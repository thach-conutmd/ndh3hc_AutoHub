ASAP2_VERSION 1 60
/begin PROJECT MG1CS022 "MG1CS022"
/begin HEADER "" VERSION "MG1CS022_62XSC_V037" PROJECT_NO MG1CS022 /end HEADER
/begin MODULE DIM ""
/begin MOD_COMMON "" BYTE_ORDER MSB_LAST ALIGNMENT_BYTE 1 ALIGNMENT_WORD 2 ALIGNMENT_LONG 4 ALIGNMENT_INT64 4 ALIGNMENT_FLOAT32_IEEE 4 ALIGNMENT_FLOAT64_IEEE 4 DATA_SIZE 32 /end MOD_COMMON
/begin AXIS_PTS InjSys_nEng10_AX "base point distribution for engine speed with 10 base points" 0x80558610 Epm_nEng RB_Axis_S16 16383.50 EngN 10 0.00 16383.50 FORMAT "%8.2" EXTENDED_LIMITS -16384.00 16383.50 DEPOSIT ABSOLUTE /end AXIS_PTS
/begin AXIS_PTS InjSys_nEng12HspVers2_AX "base point distribution for engine speed with 12 base points (Version 2 HSP Mode)" 0x80558640 Epm_nEng RB_Axis_S16 16383.50 EngN 12 0.00 16383.50 FORMAT "%8.2" EXTENDED_LIMITS -16384.00 16383.50 DEPOSIT ABSOLUTE /end AXIS_PTS
/begin AXIS_PTS InjSys_nEng12Hsp_AX "base point distribution for engine speed with 12 base points (HSP Mode)" 0x8055865A Epm_nEng RB_Axis_S16 16383.50 EngN 12 0.00 16383.50 FORMAT "%8.2" EXTENDED_LIMITS -16384.00 16383.50 DEPOSIT ABSOLUTE /end AXIS_PTS
/begin AXIS_PTS InjSys_nEng12Vers2_AX "base point distribution for engine speed with 10 base points (version 2)" 0x80558674 Epm_nEng RB_Axis_S16 16383.50 EngN 12 0.00 16383.50 FORMAT "%8.2" EXTENDED_LIMITS -16384.00 16383.50 DEPOSIT ABSOLUTE /end AXIS_PTS
/begin AXIS_PTS InjSys_nEng12_AX "base point distribution for engine speed with 12 base points" 0x8055868E Epm_nEng RB_Axis_S16 16383.50 EngN 12 0.00 16383.50 FORMAT "%8.2" EXTENDED_LIMITS -16384.00 16383.50 DEPOSIT ABSOLUTE /end AXIS_PTS
/begin AXIS_PTS InjSys_nrInj04_AX "Base point distribution number of injections with 4 base points" 0x805586A8 InjSys_nrInjLimdLoc RB_Axis_U16 65535.00 dez 4 0.00 65535.00 FORMAT "%8.2" DEPOSIT ABSOLUTE /end AXIS_PTS
/begin AXIS_PTS InjSys_nrInj08_AX "Base point distribution number of injections with 8 base points" 0x805586B2 InjSys_nrInjLimdLoc RB_Axis_U16 65535.00 dez 8 0.00 65535.00 FORMAT "%8.2" DEPOSIT ABSOLUTE /end AXIS_PTS
/begin CHARACTERISTIC InjSys_P1V4I6_HP.facWghtColdWrmEthnl_M "injection packet 1 in variant 4 / ." MAP 0x8055FEA6 RB_Map_S16S16_U8 0.9961 fak_ub_b1 0.00 0.9961
 /begin AXIS_DESCR STD_AXIS InjSys_tEng Temp_Cels 6 -3549.940 3003.560 FORMAT "%8.3" DEPOSIT ABSOLUTE /end AXIS_DESCR
 /begin AXIS_DESCR STD_AXIS InjSys_tOilLocSp Temp_Cels 4 -3549.940 3003.560 FORMAT "%8.3" DEPOSIT ABSOLUTE /end AXIS_DESCR
/end CHARACTERISTIC
/begin CHARACTERISTIC InjSys_P1V4I6_HP.facWghtColdWrm_M "injection packet 1 in variant 4 / ." MAP 0x8055FED6 RB_Map_S16S16_U8 0.9961 fak_ub_b1 0.00 0.9961
 /begin AXIS_DESCR STD_AXIS InjSys_tEng Temp_Cels 6 -3549.940 3003.560 FORMAT "%8.3" DEPOSIT ABSOLUTE /end AXIS_DESCR
 /begin AXIS_DESCR STD_AXIS InjSys_tOilLocSp Temp_Cels 4 -3549.940 3003.560 FORMAT "%8.3" DEPOSIT ABSOLUTE /end AXIS_DESCR
/end CHARACTERISTIC
/begin CHARACTERISTIC InjSys_P1V4I6_HP.facWghtTHsp_M "injection packet 1 in variant 4 / weighting factor base angle in homogenous-split mode temperature dependent" MAP 0x8055FF06 RB_Map_S16S16_U8 0.9961 fak_ub_b1 0.00 0.9961
 /begin AXIS_DESCR STD_AXIS InjSys_tEng Temp_Cels 6 -3549.940 3003.560 FORMAT "%8.3" DEPOSIT ABSOLUTE /end AXIS_DESCR
 /begin AXIS_DESCR STD_AXIS InjSys_tEngStrt Temp_Cels 4 -3549.940 3003.560 FORMAT "%8.3" DEPOSIT ABSOLUTE /end AXIS_DESCR
/end CHARACTERISTIC
/begin CHARACTERISTIC InjSys_P1V4I6_HP.facWhgtWrmColdHsp_GM "injection packet 1 in variant 4 / weighting factor warm-cold base angle in homogenous-split mode" MAP 0x8055FF36 RB_MapGroup_U16 1.000000 fak_uw_b2 0.00 1.000000 FORMAT "%8.6" EXTENDED_LIMITS 0.00 1.999969
 /begin AXIS_DESCR COM_AXIS InjSys_tEngStrt Temp_Cels 8 -3549.940 3003.560 FORMAT "%8.3" AXIS_PTS_REF InjSys_tEngStrt08_AX /end AXIS_DESCR
 /begin AXIS_DESCR COM_AXIS InjSys_nrInjLimdLoc dez 4 0.00 65535.00 FORMAT "%8.2" AXIS_PTS_REF InjSys_nrInj04_AX /end AXIS_DESCR
/end CHARACTERISTIC
/begin CHARACTERISTIC InjSys_P1V4I6_HP.flgAxVers_C "injection packet 1 in variant 4 / condition map selection with group axis in version 2" VALUE 0x8055FF76 RB_Val_Wu8 1.00000000000 B_TRUE 0.00 1.00000000000 FORMAT "%13.11" /end CHARACTERISTIC
/begin CHARACTERISTIC InjSys_P1V5I1_SHO.agBas_GM "class instance packet 1 variant 5 / base angle" MAP 0x80566974 RB_MapGroup_U8 191.3 kw_q0p75_o240 240.0 431.3 FORMAT "%5.1"
 /begin AXIS_DESCR COM_AXIS InjSys_nrInjLimdLoc dez 4 0.00 65535.00 FORMAT "%8.2" AXIS_PTS_REF InjSys_nrInj04_AX /end AXIS_DESCR
 /begin AXIS_DESCR COM_AXIS InjSys_tEngStrt Temp_Cels 8 -3549.940 3003.560 FORMAT "%8.3" AXIS_PTS_REF InjSys_tEngStrt08_AX /end AXIS_DESCR
/end CHARACTERISTIC
/begin CHARACTERISTIC InjSys_P1V5I1_SHO.agBgnCalc_M "class instance packet 1 variant 5 / Base angle calculation" MAP 0x80566994 RB_Map_U16S16_U8 191.3 kw_q0p75_o210 210.0 401.3 FORMAT "%5.1"
 /begin AXIS_DESCR STD_AXIS InjSys_nrInjLoc dez 6 0.00 65535.00 FORMAT "%8.2" DEPOSIT ABSOLUTE /end AXIS_DESCR
 /begin AXIS_DESCR STD_AXIS InjSys_tEngStrt Temp_Cels 6 -3549.940 3003.560 FORMAT "%8.3" DEPOSIT ABSOLUTE /end AXIS_DESCR
/end CHARACTERISTIC
/begin CHARACTERISTIC InjSys_P1V5I1_SHO.agBgnRstrtCld_M "class instance packet 1 variant 5 / Base angle based on cold restart conditoin" MAP 0x805669D4 RB_Map_U16S16_U8 191.3 kw_q0p75_o210 210.0 401.3 FORMAT "%5.1"
 /begin AXIS_DESCR STD_AXIS InjSys_nrInjLoc dez 6 0.00 65535.00 FORMAT "%8.2" DEPOSIT ABSOLUTE /end AXIS_DESCR
 /begin AXIS_DESCR STD_AXIS InjSys_tEngStrt Temp_Cels 6 -3549.940 3003.560 FORMAT "%8.3" DEPOSIT ABSOLUTE /end AXIS_DESCR
/end CHARACTERISTIC
/begin CHARACTERISTIC InjSys_P1V5I1_SHO.agDeltaEth_M "class instance packet 1 variant 5 / delta angle ethanol dependent" MAP 0x80566A14 RB_Map_S16S16_S16 191.2500 kw_q0p75 -96.00000 95.25000 FORMAT "%8.5" EXTENDED_LIMITS -24576.00 24575.25
 /begin AXIS_DESCR STD_AXIS InjSys_facEthLnrLocSp fak_ub_b2 4 0.00 1.992188 FORMAT "%8.6" EXTENDED_LIMITS -256.0000 255.9922 DEPOSIT ABSOLUTE /end AXIS_DESCR
 /begin AXIS_DESCR STD_AXIS InjSys_tEng Temp_Cels 4 -3549.940 3003.560 FORMAT "%8.3" DEPOSIT ABSOLUTE /end AXIS_DESCR
/end CHARACTERISTIC
/begin CHARACTERISTIC InjSys_P1V5I1_SHO.agDeltaStrt_T "class instance packet 1 variant 5 / delta angle in start" CURVE 0x80566A48 RB_Curve_S16_S8_Static 191.3 kw_q0p75 -96.00 95.25 FORMAT "%5.2"
 /begin AXIS_DESCR STD_AXIS Epm_nEngTooth10ms EngN 4 -16384.00 16383.50 FORMAT "%8.2" DEPOSIT ABSOLUTE /end AXIS_DESCR
/end CHARACTERISTIC
/begin CHARACTERISTIC InjSys_P1V5I1_SHO.flgVerCalc "class instance packet 1 variant 5 / Switch to select the base angle maps" VALUE 0x80566A56 RB_Val_Wu8 1.00000000000 B_TRUE 0.00 1.00000000000 FORMAT "%13.11" /end CHARACTERISTIC
/begin CHARACTERISTIC InjSys_P1V5I2_SHO.agBas_GM "injection packet 1 in variant 5 / base angle" MAP 0x8055FF78 RB_MapGroup_U8 191.3 kw_q0p75_o240 240.0 431.3 FORMAT "%5.1"
 /begin AXIS_DESCR COM_AXIS InjSys_nrInjLimdLoc dez 4 0.00 65535.00 FORMAT "%8.2" AXIS_PTS_REF InjSys_nrInj04_AX /end AXIS_DESCR
 /begin AXIS_DESCR COM_AXIS InjSys_tEngStrt Temp_Cels 8 -3549.940 3003.560 FORMAT "%8.3" AXIS_PTS_REF InjSys_tEngStrt08_AX /end AXIS_DESCR
/end CHARACTERISTIC
/begin CHARACTERISTIC InjSys_P1V5I2_SHO.agBgnCalc_M "injection packet 1 in variant 5 / Base angle calculation" MAP 0x8055FF98 RB_Map_U16S16_U8 191.3 kw_q0p75_o210 210.0 401.3 FORMAT "%5.1"
 /begin AXIS_DESCR STD_AXIS InjSys_nrInjLoc dez 6 0.00 65535.00 FORMAT "%8.2" DEPOSIT ABSOLUTE /end AXIS_DESCR
 /begin AXIS_DESCR STD_AXIS InjSys_tEngStrt Temp_Cels 6 -3549.940 3003.560 FORMAT "%8.3" DEPOSIT ABSOLUTE /end AXIS_DESCR
/end CHARACTERISTIC
/begin CHARACTERISTIC InjSys_P1V5I2_SHO.agBgnRstrtCld_M "injection packet 1 in variant 5 / Base angle based on cold restart conditoin" MAP 0x8055FFD8 RB_Map_U16S16_U8 191.3 kw_q0p75_o210 210.0 401.3 FORMAT "%5.1"
 /begin AXIS_DESCR STD_AXIS InjSys_nrInjLoc dez 6 0.00 65535.00 FORMAT "%8.2" DEPOSIT ABSOLUTE /end AXIS_DESCR
 /begin AXIS_DESCR STD_AXIS InjSys_tEngStrt Temp_Cels 6 -3549.940 3003.560 FORMAT "%8.3" DEPOSIT ABSOLUTE /end AXIS_DESCR
/end CHARACTERISTIC
/begin CHARACTERISTIC InjSys_P1V5I2_SHO.agDeltaEth_M "injection packet 1 in variant 5 / delta angle ethanol dependent" MAP 0x80560018 RB_Map_S16S16_S16 191.2500 kw_q0p75 -96.00000 95.25000 FORMAT "%8.5" EXTENDED_LIMITS -24576.00 24575.25
 /begin AXIS_DESCR STD_AXIS InjSys_facEthLnrLocSp fak_ub_b2 4 0.00 1.992188 FORMAT "%8.6" EXTENDED_LIMITS -256.0000 255.9922 DEPOSIT ABSOLUTE /end AXIS_DESCR
 /begin AXIS_DESCR STD_AXIS InjSys_tEng Temp_Cels 4 -3549.940 3003.560 FORMAT "%8.3" DEPOSIT ABSOLUTE /end AXIS_DESCR
/end CHARACTERISTIC
/begin CHARACTERISTIC InjSys_P1V5I2_SHO.agDeltaStrt_T "injection packet 1 in variant 5 / delta angle in start" CURVE 0x8056004C RB_Curve_S16_S8_Static 191.3 kw_q0p75 -96.00 95.25 FORMAT "%5.2"
 /begin AXIS_DESCR STD_AXIS Epm_nEngTooth10ms EngN 4 -16384.00 16383.50 FORMAT "%8.2" DEPOSIT ABSOLUTE /end AXIS_DESCR
/end CHARACTERISTIC
/begin CHARACTERISTIC InjSys_P1V5I2_SHO.flgVerCalc "injection packet 1 in variant 5 / Switch to select the base angle maps" VALUE 0x8056005A RB_Val_Wu8 1.00000000000 B_TRUE 0.00 1.00000000000 FORMAT "%13.11" /end CHARACTERISTIC
/begin CHARACTERISTIC InjSys_P1V6I1_SHO.agBas_GM "class instance packet 1 variant 6 / base angle" MAP 0x80566A58 RB_MapGroup_U8 382.5 kw_q1p5 0.00 382.5 FORMAT "%5.1"
 /begin AXIS_DESCR COM_AXIS InjSys_nrInjLimdLoc dez 4 0.00 65535.00 FORMAT "%8.2" AXIS_PTS_REF InjSys_nrInj04_AX /end AXIS_DESCR
 /begin AXIS_DESCR COM_AXIS InjSys_tEngStrt Temp_Cels 8 -3549.940 3003.560 FORMAT "%8.3" AXIS_PTS_REF InjSys_tEngStrt08_AX /end AXIS_DESCR
/end CHARACTERISTIC
/begin CHARACTERISTIC InjSys_P1V6I1_SHO.agDeltaEth_M "class instance packet 1 variant 6 / delta angle ethanol dependent" MAP 0x80566A78 RB_Map_S16S16_S16 191.2500 kw_q0p75 -96.00000 95.25000 FORMAT "%8.5" EXTENDED_LIMITS -24576.00 24575.25
 /begin AXIS_DESCR STD_AXIS InjSys_facEthLnrLocSp fak_ub_b2 4 0.00 1.992188 FORMAT "%8.6" EXTENDED_LIMITS -256.0000 255.9922 DEPOSIT ABSOLUTE /end AXIS_DESCR
 /begin AXIS_DESCR STD_AXIS InjSys_tEng Temp_Cels 4 -3549.940 3003.560 FORMAT "%8.3" DEPOSIT ABSOLUTE /end AXIS_DESCR
/end CHARACTERISTIC
/begin CHARACTERISTIC InjSys_P1V6I1_SHO.agDeltaStrt_T "class instance packet 1 variant 6 / delta angle in start" CURVE 0x80566AAC RB_Curve_S16_S8_Static 191.3 kw_q0p75 -96.00 95.25 FORMAT "%5.2"
 /begin AXIS_DESCR STD_AXIS Epm_nEngTooth10ms EngN 4 -16384.00 16383.50 FORMAT "%8.2" DEPOSIT ABSOLUTE /end AXIS_DESCR
/end CHARACTERISTIC
/begin CHARACTERISTIC InjSys_P1V6I1_SHO.facSpltAux1_GT "class instance packet 1 variant 6 / split factor auxiliary injection 1" CURVE 0x80566ABA RB_CurveGroup_U8 0.9961 fak_ub_b1 0.00 0.9961
 /begin AXIS_DESCR COM_AXIS InjSys_tEngStrt Temp_Cels 8 -3549.940 3003.560 FORMAT "%8.3" AXIS_PTS_REF InjSys_tEngStrt08_AX /end AXIS_DESCR
/end CHARACTERISTIC
/begin CHARACTERISTIC InjSys_P1V6I1_SHO.flgAbsltSplt_C "class instance packet 1 variant 6 / condition split with absolute fuel mass" VALUE 0x80566AC2 RB_Val_Wu8 1.00000000000 B_TRUE 0.00 1.00000000000 FORMAT "%13.11" /end CHARACTERISTIC
/begin CHARACTERISTIC InjSys_P1V6I1_SHO.ratFuMAux1_GT "class instance packet 1 variant 6 / relative fuel mass auxiliary injection 1" CURVE 0x80566AC4 RB_CurveGroup_U16 3071.953 rel_uw_b3072 0.00 3071.953 FORMAT "%8.3"
 /begin AXIS_DESCR COM_AXIS InjSys_tEngStrt Temp_Cels 8 -3549.940 3003.560 FORMAT "%8.3" AXIS_PTS_REF InjSys_tEngStrt08_AX /end AXIS_DESCR
/end CHARACTERISTIC
/begin CHARACTERISTIC InjSys_P1V6I1_SHO.tiBreakAux1_T "class instance packet 1 variant 6 / pause time auxiliary injection 1" CURVE 0x80566AD4 RB_Curve_S16_S16 1310.680 t_q0p04_ms 0.00 1310.680 FORMAT "%8.3" EXTENDED_LIMITS -1310.720 1310.680
 /begin AXIS_DESCR STD_AXIS InjSys_tEngStrt Temp_Cels 4 -3549.940 3003.560 FORMAT "%8.3" DEPOSIT ABSOLUTE /end AXIS_DESCR
/end CHARACTERISTIC
/begin CHARACTERISTIC InjSys_P1V7I1_SHO.agAux1_GM "class instance packet 1 variant 7 / angle auxiliary injection 1" MAP 0x80566AE6 RB_MapGroup_U8 382.5 kw_q1p5 0.00 382.5 FORMAT "%5.1"
 /begin AXIS_DESCR COM_AXIS InjSys_nrInjLimdLoc dez 4 0.00 65535.00 FORMAT "%8.2" AXIS_PTS_REF InjSys_nrInj04_AX /end AXIS_DESCR
 /begin AXIS_DESCR COM_AXIS InjSys_tEngStrt Temp_Cels 8 -3549.940 3003.560 FORMAT "%8.3" AXIS_PTS_REF InjSys_tEngStrt08_AX /end AXIS_DESCR
/end CHARACTERISTIC
/begin CHARACTERISTIC InjSys_P1V7I1_SHO.agAux2_GM "class instance packet 1 variant 7 / angle auxiliary injection 2" MAP 0x80566B06 RB_MapGroup_U8 382.5 kw_q1p5 0.00 382.5 FORMAT "%5.1"
 /begin AXIS_DESCR COM_AXIS InjSys_nrInjLimdLoc dez 4 0.00 65535.00 FORMAT "%8.2" AXIS_PTS_REF InjSys_nrInj04_AX /end AXIS_DESCR
 /begin AXIS_DESCR COM_AXIS InjSys_tEngStrt Temp_Cels 8 -3549.940 3003.560 FORMAT "%8.3" AXIS_PTS_REF InjSys_tEngStrt08_AX /end AXIS_DESCR
/end CHARACTERISTIC
/begin CHARACTERISTIC InjSys_P1V7I1_SHO.agBas_GM "class instance packet 1 variant 7 / base angle" MAP 0x80566B26 RB_MapGroup_U8 382.5 kw_q1p5 0.00 382.5 FORMAT "%5.1"
 /begin AXIS_DESCR COM_AXIS InjSys_nrInjLimdLoc dez 4 0.00 65535.00 FORMAT "%8.2" AXIS_PTS_REF InjSys_nrInj04_AX /end AXIS_DESCR
 /begin AXIS_DESCR COM_AXIS InjSys_tEngStrt Temp_Cels 8 -3549.940 3003.560 FORMAT "%8.3" AXIS_PTS_REF InjSys_tEngStrt08_AX /end AXIS_DESCR
/end CHARACTERISTIC
/begin CHARACTERISTIC InjSys_P1V7I1_SHO.agDeltaAux1Eth_M "class instance packet 1 variant 7 / delta angle auxiliary injection 1 ethanol dependent" MAP 0x80566B46 RB_Map_S16S16_S16 191.2500 kw_q0p75 -96.00000 95.25000 FORMAT "%8.5" EXTENDED_LIMITS -24576.00 24575.25
 /begin AXIS_DESCR STD_AXIS InjSys_facEthLnrLocSp fak_ub_b2 4 0.00 1.992188 FORMAT "%8.6" EXTENDED_LIMITS -256.0000 255.9922 DEPOSIT ABSOLUTE /end AXIS_DESCR
 /begin AXIS_DESCR STD_AXIS InjSys_tEng Temp_Cels 4 -3549.940 3003.560 FORMAT "%8.3" DEPOSIT ABSOLUTE /end AXIS_DESCR
/end CHARACTERISTIC
/begin CHARACTERISTIC InjSys_P1V7I1_SHO.agDeltaAux1Strt_T "class instance packet 1 variant 7 / delta angle auxiliary injection 1 in start" CURVE 0x80566B7A RB_Curve_S16_S8_Static 191.3 kw_q0p75 -96.00 95.25 FORMAT "%5.2"
 /begin AXIS_DESCR STD_AXIS Epm_nEngTooth10ms EngN 4 -16384.00 16383.50 FORMAT "%8.2" DEPOSIT ABSOLUTE /end AXIS_DESCR
/end CHARACTERISTIC
/begin CHARACTERISTIC InjSys_P1V7I1_SHO.agDeltaAux2Eth_M "class instance packet 1 variant 7 / delta angle auxiliary injection 2 ethanol dependent" MAP 0x80566B88 RB_Map_S16S16_S16 191.2500 kw_q0p75 -96.00000 95.25000 FORMAT "%8.5" EXTENDED_LIMITS -24576.00 24575.25
 /begin AXIS_DESCR STD_AXIS InjSys_facEthLnrLocSp fak_ub_b2 4 0.00 1.992188 FORMAT "%8.6" EXTENDED_LIMITS -256.0000 255.9922 DEPOSIT ABSOLUTE /end AXIS_DESCR
 /begin AXIS_DESCR STD_AXIS InjSys_tEng Temp_Cels 4 -3549.940 3003.560 FORMAT "%8.3" DEPOSIT ABSOLUTE /end AXIS_DESCR
/end CHARACTERISTIC
/begin CHARACTERISTIC InjSys_P1V7I1_SHO.agDeltaAux2Strt_T "class instance packet 1 variant 7 / delta angle auxiliary injection 2 in start" CURVE 0x80566BBC RB_Curve_S16_S8_Static 191.3 kw_q0p75 -96.00 95.25 FORMAT "%5.2"
 /begin AXIS_DESCR STD_AXIS Epm_nEngTooth10ms EngN 4 -16384.00 16383.50 FORMAT "%8.2" DEPOSIT ABSOLUTE /end AXIS_DESCR
/end CHARACTERISTIC
/begin CHARACTERISTIC InjSys_P1V7I1_SHO.agDeltaEth_M "class instance packet 1 variant 7 / delta angle ethanol dependent" MAP 0x80566BCA RB_Map_S16S16_S16 191.2500 kw_q0p75 -96.00000 95.25000 FORMAT "%8.5" EXTENDED_LIMITS -24576.00 24575.25
 /begin AXIS_DESCR STD_AXIS InjSys_facEthLnrLocSp fak_ub_b2 4 0.00 1.992188 FORMAT "%8.6" EXTENDED_LIMITS -256.0000 255.9922 DEPOSIT ABSOLUTE /end AXIS_DESCR
 /begin AXIS_DESCR STD_AXIS InjSys_tEng Temp_Cels 4 -3549.940 3003.560 FORMAT "%8.3" DEPOSIT ABSOLUTE /end AXIS_DESCR
/end CHARACTERISTIC
/begin CHARACTERISTIC InjSys_P1V7I1_SHO.agDeltaStrt_T "class instance packet 1 variant 7 / delta angle in start" CURVE 0x80566BFE RB_Curve_S16_S8_Static 191.3 kw_q0p75 -96.00 95.25 FORMAT "%5.2"
 /begin AXIS_DESCR STD_AXIS Epm_nEngTooth10ms EngN 4 -16384.00 16383.50 FORMAT "%8.2" DEPOSIT ABSOLUTE /end AXIS_DESCR
/end CHARACTERISTIC
/begin CHARACTERISTIC InjSys_P1V7I1_SHO.facSpltAux1_GT "class instance packet 1 variant 7 / split factor auxiliary injection 1" CURVE 0x80566C0C RB_CurveGroup_U8 0.9961 fak_ub_b1 0.00 0.9961
 /begin AXIS_DESCR COM_AXIS InjSys_tEngStrt Temp_Cels 8 -3549.940 3003.560 FORMAT "%8.3" AXIS_PTS_REF InjSys_tEngStrt08_AX /end AXIS_DESCR
/end CHARACTERISTIC
/begin CHARACTERISTIC InjSys_P1V7I1_SHO.facSpltAux2_GT "class instance packet 1 variant 7 / split factor auxiliary injection 2" CURVE 0x80566C14 RB_CurveGroup_U8 0.9961 fak_ub_b1 0.00 0.9961
 /begin AXIS_DESCR COM_AXIS InjSys_tEngStrt Temp_Cels 8 -3549.940 3003.560 FORMAT "%8.3" AXIS_PTS_REF InjSys_tEngStrt08_AX /end AXIS_DESCR
/end CHARACTERISTIC
/begin CHARACTERISTIC InjSys_P1V7I1_SHO.flgAbsltSplt_C "class instance packet 1 variant 7 / condition split with absolute fuel mass" VALUE 0x80566C1C RB_Val_Wu8 1.00000000000 B_TRUE 0.00 1.00000000000 FORMAT "%13.11" /end CHARACTERISTIC
/begin CHARACTERISTIC InjSys_P1V7I1_SHO.flgAgAux_C "class instance packet 1 variant 7 / condition angle for auxiliary injections" VALUE 0x80566C1D RB_Val_Wu8 1.00000000000 B_TRUE 0.00 1.00000000000 FORMAT "%13.11" /end CHARACTERISTIC
/begin CHARACTERISTIC InjSys_P1V7I1_SHO.ratFuMAux1_GT "class instance packet 1 variant 7 / relative fuel mass auxiliary injection 1" CURVE 0x80566C1E RB_CurveGroup_U16 3071.953 rel_uw_b3072 0.00 3071.953 FORMAT "%8.3"
 /begin AXIS_DESCR COM_AXIS InjSys_tEngStrt Temp_Cels 8 -3549.940 3003.560 FORMAT "%8.3" AXIS_PTS_REF InjSys_tEngStrt08_AX /end AXIS_DESCR
/end CHARACTERISTIC
/begin CHARACTERISTIC InjSys_P1V7I1_SHO.ratFuMAux2_GT "class instance packet 1 variant 7 / relative fuel mass auxiliary injection 2" CURVE 0x80566C2E RB_CurveGroup_U16 3071.953 rel_uw_b3072 0.00 3071.953 FORMAT "%8.3"
 /begin AXIS_DESCR COM_AXIS InjSys_tEngStrt Temp_Cels 8 -3549.940 3003.560 FORMAT "%8.3" AXIS_PTS_REF InjSys_tEngStrt08_AX /end AXIS_DESCR
/end CHARACTERISTIC
/begin CHARACTERISTIC InjSys_P1V7I1_SHO.stAgEnd_C "class instance packet 1 variant 7 / state end angle" VALUE 0x80566C3E RB_Val_Wu8 7.000 dez 0.00 7.000 FORMAT "%5.3" EXTENDED_LIMITS 0.00 255.0 /end CHARACTERISTIC
/begin CHARACTERISTIC InjSys_P1V7I1_SHO.tiBreakAux_T "class instance packet 1 variant 7 / pause time auxiliary injections" CURVE 0x80566C40 RB_Curve_S16_S16 1310.680 t_q0p04_ms 0.00 1310.680 FORMAT "%8.3" EXTENDED_LIMITS -1310.720 1310.680
 /begin AXIS_DESCR STD_AXIS InjSys_tEngStrt Temp_Cels 4 -3549.940 3003.560 FORMAT "%8.3" DEPOSIT ABSOLUTE /end AXIS_DESCR
/end CHARACTERISTIC
/begin CHARACTERISTIC InjSys_P2APPL.agAux1_C "class instance packet 2 for calibration / angle auxiliary injection 1" VALUE 0x80566C52 RB_Val_Ws16 1535.977 kw_q0p0234 -768.0000 767.9766 FORMAT "%8.4" /end CHARACTERISTIC
/begin CHARACTERISTIC InjSys_P2APPL.agAux2_C "class instance packet 2 for calibration / angle auxiliary injection 2" VALUE 0x80566C54 RB_Val_Ws16 1535.977 kw_q0p0234 -768.0000 767.9766 FORMAT "%8.4" /end CHARACTERISTIC
/begin CHARACTERISTIC InjSys_P2APPL.agBas_C "class instance packet 2 for calibration / base angle" VALUE 0x80566C56 RB_Val_Ws16 1535.977 kw_q0p0234 -768.0000 767.9766 FORMAT "%8.4" /end CHARACTERISTIC
/begin CHARACTERISTIC InjSys_P2APPL.facSpltAux1_C "class instance packet 2 for calibration / split factor auxiliary injection 1" VALUE 0x80566C58 RB_Val_Wu8 0.9961 fak_ub_b1 0.00 0.9961 /end CHARACTERISTIC
/begin CHARACTERISTIC InjSys_P2APPL.facSpltAux2_C "class instance packet 2 for calibration / split factor auxiliary injection 2" VALUE 0x80566C59 RB_Val_Wu8 0.9961 fak_ub_b1 0.00 0.9961 /end CHARACTERISTIC
/begin CHARACTERISTIC InjSys_P2APPL.facSpltPkt_C "class instance packet 2 for calibration / split factor packet" VALUE 0x80566C5A RB_Val_Wu8 0.9961 fak_ub_b1 0.00 0.9961 /end CHARACTERISTIC
/begin CHARACTERISTIC InjSys_P2APPL.flgAbsltSplt_C "class instance packet 2 for calibration / condition split with absolute fuel mass" VALUE 0x80566C5B RB_Val_Wu8 1.00000000000 B_TRUE 0.00 1.00000000000 FORMAT "%13.11" /end CHARACTERISTIC
/begin CHARACTERISTIC InjSys_P2APPL.flgAgAux_C "class instance packet 2 for calibration / condition angle addressing for auxiliary injections" VALUE 0x80566C5C RB_Val_Wu8 1.00000000000 B_TRUE 0.00 1.00000000000 FORMAT "%13.11" /end CHARACTERISTIC
/begin CHARACTERISTIC InjSys_P2APPL.flgAgEnd_C "class instance packet 2 for calibration / condition end angle" VALUE 0x80566C5D RB_Val_Wu8 1.00000000000 B_TRUE 0.00 1.00000000000 FORMAT "%13.11" /end CHARACTERISTIC
/begin CHARACTERISTIC InjSys_P2APPL.flgPktCoupl_C "class instance packet 2 for calibration / condition packet coupling with break time" VALUE 0x80566C5E RB_Val_Wu8 1.00000000000 B_TRUE 0.00 1.00000000000 FORMAT "%13.11" /end CHARACTERISTIC
/begin CHARACTERISTIC InjSys_P2APPL.ratFuMAux1_C "class instance packet 2 for calibration / relative fuel mass auxiliary injection 1" VALUE 0x80566C60 RB_Val_Wu16 3071.953 rel_uw_b3072 0.00 3071.953 FORMAT "%8.3" /end CHARACTERISTIC
/begin CHARACTERISTIC InjSys_P2APPL.ratFuMAux2_C "class instance packet 2 for calibration / relative fuel mass auxiliary injection 2" VALUE 0x80566C62 RB_Val_Wu16 3071.953 rel_uw_b3072 0.00 3071.953 FORMAT "%8.3" /end CHARACTERISTIC
/begin CHARACTERISTIC InjSys_P2APPL.ratFuMBas_C "class instance packet 2 for calibration / relative fuel mass base injection" VALUE 0x80566C64 RB_Val_Wu16 3071.953 rel_uw_b3072 0.00 3071.953 FORMAT "%8.3" /end CHARACTERISTIC
/begin CHARACTERISTIC InjSys_P2APPL.stAgEnd_C "class instance packet 2 for calibration / state end angle coupled" VALUE 0x80566C66 RB_Val_Wu8 255.0 dez 0.00 255.0 FORMAT "%5.1" /end CHARACTERISTIC
/begin CHARACTERISTIC InjSys_P2APPL.tiBreakAux1_C "class instance packet 2 for calibration / break time auxiliary injection 1" VALUE 0x80566C68 RB_Val_Ws16 1310.720 t_q0p04_ms -1310.720 0.00 FORMAT "%8.3" EXTENDED_LIMITS -1310.720 1310.680 /end CHARACTERISTIC
/begin CHARACTERISTIC InjSys_P2APPL.tiBreakAux2_C "class instance packet 2 for calibration / break time auxiliary injection 2" VALUE 0x80566C6A RB_Val_Ws16 1310.720 t_q0p04_ms -1310.720 0.00 FORMAT "%8.3" EXTENDED_LIMITS -1310.720 1310.680 /end CHARACTERISTIC
/begin CHARACTERISTIC InjSys_P2APPL.tiBreakPkt_C "class instance packet 2 for calibration / break time for packet coupling" VALUE 0x80566C6C RB_Val_Ws16 1310.720 t_q0p04_ms -1310.720 0.00 FORMAT "%8.3" EXTENDED_LIMITS -1310.720 1310.680 /end CHARACTERISTIC
/begin CHARACTERISTIC InjSys_P2V1I1_HP.agBasHiEthnl_GM "class instance packet 2 variant 1 / ." MAP 0x80566C74 RB_MapGroup_S8 382.5 kw_q1p5 -192.0 190.5 FORMAT "%5.1"
 /begin AXIS_DESCR COM_AXIS Epm_nEng EngN 12 0.00 16383.50 FORMAT "%8.2" EXTENDED_LIMITS -16384.00 16383.50 AXIS_PTS_REF InjSys_nEng12Hsp_AX /end AXIS_DESCR
 /begin AXIS_DESCR COM_AXIS InjSys_ratAirMAgSpAxisInp rel_uw_q0p0234 12 0.00 1535.977 FORMAT "%8.3" AXIS_PTS_REF InjSys_ratAirM12AgSpHsp_AX /end AXIS_DESCR
/end CHARACTERISTIC
/begin CHARACTERISTIC InjSys_P2V1I1_HP.agBasHiVers2Ethnl_GM "class instance packet 2 variant 1 / ." MAP 0x80566D04 RB_MapGroup_S8 382.5 kw_q1p5 -192.0 190.5 FORMAT "%5.1"
 /begin AXIS_DESCR COM_AXIS Epm_nEng EngN 12 0.00 16383.50 FORMAT "%8.2" EXTENDED_LIMITS -16384.00 16383.50 AXIS_PTS_REF InjSys_nEng12HspVers2_AX /end AXIS_DESCR
 /begin AXIS_DESCR COM_AXIS InjSys_ratAirMAgSpVers2AxisInp rel_uw_q0p0234 12 0.00 1535.977 FORMAT "%8.3" AXIS_PTS_REF InjSys_ratAirM12AgSpHspVers2_AX /end AXIS_DESCR
/end CHARACTERISTIC
/begin CHARACTERISTIC InjSys_P2V1I1_HP.agBasHiVers2_GM "class instance packet 2 variant 1 / base angle for interpolation (version 2)" MAP 0x80566D94 RB_MapGroup_S8 382.5 kw_q1p5 -192.0 190.5 FORMAT "%5.1"
 /begin AXIS_DESCR COM_AXIS Epm_nEng EngN 12 0.00 16383.50 FORMAT "%8.2" EXTENDED_LIMITS -16384.00 16383.50 AXIS_PTS_REF InjSys_nEng12HspVers2_AX /end AXIS_DESCR
 /begin AXIS_DESCR COM_AXIS InjSys_ratAirMAgSpVers2AxisInp rel_uw_q0p0234 12 0.00 1535.977 FORMAT "%8.3" AXIS_PTS_REF InjSys_ratAirM12AgSpHspVers2_AX /end AXIS_DESCR
/end CHARACTERISTIC
/begin CHARACTERISTIC InjSys_P2V1I1_HP.agBasHi_GM "class instance packet 2 variant 1 / base angle for interpolation" MAP 0x80566E24 RB_MapGroup_S8 382.5 kw_q1p5 -192.0 190.5 FORMAT "%5.1"
 /begin AXIS_DESCR COM_AXIS Epm_nEng EngN 12 0.00 16383.50 FORMAT "%8.2" EXTENDED_LIMITS -16384.00 16383.50 AXIS_PTS_REF InjSys_nEng12Hsp_AX /end AXIS_DESCR
 /begin AXIS_DESCR COM_AXIS InjSys_ratAirMAgSpAxisInp rel_uw_q0p0234 12 0.00 1535.977 FORMAT "%8.3" AXIS_PTS_REF InjSys_ratAirM12AgSpHsp_AX /end AXIS_DESCR
/end CHARACTERISTIC
/begin CHARACTERISTIC InjSys_P2V1I1_HP.agBasLoEthnl_GM "class instance packet 2 variant 1 / ." MAP 0x80566EB4 RB_MapGroup_S8 382.5 kw_q1p5 -192.0 190.5 FORMAT "%5.1"
 /begin AXIS_DESCR COM_AXIS Epm_nEng EngN 12 0.00 16383.50 FORMAT "%8.2" EXTENDED_LIMITS -16384.00 16383.50 AXIS_PTS_REF InjSys_nEng12Hsp_AX /end AXIS_DESCR
 /begin AXIS_DESCR COM_AXIS InjSys_ratAirMAgSpAxisInp rel_uw_q0p0234 12 0.00 1535.977 FORMAT "%8.3" AXIS_PTS_REF InjSys_ratAirM12AgSpHsp_AX /end AXIS_DESCR
/end CHARACTERISTIC
/begin CHARACTERISTIC InjSys_P2V1I1_HP.agBasLoVers2Ethnl_GM "class instance packet 2 variant 1 / ." MAP 0x80566F44 RB_MapGroup_S8 382.5 kw_q1p5 -192.0 190.5 FORMAT "%5.1"
 /begin AXIS_DESCR COM_AXIS Epm_nEng EngN 12 0.00 16383.50 FORMAT "%8.2" EXTENDED_LIMITS -16384.00 16383.50 AXIS_PTS_REF InjSys_nEng12HspVers2_AX /end AXIS_DESCR
 /begin AXIS_DESCR COM_AXIS InjSys_ratAirMAgSpVers2AxisInp rel_uw_q0p0234 12 0.00 1535.977 FORMAT "%8.3" AXIS_PTS_REF InjSys_ratAirM12AgSpHspVers2_AX /end AXIS_DESCR
/end CHARACTERISTIC
/begin CHARACTERISTIC InjSys_P2V1I1_HP.agBasLoVers2_GM "class instance packet 2 variant 1 / base angle for interpolation (version 2)" MAP 0x80566FD4 RB_MapGroup_S8 382.5 kw_q1p5 -192.0 190.5 FORMAT "%5.1"
 /begin AXIS_DESCR COM_AXIS Epm_nEng EngN 12 0.00 16383.50 FORMAT "%8.2" EXTENDED_LIMITS -16384.00 16383.50 AXIS_PTS_REF InjSys_nEng12HspVers2_AX /end AXIS_DESCR
 /begin AXIS_DESCR COM_AXIS InjSys_ratAirMAgSpVers2AxisInp rel_uw_q0p0234 12 0.00 1535.977 FORMAT "%8.3" AXIS_PTS_REF InjSys_ratAirM12AgSpHspVers2_AX /end AXIS_DESCR
/end CHARACTERISTIC
/begin CHARACTERISTIC InjSys_P2V1I1_HP.agBasLo_GM "class instance packet 2 variant 1 / base angle for interpolation" MAP 0x80567064 RB_MapGroup_S8 382.5 kw_q1p5 -192.0 190.5 FORMAT "%5.1"
 /begin AXIS_DESCR COM_AXIS Epm_nEng EngN 12 0.00 16383.50 FORMAT "%8.2" EXTENDED_LIMITS -16384.00 16383.50 AXIS_PTS_REF InjSys_nEng12Hsp_AX /end AXIS_DESCR
 /begin AXIS_DESCR COM_AXIS InjSys_ratAirMAgSpAxisInp rel_uw_q0p0234 12 0.00 1535.977 FORMAT "%8.3" AXIS_PTS_REF InjSys_ratAirM12AgSpHsp_AX /end AXIS_DESCR
/end CHARACTERISTIC
/begin CHARACTERISTIC InjSys_P2V1I1_HP.agBasTPistColdVers2_GM "class instance packet 2 variant 1 / base angle for interpolation cold TSA mode" MAP 0x805670F4 RB_MapGroup_U8 382.5 kw_q1p5 0.00 382.5 FORMAT "%5.1"
 /begin AXIS_DESCR COM_AXIS Epm_nEng EngN 12 0.00 16383.50 FORMAT "%8.2" EXTENDED_LIMITS -16384.00 16383.50 AXIS_PTS_REF InjSys_nEng12HspVers2_AX /end AXIS_DESCR
 /begin AXIS_DESCR COM_AXIS InjSys_ratAirMAgSpVers2AxisInp rel_uw_q0p0234 12 0.00 1535.977 FORMAT "%8.3" AXIS_PTS_REF InjSys_ratAirM12AgSpHspVers2_AX /end AXIS_DESCR
/end CHARACTERISTIC
/begin CHARACTERISTIC InjSys_P2V1I1_HP.agBasTPistCold_GM "class instance packet 2 variant 1 / base angle for interpolation cold TSA mode" MAP 0x80567184 RB_MapGroup_U8 382.5 kw_q1p5 0.00 382.5 FORMAT "%5.1"
 /begin AXIS_DESCR COM_AXIS Epm_nEng EngN 12 0.00 16383.50 FORMAT "%8.2" EXTENDED_LIMITS -16384.00 16383.50 AXIS_PTS_REF InjSys_nEng12Hsp_AX /end AXIS_DESCR
 /begin AXIS_DESCR COM_AXIS InjSys_ratAirMAgSpAxisInp rel_uw_q0p0234 12 0.00 1535.977 FORMAT "%8.3" AXIS_PTS_REF InjSys_ratAirM12AgSpHsp_AX /end AXIS_DESCR
/end CHARACTERISTIC
/begin CHARACTERISTIC InjSys_P2V1I1_HP.agBasTPistWrmVers2_GM "class instance packet 2 variant 1 / base angle for interpolation Warm TSA mode (Version 2)" MAP 0x80567214 RB_MapGroup_U8 382.5 kw_q1p5 0.00 382.5 FORMAT "%5.1"
 /begin AXIS_DESCR COM_AXIS Epm_nEng EngN 12 0.00 16383.50 FORMAT "%8.2" EXTENDED_LIMITS -16384.00 16383.50 AXIS_PTS_REF InjSys_nEng12HspVers2_AX /end AXIS_DESCR
 /begin AXIS_DESCR COM_AXIS InjSys_ratAirMAgSpVers2AxisInp rel_uw_q0p0234 12 0.00 1535.977 FORMAT "%8.3" AXIS_PTS_REF InjSys_ratAirM12AgSpHspVers2_AX /end AXIS_DESCR
/end CHARACTERISTIC
/begin CHARACTERISTIC InjSys_P2V1I1_HP.agBasTPistWrm_GM "class instance packet 2 variant 1 / base angle for interpolation Warm TSA mode" MAP 0x805672A4 RB_MapGroup_U8 382.5 kw_q1p5 0.00 382.5 FORMAT "%5.1"
 /begin AXIS_DESCR COM_AXIS Epm_nEng EngN 12 0.00 16383.50 FORMAT "%8.2" EXTENDED_LIMITS -16384.00 16383.50 AXIS_PTS_REF InjSys_nEng12Hsp_AX /end AXIS_DESCR
 /begin AXIS_DESCR COM_AXIS InjSys_ratAirMAgSpAxisInp rel_uw_q0p0234 12 0.00 1535.977 FORMAT "%8.3" AXIS_PTS_REF InjSys_ratAirM12AgSpHsp_AX /end AXIS_DESCR
/end CHARACTERISTIC
/begin CHARACTERISTIC InjSys_P2V1I1_HP.facEthnlAgBas_T "class instance packet 2 variant 1 / ." CURVE 0x80567334 RB_Curve_U8_U8 0.9961 fak_ub_b1 0.00 0.9961
 /begin AXIS_DESCR STD_AXIS fethstoeLocSp fak_ub_b2 4 0.00 1.992188 FORMAT "%8.6" DEPOSIT ABSOLUTE /end AXIS_DESCR
/end CHARACTERISTIC
/begin CHARACTERISTIC InjSys_P2V1I1_HP.facEthnlAgBgn_T "class instance packet 2 variant 1 / ." CURVE 0x8056733D RB_Curve_U8_U8 0.9961 fak_ub_b1 0.00 0.9961
 /begin AXIS_DESCR STD_AXIS fethstoeLocSp fak_ub_b2 4 0.00 1.992188 FORMAT "%8.6" DEPOSIT ABSOLUTE /end AXIS_DESCR
/end CHARACTERISTIC
/begin CHARACTERISTIC InjSys_P2V1I1_HP.facFuMBasHiEthnl_GM "class instance packet 2 variant 1 / relative fuel mass high ethanol dependent" MAP 0x80567346 RB_MapGroup_U8 0.9961 fak_ub_b1 0.00 0.9961
 /begin AXIS_DESCR COM_AXIS Epm_nEng EngN 10 0.00 16383.50 FORMAT "%8.2" EXTENDED_LIMITS -16384.00 16383.50 AXIS_PTS_REF InjSys_nEng10_AX /end AXIS_DESCR
 /begin AXIS_DESCR COM_AXIS InjSys_ratAirMAxisInp rel_uw_q0p0234 8 0.00 1535.977 FORMAT "%8.3" AXIS_PTS_REF InjSys_ratAirM08_AX /end AXIS_DESCR
/end CHARACTERISTIC
/begin CHARACTERISTIC InjSys_P2V1I1_HP.facFuMBasLoEthnl_GM "class instance packet 2 variant 1 / relative fuel mass low ethanol dependent" MAP 0x80567396 RB_MapGroup_U8 0.9961 fak_ub_b1 0.00 0.9961
 /begin AXIS_DESCR COM_AXIS Epm_nEng EngN 10 0.00 16383.50 FORMAT "%8.2" EXTENDED_LIMITS -16384.00 16383.50 AXIS_PTS_REF InjSys_nEng10_AX /end AXIS_DESCR
 /begin AXIS_DESCR COM_AXIS InjSys_ratAirMAxisInp rel_uw_q0p0234 8 0.00 1535.977 FORMAT "%8.3" AXIS_PTS_REF InjSys_ratAirM08_AX /end AXIS_DESCR
/end CHARACTERISTIC
/begin CHARACTERISTIC InjSys_P2V1I1_HP.facSpltBasCorrnLoT_GM "class instance packet 2 variant 1 / split factor correction base injection dependent of temperature and number of injections" MAP 0x805673E6 RB_MapGroup_U8 1.992188 fak_ub_b2 0.00 1.992188 FORMAT "%8.6"
 /begin AXIS_DESCR COM_AXIS InjSys_tEng Temp_Cels 8 -3549.940 3003.560 FORMAT "%8.3" AXIS_PTS_REF InjSys_tEng08_AX /end AXIS_DESCR
 /begin AXIS_DESCR COM_AXIS InjSys_nrInjLimdLoc dez 8 0.00 65535.00 FORMAT "%8.2" AXIS_PTS_REF InjSys_nrInj08_AX /end AXIS_DESCR
/end CHARACTERISTIC
/begin CHARACTERISTIC InjSys_P2V1I1_HP.facSpltBasHiExtd_GM "class instance packet 2 variant 1 / split factor base injection for interpolation" MAP 0x80567426 RB_MapGroup_U8 0.9961 fak_ub_b1 0.00 0.9961
 /begin AXIS_DESCR COM_AXIS Epm_nEng EngN 12 0.00 16383.50 FORMAT "%8.2" EXTENDED_LIMITS -16384.00 16383.50 AXIS_PTS_REF InjSys_nEng12Vers2_AX /end AXIS_DESCR
 /begin AXIS_DESCR COM_AXIS InjSys_ratAirMVers2AxisInp rel_uw_q0p0234 12 0.00 1535.977 FORMAT "%8.3" AXIS_PTS_REF InjSys_ratAirM12Vers2_AX /end AXIS_DESCR
/end CHARACTERISTIC
/begin CHARACTERISTIC InjSys_P2V1I1_HP.facSpltBasHi_GM "class instance packet 2 variant 1 / split factor base injection for interpolation" MAP 0x805674B6 RB_MapGroup_U8 0.9961 fak_ub_b1 0.00 0.9961
 /begin AXIS_DESCR COM_AXIS Epm_nEng EngN 10 0.00 16383.50 FORMAT "%8.2" EXTENDED_LIMITS -16384.00 16383.50 AXIS_PTS_REF InjSys_nEng10_AX /end AXIS_DESCR
 /begin AXIS_DESCR COM_AXIS InjSys_ratAirMAxisInp rel_uw_q0p0234 8 0.00 1535.977 FORMAT "%8.3" AXIS_PTS_REF InjSys_ratAirM08_AX /end AXIS_DESCR
/end CHARACTERISTIC
/begin CHARACTERISTIC InjSys_P2V1I1_HP.facSpltBasLoEthnl_GM "class instance packet 2 variant 1 / split factor low ethanol dependent" MAP 0x80567506 RB_MapGroup_U8 1.992188 fak_ub_b2 0.00 1.992188 FORMAT "%8.6"
 /begin AXIS_DESCR COM_AXIS InjSys_tEng Temp_Cels 8 -3549.940 3003.560 FORMAT "%8.3" AXIS_PTS_REF InjSys_tEng08_AX /end AXIS_DESCR
 /begin AXIS_DESCR COM_AXIS InjSys_nrInjLimdLoc dez 8 0.00 65535.00 FORMAT "%8.2" AXIS_PTS_REF InjSys_nrInj08_AX /end AXIS_DESCR
/end CHARACTERISTIC
/begin CHARACTERISTIC InjSys_P2V1I1_HP.facSpltBasLoExtd_GM "class instance packet 2 variant 1 / split factor base injection for interpolation" MAP 0x80567546 RB_MapGroup_U8 0.9961 fak_ub_b1 0.00 0.9961
 /begin AXIS_DESCR COM_AXIS Epm_nEng EngN 12 0.00 16383.50 FORMAT "%8.2" EXTENDED_LIMITS -16384.00 16383.50 AXIS_PTS_REF InjSys_nEng12Vers2_AX /end AXIS_DESCR
 /begin AXIS_DESCR COM_AXIS InjSys_ratAirMVers2AxisInp rel_uw_q0p0234 12 0.00 1535.977 FORMAT "%8.3" AXIS_PTS_REF InjSys_ratAirM12Vers2_AX /end AXIS_DESCR
/end CHARACTERISTIC
/begin CHARACTERISTIC InjSys_P2V1I1_HP.facSpltBasLo_GM "class instance packet 2 variant 1 / split factor base injection for interpolation" MAP 0x805675D6 RB_MapGroup_U8 0.9961 fak_ub_b1 0.00 0.9961
 /begin AXIS_DESCR COM_AXIS Epm_nEng EngN 10 0.00 16383.50 FORMAT "%8.2" EXTENDED_LIMITS -16384.00 16383.50 AXIS_PTS_REF InjSys_nEng10_AX /end AXIS_DESCR
 /begin AXIS_DESCR COM_AXIS InjSys_ratAirMAxisInp rel_uw_q0p0234 8 0.00 1535.977 FORMAT "%8.3" AXIS_PTS_REF InjSys_ratAirM08_AX /end AXIS_DESCR
/end CHARACTERISTIC
/begin CHARACTERISTIC InjSys_P2V1I1_HP.facTInjAgEthnl_M "class instance packet 2 variant 1 / ." MAP 0x80567626 RB_Map_S16S16_U8 0.9961 fak_ub_b1 0.00 0.9961
 /begin AXIS_DESCR STD_AXIS InjSys_tEng Temp_Cels 8 -3549.940 3003.560 FORMAT "%8.3" DEPOSIT ABSOLUTE /end AXIS_DESCR
 /begin AXIS_DESCR STD_AXIS InjSys_tOilLocSp Temp_Cels 8 -3549.940 3003.560 FORMAT "%8.3" DEPOSIT ABSOLUTE /end AXIS_DESCR
/end CHARACTERISTIC
/begin CHARACTERISTIC InjSys_P2V1I1_HP.facTInjAg_M "class instance packet 2 variant 1 / ." MAP 0x8056768A RB_Map_S16S16_U8 0.9961 fak_ub_b1 0.00 0.9961
 /begin AXIS_DESCR STD_AXIS InjSys_tEng Temp_Cels 8 -3549.940 3003.560 FORMAT "%8.3" DEPOSIT ABSOLUTE /end AXIS_DESCR
 /begin AXIS_DESCR STD_AXIS InjSys_tOilLocSp Temp_Cels 8 -3549.940 3003.560 FORMAT "%8.3" DEPOSIT ABSOLUTE /end AXIS_DESCR
/end CHARACTERISTIC
/begin CHARACTERISTIC InjSys_P2V1I1_HP.facTPistCold_M "class instance packet 2 variant 1 / Engine temperature and oil temperature based map for injection angle correction" MAP 0x805676EE RB_Map_S16S16_U8 0.9961 fak_ub_b1 0.00 0.9961
 /begin AXIS_DESCR STD_AXIS InjSys_tEng Temp_Cels 6 -3549.940 3003.560 FORMAT "%8.3" DEPOSIT ABSOLUTE /end AXIS_DESCR
 /begin AXIS_DESCR STD_AXIS InjSys_tOilLocSp Temp_Cels 6 -3549.940 3003.560 FORMAT "%8.3" DEPOSIT ABSOLUTE /end AXIS_DESCR
/end CHARACTERISTIC
/begin CHARACTERISTIC InjSys_P2V1I1_HP.facTPist_M "class instance packet 2 variant 1 / piston temperature based map for injection angle correction" MAP 0x8056772E RB_Map_S16S16_U8 0.9961 fak_ub_b1 0.00 0.9961
 /begin AXIS_DESCR STD_AXIS InjSys_tPistBas Temp_Cels 6 -3549.940 3003.560 FORMAT "%8.3" DEPOSIT ABSOLUTE /end AXIS_DESCR
 /begin AXIS_DESCR STD_AXIS InjSys_tPistDelta temp_q0p1 6 -3276.800 3276.700 FORMAT "%8.3" DEPOSIT ABSOLUTE /end AXIS_DESCR
/end CHARACTERISTIC
/begin CHARACTERISTIC InjSys_P2V1I1_HP.facWghtAgBasTEthnl_M "class instance packet 2 variant 1 / weighting factor base angle ethanol dependent" MAP 0x8056776E RB_Map_S16S16_U8 0.9961 fak_ub_b1 0.00 0.9961
 /begin AXIS_DESCR STD_AXIS InjSys_tEng Temp_Cels 6 -3549.940 3003.560 FORMAT "%8.3" DEPOSIT ABSOLUTE /end AXIS_DESCR
 /begin AXIS_DESCR STD_AXIS InjSys_tEngStrt Temp_Cels 4 -3549.940 3003.560 FORMAT "%8.3" DEPOSIT ABSOLUTE /end AXIS_DESCR
/end CHARACTERISTIC
/begin CHARACTERISTIC InjSys_P2V1I1_HP.facWghtAgBasT_M "class instance packet 2 variant 1 / weighting factor base angle temperature dependent" MAP 0x8056779E RB_Map_S16S16_U8 0.9961 fak_ub_b1 0.00 0.9961
 /begin AXIS_DESCR STD_AXIS InjSys_tEng Temp_Cels 6 -3549.940 3003.560 FORMAT "%8.3" DEPOSIT ABSOLUTE /end AXIS_DESCR
 /begin AXIS_DESCR STD_AXIS InjSys_tEngStrt Temp_Cels 4 -3549.940 3003.560 FORMAT "%8.3" DEPOSIT ABSOLUTE /end AXIS_DESCR
/end CHARACTERISTIC
/begin CHARACTERISTIC InjSys_P2V1I1_HP.facWghtSpltBasTFuEthnl_GM "class instance packet 2 variant 1 / weighting factor split based fuel ethanol dependent" MAP 0x805677CE RB_MapGroup_U8 0.9961 fak_ub_b1 0.00 0.9961
 /begin AXIS_DESCR COM_AXIS InjSys_tEngStrt Temp_Cels 8 -3549.940 3003.560 FORMAT "%8.3" AXIS_PTS_REF InjSys_tEngStrt08_AX /end AXIS_DESCR
 /begin AXIS_DESCR COM_AXIS InjSys_tEng Temp_Cels 8 -3549.940 3003.560 FORMAT "%8.3" AXIS_PTS_REF InjSys_tEng08_AX /end AXIS_DESCR
/end CHARACTERISTIC
/begin CHARACTERISTIC InjSys_P2V1I1_HP.facWghtSpltBasTFu_GM "class instance packet 2 variant 1 / ." MAP 0x8056780E RB_MapGroup_U8 0.9961 fak_ub_b1 0.00 0.9961
 /begin AXIS_DESCR COM_AXIS InjSys_tEngStrt Temp_Cels 8 -3549.940 3003.560 FORMAT "%8.3" AXIS_PTS_REF InjSys_tEngStrt08_AX /end AXIS_DESCR
 /begin AXIS_DESCR COM_AXIS InjSys_tEng Temp_Cels 8 -3549.940 3003.560 FORMAT "%8.3" AXIS_PTS_REF InjSys_tEng08_AX /end AXIS_DESCR
/end CHARACTERISTIC
/begin CHARACTERISTIC InjSys_P2V1I1_HP.facWghtSpltOilTEthnl_GM "class instance packet 2 variant 1 / ." MAP 0x8056784E RB_MapGroup_U8 0.9961 fak_ub_b1 0.00 0.9961
 /begin AXIS_DESCR COM_AXIS InjSys_tOilSp Temp_Cels 8 -3549.940 3003.560 FORMAT "%8.3" AXIS_PTS_REF InjSys_tosp08_AX /end AXIS_DESCR
 /begin AXIS_DESCR COM_AXIS InjSys_tEng Temp_Cels 8 -3549.940 3003.560 FORMAT "%8.3" AXIS_PTS_REF InjSys_tEng08_AX /end AXIS_DESCR
/end CHARACTERISTIC
/begin CHARACTERISTIC InjSys_P2V1I1_HP.facWghtSpltOilT_GM "class instance packet 2 variant 1 / ." MAP 0x8056788E RB_MapGroup_U8 0.9961 fak_ub_b1 0.00 0.9961
 /begin AXIS_DESCR COM_AXIS InjSys_tOilSp Temp_Cels 8 -3549.940 3003.560 FORMAT "%8.3" AXIS_PTS_REF InjSys_tosp08_AX /end AXIS_DESCR
 /begin AXIS_DESCR COM_AXIS InjSys_tEng Temp_Cels 8 -3549.940 3003.560 FORMAT "%8.3" AXIS_PTS_REF InjSys_tEng08_AX /end AXIS_DESCR
/end CHARACTERISTIC
/begin CHARACTERISTIC InjSys_P2V1I1_HP.flgAbsltSplt_C "class instance packet 2 variant 1 / condition split with absolute fuel mass" VALUE 0x805678CE RB_Val_Wu8 1.00000000000 B_TRUE 0.00 1.00000000000 FORMAT "%13.11" /end CHARACTERISTIC
/begin CHARACTERISTIC InjSys_P2V1I1_HP.flgAgCalc_C "class instance packet 2 variant 1 / ." VALUE 0x805678CF RB_Val_Wu8 1.00000000000 B_TRUE 0.00 1.00000000000 FORMAT "%13.11" /end CHARACTERISTIC
/begin CHARACTERISTIC InjSys_P2V1I1_HP.flgAgEnd_C "class instance packet 2 variant 1 / condition end angle" VALUE 0x805678D0 RB_Val_Wu8 1.00000000000 B_TRUE 0.00 1.00000000000 FORMAT "%13.11" /end CHARACTERISTIC
/begin CHARACTERISTIC InjSys_P2V1I1_HP.flgAxVers_C "class instance packet 2 variant 1 / condition map selection with group axis in version 2" VALUE 0x805678D1 RB_Val_Wu8 1.00000000000 B_TRUE 0.00 1.00000000000 FORMAT "%13.11" /end CHARACTERISTIC
/begin CHARACTERISTIC InjSys_P2V1I1_HP.flgPktCoupl_C "class instance packet 2 variant 1 / condition packet coupling with break time" VALUE 0x805678D2 RB_Val_Wu8 1.00000000000 B_TRUE 0.00 1.00000000000 FORMAT "%13.11" /end CHARACTERISTIC
/begin CHARACTERISTIC InjSys_P2V1I1_HP.ratFuMBasHi_GM "class instance packet 2 variant 1 / relative fuel mass base injection for interpolation" MAP 0x805678D4 RB_MapGroup_U16 3071.953 rel_uw_b3072 0.00 3071.953 FORMAT "%8.3"
 /begin AXIS_DESCR COM_AXIS Epm_nEng EngN 10 0.00 16383.50 FORMAT "%8.2" EXTENDED_LIMITS -16384.00 16383.50 AXIS_PTS_REF InjSys_nEng10_AX /end AXIS_DESCR
 /begin AXIS_DESCR COM_AXIS InjSys_ratAirMAxisInp rel_uw_q0p0234 8 0.00 1535.977 FORMAT "%8.3" AXIS_PTS_REF InjSys_ratAirM08_AX /end AXIS_DESCR
/end CHARACTERISTIC
/begin CHARACTERISTIC InjSys_P2V1I1_HP.ratFuMBasLo_GM "class instance packet 2 variant 1 / relative fuel mass base injection for interpolation" MAP 0x80567974 RB_MapGroup_U16 3071.953 rel_uw_b3072 0.00 3071.953 FORMAT "%8.3"
 /begin AXIS_DESCR COM_AXIS Epm_nEng EngN 10 0.00 16383.50 FORMAT "%8.2" EXTENDED_LIMITS -16384.00 16383.50 AXIS_PTS_REF InjSys_nEng10_AX /end AXIS_DESCR
 /begin AXIS_DESCR COM_AXIS InjSys_ratAirMAxisInp rel_uw_q0p0234 8 0.00 1535.977 FORMAT "%8.3" AXIS_PTS_REF InjSys_ratAirM08_AX /end AXIS_DESCR
/end CHARACTERISTIC
/begin CHARACTERISTIC InjSys_P2V1I1_HP.stAgFacTInj_C "class instance packet 2 variant 1 / switch to select oil temperature dependent map" VALUE 0x80567A14 RB_Val_Wu8 1.00000000000 B_TRUE 0.00 1.00000000000 FORMAT "%13.11" /end CHARACTERISTIC
/begin CHARACTERISTIC InjSys_P2V1I1_HP.stfacWghtSpltT_C "class instance packet 2 variant 1 / switch to select oil temerature dependent map" VALUE 0x80567A15 RB_Val_Wu8 1.00000000000 B_TRUE 0.00 1.00000000000 FORMAT "%13.11" /end CHARACTERISTIC
/begin CHARACTERISTIC InjSys_P2V1I1_HP.tiBreakPkt_M "class instance packet 2 variant 1 / break time for packet coupling" MAP 0x80567A16 RB_Map_S16U16_S16 1310.720 t_q0p04_ms -1310.720 0.00 FORMAT "%8.3" EXTENDED_LIMITS -1310.720 1310.680
 /begin AXIS_DESCR STD_AXIS Epm_nEng EngN 8 -16384.00 16383.50 FORMAT "%8.2" DEPOSIT ABSOLUTE /end AXIS_DESCR
 /begin AXIS_DESCR STD_AXIS InjSys_ratAirMPredLocSp rel_uw_q0p0234 8 0.00 1535.977 FORMAT "%8.3" DEPOSIT ABSOLUTE /end AXIS_DESCR
/end CHARACTERISTIC
/begin CHARACTERISTIC InjSys_P2V1I2_HP.agBasHiEthnl_GM "injection packet 2 in variant 1 / ." MAP 0x80560060 RB_MapGroup_S8 382.5 kw_q1p5 -192.0 190.5 FORMAT "%5.1"
 /begin AXIS_DESCR COM_AXIS Epm_nEng EngN 12 0.00 16383.50 FORMAT "%8.2" EXTENDED_LIMITS -16384.00 16383.50 AXIS_PTS_REF InjSys_nEng12Hsp_AX /end AXIS_DESCR
 /begin AXIS_DESCR COM_AXIS InjSys_ratAirMAgSpAxisInp rel_uw_q0p0234 12 0.00 1535.977 FORMAT "%8.3" AXIS_PTS_REF InjSys_ratAirM12AgSpHsp_AX /end AXIS_DESCR
/end CHARACTERISTIC
/begin CHARACTERISTIC InjSys_P2V1I2_HP.agBasHiVers2Ethnl_GM "injection packet 2 in variant 1 / ." MAP 0x805600F0 RB_MapGroup_S8 382.5 kw_q1p5 -192.0 190.5 FORMAT "%5.1"
 /begin AXIS_DESCR COM_AXIS Epm_nEng EngN 12 0.00 16383.50 FORMAT "%8.2" EXTENDED_LIMITS -16384.00 16383.50 AXIS_PTS_REF InjSys_nEng12HspVers2_AX /end AXIS_DESCR
 /begin AXIS_DESCR COM_AXIS InjSys_ratAirMAgSpVers2AxisInp rel_uw_q0p0234 12 0.00 1535.977 FORMAT "%8.3" AXIS_PTS_REF InjSys_ratAirM12AgSpHspVers2_AX /end AXIS_DESCR
/end CHARACTERISTIC
/begin CHARACTERISTIC InjSys_P2V1I2_HP.agBasHiVers2_GM "injection packet 2 in variant 1 / base angle for interpolation (version 2)" MAP 0x80560180 RB_MapGroup_S8 382.5 kw_q1p5 -192.0 190.5 FORMAT "%5.1"
 /begin AXIS_DESCR COM_AXIS Epm_nEng EngN 12 0.00 16383.50 FORMAT "%8.2" EXTENDED_LIMITS -16384.00 16383.50 AXIS_PTS_REF InjSys_nEng12HspVers2_AX /end AXIS_DESCR
 /begin AXIS_DESCR COM_AXIS InjSys_ratAirMAgSpVers2AxisInp rel_uw_q0p0234 12 0.00 1535.977 FORMAT "%8.3" AXIS_PTS_REF InjSys_ratAirM12AgSpHspVers2_AX /end AXIS_DESCR
/end CHARACTERISTIC
/begin CHARACTERISTIC InjSys_P2V1I2_HP.agBasHi_GM "injection packet 2 in variant 1 / base angle for interpolation" MAP 0x80560210 RB_MapGroup_S8 382.5 kw_q1p5 -192.0 190.5 FORMAT "%5.1"
 /begin AXIS_DESCR COM_AXIS Epm_nEng EngN 12 0.00 16383.50 FORMAT "%8.2" EXTENDED_LIMITS -16384.00 16383.50 AXIS_PTS_REF InjSys_nEng12Hsp_AX /end AXIS_DESCR
 /begin AXIS_DESCR COM_AXIS InjSys_ratAirMAgSpAxisInp rel_uw_q0p0234 12 0.00 1535.977 FORMAT "%8.3" AXIS_PTS_REF InjSys_ratAirM12AgSpHsp_AX /end AXIS_DESCR
/end CHARACTERISTIC
/begin CHARACTERISTIC InjSys_P2V1I2_HP.agBasLoEthnl_GM "injection packet 2 in variant 1 / ." MAP 0x805602A0 RB_MapGroup_S8 382.5 kw_q1p5 -192.0 190.5 FORMAT "%5.1"
 /begin AXIS_DESCR COM_AXIS Epm_nEng EngN 12 0.00 16383.50 FORMAT "%8.2" EXTENDED_LIMITS -16384.00 16383.50 AXIS_PTS_REF InjSys_nEng12Hsp_AX /end AXIS_DESCR
 /begin AXIS_DESCR COM_AXIS InjSys_ratAirMAgSpAxisInp rel_uw_q0p0234 12 0.00 1535.977 FORMAT "%8.3" AXIS_PTS_REF InjSys_ratAirM12AgSpHsp_AX /end AXIS_DESCR
/end CHARACTERISTIC
/begin CHARACTERISTIC InjSys_P2V1I2_HP.agBasLoVers2Ethnl_GM "injection packet 2 in variant 1 / ." MAP 0x80560330 RB_MapGroup_S8 382.5 kw_q1p5 -192.0 190.5 FORMAT "%5.1"
 /begin AXIS_DESCR COM_AXIS Epm_nEng EngN 12 0.00 16383.50 FORMAT "%8.2" EXTENDED_LIMITS -16384.00 16383.50 AXIS_PTS_REF InjSys_nEng12HspVers2_AX /end AXIS_DESCR
 /begin AXIS_DESCR COM_AXIS InjSys_ratAirMAgSpVers2AxisInp rel_uw_q0p0234 12 0.00 1535.977 FORMAT "%8.3" AXIS_PTS_REF InjSys_ratAirM12AgSpHspVers2_AX /end AXIS_DESCR
/end CHARACTERISTIC
/begin CHARACTERISTIC InjSys_P2V1I2_HP.agBasLoVers2_GM "injection packet 2 in variant 1 / base angle for interpolation (version 2)" MAP 0x805603C0 RB_MapGroup_S8 382.5 kw_q1p5 -192.0 190.5 FORMAT "%5.1"
 /begin AXIS_DESCR COM_AXIS Epm_nEng EngN 12 0.00 16383.50 FORMAT "%8.2" EXTENDED_LIMITS -16384.00 16383.50 AXIS_PTS_REF InjSys_nEng12HspVers2_AX /end AXIS_DESCR
 /begin AXIS_DESCR COM_AXIS InjSys_ratAirMAgSpVers2AxisInp rel_uw_q0p0234 12 0.00 1535.977 FORMAT "%8.3" AXIS_PTS_REF InjSys_ratAirM12AgSpHspVers2_AX /end AXIS_DESCR
/end CHARACTERISTIC
/begin CHARACTERISTIC InjSys_P2V1I2_HP.agBasLo_GM "injection packet 2 in variant 1 / base angle for interpolation" MAP 0x80560450 RB_MapGroup_S8 382.5 kw_q1p5 -192.0 190.5 FORMAT "%5.1"
 /begin AXIS_DESCR COM_AXIS Epm_nEng EngN 12 0.00 16383.50 FORMAT "%8.2" EXTENDED_LIMITS -16384.00 16383.50 AXIS_PTS_REF InjSys_nEng12Hsp_AX /end AXIS_DESCR
 /begin AXIS_DESCR COM_AXIS InjSys_ratAirMAgSpAxisInp rel_uw_q0p0234 12 0.00 1535.977 FORMAT "%8.3" AXIS_PTS_REF InjSys_ratAirM12AgSpHsp_AX /end AXIS_DESCR
/end CHARACTERISTIC
/begin CHARACTERISTIC InjSys_P2V1I2_HP.agBasTPistColdVers2_GM "injection packet 2 in variant 1 / base angle for interpolation cold TSA mode" MAP 0x805604E0 RB_MapGroup_U8 382.5 kw_q1p5 0.00 382.5 FORMAT "%5.1"
 /begin AXIS_DESCR COM_AXIS Epm_nEng EngN 12 0.00 16383.50 FORMAT "%8.2" EXTENDED_LIMITS -16384.00 16383.50 AXIS_PTS_REF InjSys_nEng12HspVers2_AX /end AXIS_DESCR
 /begin AXIS_DESCR COM_AXIS InjSys_ratAirMAgSpVers2AxisInp rel_uw_q0p0234 12 0.00 1535.977 FORMAT "%8.3" AXIS_PTS_REF InjSys_ratAirM12AgSpHspVers2_AX /end AXIS_DESCR
/end CHARACTERISTIC
/begin CHARACTERISTIC InjSys_P2V1I2_HP.agBasTPistCold_GM "injection packet 2 in variant 1 / base angle for interpolation cold TSA mode" MAP 0x80560570 RB_MapGroup_U8 382.5 kw_q1p5 0.00 382.5 FORMAT "%5.1"
 /begin AXIS_DESCR COM_AXIS Epm_nEng EngN 12 0.00 16383.50 FORMAT "%8.2" EXTENDED_LIMITS -16384.00 16383.50 AXIS_PTS_REF InjSys_nEng12Hsp_AX /end AXIS_DESCR
 /begin AXIS_DESCR COM_AXIS InjSys_ratAirMAgSpAxisInp rel_uw_q0p0234 12 0.00 1535.977 FORMAT "%8.3" AXIS_PTS_REF InjSys_ratAirM12AgSpHsp_AX /end AXIS_DESCR
/end CHARACTERISTIC
/begin CHARACTERISTIC InjSys_P2V1I2_HP.agBasTPistWrmVers2_GM "injection packet 2 in variant 1 / base angle for interpolation Warm TSA mode (Version 2)" MAP 0x80560600 RB_MapGroup_U8 382.5 kw_q1p5 0.00 382.5 FORMAT "%5.1"
 /begin AXIS_DESCR COM_AXIS Epm_nEng EngN 12 0.00 16383.50 FORMAT "%8.2" EXTENDED_LIMITS -16384.00 16383.50 AXIS_PTS_REF InjSys_nEng12HspVers2_AX /end AXIS_DESCR
 /begin AXIS_DESCR COM_AXIS InjSys_ratAirMAgSpVers2AxisInp rel_uw_q0p0234 12 0.00 1535.977 FORMAT "%8.3" AXIS_PTS_REF InjSys_ratAirM12AgSpHspVers2_AX /end AXIS_DESCR
/end CHARACTERISTIC
/begin CHARACTERISTIC InjSys_P2V1I2_HP.agBasTPistWrm_GM "injection packet 2 in variant 1 / base angle for interpolation Warm TSA mode" MAP 0x80560690 RB_MapGroup_U8 382.5 kw_q1p5 0.00 382.5 FORMAT "%5.1"
 /begin AXIS_DESCR COM_AXIS Epm_nEng EngN 12 0.00 16383.50 FORMAT "%8.2" EXTENDED_LIMITS -16384.00 16383.50 AXIS_PTS_REF InjSys_nEng12Hsp_AX /end AXIS_DESCR
 /begin AXIS_DESCR COM_AXIS InjSys_ratAirMAgSpAxisInp rel_uw_q0p0234 12 0.00 1535.977 FORMAT "%8.3" AXIS_PTS_REF InjSys_ratAirM12AgSpHsp_AX /end AXIS_DESCR
/end CHARACTERISTIC
/begin CHARACTERISTIC InjSys_P2V1I2_HP.facEthnlAgBas_T "injection packet 2 in variant 1 / ." CURVE 0x80560720 RB_Curve_U8_U8 0.9961 fak_ub_b1 0.00 0.9961
 /begin AXIS_DESCR STD_AXIS fethstoeLocSp fak_ub_b2 4 0.00 1.992188 FORMAT "%8.6" DEPOSIT ABSOLUTE /end AXIS_DESCR
/end CHARACTERISTIC
/begin CHARACTERISTIC InjSys_P2V1I2_HP.facEthnlAgBgn_T "injection packet 2 in variant 1 / ." CURVE 0x80560729 RB_Curve_U8_U8 0.9961 fak_ub_b1 0.00 0.9961
 /begin AXIS_DESCR STD_AXIS fethstoeLocSp fak_ub_b2 4 0.00 1.992188 FORMAT "%8.6" DEPOSIT ABSOLUTE /end AXIS_DESCR
/end CHARACTERISTIC
/begin CHARACTERISTIC InjSys_P2V1I2_HP.facFuMBasHiEthnl_GM "injection packet 2 in variant 1 / relative fuel mass high ethanol dependent" MAP 0x80560732 RB_MapGroup_U8 0.9961 fak_ub_b1 0.00 0.9961
 /begin AXIS_DESCR COM_AXIS Epm_nEng EngN 10 0.00 16383.50 FORMAT "%8.2" EXTENDED_LIMITS -16384.00 16383.50 AXIS_PTS_REF InjSys_nEng10_AX /end AXIS_DESCR
 /begin AXIS_DESCR COM_AXIS InjSys_ratAirMAxisInp rel_uw_q0p0234 8 0.00 1535.977 FORMAT "%8.3" AXIS_PTS_REF InjSys_ratAirM08_AX /end AXIS_DESCR
/end CHARACTERISTIC
/begin CHARACTERISTIC InjSys_P2V1I2_HP.facFuMBasLoEthnl_GM "injection packet 2 in variant 1 / relative fuel mass low ethanol dependent" MAP 0x80560782 RB_MapGroup_U8 0.9961 fak_ub_b1 0.00 0.9961
 /begin AXIS_DESCR COM_AXIS Epm_nEng EngN 10 0.00 16383.50 FORMAT "%8.2" EXTENDED_LIMITS -16384.00 16383.50 AXIS_PTS_REF InjSys_nEng10_AX /end AXIS_DESCR
 /begin AXIS_DESCR COM_AXIS InjSys_ratAirMAxisInp rel_uw_q0p0234 8 0.00 1535.977 FORMAT "%8.3" AXIS_PTS_REF InjSys_ratAirM08_AX /end AXIS_DESCR
/end CHARACTERISTIC
/begin CHARACTERISTIC InjSys_P2V1I2_HP.facSpltBasCorrnLoT_GM "injection packet 2 in variant 1 / split factor correction base injection dependent of temperature and number of injections" MAP 0x805607D2 RB_MapGroup_U8 1.992188 fak_ub_b2 0.00 1.992188 FORMAT "%8.6"
 /begin AXIS_DESCR COM_AXIS InjSys_tEng Temp_Cels 8 -3549.940 3003.560 FORMAT "%8.3" AXIS_PTS_REF InjSys_tEng08_AX /end AXIS_DESCR
 /begin AXIS_DESCR COM_AXIS InjSys_nrInjLimdLoc dez 8 0.00 65535.00 FORMAT "%8.2" AXIS_PTS_REF InjSys_nrInj08_AX /end AXIS_DESCR
/end CHARACTERISTIC
/begin CHARACTERISTIC InjSys_P2V1I2_HP.facSpltBasHiExtd_GM "injection packet 2 in variant 1 / split factor base injection for interpolation" MAP 0x80560812 RB_MapGroup_U8 0.9961 fak_ub_b1 0.00 0.9961
 /begin AXIS_DESCR COM_AXIS Epm_nEng EngN 12 0.00 16383.50 FORMAT "%8.2" EXTENDED_LIMITS -16384.00 16383.50 AXIS_PTS_REF InjSys_nEng12Vers2_AX /end AXIS_DESCR
 /begin AXIS_DESCR COM_AXIS InjSys_ratAirMVers2AxisInp rel_uw_q0p0234 12 0.00 1535.977 FORMAT "%8.3" AXIS_PTS_REF InjSys_ratAirM12Vers2_AX /end AXIS_DESCR
/end CHARACTERISTIC
/begin CHARACTERISTIC InjSys_P2V1I2_HP.facSpltBasHi_GM "injection packet 2 in variant 1 / split factor base injection for interpolation" MAP 0x805608A2 RB_MapGroup_U8 0.9961 fak_ub_b1 0.00 0.9961
 /begin AXIS_DESCR COM_AXIS Epm_nEng EngN 10 0.00 16383.50 FORMAT "%8.2" EXTENDED_LIMITS -16384.00 16383.50 AXIS_PTS_REF InjSys_nEng10_AX /end AXIS_DESCR
 /begin AXIS_DESCR COM_AXIS InjSys_ratAirMAxisInp rel_uw_q0p0234 8 0.00 1535.977 FORMAT "%8.3" AXIS_PTS_REF InjSys_ratAirM08_AX /end AXIS_DESCR
/end CHARACTERISTIC
/begin CHARACTERISTIC InjSys_P2V1I2_HP.facSpltBasLoEthnl_GM "injection packet 2 in variant 1 / split factor low ethanol dependent" MAP 0x805608F2 RB_MapGroup_U8 1.992188 fak_ub_b2 0.00 1.992188 FORMAT "%8.6"
 /begin AXIS_DESCR COM_AXIS InjSys_tEng Temp_Cels 8 -3549.940 3003.560 FORMAT "%8.3" AXIS_PTS_REF InjSys_tEng08_AX /end AXIS_DESCR
 /begin AXIS_DESCR COM_AXIS InjSys_nrInjLimdLoc dez 8 0.00 65535.00 FORMAT "%8.2" AXIS_PTS_REF InjSys_nrInj08_AX /end AXIS_DESCR
/end CHARACTERISTIC
/begin CHARACTERISTIC InjSys_P2V1I2_HP.facSpltBasLoExtd_GM "injection packet 2 in variant 1 / split factor base injection for interpolation" MAP 0x80560932 RB_MapGroup_U8 0.9961 fak_ub_b1 0.00 0.9961
 /begin AXIS_DESCR COM_AXIS Epm_nEng EngN 12 0.00 16383.50 FORMAT "%8.2" EXTENDED_LIMITS -16384.00 16383.50 AXIS_PTS_REF InjSys_nEng12Vers2_AX /end AXIS_DESCR
 /begin AXIS_DESCR COM_AXIS InjSys_ratAirMVers2AxisInp rel_uw_q0p0234 12 0.00 1535.977 FORMAT "%8.3" AXIS_PTS_REF InjSys_ratAirM12Vers2_AX /end AXIS_DESCR
/end CHARACTERISTIC
/begin CHARACTERISTIC InjSys_P2V1I2_HP.facSpltBasLo_GM "injection packet 2 in variant 1 / split factor base injection for interpolation" MAP 0x805609C2 RB_MapGroup_U8 0.9961 fak_ub_b1 0.00 0.9961
 /begin AXIS_DESCR COM_AXIS Epm_nEng EngN 10 0.00 16383.50 FORMAT "%8.2" EXTENDED_LIMITS -16384.00 16383.50 AXIS_PTS_REF InjSys_nEng10_AX /end AXIS_DESCR
 /begin AXIS_DESCR COM_AXIS InjSys_ratAirMAxisInp rel_uw_q0p0234 8 0.00 1535.977 FORMAT "%8.3" AXIS_PTS_REF InjSys_ratAirM08_AX /end AXIS_DESCR
/end CHARACTERISTIC
/begin CHARACTERISTIC InjSys_P2V1I2_HP.facTInjAgEthnl_M "injection packet 2 in variant 1 / ." MAP 0x80560A12 RB_Map_S16S16_U8 0.9961 fak_ub_b1 0.00 0.9961
 /begin AXIS_DESCR STD_AXIS InjSys_tEng Temp_Cels 8 -3549.940 3003.560 FORMAT "%8.3" DEPOSIT ABSOLUTE /end AXIS_DESCR
 /begin AXIS_DESCR STD_AXIS InjSys_tOilLocSp Temp_Cels 8 -3549.940 3003.560 FORMAT "%8.3" DEPOSIT ABSOLUTE /end AXIS_DESCR
/end CHARACTERISTIC
/begin CHARACTERISTIC InjSys_P2V1I2_HP.facTInjAg_M "injection packet 2 in variant 1 / ." MAP 0x80560A76 RB_Map_S16S16_U8 0.9961 fak_ub_b1 0.00 0.9961
 /begin AXIS_DESCR STD_AXIS InjSys_tEng Temp_Cels 8 -3549.940 3003.560 FORMAT "%8.3" DEPOSIT ABSOLUTE /end AXIS_DESCR
 /begin AXIS_DESCR STD_AXIS InjSys_tOilLocSp Temp_Cels 8 -3549.940 3003.560 FORMAT "%8.3" DEPOSIT ABSOLUTE /end AXIS_DESCR
/end CHARACTERISTIC
/begin CHARACTERISTIC InjSys_P2V1I2_HP.facTPistCold_M "injection packet 2 in variant 1 / Engine temperature and oil temperature based map for injection angle correction" MAP 0x80560ADA RB_Map_S16S16_U8 0.9961 fak_ub_b1 0.00 0.9961
 /begin AXIS_DESCR STD_AXIS InjSys_tEng Temp_Cels 6 -3549.940 3003.560 FORMAT "%8.3" DEPOSIT ABSOLUTE /end AXIS_DESCR
 /begin AXIS_DESCR STD_AXIS InjSys_tOilLocSp Temp_Cels 6 -3549.940 3003.560 FORMAT "%8.3" DEPOSIT ABSOLUTE /end AXIS_DESCR
/end CHARACTERISTIC
/begin CHARACTERISTIC InjSys_P2V1I2_HP.facTPist_M "injection packet 2 in variant 1 / piston temperature based map for injection angle correction" MAP 0x80560B1A RB_Map_S16S16_U8 0.9961 fak_ub_b1 0.00 0.9961
 /begin AXIS_DESCR STD_AXIS InjSys_tPistBas Temp_Cels 6 -3549.940 3003.560 FORMAT "%8.3" DEPOSIT ABSOLUTE /end AXIS_DESCR
 /begin AXIS_DESCR STD_AXIS InjSys_tPistDelta temp_q0p1 6 -3276.800 3276.700 FORMAT "%8.3" DEPOSIT ABSOLUTE /end AXIS_DESCR
/end CHARACTERISTIC
/begin CHARACTERISTIC InjSys_P2V1I2_HP.facWghtAgBasTEthnl_M "injection packet 2 in variant 1 / weighting factor base angle ethanol dependent" MAP 0x80560B5A RB_Map_S16S16_U8 0.9961 fak_ub_b1 0.00 0.9961
 /begin AXIS_DESCR STD_AXIS InjSys_tEng Temp_Cels 6 -3549.940 3003.560 FORMAT "%8.3" DEPOSIT ABSOLUTE /end AXIS_DESCR
 /begin AXIS_DESCR STD_AXIS InjSys_tEngStrt Temp_Cels 4 -3549.940 3003.560 FORMAT "%8.3" DEPOSIT ABSOLUTE /end AXIS_DESCR
/end CHARACTERISTIC
/begin CHARACTERISTIC InjSys_P2V1I2_HP.facWghtAgBasT_M "injection packet 2 in variant 1 / weighting factor base angle temperature dependent" MAP 0x80560B8A RB_Map_S16S16_U8 0.9961 fak_ub_b1 0.00 0.9961
 /begin AXIS_DESCR STD_AXIS InjSys_tEng Temp_Cels 6 -3549.940 3003.560 FORMAT "%8.3" DEPOSIT ABSOLUTE /end AXIS_DESCR
 /begin AXIS_DESCR STD_AXIS InjSys_tEngStrt Temp_Cels 4 -3549.940 3003.560 FORMAT "%8.3" DEPOSIT ABSOLUTE /end AXIS_DESCR
/end CHARACTERISTIC
/begin CHARACTERISTIC InjSys_P2V1I2_HP.facWghtSpltBasTFuEthnl_GM "injection packet 2 in variant 1 / weighting factor split based fuel ethanol dependent" MAP 0x80560BBA RB_MapGroup_U8 0.9961 fak_ub_b1 0.00 0.9961
 /begin AXIS_DESCR COM_AXIS InjSys_tEngStrt Temp_Cels 8 -3549.940 3003.560 FORMAT "%8.3" AXIS_PTS_REF InjSys_tEngStrt08_AX /end AXIS_DESCR
 /begin AXIS_DESCR COM_AXIS InjSys_tEng Temp_Cels 8 -3549.940 3003.560 FORMAT "%8.3" AXIS_PTS_REF InjSys_tEng08_AX /end AXIS_DESCR
/end CHARACTERISTIC
/begin CHARACTERISTIC InjSys_P2V1I2_HP.facWghtSpltBasTFu_GM "injection packet 2 in variant 1 / ." MAP 0x80560BFA RB_MapGroup_U8 0.9961 fak_ub_b1 0.00 0.9961
 /begin AXIS_DESCR COM_AXIS InjSys_tEngStrt Temp_Cels 8 -3549.940 3003.560 FORMAT "%8.3" AXIS_PTS_REF InjSys_tEngStrt08_AX /end AXIS_DESCR
 /begin AXIS_DESCR COM_AXIS InjSys_tEng Temp_Cels 8 -3549.940 3003.560 FORMAT "%8.3" AXIS_PTS_REF InjSys_tEng08_AX /end AXIS_DESCR
/end CHARACTERISTIC
/begin CHARACTERISTIC InjSys_P2V1I2_HP.facWghtSpltOilTEthnl_GM "injection packet 2 in variant 1 / ." MAP 0x80560C3A RB_MapGroup_U8 0.9961 fak_ub_b1 0.00 0.9961
 /begin AXIS_DESCR COM_AXIS InjSys_tOilSp Temp_Cels 8 -3549.940 3003.560 FORMAT "%8.3" AXIS_PTS_REF InjSys_tosp08_AX /end AXIS_DESCR
 /begin AXIS_DESCR COM_AXIS InjSys_tEng Temp_Cels 8 -3549.940 3003.560 FORMAT "%8.3" AXIS_PTS_REF InjSys_tEng08_AX /end AXIS_DESCR
/end CHARACTERISTIC
/begin CHARACTERISTIC InjSys_P2V1I2_HP.facWghtSpltOilT_GM "injection packet 2 in variant 1 / ." MAP 0x80560C7A RB_MapGroup_U8 0.9961 fak_ub_b1 0.00 0.9961
 /begin AXIS_DESCR COM_AXIS InjSys_tOilSp Temp_Cels 8 -3549.940 3003.560 FORMAT "%8.3" AXIS_PTS_REF InjSys_tosp08_AX /end AXIS_DESCR
 /begin AXIS_DESCR COM_AXIS InjSys_tEng Temp_Cels 8 -3549.940 3003.560 FORMAT "%8.3" AXIS_PTS_REF InjSys_tEng08_AX /end AXIS_DESCR
/end CHARACTERISTIC
/begin CHARACTERISTIC InjSys_P2V1I2_HP.flgAbsltSplt_C "injection packet 2 in variant 1 / condition split with absolute fuel mass" VALUE 0x80560CBA RB_Val_Wu8 1.00000000000 B_TRUE 0.00 1.00000000000 FORMAT "%13.11" /end CHARACTERISTIC
/begin CHARACTERISTIC InjSys_P2V1I2_HP.flgAgCalc_C "injection packet 2 in variant 1 / ." VALUE 0x80560CBB RB_Val_Wu8 1.00000000000 B_TRUE 0.00 1.00000000000 FORMAT "%13.11" /end CHARACTERISTIC
/begin CHARACTERISTIC InjSys_P2V1I2_HP.flgAgEnd_C "injection packet 2 in variant 1 / condition end angle" VALUE 0x80560CBC RB_Val_Wu8 1.00000000000 B_TRUE 0.00 1.00000000000 FORMAT "%13.11" /end CHARACTERISTIC
/begin CHARACTERISTIC InjSys_P2V1I2_HP.flgAxVers_C "injection packet 2 in variant 1 / condition map selection with group axis in version 2" VALUE 0x80560CBD RB_Val_Wu8 1.00000000000 B_TRUE 0.00 1.00000000000 FORMAT "%13.11" /end CHARACTERISTIC
/begin CHARACTERISTIC InjSys_P2V1I2_HP.flgPktCoupl_C "injection packet 2 in variant 1 / condition packet coupling with break time" VALUE 0x80560CBE RB_Val_Wu8 1.00000000000 B_TRUE 0.00 1.00000000000 FORMAT "%13.11" /end CHARACTERISTIC
/begin CHARACTERISTIC InjSys_P2V1I2_HP.ratFuMBasHi_GM "injection packet 2 in variant 1 / relative fuel mass base injection for interpolation" MAP 0x80560CC0 RB_MapGroup_U16 3071.953 rel_uw_b3072 0.00 3071.953 FORMAT "%8.3"
 /begin AXIS_DESCR COM_AXIS Epm_nEng EngN 10 0.00 16383.50 FORMAT "%8.2" EXTENDED_LIMITS -16384.00 16383.50 AXIS_PTS_REF InjSys_nEng10_AX /end AXIS_DESCR
 /begin AXIS_DESCR COM_AXIS InjSys_ratAirMAxisInp rel_uw_q0p0234 8 0.00 1535.977 FORMAT "%8.3" AXIS_PTS_REF InjSys_ratAirM08_AX /end AXIS_DESCR
/end CHARACTERISTIC
/begin CHARACTERISTIC InjSys_P2V1I2_HP.ratFuMBasLo_GM "injection packet 2 in variant 1 / relative fuel mass base injection for interpolation" MAP 0x80560D60 RB_MapGroup_U16 3071.953 rel_uw_b3072 0.00 3071.953 FORMAT "%8.3"
 /begin AXIS_DESCR COM_AXIS Epm_nEng EngN 10 0.00 16383.50 FORMAT "%8.2" EXTENDED_LIMITS -16384.00 16383.50 AXIS_PTS_REF InjSys_nEng10_AX /end AXIS_DESCR
 /begin AXIS_DESCR COM_AXIS InjSys_ratAirMAxisInp rel_uw_q0p0234 8 0.00 1535.977 FORMAT "%8.3" AXIS_PTS_REF InjSys_ratAirM08_AX /end AXIS_DESCR
/end CHARACTERISTIC
/begin CHARACTERISTIC InjSys_P2V1I2_HP.stAgFacTInj_C "injection packet 2 in variant 1 / switch to select oil temperature dependent map" VALUE 0x80560E00 RB_Val_Wu8 1.00000000000 B_TRUE 0.00 1.00000000000 FORMAT "%13.11" /end CHARACTERISTIC
/begin CHARACTERISTIC InjSys_P2V1I2_HP.stfacWghtSpltT_C "injection packet 2 in variant 1 / switch to select oil temerature dependent map" VALUE 0x80560E01 RB_Val_Wu8 1.00000000000 B_TRUE 0.00 1.00000000000 FORMAT "%13.11" /end CHARACTERISTIC
/begin CHARACTERISTIC InjSys_P2V1I2_HP.tiBreakPkt_M "injection packet 2 in variant 1 / break time for packet coupling" MAP 0x80560E02 RB_Map_S16U16_S16 1310.720 t_q0p04_ms -1310.720 0.00 FORMAT "%8.3" EXTENDED_LIMITS -1310.720 1310.680
 /begin AXIS_DESCR STD_AXIS Epm_nEng EngN 8 -16384.00 16383.50 FORMAT "%8.2" DEPOSIT ABSOLUTE /end AXIS_DESCR
 /begin AXIS_DESCR STD_AXIS InjSys_ratAirMPredLocSp rel_uw_q0p0234 8 0.00 1535.977 FORMAT "%8.3" DEPOSIT ABSOLUTE /end AXIS_DESCR
/end CHARACTERISTIC
/begin CHARACTERISTIC InjSys_P2V1I3_HP.agBasHiEthnl_GM "injection packet 2 in variant 1 / ." MAP 0x80560EAC RB_MapGroup_S8 382.5 kw_q1p5 -192.0 190.5 FORMAT "%5.1"
 /begin AXIS_DESCR COM_AXIS Epm_nEng EngN 12 0.00 16383.50 FORMAT "%8.2" EXTENDED_LIMITS -16384.00 16383.50 AXIS_PTS_REF InjSys_nEng12Hsp_AX /end AXIS_DESCR
 /begin AXIS_DESCR COM_AXIS InjSys_ratAirMAgSpAxisInp rel_uw_q0p0234 12 0.00 1535.977 FORMAT "%8.3" AXIS_PTS_REF InjSys_ratAirM12AgSpHsp_AX /end AXIS_DESCR
/end CHARACTERISTIC
/begin CHARACTERISTIC InjSys_P2V1I3_HP.agBasHiVers2Ethnl_GM "injection packet 2 in variant 1 / ." MAP 0x80560F3C RB_MapGroup_S8 382.5 kw_q1p5 -192.0 190.5 FORMAT "%5.1"
 /begin AXIS_DESCR COM_AXIS Epm_nEng EngN 12 0.00 16383.50 FORMAT "%8.2" EXTENDED_LIMITS -16384.00 16383.50 AXIS_PTS_REF InjSys_nEng12HspVers2_AX /end AXIS_DESCR
 /begin AXIS_DESCR COM_AXIS InjSys_ratAirMAgSpVers2AxisInp rel_uw_q0p0234 12 0.00 1535.977 FORMAT "%8.3" AXIS_PTS_REF InjSys_ratAirM12AgSpHspVers2_AX /end AXIS_DESCR
/end CHARACTERISTIC
/begin CHARACTERISTIC InjSys_P2V1I3_HP.agBasHiVers2_GM "injection packet 2 in variant 1 / base angle for interpolation (version 2)" MAP 0x80560FCC RB_MapGroup_S8 382.5 kw_q1p5 -192.0 190.5 FORMAT "%5.1"
 /begin AXIS_DESCR COM_AXIS Epm_nEng EngN 12 0.00 16383.50 FORMAT "%8.2" EXTENDED_LIMITS -16384.00 16383.50 AXIS_PTS_REF InjSys_nEng12HspVers2_AX /end AXIS_DESCR
 /begin AXIS_DESCR COM_AXIS InjSys_ratAirMAgSpVers2AxisInp rel_uw_q0p0234 12 0.00 1535.977 FORMAT "%8.3" AXIS_PTS_REF InjSys_ratAirM12AgSpHspVers2_AX /end AXIS_DESCR
/end CHARACTERISTIC
/begin CHARACTERISTIC InjSys_P2V1I3_HP.agBasHi_GM "injection packet 2 in variant 1 / base angle for interpolation" MAP 0x8056105C RB_MapGroup_S8 382.5 kw_q1p5 -192.0 190.5 FORMAT "%5.1"
 /begin AXIS_DESCR COM_AXIS Epm_nEng EngN 12 0.00 16383.50 FORMAT "%8.2" EXTENDED_LIMITS -16384.00 16383.50 AXIS_PTS_REF InjSys_nEng12Hsp_AX /end AXIS_DESCR
 /begin AXIS_DESCR COM_AXIS InjSys_ratAirMAgSpAxisInp rel_uw_q0p0234 12 0.00 1535.977 FORMAT "%8.3" AXIS_PTS_REF InjSys_ratAirM12AgSpHsp_AX /end AXIS_DESCR
/end CHARACTERISTIC
/begin CHARACTERISTIC InjSys_P2V1I3_HP.agBasLoEthnl_GM "injection packet 2 in variant 1 / ." MAP 0x805610EC RB_MapGroup_S8 382.5 kw_q1p5 -192.0 190.5 FORMAT "%5.1"
 /begin AXIS_DESCR COM_AXIS Epm_nEng EngN 12 0.00 16383.50 FORMAT "%8.2" EXTENDED_LIMITS -16384.00 16383.50 AXIS_PTS_REF InjSys_nEng12Hsp_AX /end AXIS_DESCR
 /begin AXIS_DESCR COM_AXIS InjSys_ratAirMAgSpAxisInp rel_uw_q0p0234 12 0.00 1535.977 FORMAT "%8.3" AXIS_PTS_REF InjSys_ratAirM12AgSpHsp_AX /end AXIS_DESCR
/end CHARACTERISTIC
/begin CHARACTERISTIC InjSys_P2V1I3_HP.agBasLoVers2Ethnl_GM "injection packet 2 in variant 1 / ." MAP 0x8056117C RB_MapGroup_S8 382.5 kw_q1p5 -192.0 190.5 FORMAT "%5.1"
 /begin AXIS_DESCR COM_AXIS Epm_nEng EngN 12 0.00 16383.50 FORMAT "%8.2" EXTENDED_LIMITS -16384.00 16383.50 AXIS_PTS_REF InjSys_nEng12HspVers2_AX /end AXIS_DESCR
 /begin AXIS_DESCR COM_AXIS InjSys_ratAirMAgSpVers2AxisInp rel_uw_q0p0234 12 0.00 1535.977 FORMAT "%8.3" AXIS_PTS_REF InjSys_ratAirM12AgSpHspVers2_AX /end AXIS_DESCR
/end CHARACTERISTIC
/begin CHARACTERISTIC InjSys_P2V1I3_HP.agBasLoVers2_GM "injection packet 2 in variant 1 / base angle for interpolation (version 2)" MAP 0x8056120C RB_MapGroup_S8 382.5 kw_q1p5 -192.0 190.5 FORMAT "%5.1"
 /begin AXIS_DESCR COM_AXIS Epm_nEng EngN 12 0.00 16383.50 FORMAT "%8.2" EXTENDED_LIMITS -16384.00 16383.50 AXIS_PTS_REF InjSys_nEng12HspVers2_AX /end AXIS_DESCR
 /begin AXIS_DESCR COM_AXIS InjSys_ratAirMAgSpVers2AxisInp rel_uw_q0p0234 12 0.00 1535.977 FORMAT "%8.3" AXIS_PTS_REF InjSys_ratAirM12AgSpHspVers2_AX /end AXIS_DESCR
/end CHARACTERISTIC
/begin CHARACTERISTIC InjSys_P2V1I3_HP.agBasLo_GM "injection packet 2 in variant 1 / base angle for interpolation" MAP 0x8056129C RB_MapGroup_S8 382.5 kw_q1p5 -192.0 190.5 FORMAT "%5.1"
 /begin AXIS_DESCR COM_AXIS Epm_nEng EngN 12 0.00 16383.50 FORMAT "%8.2" EXTENDED_LIMITS -16384.00 16383.50 AXIS_PTS_REF InjSys_nEng12Hsp_AX /end AXIS_DESCR
 /begin AXIS_DESCR COM_AXIS InjSys_ratAirMAgSpAxisInp rel_uw_q0p0234 12 0.00 1535.977 FORMAT "%8.3" AXIS_PTS_REF InjSys_ratAirM12AgSpHsp_AX /end AXIS_DESCR
/end CHARACTERISTIC
/begin CHARACTERISTIC InjSys_P2V1I3_HP.agBasTPistColdVers2_GM "injection packet 2 in variant 1 / base angle for interpolation cold TSA mode" MAP 0x8056132C RB_MapGroup_U8 382.5 kw_q1p5 0.00 382.5 FORMAT "%5.1"
 /begin AXIS_DESCR COM_AXIS Epm_nEng EngN 12 0.00 16383.50 FORMAT "%8.2" EXTENDED_LIMITS -16384.00 16383.50 AXIS_PTS_REF InjSys_nEng12HspVers2_AX /end AXIS_DESCR
 /begin AXIS_DESCR COM_AXIS InjSys_ratAirMAgSpVers2AxisInp rel_uw_q0p0234 12 0.00 1535.977 FORMAT "%8.3" AXIS_PTS_REF InjSys_ratAirM12AgSpHspVers2_AX /end AXIS_DESCR
/end CHARACTERISTIC
/begin CHARACTERISTIC InjSys_P2V1I3_HP.agBasTPistCold_GM "injection packet 2 in variant 1 / base angle for interpolation cold TSA mode" MAP 0x805613BC RB_MapGroup_U8 382.5 kw_q1p5 0.00 382.5 FORMAT "%5.1"
 /begin AXIS_DESCR COM_AXIS Epm_nEng EngN 12 0.00 16383.50 FORMAT "%8.2" EXTENDED_LIMITS -16384.00 16383.50 AXIS_PTS_REF InjSys_nEng12Hsp_AX /end AXIS_DESCR
 /begin AXIS_DESCR COM_AXIS InjSys_ratAirMAgSpAxisInp rel_uw_q0p0234 12 0.00 1535.977 FORMAT "%8.3" AXIS_PTS_REF InjSys_ratAirM12AgSpHsp_AX /end AXIS_DESCR
/end CHARACTERISTIC
/begin CHARACTERISTIC InjSys_P2V1I3_HP.agBasTPistWrmVers2_GM "injection packet 2 in variant 1 / base angle for interpolation Warm TSA mode (Version 2)" MAP 0x8056144C RB_MapGroup_U8 382.5 kw_q1p5 0.00 382.5 FORMAT "%5.1"
 /begin AXIS_DESCR COM_AXIS Epm_nEng EngN 12 0.00 16383.50 FORMAT "%8.2" EXTENDED_LIMITS -16384.00 16383.50 AXIS_PTS_REF InjSys_nEng12HspVers2_AX /end AXIS_DESCR
 /begin AXIS_DESCR COM_AXIS InjSys_ratAirMAgSpVers2AxisInp rel_uw_q0p0234 12 0.00 1535.977 FORMAT "%8.3" AXIS_PTS_REF InjSys_ratAirM12AgSpHspVers2_AX /end AXIS_DESCR
/end CHARACTERISTIC
/begin CHARACTERISTIC InjSys_P2V1I3_HP.agBasTPistWrm_GM "injection packet 2 in variant 1 / base angle for interpolation Warm TSA mode" MAP 0x805614DC RB_MapGroup_U8 382.5 kw_q1p5 0.00 382.5 FORMAT "%5.1"
 /begin AXIS_DESCR COM_AXIS Epm_nEng EngN 12 0.00 16383.50 FORMAT "%8.2" EXTENDED_LIMITS -16384.00 16383.50 AXIS_PTS_REF InjSys_nEng12Hsp_AX /end AXIS_DESCR
 /begin AXIS_DESCR COM_AXIS InjSys_ratAirMAgSpAxisInp rel_uw_q0p0234 12 0.00 1535.977 FORMAT "%8.3" AXIS_PTS_REF InjSys_ratAirM12AgSpHsp_AX /end AXIS_DESCR
/end CHARACTERISTIC
/begin CHARACTERISTIC InjSys_P2V1I3_HP.facEthnlAgBas_T "injection packet 2 in variant 1 / ." CURVE 0x8056156C RB_Curve_U8_U8 0.9961 fak_ub_b1 0.00 0.9961
 /begin AXIS_DESCR STD_AXIS fethstoeLocSp fak_ub_b2 4 0.00 1.992188 FORMAT "%8.6" DEPOSIT ABSOLUTE /end AXIS_DESCR
/end CHARACTERISTIC
/begin CHARACTERISTIC InjSys_P2V1I3_HP.facEthnlAgBgn_T "injection packet 2 in variant 1 / ." CURVE 0x80561575 RB_Curve_U8_U8 0.9961 fak_ub_b1 0.00 0.9961
 /begin AXIS_DESCR STD_AXIS fethstoeLocSp fak_ub_b2 4 0.00 1.992188 FORMAT "%8.6" DEPOSIT ABSOLUTE /end AXIS_DESCR
/end CHARACTERISTIC
/begin CHARACTERISTIC InjSys_P2V1I3_HP.facFuMBasHiEthnl_GM "injection packet 2 in variant 1 / relative fuel mass high ethanol dependent" MAP 0x8056157E RB_MapGroup_U8 0.9961 fak_ub_b1 0.00 0.9961
 /begin AXIS_DESCR COM_AXIS Epm_nEng EngN 10 0.00 16383.50 FORMAT "%8.2" EXTENDED_LIMITS -16384.00 16383.50 AXIS_PTS_REF InjSys_nEng10_AX /end AXIS_DESCR
 /begin AXIS_DESCR COM_AXIS InjSys_ratAirMAxisInp rel_uw_q0p0234 8 0.00 1535.977 FORMAT "%8.3" AXIS_PTS_REF InjSys_ratAirM08_AX /end AXIS_DESCR
/end CHARACTERISTIC
/begin CHARACTERISTIC InjSys_P2V1I3_HP.facFuMBasLoEthnl_GM "injection packet 2 in variant 1 / relative fuel mass low ethanol dependent" MAP 0x805615CE RB_MapGroup_U8 0.9961 fak_ub_b1 0.00 0.9961
 /begin AXIS_DESCR COM_AXIS Epm_nEng EngN 10 0.00 16383.50 FORMAT "%8.2" EXTENDED_LIMITS -16384.00 16383.50 AXIS_PTS_REF InjSys_nEng10_AX /end AXIS_DESCR
 /begin AXIS_DESCR COM_AXIS InjSys_ratAirMAxisInp rel_uw_q0p0234 8 0.00 1535.977 FORMAT "%8.3" AXIS_PTS_REF InjSys_ratAirM08_AX /end AXIS_DESCR
/end CHARACTERISTIC
/begin CHARACTERISTIC InjSys_P2V1I3_HP.facSpltBasCorrnLoT_GM "injection packet 2 in variant 1 / split factor correction base injection dependent of temperature and number of injections" MAP 0x8056161E RB_MapGroup_U8 1.992188 fak_ub_b2 0.00 1.992188 FORMAT "%8.6"
 /begin AXIS_DESCR COM_AXIS InjSys_tEng Temp_Cels 8 -3549.940 3003.560 FORMAT "%8.3" AXIS_PTS_REF InjSys_tEng08_AX /end AXIS_DESCR
 /begin AXIS_DESCR COM_AXIS InjSys_nrInjLimdLoc dez 8 0.00 65535.00 FORMAT "%8.2" AXIS_PTS_REF InjSys_nrInj08_AX /end AXIS_DESCR
/end CHARACTERISTIC
/begin CHARACTERISTIC InjSys_P2V1I3_HP.facSpltBasHiExtd_GM "injection packet 2 in variant 1 / split factor base injection for interpolation" MAP 0x8056165E RB_MapGroup_U8 0.9961 fak_ub_b1 0.00 0.9961
 /begin AXIS_DESCR COM_AXIS Epm_nEng EngN 12 0.00 16383.50 FORMAT "%8.2" EXTENDED_LIMITS -16384.00 16383.50 AXIS_PTS_REF InjSys_nEng12Vers2_AX /end AXIS_DESCR
 /begin AXIS_DESCR COM_AXIS InjSys_ratAirMVers2AxisInp rel_uw_q0p0234 12 0.00 1535.977 FORMAT "%8.3" AXIS_PTS_REF InjSys_ratAirM12Vers2_AX /end AXIS_DESCR
/end CHARACTERISTIC
/begin CHARACTERISTIC InjSys_P2V1I3_HP.facSpltBasHi_GM "injection packet 2 in variant 1 / split factor base injection for interpolation" MAP 0x805616EE RB_MapGroup_U8 0.9961 fak_ub_b1 0.00 0.9961
 /begin AXIS_DESCR COM_AXIS Epm_nEng EngN 10 0.00 16383.50 FORMAT "%8.2" EXTENDED_LIMITS -16384.00 16383.50 AXIS_PTS_REF InjSys_nEng10_AX /end AXIS_DESCR
 /begin AXIS_DESCR COM_AXIS InjSys_ratAirMAxisInp rel_uw_q0p0234 8 0.00 1535.977 FORMAT "%8.3" AXIS_PTS_REF InjSys_ratAirM08_AX /end AXIS_DESCR
/end CHARACTERISTIC
/begin CHARACTERISTIC InjSys_P2V1I3_HP.facSpltBasLoEthnl_GM "injection packet 2 in variant 1 / split factor low ethanol dependent" MAP 0x8056173E RB_MapGroup_U8 1.992188 fak_ub_b2 0.00 1.992188 FORMAT "%8.6"
 /begin AXIS_DESCR COM_AXIS InjSys_tEng Temp_Cels 8 -3549.940 3003.560 FORMAT "%8.3" AXIS_PTS_REF InjSys_tEng08_AX /end AXIS_DESCR
 /begin AXIS_DESCR COM_AXIS InjSys_nrInjLimdLoc dez 8 0.00 65535.00 FORMAT "%8.2" AXIS_PTS_REF InjSys_nrInj08_AX /end AXIS_DESCR
/end CHARACTERISTIC
/begin CHARACTERISTIC InjSys_P2V1I3_HP.facSpltBasLoExtd_GM "injection packet 2 in variant 1 / split factor base injection for interpolation" MAP 0x8056177E RB_MapGroup_U8 0.9961 fak_ub_b1 0.00 0.9961
 /begin AXIS_DESCR COM_AXIS Epm_nEng EngN 12 0.00 16383.50 FORMAT "%8.2" EXTENDED_LIMITS -16384.00 16383.50 AXIS_PTS_REF InjSys_nEng12Vers2_AX /end AXIS_DESCR
 /begin AXIS_DESCR COM_AXIS InjSys_ratAirMVers2AxisInp rel_uw_q0p0234 12 0.00 1535.977 FORMAT "%8.3" AXIS_PTS_REF InjSys_ratAirM12Vers2_AX /end AXIS_DESCR
/end CHARACTERISTIC
/begin CHARACTERISTIC InjSys_P2V1I3_HP.facSpltBasLo_GM "injection packet 2 in variant 1 / split factor base injection for interpolation" MAP 0x8056180E RB_MapGroup_U8 0.9961 fak_ub_b1 0.00 0.9961
 /begin AXIS_DESCR COM_AXIS Epm_nEng EngN 10 0.00 16383.50 FORMAT "%8.2" EXTENDED_LIMITS -16384.00 16383.50 AXIS_PTS_REF InjSys_nEng10_AX /end AXIS_DESCR
 /begin AXIS_DESCR COM_AXIS InjSys_ratAirMAxisInp rel_uw_q0p0234 8 0.00 1535.977 FORMAT "%8.3" AXIS_PTS_REF InjSys_ratAirM08_AX /end AXIS_DESCR
/end CHARACTERISTIC
/begin CHARACTERISTIC InjSys_P2V1I3_HP.facTInjAgEthnl_M "injection packet 2 in variant 1 / ." MAP 0x8056185E RB_Map_S16S16_U8 0.9961 fak_ub_b1 0.00 0.9961
 /begin AXIS_DESCR STD_AXIS InjSys_tEng Temp_Cels 8 -3549.940 3003.560 FORMAT "%8.3" DEPOSIT ABSOLUTE /end AXIS_DESCR
 /begin AXIS_DESCR STD_AXIS InjSys_tOilLocSp Temp_Cels 8 -3549.940 3003.560 FORMAT "%8.3" DEPOSIT ABSOLUTE /end AXIS_DESCR
/end CHARACTERISTIC
/begin CHARACTERISTIC InjSys_P2V1I3_HP.facTInjAg_M "injection packet 2 in variant 1 / ." MAP 0x805618C2 RB_Map_S16S16_U8 0.9961 fak_ub_b1 0.00 0.9961
 /begin AXIS_DESCR STD_AXIS InjSys_tEng Temp_Cels 8 -3549.940 3003.560 FORMAT "%8.3" DEPOSIT ABSOLUTE /end AXIS_DESCR
 /begin AXIS_DESCR STD_AXIS InjSys_tOilLocSp Temp_Cels 8 -3549.940 3003.560 FORMAT "%8.3" DEPOSIT ABSOLUTE /end AXIS_DESCR
/end CHARACTERISTIC
/begin CHARACTERISTIC InjSys_P2V1I3_HP.facTPistCold_M "injection packet 2 in variant 1 / Engine temperature and oil temperature based map for injection angle correction" MAP 0x80561926 RB_Map_S16S16_U8 0.9961 fak_ub_b1 0.00 0.9961
 /begin AXIS_DESCR STD_AXIS InjSys_tEng Temp_Cels 6 -3549.940 3003.560 FORMAT "%8.3" DEPOSIT ABSOLUTE /end AXIS_DESCR
 /begin AXIS_DESCR STD_AXIS InjSys_tOilLocSp Temp_Cels 6 -3549.940 3003.560 FORMAT "%8.3" DEPOSIT ABSOLUTE /end AXIS_DESCR
/end CHARACTERISTIC
/begin CHARACTERISTIC InjSys_P2V1I3_HP.facTPist_M "injection packet 2 in variant 1 / piston temperature based map for injection angle correction" MAP 0x80561966 RB_Map_S16S16_U8 0.9961 fak_ub_b1 0.00 0.9961
 /begin AXIS_DESCR STD_AXIS InjSys_tPistBas Temp_Cels 6 -3549.940 3003.560 FORMAT "%8.3" DEPOSIT ABSOLUTE /end AXIS_DESCR
 /begin AXIS_DESCR STD_AXIS InjSys_tPistDelta temp_q0p1 6 -3276.800 3276.700 FORMAT "%8.3" DEPOSIT ABSOLUTE /end AXIS_DESCR
/end CHARACTERISTIC
/begin CHARACTERISTIC InjSys_P2V1I3_HP.facWghtAgBasTEthnl_M "injection packet 2 in variant 1 / weighting factor base angle ethanol dependent" MAP 0x805619A6 RB_Map_S16S16_U8 0.9961 fak_ub_b1 0.00 0.9961
 /begin AXIS_DESCR STD_AXIS InjSys_tEng Temp_Cels 6 -3549.940 3003.560 FORMAT "%8.3" DEPOSIT ABSOLUTE /end AXIS_DESCR
 /begin AXIS_DESCR STD_AXIS InjSys_tEngStrt Temp_Cels 4 -3549.940 3003.560 FORMAT "%8.3" DEPOSIT ABSOLUTE /end AXIS_DESCR
/end CHARACTERISTIC
/begin CHARACTERISTIC InjSys_P2V1I3_HP.facWghtAgBasT_M "injection packet 2 in variant 1 / weighting factor base angle temperature dependent" MAP 0x805619D6 RB_Map_S16S16_U8 0.9961 fak_ub_b1 0.00 0.9961
 /begin AXIS_DESCR STD_AXIS InjSys_tEng Temp_Cels 6 -3549.940 3003.560 FORMAT "%8.3" DEPOSIT ABSOLUTE /end AXIS_DESCR
 /begin AXIS_DESCR STD_AXIS InjSys_tEngStrt Temp_Cels 4 -3549.940 3003.560 FORMAT "%8.3" DEPOSIT ABSOLUTE /end AXIS_DESCR
/end CHARACTERISTIC
/begin CHARACTERISTIC InjSys_P2V1I3_HP.facWghtSpltBasTFuEthnl_GM "injection packet 2 in variant 1 / weighting factor split based fuel ethanol dependent" MAP 0x80561A06 RB_MapGroup_U8 0.9961 fak_ub_b1 0.00 0.9961
 /begin AXIS_DESCR COM_AXIS InjSys_tEngStrt Temp_Cels 8 -3549.940 3003.560 FORMAT "%8.3" AXIS_PTS_REF InjSys_tEngStrt08_AX /end AXIS_DESCR
 /begin AXIS_DESCR COM_AXIS InjSys_tEng Temp_Cels 8 -3549.940 3003.560 FORMAT "%8.3" AXIS_PTS_REF InjSys_tEng08_AX /end AXIS_DESCR
/end CHARACTERISTIC
/begin CHARACTERISTIC InjSys_P2V1I3_HP.facWghtSpltBasTFu_GM "injection packet 2 in variant 1 / ." MAP 0x80561A46 RB_MapGroup_U8 0.9961 fak_ub_b1 0.00 0.9961
 /begin AXIS_DESCR COM_AXIS InjSys_tEngStrt Temp_Cels 8 -3549.940 3003.560 FORMAT "%8.3" AXIS_PTS_REF InjSys_tEngStrt08_AX /end AXIS_DESCR
 /begin AXIS_DESCR COM_AXIS InjSys_tEng Temp_Cels 8 -3549.940 3003.560 FORMAT "%8.3" AXIS_PTS_REF InjSys_tEng08_AX /end AXIS_DESCR
/end CHARACTERISTIC
/begin CHARACTERISTIC InjSys_P2V1I3_HP.facWghtSpltOilTEthnl_GM "injection packet 2 in variant 1 / ." MAP 0x80561A86 RB_MapGroup_U8 0.9961 fak_ub_b1 0.00 0.9961
 /begin AXIS_DESCR COM_AXIS InjSys_tOilSp Temp_Cels 8 -3549.940 3003.560 FORMAT "%8.3" AXIS_PTS_REF InjSys_tosp08_AX /end AXIS_DESCR
 /begin AXIS_DESCR COM_AXIS InjSys_tEng Temp_Cels 8 -3549.940 3003.560 FORMAT "%8.3" AXIS_PTS_REF InjSys_tEng08_AX /end AXIS_DESCR
/end CHARACTERISTIC
/begin CHARACTERISTIC InjSys_P2V1I3_HP.facWghtSpltOilT_GM "injection packet 2 in variant 1 / ." MAP 0x80561AC6 RB_MapGroup_U8 0.9961 fak_ub_b1 0.00 0.9961
 /begin AXIS_DESCR COM_AXIS InjSys_tOilSp Temp_Cels 8 -3549.940 3003.560 FORMAT "%8.3" AXIS_PTS_REF InjSys_tosp08_AX /end AXIS_DESCR
 /begin AXIS_DESCR COM_AXIS InjSys_tEng Temp_Cels 8 -3549.940 3003.560 FORMAT "%8.3" AXIS_PTS_REF InjSys_tEng08_AX /end AXIS_DESCR
/end CHARACTERISTIC
/begin CHARACTERISTIC InjSys_P2V1I3_HP.flgAbsltSplt_C "injection packet 2 in variant 1 / condition split with absolute fuel mass" VALUE 0x80561B06 RB_Val_Wu8 1.00000000000 B_TRUE 0.00 1.00000000000 FORMAT "%13.11" /end CHARACTERISTIC
/begin CHARACTERISTIC InjSys_P2V1I3_HP.flgAgCalc_C "injection packet 2 in variant 1 / ." VALUE 0x80561B07 RB_Val_Wu8 1.00000000000 B_TRUE 0.00 1.00000000000 FORMAT "%13.11" /end CHARACTERISTIC
/begin CHARACTERISTIC InjSys_P2V1I3_HP.flgAgEnd_C "injection packet 2 in variant 1 / condition end angle" VALUE 0x80561B08 RB_Val_Wu8 1.00000000000 B_TRUE 0.00 1.00000000000 FORMAT "%13.11" /end CHARACTERISTIC
/begin CHARACTERISTIC InjSys_P2V1I3_HP.flgAxVers_C "injection packet 2 in variant 1 / condition map selection with group axis in version 2" VALUE 0x80561B09 RB_Val_Wu8 1.00000000000 B_TRUE 0.00 1.00000000000 FORMAT "%13.11" /end CHARACTERISTIC
/begin CHARACTERISTIC InjSys_P2V1I3_HP.flgPktCoupl_C "injection packet 2 in variant 1 / condition packet coupling with break time" VALUE 0x80561B0A RB_Val_Wu8 1.00000000000 B_TRUE 0.00 1.00000000000 FORMAT "%13.11" /end CHARACTERISTIC
/begin CHARACTERISTIC InjSys_P2V1I3_HP.ratFuMBasHi_GM "injection packet 2 in variant 1 / relative fuel mass base injection for interpolation" MAP 0x80561B0C RB_MapGroup_U16 3071.953 rel_uw_b3072 0.00 3071.953 FORMAT "%8.3"
 /begin AXIS_DESCR COM_AXIS Epm_nEng EngN 10 0.00 16383.50 FORMAT "%8.2" EXTENDED_LIMITS -16384.00 16383.50 AXIS_PTS_REF InjSys_nEng10_AX /end AXIS_DESCR
 /begin AXIS_DESCR COM_AXIS InjSys_ratAirMAxisInp rel_uw_q0p0234 8 0.00 1535.977 FORMAT "%8.3" AXIS_PTS_REF InjSys_ratAirM08_AX /end AXIS_DESCR
/end CHARACTERISTIC
/begin CHARACTERISTIC InjSys_P2V1I3_HP.ratFuMBasLo_GM "injection packet 2 in variant 1 / relative fuel mass base injection for interpolation" MAP 0x80561BAC RB_MapGroup_U16 3071.953 rel_uw_b3072 0.00 3071.953 FORMAT "%8.3"
 /begin AXIS_DESCR COM_AXIS Epm_nEng EngN 10 0.00 16383.50 FORMAT "%8.2" EXTENDED_LIMITS -16384.00 16383.50 AXIS_PTS_REF InjSys_nEng10_AX /end AXIS_DESCR
 /begin AXIS_DESCR COM_AXIS InjSys_ratAirMAxisInp rel_uw_q0p0234 8 0.00 1535.977 FORMAT "%8.3" AXIS_PTS_REF InjSys_ratAirM08_AX /end AXIS_DESCR
/end CHARACTERISTIC
/begin CHARACTERISTIC InjSys_P2V1I3_HP.stAgFacTInj_C "injection packet 2 in variant 1 / switch to select oil temperature dependent map" VALUE 0x80561C4C RB_Val_Wu8 1.00000000000 B_TRUE 0.00 1.00000000000 FORMAT "%13.11" /end CHARACTERISTIC
/begin CHARACTERISTIC InjSys_P2V1I3_HP.stfacWghtSpltT_C "injection packet 2 in variant 1 / switch to select oil temerature dependent map" VALUE 0x80561C4D RB_Val_Wu8 1.00000000000 B_TRUE 0.00 1.00000000000 FORMAT "%13.11" /end CHARACTERISTIC
/begin CHARACTERISTIC InjSys_P2V1I3_HP.tiBreakPkt_M "injection packet 2 in variant 1 / break time for packet coupling" MAP 0x80561C4E RB_Map_S16U16_S16 1310.720 t_q0p04_ms -1310.720 0.00 FORMAT "%8.3" EXTENDED_LIMITS -1310.720 1310.680
 /begin AXIS_DESCR STD_AXIS Epm_nEng EngN 8 -16384.00 16383.50 FORMAT "%8.2" DEPOSIT ABSOLUTE /end AXIS_DESCR
 /begin AXIS_DESCR STD_AXIS InjSys_ratAirMPredLocSp rel_uw_q0p0234 8 0.00 1535.977 FORMAT "%8.3" DEPOSIT ABSOLUTE /end AXIS_DESCR
/end CHARACTERISTIC
/begin CHARACTERISTIC InjSys_P2V2I1_HP.agBasHiEthnl_GM "class instance packet 2 variant 2 / ." MAP 0x80567AC0 RB_MapGroup_S8 382.5 kw_q1p5 -192.0 190.5 FORMAT "%5.1"
 /begin AXIS_DESCR COM_AXIS Epm_nEng EngN 12 0.00 16383.50 FORMAT "%8.2" EXTENDED_LIMITS -16384.00 16383.50 AXIS_PTS_REF InjSys_nEng12Hsp_AX /end AXIS_DESCR
 /begin AXIS_DESCR COM_AXIS InjSys_ratAirMAgSpAxisInp rel_uw_q0p0234 12 0.00 1535.977 FORMAT "%8.3" AXIS_PTS_REF InjSys_ratAirM12AgSp_AX /end AXIS_DESCR
/end CHARACTERISTIC
/begin CHARACTERISTIC InjSys_P2V2I1_HP.agBasHiVers2Ethnl_GM "class instance packet 2 variant 2 / ." MAP 0x80567B50 RB_MapGroup_S8 382.5 kw_q1p5 -192.0 190.5 FORMAT "%5.1"
 /begin AXIS_DESCR COM_AXIS Epm_nEng EngN 12 0.00 16383.50 FORMAT "%8.2" EXTENDED_LIMITS -16384.00 16383.50 AXIS_PTS_REF InjSys_nEng12HspVers2_AX /end AXIS_DESCR
 /begin AXIS_DESCR COM_AXIS InjSys_ratAirMAgSpVers2AxisInp rel_uw_q0p0234 12 0.00 1535.977 FORMAT "%8.3" AXIS_PTS_REF InjSys_ratAirM12AgSpHspVers2_AX /end AXIS_DESCR
/end CHARACTERISTIC
/begin CHARACTERISTIC InjSys_P2V2I1_HP.agBasHiVers2_GM "class instance packet 2 variant 2 / base angle for interpolation (version 2)" MAP 0x80567BE0 RB_MapGroup_S8 382.5 kw_q1p5 -192.0 190.5 FORMAT "%5.1"
 /begin AXIS_DESCR COM_AXIS Epm_nEng EngN 12 0.00 16383.50 FORMAT "%8.2" EXTENDED_LIMITS -16384.00 16383.50 AXIS_PTS_REF InjSys_nEng12HspVers2_AX /end AXIS_DESCR
 /begin AXIS_DESCR COM_AXIS InjSys_ratAirMAgSpVers2AxisInp rel_uw_q0p0234 12 0.00 1535.977 FORMAT "%8.3" AXIS_PTS_REF InjSys_ratAirM12AgSpHspVers2_AX /end AXIS_DESCR
/end CHARACTERISTIC
/begin CHARACTERISTIC InjSys_P2V2I1_HP.agBasHi_GM "class instance packet 2 variant 2 / base angle for interpolation" MAP 0x80567C70 RB_MapGroup_S8 382.5 kw_q1p5 -192.0 190.5 FORMAT "%5.1"
 /begin AXIS_DESCR COM_AXIS Epm_nEng EngN 12 0.00 16383.50 FORMAT "%8.2" EXTENDED_LIMITS -16384.00 16383.50 AXIS_PTS_REF InjSys_nEng12Hsp_AX /end AXIS_DESCR
 /begin AXIS_DESCR COM_AXIS InjSys_ratAirMAgSpAxisInp rel_uw_q0p0234 12 0.00 1535.977 FORMAT "%8.3" AXIS_PTS_REF InjSys_ratAirM12AgSpHsp_AX /end AXIS_DESCR
/end CHARACTERISTIC
/begin CHARACTERISTIC InjSys_P2V2I1_HP.agBasLoEthnl_GM "class instance packet 2 variant 2 / ." MAP 0x80567D00 RB_MapGroup_S8 382.5 kw_q1p5 -192.0 190.5 FORMAT "%5.1"
 /begin AXIS_DESCR COM_AXIS Epm_nEng EngN 12 0.00 16383.50 FORMAT "%8.2" EXTENDED_LIMITS -16384.00 16383.50 AXIS_PTS_REF InjSys_nEng12Hsp_AX /end AXIS_DESCR
 /begin AXIS_DESCR COM_AXIS InjSys_ratAirMAgSpAxisInp rel_uw_q0p0234 12 0.00 1535.977 FORMAT "%8.3" AXIS_PTS_REF InjSys_ratAirM12AgSpHsp_AX /end AXIS_DESCR
/end CHARACTERISTIC
/begin CHARACTERISTIC InjSys_P2V2I1_HP.agBasLoVers2Ethnl_GM "class instance packet 2 variant 2 / ." MAP 0x80567D90 RB_MapGroup_S8 382.5 kw_q1p5 -192.0 190.5 FORMAT "%5.1"
 /begin AXIS_DESCR COM_AXIS Epm_nEng EngN 12 0.00 16383.50 FORMAT "%8.2" EXTENDED_LIMITS -16384.00 16383.50 AXIS_PTS_REF InjSys_nEng12HspVers2_AX /end AXIS_DESCR
 /begin AXIS_DESCR COM_AXIS InjSys_ratAirMAgSpVers2AxisInp rel_uw_q0p0234 12 0.00 1535.977 FORMAT "%8.3" AXIS_PTS_REF InjSys_ratAirM12AgSpHspVers2_AX /end AXIS_DESCR
/end CHARACTERISTIC
/begin CHARACTERISTIC InjSys_P2V2I1_HP.agBasLoVers2_GM "class instance packet 2 variant 2 / base angle for interpolation (version 2)" MAP 0x80567E20 RB_MapGroup_S8 382.5 kw_q1p5 -192.0 190.5 FORMAT "%5.1"
 /begin AXIS_DESCR COM_AXIS Epm_nEng EngN 12 0.00 16383.50 FORMAT "%8.2" EXTENDED_LIMITS -16384.00 16383.50 AXIS_PTS_REF InjSys_nEng12HspVers2_AX /end AXIS_DESCR
 /begin AXIS_DESCR COM_AXIS InjSys_ratAirMAgSpVers2AxisInp rel_uw_q0p0234 12 0.00 1535.977 FORMAT "%8.3" AXIS_PTS_REF InjSys_ratAirM12AgSpHspVers2_AX /end AXIS_DESCR
/end CHARACTERISTIC
/begin CHARACTERISTIC InjSys_P2V2I1_HP.agBasLo_GM "class instance packet 2 variant 2 / base angle for interpolation" MAP 0x80567EB0 RB_MapGroup_S8 382.5 kw_q1p5 -192.0 190.5 FORMAT "%5.1"
 /begin AXIS_DESCR COM_AXIS Epm_nEng EngN 12 0.00 16383.50 FORMAT "%8.2" EXTENDED_LIMITS -16384.00 16383.50 AXIS_PTS_REF InjSys_nEng12Hsp_AX /end AXIS_DESCR
 /begin AXIS_DESCR COM_AXIS InjSys_ratAirMAgSpAxisInp rel_uw_q0p0234 12 0.00 1535.977 FORMAT "%8.3" AXIS_PTS_REF InjSys_ratAirM12AgSpHsp_AX /end AXIS_DESCR
/end CHARACTERISTIC
/begin CHARACTERISTIC InjSys_P2V2I1_HP.agBasTPistColdVers2_GM "class instance packet 2 variant 2 / base angle for interpolation cold TSA mode" MAP 0x80567F40 RB_MapGroup_U8 382.5 kw_q1p5 0.00 382.5 FORMAT "%5.1"
 /begin AXIS_DESCR COM_AXIS Epm_nEng EngN 12 0.00 16383.50 FORMAT "%8.2" EXTENDED_LIMITS -16384.00 16383.50 AXIS_PTS_REF InjSys_nEng12HspVers2_AX /end AXIS_DESCR
 /begin AXIS_DESCR COM_AXIS InjSys_ratAirMAgSpVers2AxisInp rel_uw_q0p0234 12 0.00 1535.977 FORMAT "%8.3" AXIS_PTS_REF InjSys_ratAirM12AgSpHspVers2_AX /end AXIS_DESCR
/end CHARACTERISTIC
/begin CHARACTERISTIC InjSys_P2V2I1_HP.agBasTPistCold_GM "class instance packet 2 variant 2 / base angle for interpolation cold TSA mode" MAP 0x80567FD0 RB_MapGroup_U8 382.5 kw_q1p5 0.00 382.5 FORMAT "%5.1"
 /begin AXIS_DESCR COM_AXIS Epm_nEng EngN 12 0.00 16383.50 FORMAT "%8.2" EXTENDED_LIMITS -16384.00 16383.50 AXIS_PTS_REF InjSys_nEng12Hsp_AX /end AXIS_DESCR
 /begin AXIS_DESCR COM_AXIS InjSys_ratAirMAgSpAxisInp rel_uw_q0p0234 12 0.00 1535.977 FORMAT "%8.3" AXIS_PTS_REF InjSys_ratAirM12AgSpHsp_AX /end AXIS_DESCR
/end CHARACTERISTIC
/begin CHARACTERISTIC InjSys_P2V2I1_HP.agBasTPistWrmVers2_GM "class instance packet 2 variant 2 / base angle for interpolation Warm TSA mode (Version 2)" MAP 0x80568060 RB_MapGroup_U8 382.5 kw_q1p5 0.00 382.5 FORMAT "%5.1"
 /begin AXIS_DESCR COM_AXIS Epm_nEng EngN 12 0.00 16383.50 FORMAT "%8.2" EXTENDED_LIMITS -16384.00 16383.50 AXIS_PTS_REF InjSys_nEng12HspVers2_AX /end AXIS_DESCR
 /begin AXIS_DESCR COM_AXIS InjSys_ratAirMAgSpVers2AxisInp rel_uw_q0p0234 12 0.00 1535.977 FORMAT "%8.3" AXIS_PTS_REF InjSys_ratAirM12AgSpHspVers2_AX /end AXIS_DESCR
/end CHARACTERISTIC
/begin CHARACTERISTIC InjSys_P2V2I1_HP.agBasTPistWrm_GM "class instance packet 2 variant 2 / base angle for interpolation Warm TSA mode" MAP 0x805680F0 RB_MapGroup_U8 382.5 kw_q1p5 0.00 382.5 FORMAT "%5.1"
 /begin AXIS_DESCR COM_AXIS Epm_nEng EngN 12 0.00 16383.50 FORMAT "%8.2" EXTENDED_LIMITS -16384.00 16383.50 AXIS_PTS_REF InjSys_nEng12Hsp_AX /end AXIS_DESCR
 /begin AXIS_DESCR COM_AXIS InjSys_ratAirMAgSpAxisInp rel_uw_q0p0234 12 0.00 1535.977 FORMAT "%8.3" AXIS_PTS_REF InjSys_ratAirM12AgSpHsp_AX /end AXIS_DESCR
/end CHARACTERISTIC
/begin CHARACTERISTIC InjSys_P2V2I1_HP.facEthnlAgBas_T "class instance packet 2 variant 2 / ." CURVE 0x80568180 RB_Curve_U8_U8 0.9961 fak_ub_b1 0.00 0.9961
 /begin AXIS_DESCR STD_AXIS fethstoeLocSp fak_ub_b2 4 0.00 1.992188 FORMAT "%8.6" DEPOSIT ABSOLUTE /end AXIS_DESCR
/end CHARACTERISTIC
/begin CHARACTERISTIC InjSys_P2V2I1_HP.facSpltAux1CorrnLoT_GM "class instance packet 2 variant 2 / split factor correction auxiliary injection 1 dependent of temperature and number of injections" MAP 0x80568189 RB_MapGroup_U8 1.992188 fak_ub_b2 0.00 1.992188 FORMAT "%8.6"
 /begin AXIS_DESCR COM_AXIS InjSys_tEng Temp_Cels 8 -3549.940 3003.560 FORMAT "%8.3" AXIS_PTS_REF InjSys_tEng08_AX /end AXIS_DESCR
 /begin AXIS_DESCR COM_AXIS InjSys_nrInjLimdLoc dez 8 0.00 65535.00 FORMAT "%8.2" AXIS_PTS_REF InjSys_nrInj08_AX /end AXIS_DESCR
/end CHARACTERISTIC
/begin CHARACTERISTIC InjSys_P2V2I1_HP.facSpltAux1HiExtd_GM "class instance packet 2 variant 2 / split factor auxiliary injection 1 for interpolation" MAP 0x805681C9 RB_MapGroup_U8 0.9961 fak_ub_b1 0.00 0.9961
 /begin AXIS_DESCR COM_AXIS Epm_nEng EngN 12 0.00 16383.50 FORMAT "%8.2" EXTENDED_LIMITS -16384.00 16383.50 AXIS_PTS_REF InjSys_nEng12Vers2_AX /end AXIS_DESCR
 /begin AXIS_DESCR COM_AXIS InjSys_ratAirMVers2AxisInp rel_uw_q0p0234 12 0.00 1535.977 FORMAT "%8.3" AXIS_PTS_REF InjSys_ratAirM12Vers2_AX /end AXIS_DESCR
/end CHARACTERISTIC
/begin CHARACTERISTIC InjSys_P2V2I1_HP.facSpltAux1Hi_GM "class instance packet 2 variant 2 / split factor auxiliary injection 1 for interpolation" MAP 0x80568259 RB_MapGroup_U8 0.9961 fak_ub_b1 0.00 0.9961
 /begin AXIS_DESCR COM_AXIS Epm_nEng EngN 10 0.00 16383.50 FORMAT "%8.2" EXTENDED_LIMITS -16384.00 16383.50 AXIS_PTS_REF InjSys_nEng10_AX /end AXIS_DESCR
 /begin AXIS_DESCR COM_AXIS InjSys_ratAirMAxisInp rel_uw_q0p0234 8 0.00 1535.977 FORMAT "%8.3" AXIS_PTS_REF InjSys_ratAirM08_AX /end AXIS_DESCR
/end CHARACTERISTIC
/begin CHARACTERISTIC InjSys_P2V2I1_HP.facSpltAux1LoExtd_GM "class instance packet 2 variant 2 / split factor auxiliary injection 1 for interpolation" MAP 0x805682A9 RB_MapGroup_U8 0.9961 fak_ub_b1 0.00 0.9961
 /begin AXIS_DESCR COM_AXIS Epm_nEng EngN 12 0.00 16383.50 FORMAT "%8.2" EXTENDED_LIMITS -16384.00 16383.50 AXIS_PTS_REF InjSys_nEng12Vers2_AX /end AXIS_DESCR
 /begin AXIS_DESCR COM_AXIS InjSys_ratAirMVers2AxisInp rel_uw_q0p0234 12 0.00 1535.977 FORMAT "%8.3" AXIS_PTS_REF InjSys_ratAirM12Vers2_AX /end AXIS_DESCR
/end CHARACTERISTIC
/begin CHARACTERISTIC InjSys_P2V2I1_HP.facSpltAux1Lo_GM "class instance packet 2 variant 2 / split factor auxiliary injection 1 for interpolation" MAP 0x80568339 RB_MapGroup_U8 0.9961 fak_ub_b1 0.00 0.9961
 /begin AXIS_DESCR COM_AXIS Epm_nEng EngN 10 0.00 16383.50 FORMAT "%8.2" EXTENDED_LIMITS -16384.00 16383.50 AXIS_PTS_REF InjSys_nEng10_AX /end AXIS_DESCR
 /begin AXIS_DESCR COM_AXIS InjSys_ratAirMAxisInp rel_uw_q0p0234 8 0.00 1535.977 FORMAT "%8.3" AXIS_PTS_REF InjSys_ratAirM08_AX /end AXIS_DESCR
/end CHARACTERISTIC
/begin CHARACTERISTIC InjSys_P2V2I1_HP.facSpltCorrnLoT_GM "class instance packet 2 variant 2 / split factor correction dependent of temperature and number of injections" MAP 0x80568389 RB_MapGroup_U8 1.992188 fak_ub_b2 0.00 1.992188 FORMAT "%8.6"
 /begin AXIS_DESCR COM_AXIS InjSys_tEng Temp_Cels 8 -3549.940 3003.560 FORMAT "%8.3" AXIS_PTS_REF InjSys_tEng08_AX /end AXIS_DESCR
 /begin AXIS_DESCR COM_AXIS InjSys_nrInjLimdLoc dez 8 0.00 65535.00 FORMAT "%8.2" AXIS_PTS_REF InjSys_nrInj08_AX /end AXIS_DESCR
/end CHARACTERISTIC
/begin CHARACTERISTIC InjSys_P2V2I1_HP.facSpltPktHiExtd_GM "class instance packet 2 variant 2 / split factor packet for interpolation" MAP 0x805683C9 RB_MapGroup_U8 0.9961 fak_ub_b1 0.00 0.9961
 /begin AXIS_DESCR COM_AXIS Epm_nEng EngN 12 0.00 16383.50 FORMAT "%8.2" EXTENDED_LIMITS -16384.00 16383.50 AXIS_PTS_REF InjSys_nEng12Vers2_AX /end AXIS_DESCR
 /begin AXIS_DESCR COM_AXIS InjSys_ratAirMVers2AxisInp rel_uw_q0p0234 12 0.00 1535.977 FORMAT "%8.3" AXIS_PTS_REF InjSys_ratAirM12Vers2_AX /end AXIS_DESCR
/end CHARACTERISTIC
/begin CHARACTERISTIC InjSys_P2V2I1_HP.facSpltPktHi_GM "class instance packet 2 variant 2 / split factor packet for interpolation" MAP 0x80568459 RB_MapGroup_U8 0.9961 fak_ub_b1 0.00 0.9961
 /begin AXIS_DESCR COM_AXIS Epm_nEng EngN 10 0.00 16383.50 FORMAT "%8.2" EXTENDED_LIMITS -16384.00 16383.50 AXIS_PTS_REF InjSys_nEng10_AX /end AXIS_DESCR
 /begin AXIS_DESCR COM_AXIS InjSys_ratAirMAxisInp rel_uw_q0p0234 8 0.00 1535.977 FORMAT "%8.3" AXIS_PTS_REF InjSys_ratAirM08_AX /end AXIS_DESCR
/end CHARACTERISTIC
/begin CHARACTERISTIC InjSys_P2V2I1_HP.facSpltPktLoExtd_GM "class instance packet 2 variant 2 / split factor packet for interpolation" MAP 0x805684A9 RB_MapGroup_U8 0.9961 fak_ub_b1 0.00 0.9961
 /begin AXIS_DESCR COM_AXIS Epm_nEng EngN 12 0.00 16383.50 FORMAT "%8.2" EXTENDED_LIMITS -16384.00 16383.50 AXIS_PTS_REF InjSys_nEng12Vers2_AX /end AXIS_DESCR
 /begin AXIS_DESCR COM_AXIS InjSys_ratAirMVers2AxisInp rel_uw_q0p0234 12 0.00 1535.977 FORMAT "%8.3" AXIS_PTS_REF InjSys_ratAirM12Vers2_AX /end AXIS_DESCR
/end CHARACTERISTIC
/begin CHARACTERISTIC InjSys_P2V2I1_HP.facSpltPktLo_GM "class instance packet 2 variant 2 / split factor packet for interpolation" MAP 0x80568539 RB_MapGroup_U8 0.9961 fak_ub_b1 0.00 0.9961
 /begin AXIS_DESCR COM_AXIS Epm_nEng EngN 10 0.00 16383.50 FORMAT "%8.2" EXTENDED_LIMITS -16384.00 16383.50 AXIS_PTS_REF InjSys_nEng10_AX /end AXIS_DESCR
 /begin AXIS_DESCR COM_AXIS InjSys_ratAirMAxisInp rel_uw_q0p0234 8 0.00 1535.977 FORMAT "%8.3" AXIS_PTS_REF InjSys_ratAirM08_AX /end AXIS_DESCR
/end CHARACTERISTIC
/begin CHARACTERISTIC InjSys_P2V2I1_HP.facTInjAgEthnl_M "class instance packet 2 variant 2 / ." MAP 0x8056858A RB_Map_S16S16_U8 0.9961 fak_ub_b1 0.00 0.9961
 /begin AXIS_DESCR STD_AXIS InjSys_tEng Temp_Cels 8 -3549.940 3003.560 FORMAT "%8.3" DEPOSIT ABSOLUTE /end AXIS_DESCR
 /begin AXIS_DESCR STD_AXIS InjSys_tOilLocSp Temp_Cels 8 -3549.940 3003.560 FORMAT "%8.3" DEPOSIT ABSOLUTE /end AXIS_DESCR
/end CHARACTERISTIC
/begin CHARACTERISTIC InjSys_P2V2I1_HP.facTInjAg_M "class instance packet 2 variant 2 / ." MAP 0x805685EE RB_Map_S16S16_U8 0.9961 fak_ub_b1 0.00 0.9961
 /begin AXIS_DESCR STD_AXIS InjSys_tEng Temp_Cels 8 -3549.940 3003.560 FORMAT "%8.3" DEPOSIT ABSOLUTE /end AXIS_DESCR
 /begin AXIS_DESCR STD_AXIS InjSys_tOilLocSp Temp_Cels 8 -3549.940 3003.560 FORMAT "%8.3" DEPOSIT ABSOLUTE /end AXIS_DESCR
/end CHARACTERISTIC
/begin CHARACTERISTIC InjSys_P2V2I1_HP.facTPistCold_M "class instance packet 2 variant 2 / Engine temperature and oil temperature based map for injection angle correction" MAP 0x80568652 RB_Map_S16S16_U8 0.9961 fak_ub_b1 0.00 0.9961
 /begin AXIS_DESCR STD_AXIS InjSys_tEng Temp_Cels 8 -3549.940 3003.560 FORMAT "%8.3" DEPOSIT ABSOLUTE /end AXIS_DESCR
 /begin AXIS_DESCR STD_AXIS InjSys_tOilLocSp Temp_Cels 8 -3549.940 3003.560 FORMAT "%8.3" DEPOSIT ABSOLUTE /end AXIS_DESCR
/end CHARACTERISTIC
/begin CHARACTERISTIC InjSys_P2V2I1_HP.facTPist_M "class instance packet 2 variant 2 / piston temperature based map for injection angle correction" MAP 0x805686B6 RB_Map_S16S16_U8 0.9961 fak_ub_b1 0.00 0.9961
 /begin AXIS_DESCR STD_AXIS InjSys_tPistBas Temp_Cels 6 -3549.940 3003.560 FORMAT "%8.3" DEPOSIT ABSOLUTE /end AXIS_DESCR
 /begin AXIS_DESCR STD_AXIS InjSys_tPistDelta temp_q0p1 6 -3276.800 3276.700 FORMAT "%8.3" DEPOSIT ABSOLUTE /end AXIS_DESCR
/end CHARACTERISTIC
/begin CHARACTERISTIC InjSys_P2V2I1_HP.facWghtAgBasTEthnl_M "class instance packet 2 variant 2 / ." MAP 0x805686F6 RB_Map_S16S16_U8 0.9961 fak_ub_b1 0.00 0.9961
 /begin AXIS_DESCR STD_AXIS InjSys_tEng Temp_Cels 6 -3549.940 3003.560 FORMAT "%8.3" DEPOSIT ABSOLUTE /end AXIS_DESCR
 /begin AXIS_DESCR STD_AXIS InjSys_tEngStrt Temp_Cels 4 -3549.940 3003.560 FORMAT "%8.3" DEPOSIT ABSOLUTE /end AXIS_DESCR
/end CHARACTERISTIC
/begin CHARACTERISTIC InjSys_P2V2I1_HP.facWghtAgBasT_M "class instance packet 2 variant 2 / weighting factor base angle temperature dependent" MAP 0x80568726 RB_Map_S16S16_U8 0.9961 fak_ub_b1 0.00 0.9961
 /begin AXIS_DESCR STD_AXIS InjSys_tEng Temp_Cels 6 -3549.940 3003.560 FORMAT "%8.3" DEPOSIT ABSOLUTE /end AXIS_DESCR
 /begin AXIS_DESCR STD_AXIS InjSys_tEngStrt Temp_Cels 4 -3549.940 3003.560 FORMAT "%8.3" DEPOSIT ABSOLUTE /end AXIS_DESCR
/end CHARACTERISTIC
/begin CHARACTERISTIC InjSys_P2V2I1_HP.facWghtSpltOilT_GM "class instance packet 2 variant 2 / weighting factor split factor oil temperature dependent" MAP 0x80568756 RB_MapGroup_U8 0.9961 fak_ub_b1 0.00 0.9961
 /begin AXIS_DESCR COM_AXIS InjSys_tOilSp Temp_Cels 8 -3549.940 3003.560 FORMAT "%8.3" AXIS_PTS_REF InjSys_tosp08_AX /end AXIS_DESCR
 /begin AXIS_DESCR COM_AXIS InjSys_tEng Temp_Cels 8 -3549.940 3003.560 FORMAT "%8.3" AXIS_PTS_REF InjSys_tEng08_AX /end AXIS_DESCR
/end CHARACTERISTIC
/begin CHARACTERISTIC InjSys_P2V2I1_HP.facWghtSpltT_GM "class instance packet 2 variant 2 / weighting factor split factor temperature dependent" MAP 0x80568796 RB_MapGroup_U8 0.9961 fak_ub_b1 0.00 0.9961
 /begin AXIS_DESCR COM_AXIS InjSys_tEngStrt Temp_Cels 8 -3549.940 3003.560 FORMAT "%8.3" AXIS_PTS_REF InjSys_tEngStrt08_AX /end AXIS_DESCR
 /begin AXIS_DESCR COM_AXIS InjSys_tEng Temp_Cels 8 -3549.940 3003.560 FORMAT "%8.3" AXIS_PTS_REF InjSys_tEng08_AX /end AXIS_DESCR
/end CHARACTERISTIC
/begin CHARACTERISTIC InjSys_P2V2I1_HP.flgAbsltSplt_C "class instance packet 2 variant 2 / condition split with absolute fuel mass" VALUE 0x805687D6 RB_Val_Wu8 1.00000000000 B_TRUE 0.00 1.00000000000 FORMAT "%13.11" /end CHARACTERISTIC
/begin CHARACTERISTIC InjSys_P2V2I1_HP.flgAgEnd_C "class instance packet 2 variant 2 / condition end angle" VALUE 0x805687D7 RB_Val_Wu8 1.00000000000 B_TRUE 0.00 1.00000000000 FORMAT "%13.11" /end CHARACTERISTIC
/begin CHARACTERISTIC InjSys_P2V2I1_HP.flgAxVers_C "class instance packet 2 variant 2 / condition map selection with group axis in version 2" VALUE 0x805687D8 RB_Val_Wu8 1.00000000000 B_TRUE 0.00 1.00000000000 FORMAT "%13.11" /end CHARACTERISTIC
/begin CHARACTERISTIC InjSys_P2V2I1_HP.flgPktCoupl_C "class instance packet 2 variant 2 / condition packet coupling with break time" VALUE 0x805687D9 RB_Val_Wu8 1.00000000000 B_TRUE 0.00 1.00000000000 FORMAT "%13.11" /end CHARACTERISTIC
/begin CHARACTERISTIC InjSys_P2V2I1_HP.ratFuMAux1Hi_GM "class instance packet 2 variant 2 / relative fuel mass auxiliary injection 1 for interpolation" MAP 0x805687DA RB_MapGroup_U16 3071.953 rel_uw_b3072 0.00 3071.953 FORMAT "%8.3"
 /begin AXIS_DESCR COM_AXIS Epm_nEng EngN 10 0.00 16383.50 FORMAT "%8.2" EXTENDED_LIMITS -16384.00 16383.50 AXIS_PTS_REF InjSys_nEng10_AX /end AXIS_DESCR
 /begin AXIS_DESCR COM_AXIS InjSys_ratAirMAxisInp rel_uw_q0p0234 8 0.00 1535.977 FORMAT "%8.3" AXIS_PTS_REF InjSys_ratAirM08_AX /end AXIS_DESCR
/end CHARACTERISTIC
/begin CHARACTERISTIC InjSys_P2V2I1_HP.ratFuMAux1Lo_GM "class instance packet 2 variant 2 / relative fuel mass auxiliary injection 1 for interpolation" MAP 0x8056887A RB_MapGroup_U16 3071.953 rel_uw_b3072 0.00 3071.953 FORMAT "%8.3"
 /begin AXIS_DESCR COM_AXIS Epm_nEng EngN 10 0.00 16383.50 FORMAT "%8.2" EXTENDED_LIMITS -16384.00 16383.50 AXIS_PTS_REF InjSys_nEng10_AX /end AXIS_DESCR
 /begin AXIS_DESCR COM_AXIS InjSys_ratAirMAxisInp rel_uw_q0p0234 8 0.00 1535.977 FORMAT "%8.3" AXIS_PTS_REF InjSys_ratAirM08_AX /end AXIS_DESCR
/end CHARACTERISTIC
/begin CHARACTERISTIC InjSys_P2V2I1_HP.ratFuMBasHi_GM "class instance packet 2 variant 2 / relative fuel mass base injection 1 for interpolation" MAP 0x8056891A RB_MapGroup_U16 3071.953 rel_uw_b3072 0.00 3071.953 FORMAT "%8.3"
 /begin AXIS_DESCR COM_AXIS Epm_nEng EngN 10 0.00 16383.50 FORMAT "%8.2" EXTENDED_LIMITS -16384.00 16383.50 AXIS_PTS_REF InjSys_nEng10_AX /end AXIS_DESCR
 /begin AXIS_DESCR COM_AXIS InjSys_ratAirMAxisInp rel_uw_q0p0234 8 0.00 1535.977 FORMAT "%8.3" AXIS_PTS_REF InjSys_ratAirM08_AX /end AXIS_DESCR
/end CHARACTERISTIC
/begin CHARACTERISTIC InjSys_P2V2I1_HP.ratFuMBasLo_GM "class instance packet 2 variant 2 / relative fuel mass base injection 1 for interpolation" MAP 0x805689BA RB_MapGroup_U16 3071.953 rel_uw_b3072 0.00 3071.953 FORMAT "%8.3"
 /begin AXIS_DESCR COM_AXIS Epm_nEng EngN 10 0.00 16383.50 FORMAT "%8.2" EXTENDED_LIMITS -16384.00 16383.50 AXIS_PTS_REF InjSys_nEng10_AX /end AXIS_DESCR
 /begin AXIS_DESCR COM_AXIS InjSys_ratAirMAxisInp rel_uw_q0p0234 8 0.00 1535.977 FORMAT "%8.3" AXIS_PTS_REF InjSys_ratAirM08_AX /end AXIS_DESCR
/end CHARACTERISTIC
/begin CHARACTERISTIC InjSys_P2V2I1_HP.stAgFacTInj_C "class instance packet 2 variant 2 / switch to select oil temperature dependent map" VALUE 0x80568A5A RB_Val_Wu8 1.00000000000 B_TRUE 0.00 1.00000000000 FORMAT "%13.11" /end CHARACTERISTIC
/begin CHARACTERISTIC InjSys_P2V2I1_HP.stfacWghtSpltT_C "class instance packet 2 variant 2 / calibration to switch between weighting factor spllit factor temperatures dependent." VALUE 0x80568A5B RB_Val_Wu8 1.00000000000 B_TRUE 0.00 1.00000000000 FORMAT "%13.11" /end CHARACTERISTIC
/begin CHARACTERISTIC InjSys_P2V2I1_HP.tiBreakAux1_M "class instance packet 2 variant 2 / pause time auxiliary injection 1" MAP 0x80568A5C RB_Map_S16U16_S16 1310.720 t_q0p04_ms -1310.720 0.00 FORMAT "%8.3" EXTENDED_LIMITS -1310.720 1310.680
 /begin AXIS_DESCR STD_AXIS Epm_nEng EngN 8 -16384.00 16383.50 FORMAT "%8.2" DEPOSIT ABSOLUTE /end AXIS_DESCR
 /begin AXIS_DESCR STD_AXIS InjSys_ratAirMPredLocSp rel_uw_q0p0234 8 0.00 1535.977 FORMAT "%8.3" DEPOSIT ABSOLUTE /end AXIS_DESCR
/end CHARACTERISTIC
/begin CHARACTERISTIC InjSys_P2V2I1_HP.tiBreakPkt_M "class instance packet 2 variant 2 / break time for packet coupling" MAP 0x80568B00 RB_Map_S16U16_S16 1310.720 t_q0p04_ms -1310.720 0.00 FORMAT "%8.3" EXTENDED_LIMITS -1310.720 1310.680
 /begin AXIS_DESCR STD_AXIS Epm_nEng EngN 8 -16384.00 16383.50 FORMAT "%8.2" DEPOSIT ABSOLUTE /end AXIS_DESCR
 /begin AXIS_DESCR STD_AXIS InjSys_ratAirMPredLocSp rel_uw_q0p0234 8 0.00 1535.977 FORMAT "%8.3" DEPOSIT ABSOLUTE /end AXIS_DESCR
/end CHARACTERISTIC
/begin CHARACTERISTIC InjSys_P2V2I2_HP.agBasHiEthnl_GM "injection packet 2 in variant 2 / ." MAP 0x80561CF8 RB_MapGroup_S8 382.5 kw_q1p5 -192.0 190.5 FORMAT "%5.1"
 /begin AXIS_DESCR COM_AXIS Epm_nEng EngN 12 0.00 16383.50 FORMAT "%8.2" EXTENDED_LIMITS -16384.00 16383.50 AXIS_PTS_REF InjSys_nEng12Hsp_AX /end AXIS_DESCR
 /begin AXIS_DESCR COM_AXIS InjSys_ratAirMAgSpAxisInp rel_uw_q0p0234 12 0.00 1535.977 FORMAT "%8.3" AXIS_PTS_REF InjSys_ratAirM12AgSp_AX /end AXIS_DESCR
/end CHARACTERISTIC
/begin CHARACTERISTIC InjSys_P2V2I2_HP.agBasHiVers2Ethnl_GM "injection packet 2 in variant 2 / ." MAP 0x80561D88 RB_MapGroup_S8 382.5 kw_q1p5 -192.0 190.5 FORMAT "%5.1"
 /begin AXIS_DESCR COM_AXIS Epm_nEng EngN 12 0.00 16383.50 FORMAT "%8.2" EXTENDED_LIMITS -16384.00 16383.50 AXIS_PTS_REF InjSys_nEng12HspVers2_AX /end AXIS_DESCR
 /begin AXIS_DESCR COM_AXIS InjSys_ratAirMAgSpVers2AxisInp rel_uw_q0p0234 12 0.00 1535.977 FORMAT "%8.3" AXIS_PTS_REF InjSys_ratAirM12AgSpHspVers2_AX /end AXIS_DESCR
/end CHARACTERISTIC
/begin CHARACTERISTIC InjSys_P2V2I2_HP.agBasHiVers2_GM "injection packet 2 in variant 2 / base angle for interpolation (version 2)" MAP 0x80561E18 RB_MapGroup_S8 382.5 kw_q1p5 -192.0 190.5 FORMAT "%5.1"
 /begin AXIS_DESCR COM_AXIS Epm_nEng EngN 12 0.00 16383.50 FORMAT "%8.2" EXTENDED_LIMITS -16384.00 16383.50 AXIS_PTS_REF InjSys_nEng12HspVers2_AX /end AXIS_DESCR
 /begin AXIS_DESCR COM_AXIS InjSys_ratAirMAgSpVers2AxisInp rel_uw_q0p0234 12 0.00 1535.977 FORMAT "%8.3" AXIS_PTS_REF InjSys_ratAirM12AgSpHspVers2_AX /end AXIS_DESCR
/end CHARACTERISTIC
/begin CHARACTERISTIC InjSys_P2V2I2_HP.agBasHi_GM "injection packet 2 in variant 2 / base angle for interpolation" MAP 0x80561EA8 RB_MapGroup_S8 382.5 kw_q1p5 -192.0 190.5 FORMAT "%5.1"
 /begin AXIS_DESCR COM_AXIS Epm_nEng EngN 12 0.00 16383.50 FORMAT "%8.2" EXTENDED_LIMITS -16384.00 16383.50 AXIS_PTS_REF InjSys_nEng12Hsp_AX /end AXIS_DESCR
 /begin AXIS_DESCR COM_AXIS InjSys_ratAirMAgSpAxisInp rel_uw_q0p0234 12 0.00 1535.977 FORMAT "%8.3" AXIS_PTS_REF InjSys_ratAirM12AgSpHsp_AX /end AXIS_DESCR
/end CHARACTERISTIC
/begin CHARACTERISTIC InjSys_P2V2I2_HP.agBasLoEthnl_GM "injection packet 2 in variant 2 / ." MAP 0x80561F38 RB_MapGroup_S8 382.5 kw_q1p5 -192.0 190.5 FORMAT "%5.1"
 /begin AXIS_DESCR COM_AXIS Epm_nEng EngN 12 0.00 16383.50 FORMAT "%8.2" EXTENDED_LIMITS -16384.00 16383.50 AXIS_PTS_REF InjSys_nEng12Hsp_AX /end AXIS_DESCR
 /begin AXIS_DESCR COM_AXIS InjSys_ratAirMAgSpAxisInp rel_uw_q0p0234 12 0.00 1535.977 FORMAT "%8.3" AXIS_PTS_REF InjSys_ratAirM12AgSpHsp_AX /end AXIS_DESCR
/end CHARACTERISTIC
/begin CHARACTERISTIC InjSys_P2V2I2_HP.agBasLoVers2Ethnl_GM "injection packet 2 in variant 2 / ." MAP 0x80561FC8 RB_MapGroup_S8 382.5 kw_q1p5 -192.0 190.5 FORMAT "%5.1"
 /begin AXIS_DESCR COM_AXIS Epm_nEng EngN 12 0.00 16383.50 FORMAT "%8.2" EXTENDED_LIMITS -16384.00 16383.50 AXIS_PTS_REF InjSys_nEng12HspVers2_AX /end AXIS_DESCR
 /begin AXIS_DESCR COM_AXIS InjSys_ratAirMAgSpVers2AxisInp rel_uw_q0p0234 12 0.00 1535.977 FORMAT "%8.3" AXIS_PTS_REF InjSys_ratAirM12AgSpHspVers2_AX /end AXIS_DESCR
/end CHARACTERISTIC
/begin CHARACTERISTIC InjSys_P2V2I2_HP.agBasLoVers2_GM "injection packet 2 in variant 2 / base angle for interpolation (version 2)" MAP 0x80562058 RB_MapGroup_S8 382.5 kw_q1p5 -192.0 190.5 FORMAT "%5.1"
 /begin AXIS_DESCR COM_AXIS Epm_nEng EngN 12 0.00 16383.50 FORMAT "%8.2" EXTENDED_LIMITS -16384.00 16383.50 AXIS_PTS_REF InjSys_nEng12HspVers2_AX /end AXIS_DESCR
 /begin AXIS_DESCR COM_AXIS InjSys_ratAirMAgSpVers2AxisInp rel_uw_q0p0234 12 0.00 1535.977 FORMAT "%8.3" AXIS_PTS_REF InjSys_ratAirM12AgSpHspVers2_AX /end AXIS_DESCR
/end CHARACTERISTIC
/begin CHARACTERISTIC InjSys_P2V2I2_HP.agBasLo_GM "injection packet 2 in variant 2 / base angle for interpolation" MAP 0x805620E8 RB_MapGroup_S8 382.5 kw_q1p5 -192.0 190.5 FORMAT "%5.1"
 /begin AXIS_DESCR COM_AXIS Epm_nEng EngN 12 0.00 16383.50 FORMAT "%8.2" EXTENDED_LIMITS -16384.00 16383.50 AXIS_PTS_REF InjSys_nEng12Hsp_AX /end AXIS_DESCR
 /begin AXIS_DESCR COM_AXIS InjSys_ratAirMAgSpAxisInp rel_uw_q0p0234 12 0.00 1535.977 FORMAT "%8.3" AXIS_PTS_REF InjSys_ratAirM12AgSpHsp_AX /end AXIS_DESCR
/end CHARACTERISTIC
/begin CHARACTERISTIC InjSys_P2V2I2_HP.agBasTPistColdVers2_GM "injection packet 2 in variant 2 / base angle for interpolation cold TSA mode" MAP 0x80562178 RB_MapGroup_U8 382.5 kw_q1p5 0.00 382.5 FORMAT "%5.1"
 /begin AXIS_DESCR COM_AXIS Epm_nEng EngN 12 0.00 16383.50 FORMAT "%8.2" EXTENDED_LIMITS -16384.00 16383.50 AXIS_PTS_REF InjSys_nEng12HspVers2_AX /end AXIS_DESCR
 /begin AXIS_DESCR COM_AXIS InjSys_ratAirMAgSpVers2AxisInp rel_uw_q0p0234 12 0.00 1535.977 FORMAT "%8.3" AXIS_PTS_REF InjSys_ratAirM12AgSpHspVers2_AX /end AXIS_DESCR
/end CHARACTERISTIC
/begin CHARACTERISTIC InjSys_P2V2I2_HP.agBasTPistCold_GM "injection packet 2 in variant 2 / base angle for interpolation cold TSA mode" MAP 0x80562208 RB_MapGroup_U8 382.5 kw_q1p5 0.00 382.5 FORMAT "%5.1"
 /begin AXIS_DESCR COM_AXIS Epm_nEng EngN 12 0.00 16383.50 FORMAT "%8.2" EXTENDED_LIMITS -16384.00 16383.50 AXIS_PTS_REF InjSys_nEng12Hsp_AX /end AXIS_DESCR
 /begin AXIS_DESCR COM_AXIS InjSys_ratAirMAgSpAxisInp rel_uw_q0p0234 12 0.00 1535.977 FORMAT "%8.3" AXIS_PTS_REF InjSys_ratAirM12AgSpHsp_AX /end AXIS_DESCR
/end CHARACTERISTIC
/begin CHARACTERISTIC InjSys_P2V2I2_HP.agBasTPistWrmVers2_GM "injection packet 2 in variant 2 / base angle for interpolation Warm TSA mode (Version 2)" MAP 0x80562298 RB_MapGroup_U8 382.5 kw_q1p5 0.00 382.5 FORMAT "%5.1"
 /begin AXIS_DESCR COM_AXIS Epm_nEng EngN 12 0.00 16383.50 FORMAT "%8.2" EXTENDED_LIMITS -16384.00 16383.50 AXIS_PTS_REF InjSys_nEng12HspVers2_AX /end AXIS_DESCR
 /begin AXIS_DESCR COM_AXIS InjSys_ratAirMAgSpVers2AxisInp rel_uw_q0p0234 12 0.00 1535.977 FORMAT "%8.3" AXIS_PTS_REF InjSys_ratAirM12AgSpHspVers2_AX /end AXIS_DESCR
/end CHARACTERISTIC
/begin CHARACTERISTIC InjSys_P2V2I2_HP.agBasTPistWrm_GM "injection packet 2 in variant 2 / base angle for interpolation Warm TSA mode" MAP 0x80562328 RB_MapGroup_U8 382.5 kw_q1p5 0.00 382.5 FORMAT "%5.1"
 /begin AXIS_DESCR COM_AXIS Epm_nEng EngN 12 0.00 16383.50 FORMAT "%8.2" EXTENDED_LIMITS -16384.00 16383.50 AXIS_PTS_REF InjSys_nEng12Hsp_AX /end AXIS_DESCR
 /begin AXIS_DESCR COM_AXIS InjSys_ratAirMAgSpAxisInp rel_uw_q0p0234 12 0.00 1535.977 FORMAT "%8.3" AXIS_PTS_REF InjSys_ratAirM12AgSpHsp_AX /end AXIS_DESCR
/end CHARACTERISTIC
/begin CHARACTERISTIC InjSys_P2V2I2_HP.facEthnlAgBas_T "injection packet 2 in variant 2 / ." CURVE 0x805623B8 RB_Curve_U8_U8 0.9961 fak_ub_b1 0.00 0.9961
 /begin AXIS_DESCR STD_AXIS fethstoeLocSp fak_ub_b2 4 0.00 1.992188 FORMAT "%8.6" DEPOSIT ABSOLUTE /end AXIS_DESCR
/end CHARACTERISTIC
/begin CHARACTERISTIC InjSys_P2V2I2_HP.facSpltAux1CorrnLoT_GM "injection packet 2 in variant 2 / split factor correction auxiliary injection 1 dependent of temperature and number of injections" MAP 0x805623C1 RB_MapGroup_U8 1.992188 fak_ub_b2 0.00 1.992188 FORMAT "%8.6"
 /begin AXIS_DESCR COM_AXIS InjSys_tEng Temp_Cels 8 -3549.940 3003.560 FORMAT "%8.3" AXIS_PTS_REF InjSys_tEng08_AX /end AXIS_DESCR
 /begin AXIS_DESCR COM_AXIS InjSys_nrInjLimdLoc dez 8 0.00 65535.00 FORMAT "%8.2" AXIS_PTS_REF InjSys_nrInj08_AX /end AXIS_DESCR
/end CHARACTERISTIC
/begin CHARACTERISTIC InjSys_P2V2I2_HP.facSpltAux1HiExtd_GM "injection packet 2 in variant 2 / split factor auxiliary injection 1 for interpolation" MAP 0x80562401 RB_MapGroup_U8 0.9961 fak_ub_b1 0.00 0.9961
 /begin AXIS_DESCR COM_AXIS Epm_nEng EngN 12 0.00 16383.50 FORMAT "%8.2" EXTENDED_LIMITS -16384.00 16383.50 AXIS_PTS_REF InjSys_nEng12Vers2_AX /end AXIS_DESCR
 /begin AXIS_DESCR COM_AXIS InjSys_ratAirMVers2AxisInp rel_uw_q0p0234 12 0.00 1535.977 FORMAT "%8.3" AXIS_PTS_REF InjSys_ratAirM12Vers2_AX /end AXIS_DESCR
/end CHARACTERISTIC
/begin CHARACTERISTIC InjSys_P2V2I2_HP.facSpltAux1Hi_GM "injection packet 2 in variant 2 / split factor auxiliary injection 1 for interpolation" MAP 0x80562491 RB_MapGroup_U8 0.9961 fak_ub_b1 0.00 0.9961
 /begin AXIS_DESCR COM_AXIS Epm_nEng EngN 10 0.00 16383.50 FORMAT "%8.2" EXTENDED_LIMITS -16384.00 16383.50 AXIS_PTS_REF InjSys_nEng10_AX /end AXIS_DESCR
 /begin AXIS_DESCR COM_AXIS InjSys_ratAirMAxisInp rel_uw_q0p0234 8 0.00 1535.977 FORMAT "%8.3" AXIS_PTS_REF InjSys_ratAirM08_AX /end AXIS_DESCR
/end CHARACTERISTIC
/begin CHARACTERISTIC InjSys_P2V2I2_HP.facSpltAux1LoExtd_GM "injection packet 2 in variant 2 / split factor auxiliary injection 1 for interpolation" MAP 0x805624E1 RB_MapGroup_U8 0.9961 fak_ub_b1 0.00 0.9961
 /begin AXIS_DESCR COM_AXIS Epm_nEng EngN 12 0.00 16383.50 FORMAT "%8.2" EXTENDED_LIMITS -16384.00 16383.50 AXIS_PTS_REF InjSys_nEng12Vers2_AX /end AXIS_DESCR
 /begin AXIS_DESCR COM_AXIS InjSys_ratAirMVers2AxisInp rel_uw_q0p0234 12 0.00 1535.977 FORMAT "%8.3" AXIS_PTS_REF InjSys_ratAirM12Vers2_AX /end AXIS_DESCR
/end CHARACTERISTIC
/begin CHARACTERISTIC InjSys_P2V2I2_HP.facSpltAux1Lo_GM "injection packet 2 in variant 2 / split factor auxiliary injection 1 for interpolation" MAP 0x80562571 RB_MapGroup_U8 0.9961 fak_ub_b1 0.00 0.9961
 /begin AXIS_DESCR COM_AXIS Epm_nEng EngN 10 0.00 16383.50 FORMAT "%8.2" EXTENDED_LIMITS -16384.00 16383.50 AXIS_PTS_REF InjSys_nEng10_AX /end AXIS_DESCR
 /begin AXIS_DESCR COM_AXIS InjSys_ratAirMAxisInp rel_uw_q0p0234 8 0.00 1535.977 FORMAT "%8.3" AXIS_PTS_REF InjSys_ratAirM08_AX /end AXIS_DESCR
/end CHARACTERISTIC
/begin CHARACTERISTIC InjSys_P2V2I2_HP.facSpltCorrnLoT_GM "injection packet 2 in variant 2 / split factor correction dependent of temperature and number of injections" MAP 0x805625C1 RB_MapGroup_U8 1.992188 fak_ub_b2 0.00 1.992188 FORMAT "%8.6"
 /begin AXIS_DESCR COM_AXIS InjSys_tEng Temp_Cels 8 -3549.940 3003.560 FORMAT "%8.3" AXIS_PTS_REF InjSys_tEng08_AX /end AXIS_DESCR
 /begin AXIS_DESCR COM_AXIS InjSys_nrInjLimdLoc dez 8 0.00 65535.00 FORMAT "%8.2" AXIS_PTS_REF InjSys_nrInj08_AX /end AXIS_DESCR
/end CHARACTERISTIC
/begin CHARACTERISTIC InjSys_P2V2I2_HP.facSpltPktHiExtd_GM "injection packet 2 in variant 2 / split factor packet for interpolation" MAP 0x80562601 RB_MapGroup_U8 0.9961 fak_ub_b1 0.00 0.9961
 /begin AXIS_DESCR COM_AXIS Epm_nEng EngN 12 0.00 16383.50 FORMAT "%8.2" EXTENDED_LIMITS -16384.00 16383.50 AXIS_PTS_REF InjSys_nEng12Vers2_AX /end AXIS_DESCR
 /begin AXIS_DESCR COM_AXIS InjSys_ratAirMVers2AxisInp rel_uw_q0p0234 12 0.00 1535.977 FORMAT "%8.3" AXIS_PTS_REF InjSys_ratAirM12Vers2_AX /end AXIS_DESCR
/end CHARACTERISTIC
/begin CHARACTERISTIC InjSys_P2V2I2_HP.facSpltPktHi_GM "injection packet 2 in variant 2 / split factor packet for interpolation" MAP 0x80562691 RB_MapGroup_U8 0.9961 fak_ub_b1 0.00 0.9961
 /begin AXIS_DESCR COM_AXIS Epm_nEng EngN 10 0.00 16383.50 FORMAT "%8.2" EXTENDED_LIMITS -16384.00 16383.50 AXIS_PTS_REF InjSys_nEng10_AX /end AXIS_DESCR
 /begin AXIS_DESCR COM_AXIS InjSys_ratAirMAxisInp rel_uw_q0p0234 8 0.00 1535.977 FORMAT "%8.3" AXIS_PTS_REF InjSys_ratAirM08_AX /end AXIS_DESCR
/end CHARACTERISTIC
/begin CHARACTERISTIC InjSys_P2V2I2_HP.facSpltPktLoExtd_GM "injection packet 2 in variant 2 / split factor packet for interpolation" MAP 0x805626E1 RB_MapGroup_U8 0.9961 fak_ub_b1 0.00 0.9961
 /begin AXIS_DESCR COM_AXIS Epm_nEng EngN 12 0.00 16383.50 FORMAT "%8.2" EXTENDED_LIMITS -16384.00 16383.50 AXIS_PTS_REF InjSys_nEng12Vers2_AX /end AXIS_DESCR
 /begin AXIS_DESCR COM_AXIS InjSys_ratAirMVers2AxisInp rel_uw_q0p0234 12 0.00 1535.977 FORMAT "%8.3" AXIS_PTS_REF InjSys_ratAirM12Vers2_AX /end AXIS_DESCR
/end CHARACTERISTIC
/begin CHARACTERISTIC InjSys_P2V2I2_HP.facSpltPktLo_GM "injection packet 2 in variant 2 / split factor packet for interpolation" MAP 0x80562771 RB_MapGroup_U8 0.9961 fak_ub_b1 0.00 0.9961
 /begin AXIS_DESCR COM_AXIS Epm_nEng EngN 10 0.00 16383.50 FORMAT "%8.2" EXTENDED_LIMITS -16384.00 16383.50 AXIS_PTS_REF InjSys_nEng10_AX /end AXIS_DESCR
 /begin AXIS_DESCR COM_AXIS InjSys_ratAirMAxisInp rel_uw_q0p0234 8 0.00 1535.977 FORMAT "%8.3" AXIS_PTS_REF InjSys_ratAirM08_AX /end AXIS_DESCR
/end CHARACTERISTIC
/begin CHARACTERISTIC InjSys_P2V2I2_HP.facTInjAgEthnl_M "injection packet 2 in variant 2 / ." MAP 0x805627C2 RB_Map_S16S16_U8 0.9961 fak_ub_b1 0.00 0.9961
 /begin AXIS_DESCR STD_AXIS InjSys_tEng Temp_Cels 8 -3549.940 3003.560 FORMAT "%8.3" DEPOSIT ABSOLUTE /end AXIS_DESCR
 /begin AXIS_DESCR STD_AXIS InjSys_tOilLocSp Temp_Cels 8 -3549.940 3003.560 FORMAT "%8.3" DEPOSIT ABSOLUTE /end AXIS_DESCR
/end CHARACTERISTIC
/begin CHARACTERISTIC InjSys_P2V2I2_HP.facTInjAg_M "injection packet 2 in variant 2 / ." MAP 0x80562826 RB_Map_S16S16_U8 0.9961 fak_ub_b1 0.00 0.9961
 /begin AXIS_DESCR STD_AXIS InjSys_tEng Temp_Cels 8 -3549.940 3003.560 FORMAT "%8.3" DEPOSIT ABSOLUTE /end AXIS_DESCR
 /begin AXIS_DESCR STD_AXIS InjSys_tOilLocSp Temp_Cels 8 -3549.940 3003.560 FORMAT "%8.3" DEPOSIT ABSOLUTE /end AXIS_DESCR
/end CHARACTERISTIC
/begin CHARACTERISTIC InjSys_P2V2I2_HP.facTPistCold_M "injection packet 2 in variant 2 / Engine temperature and oil temperature based map for injection angle correction" MAP 0x8056288A RB_Map_S16S16_U8 0.9961 fak_ub_b1 0.00 0.9961
 /begin AXIS_DESCR STD_AXIS InjSys_tEng Temp_Cels 8 -3549.940 3003.560 FORMAT "%8.3" DEPOSIT ABSOLUTE /end AXIS_DESCR
 /begin AXIS_DESCR STD_AXIS InjSys_tOilLocSp Temp_Cels 8 -3549.940 3003.560 FORMAT "%8.3" DEPOSIT ABSOLUTE /end AXIS_DESCR
/end CHARACTERISTIC
/begin CHARACTERISTIC InjSys_P2V2I2_HP.facTPist_M "injection packet 2 in variant 2 / piston temperature based map for injection angle correction" MAP 0x805628EE RB_Map_S16S16_U8 0.9961 fak_ub_b1 0.00 0.9961
 /begin AXIS_DESCR STD_AXIS InjSys_tPistBas Temp_Cels 6 -3549.940 3003.560 FORMAT "%8.3" DEPOSIT ABSOLUTE /end AXIS_DESCR
 /begin AXIS_DESCR STD_AXIS InjSys_tPistDelta temp_q0p1 6 -3276.800 3276.700 FORMAT "%8.3" DEPOSIT ABSOLUTE /end AXIS_DESCR
/end CHARACTERISTIC
/begin CHARACTERISTIC InjSys_P2V2I2_HP.facWghtAgBasTEthnl_M "injection packet 2 in variant 2 / ." MAP 0x8056292E RB_Map_S16S16_U8 0.9961 fak_ub_b1 0.00 0.9961
 /begin AXIS_DESCR STD_AXIS InjSys_tEng Temp_Cels 6 -3549.940 3003.560 FORMAT "%8.3" DEPOSIT ABSOLUTE /end AXIS_DESCR
 /begin AXIS_DESCR STD_AXIS InjSys_tEngStrt Temp_Cels 4 -3549.940 3003.560 FORMAT "%8.3" DEPOSIT ABSOLUTE /end AXIS_DESCR
/end CHARACTERISTIC
/begin CHARACTERISTIC InjSys_P2V2I2_HP.facWghtAgBasT_M "injection packet 2 in variant 2 / weighting factor base angle temperature dependent" MAP 0x8056295E RB_Map_S16S16_U8 0.9961 fak_ub_b1 0.00 0.9961
 /begin AXIS_DESCR STD_AXIS InjSys_tEng Temp_Cels 6 -3549.940 3003.560 FORMAT "%8.3" DEPOSIT ABSOLUTE /end AXIS_DESCR
 /begin AXIS_DESCR STD_AXIS InjSys_tEngStrt Temp_Cels 4 -3549.940 3003.560 FORMAT "%8.3" DEPOSIT ABSOLUTE /end AXIS_DESCR
/end CHARACTERISTIC
/begin CHARACTERISTIC InjSys_P2V2I2_HP.facWghtSpltOilT_GM "injection packet 2 in variant 2 / weighting factor split factor oil temperature dependent" MAP 0x8056298E RB_MapGroup_U8 0.9961 fak_ub_b1 0.00 0.9961
 /begin AXIS_DESCR COM_AXIS InjSys_tOilSp Temp_Cels 8 -3549.940 3003.560 FORMAT "%8.3" AXIS_PTS_REF InjSys_tosp08_AX /end AXIS_DESCR
 /begin AXIS_DESCR COM_AXIS InjSys_tEng Temp_Cels 8 -3549.940 3003.560 FORMAT "%8.3" AXIS_PTS_REF InjSys_tEng08_AX /end AXIS_DESCR
/end CHARACTERISTIC
/begin CHARACTERISTIC InjSys_P2V2I2_HP.facWghtSpltT_GM "injection packet 2 in variant 2 / weighting factor split factor temperature dependent" MAP 0x805629CE RB_MapGroup_U8 0.9961 fak_ub_b1 0.00 0.9961
 /begin AXIS_DESCR COM_AXIS InjSys_tEngStrt Temp_Cels 8 -3549.940 3003.560 FORMAT "%8.3" AXIS_PTS_REF InjSys_tEngStrt08_AX /end AXIS_DESCR
 /begin AXIS_DESCR COM_AXIS InjSys_tEng Temp_Cels 8 -3549.940 3003.560 FORMAT "%8.3" AXIS_PTS_REF InjSys_tEng08_AX /end AXIS_DESCR
/end CHARACTERISTIC
/begin CHARACTERISTIC InjSys_P2V2I2_HP.flgAbsltSplt_C "injection packet 2 in variant 2 / condition split with absolute fuel mass" VALUE 0x80562A0E RB_Val_Wu8 1.00000000000 B_TRUE 0.00 1.00000000000 FORMAT "%13.11" /end CHARACTERISTIC
/begin CHARACTERISTIC InjSys_P2V2I2_HP.flgAgEnd_C "injection packet 2 in variant 2 / condition end angle" VALUE 0x80562A0F RB_Val_Wu8 1.00000000000 B_TRUE 0.00 1.00000000000 FORMAT "%13.11" /end CHARACTERISTIC
/begin CHARACTERISTIC InjSys_P2V2I2_HP.flgAxVers_C "injection packet 2 in variant 2 / condition map selection with group axis in version 2" VALUE 0x80562A10 RB_Val_Wu8 1.00000000000 B_TRUE 0.00 1.00000000000 FORMAT "%13.11" /end CHARACTERISTIC
/begin CHARACTERISTIC InjSys_P2V2I2_HP.flgPktCoupl_C "injection packet 2 in variant 2 / condition packet coupling with break time" VALUE 0x80562A11 RB_Val_Wu8 1.00000000000 B_TRUE 0.00 1.00000000000 FORMAT "%13.11" /end CHARACTERISTIC
/begin CHARACTERISTIC InjSys_P2V2I2_HP.ratFuMAux1Hi_GM "injection packet 2 in variant 2 / relative fuel mass auxiliary injection 1 for interpolation" MAP 0x80562A12 RB_MapGroup_U16 3071.953 rel_uw_b3072 0.00 3071.953 FORMAT "%8.3"
 /begin AXIS_DESCR COM_AXIS Epm_nEng EngN 10 0.00 16383.50 FORMAT "%8.2" EXTENDED_LIMITS -16384.00 16383.50 AXIS_PTS_REF InjSys_nEng10_AX /end AXIS_DESCR
 /begin AXIS_DESCR COM_AXIS InjSys_ratAirMAxisInp rel_uw_q0p0234 8 0.00 1535.977 FORMAT "%8.3" AXIS_PTS_REF InjSys_ratAirM08_AX /end AXIS_DESCR
/end CHARACTERISTIC
/begin CHARACTERISTIC InjSys_P2V2I2_HP.ratFuMAux1Lo_GM "injection packet 2 in variant 2 / relative fuel mass auxiliary injection 1 for interpolation" MAP 0x80562AB2 RB_MapGroup_U16 3071.953 rel_uw_b3072 0.00 3071.953 FORMAT "%8.3"
 /begin AXIS_DESCR COM_AXIS Epm_nEng EngN 10 0.00 16383.50 FORMAT "%8.2" EXTENDED_LIMITS -16384.00 16383.50 AXIS_PTS_REF InjSys_nEng10_AX /end AXIS_DESCR
 /begin AXIS_DESCR COM_AXIS InjSys_ratAirMAxisInp rel_uw_q0p0234 8 0.00 1535.977 FORMAT "%8.3" AXIS_PTS_REF InjSys_ratAirM08_AX /end AXIS_DESCR
/end CHARACTERISTIC
/begin CHARACTERISTIC InjSys_P2V2I2_HP.ratFuMBasHi_GM "injection packet 2 in variant 2 / relative fuel mass base injection 1 for interpolation" MAP 0x80562B52 RB_MapGroup_U16 3071.953 rel_uw_b3072 0.00 3071.953 FORMAT "%8.3"
 /begin AXIS_DESCR COM_AXIS Epm_nEng EngN 10 0.00 16383.50 FORMAT "%8.2" EXTENDED_LIMITS -16384.00 16383.50 AXIS_PTS_REF InjSys_nEng10_AX /end AXIS_DESCR
 /begin AXIS_DESCR COM_AXIS InjSys_ratAirMAxisInp rel_uw_q0p0234 8 0.00 1535.977 FORMAT "%8.3" AXIS_PTS_REF InjSys_ratAirM08_AX /end AXIS_DESCR
/end CHARACTERISTIC
/begin CHARACTERISTIC InjSys_P2V2I2_HP.ratFuMBasLo_GM "injection packet 2 in variant 2 / relative fuel mass base injection 1 for interpolation" MAP 0x80562BF2 RB_MapGroup_U16 3071.953 rel_uw_b3072 0.00 3071.953 FORMAT "%8.3"
 /begin AXIS_DESCR COM_AXIS Epm_nEng EngN 10 0.00 16383.50 FORMAT "%8.2" EXTENDED_LIMITS -16384.00 16383.50 AXIS_PTS_REF InjSys_nEng10_AX /end AXIS_DESCR
 /begin AXIS_DESCR COM_AXIS InjSys_ratAirMAxisInp rel_uw_q0p0234 8 0.00 1535.977 FORMAT "%8.3" AXIS_PTS_REF InjSys_ratAirM08_AX /end AXIS_DESCR
/end CHARACTERISTIC
/begin CHARACTERISTIC InjSys_P2V2I2_HP.stAgFacTInj_C "injection packet 2 in variant 2 / switch to select oil temperature dependent map" VALUE 0x80562C92 RB_Val_Wu8 1.00000000000 B_TRUE 0.00 1.00000000000 FORMAT "%13.11" /end CHARACTERISTIC
/begin CHARACTERISTIC InjSys_P2V2I2_HP.stfacWghtSpltT_C "injection packet 2 in variant 2 / calibration to switch between weighting factor spllit factor temperatures dependent." VALUE 0x80562C93 RB_Val_Wu8 1.00000000000 B_TRUE 0.00 1.00000000000 FORMAT "%13.11" /end CHARACTERISTIC
/begin CHARACTERISTIC InjSys_P2V2I2_HP.tiBreakAux1_M "injection packet 2 in variant 2 / pause time auxiliary injection 1" MAP 0x80562C94 RB_Map_S16U16_S16 1310.720 t_q0p04_ms -1310.720 0.00 FORMAT "%8.3" EXTENDED_LIMITS -1310.720 1310.680
 /begin AXIS_DESCR STD_AXIS Epm_nEng EngN 8 -16384.00 16383.50 FORMAT "%8.2" DEPOSIT ABSOLUTE /end AXIS_DESCR
 /begin AXIS_DESCR STD_AXIS InjSys_ratAirMPredLocSp rel_uw_q0p0234 8 0.00 1535.977 FORMAT "%8.3" DEPOSIT ABSOLUTE /end AXIS_DESCR
/end CHARACTERISTIC
/begin CHARACTERISTIC InjSys_P2V2I2_HP.tiBreakPkt_M "injection packet 2 in variant 2 / break time for packet coupling" MAP 0x80562D38 RB_Map_S16U16_S16 1310.720 t_q0p04_ms -1310.720 0.00 FORMAT "%8.3" EXTENDED_LIMITS -1310.720 1310.680
 /begin AXIS_DESCR STD_AXIS Epm_nEng EngN 8 -16384.00 16383.50 FORMAT "%8.2" DEPOSIT ABSOLUTE /end AXIS_DESCR
 /begin AXIS_DESCR STD_AXIS InjSys_ratAirMPredLocSp rel_uw_q0p0234 8 0.00 1535.977 FORMAT "%8.3" DEPOSIT ABSOLUTE /end AXIS_DESCR
/end CHARACTERISTIC
/begin CHARACTERISTIC InjSys_P2V3I1_HP.agAux1HiVers2_GM "class instance packet 2 variant 3 / angle auxiliary injection 1 for interpolation (version 2)" MAP 0x80568BA8 RB_MapGroup_U8 382.5 kw_q1p5 0.00 382.5 FORMAT "%5.1"
 /begin AXIS_DESCR COM_AXIS Epm_nEng EngN 12 0.00 16383.50 FORMAT "%8.2" EXTENDED_LIMITS -16384.00 16383.50 AXIS_PTS_REF InjSys_nEng12HspVers2_AX /end AXIS_DESCR
 /begin AXIS_DESCR COM_AXIS InjSys_ratAirMAgSpVers2AxisInp rel_uw_q0p0234 12 0.00 1535.977 FORMAT "%8.3" AXIS_PTS_REF InjSys_ratAirM12AgSpHspVers2_AX /end AXIS_DESCR
/end CHARACTERISTIC
/begin CHARACTERISTIC InjSys_P2V3I1_HP.agAux1Hi_GM "class instance packet 2 variant 3 / angle auxiliary injection 1 for interpolation" MAP 0x80568C38 RB_MapGroup_U8 382.5 kw_q1p5 0.00 382.5 FORMAT "%5.1"
 /begin AXIS_DESCR COM_AXIS Epm_nEng EngN 12 0.00 16383.50 FORMAT "%8.2" EXTENDED_LIMITS -16384.00 16383.50 AXIS_PTS_REF InjSys_nEng12Hsp_AX /end AXIS_DESCR
 /begin AXIS_DESCR COM_AXIS InjSys_ratAirMAgSpAxisInp rel_uw_q0p0234 12 0.00 1535.977 FORMAT "%8.3" AXIS_PTS_REF InjSys_ratAirM12AgSpHsp_AX /end AXIS_DESCR
/end CHARACTERISTIC
/begin CHARACTERISTIC InjSys_P2V3I1_HP.agAux1LoVers2_GM "class instance packet 2 variant 3 / angle auxiliary injection 1 for interpolation (version 2)" MAP 0x80568CC8 RB_MapGroup_U8 382.5 kw_q1p5 0.00 382.5 FORMAT "%5.1"
 /begin AXIS_DESCR COM_AXIS Epm_nEng EngN 12 0.00 16383.50 FORMAT "%8.2" EXTENDED_LIMITS -16384.00 16383.50 AXIS_PTS_REF InjSys_nEng12HspVers2_AX /end AXIS_DESCR
 /begin AXIS_DESCR COM_AXIS InjSys_ratAirMAgSpVers2AxisInp rel_uw_q0p0234 12 0.00 1535.977 FORMAT "%8.3" AXIS_PTS_REF InjSys_ratAirM12AgSpHspVers2_AX /end AXIS_DESCR
/end CHARACTERISTIC
/begin CHARACTERISTIC InjSys_P2V3I1_HP.agAux1Lo_GM "class instance packet 2 variant 3 / angle auxiliary injection 1 for interpolation" MAP 0x80568D58 RB_MapGroup_U8 382.5 kw_q1p5 0.00 382.5 FORMAT "%5.1"
 /begin AXIS_DESCR COM_AXIS Epm_nEng EngN 12 0.00 16383.50 FORMAT "%8.2" EXTENDED_LIMITS -16384.00 16383.50 AXIS_PTS_REF InjSys_nEng12Hsp_AX /end AXIS_DESCR
 /begin AXIS_DESCR COM_AXIS InjSys_ratAirMAgSpAxisInp rel_uw_q0p0234 12 0.00 1535.977 FORMAT "%8.3" AXIS_PTS_REF InjSys_ratAirM12AgSpHsp_AX /end AXIS_DESCR
/end CHARACTERISTIC
/begin CHARACTERISTIC InjSys_P2V3I1_HP.agAux1TPistColdVers2_GM "class instance packet 2 variant 3 / auxilary angle for interpolation cold TSA mode" MAP 0x80568DE8 RB_MapGroup_U8 382.5 kw_q1p5 0.00 382.5 FORMAT "%5.1"
 /begin AXIS_DESCR COM_AXIS Epm_nEng EngN 12 0.00 16383.50 FORMAT "%8.2" EXTENDED_LIMITS -16384.00 16383.50 AXIS_PTS_REF InjSys_nEng12HspVers2_AX /end AXIS_DESCR
 /begin AXIS_DESCR COM_AXIS InjSys_ratAirMAgSpVers2AxisInp rel_uw_q0p0234 12 0.00 1535.977 FORMAT "%8.3" AXIS_PTS_REF InjSys_ratAirM12AgSpHspVers2_AX /end AXIS_DESCR
/end CHARACTERISTIC
/begin CHARACTERISTIC InjSys_P2V3I1_HP.agAux1TPistCold_GM "class instance packet 2 variant 3 / auxilary angle for interpolation cold TSA mode" MAP 0x80568E78 RB_MapGroup_U8 382.5 kw_q1p5 0.00 382.5 FORMAT "%5.1"
 /begin AXIS_DESCR COM_AXIS Epm_nEng EngN 12 0.00 16383.50 FORMAT "%8.2" EXTENDED_LIMITS -16384.00 16383.50 AXIS_PTS_REF InjSys_nEng12Hsp_AX /end AXIS_DESCR
 /begin AXIS_DESCR COM_AXIS InjSys_ratAirMAgSpAxisInp rel_uw_q0p0234 12 0.00 1535.977 FORMAT "%8.3" AXIS_PTS_REF InjSys_ratAirM12AgSpHsp_AX /end AXIS_DESCR
/end CHARACTERISTIC
/begin CHARACTERISTIC InjSys_P2V3I1_HP.agAux1TPistWrmVers2_GM "class instance packet 2 variant 3 / auxilary angle for interpolation Warm TSA mode" MAP 0x80568F08 RB_MapGroup_U8 382.5 kw_q1p5 0.00 382.5 FORMAT "%5.1"
 /begin AXIS_DESCR COM_AXIS Epm_nEng EngN 12 0.00 16383.50 FORMAT "%8.2" EXTENDED_LIMITS -16384.00 16383.50 AXIS_PTS_REF InjSys_nEng12HspVers2_AX /end AXIS_DESCR
 /begin AXIS_DESCR COM_AXIS InjSys_ratAirMAgSpVers2AxisInp rel_uw_q0p0234 12 0.00 1535.977 FORMAT "%8.3" AXIS_PTS_REF InjSys_ratAirM12AgSpHspVers2_AX /end AXIS_DESCR
/end CHARACTERISTIC
/begin CHARACTERISTIC InjSys_P2V3I1_HP.agAux1TPistWrm_GM "class instance packet 2 variant 3 / auxilary angle for interpolation Warm TSA mode" MAP 0x80568F98 RB_MapGroup_U8 382.5 kw_q1p5 0.00 382.5 FORMAT "%5.1"
 /begin AXIS_DESCR COM_AXIS Epm_nEng EngN 12 0.00 16383.50 FORMAT "%8.2" EXTENDED_LIMITS -16384.00 16383.50 AXIS_PTS_REF InjSys_nEng12Hsp_AX /end AXIS_DESCR
 /begin AXIS_DESCR COM_AXIS InjSys_ratAirMAgSpAxisInp rel_uw_q0p0234 12 0.00 1535.977 FORMAT "%8.3" AXIS_PTS_REF InjSys_ratAirM12AgSpHsp_AX /end AXIS_DESCR
/end CHARACTERISTIC
/begin CHARACTERISTIC InjSys_P2V3I1_HP.agBasHiVers2_GM "class instance packet 2 variant 3 / base angle for interpolation (version 2)" MAP 0x80569028 RB_MapGroup_U8 382.5 kw_q1p5 0.00 382.5 FORMAT "%5.1"
 /begin AXIS_DESCR COM_AXIS Epm_nEng EngN 12 0.00 16383.50 FORMAT "%8.2" EXTENDED_LIMITS -16384.00 16383.50 AXIS_PTS_REF InjSys_nEng12HspVers2_AX /end AXIS_DESCR
 /begin AXIS_DESCR COM_AXIS InjSys_ratAirMAgSpVers2AxisInp rel_uw_q0p0234 12 0.00 1535.977 FORMAT "%8.3" AXIS_PTS_REF InjSys_ratAirM12AgSpHspVers2_AX /end AXIS_DESCR
/end CHARACTERISTIC
/begin CHARACTERISTIC InjSys_P2V3I1_HP.agBasHi_GM "class instance packet 2 variant 3 / base angle for interpolation" MAP 0x805690B8 RB_MapGroup_U8 382.5 kw_q1p5 0.00 382.5 FORMAT "%5.1"
 /begin AXIS_DESCR COM_AXIS Epm_nEng EngN 12 0.00 16383.50 FORMAT "%8.2" EXTENDED_LIMITS -16384.00 16383.50 AXIS_PTS_REF InjSys_nEng12Hsp_AX /end AXIS_DESCR
 /begin AXIS_DESCR COM_AXIS InjSys_ratAirMAgSpAxisInp rel_uw_q0p0234 12 0.00 1535.977 FORMAT "%8.3" AXIS_PTS_REF InjSys_ratAirM12AgSpHsp_AX /end AXIS_DESCR
/end CHARACTERISTIC
/begin CHARACTERISTIC InjSys_P2V3I1_HP.agBasLoVers2_GM "class instance packet 2 variant 3 / base angle for interpolation (version 2)" MAP 0x80569148 RB_MapGroup_U8 382.5 kw_q1p5 0.00 382.5 FORMAT "%5.1"
 /begin AXIS_DESCR COM_AXIS Epm_nEng EngN 12 0.00 16383.50 FORMAT "%8.2" EXTENDED_LIMITS -16384.00 16383.50 AXIS_PTS_REF InjSys_nEng12HspVers2_AX /end AXIS_DESCR
 /begin AXIS_DESCR COM_AXIS InjSys_ratAirMAgSpVers2AxisInp rel_uw_q0p0234 12 0.00 1535.977 FORMAT "%8.3" AXIS_PTS_REF InjSys_ratAirM12AgSpHspVers2_AX /end AXIS_DESCR
/end CHARACTERISTIC
/begin CHARACTERISTIC InjSys_P2V3I1_HP.agBasLo_GM "class instance packet 2 variant 3 / base angle for interpolation" MAP 0x805691D8 RB_MapGroup_U8 382.5 kw_q1p5 0.00 382.5 FORMAT "%5.1"
 /begin AXIS_DESCR COM_AXIS Epm_nEng EngN 12 0.00 16383.50 FORMAT "%8.2" EXTENDED_LIMITS -16384.00 16383.50 AXIS_PTS_REF InjSys_nEng12Hsp_AX /end AXIS_DESCR
 /begin AXIS_DESCR COM_AXIS InjSys_ratAirMAgSpAxisInp rel_uw_q0p0234 12 0.00 1535.977 FORMAT "%8.3" AXIS_PTS_REF InjSys_ratAirM12AgSpHsp_AX /end AXIS_DESCR
/end CHARACTERISTIC
/begin CHARACTERISTIC InjSys_P2V3I1_HP.agBasTPistColdVers2_GM "class instance packet 2 variant 3 / base angle for interpolation cold TSA mode" MAP 0x80569268 RB_MapGroup_U8 382.5 kw_q1p5 0.00 382.5 FORMAT "%5.1"
 /begin AXIS_DESCR COM_AXIS Epm_nEng EngN 12 0.00 16383.50 FORMAT "%8.2" EXTENDED_LIMITS -16384.00 16383.50 AXIS_PTS_REF InjSys_nEng12HspVers2_AX /end AXIS_DESCR
 /begin AXIS_DESCR COM_AXIS InjSys_ratAirMAgSpVers2AxisInp rel_uw_q0p0234 12 0.00 1535.977 FORMAT "%8.3" AXIS_PTS_REF InjSys_ratAirM12AgSpHspVers2_AX /end AXIS_DESCR
/end CHARACTERISTIC
/begin CHARACTERISTIC InjSys_P2V3I1_HP.agBasTPistCold_GM "class instance packet 2 variant 3 / base angle for interpolation cold TSA mode" MAP 0x805692F8 RB_MapGroup_U8 382.5 kw_q1p5 0.00 382.5 FORMAT "%5.1"
 /begin AXIS_DESCR COM_AXIS Epm_nEng EngN 12 0.00 16383.50 FORMAT "%8.2" EXTENDED_LIMITS -16384.00 16383.50 AXIS_PTS_REF InjSys_nEng12Hsp_AX /end AXIS_DESCR
 /begin AXIS_DESCR COM_AXIS InjSys_ratAirMAgSpAxisInp rel_uw_q0p0234 12 0.00 1535.977 FORMAT "%8.3" AXIS_PTS_REF InjSys_ratAirM12AgSpHsp_AX /end AXIS_DESCR
/end CHARACTERISTIC
/begin CHARACTERISTIC InjSys_P2V3I1_HP.agBasTPistWrmVers2_GM "class instance packet 2 variant 3 / base angle for interpolation Warm TSA mode (Version 2)" MAP 0x80569388 RB_MapGroup_U8 382.5 kw_q1p5 0.00 382.5 FORMAT "%5.1"
 /begin AXIS_DESCR COM_AXIS Epm_nEng EngN 12 0.00 16383.50 FORMAT "%8.2" EXTENDED_LIMITS -16384.00 16383.50 AXIS_PTS_REF InjSys_nEng12HspVers2_AX /end AXIS_DESCR
 /begin AXIS_DESCR COM_AXIS InjSys_ratAirMAgSpVers2AxisInp rel_uw_q0p0234 12 0.00 1535.977 FORMAT "%8.3" AXIS_PTS_REF InjSys_ratAirM12AgSpHspVers2_AX /end AXIS_DESCR
/end CHARACTERISTIC
/begin CHARACTERISTIC InjSys_P2V3I1_HP.agBasTPistWrm_GM "class instance packet 2 variant 3 / base angle for interpolation Warm TSA mode" MAP 0x80569418 RB_MapGroup_U8 382.5 kw_q1p5 0.00 382.5 FORMAT "%5.1"
 /begin AXIS_DESCR COM_AXIS Epm_nEng EngN 12 0.00 16383.50 FORMAT "%8.2" EXTENDED_LIMITS -16384.00 16383.50 AXIS_PTS_REF InjSys_nEng12Hsp_AX /end AXIS_DESCR
 /begin AXIS_DESCR COM_AXIS InjSys_ratAirMAgSpAxisInp rel_uw_q0p0234 12 0.00 1535.977 FORMAT "%8.3" AXIS_PTS_REF InjSys_ratAirM12AgSpHsp_AX /end AXIS_DESCR
/end CHARACTERISTIC
/begin CHARACTERISTIC InjSys_P2V3I1_HP.facSpltCorrnLoT_GM "class instance packet 2 variant 3 / split factor correction dependent of temperature and number of injections" MAP 0x805694A8 RB_MapGroup_U8 1.992188 fak_ub_b2 0.00 1.992188 FORMAT "%8.6"
 /begin AXIS_DESCR COM_AXIS InjSys_tEng Temp_Cels 8 -3549.940 3003.560 FORMAT "%8.3" AXIS_PTS_REF InjSys_tEng08_AX /end AXIS_DESCR
 /begin AXIS_DESCR COM_AXIS InjSys_nrInjLimdLoc dez 8 0.00 65535.00 FORMAT "%8.2" AXIS_PTS_REF InjSys_nrInj08_AX /end AXIS_DESCR
/end CHARACTERISTIC
/begin CHARACTERISTIC InjSys_P2V3I1_HP.facSpltPktHiExtd_GM "class instance packet 2 variant 3 / split factor packet for interpolation" MAP 0x805694E8 RB_MapGroup_U8 0.9961 fak_ub_b1 0.00 0.9961
 /begin AXIS_DESCR COM_AXIS Epm_nEng EngN 12 0.00 16383.50 FORMAT "%8.2" EXTENDED_LIMITS -16384.00 16383.50 AXIS_PTS_REF InjSys_nEng12Vers2_AX /end AXIS_DESCR
 /begin AXIS_DESCR COM_AXIS InjSys_ratAirMVers2AxisInp rel_uw_q0p0234 12 0.00 1535.977 FORMAT "%8.3" AXIS_PTS_REF InjSys_ratAirM12Vers2_AX /end AXIS_DESCR
/end CHARACTERISTIC
/begin CHARACTERISTIC InjSys_P2V3I1_HP.facSpltPktHi_GM "class instance packet 2 variant 3 / split factor packet for interpolation" MAP 0x80569578 RB_MapGroup_U8 0.9961 fak_ub_b1 0.00 0.9961
 /begin AXIS_DESCR COM_AXIS Epm_nEng EngN 10 0.00 16383.50 FORMAT "%8.2" EXTENDED_LIMITS -16384.00 16383.50 AXIS_PTS_REF InjSys_nEng10_AX /end AXIS_DESCR
 /begin AXIS_DESCR COM_AXIS InjSys_ratAirMAxisInp rel_uw_q0p0234 8 0.00 1535.977 FORMAT "%8.3" AXIS_PTS_REF InjSys_ratAirM08_AX /end AXIS_DESCR
/end CHARACTERISTIC
/begin CHARACTERISTIC InjSys_P2V3I1_HP.facSpltPktLoExtd_GM "class instance packet 2 variant 3 / split factor packet for interpolation" MAP 0x805695C8 RB_MapGroup_U8 0.9961 fak_ub_b1 0.00 0.9961
 /begin AXIS_DESCR COM_AXIS Epm_nEng EngN 12 0.00 16383.50 FORMAT "%8.2" EXTENDED_LIMITS -16384.00 16383.50 AXIS_PTS_REF InjSys_nEng12Vers2_AX /end AXIS_DESCR
 /begin AXIS_DESCR COM_AXIS InjSys_ratAirMVers2AxisInp rel_uw_q0p0234 12 0.00 1535.977 FORMAT "%8.3" AXIS_PTS_REF InjSys_ratAirM12Vers2_AX /end AXIS_DESCR
/end CHARACTERISTIC
/begin CHARACTERISTIC InjSys_P2V3I1_HP.facSpltPktLo_GM "class instance packet 2 variant 3 / split factor packet for interpolation" MAP 0x80569658 RB_MapGroup_U8 0.9961 fak_ub_b1 0.00 0.9961
 /begin AXIS_DESCR COM_AXIS Epm_nEng EngN 10 0.00 16383.50 FORMAT "%8.2" EXTENDED_LIMITS -16384.00 16383.50 AXIS_PTS_REF InjSys_nEng10_AX /end AXIS_DESCR
 /begin AXIS_DESCR COM_AXIS InjSys_ratAirMAxisInp rel_uw_q0p0234 8 0.00 1535.977 FORMAT "%8.3" AXIS_PTS_REF InjSys_ratAirM08_AX /end AXIS_DESCR
/end CHARACTERISTIC
/begin CHARACTERISTIC InjSys_P2V3I1_HP.facTPistCold_M "class instance packet 2 variant 3 / Engine temperature and oil temperature based map for injection angle correction" MAP 0x805696A8 RB_Map_S16S16_U8 0.9961 fak_ub_b1 0.00 0.9961
 /begin AXIS_DESCR STD_AXIS InjSys_tEng Temp_Cels 8 -3549.940 3003.560 FORMAT "%8.3" DEPOSIT ABSOLUTE /end AXIS_DESCR
 /begin AXIS_DESCR STD_AXIS InjSys_tOilLocSp Temp_Cels 8 -3549.940 3003.560 FORMAT "%8.3" DEPOSIT ABSOLUTE /end AXIS_DESCR
/end CHARACTERISTIC
/begin CHARACTERISTIC InjSys_P2V3I1_HP.facTPist_M "class instance packet 2 variant 3 / piston temperature based map for injection angle correction" MAP 0x8056970C RB_Map_S16S16_U8 0.9961 fak_ub_b1 0.00 0.9961
 /begin AXIS_DESCR STD_AXIS InjSys_tPistBas Temp_Cels 6 -3549.940 3003.560 FORMAT "%8.3" DEPOSIT ABSOLUTE /end AXIS_DESCR
 /begin AXIS_DESCR STD_AXIS InjSys_tPistDelta temp_q0p1 6 -3276.800 3276.700 FORMAT "%8.3" DEPOSIT ABSOLUTE /end AXIS_DESCR
/end CHARACTERISTIC
/begin CHARACTERISTIC InjSys_P2V3I1_HP.facWghtAgT_M "class instance packet 2 variant 3 / weighting factor injection angle temperature dependent" MAP 0x8056974C RB_Map_S16S16_U8 0.9961 fak_ub_b1 0.00 0.9961
 /begin AXIS_DESCR STD_AXIS InjSys_tEng Temp_Cels 6 -3549.940 3003.560 FORMAT "%8.3" DEPOSIT ABSOLUTE /end AXIS_DESCR
 /begin AXIS_DESCR STD_AXIS InjSys_tEngStrt Temp_Cels 4 -3549.940 3003.560 FORMAT "%8.3" DEPOSIT ABSOLUTE /end AXIS_DESCR
/end CHARACTERISTIC
/begin CHARACTERISTIC InjSys_P2V3I1_HP.facWghtRatFuMAux1_C "class instance packet 2 variant 3 / weighting factor fuel mass auxiliary injection 1" VALUE 0x8056977C RB_Val_Wu8 0.9961 fak_ub_b1 0.00 0.9961 /end CHARACTERISTIC
/begin CHARACTERISTIC InjSys_P2V3I1_HP.facWghtRatFuMBas_C "class instance packet 2 variant 3 / weighting factor fuel mass base injection" VALUE 0x8056977D RB_Val_Wu8 0.9961 fak_ub_b1 0.00 0.9961 /end CHARACTERISTIC
/begin CHARACTERISTIC InjSys_P2V3I1_HP.facWghtSpltT_GM "class instance packet 2 variant 3 / weighting factor split factor temperature dependent" MAP 0x8056977E RB_MapGroup_U8 0.9961 fak_ub_b1 0.00 0.9961
 /begin AXIS_DESCR COM_AXIS InjSys_tEngStrt Temp_Cels 8 -3549.940 3003.560 FORMAT "%8.3" AXIS_PTS_REF InjSys_tEngStrt08_AX /end AXIS_DESCR
 /begin AXIS_DESCR COM_AXIS InjSys_tEng Temp_Cels 8 -3549.940 3003.560 FORMAT "%8.3" AXIS_PTS_REF InjSys_tEng08_AX /end AXIS_DESCR
/end CHARACTERISTIC
/begin CHARACTERISTIC InjSys_P2V3I1_HP.flgAgAux1_C "class instance packet 2 variant 3 / condition angle addressing for auxiliary injection" VALUE 0x805697BE RB_Val_Wu8 1.00000000000 B_TRUE 0.00 1.00000000000 FORMAT "%13.11" /end CHARACTERISTIC
/begin CHARACTERISTIC InjSys_P2V3I1_HP.flgAgBegAux1_C "class instance packet 2 variant 3 / condition angle addressing with begin angle for auxiliary injection" VALUE 0x805697BF RB_Val_Wu8 1.00000000000 B_TRUE 0.00 1.00000000000 FORMAT "%13.11" /end CHARACTERISTIC
/begin CHARACTERISTIC InjSys_P2V3I1_HP.flgAgEnd_C "class instance packet 2 variant 3 / condition end angle" VALUE 0x805697C0 RB_Val_Wu8 1.00000000000 B_TRUE 0.00 1.00000000000 FORMAT "%13.11" /end CHARACTERISTIC
/begin CHARACTERISTIC InjSys_P2V3I1_HP.flgAxVers_C "class instance packet 2 variant 3 / condition map selection with group axis in version 2" VALUE 0x805697C1 RB_Val_Wu8 1.00000000000 B_TRUE 0.00 1.00000000000 FORMAT "%13.11" /end CHARACTERISTIC
/begin CHARACTERISTIC InjSys_P2V3I1_HP.flgDiAux1_C "class instance packet 2 variant 3 / condition auxiliary injection 1 disabled" VALUE 0x805697C2 RB_Val_Wu8 1.00000000000 B_TRUE 0.00 1.00000000000 FORMAT "%13.11" /end CHARACTERISTIC
/begin CHARACTERISTIC InjSys_P2V3I1_HP.flgPktCoupl_C "class instance packet 2 variant 3 / condition packet coupling with break time" VALUE 0x805697C3 RB_Val_Wu8 1.00000000000 B_TRUE 0.00 1.00000000000 FORMAT "%13.11" /end CHARACTERISTIC
/begin CHARACTERISTIC InjSys_P2V3I1_HP.flgSpltBasFullLft_C "class instance packet 2 variant 3 / condition split base injection in linear area" VALUE 0x805697C4 RB_Val_Wu8 1.00000000000 B_TRUE 0.00 1.00000000000 FORMAT "%13.11" /end CHARACTERISTIC
/begin CHARACTERISTIC InjSys_P2V3I1_HP.tiBreakAux1_M "class instance packet 2 variant 3 / pause time auxiliary injection 1" MAP 0x805697C6 RB_Map_S16U16_S16 1310.720 t_q0p04_ms -1310.720 0.00 FORMAT "%8.3" EXTENDED_LIMITS -1310.720 1310.680
 /begin AXIS_DESCR STD_AXIS Epm_nEng EngN 8 -16384.00 16383.50 FORMAT "%8.2" DEPOSIT ABSOLUTE /end AXIS_DESCR
 /begin AXIS_DESCR STD_AXIS InjSys_ratAirMPredLocSp rel_uw_q0p0234 8 0.00 1535.977 FORMAT "%8.3" DEPOSIT ABSOLUTE /end AXIS_DESCR
/end CHARACTERISTIC
/begin CHARACTERISTIC InjSys_P2V3I1_HP.tiBreakPkt_M "class instance packet 2 variant 3 / break time for packet coupling" MAP 0x8056986A RB_Map_S16U16_S16 1310.720 t_q0p04_ms -1310.720 0.00 FORMAT "%8.3" EXTENDED_LIMITS -1310.720 1310.680
 /begin AXIS_DESCR STD_AXIS Epm_nEng EngN 8 -16384.00 16383.50 FORMAT "%8.2" DEPOSIT ABSOLUTE /end AXIS_DESCR
 /begin AXIS_DESCR STD_AXIS InjSys_ratAirMPredLocSp rel_uw_q0p0234 8 0.00 1535.977 FORMAT "%8.3" DEPOSIT ABSOLUTE /end AXIS_DESCR
/end CHARACTERISTIC
/begin CHARACTERISTIC InjSys_P2V4I1_HP.agBasHiExtd_GM "class instance packet 2 variant 2 / base angle for interpolation" MAP 0x80569914 RB_MapGroup_S16 766.5000 kw_q1p5 -384.0000 382.5000 FORMAT "%8.4" EXTENDED_LIMITS -49152.00 49150.50
 /begin AXIS_DESCR COM_AXIS Epm_nEng EngN 12 0.00 16383.50 FORMAT "%8.2" EXTENDED_LIMITS -16384.00 16383.50 AXIS_PTS_REF InjSys_nEng12Hsp_AX /end AXIS_DESCR
 /begin AXIS_DESCR COM_AXIS InjSys_ratAirMAgSpAxisInp rel_uw_q0p0234 12 0.00 1535.977 FORMAT "%8.3" AXIS_PTS_REF InjSys_ratAirM12AgSpHsp_AX /end AXIS_DESCR
/end CHARACTERISTIC
/begin CHARACTERISTIC InjSys_P2V4I1_HP.agBasLoExtd_GM "class instance packet 2 variant 2 / base angle for interpolation" MAP 0x80569A34 RB_MapGroup_S16 766.5000 kw_q1p5 -384.0000 382.5000 FORMAT "%8.4" EXTENDED_LIMITS -49152.00 49150.50
 /begin AXIS_DESCR COM_AXIS Epm_nEng EngN 12 0.00 16383.50 FORMAT "%8.2" EXTENDED_LIMITS -16384.00 16383.50 AXIS_PTS_REF InjSys_nEng12Hsp_AX /end AXIS_DESCR
 /begin AXIS_DESCR COM_AXIS InjSys_ratAirMAgSpAxisInp rel_uw_q0p0234 12 0.00 1535.977 FORMAT "%8.3" AXIS_PTS_REF InjSys_ratAirM12AgSpHsp_AX /end AXIS_DESCR
/end CHARACTERISTIC
/begin CHARACTERISTIC InjSys_P2V4I1_HP.agBasTPistCold_GM "class instance packet 2 variant 2 / base angle for interpolation cold TSA mode" MAP 0x80569B54 RB_MapGroup_S16 766.5000 kw_q1p5 -384.0000 382.5000 FORMAT "%8.4" EXTENDED_LIMITS -49152.00 49150.50
 /begin AXIS_DESCR COM_AXIS Epm_nEng EngN 12 0.00 16383.50 FORMAT "%8.2" EXTENDED_LIMITS -16384.00 16383.50 AXIS_PTS_REF InjSys_nEng12Hsp_AX /end AXIS_DESCR
 /begin AXIS_DESCR COM_AXIS InjSys_ratAirMAgSpAxisInp rel_uw_q0p0234 12 0.00 1535.977 FORMAT "%8.3" AXIS_PTS_REF InjSys_ratAirM12AgSpHsp_AX /end AXIS_DESCR
/end CHARACTERISTIC
/begin CHARACTERISTIC InjSys_P2V4I1_HP.agBasTPistWrm_GM "class instance packet 2 variant 2 / base angle for interpolation Warm TSA mode" MAP 0x80569C74 RB_MapGroup_S16 766.5000 kw_q1p5 -384.0000 382.5000 FORMAT "%8.4" EXTENDED_LIMITS -49152.00 49150.50
 /begin AXIS_DESCR COM_AXIS Epm_nEng EngN 12 0.00 16383.50 FORMAT "%8.2" EXTENDED_LIMITS -16384.00 16383.50 AXIS_PTS_REF InjSys_nEng12Hsp_AX /end AXIS_DESCR
 /begin AXIS_DESCR COM_AXIS InjSys_ratAirMAgSpAxisInp rel_uw_q0p0234 12 0.00 1535.977 FORMAT "%8.3" AXIS_PTS_REF InjSys_ratAirM12AgSpHsp_AX /end AXIS_DESCR
/end CHARACTERISTIC
/begin CHARACTERISTIC InjSys_P2V4I1_HP.facSpltAux1Hi_GM "class instance packet 2 variant 2 / split factor auxiliary injection 1 for interpolation" MAP 0x80569D94 RB_MapGroup_U8 0.9961 fak_ub_b1 0.00 0.9961
 /begin AXIS_DESCR COM_AXIS Epm_nEng EngN 12 0.00 16383.50 FORMAT "%8.2" EXTENDED_LIMITS -16384.00 16383.50 AXIS_PTS_REF InjSys_nEng12_AX /end AXIS_DESCR
 /begin AXIS_DESCR COM_AXIS InjSys_ratAirMAxisInp rel_uw_q0p0234 12 0.00 1535.977 FORMAT "%8.3" AXIS_PTS_REF InjSys_ratAirM12_AX /end AXIS_DESCR
/end CHARACTERISTIC
/begin CHARACTERISTIC InjSys_P2V4I1_HP.facSpltAux1Lo_GM "class instance packet 2 variant 2 / split factor auxiliary injection 1 for interpolation" MAP 0x80569E24 RB_MapGroup_U8 0.9961 fak_ub_b1 0.00 0.9961
 /begin AXIS_DESCR COM_AXIS Epm_nEng EngN 12 0.00 16383.50 FORMAT "%8.2" EXTENDED_LIMITS -16384.00 16383.50 AXIS_PTS_REF InjSys_nEng12_AX /end AXIS_DESCR
 /begin AXIS_DESCR COM_AXIS InjSys_ratAirMAxisInp rel_uw_q0p0234 12 0.00 1535.977 FORMAT "%8.3" AXIS_PTS_REF InjSys_ratAirM12_AX /end AXIS_DESCR
/end CHARACTERISTIC
/begin CHARACTERISTIC InjSys_P2V4I1_HP.facSpltPktHi_GM "class instance packet 2 variant 2 / split factor packet for interpolation" MAP 0x80569EB4 RB_MapGroup_U8 0.9961 fak_ub_b1 0.00 0.9961
 /begin AXIS_DESCR COM_AXIS Epm_nEng EngN 12 0.00 16383.50 FORMAT "%8.2" EXTENDED_LIMITS -16384.00 16383.50 AXIS_PTS_REF InjSys_nEng12_AX /end AXIS_DESCR
 /begin AXIS_DESCR COM_AXIS InjSys_ratAirMAxisInp rel_uw_q0p0234 12 0.00 1535.977 FORMAT "%8.3" AXIS_PTS_REF InjSys_ratAirM12_AX /end AXIS_DESCR
/end CHARACTERISTIC
/begin CHARACTERISTIC InjSys_P2V4I1_HP.facSpltPktLo_GM "class instance packet 2 variant 2 / split factor packet for interpolation" MAP 0x80569F44 RB_MapGroup_U8 0.9961 fak_ub_b1 0.00 0.9961
 /begin AXIS_DESCR COM_AXIS Epm_nEng EngN 12 0.00 16383.50 FORMAT "%8.2" EXTENDED_LIMITS -16384.00 16383.50 AXIS_PTS_REF InjSys_nEng12_AX /end AXIS_DESCR
 /begin AXIS_DESCR COM_AXIS InjSys_ratAirMAxisInp rel_uw_q0p0234 12 0.00 1535.977 FORMAT "%8.3" AXIS_PTS_REF InjSys_ratAirM12_AX /end AXIS_DESCR
/end CHARACTERISTIC
/begin CHARACTERISTIC InjSys_P2V4I1_HP.facTPistCold_M "class instance packet 2 variant 2 / Engine temperature and oil temperature based map for injection angle correction" MAP 0x80569FD4 RB_Map_S16S16_U8 0.9961 fak_ub_b1 0.00 0.9961
 /begin AXIS_DESCR STD_AXIS InjSys_tEng Temp_Cels 8 -3549.940 3003.560 FORMAT "%8.3" DEPOSIT ABSOLUTE /end AXIS_DESCR
 /begin AXIS_DESCR STD_AXIS InjSys_tOilLocSp Temp_Cels 8 -3549.940 3003.560 FORMAT "%8.3" DEPOSIT ABSOLUTE /end AXIS_DESCR
/end CHARACTERISTIC
/begin CHARACTERISTIC InjSys_P2V4I1_HP.facTPist_M "class instance packet 2 variant 2 / piston temperature based map for injection angle correction" MAP 0x8056A038 RB_Map_S16S16_U8 0.9961 fak_ub_b1 0.00 0.9961
 /begin AXIS_DESCR STD_AXIS InjSys_tPistBas Temp_Cels 6 -3549.940 3003.560 FORMAT "%8.3" DEPOSIT ABSOLUTE /end AXIS_DESCR
 /begin AXIS_DESCR STD_AXIS InjSys_tPistDelta temp_q0p1 6 -3276.800 3276.700 FORMAT "%8.3" DEPOSIT ABSOLUTE /end AXIS_DESCR
/end CHARACTERISTIC
/begin CHARACTERISTIC InjSys_P2V4I1_HP.facWghtAgBasT_GM "class instance packet 2 variant 2 / weighting factor base angle temperature dependent" MAP 0x8056A078 RB_MapGroup_U8 0.9961 fak_ub_b1 0.00 0.9961
 /begin AXIS_DESCR COM_AXIS InjSys_tEng Temp_Cels 8 -3549.940 3003.560 FORMAT "%8.3" AXIS_PTS_REF InjSys_tEng08_AX /end AXIS_DESCR
 /begin AXIS_DESCR COM_AXIS ExhMod_tCat1B1 Temp_Cels 8 -3549.940 3003.560 FORMAT "%8.3" AXIS_PTS_REF InjSys_tCat08_AX /end AXIS_DESCR
/end CHARACTERISTIC
/begin CHARACTERISTIC InjSys_P2V4I1_HP.facWghtSpltT_GM "class instance packet 2 variant 2 / weighting factor split factor temperature dependent" MAP 0x8056A0B8 RB_MapGroup_U8 0.9961 fak_ub_b1 0.00 0.9961
 /begin AXIS_DESCR COM_AXIS ExhMod_tCat1B1 Temp_Cels 8 -3549.940 3003.560 FORMAT "%8.3" AXIS_PTS_REF InjSys_tCat08_AX /end AXIS_DESCR
 /begin AXIS_DESCR COM_AXIS InjSys_tEng Temp_Cels 8 -3549.940 3003.560 FORMAT "%8.3" AXIS_PTS_REF InjSys_tEng08_AX /end AXIS_DESCR
/end CHARACTERISTIC
/begin CHARACTERISTIC InjSys_P2V4I1_HP.flgAbsltSplt_C "class instance packet 2 variant 2 / condition split with absolute fuel mass" VALUE 0x8056A0F8 RB_Val_Wu8 1.00000000000 B_TRUE 0.00 1.00000000000 FORMAT "%13.11" /end CHARACTERISTIC
/begin CHARACTERISTIC InjSys_P2V4I1_HP.flgAgEnd_C "class instance packet 2 variant 2 / condition end angle" VALUE 0x8056A0F9 RB_Val_Wu8 1.00000000000 B_TRUE 0.00 1.00000000000 FORMAT "%13.11" /end CHARACTERISTIC
/begin CHARACTERISTIC InjSys_P2V4I1_HP.flgPktCoupl_C "class instance packet 2 variant 2 / condition packet coupling with break time" VALUE 0x8056A0FA RB_Val_Wu8 1.00000000000 B_TRUE 0.00 1.00000000000 FORMAT "%13.11" /end CHARACTERISTIC
/begin CHARACTERISTIC InjSys_P2V4I1_HP.ratFuMAux1Hi_GM "class instance packet 2 variant 2 / relative fuel mass auxiliary injection 1 for interpolation" MAP 0x8056A0FC RB_MapGroup_U16 3071.953 rel_uw_b3072 0.00 3071.953 FORMAT "%8.3"
 /begin AXIS_DESCR COM_AXIS Epm_nEng EngN 10 0.00 16383.50 FORMAT "%8.2" EXTENDED_LIMITS -16384.00 16383.50 AXIS_PTS_REF InjSys_nEng10_AX /end AXIS_DESCR
 /begin AXIS_DESCR COM_AXIS InjSys_ratAirMAxisInp rel_uw_q0p0234 8 0.00 1535.977 FORMAT "%8.3" AXIS_PTS_REF InjSys_ratAirM08_AX /end AXIS_DESCR
/end CHARACTERISTIC
/begin CHARACTERISTIC InjSys_P2V4I1_HP.ratFuMAux1Lo_GM "class instance packet 2 variant 2 / relative fuel mass auxiliary injection 1 for interpolation" MAP 0x8056A19C RB_MapGroup_U16 3071.953 rel_uw_b3072 0.00 3071.953 FORMAT "%8.3"
 /begin AXIS_DESCR COM_AXIS Epm_nEng EngN 10 0.00 16383.50 FORMAT "%8.2" EXTENDED_LIMITS -16384.00 16383.50 AXIS_PTS_REF InjSys_nEng10_AX /end AXIS_DESCR
 /begin AXIS_DESCR COM_AXIS InjSys_ratAirMAxisInp rel_uw_q0p0234 8 0.00 1535.977 FORMAT "%8.3" AXIS_PTS_REF InjSys_ratAirM08_AX /end AXIS_DESCR
/end CHARACTERISTIC
/begin CHARACTERISTIC InjSys_P2V4I1_HP.ratFuMBasHi_GM "class instance packet 2 variant 2 / relative fuel mass base injection 1 for interpolation" MAP 0x8056A23C RB_MapGroup_U16 3071.953 rel_uw_b3072 0.00 3071.953 FORMAT "%8.3"
 /begin AXIS_DESCR COM_AXIS Epm_nEng EngN 10 0.00 16383.50 FORMAT "%8.2" EXTENDED_LIMITS -16384.00 16383.50 AXIS_PTS_REF InjSys_nEng10_AX /end AXIS_DESCR
 /begin AXIS_DESCR COM_AXIS InjSys_ratAirMAxisInp rel_uw_q0p0234 8 0.00 1535.977 FORMAT "%8.3" AXIS_PTS_REF InjSys_ratAirM08_AX /end AXIS_DESCR
/end CHARACTERISTIC
/begin CHARACTERISTIC InjSys_P2V4I1_HP.ratFuMBasLo_GM "class instance packet 2 variant 2 / relative fuel mass base injection 1 for interpolation" MAP 0x8056A2DC RB_MapGroup_U16 3071.953 rel_uw_b3072 0.00 3071.953 FORMAT "%8.3"
 /begin AXIS_DESCR COM_AXIS Epm_nEng EngN 10 0.00 16383.50 FORMAT "%8.2" EXTENDED_LIMITS -16384.00 16383.50 AXIS_PTS_REF InjSys_nEng10_AX /end AXIS_DESCR
 /begin AXIS_DESCR COM_AXIS InjSys_ratAirMAxisInp rel_uw_q0p0234 8 0.00 1535.977 FORMAT "%8.3" AXIS_PTS_REF InjSys_ratAirM08_AX /end AXIS_DESCR
/end CHARACTERISTIC
/begin CHARACTERISTIC InjSys_P2V4I1_HP.tiBreakAux1_M "class instance packet 2 variant 2 / pause time auxiliary injection 1" MAP 0x8056A37C RB_Map_S16U16_S16 1310.720 t_q0p04_ms -1310.720 0.00 FORMAT "%8.3" EXTENDED_LIMITS -1310.720 1310.680
 /begin AXIS_DESCR STD_AXIS Epm_nEng EngN 8 -16384.00 16383.50 FORMAT "%8.2" DEPOSIT ABSOLUTE /end AXIS_DESCR
 /begin AXIS_DESCR STD_AXIS InjSys_ratAirMPredLocSp rel_uw_q0p0234 8 0.00 1535.977 FORMAT "%8.3" DEPOSIT ABSOLUTE /end AXIS_DESCR
/end CHARACTERISTIC
/begin CHARACTERISTIC InjSys_P2V4I1_HP.tiBreakPkt_M "class instance packet 2 variant 2 / break time for packet coupling" MAP 0x8056A420 RB_Map_S16U16_S16 1310.720 t_q0p04_ms -1310.720 0.00 FORMAT "%8.3" EXTENDED_LIMITS -1310.720 1310.680
 /begin AXIS_DESCR STD_AXIS Epm_nEng EngN 8 -16384.00 16383.50 FORMAT "%8.2" DEPOSIT ABSOLUTE /end AXIS_DESCR
 /begin AXIS_DESCR STD_AXIS InjSys_ratAirMPredLocSp rel_uw_q0p0234 8 0.00 1535.977 FORMAT "%8.3" DEPOSIT ABSOLUTE /end AXIS_DESCR
/end CHARACTERISTIC
/begin CHARACTERISTIC InjSys_P2V5I1_HP.agBasHi_GM "class instance packet 2 variant 5 / base angle for ethanol" MAP 0x8056A4C8 RB_MapGroup_U8 382.5 kw_q1p5 0.00 382.5 FORMAT "%5.1"
 /begin AXIS_DESCR COM_AXIS Epm_nEng EngN 12 0.00 16383.50 FORMAT "%8.2" EXTENDED_LIMITS -16384.00 16383.50 AXIS_PTS_REF InjSys_nEng12Hsp_AX /end AXIS_DESCR
 /begin AXIS_DESCR COM_AXIS InjSys_ratAirMAgSpAxisInp rel_uw_q0p0234 12 0.00 1535.977 FORMAT "%8.3" AXIS_PTS_REF InjSys_ratAirM12AgSpHsp_AX /end AXIS_DESCR
/end CHARACTERISTIC
/begin CHARACTERISTIC InjSys_P2V5I1_HP.agBasLo_GM "class instance packet 2 variant 5 / base angle for interpolation" MAP 0x8056A558 RB_MapGroup_U8 382.5 kw_q1p5 0.00 382.5 FORMAT "%5.1"
 /begin AXIS_DESCR COM_AXIS Epm_nEng EngN 12 0.00 16383.50 FORMAT "%8.2" EXTENDED_LIMITS -16384.00 16383.50 AXIS_PTS_REF InjSys_nEng12Hsp_AX /end AXIS_DESCR
 /begin AXIS_DESCR COM_AXIS InjSys_ratAirMAgSpAxisInp rel_uw_q0p0234 12 0.00 1535.977 FORMAT "%8.3" AXIS_PTS_REF InjSys_ratAirM12AgSpHsp_AX /end AXIS_DESCR
/end CHARACTERISTIC
/begin CHARACTERISTIC InjSys_P2V5I1_HP.agBasTPistCold_GM "class instance packet 2 variant 5 / base angle for interpolation cold TSA mode" MAP 0x8056A5E8 RB_MapGroup_U8 382.5 kw_q1p5 0.00 382.5 FORMAT "%5.1"
 /begin AXIS_DESCR COM_AXIS Epm_nEng EngN 12 0.00 16383.50 FORMAT "%8.2" EXTENDED_LIMITS -16384.00 16383.50 AXIS_PTS_REF InjSys_nEng12Hsp_AX /end AXIS_DESCR
 /begin AXIS_DESCR COM_AXIS InjSys_ratAirMAgSpAxisInp rel_uw_q0p0234 12 0.00 1535.977 FORMAT "%8.3" AXIS_PTS_REF InjSys_ratAirM12AgSpHsp_AX /end AXIS_DESCR
/end CHARACTERISTIC
/begin CHARACTERISTIC InjSys_P2V5I1_HP.agBasTPistWrm_GM "class instance packet 2 variant 5 / base angle for interpolation Warm TSA mode" MAP 0x8056A678 RB_MapGroup_U8 382.5 kw_q1p5 0.00 382.5 FORMAT "%5.1"
 /begin AXIS_DESCR COM_AXIS Epm_nEng EngN 12 0.00 16383.50 FORMAT "%8.2" EXTENDED_LIMITS -16384.00 16383.50 AXIS_PTS_REF InjSys_nEng12Hsp_AX /end AXIS_DESCR
 /begin AXIS_DESCR COM_AXIS InjSys_ratAirMAgSpAxisInp rel_uw_q0p0234 12 0.00 1535.977 FORMAT "%8.3" AXIS_PTS_REF InjSys_ratAirM12AgSpHsp_AX /end AXIS_DESCR
/end CHARACTERISTIC
/begin CHARACTERISTIC InjSys_P2V5I1_HP.facSpltAux1Hi_GM "class instance packet 2 variant 5 / split factor auxiliary injection 1 for interpolation" MAP 0x8056A708 RB_MapGroup_U8 0.9961 fak_ub_b1 0.00 0.9961
 /begin AXIS_DESCR COM_AXIS Epm_nEng EngN 10 0.00 16383.50 FORMAT "%8.2" EXTENDED_LIMITS -16384.00 16383.50 AXIS_PTS_REF InjSys_nEng10_AX /end AXIS_DESCR
 /begin AXIS_DESCR COM_AXIS InjSys_ratAirMAxisInp rel_uw_q0p0234 8 0.00 1535.977 FORMAT "%8.3" AXIS_PTS_REF InjSys_ratAirM08_AX /end AXIS_DESCR
/end CHARACTERISTIC
/begin CHARACTERISTIC InjSys_P2V5I1_HP.facSpltAux1Lo_GM "class instance packet 2 variant 5 / split factor auxiliary injection 1 for interpolation" MAP 0x8056A758 RB_MapGroup_U8 0.9961 fak_ub_b1 0.00 0.9961
 /begin AXIS_DESCR COM_AXIS Epm_nEng EngN 10 0.00 16383.50 FORMAT "%8.2" EXTENDED_LIMITS -16384.00 16383.50 AXIS_PTS_REF InjSys_nEng10_AX /end AXIS_DESCR
 /begin AXIS_DESCR COM_AXIS InjSys_ratAirMAxisInp rel_uw_q0p0234 8 0.00 1535.977 FORMAT "%8.3" AXIS_PTS_REF InjSys_ratAirM08_AX /end AXIS_DESCR
/end CHARACTERISTIC
/begin CHARACTERISTIC InjSys_P2V5I1_HP.facSpltAux2Hi_GM "class instance packet 2 variant 5 / split factor auxiliary injection 2 for interpolation" MAP 0x8056A7A8 RB_MapGroup_U8 0.9961 fak_ub_b1 0.00 0.9961
 /begin AXIS_DESCR COM_AXIS Epm_nEng EngN 10 0.00 16383.50 FORMAT "%8.2" EXTENDED_LIMITS -16384.00 16383.50 AXIS_PTS_REF InjSys_nEng10_AX /end AXIS_DESCR
 /begin AXIS_DESCR COM_AXIS InjSys_ratAirMAxisInp rel_uw_q0p0234 8 0.00 1535.977 FORMAT "%8.3" AXIS_PTS_REF InjSys_ratAirM08_AX /end AXIS_DESCR
/end CHARACTERISTIC
/begin CHARACTERISTIC InjSys_P2V5I1_HP.facSpltAux2Lo_GM "class instance packet 2 variant 5 / split factor auxiliary injection 2 for interpolation" MAP 0x8056A7F8 RB_MapGroup_U8 0.9961 fak_ub_b1 0.00 0.9961
 /begin AXIS_DESCR COM_AXIS Epm_nEng EngN 10 0.00 16383.50 FORMAT "%8.2" EXTENDED_LIMITS -16384.00 16383.50 AXIS_PTS_REF InjSys_nEng10_AX /end AXIS_DESCR
 /begin AXIS_DESCR COM_AXIS InjSys_ratAirMAxisInp rel_uw_q0p0234 8 0.00 1535.977 FORMAT "%8.3" AXIS_PTS_REF InjSys_ratAirM08_AX /end AXIS_DESCR
/end CHARACTERISTIC
/begin CHARACTERISTIC InjSys_P2V5I1_HP.facSpltCorrnLoT_GM "class instance packet 2 variant 5 / split factor correction dependent of temperature and number of injections" MAP 0x8056A848 RB_MapGroup_U8 1.992188 fak_ub_b2 0.00 1.992188 FORMAT "%8.6"
 /begin AXIS_DESCR COM_AXIS InjSys_tEng Temp_Cels 8 -3549.940 3003.560 FORMAT "%8.3" AXIS_PTS_REF InjSys_tEng08_AX /end AXIS_DESCR
 /begin AXIS_DESCR COM_AXIS InjSys_nrInjLimdLoc dez 8 0.00 65535.00 FORMAT "%8.2" AXIS_PTS_REF InjSys_nrInj08_AX /end AXIS_DESCR
/end CHARACTERISTIC
/begin CHARACTERISTIC InjSys_P2V5I1_HP.facSpltPktHi_GM "class instance packet 2 variant 5 / split factor packet for interpolation" MAP 0x8056A888 RB_MapGroup_U8 0.9961 fak_ub_b1 0.00 0.9961
 /begin AXIS_DESCR COM_AXIS Epm_nEng EngN 10 0.00 16383.50 FORMAT "%8.2" EXTENDED_LIMITS -16384.00 16383.50 AXIS_PTS_REF InjSys_nEng10_AX /end AXIS_DESCR
 /begin AXIS_DESCR COM_AXIS InjSys_ratAirMAxisInp rel_uw_q0p0234 8 0.00 1535.977 FORMAT "%8.3" AXIS_PTS_REF InjSys_ratAirM08_AX /end AXIS_DESCR
/end CHARACTERISTIC
/begin CHARACTERISTIC InjSys_P2V5I1_HP.facSpltPktLo_GM "class instance packet 2 variant 5 / split factor packet for interpolation" MAP 0x8056A8D8 RB_MapGroup_U8 0.9961 fak_ub_b1 0.00 0.9961
 /begin AXIS_DESCR COM_AXIS Epm_nEng EngN 10 0.00 16383.50 FORMAT "%8.2" EXTENDED_LIMITS -16384.00 16383.50 AXIS_PTS_REF InjSys_nEng10_AX /end AXIS_DESCR
 /begin AXIS_DESCR COM_AXIS InjSys_ratAirMAxisInp rel_uw_q0p0234 8 0.00 1535.977 FORMAT "%8.3" AXIS_PTS_REF InjSys_ratAirM08_AX /end AXIS_DESCR
/end CHARACTERISTIC
/begin CHARACTERISTIC InjSys_P2V5I1_HP.facTPistCold_M "class instance packet 2 variant 5 / Engine temperature and oil temperature based map for injection angle correction" MAP 0x8056A928 RB_Map_S16S16_U8 0.9961 fak_ub_b1 0.00 0.9961
 /begin AXIS_DESCR STD_AXIS InjSys_tEng Temp_Cels 8 -3549.940 3003.560 FORMAT "%8.3" DEPOSIT ABSOLUTE /end AXIS_DESCR
 /begin AXIS_DESCR STD_AXIS InjSys_tOilLocSp Temp_Cels 8 -3549.940 3003.560 FORMAT "%8.3" DEPOSIT ABSOLUTE /end AXIS_DESCR
/end CHARACTERISTIC
/begin CHARACTERISTIC InjSys_P2V5I1_HP.facTPist_M "class instance packet 2 variant 5 / piston temperature based map for injection angle correction" MAP 0x8056A98C RB_Map_S16S16_U8 0.9961 fak_ub_b1 0.00 0.9961
 /begin AXIS_DESCR STD_AXIS InjSys_tPistBas Temp_Cels 6 -3549.940 3003.560 FORMAT "%8.3" DEPOSIT ABSOLUTE /end AXIS_DESCR
 /begin AXIS_DESCR STD_AXIS InjSys_tPistDelta temp_q0p1 6 -3276.800 3276.700 FORMAT "%8.3" DEPOSIT ABSOLUTE /end AXIS_DESCR
/end CHARACTERISTIC
/begin CHARACTERISTIC InjSys_P2V5I1_HP.facWghtAgT_M "class instance packet 2 variant 5 / Interpolation factor for injection angle based on temperature" MAP 0x8056A9CC RB_Map_S16S16_U8 0.9961 fak_ub_b1 0.00 0.9961
 /begin AXIS_DESCR STD_AXIS InjSys_tEng Temp_Cels 6 -3549.940 3003.560 FORMAT "%8.3" DEPOSIT ABSOLUTE /end AXIS_DESCR
 /begin AXIS_DESCR STD_AXIS InjSys_tOilLocSp Temp_Cels 4 -3549.940 3003.560 FORMAT "%8.3" DEPOSIT ABSOLUTE /end AXIS_DESCR
/end CHARACTERISTIC
/begin CHARACTERISTIC InjSys_P2V5I1_HP.facWghtRatFuMAux1_C "class instance packet 2 variant 5 / weighting factor fuel mass auxiliary injection 1" VALUE 0x8056A9FC RB_Val_Wu8 0.9961 fak_ub_b1 0.00 0.9961 /end CHARACTERISTIC
/begin CHARACTERISTIC InjSys_P2V5I1_HP.facWghtRatFuMAux2_C "class instance packet 2 variant 5 / weighting factor fuel mass auxiliary injection 2" VALUE 0x8056A9FD RB_Val_Wu8 0.9961 fak_ub_b1 0.00 0.9961 /end CHARACTERISTIC
/begin CHARACTERISTIC InjSys_P2V5I1_HP.facWghtRatFuMBas_C "class instance packet 2 variant 5 / weighting factor fuel mass base injection" VALUE 0x8056A9FE RB_Val_Wu8 0.9961 fak_ub_b1 0.00 0.9961 /end CHARACTERISTIC
/begin CHARACTERISTIC InjSys_P2V5I1_HP.facWghtSpltT_GM "class instance packet 2 variant 5 / weighting factor split factor temperature dependent" MAP 0x8056A9FF RB_MapGroup_U8 0.9961 fak_ub_b1 0.00 0.9961
 /begin AXIS_DESCR COM_AXIS InjSys_tEngStrt Temp_Cels 8 -3549.940 3003.560 FORMAT "%8.3" AXIS_PTS_REF InjSys_tEngStrt08_AX /end AXIS_DESCR
 /begin AXIS_DESCR COM_AXIS InjSys_tEng Temp_Cels 8 -3549.940 3003.560 FORMAT "%8.3" AXIS_PTS_REF InjSys_tEng08_AX /end AXIS_DESCR
/end CHARACTERISTIC
/begin CHARACTERISTIC InjSys_P2V5I1_HP.flgAbsltSplt_C "class instance packet 2 variant 5 / condition split with absolute fuel mass" VALUE 0x8056AA3F RB_Val_Wu8 1.00000000000 B_TRUE 0.00 1.00000000000 FORMAT "%13.11" /end CHARACTERISTIC
/begin CHARACTERISTIC InjSys_P2V5I1_HP.flgAgEnd_C "class instance packet 2 variant 5 / condition end angle" VALUE 0x8056AA40 RB_Val_Wu8 1.00000000000 B_TRUE 0.00 1.00000000000 FORMAT "%13.11" /end CHARACTERISTIC
/begin CHARACTERISTIC InjSys_P2V5I1_HP.flgDiAux2_C "class instance packet 2 variant 5 / condition auxiliary injection 2 disabled" VALUE 0x8056AA41 RB_Val_Wu8 1.00000000000 B_TRUE 0.00 1.00000000000 FORMAT "%13.11" /end CHARACTERISTIC
/begin CHARACTERISTIC InjSys_P2V5I1_HP.flgPktCoupl_C "class instance packet 2 variant 5 / condition packet coupling with break time" VALUE 0x8056AA42 RB_Val_Wu8 1.00000000000 B_TRUE 0.00 1.00000000000 FORMAT "%13.11" /end CHARACTERISTIC
/begin CHARACTERISTIC InjSys_P2V5I1_HP.ratFuMAux1Hi_GM "class instance packet 2 variant 5 / relative fuel mass auxiliary injection 1 for interpolation" MAP 0x8056AA44 RB_MapGroup_U16 3071.953 rel_uw_b3072 0.00 3071.953 FORMAT "%8.3"
 /begin AXIS_DESCR COM_AXIS Epm_nEng EngN 12 0.00 16383.50 FORMAT "%8.2" EXTENDED_LIMITS -16384.00 16383.50 AXIS_PTS_REF InjSys_nEng12_AX /end AXIS_DESCR
 /begin AXIS_DESCR COM_AXIS InjSys_ratAirMAxisInp rel_uw_q0p0234 12 0.00 1535.977 FORMAT "%8.3" AXIS_PTS_REF InjSys_ratAirM12_AX /end AXIS_DESCR
/end CHARACTERISTIC
/begin CHARACTERISTIC InjSys_P2V5I1_HP.ratFuMAux1Lo_GM "class instance packet 2 variant 5 / relative fuel mass auxiliary injection 1 for interpolation" MAP 0x8056AB64 RB_MapGroup_U16 3071.953 rel_uw_b3072 0.00 3071.953 FORMAT "%8.3"
 /begin AXIS_DESCR COM_AXIS Epm_nEng EngN 12 0.00 16383.50 FORMAT "%8.2" EXTENDED_LIMITS -16384.00 16383.50 AXIS_PTS_REF InjSys_nEng12_AX /end AXIS_DESCR
 /begin AXIS_DESCR COM_AXIS InjSys_ratAirMAxisInp rel_uw_q0p0234 12 0.00 1535.977 FORMAT "%8.3" AXIS_PTS_REF InjSys_ratAirM12_AX /end AXIS_DESCR
/end CHARACTERISTIC
/begin CHARACTERISTIC InjSys_P2V5I1_HP.ratFuMAux2Hi_GM "class instance packet 2 variant 5 / relative fuel mass auxiliary injection 2 for interpolation" MAP 0x8056AC84 RB_MapGroup_U16 3071.953 rel_uw_b3072 0.00 3071.953 FORMAT "%8.3"
 /begin AXIS_DESCR COM_AXIS Epm_nEng EngN 12 0.00 16383.50 FORMAT "%8.2" EXTENDED_LIMITS -16384.00 16383.50 AXIS_PTS_REF InjSys_nEng12_AX /end AXIS_DESCR
 /begin AXIS_DESCR COM_AXIS InjSys_ratAirMAxisInp rel_uw_q0p0234 12 0.00 1535.977 FORMAT "%8.3" AXIS_PTS_REF InjSys_ratAirM12_AX /end AXIS_DESCR
/end CHARACTERISTIC
/begin CHARACTERISTIC InjSys_P2V5I1_HP.ratFuMAux2Lo_GM "class instance packet 2 variant 5 / relative fuel mass auxiliary injection 2 for interpolation" MAP 0x8056ADA4 RB_MapGroup_U16 3071.953 rel_uw_b3072 0.00 3071.953 FORMAT "%8.3"
 /begin AXIS_DESCR COM_AXIS Epm_nEng EngN 12 0.00 16383.50 FORMAT "%8.2" EXTENDED_LIMITS -16384.00 16383.50 AXIS_PTS_REF InjSys_nEng12_AX /end AXIS_DESCR
 /begin AXIS_DESCR COM_AXIS InjSys_ratAirMAxisInp rel_uw_q0p0234 12 0.00 1535.977 FORMAT "%8.3" AXIS_PTS_REF InjSys_ratAirM12_AX /end AXIS_DESCR
/end CHARACTERISTIC
/begin CHARACTERISTIC InjSys_P2V5I1_HP.ratFuMBallHysOffs_C "class instance packet 2 variant 5 / Hysteresis for fuel mass to shift injection pulse to ballistic area" VALUE 0x8056AEC4 RB_Val_Wu16 3071.953 rel_uw_b3072 0.00 3071.953 FORMAT "%8.3" /end CHARACTERISTIC
/begin CHARACTERISTIC InjSys_P2V5I1_HP.ratFuMBallHysThd_C "class instance packet 2 variant 5 / Threshold fuel mass to shift injection pulse in ballistic area" VALUE 0x8056AEC6 RB_Val_Wu16 3071.953 rel_uw_b3072 0.00 3071.953 FORMAT "%8.3" /end CHARACTERISTIC
/begin CHARACTERISTIC InjSys_P2V5I1_HP.ratFuMBasHi_GM "class instance packet 2 variant 5 / relative fuel mass base injection 1 for interpolation" MAP 0x8056AEC8 RB_MapGroup_U16 3071.953 rel_uw_b3072 0.00 3071.953 FORMAT "%8.3"
 /begin AXIS_DESCR COM_AXIS Epm_nEng EngN 12 0.00 16383.50 FORMAT "%8.2" EXTENDED_LIMITS -16384.00 16383.50 AXIS_PTS_REF InjSys_nEng12_AX /end AXIS_DESCR
 /begin AXIS_DESCR COM_AXIS InjSys_ratAirMAxisInp rel_uw_q0p0234 12 0.00 1535.977 FORMAT "%8.3" AXIS_PTS_REF InjSys_ratAirM12_AX /end AXIS_DESCR
/end CHARACTERISTIC
/begin CHARACTERISTIC InjSys_P2V5I1_HP.ratFuMBasLo_GM "class instance packet 2 variant 5 / relative fuel mass base injection 1 for interpolation" MAP 0x8056AFE8 RB_MapGroup_U16 3071.953 rel_uw_b3072 0.00 3071.953 FORMAT "%8.3"
 /begin AXIS_DESCR COM_AXIS Epm_nEng EngN 12 0.00 16383.50 FORMAT "%8.2" EXTENDED_LIMITS -16384.00 16383.50 AXIS_PTS_REF InjSys_nEng12_AX /end AXIS_DESCR
 /begin AXIS_DESCR COM_AXIS InjSys_ratAirMAxisInp rel_uw_q0p0234 12 0.00 1535.977 FORMAT "%8.3" AXIS_PTS_REF InjSys_ratAirM12_AX /end AXIS_DESCR
/end CHARACTERISTIC
/begin CHARACTERISTIC InjSys_P2V5I1_HP.tiBreakAux1_M "class instance packet 2 variant 5 / pause time auxiliary injection 1" MAP 0x8056B108 RB_Map_S16U16_S16 1310.720 t_q0p04_ms -1310.720 0.00 FORMAT "%8.3" EXTENDED_LIMITS -1310.720 1310.680
 /begin AXIS_DESCR STD_AXIS Epm_nEng EngN 8 -16384.00 16383.50 FORMAT "%8.2" DEPOSIT ABSOLUTE /end AXIS_DESCR
 /begin AXIS_DESCR STD_AXIS InjSys_ratAirMPredLocSp rel_uw_q0p0234 8 0.00 1535.977 FORMAT "%8.3" DEPOSIT ABSOLUTE /end AXIS_DESCR
/end CHARACTERISTIC
/begin CHARACTERISTIC InjSys_P2V5I1_HP.tiBreakAux2_M "class instance packet 2 variant 5 / pause time auxiliary injection 2" MAP 0x8056B1AC RB_Map_S16U16_S16 1310.720 t_q0p04_ms -1310.720 0.00 FORMAT "%8.3" EXTENDED_LIMITS -1310.720 1310.680
 /begin AXIS_DESCR STD_AXIS Epm_nEng EngN 8 -16384.00 16383.50 FORMAT "%8.2" DEPOSIT ABSOLUTE /end AXIS_DESCR
 /begin AXIS_DESCR STD_AXIS InjSys_ratAirMPredLocSp rel_uw_q0p0234 8 0.00 1535.977 FORMAT "%8.3" DEPOSIT ABSOLUTE /end AXIS_DESCR
/end CHARACTERISTIC
/begin CHARACTERISTIC InjSys_P2V5I1_HP.tiBreakPkt_M "class instance packet 2 variant 5 / break time for packet coupling" MAP 0x8056B250 RB_Map_S16U16_S16 1310.720 t_q0p04_ms -1310.720 0.00 FORMAT "%8.3" EXTENDED_LIMITS -1310.720 1310.680
 /begin AXIS_DESCR STD_AXIS Epm_nEng EngN 8 -16384.00 16383.50 FORMAT "%8.2" DEPOSIT ABSOLUTE /end AXIS_DESCR
 /begin AXIS_DESCR STD_AXIS InjSys_ratAirMPredLocSp rel_uw_q0p0234 8 0.00 1535.977 FORMAT "%8.3" DEPOSIT ABSOLUTE /end AXIS_DESCR
/end CHARACTERISTIC
/begin CHARACTERISTIC InjSys_P2V6I1_S.facSpltAux1_GM "class instance packet 2 variant 6 / Split factor auxiliary injection 1" MAP 0x8056B2F4 RB_MapGroup_U8 0.9961 fak_ub_b1 0.00 0.9961
 /begin AXIS_DESCR COM_AXIS InjSys_tEngStrt Temp_Cels 8 -3549.940 3003.560 FORMAT "%8.3" AXIS_PTS_REF InjSys_tEngStrt08_AX /end AXIS_DESCR
 /begin AXIS_DESCR COM_AXIS InjSys_nrInjLimdLoc dez 8 0.00 65535.00 FORMAT "%8.2" AXIS_PTS_REF InjSys_nrInj08_AX /end AXIS_DESCR
/end CHARACTERISTIC
/begin CHARACTERISTIC InjSys_P2V6I1_S.facSpltBas_GM "class instance packet 2 variant 6 / split factor base injection" MAP 0x8056B334 RB_MapGroup_U8 0.9961 fak_ub_b1 0.00 0.9961
 /begin AXIS_DESCR COM_AXIS InjSys_tEngStrt Temp_Cels 8 -3549.940 3003.560 FORMAT "%8.3" AXIS_PTS_REF InjSys_tEngStrt08_AX /end AXIS_DESCR
 /begin AXIS_DESCR COM_AXIS InjSys_nrInjLimdLoc dez 8 0.00 65535.00 FORMAT "%8.2" AXIS_PTS_REF InjSys_nrInj08_AX /end AXIS_DESCR
/end CHARACTERISTIC
/begin CHARACTERISTIC InjSys_P2V6I1_S.facTiBreakAux1Corrn_T "class instance packet 2 variant 6 / correction factor pause time auxiliary injection 1" CURVE 0x8056B374 RB_Curve_S16_U8_Static 7.969 fak_ub_b8 0.00 7.969 FORMAT "%5.3"
 /begin AXIS_DESCR STD_AXIS Epm_nEngTooth10ms EngN 4 -16384.00 16383.50 FORMAT "%8.2" DEPOSIT ABSOLUTE /end AXIS_DESCR
/end CHARACTERISTIC
/begin CHARACTERISTIC InjSys_P2V6I1_S.facTiBreakPktCorrn_T "class instance packet 2 variant 6 / correction factor pause time" CURVE 0x8056B382 RB_Curve_S16_U8_Static 7.969 fak_ub_b8 0.00 7.969 FORMAT "%5.3"
 /begin AXIS_DESCR STD_AXIS Epm_nEngTooth10ms EngN 4 -16384.00 16383.50 FORMAT "%8.2" DEPOSIT ABSOLUTE /end AXIS_DESCR
/end CHARACTERISTIC
/begin CHARACTERISTIC InjSys_P2V6I1_S.flgAbsltSplt_C "class instance packet 2 variant 6 / condition split with absolute fuel mass" VALUE 0x8056B390 RB_Val_Wu8 1.00000000000 B_TRUE 0.00 1.00000000000 FORMAT "%13.11" /end CHARACTERISTIC
/begin CHARACTERISTIC InjSys_P2V6I1_S.flgP3Lnk_C "class instance packet 2 variant 6 / link with package 3" VALUE 0x8056B391 RB_Val_Wu8 1.00000000000 B_TRUE 0.00 1.00000000000 FORMAT "%13.11" /end CHARACTERISTIC
/begin CHARACTERISTIC InjSys_P2V6I1_S.ratFuMAux1_GM "class instance packet 2 variant 6 / relative fuel mass auxiliary injection 1" MAP 0x8056B392 RB_MapGroup_U16 3071.953 rel_uw_b3072 0.00 3071.953 FORMAT "%8.3"
 /begin AXIS_DESCR COM_AXIS InjSys_tEngStrt Temp_Cels 8 -3549.940 3003.560 FORMAT "%8.3" AXIS_PTS_REF InjSys_tEngStrt08_AX /end AXIS_DESCR
 /begin AXIS_DESCR COM_AXIS InjSys_nrInjLimdLoc dez 8 0.00 65535.00 FORMAT "%8.2" AXIS_PTS_REF InjSys_nrInj08_AX /end AXIS_DESCR
/end CHARACTERISTIC
/begin CHARACTERISTIC InjSys_P2V6I1_S.ratFuMBas_GM "class instance packet 2 variant 6 / relative fuel mass base injection" MAP 0x8056B412 RB_MapGroup_U16 3071.953 rel_uw_b3072 0.00 3071.953 FORMAT "%8.3"
 /begin AXIS_DESCR COM_AXIS InjSys_tEngStrt Temp_Cels 8 -3549.940 3003.560 FORMAT "%8.3" AXIS_PTS_REF InjSys_tEngStrt08_AX /end AXIS_DESCR
 /begin AXIS_DESCR COM_AXIS InjSys_nrInjLimdLoc dez 8 0.00 65535.00 FORMAT "%8.2" AXIS_PTS_REF InjSys_nrInj08_AX /end AXIS_DESCR
/end CHARACTERISTIC
/begin CHARACTERISTIC InjSys_P2V6I1_S.tiBreakAux1_T "class instance packet 2 variant 6 / pause time auxiliary injection 1" CURVE 0x8056B492 RB_Curve_S16_S16 1310.720 t_q0p04_ms -1310.720 0.00 FORMAT "%8.3" EXTENDED_LIMITS -1310.720 1310.680
 /begin AXIS_DESCR STD_AXIS InjSys_tEngStrt Temp_Cels 4 -3549.940 3003.560 FORMAT "%8.3" DEPOSIT ABSOLUTE /end AXIS_DESCR
/end CHARACTERISTIC
/begin CHARACTERISTIC InjSys_P2V6I1_S.tiBreakPkt_T "class instance packet 2 variant 6 / pause time" CURVE 0x8056B4A4 RB_Curve_S16_S16 1310.680 t_q0p04_ms 0.00 1310.680 FORMAT "%8.3" EXTENDED_LIMITS -1310.720 1310.680
 /begin AXIS_DESCR STD_AXIS InjSys_tEngStrt Temp_Cels 4 -3549.940 3003.560 FORMAT "%8.3" DEPOSIT ABSOLUTE /end AXIS_DESCR
/end CHARACTERISTIC
/begin CHARACTERISTIC InjSys_P3V1I1_SH.agBasDrctStrt_M "class instance packet 3 variant 1 / base angle direct start" MAP 0x8056B4B6 RB_Map_U8U8_S8 382.5 kw_q1p5 -192.0 190.5 FORMAT "%5.1"
 /begin AXIS_DESCR STD_AXIS InjSys_cntrInjLimdSyncS1 dez 3 0.00 255.0 FORMAT "%5.1" DEPOSIT ABSOLUTE /end AXIS_DESCR
 /begin AXIS_DESCR STD_AXIS InjSys_agDrctStrtLocSp kw_q2 3 0.00 510.0 FORMAT "%5.1" DEPOSIT ABSOLUTE /end AXIS_DESCR
/end CHARACTERISTIC
/begin CHARACTERISTIC InjSys_P3V1I1_SH.agBasEthnl_GM "class instance packet 3 variant 1 / ." MAP 0x8056B4C8 RB_MapGroup_U8 191.3 kw_q0p75 0.00 191.3 FORMAT "%5.1"
 /begin AXIS_DESCR COM_AXIS InjSys_nrInjLimdLoc dez 4 0.00 65535.00 FORMAT "%8.2" AXIS_PTS_REF InjSys_nrInj04_AX /end AXIS_DESCR
 /begin AXIS_DESCR COM_AXIS InjSys_tEngStrt Temp_Cels 8 -3549.940 3003.560 FORMAT "%8.3" AXIS_PTS_REF InjSys_tEngStrt08_AX /end AXIS_DESCR
/end CHARACTERISTIC
/begin CHARACTERISTIC InjSys_P3V1I1_SH.agBas_GM "class instance packet 3 variant 1 / base angle" MAP 0x8056B4E8 RB_MapGroup_U8 191.3 kw_q0p75 0.00 191.3 FORMAT "%5.1"
 /begin AXIS_DESCR COM_AXIS InjSys_nrInjLimdLoc dez 4 0.00 65535.00 FORMAT "%8.2" AXIS_PTS_REF InjSys_nrInj04_AX /end AXIS_DESCR
 /begin AXIS_DESCR COM_AXIS InjSys_tEngStrt Temp_Cels 8 -3549.940 3003.560 FORMAT "%8.3" AXIS_PTS_REF InjSys_tEngStrt08_AX /end AXIS_DESCR
/end CHARACTERISTIC
/begin CHARACTERISTIC InjSys_P3V1I1_SH.agDeltaApp_M "class instance packet 3 variant 1 / delta angle driver dependent" MAP 0x8056B508 RB_Map_S16S16_S16 191.2500 kw_q0p75 -96.00000 95.25000 FORMAT "%8.5" EXTENDED_LIMITS -24576.00 24575.25
 /begin AXIS_DESCR STD_AXIS Epm_nEngTooth10ms EngN 6 -16384.00 16383.50 FORMAT "%8.2" DEPOSIT ABSOLUTE /end AXIS_DESCR
 /begin AXIS_DESCR STD_AXIS InjSys_rAppLocSp Prc 6 -400.0000 399.9878 FORMAT "%8.4" DEPOSIT ABSOLUTE /end AXIS_DESCR
/end CHARACTERISTIC
/begin CHARACTERISTIC InjSys_P3V1I1_SH.agDeltaDrctStrtCorrn_T "class instance packet 3 variant 1 / delta angle correction direct start" CURVE 0x8056B56C RB_Curve_S16_S8_Static 382.5 kw_q1p5 -192.0 190.5 FORMAT "%5.1"
 /begin AXIS_DESCR STD_AXIS InjSys_tEngStrt Temp_Cels 3 -3549.940 3003.560 FORMAT "%8.3" DEPOSIT ABSOLUTE /end AXIS_DESCR
/end CHARACTERISTIC
/begin CHARACTERISTIC InjSys_P3V1I1_SH.agDeltaEth_M "class instance packet 3 variant 1 / delta angle ethanol dependent" MAP 0x8056B578 RB_Map_S16S16_S16 191.2500 kw_q0p75 -96.00000 95.25000 FORMAT "%8.5" EXTENDED_LIMITS -24576.00 24575.25
 /begin AXIS_DESCR STD_AXIS InjSys_facEthLnrLocSp fak_ub_b2 4 0.00 1.992188 FORMAT "%8.6" EXTENDED_LIMITS -256.0000 255.9922 DEPOSIT ABSOLUTE /end AXIS_DESCR
 /begin AXIS_DESCR STD_AXIS InjSys_tEngStrt Temp_Cels 4 -3549.940 3003.560 FORMAT "%8.3" DEPOSIT ABSOLUTE /end AXIS_DESCR
/end CHARACTERISTIC
/begin CHARACTERISTIC InjSys_P3V1I1_SH.agDeltaStrtEthnl_T "class instance packet 3 variant 1 / ." CURVE 0x8056B5AC RB_Curve_S16_S8_Static 191.3 kw_q0p75 -96.00 95.25 FORMAT "%5.2"
 /begin AXIS_DESCR STD_AXIS Epm_nEngTooth10ms EngN 4 -16384.00 16383.50 FORMAT "%8.2" DEPOSIT ABSOLUTE /end AXIS_DESCR
/end CHARACTERISTIC
/begin CHARACTERISTIC InjSys_P3V1I1_SH.agDeltaStrt_T "class instance packet 3 variant 1 / delta angle in start" CURVE 0x8056B5BA RB_Curve_S16_S8_Static 191.3 kw_q0p75 -96.00 95.25 FORMAT "%5.2"
 /begin AXIS_DESCR STD_AXIS Epm_nEngTooth10ms EngN 4 -16384.00 16383.50 FORMAT "%8.2" DEPOSIT ABSOLUTE /end AXIS_DESCR
/end CHARACTERISTIC
/begin CHARACTERISTIC InjSys_P3V1I1_SH.facEthnlAgBas_T "class instance packet 3 variant 1 / ." CURVE 0x8056B5C8 RB_Curve_U8_U8 0.9961 fak_ub_b1 0.00 0.9961
 /begin AXIS_DESCR STD_AXIS fethstoeLocSp fak_ub_b2 4 0.00 1.992188 FORMAT "%8.6" DEPOSIT ABSOLUTE /end AXIS_DESCR
/end CHARACTERISTIC
/begin CHARACTERISTIC InjSys_P3V1I1_SH.flgIgnCoupld_C "class instance packet 3 variant 1 / condition ignition coupled" VALUE 0x8056B5D1 RB_Val_Wu8 1.00000000000 B_TRUE 0.00 1.00000000000 FORMAT "%13.11" /end CHARACTERISTIC
/begin CHARACTERISTIC InjSys_P3V2I1_SH.agAux1DeltaDrctStrtCorrn_T "class instance packet 3 variant 2 / delta angle correction auxiliary injection 1 direct start" CURVE 0x8056B5D2 RB_Curve_S16_S8_Static 382.5 kw_q1p5 -192.0 190.5 FORMAT "%5.1"
 /begin AXIS_DESCR STD_AXIS InjSys_tEngStrt Temp_Cels 3 -3549.940 3003.560 FORMAT "%8.3" DEPOSIT ABSOLUTE /end AXIS_DESCR
/end CHARACTERISTIC
/begin CHARACTERISTIC InjSys_P3V2I1_SH.agAux1DeltaEth_M "class instance packet 3 variant 2 / delta angle auxiliary injection 1 ethanol" MAP 0x8056B5DE RB_Map_S16S16_S16 191.2500 kw_q0p75 -96.00000 95.25000 FORMAT "%8.5" EXTENDED_LIMITS -24576.00 24575.25
 /begin AXIS_DESCR STD_AXIS InjSys_facEthLnrLocSp fak_ub_b2 4 0.00 1.992188 FORMAT "%8.6" EXTENDED_LIMITS -256.0000 255.9922 DEPOSIT ABSOLUTE /end AXIS_DESCR
 /begin AXIS_DESCR STD_AXIS InjSys_tEngStrt Temp_Cels 4 -3549.940 3003.560 FORMAT "%8.3" DEPOSIT ABSOLUTE /end AXIS_DESCR
/end CHARACTERISTIC
/begin CHARACTERISTIC InjSys_P3V2I1_SH.agAux1DeltaStrt_T "class instance packet 3 variant 2 / delta angle auxiliary injection 1 in start" CURVE 0x8056B612 RB_Curve_S16_S8_Static 191.3 kw_q0p75 -96.00 95.25 FORMAT "%5.2"
 /begin AXIS_DESCR STD_AXIS Epm_nEngTooth10ms EngN 4 -16384.00 16383.50 FORMAT "%8.2" DEPOSIT ABSOLUTE /end AXIS_DESCR
/end CHARACTERISTIC
/begin CHARACTERISTIC InjSys_P3V2I1_SH.agAux1DrctStrt_M "class instance packet 3 variant 2 / angle auxiliary injection 1 direct start" MAP 0x8056B620 RB_Map_U8U8_S8 382.5 kw_q1p5 -192.0 190.5 FORMAT "%5.1"
 /begin AXIS_DESCR STD_AXIS InjSys_cntrInjLimdSyncS1 dez 3 0.00 255.0 FORMAT "%5.1" DEPOSIT ABSOLUTE /end AXIS_DESCR
 /begin AXIS_DESCR STD_AXIS InjSys_agDrctStrtLocSp kw_q2 3 0.00 510.0 FORMAT "%5.1" DEPOSIT ABSOLUTE /end AXIS_DESCR
/end CHARACTERISTIC
/begin CHARACTERISTIC InjSys_P3V2I1_SH.agAux1_GM "class instance packet 3 variant 2 / angle auxiliary injection 1" MAP 0x8056B632 RB_MapGroup_S8 382.5 kw_q1p5 -192.0 190.5 FORMAT "%5.1"
 /begin AXIS_DESCR COM_AXIS InjSys_nrInjLimdLoc dez 4 0.00 65535.00 FORMAT "%8.2" AXIS_PTS_REF InjSys_nrInj04_AX /end AXIS_DESCR
 /begin AXIS_DESCR COM_AXIS InjSys_tEngStrt Temp_Cels 8 -3549.940 3003.560 FORMAT "%8.3" AXIS_PTS_REF InjSys_tEngStrt08_AX /end AXIS_DESCR
/end CHARACTERISTIC
/begin CHARACTERISTIC InjSys_P3V2I1_SH.agBasDrctStrt_M "class instance packet 3 variant 2 / base angle direct start" MAP 0x8056B652 RB_Map_U8U8_S8 382.5 kw_q1p5 -192.0 190.5 FORMAT "%5.1"
 /begin AXIS_DESCR STD_AXIS InjSys_cntrInjLimdSyncS1 dez 3 0.00 255.0 FORMAT "%5.1" DEPOSIT ABSOLUTE /end AXIS_DESCR
 /begin AXIS_DESCR STD_AXIS InjSys_agDrctStrtLocSp kw_q2 3 0.00 510.0 FORMAT "%5.1" DEPOSIT ABSOLUTE /end AXIS_DESCR
/end CHARACTERISTIC
/begin CHARACTERISTIC InjSys_P3V2I1_SH.agBasEthnlVers2_T "class instance packet 3 variant 2 / ." CURVE 0x8056B664 RB_Curve_S16_S8_Static 191.3 kw_q0p75 -96.00 95.25 FORMAT "%5.2"
 /begin AXIS_DESCR STD_AXIS Epm_nEngTooth10ms EngN 4 -16384.00 16383.50 FORMAT "%8.2" DEPOSIT ABSOLUTE /end AXIS_DESCR
/end CHARACTERISTIC
/begin CHARACTERISTIC InjSys_P3V2I1_SH.agBasEthnl_GM "class instance packet 3 variant 2 / ." MAP 0x8056B672 RB_MapGroup_U8 191.3 kw_q0p75 0.00 191.3 FORMAT "%5.1"
 /begin AXIS_DESCR COM_AXIS InjSys_nrInjLimdLoc dez 4 0.00 65535.00 FORMAT "%8.2" AXIS_PTS_REF InjSys_nrInj04_AX /end AXIS_DESCR
 /begin AXIS_DESCR COM_AXIS InjSys_tEngStrt Temp_Cels 8 -3549.940 3003.560 FORMAT "%8.3" AXIS_PTS_REF InjSys_tEngStrt08_AX /end AXIS_DESCR
/end CHARACTERISTIC
/begin CHARACTERISTIC InjSys_P3V2I1_SH.agBas_GM "class instance packet 3 variant 2 / base angle" MAP 0x8056B692 RB_MapGroup_U8 191.3 kw_q0p75 0.00 191.3 FORMAT "%5.1"
 /begin AXIS_DESCR COM_AXIS InjSys_nrInjLimdLoc dez 4 0.00 65535.00 FORMAT "%8.2" AXIS_PTS_REF InjSys_nrInj04_AX /end AXIS_DESCR
 /begin AXIS_DESCR COM_AXIS InjSys_tEngStrt Temp_Cels 8 -3549.940 3003.560 FORMAT "%8.3" AXIS_PTS_REF InjSys_tEngStrt08_AX /end AXIS_DESCR
/end CHARACTERISTIC
/begin CHARACTERISTIC InjSys_P3V2I1_SH.agDeltaApp_M "class instance packet 3 variant 2 / delta angle driver dependent" MAP 0x8056B6B2 RB_Map_S16S16_S16 191.2500 kw_q0p75 -96.00000 95.25000 FORMAT "%8.5" EXTENDED_LIMITS -24576.00 24575.25
 /begin AXIS_DESCR STD_AXIS Epm_nEngTooth10ms EngN 6 -16384.00 16383.50 FORMAT "%8.2" DEPOSIT ABSOLUTE /end AXIS_DESCR
 /begin AXIS_DESCR STD_AXIS InjSys_rAppLocSp Prc 6 -400.0000 399.9878 FORMAT "%8.4" DEPOSIT ABSOLUTE /end AXIS_DESCR
/end CHARACTERISTIC
/begin CHARACTERISTIC InjSys_P3V2I1_SH.agDeltaDrctStrtCorrn_T "class instance packet 3 variant 2 / delta angle correction direct start" CURVE 0x8056B716 RB_Curve_S16_S8_Static 382.5 kw_q1p5 -192.0 190.5 FORMAT "%5.1"
 /begin AXIS_DESCR STD_AXIS InjSys_tEngStrt Temp_Cels 3 -3549.940 3003.560 FORMAT "%8.3" DEPOSIT ABSOLUTE /end AXIS_DESCR
/end CHARACTERISTIC
/begin CHARACTERISTIC InjSys_P3V2I1_SH.agDeltaEth_M "class instance packet 3 variant 2 / delta angle ethanol dependent" MAP 0x8056B722 RB_Map_S16S16_S16 191.2500 kw_q0p75 -96.00000 95.25000 FORMAT "%8.5" EXTENDED_LIMITS -24576.00 24575.25
 /begin AXIS_DESCR STD_AXIS InjSys_facEthLnrLocSp fak_ub_b2 4 0.00 1.992188 FORMAT "%8.6" EXTENDED_LIMITS -256.0000 255.9922 DEPOSIT ABSOLUTE /end AXIS_DESCR
 /begin AXIS_DESCR STD_AXIS InjSys_tEngStrt Temp_Cels 4 -3549.940 3003.560 FORMAT "%8.3" DEPOSIT ABSOLUTE /end AXIS_DESCR
/end CHARACTERISTIC
/begin CHARACTERISTIC InjSys_P3V2I1_SH.agDeltaStrt_T "class instance packet 3 variant 2 / delta angle in start" CURVE 0x8056B756 RB_Curve_S16_S8_Static 191.3 kw_q0p75 -96.00 95.25 FORMAT "%5.2"
 /begin AXIS_DESCR STD_AXIS Epm_nEngTooth10ms EngN 4 -16384.00 16383.50 FORMAT "%8.2" DEPOSIT ABSOLUTE /end AXIS_DESCR
/end CHARACTERISTIC
/begin CHARACTERISTIC InjSys_P3V2I1_SH.facEthnlAux1_T "class instance packet 3 variant 2 / ." CURVE 0x8056B764 RB_Curve_U8_U8 0.9961 fak_ub_b1 0.00 0.9961
 /begin AXIS_DESCR STD_AXIS fethstoeLocSp fak_ub_b2 4 0.00 1.992188 FORMAT "%8.6" DEPOSIT ABSOLUTE /end AXIS_DESCR
/end CHARACTERISTIC
/begin CHARACTERISTIC InjSys_P3V2I1_SH.facEthnlBas_T "class instance packet 3 variant 2 / ." CURVE 0x8056B76D RB_Curve_U8_U8 0.9961 fak_ub_b1 0.00 0.9961
 /begin AXIS_DESCR STD_AXIS fethstoeLocSp fak_ub_b2 4 0.00 1.992188 FORMAT "%8.6" DEPOSIT ABSOLUTE /end AXIS_DESCR
/end CHARACTERISTIC
/begin CHARACTERISTIC InjSys_P3V2I1_SH.facEthnlagBas_T "class instance packet 3 variant 2 / ." CURVE 0x8056B776 RB_Curve_U8_U8 0.9961 fak_ub_b1 0.00 0.9961
 /begin AXIS_DESCR STD_AXIS fethstoeLocSp fak_ub_b2 4 0.00 1.992188 FORMAT "%8.6" DEPOSIT ABSOLUTE /end AXIS_DESCR
/end CHARACTERISTIC
/begin CHARACTERISTIC InjSys_P3V2I1_SH.facSpltAux1Ethnl_GM "class instance packet 3 variant 2 / ." MAP 0x8056B77F RB_MapGroup_U8 0.9961 fak_ub_b1 0.00 0.9961
 /begin AXIS_DESCR COM_AXIS InjSys_tEngStrt Temp_Cels 8 -3549.940 3003.560 FORMAT "%8.3" AXIS_PTS_REF InjSys_tEngStrt08_AX /end AXIS_DESCR
 /begin AXIS_DESCR COM_AXIS InjSys_nrInjLimdLoc dez 8 0.00 65535.00 FORMAT "%8.2" AXIS_PTS_REF InjSys_nrInj08_AX /end AXIS_DESCR
/end CHARACTERISTIC
/begin CHARACTERISTIC InjSys_P3V2I1_SH.facSpltAux1_GM "class instance packet 3 variant 2 / split factor auxiliary injection 1" MAP 0x8056B7BF RB_MapGroup_U8 0.9961 fak_ub_b1 0.00 0.9961
 /begin AXIS_DESCR COM_AXIS InjSys_tEngStrt Temp_Cels 8 -3549.940 3003.560 FORMAT "%8.3" AXIS_PTS_REF InjSys_tEngStrt08_AX /end AXIS_DESCR
 /begin AXIS_DESCR COM_AXIS InjSys_nrInjLimdLoc dez 8 0.00 65535.00 FORMAT "%8.2" AXIS_PTS_REF InjSys_nrInj08_AX /end AXIS_DESCR
/end CHARACTERISTIC
/begin CHARACTERISTIC InjSys_P3V2I1_SH.facSpltBasEthnl_GM "class instance packet 3 variant 2 / ." MAP 0x8056B7FF RB_MapGroup_U8 0.9961 fak_ub_b1 0.00 0.9961
 /begin AXIS_DESCR COM_AXIS InjSys_tEngStrt Temp_Cels 8 -3549.940 3003.560 FORMAT "%8.3" AXIS_PTS_REF InjSys_tEngStrt08_AX /end AXIS_DESCR
 /begin AXIS_DESCR COM_AXIS InjSys_nrInjLimdLoc dez 8 0.00 65535.00 FORMAT "%8.2" AXIS_PTS_REF InjSys_nrInj08_AX /end AXIS_DESCR
/end CHARACTERISTIC
/begin CHARACTERISTIC InjSys_P3V2I1_SH.facSpltBas_GM "class instance packet 3 variant 2 / split factor base injection" MAP 0x8056B83F RB_MapGroup_U8 0.9961 fak_ub_b1 0.00 0.9961
 /begin AXIS_DESCR COM_AXIS InjSys_tEngStrt Temp_Cels 8 -3549.940 3003.560 FORMAT "%8.3" AXIS_PTS_REF InjSys_tEngStrt08_AX /end AXIS_DESCR
 /begin AXIS_DESCR COM_AXIS InjSys_nrInjLimdLoc dez 8 0.00 65535.00 FORMAT "%8.2" AXIS_PTS_REF InjSys_nrInj08_AX /end AXIS_DESCR
/end CHARACTERISTIC
/begin CHARACTERISTIC InjSys_P3V2I1_SH.facTiBreakAux1Corrn_T "class instance packet 3 variant 2 / pause time correction factor auxiliary injection 1" CURVE 0x8056B880 RB_Curve_S16_U8_Static 7.969 fak_ub_b8 0.00 7.969 FORMAT "%5.3"
 /begin AXIS_DESCR STD_AXIS Epm_nEngTooth10ms EngN 4 -16384.00 16383.50 FORMAT "%8.2" DEPOSIT ABSOLUTE /end AXIS_DESCR
/end CHARACTERISTIC
/begin CHARACTERISTIC InjSys_P3V2I1_SH.flgAbsltSplt_C "class instance packet 3 variant 2 / condition split with absolute fuel mass" VALUE 0x8056B88E RB_Val_Wu8 1.00000000000 B_TRUE 0.00 1.00000000000 FORMAT "%13.11" /end CHARACTERISTIC
/begin CHARACTERISTIC InjSys_P3V2I1_SH.flgAgAux1_C "class instance packet 3 variant 2 / condition angle for auxiliary injection 1" VALUE 0x8056B88F RB_Val_Wu8 1.00000000000 B_TRUE 0.00 1.00000000000 FORMAT "%13.11" /end CHARACTERISTIC
/begin CHARACTERISTIC InjSys_P3V2I1_SH.flgIgnCoupld_C "class instance packet 3 variant 2 / condition ignition coupled" VALUE 0x8056B890 RB_Val_Wu8 1.00000000000 B_TRUE 0.00 1.00000000000 FORMAT "%13.11" /end CHARACTERISTIC
/begin CHARACTERISTIC InjSys_P3V2I1_SH.ratFuMAux1_GM "class instance packet 3 variant 2 / relative fuel mass auxiliary injection 1" MAP 0x8056B892 RB_MapGroup_U16 3071.953 rel_uw_b3072 0.00 3071.953 FORMAT "%8.3"
 /begin AXIS_DESCR COM_AXIS InjSys_tEngStrt Temp_Cels 8 -3549.940 3003.560 FORMAT "%8.3" AXIS_PTS_REF InjSys_tEngStrt08_AX /end AXIS_DESCR
 /begin AXIS_DESCR COM_AXIS InjSys_nrInjLimdLoc dez 8 0.00 65535.00 FORMAT "%8.2" AXIS_PTS_REF InjSys_nrInj08_AX /end AXIS_DESCR
/end CHARACTERISTIC
/begin CHARACTERISTIC InjSys_P3V2I1_SH.ratFuMBas_GM "class instance packet 3 variant 2 / relative fuel mass base injection" MAP 0x8056B912 RB_MapGroup_U16 3071.953 rel_uw_b3072 0.00 3071.953 FORMAT "%8.3"
 /begin AXIS_DESCR COM_AXIS InjSys_tEngStrt Temp_Cels 8 -3549.940 3003.560 FORMAT "%8.3" AXIS_PTS_REF InjSys_tEngStrt08_AX /end AXIS_DESCR
 /begin AXIS_DESCR COM_AXIS InjSys_nrInjLimdLoc dez 8 0.00 65535.00 FORMAT "%8.2" AXIS_PTS_REF InjSys_nrInj08_AX /end AXIS_DESCR
/end CHARACTERISTIC
/begin AXIS_PTS InjSys_ratAirM08_AX "base point distribution relative air mass with 8 base points" 0x805586E8 InjSys_ratAirMAxisInp RB_Axis_U16 1535.977 rel_uw_q0p0234 8 0.00 1535.977 FORMAT "%8.3" DEPOSIT ABSOLUTE /end AXIS_PTS
/begin AXIS_PTS InjSys_ratAirM12AgSpHspVers2_AX "base point distribution relative air mass with 12 base points (Version 2 HSP Mode)" 0x805586FA InjSys_ratAirMAgSpVers2AxisInp RB_Axis_U16 1535.977 rel_uw_q0p0234 12 0.00 1535.977 FORMAT "%8.3" DEPOSIT ABSOLUTE /end AXIS_PTS
/begin AXIS_PTS InjSys_ratAirM12AgSpHsp_AX "base point distribution relative air mass with 12 base points (HSP Mode)" 0x80558714 InjSys_ratAirMAgSpAxisInp RB_Axis_U16 1535.977 rel_uw_q0p0234 12 0.00 1535.977 FORMAT "%8.3" DEPOSIT ABSOLUTE /end AXIS_PTS
/begin AXIS_PTS InjSys_ratAirM12AgSp_AX "base point distribution relative air mass with 12 base points" 0x80558748 InjSys_ratAirMAgSpAxisInp RB_Axis_U16 1535.977 rel_uw_q0p0234 12 0.00 1535.977 FORMAT "%8.3" DEPOSIT ABSOLUTE /end AXIS_PTS
/begin AXIS_PTS InjSys_ratAirM12Vers2_AX "base point distribution relative air mass with 12 base points" 0x8055877C InjSys_ratAirMVers2AxisInp RB_Axis_U16 1535.977 rel_uw_q0p0234 12 0.00 1535.977 FORMAT "%8.3" DEPOSIT ABSOLUTE /end AXIS_PTS
/begin AXIS_PTS InjSys_ratAirM12_AX "base point distribution relative air mass with 12 base points" 0x80558796 InjSys_ratAirMAxisInp RB_Axis_U16 1535.977 rel_uw_q0p0234 12 0.00 1535.977 FORMAT "%8.3" DEPOSIT ABSOLUTE /end AXIS_PTS
/begin AXIS_PTS InjSys_tCat08_AX "Group axis for cat Temperature" 0x805587B8 ExhMod_tCat1B1 RB_Axis_S16 6553.500 Temp_Cels 8 -3549.940 3003.560 FORMAT "%8.3" DEPOSIT ABSOLUTE /end AXIS_PTS
/begin AXIS_PTS InjSys_tEng08_AX "base point distribution for engine temperature with 8 base points" 0x805587CA InjSys_tEng RB_Axis_S16 6553.500 Temp_Cels 8 -3549.940 3003.560 FORMAT "%8.3" DEPOSIT ABSOLUTE /end AXIS_PTS
/begin AXIS_PTS InjSys_tEngStrt08_AX "Base point distribution for engine temperature at start with 8 base points" 0x805587DC InjSys_tEngStrt RB_Axis_S16 6553.500 Temp_Cels 8 -3549.940 3003.560 FORMAT "%8.3" DEPOSIT ABSOLUTE /end AXIS_PTS
/begin AXIS_PTS InjSys_tosp08_AX "base point distribution for oil temperature with 8 base points" 0x805587EE InjSys_tOilSp RB_Axis_S16 6553.500 Temp_Cels 8 -3549.940 3003.560 FORMAT "%8.3" DEPOSIT ABSOLUTE /end AXIS_PTS
/begin FUNCTION InjSyG_InjSp "159.0.0   Injection Setpoints"
 /begin DEF_CHARACTERISTIC InjSys_P1V4I6_HP.facWghtColdWrmEthnl_M InjSys_P1V4I6_HP.facWghtColdWrm_M InjSys_P1V4I6_HP.facWghtTHsp_M InjSys_P1V4I6_HP.facWhgtWrmColdHsp_GM InjSys_P1V4I6_HP.flgAxVers_C InjSys_P1V5I1_SHO.agBas_GM InjSys_P1V5I1_SHO.agBgnCalc_M InjSys_P1V5I1_SHO.agBgnRstrtCld_M InjSys_P1V5I1_SHO.agDeltaEth_M InjSys_P1V5I1_SHO.agDeltaStrt_T InjSys_P1V5I1_SHO.flgVerCalc InjSys_P1V5I2_SHO.agBas_GM InjSys_P1V5I2_SHO.agBgnCalc_M InjSys_P1V5I2_SHO.agBgnRstrtCld_M InjSys_P1V5I2_SHO.agDeltaEth_M InjSys_P1V5I2_SHO.agDeltaStrt_T InjSys_P1V5I2_SHO.flgVerCalc InjSys_P1V6I1_SHO.agBas_GM InjSys_P1V6I1_SHO.agDeltaEth_M InjSys_P1V6I1_SHO.agDeltaStrt_T InjSys_P1V6I1_SHO.facSpltAux1_GT InjSys_P1V6I1_SHO.flgAbsltSplt_C InjSys_P1V6I1_SHO.ratFuMAux1_GT InjSys_P1V6I1_SHO.tiBreakAux1_T InjSys_P1V7I1_SHO.agAux1_GM InjSys_P1V7I1_SHO.agAux2_GM InjSys_P1V7I1_SHO.agBas_GM InjSys_P1V7I1_SHO.agDeltaAux1Eth_M InjSys_P1V7I1_SHO.agDeltaAux1Strt_T InjSys_P1V7I1_SHO.agDeltaAux2Eth_M InjSys_P1V7I1_SHO.agDeltaAux2Strt_T InjSys_P1V7I1_SHO.agDeltaEth_M InjSys_P1V7I1_SHO.agDeltaStrt_T InjSys_P1V7I1_SHO.facSpltAux1_GT InjSys_P1V7I1_SHO.facSpltAux2_GT InjSys_P1V7I1_SHO.flgAbsltSplt_C InjSys_P1V7I1_SHO.flgAgAux_C InjSys_P1V7I1_SHO.ratFuMAux1_GT InjSys_P1V7I1_SHO.ratFuMAux2_GT InjSys_P1V7I1_SHO.stAgEnd_C InjSys_P1V7I1_SHO.tiBreakAux_T InjSys_P2APPL.agAux1_C InjSys_P2APPL.agAux2_C InjSys_P2APPL.agBas_C InjSys_P2APPL.facSpltAux1_C InjSys_P2APPL.facSpltAux2_C InjSys_P2APPL.facSpltPkt_C InjSys_P2APPL.flgAbsltSplt_C InjSys_P2APPL.flgAgAux_C InjSys_P2APPL.flgAgEnd_C InjSys_P2APPL.flgPktCoupl_C InjSys_P2APPL.ratFuMAux1_C InjSys_P2APPL.ratFuMAux2_C InjSys_P2APPL.ratFuMBas_C InjSys_P2APPL.stAgEnd_C InjSys_P2APPL.tiBreakAux1_C InjSys_P2APPL.tiBreakAux2_C InjSys_P2APPL.tiBreakPkt_C InjSys_P2V1I1_HP.agBasHiEthnl_GM InjSys_P2V1I1_HP.agBasHiVers2Ethnl_GM InjSys_P2V1I1_HP.agBasHiVers2_GM InjSys_P2V1I1_HP.agBasHi_GM InjSys_P2V1I1_HP.agBasLoEthnl_GM InjSys_P2V1I1_HP.agBasLoVers2Ethnl_GM InjSys_P2V1I1_HP.agBasLoVers2_GM InjSys_P2V1I1_HP.agBasLo_GM InjSys_P2V1I1_HP.agBasTPistColdVers2_GM InjSys_P2V1I1_HP.agBasTPistCold_GM InjSys_P2V1I1_HP.agBasTPistWrmVers2_GM InjSys_P2V1I1_HP.agBasTPistWrm_GM InjSys_P2V1I1_HP.facEthnlAgBas_T InjSys_P2V1I1_HP.facEthnlAgBgn_T InjSys_P2V1I1_HP.facFuMBasHiEthnl_GM InjSys_P2V1I1_HP.facFuMBasLoEthnl_GM InjSys_P2V1I1_HP.facSpltBasCorrnLoT_GM InjSys_P2V1I1_HP.facSpltBasHiExtd_GM InjSys_P2V1I1_HP.facSpltBasHi_GM InjSys_P2V1I1_HP.facSpltBasLoEthnl_GM InjSys_P2V1I1_HP.facSpltBasLoExtd_GM InjSys_P2V1I1_HP.facSpltBasLo_GM InjSys_P2V1I1_HP.facTInjAgEthnl_M InjSys_P2V1I1_HP.facTInjAg_M InjSys_P2V1I1_HP.facTPistCold_M InjSys_P2V1I1_HP.facTPist_M InjSys_P2V1I1_HP.facWghtAgBasTEthnl_M InjSys_P2V1I1_HP.facWghtAgBasT_M InjSys_P2V1I1_HP.facWghtSpltBasTFuEthnl_GM InjSys_P2V1I1_HP.facWghtSpltBasTFu_GM InjSys_P2V1I1_HP.facWghtSpltOilTEthnl_GM InjSys_P2V1I1_HP.facWghtSpltOilT_GM InjSys_P2V1I1_HP.flgAbsltSplt_C InjSys_P2V1I1_HP.flgAgCalc_C InjSys_P2V1I1_HP.flgAgEnd_C InjSys_P2V1I1_HP.flgAxVers_C InjSys_P2V1I1_HP.flgPktCoupl_C InjSys_P2V1I1_HP.ratFuMBasHi_GM InjSys_P2V1I1_HP.ratFuMBasLo_GM InjSys_P2V1I1_HP.stAgFacTInj_C InjSys_P2V1I1_HP.stfacWghtSpltT_C InjSys_P2V1I1_HP.tiBreakPkt_M InjSys_P2V1I2_HP.agBasHiEthnl_GM InjSys_P2V1I2_HP.agBasHiVers2Ethnl_GM InjSys_P2V1I2_HP.agBasHiVers2_GM InjSys_P2V1I2_HP.agBasHi_GM InjSys_P2V1I2_HP.agBasLoEthnl_GM InjSys_P2V1I2_HP.agBasLoVers2Ethnl_GM InjSys_P2V1I2_HP.agBasLoVers2_GM InjSys_P2V1I2_HP.agBasLo_GM InjSys_P2V1I2_HP.agBasTPistColdVers2_GM InjSys_P2V1I2_HP.agBasTPistCold_GM InjSys_P2V1I2_HP.agBasTPistWrmVers2_GM InjSys_P2V1I2_HP.agBasTPistWrm_GM InjSys_P2V1I2_HP.facEthnlAgBas_T InjSys_P2V1I2_HP.facEthnlAgBgn_T InjSys_P2V1I2_HP.facFuMBasHiEthnl_GM InjSys_P2V1I2_HP.facFuMBasLoEthnl_GM InjSys_P2V1I2_HP.facSpltBasCorrnLoT_GM InjSys_P2V1I2_HP.facSpltBasHiExtd_GM InjSys_P2V1I2_HP.facSpltBasHi_GM InjSys_P2V1I2_HP.facSpltBasLoEthnl_GM InjSys_P2V1I2_HP.facSpltBasLoExtd_GM InjSys_P2V1I2_HP.facSpltBasLo_GM InjSys_P2V1I2_HP.facTInjAgEthnl_M InjSys_P2V1I2_HP.facTInjAg_M InjSys_P2V1I2_HP.facTPistCold_M InjSys_P2V1I2_HP.facTPist_M InjSys_P2V1I2_HP.facWghtAgBasTEthnl_M InjSys_P2V1I2_HP.facWghtAgBasT_M InjSys_P2V1I2_HP.facWghtSpltBasTFuEthnl_GM InjSys_P2V1I2_HP.facWghtSpltBasTFu_GM InjSys_P2V1I2_HP.facWghtSpltOilTEthnl_GM InjSys_P2V1I2_HP.facWghtSpltOilT_GM InjSys_P2V1I2_HP.flgAbsltSplt_C InjSys_P2V1I2_HP.flgAgCalc_C InjSys_P2V1I2_HP.flgAgEnd_C InjSys_P2V1I2_HP.flgAxVers_C InjSys_P2V1I2_HP.flgPktCoupl_C InjSys_P2V1I2_HP.ratFuMBasHi_GM InjSys_P2V1I2_HP.ratFuMBasLo_GM InjSys_P2V1I2_HP.stAgFacTInj_C InjSys_P2V1I2_HP.stfacWghtSpltT_C InjSys_P2V1I2_HP.tiBreakPkt_M InjSys_P2V1I3_HP.agBasHiEthnl_GM InjSys_P2V1I3_HP.agBasHiVers2Ethnl_GM InjSys_P2V1I3_HP.agBasHiVers2_GM InjSys_P2V1I3_HP.agBasHi_GM InjSys_P2V1I3_HP.agBasLoEthnl_GM InjSys_P2V1I3_HP.agBasLoVers2Ethnl_GM InjSys_P2V1I3_HP.agBasLoVers2_GM InjSys_P2V1I3_HP.agBasLo_GM InjSys_P2V1I3_HP.agBasTPistColdVers2_GM InjSys_P2V1I3_HP.agBasTPistCold_GM InjSys_P2V1I3_HP.agBasTPistWrmVers2_GM InjSys_P2V1I3_HP.agBasTPistWrm_GM InjSys_P2V1I3_HP.facEthnlAgBas_T InjSys_P2V1I3_HP.facEthnlAgBgn_T InjSys_P2V1I3_HP.facFuMBasHiEthnl_GM InjSys_P2V1I3_HP.facFuMBasLoEthnl_GM InjSys_P2V1I3_HP.facSpltBasCorrnLoT_GM InjSys_P2V1I3_HP.facSpltBasHiExtd_GM InjSys_P2V1I3_HP.facSpltBasHi_GM InjSys_P2V1I3_HP.facSpltBasLoEthnl_GM InjSys_P2V1I3_HP.facSpltBasLoExtd_GM InjSys_P2V1I3_HP.facSpltBasLo_GM InjSys_P2V1I3_HP.facTInjAgEthnl_M InjSys_P2V1I3_HP.facTInjAg_M InjSys_P2V1I3_HP.facTPistCold_M InjSys_P2V1I3_HP.facTPist_M InjSys_P2V1I3_HP.facWghtAgBasTEthnl_M InjSys_P2V1I3_HP.facWghtAgBasT_M InjSys_P2V1I3_HP.facWghtSpltBasTFuEthnl_GM InjSys_P2V1I3_HP.facWghtSpltBasTFu_GM InjSys_P2V1I3_HP.facWghtSpltOilTEthnl_GM InjSys_P2V1I3_HP.facWghtSpltOilT_GM InjSys_P2V1I3_HP.flgAbsltSplt_C InjSys_P2V1I3_HP.flgAgCalc_C InjSys_P2V1I3_HP.flgAgEnd_C InjSys_P2V1I3_HP.flgAxVers_C InjSys_P2V1I3_HP.flgPktCoupl_C InjSys_P2V1I3_HP.ratFuMBasHi_GM InjSys_P2V1I3_HP.ratFuMBasLo_GM InjSys_P2V1I3_HP.stAgFacTInj_C InjSys_P2V1I3_HP.stfacWghtSpltT_C InjSys_P2V1I3_HP.tiBreakPkt_M InjSys_P2V2I1_HP.agBasHiEthnl_GM InjSys_P2V2I1_HP.agBasHiVers2Ethnl_GM InjSys_P2V2I1_HP.agBasHiVers2_GM InjSys_P2V2I1_HP.agBasHi_GM InjSys_P2V2I1_HP.agBasLoEthnl_GM InjSys_P2V2I1_HP.agBasLoVers2Ethnl_GM InjSys_P2V2I1_HP.agBasLoVers2_GM InjSys_P2V2I1_HP.agBasLo_GM InjSys_P2V2I1_HP.agBasTPistColdVers2_GM InjSys_P2V2I1_HP.agBasTPistCold_GM InjSys_P2V2I1_HP.agBasTPistWrmVers2_GM InjSys_P2V2I1_HP.agBasTPistWrm_GM InjSys_P2V2I1_HP.facEthnlAgBas_T InjSys_P2V2I1_HP.facSpltAux1CorrnLoT_GM InjSys_P2V2I1_HP.facSpltAux1HiExtd_GM InjSys_P2V2I1_HP.facSpltAux1Hi_GM InjSys_P2V2I1_HP.facSpltAux1LoExtd_GM InjSys_P2V2I1_HP.facSpltAux1Lo_GM InjSys_P2V2I1_HP.facSpltCorrnLoT_GM InjSys_P2V2I1_HP.facSpltPktHiExtd_GM InjSys_P2V2I1_HP.facSpltPktHi_GM InjSys_P2V2I1_HP.facSpltPktLoExtd_GM InjSys_P2V2I1_HP.facSpltPktLo_GM InjSys_P2V2I1_HP.facTInjAgEthnl_M InjSys_P2V2I1_HP.facTInjAg_M InjSys_P2V2I1_HP.facTPistCold_M InjSys_P2V2I1_HP.facTPist_M InjSys_P2V2I1_HP.facWghtAgBasTEthnl_M InjSys_P2V2I1_HP.facWghtAgBasT_M InjSys_P2V2I1_HP.facWghtSpltOilT_GM InjSys_P2V2I1_HP.facWghtSpltT_GM InjSys_P2V2I1_HP.flgAbsltSplt_C InjSys_P2V2I1_HP.flgAgEnd_C InjSys_P2V2I1_HP.flgAxVers_C InjSys_P2V2I1_HP.flgPktCoupl_C InjSys_P2V2I1_HP.ratFuMAux1Hi_GM InjSys_P2V2I1_HP.ratFuMAux1Lo_GM InjSys_P2V2I1_HP.ratFuMBasHi_GM InjSys_P2V2I1_HP.ratFuMBasLo_GM InjSys_P2V2I1_HP.stAgFacTInj_C InjSys_P2V2I1_HP.stfacWghtSpltT_C InjSys_P2V2I1_HP.tiBreakAux1_M InjSys_P2V2I1_HP.tiBreakPkt_M InjSys_P2V2I2_HP.agBasHiEthnl_GM InjSys_P2V2I2_HP.agBasHiVers2Ethnl_GM InjSys_P2V2I2_HP.agBasHiVers2_GM InjSys_P2V2I2_HP.agBasHi_GM InjSys_P2V2I2_HP.agBasLoEthnl_GM InjSys_P2V2I2_HP.agBasLoVers2Ethnl_GM InjSys_P2V2I2_HP.agBasLoVers2_GM InjSys_P2V2I2_HP.agBasLo_GM InjSys_P2V2I2_HP.agBasTPistColdVers2_GM InjSys_P2V2I2_HP.agBasTPistCold_GM InjSys_P2V2I2_HP.agBasTPistWrmVers2_GM InjSys_P2V2I2_HP.agBasTPistWrm_GM InjSys_P2V2I2_HP.facEthnlAgBas_T InjSys_P2V2I2_HP.facSpltAux1CorrnLoT_GM InjSys_P2V2I2_HP.facSpltAux1HiExtd_GM InjSys_P2V2I2_HP.facSpltAux1Hi_GM InjSys_P2V2I2_HP.facSpltAux1LoExtd_GM InjSys_P2V2I2_HP.facSpltAux1Lo_GM InjSys_P2V2I2_HP.facSpltCorrnLoT_GM InjSys_P2V2I2_HP.facSpltPktHiExtd_GM InjSys_P2V2I2_HP.facSpltPktHi_GM InjSys_P2V2I2_HP.facSpltPktLoExtd_GM InjSys_P2V2I2_HP.facSpltPktLo_GM InjSys_P2V2I2_HP.facTInjAgEthnl_M InjSys_P2V2I2_HP.facTInjAg_M InjSys_P2V2I2_HP.facTPistCold_M InjSys_P2V2I2_HP.facTPist_M InjSys_P2V2I2_HP.facWghtAgBasTEthnl_M InjSys_P2V2I2_HP.facWghtAgBasT_M InjSys_P2V2I2_HP.facWghtSpltOilT_GM InjSys_P2V2I2_HP.facWghtSpltT_GM InjSys_P2V2I2_HP.flgAbsltSplt_C InjSys_P2V2I2_HP.flgAgEnd_C InjSys_P2V2I2_HP.flgAxVers_C InjSys_P2V2I2_HP.flgPktCoupl_C InjSys_P2V2I2_HP.ratFuMAux1Hi_GM InjSys_P2V2I2_HP.ratFuMAux1Lo_GM InjSys_P2V2I2_HP.ratFuMBasHi_GM InjSys_P2V2I2_HP.ratFuMBasLo_GM InjSys_P2V2I2_HP.stAgFacTInj_C InjSys_P2V2I2_HP.stfacWghtSpltT_C InjSys_P2V2I2_HP.tiBreakAux1_M InjSys_P2V2I2_HP.tiBreakPkt_M InjSys_P2V3I1_HP.agAux1HiVers2_GM InjSys_P2V3I1_HP.agAux1Hi_GM InjSys_P2V3I1_HP.agAux1LoVers2_GM InjSys_P2V3I1_HP.agAux1Lo_GM InjSys_P2V3I1_HP.agAux1TPistColdVers2_GM InjSys_P2V3I1_HP.agAux1TPistCold_GM InjSys_P2V3I1_HP.agAux1TPistWrmVers2_GM InjSys_P2V3I1_HP.agAux1TPistWrm_GM InjSys_P2V3I1_HP.agBasHiVers2_GM InjSys_P2V3I1_HP.agBasHi_GM InjSys_P2V3I1_HP.agBasLoVers2_GM InjSys_P2V3I1_HP.agBasLo_GM InjSys_P2V3I1_HP.agBasTPistColdVers2_GM InjSys_P2V3I1_HP.agBasTPistCold_GM InjSys_P2V3I1_HP.agBasTPistWrmVers2_GM InjSys_P2V3I1_HP.agBasTPistWrm_GM InjSys_P2V3I1_HP.facSpltCorrnLoT_GM InjSys_P2V3I1_HP.facSpltPktHiExtd_GM InjSys_P2V3I1_HP.facSpltPktHi_GM InjSys_P2V3I1_HP.facSpltPktLoExtd_GM InjSys_P2V3I1_HP.facSpltPktLo_GM InjSys_P2V3I1_HP.facTPistCold_M InjSys_P2V3I1_HP.facTPist_M InjSys_P2V3I1_HP.facWghtAgT_M InjSys_P2V3I1_HP.facWghtRatFuMAux1_C InjSys_P2V3I1_HP.facWghtRatFuMBas_C InjSys_P2V3I1_HP.facWghtSpltT_GM InjSys_P2V3I1_HP.flgAgAux1_C InjSys_P2V3I1_HP.flgAgBegAux1_C InjSys_P2V3I1_HP.flgAgEnd_C InjSys_P2V3I1_HP.flgAxVers_C InjSys_P2V3I1_HP.flgDiAux1_C InjSys_P2V3I1_HP.flgPktCoupl_C InjSys_P2V3I1_HP.flgSpltBasFullLft_C InjSys_P2V3I1_HP.tiBreakAux1_M InjSys_P2V3I1_HP.tiBreakPkt_M InjSys_P2V4I1_HP.agBasHiExtd_GM InjSys_P2V4I1_HP.agBasLoExtd_GM InjSys_P2V4I1_HP.agBasTPistCold_GM InjSys_P2V4I1_HP.agBasTPistWrm_GM InjSys_P2V4I1_HP.facSpltAux1Hi_GM InjSys_P2V4I1_HP.facSpltAux1Lo_GM InjSys_P2V4I1_HP.facSpltPktHi_GM InjSys_P2V4I1_HP.facSpltPktLo_GM InjSys_P2V4I1_HP.facTPistCold_M InjSys_P2V4I1_HP.facTPist_M InjSys_P2V4I1_HP.facWghtAgBasT_GM InjSys_P2V4I1_HP.facWghtSpltT_GM InjSys_P2V4I1_HP.flgAbsltSplt_C InjSys_P2V4I1_HP.flgAgEnd_C InjSys_P2V4I1_HP.flgPktCoupl_C InjSys_P2V4I1_HP.ratFuMAux1Hi_GM InjSys_P2V4I1_HP.ratFuMAux1Lo_GM InjSys_P2V4I1_HP.ratFuMBasHi_GM InjSys_P2V4I1_HP.ratFuMBasLo_GM InjSys_P2V4I1_HP.tiBreakAux1_M InjSys_P2V4I1_HP.tiBreakPkt_M InjSys_P2V5I1_HP.agBasHi_GM InjSys_P2V5I1_HP.agBasLo_GM InjSys_P2V5I1_HP.agBasTPistCold_GM InjSys_P2V5I1_HP.agBasTPistWrm_GM InjSys_P2V5I1_HP.facSpltAux1Hi_GM InjSys_P2V5I1_HP.facSpltAux1Lo_GM InjSys_P2V5I1_HP.facSpltAux2Hi_GM InjSys_P2V5I1_HP.facSpltAux2Lo_GM InjSys_P2V5I1_HP.facSpltCorrnLoT_GM InjSys_P2V5I1_HP.facSpltPktHi_GM InjSys_P2V5I1_HP.facSpltPktLo_GM InjSys_P2V5I1_HP.facTPistCold_M InjSys_P2V5I1_HP.facTPist_M InjSys_P2V5I1_HP.facWghtAgT_M InjSys_P2V5I1_HP.facWghtRatFuMAux1_C InjSys_P2V5I1_HP.facWghtRatFuMAux2_C InjSys_P2V5I1_HP.facWghtRatFuMBas_C InjSys_P2V5I1_HP.facWghtSpltT_GM InjSys_P2V5I1_HP.flgAbsltSplt_C InjSys_P2V5I1_HP.flgAgEnd_C InjSys_P2V5I1_HP.flgDiAux2_C InjSys_P2V5I1_HP.flgPktCoupl_C InjSys_P2V5I1_HP.ratFuMAux1Hi_GM InjSys_P2V5I1_HP.ratFuMAux1Lo_GM InjSys_P2V5I1_HP.ratFuMAux2Hi_GM InjSys_P2V5I1_HP.ratFuMAux2Lo_GM InjSys_P2V5I1_HP.ratFuMBallHysOffs_C InjSys_P2V5I1_HP.ratFuMBallHysThd_C InjSys_P2V5I1_HP.ratFuMBasHi_GM InjSys_P2V5I1_HP.ratFuMBasLo_GM InjSys_P2V5I1_HP.tiBreakAux1_M InjSys_P2V5I1_HP.tiBreakAux2_M InjSys_P2V5I1_HP.tiBreakPkt_M InjSys_P2V6I1_S.facSpltAux1_GM InjSys_P2V6I1_S.facSpltBas_GM InjSys_P2V6I1_S.facTiBreakAux1Corrn_T InjSys_P2V6I1_S.facTiBreakPktCorrn_T InjSys_P2V6I1_S.flgAbsltSplt_C InjSys_P2V6I1_S.flgP3Lnk_C InjSys_P2V6I1_S.ratFuMAux1_GM InjSys_P2V6I1_S.ratFuMBas_GM InjSys_P2V6I1_S.tiBreakAux1_T InjSys_P2V6I1_S.tiBreakPkt_T InjSys_P3V1I1_SH.agBasDrctStrt_M InjSys_P3V1I1_SH.agBasEthnl_GM InjSys_P3V1I1_SH.agBas_GM InjSys_P3V1I1_SH.agDeltaApp_M InjSys_P3V1I1_SH.agDeltaDrctStrtCorrn_T InjSys_P3V1I1_SH.agDeltaEth_M InjSys_P3V1I1_SH.agDeltaStrtEthnl_T InjSys_P3V1I1_SH.agDeltaStrt_T InjSys_P3V1I1_SH.facEthnlAgBas_T InjSys_P3V1I1_SH.flgIgnCoupld_C InjSys_P3V2I1_SH.agAux1DeltaDrctStrtCorrn_T InjSys_P3V2I1_SH.agAux1DeltaEth_M InjSys_P3V2I1_SH.agAux1DeltaStrt_T InjSys_P3V2I1_SH.agAux1DrctStrt_M InjSys_P3V2I1_SH.agAux1_GM InjSys_P3V2I1_SH.agBasDrctStrt_M InjSys_P3V2I1_SH.agBasEthnlVers2_T InjSys_P3V2I1_SH.agBasEthnl_GM InjSys_P3V2I1_SH.agBas_GM InjSys_P3V2I1_SH.agDeltaApp_M InjSys_P3V2I1_SH.agDeltaDrctStrtCorrn_T InjSys_P3V2I1_SH.agDeltaEth_M InjSys_P3V2I1_SH.agDeltaStrt_T InjSys_P3V2I1_SH.facEthnlAux1_T InjSys_P3V2I1_SH.facEthnlBas_T InjSys_P3V2I1_SH.facEthnlagBas_T InjSys_P3V2I1_SH.facSpltAux1Ethnl_GM InjSys_P3V2I1_SH.facSpltAux1_GM InjSys_P3V2I1_SH.facSpltBasEthnl_GM InjSys_P3V2I1_SH.facSpltBas_GM InjSys_P3V2I1_SH.facTiBreakAux1Corrn_T InjSys_P3V2I1_SH.flgAbsltSplt_C InjSys_P3V2I1_SH.flgAgAux1_C InjSys_P3V2I1_SH.flgIgnCoupld_C InjSys_P3V2I1_SH.ratFuMAux1_GM InjSys_P3V2I1_SH.ratFuMBas_GM /end DEF_CHARACTERISTIC
 FUNCTION_VERSION "159.0.0" /end FUNCTION
/begin COMPU_METHOD B_TRUE "" TAB_VERB "%6.3" "" COMPU_TAB_REF B_TRUE /end COMPU_METHOD
/begin COMPU_VTAB B_TRUE "" TAB_VERB 2 0 "FALSE" 1 "TRUE" /end COMPU_VTAB
/begin COMPU_METHOD dez "" RAT_FUNC "%6.2" "" COEFFS 0 1 0 0 0 1 /end COMPU_METHOD
/begin COMPU_METHOD EngN "" RAT_FUNC "%6.3" "rpm" COEFFS 0 2 0 0 0 1 /end COMPU_METHOD
/begin COMPU_METHOD fak_ub_b1 "" RAT_FUNC "%6.4" "-" COEFFS 0 256 0 0 0 1 /end COMPU_METHOD
/begin COMPU_METHOD fak_ub_b2 "" RAT_FUNC "%8.5" "-" COEFFS 0 256 0 0 0 2 /end COMPU_METHOD
/begin COMPU_METHOD fak_ub_b8 "" RAT_FUNC "%6.4" "-" COEFFS 0 256 0 0 0 8 /end COMPU_METHOD
/begin COMPU_METHOD fak_uw_b2 "" RAT_FUNC "%7.6" "-" COEFFS 0 65536 0 0 0 2 /end COMPU_METHOD
/begin COMPU_METHOD kw_q0p0234 "" RAT_FUNC "%6.4" "Grad KW" COEFFS 0 32768 0 0 0 768 /end COMPU_METHOD
/begin COMPU_METHOD kw_q0p75 "" RAT_FUNC "%6.3" "Grad KW" COEFFS 0 4 0 0 0 3 /end COMPU_METHOD
/begin COMPU_METHOD kw_q0p75_o210 "" RAT_FUNC "%6.1" "Grad KW" COEFFS 0 4 -840 0 0 3 /end COMPU_METHOD
/begin COMPU_METHOD kw_q0p75_o240 "" RAT_FUNC "%6.1" "Grad KW" COEFFS 0 4 -960 0 0 3 /end COMPU_METHOD
/begin COMPU_METHOD kw_q1p5 "" RAT_FUNC "%6.2" "deg KW" COEFFS 0 256 0 0 0 384 /end COMPU_METHOD
/begin COMPU_METHOD kw_q2 "" RAT_FUNC "%6.2" "deg KW" COEFFS 0 1 0 0 0 2 /end COMPU_METHOD
/begin COMPU_METHOD Prc "" RAT_FUNC "%6.4" "%" COEFFS 0 81.92 0 0 0 1 /end COMPU_METHOD
/begin COMPU_METHOD rel_uw_b3072 "" RAT_FUNC "%6.4" "%" COEFFS 0 65536 0 0 0 3072 /end COMPU_METHOD
/begin COMPU_METHOD rel_uw_q0p0234 "" RAT_FUNC "%6.4" "%" COEFFS 0 32 0 0 0 0.75 /end COMPU_METHOD
/begin COMPU_METHOD Temp_Cels "" RAT_FUNC "%6.1" "deg C" COEFFS 0 10 2731.4 0 0 1 /end COMPU_METHOD
/begin COMPU_METHOD temp_q0p1 "" RAT_FUNC "%6.3" "Grad C" COEFFS 0 10 0 0 0 1 /end COMPU_METHOD
/begin COMPU_METHOD t_q0p04_ms "" RAT_FUNC "%6.4" "ms" COEFFS 0 1 0 0 0 0.04 /end COMPU_METHOD
/begin RECORD_LAYOUT RB_Axis_S16 NO_AXIS_PTS_X 1 SWORD AXIS_PTS_X 2 SWORD INDEX_INCR DIRECT /end RECORD_LAYOUT
/begin RECORD_LAYOUT RB_Axis_U16 NO_AXIS_PTS_X 1 UWORD AXIS_PTS_X 2 UWORD INDEX_INCR DIRECT /end RECORD_LAYOUT
/begin RECORD_LAYOUT RB_CurveGroup_U16 FNC_VALUES 1 UWORD COLUMN_DIR DIRECT /end RECORD_LAYOUT
/begin RECORD_LAYOUT RB_CurveGroup_U8 FNC_VALUES 1 UBYTE COLUMN_DIR DIRECT /end RECORD_LAYOUT
/begin RECORD_LAYOUT RB_Curve_S16_S16 NO_AXIS_PTS_X 1 SWORD AXIS_PTS_X 2 SWORD INDEX_INCR DIRECT FNC_VALUES 3 SWORD COLUMN_DIR DIRECT /end RECORD_LAYOUT
/begin RECORD_LAYOUT RB_Curve_S16_S8_Static NO_AXIS_PTS_X 1 SWORD AXIS_PTS_X 2 SWORD INDEX_INCR DIRECT FNC_VALUES 3 SBYTE COLUMN_DIR DIRECT STATIC_RECORD_LAYOUT /end RECORD_LAYOUT
/begin RECORD_LAYOUT RB_Curve_S16_U8_Static NO_AXIS_PTS_X 1 SWORD AXIS_PTS_X 2 SWORD INDEX_INCR DIRECT FNC_VALUES 3 UBYTE COLUMN_DIR DIRECT STATIC_RECORD_LAYOUT /end RECORD_LAYOUT
/begin RECORD_LAYOUT RB_Curve_U8_U8 NO_AXIS_PTS_X 1 UBYTE AXIS_PTS_X 2 UBYTE INDEX_INCR DIRECT FNC_VALUES 3 UBYTE COLUMN_DIR DIRECT /end RECORD_LAYOUT
/begin RECORD_LAYOUT RB_MapGroup_S16 FNC_VALUES 1 SWORD COLUMN_DIR DIRECT /end RECORD_LAYOUT
/begin RECORD_LAYOUT RB_MapGroup_S8 FNC_VALUES 1 SBYTE COLUMN_DIR DIRECT /end RECORD_LAYOUT
/begin RECORD_LAYOUT RB_MapGroup_U16 FNC_VALUES 1 UWORD COLUMN_DIR DIRECT /end RECORD_LAYOUT
/begin RECORD_LAYOUT RB_MapGroup_U8 FNC_VALUES 1 UBYTE COLUMN_DIR DIRECT /end RECORD_LAYOUT
/begin RECORD_LAYOUT RB_Map_S16S16_S16 NO_AXIS_PTS_X 1 SWORD NO_AXIS_PTS_Y 2 SWORD AXIS_PTS_X 3 SWORD INDEX_INCR DIRECT AXIS_PTS_Y 4 SWORD INDEX_INCR DIRECT FNC_VALUES 5 SWORD COLUMN_DIR DIRECT /end RECORD_LAYOUT
/begin RECORD_LAYOUT RB_Map_S16S16_U8 NO_AXIS_PTS_X 1 SWORD NO_AXIS_PTS_Y 2 SWORD AXIS_PTS_X 3 SWORD INDEX_INCR DIRECT AXIS_PTS_Y 4 SWORD INDEX_INCR DIRECT FNC_VALUES 5 UBYTE COLUMN_DIR DIRECT /end RECORD_LAYOUT
/begin RECORD_LAYOUT RB_Map_S16U16_S16 NO_AXIS_PTS_X 1 SWORD NO_AXIS_PTS_Y 2 SWORD AXIS_PTS_X 3 SWORD INDEX_INCR DIRECT AXIS_PTS_Y 4 UWORD INDEX_INCR DIRECT FNC_VALUES 5 SWORD ROW_DIR DIRECT /end RECORD_LAYOUT
/begin RECORD_LAYOUT RB_Map_U16S16_U8 NO_AXIS_PTS_X 1 UWORD NO_AXIS_PTS_Y 2 UWORD AXIS_PTS_X 3 UWORD INDEX_INCR DIRECT AXIS_PTS_Y 4 SWORD INDEX_INCR DIRECT FNC_VALUES 5 UBYTE COLUMN_DIR DIRECT /end RECORD_LAYOUT
/begin RECORD_LAYOUT RB_Map_U8U8_S8 NO_AXIS_PTS_X 1 UBYTE NO_AXIS_PTS_Y 2 UBYTE AXIS_PTS_X 3 UBYTE INDEX_INCR DIRECT AXIS_PTS_Y 4 UBYTE INDEX_INCR DIRECT FNC_VALUES 5 SBYTE COLUMN_DIR DIRECT /end RECORD_LAYOUT
/begin RECORD_LAYOUT RB_Val_Ws16 FNC_VALUES 1 SWORD COLUMN_DIR DIRECT /end RECORD_LAYOUT
/begin RECORD_LAYOUT RB_Val_Wu16 FNC_VALUES 1 UWORD COLUMN_DIR DIRECT /end RECORD_LAYOUT
/begin RECORD_LAYOUT RB_Val_Wu8 FNC_VALUES 1 UBYTE COLUMN_DIR DIRECT /end RECORD_LAYOUT
/end MODULE
/end PROJECT
