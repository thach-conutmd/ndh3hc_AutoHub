ASAP2_VERSION 1 60
/begin PROJECT MG1CS022 "MG1CS022"
/begin HEADER "" VERSION "MG1CS022_62XSC_V037" PROJECT_NO MG1CS022 /end HEADER
/begin MODULE DIM ""
/begin MOD_COMMON "" BYTE_ORDER MSB_LAST ALIGNMENT_BYTE 1 ALIGNMENT_WORD 2 ALIGNMENT_LONG 4 ALIGNMENT_INT64 4 ALIGNMENT_FLOAT32_IEEE 4 ALIGNMENT_FLOAT64_IEEE 4 DATA_SIZE 32 /end MOD_COMMON
/begin CHARACTERISTIC CWDFSTT "codeword diagnostics for fluid level sensor tank" VALUE 0x8053AED4 RB_Val_Wu8 255.0 dez 0.00 255.0 FORMAT "%5.1" /end CHARACTERISTIC
/begin CHARACTERISTIC DFES_GrpRpr.DFC_IVGdiCtl_CvoErr_C "common MIL debouncing / group representative for common MIL debouncing of DFC_IVGdiCtl_CvoErr" VALUE 0x805055D6 Val_Wu16 906.000000000 DFC_Verb 0.00 906.000000000 FORMAT "%13.9" /end CHARACTERISTIC
/begin CHARACTERISTIC DFES_GrpRpr.DFC_IVGdiCtl_CvoSigPlaus_0_C "common MIL debouncing / group representative for common MIL debouncing of DFC_IVGdiCtl_CvoSigPlaus_0" VALUE 0x805055D8 Val_Wu16 906.000000000 DFC_Verb 0.00 906.000000000 FORMAT "%13.9" /end CHARACTERISTIC
/begin CHARACTERISTIC DFES_GrpRpr.DFC_IVGdiCtl_CvoSigPlaus_1_C "common MIL debouncing / group representative for common MIL debouncing of DFC_IVGdiCtl_CvoSigPlaus_1" VALUE 0x805055DA Val_Wu16 906.000000000 DFC_Verb 0.00 906.000000000 FORMAT "%13.9" /end CHARACTERISTIC
/begin CHARACTERISTIC DFES_GrpRpr.DFC_IVGdiCtl_CvoSigPlaus_2_C "common MIL debouncing / group representative for common MIL debouncing of DFC_IVGdiCtl_CvoSigPlaus_2" VALUE 0x805055DC Val_Wu16 906.000000000 DFC_Verb 0.00 906.000000000 FORMAT "%13.9" /end CHARACTERISTIC
/begin CHARACTERISTIC DFES_GrpRpr.DFC_IVGdiCtl_CvoSigPlaus_3_C "common MIL debouncing / group representative for common MIL debouncing of DFC_IVGdiCtl_CvoSigPlaus_3" VALUE 0x805055DE Val_Wu16 906.000000000 DFC_Verb 0.00 906.000000000 FORMAT "%13.9" /end CHARACTERISTIC
/begin CHARACTERISTIC DFES_GrpRpr.DFC_IntkAirTAirFltDsCrssMax_C "common MIL debouncing / group representative for common MIL debouncing of DFC_IntkAirTAirFltDsCrssMax" VALUE 0x805055E0 Val_Wu16 906.000000000 DFC_Verb 0.00 906.000000000 FORMAT "%13.9" /end CHARACTERISTIC
/begin CHARACTERISTIC DFES_GrpRpr.DFC_IntkAirTAirFltDsCrssMin_C "common MIL debouncing / group representative for common MIL debouncing of DFC_IntkAirTAirFltDsCrssMin" VALUE 0x805055E2 Val_Wu16 906.000000000 DFC_Verb 0.00 906.000000000 FORMAT "%13.9" /end CHARACTERISTIC
/begin CHARACTERISTIC DFES_GrpRpr.DFC_IntkAirTAirFltDsHSCMax_C "common MIL debouncing / group representative for common MIL debouncing of DFC_IntkAirTAirFltDsHSCMax" VALUE 0x805055E4 Val_Wu16 906.000000000 DFC_Verb 0.00 906.000000000 FORMAT "%13.9" /end CHARACTERISTIC
/begin CHARACTERISTIC DFES_GrpRpr.DFC_IntkAirTAirFltDsImps_C "common MIL debouncing / group representative for common MIL debouncing of DFC_IntkAirTAirFltDsImps" VALUE 0x805055E6 Val_Wu16 906.000000000 DFC_Verb 0.00 906.000000000 FORMAT "%13.9" /end CHARACTERISTIC
/begin CHARACTERISTIC DFES_GrpRpr.DFC_IntkAirTAirFltDsPRCMax_C "common MIL debouncing / group representative for common MIL debouncing of DFC_IntkAirTAirFltDsPRCMax" VALUE 0x805055E8 Val_Wu16 906.000000000 DFC_Verb 0.00 906.000000000 FORMAT "%13.9" /end CHARACTERISTIC
/begin CHARACTERISTIC DFES_GrpRpr.DFC_IntkAirTAirFltDsPRCMin_C "common MIL debouncing / group representative for common MIL debouncing of DFC_IntkAirTAirFltDsPRCMin" VALUE 0x805055EA Val_Wu16 906.000000000 DFC_Verb 0.00 906.000000000 FORMAT "%13.9" /end CHARACTERISTIC
/begin CHARACTERISTIC DFES_GrpRpr.DFC_IntkAirTAirFltDsSRCMax_C "common MIL debouncing / group representative for common MIL debouncing of DFC_IntkAirTAirFltDsSRCMax" VALUE 0x805055EC Val_Wu16 906.000000000 DFC_Verb 0.00 906.000000000 FORMAT "%13.9" /end CHARACTERISTIC
/begin CHARACTERISTIC DFES_GrpRpr.DFC_IntkAirTAirFltDsSRCMin_C "common MIL debouncing / group representative for common MIL debouncing of DFC_IntkAirTAirFltDsSRCMin" VALUE 0x805055EE Val_Wu16 906.000000000 DFC_Verb 0.00 906.000000000 FORMAT "%13.9" /end CHARACTERISTIC
/begin CHARACTERISTIC DFES_GrpRpr.DFC_IntkAirTAirFltDsSTC_C "common MIL debouncing / group representative for common MIL debouncing of DFC_IntkAirTAirFltDsSTC" VALUE 0x805055F0 Val_Wu16 906.000000000 DFC_Verb 0.00 906.000000000 FORMAT "%13.9" /end CHARACTERISTIC
/begin CHARACTERISTIC DFES_GrpRpr.DFC_IntkAirTIntkMnfldCrssMax_C "common MIL debouncing / group representative for common MIL debouncing of DFC_IntkAirTIntkMnfldCrssMax" VALUE 0x805055F2 Val_Wu16 906.000000000 DFC_Verb 0.00 906.000000000 FORMAT "%13.9" /end CHARACTERISTIC
/begin CHARACTERISTIC DFES_GrpRpr.DFC_IntkAirTIntkMnfldCrssMin_C "common MIL debouncing / group representative for common MIL debouncing of DFC_IntkAirTIntkMnfldCrssMin" VALUE 0x805055F4 Val_Wu16 906.000000000 DFC_Verb 0.00 906.000000000 FORMAT "%13.9" /end CHARACTERISTIC
/begin CHARACTERISTIC DFES_GrpRpr.DFC_IntkAirTIntkMnfldHSCMax_C "common MIL debouncing / group representative for common MIL debouncing of DFC_IntkAirTIntkMnfldHSCMax" VALUE 0x805055F6 Val_Wu16 906.000000000 DFC_Verb 0.00 906.000000000 FORMAT "%13.9" /end CHARACTERISTIC
/begin CHARACTERISTIC DFES_GrpRpr.DFC_IntkAirTIntkMnfldImps_C "common MIL debouncing / group representative for common MIL debouncing of DFC_IntkAirTIntkMnfldImps" VALUE 0x805055F8 Val_Wu16 906.000000000 DFC_Verb 0.00 906.000000000 FORMAT "%13.9" /end CHARACTERISTIC
/begin CHARACTERISTIC DFES_GrpRpr.DFC_IntkAirTIntkMnfldPRCMax_C "common MIL debouncing / group representative for common MIL debouncing of DFC_IntkAirTIntkMnfldPRCMax" VALUE 0x805055FA Val_Wu16 906.000000000 DFC_Verb 0.00 906.000000000 FORMAT "%13.9" /end CHARACTERISTIC
/begin CHARACTERISTIC DFES_GrpRpr.DFC_IntkAirTIntkMnfldPRCMin_C "common MIL debouncing / group representative for common MIL debouncing of DFC_IntkAirTIntkMnfldPRCMin" VALUE 0x805055FC Val_Wu16 906.000000000 DFC_Verb 0.00 906.000000000 FORMAT "%13.9" /end CHARACTERISTIC
/begin CHARACTERISTIC DFES_GrpRpr.DFC_IntkAirTIntkMnfldSRCMax_C "common MIL debouncing / group representative for common MIL debouncing of DFC_IntkAirTIntkMnfldSRCMax" VALUE 0x805055FE Val_Wu16 906.000000000 DFC_Verb 0.00 906.000000000 FORMAT "%13.9" /end CHARACTERISTIC
/begin CHARACTERISTIC DFES_GrpRpr.DFC_IntkAirTIntkMnfldSRCMin_C "common MIL debouncing / group representative for common MIL debouncing of DFC_IntkAirTIntkMnfldSRCMin" VALUE 0x80505600 Val_Wu16 906.000000000 DFC_Verb 0.00 906.000000000 FORMAT "%13.9" /end CHARACTERISTIC
/begin CHARACTERISTIC DFES_GrpRpr.DFC_IntkAirTIntkMnfldSTC_C "common MIL debouncing / group representative for common MIL debouncing of DFC_IntkAirTIntkMnfldSTC" VALUE 0x80505602 Val_Wu16 906.000000000 DFC_Verb 0.00 906.000000000 FORMAT "%13.9" /end CHARACTERISTIC
/begin CHARACTERISTIC DFES_GrpRpr.DFC_KRREGRLMX_C "common MIL debouncing / group representative for common MIL debouncing of DFC_KRREGRLMX" VALUE 0x80505604 Val_Wu16 906.000000000 DFC_Verb 0.00 906.000000000 FORMAT "%13.9" /end CHARACTERISTIC
/begin CHARACTERISTIC DFES_GrpRpr.DFC_KRVEKOCVLCI_C "common MIL debouncing / group representative for common MIL debouncing of DFC_KRVEKOCVLCI" VALUE 0x80505606 Val_Wu16 906.000000000 DFC_Verb 0.00 906.000000000 FORMAT "%13.9" /end CHARACTERISTIC
/begin CHARACTERISTIC DFES_GrpRpr.DFC_KRVEKOENCHMT_C "common MIL debouncing / group representative for common MIL debouncing of DFC_KRVEKOENCHMT" VALUE 0x80505608 Val_Wu16 906.000000000 DFC_Verb 0.00 906.000000000 FORMAT "%13.9" /end CHARACTERISTIC
/begin CHARACTERISTIC DFES_GrpRpr.DFC_KRVEKOENCHMT0_C "common MIL debouncing / group representative for common MIL debouncing of DFC_KRVEKOENCHMT0" VALUE 0x8050560A Val_Wu16 906.000000000 DFC_Verb 0.00 906.000000000 FORMAT "%13.9" /end CHARACTERISTIC
/begin CHARACTERISTIC DFES_GrpRpr.DFC_KRVEKOENCHMT1_C "common MIL debouncing / group representative for common MIL debouncing of DFC_KRVEKOENCHMT1" VALUE 0x8050560C Val_Wu16 906.000000000 DFC_Verb 0.00 906.000000000 FORMAT "%13.9" /end CHARACTERISTIC
/begin CHARACTERISTIC DFES_GrpRpr.DFC_KRVEKOENCHMT2_C "common MIL debouncing / group representative for common MIL debouncing of DFC_KRVEKOENCHMT2" VALUE 0x8050560E Val_Wu16 906.000000000 DFC_Verb 0.00 906.000000000 FORMAT "%13.9" /end CHARACTERISTIC
/begin CHARACTERISTIC DFES_GrpRpr.DFC_KRVEKOENCHMT3_C "common MIL debouncing / group representative for common MIL debouncing of DFC_KRVEKOENCHMT3" VALUE 0x80505610 Val_Wu16 906.000000000 DFC_Verb 0.00 906.000000000 FORMAT "%13.9" /end CHARACTERISTIC
/begin CHARACTERISTIC DFES_GrpRpr.DFC_KRVEKOENCHMT4_C "common MIL debouncing / group representative for common MIL debouncing of DFC_KRVEKOENCHMT4" VALUE 0x80505612 Val_Wu16 906.000000000 DFC_Verb 0.00 906.000000000 FORMAT "%13.9" /end CHARACTERISTIC
/begin CHARACTERISTIC DFES_GrpRpr.DFC_KRVEKOENCHMT5_C "common MIL debouncing / group representative for common MIL debouncing of DFC_KRVEKOENCHMT5" VALUE 0x80505614 Val_Wu16 906.000000000 DFC_Verb 0.00 906.000000000 FORMAT "%13.9" /end CHARACTERISTIC
/begin CHARACTERISTIC DFES_GrpRpr.DFC_KRVEKOENCHMT6_C "common MIL debouncing / group representative for common MIL debouncing of DFC_KRVEKOENCHMT6" VALUE 0x80505616 Val_Wu16 906.000000000 DFC_Verb 0.00 906.000000000 FORMAT "%13.9" /end CHARACTERISTIC
/begin CHARACTERISTIC DFES_GrpRpr.DFC_KRVEKOENCHMT7_C "common MIL debouncing / group representative for common MIL debouncing of DFC_KRVEKOENCHMT7" VALUE 0x80505618 Val_Wu16 906.000000000 DFC_Verb 0.00 906.000000000 FORMAT "%13.9" /end CHARACTERISTIC
/begin CHARACTERISTIC DFES_GrpRpr.DFC_KRVEKORLMX_C "common MIL debouncing / group representative for common MIL debouncing of DFC_KRVEKORLMX" VALUE 0x8050561A Val_Wu16 906.000000000 DFC_Verb 0.00 906.000000000 FORMAT "%13.9" /end CHARACTERISTIC
/begin CHARACTERISTIC DFES_GrpRpr.DFC_KRVEKORLMXL_C "common MIL debouncing / group representative for common MIL debouncing of DFC_KRVEKORLMXL" VALUE 0x8050561C Val_Wu16 906.000000000 DFC_Verb 0.00 906.000000000 FORMAT "%13.9" /end CHARACTERISTIC
/begin CHARACTERISTIC DFES_GrpRpr.DFC_KS1max_C "common MIL debouncing / group representative for common MIL debouncing of DFC_KS1max" VALUE 0x8050561E Val_Wu16 906.000000000 DFC_Verb 0.00 906.000000000 FORMAT "%13.9" /end CHARACTERISTIC
/begin CHARACTERISTIC DFES_GrpRpr.DFC_KS1min_C "common MIL debouncing / group representative for common MIL debouncing of DFC_KS1min" VALUE 0x80505620 Val_Wu16 906.000000000 DFC_Verb 0.00 906.000000000 FORMAT "%13.9" /end CHARACTERISTIC
/begin CHARACTERISTIC DFES_GrpRpr.DFC_LMmax_C "common MIL debouncing / group representative for common MIL debouncing of DFC_LMmax" VALUE 0x80505622 Val_Wu16 906.000000000 DFC_Verb 0.00 906.000000000 FORMAT "%13.9" /end CHARACTERISTIC
/begin CHARACTERISTIC DFES_GrpRpr.DFC_LZSRnpl_C "common MIL debouncing / group representative for common MIL debouncing of DFC_LZSRnpl" VALUE 0x80505624 Val_Wu16 906.000000000 DFC_Verb 0.00 906.000000000 FORMAT "%13.9" /end CHARACTERISTIC
/begin CHARACTERISTIC DFES_GrpRpr.DFC_LamDynDiagS1B1_C "common MIL debouncing / group representative for common MIL debouncing of DFC_LamDynDiagS1B1" VALUE 0x80505626 Val_Wu16 906.000000000 DFC_Verb 0.00 906.000000000 FORMAT "%13.9" /end CHARACTERISTIC
/begin CHARACTERISTIC DFES_GrpRpr.DFC_LeakIntkMnfldEmiInfl_C "common MIL debouncing / group representative for common MIL debouncing of DFC_LeakIntkMnfldEmiInfl" VALUE 0x80505628 Val_Wu16 906.000000000 DFC_Verb 0.00 906.000000000 FORMAT "%13.9" /end CHARACTERISTIC
/begin CHARACTERISTIC DFES_GrpRpr.DFC_LinFrameErrDCDC_C "common MIL debouncing / group representative for common MIL debouncing of DFC_LinFrameErrDCDC" VALUE 0x8050562A Val_Wu16 906.000000000 DFC_Verb 0.00 906.000000000 FORMAT "%13.9" /end CHARACTERISTIC
/begin CHARACTERISTIC DFES_GrpRpr.DFC_LinOverrunErrDCDC_C "common MIL debouncing / group representative for common MIL debouncing of DFC_LinOverrunErrDCDC" VALUE 0x8050562C Val_Wu16 906.000000000 DFC_Verb 0.00 906.000000000 FORMAT "%13.9" /end CHARACTERISTIC
/begin CHARACTERISTIC DFES_GrpRpr.DFC_MD00max_C "common MIL debouncing / group representative for common MIL debouncing of DFC_MD00max" VALUE 0x8050562E Val_Wu16 906.000000000 DFC_Verb 0.00 906.000000000 FORMAT "%13.9" /end CHARACTERISTIC
/begin CHARACTERISTIC DFES_GrpRpr.DFC_MDBmax_C "common MIL debouncing / group representative for common MIL debouncing of DFC_MDBmax" VALUE 0x80505630 Val_Wu16 906.000000000 DFC_Verb 0.00 906.000000000 FORMAT "%13.9" /end CHARACTERISTIC
/begin CHARACTERISTIC DFES_GrpRpr.DFC_MDCat_C "common MIL debouncing / group representative for common MIL debouncing of DFC_MDCat" VALUE 0x80505632 Val_Wu16 906.000000000 DFC_Verb 0.00 906.000000000 FORMAT "%13.9" /end CHARACTERISTIC
/begin CHARACTERISTIC DFES_GrpRpr.DFC_MDCatCrit_C "common MIL debouncing / group representative for common MIL debouncing of DFC_MDCatCrit" VALUE 0x80505634 Val_Wu16 906.000000000 DFC_Verb 0.00 906.000000000 FORMAT "%13.9" /end CHARACTERISTIC
/begin CHARACTERISTIC DFES_GrpRpr.DFC_MDCatCurr_C "common MIL debouncing / group representative for common MIL debouncing of DFC_MDCatCurr" VALUE 0x80505636 Val_Wu16 906.000000000 DFC_Verb 0.00 906.000000000 FORMAT "%13.9" /end CHARACTERISTIC
/begin CHARACTERISTIC DFES_GrpRpr.DFC_MDCyl_0_C "common MIL debouncing / group representative for common MIL debouncing of DFC_MDCyl_0" VALUE 0x80505638 Val_Wu16 906.000000000 DFC_Verb 0.00 906.000000000 FORMAT "%13.9" /end CHARACTERISTIC
/begin CHARACTERISTIC DFES_GrpRpr.DFC_MDCyl_1_C "common MIL debouncing / group representative for common MIL debouncing of DFC_MDCyl_1" VALUE 0x8050563A Val_Wu16 906.000000000 DFC_Verb 0.00 906.000000000 FORMAT "%13.9" /end CHARACTERISTIC
/begin CHARACTERISTIC DFES_GrpRpr.DFC_MDCyl_2_C "common MIL debouncing / group representative for common MIL debouncing of DFC_MDCyl_2" VALUE 0x8050563C Val_Wu16 906.000000000 DFC_Verb 0.00 906.000000000 FORMAT "%13.9" /end CHARACTERISTIC
/begin CHARACTERISTIC DFES_GrpRpr.DFC_MDCyl_3_C "common MIL debouncing / group representative for common MIL debouncing of DFC_MDCyl_3" VALUE 0x8050563E Val_Wu16 906.000000000 DFC_Verb 0.00 906.000000000 FORMAT "%13.9" /end CHARACTERISTIC
/begin CHARACTERISTIC DFES_GrpRpr.DFC_MDEmi_C "common MIL debouncing / group representative for common MIL debouncing of DFC_MDEmi" VALUE 0x80505640 Val_Wu16 906.000000000 DFC_Verb 0.00 906.000000000 FORMAT "%13.9" /end CHARACTERISTIC
/begin CHARACTERISTIC DFES_GrpRpr.DFC_MDEmiStrt_C "common MIL debouncing / group representative for common MIL debouncing of DFC_MDEmiStrt" VALUE 0x80505642 Val_Wu16 906.000000000 DFC_Verb 0.00 906.000000000 FORMAT "%13.9" /end CHARACTERISTIC
/begin CHARACTERISTIC DFES_GrpRpr.DFC_MDFco_C "common MIL debouncing / group representative for common MIL debouncing of DFC_MDFco" VALUE 0x80505644 Val_Wu16 906.000000000 DFC_Verb 0.00 906.000000000 FORMAT "%13.9" /end CHARACTERISTIC
/begin CHARACTERISTIC DFES_GrpRpr.DFC_MDMpl_C "common MIL debouncing / group representative for common MIL debouncing of DFC_MDMpl" VALUE 0x80505646 Val_Wu16 906.000000000 DFC_Verb 0.00 906.000000000 FORMAT "%13.9" /end CHARACTERISTIC
/begin CHARACTERISTIC DFES_GrpRpr.DFC_MDSegTiAdpn_C "common MIL debouncing / group representative for common MIL debouncing of DFC_MDSegTiAdpn" VALUE 0x80505648 Val_Wu16 906.000000000 DFC_Verb 0.00 906.000000000 FORMAT "%13.9" /end CHARACTERISTIC
/begin CHARACTERISTIC DFES_GrpRpr.DFC_MDmax_C "common MIL debouncing / group representative for common MIL debouncing of DFC_MDmax" VALUE 0x8050564A Val_Wu16 906.000000000 DFC_Verb 0.00 906.000000000 FORMAT "%13.9" /end CHARACTERISTIC
/begin CHARACTERISTIC DFES_GrpRpr.DFC_MFuOilMax_C "common MIL debouncing / group representative for common MIL debouncing of DFC_MFuOilMax" VALUE 0x8050564C Val_Wu16 906.000000000 DFC_Verb 0.00 906.000000000 FORMAT "%13.9" /end CHARACTERISTIC
/begin CHARACTERISTIC DFES_GrpRpr.DFC_MOXEMM_SMU_ALM0_0_C "common MIL debouncing / group representative for common MIL debouncing of DFC_MOXEMM_SMU_ALM0_0" VALUE 0x8050564E Val_Wu16 906.000000000 DFC_Verb 0.00 906.000000000 FORMAT "%13.9" /end CHARACTERISTIC
/begin CHARACTERISTIC DFES_GrpRpr.DFC_MOXEMM_SMU_ALM0_1_C "common MIL debouncing / group representative for common MIL debouncing of DFC_MOXEMM_SMU_ALM0_1" VALUE 0x80505650 Val_Wu16 906.000000000 DFC_Verb 0.00 906.000000000 FORMAT "%13.9" /end CHARACTERISTIC
/begin CHARACTERISTIC DFES_GrpRpr.DFC_MOXEMM_SMU_ALM0_10_C "common MIL debouncing / group representative for common MIL debouncing of DFC_MOXEMM_SMU_ALM0_10" VALUE 0x80505652 Val_Wu16 906.000000000 DFC_Verb 0.00 906.000000000 FORMAT "%13.9" /end CHARACTERISTIC
/begin CHARACTERISTIC DFES_GrpRpr.DFC_MOXEMM_SMU_ALM0_11_C "common MIL debouncing / group representative for common MIL debouncing of DFC_MOXEMM_SMU_ALM0_11" VALUE 0x80505654 Val_Wu16 906.000000000 DFC_Verb 0.00 906.000000000 FORMAT "%13.9" /end CHARACTERISTIC
/begin CHARACTERISTIC DFES_GrpRpr.DFC_MOXEMM_SMU_ALM0_13_C "common MIL debouncing / group representative for common MIL debouncing of DFC_MOXEMM_SMU_ALM0_13" VALUE 0x80505656 Val_Wu16 906.000000000 DFC_Verb 0.00 906.000000000 FORMAT "%13.9" /end CHARACTERISTIC
/begin CHARACTERISTIC DFES_GrpRpr.DFC_MOXEMM_SMU_ALM0_14_C "common MIL debouncing / group representative for common MIL debouncing of DFC_MOXEMM_SMU_ALM0_14" VALUE 0x80505658 Val_Wu16 906.000000000 DFC_Verb 0.00 906.000000000 FORMAT "%13.9" /end CHARACTERISTIC
/begin CHARACTERISTIC DFES_GrpRpr.DFC_MOXEMM_SMU_ALM0_2_C "common MIL debouncing / group representative for common MIL debouncing of DFC_MOXEMM_SMU_ALM0_2" VALUE 0x8050565A Val_Wu16 906.000000000 DFC_Verb 0.00 906.000000000 FORMAT "%13.9" /end CHARACTERISTIC
/begin CHARACTERISTIC DFES_GrpRpr.DFC_MOXEMM_SMU_ALM0_22_C "common MIL debouncing / group representative for common MIL debouncing of DFC_MOXEMM_SMU_ALM0_22" VALUE 0x8050565C Val_Wu16 906.000000000 DFC_Verb 0.00 906.000000000 FORMAT "%13.9" /end CHARACTERISTIC
/begin CHARACTERISTIC DFES_GrpRpr.DFC_MOXEMM_SMU_ALM0_23_C "common MIL debouncing / group representative for common MIL debouncing of DFC_MOXEMM_SMU_ALM0_23" VALUE 0x8050565E Val_Wu16 906.000000000 DFC_Verb 0.00 906.000000000 FORMAT "%13.9" /end CHARACTERISTIC
/begin CHARACTERISTIC DFES_GrpRpr.DFC_MOXEMM_SMU_ALM0_4_C "common MIL debouncing / group representative for common MIL debouncing of DFC_MOXEMM_SMU_ALM0_4" VALUE 0x80505660 Val_Wu16 906.000000000 DFC_Verb 0.00 906.000000000 FORMAT "%13.9" /end CHARACTERISTIC
/begin CHARACTERISTIC DFES_GrpRpr.DFC_MOXEMM_SMU_ALM0_5_C "common MIL debouncing / group representative for common MIL debouncing of DFC_MOXEMM_SMU_ALM0_5" VALUE 0x80505662 Val_Wu16 906.000000000 DFC_Verb 0.00 906.000000000 FORMAT "%13.9" /end CHARACTERISTIC
/begin CHARACTERISTIC DFES_GrpRpr.DFC_MOXEMM_SMU_ALM0_7_C "common MIL debouncing / group representative for common MIL debouncing of DFC_MOXEMM_SMU_ALM0_7" VALUE 0x80505664 Val_Wu16 906.000000000 DFC_Verb 0.00 906.000000000 FORMAT "%13.9" /end CHARACTERISTIC
/begin CHARACTERISTIC DFES_GrpRpr.DFC_MOXEMM_SMU_ALM0_8_C "common MIL debouncing / group representative for common MIL debouncing of DFC_MOXEMM_SMU_ALM0_8" VALUE 0x80505666 Val_Wu16 906.000000000 DFC_Verb 0.00 906.000000000 FORMAT "%13.9" /end CHARACTERISTIC
/begin CHARACTERISTIC DFES_GrpRpr.DFC_MOXEMM_SMU_ALM10_16_C "common MIL debouncing / group representative for common MIL debouncing of DFC_MOXEMM_SMU_ALM10_16" VALUE 0x80505668 Val_Wu16 906.000000000 DFC_Verb 0.00 906.000000000 FORMAT "%13.9" /end CHARACTERISTIC
/begin CHARACTERISTIC DFES_GrpRpr.DFC_MOXEMM_SMU_ALM10_17_C "common MIL debouncing / group representative for common MIL debouncing of DFC_MOXEMM_SMU_ALM10_17" VALUE 0x8050566A Val_Wu16 906.000000000 DFC_Verb 0.00 906.000000000 FORMAT "%13.9" /end CHARACTERISTIC
/begin CHARACTERISTIC DFES_GrpRpr.DFC_MOXEMM_SMU_ALM10_21_C "common MIL debouncing / group representative for common MIL debouncing of DFC_MOXEMM_SMU_ALM10_21" VALUE 0x8050566C Val_Wu16 906.000000000 DFC_Verb 0.00 906.000000000 FORMAT "%13.9" /end CHARACTERISTIC
/begin CHARACTERISTIC DFES_GrpRpr.DFC_MOXEMM_SMU_ALM11_0_C "common MIL debouncing / group representative for common MIL debouncing of DFC_MOXEMM_SMU_ALM11_0" VALUE 0x8050566E Val_Wu16 906.000000000 DFC_Verb 0.00 906.000000000 FORMAT "%13.9" /end CHARACTERISTIC
/begin CHARACTERISTIC DFES_GrpRpr.DFC_MOXEMM_SMU_ALM11_1_C "common MIL debouncing / group representative for common MIL debouncing of DFC_MOXEMM_SMU_ALM11_1" VALUE 0x80505670 Val_Wu16 906.000000000 DFC_Verb 0.00 906.000000000 FORMAT "%13.9" /end CHARACTERISTIC
/begin CHARACTERISTIC DFES_GrpRpr.DFC_MOXEMM_SMU_ALM11_2_C "common MIL debouncing / group representative for common MIL debouncing of DFC_MOXEMM_SMU_ALM11_2" VALUE 0x80505672 Val_Wu16 906.000000000 DFC_Verb 0.00 906.000000000 FORMAT "%13.9" /end CHARACTERISTIC
/begin CHARACTERISTIC DFES_GrpRpr.DFC_MOXEMM_SMU_ALM11_3_C "common MIL debouncing / group representative for common MIL debouncing of DFC_MOXEMM_SMU_ALM11_3" VALUE 0x80505674 Val_Wu16 906.000000000 DFC_Verb 0.00 906.000000000 FORMAT "%13.9" /end CHARACTERISTIC
/begin CHARACTERISTIC DFES_GrpRpr.DFC_MOXEMM_SMU_ALM11_4_C "common MIL debouncing / group representative for common MIL debouncing of DFC_MOXEMM_SMU_ALM11_4" VALUE 0x80505676 Val_Wu16 906.000000000 DFC_Verb 0.00 906.000000000 FORMAT "%13.9" /end CHARACTERISTIC
/begin CHARACTERISTIC DFES_GrpRpr.DFC_MOXEMM_SMU_ALM11_5_C "common MIL debouncing / group representative for common MIL debouncing of DFC_MOXEMM_SMU_ALM11_5" VALUE 0x80505678 Val_Wu16 906.000000000 DFC_Verb 0.00 906.000000000 FORMAT "%13.9" /end CHARACTERISTIC
/begin CHARACTERISTIC DFES_GrpRpr.DFC_MOXEMM_SMU_ALM11_8_C "common MIL debouncing / group representative for common MIL debouncing of DFC_MOXEMM_SMU_ALM11_8" VALUE 0x8050567A Val_Wu16 906.000000000 DFC_Verb 0.00 906.000000000 FORMAT "%13.9" /end CHARACTERISTIC
/begin CHARACTERISTIC DFES_GrpRpr.DFC_MOXEMM_SMU_ALM11_9_C "common MIL debouncing / group representative for common MIL debouncing of DFC_MOXEMM_SMU_ALM11_9" VALUE 0x8050567C Val_Wu16 906.000000000 DFC_Verb 0.00 906.000000000 FORMAT "%13.9" /end CHARACTERISTIC
/begin CHARACTERISTIC DFES_GrpRpr.DFC_MOXEMM_SMU_ALM1_0_C "common MIL debouncing / group representative for common MIL debouncing of DFC_MOXEMM_SMU_ALM1_0" VALUE 0x8050567E Val_Wu16 906.000000000 DFC_Verb 0.00 906.000000000 FORMAT "%13.9" /end CHARACTERISTIC
/begin CHARACTERISTIC DFES_GrpRpr.DFC_MOXEMM_SMU_ALM1_1_C "common MIL debouncing / group representative for common MIL debouncing of DFC_MOXEMM_SMU_ALM1_1" VALUE 0x80505680 Val_Wu16 906.000000000 DFC_Verb 0.00 906.000000000 FORMAT "%13.9" /end CHARACTERISTIC
/begin CHARACTERISTIC DFES_GrpRpr.DFC_MOXEMM_SMU_ALM1_10_C "common MIL debouncing / group representative for common MIL debouncing of DFC_MOXEMM_SMU_ALM1_10" VALUE 0x80505682 Val_Wu16 906.000000000 DFC_Verb 0.00 906.000000000 FORMAT "%13.9" /end CHARACTERISTIC
/begin CHARACTERISTIC DFES_GrpRpr.DFC_MOXEMM_SMU_ALM1_11_C "common MIL debouncing / group representative for common MIL debouncing of DFC_MOXEMM_SMU_ALM1_11" VALUE 0x80505684 Val_Wu16 906.000000000 DFC_Verb 0.00 906.000000000 FORMAT "%13.9" /end CHARACTERISTIC
/begin CHARACTERISTIC DFES_GrpRpr.DFC_MOXEMM_SMU_ALM1_13_C "common MIL debouncing / group representative for common MIL debouncing of DFC_MOXEMM_SMU_ALM1_13" VALUE 0x80505686 Val_Wu16 906.000000000 DFC_Verb 0.00 906.000000000 FORMAT "%13.9" /end CHARACTERISTIC
/begin CHARACTERISTIC DFES_GrpRpr.DFC_MOXEMM_SMU_ALM1_14_C "common MIL debouncing / group representative for common MIL debouncing of DFC_MOXEMM_SMU_ALM1_14" VALUE 0x80505688 Val_Wu16 906.000000000 DFC_Verb 0.00 906.000000000 FORMAT "%13.9" /end CHARACTERISTIC
/begin CHARACTERISTIC DFES_GrpRpr.DFC_MOXEMM_SMU_ALM1_2_C "common MIL debouncing / group representative for common MIL debouncing of DFC_MOXEMM_SMU_ALM1_2" VALUE 0x8050568A Val_Wu16 906.000000000 DFC_Verb 0.00 906.000000000 FORMAT "%13.9" /end CHARACTERISTIC
/begin CHARACTERISTIC DFES_GrpRpr.DFC_MOXEMM_SMU_ALM1_22_C "common MIL debouncing / group representative for common MIL debouncing of DFC_MOXEMM_SMU_ALM1_22" VALUE 0x8050568C Val_Wu16 906.000000000 DFC_Verb 0.00 906.000000000 FORMAT "%13.9" /end CHARACTERISTIC
/begin CHARACTERISTIC DFES_GrpRpr.DFC_MOXEMM_SMU_ALM1_23_C "common MIL debouncing / group representative for common MIL debouncing of DFC_MOXEMM_SMU_ALM1_23" VALUE 0x8050568E Val_Wu16 906.000000000 DFC_Verb 0.00 906.000000000 FORMAT "%13.9" /end CHARACTERISTIC
/begin CHARACTERISTIC DFES_GrpRpr.DFC_MOXEMM_SMU_ALM1_4_C "common MIL debouncing / group representative for common MIL debouncing of DFC_MOXEMM_SMU_ALM1_4" VALUE 0x80505690 Val_Wu16 906.000000000 DFC_Verb 0.00 906.000000000 FORMAT "%13.9" /end CHARACTERISTIC
/begin CHARACTERISTIC DFES_GrpRpr.DFC_MOXEMM_SMU_ALM1_5_C "common MIL debouncing / group representative for common MIL debouncing of DFC_MOXEMM_SMU_ALM1_5" VALUE 0x80505692 Val_Wu16 906.000000000 DFC_Verb 0.00 906.000000000 FORMAT "%13.9" /end CHARACTERISTIC
/begin CHARACTERISTIC DFES_GrpRpr.DFC_MOXEMM_SMU_ALM1_7_C "common MIL debouncing / group representative for common MIL debouncing of DFC_MOXEMM_SMU_ALM1_7" VALUE 0x80505694 Val_Wu16 906.000000000 DFC_Verb 0.00 906.000000000 FORMAT "%13.9" /end CHARACTERISTIC
/begin CHARACTERISTIC DFES_GrpRpr.DFC_MOXEMM_SMU_ALM1_8_C "common MIL debouncing / group representative for common MIL debouncing of DFC_MOXEMM_SMU_ALM1_8" VALUE 0x80505696 Val_Wu16 906.000000000 DFC_Verb 0.00 906.000000000 FORMAT "%13.9" /end CHARACTERISTIC
/begin CHARACTERISTIC DFES_GrpRpr.DFC_MOXEMM_SMU_ALM21_0_C "common MIL debouncing / group representative for common MIL debouncing of DFC_MOXEMM_SMU_ALM21_0" VALUE 0x80505698 Val_Wu16 906.000000000 DFC_Verb 0.00 906.000000000 FORMAT "%13.9" /end CHARACTERISTIC
/begin CHARACTERISTIC DFES_GrpRpr.DFC_MOXEMM_SMU_ALM21_16_C "common MIL debouncing / group representative for common MIL debouncing of DFC_MOXEMM_SMU_ALM21_16" VALUE 0x8050569A Val_Wu16 906.000000000 DFC_Verb 0.00 906.000000000 FORMAT "%13.9" /end CHARACTERISTIC
/begin CHARACTERISTIC DFES_GrpRpr.DFC_MOXEMM_SMU_ALM21_3_C "common MIL debouncing / group representative for common MIL debouncing of DFC_MOXEMM_SMU_ALM21_3" VALUE 0x8050569C Val_Wu16 906.000000000 DFC_Verb 0.00 906.000000000 FORMAT "%13.9" /end CHARACTERISTIC
/begin CHARACTERISTIC DFES_GrpRpr.DFC_MOXEMM_SMU_ALM2_1_C "common MIL debouncing / group representative for common MIL debouncing of DFC_MOXEMM_SMU_ALM2_1" VALUE 0x8050569E Val_Wu16 906.000000000 DFC_Verb 0.00 906.000000000 FORMAT "%13.9" /end CHARACTERISTIC
/begin CHARACTERISTIC DFES_GrpRpr.DFC_MOXEMM_SMU_ALM2_10_C "common MIL debouncing / group representative for common MIL debouncing of DFC_MOXEMM_SMU_ALM2_10" VALUE 0x805056A0 Val_Wu16 906.000000000 DFC_Verb 0.00 906.000000000 FORMAT "%13.9" /end CHARACTERISTIC
/begin CHARACTERISTIC DFES_GrpRpr.DFC_MOXEMM_SMU_ALM2_11_C "common MIL debouncing / group representative for common MIL debouncing of DFC_MOXEMM_SMU_ALM2_11" VALUE 0x805056A2 Val_Wu16 906.000000000 DFC_Verb 0.00 906.000000000 FORMAT "%13.9" /end CHARACTERISTIC
/begin CHARACTERISTIC DFES_GrpRpr.DFC_MOXEMM_SMU_ALM2_13_C "common MIL debouncing / group representative for common MIL debouncing of DFC_MOXEMM_SMU_ALM2_13" VALUE 0x805056A4 Val_Wu16 906.000000000 DFC_Verb 0.00 906.000000000 FORMAT "%13.9" /end CHARACTERISTIC
/begin CHARACTERISTIC DFES_GrpRpr.DFC_MOXEMM_SMU_ALM2_14_C "common MIL debouncing / group representative for common MIL debouncing of DFC_MOXEMM_SMU_ALM2_14" VALUE 0x805056A6 Val_Wu16 906.000000000 DFC_Verb 0.00 906.000000000 FORMAT "%13.9" /end CHARACTERISTIC
/begin CHARACTERISTIC DFES_GrpRpr.DFC_MOXEMM_SMU_ALM2_22_C "common MIL debouncing / group representative for common MIL debouncing of DFC_MOXEMM_SMU_ALM2_22" VALUE 0x805056A8 Val_Wu16 906.000000000 DFC_Verb 0.00 906.000000000 FORMAT "%13.9" /end CHARACTERISTIC
/begin CHARACTERISTIC DFES_GrpRpr.DFC_MOXEMM_SMU_ALM2_23_C "common MIL debouncing / group representative for common MIL debouncing of DFC_MOXEMM_SMU_ALM2_23" VALUE 0x805056AA Val_Wu16 906.000000000 DFC_Verb 0.00 906.000000000 FORMAT "%13.9" /end CHARACTERISTIC
/begin CHARACTERISTIC DFES_GrpRpr.DFC_MOXEMM_SMU_ALM2_4_C "common MIL debouncing / group representative for common MIL debouncing of DFC_MOXEMM_SMU_ALM2_4" VALUE 0x805056AC Val_Wu16 906.000000000 DFC_Verb 0.00 906.000000000 FORMAT "%13.9" /end CHARACTERISTIC
/begin CHARACTERISTIC DFES_GrpRpr.DFC_MOXEMM_SMU_ALM2_5_C "common MIL debouncing / group representative for common MIL debouncing of DFC_MOXEMM_SMU_ALM2_5" VALUE 0x805056AE Val_Wu16 906.000000000 DFC_Verb 0.00 906.000000000 FORMAT "%13.9" /end CHARACTERISTIC
/begin CHARACTERISTIC DFES_GrpRpr.DFC_MOXEMM_SMU_ALM2_7_C "common MIL debouncing / group representative for common MIL debouncing of DFC_MOXEMM_SMU_ALM2_7" VALUE 0x805056B0 Val_Wu16 906.000000000 DFC_Verb 0.00 906.000000000 FORMAT "%13.9" /end CHARACTERISTIC
/begin CHARACTERISTIC DFES_GrpRpr.DFC_MOXEMM_SMU_ALM2_8_C "common MIL debouncing / group representative for common MIL debouncing of DFC_MOXEMM_SMU_ALM2_8" VALUE 0x805056B2 Val_Wu16 906.000000000 DFC_Verb 0.00 906.000000000 FORMAT "%13.9" /end CHARACTERISTIC
/begin CHARACTERISTIC DFES_GrpRpr.DFC_MOXEMM_SMU_ALM6_0_C "common MIL debouncing / group representative for common MIL debouncing of DFC_MOXEMM_SMU_ALM6_0" VALUE 0x805056B4 Val_Wu16 906.000000000 DFC_Verb 0.00 906.000000000 FORMAT "%13.9" /end CHARACTERISTIC
/begin CHARACTERISTIC DFES_GrpRpr.DFC_MOXEMM_SMU_ALM6_11_C "common MIL debouncing / group representative for common MIL debouncing of DFC_MOXEMM_SMU_ALM6_11" VALUE 0x805056B6 Val_Wu16 906.000000000 DFC_Verb 0.00 906.000000000 FORMAT "%13.9" /end CHARACTERISTIC
/begin CHARACTERISTIC DFES_GrpRpr.DFC_MOXEMM_SMU_ALM6_12_C "common MIL debouncing / group representative for common MIL debouncing of DFC_MOXEMM_SMU_ALM6_12" VALUE 0x805056B8 Val_Wu16 906.000000000 DFC_Verb 0.00 906.000000000 FORMAT "%13.9" /end CHARACTERISTIC
/begin CHARACTERISTIC DFES_GrpRpr.DFC_MOXEMM_SMU_ALM6_14_C "common MIL debouncing / group representative for common MIL debouncing of DFC_MOXEMM_SMU_ALM6_14" VALUE 0x805056BA Val_Wu16 906.000000000 DFC_Verb 0.00 906.000000000 FORMAT "%13.9" /end CHARACTERISTIC
/begin CHARACTERISTIC DFES_GrpRpr.DFC_MOXEMM_SMU_ALM6_15_C "common MIL debouncing / group representative for common MIL debouncing of DFC_MOXEMM_SMU_ALM6_15" VALUE 0x805056BC Val_Wu16 906.000000000 DFC_Verb 0.00 906.000000000 FORMAT "%13.9" /end CHARACTERISTIC
/begin CHARACTERISTIC DFES_GrpRpr.DFC_MOXEMM_SMU_ALM6_17_C "common MIL debouncing / group representative for common MIL debouncing of DFC_MOXEMM_SMU_ALM6_17" VALUE 0x805056BE Val_Wu16 906.000000000 DFC_Verb 0.00 906.000000000 FORMAT "%13.9" /end CHARACTERISTIC
/begin CHARACTERISTIC DFES_GrpRpr.DFC_MOXEMM_SMU_ALM6_18_C "common MIL debouncing / group representative for common MIL debouncing of DFC_MOXEMM_SMU_ALM6_18" VALUE 0x805056C0 Val_Wu16 906.000000000 DFC_Verb 0.00 906.000000000 FORMAT "%13.9" /end CHARACTERISTIC
/begin CHARACTERISTIC DFES_GrpRpr.DFC_MOXEMM_SMU_ALM6_20_C "common MIL debouncing / group representative for common MIL debouncing of DFC_MOXEMM_SMU_ALM6_20" VALUE 0x805056C2 Val_Wu16 906.000000000 DFC_Verb 0.00 906.000000000 FORMAT "%13.9" /end CHARACTERISTIC
/begin CHARACTERISTIC DFES_GrpRpr.DFC_MOXEMM_SMU_ALM6_21_C "common MIL debouncing / group representative for common MIL debouncing of DFC_MOXEMM_SMU_ALM6_21" VALUE 0x805056C4 Val_Wu16 906.000000000 DFC_Verb 0.00 906.000000000 FORMAT "%13.9" /end CHARACTERISTIC
/begin CHARACTERISTIC DFES_GrpRpr.DFC_MOXEMM_SMU_ALM6_25_C "common MIL debouncing / group representative for common MIL debouncing of DFC_MOXEMM_SMU_ALM6_25" VALUE 0x805056C6 Val_Wu16 906.000000000 DFC_Verb 0.00 906.000000000 FORMAT "%13.9" /end CHARACTERISTIC
/begin CHARACTERISTIC DFES_GrpRpr.DFC_MOXEMM_SMU_ALM6_4_C "common MIL debouncing / group representative for common MIL debouncing of DFC_MOXEMM_SMU_ALM6_4" VALUE 0x805056C8 Val_Wu16 906.000000000 DFC_Verb 0.00 906.000000000 FORMAT "%13.9" /end CHARACTERISTIC
/begin CHARACTERISTIC DFES_GrpRpr.DFC_MOXEMM_SMU_ALM6_5_C "common MIL debouncing / group representative for common MIL debouncing of DFC_MOXEMM_SMU_ALM6_5" VALUE 0x805056CA Val_Wu16 906.000000000 DFC_Verb 0.00 906.000000000 FORMAT "%13.9" /end CHARACTERISTIC
/begin CHARACTERISTIC DFES_GrpRpr.DFC_MOXEMM_SMU_ALM6_7_C "common MIL debouncing / group representative for common MIL debouncing of DFC_MOXEMM_SMU_ALM6_7" VALUE 0x805056CC Val_Wu16 906.000000000 DFC_Verb 0.00 906.000000000 FORMAT "%13.9" /end CHARACTERISTIC
/begin CHARACTERISTIC DFES_GrpRpr.DFC_MOXEMM_SMU_ALM6_8_C "common MIL debouncing / group representative for common MIL debouncing of DFC_MOXEMM_SMU_ALM6_8" VALUE 0x805056CE Val_Wu16 906.000000000 DFC_Verb 0.00 906.000000000 FORMAT "%13.9" /end CHARACTERISTIC
/begin CHARACTERISTIC DFES_GrpRpr.DFC_MOXEMM_SMU_ALM7_1_C "common MIL debouncing / group representative for common MIL debouncing of DFC_MOXEMM_SMU_ALM7_1" VALUE 0x805056D0 Val_Wu16 906.000000000 DFC_Verb 0.00 906.000000000 FORMAT "%13.9" /end CHARACTERISTIC
/begin CHARACTERISTIC DFES_GrpRpr.DFC_MOXEMM_SMU_ALM7_12_C "common MIL debouncing / group representative for common MIL debouncing of DFC_MOXEMM_SMU_ALM7_12" VALUE 0x805056D2 Val_Wu16 906.000000000 DFC_Verb 0.00 906.000000000 FORMAT "%13.9" /end CHARACTERISTIC
/begin CHARACTERISTIC DFES_GrpRpr.DFC_MOXEMM_SMU_ALM7_13_C "common MIL debouncing / group representative for common MIL debouncing of DFC_MOXEMM_SMU_ALM7_13" VALUE 0x805056D4 Val_Wu16 906.000000000 DFC_Verb 0.00 906.000000000 FORMAT "%13.9" /end CHARACTERISTIC
/begin CHARACTERISTIC DFES_GrpRpr.DFC_MOXEMM_SMU_ALM7_14_C "common MIL debouncing / group representative for common MIL debouncing of DFC_MOXEMM_SMU_ALM7_14" VALUE 0x805056D6 Val_Wu16 906.000000000 DFC_Verb 0.00 906.000000000 FORMAT "%13.9" /end CHARACTERISTIC
/begin CHARACTERISTIC DFES_GrpRpr.DFC_MOXEMM_SMU_ALM7_15_C "common MIL debouncing / group representative for common MIL debouncing of DFC_MOXEMM_SMU_ALM7_15" VALUE 0x805056D8 Val_Wu16 906.000000000 DFC_Verb 0.00 906.000000000 FORMAT "%13.9" /end CHARACTERISTIC
/begin CHARACTERISTIC DFES_GrpRpr.DFC_MOXEMM_SMU_ALM7_16_C "common MIL debouncing / group representative for common MIL debouncing of DFC_MOXEMM_SMU_ALM7_16" VALUE 0x805056DA Val_Wu16 906.000000000 DFC_Verb 0.00 906.000000000 FORMAT "%13.9" /end CHARACTERISTIC
/begin CHARACTERISTIC DFES_GrpRpr.DFC_MOXEMM_SMU_ALM7_17_C "common MIL debouncing / group representative for common MIL debouncing of DFC_MOXEMM_SMU_ALM7_17" VALUE 0x805056DC Val_Wu16 906.000000000 DFC_Verb 0.00 906.000000000 FORMAT "%13.9" /end CHARACTERISTIC
/begin CHARACTERISTIC DFES_GrpRpr.DFC_MOXEMM_SMU_ALM7_2_C "common MIL debouncing / group representative for common MIL debouncing of DFC_MOXEMM_SMU_ALM7_2" VALUE 0x805056DE Val_Wu16 906.000000000 DFC_Verb 0.00 906.000000000 FORMAT "%13.9" /end CHARACTERISTIC
/begin CHARACTERISTIC DFES_GrpRpr.DFC_MOXEMM_SMU_ALM7_20_C "common MIL debouncing / group representative for common MIL debouncing of DFC_MOXEMM_SMU_ALM7_20" VALUE 0x805056E0 Val_Wu16 906.000000000 DFC_Verb 0.00 906.000000000 FORMAT "%13.9" /end CHARACTERISTIC
/begin CHARACTERISTIC DFES_GrpRpr.DFC_MOXEMM_SMU_ALM7_25_C "common MIL debouncing / group representative for common MIL debouncing of DFC_MOXEMM_SMU_ALM7_25" VALUE 0x805056E2 Val_Wu16 906.000000000 DFC_Verb 0.00 906.000000000 FORMAT "%13.9" /end CHARACTERISTIC
/begin CHARACTERISTIC DFES_GrpRpr.DFC_MOXEMM_SMU_ALM7_26_C "common MIL debouncing / group representative for common MIL debouncing of DFC_MOXEMM_SMU_ALM7_26" VALUE 0x805056E4 Val_Wu16 906.000000000 DFC_Verb 0.00 906.000000000 FORMAT "%13.9" /end CHARACTERISTIC
/begin CHARACTERISTIC DFES_GrpRpr.DFC_MOXEMM_SMU_ALM7_28_C "common MIL debouncing / group representative for common MIL debouncing of DFC_MOXEMM_SMU_ALM7_28" VALUE 0x805056E6 Val_Wu16 906.000000000 DFC_Verb 0.00 906.000000000 FORMAT "%13.9" /end CHARACTERISTIC
/begin CHARACTERISTIC DFES_GrpRpr.DFC_MOXEMM_SMU_ALM7_29_C "common MIL debouncing / group representative for common MIL debouncing of DFC_MOXEMM_SMU_ALM7_29" VALUE 0x805056E8 Val_Wu16 906.000000000 DFC_Verb 0.00 906.000000000 FORMAT "%13.9" /end CHARACTERISTIC
/begin CHARACTERISTIC DFES_GrpRpr.DFC_MOXEMM_SMU_ALM7_30_C "common MIL debouncing / group representative for common MIL debouncing of DFC_MOXEMM_SMU_ALM7_30" VALUE 0x805056EA Val_Wu16 906.000000000 DFC_Verb 0.00 906.000000000 FORMAT "%13.9" /end CHARACTERISTIC
/begin CHARACTERISTIC DFES_GrpRpr.DFC_MOXEMM_SMU_ALM7_31_C "common MIL debouncing / group representative for common MIL debouncing of DFC_MOXEMM_SMU_ALM7_31" VALUE 0x805056EC Val_Wu16 906.000000000 DFC_Verb 0.00 906.000000000 FORMAT "%13.9" /end CHARACTERISTIC
/begin CHARACTERISTIC DFES_GrpRpr.DFC_MOXEMM_SMU_ALM8_0_C "common MIL debouncing / group representative for common MIL debouncing of DFC_MOXEMM_SMU_ALM8_0" VALUE 0x805056EE Val_Wu16 906.000000000 DFC_Verb 0.00 906.000000000 FORMAT "%13.9" /end CHARACTERISTIC
/begin CHARACTERISTIC DFES_GrpRpr.DFC_MOXEMM_SMU_ALM8_1_C "common MIL debouncing / group representative for common MIL debouncing of DFC_MOXEMM_SMU_ALM8_1" VALUE 0x805056F0 Val_Wu16 906.000000000 DFC_Verb 0.00 906.000000000 FORMAT "%13.9" /end CHARACTERISTIC
/begin CHARACTERISTIC DFES_GrpRpr.DFC_MOXEMM_SMU_ALM8_10_C "common MIL debouncing / group representative for common MIL debouncing of DFC_MOXEMM_SMU_ALM8_10" VALUE 0x805056F2 Val_Wu16 906.000000000 DFC_Verb 0.00 906.000000000 FORMAT "%13.9" /end CHARACTERISTIC
/begin CHARACTERISTIC DFES_GrpRpr.DFC_MOXEMM_SMU_ALM8_11_C "common MIL debouncing / group representative for common MIL debouncing of DFC_MOXEMM_SMU_ALM8_11" VALUE 0x805056F4 Val_Wu16 906.000000000 DFC_Verb 0.00 906.000000000 FORMAT "%13.9" /end CHARACTERISTIC
/begin CHARACTERISTIC DFES_GrpRpr.DFC_MOXEMM_SMU_ALM8_12_C "common MIL debouncing / group representative for common MIL debouncing of DFC_MOXEMM_SMU_ALM8_12" VALUE 0x805056F6 Val_Wu16 906.000000000 DFC_Verb 0.00 906.000000000 FORMAT "%13.9" /end CHARACTERISTIC
/begin CHARACTERISTIC DFES_GrpRpr.DFC_MOXEMM_SMU_ALM8_16_C "common MIL debouncing / group representative for common MIL debouncing of DFC_MOXEMM_SMU_ALM8_16" VALUE 0x805056F8 Val_Wu16 906.000000000 DFC_Verb 0.00 906.000000000 FORMAT "%13.9" /end CHARACTERISTIC
/begin CHARACTERISTIC DFES_GrpRpr.DFC_MOXEMM_SMU_ALM8_18_C "common MIL debouncing / group representative for common MIL debouncing of DFC_MOXEMM_SMU_ALM8_18" VALUE 0x805056FA Val_Wu16 906.000000000 DFC_Verb 0.00 906.000000000 FORMAT "%13.9" /end CHARACTERISTIC
/begin CHARACTERISTIC DFES_GrpRpr.DFC_MOXEMM_SMU_ALM8_2_C "common MIL debouncing / group representative for common MIL debouncing of DFC_MOXEMM_SMU_ALM8_2" VALUE 0x805056FC Val_Wu16 906.000000000 DFC_Verb 0.00 906.000000000 FORMAT "%13.9" /end CHARACTERISTIC
/begin CHARACTERISTIC DFES_GrpRpr.DFC_MOXEMM_SMU_ALM8_3_C "common MIL debouncing / group representative for common MIL debouncing of DFC_MOXEMM_SMU_ALM8_3" VALUE 0x805056FE Val_Wu16 906.000000000 DFC_Verb 0.00 906.000000000 FORMAT "%13.9" /end CHARACTERISTIC
/begin CHARACTERISTIC DFES_GrpRpr.DFC_MOXEMM_SMU_ALM8_31_C "common MIL debouncing / group representative for common MIL debouncing of DFC_MOXEMM_SMU_ALM8_31" VALUE 0x80505700 Val_Wu16 906.000000000 DFC_Verb 0.00 906.000000000 FORMAT "%13.9" /end CHARACTERISTIC
/begin CHARACTERISTIC DFES_GrpRpr.DFC_MOXEMM_SMU_ALM8_4_C "common MIL debouncing / group representative for common MIL debouncing of DFC_MOXEMM_SMU_ALM8_4" VALUE 0x80505702 Val_Wu16 906.000000000 DFC_Verb 0.00 906.000000000 FORMAT "%13.9" /end CHARACTERISTIC
/begin CHARACTERISTIC DFES_GrpRpr.DFC_MOXEMM_SMU_ALM9_0_C "common MIL debouncing / group representative for common MIL debouncing of DFC_MOXEMM_SMU_ALM9_0" VALUE 0x80505704 Val_Wu16 906.000000000 DFC_Verb 0.00 906.000000000 FORMAT "%13.9" /end CHARACTERISTIC
/begin CHARACTERISTIC DFES_GrpRpr.DFC_MOXEMM_SMU_ALM9_15_C "common MIL debouncing / group representative for common MIL debouncing of DFC_MOXEMM_SMU_ALM9_15" VALUE 0x80505706 Val_Wu16 906.000000000 DFC_Verb 0.00 906.000000000 FORMAT "%13.9" /end CHARACTERISTIC
/begin CHARACTERISTIC DFES_GrpRpr.DFC_MOXEMM_SMU_ALM9_3_C "common MIL debouncing / group representative for common MIL debouncing of DFC_MOXEMM_SMU_ALM9_3" VALUE 0x80505708 Val_Wu16 906.000000000 DFC_Verb 0.00 906.000000000 FORMAT "%13.9" /end CHARACTERISTIC
/begin CHARACTERISTIC DFES_GrpRpr.DFC_MoCADCNTP_C "common MIL debouncing / group representative for common MIL debouncing of DFC_MoCADCNTP" VALUE 0x8050570A Val_Wu16 906.000000000 DFC_Verb 0.00 906.000000000 FORMAT "%13.9" /end CHARACTERISTIC
/begin CHARACTERISTIC DFES_GrpRpr.DFC_MoCADCTst_C "common MIL debouncing / group representative for common MIL debouncing of DFC_MoCADCTst" VALUE 0x8050570C Val_Wu16 906.000000000 DFC_Verb 0.00 906.000000000 FORMAT "%13.9" /end CHARACTERISTIC
/begin CHARACTERISTIC DFES_GrpRpr.DFC_MoCSOPICO_C "common MIL debouncing / group representative for common MIL debouncing of DFC_MoCSOPICO" VALUE 0x8050570E Val_Wu16 906.000000000 DFC_Verb 0.00 906.000000000 FORMAT "%13.9" /end CHARACTERISTIC
/begin CHARACTERISTIC DFES_GrpRpr.DFC_MoFAPP_C "common MIL debouncing / group representative for common MIL debouncing of DFC_MoFAPP" VALUE 0x80505710 Val_Wu16 906.000000000 DFC_Verb 0.00 906.000000000 FORMAT "%13.9" /end CHARACTERISTIC
/begin CHARACTERISTIC DFES_GrpRpr.DFC_MoFAirFilgPrdc_C "common MIL debouncing / group representative for common MIL debouncing of DFC_MoFAirFilgPrdc" VALUE 0x80505712 Val_Wu16 906.000000000 DFC_Verb 0.00 906.000000000 FORMAT "%13.9" /end CHARACTERISTIC
/begin CHARACTERISTIC DFES_GrpRpr.DFC_MoFAirFlCtOffGdi_C "common MIL debouncing / group representative for common MIL debouncing of DFC_MoFAirFlCtOffGdi" VALUE 0x80505714 Val_Wu16 906.000000000 DFC_Verb 0.00 906.000000000 FORMAT "%13.9" /end CHARACTERISTIC
/begin CHARACTERISTIC DFES_GrpRpr.DFC_MoFAirFlCylGdi_C "common MIL debouncing / group representative for common MIL debouncing of DFC_MoFAirFlCylGdi" VALUE 0x80505716 Val_Wu16 906.000000000 DFC_Verb 0.00 906.000000000 FORMAT "%13.9" /end CHARACTERISTIC
/begin CHARACTERISTIC DFES_GrpRpr.DFC_MoFAirFlFF_C "common MIL debouncing / group representative for common MIL debouncing of DFC_MoFAirFlFF" VALUE 0x80505718 Val_Wu16 906.000000000 DFC_Verb 0.00 906.000000000 FORMAT "%13.9" /end CHARACTERISTIC
/begin CHARACTERISTIC DFES_GrpRpr.DFC_MoFAirFlIn_C "common MIL debouncing / group representative for common MIL debouncing of DFC_MoFAirFlIn" VALUE 0x8050571A Val_Wu16 906.000000000 DFC_Verb 0.00 906.000000000 FORMAT "%13.9" /end CHARACTERISTIC
/begin CHARACTERISTIC DFES_GrpRpr.DFC_MoFAirFlMixCtlGdiChkAirFl_C "common MIL debouncing / group representative for common MIL debouncing of DFC_MoFAirFlMixCtlGdiChkAirFl" VALUE 0x8050571C Val_Wu16 906.000000000 DFC_Verb 0.00 906.000000000 FORMAT "%13.9" /end CHARACTERISTIC
/begin CHARACTERISTIC DFES_GrpRpr.DFC_MoFAirFlMixCtlGdiChkCtrl_C "common MIL debouncing / group representative for common MIL debouncing of DFC_MoFAirFlMixCtlGdiChkCtrl" VALUE 0x8050571E Val_Wu16 906.000000000 DFC_Verb 0.00 906.000000000 FORMAT "%13.9" /end CHARACTERISTIC
/begin CHARACTERISTIC DFES_GrpRpr.DFC_MoFAirFlMode_C "common MIL debouncing / group representative for common MIL debouncing of DFC_MoFAirFlMode" VALUE 0x80505720 Val_Wu16 906.000000000 DFC_Verb 0.00 906.000000000 FORMAT "%13.9" /end CHARACTERISTIC
/begin CHARACTERISTIC DFES_GrpRpr.DFC_MoFESpd_C "common MIL debouncing / group representative for common MIL debouncing of DFC_MoFESpd" VALUE 0x80505722 Val_Wu16 906.000000000 DFC_Verb 0.00 906.000000000 FORMAT "%13.9" /end CHARACTERISTIC
/begin CHARACTERISTIC DFES_GrpRpr.DFC_MoFIACo_C "common MIL debouncing / group representative for common MIL debouncing of DFC_MoFIACo" VALUE 0x80505724 Val_Wu16 906.000000000 DFC_Verb 0.00 906.000000000 FORMAT "%13.9" /end CHARACTERISTIC
/begin CHARACTERISTIC DFES_GrpRpr.DFC_MoFICOL1_C "common MIL debouncing / group representative for common MIL debouncing of DFC_MoFICOL1" VALUE 0x80505726 Val_Wu16 906.000000000 DFC_Verb 0.00 906.000000000 FORMAT "%13.9" /end CHARACTERISTIC
/begin CHARACTERISTIC DFES_GrpRpr.DFC_MoFICOL2_C "common MIL debouncing / group representative for common MIL debouncing of DFC_MoFICOL2" VALUE 0x80505728 Val_Wu16 906.000000000 DFC_Verb 0.00 906.000000000 FORMAT "%13.9" /end CHARACTERISTIC
/begin CHARACTERISTIC DFES_GrpRpr.DFC_MoFStrt_C "common MIL debouncing / group representative for common MIL debouncing of DFC_MoFStrt" VALUE 0x8050572A Val_Wu16 906.000000000 DFC_Verb 0.00 906.000000000 FORMAT "%13.9" /end CHARACTERISTIC
/begin CHARACTERISTIC DFES_GrpRpr.DFC_MoFTrqCmp_C "common MIL debouncing / group representative for common MIL debouncing of DFC_MoFTrqCmp" VALUE 0x8050572C Val_Wu16 906.000000000 DFC_Verb 0.00 906.000000000 FORMAT "%13.9" /end CHARACTERISTIC
/begin CHARACTERISTIC DFES_GrpRpr.DFC_MoFTrqCmpMax_C "common MIL debouncing / group representative for common MIL debouncing of DFC_MoFTrqCmpMax" VALUE 0x8050572E Val_Wu16 906.000000000 DFC_Verb 0.00 906.000000000 FORMAT "%13.9" /end CHARACTERISTIC
/begin CHARACTERISTIC DFES_GrpRpr.DFC_MoFTrqCmpMin_C "common MIL debouncing / group representative for common MIL debouncing of DFC_MoFTrqCmpMin" VALUE 0x80505730 Val_Wu16 906.000000000 DFC_Verb 0.00 906.000000000 FORMAT "%13.9" /end CHARACTERISTIC
/begin CHARACTERISTIC DFES_GrpRpr.DFC_MoFVarPostBldSel_C "common MIL debouncing / group representative for common MIL debouncing of DFC_MoFVarPostBldSel" VALUE 0x80505732 Val_Wu16 906.000000000 DFC_Verb 0.00 906.000000000 FORMAT "%13.9" /end CHARACTERISTIC
/begin CHARACTERISTIC DFES_GrpRpr.DFC_MoXEMMHwLTMCUFW_C "common MIL debouncing / group representative for common MIL debouncing of DFC_MoXEMMHwLTMCUFW" VALUE 0x80505734 Val_Wu16 906.000000000 DFC_Verb 0.00 906.000000000 FORMAT "%13.9" /end CHARACTERISTIC
/begin CHARACTERISTIC DFES_GrpRpr.DFC_MoXEMMHwLTMonBIST_C "common MIL debouncing / group representative for common MIL debouncing of DFC_MoXEMMHwLTMonBIST" VALUE 0x80505736 Val_Wu16 906.000000000 DFC_Verb 0.00 906.000000000 FORMAT "%13.9" /end CHARACTERISTIC
/begin CHARACTERISTIC DFES_GrpRpr.DFC_MoXEMMHwLTRegMonTest_C "common MIL debouncing / group representative for common MIL debouncing of DFC_MoXEMMHwLTRegMonTest" VALUE 0x80505738 Val_Wu16 906.000000000 DFC_Verb 0.00 906.000000000 FORMAT "%13.9" /end CHARACTERISTIC
/begin CHARACTERISTIC DFES_GrpRpr.DFC_MoXEMMHwLTStbySMUAlvTest_C "common MIL debouncing / group representative for common MIL debouncing of DFC_MoXEMMHwLTStbySMUAlvTest" VALUE 0x8050573A Val_Wu16 906.000000000 DFC_Verb 0.00 906.000000000 FORMAT "%13.9" /end CHARACTERISTIC
/begin CHARACTERISTIC DFES_GrpRpr.DFC_MoXEMMHwLTTempSens_C "common MIL debouncing / group representative for common MIL debouncing of DFC_MoXEMMHwLTTempSens" VALUE 0x8050573C Val_Wu16 906.000000000 DFC_Verb 0.00 906.000000000 FORMAT "%13.9" /end CHARACTERISTIC
/begin CHARACTERISTIC DFES_GrpRpr.DFC_MoXEMMHwLTUCBCfg_C "common MIL debouncing / group representative for common MIL debouncing of DFC_MoXEMMHwLTUCBCfg" VALUE 0x8050573E Val_Wu16 906.000000000 DFC_Verb 0.00 906.000000000 FORMAT "%13.9" /end CHARACTERISTIC
/begin CHARACTERISTIC DFES_GrpRpr.DFC_NWSEmax_C "common MIL debouncing / group representative for common MIL debouncing of DFC_NWSEmax" VALUE 0x80505740 Val_Wu16 906.000000000 DFC_Verb 0.00 906.000000000 FORMAT "%13.9" /end CHARACTERISTIC
/begin CHARACTERISTIC DFES_GrpRpr.DFC_NWSmax_C "common MIL debouncing / group representative for common MIL debouncing of DFC_NWSmax" VALUE 0x80505742 Val_Wu16 906.000000000 DFC_Verb 0.00 906.000000000 FORMAT "%13.9" /end CHARACTERISTIC
/begin CHARACTERISTIC DFES_GrpRpr.DFC_OCWDAABEActv_C "common MIL debouncing / group representative for common MIL debouncing of DFC_OCWDAABEActv" VALUE 0x80505744 Val_Wu16 906.000000000 DFC_Verb 0.00 906.000000000 FORMAT "%13.9" /end CHARACTERISTIC
/begin CHARACTERISTIC DFES_GrpRpr.DFC_OCWDACom_C "common MIL debouncing / group representative for common MIL debouncing of DFC_OCWDACom" VALUE 0x80505746 Val_Wu16 906.000000000 DFC_Verb 0.00 906.000000000 FORMAT "%13.9" /end CHARACTERISTIC
/begin CHARACTERISTIC DFES_GrpRpr.DFC_OCWDAErrPin_C "common MIL debouncing / group representative for common MIL debouncing of DFC_OCWDAErrPin" VALUE 0x80505748 Val_Wu16 906.000000000 DFC_Verb 0.00 906.000000000 FORMAT "%13.9" /end CHARACTERISTIC
/begin CHARACTERISTIC DFES_GrpRpr.DFC_OCWDAOvrVltg_C "common MIL debouncing / group representative for common MIL debouncing of DFC_OCWDAOvrVltg" VALUE 0x8050574A Val_Wu16 906.000000000 DFC_Verb 0.00 906.000000000 FORMAT "%13.9" /end CHARACTERISTIC
/begin CHARACTERISTIC DFES_GrpRpr.DFC_ORAmax_C "common MIL debouncing / group representative for common MIL debouncing of DFC_ORAmax" VALUE 0x8050574C Val_Wu16 906.000000000 DFC_Verb 0.00 906.000000000 FORMAT "%13.9" /end CHARACTERISTIC
/begin CHARACTERISTIC DFES_GrpRpr.DFC_ORAmin_C "common MIL debouncing / group representative for common MIL debouncing of DFC_ORAmin" VALUE 0x8050574E Val_Wu16 906.000000000 DFC_Verb 0.00 906.000000000 FORMAT "%13.9" /end CHARACTERISTIC
/begin CHARACTERISTIC DFES_GrpRpr.DFC_OilPPlaus_C "common MIL debouncing / group representative for common MIL debouncing of DFC_OilPPlaus" VALUE 0x80505750 Val_Wu16 906.000000000 DFC_Verb 0.00 906.000000000 FORMAT "%13.9" /end CHARACTERISTIC
/begin CHARACTERISTIC DFES_GrpRpr.DFC_PLLSUmax_C "common MIL debouncing / group representative for common MIL debouncing of DFC_PLLSUmax" VALUE 0x80505752 Val_Wu16 906.000000000 DFC_Verb 0.00 906.000000000 FORMAT "%13.9" /end CHARACTERISTIC
/begin CHARACTERISTIC DFES_GrpRpr.DFC_PLLSUmin_C "common MIL debouncing / group representative for common MIL debouncing of DFC_PLLSUmin" VALUE 0x80505754 Val_Wu16 906.000000000 DFC_Verb 0.00 906.000000000 FORMAT "%13.9" /end CHARACTERISTIC
/begin CHARACTERISTIC DFES_GrpRpr.DFC_PSR1max_C "common MIL debouncing / group representative for common MIL debouncing of DFC_PSR1max" VALUE 0x80505756 Val_Wu16 906.000000000 DFC_Verb 0.00 906.000000000 FORMAT "%13.9" /end CHARACTERISTIC
/begin CHARACTERISTIC DFES_GrpRpr.DFC_PSRBmax_C "common MIL debouncing / group representative for common MIL debouncing of DFC_PSRBmax" VALUE 0x80505758 Val_Wu16 906.000000000 DFC_Verb 0.00 906.000000000 FORMAT "%13.9" /end CHARACTERISTIC
/begin CHARACTERISTIC DFES_GrpRpr.DFC_PSRBmin_C "common MIL debouncing / group representative for common MIL debouncing of DFC_PSRBmin" VALUE 0x8050575A Val_Wu16 906.000000000 DFC_Verb 0.00 906.000000000 FORMAT "%13.9" /end CHARACTERISTIC
/begin CHARACTERISTIC DFES_GrpRpr.DFC_PSRPmax_C "common MIL debouncing / group representative for common MIL debouncing of DFC_PSRPmax" VALUE 0x8050575C Val_Wu16 906.000000000 DFC_Verb 0.00 906.000000000 FORMAT "%13.9" /end CHARACTERISTIC
/begin CHARACTERISTIC DFES_GrpRpr.DFC_PSRPmin_C "common MIL debouncing / group representative for common MIL debouncing of DFC_PSRPmin" VALUE 0x8050575E Val_Wu16 906.000000000 DFC_Verb 0.00 906.000000000 FORMAT "%13.9" /end CHARACTERISTIC
/begin CHARACTERISTIC DFES_GrpRpr.DFC_PSRPsig_C "common MIL debouncing / group representative for common MIL debouncing of DFC_PSRPsig" VALUE 0x80505760 Val_Wu16 906.000000000 DFC_Verb 0.00 906.000000000 FORMAT "%13.9" /end CHARACTERISTIC
/begin CHARACTERISTIC DFES_GrpRpr.DFC_PSRmax_C "common MIL debouncing / group representative for common MIL debouncing of DFC_PSRmax" VALUE 0x80505762 Val_Wu16 906.000000000 DFC_Verb 0.00 906.000000000 FORMAT "%13.9" /end CHARACTERISTIC
/begin CHARACTERISTIC DFES_GrpRpr.DFC_PUmax_C "common MIL debouncing / group representative for common MIL debouncing of DFC_PUmax" VALUE 0x80505764 Val_Wu16 906.000000000 DFC_Verb 0.00 906.000000000 FORMAT "%13.9" /end CHARACTERISTIC
/begin CHARACTERISTIC DFES_GrpRpr.DFC_P_VSE11_OL_C "common MIL debouncing / group representative for common MIL debouncing of DFC_P_VSE11_OL" VALUE 0x80505766 Val_Wu16 906.000000000 DFC_Verb 0.00 906.000000000 FORMAT "%13.9" /end CHARACTERISTIC
/begin CHARACTERISTIC DFES_GrpRpr.DFC_P_VSE11_SCB_C "common MIL debouncing / group representative for common MIL debouncing of DFC_P_VSE11_SCB" VALUE 0x80505768 Val_Wu16 906.000000000 DFC_Verb 0.00 906.000000000 FORMAT "%13.9" /end CHARACTERISTIC
/begin CHARACTERISTIC DFES_GrpRpr.DFC_P_VSE11_SCG_C "common MIL debouncing / group representative for common MIL debouncing of DFC_P_VSE11_SCG" VALUE 0x8050576A Val_Wu16 906.000000000 DFC_Verb 0.00 906.000000000 FORMAT "%13.9" /end CHARACTERISTIC
/begin CHARACTERISTIC DFES_GrpRpr.DFC_PhyHighAPP1_C "common MIL debouncing / group representative for common MIL debouncing of DFC_PhyHighAPP1" VALUE 0x8050576C Val_Wu16 906.000000000 DFC_Verb 0.00 906.000000000 FORMAT "%13.9" /end CHARACTERISTIC
/begin CHARACTERISTIC DFES_GrpRpr.DFC_PhyHighAPP2_C "common MIL debouncing / group representative for common MIL debouncing of DFC_PhyHighAPP2" VALUE 0x8050576E Val_Wu16 906.000000000 DFC_Verb 0.00 906.000000000 FORMAT "%13.9" /end CHARACTERISTIC
/begin CHARACTERISTIC DFES_GrpRpr.DFC_PhyLowAPP1_C "common MIL debouncing / group representative for common MIL debouncing of DFC_PhyLowAPP1" VALUE 0x80505770 Val_Wu16 906.000000000 DFC_Verb 0.00 906.000000000 FORMAT "%13.9" /end CHARACTERISTIC
/begin CHARACTERISTIC DFES_GrpRpr.DFC_PhyLowAPP2_C "common MIL debouncing / group representative for common MIL debouncing of DFC_PhyLowAPP2" VALUE 0x80505772 Val_Wu16 906.000000000 DFC_Verb 0.00 906.000000000 FORMAT "%13.9" /end CHARACTERISTIC
/begin CHARACTERISTIC DFES_GrpRpr.DFC_SRCHighAPP1_C "common MIL debouncing / group representative for common MIL debouncing of DFC_SRCHighAPP1" VALUE 0x80505774 Val_Wu16 906.000000000 DFC_Verb 0.00 906.000000000 FORMAT "%13.9" /end CHARACTERISTIC
/begin CHARACTERISTIC DFES_GrpRpr.DFC_SRCHighAPP2_C "common MIL debouncing / group representative for common MIL debouncing of DFC_SRCHighAPP2" VALUE 0x80505776 Val_Wu16 906.000000000 DFC_Verb 0.00 906.000000000 FORMAT "%13.9" /end CHARACTERISTIC
/begin CHARACTERISTIC DFES_GrpRpr.DFC_SRCLowAPP1_C "common MIL debouncing / group representative for common MIL debouncing of DFC_SRCLowAPP1" VALUE 0x80505778 Val_Wu16 906.000000000 DFC_Verb 0.00 906.000000000 FORMAT "%13.9" /end CHARACTERISTIC
/begin CHARACTERISTIC DFES_GrpRpr.DFC_SRCLowAPP2_C "common MIL debouncing / group representative for common MIL debouncing of DFC_SRCLowAPP2" VALUE 0x8050577A Val_Wu16 906.000000000 DFC_Verb 0.00 906.000000000 FORMAT "%13.9" /end CHARACTERISTIC
/begin CHARACTERISTIC DFES_GrpRpr.DFC_SSpMon2_C "common MIL debouncing / group representative for common MIL debouncing of DFC_SSpMon2" VALUE 0x8050577C Val_Wu16 906.000000000 DFC_Verb 0.00 906.000000000 FORMAT "%13.9" /end CHARACTERISTIC
/begin CHARACTERISTIC DFES_GrpRpr.DFC_STHDRmax_C "common MIL debouncing / group representative for common MIL debouncing of DFC_STHDRmax" VALUE 0x8050577E Val_Wu16 906.000000000 DFC_Verb 0.00 906.000000000 FORMAT "%13.9" /end CHARACTERISTIC
/begin CHARACTERISTIC DFES_GrpRpr.DFC_SWReset_0_C "common MIL debouncing / group representative for common MIL debouncing of DFC_SWReset_0" VALUE 0x80505780 Val_Wu16 906.000000000 DFC_Verb 0.00 906.000000000 FORMAT "%13.9" /end CHARACTERISTIC
/begin CHARACTERISTIC DFES_GrpRpr.DFC_SWReset_1_C "common MIL debouncing / group representative for common MIL debouncing of DFC_SWReset_1" VALUE 0x80505782 Val_Wu16 906.000000000 DFC_Verb 0.00 906.000000000 FORMAT "%13.9" /end CHARACTERISTIC
/begin CHARACTERISTIC DFES_GrpRpr.DFC_SWReset_2_C "common MIL debouncing / group representative for common MIL debouncing of DFC_SWReset_2" VALUE 0x80505784 Val_Wu16 906.000000000 DFC_Verb 0.00 906.000000000 FORMAT "%13.9" /end CHARACTERISTIC
/begin CHARACTERISTIC DFES_GrpRpr.DFC_SyncAPP_C "common MIL debouncing / group representative for common MIL debouncing of DFC_SyncAPP" VALUE 0x80505786 Val_Wu16 906.000000000 DFC_Verb 0.00 906.000000000 FORMAT "%13.9" /end CHARACTERISTIC
/begin CHARACTERISTIC DFES_GrpRpr.DFC_TANKLnpl_C "common MIL debouncing / group representative for common MIL debouncing of DFC_TANKLnpl" VALUE 0x80505788 Val_Wu16 906.000000000 DFC_Verb 0.00 906.000000000 FORMAT "%13.9" /end CHARACTERISTIC
/begin CHARACTERISTIC DFES_GrpRpr.DFC_TAmax_Dummy_C "common MIL debouncing / group representative for common MIL debouncing of DFC_TAmax_Dummy" VALUE 0x8050578A Val_Wu16 906.000000000 DFC_Verb 0.00 906.000000000 FORMAT "%13.9" /end CHARACTERISTIC
/begin CHARACTERISTIC DFES_GrpRpr.DFC_TESFmax_C "common MIL debouncing / group representative for common MIL debouncing of DFC_TESFmax" VALUE 0x8050578C Val_Wu16 906.000000000 DFC_Verb 0.00 906.000000000 FORMAT "%13.9" /end CHARACTERISTIC
/begin CHARACTERISTIC DFES_GrpRpr.DFC_TESGmax_C "common MIL debouncing / group representative for common MIL debouncing of DFC_TESGmax" VALUE 0x8050578E Val_Wu16 906.000000000 DFC_Verb 0.00 906.000000000 FORMAT "%13.9" /end CHARACTERISTIC
/begin CHARACTERISTIC DFES_GrpRpr.DFC_TKAEmax_C "common MIL debouncing / group representative for common MIL debouncing of DFC_TKAEmax" VALUE 0x80505790 Val_Wu16 906.000000000 DFC_Verb 0.00 906.000000000 FORMAT "%13.9" /end CHARACTERISTIC
/begin CHARACTERISTIC DFES_GrpRpr.DFC_TKAEmin_C "common MIL debouncing / group representative for common MIL debouncing of DFC_TKAEmin" VALUE 0x80505792 Val_Wu16 906.000000000 DFC_Verb 0.00 906.000000000 FORMAT "%13.9" /end CHARACTERISTIC
/begin CHARACTERISTIC DFES_GrpRpr.DFC_TKARmax_C "common MIL debouncing / group representative for common MIL debouncing of DFC_TKARmax" VALUE 0x80505794 Val_Wu16 906.000000000 DFC_Verb 0.00 906.000000000 FORMAT "%13.9" /end CHARACTERISTIC
/begin CHARACTERISTIC DFES_GrpRpr.DFC_TKARnpl_C "common MIL debouncing / group representative for common MIL debouncing of DFC_TKARnpl" VALUE 0x80505796 Val_Wu16 906.000000000 DFC_Verb 0.00 906.000000000 FORMAT "%13.9" /end CHARACTERISTIC
/begin CHARACTERISTIC DFES_GrpRpr.DFC_TMmax_Dummy_C "common MIL debouncing / group representative for common MIL debouncing of DFC_TMmax_Dummy" VALUE 0x80505798 Val_Wu16 906.000000000 DFC_Verb 0.00 906.000000000 FORMAT "%13.9" /end CHARACTERISTIC
/begin CHARACTERISTIC DFES_GrpRpr.DFC_TUMmax_Dummy_C "common MIL debouncing / group representative for common MIL debouncing of DFC_TUMmax_Dummy" VALUE 0x8050579A Val_Wu16 906.000000000 DFC_Verb 0.00 906.000000000 FORMAT "%13.9" /end CHARACTERISTIC
/begin CHARACTERISTIC DFES_GrpRpr.DFC_TWCDPriCatB1_C "common MIL debouncing / group representative for common MIL debouncing of DFC_TWCDPriCatB1" VALUE 0x8050579C Val_Wu16 906.000000000 DFC_Verb 0.00 906.000000000 FORMAT "%13.9" /end CHARACTERISTIC
/begin CHARACTERISTIC DFES_GrpRpr.DFC_ThrVlvClsdPosnFirstOffsLrnImpoB1_C "common MIL debouncing / group representative for common MIL debouncing of DFC_ThrVlvClsdPosnFirstOffsLrnImpoB1" VALUE 0x8050579E Val_Wu16 906.000000000 DFC_Verb 0.00 906.000000000 FORMAT "%13.9" /end CHARACTERISTIC
/begin CHARACTERISTIC DFES_GrpRpr.DFC_ThrVlvClsdPosnOffsLrnImpoB1_C "common MIL debouncing / group representative for common MIL debouncing of DFC_ThrVlvClsdPosnOffsLrnImpoB1" VALUE 0x805057A0 Val_Wu16 906.000000000 DFC_Verb 0.00 906.000000000 FORMAT "%13.9" /end CHARACTERISTIC
/begin CHARACTERISTIC DFES_GrpRpr.DFC_ThrVlvClsdPosnOffsLrnMaxB1_C "common MIL debouncing / group representative for common MIL debouncing of DFC_ThrVlvClsdPosnOffsLrnMaxB1" VALUE 0x805057A2 Val_Wu16 906.000000000 DFC_Verb 0.00 906.000000000 FORMAT "%13.9" /end CHARACTERISTIC
/begin CHARACTERISTIC DFES_GrpRpr.DFC_ThrVlvClsdPosnOffsLrnMinB1_C "common MIL debouncing / group representative for common MIL debouncing of DFC_ThrVlvClsdPosnOffsLrnMinB1" VALUE 0x805057A4 Val_Wu16 906.000000000 DFC_Verb 0.00 906.000000000 FORMAT "%13.9" /end CHARACTERISTIC
/begin CHARACTERISTIC DFES_GrpRpr.DFC_ThrVlvCtrlDeB1_C "common MIL debouncing / group representative for common MIL debouncing of DFC_ThrVlvCtrlDeB1" VALUE 0x805057A6 Val_Wu16 906.000000000 DFC_Verb 0.00 906.000000000 FORMAT "%13.9" /end CHARACTERISTIC
/begin CHARACTERISTIC DFES_GrpRpr.DFC_ThrVlvDycB1_C "common MIL debouncing / group representative for common MIL debouncing of DFC_ThrVlvDycB1" VALUE 0x805057A8 Val_Wu16 906.000000000 DFC_Verb 0.00 906.000000000 FORMAT "%13.9" /end CHARACTERISTIC
/begin CHARACTERISTIC DFES_GrpRpr.DFC_ThrVlvLimpAirPosnMaxAbsltDriftB1_C "common MIL debouncing / group representative for common MIL debouncing of DFC_ThrVlvLimpAirPosnMaxAbsltDriftB1" VALUE 0x805057AA Val_Wu16 906.000000000 DFC_Verb 0.00 906.000000000 FORMAT "%13.9" /end CHARACTERISTIC
/begin CHARACTERISTIC DFES_GrpRpr.DFC_ThrVlvLimpAirPosnMaxB1_C "common MIL debouncing / group representative for common MIL debouncing of DFC_ThrVlvLimpAirPosnMaxB1" VALUE 0x805057AC Val_Wu16 906.000000000 DFC_Verb 0.00 906.000000000 FORMAT "%13.9" /end CHARACTERISTIC
/begin CHARACTERISTIC DFES_GrpRpr.DFC_ThrVlvLimpAirPosnMaxRelDriftB1_C "common MIL debouncing / group representative for common MIL debouncing of DFC_ThrVlvLimpAirPosnMaxRelDriftB1" VALUE 0x805057AE Val_Wu16 906.000000000 DFC_Verb 0.00 906.000000000 FORMAT "%13.9" /end CHARACTERISTIC
/begin CHARACTERISTIC DFES_GrpRpr.DFC_ThrVlvLimpAirPosnMinB1_C "common MIL debouncing / group representative for common MIL debouncing of DFC_ThrVlvLimpAirPosnMinB1" VALUE 0x805057B0 Val_Wu16 906.000000000 DFC_Verb 0.00 906.000000000 FORMAT "%13.9" /end CHARACTERISTIC
/begin CHARACTERISTIC DFES_GrpRpr.DFC_ThrVlvOpenLoadB1_C "common MIL debouncing / group representative for common MIL debouncing of DFC_ThrVlvOpenLoadB1" VALUE 0x805057B2 Val_Wu16 906.000000000 DFC_Verb 0.00 906.000000000 FORMAT "%13.9" /end CHARACTERISTIC
/begin CHARACTERISTIC DFES_GrpRpr.DFC_ThrVlvOpenSprgB1_C "common MIL debouncing / group representative for common MIL debouncing of DFC_ThrVlvOpenSprgB1" VALUE 0x805057B4 Val_Wu16 906.000000000 DFC_Verb 0.00 906.000000000 FORMAT "%13.9" /end CHARACTERISTIC
/begin CHARACTERISTIC DFES_GrpRpr.DFC_ThrVlvOpenSprgSprdB1_C "common MIL debouncing / group representative for common MIL debouncing of DFC_ThrVlvOpenSprgSprdB1" VALUE 0x805057B6 Val_Wu16 906.000000000 DFC_Verb 0.00 906.000000000 FORMAT "%13.9" /end CHARACTERISTIC
/begin CHARACTERISTIC DFES_GrpRpr.DFC_ThrVlvOpenSprgTwnB1_C "common MIL debouncing / group representative for common MIL debouncing of DFC_ThrVlvOpenSprgTwnB1" VALUE 0x805057B8 Val_Wu16 906.000000000 DFC_Verb 0.00 906.000000000 FORMAT "%13.9" /end CHARACTERISTIC
/begin CHARACTERISTIC DFES_GrpRpr.DFC_ThrVlvOverTB1_C "common MIL debouncing / group representative for common MIL debouncing of DFC_ThrVlvOverTB1" VALUE 0x805057BA Val_Wu16 906.000000000 DFC_Verb 0.00 906.000000000 FORMAT "%13.9" /end CHARACTERISTIC
/begin CHARACTERISTIC DFES_GrpRpr.DFC_ThrVlvRetSprgB1_C "common MIL debouncing / group representative for common MIL debouncing of DFC_ThrVlvRetSprgB1" VALUE 0x805057BC Val_Wu16 906.000000000 DFC_Verb 0.00 906.000000000 FORMAT "%13.9" /end CHARACTERISTIC
/begin CHARACTERISTIC DFES_GrpRpr.DFC_ThrVlvRetSprgSprdB1_C "common MIL debouncing / group representative for common MIL debouncing of DFC_ThrVlvRetSprgSprdB1" VALUE 0x805057BE Val_Wu16 906.000000000 DFC_Verb 0.00 906.000000000 FORMAT "%13.9" /end CHARACTERISTIC
/begin CHARACTERISTIC DFES_GrpRpr.DFC_ThrVlvRetSprgTwnB1_C "common MIL debouncing / group representative for common MIL debouncing of DFC_ThrVlvRetSprgTwnB1" VALUE 0x805057C0 Val_Wu16 906.000000000 DFC_Verb 0.00 906.000000000 FORMAT "%13.9" /end CHARACTERISTIC
/begin CHARACTERISTIC DFES_GrpRpr.DFC_ThrVlvSens1MaxB1_C "common MIL debouncing / group representative for common MIL debouncing of DFC_ThrVlvSens1MaxB1" VALUE 0x805057C2 Val_Wu16 906.000000000 DFC_Verb 0.00 906.000000000 FORMAT "%13.9" /end CHARACTERISTIC
/begin CHARACTERISTIC DFES_GrpRpr.DFC_ThrVlvSens1NplB1_C "common MIL debouncing / group representative for common MIL debouncing of DFC_ThrVlvSens1NplB1" VALUE 0x805057C4 Val_Wu16 906.000000000 DFC_Verb 0.00 906.000000000 FORMAT "%13.9" /end CHARACTERISTIC
/begin CHARACTERISTIC DFES_GrpRpr.DFC_ThrVlvSens2MaxB1_C "common MIL debouncing / group representative for common MIL debouncing of DFC_ThrVlvSens2MaxB1" VALUE 0x805057C6 Val_Wu16 906.000000000 DFC_Verb 0.00 906.000000000 FORMAT "%13.9" /end CHARACTERISTIC
/begin CHARACTERISTIC DFES_GrpRpr.DFC_ThrVlvSens2MinB1_C "common MIL debouncing / group representative for common MIL debouncing of DFC_ThrVlvSens2MinB1" VALUE 0x805057C8 Val_Wu16 906.000000000 DFC_Verb 0.00 906.000000000 FORMAT "%13.9" /end CHARACTERISTIC
/begin CHARACTERISTIC DFES_GrpRpr.DFC_ThrVlvSens2NplB1_C "common MIL debouncing / group representative for common MIL debouncing of DFC_ThrVlvSens2NplB1" VALUE 0x805057CA Val_Wu16 906.000000000 DFC_Verb 0.00 906.000000000 FORMAT "%13.9" /end CHARACTERISTIC
/begin CHARACTERISTIC DFES_GrpRpr.DFC_ThrVlvShoCircB1_C "common MIL debouncing / group representative for common MIL debouncing of DFC_ThrVlvShoCircB1" VALUE 0x805057CC Val_Wu16 906.000000000 DFC_Verb 0.00 906.000000000 FORMAT "%13.9" /end CHARACTERISTIC
/begin CHARACTERISTIC DFES_GrpRpr.DFC_ThrVlvSpiErrB1_C "common MIL debouncing / group representative for common MIL debouncing of DFC_ThrVlvSpiErrB1" VALUE 0x805057CE Val_Wu16 906.000000000 DFC_Verb 0.00 906.000000000 FORMAT "%13.9" /end CHARACTERISTIC
/begin CHARACTERISTIC DFES_GrpRpr.DFC_ThrvlvSens1MinB1_C "common MIL debouncing / group representative for common MIL debouncing of DFC_ThrvlvSens1MinB1" VALUE 0x805057D0 Val_Wu16 906.000000000 DFC_Verb 0.00 906.000000000 FORMAT "%13.9" /end CHARACTERISTIC
/begin CHARACTERISTIC DFES_GrpRpr.DFC_TiOffTBasdChkFast_C "common MIL debouncing / group representative for common MIL debouncing of DFC_TiOffTBasdChkFast" VALUE 0x805057D2 Val_Wu16 906.000000000 DFC_Verb 0.00 906.000000000 FORMAT "%13.9" /end CHARACTERISTIC
/begin CHARACTERISTIC DFES_GrpRpr.DFC_TiOffTBasdChkSlow_C "common MIL debouncing / group representative for common MIL debouncing of DFC_TiOffTBasdChkSlow" VALUE 0x805057D4 Val_Wu16 906.000000000 DFC_Verb 0.00 906.000000000 FORMAT "%13.9" /end CHARACTERISTIC
/begin CHARACTERISTIC DFES_GrpRpr.DFC_UEGOSnsrMntdS1B1_C "common MIL debouncing / group representative for common MIL debouncing of DFC_UEGOSnsrMntdS1B1" VALUE 0x805057D6 Val_Wu16 906.000000000 DFC_Verb 0.00 906.000000000 FORMAT "%13.9" /end CHARACTERISTIC
/begin CHARACTERISTIC DFES_GrpRpr.DFC_VehVSig_C "common MIL debouncing / group representative for common MIL debouncing of DFC_VehVSig" VALUE 0x805057D8 Val_Wu16 906.000000000 DFC_Verb 0.00 906.000000000 FORMAT "%13.9" /end CHARACTERISTIC
/begin CHARACTERISTIC DFES_GrpRpr.DFC_VlvLftFbSwtIntk11SpclFail_C "common MIL debouncing / group representative for common MIL debouncing of DFC_VlvLftFbSwtIntk11SpclFail" VALUE 0x805057DA Val_Wu16 906.000000000 DFC_Verb 0.00 906.000000000 FORMAT "%13.9" /end CHARACTERISTIC
/begin CHARACTERISTIC DFES_GrpRpr.DFC_VlvLftFbSwtIntk11StdFail_C "common MIL debouncing / group representative for common MIL debouncing of DFC_VlvLftFbSwtIntk11StdFail" VALUE 0x805057DC Val_Wu16 906.000000000 DFC_Verb 0.00 906.000000000 FORMAT "%13.9" /end CHARACTERISTIC
/begin CHARACTERISTIC DFES_MonEvtMSK0_C "Event filter mask of Monitoring - Mask Id mast have 0 at bit mask 0 positions" VALUE 0x804D9A66 Val_Wu16 65535.00 OneToOne 0.00 65535.00 FORMAT "%8.2" /end CHARACTERISTIC
/begin CHARACTERISTIC DFES_MonEvtMSK1_C "Event filter mask of Monitoring - Mask Id mast have 1 at bit mask 1 positions" VALUE 0x804D9A68 Val_Wu16 65535.00 OneToOne 0.00 65535.00 FORMAT "%8.2" /end CHARACTERISTIC
/begin CHARACTERISTIC DFES_MonRepeat_C "switch to ignore same kind of monitoring events, set to 0 to suppress identical events in a row" VALUE 0x804D9A6A Val_Wu8 255.0 OneToOne 0.00 255.0 FORMAT "%5.1" /end CHARACTERISTIC
/begin CHARACTERISTIC DFES_numClsDlt_CA "Fault class parameter: Number of cycles for OBD delete counter" VAL_BLK 0x804D9A6B ValA_Wu8 255.0 DFES_OneToOne 0.00 255.0 FORMAT "%5.1" NUMBER 31 /end CHARACTERISTIC
/begin CHARACTERISTIC DFES_numClsFaultCycl_CA "Fault class parameter: Number of cycles for fault counter" VAL_BLK 0x804D9A8A ValA_Wu8 255.0 DFES_OneToOne 0.00 255.0 FORMAT "%5.1" NUMBER 31 /end CHARACTERISTIC
/begin CHARACTERISTIC DFES_numClsHealCycl_CA "Fault class parameter: Number of cycles for healing counter" VAL_BLK 0x804D9AA9 ValA_Wu8 255.0 DFES_OneToOne 0.00 255.0 FORMAT "%5.1" NUMBER 31 /end CHARACTERISTIC
/begin CHARACTERISTIC DFES_numClsPndDlt_CA "Fault class parameter: Number of cycles for pending delete counter" VAL_BLK 0x804D9AC8 ValA_Wu8 255.0 DFES_OneToOne 0.00 255.0 FORMAT "%5.1" NUMBER 31 /end CHARACTERISTIC
/begin CHARACTERISTIC DFES_numClsSvcDlt_CA "Fault class parameter: Number of cycles for delete counter" VAL_BLK 0x804D9AE7 ValA_Wu8 255.0 DFES_OneToOne 0.00 255.0 FORMAT "%5.1" NUMBER 31 /end CHARACTERISTIC
/begin CHARACTERISTIC DFES_numClsSVSFaultCycl_CA "Fault class parameter: Number of cycles for SVS lamp fault counter" VAL_BLK 0x804D9B06 ValA_Wu8 255.0 DFES_OneToOne 0.00 255.0 FORMAT "%5.1" NUMBER 31 /end CHARACTERISTIC
/begin CHARACTERISTIC DFES_numClsSVSHealCycl_CA "Fault class parameter: Number of cycles for SVS lamp healing counter" VAL_BLK 0x804D9B25 ValA_Wu8 255.0 DFES_OneToOne 0.00 255.0 FORMAT "%5.1" NUMBER 31 /end CHARACTERISTIC
/begin CHARACTERISTIC DFES_numPDTC_C "Number of permanent DTCs (from 0 to configured maximum value)" VALUE 0x804D9B44 Val_Wu8 5.000 DFES_OneToOne 0.00 5.000 FORMAT "%5.3" EXTENDED_LIMITS 0.00 255.0 /end CHARACTERISTIC
/begin CHARACTERISTIC DFES_ThresSimCond.n_C "" VALUE 0x804D9B46 Val_Wu16 16383.75 DFES_nPID0C 0.00 16383.75 FORMAT "%8.2" /end CHARACTERISTIC
/begin CHARACTERISTIC DFES_ThresSimCond.r_C "" VALUE 0x804D9B48 Val_Wu8 100.0 DFES_rPID04 0.00 100.0 FORMAT "%5.1" /end CHARACTERISTIC
/begin CHARACTERISTIC DFES_ThresSimCond.t_C "" VALUE 0x804D9B49 Val_Wu8 255.0 DFES_tPID05 -40.0 215.0 FORMAT "%5.1" /end CHARACTERISTIC
/begin CHARACTERISTIC DFES_xAsgnExtdFrzFrSig_CA "Signal selection for extended freeze frame (signal based)" VAL_BLK 0x804D9B4A ValA_Wu16 1168.00000000 Signals_IntSigNumVerb 0.00 1168.00000000 FORMAT "%13.8" NUMBER 50 /end CHARACTERISTIC
/begin CHARACTERISTIC DFES_xAsgnFrzFrSig_CA "Signal selection for freeze frame (signal based)" VAL_BLK 0x804D9BAE ValA_Wu16 1168.00000000 Signals_IntSigNumVerb 0.00 1168.00000000 FORMAT "%13.8" NUMBER 87 /end CHARACTERISTIC
/begin CHARACTERISTIC DFES_xClsDltTrg_CA "Fault class parameter: Trigger type for OBD delete counter" VAL_BLK 0x804D9C5C ValA_Wu8 11.0000000000 DSMAUX_DTRGVerb 0.00 11.0000000000 FORMAT "%13.10" NUMBER 31 /end CHARACTERISTIC
/begin CHARACTERISTIC DFES_xClsFaultTrg_CA "Fault class parameter: Trigger type for fault counter" VAL_BLK 0x804D9C7B ValA_Wu8 11.0000000000 DSMAUX_DTRGVerb 0.00 11.0000000000 FORMAT "%13.10" NUMBER 31 /end CHARACTERISTIC
/begin CHARACTERISTIC DFES_xClsFltMIL_CA "Fault class parameter: MIL control" VAL_BLK 0x804D9C9A ValA_Wu8 3.00000000000 DFES_LampFltMIL 0.00 3.00000000000 FORMAT "%13.11" NUMBER 31 /end CHARACTERISTIC
/begin CHARACTERISTIC DFES_xClsFltSVS_CA "Fault class parameter: SVS lamp control" VAL_BLK 0x804D9CB9 ValA_Wu8 8.00000000000 DFES_LampFltSVS 0.00 8.00000000000 FORMAT "%13.11" NUMBER 31 /end CHARACTERISTIC
/begin CHARACTERISTIC DFES_xClsHealTrg_CA "Fault class parameter: Trigger type for healing counter" VAL_BLK 0x804D9CD8 ValA_Wu8 11.0000000000 DSMAUX_DTRGVerb 0.00 11.0000000000 FORMAT "%13.10" NUMBER 31 /end CHARACTERISTIC
/begin CHARACTERISTIC DFES_xClsPndDltTrg_CA "Fault class parameter: Trigger type for pending delete counter" VAL_BLK 0x804D9CF7 ValA_Wu8 11.0000000000 DSMAUX_DTRGVerb 0.00 11.0000000000 FORMAT "%13.10" NUMBER 31 /end CHARACTERISTIC
/begin CHARACTERISTIC DFES_xClsPrio_CA "Fault class parameter: Static priority and tester visibility" VAL_BLK 0x804D9D16 ValA_Wu8 214.000000000 DFES_TstVisAndPrio 3.000000000 217.000000000 FORMAT "%13.9" NUMBER 31 /end CHARACTERISTIC
/begin CHARACTERISTIC DFES_xClsSvcDltTrg_CA "Fault class parameter: Trigger type for delete counter" VAL_BLK 0x804D9D35 ValA_Wu8 11.0000000000 DSMAUX_DTRGVerb 0.00 11.0000000000 FORMAT "%13.10" NUMBER 31 /end CHARACTERISTIC
/begin CHARACTERISTIC DFES_xClsSVSFaultTrg_CA "Fault class parameter: Trigger type for SVS lamp fault counter" VAL_BLK 0x804D9D54 ValA_Wu8 11.0000000000 DSMAUX_DTRGVerb 0.00 11.0000000000 FORMAT "%13.10" NUMBER 31 /end CHARACTERISTIC
/begin CHARACTERISTIC DFES_xClsSVSHealTrg_CA "Fault class parameter: Trigger type for SVS lamp healing counter" VAL_BLK 0x804D9D73 ValA_Wu8 11.0000000000 DSMAUX_DTRGVerb 0.00 11.0000000000 FORMAT "%13.10" NUMBER 31 /end CHARACTERISTIC
/begin CHARACTERISTIC DFSKVMN "lower threshold for fuel-level sensor plausibility error detection" VALUE 0x8053AED6 RB_Val_Ws16 6553.500 vol_q0p1_l -3276.800 3276.700 FORMAT "%8.3" /end CHARACTERISTIC
/begin CHARACTERISTIC DFSKVMX "upper threshold for fuel-level sensor plausibility error detection" VALUE 0x8053AED8 RB_Val_Ws16 6553.500 vol_q0p1_l -3276.800 3276.700 FORMAT "%8.3" /end CHARACTERISTIC
/begin CHARACTERISTIC DFSTTH "Minimum fuel-volume-change in tank for plausibility check" VALUE 0x8053AEDA RB_Val_Wu16 6553.500 vol_q0p1_l 0.00 6553.500 FORMAT "%8.3" /end CHARACTERISTIC
/begin CHARACTERISTIC DHDEVE0P "Parameter for detection failure power stage bank 0" VALUE 0x8053AF24 RB_Val_Wu8 255.0 dez 0.00 255.0 FORMAT "%5.1" /end CHARACTERISTIC
/begin CHARACTERISTIC DHDEVE1P "Parameter for detection failure power stage bank 0" VALUE 0x8053AF25 RB_Val_Wu8 255.0 dez 0.00 255.0 FORMAT "%5.1" /end CHARACTERISTIC
/begin CHARACTERISTIC DiaActr_ElecHBrdgDiag_DbgSigId_C "Select H-Bridge signal to be debugged." VALUE 0x8058B600 Val_Wu16 65535.00 OneToOne 0.00 65535.00 FORMAT "%8.2" /end CHARACTERISTIC
/begin CHARACTERISTIC DiaActr_ElecHBrdgDiag_DbgSigType_C "Select the signal type of signal to be debugged." VALUE 0x8058B602 Val_Wu8 1.00000000000 DiaActr_ElecHBrdgDiag_DbgSigType_COMPU_VERB 0.00 1.00000000000 FORMAT "%13.11" /end CHARACTERISTIC
/begin CHARACTERISTIC DiaActr_ElecHBrdgDiag_OlEnaSwtOff_C "Enable powerstage switchoff during permanent error and preliminary heal of open load error. [Relevant only if open load is configured in active \ normal drive mode]." VALUE 0x8058B603 Val_Wu8 1.00000000000 DiaActr_ElecHBrdgDiag_OlEnaSwtOff_COMPU_VERB 0.00 1.00000000000 FORMAT "%13.11" /end CHARACTERISTIC
/begin CHARACTERISTIC DKVBTH "minimum-volume of fuel-consumed for tank plausibility check" VALUE 0x8053AEDC RB_Val_Wu16 255.9961 vol_q3p90625Em3_l 0.00 255.9961 FORMAT "%8.4" /end CHARACTERISTIC
/begin CHARACTERISTIC FlLvl_ctMacCntRstPlausyChk_C "Maximum calibratable counts to reset dualtank fuel-level plausibility-check since fuel tank full condition is set." VALUE 0x8053AEDE RB_Val_Wu16 65535.00 OneToOne 0.00 65535.00 FORMAT "%8.2" /end CHARACTERISTIC
/begin CHARACTERISTIC Fllvl_lenPlausDiagFuSnsrMin_C "Minimum Length to release the IUMPR-FID of the plausibility diagnosis for fuel level sensor." VALUE 0x8053AEE0 RB_Val_Ws32 4294967295.00 Length -2147483648.00 2147483647.00 FORMAT "%13.2" /end CHARACTERISTIC
/begin CHARACTERISTIC FlLvl_stPlausyDiagRst_C "Code word to select reseting of plausibility diagnosis in case of tank full or tank empty" VALUE 0x8053AEE4 RB_Val_Wu8 255.0 OneToOne 0.00 255.0 FORMAT "%5.1" /end CHARACTERISTIC
/begin CHARACTERISTIC FlLvl_stSlopDetn_C "Enable or disable slope detection for fuel level" VALUE 0x8053AEE5 RB_Val_Wu8 255.0 OneToOne 0.00 255.0 FORMAT "%5.1" /end CHARACTERISTIC
/begin CHARACTERISTIC FlLvl_tiLongStandStill_C "Delay time to wait before resetting the plausibility diagnosis in case of fuel in upper or lower dead zone" VALUE 0x8053AEE6 RB_Val_Wu8 255.0 t_q1 0.00 255.0 FORMAT "%5.1" /end CHARACTERISTIC
/begin CHARACTERISTIC FlLvl_tiRefuOnDec_C "Check for detection on fuel level decrement in slope" VALUE 0x8053AEE7 RB_Val_Wu8 255.0 t_q1 0.00 255.0 FORMAT "%5.1" /end CHARACTERISTIC
/begin CHARACTERISTIC FlLvl_tiRefuOnInc_C "Check for detection on fuel level increment in slope" VALUE 0x8053AEE8 RB_Val_Wu8 255.0 t_q1 0.00 255.0 FORMAT "%5.1" /end CHARACTERISTIC
/begin CHARACTERISTIC FlLvl_vMovingChkThdHi_C "Upper threshold for vehicle speed in case of plausibility diagnosis reset for upper dead zone" VALUE 0x8053AEEA RB_Val_Ws16 655.3500 Vel -327.6800 327.6700 FORMAT "%8.4" /end CHARACTERISTIC
/begin CHARACTERISTIC FlLvl_vMovingChkThdLo_C "lower threshold for vehicle speed in case of plausibility diagnosis reset for upper dead zone" VALUE 0x8053AEEC RB_Val_Ws16 655.3500 Vel -327.6800 327.6700 FORMAT "%8.4" /end CHARACTERISTIC
/begin CHARACTERISTIC FlLvl_vVehStopChkThdHi_C "High threshold for vehicle stop check" VALUE 0x8053AEEE RB_Val_Wu16 511.9922 vfzg_uw_b512 0.00 511.9922 FORMAT "%8.4" /end CHARACTERISTIC
/begin CHARACTERISTIC FlLvl_vVehStopChkThdLo_C "Low threshold for vehicle stop check" VALUE 0x8053AEF0 RB_Val_Wu16 511.9922 vfzg_uw_b512 0.00 511.9922 FORMAT "%8.4" /end CHARACTERISTIC
/begin CHARACTERISTIC FST1SKTH "Primary fuel-tank volume-change threshold for sensor-stuck detection" VALUE 0x8053AEF2 RB_Val_Wu16 6553.500 vol_q0p1_l 0.00 6553.500 FORMAT "%8.3" /end CHARACTERISTIC
/begin CHARACTERISTIC KLDFSTVFZG "delay time for release diagnosis dependent on fuel level difference" CURVE 0x8053AEF4 RB_Curve_U16_U16 65535.00 t_q1 0.00 65535.00 FORMAT "%8.2"
 /begin AXIS_DESCR STD_AXIS dfstig_w vol_q0p1_l 4 0.00 6553.500 FORMAT "%8.3" DEPOSIT ABSOLUTE /end AXIS_DESCR
/end CHARACTERISTIC
/begin CHARACTERISTIC MISFZUL "number of permissible misfire" VALUE 0x8053AF26 RB_Val_Wu8 255.0 dez 0.00 255.0 FORMAT "%5.1" /end CHARACTERISTIC
/begin CHARACTERISTIC NFSTPLMN "min. Number of equal plausibility-results for majority-decision" VALUE 0x8053AF06 RB_Val_Wu8 126.0 dez 1.0 127.0 FORMAT "%5.1" EXTENDED_LIMITS 0.00 255.0 /end CHARACTERISTIC
/begin CHARACTERISTIC NMNDHDEVO "minimum engine speed for function DHDEVO" VALUE 0x8053AF27 RB_Val_Wu8 10200. nmot_ub_q40 0.00 10200. FORMAT "%5.0" /end CHARACTERISTIC
/begin CHARACTERISTIC NMXDHDEVO "maximum engine speed for function DHDEVO" VALUE 0x8053AF28 RB_Val_Wu8 10200. nmot_ub_q40 0.00 10200. FORMAT "%5.0" /end CHARACTERISTIC
/begin CHARACTERISTIC RDHDEVOCTR "Number of synchros to reset counters" VALUE 0x8053AF29 RB_Val_Wu8 255.0 dez 0.00 255.0 FORMAT "%5.1" /end CHARACTERISTIC
/begin CHARACTERISTIC RLMXDHDEVO "load threshold for function DHDEVO" VALUE 0x8053AF2A RB_Val_Wu8 191.3 rel_ub_q0p75 0.00 191.3 FORMAT "%5.1" /end CHARACTERISTIC
/begin CHARACTERISTIC SF_FST "Sum Fault Fuel Level" VAL_BLK 0x8053AF1C RB_ValA_Wu16 82.0000000000 dfp_verbal 0.00 82.0000000000 FORMAT "%13.10" READ_ONLY NUMBER 4 /end CHARACTERISTIC
/begin CHARACTERISTIC TANKABN "minimum fuel level decrease for refuelling diagnostic" VALUE 0x8053AF08 RB_Val_Ws16 6553.500 vol_q0p1_l -3276.800 3276.700 FORMAT "%8.3" /end CHARACTERISTIC
/begin CHARACTERISTIC TANKMN "minimum fuel in for refuelling diagnostic" VALUE 0x8053AF0A RB_Val_Ws16 6553.500 vol_q0p1_l -3276.800 3276.700 FORMAT "%8.3" /end CHARACTERISTIC
/begin CHARACTERISTIC TANKVOL "maximum of possible existent fuel volume in complete tank system" VALUE 0x8053AF0C RB_Val_Wu16 255.9961 vol_q3p90625Em3_l 0.00 255.9961 FORMAT "%8.4" /end CHARACTERISTIC
/begin CHARACTERISTIC TANKVOLH "maximum physical possible fuel level in main tank" VALUE 0x8053AF0E RB_Val_Wu16 6553.500 vol_q0p1_l 0.00 6553.500 FORMAT "%8.3" /end CHARACTERISTIC
/begin CHARACTERISTIC TDDHDEVOER "delay time error detection DHDEVO" VALUE 0x8053AF2B RB_Val_Wu8 25.50 t_q0p1 0.00 25.50 FORMAT "%5.2" /end CHARACTERISTIC
/begin CHARACTERISTIC TVFAHRTT "Delay time vehicle speed for plaus. tank fluid level" VALUE 0x8053AF10 RB_Val_Wu8 255.0 t_q1 0.00 255.0 FORMAT "%5.1" /end CHARACTERISTIC
/begin CHARACTERISTIC TVFSTPRC "debounce time for ""physical range check""" VALUE 0x8053AF11 RB_Val_Wu8 255.0 t_q1 0.00 255.0 FORMAT "%5.1" /end CHARACTERISTIC
/begin CHARACTERISTIC TVFSTTG "Delay time fuel level tank valid" VALUE 0x8053AF12 RB_Val_Wu8 255.0 t_q1 0.00 255.0 FORMAT "%5.1" /end CHARACTERISTIC
/begin CHARACTERISTIC TVHATA "delay time before refuelling - cycle" VALUE 0x8053AF13 RB_Val_Wu8 255.0 t_q1 0.00 255.0 FORMAT "%5.1" /end CHARACTERISTIC
/begin CHARACTERISTIC VFZGDFSTT "threshold vehicle speed for plaus. tank fluid level" VALUE 0x8053AF14 RB_Val_Wu8 318.8 vfzg_ub_q1p25 0.00 318.8 FORMAT "%5.1" /end CHARACTERISTIC
/begin CHARACTERISTIC VOLBMNSL "maximum fuel volume below minimum sensor level" VALUE 0x8053AF16 RB_Val_Ws16 6553.500 vol_q0p1_l -3276.800 3276.700 FORMAT "%8.3" /end CHARACTERISTIC
/begin CHARACTERISTIC VOLOMXSL "maximum fuel volume over maximum sensor level" VALUE 0x8053AF18 RB_Val_Ws16 6553.500 vol_q0p1_l -3276.800 3276.700 FORMAT "%8.3" /end CHARACTERISTIC
/begin CHARACTERISTIC ZFSTPLTH "Minimum time threshold for Dualtank plausibility failure detection" VALUE 0x8053AF1A RB_Val_Wu8 255.0 t_q1 0.00 255.0 FORMAT "%5.1" /end CHARACTERISTIC
/begin MEASUREMENT B_clrfste_msg "Condition deleting electrical/CAN-signal error from fault memory" UBYTE B_TRUE 1 100 0.00 1.00000000000 BIT_MASK 0x1 FORMAT "%13.11" ECU_ADDRESS 0x600013FD /end MEASUREMENT
/begin MEASUREMENT B_clrfst_msg "Condition fuel level sender error is deleted from fault memory" UBYTE B_TRUE 1 100 0.00 1.00000000000 BIT_MASK 0x1 FORMAT "%13.11" ECU_ADDRESS 0x600013FE /end MEASUREMENT
/begin MEASUREMENT B_dfsininv "initialization of NV values of %DFSTT is finished" UBYTE B_TRUE 1 100 0.00 1.00000000000 BIT_MASK 0x1 FORMAT "%13.11" ECU_ADDRESS 0x60036DE7 /end MEASUREMENT
/begin MEASUREMENT B_dfstvfzg "Condition: vehicle speed for plausible tank fluid level" UBYTE B_TRUE 1 100 0.00 1.00000000000 BIT_MASK 0x1 FORMAT "%13.11" ECU_ADDRESS 0x60000107 /end MEASUREMENT
/begin MEASUREMENT B_dhdevoe "Condition: electrical failure of high pressure injector (HPIV) power stage bank of diagnosis DHDEVO" UBYTE B_TRUE 1 100 0.00 1.00000000000 BIT_MASK 0x1 FORMAT "%13.11" ECU_ADDRESS 0x70000380 /end MEASUREMENT
/begin MEASUREMENT B_dhdevom "Condition: mechanical failure HPIV" UBYTE B_TRUE 1 100 0.00 1.00000000000 BIT_MASK 0x1 FORMAT "%13.11" ECU_ADDRESS 0x7000037F /end MEASUREMENT
/begin MEASUREMENT B_dtankm "condition refuelling possible" UBYTE B_TRUE 1 100 0.00 1.00000000000 BIT_MASK 0x1 FORMAT "%13.11" ECU_ADDRESS 0x60000106 /end MEASUREMENT
/begin MEASUREMENT B_efstgth_msg "Condition fuel level sender error ""fuel level greater than main tank"" existent" UBYTE B_TRUE 1 100 0.00 1.00000000000 BIT_MASK 0x1 FORMAT "%13.11" ECU_ADDRESS 0x60000236 /end MEASUREMENT
/begin MEASUREMENT B_efstnpl_msg "Condition fuel level sender error ""fuel level not plausible against fuel consumption"" existent" UBYTE B_TRUE 1 100 0.00 1.00000000000 BIT_MASK 0x1 FORMAT "%13.11" ECU_ADDRESS 0x60000235 /end MEASUREMENT
/begin MEASUREMENT B_efstsk1_msg "Condition fuel level sender error ""fuel level not plausible against fuel consumption, because signal 1 stucks"" existent" UBYTE B_TRUE 1 100 0.00 1.00000000000 BIT_MASK 0x1 FORMAT "%13.11" ECU_ADDRESS 0x60000234 /end MEASUREMENT
/begin MEASUREMENT B_fplreff "interim result of the Condition: Dualtank fuel-level plausibility-check restart if driving" UBYTE B_TRUE 1 100 0.00 1.00000000000 BIT_MASK 0x1 FORMAT "%13.11" ECU_ADDRESS 0x60036DE6 /end MEASUREMENT
/begin MEASUREMENT B_fst1sk_msg "Condition: Primary-tank fuel-sensor may be stuck" UBYTE B_TRUE 1 100 0.00 1.00000000000 BIT_MASK 0x1 FORMAT "%13.11" ECU_ADDRESS 0x60036E2B /end MEASUREMENT
/begin MEASUREMENT B_fstelerr_msg "Condition electrical/CAN-signal error in fault memory existent" UBYTE B_TRUE 1 100 0.00 1.00000000000 BIT_MASK 0x1 FORMAT "%13.11" ECU_ADDRESS 0x60039852 /end MEASUREMENT
/begin MEASUREMENT B_fstneu "condition first fuel level after ignition" UBYTE B_TRUE 1 100 0.00 1.00000000000 BIT_MASK 0x1 FORMAT "%13.11" ECU_ADDRESS 0x60000105 /end MEASUREMENT
/begin MEASUREMENT B_fstofen "Refueling detection" UBYTE B_TRUE 1 100 0.00 1.00000000000 BIT_MASK 0x1 FORMAT "%13.11" ECU_ADDRESS 0x60000104 /end MEASUREMENT
/begin MEASUREMENT B_fstplcfm "condition plaus. error suspicion and new start of partial plaus. check" UBYTE B_TRUE 1 100 0.00 1.00000000000 BIT_MASK 0x1 FORMAT "%13.11" ECU_ADDRESS 0x60000103 /end MEASUREMENT
/begin MEASUREMENT B_fstplen "Condition: Dueltank fuel-level plausibility-check enable" UBYTE B_TRUE 1 100 0.00 1.00000000000 BIT_MASK 0x1 FORMAT "%13.11" ECU_ADDRESS 0x60000102 /end MEASUREMENT
/begin MEASUREMENT B_fstpler_msg "Condition: Dualtank fuel-level plausibility-error is suspected" UBYTE B_TRUE 1 100 0.00 1.00000000000 BIT_MASK 0x1 FORMAT "%13.11" ECU_ADDRESS 0x60000218 /end MEASUREMENT
/begin MEASUREMENT B_fstploki "Condition: internal fuel-level plausibility-check is OK" UBYTE B_TRUE 1 100 0.00 1.00000000000 BIT_MASK 0x1 FORMAT "%13.11" ECU_ADDRESS 0x60000101 /end MEASUREMENT
/begin MEASUREMENT B_fstplok_msg "Condition: fuel-level plausibility-check is OK" UBYTE B_TRUE 1 100 0.00 1.00000000000 BIT_MASK 0x1 FORMAT "%13.11" ECU_ADDRESS 0x60000217 /end MEASUREMENT
/begin MEASUREMENT B_fstplre "Condition: Dualtank fuel-level plausibility-check restart" UBYTE B_TRUE 1 100 0.00 1.00000000000 BIT_MASK 0x1 FORMAT "%13.11" ECU_ADDRESS 0x60000100 /end MEASUREMENT
/begin MEASUREMENT B_fstplref "Condition: Dualtank fuel-level plausibility-check restart if driving" UBYTE B_TRUE 1 100 0.00 1.00000000000 BIT_MASK 0x1 FORMAT "%13.11" ECU_ADDRESS 0x600000FF /end MEASUREMENT
/begin MEASUREMENT B_fstrok_msg "Condition result of physical range check okay" UBYTE B_TRUE 1 100 0.00 1.00000000000 BIT_MASK 0x1 FORMAT "%13.11" ECU_ADDRESS 0x60000216 /end MEASUREMENT
/begin MEASUREMENT B_fsttab "condition fuel level decrease while ignition on" UBYTE B_TRUE 1 100 0.00 1.00000000000 BIT_MASK 0x1 FORMAT "%13.11" ECU_ADDRESS 0x600000FE /end MEASUREMENT
/begin MEASUREMENT B_fsttldv_msg "Condition: Fuel level for Tank leak diagnosis is valid" UBYTE B_TRUE 1 100 0.00 1.00000000000 BIT_MASK 0x1 FORMAT "%13.11" ECU_ADDRESS 0x60039851 /end MEASUREMENT
/begin MEASUREMENT B_fsttnp_msg "Condition: Dualtank fuel-level plausibility-error detected" UBYTE B_TRUE 1 100 0.00 1.00000000000 BIT_MASK 0x1 FORMAT "%13.11" ECU_ADDRESS 0x60000215 /end MEASUREMENT
/begin MEASUREMENT B_fsttzu_msg "condition fuel level increases while ignition on" UBYTE B_TRUE 1 100 0.00 1.00000000000 BIT_MASK 0x1 FORMAT "%13.11" ECU_ADDRESS 0x60000214 /end MEASUREMENT
/begin MEASUREMENT B_hdevo_msg "Condition open clamping HPIV" UBYTE B_TRUE 1 100 0.00 1.00000000000 BIT_MASK 0x1 FORMAT "%13.11" ECU_ADDRESS 0x70000BAC /end MEASUREMENT
/begin MEASUREMENT B_iok "Condition: interval for plaus.check okay" UBYTE B_TRUE 1 100 0.00 1.00000000000 BIT_MASK 0x1 FORMAT "%13.11" ECU_ADDRESS 0x600000FD /end MEASUREMENT
/begin MEASUREMENT B_mnhdr "Condition: Error rail pressure too low" UBYTE B_TRUE 1 100 0.00 1.00000000000 BIT_MASK 0x1 FORMAT "%13.11" ECU_ADDRESS 0x7000037E /end MEASUREMENT
/begin MEASUREMENT B_nodhdevo "Condition: no diagnosis open HPIV" UBYTE B_TRUE 1 100 0.00 1.00000000000 BIT_MASK 0x1 FORMAT "%13.11" ECU_ADDRESS 0x7000037D /end MEASUREMENT
/begin MEASUREMENT B_nomfcnt "Condition: no misfire counted" UBYTE B_TRUE 1 100 0.00 1.00000000000 BIT_MASK 0x1 FORMAT "%13.11" ECU_ADDRESS 0x7000037C /end MEASUREMENT
/begin MEASUREMENT B_nomfdet "Condion: no misfire detected" UBYTE B_TRUE 1 100 0.00 1.00000000000 BIT_MASK 0x1 FORMAT "%13.11" ECU_ADDRESS 0x7000037B /end MEASUREMENT
/begin MEASUREMENT B_tankab_msg "condition fuel level decrease" UBYTE B_TRUE 1 100 0.00 1.00000000000 BIT_MASK 0x1 FORMAT "%13.11" ECU_ADDRESS 0x600013BC /end MEASUREMENT
/begin MEASUREMENT B_tankdy_msg "condition fuel level dynamic during refuelling" UBYTE B_TRUE 1 100 0.00 1.00000000000 BIT_MASK 0x1 FORMAT "%13.11" ECU_ADDRESS 0x600013BB /end MEASUREMENT
/begin MEASUREMENT B_tankend "condition refuelling end" UBYTE B_TRUE 1 100 0.00 1.00000000000 BIT_MASK 0x1 FORMAT "%13.11" ECU_ADDRESS 0x600000FC /end MEASUREMENT
/begin MEASUREMENT B_tankg_msg "Condition: re-fuelling bit valid" UBYTE B_TRUE 1 100 0.00 1.00000000000 BIT_MASK 0x1 FORMAT "%13.11" ECU_ADDRESS 0x600001CC /end MEASUREMENT
/begin MEASUREMENT B_tankzu_msg "condition fuel level increase" UBYTE B_TRUE 1 100 0.00 1.00000000000 BIT_MASK 0x1 FORMAT "%13.11" ECU_ADDRESS 0x600001CB /end MEASUREMENT
/begin MEASUREMENT B_tank_msg "Condition: re-fuelling" UBYTE B_TRUE 1 100 0.00 1.00000000000 BIT_MASK 0x1 FORMAT "%13.11" ECU_ADDRESS 0x600001CD /end MEASUREMENT
/begin MEASUREMENT dfskv_w "difference consumed fuel - fuel level difference" SWORD vol_q0p1_l 1 100 -3276.800 3276.700 FORMAT "%8.3" ECU_ADDRESS 0x60001054 /end MEASUREMENT
/begin MEASUREMENT dfstigof_w_msg "difference fuel levels after restart" SWORD vol_q0p1_l 1 100 -3276.800 3276.700 FORMAT "%8.3" ECU_ADDRESS 0x600014CC /end MEASUREMENT
/begin MEASUREMENT dfstigo_w_msg "difference fuel lvels during vehicle halts" SWORD vol_q0p1_l 1 100 -3276.800 3276.700 FORMAT "%8.3" ECU_ADDRESS 0x600014CE /end MEASUREMENT
/begin MEASUREMENT dfstig_w "differnez fuel level" UWORD vol_q0p1_l 1 100 0.00 6553.500 FORMAT "%8.3" ECU_ADDRESS 0x60001052 /end MEASUREMENT
/begin MEASUREMENT dfstt_w "difference fuel levels" SWORD vol_q0p1_l 1 100 -3276.800 3276.700 FORMAT "%8.3" ECU_ADDRESS 0x60001050 /end MEASUREMENT
/begin MEASUREMENT DHDEVO_flgDsmClr100ms "Flag for DSM clear in 100ms in the function DHDEVO" UBYTE B_TRUE 1 100 0.00 1.00000000000 BIT_MASK 0x1 FORMAT "%13.11" ECU_ADDRESS 0x7000037A /end MEASUREMENT
/begin MEASUREMENT DHDEVO_flgDsmClr50ms "Flag for DSM clear in 50ms in the function DHDEVO" UBYTE B_TRUE 1 100 0.00 1.00000000000 BIT_MASK 0x1 FORMAT "%13.11" ECU_ADDRESS 0x70000379 /end MEASUREMENT
/begin MEASUREMENT DHDEVO_flgDsmClrSyncS0 "Flag for DSM clear in synchro in the function DHDEVO" UBYTE B_TRUE 1 100 0.00 1.00000000000 BIT_MASK 0x1 FORMAT "%13.11" ECU_ADDRESS 0x70000378 /end MEASUREMENT
/begin MEASUREMENT DiaActr_ElecHBrdgDiag_HBrDiagInfo_mp "Diagnosis information from HWE - HBr." ULONG OneToOne 1 100 0.00 4294967295.00 FORMAT "%13.2" ECU_ADDRESS 0x70009C2C /end MEASUREMENT
/begin MEASUREMENT DiaActr_ElecHBrdgDiag_HlfBrDiagInfo_mp "Diagnosis information from IoSrv - HlfBr" ULONG OneToOne 1 100 0.00 4294967295.00 FORMAT "%13.2" ARRAY_SIZE 2 ECU_ADDRESS 0x70009C24 /end MEASUREMENT
/begin MEASUREMENT DiaActr_ElecHBrdgDiag_nrDiagErr_mp "Number of diagnostic errors Size of error object array." UBYTE OneToOne 1 100 0.00 255.0 FORMAT "%5.1" ECU_ADDRESS 0x70009FE3 /end MEASUREMENT
/begin MEASUREMENT DiaActr_ElecHBrdgDiag_OLSigErrInfo_mp "Signal error information during open load diagnosis." ULONG OneToOne 1 100 0.00 4294967295.00 FORMAT "%13.2" ECU_ADDRESS 0x70009C20 /end MEASUREMENT
/begin MEASUREMENT DiaActr_ElecHBrdgDiag_ReasOLAbort_mp "Measuring point indicating reason for open load diagnosis abort. [Relevant only if open load is configured in switchoff or disable mode]." UBYTE OneToOne 1 100 0.00 255.0 FORMAT "%5.1" ECU_ADDRESS 0x70009FE2 /end MEASUREMENT
/begin MEASUREMENT DiaActr_ElecHBrdgDiag_SigErrInfo_mp "Signal error information during normal diagnosis." ULONG OneToOne 1 100 0.00 4294967295.00 FORMAT "%13.2" ECU_ADDRESS 0x70009C1C /end MEASUREMENT
/begin MEASUREMENT DiaActr_ElecHBrdgDiag_stAddOLDiag_mp "Additional open load diagnosis status." UBYTE OneToOne 1 100 0.00 255.0 FORMAT "%5.1" ECU_ADDRESS 0x70009FE1 /end MEASUREMENT
/begin MEASUREMENT DiaActr_ElecHBrdgDiag_stDiagCtrl_mp "Status of diagnosis software (DiaActr_ElecHBrdgDiag) controlling H-Bridge output." UBYTE OneToOne 1 100 0.00 255.0 FORMAT "%5.1" ECU_ADDRESS 0x70009FE0 /end MEASUREMENT
/begin MEASUREMENT DiaActr_ElecHBrdgDiag_stDiagDi_mp "Diagnosis disable status." UBYTE OneToOne 1 100 0.00 255.0 FORMAT "%5.1" ECU_ADDRESS 0x70009FDF /end MEASUREMENT
/begin MEASUREMENT DiaActr_ElecHBrdgDiag_stOLAbortReq_mp "Open load abort request status." UBYTE OneToOne 1 100 0.00 255.0 FORMAT "%5.1" ECU_ADDRESS 0x70009FDE /end MEASUREMENT
/begin MEASUREMENT DiaActr_ElecHBrdgDiag_stOLDiagMode_mp "Open load diagnosis mode." UBYTE OneToOne 1 100 0.00 255.0 FORMAT "%5.1" ECU_ADDRESS 0x70009FDD /end MEASUREMENT
/begin MEASUREMENT DiaActr_ElecHBrdgDiag_stOLDiag_mp "Open load diagnosis status." UBYTE OneToOne 1 100 0.00 255.0 FORMAT "%5.1" ECU_ADDRESS 0x70009FDC /end MEASUREMENT
/begin MEASUREMENT DiaActr_ElecHBrdgDiag_stSigQly_mp "Signal quality returned." UBYTE OneToOne 1 100 0.00 255.0 FORMAT "%5.1" ECU_ADDRESS 0x70009FDB /end MEASUREMENT
/begin MEASUREMENT DiaActr_ElecHBrdgDiag_TestPlsReq_mp "Test pulse request status." UBYTE OneToOne 1 100 0.00 255.0 FORMAT "%5.1" ECU_ADDRESS 0x70009FDA /end MEASUREMENT
/begin MEASUREMENT dkvbigo_w "fuel consumption during vehicle halts" UWORD vol_q3p90625Em3_l 1 100 0.00 255.9961 FORMAT "%8.4" ECU_ADDRESS 0x6000104E /end MEASUREMENT
/begin MEASUREMENT dkvb_w "difference consumed fuel" UWORD vol_q3p90625Em3_l 1 100 0.00 255.9961 FORMAT "%8.4" ECU_ADDRESS 0x60039774 /end MEASUREMENT
/begin MEASUREMENT FlDev_lenTotDstLstRlsDenom "Stored odometer for fuel level diagnosis denominator" SLONG Length 1 100 -2147483648.00 2147483647.00 FORMAT "%13.2" ECU_ADDRESS 0x60039770 /end MEASUREMENT
/begin MEASUREMENT FlLvl_cntrFuLvlErr "number of successive plausibility errors on fuel-level" UBYTE dez 1 100 0.00 255.0 FORMAT "%5.1" ECU_ADDRESS 0x60001422 /end MEASUREMENT
/begin MEASUREMENT FlLvl_ctPlausyRst "FlLvl_ctPlausyRst" UWORD OneToOne 1 100 0.00 65535.00 FORMAT "%8.2" ECU_ADDRESS 0x6000104C /end MEASUREMENT
/begin MEASUREMENT FlLvl_flgFstPlausyOkCfm "Plausibility check ok confirm" UBYTE B_TRUE 1 100 0.00 1.00000000000 BIT_MASK 0x1 FORMAT "%13.11" ECU_ADDRESS 0x600000FB /end MEASUREMENT
/begin MEASUREMENT FlLvl_flgFuSnsrRlsDenom "Flag to signify that the required distance for fuel sensor plusibility diagnosis FID denominator is reached" UBYTE B_TRUE 1 100 0.00 1.00000000000 BIT_MASK 0x1 FORMAT "%13.11" ECU_ADDRESS 0x600000FA /end MEASUREMENT
/begin MEASUREMENT FlLvl_flgLongStandStill "Flag to signify that the vehicle has stopped for a long time when the fuel was in the upper or lower dead zone and hence reset the plausibility diagnosis" UBYTE B_TRUE 1 100 0.00 1.00000000000 BIT_MASK 0x1 FORMAT "%13.11" ECU_ADDRESS 0x6000104A /end MEASUREMENT
/begin MEASUREMENT FlLvl_flgRefuPsbl "Refuelling possible flag" UBYTE B_TRUE 1 100 0.00 1.00000000000 BIT_MASK 0x1 FORMAT "%13.11" ECU_ADDRESS 0x60001397 /end MEASUREMENT
/begin MEASUREMENT FlLvl_flgTankEmptyResv "Tank empty or reserve" UBYTE B_TRUE 1 100 0.00 1.00000000000 BIT_MASK 0x1 FORMAT "%13.11" ECU_ADDRESS 0x60036DE5 /end MEASUREMENT
/begin MEASUREMENT FlLvl_flgTankFull "Tank full" UBYTE B_TRUE 1 100 0.00 1.00000000000 BIT_MASK 0x1 FORMAT "%13.11" ECU_ADDRESS 0x60036DE4 /end MEASUREMENT
/begin MEASUREMENT FlLvl_flgVehHaltSeln "Vehicle halt slection flag" UBYTE B_TRUE 1 100 0.00 1.00000000000 BIT_MASK 0x1 FORMAT "%13.11" ECU_ADDRESS 0x60001049 /end MEASUREMENT
/begin MEASUREMENT FlLvl_flgVehMov "used by refuelling enable calculation" UBYTE B_TRUE 1 100 0.00 1.00000000000 BIT_MASK 0x1 FORMAT "%13.11" ECU_ADDRESS 0x60001048 /end MEASUREMENT
/begin MEASUREMENT FlLvl_flgVehStandStill "Vehicle standstill flag" UBYTE B_TRUE 1 100 0.00 1.00000000000 BIT_MASK 0x1 FORMAT "%13.11" ECU_ADDRESS 0x60039840 /end MEASUREMENT
/begin MEASUREMENT FlLvl_lenDstSnceLstRlsDenom "Distance travelled by the vehicle since the last release of the IUMPR denominator" SLONG Length 1 100 -2147483648.00 2147483647.00 FORMAT "%13.2" ECU_ADDRESS 0x60001044 /end MEASUREMENT
/begin MEASUREMENT FlLvl_tiLongStandStillIni "Time delay before resetting plausibility diagnosis in case of Kl15 Off and On" UBYTE t_q1 1 100 0.00 255.0 FORMAT "%5.1" ECU_ADDRESS 0x60001040 /end MEASUREMENT
/begin MEASUREMENT FlLvl_tiVehStandStill "Vehicle standstill timer" UBYTE t_q1 1 100 0.00 255.0 FORMAT "%5.1" ECU_ADDRESS 0x6003976E /end MEASUREMENT
/begin MEASUREMENT FlLvl_volPlausyCycFuInj "difference consumed fuel" UWORD vol_q3p90625Em3_l 1 100 0.00 255.9961 FORMAT "%8.4" ECU_ADDRESS 0x600014A2 /end MEASUREMENT
/begin MEASUREMENT FlLvl_volSnsr1Stk "Primary-fueltank volume at start of sensor-stuck check" UWORD vol_q0p1_l 1 100 0.00 6553.500 FORMAT "%8.3" ECU_ADDRESS 0x6000149E /end MEASUREMENT
/begin MEASUREMENT FlLv_cntrDualTankPlausRstrt "Counter to increment for tank plausibility restart" UWORD OneToOne 1 100 0.00 65535.00 FORMAT "%8.2" ECU_ADDRESS 0x6003976C /end MEASUREMENT
/begin MEASUREMENT FlLv_volLvlSnsrPlausChk "Calibrated fuel volume for sensor plausibility check" SWORD vol_q0p1_l 1 100 -3276.800 3276.700 FORMAT "%8.3" ECU_ADDRESS 0x6000103E /end MEASUREMENT
/begin MEASUREMENT fst1stk_w "Primary-fueltank volume at start of sensor-stuck check" UWORD vol_q0p1_l 1 100 0.00 6553.500 FORMAT "%8.3" ECU_ADDRESS 0x6003976A /end MEASUREMENT
/begin MEASUREMENT fstakt_w "current fuel level" UWORD vol_q0p1_l 1 100 0.00 6553.500 FORMAT "%8.3" ECU_ADDRESS 0x6000103C /end MEASUREMENT
/begin MEASUREMENT fstalt_w "last fuel level before ignition off" UWORD vol_q0p1_l 1 100 0.00 6553.500 FORMAT "%8.3" ECU_ADDRESS 0x60039762 /end MEASUREMENT
/begin MEASUREMENT fstalt_w_msg "last fuel level before ignition off" UWORD vol_q0p1_l 1 100 0.00 6553.500 FORMAT "%8.3" ECU_ADDRESS 0x6003986E /end MEASUREMENT
/begin MEASUREMENT fstercnt "number of successive plausibility errors on fuel-level" UBYTE dez 1 100 0.00 255.0 FORMAT "%5.1" ECU_ADDRESS 0x60039769 /end MEASUREMENT
/begin MEASUREMENT fsthin_w_msg "fuel level during vehicle stops" UWORD vol_q0p1_l 1 100 0.00 6553.500 FORMAT "%8.3" ECU_ADDRESS 0x60001484 /end MEASUREMENT
/begin MEASUREMENT fstokcnt "number of successive plausibility checks ok on fuel-level" UBYTE dez 1 100 0.00 255.0 FORMAT "%5.1" ECU_ADDRESS 0x60039768 /end MEASUREMENT
/begin MEASUREMENT fstold_w "Dualtank fuel-volume at the start of plausibility check" UWORD vol_q0p1_l 1 100 0.00 6553.500 FORMAT "%8.3" ECU_ADDRESS 0x60039766 /end MEASUREMENT
/begin MEASUREMENT InjSys_flgDHDEVOReIni "State variable to allow reinitialization" UBYTE B_TRUE 1 100 0.00 1.00000000000 BIT_MASK 0x1 FORMAT "%13.11" ECU_ADDRESS 0x70000377 /end MEASUREMENT
/begin MEASUREMENT InjSys_nEngLResDiagOpenInjVlv "engine speed with low resolution for diagnosis open HDEV" UBYTE nmot_ub_q40 1 100 0.00 10200. FORMAT "%5.0" ECU_ADDRESS 0x6000F06F /end MEASUREMENT
/begin MEASUREMENT kvbmsold_w "Fuel consumption from actual driving cycle until detected refueling with negative algebraic sign." SWORD vol_q7p8125Em3_l 1 100 -256.0000 255.9922 FORMAT "%8.4" ECU_ADDRESS 0x6000103A /end MEASUREMENT
/begin MEASUREMENT kvbmssum_w "integrated fuel consumption for condition fuel consumption greater tank since last refueling" UWORD vol_q3p90625Em3_l 1 100 0.00 255.9961 FORMAT "%8.4" ECU_ADDRESS 0x60039764 /end MEASUREMENT
/begin MEASUREMENT kvbold_w "Volume of fuel-consumed at the start of dualtank fuel-level plausibility check" SWORD vol_q7p8125Em3_l 1 100 -256.0000 255.9922 FORMAT "%8.4" ECU_ADDRESS 0x60001038 /end MEASUREMENT
/begin MEASUREMENT misfire "number of misfire" UBYTE dez 1 100 0.00 255.0 FORMAT "%5.1" ARRAY_SIZE 4 ECU_ADDRESS 0x6000F06B /end MEASUREMENT
/begin MEASUREMENT nomisfcnt "Counter no misfire counted" UBYTE dez 1 100 0.00 255.0 FORMAT "%5.1" ECU_ADDRESS 0x700030B0 /end MEASUREMENT
/begin MEASUREMENT setdhdevo "Cylinder specific bitcoded errorbyte of diagnosis open high pressure injector (HPIV)" UBYTE dez 1 100 0.00 255.0 FORMAT "%5.1" ECU_ADDRESS 0x6000F06A /end MEASUREMENT
/begin MEASUREMENT setdhdevos "Cylinder specific bitcoded error suspicious byte of diagnosis open high pressure injector (HPIV)" UBYTE dez 1 100 0.00 255.0 FORMAT "%5.1" ECU_ADDRESS 0x6000F069 /end MEASUREMENT
/begin MEASUREMENT _stcEmiMisfCntrCyl "cylinder individual misfire counter for emission statistic local" UWORD OneToOne 1 100 0.00 65535.00 FORMAT "%8.2" ARRAY_SIZE 4 ECU_ADDRESS 0x60007CD8 /end MEASUREMENT
/begin MEASUREMENT _stcEmiMisfCntrCyl_100ms "cylinder individual misfire counter for emission statistic local_100ms" UWORD OneToOne 1 100 0.00 65535.00 FORMAT "%8.2" ARRAY_SIZE 4 ECU_ADDRESS 0x60007CD0 /end MEASUREMENT
/begin FUNCTION DFES "30000.73.0_2.0.0Diagnostic Fault Event Storage"
 /begin DEF_CHARACTERISTIC DFES_GrpRpr.DFC_IVGdiCtl_CvoErr_C DFES_GrpRpr.DFC_IVGdiCtl_CvoSigPlaus_0_C DFES_GrpRpr.DFC_IVGdiCtl_CvoSigPlaus_1_C DFES_GrpRpr.DFC_IVGdiCtl_CvoSigPlaus_2_C DFES_GrpRpr.DFC_IVGdiCtl_CvoSigPlaus_3_C DFES_GrpRpr.DFC_IntkAirTAirFltDsCrssMax_C DFES_GrpRpr.DFC_IntkAirTAirFltDsCrssMin_C DFES_GrpRpr.DFC_IntkAirTAirFltDsHSCMax_C DFES_GrpRpr.DFC_IntkAirTAirFltDsImps_C DFES_GrpRpr.DFC_IntkAirTAirFltDsPRCMax_C DFES_GrpRpr.DFC_IntkAirTAirFltDsPRCMin_C DFES_GrpRpr.DFC_IntkAirTAirFltDsSRCMax_C DFES_GrpRpr.DFC_IntkAirTAirFltDsSRCMin_C DFES_GrpRpr.DFC_IntkAirTAirFltDsSTC_C DFES_GrpRpr.DFC_IntkAirTIntkMnfldCrssMax_C DFES_GrpRpr.DFC_IntkAirTIntkMnfldCrssMin_C DFES_GrpRpr.DFC_IntkAirTIntkMnfldHSCMax_C DFES_GrpRpr.DFC_IntkAirTIntkMnfldImps_C DFES_GrpRpr.DFC_IntkAirTIntkMnfldPRCMax_C DFES_GrpRpr.DFC_IntkAirTIntkMnfldPRCMin_C DFES_GrpRpr.DFC_IntkAirTIntkMnfldSRCMax_C DFES_GrpRpr.DFC_IntkAirTIntkMnfldSRCMin_C DFES_GrpRpr.DFC_IntkAirTIntkMnfldSTC_C DFES_GrpRpr.DFC_KRREGRLMX_C DFES_GrpRpr.DFC_KRVEKOCVLCI_C DFES_GrpRpr.DFC_KRVEKOENCHMT_C DFES_GrpRpr.DFC_KRVEKOENCHMT0_C DFES_GrpRpr.DFC_KRVEKOENCHMT1_C DFES_GrpRpr.DFC_KRVEKOENCHMT2_C DFES_GrpRpr.DFC_KRVEKOENCHMT3_C DFES_GrpRpr.DFC_KRVEKOENCHMT4_C DFES_GrpRpr.DFC_KRVEKOENCHMT5_C DFES_GrpRpr.DFC_KRVEKOENCHMT6_C DFES_GrpRpr.DFC_KRVEKOENCHMT7_C DFES_GrpRpr.DFC_KRVEKORLMX_C DFES_GrpRpr.DFC_KRVEKORLMXL_C DFES_GrpRpr.DFC_KS1max_C DFES_GrpRpr.DFC_KS1min_C DFES_GrpRpr.DFC_LMmax_C DFES_GrpRpr.DFC_LZSRnpl_C DFES_GrpRpr.DFC_LamDynDiagS1B1_C DFES_GrpRpr.DFC_LeakIntkMnfldEmiInfl_C DFES_GrpRpr.DFC_LinFrameErrDCDC_C DFES_GrpRpr.DFC_LinOverrunErrDCDC_C DFES_GrpRpr.DFC_MD00max_C DFES_GrpRpr.DFC_MDBmax_C DFES_GrpRpr.DFC_MDCat_C DFES_GrpRpr.DFC_MDCatCrit_C DFES_GrpRpr.DFC_MDCatCurr_C DFES_GrpRpr.DFC_MDCyl_0_C DFES_GrpRpr.DFC_MDCyl_1_C DFES_GrpRpr.DFC_MDCyl_2_C DFES_GrpRpr.DFC_MDCyl_3_C DFES_GrpRpr.DFC_MDEmi_C DFES_GrpRpr.DFC_MDEmiStrt_C DFES_GrpRpr.DFC_MDFco_C DFES_GrpRpr.DFC_MDMpl_C DFES_GrpRpr.DFC_MDSegTiAdpn_C DFES_GrpRpr.DFC_MDmax_C DFES_GrpRpr.DFC_MFuOilMax_C DFES_GrpRpr.DFC_MOXEMM_SMU_ALM0_0_C DFES_GrpRpr.DFC_MOXEMM_SMU_ALM0_1_C DFES_GrpRpr.DFC_MOXEMM_SMU_ALM0_10_C DFES_GrpRpr.DFC_MOXEMM_SMU_ALM0_11_C DFES_GrpRpr.DFC_MOXEMM_SMU_ALM0_13_C DFES_GrpRpr.DFC_MOXEMM_SMU_ALM0_14_C DFES_GrpRpr.DFC_MOXEMM_SMU_ALM0_2_C DFES_GrpRpr.DFC_MOXEMM_SMU_ALM0_22_C DFES_GrpRpr.DFC_MOXEMM_SMU_ALM0_23_C DFES_GrpRpr.DFC_MOXEMM_SMU_ALM0_4_C DFES_GrpRpr.DFC_MOXEMM_SMU_ALM0_5_C DFES_GrpRpr.DFC_MOXEMM_SMU_ALM0_7_C DFES_GrpRpr.DFC_MOXEMM_SMU_ALM0_8_C DFES_GrpRpr.DFC_MOXEMM_SMU_ALM10_16_C DFES_GrpRpr.DFC_MOXEMM_SMU_ALM10_17_C DFES_GrpRpr.DFC_MOXEMM_SMU_ALM10_21_C DFES_GrpRpr.DFC_MOXEMM_SMU_ALM11_0_C DFES_GrpRpr.DFC_MOXEMM_SMU_ALM11_1_C DFES_GrpRpr.DFC_MOXEMM_SMU_ALM11_2_C DFES_GrpRpr.DFC_MOXEMM_SMU_ALM11_3_C DFES_GrpRpr.DFC_MOXEMM_SMU_ALM11_4_C DFES_GrpRpr.DFC_MOXEMM_SMU_ALM11_5_C DFES_GrpRpr.DFC_MOXEMM_SMU_ALM11_8_C DFES_GrpRpr.DFC_MOXEMM_SMU_ALM11_9_C DFES_GrpRpr.DFC_MOXEMM_SMU_ALM1_0_C DFES_GrpRpr.DFC_MOXEMM_SMU_ALM1_1_C DFES_GrpRpr.DFC_MOXEMM_SMU_ALM1_10_C DFES_GrpRpr.DFC_MOXEMM_SMU_ALM1_11_C DFES_GrpRpr.DFC_MOXEMM_SMU_ALM1_13_C DFES_GrpRpr.DFC_MOXEMM_SMU_ALM1_14_C DFES_GrpRpr.DFC_MOXEMM_SMU_ALM1_2_C DFES_GrpRpr.DFC_MOXEMM_SMU_ALM1_22_C DFES_GrpRpr.DFC_MOXEMM_SMU_ALM1_23_C DFES_GrpRpr.DFC_MOXEMM_SMU_ALM1_4_C DFES_GrpRpr.DFC_MOXEMM_SMU_ALM1_5_C DFES_GrpRpr.DFC_MOXEMM_SMU_ALM1_7_C DFES_GrpRpr.DFC_MOXEMM_SMU_ALM1_8_C DFES_GrpRpr.DFC_MOXEMM_SMU_ALM21_0_C DFES_GrpRpr.DFC_MOXEMM_SMU_ALM21_16_C DFES_GrpRpr.DFC_MOXEMM_SMU_ALM21_3_C DFES_GrpRpr.DFC_MOXEMM_SMU_ALM2_1_C DFES_GrpRpr.DFC_MOXEMM_SMU_ALM2_10_C DFES_GrpRpr.DFC_MOXEMM_SMU_ALM2_11_C DFES_GrpRpr.DFC_MOXEMM_SMU_ALM2_13_C DFES_GrpRpr.DFC_MOXEMM_SMU_ALM2_14_C DFES_GrpRpr.DFC_MOXEMM_SMU_ALM2_22_C DFES_GrpRpr.DFC_MOXEMM_SMU_ALM2_23_C DFES_GrpRpr.DFC_MOXEMM_SMU_ALM2_4_C DFES_GrpRpr.DFC_MOXEMM_SMU_ALM2_5_C DFES_GrpRpr.DFC_MOXEMM_SMU_ALM2_7_C DFES_GrpRpr.DFC_MOXEMM_SMU_ALM2_8_C DFES_GrpRpr.DFC_MOXEMM_SMU_ALM6_0_C DFES_GrpRpr.DFC_MOXEMM_SMU_ALM6_11_C DFES_GrpRpr.DFC_MOXEMM_SMU_ALM6_12_C DFES_GrpRpr.DFC_MOXEMM_SMU_ALM6_14_C DFES_GrpRpr.DFC_MOXEMM_SMU_ALM6_15_C DFES_GrpRpr.DFC_MOXEMM_SMU_ALM6_17_C DFES_GrpRpr.DFC_MOXEMM_SMU_ALM6_18_C DFES_GrpRpr.DFC_MOXEMM_SMU_ALM6_20_C DFES_GrpRpr.DFC_MOXEMM_SMU_ALM6_21_C DFES_GrpRpr.DFC_MOXEMM_SMU_ALM6_25_C DFES_GrpRpr.DFC_MOXEMM_SMU_ALM6_4_C DFES_GrpRpr.DFC_MOXEMM_SMU_ALM6_5_C DFES_GrpRpr.DFC_MOXEMM_SMU_ALM6_7_C DFES_GrpRpr.DFC_MOXEMM_SMU_ALM6_8_C DFES_GrpRpr.DFC_MOXEMM_SMU_ALM7_1_C DFES_GrpRpr.DFC_MOXEMM_SMU_ALM7_12_C DFES_GrpRpr.DFC_MOXEMM_SMU_ALM7_13_C DFES_GrpRpr.DFC_MOXEMM_SMU_ALM7_14_C DFES_GrpRpr.DFC_MOXEMM_SMU_ALM7_15_C DFES_GrpRpr.DFC_MOXEMM_SMU_ALM7_16_C DFES_GrpRpr.DFC_MOXEMM_SMU_ALM7_17_C DFES_GrpRpr.DFC_MOXEMM_SMU_ALM7_2_C DFES_GrpRpr.DFC_MOXEMM_SMU_ALM7_20_C DFES_GrpRpr.DFC_MOXEMM_SMU_ALM7_25_C DFES_GrpRpr.DFC_MOXEMM_SMU_ALM7_26_C DFES_GrpRpr.DFC_MOXEMM_SMU_ALM7_28_C DFES_GrpRpr.DFC_MOXEMM_SMU_ALM7_29_C DFES_GrpRpr.DFC_MOXEMM_SMU_ALM7_30_C DFES_GrpRpr.DFC_MOXEMM_SMU_ALM7_31_C DFES_GrpRpr.DFC_MOXEMM_SMU_ALM8_0_C DFES_GrpRpr.DFC_MOXEMM_SMU_ALM8_1_C DFES_GrpRpr.DFC_MOXEMM_SMU_ALM8_10_C DFES_GrpRpr.DFC_MOXEMM_SMU_ALM8_11_C DFES_GrpRpr.DFC_MOXEMM_SMU_ALM8_12_C DFES_GrpRpr.DFC_MOXEMM_SMU_ALM8_16_C DFES_GrpRpr.DFC_MOXEMM_SMU_ALM8_18_C DFES_GrpRpr.DFC_MOXEMM_SMU_ALM8_2_C DFES_GrpRpr.DFC_MOXEMM_SMU_ALM8_3_C DFES_GrpRpr.DFC_MOXEMM_SMU_ALM8_31_C DFES_GrpRpr.DFC_MOXEMM_SMU_ALM8_4_C DFES_GrpRpr.DFC_MOXEMM_SMU_ALM9_0_C DFES_GrpRpr.DFC_MOXEMM_SMU_ALM9_15_C DFES_GrpRpr.DFC_MOXEMM_SMU_ALM9_3_C DFES_GrpRpr.DFC_MoCADCNTP_C DFES_GrpRpr.DFC_MoCADCTst_C DFES_GrpRpr.DFC_MoCSOPICO_C DFES_GrpRpr.DFC_MoFAPP_C DFES_GrpRpr.DFC_MoFAirFilgPrdc_C DFES_GrpRpr.DFC_MoFAirFlCtOffGdi_C DFES_GrpRpr.DFC_MoFAirFlCylGdi_C DFES_GrpRpr.DFC_MoFAirFlFF_C DFES_GrpRpr.DFC_MoFAirFlIn_C DFES_GrpRpr.DFC_MoFAirFlMixCtlGdiChkAirFl_C DFES_GrpRpr.DFC_MoFAirFlMixCtlGdiChkCtrl_C DFES_GrpRpr.DFC_MoFAirFlMode_C DFES_GrpRpr.DFC_MoFESpd_C DFES_GrpRpr.DFC_MoFIACo_C DFES_GrpRpr.DFC_MoFICOL1_C DFES_GrpRpr.DFC_MoFICOL2_C DFES_GrpRpr.DFC_MoFStrt_C DFES_GrpRpr.DFC_MoFTrqCmp_C DFES_GrpRpr.DFC_MoFTrqCmpMax_C DFES_GrpRpr.DFC_MoFTrqCmpMin_C DFES_GrpRpr.DFC_MoFVarPostBldSel_C DFES_GrpRpr.DFC_MoXEMMHwLTMCUFW_C DFES_GrpRpr.DFC_MoXEMMHwLTMonBIST_C DFES_GrpRpr.DFC_MoXEMMHwLTRegMonTest_C DFES_GrpRpr.DFC_MoXEMMHwLTStbySMUAlvTest_C DFES_GrpRpr.DFC_MoXEMMHwLTTempSens_C DFES_GrpRpr.DFC_MoXEMMHwLTUCBCfg_C DFES_GrpRpr.DFC_NWSEmax_C DFES_GrpRpr.DFC_NWSmax_C DFES_GrpRpr.DFC_OCWDAABEActv_C DFES_GrpRpr.DFC_OCWDACom_C DFES_GrpRpr.DFC_OCWDAErrPin_C DFES_GrpRpr.DFC_OCWDAOvrVltg_C DFES_GrpRpr.DFC_ORAmax_C DFES_GrpRpr.DFC_ORAmin_C DFES_GrpRpr.DFC_OilPPlaus_C DFES_GrpRpr.DFC_PLLSUmax_C DFES_GrpRpr.DFC_PLLSUmin_C DFES_GrpRpr.DFC_PSR1max_C DFES_GrpRpr.DFC_PSRBmax_C DFES_GrpRpr.DFC_PSRBmin_C DFES_GrpRpr.DFC_PSRPmax_C DFES_GrpRpr.DFC_PSRPmin_C DFES_GrpRpr.DFC_PSRPsig_C DFES_GrpRpr.DFC_PSRmax_C DFES_GrpRpr.DFC_PUmax_C DFES_GrpRpr.DFC_P_VSE11_OL_C DFES_GrpRpr.DFC_P_VSE11_SCB_C DFES_GrpRpr.DFC_P_VSE11_SCG_C DFES_GrpRpr.DFC_PhyHighAPP1_C DFES_GrpRpr.DFC_PhyHighAPP2_C DFES_GrpRpr.DFC_PhyLowAPP1_C DFES_GrpRpr.DFC_PhyLowAPP2_C DFES_GrpRpr.DFC_SRCHighAPP1_C DFES_GrpRpr.DFC_SRCHighAPP2_C DFES_GrpRpr.DFC_SRCLowAPP1_C DFES_GrpRpr.DFC_SRCLowAPP2_C DFES_GrpRpr.DFC_SSpMon2_C DFES_GrpRpr.DFC_STHDRmax_C DFES_GrpRpr.DFC_SWReset_0_C DFES_GrpRpr.DFC_SWReset_1_C DFES_GrpRpr.DFC_SWReset_2_C DFES_GrpRpr.DFC_SyncAPP_C DFES_GrpRpr.DFC_TANKLnpl_C DFES_GrpRpr.DFC_TAmax_Dummy_C DFES_GrpRpr.DFC_TESFmax_C DFES_GrpRpr.DFC_TESGmax_C DFES_GrpRpr.DFC_TKAEmax_C DFES_GrpRpr.DFC_TKAEmin_C DFES_GrpRpr.DFC_TKARmax_C DFES_GrpRpr.DFC_TKARnpl_C DFES_GrpRpr.DFC_TMmax_Dummy_C DFES_GrpRpr.DFC_TUMmax_Dummy_C DFES_GrpRpr.DFC_TWCDPriCatB1_C DFES_GrpRpr.DFC_ThrVlvClsdPosnFirstOffsLrnImpoB1_C DFES_GrpRpr.DFC_ThrVlvClsdPosnOffsLrnImpoB1_C DFES_GrpRpr.DFC_ThrVlvClsdPosnOffsLrnMaxB1_C DFES_GrpRpr.DFC_ThrVlvClsdPosnOffsLrnMinB1_C DFES_GrpRpr.DFC_ThrVlvCtrlDeB1_C DFES_GrpRpr.DFC_ThrVlvDycB1_C DFES_GrpRpr.DFC_ThrVlvLimpAirPosnMaxAbsltDriftB1_C DFES_GrpRpr.DFC_ThrVlvLimpAirPosnMaxB1_C DFES_GrpRpr.DFC_ThrVlvLimpAirPosnMaxRelDriftB1_C DFES_GrpRpr.DFC_ThrVlvLimpAirPosnMinB1_C DFES_GrpRpr.DFC_ThrVlvOpenLoadB1_C DFES_GrpRpr.DFC_ThrVlvOpenSprgB1_C DFES_GrpRpr.DFC_ThrVlvOpenSprgSprdB1_C DFES_GrpRpr.DFC_ThrVlvOpenSprgTwnB1_C DFES_GrpRpr.DFC_ThrVlvOverTB1_C DFES_GrpRpr.DFC_ThrVlvRetSprgB1_C DFES_GrpRpr.DFC_ThrVlvRetSprgSprdB1_C DFES_GrpRpr.DFC_ThrVlvRetSprgTwnB1_C DFES_GrpRpr.DFC_ThrVlvSens1MaxB1_C DFES_GrpRpr.DFC_ThrVlvSens1NplB1_C DFES_GrpRpr.DFC_ThrVlvSens2MaxB1_C DFES_GrpRpr.DFC_ThrVlvSens2MinB1_C DFES_GrpRpr.DFC_ThrVlvSens2NplB1_C DFES_GrpRpr.DFC_ThrVlvShoCircB1_C DFES_GrpRpr.DFC_ThrVlvSpiErrB1_C DFES_GrpRpr.DFC_ThrvlvSens1MinB1_C DFES_GrpRpr.DFC_TiOffTBasdChkFast_C DFES_GrpRpr.DFC_TiOffTBasdChkSlow_C DFES_GrpRpr.DFC_UEGOSnsrMntdS1B1_C DFES_GrpRpr.DFC_VehVSig_C DFES_GrpRpr.DFC_VlvLftFbSwtIntk11SpclFail_C DFES_GrpRpr.DFC_VlvLftFbSwtIntk11StdFail_C DFES_MonEvtMSK0_C DFES_MonEvtMSK1_C DFES_MonRepeat_C DFES_numClsDlt_CA DFES_numClsFaultCycl_CA DFES_numClsHealCycl_CA DFES_numClsPndDlt_CA DFES_numClsSvcDlt_CA DFES_numClsSVSFaultCycl_CA DFES_numClsSVSHealCycl_CA DFES_numPDTC_C DFES_ThresSimCond.n_C DFES_ThresSimCond.r_C DFES_ThresSimCond.t_C DFES_xAsgnExtdFrzFrSig_CA DFES_xAsgnFrzFrSig_CA DFES_xClsDltTrg_CA DFES_xClsFaultTrg_CA DFES_xClsFltMIL_CA DFES_xClsFltSVS_CA DFES_xClsHealTrg_CA DFES_xClsPndDltTrg_CA DFES_xClsPrio_CA DFES_xClsSvcDltTrg_CA DFES_xClsSVSFaultTrg_CA DFES_xClsSVSHealTrg_CA /end DEF_CHARACTERISTIC
 FUNCTION_VERSION "30000.73.0_2.0.0" /end FUNCTION
/begin FUNCTION DFP "30000.7.0 Diagnostic Fault Path" FUNCTION_VERSION "30000.7.0" /end FUNCTION
/begin FUNCTION DfpCl "3.0.0     support of DFP handling" FUNCTION_VERSION "3.0.0" /end FUNCTION
/begin FUNCTION DFSTT "11.12.0   Diagnostics for fluid level sensor tank"
 /begin DEF_CHARACTERISTIC CWDFSTT DFSKVMN DFSKVMX DFSTTH DKVBTH FlLvl_ctMacCntRstPlausyChk_C Fllvl_lenPlausDiagFuSnsrMin_C FlLvl_stPlausyDiagRst_C FlLvl_stSlopDetn_C FlLvl_tiLongStandStill_C FlLvl_tiRefuOnDec_C FlLvl_tiRefuOnInc_C FlLvl_vMovingChkThdHi_C FlLvl_vMovingChkThdLo_C FlLvl_vVehStopChkThdHi_C FlLvl_vVehStopChkThdLo_C FST1SKTH KLDFSTVFZG NFSTPLMN TANKABN TANKMN TANKVOL TANKVOLH TVFAHRTT TVFSTPRC TVFSTTG TVHATA VFZGDFSTT VOLBMNSL VOLOMXSL ZFSTPLTH /end DEF_CHARACTERISTIC
 /begin IN_MEASUREMENT B_cdfst_msg B_clrfst_msg B_fstelerr_msg B_fstsok_msg B_fsttg_msg B_fsttldv_msg B_fsttrg_msg B_fsttsh_msg B_nachl_msg B_tal_msg B_tav_msg Eep_EnvRamHist Eep_EnvRamInvld EngStrt_bFrstStrtEnd Epm_stSpd FlLvl_volRefuFuLvlFild fstt_w_msg fstu_w_msg GlbDa_lTotDst InjSys_volFuConsDrvCyc SyC_stSub TiEngOff_stTi TiEngOff_ti VehV_v /end IN_MEASUREMENT
 /begin OUT_MEASUREMENT B_efstgth_msg B_efstnpl_msg B_efstsk1_msg B_fst1sk_msg B_fstpler_msg B_fstplok_msg B_fstrok_msg B_fsttnp_msg B_fsttzu_msg B_tankab_msg B_tankdy_msg B_tankg_msg B_tankzu_msg B_tank_msg dfstigof_w_msg dfstigo_w_msg FlLvl_cntrFuLvlErr FlLvl_flgRefuPsbl FlLvl_flgVehStandStill FlLvl_volPlausyCycFuInj FlLvl_volSnsr1Stk fstalt_w fstalt_w_msg fsthin_w_msg /end OUT_MEASUREMENT
 /begin LOC_MEASUREMENT B_dfsininv B_dfstvfzg B_dtankm B_fplreff B_fstneu B_fstofen B_fstplcfm B_fstplen B_fstploki B_fstplre B_fstplref B_fsttab B_iok B_tankend dfskv_w dfstig_w dfstt_w dkvbigo_w dkvb_w FlDev_lenTotDstLstRlsDenom FlLvl_ctPlausyRst FlLvl_flgFstPlausyOkCfm FlLvl_flgFuSnsrRlsDenom FlLvl_flgLongStandStill FlLvl_flgTankEmptyResv FlLvl_flgTankFull FlLvl_flgVehHaltSeln FlLvl_flgVehMov FlLvl_lenDstSnceLstRlsDenom FlLvl_tiLongStandStillIni FlLvl_tiVehStandStill FlLv_cntrDualTankPlausRstrt FlLv_volLvlSnsrPlausChk fst1stk_w fstakt_w fstercnt fstokcnt fstold_w kvbmsold_w kvbmssum_w kvbold_w /end LOC_MEASUREMENT
 FUNCTION_VERSION "11.12.0" /end FUNCTION
/begin FUNCTION DFSTTDFP "11.10.0   Connection to DFPM for fuel level sensor diagnosis" /begin DEF_CHARACTERISTIC SF_FST /end DEF_CHARACTERISTIC
 /begin IN_MEASUREMENT B_cdfstr_msg B_cdfst_msg B_efstgth_msg B_efstmn_msg B_efstmx_msg B_efstnpl_msg B_efstsk1_msg B_fstplok_msg B_fstrok_msg B_fstsok1_msg FlLvl_flgFuSnsrPhyRngMaxErr FlLvl_flgFuSnsrPhyRngMinErr SyC_stSub /end IN_MEASUREMENT
 /begin OUT_MEASUREMENT B_clrfste_msg B_clrfst_msg B_fstelerr_msg B_fsttldv_msg /end OUT_MEASUREMENT
 FUNCTION_VERSION "11.10.0" /end FUNCTION
/begin FUNCTION DHDEVO "3.7.0     diagnosis open HDEV"
 /begin DEF_CHARACTERISTIC DHDEVE0P DHDEVE1P MISFZUL NMNDHDEVO NMXDHDEVO RDHDEVOCTR RLMXDHDEVO TDDHDEVOER /end DEF_CHARACTERISTIC
 /begin IN_MEASUREMENT abmhdev_msg Epm_nEngLRes Epm_numCyl MisfDet_stBlkStc MisfDet_stCatDmgFcoCyl MisfDet_stcEmiMisfCntrCyl MisfDet_stcEmiMisfCntrSum rl_msg SyC_stSub /end IN_MEASUREMENT
 /begin OUT_MEASUREMENT B_hdevo_msg /end OUT_MEASUREMENT
 /begin LOC_MEASUREMENT B_dhdevoe B_dhdevom B_mnhdr B_nodhdevo B_nomfcnt B_nomfdet DHDEVO_flgDsmClr100ms DHDEVO_flgDsmClr50ms DHDEVO_flgDsmClrSyncS0 InjSys_flgDHDEVOReIni InjSys_nEngLResDiagOpenInjVlv misfire nomisfcnt setdhdevo setdhdevos _stcEmiMisfCntrCyl _stcEmiMisfCntrCyl_100ms /end LOC_MEASUREMENT
 FUNCTION_VERSION "3.7.0" /end FUNCTION
/begin FUNCTION DiaActr_ElecHBrdgDiag "1.9.0     Diagnostic service for electrical error detection on H-Bridge power stage outputs"
 /begin DEF_CHARACTERISTIC DiaActr_ElecHBrdgDiag_DbgSigId_C DiaActr_ElecHBrdgDiag_DbgSigType_C DiaActr_ElecHBrdgDiag_OlEnaSwtOff_C /end DEF_CHARACTERISTIC
 /begin LOC_MEASUREMENT DiaActr_ElecHBrdgDiag_HBrDiagInfo_mp DiaActr_ElecHBrdgDiag_HlfBrDiagInfo_mp DiaActr_ElecHBrdgDiag_nrDiagErr_mp DiaActr_ElecHBrdgDiag_OLSigErrInfo_mp DiaActr_ElecHBrdgDiag_ReasOLAbort_mp DiaActr_ElecHBrdgDiag_SigErrInfo_mp DiaActr_ElecHBrdgDiag_stAddOLDiag_mp DiaActr_ElecHBrdgDiag_stDiagCtrl_mp DiaActr_ElecHBrdgDiag_stDiagDi_mp DiaActr_ElecHBrdgDiag_stOLAbortReq_mp DiaActr_ElecHBrdgDiag_stOLDiagMode_mp DiaActr_ElecHBrdgDiag_stOLDiag_mp DiaActr_ElecHBrdgDiag_stSigQly_mp DiaActr_ElecHBrdgDiag_TestPlsReq_mp /end LOC_MEASUREMENT
 FUNCTION_VERSION "1.9.0" /end FUNCTION
/begin COMPU_METHOD B_TRUE "" TAB_VERB "%6.3" "" COMPU_TAB_REF B_TRUE /end COMPU_METHOD
/begin COMPU_VTAB B_TRUE "" TAB_VERB 2 0 "FALSE" 1 "TRUE" /end COMPU_VTAB
/begin COMPU_METHOD dez "" RAT_FUNC "%6.2" "" COEFFS 0 1 0 0 0 1 /end COMPU_METHOD
/begin COMPU_METHOD DFC_Verb "" TAB_VERB "%6.3" "-" COMPU_TAB_REF DFC_Verb /end COMPU_METHOD
/begin COMPU_VTAB DFC_Verb "" TAB_VERB 907 0 "DFC_Unused" 1 "DFC_AAVEmax" 2 "DFC_AAVEmin" 3 "DFC_AAVEsig" 508 "DFC_AAVmin" 379 "DFC_ACEvpTPhysRngHi" 380 "DFC_ACEvpTPhysRngLo" 381 "DFC_ACEvpTSRCMax" 382 "DFC_ACEvpTSRCMin" 288 "DFC_AfsPhyRngHiB1" 289 "DFC_AfsPhyRngLoB1" 510 "DFC_AfsPlausDiagHi" 511 "DFC_AfsPlausDiagLo" 383 "DFC_AfsRawSigRngHiB1" 384 "DFC_AfsRawSigRngLoB1" 415 "DFC_AfsSigErrLineHiB1" 416 "DFC_AfsSigErrLineLoB1" 385 "DFC_AfsSnsrErrB1" 512 "DFC_AfsVrntDiagErrB1" 509 "DFC_AGRSUS" 386 "DFC_AirCClntPAnaSRCMax" 387 "DFC_AirCClntPAnaSRCMin" 290 "DFC_AirCCmprOL" 291 "DFC_AirCCmprOvrTemp" 292 "DFC_AirCCmprSCB" 293 "DFC_AirCCmprSCG" 388 "DFC_AirCSwtNpl" 389 "DFC_AirCSwtSig" 294 "DFC_AltErr" 4 "DFC_AltIOACGFailr" 5 "DFC_AltIOACGHiVltg" 6 "DFC_AltIOACGLoVltg" 7 "DFC_AltIOACGTHi" 8 "DFC_AltIODConnACG" 513 "DFC_AppAllSnsrDfct" 10 "DFC_BattUHiFailr" 11 "DFC_BattULoFailr" 295 "DFC_BattUSRCMax" 296 "DFC_BattUSRCMin" 516 "DFC_BattUStdbyDiaOL" 514 "DFC_BBKRnldg" 515 "DFC_BBKRsyne" 9 "DFC_BGOELWAF" 517 "DFC_BigLeakIntkMnfldEmiInfl" 518 "DFC_BlkdLineTank" 390 "DFC_Brk" 12 "DFC_BrkBstPDriftHiErr" 13 "DFC_BrkBstPDriftLoErr" 14 "DFC_BrkBstPSnsrStuck" 391 "DFC_BrkBstSensSCB" 392 "DFC_BrkBstSensSCG" 15 "DFC_BrkMnSwtContOn" 519 "DFC_BrkMnSwtContOnWarnLmp" 16 "DFC_BrkMnSwtNotStp" 520 "DFC_BrkMnSwtNotStpWarnLmp" 17 "DFC_BrkNpl" 18 "DFC_BrkRdntSwtContOn" 521 "DFC_BrkRdntSwtContOnWarnLmp" 19 "DFC_BrkRdntSwtNotStp" 522 "DFC_BrkRdntSwtNotStpWarnLmp" 393 "DFC_BrkSig" 496 "DFC_BSWM_E_ACTION_FAILED" 497 "DFC_BSWM_E_INTRPTQUEUE_FULL" 472 "DFC_BusDiagCANAPPLBusOff" 473 "DFC_BusDiagCANCANCBusOff" 474 "DFC_BusDiagCANVEHICLEBusOff" 490 "DFC_CAN_E_TIMEOUT" 523 "DFC_CEngDsTColdStrtMax" 524 "DFC_CEngDsTColdStrtMin" 525 "DFC_CEngDsTImps" 526 "DFC_CEngDsTPlausHSC" 527 "DFC_CEngDsTPlausLSC" 528 "DFC_CEngDsTPlausSTC" 531 "DFC_CEngDsTSig" 529 "DFC_CEngDsTSRCMax" 530 "DFC_CEngDsTSRCMin" 532 "DFC_CEngUsTColdStrtMax" 533 "DFC_CEngUsTColdStrtMin" 534 "DFC_CEngUsTLooseCnctn" 535 "DFC_CEngUsTSRCMax" 536 "DFC_CEngUsTSRCMin" 432 "DFC_Clth2ONStuck" 433 "DFC_Clth2ONStuckLdc" 20 "DFC_Clth3ONStuck" 434 "DFC_Clth3ONStuckLdc" 435 "DFC_Clth3ONStuckPostDrv" 21 "DFC_Clth4OFFStuck" 436 "DFC_Clth4ONStuck" 437 "DFC_Clth4ONStuckLdc" 260 "DFC_ClthMax" 412 "DFC_ClthNpl" 22 "DFC_ClthOFFStuck" 23 "DFC_ClthONStuck" 394 "DFC_ClthSig" 24 "DFC_ClthStkFailInfo" 25 "DFC_ComACFailInfo" 26 "DFC_ComATFTValErr" 27 "DFC_ComATMILReq" 28 "DFC_ComAYCAChksum" 29 "DFC_ComAYCARingCnt" 30 "DFC_ComAYCATOut" 31 "DFC_ComAYCDChkSum" 32 "DFC_ComAYCDTOut" 33 "DFC_ComAYCFChksum" 34 "DFC_ComAYCFRingCnt" 35 "DFC_ComAYCFTOut" 36 "DFC_ComAYCGChksum" 37 "DFC_ComAYCGRingCnt" 38 "DFC_ComAYCGTOut" 39 "DFC_ComAYCIChkSum" 40 "DFC_ComAYCIRingCnt" 41 "DFC_ComAYCITOut" 42 "DFC_ComBCM1ChkSum" 43 "DFC_ComBCM1RingCnt" 44 "DFC_ComBCM1TOut" 438 "DFC_ComBCMUnit" 45 "DFC_ComCANABusOffErr" 46 "DFC_ComCANBBusOffErr" 47 "DFC_ComCANCBusOffErr" 48 "DFC_ComCGW1ChkSum" 49 "DFC_ComCGW1RingCnt" 50 "DFC_ComCGW1TOut" 297 "DFC_ComChksTCU1" 298 "DFC_ComChksTCU11" 299 "DFC_ComChksTCU12" 300 "DFC_ComChksTCU13" 301 "DFC_ComChksTCU2" 302 "DFC_ComChksTCU3" 303 "DFC_ComChksTCU4" 304 "DFC_ComCntTCU1" 305 "DFC_ComCntTCU11" 306 "DFC_ComCntTCU12" 307 "DFC_ComCntTCU13" 308 "DFC_ComCntTCU2" 309 "DFC_ComCntTCU3" 310 "DFC_ComCntTCU4" 51 "DFC_ComConvBoostErr" 52 "DFC_ComConvSlipErr" 537 "DFC_ComDCDCACCFailr" 53 "DFC_ComDCDCPrfmncErr" 54 "DFC_ComDCDCTempWarn" 439 "DFC_ComDLCTCU01" 440 "DFC_ComDLCTCU02" 441 "DFC_ComDLCTCU1" 442 "DFC_ComDLCTCU11" 443 "DFC_ComDLCTCU12" 444 "DFC_ComDLCTCU13" 445 "DFC_ComDLCTCU14" 446 "DFC_ComDLCTCU2" 447 "DFC_ComDLCTCU3" 448 "DFC_ComDLCTCU4" 55 "DFC_ComEAT10Chksum" 56 "DFC_ComEAT10RingCnt" 57 "DFC_ComEAT10TOut" 58 "DFC_ComEAT11ChkSum" 59 "DFC_ComEAT11RingCnt" 60 "DFC_ComEAT11TOut" 61 "DFC_ComEAT12ChkSum" 62 "DFC_ComEAT12RingCnt" 63 "DFC_ComEAT12TOut" 64 "DFC_ComEAT13ChkSum" 65 "DFC_ComEAT13RingCnt" 66 "DFC_ComEAT13TOut" 67 "DFC_ComEAT1Chksum" 68 "DFC_ComEAT1RingCnt" 69 "DFC_ComEAT1TOut" 70 "DFC_ComEAT2ChkSum" 71 "DFC_ComEAT2RingCnt" 72 "DFC_ComEAT2TOut" 73 "DFC_ComEAT4ChkSum" 74 "DFC_ComEAT4RingCnt" 75 "DFC_ComEAT4TOut" 76 "DFC_ComEAT6Chksum" 77 "DFC_ComEAT6RingCnt" 78 "DFC_ComEAT6TOut" 79 "DFC_ComEAT7Chksum" 80 "DFC_ComEAT7RingCnt" 81 "DFC_ComEAT7TOut" 82 "DFC_ComEAT8Chksum" 83 "DFC_ComEAT8RingCnt" 84 "DFC_ComEAT8TOut" 85 "DFC_ComEATAChksum" 86 "DFC_ComEATARingCnt" 87 "DFC_ComEATATOut" 88 "DFC_ComEATBChkSum" 89 "DFC_ComEATBRingCnt" 90 "DFC_ComEATBTOut" 91 "DFC_ComEATCChksum" 92 "DFC_ComEATCRingCnt" 93 "DFC_ComEATCTOut" 103 "DFC_ComEngCanRxErr" 94 "DFC_ComEPBBChkSum" 95 "DFC_ComEPBBRingCnt" 96 "DFC_ComEPBBTOut" 97 "DFC_ComEPBChksum" 99 "DFC_ComEPBctRing" 98 "DFC_ComEPBTOut" 100 "DFC_ComEPS1Chksum" 101 "DFC_ComEPS1RingCnt" 102 "DFC_ComEPS1TOut" 449 "DFC_ComEPSUnit" 104 "DFC_ComGrvySnsrErr" 105 "DFC_ComGwIMG1ChkSum" 106 "DFC_ComGwIMG1RingCnt" 107 "DFC_ComGwIMG1TOut" 108 "DFC_ComGwIMG3ChkSum" 109 "DFC_ComGwIMG3RingCnt" 110 "DFC_ComGwIMG3TOut" 111 "DFC_ComGwIMG4ChkSum" 112 "DFC_ComGwIMG4RingCnt" 113 "DFC_ComGwIMG4TOut" 114 "DFC_ComGwIMG5ChkSum" 115 "DFC_ComGwIMG5RingCnt" 116 "DFC_ComGwIMG5TOut" 117 "DFC_ComGwIMG6ChkSum" 118 "DFC_ComGwIMG6RingCnt" 119 "DFC_ComGwIMG6TOut" 120 "DFC_ComIDASBChksum" 121 "DFC_ComIDASBRingCnt" 122 "DFC_ComIDASBTOut" 450 "DFC_ComIDASBUnit" 123 "DFC_ComIMGMILReq" 451 "DFC_ComIMGUnit" 124 "DFC_ComISSPrms" 125 "DFC_ComMETAChksum" 126 "DFC_ComMETAChksumPstDrv" 127 "DFC_ComMETARingCnt" 128 "DFC_ComMETARingCntPstDrv" 129 "DFC_ComMETATOut" 130 "DFC_ComMETATOutPstDrv" 131 "DFC_ComMETCChksum" 132 "DFC_ComMETCRingCnt" 133 "DFC_ComMETCTOut" 134 "DFC_ComMETDChksum" 135 "DFC_ComMETDRingCnt" 136 "DFC_ComMETDTOut" 137 "DFC_ComMETE2Chksum" 138 "DFC_ComMETE2RingCnt" 139 "DFC_ComMETE2TOut" 140 "DFC_ComMETFChksum" 141 "DFC_ComMETFRingCnt" 142 "DFC_ComMETFTOut" 143 "DFC_ComMETGChksum" 144 "DFC_ComMETGRingCnt" 145 "DFC_ComMETGTOut" 146 "DFC_ComMETH2Chksum" 147 "DFC_ComMETH2RingCnt" 148 "DFC_ComMETH2TOut" 149 "DFC_ComMETHChksum" 150 "DFC_ComMETHRingCnt" 151 "DFC_ComMETHTOut" 152 "DFC_ComMETIChksum" 153 "DFC_ComMETIRingCnt" 154 "DFC_ComMETITOut" 155 "DFC_ComMETKChksum" 156 "DFC_ComMETKRingCnt" 157 "DFC_ComMETKTOut" 158 "DFC_ComMETLChksum" 159 "DFC_ComMETLRingCnt" 160 "DFC_ComMETLTOut" 161 "DFC_ComMETMChksum" 162 "DFC_ComMETMRingCnt" 163 "DFC_ComMETMTOut" 164 "DFC_ComMETNChksum" 165 "DFC_ComMETNRingCnt" 166 "DFC_ComMETNTOut" 452 "DFC_ComMETUnit" 167 "DFC_ComMtrCom" 168 "DFC_ComPCUChkSum" 169 "DFC_ComPCURingCnt" 170 "DFC_ComPCUTOut" 171 "DFC_ComSRSAChksum" 172 "DFC_ComSRSARingCnt" 173 "DFC_ComSRSATOut" 174 "DFC_ComSRSBChksum" 175 "DFC_ComSRSBRingCnt" 176 "DFC_ComSRSBTOut" 177 "DFC_ComSRSChksum" 178 "DFC_ComSRSErr" 179 "DFC_ComSRSRingCnt" 180 "DFC_ComSRSTOut" 453 "DFC_ComSRSUnit" 311 "DFC_ComTOutTCU01" 312 "DFC_ComTOutTCU02" 313 "DFC_ComTOutTCU1" 314 "DFC_ComTOutTCU11" 315 "DFC_ComTOutTCU12" 316 "DFC_ComTOutTCU13" 317 "DFC_ComTOutTCU14" 318 "DFC_ComTOutTCU2" 319 "DFC_ComTOutTCU3" 320 "DFC_ComTOutTCU4" 181 "DFC_ComVehSpdPndFltTCU" 454 "DFC_ComVSAUnit" 538 "DFC_DCDCFltDet" 321 "DFC_DevLibBattUHi" 322 "DFC_DevLibBattULo" 357 "DFC_DHFHD" 558 "DFC_DiagCpv1DteskLoLoadStuckClsd" 559 "DFC_DiagCpv1DteskLoLoadStuckOpen" 541 "DFC_DKnpl" 539 "DFC_DKRSA" 540 "DFC_DKVSmax" 542 "DFC_DSKVRmax" 543 "DFC_DSKVRmin" 544 "DFC_DSKVRnpl" 545 "DFC_DSKVRsig" 546 "DFC_DSKVSsig" 547 "DFC_DSSmax" 548 "DFC_DSTDmax" 549 "DFC_DSTEmax" 550 "DFC_DSTEmin" 551 "DFC_DSTOFmax" 552 "DFC_DSTRmax" 553 "DFC_DSTRmin" 554 "DFC_DSTRnpl" 555 "DFC_DSTRsig" 556 "DFC_DSTTI" 557 "DFC_DSUmax" 182 "DFC_EbsChartcCurrErr" 183 "DFC_EbsSelfDiagErr" 455 "DFC_EbsSocFlt" 395 "DFC_EGRVlvCurrLim" 560 "DFC_EGRVlvDrftClsd" 561 "DFC_EGRVlvDrftOpn" 323 "DFC_EGRVlvFailSafeActv" 324 "DFC_EGRVlvGovDvtCld" 562 "DFC_EGRVlvJamVlvClsd" 563 "DFC_EGRVlvJamVlvOpn" 396 "DFC_EGRVlvOL" 397 "DFC_EGRVlvOvrTemp" 325 "DFC_EGRVlvPhysSRCMax" 326 "DFC_EGRVlvPhysSRCMin" 398 "DFC_EGRVlvSCB" 399 "DFC_EGRVlvSCG" 564 "DFC_EGRVlvSprgBrk" 400 "DFC_EGRVlvSRCMax" 401 "DFC_EGRVlvSRCMin" 565 "DFC_EGRVlvTempMdlEEPErr" 566 "DFC_EGRVlvTmpErr" 567 "DFC_EGSDUS2B1LtrDly" 568 "DFC_EGSDUS2B1LtrPT1" 569 "DFC_EGSDUS2B1RtlDly" 570 "DFC_EGSDUS2B1RtlPT1" 571 "DFC_EGSDUS2B1TarLean" 572 "DFC_EGSDUS2B1TarRich" 586 "DFC_EngICO" 587 "DFC_EngPrtOvrSpdMon" 573 "DFC_EONVmax" 588 "DFC_EpmCaSI1ErrSig" 589 "DFC_EpmCaSI1MntErr" 590 "DFC_EpmCaSI1NoSigMax" 591 "DFC_EpmCaSI1NoSigMin" 592 "DFC_EpmCaSI1OfsErr" 593 "DFC_EpmCrSDGI" 594 "DFC_EpmCrSErrSig" 595 "DFC_EpmCrSNoSig" 596 "DFC_EtaEngIdleNonCsers" 597 "DFC_EtaEngPtlNonCsers" 574 "DFC_ETAKHLmax" 575 "DFC_ETAKHTmax" 576 "DFC_ETHSEmax" 577 "DFC_ETHSEmin" 578 "DFC_ETHSFmax" 579 "DFC_ETHSFmin" 580 "DFC_ETHSFsig" 581 "DFC_ETHSNPWmax" 582 "DFC_ETHSNPWmin" 583 "DFC_ETHSNPWsig" 584 "DFC_ETHSPLnpl" 585 "DFC_ETHSTPLnpl" 327 "DFC_FanDIOOL_0" 328 "DFC_FanDIOOL_1" 329 "DFC_FanDIOOvrTemp_0" 330 "DFC_FanDIOOvrTemp_1" 331 "DFC_FanDIOSCB_0" 332 "DFC_FanDIOSCB_1" 333 "DFC_FanDIOSCG_0" 334 "DFC_FanDIOSCG_1" 598 "DFC_FRAmax" 599 "DFC_FRAmin" 600 "DFC_FSTEmax" 601 "DFC_FSTEmin" 605 "DFC_FSTmax" 602 "DFC_FSTRmax" 603 "DFC_FSTRmin" 604 "DFC_FSTRnpl" 606 "DFC_FTDLAmax" 607 "DFC_FTDLAmin" 608 "DFC_FuPHiSnsrEleclmax" 609 "DFC_FuPHiSnsrEleclmin" 610 "DFC_FuPHiSnsrEleclnpl" 611 "DFC_FuPHiSnsrURngMax" 612 "DFC_FuPHiSnsrURngMin" 613 "DFC_FuSnsrPhyRngMaxErr" 614 "DFC_FuSnsrPhyRngMinErr" 188 "DFC_GbxCANDigPlausErr" 189 "DFC_GbxNPos1SRCMax" 190 "DFC_GbxNPos1SRCMin" 191 "DFC_GbxNPos2SRCMax" 192 "DFC_GbxNPos2SRCMin" 193 "DFC_GbxNPosAlvChk" 194 "DFC_GbxNPosSyncErr" 413 "DFC_GbxPNPosnDrvCdn" 414 "DFC_GbxPNPosnPlausy" 618 "DFC_GbxRvsSwtStk" 615 "DFC_GEVlvLockPinDiagIntkB1" 184 "DFC_GEVlvPhaCsersIntkB1" 185 "DFC_GEVlvPhaPsOpenLoadIntkB1" 186 "DFC_GEVlvPhaPsShoToBattIntkB1" 187 "DFC_GEVlvPhaPsShoToGndIntkB1" 616 "DFC_GEVlvPhaSlowIntkB1" 617 "DFC_GEVlvPhaTargIntkB1" 619 "DFC_HDRKHmax" 620 "DFC_HDRKHmin" 623 "DFC_HDRmax" 624 "DFC_HDRmin" 621 "DFC_HDRPLmax" 622 "DFC_HDRPLmin" 625 "DFC_HEGOS2B1ElecMax" 626 "DFC_HEGOS2B1ElecMin" 627 "DFC_HEGOS2B1ElecSig" 628 "DFC_HEGOS2B1HtgNpl" 195 "DFC_HEGOS2B1HtrPsMax" 196 "DFC_HEGOS2B1HtrPsMin" 197 "DFC_HEGOS2B1HtrPsSig" 629 "DFC_HEV00max" 630 "DFC_HEV01max" 631 "DFC_HEV02max" 632 "DFC_HEV03max" 633 "DFC_HEVE0max" 634 "DFC_HEVE1max" 635 "DFC_HFMmax" 636 "DFC_HiPSysHiPMaxLimExcdd" 402 "DFC_HLSDemOvhtEngLim" 456 "DFC_I14229VINErr" 261 "DFC_IgnClPs_DevComErr" 262 "DFC_IgnClPs_LineOl_0" 263 "DFC_IgnClPs_LineOl_1" 264 "DFC_IgnClPs_LineOl_2" 265 "DFC_IgnClPs_LineOl_3" 266 "DFC_IgnClPs_LineScb_0" 267 "DFC_IgnClPs_LineScb_1" 268 "DFC_IgnClPs_LineScb_2" 269 "DFC_IgnClPs_LineScb_3" 270 "DFC_IgnClPs_LineScg_0" 271 "DFC_IgnClPs_LineScg_1" 272 "DFC_IgnClPs_LineScg_2" 273 "DFC_IgnClPs_LineScg_3" 457 "DFC_InjCatHeatgErr" 458 "DFC_InjSysMulInjDiagErr" 358 "DFC_InjVlv_DI_DcDc" 359 "DFC_InjVlv_DI_NoLd_0" 360 "DFC_InjVlv_DI_NoLd_1" 361 "DFC_InjVlv_DI_NoLd_2" 362 "DFC_InjVlv_DI_NoLd_3" 363 "DFC_InjVlv_DI_ScBnk_0" 364 "DFC_InjVlv_DI_ScBnk_1" 365 "DFC_InjVlv_DI_ScBnk_2" 366 "DFC_InjVlv_DI_ScBnk_3" 367 "DFC_InjVlv_DI_ScCyl_0" 368 "DFC_InjVlv_DI_ScCyl_1" 369 "DFC_InjVlv_DI_ScCyl_2" 370 "DFC_InjVlv_DI_ScCyl_3" 371 "DFC_InjVlv_DI_ScHsLs_0" 372 "DFC_InjVlv_DI_ScHsLs_1" 373 "DFC_InjVlv_DI_ScHsLs_2" 374 "DFC_InjVlv_DI_ScHsLs_3" 652 "DFC_IntkAirTAirFltDsCrssMax" 653 "DFC_IntkAirTAirFltDsCrssMin" 654 "DFC_IntkAirTAirFltDsHSCMax" 655 "DFC_IntkAirTAirFltDsImps" 656 "DFC_IntkAirTAirFltDsPRCMax" 657 "DFC_IntkAirTAirFltDsPRCMin" 658 "DFC_IntkAirTAirFltDsSRCMax" 659 "DFC_IntkAirTAirFltDsSRCMin" 660 "DFC_IntkAirTAirFltDsSTC" 661 "DFC_IntkAirTIntkMnfldCrssMax" 662 "DFC_IntkAirTIntkMnfldCrssMin" 663 "DFC_IntkAirTIntkMnfldHSCMax" 664 "DFC_IntkAirTIntkMnfldImps" 665 "DFC_IntkAirTIntkMnfldPRCMax" 666 "DFC_IntkAirTIntkMnfldPRCMin" 667 "DFC_IntkAirTIntkMnfldSRCMax" 668 "DFC_IntkAirTIntkMnfldSRCMin" 669 "DFC_IntkAirTIntkMnfldSTC" 647 "DFC_IVGdiCtl_CvoErr" 648 "DFC_IVGdiCtl_CvoSigPlaus_0" 649 "DFC_IVGdiCtl_CvoSigPlaus_1" 650 "DFC_IVGdiCtl_CvoSigPlaus_2" 651 "DFC_IVGdiCtl_CvoSigPlaus_3" 637 "DFC_IVGdiCtlCvoErrMax_0" 638 "DFC_IVGdiCtlCvoErrMax_1" 639 "DFC_IVGdiCtlCvoErrMax_2" 640 "DFC_IVGdiCtlCvoErrMax_3" 641 "DFC_IVGdiCtlCvoErrMin_0" 642 "DFC_IVGdiCtlCvoErrMin_1" 643 "DFC_IVGdiCtlCvoErrMin_2" 644 "DFC_IVGdiCtlCvoErrMin_3" 645 "DFC_IVGdiCtlCvoErrMinMax" 646 "DFC_IVGdiCtlCvoSigPlausErrSmrCdn" 428 "DFC_KnDetSens1PortAMax" 429 "DFC_KnDetSens1PortAMin" 430 "DFC_KnDetSens1PortBMax" 431 "DFC_KnDetSens1PortBMin" 670 "DFC_KRREGRLMX" 671 "DFC_KRVEKOCVLCI" 672 "DFC_KRVEKOENCHMT" 673 "DFC_KRVEKOENCHMT0" 674 "DFC_KRVEKOENCHMT1" 675 "DFC_KRVEKOENCHMT2" 676 "DFC_KRVEKOENCHMT3" 677 "DFC_KRVEKOENCHMT4" 678 "DFC_KRVEKOENCHMT5" 679 "DFC_KRVEKOENCHMT6" 680 "DFC_KRVEKOENCHMT7" 274 "DFC_KRVEKOEVAB" 275 "DFC_KRVEKOEVAB0" 276 "DFC_KRVEKOEVAB1" 277 "DFC_KRVEKOEVAB2" 278 "DFC_KRVEKOEVAB3" 681 "DFC_KRVEKORLMX" 682 "DFC_KRVEKORLMXL" 683 "DFC_KS1max" 684 "DFC_KS1min" 687 "DFC_LamDynDiagS1B1" 688 "DFC_LeakIntkMnfldEmiInfl" 491 "DFC_LIN_E_TIMEOUT" 465 "DFC_LinACGUnit" 466 "DFC_LinAEVUnit" 198 "DFC_LinCSErrACG" 199 "DFC_LinCSErrAEV" 200 "DFC_LinCSErrDCDC" 201 "DFC_LinCSErrEBS" 467 "DFC_LinEBSUnit" 689 "DFC_LinFrameErrDCDC" 202 "DFC_LinHdrTimeoutErrACG" 203 "DFC_LinHdrTimeoutErrAEV" 204 "DFC_LinHdrTimeoutErrDCDC" 205 "DFC_LinHdrTimeoutErrEBS" 206 "DFC_LinMsgTimeoutErrACG" 207 "DFC_LinMsgTimeoutErrAEV" 208 "DFC_LinMsgTimeoutErrDCDC" 209 "DFC_LinMsgTimeoutErrEBS" 210 "DFC_LinNoStrtComErr" 690 "DFC_LinOverrunErrDCDC" 459 "DFC_LLRHmax" 460 "DFC_LLRHmin" 461 "DFC_LLRHnpl" 462 "DFC_LLRKHmax" 463 "DFC_LLRKHmin" 464 "DFC_LLRKHnpl" 685 "DFC_LMmax" 211 "DFC_LowPresOilP" 686 "DFC_LZSRnpl" 691 "DFC_MD00max" 692 "DFC_MDBmax" 693 "DFC_MDCat" 694 "DFC_MDCatCrit" 695 "DFC_MDCatCurr" 696 "DFC_MDCyl_0" 697 "DFC_MDCyl_1" 698 "DFC_MDCyl_2" 699 "DFC_MDCyl_3" 700 "DFC_MDEmi" 701 "DFC_MDEmiStrt" 702 "DFC_MDFco" 705 "DFC_MDmax" 703 "DFC_MDMpl" 704 "DFC_MDSegTiAdpn" 375 "DFC_MfPsDiaOpenLoad1" 376 "DFC_MfPsDiaScHiS1" 377 "DFC_MfPsDiaScHiSLowS1" 378 "DFC_MfPsDiaScLowS1" 706 "DFC_MFuOilMax" 228 "DFC_MisfDetdVWhlFrntLePlaus" 229 "DFC_MisfDetdVWhlFrntRiPlaus" 230 "DFC_MisfDetdVWhlReLePlaus" 231 "DFC_MisfDetdVWhlReRiPlaus" 212 "DFC_MisfDetVWhlFrntLeOORHi" 213 "DFC_MisfDetVWhlFrntLeRatyHi" 214 "DFC_MisfDetVWhlFrntLeRatyLo" 215 "DFC_MisfDetVWhlFrntLeStuck" 216 "DFC_MisfDetVWhlFrntRiOORHi" 217 "DFC_MisfDetVWhlFrntRiRatyHi" 218 "DFC_MisfDetVWhlFrntRiRatyLo" 219 "DFC_MisfDetVWhlFrntRiStuck" 220 "DFC_MisfDetVWhlReLeOORHi" 221 "DFC_MisfDetVWhlReLeRatyHi" 222 "DFC_MisfDetVWhlReLeRatyLo" 223 "DFC_MisfDetVWhlReLeStuck" 224 "DFC_MisfDetVWhlReRiOORHi" 225 "DFC_MisfDetVWhlReRiRatyHi" 226 "DFC_MisfDetVWhlReRiRatyLo" 227 "DFC_MisfDetVWhlReRiStuck" 801 "DFC_MoCADCNTP" 802 "DFC_MoCADCTst" 803 "DFC_MoCSOPICO" 805 "DFC_MoFAirFilgPrdc" 806 "DFC_MoFAirFlCtOffGdi" 807 "DFC_MoFAirFlCylGdi" 808 "DFC_MoFAirFlFF" 809 "DFC_MoFAirFlIn" 810 "DFC_MoFAirFlMixCtlGdiChkAirFl" 811 "DFC_MoFAirFlMixCtlGdiChkCtrl" 812 "DFC_MoFAirFlMode" 804 "DFC_MoFAPP" 813 "DFC_MoFESpd" 814 "DFC_MoFIACo" 815 "DFC_MoFICOL1" 816 "DFC_MoFICOL2" 817 "DFC_MoFStrt" 818 "DFC_MoFTrqCmp" 819 "DFC_MoFTrqCmpMax" 820 "DFC_MoFTrqCmpMin" 821 "DFC_MoFVarPostBldSel" 707 "DFC_MOXEMM_SMU_ALM0_0" 708 "DFC_MOXEMM_SMU_ALM0_1" 709 "DFC_MOXEMM_SMU_ALM0_10" 710 "DFC_MOXEMM_SMU_ALM0_11" 711 "DFC_MOXEMM_SMU_ALM0_13" 712 "DFC_MOXEMM_SMU_ALM0_14" 713 "DFC_MOXEMM_SMU_ALM0_2" 714 "DFC_MOXEMM_SMU_ALM0_22" 715 "DFC_MOXEMM_SMU_ALM0_23" 716 "DFC_MOXEMM_SMU_ALM0_4" 717 "DFC_MOXEMM_SMU_ALM0_5" 718 "DFC_MOXEMM_SMU_ALM0_7" 719 "DFC_MOXEMM_SMU_ALM0_8" 720 "DFC_MOXEMM_SMU_ALM10_16" 721 "DFC_MOXEMM_SMU_ALM10_17" 722 "DFC_MOXEMM_SMU_ALM10_21" 723 "DFC_MOXEMM_SMU_ALM11_0" 724 "DFC_MOXEMM_SMU_ALM11_1" 725 "DFC_MOXEMM_SMU_ALM11_2" 726 "DFC_MOXEMM_SMU_ALM11_3" 727 "DFC_MOXEMM_SMU_ALM11_4" 728 "DFC_MOXEMM_SMU_ALM11_5" 729 "DFC_MOXEMM_SMU_ALM11_8" 730 "DFC_MOXEMM_SMU_ALM11_9" 731 "DFC_MOXEMM_SMU_ALM1_0" 732 "DFC_MOXEMM_SMU_ALM1_1" 733 "DFC_MOXEMM_SMU_ALM1_10" 734 "DFC_MOXEMM_SMU_ALM1_11" 735 "DFC_MOXEMM_SMU_ALM1_13" 736 "DFC_MOXEMM_SMU_ALM1_14" 737 "DFC_MOXEMM_SMU_ALM1_2" 738 "DFC_MOXEMM_SMU_ALM1_22" 739 "DFC_MOXEMM_SMU_ALM1_23" 740 "DFC_MOXEMM_SMU_ALM1_4" 741 "DFC_MOXEMM_SMU_ALM1_5" 742 "DFC_MOXEMM_SMU_ALM1_7" 743 "DFC_MOXEMM_SMU_ALM1_8" 744 "DFC_MOXEMM_SMU_ALM21_0" 745 "DFC_MOXEMM_SMU_ALM21_16" 746 "DFC_MOXEMM_SMU_ALM21_3" 747 "DFC_MOXEMM_SMU_ALM2_1" 748 "DFC_MOXEMM_SMU_ALM2_10" 749 "DFC_MOXEMM_SMU_ALM2_11" 750 "DFC_MOXEMM_SMU_ALM2_13" 751 "DFC_MOXEMM_SMU_ALM2_14" 752 "DFC_MOXEMM_SMU_ALM2_22" 753 "DFC_MOXEMM_SMU_ALM2_23" 754 "DFC_MOXEMM_SMU_ALM2_4" 755 "DFC_MOXEMM_SMU_ALM2_5" 756 "DFC_MOXEMM_SMU_ALM2_7" 757 "DFC_MOXEMM_SMU_ALM2_8" 758 "DFC_MOXEMM_SMU_ALM6_0" 759 "DFC_MOXEMM_SMU_ALM6_11" 760 "DFC_MOXEMM_SMU_ALM6_12" 761 "DFC_MOXEMM_SMU_ALM6_14" 762 "DFC_MOXEMM_SMU_ALM6_15" 763 "DFC_MOXEMM_SMU_ALM6_17" 764 "DFC_MOXEMM_SMU_ALM6_18" 765 "DFC_MOXEMM_SMU_ALM6_20" 766 "DFC_MOXEMM_SMU_ALM6_21" 767 "DFC_MOXEMM_SMU_ALM6_25" 768 "DFC_MOXEMM_SMU_ALM6_4" 769 "DFC_MOXEMM_SMU_ALM6_5" 770 "DFC_MOXEMM_SMU_ALM6_7" 771 "DFC_MOXEMM_SMU_ALM6_8" 772 "DFC_MOXEMM_SMU_ALM7_1" 773 "DFC_MOXEMM_SMU_ALM7_12" 774 "DFC_MOXEMM_SMU_ALM7_13" 775 "DFC_MOXEMM_SMU_ALM7_14" 776 "DFC_MOXEMM_SMU_ALM7_15" 777 "DFC_MOXEMM_SMU_ALM7_16" 778 "DFC_MOXEMM_SMU_ALM7_17" 779 "DFC_MOXEMM_SMU_ALM7_2" 780 "DFC_MOXEMM_SMU_ALM7_20" 781 "DFC_MOXEMM_SMU_ALM7_25" 782 "DFC_MOXEMM_SMU_ALM7_26" 783 "DFC_MOXEMM_SMU_ALM7_28" 784 "DFC_MOXEMM_SMU_ALM7_29" 785 "DFC_MOXEMM_SMU_ALM7_30" 786 "DFC_MOXEMM_SMU_ALM7_31" 787 "DFC_MOXEMM_SMU_ALM8_0" 788 "DFC_MOXEMM_SMU_ALM8_1" 789 "DFC_MOXEMM_SMU_ALM8_10" 790 "DFC_MOXEMM_SMU_ALM8_11" 791 "DFC_MOXEMM_SMU_ALM8_12" 792 "DFC_MOXEMM_SMU_ALM8_16" 793 "DFC_MOXEMM_SMU_ALM8_18" 794 "DFC_MOXEMM_SMU_ALM8_2" 795 "DFC_MOXEMM_SMU_ALM8_3" 796 "DFC_MOXEMM_SMU_ALM8_31" 797 "DFC_MOXEMM_SMU_ALM8_4" 798 "DFC_MOXEMM_SMU_ALM9_0" 799 "DFC_MOXEMM_SMU_ALM9_15" 800 "DFC_MOXEMM_SMU_ALM9_3" 822 "DFC_MoXEMMHwLTMCUFW" 823 "DFC_MoXEMMHwLTMonBIST" 824 "DFC_MoXEMMHwLTRegMonTest" 825 "DFC_MoXEMMHwLTStbySMUAlvTest" 826 "DFC_MoXEMMHwLTTempSens" 827 "DFC_MoXEMMHwLTUCBCfg" 335 "DFC_MRlyDcOL" 336 "DFC_MRlyDcSCB" 337 "DFC_MRlyDcSCG" 492 "DFC_MRlyOL" 493 "DFC_MRlySCB" 494 "DFC_MRlySCG" 828 "DFC_NWSEmax" 829 "DFC_NWSmax" 830 "DFC_OCWDAABEActv" 831 "DFC_OCWDACom" 832 "DFC_OCWDAErrPin" 833 "DFC_OCWDAOvrVltg" 836 "DFC_OilPPlaus" 403 "DFC_OilPSwmpSRCMax" 404 "DFC_OilPSwmpSRCMin" 834 "DFC_ORAmax" 835 "DFC_ORAmin" 847 "DFC_P_VSE11_OL" 848 "DFC_P_VSE11_SCB" 849 "DFC_P_VSE11_SCG" 417 "DFC_PEnvCcMax" 418 "DFC_PEnvCcMin" 419 "DFC_PEnvRngChkMax" 420 "DFC_PEnvRngChkMin" 232 "DFC_PEnvSigRngMax" 233 "DFC_PEnvSigRngMin" 421 "DFC_PEnvSnsrPlaus" 850 "DFC_PhyHighAPP1" 851 "DFC_PhyHighAPP2" 852 "DFC_PhyLowAPP1" 853 "DFC_PhyLowAPP2" 405 "DFC_PIntkVUsLineHiB1" 406 "DFC_PIntkVUsLineLoB1" 837 "DFC_PLLSUmax" 838 "DFC_PLLSUmin" 338 "DFC_PSPOL" 339 "DFC_PSPOvrTemp" 340 "DFC_PSPSCB" 341 "DFC_PSPSCG" 839 "DFC_PSR1max" 840 "DFC_PSRBmax" 841 "DFC_PSRBmin" 845 "DFC_PSRmax" 842 "DFC_PSRPmax" 843 "DFC_PSRPmin" 844 "DFC_PSRPsig" 846 "DFC_PUmax" 475 "DFC_RBA_IODIAGPWR_rba_IoExtCy329_SignalVltSply_0" 476 "DFC_RBA_IODIAGPWR_rba_IoExtCy329_SignalVltSply_0OT" 477 "DFC_RBA_IODIAGPWR_rba_IoExtCy329_SignalVltSply_0OV" 478 "DFC_RBA_IODIAGPWR_rba_IoExtCy329_SignalVltSply_0SCG" 479 "DFC_RBA_IODIAGPWR_rba_IoExtCy329_SignalVltSply_0UV" 480 "DFC_RBA_IODIAGPWR_rba_IoExtCy329_SignalVltSply_1" 481 "DFC_RBA_IODIAGPWR_rba_IoExtCy329_SignalVltSply_1OT" 482 "DFC_RBA_IODIAGPWR_rba_IoExtCy329_SignalVltSply_1OV" 483 "DFC_RBA_IODIAGPWR_rba_IoExtCy329_SignalVltSply_1SCG" 484 "DFC_RBA_IODIAGPWR_rba_IoExtCy329_SignalVltSply_1UV" 485 "DFC_RBA_IODIAGPWR_rba_IoExtCy329_SignalVltSply_2" 486 "DFC_RBA_IODIAGPWR_rba_IoExtCy329_SignalVltSply_2OT" 487 "DFC_RBA_IODIAGPWR_rba_IoExtCy329_SignalVltSply_2OV" 488 "DFC_RBA_IODIAGPWR_rba_IoExtCy329_SignalVltSply_2SCG" 489 "DFC_RBA_IODIAGPWR_rba_IoExtCy329_SignalVltSply_2UV" 498 "DFC_RBA_IOEXTLIB_KEEPALIVE_DRV" 499 "DFC_RBA_IOEXTLIB_KEEPALIVE_INI" 500 "DFC_rba_IoSigRtc_StopCounter" 502 "DFC_rba_MemDiag_MemReadErr" 503 "DFC_rba_MemDiag_MemWrErr" 501 "DFC_rba_MRly_Diag_Stk_Event" 495 "DFC_rba_MultiStackTrace_Threshold" 504 "DFC_rba_SyC_IrrSwOffTrigEngRun_Event" 505 "DFC_rba_T15_Diag_ComInVld_Event" 506 "DFC_rba_T15_Diag_ComOff_HwOn_Event" 507 "DFC_rba_T15_Diag_ComOn_HwOff_Event" 468 "DFC_RoughRoad" 469 "DFC_SiaEEPRdErr" 470 "DFC_SiaEEPWrngCod" 854 "DFC_SRCHighAPP1" 855 "DFC_SRCHighAPP2" 856 "DFC_SRCLowAPP1" 857 "DFC_SRCLowAPP2" 858 "DFC_SSpMon2" 859 "DFC_STHDRmax" 234 "DFC_StmFault" 236 "DFC_StrtCtlErr" 235 "DFC_StrtCtOffPth" 237 "DFC_StrtFault" 238 "DFC_StrtLckJudg1" 239 "DFC_StrtLckJudg2" 240 "DFC_StrtOL" 241 "DFC_StrtOL2" 242 "DFC_StrtSCB" 243 "DFC_StrtSCB2" 244 "DFC_StrtSCG" 245 "DFC_StrtSCG2" 246 "DFC_StrtStkRly1" 247 "DFC_StrtStkRly2" 860 "DFC_SWReset_0" 861 "DFC_SWReset_1" 862 "DFC_SWReset_2" 863 "DFC_SyncAPP" 342 "DFC_T50Err" 865 "DFC_TAmax_Dummy" 864 "DFC_TANKLnpl" 866 "DFC_TESFmax" 867 "DFC_TESGmax" 248 "DFC_TEVEmax" 249 "DFC_TEVEmin" 250 "DFC_TEVEsig" 875 "DFC_ThrVlvClsdPosnFirstOffsLrnImpoB1" 876 "DFC_ThrVlvClsdPosnOffsLrnImpoB1" 877 "DFC_ThrVlvClsdPosnOffsLrnMaxB1" 878 "DFC_ThrVlvClsdPosnOffsLrnMinB1" 879 "DFC_ThrVlvCtrlDeB1" 880 "DFC_ThrVlvDycB1" 881 "DFC_ThrVlvLimpAirPosnMaxAbsltDriftB1" 882 "DFC_ThrVlvLimpAirPosnMaxB1" 883 "DFC_ThrVlvLimpAirPosnMaxRelDriftB1" 884 "DFC_ThrVlvLimpAirPosnMinB1" 343 "DFC_ThrVlvLoBattB1" 885 "DFC_ThrVlvOpenLoadB1" 886 "DFC_ThrVlvOpenSprgB1" 887 "DFC_ThrVlvOpenSprgSprdB1" 888 "DFC_ThrVlvOpenSprgTwnB1" 889 "DFC_ThrVlvOverTB1" 890 "DFC_ThrVlvRetSprgB1" 891 "DFC_ThrVlvRetSprgSprdB1" 892 "DFC_ThrVlvRetSprgTwnB1" 893 "DFC_ThrVlvSens1MaxB1" 900 "DFC_ThrvlvSens1MinB1" 894 "DFC_ThrVlvSens1NplB1" 895 "DFC_ThrVlvSens2MaxB1" 896 "DFC_ThrVlvSens2MinB1" 897 "DFC_ThrVlvSens2NplB1" 898 "DFC_ThrVlvShoCircB1" 899 "DFC_ThrVlvSpiErrB1" 901 "DFC_TiOffTBasdChkFast" 902 "DFC_TiOffTBasdChkSlow" 868 "DFC_TKAEmax" 869 "DFC_TKAEmin" 870 "DFC_TKARmax" 871 "DFC_TKARnpl" 872 "DFC_TMmax_Dummy" 873 "DFC_TUMmax_Dummy" 874 "DFC_TWCDPriCatB1" 251 "DFC_UegoHeatrPrfmncLoS1B1" 422 "DFC_UEGOHeatrRlyPsOLS1B1" 423 "DFC_UEGOHeatrRlyPsSCBS1B1" 424 "DFC_UEGOHeatrRlyPsSCGS1B1" 471 "DFC_UegoHeatrStrtS1B1" 425 "DFC_UegoHeatrWireOlS1B1" 426 "DFC_UegoHeatrWireScbS1B1" 427 "DFC_UegoHeatrWireScgS1B1" 279 "DFC_UegoSigEcuAsicS1B1" 280 "DFC_UegoSigEcuComS1B1" 344 "DFC_UegoSigOperPlausS1B1" 281 "DFC_UegoSigSnsrS1B1" 282 "DFC_UegoSigWireOlApesS1B1" 283 "DFC_UegoSigWireOlIpeS1B1" 284 "DFC_UegoSigWireOlReS1B1" 285 "DFC_UegoSigWireRCmpS1B1" 286 "DFC_UegoSigWireScbS1B1" 287 "DFC_UegoSigWireScgS1B1" 903 "DFC_UEGOSnsrMntdS1B1" 252 "DFC_VehVAllPlaus" 253 "DFC_VehVNCSnsrElecFailr" 345 "DFC_VehVPhysRngHi" 407 "DFC_VehVPhysRngLo" 254 "DFC_VehVPlausCan" 255 "DFC_VehVPlausFco" 256 "DFC_VehVPlausPwr" 257 "DFC_VehVPlausV2N" 346 "DFC_VehVSclOutOL" 347 "DFC_VehVSclOutOT" 348 "DFC_VehVSclOutSCB" 349 "DFC_VehVSclOutSCG" 904 "DFC_VehVSig" 408 "DFC_VehVSigCan" 409 "DFC_VehVSigCanSafe" 350 "DFC_VehVSigFL" 351 "DFC_VehVSigFR" 352 "DFC_VehVSigRL" 353 "DFC_VehVSigRR" 354 "DFC_VehVSnsrARngHi" 355 "DFC_VehVSnsrBRngHi" 356 "DFC_VehVSpdRtyDiag" 258 "DFC_VehVSpdSnsrAElecFailr" 259 "DFC_VehVSpdSnsrBElecFailr" 410 "DFC_VlvLftFbOilPSnsrIntk11SRCMax" 411 "DFC_VlvLftFbOilPSnsrIntk11SRCMin" 905 "DFC_VlvLftFbSwtIntk11SpclFail" 906 "DFC_VlvLftFbSwtIntk11StdFail" DEFAULT_VALUE "---" /end COMPU_VTAB
/begin COMPU_METHOD DFES_LampFltMIL "" TAB_VERB "%6.3" "-" COMPU_TAB_REF DFES_LampFltMIL /end COMPU_METHOD
/begin COMPU_VTAB DFES_LampFltMIL "" TAB_VERB 4 0 "NO_Lamp_Activation" 1 "Continous_Lamp_Support" 2 "Blinking_Lamp_Support" 3 "Blinking_and_Continous_Lamp_Supp" /end COMPU_VTAB
/begin COMPU_METHOD DFES_LampFltSVS "" TAB_VERB "%6.3" "-" COMPU_TAB_REF DFES_LampFltSVS /end COMPU_METHOD
/begin COMPU_VTAB DFES_LampFltSVS "" TAB_VERB 6 0 "NO_Lamp_Activation" 1 "Continous_Lamp_Support" 2 "Blinking_Lamp_Support" 3 "Blinking_and_Continous_Lamp_Supp" 4 "Continuous_SVS_Support_LDF" 8 "Continuous_SVS_Support_LDF_FLC" /end COMPU_VTAB
/begin COMPU_METHOD DFES_nPID0C "" RAT_FUNC "%6.3" "rpm" COEFFS 0 4 0 0 0 1 /end COMPU_METHOD
/begin COMPU_METHOD DFES_OneToOne "" RAT_FUNC "%6.2" "-" COEFFS 0 1 0 0 0 1 /end COMPU_METHOD
/begin COMPU_METHOD DFES_rPID04 "" RAT_FUNC "%6.3" "%" COEFFS 0 2.55 0 0 0 1 /end COMPU_METHOD
/begin COMPU_METHOD DFES_tPID05 "" RAT_FUNC "%6.2" "deg C" COEFFS 0 1 40 0 0 1 /end COMPU_METHOD
/begin COMPU_METHOD DFES_TstVisAndPrio "" TAB_VERB "%6.3" "-" COMPU_TAB_REF DFES_TstVisAndPrio /end COMPU_METHOD
/begin COMPU_VTAB DFES_TstVisAndPrio "" TAB_VERB 13 3 "invisible_for_all_Testers" 5 "ServiceLow" 7 "ServiceHigh" 9 "ServiceHigh_PrioOffs_1" 11 "ServiceHigh_PrioOffs_2" 27 "ServiceHighPlus" 205 "OBDLow" 207 "OBDHigh" 209 "OBDHighPlus" 211 "ServiceHigh_MaxPrio" 213 "ServiceHigh_OBDLow_MaxPrio" 215 "ServiceHigh_OBDHigh_MaxPrio" 217 "ServiceHigh_OBDHighPlus_MaxPrio" /end COMPU_VTAB
/begin COMPU_METHOD dfp_verbal "" TAB_VERB "%6.3" "-" COMPU_TAB_REF dfp_verbal /end COMPU_METHOD
/begin COMPU_VTAB dfp_verbal "" TAB_VERB 83 0 "DFP_AAA" 1 "DFP_AAV" 2 "DFP_AAVE" 3 "DFP_AGRE" 4 "DFP_AGRS" 5 "DFP_DHFHD" 6 "DFP_DK" 7 "DFP_DK1P" 8 "DFP_DK2P" 9 "DFP_DKVS" 10 "DFP_DSKV" 11 "DFP_DSKVR" 12 "DFP_DSKVS" 13 "DFP_DSS" 14 "DFP_DSU" 15 "DFP_DVEE" 16 "DFP_DVEF" 17 "DFP_DVEFO" 18 "DFP_DVEL" 19 "DFP_DVEN" 20 "DFP_DVER" 21 "DFP_DVEU" 22 "DFP_DVEUB" 23 "DFP_DVEUW" 24 "DFP_DYLSU" 25 "DFP_ENWCS" 26 "DFP_ENWS" 27 "DFP_ENWSE" 28 "DFP_EONV" 29 "DFP_FP1P" 30 "DFP_FP2P" 31 "DFP_FRA" 32 "DFP_FST" 33 "DFP_FSTE" 34 "DFP_FSTR" 35 "DFP_FTDLA" 36 "DFP_HDR" 37 "DFP_HDRKH" 38 "DFP_HDRPL" 39 "DFP_HFM" 40 "DFP_HSH" 41 "DFP_HSHE" 42 "DFP_KAT" 43 "DFP_KPE" 44 "DFP_KS1" 45 "DFP_LLRH" 46 "DFP_LLRKH" 47 "DFP_LM" 48 "DFP_LSH" 49 "DFP_LZSR" 50 "DFP_MD" 51 "DFP_NWS" 52 "DFP_NWSE" 53 "DFP_ORA" 54 "DFP_PLLSU" 55 "DFP_PSR" 56 "DFP_PSR1" 57 "DFP_PSRB" 58 "DFP_PSRE" 59 "DFP_PSRP" 60 "DFP_PU" 61 "DFP_PUE" 62 "DFP_PUPL" 63 "DFP_PUR" 64 "DFP_STHDR" 65 "DFP_TA" 66 "DFP_TANKL" 67 "DFP_TANLCS" 68 "DFP_TANLPRC" 69 "DFP_TANLR" 70 "DFP_TASRCS" 71 "DFP_TASRE" 72 "DFP_TASRPRC" 73 "DFP_TASRR" 74 "DFP_TESF" 75 "DFP_TESG" 76 "DFP_TM" 77 "DFP_TMCS" 78 "DFP_TME" 79 "DFP_TMP" 80 "DFP_UB" 81 "DFP_VFZ" 82 "DFP_ZZZ" DEFAULT_VALUE "---" /end COMPU_VTAB
/begin COMPU_METHOD DiaActr_ElecHBrdgDiag_DbgSigType_COMPU_VERB "" TAB_VERB "%6.3" "" COMPU_TAB_REF DiaActr_ElecHBrdgDiag_DbgSigType_COMPU_VERB /end COMPU_METHOD
/begin COMPU_VTAB DiaActr_ElecHBrdgDiag_DbgSigType_COMPU_VERB "" TAB_VERB 2 0 "HBR_SIGNAL" 1 "HLFBR_SIGNAL" DEFAULT_VALUE "0" /end COMPU_VTAB
/begin COMPU_METHOD DiaActr_ElecHBrdgDiag_OlEnaSwtOff_COMPU_VERB "" TAB_VERB "%6.3" "" COMPU_TAB_REF DiaActr_ElecHBrdgDiag_OlEnaSwtOff_COMPU_VERB /end COMPU_METHOD
/begin COMPU_VTAB DiaActr_ElecHBrdgDiag_OlEnaSwtOff_COMPU_VERB "" TAB_VERB 2 0 "NO_SWITCHOFF" 1 "SWITCHOFF" DEFAULT_VALUE "0" /end COMPU_VTAB
/begin COMPU_METHOD DSMAUX_DTRGVerb "" TAB_VERB "%6.3" "-" COMPU_TAB_REF DSMAUX_DTRGVerb /end COMPU_METHOD
/begin COMPU_VTAB DSMAUX_DTRGVerb "" TAB_VERB 12 1 "DTRG_AlwaysTrue" 2 "DTRG_DrivingCycleFLC" 3 "DTRG_DrivingCycleHLC" 4 "DTRG_MDCatHLC" 5 "DTRG_MDEmiHLC" 6 "DTRG_MDEmiStrtHLC" 7 "DTRG_MDFLC2" 8 "DTRG_MDHLC2" 9 "DTRG_NoTrigger" 10 "DTRG_SimilarCondHLC" 0 "DTRG_Time200ms" 11 "DTRG_WarmUpCycle" DEFAULT_VALUE "---" /end COMPU_VTAB
/begin COMPU_METHOD EPM_IAPACTV_SC_Compu "" TAB_VERB "%6.3" "" COMPU_TAB_REF EPM_IAPACTV_SC_Compu /end COMPU_METHOD
/begin COMPU_VTAB EPM_IAPACTV_SC_Compu "" TAB_VERB 2 0 "IAP_OFF" 1 "IAP_ON" /end COMPU_VTAB
/begin COMPU_METHOD EPM_INDCAMSFTCFG_SC_Compu "" TAB_VERB "%6.3" "" COMPU_TAB_REF EPM_INDCAMSFTCFG_SC_Compu /end COMPU_METHOD
/begin COMPU_VTAB EPM_INDCAMSFTCFG_SC_Compu "" TAB_VERB 2 0 "False" 1 "True" /end COMPU_VTAB
/begin COMPU_METHOD EPM_KEEPDGISYNC_SC_Compu "" TAB_VERB "%6.3" "" COMPU_TAB_REF EPM_KEEPDGISYNC_SC_Compu /end COMPU_METHOD
/begin COMPU_VTAB EPM_KEEPDGISYNC_SC_Compu "" TAB_VERB 2 0 "STD" 1 "KEEPDGISYNC" /end COMPU_VTAB
/begin COMPU_METHOD EPM_MEASURE_SY_Compu "" TAB_VERB "%6.3" "" COMPU_TAB_REF EPM_MEASURE_SY_Compu /end COMPU_METHOD
/begin COMPU_VTAB EPM_MEASURE_SY_Compu "" TAB_VERB 3 0 "NO_MP" 1 "TEST_MP" 2 "RAW_AG_TEST_MP" /end COMPU_VTAB
/begin COMPU_METHOD EPM_NRAGEVE_SC_Compu "" RAT_FUNC "%6.2" "" COEFFS 0 1 0 0 0 1 /end COMPU_METHOD
/begin COMPU_METHOD EPM_NRVIRTSYN_SC_Compu "" RAT_FUNC "%6.2" "" COEFFS 0 1 0 0 0 1 /end COMPU_METHOD
/begin COMPU_METHOD EPM_OPTMRT_SC_Compu "" TAB_VERB "%6.3" "" COMPU_TAB_REF EPM_OPTMRT_SC_Compu /end COMPU_METHOD
/begin COMPU_VTAB EPM_OPTMRT_SC_Compu "" TAB_VERB 2 0 "OPTMRT_OFF" 1 "OPTMRT_ON" /end COMPU_VTAB
/begin COMPU_METHOD EPM_RVSROTPRED_SC_Compu "" TAB_VERB "%6.3" "" COMPU_TAB_REF EPM_RVSROTPRED_SC_Compu /end COMPU_METHOD
/begin COMPU_VTAB EPM_RVSROTPRED_SC_Compu "" TAB_VERB 2 0 "Deactvd" 1 "Inct_Ti_Thd" /end COMPU_VTAB
/begin COMPU_METHOD EPM_SPD_CALC_SY_Compu "" TAB_VERB "%6.3" "" COMPU_TAB_REF EPM_SPD_CALC_SY_Compu /end COMPU_METHOD
/begin COMPU_VTAB EPM_SPD_CALC_SY_Compu "" TAB_VERB 4 0 "SPD_IN_IGNEDGE" 1 "SPD_IN_WAITGAP" 2 "SPD_LOW_NEG" 3 "SPD_LOW_NEG_HIRES" /end COMPU_VTAB
/begin COMPU_METHOD EPM_STRTSELECT_SC_Compu "" TAB_VERB "%6.3" "" COMPU_TAB_REF EPM_STRTSELECT_SC_Compu /end COMPU_METHOD
/begin COMPU_VTAB EPM_STRTSELECT_SC_Compu "" TAB_VERB 5 0 "NO_SELECT" 1 "SEL_StaActV_C" 2 "SEL_StaActV_CA02" 3 "SEL_StaActV_CA03" 4 "SEL_StaActV_CA04" /end COMPU_VTAB
/begin COMPU_METHOD EPM_STRTWOCAMSFTSIGDETN_SC_Compu "" TAB_VERB "%6.3" "" COMPU_TAB_REF EPM_STRTWOCAMSFTSIGDETN_SC_Compu /end COMPU_METHOD
/begin COMPU_VTAB EPM_STRTWOCAMSFTSIGDETN_SC_Compu "" TAB_VERB 2 0 "Disabled" 1 "Enabled" /end COMPU_VTAB
/begin COMPU_METHOD EPM_SYNCSLV_SY_Compu "" TAB_VERB "%6.3" "" COMPU_TAB_REF EPM_SYNCSLV_SY_Compu /end COMPU_METHOD
/begin COMPU_VTAB EPM_SYNCSLV_SY_Compu "" TAB_VERB 2 0 "NO_SLV_SYNC" 1 "SLV_VIA_CAN_SYNC" /end COMPU_VTAB
/begin COMPU_METHOD EPM_TDCDSTCLB_SC_Compu "" TAB_VERB "%6.3" "" COMPU_TAB_REF EPM_TDCDSTCLB_SC_Compu /end COMPU_METHOD
/begin COMPU_VTAB EPM_TDCDSTCLB_SC_Compu "" TAB_VERB 2 0 "STANDARD" 1 "ARRAY" /end COMPU_VTAB
/begin COMPU_METHOD EPM_TIMING_SY_Compu "" TAB_VERB "%6.3" "" COMPU_TAB_REF EPM_TIMING_SY_Compu /end COMPU_METHOD
/begin COMPU_VTAB EPM_TIMING_SY_Compu "" TAB_VERB 3 0 "STD" 1 "HE_ONEBOX" 2 "RC_MASLV" /end COMPU_VTAB
/begin COMPU_METHOD EPM_VAR_SY_Compu "" TAB_VERB "%6.3" "" COMPU_TAB_REF EPM_VAR_SY_Compu /end COMPU_METHOD
/begin COMPU_VTAB EPM_VAR_SY_Compu "" TAB_VERB 48 0 "no customer" 1 "DAI" 3 "VWW" 4 "POR" 5 "AUD" 6 "OPE" 9 "FIA" 11 "BMW" 14 "PSA" 15 "REN" 17 "ALF" 18 "SAB" 19 "VOL" 20 "NIS" 21 "GMU" 22 "FOR" 26 "ISZ" 36 "MAN" 51 "SEA" 53 "CHR" 54 "JAG" 55 "ROL" 69 "FER" 72 "TOY" 123 "MIT" 147 "HYU" 159 "HON" 160 "MAZ" 183 "CU" 190 "LRG" 204 "VVW" 214 "AVT" 242 "Iveco" 243 "DMC" 248 "SUZ" 267 "SSANGYONG" 270 "KEF" 289 "AMG" 308 "TAT" 319 "MVM" 385 "UAES" 699 "AGCO" 828 "RBCD" 898 "MFTBC" 999 "ALL" 2887 "Nonox" 9454 "Fuso" 9740 "Navistar" /end COMPU_VTAB
/begin COMPU_METHOD Length "" RAT_FUNC "%6.2" "m" COEFFS 0 1 0 0 0 1 /end COMPU_METHOD
/begin COMPU_METHOD nmot_ub_q40 "" RAT_FUNC "%6.1" "1/min" COEFFS 0 1 0 0 0 40 /end COMPU_METHOD
/begin COMPU_METHOD OneToOne "" RAT_FUNC "%6.2" "-" COEFFS 0 1 0 0 0 1 /end COMPU_METHOD
/begin COMPU_METHOD rel_ub_q0p75 "" RAT_FUNC "%6.3" "%" COEFFS 0 1 0 0 0 0.75 /end COMPU_METHOD
/begin COMPU_METHOD Signals_IntSigNumVerb "" TAB_VERB "%6.3" "" COMPU_TAB_REF Signals_IntSigNumVerb /end COMPU_METHOD
/begin COMPU_VTAB Signals_IntSigNumVerb "" TAB_VERB 1169 0 "SIGNALS_Signals_Default" 1 "SIGNALS_APP_rUnFlt" 2 "SIGNALS_APP_r_sig" 3 "SIGNALS_APP_r_signal" 4 "SIGNALS_APP_uRaw1_signal" 5 "SIGNALS_APP_uRaw2_signal" 6 "SIGNALS_AbsLdCom8Bit_PID43h" 7 "SIGNALS_AccPed_tqMapBasd_BENG_signal" 8 "SIGNALS_AccPed_tqMapBasd_TRQB_signal" 9 "SIGNALS_ActMod_trqInr_signal" 10 "SIGNALS_AirC_uAnaRawClnt_signal" 11 "SIGNALS_Alt_iExctLim_signal" 12 "SIGNALS_Alt_rAltExct_signal" 13 "SIGNALS_Alt_uFinalDes_signal" 14 "SIGNALS_BattU_u" 15 "SIGNALS_BattU_uSens1_signal" 16 "SIGNALS_BattU_uSens2_s" 17 "SIGNALS_BattU_uSens_signal" 18 "SIGNALS_Batt_lMaxCnsChk_signal" 19 "SIGNALS_Batt_lMinCnsChk_signal" 20 "SIGNALS_Batt_qCnsChkAH_signal" 21 "SIGNALS_Brk_st" 22 "SIGNALS_Brk_stRed" 23 "SIGNALS_CEngDsT_uRaw_s" 24 "SIGNALS_CEngDsT_uRaw_signal" 25 "SIGNALS_CEngUsT_t_signal" 26 "SIGNALS_CEngUsT_uSnsr_s" 27 "SIGNALS_CoEng_tiCranking_signal" 28 "SIGNALS_CoVeh_trqAcs_s" 29 "SIGNALS_ComEBS_BattID_signal" 30 "SIGNALS_ComEBS_rBattSensCh_signal" 31 "SIGNALS_ComEBS_rBattStrat_signal" 32 "SIGNALS_ComEBS_uBattSens_signal" 33 "SIGNALS_ComEBS_uBattUCO_signal" 34 "SIGNALS_Com_iBattEBS_signal" 35 "SIGNALS_Com_lDst_signal" 36 "SIGNALS_Com_rMeasdBattREbs_signal" 37 "SIGNALS_Com_stI_signal" 38 "SIGNALS_Com_stT_signal" 39 "SIGNALS_Com_stU_signal" 40 "SIGNALS_Com_tBattEBS_signal" 41 "SIGNALS_Com_trqAYCFDes_signal" 42 "SIGNALS_Com_uPeak_signal" 43 "SIGNALS_CrCtl_stShutOffCode0_signal" 44 "SIGNALS_CrCtl_stShutOffCode1_signal" 45 "SIGNALS_CrCtl_stShutOffCode2_signal" 46 "SIGNALS_CrCtl_stShutOffCode3_signal" 47 "SIGNALS_CrCtl_stShutOffCode4_signal" 48 "SIGNALS_CrCtl_stShutOffCode5_signal" 49 "SIGNALS_CrCtl_stShutOffCode6_signal" 50 "SIGNALS_CrCtl_stShutOffCode7_signal" 51 "SIGNALS_CrCtl_stShutOffCode8_signal" 52 "SIGNALS_CrCtl_stShutOffCode9_signal" 53 "SIGNALS_DIUMPR_ctGenDenom_signal" 54 "SIGNALS_DIUMPR_ctIgn_signal" 55 "SIGNALS_DRIVE_numDTCFrz_s" 56 "SIGNALS_DRIVE_stCurTrgMode_signal" 57 "SIGNALS_DRIVE_stHardToStrt_s" 58 "SIGNALS_DSM_tiMICumCont" 59 "SIGNALS_DcmDspUDS_rdbi_2612Byte10_signal" 60 "SIGNALS_DcmDspUDS_rdbi_2612Byte11_signal" 61 "SIGNALS_DcmDspUDS_rdbi_fixed_signal" 62 "SIGNALS_DcmDspUDS_rdbi_reserved0_signal_s" 63 "SIGNALS_DcmDspUDS_rdbi_reserved0_signal_w_s" 64 "SIGNALS_DcmDspUDS_rdbi_reserved1_signal" 65 "SIGNALS_Dspl_stCrsSwtInfo_signal" 66 "SIGNALS_Ebs_qBliChrg_signal" 67 "SIGNALS_Ebs_qBliDchaTotDcyc_0_signal" 68 "SIGNALS_Ebs_qBliDchaTotDcyc_1_signal" 69 "SIGNALS_Ebs_qBliDchaTotDcyc_2_signal" 70 "SIGNALS_Ebs_qBliDchaTotDcyc_3_signal" 71 "SIGNALS_Ebs_qBliDchaTotDcyc_4_signal" 72 "SIGNALS_Ebs_qBliDcha_signal" 73 "SIGNALS_Ebs_stStbIEBSByt0_0_signal" 74 "SIGNALS_Ebs_stStbIEBSByt0_1_signal" 75 "SIGNALS_Ebs_stStbIEBSByt0_2_signal" 76 "SIGNALS_Ebs_stStbIEBSByt0_3_signal" 77 "SIGNALS_Ebs_stStbIEBSByt0_4_signal" 78 "SIGNALS_Ebs_stStbIEBSByt1_0_signal" 79 "SIGNALS_Ebs_stStbIEBSByt1_1_signal" 80 "SIGNALS_Ebs_stStbIEBSByt1_2_signal" 81 "SIGNALS_Ebs_stStbIEBSByt1_3_signal" 82 "SIGNALS_Ebs_stStbIEBSByt1_4_signal" 83 "SIGNALS_Ebs_stStbIEBSByt2_0_signal" 84 "SIGNALS_Ebs_stStbIEBSByt2_1_signal" 85 "SIGNALS_Ebs_stStbIEBSByt2_2_signal" 86 "SIGNALS_Ebs_stStbIEBSByt2_3_signal" 87 "SIGNALS_Ebs_stStbIEBSByt2_4_signal" 88 "SIGNALS_Ebs_stStbIEBSByt3_0_signal" 89 "SIGNALS_Ebs_stStbIEBSByt3_1_signal" 90 "SIGNALS_Ebs_stStbIEBSByt3_2_signal" 91 "SIGNALS_Ebs_stStbIEBSByt3_3_signal" 92 "SIGNALS_Ebs_stStbIEBSByt3_4_signal" 93 "SIGNALS_Ebs_stStbIEBSByt4_0_signal" 94 "SIGNALS_Ebs_stStbIEBSByt4_1_signal" 95 "SIGNALS_Ebs_stStbIEBSByt4_2_signal" 96 "SIGNALS_Ebs_stStbIEBSByt4_3_signal" 97 "SIGNALS_Ebs_stStbIEBSByt4_4_signal" 98 "SIGNALS_EngTrqPtd_trqLead_s" 99 "SIGNALS_EngTrqPtd_trqLead_signal" 100 "SIGNALS_EngTrqPtd_trqSet_s" 101 "SIGNALS_EngTrqPtd_trqSet_signal" 102 "SIGNALS_EpmCaS_ctErrSig_signal" 103 "SIGNALS_EpmCaS_ctNoSig_signal" 104 "SIGNALS_EpmCaS_phiDiffCal2AdapEqAvg_0" 105 "SIGNALS_EpmCaS_phiOfsCorr" 106 "SIGNALS_Epm_nEngAct" 107 "SIGNALS_Epm_nEngRaw_s" 108 "SIGNALS_Epm_nEngRaw_signal" 109 "SIGNALS_Epm_stOpMode" 110 "SIGNALS_Epm_stSync" 111 "SIGNALS_FuPHi_uHiResl_signal" 112 "SIGNALS_GEVlv_ratPhaIntkB1_signal" 113 "SIGNALS_GlbDa_lenTotDstDcycHiResl_signal" 114 "SIGNALS_HEGO_uS2B1Extd_s" 115 "SIGNALS_HEGO_uS2B1HiRes_signal" 116 "SIGNALS_I14229CoEng_tiNormalOBDPrevDcyc_s" 117 "SIGNALS_I14229EpmCaS_ctErrSig1_signal" 118 "SIGNALS_I14229EpmCaS_ctNoSig1_signal" 119 "SIGNALS_I14229GlbDa_lTotDstDCHiReslPrevDcyc_s" 120 "SIGNALS_I14229IntkAirT_tSnsrTstrMax_s" 121 "SIGNALS_I14229IntkAirT_tSnsrTstrMin_s" 122 "SIGNALS_I14229RDBI_nOvrSpd_signal" 123 "SIGNALS_I14229RDBI_tiOvrSpd_signal" 124 "SIGNALS_I14229_AirC_pAnaClnt_signal" 125 "SIGNALS_I14229_ElecLd_iEPSLoadOnly_signal" 126 "SIGNALS_I14229_EpmCaS_ctErrSig2_signal" 127 "SIGNALS_I14229_EpmCaS_ctNoSig2_signal" 128 "SIGNALS_I14229_EpmCrS_ctCaSRev_signal" 129 "SIGNALS_I14229_EpmCrS_ctErrSig_signal" 130 "SIGNALS_I14229_GEVCtl_agMaxAdpdIntk_signal" 131 "SIGNALS_I14229_Gbx_uAna1NPosRaw_signal" 132 "SIGNALS_I14229_Gbx_uAna2NPosRaw_signal" 133 "SIGNALS_I14229_ivzabg_w_signal" 134 "SIGNALS_I14229_lDst_signal" 135 "SIGNALS_I14229_nstat_signal" 136 "SIGNALS_I14229_numDTCFrzFrmHi_signal" 137 "SIGNALS_I14229_numDTCFrzFrmLo_signal" 138 "SIGNALS_I14229_numDTCFrzFrmMid_signal" 139 "SIGNALS_I14229_ps_w_signal" 140 "SIGNALS_I14229_rTrqPT_signal" 141 "SIGNALS_I14229_stTURBODV_signal" 142 "SIGNALS_I14229_tSnsrFild1_signal" 143 "SIGNALS_I14229_tiInj1On_signal" 144 "SIGNALS_I14229_tiOilFlowCompl_signal" 145 "SIGNALS_I14229_tiSia_signal" 146 "SIGNALS_I14229_tkaMax_s" 147 "SIGNALS_I14229_tkaMin_s" 148 "SIGNALS_I14229_tka_signal" 149 "SIGNALS_I14229_tmotMaxCurrDcyc_s" 150 "SIGNALS_I14229_tmotMaxPrevDcyc_s" 151 "SIGNALS_I14229_tmotMinCurrDcyc_s" 152 "SIGNALS_I14229_tmotMinPrevDcyc_s" 153 "SIGNALS_I14229_ubsq_signal" 154 "SIGNALS_I14229_umsrln_w_signal" 155 "SIGNALS_I14229_wdks_w_signal" 156 "SIGNALS_I14229_wped1_signal" 157 "SIGNALS_I14229_wped2_signal" 158 "SIGNALS_I14229_zwist_signal" 159 "SIGNALS_I14229iocpMDA_numABV_signal" 160 "SIGNALS_I14229iocpMDA_numACGC_signal" 161 "SIGNALS_I14229iocpMDA_numAPS_signal" 162 "SIGNALS_I14229iocpMDA_numPSC_signal" 163 "SIGNALS_I14229iocpMDA_numRFAN_signal" 164 "SIGNALS_I14229iocpMDA_numRvsLck_signal" 165 "SIGNALS_I14229iocpMDA_numVTEC_signal" 166 "SIGNALS_I14229iocp_numCtlSt_s" 167 "SIGNALS_I14229iocp_numEXE_signal" 168 "SIGNALS_I14229iocp_numREQ_s" 169 "SIGNALS_I14229iocp_stSFTRJC_s" 170 "SIGNALS_I15031_PID1Dh" 171 "SIGNALS_I15031_PID65Ah" 172 "SIGNALS_I15031_PID66Ah" 173 "SIGNALS_I15031_PID69Ah" 174 "SIGNALS_I15031_PID6AAh" 175 "SIGNALS_I15031_PID6BAh" 176 "SIGNALS_I15031_PID6CAh" 177 "SIGNALS_I15031_PID6DAh" 178 "SIGNALS_I15031_PID6EAh" 179 "SIGNALS_I15031_PID6FAh" 180 "SIGNALS_I15031_PID70Ah" 181 "SIGNALS_I15031_PID71Ah" 182 "SIGNALS_I15031_PID72Ah" 183 "SIGNALS_I15031_PID73Ah" 184 "SIGNALS_I15031_PID74Ah" 185 "SIGNALS_I15031_PID75Ah" 186 "SIGNALS_I15031_PID76Ah" 187 "SIGNALS_I15031_PID77Ah" 188 "SIGNALS_I15031_PID78Ah" 189 "SIGNALS_I15031_PID79Ah" 190 "SIGNALS_I15031_PID7AAh" 191 "SIGNALS_I15031_PID7BAh" 192 "SIGNALS_I15031_PID7CAh" 193 "SIGNALS_I15031_PID7FAh" 194 "SIGNALS_I15031_PID81Ah" 195 "SIGNALS_I15031_PID82Ah" 196 "SIGNALS_I15031_PID85Ah" 197 "SIGNALS_I15031_PID86Ah" 198 "SIGNALS_I15031_PID87Ah" 199 "SIGNALS_I15031_PID89Ah" 200 "SIGNALS_I15031_PID8AAh" 201 "SIGNALS_I15031_PID8FAh" 202 "SIGNALS_I15031_PID92Ah" 203 "SIGNALS_I15031_PID93Ah" 204 "SIGNALS_I15031_PID94Ah" 205 "SIGNALS_I15031_PID98Ah" 206 "SIGNALS_I15031_PID99Ah" 207 "SIGNALS_I15031_PID9CAh" 208 "SIGNALS_I15031_PIDA3Ah" 209 "SIGNALS_I15031_PIDA4Ah" 210 "SIGNALS_I15031_PIDA5Ah" 211 "SIGNALS_I15031_PIDA9Ah" 212 "SIGNALS_I15031_PIDACAh" 213 "SIGNALS_IKCtl_agKnkAvrg_s8_signal" 214 "SIGNALS_InjSys_volFuConsDrvCycCAN_s" 215 "SIGNALS_IntkAirT_tSnsr2_signal" 216 "SIGNALS_IntkAirT_uSnsr1Exprt_signal" 217 "SIGNALS_IntkAirT_uSnsr3CrssSwtLoc_s" 218 "SIGNALS_MoF_rTrqInrAct_s" 219 "SIGNALS_MoF_rTrqPtdFlt_s" 220 "SIGNALS_OBD_ITID_InjSys_volFuConsDrvgCycTstrSrv" 221 "SIGNALS_OilSwmpT_uSnsrRaw_s" 222 "SIGNALS_Oil_pSensPSwmp_signal" 223 "SIGNALS_Oil_uRawPSwmp_signal" 224 "SIGNALS_PID01h" 225 "SIGNALS_PID03h_0" 226 "SIGNALS_PID03h_1" 227 "SIGNALS_PID04h" 228 "SIGNALS_PID05h" 229 "SIGNALS_PID06h_0" 230 "SIGNALS_PID07h_0" 231 "SIGNALS_PID0Ch_Epm_nEng" 232 "SIGNALS_PID0D_VehV_vSens" 233 "SIGNALS_PID0Eh" 234 "SIGNALS_PID0Fh" 235 "SIGNALS_PID0bh_PIntkVUs_pRawObd" 236 "SIGNALS_PID10h" 237 "SIGNALS_PID11h_ThrVlv_ratActSens1AbsltB1_u8" 238 "SIGNALS_PID13h" 239 "SIGNALS_PID15h_0" 240 "SIGNALS_PID15h_1" 241 "SIGNALS_PID1Ch" 242 "SIGNALS_PID1Fh_TiScneEngStrt" 243 "SIGNALS_PID21h" 244 "SIGNALS_PID23h" 245 "SIGNALS_PID2Ch_EGRVlv_rCmdNrm" 246 "SIGNALS_PID2Dh_EGRVlv_rGovDvtNrm" 247 "SIGNALS_PID2Eh" 248 "SIGNALS_PID2Fh" 249 "SIGNALS_PID30h" 250 "SIGNALS_PID31h" 251 "SIGNALS_PID33h_PEnv_pRaw" 252 "SIGNALS_PID34h_0" 253 "SIGNALS_PID34h_1" 254 "SIGNALS_PID3Ch" 255 "SIGNALS_PID41h" 256 "SIGNALS_PID42_BattU_uSens" 257 "SIGNALS_PID43h" 258 "SIGNALS_PID44h" 259 "SIGNALS_PID45h_ThrVlv_ratActSens1RelB1_u8" 260 "SIGNALS_PID46h" 261 "SIGNALS_PID47h_ThrVlv_ratActSens2AbsltB1_u8" 262 "SIGNALS_PID49_APP_uRaw1unLim" 263 "SIGNALS_PID4A_APP_uRaw2unLim" 264 "SIGNALS_PID4Ch_wdks_msg" 265 "SIGNALS_PID4FAh" 266 "SIGNALS_PID4FBh" 267 "SIGNALS_PID4FCh" 268 "SIGNALS_PID4FDh" 269 "SIGNALS_PID50Ah" 270 "SIGNALS_PID50Bh" 271 "SIGNALS_PID50Ch" 272 "SIGNALS_PID50Dh" 273 "SIGNALS_PID51h_PID51_stFuTyp" 274 "SIGNALS_PID52h" 275 "SIGNALS_PID56h_0" 276 "SIGNALS_PID5A_APP_rOBDPID5A" 277 "SIGNALS_PID5Eh_InjSys_volEngFuCnsPerHr" 278 "SIGNALS_PID5Fh" 279 "SIGNALS_PID62h_TME_ratActEngPercTqPrmIdH62" 280 "SIGNALS_IntFloat_PID63h_TqEngRef" 281 "SIGNALS_PID67h_ects2sva_msg" 282 "SIGNALS_PID67h_ects2svb_msg" 283 "SIGNALS_PID67h_ects2svc_msg" 284 "SIGNALS_PID68h_iats2sva" 285 "SIGNALS_PID68h_iats2svb" 286 "SIGNALS_PID68h_iats2svc" 287 "SIGNALS_PID68h_iats2svd" 288 "SIGNALS_PID68h_iats2sve" 289 "SIGNALS_PID68h_iats2svf" 290 "SIGNALS_PID68h_iats2svg" 291 "SIGNALS_PID69h_EGRVlv_rActNrm" 292 "SIGNALS_PID69h_EGRVlv_rCmdNrm" 293 "SIGNALS_PID69h_EGRVlv_rGovDvtNrm" 294 "SIGNALS_PID7Fh_RTId_TotRt" 295 "SIGNALS_PID7Fh_RtId_TotIdleRt" 296 "SIGNALS_PID7Fh_RtId_TotPtoRt" 297 "SIGNALS_PID87h_PIntkVUs_pRawObd" 298 "SIGNALS_PID8BAh" 299 "SIGNALS_PID8CAh" 300 "SIGNALS_PID8Eh_TME_ratEngFricPercTqPrmIdH8E" 301 "SIGNALS_PID93BCh" 302 "SIGNALS_PID9AAh" 303 "SIGNALS_PID9Dh_InjSys_mfEngFuRate" 304 "SIGNALS_PID9Dh_InjSys_mfVehFuRate" 305 "SIGNALS_PID9FAh" 306 "SIGNALS_PIDA6h_lTotDst" 307 "SIGNALS_PID_FILLSIG_1BIT" 308 "SIGNALS_PID_FILLSIG_1BITNZ" 309 "SIGNALS_PID_FILLSIG_1BYTE" 310 "SIGNALS_PID_FILLSIG_1BYTENZ" 311 "SIGNALS_PID_FILLSIG_2BIT" 312 "SIGNALS_PID_FILLSIG_2BITNZ" 313 "SIGNALS_PID_FILLSIG_2BYTE" 314 "SIGNALS_PID_FILLSIG_2BYTENZ" 315 "SIGNALS_PID_FILLSIG_3BIT" 316 "SIGNALS_PID_FILLSIG_3BITNZ" 317 "SIGNALS_PID_FILLSIG_4BIT" 318 "SIGNALS_PID_FILLSIG_4BITNZ" 319 "SIGNALS_PID_FILLSIG_4BYTE" 320 "SIGNALS_PID_FILLSIG_4BYTENZ" 321 "SIGNALS_PID_FILLSIG_5BIT" 322 "SIGNALS_PID_FILLSIG_5BITNZ" 323 "SIGNALS_PID_FILLSIG_6BIT" 324 "SIGNALS_PID_FILLSIG_6BITNZ" 325 "SIGNALS_PID_FILLSIG_7BIT" 326 "SIGNALS_PID_FILLSIG_7BITNZ" 327 "SIGNALS_PIntkVUs_uRawUnFlt_signal" 328 "SIGNALS_PT_rGrip_signal" 329 "SIGNALS_PT_trqLos_signal" 330 "SIGNALS_PThrVlvUs_uRawB1_signal" 331 "SIGNALS_PthLead_trqInrNoMon_s" 332 "SIGNALS_PthLead_trqInrNoMon_signal" 333 "SIGNALS_PthSet_trqInrIABef_s" 334 "SIGNALS_PthSet_trqInrLtd_s" 335 "SIGNALS_RngMod_trqDiffAdap_signal" 336 "SIGNALS_RngMod_trqDiffAdap_signal_s" 337 "SIGNALS_RngMod_trqInrBs_s" 338 "SIGNALS_SIGNAL_GEVlv_agSumSpCsersDeIntkB1" 339 "SIGNALS_Strt_uStrtMonDia_signal" 340 "SIGNALS_TWCD_numMeasB1_s" 341 "SIGNALS_TWCD_rOSCAvrgPriB1_s" 342 "SIGNALS_TWCD_rOSCAvrgPriB1_signal" 343 "SIGNALS_ThrVlv_uRawSens1B1_signal" 344 "SIGNALS_ThrVlv_uRawSens2B1_signal" 345 "SIGNALS_TiEngOff_ti_s" 346 "SIGNALS_VehStc_lDstCityEco_signal" 347 "SIGNALS_VehStc_lDstCity_signal" 348 "SIGNALS_VehStc_lDstHighWayEco_signal" 349 "SIGNALS_VehStc_lDstHighWay_signal" 350 "SIGNALS_VehStc_numFuDiagRecA_0_s" 351 "SIGNALS_VehStc_numFuDiagRecA_10_s" 352 "SIGNALS_VehStc_numFuDiagRecA_11_s" 353 "SIGNALS_VehStc_numFuDiagRecA_12_s" 354 "SIGNALS_VehStc_numFuDiagRecA_13_s" 355 "SIGNALS_VehStc_numFuDiagRecA_14_s" 356 "SIGNALS_VehStc_numFuDiagRecA_15_s" 357 "SIGNALS_VehStc_numFuDiagRecA_16_s" 358 "SIGNALS_VehStc_numFuDiagRecA_17_s" 359 "SIGNALS_VehStc_numFuDiagRecA_18_s" 360 "SIGNALS_VehStc_numFuDiagRecA_19_s" 361 "SIGNALS_VehStc_numFuDiagRecA_1_s" 362 "SIGNALS_VehStc_numFuDiagRecA_20_s" 363 "SIGNALS_VehStc_numFuDiagRecA_2_s" 364 "SIGNALS_VehStc_numFuDiagRecA_3_s" 365 "SIGNALS_VehStc_numFuDiagRecA_4_s" 366 "SIGNALS_VehStc_numFuDiagRecA_5_s" 367 "SIGNALS_VehStc_numFuDiagRecA_6_s" 368 "SIGNALS_VehStc_numFuDiagRecA_7_s" 369 "SIGNALS_VehStc_numFuDiagRecA_8_s" 370 "SIGNALS_VehStc_numFuDiagRecA_9_s" 371 "SIGNALS_VehStc_numMisfDetnHiEctA_0_s" 372 "SIGNALS_VehStc_numMisfDetnHiEctA_10_s" 373 "SIGNALS_VehStc_numMisfDetnHiEctA_11_s" 374 "SIGNALS_VehStc_numMisfDetnHiEctA_12_s" 375 "SIGNALS_VehStc_numMisfDetnHiEctA_13_s" 376 "SIGNALS_VehStc_numMisfDetnHiEctA_14_s" 377 "SIGNALS_VehStc_numMisfDetnHiEctA_15_s" 378 "SIGNALS_VehStc_numMisfDetnHiEctA_16_s" 379 "SIGNALS_VehStc_numMisfDetnHiEctA_17_s" 380 "SIGNALS_VehStc_numMisfDetnHiEctA_18_s" 381 "SIGNALS_VehStc_numMisfDetnHiEctA_19_s" 382 "SIGNALS_VehStc_numMisfDetnHiEctA_1_s" 383 "SIGNALS_VehStc_numMisfDetnHiEctA_20_s" 384 "SIGNALS_VehStc_numMisfDetnHiEctA_2_s" 385 "SIGNALS_VehStc_numMisfDetnHiEctA_3_s" 386 "SIGNALS_VehStc_numMisfDetnHiEctA_4_s" 387 "SIGNALS_VehStc_numMisfDetnHiEctA_5_s" 388 "SIGNALS_VehStc_numMisfDetnHiEctA_6_s" 389 "SIGNALS_VehStc_numMisfDetnHiEctA_7_s" 390 "SIGNALS_VehStc_numMisfDetnHiEctA_8_s" 391 "SIGNALS_VehStc_numMisfDetnHiEctA_9_s" 392 "SIGNALS_VehStc_numMisfDetnLoEctA_0_s" 393 "SIGNALS_VehStc_numMisfDetnLoEctA_10_s" 394 "SIGNALS_VehStc_numMisfDetnLoEctA_11_s" 395 "SIGNALS_VehStc_numMisfDetnLoEctA_12_s" 396 "SIGNALS_VehStc_numMisfDetnLoEctA_13_s" 397 "SIGNALS_VehStc_numMisfDetnLoEctA_14_s" 398 "SIGNALS_VehStc_numMisfDetnLoEctA_15_s" 399 "SIGNALS_VehStc_numMisfDetnLoEctA_16_s" 400 "SIGNALS_VehStc_numMisfDetnLoEctA_17_s" 401 "SIGNALS_VehStc_numMisfDetnLoEctA_18_s" 402 "SIGNALS_VehStc_numMisfDetnLoEctA_19_s" 403 "SIGNALS_VehStc_numMisfDetnLoEctA_1_s" 404 "SIGNALS_VehStc_numMisfDetnLoEctA_20_s" 405 "SIGNALS_VehStc_numMisfDetnLoEctA_2_s" 406 "SIGNALS_VehStc_numMisfDetnLoEctA_3_s" 407 "SIGNALS_VehStc_numMisfDetnLoEctA_4_s" 408 "SIGNALS_VehStc_numMisfDetnLoEctA_5_s" 409 "SIGNALS_VehStc_numMisfDetnLoEctA_6_s" 410 "SIGNALS_VehStc_numMisfDetnLoEctA_7_s" 411 "SIGNALS_VehStc_numMisfDetnLoEctA_8_s" 412 "SIGNALS_VehStc_numMisfDetnLoEctA_9_s" 413 "SIGNALS_VehStc_numMisfDetnNormA_0_s" 414 "SIGNALS_VehStc_numMisfDetnNormA_10_s" 415 "SIGNALS_VehStc_numMisfDetnNormA_11_s" 416 "SIGNALS_VehStc_numMisfDetnNormA_12_s" 417 "SIGNALS_VehStc_numMisfDetnNormA_13_s" 418 "SIGNALS_VehStc_numMisfDetnNormA_14_s" 419 "SIGNALS_VehStc_numMisfDetnNormA_15_s" 420 "SIGNALS_VehStc_numMisfDetnNormA_16_s" 421 "SIGNALS_VehStc_numMisfDetnNormA_17_s" 422 "SIGNALS_VehStc_numMisfDetnNormA_18_s" 423 "SIGNALS_VehStc_numMisfDetnNormA_19_s" 424 "SIGNALS_VehStc_numMisfDetnNormA_1_s" 425 "SIGNALS_VehStc_numMisfDetnNormA_20_s" 426 "SIGNALS_VehStc_numMisfDetnNormA_2_s" 427 "SIGNALS_VehStc_numMisfDetnNormA_3_s" 428 "SIGNALS_VehStc_numMisfDetnNormA_4_s" 429 "SIGNALS_VehStc_numMisfDetnNormA_5_s" 430 "SIGNALS_VehStc_numMisfDetnNormA_6_s" 431 "SIGNALS_VehStc_numMisfDetnNormA_7_s" 432 "SIGNALS_VehStc_numMisfDetnNormA_8_s" 433 "SIGNALS_VehStc_numMisfDetnNormA_9_s" 434 "SIGNALS_VehStc_rDiagRsltB1A_0_s" 435 "SIGNALS_VehStc_rDiagRsltB1A_1_s" 436 "SIGNALS_VehStc_rDiagRsltB1A_2_s" 437 "SIGNALS_VehStc_rDiagRsltB1A_3_s" 438 "SIGNALS_VehStc_rDiagRsltB1A_4_s" 439 "SIGNALS_VehStc_tiRtCityEco_signal" 440 "SIGNALS_VehStc_tiRtCity_signal" 441 "SIGNALS_VehStc_tiRtHighWayEco_signal" 442 "SIGNALS_VehStc_tiRtHighWay_signal" 443 "SIGNALS_VehStc_tiRtStop_signal" 444 "SIGNALS_VehStc_volCnsCityDcyc_signal" 445 "SIGNALS_VehStc_volCnsCityEcoDcyc_signal" 446 "SIGNALS_VehStc_volCnsHighWayDcyc_signal" 447 "SIGNALS_VehStc_volCnsHighWayEcoDcyc_signal" 448 "SIGNALS_VehStc_volCnsStopDcyc_signal" 449 "SIGNALS_VehV_a" 450 "SIGNALS_VehV_v" 451 "SIGNALS_VehV_vSens_signal" 452 "SIGNALS_fra_w_msg_signal" 453 "SIGNALS_fra_w_s" 454 "SIGNALS_ftead_w_msg_s" 455 "SIGNALS_ftead_w_si" 456 "SIGNALS_ftead_w_signal" 457 "SIGNALS_i14229_agIntkB1GEVlv_2Byte_signal" 458 "SIGNALS_i14229_agIntkB1GEVlv_signal" 459 "SIGNALS_i14229_agSpIntkB1GevCtl_2Byte_signal" 460 "SIGNALS_i14229_agSpIntkB1GevCtl_signal" 461 "SIGNALS_lutskzyl_w_0_signal" 462 "SIGNALS_lutskzyl_w_1_signal" 463 "SIGNALS_lutskzyl_w_2_signal" 464 "SIGNALS_lutskzyl_w_3_signal" 465 "SIGNALS_lutskzyl_w_msg_0_signal" 466 "SIGNALS_mshfmst_w_signal" 467 "SIGNALS_ofmsndkh1_w_msg_signal" 468 "SIGNALS_ofmsndkh2_w_msg_signal" 469 "SIGNALS_prsoll_w_msg_s" 470 "SIGNALS_tateout_w_signal" 471 "SIGNALS_tatesoll_w_msg_signal" 472 "SIGNALS_thdev_msg_signal" 473 "SIGNALS_tmst_signal" 474 "SIGNALS_wkratst_signal" 475 "SIGNALS_PID83h_A_BitCombineSignal" 476 "SIGNALS_PID9Bh_A_BitCombineSignal" 477 "SIGNALS_PIDA1h_A_BitCombineSignal" 478 "SIGNALS_PIDA7h_A_BitCombineSignal" 479 "SIGNALS_PIDA8h_A_BitCombineSignal" 480 "SIGNALS_Virtual_DcmDspUDS_2600Byte06_signal" 481 "SIGNALS_Virtual_DcmDspUDS_2610Byte00_signal" 482 "SIGNALS_Virtual_DcmDspUDS_2610Byte01_signal" 483 "SIGNALS_Virtual_DcmDspUDS_2610Byte02_signal" 484 "SIGNALS_Virtual_DcmDspUDS_2610Byte03_signal" 485 "SIGNALS_Virtual_DcmDspUDS_2610Byte04_signal" 486 "SIGNALS_Virtual_DcmDspUDS_2610Byte05_signal" 487 "SIGNALS_Virtual_DcmDspUDS_2610Byte0D_signal" 488 "SIGNALS_Virtual_DcmDspUDS_2610Byte0F_signal" 489 "SIGNALS_Virtual_DcmDspUDS_2610Byte10_signal" 490 "SIGNALS_Virtual_DcmDspUDS_2610Byte1A_signal" 491 "SIGNALS_Virtual_DcmDspUDS_2610Byte1B_signal" 492 "SIGNALS_Virtual_DcmDspUDS_2610Byte1C_signal" 493 "SIGNALS_Virtual_DcmDspUDS_2610Byte1D_signal" 494 "SIGNALS_Virtual_DcmDspUDS_2610Byte1F_signal" 495 "SIGNALS_Virtual_DcmDspUDS_2610Byte20_signal" 496 "SIGNALS_Virtual_DcmDspUDS_2610Byte21_signal" 497 "SIGNALS_Virtual_DcmDspUDS_2610Byte22to23_signal" 498 "SIGNALS_Virtual_DcmDspUDS_2610Byte29_signal" 499 "SIGNALS_Virtual_DcmDspUDS_2610Byte2A_signal" 500 "SIGNALS_Virtual_DcmDspUDS_2611Byte00_signal" 501 "SIGNALS_Virtual_DcmDspUDS_2611Byte01_signal" 502 "SIGNALS_Virtual_DcmDspUDS_2611Byte02_signal" 503 "SIGNALS_Virtual_DcmDspUDS_2611Byte03_signal" 504 "SIGNALS_Virtual_DcmDspUDS_2611Byte04_signal" 505 "SIGNALS_Virtual_DcmDspUDS_2611Byte05_signal" 506 "SIGNALS_Virtual_DcmDspUDS_2611Byte06_07_signal" 507 "SIGNALS_Virtual_DcmDspUDS_2611Byte08to09_signal" 508 "SIGNALS_Virtual_DcmDspUDS_2611Byte0A_signal" 509 "SIGNALS_Virtual_DcmDspUDS_2611Byte0B_signal" 510 "SIGNALS_Virtual_DcmDspUDS_2611Byte0Cto0D_signal" 511 "SIGNALS_Virtual_DcmDspUDS_2611Byte0E_signal" 512 "SIGNALS_Virtual_DcmDspUDS_2611Byte2A_signal" 513 "SIGNALS_Virtual_DcmDspUDS_2611Byte2B_signal" 514 "SIGNALS_Virtual_DcmDspUDS_2611Byte30_signal" 515 "SIGNALS_Virtual_DcmDspUDS_2611Byte31_signal" 516 "SIGNALS_Virtual_DcmDspUDS_2611Byte32_signal" 517 "SIGNALS_Virtual_DcmDspUDS_2611Byte33_signal" 518 "SIGNALS_Virtual_DcmDspUDS_2612Byte00_signal" 519 "SIGNALS_Virtual_DcmDspUDS_2612Byte01_signal" 520 "SIGNALS_Virtual_DcmDspUDS_2612Byte02_signal" 521 "SIGNALS_Virtual_DcmDspUDS_2612Byte03_signal" 522 "SIGNALS_Virtual_DcmDspUDS_2612Byte04_signal" 523 "SIGNALS_Virtual_DcmDspUDS_2612Byte05_signal" 524 "SIGNALS_Virtual_DcmDspUDS_2612Byte0B_0C_signal" 525 "SIGNALS_Virtual_DcmDspUDS_2612Byte14_signal" 526 "SIGNALS_Virtual_DcmDspUDS_2612Byte15_signal" 527 "SIGNALS_Virtual_DcmDspUDS_2612Byte16_signal" 528 "SIGNALS_Virtual_DcmDspUDS_2612Byte17_signal" 529 "SIGNALS_Virtual_DcmDspUDS_2612Byte1F_signal" 530 "SIGNALS_Virtual_DcmDspUDS_2612Byte20_signal" 531 "SIGNALS_Virtual_DcmDspUDS_2612Byte2A_signal" 532 "SIGNALS_Virtual_DcmDspUDS_2612Byte2B_signal" 533 "SIGNALS_Virtual_DcmDspUDS_2613Byte00_signal" 534 "SIGNALS_Virtual_DcmDspUDS_2613Byte01_signal" 535 "SIGNALS_Virtual_DcmDspUDS_2613Byte02_signal" 536 "SIGNALS_Virtual_DcmDspUDS_2613Byte03_signal" 537 "SIGNALS_Virtual_DcmDspUDS_2613Byte04_signal" 538 "SIGNALS_Virtual_DcmDspUDS_2613Byte05_signal" 539 "SIGNALS_Virtual_DcmDspUDS_2613Byte08_signal" 540 "SIGNALS_Virtual_DcmDspUDS_2613Byte09_signal" 541 "SIGNALS_Virtual_DcmDspUDS_2615Byte00_signal" 542 "SIGNALS_Virtual_DcmDspUDS_2615Byte01_signal" 543 "SIGNALS_Virtual_DcmDspUDS_2615Byte02_signal" 544 "SIGNALS_Virtual_DcmDspUDS_2615Byte03_signal" 545 "SIGNALS_Virtual_DcmDspUDS_2615Byte04_signal" 546 "SIGNALS_Virtual_DcmDspUDS_2615Byte05_signal" 547 "SIGNALS_Virtual_DcmDspUDS_2615Byte10_signal" 548 "SIGNALS_Virtual_DcmDspUDS_2615Byte26_signal" 549 "SIGNALS_Virtual_DcmDspUDS_2615Byte27_signal" 550 "SIGNALS_Virtual_DcmDspUDS_2617Byte00_signal" 551 "SIGNALS_Virtual_DcmDspUDS_2617Byte01_signal" 552 "SIGNALS_Virtual_DcmDspUDS_2617Byte02_signal" 553 "SIGNALS_Virtual_DcmDspUDS_2617Byte03_signal" 554 "SIGNALS_Virtual_DcmDspUDS_2617Byte04_signal" 555 "SIGNALS_Virtual_DcmDspUDS_2617Byte05_signal" 556 "SIGNALS_Virtual_DcmDspUDS_261AByte00_signal" 557 "SIGNALS_Virtual_DcmDspUDS_261AByte01_signal" 558 "SIGNALS_Virtual_DcmDspUDS_261AByte02_signal" 559 "SIGNALS_Virtual_DcmDspUDS_261AByte03_signal" 560 "SIGNALS_Virtual_DcmDspUDS_261AByte04_signal" 561 "SIGNALS_Virtual_DcmDspUDS_261AByte05_signal" 562 "SIGNALS_Virtual_DcmDspUDS_261AByte07_signal" 563 "SIGNALS_Virtual_DcmDspUDS_261AByte0A_signal" 564 "SIGNALS_Virtual_DcmDspUDS_261AByte0B_signal" 565 "SIGNALS_Virtual_DcmDspUDS_261AByte0C_signal" 566 "SIGNALS_Virtual_DcmDspUDS_261AByte0D_signal" 567 "SIGNALS_Virtual_DcmDspUDS_261AByte0E_signal" 568 "SIGNALS_Virtual_DcmDspUDS_2620Byte00_signal" 569 "SIGNALS_Virtual_DcmDspUDS_2620Byte01_signal" 570 "SIGNALS_Virtual_DcmDspUDS_2620Byte02_signal" 571 "SIGNALS_Virtual_DcmDspUDS_2620Byte03_signal" 572 "SIGNALS_Virtual_DcmDspUDS_2620Byte04_signal" 573 "SIGNALS_Virtual_DcmDspUDS_2620Byte05_signal" 574 "SIGNALS_Virtual_DcmDspUDS_2621Byte00_signal" 575 "SIGNALS_Virtual_DcmDspUDS_2621Byte01_signal" 576 "SIGNALS_Virtual_DcmDspUDS_2621Byte02_signal" 577 "SIGNALS_Virtual_DcmDspUDS_2621Byte03_signal" 578 "SIGNALS_Virtual_DcmDspUDS_2621Byte04_signal" 579 "SIGNALS_Virtual_DcmDspUDS_2621Byte05_signal" 580 "SIGNALS_Virtual_DcmDspUDS_2622Byte00_signal" 581 "SIGNALS_Virtual_DcmDspUDS_2622Byte01_signal" 582 "SIGNALS_Virtual_DcmDspUDS_2622Byte02_signal" 583 "SIGNALS_Virtual_DcmDspUDS_2622Byte03_signal" 584 "SIGNALS_Virtual_DcmDspUDS_2622Byte04_signal" 585 "SIGNALS_Virtual_DcmDspUDS_2622Byte05_signal" 586 "SIGNALS_Virtual_DcmDspUDS_2623Byte00_signal" 587 "SIGNALS_Virtual_DcmDspUDS_2623Byte01_signal" 588 "SIGNALS_Virtual_DcmDspUDS_2623Byte02_signal" 589 "SIGNALS_Virtual_DcmDspUDS_2623Byte03_signal" 590 "SIGNALS_Virtual_DcmDspUDS_2623Byte04_signal" 591 "SIGNALS_Virtual_DcmDspUDS_2623Byte05_signal" 592 "SIGNALS_Virtual_DcmDspUDS_2625Byte00_signal" 593 "SIGNALS_Virtual_DcmDspUDS_2625Byte01_signal" 594 "SIGNALS_Virtual_DcmDspUDS_2625Byte02_signal" 595 "SIGNALS_Virtual_DcmDspUDS_2625Byte03_signal" 596 "SIGNALS_Virtual_DcmDspUDS_2625Byte04_signal" 597 "SIGNALS_Virtual_DcmDspUDS_2625Byte05_signal" 598 "SIGNALS_Virtual_DcmDspUDS_2627Byte00_signal" 599 "SIGNALS_Virtual_DcmDspUDS_2627Byte01_signal" 600 "SIGNALS_Virtual_DcmDspUDS_2627Byte02_signal" 601 "SIGNALS_Virtual_DcmDspUDS_2627Byte03_signal" 602 "SIGNALS_Virtual_DcmDspUDS_2627Byte04_signal" 603 "SIGNALS_Virtual_DcmDspUDS_2627Byte05_signal" 604 "SIGNALS_Virtual_DcmDspUDS_262AByte00_signal" 605 "SIGNALS_Virtual_DcmDspUDS_262AByte01_signal" 606 "SIGNALS_Virtual_DcmDspUDS_262AByte02_signal" 607 "SIGNALS_Virtual_DcmDspUDS_262AByte03_signal" 608 "SIGNALS_Virtual_DcmDspUDS_262AByte04_signal" 609 "SIGNALS_Virtual_DcmDspUDS_262AByte05_signal" 610 "SIGNALS_Virtual_DcmDspUDS_2660Byte0_signal" 611 "SIGNALS_Virtual_DcmDspUDS_2660Byte11to12_signal" 612 "SIGNALS_Virtual_DcmDspUDS_2660Byte13to14_signal" 613 "SIGNALS_Virtual_DcmDspUDS_2660Byte15_signal" 614 "SIGNALS_Virtual_DcmDspUDS_2660Byte16_signal" 615 "SIGNALS_Virtual_DcmDspUDS_2660Byte17_signal" 616 "SIGNALS_Virtual_DcmDspUDS_2660Byte18_signal" 617 "SIGNALS_Virtual_DcmDspUDS_2660Byte19_signal" 618 "SIGNALS_Virtual_DcmDspUDS_2660Byte1A_signal" 619 "SIGNALS_Virtual_DcmDspUDS_2660Byte1B_signal" 620 "SIGNALS_Virtual_DcmDspUDS_2660Byte1C_signal" 621 "SIGNALS_Virtual_DcmDspUDS_2660Byte1D_signal" 622 "SIGNALS_Virtual_DcmDspUDS_2660Byte1E_signal" 623 "SIGNALS_Virtual_DcmDspUDS_2660Byte1_signal" 624 "SIGNALS_Virtual_DcmDspUDS_2660Byte26to27_signal" 625 "SIGNALS_Virtual_DcmDspUDS_2660Byte2A_signal" 626 "SIGNALS_Virtual_DcmDspUDS_2660Byte2Eto2F_signal" 627 "SIGNALS_Virtual_DcmDspUDS_2660Byte2_signal" 628 "SIGNALS_Virtual_DcmDspUDS_2660Byte3_signal" 629 "SIGNALS_Virtual_DcmDspUDS_2660Byte4_signal" 630 "SIGNALS_Virtual_DcmDspUDS_2660Byte5_signal" 631 "SIGNALS_Virtual_DcmDspUDS_2660Byte6_signal" 632 "SIGNALS_Virtual_DcmDspUDS_2661Byte0A_signal" 633 "SIGNALS_Virtual_DcmDspUDS_2661Byte0B_signal" 634 "SIGNALS_Virtual_DcmDspUDS_2661Byte0C_signal" 635 "SIGNALS_Virtual_DcmDspUDS_2661Byte0D_signal" 636 "SIGNALS_Virtual_DcmDspUDS_2661Byte0E_signal" 637 "SIGNALS_Virtual_DcmDspUDS_2661Byte0F_signal" 638 "SIGNALS_Virtual_DcmDspUDS_2661Byte0_signal" 639 "SIGNALS_Virtual_DcmDspUDS_2661Byte1_signal" 640 "SIGNALS_Virtual_DcmDspUDS_2661Byte2D_signal" 641 "SIGNALS_Virtual_DcmDspUDS_2661Byte2E_signal" 642 "SIGNALS_Virtual_DcmDspUDS_2661Byte2F_signal" 643 "SIGNALS_Virtual_DcmDspUDS_2661Byte2_signal" 644 "SIGNALS_Virtual_DcmDspUDS_2661Byte30_signal" 645 "SIGNALS_Virtual_DcmDspUDS_2661Byte31_signal" 646 "SIGNALS_Virtual_DcmDspUDS_2661Byte32_signal" 647 "SIGNALS_Virtual_DcmDspUDS_2661Byte3_signal" 648 "SIGNALS_Virtual_DcmDspUDS_2661Byte4_signal" 649 "SIGNALS_Virtual_DcmDspUDS_2661Byte5_signal" 650 "SIGNALS_Virtual_DcmDspUDS_2661Byte6_signal" 651 "SIGNALS_Virtual_DcmDspUDS_2661Byte7_signal" 652 "SIGNALS_Virtual_DcmDspUDS_2661Byte8_signal" 653 "SIGNALS_Virtual_DcmDspUDS_2661Byte9_signal" 654 "SIGNALS_Virtual_DcmDspUDS_2662Byte0Cto0D_signal" 655 "SIGNALS_Virtual_DcmDspUDS_2662Byte0_signal" 656 "SIGNALS_Virtual_DcmDspUDS_2662Byte18_signal" 657 "SIGNALS_Virtual_DcmDspUDS_2662Byte19_signal" 658 "SIGNALS_Virtual_DcmDspUDS_2662Byte1_signal" 659 "SIGNALS_Virtual_DcmDspUDS_2662Byte2_signal" 660 "SIGNALS_Virtual_DcmDspUDS_2662Byte3_signal" 661 "SIGNALS_Virtual_DcmDspUDS_2662Byte4_signal" 662 "SIGNALS_Virtual_DcmDspUDS_2662Byte5_signal" 663 "SIGNALS_Virtual_DcmDspUDS_2663Byte0_signal" 664 "SIGNALS_Virtual_DcmDspUDS_2663Byte14Byte15_signal" 665 "SIGNALS_Virtual_DcmDspUDS_2663Byte16Byte17_signal" 666 "SIGNALS_Virtual_DcmDspUDS_2663Byte18Byte19_signal" 667 "SIGNALS_Virtual_DcmDspUDS_2663Byte1AByte1B_signal" 668 "SIGNALS_Virtual_DcmDspUDS_2663Byte1_signal" 669 "SIGNALS_Virtual_DcmDspUDS_2663Byte2_signal" 670 "SIGNALS_Virtual_DcmDspUDS_2663Byte3_signal" 671 "SIGNALS_Virtual_DcmDspUDS_2663Byte4_signal" 672 "SIGNALS_Virtual_DcmDspUDS_2663Byte5_signal" 673 "SIGNALS_Virtual_DcmDspUDS_2664Byte0_signal" 674 "SIGNALS_Virtual_DcmDspUDS_2664Byte1_signal" 675 "SIGNALS_Virtual_DcmDspUDS_2664Byte25_signal" 676 "SIGNALS_Virtual_DcmDspUDS_2664Byte26_signal" 677 "SIGNALS_Virtual_DcmDspUDS_2664Byte2_signal" 678 "SIGNALS_Virtual_DcmDspUDS_2664Byte3_signal" 679 "SIGNALS_Virtual_DcmDspUDS_2664Byte4_signal" 680 "SIGNALS_Virtual_DcmDspUDS_2664Byte5_signal" 681 "SIGNALS_Virtual_DcmDspUDS_2664Byte6_signal" 682 "SIGNALS_Virtual_DcmDspUDS_2664Byte7_signal" 683 "SIGNALS_Virtual_DcmDspUDS_2665Byte0_signal" 684 "SIGNALS_Virtual_DcmDspUDS_2665Byte1_signal" 685 "SIGNALS_Virtual_DcmDspUDS_2665Byte2_signal" 686 "SIGNALS_Virtual_DcmDspUDS_2665Byte3_signal" 687 "SIGNALS_Virtual_DcmDspUDS_2665Byte4_signal" 688 "SIGNALS_Virtual_DcmDspUDS_2665Byte5_signal" 689 "SIGNALS_Virtual_DcmDspUDS_2666Byte0_signal" 690 "SIGNALS_Virtual_DcmDspUDS_2666Byte1_signal" 691 "SIGNALS_Virtual_DcmDspUDS_2666Byte2_signal" 692 "SIGNALS_Virtual_DcmDspUDS_2666Byte3_signal" 693 "SIGNALS_Virtual_DcmDspUDS_2666Byte4_signal" 694 "SIGNALS_Virtual_DcmDspUDS_2666Byte5_signal" 695 "SIGNALS_Virtual_DcmDspUDS_2668Byte0_signal" 696 "SIGNALS_Virtual_DcmDspUDS_2668Byte1_signal" 697 "SIGNALS_Virtual_DcmDspUDS_2668Byte2_signal" 698 "SIGNALS_Virtual_DcmDspUDS_2668Byte3_signal" 699 "SIGNALS_Virtual_DcmDspUDS_2668Byte4_signal" 700 "SIGNALS_Virtual_DcmDspUDS_2668Byte5_signal" 701 "SIGNALS_Virtual_DcmDspUDS_266CByte0_signal" 702 "SIGNALS_Virtual_DcmDspUDS_266CByte1_signal" 703 "SIGNALS_Virtual_DcmDspUDS_266CByte26_signal" 704 "SIGNALS_Virtual_DcmDspUDS_266CByte27_signal" 705 "SIGNALS_Virtual_DcmDspUDS_266CByte2_signal" 706 "SIGNALS_Virtual_DcmDspUDS_266CByte3_signal" 707 "SIGNALS_Virtual_DcmDspUDS_266CByte4_signal" 708 "SIGNALS_Virtual_DcmDspUDS_266CByte5_signal" 709 "SIGNALS_Virtual_DcmDspUDS_266CByte6_signal" 710 "SIGNALS_Virtual_DcmDspUDS_266CByte7_signal" 711 "SIGNALS_Virtual_DcmDspUDS_266CByte8_signal" 712 "SIGNALS_Virtual_DcmDspUDS_266CByte9_signal" 713 "SIGNALS_Virtual_DcmDspUDS_266DByte0_signal" 714 "SIGNALS_Virtual_DcmDspUDS_266DByte1_signal" 715 "SIGNALS_Virtual_DcmDspUDS_266DByte2_signal" 716 "SIGNALS_Virtual_DcmDspUDS_266DByte3_signal" 717 "SIGNALS_Virtual_DcmDspUDS_266DByte4_signal" 718 "SIGNALS_Virtual_DcmDspUDS_266DByte5_signal" 719 "SIGNALS_Virtual_DcmDspUDS_266FByte0_signal" 720 "SIGNALS_Virtual_DcmDspUDS_266FByte1_signal" 721 "SIGNALS_Virtual_DcmDspUDS_266FByte2_signal" 722 "SIGNALS_Virtual_DcmDspUDS_266FByte3_signal" 723 "SIGNALS_Virtual_DcmDspUDS_2673Byte0A_signal" 724 "SIGNALS_Virtual_DcmDspUDS_2673Byte0B_signal" 725 "SIGNALS_Virtual_DcmDspUDS_2673Byte0_signal" 726 "SIGNALS_Virtual_DcmDspUDS_2673Byte12_signal" 727 "SIGNALS_Virtual_DcmDspUDS_2673Byte13_signal" 728 "SIGNALS_Virtual_DcmDspUDS_2673Byte16_signal" 729 "SIGNALS_Virtual_DcmDspUDS_2673Byte17_signal" 730 "SIGNALS_Virtual_DcmDspUDS_2673Byte1E_signal" 731 "SIGNALS_Virtual_DcmDspUDS_2673Byte1F_signal" 732 "SIGNALS_Virtual_DcmDspUDS_2673Byte1_signal" 733 "SIGNALS_Virtual_DcmDspUDS_2673Byte2_signal" 734 "SIGNALS_Virtual_DcmDspUDS_2673Byte3_signal" 735 "SIGNALS_Virtual_DcmDspUDS_2673Byte4_signal" 736 "SIGNALS_Virtual_DcmDspUDS_2673Byte5_signal" 737 "SIGNALS_Virtual_DcmDspUDS_2673Byte6_signal" 738 "SIGNALS_Virtual_DcmDspUDS_2673Byte7_signal" 739 "SIGNALS_Virtual_DcmDspUDS_2676Byte0_signal" 740 "SIGNALS_Virtual_DcmDspUDS_2676Byte1_signal" 741 "SIGNALS_Virtual_DcmDspUDS_2676Byte2E_signal" 742 "SIGNALS_Virtual_DcmDspUDS_2676Byte2F_signal" 743 "SIGNALS_Virtual_DcmDspUDS_2676Byte2_signal" 744 "SIGNALS_Virtual_DcmDspUDS_2676Byte3_signal" 745 "SIGNALS_Virtual_DcmDspUDS_2676Byte4_signal" 746 "SIGNALS_Virtual_DcmDspUDS_2676Byte5_signal" 747 "SIGNALS_Virtual_DcmDspUDS_2676Byte6_signal" 748 "SIGNALS_Virtual_DcmDspUDS_2676Byte7_signal" 749 "SIGNALS_Virtual_DcmDspUDS_267BByte0_signal" 750 "SIGNALS_Virtual_DcmDspUDS_267BByte1_signal" 751 "SIGNALS_Virtual_DcmDspUDS_267BByte2_signal" 752 "SIGNALS_Virtual_DcmDspUDS_267BByte3_signal" 753 "SIGNALS_Virtual_DcmDspUDS_267BByte4_signal" 754 "SIGNALS_Virtual_DcmDspUDS_267BByte5_signal" 755 "SIGNALS_Virtual_DcmDspUDS_267EByte0_signal" 756 "SIGNALS_Virtual_DcmDspUDS_267EByte1_signal" 757 "SIGNALS_Virtual_DcmDspUDS_267EByte22_signal" 758 "SIGNALS_Virtual_DcmDspUDS_267EByte2_signal" 759 "SIGNALS_Virtual_DcmDspUDS_2680Byte00_signal" 760 "SIGNALS_Virtual_DcmDspUDS_2680Byte01_signal" 761 "SIGNALS_Virtual_DcmDspUDS_2680Byte02_signal" 762 "SIGNALS_Virtual_DcmDspUDS_2680Byte03_signal" 763 "SIGNALS_Virtual_DcmDspUDS_2680Byte04_signal" 764 "SIGNALS_Virtual_DcmDspUDS_2680Byte05_signal" 765 "SIGNALS_Virtual_DcmDspUDS_2680Byte08_signal" 766 "SIGNALS_Virtual_DcmDspUDS_2680Byte09_signal" 767 "SIGNALS_Virtual_DcmDspUDS_2680Byte0E_signal" 768 "SIGNALS_Virtual_DcmDspUDS_2680Byte0F_signal" 769 "SIGNALS_Virtual_DcmDspUDS_2681Byte00_signal" 770 "SIGNALS_Virtual_DcmDspUDS_2681Byte01_signal" 771 "SIGNALS_Virtual_DcmDspUDS_2681Byte02_signal" 772 "SIGNALS_Virtual_DcmDspUDS_2681Byte03_signal" 773 "SIGNALS_Virtual_DcmDspUDS_2681Byte04_signal" 774 "SIGNALS_Virtual_DcmDspUDS_2681Byte05_signal" 775 "SIGNALS_Virtual_DcmDspUDS_2681Byte0F_signal" 776 "SIGNALS_Virtual_DcmDspUDS_2681Byte10_signal" 777 "SIGNALS_Virtual_DcmDspUDS_2681Byte13_signal" 778 "SIGNALS_Virtual_DcmDspUDS_2681Byte14_signal" 779 "SIGNALS_Virtual_DcmDspUDS_2681Byte1D_signal" 780 "SIGNALS_Virtual_DcmDspUDS_2681Byte1E_signal" 781 "SIGNALS_Virtual_DcmDspUDS_2682Byte00_signal" 782 "SIGNALS_Virtual_DcmDspUDS_2682Byte01_signal" 783 "SIGNALS_Virtual_DcmDspUDS_2682Byte02_signal" 784 "SIGNALS_Virtual_DcmDspUDS_2682Byte03_signal" 785 "SIGNALS_Virtual_DcmDspUDS_2682Byte04_signal" 786 "SIGNALS_Virtual_DcmDspUDS_2682Byte05_signal" 787 "SIGNALS_Virtual_DcmDspUDS_2682Byte06_07_signal" 788 "SIGNALS_Virtual_DcmDspUDS_2682Byte08_09_signal" 789 "SIGNALS_Virtual_DcmDspUDS_2682Byte0E_signal" 790 "SIGNALS_Virtual_DcmDspUDS_2682Byte11_12_signal" 791 "SIGNALS_Virtual_DcmDspUDS_2682Byte13_14_signal" 792 "SIGNALS_Virtual_DcmDspUDS_2682Byte15_16_signal" 793 "SIGNALS_Virtual_DcmDspUDS_2682Byte18_19_signal" 794 "SIGNALS_Virtual_DcmDspUDS_2682Byte1B_signal" 795 "SIGNALS_Virtual_DcmDspUDS_2682Byte1C_signal" 796 "SIGNALS_Virtual_DcmDspUDS_2683Byte00_signal" 797 "SIGNALS_Virtual_DcmDspUDS_2683Byte01_signal" 798 "SIGNALS_Virtual_DcmDspUDS_2683Byte02_signal" 799 "SIGNALS_Virtual_DcmDspUDS_2683Byte03_signal" 800 "SIGNALS_Virtual_DcmDspUDS_2683Byte04_signal" 801 "SIGNALS_Virtual_DcmDspUDS_2683Byte05_signal" 802 "SIGNALS_Virtual_DcmDspUDS_2684Byte00_signal" 803 "SIGNALS_Virtual_DcmDspUDS_2684Byte01_signal" 804 "SIGNALS_Virtual_DcmDspUDS_2684Byte02_signal" 805 "SIGNALS_Virtual_DcmDspUDS_2684Byte03_signal" 806 "SIGNALS_Virtual_DcmDspUDS_2684Byte04_signal" 807 "SIGNALS_Virtual_DcmDspUDS_2684Byte05_signal" 808 "SIGNALS_Virtual_DcmDspUDS_2688Byte00_signal" 809 "SIGNALS_Virtual_DcmDspUDS_2688Byte01_signal" 810 "SIGNALS_Virtual_DcmDspUDS_2688Byte02_signal" 811 "SIGNALS_Virtual_DcmDspUDS_2688Byte03_signal" 812 "SIGNALS_Virtual_DcmDspUDS_2688Byte04_signal" 813 "SIGNALS_Virtual_DcmDspUDS_2688Byte05_signal" 814 "SIGNALS_Virtual_DcmDspUDS_2689Byte00_signal" 815 "SIGNALS_Virtual_DcmDspUDS_2689Byte01_signal" 816 "SIGNALS_Virtual_DcmDspUDS_2689Byte02_signal" 817 "SIGNALS_Virtual_DcmDspUDS_2689Byte03_signal" 818 "SIGNALS_Virtual_DcmDspUDS_2689Byte04_signal" 819 "SIGNALS_Virtual_DcmDspUDS_2689Byte05_signal" 820 "SIGNALS_Virtual_DcmDspUDS_2689Byte06to09_signal" 821 "SIGNALS_Virtual_DcmDspUDS_2689Byte0Eto11_signal" 822 "SIGNALS_Virtual_DcmDspUDS_2689Byte12to15_signal" 823 "SIGNALS_Virtual_DcmDspUDS_2689Byte16to19_signal" 824 "SIGNALS_Virtual_DcmDspUDS_2689Byte1Ato1D_signal" 825 "SIGNALS_Virtual_DcmDspUDS_2689Byte1Eto21_signal" 826 "SIGNALS_Virtual_DcmDspUDS_2689Byte22to25_signal" 827 "SIGNALS_Virtual_DcmDspUDS_2689Byte26to29_signal" 828 "SIGNALS_Virtual_DcmDspUDS_2689Byte2Ato2D_signal" 829 "SIGNALS_Virtual_DcmDspUDS_2689Byte2Eto31_signal" 830 "SIGNALS_Virtual_DcmDspUDS_268BByte00_signal" 831 "SIGNALS_Virtual_DcmDspUDS_268BByte01_signal" 832 "SIGNALS_Virtual_DcmDspUDS_268BByte02_signal" 833 "SIGNALS_Virtual_DcmDspUDS_268BByte03_signal" 834 "SIGNALS_Virtual_DcmDspUDS_268BByte04_signal" 835 "SIGNALS_Virtual_DcmDspUDS_268BByte05_signal" 836 "SIGNALS_Virtual_DcmDspUDS_268BByte06_signal" 837 "SIGNALS_Virtual_DcmDspUDS_268BByte07_signal" 838 "SIGNALS_Virtual_DcmDspUDS_268BByte08_signal" 839 "SIGNALS_Virtual_DcmDspUDS_268BByte09_signal" 840 "SIGNALS_Virtual_DcmDspUDS_268BByte0A_signal" 841 "SIGNALS_Virtual_DcmDspUDS_268BByte0B_signal" 842 "SIGNALS_Virtual_DcmDspUDS_268BByte0C_signal" 843 "SIGNALS_Virtual_DcmDspUDS_268BByte0D_signal" 844 "SIGNALS_Virtual_DcmDspUDS_268CByte00_signal" 845 "SIGNALS_Virtual_DcmDspUDS_268CByte01_signal" 846 "SIGNALS_Virtual_DcmDspUDS_268CByte02_signal" 847 "SIGNALS_Virtual_DcmDspUDS_268CByte03_signal" 848 "SIGNALS_Virtual_DcmDspUDS_268CByte04_signal" 849 "SIGNALS_Virtual_DcmDspUDS_268CByte05_signal" 850 "SIGNALS_Virtual_DcmDspUDS_268CByte06_signal" 851 "SIGNALS_Virtual_DcmDspUDS_268CByte07_signal" 852 "SIGNALS_Virtual_DcmDspUDS_268CByte08_signal" 853 "SIGNALS_Virtual_DcmDspUDS_268CByte09_signal" 854 "SIGNALS_Virtual_DcmDspUDS_268CByte0A_signal" 855 "SIGNALS_Virtual_DcmDspUDS_268CByte2E_signal" 856 "SIGNALS_Virtual_DcmDspUDS_268CByte2F_signal" 857 "SIGNALS_Virtual_DcmDspUDS_268CByte30_signal" 858 "SIGNALS_Virtual_DcmDspUDS_268CByte31_signal" 859 "SIGNALS_Virtual_DcmDspUDS_268CByte32_signal" 860 "SIGNALS_Virtual_DcmDspUDS_268CByte33_signal" 861 "SIGNALS_Virtual_DcmDspUDS_268EByte00_signal" 862 "SIGNALS_Virtual_DcmDspUDS_268EByte01_signal" 863 "SIGNALS_Virtual_DcmDspUDS_268EByte02_signal" 864 "SIGNALS_Virtual_DcmDspUDS_268EByte03_signal" 865 "SIGNALS_Virtual_DcmDspUDS_268EByte04_signal" 866 "SIGNALS_Virtual_DcmDspUDS_268EByte05_signal" 867 "SIGNALS_Virtual_DcmDspUDS_268EByte08to09_signal" 868 "SIGNALS_Virtual_DcmDspUDS_268EByte0A_signal" 869 "SIGNALS_Virtual_DcmDspUDS_268EByte0B_signal" 870 "SIGNALS_Virtual_DcmDspUDS_268FByte00_signal" 871 "SIGNALS_Virtual_DcmDspUDS_268FByte01_signal" 872 "SIGNALS_Virtual_DcmDspUDS_268FByte02_signal" 873 "SIGNALS_Virtual_DcmDspUDS_268FByte03_signal" 874 "SIGNALS_Virtual_DcmDspUDS_268FByte04_signal" 875 "SIGNALS_Virtual_DcmDspUDS_268FByte05_signal" 876 "SIGNALS_Virtual_DcmDspUDS_268FByte0A_signal" 877 "SIGNALS_Virtual_DcmDspUDS_268FByte0B_signal" 878 "SIGNALS_Virtual_DcmDspUDS_268FByte16_17_signal" 879 "SIGNALS_Virtual_DcmDspUDS_268FByte18_19_signal" 880 "SIGNALS_Virtual_DcmDspUDS_268FByte1A_1B_signal" 881 "SIGNALS_Virtual_DcmDspUDS_2699Byte00_signal" 882 "SIGNALS_Virtual_DcmDspUDS_2699Byte01_signal" 883 "SIGNALS_Virtual_DcmDspUDS_2699Byte02_signal" 884 "SIGNALS_Virtual_DcmDspUDS_2699Byte03_signal" 885 "SIGNALS_Virtual_DcmDspUDS_2699Byte04_signal" 886 "SIGNALS_Virtual_DcmDspUDS_2699Byte05_signal" 887 "SIGNALS_Virtual_DcmDspUDS_2699Byte06_signal" 888 "SIGNALS_Virtual_DcmDspUDS_2699Byte07_signal" 889 "SIGNALS_Virtual_DcmDspUDS_2699Byte0B_0C_signal" 890 "SIGNALS_Virtual_DcmDspUDS_2699Byte16_signal" 891 "SIGNALS_Virtual_DcmDspUDS_2699Byte17_signal" 892 "SIGNALS_Virtual_DcmDspUDS_2699Byte26_27_signal" 893 "SIGNALS_Virtual_DcmDspUDS_2699Byte28_29_signal" 894 "SIGNALS_Virtual_DcmDspUDS_2699Byte2A_2B_signal" 895 "SIGNALS_Virtual_DcmDspUDS_2699Byte2E_signal" 896 "SIGNALS_Virtual_DcmDspUDS_2699Byte2F_30_signal" 897 "SIGNALS_Virtual_DcmDspUDS_269AByte00_signal" 898 "SIGNALS_Virtual_DcmDspUDS_269AByte01_signal" 899 "SIGNALS_Virtual_DcmDspUDS_269AByte02_signal" 900 "SIGNALS_Virtual_DcmDspUDS_269AByte03_signal" 901 "SIGNALS_Virtual_DcmDspUDS_269AByte04_signal" 902 "SIGNALS_Virtual_DcmDspUDS_269AByte05_signal" 903 "SIGNALS_Virtual_DcmDspUDS_269BByte00_signal" 904 "SIGNALS_Virtual_DcmDspUDS_269BByte01_signal" 905 "SIGNALS_Virtual_DcmDspUDS_269BByte02_signal" 906 "SIGNALS_Virtual_DcmDspUDS_269BByte03_signal" 907 "SIGNALS_Virtual_DcmDspUDS_269BByte04_signal" 908 "SIGNALS_Virtual_DcmDspUDS_269BByte05_signal" 909 "SIGNALS_Virtual_DcmDspUDS_269EByte00_signal" 910 "SIGNALS_Virtual_DcmDspUDS_269EByte01_signal" 911 "SIGNALS_Virtual_DcmDspUDS_269EByte02_signal" 912 "SIGNALS_Virtual_DcmDspUDS_269EByte03_signal" 913 "SIGNALS_Virtual_DcmDspUDS_269EByte04_signal" 914 "SIGNALS_Virtual_DcmDspUDS_269EByte05_signal" 915 "SIGNALS_Virtual_DcmDspUDS_26A0Byte00_signal" 916 "SIGNALS_Virtual_DcmDspUDS_26A0Byte01_signal" 917 "SIGNALS_Virtual_DcmDspUDS_26A0Byte02_signal" 918 "SIGNALS_Virtual_DcmDspUDS_26A0Byte03_signal" 919 "SIGNALS_Virtual_DcmDspUDS_26A0Byte04_signal" 920 "SIGNALS_Virtual_DcmDspUDS_26A0Byte05_signal" 921 "SIGNALS_Virtual_DcmDspUDS_26A0Byte06_signal" 922 "SIGNALS_Virtual_DcmDspUDS_26A0Byte07_signal" 923 "SIGNALS_Virtual_DcmDspUDS_26A0Byte08_signal" 924 "SIGNALS_Virtual_DcmDspUDS_26A0Byte09_signal" 925 "SIGNALS_Virtual_DcmDspUDS_26A0Byte0A_signal" 926 "SIGNALS_Virtual_DcmDspUDS_26A0Byte0B_signal" 927 "SIGNALS_Virtual_DcmDspUDS_26A0Byte0C_signal" 928 "SIGNALS_Virtual_DcmDspUDS_26A0Byte0D_signal" 929 "SIGNALS_Virtual_DcmDspUDS_26A0Byte0E_signal" 930 "SIGNALS_Virtual_DcmDspUDS_26A0Byte0F_signal" 931 "SIGNALS_Virtual_DcmDspUDS_26A0Byte10_signal" 932 "SIGNALS_Virtual_DcmDspUDS_26A0Byte11_signal" 933 "SIGNALS_Virtual_DcmDspUDS_26A0Byte12_signal" 934 "SIGNALS_Virtual_DcmDspUDS_26A0Byte13_signal" 935 "SIGNALS_Virtual_DcmDspUDS_26A0Byte14_signal" 936 "SIGNALS_Virtual_DcmDspUDS_26A0Byte15_signal" 937 "SIGNALS_Virtual_DcmDspUDS_26A0Byte16_signal" 938 "SIGNALS_Virtual_DcmDspUDS_26A0Byte17_signal" 939 "SIGNALS_Virtual_DcmDspUDS_26A0Byte18_signal" 940 "SIGNALS_Virtual_DcmDspUDS_26A0Byte19_signal" 941 "SIGNALS_Virtual_DcmDspUDS_26A0Byte1A_signal" 942 "SIGNALS_Virtual_DcmDspUDS_26A0Byte4E_signal" 943 "SIGNALS_Virtual_DcmDspUDS_26A0Byte52_53_signal" 944 "SIGNALS_Virtual_DcmDspUDS_26A0Byte54_55_signal" 945 "SIGNALS_Virtual_DcmDspUDS_26A0Byte56_57_signal" 946 "SIGNALS_Virtual_DcmDspUDS_26A0Byte66_signal" 947 "SIGNALS_Virtual_DcmDspUDS_26A0Byte67_signal" 948 "SIGNALS_Virtual_DcmDspUDS_26A0Byte68_signal" 949 "SIGNALS_Virtual_DcmDspUDS_26A0Byte69_signal" 950 "SIGNALS_Virtual_DcmDspUDS_26A0Byte6A_signal" 951 "SIGNALS_Virtual_DcmDspUDS_26A0Byte6B_signal" 952 "SIGNALS_Virtual_DcmDspUDS_26A0Byte6C_signal" 953 "SIGNALS_Virtual_DcmDspUDS_26A0Byte6D_signal" 954 "SIGNALS_Virtual_DcmDspUDS_26A0Byte7F_80_signal" 955 "SIGNALS_Virtual_DcmDspUDS_26A0Byte81_82_signal" 956 "SIGNALS_Virtual_DcmDspUDS_26A0Byte83_84_signal" 957 "SIGNALS_Virtual_DcmDspUDS_26A0Byte85_86_signal" 958 "SIGNALS_Virtual_DcmDspUDS_26A0Byte87_88_signal" 959 "SIGNALS_Virtual_DcmDspUDS_26A0Byte89_8A_signal" 960 "SIGNALS_Virtual_DcmDspUDS_26A0Byte8B_8C_signal" 961 "SIGNALS_Virtual_DcmDspUDS_26A0Byte8D_8E_signal" 962 "SIGNALS_Virtual_DcmDspUDS_26A0Byte8F_90_signal" 963 "SIGNALS_Virtual_DcmDspUDS_26A0Byte91_92_signal" 964 "SIGNALS_Virtual_DcmDspUDS_26A0Byte93_94_signal" 965 "SIGNALS_Virtual_DcmDspUDS_26A0Byte95_96_signal" 966 "SIGNALS_Virtual_DcmDspUDS_26A0Byte97_98_signal" 967 "SIGNALS_Virtual_DcmDspUDS_26A0Byte99_9A_signal" 968 "SIGNALS_Virtual_DcmDspUDS_26A0Byte9B_9C_signal" 969 "SIGNALS_Virtual_DcmDspUDS_26A0Byte9D_9E_signal" 970 "SIGNALS_Virtual_DcmDspUDS_26A0Byte9F_A0_signal" 971 "SIGNALS_Virtual_DcmDspUDS_26A0ByteA1_A2_signal" 972 "SIGNALS_Virtual_DcmDspUDS_26A0ByteA3_A4_signal" 973 "SIGNALS_Virtual_DcmDspUDS_26A0ByteA5_A6_signal" 974 "SIGNALS_Virtual_DcmDspUDS_26A0ByteA7_A8_signal" 975 "SIGNALS_Virtual_DcmDspUDS_26A0ByteA9_AA_signal" 976 "SIGNALS_Virtual_DcmDspUDS_26A0ByteAB_AC_signal" 977 "SIGNALS_Virtual_DcmDspUDS_26A0ByteAD_AE_signal" 978 "SIGNALS_Virtual_DcmDspUDS_26A0ByteAF_B0_signal" 979 "SIGNALS_Virtual_DcmDspUDS_26A0ByteB1_B2_signal" 980 "SIGNALS_Virtual_DcmDspUDS_26A0ByteB3_B4_signal" 981 "SIGNALS_Virtual_DcmDspUDS_26A0ByteB5_B6_signal" 982 "SIGNALS_Virtual_DcmDspUDS_26A0ByteB7_B8_signal" 983 "SIGNALS_Virtual_DcmDspUDS_26A0ByteB9_BA_signal" 984 "SIGNALS_Virtual_DcmDspUDS_26A0ByteBB_BC_signal" 985 "SIGNALS_Virtual_DcmDspUDS_26A0ByteBD_BE_signal" 986 "SIGNALS_Virtual_DcmDspUDS_26A0ByteBF_C0_signal" 987 "SIGNALS_Virtual_DcmDspUDS_26A0ByteC1_C2_signal" 988 "SIGNALS_Virtual_DcmDspUDS_26A0ByteC3_C4_signal" 989 "SIGNALS_Virtual_DcmDspUDS_26A0ByteC5_C6_signal" 990 "SIGNALS_Virtual_DcmDspUDS_26A0ByteC7_C8_signal" 991 "SIGNALS_Virtual_DcmDspUDS_26A0ByteC9_CA_signal" 992 "SIGNALS_Virtual_DcmDspUDS_26A0ByteCB_CC_signal" 993 "SIGNALS_Virtual_DcmDspUDS_26A0ByteCD_CE_signal" 994 "SIGNALS_Virtual_DcmDspUDS_26A0ByteCF_D0_signal" 995 "SIGNALS_Virtual_DcmDspUDS_26A0ByteD1_D2_signal" 996 "SIGNALS_Virtual_DcmDspUDS_26A0ByteD3_D4_signal" 997 "SIGNALS_Virtual_DcmDspUDS_26A0ByteD5_D6_signal" 998 "SIGNALS_Virtual_DcmDspUDS_26A0ByteD7_D8_signal" 999 "SIGNALS_Virtual_DcmDspUDS_26A0ByteD9_DA_signal" 1000 "SIGNALS_Virtual_DcmDspUDS_26A0ByteDB_DC_signal" 1001 "SIGNALS_Virtual_DcmDspUDS_26A0ByteDD_DE_signal" 1002 "SIGNALS_Virtual_DcmDspUDS_26A0ByteDF_E0_signal" 1003 "SIGNALS_Virtual_DcmDspUDS_26A0ByteE1_E2_signal" 1004 "SIGNALS_Virtual_DcmDspUDS_26A0ByteE3_E4_signal" 1005 "SIGNALS_Virtual_DcmDspUDS_26A0ByteE5_E6_signal" 1006 "SIGNALS_Virtual_DcmDspUDS_26A0ByteE7_E8_signal" 1007 "SIGNALS_Virtual_DcmDspUDS_26A0ByteE9_EA_signal" 1008 "SIGNALS_Virtual_DcmDspUDS_26A0ByteEB_EC_signal" 1009 "SIGNALS_Virtual_DcmDspUDS_26A0ByteED_EE_signal" 1010 "SIGNALS_Virtual_DcmDspUDS_26A0ByteEF_F0_signal" 1011 "SIGNALS_Virtual_DcmDspUDS_26A0ByteF1_F2_signal" 1012 "SIGNALS_Virtual_DcmDspUDS_26A1Byte00_signal" 1013 "SIGNALS_Virtual_DcmDspUDS_26A1Byte01_signal" 1014 "SIGNALS_Virtual_DcmDspUDS_26A1Byte02_signal" 1015 "SIGNALS_Virtual_DcmDspUDS_26A1Byte03_signal" 1016 "SIGNALS_Virtual_DcmDspUDS_26A1Byte04_signal" 1017 "SIGNALS_Virtual_DcmDspUDS_26A1Byte05_signal" 1018 "SIGNALS_Virtual_DcmDspUDS_26A1Byte06_signal" 1019 "SIGNALS_Virtual_DcmDspUDS_26A1Byte07_signal" 1020 "SIGNALS_Virtual_DcmDspUDS_26A1Byte08_signal" 1021 "SIGNALS_Virtual_DcmDspUDS_26A1Byte09_signal" 1022 "SIGNALS_Virtual_DcmDspUDS_26A1Byte0A_signal" 1023 "SIGNALS_Virtual_DcmDspUDS_26A1Byte0B_signal" 1024 "SIGNALS_Virtual_DcmDspUDS_26A1Byte0C_signal" 1025 "SIGNALS_Virtual_DcmDspUDS_26A1Byte0D_signal" 1026 "SIGNALS_Virtual_DcmDspUDS_26A1Byte0E_signal" 1027 "SIGNALS_Virtual_DcmDspUDS_26A1Byte0F_signal" 1028 "SIGNALS_Virtual_DcmDspUDS_26A1Byte10_signal" 1029 "SIGNALS_Virtual_DcmDspUDS_26A1Byte11_signal" 1030 "SIGNALS_Virtual_DcmDspUDS_26A1Byte12_signal" 1031 "SIGNALS_Virtual_DcmDspUDS_26A1Byte13_signal" 1032 "SIGNALS_Virtual_DcmDspUDS_26A1Byte14_signal" 1033 "SIGNALS_Virtual_DcmDspUDS_26A1Byte15_signal" 1034 "SIGNALS_Virtual_DcmDspUDS_26A1Byte16_signal" 1035 "SIGNALS_Virtual_DcmDspUDS_26A1Byte17_signal" 1036 "SIGNALS_Virtual_DcmDspUDS_26A1Byte18_signal" 1037 "SIGNALS_Virtual_DcmDspUDS_26A1Byte19_signal" 1038 "SIGNALS_Virtual_DcmDspUDS_26A1Byte1A_signal" 1039 "SIGNALS_Virtual_DcmDspUDS_26A1Byte1B_1C_signal" 1040 "SIGNALS_Virtual_DcmDspUDS_26A1Byte1D_1E_signal" 1041 "SIGNALS_Virtual_DcmDspUDS_26A1Byte1F_20_signal" 1042 "SIGNALS_Virtual_DcmDspUDS_26A1Byte21_22_signal" 1043 "SIGNALS_Virtual_DcmDspUDS_26A1Byte23_24_signal" 1044 "SIGNALS_Virtual_DcmDspUDS_26A1Byte25_signal" 1045 "SIGNALS_Virtual_DcmDspUDS_26A1Byte26_signal" 1046 "SIGNALS_Virtual_DcmDspUDS_26A1Byte27_signal" 1047 "SIGNALS_Virtual_DcmDspUDS_26A1Byte28_signal" 1048 "SIGNALS_Virtual_DcmDspUDS_26A1Byte29_signal" 1049 "SIGNALS_Virtual_DcmDspUDS_26A1Byte2A_signal" 1050 "SIGNALS_Virtual_DcmDspUDS_26A1Byte2B_signal" 1051 "SIGNALS_Virtual_DcmDspUDS_26A1Byte2C_signal" 1052 "SIGNALS_Virtual_DcmDspUDS_26A1Byte2D_signal" 1053 "SIGNALS_Virtual_DcmDspUDS_26A1Byte2E_signal" 1054 "SIGNALS_Virtual_DcmDspUDS_26A1Byte2F_signal" 1055 "SIGNALS_Virtual_DcmDspUDS_26A1Byte30_signal" 1056 "SIGNALS_Virtual_DcmDspUDS_26A1Byte31_signal" 1057 "SIGNALS_Virtual_DcmDspUDS_26A1Byte32_signal" 1058 "SIGNALS_Virtual_DcmDspUDS_26A1Byte33_signal" 1059 "SIGNALS_Virtual_DcmDspUDS_26A1Byte34_signal" 1060 "SIGNALS_Virtual_DcmDspUDS_26A1Byte35_signal" 1061 "SIGNALS_Virtual_DcmDspUDS_26A1Byte36_signal" 1062 "SIGNALS_Virtual_DcmDspUDS_26A1Byte37_signal" 1063 "SIGNALS_Virtual_DcmDspUDS_26A1Byte38_signal" 1064 "SIGNALS_Virtual_DcmDspUDS_26A1Byte39_signal" 1065 "SIGNALS_Virtual_DcmDspUDS_26A1Byte6F_70_signal" 1066 "SIGNALS_Virtual_DcmDspUDS_26A1Byte71_72_signal" 1067 "SIGNALS_Virtual_DcmDspUDS_26A1Byte73_74_signal" 1068 "SIGNALS_Virtual_DcmDspUDS_26A1Byte75_76_signal" 1069 "SIGNALS_Virtual_DcmDspUDS_26A1Byte77_78_signal" 1070 "SIGNALS_Virtual_DcmDspUDS_26A1Byte79_signal" 1071 "SIGNALS_Virtual_DcmDspUDS_26A1Byte7B_signal" 1072 "SIGNALS_Virtual_DcmDspUDS_26A2Byte00_signal" 1073 "SIGNALS_Virtual_DcmDspUDS_26A2Byte01_signal" 1074 "SIGNALS_Virtual_DcmDspUDS_26A2Byte02_signal" 1075 "SIGNALS_Virtual_DcmDspUDS_26A2Byte03_signal" 1076 "SIGNALS_Virtual_DcmDspUDS_26A2Byte04_signal" 1077 "SIGNALS_Virtual_DcmDspUDS_26A2Byte05_signal" 1078 "SIGNALS_Virtual_DcmDspUDS_26A2Byte12_13_signal" 1079 "SIGNALS_Virtual_DcmDspUDS_26A2Byte1C_signal" 1080 "SIGNALS_Virtual_DcmDspUDS_26A2Byte1D_signal" 1081 "SIGNALS_Virtual_DcmDspUDS_26A2Byte21_signal" 1082 "SIGNALS_Virtual_DcmDspUDS_26A2Byte22_signal" 1083 "SIGNALS_Virtual_DcmDspUDS_Acm_fzabgs_w_signal" 1084 "SIGNALS_Virtual_DcmDspUDS_DID_2613Byte2Eto2F_signal_VirtFunc_s" 1085 "SIGNALS_Virtual_DcmDspUDS_DID_261AByte08_signal" 1086 "SIGNALS_Virtual_DcmDspUDS_DID_261AByte09_signal" 1087 "SIGNALS_Virtual_DcmDspUDS_DID_E402Byte00_signal" 1088 "SIGNALS_Virtual_DcmDspUDS_DID_E402Byte01_signal" 1089 "SIGNALS_Virtual_DcmDspUDS_DID_E402Byte07to08_signal" 1090 "SIGNALS_Virtual_DcmDspUDS_DID_E402Byte10to11_signal" 1091 "SIGNALS_Virtual_DcmDspUDS_DID_E402Byte19to1A_signal" 1092 "SIGNALS_Virtual_DcmDspUDS_DID_E402Byte22to23_signal" 1093 "SIGNALS_Virtual_DcmDspUDS_DID_E402Byte2Bto2C_signal" 1094 "SIGNALS_Virtual_DcmDspUDS_DID_F110Byte0_3_signal" 1095 "SIGNALS_Virtual_DcmDspUDS_DID_F110Byte12_15_signal" 1096 "SIGNALS_Virtual_DcmDspUDS_DID_F110Byte16_signal" 1097 "SIGNALS_Virtual_DcmDspUDS_DID_F110Byte4_7_signal" 1098 "SIGNALS_Virtual_DcmDspUDS_DID_F110Byte8_11_signal" 1099 "SIGNALS_Virtual_DcmDspUDS_DID_F112Byte0_3_signal" 1100 "SIGNALS_Virtual_DcmDspUDS_DID_F112Byte12_15_signal" 1101 "SIGNALS_Virtual_DcmDspUDS_DID_F112Byte16_19_signal" 1102 "SIGNALS_Virtual_DcmDspUDS_DID_F112Byte20_23_signal" 1103 "SIGNALS_Virtual_DcmDspUDS_DID_F112Byte24_27_signal" 1104 "SIGNALS_Virtual_DcmDspUDS_DID_F112Byte28_29_signal" 1105 "SIGNALS_Virtual_DcmDspUDS_DID_F112Byte30_signal" 1106 "SIGNALS_Virtual_DcmDspUDS_DID_F112Byte4_7_signal" 1107 "SIGNALS_Virtual_DcmDspUDS_DID_F112Byte8_11_signal" 1108 "SIGNALS_Virtual_DcmDspUDS_E602Byte2_signal" 1109 "SIGNALS_Virtual_DcmDspUDS_F181Byte0_3_signal" 1110 "SIGNALS_Virtual_DcmDspUDS_F181Byte12_15_signal" 1111 "SIGNALS_Virtual_DcmDspUDS_F181Byte4_7_signal" 1112 "SIGNALS_Virtual_DcmDspUDS_F181Byte8_11_signal" 1113 "SIGNALS_Virtual_DcmDspUDS_fzabgs_w_signal" 1114 "SIGNALS_Virtual_DcmDspUDS_numReWrECUID1_signal" 1115 "SIGNALS_Virtual_DcmDspUDS_numReWrECUID2_signal" 1116 "SIGNALS_Virtual_I14229B9_0490_FrNo09_signal" 1117 "SIGNALS_Virtual_I14229B9_0490_FrNo10_signal" 1118 "SIGNALS_Virtual_I14229B9_04B1_FrNo16_signal" 1119 "SIGNALS_Virtual_I14229B9_04B1_FrNo17_signal" 1120 "SIGNALS_Virtual_I14229B9_04B1_FrNo20_signal" 1121 "SIGNALS_Virtual_I14229B9_04B1_FrNo21_signal" 1122 "SIGNALS_Virtual_I14229B9_04B1_FrNo22_signal" 1123 "SIGNALS_Virtual_I14229B9_04B1_FrNo23_signal" 1124 "SIGNALS_Virtual_I14229B9_04C2_FrNo2021_signal" 1125 "SIGNALS_Virtual_I14229B9_04D2_FrNo24_signal" 1126 "SIGNALS_Virtual_I14229B9_04D2_FrNo25_signal" 1127 "SIGNALS_Virtual_I14229B9_0520_FrNo15_signal" 1128 "SIGNALS_Virtual_I14229B9_0520_FrNo16_signal" 1129 "SIGNALS_Virtual_I14229B9_0523_FrNo42_signal" 1130 "SIGNALS_Virtual_I14229B9_0523_FrNo43_signal" 1131 "SIGNALS_Virtual_I14229B9_0524_FrNo09_signal" 1132 "SIGNALS_Virtual_I14229B9_0524_FrNo10_signal" 1133 "SIGNALS_Virtual_I14229B9_0550_FrNo09_signal" 1134 "SIGNALS_Virtual_I14229B9_0550_FrNo10_signal" 1135 "SIGNALS_Virtual_I14229B9_0553_FrNo13_signal" 1136 "SIGNALS_Virtual_I14229B9_0553_FrNo14_signal" 1137 "SIGNALS_Virtual_I14229B9_056A_FrNo8_signal" 1138 "SIGNALS_Virtual_I14229B9_056A_FrNo9_signal" 1139 "SIGNALS_Virtual_I14229B9_0588_FrNo15_signal" 1140 "SIGNALS_Virtual_I14229B9_0588_FrNo16_signal" 1141 "SIGNALS_Virtual_I14229B9_05A0_FrNo40_signal" 1142 "SIGNALS_Virtual_I14229B9_05A0_FrNo41_signal" 1143 "SIGNALS_Virtual_I14229B9_05B0_FrNo13_signal" 1144 "SIGNALS_Virtual_I14229B9_05B0_FrNo14_signal" 1145 "SIGNALS_Virtual_I14229B9_05C0_FrNo12_signal" 1146 "SIGNALS_Virtual_I14229B9_05C0_FrNo13_signal" 1147 "SIGNALS_Virtual_I14229B9_05E0_FrNo19_signal" 1148 "SIGNALS_Virtual_I14229B9_05E0_FrNo20_signal" 1149 "SIGNALS_Virtual_I14229B9_05E0_FrNo21_signal" 1150 "SIGNALS_Virtual_I14229B9_05E0_FrNo22_signal" 1151 "SIGNALS_Virtual_I14229B9_05E0_FrNo23_signal" 1152 "SIGNALS_Virtual_I14229B9_05E0_FrNo24_signal" 1153 "SIGNALS_Virtual_I14229B9_1208_FrNo34_signal" 1154 "SIGNALS_Virtual_I14229B9_1208_FrNo35_signal" 1155 "SIGNALS_Virtual_I14229B9_1208_FrNo36_signal" 1156 "SIGNALS_Virtual_I14229B9_1208_FrNo37_signal" 1157 "SIGNALS_Virtual_I14229B9_120A_FrNo09_signal" 1158 "SIGNALS_Virtual_I14229B9_120A_FrNo10_signal" 1159 "SIGNALS_Virtual_I14229B9_120B_FrNo09_signal" 1160 "SIGNALS_Virtual_I14229B9_120B_FrNo10_signal" 1161 "SIGNALS_Virtual_I14229_Com_aLgtG_signal" 1162 "SIGNALS_Virtual_I14229_pEngSrtMin_signal" 1163 "SIGNALS_Virtual_IKCtl_agAdpnCurr_s16_signal" 1164 "SIGNALS_Virtual_IKCtl_wIntgRef_au32_0__s" 1165 "SIGNALS_Virtual_PtCoornDyn_tqCluDes_signal" 1166 "SIGNALS_Virtual_PtCoornDyn_tqCluLeadTrsmIntv_signal" 1167 "SIGNALS_Virtual_Tra_numGear_signal" 1168 "SIGNALS_Virtual_i14229_agIntkB1GEVlvSig_signal" /end COMPU_VTAB
/begin COMPU_METHOD t_q0p1 "" RAT_FUNC "%6.3" "s" COEFFS 0 10 0 0 0 1 /end COMPU_METHOD
/begin COMPU_METHOD t_q1 "" RAT_FUNC "%6.2" "s" COEFFS 0 1 0 0 0 1 /end COMPU_METHOD
/begin COMPU_METHOD Vel "" RAT_FUNC "%6.4" "km/h" COEFFS 0 100 0 0 0 1 /end COMPU_METHOD
/begin COMPU_METHOD vfzg_ub_q1p25 "" RAT_FUNC "%6.2" "km/h" COEFFS 0 1 0 0 0 1.25 /end COMPU_METHOD
/begin COMPU_METHOD vfzg_uw_b512 "" RAT_FUNC "%6.4" "km/h" COEFFS 0 65536 0 0 0 512 /end COMPU_METHOD
/begin COMPU_METHOD vol_q0p1_l "" RAT_FUNC "%6.3" "l" COEFFS 0 1 0 0 0 0.1 /end COMPU_METHOD
/begin COMPU_METHOD vol_q3p90625Em3_l "" RAT_FUNC "%6.4" "l" COEFFS 0 65536 0 0 0 256 /end COMPU_METHOD
/begin COMPU_METHOD vol_q7p8125Em3_l "" RAT_FUNC "%6.4" "l" COEFFS 0 128 0 0 0 1 /end COMPU_METHOD
/begin RECORD_LAYOUT RB_Curve_U16_U16 NO_AXIS_PTS_X 1 UWORD AXIS_PTS_X 2 UWORD INDEX_INCR DIRECT FNC_VALUES 3 UWORD COLUMN_DIR DIRECT /end RECORD_LAYOUT
/begin RECORD_LAYOUT RB_ValA_Wu16 FNC_VALUES 1 UWORD COLUMN_DIR DIRECT /end RECORD_LAYOUT
/begin RECORD_LAYOUT RB_Val_Ws16 FNC_VALUES 1 SWORD COLUMN_DIR DIRECT /end RECORD_LAYOUT
/begin RECORD_LAYOUT RB_Val_Ws32 FNC_VALUES 1 SLONG COLUMN_DIR DIRECT /end RECORD_LAYOUT
/begin RECORD_LAYOUT RB_Val_Wu16 FNC_VALUES 1 UWORD COLUMN_DIR DIRECT /end RECORD_LAYOUT
/begin RECORD_LAYOUT RB_Val_Wu8 FNC_VALUES 1 UBYTE COLUMN_DIR DIRECT /end RECORD_LAYOUT
/begin RECORD_LAYOUT ValA_Wu16 FNC_VALUES 1 UWORD COLUMN_DIR DIRECT /end RECORD_LAYOUT
/begin RECORD_LAYOUT ValA_Wu8 FNC_VALUES 1 UBYTE COLUMN_DIR DIRECT /end RECORD_LAYOUT
/begin RECORD_LAYOUT Val_Wu16 FNC_VALUES 1 UWORD COLUMN_DIR DIRECT /end RECORD_LAYOUT
/begin RECORD_LAYOUT Val_Wu8 FNC_VALUES 1 UBYTE COLUMN_DIR DIRECT /end RECORD_LAYOUT
/end MODULE
/end PROJECT
