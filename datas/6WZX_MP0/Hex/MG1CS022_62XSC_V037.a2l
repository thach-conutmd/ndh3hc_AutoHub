ASAP2_VERSION 1 60
/begin PROJECT MG1CS022 "MG1CS022"
/begin HEADER "" VERSION "MG1CS022_62XSC_V037" PROJECT_NO MG1CS022 /end HEADER
/begin MODULE DIM ""
/begin MOD_COMMON "" BYTE_ORDER MSB_LAST ALIGNMENT_BYTE 1 ALIGNMENT_WORD 2 ALIGNMENT_LONG 4 ALIGNMENT_INT64 4 ALIGNMENT_FLOAT32_IEEE 4 ALIGNMENT_FLOAT64_IEEE 4 DATA_SIZE 32 /end MOD_COMMON
/begin CHARACTERISTIC InjSys_agMaxErlyCvo_C "Maximal earlier angle from CVO additional injection before the first injection" VALUE 0x8056D1CC RB_Val_Wu16 1535.977 kw_q0p0234 0.00 1535.977 FORMAT "%8.3" /end CHARACTERISTIC
/begin CHARACTERISTIC InjSys_facAdbtCmprn_T "factor adiabatic compression" CURVE 0x8056C6C0 RB_Curve_S16_U16_Static 0.9999847 fak_uw_b1 0.00 0.9999847 FORMAT "%9.7"
 /begin AXIS_DESCR STD_AXIS InjSys_agIntkVlvClsd kw_q0p0156 12 -512.0000 511.9844 FORMAT "%8.4" DEPOSIT ABSOLUTE /end AXIS_DESCR
/end CHARACTERISTIC
/begin CHARACTERISTIC InjSys_facAgMidPosn_C "factor mid angle position" VALUE 0x8056C6F2 RB_Val_Wu8 0.9961 fak_ub_b1 0.00 0.9961 /end CHARACTERISTIC
/begin CHARACTERISTIC InjSys_facCorrnPChmbNCamsft_M "factor correction in-cylinder pressure at intake valve closing" MAP 0x8056C7DA RB_Map_S16S16_U16 1.999969 fak_uw_b2 0.00 1.999969 FORMAT "%8.6"
 /begin AXIS_DESCR STD_AXIS InjSys_agIntkVlvClsd kw_q0p0156 9 -512.0000 511.9844 FORMAT "%8.4" DEPOSIT ABSOLUTE /end AXIS_DESCR
 /begin AXIS_DESCR STD_AXIS Epm_nEng EngN 6 -16384.00 16383.50 FORMAT "%8.2" DEPOSIT ABSOLUTE /end AXIS_DESCR
/end CHARACTERISTIC
/begin CHARACTERISTIC InjSys_facGenMixCorrn1_M "Factor fuel mixture adaption in injection mode 1" MAP 0x8056C9DC RB_Map_S16U16_U16 1.999969 fak_uw_b2 0.00 1.999969 FORMAT "%8.6"
 /begin AXIS_DESCR STD_AXIS Epm_nEng EngN 10 -16384.00 16383.50 FORMAT "%8.2" DEPOSIT ABSOLUTE /end AXIS_DESCR
 /begin AXIS_DESCR STD_AXIS InjSys_ratAirChrgLoc rel_q0p0234 8 0.00 1535.977 FORMAT "%8.3" DEPOSIT ABSOLUTE /end AXIS_DESCR
/end CHARACTERISTIC
/begin CHARACTERISTIC InjSys_facGenMixCorrn2_M "Factor fuel mixture adaption in injection mode 2" MAP 0x8056CAA4 RB_Map_S16U16_U16 1.999969 fak_uw_b2 0.00 1.999969 FORMAT "%8.6"
 /begin AXIS_DESCR STD_AXIS Epm_nEng EngN 10 -16384.00 16383.50 FORMAT "%8.2" DEPOSIT ABSOLUTE /end AXIS_DESCR
 /begin AXIS_DESCR STD_AXIS InjSys_ratAirChrgLoc rel_q0p0234 8 0.00 1535.977 FORMAT "%8.3" DEPOSIT ABSOLUTE /end AXIS_DESCR
/end CHARACTERISTIC
/begin CHARACTERISTIC InjSys_facGenMixCorrn3_M "Factor fuel mixture adaption in injection mode 3" MAP 0x8056CB6C RB_Map_S16U16_U16 1.999969 fak_uw_b2 0.00 1.999969 FORMAT "%8.6"
 /begin AXIS_DESCR STD_AXIS Epm_nEng EngN 10 -16384.00 16383.50 FORMAT "%8.2" DEPOSIT ABSOLUTE /end AXIS_DESCR
 /begin AXIS_DESCR STD_AXIS InjSys_ratAirChrgLoc rel_q0p0234 8 0.00 1535.977 FORMAT "%8.3" DEPOSIT ABSOLUTE /end AXIS_DESCR
/end CHARACTERISTIC
/begin CHARACTERISTIC InjSys_facGenMixCorrn4_M "Factor fuel mixture adaption in injection mode 4" MAP 0x8056CC34 RB_Map_S16U16_U16 1.999969 fak_uw_b2 0.00 1.999969 FORMAT "%8.6"
 /begin AXIS_DESCR STD_AXIS Epm_nEng EngN 10 -16384.00 16383.50 FORMAT "%8.2" DEPOSIT ABSOLUTE /end AXIS_DESCR
 /begin AXIS_DESCR STD_AXIS InjSys_ratAirChrgLoc rel_q0p0234 8 0.00 1535.977 FORMAT "%8.3" DEPOSIT ABSOLUTE /end AXIS_DESCR
/end CHARACTERISTIC
/begin CHARACTERISTIC InjSys_facGenMixCorrn5_M "Factor fuel mixture adaption in injection mode 5" MAP 0x8056CCFC RB_Map_S16U16_U16 1.999969 fak_uw_b2 0.00 1.999969 FORMAT "%8.6"
 /begin AXIS_DESCR STD_AXIS Epm_nEng EngN 10 -16384.00 16383.50 FORMAT "%8.2" DEPOSIT ABSOLUTE /end AXIS_DESCR
 /begin AXIS_DESCR STD_AXIS InjSys_ratAirChrgLoc rel_q0p0234 8 0.00 1535.977 FORMAT "%8.3" DEPOSIT ABSOLUTE /end AXIS_DESCR
/end CHARACTERISTIC
/begin CHARACTERISTIC InjSys_facGenMixCorrn6_M "Factor fuel mixture adaption in injection mode 6" MAP 0x8056CDC4 RB_Map_S16U16_U16 1.999969 fak_uw_b2 0.00 1.999969 FORMAT "%8.6"
 /begin AXIS_DESCR STD_AXIS Epm_nEng EngN 10 -16384.00 16383.50 FORMAT "%8.2" DEPOSIT ABSOLUTE /end AXIS_DESCR
 /begin AXIS_DESCR STD_AXIS InjSys_ratAirChrgLoc rel_q0p0234 8 0.00 1535.977 FORMAT "%8.3" DEPOSIT ABSOLUTE /end AXIS_DESCR
/end CHARACTERISTIC
/begin CHARACTERISTIC InjSys_facGenMixCorrn7_M "Factor fuel mixture adaption in injection mode 7" MAP 0x8056CE8C RB_Map_S16U16_U16 1.999969 fak_uw_b2 0.00 1.999969 FORMAT "%8.6"
 /begin AXIS_DESCR STD_AXIS Epm_nEng EngN 10 -16384.00 16383.50 FORMAT "%8.2" DEPOSIT ABSOLUTE /end AXIS_DESCR
 /begin AXIS_DESCR STD_AXIS InjSys_ratAirChrgLoc rel_q0p0234 8 0.00 1535.977 FORMAT "%8.3" DEPOSIT ABSOLUTE /end AXIS_DESCR
/end CHARACTERISTIC
/begin CHARACTERISTIC InjSys_facGenMixCorrn8_M "Factor fuel mixture adaption in injection mode 8" MAP 0x8056CF54 RB_Map_S16U16_U16 1.999969 fak_uw_b2 0.00 1.999969 FORMAT "%8.6"
 /begin AXIS_DESCR STD_AXIS Epm_nEng EngN 10 -16384.00 16383.50 FORMAT "%8.2" DEPOSIT ABSOLUTE /end AXIS_DESCR
 /begin AXIS_DESCR STD_AXIS InjSys_ratAirChrgLoc rel_q0p0234 8 0.00 1535.977 FORMAT "%8.3" DEPOSIT ABSOLUTE /end AXIS_DESCR
/end CHARACTERISTIC
/begin CHARACTERISTIC InjSys_facInjrFlowCorr_T "factor injector flow correction" CURVE 0x8056C6F4 RB_Curve_U16_U16 15.99976 fak_uw_b16 0.00 15.99976 FORMAT "%8.5"
 /begin AXIS_DESCR STD_AXIS NO_INPUT_QUANTITY RBPtCel_p_0p002_1 23 0.00 131.0700 FORMAT "%8.4" DEPOSIT ABSOLUTE /end AXIS_DESCR
/end CHARACTERISTIC
/begin CHARACTERISTIC InjSys_facRatFuMCylAppl_CA "factor mixture cylinder individual for calibration" VAL_BLK 0x8056D1B2 RB_ValA_Wu16 3.999939 fak_uw_b4 0.00 3.999939 FORMAT "%8.6" NUMBER 4 /end CHARACTERISTIC
/begin CHARACTERISTIC InjSys_facRelMCorEth_M "MAP:Factor relative mass correction injection mode Ethanol" MAP 0x8056D01C RB_Map_S16U16_U16 1.999969 fak_uw_b2 0.00 1.999969 FORMAT "%8.6"
 /begin AXIS_DESCR STD_AXIS Epm_nEng EngN 9 -16384.00 16383.50 FORMAT "%8.2" DEPOSIT ABSOLUTE /end AXIS_DESCR
 /begin AXIS_DESCR STD_AXIS InjSys_ratAirChrgLoc rel_q0p0234 8 0.00 1535.977 FORMAT "%8.3" DEPOSIT ABSOLUTE /end AXIS_DESCR
/end CHARACTERISTIC
/begin CHARACTERISTIC InjSys_facRelMCorrnSmlVlv_M "Factor relative mass correction injection mode with small cam." MAP 0x8056D0D2 RB_Map_S16U16_U16 1.999969 fak_uw_b2 0.00 1.999969 FORMAT "%8.6"
 /begin AXIS_DESCR STD_AXIS Epm_nEng EngN 9 -16384.00 16383.50 FORMAT "%8.2" DEPOSIT ABSOLUTE /end AXIS_DESCR
 /begin AXIS_DESCR STD_AXIS InjSys_ratAirChrgLoc rel_q0p0234 8 0.00 1535.977 FORMAT "%8.3" DEPOSIT ABSOLUTE /end AXIS_DESCR
/end CHARACTERISTIC
/begin CHARACTERISTIC InjSys_facTiCorrNDpdt_T "Factor to correct fuel delivery system dependent on engine speed" CURVE 0x8056C752 RB_Curve_S16_U16_Static 1.999969 fak_uw_b2 0.00 1.999969 FORMAT "%8.6"
 /begin AXIS_DESCR STD_AXIS Epm_nEng EngN 8 -16384.00 16383.50 FORMAT "%8.2" DEPOSIT ABSOLUTE /end AXIS_DESCR
/end CHARACTERISTIC
/begin CHARACTERISTIC InjSys_facVfStatyInjrCorr_T "correction of the injector volume flow dependent on fuel density" CURVE 0x8056C774 RB_Curve_U16_U16 1.999969 fak_uw_b2 0.00 1.999969 FORMAT "%8.6"
 /begin AXIS_DESCR STD_AXIS NO_INPUT_QUANTITY m_q0p1_g_DIV_L 5 0.00 6553.500 FORMAT "%8.3" DEPOSIT ABSOLUTE /end AXIS_DESCR
/end CHARACTERISTIC
/begin CHARACTERISTIC InjSys_idxMapGenFuMShift_GT "injection mode mapped generated table to enable fuel mass rearrangement." CURVE 0x8056C6A8 RB_CurveGroup_U8 255.0 dez 0.00 255.0 FORMAT "%5.1"
 /begin AXIS_DESCR COM_AXIS NO_INPUT_QUANTITY InjSys_InjMode_Set_COMPU_VERB 20 0.00 19.0000000000 FORMAT "%13.10" AXIS_PTS_REF InjSys_stInjMod_AX /end AXIS_DESCR
/end CHARACTERISTIC
/begin CHARACTERISTIC InjSys_idxMapGenMixCorrn_T "Mapping of injection mode to the correction maps" CURVE 0x8056D188 RB_Curve_U8_U8 15.00 dez 1.00 16.00 FORMAT "%5.2" EXTENDED_LIMITS 0.00 255.0
 /begin AXIS_DESCR STD_AXIS InjSys_stInjMod InjSys_InjMode_Set_COMPU_VERB 20 0.00 19.0000000000 FORMAT "%13.10" DEPOSIT ABSOLUTE /end AXIS_DESCR
/end CHARACTERISTIC
/begin CHARACTERISTIC InjSys_idxMapGenSpCvo_T "mapped generated table to enable CVO basic adaption in the choose injection mode" CURVE 0x8056D1CE RB_Curve_U8_U8 1.000 dez 0.00 1.000 FORMAT "%5.3" EXTENDED_LIMITS 0.00 255.0
 /begin AXIS_DESCR STD_AXIS InjSys_stInjMod InjSys_InjMode_Set_COMPU_VERB 20 0.00 19.0000000000 FORMAT "%13.10" DEPOSIT ABSOLUTE /end AXIS_DESCR
/end CHARACTERISTIC
/begin AXIS_PTS InjSys_nEng10Vers2_AX "base point distribution for engine speed with 10 base points (version 2)" 0x805585FA Epm_nEng RB_Axis_S16 16383.50 EngN 10 0.00 16383.50 FORMAT "%8.2" EXTENDED_LIMITS -16384.00 16383.50 DEPOSIT ABSOLUTE /end AXIS_PTS
/begin AXIS_PTS InjSys_nEng10_AX "base point distribution for engine speed with 10 base points" 0x80558610 Epm_nEng RB_Axis_S16 16383.50 EngN 10 0.00 16383.50 FORMAT "%8.2" EXTENDED_LIMITS -16384.00 16383.50 DEPOSIT ABSOLUTE /end AXIS_PTS
/begin AXIS_PTS InjSys_nEng12Vers2_AX "base point distribution for engine speed with 10 base points (version 2)" 0x80558674 Epm_nEng RB_Axis_S16 16383.50 EngN 12 0.00 16383.50 FORMAT "%8.2" EXTENDED_LIMITS -16384.00 16383.50 DEPOSIT ABSOLUTE /end AXIS_PTS
/begin CHARACTERISTIC InjSys_nMaxAirChrDrctStrt_C "Max engine speed threshold to select direct start air charge" VALUE 0x8056D1BA RB_Val_Ws16 32767.50 EngN -16384.00 16383.50 FORMAT "%8.2" /end CHARACTERISTIC
/begin AXIS_PTS InjSys_nrInj04_AX "Base point distribution number of injections with 4 base points" 0x805586A8 InjSys_nrInjLimdLoc RB_Axis_U16 65535.00 dez 4 0.00 65535.00 FORMAT "%8.2" DEPOSIT ABSOLUTE /end AXIS_PTS
/begin AXIS_PTS InjSys_nrInj08_AX "Base point distribution number of injections with 8 base points" 0x805586B2 InjSys_nrInjLimdLoc RB_Axis_U16 65535.00 dez 8 0.00 65535.00 FORMAT "%8.2" DEPOSIT ABSOLUTE /end AXIS_PTS
/begin CHARACTERISTIC InjSys_P3V2I1_SH.tiBreakAux1_T "class instance packet 3 variant 2 / pause time auxiliary injection 1" CURVE 0x8056B992 RB_Curve_S16_S16 1310.720 t_q0p04_ms -1310.720 0.00 FORMAT "%8.3" EXTENDED_LIMITS -1310.720 1310.680
 /begin AXIS_DESCR STD_AXIS InjSys_tEngStrt Temp_Cels 4 -3549.940 3003.560 FORMAT "%8.3" DEPOSIT ABSOLUTE /end AXIS_DESCR
/end CHARACTERISTIC
/begin CHARACTERISTIC InjSys_P3V3I1_SH.agAux2DeltaDrctStrtCorrn_T "class instance packet 3 variant 3 / delta angle correction auxiliary injection 2 direct start" CURVE 0x8056B9A4 RB_Curve_S16_S8_Static 382.5 kw_q1p5 -192.0 190.5 FORMAT "%5.1"
 /begin AXIS_DESCR STD_AXIS InjSys_tEngStrt Temp_Cels 3 -3549.940 3003.560 FORMAT "%8.3" DEPOSIT ABSOLUTE /end AXIS_DESCR
/end CHARACTERISTIC
/begin CHARACTERISTIC InjSys_P3V3I1_SH.agAux2DeltaEth_M "class instance packet 3 variant 3 / delta angle auxiliary injection 2 ethanol" MAP 0x8056B9B0 RB_Map_S16S16_S16 191.2500 kw_q0p75 -96.00000 95.25000 FORMAT "%8.5" EXTENDED_LIMITS -24576.00 24575.25
 /begin AXIS_DESCR STD_AXIS InjSys_facEthLnrLocSp fak_ub_b2 4 0.00 1.992188 FORMAT "%8.6" EXTENDED_LIMITS -256.0000 255.9922 DEPOSIT ABSOLUTE /end AXIS_DESCR
 /begin AXIS_DESCR STD_AXIS InjSys_tEngStrt Temp_Cels 4 -3549.940 3003.560 FORMAT "%8.3" DEPOSIT ABSOLUTE /end AXIS_DESCR
/end CHARACTERISTIC
/begin CHARACTERISTIC InjSys_P3V3I1_SH.agAux2DeltaStrt_T "class instance packet 3 variant 3 / delta angle auxiliary injection 2 in start" CURVE 0x8056B9E4 RB_Curve_S16_S8_Static 191.3 kw_q0p75 -96.00 95.25 FORMAT "%5.2"
 /begin AXIS_DESCR STD_AXIS Epm_nEngTooth10ms EngN 4 -16384.00 16383.50 FORMAT "%8.2" DEPOSIT ABSOLUTE /end AXIS_DESCR
/end CHARACTERISTIC
/begin CHARACTERISTIC InjSys_P3V3I1_SH.agAux2DrctStrt_M "class instance packet 3 variant 3 / angle auxiliary injection 2 direct start" MAP 0x8056B9F2 RB_Map_U8U8_S8 382.5 kw_q1p5 -192.0 190.5 FORMAT "%5.1"
 /begin AXIS_DESCR STD_AXIS InjSys_cntrInjLimdSyncS1 dez 3 0.00 255.0 FORMAT "%5.1" DEPOSIT ABSOLUTE /end AXIS_DESCR
 /begin AXIS_DESCR STD_AXIS InjSys_agDrctStrtLocSp kw_q2 3 0.00 510.0 FORMAT "%5.1" DEPOSIT ABSOLUTE /end AXIS_DESCR
/end CHARACTERISTIC
/begin CHARACTERISTIC InjSys_P3V3I1_SH.agAux2_GM "class instance packet 3 variant 3 / angle auxiliary injection 2" MAP 0x8056BA04 RB_MapGroup_S8 382.5 kw_q1p5 -192.0 190.5 FORMAT "%5.1"
 /begin AXIS_DESCR COM_AXIS InjSys_nrInjLimdLoc dez 4 0.00 65535.00 FORMAT "%8.2" AXIS_PTS_REF InjSys_nrInj04_AX /end AXIS_DESCR
 /begin AXIS_DESCR COM_AXIS InjSys_tEngStrt Temp_Cels 8 -3549.940 3003.560 FORMAT "%8.3" AXIS_PTS_REF InjSys_tEngStrt08_AX /end AXIS_DESCR
/end CHARACTERISTIC
/begin CHARACTERISTIC InjSys_P3V3I1_SH.agBasDrctStrt_M "class instance packet 3 variant 3 / base angle direct start" MAP 0x8056BA24 RB_Map_U8U8_S8 382.5 kw_q1p5 -192.0 190.5 FORMAT "%5.1"
 /begin AXIS_DESCR STD_AXIS InjSys_cntrInjLimdSyncS1 dez 3 0.00 255.0 FORMAT "%5.1" DEPOSIT ABSOLUTE /end AXIS_DESCR
 /begin AXIS_DESCR STD_AXIS InjSys_agDrctStrtLocSp kw_q2 3 0.00 510.0 FORMAT "%5.1" DEPOSIT ABSOLUTE /end AXIS_DESCR
/end CHARACTERISTIC
/begin CHARACTERISTIC InjSys_P3V3I1_SH.agBasEthnlVers2_T "class instance packet 3 variant 3 / base angle ethanol dependent version 2 curve" CURVE 0x8056BA36 RB_Curve_S16_S8_Static 191.3 kw_q0p75 -96.00 95.25 FORMAT "%5.2"
 /begin AXIS_DESCR STD_AXIS Epm_nEngTooth10ms EngN 4 -16384.00 16383.50 FORMAT "%8.2" DEPOSIT ABSOLUTE /end AXIS_DESCR
/end CHARACTERISTIC
/begin CHARACTERISTIC InjSys_P3V3I1_SH.agBasEthnl_GM "class instance packet 3 variant 3 / base angle ethanol dependent" MAP 0x8056BA44 RB_MapGroup_U8 191.3 kw_q0p75 0.00 191.3 FORMAT "%5.1"
 /begin AXIS_DESCR COM_AXIS InjSys_nrInjLimdLoc dez 4 0.00 65535.00 FORMAT "%8.2" AXIS_PTS_REF InjSys_nrInj04_AX /end AXIS_DESCR
 /begin AXIS_DESCR COM_AXIS InjSys_tEngStrt Temp_Cels 8 -3549.940 3003.560 FORMAT "%8.3" AXIS_PTS_REF InjSys_tEngStrt08_AX /end AXIS_DESCR
/end CHARACTERISTIC
/begin CHARACTERISTIC InjSys_P3V3I1_SH.agBas_GM "class instance packet 3 variant 3 / base angle" MAP 0x8056BA64 RB_MapGroup_U8 191.3 kw_q0p75 0.00 191.3 FORMAT "%5.1"
 /begin AXIS_DESCR COM_AXIS InjSys_nrInjLimdLoc dez 4 0.00 65535.00 FORMAT "%8.2" AXIS_PTS_REF InjSys_nrInj04_AX /end AXIS_DESCR
 /begin AXIS_DESCR COM_AXIS InjSys_tEngStrt Temp_Cels 8 -3549.940 3003.560 FORMAT "%8.3" AXIS_PTS_REF InjSys_tEngStrt08_AX /end AXIS_DESCR
/end CHARACTERISTIC
/begin CHARACTERISTIC InjSys_P3V3I1_SH.agDeltaApp_M "class instance packet 3 variant 3 / delta angle driver dependent" MAP 0x8056BA84 RB_Map_S16S16_S16 191.2500 kw_q0p75 -96.00000 95.25000 FORMAT "%8.5" EXTENDED_LIMITS -24576.00 24575.25
 /begin AXIS_DESCR STD_AXIS Epm_nEngTooth10ms EngN 6 -16384.00 16383.50 FORMAT "%8.2" DEPOSIT ABSOLUTE /end AXIS_DESCR
 /begin AXIS_DESCR STD_AXIS InjSys_rAppLocSp Prc 6 -400.0000 399.9878 FORMAT "%8.4" DEPOSIT ABSOLUTE /end AXIS_DESCR
/end CHARACTERISTIC
/begin CHARACTERISTIC InjSys_P3V3I1_SH.agDeltaDrctStrtCorrn_T "class instance packet 3 variant 3 / delta angle correction direct start" CURVE 0x8056BAE8 RB_Curve_S16_S8_Static 382.5 kw_q1p5 -192.0 190.5 FORMAT "%5.1"
 /begin AXIS_DESCR STD_AXIS InjSys_tEngStrt Temp_Cels 3 -3549.940 3003.560 FORMAT "%8.3" DEPOSIT ABSOLUTE /end AXIS_DESCR
/end CHARACTERISTIC
/begin CHARACTERISTIC InjSys_P3V3I1_SH.agDeltaEth_M "class instance packet 3 variant 3 / delta angle ethanol dependent" MAP 0x8056BAF4 RB_Map_S16S16_S16 191.2500 kw_q0p75 -96.00000 95.25000 FORMAT "%8.5" EXTENDED_LIMITS -24576.00 24575.25
 /begin AXIS_DESCR STD_AXIS InjSys_facEthLnrLocSp fak_ub_b2 4 0.00 1.992188 FORMAT "%8.6" EXTENDED_LIMITS -256.0000 255.9922 DEPOSIT ABSOLUTE /end AXIS_DESCR
 /begin AXIS_DESCR STD_AXIS InjSys_tEngStrt Temp_Cels 4 -3549.940 3003.560 FORMAT "%8.3" DEPOSIT ABSOLUTE /end AXIS_DESCR
/end CHARACTERISTIC
/begin CHARACTERISTIC InjSys_P3V3I1_SH.agDeltaStrt_T "class instance packet 3 variant 3 / delta angle in start" CURVE 0x8056BB28 RB_Curve_S16_S8_Static 191.3 kw_q0p75 -96.00 95.25 FORMAT "%5.2"
 /begin AXIS_DESCR STD_AXIS Epm_nEngTooth10ms EngN 4 -16384.00 16383.50 FORMAT "%8.2" DEPOSIT ABSOLUTE /end AXIS_DESCR
/end CHARACTERISTIC
/begin CHARACTERISTIC InjSys_P3V3I1_SH.facEthnlAgBas_T "class instance packet 3 variant 3 / ethanol factor base angle curve" CURVE 0x8056BB36 RB_Curve_U8_U8 0.9961 fak_ub_b1 0.00 0.9961
 /begin AXIS_DESCR STD_AXIS fethstoeLocSp fak_ub_b2 4 0.00 1.992188 FORMAT "%8.6" DEPOSIT ABSOLUTE /end AXIS_DESCR
/end CHARACTERISTIC
/begin CHARACTERISTIC InjSys_P3V3I1_SH.facEthnlAux1_T "class instance packet 3 variant 3 / ethanol factor auxillary 1 curve" CURVE 0x8056BB3F RB_Curve_U8_U8 0.9961 fak_ub_b1 0.00 0.9961
 /begin AXIS_DESCR STD_AXIS fethstoeLocSp fak_ub_b2 4 0.00 1.992188 FORMAT "%8.6" DEPOSIT ABSOLUTE /end AXIS_DESCR
/end CHARACTERISTIC
/begin CHARACTERISTIC InjSys_P3V3I1_SH.facEthnlAux2_T "class instance packet 3 variant 3 / ethanol factor auxillary 2 curve" CURVE 0x8056BB48 RB_Curve_U8_U8 0.9961 fak_ub_b1 0.00 0.9961
 /begin AXIS_DESCR STD_AXIS fethstoeLocSp fak_ub_b2 4 0.00 1.992188 FORMAT "%8.6" DEPOSIT ABSOLUTE /end AXIS_DESCR
/end CHARACTERISTIC
/begin CHARACTERISTIC InjSys_P3V3I1_SH.facEthnlBas_T "class instance packet 3 variant 3 / ethanol facor base curve" CURVE 0x8056BB51 RB_Curve_U8_U8 0.9961 fak_ub_b1 0.00 0.9961
 /begin AXIS_DESCR STD_AXIS fethstoeLocSp fak_ub_b2 4 0.00 1.992188 FORMAT "%8.6" DEPOSIT ABSOLUTE /end AXIS_DESCR
/end CHARACTERISTIC
/begin CHARACTERISTIC InjSys_P3V3I1_SH.facSpltAux1Ethnl_GM "class instance packet 3 variant 3 / split factor auxillary 1 ethanol dependent" MAP 0x8056BB5A RB_MapGroup_U8 0.9961 fak_ub_b1 0.00 0.9961
 /begin AXIS_DESCR COM_AXIS InjSys_tEngStrt Temp_Cels 8 -3549.940 3003.560 FORMAT "%8.3" AXIS_PTS_REF InjSys_tEngStrt08_AX /end AXIS_DESCR
 /begin AXIS_DESCR COM_AXIS InjSys_nrInjLimdLoc dez 8 0.00 65535.00 FORMAT "%8.2" AXIS_PTS_REF InjSys_nrInj08_AX /end AXIS_DESCR
/end CHARACTERISTIC
/begin CHARACTERISTIC InjSys_P3V3I1_SH.facSpltAux1_GM "class instance packet 3 variant 3 / split factor auxiliary injection 1" MAP 0x8056BB9A RB_MapGroup_U8 0.9961 fak_ub_b1 0.00 0.9961
 /begin AXIS_DESCR COM_AXIS InjSys_tEngStrt Temp_Cels 8 -3549.940 3003.560 FORMAT "%8.3" AXIS_PTS_REF InjSys_tEngStrt08_AX /end AXIS_DESCR
 /begin AXIS_DESCR COM_AXIS InjSys_nrInjLimdLoc dez 8 0.00 65535.00 FORMAT "%8.2" AXIS_PTS_REF InjSys_nrInj08_AX /end AXIS_DESCR
/end CHARACTERISTIC
/begin CHARACTERISTIC InjSys_P3V3I1_SH.facSpltAux2Ethnl_GM "class instance packet 3 variant 3 / split factor auxillary 2 ethanol dependent" MAP 0x8056BBDA RB_MapGroup_U8 0.9961 fak_ub_b1 0.00 0.9961
 /begin AXIS_DESCR COM_AXIS InjSys_tEngStrt Temp_Cels 8 -3549.940 3003.560 FORMAT "%8.3" AXIS_PTS_REF InjSys_tEngStrt08_AX /end AXIS_DESCR
 /begin AXIS_DESCR COM_AXIS InjSys_nrInjLimdLoc dez 8 0.00 65535.00 FORMAT "%8.2" AXIS_PTS_REF InjSys_nrInj08_AX /end AXIS_DESCR
/end CHARACTERISTIC
/begin CHARACTERISTIC InjSys_P3V3I1_SH.facSpltAux2_GM "class instance packet 3 variant 3 / split factor auxiliary injection 2" MAP 0x8056BC1A RB_MapGroup_U8 0.9961 fak_ub_b1 0.00 0.9961
 /begin AXIS_DESCR COM_AXIS InjSys_tEngStrt Temp_Cels 8 -3549.940 3003.560 FORMAT "%8.3" AXIS_PTS_REF InjSys_tEngStrt08_AX /end AXIS_DESCR
 /begin AXIS_DESCR COM_AXIS InjSys_nrInjLimdLoc dez 8 0.00 65535.00 FORMAT "%8.2" AXIS_PTS_REF InjSys_nrInj08_AX /end AXIS_DESCR
/end CHARACTERISTIC
/begin CHARACTERISTIC InjSys_P3V3I1_SH.facSpltBasEthnl_GM "class instance packet 3 variant 3 / split factor base ethanol dependent" MAP 0x8056BC5A RB_MapGroup_U8 0.9961 fak_ub_b1 0.00 0.9961
 /begin AXIS_DESCR COM_AXIS InjSys_tEngStrt Temp_Cels 8 -3549.940 3003.560 FORMAT "%8.3" AXIS_PTS_REF InjSys_tEngStrt08_AX /end AXIS_DESCR
 /begin AXIS_DESCR COM_AXIS InjSys_nrInjLimdLoc dez 8 0.00 65535.00 FORMAT "%8.2" AXIS_PTS_REF InjSys_nrInj08_AX /end AXIS_DESCR
/end CHARACTERISTIC
/begin CHARACTERISTIC InjSys_P3V3I1_SH.facSpltBas_GM "class instance packet 3 variant 3 / split factor base injection" MAP 0x8056BC9A RB_MapGroup_U8 0.9961 fak_ub_b1 0.00 0.9961
 /begin AXIS_DESCR COM_AXIS InjSys_tEngStrt Temp_Cels 8 -3549.940 3003.560 FORMAT "%8.3" AXIS_PTS_REF InjSys_tEngStrt08_AX /end AXIS_DESCR
 /begin AXIS_DESCR COM_AXIS InjSys_nrInjLimdLoc dez 8 0.00 65535.00 FORMAT "%8.2" AXIS_PTS_REF InjSys_nrInj08_AX /end AXIS_DESCR
/end CHARACTERISTIC
/begin CHARACTERISTIC InjSys_P3V3I1_SH.facTiBreakAux1Corrn_T "class instance packet 3 variant 3 / pause time correction factor auxiliary injection 1" CURVE 0x8056BCDA RB_Curve_S16_U8_Static 7.969 fak_ub_b8 0.00 7.969 FORMAT "%5.3"
 /begin AXIS_DESCR STD_AXIS Epm_nEngTooth10ms EngN 4 -16384.00 16383.50 FORMAT "%8.2" DEPOSIT ABSOLUTE /end AXIS_DESCR
/end CHARACTERISTIC
/begin CHARACTERISTIC InjSys_P3V3I1_SH.facTiBreakAux2Corrn_T "class instance packet 3 variant 3 / pause time correction factor auxiliary injection 2" CURVE 0x8056BCE8 RB_Curve_S16_U8_Static 7.969 fak_ub_b8 0.00 7.969 FORMAT "%5.3"
 /begin AXIS_DESCR STD_AXIS Epm_nEngTooth10ms EngN 4 -16384.00 16383.50 FORMAT "%8.2" DEPOSIT ABSOLUTE /end AXIS_DESCR
/end CHARACTERISTIC
/begin CHARACTERISTIC InjSys_P3V3I1_SH.flgAbsltSplt_C "class instance packet 3 variant 3 / condition split with absolute fuel mass" VALUE 0x8056BCF6 RB_Val_Wu8 1.00000000000 B_TRUE 0.00 1.00000000000 FORMAT "%13.11" /end CHARACTERISTIC
/begin CHARACTERISTIC InjSys_P3V3I1_SH.flgAgAux2_C "class instance packet 3 variant 3 / condition angle for auxiliary injection 2" VALUE 0x8056BCF7 RB_Val_Wu8 1.00000000000 B_TRUE 0.00 1.00000000000 FORMAT "%13.11" /end CHARACTERISTIC
/begin CHARACTERISTIC InjSys_P3V3I1_SH.flgIgnCoupld_C "class instance packet 3 variant 3 / condition ignition coupled" VALUE 0x8056BCF8 RB_Val_Wu8 1.00000000000 B_TRUE 0.00 1.00000000000 FORMAT "%13.11" /end CHARACTERISTIC
/begin CHARACTERISTIC InjSys_P3V3I1_SH.ratFuMAux1_GM "class instance packet 3 variant 3 / relative fuel mass auxiliary injection 1" MAP 0x8056BCFA RB_MapGroup_U16 3071.953 rel_uw_b3072 0.00 3071.953 FORMAT "%8.3"
 /begin AXIS_DESCR COM_AXIS InjSys_tEngStrt Temp_Cels 8 -3549.940 3003.560 FORMAT "%8.3" AXIS_PTS_REF InjSys_tEngStrt08_AX /end AXIS_DESCR
 /begin AXIS_DESCR COM_AXIS InjSys_nrInjLimdLoc dez 8 0.00 65535.00 FORMAT "%8.2" AXIS_PTS_REF InjSys_nrInj08_AX /end AXIS_DESCR
/end CHARACTERISTIC
/begin CHARACTERISTIC InjSys_P3V3I1_SH.ratFuMAux2_GM "class instance packet 3 variant 3 / relative fuel mass auxiliary injection 2" MAP 0x8056BD7A RB_MapGroup_U16 3071.953 rel_uw_b3072 0.00 3071.953 FORMAT "%8.3"
 /begin AXIS_DESCR COM_AXIS InjSys_tEngStrt Temp_Cels 8 -3549.940 3003.560 FORMAT "%8.3" AXIS_PTS_REF InjSys_tEngStrt08_AX /end AXIS_DESCR
 /begin AXIS_DESCR COM_AXIS InjSys_nrInjLimdLoc dez 8 0.00 65535.00 FORMAT "%8.2" AXIS_PTS_REF InjSys_nrInj08_AX /end AXIS_DESCR
/end CHARACTERISTIC
/begin CHARACTERISTIC InjSys_P3V3I1_SH.ratFuMBas_GM "class instance packet 3 variant 3 / relative fuel mass base injection" MAP 0x8056BDFA RB_MapGroup_U16 3071.953 rel_uw_b3072 0.00 3071.953 FORMAT "%8.3"
 /begin AXIS_DESCR COM_AXIS InjSys_tEngStrt Temp_Cels 8 -3549.940 3003.560 FORMAT "%8.3" AXIS_PTS_REF InjSys_tEngStrt08_AX /end AXIS_DESCR
 /begin AXIS_DESCR COM_AXIS InjSys_nrInjLimdLoc dez 8 0.00 65535.00 FORMAT "%8.2" AXIS_PTS_REF InjSys_nrInj08_AX /end AXIS_DESCR
/end CHARACTERISTIC
/begin CHARACTERISTIC InjSys_P3V3I1_SH.tiBreakAux_T "class instance packet 3 variant 3 / pause time auxiliary injections" CURVE 0x8056BE7A RB_Curve_S16_S16 1310.720 t_q0p04_ms -1310.720 0.00 FORMAT "%8.3" EXTENDED_LIMITS -1310.720 1310.680
 /begin AXIS_DESCR STD_AXIS InjSys_tEngStrt Temp_Cels 4 -3549.940 3003.560 FORMAT "%8.3" DEPOSIT ABSOLUTE /end AXIS_DESCR
/end CHARACTERISTIC
/begin CHARACTERISTIC InjSys_P3V4I1_SHP.agBas_M "class instance packet 3 variant 4 / base angle" MAP 0x8056BE8C RB_Map_U8S16_S8 382.5 kw_q1p5 -192.0 190.5 FORMAT "%5.1"
 /begin AXIS_DESCR STD_AXIS InjSys_nrInjLimdLteLocSp dez 4 0.00 255.0 FORMAT "%5.1" DEPOSIT ABSOLUTE /end AXIS_DESCR
 /begin AXIS_DESCR STD_AXIS InjSys_tEngStrt Temp_Cels 8 -3549.940 3003.560 FORMAT "%8.3" DEPOSIT ABSOLUTE /end AXIS_DESCR
/end CHARACTERISTIC
/begin CHARACTERISTIC InjSys_P3V4I1_SHP.agDeltaEth_M "class instance packet 3 variant 4 / delta angle ethanol dependent" MAP 0x8056BEC2 RB_Map_S16S16_S16 191.2500 kw_q0p75 -96.00000 95.25000 FORMAT "%8.5" EXTENDED_LIMITS -24576.00 24575.25
 /begin AXIS_DESCR STD_AXIS InjSys_facEthLnrLocSp fak_ub_b2 4 0.00 1.992188 FORMAT "%8.6" EXTENDED_LIMITS -256.0000 255.9922 DEPOSIT ABSOLUTE /end AXIS_DESCR
 /begin AXIS_DESCR STD_AXIS InjSys_tEngStrt Temp_Cels 4 -3549.940 3003.560 FORMAT "%8.3" DEPOSIT ABSOLUTE /end AXIS_DESCR
/end CHARACTERISTIC
/begin CHARACTERISTIC InjSys_P3V4I1_SHP.agDeltaStrtIgn_M "class instance packet 3 variant 4 / delta angle in start for ignition coupling" MAP 0x8056BEF6 RB_Map_S16S16_U8 95.63 kw_q0p375 0.00 95.63 FORMAT "%5.2"
 /begin AXIS_DESCR STD_AXIS Epm_nEngTooth10ms EngN 4 -16384.00 16383.50 FORMAT "%8.2" DEPOSIT ABSOLUTE /end AXIS_DESCR
 /begin AXIS_DESCR STD_AXIS InjSys_tEngStrt Temp_Cels 8 -3549.940 3003.560 FORMAT "%8.3" DEPOSIT ABSOLUTE /end AXIS_DESCR
/end CHARACTERISTIC
/begin CHARACTERISTIC InjSys_P3V4I1_SHP.agDeltaStrt_T "class instance packet 3 variant 4 / delta angle in start" CURVE 0x8056BF32 RB_Curve_S16_S8_Static 191.3 kw_q0p75 -96.00 95.25 FORMAT "%5.2"
 /begin AXIS_DESCR STD_AXIS Epm_nEngTooth10ms EngN 4 -16384.00 16383.50 FORMAT "%8.2" DEPOSIT ABSOLUTE /end AXIS_DESCR
/end CHARACTERISTIC
/begin CHARACTERISTIC InjSys_P3V4I1_SHP.facSpltAux1Eth_GM "class instance packet 3 variant 4 / split factor auxiliary injection 1 ethanol dependent" MAP 0x8056BF40 RB_MapGroup_U8 0.9961 fak_ub_b1 0.00 0.9961
 /begin AXIS_DESCR COM_AXIS InjSys_tEngStrt Temp_Cels 8 -3549.940 3003.560 FORMAT "%8.3" AXIS_PTS_REF InjSys_tEngStrt08_AX /end AXIS_DESCR
 /begin AXIS_DESCR COM_AXIS InjSys_nrInjLimdLoc dez 8 0.00 65535.00 FORMAT "%8.2" AXIS_PTS_REF InjSys_nrInj08_AX /end AXIS_DESCR
/end CHARACTERISTIC
/begin CHARACTERISTIC InjSys_P3V4I1_SHP.facSpltAux1_GM "class instance packet 3 variant 4 / split factor auxiliary injection 1" MAP 0x8056BF80 RB_MapGroup_U8 0.9961 fak_ub_b1 0.00 0.9961
 /begin AXIS_DESCR COM_AXIS InjSys_tEngStrt Temp_Cels 8 -3549.940 3003.560 FORMAT "%8.3" AXIS_PTS_REF InjSys_tEngStrt08_AX /end AXIS_DESCR
 /begin AXIS_DESCR COM_AXIS InjSys_nrInjLimdLoc dez 8 0.00 65535.00 FORMAT "%8.2" AXIS_PTS_REF InjSys_nrInj08_AX /end AXIS_DESCR
/end CHARACTERISTIC
/begin CHARACTERISTIC InjSys_P3V4I1_SHP.facSpltPktEth_GM "class instance packet 3 variant 4 / split factor packet auxiliary ethanol dependent" MAP 0x8056BFC0 RB_MapGroup_U8 0.9961 fak_ub_b1 0.00 0.9961
 /begin AXIS_DESCR COM_AXIS InjSys_tEngStrt Temp_Cels 8 -3549.940 3003.560 FORMAT "%8.3" AXIS_PTS_REF InjSys_tEngStrt08_AX /end AXIS_DESCR
 /begin AXIS_DESCR COM_AXIS InjSys_nrInjLimdLoc dez 8 0.00 65535.00 FORMAT "%8.2" AXIS_PTS_REF InjSys_nrInj08_AX /end AXIS_DESCR
/end CHARACTERISTIC
/begin CHARACTERISTIC InjSys_P3V4I1_SHP.facSpltPkt_GM "class instance packet 3 variant 4 / split factor packet" MAP 0x8056C000 RB_MapGroup_U8 0.9961 fak_ub_b1 0.00 0.9961
 /begin AXIS_DESCR COM_AXIS InjSys_tEngStrt Temp_Cels 8 -3549.940 3003.560 FORMAT "%8.3" AXIS_PTS_REF InjSys_tEngStrt08_AX /end AXIS_DESCR
 /begin AXIS_DESCR COM_AXIS InjSys_nrInjLimdLoc dez 8 0.00 65535.00 FORMAT "%8.2" AXIS_PTS_REF InjSys_nrInj08_AX /end AXIS_DESCR
/end CHARACTERISTIC
/begin CHARACTERISTIC InjSys_P3V4I1_SHP.facTiBreakAux1Corrn_T "class instance packet 3 variant 4 / pause time correction factor auxiliary injection 1" CURVE 0x8056C040 RB_Curve_S16_U8_Static 7.969 fak_ub_b8 0.00 7.969 FORMAT "%5.3"
 /begin AXIS_DESCR STD_AXIS Epm_nEngTooth10ms EngN 4 -16384.00 16383.50 FORMAT "%8.2" DEPOSIT ABSOLUTE /end AXIS_DESCR
/end CHARACTERISTIC
/begin CHARACTERISTIC InjSys_P3V4I1_SHP.flgAbsltSplt_C "class instance packet 3 variant 4 / condition split with absolute fuel mass" VALUE 0x8056C04E RB_Val_Wu8 1.00000000000 B_TRUE 0.00 1.00000000000 FORMAT "%13.11" /end CHARACTERISTIC
/begin CHARACTERISTIC InjSys_P3V4I1_SHP.flgIgnCoupld_C "class instance packet 3 variant 4 / condition ignition coupled" VALUE 0x8056C04F RB_Val_Wu8 1.00000000000 B_TRUE 0.00 1.00000000000 FORMAT "%13.11" /end CHARACTERISTIC
/begin CHARACTERISTIC InjSys_P3V4I1_SHP.ratFuMAux1Eth_GM "class instance packet 3 variant 4 / relative fuel mass auxiliary injection 1 ethanol dependent" MAP 0x8056C050 RB_MapGroup_U16 3071.953 rel_uw_b3072 0.00 3071.953 FORMAT "%8.3"
 /begin AXIS_DESCR COM_AXIS InjSys_tEngStrt Temp_Cels 8 -3549.940 3003.560 FORMAT "%8.3" AXIS_PTS_REF InjSys_tEngStrt08_AX /end AXIS_DESCR
 /begin AXIS_DESCR COM_AXIS InjSys_nrInjLimdLoc dez 8 0.00 65535.00 FORMAT "%8.2" AXIS_PTS_REF InjSys_nrInj08_AX /end AXIS_DESCR
/end CHARACTERISTIC
/begin CHARACTERISTIC InjSys_P3V4I1_SHP.ratFuMAux1_GM "class instance packet 3 variant 4 / relative fuel mass auxiliary injection 1" MAP 0x8056C0D0 RB_MapGroup_U16 3071.953 rel_uw_b3072 0.00 3071.953 FORMAT "%8.3"
 /begin AXIS_DESCR COM_AXIS InjSys_tEngStrt Temp_Cels 8 -3549.940 3003.560 FORMAT "%8.3" AXIS_PTS_REF InjSys_tEngStrt08_AX /end AXIS_DESCR
 /begin AXIS_DESCR COM_AXIS InjSys_nrInjLimdLoc dez 8 0.00 65535.00 FORMAT "%8.2" AXIS_PTS_REF InjSys_nrInj08_AX /end AXIS_DESCR
/end CHARACTERISTIC
/begin CHARACTERISTIC InjSys_P3V4I1_SHP.ratFuMBasEth_GM "class instance packet 3 variant 4 / relative fuel mass base injection ethanol dependent" MAP 0x8056C150 RB_MapGroup_U16 3071.953 rel_uw_b3072 0.00 3071.953 FORMAT "%8.3"
 /begin AXIS_DESCR COM_AXIS InjSys_tEngStrt Temp_Cels 8 -3549.940 3003.560 FORMAT "%8.3" AXIS_PTS_REF InjSys_tEngStrt08_AX /end AXIS_DESCR
 /begin AXIS_DESCR COM_AXIS InjSys_nrInjLimdLoc dez 8 0.00 65535.00 FORMAT "%8.2" AXIS_PTS_REF InjSys_nrInj08_AX /end AXIS_DESCR
/end CHARACTERISTIC
/begin CHARACTERISTIC InjSys_P3V4I1_SHP.ratFuMBas_GM "class instance packet 3 variant 4 / relative fuel mass base injection" MAP 0x8056C1D0 RB_MapGroup_U16 3071.953 rel_uw_b3072 0.00 3071.953 FORMAT "%8.3"
 /begin AXIS_DESCR COM_AXIS InjSys_tEngStrt Temp_Cels 8 -3549.940 3003.560 FORMAT "%8.3" AXIS_PTS_REF InjSys_tEngStrt08_AX /end AXIS_DESCR
 /begin AXIS_DESCR COM_AXIS InjSys_nrInjLimdLoc dez 8 0.00 65535.00 FORMAT "%8.2" AXIS_PTS_REF InjSys_nrInj08_AX /end AXIS_DESCR
/end CHARACTERISTIC
/begin CHARACTERISTIC InjSys_P3V4I1_SHP.tiBreakAux1_T "class instance packet 3 variant 4 / pause time auxiliary injection 1" CURVE 0x8056C250 RB_Curve_S16_S16 1310.720 t_q0p04_ms -1310.720 0.00 FORMAT "%8.3" EXTENDED_LIMITS -1310.720 1310.680
 /begin AXIS_DESCR STD_AXIS InjSys_tEngStrt Temp_Cels 4 -3549.940 3003.560 FORMAT "%8.3" DEPOSIT ABSOLUTE /end AXIS_DESCR
/end CHARACTERISTIC
/begin CHARACTERISTIC InjSys_P3V5I1_HPZ.agDeltaOffsVers2_GM "class instance packet 3 variant 5 / delta angle offset" MAP 0x8056C268 RB_MapGroup_S8 95.63 kw_q0p375 -48.00 47.63 FORMAT "%5.2"
 /begin AXIS_DESCR COM_AXIS Epm_nEng EngN 10 0.00 16383.50 FORMAT "%8.2" EXTENDED_LIMITS -16384.00 16383.50 AXIS_PTS_REF InjSys_nEng10Vers2_AX /end AXIS_DESCR
 /begin AXIS_DESCR COM_AXIS InjSys_ratAirMAgSpVers2AxisInp rel_uw_q0p0234 12 0.00 1535.977 FORMAT "%8.3" AXIS_PTS_REF InjSys_ratAirM12AgSpHspVers2_AX /end AXIS_DESCR
/end CHARACTERISTIC
/begin CHARACTERISTIC InjSys_P3V5I1_HPZ.agDeltaOffs_GM "class instance packet 3 variant 5 / delta angle offset" MAP 0x8056C2E0 RB_MapGroup_S8 95.63 kw_q0p375 -48.00 47.63 FORMAT "%5.2"
 /begin AXIS_DESCR COM_AXIS Epm_nEng EngN 10 0.00 16383.50 FORMAT "%8.2" EXTENDED_LIMITS -16384.00 16383.50 AXIS_PTS_REF InjSys_nEng10_AX /end AXIS_DESCR
 /begin AXIS_DESCR COM_AXIS InjSys_ratAirMAgSpAxisInp rel_uw_q0p0234 12 0.00 1535.977 FORMAT "%8.3" AXIS_PTS_REF InjSys_ratAirM12AgSpHsp_AX /end AXIS_DESCR
/end CHARACTERISTIC
/begin CHARACTERISTIC InjSys_P3V5I1_HPZ.agDeltaVers2_GM "class instance packet 3 variant 5 / delta angle" MAP 0x8056C358 RB_MapGroup_S8 95.63 kw_q0p375 -48.00 47.63 FORMAT "%5.2"
 /begin AXIS_DESCR COM_AXIS Epm_nEng EngN 10 0.00 16383.50 FORMAT "%8.2" EXTENDED_LIMITS -16384.00 16383.50 AXIS_PTS_REF InjSys_nEng10Vers2_AX /end AXIS_DESCR
 /begin AXIS_DESCR COM_AXIS InjSys_ratAirMAgSpVers2AxisInp rel_uw_q0p0234 12 0.00 1535.977 FORMAT "%8.3" AXIS_PTS_REF InjSys_ratAirM12AgSpHspVers2_AX /end AXIS_DESCR
/end CHARACTERISTIC
/begin CHARACTERISTIC InjSys_P3V5I1_HPZ.agDelta_GM "class instance packet 3 variant 5 / delta angle" MAP 0x8056C3D0 RB_MapGroup_S8 95.63 kw_q0p375 -48.00 47.63 FORMAT "%5.2"
 /begin AXIS_DESCR COM_AXIS Epm_nEng EngN 10 0.00 16383.50 FORMAT "%8.2" EXTENDED_LIMITS -16384.00 16383.50 AXIS_PTS_REF InjSys_nEng10_AX /end AXIS_DESCR
 /begin AXIS_DESCR COM_AXIS InjSys_ratAirMAgSpAxisInp rel_uw_q0p0234 12 0.00 1535.977 FORMAT "%8.3" AXIS_PTS_REF InjSys_ratAirM12AgSpHsp_AX /end AXIS_DESCR
/end CHARACTERISTIC
/begin CHARACTERISTIC InjSys_P3V5I1_HPZ.facSpltBasCorrnLoT_GM "class instance packet 3 variant 5 / split factor correction base injection dependent of temperature and number of injections" MAP 0x8056C448 RB_MapGroup_U8 1.992188 fak_ub_b2 0.00 1.992188 FORMAT "%8.6"
 /begin AXIS_DESCR COM_AXIS InjSys_tEng Temp_Cels 8 -3549.940 3003.560 FORMAT "%8.3" AXIS_PTS_REF InjSys_tEng08_AX /end AXIS_DESCR
 /begin AXIS_DESCR COM_AXIS InjSys_nrInjLimdLoc dez 8 0.00 65535.00 FORMAT "%8.2" AXIS_PTS_REF InjSys_nrInj08_AX /end AXIS_DESCR
/end CHARACTERISTIC
/begin CHARACTERISTIC InjSys_P3V5I1_HPZ.facWghtAg_T "class instance packet 3 variant 5 / weighting factor angle" CURVE 0x8056C488 RB_Curve_S16_U8_Static 1.992188 fak_ub_b2 0.00 1.992188 FORMAT "%8.6"
 /begin AXIS_DESCR STD_AXIS InjSys_tEng Temp_Cels 6 -3549.940 3003.560 FORMAT "%8.3" DEPOSIT ABSOLUTE /end AXIS_DESCR
/end CHARACTERISTIC
/begin CHARACTERISTIC InjSys_P3V5I1_HPZ.facWghtSpltBasT_GM "class instance packet 3 variant 5 / weighting factor split base injection" MAP 0x8056C49C RB_MapGroup_U8 0.9961 fak_ub_b1 0.00 0.9961
 /begin AXIS_DESCR COM_AXIS InjSys_tEngStrt Temp_Cels 8 -3549.940 3003.560 FORMAT "%8.3" AXIS_PTS_REF InjSys_tEngStrt08_AX /end AXIS_DESCR
 /begin AXIS_DESCR COM_AXIS InjSys_tEng Temp_Cels 8 -3549.940 3003.560 FORMAT "%8.3" AXIS_PTS_REF InjSys_tEng08_AX /end AXIS_DESCR
/end CHARACTERISTIC
/begin CHARACTERISTIC InjSys_P3V5I1_HPZ.flgAxVers_C "class instance packet 3 variant 5 / condition map selection with group axis in version 2" VALUE 0x8056C4DC RB_Val_Wu8 1.00000000000 B_TRUE 0.00 1.00000000000 FORMAT "%13.11" /end CHARACTERISTIC
/begin CHARACTERISTIC InjSys_P3V5I1_HPZ.ratFuMBasHiExtd_GM "class instance packet 3 variant 5 / relative fuel mass base injection for interpolation" MAP 0x8056C4DD RB_MapGroup_U8 47.81 rel_q0p1875 0.00 47.81 FORMAT "%5.2"
 /begin AXIS_DESCR COM_AXIS Epm_nEng EngN 12 0.00 16383.50 FORMAT "%8.2" EXTENDED_LIMITS -16384.00 16383.50 AXIS_PTS_REF InjSys_nEng12Vers2_AX /end AXIS_DESCR
 /begin AXIS_DESCR COM_AXIS InjSys_ratAirMVers2AxisInp rel_uw_q0p0234 12 0.00 1535.977 FORMAT "%8.3" AXIS_PTS_REF InjSys_ratAirM12Vers2_AX /end AXIS_DESCR
/end CHARACTERISTIC
/begin CHARACTERISTIC InjSys_P3V5I1_HPZ.ratFuMBasHi_GM "class instance packet 3 variant 5 / relative fuel mass base injection for interpolation" MAP 0x8056C56D RB_MapGroup_U8 47.81 rel_q0p1875 0.00 47.81 FORMAT "%5.2"
 /begin AXIS_DESCR COM_AXIS Epm_nEng EngN 10 0.00 16383.50 FORMAT "%8.2" EXTENDED_LIMITS -16384.00 16383.50 AXIS_PTS_REF InjSys_nEng10_AX /end AXIS_DESCR
 /begin AXIS_DESCR COM_AXIS InjSys_ratAirMAxisInp rel_uw_q0p0234 8 0.00 1535.977 FORMAT "%8.3" AXIS_PTS_REF InjSys_ratAirM08_AX /end AXIS_DESCR
/end CHARACTERISTIC
/begin CHARACTERISTIC InjSys_P3V5I1_HPZ.ratFuMBasLoExtd_GM "class instance packet 3 variant 5 / relative fuel mass base injection for interpolation" MAP 0x8056C5BD RB_MapGroup_U8 47.81 rel_q0p1875 0.00 47.81 FORMAT "%5.2"
 /begin AXIS_DESCR COM_AXIS Epm_nEng EngN 12 0.00 16383.50 FORMAT "%8.2" EXTENDED_LIMITS -16384.00 16383.50 AXIS_PTS_REF InjSys_nEng12Vers2_AX /end AXIS_DESCR
 /begin AXIS_DESCR COM_AXIS InjSys_ratAirMVers2AxisInp rel_uw_q0p0234 12 0.00 1535.977 FORMAT "%8.3" AXIS_PTS_REF InjSys_ratAirM12Vers2_AX /end AXIS_DESCR
/end CHARACTERISTIC
/begin CHARACTERISTIC InjSys_P3V5I1_HPZ.ratFuMBasLo_GM "class instance packet 3 variant 5 / relative fuel mass base injection for interpolation" MAP 0x8056C64D RB_MapGroup_U8 47.81 rel_q0p1875 0.00 47.81 FORMAT "%5.2"
 /begin AXIS_DESCR COM_AXIS Epm_nEng EngN 10 0.00 16383.50 FORMAT "%8.2" EXTENDED_LIMITS -16384.00 16383.50 AXIS_PTS_REF InjSys_nEng10_AX /end AXIS_DESCR
 /begin AXIS_DESCR COM_AXIS InjSys_ratAirMAxisInp rel_uw_q0p0234 8 0.00 1535.977 FORMAT "%8.3" AXIS_PTS_REF InjSys_ratAirM08_AX /end AXIS_DESCR
/end CHARACTERISTIC
/begin CHARACTERISTIC InjSys_P3V5I2_HPZ.agDeltaOffsVers2_GM "injection packet 3 in variant 5 / delta angle offset" MAP 0x80562DE0 RB_MapGroup_S8 95.63 kw_q0p375 -48.00 47.63 FORMAT "%5.2"
 /begin AXIS_DESCR COM_AXIS Epm_nEng EngN 10 0.00 16383.50 FORMAT "%8.2" EXTENDED_LIMITS -16384.00 16383.50 AXIS_PTS_REF InjSys_nEng10Vers2_AX /end AXIS_DESCR
 /begin AXIS_DESCR COM_AXIS InjSys_ratAirMAgSpVers2AxisInp rel_uw_q0p0234 12 0.00 1535.977 FORMAT "%8.3" AXIS_PTS_REF InjSys_ratAirM12AgSpHspVers2_AX /end AXIS_DESCR
/end CHARACTERISTIC
/begin CHARACTERISTIC InjSys_P3V5I2_HPZ.agDeltaOffs_GM "injection packet 3 in variant 5 / delta angle offset" MAP 0x80562E58 RB_MapGroup_S8 95.63 kw_q0p375 -48.00 47.63 FORMAT "%5.2"
 /begin AXIS_DESCR COM_AXIS Epm_nEng EngN 10 0.00 16383.50 FORMAT "%8.2" EXTENDED_LIMITS -16384.00 16383.50 AXIS_PTS_REF InjSys_nEng10_AX /end AXIS_DESCR
 /begin AXIS_DESCR COM_AXIS InjSys_ratAirMAgSpAxisInp rel_uw_q0p0234 12 0.00 1535.977 FORMAT "%8.3" AXIS_PTS_REF InjSys_ratAirM12AgSpHsp_AX /end AXIS_DESCR
/end CHARACTERISTIC
/begin CHARACTERISTIC InjSys_P3V5I2_HPZ.agDeltaVers2_GM "injection packet 3 in variant 5 / delta angle" MAP 0x80562ED0 RB_MapGroup_S8 95.63 kw_q0p375 -48.00 47.63 FORMAT "%5.2"
 /begin AXIS_DESCR COM_AXIS Epm_nEng EngN 10 0.00 16383.50 FORMAT "%8.2" EXTENDED_LIMITS -16384.00 16383.50 AXIS_PTS_REF InjSys_nEng10Vers2_AX /end AXIS_DESCR
 /begin AXIS_DESCR COM_AXIS InjSys_ratAirMAgSpVers2AxisInp rel_uw_q0p0234 12 0.00 1535.977 FORMAT "%8.3" AXIS_PTS_REF InjSys_ratAirM12AgSpHspVers2_AX /end AXIS_DESCR
/end CHARACTERISTIC
/begin CHARACTERISTIC InjSys_P3V5I2_HPZ.agDelta_GM "injection packet 3 in variant 5 / delta angle" MAP 0x80562F48 RB_MapGroup_S8 95.63 kw_q0p375 -48.00 47.63 FORMAT "%5.2"
 /begin AXIS_DESCR COM_AXIS Epm_nEng EngN 10 0.00 16383.50 FORMAT "%8.2" EXTENDED_LIMITS -16384.00 16383.50 AXIS_PTS_REF InjSys_nEng10_AX /end AXIS_DESCR
 /begin AXIS_DESCR COM_AXIS InjSys_ratAirMAgSpAxisInp rel_uw_q0p0234 12 0.00 1535.977 FORMAT "%8.3" AXIS_PTS_REF InjSys_ratAirM12AgSpHsp_AX /end AXIS_DESCR
/end CHARACTERISTIC
/begin CHARACTERISTIC InjSys_P3V5I2_HPZ.facSpltBasCorrnLoT_GM "injection packet 3 in variant 5 / split factor correction base injection dependent of temperature and number of injections" MAP 0x80562FC0 RB_MapGroup_U8 1.992188 fak_ub_b2 0.00 1.992188 FORMAT "%8.6"
 /begin AXIS_DESCR COM_AXIS InjSys_tEng Temp_Cels 8 -3549.940 3003.560 FORMAT "%8.3" AXIS_PTS_REF InjSys_tEng08_AX /end AXIS_DESCR
 /begin AXIS_DESCR COM_AXIS InjSys_nrInjLimdLoc dez 8 0.00 65535.00 FORMAT "%8.2" AXIS_PTS_REF InjSys_nrInj08_AX /end AXIS_DESCR
/end CHARACTERISTIC
/begin CHARACTERISTIC InjSys_P3V5I2_HPZ.facWghtAg_T "injection packet 3 in variant 5 / weighting factor angle" CURVE 0x80563000 RB_Curve_S16_U8_Static 1.992188 fak_ub_b2 0.00 1.992188 FORMAT "%8.6"
 /begin AXIS_DESCR STD_AXIS InjSys_tEng Temp_Cels 6 -3549.940 3003.560 FORMAT "%8.3" DEPOSIT ABSOLUTE /end AXIS_DESCR
/end CHARACTERISTIC
/begin CHARACTERISTIC InjSys_P3V5I2_HPZ.facWghtSpltBasT_GM "injection packet 3 in variant 5 / weighting factor split base injection" MAP 0x80563014 RB_MapGroup_U8 0.9961 fak_ub_b1 0.00 0.9961
 /begin AXIS_DESCR COM_AXIS InjSys_tEngStrt Temp_Cels 8 -3549.940 3003.560 FORMAT "%8.3" AXIS_PTS_REF InjSys_tEngStrt08_AX /end AXIS_DESCR
 /begin AXIS_DESCR COM_AXIS InjSys_tEng Temp_Cels 8 -3549.940 3003.560 FORMAT "%8.3" AXIS_PTS_REF InjSys_tEng08_AX /end AXIS_DESCR
/end CHARACTERISTIC
/begin CHARACTERISTIC InjSys_P3V5I2_HPZ.flgAxVers_C "injection packet 3 in variant 5 / condition map selection with group axis in version 2" VALUE 0x80563054 RB_Val_Wu8 1.00000000000 B_TRUE 0.00 1.00000000000 FORMAT "%13.11" /end CHARACTERISTIC
/begin CHARACTERISTIC InjSys_P3V5I2_HPZ.ratFuMBasHiExtd_GM "injection packet 3 in variant 5 / relative fuel mass base injection for interpolation" MAP 0x80563055 RB_MapGroup_U8 47.81 rel_q0p1875 0.00 47.81 FORMAT "%5.2"
 /begin AXIS_DESCR COM_AXIS Epm_nEng EngN 12 0.00 16383.50 FORMAT "%8.2" EXTENDED_LIMITS -16384.00 16383.50 AXIS_PTS_REF InjSys_nEng12Vers2_AX /end AXIS_DESCR
 /begin AXIS_DESCR COM_AXIS InjSys_ratAirMVers2AxisInp rel_uw_q0p0234 12 0.00 1535.977 FORMAT "%8.3" AXIS_PTS_REF InjSys_ratAirM12Vers2_AX /end AXIS_DESCR
/end CHARACTERISTIC
/begin CHARACTERISTIC InjSys_P3V5I2_HPZ.ratFuMBasHi_GM "injection packet 3 in variant 5 / relative fuel mass base injection for interpolation" MAP 0x805630E5 RB_MapGroup_U8 47.81 rel_q0p1875 0.00 47.81 FORMAT "%5.2"
 /begin AXIS_DESCR COM_AXIS Epm_nEng EngN 10 0.00 16383.50 FORMAT "%8.2" EXTENDED_LIMITS -16384.00 16383.50 AXIS_PTS_REF InjSys_nEng10_AX /end AXIS_DESCR
 /begin AXIS_DESCR COM_AXIS InjSys_ratAirMAxisInp rel_uw_q0p0234 8 0.00 1535.977 FORMAT "%8.3" AXIS_PTS_REF InjSys_ratAirM08_AX /end AXIS_DESCR
/end CHARACTERISTIC
/begin CHARACTERISTIC InjSys_P3V5I2_HPZ.ratFuMBasLoExtd_GM "injection packet 3 in variant 5 / relative fuel mass base injection for interpolation" MAP 0x80563135 RB_MapGroup_U8 47.81 rel_q0p1875 0.00 47.81 FORMAT "%5.2"
 /begin AXIS_DESCR COM_AXIS Epm_nEng EngN 12 0.00 16383.50 FORMAT "%8.2" EXTENDED_LIMITS -16384.00 16383.50 AXIS_PTS_REF InjSys_nEng12Vers2_AX /end AXIS_DESCR
 /begin AXIS_DESCR COM_AXIS InjSys_ratAirMVers2AxisInp rel_uw_q0p0234 12 0.00 1535.977 FORMAT "%8.3" AXIS_PTS_REF InjSys_ratAirM12Vers2_AX /end AXIS_DESCR
/end CHARACTERISTIC
/begin CHARACTERISTIC InjSys_P3V5I2_HPZ.ratFuMBasLo_GM "injection packet 3 in variant 5 / relative fuel mass base injection for interpolation" MAP 0x805631C5 RB_MapGroup_U8 47.81 rel_q0p1875 0.00 47.81 FORMAT "%5.2"
 /begin AXIS_DESCR COM_AXIS Epm_nEng EngN 10 0.00 16383.50 FORMAT "%8.2" EXTENDED_LIMITS -16384.00 16383.50 AXIS_PTS_REF InjSys_nEng10_AX /end AXIS_DESCR
 /begin AXIS_DESCR COM_AXIS InjSys_ratAirMAxisInp rel_uw_q0p0234 8 0.00 1535.977 FORMAT "%8.3" AXIS_PTS_REF InjSys_ratAirM08_AX /end AXIS_DESCR
/end CHARACTERISTIC
/begin CHARACTERISTIC InjSys_PktIfIni.stDummy_C "class instance for initialization / dummy parameter for sw integration without any functional impact" VALUE 0x8056C6A4 RB_Val_Wu8 1.00000000000 B_TRUE 0.00 1.00000000000 FORMAT "%13.11" /end CHARACTERISTIC
/begin AXIS_PTS InjSys_ratAirM08_AX "base point distribution relative air mass with 8 base points" 0x805586E8 InjSys_ratAirMAxisInp RB_Axis_U16 1535.977 rel_uw_q0p0234 8 0.00 1535.977 FORMAT "%8.3" DEPOSIT ABSOLUTE /end AXIS_PTS
/begin AXIS_PTS InjSys_ratAirM12AgSpHspVers2_AX "base point distribution relative air mass with 12 base points (Version 2 HSP Mode)" 0x805586FA InjSys_ratAirMAgSpVers2AxisInp RB_Axis_U16 1535.977 rel_uw_q0p0234 12 0.00 1535.977 FORMAT "%8.3" DEPOSIT ABSOLUTE /end AXIS_PTS
/begin AXIS_PTS InjSys_ratAirM12AgSpHsp_AX "base point distribution relative air mass with 12 base points (HSP Mode)" 0x80558714 InjSys_ratAirMAgSpAxisInp RB_Axis_U16 1535.977 rel_uw_q0p0234 12 0.00 1535.977 FORMAT "%8.3" DEPOSIT ABSOLUTE /end AXIS_PTS
/begin AXIS_PTS InjSys_ratAirM12Vers2_AX "base point distribution relative air mass with 12 base points" 0x8055877C InjSys_ratAirMVers2AxisInp RB_Axis_U16 1535.977 rel_uw_q0p0234 12 0.00 1535.977 FORMAT "%8.3" DEPOSIT ABSOLUTE /end AXIS_PTS
/begin CHARACTERISTIC InjSys_ratFuMAppl_C "calibration value for relative fuel mass" VALUE 0x8056D1BC RB_Val_Wu16 3071.953 rel_uw_b3072 0.00 3071.953 FORMAT "%8.3" /end CHARACTERISTIC
/begin CHARACTERISTIC InjSys_ratFuMMinUnderBascCvo_C "Minimally allowed under threshold CVO basic adaption relative fuel mass" VALUE 0x8056D1BE RB_Val_Wu16 3071.953 rel_uw_b3072 0.00 3071.953 FORMAT "%8.3" /end CHARACTERISTIC
/begin CHARACTERISTIC InjSys_ratFuMMinUpperBascCvo_C "Minimally allowed upper threshold CVO basic adaption relativ fuel mass" VALUE 0x8056D1C0 RB_Val_Wu16 3071.953 rel_uw_b3072 0.00 3071.953 FORMAT "%8.3" /end CHARACTERISTIC
/begin CHARACTERISTIC InjSys_ratFuMTransSctnHys_C "Relative fuel mass hysteresis transition area" VALUE 0x8056C6BC RB_Val_Wu16 3071.953 rel_uw_b3072 0.00 3071.953 FORMAT "%8.3" /end CHARACTERISTIC
/begin CHARACTERISTIC InjSys_stEnaFuMCorrnBascAdpn_C "enabling of fuel mass correction during CVO basic adation" VALUE 0x8056D1F7 RB_Val_Wu8 255.0 dez 0.00 255.0 FORMAT "%5.1" /end CHARACTERISTIC
/begin AXIS_PTS InjSys_stInjMod_AX "base point distribution current injection mode" 0x805596BE NO_INPUT_QUANTITY RB_Axis_U8 19.0000000000 InjSys_InjMode_Set_COMPU_VERB 20 0.00 19.0000000000 FORMAT "%13.10" DEPOSIT ABSOLUTE /end AXIS_PTS
/begin CHARACTERISTIC InjSys_stInjSpAppl_C "local codeword for calibration interface" VALUE 0x805599D8 RB_Val_Wu8 255.0 dez 0.00 255.0 FORMAT "%5.1" /end CHARACTERISTIC
/begin CHARACTERISTIC InjSys_stInjTi_C "code word InjTi" VALUE 0x8056C868 RB_Val_Wu8 255.0 dez 0.00 255.0 FORMAT "%5.1" /end CHARACTERISTIC
/begin CHARACTERISTIC InjSys_stMixCorrn_C "Code word for mixture correction" VALUE 0x8056D1B1 RB_Val_Wu8 255.0 dez 0.00 255.0 FORMAT "%5.1" /end CHARACTERISTIC
/begin AXIS_PTS InjSys_tEng08_AX "base point distribution for engine temperature with 8 base points" 0x805587CA InjSys_tEng RB_Axis_S16 6553.500 Temp_Cels 8 -3549.940 3003.560 FORMAT "%8.3" DEPOSIT ABSOLUTE /end AXIS_PTS
/begin CHARACTERISTIC InjSys_tEngMaxTPist_C "Maximum engine temperature below which TSA feature is enabled" VALUE 0x805599DA RB_Val_Ws16 6553.500 Temp_Cels -3549.940 3003.560 FORMAT "%8.3" /end CHARACTERISTIC
/begin CHARACTERISTIC InjSys_tEngMinTPist_C "Minimum engine temperature above which TSA feature is enabled" VALUE 0x805599DC RB_Val_Ws16 6553.500 Temp_Cels -3549.940 3003.560 FORMAT "%8.3" /end CHARACTERISTIC
/begin AXIS_PTS InjSys_tEngStrt08_AX "Base point distribution for engine temperature at start with 8 base points" 0x805587DC InjSys_tEngStrt RB_Axis_S16 6553.500 Temp_Cels 8 -3549.940 3003.560 FORMAT "%8.3" DEPOSIT ABSOLUTE /end AXIS_PTS
/begin CHARACTERISTIC InjSys_tiBreakInjCvo_C "Break time from CVO additional injection before the first injection" VALUE 0x8056D1F8 RB_Val_Wu16 65.53500 t_q0p001_ms 0.00 65.53500 FORMAT "%8.5" /end CHARACTERISTIC
/begin CHARACTERISTIC InjSys_tiBreakMin_C "shortest pause duration between two injections" VALUE 0x805599DE RB_Val_Ws16 1310.680 t_q0p04_ms 0.00 1310.680 FORMAT "%8.3" EXTENDED_LIMITS -1310.720 1310.680 /end CHARACTERISTIC
/begin CHARACTERISTIC InjSys_tiBreakMin_T "Minimum dwell time between injection pulses dependent on temperature" CURVE 0x805599E0 RB_Curve_U8_S16_Static 1310.680 t_q0p04_ms 0.00 1310.680 FORMAT "%8.3" EXTENDED_LIMITS -1310.720 1310.680
 /begin AXIS_DESCR STD_AXIS InjSys_tInjVlvLocSp temp_ub_q0p75_o48 6 -48.0 143.3 FORMAT "%5.1" DEPOSIT ABSOLUTE /end AXIS_DESCR
/end CHARACTERISTIC
/begin CHARACTERISTIC InjSys_tiBreakOffsBall_T "pause time offset for ballistic injection" CURVE 0x8056C78A RB_Curve_S16_S16 26.21400 t_q0p0004_ms -13.10720 13.10680 FORMAT "%8.5"
 /begin AXIS_DESCR STD_AXIS NO_INPUT_QUANTITY t_q0p001_ms 6 -32.76800 32.76700 FORMAT "%8.5" DEPOSIT ABSOLUTE /end AXIS_DESCR
/end CHARACTERISTIC
/begin CHARACTERISTIC InjSys_tiBreakOffs_T "Correction of pause time effects (full range)" CURVE 0x8056C7A4 RB_Curve_S16_S16 26.21400 t_q0p0004_ms -13.10720 13.10680 FORMAT "%8.5"
 /begin AXIS_DESCR STD_AXIS NO_INPUT_QUANTITY t_q0p001_ms 6 -32.76800 32.76700 FORMAT "%8.5" DEPOSIT ABSOLUTE /end AXIS_DESCR
/end CHARACTERISTIC
/begin CHARACTERISTIC InjSys_tiDeltaEndBall_C "Delta injection time end of ballistic range" VALUE 0x8056D1C2 RB_Val_Ws16 65.53500 t_q0p001_ms -32.76800 32.76700 FORMAT "%8.5" /end CHARACTERISTIC
/begin CHARACTERISTIC InjSys_tiInjNlnrHiResl_T "injection time non-linear, high resolution" CURVE 0x8056C86A RB_Curve_U16_U16 26.21400 t_q0p0004_ms 0.00 26.21400 FORMAT "%8.5"
 /begin AXIS_DESCR STD_AXIS NO_INPUT_QUANTITY t_q0p0004_ms 30 0.00 26.21400 FORMAT "%8.5" DEPOSIT ABSOLUTE /end AXIS_DESCR
/end CHARACTERISTIC
/begin CHARACTERISTIC InjSys_tiInjNlnrIvsHiResl_T "injection time non-linear inverse, high resolution" CURVE 0x8056C8E4 RB_Curve_U16_U16 26.21400 t_q0p0004_ms 0.00 26.21400 FORMAT "%8.5"
 /begin AXIS_DESCR STD_AXIS InjSys_tiInjNlnrMaxHiResl t_q0p0004_ms 30 0.00 26.21400 FORMAT "%8.5" DEPOSIT ABSOLUTE /end AXIS_DESCR
/end CHARACTERISTIC
/begin CHARACTERISTIC InjSys_tiInjOpenHiResl_T "map of open time of injection valve" CURVE 0x8056C95E RB_Curve_U16_U16 26.21400 t_q0p0004_ms 0.00 26.21400 FORMAT "%8.5"
 /begin AXIS_DESCR STD_AXIS NO_INPUT_QUANTITY t_q0p0004_ms 10 0.00 26.21400 FORMAT "%8.5" DEPOSIT ABSOLUTE /end AXIS_DESCR
/end CHARACTERISTIC
/begin CHARACTERISTIC InjSys_tiInjOpenIvsHiResl_T "Injection valve desired time open inverse" CURVE 0x8056C988 RB_Curve_U16_U16 26.21400 t_q0p0004_ms 0.00 26.21400 FORMAT "%8.5"
 /begin AXIS_DESCR STD_AXIS InjSys_tiInjOpenMaxHiResl t_q0p0004_ms 10 0.00 26.21400 FORMAT "%8.5" DEPOSIT ABSOLUTE /end AXIS_DESCR
/end CHARACTERISTIC
/begin CHARACTERISTIC InjSys_tiInjOpenMaxBall_C "maximally injection open time valve in the ballistic area" VALUE 0x8056D1FA RB_Val_Wu16 65.53500 t_q0p001_ms 0.00 65.53500 FORMAT "%8.5" /end CHARACTERISTIC
/begin CHARACTERISTIC InjSys_tiInjOpenMinBall_C "minimally injection open time valve in the ballistic area" VALUE 0x8056D1FC RB_Val_Wu16 65.53500 t_q0p001_ms 0.00 65.53500 FORMAT "%8.5" /end CHARACTERISTIC
/begin CHARACTERISTIC InjSys_tiInjOpenMinLnr_C "minimally injection open time valve in the linear area" VALUE 0x8056D1FE RB_Val_Wu16 65.53500 t_q0p001_ms 0.00 65.53500 FORMAT "%8.5" /end CHARACTERISTIC
/begin CHARACTERISTIC InjSys_tiInjOpenMinMaiInj_C "minimal injection time open valve main injection" VALUE 0x8056D200 RB_Val_Wu16 65.53500 t_q0p001_ms 0.00 65.53500 FORMAT "%8.5" /end CHARACTERISTIC
/begin CHARACTERISTIC InjSys_tiInjrPOffs_T "injection time offset depending on injector pressure difference" CURVE 0x8056C7BE RB_Curve_U16_S16_Static 26.21400 t_q0p0004_ms -13.10720 13.10680 FORMAT "%8.5"
 /begin AXIS_DESCR STD_AXIS NO_INPUT_QUANTITY RBPtCel_p_0p002_1 6 0.00 131.0700 FORMAT "%8.4" DEPOSIT ABSOLUTE /end AXIS_DESCR
/end CHARACTERISTIC
/begin CHARACTERISTIC InjSys_tiInjSyn0Appl_CA "calibration interface for injection time S0 timing" VAL_BLK 0x8056C9B4 RB_ValA_Wu32 1717986.91800 t_q0p0004_ms 0.00 1717986.91800 FORMAT "%13.5" NUMBER 4 /end CHARACTERISTIC
/begin CHARACTERISTIC InjSys_tiInjSyn1Appl_CA "calibration interface for injection time S1 timing" VAL_BLK 0x8056C9C4 RB_ValA_Wu32 1717986.91800 t_q0p0004_ms 0.00 1717986.91800 FORMAT "%13.5" NUMBER 4 /end CHARACTERISTIC
/begin CHARACTERISTIC InjSys_tiOpenMaxBall_C "Maximum value injection open time in ballistic range" VALUE 0x8056C9D4 RB_Val_Wu16 65.53500 t_q0p001_ms 0.00 65.53500 FORMAT "%8.5" /end CHARACTERISTIC
/begin CHARACTERISTIC InjSys_tiOpenMinFullLft_C "Minimum value injection open time in full lift range" VALUE 0x8056C9D6 RB_Val_Wu16 65.53500 t_q0p001_ms 0.00 65.53500 FORMAT "%8.5" /end CHARACTERISTIC
/begin CHARACTERISTIC InjSys_tiOpenMinMiCvo_C "Minimum value injection open time for CVO torque reserve request" VALUE 0x8056D1C4 RB_Val_Wu16 65.53500 t_q0p001_ms 0.00 65.53500 FORMAT "%8.5" /end CHARACTERISTIC
/begin CHARACTERISTIC InjSys_tiOpenMinUndrBascCvo_C "Minimally allowed under threshold CVO basic adaption injection" VALUE 0x8056D1C6 RB_Val_Wu16 26.21400 t_q0p0004_ms 0.00 26.21400 FORMAT "%8.5" /end CHARACTERISTIC
/begin CHARACTERISTIC InjSys_tiOpenMinUpprBascCvo_C "Minimally allowed upper threshold CVO basic adaption injection" VALUE 0x8056D1C8 RB_Val_Wu16 26.21400 t_q0p0004_ms 0.00 26.21400 FORMAT "%8.5" /end CHARACTERISTIC
/begin CHARACTERISTIC InjSys_tiOpenRefCvo_C "Injection open time reference point CVO" VALUE 0x8056D1CA RB_Val_Wu16 65.53500 t_q0p001_ms 0.00 65.53500 FORMAT "%8.5" /end CHARACTERISTIC
/begin CHARACTERISTIC InjSys_vfStatyInjr_C "stationary volume flow injector" VALUE 0x8056C7D8 RB_Val_Wu16 409.5938 vol_q0p00625_ml_DIV_s 0.00 409.5938 FORMAT "%8.4" /end CHARACTERISTIC
/begin CHARACTERISTIC InjVlvPs_DCDC_SETPNTVOLT_C "Desired booster voltage" VALUE 0x80506058 KwUw 55.00000 spg_q0p1 12.00000 67.00000 FORMAT "%8.5" EXTENDED_LIMITS 0.00 6553.500 READ_ONLY /end CHARACTERISTIC
/begin CHARACTERISTIC InjVlvPs_Dia_AbmNoLd "Suppression-Mask for Error: OpenLoad" VAL_BLK 0x805915A0 ValA_Wu8 255.0 OneToOne 0.00 255.0 FORMAT "%5.1" NUMBER 4 /end CHARACTERISTIC
/begin CHARACTERISTIC InjVlvPs_Dia_AbmScBnk "Suppression-Mask for Error: Short Circuit On Bank (HighSide)" VAL_BLK 0x805915A4 ValA_Wu8 255.0 OneToOne 0.00 255.0 FORMAT "%5.1" NUMBER 4 /end CHARACTERISTIC
/begin CHARACTERISTIC InjVlvPs_Dia_AbmScCyl "Suppression-Mask for Error: Short Circuit On Cylinder (LowSide)" VAL_BLK 0x805915A8 ValA_Wu8 255.0 OneToOne 0.00 255.0 FORMAT "%5.1" NUMBER 4 /end CHARACTERISTIC
/begin CHARACTERISTIC InjVlvPs_Dia_AbmScHsLs "Suppression-Mask for Error: Short Circuit between High- and LowSide" VAL_BLK 0x805915AC ValA_Wu8 255.0 OneToOne 0.00 255.0 FORMAT "%5.1" NUMBER 4 /end CHARACTERISTIC
/begin CHARACTERISTIC InjVlvPs_Dset0_iBoost_max_C "Upper limit of the booster current" VALUE 0x8050605C KwSl 4294967295.00 i_q1_mA -2147483648.00 2147483647.00 FORMAT "%13.2" /end CHARACTERISTIC
/begin CHARACTERISTIC InjVlvPs_Dset0_iBoost_min_C "Lower limit of the booster current" VALUE 0x80506060 KwSl 4294967295.00 i_q1_mA -2147483648.00 2147483647.00 FORMAT "%13.2" /end CHARACTERISTIC
/begin CHARACTERISTIC InjVlvPs_Dset0_iDcdcChrg_max_C "Upper limit of the DCDC-charge current" VALUE 0x80506064 KwSl 4294967295.00 i_q1_mA -2147483648.00 2147483647.00 FORMAT "%13.2" /end CHARACTERISTIC
/begin CHARACTERISTIC InjVlvPs_Dset0_iDcdcChrg_min_C "Lower limit of the DCDC-charge current" VALUE 0x80506068 KwSl 4294967295.00 i_q1_mA -2147483648.00 2147483647.00 FORMAT "%13.2" /end CHARACTERISTIC
/begin CHARACTERISTIC InjVlvPs_Dset0_iHold_max_C "Upper limit of the holding current" VALUE 0x8050606C KwSl 4294967295.00 i_q1_mA -2147483648.00 2147483647.00 FORMAT "%13.2" /end CHARACTERISTIC
/begin CHARACTERISTIC InjVlvPs_Dset0_iHold_min_C "Lower limit of the holding current" VALUE 0x80506070 KwSl 4294967295.00 i_q1_mA -2147483648.00 2147483647.00 FORMAT "%13.2" /end CHARACTERISTIC
/begin CHARACTERISTIC InjVlvPs_Dset0_iPull_max_C "Upper limit of the pick up current" VALUE 0x80506074 KwSl 4294967295.00 i_q1_mA -2147483648.00 2147483647.00 FORMAT "%13.2" /end CHARACTERISTIC
/begin CHARACTERISTIC InjVlvPs_Dset0_iPull_min_C "Lower limit of the pick up current" VALUE 0x80506078 KwSl 4294967295.00 i_q1_mA -2147483648.00 2147483647.00 FORMAT "%13.2" /end CHARACTERISTIC
/begin CHARACTERISTIC InjVlvPs_Dset0_numBoosts_C "Number of booster pulses" VALUE 0x8050607C KwUb 255.0 dez 0.00 255.0 FORMAT "%5.1" /end CHARACTERISTIC
/begin CHARACTERISTIC InjVlvPs_Dset0_tiBoost_C "Maximum booster time" VALUE 0x80506080 KwUl 4294967295.00 t_q1p0_us 0.00 4294967295.00 FORMAT "%13.2" /end CHARACTERISTIC
/begin CHARACTERISTIC InjVlvPs_Dset0_tiPull_C "End of the pick up phase after start of injection" VALUE 0x80506084 KwUl 4294967295.00 t_q1p0_us 0.00 4294967295.00 FORMAT "%13.2" /end CHARACTERISTIC
/begin CHARACTERISTIC InjVlvPs_Dset1_iBoost_max_C "Upper limit of the booster current" VALUE 0x80506088 KwSl 4294967295.00 i_q1_mA -2147483648.00 2147483647.00 FORMAT "%13.2" /end CHARACTERISTIC
/begin CHARACTERISTIC InjVlvPs_Dset1_iBoost_min_C "Lower limit of the booster current" VALUE 0x8050608C KwSl 4294967295.00 i_q1_mA -2147483648.00 2147483647.00 FORMAT "%13.2" /end CHARACTERISTIC
/begin CHARACTERISTIC InjVlvPs_Dset1_iDcdcChrg_max_C "Upper limit of the DCDC-charge current" VALUE 0x80506090 KwSl 4294967295.00 i_q1_mA -2147483648.00 2147483647.00 FORMAT "%13.2" /end CHARACTERISTIC
/begin CHARACTERISTIC InjVlvPs_Dset1_iDcdcChrg_min_C "Lower limit of the DCDC-charge current" VALUE 0x80506094 KwSl 4294967295.00 i_q1_mA -2147483648.00 2147483647.00 FORMAT "%13.2" /end CHARACTERISTIC
/begin CHARACTERISTIC InjVlvPs_Dset1_iHold_max_C "Upper limit of the holding current" VALUE 0x80506098 KwSl 4294967295.00 i_q1_mA -2147483648.00 2147483647.00 FORMAT "%13.2" /end CHARACTERISTIC
/begin CHARACTERISTIC InjVlvPs_Dset1_iHold_min_C "Lower limit of the holding current" VALUE 0x8050609C KwSl 4294967295.00 i_q1_mA -2147483648.00 2147483647.00 FORMAT "%13.2" /end CHARACTERISTIC
/begin CHARACTERISTIC InjVlvPs_Dset1_iPull_max_C "Upper limit of the pick up current" VALUE 0x805060A0 KwSl 4294967295.00 i_q1_mA -2147483648.00 2147483647.00 FORMAT "%13.2" /end CHARACTERISTIC
/begin CHARACTERISTIC InjVlvPs_Dset1_iPull_min_C "Lower limit of the pick up current" VALUE 0x805060A4 KwSl 4294967295.00 i_q1_mA -2147483648.00 2147483647.00 FORMAT "%13.2" /end CHARACTERISTIC
/begin CHARACTERISTIC InjVlvPs_Dset1_numBoosts_C "Number of booster pulses" VALUE 0x805060A8 KwUb 255.0 dez 0.00 255.0 FORMAT "%5.1" /end CHARACTERISTIC
/begin CHARACTERISTIC InjVlvPs_Dset1_tiBoost_C "Maximum booster time" VALUE 0x805060AC KwUl 4294967295.00 t_q1p0_us 0.00 4294967295.00 FORMAT "%13.2" /end CHARACTERISTIC
/begin CHARACTERISTIC InjVlvPs_Dset1_tiPull_C "End of the pick up phase after start of injection" VALUE 0x805060B0 KwUl 4294967295.00 t_q1p0_us 0.00 4294967295.00 FORMAT "%13.2" /end CHARACTERISTIC
/begin CHARACTERISTIC InjVlvPs_Dset2_iBoost_max_C "Upper limit of the booster current" VALUE 0x805060B4 KwSl 4294967295.00 i_q1_mA -2147483648.00 2147483647.00 FORMAT "%13.2" /end CHARACTERISTIC
/begin CHARACTERISTIC InjVlvPs_Dset2_iBoost_min_C "Lower limit of the booster current" VALUE 0x805060B8 KwSl 4294967295.00 i_q1_mA -2147483648.00 2147483647.00 FORMAT "%13.2" /end CHARACTERISTIC
/begin CHARACTERISTIC InjVlvPs_Dset2_iDcdcChrg_max_C "Upper limit of the DCDC-charge current" VALUE 0x805060BC KwSl 4294967295.00 i_q1_mA -2147483648.00 2147483647.00 FORMAT "%13.2" /end CHARACTERISTIC
/begin CHARACTERISTIC InjVlvPs_Dset2_iDcdcChrg_min_C "Lower limit of the DCDC-charge current" VALUE 0x805060C0 KwSl 4294967295.00 i_q1_mA -2147483648.00 2147483647.00 FORMAT "%13.2" /end CHARACTERISTIC
/begin CHARACTERISTIC InjVlvPs_Dset2_iHold_max_C "Upper limit of the holding current" VALUE 0x805060C4 KwSl 4294967295.00 i_q1_mA -2147483648.00 2147483647.00 FORMAT "%13.2" /end CHARACTERISTIC
/begin CHARACTERISTIC InjVlvPs_Dset2_iHold_min_C "Lower limit of the holding current" VALUE 0x805060C8 KwSl 4294967295.00 i_q1_mA -2147483648.00 2147483647.00 FORMAT "%13.2" /end CHARACTERISTIC
/begin CHARACTERISTIC InjVlvPs_Dset2_iPull_max_C "Upper limit of the pick up current" VALUE 0x805060CC KwSl 4294967295.00 i_q1_mA -2147483648.00 2147483647.00 FORMAT "%13.2" /end CHARACTERISTIC
/begin CHARACTERISTIC InjVlvPs_Dset2_iPull_min_C "Lower limit of the pick up current" VALUE 0x805060D0 KwSl 4294967295.00 i_q1_mA -2147483648.00 2147483647.00 FORMAT "%13.2" /end CHARACTERISTIC
/begin CHARACTERISTIC InjVlvPs_Dset2_numBoosts_C "Number of booster pulses" VALUE 0x805060D4 KwUb 255.0 dez 0.00 255.0 FORMAT "%5.1" /end CHARACTERISTIC
/begin CHARACTERISTIC InjVlvPs_Dset2_tiBoost_C "Maximum booster time" VALUE 0x805060D8 KwUl 4294967295.00 t_q1p0_us 0.00 4294967295.00 FORMAT "%13.2" /end CHARACTERISTIC
/begin CHARACTERISTIC InjVlvPs_Dset2_tiPull_C "End of the pick up phase after start of injection" VALUE 0x805060DC KwUl 4294967295.00 t_q1p0_us 0.00 4294967295.00 FORMAT "%13.2" /end CHARACTERISTIC
/begin CHARACTERISTIC InjVlvPs_FD1SKIP_C "Free Wheeling after Pull" VALUE 0x805060E0 KwUb 255.0 dez 0.00 255.0 FORMAT "%5.1" /end CHARACTERISTIC
/begin CHARACTERISTIC InjVlvPs_numMinCylOk_C "minimum number of intact cylinders required for engine operation" VALUE 0x805915B0 Val_Wu8 255.0 OneToOne 0.00 255.0 FORMAT "%5.1" /end CHARACTERISTIC
/begin CHARACTERISTIC INJVLVPS_UDMAX_C "max. battery threshold for enable CJ840 diagnosis" VALUE 0x805915B2 Val_Wu16 6553.500 spg_q0p1 0.00 6553.500 FORMAT "%8.3" /end CHARACTERISTIC
/begin CHARACTERISTIC INJVLVPS_UDMIN_C "min. battery threshold for enable CJ840 diagnosis" VALUE 0x805915B4 Val_Wu16 6553.500 spg_q0p1 0.00 6553.500 FORMAT "%8.3" /end CHARACTERISTIC
/begin CHARACTERISTIC InjVlv_numBnkTDC_CA "Injection bank in which the cylinder is located (=x-1 for MVxy in the ""Brunnerplan"")" VAL_BLK 0x805060E1 KwbWU8 255.0 dez 0.00 255.0 FORMAT "%5.1" NUMBER 4 /end CHARACTERISTIC
/begin CHARACTERISTIC InjVlv_numStLine_CA "State line number corresponding to the cylinder" VAL_BLK 0x805060E5 KwbWU8 255.0 dez 0.00 255.0 FORMAT "%5.1" NUMBER 4 /end CHARACTERISTIC
/begin CHARACTERISTIC InjVlv_numTDCToINJS_T "ASIC number corresponding to the customer cylinder" CURVE 0x8056D202 RB_Curve_U8_U8 255.0 dez 0.00 255.0 FORMAT "%5.1"
 /begin AXIS_DESCR STD_AXIS NO_INPUT_QUANTITY dez 4 0.00 255.0 FORMAT "%5.1" DEPOSIT ABSOLUTE /end AXIS_DESCR
/end CHARACTERISTIC
/begin CHARACTERISTIC InjVvG_FSC_RetVal_Enum_C "enum from rba_IoSigIfAdapt_Cfg_Fsc.h" VALUE 0x805060E9 KwUb 255.0 dez 0.00 255.0 FORMAT "%5.1" /end CHARACTERISTIC
/begin CHARACTERISTIC IntkAirT_cwSnsrFrzEna_C "Code word for intake air temperature sensor freez enable" VALUE 0x8056D20E RB_Val_Wu8 255.0 OneToOne 0.00 255.0 FORMAT "%5.1" /end CHARACTERISTIC
/begin CHARACTERISTIC IntkAirT_LnrwSnsr1_T "Characteristic line to linearize the intake air temperature of Snsr1 (word)" CURVE 0x8056D210 RB_Curve_U16_S16_Static 6553.500 Temp_Cels -3549.940 3003.560 FORMAT "%8.3"
 /begin AXIS_DESCR STD_AXIS IntkAirT_uSnsr1CrssSwtLoc Volt 20 0.00 5000.000 FORMAT "%8.3" EXTENDED_LIMITS 0.00 13107.00 DEPOSIT ABSOLUTE /end AXIS_DESCR
/end CHARACTERISTIC
/begin CHARACTERISTIC IntkAirT_LnrwSnsr2_T "Characteristic line to linearize the intake air temperature of Snsr2 (word)" CURVE 0x8056D262 RB_Curve_U16_S16_Static 6553.500 Temp_Cels -3549.940 3003.560 FORMAT "%8.3"
 /begin AXIS_DESCR STD_AXIS IntkAirT_uSnsr2CrssSwtLoc Volt 20 0.00 5000.000 FORMAT "%8.3" EXTENDED_LIMITS 0.00 13107.00 DEPOSIT ABSOLUTE /end AXIS_DESCR
/end CHARACTERISTIC
/begin CHARACTERISTIC IntkAirT_mAirMflmaxSnsr1Enad_C "air-mass threshold used for limitation of intake air temperature sensor tfa1 after initialization" VALUE 0x8056D2B4 RB_Val_Wu16 23.30133 m_uw_b23p3 0.00 23.30133 FORMAT "%8.5" /end CHARACTERISTIC
/begin CHARACTERISTIC IntkAirT_mAirMflmaxSnsr2Enad_C "air-mass threshold used for limitation of intake air temperature sensor tfa2 after initialization (SY_TFAKON 0)" VALUE 0x8056D2B6 RB_Val_Wu16 23.30133 m_uw_b23p3 0.00 23.30133 FORMAT "%8.5" /end CHARACTERISTIC
/begin CHARACTERISTIC IntkAirT_mAirMfSnsrElecChk_C "Maximum air mass flow to enable the electrical diagnosis of the intake air temperature sensor" VALUE 0x8056D2B8 RB_Val_Wu8 1020. m_ub_b1020 0.00 1020. FORMAT "%5.0" /end CHARACTERISTIC
/begin CHARACTERISTIC IntkAirT_SnsrLim_CW "Codeword: limitation of intake air temperature signal for sensors mounted in HFM" VALUE 0x8056D2B9 RB_Val_Wu8 255.0 OneToOne 0.00 255.0 FORMAT "%5.1" /end CHARACTERISTIC
/begin CHARACTERISTIC IntkAirT_SRCSnsrLim_CW "Configuration for SignalRangeCheck TFA-Sensor" VALUE 0x8056D2BA RB_Val_Wu8 255.0 OneToOne 0.00 255.0 FORMAT "%5.1" /end CHARACTERISTIC
/begin CHARACTERISTIC IntkAirT_tEngMinRelsElecDiag_C "Minimum engine temperature to enable the electrical check of the intake air temperature sensor" VALUE 0x8056D2BC RB_Val_Ws16 6553.500 Temp_Cels -3549.940 3003.560 FORMAT "%8.3" /end CHARACTERISTIC
/begin CHARACTERISTIC IntkAirT_tEngMinRelsStrtElecDiag_C "engine temperature threshold for enabling the electrical check of TFA-sensor" VALUE 0x8056D2BE RB_Val_Ws16 6553.500 Temp_Cels -3549.940 3003.560 FORMAT "%8.3" /end CHARACTERISTIC
/begin CHARACTERISTIC IntkAirT_tiDebElecFaultSnsr1_C "debonce time for error detection (minmax) for intake air temperature sensor Snsr1" VALUE 0x8056D2C0 RB_Val_Wu8 2.500 t_q0p1 0.00 2.500 FORMAT "%5.3" EXTENDED_LIMITS 0.00 25.50 /end CHARACTERISTIC
/begin CHARACTERISTIC IntkAirT_tiDebElecFaultSnsr2_C "debonce time for error detection (minmax) for intake air temperature sensor Snsr2" VALUE 0x8056D2C1 RB_Val_Wu8 2.500 t_q0p1 0.00 2.500 FORMAT "%5.3" EXTENDED_LIMITS 0.00 25.50 /end CHARACTERISTIC
/begin CHARACTERISTIC IntkAirT_tiDebHealElecFaultSnsr1_C "debonce time for healing of intake air temperature sensor Snsr1 (SY_TFAKON 0)" VALUE 0x8056D2C2 RB_Val_Wu8 25.50 t_q0p1 0.00 25.50 FORMAT "%5.2" /end CHARACTERISTIC
/begin CHARACTERISTIC IntkAirT_tiDebHealElecFaultSnsr2_C "debonce time for healing of intake air temperature sensor Snsr2 (SY_TFAKON 0)" VALUE 0x8056D2C3 RB_Val_Wu8 25.50 t_q0p1 0.00 25.50 FORMAT "%5.2" /end CHARACTERISTIC
/begin CHARACTERISTIC IntkAirT_tiSnsr1DSMCycRprt_C "Freely adjustable IntkAirT Sensor1 specific repetition rate at which diagnostic result should be sent to the DSM" VALUE 0x8056D2DC RB_Val_Wu8 25.50 t_q0p1 0.00 25.50 FORMAT "%5.2" /end CHARACTERISTIC
/begin CHARACTERISTIC IntkAirT_tiSnsr1DSMFrstRprt_C "Time period at which diagnostic result should be sent to the DSM for the first time once DSM is ready (after new start or with DSM clear)" VALUE 0x8056D2DD RB_Val_Wu8 25.50 t_q0p1 0.00 25.50 FORMAT "%5.2" /end CHARACTERISTIC
/begin CHARACTERISTIC IntkAirT_tiSnsr2DSMCycRprt_C "Freely adjustable IntkAirT Sensor2 specific repetition rate at which diagnostic result should be sent to the DSM" VALUE 0x8056D2DE RB_Val_Wu8 25.50 t_q0p1 0.00 25.50 FORMAT "%5.2" /end CHARACTERISTIC
/begin CHARACTERISTIC IntkAirT_tiSnsr2DSMFrstRprt_C "Time period at which diagnostic result should be sent to the DSM for the first time once DSM is ready (after new start or with DSM clear)" VALUE 0x8056D2DF RB_Val_Wu8 25.40 t_q0p1 0.10 25.50 FORMAT "%5.2" EXTENDED_LIMITS 0.00 25.50 /end CHARACTERISTIC
/begin CHARACTERISTIC IntkAirT_TnDebDiagSnsr_C "Debouncing time for enabling the electrical diagnosis of the intake air temperature sensor" VALUE 0x8056D2C4 RB_Val_Wu8 25.50 t_q0p1 0.00 25.50 FORMAT "%5.2" /end CHARACTERISTIC
/begin CHARACTERISTIC IntkAirT_TnJmp1Snsr1_C "Jump-Check intake air temperature sensor Snsr1: debounce time 1 (SY_TFAJEC 0)" VALUE 0x8056D2C5 RB_Val_Wu8 2.500 t_q0p1 0.00 2.500 FORMAT "%5.3" EXTENDED_LIMITS 0.00 25.50 /end CHARACTERISTIC
/begin CHARACTERISTIC IntkAirT_TnJmp1Snsr2_C "Jump-Check intake air temperature sensor Snsr1: debounce time 2 (SY_TFAJEC 0)" VALUE 0x8056D2C6 RB_Val_Wu8 25.50 t_q0p1 0.00 25.50 FORMAT "%5.2" /end CHARACTERISTIC
/begin CHARACTERISTIC IntkAirT_TnJmp2Snsr1_C "Jump-Check intake air temperature sensor Snsr1: debounce time 2 (SY_TFAJEC 0)" VALUE 0x8056D2C7 RB_Val_Wu8 25.50 t_q0p1 0.00 25.50 FORMAT "%5.2" /end CHARACTERISTIC
/begin CHARACTERISTIC IntkAirT_TnJmp2Snsr2_C "Jump-Check intake air temperature sensor Snsr2: debounce time 2 (SY_TFAKON 0 and SY_TFAJEC )" VALUE 0x8056D2C8 RB_Val_Wu8 25.50 t_q0p1 0.00 25.50 FORMAT "%5.2" /end CHARACTERISTIC
/begin CHARACTERISTIC IntkAirT_TnPT1locSnsr1_C "time constant for lowpass filter of IntkAirT_uFildSnsr1" VALUE 0x8056D2C9 RB_Val_Wu8 25.40 t_q0p1 0.10 25.50 FORMAT "%5.2" EXTENDED_LIMITS 0.00 25.50 /end CHARACTERISTIC
/begin CHARACTERISTIC IntkAirT_TnPT1Snsr1_C "time constant for lowpass filter of SnSr1 lin" VALUE 0x8056D2CA RB_Val_Wu8 25.40 t_q0p1 0.10 25.50 FORMAT "%5.2" EXTENDED_LIMITS 0.00 25.50 /end CHARACTERISTIC
/begin CHARACTERISTIC IntkAirT_TnPT1Snsr2_C "time constant for lowpass filter of Snsr2 lin" VALUE 0x8056D2CB RB_Val_Wu8 25.40 t_q0p1 0.10 25.50 FORMAT "%5.2" EXTENDED_LIMITS 0.00 25.50 /end CHARACTERISTIC
/begin CHARACTERISTIC IntkAirT_TnPT2locSnsr2_C "time constant for lowpass filter of wtfa1_w" VALUE 0x8056D2CC RB_Val_Wu8 25.40 t_q0p1 0.10 25.50 FORMAT "%5.2" EXTENDED_LIMITS 0.00 25.50 /end CHARACTERISTIC
/begin CHARACTERISTIC IntkAirT_TolrSrcSnsr1_C "range of tolerance for jump-check intake air temperature sensor Snsr1 (SY_TFAJEC 0)" VALUE 0x8056D2CE RB_Val_Wu16 13107.00 Volt 0.00 13107.00 FORMAT "%8.2" /end CHARACTERISTIC
/begin CHARACTERISTIC IntkAirT_TolrSrcSnsr2_C "range of tolerance for jump-check intake air temperature sensor Snsr2 (SY_TFAJEC 0)" VALUE 0x8056D2D0 RB_Val_Wu16 13107.00 Volt 0.00 13107.00 FORMAT "%8.2" /end CHARACTERISTIC
/begin CHARACTERISTIC IntkAirT_UmaxSnsr1_C "maximum allowed voltage-signal of intake air temperature sensor SnSr1" VALUE 0x8056D2D2 RB_Val_Wu16 13107.00 Volt 0.00 13107.00 FORMAT "%8.2" /end CHARACTERISTIC
/begin CHARACTERISTIC IntkAirT_UmaxSnsr2_C "maximum allowed voltage-signal of intake air temperature sensor Snsr2" VALUE 0x8056D2D4 RB_Val_Wu16 13107.00 Volt 0.00 13107.00 FORMAT "%8.2" /end CHARACTERISTIC
/begin CHARACTERISTIC IntkAirT_UminSnsr1_C "minimum allowed voltage-value of intake air temperature sensor SnSr1" VALUE 0x8056D2D6 RB_Val_Wu16 13107.00 Volt 0.00 13107.00 FORMAT "%8.2" /end CHARACTERISTIC
/begin CHARACTERISTIC IntkAirT_UminSnsr2_C "minimal allowed voltage-signal of intake air temperature sensor Snsr2 (SY_TFAKON 0)" VALUE 0x8056D2D8 RB_Val_Wu16 13107.00 Volt 0.00 13107.00 FORMAT "%8.2" /end CHARACTERISTIC
/begin CHARACTERISTIC IntkAirT_vVehMaxRelsElecDiag_C "Maximum vehicle speed to enable the electrical check of the intake air temperature sensor" VALUE 0x8056D2DA RB_Val_Ws16 655.3500 Vel -327.6800 327.6700 FORMAT "%8.4" /end CHARACTERISTIC
/begin CHARACTERISTIC TANSDE "substitute value air temperature in case of fault" VALUE 0x8056D20C RB_Val_Wu8 191.3 temp_ub_q0p75_o48 -48.0 143.3 FORMAT "%5.1" /end CHARACTERISTIC
/begin CHARACTERISTIC THEALING_C "Waiting time until healing test" VALUE 0x805915B6 Val_Wu16 1310.700 t_q0p02 0.00 1310.700 FORMAT "%8.3" /end CHARACTERISTIC
/begin CHARACTERISTIC TIMINP "minimum injection time" VALUE 0x8056C9D8 RB_Val_Wu16 65.53500 t_q0p001_ms 0.00 65.53500 FORMAT "%8.5" /end CHARACTERISTIC
/begin CHARACTERISTIC TTFANMOT "Delaytime for B_nmot." VALUE 0x8056D20D RB_Val_Wu8 25.50 t_q0p1 0.00 25.50 FORMAT "%5.2" /end CHARACTERISTIC
/begin MEASUREMENT abmhdev_msg "Cut off pattern high-pressure injection-valve" UBYTE OneToOne 1 100 0.00 255.0 FORMAT "%5.1" ECU_ADDRESS 0x70003669 /end MEASUREMENT
/begin MEASUREMENT B_ctfa1fcl_msg "Condition: clear fault-path <E_TFA1CS>" UBYTE B_TRUE 1 100 0.00 1.00000000000 BIT_MASK 0x1 FORMAT "%13.11" ECU_ADDRESS 0x70000C1F /end MEASUREMENT
/begin MEASUREMENT B_ctfa1prm_msg "Diagnosis enabling for tfa1-sensor at coldstart (FID)" UBYTE B_TRUE 1 100 0.00 1.00000000000 BIT_MASK 0x1 FORMAT "%13.11" ECU_ADDRESS 0x70000C1E /end MEASUREMENT
/begin MEASUREMENT B_ctfa2fcl_msg "Condition: clear fault-path <E_TFA2CS>" UBYTE B_TRUE 1 100 0.00 1.00000000000 BIT_MASK 0x1 FORMAT "%13.11" ECU_ADDRESS 0x70000C1D /end MEASUREMENT
/begin MEASUREMENT B_ctfa2prm_msg "diagnosis enabling of tfa2-sensor at coldstart (FID)" UBYTE B_TRUE 1 100 0.00 1.00000000000 BIT_MASK 0x1 FORMAT "%13.11" ECU_ADDRESS 0x70000C1C /end MEASUREMENT
/begin MEASUREMENT B_eev_msg "Injector fault (power stage)." UBYTE B_TRUE 1 100 0.00 1.00000000000 BIT_MASK 0x1 FORMAT "%13.11" ECU_ADDRESS 0x70000BF8 /end MEASUREMENT
/begin MEASUREMENT B_ehdev_msg "Condition: fault in the HEDV-power stages" UBYTE B_TRUE 1 100 0.00 1.00000000000 BIT_MASK 0x1 FORMAT "%13.11" ECU_ADDRESS 0x70000BF4 /end MEASUREMENT
/begin MEASUREMENT B_etfa1fcl_msg "Condition: clear fault-path <E_TFA1E>" UBYTE B_TRUE 1 100 0.00 1.00000000000 BIT_MASK 0x1 FORMAT "%13.11" ECU_ADDRESS 0x70000BE2 /end MEASUREMENT
/begin MEASUREMENT B_etfa2fcl_msg "Condition: clear fault-path <E_TFA2E>" UBYTE B_TRUE 1 100 0.00 1.00000000000 BIT_MASK 0x1 FORMAT "%13.11" ECU_ADDRESS 0x70000BE1 /end MEASUREMENT
/begin MEASUREMENT B_ptfa1fcl_msg "request for clearing plaus-error of TFA1" UBYTE B_TRUE 1 100 0.00 1.00000000000 BIT_MASK 0x1 FORMAT "%13.11" ECU_ADDRESS 0x70000B3D /end MEASUREMENT
/begin MEASUREMENT B_ptfa1prm_msg "diagnosis-release (FID) for manifold-air temperature sensor TFA1" UBYTE B_TRUE 1 100 0.00 1.00000000000 BIT_MASK 0x1 FORMAT "%13.11" ECU_ADDRESS 0x70000B3C /end MEASUREMENT
/begin MEASUREMENT B_ptfa2fcl_msg "plausiblity-check TFA2-sensor: request clear fault path" UBYTE B_TRUE 1 100 0.00 1.00000000000 BIT_MASK 0x1 FORMAT "%13.11" ECU_ADDRESS 0x70000B3B /end MEASUREMENT
/begin MEASUREMENT B_ptfa2prm_msg "plausiblity-check TFA2-sensor: diagnosis released from inhibitor" UBYTE B_TRUE 1 100 0.00 1.00000000000 BIT_MASK 0x1 FORMAT "%13.11" ECU_ADDRESS 0x70000B3A /end MEASUREMENT
/begin MEASUREMENT B_tanlfg_msg "Condition temperature downstream air filter is valid" UBYTE B_TRUE 1 100 0.00 1.00000000000 BIT_MASK 0x1 FORMAT "%13.11" ECU_ADDRESS 0x70000B1A /end MEASUREMENT
/begin MEASUREMENT B_tansgg_msg "valid-flag for tfa1-sensor" UBYTE B_TRUE 1 100 0.00 1.00000000000 BIT_MASK 0x1 FORMAT "%13.11" ECU_ADDRESS 0x70000B19 /end MEASUREMENT
/begin MEASUREMENT B_tansnmot "Local bit: value of turnOffDelay for B_nmot" UBYTE B_TRUE 1 100 0.00 1.00000000000 BIT_MASK 0x1 FORMAT "%13.11" ECU_ADDRESS 0x700001EE /end MEASUREMENT
/begin MEASUREMENT B_tasrgg_msg "Intake air temperature tasrg_w is valid" UBYTE B_TRUE 1 100 0.00 1.00000000000 BIT_MASK 0x1 FORMAT "%13.11" ECU_ADDRESS 0x70000B17 /end MEASUREMENT
/begin MEASUREMENT B_tasrg_msg "Condition tasr is valid" UBYTE B_TRUE 1 100 0.00 1.00000000000 BIT_MASK 0x1 FORMAT "%13.11" ECU_ADDRESS 0x70000B18 /end MEASUREMENT
/begin MEASUREMENT B_tavdkg_msg "Condition temperature upstream throttle blade valid" UBYTE B_TRUE 1 100 0.00 1.00000000000 BIT_MASK 0x1 FORMAT "%13.11" ECU_ADDRESS 0x70000B16 /end MEASUREMENT
/begin MEASUREMENT B_tfa1gg_msg "valid flag for TFA1-sensor" UBYTE B_TRUE 1 100 0.00 1.00000000000 BIT_MASK 0x1 FORMAT "%13.11" ECU_ADDRESS 0x70000B12 /end MEASUREMENT
/begin MEASUREMENT B_tfa1rg_msg "sensor tfa1 is electrical valid" UBYTE B_TRUE 1 100 0.00 1.00000000000 BIT_MASK 0x1 FORMAT "%13.11" ECU_ADDRESS 0x70000B11 /end MEASUREMENT
/begin MEASUREMENT B_tfa2gg_msg "valid-flag for tfa2-sensor, FG internal" UBYTE B_TRUE 1 100 0.00 1.00000000000 BIT_MASK 0x1 FORMAT "%13.11" ECU_ADDRESS 0x70000B10 /end MEASUREMENT
/begin MEASUREMENT B_tfa2rg_msg "sensor tfa2 is electrical valid" UBYTE B_TRUE 1 100 0.00 1.00000000000 BIT_MASK 0x1 FORMAT "%13.11" ECU_ADDRESS 0x70000B0F /end MEASUREMENT
/begin MEASUREMENT B_tfastz "Intake air temperature: first start value of driving cycle is written" UBYTE B_TRUE 1 100 0.00 1.00000000000 BIT_MASK 0x1 FORMAT "%13.11" ECU_ADDRESS 0x700001ED /end MEASUREMENT
/begin MEASUREMENT InjSys_agAux1 "angle auxiliary injection 1" SWORD kw_q0p0234 1 100 -768.0000 767.9766 FORMAT "%8.4" ARRAY_SIZE 3 ECU_ADDRESS 0x70003B86 /end MEASUREMENT
/begin MEASUREMENT InjSys_agAux1Stb "angle auxiliary injection 1 (standby injection mode)" SWORD kw_q0p0234 1 100 -768.0000 767.9766 FORMAT "%8.4" ARRAY_SIZE 3 ECU_ADDRESS 0x70003B8C /end MEASUREMENT
/begin MEASUREMENT InjSys_agAux2 "angle auxiliary injection 2" SWORD kw_q0p0234 1 100 -768.0000 767.9766 FORMAT "%8.4" ARRAY_SIZE 3 ECU_ADDRESS 0x70003B7A /end MEASUREMENT
/begin MEASUREMENT InjSys_agAux2Stb "angle auxiliary injection 2 (standby injection mode)" SWORD kw_q0p0234 1 100 -768.0000 767.9766 FORMAT "%8.4" ARRAY_SIZE 3 ECU_ADDRESS 0x70003B80 /end MEASUREMENT
/begin MEASUREMENT InjSys_agBas "base angle packet" SWORD kw_q0p0234 1 100 -768.0000 767.9766 FORMAT "%8.4" ARRAY_SIZE 3 ECU_ADDRESS 0x70003B6E /end MEASUREMENT
/begin MEASUREMENT InjSys_agBasStb "base angle packet (standby injection mode)" SWORD kw_q0p0234 1 100 -768.0000 767.9766 FORMAT "%8.4" ARRAY_SIZE 3 ECU_ADDRESS 0x70003B74 /end MEASUREMENT
/begin MEASUREMENT InjSys_agBasTmpSyn0 "base angle injection individual S0 timing temporary" SWORD kw_q0p0234 1 100 -768.0000 767.9766 FORMAT "%8.4" ARRAY_SIZE 4 ECU_ADDRESS 0x70002A12 /end MEASUREMENT
/begin MEASUREMENT InjSys_agBasTmpSyn0Stb "base angle injection individual S0 timing temporary (standby injection mode)" SWORD kw_q0p0234 1 100 -768.0000 767.9766 FORMAT "%8.4" ARRAY_SIZE 4 ECU_ADDRESS 0x70002A0A /end MEASUREMENT
/begin MEASUREMENT InjSys_agEoiCvo "CVO Addition injection final angle" SWORD kw_q0p0234 1 100 -768.0000 767.9766 FORMAT "%8.4" ECU_ADDRESS 0x70003B6C /end MEASUREMENT
/begin MEASUREMENT InjSys_agEoiSyn0 "angle end of injection S0 timing" SWORD kw_q0p0234 1 100 -768.0000 767.9766 FORMAT "%8.4" ARRAY_SIZE 4 ECU_ADDRESS 0x70003B5C /end MEASUREMENT
/begin MEASUREMENT InjSys_agEoiSyn0Stb "angle end of injection S0 timing (standby injection mode)" SWORD kw_q0p0234 1 100 -768.0000 767.9766 FORMAT "%8.4" ARRAY_SIZE 4 ECU_ADDRESS 0x70003B64 /end MEASUREMENT
/begin MEASUREMENT InjSys_agEoiSyn1 "angle end of injection S1 timing" SWORD kw_q0p0234 1 100 -768.0000 767.9766 FORMAT "%8.4" ARRAY_SIZE 4 ECU_ADDRESS 0x70003B4C /end MEASUREMENT
/begin MEASUREMENT InjSys_agEoiSyn1Stb "angle end of injection S1 timing (standby injection mode)" SWORD kw_q0p0234 1 100 -768.0000 767.9766 FORMAT "%8.4" ARRAY_SIZE 4 ECU_ADDRESS 0x70003B54 /end MEASUREMENT
/begin MEASUREMENT InjSys_agInjShiftCvo "injection angle shift by CVO" UWORD kw_q0p0234 1 100 0.00 1535.977 FORMAT "%8.3" ECU_ADDRESS 0x7000395E /end MEASUREMENT
/begin MEASUREMENT InjSys_agInjSyn0 "base angle injection individual S0 timing" SWORD kw_q0p0234 1 100 -768.0000 767.9766 FORMAT "%8.4" ARRAY_SIZE 4 ECU_ADDRESS 0x70003B3C /end MEASUREMENT
/begin MEASUREMENT InjSys_agInjSyn0Stb "base angle injection individual S0 timing (standby injection mode)" SWORD kw_q0p0234 1 100 -768.0000 767.9766 FORMAT "%8.4" ARRAY_SIZE 4 ECU_ADDRESS 0x70003B44 /end MEASUREMENT
/begin MEASUREMENT InjSys_agInjSyn1 "base angle injection individual S1 timing" SWORD kw_q0p0234 1 100 -768.0000 767.9766 FORMAT "%8.4" ARRAY_SIZE 4 ECU_ADDRESS 0x70003B2C /end MEASUREMENT
/begin MEASUREMENT InjSys_agInjSyn1Stb "base angle injection individual S1 timing (standby injection mode)" SWORD kw_q0p0234 1 100 -768.0000 767.9766 FORMAT "%8.4" ARRAY_SIZE 4 ECU_ADDRESS 0x70003B34 /end MEASUREMENT
/begin MEASUREMENT InjSys_agIntkVlvClsd "angle intake valve closing" SWORD kw_q0p0156 1 100 -512.0000 511.9844 FORMAT "%8.4" ECU_ADDRESS 0x600098BC /end MEASUREMENT
/begin MEASUREMENT InjSys_agSoiCvo "Begin angle of the CVO injection" SWORD kw_q0p0234 1 100 -768.0000 767.9766 FORMAT "%8.4" ECU_ADDRESS 0x70003B08 /end MEASUREMENT
/begin MEASUREMENT InjSys_agSoiSyn0 "angle start of injection S0 timing" SWORD kw_q0p0234 1 100 -768.0000 767.9766 FORMAT "%8.4" ARRAY_SIZE 4 ECU_ADDRESS 0x70003AF8 /end MEASUREMENT
/begin MEASUREMENT InjSys_agSoiSyn0Stb "angle start of injection S0 timing (standby injection mode)" SWORD kw_q0p0234 1 100 -768.0000 767.9766 FORMAT "%8.4" ARRAY_SIZE 4 ECU_ADDRESS 0x70003B00 /end MEASUREMENT
/begin MEASUREMENT InjSys_agSoiSyn1 "angle start of injection S1 timing" SWORD kw_q0p0234 1 100 -768.0000 767.9766 FORMAT "%8.4" ARRAY_SIZE 4 ECU_ADDRESS 0x70003AE8 /end MEASUREMENT
/begin MEASUREMENT InjSys_agSoiSyn1Stb "angle start of injection S1 timing (standby injection mode)" SWORD kw_q0p0234 1 100 -768.0000 767.9766 FORMAT "%8.4" ARRAY_SIZE 4 ECU_ADDRESS 0x70003AF0 /end MEASUREMENT
/begin MEASUREMENT InjSys_facAdpnInjrIndInj "factor injector adaption (pulse individual)" UWORD fak_uw_b2 1 100 0.00 1.999969 FORMAT "%8.6" ARRAY_SIZE 4 ECU_ADDRESS 0x70003952 /end MEASUREMENT
/begin MEASUREMENT InjSys_facAdpnInjrStb "factor injector adaption (standby injection mode)" UWORD fak_uw_b2 1 100 0.00 1.999969 FORMAT "%8.6" ARRAY_SIZE 4 ECU_ADDRESS 0x7000394A /end MEASUREMENT
/begin MEASUREMENT InjSys_facCorrnMix "local multiplicative correction of the mixture adaptation" UWORD fak_uw_b2 1 100 0.00 1.999969 FORMAT "%8.6" ECU_ADDRESS 0x70003948 /end MEASUREMENT
/begin MEASUREMENT InjSys_facGenMixCorrn "factor general mixture correction" UWORD fak_uw_b2 1 100 0.00 1.999969 FORMAT "%8.6" ECU_ADDRESS 0x70003946 /end MEASUREMENT
/begin MEASUREMENT InjSys_facGenMixCorrnLoc "factor general mixture correction" UWORD fak_uw_b2 1 100 0.00 1.999969 FORMAT "%8.6" ECU_ADDRESS 0x700025F2 /end MEASUREMENT
/begin MEASUREMENT InjSys_facGenMixCorrnStb "factor general mixture correction (standby injection mode)" UWORD fak_uw_b2 1 100 0.00 1.999969 FORMAT "%8.6" ECU_ADDRESS 0x70003944 /end MEASUREMENT
/begin MEASUREMENT InjSys_facGenMixCorrnTmp "factor general mixture correction" UWORD fak_uw_b2 1 100 0.00 1.999969 FORMAT "%8.6" ECU_ADDRESS 0x700025F0 /end MEASUREMENT
/begin MEASUREMENT InjSys_facMixCylInd "factor mixture cylinder individual" UWORD fak_uw_b4 1 100 0.00 3.999939 FORMAT "%8.6" ECU_ADDRESS 0x70003942 /end MEASUREMENT
/begin MEASUREMENT InjSys_facPc "factor mixture precontrol" UWORD fak_uw_b64 1 100 0.00 63.99902 FORMAT "%8.5" ECU_ADDRESS 0x70003940 /end MEASUREMENT
/begin MEASUREMENT InjSys_facRelMCorEth "Factor relative mass correction injection mode Ethanol" UWORD fak_uw_b2 1 100 0.00 1.999969 FORMAT "%8.6" ECU_ADDRESS 0x700025EE /end MEASUREMENT
/begin MEASUREMENT InjSys_facRelMCorrnSmlVlv "Factor relative mass correction injection mode with small cam." UWORD fak_uw_b2 1 100 0.00 1.999969 FORMAT "%8.6" ECU_ADDRESS 0x700025EC /end MEASUREMENT
/begin MEASUREMENT InjSys_facSpltCmprn "split factor compression stroke injections" UBYTE fak_ub_b1 1 100 0.00 0.9961 ECU_ADDRESS 0x700036DE /end MEASUREMENT
/begin MEASUREMENT InjSys_flgAgEndSyn0 "condition end angle injection individual S0 timing" UBYTE B_TRUE 1 100 0.00 1.00000000000 FORMAT "%13.11" ARRAY_SIZE 4 ECU_ADDRESS 0x700036D6 /end MEASUREMENT
/begin MEASUREMENT InjSys_flgAgEndSyn0Stb "condition end angle injection individual S0 timing (standby injection mode)" UBYTE B_TRUE 1 100 0.00 1.00000000000 FORMAT "%13.11" ARRAY_SIZE 4 ECU_ADDRESS 0x700036DA /end MEASUREMENT
/begin MEASUREMENT InjSys_flgAgEndSyn1 "condition end angle injection individual S1 timing" UBYTE B_TRUE 1 100 0.00 1.00000000000 FORMAT "%13.11" ARRAY_SIZE 4 ECU_ADDRESS 0x700036CE /end MEASUREMENT
/begin MEASUREMENT InjSys_flgAgEndSyn1Stb "condition end angle injection individual S1 timing (standby injection mode)" UBYTE B_TRUE 1 100 0.00 1.00000000000 FORMAT "%13.11" ARRAY_SIZE 4 ECU_ADDRESS 0x700036D2 /end MEASUREMENT
/begin MEASUREMENT InjSys_flgCalcInjTiSyn0 "flag calculation injection time S0 timing" UBYTE B_TRUE 1 100 0.00 1.00000000000 BIT_MASK 0x1 FORMAT "%13.11" ECU_ADDRESS 0x700001F5 /end MEASUREMENT
/begin MEASUREMENT InjSys_flgCalcInjTiSyn1 "flag calculation injection time S1 timing" UBYTE B_TRUE 1 100 0.00 1.00000000000 BIT_MASK 0x1 FORMAT "%13.11" ECU_ADDRESS 0x700001F4 /end MEASUREMENT
/begin MEASUREMENT InjSys_flgCvoBascCylIndEna "flag CVO basic adation cylinder individual enable" UBYTE B_TRUE 1 100 0.00 1.00000000000 BIT_MASK 0x1 FORMAT "%13.11" ECU_ADDRESS 0x70000886 /end MEASUREMENT
/begin MEASUREMENT InjSys_flgCvoBascEna "Controlled Valve Operation (CVO) basic adaptation enable condition" UBYTE B_TRUE 1 100 0.00 1.00000000000 BIT_MASK 0x1 FORMAT "%13.11" ECU_ADDRESS 0x70000885 /end MEASUREMENT
/begin MEASUREMENT InjSys_flgEomCvoBasc "Condition engine operation mode for CVO(Controlled Valve Operation) basic adaption ready" UBYTE B_TRUE 1 100 0.00 1.00000000000 BIT_MASK 0x1 FORMAT "%13.11" ECU_ADDRESS 0x70000880 /end MEASUREMENT
/begin MEASUREMENT InjSys_flgMinTiBascCvo "Minimum injection time for release of CVO(Controlled Valve Operation) basic adaptation" UBYTE B_TRUE 1 100 0.00 1.00000000000 BIT_MASK 0x1 FORMAT "%13.11" ECU_ADDRESS 0x70000873 /end MEASUREMENT
/begin MEASUREMENT InjSys_flgRatFuMOvf "overflow relative fuel mass" UBYTE B_TRUE 1 100 0.00 1.00000000000 BIT_MASK 0x1 FORMAT "%13.11" ECU_ADDRESS 0x700001F7 /end MEASUREMENT
/begin MEASUREMENT InjSys_flgRatFuMOvfStb "overflow relative fuel mass (standby injection mode)" UBYTE B_TRUE 1 100 0.00 1.00000000000 BIT_MASK 0x1 FORMAT "%13.11" ECU_ADDRESS 0x700001F6 /end MEASUREMENT
/begin MEASUREMENT InjSys_flgStrtEndMixCalcn "condition end of start for injection" UBYTE B_TRUE 1 100 0.00 1.00000000000 BIT_MASK 0x1 FORMAT "%13.11" ECU_ADDRESS 0x700001F3 /end MEASUREMENT
/begin MEASUREMENT InjSys_flgStrtEndTran "flag transition end of start" UBYTE B_TRUE 1 100 0.00 1.00000000000 BIT_MASK 0x1 FORMAT "%13.11" ECU_ADDRESS 0x700001F2 /end MEASUREMENT
/begin MEASUREMENT InjSys_idxMaskBascAdpnCvo "status of cyllinder individual CVO enable" UBYTE OneToOne 1 100 0.00 255.0 FORMAT "%5.1" ECU_ADDRESS 0x700036C2 /end MEASUREMENT
/begin MEASUREMENT InjSys_idxMI "index for main injection" UBYTE dez 1 100 0.00 255.0 FORMAT "%5.1" ECU_ADDRESS 0x700036C3 /end MEASUREMENT
/begin MEASUREMENT InjSys_idxPktInjInd "packet number injection individual" UBYTE dez 1 100 0.00 255.0 FORMAT "%5.1" ARRAY_SIZE 4 ECU_ADDRESS 0x700029D7 /end MEASUREMENT
/begin MEASUREMENT InjSys_InjCalcSyn0.agEoi "class instance for computation of injection times S0 timing / angle end of injection" SWORD kw_q0p0234 1 100 -768.0000 767.9766 FORMAT "%8.4" ARRAY_SIZE 4 ECU_ADDRESS 0x700028C0 /end MEASUREMENT
/begin MEASUREMENT InjSys_InjCalcSyn0.agSoi "class instance for computation of injection times S0 timing / angle start of injection" SWORD kw_q0p0234 1 100 -768.0000 767.9766 FORMAT "%8.4" ARRAY_SIZE 4 ECU_ADDRESS 0x700028CA /end MEASUREMENT
/begin MEASUREMENT InjSys_InjCalcSyn0.mFu "class instance for computation of injection times S0 timing / absolute fuel mass" ULONG m_q0p01_mg 1 100 0.00 2621.43000000 FORMAT "%13.8" ARRAY_SIZE 4 ECU_ADDRESS 0x700028D4 /end MEASUREMENT
/begin MEASUREMENT InjSys_InjCalcSyn0.pDeltaRailChmb "class instance for computation of injection times S0 timing / delta pressure between fuel rail and combustion chamber" UWORD RBPtCel_p_0p002_1 1 100 0.00 131.0700 FORMAT "%8.4" ARRAY_SIZE 4 ECU_ADDRESS 0x700028E8 /end MEASUREMENT
/begin MEASUREMENT InjSys_InjCalcSyn0.tiBreakOffs "class instance for computation of injection times S0 timing / pause time offset" SWORD t_q0p0004_ms 1 100 -13.10720 13.10680 FORMAT "%8.5" ARRAY_SIZE 4 ECU_ADDRESS 0x700028F2 /end MEASUREMENT
/begin MEASUREMENT InjSys_InjCalcSyn0.tiBreakOffsBall "class instance for computation of injection times S0 timing / pause time offset for ballistic injection" SWORD t_q0p0004_ms 1 100 -13.10720 13.10680 FORMAT "%8.5" ARRAY_SIZE 4 ECU_ADDRESS 0x700028FA /end MEASUREMENT
/begin MEASUREMENT InjSys_InjCalcSyn0.tiInj "class instance for computation of injection times S0 timing / injection time" ULONG t_q0p0004_ms 1 100 0.00 1717986.91800 FORMAT "%13.5" ARRAY_SIZE 4 ECU_ADDRESS 0x70002904 /end MEASUREMENT
/begin MEASUREMENT InjSys_InjCalcSyn0.tiInjEfc "class instance for computation of injection times S0 timing / injection time effective" ULONG t_q0p0004_ms 1 100 0.00 1717986.91800 FORMAT "%13.5" ARRAY_SIZE 4 ECU_ADDRESS 0x70002914 /end MEASUREMENT
/begin MEASUREMENT InjSys_InjCalcSyn0.tiInjNlnr "class instance for computation of injection times S0 timing / injection time non-linear" ULONG t_q0p0004_ms 1 100 0.00 1717986.91800 FORMAT "%13.5" ARRAY_SIZE 4 ECU_ADDRESS 0x70002924 /end MEASUREMENT
/begin MEASUREMENT InjSys_InjCalcSyn0.tiInjOpen "class instance for computation of injection times S0 timing / injection time open valve" ULONG t_q0p0004_ms 1 100 0.00 1717986.91800 FORMAT "%13.5" ARRAY_SIZE 4 ECU_ADDRESS 0x70002934 /end MEASUREMENT
/begin MEASUREMENT InjSys_InjCalcSyn0.tiInjPred "class instance for computation of injection times S0 timing / injection time predicted" ULONG t_q0p0004_ms 1 100 0.00 1717986.91800 FORMAT "%13.5" ARRAY_SIZE 4 ECU_ADDRESS 0x70002944 /end MEASUREMENT
/begin MEASUREMENT InjSys_InjCalcSyn0.volFu "class instance for computation of injection times S0 timing / absolute fuel volume" ULONG vol_q1Em5_ml 1 100 0.00 2.62143000000 FORMAT "%13.11" ARRAY_SIZE 4 ECU_ADDRESS 0x70002958 /end MEASUREMENT
/begin MEASUREMENT InjSys_InjCalcSyn0Stb.agEoi "class instance for computation of injection times S0 timing (standby injection mode) / angle end of injection" SWORD kw_q0p0234 1 100 -768.0000 767.9766 FORMAT "%8.4" ARRAY_SIZE 4 ECU_ADDRESS 0x700027EC /end MEASUREMENT
/begin MEASUREMENT InjSys_InjCalcSyn0Stb.agSoi "class instance for computation of injection times S0 timing (standby injection mode) / angle start of injection" SWORD kw_q0p0234 1 100 -768.0000 767.9766 FORMAT "%8.4" ARRAY_SIZE 4 ECU_ADDRESS 0x700027F6 /end MEASUREMENT
/begin MEASUREMENT InjSys_InjCalcSyn0Stb.mFu "class instance for computation of injection times S0 timing (standby injection mode) / absolute fuel mass" ULONG m_q0p01_mg 1 100 0.00 2621.43000000 FORMAT "%13.8" ARRAY_SIZE 4 ECU_ADDRESS 0x70002800 /end MEASUREMENT
/begin MEASUREMENT InjSys_InjCalcSyn0Stb.pDeltaRailChmb "class instance for computation of injection times S0 timing (standby injection mode) / delta pressure between fuel rail and combustion chamber" UWORD RBPtCel_p_0p002_1 1 100 0.00 131.0700 FORMAT "%8.4" ARRAY_SIZE 4 ECU_ADDRESS 0x70002814 /end MEASUREMENT
/begin MEASUREMENT InjSys_InjCalcSyn0Stb.tiBreakOffs "class instance for computation of injection times S0 timing (standby injection mode) / pause time offset" SWORD t_q0p0004_ms 1 100 -13.10720 13.10680 FORMAT "%8.5" ARRAY_SIZE 4 ECU_ADDRESS 0x7000281E /end MEASUREMENT
/begin MEASUREMENT InjSys_InjCalcSyn0Stb.tiBreakOffsBall "class instance for computation of injection times S0 timing (standby injection mode) / pause time offset for ballistic injection" SWORD t_q0p0004_ms 1 100 -13.10720 13.10680 FORMAT "%8.5" ARRAY_SIZE 4 ECU_ADDRESS 0x70002826 /end MEASUREMENT
/begin MEASUREMENT InjSys_InjCalcSyn0Stb.tiInj "class instance for computation of injection times S0 timing (standby injection mode) / injection time" ULONG t_q0p0004_ms 1 100 0.00 1717986.91800 FORMAT "%13.5" ARRAY_SIZE 4 ECU_ADDRESS 0x70002830 /end MEASUREMENT
/begin MEASUREMENT InjSys_InjCalcSyn0Stb.tiInjEfc "class instance for computation of injection times S0 timing (standby injection mode) / injection time effective" ULONG t_q0p0004_ms 1 100 0.00 1717986.91800 FORMAT "%13.5" ARRAY_SIZE 4 ECU_ADDRESS 0x70002840 /end MEASUREMENT
/begin MEASUREMENT InjSys_InjCalcSyn0Stb.tiInjNlnr "class instance for computation of injection times S0 timing (standby injection mode) / injection time non-linear" ULONG t_q0p0004_ms 1 100 0.00 1717986.91800 FORMAT "%13.5" ARRAY_SIZE 4 ECU_ADDRESS 0x70002850 /end MEASUREMENT
/begin MEASUREMENT InjSys_InjCalcSyn0Stb.tiInjOpen "class instance for computation of injection times S0 timing (standby injection mode) / injection time open valve" ULONG t_q0p0004_ms 1 100 0.00 1717986.91800 FORMAT "%13.5" ARRAY_SIZE 4 ECU_ADDRESS 0x70002860 /end MEASUREMENT
/begin MEASUREMENT InjSys_InjCalcSyn0Stb.tiInjPred "class instance for computation of injection times S0 timing (standby injection mode) / injection time predicted" ULONG t_q0p0004_ms 1 100 0.00 1717986.91800 FORMAT "%13.5" ARRAY_SIZE 4 ECU_ADDRESS 0x70002870 /end MEASUREMENT
/begin MEASUREMENT InjSys_InjCalcSyn0Stb.volFu "class instance for computation of injection times S0 timing (standby injection mode) / absolute fuel volume" ULONG vol_q1Em5_ml 1 100 0.00 2.62143000000 FORMAT "%13.11" ARRAY_SIZE 4 ECU_ADDRESS 0x70002884 /end MEASUREMENT
/begin MEASUREMENT InjSys_InjCalcSyn1.agEoi "class instance for computation of injection times S1 timing / angle end of injection" SWORD kw_q0p0234 1 100 -768.0000 767.9766 FORMAT "%8.4" ARRAY_SIZE 4 ECU_ADDRESS 0x70002718 /end MEASUREMENT
/begin MEASUREMENT InjSys_InjCalcSyn1.agSoi "class instance for computation of injection times S1 timing / angle start of injection" SWORD kw_q0p0234 1 100 -768.0000 767.9766 FORMAT "%8.4" ARRAY_SIZE 4 ECU_ADDRESS 0x70002722 /end MEASUREMENT
/begin MEASUREMENT InjSys_InjCalcSyn1.mFu "class instance for computation of injection times S1 timing / absolute fuel mass" ULONG m_q0p01_mg 1 100 0.00 2621.43000000 FORMAT "%13.8" ARRAY_SIZE 4 ECU_ADDRESS 0x7000272C /end MEASUREMENT
/begin MEASUREMENT InjSys_InjCalcSyn1.pDeltaRailChmb "class instance for computation of injection times S1 timing / delta pressure between fuel rail and combustion chamber" UWORD RBPtCel_p_0p002_1 1 100 0.00 131.0700 FORMAT "%8.4" ARRAY_SIZE 4 ECU_ADDRESS 0x70002740 /end MEASUREMENT
/begin MEASUREMENT InjSys_InjCalcSyn1.tiBreakOffs "class instance for computation of injection times S1 timing / pause time offset" SWORD t_q0p0004_ms 1 100 -13.10720 13.10680 FORMAT "%8.5" ARRAY_SIZE 4 ECU_ADDRESS 0x7000274A /end MEASUREMENT
/begin MEASUREMENT InjSys_InjCalcSyn1.tiBreakOffsBall "class instance for computation of injection times S1 timing / pause time offset for ballistic injection" SWORD t_q0p0004_ms 1 100 -13.10720 13.10680 FORMAT "%8.5" ARRAY_SIZE 4 ECU_ADDRESS 0x70002752 /end MEASUREMENT
/begin MEASUREMENT InjSys_InjCalcSyn1.tiInj "class instance for computation of injection times S1 timing / injection time" ULONG t_q0p0004_ms 1 100 0.00 1717986.91800 FORMAT "%13.5" ARRAY_SIZE 4 ECU_ADDRESS 0x7000275C /end MEASUREMENT
/begin MEASUREMENT InjSys_InjCalcSyn1.tiInjEfc "class instance for computation of injection times S1 timing / injection time effective" ULONG t_q0p0004_ms 1 100 0.00 1717986.91800 FORMAT "%13.5" ARRAY_SIZE 4 ECU_ADDRESS 0x7000276C /end MEASUREMENT
/begin MEASUREMENT InjSys_InjCalcSyn1.tiInjNlnr "class instance for computation of injection times S1 timing / injection time non-linear" ULONG t_q0p0004_ms 1 100 0.00 1717986.91800 FORMAT "%13.5" ARRAY_SIZE 4 ECU_ADDRESS 0x7000277C /end MEASUREMENT
/begin MEASUREMENT InjSys_InjCalcSyn1.tiInjOpen "class instance for computation of injection times S1 timing / injection time open valve" ULONG t_q0p0004_ms 1 100 0.00 1717986.91800 FORMAT "%13.5" ARRAY_SIZE 4 ECU_ADDRESS 0x7000278C /end MEASUREMENT
/begin MEASUREMENT InjSys_InjCalcSyn1.tiInjPred "class instance for computation of injection times S1 timing / injection time predicted" ULONG t_q0p0004_ms 1 100 0.00 1717986.91800 FORMAT "%13.5" ARRAY_SIZE 4 ECU_ADDRESS 0x7000279C /end MEASUREMENT
/begin MEASUREMENT InjSys_InjCalcSyn1.volFu "class instance for computation of injection times S1 timing / absolute fuel volume" ULONG vol_q1Em5_ml 1 100 0.00 2.62143000000 FORMAT "%13.11" ARRAY_SIZE 4 ECU_ADDRESS 0x700027B0 /end MEASUREMENT
/begin MEASUREMENT InjSys_InjCalcSyn1Stb.agEoi "class instance for computation of injection times S1 timing (standby injection mode) / angle end of injection" SWORD kw_q0p0234 1 100 -768.0000 767.9766 FORMAT "%8.4" ARRAY_SIZE 4 ECU_ADDRESS 0x70002644 /end MEASUREMENT
/begin MEASUREMENT InjSys_InjCalcSyn1Stb.agSoi "class instance for computation of injection times S1 timing (standby injection mode) / angle start of injection" SWORD kw_q0p0234 1 100 -768.0000 767.9766 FORMAT "%8.4" ARRAY_SIZE 4 ECU_ADDRESS 0x7000264E /end MEASUREMENT
/begin MEASUREMENT InjSys_InjCalcSyn1Stb.mFu "class instance for computation of injection times S1 timing (standby injection mode) / absolute fuel mass" ULONG m_q0p01_mg 1 100 0.00 2621.43000000 FORMAT "%13.8" ARRAY_SIZE 4 ECU_ADDRESS 0x70002658 /end MEASUREMENT
/begin MEASUREMENT InjSys_InjCalcSyn1Stb.pDeltaRailChmb "class instance for computation of injection times S1 timing (standby injection mode) / delta pressure between fuel rail and combustion chamber" UWORD RBPtCel_p_0p002_1 1 100 0.00 131.0700 FORMAT "%8.4" ARRAY_SIZE 4 ECU_ADDRESS 0x7000266C /end MEASUREMENT
/begin MEASUREMENT InjSys_InjCalcSyn1Stb.tiBreakOffs "class instance for computation of injection times S1 timing (standby injection mode) / pause time offset" SWORD t_q0p0004_ms 1 100 -13.10720 13.10680 FORMAT "%8.5" ARRAY_SIZE 4 ECU_ADDRESS 0x70002676 /end MEASUREMENT
/begin MEASUREMENT InjSys_InjCalcSyn1Stb.tiBreakOffsBall "class instance for computation of injection times S1 timing (standby injection mode) / pause time offset for ballistic injection" SWORD t_q0p0004_ms 1 100 -13.10720 13.10680 FORMAT "%8.5" ARRAY_SIZE 4 ECU_ADDRESS 0x7000267E /end MEASUREMENT
/begin MEASUREMENT InjSys_InjCalcSyn1Stb.tiInj "class instance for computation of injection times S1 timing (standby injection mode) / injection time" ULONG t_q0p0004_ms 1 100 0.00 1717986.91800 FORMAT "%13.5" ARRAY_SIZE 4 ECU_ADDRESS 0x70002688 /end MEASUREMENT
/begin MEASUREMENT InjSys_InjCalcSyn1Stb.tiInjEfc "class instance for computation of injection times S1 timing (standby injection mode) / injection time effective" ULONG t_q0p0004_ms 1 100 0.00 1717986.91800 FORMAT "%13.5" ARRAY_SIZE 4 ECU_ADDRESS 0x70002698 /end MEASUREMENT
/begin MEASUREMENT InjSys_InjCalcSyn1Stb.tiInjNlnr "class instance for computation of injection times S1 timing (standby injection mode) / injection time non-linear" ULONG t_q0p0004_ms 1 100 0.00 1717986.91800 FORMAT "%13.5" ARRAY_SIZE 4 ECU_ADDRESS 0x700026A8 /end MEASUREMENT
/begin MEASUREMENT InjSys_InjCalcSyn1Stb.tiInjOpen "class instance for computation of injection times S1 timing (standby injection mode) / injection time open valve" ULONG t_q0p0004_ms 1 100 0.00 1717986.91800 FORMAT "%13.5" ARRAY_SIZE 4 ECU_ADDRESS 0x700026B8 /end MEASUREMENT
/begin MEASUREMENT InjSys_InjCalcSyn1Stb.tiInjPred "class instance for computation of injection times S1 timing (standby injection mode) / injection time predicted" ULONG t_q0p0004_ms 1 100 0.00 1717986.91800 FORMAT "%13.5" ARRAY_SIZE 4 ECU_ADDRESS 0x700026C8 /end MEASUREMENT
/begin MEASUREMENT InjSys_InjCalcSyn1Stb.volFu "class instance for computation of injection times S1 timing (standby injection mode) / absolute fuel volume" ULONG vol_q1Em5_ml 1 100 0.00 2.62143000000 FORMAT "%13.11" ARRAY_SIZE 4 ECU_ADDRESS 0x700026DC /end MEASUREMENT
/begin MEASUREMENT InjSys_mFuSum "sum absolute fuel mass" ULONG m_q0p01_mg 1 100 0.00 42949672.9500 FORMAT "%13.4" ECU_ADDRESS 0x70003DEC /end MEASUREMENT
/begin MEASUREMENT InjSys_mFuSumMem "sum absolute fuel mass memory" ULONG m_q0p01_mg 1 100 0.00 42949672.9500 FORMAT "%13.4" ARRAY_SIZE 4 ECU_ADDRESS 0x70003DDC /end MEASUREMENT
/begin MEASUREMENT InjSys_mFuSumStb "sum absolute fuel mass (standby injection mode)" ULONG m_q0p01_mg 1 100 0.00 42949672.9500 FORMAT "%13.4" ECU_ADDRESS 0x70003DD8 /end MEASUREMENT
/begin MEASUREMENT InjSys_mFuSumStbMem "sum absolute fuel mass memory (standby injection mode)" ULONG m_q0p01_mg 1 100 0.00 42949672.9500 FORMAT "%13.4" ARRAY_SIZE 4 ECU_ADDRESS 0x70003DC8 /end MEASUREMENT
/begin MEASUREMENT InjSys_mskMinTiBascCvo "cylinder individual mask for release minimal ti for CVO basic adaption" UBYTE dez 1 100 0.00 255.0 FORMAT "%5.1" ECU_ADDRESS 0x700025E0 /end MEASUREMENT
/begin MEASUREMENT InjSys_nrIdxInjCvo_a "Index for injections used in compression stroke for CVO" UBYTE dez 1 100 0.00 255.0 FORMAT "%5.1" ARRAY_SIZE 4 ECU_ADDRESS 0x700036B7 /end MEASUREMENT
/begin MEASUREMENT InjSys_nrInj "number of injections per packet" UBYTE dez 1 100 0.00 255.0 FORMAT "%5.1" ARRAY_SIZE 3 ECU_ADDRESS 0x700036A2 /end MEASUREMENT
/begin MEASUREMENT InjSys_nrInjActv "number of requested injections per working cycle by setpoint function" UBYTE dez 1 100 0.00 255.0 FORMAT "%5.1" ECU_ADDRESS 0x700036B6 /end MEASUREMENT
/begin MEASUREMENT InjSys_nrInjCorrn "number faded out injections" UBYTE dez 1 100 0.00 255.0 FORMAT "%5.1" ECU_ADDRESS 0x700036B5 /end MEASUREMENT
/begin MEASUREMENT InjSys_nrInjCycRaw "number of injections per working cycle raw value" UBYTE dez 1 100 0.00 255.0 FORMAT "%5.1" ECU_ADDRESS 0x700036B3 /end MEASUREMENT
/begin MEASUREMENT InjSys_nrInjCycRawStb "number of injections per working cycle raw value (standby injection mode)" UBYTE dez 1 100 0.00 255.0 FORMAT "%5.1" ECU_ADDRESS 0x700036B2 /end MEASUREMENT
/begin MEASUREMENT InjSys_nrInjPkt "number of injections per packet" UBYTE dez 1 100 0.00 255.0 FORMAT "%5.1" ARRAY_SIZE 3 ECU_ADDRESS 0x700029D4 /end MEASUREMENT
/begin MEASUREMENT InjSys_nrInjStb "number of injections (standby injection mode)" UBYTE dez 1 100 0.00 255.0 FORMAT "%5.1" ARRAY_SIZE 3 ECU_ADDRESS 0x700036AB /end MEASUREMENT
/begin MEASUREMENT InjSys_nrInjSyn0 "number of injections S0 timing" UBYTE dez 1 100 0.00 255.0 FORMAT "%5.1" ECU_ADDRESS 0x700036AA /end MEASUREMENT
/begin MEASUREMENT InjSys_nrInjSyn0Mem "buffered number of injections S0 timing" UBYTE dez 1 100 0.00 255.0 FORMAT "%5.1" ARRAY_SIZE 4 ECU_ADDRESS 0x700036A6 /end MEASUREMENT
/begin MEASUREMENT InjSys_nrInjSyn0Stb "number of injections S0 timing (standby injection mode)" UBYTE dez 1 100 0.00 255.0 FORMAT "%5.1" ECU_ADDRESS 0x700036A5 /end MEASUREMENT
/begin MEASUREMENT InjSys_pDeltaRailChmbSyn0 "delta pressure between fuel rail and combustion chamber S0 timing" UWORD RBPtCel_p_0p002_1 1 100 0.00 131.0700 FORMAT "%8.4" ARRAY_SIZE 4 ECU_ADDRESS 0x7000392A /end MEASUREMENT
/begin MEASUREMENT InjSys_pDeltaRailChmbSyn0Stb "delta pressure between fuel rail and combustion chamber S0 timing (standby injection mode)" UWORD RBPtCel_p_0p002_1 1 100 0.00 131.0700 FORMAT "%8.4" ARRAY_SIZE 4 ECU_ADDRESS 0x70003932 /end MEASUREMENT
/begin MEASUREMENT InjSys_pDeltaRailChmbSyn1 "delta pressure between fuel rail and combustion chamber S1 timing" UWORD RBPtCel_p_0p002_1 1 100 0.00 131.0700 FORMAT "%8.4" ARRAY_SIZE 4 ECU_ADDRESS 0x7000391A /end MEASUREMENT
/begin MEASUREMENT InjSys_pDeltaRailChmbSyn1Stb "delta pressure between fuel rail and combustion chamber S1 timing (standby injection mode)" UWORD RBPtCel_p_0p002_1 1 100 0.00 131.0700 FORMAT "%8.4" ARRAY_SIZE 4 ECU_ADDRESS 0x70003922 /end MEASUREMENT
/begin MEASUREMENT InjSys_pInjIndCvoExtdRng "Pressure difference fuelrail-CC" UWORD RBPtCel_p_0p002_1 1 100 0.00 131.0700 FORMAT "%8.4" ARRAY_SIZE 4 ECU_ADDRESS 0x70003912 /end MEASUREMENT
/begin MEASUREMENT InjSys_pMnfldCorrdExtdRng "Manifold pressure corrected (extended range)" UWORD p_q0p078 1 100 0.00 5119.922 FORMAT "%8.3" ECU_ADDRESS 0x70003910 /end MEASUREMENT
/begin MEASUREMENT InjSys_ratAirChrgLoc "Relative air charge" UWORD rel_q0p0234 1 100 0.00 1535.977 FORMAT "%8.3" ECU_ADDRESS 0x700025EA /end MEASUREMENT
/begin MEASUREMENT InjSys_ratAirChrgPrdc "rel. air charge predicted for injection calculation (local)" UWORD rel_q0p0234 1 100 0.00 1535.977 FORMAT "%8.3" ECU_ADDRESS 0x700025E8 /end MEASUREMENT
/begin MEASUREMENT InjSys_ratChrgAirSync0 "Relative air charge intended for mixture calculation that applies to the fuel injection (advanced S0 context)" UWORD rel_uw_q0p0234 1 100 0.00 1535.977 FORMAT "%8.3" ECU_ADDRESS 0x70003906 /end MEASUREMENT
/begin MEASUREMENT InjSys_ratChrgAirSync1 "Relative air charge intended for mixture calculation that applies to the fuel injection (late S1context)" UWORD rel_uw_q0p0234 1 100 0.00 1535.977 FORMAT "%8.3" ECU_ADDRESS 0x70003904 /end MEASUREMENT
/begin MEASUREMENT InjSys_ratFuM "Relative fuel mass" UWORD rel_uw_b3072 1 100 0.00 3071.953 FORMAT "%8.3" ECU_ADDRESS 0x600006D8 /end MEASUREMENT
/begin MEASUREMENT InjSys_ratFuMAdpnAddl "local additive adaptive correction of the relative fuel amount" SWORD rel_sw_b1536 1 100 -1536.000 1535.953 FORMAT "%8.3" ECU_ADDRESS 0x70003AE4 /end MEASUREMENT
/begin MEASUREMENT InjSys_ratFuMAux1 "relative fuel mass packet auxiliary injection 1" UWORD rel_uw_b3072 1 100 0.00 3071.953 FORMAT "%8.3" ARRAY_SIZE 3 ECU_ADDRESS 0x700038F0 /end MEASUREMENT
/begin MEASUREMENT InjSys_ratFuMAux1Appl "relative fuel mass packet auxiliary injection 1 raw value" UWORD rel_uw_b3072 1 100 0.00 3071.953 FORMAT "%8.3" ARRAY_SIZE 3 ECU_ADDRESS 0x700029CE /end MEASUREMENT
/begin MEASUREMENT InjSys_ratFuMAux1ApplStb "relative fuel mass packet auxiliary injection 1 raw value (standby injection mode)" UWORD rel_uw_b3072 1 100 0.00 3071.953 FORMAT "%8.3" ARRAY_SIZE 3 ECU_ADDRESS 0x700029C8 /end MEASUREMENT
/begin MEASUREMENT InjSys_ratFuMAux1Mem "buffered relative fuel mass packet auxiliary injection 1" UWORD rel_uw_b3072 1 100 0.00 3071.953 FORMAT "%8.3" ARRAY_SIZE 4 ECU_ADDRESS 0x700038FC /end MEASUREMENT
/begin MEASUREMENT InjSys_ratFuMAux1Stb "relative fuel mass packet auxiliary injection 1 (standby injection mode)" UWORD rel_uw_b3072 1 100 0.00 3071.953 FORMAT "%8.3" ARRAY_SIZE 3 ECU_ADDRESS 0x700038F6 /end MEASUREMENT
/begin MEASUREMENT InjSys_ratFuMAux2 "relative fuel mass packet auxiliary injection 2" UWORD rel_uw_b3072 1 100 0.00 3071.953 FORMAT "%8.3" ARRAY_SIZE 3 ECU_ADDRESS 0x700038DC /end MEASUREMENT
/begin MEASUREMENT InjSys_ratFuMAux2Appl "relative fuel mass packet auxiliary injection 2 raw value" UWORD rel_uw_b3072 1 100 0.00 3071.953 FORMAT "%8.3" ARRAY_SIZE 3 ECU_ADDRESS 0x700029C2 /end MEASUREMENT
/begin MEASUREMENT InjSys_ratFuMAux2ApplStb "relative fuel mass packet auxiliary injection 2 raw value (standby injection mode)" UWORD rel_uw_b3072 1 100 0.00 3071.953 FORMAT "%8.3" ARRAY_SIZE 3 ECU_ADDRESS 0x700029BC /end MEASUREMENT
/begin MEASUREMENT InjSys_ratFuMAux2Mem "buffered relative fuel mass packet auxiliary injection 2" UWORD rel_uw_b3072 1 100 0.00 3071.953 FORMAT "%8.3" ARRAY_SIZE 4 ECU_ADDRESS 0x700038E8 /end MEASUREMENT
/begin MEASUREMENT InjSys_ratFuMAux2Stb "relative fuel mass packet auxiliary injection 2 (standby injection mode)" UWORD rel_uw_b3072 1 100 0.00 3071.953 FORMAT "%8.3" ARRAY_SIZE 3 ECU_ADDRESS 0x700038E2 /end MEASUREMENT
/begin MEASUREMENT InjSys_ratFuMAvrg "average value of relative fuel mass" UWORD rel_uw_b3072 1 100 0.00 3071.953 FORMAT "%8.3" ECU_ADDRESS 0x700038DA /end MEASUREMENT
/begin MEASUREMENT InjSys_ratFuMBas "relative fuel mass packet base injection" UWORD rel_uw_b3072 1 100 0.00 3071.953 FORMAT "%8.3" ARRAY_SIZE 3 ECU_ADDRESS 0x700038C6 /end MEASUREMENT
/begin MEASUREMENT InjSys_ratFuMBasAppl "relative fuel mass packet base injection raw value" UWORD rel_uw_b3072 1 100 0.00 3071.953 FORMAT "%8.3" ARRAY_SIZE 3 ECU_ADDRESS 0x700029B6 /end MEASUREMENT
/begin MEASUREMENT InjSys_ratFuMBasApplStb "relative fuel mass packet base injection raw value (standby injection mode)" UWORD rel_uw_b3072 1 100 0.00 3071.953 FORMAT "%8.3" ARRAY_SIZE 3 ECU_ADDRESS 0x700029B0 /end MEASUREMENT
/begin MEASUREMENT InjSys_ratFuMBasMem "buffered relative fuel mass packet base injection" UWORD rel_uw_b3072 1 100 0.00 3071.953 FORMAT "%8.3" ARRAY_SIZE 4 ECU_ADDRESS 0x700038D2 /end MEASUREMENT
/begin MEASUREMENT InjSys_ratFuMBasStb "relative fuel mass packet base injection (standby injection mode)" UWORD rel_uw_b3072 1 100 0.00 3071.953 FORMAT "%8.3" ARRAY_SIZE 3 ECU_ADDRESS 0x700038CC /end MEASUREMENT
/begin MEASUREMENT InjSys_ratFuMCvo "relative fuel mass CVO injection" UWORD rel_uw_b3072 1 100 0.00 3071.953 FORMAT "%8.3" ECU_ADDRESS 0x700038C4 /end MEASUREMENT
/begin MEASUREMENT InjSys_ratFuMCylInd "relative fuel mass cylinder individual" UWORD rel_uw_b3072 1 100 0.00 3071.953 FORMAT "%8.3" ECU_ADDRESS 0x700038C2 /end MEASUREMENT
/begin MEASUREMENT InjSys_ratFuMCylIndRdnt_a "Complement array relative fuel mass cylinder individual" UWORD dez 1 100 0.00 65535.00 FORMAT "%8.2" ARRAY_SIZE 4 ECU_ADDRESS 0x700038BA /end MEASUREMENT
/begin MEASUREMENT InjSys_ratFuMCylIndStb "relative fuel mass cylinder individual (standby injection mode)" UWORD rel_uw_b3072 1 100 0.00 3071.953 FORMAT "%8.3" ECU_ADDRESS 0x700038B8 /end MEASUREMENT
/begin MEASUREMENT InjSys_ratFuMCylInd_a "array relative fuel mass cylinder individual" UWORD rel_uw_b3072 1 100 0.00 3071.953 FORMAT "%8.3" ARRAY_SIZE 4 ECU_ADDRESS 0x700038B0 /end MEASUREMENT
/begin MEASUREMENT InjSys_ratFuMInjIndRaw "relative fuel mass injection individual raw value" UWORD rel_uw_b3072 1 100 0.00 3071.953 FORMAT "%8.3" ARRAY_SIZE 4 ECU_ADDRESS 0x700029A8 /end MEASUREMENT
/begin MEASUREMENT InjSys_ratFuMMaxBall "maximum ballistic relative injection mass" UWORD rel_uw_b3072 1 100 0.00 3071.953 FORMAT "%8.3" ECU_ADDRESS 0x700038AE /end MEASUREMENT
/begin MEASUREMENT InjSys_ratFuMMinBall "minimum ballistic relative injection mass" UWORD rel_uw_b3072 1 100 0.00 3071.953 FORMAT "%8.3" ECU_ADDRESS 0x700038AC /end MEASUREMENT
/begin MEASUREMENT InjSys_ratFuMMinLnr "minimum relative injection mass in linear range" UWORD rel_uw_b3072 1 100 0.00 3071.953 FORMAT "%8.3" ECU_ADDRESS 0x700038AA /end MEASUREMENT
/begin MEASUREMENT InjSys_ratFuMMinMaiInj "minimum relative injection mass of main injection" UWORD rel_uw_b3072 1 100 0.00 3071.953 FORMAT "%8.3" ECU_ADDRESS 0x700038A8 /end MEASUREMENT
/begin MEASUREMENT InjSys_ratFuMPkt "relative fuel mass packet" UWORD rel_uw_b3072 1 100 0.00 3071.953 FORMAT "%8.3" ARRAY_SIZE 3 ECU_ADDRESS 0x7000389C /end MEASUREMENT
/begin MEASUREMENT InjSys_ratFuMPktStb "relative fuel mass packet (standby injection mode)" UWORD rel_uw_b3072 1 100 0.00 3071.953 FORMAT "%8.3" ARRAY_SIZE 3 ECU_ADDRESS 0x700038A2 /end MEASUREMENT
/begin MEASUREMENT InjSys_ratFuMSum "relative fuel mass injection sum" UWORD rel_uw_b3072 1 100 0.00 3071.953 FORMAT "%8.3" ECU_ADDRESS 0x70002A08 /end MEASUREMENT
/begin MEASUREMENT InjSys_ratFuMSyn0 "relative fuel mass injection individual S0 timing" UWORD rel_uw_b3072 1 100 0.00 3071.953 FORMAT "%8.3" ARRAY_SIZE 4 ECU_ADDRESS 0x7000388C /end MEASUREMENT
/begin MEASUREMENT InjSys_ratFuMSyn0Stb "relative fuel mass injection individual S0 timing (standby injection mode)" UWORD rel_uw_b3072 1 100 0.00 3071.953 FORMAT "%8.3" ARRAY_SIZE 4 ECU_ADDRESS 0x70003894 /end MEASUREMENT
/begin MEASUREMENT InjSys_ratFuMSyn1 "relative fuel mass injection individual S1 timing" UWORD rel_uw_b3072 1 100 0.00 3071.953 FORMAT "%8.3" ARRAY_SIZE 4 ECU_ADDRESS 0x7000387C /end MEASUREMENT
/begin MEASUREMENT InjSys_ratFuMSyn1Stb "relative fuel mass injection individual S1 timing (standby injection mode)" UWORD rel_uw_b3072 1 100 0.00 3071.953 FORMAT "%8.3" ARRAY_SIZE 4 ECU_ADDRESS 0x70003884 /end MEASUREMENT
/begin MEASUREMENT InjSys_ratFuMTmpSyn0 "relative fuel mass injection individual S0 timing temporary" UWORD rel_uw_b3072 1 100 0.00 3071.953 FORMAT "%8.3" ARRAY_SIZE 4 ECU_ADDRESS 0x70002A00 /end MEASUREMENT
/begin MEASUREMENT InjSys_ratFuMTmpSyn0Stb "relative fuel mass injection individual S0 timing temporary (standby injection mode)" UWORD rel_uw_b3072 1 100 0.00 3071.953 FORMAT "%8.3" ARRAY_SIZE 4 ECU_ADDRESS 0x700029F8 /end MEASUREMENT
/begin MEASUREMENT InjSys_ratFuMTot "relative fuel mass total" UWORD rel_uw_b3072 1 100 0.00 3071.953 FORMAT "%8.3" ECU_ADDRESS 0x600006DA /end MEASUREMENT
/begin MEASUREMENT InjSys_ratFuMTranCmpLoc "rel. fuel mass transition compensation (local)" SWORD rel_sw_b1536 1 100 -1536.000 1535.953 FORMAT "%8.3" ECU_ADDRESS 0x700025E4 /end MEASUREMENT
/begin MEASUREMENT InjSys_ratLamSp "Desired Lambda (current calculation)" UWORD fak_uw_b16 1 100 0.00 15.99976 FORMAT "%8.5" ECU_ADDRESS 0x700025E2 /end MEASUREMENT
/begin MEASUREMENT InjSys_ratLamSpSyn0 "Cylinder individual Desired Lambda (current calculation) in S0" UWORD fak_uw_b16 1 100 0.00 15.99976 FORMAT "%8.5" ARRAY_SIZE 4 ECU_ADDRESS 0x70003874 /end MEASUREMENT
/begin MEASUREMENT InjSys_ratPrdcAirLamDes "relative air mass for computation of desired lambda" UWORD rel_uw_q0p0234 1 100 0.00 1535.977 FORMAT "%8.3" ECU_ADDRESS 0x600006E6 /end MEASUREMENT
/begin MEASUREMENT InjSys_ratPrdcFuMLamDesAvrg "predicted average relative fuel mass for the current lambda setpoint." UWORD rel_uw_b3072 1 100 0.00 3071.953 FORMAT "%8.3" ECU_ADDRESS 0x70003872 /end MEASUREMENT
/begin MEASUREMENT InjSys_ratRelAirChrgTmp "Relative air charge" UWORD rel_q0p0234 1 100 0.00 1535.977 FORMAT "%8.3" ECU_ADDRESS 0x700025E6 /end MEASUREMENT
/begin MEASUREMENT InjSys_stAgEnd "state end angle addressing packet" UBYTE dez 1 100 0.00 255.0 FORMAT "%5.1" ARRAY_SIZE 3 ECU_ADDRESS 0x7000369B /end MEASUREMENT
/begin MEASUREMENT InjSys_stAgEndStb "state end angle addressing packet (standby injection mode)" UBYTE dez 1 100 0.00 255.0 FORMAT "%5.1" ARRAY_SIZE 3 ECU_ADDRESS 0x7000369E /end MEASUREMENT
/begin MEASUREMENT InjSys_stMaiInj "state main injection" UBYTE dez 1 100 0.00 255.0 FORMAT "%5.1" ARRAY_SIZE 3 ECU_ADDRESS 0x70003682 /end MEASUREMENT
/begin MEASUREMENT InjSys_stMaiInjStb "state main injection standby" UBYTE dez 1 100 0.00 255.0 FORMAT "%5.1" ARRAY_SIZE 3 ECU_ADDRESS 0x70003685 /end MEASUREMENT
/begin MEASUREMENT InjSys_stTransSctnActv "Status transition area active" UBYTE OneToOne 1 100 0.00 255.0 FORMAT "%5.1" ARRAY_SIZE 4 ECU_ADDRESS 0x700029F4 /end MEASUREMENT
/begin MEASUREMENT InjSys_tiBreakHiReslAux1 "time pause high resolution packet auxiliary injection 1" SWORD t_q0p001_ms 1 100 -32.76800 32.76700 FORMAT "%8.5" ARRAY_SIZE 3 ECU_ADDRESS 0x70003AD6 /end MEASUREMENT
/begin MEASUREMENT InjSys_tiBreakHiReslAux1Stb "time pause high resolution packet auxiliary injection 1 (standby injection mode)" SWORD t_q0p001_ms 1 100 -32.76800 32.76700 FORMAT "%8.5" ARRAY_SIZE 3 ECU_ADDRESS 0x70003ADC /end MEASUREMENT
/begin MEASUREMENT InjSys_tiBreakHiReslAux2 "time pause high resolution packet auxiliary injection 2" SWORD t_q0p001_ms 1 100 -32.76800 32.76700 FORMAT "%8.5" ARRAY_SIZE 3 ECU_ADDRESS 0x70003ACA /end MEASUREMENT
/begin MEASUREMENT InjSys_tiBreakHiReslAux2Stb "time pause high resolution packet auxiliary injection 2 (standby injection mode)" SWORD t_q0p001_ms 1 100 -32.76800 32.76700 FORMAT "%8.5" ARRAY_SIZE 3 ECU_ADDRESS 0x70003AD0 /end MEASUREMENT
/begin MEASUREMENT InjSys_tiBreakHiReslSyn0 "time pause injection individual S0 timing - High Resolution" SWORD t_q0p001_ms 1 100 -32.76800 32.76700 FORMAT "%8.5" ARRAY_SIZE 4 ECU_ADDRESS 0x70003ABA /end MEASUREMENT
/begin MEASUREMENT InjSys_tiBreakHiReslSyn0Stb "time pause injection individual S0 timing (standby injection mode)- High Resolution" SWORD t_q0p001_ms 1 100 -32.76800 32.76700 FORMAT "%8.5" ARRAY_SIZE 4 ECU_ADDRESS 0x70003AC2 /end MEASUREMENT
/begin MEASUREMENT InjSys_tiBreakHiReslSyn1 "time pause injection individual S1 timing- High Resolution" SWORD t_q0p001_ms 1 100 -32.76800 32.76700 FORMAT "%8.5" ARRAY_SIZE 4 ECU_ADDRESS 0x70003AAA /end MEASUREMENT
/begin MEASUREMENT InjSys_tiBreakHiReslSyn1Stb "time pause injection individual S1 timing (standby injection mode)- High Resolution" SWORD t_q0p001_ms 1 100 -32.76800 32.76700 FORMAT "%8.5" ARRAY_SIZE 4 ECU_ADDRESS 0x70003AB2 /end MEASUREMENT
/begin MEASUREMENT InjSys_tiBreakHiReslTmpSyn0 "time pause injection individual temporary S0 timing - High Resolution" SWORD t_q0p001_ms 1 100 -32.76800 32.76700 FORMAT "%8.5" ARRAY_SIZE 4 ECU_ADDRESS 0x700029EC /end MEASUREMENT
/begin MEASUREMENT InjSys_tiBreakHiReslTmpSyn0Stb "time pause injection individual temporary S0 timing (standby injection mode - High Resolution" SWORD t_q0p001_ms 1 100 -32.76800 32.76700 FORMAT "%8.5" ARRAY_SIZE 4 ECU_ADDRESS 0x700029E4 /end MEASUREMENT
/begin MEASUREMENT InjSys_tiBreakHiReslTmpSyn1 "time pause injection individual temporary S1 timing - High Resolution" SWORD t_q0p001_ms 1 100 -32.76800 32.76700 FORMAT "%8.5" ARRAY_SIZE 4 ECU_ADDRESS 0x700029DC /end MEASUREMENT
/begin MEASUREMENT InjSys_tiBreakPkt "pause time injection packet" SWORD t_q0p001_ms 1 100 -32.76800 32.76700 FORMAT "%8.5" ARRAY_SIZE 3 ECU_ADDRESS 0x70003A9E /end MEASUREMENT
/begin MEASUREMENT InjSys_tiBreakPktStb "pause time injection packet standby" SWORD t_q0p001_ms 1 100 -32.76800 32.76700 FORMAT "%8.5" ARRAY_SIZE 3 ECU_ADDRESS 0x70003AA4 /end MEASUREMENT
/begin MEASUREMENT InjSys_tiDesCvo "Desired Injection time for CVO Adaptation" UWORD t_q0p001_ms 1 100 0.00 65.53500 FORMAT "%8.5" ECU_ADDRESS 0x70003868 /end MEASUREMENT
/begin MEASUREMENT InjSys_tiDesOpenInjCvo1_Ary "desired value valve needle flight duration of the 1. injection" UWORD t_q0p001_ms 1 100 0.00 65.53500 FORMAT "%8.5" ARRAY_SIZE 4 ECU_ADDRESS 0x70003860 /end MEASUREMENT
/begin MEASUREMENT InjSys_tiDesOpenInjCvo2_Ary "desired value valve needle flight duration of the 2. injection" UWORD t_q0p001_ms 1 100 0.00 65.53500 FORMAT "%8.5" ARRAY_SIZE 4 ECU_ADDRESS 0x70003858 /end MEASUREMENT
/begin MEASUREMENT InjSys_tiDesOpenInjCvo3_Ary "desired value valve needle flight duration of the 3. injection" UWORD t_q0p001_ms 1 100 0.00 65.53500 FORMAT "%8.5" ARRAY_SIZE 4 ECU_ADDRESS 0x70003850 /end MEASUREMENT
/begin MEASUREMENT InjSys_tiDesOpenInjCvo4_Ary "desired value valve needle flight duration of the 4. injection" UWORD t_q0p001_ms 1 100 0.00 65.53500 FORMAT "%8.5" ARRAY_SIZE 4 ECU_ADDRESS 0x70003848 /end MEASUREMENT
/begin MEASUREMENT InjSys_tiInjMin "minimum injection time" UWORD t_q0p001_ms 1 100 0.00 65.53500 FORMAT "%8.5" ECU_ADDRESS 0x70003846 /end MEASUREMENT
/begin MEASUREMENT InjSys_tiInjMinIndInj "minimum injection time (pulse individual)" UWORD t_q0p001_ms 1 100 0.00 65.53500 FORMAT "%8.5" ARRAY_SIZE 4 ECU_ADDRESS 0x7000383E /end MEASUREMENT
/begin MEASUREMENT InjSys_tiInjNlnrMaxHiResl "injection time non-linear maximum, high resolution" UWORD t_q0p0004_ms 1 100 0.00 26.21400 FORMAT "%8.5" ECU_ADDRESS 0x60008E08 /end MEASUREMENT
/begin MEASUREMENT InjSys_tiInjNlnrOffsHiResl "injection time non-linear offset, high resolution" SWORD t_q0p0004_ms 1 100 -13.10720 13.10680 FORMAT "%8.5" ECU_ADDRESS 0x60009070 /end MEASUREMENT
/begin MEASUREMENT InjSys_tiInjOpenMaxHiResl "injection time open valve maximum, high resolution" UWORD t_q0p0004_ms 1 100 0.00 26.21400 FORMAT "%8.5" ECU_ADDRESS 0x60008E06 /end MEASUREMENT
/begin MEASUREMENT InjSys_tiInjOpenOffsHiResl "injection time open valve offset, high resolution" SWORD t_q0p0004_ms 1 100 -13.10720 13.10680 FORMAT "%8.5" ECU_ADDRESS 0x6000906E /end MEASUREMENT
/begin MEASUREMENT InjSys_tiInjOpenSyn0 "injection time open valve S0 timing" ULONG t_q0p0004_ms 1 100 0.00 1717986.91800 FORMAT "%13.5" ARRAY_SIZE 4 ECU_ADDRESS 0x70003DA0 /end MEASUREMENT
/begin MEASUREMENT InjSys_tiInjOpenSyn0Stb "injection time open valve S0 timing (standby injection mode)" ULONG t_q0p0004_ms 1 100 0.00 1717986.91800 FORMAT "%13.5" ARRAY_SIZE 4 ECU_ADDRESS 0x70003DB0 /end MEASUREMENT
/begin MEASUREMENT InjSys_tiInjOpenSyn1 "injection time open valve S1 timing" ULONG t_q0p0004_ms 1 100 0.00 1717986.91800 FORMAT "%13.5" ARRAY_SIZE 4 ECU_ADDRESS 0x70003D80 /end MEASUREMENT
/begin MEASUREMENT InjSys_tiInjOpenSyn1Stb "injection time open valve S1 timing (standby injection mode)" ULONG t_q0p0004_ms 1 100 0.00 1717986.91800 FORMAT "%13.5" ARRAY_SIZE 4 ECU_ADDRESS 0x70003D90 /end MEASUREMENT
/begin MEASUREMENT InjSys_tiInjRefBgnTrans "Injection time reference point begin transition range" UWORD t_q0p001_ms 1 100 0.00 65.53500 FORMAT "%8.5" ECU_ADDRESS 0x7000383C /end MEASUREMENT
/begin MEASUREMENT InjSys_tiInjRefCvo "Reference injection time for CVO basic adaptation" UWORD t_q0p001_ms 1 100 0.00 65.53500 FORMAT "%8.5" ECU_ADDRESS 0x7000383A /end MEASUREMENT
/begin MEASUREMENT InjSys_tiInjrPOffsRef "Injector delay time for the reference injection" SWORD t_q0p0004_ms 1 100 -13.10720 13.10680 FORMAT "%8.5" ECU_ADDRESS 0x70003A9C /end MEASUREMENT
/begin MEASUREMENT InjSys_tiInjSum "injection time sum" ULONG t_q0p0004_ms 1 100 0.00 1717986.91800 FORMAT "%13.5" ECU_ADDRESS 0x70003D7C /end MEASUREMENT
/begin MEASUREMENT InjSys_tiInjSumMem "sum injection time memory" ULONG t_q0p0004_ms 1 100 0.00 1717986.91800 FORMAT "%13.5" ARRAY_SIZE 4 ECU_ADDRESS 0x70003D5C /end MEASUREMENT
/begin MEASUREMENT InjSys_tiInjSumStb "injection time sum (standby injection mode)" ULONG t_q0p0004_ms 1 100 0.00 1717986.91800 FORMAT "%13.5" ECU_ADDRESS 0x70003D58 /end MEASUREMENT
/begin MEASUREMENT InjSys_tiInjSumStbMem "sum injection time memory (standby injection mode)" ULONG t_q0p0004_ms 1 100 0.00 1717986.91800 FORMAT "%13.5" ARRAY_SIZE 4 ECU_ADDRESS 0x70003D48 /end MEASUREMENT
/begin MEASUREMENT InjSys_tiInjSyn0 "injection time S0 timing" ULONG t_q0p0004_ms 1 100 0.00 1717986.91800 FORMAT "%13.5" ARRAY_SIZE 4 ECU_ADDRESS 0x70003D28 /end MEASUREMENT
/begin MEASUREMENT InjSys_tiInjSyn0Stb "injection time S0 timing (standby injection mode)" ULONG t_q0p0004_ms 1 100 0.00 1717986.91800 FORMAT "%13.5" ARRAY_SIZE 4 ECU_ADDRESS 0x70003D38 /end MEASUREMENT
/begin MEASUREMENT InjSys_tiInjSyn1 "injection time S1 timing" ULONG t_q0p0004_ms 1 100 0.00 1717986.91800 FORMAT "%13.5" ARRAY_SIZE 4 ECU_ADDRESS 0x70003D08 /end MEASUREMENT
/begin MEASUREMENT InjSys_tiInjSyn1Stb "injection time S1 timing (standby injection mode)" ULONG t_q0p0004_ms 1 100 0.00 1717986.91800 FORMAT "%13.5" ARRAY_SIZE 4 ECU_ADDRESS 0x70003D18 /end MEASUREMENT
/begin MEASUREMENT InjSys_tiOffsMinMiCvo "Injection time offset between current main injection and minimum main injection" UWORD t_q0p001_ms 1 100 0.00 65.53500 FORMAT "%8.5" ECU_ADDRESS 0x70003838 /end MEASUREMENT
/begin MEASUREMENT InjSys_tiOpenEndBall "Maximum injection time in the ballistic range" UWORD t_q0p0004_ms 1 100 0.00 26.21400 FORMAT "%8.5" ECU_ADDRESS 0x70003836 /end MEASUREMENT
/begin MEASUREMENT InjSys_tiOpenInvCvo "CVO Injection open time invers" UWORD t_q0p0004_ms 1 100 0.00 26.21400 FORMAT "%8.5" ECU_ADDRESS 0x70003834 /end MEASUREMENT
/begin MEASUREMENT InjSys_tiOpenRefCvo "Injection open time reference point CVO" UWORD t_q0p0004_ms 1 100 0.00 26.21400 FORMAT "%8.5" ECU_ADDRESS 0x70003832 /end MEASUREMENT
/begin MEASUREMENT InjSys_volFuSum "sum absolute fuel volume" ULONG vol_q1Em5_ml 1 100 0.00 42949.6729500 FORMAT "%13.7" ECU_ADDRESS 0x70003CB4 /end MEASUREMENT
/begin MEASUREMENT InjSys_volFuSumMem "sum fuel volume memory" ULONG vol_q1Em5_ml 1 100 0.00 42949.6729500 FORMAT "%13.7" ARRAY_SIZE 4 ECU_ADDRESS 0x70003CA4 /end MEASUREMENT
/begin MEASUREMENT InjSys_volFuSumStb "sum absolute fuel volume (standby injection mode)" ULONG vol_q1Em5_ml 1 100 0.00 42949.6729500 FORMAT "%13.7" ECU_ADDRESS 0x70003CA0 /end MEASUREMENT
/begin MEASUREMENT InjSys_volFuSumStbMem "sum fuel volume memory (standby injection mode)" ULONG vol_q1Em5_ml 1 100 0.00 42949.6729500 FORMAT "%13.7" ARRAY_SIZE 4 ECU_ADDRESS 0x70003C90 /end MEASUREMENT
/begin MEASUREMENT injvlvps_cntErr_Conf_u8 "Counter configuration error" UBYTE dez 1 100 0.00 255.0 FORMAT "%5.1" ECU_ADDRESS 0x7000258D /end MEASUREMENT
/begin MEASUREMENT InjVlvPs_ConCJ_ctIniDrv "internal counter for IniDrives" UBYTE dez 1 100 0.00 255.0 FORMAT "%5.1" ECU_ADDRESS 0x7000258C /end MEASUREMENT
/begin MEASUREMENT injvlvps_dhdevee_b "conditions HDEV powerstage diagnosis fulfilled" UBYTE B_TRUE 1 100 0.00 1.00000000000 BIT_MASK 0x1 FORMAT "%13.11" ECU_ADDRESS 0x700001F1 /end MEASUREMENT
/begin MEASUREMENT InjVlvPs_DiagDcDc_u32 "DCDC-Diagnosis Info" ULONG OneToOne 1 100 0.00 4294967295.00 FORMAT "%13.2" ARRAY_SIZE 2 ECU_ADDRESS 0x7000254C /end MEASUREMENT
/begin MEASUREMENT InjVlvPs_Dia_AbmNoLd_u8 "Suppression-Mask for Error: Open Load" UBYTE OneToOne 1 100 0.00 255.0 FORMAT "%5.1" ARRAY_SIZE 4 ECU_ADDRESS 0x70002545 /end MEASUREMENT
/begin MEASUREMENT InjVlvPs_Dia_AbmScBnk_u8 "Suppression-Mask for Error: Short Circuit On Bank (HighSide)" UBYTE OneToOne 1 100 0.00 255.0 FORMAT "%5.1" ARRAY_SIZE 4 ECU_ADDRESS 0x70002541 /end MEASUREMENT
/begin MEASUREMENT InjVlvPs_Dia_AbmScCyl_u8 "Suppression-Mask for Error: Short Circuit On Cylinder (LowSide)" UBYTE OneToOne 1 100 0.00 255.0 FORMAT "%5.1" ARRAY_SIZE 4 ECU_ADDRESS 0x7000253D /end MEASUREMENT
/begin MEASUREMENT InjVlvPs_Dia_AbmScHsLs_u8 "Suppression-Mask for Error: Short Circuit between High- and LowSide" UBYTE OneToOne 1 100 0.00 255.0 FORMAT "%5.1" ARRAY_SIZE 4 ECU_ADDRESS 0x70002539 /end MEASUREMENT
/begin MEASUREMENT InjVlvPs_Dia_Abm_Cyl_u8 "Suppression-Mask, which is set by an error on this cylinder" UBYTE OneToOne 1 100 0.00 255.0 FORMAT "%5.1" ARRAY_SIZE 4 ECU_ADDRESS 0x70002535 /end MEASUREMENT
/begin MEASUREMENT InjVlvPs_Dia_cntErr_SpiInit_u8 "Error counter: SPI-Initialization" UBYTE OneToOne 1 100 0.00 255.0 FORMAT "%5.1" ARRAY_SIZE 1 ECU_ADDRESS 0x70002534 /end MEASUREMENT
/begin MEASUREMENT InjVlvPs_Dia_cntErr_SpiReq_u8 "Error counter: SPI-Request" UBYTE OneToOne 1 100 0.00 255.0 FORMAT "%5.1" ARRAY_SIZE 1 ECU_ADDRESS 0x70002533 /end MEASUREMENT
/begin MEASUREMENT InjVlvPs_Dia_cntErr_SpiTx_u8 "Error counter: SPI-Transmit" UBYTE OneToOne 1 100 0.00 255.0 FORMAT "%5.1" ARRAY_SIZE 1 ECU_ADDRESS 0x70002532 /end MEASUREMENT
/begin MEASUREMENT InjVlvPs_Dia_cntErr_ValDiff_u8 "Error counter: Value irregularity" UBYTE OneToOne 1 100 0.00 255.0 FORMAT "%5.1" ARRAY_SIZE 1 ECU_ADDRESS 0x70002531 /end MEASUREMENT
/begin MEASUREMENT InjVlvPs_Dia_ctIniDrv "internal counter for IniDrives" UBYTE OneToOne 1 100 0.00 255.0 FORMAT "%5.1" ECU_ADDRESS 0x70002530 /end MEASUREMENT
/begin MEASUREMENT InjVlvPs_Dia_DiagInfo_Cyl_u32 "Cylinder specific diagnosis information from the powerstage" ULONG OneToOne 1 100 0.00 4294967295.00 FORMAT "%13.2" ARRAY_SIZE 4 ECU_ADDRESS 0x70002520 /end MEASUREMENT
/begin MEASUREMENT InjVlvPs_Dia_DiagInfo_IC_u32 "Powerstage specific diagnosis information from the powerstage" ULONG OneToOne 1 100 0.00 4294967295.00 FORMAT "%13.2" ARRAY_SIZE 2 ECU_ADDRESS 0x70002518 /end MEASUREMENT
/begin MEASUREMENT InjVlvPs_Dia_drven "Drive enable state of the powerstage" SLONG OneToOne 1 100 -2147483648.00 2147483647.00 FORMAT "%13.2" ARRAY_SIZE 1 ECU_ADDRESS 0x70002514 /end MEASUREMENT
/begin MEASUREMENT InjVlvPs_Dia_HdevErr_Cyl_u8 "Suppression-Mask created out of the HDEV_DFCs" UBYTE OneToOne 1 100 0.00 255.0 FORMAT "%5.1" ECU_ADDRESS 0x70002510 /end MEASUREMENT
/begin MEASUREMENT InjVlvPs_Dia_HealPrms "Fault heal permission" UBYTE B_TRUE 1 100 0.00 1.00000000000 BIT_MASK 0x1 FORMAT "%13.11" ECU_ADDRESS 0x700001F0 /end MEASUREMENT
/begin MEASUREMENT InjVlvPs_Dia_mskCylNotActv "Pattern for cylinder individual deactivation of the diagnosis" UBYTE OneToOne 1 100 0.00 255.0 FORMAT "%5.1" ECU_ADDRESS 0x7000250F /end MEASUREMENT
/begin MEASUREMENT InjVlvPs_Dia_nrDcDcActv_u8 "Number of active dcdc converter" UBYTE OneToOne 1 100 0.00 255.0 FORMAT "%5.1" ECU_ADDRESS 0x700024F2 /end MEASUREMENT
/begin MEASUREMENT InjVlvPs_Dia_nrDevActv_u8 "Number of active powerstage ICs" UBYTE OneToOne 1 100 0.00 255.0 FORMAT "%5.1" ECU_ADDRESS 0x700024F1 /end MEASUREMENT
/begin MEASUREMENT InjVlvPs_Dia_nrVlvToStrt "Logic HW-ps number of corresponding SW-cylinder number" UBYTE OneToOne 1 100 0.00 255.0 FORMAT "%5.1" ARRAY_SIZE 4 ECU_ADDRESS 0x7000250B /end MEASUREMENT
/begin MEASUREMENT InjVlvPs_Dia_State_Cyl_u8 "cylinder specific state of the diagnosis" UBYTE OneToOne 1 100 0.00 255.0 FORMAT "%5.1" ARRAY_SIZE 4 ECU_ADDRESS 0x70002507 /end MEASUREMENT
/begin MEASUREMENT InjVlvPs_Dia_stCylOk_u8 "Bitcoded information about faultfree cylinder" UBYTE OneToOne 1 100 0.00 255.0 FORMAT "%5.1" ECU_ADDRESS 0x70003681 /end MEASUREMENT
/begin MEASUREMENT InjVlvPs_Dia_stFscDiagAct_u8 "status diagnosis of HW-ps (bitcoded, 1 bit per ps, 1 = active, 0 = inactive)" UBYTE OneToOne 1 100 0.00 255.0 FORMAT "%5.1" ECU_ADDRESS 0x70002506 /end MEASUREMENT
/begin MEASUREMENT InjVlvPs_Dia_tHealing_Cyl_u16 "cylinder specific counter for the time since the last healing" UWORD t_q0p02 1 100 0.00 1310.700 FORMAT "%8.3" ARRAY_SIZE 4 ECU_ADDRESS 0x700024FE /end MEASUREMENT
/begin MEASUREMENT InjVlvPs_Dia_uBatt_u16 "Battery voltage for DGDI-S diagnosis" UWORD spg_q0p1 1 100 0.00 6553.500 FORMAT "%8.3" ECU_ADDRESS 0x700024FC /end MEASUREMENT
/begin MEASUREMENT InjVlvPs_Dia_Ver_HW "Hardware-Version of the powerstage" SLONG OneToOne 1 100 -2147483648.00 2147483647.00 FORMAT "%13.2" ARRAY_SIZE 1 ECU_ADDRESS 0x700024F8 /end MEASUREMENT
/begin MEASUREMENT InjVlvPs_Dia_WDA_ReadCnt "Counter: WDA-Read events for powerstage information" UBYTE OneToOne 1 100 0.00 255.0 FORMAT "%5.1" ECU_ADDRESS 0x700024F5 /end MEASUREMENT
/begin MEASUREMENT InjVlvPs_Dia_WDA_ReadRet "Return Value: powerstage information for WDA" UBYTE OneToOne 1 100 0.00 255.0 FORMAT "%5.1" ECU_ADDRESS 0x700024F4 /end MEASUREMENT
/begin MEASUREMENT InjVlvPs_Dia_WDA_ReqCnt "Counter: WDA-Read requests for powerstage information" UBYTE OneToOne 1 100 0.00 255.0 FORMAT "%5.1" ECU_ADDRESS 0x700024F3 /end MEASUREMENT
/begin MEASUREMENT InjVlvPs_Dia_WDA_ReqRet "Return Value: WDA-Read request sucessfull or not" UBYTE B_TRUE 1 100 0.00 1.00000000000 BIT_MASK 0x1 FORMAT "%13.11" ECU_ADDRESS 0x700001EF /end MEASUREMENT
/begin MEASUREMENT InjVlvPs_numBnk "Number of banks" UBYTE dez 1 100 0.00 255.0 FORMAT "%5.1" ECU_ADDRESS 0x7000256C /end MEASUREMENT
/begin MEASUREMENT InjVlvPs_numCplCyl "Complementary cylinder" SBYTE dez 1 100 -128.0 127.0 FORMAT "%5.1" ARRAY_SIZE 4 ECU_ADDRESS 0x70002568 /end MEASUREMENT
/begin MEASUREMENT InjVlv_stAct_prmSetInjVlvPs "active parameter set assignment of injection valve power stage" ULONG OneToOne 1 100 0.00 4294967295.00 FORMAT "%13.2" ECU_ADDRESS 0x70003C8C /end MEASUREMENT
/begin MEASUREMENT InjVvG_FSC_RetVal_CmplxGetConfigFunc "FSC monitoring by Fsc_CmplxGetConfigFunc" ULONG OneToOne 1 100 0.00 4294967295.00 FORMAT "%13.2" ECU_ADDRESS 0x70002564 /end MEASUREMENT
/begin MEASUREMENT InjVvG_FSC_RetVal_GetConfig "FSC monitoring by Fsc_CmplxGetConfig" SLONG OneToOne 1 100 -2147483648.00 2147483647.00 FORMAT "%13.2" ECU_ADDRESS 0x70002560 /end MEASUREMENT
/begin MEASUREMENT InjVvG_FSC_RetVal_GetDiagFunc "FSC monitoring by Fsc_CmplxGetDiagFunc" ULONG OneToOne 1 100 0.00 4294967295.00 FORMAT "%13.2" ECU_ADDRESS 0x7000255C /end MEASUREMENT
/begin MEASUREMENT InjVvG_FSC_RetVal_GetVar "FSC monitoring by Fsc_CmplxGetVar" SLONG OneToOne 1 100 -2147483648.00 2147483647.00 FORMAT "%13.2" ECU_ADDRESS 0x70002558 /end MEASUREMENT
/begin MEASUREMENT IntkAirT_flgAirFltDsMeasdVld "Condition: measured intake air temperature after air filter is valid" UBYTE B_TRUE 1 100 0.00 1.00000000000 BIT_MASK 0x1 FORMAT "%13.11" ECU_ADDRESS 0x70000866 /end MEASUREMENT
/begin MEASUREMENT IntkAirT_flgDSMClrDevDrvrSnsr1 "local request for clearing electrical error of intake air temperature sensor 1" UBYTE B_TRUE 1 100 0.00 1.00000000000 BIT_MASK 0x1 FORMAT "%13.11" ECU_ADDRESS 0x6000B7E2 /end MEASUREMENT
/begin MEASUREMENT IntkAirT_flgDSMClrDevDrvrSnsr2 "local request for clearing electrical error of intake air temperature sensor 2" UBYTE B_TRUE 1 100 0.00 1.00000000000 BIT_MASK 0x1 FORMAT "%13.11" ECU_ADDRESS 0x6000B7E1 /end MEASUREMENT
/begin MEASUREMENT IntkAirT_flgImps1Err "Error flag of the electrical error (non plausible signal) of intake air temperature sensor 1, debounced" UBYTE B_TRUE 1 100 0.00 1.00000000000 BIT_MASK 0x1 FORMAT "%13.11" ECU_ADDRESS 0x6000F678 /end MEASUREMENT
/begin MEASUREMENT IntkAirT_flgImps1Errloc "local copy of the error flag" UBYTE B_TRUE 1 100 0.00 1.00000000000 BIT_MASK 0x1 FORMAT "%13.11" ECU_ADDRESS 0x6000B7E0 /end MEASUREMENT
/begin MEASUREMENT IntkAirT_flgImps1Heal "Healing flag of the electrical error (non plausible signal) of intake air temperature sensor 1, debounced" UBYTE B_TRUE 1 100 0.00 1.00000000000 BIT_MASK 0x1 FORMAT "%13.11" ECU_ADDRESS 0x6000F677 /end MEASUREMENT
/begin MEASUREMENT IntkAirT_flgImps1Healloc "local copy of the healing flag" UBYTE B_TRUE 1 100 0.00 1.00000000000 BIT_MASK 0x1 FORMAT "%13.11" ECU_ADDRESS 0x6000B7DF /end MEASUREMENT
/begin MEASUREMENT IntkAirT_flgImps1mld "stored electrical error non plausible signal of intake air sensor SnSr1" UBYTE B_TRUE 1 100 0.00 1.00000000000 BIT_MASK 0x1 FORMAT "%13.11" ECU_ADDRESS 0x60039291 /end MEASUREMENT
/begin MEASUREMENT IntkAirT_flgImps2Err "Error flag of the electrical error (non plausible signal) of intake air temperature sensor 2, debounced" UBYTE B_TRUE 1 100 0.00 1.00000000000 BIT_MASK 0x1 FORMAT "%13.11" ECU_ADDRESS 0x6000F676 /end MEASUREMENT
/begin MEASUREMENT IntkAirT_flgImps2Errloc "local copy of the error flag" UBYTE B_TRUE 1 100 0.00 1.00000000000 BIT_MASK 0x1 FORMAT "%13.11" ECU_ADDRESS 0x6000B7DE /end MEASUREMENT
/begin MEASUREMENT IntkAirT_flgImps2Heal "Healing flag of the electrical error (non plausible signal) of intake air temperature sensor 2, debounced" UBYTE B_TRUE 1 100 0.00 1.00000000000 BIT_MASK 0x1 FORMAT "%13.11" ECU_ADDRESS 0x6000F675 /end MEASUREMENT
/begin MEASUREMENT IntkAirT_flgImps2Healloc "local copy of the healing flag" UBYTE B_TRUE 1 100 0.00 1.00000000000 BIT_MASK 0x1 FORMAT "%13.11" ECU_ADDRESS 0x6000B7DD /end MEASUREMENT
/begin MEASUREMENT IntkAirT_flgImps2mld "stored electrical error non plausible signal of intake air sensor SnSr2" UBYTE B_TRUE 1 100 0.00 1.00000000000 BIT_MASK 0x1 FORMAT "%13.11" ECU_ADDRESS 0x60039290 /end MEASUREMENT
/begin MEASUREMENT IntkAirT_flgIntkMnfldMeasdVld "Condition: measured intake air temperature in manifold is valid" UBYTE B_TRUE 1 100 0.00 1.00000000000 BIT_MASK 0x1 FORMAT "%13.11" ECU_ADDRESS 0x70000854 /end MEASUREMENT
/begin MEASUREMENT IntkAirT_flgNormOp "Flag to indicate the vehicle with normal- or charge operation" UBYTE B_TRUE 1 100 0.00 1.00000000000 BIT_MASK 0x1 FORMAT "%13.11" ECU_ADDRESS 0x6000B7DC /end MEASUREMENT
/begin MEASUREMENT IntkAirT_flgSnsr1CrssChkClr "request for clearing Cross-Check error of intake air temperature sensor 1" UBYTE B_TRUE 1 100 0.00 1.00000000000 BIT_MASK 0x1 FORMAT "%13.11" ECU_ADDRESS 0x70000844 /end MEASUREMENT
/begin MEASUREMENT IntkAirT_flgSnsr1CrssChkPrms "release of Cross-Check for intake air temperature sensor 1" UBYTE B_TRUE 1 100 0.00 1.00000000000 BIT_MASK 0x1 FORMAT "%13.11" ECU_ADDRESS 0x70000843 /end MEASUREMENT
/begin MEASUREMENT IntkAirT_flgSnsr1ElecChkClr "request for clearing elektrical error of intake air temperature sensor 1" UBYTE B_TRUE 1 100 0.00 1.00000000000 BIT_MASK 0x1 FORMAT "%13.11" ECU_ADDRESS 0x70000842 /end MEASUREMENT
/begin MEASUREMENT IntkAirT_flgSnsr1Elecdl "debounced electrical error non plausible signal of intake air sensor Snsr1" UBYTE B_TRUE 1 100 0.00 1.00000000000 BIT_MASK 0x1 FORMAT "%13.11" ECU_ADDRESS 0x6000B7DB /end MEASUREMENT
/begin MEASUREMENT IntkAirT_flgSnsr1ElecEnag "unconfirmed electrical error (non plausible signal) for intake air temperature sensor tfa1" UBYTE B_TRUE 1 100 0.00 1.00000000000 BIT_MASK 0x1 FORMAT "%13.11" ECU_ADDRESS 0x6000B7DA /end MEASUREMENT
/begin MEASUREMENT IntkAirT_flgSnsr1ElecVld "Intak air temperature sensor 1 is electical valid" UBYTE B_TRUE 1 100 0.00 1.00000000000 BIT_MASK 0x1 FORMAT "%13.11" ECU_ADDRESS 0x70000841 /end MEASUREMENT
/begin MEASUREMENT IntkAirT_flgSnsr1MaxErr "unconfirmed electrical error (max) for intake air temperature sensor tfa1" UBYTE B_TRUE 1 100 0.00 1.00000000000 BIT_MASK 0x1 FORMAT "%13.11" ECU_ADDRESS 0x6000B7D9 /end MEASUREMENT
/begin MEASUREMENT IntkAirT_flgSnsr1MeasdVld "measured intak air temperature from sensor 1 is valid" UBYTE B_TRUE 1 100 0.00 1.00000000000 BIT_MASK 0x1 FORMAT "%13.11" ECU_ADDRESS 0x70000840 /end MEASUREMENT
/begin MEASUREMENT IntkAirT_flgSnsr1MinErr "unconfirmed electrical error (min) for intake air temperature sensor tfa1" UBYTE B_TRUE 1 100 0.00 1.00000000000 BIT_MASK 0x1 FORMAT "%13.11" ECU_ADDRESS 0x6000B7D8 /end MEASUREMENT
/begin MEASUREMENT IntkAirT_flgSnsr1PlausChkClr "request for clearing Plaus-Check error of intake air temperature sensor 1" UBYTE B_TRUE 1 100 0.00 1.00000000000 BIT_MASK 0x1 FORMAT "%13.11" ECU_ADDRESS 0x7000083F /end MEASUREMENT
/begin MEASUREMENT IntkAirT_flgSnsr1PlausChkPrms "release of Plaus-Check for intake air temperature sensor 1" UBYTE B_TRUE 1 100 0.00 1.00000000000 BIT_MASK 0x1 FORMAT "%13.11" ECU_ADDRESS 0x7000083E /end MEASUREMENT
/begin MEASUREMENT IntkAirT_flgSnsr1PwrSplyAvl "Flag to indicate the power supply error of the sensor 1" UBYTE B_TRUE 1 100 0.00 1.00000000000 BIT_MASK 0x1 FORMAT "%13.11" ECU_ADDRESS 0x6000B7D7 /end MEASUREMENT
/begin MEASUREMENT IntkAirT_flgSnsr2CrssChkClr "request for clearing Cross-Check error of intake air temperature sensor 2" UBYTE B_TRUE 1 100 0.00 1.00000000000 BIT_MASK 0x1 FORMAT "%13.11" ECU_ADDRESS 0x7000083D /end MEASUREMENT
/begin MEASUREMENT IntkAirT_flgSnsr2CrssChkPrms "release of Cross-Check for intake air temperature sensor 2" UBYTE B_TRUE 1 100 0.00 1.00000000000 BIT_MASK 0x1 FORMAT "%13.11" ECU_ADDRESS 0x7000083C /end MEASUREMENT
/begin MEASUREMENT IntkAirT_flgSnsr2ElecChkClr "request for clearing elektrical error of intake air temperature sensor 2" UBYTE B_TRUE 1 100 0.00 1.00000000000 BIT_MASK 0x1 FORMAT "%13.11" ECU_ADDRESS 0x7000083B /end MEASUREMENT
/begin MEASUREMENT IntkAirT_flgSnsr2Elecdl "debounced electrical error non plausible signal of intake air sensor Snsr2" UBYTE B_TRUE 1 100 0.00 1.00000000000 BIT_MASK 0x1 FORMAT "%13.11" ECU_ADDRESS 0x6000B7D6 /end MEASUREMENT
/begin MEASUREMENT IntkAirT_flgSnsr2ElecEnag "unconfirmed electrical error (non plausible signal) for intake air temperature sensor tfa2 (SY_TFAKON 0)" UBYTE B_TRUE 1 100 0.00 1.00000000000 BIT_MASK 0x1 FORMAT "%13.11" ECU_ADDRESS 0x6000B7D5 /end MEASUREMENT
/begin MEASUREMENT IntkAirT_flgSnsr2ElecVld "Intak air temperature sensor 2 is electical valid" UBYTE B_TRUE 1 100 0.00 1.00000000000 BIT_MASK 0x1 FORMAT "%13.11" ECU_ADDRESS 0x7000083A /end MEASUREMENT
/begin MEASUREMENT IntkAirT_flgSnsr2MaxErr "unconfirmed electrical error (max) for intake air temperature sensor tfa2 (SY_TFAKON 0)" UBYTE B_TRUE 1 100 0.00 1.00000000000 BIT_MASK 0x1 FORMAT "%13.11" ECU_ADDRESS 0x6000B7D4 /end MEASUREMENT
/begin MEASUREMENT IntkAirT_flgSnsr2MeasdVld "measured intak air temperature from sensor 2 is valid" UBYTE B_TRUE 1 100 0.00 1.00000000000 BIT_MASK 0x1 FORMAT "%13.11" ECU_ADDRESS 0x70000839 /end MEASUREMENT
/begin MEASUREMENT IntkAirT_flgSnsr2MinErr "unconfirmed electrical error (min) for intake air temperature sensor tfa2 (SY_TFAKON 0)" UBYTE B_TRUE 1 100 0.00 1.00000000000 BIT_MASK 0x1 FORMAT "%13.11" ECU_ADDRESS 0x6000B7D3 /end MEASUREMENT
/begin MEASUREMENT IntkAirT_flgSnsr2PlausChkClr "request for clearing Plaus-Check error of intake air temperature sensor 2" UBYTE B_TRUE 1 100 0.00 1.00000000000 BIT_MASK 0x1 FORMAT "%13.11" ECU_ADDRESS 0x70000838 /end MEASUREMENT
/begin MEASUREMENT IntkAirT_flgSnsr2PlausChkPrms "release of Plaus-Check for intake air temperature sensor 2" UBYTE B_TRUE 1 100 0.00 1.00000000000 BIT_MASK 0x1 FORMAT "%13.11" ECU_ADDRESS 0x70000837 /end MEASUREMENT
/begin MEASUREMENT IntkAirT_flgSnsr2PwrSplyAvl "Flag to indicate the power supply error of the sensor 2" UBYTE B_TRUE 1 100 0.00 1.00000000000 BIT_MASK 0x1 FORMAT "%13.11" ECU_ADDRESS 0x6000B7D2 /end MEASUREMENT
/begin MEASUREMENT IntkAirT_flgSRC1MaxErr "Error flag of the max.error of the elektrical check for sensor 1, debounced" UBYTE B_TRUE 1 100 0.00 1.00000000000 BIT_MASK 0x1 FORMAT "%13.11" ECU_ADDRESS 0x6000F674 /end MEASUREMENT
/begin MEASUREMENT IntkAirT_flgSRC1MaxErrloc "local copy of the error flag" UBYTE B_TRUE 1 100 0.00 1.00000000000 BIT_MASK 0x1 FORMAT "%13.11" ECU_ADDRESS 0x6000B7D1 /end MEASUREMENT
/begin MEASUREMENT IntkAirT_flgSRC1MaxHeal "Healing flag of the max.error of the elektrical check for sensor 1, debounced" UBYTE B_TRUE 1 100 0.00 1.00000000000 BIT_MASK 0x1 FORMAT "%13.11" ECU_ADDRESS 0x6000F673 /end MEASUREMENT
/begin MEASUREMENT IntkAirT_flgSRC1MaxHealloc "local copy of the healing flag" UBYTE B_TRUE 1 100 0.00 1.00000000000 BIT_MASK 0x1 FORMAT "%13.11" ECU_ADDRESS 0x6000B7D0 /end MEASUREMENT
/begin MEASUREMENT IntkAirT_flgSRC1MinErr "Error flag of the min.error of the elektrical check for sensor 1, debounced" UBYTE B_TRUE 1 100 0.00 1.00000000000 BIT_MASK 0x1 FORMAT "%13.11" ECU_ADDRESS 0x6000F672 /end MEASUREMENT
/begin MEASUREMENT IntkAirT_flgSRC1MinErrloc "local copy of the error flag" UBYTE B_TRUE 1 100 0.00 1.00000000000 BIT_MASK 0x1 FORMAT "%13.11" ECU_ADDRESS 0x6000B7CF /end MEASUREMENT
/begin MEASUREMENT IntkAirT_flgSRC1MinHeal "Healing flag of the min.error of the elektrical check for sensor 1, debounced" UBYTE B_TRUE 1 100 0.00 1.00000000000 BIT_MASK 0x1 FORMAT "%13.11" ECU_ADDRESS 0x6000F671 /end MEASUREMENT
/begin MEASUREMENT IntkAirT_flgSRC1MinHealloc "local copy of the healing flag" UBYTE B_TRUE 1 100 0.00 1.00000000000 BIT_MASK 0x1 FORMAT "%13.11" ECU_ADDRESS 0x6000B7CE /end MEASUREMENT
/begin MEASUREMENT IntkAirT_flgSRC1MinRels "enabling SRC_Min for TFA1-sensor" UBYTE B_TRUE 1 100 0.00 1.00000000000 BIT_MASK 0x1 FORMAT "%13.11" ECU_ADDRESS 0x6000B7CD /end MEASUREMENT
/begin MEASUREMENT IntkAirT_flgSRC2MaxErr "Error flag of the max.error of the elektrical check for sensor 2, debounced" UBYTE B_TRUE 1 100 0.00 1.00000000000 BIT_MASK 0x1 FORMAT "%13.11" ECU_ADDRESS 0x6000F670 /end MEASUREMENT
/begin MEASUREMENT IntkAirT_flgSRC2MaxErrloc "local copy of the error flag" UBYTE B_TRUE 1 100 0.00 1.00000000000 BIT_MASK 0x1 FORMAT "%13.11" ECU_ADDRESS 0x6000B7CC /end MEASUREMENT
/begin MEASUREMENT IntkAirT_flgSRC2MaxHeal "Healing flag of the max.error of the elektrical check for sensor 2, debounced" UBYTE B_TRUE 1 100 0.00 1.00000000000 BIT_MASK 0x1 FORMAT "%13.11" ECU_ADDRESS 0x6000F66F /end MEASUREMENT
/begin MEASUREMENT IntkAirT_flgSRC2MaxHealloc "local copy of the healing flag" UBYTE B_TRUE 1 100 0.00 1.00000000000 BIT_MASK 0x1 FORMAT "%13.11" ECU_ADDRESS 0x6000B7CB /end MEASUREMENT
/begin MEASUREMENT IntkAirT_flgSRC2MinErr "Error flag of the min.error of the elektrical check for sensor 2, debounced" UBYTE B_TRUE 1 100 0.00 1.00000000000 BIT_MASK 0x1 FORMAT "%13.11" ECU_ADDRESS 0x6000F66E /end MEASUREMENT
/begin MEASUREMENT IntkAirT_flgSRC2MinErrloc "local copy of the error flag" UBYTE B_TRUE 1 100 0.00 1.00000000000 BIT_MASK 0x1 FORMAT "%13.11" ECU_ADDRESS 0x6000B7CA /end MEASUREMENT
/begin MEASUREMENT IntkAirT_flgSRC2MinHeal "Healing flag of the min.error of the elektrical check for sensor 2, debounced" UBYTE B_TRUE 1 100 0.00 1.00000000000 BIT_MASK 0x1 FORMAT "%13.11" ECU_ADDRESS 0x6000F66D /end MEASUREMENT
/begin MEASUREMENT IntkAirT_flgSRC2MinHealloc "local copy of the healing flag" UBYTE B_TRUE 1 100 0.00 1.00000000000 BIT_MASK 0x1 FORMAT "%13.11" ECU_ADDRESS 0x6000B7C9 /end MEASUREMENT
/begin MEASUREMENT IntkAirT_flgSRC2MinRels "enabling SRC_Min for TFA2-sensor" UBYTE B_TRUE 1 100 0.00 1.00000000000 BIT_MASK 0x1 FORMAT "%13.11" ECU_ADDRESS 0x6000B7C8 /end MEASUREMENT
/begin MEASUREMENT IntkAirT_flgSRC3MinRels "enabling SRC_Min for TFA3-sensor" UBYTE B_TRUE 1 100 0.00 1.00000000000 BIT_MASK 0x1 FORMAT "%13.11" ECU_ADDRESS 0x6000B7C7 /end MEASUREMENT
/begin MEASUREMENT IntkAirT_flgSRC4MinRels "enabling SRC_Min for TFA4-sensor" UBYTE B_TRUE 1 100 0.00 1.00000000000 BIT_MASK 0x1 FORMAT "%13.11" ECU_ADDRESS 0x6000B7C6 /end MEASUREMENT
/begin MEASUREMENT IntkAirT_flgSRC5MinRels "enabling SRC_Min for TFA5-sensor" UBYTE B_TRUE 1 100 0.00 1.00000000000 BIT_MASK 0x1 FORMAT "%13.11" ECU_ADDRESS 0x6000B7C5 /end MEASUREMENT
/begin MEASUREMENT IntkAirT_flgSRC6MinRels "enabling SRC_Min for TFA6-sensor" UBYTE B_TRUE 1 100 0.00 1.00000000000 BIT_MASK 0x1 FORMAT "%13.11" ECU_ADDRESS 0x6000B7C4 /end MEASUREMENT
/begin MEASUREMENT IntkAirT_flgSRCMaxEna "Enable of the electrical diagnosis of the intake air temperature sensor" UBYTE B_TRUE 1 100 0.00 1.00000000000 BIT_MASK 0x1 FORMAT "%13.11" ECU_ADDRESS 0x6000F66C /end MEASUREMENT
/begin MEASUREMENT IntkAirT_flgSRCMinEna "Enable bit SRC (min) preliminarity" UBYTE B_TRUE 1 100 0.00 1.00000000000 BIT_MASK 0x1 FORMAT "%13.11" ECU_ADDRESS 0x6000F66B /end MEASUREMENT
/begin MEASUREMENT IntkAirT_flgTnPTRstSnsr1 "Flag: rest for lowpass-filter of sensor raw voltage signal from sensor 1" UBYTE B_TRUE 1 100 0.00 1.00000000000 BIT_MASK 0x1 FORMAT "%13.11" ECU_ADDRESS 0x6000B7C3 /end MEASUREMENT
/begin MEASUREMENT IntkAirT_flgTnPTRstSnsr2 "Flag: rest for lowpass-filter of sensor raw voltage signal from sensor 2" UBYTE B_TRUE 1 100 0.00 1.00000000000 BIT_MASK 0x1 FORMAT "%13.11" ECU_ADDRESS 0x6000B7C2 /end MEASUREMENT
/begin MEASUREMENT IntkAirT_stAirFltDsVccErrChkClr "Dsm clear interface for Vcc error diagnosis" UBYTE B_TRUE 1 100 0.00 1.00000000000 BIT_MASK 0x1 FORMAT "%13.11" ECU_ADDRESS 0x6000B7B9 /end MEASUREMENT
/begin MEASUREMENT IntkAirT_stSnsr1 "State of the intake air temperature sensor 1" UBYTE OneToOne 1 100 0.00 255.0 FORMAT "%5.1" ECU_ADDRESS 0x6000F7A6 /end MEASUREMENT
/begin MEASUREMENT IntkAirT_stSnsr1ADC "State of the intake air temperature sensor 1 from ADC sensor" UBYTE OneToOne 1 100 0.00 255.0 FORMAT "%5.1" ECU_ADDRESS 0x6000F7A5 /end MEASUREMENT
/begin MEASUREMENT IntkAirT_stSnsr1ADCLoc "local copy of the State of the intake air temperature sensor 1 from ADC sensor" UBYTE OneToOne 1 100 0.00 255.0 FORMAT "%5.1" ECU_ADDRESS 0x6000B7C1 /end MEASUREMENT
/begin MEASUREMENT IntkAirT_stSnsr1CycRprt1000ms "Status flag to enable cyclic reporting to DSM in 1000ms" UBYTE B_TRUE 1 100 0.00 1.00000000000 BIT_MASK 0x1 FORMAT "%13.11" ECU_ADDRESS 0x6000B7BD /end MEASUREMENT
/begin MEASUREMENT IntkAirT_stSnsr1CycRprt100ms "Status flag to enable cyclic reporting to DSM in 100ms" UBYTE B_TRUE 1 100 0.00 1.00000000000 BIT_MASK 0x1 FORMAT "%13.11" ECU_ADDRESS 0x6000B7BC /end MEASUREMENT
/begin MEASUREMENT IntkAirT_stSnsr2 "State of the intake air temperature sensor 2" UBYTE OneToOne 1 100 0.00 255.0 FORMAT "%5.1" ECU_ADDRESS 0x6000F7A4 /end MEASUREMENT
/begin MEASUREMENT IntkAirT_stSnsr2ADC "State of the intake air temperature sensor 2 from ADC sensor" UBYTE OneToOne 1 100 0.00 255.0 FORMAT "%5.1" ECU_ADDRESS 0x6000F7A3 /end MEASUREMENT
/begin MEASUREMENT IntkAirT_stSnsr2ADCLoc "local copy of the State of the intake air temperature sensor 2 from ADC sensor" UBYTE OneToOne 1 100 0.00 255.0 FORMAT "%5.1" ECU_ADDRESS 0x6000B7C0 /end MEASUREMENT
/begin MEASUREMENT IntkAirT_stSnsr2CycRprt1000ms "Status flag to enable cyclic reporting to DSM in 1000ms" UBYTE B_TRUE 1 100 0.00 1.00000000000 BIT_MASK 0x1 FORMAT "%13.11" ECU_ADDRESS 0x6000B7B8 /end MEASUREMENT
/begin MEASUREMENT IntkAirT_stSnsr2CycRprt100ms "Status flag to enable cyclic reporting to DSM in 100ms" UBYTE B_TRUE 1 100 0.00 1.00000000000 BIT_MASK 0x1 FORMAT "%13.11" ECU_ADDRESS 0x6000B7B7 /end MEASUREMENT
/begin MEASUREMENT IntkAirT_tAirFltDsMeasd "measured intake air temperature after air filter" SWORD Temp_Cels 1 100 -3549.940 3003.560 FORMAT "%8.3" ECU_ADDRESS 0x60009068 /end MEASUREMENT
/begin MEASUREMENT IntkAirT_tIntkMnfldMeasd "measured intake air temperature in manifold" SWORD Temp_Cels 1 100 -3549.940 3003.560 FORMAT "%8.3" ECU_ADDRESS 0x60009066 /end MEASUREMENT
/begin MEASUREMENT IntkAirT_tiSnsr1CycRprt1000ms "Timer to evaluate cyclic reporting to DSM in 1000ms" UBYTE t_q1 1 100 0.00 255.0 FORMAT "%5.1" ECU_ADDRESS 0x6000B7BB /end MEASUREMENT
/begin MEASUREMENT IntkAirT_tiSnsr1CycRprt100ms "Timer to evaluate cyclic reporting to DSM in 100ms" UBYTE t_q0p1 1 100 0.00 25.50 FORMAT "%5.2" ECU_ADDRESS 0x6000B7BA /end MEASUREMENT
/begin MEASUREMENT IntkAirT_tiSnsr2CycRprt1000ms "Timer to evaluate cyclic reporting to DSM in 1000ms" UBYTE t_q1 1 100 0.00 255.0 FORMAT "%5.1" ECU_ADDRESS 0x6000B7B6 /end MEASUREMENT
/begin MEASUREMENT IntkAirT_tiSnsr2CycRprt100ms "Timer to evaluate cyclic reporting to DSM in 100ms" UBYTE t_q0p1 1 100 0.00 25.50 FORMAT "%5.2" ECU_ADDRESS 0x6000B7B5 /end MEASUREMENT
/begin MEASUREMENT IntkAirT_tSnsr1 "Temperature raw value of the intake air temperature sensor 1" SWORD Temp_Cels 1 100 -3549.940 3003.560 FORMAT "%8.3" ECU_ADDRESS 0x60009064 /end MEASUREMENT
/begin MEASUREMENT IntkAirT_tSnsr1ADC "Temperature raw value of the intake air temperature sensor 1 from ADC sensor" SWORD Temp_Cels 1 100 -3549.940 3003.560 FORMAT "%8.3" ECU_ADDRESS 0x60009062 /end MEASUREMENT
/begin MEASUREMENT IntkAirT_tSnsr1ADCLoc "local copy of the Temperature raw value of the intake air temperature sensor 1 from ADC sensor" SWORD Temp_Cels 1 100 -3549.940 3003.560 FORMAT "%8.3" ECU_ADDRESS 0x600073DE /end MEASUREMENT
/begin MEASUREMENT IntkAirT_tSnsr1Tstr "Intake Air Tempertaure for Scan Service" UBYTE temp_ub_q1_o40 1 100 -40.0 215.0 FORMAT "%5.1" ECU_ADDRESS 0x6000F7A0 /end MEASUREMENT
/begin MEASUREMENT IntkAirT_tSnsr1TstrADC "Intake Air Tempertaure for Scan Service from sensor 1 via ADC" UBYTE temp_ub_q1_o40 1 100 -40.0 215.0 FORMAT "%5.1" ECU_ADDRESS 0x6000F79F /end MEASUREMENT
/begin MEASUREMENT IntkAirT_tSnsr1TstrADCLoc "local copy of the Intake Air Tempertaure for Scan Service from sensor 1 via ADC" UBYTE temp_ub_q1_o40 1 100 -40.0 215.0 FORMAT "%5.1" ECU_ADDRESS 0x6000B7BF /end MEASUREMENT
/begin MEASUREMENT IntkAirT_tSnsr2 "Temperature raw value of the intake air temperature sensor 2" SWORD Temp_Cels 1 100 -3549.940 3003.560 FORMAT "%8.3" ECU_ADDRESS 0x6000905E /end MEASUREMENT
/begin MEASUREMENT IntkAirT_tSnsr2ADC "Temperature raw value of the intake air temperature sensor 2 from ADC sensor" SWORD Temp_Cels 1 100 -3549.940 3003.560 FORMAT "%8.3" ECU_ADDRESS 0x6000905C /end MEASUREMENT
/begin MEASUREMENT IntkAirT_tSnsr2ADCLoc "local copy of the Temperature raw value of the intake air temperature sensor 2 from ADC sensor" SWORD Temp_Cels 1 100 -3549.940 3003.560 FORMAT "%8.3" ECU_ADDRESS 0x600073DC /end MEASUREMENT
/begin MEASUREMENT IntkAirT_tSnsr2Tstr "Intake Air Tempertaure for Scan Service" UBYTE temp_ub_q1_o40 1 100 -40.0 215.0 FORMAT "%5.1" ECU_ADDRESS 0x6000F79E /end MEASUREMENT
/begin MEASUREMENT IntkAirT_tSnsr2TstrADC "Intake Air Tempertaure for Scan Service from sensor 2 via ADC" UBYTE temp_ub_q1_o40 1 100 -40.0 215.0 FORMAT "%5.1" ECU_ADDRESS 0x6000F79D /end MEASUREMENT
/begin MEASUREMENT IntkAirT_tSnsr2TstrADCLoc "local copy of the Intake Air Tempertaure for Scan Service from sensor 2 via ADC" UBYTE temp_ub_q1_o40 1 100 -40.0 215.0 FORMAT "%5.1" ECU_ADDRESS 0x6000B7BE /end MEASUREMENT
/begin MEASUREMENT IntkAirT_tSnsrFild1 "intake air temperature (value sensor 1) after lowpass filter" SWORD Temp_Cels 1 100 -3549.940 3003.560 FORMAT "%8.3" ECU_ADDRESS 0x60009058 /end MEASUREMENT
/begin MEASUREMENT IntkAirT_tSnsrFild1ADC "intake air temperature (value from sensor 1 via ADC) after lowpass filter" SWORD Temp_Cels 1 100 -3549.940 3003.560 FORMAT "%8.3" ECU_ADDRESS 0x60009056 /end MEASUREMENT
/begin MEASUREMENT IntkAirT_tSnsrFild1ADCLoc "local copy of the intake air temperature (value from sensor 1 via ADC) after lowpass filter" SWORD Temp_Cels 1 100 -3549.940 3003.560 FORMAT "%8.3" ECU_ADDRESS 0x600073DA /end MEASUREMENT
/begin MEASUREMENT IntkAirT_tSnsrFild2 "intake air temperature (value sensor 2) after lowpass filter" SWORD Temp_Cels 1 100 -3549.940 3003.560 FORMAT "%8.3" ECU_ADDRESS 0x60009054 /end MEASUREMENT
/begin MEASUREMENT IntkAirT_tSnsrFild2ADC "intake air temperature (value from sensor 2 via ADC) after lowpass filter" SWORD Temp_Cels 1 100 -3549.940 3003.560 FORMAT "%8.3" ECU_ADDRESS 0x60009052 /end MEASUREMENT
/begin MEASUREMENT IntkAirT_tSnsrFild2ADCLoc "local copy of the intake air temperature (value from sensor 2 via ADC) after lowpass filter" SWORD Temp_Cels 1 100 -3549.940 3003.560 FORMAT "%8.3" ECU_ADDRESS 0x600073D8 /end MEASUREMENT
/begin MEASUREMENT IntkAirT_tSnsrFildLimd1 "Temperature of the intake air temperature sensor 1 after lowpass filter and the limitation of coolant temperature" SWORD Temp_Cels 1 100 -3549.940 3003.560 FORMAT "%8.3" ECU_ADDRESS 0x60009050 /end MEASUREMENT
/begin MEASUREMENT IntkAirT_tSnsrFildLimd1ADC "Temperature of the intake air temperature sensor 1 via ADC, after lowpass filter and the limitation of coolant temperature" SWORD Temp_Cels 1 100 -3549.940 3003.560 FORMAT "%8.3" ECU_ADDRESS 0x6000904E /end MEASUREMENT
/begin MEASUREMENT IntkAirT_tSnsrFildLimd1ADCLoc "local copy of the Temperature of the intake air temperature sensor 1 via ADC, after lowpass filter and the limitation of coolant temperature" SWORD Temp_Cels 1 100 -3549.940 3003.560 FORMAT "%8.3" ECU_ADDRESS 0x600073D6 /end MEASUREMENT
/begin MEASUREMENT IntkAirT_tSnsrFildLimd2 "Temperature of the intake air temperature sensor 2 after lowpass filter and the limitation of coolant temperature" SWORD Temp_Cels 1 100 -3549.940 3003.560 FORMAT "%8.3" ECU_ADDRESS 0x6000904C /end MEASUREMENT
/begin MEASUREMENT IntkAirT_tSnsrFildLimd2ADC "Temperature of the intake air temperature sensor 2 via ADC, after lowpass filter and the limitation of coolant temperature" SWORD Temp_Cels 1 100 -3549.940 3003.560 FORMAT "%8.3" ECU_ADDRESS 0x6000904A /end MEASUREMENT
/begin MEASUREMENT IntkAirT_tSnsrFildLimd2ADCLoc "local copy of the Temperature of the intake air temperature sensor 2 via ADC, after lowpass filter and the limitation of coolant temperature" SWORD Temp_Cels 1 100 -3549.940 3003.560 FORMAT "%8.3" ECU_ADDRESS 0x600073D4 /end MEASUREMENT
/begin MEASUREMENT IntkAirT_tSnsrTstr "Intake Air Tempertaure for Scan Service" SWORD Temp_Cels 1 100 -3549.940 3003.560 FORMAT "%8.3" ECU_ADDRESS 0x60009048 /end MEASUREMENT
/begin MEASUREMENT IntkAirT_uFildSnsr1 "filtered voltage-signal of intake air temperature sensor Snsr1" UWORD Volt 1 100 0.00 13107.00 FORMAT "%8.2" ECU_ADDRESS 0x600073D2 /end MEASUREMENT
/begin MEASUREMENT IntkAirT_uFildSnsr2 "filtered voltage-signal of intake air temperature sensor Snsr2" UWORD Volt 1 100 0.00 13107.00 FORMAT "%8.2" ECU_ADDRESS 0x600073D0 /end MEASUREMENT
/begin MEASUREMENT IntkAirT_uSnsr1CrssSwtLoc "voltage-signal from intake air temperature sensor Snsr1, local" UWORD Volt 1 100 0.00 5000.000 FORMAT "%8.3" ECU_ADDRESS 0x600073CE /end MEASUREMENT
/begin MEASUREMENT IntkAirT_uSnsr1Exprt "voltage-signal from intake air temperature sensor tfa1, export" UWORD Volt 1 100 0.00 13107.00 FORMAT "%8.2" ECU_ADDRESS 0x60008E02 /end MEASUREMENT
/begin MEASUREMENT IntkAirT_uSnsr2CrssSwtLoc "voltage-signal from intake air temperature sensor Snsr2, local" UWORD Volt 1 100 0.00 5000.000 FORMAT "%8.3" ECU_ADDRESS 0x600073CC /end MEASUREMENT
/begin MEASUREMENT IntkAirT_uSnsr2Exprt "voltage-signal from intake air temperature sensor tfa2, export" UWORD Volt 1 100 0.00 13107.00 FORMAT "%8.2" ECU_ADDRESS 0x60008E00 /end MEASUREMENT
/begin MEASUREMENT ParSentenceAssign_u32 "activ parameter sentence assignement of injection valve powerstage" ULONG dez 1 100 0.00 4294967295.00 FORMAT "%13.2" ECU_ADDRESS 0x70002554 /end MEASUREMENT
/begin MEASUREMENT tanlf_w_msg "temperature downstream air filter" UWORD temp_q0p0234_o273 1 100 -273.150 1262.827 FORMAT "%8.3" ECU_ADDRESS 0x60008D16 /end MEASUREMENT
/begin MEASUREMENT tansabz_msg "Intake air temperature: stop value of last driving cycle" UBYTE temp_ub_q0p75_o48 1 100 -48.0 143.3 FORMAT "%5.1" ECU_ADDRESS 0x6000FB24 /end MEASUREMENT
/begin MEASUREMENT tansab_loc "Local copy of tansab" UBYTE temp_ub_q0p75_o48 1 100 -48.0 143.3 FORMAT "%5.1" ECU_ADDRESS 0x60039292 /end MEASUREMENT
/begin MEASUREMENT tansab_msg "Intake air temperature when engine is shut-off" UBYTE temp_ub_q0p75_o48 1 100 -48.0 143.3 FORMAT "%5.1" ECU_ADDRESS 0x6000FB25 /end MEASUREMENT
/begin MEASUREMENT tanskst_w_msg "intake air temperature before start" UWORD temp_q0p0234_o273 1 100 -273.150 1262.827 FORMAT "%8.3" ECU_ADDRESS 0x600092BE /end MEASUREMENT
/begin MEASUREMENT tansk_w_msg "Intake air temperature in degC, internally in Kelvin" UWORD temp_q0p0234_o273 1 100 -273.150 1262.827 FORMAT "%8.3" ECU_ADDRESS 0x60008D14 /end MEASUREMENT
/begin MEASUREMENT tanslin_msg "intake air temperature, linearised and calculated" UBYTE temp_ub_q0p75_o48 1 100 -48.0 143.3 FORMAT "%5.1" ECU_ADDRESS 0x6000F71D /end MEASUREMENT
/begin MEASUREMENT tansstz_msg "Intake air temperature: first start value of actual driving cycle" UBYTE temp_ub_q0p75_o48 1 100 -48.0 143.3 FORMAT "%5.1" ECU_ADDRESS 0x6000FB22 /end MEASUREMENT
/begin MEASUREMENT tansst_msg "Intake air temperature at cranking" UBYTE temp_ub_q0p75_o48 1 100 -48.0 143.3 FORMAT "%5.1" ECU_ADDRESS 0x6000FB23 /end MEASUREMENT
/begin MEASUREMENT tans_msg "intake air temperature" UBYTE temp_ub_q0p75_o48 1 100 -48.0 143.3 FORMAT "%5.1" ECU_ADDRESS 0x500060CF /end MEASUREMENT
/begin MEASUREMENT tasrg_w_msg "intake air temperatur, measured in manifold" UWORD temp_q0p0234_o273 1 100 -273.150 1262.827 FORMAT "%8.3" ECU_ADDRESS 0x600149C0 /end MEASUREMENT
/begin MEASUREMENT tasr_w_msg "air temperature in manifold" UWORD temp_q0p0234_o273 1 100 -273.150 1262.827 FORMAT "%8.3" ECU_ADDRESS 0x60008D12 /end MEASUREMENT
/begin MEASUREMENT tavdkmn_w_msg "Minimum intake air temperature at the throttle valve" UWORD temp_q0p0234_o273 1 100 -273.150 1262.827 FORMAT "%8.3" ECU_ADDRESS 0x60008D0E /end MEASUREMENT
/begin MEASUREMENT tavdkmx_w_msg "Maximum intake air temperature at the throttle valve" UWORD temp_q0p0234_o273 1 100 -273.150 1262.827 FORMAT "%8.3" ECU_ADDRESS 0x60008D0C /end MEASUREMENT
/begin MEASUREMENT tavdk_w_msg "air temperature upstream throttle" UWORD temp_q0p0234_o273 1 100 -273.150 1262.827 FORMAT "%8.3" ECU_ADDRESS 0x60008D10 /end MEASUREMENT
/begin FUNCTION InjSyG_InjSp "159.0.0   Injection Setpoints"
 /begin DEF_CHARACTERISTIC InjSys_P3V2I1_SH.tiBreakAux1_T InjSys_P3V3I1_SH.agAux2DeltaDrctStrtCorrn_T InjSys_P3V3I1_SH.agAux2DeltaEth_M InjSys_P3V3I1_SH.agAux2DeltaStrt_T InjSys_P3V3I1_SH.agAux2DrctStrt_M InjSys_P3V3I1_SH.agAux2_GM InjSys_P3V3I1_SH.agBasDrctStrt_M InjSys_P3V3I1_SH.agBasEthnlVers2_T InjSys_P3V3I1_SH.agBasEthnl_GM InjSys_P3V3I1_SH.agBas_GM InjSys_P3V3I1_SH.agDeltaApp_M InjSys_P3V3I1_SH.agDeltaDrctStrtCorrn_T InjSys_P3V3I1_SH.agDeltaEth_M InjSys_P3V3I1_SH.agDeltaStrt_T InjSys_P3V3I1_SH.facEthnlAgBas_T InjSys_P3V3I1_SH.facEthnlAux1_T InjSys_P3V3I1_SH.facEthnlAux2_T InjSys_P3V3I1_SH.facEthnlBas_T InjSys_P3V3I1_SH.facSpltAux1Ethnl_GM InjSys_P3V3I1_SH.facSpltAux1_GM InjSys_P3V3I1_SH.facSpltAux2Ethnl_GM InjSys_P3V3I1_SH.facSpltAux2_GM InjSys_P3V3I1_SH.facSpltBasEthnl_GM InjSys_P3V3I1_SH.facSpltBas_GM InjSys_P3V3I1_SH.facTiBreakAux1Corrn_T InjSys_P3V3I1_SH.facTiBreakAux2Corrn_T InjSys_P3V3I1_SH.flgAbsltSplt_C InjSys_P3V3I1_SH.flgAgAux2_C InjSys_P3V3I1_SH.flgIgnCoupld_C InjSys_P3V3I1_SH.ratFuMAux1_GM InjSys_P3V3I1_SH.ratFuMAux2_GM InjSys_P3V3I1_SH.ratFuMBas_GM InjSys_P3V3I1_SH.tiBreakAux_T InjSys_P3V4I1_SHP.agBas_M InjSys_P3V4I1_SHP.agDeltaEth_M InjSys_P3V4I1_SHP.agDeltaStrtIgn_M InjSys_P3V4I1_SHP.agDeltaStrt_T InjSys_P3V4I1_SHP.facSpltAux1Eth_GM InjSys_P3V4I1_SHP.facSpltAux1_GM InjSys_P3V4I1_SHP.facSpltPktEth_GM InjSys_P3V4I1_SHP.facSpltPkt_GM InjSys_P3V4I1_SHP.facTiBreakAux1Corrn_T InjSys_P3V4I1_SHP.flgAbsltSplt_C InjSys_P3V4I1_SHP.flgIgnCoupld_C InjSys_P3V4I1_SHP.ratFuMAux1Eth_GM InjSys_P3V4I1_SHP.ratFuMAux1_GM InjSys_P3V4I1_SHP.ratFuMBasEth_GM InjSys_P3V4I1_SHP.ratFuMBas_GM InjSys_P3V4I1_SHP.tiBreakAux1_T InjSys_P3V5I1_HPZ.agDeltaOffsVers2_GM InjSys_P3V5I1_HPZ.agDeltaOffs_GM InjSys_P3V5I1_HPZ.agDeltaVers2_GM InjSys_P3V5I1_HPZ.agDelta_GM InjSys_P3V5I1_HPZ.facSpltBasCorrnLoT_GM InjSys_P3V5I1_HPZ.facWghtAg_T InjSys_P3V5I1_HPZ.facWghtSpltBasT_GM InjSys_P3V5I1_HPZ.flgAxVers_C InjSys_P3V5I1_HPZ.ratFuMBasHiExtd_GM InjSys_P3V5I1_HPZ.ratFuMBasHi_GM InjSys_P3V5I1_HPZ.ratFuMBasLoExtd_GM InjSys_P3V5I1_HPZ.ratFuMBasLo_GM InjSys_P3V5I2_HPZ.agDeltaOffsVers2_GM InjSys_P3V5I2_HPZ.agDeltaOffs_GM InjSys_P3V5I2_HPZ.agDeltaVers2_GM InjSys_P3V5I2_HPZ.agDelta_GM InjSys_P3V5I2_HPZ.facSpltBasCorrnLoT_GM InjSys_P3V5I2_HPZ.facWghtAg_T InjSys_P3V5I2_HPZ.facWghtSpltBasT_GM InjSys_P3V5I2_HPZ.flgAxVers_C InjSys_P3V5I2_HPZ.ratFuMBasHiExtd_GM InjSys_P3V5I2_HPZ.ratFuMBasHi_GM InjSys_P3V5I2_HPZ.ratFuMBasLoExtd_GM InjSys_P3V5I2_HPZ.ratFuMBasLo_GM InjSys_PktIfIni.stDummy_C InjSys_stInjSpAppl_C InjSys_tEngMaxTPist_C InjSys_tEngMinTPist_C InjSys_tiBreakMin_C InjSys_tiBreakMin_T /end DEF_CHARACTERISTIC
 FUNCTION_VERSION "159.0.0" /end FUNCTION
/begin FUNCTION InjSyG_InjSpIf "1.22.0    Injection Setpoint Interface" /begin DEF_CHARACTERISTIC InjSys_idxMapGenFuMShift_GT InjSys_ratFuMTransSctnHys_C /end DEF_CHARACTERISTIC /begin REF_CHARACTERISTIC InjSys_stInjMod_AX /end REF_CHARACTERISTIC
 /begin IN_MEASUREMENT InjSys_agAux1 InjSys_agAux1Stb InjSys_agAux2 InjSys_agAux2Stb InjSys_agBas InjSys_agBasStb InjSys_agInjShiftCvo InjSys_flgCvoBascCylIndEna InjSys_flgInjModTran InjSys_flgInjTmngErly InjSys_flgRtOptNEng InjSys_nrInj InjSys_nrInjStb InjSys_ratFuMAux1 InjSys_ratFuMAux1Stb InjSys_ratFuMAux2 InjSys_ratFuMAux2Stb InjSys_ratFuMBas InjSys_ratFuMBasStb InjSys_ratFuMCvo InjSys_ratFuMMaxBall InjSys_ratFuMMinBall InjSys_ratFuMMinLnr InjSys_stAgEnd InjSys_stAgEndStb InjSys_stInjTmng InjSys_tiBreakHiReslAux1 InjSys_tiBreakHiReslAux1Stb InjSys_tiBreakHiReslAux2 InjSys_tiBreakHiReslAux2Stb InjSys_tiBreakPkt InjSys_tiBreakPktStb zzylh_msg zzyls_msg /end IN_MEASUREMENT
 /begin OUT_MEASUREMENT InjSys_agInjSyn0 InjSys_agInjSyn0Stb InjSys_agInjSyn1 InjSys_agInjSyn1Stb InjSys_flgAgEndSyn0 InjSys_flgAgEndSyn0Stb InjSys_flgAgEndSyn1 InjSys_flgAgEndSyn1Stb InjSys_idxMI InjSys_nrInjCorrn InjSys_nrInjCycRaw InjSys_nrInjCycRawStb InjSys_nrInjSyn0 InjSys_nrInjSyn0Mem InjSys_nrInjSyn0Stb InjSys_ratFuMAux1Mem InjSys_ratFuMAux2Mem InjSys_ratFuMBasMem InjSys_ratFuMSyn0 InjSys_ratFuMSyn0Stb InjSys_ratFuMSyn1 InjSys_ratFuMSyn1Stb InjSys_tiBreakHiReslSyn0 InjSys_tiBreakHiReslSyn0Stb InjSys_tiBreakHiReslSyn1 InjSys_tiBreakHiReslSyn1Stb /end OUT_MEASUREMENT
 /begin LOC_MEASUREMENT InjSys_agBasTmpSyn0 InjSys_agBasTmpSyn0Stb InjSys_ratFuMSum InjSys_ratFuMTmpSyn0 InjSys_ratFuMTmpSyn0Stb InjSys_stTransSctnActv InjSys_tiBreakHiReslTmpSyn0 InjSys_tiBreakHiReslTmpSyn0Stb InjSys_tiBreakHiReslTmpSyn1 /end LOC_MEASUREMENT
 FUNCTION_VERSION "1.22.0" /end FUNCTION
/begin FUNCTION InjSyG_InjSpSeln "1.7.0     Injection Setpoints Selection" /begin REF_CHARACTERISTIC InjSys_stInjSpAppl_C /end REF_CHARACTERISTIC
 /begin IN_MEASUREMENT InjSys_flgInjTmngErly InjSys_flgRtOptNEng InjSys_idxInst InjSys_idxInstStb InjSys_idxPkt InjSys_idxPktStb InjSys_ratFuMCylInd InjSys_ratFuMCylIndStb InjSys_stInjTmng /end IN_MEASUREMENT
 /begin OUT_MEASUREMENT InjSys_agAux1 InjSys_agAux1Stb InjSys_agAux2 InjSys_agAux2Stb InjSys_agBas InjSys_agBasStb InjSys_facSpltCmprn InjSys_nrInj InjSys_nrInjActv InjSys_nrInjStb InjSys_ratFuMAux1 InjSys_ratFuMAux1Stb InjSys_ratFuMAux2 InjSys_ratFuMAux2Stb InjSys_ratFuMBas InjSys_ratFuMBasStb InjSys_ratFuMPkt InjSys_ratFuMPktStb InjSys_stAgEnd InjSys_stAgEndStb InjSys_stMaiInj InjSys_stMaiInjStb InjSys_tiBreakHiReslAux1 InjSys_tiBreakHiReslAux1Stb InjSys_tiBreakHiReslAux2 InjSys_tiBreakHiReslAux2Stb InjSys_tiBreakPkt InjSys_tiBreakPktStb /end OUT_MEASUREMENT
 /begin LOC_MEASUREMENT InjSys_flgRatFuMOvf InjSys_flgRatFuMOvfStb InjSys_idxPktInjInd InjSys_nrInjPkt InjSys_ratFuMAux1Appl InjSys_ratFuMAux1ApplStb InjSys_ratFuMAux2Appl InjSys_ratFuMAux2ApplStb InjSys_ratFuMBasAppl InjSys_ratFuMBasApplStb InjSys_ratFuMInjIndRaw /end LOC_MEASUREMENT
 FUNCTION_VERSION "1.7.0" /end FUNCTION
/begin FUNCTION InjSyG_InjTi "1.27.0    Calculation Injection time"
 /begin DEF_CHARACTERISTIC InjSys_facAdbtCmprn_T InjSys_facAgMidPosn_C InjSys_facInjrFlowCorr_T InjSys_facTiCorrNDpdt_T InjSys_facVfStatyInjrCorr_T InjSys_tiBreakOffsBall_T InjSys_tiBreakOffs_T InjSys_tiInjrPOffs_T InjSys_vfStatyInjr_C InjSys_facCorrnPChmbNCamsft_M InjSys_stInjTi_C InjSys_tiInjNlnrHiResl_T InjSys_tiInjNlnrIvsHiResl_T InjSys_tiInjOpenHiResl_T InjSys_tiInjOpenIvsHiResl_T InjSys_tiInjSyn0Appl_CA InjSys_tiInjSyn1Appl_CA InjSys_tiOpenMaxBall_C InjSys_tiOpenMinFullLft_C TIMINP /end DEF_CHARACTERISTIC
 /begin IN_MEASUREMENT B_stendes_msg Epm_nEng FuPHi_pRailInj GEVCtl_agIntkClsd InjSys_agInjSyn0 InjSys_agInjSyn0Stb InjSys_agInjSyn1 InjSys_agInjSyn1Stb InjSys_facCnvnRatFuM InjSys_flgAgEndSyn0 InjSys_flgAgEndSyn0Stb InjSys_flgAgEndSyn1 InjSys_flgAgEndSyn1Stb InjSys_flgRtOptNEng InjSys_ratFuMSyn0 InjSys_ratFuMSyn0Stb InjSys_ratFuMSyn1 InjSys_ratFuMSyn1Stb InjSys_rhoFu InjSys_stInjTmng InjSys_tiBreakHiReslSyn0 InjSys_tiBreakHiReslSyn0Stb InjSys_tiBreakHiReslSyn1 InjSys_tiBreakHiReslSyn1Stb InjSys_vAgCrksft psr_w_msg zzylh_msg zzyls_msg /end IN_MEASUREMENT
 /begin OUT_MEASUREMENT InjSys_agEoiSyn0 InjSys_agEoiSyn0Stb InjSys_agEoiSyn1 InjSys_agEoiSyn1Stb InjSys_agIntkVlvClsd InjSys_agSoiSyn0 InjSys_agSoiSyn0Stb InjSys_agSoiSyn1 InjSys_agSoiSyn1Stb InjSys_mFuSum InjSys_mFuSumStb InjSys_pDeltaRailChmbSyn0 InjSys_pDeltaRailChmbSyn0Stb InjSys_pDeltaRailChmbSyn1 InjSys_pDeltaRailChmbSyn1Stb InjSys_pMnfldCorrdExtdRng InjSys_tiInjMin InjSys_tiInjNlnrMaxHiResl InjSys_tiInjNlnrOffsHiResl InjSys_tiInjOpenMaxHiResl InjSys_tiInjOpenOffsHiResl InjSys_tiInjOpenSyn0 InjSys_tiInjOpenSyn0Stb InjSys_tiInjOpenSyn1 InjSys_tiInjOpenSyn1Stb InjSys_tiInjSum InjSys_tiInjSumStb InjSys_tiInjSyn0 InjSys_tiInjSyn0Stb InjSys_tiInjSyn1 InjSys_tiInjSyn1Stb InjSys_volFuSum InjSys_volFuSumStb /end OUT_MEASUREMENT
 /begin LOC_MEASUREMENT InjSys_facAdpnInjrIndInj InjSys_facAdpnInjrStb InjSys_flgCalcInjTiSyn0 InjSys_flgCalcInjTiSyn1 InjSys_InjCalcSyn0.agEoi InjSys_InjCalcSyn0.agSoi InjSys_InjCalcSyn0.mFu InjSys_InjCalcSyn0.pDeltaRailChmb InjSys_InjCalcSyn0.tiBreakOffs InjSys_InjCalcSyn0.tiBreakOffsBall InjSys_InjCalcSyn0.tiInj InjSys_InjCalcSyn0.tiInjEfc InjSys_InjCalcSyn0.tiInjNlnr InjSys_InjCalcSyn0.tiInjOpen InjSys_InjCalcSyn0.tiInjPred InjSys_InjCalcSyn0.volFu InjSys_InjCalcSyn0Stb.agEoi InjSys_InjCalcSyn0Stb.agSoi InjSys_InjCalcSyn0Stb.mFu InjSys_InjCalcSyn0Stb.pDeltaRailChmb InjSys_InjCalcSyn0Stb.tiBreakOffs InjSys_InjCalcSyn0Stb.tiBreakOffsBall InjSys_InjCalcSyn0Stb.tiInj InjSys_InjCalcSyn0Stb.tiInjEfc InjSys_InjCalcSyn0Stb.tiInjNlnr InjSys_InjCalcSyn0Stb.tiInjOpen InjSys_InjCalcSyn0Stb.tiInjPred InjSys_InjCalcSyn0Stb.volFu InjSys_InjCalcSyn1.agEoi InjSys_InjCalcSyn1.agSoi InjSys_InjCalcSyn1.mFu InjSys_InjCalcSyn1.pDeltaRailChmb InjSys_InjCalcSyn1.tiBreakOffs InjSys_InjCalcSyn1.tiBreakOffsBall InjSys_InjCalcSyn1.tiInj InjSys_InjCalcSyn1.tiInjEfc InjSys_InjCalcSyn1.tiInjNlnr InjSys_InjCalcSyn1.tiInjOpen InjSys_InjCalcSyn1.tiInjPred InjSys_InjCalcSyn1.volFu InjSys_InjCalcSyn1Stb.agEoi InjSys_InjCalcSyn1Stb.agSoi InjSys_InjCalcSyn1Stb.mFu InjSys_InjCalcSyn1Stb.pDeltaRailChmb InjSys_InjCalcSyn1Stb.tiBreakOffs InjSys_InjCalcSyn1Stb.tiBreakOffsBall InjSys_InjCalcSyn1Stb.tiInj InjSys_InjCalcSyn1Stb.tiInjEfc InjSys_InjCalcSyn1Stb.tiInjNlnr InjSys_InjCalcSyn1Stb.tiInjOpen InjSys_InjCalcSyn1Stb.tiInjPred InjSys_InjCalcSyn1Stb.volFu InjSys_mFuSumMem InjSys_mFuSumStbMem InjSys_tiInjMinIndInj InjSys_tiInjSumMem InjSys_tiInjSumStbMem InjSys_volFuSumMem InjSys_volFuSumStbMem /end LOC_MEASUREMENT
 FUNCTION_VERSION "1.27.0" /end FUNCTION
/begin FUNCTION InjSyG_MixCor "3.5.1     Calculation of mixture correction factor dependent on injection mode"
 /begin DEF_CHARACTERISTIC InjSys_facGenMixCorrn1_M InjSys_facGenMixCorrn2_M InjSys_facGenMixCorrn3_M InjSys_facGenMixCorrn4_M InjSys_facGenMixCorrn5_M InjSys_facGenMixCorrn6_M InjSys_facGenMixCorrn7_M InjSys_facGenMixCorrn8_M InjSys_facRelMCorEth_M InjSys_facRelMCorrnSmlVlv_M InjSys_idxMapGenMixCorrn_T InjSys_stMixCorrn_C /end DEF_CHARACTERISTIC
 /begin IN_MEASUREMENT B_vheg_msg Epm_nEng fipoleth_msg InjSys_flgRtOptNEng InjSys_stInjMod InjSys_stInjModStb InjSys_stInjTmng rlp_w_msg rl_w_msg /end IN_MEASUREMENT
 /begin OUT_MEASUREMENT InjSys_facGenMixCorrn InjSys_facGenMixCorrnStb /end OUT_MEASUREMENT
 /begin LOC_MEASUREMENT InjSys_facGenMixCorrnLoc InjSys_facGenMixCorrnTmp InjSys_facRelMCorEth InjSys_facRelMCorrnSmlVlv InjSys_ratAirChrgLoc InjSys_ratAirChrgPrdc InjSys_ratRelAirChrgTmp /end LOC_MEASUREMENT
 FUNCTION_VERSION "3.5.1" /end FUNCTION
/begin FUNCTION InjSyG_MixMngt "159.0.0   Mixture Management"
 /begin DEF_CHARACTERISTIC InjSys_facRatFuMCylAppl_CA InjSys_nMaxAirChrDrctStrt_C InjSys_ratFuMAppl_C /end DEF_CHARACTERISTIC
 /begin IN_MEASUREMENT B_rkapp_msg B_stendes_msg EngStrt_facAftStrtWrmUp EngStrt_flgDrctStrt Epm_nEng fgru_msg fkrk_w_msg fra_w_msg fr_w_msg fst_w_msg fwe_msg InjSys_cntrInjLimdSyncS1 InjSys_facGenMixCorrn InjSys_facGenMixCorrnStb InjSys_facRatFuMCylIndTstr InjSys_flgInjModTran InjSys_flgRtOptNEng InjSys_stInjTmng lamsbg_w_msg rkakapb_w_msg rkausg_w_msg rka_w_msg rkte_w_msg rkukg_w_msg rldirsta_w_msg rlp_w_msg rl_w_msg zzylh_msg zzyls_msg /end IN_MEASUREMENT
 /begin OUT_MEASUREMENT InjSys_facCorrnMix InjSys_facMixCylInd InjSys_facPc InjSys_ratChrgAirSync0 InjSys_ratChrgAirSync1 InjSys_ratFuM InjSys_ratFuMAdpnAddl InjSys_ratFuMAvrg InjSys_ratFuMCylInd InjSys_ratFuMCylIndRdnt_a InjSys_ratFuMCylIndStb InjSys_ratFuMCylInd_a InjSys_ratFuMTot InjSys_ratLamSpSyn0 InjSys_ratPrdcAirLamDes InjSys_ratPrdcFuMLamDesAvrg /end OUT_MEASUREMENT
 /begin LOC_MEASUREMENT InjSys_flgStrtEndMixCalcn InjSys_flgStrtEndTran InjSys_ratFuMTranCmpLoc InjSys_ratLamSp /end LOC_MEASUREMENT
 FUNCTION_VERSION "159.0.0" /end FUNCTION
/begin FUNCTION InjSyG_OpPntCvo "159.1.0   Operating Points Controlled Valve Operation"
 /begin DEF_CHARACTERISTIC InjSys_ratFuMMinUnderBascCvo_C InjSys_ratFuMMinUpperBascCvo_C InjSys_tiDeltaEndBall_C InjSys_tiOpenMinMiCvo_C InjSys_tiOpenMinUndrBascCvo_C InjSys_tiOpenMinUpprBascCvo_C InjSys_tiOpenRefCvo_C /end DEF_CHARACTERISTIC
 /begin REF_CHARACTERISTIC InjSys_tiInjNlnrHiResl_T InjSys_tiOpenMaxBall_C /end REF_CHARACTERISTIC
 /begin IN_MEASUREMENT InjSys_flgCvoBascCylIndEna InjSys_nrInjSyn0 InjSys_pDeltaRailChmbSyn0 InjSys_pDeltaRailChmbSyn1 InjSys_ratFuMBas InjSys_stInjTmng InjSys_tiInjOpenSyn0 InjSys_tiInjOpenSyn1 InjSys_tiInjrPOffsRef InjSys_tiOpenInvCvo InjVvG_desTiAry zzylh_msg zzyls_msg /end IN_MEASUREMENT
 /begin OUT_MEASUREMENT InjSys_flgMinTiBascCvo InjSys_idxMaskBascAdpnCvo InjSys_pInjIndCvoExtdRng InjSys_tiDesOpenInjCvo1_Ary InjSys_tiDesOpenInjCvo2_Ary InjSys_tiDesOpenInjCvo3_Ary InjSys_tiDesOpenInjCvo4_Ary InjSys_tiInjRefBgnTrans InjSys_tiInjRefCvo InjSys_tiOffsMinMiCvo InjSys_tiOpenEndBall InjSys_tiOpenRefCvo /end OUT_MEASUREMENT
 /begin LOC_MEASUREMENT InjSys_mskMinTiBascCvo InjSys_nrIdxInjCvo_a /end LOC_MEASUREMENT
 FUNCTION_VERSION "159.1.0" /end FUNCTION
/begin FUNCTION InjSyG_SpCvo "2.12.0    Setpoints Controlled Valve Operation"
 /begin DEF_CHARACTERISTIC InjSys_agMaxErlyCvo_C InjSys_idxMapGenSpCvo_T InjSys_stEnaFuMCorrnBascAdpn_C InjSys_tiBreakInjCvo_C InjSys_tiInjOpenMaxBall_C InjSys_tiInjOpenMinBall_C InjSys_tiInjOpenMinLnr_C InjSys_tiInjOpenMinMaiInj_C /end DEF_CHARACTERISTIC
 /begin REF_CHARACTERISTIC InjSys_tiOpenRefCvo_C /end REF_CHARACTERISTIC
 /begin IN_MEASUREMENT Epm_nEng FuPHi_pRail GEVCtl_agIntkClsd InjSys_agBas InjSys_facCnvnRatFuM InjSys_flgCvoTestInjBall InjSys_flgInjModCvo InjSys_flgInjModReqCvo InjSys_flgRtOptNEng InjSys_nrMaiInjCyc InjSys_pMnfldCorrdExtdRng InjSys_rhoFu InjSys_stInjMod InjSys_tiInjRefBgnTrans InjSys_tiInjRefCvo InjSys_vAgCrksft InjVvG_CvoAdpn_RefTiCorrAry InjVvG_desTiAry zzylh_msg /end IN_MEASUREMENT
 /begin OUT_MEASUREMENT InjSys_agEoiCvo InjSys_agInjShiftCvo InjSys_agSoiCvo InjSys_flgCvoBascCylIndEna InjSys_flgCvoBascEna InjSys_flgEomCvoBasc InjSys_ratFuMCvo InjSys_ratFuMMaxBall InjSys_ratFuMMinBall InjSys_ratFuMMinLnr InjSys_ratFuMMinMaiInj InjSys_tiDesCvo InjSys_tiInjrPOffsRef InjSys_tiOpenInvCvo /end OUT_MEASUREMENT
 FUNCTION_VERSION "2.12.0" /end FUNCTION
/begin FUNCTION InjVlvPs_ConCJ "10.13.0_1.5.0Configuration of Output Stage Electromagnetic Injector (HDEV)"
 /begin DEF_CHARACTERISTIC InjVlvPs_DCDC_SETPNTVOLT_C InjVlvPs_Dset0_iBoost_max_C InjVlvPs_Dset0_iBoost_min_C InjVlvPs_Dset0_iDcdcChrg_max_C InjVlvPs_Dset0_iDcdcChrg_min_C InjVlvPs_Dset0_iHold_max_C InjVlvPs_Dset0_iHold_min_C InjVlvPs_Dset0_iPull_max_C InjVlvPs_Dset0_iPull_min_C InjVlvPs_Dset0_numBoosts_C InjVlvPs_Dset0_tiBoost_C InjVlvPs_Dset0_tiPull_C InjVlvPs_Dset1_iBoost_max_C InjVlvPs_Dset1_iBoost_min_C InjVlvPs_Dset1_iDcdcChrg_max_C InjVlvPs_Dset1_iDcdcChrg_min_C InjVlvPs_Dset1_iHold_max_C InjVlvPs_Dset1_iHold_min_C InjVlvPs_Dset1_iPull_max_C InjVlvPs_Dset1_iPull_min_C InjVlvPs_Dset1_numBoosts_C InjVlvPs_Dset1_tiBoost_C InjVlvPs_Dset1_tiPull_C InjVlvPs_Dset2_iBoost_max_C InjVlvPs_Dset2_iBoost_min_C InjVlvPs_Dset2_iDcdcChrg_max_C InjVlvPs_Dset2_iDcdcChrg_min_C InjVlvPs_Dset2_iHold_max_C InjVlvPs_Dset2_iHold_min_C InjVlvPs_Dset2_iPull_max_C InjVlvPs_Dset2_iPull_min_C InjVlvPs_Dset2_numBoosts_C InjVlvPs_Dset2_tiBoost_C InjVlvPs_Dset2_tiPull_C InjVlvPs_FD1SKIP_C InjVlv_numBnkTDC_CA InjVlv_numStLine_CA InjVlv_numTDCToINJS_T InjVvG_FSC_RetVal_Enum_C /end DEF_CHARACTERISTIC
 /begin REF_CHARACTERISTIC Epm_numFireSeg_C /end REF_CHARACTERISTIC
 /begin IN_MEASUREMENT B_invlvbcd_msg B_invlvhpr_msg EngStrt_bStrtEnd Epm_numCyl /end IN_MEASUREMENT
 /begin OUT_MEASUREMENT InjVlv_stAct_prmSetInjVlvPs /end OUT_MEASUREMENT
 /begin LOC_MEASUREMENT injvlvps_cntErr_Conf_u8 InjVlvPs_ConCJ_ctIniDrv InjVlvPs_numBnk InjVlvPs_numCplCyl InjVvG_FSC_RetVal_CmplxGetConfigFunc InjVvG_FSC_RetVal_GetConfig InjVvG_FSC_RetVal_GetDiagFunc InjVvG_FSC_RetVal_GetVar ParSentenceAssign_u32 /end LOC_MEASUREMENT
 FUNCTION_VERSION "10.13.0_1.5.0" /end FUNCTION
/begin FUNCTION InjVlvPs_Dia "10.25.0   Diagnosis of Output Stage Electromagnetic Injector"
 /begin DEF_CHARACTERISTIC InjVlvPs_Dia_AbmNoLd InjVlvPs_Dia_AbmScBnk InjVlvPs_Dia_AbmScCyl InjVlvPs_Dia_AbmScHsLs InjVlvPs_numMinCylOk_C INJVLVPS_UDMAX_C INJVLVPS_UDMIN_C THEALING_C /end DEF_CHARACTERISTIC
 /begin IN_MEASUREMENT BattU_u B_ll_msg DSM_TripChgFinshd EngStrt_bStrtEnd Epm_nEng Epm_numCyl evz_austot_msg /end IN_MEASUREMENT
 /begin OUT_MEASUREMENT abmhdev_msg B_eev_msg B_ehdev_msg InjVlvPs_Dia_nrDcDcActv_u8 InjVlvPs_Dia_nrDevActv_u8 InjVlvPs_Dia_stCylOk_u8 /end OUT_MEASUREMENT
 /begin LOC_MEASUREMENT injvlvps_dhdevee_b InjVlvPs_DiagDcDc_u32 InjVlvPs_Dia_AbmNoLd_u8 InjVlvPs_Dia_AbmScBnk_u8 InjVlvPs_Dia_AbmScCyl_u8 InjVlvPs_Dia_AbmScHsLs_u8 InjVlvPs_Dia_Abm_Cyl_u8 InjVlvPs_Dia_cntErr_SpiInit_u8 InjVlvPs_Dia_cntErr_SpiReq_u8 InjVlvPs_Dia_cntErr_SpiTx_u8 InjVlvPs_Dia_cntErr_ValDiff_u8 InjVlvPs_Dia_ctIniDrv InjVlvPs_Dia_DiagInfo_Cyl_u32 InjVlvPs_Dia_DiagInfo_IC_u32 InjVlvPs_Dia_drven InjVlvPs_Dia_HdevErr_Cyl_u8 InjVlvPs_Dia_HealPrms InjVlvPs_Dia_mskCylNotActv InjVlvPs_Dia_nrVlvToStrt InjVlvPs_Dia_State_Cyl_u8 InjVlvPs_Dia_stFscDiagAct_u8 InjVlvPs_Dia_tHealing_Cyl_u16 InjVlvPs_Dia_uBatt_u16 InjVlvPs_Dia_Ver_HW InjVlvPs_Dia_WDA_ReadCnt InjVlvPs_Dia_WDA_ReadRet InjVlvPs_Dia_WDA_ReqCnt InjVlvPs_Dia_WDA_ReqRet /end LOC_MEASUREMENT
 FUNCTION_VERSION "10.25.0" /end FUNCTION
/begin FUNCTION InjVlvPs_Dia_Auto "" /end FUNCTION
/begin FUNCTION IntkAirT_AdprOutp "2.14.0    Export adapter for sensor-package IntkAirT" /begin DEF_CHARACTERISTIC TANSDE TTFANMOT /end DEF_CHARACTERISTIC
 /begin IN_MEASUREMENT Eep_EnvRamHist Eep_EnvRamInvld Epm_stSpd IntkAirT_flgAirFltDsVld IntkAirT_flgIntkMnfldMeasdVld IntkAirT_flgIntkMnfldVld IntkAirT_flgSnsr1CrssChkClr IntkAirT_flgSnsr1CrssChkPrms IntkAirT_flgSnsr1ElecChkClr IntkAirT_flgSnsr1ElecVld IntkAirT_flgSnsr1MeasdVld IntkAirT_flgSnsr1PlausChkClr IntkAirT_flgSnsr1PlausChkPrms IntkAirT_flgSnsr2CrssChkClr IntkAirT_flgSnsr2CrssChkPrms IntkAirT_flgSnsr2ElecChkClr IntkAirT_flgSnsr2ElecVld IntkAirT_flgSnsr2MeasdVld IntkAirT_flgSnsr2PlausChkClr IntkAirT_flgSnsr2PlausChkPrms IntkAirT_flgThrVlvUsVld IntkAirT_tAirFltDs IntkAirT_tIntkMnfld IntkAirT_tIntkMnfldMeasd IntkAirT_tSnsr1 IntkAirT_tThrVlvUs IntkAirT_tThrVlvUsMax IntkAirT_tThrVlvUsMin SyC_stSub TiEngOff_bRst /end IN_MEASUREMENT
 /begin OUT_MEASUREMENT B_ctfa1fcl_msg B_ctfa1prm_msg B_ctfa2fcl_msg B_ctfa2prm_msg B_etfa1fcl_msg B_etfa2fcl_msg B_ptfa1fcl_msg B_ptfa1prm_msg B_ptfa2fcl_msg B_ptfa2prm_msg B_tanlfg_msg B_tansgg_msg B_tasrgg_msg B_tasrg_msg B_tavdkg_msg B_tfa1gg_msg B_tfa1rg_msg B_tfa2gg_msg B_tfa2rg_msg tanlf_w_msg tansabz_msg tansab_msg tanskst_w_msg tansk_w_msg tanslin_msg tansstz_msg tansst_msg tans_msg tasrg_w_msg tasr_w_msg tavdkmn_w_msg tavdkmx_w_msg tavdk_w_msg /end OUT_MEASUREMENT
 /begin LOC_MEASUREMENT B_tansnmot B_tfastz tansab_loc /end LOC_MEASUREMENT
 FUNCTION_VERSION "2.14.0" /end FUNCTION
/begin FUNCTION IntkAirT_Dd "5.0.0     DeviceDriver for Intake Air Temperature Sensor"
 /begin DEF_CHARACTERISTIC IntkAirT_cwSnsrFrzEna_C IntkAirT_LnrwSnsr1_T IntkAirT_LnrwSnsr2_T IntkAirT_mAirMflmaxSnsr1Enad_C IntkAirT_mAirMflmaxSnsr2Enad_C IntkAirT_mAirMfSnsrElecChk_C IntkAirT_SnsrLim_CW IntkAirT_SRCSnsrLim_CW IntkAirT_tEngMinRelsElecDiag_C IntkAirT_tEngMinRelsStrtElecDiag_C IntkAirT_tiDebElecFaultSnsr1_C IntkAirT_tiDebElecFaultSnsr2_C IntkAirT_tiDebHealElecFaultSnsr1_C IntkAirT_tiDebHealElecFaultSnsr2_C IntkAirT_TnDebDiagSnsr_C IntkAirT_TnJmp1Snsr1_C IntkAirT_TnJmp1Snsr2_C IntkAirT_TnJmp2Snsr1_C IntkAirT_TnJmp2Snsr2_C IntkAirT_TnPT1locSnsr1_C IntkAirT_TnPT1Snsr1_C IntkAirT_TnPT1Snsr2_C IntkAirT_TnPT2locSnsr2_C IntkAirT_TolrSrcSnsr1_C IntkAirT_TolrSrcSnsr2_C IntkAirT_UmaxSnsr1_C IntkAirT_UmaxSnsr2_C IntkAirT_UminSnsr1_C IntkAirT_UminSnsr2_C IntkAirT_vVehMaxRelsElecDiag_C /end DEF_CHARACTERISTIC
 /begin IN_MEASUREMENT AirMod_mfAirCyl CEngDsT_t CEngDsT_tStrt CEngDsT_t_Sq ExhMod_mAirMfIntegEngStrt IntkAirT_flgSnsr1ElecChkClr IntkAirT_flgSnsr2ElecChkClr SyC_stSub VehV_v /end IN_MEASUREMENT
 /begin OUT_MEASUREMENT IntkAirT_flgImps1Err IntkAirT_flgImps1Heal IntkAirT_flgImps2Err IntkAirT_flgImps2Heal IntkAirT_flgSRC1MaxErr IntkAirT_flgSRC1MaxHeal IntkAirT_flgSRC1MinErr IntkAirT_flgSRC1MinHeal IntkAirT_flgSRC2MaxErr IntkAirT_flgSRC2MaxHeal IntkAirT_flgSRC2MinErr IntkAirT_flgSRC2MinHeal IntkAirT_flgSRCMaxEna IntkAirT_flgSRCMinEna IntkAirT_stSnsr1ADC IntkAirT_stSnsr2ADC IntkAirT_tSnsr1ADC IntkAirT_tSnsr1TstrADC IntkAirT_tSnsr2ADC IntkAirT_tSnsr2TstrADC IntkAirT_tSnsrFild1ADC IntkAirT_tSnsrFild2ADC IntkAirT_tSnsrFildLimd1ADC IntkAirT_tSnsrFildLimd2ADC IntkAirT_tSnsrTstr IntkAirT_uSnsr1Exprt IntkAirT_uSnsr2Exprt /end OUT_MEASUREMENT
 /begin LOC_MEASUREMENT IntkAirT_flgDSMClrDevDrvrSnsr1 IntkAirT_flgDSMClrDevDrvrSnsr2 IntkAirT_flgImps1Errloc IntkAirT_flgImps1Healloc IntkAirT_flgImps1mld IntkAirT_flgImps2Errloc IntkAirT_flgImps2Healloc IntkAirT_flgImps2mld IntkAirT_flgNormOp IntkAirT_flgSnsr1Elecdl IntkAirT_flgSnsr1ElecEnag IntkAirT_flgSnsr1MaxErr IntkAirT_flgSnsr1MinErr IntkAirT_flgSnsr1PwrSplyAvl IntkAirT_flgSnsr2Elecdl IntkAirT_flgSnsr2ElecEnag IntkAirT_flgSnsr2MaxErr IntkAirT_flgSnsr2MinErr IntkAirT_flgSnsr2PwrSplyAvl IntkAirT_flgSRC1MaxErrloc IntkAirT_flgSRC1MaxHealloc IntkAirT_flgSRC1MinErrloc IntkAirT_flgSRC1MinHealloc IntkAirT_flgSRC1MinRels IntkAirT_flgSRC2MaxErrloc IntkAirT_flgSRC2MaxHealloc IntkAirT_flgSRC2MinErrloc IntkAirT_flgSRC2MinHealloc IntkAirT_flgSRC2MinRels IntkAirT_flgSRC3MinRels IntkAirT_flgSRC4MinRels IntkAirT_flgSRC5MinRels IntkAirT_flgSRC6MinRels IntkAirT_flgTnPTRstSnsr1 IntkAirT_flgTnPTRstSnsr2 IntkAirT_stSnsr1ADCLoc IntkAirT_stSnsr2ADCLoc IntkAirT_tSnsr1ADCLoc IntkAirT_tSnsr1TstrADCLoc IntkAirT_tSnsr2ADCLoc IntkAirT_tSnsr2TstrADCLoc IntkAirT_tSnsrFild1ADCLoc IntkAirT_tSnsrFild2ADCLoc IntkAirT_tSnsrFildLimd1ADCLoc IntkAirT_tSnsrFildLimd2ADCLoc IntkAirT_uFildSnsr1 IntkAirT_uFildSnsr2 IntkAirT_uSnsr1CrssSwtLoc IntkAirT_uSnsr2CrssSwtLoc /end LOC_MEASUREMENT
 FUNCTION_VERSION "5.0.0" /end FUNCTION
/begin FUNCTION IntkAirT_DiagCoorrSnsr1 "1.15.0    Diagnosis coordinator of Intake Air Temperature Sensor 1" /begin DEF_CHARACTERISTIC IntkAirT_tiSnsr1DSMCycRprt_C IntkAirT_tiSnsr1DSMFrstRprt_C /end DEF_CHARACTERISTIC
 /begin IN_MEASUREMENT IntkAirT_flgCrss1MaxErr IntkAirT_flgCrss1MaxHeal IntkAirT_flgCrss1MinErr IntkAirT_flgCrss1MinHeal IntkAirT_flgCrssChk1NumrInc IntkAirT_flgHSC1MaxErr IntkAirT_flgHSC1MaxHeal IntkAirT_flgImps1Err IntkAirT_flgImps1Heal IntkAirT_flgPlausChk1NumrInc IntkAirT_flgPRC1MaxErr IntkAirT_flgPRC1MaxHeal IntkAirT_flgPRC1MinErr IntkAirT_flgPRC1MinHeal IntkAirT_flgSRC1MaxErr IntkAirT_flgSRC1MaxHeal IntkAirT_flgSRC1MinErr IntkAirT_flgSRC1MinHeal IntkAirT_flgSTC1Err IntkAirT_flgSTC1Heal IntkAirT_stSnsr1ADC IntkAirT_tSnsr1ADC IntkAirT_tSnsr1TstrADC IntkAirT_tSnsrFild1ADC IntkAirT_tSnsrFildLimd1ADC TDev_flgDSMRprt1000ms TDev_flgDSMRprt100ms /end IN_MEASUREMENT
 /begin OUT_MEASUREMENT IntkAirT_flgIntkMnfldMeasdVld IntkAirT_flgSnsr1CrssChkClr IntkAirT_flgSnsr1CrssChkPrms IntkAirT_flgSnsr1ElecChkClr IntkAirT_flgSnsr1ElecVld IntkAirT_flgSnsr1MeasdVld IntkAirT_flgSnsr1PlausChkClr IntkAirT_flgSnsr1PlausChkPrms IntkAirT_stSnsr1 IntkAirT_tIntkMnfldMeasd IntkAirT_tSnsr1 IntkAirT_tSnsr1Tstr IntkAirT_tSnsrFild1 IntkAirT_tSnsrFildLimd1 /end OUT_MEASUREMENT
 /begin LOC_MEASUREMENT IntkAirT_stSnsr1CycRprt1000ms IntkAirT_stSnsr1CycRprt100ms IntkAirT_tiSnsr1CycRprt1000ms IntkAirT_tiSnsr1CycRprt100ms /end LOC_MEASUREMENT
 FUNCTION_VERSION "1.15.0" /end FUNCTION
/begin FUNCTION IntkAirT_DiagCoorrSnsr2 "5.0.0     Diagnosis coordinator of Intake Air Temperature Sensor 2" /begin DEF_CHARACTERISTIC IntkAirT_tiSnsr2DSMCycRprt_C IntkAirT_tiSnsr2DSMFrstRprt_C /end DEF_CHARACTERISTIC
 /begin IN_MEASUREMENT IntkAirT_flgCrss2MaxErr IntkAirT_flgCrss2MaxHeal IntkAirT_flgCrss2MinErr IntkAirT_flgCrss2MinHeal IntkAirT_flgCrssChk2NumrInc IntkAirT_flgHSC2MaxErr IntkAirT_flgHSC2MaxHeal IntkAirT_flgImps2Err IntkAirT_flgImps2Heal IntkAirT_flgPlausChk2NumrInc IntkAirT_flgPRC2MaxErr IntkAirT_flgPRC2MaxHeal IntkAirT_flgPRC2MinErr IntkAirT_flgPRC2MinHeal IntkAirT_flgSRC2MaxErr IntkAirT_flgSRC2MaxHeal IntkAirT_flgSRC2MinErr IntkAirT_flgSRC2MinHeal IntkAirT_flgSTC2Err IntkAirT_flgSTC2Heal IntkAirT_stSnsr2ADC IntkAirT_tSnsr2ADC IntkAirT_tSnsr2TstrADC IntkAirT_tSnsrFild2ADC IntkAirT_tSnsrFildLimd2ADC TDev_flgDSMRprt1000ms TDev_flgDSMRprt100ms /end IN_MEASUREMENT
 /begin OUT_MEASUREMENT IntkAirT_flgAirFltDsMeasdVld IntkAirT_flgSnsr2CrssChkClr IntkAirT_flgSnsr2CrssChkPrms IntkAirT_flgSnsr2ElecChkClr IntkAirT_flgSnsr2ElecVld IntkAirT_flgSnsr2MeasdVld IntkAirT_flgSnsr2PlausChkClr IntkAirT_flgSnsr2PlausChkPrms IntkAirT_stSnsr2 IntkAirT_tAirFltDsMeasd IntkAirT_tSnsr2 IntkAirT_tSnsr2Tstr IntkAirT_tSnsrFild2 IntkAirT_tSnsrFildLimd2 /end OUT_MEASUREMENT
 /begin LOC_MEASUREMENT IntkAirT_stAirFltDsVccErrChkClr IntkAirT_stSnsr2CycRprt1000ms IntkAirT_stSnsr2CycRprt100ms IntkAirT_tiSnsr2CycRprt1000ms IntkAirT_tiSnsr2CycRprt100ms /end LOC_MEASUREMENT
 FUNCTION_VERSION "5.0.0" /end FUNCTION
/begin COMPU_METHOD B_TRUE "" TAB_VERB "%6.3" "" COMPU_TAB_REF B_TRUE /end COMPU_METHOD
/begin COMPU_VTAB B_TRUE "" TAB_VERB 2 0 "FALSE" 1 "TRUE" /end COMPU_VTAB
/begin COMPU_METHOD dez "" RAT_FUNC "%6.2" "" COEFFS 0 1 0 0 0 1 /end COMPU_METHOD
/begin COMPU_METHOD EngN "" RAT_FUNC "%6.3" "rpm" COEFFS 0 2 0 0 0 1 /end COMPU_METHOD
/begin COMPU_METHOD fak_ub_b1 "" RAT_FUNC "%6.4" "-" COEFFS 0 256 0 0 0 1 /end COMPU_METHOD
/begin COMPU_METHOD fak_ub_b2 "" RAT_FUNC "%8.5" "-" COEFFS 0 256 0 0 0 2 /end COMPU_METHOD
/begin COMPU_METHOD fak_ub_b8 "" RAT_FUNC "%6.4" "-" COEFFS 0 256 0 0 0 8 /end COMPU_METHOD
/begin COMPU_METHOD fak_uw_b1 "" RAT_FUNC "%7.6" "-" COEFFS 0 65536 0 0 0 1 /end COMPU_METHOD
/begin COMPU_METHOD fak_uw_b16 "" RAT_FUNC "%6.5" "-" COEFFS 0 65536 0 0 0 16 /end COMPU_METHOD
/begin COMPU_METHOD fak_uw_b2 "" RAT_FUNC "%7.6" "-" COEFFS 0 65536 0 0 0 2 /end COMPU_METHOD
/begin COMPU_METHOD fak_uw_b4 "" RAT_FUNC "%7.6" "-" COEFFS 0 65536 0 0 0 4 /end COMPU_METHOD
/begin COMPU_METHOD fak_uw_b64 "" RAT_FUNC "%6.5" "-" COEFFS 0 65536 0 0 0 64 /end COMPU_METHOD
/begin COMPU_METHOD InjSys_InjMode_Set_COMPU_VERB "" TAB_VERB "%6.3" "-" COMPU_TAB_REF InjSys_InjMode_Set_COMPU_VERB /end COMPU_METHOD
/begin COMPU_VTAB InjSys_InjMode_Set_COMPU_VERB "" TAB_VERB 20 0 "GDIOff" 1 "HO1" 2 "HO2" 3 "HO3" 4 "HO1_WU" 5 "HO2_WU" 6 "HO3_WU" 7 "HP2" 8 "HP3" 9 "HP2_CH" 10 "HP3_CH" 11 "HP2Z" 12 "HP3Z" 13 "SHO1" 14 "SHO2" 15 "SHO3" 16 "SHP3" 17 "SH1" 18 "SH2" 19 "SH3" /end COMPU_VTAB
/begin COMPU_METHOD i_q1_mA "" RAT_FUNC "%6.2" "mA" COEFFS 0 1 0 0 0 1 /end COMPU_METHOD
/begin COMPU_METHOD kw_q0p0156 "" RAT_FUNC "%6.4" "Grad KW" COEFFS 0 64 0 0 0 1 /end COMPU_METHOD
/begin COMPU_METHOD kw_q0p0234 "" RAT_FUNC "%6.4" "Grad KW" COEFFS 0 32768 0 0 0 768 /end COMPU_METHOD
/begin COMPU_METHOD kw_q0p375 "" RAT_FUNC "%6.3" "deg KW" COEFFS 0 1 0 0 0 0.375 /end COMPU_METHOD
/begin COMPU_METHOD kw_q0p75 "" RAT_FUNC "%6.3" "Grad KW" COEFFS 0 4 0 0 0 3 /end COMPU_METHOD
/begin COMPU_METHOD kw_q1p5 "" RAT_FUNC "%6.2" "deg KW" COEFFS 0 256 0 0 0 384 /end COMPU_METHOD
/begin COMPU_METHOD kw_q2 "" RAT_FUNC "%6.2" "deg KW" COEFFS 0 1 0 0 0 2 /end COMPU_METHOD
/begin COMPU_METHOD m_q0p01_mg "" RAT_FUNC "%6.4" "mg" COEFFS 0 100 0 0 0 1 /end COMPU_METHOD
/begin COMPU_METHOD m_q0p1_g_DIV_L "" RAT_FUNC "%6.3" "g/l" COEFFS 0 10 0 0 0 1 /end COMPU_METHOD
/begin COMPU_METHOD m_ub_b1020 "" RAT_FUNC "%6.2" "kg/h" COEFFS 0 1 0 0 0 4 /end COMPU_METHOD
/begin COMPU_METHOD m_uw_b23p3 "" RAT_FUNC "%6.5" "kg" COEFFS 0 2812.5 0 0 0 1 /end COMPU_METHOD
/begin COMPU_METHOD OneToOne "" RAT_FUNC "%6.2" "-" COEFFS 0 1 0 0 0 1 /end COMPU_METHOD
/begin COMPU_METHOD Prc "" RAT_FUNC "%6.4" "%" COEFFS 0 81.92 0 0 0 1 /end COMPU_METHOD
/begin COMPU_METHOD p_q0p078 "" RAT_FUNC "%6.4" "hPa" COEFFS 0 64 0 0 0 5 /end COMPU_METHOD
/begin COMPU_METHOD RBPtCel_p_0p002_1 "" RAT_FUNC "%6.4" "MPa" COEFFS 0 1000 0 0 0 2 /end COMPU_METHOD
/begin COMPU_METHOD rel_q0p0234 "" RAT_FUNC "%6.4" "%" COEFFS 0 128 0 0 0 3 /end COMPU_METHOD
/begin COMPU_METHOD rel_q0p1875 "" RAT_FUNC "%6.3" "%" COEFFS 0 1 0 0 0 0.1875 /end COMPU_METHOD
/begin COMPU_METHOD rel_sw_b1536 "" RAT_FUNC "%6.4" "%" COEFFS 0 65536 0 0 0 3072 /end COMPU_METHOD
/begin COMPU_METHOD rel_uw_b3072 "" RAT_FUNC "%6.4" "%" COEFFS 0 65536 0 0 0 3072 /end COMPU_METHOD
/begin COMPU_METHOD rel_uw_q0p0234 "" RAT_FUNC "%6.4" "%" COEFFS 0 32 0 0 0 0.75 /end COMPU_METHOD
/begin COMPU_METHOD SECBATT_SC_Compu "" TAB_VERB "%6.3" "" COMPU_TAB_REF SECBATT_SC_Compu /end COMPU_METHOD
/begin COMPU_VTAB SECBATT_SC_Compu "" TAB_VERB 2 0 "False" 1 "True" /end COMPU_VTAB
/begin COMPU_METHOD SECUPCK_SC_Compu "" TAB_VERB "%6.3" "" COMPU_TAB_REF SECUPCK_SC_Compu /end COMPU_METHOD
/begin COMPU_VTAB SECUPCK_SC_Compu "" TAB_VERB 4 0 "None" 1 "SecuMgr" 2 "EcuSecu_HSM" 3 "EcuSecu_SSM" /end COMPU_VTAB
/begin COMPU_METHOD SECURBOOTENA_SC_Compu "" TAB_VERB "%6.3" "" COMPU_TAB_REF SECURBOOTENA_SC_Compu /end COMPU_METHOD
/begin COMPU_VTAB SECURBOOTENA_SC_Compu "" TAB_VERB 2 0 "False" 1 "True" /end COMPU_VTAB
/begin COMPU_METHOD SELVRNTBASDAIRCDNSHOFF_SC_Compu "" TAB_VERB "%6.3" "" COMPU_TAB_REF SELVRNTBASDAIRCDNSHOFF_SC_Compu /end COMPU_METHOD
/begin COMPU_VTAB SELVRNTBASDAIRCDNSHOFF_SC_Compu "" TAB_VERB 3 1 "2WF_variant" 2 "2CF_variant" 3 "2SV_Variant" /end COMPU_VTAB
/begin COMPU_METHOD SENTIPCORETYPE_SC_Compu "" TAB_VERB "%6.3" "" COMPU_TAB_REF SENTIPCORETYPE_SC_Compu /end COMPU_METHOD
/begin COMPU_VTAB SENTIPCORETYPE_SC_Compu "" TAB_VERB 2 0 "0" 1 "1" /end COMPU_VTAB
/begin COMPU_METHOD SENT_SC_Compu "" TAB_VERB "%6.3" "" COMPU_TAB_REF SENT_SC_Compu /end COMPU_METHOD
/begin COMPU_VTAB SENT_SC_Compu "" TAB_VERB 2 0 "False" 1 "True" /end COMPU_VTAB
/begin COMPU_METHOD SEPAIRVOLINTKMNFLD_SC_Compu "" TAB_VERB "%6.3" "" COMPU_TAB_REF SEPAIRVOLINTKMNFLD_SC_Compu /end COMPU_METHOD
/begin COMPU_VTAB SEPAIRVOLINTKMNFLD_SC_Compu "" TAB_VERB 2 0 "False" 1 "True" /end COMPU_VTAB
/begin COMPU_METHOD SEPAIRVOLTHRVLVUS_SC_Compu "" TAB_VERB "%6.3" "" COMPU_TAB_REF SEPAIRVOLTHRVLVUS_SC_Compu /end COMPU_METHOD
/begin COMPU_VTAB SEPAIRVOLTHRVLVUS_SC_Compu "" TAB_VERB 2 0 "False" 1 "True" /end COMPU_VTAB
/begin COMPU_METHOD SETPOINTCALC_TRQBASED_SY_Compu "" TAB_VERB "%6.3" "" COMPU_TAB_REF SETPOINTCALC_TRQBASED_SY_Compu /end COMPU_METHOD
/begin COMPU_VTAB SETPOINTCALC_TRQBASED_SY_Compu "" TAB_VERB 2 0 "QUANTITY" 1 "TORQUE" /end COMPU_VTAB
/begin COMPU_METHOD SG_INTVENG_SY_Compu "" TAB_VERB "%6.3" "" COMPU_TAB_REF SG_INTVENG_SY_Compu /end COMPU_METHOD
/begin COMPU_VTAB SG_INTVENG_SY_Compu "" TAB_VERB 2 0 "False" 1 "True" /end COMPU_VTAB
/begin COMPU_METHOD SIGNALS_OBDDIDSUPRT_SC_Compu "" TAB_VERB "%6.3" "" COMPU_TAB_REF SIGNALS_OBDDIDSUPRT_SC_Compu /end COMPU_METHOD
/begin COMPU_VTAB SIGNALS_OBDDIDSUPRT_SC_Compu "" TAB_VERB 2 0 "Disabled" 1 "Enabled" /end COMPU_VTAB
/begin COMPU_METHOD Signals_OneToOne "" RAT_FUNC "%6.2" "" COEFFS 0 1 0 0 0 1 /end COMPU_METHOD
/begin COMPU_METHOD Sig_I15031_LeanAppl_SY_Compu "" RAT_FUNC "%6.2" "" COEFFS 0 1 0 0 0 1 /end COMPU_METHOD
/begin COMPU_METHOD SMTACTR_SC_Compu "" TAB_VERB "%6.3" "" COMPU_TAB_REF SMTACTR_SC_Compu /end COMPU_METHOD
/begin COMPU_VTAB SMTACTR_SC_Compu "" TAB_VERB 2 0 "noSmartActuator" 1 "SmartActuator" /end COMPU_VTAB
/begin COMPU_METHOD Soot_gPerLtr "" RAT_FUNC "%6.4" "g/l" COEFFS 0 100 0 0 0 1 /end COMPU_METHOD
/begin COMPU_METHOD SotMassPerDist "" RAT_FUNC "%7.6" "g/km" COEFFS 0 10000 0 0 0 1 /end COMPU_METHOD
/begin COMPU_METHOD SotMassPerSec "" RAT_FUNC "%6.3" "g/s" COEFFS 0 10 0 0 0 1 /end COMPU_METHOD
/begin COMPU_METHOD SotMassPerTime "" RAT_FUNC "%6.4" "mg/s" COEFFS 0 100 0 0 0 1 /end COMPU_METHOD
/begin COMPU_METHOD SotMsPerkm_COMPU "" RAT_FUNC "%6.5" "g/km" COEFFS 0 8192 0 0 0 1 /end COMPU_METHOD
/begin COMPU_METHOD SotMs_KgPrSec_COMPU "" RAT_FUNC "%6.2" "kg/s" COEFFS 0 1 0 0 0 1 /end COMPU_METHOD
/begin COMPU_METHOD SOUNDTUN_SC_Compu "" TAB_VERB "%6.3" "" COMPU_TAB_REF SOUNDTUN_SC_Compu /end COMPU_METHOD
/begin COMPU_VTAB SOUNDTUN_SC_Compu "" TAB_VERB 2 0 "False" 1 "True" /end COMPU_VTAB
/begin COMPU_METHOD SOxMassPerTime "" RAT_FUNC "%7.6" "mg/s" COEFFS 0 10000 0 0 0 1 /end COMPU_METHOD
/begin COMPU_METHOD SPAF_SY_Compu "" TAB_VERB "%6.3" "" COMPU_TAB_REF SPAF_SY_Compu /end COMPU_METHOD
/begin COMPU_VTAB SPAF_SY_Compu "" TAB_VERB 2 0 "False" 1 "True" /end COMPU_VTAB
/begin COMPU_METHOD SpaVel "" RAT_FUNC "%6.1" "l/h" COEFFS 0 0.1 0 0 0 1 /end COMPU_METHOD
/begin COMPU_METHOD SPC_SY_Compu "" TAB_VERB "%6.3" "" COMPU_TAB_REF SPC_SY_Compu /end COMPU_METHOD
/begin COMPU_VTAB SPC_SY_Compu "" TAB_VERB 2 0 "no SPC available" 1 "SPC available" /end COMPU_VTAB
/begin COMPU_METHOD SPDCTL_CRPINCBRKVAC_SC_Compu "" TAB_VERB "%6.3" "" COMPU_TAB_REF SPDCTL_CRPINCBRKVAC_SC_Compu /end COMPU_METHOD
/begin COMPU_VTAB SPDCTL_CRPINCBRKVAC_SC_Compu "" TAB_VERB 2 0 "False" 1 "True" /end COMPU_VTAB
/begin COMPU_METHOD SPDCTL_DRVMODACTVTQRESV_SC_Compu "" TAB_VERB "%6.3" "" COMPU_TAB_REF SPDCTL_DRVMODACTVTQRESV_SC_Compu /end COMPU_METHOD
/begin COMPU_VTAB SPDCTL_DRVMODACTVTQRESV_SC_Compu "" TAB_VERB 2 0 "False" 1 "True" /end COMPU_VTAB
/begin COMPU_METHOD SPDCTL_ENAGQUICKSTRT_SC_Compu "" TAB_VERB "%6.3" "" COMPU_TAB_REF SPDCTL_ENAGQUICKSTRT_SC_Compu /end COMPU_METHOD
/begin COMPU_VTAB SPDCTL_ENAGQUICKSTRT_SC_Compu "" TAB_VERB 2 0 "False" 1 "True" /end COMPU_VTAB
/begin COMPU_METHOD SPDCTL_HPTQRESV_SC_Compu "" TAB_VERB "%6.3" "" COMPU_TAB_REF SPDCTL_HPTQRESV_SC_Compu /end COMPU_METHOD
/begin COMPU_VTAB SPDCTL_HPTQRESV_SC_Compu "" TAB_VERB 2 0 "False" 1 "True" /end COMPU_VTAB
/begin COMPU_METHOD SPDCTL_HYB_SC_Compu "" TAB_VERB "%6.3" "" COMPU_TAB_REF SPDCTL_HYB_SC_Compu /end COMPU_METHOD
/begin COMPU_VTAB SPDCTL_HYB_SC_Compu "" TAB_VERB 2 0 "False" 1 "True" /end COMPU_VTAB
/begin COMPU_METHOD SPDCTL_IDLESPDSPDEFRST_SC_Compu "" TAB_VERB "%6.3" "" COMPU_TAB_REF SPDCTL_IDLESPDSPDEFRST_SC_Compu /end COMPU_METHOD
/begin COMPU_VTAB SPDCTL_IDLESPDSPDEFRST_SC_Compu "" TAB_VERB 3 0 "Disabled" 1 "IdleSpd" 2 "IdleSpd_DesMod" /end COMPU_VTAB
/begin COMPU_METHOD SPDCTL_SGA09LLSBSIZE_SC_Compu "" RAT_FUNC "%6.2" "" COEFFS 0 1 0 0 0 1 /end COMPU_METHOD
/begin COMPU_METHOD SPDCTL_TNRMAXSIZE_SC_Compu "" RAT_FUNC "%6.2" "" COEFFS 0 1 0 0 0 1 /end COMPU_METHOD
/begin COMPU_METHOD SPDCTL_TQLVL_SC_Compu "" TAB_VERB "%6.3" "" COMPU_TAB_REF SPDCTL_TQLVL_SC_Compu /end COMPU_METHOD
/begin COMPU_VTAB SPDCTL_TQLVL_SC_Compu "" TAB_VERB 2 0 "0" 1 "1" /end COMPU_VTAB
/begin COMPU_METHOD SPDCTL_VAR_SY_Compu "" TAB_VERB "%6.3" "" COMPU_TAB_REF SPDCTL_VAR_SY_Compu /end COMPU_METHOD
/begin COMPU_VTAB SPDCTL_VAR_SY_Compu "" TAB_VERB 54 1 "DAI" 3 "VWW" 4 "POR" 5 "AUD" 6 "OPE" 9 "FIA" 11 "BMW" 14 "PSA" 15 "REN" 17 "ALF" 18 "SAB" 19 "VOL" 20 "NIS" 21 "GMU" 22 "FOR" 26 "IMJ" 51 "SEA" 53 "CHR" 54 "JAG" 55 "ROL" 69 "FER" 72 "TOY" 123 "MIT" 147 "HYU" 159 "HON" 160 "MAZ" 183 "CU" 190 "LRG" 204 "VVW" 214 "AVT" 242 "Iveco" 243 "DMC" 248 "SUZ" 267 "SSANGYONG" 270 "KEF" 289 "AMG" 308 "TAT" 319 "MVM" 328 "MM" 385 "UAES" 425 "Polaris" 590 "Scania" 828 "RBCD" 858 "Kubota" 898 "MFTBC" 944 "DOOSAN_Infracore" 973 "Yanmar_Japan" 987 "Shanghai Diesel" 999 "ALL" 2887 "Nonox" 9347 "SDFG" 9454 "Fuso" 9797 "Mitsubishi_Heavy_Industr" 9947 "SONSTIGE" /end COMPU_VTAB
/begin COMPU_METHOD SPDLIM_SY_Compu "" TAB_VERB "%6.3" "" COMPU_TAB_REF SPDLIM_SY_Compu /end COMPU_METHOD
/begin COMPU_VTAB SPDLIM_SY_Compu "" TAB_VERB 2 0 "False" 1 "True" /end COMPU_VTAB
/begin COMPU_METHOD SpecHeatFine "" RAT_FUNC "%6.3" "J/Kg/K" COEFFS 0 5 0 0 0 1 /end COMPU_METHOD
/begin COMPU_METHOD spg_q0p1 "" RAT_FUNC "%6.3" "V" COEFFS 0 1 0 0 0 0.1 /end COMPU_METHOD
/begin COMPU_METHOD Temp_Cels "" RAT_FUNC "%6.1" "deg C" COEFFS 0 10 2731.4 0 0 1 /end COMPU_METHOD
/begin COMPU_METHOD temp_q0p0234_o273 "" RAT_FUNC "%6.1" "Grad C" COEFFS 0 1 273.15 0 0 0.0234375 /end COMPU_METHOD
/begin COMPU_METHOD temp_ub_q0p75_o48 "" RAT_FUNC "%6.2" "Grad C" COEFFS 0 1 48 0 0 0.75 /end COMPU_METHOD
/begin COMPU_METHOD temp_ub_q1_o40 "" RAT_FUNC "%6.2" "Grad C" COEFFS 0 1 40 0 0 1 /end COMPU_METHOD
/begin COMPU_METHOD t_q0p0004_ms "" RAT_FUNC "%6.5" "ms" COEFFS 0 10000 0 0 0 4 /end COMPU_METHOD
/begin COMPU_METHOD t_q0p001_ms "" RAT_FUNC "%6.5" "ms" COEFFS 0 1 0 0 0 0.001 /end COMPU_METHOD
/begin COMPU_METHOD t_q0p02 "" RAT_FUNC "%6.4" "s" COEFFS 0 100 0 0 0 2 /end COMPU_METHOD
/begin COMPU_METHOD t_q0p04_ms "" RAT_FUNC "%6.4" "ms" COEFFS 0 1 0 0 0 0.04 /end COMPU_METHOD
/begin COMPU_METHOD t_q0p1 "" RAT_FUNC "%6.3" "s" COEFFS 0 10 0 0 0 1 /end COMPU_METHOD
/begin COMPU_METHOD t_q1 "" RAT_FUNC "%6.2" "s" COEFFS 0 1 0 0 0 1 /end COMPU_METHOD
/begin COMPU_METHOD t_q1p0_us "" RAT_FUNC "%6.2" "us" COEFFS 0 1 0 0 0 1 /end COMPU_METHOD
/begin COMPU_METHOD Vel "" RAT_FUNC "%6.4" "km/h" COEFFS 0 100 0 0 0 1 /end COMPU_METHOD
/begin COMPU_METHOD Volt "" RAT_FUNC "%6.3" "mV" COEFFS 0 5 0 0 0 1 /end COMPU_METHOD
/begin COMPU_METHOD vol_q0p00625_ml_DIV_s "" RAT_FUNC "%6.4" "ml/s" COEFFS 0 160 0 0 0 1 /end COMPU_METHOD
/begin COMPU_METHOD vol_q1Em5_ml "" RAT_FUNC "%8.7" "ml" COEFFS 0 100000 0 0 0 1 /end COMPU_METHOD
/begin RECORD_LAYOUT KwbWU8 FNC_VALUES 1 UBYTE COLUMN_DIR DIRECT /end RECORD_LAYOUT
/begin RECORD_LAYOUT KwSl FNC_VALUES 1 SLONG COLUMN_DIR DIRECT /end RECORD_LAYOUT
/begin RECORD_LAYOUT KwUb FNC_VALUES 1 UBYTE COLUMN_DIR DIRECT /end RECORD_LAYOUT
/begin RECORD_LAYOUT KwUl FNC_VALUES 1 ULONG COLUMN_DIR DIRECT /end RECORD_LAYOUT
/begin RECORD_LAYOUT KwUw FNC_VALUES 1 UWORD COLUMN_DIR DIRECT /end RECORD_LAYOUT
/begin RECORD_LAYOUT RB_Axis_S16 NO_AXIS_PTS_X 1 SWORD AXIS_PTS_X 2 SWORD INDEX_INCR DIRECT /end RECORD_LAYOUT
/begin RECORD_LAYOUT RB_Axis_U16 NO_AXIS_PTS_X 1 UWORD AXIS_PTS_X 2 UWORD INDEX_INCR DIRECT /end RECORD_LAYOUT
/begin RECORD_LAYOUT RB_Axis_U8 NO_AXIS_PTS_X 1 UBYTE AXIS_PTS_X 2 UBYTE INDEX_INCR DIRECT /end RECORD_LAYOUT
/begin RECORD_LAYOUT RB_CurveGroup_U8 FNC_VALUES 1 UBYTE COLUMN_DIR DIRECT /end RECORD_LAYOUT
/begin RECORD_LAYOUT RB_Curve_S16_S16 NO_AXIS_PTS_X 1 SWORD AXIS_PTS_X 2 SWORD INDEX_INCR DIRECT FNC_VALUES 3 SWORD COLUMN_DIR DIRECT /end RECORD_LAYOUT
/begin RECORD_LAYOUT RB_Curve_S16_S8_Static NO_AXIS_PTS_X 1 SWORD AXIS_PTS_X 2 SWORD INDEX_INCR DIRECT FNC_VALUES 3 SBYTE COLUMN_DIR DIRECT STATIC_RECORD_LAYOUT /end RECORD_LAYOUT
/begin RECORD_LAYOUT RB_Curve_S16_U16_Static NO_AXIS_PTS_X 1 SWORD AXIS_PTS_X 2 SWORD INDEX_INCR DIRECT FNC_VALUES 3 UWORD COLUMN_DIR DIRECT STATIC_RECORD_LAYOUT /end RECORD_LAYOUT
/begin RECORD_LAYOUT RB_Curve_S16_U8_Static NO_AXIS_PTS_X 1 SWORD AXIS_PTS_X 2 SWORD INDEX_INCR DIRECT FNC_VALUES 3 UBYTE COLUMN_DIR DIRECT STATIC_RECORD_LAYOUT /end RECORD_LAYOUT
/begin RECORD_LAYOUT RB_Curve_U16_S16_Static NO_AXIS_PTS_X 1 UWORD AXIS_PTS_X 2 UWORD INDEX_INCR DIRECT FNC_VALUES 3 SWORD COLUMN_DIR DIRECT STATIC_RECORD_LAYOUT /end RECORD_LAYOUT
/begin RECORD_LAYOUT RB_Curve_U16_U16 NO_AXIS_PTS_X 1 UWORD AXIS_PTS_X 2 UWORD INDEX_INCR DIRECT FNC_VALUES 3 UWORD COLUMN_DIR DIRECT /end RECORD_LAYOUT
/begin RECORD_LAYOUT RB_Curve_U8_S16_Static NO_AXIS_PTS_X 1 UBYTE AXIS_PTS_X 2 UBYTE INDEX_INCR DIRECT FNC_VALUES 3 SWORD COLUMN_DIR DIRECT STATIC_RECORD_LAYOUT /end RECORD_LAYOUT
/begin RECORD_LAYOUT RB_Curve_U8_U8 NO_AXIS_PTS_X 1 UBYTE AXIS_PTS_X 2 UBYTE INDEX_INCR DIRECT FNC_VALUES 3 UBYTE COLUMN_DIR DIRECT /end RECORD_LAYOUT
/begin RECORD_LAYOUT RB_MapGroup_S8 FNC_VALUES 1 SBYTE COLUMN_DIR DIRECT /end RECORD_LAYOUT
/begin RECORD_LAYOUT RB_MapGroup_U16 FNC_VALUES 1 UWORD COLUMN_DIR DIRECT /end RECORD_LAYOUT
/begin RECORD_LAYOUT RB_MapGroup_U8 FNC_VALUES 1 UBYTE COLUMN_DIR DIRECT /end RECORD_LAYOUT
/begin RECORD_LAYOUT RB_Map_S16S16_S16 NO_AXIS_PTS_X 1 SWORD NO_AXIS_PTS_Y 2 SWORD AXIS_PTS_X 3 SWORD INDEX_INCR DIRECT AXIS_PTS_Y 4 SWORD INDEX_INCR DIRECT FNC_VALUES 5 SWORD COLUMN_DIR DIRECT /end RECORD_LAYOUT
/begin RECORD_LAYOUT RB_Map_S16S16_U16 NO_AXIS_PTS_X 1 SWORD NO_AXIS_PTS_Y 2 SWORD AXIS_PTS_X 3 SWORD INDEX_INCR DIRECT AXIS_PTS_Y 4 SWORD INDEX_INCR DIRECT FNC_VALUES 5 UWORD COLUMN_DIR DIRECT /end RECORD_LAYOUT
/begin RECORD_LAYOUT RB_Map_S16S16_U8 NO_AXIS_PTS_X 1 SWORD NO_AXIS_PTS_Y 2 SWORD AXIS_PTS_X 3 SWORD INDEX_INCR DIRECT AXIS_PTS_Y 4 SWORD INDEX_INCR DIRECT FNC_VALUES 5 UBYTE COLUMN_DIR DIRECT /end RECORD_LAYOUT
/begin RECORD_LAYOUT RB_Map_S16U16_U16 NO_AXIS_PTS_X 1 SWORD NO_AXIS_PTS_Y 2 SWORD AXIS_PTS_X 3 SWORD INDEX_INCR DIRECT AXIS_PTS_Y 4 UWORD INDEX_INCR DIRECT FNC_VALUES 5 UWORD ROW_DIR DIRECT /end RECORD_LAYOUT
/begin RECORD_LAYOUT RB_Map_U8S16_S8 NO_AXIS_PTS_X 1 UBYTE NO_AXIS_PTS_Y 2 UBYTE AXIS_PTS_X 3 UBYTE INDEX_INCR DIRECT AXIS_PTS_Y 4 SWORD INDEX_INCR DIRECT FNC_VALUES 5 SBYTE ROW_DIR DIRECT /end RECORD_LAYOUT
/begin RECORD_LAYOUT RB_Map_U8U8_S8 NO_AXIS_PTS_X 1 UBYTE NO_AXIS_PTS_Y 2 UBYTE AXIS_PTS_X 3 UBYTE INDEX_INCR DIRECT AXIS_PTS_Y 4 UBYTE INDEX_INCR DIRECT FNC_VALUES 5 SBYTE COLUMN_DIR DIRECT /end RECORD_LAYOUT
/begin RECORD_LAYOUT RB_ValA_Wu16 FNC_VALUES 1 UWORD COLUMN_DIR DIRECT /end RECORD_LAYOUT
/begin RECORD_LAYOUT RB_ValA_Wu32 FNC_VALUES 1 ULONG COLUMN_DIR DIRECT /end RECORD_LAYOUT
/begin RECORD_LAYOUT RB_Val_Ws16 FNC_VALUES 1 SWORD COLUMN_DIR DIRECT /end RECORD_LAYOUT
/begin RECORD_LAYOUT RB_Val_Wu16 FNC_VALUES 1 UWORD COLUMN_DIR DIRECT /end RECORD_LAYOUT
/begin RECORD_LAYOUT RB_Val_Wu8 FNC_VALUES 1 UBYTE COLUMN_DIR DIRECT /end RECORD_LAYOUT
/begin RECORD_LAYOUT ValA_Wu8 FNC_VALUES 1 UBYTE COLUMN_DIR DIRECT /end RECORD_LAYOUT
/begin RECORD_LAYOUT Val_Wu16 FNC_VALUES 1 UWORD COLUMN_DIR DIRECT /end RECORD_LAYOUT
/begin RECORD_LAYOUT Val_Wu8 FNC_VALUES 1 UBYTE COLUMN_DIR DIRECT /end RECORD_LAYOUT
/end MODULE
/end PROJECT
