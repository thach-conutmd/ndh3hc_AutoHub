ASAP2_VERSION 1 60
/begin PROJECT MG1CS022 "MG1CS022"
/begin HEADER "" VERSION "MG1CS022_62XSC_V037" PROJECT_NO MG1CS022 /end HEADER
/begin MODULE DIM ""
/begin MOD_COMMON "" BYTE_ORDER MSB_LAST ALIGNMENT_BYTE 1 ALIGNMENT_WORD 2 ALIGNMENT_LONG 4 ALIGNMENT_INT64 4 ALIGNMENT_FLOAT32_IEEE 4 ALIGNMENT_FLOAT64_IEEE 4 DATA_SIZE 32 /end MOD_COMMON
/begin MEASUREMENT DINH_nrActvInhReas.FId_APPLETVldnErr "Number of active inhibit reasons for the FIds / Number of active inhibit reasons for FId_APPLETVldnErr" UWORD DINH_ct_Compu 1 100 -4095.000 4096.000 BIT_MASK 0x1fff FORMAT "%8.3" ECU_ADDRESS 0x6001402A /end MEASUREMENT
/begin MEASUREMENT DINH_nrActvInhReas.FId_APPLrn "Number of active inhibit reasons for the FIds / Number of active inhibit reasons for FId_APPLrn" UWORD DINH_ct_Compu 1 100 -4095.000 4096.000 BIT_MASK 0x1fff FORMAT "%8.3" ECU_ADDRESS 0x6001402C /end MEASUREMENT
/begin MEASUREMENT DINH_nrActvInhReas.FId_APPVehVErr "Number of active inhibit reasons for the FIds / Number of active inhibit reasons for FId_APPVehVErr" UWORD DINH_ct_Compu 1 100 -4095.000 4096.000 BIT_MASK 0x1fff FORMAT "%8.3" ECU_ADDRESS 0x6001402E /end MEASUREMENT
/begin MEASUREMENT DINH_nrActvInhReas.FId_AccPedDrvModComErr "Number of active inhibit reasons for the FIds / Number of active inhibit reasons for FId_AccPedDrvModComErr" UWORD DINH_ct_Compu 1 100 -4095.000 4096.000 BIT_MASK 0x1fff FORMAT "%8.3" ECU_ADDRESS 0x60014030 /end MEASUREMENT
/begin MEASUREMENT DINH_nrActvInhReas.FId_AccPedDrvModFailr "Number of active inhibit reasons for the FIds / Number of active inhibit reasons for FId_AccPedDrvModFailr" UWORD DINH_ct_Compu 1 100 -4095.000 4096.000 BIT_MASK 0x1fff FORMAT "%8.3" ECU_ADDRESS 0x60014032 /end MEASUREMENT
/begin MEASUREMENT DINH_nrActvInhReas.FId_AccPedNMaxLim "Number of active inhibit reasons for the FIds / Number of active inhibit reasons for FId_AccPedNMaxLim" UWORD DINH_ct_Compu 1 100 -4095.000 4096.000 BIT_MASK 0x1fff FORMAT "%8.3" ECU_ADDRESS 0x60014034 /end MEASUREMENT
/begin MEASUREMENT DINH_nrActvInhReas.FId_AccPedNMinLim "Number of active inhibit reasons for the FIds / Number of active inhibit reasons for FId_AccPedNMinLim" UWORD DINH_ct_Compu 1 100 -4095.000 4096.000 BIT_MASK 0x1fff FORMAT "%8.3" ECU_ADDRESS 0x60014036 /end MEASUREMENT
/begin MEASUREMENT DINH_nrActvInhReas.FId_AccPedNMinLimBrkApp "Number of active inhibit reasons for the FIds / Number of active inhibit reasons for FId_AccPedNMinLimBrkApp" UWORD DINH_ct_Compu 1 100 -4095.000 4096.000 BIT_MASK 0x1fff FORMAT "%8.3" ECU_ADDRESS 0x60014038 /end MEASUREMENT
/begin MEASUREMENT DINH_nrActvInhReas.FId_AccPedTrqLim "Number of active inhibit reasons for the FIds / Number of active inhibit reasons for FId_AccPedTrqLim" UWORD DINH_ct_Compu 1 100 -4095.000 4096.000 BIT_MASK 0x1fff FORMAT "%8.3" ECU_ADDRESS 0x6001403A /end MEASUREMENT
/begin MEASUREMENT DINH_nrActvInhReas.FId_AfsDdDiag "Number of active inhibit reasons for the FIds / Number of active inhibit reasons for FId_AfsDdDiag" UWORD DINH_ct_Compu 1 100 -4095.000 4096.000 BIT_MASK 0x1fff FORMAT "%8.3" ECU_ADDRESS 0x6001403C /end MEASUREMENT
/begin MEASUREMENT DINH_nrActvInhReas.FId_AfsDiagErr "Number of active inhibit reasons for the FIds / Number of active inhibit reasons for FId_AfsDiagErr" UWORD DINH_ct_Compu 1 100 -4095.000 4096.000 BIT_MASK 0x1fff FORMAT "%8.3" ECU_ADDRESS 0x6001403E /end MEASUREMENT
/begin MEASUREMENT DINH_nrActvInhReas.FId_AfsDiagTst "Number of active inhibit reasons for the FIds / Number of active inhibit reasons for FId_AfsDiagTst" UWORD DINH_ct_Compu 1 100 -4095.000 4096.000 BIT_MASK 0x1fff FORMAT "%8.3" ECU_ADDRESS 0x60014040 /end MEASUREMENT
/begin MEASUREMENT DINH_nrActvInhReas.FId_AfsPlausDiag "Number of active inhibit reasons for the FIds / Number of active inhibit reasons for FId_AfsPlausDiag" UWORD DINH_ct_Compu 1 100 -4095.000 4096.000 BIT_MASK 0x1fff FORMAT "%8.3" ECU_ADDRESS 0x60014042 /end MEASUREMENT
/begin MEASUREMENT DINH_nrActvInhReas.FId_AfsVrntDiag "Number of active inhibit reasons for the FIds / Number of active inhibit reasons for FId_AfsVrntDiag" UWORD DINH_ct_Compu 1 100 -4095.000 4096.000 BIT_MASK 0x1fff FORMAT "%8.3" ECU_ADDRESS 0x60014044 /end MEASUREMENT
/begin MEASUREMENT DINH_nrActvInhReas.FId_AirCClntPFrzVal "Number of active inhibit reasons for the FIds / Number of active inhibit reasons for FId_AirCClntPFrzVal" UWORD DINH_ct_Compu 1 100 -4095.000 4096.000 BIT_MASK 0x1fff FORMAT "%8.3" ECU_ADDRESS 0x60014046 /end MEASUREMENT
/begin MEASUREMENT DINH_nrActvInhReas.FId_AirCClntPRplVal "Number of active inhibit reasons for the FIds / Number of active inhibit reasons for FId_AirCClntPRplVal" UWORD DINH_ct_Compu 1 100 -4095.000 4096.000 BIT_MASK 0x1fff FORMAT "%8.3" ECU_ADDRESS 0x60014048 /end MEASUREMENT
/begin MEASUREMENT DINH_nrActvInhReas.FId_AirCSwt "Number of active inhibit reasons for the FIds / Number of active inhibit reasons for FId_AirCSwt" UWORD DINH_ct_Compu 1 100 -4095.000 4096.000 BIT_MASK 0x1fff FORMAT "%8.3" ECU_ADDRESS 0x6001404A /end MEASUREMENT
/begin MEASUREMENT DINH_nrActvInhReas.FId_AirDvPAdpnPEnv "Number of active inhibit reasons for the FIds / Number of active inhibit reasons for FId_AirDvPAdpnPEnv" UWORD DINH_ct_Compu 1 100 -4095.000 4096.000 BIT_MASK 0x1fff FORMAT "%8.3" ECU_ADDRESS 0x6001404C /end MEASUREMENT
/begin MEASUREMENT DINH_nrActvInhReas.FId_AirDvPAdpnPIntkVUsB1 "Number of active inhibit reasons for the FIds / Number of active inhibit reasons for FId_AirDvPAdpnPIntkVUsB1" UWORD DINH_ct_Compu 1 100 -4095.000 4096.000 BIT_MASK 0x1fff FORMAT "%8.3" ECU_ADDRESS 0x6001404E /end MEASUREMENT
/begin MEASUREMENT DINH_nrActvInhReas.FId_AirDvPPSnsrAdpn_PModeActv "Number of active inhibit reasons for the FIds / Number of active inhibit reasons for FId_AirDvPPSnsrAdpn_PModeActv" UWORD DINH_ct_Compu 1 100 -4095.000 4096.000 BIT_MASK 0x1fff FORMAT "%8.3" ECU_ADDRESS 0x60014050 /end MEASUREMENT
/begin MEASUREMENT DINH_nrActvInhReas.FId_AltACGFailr "Number of active inhibit reasons for the FIds / Number of active inhibit reasons for FId_AltACGFailr" UWORD DINH_ct_Compu 1 100 -4095.000 4096.000 BIT_MASK 0x1fff FORMAT "%8.3" ECU_ADDRESS 0x60014052 /end MEASUREMENT
/begin MEASUREMENT DINH_nrActvInhReas.FId_AltAPPErrSt "Number of active inhibit reasons for the FIds / Number of active inhibit reasons for FId_AltAPPErrSt" UWORD DINH_ct_Compu 1 100 -4095.000 4096.000 BIT_MASK 0x1fff FORMAT "%8.3" ECU_ADDRESS 0x60014054 /end MEASUREMENT
/begin MEASUREMENT DINH_nrActvInhReas.FId_AltBattMngtFailr "Number of active inhibit reasons for the FIds / Number of active inhibit reasons for FId_AltBattMngtFailr" UWORD DINH_ct_Compu 1 100 -4095.000 4096.000 BIT_MASK 0x1fff FORMAT "%8.3" ECU_ADDRESS 0x60014056 /end MEASUREMENT
/begin MEASUREMENT DINH_nrActvInhReas.FId_AltBrkErrSt "Number of active inhibit reasons for the FIds / Number of active inhibit reasons for FId_AltBrkErrSt" UWORD DINH_ct_Compu 1 100 -4095.000 4096.000 BIT_MASK 0x1fff FORMAT "%8.3" ECU_ADDRESS 0x60014058 /end MEASUREMENT
/begin MEASUREMENT DINH_nrActvInhReas.FId_AltComErr "Number of active inhibit reasons for the FIds / Number of active inhibit reasons for FId_AltComErr" UWORD DINH_ct_Compu 1 100 -4095.000 4096.000 BIT_MASK 0x1fff FORMAT "%8.3" ECU_ADDRESS 0x6001405A /end MEASUREMENT
/begin MEASUREMENT DINH_nrActvInhReas.FId_AltENGB "Number of active inhibit reasons for the FIds / Number of active inhibit reasons for FId_AltENGB" UWORD DINH_ct_Compu 1 100 -4095.000 4096.000 BIT_MASK 0x1fff FORMAT "%8.3" ECU_ADDRESS 0x6001405C /end MEASUREMENT
/begin MEASUREMENT DINH_nrActvInhReas.FId_AltElecLoadErr "Number of active inhibit reasons for the FIds / Number of active inhibit reasons for FId_AltElecLoadErr" UWORD DINH_ct_Compu 1 100 -4095.000 4096.000 BIT_MASK 0x1fff FORMAT "%8.3" ECU_ADDRESS 0x6001405E /end MEASUREMENT
/begin MEASUREMENT DINH_nrActvInhReas.FId_AltEnvTErr "Number of active inhibit reasons for the FIds / Number of active inhibit reasons for FId_AltEnvTErr" UWORD DINH_ct_Compu 1 100 -4095.000 4096.000 BIT_MASK 0x1fff FORMAT "%8.3" ECU_ADDRESS 0x60014060 /end MEASUREMENT
/begin MEASUREMENT DINH_nrActvInhReas.FId_AltFFAltLoadFast "Number of active inhibit reasons for the FIds / Number of active inhibit reasons for FId_AltFFAltLoadFast" UWORD DINH_ct_Compu 1 100 -4095.000 4096.000 BIT_MASK 0x1fff FORMAT "%8.3" ECU_ADDRESS 0x60014062 /end MEASUREMENT
/begin MEASUREMENT DINH_nrActvInhReas.FId_AltFFAltLoadSlow "Number of active inhibit reasons for the FIds / Number of active inhibit reasons for FId_AltFFAltLoadSlow" UWORD DINH_ct_Compu 1 100 -4095.000 4096.000 BIT_MASK 0x1fff FORMAT "%8.3" ECU_ADDRESS 0x60014064 /end MEASUREMENT
/begin MEASUREMENT DINH_nrActvInhReas.FId_AltIOACGErr "Number of active inhibit reasons for the FIds / Number of active inhibit reasons for FId_AltIOACGErr" UWORD DINH_ct_Compu 1 100 -4095.000 4096.000 BIT_MASK 0x1fff FORMAT "%8.3" ECU_ADDRESS 0x60014066 /end MEASUREMENT
/begin MEASUREMENT DINH_nrActvInhReas.FId_AltIOACGLinComFailr "Number of active inhibit reasons for the FIds / Number of active inhibit reasons for FId_AltIOACGLinComFailr" UWORD DINH_ct_Compu 1 100 -4095.000 4096.000 BIT_MASK 0x1fff FORMAT "%8.3" ECU_ADDRESS 0x60014068 /end MEASUREMENT
/begin MEASUREMENT DINH_nrActvInhReas.FId_AltIOComErr "Number of active inhibit reasons for the FIds / Number of active inhibit reasons for FId_AltIOComErr" UWORD DINH_ct_Compu 1 100 -4095.000 4096.000 BIT_MASK 0x1fff FORMAT "%8.3" ECU_ADDRESS 0x6001406A /end MEASUREMENT
/begin MEASUREMENT DINH_nrActvInhReas.FId_AltLinErr "Number of active inhibit reasons for the FIds / Number of active inhibit reasons for FId_AltLinErr" UWORD DINH_ct_Compu 1 100 -4095.000 4096.000 BIT_MASK 0x1fff FORMAT "%8.3" ECU_ADDRESS 0x6001406C /end MEASUREMENT
/begin MEASUREMENT DINH_nrActvInhReas.FId_AltPwr "Number of active inhibit reasons for the FIds / Number of active inhibit reasons for FId_AltPwr" UWORD DINH_ct_Compu 1 100 -4095.000 4096.000 BIT_MASK 0x1fff FORMAT "%8.3" ECU_ADDRESS 0x6001406E /end MEASUREMENT
/begin MEASUREMENT DINH_nrActvInhReas.FId_AltVehVErrSt "Number of active inhibit reasons for the FIds / Number of active inhibit reasons for FId_AltVehVErrSt" UWORD DINH_ct_Compu 1 100 -4095.000 4096.000 BIT_MASK 0x1fff FORMAT "%8.3" ECU_ADDRESS 0x60014070 /end MEASUREMENT
/begin MEASUREMENT DINH_nrActvInhReas.FId_AltvCluFail "Number of active inhibit reasons for the FIds / Number of active inhibit reasons for FId_AltvCluFail" UWORD DINH_ct_Compu 1 100 -4095.000 4096.000 BIT_MASK 0x1fff FORMAT "%8.3" ECU_ADDRESS 0x60014072 /end MEASUREMENT
/begin MEASUREMENT DINH_nrActvInhReas.FId_BGAGRTS "Number of active inhibit reasons for the FIds / Number of active inhibit reasons for FId_BGAGRTS" UWORD DINH_ct_Compu 1 100 -4095.000 4096.000 BIT_MASK 0x1fff FORMAT "%8.3" ECU_ADDRESS 0x60014074 /end MEASUREMENT
/begin MEASUREMENT DINH_nrActvInhReas.FId_BGFKMSEPSR "Number of active inhibit reasons for the FIds / Number of active inhibit reasons for FId_BGFKMSEPSR" UWORD DINH_ct_Compu 1 100 -4095.000 4096.000 BIT_MASK 0x1fff FORMAT "%8.3" ECU_ADDRESS 0x60014076 /end MEASUREMENT
/begin MEASUREMENT DINH_nrActvInhReas.FId_BGFKMSEPU "Number of active inhibit reasons for the FIds / Number of active inhibit reasons for FId_BGFKMSEPU" UWORD DINH_ct_Compu 1 100 -4095.000 4096.000 BIT_MASK 0x1fff FORMAT "%8.3" ECU_ADDRESS 0x60014078 /end MEASUREMENT
/begin MEASUREMENT DINH_nrActvInhReas.FId_BGFKMSESumClr "Number of active inhibit reasons for the FIds / Number of active inhibit reasons for FId_BGFKMSESumClr" UWORD DINH_ct_Compu 1 100 -4095.000 4096.000 BIT_MASK 0x1fff FORMAT "%8.3" ECU_ADDRESS 0x6001407A /end MEASUREMENT
/begin MEASUREMENT DINH_nrActvInhReas.FId_BGFKMSHFME "Number of active inhibit reasons for the FIds / Number of active inhibit reasons for FId_BGFKMSHFME" UWORD DINH_ct_Compu 1 100 -4095.000 4096.000 BIT_MASK 0x1fff FORMAT "%8.3" ECU_ADDRESS 0x6001407C /end MEASUREMENT
/begin MEASUREMENT DINH_nrActvInhReas.FId_BGFKMSHFMZ "Number of active inhibit reasons for the FIds / Number of active inhibit reasons for FId_BGFKMSHFMZ" UWORD DINH_ct_Compu 1 100 -4095.000 4096.000 BIT_MASK 0x1fff FORMAT "%8.3" ECU_ADDRESS 0x6001407E /end MEASUREMENT
/begin MEASUREMENT DINH_nrActvInhReas.FId_BGFKMSZPSR "Number of active inhibit reasons for the FIds / Number of active inhibit reasons for FId_BGFKMSZPSR" UWORD DINH_ct_Compu 1 100 -4095.000 4096.000 BIT_MASK 0x1fff FORMAT "%8.3" ECU_ADDRESS 0x60014080 /end MEASUREMENT
/begin MEASUREMENT DINH_nrActvInhReas.FId_BGOSCCat1B1 "Number of active inhibit reasons for the FIds / Number of active inhibit reasons for FId_BGOSCCat1B1" UWORD DINH_ct_Compu 1 100 -4095.000 4096.000 BIT_MASK 0x1fff FORMAT "%8.3" ECU_ADDRESS 0x60014082 /end MEASUREMENT
/begin MEASUREMENT DINH_nrActvInhReas.FId_BGOSCCat2B1 "Number of active inhibit reasons for the FIds / Number of active inhibit reasons for FId_BGOSCCat2B1" UWORD DINH_ct_Compu 1 100 -4095.000 4096.000 BIT_MASK 0x1fff FORMAT "%8.3" ECU_ADDRESS 0x60014084 /end MEASUREMENT
/begin MEASUREMENT DINH_nrActvInhReas.FId_BattAltFailr "Number of active inhibit reasons for the FIds / Number of active inhibit reasons for FId_BattAltFailr" UWORD DINH_ct_Compu 1 100 -4095.000 4096.000 BIT_MASK 0x1fff FORMAT "%8.3" ECU_ADDRESS 0x60014086 /end MEASUREMENT
/begin MEASUREMENT DINH_nrActvInhReas.FId_BattMngtFailr "Number of active inhibit reasons for the FIds / Number of active inhibit reasons for FId_BattMngtFailr" UWORD DINH_ct_Compu 1 100 -4095.000 4096.000 BIT_MASK 0x1fff FORMAT "%8.3" ECU_ADDRESS 0x60014088 /end MEASUREMENT
/begin MEASUREMENT DINH_nrActvInhReas.FId_BattSigPtd "Number of active inhibit reasons for the FIds / Number of active inhibit reasons for FId_BattSigPtd" UWORD DINH_ct_Compu 1 100 -4095.000 4096.000 BIT_MASK 0x1fff FORMAT "%8.3" ECU_ADDRESS 0x6001408A /end MEASUREMENT
/begin MEASUREMENT DINH_nrActvInhReas.FId_BattU2MEDSRC "Number of active inhibit reasons for the FIds / Number of active inhibit reasons for FId_BattU2MEDSRC" UWORD DINH_ct_Compu 1 100 -4095.000 4096.000 BIT_MASK 0x1fff FORMAT "%8.3" ECU_ADDRESS 0x6001408C /end MEASUREMENT
/begin MEASUREMENT DINH_nrActvInhReas.FId_BattUDrpPrvOff "Number of active inhibit reasons for the FIds / Number of active inhibit reasons for FId_BattUDrpPrvOff" UWORD DINH_ct_Compu 1 100 -4095.000 4096.000 BIT_MASK 0x1fff FORMAT "%8.3" ECU_ADDRESS 0x6001408E /end MEASUREMENT
/begin MEASUREMENT DINH_nrActvInhReas.FId_BattUFrzVal "Number of active inhibit reasons for the FIds / Number of active inhibit reasons for FId_BattUFrzVal" UWORD DINH_ct_Compu 1 100 -4095.000 4096.000 BIT_MASK 0x1fff FORMAT "%8.3" ECU_ADDRESS 0x60014090 /end MEASUREMENT
/begin MEASUREMENT DINH_nrActvInhReas.FId_BattUHiFailrEna "Number of active inhibit reasons for the FIds / Number of active inhibit reasons for FId_BattUHiFailrEna" UWORD DINH_ct_Compu 1 100 -4095.000 4096.000 BIT_MASK 0x1fff FORMAT "%8.3" ECU_ADDRESS 0x60014092 /end MEASUREMENT
/begin MEASUREMENT DINH_nrActvInhReas.FId_BattUIMGTCUCANFailr "Number of active inhibit reasons for the FIds / Number of active inhibit reasons for FId_BattUIMGTCUCANFailr" UWORD DINH_ct_Compu 1 100 -4095.000 4096.000 BIT_MASK 0x1fff FORMAT "%8.3" ECU_ADDRESS 0x60014094 /end MEASUREMENT
/begin MEASUREMENT DINH_nrActvInhReas.FId_BattULoFailrEna "Number of active inhibit reasons for the FIds / Number of active inhibit reasons for FId_BattULoFailrEna" UWORD DINH_ct_Compu 1 100 -4095.000 4096.000 BIT_MASK 0x1fff FORMAT "%8.3" ECU_ADDRESS 0x60014096 /end MEASUREMENT
/begin MEASUREMENT DINH_nrActvInhReas.FId_BattUReplVal "Number of active inhibit reasons for the FIds / Number of active inhibit reasons for FId_BattUReplVal" UWORD DINH_ct_Compu 1 100 -4095.000 4096.000 BIT_MASK 0x1fff FORMAT "%8.3" ECU_ADDRESS 0x60014098 /end MEASUREMENT
/begin MEASUREMENT DINH_nrActvInhReas.FId_BattUSRC "Number of active inhibit reasons for the FIds / Number of active inhibit reasons for FId_BattUSRC" UWORD DINH_ct_Compu 1 100 -4095.000 4096.000 BIT_MASK 0x1fff FORMAT "%8.3" ECU_ADDRESS 0x6001409A /end MEASUREMENT
/begin MEASUREMENT DINH_nrActvInhReas.FId_BlwrComErr "Number of active inhibit reasons for the FIds / Number of active inhibit reasons for FId_BlwrComErr" UWORD DINH_ct_Compu 1 100 -4095.000 4096.000 BIT_MASK 0x1fff FORMAT "%8.3" ECU_ADDRESS 0x6001409C /end MEASUREMENT
/begin MEASUREMENT DINH_nrActvInhReas.FId_BrkBstMdl "Number of active inhibit reasons for the FIds / Number of active inhibit reasons for FId_BrkBstMdl" UWORD DINH_ct_Compu 1 100 -4095.000 4096.000 BIT_MASK 0x1fff FORMAT "%8.3" ECU_ADDRESS 0x6001409E /end MEASUREMENT
/begin MEASUREMENT DINH_nrActvInhReas.FId_BrkBstMdlBrkP "Number of active inhibit reasons for the FIds / Number of active inhibit reasons for FId_BrkBstMdlBrkP" UWORD DINH_ct_Compu 1 100 -4095.000 4096.000 BIT_MASK 0x1fff FORMAT "%8.3" ECU_ADDRESS 0x600140A0 /end MEASUREMENT
/begin MEASUREMENT DINH_nrActvInhReas.FId_BrkBstMdlBrkSt "Number of active inhibit reasons for the FIds / Number of active inhibit reasons for FId_BrkBstMdlBrkSt" UWORD DINH_ct_Compu 1 100 -4095.000 4096.000 BIT_MASK 0x1fff FORMAT "%8.3" ECU_ADDRESS 0x600140A2 /end MEASUREMENT
/begin MEASUREMENT DINH_nrActvInhReas.FId_BrkBstMdlEnvP "Number of active inhibit reasons for the FIds / Number of active inhibit reasons for FId_BrkBstMdlEnvP" UWORD DINH_ct_Compu 1 100 -4095.000 4096.000 BIT_MASK 0x1fff FORMAT "%8.3" ECU_ADDRESS 0x600140A4 /end MEASUREMENT
/begin MEASUREMENT DINH_nrActvInhReas.FId_BrkBstPDetnInhbn "Number of active inhibit reasons for the FIds / Number of active inhibit reasons for FId_BrkBstPDetnInhbn" UWORD DINH_ct_Compu 1 100 -4095.000 4096.000 BIT_MASK 0x1fff FORMAT "%8.3" ECU_ADDRESS 0x600140A6 /end MEASUREMENT
/begin MEASUREMENT DINH_nrActvInhReas.FId_BrkBstPMstCylPSnsrFail "Number of active inhibit reasons for the FIds / Number of active inhibit reasons for FId_BrkBstPMstCylPSnsrFail" UWORD DINH_ct_Compu 1 100 -4095.000 4096.000 BIT_MASK 0x1fff FORMAT "%8.3" ECU_ADDRESS 0x600140A8 /end MEASUREMENT
/begin MEASUREMENT DINH_nrActvInhReas.FId_BrkBstPSnsrStuckDetn "Number of active inhibit reasons for the FIds / Number of active inhibit reasons for FId_BrkBstPSnsrStuckDetn" UWORD DINH_ct_Compu 1 100 -4095.000 4096.000 BIT_MASK 0x1fff FORMAT "%8.3" ECU_ADDRESS 0x600140AA /end MEASUREMENT
/begin MEASUREMENT DINH_nrActvInhReas.FId_BrkBstSigPath "Number of active inhibit reasons for the FIds / Number of active inhibit reasons for FId_BrkBstSigPath" UWORD DINH_ct_Compu 1 100 -4095.000 4096.000 BIT_MASK 0x1fff FORMAT "%8.3" ECU_ADDRESS 0x600140AC /end MEASUREMENT
/begin MEASUREMENT DINH_nrActvInhReas.FId_BrkBstVehVv "Number of active inhibit reasons for the FIds / Number of active inhibit reasons for FId_BrkBstVehVv" UWORD DINH_ct_Compu 1 100 -4095.000 4096.000 BIT_MASK 0x1fff FORMAT "%8.3" ECU_ADDRESS 0x600140AE /end MEASUREMENT
/begin MEASUREMENT DINH_nrActvInhReas.FId_BrkMnSwtErr "Number of active inhibit reasons for the FIds / Number of active inhibit reasons for FId_BrkMnSwtErr" UWORD DINH_ct_Compu 1 100 -4095.000 4096.000 BIT_MASK 0x1fff FORMAT "%8.3" ECU_ADDRESS 0x600140B0 /end MEASUREMENT
/begin MEASUREMENT DINH_nrActvInhReas.FId_BrkPFrzVal "Number of active inhibit reasons for the FIds / Number of active inhibit reasons for FId_BrkPFrzVal" UWORD DINH_ct_Compu 1 100 -4095.000 4096.000 BIT_MASK 0x1fff FORMAT "%8.3" ECU_ADDRESS 0x600140B2 /end MEASUREMENT
/begin MEASUREMENT DINH_nrActvInhReas.FId_BrkPOilPres "Number of active inhibit reasons for the FIds / Number of active inhibit reasons for FId_BrkPOilPres" UWORD DINH_ct_Compu 1 100 -4095.000 4096.000 BIT_MASK 0x1fff FORMAT "%8.3" ECU_ADDRESS 0x600140B4 /end MEASUREMENT
/begin MEASUREMENT DINH_nrActvInhReas.FId_BrkPReplVal "Number of active inhibit reasons for the FIds / Number of active inhibit reasons for FId_BrkPReplVal" UWORD DINH_ct_Compu 1 100 -4095.000 4096.000 BIT_MASK 0x1fff FORMAT "%8.3" ECU_ADDRESS 0x600140B6 /end MEASUREMENT
/begin MEASUREMENT DINH_nrActvInhReas.FId_BrkPedEngStopEna "Number of active inhibit reasons for the FIds / Number of active inhibit reasons for FId_BrkPedEngStopEna" UWORD DINH_ct_Compu 1 100 -4095.000 4096.000 BIT_MASK 0x1fff FORMAT "%8.3" ECU_ADDRESS 0x600140B8 /end MEASUREMENT
/begin MEASUREMENT DINH_nrActvInhReas.FId_BrkRdntSwtErr "Number of active inhibit reasons for the FIds / Number of active inhibit reasons for FId_BrkRdntSwtErr" UWORD DINH_ct_Compu 1 100 -4095.000 4096.000 BIT_MASK 0x1fff FORMAT "%8.3" ECU_ADDRESS 0x600140BA /end MEASUREMENT
/begin MEASUREMENT DINH_nrActvInhReas.FId_CAGRSDS "Number of active inhibit reasons for the FIds / Number of active inhibit reasons for FId_CAGRSDS" UWORD DINH_ct_Compu 1 100 -4095.000 4096.000 BIT_MASK 0x1fff FORMAT "%8.3" ECU_ADDRESS 0x600140BC /end MEASUREMENT
/begin MEASUREMENT DINH_nrActvInhReas.FId_CEngDsTColdStrt "Number of active inhibit reasons for the FIds / Number of active inhibit reasons for FId_CEngDsTColdStrt" UWORD DINH_ct_Compu 1 100 -4095.000 4096.000 BIT_MASK 0x1fff FORMAT "%8.3" ECU_ADDRESS 0x600140BE /end MEASUREMENT
/begin MEASUREMENT DINH_nrActvInhReas.FId_CEngDsTColdStrtErr "Number of active inhibit reasons for the FIds / Number of active inhibit reasons for FId_CEngDsTColdStrtErr" UWORD DINH_ct_Compu 1 100 -4095.000 4096.000 BIT_MASK 0x1fff FORMAT "%8.3" ECU_ADDRESS 0x600140C0 /end MEASUREMENT
/begin MEASUREMENT DINH_nrActvInhReas.FId_CEngDsTHSC "Number of active inhibit reasons for the FIds / Number of active inhibit reasons for FId_CEngDsTHSC" UWORD DINH_ct_Compu 1 100 -4095.000 4096.000 BIT_MASK 0x1fff FORMAT "%8.3" ECU_ADDRESS 0x600140C2 /end MEASUREMENT
/begin MEASUREMENT DINH_nrActvInhReas.FId_CEngDsTLSC "Number of active inhibit reasons for the FIds / Number of active inhibit reasons for FId_CEngDsTLSC" UWORD DINH_ct_Compu 1 100 -4095.000 4096.000 BIT_MASK 0x1fff FORMAT "%8.3" ECU_ADDRESS 0x600140C4 /end MEASUREMENT
/begin MEASUREMENT DINH_nrActvInhReas.FId_CEngDsTPlausErr "Number of active inhibit reasons for the FIds / Number of active inhibit reasons for FId_CEngDsTPlausErr" UWORD DINH_ct_Compu 1 100 -4095.000 4096.000 BIT_MASK 0x1fff FORMAT "%8.3" ECU_ADDRESS 0x600140C6 /end MEASUREMENT
/begin MEASUREMENT DINH_nrActvInhReas.FId_CEngDsTReplMdlEngStop "Number of active inhibit reasons for the FIds / Number of active inhibit reasons for FId_CEngDsTReplMdlEngStop" UWORD DINH_ct_Compu 1 100 -4095.000 4096.000 BIT_MASK 0x1fff FORMAT "%8.3" ECU_ADDRESS 0x600140C8 /end MEASUREMENT
/begin MEASUREMENT DINH_nrActvInhReas.FId_CEngDsTSTC "Number of active inhibit reasons for the FIds / Number of active inhibit reasons for FId_CEngDsTSTC" UWORD DINH_ct_Compu 1 100 -4095.000 4096.000 BIT_MASK 0x1fff FORMAT "%8.3" ECU_ADDRESS 0x600140CA /end MEASUREMENT
/begin MEASUREMENT DINH_nrActvInhReas.FId_CEngDsTSnsrElec "Number of active inhibit reasons for the FIds / Number of active inhibit reasons for FId_CEngDsTSnsrElec" UWORD DINH_ct_Compu 1 100 -4095.000 4096.000 BIT_MASK 0x1fff FORMAT "%8.3" ECU_ADDRESS 0x600140CC /end MEASUREMENT
/begin MEASUREMENT DINH_nrActvInhReas.FId_CEngDsTSwtReplMdl "Number of active inhibit reasons for the FIds / Number of active inhibit reasons for FId_CEngDsTSwtReplMdl" UWORD DINH_ct_Compu 1 100 -4095.000 4096.000 BIT_MASK 0x1fff FORMAT "%8.3" ECU_ADDRESS 0x600140CE /end MEASUREMENT
/begin MEASUREMENT DINH_nrActvInhReas.FId_CEngUsTColdChkErr "Number of active inhibit reasons for the FIds / Number of active inhibit reasons for FId_CEngUsTColdChkErr" UWORD DINH_ct_Compu 1 100 -4095.000 4096.000 BIT_MASK 0x1fff FORMAT "%8.3" ECU_ADDRESS 0x600140D0 /end MEASUREMENT
/begin MEASUREMENT DINH_nrActvInhReas.FId_CEngUsTCrssChk "Number of active inhibit reasons for the FIds / Number of active inhibit reasons for FId_CEngUsTCrssChk" UWORD DINH_ct_Compu 1 100 -4095.000 4096.000 BIT_MASK 0x1fff FORMAT "%8.3" ECU_ADDRESS 0x600140D2 /end MEASUREMENT
/begin MEASUREMENT DINH_nrActvInhReas.FId_CEngUsTElecErr "Number of active inhibit reasons for the FIds / Number of active inhibit reasons for FId_CEngUsTElecErr" UWORD DINH_ct_Compu 1 100 -4095.000 4096.000 BIT_MASK 0x1fff FORMAT "%8.3" ECU_ADDRESS 0x600140D4 /end MEASUREMENT
/begin MEASUREMENT DINH_nrActvInhReas.FId_CEngUsTSnsrElecErr "Number of active inhibit reasons for the FIds / Number of active inhibit reasons for FId_CEngUsTSnsrElecErr" UWORD DINH_ct_Compu 1 100 -4095.000 4096.000 BIT_MASK 0x1fff FORMAT "%8.3" ECU_ADDRESS 0x600140D6 /end MEASUREMENT
/begin MEASUREMENT DINH_nrActvInhReas.FId_CEngUsTSwtReplMdl "Number of active inhibit reasons for the FIds / Number of active inhibit reasons for FId_CEngUsTSwtReplMdl" UWORD DINH_ct_Compu 1 100 -4095.000 4096.000 BIT_MASK 0x1fff FORMAT "%8.3" ECU_ADDRESS 0x600140D8 /end MEASUREMENT
/begin MEASUREMENT DINH_nrActvInhReas.FId_CInjCatHeatgDiag "Number of active inhibit reasons for the FIds / Number of active inhibit reasons for FId_CInjCatHeatgDiag" UWORD DINH_ct_Compu 1 100 -4095.000 4096.000 BIT_MASK 0x1fff FORMAT "%8.3" ECU_ADDRESS 0x600140DA /end MEASUREMENT
/begin MEASUREMENT DINH_nrActvInhReas.FId_CMSUDKSOM1 "Number of active inhibit reasons for the FIds / Number of active inhibit reasons for FId_CMSUDKSOM1" UWORD DINH_ct_Compu 1 100 -4095.000 4096.000 BIT_MASK 0x1fff FORMAT "%8.3" ECU_ADDRESS 0x600140DC /end MEASUREMENT
/begin MEASUREMENT DINH_nrActvInhReas.FId_CMSUDKSOM2 "Number of active inhibit reasons for the FIds / Number of active inhibit reasons for FId_CMSUDKSOM2" UWORD DINH_ct_Compu 1 100 -4095.000 4096.000 BIT_MASK 0x1fff FORMAT "%8.3" ECU_ADDRESS 0x600140DE /end MEASUREMENT
/begin MEASUREMENT DINH_nrActvInhReas.FId_CatHeatgEomShtrpAct "Number of active inhibit reasons for the FIds / Number of active inhibit reasons for FId_CatHeatgEomShtrpAct" UWORD DINH_ct_Compu 1 100 -4095.000 4096.000 BIT_MASK 0x1fff FORMAT "%8.3" ECU_ADDRESS 0x600140E0 /end MEASUREMENT
/begin MEASUREMENT DINH_nrActvInhReas.FId_ChrctlAgrsErr "Number of active inhibit reasons for the FIds / Number of active inhibit reasons for FId_ChrctlAgrsErr" UWORD DINH_ct_Compu 1 100 -4095.000 4096.000 BIT_MASK 0x1fff FORMAT "%8.3" ECU_ADDRESS 0x600140E2 /end MEASUREMENT
/begin MEASUREMENT DINH_nrActvInhReas.FId_ChrctlAgrscf "Number of active inhibit reasons for the FIds / Number of active inhibit reasons for FId_ChrctlAgrscf" UWORD DINH_ct_Compu 1 100 -4095.000 4096.000 BIT_MASK 0x1fff FORMAT "%8.3" ECU_ADDRESS 0x600140E4 /end MEASUREMENT
/begin MEASUREMENT DINH_nrActvInhReas.FId_ClntTempENGB "Number of active inhibit reasons for the FIds / Number of active inhibit reasons for FId_ClntTempENGB" UWORD DINH_ct_Compu 1 100 -4095.000 4096.000 BIT_MASK 0x1fff FORMAT "%8.3" ECU_ADDRESS 0x600140E6 /end MEASUREMENT
/begin MEASUREMENT DINH_nrActvInhReas.FId_Clth "Number of active inhibit reasons for the FIds / Number of active inhibit reasons for FId_Clth" UWORD DINH_ct_Compu 1 100 -4095.000 4096.000 BIT_MASK 0x1fff FORMAT "%8.3" ECU_ADDRESS 0x600140E8 /end MEASUREMENT
/begin MEASUREMENT DINH_nrActvInhReas.FId_Clth2 "Number of active inhibit reasons for the FIds / Number of active inhibit reasons for FId_Clth2" UWORD DINH_ct_Compu 1 100 -4095.000 4096.000 BIT_MASK 0x1fff FORMAT "%8.3" ECU_ADDRESS 0x600140EA /end MEASUREMENT
/begin MEASUREMENT DINH_nrActvInhReas.FId_Clth3StuckOn "Number of active inhibit reasons for the FIds / Number of active inhibit reasons for FId_Clth3StuckOn" UWORD DINH_ct_Compu 1 100 -4095.000 4096.000 BIT_MASK 0x1fff FORMAT "%8.3" ECU_ADDRESS 0x600140EC /end MEASUREMENT
/begin MEASUREMENT DINH_nrActvInhReas.FId_Clth4 "Number of active inhibit reasons for the FIds / Number of active inhibit reasons for FId_Clth4" UWORD DINH_ct_Compu 1 100 -4095.000 4096.000 BIT_MASK 0x1fff FORMAT "%8.3" ECU_ADDRESS 0x600140EE /end MEASUREMENT
/begin MEASUREMENT DINH_nrActvInhReas.FId_ClthCAN "Number of active inhibit reasons for the FIds / Number of active inhibit reasons for FId_ClthCAN" UWORD DINH_ct_Compu 1 100 -4095.000 4096.000 BIT_MASK 0x1fff FORMAT "%8.3" ECU_ADDRESS 0x600140F0 /end MEASUREMENT
/begin MEASUREMENT DINH_nrActvInhReas.FId_ClthMax "Number of active inhibit reasons for the FIds / Number of active inhibit reasons for FId_ClthMax" UWORD DINH_ct_Compu 1 100 -4095.000 4096.000 BIT_MASK 0x1fff FORMAT "%8.3" ECU_ADDRESS 0x600140F2 /end MEASUREMENT
/begin MEASUREMENT DINH_nrActvInhReas.FId_ClthStk "Number of active inhibit reasons for the FIds / Number of active inhibit reasons for FId_ClthStk" UWORD DINH_ct_Compu 1 100 -4095.000 4096.000 BIT_MASK 0x1fff FORMAT "%8.3" ECU_ADDRESS 0x600140F4 /end MEASUREMENT
/begin MEASUREMENT DINH_nrActvInhReas.FId_ClthStkErr "Number of active inhibit reasons for the FIds / Number of active inhibit reasons for FId_ClthStkErr" UWORD DINH_ct_Compu 1 100 -4095.000 4096.000 BIT_MASK 0x1fff FORMAT "%8.3" ECU_ADDRESS 0x600140F6 /end MEASUREMENT
/begin MEASUREMENT DINH_nrActvInhReas.FId_ClthStkFailr "Number of active inhibit reasons for the FIds / Number of active inhibit reasons for FId_ClthStkFailr" UWORD DINH_ct_Compu 1 100 -4095.000 4096.000 BIT_MASK 0x1fff FORMAT "%8.3" ECU_ADDRESS 0x600140F8 /end MEASUREMENT
/begin MEASUREMENT DINH_nrActvInhReas.FId_ClthStkOFFStuck "Number of active inhibit reasons for the FIds / Number of active inhibit reasons for FId_ClthStkOFFStuck" UWORD DINH_ct_Compu 1 100 -4095.000 4096.000 BIT_MASK 0x1fff FORMAT "%8.3" ECU_ADDRESS 0x600140FA /end MEASUREMENT
/begin MEASUREMENT DINH_nrActvInhReas.FId_ClthStkONStuck "Number of active inhibit reasons for the FIds / Number of active inhibit reasons for FId_ClthStkONStuck" UWORD DINH_ct_Compu 1 100 -4095.000 4096.000 BIT_MASK 0x1fff FORMAT "%8.3" ECU_ADDRESS 0x600140FC /end MEASUREMENT
/begin MEASUREMENT DINH_nrActvInhReas.FId_ClthSwtFailr "Number of active inhibit reasons for the FIds / Number of active inhibit reasons for FId_ClthSwtFailr" UWORD DINH_ct_Compu 1 100 -4095.000 4096.000 BIT_MASK 0x1fff FORMAT "%8.3" ECU_ADDRESS 0x600140FE /end MEASUREMENT
/begin MEASUREMENT DINH_nrActvInhReas.FId_CntrShaftFailr "Number of active inhibit reasons for the FIds / Number of active inhibit reasons for FId_CntrShaftFailr" UWORD DINH_ct_Compu 1 100 -4095.000 4096.000 BIT_MASK 0x1fff FORMAT "%8.3" ECU_ADDRESS 0x60014100 /end MEASUREMENT
/begin MEASUREMENT DINH_nrActvInhReas.FId_CoEOMGdiEomErrLcy "Number of active inhibit reasons for the FIds / Number of active inhibit reasons for FId_CoEOMGdiEomErrLcy" UWORD DINH_ct_Compu 1 100 -4095.000 4096.000 BIT_MASK 0x1fff FORMAT "%8.3" ECU_ADDRESS 0x60014102 /end MEASUREMENT
/begin MEASUREMENT DINH_nrActvInhReas.FId_CoESSBlowrVld "Number of active inhibit reasons for the FIds / Number of active inhibit reasons for FId_CoESSBlowrVld" UWORD DINH_ct_Compu 1 100 -4095.000 4096.000 BIT_MASK 0x1fff FORMAT "%8.3" ECU_ADDRESS 0x60014104 /end MEASUREMENT
/begin MEASUREMENT DINH_nrActvInhReas.FId_CoETM "Number of active inhibit reasons for the FIds / Number of active inhibit reasons for FId_CoETM" UWORD DINH_ct_Compu 1 100 -4095.000 4096.000 BIT_MASK 0x1fff FORMAT "%8.3" ECU_ADDRESS 0x60014106 /end MEASUREMENT
/begin MEASUREMENT DINH_nrActvInhReas.FId_CoETS_StTrqLimErr1 "Number of active inhibit reasons for the FIds / Number of active inhibit reasons for FId_CoETS_StTrqLimErr1" UWORD DINH_ct_Compu 1 100 -4095.000 4096.000 BIT_MASK 0x1fff FORMAT "%8.3" ECU_ADDRESS 0x60014108 /end MEASUREMENT
/begin MEASUREMENT DINH_nrActvInhReas.FId_CoETS_StTrqLimErr2 "Number of active inhibit reasons for the FIds / Number of active inhibit reasons for FId_CoETS_StTrqLimErr2" UWORD DINH_ct_Compu 1 100 -4095.000 4096.000 BIT_MASK 0x1fff FORMAT "%8.3" ECU_ADDRESS 0x6001410A /end MEASUREMENT
/begin MEASUREMENT DINH_nrActvInhReas.FId_CoEngStopEnblStSpEngT "Number of active inhibit reasons for the FIds / Number of active inhibit reasons for FId_CoEngStopEnblStSpEngT" UWORD DINH_ct_Compu 1 100 -4095.000 4096.000 BIT_MASK 0x1fff FORMAT "%8.3" ECU_ADDRESS 0x6001410C /end MEASUREMENT
/begin MEASUREMENT DINH_nrActvInhReas.FId_CoEngStopEnblStSpLSU "Number of active inhibit reasons for the FIds / Number of active inhibit reasons for FId_CoEngStopEnblStSpLSU" UWORD DINH_ct_Compu 1 100 -4095.000 4096.000 BIT_MASK 0x1fff FORMAT "%8.3" ECU_ADDRESS 0x6001410E /end MEASUREMENT
/begin MEASUREMENT DINH_nrActvInhReas.FId_CoEngStopEnblStSpTcT "Number of active inhibit reasons for the FIds / Number of active inhibit reasons for FId_CoEngStopEnblStSpTcT" UWORD DINH_ct_Compu 1 100 -4095.000 4096.000 BIT_MASK 0x1fff FORMAT "%8.3" ECU_ADDRESS 0x60014110 /end MEASUREMENT
/begin MEASUREMENT DINH_nrActvInhReas.FId_CoEngStopEnblSysErr "Number of active inhibit reasons for the FIds / Number of active inhibit reasons for FId_CoEngStopEnblSysErr" UWORD DINH_ct_Compu 1 100 -4095.000 4096.000 BIT_MASK 0x1fff FORMAT "%8.3" ECU_ADDRESS 0x60014112 /end MEASUREMENT
/begin MEASUREMENT DINH_nrActvInhReas.FId_CoEngVlvLftSpIntk "Number of active inhibit reasons for the FIds / Number of active inhibit reasons for FId_CoEngVlvLftSpIntk" UWORD DINH_ct_Compu 1 100 -4095.000 4096.000 BIT_MASK 0x1fff FORMAT "%8.3" ECU_ADDRESS 0x60014114 /end MEASUREMENT
/begin MEASUREMENT DINH_nrActvInhReas.FId_CoPOMStrtgDevStrtr "Number of active inhibit reasons for the FIds / Number of active inhibit reasons for FId_CoPOMStrtgDevStrtr" UWORD DINH_ct_Compu 1 100 -4095.000 4096.000 BIT_MASK 0x1fff FORMAT "%8.3" ECU_ADDRESS 0x60014116 /end MEASUREMENT
/begin MEASUREMENT DINH_nrActvInhReas.FId_CoPOM_FirstStrtAut "Number of active inhibit reasons for the FIds / Number of active inhibit reasons for FId_CoPOM_FirstStrtAut" UWORD DINH_ct_Compu 1 100 -4095.000 4096.000 BIT_MASK 0x1fff FORMAT "%8.3" ECU_ADDRESS 0x60014118 /end MEASUREMENT
/begin MEASUREMENT DINH_nrActvInhReas.FId_CoTS_SwtOff "Number of active inhibit reasons for the FIds / Number of active inhibit reasons for FId_CoTS_SwtOff" UWORD DINH_ct_Compu 1 100 -4095.000 4096.000 BIT_MASK 0x1fff FORMAT "%8.3" ECU_ADDRESS 0x6001411A /end MEASUREMENT
/begin MEASUREMENT DINH_nrActvInhReas.FId_CoVOMACCComFailr "Number of active inhibit reasons for the FIds / Number of active inhibit reasons for FId_CoVOMACCComFailr" UWORD DINH_ct_Compu 1 100 -4095.000 4096.000 BIT_MASK 0x1fff FORMAT "%8.3" ECU_ADDRESS 0x6001411C /end MEASUREMENT
/begin MEASUREMENT DINH_nrActvInhReas.FId_CoVOMBrkPedISABSigFailr "Number of active inhibit reasons for the FIds / Number of active inhibit reasons for FId_CoVOMBrkPedISABSigFailr" UWORD DINH_ct_Compu 1 100 -4095.000 4096.000 BIT_MASK 0x1fff FORMAT "%8.3" ECU_ADDRESS 0x6001411E /end MEASUREMENT
/begin MEASUREMENT DINH_nrActvInhReas.FId_CoVOMEngCrkAbort "Number of active inhibit reasons for the FIds / Number of active inhibit reasons for FId_CoVOMEngCrkAbort" UWORD DINH_ct_Compu 1 100 -4095.000 4096.000 BIT_MASK 0x1fff FORMAT "%8.3" ECU_ADDRESS 0x60014120 /end MEASUREMENT
/begin MEASUREMENT DINH_nrActvInhReas.FId_CoVOMEngRstrtEnaCdn "Number of active inhibit reasons for the FIds / Number of active inhibit reasons for FId_CoVOMEngRstrtEnaCdn" UWORD DINH_ct_Compu 1 100 -4095.000 4096.000 BIT_MASK 0x1fff FORMAT "%8.3" ECU_ADDRESS 0x60014122 /end MEASUREMENT
/begin MEASUREMENT DINH_nrActvInhReas.FId_CoVOMISSEng "Number of active inhibit reasons for the FIds / Number of active inhibit reasons for FId_CoVOMISSEng" UWORD DINH_ct_Compu 1 100 -4095.000 4096.000 BIT_MASK 0x1fff FORMAT "%8.3" ECU_ADDRESS 0x60014124 /end MEASUREMENT
/begin MEASUREMENT DINH_nrActvInhReas.FId_ComACRly "Number of active inhibit reasons for the FIds / Number of active inhibit reasons for FId_ComACRly" UWORD DINH_ct_Compu 1 100 -4095.000 4096.000 BIT_MASK 0x1fff FORMAT "%8.3" ECU_ADDRESS 0x60014126 /end MEASUREMENT
/begin MEASUREMENT DINH_nrActvInhReas.FId_ComAPPSensFail "Number of active inhibit reasons for the FIds / Number of active inhibit reasons for FId_ComAPPSensFail" UWORD DINH_ct_Compu 1 100 -4095.000 4096.000 BIT_MASK 0x1fff FORMAT "%8.3" ECU_ADDRESS 0x60014128 /end MEASUREMENT
/begin MEASUREMENT DINH_nrActvInhReas.FId_ComAPedl "Number of active inhibit reasons for the FIds / Number of active inhibit reasons for FId_ComAPedl" UWORD DINH_ct_Compu 1 100 -4095.000 4096.000 BIT_MASK 0x1fff FORMAT "%8.3" ECU_ADDRESS 0x6001412A /end MEASUREMENT
/begin MEASUREMENT DINH_nrActvInhReas.FId_ComAYCA "Number of active inhibit reasons for the FIds / Number of active inhibit reasons for FId_ComAYCA" UWORD DINH_ct_Compu 1 100 -4095.000 4096.000 BIT_MASK 0x1fff FORMAT "%8.3" ECU_ADDRESS 0x6001412C /end MEASUREMENT
/begin MEASUREMENT DINH_nrActvInhReas.FId_ComAYCAMon "Number of active inhibit reasons for the FIds / Number of active inhibit reasons for FId_ComAYCAMon" UWORD DINH_ct_Compu 1 100 -4095.000 4096.000 BIT_MASK 0x1fff FORMAT "%8.3" ECU_ADDRESS 0x6001412E /end MEASUREMENT
/begin MEASUREMENT DINH_nrActvInhReas.FId_ComAYCD "Number of active inhibit reasons for the FIds / Number of active inhibit reasons for FId_ComAYCD" UWORD DINH_ct_Compu 1 100 -4095.000 4096.000 BIT_MASK 0x1fff FORMAT "%8.3" ECU_ADDRESS 0x60014130 /end MEASUREMENT
/begin MEASUREMENT DINH_nrActvInhReas.FId_ComAYCDMon "Number of active inhibit reasons for the FIds / Number of active inhibit reasons for FId_ComAYCDMon" UWORD DINH_ct_Compu 1 100 -4095.000 4096.000 BIT_MASK 0x1fff FORMAT "%8.3" ECU_ADDRESS 0x60014132 /end MEASUREMENT
/begin MEASUREMENT DINH_nrActvInhReas.FId_ComAYCF "Number of active inhibit reasons for the FIds / Number of active inhibit reasons for FId_ComAYCF" UWORD DINH_ct_Compu 1 100 -4095.000 4096.000 BIT_MASK 0x1fff FORMAT "%8.3" ECU_ADDRESS 0x60014134 /end MEASUREMENT
/begin MEASUREMENT DINH_nrActvInhReas.FId_ComAYCFMon "Number of active inhibit reasons for the FIds / Number of active inhibit reasons for FId_ComAYCFMon" UWORD DINH_ct_Compu 1 100 -4095.000 4096.000 BIT_MASK 0x1fff FORMAT "%8.3" ECU_ADDRESS 0x60014136 /end MEASUREMENT
/begin MEASUREMENT DINH_nrActvInhReas.FId_ComAYCG "Number of active inhibit reasons for the FIds / Number of active inhibit reasons for FId_ComAYCG" UWORD DINH_ct_Compu 1 100 -4095.000 4096.000 BIT_MASK 0x1fff FORMAT "%8.3" ECU_ADDRESS 0x60014138 /end MEASUREMENT
/begin MEASUREMENT DINH_nrActvInhReas.FId_ComAYCGMon "Number of active inhibit reasons for the FIds / Number of active inhibit reasons for FId_ComAYCGMon" UWORD DINH_ct_Compu 1 100 -4095.000 4096.000 BIT_MASK 0x1fff FORMAT "%8.3" ECU_ADDRESS 0x6001413A /end MEASUREMENT
/begin MEASUREMENT DINH_nrActvInhReas.FId_ComAYCI "Number of active inhibit reasons for the FIds / Number of active inhibit reasons for FId_ComAYCI" UWORD DINH_ct_Compu 1 100 -4095.000 4096.000 BIT_MASK 0x1fff FORMAT "%8.3" ECU_ADDRESS 0x6001413C /end MEASUREMENT
/begin MEASUREMENT DINH_nrActvInhReas.FId_ComAYCIMon "Number of active inhibit reasons for the FIds / Number of active inhibit reasons for FId_ComAYCIMon" UWORD DINH_ct_Compu 1 100 -4095.000 4096.000 BIT_MASK 0x1fff FORMAT "%8.3" ECU_ADDRESS 0x6001413E /end MEASUREMENT
/begin MEASUREMENT DINH_nrActvInhReas.FId_ComAirPThrUsSnsrErr "Number of active inhibit reasons for the FIds / Number of active inhibit reasons for FId_ComAirPThrUsSnsrErr" UWORD DINH_ct_Compu 1 100 -4095.000 4096.000 BIT_MASK 0x1fff FORMAT "%8.3" ECU_ADDRESS 0x60014140 /end MEASUREMENT
/begin MEASUREMENT DINH_nrActvInhReas.FId_ComAltFail "Number of active inhibit reasons for the FIds / Number of active inhibit reasons for FId_ComAltFail" UWORD DINH_ct_Compu 1 100 -4095.000 4096.000 BIT_MASK 0x1fff FORMAT "%8.3" ECU_ADDRESS 0x60014142 /end MEASUREMENT
/begin MEASUREMENT DINH_nrActvInhReas.FId_ComAppVehSnsrFailr "Number of active inhibit reasons for the FIds / Number of active inhibit reasons for FId_ComAppVehSnsrFailr" UWORD DINH_ct_Compu 1 100 -4095.000 4096.000 BIT_MASK 0x1fff FORMAT "%8.3" ECU_ADDRESS 0x60014144 /end MEASUREMENT
/begin MEASUREMENT DINH_nrActvInhReas.FId_ComBCM1 "Number of active inhibit reasons for the FIds / Number of active inhibit reasons for FId_ComBCM1" UWORD DINH_ct_Compu 1 100 -4095.000 4096.000 BIT_MASK 0x1fff FORMAT "%8.3" ECU_ADDRESS 0x60014146 /end MEASUREMENT
/begin MEASUREMENT DINH_nrActvInhReas.FId_ComBCM1Mon "Number of active inhibit reasons for the FIds / Number of active inhibit reasons for FId_ComBCM1Mon" UWORD DINH_ct_Compu 1 100 -4095.000 4096.000 BIT_MASK 0x1fff FORMAT "%8.3" ECU_ADDRESS 0x60014148 /end MEASUREMENT
/begin MEASUREMENT DINH_nrActvInhReas.FId_ComBCMUnitCfmdErr "Number of active inhibit reasons for the FIds / Number of active inhibit reasons for FId_ComBCMUnitCfmdErr" UWORD DINH_ct_Compu 1 100 -4095.000 4096.000 BIT_MASK 0x1fff FORMAT "%8.3" ECU_ADDRESS 0x6001414A /end MEASUREMENT
/begin MEASUREMENT DINH_nrActvInhReas.FId_ComBCMUnitNotTstd "Number of active inhibit reasons for the FIds / Number of active inhibit reasons for FId_ComBCMUnitNotTstd" UWORD DINH_ct_Compu 1 100 -4095.000 4096.000 BIT_MASK 0x1fff FORMAT "%8.3" ECU_ADDRESS 0x6001414C /end MEASUREMENT
/begin MEASUREMENT DINH_nrActvInhReas.FId_ComBstCtrl "Number of active inhibit reasons for the FIds / Number of active inhibit reasons for FId_ComBstCtrl" UWORD DINH_ct_Compu 1 100 -4095.000 4096.000 BIT_MASK 0x1fff FORMAT "%8.3" ECU_ADDRESS 0x6001414E /end MEASUREMENT
/begin MEASUREMENT DINH_nrActvInhReas.FId_ComCANVEHICLEBusOff "Number of active inhibit reasons for the FIds / Number of active inhibit reasons for FId_ComCANVEHICLEBusOff" UWORD DINH_ct_Compu 1 100 -4095.000 4096.000 BIT_MASK 0x1fff FORMAT "%8.3" ECU_ADDRESS 0x60014150 /end MEASUREMENT
/begin MEASUREMENT DINH_nrActvInhReas.FId_ComCGW1 "Number of active inhibit reasons for the FIds / Number of active inhibit reasons for FId_ComCGW1" UWORD DINH_ct_Compu 1 100 -4095.000 4096.000 BIT_MASK 0x1fff FORMAT "%8.3" ECU_ADDRESS 0x60014152 /end MEASUREMENT
/begin MEASUREMENT DINH_nrActvInhReas.FId_ComCGW1Mon "Number of active inhibit reasons for the FIds / Number of active inhibit reasons for FId_ComCGW1Mon" UWORD DINH_ct_Compu 1 100 -4095.000 4096.000 BIT_MASK 0x1fff FORMAT "%8.3" ECU_ADDRESS 0x60014154 /end MEASUREMENT
/begin MEASUREMENT DINH_nrActvInhReas.FId_ComClthSt "Number of active inhibit reasons for the FIds / Number of active inhibit reasons for FId_ComClthSt" UWORD DINH_ct_Compu 1 100 -4095.000 4096.000 BIT_MASK 0x1fff FORMAT "%8.3" ECU_ADDRESS 0x60014156 /end MEASUREMENT
/begin MEASUREMENT DINH_nrActvInhReas.FId_ComConvClth "Number of active inhibit reasons for the FIds / Number of active inhibit reasons for FId_ComConvClth" UWORD DINH_ct_Compu 1 100 -4095.000 4096.000 BIT_MASK 0x1fff FORMAT "%8.3" ECU_ADDRESS 0x60014158 /end MEASUREMENT
/begin MEASUREMENT DINH_nrActvInhReas.FId_ComCrCtlReq "Number of active inhibit reasons for the FIds / Number of active inhibit reasons for FId_ComCrCtlReq" UWORD DINH_ct_Compu 1 100 -4095.000 4096.000 BIT_MASK 0x1fff FORMAT "%8.3" ECU_ADDRESS 0x6001415A /end MEASUREMENT
/begin MEASUREMENT DINH_nrActvInhReas.FId_ComCrsMaiIndcnLampReq "Number of active inhibit reasons for the FIds / Number of active inhibit reasons for FId_ComCrsMaiIndcnLampReq" UWORD DINH_ct_Compu 1 100 -4095.000 4096.000 BIT_MASK 0x1fff FORMAT "%8.3" ECU_ADDRESS 0x6001415C /end MEASUREMENT
/begin MEASUREMENT DINH_nrActvInhReas.FId_ComCrsSetIndcnLampReq "Number of active inhibit reasons for the FIds / Number of active inhibit reasons for FId_ComCrsSetIndcnLampReq" UWORD DINH_ct_Compu 1 100 -4095.000 4096.000 BIT_MASK 0x1fff FORMAT "%8.3" ECU_ADDRESS 0x6001415E /end MEASUREMENT
/begin MEASUREMENT DINH_nrActvInhReas.FId_ComDCDCCdn "Number of active inhibit reasons for the FIds / Number of active inhibit reasons for FId_ComDCDCCdn" UWORD DINH_ct_Compu 1 100 -4095.000 4096.000 BIT_MASK 0x1fff FORMAT "%8.3" ECU_ADDRESS 0x60014160 /end MEASUREMENT
/begin MEASUREMENT DINH_nrActvInhReas.FId_ComDCDCErr "Number of active inhibit reasons for the FIds / Number of active inhibit reasons for FId_ComDCDCErr" UWORD DINH_ct_Compu 1 100 -4095.000 4096.000 BIT_MASK 0x1fff FORMAT "%8.3" ECU_ADDRESS 0x60014162 /end MEASUREMENT
/begin MEASUREMENT DINH_nrActvInhReas.FId_ComDesGearCurr "Number of active inhibit reasons for the FIds / Number of active inhibit reasons for FId_ComDesGearCurr" UWORD DINH_ct_Compu 1 100 -4095.000 4096.000 BIT_MASK 0x1fff FORMAT "%8.3" ECU_ADDRESS 0x60014164 /end MEASUREMENT
/begin MEASUREMENT DINH_nrActvInhReas.FId_ComDetrmAirM "Number of active inhibit reasons for the FIds / Number of active inhibit reasons for FId_ComDetrmAirM" UWORD DINH_ct_Compu 1 100 -4095.000 4096.000 BIT_MASK 0x1fff FORMAT "%8.3" ECU_ADDRESS 0x60014166 /end MEASUREMENT
/begin MEASUREMENT DINH_nrActvInhReas.FId_ComDwnShiftCtrlReq "Number of active inhibit reasons for the FIds / Number of active inhibit reasons for FId_ComDwnShiftCtrlReq" UWORD DINH_ct_Compu 1 100 -4095.000 4096.000 BIT_MASK 0x1fff FORMAT "%8.3" ECU_ADDRESS 0x60014168 /end MEASUREMENT
/begin MEASUREMENT DINH_nrActvInhReas.FId_ComEAT1 "Number of active inhibit reasons for the FIds / Number of active inhibit reasons for FId_ComEAT1" UWORD DINH_ct_Compu 1 100 -4095.000 4096.000 BIT_MASK 0x1fff FORMAT "%8.3" ECU_ADDRESS 0x6001416A /end MEASUREMENT
/begin MEASUREMENT DINH_nrActvInhReas.FId_ComEAT10 "Number of active inhibit reasons for the FIds / Number of active inhibit reasons for FId_ComEAT10" UWORD DINH_ct_Compu 1 100 -4095.000 4096.000 BIT_MASK 0x1fff FORMAT "%8.3" ECU_ADDRESS 0x6001416C /end MEASUREMENT
/begin MEASUREMENT DINH_nrActvInhReas.FId_ComEAT10Mon "Number of active inhibit reasons for the FIds / Number of active inhibit reasons for FId_ComEAT10Mon" UWORD DINH_ct_Compu 1 100 -4095.000 4096.000 BIT_MASK 0x1fff FORMAT "%8.3" ECU_ADDRESS 0x6001416E /end MEASUREMENT
/begin MEASUREMENT DINH_nrActvInhReas.FId_ComEAT11 "Number of active inhibit reasons for the FIds / Number of active inhibit reasons for FId_ComEAT11" UWORD DINH_ct_Compu 1 100 -4095.000 4096.000 BIT_MASK 0x1fff FORMAT "%8.3" ECU_ADDRESS 0x60014170 /end MEASUREMENT
/begin MEASUREMENT DINH_nrActvInhReas.FId_ComEAT11Mon "Number of active inhibit reasons for the FIds / Number of active inhibit reasons for FId_ComEAT11Mon" UWORD DINH_ct_Compu 1 100 -4095.000 4096.000 BIT_MASK 0x1fff FORMAT "%8.3" ECU_ADDRESS 0x60014172 /end MEASUREMENT
/begin MEASUREMENT DINH_nrActvInhReas.FId_ComEAT12 "Number of active inhibit reasons for the FIds / Number of active inhibit reasons for FId_ComEAT12" UWORD DINH_ct_Compu 1 100 -4095.000 4096.000 BIT_MASK 0x1fff FORMAT "%8.3" ECU_ADDRESS 0x60014174 /end MEASUREMENT
/begin MEASUREMENT DINH_nrActvInhReas.FId_ComEAT12Mon "Number of active inhibit reasons for the FIds / Number of active inhibit reasons for FId_ComEAT12Mon" UWORD DINH_ct_Compu 1 100 -4095.000 4096.000 BIT_MASK 0x1fff FORMAT "%8.3" ECU_ADDRESS 0x60014176 /end MEASUREMENT
/begin MEASUREMENT DINH_nrActvInhReas.FId_ComEAT13 "Number of active inhibit reasons for the FIds / Number of active inhibit reasons for FId_ComEAT13" UWORD DINH_ct_Compu 1 100 -4095.000 4096.000 BIT_MASK 0x1fff FORMAT "%8.3" ECU_ADDRESS 0x60014178 /end MEASUREMENT
/begin MEASUREMENT DINH_nrActvInhReas.FId_ComEAT13Mon "Number of active inhibit reasons for the FIds / Number of active inhibit reasons for FId_ComEAT13Mon" UWORD DINH_ct_Compu 1 100 -4095.000 4096.000 BIT_MASK 0x1fff FORMAT "%8.3" ECU_ADDRESS 0x6001417A /end MEASUREMENT
/begin MEASUREMENT DINH_nrActvInhReas.FId_ComEAT1Mon "Number of active inhibit reasons for the FIds / Number of active inhibit reasons for FId_ComEAT1Mon" UWORD DINH_ct_Compu 1 100 -4095.000 4096.000 BIT_MASK 0x1fff FORMAT "%8.3" ECU_ADDRESS 0x6001417C /end MEASUREMENT
/begin MEASUREMENT DINH_nrActvInhReas.FId_ComEAT2 "Number of active inhibit reasons for the FIds / Number of active inhibit reasons for FId_ComEAT2" UWORD DINH_ct_Compu 1 100 -4095.000 4096.000 BIT_MASK 0x1fff FORMAT "%8.3" ECU_ADDRESS 0x6001417E /end MEASUREMENT
/begin MEASUREMENT DINH_nrActvInhReas.FId_ComEAT2Mon "Number of active inhibit reasons for the FIds / Number of active inhibit reasons for FId_ComEAT2Mon" UWORD DINH_ct_Compu 1 100 -4095.000 4096.000 BIT_MASK 0x1fff FORMAT "%8.3" ECU_ADDRESS 0x60014180 /end MEASUREMENT
/begin MEASUREMENT DINH_nrActvInhReas.FId_ComEAT4 "Number of active inhibit reasons for the FIds / Number of active inhibit reasons for FId_ComEAT4" UWORD DINH_ct_Compu 1 100 -4095.000 4096.000 BIT_MASK 0x1fff FORMAT "%8.3" ECU_ADDRESS 0x60014182 /end MEASUREMENT
/begin MEASUREMENT DINH_nrActvInhReas.FId_ComEAT4Mon "Number of active inhibit reasons for the FIds / Number of active inhibit reasons for FId_ComEAT4Mon" UWORD DINH_ct_Compu 1 100 -4095.000 4096.000 BIT_MASK 0x1fff FORMAT "%8.3" ECU_ADDRESS 0x60014184 /end MEASUREMENT
/begin MEASUREMENT DINH_nrActvInhReas.FId_ComEAT6 "Number of active inhibit reasons for the FIds / Number of active inhibit reasons for FId_ComEAT6" UWORD DINH_ct_Compu 1 100 -4095.000 4096.000 BIT_MASK 0x1fff FORMAT "%8.3" ECU_ADDRESS 0x60014186 /end MEASUREMENT
/begin MEASUREMENT DINH_nrActvInhReas.FId_ComEAT6Mon "Number of active inhibit reasons for the FIds / Number of active inhibit reasons for FId_ComEAT6Mon" UWORD DINH_ct_Compu 1 100 -4095.000 4096.000 BIT_MASK 0x1fff FORMAT "%8.3" ECU_ADDRESS 0x60014188 /end MEASUREMENT
/begin MEASUREMENT DINH_nrActvInhReas.FId_ComEAT7 "Number of active inhibit reasons for the FIds / Number of active inhibit reasons for FId_ComEAT7" UWORD DINH_ct_Compu 1 100 -4095.000 4096.000 BIT_MASK 0x1fff FORMAT "%8.3" ECU_ADDRESS 0x6001418A /end MEASUREMENT
/begin MEASUREMENT DINH_nrActvInhReas.FId_ComEAT7Mon "Number of active inhibit reasons for the FIds / Number of active inhibit reasons for FId_ComEAT7Mon" UWORD DINH_ct_Compu 1 100 -4095.000 4096.000 BIT_MASK 0x1fff FORMAT "%8.3" ECU_ADDRESS 0x6001418C /end MEASUREMENT
/begin MEASUREMENT DINH_nrActvInhReas.FId_ComEAT8 "Number of active inhibit reasons for the FIds / Number of active inhibit reasons for FId_ComEAT8" UWORD DINH_ct_Compu 1 100 -4095.000 4096.000 BIT_MASK 0x1fff FORMAT "%8.3" ECU_ADDRESS 0x6001418E /end MEASUREMENT
/begin MEASUREMENT DINH_nrActvInhReas.FId_ComEAT8Mon "Number of active inhibit reasons for the FIds / Number of active inhibit reasons for FId_ComEAT8Mon" UWORD DINH_ct_Compu 1 100 -4095.000 4096.000 BIT_MASK 0x1fff FORMAT "%8.3" ECU_ADDRESS 0x60014190 /end MEASUREMENT
/begin MEASUREMENT DINH_nrActvInhReas.FId_ComEATA "Number of active inhibit reasons for the FIds / Number of active inhibit reasons for FId_ComEATA" UWORD DINH_ct_Compu 1 100 -4095.000 4096.000 BIT_MASK 0x1fff FORMAT "%8.3" ECU_ADDRESS 0x60014192 /end MEASUREMENT
/begin MEASUREMENT DINH_nrActvInhReas.FId_ComEATAMon "Number of active inhibit reasons for the FIds / Number of active inhibit reasons for FId_ComEATAMon" UWORD DINH_ct_Compu 1 100 -4095.000 4096.000 BIT_MASK 0x1fff FORMAT "%8.3" ECU_ADDRESS 0x60014194 /end MEASUREMENT
/begin MEASUREMENT DINH_nrActvInhReas.FId_ComEATB "Number of active inhibit reasons for the FIds / Number of active inhibit reasons for FId_ComEATB" UWORD DINH_ct_Compu 1 100 -4095.000 4096.000 BIT_MASK 0x1fff FORMAT "%8.3" ECU_ADDRESS 0x60014196 /end MEASUREMENT
/begin MEASUREMENT DINH_nrActvInhReas.FId_ComEATBMon "Number of active inhibit reasons for the FIds / Number of active inhibit reasons for FId_ComEATBMon" UWORD DINH_ct_Compu 1 100 -4095.000 4096.000 BIT_MASK 0x1fff FORMAT "%8.3" ECU_ADDRESS 0x60014198 /end MEASUREMENT
/begin MEASUREMENT DINH_nrActvInhReas.FId_ComEATC "Number of active inhibit reasons for the FIds / Number of active inhibit reasons for FId_ComEATC" UWORD DINH_ct_Compu 1 100 -4095.000 4096.000 BIT_MASK 0x1fff FORMAT "%8.3" ECU_ADDRESS 0x6001419A /end MEASUREMENT
/begin MEASUREMENT DINH_nrActvInhReas.FId_ComEATCMon "Number of active inhibit reasons for the FIds / Number of active inhibit reasons for FId_ComEATCMon" UWORD DINH_ct_Compu 1 100 -4095.000 4096.000 BIT_MASK 0x1fff FORMAT "%8.3" ECU_ADDRESS 0x6001419C /end MEASUREMENT
/begin MEASUREMENT DINH_nrActvInhReas.FId_ComEBSSelfDiagErr "Number of active inhibit reasons for the FIds / Number of active inhibit reasons for FId_ComEBSSelfDiagErr" UWORD DINH_ct_Compu 1 100 -4095.000 4096.000 BIT_MASK 0x1fff FORMAT "%8.3" ECU_ADDRESS 0x6001419E /end MEASUREMENT
/begin MEASUREMENT DINH_nrActvInhReas.FId_ComECUHwErr "Number of active inhibit reasons for the FIds / Number of active inhibit reasons for FId_ComECUHwErr" UWORD DINH_ct_Compu 1 100 -4095.000 4096.000 BIT_MASK 0x1fff FORMAT "%8.3" ECU_ADDRESS 0x600141A0 /end MEASUREMENT
/begin MEASUREMENT DINH_nrActvInhReas.FId_ComEGRVlvErr "Number of active inhibit reasons for the FIds / Number of active inhibit reasons for FId_ComEGRVlvErr" UWORD DINH_ct_Compu 1 100 -4095.000 4096.000 BIT_MASK 0x1fff FORMAT "%8.3" ECU_ADDRESS 0x600141A2 /end MEASUREMENT
/begin MEASUREMENT DINH_nrActvInhReas.FId_ComEMSIntAirTemp "Number of active inhibit reasons for the FIds / Number of active inhibit reasons for FId_ComEMSIntAirTemp" UWORD DINH_ct_Compu 1 100 -4095.000 4096.000 BIT_MASK 0x1fff FORMAT "%8.3" ECU_ADDRESS 0x600141A4 /end MEASUREMENT
/begin MEASUREMENT DINH_nrActvInhReas.FId_ComEPB "Number of active inhibit reasons for the FIds / Number of active inhibit reasons for FId_ComEPB" UWORD DINH_ct_Compu 1 100 -4095.000 4096.000 BIT_MASK 0x1fff FORMAT "%8.3" ECU_ADDRESS 0x600141A6 /end MEASUREMENT
/begin MEASUREMENT DINH_nrActvInhReas.FId_ComEPBB "Number of active inhibit reasons for the FIds / Number of active inhibit reasons for FId_ComEPBB" UWORD DINH_ct_Compu 1 100 -4095.000 4096.000 BIT_MASK 0x1fff FORMAT "%8.3" ECU_ADDRESS 0x600141A8 /end MEASUREMENT
/begin MEASUREMENT DINH_nrActvInhReas.FId_ComEPBBMon "Number of active inhibit reasons for the FIds / Number of active inhibit reasons for FId_ComEPBBMon" UWORD DINH_ct_Compu 1 100 -4095.000 4096.000 BIT_MASK 0x1fff FORMAT "%8.3" ECU_ADDRESS 0x600141AA /end MEASUREMENT
/begin MEASUREMENT DINH_nrActvInhReas.FId_ComEPBMon "Number of active inhibit reasons for the FIds / Number of active inhibit reasons for FId_ComEPBMon" UWORD DINH_ct_Compu 1 100 -4095.000 4096.000 BIT_MASK 0x1fff FORMAT "%8.3" ECU_ADDRESS 0x600141AC /end MEASUREMENT
/begin MEASUREMENT DINH_nrActvInhReas.FId_ComEPS1 "Number of active inhibit reasons for the FIds / Number of active inhibit reasons for FId_ComEPS1" UWORD DINH_ct_Compu 1 100 -4095.000 4096.000 BIT_MASK 0x1fff FORMAT "%8.3" ECU_ADDRESS 0x600141AE /end MEASUREMENT
/begin MEASUREMENT DINH_nrActvInhReas.FId_ComEPS1Mon "Number of active inhibit reasons for the FIds / Number of active inhibit reasons for FId_ComEPS1Mon" UWORD DINH_ct_Compu 1 100 -4095.000 4096.000 BIT_MASK 0x1fff FORMAT "%8.3" ECU_ADDRESS 0x600141B0 /end MEASUREMENT
/begin MEASUREMENT DINH_nrActvInhReas.FId_ComEPSUnitCfmdErr "Number of active inhibit reasons for the FIds / Number of active inhibit reasons for FId_ComEPSUnitCfmdErr" UWORD DINH_ct_Compu 1 100 -4095.000 4096.000 BIT_MASK 0x1fff FORMAT "%8.3" ECU_ADDRESS 0x600141B2 /end MEASUREMENT
/begin MEASUREMENT DINH_nrActvInhReas.FId_ComEPSUnitNotTstd "Number of active inhibit reasons for the FIds / Number of active inhibit reasons for FId_ComEPSUnitNotTstd" UWORD DINH_ct_Compu 1 100 -4095.000 4096.000 BIT_MASK 0x1fff FORMAT "%8.3" ECU_ADDRESS 0x600141B4 /end MEASUREMENT
/begin MEASUREMENT DINH_nrActvInhReas.FId_ComEngBrkOvrdInfo "Number of active inhibit reasons for the FIds / Number of active inhibit reasons for FId_ComEngBrkOvrdInfo" UWORD DINH_ct_Compu 1 100 -4095.000 4096.000 BIT_MASK 0x1fff FORMAT "%8.3" ECU_ADDRESS 0x600141B6 /end MEASUREMENT
/begin MEASUREMENT DINH_nrActvInhReas.FId_ComEngBrkOvrdMtr "Number of active inhibit reasons for the FIds / Number of active inhibit reasons for FId_ComEngBrkOvrdMtr" UWORD DINH_ct_Compu 1 100 -4095.000 4096.000 BIT_MASK 0x1fff FORMAT "%8.3" ECU_ADDRESS 0x600141B8 /end MEASUREMENT
/begin MEASUREMENT DINH_nrActvInhReas.FId_ComEngBrkSwErr "Number of active inhibit reasons for the FIds / Number of active inhibit reasons for FId_ComEngBrkSwErr" UWORD DINH_ct_Compu 1 100 -4095.000 4096.000 BIT_MASK 0x1fff FORMAT "%8.3" ECU_ADDRESS 0x600141BA /end MEASUREMENT
/begin MEASUREMENT DINH_nrActvInhReas.FId_ComEngPosng "Number of active inhibit reasons for the FIds / Number of active inhibit reasons for FId_ComEngPosng" UWORD DINH_ct_Compu 1 100 -4095.000 4096.000 BIT_MASK 0x1fff FORMAT "%8.3" ECU_ADDRESS 0x600141BC /end MEASUREMENT
/begin MEASUREMENT DINH_nrActvInhReas.FId_ComEngRPMLim "Number of active inhibit reasons for the FIds / Number of active inhibit reasons for FId_ComEngRPMLim" UWORD DINH_ct_Compu 1 100 -4095.000 4096.000 BIT_MASK 0x1fff FORMAT "%8.3" ECU_ADDRESS 0x600141BE /end MEASUREMENT
/begin MEASUREMENT DINH_nrActvInhReas.FId_ComEngTrqLim "Number of active inhibit reasons for the FIds / Number of active inhibit reasons for FId_ComEngTrqLim" UWORD DINH_ct_Compu 1 100 -4095.000 4096.000 BIT_MASK 0x1fff FORMAT "%8.3" ECU_ADDRESS 0x600141C0 /end MEASUREMENT
/begin MEASUREMENT DINH_nrActvInhReas.FId_ComEnvtlAirPSnsrErr "Number of active inhibit reasons for the FIds / Number of active inhibit reasons for FId_ComEnvtlAirPSnsrErr" UWORD DINH_ct_Compu 1 100 -4095.000 4096.000 BIT_MASK 0x1fff FORMAT "%8.3" ECU_ADDRESS 0x600141C2 /end MEASUREMENT
/begin MEASUREMENT DINH_nrActvInhReas.FId_ComEstmTqNormJdg "Number of active inhibit reasons for the FIds / Number of active inhibit reasons for FId_ComEstmTqNormJdg" UWORD DINH_ct_Compu 1 100 -4095.000 4096.000 BIT_MASK 0x1fff FORMAT "%8.3" ECU_ADDRESS 0x600141C4 /end MEASUREMENT
/begin MEASUREMENT DINH_nrActvInhReas.FId_ComEthnlSErr "Number of active inhibit reasons for the FIds / Number of active inhibit reasons for FId_ComEthnlSErr" UWORD DINH_ct_Compu 1 100 -4095.000 4096.000 BIT_MASK 0x1fff FORMAT "%8.3" ECU_ADDRESS 0x600141C6 /end MEASUREMENT
/begin MEASUREMENT DINH_nrActvInhReas.FId_ComFlSply "Number of active inhibit reasons for the FIds / Number of active inhibit reasons for FId_ComFlSply" UWORD DINH_ct_Compu 1 100 -4095.000 4096.000 BIT_MASK 0x1fff FORMAT "%8.3" ECU_ADDRESS 0x600141C8 /end MEASUREMENT
/begin MEASUREMENT DINH_nrActvInhReas.FId_ComFuCnsBitDurgIdleStop "Number of active inhibit reasons for the FIds / Number of active inhibit reasons for FId_ComFuCnsBitDurgIdleStop" UWORD DINH_ct_Compu 1 100 -4095.000 4096.000 BIT_MASK 0x1fff FORMAT "%8.3" ECU_ADDRESS 0x600141CA /end MEASUREMENT
/begin MEASUREMENT DINH_nrActvInhReas.FId_ComGEVCntrl "Number of active inhibit reasons for the FIds / Number of active inhibit reasons for FId_ComGEVCntrl" UWORD DINH_ct_Compu 1 100 -4095.000 4096.000 BIT_MASK 0x1fff FORMAT "%8.3" ECU_ADDRESS 0x600141CC /end MEASUREMENT
/begin MEASUREMENT DINH_nrActvInhReas.FId_ComGbxNPosFail "Number of active inhibit reasons for the FIds / Number of active inhibit reasons for FId_ComGbxNPosFail" UWORD DINH_ct_Compu 1 100 -4095.000 4096.000 BIT_MASK 0x1fff FORMAT "%8.3" ECU_ADDRESS 0x600141CE /end MEASUREMENT
/begin MEASUREMENT DINH_nrActvInhReas.FId_ComGbxTemp "Number of active inhibit reasons for the FIds / Number of active inhibit reasons for FId_ComGbxTemp" UWORD DINH_ct_Compu 1 100 -4095.000 4096.000 BIT_MASK 0x1fff FORMAT "%8.3" ECU_ADDRESS 0x600141D0 /end MEASUREMENT
/begin MEASUREMENT DINH_nrActvInhReas.FId_ComGwIMG1 "Number of active inhibit reasons for the FIds / Number of active inhibit reasons for FId_ComGwIMG1" UWORD DINH_ct_Compu 1 100 -4095.000 4096.000 BIT_MASK 0x1fff FORMAT "%8.3" ECU_ADDRESS 0x600141D2 /end MEASUREMENT
/begin MEASUREMENT DINH_nrActvInhReas.FId_ComGwIMG1Mon "Number of active inhibit reasons for the FIds / Number of active inhibit reasons for FId_ComGwIMG1Mon" UWORD DINH_ct_Compu 1 100 -4095.000 4096.000 BIT_MASK 0x1fff FORMAT "%8.3" ECU_ADDRESS 0x600141D4 /end MEASUREMENT
/begin MEASUREMENT DINH_nrActvInhReas.FId_ComGwIMG3 "Number of active inhibit reasons for the FIds / Number of active inhibit reasons for FId_ComGwIMG3" UWORD DINH_ct_Compu 1 100 -4095.000 4096.000 BIT_MASK 0x1fff FORMAT "%8.3" ECU_ADDRESS 0x600141D6 /end MEASUREMENT
/begin MEASUREMENT DINH_nrActvInhReas.FId_ComGwIMG3Mon "Number of active inhibit reasons for the FIds / Number of active inhibit reasons for FId_ComGwIMG3Mon" UWORD DINH_ct_Compu 1 100 -4095.000 4096.000 BIT_MASK 0x1fff FORMAT "%8.3" ECU_ADDRESS 0x600141D8 /end MEASUREMENT
/begin MEASUREMENT DINH_nrActvInhReas.FId_ComGwIMG4 "Number of active inhibit reasons for the FIds / Number of active inhibit reasons for FId_ComGwIMG4" UWORD DINH_ct_Compu 1 100 -4095.000 4096.000 BIT_MASK 0x1fff FORMAT "%8.3" ECU_ADDRESS 0x600141DA /end MEASUREMENT
/begin MEASUREMENT DINH_nrActvInhReas.FId_ComGwIMG4Mon "Number of active inhibit reasons for the FIds / Number of active inhibit reasons for FId_ComGwIMG4Mon" UWORD DINH_ct_Compu 1 100 -4095.000 4096.000 BIT_MASK 0x1fff FORMAT "%8.3" ECU_ADDRESS 0x600141DC /end MEASUREMENT
/begin MEASUREMENT DINH_nrActvInhReas.FId_ComGwIMG5 "Number of active inhibit reasons for the FIds / Number of active inhibit reasons for FId_ComGwIMG5" UWORD DINH_ct_Compu 1 100 -4095.000 4096.000 BIT_MASK 0x1fff FORMAT "%8.3" ECU_ADDRESS 0x600141DE /end MEASUREMENT
/begin MEASUREMENT DINH_nrActvInhReas.FId_ComGwIMG5Mon "Number of active inhibit reasons for the FIds / Number of active inhibit reasons for FId_ComGwIMG5Mon" UWORD DINH_ct_Compu 1 100 -4095.000 4096.000 BIT_MASK 0x1fff FORMAT "%8.3" ECU_ADDRESS 0x600141E0 /end MEASUREMENT
/begin MEASUREMENT DINH_nrActvInhReas.FId_ComGwIMG6 "Number of active inhibit reasons for the FIds / Number of active inhibit reasons for FId_ComGwIMG6" UWORD DINH_ct_Compu 1 100 -4095.000 4096.000 BIT_MASK 0x1fff FORMAT "%8.3" ECU_ADDRESS 0x600141E2 /end MEASUREMENT
/begin MEASUREMENT DINH_nrActvInhReas.FId_ComGwIMG6Mon "Number of active inhibit reasons for the FIds / Number of active inhibit reasons for FId_ComGwIMG6Mon" UWORD DINH_ct_Compu 1 100 -4095.000 4096.000 BIT_MASK 0x1fff FORMAT "%8.3" ECU_ADDRESS 0x600141E4 /end MEASUREMENT
/begin MEASUREMENT DINH_nrActvInhReas.FId_ComHFMSnsrErr "Number of active inhibit reasons for the FIds / Number of active inhibit reasons for FId_ComHFMSnsrErr" UWORD DINH_ct_Compu 1 100 -4095.000 4096.000 BIT_MASK 0x1fff FORMAT "%8.3" ECU_ADDRESS 0x600141E6 /end MEASUREMENT
/begin MEASUREMENT DINH_nrActvInhReas.FId_ComIDASB "Number of active inhibit reasons for the FIds / Number of active inhibit reasons for FId_ComIDASB" UWORD DINH_ct_Compu 1 100 -4095.000 4096.000 BIT_MASK 0x1fff FORMAT "%8.3" ECU_ADDRESS 0x600141E8 /end MEASUREMENT
/begin MEASUREMENT DINH_nrActvInhReas.FId_ComIDASBMon "Number of active inhibit reasons for the FIds / Number of active inhibit reasons for FId_ComIDASBMon" UWORD DINH_ct_Compu 1 100 -4095.000 4096.000 BIT_MASK 0x1fff FORMAT "%8.3" ECU_ADDRESS 0x600141EA /end MEASUREMENT
/begin MEASUREMENT DINH_nrActvInhReas.FId_ComIDASBUnitCfmdErr "Number of active inhibit reasons for the FIds / Number of active inhibit reasons for FId_ComIDASBUnitCfmdErr" UWORD DINH_ct_Compu 1 100 -4095.000 4096.000 BIT_MASK 0x1fff FORMAT "%8.3" ECU_ADDRESS 0x600141EC /end MEASUREMENT
/begin MEASUREMENT DINH_nrActvInhReas.FId_ComIDASBUnitNotTstd "Number of active inhibit reasons for the FIds / Number of active inhibit reasons for FId_ComIDASBUnitNotTstd" UWORD DINH_ct_Compu 1 100 -4095.000 4096.000 BIT_MASK 0x1fff FORMAT "%8.3" ECU_ADDRESS 0x600141EE /end MEASUREMENT
/begin MEASUREMENT DINH_nrActvInhReas.FId_ComIDASEngFail "Number of active inhibit reasons for the FIds / Number of active inhibit reasons for FId_ComIDASEngFail" UWORD DINH_ct_Compu 1 100 -4095.000 4096.000 BIT_MASK 0x1fff FORMAT "%8.3" ECU_ADDRESS 0x600141F0 /end MEASUREMENT
/begin MEASUREMENT DINH_nrActvInhReas.FId_ComIDASEngFailMil "Number of active inhibit reasons for the FIds / Number of active inhibit reasons for FId_ComIDASEngFailMil" UWORD DINH_ct_Compu 1 100 -4095.000 4096.000 BIT_MASK 0x1fff FORMAT "%8.3" ECU_ADDRESS 0x600141F2 /end MEASUREMENT
/begin MEASUREMENT DINH_nrActvInhReas.FId_ComIMGUnitCfmdErr "Number of active inhibit reasons for the FIds / Number of active inhibit reasons for FId_ComIMGUnitCfmdErr" UWORD DINH_ct_Compu 1 100 -4095.000 4096.000 BIT_MASK 0x1fff FORMAT "%8.3" ECU_ADDRESS 0x600141F4 /end MEASUREMENT
/begin MEASUREMENT DINH_nrActvInhReas.FId_ComIMGUnitNotTstd "Number of active inhibit reasons for the FIds / Number of active inhibit reasons for FId_ComIMGUnitNotTstd" UWORD DINH_ct_Compu 1 100 -4095.000 4096.000 BIT_MASK 0x1fff FORMAT "%8.3" ECU_ADDRESS 0x600141F6 /end MEASUREMENT
/begin MEASUREMENT DINH_nrActvInhReas.FId_ComISG2 "Number of active inhibit reasons for the FIds / Number of active inhibit reasons for FId_ComISG2" UWORD DINH_ct_Compu 1 100 -4095.000 4096.000 BIT_MASK 0x1fff FORMAT "%8.3" ECU_ADDRESS 0x600141F8 /end MEASUREMENT
/begin MEASUREMENT DINH_nrActvInhReas.FId_ComIgnCtrl "Number of active inhibit reasons for the FIds / Number of active inhibit reasons for FId_ComIgnCtrl" UWORD DINH_ct_Compu 1 100 -4095.000 4096.000 BIT_MASK 0x1fff FORMAT "%8.3" ECU_ADDRESS 0x600141FA /end MEASUREMENT
/begin MEASUREMENT DINH_nrActvInhReas.FId_ComInjCtrl "Number of active inhibit reasons for the FIds / Number of active inhibit reasons for FId_ComInjCtrl" UWORD DINH_ct_Compu 1 100 -4095.000 4096.000 BIT_MASK 0x1fff FORMAT "%8.3" ECU_ADDRESS 0x600141FC /end MEASUREMENT
/begin MEASUREMENT DINH_nrActvInhReas.FId_ComIntkAirPSnsrErr "Number of active inhibit reasons for the FIds / Number of active inhibit reasons for FId_ComIntkAirPSnsrErr" UWORD DINH_ct_Compu 1 100 -4095.000 4096.000 BIT_MASK 0x1fff FORMAT "%8.3" ECU_ADDRESS 0x600141FE /end MEASUREMENT
/begin MEASUREMENT DINH_nrActvInhReas.FId_ComLamCtrl "Number of active inhibit reasons for the FIds / Number of active inhibit reasons for FId_ComLamCtrl" UWORD DINH_ct_Compu 1 100 -4095.000 4096.000 BIT_MASK 0x1fff FORMAT "%8.3" ECU_ADDRESS 0x60014200 /end MEASUREMENT
/begin MEASUREMENT DINH_nrActvInhReas.FId_ComMETA "Number of active inhibit reasons for the FIds / Number of active inhibit reasons for FId_ComMETA" UWORD DINH_ct_Compu 1 100 -4095.000 4096.000 BIT_MASK 0x1fff FORMAT "%8.3" ECU_ADDRESS 0x60014202 /end MEASUREMENT
/begin MEASUREMENT DINH_nrActvInhReas.FId_ComMETAMon "Number of active inhibit reasons for the FIds / Number of active inhibit reasons for FId_ComMETAMon" UWORD DINH_ct_Compu 1 100 -4095.000 4096.000 BIT_MASK 0x1fff FORMAT "%8.3" ECU_ADDRESS 0x60014204 /end MEASUREMENT
/begin MEASUREMENT DINH_nrActvInhReas.FId_ComMETC "Number of active inhibit reasons for the FIds / Number of active inhibit reasons for FId_ComMETC" UWORD DINH_ct_Compu 1 100 -4095.000 4096.000 BIT_MASK 0x1fff FORMAT "%8.3" ECU_ADDRESS 0x60014206 /end MEASUREMENT
/begin MEASUREMENT DINH_nrActvInhReas.FId_ComMETCMon "Number of active inhibit reasons for the FIds / Number of active inhibit reasons for FId_ComMETCMon" UWORD DINH_ct_Compu 1 100 -4095.000 4096.000 BIT_MASK 0x1fff FORMAT "%8.3" ECU_ADDRESS 0x60014208 /end MEASUREMENT
/begin MEASUREMENT DINH_nrActvInhReas.FId_ComMETD "Number of active inhibit reasons for the FIds / Number of active inhibit reasons for FId_ComMETD" UWORD DINH_ct_Compu 1 100 -4095.000 4096.000 BIT_MASK 0x1fff FORMAT "%8.3" ECU_ADDRESS 0x6001420A /end MEASUREMENT
/begin MEASUREMENT DINH_nrActvInhReas.FId_ComMETDMon "Number of active inhibit reasons for the FIds / Number of active inhibit reasons for FId_ComMETDMon" UWORD DINH_ct_Compu 1 100 -4095.000 4096.000 BIT_MASK 0x1fff FORMAT "%8.3" ECU_ADDRESS 0x6001420C /end MEASUREMENT
/begin MEASUREMENT DINH_nrActvInhReas.FId_ComMETE2 "Number of active inhibit reasons for the FIds / Number of active inhibit reasons for FId_ComMETE2" UWORD DINH_ct_Compu 1 100 -4095.000 4096.000 BIT_MASK 0x1fff FORMAT "%8.3" ECU_ADDRESS 0x6001420E /end MEASUREMENT
/begin MEASUREMENT DINH_nrActvInhReas.FId_ComMETE2Mon "Number of active inhibit reasons for the FIds / Number of active inhibit reasons for FId_ComMETE2Mon" UWORD DINH_ct_Compu 1 100 -4095.000 4096.000 BIT_MASK 0x1fff FORMAT "%8.3" ECU_ADDRESS 0x60014210 /end MEASUREMENT
/begin MEASUREMENT DINH_nrActvInhReas.FId_ComMETF "Number of active inhibit reasons for the FIds / Number of active inhibit reasons for FId_ComMETF" UWORD DINH_ct_Compu 1 100 -4095.000 4096.000 BIT_MASK 0x1fff FORMAT "%8.3" ECU_ADDRESS 0x60014212 /end MEASUREMENT
/begin MEASUREMENT DINH_nrActvInhReas.FId_ComMETFMon "Number of active inhibit reasons for the FIds / Number of active inhibit reasons for FId_ComMETFMon" UWORD DINH_ct_Compu 1 100 -4095.000 4096.000 BIT_MASK 0x1fff FORMAT "%8.3" ECU_ADDRESS 0x60014214 /end MEASUREMENT
/begin MEASUREMENT DINH_nrActvInhReas.FId_ComMETG "Number of active inhibit reasons for the FIds / Number of active inhibit reasons for FId_ComMETG" UWORD DINH_ct_Compu 1 100 -4095.000 4096.000 BIT_MASK 0x1fff FORMAT "%8.3" ECU_ADDRESS 0x60014216 /end MEASUREMENT
/begin MEASUREMENT DINH_nrActvInhReas.FId_ComMETGMon "Number of active inhibit reasons for the FIds / Number of active inhibit reasons for FId_ComMETGMon" UWORD DINH_ct_Compu 1 100 -4095.000 4096.000 BIT_MASK 0x1fff FORMAT "%8.3" ECU_ADDRESS 0x60014218 /end MEASUREMENT
/begin MEASUREMENT DINH_nrActvInhReas.FId_ComMETH "Number of active inhibit reasons for the FIds / Number of active inhibit reasons for FId_ComMETH" UWORD DINH_ct_Compu 1 100 -4095.000 4096.000 BIT_MASK 0x1fff FORMAT "%8.3" ECU_ADDRESS 0x6001421A /end MEASUREMENT
/begin MEASUREMENT DINH_nrActvInhReas.FId_ComMETH2 "Number of active inhibit reasons for the FIds / Number of active inhibit reasons for FId_ComMETH2" UWORD DINH_ct_Compu 1 100 -4095.000 4096.000 BIT_MASK 0x1fff FORMAT "%8.3" ECU_ADDRESS 0x6001421C /end MEASUREMENT
/begin MEASUREMENT DINH_nrActvInhReas.FId_ComMETH2Mon "Number of active inhibit reasons for the FIds / Number of active inhibit reasons for FId_ComMETH2Mon" UWORD DINH_ct_Compu 1 100 -4095.000 4096.000 BIT_MASK 0x1fff FORMAT "%8.3" ECU_ADDRESS 0x6001421E /end MEASUREMENT
/begin MEASUREMENT DINH_nrActvInhReas.FId_ComMETHMon "Number of active inhibit reasons for the FIds / Number of active inhibit reasons for FId_ComMETHMon" UWORD DINH_ct_Compu 1 100 -4095.000 4096.000 BIT_MASK 0x1fff FORMAT "%8.3" ECU_ADDRESS 0x60014220 /end MEASUREMENT
/begin MEASUREMENT DINH_nrActvInhReas.FId_ComMETI "Number of active inhibit reasons for the FIds / Number of active inhibit reasons for FId_ComMETI" UWORD DINH_ct_Compu 1 100 -4095.000 4096.000 BIT_MASK 0x1fff FORMAT "%8.3" ECU_ADDRESS 0x60014222 /end MEASUREMENT
/begin MEASUREMENT DINH_nrActvInhReas.FId_ComMETIMon "Number of active inhibit reasons for the FIds / Number of active inhibit reasons for FId_ComMETIMon" UWORD DINH_ct_Compu 1 100 -4095.000 4096.000 BIT_MASK 0x1fff FORMAT "%8.3" ECU_ADDRESS 0x60014224 /end MEASUREMENT
/begin MEASUREMENT DINH_nrActvInhReas.FId_ComMETK "Number of active inhibit reasons for the FIds / Number of active inhibit reasons for FId_ComMETK" UWORD DINH_ct_Compu 1 100 -4095.000 4096.000 BIT_MASK 0x1fff FORMAT "%8.3" ECU_ADDRESS 0x60014226 /end MEASUREMENT
/begin MEASUREMENT DINH_nrActvInhReas.FId_ComMETKMon "Number of active inhibit reasons for the FIds / Number of active inhibit reasons for FId_ComMETKMon" UWORD DINH_ct_Compu 1 100 -4095.000 4096.000 BIT_MASK 0x1fff FORMAT "%8.3" ECU_ADDRESS 0x60014228 /end MEASUREMENT
/begin MEASUREMENT DINH_nrActvInhReas.FId_ComMETL "Number of active inhibit reasons for the FIds / Number of active inhibit reasons for FId_ComMETL" UWORD DINH_ct_Compu 1 100 -4095.000 4096.000 BIT_MASK 0x1fff FORMAT "%8.3" ECU_ADDRESS 0x6001422A /end MEASUREMENT
/begin MEASUREMENT DINH_nrActvInhReas.FId_ComMETLMon "Number of active inhibit reasons for the FIds / Number of active inhibit reasons for FId_ComMETLMon" UWORD DINH_ct_Compu 1 100 -4095.000 4096.000 BIT_MASK 0x1fff FORMAT "%8.3" ECU_ADDRESS 0x6001422C /end MEASUREMENT
/begin MEASUREMENT DINH_nrActvInhReas.FId_ComMETM "Number of active inhibit reasons for the FIds / Number of active inhibit reasons for FId_ComMETM" UWORD DINH_ct_Compu 1 100 -4095.000 4096.000 BIT_MASK 0x1fff FORMAT "%8.3" ECU_ADDRESS 0x6001422E /end MEASUREMENT
/begin MEASUREMENT DINH_nrActvInhReas.FId_ComMETMMon "Number of active inhibit reasons for the FIds / Number of active inhibit reasons for FId_ComMETMMon" UWORD DINH_ct_Compu 1 100 -4095.000 4096.000 BIT_MASK 0x1fff FORMAT "%8.3" ECU_ADDRESS 0x60014230 /end MEASUREMENT
/begin MEASUREMENT DINH_nrActvInhReas.FId_ComMETN "Number of active inhibit reasons for the FIds / Number of active inhibit reasons for FId_ComMETN" UWORD DINH_ct_Compu 1 100 -4095.000 4096.000 BIT_MASK 0x1fff FORMAT "%8.3" ECU_ADDRESS 0x60014232 /end MEASUREMENT
/begin MEASUREMENT DINH_nrActvInhReas.FId_ComMETNMon "Number of active inhibit reasons for the FIds / Number of active inhibit reasons for FId_ComMETNMon" UWORD DINH_ct_Compu 1 100 -4095.000 4096.000 BIT_MASK 0x1fff FORMAT "%8.3" ECU_ADDRESS 0x60014234 /end MEASUREMENT
/begin MEASUREMENT DINH_nrActvInhReas.FId_ComMETUnitCfmdErr "Number of active inhibit reasons for the FIds / Number of active inhibit reasons for FId_ComMETUnitCfmdErr" UWORD DINH_ct_Compu 1 100 -4095.000 4096.000 BIT_MASK 0x1fff FORMAT "%8.3" ECU_ADDRESS 0x60014236 /end MEASUREMENT
/begin MEASUREMENT DINH_nrActvInhReas.FId_ComMETUnitNotTstd "Number of active inhibit reasons for the FIds / Number of active inhibit reasons for FId_ComMETUnitNotTstd" UWORD DINH_ct_Compu 1 100 -4095.000 4096.000 BIT_MASK 0x1fff FORMAT "%8.3" ECU_ADDRESS 0x60014238 /end MEASUREMENT
/begin MEASUREMENT DINH_nrActvInhReas.FId_ComMisf "Number of active inhibit reasons for the FIds / Number of active inhibit reasons for FId_ComMisf" UWORD DINH_ct_Compu 1 100 -4095.000 4096.000 BIT_MASK 0x1fff FORMAT "%8.3" ECU_ADDRESS 0x6001423A /end MEASUREMENT
/begin MEASUREMENT DINH_nrActvInhReas.FId_ComMon "Number of active inhibit reasons for the FIds / Number of active inhibit reasons for FId_ComMon" UWORD DINH_ct_Compu 1 100 -4095.000 4096.000 BIT_MASK 0x1fff FORMAT "%8.3" ECU_ADDRESS 0x6001423C /end MEASUREMENT
/begin MEASUREMENT DINH_nrActvInhReas.FId_ComNTrbn "Number of active inhibit reasons for the FIds / Number of active inhibit reasons for FId_ComNTrbn" UWORD DINH_ct_Compu 1 100 -4095.000 4096.000 BIT_MASK 0x1fff FORMAT "%8.3" ECU_ADDRESS 0x6001423E /end MEASUREMENT
/begin MEASUREMENT DINH_nrActvInhReas.FId_ComODOff "Number of active inhibit reasons for the FIds / Number of active inhibit reasons for FId_ComODOff" UWORD DINH_ct_Compu 1 100 -4095.000 4096.000 BIT_MASK 0x1fff FORMAT "%8.3" ECU_ADDRESS 0x60014240 /end MEASUREMENT
/begin MEASUREMENT DINH_nrActvInhReas.FId_ComOilLvlLamp "Number of active inhibit reasons for the FIds / Number of active inhibit reasons for FId_ComOilLvlLamp" UWORD DINH_ct_Compu 1 100 -4095.000 4096.000 BIT_MASK 0x1fff FORMAT "%8.3" ECU_ADDRESS 0x60014242 /end MEASUREMENT
/begin MEASUREMENT DINH_nrActvInhReas.FId_ComOilPWarnLamp "Number of active inhibit reasons for the FIds / Number of active inhibit reasons for FId_ComOilPWarnLamp" UWORD DINH_ct_Compu 1 100 -4095.000 4096.000 BIT_MASK 0x1fff FORMAT "%8.3" ECU_ADDRESS 0x60014244 /end MEASUREMENT
/begin MEASUREMENT DINH_nrActvInhReas.FId_ComPASensFail "Number of active inhibit reasons for the FIds / Number of active inhibit reasons for FId_ComPASensFail" UWORD DINH_ct_Compu 1 100 -4095.000 4096.000 BIT_MASK 0x1fff FORMAT "%8.3" ECU_ADDRESS 0x60014246 /end MEASUREMENT
/begin MEASUREMENT DINH_nrActvInhReas.FId_ComPBSensFail "Number of active inhibit reasons for the FIds / Number of active inhibit reasons for FId_ComPBSensFail" UWORD DINH_ct_Compu 1 100 -4095.000 4096.000 BIT_MASK 0x1fff FORMAT "%8.3" ECU_ADDRESS 0x60014248 /end MEASUREMENT
/begin MEASUREMENT DINH_nrActvInhReas.FId_ComPCU "Number of active inhibit reasons for the FIds / Number of active inhibit reasons for FId_ComPCU" UWORD DINH_ct_Compu 1 100 -4095.000 4096.000 BIT_MASK 0x1fff FORMAT "%8.3" ECU_ADDRESS 0x6001424A /end MEASUREMENT
/begin MEASUREMENT DINH_nrActvInhReas.FId_ComPCUMon "Number of active inhibit reasons for the FIds / Number of active inhibit reasons for FId_ComPCUMon" UWORD DINH_ct_Compu 1 100 -4095.000 4096.000 BIT_MASK 0x1fff FORMAT "%8.3" ECU_ADDRESS 0x6001424C /end MEASUREMENT
/begin MEASUREMENT DINH_nrActvInhReas.FId_ComPosActnSpdLimrFctReq "Number of active inhibit reasons for the FIds / Number of active inhibit reasons for FId_ComPosActnSpdLimrFctReq" UWORD DINH_ct_Compu 1 100 -4095.000 4096.000 BIT_MASK 0x1fff FORMAT "%8.3" ECU_ADDRESS 0x6001424E /end MEASUREMENT
/begin MEASUREMENT DINH_nrActvInhReas.FId_ComSRS "Number of active inhibit reasons for the FIds / Number of active inhibit reasons for FId_ComSRS" UWORD DINH_ct_Compu 1 100 -4095.000 4096.000 BIT_MASK 0x1fff FORMAT "%8.3" ECU_ADDRESS 0x60014250 /end MEASUREMENT
/begin MEASUREMENT DINH_nrActvInhReas.FId_ComSRSA "Number of active inhibit reasons for the FIds / Number of active inhibit reasons for FId_ComSRSA" UWORD DINH_ct_Compu 1 100 -4095.000 4096.000 BIT_MASK 0x1fff FORMAT "%8.3" ECU_ADDRESS 0x60014252 /end MEASUREMENT
/begin MEASUREMENT DINH_nrActvInhReas.FId_ComSRSAMon "Number of active inhibit reasons for the FIds / Number of active inhibit reasons for FId_ComSRSAMon" UWORD DINH_ct_Compu 1 100 -4095.000 4096.000 BIT_MASK 0x1fff FORMAT "%8.3" ECU_ADDRESS 0x60014254 /end MEASUREMENT
/begin MEASUREMENT DINH_nrActvInhReas.FId_ComSRSB "Number of active inhibit reasons for the FIds / Number of active inhibit reasons for FId_ComSRSB" UWORD DINH_ct_Compu 1 100 -4095.000 4096.000 BIT_MASK 0x1fff FORMAT "%8.3" ECU_ADDRESS 0x60014256 /end MEASUREMENT
/begin MEASUREMENT DINH_nrActvInhReas.FId_ComSRSBMon "Number of active inhibit reasons for the FIds / Number of active inhibit reasons for FId_ComSRSBMon" UWORD DINH_ct_Compu 1 100 -4095.000 4096.000 BIT_MASK 0x1fff FORMAT "%8.3" ECU_ADDRESS 0x60014258 /end MEASUREMENT
/begin MEASUREMENT DINH_nrActvInhReas.FId_ComSRSMon "Number of active inhibit reasons for the FIds / Number of active inhibit reasons for FId_ComSRSMon" UWORD DINH_ct_Compu 1 100 -4095.000 4096.000 BIT_MASK 0x1fff FORMAT "%8.3" ECU_ADDRESS 0x6001425A /end MEASUREMENT
/begin MEASUREMENT DINH_nrActvInhReas.FId_ComSRSUnitCfmdErr "Number of active inhibit reasons for the FIds / Number of active inhibit reasons for FId_ComSRSUnitCfmdErr" UWORD DINH_ct_Compu 1 100 -4095.000 4096.000 BIT_MASK 0x1fff FORMAT "%8.3" ECU_ADDRESS 0x6001425C /end MEASUREMENT
/begin MEASUREMENT DINH_nrActvInhReas.FId_ComSRSUnitNotTstd "Number of active inhibit reasons for the FIds / Number of active inhibit reasons for FId_ComSRSUnitNotTstd" UWORD DINH_ct_Compu 1 100 -4095.000 4096.000 BIT_MASK 0x1fff FORMAT "%8.3" ECU_ADDRESS 0x6001425E /end MEASUREMENT
/begin MEASUREMENT DINH_nrActvInhReas.FId_ComSTFlt "Number of active inhibit reasons for the FIds / Number of active inhibit reasons for FId_ComSTFlt" UWORD DINH_ct_Compu 1 100 -4095.000 4096.000 BIT_MASK 0x1fff FORMAT "%8.3" ECU_ADDRESS 0x60014260 /end MEASUREMENT
/begin MEASUREMENT DINH_nrActvInhReas.FId_ComSpdLimrDevActvn "Number of active inhibit reasons for the FIds / Number of active inhibit reasons for FId_ComSpdLimrDevActvn" UWORD DINH_ct_Compu 1 100 -4095.000 4096.000 BIT_MASK 0x1fff FORMAT "%8.3" ECU_ADDRESS 0x60014262 /end MEASUREMENT
/begin MEASUREMENT DINH_nrActvInhReas.FId_ComTCU01 "Number of active inhibit reasons for the FIds / Number of active inhibit reasons for FId_ComTCU01" UWORD DINH_ct_Compu 1 100 -4095.000 4096.000 BIT_MASK 0x1fff FORMAT "%8.3" ECU_ADDRESS 0x60014264 /end MEASUREMENT
/begin MEASUREMENT DINH_nrActvInhReas.FId_ComTCU02 "Number of active inhibit reasons for the FIds / Number of active inhibit reasons for FId_ComTCU02" UWORD DINH_ct_Compu 1 100 -4095.000 4096.000 BIT_MASK 0x1fff FORMAT "%8.3" ECU_ADDRESS 0x60014266 /end MEASUREMENT
/begin MEASUREMENT DINH_nrActvInhReas.FId_ComTCU1 "Number of active inhibit reasons for the FIds / Number of active inhibit reasons for FId_ComTCU1" UWORD DINH_ct_Compu 1 100 -4095.000 4096.000 BIT_MASK 0x1fff FORMAT "%8.3" ECU_ADDRESS 0x60014268 /end MEASUREMENT
/begin MEASUREMENT DINH_nrActvInhReas.FId_ComTCU11 "Number of active inhibit reasons for the FIds / Number of active inhibit reasons for FId_ComTCU11" UWORD DINH_ct_Compu 1 100 -4095.000 4096.000 BIT_MASK 0x1fff FORMAT "%8.3" ECU_ADDRESS 0x6001426A /end MEASUREMENT
/begin MEASUREMENT DINH_nrActvInhReas.FId_ComTCU12 "Number of active inhibit reasons for the FIds / Number of active inhibit reasons for FId_ComTCU12" UWORD DINH_ct_Compu 1 100 -4095.000 4096.000 BIT_MASK 0x1fff FORMAT "%8.3" ECU_ADDRESS 0x6001426C /end MEASUREMENT
/begin MEASUREMENT DINH_nrActvInhReas.FId_ComTCU13 "Number of active inhibit reasons for the FIds / Number of active inhibit reasons for FId_ComTCU13" UWORD DINH_ct_Compu 1 100 -4095.000 4096.000 BIT_MASK 0x1fff FORMAT "%8.3" ECU_ADDRESS 0x6001426E /end MEASUREMENT
/begin MEASUREMENT DINH_nrActvInhReas.FId_ComTCU14 "Number of active inhibit reasons for the FIds / Number of active inhibit reasons for FId_ComTCU14" UWORD DINH_ct_Compu 1 100 -4095.000 4096.000 BIT_MASK 0x1fff FORMAT "%8.3" ECU_ADDRESS 0x60014270 /end MEASUREMENT
/begin MEASUREMENT DINH_nrActvInhReas.FId_ComTCU2 "Number of active inhibit reasons for the FIds / Number of active inhibit reasons for FId_ComTCU2" UWORD DINH_ct_Compu 1 100 -4095.000 4096.000 BIT_MASK 0x1fff FORMAT "%8.3" ECU_ADDRESS 0x60014272 /end MEASUREMENT
/begin MEASUREMENT DINH_nrActvInhReas.FId_ComTCU3 "Number of active inhibit reasons for the FIds / Number of active inhibit reasons for FId_ComTCU3" UWORD DINH_ct_Compu 1 100 -4095.000 4096.000 BIT_MASK 0x1fff FORMAT "%8.3" ECU_ADDRESS 0x60014274 /end MEASUREMENT
/begin MEASUREMENT DINH_nrActvInhReas.FId_ComTCU4 "Number of active inhibit reasons for the FIds / Number of active inhibit reasons for FId_ComTCU4" UWORD DINH_ct_Compu 1 100 -4095.000 4096.000 BIT_MASK 0x1fff FORMAT "%8.3" ECU_ADDRESS 0x60014276 /end MEASUREMENT
/begin MEASUREMENT DINH_nrActvInhReas.FId_ComTCUGear "Number of active inhibit reasons for the FIds / Number of active inhibit reasons for FId_ComTCUGear" UWORD DINH_ct_Compu 1 100 -4095.000 4096.000 BIT_MASK 0x1fff FORMAT "%8.3" ECU_ADDRESS 0x60014278 /end MEASUREMENT
/begin MEASUREMENT DINH_nrActvInhReas.FId_ComTarGearDwnShift "Number of active inhibit reasons for the FIds / Number of active inhibit reasons for FId_ComTarGearDwnShift" UWORD DINH_ct_Compu 1 100 -4095.000 4096.000 BIT_MASK 0x1fff FORMAT "%8.3" ECU_ADDRESS 0x6001427A /end MEASUREMENT
/begin MEASUREMENT DINH_nrActvInhReas.FId_ComTarGearUpShift "Number of active inhibit reasons for the FIds / Number of active inhibit reasons for FId_ComTarGearUpShift" UWORD DINH_ct_Compu 1 100 -4095.000 4096.000 BIT_MASK 0x1fff FORMAT "%8.3" ECU_ADDRESS 0x6001427C /end MEASUREMENT
/begin MEASUREMENT DINH_nrActvInhReas.FId_ComThrPosnFail "Number of active inhibit reasons for the FIds / Number of active inhibit reasons for FId_ComThrPosnFail" UWORD DINH_ct_Compu 1 100 -4095.000 4096.000 BIT_MASK 0x1fff FORMAT "%8.3" ECU_ADDRESS 0x6001427E /end MEASUREMENT
/begin MEASUREMENT DINH_nrActvInhReas.FId_ComThrVlv "Number of active inhibit reasons for the FIds / Number of active inhibit reasons for FId_ComThrVlv" UWORD DINH_ct_Compu 1 100 -4095.000 4096.000 BIT_MASK 0x1fff FORMAT "%8.3" ECU_ADDRESS 0x60014280 /end MEASUREMENT
/begin MEASUREMENT DINH_nrActvInhReas.FId_ComTrboChrgnErr "Number of active inhibit reasons for the FIds / Number of active inhibit reasons for FId_ComTrboChrgnErr" UWORD DINH_ct_Compu 1 100 -4095.000 4096.000 BIT_MASK 0x1fff FORMAT "%8.3" ECU_ADDRESS 0x60014282 /end MEASUREMENT
/begin MEASUREMENT DINH_nrActvInhReas.FId_ComTrqAccuracySlow "Number of active inhibit reasons for the FIds / Number of active inhibit reasons for FId_ComTrqAccuracySlow" UWORD DINH_ct_Compu 1 100 -4095.000 4096.000 BIT_MASK 0x1fff FORMAT "%8.3" ECU_ADDRESS 0x60014284 /end MEASUREMENT
/begin MEASUREMENT DINH_nrActvInhReas.FId_ComTrqReqFast "Number of active inhibit reasons for the FIds / Number of active inhibit reasons for FId_ComTrqReqFast" UWORD DINH_ct_Compu 1 100 -4095.000 4096.000 BIT_MASK 0x1fff FORMAT "%8.3" ECU_ADDRESS 0x60014286 /end MEASUREMENT
/begin MEASUREMENT DINH_nrActvInhReas.FId_ComTrqReqSlow "Number of active inhibit reasons for the FIds / Number of active inhibit reasons for FId_ComTrqReqSlow" UWORD DINH_ct_Compu 1 100 -4095.000 4096.000 BIT_MASK 0x1fff FORMAT "%8.3" ECU_ADDRESS 0x60014288 /end MEASUREMENT
/begin MEASUREMENT DINH_nrActvInhReas.FId_ComVSAErr "Number of active inhibit reasons for the FIds / Number of active inhibit reasons for FId_ComVSAErr" UWORD DINH_ct_Compu 1 100 -4095.000 4096.000 BIT_MASK 0x1fff FORMAT "%8.3" ECU_ADDRESS 0x6001428A /end MEASUREMENT
/begin MEASUREMENT DINH_nrActvInhReas.FId_ComVSAUnitCfmdErr "Number of active inhibit reasons for the FIds / Number of active inhibit reasons for FId_ComVSAUnitCfmdErr" UWORD DINH_ct_Compu 1 100 -4095.000 4096.000 BIT_MASK 0x1fff FORMAT "%8.3" ECU_ADDRESS 0x6001428C /end MEASUREMENT
/begin MEASUREMENT DINH_nrActvInhReas.FId_ComVSAUnitNotTstd "Number of active inhibit reasons for the FIds / Number of active inhibit reasons for FId_ComVSAUnitNotTstd" UWORD DINH_ct_Compu 1 100 -4095.000 4096.000 BIT_MASK 0x1fff FORMAT "%8.3" ECU_ADDRESS 0x6001428E /end MEASUREMENT
/begin MEASUREMENT DINH_nrActvInhReas.FId_ComVehSpdFlLvl "Number of active inhibit reasons for the FIds / Number of active inhibit reasons for FId_ComVehSpdFlLvl" UWORD DINH_ct_Compu 1 100 -4095.000 4096.000 BIT_MASK 0x1fff FORMAT "%8.3" ECU_ADDRESS 0x60014290 /end MEASUREMENT
/begin MEASUREMENT DINH_nrActvInhReas.FId_ComVehSpdFltChk "Number of active inhibit reasons for the FIds / Number of active inhibit reasons for FId_ComVehSpdFltChk" UWORD DINH_ct_Compu 1 100 -4095.000 4096.000 BIT_MASK 0x1fff FORMAT "%8.3" ECU_ADDRESS 0x60014292 /end MEASUREMENT
/begin MEASUREMENT DINH_nrActvInhReas.FId_ComVehSpdImpsErr "Number of active inhibit reasons for the FIds / Number of active inhibit reasons for FId_ComVehSpdImpsErr" UWORD DINH_ct_Compu 1 100 -4095.000 4096.000 BIT_MASK 0x1fff FORMAT "%8.3" ECU_ADDRESS 0x60014294 /end MEASUREMENT
/begin MEASUREMENT DINH_nrActvInhReas.FId_ComVlvLftCtrl "Number of active inhibit reasons for the FIds / Number of active inhibit reasons for FId_ComVlvLftCtrl" UWORD DINH_ct_Compu 1 100 -4095.000 4096.000 BIT_MASK 0x1fff FORMAT "%8.3" ECU_ADDRESS 0x60014296 /end MEASUREMENT
/begin MEASUREMENT DINH_nrActvInhReas.FId_ComvolEng "Number of active inhibit reasons for the FIds / Number of active inhibit reasons for FId_ComvolEng" UWORD DINH_ct_Compu 1 100 -4095.000 4096.000 BIT_MASK 0x1fff FORMAT "%8.3" ECU_ADDRESS 0x60014298 /end MEASUREMENT
/begin MEASUREMENT DINH_nrActvInhReas.FId_ConvLdCalcLvrPos "Number of active inhibit reasons for the FIds / Number of active inhibit reasons for FId_ConvLdCalcLvrPos" UWORD DINH_ct_Compu 1 100 -4095.000 4096.000 BIT_MASK 0x1fff FORMAT "%8.3" ECU_ADDRESS 0x6001429A /end MEASUREMENT
/begin MEASUREMENT DINH_nrActvInhReas.FId_ConvLdNTrbnCan "Number of active inhibit reasons for the FIds / Number of active inhibit reasons for FId_ConvLdNTrbnCan" UWORD DINH_ct_Compu 1 100 -4095.000 4096.000 BIT_MASK 0x1fff FORMAT "%8.3" ECU_ADDRESS 0x6001429C /end MEASUREMENT
/begin MEASUREMENT DINH_nrActvInhReas.FId_ConvLdOilCoolrPmp "Number of active inhibit reasons for the FIds / Number of active inhibit reasons for FId_ConvLdOilCoolrPmp" UWORD DINH_ct_Compu 1 100 -4095.000 4096.000 BIT_MASK 0x1fff FORMAT "%8.3" ECU_ADDRESS 0x6001429E /end MEASUREMENT
/begin MEASUREMENT DINH_nrActvInhReas.FId_ConvLdOilTemp "Number of active inhibit reasons for the FIds / Number of active inhibit reasons for FId_ConvLdOilTemp" UWORD DINH_ct_Compu 1 100 -4095.000 4096.000 BIT_MASK 0x1fff FORMAT "%8.3" ECU_ADDRESS 0x600142A0 /end MEASUREMENT
/begin MEASUREMENT DINH_nrActvInhReas.FId_ConvLdTrqLdCan "Number of active inhibit reasons for the FIds / Number of active inhibit reasons for FId_ConvLdTrqLdCan" UWORD DINH_ct_Compu 1 100 -4095.000 4096.000 BIT_MASK 0x1fff FORMAT "%8.3" ECU_ADDRESS 0x600142A2 /end MEASUREMENT
/begin MEASUREMENT DINH_nrActvInhReas.FId_ConvLdVel "Number of active inhibit reasons for the FIds / Number of active inhibit reasons for FId_ConvLdVel" UWORD DINH_ct_Compu 1 100 -4095.000 4096.000 BIT_MASK 0x1fff FORMAT "%8.3" ECU_ADDRESS 0x600142A4 /end MEASUREMENT
/begin MEASUREMENT DINH_nrActvInhReas.FId_CooltTVldyTMdl "Number of active inhibit reasons for the FIds / Number of active inhibit reasons for FId_CooltTVldyTMdl" UWORD DINH_ct_Compu 1 100 -4095.000 4096.000 BIT_MASK 0x1fff FORMAT "%8.3" ECU_ADDRESS 0x600142A6 /end MEASUREMENT
/begin MEASUREMENT DINH_nrActvInhReas.FId_CptProtnCamsft "Number of active inhibit reasons for the FIds / Number of active inhibit reasons for FId_CptProtnCamsft" UWORD DINH_ct_Compu 1 100 -4095.000 4096.000 BIT_MASK 0x1fff FORMAT "%8.3" ECU_ADDRESS 0x600142A8 /end MEASUREMENT
/begin MEASUREMENT DINH_nrActvInhReas.FId_CptProtnExhTempMdl "Number of active inhibit reasons for the FIds / Number of active inhibit reasons for FId_CptProtnExhTempMdl" UWORD DINH_ct_Compu 1 100 -4095.000 4096.000 BIT_MASK 0x1fff FORMAT "%8.3" ECU_ADDRESS 0x600142AA /end MEASUREMENT
/begin MEASUREMENT DINH_nrActvInhReas.FId_CptProtnO2SnsrB1 "Number of active inhibit reasons for the FIds / Number of active inhibit reasons for FId_CptProtnO2SnsrB1" UWORD DINH_ct_Compu 1 100 -4095.000 4096.000 BIT_MASK 0x1fff FORMAT "%8.3" ECU_ADDRESS 0x600142AC /end MEASUREMENT
/begin MEASUREMENT DINH_nrActvInhReas.FId_CptProtnVVeh "Number of active inhibit reasons for the FIds / Number of active inhibit reasons for FId_CptProtnVVeh" UWORD DINH_ct_Compu 1 100 -4095.000 4096.000 BIT_MASK 0x1fff FORMAT "%8.3" ECU_ADDRESS 0x600142AE /end MEASUREMENT
/begin MEASUREMENT DINH_nrActvInhReas.FId_CrCUI1EFRxErr "Number of active inhibit reasons for the FIds / Number of active inhibit reasons for FId_CrCUI1EFRxErr" UWORD DINH_ct_Compu 1 100 -4095.000 4096.000 BIT_MASK 0x1fff FORMAT "%8.3" ECU_ADDRESS 0x600142B0 /end MEASUREMENT
/begin MEASUREMENT DINH_nrActvInhReas.FId_CrCUICANRxErr "Number of active inhibit reasons for the FIds / Number of active inhibit reasons for FId_CrCUICANRxErr" UWORD DINH_ct_Compu 1 100 -4095.000 4096.000 BIT_MASK 0x1fff FORMAT "%8.3" ECU_ADDRESS 0x600142B2 /end MEASUREMENT
/begin MEASUREMENT DINH_nrActvInhReas.FId_CrCUIFCMRxErr "Number of active inhibit reasons for the FIds / Number of active inhibit reasons for FId_CrCUIFCMRxErr" UWORD DINH_ct_Compu 1 100 -4095.000 4096.000 BIT_MASK 0x1fff FORMAT "%8.3" ECU_ADDRESS 0x600142B4 /end MEASUREMENT
/begin MEASUREMENT DINH_nrActvInhReas.FId_CrCUIMETDRxErr "Number of active inhibit reasons for the FIds / Number of active inhibit reasons for FId_CrCUIMETDRxErr" UWORD DINH_ct_Compu 1 100 -4095.000 4096.000 BIT_MASK 0x1fff FORMAT "%8.3" ECU_ADDRESS 0x600142B6 /end MEASUREMENT
/begin MEASUREMENT DINH_nrActvInhReas.FId_CrCtlACCRxErr "Number of active inhibit reasons for the FIds / Number of active inhibit reasons for FId_CrCtlACCRxErr" UWORD DINH_ct_Compu 1 100 -4095.000 4096.000 BIT_MASK 0x1fff FORMAT "%8.3" ECU_ADDRESS 0x600142B8 /end MEASUREMENT
/begin MEASUREMENT DINH_nrActvInhReas.FId_CrCtlAppSnsrErr "Number of active inhibit reasons for the FIds / Number of active inhibit reasons for FId_CrCtlAppSnsrErr" UWORD DINH_ct_Compu 1 100 -4095.000 4096.000 BIT_MASK 0x1fff FORMAT "%8.3" ECU_ADDRESS 0x600142BA /end MEASUREMENT
/begin MEASUREMENT DINH_nrActvInhReas.FId_CrCtlShutOffEng "Number of active inhibit reasons for the FIds / Number of active inhibit reasons for FId_CrCtlShutOffEng" UWORD DINH_ct_Compu 1 100 -4095.000 4096.000 BIT_MASK 0x1fff FORMAT "%8.3" ECU_ADDRESS 0x600142BC /end MEASUREMENT
/begin MEASUREMENT DINH_nrActvInhReas.FId_CstrPurgGnrlTstrReq "Number of active inhibit reasons for the FIds / Number of active inhibit reasons for FId_CstrPurgGnrlTstrReq" UWORD DINH_ct_Compu 1 100 -4095.000 4096.000 BIT_MASK 0x1fff FORMAT "%8.3" ECU_ADDRESS 0x600142BE /end MEASUREMENT
/begin MEASUREMENT DINH_nrActvInhReas.FId_DAGRS "Number of active inhibit reasons for the FIds / Number of active inhibit reasons for FId_DAGRS" UWORD DINH_ct_Compu 1 100 -4095.000 4096.000 BIT_MASK 0x1fff FORMAT "%8.3" ECU_ADDRESS 0x600142C0 /end MEASUREMENT
/begin MEASUREMENT DINH_nrActvInhReas.FId_DELibBrkBstP "Number of active inhibit reasons for the FIds / Number of active inhibit reasons for FId_DELibBrkBstP" UWORD DINH_ct_Compu 1 100 -4095.000 4096.000 BIT_MASK 0x1fff FORMAT "%8.3" ECU_ADDRESS 0x600142C2 /end MEASUREMENT
/begin MEASUREMENT DINH_nrActvInhReas.FId_DELibCEngDsT "Number of active inhibit reasons for the FIds / Number of active inhibit reasons for FId_DELibCEngDsT" UWORD DINH_ct_Compu 1 100 -4095.000 4096.000 BIT_MASK 0x1fff FORMAT "%8.3" ECU_ADDRESS 0x600142C4 /end MEASUREMENT
/begin MEASUREMENT DINH_nrActvInhReas.FId_DELibCEngUsT "Number of active inhibit reasons for the FIds / Number of active inhibit reasons for FId_DELibCEngUsT" UWORD DINH_ct_Compu 1 100 -4095.000 4096.000 BIT_MASK 0x1fff FORMAT "%8.3" ECU_ADDRESS 0x600142C6 /end MEASUREMENT
/begin MEASUREMENT DINH_nrActvInhReas.FId_DELibEngDatEng "Number of active inhibit reasons for the FIds / Number of active inhibit reasons for FId_DELibEngDatEng" UWORD DINH_ct_Compu 1 100 -4095.000 4096.000 BIT_MASK 0x1fff FORMAT "%8.3" ECU_ADDRESS 0x600142C8 /end MEASUREMENT
/begin MEASUREMENT DINH_nrActvInhReas.FId_DELibEnvP "Number of active inhibit reasons for the FIds / Number of active inhibit reasons for FId_DELibEnvP" UWORD DINH_ct_Compu 1 100 -4095.000 4096.000 BIT_MASK 0x1fff FORMAT "%8.3" ECU_ADDRESS 0x600142CA /end MEASUREMENT
/begin MEASUREMENT DINH_nrActvInhReas.FId_DELibEnvT "Number of active inhibit reasons for the FIds / Number of active inhibit reasons for FId_DELibEnvT" UWORD DINH_ct_Compu 1 100 -4095.000 4096.000 BIT_MASK 0x1fff FORMAT "%8.3" ECU_ADDRESS 0x600142CC /end MEASUREMENT
/begin MEASUREMENT DINH_nrActvInhReas.FId_DELibFuelT "Number of active inhibit reasons for the FIds / Number of active inhibit reasons for FId_DELibFuelT" UWORD DINH_ct_Compu 1 100 -4095.000 4096.000 BIT_MASK 0x1fff FORMAT "%8.3" ECU_ADDRESS 0x600142CE /end MEASUREMENT
/begin MEASUREMENT DINH_nrActvInhReas.FId_DELibIntkAirT "Number of active inhibit reasons for the FIds / Number of active inhibit reasons for FId_DELibIntkAirT" UWORD DINH_ct_Compu 1 100 -4095.000 4096.000 BIT_MASK 0x1fff FORMAT "%8.3" ECU_ADDRESS 0x600142D0 /end MEASUREMENT
/begin MEASUREMENT DINH_nrActvInhReas.FId_DELibNRCat "Number of active inhibit reasons for the FIds / Number of active inhibit reasons for FId_DELibNRCat" UWORD DINH_ct_Compu 1 100 -4095.000 4096.000 BIT_MASK 0x1fff FORMAT "%8.3" ECU_ADDRESS 0x600142D2 /end MEASUREMENT
/begin MEASUREMENT DINH_nrActvInhReas.FId_DELibOilP "Number of active inhibit reasons for the FIds / Number of active inhibit reasons for FId_DELibOilP" UWORD DINH_ct_Compu 1 100 -4095.000 4096.000 BIT_MASK 0x1fff FORMAT "%8.3" ECU_ADDRESS 0x600142D4 /end MEASUREMENT
/begin MEASUREMENT DINH_nrActvInhReas.FId_DELibOilSwmpT "Number of active inhibit reasons for the FIds / Number of active inhibit reasons for FId_DELibOilSwmpT" UWORD DINH_ct_Compu 1 100 -4095.000 4096.000 BIT_MASK 0x1fff FORMAT "%8.3" ECU_ADDRESS 0x600142D6 /end MEASUREMENT
/begin MEASUREMENT DINH_nrActvInhReas.FId_DELibPRelPfilDs "Number of active inhibit reasons for the FIds / Number of active inhibit reasons for FId_DELibPRelPfilDs" UWORD DINH_ct_Compu 1 100 -4095.000 4096.000 BIT_MASK 0x1fff FORMAT "%8.3" ECU_ADDRESS 0x600142D8 /end MEASUREMENT
/begin MEASUREMENT DINH_nrActvInhReas.FId_DELibTEGRClrLPDs "Number of active inhibit reasons for the FIds / Number of active inhibit reasons for FId_DELibTEGRClrLPDs" UWORD DINH_ct_Compu 1 100 -4095.000 4096.000 BIT_MASK 0x1fff FORMAT "%8.3" ECU_ADDRESS 0x600142DA /end MEASUREMENT
/begin MEASUREMENT DINH_nrActvInhReas.FId_DEONVEBPEnv "Number of active inhibit reasons for the FIds / Number of active inhibit reasons for FId_DEONVEBPEnv" UWORD DINH_ct_Compu 1 100 -4095.000 4096.000 BIT_MASK 0x1fff FORMAT "%8.3" ECU_ADDRESS 0x600142DC /end MEASUREMENT
/begin MEASUREMENT DINH_nrActvInhReas.FId_DEONVTCCpv1DteskLoLoadStuckClsd "Number of active inhibit reasons for the FIds / Number of active inhibit reasons for FId_DEONVTCCpv1DteskLoLoadStuckClsd" UWORD DINH_ct_Compu 1 100 -4095.000 4096.000 BIT_MASK 0x1fff FORMAT "%8.3" ECU_ADDRESS 0x600142DE /end MEASUREMENT
/begin MEASUREMENT DINH_nrActvInhReas.FId_DEONVTCCpv1DteskLoLoadStuckOpen "Number of active inhibit reasons for the FIds / Number of active inhibit reasons for FId_DEONVTCCpv1DteskLoLoadStuckOpen" UWORD DINH_ct_Compu 1 100 -4095.000 4096.000 BIT_MASK 0x1fff FORMAT "%8.3" ECU_ADDRESS 0x600142E0 /end MEASUREMENT
/begin MEASUREMENT DINH_nrActvInhReas.FId_DIUMPRCldStrtMon "Number of active inhibit reasons for the FIds / Number of active inhibit reasons for FId_DIUMPRCldStrtMon" UWORD DINH_ct_Compu 1 100 -4095.000 4096.000 BIT_MASK 0x1fff FORMAT "%8.3" ECU_ADDRESS 0x600142E2 /end MEASUREMENT
/begin MEASUREMENT DINH_nrActvInhReas.FId_DIUMPREvapMon "Number of active inhibit reasons for the FIds / Number of active inhibit reasons for FId_DIUMPREvapMon" UWORD DINH_ct_Compu 1 100 -4095.000 4096.000 BIT_MASK 0x1fff FORMAT "%8.3" ECU_ADDRESS 0x600142E4 /end MEASUREMENT
/begin MEASUREMENT DINH_nrActvInhReas.FId_DIUMPRGenDenom1 "Number of active inhibit reasons for the FIds / Number of active inhibit reasons for FId_DIUMPRGenDenom1" UWORD DINH_ct_Compu 1 100 -4095.000 4096.000 BIT_MASK 0x1fff FORMAT "%8.3" ECU_ADDRESS 0x600142E6 /end MEASUREMENT
/begin MEASUREMENT DINH_nrActvInhReas.FId_DIUMPRGenDenom1PDTC "Number of active inhibit reasons for the FIds / Number of active inhibit reasons for FId_DIUMPRGenDenom1PDTC" UWORD DINH_ct_Compu 1 100 -4095.000 4096.000 BIT_MASK 0x1fff FORMAT "%8.3" ECU_ADDRESS 0x600142E8 /end MEASUREMENT
/begin MEASUREMENT DINH_nrActvInhReas.FId_DIUMPRGenDenom2 "Number of active inhibit reasons for the FIds / Number of active inhibit reasons for FId_DIUMPRGenDenom2" UWORD DINH_ct_Compu 1 100 -4095.000 4096.000 BIT_MASK 0x1fff FORMAT "%8.3" ECU_ADDRESS 0x600142EA /end MEASUREMENT
/begin MEASUREMENT DINH_nrActvInhReas.FId_DIUMPRGenDenom3 "Number of active inhibit reasons for the FIds / Number of active inhibit reasons for FId_DIUMPRGenDenom3" UWORD DINH_ct_Compu 1 100 -4095.000 4096.000 BIT_MASK 0x1fff FORMAT "%8.3" ECU_ADDRESS 0x600142EC /end MEASUREMENT
/begin MEASUREMENT DINH_nrActvInhReas.FId_DIUMPRIgn "Number of active inhibit reasons for the FIds / Number of active inhibit reasons for FId_DIUMPRIgn" UWORD DINH_ct_Compu 1 100 -4095.000 4096.000 BIT_MASK 0x1fff FORMAT "%8.3" ECU_ADDRESS 0x600142EE /end MEASUREMENT
/begin MEASUREMENT DINH_nrActvInhReas.FId_DOGov "Number of active inhibit reasons for the FIds / Number of active inhibit reasons for FId_DOGov" UWORD DINH_ct_Compu 1 100 -4095.000 4096.000 BIT_MASK 0x1fff FORMAT "%8.3" ECU_ADDRESS 0x600142F0 /end MEASUREMENT
/begin MEASUREMENT DINH_nrActvInhReas.FId_DSMWarmUpCycle "Number of active inhibit reasons for the FIds / Number of active inhibit reasons for FId_DSMWarmUpCycle" UWORD DINH_ct_Compu 1 100 -4095.000 4096.000 BIT_MASK 0x1fff FORMAT "%8.3" ECU_ADDRESS 0x600142F2 /end MEASUREMENT
/begin MEASUREMENT DINH_nrActvInhReas.FId_DTESKEBCpv1DteskLoLoadStuckClsd "Number of active inhibit reasons for the FIds / Number of active inhibit reasons for FId_DTESKEBCpv1DteskLoLoadStuckClsd" UWORD DINH_ct_Compu 1 100 -4095.000 4096.000 BIT_MASK 0x1fff FORMAT "%8.3" ECU_ADDRESS 0x600142F4 /end MEASUREMENT
/begin MEASUREMENT DINH_nrActvInhReas.FId_DTESKEBCpv1DteskLoLoadStuckOpen "Number of active inhibit reasons for the FIds / Number of active inhibit reasons for FId_DTESKEBCpv1DteskLoLoadStuckOpen" UWORD DINH_ct_Compu 1 100 -4095.000 4096.000 BIT_MASK 0x1fff FORMAT "%8.3" ECU_ADDRESS 0x600142F6 /end MEASUREMENT
/begin MEASUREMENT DINH_nrActvInhReas.FId_DTESKEnvCondVld "Number of active inhibit reasons for the FIds / Number of active inhibit reasons for FId_DTESKEnvCondVld" UWORD DINH_ct_Compu 1 100 -4095.000 4096.000 BIT_MASK 0x1fff FORMAT "%8.3" ECU_ADDRESS 0x600142F8 /end MEASUREMENT
/begin MEASUREMENT DINH_nrActvInhReas.FId_DTESKFuLvlCondVld "Number of active inhibit reasons for the FIds / Number of active inhibit reasons for FId_DTESKFuLvlCondVld" UWORD DINH_ct_Compu 1 100 -4095.000 4096.000 BIT_MASK 0x1fff FORMAT "%8.3" ECU_ADDRESS 0x600142FA /end MEASUREMENT
/begin MEASUREMENT DINH_nrActvInhReas.FId_DTESKvfz "Number of active inhibit reasons for the FIds / Number of active inhibit reasons for FId_DTESKvfz" UWORD DINH_ct_Compu 1 100 -4095.000 4096.000 BIT_MASK 0x1fff FORMAT "%8.3" ECU_ADDRESS 0x600142FC /end MEASUREMENT
/begin MEASUREMENT DINH_nrActvInhReas.FId_DdskvFraTstd "Number of active inhibit reasons for the FIds / Number of active inhibit reasons for FId_DdskvFraTstd" UWORD DINH_ct_Compu 1 100 -4095.000 4096.000 BIT_MASK 0x1fff FORMAT "%8.3" ECU_ADDRESS 0x600142FE /end MEASUREMENT
/begin MEASUREMENT DINH_nrActvInhReas.FId_DdskvOraTstd "Number of active inhibit reasons for the FIds / Number of active inhibit reasons for FId_DdskvOraTstd" UWORD DINH_ct_Compu 1 100 -4095.000 4096.000 BIT_MASK 0x1fff FORMAT "%8.3" ECU_ADDRESS 0x60014300 /end MEASUREMENT
/begin MEASUREMENT DINH_nrActvInhReas.FId_DewDetTKAMax "Number of active inhibit reasons for the FIds / Number of active inhibit reasons for FId_DewDetTKAMax" UWORD DINH_ct_Compu 1 100 -4095.000 4096.000 BIT_MASK 0x1fff FORMAT "%8.3" ECU_ADDRESS 0x60014302 /end MEASUREMENT
/begin MEASUREMENT DINH_nrActvInhReas.FId_DiagBlkdLine "Number of active inhibit reasons for the FIds / Number of active inhibit reasons for FId_DiagBlkdLine" UWORD DINH_ct_Compu 1 100 -4095.000 4096.000 BIT_MASK 0x1fff FORMAT "%8.3" ECU_ADDRESS 0x60014304 /end MEASUREMENT
/begin MEASUREMENT DINH_nrActvInhReas.FId_DiagCpv1DteskLoLoad "Number of active inhibit reasons for the FIds / Number of active inhibit reasons for FId_DiagCpv1DteskLoLoad" UWORD DINH_ct_Compu 1 100 -4095.000 4096.000 BIT_MASK 0x1fff FORMAT "%8.3" ECU_ADDRESS 0x60014306 /end MEASUREMENT
/begin MEASUREMENT DINH_nrActvInhReas.FId_DkrsaEpmNoSig "Number of active inhibit reasons for the FIds / Number of active inhibit reasons for FId_DkrsaEpmNoSig" UWORD DINH_ct_Compu 1 100 -4095.000 4096.000 BIT_MASK 0x1fff FORMAT "%8.3" ECU_ADDRESS 0x60014308 /end MEASUREMENT
/begin MEASUREMENT DINH_nrActvInhReas.FId_EBBCANErrFrzVal "Number of active inhibit reasons for the FIds / Number of active inhibit reasons for FId_EBBCANErrFrzVal" UWORD DINH_ct_Compu 1 100 -4095.000 4096.000 BIT_MASK 0x1fff FORMAT "%8.3" ECU_ADDRESS 0x6001430A /end MEASUREMENT
/begin MEASUREMENT DINH_nrActvInhReas.FId_EBBCANErrReplVal "Number of active inhibit reasons for the FIds / Number of active inhibit reasons for FId_EBBCANErrReplVal" UWORD DINH_ct_Compu 1 100 -4095.000 4096.000 BIT_MASK 0x1fff FORMAT "%8.3" ECU_ADDRESS 0x6001430C /end MEASUREMENT
/begin MEASUREMENT DINH_nrActvInhReas.FId_EGLZSR "Number of active inhibit reasons for the FIds / Number of active inhibit reasons for FId_EGLZSR" UWORD DINH_ct_Compu 1 100 -4095.000 4096.000 BIT_MASK 0x1fff FORMAT "%8.3" ECU_ADDRESS 0x6001430E /end MEASUREMENT
/begin MEASUREMENT DINH_nrActvInhReas.FId_EGRVlvActrOff "Number of active inhibit reasons for the FIds / Number of active inhibit reasons for FId_EGRVlvActrOff" UWORD DINH_ct_Compu 1 100 -4095.000 4096.000 BIT_MASK 0x1fff FORMAT "%8.3" ECU_ADDRESS 0x60014310 /end MEASUREMENT
/begin MEASUREMENT DINH_nrActvInhReas.FId_EGRVlvCldStrt "Number of active inhibit reasons for the FIds / Number of active inhibit reasons for FId_EGRVlvCldStrt" UWORD DINH_ct_Compu 1 100 -4095.000 4096.000 BIT_MASK 0x1fff FORMAT "%8.3" ECU_ADDRESS 0x60014312 /end MEASUREMENT
/begin MEASUREMENT DINH_nrActvInhReas.FId_EGRVlvClnVrfy "Number of active inhibit reasons for the FIds / Number of active inhibit reasons for FId_EGRVlvClnVrfy" UWORD DINH_ct_Compu 1 100 -4095.000 4096.000 BIT_MASK 0x1fff FORMAT "%8.3" ECU_ADDRESS 0x60014314 /end MEASUREMENT
/begin MEASUREMENT DINH_nrActvInhReas.FId_EGRVlvCtrlErr "Number of active inhibit reasons for the FIds / Number of active inhibit reasons for FId_EGRVlvCtrlErr" UWORD DINH_ct_Compu 1 100 -4095.000 4096.000 BIT_MASK 0x1fff FORMAT "%8.3" ECU_ADDRESS 0x60014316 /end MEASUREMENT
/begin MEASUREMENT DINH_nrActvInhReas.FId_EGRVlvEngTempDef "Number of active inhibit reasons for the FIds / Number of active inhibit reasons for FId_EGRVlvEngTempDef" UWORD DINH_ct_Compu 1 100 -4095.000 4096.000 BIT_MASK 0x1fff FORMAT "%8.3" ECU_ADDRESS 0x60014318 /end MEASUREMENT
/begin MEASUREMENT DINH_nrActvInhReas.FId_EGRVlvFailSafeActv "Number of active inhibit reasons for the FIds / Number of active inhibit reasons for FId_EGRVlvFailSafeActv" UWORD DINH_ct_Compu 1 100 -4095.000 4096.000 BIT_MASK 0x1fff FORMAT "%8.3" ECU_ADDRESS 0x6001431A /end MEASUREMENT
/begin MEASUREMENT DINH_nrActvInhReas.FId_EGRVlvFrzVal "Number of active inhibit reasons for the FIds / Number of active inhibit reasons for FId_EGRVlvFrzVal" UWORD DINH_ct_Compu 1 100 -4095.000 4096.000 BIT_MASK 0x1fff FORMAT "%8.3" ECU_ADDRESS 0x6001431C /end MEASUREMENT
/begin MEASUREMENT DINH_nrActvInhReas.FId_EGRVlvGovOn "Number of active inhibit reasons for the FIds / Number of active inhibit reasons for FId_EGRVlvGovOn" UWORD DINH_ct_Compu 1 100 -4095.000 4096.000 BIT_MASK 0x1fff FORMAT "%8.3" ECU_ADDRESS 0x6001431E /end MEASUREMENT
/begin MEASUREMENT DINH_nrActvInhReas.FId_EGRVlvGovOnCld "Number of active inhibit reasons for the FIds / Number of active inhibit reasons for FId_EGRVlvGovOnCld" UWORD DINH_ct_Compu 1 100 -4095.000 4096.000 BIT_MASK 0x1fff FORMAT "%8.3" ECU_ADDRESS 0x60014320 /end MEASUREMENT
/begin MEASUREMENT DINH_nrActvInhReas.FId_EGRVlvGovrOnRelsFct "Number of active inhibit reasons for the FIds / Number of active inhibit reasons for FId_EGRVlvGovrOnRelsFct" UWORD DINH_ct_Compu 1 100 -4095.000 4096.000 BIT_MASK 0x1fff FORMAT "%8.3" ECU_ADDRESS 0x60014322 /end MEASUREMENT
/begin MEASUREMENT DINH_nrActvInhReas.FId_EGRVlvILimn "Number of active inhibit reasons for the FIds / Number of active inhibit reasons for FId_EGRVlvILimn" UWORD DINH_ct_Compu 1 100 -4095.000 4096.000 BIT_MASK 0x1fff FORMAT "%8.3" ECU_ADDRESS 0x60014324 /end MEASUREMENT
/begin MEASUREMENT DINH_nrActvInhReas.FId_EGRVlvIni "Number of active inhibit reasons for the FIds / Number of active inhibit reasons for FId_EGRVlvIni" UWORD DINH_ct_Compu 1 100 -4095.000 4096.000 BIT_MASK 0x1fff FORMAT "%8.3" ECU_ADDRESS 0x60014326 /end MEASUREMENT
/begin MEASUREMENT DINH_nrActvInhReas.FId_EGRVlvMon "Number of active inhibit reasons for the FIds / Number of active inhibit reasons for FId_EGRVlvMon" UWORD DINH_ct_Compu 1 100 -4095.000 4096.000 BIT_MASK 0x1fff FORMAT "%8.3" ECU_ADDRESS 0x60014328 /end MEASUREMENT
/begin MEASUREMENT DINH_nrActvInhReas.FId_EGRVlvOfsLrnInhib "Number of active inhibit reasons for the FIds / Number of active inhibit reasons for FId_EGRVlvOfsLrnInhib" UWORD DINH_ct_Compu 1 100 -4095.000 4096.000 BIT_MASK 0x1fff FORMAT "%8.3" ECU_ADDRESS 0x6001432A /end MEASUREMENT
/begin MEASUREMENT DINH_nrActvInhReas.FId_EGRVlvPhysRng "Number of active inhibit reasons for the FIds / Number of active inhibit reasons for FId_EGRVlvPhysRng" UWORD DINH_ct_Compu 1 100 -4095.000 4096.000 BIT_MASK 0x1fff FORMAT "%8.3" ECU_ADDRESS 0x6001432C /end MEASUREMENT
/begin MEASUREMENT DINH_nrActvInhReas.FId_EGRVlvPsSwtOff "Number of active inhibit reasons for the FIds / Number of active inhibit reasons for FId_EGRVlvPsSwtOff" UWORD DINH_ct_Compu 1 100 -4095.000 4096.000 BIT_MASK 0x1fff FORMAT "%8.3" ECU_ADDRESS 0x6001432E /end MEASUREMENT
/begin MEASUREMENT DINH_nrActvInhReas.FId_EGRVlvPwrStgMonDis "Number of active inhibit reasons for the FIds / Number of active inhibit reasons for FId_EGRVlvPwrStgMonDis" UWORD DINH_ct_Compu 1 100 -4095.000 4096.000 BIT_MASK 0x1fff FORMAT "%8.3" ECU_ADDRESS 0x60014330 /end MEASUREMENT
/begin MEASUREMENT DINH_nrActvInhReas.FId_EGRVlvRplVal "Number of active inhibit reasons for the FIds / Number of active inhibit reasons for FId_EGRVlvRplVal" UWORD DINH_ct_Compu 1 100 -4095.000 4096.000 BIT_MASK 0x1fff FORMAT "%8.3" ECU_ADDRESS 0x60014332 /end MEASUREMENT
/begin MEASUREMENT DINH_nrActvInhReas.FId_EGRVlvSSpMon "Number of active inhibit reasons for the FIds / Number of active inhibit reasons for FId_EGRVlvSSpMon" UWORD DINH_ct_Compu 1 100 -4095.000 4096.000 BIT_MASK 0x1fff FORMAT "%8.3" ECU_ADDRESS 0x60014334 /end MEASUREMENT
/begin MEASUREMENT DINH_nrActvInhReas.FId_EGRVlvSnsrErr "Number of active inhibit reasons for the FIds / Number of active inhibit reasons for FId_EGRVlvSnsrErr" UWORD DINH_ct_Compu 1 100 -4095.000 4096.000 BIT_MASK 0x1fff FORMAT "%8.3" ECU_ADDRESS 0x60014336 /end MEASUREMENT
/begin MEASUREMENT DINH_nrActvInhReas.FId_EGRVlvTempCmp "Number of active inhibit reasons for the FIds / Number of active inhibit reasons for FId_EGRVlvTempCmp" UWORD DINH_ct_Compu 1 100 -4095.000 4096.000 BIT_MASK 0x1fff FORMAT "%8.3" ECU_ADDRESS 0x60014338 /end MEASUREMENT
/begin MEASUREMENT DINH_nrActvInhReas.FId_EGRVlvTempMdlEEPErr "Number of active inhibit reasons for the FIds / Number of active inhibit reasons for FId_EGRVlvTempMdlEEPErr" UWORD DINH_ct_Compu 1 100 -4095.000 4096.000 BIT_MASK 0x1fff FORMAT "%8.3" ECU_ADDRESS 0x6001433A /end MEASUREMENT
/begin MEASUREMENT DINH_nrActvInhReas.FId_EGRVlvTmpErrCnt "Number of active inhibit reasons for the FIds / Number of active inhibit reasons for FId_EGRVlvTmpErrCnt" UWORD DINH_ct_Compu 1 100 -4095.000 4096.000 BIT_MASK 0x1fff FORMAT "%8.3" ECU_ADDRESS 0x6001433C /end MEASUREMENT
/begin MEASUREMENT DINH_nrActvInhReas.FId_EGRVlvTrlPtr "Number of active inhibit reasons for the FIds / Number of active inhibit reasons for FId_EGRVlvTrlPtr" UWORD DINH_ct_Compu 1 100 -4095.000 4096.000 BIT_MASK 0x1fff FORMAT "%8.3" ECU_ADDRESS 0x6001433E /end MEASUREMENT
/begin MEASUREMENT DINH_nrActvInhReas.FId_EGRVlv_VehvErr "Number of active inhibit reasons for the FIds / Number of active inhibit reasons for FId_EGRVlv_VehvErr" UWORD DINH_ct_Compu 1 100 -4095.000 4096.000 BIT_MASK 0x1fff FORMAT "%8.3" ECU_ADDRESS 0x60014340 /end MEASUREMENT
/begin MEASUREMENT DINH_nrActvInhReas.FId_EGRVlviActIEfcLimn "Number of active inhibit reasons for the FIds / Number of active inhibit reasons for FId_EGRVlviActIEfcLimn" UWORD DINH_ct_Compu 1 100 -4095.000 4096.000 BIT_MASK 0x1fff FORMAT "%8.3" ECU_ADDRESS 0x60014342 /end MEASUREMENT
/begin MEASUREMENT DINH_nrActvInhReas.FId_EGRVlvpDsbcInvld "Number of active inhibit reasons for the FIds / Number of active inhibit reasons for FId_EGRVlvpDsbcInvld" UWORD DINH_ct_Compu 1 100 -4095.000 4096.000 BIT_MASK 0x1fff FORMAT "%8.3" ECU_ADDRESS 0x60014344 /end MEASUREMENT
/begin MEASUREMENT DINH_nrActvInhReas.FId_EGSDO2OffsRstDsmS1B1 "Number of active inhibit reasons for the FIds / Number of active inhibit reasons for FId_EGSDO2OffsRstDsmS1B1" UWORD DINH_ct_Compu 1 100 -4095.000 4096.000 BIT_MASK 0x1fff FORMAT "%8.3" ECU_ADDRESS 0x60014346 /end MEASUREMENT
/begin MEASUREMENT DINH_nrActvInhReas.FId_EGSDO2_LamOffsSlowS1 "Number of active inhibit reasons for the FIds / Number of active inhibit reasons for FId_EGSDO2_LamOffsSlowS1" UWORD DINH_ct_Compu 1 100 -4095.000 4096.000 BIT_MASK 0x1fff FORMAT "%8.3" ECU_ADDRESS 0x60014348 /end MEASUREMENT
/begin MEASUREMENT DINH_nrActvInhReas.FId_EGSDO2_RstFltSuspcnOffsB1 "Number of active inhibit reasons for the FIds / Number of active inhibit reasons for FId_EGSDO2_RstFltSuspcnOffsB1" UWORD DINH_ct_Compu 1 100 -4095.000 4096.000 BIT_MASK 0x1fff FORMAT "%8.3" ECU_ADDRESS 0x6001434A /end MEASUREMENT
/begin MEASUREMENT DINH_nrActvInhReas.FId_EGSDUS2B1DlyEvln "Number of active inhibit reasons for the FIds / Number of active inhibit reasons for FId_EGSDUS2B1DlyEvln" UWORD DINH_ct_Compu 1 100 -4095.000 4096.000 BIT_MASK 0x1fff FORMAT "%8.3" ECU_ADDRESS 0x6001434C /end MEASUREMENT
/begin MEASUREMENT DINH_nrActvInhReas.FId_EGSDUS2B1LtrDly "Number of active inhibit reasons for the FIds / Number of active inhibit reasons for FId_EGSDUS2B1LtrDly" UWORD DINH_ct_Compu 1 100 -4095.000 4096.000 BIT_MASK 0x1fff FORMAT "%8.3" ECU_ADDRESS 0x6001434E /end MEASUREMENT
/begin MEASUREMENT DINH_nrActvInhReas.FId_EGSDUS2B1LtrPT1 "Number of active inhibit reasons for the FIds / Number of active inhibit reasons for FId_EGSDUS2B1LtrPT1" UWORD DINH_ct_Compu 1 100 -4095.000 4096.000 BIT_MASK 0x1fff FORMAT "%8.3" ECU_ADDRESS 0x60014350 /end MEASUREMENT
/begin MEASUREMENT DINH_nrActvInhReas.FId_EGSDUS2B1PT1Evln "Number of active inhibit reasons for the FIds / Number of active inhibit reasons for FId_EGSDUS2B1PT1Evln" UWORD DINH_ct_Compu 1 100 -4095.000 4096.000 BIT_MASK 0x1fff FORMAT "%8.3" ECU_ADDRESS 0x60014352 /end MEASUREMENT
/begin MEASUREMENT DINH_nrActvInhReas.FId_EGSDUS2B1RtlDly "Number of active inhibit reasons for the FIds / Number of active inhibit reasons for FId_EGSDUS2B1RtlDly" UWORD DINH_ct_Compu 1 100 -4095.000 4096.000 BIT_MASK 0x1fff FORMAT "%8.3" ECU_ADDRESS 0x60014354 /end MEASUREMENT
/begin MEASUREMENT DINH_nrActvInhReas.FId_EGSDUS2B1RtlPT1 "Number of active inhibit reasons for the FIds / Number of active inhibit reasons for FId_EGSDUS2B1RtlPT1" UWORD DINH_ct_Compu 1 100 -4095.000 4096.000 BIT_MASK 0x1fff FORMAT "%8.3" ECU_ADDRESS 0x60014356 /end MEASUREMENT
/begin MEASUREMENT DINH_nrActvInhReas.FId_EGSDUS2B1TarEvln "Number of active inhibit reasons for the FIds / Number of active inhibit reasons for FId_EGSDUS2B1TarEvln" UWORD DINH_ct_Compu 1 100 -4095.000 4096.000 BIT_MASK 0x1fff FORMAT "%8.3" ECU_ADDRESS 0x60014358 /end MEASUREMENT
/begin MEASUREMENT DINH_nrActvInhReas.FId_EGSDUS2B1TarLean "Number of active inhibit reasons for the FIds / Number of active inhibit reasons for FId_EGSDUS2B1TarLean" UWORD DINH_ct_Compu 1 100 -4095.000 4096.000 BIT_MASK 0x1fff FORMAT "%8.3" ECU_ADDRESS 0x6001435A /end MEASUREMENT
/begin MEASUREMENT DINH_nrActvInhReas.FId_EGSDUS2B1TarRich "Number of active inhibit reasons for the FIds / Number of active inhibit reasons for FId_EGSDUS2B1TarRich" UWORD DINH_ct_Compu 1 100 -4095.000 4096.000 BIT_MASK 0x1fff FORMAT "%8.3" ECU_ADDRESS 0x6001435C /end MEASUREMENT
/begin MEASUREMENT DINH_nrActvInhReas.FId_EGSSigO2S1B1 "Number of active inhibit reasons for the FIds / Number of active inhibit reasons for FId_EGSSigO2S1B1" UWORD DINH_ct_Compu 1 100 -4095.000 4096.000 BIT_MASK 0x1fff FORMAT "%8.3" ECU_ADDRESS 0x6001435E /end MEASUREMENT
/begin MEASUREMENT DINH_nrActvInhReas.FId_ELZSR "Number of active inhibit reasons for the FIds / Number of active inhibit reasons for FId_ELZSR" UWORD DINH_ct_Compu 1 100 -4095.000 4096.000 BIT_MASK 0x1fff FORMAT "%8.3" ECU_ADDRESS 0x60014360 /end MEASUREMENT
/begin MEASUREMENT DINH_nrActvInhReas.FId_EPBErr "Number of active inhibit reasons for the FIds / Number of active inhibit reasons for FId_EPBErr" UWORD DINH_ct_Compu 1 100 -4095.000 4096.000 BIT_MASK 0x1fff FORMAT "%8.3" ECU_ADDRESS 0x60014362 /end MEASUREMENT
/begin MEASUREMENT DINH_nrActvInhReas.FId_EPBFrmErr "Number of active inhibit reasons for the FIds / Number of active inhibit reasons for FId_EPBFrmErr" UWORD DINH_ct_Compu 1 100 -4095.000 4096.000 BIT_MASK 0x1fff FORMAT "%8.3" ECU_ADDRESS 0x60014364 /end MEASUREMENT
/begin MEASUREMENT DINH_nrActvInhReas.FId_EPBFrmErrClth "Number of active inhibit reasons for the FIds / Number of active inhibit reasons for FId_EPBFrmErrClth" UWORD DINH_ct_Compu 1 100 -4095.000 4096.000 BIT_MASK 0x1fff FORMAT "%8.3" ECU_ADDRESS 0x60014366 /end MEASUREMENT
/begin MEASUREMENT DINH_nrActvInhReas.FId_ETHSCPErrDrvCyc "Number of active inhibit reasons for the FIds / Number of active inhibit reasons for FId_ETHSCPErrDrvCyc" UWORD DINH_ct_Compu 1 100 -4095.000 4096.000 BIT_MASK 0x1fff FORMAT "%8.3" ECU_ADDRESS 0x60014368 /end MEASUREMENT
/begin MEASUREMENT DINH_nrActvInhReas.FId_EVPComFailr "Number of active inhibit reasons for the FIds / Number of active inhibit reasons for FId_EVPComFailr" UWORD DINH_ct_Compu 1 100 -4095.000 4096.000 BIT_MASK 0x1fff FORMAT "%8.3" ECU_ADDRESS 0x6001436A /end MEASUREMENT
/begin MEASUREMENT DINH_nrActvInhReas.FId_EbsLinErr "Number of active inhibit reasons for the FIds / Number of active inhibit reasons for FId_EbsLinErr" UWORD DINH_ct_Compu 1 100 -4095.000 4096.000 BIT_MASK 0x1fff FORMAT "%8.3" ECU_ADDRESS 0x6001436C /end MEASUREMENT
/begin MEASUREMENT DINH_nrActvInhReas.FId_ElecLdComErr "Number of active inhibit reasons for the FIds / Number of active inhibit reasons for FId_ElecLdComErr" UWORD DINH_ct_Compu 1 100 -4095.000 4096.000 BIT_MASK 0x1fff FORMAT "%8.3" ECU_ADDRESS 0x6001436E /end MEASUREMENT
/begin MEASUREMENT DINH_nrActvInhReas.FId_ElecLdFrzVal "Number of active inhibit reasons for the FIds / Number of active inhibit reasons for FId_ElecLdFrzVal" UWORD DINH_ct_Compu 1 100 -4095.000 4096.000 BIT_MASK 0x1fff FORMAT "%8.3" ECU_ADDRESS 0x60014370 /end MEASUREMENT
/begin MEASUREMENT DINH_nrActvInhReas.FId_ElecLdHdLiComErr "Number of active inhibit reasons for the FIds / Number of active inhibit reasons for FId_ElecLdHdLiComErr" UWORD DINH_ct_Compu 1 100 -4095.000 4096.000 BIT_MASK 0x1fff FORMAT "%8.3" ECU_ADDRESS 0x60014372 /end MEASUREMENT
/begin MEASUREMENT DINH_nrActvInhReas.FId_ElecLdRplVal "Number of active inhibit reasons for the FIds / Number of active inhibit reasons for FId_ElecLdRplVal" UWORD DINH_ct_Compu 1 100 -4095.000 4096.000 BIT_MASK 0x1fff FORMAT "%8.3" ECU_ADDRESS 0x60014374 /end MEASUREMENT
/begin MEASUREMENT DINH_nrActvInhReas.FId_ElecLoadEPSComErr "Number of active inhibit reasons for the FIds / Number of active inhibit reasons for FId_ElecLoadEPSComErr" UWORD DINH_ct_Compu 1 100 -4095.000 4096.000 BIT_MASK 0x1fff FORMAT "%8.3" ECU_ADDRESS 0x60014376 /end MEASUREMENT
/begin MEASUREMENT DINH_nrActvInhReas.FId_EngBlkTWrn "Number of active inhibit reasons for the FIds / Number of active inhibit reasons for FId_EngBlkTWrn" UWORD DINH_ct_Compu 1 100 -4095.000 4096.000 BIT_MASK 0x1fff FORMAT "%8.3" ECU_ADDRESS 0x60014378 /end MEASUREMENT
/begin MEASUREMENT DINH_nrActvInhReas.FId_EngCooltTFail "Number of active inhibit reasons for the FIds / Number of active inhibit reasons for FId_EngCooltTFail" UWORD DINH_ct_Compu 1 100 -4095.000 4096.000 BIT_MASK 0x1fff FORMAT "%8.3" ECU_ADDRESS 0x6001437A /end MEASUREMENT
/begin MEASUREMENT DINH_nrActvInhReas.FId_EngDemTqLimnCamsftErr "Number of active inhibit reasons for the FIds / Number of active inhibit reasons for FId_EngDemTqLimnCamsftErr" UWORD DINH_ct_Compu 1 100 -4095.000 4096.000 BIT_MASK 0x1fff FORMAT "%8.3" ECU_ADDRESS 0x6001437C /end MEASUREMENT
/begin MEASUREMENT DINH_nrActvInhReas.FId_EngDemTqLimnErrThmstHeatCtrlCirc "Number of active inhibit reasons for the FIds / Number of active inhibit reasons for FId_EngDemTqLimnErrThmstHeatCtrlCirc" UWORD DINH_ct_Compu 1 100 -4095.000 4096.000 BIT_MASK 0x1fff FORMAT "%8.3" ECU_ADDRESS 0x6001437E /end MEASUREMENT
/begin MEASUREMENT DINH_nrActvInhReas.FId_EngDemTqLimnOilPmp "Number of active inhibit reasons for the FIds / Number of active inhibit reasons for FId_EngDemTqLimnOilPmp" UWORD DINH_ct_Compu 1 100 -4095.000 4096.000 BIT_MASK 0x1fff FORMAT "%8.3" ECU_ADDRESS 0x60014380 /end MEASUREMENT
/begin MEASUREMENT DINH_nrActvInhReas.FId_EngDemTrqLimErrAPP "Number of active inhibit reasons for the FIds / Number of active inhibit reasons for FId_EngDemTrqLimErrAPP" UWORD DINH_ct_Compu 1 100 -4095.000 4096.000 BIT_MASK 0x1fff FORMAT "%8.3" ECU_ADDRESS 0x60014382 /end MEASUREMENT
/begin MEASUREMENT DINH_nrActvInhReas.FId_EngIntkAirFail "Number of active inhibit reasons for the FIds / Number of active inhibit reasons for FId_EngIntkAirFail" UWORD DINH_ct_Compu 1 100 -4095.000 4096.000 BIT_MASK 0x1fff FORMAT "%8.3" ECU_ADDRESS 0x60014384 /end MEASUREMENT
/begin MEASUREMENT DINH_nrActvInhReas.FId_EngPrtErrVehV "Number of active inhibit reasons for the FIds / Number of active inhibit reasons for FId_EngPrtErrVehV" UWORD DINH_ct_Compu 1 100 -4095.000 4096.000 BIT_MASK 0x1fff FORMAT "%8.3" ECU_ADDRESS 0x60014386 /end MEASUREMENT
/begin MEASUREMENT DINH_nrActvInhReas.FId_EngSpd30DegFail "Number of active inhibit reasons for the FIds / Number of active inhibit reasons for FId_EngSpd30DegFail" UWORD DINH_ct_Compu 1 100 -4095.000 4096.000 BIT_MASK 0x1fff FORMAT "%8.3" ECU_ADDRESS 0x60014388 /end MEASUREMENT
/begin MEASUREMENT DINH_nrActvInhReas.FId_EngStrtEnaEthAdap "Number of active inhibit reasons for the FIds / Number of active inhibit reasons for FId_EngStrtEnaEthAdap" UWORD DINH_ct_Compu 1 100 -4095.000 4096.000 BIT_MASK 0x1fff FORMAT "%8.3" ECU_ADDRESS 0x6001438A /end MEASUREMENT
/begin MEASUREMENT DINH_nrActvInhReas.FId_EngStrt_EnaCep "Number of active inhibit reasons for the FIds / Number of active inhibit reasons for FId_EngStrt_EnaCep" UWORD DINH_ct_Compu 1 100 -4095.000 4096.000 BIT_MASK 0x1fff FORMAT "%8.3" ECU_ADDRESS 0x6001438C /end MEASUREMENT
/begin MEASUREMENT DINH_nrActvInhReas.FId_EngStrt_InjProhb "Number of active inhibit reasons for the FIds / Number of active inhibit reasons for FId_EngStrt_InjProhb" UWORD DINH_ct_Compu 1 100 -4095.000 4096.000 BIT_MASK 0x1fff FORMAT "%8.3" ECU_ADDRESS 0x6001438E /end MEASUREMENT
/begin MEASUREMENT DINH_nrActvInhReas.FId_EngStrt_VehVInhb "Number of active inhibit reasons for the FIds / Number of active inhibit reasons for FId_EngStrt_VehVInhb" UWORD DINH_ct_Compu 1 100 -4095.000 4096.000 BIT_MASK 0x1fff FORMAT "%8.3" ECU_ADDRESS 0x60014390 /end MEASUREMENT
/begin MEASUREMENT DINH_nrActvInhReas.FId_EngTqRvsnEnaFlg "Number of active inhibit reasons for the FIds / Number of active inhibit reasons for FId_EngTqRvsnEnaFlg" UWORD DINH_ct_Compu 1 100 -4095.000 4096.000 BIT_MASK 0x1fff FORMAT "%8.3" ECU_ADDRESS 0x60014392 /end MEASUREMENT
/begin MEASUREMENT DINH_nrActvInhReas.FId_EnvTPrimMod "Number of active inhibit reasons for the FIds / Number of active inhibit reasons for FId_EnvTPrimMod" UWORD DINH_ct_Compu 1 100 -4095.000 4096.000 BIT_MASK 0x1fff FORMAT "%8.3" ECU_ADDRESS 0x60014394 /end MEASUREMENT
/begin MEASUREMENT DINH_nrActvInhReas.FId_EnvTPrimModIniVal "Number of active inhibit reasons for the FIds / Number of active inhibit reasons for FId_EnvTPrimModIniVal" UWORD DINH_ct_Compu 1 100 -4095.000 4096.000 BIT_MASK 0x1fff FORMAT "%8.3" ECU_ADDRESS 0x60014396 /end MEASUREMENT
/begin MEASUREMENT DINH_nrActvInhReas.FId_EnvTSensSum "Number of active inhibit reasons for the FIds / Number of active inhibit reasons for FId_EnvTSensSum" UWORD DINH_ct_Compu 1 100 -4095.000 4096.000 BIT_MASK 0x1fff FORMAT "%8.3" ECU_ADDRESS 0x60014398 /end MEASUREMENT
/begin MEASUREMENT DINH_nrActvInhReas.FId_EnvTtAirFltDs "Number of active inhibit reasons for the FIds / Number of active inhibit reasons for FId_EnvTtAirFltDs" UWORD DINH_ct_Compu 1 100 -4095.000 4096.000 BIT_MASK 0x1fff FORMAT "%8.3" ECU_ADDRESS 0x6001439A /end MEASUREMENT
/begin MEASUREMENT DINH_nrActvInhReas.FId_EnvTtCEngDsT "Number of active inhibit reasons for the FIds / Number of active inhibit reasons for FId_EnvTtCEngDsT" UWORD DINH_ct_Compu 1 100 -4095.000 4096.000 BIT_MASK 0x1fff FORMAT "%8.3" ECU_ADDRESS 0x6001439C /end MEASUREMENT
/begin MEASUREMENT DINH_nrActvInhReas.FId_EnvTtIntkMnfld "Number of active inhibit reasons for the FIds / Number of active inhibit reasons for FId_EnvTtIntkMnfld" UWORD DINH_ct_Compu 1 100 -4095.000 4096.000 BIT_MASK 0x1fff FORMAT "%8.3" ECU_ADDRESS 0x6001439E /end MEASUREMENT
/begin MEASUREMENT DINH_nrActvInhReas.FId_EomCvoAllwd "Number of active inhibit reasons for the FIds / Number of active inhibit reasons for FId_EomCvoAllwd" UWORD DINH_ct_Compu 1 100 -4095.000 4096.000 BIT_MASK 0x1fff FORMAT "%8.3" ECU_ADDRESS 0x600143A0 /end MEASUREMENT
/begin MEASUREMENT DINH_nrActvInhReas.FId_EpmBCr "Number of active inhibit reasons for the FIds / Number of active inhibit reasons for FId_EpmBCr" UWORD DINH_ct_Compu 1 100 -4095.000 4096.000 BIT_MASK 0x1fff FORMAT "%8.3" ECU_ADDRESS 0x600143A2 /end MEASUREMENT
/begin MEASUREMENT DINH_nrActvInhReas.FId_EpmCaSAdapCaSI1 "Number of active inhibit reasons for the FIds / Number of active inhibit reasons for FId_EpmCaSAdapCaSI1" UWORD DINH_ct_Compu 1 100 -4095.000 4096.000 BIT_MASK 0x1fff FORMAT "%8.3" ECU_ADDRESS 0x600143A4 /end MEASUREMENT
/begin MEASUREMENT DINH_nrActvInhReas.FId_EpmCaSAdapRstI1 "Number of active inhibit reasons for the FIds / Number of active inhibit reasons for FId_EpmCaSAdapRstI1" UWORD DINH_ct_Compu 1 100 -4095.000 4096.000 BIT_MASK 0x1fff FORMAT "%8.3" ECU_ADDRESS 0x600143A6 /end MEASUREMENT
/begin MEASUREMENT DINH_nrActvInhReas.FId_EpmCaSDiagI1 "Number of active inhibit reasons for the FIds / Number of active inhibit reasons for FId_EpmCaSDiagI1" UWORD DINH_ct_Compu 1 100 -4095.000 4096.000 BIT_MASK 0x1fff FORMAT "%8.3" ECU_ADDRESS 0x600143A8 /end MEASUREMENT
/begin MEASUREMENT DINH_nrActvInhReas.FId_EpmCaSErrCaSI1 "Number of active inhibit reasons for the FIds / Number of active inhibit reasons for FId_EpmCaSErrCaSI1" UWORD DINH_ct_Compu 1 100 -4095.000 4096.000 BIT_MASK 0x1fff FORMAT "%8.3" ECU_ADDRESS 0x600143AA /end MEASUREMENT
/begin MEASUREMENT DINH_nrActvInhReas.FId_EpmCaSOfsDiagCaSI1 "Number of active inhibit reasons for the FIds / Number of active inhibit reasons for FId_EpmCaSOfsDiagCaSI1" UWORD DINH_ct_Compu 1 100 -4095.000 4096.000 BIT_MASK 0x1fff FORMAT "%8.3" ECU_ADDRESS 0x600143AC /end MEASUREMENT
/begin MEASUREMENT DINH_nrActvInhReas.FId_EpmCaSOfsErrCaSI1 "Number of active inhibit reasons for the FIds / Number of active inhibit reasons for FId_EpmCaSOfsErrCaSI1" UWORD DINH_ct_Compu 1 100 -4095.000 4096.000 BIT_MASK 0x1fff FORMAT "%8.3" ECU_ADDRESS 0x600143AE /end MEASUREMENT
/begin MEASUREMENT DINH_nrActvInhReas.FId_EpmCaSSegI1 "Number of active inhibit reasons for the FIds / Number of active inhibit reasons for FId_EpmCaSSegI1" UWORD DINH_ct_Compu 1 100 -4095.000 4096.000 BIT_MASK 0x1fff FORMAT "%8.3" ECU_ADDRESS 0x600143B0 /end MEASUREMENT
/begin MEASUREMENT DINH_nrActvInhReas.FId_EpmCaSSpdPlausI1 "Number of active inhibit reasons for the FIds / Number of active inhibit reasons for FId_EpmCaSSpdPlausI1" UWORD DINH_ct_Compu 1 100 -4095.000 4096.000 BIT_MASK 0x1fff FORMAT "%8.3" ECU_ADDRESS 0x600143B2 /end MEASUREMENT
/begin MEASUREMENT DINH_nrActvInhReas.FId_EpmCrSDiag "Number of active inhibit reasons for the FIds / Number of active inhibit reasons for FId_EpmCrSDiag" UWORD DINH_ct_Compu 1 100 -4095.000 4096.000 BIT_MASK 0x1fff FORMAT "%8.3" ECU_ADDRESS 0x600143B4 /end MEASUREMENT
/begin MEASUREMENT DINH_nrActvInhReas.FId_EpmCrSDiagVeh "Number of active inhibit reasons for the FIds / Number of active inhibit reasons for FId_EpmCrSDiagVeh" UWORD DINH_ct_Compu 1 100 -4095.000 4096.000 BIT_MASK 0x1fff FORMAT "%8.3" ECU_ADDRESS 0x600143B6 /end MEASUREMENT
/begin MEASUREMENT DINH_nrActvInhReas.FId_EpmCrSErr "Number of active inhibit reasons for the FIds / Number of active inhibit reasons for FId_EpmCrSErr" UWORD DINH_ct_Compu 1 100 -4095.000 4096.000 BIT_MASK 0x1fff FORMAT "%8.3" ECU_ADDRESS 0x600143B8 /end MEASUREMENT
/begin MEASUREMENT DINH_nrActvInhReas.FId_EpmOpMode_ALELock "Number of active inhibit reasons for the FIds / Number of active inhibit reasons for FId_EpmOpMode_ALELock" UWORD DINH_ct_Compu 1 100 -4095.000 4096.000 BIT_MASK 0x1fff FORMAT "%8.3" ECU_ADDRESS 0x600143BA /end MEASUREMENT
/begin MEASUREMENT DINH_nrActvInhReas.FId_EpmOpMode_DirStLock "Number of active inhibit reasons for the FIds / Number of active inhibit reasons for FId_EpmOpMode_DirStLock" UWORD DINH_ct_Compu 1 100 -4095.000 4096.000 BIT_MASK 0x1fff FORMAT "%8.3" ECU_ADDRESS 0x600143BC /end MEASUREMENT
/begin MEASUREMENT DINH_nrActvInhReas.FId_EpmRRSCrSFaultCheck "Number of active inhibit reasons for the FIds / Number of active inhibit reasons for FId_EpmRRSCrSFaultCheck" UWORD DINH_ct_Compu 1 100 -4095.000 4096.000 BIT_MASK 0x1fff FORMAT "%8.3" ECU_ADDRESS 0x600143BE /end MEASUREMENT
/begin MEASUREMENT DINH_nrActvInhReas.FId_EpmRRSDGIFaultCheck "Number of active inhibit reasons for the FIds / Number of active inhibit reasons for FId_EpmRRSDGIFaultCheck" UWORD DINH_ct_Compu 1 100 -4095.000 4096.000 BIT_MASK 0x1fff FORMAT "%8.3" ECU_ADDRESS 0x600143C0 /end MEASUREMENT
/begin MEASUREMENT DINH_nrActvInhReas.FId_EpmRRSRdCheck "Number of active inhibit reasons for the FIds / Number of active inhibit reasons for FId_EpmRRSRdCheck" UWORD DINH_ct_Compu 1 100 -4095.000 4096.000 BIT_MASK 0x1fff FORMAT "%8.3" ECU_ADDRESS 0x600143C2 /end MEASUREMENT
/begin MEASUREMENT DINH_nrActvInhReas.FId_EpmRRSVehVFaultChck "Number of active inhibit reasons for the FIds / Number of active inhibit reasons for FId_EpmRRSVehVFaultChck" UWORD DINH_ct_Compu 1 100 -4095.000 4096.000 BIT_MASK 0x1fff FORMAT "%8.3" ECU_ADDRESS 0x600143C4 /end MEASUREMENT
/begin MEASUREMENT DINH_nrActvInhReas.FId_EpmSynLockCaSSync "Number of active inhibit reasons for the FIds / Number of active inhibit reasons for FId_EpmSynLockCaSSync" UWORD DINH_ct_Compu 1 100 -4095.000 4096.000 BIT_MASK 0x1fff FORMAT "%8.3" ECU_ADDRESS 0x600143C6 /end MEASUREMENT
/begin MEASUREMENT DINH_nrActvInhReas.FId_EpmTmpSuppRvsRotCASI1 "Number of active inhibit reasons for the FIds / Number of active inhibit reasons for FId_EpmTmpSuppRvsRotCASI1" UWORD DINH_ct_Compu 1 100 -4095.000 4096.000 BIT_MASK 0x1fff FORMAT "%8.3" ECU_ADDRESS 0x600143C8 /end MEASUREMENT
/begin MEASUREMENT DINH_nrActvInhReas.FId_EtaEngIdleNonCsers "Number of active inhibit reasons for the FIds / Number of active inhibit reasons for FId_EtaEngIdleNonCsers" UWORD DINH_ct_Compu 1 100 -4095.000 4096.000 BIT_MASK 0x1fff FORMAT "%8.3" ECU_ADDRESS 0x600143CA /end MEASUREMENT
/begin MEASUREMENT DINH_nrActvInhReas.FId_EtaEngPtlNonCsers "Number of active inhibit reasons for the FIds / Number of active inhibit reasons for FId_EtaEngPtlNonCsers" UWORD DINH_ct_Compu 1 100 -4095.000 4096.000 BIT_MASK 0x1fff FORMAT "%8.3" ECU_ADDRESS 0x600143CC /end MEASUREMENT
/begin MEASUREMENT DINH_nrActvInhReas.FId_EthnlSnsrErrCdn "Number of active inhibit reasons for the FIds / Number of active inhibit reasons for FId_EthnlSnsrErrCdn" UWORD DINH_ct_Compu 1 100 -4095.000 4096.000 BIT_MASK 0x1fff FORMAT "%8.3" ECU_ADDRESS 0x600143CE /end MEASUREMENT
/begin MEASUREMENT DINH_nrActvInhReas.FId_EvapActrCcvElecDiag "Number of active inhibit reasons for the FIds / Number of active inhibit reasons for FId_EvapActrCcvElecDiag" UWORD DINH_ct_Compu 1 100 -4095.000 4096.000 BIT_MASK 0x1fff FORMAT "%8.3" ECU_ADDRESS 0x600143D0 /end MEASUREMENT
/begin MEASUREMENT DINH_nrActvInhReas.FId_EvapPSnsrTankPhyRngChk "Number of active inhibit reasons for the FIds / Number of active inhibit reasons for FId_EvapPSnsrTankPhyRngChk" UWORD DINH_ct_Compu 1 100 -4095.000 4096.000 BIT_MASK 0x1fff FORMAT "%8.3" ECU_ADDRESS 0x600143D2 /end MEASUREMENT
/begin MEASUREMENT DINH_nrActvInhReas.FId_FanCtlACClntP "Number of active inhibit reasons for the FIds / Number of active inhibit reasons for FId_FanCtlACClntP" UWORD DINH_ct_Compu 1 100 -4095.000 4096.000 BIT_MASK 0x1fff FORMAT "%8.3" ECU_ADDRESS 0x600143D4 /end MEASUREMENT
/begin MEASUREMENT DINH_nrActvInhReas.FId_FanCtlACGModFail "Number of active inhibit reasons for the FIds / Number of active inhibit reasons for FId_FanCtlACGModFail" UWORD DINH_ct_Compu 1 100 -4095.000 4096.000 BIT_MASK 0x1fff FORMAT "%8.3" ECU_ADDRESS 0x600143D6 /end MEASUREMENT
/begin MEASUREMENT DINH_nrActvInhReas.FId_FanCtlAPP1 "Number of active inhibit reasons for the FIds / Number of active inhibit reasons for FId_FanCtlAPP1" UWORD DINH_ct_Compu 1 100 -4095.000 4096.000 BIT_MASK 0x1fff FORMAT "%8.3" ECU_ADDRESS 0x600143D8 /end MEASUREMENT
/begin MEASUREMENT DINH_nrActvInhReas.FId_FanCtlAPP2 "Number of active inhibit reasons for the FIds / Number of active inhibit reasons for FId_FanCtlAPP2" UWORD DINH_ct_Compu 1 100 -4095.000 4096.000 BIT_MASK 0x1fff FORMAT "%8.3" ECU_ADDRESS 0x600143DA /end MEASUREMENT
/begin MEASUREMENT DINH_nrActvInhReas.FId_FanCtlAPPSync "Number of active inhibit reasons for the FIds / Number of active inhibit reasons for FId_FanCtlAPPSync" UWORD DINH_ct_Compu 1 100 -4095.000 4096.000 BIT_MASK 0x1fff FORMAT "%8.3" ECU_ADDRESS 0x600143DC /end MEASUREMENT
/begin MEASUREMENT DINH_nrActvInhReas.FId_FanCtlBlowrU "Number of active inhibit reasons for the FIds / Number of active inhibit reasons for FId_FanCtlBlowrU" UWORD DINH_ct_Compu 1 100 -4095.000 4096.000 BIT_MASK 0x1fff FORMAT "%8.3" ECU_ADDRESS 0x600143DE /end MEASUREMENT
/begin MEASUREMENT DINH_nrActvInhReas.FId_FanCtlCooltT "Number of active inhibit reasons for the FIds / Number of active inhibit reasons for FId_FanCtlCooltT" UWORD DINH_ct_Compu 1 100 -4095.000 4096.000 BIT_MASK 0x1fff FORMAT "%8.3" ECU_ADDRESS 0x600143E0 /end MEASUREMENT
/begin MEASUREMENT DINH_nrActvInhReas.FId_FanCtlCooltT2 "Number of active inhibit reasons for the FIds / Number of active inhibit reasons for FId_FanCtlCooltT2" UWORD DINH_ct_Compu 1 100 -4095.000 4096.000 BIT_MASK 0x1fff FORMAT "%8.3" ECU_ADDRESS 0x600143E2 /end MEASUREMENT
/begin MEASUREMENT DINH_nrActvInhReas.FId_FanCtlEnvT "Number of active inhibit reasons for the FIds / Number of active inhibit reasons for FId_FanCtlEnvT" UWORD DINH_ct_Compu 1 100 -4095.000 4096.000 BIT_MASK 0x1fff FORMAT "%8.3" ECU_ADDRESS 0x600143E4 /end MEASUREMENT
/begin MEASUREMENT DINH_nrActvInhReas.FId_FanCtlLiSwtInfo "Number of active inhibit reasons for the FIds / Number of active inhibit reasons for FId_FanCtlLiSwtInfo" UWORD DINH_ct_Compu 1 100 -4095.000 4096.000 BIT_MASK 0x1fff FORMAT "%8.3" ECU_ADDRESS 0x600143E6 /end MEASUREMENT
/begin MEASUREMENT DINH_nrActvInhReas.FId_FanCtlSpd "Number of active inhibit reasons for the FIds / Number of active inhibit reasons for FId_FanCtlSpd" UWORD DINH_ct_Compu 1 100 -4095.000 4096.000 BIT_MASK 0x1fff FORMAT "%8.3" ECU_ADDRESS 0x600143E8 /end MEASUREMENT
/begin MEASUREMENT DINH_nrActvInhReas.FId_FanCtlTSnsrErr "Number of active inhibit reasons for the FIds / Number of active inhibit reasons for FId_FanCtlTSnsrErr" UWORD DINH_ct_Compu 1 100 -4095.000 4096.000 BIT_MASK 0x1fff FORMAT "%8.3" ECU_ADDRESS 0x600143EA /end MEASUREMENT
/begin MEASUREMENT DINH_nrActvInhReas.FId_FanCtlThr1 "Number of active inhibit reasons for the FIds / Number of active inhibit reasons for FId_FanCtlThr1" UWORD DINH_ct_Compu 1 100 -4095.000 4096.000 BIT_MASK 0x1fff FORMAT "%8.3" ECU_ADDRESS 0x600143EC /end MEASUREMENT
/begin MEASUREMENT DINH_nrActvInhReas.FId_FanCtlThr2 "Number of active inhibit reasons for the FIds / Number of active inhibit reasons for FId_FanCtlThr2" UWORD DINH_ct_Compu 1 100 -4095.000 4096.000 BIT_MASK 0x1fff FORMAT "%8.3" ECU_ADDRESS 0x600143EE /end MEASUREMENT
/begin MEASUREMENT DINH_nrActvInhReas.FId_FcoReq "Number of active inhibit reasons for the FIds / Number of active inhibit reasons for FId_FcoReq" UWORD DINH_ct_Compu 1 100 -4095.000 4096.000 BIT_MASK 0x1fff FORMAT "%8.3" ECU_ADDRESS 0x600143F0 /end MEASUREMENT
/begin MEASUREMENT DINH_nrActvInhReas.FId_FiMFID_rba_MRly_Diag_Stk "Number of active inhibit reasons for the FIds / Number of active inhibit reasons for FId_FiMFID_rba_MRly_Diag_Stk" UWORD DINH_ct_Compu 1 100 -4095.000 4096.000 BIT_MASK 0x1fff FORMAT "%8.3" ECU_ADDRESS 0x600143F2 /end MEASUREMENT
/begin MEASUREMENT DINH_nrActvInhReas.FId_FlComErr "Number of active inhibit reasons for the FIds / Number of active inhibit reasons for FId_FlComErr" UWORD DINH_ct_Compu 1 100 -4095.000 4096.000 BIT_MASK 0x1fff FORMAT "%8.3" ECU_ADDRESS 0x600143F4 /end MEASUREMENT
/begin MEASUREMENT DINH_nrActvInhReas.FId_FlDevPlauDiagFuSnsr "Number of active inhibit reasons for the FIds / Number of active inhibit reasons for FId_FlDevPlauDiagFuSnsr" UWORD DINH_ct_Compu 1 100 -4095.000 4096.000 BIT_MASK 0x1fff FORMAT "%8.3" ECU_ADDRESS 0x600143F6 /end MEASUREMENT
/begin MEASUREMENT DINH_nrActvInhReas.FId_FlLvlNoSigErr "Number of active inhibit reasons for the FIds / Number of active inhibit reasons for FId_FlLvlNoSigErr" UWORD DINH_ct_Compu 1 100 -4095.000 4096.000 BIT_MASK 0x1fff FORMAT "%8.3" ECU_ADDRESS 0x600143F8 /end MEASUREMENT
/begin MEASUREMENT DINH_nrActvInhReas.FId_FlLvlVehSpdSigErr "Number of active inhibit reasons for the FIds / Number of active inhibit reasons for FId_FlLvlVehSpdSigErr" UWORD DINH_ct_Compu 1 100 -4095.000 4096.000 BIT_MASK 0x1fff FORMAT "%8.3" ECU_ADDRESS 0x600143FA /end MEASUREMENT
/begin MEASUREMENT DINH_nrActvInhReas.FId_FlLvlVehVErr "Number of active inhibit reasons for the FIds / Number of active inhibit reasons for FId_FlLvlVehVErr" UWORD DINH_ct_Compu 1 100 -4095.000 4096.000 BIT_MASK 0x1fff FORMAT "%8.3" ECU_ADDRESS 0x600143FC /end MEASUREMENT
/begin MEASUREMENT DINH_nrActvInhReas.FId_FlMALamDynDiag "Number of active inhibit reasons for the FIds / Number of active inhibit reasons for FId_FlMALamDynDiag" UWORD DINH_ct_Compu 1 100 -4095.000 4096.000 BIT_MASK 0x1fff FORMAT "%8.3" ECU_ADDRESS 0x600143FE /end MEASUREMENT
/begin MEASUREMENT DINH_nrActvInhReas.FId_FlSplGAltLin "Number of active inhibit reasons for the FIds / Number of active inhibit reasons for FId_FlSplGAltLin" UWORD DINH_ct_Compu 1 100 -4095.000 4096.000 BIT_MASK 0x1fff FORMAT "%8.3" ECU_ADDRESS 0x60014400 /end MEASUREMENT
/begin MEASUREMENT DINH_nrActvInhReas.FId_FlTnkQnt "Number of active inhibit reasons for the FIds / Number of active inhibit reasons for FId_FlTnkQnt" UWORD DINH_ct_Compu 1 100 -4095.000 4096.000 BIT_MASK 0x1fff FORMAT "%8.3" ECU_ADDRESS 0x60014402 /end MEASUREMENT
/begin MEASUREMENT DINH_nrActvInhReas.FId_FuMixHotFilmErr "Number of active inhibit reasons for the FIds / Number of active inhibit reasons for FId_FuMixHotFilmErr" UWORD DINH_ct_Compu 1 100 -4095.000 4096.000 BIT_MASK 0x1fff FORMAT "%8.3" ECU_ADDRESS 0x60014404 /end MEASUREMENT
/begin MEASUREMENT DINH_nrActvInhReas.FId_FuMixUegoErrExcl "Number of active inhibit reasons for the FIds / Number of active inhibit reasons for FId_FuMixUegoErrExcl" UWORD DINH_ct_Compu 1 100 -4095.000 4096.000 BIT_MASK 0x1fff FORMAT "%8.3" ECU_ADDRESS 0x60014406 /end MEASUREMENT
/begin MEASUREMENT DINH_nrActvInhReas.FId_FuPHiRailEthnlSnsrErr "Number of active inhibit reasons for the FIds / Number of active inhibit reasons for FId_FuPHiRailEthnlSnsrErr" UWORD DINH_ct_Compu 1 100 -4095.000 4096.000 BIT_MASK 0x1fff FORMAT "%8.3" ECU_ADDRESS 0x60014408 /end MEASUREMENT
/begin MEASUREMENT DINH_nrActvInhReas.FId_FuPurg_TEVError "Number of active inhibit reasons for the FIds / Number of active inhibit reasons for FId_FuPurg_TEVError" UWORD DINH_ct_Compu 1 100 -4095.000 4096.000 BIT_MASK 0x1fff FORMAT "%8.3" ECU_ADDRESS 0x6001440A /end MEASUREMENT
/begin MEASUREMENT DINH_nrActvInhReas.FId_FuSnsrPhyRngErr "Number of active inhibit reasons for the FIds / Number of active inhibit reasons for FId_FuSnsrPhyRngErr" UWORD DINH_ct_Compu 1 100 -4095.000 4096.000 BIT_MASK 0x1fff FORMAT "%8.3" ECU_ADDRESS 0x6001440C /end MEASUREMENT
/begin MEASUREMENT DINH_nrActvInhReas.FId_GEVCtlAVCAdprCBBNWEErrIntk "Number of active inhibit reasons for the FIds / Number of active inhibit reasons for FId_GEVCtlAVCAdprCBBNWEErrIntk" UWORD DINH_ct_Compu 1 100 -4095.000 4096.000 BIT_MASK 0x1fff FORMAT "%8.3" ECU_ADDRESS 0x6001440E /end MEASUREMENT
/begin MEASUREMENT DINH_nrActvInhReas.FId_GEVCtlAVCAdprIntkB1 "Number of active inhibit reasons for the FIds / Number of active inhibit reasons for FId_GEVCtlAVCAdprIntkB1" UWORD DINH_ct_Compu 1 100 -4095.000 4096.000 BIT_MASK 0x1fff FORMAT "%8.3" ECU_ADDRESS 0x60014410 /end MEASUREMENT
/begin MEASUREMENT DINH_nrActvInhReas.FId_GEVCtlAVCAdprNWSEErrIntk "Number of active inhibit reasons for the FIds / Number of active inhibit reasons for FId_GEVCtlAVCAdprNWSEErrIntk" UWORD DINH_ct_Compu 1 100 -4095.000 4096.000 BIT_MASK 0x1fff FORMAT "%8.3" ECU_ADDRESS 0x60014412 /end MEASUREMENT
/begin MEASUREMENT DINH_nrActvInhReas.FId_GEVCtlAdpnEnaIntk "Number of active inhibit reasons for the FIds / Number of active inhibit reasons for FId_GEVCtlAdpnEnaIntk" UWORD DINH_ct_Compu 1 100 -4095.000 4096.000 BIT_MASK 0x1fff FORMAT "%8.3" ECU_ADDRESS 0x60014414 /end MEASUREMENT
/begin MEASUREMENT DINH_nrActvInhReas.FId_GEVCtlAdpnEnaShtrpActv "Number of active inhibit reasons for the FIds / Number of active inhibit reasons for FId_GEVCtlAdpnEnaShtrpActv" UWORD DINH_ct_Compu 1 100 -4095.000 4096.000 BIT_MASK 0x1fff FORMAT "%8.3" ECU_ADDRESS 0x60014416 /end MEASUREMENT
/begin MEASUREMENT DINH_nrActvInhReas.FId_GEVCtlClngIntk "Number of active inhibit reasons for the FIds / Number of active inhibit reasons for FId_GEVCtlClngIntk" UWORD DINH_ct_Compu 1 100 -4095.000 4096.000 BIT_MASK 0x1fff FORMAT "%8.3" ECU_ADDRESS 0x60014418 /end MEASUREMENT
/begin MEASUREMENT DINH_nrActvInhReas.FId_GEVCtlMinOvlIntk "Number of active inhibit reasons for the FIds / Number of active inhibit reasons for FId_GEVCtlMinOvlIntk" UWORD DINH_ct_Compu 1 100 -4095.000 4096.000 BIT_MASK 0x1fff FORMAT "%8.3" ECU_ADDRESS 0x6001441A /end MEASUREMENT
/begin MEASUREMENT DINH_nrActvInhReas.FId_GEVCtlPOilSnsr "Number of active inhibit reasons for the FIds / Number of active inhibit reasons for FId_GEVCtlPOilSnsr" UWORD DINH_ct_Compu 1 100 -4095.000 4096.000 BIT_MASK 0x1fff FORMAT "%8.3" ECU_ADDRESS 0x6001441C /end MEASUREMENT
/begin MEASUREMENT DINH_nrActvInhReas.FId_GEVCtlPhaEnaIntk "Number of active inhibit reasons for the FIds / Number of active inhibit reasons for FId_GEVCtlPhaEnaIntk" UWORD DINH_ct_Compu 1 100 -4095.000 4096.000 BIT_MASK 0x1fff FORMAT "%8.3" ECU_ADDRESS 0x6001441E /end MEASUREMENT
/begin MEASUREMENT DINH_nrActvInhReas.FId_GEVCtlPhaSpTstrIntk "Number of active inhibit reasons for the FIds / Number of active inhibit reasons for FId_GEVCtlPhaSpTstrIntk" UWORD DINH_ct_Compu 1 100 -4095.000 4096.000 BIT_MASK 0x1fff FORMAT "%8.3" ECU_ADDRESS 0x60014420 /end MEASUREMENT
/begin MEASUREMENT DINH_nrActvInhReas.FId_GEVCtlRefAdpnMntChck "Number of active inhibit reasons for the FIds / Number of active inhibit reasons for FId_GEVCtlRefAdpnMntChck" UWORD DINH_ct_Compu 1 100 -4095.000 4096.000 BIT_MASK 0x1fff FORMAT "%8.3" ECU_ADDRESS 0x60014422 /end MEASUREMENT
/begin MEASUREMENT DINH_nrActvInhReas.FId_GEVCtlRefAdpnMntChckTstd "Number of active inhibit reasons for the FIds / Number of active inhibit reasons for FId_GEVCtlRefAdpnMntChckTstd" UWORD DINH_ct_Compu 1 100 -4095.000 4096.000 BIT_MASK 0x1fff FORMAT "%8.3" ECU_ADDRESS 0x60014424 /end MEASUREMENT
/begin MEASUREMENT DINH_nrActvInhReas.FId_GEVCtlReqRefAdpnTstrIntk "Number of active inhibit reasons for the FIds / Number of active inhibit reasons for FId_GEVCtlReqRefAdpnTstrIntk" UWORD DINH_ct_Compu 1 100 -4095.000 4096.000 BIT_MASK 0x1fff FORMAT "%8.3" ECU_ADDRESS 0x60014426 /end MEASUREMENT
/begin MEASUREMENT DINH_nrActvInhReas.FId_GEVCtlReqRefAdpnTstrIntkTstd "Number of active inhibit reasons for the FIds / Number of active inhibit reasons for FId_GEVCtlReqRefAdpnTstrIntkTstd" UWORD DINH_ct_Compu 1 100 -4095.000 4096.000 BIT_MASK 0x1fff FORMAT "%8.3" ECU_ADDRESS 0x60014428 /end MEASUREMENT
/begin MEASUREMENT DINH_nrActvInhReas.FId_GEVCtlVlvLftEnaIntk "Number of active inhibit reasons for the FIds / Number of active inhibit reasons for FId_GEVCtlVlvLftEnaIntk" UWORD DINH_ct_Compu 1 100 -4095.000 4096.000 BIT_MASK 0x1fff FORMAT "%8.3" ECU_ADDRESS 0x6001442A /end MEASUREMENT
/begin MEASUREMENT DINH_nrActvInhReas.FId_GEVCtlVlvOpenClsdIntkB1 "Number of active inhibit reasons for the FIds / Number of active inhibit reasons for FId_GEVCtlVlvOpenClsdIntkB1" UWORD DINH_ct_Compu 1 100 -4095.000 4096.000 BIT_MASK 0x1fff FORMAT "%8.3" ECU_ADDRESS 0x6001442C /end MEASUREMENT
/begin MEASUREMENT DINH_nrActvInhReas.FId_GEVlvLockPinDiagIntkB1 "Number of active inhibit reasons for the FIds / Number of active inhibit reasons for FId_GEVlvLockPinDiagIntkB1" UWORD DINH_ct_Compu 1 100 -4095.000 4096.000 BIT_MASK 0x1fff FORMAT "%8.3" ECU_ADDRESS 0x6001442E /end MEASUREMENT
/begin MEASUREMENT DINH_nrActvInhReas.FId_GEVlvPhaDiagEnaCsersIntkB1 "Number of active inhibit reasons for the FIds / Number of active inhibit reasons for FId_GEVlvPhaDiagEnaCsersIntkB1" UWORD DINH_ct_Compu 1 100 -4095.000 4096.000 BIT_MASK 0x1fff FORMAT "%8.3" ECU_ADDRESS 0x60014430 /end MEASUREMENT
/begin MEASUREMENT DINH_nrActvInhReas.FId_GEVlvPhaDiagEnaIntkB1 "Number of active inhibit reasons for the FIds / Number of active inhibit reasons for FId_GEVlvPhaDiagEnaIntkB1" UWORD DINH_ct_Compu 1 100 -4095.000 4096.000 BIT_MASK 0x1fff FORMAT "%8.3" ECU_ADDRESS 0x60014432 /end MEASUREMENT
/begin MEASUREMENT DINH_nrActvInhReas.FId_GEVlvPhaPsIntkB1 "Number of active inhibit reasons for the FIds / Number of active inhibit reasons for FId_GEVlvPhaPsIntkB1" UWORD DINH_ct_Compu 1 100 -4095.000 4096.000 BIT_MASK 0x1fff FORMAT "%8.3" ECU_ADDRESS 0x60014434 /end MEASUREMENT
/begin MEASUREMENT DINH_nrActvInhReas.FId_GbxAnNeutPosnErr "Number of active inhibit reasons for the FIds / Number of active inhibit reasons for FId_GbxAnNeutPosnErr" UWORD DINH_ct_Compu 1 100 -4095.000 4096.000 BIT_MASK 0x1fff FORMAT "%8.3" ECU_ADDRESS 0x60014436 /end MEASUREMENT
/begin MEASUREMENT DINH_nrActvInhReas.FId_GbxCANDigPlausErr "Number of active inhibit reasons for the FIds / Number of active inhibit reasons for FId_GbxCANDigPlausErr" UWORD DINH_ct_Compu 1 100 -4095.000 4096.000 BIT_MASK 0x1fff FORMAT "%8.3" ECU_ADDRESS 0x60014438 /end MEASUREMENT
/begin MEASUREMENT DINH_nrActvInhReas.FId_GbxCANNeutSigErr "Number of active inhibit reasons for the FIds / Number of active inhibit reasons for FId_GbxCANNeutSigErr" UWORD DINH_ct_Compu 1 100 -4095.000 4096.000 BIT_MASK 0x1fff FORMAT "%8.3" ECU_ADDRESS 0x6001443A /end MEASUREMENT
/begin MEASUREMENT DINH_nrActvInhReas.FId_GbxPNPosSig "Number of active inhibit reasons for the FIds / Number of active inhibit reasons for FId_GbxPNPosSig" UWORD DINH_ct_Compu 1 100 -4095.000 4096.000 BIT_MASK 0x1fff FORMAT "%8.3" ECU_ADDRESS 0x6001443C /end MEASUREMENT
/begin MEASUREMENT DINH_nrActvInhReas.FId_GbxPNPosnComErr "Number of active inhibit reasons for the FIds / Number of active inhibit reasons for FId_GbxPNPosnComErr" UWORD DINH_ct_Compu 1 100 -4095.000 4096.000 BIT_MASK 0x1fff FORMAT "%8.3" ECU_ADDRESS 0x6001443E /end MEASUREMENT
/begin MEASUREMENT DINH_nrActvInhReas.FId_GbxPNPosnDiagDrvCdnRels "Number of active inhibit reasons for the FIds / Number of active inhibit reasons for FId_GbxPNPosnDiagDrvCdnRels" UWORD DINH_ct_Compu 1 100 -4095.000 4096.000 BIT_MASK 0x1fff FORMAT "%8.3" ECU_ADDRESS 0x60014440 /end MEASUREMENT
/begin MEASUREMENT DINH_nrActvInhReas.FId_GbxPNPosnDiagDrvCodnHealRels "Number of active inhibit reasons for the FIds / Number of active inhibit reasons for FId_GbxPNPosnDiagDrvCodnHealRels" UWORD DINH_ct_Compu 1 100 -4095.000 4096.000 BIT_MASK 0x1fff FORMAT "%8.3" ECU_ADDRESS 0x60014442 /end MEASUREMENT
/begin MEASUREMENT DINH_nrActvInhReas.FId_GbxPNPosnDiagPlausyRels "Number of active inhibit reasons for the FIds / Number of active inhibit reasons for FId_GbxPNPosnDiagPlausyRels" UWORD DINH_ct_Compu 1 100 -4095.000 4096.000 BIT_MASK 0x1fff FORMAT "%8.3" ECU_ADDRESS 0x60014444 /end MEASUREMENT
/begin MEASUREMENT DINH_nrActvInhReas.FId_GbxPNPosnSubsVal "Number of active inhibit reasons for the FIds / Number of active inhibit reasons for FId_GbxPNPosnSubsVal" UWORD DINH_ct_Compu 1 100 -4095.000 4096.000 BIT_MASK 0x1fff FORMAT "%8.3" ECU_ADDRESS 0x60014446 /end MEASUREMENT
/begin MEASUREMENT DINH_nrActvInhReas.FId_GbxRvsSwtStk "Number of active inhibit reasons for the FIds / Number of active inhibit reasons for FId_GbxRvsSwtStk" UWORD DINH_ct_Compu 1 100 -4095.000 4096.000 BIT_MASK 0x1fff FORMAT "%8.3" ECU_ADDRESS 0x60014448 /end MEASUREMENT
/begin MEASUREMENT DINH_nrActvInhReas.FId_GbxSnsrSplyUErr "Number of active inhibit reasons for the FIds / Number of active inhibit reasons for FId_GbxSnsrSplyUErr" UWORD DINH_ct_Compu 1 100 -4095.000 4096.000 BIT_MASK 0x1fff FORMAT "%8.3" ECU_ADDRESS 0x6001444A /end MEASUREMENT
/begin MEASUREMENT DINH_nrActvInhReas.FId_GbxSpstReqOk "Number of active inhibit reasons for the FIds / Number of active inhibit reasons for FId_GbxSpstReqOk" UWORD DINH_ct_Compu 1 100 -4095.000 4096.000 BIT_MASK 0x1fff FORMAT "%8.3" ECU_ADDRESS 0x6001444C /end MEASUREMENT
/begin MEASUREMENT DINH_nrActvInhReas.FId_GlbDaLSumvXPtd "Number of active inhibit reasons for the FIds / Number of active inhibit reasons for FId_GlbDaLSumvXPtd" UWORD DINH_ct_Compu 1 100 -4095.000 4096.000 BIT_MASK 0x1fff FORMAT "%8.3" ECU_ADDRESS 0x6001444E /end MEASUREMENT
/begin MEASUREMENT DINH_nrActvInhReas.FId_GslThrVlvSnsrDiagB1 "Number of active inhibit reasons for the FIds / Number of active inhibit reasons for FId_GslThrVlvSnsrDiagB1" UWORD DINH_ct_Compu 1 100 -4095.000 4096.000 BIT_MASK 0x1fff FORMAT "%8.3" ECU_ADDRESS 0x60014450 /end MEASUREMENT
/begin MEASUREMENT DINH_nrActvInhReas.FId_HEGOS2B1DElec "Number of active inhibit reasons for the FIds / Number of active inhibit reasons for FId_HEGOS2B1DElec" UWORD DINH_ct_Compu 1 100 -4095.000 4096.000 BIT_MASK 0x1fff FORMAT "%8.3" ECU_ADDRESS 0x60014452 /end MEASUREMENT
/begin MEASUREMENT DINH_nrActvInhReas.FId_HEGOS2B1DHtg "Number of active inhibit reasons for the FIds / Number of active inhibit reasons for FId_HEGOS2B1DHtg" UWORD DINH_ct_Compu 1 100 -4095.000 4096.000 BIT_MASK 0x1fff FORMAT "%8.3" ECU_ADDRESS 0x60014454 /end MEASUREMENT
/begin MEASUREMENT DINH_nrActvInhReas.FId_HEGOS2B1Htg "Number of active inhibit reasons for the FIds / Number of active inhibit reasons for FId_HEGOS2B1Htg" UWORD DINH_ct_Compu 1 100 -4095.000 4096.000 BIT_MASK 0x1fff FORMAT "%8.3" ECU_ADDRESS 0x60014456 /end MEASUREMENT
/begin MEASUREMENT DINH_nrActvInhReas.FId_HEGOS2B1HtrPsSt "Number of active inhibit reasons for the FIds / Number of active inhibit reasons for FId_HEGOS2B1HtrPsSt" UWORD DINH_ct_Compu 1 100 -4095.000 4096.000 BIT_MASK 0x1fff FORMAT "%8.3" ECU_ADDRESS 0x60014458 /end MEASUREMENT
/begin MEASUREMENT DINH_nrActvInhReas.FId_HEGOS2B1InVld "Number of active inhibit reasons for the FIds / Number of active inhibit reasons for FId_HEGOS2B1InVld" UWORD DINH_ct_Compu 1 100 -4095.000 4096.000 BIT_MASK 0x1fff FORMAT "%8.3" ECU_ADDRESS 0x6001445A /end MEASUREMENT
/begin MEASUREMENT DINH_nrActvInhReas.FId_HEGOS2B1LSPsDiaDi "Number of active inhibit reasons for the FIds / Number of active inhibit reasons for FId_HEGOS2B1LSPsDiaDi" UWORD DINH_ct_Compu 1 100 -4095.000 4096.000 BIT_MASK 0x1fff FORMAT "%8.3" ECU_ADDRESS 0x6001445C /end MEASUREMENT
/begin MEASUREMENT DINH_nrActvInhReas.FId_HLSDemBrkFlt "Number of active inhibit reasons for the FIds / Number of active inhibit reasons for FId_HLSDemBrkFlt" UWORD DINH_ct_Compu 1 100 -4095.000 4096.000 BIT_MASK 0x1fff FORMAT "%8.3" ECU_ADDRESS 0x6001445E /end MEASUREMENT
/begin MEASUREMENT DINH_nrActvInhReas.FId_HLSDemErr1 "Number of active inhibit reasons for the FIds / Number of active inhibit reasons for FId_HLSDemErr1" UWORD DINH_ct_Compu 1 100 -4095.000 4096.000 BIT_MASK 0x1fff FORMAT "%8.3" ECU_ADDRESS 0x60014460 /end MEASUREMENT
/begin MEASUREMENT DINH_nrActvInhReas.FId_HLSDemErr2 "Number of active inhibit reasons for the FIds / Number of active inhibit reasons for FId_HLSDemErr2" UWORD DINH_ct_Compu 1 100 -4095.000 4096.000 BIT_MASK 0x1fff FORMAT "%8.3" ECU_ADDRESS 0x60014462 /end MEASUREMENT
/begin MEASUREMENT DINH_nrActvInhReas.FId_HLSDemIntkAirTemp "Number of active inhibit reasons for the FIds / Number of active inhibit reasons for FId_HLSDemIntkAirTemp" UWORD DINH_ct_Compu 1 100 -4095.000 4096.000 BIT_MASK 0x1fff FORMAT "%8.3" ECU_ADDRESS 0x60014464 /end MEASUREMENT
/begin MEASUREMENT DINH_nrActvInhReas.FId_HLSDemMotTemp "Number of active inhibit reasons for the FIds / Number of active inhibit reasons for FId_HLSDemMotTemp" UWORD DINH_ct_Compu 1 100 -4095.000 4096.000 BIT_MASK 0x1fff FORMAT "%8.3" ECU_ADDRESS 0x60014466 /end MEASUREMENT
/begin MEASUREMENT DINH_nrActvInhReas.FId_HLSDemMstCyldpVld "Number of active inhibit reasons for the FIds / Number of active inhibit reasons for FId_HLSDemMstCyldpVld" UWORD DINH_ct_Compu 1 100 -4095.000 4096.000 BIT_MASK 0x1fff FORMAT "%8.3" ECU_ADDRESS 0x60014468 /end MEASUREMENT
/begin MEASUREMENT DINH_nrActvInhReas.FId_HLSDemSpdClthGearAccrSigErr "Number of active inhibit reasons for the FIds / Number of active inhibit reasons for FId_HLSDemSpdClthGearAccrSigErr" UWORD DINH_ct_Compu 1 100 -4095.000 4096.000 BIT_MASK 0x1fff FORMAT "%8.3" ECU_ADDRESS 0x6001446A /end MEASUREMENT
/begin MEASUREMENT DINH_nrActvInhReas.FId_HLSDem_DrvOffSuprt "Number of active inhibit reasons for the FIds / Number of active inhibit reasons for FId_HLSDem_DrvOffSuprt" UWORD DINH_ct_Compu 1 100 -4095.000 4096.000 BIT_MASK 0x1fff FORMAT "%8.3" ECU_ADDRESS 0x6001446C /end MEASUREMENT
/begin MEASUREMENT DINH_nrActvInhReas.FId_HLSDem_DrvOffSuprtBrkHldSys "Number of active inhibit reasons for the FIds / Number of active inhibit reasons for FId_HLSDem_DrvOffSuprtBrkHldSys" UWORD DINH_ct_Compu 1 100 -4095.000 4096.000 BIT_MASK 0x1fff FORMAT "%8.3" ECU_ADDRESS 0x6001446E /end MEASUREMENT
/begin MEASUREMENT DINH_nrActvInhReas.FId_HLSDem_DrvOffSuprtLAS "Number of active inhibit reasons for the FIds / Number of active inhibit reasons for FId_HLSDem_DrvOffSuprtLAS" UWORD DINH_ct_Compu 1 100 -4095.000 4096.000 BIT_MASK 0x1fff FORMAT "%8.3" ECU_ADDRESS 0x60014470 /end MEASUREMENT
/begin MEASUREMENT DINH_nrActvInhReas.FId_HLSDem_PModeActv "Number of active inhibit reasons for the FIds / Number of active inhibit reasons for FId_HLSDem_PModeActv" UWORD DINH_ct_Compu 1 100 -4095.000 4096.000 BIT_MASK 0x1fff FORMAT "%8.3" ECU_ADDRESS 0x60014472 /end MEASUREMENT
/begin MEASUREMENT DINH_nrActvInhReas.FId_HLSDem_TModeActv "Number of active inhibit reasons for the FIds / Number of active inhibit reasons for FId_HLSDem_TModeActv" UWORD DINH_ct_Compu 1 100 -4095.000 4096.000 BIT_MASK 0x1fff FORMAT "%8.3" ECU_ADDRESS 0x60014474 /end MEASUREMENT
/begin MEASUREMENT DINH_nrActvInhReas.FId_HLSDem_TraSubFcn "Number of active inhibit reasons for the FIds / Number of active inhibit reasons for FId_HLSDem_TraSubFcn" UWORD DINH_ct_Compu 1 100 -4095.000 4096.000 BIT_MASK 0x1fff FORMAT "%8.3" ECU_ADDRESS 0x60014476 /end MEASUREMENT
/begin MEASUREMENT DINH_nrActvInhReas.FId_HLSDem_nMaxLimErr1 "Number of active inhibit reasons for the FIds / Number of active inhibit reasons for FId_HLSDem_nMaxLimErr1" UWORD DINH_ct_Compu 1 100 -4095.000 4096.000 BIT_MASK 0x1fff FORMAT "%8.3" ECU_ADDRESS 0x60014478 /end MEASUREMENT
/begin MEASUREMENT DINH_nrActvInhReas.FId_HLSDem_nMaxLimErr2 "Number of active inhibit reasons for the FIds / Number of active inhibit reasons for FId_HLSDem_nMaxLimErr2" UWORD DINH_ct_Compu 1 100 -4095.000 4096.000 BIT_MASK 0x1fff FORMAT "%8.3" ECU_ADDRESS 0x6001447A /end MEASUREMENT
/begin MEASUREMENT DINH_nrActvInhReas.FId_HLSDem_nMaxLimErr3 "Number of active inhibit reasons for the FIds / Number of active inhibit reasons for FId_HLSDem_nMaxLimErr3" UWORD DINH_ct_Compu 1 100 -4095.000 4096.000 BIT_MASK 0x1fff FORMAT "%8.3" ECU_ADDRESS 0x6001447C /end MEASUREMENT
/begin MEASUREMENT DINH_nrActvInhReas.FId_HLSDem_nMaxVErr "Number of active inhibit reasons for the FIds / Number of active inhibit reasons for FId_HLSDem_nMaxVErr" UWORD DINH_ct_Compu 1 100 -4095.000 4096.000 BIT_MASK 0x1fff FORMAT "%8.3" ECU_ADDRESS 0x6001447E /end MEASUREMENT
/begin MEASUREMENT DINH_nrActvInhReas.FId_I14229APP "Number of active inhibit reasons for the FIds / Number of active inhibit reasons for FId_I14229APP" UWORD DINH_ct_Compu 1 100 -4095.000 4096.000 BIT_MASK 0x1fff FORMAT "%8.3" ECU_ADDRESS 0x60014480 /end MEASUREMENT
/begin MEASUREMENT DINH_nrActvInhReas.FId_I14229CANErr "Number of active inhibit reasons for the FIds / Number of active inhibit reasons for FId_I14229CANErr" UWORD DINH_ct_Compu 1 100 -4095.000 4096.000 BIT_MASK 0x1fff FORMAT "%8.3" ECU_ADDRESS 0x60014482 /end MEASUREMENT
/begin MEASUREMENT DINH_nrActvInhReas.FId_I14229FlLvlFltComErr "Number of active inhibit reasons for the FIds / Number of active inhibit reasons for FId_I14229FlLvlFltComErr" UWORD DINH_ct_Compu 1 100 -4095.000 4096.000 BIT_MASK 0x1fff FORMAT "%8.3" ECU_ADDRESS 0x60014484 /end MEASUREMENT
/begin MEASUREMENT DINH_nrActvInhReas.FId_I14229VTCErr "Number of active inhibit reasons for the FIds / Number of active inhibit reasons for FId_I14229VTCErr" UWORD DINH_ct_Compu 1 100 -4095.000 4096.000 BIT_MASK 0x1fff FORMAT "%8.3" ECU_ADDRESS 0x60014486 /end MEASUREMENT
/begin MEASUREMENT DINH_nrActvInhReas.FId_IMGISABComErr "Number of active inhibit reasons for the FIds / Number of active inhibit reasons for FId_IMGISABComErr" UWORD DINH_ct_Compu 1 100 -4095.000 4096.000 BIT_MASK 0x1fff FORMAT "%8.3" ECU_ADDRESS 0x60014488 /end MEASUREMENT
/begin MEASUREMENT DINH_nrActvInhReas.FId_InhbLamDynS1B1 "Number of active inhibit reasons for the FIds / Number of active inhibit reasons for FId_InhbLamDynS1B1" UWORD DINH_ct_Compu 1 100 -4095.000 4096.000 BIT_MASK 0x1fff FORMAT "%8.3" ECU_ADDRESS 0x6001448A /end MEASUREMENT
/begin MEASUREMENT DINH_nrActvInhReas.FId_InhbnBlkdLineDiag "Number of active inhibit reasons for the FIds / Number of active inhibit reasons for FId_InhbnBlkdLineDiag" UWORD DINH_ct_Compu 1 100 -4095.000 4096.000 BIT_MASK 0x1fff FORMAT "%8.3" ECU_ADDRESS 0x6001448C /end MEASUREMENT
/begin MEASUREMENT DINH_nrActvInhReas.FId_InhibitAlways "Number of active inhibit reasons for the FIds / Number of active inhibit reasons for FId_InhibitAlways" UWORD DINH_ct_Compu 1 100 -4095.000 4096.000 BIT_MASK 0x1fff FORMAT "%8.3" ECU_ADDRESS 0x6001448E /end MEASUREMENT
/begin MEASUREMENT DINH_nrActvInhReas.FId_InhibitNever "Number of active inhibit reasons for the FIds / Number of active inhibit reasons for FId_InhibitNever" UWORD DINH_ct_Compu 1 100 -4095.000 4096.000 BIT_MASK 0x1fff FORMAT "%8.3" ECU_ADDRESS 0x60014490 /end MEASUREMENT
/begin MEASUREMENT DINH_nrActvInhReas.FId_InjSysMulInjDiagErr "Number of active inhibit reasons for the FIds / Number of active inhibit reasons for FId_InjSysMulInjDiagErr" UWORD DINH_ct_Compu 1 100 -4095.000 4096.000 BIT_MASK 0x1fff FORMAT "%8.3" ECU_ADDRESS 0x60014492 /end MEASUREMENT
/begin MEASUREMENT DINH_nrActvInhReas.FId_InjVlvPs_Bank1OnlyErr "Number of active inhibit reasons for the FIds / Number of active inhibit reasons for FId_InjVlvPs_Bank1OnlyErr" UWORD DINH_ct_Compu 1 100 -4095.000 4096.000 BIT_MASK 0x1fff FORMAT "%8.3" ECU_ADDRESS 0x60014494 /end MEASUREMENT
/begin MEASUREMENT DINH_nrActvInhReas.FId_InjVlvPs_Bank1Tested "Number of active inhibit reasons for the FIds / Number of active inhibit reasons for FId_InjVlvPs_Bank1Tested" UWORD DINH_ct_Compu 1 100 -4095.000 4096.000 BIT_MASK 0x1fff FORMAT "%8.3" ECU_ADDRESS 0x60014496 /end MEASUREMENT
/begin MEASUREMENT DINH_nrActvInhReas.FId_InjVlvPs_Bank2OnlyErr "Number of active inhibit reasons for the FIds / Number of active inhibit reasons for FId_InjVlvPs_Bank2OnlyErr" UWORD DINH_ct_Compu 1 100 -4095.000 4096.000 BIT_MASK 0x1fff FORMAT "%8.3" ECU_ADDRESS 0x60014498 /end MEASUREMENT
/begin MEASUREMENT DINH_nrActvInhReas.FId_InjVlvPs_Bank2Tested "Number of active inhibit reasons for the FIds / Number of active inhibit reasons for FId_InjVlvPs_Bank2Tested" UWORD DINH_ct_Compu 1 100 -4095.000 4096.000 BIT_MASK 0x1fff FORMAT "%8.3" ECU_ADDRESS 0x6001449A /end MEASUREMENT
/begin MEASUREMENT DINH_nrActvInhReas.FId_InjVlvPs_Bank3OnlyErr "Number of active inhibit reasons for the FIds / Number of active inhibit reasons for FId_InjVlvPs_Bank3OnlyErr" UWORD DINH_ct_Compu 1 100 -4095.000 4096.000 BIT_MASK 0x1fff FORMAT "%8.3" ECU_ADDRESS 0x6001449C /end MEASUREMENT
/begin MEASUREMENT DINH_nrActvInhReas.FId_InjVlvPs_Bank3Tested "Number of active inhibit reasons for the FIds / Number of active inhibit reasons for FId_InjVlvPs_Bank3Tested" UWORD DINH_ct_Compu 1 100 -4095.000 4096.000 BIT_MASK 0x1fff FORMAT "%8.3" ECU_ADDRESS 0x6001449E /end MEASUREMENT
/begin MEASUREMENT DINH_nrActvInhReas.FId_IntkAirTAirFltDsCrssChk "Number of active inhibit reasons for the FIds / Number of active inhibit reasons for FId_IntkAirTAirFltDsCrssChk" UWORD DINH_ct_Compu 1 100 -4095.000 4096.000 BIT_MASK 0x1fff FORMAT "%8.3" ECU_ADDRESS 0x600144A0 /end MEASUREMENT
/begin MEASUREMENT DINH_nrActvInhReas.FId_IntkAirTAirFltDsPlausChk "Number of active inhibit reasons for the FIds / Number of active inhibit reasons for FId_IntkAirTAirFltDsPlausChk" UWORD DINH_ct_Compu 1 100 -4095.000 4096.000 BIT_MASK 0x1fff FORMAT "%8.3" ECU_ADDRESS 0x600144A2 /end MEASUREMENT
/begin MEASUREMENT DINH_nrActvInhReas.FId_IntkAirTIntkMnfldCrssChk "Number of active inhibit reasons for the FIds / Number of active inhibit reasons for FId_IntkAirTIntkMnfldCrssChk" UWORD DINH_ct_Compu 1 100 -4095.000 4096.000 BIT_MASK 0x1fff FORMAT "%8.3" ECU_ADDRESS 0x600144A4 /end MEASUREMENT
/begin MEASUREMENT DINH_nrActvInhReas.FId_IntkAirTIntkMnfldPlausChk "Number of active inhibit reasons for the FIds / Number of active inhibit reasons for FId_IntkAirTIntkMnfldPlausChk" UWORD DINH_ct_Compu 1 100 -4095.000 4096.000 BIT_MASK 0x1fff FORMAT "%8.3" ECU_ADDRESS 0x600144A6 /end MEASUREMENT
/begin MEASUREMENT DINH_nrActvInhReas.FId_IntkAirTIntkMnfldRepl "Number of active inhibit reasons for the FIds / Number of active inhibit reasons for FId_IntkAirTIntkMnfldRepl" UWORD DINH_ct_Compu 1 100 -4095.000 4096.000 BIT_MASK 0x1fff FORMAT "%8.3" ECU_ADDRESS 0x600144A8 /end MEASUREMENT
/begin MEASUREMENT DINH_nrActvInhReas.FId_IntkAirTSnsr1Elec "Number of active inhibit reasons for the FIds / Number of active inhibit reasons for FId_IntkAirTSnsr1Elec" UWORD DINH_ct_Compu 1 100 -4095.000 4096.000 BIT_MASK 0x1fff FORMAT "%8.3" ECU_ADDRESS 0x600144AA /end MEASUREMENT
/begin MEASUREMENT DINH_nrActvInhReas.FId_IntkAirTSnsr1PRC "Number of active inhibit reasons for the FIds / Number of active inhibit reasons for FId_IntkAirTSnsr1PRC" UWORD DINH_ct_Compu 1 100 -4095.000 4096.000 BIT_MASK 0x1fff FORMAT "%8.3" ECU_ADDRESS 0x600144AC /end MEASUREMENT
/begin MEASUREMENT DINH_nrActvInhReas.FId_IntkAirTSnsr1Sum "Number of active inhibit reasons for the FIds / Number of active inhibit reasons for FId_IntkAirTSnsr1Sum" UWORD DINH_ct_Compu 1 100 -4095.000 4096.000 BIT_MASK 0x1fff FORMAT "%8.3" ECU_ADDRESS 0x600144AE /end MEASUREMENT
/begin MEASUREMENT DINH_nrActvInhReas.FId_IntkAirTSnsr2Elec "Number of active inhibit reasons for the FIds / Number of active inhibit reasons for FId_IntkAirTSnsr2Elec" UWORD DINH_ct_Compu 1 100 -4095.000 4096.000 BIT_MASK 0x1fff FORMAT "%8.3" ECU_ADDRESS 0x600144B0 /end MEASUREMENT
/begin MEASUREMENT DINH_nrActvInhReas.FId_IntkAirTSnsr2PRC "Number of active inhibit reasons for the FIds / Number of active inhibit reasons for FId_IntkAirTSnsr2PRC" UWORD DINH_ct_Compu 1 100 -4095.000 4096.000 BIT_MASK 0x1fff FORMAT "%8.3" ECU_ADDRESS 0x600144B2 /end MEASUREMENT
/begin MEASUREMENT DINH_nrActvInhReas.FId_IntkAirTSnsr2Sum "Number of active inhibit reasons for the FIds / Number of active inhibit reasons for FId_IntkAirTSnsr2Sum" UWORD DINH_ct_Compu 1 100 -4095.000 4096.000 BIT_MASK 0x1fff FORMAT "%8.3" ECU_ADDRESS 0x600144B4 /end MEASUREMENT
/begin MEASUREMENT DINH_nrActvInhReas.FId_IntkArTempENGB "Number of active inhibit reasons for the FIds / Number of active inhibit reasons for FId_IntkArTempENGB" UWORD DINH_ct_Compu 1 100 -4095.000 4096.000 BIT_MASK 0x1fff FORMAT "%8.3" ECU_ADDRESS 0x600144B6 /end MEASUREMENT
/begin MEASUREMENT DINH_nrActvInhReas.FId_LIGovDfrstI "Number of active inhibit reasons for the FIds / Number of active inhibit reasons for FId_LIGovDfrstI" UWORD DINH_ct_Compu 1 100 -4095.000 4096.000 BIT_MASK 0x1fff FORMAT "%8.3" ECU_ADDRESS 0x600144B8 /end MEASUREMENT
/begin MEASUREMENT DINH_nrActvInhReas.FId_LIGovUndrBrk "Number of active inhibit reasons for the FIds / Number of active inhibit reasons for FId_LIGovUndrBrk" UWORD DINH_ct_Compu 1 100 -4095.000 4096.000 BIT_MASK 0x1fff FORMAT "%8.3" ECU_ADDRESS 0x600144BA /end MEASUREMENT
/begin MEASUREMENT DINH_nrActvInhReas.FId_LINDCDCRxErr "Number of active inhibit reasons for the FIds / Number of active inhibit reasons for FId_LINDCDCRxErr" UWORD DINH_ct_Compu 1 100 -4095.000 4096.000 BIT_MASK 0x1fff FORMAT "%8.3" ECU_ADDRESS 0x600144BC /end MEASUREMENT
/begin MEASUREMENT DINH_nrActvInhReas.FId_LLimAppSnsrErr "Number of active inhibit reasons for the FIds / Number of active inhibit reasons for FId_LLimAppSnsrErr" UWORD DINH_ct_Compu 1 100 -4095.000 4096.000 BIT_MASK 0x1fff FORMAT "%8.3" ECU_ADDRESS 0x600144BE /end MEASUREMENT
/begin MEASUREMENT DINH_nrActvInhReas.FId_LLimAppSnsrSyncErr "Number of active inhibit reasons for the FIds / Number of active inhibit reasons for FId_LLimAppSnsrSyncErr" UWORD DINH_ct_Compu 1 100 -4095.000 4096.000 BIT_MASK 0x1fff FORMAT "%8.3" ECU_ADDRESS 0x600144C0 /end MEASUREMENT
/begin MEASUREMENT DINH_nrActvInhReas.FId_LLimMTVehSpdSnsrErr "Number of active inhibit reasons for the FIds / Number of active inhibit reasons for FId_LLimMTVehSpdSnsrErr" UWORD DINH_ct_Compu 1 100 -4095.000 4096.000 BIT_MASK 0x1fff FORMAT "%8.3" ECU_ADDRESS 0x600144C2 /end MEASUREMENT
/begin MEASUREMENT DINH_nrActvInhReas.FId_LLimShutOffEng "Number of active inhibit reasons for the FIds / Number of active inhibit reasons for FId_LLimShutOffEng" UWORD DINH_ct_Compu 1 100 -4095.000 4096.000 BIT_MASK 0x1fff FORMAT "%8.3" ECU_ADDRESS 0x600144C4 /end MEASUREMENT
/begin MEASUREMENT DINH_nrActvInhReas.FId_LRSEBMisf "Number of active inhibit reasons for the FIds / Number of active inhibit reasons for FId_LRSEBMisf" UWORD DINH_ct_Compu 1 100 -4095.000 4096.000 BIT_MASK 0x1fff FORMAT "%8.3" ECU_ADDRESS 0x600144C6 /end MEASUREMENT
/begin MEASUREMENT DINH_nrActvInhReas.FId_LZSR "Number of active inhibit reasons for the FIds / Number of active inhibit reasons for FId_LZSR" UWORD DINH_ct_Compu 1 100 -4095.000 4096.000 BIT_MASK 0x1fff FORMAT "%8.3" ECU_ADDRESS 0x600144C8 /end MEASUREMENT
/begin MEASUREMENT DINH_nrActvInhReas.FId_LeakToMnfld "Number of active inhibit reasons for the FIds / Number of active inhibit reasons for FId_LeakToMnfld" UWORD DINH_ct_Compu 1 100 -4095.000 4096.000 BIT_MASK 0x1fff FORMAT "%8.3" ECU_ADDRESS 0x600144CA /end MEASUREMENT
/begin MEASUREMENT DINH_nrActvInhReas.FId_LeakToMnfldTstd "Number of active inhibit reasons for the FIds / Number of active inhibit reasons for FId_LeakToMnfldTstd" UWORD DINH_ct_Compu 1 100 -4095.000 4096.000 BIT_MASK 0x1fff FORMAT "%8.3" ECU_ADDRESS 0x600144CC /end MEASUREMENT
/begin MEASUREMENT DINH_nrActvInhReas.FId_LimpHomPsErrInjtr "Number of active inhibit reasons for the FIds / Number of active inhibit reasons for FId_LimpHomPsErrInjtr" UWORD DINH_ct_Compu 1 100 -4095.000 4096.000 BIT_MASK 0x1fff FORMAT "%8.3" ECU_ADDRESS 0x600144CE /end MEASUREMENT
/begin MEASUREMENT DINH_nrActvInhReas.FId_LinACGUnitCfmdErr "Number of active inhibit reasons for the FIds / Number of active inhibit reasons for FId_LinACGUnitCfmdErr" UWORD DINH_ct_Compu 1 100 -4095.000 4096.000 BIT_MASK 0x1fff FORMAT "%8.3" ECU_ADDRESS 0x600144D0 /end MEASUREMENT
/begin MEASUREMENT DINH_nrActvInhReas.FId_LinACGUnitNotTstd "Number of active inhibit reasons for the FIds / Number of active inhibit reasons for FId_LinACGUnitNotTstd" UWORD DINH_ct_Compu 1 100 -4095.000 4096.000 BIT_MASK 0x1fff FORMAT "%8.3" ECU_ADDRESS 0x600144D2 /end MEASUREMENT
/begin MEASUREMENT DINH_nrActvInhReas.FId_LinAEVUnitCfmdErr "Number of active inhibit reasons for the FIds / Number of active inhibit reasons for FId_LinAEVUnitCfmdErr" UWORD DINH_ct_Compu 1 100 -4095.000 4096.000 BIT_MASK 0x1fff FORMAT "%8.3" ECU_ADDRESS 0x600144D4 /end MEASUREMENT
/begin MEASUREMENT DINH_nrActvInhReas.FId_LinAEVUnitNotTstd "Number of active inhibit reasons for the FIds / Number of active inhibit reasons for FId_LinAEVUnitNotTstd" UWORD DINH_ct_Compu 1 100 -4095.000 4096.000 BIT_MASK 0x1fff FORMAT "%8.3" ECU_ADDRESS 0x600144D6 /end MEASUREMENT
/begin MEASUREMENT DINH_nrActvInhReas.FId_LinEBSUnitCfmdErr "Number of active inhibit reasons for the FIds / Number of active inhibit reasons for FId_LinEBSUnitCfmdErr" UWORD DINH_ct_Compu 1 100 -4095.000 4096.000 BIT_MASK 0x1fff FORMAT "%8.3" ECU_ADDRESS 0x600144D8 /end MEASUREMENT
/begin MEASUREMENT DINH_nrActvInhReas.FId_LinEBSUnitNotTstd "Number of active inhibit reasons for the FIds / Number of active inhibit reasons for FId_LinEBSUnitNotTstd" UWORD DINH_ct_Compu 1 100 -4095.000 4096.000 BIT_MASK 0x1fff FORMAT "%8.3" ECU_ADDRESS 0x600144DA /end MEASUREMENT
/begin MEASUREMENT DINH_nrActvInhReas.FId_LowPresOilP "Number of active inhibit reasons for the FIds / Number of active inhibit reasons for FId_LowPresOilP" UWORD DINH_ct_Compu 1 100 -4095.000 4096.000 BIT_MASK 0x1fff FORMAT "%8.3" ECU_ADDRESS 0x600144DC /end MEASUREMENT
/begin MEASUREMENT DINH_nrActvInhReas.FId_MFlowAirCrkcsSubVal "Number of active inhibit reasons for the FIds / Number of active inhibit reasons for FId_MFlowAirCrkcsSubVal" UWORD DINH_ct_Compu 1 100 -4095.000 4096.000 BIT_MASK 0x1fff FORMAT "%8.3" ECU_ADDRESS 0x600144DE /end MEASUREMENT
/begin MEASUREMENT DINH_nrActvInhReas.FId_MFuOilMax "Number of active inhibit reasons for the FIds / Number of active inhibit reasons for FId_MFuOilMax" UWORD DINH_ct_Compu 1 100 -4095.000 4096.000 BIT_MASK 0x1fff FORMAT "%8.3" ECU_ADDRESS 0x600144E0 /end MEASUREMENT
/begin MEASUREMENT DINH_nrActvInhReas.FId_MaiLoadSnsr "Number of active inhibit reasons for the FIds / Number of active inhibit reasons for FId_MaiLoadSnsr" UWORD DINH_ct_Compu 1 100 -4095.000 4096.000 BIT_MASK 0x1fff FORMAT "%8.3" ECU_ADDRESS 0x600144E2 /end MEASUREMENT
/begin MEASUREMENT DINH_nrActvInhReas.FId_MaiShaftFailr "Number of active inhibit reasons for the FIds / Number of active inhibit reasons for FId_MaiShaftFailr" UWORD DINH_ct_Compu 1 100 -4095.000 4096.000 BIT_MASK 0x1fff FORMAT "%8.3" ECU_ADDRESS 0x600144E4 /end MEASUREMENT
/begin MEASUREMENT DINH_nrActvInhReas.FId_MfPsDia1 "Number of active inhibit reasons for the FIds / Number of active inhibit reasons for FId_MfPsDia1" UWORD DINH_ct_Compu 1 100 -4095.000 4096.000 BIT_MASK 0x1fff FORMAT "%8.3" ECU_ADDRESS 0x600144E6 /end MEASUREMENT
/begin MEASUREMENT DINH_nrActvInhReas.FId_MisfDetDnAdpn "Number of active inhibit reasons for the FIds / Number of active inhibit reasons for FId_MisfDetDnAdpn" UWORD DINH_ct_Compu 1 100 -4095.000 4096.000 BIT_MASK 0x1fff FORMAT "%8.3" ECU_ADDRESS 0x600144E8 /end MEASUREMENT
/begin MEASUREMENT DINH_nrActvInhReas.FId_MisfDetDnAdpnPlaus "Number of active inhibit reasons for the FIds / Number of active inhibit reasons for FId_MisfDetDnAdpnPlaus" UWORD DINH_ct_Compu 1 100 -4095.000 4096.000 BIT_MASK 0x1fff FORMAT "%8.3" ECU_ADDRESS 0x600144EA /end MEASUREMENT
/begin MEASUREMENT DINH_nrActvInhReas.FId_MisfDetEnvP "Number of active inhibit reasons for the FIds / Number of active inhibit reasons for FId_MisfDetEnvP" UWORD DINH_ct_Compu 1 100 -4095.000 4096.000 BIT_MASK 0x1fff FORMAT "%8.3" ECU_ADDRESS 0x600144EC /end MEASUREMENT
/begin MEASUREMENT DINH_nrActvInhReas.FId_MisfDetSegTiAdpnFco "Number of active inhibit reasons for the FIds / Number of active inhibit reasons for FId_MisfDetSegTiAdpnFco" UWORD DINH_ct_Compu 1 100 -4095.000 4096.000 BIT_MASK 0x1fff FORMAT "%8.3" ECU_ADDRESS 0x600144EE /end MEASUREMENT
/begin MEASUREMENT DINH_nrActvInhReas.FId_MisfDetShtrpAct "Number of active inhibit reasons for the FIds / Number of active inhibit reasons for FId_MisfDetShtrpAct" UWORD DINH_ct_Compu 1 100 -4095.000 4096.000 BIT_MASK 0x1fff FORMAT "%8.3" ECU_ADDRESS 0x600144F0 /end MEASUREMENT
/begin MEASUREMENT DINH_nrActvInhReas.FId_MisfDetStc "Number of active inhibit reasons for the FIds / Number of active inhibit reasons for FId_MisfDetStc" UWORD DINH_ct_Compu 1 100 -4095.000 4096.000 BIT_MASK 0x1fff FORMAT "%8.3" ECU_ADDRESS 0x600144F2 /end MEASUREMENT
/begin MEASUREMENT DINH_nrActvInhReas.FId_MisfDetV "Number of active inhibit reasons for the FIds / Number of active inhibit reasons for FId_MisfDetV" UWORD DINH_ct_Compu 1 100 -4095.000 4096.000 BIT_MASK 0x1fff FORMAT "%8.3" ECU_ADDRESS 0x600144F4 /end MEASUREMENT
/begin MEASUREMENT DINH_nrActvInhReas.FId_MisfDetVWhlFrntLe "Number of active inhibit reasons for the FIds / Number of active inhibit reasons for FId_MisfDetVWhlFrntLe" UWORD DINH_ct_Compu 1 100 -4095.000 4096.000 BIT_MASK 0x1fff FORMAT "%8.3" ECU_ADDRESS 0x600144F6 /end MEASUREMENT
/begin MEASUREMENT DINH_nrActvInhReas.FId_MisfDetVWhlFrntRi "Number of active inhibit reasons for the FIds / Number of active inhibit reasons for FId_MisfDetVWhlFrntRi" UWORD DINH_ct_Compu 1 100 -4095.000 4096.000 BIT_MASK 0x1fff FORMAT "%8.3" ECU_ADDRESS 0x600144F8 /end MEASUREMENT
/begin MEASUREMENT DINH_nrActvInhReas.FId_MisfDetVWhlReLe "Number of active inhibit reasons for the FIds / Number of active inhibit reasons for FId_MisfDetVWhlReLe" UWORD DINH_ct_Compu 1 100 -4095.000 4096.000 BIT_MASK 0x1fff FORMAT "%8.3" ECU_ADDRESS 0x600144FA /end MEASUREMENT
/begin MEASUREMENT DINH_nrActvInhReas.FId_MisfDetVWhlReRi "Number of active inhibit reasons for the FIds / Number of active inhibit reasons for FId_MisfDetVWhlReRi" UWORD DINH_ct_Compu 1 100 -4095.000 4096.000 BIT_MASK 0x1fff FORMAT "%8.3" ECU_ADDRESS 0x600144FC /end MEASUREMENT
/begin MEASUREMENT DINH_nrActvInhReas.FId_NLimVehHalt "Number of active inhibit reasons for the FIds / Number of active inhibit reasons for FId_NLimVehHalt" UWORD DINH_ct_Compu 1 100 -4095.000 4096.000 BIT_MASK 0x1fff FORMAT "%8.3" ECU_ADDRESS 0x600144FE /end MEASUREMENT
/begin MEASUREMENT DINH_nrActvInhReas.FId_NSHTDAmbT "Number of active inhibit reasons for the FIds / Number of active inhibit reasons for FId_NSHTDAmbT" UWORD DINH_ct_Compu 1 100 -4095.000 4096.000 BIT_MASK 0x1fff FORMAT "%8.3" ECU_ADDRESS 0x60014500 /end MEASUREMENT
/begin MEASUREMENT DINH_nrActvInhReas.FId_NSHTDEngT "Number of active inhibit reasons for the FIds / Number of active inhibit reasons for FId_NSHTDEngT" UWORD DINH_ct_Compu 1 100 -4095.000 4096.000 BIT_MASK 0x1fff FORMAT "%8.3" ECU_ADDRESS 0x60014502 /end MEASUREMENT
/begin MEASUREMENT DINH_nrActvInhReas.FId_NSHTILimHiAltiLoIdleSp "Number of active inhibit reasons for the FIds / Number of active inhibit reasons for FId_NSHTILimHiAltiLoIdleSp" UWORD DINH_ct_Compu 1 100 -4095.000 4096.000 BIT_MASK 0x1fff FORMAT "%8.3" ECU_ADDRESS 0x60014504 /end MEASUREMENT
/begin MEASUREMENT DINH_nrActvInhReas.FId_NeutPosnFailr "Number of active inhibit reasons for the FIds / Number of active inhibit reasons for FId_NeutPosnFailr" UWORD DINH_ct_Compu 1 100 -4095.000 4096.000 BIT_MASK 0x1fff FORMAT "%8.3" ECU_ADDRESS 0x60014506 /end MEASUREMENT
/begin MEASUREMENT DINH_nrActvInhReas.FId_O2StorgMdlMD "Number of active inhibit reasons for the FIds / Number of active inhibit reasons for FId_O2StorgMdlMD" UWORD DINH_ct_Compu 1 100 -4095.000 4096.000 BIT_MASK 0x1fff FORMAT "%8.3" ECU_ADDRESS 0x60014508 /end MEASUREMENT
/begin MEASUREMENT DINH_nrActvInhReas.FId_OilCmbdSen_LvlDfctHW "Number of active inhibit reasons for the FIds / Number of active inhibit reasons for FId_OilCmbdSen_LvlDfctHW" UWORD DINH_ct_Compu 1 100 -4095.000 4096.000 BIT_MASK 0x1fff FORMAT "%8.3" ECU_ADDRESS 0x6001450A /end MEASUREMENT
/begin MEASUREMENT DINH_nrActvInhReas.FId_OilPCtrlVlvNpl "Number of active inhibit reasons for the FIds / Number of active inhibit reasons for FId_OilPCtrlVlvNpl" UWORD DINH_ct_Compu 1 100 -4095.000 4096.000 BIT_MASK 0x1fff FORMAT "%8.3" ECU_ADDRESS 0x6001450C /end MEASUREMENT
/begin MEASUREMENT DINH_nrActvInhReas.FId_OilPFrzVal "Number of active inhibit reasons for the FIds / Number of active inhibit reasons for FId_OilPFrzVal" UWORD DINH_ct_Compu 1 100 -4095.000 4096.000 BIT_MASK 0x1fff FORMAT "%8.3" ECU_ADDRESS 0x6001450E /end MEASUREMENT
/begin MEASUREMENT DINH_nrActvInhReas.FId_OilPPlaus "Number of active inhibit reasons for the FIds / Number of active inhibit reasons for FId_OilPPlaus" UWORD DINH_ct_Compu 1 100 -4095.000 4096.000 BIT_MASK 0x1fff FORMAT "%8.3" ECU_ADDRESS 0x60014510 /end MEASUREMENT
/begin MEASUREMENT DINH_nrActvInhReas.FId_OilPPlausAftRun "Number of active inhibit reasons for the FIds / Number of active inhibit reasons for FId_OilPPlausAftRun" UWORD DINH_ct_Compu 1 100 -4095.000 4096.000 BIT_MASK 0x1fff FORMAT "%8.3" ECU_ADDRESS 0x60014512 /end MEASUREMENT
/begin MEASUREMENT DINH_nrActvInhReas.FId_OilPPlausMax "Number of active inhibit reasons for the FIds / Number of active inhibit reasons for FId_OilPPlausMax" UWORD DINH_ct_Compu 1 100 -4095.000 4096.000 BIT_MASK 0x1fff FORMAT "%8.3" ECU_ADDRESS 0x60014514 /end MEASUREMENT
/begin MEASUREMENT DINH_nrActvInhReas.FId_OilPPlausMin "Number of active inhibit reasons for the FIds / Number of active inhibit reasons for FId_OilPPlausMin" UWORD DINH_ct_Compu 1 100 -4095.000 4096.000 BIT_MASK 0x1fff FORMAT "%8.3" ECU_ADDRESS 0x60014516 /end MEASUREMENT
/begin FUNCTION DINH "30000.27.0_1.0.0Diagnostic Inhibit Handler"
 /begin LOC_MEASUREMENT DINH_nrActvInhReas.FId_APPLETVldnErr DINH_nrActvInhReas.FId_APPLrn DINH_nrActvInhReas.FId_APPVehVErr DINH_nrActvInhReas.FId_AccPedDrvModComErr DINH_nrActvInhReas.FId_AccPedDrvModFailr DINH_nrActvInhReas.FId_AccPedNMaxLim DINH_nrActvInhReas.FId_AccPedNMinLim DINH_nrActvInhReas.FId_AccPedNMinLimBrkApp DINH_nrActvInhReas.FId_AccPedTrqLim DINH_nrActvInhReas.FId_AfsDdDiag DINH_nrActvInhReas.FId_AfsDiagErr DINH_nrActvInhReas.FId_AfsDiagTst DINH_nrActvInhReas.FId_AfsPlausDiag DINH_nrActvInhReas.FId_AfsVrntDiag DINH_nrActvInhReas.FId_AirCClntPFrzVal DINH_nrActvInhReas.FId_AirCClntPRplVal DINH_nrActvInhReas.FId_AirCSwt DINH_nrActvInhReas.FId_AirDvPAdpnPEnv DINH_nrActvInhReas.FId_AirDvPAdpnPIntkVUsB1 DINH_nrActvInhReas.FId_AirDvPPSnsrAdpn_PModeActv DINH_nrActvInhReas.FId_AltACGFailr DINH_nrActvInhReas.FId_AltAPPErrSt DINH_nrActvInhReas.FId_AltBattMngtFailr DINH_nrActvInhReas.FId_AltBrkErrSt DINH_nrActvInhReas.FId_AltComErr DINH_nrActvInhReas.FId_AltENGB DINH_nrActvInhReas.FId_AltElecLoadErr DINH_nrActvInhReas.FId_AltEnvTErr DINH_nrActvInhReas.FId_AltFFAltLoadFast DINH_nrActvInhReas.FId_AltFFAltLoadSlow DINH_nrActvInhReas.FId_AltIOACGErr DINH_nrActvInhReas.FId_AltIOACGLinComFailr DINH_nrActvInhReas.FId_AltIOComErr DINH_nrActvInhReas.FId_AltLinErr DINH_nrActvInhReas.FId_AltPwr DINH_nrActvInhReas.FId_AltVehVErrSt DINH_nrActvInhReas.FId_AltvCluFail DINH_nrActvInhReas.FId_BGAGRTS DINH_nrActvInhReas.FId_BGFKMSEPSR DINH_nrActvInhReas.FId_BGFKMSEPU DINH_nrActvInhReas.FId_BGFKMSESumClr DINH_nrActvInhReas.FId_BGFKMSHFME DINH_nrActvInhReas.FId_BGFKMSHFMZ DINH_nrActvInhReas.FId_BGFKMSZPSR DINH_nrActvInhReas.FId_BGOSCCat1B1 DINH_nrActvInhReas.FId_BGOSCCat2B1 DINH_nrActvInhReas.FId_BattAltFailr DINH_nrActvInhReas.FId_BattMngtFailr DINH_nrActvInhReas.FId_BattSigPtd DINH_nrActvInhReas.FId_BattU2MEDSRC DINH_nrActvInhReas.FId_BattUDrpPrvOff DINH_nrActvInhReas.FId_BattUFrzVal DINH_nrActvInhReas.FId_BattUHiFailrEna DINH_nrActvInhReas.FId_BattUIMGTCUCANFailr DINH_nrActvInhReas.FId_BattULoFailrEna DINH_nrActvInhReas.FId_BattUReplVal DINH_nrActvInhReas.FId_BattUSRC DINH_nrActvInhReas.FId_BlwrComErr DINH_nrActvInhReas.FId_BrkBstMdl DINH_nrActvInhReas.FId_BrkBstMdlBrkP DINH_nrActvInhReas.FId_BrkBstMdlBrkSt DINH_nrActvInhReas.FId_BrkBstMdlEnvP DINH_nrActvInhReas.FId_BrkBstPDetnInhbn DINH_nrActvInhReas.FId_BrkBstPMstCylPSnsrFail DINH_nrActvInhReas.FId_BrkBstPSnsrStuckDetn DINH_nrActvInhReas.FId_BrkBstSigPath DINH_nrActvInhReas.FId_BrkBstVehVv DINH_nrActvInhReas.FId_BrkMnSwtErr DINH_nrActvInhReas.FId_BrkPFrzVal DINH_nrActvInhReas.FId_BrkPOilPres DINH_nrActvInhReas.FId_BrkPReplVal DINH_nrActvInhReas.FId_BrkPedEngStopEna DINH_nrActvInhReas.FId_BrkRdntSwtErr DINH_nrActvInhReas.FId_CAGRSDS DINH_nrActvInhReas.FId_CEngDsTColdStrt DINH_nrActvInhReas.FId_CEngDsTColdStrtErr DINH_nrActvInhReas.FId_CEngDsTHSC DINH_nrActvInhReas.FId_CEngDsTLSC DINH_nrActvInhReas.FId_CEngDsTPlausErr DINH_nrActvInhReas.FId_CEngDsTReplMdlEngStop DINH_nrActvInhReas.FId_CEngDsTSTC DINH_nrActvInhReas.FId_CEngDsTSnsrElec DINH_nrActvInhReas.FId_CEngDsTSwtReplMdl DINH_nrActvInhReas.FId_CEngUsTColdChkErr DINH_nrActvInhReas.FId_CEngUsTCrssChk DINH_nrActvInhReas.FId_CEngUsTElecErr DINH_nrActvInhReas.FId_CEngUsTSnsrElecErr DINH_nrActvInhReas.FId_CEngUsTSwtReplMdl DINH_nrActvInhReas.FId_CInjCatHeatgDiag DINH_nrActvInhReas.FId_CMSUDKSOM1 DINH_nrActvInhReas.FId_CMSUDKSOM2 DINH_nrActvInhReas.FId_CatHeatgEomShtrpAct DINH_nrActvInhReas.FId_ChrctlAgrsErr DINH_nrActvInhReas.FId_ChrctlAgrscf DINH_nrActvInhReas.FId_ClntTempENGB DINH_nrActvInhReas.FId_Clth DINH_nrActvInhReas.FId_Clth2 DINH_nrActvInhReas.FId_Clth3StuckOn DINH_nrActvInhReas.FId_Clth4 DINH_nrActvInhReas.FId_ClthCAN DINH_nrActvInhReas.FId_ClthMax DINH_nrActvInhReas.FId_ClthStk DINH_nrActvInhReas.FId_ClthStkErr DINH_nrActvInhReas.FId_ClthStkFailr DINH_nrActvInhReas.FId_ClthStkOFFStuck DINH_nrActvInhReas.FId_ClthStkONStuck DINH_nrActvInhReas.FId_ClthSwtFailr DINH_nrActvInhReas.FId_CntrShaftFailr DINH_nrActvInhReas.FId_CoEOMGdiEomErrLcy DINH_nrActvInhReas.FId_CoESSBlowrVld DINH_nrActvInhReas.FId_CoETM DINH_nrActvInhReas.FId_CoETS_StTrqLimErr1 DINH_nrActvInhReas.FId_CoETS_StTrqLimErr2 DINH_nrActvInhReas.FId_CoEngStopEnblStSpEngT DINH_nrActvInhReas.FId_CoEngStopEnblStSpLSU DINH_nrActvInhReas.FId_CoEngStopEnblStSpTcT DINH_nrActvInhReas.FId_CoEngStopEnblSysErr DINH_nrActvInhReas.FId_CoEngVlvLftSpIntk DINH_nrActvInhReas.FId_CoPOMStrtgDevStrtr DINH_nrActvInhReas.FId_CoPOM_FirstStrtAut DINH_nrActvInhReas.FId_CoTS_SwtOff DINH_nrActvInhReas.FId_CoVOMACCComFailr DINH_nrActvInhReas.FId_CoVOMBrkPedISABSigFailr DINH_nrActvInhReas.FId_CoVOMEngCrkAbort DINH_nrActvInhReas.FId_CoVOMEngRstrtEnaCdn DINH_nrActvInhReas.FId_CoVOMISSEng DINH_nrActvInhReas.FId_ComACRly DINH_nrActvInhReas.FId_ComAPPSensFail DINH_nrActvInhReas.FId_ComAPedl DINH_nrActvInhReas.FId_ComAYCA DINH_nrActvInhReas.FId_ComAYCAMon DINH_nrActvInhReas.FId_ComAYCD DINH_nrActvInhReas.FId_ComAYCDMon DINH_nrActvInhReas.FId_ComAYCF DINH_nrActvInhReas.FId_ComAYCFMon DINH_nrActvInhReas.FId_ComAYCG DINH_nrActvInhReas.FId_ComAYCGMon DINH_nrActvInhReas.FId_ComAYCI DINH_nrActvInhReas.FId_ComAYCIMon DINH_nrActvInhReas.FId_ComAirPThrUsSnsrErr DINH_nrActvInhReas.FId_ComAltFail DINH_nrActvInhReas.FId_ComAppVehSnsrFailr DINH_nrActvInhReas.FId_ComBCM1 DINH_nrActvInhReas.FId_ComBCM1Mon DINH_nrActvInhReas.FId_ComBCMUnitCfmdErr DINH_nrActvInhReas.FId_ComBCMUnitNotTstd DINH_nrActvInhReas.FId_ComBstCtrl DINH_nrActvInhReas.FId_ComCANVEHICLEBusOff DINH_nrActvInhReas.FId_ComCGW1 DINH_nrActvInhReas.FId_ComCGW1Mon DINH_nrActvInhReas.FId_ComClthSt DINH_nrActvInhReas.FId_ComConvClth DINH_nrActvInhReas.FId_ComCrCtlReq DINH_nrActvInhReas.FId_ComCrsMaiIndcnLampReq DINH_nrActvInhReas.FId_ComCrsSetIndcnLampReq DINH_nrActvInhReas.FId_ComDCDCCdn DINH_nrActvInhReas.FId_ComDCDCErr DINH_nrActvInhReas.FId_ComDesGearCurr DINH_nrActvInhReas.FId_ComDetrmAirM DINH_nrActvInhReas.FId_ComDwnShiftCtrlReq DINH_nrActvInhReas.FId_ComEAT1 DINH_nrActvInhReas.FId_ComEAT10 DINH_nrActvInhReas.FId_ComEAT10Mon DINH_nrActvInhReas.FId_ComEAT11 DINH_nrActvInhReas.FId_ComEAT11Mon DINH_nrActvInhReas.FId_ComEAT12 DINH_nrActvInhReas.FId_ComEAT12Mon DINH_nrActvInhReas.FId_ComEAT13 DINH_nrActvInhReas.FId_ComEAT13Mon DINH_nrActvInhReas.FId_ComEAT1Mon DINH_nrActvInhReas.FId_ComEAT2 DINH_nrActvInhReas.FId_ComEAT2Mon DINH_nrActvInhReas.FId_ComEAT4 DINH_nrActvInhReas.FId_ComEAT4Mon DINH_nrActvInhReas.FId_ComEAT6 DINH_nrActvInhReas.FId_ComEAT6Mon DINH_nrActvInhReas.FId_ComEAT7 DINH_nrActvInhReas.FId_ComEAT7Mon DINH_nrActvInhReas.FId_ComEAT8 DINH_nrActvInhReas.FId_ComEAT8Mon DINH_nrActvInhReas.FId_ComEATA DINH_nrActvInhReas.FId_ComEATAMon DINH_nrActvInhReas.FId_ComEATB DINH_nrActvInhReas.FId_ComEATBMon DINH_nrActvInhReas.FId_ComEATC DINH_nrActvInhReas.FId_ComEATCMon DINH_nrActvInhReas.FId_ComEBSSelfDiagErr DINH_nrActvInhReas.FId_ComECUHwErr DINH_nrActvInhReas.FId_ComEGRVlvErr DINH_nrActvInhReas.FId_ComEMSIntAirTemp DINH_nrActvInhReas.FId_ComEPB DINH_nrActvInhReas.FId_ComEPBB DINH_nrActvInhReas.FId_ComEPBBMon DINH_nrActvInhReas.FId_ComEPBMon DINH_nrActvInhReas.FId_ComEPS1 DINH_nrActvInhReas.FId_ComEPS1Mon DINH_nrActvInhReas.FId_ComEPSUnitCfmdErr DINH_nrActvInhReas.FId_ComEPSUnitNotTstd DINH_nrActvInhReas.FId_ComEngBrkOvrdInfo DINH_nrActvInhReas.FId_ComEngBrkOvrdMtr DINH_nrActvInhReas.FId_ComEngBrkSwErr DINH_nrActvInhReas.FId_ComEngPosng DINH_nrActvInhReas.FId_ComEngRPMLim DINH_nrActvInhReas.FId_ComEngTrqLim DINH_nrActvInhReas.FId_ComEnvtlAirPSnsrErr DINH_nrActvInhReas.FId_ComEstmTqNormJdg DINH_nrActvInhReas.FId_ComEthnlSErr DINH_nrActvInhReas.FId_ComFlSply DINH_nrActvInhReas.FId_ComFuCnsBitDurgIdleStop DINH_nrActvInhReas.FId_ComGEVCntrl DINH_nrActvInhReas.FId_ComGbxNPosFail DINH_nrActvInhReas.FId_ComGbxTemp DINH_nrActvInhReas.FId_ComGwIMG1 DINH_nrActvInhReas.FId_ComGwIMG1Mon DINH_nrActvInhReas.FId_ComGwIMG3 DINH_nrActvInhReas.FId_ComGwIMG3Mon DINH_nrActvInhReas.FId_ComGwIMG4 DINH_nrActvInhReas.FId_ComGwIMG4Mon DINH_nrActvInhReas.FId_ComGwIMG5 DINH_nrActvInhReas.FId_ComGwIMG5Mon DINH_nrActvInhReas.FId_ComGwIMG6 DINH_nrActvInhReas.FId_ComGwIMG6Mon DINH_nrActvInhReas.FId_ComHFMSnsrErr DINH_nrActvInhReas.FId_ComIDASB DINH_nrActvInhReas.FId_ComIDASBMon DINH_nrActvInhReas.FId_ComIDASBUnitCfmdErr DINH_nrActvInhReas.FId_ComIDASBUnitNotTstd DINH_nrActvInhReas.FId_ComIDASEngFail DINH_nrActvInhReas.FId_ComIDASEngFailMil DINH_nrActvInhReas.FId_ComIMGUnitCfmdErr DINH_nrActvInhReas.FId_ComIMGUnitNotTstd DINH_nrActvInhReas.FId_ComISG2 DINH_nrActvInhReas.FId_ComIgnCtrl DINH_nrActvInhReas.FId_ComInjCtrl DINH_nrActvInhReas.FId_ComIntkAirPSnsrErr DINH_nrActvInhReas.FId_ComLamCtrl DINH_nrActvInhReas.FId_ComMETA DINH_nrActvInhReas.FId_ComMETAMon DINH_nrActvInhReas.FId_ComMETC DINH_nrActvInhReas.FId_ComMETCMon DINH_nrActvInhReas.FId_ComMETD DINH_nrActvInhReas.FId_ComMETDMon DINH_nrActvInhReas.FId_ComMETE2 DINH_nrActvInhReas.FId_ComMETE2Mon DINH_nrActvInhReas.FId_ComMETF DINH_nrActvInhReas.FId_ComMETFMon DINH_nrActvInhReas.FId_ComMETG DINH_nrActvInhReas.FId_ComMETGMon DINH_nrActvInhReas.FId_ComMETH DINH_nrActvInhReas.FId_ComMETH2 DINH_nrActvInhReas.FId_ComMETH2Mon DINH_nrActvInhReas.FId_ComMETHMon DINH_nrActvInhReas.FId_ComMETI DINH_nrActvInhReas.FId_ComMETIMon DINH_nrActvInhReas.FId_ComMETK DINH_nrActvInhReas.FId_ComMETKMon DINH_nrActvInhReas.FId_ComMETL DINH_nrActvInhReas.FId_ComMETLMon DINH_nrActvInhReas.FId_ComMETM DINH_nrActvInhReas.FId_ComMETMMon DINH_nrActvInhReas.FId_ComMETN DINH_nrActvInhReas.FId_ComMETNMon DINH_nrActvInhReas.FId_ComMETUnitCfmdErr DINH_nrActvInhReas.FId_ComMETUnitNotTstd DINH_nrActvInhReas.FId_ComMisf DINH_nrActvInhReas.FId_ComMon DINH_nrActvInhReas.FId_ComNTrbn DINH_nrActvInhReas.FId_ComODOff DINH_nrActvInhReas.FId_ComOilLvlLamp DINH_nrActvInhReas.FId_ComOilPWarnLamp DINH_nrActvInhReas.FId_ComPASensFail DINH_nrActvInhReas.FId_ComPBSensFail DINH_nrActvInhReas.FId_ComPCU DINH_nrActvInhReas.FId_ComPCUMon DINH_nrActvInhReas.FId_ComPosActnSpdLimrFctReq DINH_nrActvInhReas.FId_ComSRS DINH_nrActvInhReas.FId_ComSRSA DINH_nrActvInhReas.FId_ComSRSAMon DINH_nrActvInhReas.FId_ComSRSB DINH_nrActvInhReas.FId_ComSRSBMon DINH_nrActvInhReas.FId_ComSRSMon DINH_nrActvInhReas.FId_ComSRSUnitCfmdErr DINH_nrActvInhReas.FId_ComSRSUnitNotTstd DINH_nrActvInhReas.FId_ComSTFlt DINH_nrActvInhReas.FId_ComSpdLimrDevActvn DINH_nrActvInhReas.FId_ComTCU01 DINH_nrActvInhReas.FId_ComTCU02 DINH_nrActvInhReas.FId_ComTCU1 DINH_nrActvInhReas.FId_ComTCU11 DINH_nrActvInhReas.FId_ComTCU12 DINH_nrActvInhReas.FId_ComTCU13 DINH_nrActvInhReas.FId_ComTCU14 DINH_nrActvInhReas.FId_ComTCU2 DINH_nrActvInhReas.FId_ComTCU3 DINH_nrActvInhReas.FId_ComTCU4 DINH_nrActvInhReas.FId_ComTCUGear DINH_nrActvInhReas.FId_ComTarGearDwnShift DINH_nrActvInhReas.FId_ComTarGearUpShift DINH_nrActvInhReas.FId_ComThrPosnFail DINH_nrActvInhReas.FId_ComThrVlv DINH_nrActvInhReas.FId_ComTrboChrgnErr DINH_nrActvInhReas.FId_ComTrqAccuracySlow DINH_nrActvInhReas.FId_ComTrqReqFast DINH_nrActvInhReas.FId_ComTrqReqSlow DINH_nrActvInhReas.FId_ComVSAErr DINH_nrActvInhReas.FId_ComVSAUnitCfmdErr DINH_nrActvInhReas.FId_ComVSAUnitNotTstd DINH_nrActvInhReas.FId_ComVehSpdFlLvl DINH_nrActvInhReas.FId_ComVehSpdFltChk DINH_nrActvInhReas.FId_ComVehSpdImpsErr DINH_nrActvInhReas.FId_ComVlvLftCtrl DINH_nrActvInhReas.FId_ComvolEng DINH_nrActvInhReas.FId_ConvLdCalcLvrPos DINH_nrActvInhReas.FId_ConvLdNTrbnCan DINH_nrActvInhReas.FId_ConvLdOilCoolrPmp DINH_nrActvInhReas.FId_ConvLdOilTemp DINH_nrActvInhReas.FId_ConvLdTrqLdCan DINH_nrActvInhReas.FId_ConvLdVel DINH_nrActvInhReas.FId_CooltTVldyTMdl DINH_nrActvInhReas.FId_CptProtnCamsft DINH_nrActvInhReas.FId_CptProtnExhTempMdl DINH_nrActvInhReas.FId_CptProtnO2SnsrB1 DINH_nrActvInhReas.FId_CptProtnVVeh DINH_nrActvInhReas.FId_CrCUI1EFRxErr DINH_nrActvInhReas.FId_CrCUICANRxErr DINH_nrActvInhReas.FId_CrCUIFCMRxErr DINH_nrActvInhReas.FId_CrCUIMETDRxErr DINH_nrActvInhReas.FId_CrCtlACCRxErr DINH_nrActvInhReas.FId_CrCtlAppSnsrErr DINH_nrActvInhReas.FId_CrCtlShutOffEng DINH_nrActvInhReas.FId_CstrPurgGnrlTstrReq DINH_nrActvInhReas.FId_DAGRS DINH_nrActvInhReas.FId_DELibBrkBstP DINH_nrActvInhReas.FId_DELibCEngDsT DINH_nrActvInhReas.FId_DELibCEngUsT DINH_nrActvInhReas.FId_DELibEngDatEng DINH_nrActvInhReas.FId_DELibEnvP DINH_nrActvInhReas.FId_DELibEnvT DINH_nrActvInhReas.FId_DELibFuelT DINH_nrActvInhReas.FId_DELibIntkAirT DINH_nrActvInhReas.FId_DELibNRCat DINH_nrActvInhReas.FId_DELibOilP DINH_nrActvInhReas.FId_DELibOilSwmpT DINH_nrActvInhReas.FId_DELibPRelPfilDs DINH_nrActvInhReas.FId_DELibTEGRClrLPDs DINH_nrActvInhReas.FId_DEONVEBPEnv DINH_nrActvInhReas.FId_DEONVTCCpv1DteskLoLoadStuckClsd DINH_nrActvInhReas.FId_DEONVTCCpv1DteskLoLoadStuckOpen DINH_nrActvInhReas.FId_DIUMPRCldStrtMon DINH_nrActvInhReas.FId_DIUMPREvapMon DINH_nrActvInhReas.FId_DIUMPRGenDenom1 DINH_nrActvInhReas.FId_DIUMPRGenDenom1PDTC DINH_nrActvInhReas.FId_DIUMPRGenDenom2 DINH_nrActvInhReas.FId_DIUMPRGenDenom3 DINH_nrActvInhReas.FId_DIUMPRIgn DINH_nrActvInhReas.FId_DOGov DINH_nrActvInhReas.FId_DSMWarmUpCycle DINH_nrActvInhReas.FId_DTESKEBCpv1DteskLoLoadStuckClsd DINH_nrActvInhReas.FId_DTESKEBCpv1DteskLoLoadStuckOpen DINH_nrActvInhReas.FId_DTESKEnvCondVld DINH_nrActvInhReas.FId_DTESKFuLvlCondVld DINH_nrActvInhReas.FId_DTESKvfz DINH_nrActvInhReas.FId_DdskvFraTstd DINH_nrActvInhReas.FId_DdskvOraTstd DINH_nrActvInhReas.FId_DewDetTKAMax DINH_nrActvInhReas.FId_DiagBlkdLine DINH_nrActvInhReas.FId_DiagCpv1DteskLoLoad DINH_nrActvInhReas.FId_DkrsaEpmNoSig DINH_nrActvInhReas.FId_EBBCANErrFrzVal DINH_nrActvInhReas.FId_EBBCANErrReplVal DINH_nrActvInhReas.FId_EGLZSR DINH_nrActvInhReas.FId_EGRVlvActrOff DINH_nrActvInhReas.FId_EGRVlvCldStrt DINH_nrActvInhReas.FId_EGRVlvClnVrfy DINH_nrActvInhReas.FId_EGRVlvCtrlErr DINH_nrActvInhReas.FId_EGRVlvEngTempDef DINH_nrActvInhReas.FId_EGRVlvFailSafeActv DINH_nrActvInhReas.FId_EGRVlvFrzVal DINH_nrActvInhReas.FId_EGRVlvGovOn DINH_nrActvInhReas.FId_EGRVlvGovOnCld DINH_nrActvInhReas.FId_EGRVlvGovrOnRelsFct DINH_nrActvInhReas.FId_EGRVlvILimn DINH_nrActvInhReas.FId_EGRVlvIni DINH_nrActvInhReas.FId_EGRVlvMon DINH_nrActvInhReas.FId_EGRVlvOfsLrnInhib DINH_nrActvInhReas.FId_EGRVlvPhysRng DINH_nrActvInhReas.FId_EGRVlvPsSwtOff DINH_nrActvInhReas.FId_EGRVlvPwrStgMonDis DINH_nrActvInhReas.FId_EGRVlvRplVal DINH_nrActvInhReas.FId_EGRVlvSSpMon DINH_nrActvInhReas.FId_EGRVlvSnsrErr DINH_nrActvInhReas.FId_EGRVlvTempCmp DINH_nrActvInhReas.FId_EGRVlvTempMdlEEPErr DINH_nrActvInhReas.FId_EGRVlvTmpErrCnt DINH_nrActvInhReas.FId_EGRVlvTrlPtr DINH_nrActvInhReas.FId_EGRVlv_VehvErr DINH_nrActvInhReas.FId_EGRVlviActIEfcLimn DINH_nrActvInhReas.FId_EGRVlvpDsbcInvld DINH_nrActvInhReas.FId_EGSDO2OffsRstDsmS1B1 DINH_nrActvInhReas.FId_EGSDO2_LamOffsSlowS1 DINH_nrActvInhReas.FId_EGSDO2_RstFltSuspcnOffsB1 DINH_nrActvInhReas.FId_EGSDUS2B1DlyEvln DINH_nrActvInhReas.FId_EGSDUS2B1LtrDly DINH_nrActvInhReas.FId_EGSDUS2B1LtrPT1 DINH_nrActvInhReas.FId_EGSDUS2B1PT1Evln DINH_nrActvInhReas.FId_EGSDUS2B1RtlDly DINH_nrActvInhReas.FId_EGSDUS2B1RtlPT1 DINH_nrActvInhReas.FId_EGSDUS2B1TarEvln DINH_nrActvInhReas.FId_EGSDUS2B1TarLean DINH_nrActvInhReas.FId_EGSDUS2B1TarRich DINH_nrActvInhReas.FId_EGSSigO2S1B1 DINH_nrActvInhReas.FId_ELZSR DINH_nrActvInhReas.FId_EPBErr DINH_nrActvInhReas.FId_EPBFrmErr DINH_nrActvInhReas.FId_EPBFrmErrClth DINH_nrActvInhReas.FId_ETHSCPErrDrvCyc DINH_nrActvInhReas.FId_EVPComFailr DINH_nrActvInhReas.FId_EbsLinErr DINH_nrActvInhReas.FId_ElecLdComErr DINH_nrActvInhReas.FId_ElecLdFrzVal DINH_nrActvInhReas.FId_ElecLdHdLiComErr DINH_nrActvInhReas.FId_ElecLdRplVal DINH_nrActvInhReas.FId_ElecLoadEPSComErr DINH_nrActvInhReas.FId_EngBlkTWrn DINH_nrActvInhReas.FId_EngCooltTFail DINH_nrActvInhReas.FId_EngDemTqLimnCamsftErr DINH_nrActvInhReas.FId_EngDemTqLimnErrThmstHeatCtrlCirc DINH_nrActvInhReas.FId_EngDemTqLimnOilPmp DINH_nrActvInhReas.FId_EngDemTrqLimErrAPP DINH_nrActvInhReas.FId_EngIntkAirFail DINH_nrActvInhReas.FId_EngPrtErrVehV DINH_nrActvInhReas.FId_EngSpd30DegFail DINH_nrActvInhReas.FId_EngStrtEnaEthAdap DINH_nrActvInhReas.FId_EngStrt_EnaCep DINH_nrActvInhReas.FId_EngStrt_InjProhb DINH_nrActvInhReas.FId_EngStrt_VehVInhb DINH_nrActvInhReas.FId_EngTqRvsnEnaFlg DINH_nrActvInhReas.FId_EnvTPrimMod DINH_nrActvInhReas.FId_EnvTPrimModIniVal DINH_nrActvInhReas.FId_EnvTSensSum DINH_nrActvInhReas.FId_EnvTtAirFltDs DINH_nrActvInhReas.FId_EnvTtCEngDsT DINH_nrActvInhReas.FId_EnvTtIntkMnfld DINH_nrActvInhReas.FId_EomCvoAllwd DINH_nrActvInhReas.FId_EpmBCr DINH_nrActvInhReas.FId_EpmCaSAdapCaSI1 DINH_nrActvInhReas.FId_EpmCaSAdapRstI1 DINH_nrActvInhReas.FId_EpmCaSDiagI1 DINH_nrActvInhReas.FId_EpmCaSErrCaSI1 DINH_nrActvInhReas.FId_EpmCaSOfsDiagCaSI1 DINH_nrActvInhReas.FId_EpmCaSOfsErrCaSI1 DINH_nrActvInhReas.FId_EpmCaSSegI1 DINH_nrActvInhReas.FId_EpmCaSSpdPlausI1 DINH_nrActvInhReas.FId_EpmCrSDiag DINH_nrActvInhReas.FId_EpmCrSDiagVeh DINH_nrActvInhReas.FId_EpmCrSErr DINH_nrActvInhReas.FId_EpmOpMode_ALELock DINH_nrActvInhReas.FId_EpmOpMode_DirStLock DINH_nrActvInhReas.FId_EpmRRSCrSFaultCheck DINH_nrActvInhReas.FId_EpmRRSDGIFaultCheck DINH_nrActvInhReas.FId_EpmRRSRdCheck DINH_nrActvInhReas.FId_EpmRRSVehVFaultChck DINH_nrActvInhReas.FId_EpmSynLockCaSSync DINH_nrActvInhReas.FId_EpmTmpSuppRvsRotCASI1 DINH_nrActvInhReas.FId_EtaEngIdleNonCsers DINH_nrActvInhReas.FId_EtaEngPtlNonCsers DINH_nrActvInhReas.FId_EthnlSnsrErrCdn DINH_nrActvInhReas.FId_EvapActrCcvElecDiag DINH_nrActvInhReas.FId_EvapPSnsrTankPhyRngChk DINH_nrActvInhReas.FId_FanCtlACClntP DINH_nrActvInhReas.FId_FanCtlACGModFail DINH_nrActvInhReas.FId_FanCtlAPP1 DINH_nrActvInhReas.FId_FanCtlAPP2 DINH_nrActvInhReas.FId_FanCtlAPPSync DINH_nrActvInhReas.FId_FanCtlBlowrU DINH_nrActvInhReas.FId_FanCtlCooltT DINH_nrActvInhReas.FId_FanCtlCooltT2 DINH_nrActvInhReas.FId_FanCtlEnvT DINH_nrActvInhReas.FId_FanCtlLiSwtInfo DINH_nrActvInhReas.FId_FanCtlSpd DINH_nrActvInhReas.FId_FanCtlTSnsrErr DINH_nrActvInhReas.FId_FanCtlThr1 DINH_nrActvInhReas.FId_FanCtlThr2 DINH_nrActvInhReas.FId_FcoReq DINH_nrActvInhReas.FId_FiMFID_rba_MRly_Diag_Stk DINH_nrActvInhReas.FId_FlComErr DINH_nrActvInhReas.FId_FlDevPlauDiagFuSnsr DINH_nrActvInhReas.FId_FlLvlNoSigErr DINH_nrActvInhReas.FId_FlLvlVehSpdSigErr DINH_nrActvInhReas.FId_FlLvlVehVErr DINH_nrActvInhReas.FId_FlMALamDynDiag DINH_nrActvInhReas.FId_FlSplGAltLin DINH_nrActvInhReas.FId_FlTnkQnt DINH_nrActvInhReas.FId_FuMixHotFilmErr DINH_nrActvInhReas.FId_FuMixUegoErrExcl DINH_nrActvInhReas.FId_FuPHiRailEthnlSnsrErr DINH_nrActvInhReas.FId_FuPurg_TEVError DINH_nrActvInhReas.FId_FuSnsrPhyRngErr DINH_nrActvInhReas.FId_GEVCtlAVCAdprCBBNWEErrIntk DINH_nrActvInhReas.FId_GEVCtlAVCAdprIntkB1 DINH_nrActvInhReas.FId_GEVCtlAVCAdprNWSEErrIntk DINH_nrActvInhReas.FId_GEVCtlAdpnEnaIntk DINH_nrActvInhReas.FId_GEVCtlAdpnEnaShtrpActv DINH_nrActvInhReas.FId_GEVCtlClngIntk DINH_nrActvInhReas.FId_GEVCtlMinOvlIntk DINH_nrActvInhReas.FId_GEVCtlPOilSnsr DINH_nrActvInhReas.FId_GEVCtlPhaEnaIntk DINH_nrActvInhReas.FId_GEVCtlPhaSpTstrIntk DINH_nrActvInhReas.FId_GEVCtlRefAdpnMntChck DINH_nrActvInhReas.FId_GEVCtlRefAdpnMntChckTstd DINH_nrActvInhReas.FId_GEVCtlReqRefAdpnTstrIntk DINH_nrActvInhReas.FId_GEVCtlReqRefAdpnTstrIntkTstd DINH_nrActvInhReas.FId_GEVCtlVlvLftEnaIntk DINH_nrActvInhReas.FId_GEVCtlVlvOpenClsdIntkB1 DINH_nrActvInhReas.FId_GEVlvLockPinDiagIntkB1 DINH_nrActvInhReas.FId_GEVlvPhaDiagEnaCsersIntkB1 DINH_nrActvInhReas.FId_GEVlvPhaDiagEnaIntkB1 DINH_nrActvInhReas.FId_GEVlvPhaPsIntkB1 DINH_nrActvInhReas.FId_GbxAnNeutPosnErr DINH_nrActvInhReas.FId_GbxCANDigPlausErr DINH_nrActvInhReas.FId_GbxCANNeutSigErr DINH_nrActvInhReas.FId_GbxPNPosSig DINH_nrActvInhReas.FId_GbxPNPosnComErr DINH_nrActvInhReas.FId_GbxPNPosnDiagDrvCdnRels DINH_nrActvInhReas.FId_GbxPNPosnDiagDrvCodnHealRels DINH_nrActvInhReas.FId_GbxPNPosnDiagPlausyRels DINH_nrActvInhReas.FId_GbxPNPosnSubsVal DINH_nrActvInhReas.FId_GbxRvsSwtStk DINH_nrActvInhReas.FId_GbxSnsrSplyUErr DINH_nrActvInhReas.FId_GbxSpstReqOk DINH_nrActvInhReas.FId_GlbDaLSumvXPtd DINH_nrActvInhReas.FId_GslThrVlvSnsrDiagB1 DINH_nrActvInhReas.FId_HEGOS2B1DElec DINH_nrActvInhReas.FId_HEGOS2B1DHtg DINH_nrActvInhReas.FId_HEGOS2B1Htg DINH_nrActvInhReas.FId_HEGOS2B1HtrPsSt DINH_nrActvInhReas.FId_HEGOS2B1InVld DINH_nrActvInhReas.FId_HEGOS2B1LSPsDiaDi DINH_nrActvInhReas.FId_HLSDemBrkFlt DINH_nrActvInhReas.FId_HLSDemErr1 DINH_nrActvInhReas.FId_HLSDemErr2 DINH_nrActvInhReas.FId_HLSDemIntkAirTemp DINH_nrActvInhReas.FId_HLSDemMotTemp DINH_nrActvInhReas.FId_HLSDemMstCyldpVld DINH_nrActvInhReas.FId_HLSDemSpdClthGearAccrSigErr DINH_nrActvInhReas.FId_HLSDem_DrvOffSuprt DINH_nrActvInhReas.FId_HLSDem_DrvOffSuprtBrkHldSys DINH_nrActvInhReas.FId_HLSDem_DrvOffSuprtLAS DINH_nrActvInhReas.FId_HLSDem_PModeActv DINH_nrActvInhReas.FId_HLSDem_TModeActv DINH_nrActvInhReas.FId_HLSDem_TraSubFcn DINH_nrActvInhReas.FId_HLSDem_nMaxLimErr1 DINH_nrActvInhReas.FId_HLSDem_nMaxLimErr2 DINH_nrActvInhReas.FId_HLSDem_nMaxLimErr3 DINH_nrActvInhReas.FId_HLSDem_nMaxVErr DINH_nrActvInhReas.FId_I14229APP DINH_nrActvInhReas.FId_I14229CANErr DINH_nrActvInhReas.FId_I14229FlLvlFltComErr DINH_nrActvInhReas.FId_I14229VTCErr DINH_nrActvInhReas.FId_IMGISABComErr DINH_nrActvInhReas.FId_InhbLamDynS1B1 DINH_nrActvInhReas.FId_InhbnBlkdLineDiag DINH_nrActvInhReas.FId_InhibitAlways DINH_nrActvInhReas.FId_InhibitNever DINH_nrActvInhReas.FId_InjSysMulInjDiagErr DINH_nrActvInhReas.FId_InjVlvPs_Bank1OnlyErr DINH_nrActvInhReas.FId_InjVlvPs_Bank1Tested DINH_nrActvInhReas.FId_InjVlvPs_Bank2OnlyErr DINH_nrActvInhReas.FId_InjVlvPs_Bank2Tested DINH_nrActvInhReas.FId_InjVlvPs_Bank3OnlyErr DINH_nrActvInhReas.FId_InjVlvPs_Bank3Tested DINH_nrActvInhReas.FId_IntkAirTAirFltDsCrssChk DINH_nrActvInhReas.FId_IntkAirTAirFltDsPlausChk DINH_nrActvInhReas.FId_IntkAirTIntkMnfldCrssChk DINH_nrActvInhReas.FId_IntkAirTIntkMnfldPlausChk DINH_nrActvInhReas.FId_IntkAirTIntkMnfldRepl DINH_nrActvInhReas.FId_IntkAirTSnsr1Elec DINH_nrActvInhReas.FId_IntkAirTSnsr1PRC DINH_nrActvInhReas.FId_IntkAirTSnsr1Sum DINH_nrActvInhReas.FId_IntkAirTSnsr2Elec DINH_nrActvInhReas.FId_IntkAirTSnsr2PRC DINH_nrActvInhReas.FId_IntkAirTSnsr2Sum DINH_nrActvInhReas.FId_IntkArTempENGB DINH_nrActvInhReas.FId_LIGovDfrstI DINH_nrActvInhReas.FId_LIGovUndrBrk DINH_nrActvInhReas.FId_LINDCDCRxErr DINH_nrActvInhReas.FId_LLimAppSnsrErr DINH_nrActvInhReas.FId_LLimAppSnsrSyncErr DINH_nrActvInhReas.FId_LLimMTVehSpdSnsrErr DINH_nrActvInhReas.FId_LLimShutOffEng DINH_nrActvInhReas.FId_LRSEBMisf DINH_nrActvInhReas.FId_LZSR DINH_nrActvInhReas.FId_LeakToMnfld DINH_nrActvInhReas.FId_LeakToMnfldTstd DINH_nrActvInhReas.FId_LimpHomPsErrInjtr DINH_nrActvInhReas.FId_LinACGUnitCfmdErr DINH_nrActvInhReas.FId_LinACGUnitNotTstd DINH_nrActvInhReas.FId_LinAEVUnitCfmdErr DINH_nrActvInhReas.FId_LinAEVUnitNotTstd DINH_nrActvInhReas.FId_LinEBSUnitCfmdErr DINH_nrActvInhReas.FId_LinEBSUnitNotTstd DINH_nrActvInhReas.FId_LowPresOilP DINH_nrActvInhReas.FId_MFlowAirCrkcsSubVal DINH_nrActvInhReas.FId_MFuOilMax DINH_nrActvInhReas.FId_MaiLoadSnsr DINH_nrActvInhReas.FId_MaiShaftFailr DINH_nrActvInhReas.FId_MfPsDia1 DINH_nrActvInhReas.FId_MisfDetDnAdpn DINH_nrActvInhReas.FId_MisfDetDnAdpnPlaus DINH_nrActvInhReas.FId_MisfDetEnvP DINH_nrActvInhReas.FId_MisfDetSegTiAdpnFco DINH_nrActvInhReas.FId_MisfDetShtrpAct DINH_nrActvInhReas.FId_MisfDetStc DINH_nrActvInhReas.FId_MisfDetV DINH_nrActvInhReas.FId_MisfDetVWhlFrntLe DINH_nrActvInhReas.FId_MisfDetVWhlFrntRi DINH_nrActvInhReas.FId_MisfDetVWhlReLe DINH_nrActvInhReas.FId_MisfDetVWhlReRi DINH_nrActvInhReas.FId_NLimVehHalt DINH_nrActvInhReas.FId_NSHTDAmbT DINH_nrActvInhReas.FId_NSHTDEngT DINH_nrActvInhReas.FId_NSHTILimHiAltiLoIdleSp DINH_nrActvInhReas.FId_NeutPosnFailr DINH_nrActvInhReas.FId_O2StorgMdlMD DINH_nrActvInhReas.FId_OilCmbdSen_LvlDfctHW DINH_nrActvInhReas.FId_OilPCtrlVlvNpl DINH_nrActvInhReas.FId_OilPFrzVal DINH_nrActvInhReas.FId_OilPPlaus DINH_nrActvInhReas.FId_OilPPlausAftRun DINH_nrActvInhReas.FId_OilPPlausMax DINH_nrActvInhReas.FId_OilPPlausMin /end LOC_MEASUREMENT
 FUNCTION_VERSION "30000.27.0_1.0.0" /end FUNCTION
/begin COMPU_METHOD DINH_ct_Compu "" RAT_FUNC "%6.0" "" COEFFS 0 -1 4096 0 0 1 /end COMPU_METHOD
/end MODULE
/end PROJECT
