ASAP2_VERSION 1 60
/begin PROJECT MG1CS022 "MG1CS022"
/begin HEADER "" VERSION "MG1CS022_62XSC_V037" PROJECT_NO MG1CS022 /end HEADER
/begin MODULE DIM ""
/begin MOD_COMMON "" BYTE_ORDER MSB_LAST ALIGNMENT_BYTE 1 ALIGNMENT_WORD 2 ALIGNMENT_LONG 4 ALIGNMENT_INT64 4 ALIGNMENT_FLOAT32_IEEE 4 ALIGNMENT_FLOAT64_IEEE 4 DATA_SIZE 32 /end MOD_COMMON
/begin CHARACTERISTIC DFC_DisblMsk.DFC_MoCSOPICO_C "disable mask / Disable masks of check DFC_MoCSOPICO" VALUE 0x804F6148 Val_Wu16 65535.00 DFES_OneToOne 0.00 65535.00 FORMAT "%8.2" /end CHARACTERISTIC
/begin CHARACTERISTIC DFC_DisblMsk.DFC_MoFAPP_C "disable mask / Disable masks of check DFC_MoFAPP" VALUE 0x804F614A Val_Wu16 65535.00 DFES_OneToOne 0.00 65535.00 FORMAT "%8.2" /end CHARACTERISTIC
/begin CHARACTERISTIC DFC_DisblMsk.DFC_MoFAirFilgPrdc_C "disable mask / Disable masks of check DFC_MoFAirFilgPrdc" VALUE 0x804F614C Val_Wu16 65535.00 DFES_OneToOne 0.00 65535.00 FORMAT "%8.2" /end CHARACTERISTIC
/begin CHARACTERISTIC DFC_DisblMsk.DFC_MoFAirFlCtOffGdi_C "disable mask / Disable masks of check DFC_MoFAirFlCtOffGdi" VALUE 0x804F614E Val_Wu16 65535.00 DFES_OneToOne 0.00 65535.00 FORMAT "%8.2" /end CHARACTERISTIC
/begin CHARACTERISTIC DFC_DisblMsk.DFC_MoFAirFlCylGdi_C "disable mask / Disable masks of check DFC_MoFAirFlCylGdi" VALUE 0x804F6150 Val_Wu16 65535.00 DFES_OneToOne 0.00 65535.00 FORMAT "%8.2" /end CHARACTERISTIC
/begin CHARACTERISTIC DFC_DisblMsk.DFC_MoFAirFlFF_C "disable mask / Disable masks of check DFC_MoFAirFlFF" VALUE 0x804F6152 Val_Wu16 65535.00 DFES_OneToOne 0.00 65535.00 FORMAT "%8.2" /end CHARACTERISTIC
/begin CHARACTERISTIC DFC_DisblMsk.DFC_MoFAirFlIn_C "disable mask / Disable masks of check DFC_MoFAirFlIn" VALUE 0x804F6154 Val_Wu16 65535.00 DFES_OneToOne 0.00 65535.00 FORMAT "%8.2" /end CHARACTERISTIC
/begin CHARACTERISTIC DFC_DisblMsk.DFC_MoFAirFlMixCtlGdiChkAirFl_C "disable mask / Disable masks of check DFC_MoFAirFlMixCtlGdiChkAirFl" VALUE 0x804F6156 Val_Wu16 65535.00 DFES_OneToOne 0.00 65535.00 FORMAT "%8.2" /end CHARACTERISTIC
/begin CHARACTERISTIC DFC_DisblMsk.DFC_MoFAirFlMixCtlGdiChkCtrl_C "disable mask / Disable masks of check DFC_MoFAirFlMixCtlGdiChkCtrl" VALUE 0x804F6158 Val_Wu16 65535.00 DFES_OneToOne 0.00 65535.00 FORMAT "%8.2" /end CHARACTERISTIC
/begin CHARACTERISTIC DFC_DisblMsk.DFC_MoFAirFlMode_C "disable mask / Disable masks of check DFC_MoFAirFlMode" VALUE 0x804F615A Val_Wu16 65535.00 DFES_OneToOne 0.00 65535.00 FORMAT "%8.2" /end CHARACTERISTIC
/begin CHARACTERISTIC DFC_DisblMsk.DFC_MoFESpd_C "disable mask / Disable masks of check DFC_MoFESpd" VALUE 0x804F615C Val_Wu16 65535.00 DFES_OneToOne 0.00 65535.00 FORMAT "%8.2" /end CHARACTERISTIC
/begin CHARACTERISTIC DFC_DisblMsk.DFC_MoFIACo_C "disable mask / Disable masks of check DFC_MoFIACo" VALUE 0x804F615E Val_Wu16 65535.00 DFES_OneToOne 0.00 65535.00 FORMAT "%8.2" /end CHARACTERISTIC
/begin CHARACTERISTIC DFC_DisblMsk.DFC_MoFICOL1_C "disable mask / Disable masks of check DFC_MoFICOL1" VALUE 0x804F6160 Val_Wu16 65535.00 DFES_OneToOne 0.00 65535.00 FORMAT "%8.2" /end CHARACTERISTIC
/begin CHARACTERISTIC DFC_DisblMsk.DFC_MoFICOL2_C "disable mask / Disable masks of check DFC_MoFICOL2" VALUE 0x804F6162 Val_Wu16 65535.00 DFES_OneToOne 0.00 65535.00 FORMAT "%8.2" /end CHARACTERISTIC
/begin CHARACTERISTIC DFC_DisblMsk.DFC_MoFStrt_C "disable mask / Disable masks of check DFC_MoFStrt" VALUE 0x804F6164 Val_Wu16 65535.00 DFES_OneToOne 0.00 65535.00 FORMAT "%8.2" /end CHARACTERISTIC
/begin CHARACTERISTIC DFC_DisblMsk.DFC_MoFTrqCmp_C "disable mask / Disable masks of check DFC_MoFTrqCmp" VALUE 0x804F6166 Val_Wu16 65535.00 DFES_OneToOne 0.00 65535.00 FORMAT "%8.2" /end CHARACTERISTIC
/begin CHARACTERISTIC DFC_DisblMsk.DFC_MoFTrqCmpMax_C "disable mask / Disable masks of check DFC_MoFTrqCmpMax" VALUE 0x804F6168 Val_Wu16 65535.00 DFES_OneToOne 0.00 65535.00 FORMAT "%8.2" /end CHARACTERISTIC
/begin CHARACTERISTIC DFC_DisblMsk.DFC_MoFTrqCmpMin_C "disable mask / Disable masks of check DFC_MoFTrqCmpMin" VALUE 0x804F616A Val_Wu16 65535.00 DFES_OneToOne 0.00 65535.00 FORMAT "%8.2" /end CHARACTERISTIC
/begin CHARACTERISTIC DFC_DisblMsk.DFC_MoFVarPostBldSel_C "disable mask / Disable masks of check DFC_MoFVarPostBldSel" VALUE 0x804F616C Val_Wu16 65535.00 DFES_OneToOne 0.00 65535.00 FORMAT "%8.2" /end CHARACTERISTIC
/begin CHARACTERISTIC DFC_DisblMsk.DFC_MoXEMMHwLTMCUFW_C "disable mask / Disable masks of check DFC_MoXEMMHwLTMCUFW" VALUE 0x804F616E Val_Wu16 65535.00 DFES_OneToOne 0.00 65535.00 FORMAT "%8.2" /end CHARACTERISTIC
/begin CHARACTERISTIC DFC_DisblMsk.DFC_MoXEMMHwLTMonBIST_C "disable mask / Disable masks of check DFC_MoXEMMHwLTMonBIST" VALUE 0x804F6170 Val_Wu16 65535.00 DFES_OneToOne 0.00 65535.00 FORMAT "%8.2" /end CHARACTERISTIC
/begin CHARACTERISTIC DFC_DisblMsk.DFC_MoXEMMHwLTRegMonTest_C "disable mask / Disable masks of check DFC_MoXEMMHwLTRegMonTest" VALUE 0x804F6172 Val_Wu16 65535.00 DFES_OneToOne 0.00 65535.00 FORMAT "%8.2" /end CHARACTERISTIC
/begin CHARACTERISTIC DFC_DisblMsk.DFC_MoXEMMHwLTStbySMUAlvTest_C "disable mask / Disable masks of check DFC_MoXEMMHwLTStbySMUAlvTest" VALUE 0x804F6174 Val_Wu16 65535.00 DFES_OneToOne 0.00 65535.00 FORMAT "%8.2" /end CHARACTERISTIC
/begin CHARACTERISTIC DFC_DisblMsk.DFC_MoXEMMHwLTTempSens_C "disable mask / Disable masks of check DFC_MoXEMMHwLTTempSens" VALUE 0x804F6176 Val_Wu16 65535.00 DFES_OneToOne 0.00 65535.00 FORMAT "%8.2" /end CHARACTERISTIC
/begin CHARACTERISTIC DFC_DisblMsk.DFC_MoXEMMHwLTUCBCfg_C "disable mask / Disable masks of check DFC_MoXEMMHwLTUCBCfg" VALUE 0x804F6178 Val_Wu16 65535.00 DFES_OneToOne 0.00 65535.00 FORMAT "%8.2" /end CHARACTERISTIC
/begin CHARACTERISTIC DFC_DisblMsk.DFC_NWSEmax_C "disable mask / Disable masks of check DFC_NWSEmax" VALUE 0x804F617A Val_Wu16 65535.00 DFES_OneToOne 0.00 65535.00 FORMAT "%8.2" /end CHARACTERISTIC
/begin CHARACTERISTIC DFC_DisblMsk.DFC_NWSmax_C "disable mask / Disable masks of check DFC_NWSmax" VALUE 0x804F617C Val_Wu16 65535.00 DFES_OneToOne 0.00 65535.00 FORMAT "%8.2" /end CHARACTERISTIC
/begin CHARACTERISTIC DFC_DisblMsk.DFC_OCWDAABEActv_C "disable mask / Disable masks of check DFC_OCWDAABEActv" VALUE 0x804F617E Val_Wu16 65535.00 DFES_OneToOne 0.00 65535.00 FORMAT "%8.2" /end CHARACTERISTIC
/begin CHARACTERISTIC DFC_DisblMsk.DFC_OCWDACom_C "disable mask / Disable masks of check DFC_OCWDACom" VALUE 0x804F6180 Val_Wu16 65535.00 DFES_OneToOne 0.00 65535.00 FORMAT "%8.2" /end CHARACTERISTIC
/begin CHARACTERISTIC DFC_DisblMsk.DFC_OCWDAErrPin_C "disable mask / Disable masks of check DFC_OCWDAErrPin" VALUE 0x804F6182 Val_Wu16 65535.00 DFES_OneToOne 0.00 65535.00 FORMAT "%8.2" /end CHARACTERISTIC
/begin CHARACTERISTIC DFC_DisblMsk.DFC_OCWDAOvrVltg_C "disable mask / Disable masks of check DFC_OCWDAOvrVltg" VALUE 0x804F6184 Val_Wu16 65535.00 DFES_OneToOne 0.00 65535.00 FORMAT "%8.2" /end CHARACTERISTIC
/begin CHARACTERISTIC DFC_DisblMsk.DFC_ORAmax_C "disable mask / Disable masks of check DFC_ORAmax" VALUE 0x804F6186 Val_Wu16 65535.00 DFES_OneToOne 0.00 65535.00 FORMAT "%8.2" /end CHARACTERISTIC
/begin CHARACTERISTIC DFC_DisblMsk.DFC_ORAmin_C "disable mask / Disable masks of check DFC_ORAmin" VALUE 0x804F6188 Val_Wu16 65535.00 DFES_OneToOne 0.00 65535.00 FORMAT "%8.2" /end CHARACTERISTIC
/begin CHARACTERISTIC DFC_DisblMsk.DFC_OilPPlaus_C "disable mask / Disable masks of check DFC_OilPPlaus" VALUE 0x804F618A Val_Wu16 65535.00 DFES_OneToOne 0.00 65535.00 FORMAT "%8.2" /end CHARACTERISTIC
/begin CHARACTERISTIC DFC_DisblMsk.DFC_PLLSUmax_C "disable mask / Disable masks of check DFC_PLLSUmax" VALUE 0x804F618C Val_Wu16 65535.00 DFES_OneToOne 0.00 65535.00 FORMAT "%8.2" /end CHARACTERISTIC
/begin CHARACTERISTIC DFC_DisblMsk.DFC_PLLSUmin_C "disable mask / Disable masks of check DFC_PLLSUmin" VALUE 0x804F618E Val_Wu16 65535.00 DFES_OneToOne 0.00 65535.00 FORMAT "%8.2" /end CHARACTERISTIC
/begin CHARACTERISTIC DFC_DisblMsk.DFC_PSR1max_C "disable mask / Disable masks of check DFC_PSR1max" VALUE 0x804F6190 Val_Wu16 65535.00 DFES_OneToOne 0.00 65535.00 FORMAT "%8.2" /end CHARACTERISTIC
/begin CHARACTERISTIC DFC_DisblMsk.DFC_PSRBmax_C "disable mask / Disable masks of check DFC_PSRBmax" VALUE 0x804F6192 Val_Wu16 65535.00 DFES_OneToOne 0.00 65535.00 FORMAT "%8.2" /end CHARACTERISTIC
/begin CHARACTERISTIC DFC_DisblMsk.DFC_PSRBmin_C "disable mask / Disable masks of check DFC_PSRBmin" VALUE 0x804F6194 Val_Wu16 65535.00 DFES_OneToOne 0.00 65535.00 FORMAT "%8.2" /end CHARACTERISTIC
/begin CHARACTERISTIC DFC_DisblMsk.DFC_PSRPmax_C "disable mask / Disable masks of check DFC_PSRPmax" VALUE 0x804F6196 Val_Wu16 65535.00 DFES_OneToOne 0.00 65535.00 FORMAT "%8.2" /end CHARACTERISTIC
/begin CHARACTERISTIC DFC_DisblMsk.DFC_PSRPmin_C "disable mask / Disable masks of check DFC_PSRPmin" VALUE 0x804F6198 Val_Wu16 65535.00 DFES_OneToOne 0.00 65535.00 FORMAT "%8.2" /end CHARACTERISTIC
/begin CHARACTERISTIC DFC_DisblMsk.DFC_PSRPsig_C "disable mask / Disable masks of check DFC_PSRPsig" VALUE 0x804F619A Val_Wu16 65535.00 DFES_OneToOne 0.00 65535.00 FORMAT "%8.2" /end CHARACTERISTIC
/begin CHARACTERISTIC DFC_DisblMsk.DFC_PSRmax_C "disable mask / Disable masks of check DFC_PSRmax" VALUE 0x804F619C Val_Wu16 65535.00 DFES_OneToOne 0.00 65535.00 FORMAT "%8.2" /end CHARACTERISTIC
/begin CHARACTERISTIC DFC_DisblMsk.DFC_PUmax_C "disable mask / Disable masks of check DFC_PUmax" VALUE 0x804F619E Val_Wu16 65535.00 DFES_OneToOne 0.00 65535.00 FORMAT "%8.2" /end CHARACTERISTIC
/begin CHARACTERISTIC DFC_DisblMsk.DFC_P_VSE11_OL_C "disable mask / Disable masks of check DFC_P_VSE11_OL" VALUE 0x804F61A0 Val_Wu16 65535.00 DFES_OneToOne 0.00 65535.00 FORMAT "%8.2" /end CHARACTERISTIC
/begin CHARACTERISTIC DFC_DisblMsk.DFC_P_VSE11_SCB_C "disable mask / Disable masks of check DFC_P_VSE11_SCB" VALUE 0x804F61A2 Val_Wu16 65535.00 DFES_OneToOne 0.00 65535.00 FORMAT "%8.2" /end CHARACTERISTIC
/begin CHARACTERISTIC DFC_DisblMsk.DFC_P_VSE11_SCG_C "disable mask / Disable masks of check DFC_P_VSE11_SCG" VALUE 0x804F61A4 Val_Wu16 65535.00 DFES_OneToOne 0.00 65535.00 FORMAT "%8.2" /end CHARACTERISTIC
/begin CHARACTERISTIC DFC_DisblMsk.DFC_PhyHighAPP1_C "disable mask / Disable masks of check DFC_PhyHighAPP1" VALUE 0x804F61A6 Val_Wu16 65535.00 DFES_OneToOne 0.00 65535.00 FORMAT "%8.2" /end CHARACTERISTIC
/begin CHARACTERISTIC DFC_DisblMsk.DFC_PhyHighAPP2_C "disable mask / Disable masks of check DFC_PhyHighAPP2" VALUE 0x804F61A8 Val_Wu16 65535.00 DFES_OneToOne 0.00 65535.00 FORMAT "%8.2" /end CHARACTERISTIC
/begin CHARACTERISTIC DFC_DisblMsk.DFC_PhyLowAPP1_C "disable mask / Disable masks of check DFC_PhyLowAPP1" VALUE 0x804F61AA Val_Wu16 65535.00 DFES_OneToOne 0.00 65535.00 FORMAT "%8.2" /end CHARACTERISTIC
/begin CHARACTERISTIC DFC_DisblMsk.DFC_PhyLowAPP2_C "disable mask / Disable masks of check DFC_PhyLowAPP2" VALUE 0x804F61AC Val_Wu16 65535.00 DFES_OneToOne 0.00 65535.00 FORMAT "%8.2" /end CHARACTERISTIC
/begin CHARACTERISTIC DFC_DisblMsk.DFC_SRCHighAPP1_C "disable mask / Disable masks of check DFC_SRCHighAPP1" VALUE 0x804F61AE Val_Wu16 65535.00 DFES_OneToOne 0.00 65535.00 FORMAT "%8.2" /end CHARACTERISTIC
/begin CHARACTERISTIC DFC_DisblMsk.DFC_SRCHighAPP2_C "disable mask / Disable masks of check DFC_SRCHighAPP2" VALUE 0x804F61B0 Val_Wu16 65535.00 DFES_OneToOne 0.00 65535.00 FORMAT "%8.2" /end CHARACTERISTIC
/begin CHARACTERISTIC DFC_DisblMsk.DFC_SRCLowAPP1_C "disable mask / Disable masks of check DFC_SRCLowAPP1" VALUE 0x804F61B2 Val_Wu16 65535.00 DFES_OneToOne 0.00 65535.00 FORMAT "%8.2" /end CHARACTERISTIC
/begin CHARACTERISTIC DFC_DisblMsk.DFC_SRCLowAPP2_C "disable mask / Disable masks of check DFC_SRCLowAPP2" VALUE 0x804F61B4 Val_Wu16 65535.00 DFES_OneToOne 0.00 65535.00 FORMAT "%8.2" /end CHARACTERISTIC
/begin CHARACTERISTIC DFC_DisblMsk.DFC_SSpMon2_C "disable mask / Disable masks of check DFC_SSpMon2" VALUE 0x804F61B6 Val_Wu16 65535.00 DFES_OneToOne 0.00 65535.00 FORMAT "%8.2" /end CHARACTERISTIC
/begin CHARACTERISTIC DFC_DisblMsk.DFC_STHDRmax_C "disable mask / Disable masks of check DFC_STHDRmax" VALUE 0x804F61B8 Val_Wu16 65535.00 DFES_OneToOne 0.00 65535.00 FORMAT "%8.2" /end CHARACTERISTIC
/begin CHARACTERISTIC DFC_DisblMsk.DFC_SWReset_0_C "disable mask / Disable masks of check DFC_SWReset_0" VALUE 0x804F61BA Val_Wu16 65535.00 DFES_OneToOne 0.00 65535.00 FORMAT "%8.2" /end CHARACTERISTIC
/begin CHARACTERISTIC DFC_DisblMsk.DFC_SWReset_1_C "disable mask / Disable masks of check DFC_SWReset_1" VALUE 0x804F61BC Val_Wu16 65535.00 DFES_OneToOne 0.00 65535.00 FORMAT "%8.2" /end CHARACTERISTIC
/begin CHARACTERISTIC DFC_DisblMsk.DFC_SWReset_2_C "disable mask / Disable masks of check DFC_SWReset_2" VALUE 0x804F61BE Val_Wu16 65535.00 DFES_OneToOne 0.00 65535.00 FORMAT "%8.2" /end CHARACTERISTIC
/begin CHARACTERISTIC DFC_DisblMsk.DFC_SyncAPP_C "disable mask / Disable masks of check DFC_SyncAPP" VALUE 0x804F61C0 Val_Wu16 65535.00 DFES_OneToOne 0.00 65535.00 FORMAT "%8.2" /end CHARACTERISTIC
/begin CHARACTERISTIC DFC_DisblMsk.DFC_TANKLnpl_C "disable mask / Disable masks of check DFC_TANKLnpl" VALUE 0x804F61C2 Val_Wu16 65535.00 DFES_OneToOne 0.00 65535.00 FORMAT "%8.2" /end CHARACTERISTIC
/begin CHARACTERISTIC DFC_DisblMsk.DFC_TAmax_Dummy_C "disable mask / Disable masks of check DFC_TAmax_Dummy" VALUE 0x804F61C4 Val_Wu16 65535.00 DFES_OneToOne 0.00 65535.00 FORMAT "%8.2" /end CHARACTERISTIC
/begin CHARACTERISTIC DFC_DisblMsk.DFC_TESFmax_C "disable mask / Disable masks of check DFC_TESFmax" VALUE 0x804F61C6 Val_Wu16 65535.00 DFES_OneToOne 0.00 65535.00 FORMAT "%8.2" /end CHARACTERISTIC
/begin CHARACTERISTIC DFC_DisblMsk.DFC_TESGmax_C "disable mask / Disable masks of check DFC_TESGmax" VALUE 0x804F61C8 Val_Wu16 65535.00 DFES_OneToOne 0.00 65535.00 FORMAT "%8.2" /end CHARACTERISTIC
/begin CHARACTERISTIC DFC_DisblMsk.DFC_TKAEmax_C "disable mask / Disable masks of check DFC_TKAEmax" VALUE 0x804F61CA Val_Wu16 65535.00 DFES_OneToOne 0.00 65535.00 FORMAT "%8.2" /end CHARACTERISTIC
/begin CHARACTERISTIC DFC_DisblMsk.DFC_TKAEmin_C "disable mask / Disable masks of check DFC_TKAEmin" VALUE 0x804F61CC Val_Wu16 65535.00 DFES_OneToOne 0.00 65535.00 FORMAT "%8.2" /end CHARACTERISTIC
/begin CHARACTERISTIC DFC_DisblMsk.DFC_TKARmax_C "disable mask / Disable masks of check DFC_TKARmax" VALUE 0x804F61CE Val_Wu16 65535.00 DFES_OneToOne 0.00 65535.00 FORMAT "%8.2" /end CHARACTERISTIC
/begin CHARACTERISTIC DFC_DisblMsk.DFC_TKARnpl_C "disable mask / Disable masks of check DFC_TKARnpl" VALUE 0x804F61D0 Val_Wu16 65535.00 DFES_OneToOne 0.00 65535.00 FORMAT "%8.2" /end CHARACTERISTIC
/begin CHARACTERISTIC DFC_DisblMsk.DFC_TMmax_Dummy_C "disable mask / Disable masks of check DFC_TMmax_Dummy" VALUE 0x804F61D2 Val_Wu16 65535.00 DFES_OneToOne 0.00 65535.00 FORMAT "%8.2" /end CHARACTERISTIC
/begin CHARACTERISTIC DFC_DisblMsk.DFC_TUMmax_Dummy_C "disable mask / Disable masks of check DFC_TUMmax_Dummy" VALUE 0x804F61D4 Val_Wu16 65535.00 DFES_OneToOne 0.00 65535.00 FORMAT "%8.2" /end CHARACTERISTIC
/begin CHARACTERISTIC DFC_DisblMsk.DFC_TWCDPriCatB1_C "disable mask / Disable masks of check DFC_TWCDPriCatB1" VALUE 0x804F61D6 Val_Wu16 65535.00 DFES_OneToOne 0.00 65535.00 FORMAT "%8.2" /end CHARACTERISTIC
/begin CHARACTERISTIC DFC_DisblMsk.DFC_ThrVlvClsdPosnFirstOffsLrnImpoB1_C "disable mask / Disable masks of check DFC_ThrVlvClsdPosnFirstOffsLrnImpoB1" VALUE 0x804F61D8 Val_Wu16 65535.00 DFES_OneToOne 0.00 65535.00 FORMAT "%8.2" /end CHARACTERISTIC
/begin CHARACTERISTIC DFC_DisblMsk.DFC_ThrVlvClsdPosnOffsLrnImpoB1_C "disable mask / Disable masks of check DFC_ThrVlvClsdPosnOffsLrnImpoB1" VALUE 0x804F61DA Val_Wu16 65535.00 DFES_OneToOne 0.00 65535.00 FORMAT "%8.2" /end CHARACTERISTIC
/begin CHARACTERISTIC DFC_DisblMsk.DFC_ThrVlvClsdPosnOffsLrnMaxB1_C "disable mask / Disable masks of check DFC_ThrVlvClsdPosnOffsLrnMaxB1" VALUE 0x804F61DC Val_Wu16 65535.00 DFES_OneToOne 0.00 65535.00 FORMAT "%8.2" /end CHARACTERISTIC
/begin CHARACTERISTIC DFC_DisblMsk.DFC_ThrVlvClsdPosnOffsLrnMinB1_C "disable mask / Disable masks of check DFC_ThrVlvClsdPosnOffsLrnMinB1" VALUE 0x804F61DE Val_Wu16 65535.00 DFES_OneToOne 0.00 65535.00 FORMAT "%8.2" /end CHARACTERISTIC
/begin CHARACTERISTIC DFC_DisblMsk.DFC_ThrVlvCtrlDeB1_C "disable mask / Disable masks of check DFC_ThrVlvCtrlDeB1" VALUE 0x804F61E0 Val_Wu16 65535.00 DFES_OneToOne 0.00 65535.00 FORMAT "%8.2" /end CHARACTERISTIC
/begin CHARACTERISTIC DFC_DisblMsk.DFC_ThrVlvDycB1_C "disable mask / Disable masks of check DFC_ThrVlvDycB1" VALUE 0x804F61E2 Val_Wu16 65535.00 DFES_OneToOne 0.00 65535.00 FORMAT "%8.2" /end CHARACTERISTIC
/begin CHARACTERISTIC DFC_DisblMsk.DFC_ThrVlvLimpAirPosnMaxAbsltDriftB1_C "disable mask / Disable masks of check DFC_ThrVlvLimpAirPosnMaxAbsltDriftB1" VALUE 0x804F61E4 Val_Wu16 65535.00 DFES_OneToOne 0.00 65535.00 FORMAT "%8.2" /end CHARACTERISTIC
/begin CHARACTERISTIC DFC_DisblMsk.DFC_ThrVlvLimpAirPosnMaxB1_C "disable mask / Disable masks of check DFC_ThrVlvLimpAirPosnMaxB1" VALUE 0x804F61E6 Val_Wu16 65535.00 DFES_OneToOne 0.00 65535.00 FORMAT "%8.2" /end CHARACTERISTIC
/begin CHARACTERISTIC DFC_DisblMsk.DFC_ThrVlvLimpAirPosnMaxRelDriftB1_C "disable mask / Disable masks of check DFC_ThrVlvLimpAirPosnMaxRelDriftB1" VALUE 0x804F61E8 Val_Wu16 65535.00 DFES_OneToOne 0.00 65535.00 FORMAT "%8.2" /end CHARACTERISTIC
/begin CHARACTERISTIC DFC_DisblMsk.DFC_ThrVlvLimpAirPosnMinB1_C "disable mask / Disable masks of check DFC_ThrVlvLimpAirPosnMinB1" VALUE 0x804F61EA Val_Wu16 65535.00 DFES_OneToOne 0.00 65535.00 FORMAT "%8.2" /end CHARACTERISTIC
/begin CHARACTERISTIC DFC_DisblMsk.DFC_ThrVlvOpenLoadB1_C "disable mask / Disable masks of check DFC_ThrVlvOpenLoadB1" VALUE 0x804F61EC Val_Wu16 65535.00 DFES_OneToOne 0.00 65535.00 FORMAT "%8.2" /end CHARACTERISTIC
/begin CHARACTERISTIC DFC_DisblMsk.DFC_ThrVlvOpenSprgB1_C "disable mask / Disable masks of check DFC_ThrVlvOpenSprgB1" VALUE 0x804F61EE Val_Wu16 65535.00 DFES_OneToOne 0.00 65535.00 FORMAT "%8.2" /end CHARACTERISTIC
/begin CHARACTERISTIC DFC_DisblMsk.DFC_ThrVlvOpenSprgSprdB1_C "disable mask / Disable masks of check DFC_ThrVlvOpenSprgSprdB1" VALUE 0x804F61F0 Val_Wu16 65535.00 DFES_OneToOne 0.00 65535.00 FORMAT "%8.2" /end CHARACTERISTIC
/begin CHARACTERISTIC DFC_DisblMsk.DFC_ThrVlvOpenSprgTwnB1_C "disable mask / Disable masks of check DFC_ThrVlvOpenSprgTwnB1" VALUE 0x804F61F2 Val_Wu16 65535.00 DFES_OneToOne 0.00 65535.00 FORMAT "%8.2" /end CHARACTERISTIC
/begin CHARACTERISTIC DFC_DisblMsk.DFC_ThrVlvOverTB1_C "disable mask / Disable masks of check DFC_ThrVlvOverTB1" VALUE 0x804F61F4 Val_Wu16 65535.00 DFES_OneToOne 0.00 65535.00 FORMAT "%8.2" /end CHARACTERISTIC
/begin CHARACTERISTIC DFC_DisblMsk.DFC_ThrVlvRetSprgB1_C "disable mask / Disable masks of check DFC_ThrVlvRetSprgB1" VALUE 0x804F61F6 Val_Wu16 65535.00 DFES_OneToOne 0.00 65535.00 FORMAT "%8.2" /end CHARACTERISTIC
/begin CHARACTERISTIC DFC_DisblMsk.DFC_ThrVlvRetSprgSprdB1_C "disable mask / Disable masks of check DFC_ThrVlvRetSprgSprdB1" VALUE 0x804F61F8 Val_Wu16 65535.00 DFES_OneToOne 0.00 65535.00 FORMAT "%8.2" /end CHARACTERISTIC
/begin CHARACTERISTIC DFC_DisblMsk.DFC_ThrVlvRetSprgTwnB1_C "disable mask / Disable masks of check DFC_ThrVlvRetSprgTwnB1" VALUE 0x804F61FA Val_Wu16 65535.00 DFES_OneToOne 0.00 65535.00 FORMAT "%8.2" /end CHARACTERISTIC
/begin CHARACTERISTIC DFC_DisblMsk.DFC_ThrVlvSens1MaxB1_C "disable mask / Disable masks of check DFC_ThrVlvSens1MaxB1" VALUE 0x804F61FC Val_Wu16 65535.00 DFES_OneToOne 0.00 65535.00 FORMAT "%8.2" /end CHARACTERISTIC
/begin CHARACTERISTIC DFC_DisblMsk.DFC_ThrVlvSens1NplB1_C "disable mask / Disable masks of check DFC_ThrVlvSens1NplB1" VALUE 0x804F61FE Val_Wu16 65535.00 DFES_OneToOne 0.00 65535.00 FORMAT "%8.2" /end CHARACTERISTIC
/begin CHARACTERISTIC DFC_DisblMsk.DFC_ThrVlvSens2MaxB1_C "disable mask / Disable masks of check DFC_ThrVlvSens2MaxB1" VALUE 0x804F6200 Val_Wu16 65535.00 DFES_OneToOne 0.00 65535.00 FORMAT "%8.2" /end CHARACTERISTIC
/begin CHARACTERISTIC DFC_DisblMsk.DFC_ThrVlvSens2MinB1_C "disable mask / Disable masks of check DFC_ThrVlvSens2MinB1" VALUE 0x804F6202 Val_Wu16 65535.00 DFES_OneToOne 0.00 65535.00 FORMAT "%8.2" /end CHARACTERISTIC
/begin CHARACTERISTIC DFC_DisblMsk.DFC_ThrVlvSens2NplB1_C "disable mask / Disable masks of check DFC_ThrVlvSens2NplB1" VALUE 0x804F6204 Val_Wu16 65535.00 DFES_OneToOne 0.00 65535.00 FORMAT "%8.2" /end CHARACTERISTIC
/begin CHARACTERISTIC DFC_DisblMsk.DFC_ThrVlvShoCircB1_C "disable mask / Disable masks of check DFC_ThrVlvShoCircB1" VALUE 0x804F6206 Val_Wu16 65535.00 DFES_OneToOne 0.00 65535.00 FORMAT "%8.2" /end CHARACTERISTIC
/begin CHARACTERISTIC DFC_DisblMsk.DFC_ThrVlvSpiErrB1_C "disable mask / Disable masks of check DFC_ThrVlvSpiErrB1" VALUE 0x804F6208 Val_Wu16 65535.00 DFES_OneToOne 0.00 65535.00 FORMAT "%8.2" /end CHARACTERISTIC
/begin CHARACTERISTIC DFC_DisblMsk.DFC_ThrvlvSens1MinB1_C "disable mask / Disable masks of check DFC_ThrvlvSens1MinB1" VALUE 0x804F620A Val_Wu16 65535.00 DFES_OneToOne 0.00 65535.00 FORMAT "%8.2" /end CHARACTERISTIC
/begin CHARACTERISTIC DFC_DisblMsk.DFC_TiOffTBasdChkFast_C "disable mask / Disable masks of check DFC_TiOffTBasdChkFast" VALUE 0x804F620C Val_Wu16 65535.00 DFES_OneToOne 0.00 65535.00 FORMAT "%8.2" /end CHARACTERISTIC
/begin CHARACTERISTIC DFC_DisblMsk.DFC_TiOffTBasdChkSlow_C "disable mask / Disable masks of check DFC_TiOffTBasdChkSlow" VALUE 0x804F620E Val_Wu16 65535.00 DFES_OneToOne 0.00 65535.00 FORMAT "%8.2" /end CHARACTERISTIC
/begin CHARACTERISTIC DFC_DisblMsk.DFC_UEGOSnsrMntdS1B1_C "disable mask / Disable masks of check DFC_UEGOSnsrMntdS1B1" VALUE 0x804F6210 Val_Wu16 65535.00 DFES_OneToOne 0.00 65535.00 FORMAT "%8.2" /end CHARACTERISTIC
/begin CHARACTERISTIC DFC_DisblMsk.DFC_VehVSig_C "disable mask / Disable masks of check DFC_VehVSig" VALUE 0x804F6212 Val_Wu16 65535.00 DFES_OneToOne 0.00 65535.00 FORMAT "%8.2" /end CHARACTERISTIC
/begin CHARACTERISTIC DFC_DisblMsk.DFC_VlvLftFbSwtIntk11SpclFail_C "disable mask / Disable masks of check DFC_VlvLftFbSwtIntk11SpclFail" VALUE 0x804F6214 Val_Wu16 65535.00 DFES_OneToOne 0.00 65535.00 FORMAT "%8.2" /end CHARACTERISTIC
/begin CHARACTERISTIC DFC_DisblMsk.DFC_VlvLftFbSwtIntk11StdFail_C "disable mask / Disable masks of check DFC_VlvLftFbSwtIntk11StdFail" VALUE 0x804F6216 Val_Wu16 65535.00 DFES_OneToOne 0.00 65535.00 FORMAT "%8.2" /end CHARACTERISTIC
/begin CHARACTERISTIC DFC_DtcFuncUnit_C "AUTOSAR: Functional unit of DTC of all events" VALUE 0x804D96D4 Val_Wu8 255.0 OneToOne 0.00 255.0 FORMAT "%5.1" /end CHARACTERISTIC
/begin CHARACTERISTIC DFC_DtcGroup_C "AUTOSAR: Matching DTC group of all events" VALUE 0x804D96D5 Val_Wu8 16.0000000000 Dem_DTCGroup_Verb 0.00 16.0000000000 FORMAT "%13.10" /end CHARACTERISTIC
/begin CHARACTERISTIC DFC_DtcSeverity_C "AUTOSAR: DTC severity class of all events" VALUE 0x804D96D6 Val_Wu8 128.000000000 Dem_DTCSeverity_Verb 0.00 128.000000000 FORMAT "%13.9" /end CHARACTERISTIC
/begin CHARACTERISTIC DFES_Cls.DFC_Unused_C "fault class per DFC / " VALUE 0x804D96D8 Val_Wu8 30.00 DFES_OneToOne 0.00 30.00 FORMAT "%5.2" EXTENDED_LIMITS 0.00 255.0 READ_ONLY /end CHARACTERISTIC
/begin CHARACTERISTIC DFES_Cls.DFC_AAVEmax_C "fault class per DFC / Fault class for check DFC_AAVEmax" VALUE 0x804D96D9 Val_Wu8 30.00 DFES_OneToOne 0.00 30.00 FORMAT "%5.2" EXTENDED_LIMITS 0.00 255.0 /end CHARACTERISTIC
/begin CHARACTERISTIC DFES_Cls.DFC_AAVEmin_C "fault class per DFC / Fault class for check DFC_AAVEmin" VALUE 0x804D96DA Val_Wu8 30.00 DFES_OneToOne 0.00 30.00 FORMAT "%5.2" EXTENDED_LIMITS 0.00 255.0 /end CHARACTERISTIC
/begin CHARACTERISTIC DFES_Cls.DFC_AAVEsig_C "fault class per DFC / Fault class for check DFC_AAVEsig" VALUE 0x804D96DB Val_Wu8 30.00 DFES_OneToOne 0.00 30.00 FORMAT "%5.2" EXTENDED_LIMITS 0.00 255.0 /end CHARACTERISTIC
/begin CHARACTERISTIC DFES_Cls.DFC_AltIOACGFailr_C "fault class per DFC / Fault class for check DFC_AltIOACGFailr" VALUE 0x804D96DC Val_Wu8 30.00 DFES_OneToOne 0.00 30.00 FORMAT "%5.2" EXTENDED_LIMITS 0.00 255.0 /end CHARACTERISTIC
/begin CHARACTERISTIC DFES_Cls.DFC_AltIOACGHiVltg_C "fault class per DFC / Fault class for check DFC_AltIOACGHiVltg" VALUE 0x804D96DD Val_Wu8 30.00 DFES_OneToOne 0.00 30.00 FORMAT "%5.2" EXTENDED_LIMITS 0.00 255.0 /end CHARACTERISTIC
/begin CHARACTERISTIC DFES_Cls.DFC_AltIOACGLoVltg_C "fault class per DFC / Fault class for check DFC_AltIOACGLoVltg" VALUE 0x804D96DE Val_Wu8 30.00 DFES_OneToOne 0.00 30.00 FORMAT "%5.2" EXTENDED_LIMITS 0.00 255.0 /end CHARACTERISTIC
/begin CHARACTERISTIC DFES_Cls.DFC_AltIOACGTHi_C "fault class per DFC / Fault class for check DFC_AltIOACGTHi" VALUE 0x804D96DF Val_Wu8 30.00 DFES_OneToOne 0.00 30.00 FORMAT "%5.2" EXTENDED_LIMITS 0.00 255.0 /end CHARACTERISTIC
/begin CHARACTERISTIC DFES_Cls.DFC_AltIODConnACG_C "fault class per DFC / Fault class for check DFC_AltIODConnACG" VALUE 0x804D96E0 Val_Wu8 30.00 DFES_OneToOne 0.00 30.00 FORMAT "%5.2" EXTENDED_LIMITS 0.00 255.0 /end CHARACTERISTIC
/begin CHARACTERISTIC DFES_Cls.DFC_BGOELWAF_C "fault class per DFC / Fault class for check DFC_BGOELWAF" VALUE 0x804D96E1 Val_Wu8 30.00 DFES_OneToOne 0.00 30.00 FORMAT "%5.2" EXTENDED_LIMITS 0.00 255.0 /end CHARACTERISTIC
/begin CHARACTERISTIC DFES_Cls.DFC_BattUHiFailr_C "fault class per DFC / Fault class for check DFC_BattUHiFailr" VALUE 0x804D96E2 Val_Wu8 30.00 DFES_OneToOne 0.00 30.00 FORMAT "%5.2" EXTENDED_LIMITS 0.00 255.0 /end CHARACTERISTIC
/begin CHARACTERISTIC DFES_Cls.DFC_BattULoFailr_C "fault class per DFC / Fault class for check DFC_BattULoFailr" VALUE 0x804D96E3 Val_Wu8 30.00 DFES_OneToOne 0.00 30.00 FORMAT "%5.2" EXTENDED_LIMITS 0.00 255.0 /end CHARACTERISTIC
/begin CHARACTERISTIC DFES_Cls.DFC_BrkBstPDriftHiErr_C "fault class per DFC / Fault class for check DFC_BrkBstPDriftHiErr" VALUE 0x804D96E4 Val_Wu8 30.00 DFES_OneToOne 0.00 30.00 FORMAT "%5.2" EXTENDED_LIMITS 0.00 255.0 /end CHARACTERISTIC
/begin CHARACTERISTIC DFES_Cls.DFC_BrkBstPDriftLoErr_C "fault class per DFC / Fault class for check DFC_BrkBstPDriftLoErr" VALUE 0x804D96E5 Val_Wu8 30.00 DFES_OneToOne 0.00 30.00 FORMAT "%5.2" EXTENDED_LIMITS 0.00 255.0 /end CHARACTERISTIC
/begin CHARACTERISTIC DFES_Cls.DFC_BrkBstPSnsrStuck_C "fault class per DFC / Fault class for check DFC_BrkBstPSnsrStuck" VALUE 0x804D96E6 Val_Wu8 30.00 DFES_OneToOne 0.00 30.00 FORMAT "%5.2" EXTENDED_LIMITS 0.00 255.0 /end CHARACTERISTIC
/begin CHARACTERISTIC DFES_Cls.DFC_BrkMnSwtContOn_C "fault class per DFC / Fault class for check DFC_BrkMnSwtContOn" VALUE 0x804D96E7 Val_Wu8 30.00 DFES_OneToOne 0.00 30.00 FORMAT "%5.2" EXTENDED_LIMITS 0.00 255.0 /end CHARACTERISTIC
/begin CHARACTERISTIC DFES_Cls.DFC_BrkMnSwtNotStp_C "fault class per DFC / Fault class for check DFC_BrkMnSwtNotStp" VALUE 0x804D96E8 Val_Wu8 30.00 DFES_OneToOne 0.00 30.00 FORMAT "%5.2" EXTENDED_LIMITS 0.00 255.0 /end CHARACTERISTIC
/begin CHARACTERISTIC DFES_Cls.DFC_BrkNpl_C "fault class per DFC / Fault class for check DFC_BrkNpl" VALUE 0x804D96E9 Val_Wu8 30.00 DFES_OneToOne 0.00 30.00 FORMAT "%5.2" EXTENDED_LIMITS 0.00 255.0 /end CHARACTERISTIC
/begin CHARACTERISTIC DFES_Cls.DFC_BrkRdntSwtContOn_C "fault class per DFC / Fault class for check DFC_BrkRdntSwtContOn" VALUE 0x804D96EA Val_Wu8 30.00 DFES_OneToOne 0.00 30.00 FORMAT "%5.2" EXTENDED_LIMITS 0.00 255.0 /end CHARACTERISTIC
/begin CHARACTERISTIC DFES_Cls.DFC_BrkRdntSwtNotStp_C "fault class per DFC / Fault class for check DFC_BrkRdntSwtNotStp" VALUE 0x804D96EB Val_Wu8 30.00 DFES_OneToOne 0.00 30.00 FORMAT "%5.2" EXTENDED_LIMITS 0.00 255.0 /end CHARACTERISTIC
/begin CHARACTERISTIC DFES_Cls.DFC_Clth3ONStuck_C "fault class per DFC / Fault class for check DFC_Clth3ONStuck" VALUE 0x804D96EC Val_Wu8 30.00 DFES_OneToOne 0.00 30.00 FORMAT "%5.2" EXTENDED_LIMITS 0.00 255.0 /end CHARACTERISTIC
/begin CHARACTERISTIC DFES_Cls.DFC_Clth4OFFStuck_C "fault class per DFC / Fault class for check DFC_Clth4OFFStuck" VALUE 0x804D96ED Val_Wu8 30.00 DFES_OneToOne 0.00 30.00 FORMAT "%5.2" EXTENDED_LIMITS 0.00 255.0 /end CHARACTERISTIC
/begin CHARACTERISTIC DFES_Cls.DFC_ClthOFFStuck_C "fault class per DFC / Fault class for check DFC_ClthOFFStuck" VALUE 0x804D96EE Val_Wu8 30.00 DFES_OneToOne 0.00 30.00 FORMAT "%5.2" EXTENDED_LIMITS 0.00 255.0 /end CHARACTERISTIC
/begin CHARACTERISTIC DFES_Cls.DFC_ClthONStuck_C "fault class per DFC / Fault class for check DFC_ClthONStuck" VALUE 0x804D96EF Val_Wu8 30.00 DFES_OneToOne 0.00 30.00 FORMAT "%5.2" EXTENDED_LIMITS 0.00 255.0 /end CHARACTERISTIC
/begin CHARACTERISTIC DFES_Cls.DFC_ClthStkFailInfo_C "fault class per DFC / Fault class for check DFC_ClthStkFailInfo" VALUE 0x804D96F0 Val_Wu8 30.00 DFES_OneToOne 0.00 30.00 FORMAT "%5.2" EXTENDED_LIMITS 0.00 255.0 /end CHARACTERISTIC
/begin CHARACTERISTIC DFES_Cls.DFC_ComACFailInfo_C "fault class per DFC / Fault class for check DFC_ComACFailInfo" VALUE 0x804D96F1 Val_Wu8 30.00 DFES_OneToOne 0.00 30.00 FORMAT "%5.2" EXTENDED_LIMITS 0.00 255.0 /end CHARACTERISTIC
/begin CHARACTERISTIC DFES_Cls.DFC_ComATFTValErr_C "fault class per DFC / Fault class for check DFC_ComATFTValErr" VALUE 0x804D96F2 Val_Wu8 30.00 DFES_OneToOne 0.00 30.00 FORMAT "%5.2" EXTENDED_LIMITS 0.00 255.0 /end CHARACTERISTIC
/begin CHARACTERISTIC DFES_Cls.DFC_ComATMILReq_C "fault class per DFC / Fault class for check DFC_ComATMILReq" VALUE 0x804D96F3 Val_Wu8 30.00 DFES_OneToOne 0.00 30.00 FORMAT "%5.2" EXTENDED_LIMITS 0.00 255.0 /end CHARACTERISTIC
/begin CHARACTERISTIC DFES_Cls.DFC_ComAYCAChksum_C "fault class per DFC / Fault class for check DFC_ComAYCAChksum" VALUE 0x804D96F4 Val_Wu8 30.00 DFES_OneToOne 0.00 30.00 FORMAT "%5.2" EXTENDED_LIMITS 0.00 255.0 /end CHARACTERISTIC
/begin CHARACTERISTIC DFES_Cls.DFC_ComAYCARingCnt_C "fault class per DFC / Fault class for check DFC_ComAYCARingCnt" VALUE 0x804D96F5 Val_Wu8 30.00 DFES_OneToOne 0.00 30.00 FORMAT "%5.2" EXTENDED_LIMITS 0.00 255.0 /end CHARACTERISTIC
/begin CHARACTERISTIC DFES_Cls.DFC_ComAYCATOut_C "fault class per DFC / Fault class for check DFC_ComAYCATOut" VALUE 0x804D96F6 Val_Wu8 30.00 DFES_OneToOne 0.00 30.00 FORMAT "%5.2" EXTENDED_LIMITS 0.00 255.0 /end CHARACTERISTIC
/begin CHARACTERISTIC DFES_Cls.DFC_ComAYCDChkSum_C "fault class per DFC / Fault class for check DFC_ComAYCDChkSum" VALUE 0x804D96F7 Val_Wu8 30.00 DFES_OneToOne 0.00 30.00 FORMAT "%5.2" EXTENDED_LIMITS 0.00 255.0 /end CHARACTERISTIC
/begin CHARACTERISTIC DFES_Cls.DFC_ComAYCDTOut_C "fault class per DFC / Fault class for check DFC_ComAYCDTOut" VALUE 0x804D96F8 Val_Wu8 30.00 DFES_OneToOne 0.00 30.00 FORMAT "%5.2" EXTENDED_LIMITS 0.00 255.0 /end CHARACTERISTIC
/begin CHARACTERISTIC DFES_Cls.DFC_ComAYCFChksum_C "fault class per DFC / Fault class for check DFC_ComAYCFChksum" VALUE 0x804D96F9 Val_Wu8 30.00 DFES_OneToOne 0.00 30.00 FORMAT "%5.2" EXTENDED_LIMITS 0.00 255.0 /end CHARACTERISTIC
/begin CHARACTERISTIC DFES_Cls.DFC_ComAYCFRingCnt_C "fault class per DFC / Fault class for check DFC_ComAYCFRingCnt" VALUE 0x804D96FA Val_Wu8 30.00 DFES_OneToOne 0.00 30.00 FORMAT "%5.2" EXTENDED_LIMITS 0.00 255.0 /end CHARACTERISTIC
/begin CHARACTERISTIC DFES_Cls.DFC_ComAYCFTOut_C "fault class per DFC / Fault class for check DFC_ComAYCFTOut" VALUE 0x804D96FB Val_Wu8 30.00 DFES_OneToOne 0.00 30.00 FORMAT "%5.2" EXTENDED_LIMITS 0.00 255.0 /end CHARACTERISTIC
/begin CHARACTERISTIC DFES_Cls.DFC_ComAYCGChksum_C "fault class per DFC / Fault class for check DFC_ComAYCGChksum" VALUE 0x804D96FC Val_Wu8 30.00 DFES_OneToOne 0.00 30.00 FORMAT "%5.2" EXTENDED_LIMITS 0.00 255.0 /end CHARACTERISTIC
/begin CHARACTERISTIC DFES_Cls.DFC_ComAYCGRingCnt_C "fault class per DFC / Fault class for check DFC_ComAYCGRingCnt" VALUE 0x804D96FD Val_Wu8 30.00 DFES_OneToOne 0.00 30.00 FORMAT "%5.2" EXTENDED_LIMITS 0.00 255.0 /end CHARACTERISTIC
/begin CHARACTERISTIC DFES_Cls.DFC_ComAYCGTOut_C "fault class per DFC / Fault class for check DFC_ComAYCGTOut" VALUE 0x804D96FE Val_Wu8 30.00 DFES_OneToOne 0.00 30.00 FORMAT "%5.2" EXTENDED_LIMITS 0.00 255.0 /end CHARACTERISTIC
/begin CHARACTERISTIC DFES_Cls.DFC_ComAYCIChkSum_C "fault class per DFC / Fault class for check DFC_ComAYCIChkSum" VALUE 0x804D96FF Val_Wu8 30.00 DFES_OneToOne 0.00 30.00 FORMAT "%5.2" EXTENDED_LIMITS 0.00 255.0 /end CHARACTERISTIC
/begin CHARACTERISTIC DFES_Cls.DFC_ComAYCIRingCnt_C "fault class per DFC / Fault class for check DFC_ComAYCIRingCnt" VALUE 0x804D9700 Val_Wu8 30.00 DFES_OneToOne 0.00 30.00 FORMAT "%5.2" EXTENDED_LIMITS 0.00 255.0 /end CHARACTERISTIC
/begin CHARACTERISTIC DFES_Cls.DFC_ComAYCITOut_C "fault class per DFC / Fault class for check DFC_ComAYCITOut" VALUE 0x804D9701 Val_Wu8 30.00 DFES_OneToOne 0.00 30.00 FORMAT "%5.2" EXTENDED_LIMITS 0.00 255.0 /end CHARACTERISTIC
/begin CHARACTERISTIC DFES_Cls.DFC_ComBCM1ChkSum_C "fault class per DFC / Fault class for check DFC_ComBCM1ChkSum" VALUE 0x804D9702 Val_Wu8 30.00 DFES_OneToOne 0.00 30.00 FORMAT "%5.2" EXTENDED_LIMITS 0.00 255.0 /end CHARACTERISTIC
/begin CHARACTERISTIC DFES_Cls.DFC_ComBCM1RingCnt_C "fault class per DFC / Fault class for check DFC_ComBCM1RingCnt" VALUE 0x804D9703 Val_Wu8 30.00 DFES_OneToOne 0.00 30.00 FORMAT "%5.2" EXTENDED_LIMITS 0.00 255.0 /end CHARACTERISTIC
/begin CHARACTERISTIC DFES_Cls.DFC_ComBCM1TOut_C "fault class per DFC / Fault class for check DFC_ComBCM1TOut" VALUE 0x804D9704 Val_Wu8 30.00 DFES_OneToOne 0.00 30.00 FORMAT "%5.2" EXTENDED_LIMITS 0.00 255.0 /end CHARACTERISTIC
/begin CHARACTERISTIC DFES_Cls.DFC_ComCANABusOffErr_C "fault class per DFC / Fault class for check DFC_ComCANABusOffErr" VALUE 0x804D9705 Val_Wu8 30.00 DFES_OneToOne 0.00 30.00 FORMAT "%5.2" EXTENDED_LIMITS 0.00 255.0 /end CHARACTERISTIC
/begin CHARACTERISTIC DFES_Cls.DFC_ComCANBBusOffErr_C "fault class per DFC / Fault class for check DFC_ComCANBBusOffErr" VALUE 0x804D9706 Val_Wu8 30.00 DFES_OneToOne 0.00 30.00 FORMAT "%5.2" EXTENDED_LIMITS 0.00 255.0 /end CHARACTERISTIC
/begin CHARACTERISTIC DFES_Cls.DFC_ComCANCBusOffErr_C "fault class per DFC / Fault class for check DFC_ComCANCBusOffErr" VALUE 0x804D9707 Val_Wu8 30.00 DFES_OneToOne 0.00 30.00 FORMAT "%5.2" EXTENDED_LIMITS 0.00 255.0 /end CHARACTERISTIC
/begin CHARACTERISTIC DFES_Cls.DFC_ComCGW1ChkSum_C "fault class per DFC / Fault class for check DFC_ComCGW1ChkSum" VALUE 0x804D9708 Val_Wu8 30.00 DFES_OneToOne 0.00 30.00 FORMAT "%5.2" EXTENDED_LIMITS 0.00 255.0 /end CHARACTERISTIC
/begin CHARACTERISTIC DFES_Cls.DFC_ComCGW1RingCnt_C "fault class per DFC / Fault class for check DFC_ComCGW1RingCnt" VALUE 0x804D9709 Val_Wu8 30.00 DFES_OneToOne 0.00 30.00 FORMAT "%5.2" EXTENDED_LIMITS 0.00 255.0 /end CHARACTERISTIC
/begin CHARACTERISTIC DFES_Cls.DFC_ComCGW1TOut_C "fault class per DFC / Fault class for check DFC_ComCGW1TOut" VALUE 0x804D970A Val_Wu8 30.00 DFES_OneToOne 0.00 30.00 FORMAT "%5.2" EXTENDED_LIMITS 0.00 255.0 /end CHARACTERISTIC
/begin CHARACTERISTIC DFES_Cls.DFC_ComConvBoostErr_C "fault class per DFC / Fault class for check DFC_ComConvBoostErr" VALUE 0x804D970B Val_Wu8 30.00 DFES_OneToOne 0.00 30.00 FORMAT "%5.2" EXTENDED_LIMITS 0.00 255.0 /end CHARACTERISTIC
/begin CHARACTERISTIC DFES_Cls.DFC_ComConvSlipErr_C "fault class per DFC / Fault class for check DFC_ComConvSlipErr" VALUE 0x804D970C Val_Wu8 30.00 DFES_OneToOne 0.00 30.00 FORMAT "%5.2" EXTENDED_LIMITS 0.00 255.0 /end CHARACTERISTIC
/begin CHARACTERISTIC DFES_Cls.DFC_ComDCDCPrfmncErr_C "fault class per DFC / Fault class for check DFC_ComDCDCPrfmncErr" VALUE 0x804D970D Val_Wu8 30.00 DFES_OneToOne 0.00 30.00 FORMAT "%5.2" EXTENDED_LIMITS 0.00 255.0 /end CHARACTERISTIC
/begin CHARACTERISTIC DFES_Cls.DFC_ComDCDCTempWarn_C "fault class per DFC / Fault class for check DFC_ComDCDCTempWarn" VALUE 0x804D970E Val_Wu8 30.00 DFES_OneToOne 0.00 30.00 FORMAT "%5.2" EXTENDED_LIMITS 0.00 255.0 /end CHARACTERISTIC
/begin CHARACTERISTIC DFES_Cls.DFC_ComEAT10Chksum_C "fault class per DFC / Fault class for check DFC_ComEAT10Chksum" VALUE 0x804D970F Val_Wu8 30.00 DFES_OneToOne 0.00 30.00 FORMAT "%5.2" EXTENDED_LIMITS 0.00 255.0 /end CHARACTERISTIC
/begin CHARACTERISTIC DFES_Cls.DFC_ComEAT10RingCnt_C "fault class per DFC / Fault class for check DFC_ComEAT10RingCnt" VALUE 0x804D9710 Val_Wu8 30.00 DFES_OneToOne 0.00 30.00 FORMAT "%5.2" EXTENDED_LIMITS 0.00 255.0 /end CHARACTERISTIC
/begin CHARACTERISTIC DFES_Cls.DFC_ComEAT10TOut_C "fault class per DFC / Fault class for check DFC_ComEAT10TOut" VALUE 0x804D9711 Val_Wu8 30.00 DFES_OneToOne 0.00 30.00 FORMAT "%5.2" EXTENDED_LIMITS 0.00 255.0 /end CHARACTERISTIC
/begin CHARACTERISTIC DFES_Cls.DFC_ComEAT11ChkSum_C "fault class per DFC / Fault class for check DFC_ComEAT11ChkSum" VALUE 0x804D9712 Val_Wu8 30.00 DFES_OneToOne 0.00 30.00 FORMAT "%5.2" EXTENDED_LIMITS 0.00 255.0 /end CHARACTERISTIC
/begin CHARACTERISTIC DFES_Cls.DFC_ComEAT11RingCnt_C "fault class per DFC / Fault class for check DFC_ComEAT11RingCnt" VALUE 0x804D9713 Val_Wu8 30.00 DFES_OneToOne 0.00 30.00 FORMAT "%5.2" EXTENDED_LIMITS 0.00 255.0 /end CHARACTERISTIC
/begin CHARACTERISTIC DFES_Cls.DFC_ComEAT11TOut_C "fault class per DFC / Fault class for check DFC_ComEAT11TOut" VALUE 0x804D9714 Val_Wu8 30.00 DFES_OneToOne 0.00 30.00 FORMAT "%5.2" EXTENDED_LIMITS 0.00 255.0 /end CHARACTERISTIC
/begin CHARACTERISTIC DFES_Cls.DFC_ComEAT12ChkSum_C "fault class per DFC / Fault class for check DFC_ComEAT12ChkSum" VALUE 0x804D9715 Val_Wu8 30.00 DFES_OneToOne 0.00 30.00 FORMAT "%5.2" EXTENDED_LIMITS 0.00 255.0 /end CHARACTERISTIC
/begin CHARACTERISTIC DFES_Cls.DFC_ComEAT12RingCnt_C "fault class per DFC / Fault class for check DFC_ComEAT12RingCnt" VALUE 0x804D9716 Val_Wu8 30.00 DFES_OneToOne 0.00 30.00 FORMAT "%5.2" EXTENDED_LIMITS 0.00 255.0 /end CHARACTERISTIC
/begin CHARACTERISTIC DFES_Cls.DFC_ComEAT12TOut_C "fault class per DFC / Fault class for check DFC_ComEAT12TOut" VALUE 0x804D9717 Val_Wu8 30.00 DFES_OneToOne 0.00 30.00 FORMAT "%5.2" EXTENDED_LIMITS 0.00 255.0 /end CHARACTERISTIC
/begin CHARACTERISTIC DFES_Cls.DFC_ComEAT13ChkSum_C "fault class per DFC / Fault class for check DFC_ComEAT13ChkSum" VALUE 0x804D9718 Val_Wu8 30.00 DFES_OneToOne 0.00 30.00 FORMAT "%5.2" EXTENDED_LIMITS 0.00 255.0 /end CHARACTERISTIC
/begin CHARACTERISTIC DFES_Cls.DFC_ComEAT13RingCnt_C "fault class per DFC / Fault class for check DFC_ComEAT13RingCnt" VALUE 0x804D9719 Val_Wu8 30.00 DFES_OneToOne 0.00 30.00 FORMAT "%5.2" EXTENDED_LIMITS 0.00 255.0 /end CHARACTERISTIC
/begin CHARACTERISTIC DFES_Cls.DFC_ComEAT13TOut_C "fault class per DFC / Fault class for check DFC_ComEAT13TOut" VALUE 0x804D971A Val_Wu8 30.00 DFES_OneToOne 0.00 30.00 FORMAT "%5.2" EXTENDED_LIMITS 0.00 255.0 /end CHARACTERISTIC
/begin CHARACTERISTIC DFES_Cls.DFC_ComEAT1Chksum_C "fault class per DFC / Fault class for check DFC_ComEAT1Chksum" VALUE 0x804D971B Val_Wu8 30.00 DFES_OneToOne 0.00 30.00 FORMAT "%5.2" EXTENDED_LIMITS 0.00 255.0 /end CHARACTERISTIC
/begin CHARACTERISTIC DFES_Cls.DFC_ComEAT1RingCnt_C "fault class per DFC / Fault class for check DFC_ComEAT1RingCnt" VALUE 0x804D971C Val_Wu8 30.00 DFES_OneToOne 0.00 30.00 FORMAT "%5.2" EXTENDED_LIMITS 0.00 255.0 /end CHARACTERISTIC
/begin CHARACTERISTIC DFES_Cls.DFC_ComEAT1TOut_C "fault class per DFC / Fault class for check DFC_ComEAT1TOut" VALUE 0x804D971D Val_Wu8 30.00 DFES_OneToOne 0.00 30.00 FORMAT "%5.2" EXTENDED_LIMITS 0.00 255.0 /end CHARACTERISTIC
/begin CHARACTERISTIC DFES_Cls.DFC_ComEAT2ChkSum_C "fault class per DFC / Fault class for check DFC_ComEAT2ChkSum" VALUE 0x804D971E Val_Wu8 30.00 DFES_OneToOne 0.00 30.00 FORMAT "%5.2" EXTENDED_LIMITS 0.00 255.0 /end CHARACTERISTIC
/begin CHARACTERISTIC DFES_Cls.DFC_ComEAT2RingCnt_C "fault class per DFC / Fault class for check DFC_ComEAT2RingCnt" VALUE 0x804D971F Val_Wu8 30.00 DFES_OneToOne 0.00 30.00 FORMAT "%5.2" EXTENDED_LIMITS 0.00 255.0 /end CHARACTERISTIC
/begin CHARACTERISTIC DFES_Cls.DFC_ComEAT2TOut_C "fault class per DFC / Fault class for check DFC_ComEAT2TOut" VALUE 0x804D9720 Val_Wu8 30.00 DFES_OneToOne 0.00 30.00 FORMAT "%5.2" EXTENDED_LIMITS 0.00 255.0 /end CHARACTERISTIC
/begin CHARACTERISTIC DFES_Cls.DFC_ComEAT4ChkSum_C "fault class per DFC / Fault class for check DFC_ComEAT4ChkSum" VALUE 0x804D9721 Val_Wu8 30.00 DFES_OneToOne 0.00 30.00 FORMAT "%5.2" EXTENDED_LIMITS 0.00 255.0 /end CHARACTERISTIC
/begin CHARACTERISTIC DFES_Cls.DFC_ComEAT4RingCnt_C "fault class per DFC / Fault class for check DFC_ComEAT4RingCnt" VALUE 0x804D9722 Val_Wu8 30.00 DFES_OneToOne 0.00 30.00 FORMAT "%5.2" EXTENDED_LIMITS 0.00 255.0 /end CHARACTERISTIC
/begin CHARACTERISTIC DFES_Cls.DFC_ComEAT4TOut_C "fault class per DFC / Fault class for check DFC_ComEAT4TOut" VALUE 0x804D9723 Val_Wu8 30.00 DFES_OneToOne 0.00 30.00 FORMAT "%5.2" EXTENDED_LIMITS 0.00 255.0 /end CHARACTERISTIC
/begin CHARACTERISTIC DFES_Cls.DFC_ComEAT6Chksum_C "fault class per DFC / Fault class for check DFC_ComEAT6Chksum" VALUE 0x804D9724 Val_Wu8 30.00 DFES_OneToOne 0.00 30.00 FORMAT "%5.2" EXTENDED_LIMITS 0.00 255.0 /end CHARACTERISTIC
/begin CHARACTERISTIC DFES_Cls.DFC_ComEAT6RingCnt_C "fault class per DFC / Fault class for check DFC_ComEAT6RingCnt" VALUE 0x804D9725 Val_Wu8 30.00 DFES_OneToOne 0.00 30.00 FORMAT "%5.2" EXTENDED_LIMITS 0.00 255.0 /end CHARACTERISTIC
/begin CHARACTERISTIC DFES_Cls.DFC_ComEAT6TOut_C "fault class per DFC / Fault class for check DFC_ComEAT6TOut" VALUE 0x804D9726 Val_Wu8 30.00 DFES_OneToOne 0.00 30.00 FORMAT "%5.2" EXTENDED_LIMITS 0.00 255.0 /end CHARACTERISTIC
/begin CHARACTERISTIC DFES_Cls.DFC_ComEAT7Chksum_C "fault class per DFC / Fault class for check DFC_ComEAT7Chksum" VALUE 0x804D9727 Val_Wu8 30.00 DFES_OneToOne 0.00 30.00 FORMAT "%5.2" EXTENDED_LIMITS 0.00 255.0 /end CHARACTERISTIC
/begin CHARACTERISTIC DFES_Cls.DFC_ComEAT7RingCnt_C "fault class per DFC / Fault class for check DFC_ComEAT7RingCnt" VALUE 0x804D9728 Val_Wu8 30.00 DFES_OneToOne 0.00 30.00 FORMAT "%5.2" EXTENDED_LIMITS 0.00 255.0 /end CHARACTERISTIC
/begin CHARACTERISTIC DFES_Cls.DFC_ComEAT7TOut_C "fault class per DFC / Fault class for check DFC_ComEAT7TOut" VALUE 0x804D9729 Val_Wu8 30.00 DFES_OneToOne 0.00 30.00 FORMAT "%5.2" EXTENDED_LIMITS 0.00 255.0 /end CHARACTERISTIC
/begin CHARACTERISTIC DFES_Cls.DFC_ComEAT8Chksum_C "fault class per DFC / Fault class for check DFC_ComEAT8Chksum" VALUE 0x804D972A Val_Wu8 30.00 DFES_OneToOne 0.00 30.00 FORMAT "%5.2" EXTENDED_LIMITS 0.00 255.0 /end CHARACTERISTIC
/begin CHARACTERISTIC DFES_Cls.DFC_ComEAT8RingCnt_C "fault class per DFC / Fault class for check DFC_ComEAT8RingCnt" VALUE 0x804D972B Val_Wu8 30.00 DFES_OneToOne 0.00 30.00 FORMAT "%5.2" EXTENDED_LIMITS 0.00 255.0 /end CHARACTERISTIC
/begin CHARACTERISTIC DFES_Cls.DFC_ComEAT8TOut_C "fault class per DFC / Fault class for check DFC_ComEAT8TOut" VALUE 0x804D972C Val_Wu8 30.00 DFES_OneToOne 0.00 30.00 FORMAT "%5.2" EXTENDED_LIMITS 0.00 255.0 /end CHARACTERISTIC
/begin CHARACTERISTIC DFES_Cls.DFC_ComEATAChksum_C "fault class per DFC / Fault class for check DFC_ComEATAChksum" VALUE 0x804D972D Val_Wu8 30.00 DFES_OneToOne 0.00 30.00 FORMAT "%5.2" EXTENDED_LIMITS 0.00 255.0 /end CHARACTERISTIC
/begin CHARACTERISTIC DFES_Cls.DFC_ComEATARingCnt_C "fault class per DFC / Fault class for check DFC_ComEATARingCnt" VALUE 0x804D972E Val_Wu8 30.00 DFES_OneToOne 0.00 30.00 FORMAT "%5.2" EXTENDED_LIMITS 0.00 255.0 /end CHARACTERISTIC
/begin CHARACTERISTIC DFES_Cls.DFC_ComEATATOut_C "fault class per DFC / Fault class for check DFC_ComEATATOut" VALUE 0x804D972F Val_Wu8 30.00 DFES_OneToOne 0.00 30.00 FORMAT "%5.2" EXTENDED_LIMITS 0.00 255.0 /end CHARACTERISTIC
/begin CHARACTERISTIC DFES_Cls.DFC_ComEATBChkSum_C "fault class per DFC / Fault class for check DFC_ComEATBChkSum" VALUE 0x804D9730 Val_Wu8 30.00 DFES_OneToOne 0.00 30.00 FORMAT "%5.2" EXTENDED_LIMITS 0.00 255.0 /end CHARACTERISTIC
/begin CHARACTERISTIC DFES_Cls.DFC_ComEATBRingCnt_C "fault class per DFC / Fault class for check DFC_ComEATBRingCnt" VALUE 0x804D9731 Val_Wu8 30.00 DFES_OneToOne 0.00 30.00 FORMAT "%5.2" EXTENDED_LIMITS 0.00 255.0 /end CHARACTERISTIC
/begin CHARACTERISTIC DFES_Cls.DFC_ComEATBTOut_C "fault class per DFC / Fault class for check DFC_ComEATBTOut" VALUE 0x804D9732 Val_Wu8 30.00 DFES_OneToOne 0.00 30.00 FORMAT "%5.2" EXTENDED_LIMITS 0.00 255.0 /end CHARACTERISTIC
/begin CHARACTERISTIC DFES_Cls.DFC_ComEATCChksum_C "fault class per DFC / Fault class for check DFC_ComEATCChksum" VALUE 0x804D9733 Val_Wu8 30.00 DFES_OneToOne 0.00 30.00 FORMAT "%5.2" EXTENDED_LIMITS 0.00 255.0 /end CHARACTERISTIC
/begin CHARACTERISTIC DFES_Cls.DFC_ComEATCRingCnt_C "fault class per DFC / Fault class for check DFC_ComEATCRingCnt" VALUE 0x804D9734 Val_Wu8 30.00 DFES_OneToOne 0.00 30.00 FORMAT "%5.2" EXTENDED_LIMITS 0.00 255.0 /end CHARACTERISTIC
/begin CHARACTERISTIC DFES_Cls.DFC_ComEATCTOut_C "fault class per DFC / Fault class for check DFC_ComEATCTOut" VALUE 0x804D9735 Val_Wu8 30.00 DFES_OneToOne 0.00 30.00 FORMAT "%5.2" EXTENDED_LIMITS 0.00 255.0 /end CHARACTERISTIC
/begin CHARACTERISTIC DFES_Cls.DFC_ComEPBBChkSum_C "fault class per DFC / Fault class for check DFC_ComEPBBChkSum" VALUE 0x804D9736 Val_Wu8 30.00 DFES_OneToOne 0.00 30.00 FORMAT "%5.2" EXTENDED_LIMITS 0.00 255.0 /end CHARACTERISTIC
/begin CHARACTERISTIC DFES_Cls.DFC_ComEPBBRingCnt_C "fault class per DFC / Fault class for check DFC_ComEPBBRingCnt" VALUE 0x804D9737 Val_Wu8 30.00 DFES_OneToOne 0.00 30.00 FORMAT "%5.2" EXTENDED_LIMITS 0.00 255.0 /end CHARACTERISTIC
/begin CHARACTERISTIC DFES_Cls.DFC_ComEPBBTOut_C "fault class per DFC / Fault class for check DFC_ComEPBBTOut" VALUE 0x804D9738 Val_Wu8 30.00 DFES_OneToOne 0.00 30.00 FORMAT "%5.2" EXTENDED_LIMITS 0.00 255.0 /end CHARACTERISTIC
/begin CHARACTERISTIC DFES_Cls.DFC_ComEPBChksum_C "fault class per DFC / Fault class for check DFC_ComEPBChksum" VALUE 0x804D9739 Val_Wu8 30.00 DFES_OneToOne 0.00 30.00 FORMAT "%5.2" EXTENDED_LIMITS 0.00 255.0 /end CHARACTERISTIC
/begin CHARACTERISTIC DFES_Cls.DFC_ComEPBTOut_C "fault class per DFC / Fault class for check DFC_ComEPBTOut" VALUE 0x804D973A Val_Wu8 30.00 DFES_OneToOne 0.00 30.00 FORMAT "%5.2" EXTENDED_LIMITS 0.00 255.0 /end CHARACTERISTIC
/begin CHARACTERISTIC DFES_Cls.DFC_ComEPBctRing_C "fault class per DFC / Fault class for check DFC_ComEPBctRing" VALUE 0x804D973B Val_Wu8 30.00 DFES_OneToOne 0.00 30.00 FORMAT "%5.2" EXTENDED_LIMITS 0.00 255.0 /end CHARACTERISTIC
/begin CHARACTERISTIC DFES_Cls.DFC_ComEPS1Chksum_C "fault class per DFC / Fault class for check DFC_ComEPS1Chksum" VALUE 0x804D973C Val_Wu8 30.00 DFES_OneToOne 0.00 30.00 FORMAT "%5.2" EXTENDED_LIMITS 0.00 255.0 /end CHARACTERISTIC
/begin CHARACTERISTIC DFES_Cls.DFC_ComEPS1RingCnt_C "fault class per DFC / Fault class for check DFC_ComEPS1RingCnt" VALUE 0x804D973D Val_Wu8 30.00 DFES_OneToOne 0.00 30.00 FORMAT "%5.2" EXTENDED_LIMITS 0.00 255.0 /end CHARACTERISTIC
/begin CHARACTERISTIC DFES_Cls.DFC_ComEPS1TOut_C "fault class per DFC / Fault class for check DFC_ComEPS1TOut" VALUE 0x804D973E Val_Wu8 30.00 DFES_OneToOne 0.00 30.00 FORMAT "%5.2" EXTENDED_LIMITS 0.00 255.0 /end CHARACTERISTIC
/begin CHARACTERISTIC DFES_Cls.DFC_ComEngCanRxErr_C "fault class per DFC / Fault class for check DFC_ComEngCanRxErr" VALUE 0x804D973F Val_Wu8 30.00 DFES_OneToOne 0.00 30.00 FORMAT "%5.2" EXTENDED_LIMITS 0.00 255.0 /end CHARACTERISTIC
/begin CHARACTERISTIC DFES_Cls.DFC_ComGrvySnsrErr_C "fault class per DFC / Fault class for check DFC_ComGrvySnsrErr" VALUE 0x804D9740 Val_Wu8 30.00 DFES_OneToOne 0.00 30.00 FORMAT "%5.2" EXTENDED_LIMITS 0.00 255.0 /end CHARACTERISTIC
/begin CHARACTERISTIC DFES_Cls.DFC_ComGwIMG1ChkSum_C "fault class per DFC / Fault class for check DFC_ComGwIMG1ChkSum" VALUE 0x804D9741 Val_Wu8 30.00 DFES_OneToOne 0.00 30.00 FORMAT "%5.2" EXTENDED_LIMITS 0.00 255.0 /end CHARACTERISTIC
/begin CHARACTERISTIC DFES_Cls.DFC_ComGwIMG1RingCnt_C "fault class per DFC / Fault class for check DFC_ComGwIMG1RingCnt" VALUE 0x804D9742 Val_Wu8 30.00 DFES_OneToOne 0.00 30.00 FORMAT "%5.2" EXTENDED_LIMITS 0.00 255.0 /end CHARACTERISTIC
/begin CHARACTERISTIC DFES_Cls.DFC_ComGwIMG1TOut_C "fault class per DFC / Fault class for check DFC_ComGwIMG1TOut" VALUE 0x804D9743 Val_Wu8 30.00 DFES_OneToOne 0.00 30.00 FORMAT "%5.2" EXTENDED_LIMITS 0.00 255.0 /end CHARACTERISTIC
/begin CHARACTERISTIC DFES_Cls.DFC_ComGwIMG3ChkSum_C "fault class per DFC / Fault class for check DFC_ComGwIMG3ChkSum" VALUE 0x804D9744 Val_Wu8 30.00 DFES_OneToOne 0.00 30.00 FORMAT "%5.2" EXTENDED_LIMITS 0.00 255.0 /end CHARACTERISTIC
/begin CHARACTERISTIC DFES_Cls.DFC_ComGwIMG3RingCnt_C "fault class per DFC / Fault class for check DFC_ComGwIMG3RingCnt" VALUE 0x804D9745 Val_Wu8 30.00 DFES_OneToOne 0.00 30.00 FORMAT "%5.2" EXTENDED_LIMITS 0.00 255.0 /end CHARACTERISTIC
/begin CHARACTERISTIC DFES_Cls.DFC_ComGwIMG3TOut_C "fault class per DFC / Fault class for check DFC_ComGwIMG3TOut" VALUE 0x804D9746 Val_Wu8 30.00 DFES_OneToOne 0.00 30.00 FORMAT "%5.2" EXTENDED_LIMITS 0.00 255.0 /end CHARACTERISTIC
/begin CHARACTERISTIC DFES_Cls.DFC_ComGwIMG4ChkSum_C "fault class per DFC / Fault class for check DFC_ComGwIMG4ChkSum" VALUE 0x804D9747 Val_Wu8 30.00 DFES_OneToOne 0.00 30.00 FORMAT "%5.2" EXTENDED_LIMITS 0.00 255.0 /end CHARACTERISTIC
/begin CHARACTERISTIC DFES_Cls.DFC_ComGwIMG4RingCnt_C "fault class per DFC / Fault class for check DFC_ComGwIMG4RingCnt" VALUE 0x804D9748 Val_Wu8 30.00 DFES_OneToOne 0.00 30.00 FORMAT "%5.2" EXTENDED_LIMITS 0.00 255.0 /end CHARACTERISTIC
/begin CHARACTERISTIC DFES_Cls.DFC_ComGwIMG4TOut_C "fault class per DFC / Fault class for check DFC_ComGwIMG4TOut" VALUE 0x804D9749 Val_Wu8 30.00 DFES_OneToOne 0.00 30.00 FORMAT "%5.2" EXTENDED_LIMITS 0.00 255.0 /end CHARACTERISTIC
/begin CHARACTERISTIC DFES_Cls.DFC_ComGwIMG5ChkSum_C "fault class per DFC / Fault class for check DFC_ComGwIMG5ChkSum" VALUE 0x804D974A Val_Wu8 30.00 DFES_OneToOne 0.00 30.00 FORMAT "%5.2" EXTENDED_LIMITS 0.00 255.0 /end CHARACTERISTIC
/begin CHARACTERISTIC DFES_Cls.DFC_ComGwIMG5RingCnt_C "fault class per DFC / Fault class for check DFC_ComGwIMG5RingCnt" VALUE 0x804D974B Val_Wu8 30.00 DFES_OneToOne 0.00 30.00 FORMAT "%5.2" EXTENDED_LIMITS 0.00 255.0 /end CHARACTERISTIC
/begin CHARACTERISTIC DFES_Cls.DFC_ComGwIMG5TOut_C "fault class per DFC / Fault class for check DFC_ComGwIMG5TOut" VALUE 0x804D974C Val_Wu8 30.00 DFES_OneToOne 0.00 30.00 FORMAT "%5.2" EXTENDED_LIMITS 0.00 255.0 /end CHARACTERISTIC
/begin CHARACTERISTIC DFES_Cls.DFC_ComGwIMG6ChkSum_C "fault class per DFC / Fault class for check DFC_ComGwIMG6ChkSum" VALUE 0x804D974D Val_Wu8 30.00 DFES_OneToOne 0.00 30.00 FORMAT "%5.2" EXTENDED_LIMITS 0.00 255.0 /end CHARACTERISTIC
/begin CHARACTERISTIC DFES_Cls.DFC_ComGwIMG6RingCnt_C "fault class per DFC / Fault class for check DFC_ComGwIMG6RingCnt" VALUE 0x804D974E Val_Wu8 30.00 DFES_OneToOne 0.00 30.00 FORMAT "%5.2" EXTENDED_LIMITS 0.00 255.0 /end CHARACTERISTIC
/begin CHARACTERISTIC DFES_Cls.DFC_ComGwIMG6TOut_C "fault class per DFC / Fault class for check DFC_ComGwIMG6TOut" VALUE 0x804D974F Val_Wu8 30.00 DFES_OneToOne 0.00 30.00 FORMAT "%5.2" EXTENDED_LIMITS 0.00 255.0 /end CHARACTERISTIC
/begin CHARACTERISTIC DFES_Cls.DFC_ComIDASBChksum_C "fault class per DFC / Fault class for check DFC_ComIDASBChksum" VALUE 0x804D9750 Val_Wu8 30.00 DFES_OneToOne 0.00 30.00 FORMAT "%5.2" EXTENDED_LIMITS 0.00 255.0 /end CHARACTERISTIC
/begin CHARACTERISTIC DFES_Cls.DFC_ComIDASBRingCnt_C "fault class per DFC / Fault class for check DFC_ComIDASBRingCnt" VALUE 0x804D9751 Val_Wu8 30.00 DFES_OneToOne 0.00 30.00 FORMAT "%5.2" EXTENDED_LIMITS 0.00 255.0 /end CHARACTERISTIC
/begin CHARACTERISTIC DFES_Cls.DFC_ComIDASBTOut_C "fault class per DFC / Fault class for check DFC_ComIDASBTOut" VALUE 0x804D9752 Val_Wu8 30.00 DFES_OneToOne 0.00 30.00 FORMAT "%5.2" EXTENDED_LIMITS 0.00 255.0 /end CHARACTERISTIC
/begin CHARACTERISTIC DFES_Cls.DFC_ComIMGMILReq_C "fault class per DFC / Fault class for check DFC_ComIMGMILReq" VALUE 0x804D9753 Val_Wu8 30.00 DFES_OneToOne 0.00 30.00 FORMAT "%5.2" EXTENDED_LIMITS 0.00 255.0 /end CHARACTERISTIC
/begin CHARACTERISTIC DFES_Cls.DFC_ComISSPrms_C "fault class per DFC / Fault class for check DFC_ComISSPrms" VALUE 0x804D9754 Val_Wu8 30.00 DFES_OneToOne 0.00 30.00 FORMAT "%5.2" EXTENDED_LIMITS 0.00 255.0 /end CHARACTERISTIC
/begin CHARACTERISTIC DFES_Cls.DFC_ComMETAChksum_C "fault class per DFC / Fault class for check DFC_ComMETAChksum" VALUE 0x804D9755 Val_Wu8 30.00 DFES_OneToOne 0.00 30.00 FORMAT "%5.2" EXTENDED_LIMITS 0.00 255.0 /end CHARACTERISTIC
/begin CHARACTERISTIC DFES_Cls.DFC_ComMETAChksumPstDrv_C "fault class per DFC / Fault class for check DFC_ComMETAChksumPstDrv" VALUE 0x804D9756 Val_Wu8 30.00 DFES_OneToOne 0.00 30.00 FORMAT "%5.2" EXTENDED_LIMITS 0.00 255.0 /end CHARACTERISTIC
/begin CHARACTERISTIC DFES_Cls.DFC_ComMETARingCnt_C "fault class per DFC / Fault class for check DFC_ComMETARingCnt" VALUE 0x804D9757 Val_Wu8 30.00 DFES_OneToOne 0.00 30.00 FORMAT "%5.2" EXTENDED_LIMITS 0.00 255.0 /end CHARACTERISTIC
/begin CHARACTERISTIC DFES_Cls.DFC_ComMETARingCntPstDrv_C "fault class per DFC / Fault class for check DFC_ComMETARingCntPstDrv" VALUE 0x804D9758 Val_Wu8 30.00 DFES_OneToOne 0.00 30.00 FORMAT "%5.2" EXTENDED_LIMITS 0.00 255.0 /end CHARACTERISTIC
/begin CHARACTERISTIC DFES_Cls.DFC_ComMETATOut_C "fault class per DFC / Fault class for check DFC_ComMETATOut" VALUE 0x804D9759 Val_Wu8 30.00 DFES_OneToOne 0.00 30.00 FORMAT "%5.2" EXTENDED_LIMITS 0.00 255.0 /end CHARACTERISTIC
/begin CHARACTERISTIC DFES_Cls.DFC_ComMETATOutPstDrv_C "fault class per DFC / Fault class for check DFC_ComMETATOutPstDrv" VALUE 0x804D975A Val_Wu8 30.00 DFES_OneToOne 0.00 30.00 FORMAT "%5.2" EXTENDED_LIMITS 0.00 255.0 /end CHARACTERISTIC
/begin CHARACTERISTIC DFES_Cls.DFC_ComMETCChksum_C "fault class per DFC / Fault class for check DFC_ComMETCChksum" VALUE 0x804D975B Val_Wu8 30.00 DFES_OneToOne 0.00 30.00 FORMAT "%5.2" EXTENDED_LIMITS 0.00 255.0 /end CHARACTERISTIC
/begin CHARACTERISTIC DFES_Cls.DFC_ComMETCRingCnt_C "fault class per DFC / Fault class for check DFC_ComMETCRingCnt" VALUE 0x804D975C Val_Wu8 30.00 DFES_OneToOne 0.00 30.00 FORMAT "%5.2" EXTENDED_LIMITS 0.00 255.0 /end CHARACTERISTIC
/begin CHARACTERISTIC DFES_Cls.DFC_ComMETCTOut_C "fault class per DFC / Fault class for check DFC_ComMETCTOut" VALUE 0x804D975D Val_Wu8 30.00 DFES_OneToOne 0.00 30.00 FORMAT "%5.2" EXTENDED_LIMITS 0.00 255.0 /end CHARACTERISTIC
/begin CHARACTERISTIC DFES_Cls.DFC_ComMETDChksum_C "fault class per DFC / Fault class for check DFC_ComMETDChksum" VALUE 0x804D975E Val_Wu8 30.00 DFES_OneToOne 0.00 30.00 FORMAT "%5.2" EXTENDED_LIMITS 0.00 255.0 /end CHARACTERISTIC
/begin CHARACTERISTIC DFES_Cls.DFC_ComMETDRingCnt_C "fault class per DFC / Fault class for check DFC_ComMETDRingCnt" VALUE 0x804D975F Val_Wu8 30.00 DFES_OneToOne 0.00 30.00 FORMAT "%5.2" EXTENDED_LIMITS 0.00 255.0 /end CHARACTERISTIC
/begin CHARACTERISTIC DFES_Cls.DFC_ComMETDTOut_C "fault class per DFC / Fault class for check DFC_ComMETDTOut" VALUE 0x804D9760 Val_Wu8 30.00 DFES_OneToOne 0.00 30.00 FORMAT "%5.2" EXTENDED_LIMITS 0.00 255.0 /end CHARACTERISTIC
/begin CHARACTERISTIC DFES_Cls.DFC_ComMETE2Chksum_C "fault class per DFC / Fault class for check DFC_ComMETE2Chksum" VALUE 0x804D9761 Val_Wu8 30.00 DFES_OneToOne 0.00 30.00 FORMAT "%5.2" EXTENDED_LIMITS 0.00 255.0 /end CHARACTERISTIC
/begin CHARACTERISTIC DFES_Cls.DFC_ComMETE2RingCnt_C "fault class per DFC / Fault class for check DFC_ComMETE2RingCnt" VALUE 0x804D9762 Val_Wu8 30.00 DFES_OneToOne 0.00 30.00 FORMAT "%5.2" EXTENDED_LIMITS 0.00 255.0 /end CHARACTERISTIC
/begin CHARACTERISTIC DFES_Cls.DFC_ComMETE2TOut_C "fault class per DFC / Fault class for check DFC_ComMETE2TOut" VALUE 0x804D9763 Val_Wu8 30.00 DFES_OneToOne 0.00 30.00 FORMAT "%5.2" EXTENDED_LIMITS 0.00 255.0 /end CHARACTERISTIC
/begin CHARACTERISTIC DFES_Cls.DFC_ComMETFChksum_C "fault class per DFC / Fault class for check DFC_ComMETFChksum" VALUE 0x804D9764 Val_Wu8 30.00 DFES_OneToOne 0.00 30.00 FORMAT "%5.2" EXTENDED_LIMITS 0.00 255.0 /end CHARACTERISTIC
/begin CHARACTERISTIC DFES_Cls.DFC_ComMETFRingCnt_C "fault class per DFC / Fault class for check DFC_ComMETFRingCnt" VALUE 0x804D9765 Val_Wu8 30.00 DFES_OneToOne 0.00 30.00 FORMAT "%5.2" EXTENDED_LIMITS 0.00 255.0 /end CHARACTERISTIC
/begin CHARACTERISTIC DFES_Cls.DFC_ComMETFTOut_C "fault class per DFC / Fault class for check DFC_ComMETFTOut" VALUE 0x804D9766 Val_Wu8 30.00 DFES_OneToOne 0.00 30.00 FORMAT "%5.2" EXTENDED_LIMITS 0.00 255.0 /end CHARACTERISTIC
/begin CHARACTERISTIC DFES_Cls.DFC_ComMETGChksum_C "fault class per DFC / Fault class for check DFC_ComMETGChksum" VALUE 0x804D9767 Val_Wu8 30.00 DFES_OneToOne 0.00 30.00 FORMAT "%5.2" EXTENDED_LIMITS 0.00 255.0 /end CHARACTERISTIC
/begin CHARACTERISTIC DFES_Cls.DFC_ComMETGRingCnt_C "fault class per DFC / Fault class for check DFC_ComMETGRingCnt" VALUE 0x804D9768 Val_Wu8 30.00 DFES_OneToOne 0.00 30.00 FORMAT "%5.2" EXTENDED_LIMITS 0.00 255.0 /end CHARACTERISTIC
/begin CHARACTERISTIC DFES_Cls.DFC_ComMETGTOut_C "fault class per DFC / Fault class for check DFC_ComMETGTOut" VALUE 0x804D9769 Val_Wu8 30.00 DFES_OneToOne 0.00 30.00 FORMAT "%5.2" EXTENDED_LIMITS 0.00 255.0 /end CHARACTERISTIC
/begin CHARACTERISTIC DFES_Cls.DFC_ComMETH2Chksum_C "fault class per DFC / Fault class for check DFC_ComMETH2Chksum" VALUE 0x804D976A Val_Wu8 30.00 DFES_OneToOne 0.00 30.00 FORMAT "%5.2" EXTENDED_LIMITS 0.00 255.0 /end CHARACTERISTIC
/begin CHARACTERISTIC DFES_Cls.DFC_ComMETH2RingCnt_C "fault class per DFC / Fault class for check DFC_ComMETH2RingCnt" VALUE 0x804D976B Val_Wu8 30.00 DFES_OneToOne 0.00 30.00 FORMAT "%5.2" EXTENDED_LIMITS 0.00 255.0 /end CHARACTERISTIC
/begin CHARACTERISTIC DFES_Cls.DFC_ComMETH2TOut_C "fault class per DFC / Fault class for check DFC_ComMETH2TOut" VALUE 0x804D976C Val_Wu8 30.00 DFES_OneToOne 0.00 30.00 FORMAT "%5.2" EXTENDED_LIMITS 0.00 255.0 /end CHARACTERISTIC
/begin CHARACTERISTIC DFES_Cls.DFC_ComMETHChksum_C "fault class per DFC / Fault class for check DFC_ComMETHChksum" VALUE 0x804D976D Val_Wu8 30.00 DFES_OneToOne 0.00 30.00 FORMAT "%5.2" EXTENDED_LIMITS 0.00 255.0 /end CHARACTERISTIC
/begin CHARACTERISTIC DFES_Cls.DFC_ComMETHRingCnt_C "fault class per DFC / Fault class for check DFC_ComMETHRingCnt" VALUE 0x804D976E Val_Wu8 30.00 DFES_OneToOne 0.00 30.00 FORMAT "%5.2" EXTENDED_LIMITS 0.00 255.0 /end CHARACTERISTIC
/begin CHARACTERISTIC DFES_Cls.DFC_ComMETHTOut_C "fault class per DFC / Fault class for check DFC_ComMETHTOut" VALUE 0x804D976F Val_Wu8 30.00 DFES_OneToOne 0.00 30.00 FORMAT "%5.2" EXTENDED_LIMITS 0.00 255.0 /end CHARACTERISTIC
/begin CHARACTERISTIC DFES_Cls.DFC_ComMETIChksum_C "fault class per DFC / Fault class for check DFC_ComMETIChksum" VALUE 0x804D9770 Val_Wu8 30.00 DFES_OneToOne 0.00 30.00 FORMAT "%5.2" EXTENDED_LIMITS 0.00 255.0 /end CHARACTERISTIC
/begin CHARACTERISTIC DFES_Cls.DFC_ComMETIRingCnt_C "fault class per DFC / Fault class for check DFC_ComMETIRingCnt" VALUE 0x804D9771 Val_Wu8 30.00 DFES_OneToOne 0.00 30.00 FORMAT "%5.2" EXTENDED_LIMITS 0.00 255.0 /end CHARACTERISTIC
/begin CHARACTERISTIC DFES_Cls.DFC_ComMETITOut_C "fault class per DFC / Fault class for check DFC_ComMETITOut" VALUE 0x804D9772 Val_Wu8 30.00 DFES_OneToOne 0.00 30.00 FORMAT "%5.2" EXTENDED_LIMITS 0.00 255.0 /end CHARACTERISTIC
/begin CHARACTERISTIC DFES_Cls.DFC_ComMETKChksum_C "fault class per DFC / Fault class for check DFC_ComMETKChksum" VALUE 0x804D9773 Val_Wu8 30.00 DFES_OneToOne 0.00 30.00 FORMAT "%5.2" EXTENDED_LIMITS 0.00 255.0 /end CHARACTERISTIC
/begin CHARACTERISTIC DFES_Cls.DFC_ComMETKRingCnt_C "fault class per DFC / Fault class for check DFC_ComMETKRingCnt" VALUE 0x804D9774 Val_Wu8 30.00 DFES_OneToOne 0.00 30.00 FORMAT "%5.2" EXTENDED_LIMITS 0.00 255.0 /end CHARACTERISTIC
/begin CHARACTERISTIC DFES_Cls.DFC_ComMETKTOut_C "fault class per DFC / Fault class for check DFC_ComMETKTOut" VALUE 0x804D9775 Val_Wu8 30.00 DFES_OneToOne 0.00 30.00 FORMAT "%5.2" EXTENDED_LIMITS 0.00 255.0 /end CHARACTERISTIC
/begin CHARACTERISTIC DFES_Cls.DFC_ComMETLChksum_C "fault class per DFC / Fault class for check DFC_ComMETLChksum" VALUE 0x804D9776 Val_Wu8 30.00 DFES_OneToOne 0.00 30.00 FORMAT "%5.2" EXTENDED_LIMITS 0.00 255.0 /end CHARACTERISTIC
/begin CHARACTERISTIC DFES_Cls.DFC_ComMETLRingCnt_C "fault class per DFC / Fault class for check DFC_ComMETLRingCnt" VALUE 0x804D9777 Val_Wu8 30.00 DFES_OneToOne 0.00 30.00 FORMAT "%5.2" EXTENDED_LIMITS 0.00 255.0 /end CHARACTERISTIC
/begin CHARACTERISTIC DFES_Cls.DFC_ComMETLTOut_C "fault class per DFC / Fault class for check DFC_ComMETLTOut" VALUE 0x804D9778 Val_Wu8 30.00 DFES_OneToOne 0.00 30.00 FORMAT "%5.2" EXTENDED_LIMITS 0.00 255.0 /end CHARACTERISTIC
/begin CHARACTERISTIC DFES_Cls.DFC_ComMETMChksum_C "fault class per DFC / Fault class for check DFC_ComMETMChksum" VALUE 0x804D9779 Val_Wu8 30.00 DFES_OneToOne 0.00 30.00 FORMAT "%5.2" EXTENDED_LIMITS 0.00 255.0 /end CHARACTERISTIC
/begin CHARACTERISTIC DFES_Cls.DFC_ComMETMRingCnt_C "fault class per DFC / Fault class for check DFC_ComMETMRingCnt" VALUE 0x804D977A Val_Wu8 30.00 DFES_OneToOne 0.00 30.00 FORMAT "%5.2" EXTENDED_LIMITS 0.00 255.0 /end CHARACTERISTIC
/begin CHARACTERISTIC DFES_Cls.DFC_ComMETMTOut_C "fault class per DFC / Fault class for check DFC_ComMETMTOut" VALUE 0x804D977B Val_Wu8 30.00 DFES_OneToOne 0.00 30.00 FORMAT "%5.2" EXTENDED_LIMITS 0.00 255.0 /end CHARACTERISTIC
/begin CHARACTERISTIC DFES_Cls.DFC_ComMETNChksum_C "fault class per DFC / Fault class for check DFC_ComMETNChksum" VALUE 0x804D977C Val_Wu8 30.00 DFES_OneToOne 0.00 30.00 FORMAT "%5.2" EXTENDED_LIMITS 0.00 255.0 /end CHARACTERISTIC
/begin CHARACTERISTIC DFES_Cls.DFC_ComMETNRingCnt_C "fault class per DFC / Fault class for check DFC_ComMETNRingCnt" VALUE 0x804D977D Val_Wu8 30.00 DFES_OneToOne 0.00 30.00 FORMAT "%5.2" EXTENDED_LIMITS 0.00 255.0 /end CHARACTERISTIC
/begin CHARACTERISTIC DFES_Cls.DFC_ComMETNTOut_C "fault class per DFC / Fault class for check DFC_ComMETNTOut" VALUE 0x804D977E Val_Wu8 30.00 DFES_OneToOne 0.00 30.00 FORMAT "%5.2" EXTENDED_LIMITS 0.00 255.0 /end CHARACTERISTIC
/begin CHARACTERISTIC DFES_Cls.DFC_ComMtrCom_C "fault class per DFC / Fault class for check DFC_ComMtrCom" VALUE 0x804D977F Val_Wu8 30.00 DFES_OneToOne 0.00 30.00 FORMAT "%5.2" EXTENDED_LIMITS 0.00 255.0 /end CHARACTERISTIC
/begin CHARACTERISTIC DFES_Cls.DFC_ComPCUChkSum_C "fault class per DFC / Fault class for check DFC_ComPCUChkSum" VALUE 0x804D9780 Val_Wu8 30.00 DFES_OneToOne 0.00 30.00 FORMAT "%5.2" EXTENDED_LIMITS 0.00 255.0 /end CHARACTERISTIC
/begin CHARACTERISTIC DFES_Cls.DFC_ComPCURingCnt_C "fault class per DFC / Fault class for check DFC_ComPCURingCnt" VALUE 0x804D9781 Val_Wu8 30.00 DFES_OneToOne 0.00 30.00 FORMAT "%5.2" EXTENDED_LIMITS 0.00 255.0 /end CHARACTERISTIC
/begin CHARACTERISTIC DFES_Cls.DFC_ComPCUTOut_C "fault class per DFC / Fault class for check DFC_ComPCUTOut" VALUE 0x804D9782 Val_Wu8 30.00 DFES_OneToOne 0.00 30.00 FORMAT "%5.2" EXTENDED_LIMITS 0.00 255.0 /end CHARACTERISTIC
/begin CHARACTERISTIC DFES_Cls.DFC_ComSRSAChksum_C "fault class per DFC / Fault class for check DFC_ComSRSAChksum" VALUE 0x804D9783 Val_Wu8 30.00 DFES_OneToOne 0.00 30.00 FORMAT "%5.2" EXTENDED_LIMITS 0.00 255.0 /end CHARACTERISTIC
/begin CHARACTERISTIC DFES_Cls.DFC_ComSRSARingCnt_C "fault class per DFC / Fault class for check DFC_ComSRSARingCnt" VALUE 0x804D9784 Val_Wu8 30.00 DFES_OneToOne 0.00 30.00 FORMAT "%5.2" EXTENDED_LIMITS 0.00 255.0 /end CHARACTERISTIC
/begin CHARACTERISTIC DFES_Cls.DFC_ComSRSATOut_C "fault class per DFC / Fault class for check DFC_ComSRSATOut" VALUE 0x804D9785 Val_Wu8 30.00 DFES_OneToOne 0.00 30.00 FORMAT "%5.2" EXTENDED_LIMITS 0.00 255.0 /end CHARACTERISTIC
/begin CHARACTERISTIC DFES_Cls.DFC_ComSRSBChksum_C "fault class per DFC / Fault class for check DFC_ComSRSBChksum" VALUE 0x804D9786 Val_Wu8 30.00 DFES_OneToOne 0.00 30.00 FORMAT "%5.2" EXTENDED_LIMITS 0.00 255.0 /end CHARACTERISTIC
/begin CHARACTERISTIC DFES_Cls.DFC_ComSRSBRingCnt_C "fault class per DFC / Fault class for check DFC_ComSRSBRingCnt" VALUE 0x804D9787 Val_Wu8 30.00 DFES_OneToOne 0.00 30.00 FORMAT "%5.2" EXTENDED_LIMITS 0.00 255.0 /end CHARACTERISTIC
/begin CHARACTERISTIC DFES_Cls.DFC_ComSRSBTOut_C "fault class per DFC / Fault class for check DFC_ComSRSBTOut" VALUE 0x804D9788 Val_Wu8 30.00 DFES_OneToOne 0.00 30.00 FORMAT "%5.2" EXTENDED_LIMITS 0.00 255.0 /end CHARACTERISTIC
/begin CHARACTERISTIC DFES_Cls.DFC_ComSRSChksum_C "fault class per DFC / Fault class for check DFC_ComSRSChksum" VALUE 0x804D9789 Val_Wu8 30.00 DFES_OneToOne 0.00 30.00 FORMAT "%5.2" EXTENDED_LIMITS 0.00 255.0 /end CHARACTERISTIC
/begin CHARACTERISTIC DFES_Cls.DFC_ComSRSErr_C "fault class per DFC / Fault class for check DFC_ComSRSErr" VALUE 0x804D978A Val_Wu8 30.00 DFES_OneToOne 0.00 30.00 FORMAT "%5.2" EXTENDED_LIMITS 0.00 255.0 /end CHARACTERISTIC
/begin CHARACTERISTIC DFES_Cls.DFC_ComSRSRingCnt_C "fault class per DFC / Fault class for check DFC_ComSRSRingCnt" VALUE 0x804D978B Val_Wu8 30.00 DFES_OneToOne 0.00 30.00 FORMAT "%5.2" EXTENDED_LIMITS 0.00 255.0 /end CHARACTERISTIC
/begin CHARACTERISTIC DFES_Cls.DFC_ComSRSTOut_C "fault class per DFC / Fault class for check DFC_ComSRSTOut" VALUE 0x804D978C Val_Wu8 30.00 DFES_OneToOne 0.00 30.00 FORMAT "%5.2" EXTENDED_LIMITS 0.00 255.0 /end CHARACTERISTIC
/begin CHARACTERISTIC DFES_Cls.DFC_ComVehSpdPndFltTCU_C "fault class per DFC / Fault class for check DFC_ComVehSpdPndFltTCU" VALUE 0x804D978D Val_Wu8 30.00 DFES_OneToOne 0.00 30.00 FORMAT "%5.2" EXTENDED_LIMITS 0.00 255.0 /end CHARACTERISTIC
/begin CHARACTERISTIC DFES_Cls.DFC_EbsChartcCurrErr_C "fault class per DFC / Fault class for check DFC_EbsChartcCurrErr" VALUE 0x804D978E Val_Wu8 30.00 DFES_OneToOne 0.00 30.00 FORMAT "%5.2" EXTENDED_LIMITS 0.00 255.0 /end CHARACTERISTIC
/begin CHARACTERISTIC DFES_Cls.DFC_EbsSelfDiagErr_C "fault class per DFC / Fault class for check DFC_EbsSelfDiagErr" VALUE 0x804D978F Val_Wu8 30.00 DFES_OneToOne 0.00 30.00 FORMAT "%5.2" EXTENDED_LIMITS 0.00 255.0 /end CHARACTERISTIC
/begin CHARACTERISTIC DFES_Cls.DFC_GEVlvPhaCsersIntkB1_C "fault class per DFC / Fault class for check DFC_GEVlvPhaCsersIntkB1" VALUE 0x804D9790 Val_Wu8 30.00 DFES_OneToOne 0.00 30.00 FORMAT "%5.2" EXTENDED_LIMITS 0.00 255.0 /end CHARACTERISTIC
/begin CHARACTERISTIC DFES_Cls.DFC_GEVlvPhaPsOpenLoadIntkB1_C "fault class per DFC / Fault class for check DFC_GEVlvPhaPsOpenLoadIntkB1" VALUE 0x804D9791 Val_Wu8 30.00 DFES_OneToOne 0.00 30.00 FORMAT "%5.2" EXTENDED_LIMITS 0.00 255.0 /end CHARACTERISTIC
/begin CHARACTERISTIC DFES_Cls.DFC_GEVlvPhaPsShoToBattIntkB1_C "fault class per DFC / Fault class for check DFC_GEVlvPhaPsShoToBattIntkB1" VALUE 0x804D9792 Val_Wu8 30.00 DFES_OneToOne 0.00 30.00 FORMAT "%5.2" EXTENDED_LIMITS 0.00 255.0 /end CHARACTERISTIC
/begin CHARACTERISTIC DFES_Cls.DFC_GEVlvPhaPsShoToGndIntkB1_C "fault class per DFC / Fault class for check DFC_GEVlvPhaPsShoToGndIntkB1" VALUE 0x804D9793 Val_Wu8 30.00 DFES_OneToOne 0.00 30.00 FORMAT "%5.2" EXTENDED_LIMITS 0.00 255.0 /end CHARACTERISTIC
/begin CHARACTERISTIC DFES_Cls.DFC_GbxCANDigPlausErr_C "fault class per DFC / Fault class for check DFC_GbxCANDigPlausErr" VALUE 0x804D9794 Val_Wu8 30.00 DFES_OneToOne 0.00 30.00 FORMAT "%5.2" EXTENDED_LIMITS 0.00 255.0 /end CHARACTERISTIC
/begin CHARACTERISTIC DFES_Cls.DFC_GbxNPos1SRCMax_C "fault class per DFC / Fault class for check DFC_GbxNPos1SRCMax" VALUE 0x804D9795 Val_Wu8 30.00 DFES_OneToOne 0.00 30.00 FORMAT "%5.2" EXTENDED_LIMITS 0.00 255.0 /end CHARACTERISTIC
/begin CHARACTERISTIC DFES_Cls.DFC_GbxNPos1SRCMin_C "fault class per DFC / Fault class for check DFC_GbxNPos1SRCMin" VALUE 0x804D9796 Val_Wu8 30.00 DFES_OneToOne 0.00 30.00 FORMAT "%5.2" EXTENDED_LIMITS 0.00 255.0 /end CHARACTERISTIC
/begin CHARACTERISTIC DFES_Cls.DFC_GbxNPos2SRCMax_C "fault class per DFC / Fault class for check DFC_GbxNPos2SRCMax" VALUE 0x804D9797 Val_Wu8 30.00 DFES_OneToOne 0.00 30.00 FORMAT "%5.2" EXTENDED_LIMITS 0.00 255.0 /end CHARACTERISTIC
/begin CHARACTERISTIC DFES_Cls.DFC_GbxNPos2SRCMin_C "fault class per DFC / Fault class for check DFC_GbxNPos2SRCMin" VALUE 0x804D9798 Val_Wu8 30.00 DFES_OneToOne 0.00 30.00 FORMAT "%5.2" EXTENDED_LIMITS 0.00 255.0 /end CHARACTERISTIC
/begin CHARACTERISTIC DFES_Cls.DFC_GbxNPosAlvChk_C "fault class per DFC / Fault class for check DFC_GbxNPosAlvChk" VALUE 0x804D9799 Val_Wu8 30.00 DFES_OneToOne 0.00 30.00 FORMAT "%5.2" EXTENDED_LIMITS 0.00 255.0 /end CHARACTERISTIC
/begin CHARACTERISTIC DFES_Cls.DFC_GbxNPosSyncErr_C "fault class per DFC / Fault class for check DFC_GbxNPosSyncErr" VALUE 0x804D979A Val_Wu8 30.00 DFES_OneToOne 0.00 30.00 FORMAT "%5.2" EXTENDED_LIMITS 0.00 255.0 /end CHARACTERISTIC
/begin CHARACTERISTIC DFES_Cls.DFC_HEGOS2B1HtrPsMax_C "fault class per DFC / Fault class for check DFC_HEGOS2B1HtrPsMax" VALUE 0x804D979B Val_Wu8 30.00 DFES_OneToOne 0.00 30.00 FORMAT "%5.2" EXTENDED_LIMITS 0.00 255.0 /end CHARACTERISTIC
/begin CHARACTERISTIC DFES_Cls.DFC_HEGOS2B1HtrPsMin_C "fault class per DFC / Fault class for check DFC_HEGOS2B1HtrPsMin" VALUE 0x804D979C Val_Wu8 30.00 DFES_OneToOne 0.00 30.00 FORMAT "%5.2" EXTENDED_LIMITS 0.00 255.0 /end CHARACTERISTIC
/begin CHARACTERISTIC DFES_Cls.DFC_HEGOS2B1HtrPsSig_C "fault class per DFC / Fault class for check DFC_HEGOS2B1HtrPsSig" VALUE 0x804D979D Val_Wu8 30.00 DFES_OneToOne 0.00 30.00 FORMAT "%5.2" EXTENDED_LIMITS 0.00 255.0 /end CHARACTERISTIC
/begin CHARACTERISTIC DFES_Cls.DFC_LinCSErrACG_C "fault class per DFC / Fault class for check DFC_LinCSErrACG" VALUE 0x804D979E Val_Wu8 30.00 DFES_OneToOne 0.00 30.00 FORMAT "%5.2" EXTENDED_LIMITS 0.00 255.0 /end CHARACTERISTIC
/begin CHARACTERISTIC DFES_Cls.DFC_LinCSErrAEV_C "fault class per DFC / Fault class for check DFC_LinCSErrAEV" VALUE 0x804D979F Val_Wu8 30.00 DFES_OneToOne 0.00 30.00 FORMAT "%5.2" EXTENDED_LIMITS 0.00 255.0 /end CHARACTERISTIC
/begin CHARACTERISTIC DFES_Cls.DFC_LinCSErrDCDC_C "fault class per DFC / Fault class for check DFC_LinCSErrDCDC" VALUE 0x804D97A0 Val_Wu8 30.00 DFES_OneToOne 0.00 30.00 FORMAT "%5.2" EXTENDED_LIMITS 0.00 255.0 /end CHARACTERISTIC
/begin CHARACTERISTIC DFES_Cls.DFC_LinCSErrEBS_C "fault class per DFC / Fault class for check DFC_LinCSErrEBS" VALUE 0x804D97A1 Val_Wu8 30.00 DFES_OneToOne 0.00 30.00 FORMAT "%5.2" EXTENDED_LIMITS 0.00 255.0 /end CHARACTERISTIC
/begin CHARACTERISTIC DFES_Cls.DFC_LinHdrTimeoutErrACG_C "fault class per DFC / Fault class for check DFC_LinHdrTimeoutErrACG" VALUE 0x804D97A2 Val_Wu8 30.00 DFES_OneToOne 0.00 30.00 FORMAT "%5.2" EXTENDED_LIMITS 0.00 255.0 /end CHARACTERISTIC
/begin CHARACTERISTIC DFES_Cls.DFC_LinHdrTimeoutErrAEV_C "fault class per DFC / Fault class for check DFC_LinHdrTimeoutErrAEV" VALUE 0x804D97A3 Val_Wu8 30.00 DFES_OneToOne 0.00 30.00 FORMAT "%5.2" EXTENDED_LIMITS 0.00 255.0 /end CHARACTERISTIC
/begin CHARACTERISTIC DFES_Cls.DFC_LinHdrTimeoutErrDCDC_C "fault class per DFC / Fault class for check DFC_LinHdrTimeoutErrDCDC" VALUE 0x804D97A4 Val_Wu8 30.00 DFES_OneToOne 0.00 30.00 FORMAT "%5.2" EXTENDED_LIMITS 0.00 255.0 /end CHARACTERISTIC
/begin CHARACTERISTIC DFES_Cls.DFC_LinHdrTimeoutErrEBS_C "fault class per DFC / Fault class for check DFC_LinHdrTimeoutErrEBS" VALUE 0x804D97A5 Val_Wu8 30.00 DFES_OneToOne 0.00 30.00 FORMAT "%5.2" EXTENDED_LIMITS 0.00 255.0 /end CHARACTERISTIC
/begin CHARACTERISTIC DFES_Cls.DFC_LinMsgTimeoutErrACG_C "fault class per DFC / Fault class for check DFC_LinMsgTimeoutErrACG" VALUE 0x804D97A6 Val_Wu8 30.00 DFES_OneToOne 0.00 30.00 FORMAT "%5.2" EXTENDED_LIMITS 0.00 255.0 /end CHARACTERISTIC
/begin CHARACTERISTIC DFES_Cls.DFC_LinMsgTimeoutErrAEV_C "fault class per DFC / Fault class for check DFC_LinMsgTimeoutErrAEV" VALUE 0x804D97A7 Val_Wu8 30.00 DFES_OneToOne 0.00 30.00 FORMAT "%5.2" EXTENDED_LIMITS 0.00 255.0 /end CHARACTERISTIC
/begin CHARACTERISTIC DFES_Cls.DFC_LinMsgTimeoutErrDCDC_C "fault class per DFC / Fault class for check DFC_LinMsgTimeoutErrDCDC" VALUE 0x804D97A8 Val_Wu8 30.00 DFES_OneToOne 0.00 30.00 FORMAT "%5.2" EXTENDED_LIMITS 0.00 255.0 /end CHARACTERISTIC
/begin CHARACTERISTIC DFES_Cls.DFC_LinMsgTimeoutErrEBS_C "fault class per DFC / Fault class for check DFC_LinMsgTimeoutErrEBS" VALUE 0x804D97A9 Val_Wu8 30.00 DFES_OneToOne 0.00 30.00 FORMAT "%5.2" EXTENDED_LIMITS 0.00 255.0 /end CHARACTERISTIC
/begin CHARACTERISTIC DFES_Cls.DFC_LinNoStrtComErr_C "fault class per DFC / Fault class for check DFC_LinNoStrtComErr" VALUE 0x804D97AA Val_Wu8 30.00 DFES_OneToOne 0.00 30.00 FORMAT "%5.2" EXTENDED_LIMITS 0.00 255.0 /end CHARACTERISTIC
/begin CHARACTERISTIC DFES_Cls.DFC_LowPresOilP_C "fault class per DFC / Fault class for check DFC_LowPresOilP" VALUE 0x804D97AB Val_Wu8 30.00 DFES_OneToOne 0.00 30.00 FORMAT "%5.2" EXTENDED_LIMITS 0.00 255.0 /end CHARACTERISTIC
/begin CHARACTERISTIC DFES_Cls.DFC_MisfDetVWhlFrntLeOORHi_C "fault class per DFC / Fault class for check DFC_MisfDetVWhlFrntLeOORHi" VALUE 0x804D97AC Val_Wu8 30.00 DFES_OneToOne 0.00 30.00 FORMAT "%5.2" EXTENDED_LIMITS 0.00 255.0 /end CHARACTERISTIC
/begin CHARACTERISTIC DFES_Cls.DFC_MisfDetVWhlFrntLeRatyHi_C "fault class per DFC / Fault class for check DFC_MisfDetVWhlFrntLeRatyHi" VALUE 0x804D97AD Val_Wu8 30.00 DFES_OneToOne 0.00 30.00 FORMAT "%5.2" EXTENDED_LIMITS 0.00 255.0 /end CHARACTERISTIC
/begin CHARACTERISTIC DFES_Cls.DFC_MisfDetVWhlFrntLeRatyLo_C "fault class per DFC / Fault class for check DFC_MisfDetVWhlFrntLeRatyLo" VALUE 0x804D97AE Val_Wu8 30.00 DFES_OneToOne 0.00 30.00 FORMAT "%5.2" EXTENDED_LIMITS 0.00 255.0 /end CHARACTERISTIC
/begin CHARACTERISTIC DFES_Cls.DFC_MisfDetVWhlFrntLeStuck_C "fault class per DFC / Fault class for check DFC_MisfDetVWhlFrntLeStuck" VALUE 0x804D97AF Val_Wu8 30.00 DFES_OneToOne 0.00 30.00 FORMAT "%5.2" EXTENDED_LIMITS 0.00 255.0 /end CHARACTERISTIC
/begin CHARACTERISTIC DFES_Cls.DFC_MisfDetVWhlFrntRiOORHi_C "fault class per DFC / Fault class for check DFC_MisfDetVWhlFrntRiOORHi" VALUE 0x804D97B0 Val_Wu8 30.00 DFES_OneToOne 0.00 30.00 FORMAT "%5.2" EXTENDED_LIMITS 0.00 255.0 /end CHARACTERISTIC
/begin CHARACTERISTIC DFES_Cls.DFC_MisfDetVWhlFrntRiRatyHi_C "fault class per DFC / Fault class for check DFC_MisfDetVWhlFrntRiRatyHi" VALUE 0x804D97B1 Val_Wu8 30.00 DFES_OneToOne 0.00 30.00 FORMAT "%5.2" EXTENDED_LIMITS 0.00 255.0 /end CHARACTERISTIC
/begin CHARACTERISTIC DFES_Cls.DFC_MisfDetVWhlFrntRiRatyLo_C "fault class per DFC / Fault class for check DFC_MisfDetVWhlFrntRiRatyLo" VALUE 0x804D97B2 Val_Wu8 30.00 DFES_OneToOne 0.00 30.00 FORMAT "%5.2" EXTENDED_LIMITS 0.00 255.0 /end CHARACTERISTIC
/begin CHARACTERISTIC DFES_Cls.DFC_MisfDetVWhlFrntRiStuck_C "fault class per DFC / Fault class for check DFC_MisfDetVWhlFrntRiStuck" VALUE 0x804D97B3 Val_Wu8 30.00 DFES_OneToOne 0.00 30.00 FORMAT "%5.2" EXTENDED_LIMITS 0.00 255.0 /end CHARACTERISTIC
/begin CHARACTERISTIC DFES_Cls.DFC_MisfDetVWhlReLeOORHi_C "fault class per DFC / Fault class for check DFC_MisfDetVWhlReLeOORHi" VALUE 0x804D97B4 Val_Wu8 30.00 DFES_OneToOne 0.00 30.00 FORMAT "%5.2" EXTENDED_LIMITS 0.00 255.0 /end CHARACTERISTIC
/begin CHARACTERISTIC DFES_Cls.DFC_MisfDetVWhlReLeRatyHi_C "fault class per DFC / Fault class for check DFC_MisfDetVWhlReLeRatyHi" VALUE 0x804D97B5 Val_Wu8 30.00 DFES_OneToOne 0.00 30.00 FORMAT "%5.2" EXTENDED_LIMITS 0.00 255.0 /end CHARACTERISTIC
/begin CHARACTERISTIC DFES_Cls.DFC_MisfDetVWhlReLeRatyLo_C "fault class per DFC / Fault class for check DFC_MisfDetVWhlReLeRatyLo" VALUE 0x804D97B6 Val_Wu8 30.00 DFES_OneToOne 0.00 30.00 FORMAT "%5.2" EXTENDED_LIMITS 0.00 255.0 /end CHARACTERISTIC
/begin CHARACTERISTIC DFES_Cls.DFC_MisfDetVWhlReLeStuck_C "fault class per DFC / Fault class for check DFC_MisfDetVWhlReLeStuck" VALUE 0x804D97B7 Val_Wu8 30.00 DFES_OneToOne 0.00 30.00 FORMAT "%5.2" EXTENDED_LIMITS 0.00 255.0 /end CHARACTERISTIC
/begin CHARACTERISTIC DFES_Cls.DFC_MisfDetVWhlReRiOORHi_C "fault class per DFC / Fault class for check DFC_MisfDetVWhlReRiOORHi" VALUE 0x804D97B8 Val_Wu8 30.00 DFES_OneToOne 0.00 30.00 FORMAT "%5.2" EXTENDED_LIMITS 0.00 255.0 /end CHARACTERISTIC
/begin CHARACTERISTIC DFES_Cls.DFC_MisfDetVWhlReRiRatyHi_C "fault class per DFC / Fault class for check DFC_MisfDetVWhlReRiRatyHi" VALUE 0x804D97B9 Val_Wu8 30.00 DFES_OneToOne 0.00 30.00 FORMAT "%5.2" EXTENDED_LIMITS 0.00 255.0 /end CHARACTERISTIC
/begin CHARACTERISTIC DFES_Cls.DFC_MisfDetVWhlReRiRatyLo_C "fault class per DFC / Fault class for check DFC_MisfDetVWhlReRiRatyLo" VALUE 0x804D97BA Val_Wu8 30.00 DFES_OneToOne 0.00 30.00 FORMAT "%5.2" EXTENDED_LIMITS 0.00 255.0 /end CHARACTERISTIC
/begin CHARACTERISTIC DFES_Cls.DFC_MisfDetVWhlReRiStuck_C "fault class per DFC / Fault class for check DFC_MisfDetVWhlReRiStuck" VALUE 0x804D97BB Val_Wu8 30.00 DFES_OneToOne 0.00 30.00 FORMAT "%5.2" EXTENDED_LIMITS 0.00 255.0 /end CHARACTERISTIC
/begin CHARACTERISTIC DFES_Cls.DFC_MisfDetdVWhlFrntLePlaus_C "fault class per DFC / Fault class for check DFC_MisfDetdVWhlFrntLePlaus" VALUE 0x804D97BC Val_Wu8 30.00 DFES_OneToOne 0.00 30.00 FORMAT "%5.2" EXTENDED_LIMITS 0.00 255.0 /end CHARACTERISTIC
/begin CHARACTERISTIC DFES_Cls.DFC_MisfDetdVWhlFrntRiPlaus_C "fault class per DFC / Fault class for check DFC_MisfDetdVWhlFrntRiPlaus" VALUE 0x804D97BD Val_Wu8 30.00 DFES_OneToOne 0.00 30.00 FORMAT "%5.2" EXTENDED_LIMITS 0.00 255.0 /end CHARACTERISTIC
/begin CHARACTERISTIC DFES_Cls.DFC_MisfDetdVWhlReLePlaus_C "fault class per DFC / Fault class for check DFC_MisfDetdVWhlReLePlaus" VALUE 0x804D97BE Val_Wu8 30.00 DFES_OneToOne 0.00 30.00 FORMAT "%5.2" EXTENDED_LIMITS 0.00 255.0 /end CHARACTERISTIC
/begin CHARACTERISTIC DFES_Cls.DFC_MisfDetdVWhlReRiPlaus_C "fault class per DFC / Fault class for check DFC_MisfDetdVWhlReRiPlaus" VALUE 0x804D97BF Val_Wu8 30.00 DFES_OneToOne 0.00 30.00 FORMAT "%5.2" EXTENDED_LIMITS 0.00 255.0 /end CHARACTERISTIC
/begin CHARACTERISTIC DFES_Cls.DFC_PEnvSigRngMax_C "fault class per DFC / Fault class for check DFC_PEnvSigRngMax" VALUE 0x804D97C0 Val_Wu8 30.00 DFES_OneToOne 0.00 30.00 FORMAT "%5.2" EXTENDED_LIMITS 0.00 255.0 /end CHARACTERISTIC
/begin CHARACTERISTIC DFES_Cls.DFC_PEnvSigRngMin_C "fault class per DFC / Fault class for check DFC_PEnvSigRngMin" VALUE 0x804D97C1 Val_Wu8 30.00 DFES_OneToOne 0.00 30.00 FORMAT "%5.2" EXTENDED_LIMITS 0.00 255.0 /end CHARACTERISTIC
/begin CHARACTERISTIC DFES_Cls.DFC_StmFault_C "fault class per DFC / Fault class for check DFC_StmFault" VALUE 0x804D97C2 Val_Wu8 30.00 DFES_OneToOne 0.00 30.00 FORMAT "%5.2" EXTENDED_LIMITS 0.00 255.0 /end CHARACTERISTIC
/begin CHARACTERISTIC DFES_Cls.DFC_StrtCtOffPth_C "fault class per DFC / Fault class for check DFC_StrtCtOffPth" VALUE 0x804D97C3 Val_Wu8 30.00 DFES_OneToOne 0.00 30.00 FORMAT "%5.2" EXTENDED_LIMITS 0.00 255.0 /end CHARACTERISTIC
/begin CHARACTERISTIC DFES_Cls.DFC_StrtCtlErr_C "fault class per DFC / Fault class for check DFC_StrtCtlErr" VALUE 0x804D97C4 Val_Wu8 30.00 DFES_OneToOne 0.00 30.00 FORMAT "%5.2" EXTENDED_LIMITS 0.00 255.0 /end CHARACTERISTIC
/begin CHARACTERISTIC DFES_Cls.DFC_StrtFault_C "fault class per DFC / Fault class for check DFC_StrtFault" VALUE 0x804D97C5 Val_Wu8 30.00 DFES_OneToOne 0.00 30.00 FORMAT "%5.2" EXTENDED_LIMITS 0.00 255.0 /end CHARACTERISTIC
/begin CHARACTERISTIC DFES_Cls.DFC_StrtLckJudg1_C "fault class per DFC / Fault class for check DFC_StrtLckJudg1" VALUE 0x804D97C6 Val_Wu8 30.00 DFES_OneToOne 0.00 30.00 FORMAT "%5.2" EXTENDED_LIMITS 0.00 255.0 /end CHARACTERISTIC
/begin CHARACTERISTIC DFES_Cls.DFC_StrtLckJudg2_C "fault class per DFC / Fault class for check DFC_StrtLckJudg2" VALUE 0x804D97C7 Val_Wu8 30.00 DFES_OneToOne 0.00 30.00 FORMAT "%5.2" EXTENDED_LIMITS 0.00 255.0 /end CHARACTERISTIC
/begin CHARACTERISTIC DFES_Cls.DFC_StrtOL_C "fault class per DFC / Fault class for check DFC_StrtOL" VALUE 0x804D97C8 Val_Wu8 30.00 DFES_OneToOne 0.00 30.00 FORMAT "%5.2" EXTENDED_LIMITS 0.00 255.0 /end CHARACTERISTIC
/begin CHARACTERISTIC DFES_Cls.DFC_StrtOL2_C "fault class per DFC / Fault class for check DFC_StrtOL2" VALUE 0x804D97C9 Val_Wu8 30.00 DFES_OneToOne 0.00 30.00 FORMAT "%5.2" EXTENDED_LIMITS 0.00 255.0 /end CHARACTERISTIC
/begin CHARACTERISTIC DFES_Cls.DFC_StrtSCB_C "fault class per DFC / Fault class for check DFC_StrtSCB" VALUE 0x804D97CA Val_Wu8 30.00 DFES_OneToOne 0.00 30.00 FORMAT "%5.2" EXTENDED_LIMITS 0.00 255.0 /end CHARACTERISTIC
/begin CHARACTERISTIC DFES_Cls.DFC_StrtSCB2_C "fault class per DFC / Fault class for check DFC_StrtSCB2" VALUE 0x804D97CB Val_Wu8 30.00 DFES_OneToOne 0.00 30.00 FORMAT "%5.2" EXTENDED_LIMITS 0.00 255.0 /end CHARACTERISTIC
/begin CHARACTERISTIC DFES_Cls.DFC_StrtSCG_C "fault class per DFC / Fault class for check DFC_StrtSCG" VALUE 0x804D97CC Val_Wu8 30.00 DFES_OneToOne 0.00 30.00 FORMAT "%5.2" EXTENDED_LIMITS 0.00 255.0 /end CHARACTERISTIC
/begin CHARACTERISTIC DFES_Cls.DFC_StrtSCG2_C "fault class per DFC / Fault class for check DFC_StrtSCG2" VALUE 0x804D97CD Val_Wu8 30.00 DFES_OneToOne 0.00 30.00 FORMAT "%5.2" EXTENDED_LIMITS 0.00 255.0 /end CHARACTERISTIC
/begin CHARACTERISTIC DFES_Cls.DFC_StrtStkRly1_C "fault class per DFC / Fault class for check DFC_StrtStkRly1" VALUE 0x804D97CE Val_Wu8 30.00 DFES_OneToOne 0.00 30.00 FORMAT "%5.2" EXTENDED_LIMITS 0.00 255.0 /end CHARACTERISTIC
/begin CHARACTERISTIC DFES_Cls.DFC_StrtStkRly2_C "fault class per DFC / Fault class for check DFC_StrtStkRly2" VALUE 0x804D97CF Val_Wu8 30.00 DFES_OneToOne 0.00 30.00 FORMAT "%5.2" EXTENDED_LIMITS 0.00 255.0 /end CHARACTERISTIC
/begin CHARACTERISTIC DFES_Cls.DFC_TEVEmax_C "fault class per DFC / Fault class for check DFC_TEVEmax" VALUE 0x804D97D0 Val_Wu8 30.00 DFES_OneToOne 0.00 30.00 FORMAT "%5.2" EXTENDED_LIMITS 0.00 255.0 /end CHARACTERISTIC
/begin CHARACTERISTIC DFES_Cls.DFC_TEVEmin_C "fault class per DFC / Fault class for check DFC_TEVEmin" VALUE 0x804D97D1 Val_Wu8 30.00 DFES_OneToOne 0.00 30.00 FORMAT "%5.2" EXTENDED_LIMITS 0.00 255.0 /end CHARACTERISTIC
/begin CHARACTERISTIC DFES_Cls.DFC_TEVEsig_C "fault class per DFC / Fault class for check DFC_TEVEsig" VALUE 0x804D97D2 Val_Wu8 30.00 DFES_OneToOne 0.00 30.00 FORMAT "%5.2" EXTENDED_LIMITS 0.00 255.0 /end CHARACTERISTIC
/begin CHARACTERISTIC DFES_Cls.DFC_UegoHeatrPrfmncLoS1B1_C "fault class per DFC / Fault class for check DFC_UegoHeatrPrfmncLoS1B1" VALUE 0x804D97D3 Val_Wu8 30.00 DFES_OneToOne 0.00 30.00 FORMAT "%5.2" EXTENDED_LIMITS 0.00 255.0 /end CHARACTERISTIC
/begin CHARACTERISTIC DFES_Cls.DFC_VehVAllPlaus_C "fault class per DFC / Fault class for check DFC_VehVAllPlaus" VALUE 0x804D97D4 Val_Wu8 30.00 DFES_OneToOne 0.00 30.00 FORMAT "%5.2" EXTENDED_LIMITS 0.00 255.0 /end CHARACTERISTIC
/begin CHARACTERISTIC DFES_Cls.DFC_VehVNCSnsrElecFailr_C "fault class per DFC / Fault class for check DFC_VehVNCSnsrElecFailr" VALUE 0x804D97D5 Val_Wu8 30.00 DFES_OneToOne 0.00 30.00 FORMAT "%5.2" EXTENDED_LIMITS 0.00 255.0 /end CHARACTERISTIC
/begin CHARACTERISTIC DFES_Cls.DFC_VehVPlausCan_C "fault class per DFC / Fault class for check DFC_VehVPlausCan" VALUE 0x804D97D6 Val_Wu8 30.00 DFES_OneToOne 0.00 30.00 FORMAT "%5.2" EXTENDED_LIMITS 0.00 255.0 /end CHARACTERISTIC
/begin CHARACTERISTIC DFES_Cls.DFC_VehVPlausFco_C "fault class per DFC / Fault class for check DFC_VehVPlausFco" VALUE 0x804D97D7 Val_Wu8 30.00 DFES_OneToOne 0.00 30.00 FORMAT "%5.2" EXTENDED_LIMITS 0.00 255.0 /end CHARACTERISTIC
/begin CHARACTERISTIC DFES_Cls.DFC_VehVPlausPwr_C "fault class per DFC / Fault class for check DFC_VehVPlausPwr" VALUE 0x804D97D8 Val_Wu8 30.00 DFES_OneToOne 0.00 30.00 FORMAT "%5.2" EXTENDED_LIMITS 0.00 255.0 /end CHARACTERISTIC
/begin CHARACTERISTIC DFES_Cls.DFC_VehVPlausV2N_C "fault class per DFC / Fault class for check DFC_VehVPlausV2N" VALUE 0x804D97D9 Val_Wu8 30.00 DFES_OneToOne 0.00 30.00 FORMAT "%5.2" EXTENDED_LIMITS 0.00 255.0 /end CHARACTERISTIC
/begin CHARACTERISTIC DFES_Cls.DFC_VehVSpdSnsrAElecFailr_C "fault class per DFC / Fault class for check DFC_VehVSpdSnsrAElecFailr" VALUE 0x804D97DA Val_Wu8 30.00 DFES_OneToOne 0.00 30.00 FORMAT "%5.2" EXTENDED_LIMITS 0.00 255.0 /end CHARACTERISTIC
/begin CHARACTERISTIC DFES_Cls.DFC_VehVSpdSnsrBElecFailr_C "fault class per DFC / Fault class for check DFC_VehVSpdSnsrBElecFailr" VALUE 0x804D97DB Val_Wu8 30.00 DFES_OneToOne 0.00 30.00 FORMAT "%5.2" EXTENDED_LIMITS 0.00 255.0 /end CHARACTERISTIC
/begin CHARACTERISTIC DFES_Cls.DFC_ClthMax_C "fault class per DFC / Fault class for check DFC_ClthMax" VALUE 0x804D97DC Val_Wu8 30.00 DFES_OneToOne 0.00 30.00 FORMAT "%5.2" EXTENDED_LIMITS 0.00 255.0 /end CHARACTERISTIC
/begin CHARACTERISTIC DFES_Cls.DFC_IgnClPs_DevComErr_C "fault class per DFC / Fault class for check DFC_IgnClPs_DevComErr" VALUE 0x804D97DD Val_Wu8 30.00 DFES_OneToOne 0.00 30.00 FORMAT "%5.2" EXTENDED_LIMITS 0.00 255.0 /end CHARACTERISTIC
/begin CHARACTERISTIC DFES_Cls.DFC_IgnClPs_LineOl_0_C "fault class per DFC / Fault class for check DFC_IgnClPs_LineOl_0" VALUE 0x804D97DE Val_Wu8 30.00 DFES_OneToOne 0.00 30.00 FORMAT "%5.2" EXTENDED_LIMITS 0.00 255.0 /end CHARACTERISTIC
/begin CHARACTERISTIC DFES_Cls.DFC_IgnClPs_LineOl_1_C "fault class per DFC / Fault class for check DFC_IgnClPs_LineOl_1" VALUE 0x804D97DF Val_Wu8 30.00 DFES_OneToOne 0.00 30.00 FORMAT "%5.2" EXTENDED_LIMITS 0.00 255.0 /end CHARACTERISTIC
/begin CHARACTERISTIC DFES_Cls.DFC_IgnClPs_LineOl_2_C "fault class per DFC / Fault class for check DFC_IgnClPs_LineOl_2" VALUE 0x804D97E0 Val_Wu8 30.00 DFES_OneToOne 0.00 30.00 FORMAT "%5.2" EXTENDED_LIMITS 0.00 255.0 /end CHARACTERISTIC
/begin CHARACTERISTIC DFES_Cls.DFC_IgnClPs_LineOl_3_C "fault class per DFC / Fault class for check DFC_IgnClPs_LineOl_3" VALUE 0x804D97E1 Val_Wu8 30.00 DFES_OneToOne 0.00 30.00 FORMAT "%5.2" EXTENDED_LIMITS 0.00 255.0 /end CHARACTERISTIC
/begin CHARACTERISTIC DFES_Cls.DFC_IgnClPs_LineScb_0_C "fault class per DFC / Fault class for check DFC_IgnClPs_LineScb_0" VALUE 0x804D97E2 Val_Wu8 30.00 DFES_OneToOne 0.00 30.00 FORMAT "%5.2" EXTENDED_LIMITS 0.00 255.0 /end CHARACTERISTIC
/begin CHARACTERISTIC DFES_Cls.DFC_IgnClPs_LineScb_1_C "fault class per DFC / Fault class for check DFC_IgnClPs_LineScb_1" VALUE 0x804D97E3 Val_Wu8 30.00 DFES_OneToOne 0.00 30.00 FORMAT "%5.2" EXTENDED_LIMITS 0.00 255.0 /end CHARACTERISTIC
/begin CHARACTERISTIC DFES_Cls.DFC_IgnClPs_LineScb_2_C "fault class per DFC / Fault class for check DFC_IgnClPs_LineScb_2" VALUE 0x804D97E4 Val_Wu8 30.00 DFES_OneToOne 0.00 30.00 FORMAT "%5.2" EXTENDED_LIMITS 0.00 255.0 /end CHARACTERISTIC
/begin CHARACTERISTIC DFES_Cls.DFC_IgnClPs_LineScb_3_C "fault class per DFC / Fault class for check DFC_IgnClPs_LineScb_3" VALUE 0x804D97E5 Val_Wu8 30.00 DFES_OneToOne 0.00 30.00 FORMAT "%5.2" EXTENDED_LIMITS 0.00 255.0 /end CHARACTERISTIC
/begin CHARACTERISTIC DFES_Cls.DFC_IgnClPs_LineScg_0_C "fault class per DFC / Fault class for check DFC_IgnClPs_LineScg_0" VALUE 0x804D97E6 Val_Wu8 30.00 DFES_OneToOne 0.00 30.00 FORMAT "%5.2" EXTENDED_LIMITS 0.00 255.0 /end CHARACTERISTIC
/begin CHARACTERISTIC DFES_Cls.DFC_IgnClPs_LineScg_1_C "fault class per DFC / Fault class for check DFC_IgnClPs_LineScg_1" VALUE 0x804D97E7 Val_Wu8 30.00 DFES_OneToOne 0.00 30.00 FORMAT "%5.2" EXTENDED_LIMITS 0.00 255.0 /end CHARACTERISTIC
/begin CHARACTERISTIC DFES_Cls.DFC_IgnClPs_LineScg_2_C "fault class per DFC / Fault class for check DFC_IgnClPs_LineScg_2" VALUE 0x804D97E8 Val_Wu8 30.00 DFES_OneToOne 0.00 30.00 FORMAT "%5.2" EXTENDED_LIMITS 0.00 255.0 /end CHARACTERISTIC
/begin CHARACTERISTIC DFES_Cls.DFC_IgnClPs_LineScg_3_C "fault class per DFC / Fault class for check DFC_IgnClPs_LineScg_3" VALUE 0x804D97E9 Val_Wu8 30.00 DFES_OneToOne 0.00 30.00 FORMAT "%5.2" EXTENDED_LIMITS 0.00 255.0 /end CHARACTERISTIC
/begin CHARACTERISTIC DFES_Cls.DFC_KRVEKOEVAB_C "fault class per DFC / Fault class for check DFC_KRVEKOEVAB" VALUE 0x804D97EA Val_Wu8 30.00 DFES_OneToOne 0.00 30.00 FORMAT "%5.2" EXTENDED_LIMITS 0.00 255.0 /end CHARACTERISTIC
/begin CHARACTERISTIC DFES_Cls.DFC_KRVEKOEVAB0_C "fault class per DFC / Fault class for check DFC_KRVEKOEVAB0" VALUE 0x804D97EB Val_Wu8 30.00 DFES_OneToOne 0.00 30.00 FORMAT "%5.2" EXTENDED_LIMITS 0.00 255.0 /end CHARACTERISTIC
/begin CHARACTERISTIC DFES_Cls.DFC_KRVEKOEVAB1_C "fault class per DFC / Fault class for check DFC_KRVEKOEVAB1" VALUE 0x804D97EC Val_Wu8 30.00 DFES_OneToOne 0.00 30.00 FORMAT "%5.2" EXTENDED_LIMITS 0.00 255.0 /end CHARACTERISTIC
/begin CHARACTERISTIC DFES_Cls.DFC_KRVEKOEVAB2_C "fault class per DFC / Fault class for check DFC_KRVEKOEVAB2" VALUE 0x804D97ED Val_Wu8 30.00 DFES_OneToOne 0.00 30.00 FORMAT "%5.2" EXTENDED_LIMITS 0.00 255.0 /end CHARACTERISTIC
/begin CHARACTERISTIC DFES_Cls.DFC_KRVEKOEVAB3_C "fault class per DFC / Fault class for check DFC_KRVEKOEVAB3" VALUE 0x804D97EE Val_Wu8 30.00 DFES_OneToOne 0.00 30.00 FORMAT "%5.2" EXTENDED_LIMITS 0.00 255.0 /end CHARACTERISTIC
/begin CHARACTERISTIC DFES_Cls.DFC_UegoSigEcuAsicS1B1_C "fault class per DFC / Fault class for check DFC_UegoSigEcuAsicS1B1" VALUE 0x804D97EF Val_Wu8 30.00 DFES_OneToOne 0.00 30.00 FORMAT "%5.2" EXTENDED_LIMITS 0.00 255.0 /end CHARACTERISTIC
/begin CHARACTERISTIC DFES_Cls.DFC_UegoSigEcuComS1B1_C "fault class per DFC / Fault class for check DFC_UegoSigEcuComS1B1" VALUE 0x804D97F0 Val_Wu8 30.00 DFES_OneToOne 0.00 30.00 FORMAT "%5.2" EXTENDED_LIMITS 0.00 255.0 /end CHARACTERISTIC
/begin CHARACTERISTIC DFES_Cls.DFC_UegoSigSnsrS1B1_C "fault class per DFC / Fault class for check DFC_UegoSigSnsrS1B1" VALUE 0x804D97F1 Val_Wu8 30.00 DFES_OneToOne 0.00 30.00 FORMAT "%5.2" EXTENDED_LIMITS 0.00 255.0 /end CHARACTERISTIC
/begin CHARACTERISTIC DFES_Cls.DFC_UegoSigWireOlApesS1B1_C "fault class per DFC / Fault class for check DFC_UegoSigWireOlApesS1B1" VALUE 0x804D97F2 Val_Wu8 30.00 DFES_OneToOne 0.00 30.00 FORMAT "%5.2" EXTENDED_LIMITS 0.00 255.0 /end CHARACTERISTIC
/begin CHARACTERISTIC DFES_Cls.DFC_UegoSigWireOlIpeS1B1_C "fault class per DFC / Fault class for check DFC_UegoSigWireOlIpeS1B1" VALUE 0x804D97F3 Val_Wu8 30.00 DFES_OneToOne 0.00 30.00 FORMAT "%5.2" EXTENDED_LIMITS 0.00 255.0 /end CHARACTERISTIC
/begin CHARACTERISTIC DFES_Cls.DFC_UegoSigWireOlReS1B1_C "fault class per DFC / Fault class for check DFC_UegoSigWireOlReS1B1" VALUE 0x804D97F4 Val_Wu8 30.00 DFES_OneToOne 0.00 30.00 FORMAT "%5.2" EXTENDED_LIMITS 0.00 255.0 /end CHARACTERISTIC
/begin CHARACTERISTIC DFES_Cls.DFC_UegoSigWireRCmpS1B1_C "fault class per DFC / Fault class for check DFC_UegoSigWireRCmpS1B1" VALUE 0x804D97F5 Val_Wu8 30.00 DFES_OneToOne 0.00 30.00 FORMAT "%5.2" EXTENDED_LIMITS 0.00 255.0 /end CHARACTERISTIC
/begin CHARACTERISTIC DFES_Cls.DFC_UegoSigWireScbS1B1_C "fault class per DFC / Fault class for check DFC_UegoSigWireScbS1B1" VALUE 0x804D97F6 Val_Wu8 30.00 DFES_OneToOne 0.00 30.00 FORMAT "%5.2" EXTENDED_LIMITS 0.00 255.0 /end CHARACTERISTIC
/begin CHARACTERISTIC DFES_Cls.DFC_UegoSigWireScgS1B1_C "fault class per DFC / Fault class for check DFC_UegoSigWireScgS1B1" VALUE 0x804D97F7 Val_Wu8 30.00 DFES_OneToOne 0.00 30.00 FORMAT "%5.2" EXTENDED_LIMITS 0.00 255.0 /end CHARACTERISTIC
/begin CHARACTERISTIC DFES_Cls.DFC_AfsPhyRngHiB1_C "fault class per DFC / Fault class for check DFC_AfsPhyRngHiB1" VALUE 0x804D97F8 Val_Wu8 30.00 DFES_OneToOne 0.00 30.00 FORMAT "%5.2" EXTENDED_LIMITS 0.00 255.0 /end CHARACTERISTIC
/begin CHARACTERISTIC DFES_Cls.DFC_AfsPhyRngLoB1_C "fault class per DFC / Fault class for check DFC_AfsPhyRngLoB1" VALUE 0x804D97F9 Val_Wu8 30.00 DFES_OneToOne 0.00 30.00 FORMAT "%5.2" EXTENDED_LIMITS 0.00 255.0 /end CHARACTERISTIC
/begin CHARACTERISTIC DFES_Cls.DFC_AirCCmprOL_C "fault class per DFC / Fault class for check DFC_AirCCmprOL" VALUE 0x804D97FA Val_Wu8 30.00 DFES_OneToOne 0.00 30.00 FORMAT "%5.2" EXTENDED_LIMITS 0.00 255.0 /end CHARACTERISTIC
/begin CHARACTERISTIC DFES_Cls.DFC_AirCCmprOvrTemp_C "fault class per DFC / Fault class for check DFC_AirCCmprOvrTemp" VALUE 0x804D97FB Val_Wu8 30.00 DFES_OneToOne 0.00 30.00 FORMAT "%5.2" EXTENDED_LIMITS 0.00 255.0 /end CHARACTERISTIC
/begin CHARACTERISTIC DFES_Cls.DFC_AirCCmprSCB_C "fault class per DFC / Fault class for check DFC_AirCCmprSCB" VALUE 0x804D97FC Val_Wu8 30.00 DFES_OneToOne 0.00 30.00 FORMAT "%5.2" EXTENDED_LIMITS 0.00 255.0 /end CHARACTERISTIC
/begin CHARACTERISTIC DFES_Cls.DFC_AirCCmprSCG_C "fault class per DFC / Fault class for check DFC_AirCCmprSCG" VALUE 0x804D97FD Val_Wu8 30.00 DFES_OneToOne 0.00 30.00 FORMAT "%5.2" EXTENDED_LIMITS 0.00 255.0 /end CHARACTERISTIC
/begin CHARACTERISTIC DFES_Cls.DFC_AltErr_C "fault class per DFC / Fault class for check DFC_AltErr" VALUE 0x804D97FE Val_Wu8 30.00 DFES_OneToOne 0.00 30.00 FORMAT "%5.2" EXTENDED_LIMITS 0.00 255.0 /end CHARACTERISTIC
/begin CHARACTERISTIC DFES_Cls.DFC_BattUSRCMax_C "fault class per DFC / Fault class for check DFC_BattUSRCMax" VALUE 0x804D97FF Val_Wu8 30.00 DFES_OneToOne 0.00 30.00 FORMAT "%5.2" EXTENDED_LIMITS 0.00 255.0 /end CHARACTERISTIC
/begin CHARACTERISTIC DFES_Cls.DFC_BattUSRCMin_C "fault class per DFC / Fault class for check DFC_BattUSRCMin" VALUE 0x804D9800 Val_Wu8 30.00 DFES_OneToOne 0.00 30.00 FORMAT "%5.2" EXTENDED_LIMITS 0.00 255.0 /end CHARACTERISTIC
/begin CHARACTERISTIC DFES_Cls.DFC_ComChksTCU1_C "fault class per DFC / Fault class for check DFC_ComChksTCU1" VALUE 0x804D9801 Val_Wu8 30.00 DFES_OneToOne 0.00 30.00 FORMAT "%5.2" EXTENDED_LIMITS 0.00 255.0 /end CHARACTERISTIC
/begin CHARACTERISTIC DFES_Cls.DFC_ComChksTCU11_C "fault class per DFC / Fault class for check DFC_ComChksTCU11" VALUE 0x804D9802 Val_Wu8 30.00 DFES_OneToOne 0.00 30.00 FORMAT "%5.2" EXTENDED_LIMITS 0.00 255.0 /end CHARACTERISTIC
/begin CHARACTERISTIC DFES_Cls.DFC_ComChksTCU12_C "fault class per DFC / Fault class for check DFC_ComChksTCU12" VALUE 0x804D9803 Val_Wu8 30.00 DFES_OneToOne 0.00 30.00 FORMAT "%5.2" EXTENDED_LIMITS 0.00 255.0 /end CHARACTERISTIC
/begin CHARACTERISTIC DFES_Cls.DFC_ComChksTCU13_C "fault class per DFC / Fault class for check DFC_ComChksTCU13" VALUE 0x804D9804 Val_Wu8 30.00 DFES_OneToOne 0.00 30.00 FORMAT "%5.2" EXTENDED_LIMITS 0.00 255.0 /end CHARACTERISTIC
/begin CHARACTERISTIC DFES_Cls.DFC_ComChksTCU2_C "fault class per DFC / Fault class for check DFC_ComChksTCU2" VALUE 0x804D9805 Val_Wu8 30.00 DFES_OneToOne 0.00 30.00 FORMAT "%5.2" EXTENDED_LIMITS 0.00 255.0 /end CHARACTERISTIC
/begin CHARACTERISTIC DFES_Cls.DFC_ComChksTCU3_C "fault class per DFC / Fault class for check DFC_ComChksTCU3" VALUE 0x804D9806 Val_Wu8 30.00 DFES_OneToOne 0.00 30.00 FORMAT "%5.2" EXTENDED_LIMITS 0.00 255.0 /end CHARACTERISTIC
/begin CHARACTERISTIC DFES_Cls.DFC_ComChksTCU4_C "fault class per DFC / Fault class for check DFC_ComChksTCU4" VALUE 0x804D9807 Val_Wu8 30.00 DFES_OneToOne 0.00 30.00 FORMAT "%5.2" EXTENDED_LIMITS 0.00 255.0 /end CHARACTERISTIC
/begin CHARACTERISTIC DFES_Cls.DFC_ComCntTCU1_C "fault class per DFC / Fault class for check DFC_ComCntTCU1" VALUE 0x804D9808 Val_Wu8 30.00 DFES_OneToOne 0.00 30.00 FORMAT "%5.2" EXTENDED_LIMITS 0.00 255.0 /end CHARACTERISTIC
/begin CHARACTERISTIC DFES_Cls.DFC_ComCntTCU11_C "fault class per DFC / Fault class for check DFC_ComCntTCU11" VALUE 0x804D9809 Val_Wu8 30.00 DFES_OneToOne 0.00 30.00 FORMAT "%5.2" EXTENDED_LIMITS 0.00 255.0 /end CHARACTERISTIC
/begin CHARACTERISTIC DFES_Cls.DFC_ComCntTCU12_C "fault class per DFC / Fault class for check DFC_ComCntTCU12" VALUE 0x804D980A Val_Wu8 30.00 DFES_OneToOne 0.00 30.00 FORMAT "%5.2" EXTENDED_LIMITS 0.00 255.0 /end CHARACTERISTIC
/begin CHARACTERISTIC DFES_Cls.DFC_ComCntTCU13_C "fault class per DFC / Fault class for check DFC_ComCntTCU13" VALUE 0x804D980B Val_Wu8 30.00 DFES_OneToOne 0.00 30.00 FORMAT "%5.2" EXTENDED_LIMITS 0.00 255.0 /end CHARACTERISTIC
/begin CHARACTERISTIC DFES_Cls.DFC_ComCntTCU2_C "fault class per DFC / Fault class for check DFC_ComCntTCU2" VALUE 0x804D980C Val_Wu8 30.00 DFES_OneToOne 0.00 30.00 FORMAT "%5.2" EXTENDED_LIMITS 0.00 255.0 /end CHARACTERISTIC
/begin CHARACTERISTIC DFES_Cls.DFC_ComCntTCU3_C "fault class per DFC / Fault class for check DFC_ComCntTCU3" VALUE 0x804D980D Val_Wu8 30.00 DFES_OneToOne 0.00 30.00 FORMAT "%5.2" EXTENDED_LIMITS 0.00 255.0 /end CHARACTERISTIC
/begin CHARACTERISTIC DFES_Cls.DFC_ComCntTCU4_C "fault class per DFC / Fault class for check DFC_ComCntTCU4" VALUE 0x804D980E Val_Wu8 30.00 DFES_OneToOne 0.00 30.00 FORMAT "%5.2" EXTENDED_LIMITS 0.00 255.0 /end CHARACTERISTIC
/begin CHARACTERISTIC DFES_Cls.DFC_ComTOutTCU01_C "fault class per DFC / Fault class for check DFC_ComTOutTCU01" VALUE 0x804D980F Val_Wu8 30.00 DFES_OneToOne 0.00 30.00 FORMAT "%5.2" EXTENDED_LIMITS 0.00 255.0 /end CHARACTERISTIC
/begin CHARACTERISTIC DFES_Cls.DFC_ComTOutTCU02_C "fault class per DFC / Fault class for check DFC_ComTOutTCU02" VALUE 0x804D9810 Val_Wu8 30.00 DFES_OneToOne 0.00 30.00 FORMAT "%5.2" EXTENDED_LIMITS 0.00 255.0 /end CHARACTERISTIC
/begin CHARACTERISTIC DFES_Cls.DFC_ComTOutTCU1_C "fault class per DFC / Fault class for check DFC_ComTOutTCU1" VALUE 0x804D9811 Val_Wu8 30.00 DFES_OneToOne 0.00 30.00 FORMAT "%5.2" EXTENDED_LIMITS 0.00 255.0 /end CHARACTERISTIC
/begin CHARACTERISTIC DFES_Cls.DFC_ComTOutTCU11_C "fault class per DFC / Fault class for check DFC_ComTOutTCU11" VALUE 0x804D9812 Val_Wu8 30.00 DFES_OneToOne 0.00 30.00 FORMAT "%5.2" EXTENDED_LIMITS 0.00 255.0 /end CHARACTERISTIC
/begin CHARACTERISTIC DFES_Cls.DFC_ComTOutTCU12_C "fault class per DFC / Fault class for check DFC_ComTOutTCU12" VALUE 0x804D9813 Val_Wu8 30.00 DFES_OneToOne 0.00 30.00 FORMAT "%5.2" EXTENDED_LIMITS 0.00 255.0 /end CHARACTERISTIC
/begin CHARACTERISTIC DFES_Cls.DFC_ComTOutTCU13_C "fault class per DFC / Fault class for check DFC_ComTOutTCU13" VALUE 0x804D9814 Val_Wu8 30.00 DFES_OneToOne 0.00 30.00 FORMAT "%5.2" EXTENDED_LIMITS 0.00 255.0 /end CHARACTERISTIC
/begin CHARACTERISTIC DFES_Cls.DFC_ComTOutTCU14_C "fault class per DFC / Fault class for check DFC_ComTOutTCU14" VALUE 0x804D9815 Val_Wu8 30.00 DFES_OneToOne 0.00 30.00 FORMAT "%5.2" EXTENDED_LIMITS 0.00 255.0 /end CHARACTERISTIC
/begin CHARACTERISTIC DFES_Cls.DFC_ComTOutTCU2_C "fault class per DFC / Fault class for check DFC_ComTOutTCU2" VALUE 0x804D9816 Val_Wu8 30.00 DFES_OneToOne 0.00 30.00 FORMAT "%5.2" EXTENDED_LIMITS 0.00 255.0 /end CHARACTERISTIC
/begin CHARACTERISTIC DFES_Cls.DFC_ComTOutTCU3_C "fault class per DFC / Fault class for check DFC_ComTOutTCU3" VALUE 0x804D9817 Val_Wu8 30.00 DFES_OneToOne 0.00 30.00 FORMAT "%5.2" EXTENDED_LIMITS 0.00 255.0 /end CHARACTERISTIC
/begin CHARACTERISTIC DFES_Cls.DFC_ComTOutTCU4_C "fault class per DFC / Fault class for check DFC_ComTOutTCU4" VALUE 0x804D9818 Val_Wu8 30.00 DFES_OneToOne 0.00 30.00 FORMAT "%5.2" EXTENDED_LIMITS 0.00 255.0 /end CHARACTERISTIC
/begin CHARACTERISTIC DFES_Cls.DFC_DevLibBattUHi_C "fault class per DFC / Fault class for check DFC_DevLibBattUHi" VALUE 0x804D9819 Val_Wu8 30.00 DFES_OneToOne 0.00 30.00 FORMAT "%5.2" EXTENDED_LIMITS 0.00 255.0 /end CHARACTERISTIC
/begin CHARACTERISTIC DFES_Cls.DFC_DevLibBattULo_C "fault class per DFC / Fault class for check DFC_DevLibBattULo" VALUE 0x804D981A Val_Wu8 30.00 DFES_OneToOne 0.00 30.00 FORMAT "%5.2" EXTENDED_LIMITS 0.00 255.0 /end CHARACTERISTIC
/begin CHARACTERISTIC DFES_Cls.DFC_EGRVlvFailSafeActv_C "fault class per DFC / Fault class for check DFC_EGRVlvFailSafeActv" VALUE 0x804D981B Val_Wu8 30.00 DFES_OneToOne 0.00 30.00 FORMAT "%5.2" EXTENDED_LIMITS 0.00 255.0 /end CHARACTERISTIC
/begin CHARACTERISTIC DFES_Cls.DFC_EGRVlvGovDvtCld_C "fault class per DFC / Fault class for check DFC_EGRVlvGovDvtCld" VALUE 0x804D981C Val_Wu8 30.00 DFES_OneToOne 0.00 30.00 FORMAT "%5.2" EXTENDED_LIMITS 0.00 255.0 /end CHARACTERISTIC
/begin CHARACTERISTIC DFES_Cls.DFC_EGRVlvPhysSRCMax_C "fault class per DFC / Fault class for check DFC_EGRVlvPhysSRCMax" VALUE 0x804D981D Val_Wu8 30.00 DFES_OneToOne 0.00 30.00 FORMAT "%5.2" EXTENDED_LIMITS 0.00 255.0 /end CHARACTERISTIC
/begin CHARACTERISTIC DFES_Cls.DFC_EGRVlvPhysSRCMin_C "fault class per DFC / Fault class for check DFC_EGRVlvPhysSRCMin" VALUE 0x804D981E Val_Wu8 30.00 DFES_OneToOne 0.00 30.00 FORMAT "%5.2" EXTENDED_LIMITS 0.00 255.0 /end CHARACTERISTIC
/begin CHARACTERISTIC DFES_Cls.DFC_FanDIOOL_0_C "fault class per DFC / Fault class for check DFC_FanDIOOL_0" VALUE 0x804D981F Val_Wu8 30.00 DFES_OneToOne 0.00 30.00 FORMAT "%5.2" EXTENDED_LIMITS 0.00 255.0 /end CHARACTERISTIC
/begin CHARACTERISTIC DFES_Cls.DFC_FanDIOOL_1_C "fault class per DFC / Fault class for check DFC_FanDIOOL_1" VALUE 0x804D9820 Val_Wu8 30.00 DFES_OneToOne 0.00 30.00 FORMAT "%5.2" EXTENDED_LIMITS 0.00 255.0 /end CHARACTERISTIC
/begin CHARACTERISTIC DFES_Cls.DFC_FanDIOOvrTemp_0_C "fault class per DFC / Fault class for check DFC_FanDIOOvrTemp_0" VALUE 0x804D9821 Val_Wu8 30.00 DFES_OneToOne 0.00 30.00 FORMAT "%5.2" EXTENDED_LIMITS 0.00 255.0 /end CHARACTERISTIC
/begin CHARACTERISTIC DFES_Cls.DFC_FanDIOOvrTemp_1_C "fault class per DFC / Fault class for check DFC_FanDIOOvrTemp_1" VALUE 0x804D9822 Val_Wu8 30.00 DFES_OneToOne 0.00 30.00 FORMAT "%5.2" EXTENDED_LIMITS 0.00 255.0 /end CHARACTERISTIC
/begin CHARACTERISTIC DFES_Cls.DFC_FanDIOSCB_0_C "fault class per DFC / Fault class for check DFC_FanDIOSCB_0" VALUE 0x804D9823 Val_Wu8 30.00 DFES_OneToOne 0.00 30.00 FORMAT "%5.2" EXTENDED_LIMITS 0.00 255.0 /end CHARACTERISTIC
/begin CHARACTERISTIC DFES_Cls.DFC_FanDIOSCB_1_C "fault class per DFC / Fault class for check DFC_FanDIOSCB_1" VALUE 0x804D9824 Val_Wu8 30.00 DFES_OneToOne 0.00 30.00 FORMAT "%5.2" EXTENDED_LIMITS 0.00 255.0 /end CHARACTERISTIC
/begin CHARACTERISTIC DFES_Cls.DFC_FanDIOSCG_0_C "fault class per DFC / Fault class for check DFC_FanDIOSCG_0" VALUE 0x804D9825 Val_Wu8 30.00 DFES_OneToOne 0.00 30.00 FORMAT "%5.2" EXTENDED_LIMITS 0.00 255.0 /end CHARACTERISTIC
/begin CHARACTERISTIC DFES_Cls.DFC_FanDIOSCG_1_C "fault class per DFC / Fault class for check DFC_FanDIOSCG_1" VALUE 0x804D9826 Val_Wu8 30.00 DFES_OneToOne 0.00 30.00 FORMAT "%5.2" EXTENDED_LIMITS 0.00 255.0 /end CHARACTERISTIC
/begin CHARACTERISTIC DFES_Cls.DFC_MRlyDcOL_C "fault class per DFC / Fault class for check DFC_MRlyDcOL" VALUE 0x804D9827 Val_Wu8 30.00 DFES_OneToOne 0.00 30.00 FORMAT "%5.2" EXTENDED_LIMITS 0.00 255.0 /end CHARACTERISTIC
/begin CHARACTERISTIC DFES_Cls.DFC_MRlyDcSCB_C "fault class per DFC / Fault class for check DFC_MRlyDcSCB" VALUE 0x804D9828 Val_Wu8 30.00 DFES_OneToOne 0.00 30.00 FORMAT "%5.2" EXTENDED_LIMITS 0.00 255.0 /end CHARACTERISTIC
/begin CHARACTERISTIC DFES_Cls.DFC_MRlyDcSCG_C "fault class per DFC / Fault class for check DFC_MRlyDcSCG" VALUE 0x804D9829 Val_Wu8 30.00 DFES_OneToOne 0.00 30.00 FORMAT "%5.2" EXTENDED_LIMITS 0.00 255.0 /end CHARACTERISTIC
/begin CHARACTERISTIC DFES_Cls.DFC_PSPOL_C "fault class per DFC / Fault class for check DFC_PSPOL" VALUE 0x804D982A Val_Wu8 30.00 DFES_OneToOne 0.00 30.00 FORMAT "%5.2" EXTENDED_LIMITS 0.00 255.0 /end CHARACTERISTIC
/begin CHARACTERISTIC DFES_Cls.DFC_PSPOvrTemp_C "fault class per DFC / Fault class for check DFC_PSPOvrTemp" VALUE 0x804D982B Val_Wu8 30.00 DFES_OneToOne 0.00 30.00 FORMAT "%5.2" EXTENDED_LIMITS 0.00 255.0 /end CHARACTERISTIC
/begin CHARACTERISTIC DFES_Cls.DFC_PSPSCB_C "fault class per DFC / Fault class for check DFC_PSPSCB" VALUE 0x804D982C Val_Wu8 30.00 DFES_OneToOne 0.00 30.00 FORMAT "%5.2" EXTENDED_LIMITS 0.00 255.0 /end CHARACTERISTIC
/begin CHARACTERISTIC DFES_Cls.DFC_PSPSCG_C "fault class per DFC / Fault class for check DFC_PSPSCG" VALUE 0x804D982D Val_Wu8 30.00 DFES_OneToOne 0.00 30.00 FORMAT "%5.2" EXTENDED_LIMITS 0.00 255.0 /end CHARACTERISTIC
/begin CHARACTERISTIC DFES_Cls.DFC_T50Err_C "fault class per DFC / Fault class for check DFC_T50Err" VALUE 0x804D982E Val_Wu8 30.00 DFES_OneToOne 0.00 30.00 FORMAT "%5.2" EXTENDED_LIMITS 0.00 255.0 /end CHARACTERISTIC
/begin CHARACTERISTIC DFES_Cls.DFC_ThrVlvLoBattB1_C "fault class per DFC / Fault class for check DFC_ThrVlvLoBattB1" VALUE 0x804D982F Val_Wu8 30.00 DFES_OneToOne 0.00 30.00 FORMAT "%5.2" EXTENDED_LIMITS 0.00 255.0 /end CHARACTERISTIC
/begin CHARACTERISTIC DFES_Cls.DFC_UegoSigOperPlausS1B1_C "fault class per DFC / Fault class for check DFC_UegoSigOperPlausS1B1" VALUE 0x804D9830 Val_Wu8 30.00 DFES_OneToOne 0.00 30.00 FORMAT "%5.2" EXTENDED_LIMITS 0.00 255.0 /end CHARACTERISTIC
/begin CHARACTERISTIC DFES_Cls.DFC_VehVPhysRngHi_C "fault class per DFC / Fault class for check DFC_VehVPhysRngHi" VALUE 0x804D9831 Val_Wu8 30.00 DFES_OneToOne 0.00 30.00 FORMAT "%5.2" EXTENDED_LIMITS 0.00 255.0 /end CHARACTERISTIC
/begin CHARACTERISTIC DFES_Cls.DFC_VehVSclOutOL_C "fault class per DFC / Fault class for check DFC_VehVSclOutOL" VALUE 0x804D9832 Val_Wu8 30.00 DFES_OneToOne 0.00 30.00 FORMAT "%5.2" EXTENDED_LIMITS 0.00 255.0 /end CHARACTERISTIC
/begin CHARACTERISTIC DFES_Cls.DFC_VehVSclOutOT_C "fault class per DFC / Fault class for check DFC_VehVSclOutOT" VALUE 0x804D9833 Val_Wu8 30.00 DFES_OneToOne 0.00 30.00 FORMAT "%5.2" EXTENDED_LIMITS 0.00 255.0 /end CHARACTERISTIC
/begin CHARACTERISTIC DFES_Cls.DFC_VehVSclOutSCB_C "fault class per DFC / Fault class for check DFC_VehVSclOutSCB" VALUE 0x804D9834 Val_Wu8 30.00 DFES_OneToOne 0.00 30.00 FORMAT "%5.2" EXTENDED_LIMITS 0.00 255.0 /end CHARACTERISTIC
/begin CHARACTERISTIC DFES_Cls.DFC_VehVSclOutSCG_C "fault class per DFC / Fault class for check DFC_VehVSclOutSCG" VALUE 0x804D9835 Val_Wu8 30.00 DFES_OneToOne 0.00 30.00 FORMAT "%5.2" EXTENDED_LIMITS 0.00 255.0 /end CHARACTERISTIC
/begin CHARACTERISTIC DFES_Cls.DFC_VehVSigFL_C "fault class per DFC / Fault class for check DFC_VehVSigFL" VALUE 0x804D9836 Val_Wu8 30.00 DFES_OneToOne 0.00 30.00 FORMAT "%5.2" EXTENDED_LIMITS 0.00 255.0 /end CHARACTERISTIC
/begin CHARACTERISTIC DFES_Cls.DFC_VehVSigFR_C "fault class per DFC / Fault class for check DFC_VehVSigFR" VALUE 0x804D9837 Val_Wu8 30.00 DFES_OneToOne 0.00 30.00 FORMAT "%5.2" EXTENDED_LIMITS 0.00 255.0 /end CHARACTERISTIC
/begin CHARACTERISTIC DFES_Cls.DFC_VehVSigRL_C "fault class per DFC / Fault class for check DFC_VehVSigRL" VALUE 0x804D9838 Val_Wu8 30.00 DFES_OneToOne 0.00 30.00 FORMAT "%5.2" EXTENDED_LIMITS 0.00 255.0 /end CHARACTERISTIC
/begin CHARACTERISTIC DFES_Cls.DFC_VehVSigRR_C "fault class per DFC / Fault class for check DFC_VehVSigRR" VALUE 0x804D9839 Val_Wu8 30.00 DFES_OneToOne 0.00 30.00 FORMAT "%5.2" EXTENDED_LIMITS 0.00 255.0 /end CHARACTERISTIC
/begin CHARACTERISTIC DFES_Cls.DFC_VehVSnsrARngHi_C "fault class per DFC / Fault class for check DFC_VehVSnsrARngHi" VALUE 0x804D983A Val_Wu8 30.00 DFES_OneToOne 0.00 30.00 FORMAT "%5.2" EXTENDED_LIMITS 0.00 255.0 /end CHARACTERISTIC
/begin CHARACTERISTIC DFES_Cls.DFC_VehVSnsrBRngHi_C "fault class per DFC / Fault class for check DFC_VehVSnsrBRngHi" VALUE 0x804D983B Val_Wu8 30.00 DFES_OneToOne 0.00 30.00 FORMAT "%5.2" EXTENDED_LIMITS 0.00 255.0 /end CHARACTERISTIC
/begin CHARACTERISTIC DFES_Cls.DFC_VehVSpdRtyDiag_C "fault class per DFC / Fault class for check DFC_VehVSpdRtyDiag" VALUE 0x804D983C Val_Wu8 30.00 DFES_OneToOne 0.00 30.00 FORMAT "%5.2" EXTENDED_LIMITS 0.00 255.0 /end CHARACTERISTIC
/begin CHARACTERISTIC DFES_Cls.DFC_DHFHD_C "fault class per DFC / Fault class for check DFC_DHFHD" VALUE 0x804D983D Val_Wu8 30.00 DFES_OneToOne 0.00 30.00 FORMAT "%5.2" EXTENDED_LIMITS 0.00 255.0 /end CHARACTERISTIC
/begin CHARACTERISTIC DFES_Cls.DFC_InjVlv_DI_DcDc_C "fault class per DFC / Fault class for check DFC_InjVlv_DI_DcDc" VALUE 0x804D983E Val_Wu8 30.00 DFES_OneToOne 0.00 30.00 FORMAT "%5.2" EXTENDED_LIMITS 0.00 255.0 /end CHARACTERISTIC
/begin CHARACTERISTIC DFES_Cls.DFC_InjVlv_DI_NoLd_0_C "fault class per DFC / Fault class for check DFC_InjVlv_DI_NoLd_0" VALUE 0x804D983F Val_Wu8 30.00 DFES_OneToOne 0.00 30.00 FORMAT "%5.2" EXTENDED_LIMITS 0.00 255.0 /end CHARACTERISTIC
/begin CHARACTERISTIC DFES_Cls.DFC_InjVlv_DI_NoLd_1_C "fault class per DFC / Fault class for check DFC_InjVlv_DI_NoLd_1" VALUE 0x804D9840 Val_Wu8 30.00 DFES_OneToOne 0.00 30.00 FORMAT "%5.2" EXTENDED_LIMITS 0.00 255.0 /end CHARACTERISTIC
/begin CHARACTERISTIC DFES_Cls.DFC_InjVlv_DI_NoLd_2_C "fault class per DFC / Fault class for check DFC_InjVlv_DI_NoLd_2" VALUE 0x804D9841 Val_Wu8 30.00 DFES_OneToOne 0.00 30.00 FORMAT "%5.2" EXTENDED_LIMITS 0.00 255.0 /end CHARACTERISTIC
/begin CHARACTERISTIC DFES_Cls.DFC_InjVlv_DI_NoLd_3_C "fault class per DFC / Fault class for check DFC_InjVlv_DI_NoLd_3" VALUE 0x804D9842 Val_Wu8 30.00 DFES_OneToOne 0.00 30.00 FORMAT "%5.2" EXTENDED_LIMITS 0.00 255.0 /end CHARACTERISTIC
/begin CHARACTERISTIC DFES_Cls.DFC_InjVlv_DI_ScBnk_0_C "fault class per DFC / Fault class for check DFC_InjVlv_DI_ScBnk_0" VALUE 0x804D9843 Val_Wu8 30.00 DFES_OneToOne 0.00 30.00 FORMAT "%5.2" EXTENDED_LIMITS 0.00 255.0 /end CHARACTERISTIC
/begin CHARACTERISTIC DFES_Cls.DFC_InjVlv_DI_ScBnk_1_C "fault class per DFC / Fault class for check DFC_InjVlv_DI_ScBnk_1" VALUE 0x804D9844 Val_Wu8 30.00 DFES_OneToOne 0.00 30.00 FORMAT "%5.2" EXTENDED_LIMITS 0.00 255.0 /end CHARACTERISTIC
/begin CHARACTERISTIC DFES_Cls.DFC_InjVlv_DI_ScBnk_2_C "fault class per DFC / Fault class for check DFC_InjVlv_DI_ScBnk_2" VALUE 0x804D9845 Val_Wu8 30.00 DFES_OneToOne 0.00 30.00 FORMAT "%5.2" EXTENDED_LIMITS 0.00 255.0 /end CHARACTERISTIC
/begin CHARACTERISTIC DFES_Cls.DFC_InjVlv_DI_ScBnk_3_C "fault class per DFC / Fault class for check DFC_InjVlv_DI_ScBnk_3" VALUE 0x804D9846 Val_Wu8 30.00 DFES_OneToOne 0.00 30.00 FORMAT "%5.2" EXTENDED_LIMITS 0.00 255.0 /end CHARACTERISTIC
/begin CHARACTERISTIC DFES_Cls.DFC_InjVlv_DI_ScCyl_0_C "fault class per DFC / Fault class for check DFC_InjVlv_DI_ScCyl_0" VALUE 0x804D9847 Val_Wu8 30.00 DFES_OneToOne 0.00 30.00 FORMAT "%5.2" EXTENDED_LIMITS 0.00 255.0 /end CHARACTERISTIC
/begin CHARACTERISTIC DFES_Cls.DFC_InjVlv_DI_ScCyl_1_C "fault class per DFC / Fault class for check DFC_InjVlv_DI_ScCyl_1" VALUE 0x804D9848 Val_Wu8 30.00 DFES_OneToOne 0.00 30.00 FORMAT "%5.2" EXTENDED_LIMITS 0.00 255.0 /end CHARACTERISTIC
/begin CHARACTERISTIC DFES_Cls.DFC_InjVlv_DI_ScCyl_2_C "fault class per DFC / Fault class for check DFC_InjVlv_DI_ScCyl_2" VALUE 0x804D9849 Val_Wu8 30.00 DFES_OneToOne 0.00 30.00 FORMAT "%5.2" EXTENDED_LIMITS 0.00 255.0 /end CHARACTERISTIC
/begin CHARACTERISTIC DFES_Cls.DFC_InjVlv_DI_ScCyl_3_C "fault class per DFC / Fault class for check DFC_InjVlv_DI_ScCyl_3" VALUE 0x804D984A Val_Wu8 30.00 DFES_OneToOne 0.00 30.00 FORMAT "%5.2" EXTENDED_LIMITS 0.00 255.0 /end CHARACTERISTIC
/begin CHARACTERISTIC DFES_Cls.DFC_InjVlv_DI_ScHsLs_0_C "fault class per DFC / Fault class for check DFC_InjVlv_DI_ScHsLs_0" VALUE 0x804D984B Val_Wu8 30.00 DFES_OneToOne 0.00 30.00 FORMAT "%5.2" EXTENDED_LIMITS 0.00 255.0 /end CHARACTERISTIC
/begin CHARACTERISTIC DFES_Cls.DFC_InjVlv_DI_ScHsLs_1_C "fault class per DFC / Fault class for check DFC_InjVlv_DI_ScHsLs_1" VALUE 0x804D984C Val_Wu8 30.00 DFES_OneToOne 0.00 30.00 FORMAT "%5.2" EXTENDED_LIMITS 0.00 255.0 /end CHARACTERISTIC
/begin CHARACTERISTIC DFES_Cls.DFC_InjVlv_DI_ScHsLs_2_C "fault class per DFC / Fault class for check DFC_InjVlv_DI_ScHsLs_2" VALUE 0x804D984D Val_Wu8 30.00 DFES_OneToOne 0.00 30.00 FORMAT "%5.2" EXTENDED_LIMITS 0.00 255.0 /end CHARACTERISTIC
/begin CHARACTERISTIC DFES_Cls.DFC_InjVlv_DI_ScHsLs_3_C "fault class per DFC / Fault class for check DFC_InjVlv_DI_ScHsLs_3" VALUE 0x804D984E Val_Wu8 30.00 DFES_OneToOne 0.00 30.00 FORMAT "%5.2" EXTENDED_LIMITS 0.00 255.0 /end CHARACTERISTIC
/begin CHARACTERISTIC DFES_Cls.DFC_MfPsDiaOpenLoad1_C "fault class per DFC / Fault class for check DFC_MfPsDiaOpenLoad1" VALUE 0x804D984F Val_Wu8 30.00 DFES_OneToOne 0.00 30.00 FORMAT "%5.2" EXTENDED_LIMITS 0.00 255.0 /end CHARACTERISTIC
/begin MEASUREMENT DFES_ChkLstDltDemExCond_mp "Exit condition of last delete demand check during initialisation" UBYTE OneToOne 1 100 0.00 255.0 FORMAT "%5.1" ECU_ADDRESS 0x70009FE4 /end MEASUREMENT
/begin MEASUREMENT DFES_chkSt "Check state of all DFCs stored in the error memory" UWORD OneToOne 1 100 0.00 65535.00 FORMAT "%8.2" ARRAY_SIZE 20 ECU_ADDRESS 0x60038160 /end MEASUREMENT
/begin MEASUREMENT DFES_cnfSequence "DSM internal sequence counter to obtain confirmed entry sorting of all error memory entries" UBYTE OneToOne 1 100 0.00 255.0 FORMAT "%5.1" ARRAY_SIZE 20 ECU_ADDRESS 0x6003801E /end MEASUREMENT
/begin MEASUREMENT DFES_ctDef "Fault counters (FLC) of error memory entries" UBYTE DFES_OneToOne 1 100 0.00 255.0 FORMAT "%5.1" ARRAY_SIZE 20 ECU_ADDRESS 0x600380D4 /end MEASUREMENT
/begin MEASUREMENT DFES_ctDel "Delete counters (DLC) of error memory entries" UBYTE DFES_OneToOne 1 100 0.00 255.0 FORMAT "%5.1" ARRAY_SIZE 20 ECU_ADDRESS 0x60038084 /end MEASUREMENT
/begin MEASUREMENT DFES_ctEntry "Number of occupied DFES Entries" UBYTE DFES_OneToOne 1 100 0.00 255.0 FORMAT "%5.1" ECU_ADDRESS 0x60014A5B /end MEASUREMENT
/begin MEASUREMENT DFES_ctFrq "Frequency counters of error memory entries" UBYTE DFES_OneToOne 1 100 0.00 255.0 FORMAT "%5.1" ARRAY_SIZE 20 ECU_ADDRESS 0x6003724A /end MEASUREMENT
/begin MEASUREMENT DFES_ctManuDef "Manufacturer fault counters of error memory entries" UBYTE DFES_OneToOne 1 100 0.00 255.0 FORMAT "%5.1" ARRAY_SIZE 20 ECU_ADDRESS 0x600380AC /end MEASUREMENT
/begin MEASUREMENT DFES_ctManuOk "Manufacturer healing counters of error memory entries" UBYTE DFES_OneToOne 1 100 0.00 255.0 FORMAT "%5.1" ARRAY_SIZE 20 ECU_ADDRESS 0x60038098 /end MEASUREMENT
/begin MEASUREMENT DFES_ctMIL "Number of DFES Entries illuminating the MIL(Only continuous illumination, no blinking counted)" UBYTE DFES_OneToOne 1 100 0.00 255.0 FORMAT "%5.1" ECU_ADDRESS 0x60014A5D /end MEASUREMENT
/begin MEASUREMENT DFES_ctOBD "Number of DFES Entries visible in OBD Mode 3" UBYTE DFES_OneToOne 1 100 0.00 255.0 FORMAT "%5.1" ECU_ADDRESS 0x60010949 /end MEASUREMENT
/begin MEASUREMENT DFES_ctOBDPend "Number of DFES Entries visible in OBD Mode 7 (pending)" UBYTE DFES_OneToOne 1 100 0.00 255.0 FORMAT "%5.1" ECU_ADDRESS 0x60014A5E /end MEASUREMENT
/begin MEASUREMENT DFES_ctOk "Healing counters (HLC) of error memory entries" UBYTE DFES_OneToOne 1 100 0.00 255.0 FORMAT "%5.1" ARRAY_SIZE 20 ECU_ADDRESS 0x600380C0 /end MEASUREMENT
/begin MEASUREMENT DFES_ctPDTC "Number of DFES Entries visible in OBD Mode A (PDTC)" UBYTE DFES_OneToOne 1 100 0.00 255.0 FORMAT "%5.1" ECU_ADDRESS 0x60010947 /end MEASUREMENT
/begin MEASUREMENT DFES_ctSrv "Number of DFES Entries visible for Service tester" UBYTE DFES_OneToOne 1 100 0.00 255.0 FORMAT "%5.1" ECU_ADDRESS 0x60010948 /end MEASUREMENT
/begin MEASUREMENT DFES_entrySt "Entry state of all DFCs stored in the error memory" UBYTE DFES_Entry_Verb 1 100 0.00 34.0000000000 FORMAT "%13.10" ARRAY_SIZE 20 ECU_ADDRESS 0x6003814C /end MEASUREMENT
/begin MEASUREMENT DFES_entryStPdtcStrd "Current EEPROM storage state of PDTC DFES entries" UBYTE OneToOne 1 100 0.00 255.0 FORMAT "%5.1" ARRAY_SIZE 3 ECU_ADDRESS 0x60034000 /end MEASUREMENT
/begin MEASUREMENT DFES_EnvBlock "Environmental data of all fault entries" UBYTE DFES_OneToOne 1 100 0.00 255.0 FORMAT "%5.1" ARRAY_SIZE 20 ECU_ADDRESS 0x6003725E /end MEASUREMENT
/begin MEASUREMENT DFES_FrzFrVal "Freeze frame values of all fault entries" UBYTE DFES_OneToOne 1 100 0.00 255.0 FORMAT "%5.1" ARRAY_SIZE 3500 ECU_ADDRESS 0x60037272 /end MEASUREMENT
/begin MEASUREMENT DFES_idxSequence "Sequence in which DFES entries were allocated (became Service$03 or Service$07 visible)" UBYTE DFES_OneToOne 1 100 0.00 255.0 FORMAT "%5.1" ARRAY_SIZE 20 ECU_ADDRESS 0x60038033 /end MEASUREMENT
/begin MEASUREMENT DFES_ISOFrstCnfDFC "DFC matching to criteria of first confirmed DTC" UWORD DFCDFP_Verb 1 100 0.00 989.000000000 FORMAT "%13.9" ECU_ADDRESS 0x60037248 /end MEASUREMENT
/begin MEASUREMENT DFES_ISOFrstFailDFC "DFC matching to criteria of first failed DTC" UWORD DFCDFP_Verb 1 100 0.00 989.000000000 FORMAT "%13.9" ECU_ADDRESS 0x6003818A /end MEASUREMENT
/begin MEASUREMENT DFES_ISORcntCnfDFC "DFC matching to criteria of most recent confirmed DTC" UWORD DFCDFP_Verb 1 100 0.00 989.000000000 FORMAT "%13.9" ECU_ADDRESS 0x60037246 /end MEASUREMENT
/begin MEASUREMENT DFES_ISORcntFailDFC "DFC matching to criteria of most recent failed DTC" UWORD DFCDFP_Verb 1 100 0.00 989.000000000 FORMAT "%13.9" ECU_ADDRESS 0x60038188 /end MEASUREMENT
/begin MEASUREMENT DFES_MonEvnt "DFES monitoring - Event Id" UWORD DFES_Mon_Verb 1 100 0.00 32786.0000000 FORMAT "%13.7" ARRAY_SIZE 2 ECU_ADDRESS 0x6003820E /end MEASUREMENT
/begin MEASUREMENT DFES_MonObjt "DFES monitoring - Object Id" UWORD OneToOne 1 100 0.00 65535.00 FORMAT "%8.2" ARRAY_SIZE 2 ECU_ADDRESS 0x6003820A /end MEASUREMENT
/begin MEASUREMENT DFES_MonParm "DFES monitoring - Parameter" UWORD OneToOne 1 100 0.00 65535.00 FORMAT "%8.2" ARRAY_SIZE 2 ECU_ADDRESS 0x60038206 /end MEASUREMENT
/begin MEASUREMENT DFES_MonPtr "DSM internal pointer for DFES monitoring" UBYTE DFES_OneToOne 1 100 0.00 255.0 FORMAT "%5.1" ECU_ADDRESS 0x60038212 /end MEASUREMENT
/begin MEASUREMENT DFES_numDFC "Names of stored fault checks in the error memory" UWORD DFC_Verb 1 100 0.00 906.000000000 FORMAT "%13.9" ARRAY_SIZE 20 ECU_ADDRESS 0x60038124 /end MEASUREMENT
/begin MEASUREMENT DFES_numDFCAck "acknowledged ID of fault entry (scanned and handled)" UWORD DFC_Verb 1 100 0.00 906.000000000 FORMAT "%13.9" ARRAY_SIZE 20 ECU_ADDRESS 0x6003805C /end MEASUREMENT
/begin MEASUREMENT DFES_numDFCImdt "Names of immediately stored fault checks in the error memory" UWORD DFC_Verb 1 100 0.00 906.000000000 FORMAT "%13.9" ARRAY_SIZE 20 ECU_ADDRESS 0x600381DC /end MEASUREMENT
/begin MEASUREMENT DFES_numEntryAvl "Number of possible DFES Entries" UBYTE DFES_OneToOne 1 100 0.00 255.0 FORMAT "%5.1" ECU_ADDRESS 0x60014A5F /end MEASUREMENT
/begin MEASUREMENT DFES_numEnvSize "Number of bytes in one environment block" UBYTE DFES_OneToOne 1 100 0.00 255.0 FORMAT "%5.1" ECU_ADDRESS 0x60014A60 /end MEASUREMENT
/begin MEASUREMENT DFES_numExtdFrzFrmSize "Number of bytes for environmental conditions contained in one freeze frame extension set" UBYTE DFES_OneToOne 1 100 0.00 255.0 FORMAT "%5.1" ECU_ADDRESS 0x60014A61 /end MEASUREMENT
/begin MEASUREMENT DFES_numFrzFrmSize "Number of bytes in one freeze frame" UBYTE DFES_OneToOne 1 100 0.00 255.0 FORMAT "%5.1" ECU_ADDRESS 0x60014A62 /end MEASUREMENT
/begin MEASUREMENT DFES_OutLamps "Error lamp status of error memory entries" UBYTE DFES_OneToOne 1 100 0.00 255.0 FORMAT "%5.1" ARRAY_SIZE 20 ECU_ADDRESS 0x60010915 /end MEASUREMENT
/begin MEASUREMENT DFES_PDTCStore "indication to store permanent DTCs at beginning of postdrive" UBYTE OneToOne 1 100 0.00 255.0 BIT_MASK 0x1 FORMAT "%5.1" ECU_ADDRESS 0x60010940 /end MEASUREMENT
/begin MEASUREMENT DFES_prioEntryImdt "Priority of error memory entries" UBYTE DFES_OneToOne 1 100 0.00 255.0 FORMAT "%5.1" ARRAY_SIZE 20 ECU_ADDRESS 0x600381C8 /end MEASUREMENT
/begin MEASUREMENT DFES_StateVisibility "Tester visibility of error memory entries" UWORD DFES_OneToOne 1 100 0.00 65535.00 FORMAT "%8.2" ARRAY_SIZE 20 ECU_ADDRESS 0x60009F5A /end MEASUREMENT
/begin MEASUREMENT DFES_stChk "Legacy check state of all DFCs stored in the error memory" UBYTE DFES_stCheck_Verb 1 100 0.00 7.00000000000 FORMAT "%13.11" ARRAY_SIZE 20 ECU_ADDRESS 0x60038110 /end MEASUREMENT
/begin MEASUREMENT DFES_stCounters "Counter state of all DFCs stored in the error memory" UBYTE DFES_stCnt_Verb 1 100 0.00 85.0000000000 FORMAT "%13.10" ARRAY_SIZE 20 ECU_ADDRESS 0x600380E8 /end MEASUREMENT
/begin MEASUREMENT DFES_stCtlSetting "internal and central disable request" UBYTE OneToOne 1 100 0.00 255.0 FORMAT "%5.1" ECU_ADDRESS 0x50006038 /end MEASUREMENT
/begin MEASUREMENT DFES_stDataImdt "Environment data state of error memory entries" UBYTE DFES_stDataImdt_Verb 1 100 0.00 21.0000000000 FORMAT "%13.10" ARRAY_SIZE 20 ECU_ADDRESS 0x6003818C /end MEASUREMENT
/begin MEASUREMENT DFES_stDataImdtTrans "Alternative environment data state of error memory entries during transition." UBYTE DFES_stDataImdt_Verb 1 100 0.00 21.0000000000 FORMAT "%13.10" ARRAY_SIZE 20 ECU_ADDRESS 0x60010929 /end MEASUREMENT
/begin MEASUREMENT DFES_stDTCRecUpdt "state of disable DTC record update, AUTOSAR feature" UBYTE OneToOne 1 100 0.00 255.0 FORMAT "%5.1" ECU_ADDRESS 0x6001093E /end MEASUREMENT
/begin MEASUREMENT DFES_stDTCStorage "state of disable DTC storage AUTOSAR feature" UBYTE OneToOne 1 100 0.00 255.0 FORMAT "%5.1" ECU_ADDRESS 0x6001093D /end MEASUREMENT
/begin MEASUREMENT DFES_stEepBufChg "Status of change in DSM EEP buffer for PDTC entries." UBYTE OneToOne 1 100 0.00 255.0 BIT_MASK 0x1 FORMAT "%5.1" ECU_ADDRESS 0x60034062 /end MEASUREMENT
/begin MEASUREMENT DFES_stEepWrReq "request for an EEPROM storage" UBYTE OneToOne 1 100 0.00 255.0 FORMAT "%5.1" ECU_ADDRESS 0x60010944 /end MEASUREMENT
/begin MEASUREMENT DFES_stEntry "Legacy entry state of all DFCs stored in the error memory" UBYTE DFES_stEntry_Verb 1 100 0.00 254.000000000 FORMAT "%13.9" ARRAY_SIZE 20 ECU_ADDRESS 0x600380FC /end MEASUREMENT
/begin MEASUREMENT DFES_stErrDia "DSM internal status of all tester visibilities" UBYTE DFES_OneToOne 1 100 0.00 255.0 FORMAT "%5.1" ECU_ADDRESS 0x6001094B /end MEASUREMENT
/begin MEASUREMENT DFES_stErrLamp "DFES error lamp demands" UBYTE DFES_OneToOne 1 100 0.00 255.0 FORMAT "%5.1" ECU_ADDRESS 0x6001094C /end MEASUREMENT
/begin MEASUREMENT DFES_stErrLamp_msg "DFES error lamp demands" UBYTE DFES_OneToOne 1 100 0.00 255.0 FORMAT "%5.1" ECU_ADDRESS 0x6000FCB4 /end MEASUREMENT
/begin MEASUREMENT DFES_stInh "Inhibit (FIM) relevant state of fault entry" UBYTE DFES_OneToOne 1 100 0.00 255.0 FORMAT "%5.1" ARRAY_SIZE 20 ECU_ADDRESS 0x60038048 /end MEASUREMENT
/begin MEASUREMENT DFES_stOrdImdt "Order state of error memory entries" UWORD DFES_OneToOne 1 100 0.00 65535.00 FORMAT "%8.2" ARRAY_SIZE 20 ECU_ADDRESS 0x600381A0 /end MEASUREMENT
/begin MEASUREMENT DFES_stOrdImdtTrans "" UBYTE DFES_OneToOne 1 100 0.00 255.0 FORMAT "%5.1" ARRAY_SIZE 20 ECU_ADDRESS 0x6003402C /end MEASUREMENT
/begin MEASUREMENT DFES_stOutstate "DSM Flag status to check whether error counter is valid or not." UBYTE DFES_OneToOne 1 100 0.00 255.0 FORMAT "%5.1" ECU_ADDRESS 0x6001094A /end MEASUREMENT
/begin MEASUREMENT DFES_stPrgEvt "ECU programming event detected (reset of all diagnostic informations including IUMPR and permanent DTCs)" UBYTE OneToOne 1 100 0.00 255.0 BIT_MASK 0x1 FORMAT "%5.1" ECU_ADDRESS 0x6001093F /end MEASUREMENT
/begin MEASUREMENT DFES_stPrgEvt_msg "Interface that gives information about ECU programming event." UBYTE OneToOne 1 100 0.00 255.0 BIT_MASK 0x1 FORMAT "%5.1" ECU_ADDRESS 0x60010017 /end MEASUREMENT
/begin MEASUREMENT DFES_stRepClrAftPwrFail "Repeated DSM clear after powerfail necessary" UBYTE B_TRUE 1 100 0.00 1.00000000000 BIT_MASK 0x1 FORMAT "%13.11" ECU_ADDRESS 0x6000F070 /end MEASUREMENT
/begin MEASUREMENT DFES_xAsgnEnvAllDataSize "Memory usage of common calibrated environment data" UBYTE DFES_OneToOne 1 100 0.00 255.0 FORMAT "%5.1" ECU_ADDRESS 0x60010914 /end MEASUREMENT
/begin MEASUREMENT DSM_stProtdRamVld "DFES protected ram content is valid" UBYTE OneToOne 1 100 0.00 255.0 BIT_MASK 0x1 FORMAT "%5.1" ECU_ADDRESS 0x60034044 /end MEASUREMENT
/begin FUNCTION DFC "30000.33.0_1.1.0Diagnostic Fault Check"
 /begin DEF_CHARACTERISTIC DFC_DisblMsk.DFC_MoCSOPICO_C DFC_DisblMsk.DFC_MoFAPP_C DFC_DisblMsk.DFC_MoFAirFilgPrdc_C DFC_DisblMsk.DFC_MoFAirFlCtOffGdi_C DFC_DisblMsk.DFC_MoFAirFlCylGdi_C DFC_DisblMsk.DFC_MoFAirFlFF_C DFC_DisblMsk.DFC_MoFAirFlIn_C DFC_DisblMsk.DFC_MoFAirFlMixCtlGdiChkAirFl_C DFC_DisblMsk.DFC_MoFAirFlMixCtlGdiChkCtrl_C DFC_DisblMsk.DFC_MoFAirFlMode_C DFC_DisblMsk.DFC_MoFESpd_C DFC_DisblMsk.DFC_MoFIACo_C DFC_DisblMsk.DFC_MoFICOL1_C DFC_DisblMsk.DFC_MoFICOL2_C DFC_DisblMsk.DFC_MoFStrt_C DFC_DisblMsk.DFC_MoFTrqCmp_C DFC_DisblMsk.DFC_MoFTrqCmpMax_C DFC_DisblMsk.DFC_MoFTrqCmpMin_C DFC_DisblMsk.DFC_MoFVarPostBldSel_C DFC_DisblMsk.DFC_MoXEMMHwLTMCUFW_C DFC_DisblMsk.DFC_MoXEMMHwLTMonBIST_C DFC_DisblMsk.DFC_MoXEMMHwLTRegMonTest_C DFC_DisblMsk.DFC_MoXEMMHwLTStbySMUAlvTest_C DFC_DisblMsk.DFC_MoXEMMHwLTTempSens_C DFC_DisblMsk.DFC_MoXEMMHwLTUCBCfg_C DFC_DisblMsk.DFC_NWSEmax_C DFC_DisblMsk.DFC_NWSmax_C DFC_DisblMsk.DFC_OCWDAABEActv_C DFC_DisblMsk.DFC_OCWDACom_C DFC_DisblMsk.DFC_OCWDAErrPin_C DFC_DisblMsk.DFC_OCWDAOvrVltg_C DFC_DisblMsk.DFC_ORAmax_C DFC_DisblMsk.DFC_ORAmin_C DFC_DisblMsk.DFC_OilPPlaus_C DFC_DisblMsk.DFC_PLLSUmax_C DFC_DisblMsk.DFC_PLLSUmin_C DFC_DisblMsk.DFC_PSR1max_C DFC_DisblMsk.DFC_PSRBmax_C DFC_DisblMsk.DFC_PSRBmin_C DFC_DisblMsk.DFC_PSRPmax_C DFC_DisblMsk.DFC_PSRPmin_C DFC_DisblMsk.DFC_PSRPsig_C DFC_DisblMsk.DFC_PSRmax_C DFC_DisblMsk.DFC_PUmax_C DFC_DisblMsk.DFC_P_VSE11_OL_C DFC_DisblMsk.DFC_P_VSE11_SCB_C DFC_DisblMsk.DFC_P_VSE11_SCG_C DFC_DisblMsk.DFC_PhyHighAPP1_C DFC_DisblMsk.DFC_PhyHighAPP2_C DFC_DisblMsk.DFC_PhyLowAPP1_C DFC_DisblMsk.DFC_PhyLowAPP2_C DFC_DisblMsk.DFC_SRCHighAPP1_C DFC_DisblMsk.DFC_SRCHighAPP2_C DFC_DisblMsk.DFC_SRCLowAPP1_C DFC_DisblMsk.DFC_SRCLowAPP2_C DFC_DisblMsk.DFC_SSpMon2_C DFC_DisblMsk.DFC_STHDRmax_C DFC_DisblMsk.DFC_SWReset_0_C DFC_DisblMsk.DFC_SWReset_1_C DFC_DisblMsk.DFC_SWReset_2_C DFC_DisblMsk.DFC_SyncAPP_C DFC_DisblMsk.DFC_TANKLnpl_C DFC_DisblMsk.DFC_TAmax_Dummy_C DFC_DisblMsk.DFC_TESFmax_C DFC_DisblMsk.DFC_TESGmax_C DFC_DisblMsk.DFC_TKAEmax_C DFC_DisblMsk.DFC_TKAEmin_C DFC_DisblMsk.DFC_TKARmax_C DFC_DisblMsk.DFC_TKARnpl_C DFC_DisblMsk.DFC_TMmax_Dummy_C DFC_DisblMsk.DFC_TUMmax_Dummy_C DFC_DisblMsk.DFC_TWCDPriCatB1_C DFC_DisblMsk.DFC_ThrVlvClsdPosnFirstOffsLrnImpoB1_C DFC_DisblMsk.DFC_ThrVlvClsdPosnOffsLrnImpoB1_C DFC_DisblMsk.DFC_ThrVlvClsdPosnOffsLrnMaxB1_C DFC_DisblMsk.DFC_ThrVlvClsdPosnOffsLrnMinB1_C DFC_DisblMsk.DFC_ThrVlvCtrlDeB1_C DFC_DisblMsk.DFC_ThrVlvDycB1_C DFC_DisblMsk.DFC_ThrVlvLimpAirPosnMaxAbsltDriftB1_C DFC_DisblMsk.DFC_ThrVlvLimpAirPosnMaxB1_C DFC_DisblMsk.DFC_ThrVlvLimpAirPosnMaxRelDriftB1_C DFC_DisblMsk.DFC_ThrVlvLimpAirPosnMinB1_C DFC_DisblMsk.DFC_ThrVlvOpenLoadB1_C DFC_DisblMsk.DFC_ThrVlvOpenSprgB1_C DFC_DisblMsk.DFC_ThrVlvOpenSprgSprdB1_C DFC_DisblMsk.DFC_ThrVlvOpenSprgTwnB1_C DFC_DisblMsk.DFC_ThrVlvOverTB1_C DFC_DisblMsk.DFC_ThrVlvRetSprgB1_C DFC_DisblMsk.DFC_ThrVlvRetSprgSprdB1_C DFC_DisblMsk.DFC_ThrVlvRetSprgTwnB1_C DFC_DisblMsk.DFC_ThrVlvSens1MaxB1_C DFC_DisblMsk.DFC_ThrVlvSens1NplB1_C DFC_DisblMsk.DFC_ThrVlvSens2MaxB1_C DFC_DisblMsk.DFC_ThrVlvSens2MinB1_C DFC_DisblMsk.DFC_ThrVlvSens2NplB1_C DFC_DisblMsk.DFC_ThrVlvShoCircB1_C DFC_DisblMsk.DFC_ThrVlvSpiErrB1_C DFC_DisblMsk.DFC_ThrvlvSens1MinB1_C DFC_DisblMsk.DFC_TiOffTBasdChkFast_C DFC_DisblMsk.DFC_TiOffTBasdChkSlow_C DFC_DisblMsk.DFC_UEGOSnsrMntdS1B1_C DFC_DisblMsk.DFC_VehVSig_C DFC_DisblMsk.DFC_VlvLftFbSwtIntk11SpclFail_C DFC_DisblMsk.DFC_VlvLftFbSwtIntk11StdFail_C DFC_DtcFuncUnit_C DFC_DtcGroup_C DFC_DtcSeverity_C /end DEF_CHARACTERISTIC
 FUNCTION_VERSION "30000.33.0_1.1.0" /end FUNCTION
/begin FUNCTION DFES "30000.73.0_2.0.0Diagnostic Fault Event Storage"
 /begin DEF_CHARACTERISTIC DFES_Cls.DFC_Unused_C DFES_Cls.DFC_AAVEmax_C DFES_Cls.DFC_AAVEmin_C DFES_Cls.DFC_AAVEsig_C DFES_Cls.DFC_AltIOACGFailr_C DFES_Cls.DFC_AltIOACGHiVltg_C DFES_Cls.DFC_AltIOACGLoVltg_C DFES_Cls.DFC_AltIOACGTHi_C DFES_Cls.DFC_AltIODConnACG_C DFES_Cls.DFC_BGOELWAF_C DFES_Cls.DFC_BattUHiFailr_C DFES_Cls.DFC_BattULoFailr_C DFES_Cls.DFC_BrkBstPDriftHiErr_C DFES_Cls.DFC_BrkBstPDriftLoErr_C DFES_Cls.DFC_BrkBstPSnsrStuck_C DFES_Cls.DFC_BrkMnSwtContOn_C DFES_Cls.DFC_BrkMnSwtNotStp_C DFES_Cls.DFC_BrkNpl_C DFES_Cls.DFC_BrkRdntSwtContOn_C DFES_Cls.DFC_BrkRdntSwtNotStp_C DFES_Cls.DFC_Clth3ONStuck_C DFES_Cls.DFC_Clth4OFFStuck_C DFES_Cls.DFC_ClthOFFStuck_C DFES_Cls.DFC_ClthONStuck_C DFES_Cls.DFC_ClthStkFailInfo_C DFES_Cls.DFC_ComACFailInfo_C DFES_Cls.DFC_ComATFTValErr_C DFES_Cls.DFC_ComATMILReq_C DFES_Cls.DFC_ComAYCAChksum_C DFES_Cls.DFC_ComAYCARingCnt_C DFES_Cls.DFC_ComAYCATOut_C DFES_Cls.DFC_ComAYCDChkSum_C DFES_Cls.DFC_ComAYCDTOut_C DFES_Cls.DFC_ComAYCFChksum_C DFES_Cls.DFC_ComAYCFRingCnt_C DFES_Cls.DFC_ComAYCFTOut_C DFES_Cls.DFC_ComAYCGChksum_C DFES_Cls.DFC_ComAYCGRingCnt_C DFES_Cls.DFC_ComAYCGTOut_C DFES_Cls.DFC_ComAYCIChkSum_C DFES_Cls.DFC_ComAYCIRingCnt_C DFES_Cls.DFC_ComAYCITOut_C DFES_Cls.DFC_ComBCM1ChkSum_C DFES_Cls.DFC_ComBCM1RingCnt_C DFES_Cls.DFC_ComBCM1TOut_C DFES_Cls.DFC_ComCANABusOffErr_C DFES_Cls.DFC_ComCANBBusOffErr_C DFES_Cls.DFC_ComCANCBusOffErr_C DFES_Cls.DFC_ComCGW1ChkSum_C DFES_Cls.DFC_ComCGW1RingCnt_C DFES_Cls.DFC_ComCGW1TOut_C DFES_Cls.DFC_ComConvBoostErr_C DFES_Cls.DFC_ComConvSlipErr_C DFES_Cls.DFC_ComDCDCPrfmncErr_C DFES_Cls.DFC_ComDCDCTempWarn_C DFES_Cls.DFC_ComEAT10Chksum_C DFES_Cls.DFC_ComEAT10RingCnt_C DFES_Cls.DFC_ComEAT10TOut_C DFES_Cls.DFC_ComEAT11ChkSum_C DFES_Cls.DFC_ComEAT11RingCnt_C DFES_Cls.DFC_ComEAT11TOut_C DFES_Cls.DFC_ComEAT12ChkSum_C DFES_Cls.DFC_ComEAT12RingCnt_C DFES_Cls.DFC_ComEAT12TOut_C DFES_Cls.DFC_ComEAT13ChkSum_C DFES_Cls.DFC_ComEAT13RingCnt_C DFES_Cls.DFC_ComEAT13TOut_C DFES_Cls.DFC_ComEAT1Chksum_C DFES_Cls.DFC_ComEAT1RingCnt_C DFES_Cls.DFC_ComEAT1TOut_C DFES_Cls.DFC_ComEAT2ChkSum_C DFES_Cls.DFC_ComEAT2RingCnt_C DFES_Cls.DFC_ComEAT2TOut_C DFES_Cls.DFC_ComEAT4ChkSum_C DFES_Cls.DFC_ComEAT4RingCnt_C DFES_Cls.DFC_ComEAT4TOut_C DFES_Cls.DFC_ComEAT6Chksum_C DFES_Cls.DFC_ComEAT6RingCnt_C DFES_Cls.DFC_ComEAT6TOut_C DFES_Cls.DFC_ComEAT7Chksum_C DFES_Cls.DFC_ComEAT7RingCnt_C DFES_Cls.DFC_ComEAT7TOut_C DFES_Cls.DFC_ComEAT8Chksum_C DFES_Cls.DFC_ComEAT8RingCnt_C DFES_Cls.DFC_ComEAT8TOut_C DFES_Cls.DFC_ComEATAChksum_C DFES_Cls.DFC_ComEATARingCnt_C DFES_Cls.DFC_ComEATATOut_C DFES_Cls.DFC_ComEATBChkSum_C DFES_Cls.DFC_ComEATBRingCnt_C DFES_Cls.DFC_ComEATBTOut_C DFES_Cls.DFC_ComEATCChksum_C DFES_Cls.DFC_ComEATCRingCnt_C DFES_Cls.DFC_ComEATCTOut_C DFES_Cls.DFC_ComEPBBChkSum_C DFES_Cls.DFC_ComEPBBRingCnt_C DFES_Cls.DFC_ComEPBBTOut_C DFES_Cls.DFC_ComEPBChksum_C DFES_Cls.DFC_ComEPBTOut_C DFES_Cls.DFC_ComEPBctRing_C DFES_Cls.DFC_ComEPS1Chksum_C DFES_Cls.DFC_ComEPS1RingCnt_C DFES_Cls.DFC_ComEPS1TOut_C DFES_Cls.DFC_ComEngCanRxErr_C DFES_Cls.DFC_ComGrvySnsrErr_C DFES_Cls.DFC_ComGwIMG1ChkSum_C DFES_Cls.DFC_ComGwIMG1RingCnt_C DFES_Cls.DFC_ComGwIMG1TOut_C DFES_Cls.DFC_ComGwIMG3ChkSum_C DFES_Cls.DFC_ComGwIMG3RingCnt_C DFES_Cls.DFC_ComGwIMG3TOut_C DFES_Cls.DFC_ComGwIMG4ChkSum_C DFES_Cls.DFC_ComGwIMG4RingCnt_C DFES_Cls.DFC_ComGwIMG4TOut_C DFES_Cls.DFC_ComGwIMG5ChkSum_C DFES_Cls.DFC_ComGwIMG5RingCnt_C DFES_Cls.DFC_ComGwIMG5TOut_C DFES_Cls.DFC_ComGwIMG6ChkSum_C DFES_Cls.DFC_ComGwIMG6RingCnt_C DFES_Cls.DFC_ComGwIMG6TOut_C DFES_Cls.DFC_ComIDASBChksum_C DFES_Cls.DFC_ComIDASBRingCnt_C DFES_Cls.DFC_ComIDASBTOut_C DFES_Cls.DFC_ComIMGMILReq_C DFES_Cls.DFC_ComISSPrms_C DFES_Cls.DFC_ComMETAChksum_C DFES_Cls.DFC_ComMETAChksumPstDrv_C DFES_Cls.DFC_ComMETARingCnt_C DFES_Cls.DFC_ComMETARingCntPstDrv_C DFES_Cls.DFC_ComMETATOut_C DFES_Cls.DFC_ComMETATOutPstDrv_C DFES_Cls.DFC_ComMETCChksum_C DFES_Cls.DFC_ComMETCRingCnt_C DFES_Cls.DFC_ComMETCTOut_C DFES_Cls.DFC_ComMETDChksum_C DFES_Cls.DFC_ComMETDRingCnt_C DFES_Cls.DFC_ComMETDTOut_C DFES_Cls.DFC_ComMETE2Chksum_C DFES_Cls.DFC_ComMETE2RingCnt_C DFES_Cls.DFC_ComMETE2TOut_C DFES_Cls.DFC_ComMETFChksum_C DFES_Cls.DFC_ComMETFRingCnt_C DFES_Cls.DFC_ComMETFTOut_C DFES_Cls.DFC_ComMETGChksum_C DFES_Cls.DFC_ComMETGRingCnt_C DFES_Cls.DFC_ComMETGTOut_C DFES_Cls.DFC_ComMETH2Chksum_C DFES_Cls.DFC_ComMETH2RingCnt_C DFES_Cls.DFC_ComMETH2TOut_C DFES_Cls.DFC_ComMETHChksum_C DFES_Cls.DFC_ComMETHRingCnt_C DFES_Cls.DFC_ComMETHTOut_C DFES_Cls.DFC_ComMETIChksum_C DFES_Cls.DFC_ComMETIRingCnt_C DFES_Cls.DFC_ComMETITOut_C DFES_Cls.DFC_ComMETKChksum_C DFES_Cls.DFC_ComMETKRingCnt_C DFES_Cls.DFC_ComMETKTOut_C DFES_Cls.DFC_ComMETLChksum_C DFES_Cls.DFC_ComMETLRingCnt_C DFES_Cls.DFC_ComMETLTOut_C DFES_Cls.DFC_ComMETMChksum_C DFES_Cls.DFC_ComMETMRingCnt_C DFES_Cls.DFC_ComMETMTOut_C DFES_Cls.DFC_ComMETNChksum_C DFES_Cls.DFC_ComMETNRingCnt_C DFES_Cls.DFC_ComMETNTOut_C DFES_Cls.DFC_ComMtrCom_C DFES_Cls.DFC_ComPCUChkSum_C DFES_Cls.DFC_ComPCURingCnt_C DFES_Cls.DFC_ComPCUTOut_C DFES_Cls.DFC_ComSRSAChksum_C DFES_Cls.DFC_ComSRSARingCnt_C DFES_Cls.DFC_ComSRSATOut_C DFES_Cls.DFC_ComSRSBChksum_C DFES_Cls.DFC_ComSRSBRingCnt_C DFES_Cls.DFC_ComSRSBTOut_C DFES_Cls.DFC_ComSRSChksum_C DFES_Cls.DFC_ComSRSErr_C DFES_Cls.DFC_ComSRSRingCnt_C DFES_Cls.DFC_ComSRSTOut_C DFES_Cls.DFC_ComVehSpdPndFltTCU_C DFES_Cls.DFC_EbsChartcCurrErr_C DFES_Cls.DFC_EbsSelfDiagErr_C DFES_Cls.DFC_GEVlvPhaCsersIntkB1_C DFES_Cls.DFC_GEVlvPhaPsOpenLoadIntkB1_C DFES_Cls.DFC_GEVlvPhaPsShoToBattIntkB1_C DFES_Cls.DFC_GEVlvPhaPsShoToGndIntkB1_C DFES_Cls.DFC_GbxCANDigPlausErr_C DFES_Cls.DFC_GbxNPos1SRCMax_C DFES_Cls.DFC_GbxNPos1SRCMin_C DFES_Cls.DFC_GbxNPos2SRCMax_C DFES_Cls.DFC_GbxNPos2SRCMin_C DFES_Cls.DFC_GbxNPosAlvChk_C DFES_Cls.DFC_GbxNPosSyncErr_C DFES_Cls.DFC_HEGOS2B1HtrPsMax_C DFES_Cls.DFC_HEGOS2B1HtrPsMin_C DFES_Cls.DFC_HEGOS2B1HtrPsSig_C DFES_Cls.DFC_LinCSErrACG_C DFES_Cls.DFC_LinCSErrAEV_C DFES_Cls.DFC_LinCSErrDCDC_C DFES_Cls.DFC_LinCSErrEBS_C DFES_Cls.DFC_LinHdrTimeoutErrACG_C DFES_Cls.DFC_LinHdrTimeoutErrAEV_C DFES_Cls.DFC_LinHdrTimeoutErrDCDC_C DFES_Cls.DFC_LinHdrTimeoutErrEBS_C DFES_Cls.DFC_LinMsgTimeoutErrACG_C DFES_Cls.DFC_LinMsgTimeoutErrAEV_C DFES_Cls.DFC_LinMsgTimeoutErrDCDC_C DFES_Cls.DFC_LinMsgTimeoutErrEBS_C DFES_Cls.DFC_LinNoStrtComErr_C DFES_Cls.DFC_LowPresOilP_C DFES_Cls.DFC_MisfDetVWhlFrntLeOORHi_C DFES_Cls.DFC_MisfDetVWhlFrntLeRatyHi_C DFES_Cls.DFC_MisfDetVWhlFrntLeRatyLo_C DFES_Cls.DFC_MisfDetVWhlFrntLeStuck_C DFES_Cls.DFC_MisfDetVWhlFrntRiOORHi_C DFES_Cls.DFC_MisfDetVWhlFrntRiRatyHi_C DFES_Cls.DFC_MisfDetVWhlFrntRiRatyLo_C DFES_Cls.DFC_MisfDetVWhlFrntRiStuck_C DFES_Cls.DFC_MisfDetVWhlReLeOORHi_C DFES_Cls.DFC_MisfDetVWhlReLeRatyHi_C DFES_Cls.DFC_MisfDetVWhlReLeRatyLo_C DFES_Cls.DFC_MisfDetVWhlReLeStuck_C DFES_Cls.DFC_MisfDetVWhlReRiOORHi_C DFES_Cls.DFC_MisfDetVWhlReRiRatyHi_C DFES_Cls.DFC_MisfDetVWhlReRiRatyLo_C DFES_Cls.DFC_MisfDetVWhlReRiStuck_C DFES_Cls.DFC_MisfDetdVWhlFrntLePlaus_C DFES_Cls.DFC_MisfDetdVWhlFrntRiPlaus_C DFES_Cls.DFC_MisfDetdVWhlReLePlaus_C DFES_Cls.DFC_MisfDetdVWhlReRiPlaus_C DFES_Cls.DFC_PEnvSigRngMax_C DFES_Cls.DFC_PEnvSigRngMin_C DFES_Cls.DFC_StmFault_C DFES_Cls.DFC_StrtCtOffPth_C DFES_Cls.DFC_StrtCtlErr_C DFES_Cls.DFC_StrtFault_C DFES_Cls.DFC_StrtLckJudg1_C DFES_Cls.DFC_StrtLckJudg2_C DFES_Cls.DFC_StrtOL_C DFES_Cls.DFC_StrtOL2_C DFES_Cls.DFC_StrtSCB_C DFES_Cls.DFC_StrtSCB2_C DFES_Cls.DFC_StrtSCG_C DFES_Cls.DFC_StrtSCG2_C DFES_Cls.DFC_StrtStkRly1_C DFES_Cls.DFC_StrtStkRly2_C DFES_Cls.DFC_TEVEmax_C DFES_Cls.DFC_TEVEmin_C DFES_Cls.DFC_TEVEsig_C DFES_Cls.DFC_UegoHeatrPrfmncLoS1B1_C DFES_Cls.DFC_VehVAllPlaus_C DFES_Cls.DFC_VehVNCSnsrElecFailr_C DFES_Cls.DFC_VehVPlausCan_C DFES_Cls.DFC_VehVPlausFco_C DFES_Cls.DFC_VehVPlausPwr_C DFES_Cls.DFC_VehVPlausV2N_C DFES_Cls.DFC_VehVSpdSnsrAElecFailr_C DFES_Cls.DFC_VehVSpdSnsrBElecFailr_C DFES_Cls.DFC_ClthMax_C DFES_Cls.DFC_IgnClPs_DevComErr_C DFES_Cls.DFC_IgnClPs_LineOl_0_C DFES_Cls.DFC_IgnClPs_LineOl_1_C DFES_Cls.DFC_IgnClPs_LineOl_2_C DFES_Cls.DFC_IgnClPs_LineOl_3_C DFES_Cls.DFC_IgnClPs_LineScb_0_C DFES_Cls.DFC_IgnClPs_LineScb_1_C DFES_Cls.DFC_IgnClPs_LineScb_2_C DFES_Cls.DFC_IgnClPs_LineScb_3_C DFES_Cls.DFC_IgnClPs_LineScg_0_C DFES_Cls.DFC_IgnClPs_LineScg_1_C DFES_Cls.DFC_IgnClPs_LineScg_2_C DFES_Cls.DFC_IgnClPs_LineScg_3_C DFES_Cls.DFC_KRVEKOEVAB_C DFES_Cls.DFC_KRVEKOEVAB0_C DFES_Cls.DFC_KRVEKOEVAB1_C DFES_Cls.DFC_KRVEKOEVAB2_C DFES_Cls.DFC_KRVEKOEVAB3_C DFES_Cls.DFC_UegoSigEcuAsicS1B1_C DFES_Cls.DFC_UegoSigEcuComS1B1_C DFES_Cls.DFC_UegoSigSnsrS1B1_C DFES_Cls.DFC_UegoSigWireOlApesS1B1_C DFES_Cls.DFC_UegoSigWireOlIpeS1B1_C DFES_Cls.DFC_UegoSigWireOlReS1B1_C DFES_Cls.DFC_UegoSigWireRCmpS1B1_C DFES_Cls.DFC_UegoSigWireScbS1B1_C DFES_Cls.DFC_UegoSigWireScgS1B1_C DFES_Cls.DFC_AfsPhyRngHiB1_C DFES_Cls.DFC_AfsPhyRngLoB1_C DFES_Cls.DFC_AirCCmprOL_C DFES_Cls.DFC_AirCCmprOvrTemp_C DFES_Cls.DFC_AirCCmprSCB_C DFES_Cls.DFC_AirCCmprSCG_C DFES_Cls.DFC_AltErr_C DFES_Cls.DFC_BattUSRCMax_C DFES_Cls.DFC_BattUSRCMin_C DFES_Cls.DFC_ComChksTCU1_C DFES_Cls.DFC_ComChksTCU11_C DFES_Cls.DFC_ComChksTCU12_C DFES_Cls.DFC_ComChksTCU13_C DFES_Cls.DFC_ComChksTCU2_C DFES_Cls.DFC_ComChksTCU3_C DFES_Cls.DFC_ComChksTCU4_C DFES_Cls.DFC_ComCntTCU1_C DFES_Cls.DFC_ComCntTCU11_C DFES_Cls.DFC_ComCntTCU12_C DFES_Cls.DFC_ComCntTCU13_C DFES_Cls.DFC_ComCntTCU2_C DFES_Cls.DFC_ComCntTCU3_C DFES_Cls.DFC_ComCntTCU4_C DFES_Cls.DFC_ComTOutTCU01_C DFES_Cls.DFC_ComTOutTCU02_C DFES_Cls.DFC_ComTOutTCU1_C DFES_Cls.DFC_ComTOutTCU11_C DFES_Cls.DFC_ComTOutTCU12_C DFES_Cls.DFC_ComTOutTCU13_C DFES_Cls.DFC_ComTOutTCU14_C DFES_Cls.DFC_ComTOutTCU2_C DFES_Cls.DFC_ComTOutTCU3_C DFES_Cls.DFC_ComTOutTCU4_C DFES_Cls.DFC_DevLibBattUHi_C DFES_Cls.DFC_DevLibBattULo_C DFES_Cls.DFC_EGRVlvFailSafeActv_C DFES_Cls.DFC_EGRVlvGovDvtCld_C DFES_Cls.DFC_EGRVlvPhysSRCMax_C DFES_Cls.DFC_EGRVlvPhysSRCMin_C DFES_Cls.DFC_FanDIOOL_0_C DFES_Cls.DFC_FanDIOOL_1_C DFES_Cls.DFC_FanDIOOvrTemp_0_C DFES_Cls.DFC_FanDIOOvrTemp_1_C DFES_Cls.DFC_FanDIOSCB_0_C DFES_Cls.DFC_FanDIOSCB_1_C DFES_Cls.DFC_FanDIOSCG_0_C DFES_Cls.DFC_FanDIOSCG_1_C DFES_Cls.DFC_MRlyDcOL_C DFES_Cls.DFC_MRlyDcSCB_C DFES_Cls.DFC_MRlyDcSCG_C DFES_Cls.DFC_PSPOL_C DFES_Cls.DFC_PSPOvrTemp_C DFES_Cls.DFC_PSPSCB_C DFES_Cls.DFC_PSPSCG_C DFES_Cls.DFC_T50Err_C DFES_Cls.DFC_ThrVlvLoBattB1_C DFES_Cls.DFC_UegoSigOperPlausS1B1_C DFES_Cls.DFC_VehVPhysRngHi_C DFES_Cls.DFC_VehVSclOutOL_C DFES_Cls.DFC_VehVSclOutOT_C DFES_Cls.DFC_VehVSclOutSCB_C DFES_Cls.DFC_VehVSclOutSCG_C DFES_Cls.DFC_VehVSigFL_C DFES_Cls.DFC_VehVSigFR_C DFES_Cls.DFC_VehVSigRL_C DFES_Cls.DFC_VehVSigRR_C DFES_Cls.DFC_VehVSnsrARngHi_C DFES_Cls.DFC_VehVSnsrBRngHi_C DFES_Cls.DFC_VehVSpdRtyDiag_C DFES_Cls.DFC_DHFHD_C DFES_Cls.DFC_InjVlv_DI_DcDc_C DFES_Cls.DFC_InjVlv_DI_NoLd_0_C DFES_Cls.DFC_InjVlv_DI_NoLd_1_C DFES_Cls.DFC_InjVlv_DI_NoLd_2_C DFES_Cls.DFC_InjVlv_DI_NoLd_3_C DFES_Cls.DFC_InjVlv_DI_ScBnk_0_C DFES_Cls.DFC_InjVlv_DI_ScBnk_1_C DFES_Cls.DFC_InjVlv_DI_ScBnk_2_C DFES_Cls.DFC_InjVlv_DI_ScBnk_3_C DFES_Cls.DFC_InjVlv_DI_ScCyl_0_C DFES_Cls.DFC_InjVlv_DI_ScCyl_1_C DFES_Cls.DFC_InjVlv_DI_ScCyl_2_C DFES_Cls.DFC_InjVlv_DI_ScCyl_3_C DFES_Cls.DFC_InjVlv_DI_ScHsLs_0_C DFES_Cls.DFC_InjVlv_DI_ScHsLs_1_C DFES_Cls.DFC_InjVlv_DI_ScHsLs_2_C DFES_Cls.DFC_InjVlv_DI_ScHsLs_3_C DFES_Cls.DFC_MfPsDiaOpenLoad1_C /end DEF_CHARACTERISTIC
 /begin IN_MEASUREMENT DSMAUX_stDCy DSM_TripChgAndClrFinshd /end IN_MEASUREMENT
 /begin OUT_MEASUREMENT DFES_stEepWrReq DFES_stErrLamp DFES_stErrLamp_msg DFES_stOutstate DFES_stPrgEvt_msg DSM_stProtdRamVld /end OUT_MEASUREMENT
 /begin LOC_MEASUREMENT DFES_ChkLstDltDemExCond_mp DFES_chkSt DFES_cnfSequence DFES_ctDef DFES_ctDel DFES_ctEntry DFES_ctFrq DFES_ctManuDef DFES_ctManuOk DFES_ctMIL DFES_ctOBD DFES_ctOBDPend DFES_ctOk DFES_ctPDTC DFES_ctSrv DFES_entrySt DFES_entryStPdtcStrd DFES_EnvBlock DFES_FrzFrVal DFES_idxSequence DFES_ISOFrstCnfDFC DFES_ISOFrstFailDFC DFES_ISORcntCnfDFC DFES_ISORcntFailDFC DFES_MonEvnt DFES_MonObjt DFES_MonParm DFES_MonPtr DFES_numDFC DFES_numDFCAck DFES_numDFCImdt DFES_numEntryAvl DFES_numEnvSize DFES_numExtdFrzFrmSize DFES_numFrzFrmSize DFES_OutLamps DFES_PDTCStore DFES_prioEntryImdt DFES_StateVisibility DFES_stChk DFES_stCounters DFES_stCtlSetting DFES_stDataImdt DFES_stDataImdtTrans DFES_stDTCRecUpdt DFES_stDTCStorage DFES_stEepBufChg DFES_stEntry DFES_stErrDia DFES_stInh DFES_stOrdImdt DFES_stOrdImdtTrans DFES_stPrgEvt DFES_stRepClrAftPwrFail DFES_xAsgnEnvAllDataSize /end LOC_MEASUREMENT
 FUNCTION_VERSION "30000.73.0_2.0.0" /end FUNCTION
/begin COMPU_METHOD B_TRUE "" TAB_VERB "%6.3" "" COMPU_TAB_REF B_TRUE /end COMPU_METHOD
/begin COMPU_VTAB B_TRUE "" TAB_VERB 2 0 "FALSE" 1 "TRUE" /end COMPU_VTAB
/begin COMPU_METHOD Dem_DTCGroup_Verb "" TAB_VERB "%6.3" "-" COMPU_TAB_REF Dem_DTCGroup_Verb /end COMPU_METHOD
/begin COMPU_VTAB Dem_DTCGroup_Verb "" TAB_VERB 6 0 "DEM_DTC_GROUP_NONE" 1 "DEM_DTC_GROUP_EMISSION_REL" 2 "DEM_DTC_GROUP_POWERTRAIN" 4 "DEM_DTC_GROUP_CHASSIS" 8 "DEM_DTC_GROUP_BODY" 16 "DEM_DTC_GROUP_NETWORK_COM" /end COMPU_VTAB
/begin COMPU_METHOD Dem_DTCSeverity_Verb "" TAB_VERB "%6.3" "-" COMPU_TAB_REF Dem_DTCSeverity_Verb /end COMPU_METHOD
/begin COMPU_VTAB Dem_DTCSeverity_Verb "" TAB_VERB 4 0 "DEM_SEVERITY_NO_SEVERITY" 32 "DEM_SEVERITY_MAINTENANCE_ONLY" 64 "DEM_SEVERITY_CHECK_AT_NEXT_HALT" 128 "DEM_SEVERITY_CHECK_IMMEDIATELY" /end COMPU_VTAB
/begin COMPU_METHOD DFCDFP_Verb "" TAB_VERB "%6.3" "-" COMPU_TAB_REF DFCDFP_Verb /end COMPU_METHOD
/begin COMPU_VTAB DFCDFP_Verb "" TAB_VERB 990 0 "NoEntry" 1 "DFC_AAVEmax" 2 "DFC_AAVEmin" 3 "DFC_AAVEsig" 4 "DFC_AltIOACGFailr" 5 "DFC_AltIOACGHiVltg" 6 "DFC_AltIOACGLoVltg" 7 "DFC_AltIOACGTHi" 8 "DFC_AltIODConnACG" 9 "DFC_BGOELWAF" 10 "DFC_BattUHiFailr" 11 "DFC_BattULoFailr" 12 "DFC_BrkBstPDriftHiErr" 13 "DFC_BrkBstPDriftLoErr" 14 "DFC_BrkBstPSnsrStuck" 15 "DFC_BrkMnSwtContOn" 16 "DFC_BrkMnSwtNotStp" 17 "DFC_BrkNpl" 18 "DFC_BrkRdntSwtContOn" 19 "DFC_BrkRdntSwtNotStp" 20 "DFC_Clth3ONStuck" 21 "DFC_Clth4OFFStuck" 22 "DFC_ClthOFFStuck" 23 "DFC_ClthONStuck" 24 "DFC_ClthStkFailInfo" 25 "DFC_ComACFailInfo" 26 "DFC_ComATFTValErr" 27 "DFC_ComATMILReq" 28 "DFC_ComAYCAChksum" 29 "DFC_ComAYCARingCnt" 30 "DFC_ComAYCATOut" 31 "DFC_ComAYCDChkSum" 32 "DFC_ComAYCDTOut" 33 "DFC_ComAYCFChksum" 34 "DFC_ComAYCFRingCnt" 35 "DFC_ComAYCFTOut" 36 "DFC_ComAYCGChksum" 37 "DFC_ComAYCGRingCnt" 38 "DFC_ComAYCGTOut" 39 "DFC_ComAYCIChkSum" 40 "DFC_ComAYCIRingCnt" 41 "DFC_ComAYCITOut" 42 "DFC_ComBCM1ChkSum" 43 "DFC_ComBCM1RingCnt" 44 "DFC_ComBCM1TOut" 45 "DFC_ComCANABusOffErr" 46 "DFC_ComCANBBusOffErr" 47 "DFC_ComCANCBusOffErr" 48 "DFC_ComCGW1ChkSum" 49 "DFC_ComCGW1RingCnt" 50 "DFC_ComCGW1TOut" 51 "DFC_ComConvBoostErr" 52 "DFC_ComConvSlipErr" 53 "DFC_ComDCDCPrfmncErr" 54 "DFC_ComDCDCTempWarn" 55 "DFC_ComEAT10Chksum" 56 "DFC_ComEAT10RingCnt" 57 "DFC_ComEAT10TOut" 58 "DFC_ComEAT11ChkSum" 59 "DFC_ComEAT11RingCnt" 60 "DFC_ComEAT11TOut" 61 "DFC_ComEAT12ChkSum" 62 "DFC_ComEAT12RingCnt" 63 "DFC_ComEAT12TOut" 64 "DFC_ComEAT13ChkSum" 65 "DFC_ComEAT13RingCnt" 66 "DFC_ComEAT13TOut" 67 "DFC_ComEAT1Chksum" 68 "DFC_ComEAT1RingCnt" 69 "DFC_ComEAT1TOut" 70 "DFC_ComEAT2ChkSum" 71 "DFC_ComEAT2RingCnt" 72 "DFC_ComEAT2TOut" 73 "DFC_ComEAT4ChkSum" 74 "DFC_ComEAT4RingCnt" 75 "DFC_ComEAT4TOut" 76 "DFC_ComEAT6Chksum" 77 "DFC_ComEAT6RingCnt" 78 "DFC_ComEAT6TOut" 79 "DFC_ComEAT7Chksum" 80 "DFC_ComEAT7RingCnt" 81 "DFC_ComEAT7TOut" 82 "DFC_ComEAT8Chksum" 83 "DFC_ComEAT8RingCnt" 84 "DFC_ComEAT8TOut" 85 "DFC_ComEATAChksum" 86 "DFC_ComEATARingCnt" 87 "DFC_ComEATATOut" 88 "DFC_ComEATBChkSum" 89 "DFC_ComEATBRingCnt" 90 "DFC_ComEATBTOut" 91 "DFC_ComEATCChksum" 92 "DFC_ComEATCRingCnt" 93 "DFC_ComEATCTOut" 94 "DFC_ComEPBBChkSum" 95 "DFC_ComEPBBRingCnt" 96 "DFC_ComEPBBTOut" 97 "DFC_ComEPBChksum" 98 "DFC_ComEPBTOut" 99 "DFC_ComEPBctRing" 100 "DFC_ComEPS1Chksum" 101 "DFC_ComEPS1RingCnt" 102 "DFC_ComEPS1TOut" 103 "DFC_ComEngCanRxErr" 104 "DFC_ComGrvySnsrErr" 105 "DFC_ComGwIMG1ChkSum" 106 "DFC_ComGwIMG1RingCnt" 107 "DFC_ComGwIMG1TOut" 108 "DFC_ComGwIMG3ChkSum" 109 "DFC_ComGwIMG3RingCnt" 110 "DFC_ComGwIMG3TOut" 111 "DFC_ComGwIMG4ChkSum" 112 "DFC_ComGwIMG4RingCnt" 113 "DFC_ComGwIMG4TOut" 114 "DFC_ComGwIMG5ChkSum" 115 "DFC_ComGwIMG5RingCnt" 116 "DFC_ComGwIMG5TOut" 117 "DFC_ComGwIMG6ChkSum" 118 "DFC_ComGwIMG6RingCnt" 119 "DFC_ComGwIMG6TOut" 120 "DFC_ComIDASBChksum" 121 "DFC_ComIDASBRingCnt" 122 "DFC_ComIDASBTOut" 123 "DFC_ComIMGMILReq" 124 "DFC_ComISSPrms" 125 "DFC_ComMETAChksum" 126 "DFC_ComMETAChksumPstDrv" 127 "DFC_ComMETARingCnt" 128 "DFC_ComMETARingCntPstDrv" 129 "DFC_ComMETATOut" 130 "DFC_ComMETATOutPstDrv" 131 "DFC_ComMETCChksum" 132 "DFC_ComMETCRingCnt" 133 "DFC_ComMETCTOut" 134 "DFC_ComMETDChksum" 135 "DFC_ComMETDRingCnt" 136 "DFC_ComMETDTOut" 137 "DFC_ComMETE2Chksum" 138 "DFC_ComMETE2RingCnt" 139 "DFC_ComMETE2TOut" 140 "DFC_ComMETFChksum" 141 "DFC_ComMETFRingCnt" 142 "DFC_ComMETFTOut" 143 "DFC_ComMETGChksum" 144 "DFC_ComMETGRingCnt" 145 "DFC_ComMETGTOut" 146 "DFC_ComMETH2Chksum" 147 "DFC_ComMETH2RingCnt" 148 "DFC_ComMETH2TOut" 149 "DFC_ComMETHChksum" 150 "DFC_ComMETHRingCnt" 151 "DFC_ComMETHTOut" 152 "DFC_ComMETIChksum" 153 "DFC_ComMETIRingCnt" 154 "DFC_ComMETITOut" 155 "DFC_ComMETKChksum" 156 "DFC_ComMETKRingCnt" 157 "DFC_ComMETKTOut" 158 "DFC_ComMETLChksum" 159 "DFC_ComMETLRingCnt" 160 "DFC_ComMETLTOut" 161 "DFC_ComMETMChksum" 162 "DFC_ComMETMRingCnt" 163 "DFC_ComMETMTOut" 164 "DFC_ComMETNChksum" 165 "DFC_ComMETNRingCnt" 166 "DFC_ComMETNTOut" 167 "DFC_ComMtrCom" 168 "DFC_ComPCUChkSum" 169 "DFC_ComPCURingCnt" 170 "DFC_ComPCUTOut" 171 "DFC_ComSRSAChksum" 172 "DFC_ComSRSARingCnt" 173 "DFC_ComSRSATOut" 174 "DFC_ComSRSBChksum" 175 "DFC_ComSRSBRingCnt" 176 "DFC_ComSRSBTOut" 177 "DFC_ComSRSChksum" 178 "DFC_ComSRSErr" 179 "DFC_ComSRSRingCnt" 180 "DFC_ComSRSTOut" 181 "DFC_ComVehSpdPndFltTCU" 182 "DFC_EbsChartcCurrErr" 183 "DFC_EbsSelfDiagErr" 184 "DFC_GEVlvPhaCsersIntkB1" 185 "DFC_GEVlvPhaPsOpenLoadIntkB1" 186 "DFC_GEVlvPhaPsShoToBattIntkB1" 187 "DFC_GEVlvPhaPsShoToGndIntkB1" 188 "DFC_GbxCANDigPlausErr" 189 "DFC_GbxNPos1SRCMax" 190 "DFC_GbxNPos1SRCMin" 191 "DFC_GbxNPos2SRCMax" 192 "DFC_GbxNPos2SRCMin" 193 "DFC_GbxNPosAlvChk" 194 "DFC_GbxNPosSyncErr" 195 "DFC_HEGOS2B1HtrPsMax" 196 "DFC_HEGOS2B1HtrPsMin" 197 "DFC_HEGOS2B1HtrPsSig" 198 "DFC_LinCSErrACG" 199 "DFC_LinCSErrAEV" 200 "DFC_LinCSErrDCDC" 201 "DFC_LinCSErrEBS" 202 "DFC_LinHdrTimeoutErrACG" 203 "DFC_LinHdrTimeoutErrAEV" 204 "DFC_LinHdrTimeoutErrDCDC" 205 "DFC_LinHdrTimeoutErrEBS" 206 "DFC_LinMsgTimeoutErrACG" 207 "DFC_LinMsgTimeoutErrAEV" 208 "DFC_LinMsgTimeoutErrDCDC" 209 "DFC_LinMsgTimeoutErrEBS" 210 "DFC_LinNoStrtComErr" 211 "DFC_LowPresOilP" 212 "DFC_MisfDetVWhlFrntLeOORHi" 213 "DFC_MisfDetVWhlFrntLeRatyHi" 214 "DFC_MisfDetVWhlFrntLeRatyLo" 215 "DFC_MisfDetVWhlFrntLeStuck" 216 "DFC_MisfDetVWhlFrntRiOORHi" 217 "DFC_MisfDetVWhlFrntRiRatyHi" 218 "DFC_MisfDetVWhlFrntRiRatyLo" 219 "DFC_MisfDetVWhlFrntRiStuck" 220 "DFC_MisfDetVWhlReLeOORHi" 221 "DFC_MisfDetVWhlReLeRatyHi" 222 "DFC_MisfDetVWhlReLeRatyLo" 223 "DFC_MisfDetVWhlReLeStuck" 224 "DFC_MisfDetVWhlReRiOORHi" 225 "DFC_MisfDetVWhlReRiRatyHi" 226 "DFC_MisfDetVWhlReRiRatyLo" 227 "DFC_MisfDetVWhlReRiStuck" 228 "DFC_MisfDetdVWhlFrntLePlaus" 229 "DFC_MisfDetdVWhlFrntRiPlaus" 230 "DFC_MisfDetdVWhlReLePlaus" 231 "DFC_MisfDetdVWhlReRiPlaus" 232 "DFC_PEnvSigRngMax" 233 "DFC_PEnvSigRngMin" 234 "DFC_StmFault" 235 "DFC_StrtCtOffPth" 236 "DFC_StrtCtlErr" 237 "DFC_StrtFault" 238 "DFC_StrtLckJudg1" 239 "DFC_StrtLckJudg2" 240 "DFC_StrtOL" 241 "DFC_StrtOL2" 242 "DFC_StrtSCB" 243 "DFC_StrtSCB2" 244 "DFC_StrtSCG" 245 "DFC_StrtSCG2" 246 "DFC_StrtStkRly1" 247 "DFC_StrtStkRly2" 248 "DFC_TEVEmax" 249 "DFC_TEVEmin" 250 "DFC_TEVEsig" 251 "DFC_UegoHeatrPrfmncLoS1B1" 252 "DFC_VehVAllPlaus" 253 "DFC_VehVNCSnsrElecFailr" 254 "DFC_VehVPlausCan" 255 "DFC_VehVPlausFco" 256 "DFC_VehVPlausPwr" 257 "DFC_VehVPlausV2N" 258 "DFC_VehVSpdSnsrAElecFailr" 259 "DFC_VehVSpdSnsrBElecFailr" 260 "DFC_ClthMax" 261 "DFC_IgnClPs_DevComErr" 262 "DFC_IgnClPs_LineOl_0" 263 "DFC_IgnClPs_LineOl_1" 264 "DFC_IgnClPs_LineOl_2" 265 "DFC_IgnClPs_LineOl_3" 266 "DFC_IgnClPs_LineScb_0" 267 "DFC_IgnClPs_LineScb_1" 268 "DFC_IgnClPs_LineScb_2" 269 "DFC_IgnClPs_LineScb_3" 270 "DFC_IgnClPs_LineScg_0" 271 "DFC_IgnClPs_LineScg_1" 272 "DFC_IgnClPs_LineScg_2" 273 "DFC_IgnClPs_LineScg_3" 274 "DFC_KRVEKOEVAB" 275 "DFC_KRVEKOEVAB0" 276 "DFC_KRVEKOEVAB1" 277 "DFC_KRVEKOEVAB2" 278 "DFC_KRVEKOEVAB3" 279 "DFC_UegoSigEcuAsicS1B1" 280 "DFC_UegoSigEcuComS1B1" 281 "DFC_UegoSigSnsrS1B1" 282 "DFC_UegoSigWireOlApesS1B1" 283 "DFC_UegoSigWireOlIpeS1B1" 284 "DFC_UegoSigWireOlReS1B1" 285 "DFC_UegoSigWireRCmpS1B1" 286 "DFC_UegoSigWireScbS1B1" 287 "DFC_UegoSigWireScgS1B1" 288 "DFC_AfsPhyRngHiB1" 289 "DFC_AfsPhyRngLoB1" 290 "DFC_AirCCmprOL" 291 "DFC_AirCCmprOvrTemp" 292 "DFC_AirCCmprSCB" 293 "DFC_AirCCmprSCG" 294 "DFC_AltErr" 295 "DFC_BattUSRCMax" 296 "DFC_BattUSRCMin" 297 "DFC_ComChksTCU1" 298 "DFC_ComChksTCU11" 299 "DFC_ComChksTCU12" 300 "DFC_ComChksTCU13" 301 "DFC_ComChksTCU2" 302 "DFC_ComChksTCU3" 303 "DFC_ComChksTCU4" 304 "DFC_ComCntTCU1" 305 "DFC_ComCntTCU11" 306 "DFC_ComCntTCU12" 307 "DFC_ComCntTCU13" 308 "DFC_ComCntTCU2" 309 "DFC_ComCntTCU3" 310 "DFC_ComCntTCU4" 311 "DFC_ComTOutTCU01" 312 "DFC_ComTOutTCU02" 313 "DFC_ComTOutTCU1" 314 "DFC_ComTOutTCU11" 315 "DFC_ComTOutTCU12" 316 "DFC_ComTOutTCU13" 317 "DFC_ComTOutTCU14" 318 "DFC_ComTOutTCU2" 319 "DFC_ComTOutTCU3" 320 "DFC_ComTOutTCU4" 321 "DFC_DevLibBattUHi" 322 "DFC_DevLibBattULo" 323 "DFC_EGRVlvFailSafeActv" 324 "DFC_EGRVlvGovDvtCld" 325 "DFC_EGRVlvPhysSRCMax" 326 "DFC_EGRVlvPhysSRCMin" 327 "DFC_FanDIOOL_0" 328 "DFC_FanDIOOL_1" 329 "DFC_FanDIOOvrTemp_0" 330 "DFC_FanDIOOvrTemp_1" 331 "DFC_FanDIOSCB_0" 332 "DFC_FanDIOSCB_1" 333 "DFC_FanDIOSCG_0" 334 "DFC_FanDIOSCG_1" 335 "DFC_MRlyDcOL" 336 "DFC_MRlyDcSCB" 337 "DFC_MRlyDcSCG" 338 "DFC_PSPOL" 339 "DFC_PSPOvrTemp" 340 "DFC_PSPSCB" 341 "DFC_PSPSCG" 342 "DFC_T50Err" 343 "DFC_ThrVlvLoBattB1" 344 "DFC_UegoSigOperPlausS1B1" 345 "DFC_VehVPhysRngHi" 346 "DFC_VehVSclOutOL" 347 "DFC_VehVSclOutOT" 348 "DFC_VehVSclOutSCB" 349 "DFC_VehVSclOutSCG" 350 "DFC_VehVSigFL" 351 "DFC_VehVSigFR" 352 "DFC_VehVSigRL" 353 "DFC_VehVSigRR" 354 "DFC_VehVSnsrARngHi" 355 "DFC_VehVSnsrBRngHi" 356 "DFC_VehVSpdRtyDiag" 357 "DFC_DHFHD" 358 "DFC_InjVlv_DI_DcDc" 359 "DFC_InjVlv_DI_NoLd_0" 360 "DFC_InjVlv_DI_NoLd_1" 361 "DFC_InjVlv_DI_NoLd_2" 362 "DFC_InjVlv_DI_NoLd_3" 363 "DFC_InjVlv_DI_ScBnk_0" 364 "DFC_InjVlv_DI_ScBnk_1" 365 "DFC_InjVlv_DI_ScBnk_2" 366 "DFC_InjVlv_DI_ScBnk_3" 367 "DFC_InjVlv_DI_ScCyl_0" 368 "DFC_InjVlv_DI_ScCyl_1" 369 "DFC_InjVlv_DI_ScCyl_2" 370 "DFC_InjVlv_DI_ScCyl_3" 371 "DFC_InjVlv_DI_ScHsLs_0" 372 "DFC_InjVlv_DI_ScHsLs_1" 373 "DFC_InjVlv_DI_ScHsLs_2" 374 "DFC_InjVlv_DI_ScHsLs_3" 375 "DFC_MfPsDiaOpenLoad1" 376 "DFC_MfPsDiaScHiS1" 377 "DFC_MfPsDiaScHiSLowS1" 378 "DFC_MfPsDiaScLowS1" 379 "DFC_ACEvpTPhysRngHi" 380 "DFC_ACEvpTPhysRngLo" 381 "DFC_ACEvpTSRCMax" 382 "DFC_ACEvpTSRCMin" 383 "DFC_AfsRawSigRngHiB1" 384 "DFC_AfsRawSigRngLoB1" 385 "DFC_AfsSnsrErrB1" 386 "DFC_AirCClntPAnaSRCMax" 387 "DFC_AirCClntPAnaSRCMin" 388 "DFC_AirCSwtNpl" 389 "DFC_AirCSwtSig" 390 "DFC_Brk" 391 "DFC_BrkBstSensSCB" 392 "DFC_BrkBstSensSCG" 393 "DFC_BrkSig" 394 "DFC_ClthSig" 395 "DFC_EGRVlvCurrLim" 396 "DFC_EGRVlvOL" 397 "DFC_EGRVlvOvrTemp" 398 "DFC_EGRVlvSCB" 399 "DFC_EGRVlvSCG" 400 "DFC_EGRVlvSRCMax" 401 "DFC_EGRVlvSRCMin" 402 "DFC_HLSDemOvhtEngLim" 403 "DFC_OilPSwmpSRCMax" 404 "DFC_OilPSwmpSRCMin" 405 "DFC_PIntkVUsLineHiB1" 406 "DFC_PIntkVUsLineLoB1" 407 "DFC_VehVPhysRngLo" 408 "DFC_VehVSigCan" 409 "DFC_VehVSigCanSafe" 410 "DFC_VlvLftFbOilPSnsrIntk11SRCMax" 411 "DFC_VlvLftFbOilPSnsrIntk11SRCMin" 412 "DFC_ClthNpl" 413 "DFC_GbxPNPosnDrvCdn" 414 "DFC_GbxPNPosnPlausy" 415 "DFC_AfsSigErrLineHiB1" 416 "DFC_AfsSigErrLineLoB1" 417 "DFC_PEnvCcMax" 418 "DFC_PEnvCcMin" 419 "DFC_PEnvRngChkMax" 420 "DFC_PEnvRngChkMin" 421 "DFC_PEnvSnsrPlaus" 422 "DFC_UEGOHeatrRlyPsOLS1B1" 423 "DFC_UEGOHeatrRlyPsSCBS1B1" 424 "DFC_UEGOHeatrRlyPsSCGS1B1" 425 "DFC_UegoHeatrWireOlS1B1" 426 "DFC_UegoHeatrWireScbS1B1" 427 "DFC_UegoHeatrWireScgS1B1" 428 "DFC_KnDetSens1PortAMax" 429 "DFC_KnDetSens1PortAMin" 430 "DFC_KnDetSens1PortBMax" 431 "DFC_KnDetSens1PortBMin" 432 "DFC_Clth2ONStuck" 433 "DFC_Clth2ONStuckLdc" 434 "DFC_Clth3ONStuckLdc" 435 "DFC_Clth3ONStuckPostDrv" 436 "DFC_Clth4ONStuck" 437 "DFC_Clth4ONStuckLdc" 438 "DFC_ComBCMUnit" 439 "DFC_ComDLCTCU01" 440 "DFC_ComDLCTCU02" 441 "DFC_ComDLCTCU1" 442 "DFC_ComDLCTCU11" 443 "DFC_ComDLCTCU12" 444 "DFC_ComDLCTCU13" 445 "DFC_ComDLCTCU14" 446 "DFC_ComDLCTCU2" 447 "DFC_ComDLCTCU3" 448 "DFC_ComDLCTCU4" 449 "DFC_ComEPSUnit" 450 "DFC_ComIDASBUnit" 451 "DFC_ComIMGUnit" 452 "DFC_ComMETUnit" 453 "DFC_ComSRSUnit" 454 "DFC_ComVSAUnit" 455 "DFC_EbsSocFlt" 456 "DFC_I14229VINErr" 457 "DFC_InjCatHeatgErr" 458 "DFC_InjSysMulInjDiagErr" 459 "DFC_LLRHmax" 460 "DFC_LLRHmin" 461 "DFC_LLRHnpl" 462 "DFC_LLRKHmax" 463 "DFC_LLRKHmin" 464 "DFC_LLRKHnpl" 465 "DFC_LinACGUnit" 466 "DFC_LinAEVUnit" 467 "DFC_LinEBSUnit" 468 "DFC_RoughRoad" 469 "DFC_SiaEEPRdErr" 470 "DFC_SiaEEPWrngCod" 471 "DFC_UegoHeatrStrtS1B1" 472 "DFC_BusDiagCANAPPLBusOff" 473 "DFC_BusDiagCANCANCBusOff" 474 "DFC_BusDiagCANVEHICLEBusOff" 475 "DFC_RBA_IODIAGPWR_rba_IoExtCy329_SignalVltSply_0" 476 "DFC_RBA_IODIAGPWR_rba_IoExtCy329_SignalVltSply_0OT" 477 "DFC_RBA_IODIAGPWR_rba_IoExtCy329_SignalVltSply_0OV" 478 "DFC_RBA_IODIAGPWR_rba_IoExtCy329_SignalVltSply_0SCG" 479 "DFC_RBA_IODIAGPWR_rba_IoExtCy329_SignalVltSply_0UV" 480 "DFC_RBA_IODIAGPWR_rba_IoExtCy329_SignalVltSply_1" 481 "DFC_RBA_IODIAGPWR_rba_IoExtCy329_SignalVltSply_1OT" 482 "DFC_RBA_IODIAGPWR_rba_IoExtCy329_SignalVltSply_1OV" 483 "DFC_RBA_IODIAGPWR_rba_IoExtCy329_SignalVltSply_1SCG" 484 "DFC_RBA_IODIAGPWR_rba_IoExtCy329_SignalVltSply_1UV" 485 "DFC_RBA_IODIAGPWR_rba_IoExtCy329_SignalVltSply_2" 486 "DFC_RBA_IODIAGPWR_rba_IoExtCy329_SignalVltSply_2OT" 487 "DFC_RBA_IODIAGPWR_rba_IoExtCy329_SignalVltSply_2OV" 488 "DFC_RBA_IODIAGPWR_rba_IoExtCy329_SignalVltSply_2SCG" 489 "DFC_RBA_IODIAGPWR_rba_IoExtCy329_SignalVltSply_2UV" 490 "DFC_CAN_E_TIMEOUT" 491 "DFC_LIN_E_TIMEOUT" 492 "DFC_MRlyOL" 493 "DFC_MRlySCB" 494 "DFC_MRlySCG" 495 "DFC_rba_MultiStackTrace_Threshold" 496 "DFC_BSWM_E_ACTION_FAILED" 497 "DFC_BSWM_E_INTRPTQUEUE_FULL" 498 "DFC_RBA_IOEXTLIB_KEEPALIVE_DRV" 499 "DFC_RBA_IOEXTLIB_KEEPALIVE_INI" 500 "DFC_rba_IoSigRtc_StopCounter" 501 "DFC_rba_MRly_Diag_Stk_Event" 502 "DFC_rba_MemDiag_MemReadErr" 503 "DFC_rba_MemDiag_MemWrErr" 504 "DFC_rba_SyC_IrrSwOffTrigEngRun_Event" 505 "DFC_rba_T15_Diag_ComInVld_Event" 506 "DFC_rba_T15_Diag_ComOff_HwOn_Event" 507 "DFC_rba_T15_Diag_ComOn_HwOff_Event" 508 "DFC_AAVmin" 509 "DFC_AGRSUS" 510 "DFC_AfsPlausDiagHi" 511 "DFC_AfsPlausDiagLo" 512 "DFC_AfsVrntDiagErrB1" 513 "DFC_AppAllSnsrDfct" 514 "DFC_BBKRnldg" 515 "DFC_BBKRsyne" 516 "DFC_BattUStdbyDiaOL" 517 "DFC_BigLeakIntkMnfldEmiInfl" 518 "DFC_BlkdLineTank" 519 "DFC_BrkMnSwtContOnWarnLmp" 520 "DFC_BrkMnSwtNotStpWarnLmp" 521 "DFC_BrkRdntSwtContOnWarnLmp" 522 "DFC_BrkRdntSwtNotStpWarnLmp" 523 "DFC_CEngDsTColdStrtMax" 524 "DFC_CEngDsTColdStrtMin" 525 "DFC_CEngDsTImps" 526 "DFC_CEngDsTPlausHSC" 527 "DFC_CEngDsTPlausLSC" 528 "DFC_CEngDsTPlausSTC" 529 "DFC_CEngDsTSRCMax" 530 "DFC_CEngDsTSRCMin" 531 "DFC_CEngDsTSig" 532 "DFC_CEngUsTColdStrtMax" 533 "DFC_CEngUsTColdStrtMin" 534 "DFC_CEngUsTLooseCnctn" 535 "DFC_CEngUsTSRCMax" 536 "DFC_CEngUsTSRCMin" 537 "DFC_ComDCDCACCFailr" 538 "DFC_DCDCFltDet" 539 "DFC_DKRSA" 540 "DFC_DKVSmax" 541 "DFC_DKnpl" 542 "DFC_DSKVRmax" 543 "DFC_DSKVRmin" 544 "DFC_DSKVRnpl" 545 "DFC_DSKVRsig" 546 "DFC_DSKVSsig" 547 "DFC_DSSmax" 548 "DFC_DSTDmax" 549 "DFC_DSTEmax" 550 "DFC_DSTEmin" 551 "DFC_DSTOFmax" 552 "DFC_DSTRmax" 553 "DFC_DSTRmin" 554 "DFC_DSTRnpl" 555 "DFC_DSTRsig" 556 "DFC_DSTTI" 557 "DFC_DSUmax" 558 "DFC_DiagCpv1DteskLoLoadStuckClsd" 559 "DFC_DiagCpv1DteskLoLoadStuckOpen" 560 "DFC_EGRVlvDrftClsd" 561 "DFC_EGRVlvDrftOpn" 562 "DFC_EGRVlvJamVlvClsd" 563 "DFC_EGRVlvJamVlvOpn" 564 "DFC_EGRVlvSprgBrk" 565 "DFC_EGRVlvTempMdlEEPErr" 566 "DFC_EGRVlvTmpErr" 567 "DFC_EGSDUS2B1LtrDly" 568 "DFC_EGSDUS2B1LtrPT1" 569 "DFC_EGSDUS2B1RtlDly" 570 "DFC_EGSDUS2B1RtlPT1" 571 "DFC_EGSDUS2B1TarLean" 572 "DFC_EGSDUS2B1TarRich" 573 "DFC_EONVmax" 574 "DFC_ETAKHLmax" 575 "DFC_ETAKHTmax" 576 "DFC_ETHSEmax" 577 "DFC_ETHSEmin" 578 "DFC_ETHSFmax" 579 "DFC_ETHSFmin" 580 "DFC_ETHSFsig" 581 "DFC_ETHSNPWmax" 582 "DFC_ETHSNPWmin" 583 "DFC_ETHSNPWsig" 584 "DFC_ETHSPLnpl" 585 "DFC_ETHSTPLnpl" 586 "DFC_EngICO" 587 "DFC_EngPrtOvrSpdMon" 588 "DFC_EpmCaSI1ErrSig" 589 "DFC_EpmCaSI1MntErr" 590 "DFC_EpmCaSI1NoSigMax" 591 "DFC_EpmCaSI1NoSigMin" 592 "DFC_EpmCaSI1OfsErr" 593 "DFC_EpmCrSDGI" 594 "DFC_EpmCrSErrSig" 595 "DFC_EpmCrSNoSig" 596 "DFC_EtaEngIdleNonCsers" 597 "DFC_EtaEngPtlNonCsers" 598 "DFC_FRAmax" 599 "DFC_FRAmin" 600 "DFC_FSTEmax" 601 "DFC_FSTEmin" 602 "DFC_FSTRmax" 603 "DFC_FSTRmin" 604 "DFC_FSTRnpl" 605 "DFC_FSTmax" 606 "DFC_FTDLAmax" 607 "DFC_FTDLAmin" 608 "DFC_FuPHiSnsrEleclmax" 609 "DFC_FuPHiSnsrEleclmin" 610 "DFC_FuPHiSnsrEleclnpl" 611 "DFC_FuPHiSnsrURngMax" 612 "DFC_FuPHiSnsrURngMin" 613 "DFC_FuSnsrPhyRngMaxErr" 614 "DFC_FuSnsrPhyRngMinErr" 615 "DFC_GEVlvLockPinDiagIntkB1" 616 "DFC_GEVlvPhaSlowIntkB1" 617 "DFC_GEVlvPhaTargIntkB1" 618 "DFC_GbxRvsSwtStk" 619 "DFC_HDRKHmax" 620 "DFC_HDRKHmin" 621 "DFC_HDRPLmax" 622 "DFC_HDRPLmin" 623 "DFC_HDRmax" 624 "DFC_HDRmin" 625 "DFC_HEGOS2B1ElecMax" 626 "DFC_HEGOS2B1ElecMin" 627 "DFC_HEGOS2B1ElecSig" 628 "DFC_HEGOS2B1HtgNpl" 629 "DFC_HEV00max" 630 "DFC_HEV01max" 631 "DFC_HEV02max" 632 "DFC_HEV03max" 633 "DFC_HEVE0max" 634 "DFC_HEVE1max" 635 "DFC_HFMmax" 636 "DFC_HiPSysHiPMaxLimExcdd" 637 "DFC_IVGdiCtlCvoErrMax_0" 638 "DFC_IVGdiCtlCvoErrMax_1" 639 "DFC_IVGdiCtlCvoErrMax_2" 640 "DFC_IVGdiCtlCvoErrMax_3" 641 "DFC_IVGdiCtlCvoErrMin_0" 642 "DFC_IVGdiCtlCvoErrMin_1" 643 "DFC_IVGdiCtlCvoErrMin_2" 644 "DFC_IVGdiCtlCvoErrMin_3" 645 "DFC_IVGdiCtlCvoErrMinMax" 646 "DFC_IVGdiCtlCvoSigPlausErrSmrCdn" 647 "DFC_IVGdiCtl_CvoErr" 648 "DFC_IVGdiCtl_CvoSigPlaus_0" 649 "DFC_IVGdiCtl_CvoSigPlaus_1" 650 "DFC_IVGdiCtl_CvoSigPlaus_2" 651 "DFC_IVGdiCtl_CvoSigPlaus_3" 652 "DFC_IntkAirTAirFltDsCrssMax" 653 "DFC_IntkAirTAirFltDsCrssMin" 654 "DFC_IntkAirTAirFltDsHSCMax" 655 "DFC_IntkAirTAirFltDsImps" 656 "DFC_IntkAirTAirFltDsPRCMax" 657 "DFC_IntkAirTAirFltDsPRCMin" 658 "DFC_IntkAirTAirFltDsSRCMax" 659 "DFC_IntkAirTAirFltDsSRCMin" 660 "DFC_IntkAirTAirFltDsSTC" 661 "DFC_IntkAirTIntkMnfldCrssMax" 662 "DFC_IntkAirTIntkMnfldCrssMin" 663 "DFC_IntkAirTIntkMnfldHSCMax" 664 "DFC_IntkAirTIntkMnfldImps" 665 "DFC_IntkAirTIntkMnfldPRCMax" 666 "DFC_IntkAirTIntkMnfldPRCMin" 667 "DFC_IntkAirTIntkMnfldSRCMax" 668 "DFC_IntkAirTIntkMnfldSRCMin" 669 "DFC_IntkAirTIntkMnfldSTC" 670 "DFC_KRREGRLMX" 671 "DFC_KRVEKOCVLCI" 672 "DFC_KRVEKOENCHMT" 673 "DFC_KRVEKOENCHMT0" 674 "DFC_KRVEKOENCHMT1" 675 "DFC_KRVEKOENCHMT2" 676 "DFC_KRVEKOENCHMT3" 677 "DFC_KRVEKOENCHMT4" 678 "DFC_KRVEKOENCHMT5" 679 "DFC_KRVEKOENCHMT6" 680 "DFC_KRVEKOENCHMT7" 681 "DFC_KRVEKORLMX" 682 "DFC_KRVEKORLMXL" 683 "DFC_KS1max" 684 "DFC_KS1min" 685 "DFC_LMmax" 686 "DFC_LZSRnpl" 687 "DFC_LamDynDiagS1B1" 688 "DFC_LeakIntkMnfldEmiInfl" 689 "DFC_LinFrameErrDCDC" 690 "DFC_LinOverrunErrDCDC" 691 "DFC_MD00max" 692 "DFC_MDBmax" 693 "DFC_MDCat" 694 "DFC_MDCatCrit" 695 "DFC_MDCatCurr" 696 "DFC_MDCyl_0" 697 "DFC_MDCyl_1" 698 "DFC_MDCyl_2" 699 "DFC_MDCyl_3" 700 "DFC_MDEmi" 701 "DFC_MDEmiStrt" 702 "DFC_MDFco" 703 "DFC_MDMpl" 704 "DFC_MDSegTiAdpn" 705 "DFC_MDmax" 706 "DFC_MFuOilMax" 707 "DFC_MOXEMM_SMU_ALM0_0" 708 "DFC_MOXEMM_SMU_ALM0_1" 709 "DFC_MOXEMM_SMU_ALM0_10" 710 "DFC_MOXEMM_SMU_ALM0_11" 711 "DFC_MOXEMM_SMU_ALM0_13" 712 "DFC_MOXEMM_SMU_ALM0_14" 713 "DFC_MOXEMM_SMU_ALM0_2" 714 "DFC_MOXEMM_SMU_ALM0_22" 715 "DFC_MOXEMM_SMU_ALM0_23" 716 "DFC_MOXEMM_SMU_ALM0_4" 717 "DFC_MOXEMM_SMU_ALM0_5" 718 "DFC_MOXEMM_SMU_ALM0_7" 719 "DFC_MOXEMM_SMU_ALM0_8" 720 "DFC_MOXEMM_SMU_ALM10_16" 721 "DFC_MOXEMM_SMU_ALM10_17" 722 "DFC_MOXEMM_SMU_ALM10_21" 723 "DFC_MOXEMM_SMU_ALM11_0" 724 "DFC_MOXEMM_SMU_ALM11_1" 725 "DFC_MOXEMM_SMU_ALM11_2" 726 "DFC_MOXEMM_SMU_ALM11_3" 727 "DFC_MOXEMM_SMU_ALM11_4" 728 "DFC_MOXEMM_SMU_ALM11_5" 729 "DFC_MOXEMM_SMU_ALM11_8" 730 "DFC_MOXEMM_SMU_ALM11_9" 731 "DFC_MOXEMM_SMU_ALM1_0" 732 "DFC_MOXEMM_SMU_ALM1_1" 733 "DFC_MOXEMM_SMU_ALM1_10" 734 "DFC_MOXEMM_SMU_ALM1_11" 735 "DFC_MOXEMM_SMU_ALM1_13" 736 "DFC_MOXEMM_SMU_ALM1_14" 737 "DFC_MOXEMM_SMU_ALM1_2" 738 "DFC_MOXEMM_SMU_ALM1_22" 739 "DFC_MOXEMM_SMU_ALM1_23" 740 "DFC_MOXEMM_SMU_ALM1_4" 741 "DFC_MOXEMM_SMU_ALM1_5" 742 "DFC_MOXEMM_SMU_ALM1_7" 743 "DFC_MOXEMM_SMU_ALM1_8" 744 "DFC_MOXEMM_SMU_ALM21_0" 745 "DFC_MOXEMM_SMU_ALM21_16" 746 "DFC_MOXEMM_SMU_ALM21_3" 747 "DFC_MOXEMM_SMU_ALM2_1" 748 "DFC_MOXEMM_SMU_ALM2_10" 749 "DFC_MOXEMM_SMU_ALM2_11" 750 "DFC_MOXEMM_SMU_ALM2_13" 751 "DFC_MOXEMM_SMU_ALM2_14" 752 "DFC_MOXEMM_SMU_ALM2_22" 753 "DFC_MOXEMM_SMU_ALM2_23" 754 "DFC_MOXEMM_SMU_ALM2_4" 755 "DFC_MOXEMM_SMU_ALM2_5" 756 "DFC_MOXEMM_SMU_ALM2_7" 757 "DFC_MOXEMM_SMU_ALM2_8" 758 "DFC_MOXEMM_SMU_ALM6_0" 759 "DFC_MOXEMM_SMU_ALM6_11" 760 "DFC_MOXEMM_SMU_ALM6_12" 761 "DFC_MOXEMM_SMU_ALM6_14" 762 "DFC_MOXEMM_SMU_ALM6_15" 763 "DFC_MOXEMM_SMU_ALM6_17" 764 "DFC_MOXEMM_SMU_ALM6_18" 765 "DFC_MOXEMM_SMU_ALM6_20" 766 "DFC_MOXEMM_SMU_ALM6_21" 767 "DFC_MOXEMM_SMU_ALM6_25" 768 "DFC_MOXEMM_SMU_ALM6_4" 769 "DFC_MOXEMM_SMU_ALM6_5" 770 "DFC_MOXEMM_SMU_ALM6_7" 771 "DFC_MOXEMM_SMU_ALM6_8" 772 "DFC_MOXEMM_SMU_ALM7_1" 773 "DFC_MOXEMM_SMU_ALM7_12" 774 "DFC_MOXEMM_SMU_ALM7_13" 775 "DFC_MOXEMM_SMU_ALM7_14" 776 "DFC_MOXEMM_SMU_ALM7_15" 777 "DFC_MOXEMM_SMU_ALM7_16" 778 "DFC_MOXEMM_SMU_ALM7_17" 779 "DFC_MOXEMM_SMU_ALM7_2" 780 "DFC_MOXEMM_SMU_ALM7_20" 781 "DFC_MOXEMM_SMU_ALM7_25" 782 "DFC_MOXEMM_SMU_ALM7_26" 783 "DFC_MOXEMM_SMU_ALM7_28" 784 "DFC_MOXEMM_SMU_ALM7_29" 785 "DFC_MOXEMM_SMU_ALM7_30" 786 "DFC_MOXEMM_SMU_ALM7_31" 787 "DFC_MOXEMM_SMU_ALM8_0" 788 "DFC_MOXEMM_SMU_ALM8_1" 789 "DFC_MOXEMM_SMU_ALM8_10" 790 "DFC_MOXEMM_SMU_ALM8_11" 791 "DFC_MOXEMM_SMU_ALM8_12" 792 "DFC_MOXEMM_SMU_ALM8_16" 793 "DFC_MOXEMM_SMU_ALM8_18" 794 "DFC_MOXEMM_SMU_ALM8_2" 795 "DFC_MOXEMM_SMU_ALM8_3" 796 "DFC_MOXEMM_SMU_ALM8_31" 797 "DFC_MOXEMM_SMU_ALM8_4" 798 "DFC_MOXEMM_SMU_ALM9_0" 799 "DFC_MOXEMM_SMU_ALM9_15" 800 "DFC_MOXEMM_SMU_ALM9_3" 801 "DFC_MoCADCNTP" 802 "DFC_MoCADCTst" 803 "DFC_MoCSOPICO" 804 "DFC_MoFAPP" 805 "DFC_MoFAirFilgPrdc" 806 "DFC_MoFAirFlCtOffGdi" 807 "DFC_MoFAirFlCylGdi" 808 "DFC_MoFAirFlFF" 809 "DFC_MoFAirFlIn" 810 "DFC_MoFAirFlMixCtlGdiChkAirFl" 811 "DFC_MoFAirFlMixCtlGdiChkCtrl" 812 "DFC_MoFAirFlMode" 813 "DFC_MoFESpd" 814 "DFC_MoFIACo" 815 "DFC_MoFICOL1" 816 "DFC_MoFICOL2" 817 "DFC_MoFStrt" 818 "DFC_MoFTrqCmp" 819 "DFC_MoFTrqCmpMax" 820 "DFC_MoFTrqCmpMin" 821 "DFC_MoFVarPostBldSel" 822 "DFC_MoXEMMHwLTMCUFW" 823 "DFC_MoXEMMHwLTMonBIST" 824 "DFC_MoXEMMHwLTRegMonTest" 825 "DFC_MoXEMMHwLTStbySMUAlvTest" 826 "DFC_MoXEMMHwLTTempSens" 827 "DFC_MoXEMMHwLTUCBCfg" 828 "DFC_NWSEmax" 829 "DFC_NWSmax" 830 "DFC_OCWDAABEActv" 831 "DFC_OCWDACom" 832 "DFC_OCWDAErrPin" 833 "DFC_OCWDAOvrVltg" 834 "DFC_ORAmax" 835 "DFC_ORAmin" 836 "DFC_OilPPlaus" 837 "DFC_PLLSUmax" 838 "DFC_PLLSUmin" 839 "DFC_PSR1max" 840 "DFC_PSRBmax" 841 "DFC_PSRBmin" 842 "DFC_PSRPmax" 843 "DFC_PSRPmin" 844 "DFC_PSRPsig" 845 "DFC_PSRmax" 846 "DFC_PUmax" 847 "DFC_P_VSE11_OL" 848 "DFC_P_VSE11_SCB" 849 "DFC_P_VSE11_SCG" 850 "DFC_PhyHighAPP1" 851 "DFC_PhyHighAPP2" 852 "DFC_PhyLowAPP1" 853 "DFC_PhyLowAPP2" 854 "DFC_SRCHighAPP1" 855 "DFC_SRCHighAPP2" 856 "DFC_SRCLowAPP1" 857 "DFC_SRCLowAPP2" 858 "DFC_SSpMon2" 859 "DFC_STHDRmax" 860 "DFC_SWReset_0" 861 "DFC_SWReset_1" 862 "DFC_SWReset_2" 863 "DFC_SyncAPP" 864 "DFC_TANKLnpl" 865 "DFC_TAmax_Dummy" 866 "DFC_TESFmax" 867 "DFC_TESGmax" 868 "DFC_TKAEmax" 869 "DFC_TKAEmin" 870 "DFC_TKARmax" 871 "DFC_TKARnpl" 872 "DFC_TMmax_Dummy" 873 "DFC_TUMmax_Dummy" 874 "DFC_TWCDPriCatB1" 875 "DFC_ThrVlvClsdPosnFirstOffsLrnImpoB1" 876 "DFC_ThrVlvClsdPosnOffsLrnImpoB1" 877 "DFC_ThrVlvClsdPosnOffsLrnMaxB1" 878 "DFC_ThrVlvClsdPosnOffsLrnMinB1" 879 "DFC_ThrVlvCtrlDeB1" 880 "DFC_ThrVlvDycB1" 881 "DFC_ThrVlvLimpAirPosnMaxAbsltDriftB1" 882 "DFC_ThrVlvLimpAirPosnMaxB1" 883 "DFC_ThrVlvLimpAirPosnMaxRelDriftB1" 884 "DFC_ThrVlvLimpAirPosnMinB1" 885 "DFC_ThrVlvOpenLoadB1" 886 "DFC_ThrVlvOpenSprgB1" 887 "DFC_ThrVlvOpenSprgSprdB1" 888 "DFC_ThrVlvOpenSprgTwnB1" 889 "DFC_ThrVlvOverTB1" 890 "DFC_ThrVlvRetSprgB1" 891 "DFC_ThrVlvRetSprgSprdB1" 892 "DFC_ThrVlvRetSprgTwnB1" 893 "DFC_ThrVlvSens1MaxB1" 894 "DFC_ThrVlvSens1NplB1" 895 "DFC_ThrVlvSens2MaxB1" 896 "DFC_ThrVlvSens2MinB1" 897 "DFC_ThrVlvSens2NplB1" 898 "DFC_ThrVlvShoCircB1" 899 "DFC_ThrVlvSpiErrB1" 900 "DFC_ThrvlvSens1MinB1" 901 "DFC_TiOffTBasdChkFast" 902 "DFC_TiOffTBasdChkSlow" 903 "DFC_UEGOSnsrMntdS1B1" 904 "DFC_VehVSig" 905 "DFC_VlvLftFbSwtIntk11SpclFail" 906 "DFC_VlvLftFbSwtIntk11StdFail" 907 "DFP_AAA" 908 "DFP_AAV" 909 "DFP_AAVE" 910 "DFP_AGRE" 911 "DFP_AGRS" 912 "DFP_DHFHD" 913 "DFP_DK" 914 "DFP_DK1P" 915 "DFP_DK2P" 916 "DFP_DKVS" 917 "DFP_DSKV" 918 "DFP_DSKVR" 919 "DFP_DSKVS" 920 "DFP_DSS" 921 "DFP_DSU" 922 "DFP_DVEE" 923 "DFP_DVEF" 924 "DFP_DVEFO" 925 "DFP_DVEL" 926 "DFP_DVEN" 927 "DFP_DVER" 928 "DFP_DVEU" 929 "DFP_DVEUB" 930 "DFP_DVEUW" 931 "DFP_DYLSU" 932 "DFP_ENWCS" 933 "DFP_ENWS" 934 "DFP_ENWSE" 935 "DFP_EONV" 936 "DFP_FP1P" 937 "DFP_FP2P" 938 "DFP_FRA" 939 "DFP_FST" 940 "DFP_FSTE" 941 "DFP_FSTR" 942 "DFP_FTDLA" 943 "DFP_HDR" 944 "DFP_HDRKH" 945 "DFP_HDRPL" 946 "DFP_HFM" 947 "DFP_HSH" 948 "DFP_HSHE" 949 "DFP_KAT" 950 "DFP_KPE" 951 "DFP_KS1" 952 "DFP_LLRH" 953 "DFP_LLRKH" 954 "DFP_LM" 955 "DFP_LSH" 956 "DFP_LZSR" 957 "DFP_MD" 958 "DFP_NWS" 959 "DFP_NWSE" 960 "DFP_ORA" 961 "DFP_PLLSU" 962 "DFP_PSR" 963 "DFP_PSR1" 964 "DFP_PSRB" 965 "DFP_PSRE" 966 "DFP_PSRP" 967 "DFP_PU" 968 "DFP_PUE" 969 "DFP_PUPL" 970 "DFP_PUR" 971 "DFP_STHDR" 972 "DFP_TA" 973 "DFP_TANKL" 974 "DFP_TANLCS" 975 "DFP_TANLPRC" 976 "DFP_TANLR" 977 "DFP_TASRCS" 978 "DFP_TASRE" 979 "DFP_TASRPRC" 980 "DFP_TASRR" 981 "DFP_TESF" 982 "DFP_TESG" 983 "DFP_TM" 984 "DFP_TMCS" 985 "DFP_TME" 986 "DFP_TMP" 987 "DFP_UB" 988 "DFP_VFZ" 989 "DFP_ZZZ" DEFAULT_VALUE "---" /end COMPU_VTAB
/begin COMPU_METHOD DFC_Verb "" TAB_VERB "%6.3" "-" COMPU_TAB_REF DFC_Verb /end COMPU_METHOD
/begin COMPU_VTAB DFC_Verb "" TAB_VERB 907 0 "DFC_Unused" 1 "DFC_AAVEmax" 2 "DFC_AAVEmin" 3 "DFC_AAVEsig" 508 "DFC_AAVmin" 379 "DFC_ACEvpTPhysRngHi" 380 "DFC_ACEvpTPhysRngLo" 381 "DFC_ACEvpTSRCMax" 382 "DFC_ACEvpTSRCMin" 288 "DFC_AfsPhyRngHiB1" 289 "DFC_AfsPhyRngLoB1" 510 "DFC_AfsPlausDiagHi" 511 "DFC_AfsPlausDiagLo" 383 "DFC_AfsRawSigRngHiB1" 384 "DFC_AfsRawSigRngLoB1" 415 "DFC_AfsSigErrLineHiB1" 416 "DFC_AfsSigErrLineLoB1" 385 "DFC_AfsSnsrErrB1" 512 "DFC_AfsVrntDiagErrB1" 509 "DFC_AGRSUS" 386 "DFC_AirCClntPAnaSRCMax" 387 "DFC_AirCClntPAnaSRCMin" 290 "DFC_AirCCmprOL" 291 "DFC_AirCCmprOvrTemp" 292 "DFC_AirCCmprSCB" 293 "DFC_AirCCmprSCG" 388 "DFC_AirCSwtNpl" 389 "DFC_AirCSwtSig" 294 "DFC_AltErr" 4 "DFC_AltIOACGFailr" 5 "DFC_AltIOACGHiVltg" 6 "DFC_AltIOACGLoVltg" 7 "DFC_AltIOACGTHi" 8 "DFC_AltIODConnACG" 513 "DFC_AppAllSnsrDfct" 10 "DFC_BattUHiFailr" 11 "DFC_BattULoFailr" 295 "DFC_BattUSRCMax" 296 "DFC_BattUSRCMin" 516 "DFC_BattUStdbyDiaOL" 514 "DFC_BBKRnldg" 515 "DFC_BBKRsyne" 9 "DFC_BGOELWAF" 517 "DFC_BigLeakIntkMnfldEmiInfl" 518 "DFC_BlkdLineTank" 390 "DFC_Brk" 12 "DFC_BrkBstPDriftHiErr" 13 "DFC_BrkBstPDriftLoErr" 14 "DFC_BrkBstPSnsrStuck" 391 "DFC_BrkBstSensSCB" 392 "DFC_BrkBstSensSCG" 15 "DFC_BrkMnSwtContOn" 519 "DFC_BrkMnSwtContOnWarnLmp" 16 "DFC_BrkMnSwtNotStp" 520 "DFC_BrkMnSwtNotStpWarnLmp" 17 "DFC_BrkNpl" 18 "DFC_BrkRdntSwtContOn" 521 "DFC_BrkRdntSwtContOnWarnLmp" 19 "DFC_BrkRdntSwtNotStp" 522 "DFC_BrkRdntSwtNotStpWarnLmp" 393 "DFC_BrkSig" 496 "DFC_BSWM_E_ACTION_FAILED" 497 "DFC_BSWM_E_INTRPTQUEUE_FULL" 472 "DFC_BusDiagCANAPPLBusOff" 473 "DFC_BusDiagCANCANCBusOff" 474 "DFC_BusDiagCANVEHICLEBusOff" 490 "DFC_CAN_E_TIMEOUT" 523 "DFC_CEngDsTColdStrtMax" 524 "DFC_CEngDsTColdStrtMin" 525 "DFC_CEngDsTImps" 526 "DFC_CEngDsTPlausHSC" 527 "DFC_CEngDsTPlausLSC" 528 "DFC_CEngDsTPlausSTC" 531 "DFC_CEngDsTSig" 529 "DFC_CEngDsTSRCMax" 530 "DFC_CEngDsTSRCMin" 532 "DFC_CEngUsTColdStrtMax" 533 "DFC_CEngUsTColdStrtMin" 534 "DFC_CEngUsTLooseCnctn" 535 "DFC_CEngUsTSRCMax" 536 "DFC_CEngUsTSRCMin" 432 "DFC_Clth2ONStuck" 433 "DFC_Clth2ONStuckLdc" 20 "DFC_Clth3ONStuck" 434 "DFC_Clth3ONStuckLdc" 435 "DFC_Clth3ONStuckPostDrv" 21 "DFC_Clth4OFFStuck" 436 "DFC_Clth4ONStuck" 437 "DFC_Clth4ONStuckLdc" 260 "DFC_ClthMax" 412 "DFC_ClthNpl" 22 "DFC_ClthOFFStuck" 23 "DFC_ClthONStuck" 394 "DFC_ClthSig" 24 "DFC_ClthStkFailInfo" 25 "DFC_ComACFailInfo" 26 "DFC_ComATFTValErr" 27 "DFC_ComATMILReq" 28 "DFC_ComAYCAChksum" 29 "DFC_ComAYCARingCnt" 30 "DFC_ComAYCATOut" 31 "DFC_ComAYCDChkSum" 32 "DFC_ComAYCDTOut" 33 "DFC_ComAYCFChksum" 34 "DFC_ComAYCFRingCnt" 35 "DFC_ComAYCFTOut" 36 "DFC_ComAYCGChksum" 37 "DFC_ComAYCGRingCnt" 38 "DFC_ComAYCGTOut" 39 "DFC_ComAYCIChkSum" 40 "DFC_ComAYCIRingCnt" 41 "DFC_ComAYCITOut" 42 "DFC_ComBCM1ChkSum" 43 "DFC_ComBCM1RingCnt" 44 "DFC_ComBCM1TOut" 438 "DFC_ComBCMUnit" 45 "DFC_ComCANABusOffErr" 46 "DFC_ComCANBBusOffErr" 47 "DFC_ComCANCBusOffErr" 48 "DFC_ComCGW1ChkSum" 49 "DFC_ComCGW1RingCnt" 50 "DFC_ComCGW1TOut" 297 "DFC_ComChksTCU1" 298 "DFC_ComChksTCU11" 299 "DFC_ComChksTCU12" 300 "DFC_ComChksTCU13" 301 "DFC_ComChksTCU2" 302 "DFC_ComChksTCU3" 303 "DFC_ComChksTCU4" 304 "DFC_ComCntTCU1" 305 "DFC_ComCntTCU11" 306 "DFC_ComCntTCU12" 307 "DFC_ComCntTCU13" 308 "DFC_ComCntTCU2" 309 "DFC_ComCntTCU3" 310 "DFC_ComCntTCU4" 51 "DFC_ComConvBoostErr" 52 "DFC_ComConvSlipErr" 537 "DFC_ComDCDCACCFailr" 53 "DFC_ComDCDCPrfmncErr" 54 "DFC_ComDCDCTempWarn" 439 "DFC_ComDLCTCU01" 440 "DFC_ComDLCTCU02" 441 "DFC_ComDLCTCU1" 442 "DFC_ComDLCTCU11" 443 "DFC_ComDLCTCU12" 444 "DFC_ComDLCTCU13" 445 "DFC_ComDLCTCU14" 446 "DFC_ComDLCTCU2" 447 "DFC_ComDLCTCU3" 448 "DFC_ComDLCTCU4" 55 "DFC_ComEAT10Chksum" 56 "DFC_ComEAT10RingCnt" 57 "DFC_ComEAT10TOut" 58 "DFC_ComEAT11ChkSum" 59 "DFC_ComEAT11RingCnt" 60 "DFC_ComEAT11TOut" 61 "DFC_ComEAT12ChkSum" 62 "DFC_ComEAT12RingCnt" 63 "DFC_ComEAT12TOut" 64 "DFC_ComEAT13ChkSum" 65 "DFC_ComEAT13RingCnt" 66 "DFC_ComEAT13TOut" 67 "DFC_ComEAT1Chksum" 68 "DFC_ComEAT1RingCnt" 69 "DFC_ComEAT1TOut" 70 "DFC_ComEAT2ChkSum" 71 "DFC_ComEAT2RingCnt" 72 "DFC_ComEAT2TOut" 73 "DFC_ComEAT4ChkSum" 74 "DFC_ComEAT4RingCnt" 75 "DFC_ComEAT4TOut" 76 "DFC_ComEAT6Chksum" 77 "DFC_ComEAT6RingCnt" 78 "DFC_ComEAT6TOut" 79 "DFC_ComEAT7Chksum" 80 "DFC_ComEAT7RingCnt" 81 "DFC_ComEAT7TOut" 82 "DFC_ComEAT8Chksum" 83 "DFC_ComEAT8RingCnt" 84 "DFC_ComEAT8TOut" 85 "DFC_ComEATAChksum" 86 "DFC_ComEATARingCnt" 87 "DFC_ComEATATOut" 88 "DFC_ComEATBChkSum" 89 "DFC_ComEATBRingCnt" 90 "DFC_ComEATBTOut" 91 "DFC_ComEATCChksum" 92 "DFC_ComEATCRingCnt" 93 "DFC_ComEATCTOut" 103 "DFC_ComEngCanRxErr" 94 "DFC_ComEPBBChkSum" 95 "DFC_ComEPBBRingCnt" 96 "DFC_ComEPBBTOut" 97 "DFC_ComEPBChksum" 99 "DFC_ComEPBctRing" 98 "DFC_ComEPBTOut" 100 "DFC_ComEPS1Chksum" 101 "DFC_ComEPS1RingCnt" 102 "DFC_ComEPS1TOut" 449 "DFC_ComEPSUnit" 104 "DFC_ComGrvySnsrErr" 105 "DFC_ComGwIMG1ChkSum" 106 "DFC_ComGwIMG1RingCnt" 107 "DFC_ComGwIMG1TOut" 108 "DFC_ComGwIMG3ChkSum" 109 "DFC_ComGwIMG3RingCnt" 110 "DFC_ComGwIMG3TOut" 111 "DFC_ComGwIMG4ChkSum" 112 "DFC_ComGwIMG4RingCnt" 113 "DFC_ComGwIMG4TOut" 114 "DFC_ComGwIMG5ChkSum" 115 "DFC_ComGwIMG5RingCnt" 116 "DFC_ComGwIMG5TOut" 117 "DFC_ComGwIMG6ChkSum" 118 "DFC_ComGwIMG6RingCnt" 119 "DFC_ComGwIMG6TOut" 120 "DFC_ComIDASBChksum" 121 "DFC_ComIDASBRingCnt" 122 "DFC_ComIDASBTOut" 450 "DFC_ComIDASBUnit" 123 "DFC_ComIMGMILReq" 451 "DFC_ComIMGUnit" 124 "DFC_ComISSPrms" 125 "DFC_ComMETAChksum" 126 "DFC_ComMETAChksumPstDrv" 127 "DFC_ComMETARingCnt" 128 "DFC_ComMETARingCntPstDrv" 129 "DFC_ComMETATOut" 130 "DFC_ComMETATOutPstDrv" 131 "DFC_ComMETCChksum" 132 "DFC_ComMETCRingCnt" 133 "DFC_ComMETCTOut" 134 "DFC_ComMETDChksum" 135 "DFC_ComMETDRingCnt" 136 "DFC_ComMETDTOut" 137 "DFC_ComMETE2Chksum" 138 "DFC_ComMETE2RingCnt" 139 "DFC_ComMETE2TOut" 140 "DFC_ComMETFChksum" 141 "DFC_ComMETFRingCnt" 142 "DFC_ComMETFTOut" 143 "DFC_ComMETGChksum" 144 "DFC_ComMETGRingCnt" 145 "DFC_ComMETGTOut" 146 "DFC_ComMETH2Chksum" 147 "DFC_ComMETH2RingCnt" 148 "DFC_ComMETH2TOut" 149 "DFC_ComMETHChksum" 150 "DFC_ComMETHRingCnt" 151 "DFC_ComMETHTOut" 152 "DFC_ComMETIChksum" 153 "DFC_ComMETIRingCnt" 154 "DFC_ComMETITOut" 155 "DFC_ComMETKChksum" 156 "DFC_ComMETKRingCnt" 157 "DFC_ComMETKTOut" 158 "DFC_ComMETLChksum" 159 "DFC_ComMETLRingCnt" 160 "DFC_ComMETLTOut" 161 "DFC_ComMETMChksum" 162 "DFC_ComMETMRingCnt" 163 "DFC_ComMETMTOut" 164 "DFC_ComMETNChksum" 165 "DFC_ComMETNRingCnt" 166 "DFC_ComMETNTOut" 452 "DFC_ComMETUnit" 167 "DFC_ComMtrCom" 168 "DFC_ComPCUChkSum" 169 "DFC_ComPCURingCnt" 170 "DFC_ComPCUTOut" 171 "DFC_ComSRSAChksum" 172 "DFC_ComSRSARingCnt" 173 "DFC_ComSRSATOut" 174 "DFC_ComSRSBChksum" 175 "DFC_ComSRSBRingCnt" 176 "DFC_ComSRSBTOut" 177 "DFC_ComSRSChksum" 178 "DFC_ComSRSErr" 179 "DFC_ComSRSRingCnt" 180 "DFC_ComSRSTOut" 453 "DFC_ComSRSUnit" 311 "DFC_ComTOutTCU01" 312 "DFC_ComTOutTCU02" 313 "DFC_ComTOutTCU1" 314 "DFC_ComTOutTCU11" 315 "DFC_ComTOutTCU12" 316 "DFC_ComTOutTCU13" 317 "DFC_ComTOutTCU14" 318 "DFC_ComTOutTCU2" 319 "DFC_ComTOutTCU3" 320 "DFC_ComTOutTCU4" 181 "DFC_ComVehSpdPndFltTCU" 454 "DFC_ComVSAUnit" 538 "DFC_DCDCFltDet" 321 "DFC_DevLibBattUHi" 322 "DFC_DevLibBattULo" 357 "DFC_DHFHD" 558 "DFC_DiagCpv1DteskLoLoadStuckClsd" 559 "DFC_DiagCpv1DteskLoLoadStuckOpen" 541 "DFC_DKnpl" 539 "DFC_DKRSA" 540 "DFC_DKVSmax" 542 "DFC_DSKVRmax" 543 "DFC_DSKVRmin" 544 "DFC_DSKVRnpl" 545 "DFC_DSKVRsig" 546 "DFC_DSKVSsig" 547 "DFC_DSSmax" 548 "DFC_DSTDmax" 549 "DFC_DSTEmax" 550 "DFC_DSTEmin" 551 "DFC_DSTOFmax" 552 "DFC_DSTRmax" 553 "DFC_DSTRmin" 554 "DFC_DSTRnpl" 555 "DFC_DSTRsig" 556 "DFC_DSTTI" 557 "DFC_DSUmax" 182 "DFC_EbsChartcCurrErr" 183 "DFC_EbsSelfDiagErr" 455 "DFC_EbsSocFlt" 395 "DFC_EGRVlvCurrLim" 560 "DFC_EGRVlvDrftClsd" 561 "DFC_EGRVlvDrftOpn" 323 "DFC_EGRVlvFailSafeActv" 324 "DFC_EGRVlvGovDvtCld" 562 "DFC_EGRVlvJamVlvClsd" 563 "DFC_EGRVlvJamVlvOpn" 396 "DFC_EGRVlvOL" 397 "DFC_EGRVlvOvrTemp" 325 "DFC_EGRVlvPhysSRCMax" 326 "DFC_EGRVlvPhysSRCMin" 398 "DFC_EGRVlvSCB" 399 "DFC_EGRVlvSCG" 564 "DFC_EGRVlvSprgBrk" 400 "DFC_EGRVlvSRCMax" 401 "DFC_EGRVlvSRCMin" 565 "DFC_EGRVlvTempMdlEEPErr" 566 "DFC_EGRVlvTmpErr" 567 "DFC_EGSDUS2B1LtrDly" 568 "DFC_EGSDUS2B1LtrPT1" 569 "DFC_EGSDUS2B1RtlDly" 570 "DFC_EGSDUS2B1RtlPT1" 571 "DFC_EGSDUS2B1TarLean" 572 "DFC_EGSDUS2B1TarRich" 586 "DFC_EngICO" 587 "DFC_EngPrtOvrSpdMon" 573 "DFC_EONVmax" 588 "DFC_EpmCaSI1ErrSig" 589 "DFC_EpmCaSI1MntErr" 590 "DFC_EpmCaSI1NoSigMax" 591 "DFC_EpmCaSI1NoSigMin" 592 "DFC_EpmCaSI1OfsErr" 593 "DFC_EpmCrSDGI" 594 "DFC_EpmCrSErrSig" 595 "DFC_EpmCrSNoSig" 596 "DFC_EtaEngIdleNonCsers" 597 "DFC_EtaEngPtlNonCsers" 574 "DFC_ETAKHLmax" 575 "DFC_ETAKHTmax" 576 "DFC_ETHSEmax" 577 "DFC_ETHSEmin" 578 "DFC_ETHSFmax" 579 "DFC_ETHSFmin" 580 "DFC_ETHSFsig" 581 "DFC_ETHSNPWmax" 582 "DFC_ETHSNPWmin" 583 "DFC_ETHSNPWsig" 584 "DFC_ETHSPLnpl" 585 "DFC_ETHSTPLnpl" 327 "DFC_FanDIOOL_0" 328 "DFC_FanDIOOL_1" 329 "DFC_FanDIOOvrTemp_0" 330 "DFC_FanDIOOvrTemp_1" 331 "DFC_FanDIOSCB_0" 332 "DFC_FanDIOSCB_1" 333 "DFC_FanDIOSCG_0" 334 "DFC_FanDIOSCG_1" 598 "DFC_FRAmax" 599 "DFC_FRAmin" 600 "DFC_FSTEmax" 601 "DFC_FSTEmin" 605 "DFC_FSTmax" 602 "DFC_FSTRmax" 603 "DFC_FSTRmin" 604 "DFC_FSTRnpl" 606 "DFC_FTDLAmax" 607 "DFC_FTDLAmin" 608 "DFC_FuPHiSnsrEleclmax" 609 "DFC_FuPHiSnsrEleclmin" 610 "DFC_FuPHiSnsrEleclnpl" 611 "DFC_FuPHiSnsrURngMax" 612 "DFC_FuPHiSnsrURngMin" 613 "DFC_FuSnsrPhyRngMaxErr" 614 "DFC_FuSnsrPhyRngMinErr" 188 "DFC_GbxCANDigPlausErr" 189 "DFC_GbxNPos1SRCMax" 190 "DFC_GbxNPos1SRCMin" 191 "DFC_GbxNPos2SRCMax" 192 "DFC_GbxNPos2SRCMin" 193 "DFC_GbxNPosAlvChk" 194 "DFC_GbxNPosSyncErr" 413 "DFC_GbxPNPosnDrvCdn" 414 "DFC_GbxPNPosnPlausy" 618 "DFC_GbxRvsSwtStk" 615 "DFC_GEVlvLockPinDiagIntkB1" 184 "DFC_GEVlvPhaCsersIntkB1" 185 "DFC_GEVlvPhaPsOpenLoadIntkB1" 186 "DFC_GEVlvPhaPsShoToBattIntkB1" 187 "DFC_GEVlvPhaPsShoToGndIntkB1" 616 "DFC_GEVlvPhaSlowIntkB1" 617 "DFC_GEVlvPhaTargIntkB1" 619 "DFC_HDRKHmax" 620 "DFC_HDRKHmin" 623 "DFC_HDRmax" 624 "DFC_HDRmin" 621 "DFC_HDRPLmax" 622 "DFC_HDRPLmin" 625 "DFC_HEGOS2B1ElecMax" 626 "DFC_HEGOS2B1ElecMin" 627 "DFC_HEGOS2B1ElecSig" 628 "DFC_HEGOS2B1HtgNpl" 195 "DFC_HEGOS2B1HtrPsMax" 196 "DFC_HEGOS2B1HtrPsMin" 197 "DFC_HEGOS2B1HtrPsSig" 629 "DFC_HEV00max" 630 "DFC_HEV01max" 631 "DFC_HEV02max" 632 "DFC_HEV03max" 633 "DFC_HEVE0max" 634 "DFC_HEVE1max" 635 "DFC_HFMmax" 636 "DFC_HiPSysHiPMaxLimExcdd" 402 "DFC_HLSDemOvhtEngLim" 456 "DFC_I14229VINErr" 261 "DFC_IgnClPs_DevComErr" 262 "DFC_IgnClPs_LineOl_0" 263 "DFC_IgnClPs_LineOl_1" 264 "DFC_IgnClPs_LineOl_2" 265 "DFC_IgnClPs_LineOl_3" 266 "DFC_IgnClPs_LineScb_0" 267 "DFC_IgnClPs_LineScb_1" 268 "DFC_IgnClPs_LineScb_2" 269 "DFC_IgnClPs_LineScb_3" 270 "DFC_IgnClPs_LineScg_0" 271 "DFC_IgnClPs_LineScg_1" 272 "DFC_IgnClPs_LineScg_2" 273 "DFC_IgnClPs_LineScg_3" 457 "DFC_InjCatHeatgErr" 458 "DFC_InjSysMulInjDiagErr" 358 "DFC_InjVlv_DI_DcDc" 359 "DFC_InjVlv_DI_NoLd_0" 360 "DFC_InjVlv_DI_NoLd_1" 361 "DFC_InjVlv_DI_NoLd_2" 362 "DFC_InjVlv_DI_NoLd_3" 363 "DFC_InjVlv_DI_ScBnk_0" 364 "DFC_InjVlv_DI_ScBnk_1" 365 "DFC_InjVlv_DI_ScBnk_2" 366 "DFC_InjVlv_DI_ScBnk_3" 367 "DFC_InjVlv_DI_ScCyl_0" 368 "DFC_InjVlv_DI_ScCyl_1" 369 "DFC_InjVlv_DI_ScCyl_2" 370 "DFC_InjVlv_DI_ScCyl_3" 371 "DFC_InjVlv_DI_ScHsLs_0" 372 "DFC_InjVlv_DI_ScHsLs_1" 373 "DFC_InjVlv_DI_ScHsLs_2" 374 "DFC_InjVlv_DI_ScHsLs_3" 652 "DFC_IntkAirTAirFltDsCrssMax" 653 "DFC_IntkAirTAirFltDsCrssMin" 654 "DFC_IntkAirTAirFltDsHSCMax" 655 "DFC_IntkAirTAirFltDsImps" 656 "DFC_IntkAirTAirFltDsPRCMax" 657 "DFC_IntkAirTAirFltDsPRCMin" 658 "DFC_IntkAirTAirFltDsSRCMax" 659 "DFC_IntkAirTAirFltDsSRCMin" 660 "DFC_IntkAirTAirFltDsSTC" 661 "DFC_IntkAirTIntkMnfldCrssMax" 662 "DFC_IntkAirTIntkMnfldCrssMin" 663 "DFC_IntkAirTIntkMnfldHSCMax" 664 "DFC_IntkAirTIntkMnfldImps" 665 "DFC_IntkAirTIntkMnfldPRCMax" 666 "DFC_IntkAirTIntkMnfldPRCMin" 667 "DFC_IntkAirTIntkMnfldSRCMax" 668 "DFC_IntkAirTIntkMnfldSRCMin" 669 "DFC_IntkAirTIntkMnfldSTC" 647 "DFC_IVGdiCtl_CvoErr" 648 "DFC_IVGdiCtl_CvoSigPlaus_0" 649 "DFC_IVGdiCtl_CvoSigPlaus_1" 650 "DFC_IVGdiCtl_CvoSigPlaus_2" 651 "DFC_IVGdiCtl_CvoSigPlaus_3" 637 "DFC_IVGdiCtlCvoErrMax_0" 638 "DFC_IVGdiCtlCvoErrMax_1" 639 "DFC_IVGdiCtlCvoErrMax_2" 640 "DFC_IVGdiCtlCvoErrMax_3" 641 "DFC_IVGdiCtlCvoErrMin_0" 642 "DFC_IVGdiCtlCvoErrMin_1" 643 "DFC_IVGdiCtlCvoErrMin_2" 644 "DFC_IVGdiCtlCvoErrMin_3" 645 "DFC_IVGdiCtlCvoErrMinMax" 646 "DFC_IVGdiCtlCvoSigPlausErrSmrCdn" 428 "DFC_KnDetSens1PortAMax" 429 "DFC_KnDetSens1PortAMin" 430 "DFC_KnDetSens1PortBMax" 431 "DFC_KnDetSens1PortBMin" 670 "DFC_KRREGRLMX" 671 "DFC_KRVEKOCVLCI" 672 "DFC_KRVEKOENCHMT" 673 "DFC_KRVEKOENCHMT0" 674 "DFC_KRVEKOENCHMT1" 675 "DFC_KRVEKOENCHMT2" 676 "DFC_KRVEKOENCHMT3" 677 "DFC_KRVEKOENCHMT4" 678 "DFC_KRVEKOENCHMT5" 679 "DFC_KRVEKOENCHMT6" 680 "DFC_KRVEKOENCHMT7" 274 "DFC_KRVEKOEVAB" 275 "DFC_KRVEKOEVAB0" 276 "DFC_KRVEKOEVAB1" 277 "DFC_KRVEKOEVAB2" 278 "DFC_KRVEKOEVAB3" 681 "DFC_KRVEKORLMX" 682 "DFC_KRVEKORLMXL" 683 "DFC_KS1max" 684 "DFC_KS1min" 687 "DFC_LamDynDiagS1B1" 688 "DFC_LeakIntkMnfldEmiInfl" 491 "DFC_LIN_E_TIMEOUT" 465 "DFC_LinACGUnit" 466 "DFC_LinAEVUnit" 198 "DFC_LinCSErrACG" 199 "DFC_LinCSErrAEV" 200 "DFC_LinCSErrDCDC" 201 "DFC_LinCSErrEBS" 467 "DFC_LinEBSUnit" 689 "DFC_LinFrameErrDCDC" 202 "DFC_LinHdrTimeoutErrACG" 203 "DFC_LinHdrTimeoutErrAEV" 204 "DFC_LinHdrTimeoutErrDCDC" 205 "DFC_LinHdrTimeoutErrEBS" 206 "DFC_LinMsgTimeoutErrACG" 207 "DFC_LinMsgTimeoutErrAEV" 208 "DFC_LinMsgTimeoutErrDCDC" 209 "DFC_LinMsgTimeoutErrEBS" 210 "DFC_LinNoStrtComErr" 690 "DFC_LinOverrunErrDCDC" 459 "DFC_LLRHmax" 460 "DFC_LLRHmin" 461 "DFC_LLRHnpl" 462 "DFC_LLRKHmax" 463 "DFC_LLRKHmin" 464 "DFC_LLRKHnpl" 685 "DFC_LMmax" 211 "DFC_LowPresOilP" 686 "DFC_LZSRnpl" 691 "DFC_MD00max" 692 "DFC_MDBmax" 693 "DFC_MDCat" 694 "DFC_MDCatCrit" 695 "DFC_MDCatCurr" 696 "DFC_MDCyl_0" 697 "DFC_MDCyl_1" 698 "DFC_MDCyl_2" 699 "DFC_MDCyl_3" 700 "DFC_MDEmi" 701 "DFC_MDEmiStrt" 702 "DFC_MDFco" 705 "DFC_MDmax" 703 "DFC_MDMpl" 704 "DFC_MDSegTiAdpn" 375 "DFC_MfPsDiaOpenLoad1" 376 "DFC_MfPsDiaScHiS1" 377 "DFC_MfPsDiaScHiSLowS1" 378 "DFC_MfPsDiaScLowS1" 706 "DFC_MFuOilMax" 228 "DFC_MisfDetdVWhlFrntLePlaus" 229 "DFC_MisfDetdVWhlFrntRiPlaus" 230 "DFC_MisfDetdVWhlReLePlaus" 231 "DFC_MisfDetdVWhlReRiPlaus" 212 "DFC_MisfDetVWhlFrntLeOORHi" 213 "DFC_MisfDetVWhlFrntLeRatyHi" 214 "DFC_MisfDetVWhlFrntLeRatyLo" 215 "DFC_MisfDetVWhlFrntLeStuck" 216 "DFC_MisfDetVWhlFrntRiOORHi" 217 "DFC_MisfDetVWhlFrntRiRatyHi" 218 "DFC_MisfDetVWhlFrntRiRatyLo" 219 "DFC_MisfDetVWhlFrntRiStuck" 220 "DFC_MisfDetVWhlReLeOORHi" 221 "DFC_MisfDetVWhlReLeRatyHi" 222 "DFC_MisfDetVWhlReLeRatyLo" 223 "DFC_MisfDetVWhlReLeStuck" 224 "DFC_MisfDetVWhlReRiOORHi" 225 "DFC_MisfDetVWhlReRiRatyHi" 226 "DFC_MisfDetVWhlReRiRatyLo" 227 "DFC_MisfDetVWhlReRiStuck" 801 "DFC_MoCADCNTP" 802 "DFC_MoCADCTst" 803 "DFC_MoCSOPICO" 805 "DFC_MoFAirFilgPrdc" 806 "DFC_MoFAirFlCtOffGdi" 807 "DFC_MoFAirFlCylGdi" 808 "DFC_MoFAirFlFF" 809 "DFC_MoFAirFlIn" 810 "DFC_MoFAirFlMixCtlGdiChkAirFl" 811 "DFC_MoFAirFlMixCtlGdiChkCtrl" 812 "DFC_MoFAirFlMode" 804 "DFC_MoFAPP" 813 "DFC_MoFESpd" 814 "DFC_MoFIACo" 815 "DFC_MoFICOL1" 816 "DFC_MoFICOL2" 817 "DFC_MoFStrt" 818 "DFC_MoFTrqCmp" 819 "DFC_MoFTrqCmpMax" 820 "DFC_MoFTrqCmpMin" 821 "DFC_MoFVarPostBldSel" 707 "DFC_MOXEMM_SMU_ALM0_0" 708 "DFC_MOXEMM_SMU_ALM0_1" 709 "DFC_MOXEMM_SMU_ALM0_10" 710 "DFC_MOXEMM_SMU_ALM0_11" 711 "DFC_MOXEMM_SMU_ALM0_13" 712 "DFC_MOXEMM_SMU_ALM0_14" 713 "DFC_MOXEMM_SMU_ALM0_2" 714 "DFC_MOXEMM_SMU_ALM0_22" 715 "DFC_MOXEMM_SMU_ALM0_23" 716 "DFC_MOXEMM_SMU_ALM0_4" 717 "DFC_MOXEMM_SMU_ALM0_5" 718 "DFC_MOXEMM_SMU_ALM0_7" 719 "DFC_MOXEMM_SMU_ALM0_8" 720 "DFC_MOXEMM_SMU_ALM10_16" 721 "DFC_MOXEMM_SMU_ALM10_17" 722 "DFC_MOXEMM_SMU_ALM10_21" 723 "DFC_MOXEMM_SMU_ALM11_0" 724 "DFC_MOXEMM_SMU_ALM11_1" 725 "DFC_MOXEMM_SMU_ALM11_2" 726 "DFC_MOXEMM_SMU_ALM11_3" 727 "DFC_MOXEMM_SMU_ALM11_4" 728 "DFC_MOXEMM_SMU_ALM11_5" 729 "DFC_MOXEMM_SMU_ALM11_8" 730 "DFC_MOXEMM_SMU_ALM11_9" 731 "DFC_MOXEMM_SMU_ALM1_0" 732 "DFC_MOXEMM_SMU_ALM1_1" 733 "DFC_MOXEMM_SMU_ALM1_10" 734 "DFC_MOXEMM_SMU_ALM1_11" 735 "DFC_MOXEMM_SMU_ALM1_13" 736 "DFC_MOXEMM_SMU_ALM1_14" 737 "DFC_MOXEMM_SMU_ALM1_2" 738 "DFC_MOXEMM_SMU_ALM1_22" 739 "DFC_MOXEMM_SMU_ALM1_23" 740 "DFC_MOXEMM_SMU_ALM1_4" 741 "DFC_MOXEMM_SMU_ALM1_5" 742 "DFC_MOXEMM_SMU_ALM1_7" 743 "DFC_MOXEMM_SMU_ALM1_8" 744 "DFC_MOXEMM_SMU_ALM21_0" 745 "DFC_MOXEMM_SMU_ALM21_16" 746 "DFC_MOXEMM_SMU_ALM21_3" 747 "DFC_MOXEMM_SMU_ALM2_1" 748 "DFC_MOXEMM_SMU_ALM2_10" 749 "DFC_MOXEMM_SMU_ALM2_11" 750 "DFC_MOXEMM_SMU_ALM2_13" 751 "DFC_MOXEMM_SMU_ALM2_14" 752 "DFC_MOXEMM_SMU_ALM2_22" 753 "DFC_MOXEMM_SMU_ALM2_23" 754 "DFC_MOXEMM_SMU_ALM2_4" 755 "DFC_MOXEMM_SMU_ALM2_5" 756 "DFC_MOXEMM_SMU_ALM2_7" 757 "DFC_MOXEMM_SMU_ALM2_8" 758 "DFC_MOXEMM_SMU_ALM6_0" 759 "DFC_MOXEMM_SMU_ALM6_11" 760 "DFC_MOXEMM_SMU_ALM6_12" 761 "DFC_MOXEMM_SMU_ALM6_14" 762 "DFC_MOXEMM_SMU_ALM6_15" 763 "DFC_MOXEMM_SMU_ALM6_17" 764 "DFC_MOXEMM_SMU_ALM6_18" 765 "DFC_MOXEMM_SMU_ALM6_20" 766 "DFC_MOXEMM_SMU_ALM6_21" 767 "DFC_MOXEMM_SMU_ALM6_25" 768 "DFC_MOXEMM_SMU_ALM6_4" 769 "DFC_MOXEMM_SMU_ALM6_5" 770 "DFC_MOXEMM_SMU_ALM6_7" 771 "DFC_MOXEMM_SMU_ALM6_8" 772 "DFC_MOXEMM_SMU_ALM7_1" 773 "DFC_MOXEMM_SMU_ALM7_12" 774 "DFC_MOXEMM_SMU_ALM7_13" 775 "DFC_MOXEMM_SMU_ALM7_14" 776 "DFC_MOXEMM_SMU_ALM7_15" 777 "DFC_MOXEMM_SMU_ALM7_16" 778 "DFC_MOXEMM_SMU_ALM7_17" 779 "DFC_MOXEMM_SMU_ALM7_2" 780 "DFC_MOXEMM_SMU_ALM7_20" 781 "DFC_MOXEMM_SMU_ALM7_25" 782 "DFC_MOXEMM_SMU_ALM7_26" 783 "DFC_MOXEMM_SMU_ALM7_28" 784 "DFC_MOXEMM_SMU_ALM7_29" 785 "DFC_MOXEMM_SMU_ALM7_30" 786 "DFC_MOXEMM_SMU_ALM7_31" 787 "DFC_MOXEMM_SMU_ALM8_0" 788 "DFC_MOXEMM_SMU_ALM8_1" 789 "DFC_MOXEMM_SMU_ALM8_10" 790 "DFC_MOXEMM_SMU_ALM8_11" 791 "DFC_MOXEMM_SMU_ALM8_12" 792 "DFC_MOXEMM_SMU_ALM8_16" 793 "DFC_MOXEMM_SMU_ALM8_18" 794 "DFC_MOXEMM_SMU_ALM8_2" 795 "DFC_MOXEMM_SMU_ALM8_3" 796 "DFC_MOXEMM_SMU_ALM8_31" 797 "DFC_MOXEMM_SMU_ALM8_4" 798 "DFC_MOXEMM_SMU_ALM9_0" 799 "DFC_MOXEMM_SMU_ALM9_15" 800 "DFC_MOXEMM_SMU_ALM9_3" 822 "DFC_MoXEMMHwLTMCUFW" 823 "DFC_MoXEMMHwLTMonBIST" 824 "DFC_MoXEMMHwLTRegMonTest" 825 "DFC_MoXEMMHwLTStbySMUAlvTest" 826 "DFC_MoXEMMHwLTTempSens" 827 "DFC_MoXEMMHwLTUCBCfg" 335 "DFC_MRlyDcOL" 336 "DFC_MRlyDcSCB" 337 "DFC_MRlyDcSCG" 492 "DFC_MRlyOL" 493 "DFC_MRlySCB" 494 "DFC_MRlySCG" 828 "DFC_NWSEmax" 829 "DFC_NWSmax" 830 "DFC_OCWDAABEActv" 831 "DFC_OCWDACom" 832 "DFC_OCWDAErrPin" 833 "DFC_OCWDAOvrVltg" 836 "DFC_OilPPlaus" 403 "DFC_OilPSwmpSRCMax" 404 "DFC_OilPSwmpSRCMin" 834 "DFC_ORAmax" 835 "DFC_ORAmin" 847 "DFC_P_VSE11_OL" 848 "DFC_P_VSE11_SCB" 849 "DFC_P_VSE11_SCG" 417 "DFC_PEnvCcMax" 418 "DFC_PEnvCcMin" 419 "DFC_PEnvRngChkMax" 420 "DFC_PEnvRngChkMin" 232 "DFC_PEnvSigRngMax" 233 "DFC_PEnvSigRngMin" 421 "DFC_PEnvSnsrPlaus" 850 "DFC_PhyHighAPP1" 851 "DFC_PhyHighAPP2" 852 "DFC_PhyLowAPP1" 853 "DFC_PhyLowAPP2" 405 "DFC_PIntkVUsLineHiB1" 406 "DFC_PIntkVUsLineLoB1" 837 "DFC_PLLSUmax" 838 "DFC_PLLSUmin" 338 "DFC_PSPOL" 339 "DFC_PSPOvrTemp" 340 "DFC_PSPSCB" 341 "DFC_PSPSCG" 839 "DFC_PSR1max" 840 "DFC_PSRBmax" 841 "DFC_PSRBmin" 845 "DFC_PSRmax" 842 "DFC_PSRPmax" 843 "DFC_PSRPmin" 844 "DFC_PSRPsig" 846 "DFC_PUmax" 475 "DFC_RBA_IODIAGPWR_rba_IoExtCy329_SignalVltSply_0" 476 "DFC_RBA_IODIAGPWR_rba_IoExtCy329_SignalVltSply_0OT" 477 "DFC_RBA_IODIAGPWR_rba_IoExtCy329_SignalVltSply_0OV" 478 "DFC_RBA_IODIAGPWR_rba_IoExtCy329_SignalVltSply_0SCG" 479 "DFC_RBA_IODIAGPWR_rba_IoExtCy329_SignalVltSply_0UV" 480 "DFC_RBA_IODIAGPWR_rba_IoExtCy329_SignalVltSply_1" 481 "DFC_RBA_IODIAGPWR_rba_IoExtCy329_SignalVltSply_1OT" 482 "DFC_RBA_IODIAGPWR_rba_IoExtCy329_SignalVltSply_1OV" 483 "DFC_RBA_IODIAGPWR_rba_IoExtCy329_SignalVltSply_1SCG" 484 "DFC_RBA_IODIAGPWR_rba_IoExtCy329_SignalVltSply_1UV" 485 "DFC_RBA_IODIAGPWR_rba_IoExtCy329_SignalVltSply_2" 486 "DFC_RBA_IODIAGPWR_rba_IoExtCy329_SignalVltSply_2OT" 487 "DFC_RBA_IODIAGPWR_rba_IoExtCy329_SignalVltSply_2OV" 488 "DFC_RBA_IODIAGPWR_rba_IoExtCy329_SignalVltSply_2SCG" 489 "DFC_RBA_IODIAGPWR_rba_IoExtCy329_SignalVltSply_2UV" 498 "DFC_RBA_IOEXTLIB_KEEPALIVE_DRV" 499 "DFC_RBA_IOEXTLIB_KEEPALIVE_INI" 500 "DFC_rba_IoSigRtc_StopCounter" 502 "DFC_rba_MemDiag_MemReadErr" 503 "DFC_rba_MemDiag_MemWrErr" 501 "DFC_rba_MRly_Diag_Stk_Event" 495 "DFC_rba_MultiStackTrace_Threshold" 504 "DFC_rba_SyC_IrrSwOffTrigEngRun_Event" 505 "DFC_rba_T15_Diag_ComInVld_Event" 506 "DFC_rba_T15_Diag_ComOff_HwOn_Event" 507 "DFC_rba_T15_Diag_ComOn_HwOff_Event" 468 "DFC_RoughRoad" 469 "DFC_SiaEEPRdErr" 470 "DFC_SiaEEPWrngCod" 854 "DFC_SRCHighAPP1" 855 "DFC_SRCHighAPP2" 856 "DFC_SRCLowAPP1" 857 "DFC_SRCLowAPP2" 858 "DFC_SSpMon2" 859 "DFC_STHDRmax" 234 "DFC_StmFault" 236 "DFC_StrtCtlErr" 235 "DFC_StrtCtOffPth" 237 "DFC_StrtFault" 238 "DFC_StrtLckJudg1" 239 "DFC_StrtLckJudg2" 240 "DFC_StrtOL" 241 "DFC_StrtOL2" 242 "DFC_StrtSCB" 243 "DFC_StrtSCB2" 244 "DFC_StrtSCG" 245 "DFC_StrtSCG2" 246 "DFC_StrtStkRly1" 247 "DFC_StrtStkRly2" 860 "DFC_SWReset_0" 861 "DFC_SWReset_1" 862 "DFC_SWReset_2" 863 "DFC_SyncAPP" 342 "DFC_T50Err" 865 "DFC_TAmax_Dummy" 864 "DFC_TANKLnpl" 866 "DFC_TESFmax" 867 "DFC_TESGmax" 248 "DFC_TEVEmax" 249 "DFC_TEVEmin" 250 "DFC_TEVEsig" 875 "DFC_ThrVlvClsdPosnFirstOffsLrnImpoB1" 876 "DFC_ThrVlvClsdPosnOffsLrnImpoB1" 877 "DFC_ThrVlvClsdPosnOffsLrnMaxB1" 878 "DFC_ThrVlvClsdPosnOffsLrnMinB1" 879 "DFC_ThrVlvCtrlDeB1" 880 "DFC_ThrVlvDycB1" 881 "DFC_ThrVlvLimpAirPosnMaxAbsltDriftB1" 882 "DFC_ThrVlvLimpAirPosnMaxB1" 883 "DFC_ThrVlvLimpAirPosnMaxRelDriftB1" 884 "DFC_ThrVlvLimpAirPosnMinB1" 343 "DFC_ThrVlvLoBattB1" 885 "DFC_ThrVlvOpenLoadB1" 886 "DFC_ThrVlvOpenSprgB1" 887 "DFC_ThrVlvOpenSprgSprdB1" 888 "DFC_ThrVlvOpenSprgTwnB1" 889 "DFC_ThrVlvOverTB1" 890 "DFC_ThrVlvRetSprgB1" 891 "DFC_ThrVlvRetSprgSprdB1" 892 "DFC_ThrVlvRetSprgTwnB1" 893 "DFC_ThrVlvSens1MaxB1" 900 "DFC_ThrvlvSens1MinB1" 894 "DFC_ThrVlvSens1NplB1" 895 "DFC_ThrVlvSens2MaxB1" 896 "DFC_ThrVlvSens2MinB1" 897 "DFC_ThrVlvSens2NplB1" 898 "DFC_ThrVlvShoCircB1" 899 "DFC_ThrVlvSpiErrB1" 901 "DFC_TiOffTBasdChkFast" 902 "DFC_TiOffTBasdChkSlow" 868 "DFC_TKAEmax" 869 "DFC_TKAEmin" 870 "DFC_TKARmax" 871 "DFC_TKARnpl" 872 "DFC_TMmax_Dummy" 873 "DFC_TUMmax_Dummy" 874 "DFC_TWCDPriCatB1" 251 "DFC_UegoHeatrPrfmncLoS1B1" 422 "DFC_UEGOHeatrRlyPsOLS1B1" 423 "DFC_UEGOHeatrRlyPsSCBS1B1" 424 "DFC_UEGOHeatrRlyPsSCGS1B1" 471 "DFC_UegoHeatrStrtS1B1" 425 "DFC_UegoHeatrWireOlS1B1" 426 "DFC_UegoHeatrWireScbS1B1" 427 "DFC_UegoHeatrWireScgS1B1" 279 "DFC_UegoSigEcuAsicS1B1" 280 "DFC_UegoSigEcuComS1B1" 344 "DFC_UegoSigOperPlausS1B1" 281 "DFC_UegoSigSnsrS1B1" 282 "DFC_UegoSigWireOlApesS1B1" 283 "DFC_UegoSigWireOlIpeS1B1" 284 "DFC_UegoSigWireOlReS1B1" 285 "DFC_UegoSigWireRCmpS1B1" 286 "DFC_UegoSigWireScbS1B1" 287 "DFC_UegoSigWireScgS1B1" 903 "DFC_UEGOSnsrMntdS1B1" 252 "DFC_VehVAllPlaus" 253 "DFC_VehVNCSnsrElecFailr" 345 "DFC_VehVPhysRngHi" 407 "DFC_VehVPhysRngLo" 254 "DFC_VehVPlausCan" 255 "DFC_VehVPlausFco" 256 "DFC_VehVPlausPwr" 257 "DFC_VehVPlausV2N" 346 "DFC_VehVSclOutOL" 347 "DFC_VehVSclOutOT" 348 "DFC_VehVSclOutSCB" 349 "DFC_VehVSclOutSCG" 904 "DFC_VehVSig" 408 "DFC_VehVSigCan" 409 "DFC_VehVSigCanSafe" 350 "DFC_VehVSigFL" 351 "DFC_VehVSigFR" 352 "DFC_VehVSigRL" 353 "DFC_VehVSigRR" 354 "DFC_VehVSnsrARngHi" 355 "DFC_VehVSnsrBRngHi" 356 "DFC_VehVSpdRtyDiag" 258 "DFC_VehVSpdSnsrAElecFailr" 259 "DFC_VehVSpdSnsrBElecFailr" 410 "DFC_VlvLftFbOilPSnsrIntk11SRCMax" 411 "DFC_VlvLftFbOilPSnsrIntk11SRCMin" 905 "DFC_VlvLftFbSwtIntk11SpclFail" 906 "DFC_VlvLftFbSwtIntk11StdFail" DEFAULT_VALUE "---" /end COMPU_VTAB
/begin COMPU_METHOD DFES_Entry_Verb "" TAB_VERB "%6.3" "" COMPU_TAB_REF DFES_Entry_Verb /end COMPU_METHOD
/begin COMPU_VTAB DFES_Entry_Verb "" TAB_VERB 35 0 "Empty" 1 "Erased" 2 "Erased_PdtcClrd" 3 "Erased_PdtcClrdMinTrip" 4 "Erased_PdtcClrdOk" 5 "FrzFrm" 6 "FrzFrm_PdtcClrd" 7 "FrzFrm_PdtcClrdMinTrip" 8 "FrzFrm_PdtcClrdOk" 9 "Shadow" 10 "Shadow_PdtcClrd" 11 "Shadow_PdtcClrdMinTrip" 12 "Shadow_PdtcClrdOk" 13 "Service" 14 "Service_PdtcClrd" 15 "Service_PdtcClrdMinTrip" 16 "Service_PdtcClrdOk" 17 "Service_Shdw" 18 "Service_ShdwPdtcClrd" 19 "Service_ShdwPdtcClrdMinTrip" 20 "Service_ShdwPdtcClrdOk" 21 "Service_FrzFrm" 22 "Service_FrzFrmPdtcClrd" 23 "Service_FrzFrmPdtcClrdMinTrip" 24 "Service_FrzFrmPdtcClrdOk" 25 "Pending" 26 "Pending_PdtcClrd" 27 "Pending_PdtcClrdMinTrip" 28 "Pending_PdtcClrdOk" 29 "Confirmed" 30 "Confirmed_Pdtc" 31 "ConfirmedHealing" 32 "ConfirmedHealing_Pdtc" 33 "ConfirmedPending" 34 "ConfirmedAging" /end COMPU_VTAB
/begin COMPU_METHOD DFES_Mon_Verb "" TAB_VERB "%6.3" "-" COMPU_TAB_REF DFES_Mon_Verb /end COMPU_METHOD
/begin COMPU_VTAB DFES_Mon_Verb "" TAB_VERB 22 0 "-----" 257 "double entry" 1025 "LDF_Diff DFCst - ORD" 513 "Counter exceeds" 258 "MEM missing" 1032 "retry entry" 514 "DEL Counter Serv ex" 260 "MEM no Entry" 516 "DEL Counter Pend ex" 1026 "Deb ok missing" 520 "DEL Counter OBD ex" 1028 "Deb def missing" 2049 "EepQueOvfl" 2050 "EepIniFailed" 2051 "EepIniNoSucss" 4097 "Erased_prioHigh" 4098 "slow_scan" 8193 "miss diumpr Fid" 16385 "invalid DTR limit" 32770 "event lost due to rollback limit" 32785 "number active InhUdp negative" 32786 "non zero InhUpd counter used" /end COMPU_VTAB
/begin COMPU_METHOD DFES_OneToOne "" RAT_FUNC "%6.2" "-" COEFFS 0 1 0 0 0 1 /end COMPU_METHOD
/begin COMPU_METHOD DFES_stCheck_Verb "" TAB_VERB "%6.3" "-" COMPU_TAB_REF DFES_stCheck_Verb /end COMPU_METHOD
/begin COMPU_VTAB DFES_stCheck_Verb "" TAB_VERB 8 0 "OkNoTst" 1 "OkTested" 2 "OkHealed" 3 "OkRstNoTst" 4 "DefectNoTst" 5 "DefectDelay" 6 "Defect" 7 "DefectRstNoTst" /end COMPU_VTAB
/begin COMPU_METHOD DFES_stCnt_Verb "" TAB_VERB "%6.3" "-" COMPU_TAB_REF DFES_stCnt_Verb /end COMPU_METHOD
/begin COMPU_VTAB DFES_stCnt_Verb "" TAB_VERB 36 0 "SVS_NONE__MIL_NONE" 1 "SVS_NONE__MIL_HLC_TRG" 2 "SVS_NONE__MIL_HLC_ELAP" 3 "SVS_NONE__MIL_FLC_CNT" 4 "SVS_NONE__MIL_FLC_TIME" 5 "SVS_NONE__MIL_HLC_TIME" 16 "SVS_HLC_TRG__MIL_NONE" 17 "SVS_HLC_TRG__MIL_HLC_TRG" 18 "SVS_HLC_TRG__MIL_HLC_ELAP" 19 "SVS_HLC_TRG__MIL_FLC_CNT" 20 "SVS_HLC_TRG__MIL_FLC_TIME" 21 "SVS_HLC_TRG__MIL_HLC_TIME" 32 "SVS_HLC_ELAP__MIL_NONE" 33 "SVS_HLC_ELAP__MIL_HLC_TRG" 34 "SVS_HLC_ELAP__MIL_HLC_ELAP" 35 "SVS_HLC_ELAP__MIL_FLC_CNT" 36 "SVS_HLC_ELAP__MIL_FLC_TIME" 37 "SVS_HLC_ELAP__MIL_HLC_TIME" 48 "SVS_FLC_CNT__MIL_NONE" 49 "SVS_FLC_CNT__MIL_HLC_TRG" 50 "SVS_FLC_CNT__MIL_HLC_ELAP" 51 "SVS_FLC_CNT__MIL_FLC_CNT" 52 "SVS_FLC_CNT__MIL_FLC_TIME" 53 "SVS_FLC_CNT__MIL_HLC_TIME" 64 "SVS_FLC_TIME__MIL_NONE" 65 "SVS_FLC_TIME__MIL_HLC_TRG" 66 "SVS_FLC_TIME__MIL_HLC_ELAP" 67 "SVS_FLC_TIME__MIL_FLC_CNT" 68 "SVS_FLC_TIME__MIL_FLC_TIME" 69 "SVS_FLC_TIME__MIL_HLC_TIME" 80 "SVS_HLC_TIME__MIL_NONE" 81 "SVS_HLC_TIME__MIL_HLC_TRG" 82 "SVS_HLC_TIME__MIL_HLC_ELAP" 83 "SVS_HLC_TIME__MIL_FLC_CNT" 84 "SVS_HLC_TIME__MIL_FLC_TIME" 85 "SVS_HLC_TIME__MIL_HLC_TIME" /end COMPU_VTAB
/begin COMPU_METHOD DFES_stDataImdt_Verb "" TAB_VERB "%6.3" "" COMPU_TAB_REF DFES_stDataImdt_Verb /end COMPU_METHOD
/begin COMPU_VTAB DFES_stDataImdt_Verb "" TAB_VERB 22 0 "ERASED" 1 "ERASED_ACTSEQ_FRZ_ENV" 2 "FRZONLY" 3 "FRZONLY_ACTSEQ_FRZ_ENV" 4 "SHADOW" 5 "SHADOW_ACTSEQ_FRZ_ENV" 12 "OKENTRY" 13 "OKENTRY_ACTSEQ_LCK" 14 "OKENTRY_ACTSEQ_LCK_ENV_LCK" 15 "OKENTRY_ACTSEQ_FRZ_ENV_LCK" 16 "OKENTRY_ACTSEQ_ENV_LCK" 17 "ERROR" 18 "ERROR_ACTSEQ_LCK" 19 "ERROR_ACTSEQ_LCK_ENV_LCK" 20 "ERROR_ACTSEQ_FRZ_ENV_LCK" 21 "ERROR_ACTSEQ_ENV_LCK" 6 "SHADOWFRZ" 7 "SHADOWFRZ_ACTSEQ_FRZ_ENV" 8 "SHADOWOK" 9 "SHADOWOK_ACTSEQ_FRZ_ENV" 10 "SHADOWOKFRZ" 11 "SHADOWOKFRZ_ACTSEQ_FRZ_ENV" /end COMPU_VTAB
/begin COMPU_METHOD DFES_stEntry_Verb "" TAB_VERB "%6.3" "-" COMPU_TAB_REF DFES_stEntry_Verb /end COMPU_METHOD
/begin COMPU_VTAB DFES_stEntry_Verb "" TAB_VERB 240 0 "NoEntry" 1 "Erased" 2 "PrivateTemporary" 3 "SVSOff_FreezeFrameOnly" 4 "SVSOff_DelayActiveDefect" 5 "SVSOff_ServiceNoDefect" 6 "SVSOff_ServiceDefect" 7 "SVSOff_ServiceHistoryDefect" 8 "SVSOff_ServiceHistoryNoDefect" 9 "SVSOff_DelayActiveNoDefect" 10 "SVSOff_PendingDefect" 11 "SVSOff_DebouncedDefect" 12 "SVSOff_HistoryPendingDefect" 13 "SVSOff_HealingNoDefect" 14 "SVSOff_HistoryNoDefect" 16 "DelD_NoEntry" 17 "DelD_Erased" 18 "DelD_PrivateTemporary" 19 "SVSOff_DelD_FreezeFrameOnly" 20 "SVSOff_DelD_DelayActiveDefect" 21 "SVSOff_DelD_ServiceNoDefect" 22 "SVSOff_DelD_ServiceDefect" 23 "SVSOff_DelD_ServiceHistoryDefect" 24 "SVSOff_DelD_ServiceHistoryNoDefect" 25 "SVSOff_DelD_DelayActiveNoDefect" 26 "SVSOff_DelD_PendingDefect" 27 "SVSOff_DelD_DebouncedDefect" 28 "SVSOff_DelD_HistoryPendingDefect" 29 "SVSOff_DelD_HealingNoDefect" 30 "SVSOff_DelD_HistoryNoDefect" 32 "P_NoEntry" 33 "P_Erased" 34 "P_PrivateTemporary" 35 "SVSOff_P_FreezeFrameOnly" 36 "SVSOff_P_DelayActiveDefect" 37 "SVSOff_P_ServiceNoDefect" 38 "SVSOff_P_ServiceDefect" 39 "SVSOff_P_ServiceHistoryDefect" 40 "SVSOff_P_ServiceHistoryNoDefect" 41 "SVSOff_P_DelayActiveNoDefect" 42 "SVSOff_P_PendingDefect" 43 "SVSOff_P_DebouncedDefect" 44 "SVSOff_P_HistoryPendingDefect" 45 "SVSOff_P_HealingNoDefect" 46 "SVSOff_P_HistoryNoDefect" 48 "P_DelD_NoEntry" 49 "P_DelD_Erased" 50 "P_DelD_PrivateTemporary" 51 "SVSOff_P_DelD_FreezeFrameOnly" 52 "SVSOff_P_DelD_DelayActiveDefect" 53 "SVSOff_P_DelD_ServiceNoDefect" 54 "SVSOff_P_DelD_ServiceDefect" 55 "SVSOff_P_DelD_ServiceHistoryDefect" 56 "SVSOff_P_DelD_ServiceHistoryNoDefect" 57 "SVSOff_P_DelD_DelayActiveNoDefect" 58 "SVSOff_P_DelD_PendingDefect" 59 "SVSOff_P_DelD_DebouncedDefect" 60 "SVSOff_P_DelD_HistoryPendingDefect" 61 "SVSOff_P_DelD_HealingNoDefect" 62 "SVSOff_P_DelD_HistoryNoDefect" 64 "PS_NoEntry" 65 "PS_Erased" 66 "PS_PrivateTemporary" 67 "SVSOff_PS_FreezeFrameOnly" 68 "SVSOff_PS_DelayActiveDefect" 69 "SVSOff_PS_ServiceNoDefect" 70 "SVSOff_PS_ServiceDefect" 71 "SVSOff_PS_ServiceHistoryDefect" 72 "SVSOff_PS_ServiceHistoryNoDefect" 73 "SVSOff_PS_DelayActiveNoDefect" 74 "SVSOff_PS_PendingDefect" 75 "SVSOff_PS_DebouncedDefect" 76 "SVSOff_PS_HistoryPendingDefect" 77 "SVSOff_PS_HealingNoDefect" 78 "SVSOff_PS_HistoryNoDefect" 80 "PS_DelD_NoEntry" 81 "PS_DelD_Erased" 82 "PS_DelD_PrivateTemporary" 83 "SVSOff_PS_DelD_FreezeFrameOnly" 84 "SVSOff_PS_DelD_DelayActiveDefect" 85 "SVSOff_PS_DelD_ServiceNoDefect" 86 "SVSOff_PS_DelD_ServiceDefect" 87 "SVSOff_PS_DelD_ServiceHistoryDefect" 88 "SVSOff_PS_DelD_ServiceHistoryNoDefect" 89 "SVSOff_PS_DelD_DelayActiveNoDefect" 90 "SVSOff_PS_DelD_PendingDefect" 91 "SVSOff_PS_DelD_DebouncedDefect" 92 "SVSOff_PS_DelD_HistoryPendingDefect" 93 "SVSOff_PS_DelD_HealingNoDefect" 94 "SVSOff_PS_DelD_HistoryNoDefect" 96 "PS_P_NoEntry" 97 "PS_P_Erased" 98 "PS_P_PrivateTemporary" 99 "SVSOff_PS_P_FreezeFrameOnly" 100 "SVSOff_PS_P_DelayActiveDefect" 101 "SVSOff_PS_P_ServiceNoDefect" 102 "SVSOff_PS_P_ServiceDefect" 103 "SVSOff_PS_P_ServiceHistoryDefect" 104 "SVSOff_PS_P_ServiceHistoryNoDefect" 105 "SVSOff_PS_P_DelayActiveNoDefect" 106 "SVSOff_PS_P_PendingDefect" 107 "SVSOff_PS_P_DebouncedDefect" 108 "SVSOff_PS_P_HistoryPendingDefect" 109 "SVSOff_PS_P_HealingNoDefect" 110 "SVSOff_PS_P_HistoryNoDefect" 112 "PS_P_DelD_NoEntry" 113 "PS_P_DelD_Erased" 114 "PS_P_DelD_PrivateTemporary" 115 "SVSOff_PS_P_DelD_FreezeFrameOnly" 116 "SVSOff_PS_P_DelD_DelayActiveDefect" 117 "SVSOff_PS_P_DelD_ServiceNoDefect" 118 "SVSOff_PS_P_DelD_ServiceDefect" 119 "SVSOff_PS_P_DelD_ServiceHistoryDefect" 120 "SVSOff_PS_P_DelD_ServiceHistoryNoDefect" 121 "SVSOff_PS_P_DelD_DelayActiveNoDefect" 122 "SVSOff_PS_P_DelD_PendingDefect" 123 "SVSOff_PS_P_DelD_DebouncedDefect" 124 "SVSOff_PS_P_DelD_HistoryPendingDefect" 125 "SVSOff_PS_P_DelD_HealingNoDefect" 126 "SVSOff_PS_P_DelD_HistoryNoDefect" 128 "SVSOn_NoEntry" 129 "SVSOn_Erased" 130 "SVSOn_PrivateTemporary" 131 "SVSOn_FreezeFrameOnly" 132 "SVSOn_DelayActiveDefect" 133 "SVSOn_ServiceNoDefect" 134 "SVSOn_ServiceDefect" 135 "SVSOn_ServiceHistoryDefect" 136 "SVSOn_ServiceHistoryNoDefect" 137 "SVSOn_DelayActiveNoDefect" 138 "SVSOn_PendingDefect" 139 "SVSOn_DebouncedDefect" 140 "SVSOn_HistoryPendingDefect" 141 "SVSOn_HealingNoDefect" 142 "SVSOn_HistoryNoDefect" 144 "SVSOn_DelD_NoEntry" 145 "SVSOn_DelD_Erased" 146 "SVSOn_DelD_PrivateTemporary" 147 "SVSOn_DelD_FreezeFrameOnly" 148 "SVSOn_DelD_DelayActiveDefect" 149 "SVSOn_DelD_ServiceNoDefect" 150 "SVSOn_DelD_ServiceDefect" 151 "SVSOn_DelD_ServiceHistoryDefect" 152 "SVSOn_DelD_ServiceHistoryNoDefect" 153 "SVSOn_DelD_DelayActiveNoDefect" 154 "SVSOn_DelD_PendingDefect" 155 "SVSOn_DelD_DebouncedDefect" 156 "SVSOn_DelD_HistoryPendingDefect" 157 "SVSOn_DelD_HealingNoDefect" 158 "SVSOn_DelD_HistoryNoDefect" 160 "SVSOn_P_NoEntry" 161 "SVSOn_P_Erased" 162 "SVSOn_P_PrivateTemporary" 163 "SVSOn_P_FreezeFrameOnly" 164 "SVSOn_P_DelayActiveDefect" 165 "SVSOn_P_ServiceNoDefect" 166 "SVSOn_P_ServiceDefect" 167 "SVSOn_P_ServiceHistoryDefect" 168 "SVSOn_P_ServiceHistoryNoDefect" 169 "SVSOn_P_DelayActiveNoDefect" 170 "SVSOn_P_PendingDefect" 171 "SVSOn_P_DebouncedDefect" 172 "SVSOn_P_HistoryPendingDefect" 173 "SVSOn_P_HealingNoDefect" 174 "SVSOn_P_HistoryNoDefect" 176 "SVSOn_P_DelD_NoEntry" 177 "SVSOn_P_DelD_Erased" 178 "SVSOn_P_DelD_PrivateTemporary" 179 "SVSOn_P_DelD_FreezeFrameOnly" 180 "SVSOn_P_DelD_DelayActiveDefect" 181 "SVSOn_P_DelD_ServiceNoDefect" 182 "SVSOn_P_DelD_ServiceDefect" 183 "SVSOn_P_DelD_ServiceHistoryDefect" 184 "SVSOn_P_DelD_ServiceHistoryNoDefect" 185 "SVSOn_P_DelD_DelayActiveNoDefect" 186 "SVSOn_P_DelD_PendingDefect" 187 "SVSOn_P_DelD_DebouncedDefect" 188 "SVSOn_P_DelD_HistoryPendingDefect" 189 "SVSOn_P_DelD_HealingNoDefect" 190 "SVSOn_P_DelD_HistoryNoDefect" 192 "SVSOn_PS_NoEntry" 193 "SVSOn_PS_Erased" 194 "SVSOn_PS_PrivateTemporary" 195 "SVSOn_PS_FreezeFrameOnly" 196 "SVSOn_PS_DelayActiveDefect" 197 "SVSOn_PS_ServiceNoDefect" 198 "SVSOn_PS_ServiceDefect" 199 "SVSOn_PS_ServiceHistoryDefect" 200 "SVSOn_PS_ServiceHistoryNoDefect" 201 "SVSOn_PS_DelayActiveNoDefect" 202 "SVSOn_PS_PendingDefect" 203 "SVSOn_PS_DebouncedDefect" 204 "SVSOn_PS_HistoryPendingDefect" 205 "SVSOn_PS_HealingNoDefect" 206 "SVSOn_PS_HistoryNoDefect" 208 "SVSOn_PS_DelD_NoEntry" 209 "SVSOn_PS_DelD_Erased" 210 "SVSOn_PS_DelD_PrivateTemporary" 211 "SVSOn_PS_DelD_FreezeFrameOnly" 212 "SVSOn_PS_DelD_DelayActiveDefect" 213 "SVSOn_PS_DelD_ServiceNoDefect" 214 "SVSOn_PS_DelD_ServiceDefect" 215 "SVSOn_PS_DelD_ServiceHistoryDefect" 216 "SVSOn_PS_DelD_ServiceHistoryNoDefect" 217 "SVSOn_PS_DelD_DelayActiveNoDefect" 218 "SVSOn_PS_DelD_PendingDefect" 219 "SVSOn_PS_DelD_DebouncedDefect" 220 "SVSOn_PS_DelD_HistoryPendingDefect" 221 "SVSOn_PS_DelD_HealingNoDefect" 222 "SVSOn_PS_DelD_HistoryNoDefect" 224 "SVSOn_PS_P_NoEntry" 225 "SVSOn_PS_P_Erased" 226 "SVSOn_PS_P_PrivateTemporary" 227 "SVSOn_PS_P_FreezeFrameOnly" 228 "SVSOn_PS_P_DelayActiveDefect" 229 "SVSOn_PS_P_ServiceNoDefect" 230 "SVSOn_PS_P_ServiceDefect" 231 "SVSOn_PS_P_ServiceHistoryDefect" 232 "SVSOn_PS_P_ServiceHistoryNoDefect" 233 "SVSOn_PS_P_DelayActiveNoDefect" 234 "SVSOn_PS_P_PendingDefect" 235 "SVSOn_PS_P_DebouncedDefect" 236 "SVSOn_PS_P_HistoryPendingDefect" 237 "SVSOn_PS_P_HealingNoDefect" 238 "SVSOn_PS_P_HistoryNoDefect" 240 "SVSOn_PS_P_DelD_NoEntry" 241 "SVSOn_PS_P_DelD_Erased" 242 "SVSOn_PS_P_DelD_PrivateTemporary" 243 "SVSOn_PS_P_DelD_FreezeFrameOnly" 244 "SVSOn_PS_P_DelD_DelayActiveDefect" 245 "SVSOn_PS_P_DelD_ServiceNoDefect" 246 "SVSOn_PS_P_DelD_ServiceDefect" 247 "SVSOn_PS_P_DelD_ServiceHistoryDefect" 248 "SVSOn_PS_P_DelD_ServiceHistoryNoDefect" 249 "SVSOn_PS_P_DelD_DelayActiveNoDefect" 250 "SVSOn_PS_P_DelD_PendingDefect" 251 "SVSOn_PS_P_DelD_DebouncedDefect" 252 "SVSOn_PS_P_DelD_HistoryPendingDefect" 253 "SVSOn_PS_P_DelD_HealingNoDefect" 254 "SVSOn_PS_P_DelD_HistoryNoDefect" /end COMPU_VTAB
/begin COMPU_METHOD EPM_DSQACTVT_SC_Compu "" TAB_VERB "%6.3" "" COMPU_TAB_REF EPM_DSQACTVT_SC_Compu /end COMPU_METHOD
/begin COMPU_VTAB EPM_DSQACTVT_SC_Compu "" TAB_VERB 2 0 "Inactive" 1 "Active" /end COMPU_VTAB
/begin COMPU_METHOD EPM_HIRESLSEGLENCAL_SC_Compu "" TAB_VERB "%6.3" "" COMPU_TAB_REF EPM_HIRESLSEGLENCAL_SC_Compu /end COMPU_METHOD
/begin COMPU_VTAB EPM_HIRESLSEGLENCAL_SC_Compu "" TAB_VERB 2 0 "False" 1 "True" /end COMPU_VTAB
/begin COMPU_METHOD OneToOne "" RAT_FUNC "%6.2" "-" COEFFS 0 1 0 0 0 1 /end COMPU_METHOD
/begin RECORD_LAYOUT Val_Wu16 FNC_VALUES 1 UWORD COLUMN_DIR DIRECT /end RECORD_LAYOUT
/begin RECORD_LAYOUT Val_Wu8 FNC_VALUES 1 UBYTE COLUMN_DIR DIRECT /end RECORD_LAYOUT
/end MODULE
/end PROJECT
