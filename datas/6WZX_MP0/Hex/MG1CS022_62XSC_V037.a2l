ASAP2_VERSION 1 60
/begin PROJECT MG1CS022 "MG1CS022"
/begin HEADER "" VERSION "MG1CS022_62XSC_V037" PROJECT_NO MG1CS022 /end HEADER
/begin MODULE DIM ""
/begin MOD_COMMON "" BYTE_ORDER MSB_LAST ALIGNMENT_BYTE 1 ALIGNMENT_WORD 2 ALIGNMENT_LONG 4 ALIGNMENT_INT64 4 ALIGNMENT_FLOAT32_IEEE 4 ALIGNMENT_FLOAT64_IEEE 4 DATA_SIZE 32 /end MOD_COMMON
/begin CHARACTERISTIC UEGO_cpCapSnsrReplVal_C "replacement value for sensor capacitance of the inner electrode" VALUE 0x80581D40 RB_Val_Wu16 0.006553500 c_q1Em7_F 0.00 0.006553500 FORMAT "%11.9" /end CHARACTERISTIC
/begin CHARACTERISTIC UEGO_facIpDeltaFltConst_C "Filter time constant for delta pump current calculation" VALUE 0x80581D26 RB_Val_Wu16 0.9999847 fak_uw_b1 0.00 0.9999847 FORMAT "%9.7" /end CHARACTERISTIC
/begin CHARACTERISTIC UEGO_facIPmpRawFltConst_C "filter time constant" VALUE 0x80581D28 RB_Val_Wu16 0.9999695 fak_uw_b1 0.0000153 0.9999847 FORMAT "%9.7" EXTENDED_LIMITS 0.00 0.9999847 /end CHARACTERISTIC
/begin CHARACTERISTIC UEGO_facIPmpSegFltConst_C "Filter time constant for segment pump current calculation" VALUE 0x80581D38 RB_Val_Wu16 0.9999847 fak_uw_b1 0.00 0.9999847 FORMAT "%9.7" /end CHARACTERISTIC
/begin CHARACTERISTIC UEGO_facIsqrAFltConst_C "Filter time constant for iIsqrAAvrg measurement" VALUE 0x80581D50 RB_Val_Wu16 0.9999847 fak_uw_b1 0.00 0.9999847 FORMAT "%9.7" /end CHARACTERISTIC
/begin CHARACTERISTIC UEGO_facIsqrEFltConst_C "Filter time constant for iIsqrEAvrg measurement" VALUE 0x80581D52 RB_Val_Wu16 0.9999847 fak_uw_b1 0.00 0.9999847 FORMAT "%9.7" /end CHARACTERISTIC
/begin CHARACTERISTIC UEGO_facNernstExctFild_C "Filter factor for nernst cell relative error calculation" VALUE 0x80581D54 RB_Val_Wu16 0.9999847 fak_uw_b1 0.00 0.9999847 FORMAT "%9.7" /end CHARACTERISTIC
/begin CHARACTERISTIC UEGO_facPmpDeltaFild_C "Filter factor for absolute error of pump current calculation" VALUE 0x80581D56 RB_Val_Wu16 0.9999847 fak_uw_b1 0.00 0.9999847 FORMAT "%9.7" /end CHARACTERISTIC
/begin CHARACTERISTIC UEGO_facPmpExctFild_C "Filter factor for pump cell relative error calculation" VALUE 0x80581D58 RB_Val_Wu16 0.9999847 fak_uw_b1 0.00 0.9999847 FORMAT "%9.7" /end CHARACTERISTIC
/begin CHARACTERISTIC UEGO_facUcalFltConst_C "Filter factor for Ucal measurement" VALUE 0x80581D5A RB_Val_Wu16 0.9999847 fak_uw_b1 0.00 0.9999847 FORMAT "%9.7" /end CHARACTERISTIC
/begin CHARACTERISTIC UEGO_facUcalMFltConst_C "Filter factor for UcalM measurement" VALUE 0x80581D5C RB_Val_Wu16 0.9999847 fak_uw_b1 0.00 0.9999847 FORMAT "%9.7" /end CHARACTERISTIC
/begin CHARACTERISTIC UEGO_facUg0FltConst_C "Filter factor for Ug0 measurement" VALUE 0x80581D5E RB_Val_Wu16 0.9999847 fak_uw_b1 0.00 0.9999847 FORMAT "%9.7" /end CHARACTERISTIC
/begin CHARACTERISTIC UEGO_iIPmpDeltaMaxIni_C "Initialization value for absolute error evaluation filter" VALUE 0x80581D60 RB_Val_Ws16 0.04369000 i_q6p6667Em7_A -0.02184533 0.02184467 FORMAT "%10.8" /end CHARACTERISTIC
/begin CHARACTERISTIC UEGO_iIsqChgRglnPrimStep_C "Primary deviation threshold arround the ISQ set point for Isq regulation" VALUE 0x80581D72 RB_Val_Ws16 0.04369000 i_q6p6667Em7_A -0.02184533 0.02184467 FORMAT "%10.8" /end CHARACTERISTIC
/begin CHARACTERISTIC UEGO_iIsqChgRglnSecStep_C "Secondary deviation threshold arround the ISQ set point for Isq regulation" VALUE 0x80581D74 RB_Val_Ws16 0.04369000 i_q6p6667Em7_A -0.02184533 0.02184467 FORMAT "%10.8" /end CHARACTERISTIC
/begin CHARACTERISTIC UEGO_iIsqDesNorm_C "Converted set value for asic TRIMSQ register in standard operation of Normal mode" VALUE 0x80581D44 RB_Val_Wu16 0.02000000 i_q6p6667Em7_A 0.00 0.02000000 FORMAT "%10.8" EXTENDED_LIMITS 0.00 0.04369000 /end CHARACTERISTIC
/begin CHARACTERISTIC UEGO_iIsqDesSwtOn_C "Converted set value for asic TRIMSQ register in Switchon mode" VALUE 0x80581D46 RB_Val_Wu16 0.02000000 i_q6p6667Em7_A 0.00 0.02000000 FORMAT "%10.8" EXTENDED_LIMITS 0.00 0.04369000 /end CHARACTERISTIC
/begin CHARACTERISTIC UEGO_iIsqDesWrmUp_C "Converted set value for asic TRIMSQ register in Warmup mode" VALUE 0x80581D48 RB_Val_Wu16 0.02000000 i_q6p6667Em7_A 0.00 0.02000000 FORMAT "%10.8" EXTENDED_LIMITS 0.00 0.04369000 /end CHARACTERISTIC
/begin CHARACTERISTIC UEGO_iIsqrAMinThd_C "Isqr threshold for pump cell under which the current is considered lower as expected and lead to a suspicious of open load" VALUE 0x80581D62 RB_Val_Ws16 0.004369000 i_q6p667Em8_A -0.002184533 0.002184467 FORMAT "%11.9" /end CHARACTERISTIC
/begin CHARACTERISTIC UEGO_iIsqrChgRglnPrimStep_C "." VALUE 0x80581D76 RB_Val_Ws16 0.004369000 i_q6p667Em8_A -0.002184533 0.002184467 FORMAT "%11.9" /end CHARACTERISTIC
/begin CHARACTERISTIC UEGO_iIsqrChgRglnSecStep_C "." VALUE 0x80581D78 RB_Val_Ws16 0.004369000 i_q6p667Em8_A -0.002184533 0.002184467 FORMAT "%11.9" /end CHARACTERISTIC
/begin CHARACTERISTIC UEGO_iIsqrDesNorm_C "Converted set value for asic TRIMSQR register in standard operation of Normal mode" VALUE 0x80581D4A RB_Val_Wu16 0.003000000 i_q6p667Em8_A 0.00 0.003000000 FORMAT "%11.9" EXTENDED_LIMITS 0.00 0.004369000 /end CHARACTERISTIC
/begin CHARACTERISTIC UEGO_iIsqrDesSwtOn_C "Converted set value for asic TRIMSQR register in Switchon mode" VALUE 0x80581D4C RB_Val_Wu16 0.003000000 i_q6p667Em8_A 0.00 0.003000000 FORMAT "%11.9" EXTENDED_LIMITS 0.00 0.004369000 /end CHARACTERISTIC
/begin CHARACTERISTIC UEGO_iIsqrDesWrmUp_C "Converted set value for asic TRIMSQR register in Warmup mode" VALUE 0x80581D4E RB_Val_Wu16 0.003000000 i_q6p667Em8_A 0.00 0.003000000 FORMAT "%11.9" EXTENDED_LIMITS 0.00 0.004369000 /end CHARACTERISTIC
/begin CHARACTERISTIC UEGO_iIsqrEMinThd_C "Isqr threshold for nernst cell under which the current is considered lower as expected and lead to a suspicious of open load" VALUE 0x80581D64 RB_Val_Ws16 0.004369000 i_q6p667Em8_A -0.002184533 0.002184467 FORMAT "%11.9" /end CHARACTERISTIC
/begin CHARACTERISTIC UEGO_iIsqrMChgRglnPrimStep_C "." VALUE 0x80581D7A RB_Val_Ws16 0.004369000 i_q6p667Em8_A -0.002184533 0.002184467 FORMAT "%11.9" /end CHARACTERISTIC
/begin CHARACTERISTIC UEGO_iIsqrMChgRglnSecStep_C "." VALUE 0x80581D7C RB_Val_Ws16 0.004369000 i_q6p667Em8_A -0.002184533 0.002184467 FORMAT "%11.9" /end CHARACTERISTIC
/begin CHARACTERISTIC UEGO_iOffsIsqDes_C "Isq offset of linear relationship between digital value applied to asic and desired physical Isq" VALUE 0x80581D7E RB_Val_Ws16 0.04369000 i_q6p6667Em7_A -0.02184533 0.02184467 FORMAT "%10.8" /end CHARACTERISTIC
/begin CHARACTERISTIC UEGO_iOffsIsqrAThd_C "Isqr offset threshold to check against the offset between back measured(across pump cell) and calibrated isqr (measured across Rcal)." VALUE 0x80581D66 RB_Val_Ws16 0.004369000 i_q6p667Em8_A -0.002184533 0.002184467 FORMAT "%11.9" /end CHARACTERISTIC
/begin CHARACTERISTIC UEGO_iOffsIsqrDes_C "Isqr offset of linear relationship between digital value applied to asic and desired physical Isqr" VALUE 0x80581D80 RB_Val_Ws16 0.004369000 i_q6p667Em8_A -0.002184533 0.002184467 FORMAT "%11.9" /end CHARACTERISTIC
/begin CHARACTERISTIC UEGO_iOffsIsqrEThd_C "Isqr offset threshold to check against the offset between back measured(across nernst cell) and calibrated isqr (measured across Rcal)." VALUE 0x80581D68 RB_Val_Ws16 0.004369000 i_q6p667Em8_A -0.002184533 0.002184467 FORMAT "%11.9" /end CHARACTERISTIC
/begin CHARACTERISTIC UEGO_iOffsIsqrHwMeas_C "." VALUE 0x80581D82 RB_Val_Ws16 0.004369000 i_q6p667Em8_A -0.002184533 0.002184467 FORMAT "%11.9" /end CHARACTERISTIC
/begin CHARACTERISTIC UEGO_iSlopIsqDes_C "Isq slope of linear relationship between digital value applied to asic and desired physical Isq" VALUE 0x80581D84 RB_Val_Ws16 0.04369000 i_q6p6667Em7_A -0.02184533 0.02184467 FORMAT "%10.8" /end CHARACTERISTIC
/begin CHARACTERISTIC UEGO_iSlopIsqrDes_C "Isqr slope of linear relationship between digital value applied to asic and desired physical Isqr" VALUE 0x80581D86 RB_Val_Ws16 0.004369000 i_q6p667Em8_A -0.002184533 0.002184467 FORMAT "%11.9" /end CHARACTERISTIC
/begin CHARACTERISTIC UEGO_nfacSegSampleFlt_C "Filter factor for segment pump current calculation" VALUE 0x80581D3A RB_Val_Wu16 0.9999847 fak_uw_b1 0.00 0.9999847 FORMAT "%9.7" /end CHARACTERISTIC
/begin CHARACTERISTIC UEGO_nrIPmpCtrlIpSet_C "Specified value for I-part of pump current PID-controller in cycle number one." VALUE 0x80581D04 RB_Val_Ws16 12024.00 OneToOne -6012.000 6012.000 FORMAT "%8.3" EXTENDED_LIMITS -32768.00 32767.00 /end CHARACTERISTIC
/begin CHARACTERISTIC UEGO_nrIPmpLimdMax_C "Allowed count of pump current measurements in a pack with the maximal allowed value." VALUE 0x80581D24 RB_Val_Wu8 255.0 dez 0.00 255.0 FORMAT "%5.1" /end CHARACTERISTIC
/begin CHARACTERISTIC UEGO_nrIPmpStdOffs_C "Register value IPOFF as additional or steered digital pump current for actual IP control value" VALUE 0x80581D06 RB_Val_Ws16 12024.00 OneToOne -6012.000 6012.000 FORMAT "%8.3" EXTENDED_LIMITS -32768.00 32767.00 /end CHARACTERISTIC
/begin CHARACTERISTIC UEGO_nrISrcRglnCntr_C "." VALUE 0x80581D70 RB_Val_Wu8 255.0 OneToOne 0.00 255.0 FORMAT "%5.1" /end CHARACTERISTIC
/begin CHARACTERISTIC UEGO_nrRefPlsIni_C "" VALUE 0x80581D30 RB_Val_Wu8 15.00 dez 0.00 15.00 FORMAT "%5.2" EXTENDED_LIMITS 0.00 255.0 /end CHARACTERISTIC
/begin CHARACTERISTIC UEGO_nrRefPlsNormRgl_C "" VALUE 0x80581D31 RB_Val_Wu8 15.00 dez 0.00 15.00 FORMAT "%5.2" EXTENDED_LIMITS 0.00 255.0 /end CHARACTERISTIC
/begin CHARACTERISTIC UEGO_nrRefPlsStop_C "" VALUE 0x80581D32 RB_Val_Wu8 15.00 dez 0.00 15.00 FORMAT "%5.2" EXTENDED_LIMITS 0.00 255.0 /end CHARACTERISTIC
/begin CHARACTERISTIC UEGO_nrRefPlsWrmUpRgl_C "" VALUE 0x80581D33 RB_Val_Wu8 15.00 dez 0.00 15.00 FORMAT "%5.2" EXTENDED_LIMITS 0.00 255.0 /end CHARACTERISTIC
/begin CHARACTERISTIC UEGO_nrRegUria_C "" VALUE 0x80581D34 RB_Val_Wu8 255.0 dez 0.00 255.0 FORMAT "%5.1" /end CHARACTERISTIC
/begin CHARACTERISTIC UEGO_resRCal_C "Calibration resistor for Nernst and pump current cell" VALUE 0x80581D6A RB_Val_Wu16 6553.500 r_q0p1_Ohm 0.00 6553.500 FORMAT "%8.3" /end CHARACTERISTIC
/begin CHARACTERISTIC UEGO_resRGnd_C "resistance on pin RG" VALUE 0x80581D88 RB_Val_Wu16 6553.400 r_q0p1_Ohm 0.100 6553.500 FORMAT "%8.3" EXTENDED_LIMITS 0.00 6553.500 /end CHARACTERISTIC
/begin CHARACTERISTIC UEGO_stIPmpCtrlRst_C "Status word to configure resets for test purposes" VALUE 0x80581D08 RB_Val_Wu8 255.0 OneToOne 0.00 255.0 FORMAT "%5.1" /end CHARACTERISTIC
/begin CHARACTERISTIC UEGO_stIPmpCtrl_C "Status Bits" VALUE 0x80581D09 RB_Val_Wu8 255.0 OneToOne 0.00 255.0 FORMAT "%5.1" /end CHARACTERISTIC
/begin CHARACTERISTIC UEGO_stIPmpPckHiPrcsnBitMask_C "Mask for precision information for package filtered pump current" VALUE 0x80581D2A RB_Val_Wu8 255.0 dez 0.00 255.0 FORMAT "%5.1" /end CHARACTERISTIC
/begin CHARACTERISTIC UEGO_stIPmpPck_C "Statusword of the FC UEGO_IPmpPck to switch on and of funktionalities" VALUE 0x80581D2C RB_Val_Wu16 65535.00 dez 0.00 65535.00 FORMAT "%8.2" /end CHARACTERISTIC
/begin CHARACTERISTIC UEGO_stIPmpRef_C "Codeword for function UEGO_IPmpRef" VALUE 0x80581D36 RB_Val_Wu16 65535.00 dez 0.00 65535.00 FORMAT "%8.2" /end CHARACTERISTIC
/begin CHARACTERISTIC UEGO_stIPmpSegEvln_C "To switch the Method of Segment filtering. Only for test purpose" VALUE 0x80581D3C RB_Val_Wu8 255.0 dez 0.00 255.0 FORMAT "%5.1" /end CHARACTERISTIC
/begin CHARACTERISTIC UEGO_stIPmpStdCycOffsActvn_C "Register value PATTERN - Decision in which Cycle a pump current offset is activated" VALUE 0x80581D0A RB_Val_Wu16 65535.00 dez 0.00 65535.00 FORMAT "%8.2" /end CHARACTERISTIC
/begin CHARACTERISTIC UEGO_stIPmpStdDeltaActvn_C "Register value IPSM - Decision if in activated cycles (UEGO_stIPmpStdCycOffsActvn_C ) the offset is applied as a delta on the regulated pump current" VALUE 0x80581D0C RB_Val_Wu8 255.0 OneToOne 0.00 255.0 FORMAT "%5.1" /end CHARACTERISTIC
/begin CHARACTERISTIC UEGO_stIsqrEvln_C "Status parameter to choose Ug0ix7 or Ug0ix9 during warmup mode of Asic CJ135AN" VALUE 0x80581D8A RB_Val_Wu8 255.0 OneToOne 0.00 255.0 FORMAT "%5.1" /end CHARACTERISTIC
/begin CHARACTERISTIC UEGO_stISrcIsqRgln_C "Bit coded status for enabling Isq regulation in different modes of asic" VALUE 0x80581D8C RB_Val_Wu16 65535.00 OneToOne 0.00 65535.00 FORMAT "%8.2" /end CHARACTERISTIC
/begin CHARACTERISTIC UEGO_stISrcIsqrMRgln_C "." VALUE 0x80581D8E RB_Val_Wu16 65535.00 OneToOne 0.00 65535.00 FORMAT "%8.2" /end CHARACTERISTIC
/begin CHARACTERISTIC UEGO_stISrcIsqrRgln_C "." VALUE 0x80581D90 RB_Val_Wu16 65535.00 OneToOne 0.00 65535.00 FORMAT "%8.2" /end CHARACTERISTIC
/begin CHARACTERISTIC UEGO_stSetRegIPmp_C "Retrigger register settings during calibration and test" VALUE 0x80581D0D RB_Val_Wu8 1.000 OneToOne 0.00 1.000 FORMAT "%5.3" EXTENDED_LIMITS 0.00 255.0 /end CHARACTERISTIC
/begin CHARACTERISTIC UEGO_tiDlyiDeltaPmpVld_C "Delay time for getting a valid Absolute error for pump current in Normal Mode" VALUE 0x80581D6C RB_Val_Wu16 327.6750 t_q0p005 0.00 327.6750 FORMAT "%8.4" /end CHARACTERISTIC
/begin CHARACTERISTIC UEGO_tiDlyIPmpHiPrcn_C "Delay time to set the precision for pump current" VALUE 0x80581D3D RB_Val_Wu8 1.275 t_q0p005 0.00 1.275 FORMAT "%5.3" /end CHARACTERISTIC
/begin CHARACTERISTIC UEGO_tiDlyIPmpNotDistrbdOn_C "Calibratable delay time for Turn-On-Delay UEGO_DlyIPmpNotDistrbdOnTONV_I" VALUE 0x80581D2E RB_Val_Wu8 1.275 t_q0p005 0.00 1.275 FORMAT "%5.3" /end CHARACTERISTIC
/begin CHARACTERISTIC UEGO_tiDlyIsqrVld_C "Delay time for a valid reference pump current (isqr)" VALUE 0x80581D6E RB_Val_Wu16 327.6750 t_q0p005 0.00 327.6750 FORMAT "%8.4" /end CHARACTERISTIC
/begin CHARACTERISTIC UEGO_tiRegRecalcnIPmpCtrl_C "Time interval for periodic recalulation of digital PID params" VALUE 0x80581D0E RB_Val_Wu16 655.3500 t_q0p01 0.00 655.3500 FORMAT "%8.4" /end CHARACTERISTIC
/begin CHARACTERISTIC UEGO_tiSegLngthFilCutOff_C "Segment time length at which the PT1 filter on segment synchronous average is not effective" VALUE 0x80581D3E RB_Val_Wu16 43.69000 t_q6p6666Em4 0.00 43.69000 FORMAT "%8.5" /end CHARACTERISTIC
/begin CHARACTERISTIC UEGO_tiSegLngth_C "Parameter for duration of segment" VALUE 0x80581D42 RB_Val_Wu16 43.69000 t_q6p6666Em4 0.00 43.69000 FORMAT "%8.5" /end CHARACTERISTIC
/begin CHARACTERISTIC UEGO_tPIDPrmsSwtDwn_C "Lower temperature threshold for switching between PID param sets" VALUE 0x80581D10 RB_Val_Wu16 1535.977 temp_q0p0234_o273 -273.150 1262.827 FORMAT "%8.3" /end CHARACTERISTIC
/begin CHARACTERISTIC UEGO_tPIDPrmsSwtUp_C "Upper temperature threshold for switching between PID param sets" VALUE 0x80581D12 RB_Val_Wu16 1535.977 temp_q0p0234_o273 -273.150 1262.827 FORMAT "%8.3" /end CHARACTERISTIC
/begin CHARACTERISTIC UEGO_UnCtrlRglD_C "Physical derivative parameter for PID controller for regular PID set" VALUE 0x80581D14 RB_Val_Wu16 3872.705 q0p4728_mA_DIV_V 0.00 3872.705 FORMAT "%8.3" EXTENDED_LIMITS 0.00 30984.95 /end CHARACTERISTIC
/begin CHARACTERISTIC UEGO_UnCtrlRglI_C "Physical integral parameter for PID controller for regular PID set" VALUE 0x80581D16 RB_Val_Wu16 48.41398 q7p3875Em4_mA_DIV_V 0.00 48.41398 FORMAT "%8.5" /end CHARACTERISTIC
/begin CHARACTERISTIC UEGO_UnCtrlRglP_C "Physical proportional parameter for PID controller for regular PID set" VALUE 0x80581D18 RB_Val_Wu16 968.1762 q0p1182_mA_DIV_V 0.00 968.1762 FORMAT "%8.4" EXTENDED_LIMITS 0.00 7746.237 /end CHARACTERISTIC
/begin CHARACTERISTIC UEGO_UnCtrlRglRF_C "Feedback parameter for PID controller for regular PID set" VALUE 0x80581D1A RB_Val_Wu16 0.9921875 fak_uw_b512 0.00 0.9921875 FORMAT "%9.7" EXTENDED_LIMITS 0.00 511.9922 /end CHARACTERISTIC
/begin CHARACTERISTIC UEGO_UnCtrlSafeD_C "Physical derivative parameter for PID controller for safe PID set" VALUE 0x80581D1C RB_Val_Wu16 3872.705 q0p4728_mA_DIV_V 0.00 3872.705 FORMAT "%8.3" EXTENDED_LIMITS 0.00 30984.95 /end CHARACTERISTIC
/begin CHARACTERISTIC UEGO_UnCtrlSafeI_C "Physical integral parameter for PID controller for safe PID set" VALUE 0x80581D1E RB_Val_Wu16 48.41398 q7p3875Em4_mA_DIV_V 0.00 48.41398 FORMAT "%8.5" /end CHARACTERISTIC
/begin CHARACTERISTIC UEGO_UnCtrlSafeP_C "Physical proportional parameter for PID controller for safe PID set" VALUE 0x80581D20 RB_Val_Wu16 968.1762 q0p1182_mA_DIV_V 0.00 968.1762 FORMAT "%8.4" EXTENDED_LIMITS 0.00 7746.237 /end CHARACTERISTIC
/begin CHARACTERISTIC UEGO_UnCtrlSafeRF_C "Feedback parameter for PID controller for safe PID set" VALUE 0x80581D22 RB_Val_Wu16 0.9921875 fak_uw_b512 0.00 0.9921875 FORMAT "%9.7" EXTENDED_LIMITS 0.00 511.9922 /end CHARACTERISTIC
/begin MEASUREMENT UEGO_flgIPmpCtrlHiPrcsnS1B1 "High precision of IPmpCtrl" UBYTE B_TRUE 1 100 0.00 1.00000000000 BIT_MASK 0x1 FORMAT "%13.11" ECU_ADDRESS 0x70000723 /end MEASUREMENT
/begin MEASUREMENT UEGO_flgIPmpCtrlVldS1B1 "Validity of pump current for S1B1 is set to false if wrong or no PID controller parameters are written to the ASIC." UBYTE B_TRUE 1 100 0.00 1.00000000000 BIT_MASK 0x1 FORMAT "%13.11" ECU_ADDRESS 0x70000722 /end MEASUREMENT
/begin MEASUREMENT UEGO_flgIPmpDeltaVldS1B1 "." UBYTE B_TRUE 1 100 0.00 1.00000000000 BIT_MASK 0x1 FORMAT "%13.11" ECU_ADDRESS 0x70000721 /end MEASUREMENT
/begin MEASUREMENT UEGO_flgIPmpHiPrcsnS1B1 "Status of high precision pump current in sensor 1 bank 1" UBYTE B_TRUE 1 100 0.00 1.00000000000 BIT_MASK 0x1 FORMAT "%13.11" ECU_ADDRESS 0x70000720 /end MEASUREMENT
/begin MEASUREMENT UEGO_flgIPmpLimdLiS1B1 "Flag will be set if the llimitiation of the pump current is ligth" UBYTE B_TRUE 1 100 0.00 1.00000000000 BIT_MASK 0x1 FORMAT "%13.11" ECU_ADDRESS 0x7000071F /end MEASUREMENT
/begin MEASUREMENT UEGO_flgIPmpLimdSevS1B1 "Flag will be set if the llimitiation of the pump current is severity" UBYTE B_TRUE 1 100 0.00 1.00000000000 BIT_MASK 0x1 FORMAT "%13.11" ECU_ADDRESS 0x7000071E /end MEASUREMENT
/begin MEASUREMENT UEGO_flgIPmpLimdVldS1B1 "Flag will be true if limitation information is valid" UBYTE B_TRUE 1 100 0.00 1.00000000000 BIT_MASK 0x1 FORMAT "%13.11" ECU_ADDRESS 0x7000071D /end MEASUREMENT
/begin MEASUREMENT UEGO_flgIPmpPckHiPrcsnS1B1 "high precision information for electrical corrected pump current package sensor 1 bank 1" UBYTE B_TRUE 1 100 0.00 1.00000000000 BIT_MASK 0x1 FORMAT "%13.11" ECU_ADDRESS 0x7000071C /end MEASUREMENT
/begin MEASUREMENT UEGO_flgIPmpPckVldS1B1 "Validflag for electrical corrected pump current package sensor 1 bank 1" UBYTE B_TRUE 1 100 0.00 1.00000000000 BIT_MASK 0x1 FORMAT "%13.11" ECU_ADDRESS 0x7000071B /end MEASUREMENT
/begin MEASUREMENT UEGO_flgIPmpPlsFirstVldS1B1 "Validity flag for pump current pulse amplitude in asic switching state Z2 for sensor 1 bank 1" UBYTE B_TRUE 1 100 0.00 1.00000000000 BIT_MASK 0x1 FORMAT "%13.11" ECU_ADDRESS 0x70000719 /end MEASUREMENT
/begin MEASUREMENT UEGO_flgIPmpPlsSecVldS1B1 "Validity flag for pump current pulse amplitude in asic switching state Z1 for sensor 1 bank 1" UBYTE B_TRUE 1 100 0.00 1.00000000000 BIT_MASK 0x1 FORMAT "%13.11" ECU_ADDRESS 0x70000718 /end MEASUREMENT
/begin MEASUREMENT UEGO_flgIPmpSegVldS1B1 "Status to represents the validity of pump current in sensor 1 bank 1" UBYTE B_TRUE 1 100 0.00 1.00000000000 BIT_MASK 0x1 FORMAT "%13.11" ECU_ADDRESS 0x70000715 /end MEASUREMENT
/begin MEASUREMENT UEGO_flgIsqDesNomVldS1B1 "Validity of desired nominal Isq current amplitude for sensor 1 bank 1" UBYTE B_TRUE 1 100 0.00 1.00000000000 BIT_MASK 0x1 FORMAT "%13.11" ECU_ADDRESS 0x70000711 /end MEASUREMENT
/begin MEASUREMENT UEGO_flgIsqMeasVldS1B1 "Validity flag of the measured value of the current source" UBYTE B_TRUE 1 100 0.00 1.00000000000 BIT_MASK 0x1 FORMAT "%13.11" ECU_ADDRESS 0x70000710 /end MEASUREMENT
/begin MEASUREMENT UEGO_flgIsqrDesNomVldS1B1 "Validity of desired nominal Isqr current amplitude for sensor 1 bank 1" UBYTE B_TRUE 1 100 0.00 1.00000000000 BIT_MASK 0x1 FORMAT "%13.11" ECU_ADDRESS 0x7000070F /end MEASUREMENT
/begin MEASUREMENT UEGO_flgIsqrMeasVldS1B1 "Validity of measured Isqr current amplitude for sensor 1 bank 1" UBYTE B_TRUE 1 100 0.00 1.00000000000 BIT_MASK 0x1 FORMAT "%13.11" ECU_ADDRESS 0x7000070E /end MEASUREMENT
/begin MEASUREMENT UEGO_flgNernstIsqrVldS1B1 "validity flag for output UEGO_iNernstIsqr" UBYTE B_TRUE 1 100 0.00 1.00000000000 BIT_MASK 0x1 FORMAT "%13.11" ECU_ADDRESS 0x7000070D /end MEASUREMENT
/begin MEASUREMENT UEGO_flgPmpIsqrVldS1B1 "validity flag for output UEGO_iPmpIsqr" UBYTE B_TRUE 1 100 0.00 1.00000000000 BIT_MASK 0x1 FORMAT "%13.11" ECU_ADDRESS 0x70000703 /end MEASUREMENT
/begin MEASUREMENT UEGO_flgRatINernstExctVldS1B1 "." UBYTE B_TRUE 1 100 0.00 1.00000000000 BIT_MASK 0x1 FORMAT "%13.11" ECU_ADDRESS 0x700006EE /end MEASUREMENT
/begin MEASUREMENT UEGO_flgRatIPmpExctVldS1B1 "." UBYTE B_TRUE 1 100 0.00 1.00000000000 BIT_MASK 0x1 FORMAT "%13.11" ECU_ADDRESS 0x700006ED /end MEASUREMENT
/begin MEASUREMENT UEGO_flgReStableS1B1 "Variable flag indicates RE-Stable is active or not for sensor 1 bank 1" UBYTE B_TRUE 1 100 0.00 1.00000000000 BIT_MASK 0x1 FORMAT "%13.11" ECU_ADDRESS 0x700006EC /end MEASUREMENT
/begin MEASUREMENT UEGO_flgTrmSqRglnVldS1B1 "Validity of TIRMSQ number for regulation for sensor 1 bank 1" UBYTE B_TRUE 1 100 0.00 1.00000000000 BIT_MASK 0x1 FORMAT "%13.11" ECU_ADDRESS 0x700006E2 /end MEASUREMENT
/begin MEASUREMENT UEGO_flgTrmSqrRglnVldS1B1 "." UBYTE B_TRUE 1 100 0.00 1.00000000000 BIT_MASK 0x1 FORMAT "%13.11" ECU_ADDRESS 0x700006E1 /end MEASUREMENT
/begin MEASUREMENT UEGO_iIPmpDeltaS1B1 "." SWORD i_q6p6667Em7_A 1 100 -0.02184533 0.02184467 FORMAT "%10.8" ECU_ADDRESS 0x60009726 /end MEASUREMENT
/begin MEASUREMENT UEGO_iIPmpPckAryS1B1 "Array for package pump current values of sensor 1 bank 1" SWORD i_q6p6667Em7_A 1 100 -0.02184533 0.02184467 FORMAT "%10.8" ARRAY_SIZE 15 ECU_ADDRESS 0x60009706 /end MEASUREMENT
/begin MEASUREMENT UEGO_iIPmpPckAvrgS1B1 "UEGO package mean value of pump current for S1B1" SWORD i_q6p6667Em7_A 1 100 -0.02184533 0.02184467 FORMAT "%10.8" ECU_ADDRESS 0x60009704 /end MEASUREMENT
/begin MEASUREMENT UEGO_iIPmpPTCorrdS1B1 "pressure-corrected and temperature-corrected pump current sensor 1 bank 1" SWORD i_q6p6667Em7_A 1 100 -0.02184533 0.02184467 FORMAT "%10.8" ECU_ADDRESS 0x700053E8 /end MEASUREMENT
/begin MEASUREMENT UEGO_iIPmpSegS1B1 "Segment filtered pump current sensor 1 bank 1" SWORD i_q6p6667Em7_A 1 100 -0.02184533 0.02184467 FORMAT "%10.8" ECU_ADDRESS 0x600096E4 /end MEASUREMENT
/begin MEASUREMENT UEGO_iIsqDesNomS1B1 "Desired nominal Isq current amplitude for sensor 1 bank 1" SWORD i_q6p6667Em7_A 1 100 -0.02184533 0.02184467 FORMAT "%10.8" ECU_ADDRESS 0x600096DC /end MEASUREMENT
/begin MEASUREMENT UEGO_iIsqDesS1B1 "Desired Isq sensor 1 bank 1" SWORD i_q6p6667Em7_A 1 100 -0.02184533 0.02184467 FORMAT "%10.8" ECU_ADDRESS 0x600096DA /end MEASUREMENT
/begin MEASUREMENT UEGO_iIsqMeasRawS1B1 "Measured raw Isq current ampltude (Unfiltered) across Rgnd" SWORD i_q6p6667Em7_A 1 100 -0.02184533 0.02184467 FORMAT "%10.8" ECU_ADDRESS 0x600096D8 /end MEASUREMENT
/begin MEASUREMENT UEGO_iIsqMeasS1B1 "measured pump current source sensor 1 bank 1" SWORD i_q6p6667Em7_A 1 100 -0.02184533 0.02184467 FORMAT "%10.8" ECU_ADDRESS 0x600096D6 /end MEASUREMENT
/begin MEASUREMENT UEGO_iIsqrDesNomS1B1 "Desired nominal Isqr current amplitude for sensor 1 bank 1" SWORD i_q6p667Em8_A 1 100 -0.002184533 0.002184467 FORMAT "%11.9" ECU_ADDRESS 0x600096D4 /end MEASUREMENT
/begin MEASUREMENT UEGO_iIsqrDesS1B1 "Desired Isqr sensor 1 bank 1" SWORD i_q6p667Em8_A 1 100 -0.002184533 0.002184467 FORMAT "%11.9" ECU_ADDRESS 0x600096D2 /end MEASUREMENT
/begin MEASUREMENT UEGO_iIsqrMeasS1B1 "measured reference pump current source sensor 1 bank 1" SWORD i_q6p667Em8_A 1 100 -0.002184533 0.002184467 FORMAT "%11.9" ECU_ADDRESS 0x600096D0 /end MEASUREMENT
/begin MEASUREMENT UEGO_iNernstIsqrS1B1 "nernst cell reference pump current sensor 1 bank 1" SWORD i_q6p6667Em7_A 1 100 -0.02184533 0.02184467 FORMAT "%10.8" ECU_ADDRESS 0x600096CE /end MEASUREMENT
/begin MEASUREMENT UEGO_iOffsIsqrNernstS1B1 "Offset current of the backmeasured isqr for nernst cell from calibrated Isqr for sensor 1 bank 1" SWORD i_q6p667Em8_A 1 100 -0.002184533 0.002184467 FORMAT "%11.9" ECU_ADDRESS 0x600096CA /end MEASUREMENT
/begin MEASUREMENT UEGO_iOffsIsqrPmpS1B1 "Offset current of the backmeasured isqr for pump cell from calibrated Isqr for sensor 1 bank 1" SWORD i_q6p667Em8_A 1 100 -0.002184533 0.002184467 FORMAT "%11.9" ECU_ADDRESS 0x600096C8 /end MEASUREMENT
/begin MEASUREMENT UEGO_IPmpCtrlS1B1_I.KRFDes "IPmpCtrl Class instance for sensor 1 bank1 / Feedback parameter" UWORD fak_uw_b512 1 100 0.00 0.9921875 FORMAT "%9.7" ECU_ADDRESS 0x60002294 /end MEASUREMENT
/begin MEASUREMENT UEGO_IPmpCtrlS1B1_I.flgCalTrigSetReg "IPmpCtrl Class instance for sensor 1 bank1 / Trigger register setting during calibr and testing" UBYTE B_TRUE 1 100 0.00 1.00000000000 BIT_MASK 0x1 FORMAT "%13.11" ECU_ADDRESS 0x60002297 /end MEASUREMENT
/begin MEASUREMENT UEGO_IPmpCtrlS1B1_I.flgDacAdpnStabVld "IPmpCtrl Class instance for sensor 1 bank1 / Validity of the Adaption of the stable Dac slope" UBYTE B_TRUE 1 100 0.00 1.00000000000 BIT_MASK 0x4 FORMAT "%13.11" ECU_ADDRESS 0x60002297 /end MEASUREMENT
/begin MEASUREMENT UEGO_IPmpCtrlS1B1_I.flgDacAdpnStabVldOld "IPmpCtrl Class instance for sensor 1 bank1 / Validity of the previous cycle of the Adaption of the stable Dac slope" UBYTE B_TRUE 1 100 0.00 1.00000000000 BIT_MASK 0x8 FORMAT "%13.11" ECU_ADDRESS 0x60002297 /end MEASUREMENT
/begin MEASUREMENT UEGO_IPmpCtrlS1B1_I.flgIPmpCtrlHiPrcsn "IPmpCtrl Class instance for sensor 1 bank1 / High precision" UBYTE B_TRUE 1 100 0.00 1.00000000000 BIT_MASK 0x1 FORMAT "%13.11" ECU_ADDRESS 0x6000229A /end MEASUREMENT
/begin MEASUREMENT UEGO_IPmpCtrlS1B1_I.flgIPmpCtrlVld "IPmpCtrl Class instance for sensor 1 bank1 / Validity of pump current is set to false, if wrong or no PID controller parameters are written to the ASIC." UBYTE B_TRUE 1 100 0.00 1.00000000000 BIT_MASK 0x1 FORMAT "%13.11" ECU_ADDRESS 0x6000229B /end MEASUREMENT
/begin MEASUREMENT UEGO_IPmpCtrlS1B1_I.flgIPmpSetAcptd "IPmpCtrl Class instance for sensor 1 bank1 / Register Setting for Register IPSET successful" UBYTE B_TRUE 1 100 0.00 1.00000000000 BIT_MASK 0x40 FORMAT "%13.11" ECU_ADDRESS 0x60002299 /end MEASUREMENT
/begin MEASUREMENT UEGO_IPmpCtrlS1B1_I.flgLoupCURRDes "IPmpCtrl Class instance for sensor 1 bank1 / Chosen amplification for current back measurement" UBYTE B_TRUE 1 100 0.00 1.00000000000 BIT_MASK 0x10 FORMAT "%13.11" ECU_ADDRESS 0x60002297 /end MEASUREMENT
/begin MEASUREMENT UEGO_IPmpCtrlS1B1_I.flgLoupCURRDesOld "IPmpCtrl Class instance for sensor 1 bank1 / Previous value of chosen amplification for current back measurement" UBYTE B_TRUE 1 100 0.00 1.00000000000 BIT_MASK 0x20 FORMAT "%13.11" ECU_ADDRESS 0x60002297 /end MEASUREMENT
/begin MEASUREMENT UEGO_IPmpCtrlS1B1_I.flgLoupNDes "IPmpCtrl Class instance for sensor 1 bank1 / Nernst Loupe desired" UBYTE B_TRUE 1 100 0.00 1.00000000000 BIT_MASK 0x4 FORMAT "%13.11" ECU_ADDRESS 0x60002296 /end MEASUREMENT
/begin MEASUREMENT UEGO_IPmpCtrlS1B1_I.flgLoupNDesOld "IPmpCtrl Class instance for sensor 1 bank1 / Previous status of Nernst Loupe desired" UBYTE B_TRUE 1 100 0.00 1.00000000000 BIT_MASK 0x8 FORMAT "%13.11" ECU_ADDRESS 0x60002296 /end MEASUREMENT
/begin MEASUREMENT UEGO_IPmpCtrlS1B1_I.flgModSetIp "IPmpCtrl Class instance for sensor 1 bank1 / Mode of the setting of Ip Set (Setting of the integrator to a specific value)" UBYTE B_TRUE 1 100 0.00 1.00000000000 BIT_MASK 0x40 FORMAT "%13.11" ECU_ADDRESS 0x60002298 /end MEASUREMENT
/begin MEASUREMENT UEGO_IPmpCtrlS1B1_I.flgModSetIpOld "IPmpCtrl Class instance for sensor 1 bank1 / Previous mode of the setting of Ip Set" UBYTE B_TRUE 1 100 0.00 1.00000000000 BIT_MASK 0x80 FORMAT "%13.11" ECU_ADDRESS 0x60002298 /end MEASUREMENT
/begin MEASUREMENT UEGO_IPmpCtrlS1B1_I.flgRegSetSetIpOk "IPmpCtrl Class instance for sensor 1 bank1 / Writing of the Ip_Set mode to RegSet buffer successful" UBYTE B_TRUE 1 100 0.00 1.00000000000 BIT_MASK 0x2 FORMAT "%13.11" ECU_ADDRESS 0x60002299 /end MEASUREMENT
/begin MEASUREMENT UEGO_IPmpCtrlS1B1_I.flgSetIPmpOffTrig "IPmpCtrl Class instance for sensor 1 bank1 / Rising Edge for Adaption valid" UBYTE B_TRUE 1 100 0.00 1.00000000000 BIT_MASK 0x10 FORMAT "%13.11" ECU_ADDRESS 0x60002299 /end MEASUREMENT
/begin MEASUREMENT UEGO_IPmpCtrlS1B1_I.flgSetRegIPmpCtrlOk "IPmpCtrl Class instance for sensor 1 bank1 / Writting of register values of digital PID params to buffer successfull" UBYTE B_TRUE 1 100 0.00 1.00000000000 BIT_MASK 0x2 FORMAT "%13.11" ECU_ADDRESS 0x60002297 /end MEASUREMENT
/begin MEASUREMENT UEGO_IPmpCtrlS1B1_I.flgSetRegOk "IPmpCtrl Class instance for sensor 1 bank1 / register setting successful" UBYTE B_TRUE 1 100 0.00 1.00000000000 BIT_MASK 0x20 FORMAT "%13.11" ECU_ADDRESS 0x60002299 /end MEASUREMENT
/begin MEASUREMENT UEGO_IPmpCtrlS1B1_I.flgTHysInin "IPmpCtrl Class instance for sensor 1 bank1 / Status of initialization of temperature hysteresis" UBYTE B_TRUE 1 100 0.00 1.00000000000 BIT_MASK 0x4 FORMAT "%13.11" ECU_ADDRESS 0x60002298 /end MEASUREMENT
/begin MEASUREMENT UEGO_IPmpCtrlS1B1_I.nrModDesOld "IPmpCtrl Class instance for sensor 1 bank1 / Previous desired mode" UBYTE dez 1 100 0.00 255.0 FORMAT "%5.1" ECU_ADDRESS 0x6000229C /end MEASUREMENT
/begin MEASUREMENT UEGO_IPmpCtrlS1B1_I.nrModInt "IPmpCtrl Class instance for sensor 1 bank1 / Internal mode" UBYTE UEGO_IPmpCtrl_COMPU_VERB 1 100 0.00 3.00000000000 FORMAT "%13.11" ECU_ADDRESS 0x6000229D /end MEASUREMENT
/begin MEASUREMENT UEGO_IPmpCtrlS1B1_I.nrModIntOld "IPmpCtrl Class instance for sensor 1 bank1 / Previous status of internal mode" UBYTE UEGO_IPmpCtrl_COMPU_VERB 1 100 0.00 3.00000000000 FORMAT "%13.11" ECU_ADDRESS 0x6000229E /end MEASUREMENT
/begin MEASUREMENT UEGO_IPmpCtrlS1B1_I.nrRegKD "IPmpCtrl Class instance for sensor 1 bank1 / Digital derivative parameter for PID controller" UWORD OneToOne 1 100 0.00 8190.000 FORMAT "%8.3" ECU_ADDRESS 0x600022A0 /end MEASUREMENT
/begin MEASUREMENT UEGO_IPmpCtrlS1B1_I.nrRegKI "IPmpCtrl Class instance for sensor 1 bank1 / Digital integral parameter for PID controller" UWORD OneToOne 1 100 0.00 8190.000 FORMAT "%8.3" ECU_ADDRESS 0x600022A2 /end MEASUREMENT
/begin MEASUREMENT UEGO_IPmpCtrlS1B1_I.nrRegKP "IPmpCtrl Class instance for sensor 1 bank1 / Digital proportional parameter for PID controller" UWORD OneToOne 1 100 0.00 8190.000 FORMAT "%8.3" ECU_ADDRESS 0x600022A4 /end MEASUREMENT
/begin MEASUREMENT UEGO_IPmpCtrlS1B1_I.nrRegKRF "IPmpCtrl Class instance for sensor 1 bank1 / Digital feedback parameter for PID controller" UWORD OneToOne 1 100 0.00 127.0000 FORMAT "%8.4" ECU_ADDRESS 0x600022A6 /end MEASUREMENT
/begin MEASUREMENT UEGO_IPmpCtrlS1B1_I.nrSubModDesOld "IPmpCtrl Class instance for sensor 1 bank1 / Desired Sub mode in previous cycle" UBYTE dez 1 100 0.00 255.0 FORMAT "%5.1" ECU_ADDRESS 0x600022A8 /end MEASUREMENT
/begin MEASUREMENT UEGO_IPmpCtrlS1B1_I.prod1 "IPmpCtrl Class instance for sensor 1 bank1 / Intermediate Product 1" UWORD spg_q2p3842Em7_V 1 100 0.00 0.01562476 FORMAT "%10.8" ECU_ADDRESS 0x600022AA /end MEASUREMENT
/begin MEASUREMENT UEGO_IPmpCtrlS1B1_I.prod2 "IPmpCtrl Class instance for sensor 1 bank1 / Intermediate Product 2" FLOAT32_IEEE OneToOne 1 100 -2147483648.000 2147483647.000 FORMAT "%13.3" ECU_ADDRESS 0x600022AC /end MEASUREMENT
/begin MEASUREMENT UEGO_IPmpCtrlS1B1_I.tUnSwtThd "IPmpCtrl Class instance for sensor 1 bank1 / Current Temperature threshold for switching between PID param sets" UWORD temp_q0p0234_o273 1 100 -273.150 1262.827 FORMAT "%8.3" ECU_ADDRESS 0x600022B0 /end MEASUREMENT
/begin MEASUREMENT UEGO_IPmpCtrlS1B1_I.RegReclcnIPmpCtrlTR_I.timeCounter "IPmpCtrl Class instance for sensor 1 bank1 / Timer for periodic recalulation of digital PID params / Remaining time of the timer" UWORD t_q0p01 1 100 0.00 655.3500 FORMAT "%8.4" ECU_ADDRESS 0x600022B2 /end MEASUREMENT
/begin MEASUREMENT UEGO_IPmpCtrlS1B1_I.flgSetRegPIDERNM_I.oldSignal "IPmpCtrl Class instance for sensor 1 bank1 / Rising edge detection for retriggering register settings / value of input signal last calculation" UBYTE B_TRUE 1 100 0.00 1.00000000000 BIT_MASK 0x1 FORMAT "%13.11" ECU_ADDRESS 0x600022B4 /end MEASUREMENT
/begin MEASUREMENT UEGO_IPmpCtrlS1B1_I.flgTrigSetIpER_I.buffer "IPmpCtrl Class instance for sensor 1 bank1 / Rising edge detection for triggering of the Ip Set / rising edge detected" UBYTE B_TRUE 1 100 0.00 1.00000000000 BIT_MASK 0x1 FORMAT "%13.11" ECU_ADDRESS 0x600022B6 /end MEASUREMENT
/begin MEASUREMENT UEGO_IPmpCtrlS1B1_I.flgTrigSetIpER_I.oldSignal "IPmpCtrl Class instance for sensor 1 bank1 / Rising edge detection for triggering of the Ip Set / flag rising edge" UBYTE B_TRUE 1 100 0.00 1.00000000000 BIT_MASK 0x1 FORMAT "%13.11" ECU_ADDRESS 0x600022B7 /end MEASUREMENT
/begin MEASUREMENT UEGO_iPmpIsqrS1B1 "pump cell reference pump current sensor 1 bank 1" SWORD i_q6p6667Em7_A 1 100 -0.02184533 0.02184467 FORMAT "%10.8" ECU_ADDRESS 0x600096C6 /end MEASUREMENT
/begin MEASUREMENT UEGO_IPmpLimnEvlnClassS1B1_I.flgIPmpLimdLi "Class IPmp Limitation Evaluation / internal varaible for flgIPmpLimdLicalculation" UBYTE B_TRUE 1 100 0.00 1.00000000000 BIT_MASK 0x1 FORMAT "%13.11" ECU_ADDRESS 0x60006F1E /end MEASUREMENT
/begin MEASUREMENT UEGO_IPmpLimnEvlnClassS1B1_I.flgIPmpLimdPckVld "Class IPmp Limitation Evaluation / validity flag for IPmpLimdPck" UBYTE B_TRUE 1 100 0.00 1.00000000000 BIT_MASK 0x1 FORMAT "%13.11" ECU_ADDRESS 0x60006F1F /end MEASUREMENT
/begin MEASUREMENT UEGO_IPmpLimnEvlnClassS1B1_I.flgIPmpLimdSev "Class IPmp Limitation Evaluation / internal varaible for flgIPmpLimdSev calculation" UBYTE B_TRUE 1 100 0.00 1.00000000000 BIT_MASK 0x1 FORMAT "%13.11" ECU_ADDRESS 0x60006F20 /end MEASUREMENT
/begin MEASUREMENT UEGO_IPmpLimnEvlnClassS1B1_I.flgIPmpLimdVld "Class IPmp Limitation Evaluation / internal varaible for flgIPmpLimVld calculation" UBYTE B_TRUE 1 100 0.00 1.00000000000 BIT_MASK 0x1 FORMAT "%13.11" ECU_ADDRESS 0x60006F21 /end MEASUREMENT
/begin MEASUREMENT UEGO_IPmpLimnEvlnClassS1B1_I.nrIPmpLimdPck "Class IPmp Limitation Evaluation / Number of limited packs" UBYTE dez 1 100 0.00 255.0 FORMAT "%5.1" ECU_ADDRESS 0x60006F22 /end MEASUREMENT
/begin MEASUREMENT UEGO_IPmpPckS1B1_I.flgIPmpNotDistrbd "Class instance of the functional class of FC UEGO_IPmpPck for Bank 1 Sensor 1 / True, if input is not disturbed." UBYTE B_TRUE 1 100 0.00 1.00000000000 BIT_MASK 0x1 FORMAT "%13.11" ECU_ADDRESS 0x60002238 /end MEASUREMENT
/begin MEASUREMENT UEGO_IPmpPckS1B1_I.flgIPmpNotDistrbdRaw "Class instance of the functional class of FC UEGO_IPmpPck for Bank 1 Sensor 1 / Corresponds to flgIPmpNotDistrbd before a Turn-On-Delay is executed." UBYTE B_TRUE 1 100 0.00 1.00000000000 BIT_MASK 0x1 FORMAT "%13.11" ECU_ADDRESS 0x60002239 /end MEASUREMENT
/begin MEASUREMENT UEGO_IPmpPckS1B1_I.flgIPmpPckHiPrcsn "Class instance of the functional class of FC UEGO_IPmpPck for Bank 1 Sensor 1 / high precision information for electrical corrected pump current package" UBYTE B_TRUE 1 100 0.00 1.00000000000 BIT_MASK 0x1 FORMAT "%13.11" ECU_ADDRESS 0x6000223A /end MEASUREMENT
/begin MEASUREMENT UEGO_IPmpPckS1B1_I.flgIPmpPckVld "Class instance of the functional class of FC UEGO_IPmpPck for Bank 1 Sensor 1 / Indication for validity of current pump current package" UBYTE B_TRUE 1 100 0.00 1.00000000000 BIT_MASK 0x1 FORMAT "%13.11" ECU_ADDRESS 0x6000223B /end MEASUREMENT
/begin MEASUREMENT UEGO_IPmpPckS1B1_I.flgIPmpRawAvrgVld "Class instance of the functional class of FC UEGO_IPmpPck for Bank 1 Sensor 1 / Validityflag of the package average of the raw pump current" UBYTE B_TRUE 1 100 0.00 1.00000000000 BIT_MASK 0x1 FORMAT "%13.11" ECU_ADDRESS 0x6000223C /end MEASUREMENT
/begin MEASUREMENT UEGO_IPmpPckS1B1_I.iIPmpPckAvrg "Class instance of the functional class of FC UEGO_IPmpPck for Bank 1 Sensor 1 / average of pump current values in a package after correction" SWORD i_q6p6667Em7_A 1 100 -0.02184533 0.02184467 FORMAT "%10.8" ECU_ADDRESS 0x6000223E /end MEASUREMENT
/begin MEASUREMENT UEGO_IPmpPckS1B1_I.iIPmpRawAvrg "Class instance of the functional class of FC UEGO_IPmpPck for Bank 1 Sensor 1 / the package average of the raw pump current" SWORD i_q6p6667Em7_A 1 100 -0.02184533 0.02184467 FORMAT "%10.8" ECU_ADDRESS 0x60002240 /end MEASUREMENT
/begin MEASUREMENT UEGO_IPmpPckS1B1_I.iIPmpRawLst "Class instance of the functional class of FC UEGO_IPmpPck for Bank 1 Sensor 1 / Last pump current value of last pump current package" SWORD i_q6p6667Em7_A 1 100 -0.02184533 0.02184467 FORMAT "%10.8" ECU_ADDRESS 0x60002242 /end MEASUREMENT
/begin MEASUREMENT UEGO_IPmpPckS1B1_I.stIPmpPckHiPrcsn "Class instance of the functional class of FC UEGO_IPmpPck for Bank 1 Sensor 1 / Status word for inputs for precision information for package filtered pump current" UBYTE OneToOne 1 100 0.00 255.0 FORMAT "%5.1" ECU_ADDRESS 0x60002244 /end MEASUREMENT
/begin MEASUREMENT UEGO_IPmpPckS1B1_I.UEGO_DlyIPmpNotDistrbdOnTONV_I.outbit "Class instance of the functional class of FC UEGO_IPmpPck for Bank 1 Sensor 1 / Turn-On-Delay applied to flgIPmpNotDistrbdRaw, which has flgIPmpNotDistrbd as an output. / return value" UBYTE B_TRUE 1 100 0.00 1.00000000000 BIT_MASK 0x1 FORMAT "%13.11" ECU_ADDRESS 0x60002246 /end MEASUREMENT
/begin MEASUREMENT UEGO_IPmpPckS1B1_I.UEGO_DlyIPmpNotDistrbdOnTONV_I.time "Class instance of the functional class of FC UEGO_IPmpPck for Bank 1 Sensor 1 / Turn-On-Delay applied to flgIPmpNotDistrbdRaw, which has flgIPmpNotDistrbd as an output. / expired delay time" UBYTE t_q0p005 1 100 0.00 1.275 FORMAT "%5.3" ECU_ADDRESS 0x60002247 /end MEASUREMENT
/begin MEASUREMENT UEGO_IPmpPckS1B1_I.UEGO_IPmpPck15VectDL_I.memory "Class instance of the functional class of FC UEGO_IPmpPck for Bank 1 Sensor 1 / instance of a vector filter for arrays of dimension 15 / array average distance to package average" SLONG ASCET_1 1 100 -0.0218453333333 0.0218453333232 FORMAT "%15.13" ARRAY_SIZE 15 ECU_ADDRESS 0x60002248 /end MEASUREMENT
/begin MEASUREMENT UEGO_IPmpPckS1B1_I.UEGO_Ip_EvlnFilDlydVldy_I.flgFilVldy "Class instance of the functional class of FC UEGO_IPmpPck for Bank 1 Sensor 1 / instance of a filter for pump current evaluation / Validity Flag." UBYTE B_TRUE 1 100 0.00 1.00000000000 BIT_MASK 0x1 FORMAT "%13.11" ECU_ADDRESS 0x60002284 /end MEASUREMENT
/begin MEASUREMENT UEGO_IPmpPckS1B1_I.UEGO_Ip_EvlnFilDlydVldy_I.nrSampleCurr "Class instance of the functional class of FC UEGO_IPmpPck for Bank 1 Sensor 1 / instance of a filter for pump current evaluation / Current sample count." UWORD OneToOne 1 100 0.00 65535.00 FORMAT "%8.2" ECU_ADDRESS 0x60002286 /end MEASUREMENT
/begin MEASUREMENT UEGO_IPmpPckS1B1_I.UEGO_Ip_EvlnFilDlydVldy_I.nrSampleRef "Class instance of the functional class of FC UEGO_IPmpPck for Bank 1 Sensor 1 / instance of a filter for pump current evaluation / Reciprocal of Filter time constant." ULONG fak_uw_b2 1 100 0.00 131071.999969 FORMAT "%13.6" ECU_ADDRESS 0x60002288 /end MEASUREMENT
/begin MEASUREMENT UEGO_IPmpPckS1B1_I.UEGO_Ip_EvlnFilDlydVldy_I.nrSampleThd "Class instance of the functional class of FC UEGO_IPmpPck for Bank 1 Sensor 1 / instance of a filter for pump current evaluation / Total number of samples." UWORD OneToOne 1 100 1.00 65535.00 FORMAT "%8.2" ECU_ADDRESS 0x6000228C /end MEASUREMENT
/begin MEASUREMENT UEGO_IPmpPckS1B1_I.UEGO_Ip_EvlnFilDlydVldy_I.EvlnFil_DL_I.memory "Class instance of the functional class of FC UEGO_IPmpPck for Bank 1 Sensor 1 / instance of a filter for pump current evaluation / Filter functionality with delayed validity. / current lowpass value" SLONG i_q1p01725Em11_A 1 100 -0.0218453333333 0.0218453333232 FORMAT "%15.13" ECU_ADDRESS 0x60002290 /end MEASUREMENT
/begin MEASUREMENT UEGO_iPmpPlsFirstAryS1B1 "Pump current pulse amplitude in asic switching state Z2 for sensor 1 bank 1" SWORD i_q6p6667Em7_A 1 100 -0.02184533 0.02184467 FORMAT "%10.8" ARRAY_SIZE 5 ECU_ADDRESS 0x600096BA /end MEASUREMENT
/begin MEASUREMENT UEGO_iPmpPlsSecAryS1B1 "Pump current pulse amplitude in asic switching state Z1 for sensor 1 bank 1" SWORD i_q6p6667Em7_A 1 100 -0.02184533 0.02184467 FORMAT "%10.8" ARRAY_SIZE 5 ECU_ADDRESS 0x600096B0 /end MEASUREMENT
/begin MEASUREMENT UEGO_IPmpRefCtrlS1B1_I.flgRefPatSetVld "Class instance of the functional class of FC UEGO_IPmpRef for the control-part for Bank 1 Sensor 1 / indicator for successful setting of the REFPAT-register" UBYTE B_TRUE 1 100 0.00 1.00000000000 BIT_MASK 0x40 FORMAT "%13.11" ECU_ADDRESS 0x60006F0A /end MEASUREMENT
/begin MEASUREMENT UEGO_IPmpRefCtrlS1B1_I.nrModIntCtrl "Class instance of the functional class of FC UEGO_IPmpRef for the control-part for Bank 1 Sensor 1 / numerical indication for the currently active control state (REFPAT)" UBYTE UEGO_ModIPmpRefCtrl_COMPU_VERB 1 100 1.00000000000 9.00000000000 FORMAT "%13.11" ECU_ADDRESS 0x60006F0B /end MEASUREMENT
/begin MEASUREMENT UEGO_IPmpRefCtrlS1B1_I.nrModIntCtrlOld "Class instance of the functional class of FC UEGO_IPmpRef for the control-part for Bank 1 Sensor 1 / numerical indication for the previously active control state (REFPAT)" UBYTE UEGO_ModIPmpRefCtrl_COMPU_VERB 1 100 1.00000000000 9.00000000000 FORMAT "%13.11" ECU_ADDRESS 0x60006F0C /end MEASUREMENT
/begin MEASUREMENT UEGO_IPmpRefCtrlS1B1_I.stRefPatIniNorm "Class instance of the functional class of FC UEGO_IPmpRef for the control-part for Bank 1 Sensor 1 / internal value of the REFPAT Register for reference current in normal initial mode" UWORD dez 1 100 0.00 65535.00 FORMAT "%8.2" ECU_ADDRESS 0x60006F0E /end MEASUREMENT
/begin MEASUREMENT UEGO_IPmpRefCtrlS1B1_I.stRefPatIniWrmUp "Class instance of the functional class of FC UEGO_IPmpRef for the control-part for Bank 1 Sensor 1 / internal value of the REFPAT Register for reference current in warmup initial mode" UWORD dez 1 100 0.00 65535.00 FORMAT "%8.2" ECU_ADDRESS 0x60006F10 /end MEASUREMENT
/begin MEASUREMENT UEGO_IPmpRefCtrlS1B1_I.stRefPatNorm "Class instance of the functional class of FC UEGO_IPmpRef for the control-part for Bank 1 Sensor 1 / internal private value of the REFPAT Register for reference current in normal mode" UWORD dez 1 100 0.00 65535.00 FORMAT "%8.2" ECU_ADDRESS 0x60006F12 /end MEASUREMENT
/begin MEASUREMENT UEGO_IPmpRefCtrlS1B1_I.stRefPatRglNorm "Class instance of the functional class of FC UEGO_IPmpRef for the control-part for Bank 1 Sensor 1 / internal value of the REFPAT Register for reference current in normal regular mode" UWORD dez 1 100 0.00 65535.00 FORMAT "%8.2" ECU_ADDRESS 0x60006F14 /end MEASUREMENT
/begin MEASUREMENT UEGO_IPmpRefCtrlS1B1_I.stRefPatRglWrmUp "Class instance of the functional class of FC UEGO_IPmpRef for the control-part for Bank 1 Sensor 1 / internal value of the REFPAT Register for reference current in warmup regular mode" UWORD dez 1 100 0.00 65535.00 FORMAT "%8.2" ECU_ADDRESS 0x60006F16 /end MEASUREMENT
/begin MEASUREMENT UEGO_IPmpRefCtrlS1B1_I.stRefPatStopNorm "Class instance of the functional class of FC UEGO_IPmpRef for the control-part for Bank 1 Sensor 1 / internal value of the REFPAT Register for reference current in normal stop mode" UWORD dez 1 100 0.00 65535.00 FORMAT "%8.2" ECU_ADDRESS 0x60006F18 /end MEASUREMENT
/begin MEASUREMENT UEGO_IPmpRefCtrlS1B1_I.stRefPatStopWrmUp "Class instance of the functional class of FC UEGO_IPmpRef for the control-part for Bank 1 Sensor 1 / internal value of the REFPAT Register for reference current in warmup stop mode" UWORD dez 1 100 0.00 65535.00 FORMAT "%8.2" ECU_ADDRESS 0x60006F1A /end MEASUREMENT
/begin MEASUREMENT UEGO_IPmpRefCtrlS1B1_I.stRefPatWrmUp "Class instance of the functional class of FC UEGO_IPmpRef for the control-part for Bank 1 Sensor 1 / internal private value of the REFPAT Register for reference current in warmup mode" UWORD dez 1 100 0.00 65535.00 FORMAT "%8.2" ECU_ADDRESS 0x60006F1C /end MEASUREMENT
/begin MEASUREMENT UEGO_IPmpRefEvlnS1B1_I.flgNernstIsqrVld "Class instance of the functional class of FC UEGO_IPmpRef for the evaluation-part for Bank 1 Sensor 1 / validity of the nernst cell for the reference pump current" UBYTE B_TRUE 1 100 0.00 1.00000000000 BIT_MASK 0x1 FORMAT "%13.11" ECU_ADDRESS 0x60002220 /end MEASUREMENT
/begin MEASUREMENT UEGO_IPmpRefEvlnS1B1_I.flgPmpIsqrVld "Class instance of the functional class of FC UEGO_IPmpRef for the evaluation-part for Bank 1 Sensor 1 / validity of the pump cell for the reference pump current" UBYTE B_TRUE 1 100 0.00 1.00000000000 BIT_MASK 0x1 FORMAT "%13.11" ECU_ADDRESS 0x60002221 /end MEASUREMENT
/begin MEASUREMENT UEGO_IPmpRefEvlnS1B1_I.flgRefpatVld "Class instance of the functional class of FC UEGO_IPmpRef for the evaluation-part for Bank 1 Sensor 1 / validity of the reference pump current" UBYTE B_TRUE 1 100 0.00 1.00000000000 BIT_MASK 0x1 FORMAT "%13.11" ECU_ADDRESS 0x60002222 /end MEASUREMENT
/begin MEASUREMENT UEGO_IPmpRefEvlnS1B1_I.flgTiPlsPckVld "Class instance of the functional class of FC UEGO_IPmpRef for the evaluation-part for Bank 1 Sensor 1 / internal value of the validity for the pulse-timing-package" UBYTE B_TRUE 1 100 0.00 1.00000000000 BIT_MASK 0x1 FORMAT "%13.11" ECU_ADDRESS 0x60002223 /end MEASUREMENT
/begin MEASUREMENT UEGO_IPmpRefEvlnS1B1_I.iNernstIsqr "Class instance of the functional class of FC UEGO_IPmpRef for the evaluation-part for Bank 1 Sensor 1 / internal value of the nernst cell reference pump current" SWORD i_q6p6667Em7_A 1 100 -0.02184533 0.02184467 FORMAT "%10.8" ECU_ADDRESS 0x60002224 /end MEASUREMENT
/begin MEASUREMENT UEGO_IPmpRefEvlnS1B1_I.iPmpIsqr "Class instance of the functional class of FC UEGO_IPmpRef for the evaluation-part for Bank 1 Sensor 1 / internal value of the pump cell reference pump current" SLONG i_q6p6667Em7_A 1 100 -0.0218453333333 0.0218446666667 FORMAT "%15.13" ECU_ADDRESS 0x60002228 /end MEASUREMENT
/begin MEASUREMENT UEGO_IPmpRefEvlnS1B1_I.nrModIntEvalIsqr "Class instance of the functional class of FC UEGO_IPmpRef for the evaluation-part for Bank 1 Sensor 1 / numerical indication for the currently active evaluation Isqr-state" UBYTE UEGO_ModIPmpRefEvalIsqr_COMPU_VERB 1 100 1.0000000000 12.0000000000 FORMAT "%13.10" ECU_ADDRESS 0x6000222C /end MEASUREMENT
/begin MEASUREMENT UEGO_IPmpRefEvlnS1B1_I.nrModIntEvalIsqrOld "Class instance of the functional class of FC UEGO_IPmpRef for the evaluation-part for Bank 1 Sensor 1 / numerical indication for the previously active evaluation Isqr-state" UBYTE UEGO_ModIPmpRefEvalIsqr_COMPU_VERB 1 100 1.0000000000 12.0000000000 FORMAT "%13.10" ECU_ADDRESS 0x6000222D /end MEASUREMENT
/begin MEASUREMENT UEGO_IPmpRefEvlnS1B1_I.nrRefPatSet "Class instance of the functional class of FC UEGO_IPmpRef for the evaluation-part for Bank 1 Sensor 1 / refpat register set number" UBYTE dez 1 100 0.00 255.0 FORMAT "%5.1" ECU_ADDRESS 0x6000222E /end MEASUREMENT
/begin MEASUREMENT UEGO_IPmpRefEvlnS1B1_I.tiPlsNernstPck "Class instance of the functional class of FC UEGO_IPmpRef for the evaluation-part for Bank 1 Sensor 1 / internal value of the validity for the pulse-timing-package for the nernst cell" SLONG t_q0p01_us 1 100 -21474836.4800 21474836.4700 FORMAT "%13.4" ECU_ADDRESS 0x60002230 /end MEASUREMENT
/begin MEASUREMENT UEGO_IPmpRefEvlnS1B1_I.tiPlsPmpPck "Class instance of the functional class of FC UEGO_IPmpRef for the evaluation-part for Bank 1 Sensor 1 / internal value of the validity for the pulse-timing-package for the pump cell" SLONG t_q0p01_us 1 100 -21474836.4800 21474836.4700 FORMAT "%13.4" ECU_ADDRESS 0x60002234 /end MEASUREMENT
/begin MEASUREMENT UEGO_IPmpSegS1B1_I.flgIPmpHiPrcsn "Class instance of the functional class of FC UEGO_IPmpSeg for Bank 1 Sensor 1 / Status of high precision pump current" UBYTE B_TRUE 1 100 0.00 1.00000000000 BIT_MASK 0x1 FORMAT "%13.11" ECU_ADDRESS 0x600021ED /end MEASUREMENT
/begin MEASUREMENT UEGO_IPmpSegS1B1_I.flgIPmpSegFltVld "Class instance of the functional class of FC UEGO_IPmpSeg for Bank 1 Sensor 1 / Indication for validity of filtered pump current" UBYTE B_TRUE 1 100 0.00 1.00000000000 BIT_MASK 0x2 FORMAT "%13.11" ECU_ADDRESS 0x600021EC /end MEASUREMENT
/begin MEASUREMENT UEGO_IPmpSegS1B1_I.flgIPmpSegFull "Class instance of the functional class of FC UEGO_IPmpSeg for Bank 1 Sensor 1 / Indication for already filled ring buffer for IP segment calculation" UBYTE B_TRUE 1 100 0.00 1.00000000000 BIT_MASK 0x1 FORMAT "%13.11" ECU_ADDRESS 0x600021EC /end MEASUREMENT
/begin MEASUREMENT UEGO_IPmpSegS1B1_I.flgIPmpSegNoAdpdVld "Class instance of the functional class of FC UEGO_IPmpSeg for Bank 1 Sensor 1 / Validity information for Segment filtered pump current without offset adaption" UBYTE B_TRUE 1 100 0.00 1.00000000000 BIT_MASK 0x1 FORMAT "%13.11" ECU_ADDRESS 0x600021EE /end MEASUREMENT
/begin MEASUREMENT UEGO_IPmpSegS1B1_I.flgIPmpSegVld "Class instance of the functional class of FC UEGO_IPmpSeg for Bank 1 Sensor 1 / Indication for validity of current pump current segment" UBYTE B_TRUE 1 100 0.00 1.00000000000 BIT_MASK 0x1 FORMAT "%13.11" ECU_ADDRESS 0x600021EF /end MEASUREMENT
/begin MEASUREMENT UEGO_IPmpSegS1B1_I.iIPmpSegFild "Class instance of the functional class of FC UEGO_IPmpSeg for Bank 1 Sensor 1 / Indication for filtered pump current" SWORD i_q6p6667Em7_A 1 100 -0.02184533 0.02184467 FORMAT "%10.8" ECU_ADDRESS 0x600021F0 /end MEASUREMENT
/begin MEASUREMENT UEGO_IPmpSegS1B1_I.iIPmpSegNoAdpd "Class instance of the functional class of FC UEGO_IPmpSeg for Bank 1 Sensor 1 / Segment filtered pump current without offset adaption" SWORD i_q6p6667Em7_A 1 100 -0.02184533 0.02184467 FORMAT "%10.8" ECU_ADDRESS 0x600021F2 /end MEASUREMENT
/begin MEASUREMENT UEGO_IPmpSegS1B1_I.iIPmpSegPartSumAry "Class instance of the functional class of FC UEGO_IPmpSeg for Bank 1 Sensor 1 / Array for pump current sums of segment parts" SLONG i_q6p6667Em7_A 1 100 -1431.65576533 1431.65576467 FORMAT "%13.8" ARRAY_SIZE 4 ECU_ADDRESS 0x600021F4 /end MEASUREMENT
/begin MEASUREMENT UEGO_IPmpSegS1B1_I.iIPmpSegUnFild "Class instance of the functional class of FC UEGO_IPmpSeg for Bank 1 Sensor 1 / Indication for unfiltered pump current" SWORD i_q6p6667Em7_A 1 100 -0.02184533 0.02184467 FORMAT "%10.8" ECU_ADDRESS 0x60002204 /end MEASUREMENT
/begin MEASUREMENT UEGO_IPmpSegS1B1_I.nrCtrSegPartSumAry "Class instance of the functional class of FC UEGO_IPmpSeg for Bank 1 Sensor 1 / Array for counter of segment parts" UBYTE dez 1 100 0.00 255.0 FORMAT "%5.1" ARRAY_SIZE 4 ECU_ADDRESS 0x60002206 /end MEASUREMENT
/begin MEASUREMENT UEGO_IPmpSegS1B1_I.nrModIPmpSeg "Class instance of the functional class of FC UEGO_IPmpSeg for Bank 1 Sensor 1 / Internal mode of the FC UEGO_IPmpSeg" UBYTE UEGO_IPmpSeg_COMPU_VERB 1 100 1.00000000000 6.00000000000 FORMAT "%13.11" ECU_ADDRESS 0x6000220A /end MEASUREMENT
/begin MEASUREMENT UEGO_IPmpSegS1B1_I.nrSegPartMax "Class instance of the functional class of FC UEGO_IPmpSeg for Bank 1 Sensor 1 / Maximum number of values in current segment part" UBYTE dez 1 100 0.00 255.0 FORMAT "%5.1" ECU_ADDRESS 0x6000220B /end MEASUREMENT
/begin MEASUREMENT UEGO_IPmpSegS1B1_I.nrSegPartPosCurr "Class instance of the functional class of FC UEGO_IPmpSeg for Bank 1 Sensor 1 / Current position in the segment array" UBYTE dez 1 100 0.00 255.0 FORMAT "%5.1" ECU_ADDRESS 0x6000220C /end MEASUREMENT
/begin MEASUREMENT UEGO_IPmpSegS1B1_I.UEGO_IPmpHIPrcsnTONV_I.outbit "Class instance of the functional class of FC UEGO_IPmpSeg for Bank 1 Sensor 1 / Status Precision of segfiltered pump current / return value" UBYTE B_TRUE 1 100 0.00 1.00000000000 BIT_MASK 0x1 FORMAT "%13.11" ECU_ADDRESS 0x6000220E /end MEASUREMENT
/begin MEASUREMENT UEGO_IPmpSegS1B1_I.UEGO_IPmpHIPrcsnTONV_I.time "Class instance of the functional class of FC UEGO_IPmpSeg for Bank 1 Sensor 1 / Status Precision of segfiltered pump current / expired delay time" UBYTE t_q0p005 1 100 0.00 1.275 FORMAT "%5.3" ECU_ADDRESS 0x6000220F /end MEASUREMENT
/begin MEASUREMENT UEGO_IPmpSegS1B1_I.iIPmpSegFilt_DL_I.flgFilVldy "Class instance of the functional class of FC UEGO_IPmpSeg for Bank 1 Sensor 1 / Instance for IPmpSeg filter / Validity Flag." UBYTE B_TRUE 1 100 0.00 1.00000000000 BIT_MASK 0x1 FORMAT "%13.11" ECU_ADDRESS 0x60002210 /end MEASUREMENT
/begin MEASUREMENT UEGO_IPmpSegS1B1_I.iIPmpSegFilt_DL_I.nrSampleCurr "Class instance of the functional class of FC UEGO_IPmpSeg for Bank 1 Sensor 1 / Instance for IPmpSeg filter / Current sample count." UWORD OneToOne 1 100 0.00 65535.00 FORMAT "%8.2" ECU_ADDRESS 0x60002212 /end MEASUREMENT
/begin MEASUREMENT UEGO_IPmpSegS1B1_I.iIPmpSegFilt_DL_I.nrSampleRef "Class instance of the functional class of FC UEGO_IPmpSeg for Bank 1 Sensor 1 / Instance for IPmpSeg filter / Reciprocal of Filter time constant." ULONG fak_uw_b2 1 100 0.00 131071.999969 FORMAT "%13.6" ECU_ADDRESS 0x60002214 /end MEASUREMENT
/begin MEASUREMENT UEGO_IPmpSegS1B1_I.iIPmpSegFilt_DL_I.nrSampleThd "Class instance of the functional class of FC UEGO_IPmpSeg for Bank 1 Sensor 1 / Instance for IPmpSeg filter / Total number of samples." UWORD OneToOne 1 100 1.00 65535.00 FORMAT "%8.2" ECU_ADDRESS 0x60002218 /end MEASUREMENT
/begin MEASUREMENT UEGO_IPmpSegS1B1_I.iIPmpSegFilt_DL_I.EvlnFil_DL_I.memory "Class instance of the functional class of FC UEGO_IPmpSeg for Bank 1 Sensor 1 / Instance for IPmpSeg filter / Filter functionality with delayed validity. / current lowpass value" SLONG i_q1p01725Em11_A 1 100 -0.0218453333333 0.0218453333232 FORMAT "%15.13" ECU_ADDRESS 0x6000221C /end MEASUREMENT
/begin MEASUREMENT UEGO_ISrcCtrlS1B1_I.flgSetRegISq "Class instance for sensor 1 bank 1, for controlling current sources (Isq, Isqr, IsqM and IsqrM) of asic by means of setting appropriate value in to register / Indicates desired Isq current amplitude setting in to TRMSQ register is successful or not" UBYTE B_TRUE 1 100 0.00 1.00000000000 BIT_MASK 0x1 FORMAT "%13.11" ECU_ADDRESS 0x600021C0 /end MEASUREMENT
/begin MEASUREMENT UEGO_ISrcCtrlS1B1_I.flgSetRegISqr "Class instance for sensor 1 bank 1, for controlling current sources (Isq, Isqr, IsqM and IsqrM) of asic by means of setting appropriate value in to register / Indicates desired Isqr current amplitude setting in to register is successful or not" UBYTE B_TRUE 1 100 0.00 1.00000000000 BIT_MASK 0x1 FORMAT "%13.11" ECU_ADDRESS 0x600021C1 /end MEASUREMENT
/begin MEASUREMENT UEGO_ISrcCtrlS1B1_I.iIsqDes "Class instance for sensor 1 bank 1, for controlling current sources (Isq, Isqr, IsqM and IsqrM) of asic by means of setting appropriate value in to register / Desired Isq" UWORD i_q6p6667Em7_A 1 100 0.00 0.04369000 FORMAT "%10.8" ECU_ADDRESS 0x600021C2 /end MEASUREMENT
/begin MEASUREMENT UEGO_ISrcCtrlS1B1_I.iIsqrDes "Class instance for sensor 1 bank 1, for controlling current sources (Isq, Isqr, IsqM and IsqrM) of asic by means of setting appropriate value in to register / Desired Isqr" UWORD i_q6p667Em8_A 1 100 0.00 0.004369000 FORMAT "%11.9" ECU_ADDRESS 0x600021C4 /end MEASUREMENT
/begin MEASUREMENT UEGO_ISrcCtrlS1B1_I.nrIsqDes "Class instance for sensor 1 bank 1, for controlling current sources (Isq, Isqr, IsqM and IsqrM) of asic by means of setting appropriate value in to register / Desired Isq internal number" UBYTE dez 1 100 0.00 255.0 FORMAT "%5.1" ECU_ADDRESS 0x600021C6 /end MEASUREMENT
/begin MEASUREMENT UEGO_ISrcCtrlS1B1_I.nrIsqrDes "Class instance for sensor 1 bank 1, for controlling current sources (Isq, Isqr, IsqM and IsqrM) of asic by means of setting appropriate value in to register / Desired Isqr internal number" UBYTE dez 1 100 0.00 127.0 FORMAT "%5.1" ECU_ADDRESS 0x600021C7 /end MEASUREMENT
/begin MEASUREMENT UEGO_ISrcCtrlS1B1_I.nrModInt "Class instance for sensor 1 bank 1, for controlling current sources (Isq, Isqr, IsqM and IsqrM) of asic by means of setting appropriate value in to register / Current Isrc internal mode for control class" UBYTE UEGO_ISrc_COMPU_VERB 1 100 0.00 7.00000000000 FORMAT "%13.11" ECU_ADDRESS 0x600021C8 /end MEASUREMENT
/begin MEASUREMENT UEGO_ISrcCtrlS1B1_I.nrModIntOld "Class instance for sensor 1 bank 1, for controlling current sources (Isq, Isqr, IsqM and IsqrM) of asic by means of setting appropriate value in to register / Previous Isrc internal mode for control class" UBYTE UEGO_ISrc_COMPU_VERB 1 100 0.00 7.00000000000 FORMAT "%13.11" ECU_ADDRESS 0x600021C9 /end MEASUREMENT
/begin MEASUREMENT UEGO_ISrcCtrlS1B1_I.UEGO_ISrcRglnClass_Isq.iISrcDes "Class instance for sensor 1 bank 1, for controlling current sources (Isq, Isqr, IsqM and IsqrM) of asic by means of setting appropriate value in to register / . / ." SLONG i_q6p667Em8_A 1 100 -0.0218453333333 0.0218446666667 FORMAT "%15.13" ECU_ADDRESS 0x600021CC /end MEASUREMENT
/begin MEASUREMENT UEGO_ISrcCtrlS1B1_I.UEGO_ISrcRglnClass_Isq.iISrcRglnLowrThd "Class instance for sensor 1 bank 1, for controlling current sources (Isq, Isqr, IsqM and IsqrM) of asic by means of setting appropriate value in to register / . / ." SLONG i_q6p667Em8_A 1 100 -0.0218453333333 0.0218446666667 FORMAT "%15.13" ECU_ADDRESS 0x600021D0 /end MEASUREMENT
/begin MEASUREMENT UEGO_ISrcCtrlS1B1_I.UEGO_ISrcRglnClass_Isq.iISrcRglnUpprThd "Class instance for sensor 1 bank 1, for controlling current sources (Isq, Isqr, IsqM and IsqrM) of asic by means of setting appropriate value in to register / . / ." SLONG i_q6p667Em8_A 1 100 -0.0218453333333 0.0218446666667 FORMAT "%15.13" ECU_ADDRESS 0x600021D4 /end MEASUREMENT
/begin MEASUREMENT UEGO_ISrcCtrlS1B1_I.UEGO_ISrcRglnClass_Isq.nrISrcDes "Class instance for sensor 1 bank 1, for controlling current sources (Isq, Isqr, IsqM and IsqrM) of asic by means of setting appropriate value in to register / . / ." UBYTE OneToOne 1 100 0.00 255.0 FORMAT "%5.1" ECU_ADDRESS 0x600021D8 /end MEASUREMENT
/begin MEASUREMENT UEGO_ISrcCtrlS1B1_I.UEGO_ISrcRglnClass_Isq.nrISrcRglnCntr "Class instance for sensor 1 bank 1, for controlling current sources (Isq, Isqr, IsqM and IsqrM) of asic by means of setting appropriate value in to register / . / ." UBYTE dez 1 100 0.00 255.0 FORMAT "%5.1" ECU_ADDRESS 0x600021D9 /end MEASUREMENT
/begin MEASUREMENT UEGO_ISrcCtrlS1B1_I.UEGO_ISrcRglnClass_Isq.nrModIntRgln "Class instance for sensor 1 bank 1, for controlling current sources (Isq, Isqr, IsqM and IsqrM) of asic by means of setting appropriate value in to register / . / ." UBYTE UEGO_ISrc_RGLN_COMPU_VERB 1 100 0.00 4.00000000000 FORMAT "%13.11" ECU_ADDRESS 0x600021DA /end MEASUREMENT
/begin MEASUREMENT UEGO_ISrcCtrlS1B1_I.UEGO_ISrcRglnClass_Isq.nrModIntRglnOld "Class instance for sensor 1 bank 1, for controlling current sources (Isq, Isqr, IsqM and IsqrM) of asic by means of setting appropriate value in to register / . / ." UBYTE UEGO_ISrc_RGLN_COMPU_VERB 1 100 0.00 4.00000000000 FORMAT "%13.11" ECU_ADDRESS 0x600021DB /end MEASUREMENT
/begin MEASUREMENT UEGO_ISrcCtrlS1B1_I.UEGO_ISrcRglnClass_Isqr.iISrcDes "Class instance for sensor 1 bank 1, for controlling current sources (Isq, Isqr, IsqM and IsqrM) of asic by means of setting appropriate value in to register / . / ." SLONG i_q6p667Em8_A 1 100 -0.0218453333333 0.0218446666667 FORMAT "%15.13" ECU_ADDRESS 0x600021DC /end MEASUREMENT
/begin MEASUREMENT UEGO_ISrcCtrlS1B1_I.UEGO_ISrcRglnClass_Isqr.iISrcRglnLowrThd "Class instance for sensor 1 bank 1, for controlling current sources (Isq, Isqr, IsqM and IsqrM) of asic by means of setting appropriate value in to register / . / ." SLONG i_q6p667Em8_A 1 100 -0.0218453333333 0.0218446666667 FORMAT "%15.13" ECU_ADDRESS 0x600021E0 /end MEASUREMENT
/begin MEASUREMENT UEGO_ISrcCtrlS1B1_I.UEGO_ISrcRglnClass_Isqr.iISrcRglnUpprThd "Class instance for sensor 1 bank 1, for controlling current sources (Isq, Isqr, IsqM and IsqrM) of asic by means of setting appropriate value in to register / . / ." SLONG i_q6p667Em8_A 1 100 -0.0218453333333 0.0218446666667 FORMAT "%15.13" ECU_ADDRESS 0x600021E4 /end MEASUREMENT
/begin MEASUREMENT UEGO_ISrcCtrlS1B1_I.UEGO_ISrcRglnClass_Isqr.nrISrcDes "Class instance for sensor 1 bank 1, for controlling current sources (Isq, Isqr, IsqM and IsqrM) of asic by means of setting appropriate value in to register / . / ." UBYTE OneToOne 1 100 0.00 255.0 FORMAT "%5.1" ECU_ADDRESS 0x600021E8 /end MEASUREMENT
/begin MEASUREMENT UEGO_ISrcCtrlS1B1_I.UEGO_ISrcRglnClass_Isqr.nrISrcRglnCntr "Class instance for sensor 1 bank 1, for controlling current sources (Isq, Isqr, IsqM and IsqrM) of asic by means of setting appropriate value in to register / . / ." UBYTE dez 1 100 0.00 255.0 FORMAT "%5.1" ECU_ADDRESS 0x600021E9 /end MEASUREMENT
/begin MEASUREMENT UEGO_ISrcCtrlS1B1_I.UEGO_ISrcRglnClass_Isqr.nrModIntRgln "Class instance for sensor 1 bank 1, for controlling current sources (Isq, Isqr, IsqM and IsqrM) of asic by means of setting appropriate value in to register / . / ." UBYTE UEGO_ISrc_RGLN_COMPU_VERB 1 100 0.00 4.00000000000 FORMAT "%13.11" ECU_ADDRESS 0x600021EA /end MEASUREMENT
/begin MEASUREMENT UEGO_ISrcCtrlS1B1_I.UEGO_ISrcRglnClass_Isqr.nrModIntRglnOld "Class instance for sensor 1 bank 1, for controlling current sources (Isq, Isqr, IsqM and IsqrM) of asic by means of setting appropriate value in to register / . / ." UBYTE UEGO_ISrc_RGLN_COMPU_VERB 1 100 0.00 4.00000000000 FORMAT "%13.11" ECU_ADDRESS 0x600021EB /end MEASUREMENT
/begin MEASUREMENT UEGO_ISrcEvlnS1B1_I.flgIPmpDeltaVld "Class instance for sensor 1 bank 1, for evaluating measured data of asic / ." UBYTE B_TRUE 1 100 0.00 1.00000000000 BIT_MASK 0x1 FORMAT "%13.11" ECU_ADDRESS 0x600020F0 /end MEASUREMENT
/begin MEASUREMENT UEGO_ISrcEvlnS1B1_I.flgIPmpMeasAryISrcVld "Class instance for sensor 1 bank 1, for evaluating measured data of asic / Validity of measured pump current with high precise, for the internal evaluation within Isrc" UBYTE B_TRUE 1 100 0.00 1.00000000000 BIT_MASK 0x1 FORMAT "%13.11" ECU_ADDRESS 0x600020F1 /end MEASUREMENT
/begin MEASUREMENT UEGO_ISrcEvlnS1B1_I.flgIPmpMeasAryScVld "Class instance for sensor 1 bank 1, for evaluating measured data of asic / Validity of measured pump current with low precise for the evaluation of absolute error" UBYTE B_TRUE 1 100 0.00 1.00000000000 BIT_MASK 0x1 FORMAT "%13.11" ECU_ADDRESS 0x600020F2 /end MEASUREMENT
/begin MEASUREMENT UEGO_ISrcEvlnS1B1_I.flgIPmpMeasAryVld "Class instance for sensor 1 bank 1, for evaluating measured data of asic / Validity flag for back measured current" UBYTE B_TRUE 1 100 0.00 1.00000000000 BIT_MASK 0x1 FORMAT "%13.11" ECU_ADDRESS 0x600020F3 /end MEASUREMENT
/begin MEASUREMENT UEGO_ISrcEvlnS1B1_I.flgIPmpMeasRCmpVld "Class instance for sensor 1 bank 1, for evaluating measured data of asic / Validity of measured pump current with medium precise, 0th index for the calculation of APE wire resistance" UBYTE B_TRUE 1 100 0.00 1.00000000000 BIT_MASK 0x1 FORMAT "%13.11" ECU_ADDRESS 0x600020F4 /end MEASUREMENT
/begin MEASUREMENT UEGO_ISrcEvlnS1B1_I.flgIPmpPlsFirstVld "Class instance for sensor 1 bank 1, for evaluating measured data of asic / Validity flag for pump current pulse amplitude in asic switching state Z2" UBYTE B_TRUE 1 100 0.00 1.00000000000 BIT_MASK 0x1 FORMAT "%13.11" ECU_ADDRESS 0x600020F5 /end MEASUREMENT
/begin MEASUREMENT UEGO_ISrcEvlnS1B1_I.flgIPmpPlsSecVld "Class instance for sensor 1 bank 1, for evaluating measured data of asic / Validity flag for pump current pulse amplitude in asic switching state Z1" UBYTE B_TRUE 1 100 0.00 1.00000000000 BIT_MASK 0x1 FORMAT "%13.11" ECU_ADDRESS 0x600020F6 /end MEASUREMENT
/begin MEASUREMENT UEGO_ISrcEvlnS1B1_I.flgIsqDesNomVld "Class instance for sensor 1 bank 1, for evaluating measured data of asic / Validity flag for Isq desired nominal value" UBYTE B_TRUE 1 100 0.00 1.00000000000 BIT_MASK 0x1 FORMAT "%13.11" ECU_ADDRESS 0x600020F7 /end MEASUREMENT
/begin MEASUREMENT UEGO_ISrcEvlnS1B1_I.flgIsqMeasVld "Class instance for sensor 1 bank 1, for evaluating measured data of asic / Validity flag for Isq measured current amplitude" UBYTE B_TRUE 1 100 0.00 1.00000000000 BIT_MASK 0x1 FORMAT "%13.11" ECU_ADDRESS 0x600020F8 /end MEASUREMENT
/begin MEASUREMENT UEGO_ISrcEvlnS1B1_I.flgIsqrAAvrgRawVld "Class instance for sensor 1 bank 1, for evaluating measured data of asic / Raw Validity of averaged Isqr throgh Pump cell" UBYTE B_TRUE 1 100 0.00 1.00000000000 BIT_MASK 0x1 FORMAT "%13.11" ECU_ADDRESS 0x600020F9 /end MEASUREMENT
/begin MEASUREMENT UEGO_ISrcEvlnS1B1_I.flgIsqrAAvrgVld "Class instance for sensor 1 bank 1, for evaluating measured data of asic / Validity of avaraged Isqr throgh Pump cell" UBYTE B_TRUE 1 100 0.00 1.00000000000 BIT_MASK 0x1 FORMAT "%13.11" ECU_ADDRESS 0x600020FA /end MEASUREMENT
/begin MEASUREMENT UEGO_ISrcEvlnS1B1_I.flgIsqrDesNomVld "Class instance for sensor 1 bank 1, for evaluating measured data of asic / Validity flag for Isqr desired nominal value" UBYTE B_TRUE 1 100 0.00 1.00000000000 BIT_MASK 0x1 FORMAT "%13.11" ECU_ADDRESS 0x600020FB /end MEASUREMENT
/begin MEASUREMENT UEGO_ISrcEvlnS1B1_I.flgIsqrEAvrgRawVld "Class instance for sensor 1 bank 1, for evaluating measured data of asic / Raw Validity of averaged Isqr throgh Nernst cell" UBYTE B_TRUE 1 100 0.00 1.00000000000 BIT_MASK 0x1 FORMAT "%13.11" ECU_ADDRESS 0x600020FC /end MEASUREMENT
/begin MEASUREMENT UEGO_ISrcEvlnS1B1_I.flgIsqrEAvrgVld "Class instance for sensor 1 bank 1, for evaluating measured data of asic / Validity of avaraged Isqr throgh Nernst cell" UBYTE B_TRUE 1 100 0.00 1.00000000000 BIT_MASK 0x1 FORMAT "%13.11" ECU_ADDRESS 0x600020FD /end MEASUREMENT
/begin MEASUREMENT UEGO_ISrcEvlnS1B1_I.flgIsqrGndix7PckAryVld "Class instance for sensor 1 bank 1, for evaluating measured data of asic / Validity flag for Isqr current through cell, accross Rgnd" UBYTE B_TRUE 1 100 0.00 1.00000000000 BIT_MASK 0x1 FORMAT "%13.11" ECU_ADDRESS 0x600020FE /end MEASUREMENT
/begin MEASUREMENT UEGO_ISrcEvlnS1B1_I.flgIsqrGndix9PckAryVld "Class instance for sensor 1 bank 1, for evaluating measured data of asic / Validity flag for Isqr current through cell, accross Rgnd" UBYTE B_TRUE 1 100 0.00 1.00000000000 BIT_MASK 0x1 FORMAT "%13.11" ECU_ADDRESS 0x600020FF /end MEASUREMENT
/begin MEASUREMENT UEGO_ISrcEvlnS1B1_I.flgIsqrGndixPckAryVld "Class instance for sensor 1 bank 1, for evaluating measured data of asic / Validity flag for Isqr current through cell, accross Rgnd" UBYTE B_TRUE 1 100 0.00 1.00000000000 BIT_MASK 0x1 FORMAT "%13.11" ECU_ADDRESS 0x60002100 /end MEASUREMENT
/begin MEASUREMENT UEGO_ISrcEvlnS1B1_I.flgIsqrMMeasVld "Class instance for sensor 1 bank 1, for evaluating measured data of asic / Validity flag for IsqrM measured current amplitude" UBYTE B_TRUE 1 100 0.00 1.00000000000 BIT_MASK 0x1 FORMAT "%13.11" ECU_ADDRESS 0x60002101 /end MEASUREMENT
/begin MEASUREMENT UEGO_ISrcEvlnS1B1_I.flgIsqrMeasVld "Class instance for sensor 1 bank 1, for evaluating measured data of asic / Validity flag for Isqr measured current amplitude" UBYTE B_TRUE 1 100 0.00 1.00000000000 BIT_MASK 0x1 FORMAT "%13.11" ECU_ADDRESS 0x60002102 /end MEASUREMENT
/begin MEASUREMENT UEGO_ISrcEvlnS1B1_I.flgRatINernstExctVld "Class instance for sensor 1 bank 1, for evaluating measured data of asic / ." UBYTE B_TRUE 1 100 0.00 1.00000000000 BIT_MASK 0x1 FORMAT "%13.11" ECU_ADDRESS 0x60002103 /end MEASUREMENT
/begin MEASUREMENT UEGO_ISrcEvlnS1B1_I.flgRatIPmpExctVld "Class instance for sensor 1 bank 1, for evaluating measured data of asic / ." UBYTE B_TRUE 1 100 0.00 1.00000000000 BIT_MASK 0x1 FORMAT "%13.11" ECU_ADDRESS 0x60002104 /end MEASUREMENT
/begin MEASUREMENT UEGO_ISrcEvlnS1B1_I.flgReStabVld "Class instance for sensor 1 bank 1, for evaluating measured data of asic / Variable flag indicates RE-Stable is valid or not" UBYTE B_TRUE 1 100 0.00 1.00000000000 BIT_MASK 0x1 FORMAT "%13.11" ECU_ADDRESS 0x60002105 /end MEASUREMENT
/begin MEASUREMENT UEGO_ISrcEvlnS1B1_I.flgTrmSqRglnVld "Class instance for sensor 1 bank 1, for evaluating measured data of asic / Validity flag for TIRMSQ number for regulation" UBYTE B_TRUE 1 100 0.00 1.00000000000 BIT_MASK 0x1 FORMAT "%13.11" ECU_ADDRESS 0x60002106 /end MEASUREMENT
/begin MEASUREMENT UEGO_ISrcEvlnS1B1_I.flgTrmSqrMRglnVld "Class instance for sensor 1 bank 1, for evaluating measured data of asic / ." UBYTE B_TRUE 1 100 0.00 1.00000000000 BIT_MASK 0x1 FORMAT "%13.11" ECU_ADDRESS 0x60002107 /end MEASUREMENT
/begin MEASUREMENT UEGO_ISrcEvlnS1B1_I.flgTrmSqrRglnVld "Class instance for sensor 1 bank 1, for evaluating measured data of asic / ." UBYTE B_TRUE 1 100 0.00 1.00000000000 BIT_MASK 0x1 FORMAT "%13.11" ECU_ADDRESS 0x60002108 /end MEASUREMENT
/begin MEASUREMENT UEGO_ISrcEvlnS1B1_I.flgUg0iAvrgCalcd "Class instance for sensor 1 bank 1, for evaluating measured data of asic / Validity flag for average voltage of Ug0i values" UBYTE B_TRUE 1 100 0.00 1.00000000000 BIT_MASK 0x1 FORMAT "%13.11" ECU_ADDRESS 0x60002109 /end MEASUREMENT
/begin MEASUREMENT UEGO_ISrcEvlnS1B1_I.iIPmpDelta "Class instance for sensor 1 bank 1, for evaluating measured data of asic / ." SWORD i_q6p6667Em7_A 1 100 -0.02184533 0.02184467 FORMAT "%10.8" ECU_ADDRESS 0x6000210A /end MEASUREMENT
/begin MEASUREMENT UEGO_ISrcEvlnS1B1_I.iIPmpDeltaRaw "Class instance for sensor 1 bank 1, for evaluating measured data of asic / Raw absolute error of pump current in Normal mode" SWORD i_q6p6667Em7_A 1 100 -0.02184533 0.02184467 FORMAT "%10.8" ECU_ADDRESS 0x6000210C /end MEASUREMENT
/begin MEASUREMENT UEGO_ISrcEvlnS1B1_I.iIPmpMeasAry "Class instance for sensor 1 bank 1, for evaluating measured data of asic / Measured pump current array" SWORD i_q6p6667Em7_A 1 100 -0.02184533 0.02184467 FORMAT "%10.8" ARRAY_SIZE 4 ECU_ADDRESS 0x6000210E /end MEASUREMENT
/begin MEASUREMENT UEGO_ISrcEvlnS1B1_I.iIPmpMeasRCmp "Class instance for sensor 1 bank 1, for evaluating measured data of asic / 0th index of measured pump current(iIPmpMeasAry[0]) for the calculation of APE wire resistance" SWORD i_q6p6667Em7_A 1 100 -0.02184533 0.02184467 FORMAT "%10.8" ECU_ADDRESS 0x60002116 /end MEASUREMENT
/begin MEASUREMENT UEGO_ISrcEvlnS1B1_I.iIsqDesNom "Class instance for sensor 1 bank 1, for evaluating measured data of asic / Desired nominal Isq current ampltude" SWORD i_q6p6667Em7_A 1 100 -0.02184533 0.02184467 FORMAT "%10.8" ECU_ADDRESS 0x60002118 /end MEASUREMENT
/begin MEASUREMENT UEGO_ISrcEvlnS1B1_I.iIsqMeas "Class instance for sensor 1 bank 1, for evaluating measured data of asic / Measured Isq current ampltude" SWORD i_q6p6667Em7_A 1 100 -0.02184533 0.02184467 FORMAT "%10.8" ECU_ADDRESS 0x6000211A /end MEASUREMENT
/begin MEASUREMENT UEGO_ISrcEvlnS1B1_I.iIsqMeasRaw "Class instance for sensor 1 bank 1, for evaluating measured data of asic / Measured raw Isq current ampltude (Unfiltered) across Rgnd" SWORD i_q6p6667Em7_A 1 100 -0.02184533 0.02184467 FORMAT "%10.8" ECU_ADDRESS 0x6000211C /end MEASUREMENT
/begin MEASUREMENT UEGO_ISrcEvlnS1B1_I.iIsqrAAry "Class instance for sensor 1 bank 1, for evaluating measured data of asic / ." SWORD i_q6p667Em8_A 1 100 -0.002184533 0.002184467 FORMAT "%11.9" ARRAY_SIZE 4 ECU_ADDRESS 0x6000211E /end MEASUREMENT
/begin MEASUREMENT UEGO_ISrcEvlnS1B1_I.iIsqrAAvrg "Class instance for sensor 1 bank 1, for evaluating measured data of asic / Average reference pump current flown through pump cell" SWORD i_q6p667Em8_A 1 100 -0.002184533 0.002184467 FORMAT "%11.9" ECU_ADDRESS 0x60002126 /end MEASUREMENT
/begin MEASUREMENT UEGO_ISrcEvlnS1B1_I.iIsqrAAvrgRaw "Class instance for sensor 1 bank 1, for evaluating measured data of asic / Raw value of Isqr through pump cell" SWORD i_q6p667Em8_A 1 100 -0.002184533 0.002184467 FORMAT "%11.9" ECU_ADDRESS 0x60002128 /end MEASUREMENT
/begin MEASUREMENT UEGO_ISrcEvlnS1B1_I.iIsqrASum "Class instance for sensor 1 bank 1, for evaluating measured data of asic / Sum of reference pump current flown through Pump cell" SLONG i_q6p667Em8_A 1 100 -143.165576533 143.165576467 FORMAT "%13.9" ECU_ADDRESS 0x6000212C /end MEASUREMENT
/begin MEASUREMENT UEGO_ISrcEvlnS1B1_I.iIsqrDesNom "Class instance for sensor 1 bank 1, for evaluating measured data of asic / Desired nominal Isqr current ampltude" SWORD i_q6p667Em8_A 1 100 -0.002184533 0.002184467 FORMAT "%11.9" ECU_ADDRESS 0x60002130 /end MEASUREMENT
/begin MEASUREMENT UEGO_ISrcEvlnS1B1_I.iIsqrEAry "Class instance for sensor 1 bank 1, for evaluating measured data of asic / ." SWORD i_q6p667Em8_A 1 100 -0.002184533 0.002184467 FORMAT "%11.9" ARRAY_SIZE 4 ECU_ADDRESS 0x60002132 /end MEASUREMENT
/begin MEASUREMENT UEGO_ISrcEvlnS1B1_I.iIsqrEAvrg "Class instance for sensor 1 bank 1, for evaluating measured data of asic / Average reference pump current flown through nernst cell" SWORD i_q6p667Em8_A 1 100 -0.002184533 0.002184467 FORMAT "%11.9" ECU_ADDRESS 0x6000213A /end MEASUREMENT
/begin MEASUREMENT UEGO_ISrcEvlnS1B1_I.iIsqrEAvrgRaw "Class instance for sensor 1 bank 1, for evaluating measured data of asic / Raw value of Isqr through nernst cell" SWORD i_q6p667Em8_A 1 100 -0.002184533 0.002184467 FORMAT "%11.9" ECU_ADDRESS 0x6000213C /end MEASUREMENT
/begin MEASUREMENT UEGO_ISrcEvlnS1B1_I.iIsqrESum "Class instance for sensor 1 bank 1, for evaluating measured data of asic / Sum of reference pump current flown through Nernst cell" SLONG i_q6p667Em8_A 1 100 -143.165576533 143.165576467 FORMAT "%13.9" ECU_ADDRESS 0x60002140 /end MEASUREMENT
/begin MEASUREMENT UEGO_ISrcEvlnS1B1_I.iIsqrGndix7PckAry "Class instance for sensor 1 bank 1, for evaluating measured data of asic / Isqr current through cell, accross Rgnd" SWORD i_q6p667Em8_A 1 100 -0.002184533 0.002184467 FORMAT "%11.9" ARRAY_SIZE 2 ECU_ADDRESS 0x60002144 /end MEASUREMENT
/begin MEASUREMENT UEGO_ISrcEvlnS1B1_I.iIsqrGndix9PckAry "Class instance for sensor 1 bank 1, for evaluating measured data of asic / Isqr current through cell, accross Rgnd" SWORD i_q6p667Em8_A 1 100 -0.002184533 0.002184467 FORMAT "%11.9" ARRAY_SIZE 2 ECU_ADDRESS 0x60002148 /end MEASUREMENT
/begin MEASUREMENT UEGO_ISrcEvlnS1B1_I.iIsqrGndixPckAry "Class instance for sensor 1 bank 1, for evaluating measured data of asic / Isqr current through cell, accross Rgnd" SWORD i_q6p667Em8_A 1 100 -0.002184533 0.002184467 FORMAT "%11.9" ARRAY_SIZE 4 ECU_ADDRESS 0x6000214C /end MEASUREMENT
/begin MEASUREMENT UEGO_ISrcEvlnS1B1_I.iIsqrMMeas "Class instance for sensor 1 bank 1, for evaluating measured data of asic / Measured IsqrM current ampltude" SWORD i_q6p667Em8_A 1 100 -0.002184533 0.002184467 FORMAT "%11.9" ECU_ADDRESS 0x60002154 /end MEASUREMENT
/begin MEASUREMENT UEGO_ISrcEvlnS1B1_I.iIsqrMeas "Class instance for sensor 1 bank 1, for evaluating measured data of asic / Measured Isqr current ampltude" SWORD i_q6p667Em8_A 1 100 -0.002184533 0.002184467 FORMAT "%11.9" ECU_ADDRESS 0x60002156 /end MEASUREMENT
/begin MEASUREMENT UEGO_ISrcEvlnS1B1_I.iIsqrMeasRaw "Class instance for sensor 1 bank 1, for evaluating measured data of asic / Measured raw Isqr current ampltude (Unfiltered) across Rcal" SWORD i_q6p667Em8_A 1 100 -0.002184533 0.002184467 FORMAT "%11.9" ECU_ADDRESS 0x60002158 /end MEASUREMENT
/begin MEASUREMENT UEGO_ISrcEvlnS1B1_I.iOffsIsqrNernst "Class instance for sensor 1 bank 1, for evaluating measured data of asic / Offset current of the backmeasured isqr for nernst cell from calibrated Isqr" SWORD i_q6p667Em8_A 1 100 -0.002184533 0.002184467 FORMAT "%11.9" ECU_ADDRESS 0x6000215A /end MEASUREMENT
/begin MEASUREMENT UEGO_ISrcEvlnS1B1_I.iOffsIsqrPmp "Class instance for sensor 1 bank 1, for evaluating measured data of asic / Offset current of the backmeasured isqr for pump cell from calibrated Isqr" SWORD i_q6p667Em8_A 1 100 -0.002184533 0.002184467 FORMAT "%11.9" ECU_ADDRESS 0x6000215C /end MEASUREMENT
/begin MEASUREMENT UEGO_ISrcEvlnS1B1_I.iPmpMeasRawAry "Class instance for sensor 1 bank 1, for evaluating measured data of asic / Measured pump current value for absolute error calculation" SWORD i_q6p6667Em7_A 1 100 -0.02184533 0.02184467 FORMAT "%10.8" ECU_ADDRESS 0x6000215E /end MEASUREMENT
/begin MEASUREMENT UEGO_ISrcEvlnS1B1_I.iPmpMeasZ0 "Class instance for sensor 1 bank 1, for evaluating measured data of asic / Measured pump current for Z0 pulse" SWORD i_q6p6667Em7_A 1 100 -0.02184533 0.02184467 FORMAT "%10.8" ECU_ADDRESS 0x60002160 /end MEASUREMENT
/begin MEASUREMENT UEGO_ISrcEvlnS1B1_I.iPmpMeasZ12 "Class instance for sensor 1 bank 1, for evaluating measured data of asic / Measured pump current for Z1 and Z2 pulse" SWORD i_q6p6667Em7_A 1 100 -0.02184533 0.02184467 FORMAT "%10.8" ECU_ADDRESS 0x60002162 /end MEASUREMENT
/begin MEASUREMENT UEGO_ISrcEvlnS1B1_I.nrIsqrAAry "Class instance for sensor 1 bank 1, for evaluating measured data of asic / ." UBYTE OneToOne 1 100 0.00 255.0 FORMAT "%5.1" ECU_ADDRESS 0x60002164 /end MEASUREMENT
/begin MEASUREMENT UEGO_ISrcEvlnS1B1_I.nrIsqrEAry "Class instance for sensor 1 bank 1, for evaluating measured data of asic / ." UBYTE OneToOne 1 100 0.00 255.0 FORMAT "%5.1" ECU_ADDRESS 0x60002165 /end MEASUREMENT
/begin MEASUREMENT UEGO_ISrcEvlnS1B1_I.nrModInt "Class instance for sensor 1 bank 1, for evaluating measured data of asic / Isrc internal mode for resetting isqr filtering" UBYTE OneToOne 1 100 0.00 255.0 FORMAT "%5.1" ECU_ADDRESS 0x60002166 /end MEASUREMENT
/begin MEASUREMENT UEGO_ISrcEvlnS1B1_I.nrModIntOld "Class instance for sensor 1 bank 1, for evaluating measured data of asic / Isrc old internal mode for resetting isqr filtering" UBYTE OneToOne 1 100 0.00 255.0 FORMAT "%5.1" ECU_ADDRESS 0x60002167 /end MEASUREMENT
/begin MEASUREMENT UEGO_ISrcEvlnS1B1_I.nrModRelErrInt "Class instance for sensor 1 bank 1, for evaluating measured data of asic / Isrc internal mode for resetting relative error filtering" UBYTE OneToOne 1 100 0.00 255.0 FORMAT "%5.1" ECU_ADDRESS 0x60002168 /end MEASUREMENT
/begin MEASUREMENT UEGO_ISrcEvlnS1B1_I.nrTrmSqRgln "Class instance for sensor 1 bank 1, for evaluating measured data of asic / TIRMSQ number for regulation" UBYTE OneToOne 1 100 0.00 255.0 FORMAT "%5.1" ECU_ADDRESS 0x60002169 /end MEASUREMENT
/begin MEASUREMENT UEGO_ISrcEvlnS1B1_I.nrTrmSqrMRgln "Class instance for sensor 1 bank 1, for evaluating measured data of asic / ." UBYTE OneToOne 1 100 0.00 255.0 FORMAT "%5.1" ECU_ADDRESS 0x6000216A /end MEASUREMENT
/begin MEASUREMENT UEGO_ISrcEvlnS1B1_I.nrTrmSqrRgln "Class instance for sensor 1 bank 1, for evaluating measured data of asic / ." UBYTE OneToOne 1 100 0.00 255.0 FORMAT "%5.1" ECU_ADDRESS 0x6000216B /end MEASUREMENT
/begin MEASUREMENT UEGO_ISrcEvlnS1B1_I.ratINernstExct "Class instance for sensor 1 bank 1, for evaluating measured data of asic / ." SWORD fak_q1p201Em4 1 100 -3.936096 3.935976 FORMAT "%8.6" ECU_ADDRESS 0x6000216C /end MEASUREMENT
/begin MEASUREMENT UEGO_ISrcEvlnS1B1_I.ratIPmpExct "Class instance for sensor 1 bank 1, for evaluating measured data of asic / ." SWORD fak_q1p201Em4 1 100 -3.936096 3.935976 FORMAT "%8.6" ECU_ADDRESS 0x6000216E /end MEASUREMENT
/begin MEASUREMENT UEGO_ISrcEvlnS1B1_I.stIsqrNernst "Class instance for sensor 1 bank 1, for evaluating measured data of asic / Status information of the isqr through Nernst cell" UBYTE OneToOne 1 100 0.00 255.0 FORMAT "%5.1" ECU_ADDRESS 0x60002170 /end MEASUREMENT
/begin MEASUREMENT UEGO_ISrcEvlnS1B1_I.stIsqrPmp "Class instance for sensor 1 bank 1, for evaluating measured data of asic / Status information of the isqr through pump cell" UBYTE OneToOne 1 100 0.00 255.0 FORMAT "%5.1" ECU_ADDRESS 0x60002171 /end MEASUREMENT
/begin MEASUREMENT UEGO_ISrcEvlnS1B1_I.uUg0iAvrg "Class instance for sensor 1 bank 1, for evaluating measured data of asic / Average voltage of Ug0i values" SWORD spg_q3p2Em4_V 1 100 -10.48576 10.48544 FORMAT "%8.5" ECU_ADDRESS 0x60002172 /end MEASUREMENT
/begin MEASUREMENT UEGO_ISrcEvlnS1B1_I.UcalEvalFil_I.flgEvlnStrtd "Class instance for sensor 1 bank 1, for evaluating measured data of asic / Filter instance to filter Ucal voltage value, for measured Isqr calculation / Flag to determine evaluation status." UBYTE B_TRUE 1 100 0.00 1.00000000000 BIT_MASK 0x1 FORMAT "%13.11" ECU_ADDRESS 0x60002174 /end MEASUREMENT
/begin MEASUREMENT UEGO_ISrcEvlnS1B1_I.UcalEvalFil_I.EvlnFil_DL_I.memory "Class instance for sensor 1 bank 1, for evaluating measured data of asic / Filter instance to filter Ucal voltage value, for measured Isqr calculation / Class instance of evaluation filter. / current lowpass value" SLONG spg_q4p883Em9_V 1 100 -10.4857600000 10.4857599951 FORMAT "%13.10" ECU_ADDRESS 0x60002178 /end MEASUREMENT
/begin MEASUREMENT UEGO_ISrcEvlnS1B1_I.UcalMEvalFil_I.flgEvlnStrtd "Class instance for sensor 1 bank 1, for evaluating measured data of asic / Filter instance to filter UcalM voltage value, for measured IsqrM calculation / Flag to determine evaluation status." UBYTE B_TRUE 1 100 0.00 1.00000000000 BIT_MASK 0x1 FORMAT "%13.11" ECU_ADDRESS 0x6000217C /end MEASUREMENT
/begin MEASUREMENT UEGO_ISrcEvlnS1B1_I.UcalMEvalFil_I.EvlnFil_DL_I.memory "Class instance for sensor 1 bank 1, for evaluating measured data of asic / Filter instance to filter UcalM voltage value, for measured IsqrM calculation / Class instance of evaluation filter. / current lowpass value" SLONG spg_q4p883Em9_V 1 100 -10.4857600000 10.4857599951 FORMAT "%13.10" ECU_ADDRESS 0x60002180 /end MEASUREMENT
/begin MEASUREMENT UEGO_ISrcEvlnS1B1_I.Uego_iIsqrTONVNM_I.time "Class instance for sensor 1 bank 1, for evaluating measured data of asic / TurnOn Delay for delaying the validities of Isqr through pump and Nernst cell / Delay Time" UWORD t_q0p005 1 100 0.00 327.6750 FORMAT "%8.4" ECU_ADDRESS 0x60002184 /end MEASUREMENT
/begin MEASUREMENT UEGO_ISrcEvlnS1B1_I.Ug0EvalFil_I.flgEvlnStrtd "Class instance for sensor 1 bank 1, for evaluating measured data of asic / Filter instance to filter Ug0 voltage values, for measured Isq calculation / Flag to determine evaluation status." UBYTE B_TRUE 1 100 0.00 1.00000000000 BIT_MASK 0x1 FORMAT "%13.11" ECU_ADDRESS 0x60002188 /end MEASUREMENT
/begin MEASUREMENT UEGO_ISrcEvlnS1B1_I.Ug0EvalFil_I.EvlnFil_DL_I.memory "Class instance for sensor 1 bank 1, for evaluating measured data of asic / Filter instance to filter Ug0 voltage values, for measured Isq calculation / Class instance of evaluation filter. / current lowpass value" SLONG spg_q4p883Em9_V 1 100 -10.4857600000 10.4857599951 FORMAT "%13.10" ECU_ADDRESS 0x6000218C /end MEASUREMENT
/begin MEASUREMENT UEGO_ISrcEvlnS1B1_I.iDeltaPmpTONVNM_I.time "Class instance for sensor 1 bank 1, for evaluating measured data of asic / Turn on delay instance for pump current absolute error validity till stable DAC current / Delay Time" UWORD t_q0p005 1 100 0.00 327.6750 FORMAT "%8.4" ECU_ADDRESS 0x60002190 /end MEASUREMENT
/begin MEASUREMENT UEGO_ISrcEvlnS1B1_I.iIPmpDeltaFil_I.flgEvlnStrtd "Class instance for sensor 1 bank 1, for evaluating measured data of asic / . / Flag to determine evaluation status." UBYTE B_TRUE 1 100 0.00 1.00000000000 BIT_MASK 0x1 FORMAT "%13.11" ECU_ADDRESS 0x60002194 /end MEASUREMENT
/begin MEASUREMENT UEGO_ISrcEvlnS1B1_I.iIPmpDeltaFil_I.EvlnFil_DL_I.memory "Class instance for sensor 1 bank 1, for evaluating measured data of asic / . / Class instance of evaluation filter. / current lowpass value" SLONG i_q1p01725Em11_A 1 100 -0.0218453333333 0.0218453333232 FORMAT "%15.13" ECU_ADDRESS 0x60002198 /end MEASUREMENT
/begin MEASUREMENT UEGO_ISrcEvlnS1B1_I.iIPmpDeltaPeakFil_I.flgFilStrtd "Class instance for sensor 1 bank 1, for evaluating measured data of asic / Peak filter for minimizing the noise in the Absolute error of pump current / Peak filter start information" UBYTE B_TRUE 1 100 0.00 1.00000000000 BIT_MASK 0x1 FORMAT "%13.11" ECU_ADDRESS 0x6000219C /end MEASUREMENT
/begin MEASUREMENT UEGO_ISrcEvlnS1B1_I.iIPmpDeltaPeakFil_I.uDeltaInOutpMax "Class instance for sensor 1 bank 1, for evaluating measured data of asic / Peak filter for minimizing the noise in the Absolute error of pump current / minimal increment of the input for the peak filter" SWORD i_q6p6667Em7_A 1 100 -0.02184533 0.02184467 FORMAT "%10.8" ECU_ADDRESS 0x6000219E /end MEASUREMENT
/begin MEASUREMENT UEGO_ISrcEvlnS1B1_I.iIsqrAAvrg_I.flgEvlnStrtd "Class instance for sensor 1 bank 1, for evaluating measured data of asic / filter for redusing the noise in the Isqr current through nernst cell / Flag to determine evaluation status." UBYTE B_TRUE 1 100 0.00 1.00000000000 BIT_MASK 0x1 FORMAT "%13.11" ECU_ADDRESS 0x600021A0 /end MEASUREMENT
/begin MEASUREMENT UEGO_ISrcEvlnS1B1_I.iIsqrAAvrg_I.EvlnFil_DL_I.memory "Class instance for sensor 1 bank 1, for evaluating measured data of asic / filter for redusing the noise in the Isqr current through nernst cell / Class instance of evaluation filter. / current lowpass value" SLONG i_q1p01725Em12_A 1 100 -0.00218453333333 0.00218453333232 FORMAT "%16.14" ECU_ADDRESS 0x600021A4 /end MEASUREMENT
/begin MEASUREMENT UEGO_ISrcEvlnS1B1_I.iIsqrEAvrg_I.flgEvlnStrtd "Class instance for sensor 1 bank 1, for evaluating measured data of asic / filter for redusing the noise in the Isqr current through pump cell / Flag to determine evaluation status." UBYTE B_TRUE 1 100 0.00 1.00000000000 BIT_MASK 0x1 FORMAT "%13.11" ECU_ADDRESS 0x600021A8 /end MEASUREMENT
/begin MEASUREMENT UEGO_ISrcEvlnS1B1_I.iIsqrEAvrg_I.EvlnFil_DL_I.memory "Class instance for sensor 1 bank 1, for evaluating measured data of asic / filter for redusing the noise in the Isqr current through pump cell / Class instance of evaluation filter. / current lowpass value" SLONG i_q1p01725Em12_A 1 100 -0.00218453333333 0.00218453333232 FORMAT "%16.14" ECU_ADDRESS 0x600021AC /end MEASUREMENT
/begin MEASUREMENT UEGO_ISrcEvlnS1B1_I.ratINernstExct_I.flgEvlnStrtd "Class instance for sensor 1 bank 1, for evaluating measured data of asic / Filter instance for relative error calculation ( nernst cell ) / Flag to determine evaluation status." UBYTE B_TRUE 1 100 0.00 1.00000000000 BIT_MASK 0x1 FORMAT "%13.11" ECU_ADDRESS 0x600021B0 /end MEASUREMENT
/begin MEASUREMENT UEGO_ISrcEvlnS1B1_I.ratINernstExct_I.EvlnFil_DL_I.memory "Class instance for sensor 1 bank 1, for evaluating measured data of asic / Filter instance for relative error calculation ( nernst cell ) / Class instance of evaluation filter. / current lowpass value" SLONG fak_q1p8329Em9 1 100 -3.93609609610 3.93609609426 FORMAT "%13.11" ECU_ADDRESS 0x600021B4 /end MEASUREMENT
/begin MEASUREMENT UEGO_ISrcEvlnS1B1_I.ratIPumpExct_I.flgEvlnStrtd "Class instance for sensor 1 bank 1, for evaluating measured data of asic / Filter instance for relative error calculation ( pump cell ) / Flag to determine evaluation status." UBYTE B_TRUE 1 100 0.00 1.00000000000 BIT_MASK 0x1 FORMAT "%13.11" ECU_ADDRESS 0x600021B8 /end MEASUREMENT
/begin MEASUREMENT UEGO_ISrcEvlnS1B1_I.ratIPumpExct_I.EvlnFil_DL_I.memory "Class instance for sensor 1 bank 1, for evaluating measured data of asic / Filter instance for relative error calculation ( pump cell ) / Class instance of evaluation filter. / current lowpass value" SLONG fak_q1p8329Em9 1 100 -3.93609609610 3.93609609426 FORMAT "%13.11" ECU_ADDRESS 0x600021BC /end MEASUREMENT
/begin MEASUREMENT UEGO_nrIPmp_dummy "dummy value" SWORD dez 1 100 -32768.00 32767.00 FORMAT "%8.2" ARRAY_SIZE 15 ECU_ADDRESS 0x60006F24 /end MEASUREMENT
/begin MEASUREMENT UEGO_nrTrmSqRglnS1B1 "TIRMSQ number for regulation for sensor 1 bank 1" UBYTE OneToOne 1 100 0.00 255.0 FORMAT "%5.1" ECU_ADDRESS 0x6000FB6C /end MEASUREMENT
/begin MEASUREMENT UEGO_nrTrmSqrRglnS1B1 "." UBYTE OneToOne 1 100 0.00 255.0 FORMAT "%5.1" ECU_ADDRESS 0x6000FB6B /end MEASUREMENT
/begin MEASUREMENT UEGO_ratINernstExctS1B1 "." SWORD fak_q1p201Em4 1 100 -3.936096 3.935976 FORMAT "%8.6" ECU_ADDRESS 0x6000968A /end MEASUREMENT
/begin MEASUREMENT UEGO_ratIPmpExctS1B1 "." SWORD fak_q1p201Em4 1 100 -3.936096 3.935976 FORMAT "%8.6" ECU_ADDRESS 0x60009688 /end MEASUREMENT
/begin MEASUREMENT UEGO_stIsqrNernstS1B1 "Status information of the isqr through Nernst cell for sensor 1 bank 1" UBYTE OneToOne 1 100 0.00 255.0 FORMAT "%5.1" ECU_ADDRESS 0x6000FB61 /end MEASUREMENT
/begin MEASUREMENT UEGO_stIsqrPmpS1B1 "Status information of the isqr through pump cell for sensor 1 bank 1" UBYTE OneToOne 1 100 0.00 255.0 FORMAT "%5.1" ECU_ADDRESS 0x6000FB60 /end MEASUREMENT
/begin MEASUREMENT UEGO_tiSegLngth "Duration of a pump current segment" UWORD t_q6p6666Em4 1 100 0.00 43.69000 FORMAT "%8.5" ECU_ADDRESS 0x60006F08 /end MEASUREMENT
/begin FUNCTION UEGO_IPmpCtrl "1.17.0    UEGO Pump Current Control"
 /begin DEF_CHARACTERISTIC UEGO_nrIPmpCtrlIpSet_C UEGO_nrIPmpStdOffs_C UEGO_stIPmpCtrlRst_C UEGO_stIPmpCtrl_C UEGO_stIPmpStdCycOffsActvn_C UEGO_stIPmpStdDeltaActvn_C UEGO_stSetRegIPmp_C UEGO_tiRegRecalcnIPmpCtrl_C UEGO_tPIDPrmsSwtDwn_C UEGO_tPIDPrmsSwtUp_C UEGO_UnCtrlRglD_C UEGO_UnCtrlRglI_C UEGO_UnCtrlRglP_C UEGO_UnCtrlRglRF_C UEGO_UnCtrlSafeD_C UEGO_UnCtrlSafeI_C UEGO_UnCtrlSafeP_C UEGO_UnCtrlSafeRF_C /end DEF_CHARACTERISTIC
 /begin REF_CHARACTERISTIC UEGO_nrRvsChrgCMeasOffs_C UEGO_nrRvsChrgUiMeasOffs_C UEGO_numRegIpsmRvsChrg_C UEGO_numRegPatCMeas_C UEGO_numRegPatUiMeas_C /end REF_CHARACTERISTIC
 /begin IN_MEASUREMENT UEGO_flgCJ135AnS1B1 UEGO_flgIsqMeasVldS1B1 UEGO_flgOPM1GainVldS1B1 UEGO_flgOPM2GainVldS1B1 UEGO_flgSysSuprtdS1B1 UEGO_flgTCeramicVldS1B1 UEGO_iIsqMeasS1B1 UEGO_RegSetS1B1_I.cntrRegSet UEGO_RegSetS1B1_I.flgCJ135An UEGO_RegSetS1B1_I.flgConvVld UEGO_RegSetS1B1_I.flgIPmpDes UEGO_RegSetS1B1_I.flgIPmpPhyRels UEGO_RegSetS1B1_I.flgIniFinshd UEGO_RegSetS1B1_I.flgLoupeCURRDes UEGO_RegSetS1B1_I.flgLoupeDACDes UEGO_RegSetS1B1_I.flgLoupeNDes UEGO_RegSetS1B1_I.flgLoupePDes UEGO_RegSetS1B1_I.flgNewReq UEGO_RegSetS1B1_I.flgRegSetSt UEGO_RegSetS1B1_I.flgRegSetStVld UEGO_RegSetS1B1_I.flgReqAcptd UEGO_RegSetS1B1_I.flgSetRegOk UEGO_RegSetS1B1_I.flgTakeDataOk UEGO_RegSetS1B1_I.idxChp UEGO_RegSetS1B1_I.nrIdleSubMode UEGO_RegSetS1B1_I.nrModDes UEGO_RegSetS1B1_I.nrNormSubMode UEGO_RegSetS1B1_I.nrRegSet UEGO_RegSetS1B1_I.nrSubModDes UEGO_RegSetS1B1_I.nrSwtOnSubMode UEGO_RegSetS1B1_I.nrTrmSq UEGO_RegSetS1B1_I.nrWrmUpSubMode UEGO_RegSetS1B1_I.stRegSet UEGO_RegSetS1B1_I.stRegSetVld UEGO_RegSetS1B1_I.tmpVar UEGO_tCeramicS1B1 UEGO_uOPM1GainS1B1 UEGO_uOPM2GainS1B1 /end IN_MEASUREMENT
 /begin OUT_MEASUREMENT UEGO_flgIPmpCtrlHiPrcsnS1B1 UEGO_flgIPmpCtrlVldS1B1 /end OUT_MEASUREMENT
 /begin LOC_MEASUREMENT UEGO_IPmpCtrlS1B1_I.KRFDes UEGO_IPmpCtrlS1B1_I.flgCalTrigSetReg UEGO_IPmpCtrlS1B1_I.flgDacAdpnStabVld UEGO_IPmpCtrlS1B1_I.flgDacAdpnStabVldOld UEGO_IPmpCtrlS1B1_I.flgIPmpCtrlHiPrcsn UEGO_IPmpCtrlS1B1_I.flgIPmpCtrlVld UEGO_IPmpCtrlS1B1_I.flgIPmpSetAcptd UEGO_IPmpCtrlS1B1_I.flgLoupCURRDes UEGO_IPmpCtrlS1B1_I.flgLoupCURRDesOld UEGO_IPmpCtrlS1B1_I.flgLoupNDes UEGO_IPmpCtrlS1B1_I.flgLoupNDesOld UEGO_IPmpCtrlS1B1_I.flgModSetIp UEGO_IPmpCtrlS1B1_I.flgModSetIpOld UEGO_IPmpCtrlS1B1_I.flgRegSetSetIpOk UEGO_IPmpCtrlS1B1_I.flgSetIPmpOffTrig UEGO_IPmpCtrlS1B1_I.flgSetRegIPmpCtrlOk UEGO_IPmpCtrlS1B1_I.flgSetRegOk UEGO_IPmpCtrlS1B1_I.flgTHysInin UEGO_IPmpCtrlS1B1_I.nrModDesOld UEGO_IPmpCtrlS1B1_I.nrModInt UEGO_IPmpCtrlS1B1_I.nrModIntOld UEGO_IPmpCtrlS1B1_I.nrRegKD UEGO_IPmpCtrlS1B1_I.nrRegKI UEGO_IPmpCtrlS1B1_I.nrRegKP UEGO_IPmpCtrlS1B1_I.nrRegKRF UEGO_IPmpCtrlS1B1_I.nrSubModDesOld UEGO_IPmpCtrlS1B1_I.prod1 UEGO_IPmpCtrlS1B1_I.prod2 UEGO_IPmpCtrlS1B1_I.tUnSwtThd UEGO_IPmpCtrlS1B1_I.RegReclcnIPmpCtrlTR_I.timeCounter UEGO_IPmpCtrlS1B1_I.flgSetRegPIDERNM_I.oldSignal UEGO_IPmpCtrlS1B1_I.flgTrigSetIpER_I.buffer UEGO_IPmpCtrlS1B1_I.flgTrigSetIpER_I.oldSignal /end LOC_MEASUREMENT
 FUNCTION_VERSION "1.17.0" /end FUNCTION
/begin FUNCTION UEGO_IPmpLimn "1.12.0    UEGO Pump current limitation" /begin DEF_CHARACTERISTIC UEGO_nrIPmpLimdMax_C /end DEF_CHARACTERISTIC
 /begin IN_MEASUREMENT UEGO_DataSplyClsS1B1_I.flgCj135An UEGO_DataSplyClsS1B1_I.flgDACOff UEGO_DataSplyClsS1B1_I.flgErrSpiRamRet UEGO_DataSplyClsS1B1_I.flgFKal1Vld UEGO_DataSplyClsS1B1_I.flgFKal2Vld UEGO_DataSplyClsS1B1_I.flgFKal3Vld UEGO_DataSplyClsS1B1_I.flgIPmpActvd UEGO_DataSplyClsS1B1_I.flgISQrA UEGO_DataSplyClsS1B1_I.flgISQrE UEGO_DataSplyClsS1B1_I.flgLCURR UEGO_DataSplyClsS1B1_I.flgLNMeas UEGO_DataSplyClsS1B1_I.flgLPMeas UEGO_DataSplyClsS1B1_I.flgLoupeCAL UEGO_DataSplyClsS1B1_I.flgLoupeG0 UEGO_DataSplyClsS1B1_I.flgLstPckAbort UEGO_DataSplyClsS1B1_I.flgMKA UEGO_DataSplyClsS1B1_I.flgMKE UEGO_DataSplyClsS1B1_I.flgNewIPmpDacPckAry UEGO_DataSplyClsS1B1_I.flgNewIPmpOK UEGO_DataSplyClsS1B1_I.flgNewIPmpPckAry UEGO_DataSplyClsS1B1_I.flgNewIPmpTM UEGO_DataSplyClsS1B1_I.flgNewPck UEGO_DataSplyClsS1B1_I.flgNewPckCstnc UEGO_DataSplyClsS1B1_I.flgNewPckMiss UEGO_DataSplyClsS1B1_I.flgNewPckVld UEGO_DataSplyClsS1B1_I.flgNewTiPck UEGO_DataSplyClsS1B1_I.flgNewURmVG4MeasAryVld UEGO_DataSplyClsS1B1_I.flgNewUa2Pck UEGO_DataSplyClsS1B1_I.flgNewUa31Pck UEGO_DataSplyClsS1B1_I.flgNewUa32Pck UEGO_DataSplyClsS1B1_I.flgNewUa33Pck UEGO_DataSplyClsS1B1_I.flgNewUamPck UEGO_DataSplyClsS1B1_I.flgNewUapePck UEGO_DataSplyClsS1B1_I.flgNewUcalMaxPck UEGO_DataSplyClsS1B1_I.flgNewUcalPck UEGO_DataSplyClsS1B1_I.flgNewUg0Pck UEGO_DataSplyClsS1B1_I.flgNewUg0PckAry UEGO_DataSplyClsS1B1_I.flgNewUg0aPck UEGO_DataSplyClsS1B1_I.flgNewUg0ePck UEGO_DataSplyClsS1B1_I.flgNewUg0iPck UEGO_DataSplyClsS1B1_I.flgNewUg0iPckAry UEGO_DataSplyClsS1B1_I.flgNewUg0iaiPck UEGO_DataSplyClsS1B1_I.flgNewUg0ieiPck UEGO_DataSplyClsS1B1_I.flgNewUg0ix7PckAry UEGO_DataSplyClsS1B1_I.flgNewUg0ix9PckAry UEGO_DataSplyClsS1B1_I.flgNewUg0ixPckAry UEGO_DataSplyClsS1B1_I.flgNewUg0mPck UEGO_DataSplyClsS1B1_I.flgNewUgaPck UEGO_DataSplyClsS1B1_I.flgNewUgiPckAry UEGO_DataSplyClsS1B1_I.flgNewUgkAvrgPck UEGO_DataSplyClsS1B1_I.flgNewUguaPck UEGO_DataSplyClsS1B1_I.flgNewUguaZ2Pck UEGO_DataSplyClsS1B1_I.flgNewUguiPck UEGO_DataSplyClsS1B1_I.flgNewUguiZ1Pck UEGO_DataSplyClsS1B1_I.flgNewUi21PckAry UEGO_DataSplyClsS1B1_I.flgNewUi22Pck UEGO_DataSplyClsS1B1_I.flgNewUi23Pck UEGO_DataSplyClsS1B1_I.flgNewUi24Pck UEGO_DataSplyClsS1B1_I.flgNewUi4Pck UEGO_DataSplyClsS1B1_I.flgNewUi4Z2Pck UEGO_DataSplyClsS1B1_I.flgNewUigPckAry UEGO_DataSplyClsS1B1_I.flgNewUigmkPckAry UEGO_DataSplyClsS1B1_I.flgNewUipcalAvrgPck UEGO_DataSplyClsS1B1_I.flgNewUn0Pck UEGO_DataSplyClsS1B1_I.flgNewUn0Pck4Ary UEGO_DataSplyClsS1B1_I.flgNewUn0Pck5Ary UEGO_DataSplyClsS1B1_I.flgNewUn0PckAry UEGO_DataSplyClsS1B1_I.flgNewUnPckAry UEGO_DataSplyClsS1B1_I.flgNewUnSetPck UEGO_DataSplyClsS1B1_I.flgNewUnx3PckAry UEGO_DataSplyClsS1B1_I.flgNewUnx4PckAry UEGO_DataSplyClsS1B1_I.flgNewUp0Pck UEGO_DataSplyClsS1B1_I.flgNewUp0Pck4 UEGO_DataSplyClsS1B1_I.flgNewUp0Pck5Ary UEGO_DataSplyClsS1B1_I.flgNewUp0PckAry UEGO_DataSplyClsS1B1_I.flgNewUpPckAry UEGO_DataSplyClsS1B1_I.flgNewUpx3PckAry UEGO_DataSplyClsS1B1_I.flgNewUpx4PckAry UEGO_DataSplyClsS1B1_I.flgNewUriaPckVld UEGO_DataSplyClsS1B1_I.flgNewUriePckAry UEGO_DataSplyClsS1B1_I.flgNewUx6PckAry UEGO_DataSplyClsS1B1_I.flgNewUx7PckAry UEGO_DataSplyClsS1B1_I.flgNewUx8PckAry UEGO_DataSplyClsS1B1_I.flgNewUx9PckAry UEGO_DataSplyClsS1B1_I.flgNewUxPckAry UEGO_DataSplyClsS1B1_I.flgReStable UEGO_DataSplyClsS1B1_I.flgSngCell UEGO_DataSplyClsS1B1_I.flgUical0Vld UEGO_DataSplyClsS1B1_I.flgUicalVld UEGO_DataSplyClsS1B1_I.flgUoffipe1Vld UEGO_DataSplyClsS1B1_I.flgUoffipe2Vld UEGO_DataSplyClsS1B1_I.flgUoffipe3Vld UEGO_DataSplyClsS1B1_I.flgUoffvcc1Vld UEGO_DataSplyClsS1B1_I.flgUoffvcc2Vld UEGO_DataSplyClsS1B1_I.flgUoffvcc3Vld UEGO_DataSplyClsS1B1_I.flgUriaMeas UEGO_DataSplyClsS1B1_I.nrIPmpDacPckAry UEGO_DataSplyClsS1B1_I.nrIpPckAry UEGO_DataSplyClsS1B1_I.nrModeMeas UEGO_DataSplyClsS1B1_I.nrRamFailPosn UEGO_DataSplyClsS1B1_I.nrRamMod UEGO_DataSplyClsS1B1_I.nrRamRegMod UEGO_DataSplyClsS1B1_I.nrRamSts1 UEGO_DataSplyClsS1B1_I.nrRamSts2 UEGO_DataSplyClsS1B1_I.nrRamSts3 UEGO_DataSplyClsS1B1_I.nrURmVG4PckAry UEGO_DataSplyClsS1B1_I.nrUa2PckAry UEGO_DataSplyClsS1B1_I.nrUcalMaxCorrd UEGO_DataSplyClsS1B1_I.nrUg0PckAry UEGO_DataSplyClsS1B1_I.nrUg0iPckAry UEGO_DataSplyClsS1B1_I.nrUg0ix7PckAry UEGO_DataSplyClsS1B1_I.nrUg0ix9PckAry UEGO_DataSplyClsS1B1_I.nrUg0ixPckAry UEGO_DataSplyClsS1B1_I.nrUgaPckAry UEGO_DataSplyClsS1B1_I.nrUgiPckAry UEGO_DataSplyClsS1B1_I.nrUi21PckAry UEGO_DataSplyClsS1B1_I.nrUical0PckCorrd UEGO_DataSplyClsS1B1_I.nrUicalPckCorrd UEGO_DataSplyClsS1B1_I.nrUigPckAry UEGO_DataSplyClsS1B1_I.nrUigmkPckAry UEGO_DataSplyClsS1B1_I.nrUn0Pck4Ary UEGO_DataSplyClsS1B1_I.nrUn0Pck5Ary UEGO_DataSplyClsS1B1_I.nrUn0PckAry UEGO_DataSplyClsS1B1_I.nrUnPckAry UEGO_DataSplyClsS1B1_I.nrUnx3PckAry UEGO_DataSplyClsS1B1_I.nrUnx4PckAry UEGO_DataSplyClsS1B1_I.nrUoffipe1 UEGO_DataSplyClsS1B1_I.nrUoffipe2 UEGO_DataSplyClsS1B1_I.nrUoffipe3 UEGO_DataSplyClsS1B1_I.nrUoffvcc1 UEGO_DataSplyClsS1B1_I.nrUoffvcc2 UEGO_DataSplyClsS1B1_I.nrUoffvcc3 UEGO_DataSplyClsS1B1_I.nrUp0Pck5Ary UEGO_DataSplyClsS1B1_I.nrUp0PckAry UEGO_DataSplyClsS1B1_I.nrUpPckAry UEGO_DataSplyClsS1B1_I.nrUpx3PckAry UEGO_DataSplyClsS1B1_I.nrUpx4PckAry UEGO_DataSplyClsS1B1_I.nrUriePckAry UEGO_DataSplyClsS1B1_I.nrUx6PckAry UEGO_DataSplyClsS1B1_I.nrUx7PckAry UEGO_DataSplyClsS1B1_I.nrUx8PckAry UEGO_DataSplyClsS1B1_I.nrUx9PckAry UEGO_DataSplyClsS1B1_I.nrUxPckAry UEGO_DataSplyClsS1B1_I.stIPmpOK UEGO_DataSplyClsS1B1_I.stIPmpTM UEGO_DataSplyClsS1B1_I.stIPmpTM2L UEGO_DataSplyClsS1B1_I.stIPmpTM2R UEGO_DataSplyClsS1B1_I.stLsmRetValMod UEGO_DataSplyClsS1B1_I.stMKMeas UEGO_DataSplyClsS1B1_I.stOFFMeas UEGO_DataSplyClsS1B1_I.stOPTMeas UEGO_DataSplyClsS1B1_I.stREFMeas UEGO_DataSplyClsS1B1_I.stUa2PckAry UEGO_DataSplyClsS1B1_I.stUa2Z1PckAry UEGO_DataSplyClsS1B1_I.stUg0iPckAry UEGO_DataSplyClsS1B1_I.stUg0ix7IActvPckAry UEGO_DataSplyClsS1B1_I.stUg0ix7PmpIActvPckAry UEGO_DataSplyClsS1B1_I.stUg0ix9IActvPckAry UEGO_DataSplyClsS1B1_I.stUg0ix9PmpIActvPckAry UEGO_DataSplyClsS1B1_I.stUg0ixIActvPckAry UEGO_DataSplyClsS1B1_I.stUg0ixPmpIActvPckAry UEGO_DataSplyClsS1B1_I.stUi21PckAry UEGO_DataSplyClsS1B1_I.stUi21Z1PckAry UEGO_DataSplyClsS1B1_I.stUigmkNernstIActvPckAry UEGO_DataSplyClsS1B1_I.stUigmkPmpIActvPckAry UEGO_DataSplyClsS1B1_I.stUn0PckAry UEGO_DataSplyClsS1B1_I.stUn0Z2PckAry UEGO_DataSplyClsS1B1_I.stUnPckAry UEGO_DataSplyClsS1B1_I.stUnx3IActvAcrsNernstCellPckAry UEGO_DataSplyClsS1B1_I.stUnx3IActvAcrsPmpCellPckAry UEGO_DataSplyClsS1B1_I.stUnx4IActvAcrsNernstCellPckAry UEGO_DataSplyClsS1B1_I.stUnx4IActvAcrsPmpCellPckAry UEGO_DataSplyClsS1B1_I.stUp0PckAry UEGO_DataSplyClsS1B1_I.stUp0Z2PckAry UEGO_DataSplyClsS1B1_I.stUpPckAry UEGO_DataSplyClsS1B1_I.stUpZ2PckAry UEGO_DataSplyClsS1B1_I.stUpx3IActvAcrsNernstCellPckAry UEGO_DataSplyClsS1B1_I.stUpx3IActvAcrsPmpCellPckAry UEGO_DataSplyClsS1B1_I.stUpx4IActvAcrsNernstCellPckAry UEGO_DataSplyClsS1B1_I.stUpx4IActvAcrsPmpCellPckAry UEGO_DataSplyClsS1B1_I.stUriePckAry UEGO_DataSplyClsS1B1_I.stUx6IActvPckAry UEGO_DataSplyClsS1B1_I.stUx6MeasAcrsPmpCellPckAry UEGO_DataSplyClsS1B1_I.stUx7IActvPckAry UEGO_DataSplyClsS1B1_I.stUx7MeasAcrsPmpCellPckAry UEGO_DataSplyClsS1B1_I.stUx8IActvPckAry UEGO_DataSplyClsS1B1_I.stUx8MeasAcrsPmpCellPckAry UEGO_DataSplyClsS1B1_I.stUx9IActvPckAry UEGO_DataSplyClsS1B1_I.stUx9MeasAcrsPmpCellPckAry UEGO_DataSplyClsS1B1_I.stUxIActvPckAry UEGO_DataSplyClsS1B1_I.stUxMeasAcrsPmpCell UEGO_DataSplyClsS1B1_I.tiUEGOPck UEGO_DataSplyClsS1B1_I.uFkal1 UEGO_DataSplyClsS1B1_I.uFkal2 UEGO_DataSplyClsS1B1_I.uFkal3 UEGO_DataSplyClsS1B1_I.uUCalPck UEGO_DataSplyClsS1B1_I.uUa31Pck UEGO_DataSplyClsS1B1_I.uUa32Pck UEGO_DataSplyClsS1B1_I.uUa33Pck UEGO_DataSplyClsS1B1_I.uUamPck UEGO_DataSplyClsS1B1_I.uUapePck UEGO_DataSplyClsS1B1_I.uUcalMaxPck UEGO_DataSplyClsS1B1_I.uUg0Pck UEGO_DataSplyClsS1B1_I.uUg0aPck UEGO_DataSplyClsS1B1_I.uUg0ePck UEGO_DataSplyClsS1B1_I.uUg0iPck UEGO_DataSplyClsS1B1_I.uUg0iaiPck UEGO_DataSplyClsS1B1_I.uUg0ieiPck UEGO_DataSplyClsS1B1_I.uUg0mPck UEGO_DataSplyClsS1B1_I.uUgkAvrgPck UEGO_DataSplyClsS1B1_I.uUguaPck UEGO_DataSplyClsS1B1_I.uUguaZ2Pck UEGO_DataSplyClsS1B1_I.uUguiPck UEGO_DataSplyClsS1B1_I.uUguiZ1Pck UEGO_DataSplyClsS1B1_I.uUi22Pck UEGO_DataSplyClsS1B1_I.uUi23Pck UEGO_DataSplyClsS1B1_I.uUi24Pck UEGO_DataSplyClsS1B1_I.uUi4Pck UEGO_DataSplyClsS1B1_I.uUi4Z2Pck UEGO_DataSplyClsS1B1_I.uUipcalAvrgPck UEGO_DataSplyClsS1B1_I.uUn0Pck UEGO_DataSplyClsS1B1_I.uUnSet UEGO_DataSplyClsS1B1_I.uUp0Pck UEGO_DataSplyClsS1B1_I.uUp0Pck4 UEGO_DataSplyClsS1B1_I.uUriaPck UEGO_DataSplyClsS1B1_I.uVCC1Corrd UEGO_DataSplyClsS1B1_I.uVCC3Ref UEGO_flgCJ135AnS1B1 UEGO_flgSysSuprtdS1B1 UEGO_ratIPmpRawS1B1 UEGO_RegGetPrmS1B1_I.flgDlyBlcknNxtPckVld UEGO_RegGetPrmS1B1_I.flgDlyBlcknVld UEGO_RegGetPrmS1B1_I.flgDspDiagDis UEGO_RegGetPrmS1B1_I.flgDspDiagDisNxtPck UEGO_RegGetPrmS1B1_I.flgDspDiagDisNxtPckVld UEGO_RegGetPrmS1B1_I.flgDspDiagDisVld UEGO_RegGetPrmS1B1_I.flgEnSpA UEGO_RegGetPrmS1B1_I.flgEnSpAVld UEGO_RegGetPrmS1B1_I.flgEnSpE UEGO_RegGetPrmS1B1_I.flgEnSpEVld UEGO_RegGetPrmS1B1_I.flgEnSpNxtPckVld UEGO_RegGetPrmS1B1_I.flgEnSpVld UEGO_RegGetPrmS1B1_I.flgIPmpBlcknNxtPckVld UEGO_RegGetPrmS1B1_I.flgIPmpBlcknVld UEGO_RegGetPrmS1B1_I.flgIPmpLimnHiVld UEGO_RegGetPrmS1B1_I.flgIPmpLimnLoVld UEGO_RegGetPrmS1B1_I.flgIPmpRst UEGO_RegGetPrmS1B1_I.flgIPmpRstNxtPck UEGO_RegGetPrmS1B1_I.flgIPmpRstNxtPckVld UEGO_RegGetPrmS1B1_I.flgIPmpRstVld UEGO_RegGetPrmS1B1_I.flgIPmpSm UEGO_RegGetPrmS1B1_I.flgIPmpSmNxtPck UEGO_RegGetPrmS1B1_I.flgIPmpSmNxtPckVld UEGO_RegGetPrmS1B1_I.flgIPmpSmVld UEGO_RegGetPrmS1B1_I.flgLCal UEGO_RegGetPrmS1B1_I.flgLCalVld UEGO_RegGetPrmS1B1_I.flgLCurr UEGO_RegGetPrmS1B1_I.flgLCurrVld UEGO_RegGetPrmS1B1_I.flgLDAC UEGO_RegGetPrmS1B1_I.flgLDACConf UEGO_RegGetPrmS1B1_I.flgLDACConfVld UEGO_RegGetPrmS1B1_I.flgLDACVld UEGO_RegGetPrmS1B1_I.flgLG0 UEGO_RegGetPrmS1B1_I.flgLG0Vld UEGO_RegGetPrmS1B1_I.flgLN UEGO_RegGetPrmS1B1_I.flgLNNxtPck UEGO_RegGetPrmS1B1_I.flgLNNxtPckVld UEGO_RegGetPrmS1B1_I.flgLNVld UEGO_RegGetPrmS1B1_I.flgLP UEGO_RegGetPrmS1B1_I.flgLPNxtPck UEGO_RegGetPrmS1B1_I.flgLPNxtPckVld UEGO_RegGetPrmS1B1_I.flgLPVld UEGO_RegGetPrmS1B1_I.flgMKA UEGO_RegGetPrmS1B1_I.flgMKAVld UEGO_RegGetPrmS1B1_I.flgMKE UEGO_RegGetPrmS1B1_I.flgMKEVld UEGO_RegGetPrmS1B1_I.flgMKNxtPckVld UEGO_RegGetPrmS1B1_I.flgMKVld UEGO_RegGetPrmS1B1_I.flgN3MeasActvNxtPck UEGO_RegGetPrmS1B1_I.flgN3MeasActvNxtPckVld UEGO_RegGetPrmS1B1_I.flgOFFNxtPckVld UEGO_RegGetPrmS1B1_I.flgOFFVld UEGO_RegGetPrmS1B1_I.flgOPTNxtPckVld UEGO_RegGetPrmS1B1_I.flgOPTVld UEGO_RegGetPrmS1B1_I.flgPatNxtPckVld UEGO_RegGetPrmS1B1_I.flgPatVld UEGO_RegGetPrmS1B1_I.flgRCmpHeatrEdgeShiftAllwd UEGO_RegGetPrmS1B1_I.flgRCmpHeatrEdgeShiftAllwdNxtPck UEGO_RegGetPrmS1B1_I.flgRCmpHeatrEdgeShiftAllwdNxtPckVld UEGO_RegGetPrmS1B1_I.flgRCmpHeatrEdgeShiftAllwdVld UEGO_RegGetPrmS1B1_I.flgReStab UEGO_RegGetPrmS1B1_I.flgReStabVld UEGO_RegGetPrmS1B1_I.flgRefNxtPckVld UEGO_RegGetPrmS1B1_I.flgRefPatChng UEGO_RegGetPrmS1B1_I.flgRefPatNxtPckVld UEGO_RegGetPrmS1B1_I.flgRefPatVld UEGO_RegGetPrmS1B1_I.flgRefVld UEGO_RegGetPrmS1B1_I.flgRegIPmpSetNxtPckVld UEGO_RegGetPrmS1B1_I.flgRegIPmpSetVld UEGO_RegGetPrmS1B1_I.flgRegIpoffChng UEGO_RegGetPrmS1B1_I.flgRegIpoffNxtPckVld UEGO_RegGetPrmS1B1_I.flgRegIpoffVld UEGO_RegGetPrmS1B1_I.flgRegModNxtPckVld UEGO_RegGetPrmS1B1_I.flgRegModVld UEGO_RegGetPrmS1B1_I.flgRegPartModNxtPckVld UEGO_RegGetPrmS1B1_I.flgRegPartModVld UEGO_RegGetPrmS1B1_I.flgRegUnsetNxtPckVld UEGO_RegGetPrmS1B1_I.flgRiaPatChng UEGO_RegGetPrmS1B1_I.flgRiaPatVld UEGO_RegGetPrmS1B1_I.flgRipVld UEGO_RegGetPrmS1B1_I.flgSngCell UEGO_RegGetPrmS1B1_I.flgSngCellVld UEGO_RegGetPrmS1B1_I.flgSteerPatChng UEGO_RegGetPrmS1B1_I.flgSteerPatNxtPckVld UEGO_RegGetPrmS1B1_I.flgSteerPatVld UEGO_RegGetPrmS1B1_I.flgSubModMeasNxtPckVld UEGO_RegGetPrmS1B1_I.flgSubModMeasVld UEGO_RegGetPrmS1B1_I.flgSwVirtGnd UEGO_RegGetPrmS1B1_I.flgSwVirtGndVld UEGO_RegGetPrmS1B1_I.flgTrimSqChng UEGO_RegGetPrmS1B1_I.flgTrimSqrCalChng UEGO_RegGetPrmS1B1_I.flgTrimSqrChng UEGO_RegGetPrmS1B1_I.flgTrmNxtPckVld UEGO_RegGetPrmS1B1_I.flgTrmSqCalOffSet UEGO_RegGetPrmS1B1_I.flgTrmSqCalVld UEGO_RegGetPrmS1B1_I.flgTrmSqOffSet UEGO_RegGetPrmS1B1_I.flgTrmSqOffSetVld UEGO_RegGetPrmS1B1_I.flgTrmSqVld UEGO_RegGetPrmS1B1_I.flgTrmSqrCalOffSet UEGO_RegGetPrmS1B1_I.flgTrmSqrCalVld UEGO_RegGetPrmS1B1_I.flgTrmSqrOffSet UEGO_RegGetPrmS1B1_I.flgTrmSqrOffSetVld UEGO_RegGetPrmS1B1_I.flgTrmSqrVld UEGO_RegGetPrmS1B1_I.flgUnsetVld UEGO_RegGetPrmS1B1_I.flgUp0LeanNxtPckVld UEGO_RegGetPrmS1B1_I.flgUp0LeanVld UEGO_RegGetPrmS1B1_I.flgUp0RichNxtPckVld UEGO_RegGetPrmS1B1_I.flgUp0RichVld UEGO_RegGetPrmS1B1_I.flgUria UEGO_RegGetPrmS1B1_I.flgUriaNxtPck UEGO_RegGetPrmS1B1_I.flgUriaNxtPckVld UEGO_RegGetPrmS1B1_I.flgUriaVld UEGO_RegGetPrmS1B1_I.flgV1BF2NxtPckVld UEGO_RegGetPrmS1B1_I.flgV1BF2Vld UEGO_RegGetPrmS1B1_I.flgV1BF3NxtPckVld UEGO_RegGetPrmS1B1_I.flgV1BIT1 UEGO_RegGetPrmS1B1_I.flgV1BIT1NxtPck UEGO_RegGetPrmS1B1_I.flgV1BIT1NxtPckVld UEGO_RegGetPrmS1B1_I.flgV1BIT1Vld UEGO_RegGetPrmS1B1_I.flgV1BIT2 UEGO_RegGetPrmS1B1_I.flgV1BIT2NxtPck UEGO_RegGetPrmS1B1_I.flgV1BIT2NxtPckVld UEGO_RegGetPrmS1B1_I.flgV1BIT2Vld UEGO_RegGetPrmS1B1_I.flgV1BIT5 UEGO_RegGetPrmS1B1_I.flgV1BIT5NxtPck UEGO_RegGetPrmS1B1_I.flgV1BIT5NxtPckVld UEGO_RegGetPrmS1B1_I.flgV1BIT5Vld UEGO_RegGetPrmS1B1_I.flgWtrEleclyActv UEGO_RegGetPrmS1B1_I.flgWtrEleclyActvNxtPck UEGO_RegGetPrmS1B1_I.flgWtrEleclyActvNxtPckVld UEGO_RegGetPrmS1B1_I.flgWtrEleclyActvVld UEGO_RegGetPrmS1B1_I.flgZIsqrA UEGO_RegGetPrmS1B1_I.flgZIsqrAVld UEGO_RegGetPrmS1B1_I.flgZIsqrE UEGO_RegGetPrmS1B1_I.flgZIsqrEVld UEGO_RegGetPrmS1B1_I.nrIPmpBlcknNxtPck UEGO_RegGetPrmS1B1_I.nrIPmpLimnHi UEGO_RegGetPrmS1B1_I.nrIPmpLimnLo UEGO_RegGetPrmS1B1_I.nrPmpBlckn UEGO_RegGetPrmS1B1_I.nrRefPatNxtPck UEGO_RegGetPrmS1B1_I.nrRegIPmpSet UEGO_RegGetPrmS1B1_I.nrRegIPmpSetNxtPck UEGO_RegGetPrmS1B1_I.nrRegIpoff UEGO_RegGetPrmS1B1_I.nrRegMod UEGO_RegGetPrmS1B1_I.nrRegModNxtPck UEGO_RegGetPrmS1B1_I.nrRegPartMod UEGO_RegGetPrmS1B1_I.nrRegPartModNxtPck UEGO_RegGetPrmS1B1_I.nrRegTrmNxtPck UEGO_RegGetPrmS1B1_I.nrRegTrmSqNxtPck UEGO_RegGetPrmS1B1_I.nrRegTrmSqrNxtPck UEGO_RegGetPrmS1B1_I.nrRip UEGO_RegGetPrmS1B1_I.nrSteerPatNxtPck UEGO_RegGetPrmS1B1_I.nrSubModMeas UEGO_RegGetPrmS1B1_I.nrSubModMeasNxtPck UEGO_RegGetPrmS1B1_I.nrTrmSq UEGO_RegGetPrmS1B1_I.nrTrmSqCal UEGO_RegGetPrmS1B1_I.nrTrmSqr UEGO_RegGetPrmS1B1_I.nrTrmSqrCal UEGO_RegGetPrmS1B1_I.nrUnset UEGO_RegGetPrmS1B1_I.nrUnsetNxtPck UEGO_RegGetPrmS1B1_I.nrUp0Lean UEGO_RegGetPrmS1B1_I.nrUp0LeanNxtPck UEGO_RegGetPrmS1B1_I.nrUp0Rich UEGO_RegGetPrmS1B1_I.nrUp0RichNxtPck UEGO_RegGetPrmS1B1_I.stDlyBlckn UEGO_RegGetPrmS1B1_I.stDlyBlcknNxtPck UEGO_RegGetPrmS1B1_I.stEnSp UEGO_RegGetPrmS1B1_I.stEnSpNxtPck UEGO_RegGetPrmS1B1_I.stMK UEGO_RegGetPrmS1B1_I.stMKNxtPck UEGO_RegGetPrmS1B1_I.stOFF UEGO_RegGetPrmS1B1_I.stOFFNxtPck UEGO_RegGetPrmS1B1_I.stOPT UEGO_RegGetPrmS1B1_I.stOPTNxtPck UEGO_RegGetPrmS1B1_I.stPat UEGO_RegGetPrmS1B1_I.stPatNxtPck UEGO_RegGetPrmS1B1_I.stRef UEGO_RegGetPrmS1B1_I.stRefNxtPck UEGO_RegGetPrmS1B1_I.stRefPat UEGO_RegGetPrmS1B1_I.stRegIpoffNxtPck UEGO_RegGetPrmS1B1_I.stRiaPat UEGO_RegGetPrmS1B1_I.stSteerPat UEGO_RegGetPrmS1B1_I.stV1BF2 UEGO_RegGetPrmS1B1_I.stV1BF2NxtPck UEGO_RegGetPrmS1B1_I.stV1BF3NxtPck /end IN_MEASUREMENT
 /begin OUT_MEASUREMENT UEGO_flgIPmpLimdLiS1B1 UEGO_flgIPmpLimdSevS1B1 UEGO_flgIPmpLimdVldS1B1 /end OUT_MEASUREMENT
 /begin LOC_MEASUREMENT UEGO_IPmpLimnEvlnClassS1B1_I.flgIPmpLimdLi UEGO_IPmpLimnEvlnClassS1B1_I.flgIPmpLimdPckVld UEGO_IPmpLimnEvlnClassS1B1_I.flgIPmpLimdSev UEGO_IPmpLimnEvlnClassS1B1_I.flgIPmpLimdVld UEGO_IPmpLimnEvlnClassS1B1_I.nrIPmpLimdPck UEGO_nrIPmp_dummy /end LOC_MEASUREMENT
 FUNCTION_VERSION "1.12.0" /end FUNCTION
/begin FUNCTION UEGO_IPmpPck "1.16.0    UEGO Pump Current Package Handling"
 /begin DEF_CHARACTERISTIC UEGO_facIpDeltaFltConst_C UEGO_facIPmpRawFltConst_C UEGO_stIPmpPckHiPrcsnBitMask_C UEGO_stIPmpPck_C UEGO_tiDlyIPmpNotDistrbdOn_C /end DEF_CHARACTERISTIC
 /begin IN_MEASUREMENT UEGO_DataSplyClsS1B1_I.flgCj135An UEGO_DataSplyClsS1B1_I.flgDACOff UEGO_DataSplyClsS1B1_I.flgErrSpiRamRet UEGO_DataSplyClsS1B1_I.flgFKal1Vld UEGO_DataSplyClsS1B1_I.flgFKal2Vld UEGO_DataSplyClsS1B1_I.flgFKal3Vld UEGO_DataSplyClsS1B1_I.flgIPmpActvd UEGO_DataSplyClsS1B1_I.flgISQrA UEGO_DataSplyClsS1B1_I.flgISQrE UEGO_DataSplyClsS1B1_I.flgLCURR UEGO_DataSplyClsS1B1_I.flgLNMeas UEGO_DataSplyClsS1B1_I.flgLPMeas UEGO_DataSplyClsS1B1_I.flgLoupeCAL UEGO_DataSplyClsS1B1_I.flgLoupeG0 UEGO_DataSplyClsS1B1_I.flgLstPckAbort UEGO_DataSplyClsS1B1_I.flgMKA UEGO_DataSplyClsS1B1_I.flgMKE UEGO_DataSplyClsS1B1_I.flgNewIPmpDacPckAry UEGO_DataSplyClsS1B1_I.flgNewIPmpOK UEGO_DataSplyClsS1B1_I.flgNewIPmpPckAry UEGO_DataSplyClsS1B1_I.flgNewIPmpTM UEGO_DataSplyClsS1B1_I.flgNewPck UEGO_DataSplyClsS1B1_I.flgNewPckCstnc UEGO_DataSplyClsS1B1_I.flgNewPckMiss UEGO_DataSplyClsS1B1_I.flgNewPckVld UEGO_DataSplyClsS1B1_I.flgNewTiPck UEGO_DataSplyClsS1B1_I.flgNewURmVG4MeasAryVld UEGO_DataSplyClsS1B1_I.flgNewUa2Pck UEGO_DataSplyClsS1B1_I.flgNewUa31Pck UEGO_DataSplyClsS1B1_I.flgNewUa32Pck UEGO_DataSplyClsS1B1_I.flgNewUa33Pck UEGO_DataSplyClsS1B1_I.flgNewUamPck UEGO_DataSplyClsS1B1_I.flgNewUapePck UEGO_DataSplyClsS1B1_I.flgNewUcalMaxPck UEGO_DataSplyClsS1B1_I.flgNewUcalPck UEGO_DataSplyClsS1B1_I.flgNewUg0Pck UEGO_DataSplyClsS1B1_I.flgNewUg0PckAry UEGO_DataSplyClsS1B1_I.flgNewUg0aPck UEGO_DataSplyClsS1B1_I.flgNewUg0ePck UEGO_DataSplyClsS1B1_I.flgNewUg0iPck UEGO_DataSplyClsS1B1_I.flgNewUg0iPckAry UEGO_DataSplyClsS1B1_I.flgNewUg0iaiPck UEGO_DataSplyClsS1B1_I.flgNewUg0ieiPck UEGO_DataSplyClsS1B1_I.flgNewUg0ix7PckAry UEGO_DataSplyClsS1B1_I.flgNewUg0ix9PckAry UEGO_DataSplyClsS1B1_I.flgNewUg0ixPckAry UEGO_DataSplyClsS1B1_I.flgNewUg0mPck UEGO_DataSplyClsS1B1_I.flgNewUgaPck UEGO_DataSplyClsS1B1_I.flgNewUgiPckAry UEGO_DataSplyClsS1B1_I.flgNewUgkAvrgPck UEGO_DataSplyClsS1B1_I.flgNewUguaPck UEGO_DataSplyClsS1B1_I.flgNewUguaZ2Pck UEGO_DataSplyClsS1B1_I.flgNewUguiPck UEGO_DataSplyClsS1B1_I.flgNewUguiZ1Pck UEGO_DataSplyClsS1B1_I.flgNewUi21PckAry UEGO_DataSplyClsS1B1_I.flgNewUi22Pck UEGO_DataSplyClsS1B1_I.flgNewUi23Pck UEGO_DataSplyClsS1B1_I.flgNewUi24Pck UEGO_DataSplyClsS1B1_I.flgNewUi4Pck UEGO_DataSplyClsS1B1_I.flgNewUi4Z2Pck UEGO_DataSplyClsS1B1_I.flgNewUigPckAry UEGO_DataSplyClsS1B1_I.flgNewUigmkPckAry UEGO_DataSplyClsS1B1_I.flgNewUipcalAvrgPck UEGO_DataSplyClsS1B1_I.flgNewUn0Pck UEGO_DataSplyClsS1B1_I.flgNewUn0Pck4Ary UEGO_DataSplyClsS1B1_I.flgNewUn0Pck5Ary UEGO_DataSplyClsS1B1_I.flgNewUn0PckAry UEGO_DataSplyClsS1B1_I.flgNewUnPckAry UEGO_DataSplyClsS1B1_I.flgNewUnSetPck UEGO_DataSplyClsS1B1_I.flgNewUnx3PckAry UEGO_DataSplyClsS1B1_I.flgNewUnx4PckAry UEGO_DataSplyClsS1B1_I.flgNewUp0Pck UEGO_DataSplyClsS1B1_I.flgNewUp0Pck4 UEGO_DataSplyClsS1B1_I.flgNewUp0Pck5Ary UEGO_DataSplyClsS1B1_I.flgNewUp0PckAry UEGO_DataSplyClsS1B1_I.flgNewUpPckAry UEGO_DataSplyClsS1B1_I.flgNewUpx3PckAry UEGO_DataSplyClsS1B1_I.flgNewUpx4PckAry UEGO_DataSplyClsS1B1_I.flgNewUriaPckVld UEGO_DataSplyClsS1B1_I.flgNewUriePckAry UEGO_DataSplyClsS1B1_I.flgNewUx6PckAry UEGO_DataSplyClsS1B1_I.flgNewUx7PckAry UEGO_DataSplyClsS1B1_I.flgNewUx8PckAry UEGO_DataSplyClsS1B1_I.flgNewUx9PckAry UEGO_DataSplyClsS1B1_I.flgNewUxPckAry UEGO_DataSplyClsS1B1_I.flgReStable UEGO_DataSplyClsS1B1_I.flgSngCell UEGO_DataSplyClsS1B1_I.flgUical0Vld UEGO_DataSplyClsS1B1_I.flgUicalVld UEGO_DataSplyClsS1B1_I.flgUoffipe1Vld UEGO_DataSplyClsS1B1_I.flgUoffipe2Vld UEGO_DataSplyClsS1B1_I.flgUoffipe3Vld UEGO_DataSplyClsS1B1_I.flgUoffvcc1Vld UEGO_DataSplyClsS1B1_I.flgUoffvcc2Vld UEGO_DataSplyClsS1B1_I.flgUoffvcc3Vld UEGO_DataSplyClsS1B1_I.flgUriaMeas UEGO_DataSplyClsS1B1_I.nrIPmpDacPckAry UEGO_DataSplyClsS1B1_I.nrIpPckAry UEGO_DataSplyClsS1B1_I.nrModeMeas UEGO_DataSplyClsS1B1_I.nrRamFailPosn UEGO_DataSplyClsS1B1_I.nrRamMod UEGO_DataSplyClsS1B1_I.nrRamRegMod UEGO_DataSplyClsS1B1_I.nrRamSts1 UEGO_DataSplyClsS1B1_I.nrRamSts2 UEGO_DataSplyClsS1B1_I.nrRamSts3 UEGO_DataSplyClsS1B1_I.nrURmVG4PckAry UEGO_DataSplyClsS1B1_I.nrUa2PckAry UEGO_DataSplyClsS1B1_I.nrUcalMaxCorrd UEGO_DataSplyClsS1B1_I.nrUg0PckAry UEGO_DataSplyClsS1B1_I.nrUg0iPckAry UEGO_DataSplyClsS1B1_I.nrUg0ix7PckAry UEGO_DataSplyClsS1B1_I.nrUg0ix9PckAry UEGO_DataSplyClsS1B1_I.nrUg0ixPckAry UEGO_DataSplyClsS1B1_I.nrUgaPckAry UEGO_DataSplyClsS1B1_I.nrUgiPckAry UEGO_DataSplyClsS1B1_I.nrUi21PckAry UEGO_DataSplyClsS1B1_I.nrUical0PckCorrd UEGO_DataSplyClsS1B1_I.nrUicalPckCorrd UEGO_DataSplyClsS1B1_I.nrUigPckAry UEGO_DataSplyClsS1B1_I.nrUigmkPckAry UEGO_DataSplyClsS1B1_I.nrUn0Pck4Ary UEGO_DataSplyClsS1B1_I.nrUn0Pck5Ary UEGO_DataSplyClsS1B1_I.nrUn0PckAry UEGO_DataSplyClsS1B1_I.nrUnPckAry UEGO_DataSplyClsS1B1_I.nrUnx3PckAry UEGO_DataSplyClsS1B1_I.nrUnx4PckAry UEGO_DataSplyClsS1B1_I.nrUoffipe1 UEGO_DataSplyClsS1B1_I.nrUoffipe2 UEGO_DataSplyClsS1B1_I.nrUoffipe3 UEGO_DataSplyClsS1B1_I.nrUoffvcc1 UEGO_DataSplyClsS1B1_I.nrUoffvcc2 UEGO_DataSplyClsS1B1_I.nrUoffvcc3 UEGO_DataSplyClsS1B1_I.nrUp0Pck5Ary UEGO_DataSplyClsS1B1_I.nrUp0PckAry UEGO_DataSplyClsS1B1_I.nrUpPckAry UEGO_DataSplyClsS1B1_I.nrUpx3PckAry UEGO_DataSplyClsS1B1_I.nrUpx4PckAry UEGO_DataSplyClsS1B1_I.nrUriePckAry UEGO_DataSplyClsS1B1_I.nrUx6PckAry UEGO_DataSplyClsS1B1_I.nrUx7PckAry UEGO_DataSplyClsS1B1_I.nrUx8PckAry UEGO_DataSplyClsS1B1_I.nrUx9PckAry UEGO_DataSplyClsS1B1_I.nrUxPckAry UEGO_DataSplyClsS1B1_I.stIPmpOK UEGO_DataSplyClsS1B1_I.stIPmpTM UEGO_DataSplyClsS1B1_I.stIPmpTM2L UEGO_DataSplyClsS1B1_I.stIPmpTM2R UEGO_DataSplyClsS1B1_I.stLsmRetValMod UEGO_DataSplyClsS1B1_I.stMKMeas UEGO_DataSplyClsS1B1_I.stOFFMeas UEGO_DataSplyClsS1B1_I.stOPTMeas UEGO_DataSplyClsS1B1_I.stREFMeas UEGO_DataSplyClsS1B1_I.stUa2PckAry UEGO_DataSplyClsS1B1_I.stUa2Z1PckAry UEGO_DataSplyClsS1B1_I.stUg0iPckAry UEGO_DataSplyClsS1B1_I.stUg0ix7IActvPckAry UEGO_DataSplyClsS1B1_I.stUg0ix7PmpIActvPckAry UEGO_DataSplyClsS1B1_I.stUg0ix9IActvPckAry UEGO_DataSplyClsS1B1_I.stUg0ix9PmpIActvPckAry UEGO_DataSplyClsS1B1_I.stUg0ixIActvPckAry UEGO_DataSplyClsS1B1_I.stUg0ixPmpIActvPckAry UEGO_DataSplyClsS1B1_I.stUi21PckAry UEGO_DataSplyClsS1B1_I.stUi21Z1PckAry UEGO_DataSplyClsS1B1_I.stUigmkNernstIActvPckAry UEGO_DataSplyClsS1B1_I.stUigmkPmpIActvPckAry UEGO_DataSplyClsS1B1_I.stUn0PckAry UEGO_DataSplyClsS1B1_I.stUn0Z2PckAry UEGO_DataSplyClsS1B1_I.stUnPckAry UEGO_DataSplyClsS1B1_I.stUnx3IActvAcrsNernstCellPckAry UEGO_DataSplyClsS1B1_I.stUnx3IActvAcrsPmpCellPckAry UEGO_DataSplyClsS1B1_I.stUnx4IActvAcrsNernstCellPckAry UEGO_DataSplyClsS1B1_I.stUnx4IActvAcrsPmpCellPckAry UEGO_DataSplyClsS1B1_I.stUp0PckAry UEGO_DataSplyClsS1B1_I.stUp0Z2PckAry UEGO_DataSplyClsS1B1_I.stUpPckAry UEGO_DataSplyClsS1B1_I.stUpZ2PckAry UEGO_DataSplyClsS1B1_I.stUpx3IActvAcrsNernstCellPckAry UEGO_DataSplyClsS1B1_I.stUpx3IActvAcrsPmpCellPckAry UEGO_DataSplyClsS1B1_I.stUpx4IActvAcrsNernstCellPckAry UEGO_DataSplyClsS1B1_I.stUpx4IActvAcrsPmpCellPckAry UEGO_DataSplyClsS1B1_I.stUriePckAry UEGO_DataSplyClsS1B1_I.stUx6IActvPckAry UEGO_DataSplyClsS1B1_I.stUx6MeasAcrsPmpCellPckAry UEGO_DataSplyClsS1B1_I.stUx7IActvPckAry UEGO_DataSplyClsS1B1_I.stUx7MeasAcrsPmpCellPckAry UEGO_DataSplyClsS1B1_I.stUx8IActvPckAry UEGO_DataSplyClsS1B1_I.stUx8MeasAcrsPmpCellPckAry UEGO_DataSplyClsS1B1_I.stUx9IActvPckAry UEGO_DataSplyClsS1B1_I.stUx9MeasAcrsPmpCellPckAry UEGO_DataSplyClsS1B1_I.stUxIActvPckAry UEGO_DataSplyClsS1B1_I.stUxMeasAcrsPmpCell UEGO_DataSplyClsS1B1_I.tiUEGOPck UEGO_DataSplyClsS1B1_I.uFkal1 UEGO_DataSplyClsS1B1_I.uFkal2 UEGO_DataSplyClsS1B1_I.uFkal3 UEGO_DataSplyClsS1B1_I.uUCalPck UEGO_DataSplyClsS1B1_I.uUa31Pck UEGO_DataSplyClsS1B1_I.uUa32Pck UEGO_DataSplyClsS1B1_I.uUa33Pck UEGO_DataSplyClsS1B1_I.uUamPck UEGO_DataSplyClsS1B1_I.uUapePck UEGO_DataSplyClsS1B1_I.uUcalMaxPck UEGO_DataSplyClsS1B1_I.uUg0Pck UEGO_DataSplyClsS1B1_I.uUg0aPck UEGO_DataSplyClsS1B1_I.uUg0ePck UEGO_DataSplyClsS1B1_I.uUg0iPck UEGO_DataSplyClsS1B1_I.uUg0iaiPck UEGO_DataSplyClsS1B1_I.uUg0ieiPck UEGO_DataSplyClsS1B1_I.uUg0mPck UEGO_DataSplyClsS1B1_I.uUgkAvrgPck UEGO_DataSplyClsS1B1_I.uUguaPck UEGO_DataSplyClsS1B1_I.uUguaZ2Pck UEGO_DataSplyClsS1B1_I.uUguiPck UEGO_DataSplyClsS1B1_I.uUguiZ1Pck UEGO_DataSplyClsS1B1_I.uUi22Pck UEGO_DataSplyClsS1B1_I.uUi23Pck UEGO_DataSplyClsS1B1_I.uUi24Pck UEGO_DataSplyClsS1B1_I.uUi4Pck UEGO_DataSplyClsS1B1_I.uUi4Z2Pck UEGO_DataSplyClsS1B1_I.uUipcalAvrgPck UEGO_DataSplyClsS1B1_I.uUn0Pck UEGO_DataSplyClsS1B1_I.uUnSet UEGO_DataSplyClsS1B1_I.uUp0Pck UEGO_DataSplyClsS1B1_I.uUp0Pck4 UEGO_DataSplyClsS1B1_I.uUriaPck UEGO_DataSplyClsS1B1_I.uVCC1Corrd UEGO_DataSplyClsS1B1_I.uVCC3Ref UEGO_flgIPmpLimdLiS1B1 UEGO_flgIPmpLimdVldS1B1 UEGO_flgIPmpRawAryHiPrcsnS1B1 UEGO_flgIPmpRawAryVldS1B1 UEGO_flgSysSuprtdS1B1 UEGO_flgUPmpLimnActvS1B1 UEGO_flgUPmpLimnActvVldS1B1 UEGO_iIPmpRawAryS1B1 UEGO_RegGetPrmS1B1_I.flgDlyBlcknNxtPckVld UEGO_RegGetPrmS1B1_I.flgDlyBlcknVld UEGO_RegGetPrmS1B1_I.flgDspDiagDis UEGO_RegGetPrmS1B1_I.flgDspDiagDisNxtPck UEGO_RegGetPrmS1B1_I.flgDspDiagDisNxtPckVld UEGO_RegGetPrmS1B1_I.flgDspDiagDisVld UEGO_RegGetPrmS1B1_I.flgEnSpA UEGO_RegGetPrmS1B1_I.flgEnSpAVld UEGO_RegGetPrmS1B1_I.flgEnSpE UEGO_RegGetPrmS1B1_I.flgEnSpEVld UEGO_RegGetPrmS1B1_I.flgEnSpNxtPckVld UEGO_RegGetPrmS1B1_I.flgEnSpVld UEGO_RegGetPrmS1B1_I.flgIPmpBlcknNxtPckVld UEGO_RegGetPrmS1B1_I.flgIPmpBlcknVld UEGO_RegGetPrmS1B1_I.flgIPmpLimnHiVld UEGO_RegGetPrmS1B1_I.flgIPmpLimnLoVld UEGO_RegGetPrmS1B1_I.flgIPmpRst UEGO_RegGetPrmS1B1_I.flgIPmpRstNxtPck UEGO_RegGetPrmS1B1_I.flgIPmpRstNxtPckVld UEGO_RegGetPrmS1B1_I.flgIPmpRstVld UEGO_RegGetPrmS1B1_I.flgIPmpSm UEGO_RegGetPrmS1B1_I.flgIPmpSmNxtPck UEGO_RegGetPrmS1B1_I.flgIPmpSmNxtPckVld UEGO_RegGetPrmS1B1_I.flgIPmpSmVld UEGO_RegGetPrmS1B1_I.flgLCal UEGO_RegGetPrmS1B1_I.flgLCalVld UEGO_RegGetPrmS1B1_I.flgLCurr UEGO_RegGetPrmS1B1_I.flgLCurrVld UEGO_RegGetPrmS1B1_I.flgLDAC UEGO_RegGetPrmS1B1_I.flgLDACConf UEGO_RegGetPrmS1B1_I.flgLDACConfVld UEGO_RegGetPrmS1B1_I.flgLDACVld UEGO_RegGetPrmS1B1_I.flgLG0 UEGO_RegGetPrmS1B1_I.flgLG0Vld UEGO_RegGetPrmS1B1_I.flgLN UEGO_RegGetPrmS1B1_I.flgLNNxtPck UEGO_RegGetPrmS1B1_I.flgLNNxtPckVld UEGO_RegGetPrmS1B1_I.flgLNVld UEGO_RegGetPrmS1B1_I.flgLP UEGO_RegGetPrmS1B1_I.flgLPNxtPck UEGO_RegGetPrmS1B1_I.flgLPNxtPckVld UEGO_RegGetPrmS1B1_I.flgLPVld UEGO_RegGetPrmS1B1_I.flgMKA UEGO_RegGetPrmS1B1_I.flgMKAVld UEGO_RegGetPrmS1B1_I.flgMKE UEGO_RegGetPrmS1B1_I.flgMKEVld UEGO_RegGetPrmS1B1_I.flgMKNxtPckVld UEGO_RegGetPrmS1B1_I.flgMKVld UEGO_RegGetPrmS1B1_I.flgN3MeasActvNxtPck UEGO_RegGetPrmS1B1_I.flgN3MeasActvNxtPckVld UEGO_RegGetPrmS1B1_I.flgOFFNxtPckVld UEGO_RegGetPrmS1B1_I.flgOFFVld UEGO_RegGetPrmS1B1_I.flgOPTNxtPckVld UEGO_RegGetPrmS1B1_I.flgOPTVld UEGO_RegGetPrmS1B1_I.flgPatNxtPckVld UEGO_RegGetPrmS1B1_I.flgPatVld UEGO_RegGetPrmS1B1_I.flgRCmpHeatrEdgeShiftAllwd UEGO_RegGetPrmS1B1_I.flgRCmpHeatrEdgeShiftAllwdNxtPck UEGO_RegGetPrmS1B1_I.flgRCmpHeatrEdgeShiftAllwdNxtPckVld UEGO_RegGetPrmS1B1_I.flgRCmpHeatrEdgeShiftAllwdVld UEGO_RegGetPrmS1B1_I.flgReStab UEGO_RegGetPrmS1B1_I.flgReStabVld UEGO_RegGetPrmS1B1_I.flgRefNxtPckVld UEGO_RegGetPrmS1B1_I.flgRefPatChng UEGO_RegGetPrmS1B1_I.flgRefPatNxtPckVld UEGO_RegGetPrmS1B1_I.flgRefPatVld UEGO_RegGetPrmS1B1_I.flgRefVld UEGO_RegGetPrmS1B1_I.flgRegIPmpSetNxtPckVld UEGO_RegGetPrmS1B1_I.flgRegIPmpSetVld UEGO_RegGetPrmS1B1_I.flgRegIpoffChng UEGO_RegGetPrmS1B1_I.flgRegIpoffNxtPckVld UEGO_RegGetPrmS1B1_I.flgRegIpoffVld UEGO_RegGetPrmS1B1_I.flgRegModNxtPckVld UEGO_RegGetPrmS1B1_I.flgRegModVld UEGO_RegGetPrmS1B1_I.flgRegPartModNxtPckVld UEGO_RegGetPrmS1B1_I.flgRegPartModVld UEGO_RegGetPrmS1B1_I.flgRegUnsetNxtPckVld UEGO_RegGetPrmS1B1_I.flgRiaPatChng UEGO_RegGetPrmS1B1_I.flgRiaPatVld UEGO_RegGetPrmS1B1_I.flgRipVld UEGO_RegGetPrmS1B1_I.flgSngCell UEGO_RegGetPrmS1B1_I.flgSngCellVld UEGO_RegGetPrmS1B1_I.flgSteerPatChng UEGO_RegGetPrmS1B1_I.flgSteerPatNxtPckVld UEGO_RegGetPrmS1B1_I.flgSteerPatVld UEGO_RegGetPrmS1B1_I.flgSubModMeasNxtPckVld UEGO_RegGetPrmS1B1_I.flgSubModMeasVld UEGO_RegGetPrmS1B1_I.flgSwVirtGnd UEGO_RegGetPrmS1B1_I.flgSwVirtGndVld UEGO_RegGetPrmS1B1_I.flgTrimSqChng UEGO_RegGetPrmS1B1_I.flgTrimSqrCalChng UEGO_RegGetPrmS1B1_I.flgTrimSqrChng UEGO_RegGetPrmS1B1_I.flgTrmNxtPckVld UEGO_RegGetPrmS1B1_I.flgTrmSqCalOffSet UEGO_RegGetPrmS1B1_I.flgTrmSqCalVld UEGO_RegGetPrmS1B1_I.flgTrmSqOffSet UEGO_RegGetPrmS1B1_I.flgTrmSqOffSetVld UEGO_RegGetPrmS1B1_I.flgTrmSqVld UEGO_RegGetPrmS1B1_I.flgTrmSqrCalOffSet UEGO_RegGetPrmS1B1_I.flgTrmSqrCalVld UEGO_RegGetPrmS1B1_I.flgTrmSqrOffSet UEGO_RegGetPrmS1B1_I.flgTrmSqrOffSetVld UEGO_RegGetPrmS1B1_I.flgTrmSqrVld UEGO_RegGetPrmS1B1_I.flgUnsetVld UEGO_RegGetPrmS1B1_I.flgUp0LeanNxtPckVld UEGO_RegGetPrmS1B1_I.flgUp0LeanVld UEGO_RegGetPrmS1B1_I.flgUp0RichNxtPckVld UEGO_RegGetPrmS1B1_I.flgUp0RichVld UEGO_RegGetPrmS1B1_I.flgUria UEGO_RegGetPrmS1B1_I.flgUriaNxtPck UEGO_RegGetPrmS1B1_I.flgUriaNxtPckVld UEGO_RegGetPrmS1B1_I.flgUriaVld UEGO_RegGetPrmS1B1_I.flgV1BF2NxtPckVld UEGO_RegGetPrmS1B1_I.flgV1BF2Vld UEGO_RegGetPrmS1B1_I.flgV1BF3NxtPckVld UEGO_RegGetPrmS1B1_I.flgV1BIT1 UEGO_RegGetPrmS1B1_I.flgV1BIT1NxtPck UEGO_RegGetPrmS1B1_I.flgV1BIT1NxtPckVld UEGO_RegGetPrmS1B1_I.flgV1BIT1Vld UEGO_RegGetPrmS1B1_I.flgV1BIT2 UEGO_RegGetPrmS1B1_I.flgV1BIT2NxtPck UEGO_RegGetPrmS1B1_I.flgV1BIT2NxtPckVld UEGO_RegGetPrmS1B1_I.flgV1BIT2Vld UEGO_RegGetPrmS1B1_I.flgV1BIT5 UEGO_RegGetPrmS1B1_I.flgV1BIT5NxtPck UEGO_RegGetPrmS1B1_I.flgV1BIT5NxtPckVld UEGO_RegGetPrmS1B1_I.flgV1BIT5Vld UEGO_RegGetPrmS1B1_I.flgWtrEleclyActv UEGO_RegGetPrmS1B1_I.flgWtrEleclyActvNxtPck UEGO_RegGetPrmS1B1_I.flgWtrEleclyActvNxtPckVld UEGO_RegGetPrmS1B1_I.flgWtrEleclyActvVld UEGO_RegGetPrmS1B1_I.flgZIsqrA UEGO_RegGetPrmS1B1_I.flgZIsqrAVld UEGO_RegGetPrmS1B1_I.flgZIsqrE UEGO_RegGetPrmS1B1_I.flgZIsqrEVld UEGO_RegGetPrmS1B1_I.nrIPmpBlcknNxtPck UEGO_RegGetPrmS1B1_I.nrIPmpLimnHi UEGO_RegGetPrmS1B1_I.nrIPmpLimnLo UEGO_RegGetPrmS1B1_I.nrPmpBlckn UEGO_RegGetPrmS1B1_I.nrRefPatNxtPck UEGO_RegGetPrmS1B1_I.nrRegIPmpSet UEGO_RegGetPrmS1B1_I.nrRegIPmpSetNxtPck UEGO_RegGetPrmS1B1_I.nrRegIpoff UEGO_RegGetPrmS1B1_I.nrRegMod UEGO_RegGetPrmS1B1_I.nrRegModNxtPck UEGO_RegGetPrmS1B1_I.nrRegPartMod UEGO_RegGetPrmS1B1_I.nrRegPartModNxtPck UEGO_RegGetPrmS1B1_I.nrRegTrmNxtPck UEGO_RegGetPrmS1B1_I.nrRegTrmSqNxtPck UEGO_RegGetPrmS1B1_I.nrRegTrmSqrNxtPck UEGO_RegGetPrmS1B1_I.nrRip UEGO_RegGetPrmS1B1_I.nrSteerPatNxtPck UEGO_RegGetPrmS1B1_I.nrSubModMeas UEGO_RegGetPrmS1B1_I.nrSubModMeasNxtPck UEGO_RegGetPrmS1B1_I.nrTrmSq UEGO_RegGetPrmS1B1_I.nrTrmSqCal UEGO_RegGetPrmS1B1_I.nrTrmSqr UEGO_RegGetPrmS1B1_I.nrTrmSqrCal UEGO_RegGetPrmS1B1_I.nrUnset UEGO_RegGetPrmS1B1_I.nrUnsetNxtPck UEGO_RegGetPrmS1B1_I.nrUp0Lean UEGO_RegGetPrmS1B1_I.nrUp0LeanNxtPck UEGO_RegGetPrmS1B1_I.nrUp0Rich UEGO_RegGetPrmS1B1_I.nrUp0RichNxtPck UEGO_RegGetPrmS1B1_I.stDlyBlckn UEGO_RegGetPrmS1B1_I.stDlyBlcknNxtPck UEGO_RegGetPrmS1B1_I.stEnSp UEGO_RegGetPrmS1B1_I.stEnSpNxtPck UEGO_RegGetPrmS1B1_I.stMK UEGO_RegGetPrmS1B1_I.stMKNxtPck UEGO_RegGetPrmS1B1_I.stOFF UEGO_RegGetPrmS1B1_I.stOFFNxtPck UEGO_RegGetPrmS1B1_I.stOPT UEGO_RegGetPrmS1B1_I.stOPTNxtPck UEGO_RegGetPrmS1B1_I.stPat UEGO_RegGetPrmS1B1_I.stPatNxtPck UEGO_RegGetPrmS1B1_I.stRef UEGO_RegGetPrmS1B1_I.stRefNxtPck UEGO_RegGetPrmS1B1_I.stRefPat UEGO_RegGetPrmS1B1_I.stRegIpoffNxtPck UEGO_RegGetPrmS1B1_I.stRiaPat UEGO_RegGetPrmS1B1_I.stSteerPat UEGO_RegGetPrmS1B1_I.stV1BF2 UEGO_RegGetPrmS1B1_I.stV1BF2NxtPck UEGO_RegGetPrmS1B1_I.stV1BF3NxtPck /end IN_MEASUREMENT
 /begin OUT_MEASUREMENT UEGO_flgIPmpPckHiPrcsnS1B1 UEGO_flgIPmpPckVldS1B1 UEGO_iIPmpPckAryS1B1 UEGO_iIPmpPckAvrgS1B1 /end OUT_MEASUREMENT
 /begin LOC_MEASUREMENT UEGO_IPmpPckS1B1_I.flgIPmpNotDistrbd UEGO_IPmpPckS1B1_I.flgIPmpNotDistrbdRaw UEGO_IPmpPckS1B1_I.flgIPmpPckHiPrcsn UEGO_IPmpPckS1B1_I.flgIPmpPckVld UEGO_IPmpPckS1B1_I.flgIPmpRawAvrgVld UEGO_IPmpPckS1B1_I.iIPmpPckAvrg UEGO_IPmpPckS1B1_I.iIPmpRawAvrg UEGO_IPmpPckS1B1_I.iIPmpRawLst UEGO_IPmpPckS1B1_I.stIPmpPckHiPrcsn UEGO_IPmpPckS1B1_I.UEGO_DlyIPmpNotDistrbdOnTONV_I.outbit UEGO_IPmpPckS1B1_I.UEGO_DlyIPmpNotDistrbdOnTONV_I.time UEGO_IPmpPckS1B1_I.UEGO_IPmpPck15VectDL_I.memory UEGO_IPmpPckS1B1_I.UEGO_Ip_EvlnFilDlydVldy_I.flgFilVldy UEGO_IPmpPckS1B1_I.UEGO_Ip_EvlnFilDlydVldy_I.nrSampleCurr UEGO_IPmpPckS1B1_I.UEGO_Ip_EvlnFilDlydVldy_I.nrSampleRef UEGO_IPmpPckS1B1_I.UEGO_Ip_EvlnFilDlydVldy_I.nrSampleThd UEGO_IPmpPckS1B1_I.UEGO_Ip_EvlnFilDlydVldy_I.EvlnFil_DL_I.memory /end LOC_MEASUREMENT
 FUNCTION_VERSION "1.16.0" /end FUNCTION
/begin FUNCTION UEGO_IPmpRef "1.18.0    UEGO Determination of Reference Pump Current"
 /begin DEF_CHARACTERISTIC UEGO_nrRefPlsIni_C UEGO_nrRefPlsNormRgl_C UEGO_nrRefPlsStop_C UEGO_nrRefPlsWrmUpRgl_C UEGO_nrRegUria_C UEGO_stIPmpRef_C /end DEF_CHARACTERISTIC
 /begin IN_MEASUREMENT UEGO_DataSplyClsS1B1_I.flgCj135An UEGO_DataSplyClsS1B1_I.flgDACOff UEGO_DataSplyClsS1B1_I.flgErrSpiRamRet UEGO_DataSplyClsS1B1_I.flgFKal1Vld UEGO_DataSplyClsS1B1_I.flgFKal2Vld UEGO_DataSplyClsS1B1_I.flgFKal3Vld UEGO_DataSplyClsS1B1_I.flgIPmpActvd UEGO_DataSplyClsS1B1_I.flgISQrA UEGO_DataSplyClsS1B1_I.flgISQrE UEGO_DataSplyClsS1B1_I.flgLCURR UEGO_DataSplyClsS1B1_I.flgLNMeas UEGO_DataSplyClsS1B1_I.flgLPMeas UEGO_DataSplyClsS1B1_I.flgLoupeCAL UEGO_DataSplyClsS1B1_I.flgLoupeG0 UEGO_DataSplyClsS1B1_I.flgLstPckAbort UEGO_DataSplyClsS1B1_I.flgMKA UEGO_DataSplyClsS1B1_I.flgMKE UEGO_DataSplyClsS1B1_I.flgNewIPmpDacPckAry UEGO_DataSplyClsS1B1_I.flgNewIPmpOK UEGO_DataSplyClsS1B1_I.flgNewIPmpPckAry UEGO_DataSplyClsS1B1_I.flgNewIPmpTM UEGO_DataSplyClsS1B1_I.flgNewPck UEGO_DataSplyClsS1B1_I.flgNewPckCstnc UEGO_DataSplyClsS1B1_I.flgNewPckMiss UEGO_DataSplyClsS1B1_I.flgNewPckVld UEGO_DataSplyClsS1B1_I.flgNewTiPck UEGO_DataSplyClsS1B1_I.flgNewURmVG4MeasAryVld UEGO_DataSplyClsS1B1_I.flgNewUa2Pck UEGO_DataSplyClsS1B1_I.flgNewUa31Pck UEGO_DataSplyClsS1B1_I.flgNewUa32Pck UEGO_DataSplyClsS1B1_I.flgNewUa33Pck UEGO_DataSplyClsS1B1_I.flgNewUamPck UEGO_DataSplyClsS1B1_I.flgNewUapePck UEGO_DataSplyClsS1B1_I.flgNewUcalMaxPck UEGO_DataSplyClsS1B1_I.flgNewUcalPck UEGO_DataSplyClsS1B1_I.flgNewUg0Pck UEGO_DataSplyClsS1B1_I.flgNewUg0PckAry UEGO_DataSplyClsS1B1_I.flgNewUg0aPck UEGO_DataSplyClsS1B1_I.flgNewUg0ePck UEGO_DataSplyClsS1B1_I.flgNewUg0iPck UEGO_DataSplyClsS1B1_I.flgNewUg0iPckAry UEGO_DataSplyClsS1B1_I.flgNewUg0iaiPck UEGO_DataSplyClsS1B1_I.flgNewUg0ieiPck UEGO_DataSplyClsS1B1_I.flgNewUg0ix7PckAry UEGO_DataSplyClsS1B1_I.flgNewUg0ix9PckAry UEGO_DataSplyClsS1B1_I.flgNewUg0ixPckAry UEGO_DataSplyClsS1B1_I.flgNewUg0mPck UEGO_DataSplyClsS1B1_I.flgNewUgaPck UEGO_DataSplyClsS1B1_I.flgNewUgiPckAry UEGO_DataSplyClsS1B1_I.flgNewUgkAvrgPck UEGO_DataSplyClsS1B1_I.flgNewUguaPck UEGO_DataSplyClsS1B1_I.flgNewUguaZ2Pck UEGO_DataSplyClsS1B1_I.flgNewUguiPck UEGO_DataSplyClsS1B1_I.flgNewUguiZ1Pck UEGO_DataSplyClsS1B1_I.flgNewUi21PckAry UEGO_DataSplyClsS1B1_I.flgNewUi22Pck UEGO_DataSplyClsS1B1_I.flgNewUi23Pck UEGO_DataSplyClsS1B1_I.flgNewUi24Pck UEGO_DataSplyClsS1B1_I.flgNewUi4Pck UEGO_DataSplyClsS1B1_I.flgNewUi4Z2Pck UEGO_DataSplyClsS1B1_I.flgNewUigPckAry UEGO_DataSplyClsS1B1_I.flgNewUigmkPckAry UEGO_DataSplyClsS1B1_I.flgNewUipcalAvrgPck UEGO_DataSplyClsS1B1_I.flgNewUn0Pck UEGO_DataSplyClsS1B1_I.flgNewUn0Pck4Ary UEGO_DataSplyClsS1B1_I.flgNewUn0Pck5Ary UEGO_DataSplyClsS1B1_I.flgNewUn0PckAry UEGO_DataSplyClsS1B1_I.flgNewUnPckAry UEGO_DataSplyClsS1B1_I.flgNewUnSetPck UEGO_DataSplyClsS1B1_I.flgNewUnx3PckAry UEGO_DataSplyClsS1B1_I.flgNewUnx4PckAry UEGO_DataSplyClsS1B1_I.flgNewUp0Pck UEGO_DataSplyClsS1B1_I.flgNewUp0Pck4 UEGO_DataSplyClsS1B1_I.flgNewUp0Pck5Ary UEGO_DataSplyClsS1B1_I.flgNewUp0PckAry UEGO_DataSplyClsS1B1_I.flgNewUpPckAry UEGO_DataSplyClsS1B1_I.flgNewUpx3PckAry UEGO_DataSplyClsS1B1_I.flgNewUpx4PckAry UEGO_DataSplyClsS1B1_I.flgNewUriaPckVld UEGO_DataSplyClsS1B1_I.flgNewUriePckAry UEGO_DataSplyClsS1B1_I.flgNewUx6PckAry UEGO_DataSplyClsS1B1_I.flgNewUx7PckAry UEGO_DataSplyClsS1B1_I.flgNewUx8PckAry UEGO_DataSplyClsS1B1_I.flgNewUx9PckAry UEGO_DataSplyClsS1B1_I.flgNewUxPckAry UEGO_DataSplyClsS1B1_I.flgReStable UEGO_DataSplyClsS1B1_I.flgSngCell UEGO_DataSplyClsS1B1_I.flgUical0Vld UEGO_DataSplyClsS1B1_I.flgUicalVld UEGO_DataSplyClsS1B1_I.flgUoffipe1Vld UEGO_DataSplyClsS1B1_I.flgUoffipe2Vld UEGO_DataSplyClsS1B1_I.flgUoffipe3Vld UEGO_DataSplyClsS1B1_I.flgUoffvcc1Vld UEGO_DataSplyClsS1B1_I.flgUoffvcc2Vld UEGO_DataSplyClsS1B1_I.flgUoffvcc3Vld UEGO_DataSplyClsS1B1_I.flgUriaMeas UEGO_DataSplyClsS1B1_I.nrIPmpDacPckAry UEGO_DataSplyClsS1B1_I.nrIpPckAry UEGO_DataSplyClsS1B1_I.nrModeMeas UEGO_DataSplyClsS1B1_I.nrRamFailPosn UEGO_DataSplyClsS1B1_I.nrRamMod UEGO_DataSplyClsS1B1_I.nrRamRegMod UEGO_DataSplyClsS1B1_I.nrRamSts1 UEGO_DataSplyClsS1B1_I.nrRamSts2 UEGO_DataSplyClsS1B1_I.nrRamSts3 UEGO_DataSplyClsS1B1_I.nrURmVG4PckAry UEGO_DataSplyClsS1B1_I.nrUa2PckAry UEGO_DataSplyClsS1B1_I.nrUcalMaxCorrd UEGO_DataSplyClsS1B1_I.nrUg0PckAry UEGO_DataSplyClsS1B1_I.nrUg0iPckAry UEGO_DataSplyClsS1B1_I.nrUg0ix7PckAry UEGO_DataSplyClsS1B1_I.nrUg0ix9PckAry UEGO_DataSplyClsS1B1_I.nrUg0ixPckAry UEGO_DataSplyClsS1B1_I.nrUgaPckAry UEGO_DataSplyClsS1B1_I.nrUgiPckAry UEGO_DataSplyClsS1B1_I.nrUi21PckAry UEGO_DataSplyClsS1B1_I.nrUical0PckCorrd UEGO_DataSplyClsS1B1_I.nrUicalPckCorrd UEGO_DataSplyClsS1B1_I.nrUigPckAry UEGO_DataSplyClsS1B1_I.nrUigmkPckAry UEGO_DataSplyClsS1B1_I.nrUn0Pck4Ary UEGO_DataSplyClsS1B1_I.nrUn0Pck5Ary UEGO_DataSplyClsS1B1_I.nrUn0PckAry UEGO_DataSplyClsS1B1_I.nrUnPckAry UEGO_DataSplyClsS1B1_I.nrUnx3PckAry UEGO_DataSplyClsS1B1_I.nrUnx4PckAry UEGO_DataSplyClsS1B1_I.nrUoffipe1 UEGO_DataSplyClsS1B1_I.nrUoffipe2 UEGO_DataSplyClsS1B1_I.nrUoffipe3 UEGO_DataSplyClsS1B1_I.nrUoffvcc1 UEGO_DataSplyClsS1B1_I.nrUoffvcc2 UEGO_DataSplyClsS1B1_I.nrUoffvcc3 UEGO_DataSplyClsS1B1_I.nrUp0Pck5Ary UEGO_DataSplyClsS1B1_I.nrUp0PckAry UEGO_DataSplyClsS1B1_I.nrUpPckAry UEGO_DataSplyClsS1B1_I.nrUpx3PckAry UEGO_DataSplyClsS1B1_I.nrUpx4PckAry UEGO_DataSplyClsS1B1_I.nrUriePckAry UEGO_DataSplyClsS1B1_I.nrUx6PckAry UEGO_DataSplyClsS1B1_I.nrUx7PckAry UEGO_DataSplyClsS1B1_I.nrUx8PckAry UEGO_DataSplyClsS1B1_I.nrUx9PckAry UEGO_DataSplyClsS1B1_I.nrUxPckAry UEGO_DataSplyClsS1B1_I.stIPmpOK UEGO_DataSplyClsS1B1_I.stIPmpTM UEGO_DataSplyClsS1B1_I.stIPmpTM2L UEGO_DataSplyClsS1B1_I.stIPmpTM2R UEGO_DataSplyClsS1B1_I.stLsmRetValMod UEGO_DataSplyClsS1B1_I.stMKMeas UEGO_DataSplyClsS1B1_I.stOFFMeas UEGO_DataSplyClsS1B1_I.stOPTMeas UEGO_DataSplyClsS1B1_I.stREFMeas UEGO_DataSplyClsS1B1_I.stUa2PckAry UEGO_DataSplyClsS1B1_I.stUa2Z1PckAry UEGO_DataSplyClsS1B1_I.stUg0iPckAry UEGO_DataSplyClsS1B1_I.stUg0ix7IActvPckAry UEGO_DataSplyClsS1B1_I.stUg0ix7PmpIActvPckAry UEGO_DataSplyClsS1B1_I.stUg0ix9IActvPckAry UEGO_DataSplyClsS1B1_I.stUg0ix9PmpIActvPckAry UEGO_DataSplyClsS1B1_I.stUg0ixIActvPckAry UEGO_DataSplyClsS1B1_I.stUg0ixPmpIActvPckAry UEGO_DataSplyClsS1B1_I.stUi21PckAry UEGO_DataSplyClsS1B1_I.stUi21Z1PckAry UEGO_DataSplyClsS1B1_I.stUigmkNernstIActvPckAry UEGO_DataSplyClsS1B1_I.stUigmkPmpIActvPckAry UEGO_DataSplyClsS1B1_I.stUn0PckAry UEGO_DataSplyClsS1B1_I.stUn0Z2PckAry UEGO_DataSplyClsS1B1_I.stUnPckAry UEGO_DataSplyClsS1B1_I.stUnx3IActvAcrsNernstCellPckAry UEGO_DataSplyClsS1B1_I.stUnx3IActvAcrsPmpCellPckAry UEGO_DataSplyClsS1B1_I.stUnx4IActvAcrsNernstCellPckAry UEGO_DataSplyClsS1B1_I.stUnx4IActvAcrsPmpCellPckAry UEGO_DataSplyClsS1B1_I.stUp0PckAry UEGO_DataSplyClsS1B1_I.stUp0Z2PckAry UEGO_DataSplyClsS1B1_I.stUpPckAry UEGO_DataSplyClsS1B1_I.stUpZ2PckAry UEGO_DataSplyClsS1B1_I.stUpx3IActvAcrsNernstCellPckAry UEGO_DataSplyClsS1B1_I.stUpx3IActvAcrsPmpCellPckAry UEGO_DataSplyClsS1B1_I.stUpx4IActvAcrsNernstCellPckAry UEGO_DataSplyClsS1B1_I.stUpx4IActvAcrsPmpCellPckAry UEGO_DataSplyClsS1B1_I.stUriePckAry UEGO_DataSplyClsS1B1_I.stUx6IActvPckAry UEGO_DataSplyClsS1B1_I.stUx6MeasAcrsPmpCellPckAry UEGO_DataSplyClsS1B1_I.stUx7IActvPckAry UEGO_DataSplyClsS1B1_I.stUx7MeasAcrsPmpCellPckAry UEGO_DataSplyClsS1B1_I.stUx8IActvPckAry UEGO_DataSplyClsS1B1_I.stUx8MeasAcrsPmpCellPckAry UEGO_DataSplyClsS1B1_I.stUx9IActvPckAry UEGO_DataSplyClsS1B1_I.stUx9MeasAcrsPmpCellPckAry UEGO_DataSplyClsS1B1_I.stUxIActvPckAry UEGO_DataSplyClsS1B1_I.stUxMeasAcrsPmpCell UEGO_DataSplyClsS1B1_I.tiUEGOPck UEGO_DataSplyClsS1B1_I.uFkal1 UEGO_DataSplyClsS1B1_I.uFkal2 UEGO_DataSplyClsS1B1_I.uFkal3 UEGO_DataSplyClsS1B1_I.uUCalPck UEGO_DataSplyClsS1B1_I.uUa31Pck UEGO_DataSplyClsS1B1_I.uUa32Pck UEGO_DataSplyClsS1B1_I.uUa33Pck UEGO_DataSplyClsS1B1_I.uUamPck UEGO_DataSplyClsS1B1_I.uUapePck UEGO_DataSplyClsS1B1_I.uUcalMaxPck UEGO_DataSplyClsS1B1_I.uUg0Pck UEGO_DataSplyClsS1B1_I.uUg0aPck UEGO_DataSplyClsS1B1_I.uUg0ePck UEGO_DataSplyClsS1B1_I.uUg0iPck UEGO_DataSplyClsS1B1_I.uUg0iaiPck UEGO_DataSplyClsS1B1_I.uUg0ieiPck UEGO_DataSplyClsS1B1_I.uUg0mPck UEGO_DataSplyClsS1B1_I.uUgkAvrgPck UEGO_DataSplyClsS1B1_I.uUguaPck UEGO_DataSplyClsS1B1_I.uUguaZ2Pck UEGO_DataSplyClsS1B1_I.uUguiPck UEGO_DataSplyClsS1B1_I.uUguiZ1Pck UEGO_DataSplyClsS1B1_I.uUi22Pck UEGO_DataSplyClsS1B1_I.uUi23Pck UEGO_DataSplyClsS1B1_I.uUi24Pck UEGO_DataSplyClsS1B1_I.uUi4Pck UEGO_DataSplyClsS1B1_I.uUi4Z2Pck UEGO_DataSplyClsS1B1_I.uUipcalAvrgPck UEGO_DataSplyClsS1B1_I.uUn0Pck UEGO_DataSplyClsS1B1_I.uUnSet UEGO_DataSplyClsS1B1_I.uUp0Pck UEGO_DataSplyClsS1B1_I.uUp0Pck4 UEGO_DataSplyClsS1B1_I.uUriaPck UEGO_DataSplyClsS1B1_I.uVCC1Corrd UEGO_DataSplyClsS1B1_I.uVCC3Ref UEGO_flgCJ135AnS1B1 UEGO_flgCmbEngTmpStop UEGO_flgIsqrMeasVldS1B1 UEGO_flgO2RefSuffS1B1 UEGO_flgSysSuprtdS1B1 UEGO_iIsqrMeasS1B1 UEGO_RegGetPrmS1B1_I.flgDlyBlcknNxtPckVld UEGO_RegGetPrmS1B1_I.flgDlyBlcknVld UEGO_RegGetPrmS1B1_I.flgDspDiagDis UEGO_RegGetPrmS1B1_I.flgDspDiagDisNxtPck UEGO_RegGetPrmS1B1_I.flgDspDiagDisNxtPckVld UEGO_RegGetPrmS1B1_I.flgDspDiagDisVld UEGO_RegGetPrmS1B1_I.flgEnSpA UEGO_RegGetPrmS1B1_I.flgEnSpAVld UEGO_RegGetPrmS1B1_I.flgEnSpE UEGO_RegGetPrmS1B1_I.flgEnSpEVld UEGO_RegGetPrmS1B1_I.flgEnSpNxtPckVld UEGO_RegGetPrmS1B1_I.flgEnSpVld UEGO_RegGetPrmS1B1_I.flgIPmpBlcknNxtPckVld UEGO_RegGetPrmS1B1_I.flgIPmpBlcknVld UEGO_RegGetPrmS1B1_I.flgIPmpLimnHiVld UEGO_RegGetPrmS1B1_I.flgIPmpLimnLoVld UEGO_RegGetPrmS1B1_I.flgIPmpRst UEGO_RegGetPrmS1B1_I.flgIPmpRstNxtPck UEGO_RegGetPrmS1B1_I.flgIPmpRstNxtPckVld UEGO_RegGetPrmS1B1_I.flgIPmpRstVld UEGO_RegGetPrmS1B1_I.flgIPmpSm UEGO_RegGetPrmS1B1_I.flgIPmpSmNxtPck UEGO_RegGetPrmS1B1_I.flgIPmpSmNxtPckVld UEGO_RegGetPrmS1B1_I.flgIPmpSmVld UEGO_RegGetPrmS1B1_I.flgLCal UEGO_RegGetPrmS1B1_I.flgLCalVld UEGO_RegGetPrmS1B1_I.flgLCurr UEGO_RegGetPrmS1B1_I.flgLCurrVld UEGO_RegGetPrmS1B1_I.flgLDAC UEGO_RegGetPrmS1B1_I.flgLDACConf UEGO_RegGetPrmS1B1_I.flgLDACConfVld UEGO_RegGetPrmS1B1_I.flgLDACVld UEGO_RegGetPrmS1B1_I.flgLG0 UEGO_RegGetPrmS1B1_I.flgLG0Vld UEGO_RegGetPrmS1B1_I.flgLN UEGO_RegGetPrmS1B1_I.flgLNNxtPck UEGO_RegGetPrmS1B1_I.flgLNNxtPckVld UEGO_RegGetPrmS1B1_I.flgLNVld UEGO_RegGetPrmS1B1_I.flgLP UEGO_RegGetPrmS1B1_I.flgLPNxtPck UEGO_RegGetPrmS1B1_I.flgLPNxtPckVld UEGO_RegGetPrmS1B1_I.flgLPVld UEGO_RegGetPrmS1B1_I.flgMKA UEGO_RegGetPrmS1B1_I.flgMKAVld UEGO_RegGetPrmS1B1_I.flgMKE UEGO_RegGetPrmS1B1_I.flgMKEVld UEGO_RegGetPrmS1B1_I.flgMKNxtPckVld UEGO_RegGetPrmS1B1_I.flgMKVld UEGO_RegGetPrmS1B1_I.flgN3MeasActvNxtPck UEGO_RegGetPrmS1B1_I.flgN3MeasActvNxtPckVld UEGO_RegGetPrmS1B1_I.flgOFFNxtPckVld UEGO_RegGetPrmS1B1_I.flgOFFVld UEGO_RegGetPrmS1B1_I.flgOPTNxtPckVld UEGO_RegGetPrmS1B1_I.flgOPTVld UEGO_RegGetPrmS1B1_I.flgPatNxtPckVld UEGO_RegGetPrmS1B1_I.flgPatVld UEGO_RegGetPrmS1B1_I.flgRCmpHeatrEdgeShiftAllwd UEGO_RegGetPrmS1B1_I.flgRCmpHeatrEdgeShiftAllwdNxtPck UEGO_RegGetPrmS1B1_I.flgRCmpHeatrEdgeShiftAllwdNxtPckVld UEGO_RegGetPrmS1B1_I.flgRCmpHeatrEdgeShiftAllwdVld UEGO_RegGetPrmS1B1_I.flgReStab UEGO_RegGetPrmS1B1_I.flgReStabVld UEGO_RegGetPrmS1B1_I.flgRefNxtPckVld UEGO_RegGetPrmS1B1_I.flgRefPatChng UEGO_RegGetPrmS1B1_I.flgRefPatNxtPckVld UEGO_RegGetPrmS1B1_I.flgRefPatVld UEGO_RegGetPrmS1B1_I.flgRefVld UEGO_RegGetPrmS1B1_I.flgRegIPmpSetNxtPckVld UEGO_RegGetPrmS1B1_I.flgRegIPmpSetVld UEGO_RegGetPrmS1B1_I.flgRegIpoffChng UEGO_RegGetPrmS1B1_I.flgRegIpoffNxtPckVld UEGO_RegGetPrmS1B1_I.flgRegIpoffVld UEGO_RegGetPrmS1B1_I.flgRegModNxtPckVld UEGO_RegGetPrmS1B1_I.flgRegModVld UEGO_RegGetPrmS1B1_I.flgRegPartModNxtPckVld UEGO_RegGetPrmS1B1_I.flgRegPartModVld UEGO_RegGetPrmS1B1_I.flgRegUnsetNxtPckVld UEGO_RegGetPrmS1B1_I.flgRiaPatChng UEGO_RegGetPrmS1B1_I.flgRiaPatVld UEGO_RegGetPrmS1B1_I.flgRipVld UEGO_RegGetPrmS1B1_I.flgSngCell UEGO_RegGetPrmS1B1_I.flgSngCellVld UEGO_RegGetPrmS1B1_I.flgSteerPatChng UEGO_RegGetPrmS1B1_I.flgSteerPatNxtPckVld UEGO_RegGetPrmS1B1_I.flgSteerPatVld UEGO_RegGetPrmS1B1_I.flgSubModMeasNxtPckVld UEGO_RegGetPrmS1B1_I.flgSubModMeasVld UEGO_RegGetPrmS1B1_I.flgSwVirtGnd UEGO_RegGetPrmS1B1_I.flgSwVirtGndVld UEGO_RegGetPrmS1B1_I.flgTrimSqChng UEGO_RegGetPrmS1B1_I.flgTrimSqrCalChng UEGO_RegGetPrmS1B1_I.flgTrimSqrChng UEGO_RegGetPrmS1B1_I.flgTrmNxtPckVld UEGO_RegGetPrmS1B1_I.flgTrmSqCalOffSet UEGO_RegGetPrmS1B1_I.flgTrmSqCalVld UEGO_RegGetPrmS1B1_I.flgTrmSqOffSet UEGO_RegGetPrmS1B1_I.flgTrmSqOffSetVld UEGO_RegGetPrmS1B1_I.flgTrmSqVld UEGO_RegGetPrmS1B1_I.flgTrmSqrCalOffSet UEGO_RegGetPrmS1B1_I.flgTrmSqrCalVld UEGO_RegGetPrmS1B1_I.flgTrmSqrOffSet UEGO_RegGetPrmS1B1_I.flgTrmSqrOffSetVld UEGO_RegGetPrmS1B1_I.flgTrmSqrVld UEGO_RegGetPrmS1B1_I.flgUnsetVld UEGO_RegGetPrmS1B1_I.flgUp0LeanNxtPckVld UEGO_RegGetPrmS1B1_I.flgUp0LeanVld UEGO_RegGetPrmS1B1_I.flgUp0RichNxtPckVld UEGO_RegGetPrmS1B1_I.flgUp0RichVld UEGO_RegGetPrmS1B1_I.flgUria UEGO_RegGetPrmS1B1_I.flgUriaNxtPck UEGO_RegGetPrmS1B1_I.flgUriaNxtPckVld UEGO_RegGetPrmS1B1_I.flgUriaVld UEGO_RegGetPrmS1B1_I.flgV1BF2NxtPckVld UEGO_RegGetPrmS1B1_I.flgV1BF2Vld UEGO_RegGetPrmS1B1_I.flgV1BF3NxtPckVld UEGO_RegGetPrmS1B1_I.flgV1BIT1 UEGO_RegGetPrmS1B1_I.flgV1BIT1NxtPck UEGO_RegGetPrmS1B1_I.flgV1BIT1NxtPckVld UEGO_RegGetPrmS1B1_I.flgV1BIT1Vld UEGO_RegGetPrmS1B1_I.flgV1BIT2 UEGO_RegGetPrmS1B1_I.flgV1BIT2NxtPck UEGO_RegGetPrmS1B1_I.flgV1BIT2NxtPckVld UEGO_RegGetPrmS1B1_I.flgV1BIT2Vld UEGO_RegGetPrmS1B1_I.flgV1BIT5 UEGO_RegGetPrmS1B1_I.flgV1BIT5NxtPck UEGO_RegGetPrmS1B1_I.flgV1BIT5NxtPckVld UEGO_RegGetPrmS1B1_I.flgV1BIT5Vld UEGO_RegGetPrmS1B1_I.flgWtrEleclyActv UEGO_RegGetPrmS1B1_I.flgWtrEleclyActvNxtPck UEGO_RegGetPrmS1B1_I.flgWtrEleclyActvNxtPckVld UEGO_RegGetPrmS1B1_I.flgWtrEleclyActvVld UEGO_RegGetPrmS1B1_I.flgZIsqrA UEGO_RegGetPrmS1B1_I.flgZIsqrAVld UEGO_RegGetPrmS1B1_I.flgZIsqrE UEGO_RegGetPrmS1B1_I.flgZIsqrEVld UEGO_RegGetPrmS1B1_I.nrIPmpBlcknNxtPck UEGO_RegGetPrmS1B1_I.nrIPmpLimnHi UEGO_RegGetPrmS1B1_I.nrIPmpLimnLo UEGO_RegGetPrmS1B1_I.nrPmpBlckn UEGO_RegGetPrmS1B1_I.nrRefPatNxtPck UEGO_RegGetPrmS1B1_I.nrRegIPmpSet UEGO_RegGetPrmS1B1_I.nrRegIPmpSetNxtPck UEGO_RegGetPrmS1B1_I.nrRegIpoff UEGO_RegGetPrmS1B1_I.nrRegMod UEGO_RegGetPrmS1B1_I.nrRegModNxtPck UEGO_RegGetPrmS1B1_I.nrRegPartMod UEGO_RegGetPrmS1B1_I.nrRegPartModNxtPck UEGO_RegGetPrmS1B1_I.nrRegTrmNxtPck UEGO_RegGetPrmS1B1_I.nrRegTrmSqNxtPck UEGO_RegGetPrmS1B1_I.nrRegTrmSqrNxtPck UEGO_RegGetPrmS1B1_I.nrRip UEGO_RegGetPrmS1B1_I.nrSteerPatNxtPck UEGO_RegGetPrmS1B1_I.nrSubModMeas UEGO_RegGetPrmS1B1_I.nrSubModMeasNxtPck UEGO_RegGetPrmS1B1_I.nrTrmSq UEGO_RegGetPrmS1B1_I.nrTrmSqCal UEGO_RegGetPrmS1B1_I.nrTrmSqr UEGO_RegGetPrmS1B1_I.nrTrmSqrCal UEGO_RegGetPrmS1B1_I.nrUnset UEGO_RegGetPrmS1B1_I.nrUnsetNxtPck UEGO_RegGetPrmS1B1_I.nrUp0Lean UEGO_RegGetPrmS1B1_I.nrUp0LeanNxtPck UEGO_RegGetPrmS1B1_I.nrUp0Rich UEGO_RegGetPrmS1B1_I.nrUp0RichNxtPck UEGO_RegGetPrmS1B1_I.stDlyBlckn UEGO_RegGetPrmS1B1_I.stDlyBlcknNxtPck UEGO_RegGetPrmS1B1_I.stEnSp UEGO_RegGetPrmS1B1_I.stEnSpNxtPck UEGO_RegGetPrmS1B1_I.stMK UEGO_RegGetPrmS1B1_I.stMKNxtPck UEGO_RegGetPrmS1B1_I.stOFF UEGO_RegGetPrmS1B1_I.stOFFNxtPck UEGO_RegGetPrmS1B1_I.stOPT UEGO_RegGetPrmS1B1_I.stOPTNxtPck UEGO_RegGetPrmS1B1_I.stPat UEGO_RegGetPrmS1B1_I.stPatNxtPck UEGO_RegGetPrmS1B1_I.stRef UEGO_RegGetPrmS1B1_I.stRefNxtPck UEGO_RegGetPrmS1B1_I.stRefPat UEGO_RegGetPrmS1B1_I.stRegIpoffNxtPck UEGO_RegGetPrmS1B1_I.stRiaPat UEGO_RegGetPrmS1B1_I.stSteerPat UEGO_RegGetPrmS1B1_I.stV1BF2 UEGO_RegGetPrmS1B1_I.stV1BF2NxtPck UEGO_RegGetPrmS1B1_I.stV1BF3NxtPck UEGO_RegSetS1B1_I.cntrRegSet UEGO_RegSetS1B1_I.flgCJ135An UEGO_RegSetS1B1_I.flgConvVld UEGO_RegSetS1B1_I.flgIPmpDes UEGO_RegSetS1B1_I.flgIPmpPhyRels UEGO_RegSetS1B1_I.flgIniFinshd UEGO_RegSetS1B1_I.flgLoupeCURRDes UEGO_RegSetS1B1_I.flgLoupeDACDes UEGO_RegSetS1B1_I.flgLoupeNDes UEGO_RegSetS1B1_I.flgLoupePDes UEGO_RegSetS1B1_I.flgNewReq UEGO_RegSetS1B1_I.flgRegSetSt UEGO_RegSetS1B1_I.flgRegSetStVld UEGO_RegSetS1B1_I.flgReqAcptd UEGO_RegSetS1B1_I.flgSetRegOk UEGO_RegSetS1B1_I.flgTakeDataOk UEGO_RegSetS1B1_I.idxChp UEGO_RegSetS1B1_I.nrIdleSubMode UEGO_RegSetS1B1_I.nrModDes UEGO_RegSetS1B1_I.nrNormSubMode UEGO_RegSetS1B1_I.nrRegSet UEGO_RegSetS1B1_I.nrSubModDes UEGO_RegSetS1B1_I.nrSwtOnSubMode UEGO_RegSetS1B1_I.nrTrmSq UEGO_RegSetS1B1_I.nrWrmUpSubMode UEGO_RegSetS1B1_I.stRegSet UEGO_RegSetS1B1_I.stRegSetVld UEGO_RegSetS1B1_I.tmpVar /end IN_MEASUREMENT
 /begin OUT_MEASUREMENT UEGO_flgNernstIsqrVldS1B1 UEGO_flgPmpIsqrVldS1B1 UEGO_iNernstIsqrS1B1 UEGO_iPmpIsqrS1B1 /end OUT_MEASUREMENT
 /begin LOC_MEASUREMENT UEGO_IPmpRefCtrlS1B1_I.flgRefPatSetVld UEGO_IPmpRefCtrlS1B1_I.nrModIntCtrl UEGO_IPmpRefCtrlS1B1_I.nrModIntCtrlOld UEGO_IPmpRefCtrlS1B1_I.stRefPatIniNorm UEGO_IPmpRefCtrlS1B1_I.stRefPatIniWrmUp UEGO_IPmpRefCtrlS1B1_I.stRefPatNorm UEGO_IPmpRefCtrlS1B1_I.stRefPatRglNorm UEGO_IPmpRefCtrlS1B1_I.stRefPatRglWrmUp UEGO_IPmpRefCtrlS1B1_I.stRefPatStopNorm UEGO_IPmpRefCtrlS1B1_I.stRefPatStopWrmUp UEGO_IPmpRefCtrlS1B1_I.stRefPatWrmUp UEGO_IPmpRefEvlnS1B1_I.flgNernstIsqrVld UEGO_IPmpRefEvlnS1B1_I.flgPmpIsqrVld UEGO_IPmpRefEvlnS1B1_I.flgRefpatVld UEGO_IPmpRefEvlnS1B1_I.flgTiPlsPckVld UEGO_IPmpRefEvlnS1B1_I.iNernstIsqr UEGO_IPmpRefEvlnS1B1_I.iPmpIsqr UEGO_IPmpRefEvlnS1B1_I.nrModIntEvalIsqr UEGO_IPmpRefEvlnS1B1_I.nrModIntEvalIsqrOld UEGO_IPmpRefEvlnS1B1_I.nrRefPatSet UEGO_IPmpRefEvlnS1B1_I.tiPlsNernstPck UEGO_IPmpRefEvlnS1B1_I.tiPlsPmpPck /end LOC_MEASUREMENT
 FUNCTION_VERSION "1.18.0" /end FUNCTION
/begin FUNCTION UEGO_IPmpSeg "1.19.0    UEGO Pump Current Segment Handling"
 /begin DEF_CHARACTERISTIC UEGO_facIPmpSegFltConst_C UEGO_nfacSegSampleFlt_C UEGO_stIPmpSegEvln_C UEGO_tiDlyIPmpHiPrcn_C UEGO_tiSegLngthFilCutOff_C UEGO_cpCapSnsrReplVal_C UEGO_tiSegLngth_C /end DEF_CHARACTERISTIC
 /begin IN_MEASUREMENT EpmCrS_tiSeg Epm_numCyl UEGO_DataSplyClsS1B1_I.flgCj135An UEGO_DataSplyClsS1B1_I.flgDACOff UEGO_DataSplyClsS1B1_I.flgErrSpiRamRet UEGO_DataSplyClsS1B1_I.flgFKal1Vld UEGO_DataSplyClsS1B1_I.flgFKal2Vld UEGO_DataSplyClsS1B1_I.flgFKal3Vld UEGO_DataSplyClsS1B1_I.flgIPmpActvd UEGO_DataSplyClsS1B1_I.flgISQrA UEGO_DataSplyClsS1B1_I.flgISQrE UEGO_DataSplyClsS1B1_I.flgLCURR UEGO_DataSplyClsS1B1_I.flgLNMeas UEGO_DataSplyClsS1B1_I.flgLPMeas UEGO_DataSplyClsS1B1_I.flgLoupeCAL UEGO_DataSplyClsS1B1_I.flgLoupeG0 UEGO_DataSplyClsS1B1_I.flgLstPckAbort UEGO_DataSplyClsS1B1_I.flgMKA UEGO_DataSplyClsS1B1_I.flgMKE UEGO_DataSplyClsS1B1_I.flgNewIPmpDacPckAry UEGO_DataSplyClsS1B1_I.flgNewIPmpOK UEGO_DataSplyClsS1B1_I.flgNewIPmpPckAry UEGO_DataSplyClsS1B1_I.flgNewIPmpTM UEGO_DataSplyClsS1B1_I.flgNewPck UEGO_DataSplyClsS1B1_I.flgNewPckCstnc UEGO_DataSplyClsS1B1_I.flgNewPckMiss UEGO_DataSplyClsS1B1_I.flgNewPckVld UEGO_DataSplyClsS1B1_I.flgNewTiPck UEGO_DataSplyClsS1B1_I.flgNewURmVG4MeasAryVld UEGO_DataSplyClsS1B1_I.flgNewUa2Pck UEGO_DataSplyClsS1B1_I.flgNewUa31Pck UEGO_DataSplyClsS1B1_I.flgNewUa32Pck UEGO_DataSplyClsS1B1_I.flgNewUa33Pck UEGO_DataSplyClsS1B1_I.flgNewUamPck UEGO_DataSplyClsS1B1_I.flgNewUapePck UEGO_DataSplyClsS1B1_I.flgNewUcalMaxPck UEGO_DataSplyClsS1B1_I.flgNewUcalPck UEGO_DataSplyClsS1B1_I.flgNewUg0Pck UEGO_DataSplyClsS1B1_I.flgNewUg0PckAry UEGO_DataSplyClsS1B1_I.flgNewUg0aPck UEGO_DataSplyClsS1B1_I.flgNewUg0ePck UEGO_DataSplyClsS1B1_I.flgNewUg0iPck UEGO_DataSplyClsS1B1_I.flgNewUg0iPckAry UEGO_DataSplyClsS1B1_I.flgNewUg0iaiPck UEGO_DataSplyClsS1B1_I.flgNewUg0ieiPck UEGO_DataSplyClsS1B1_I.flgNewUg0ix7PckAry UEGO_DataSplyClsS1B1_I.flgNewUg0ix9PckAry UEGO_DataSplyClsS1B1_I.flgNewUg0ixPckAry UEGO_DataSplyClsS1B1_I.flgNewUg0mPck UEGO_DataSplyClsS1B1_I.flgNewUgaPck UEGO_DataSplyClsS1B1_I.flgNewUgiPckAry UEGO_DataSplyClsS1B1_I.flgNewUgkAvrgPck UEGO_DataSplyClsS1B1_I.flgNewUguaPck UEGO_DataSplyClsS1B1_I.flgNewUguaZ2Pck UEGO_DataSplyClsS1B1_I.flgNewUguiPck UEGO_DataSplyClsS1B1_I.flgNewUguiZ1Pck UEGO_DataSplyClsS1B1_I.flgNewUi21PckAry UEGO_DataSplyClsS1B1_I.flgNewUi22Pck UEGO_DataSplyClsS1B1_I.flgNewUi23Pck UEGO_DataSplyClsS1B1_I.flgNewUi24Pck UEGO_DataSplyClsS1B1_I.flgNewUi4Pck UEGO_DataSplyClsS1B1_I.flgNewUi4Z2Pck UEGO_DataSplyClsS1B1_I.flgNewUigPckAry UEGO_DataSplyClsS1B1_I.flgNewUigmkPckAry UEGO_DataSplyClsS1B1_I.flgNewUipcalAvrgPck UEGO_DataSplyClsS1B1_I.flgNewUn0Pck UEGO_DataSplyClsS1B1_I.flgNewUn0Pck4Ary UEGO_DataSplyClsS1B1_I.flgNewUn0Pck5Ary UEGO_DataSplyClsS1B1_I.flgNewUn0PckAry UEGO_DataSplyClsS1B1_I.flgNewUnPckAry UEGO_DataSplyClsS1B1_I.flgNewUnSetPck UEGO_DataSplyClsS1B1_I.flgNewUnx3PckAry UEGO_DataSplyClsS1B1_I.flgNewUnx4PckAry UEGO_DataSplyClsS1B1_I.flgNewUp0Pck UEGO_DataSplyClsS1B1_I.flgNewUp0Pck4 UEGO_DataSplyClsS1B1_I.flgNewUp0Pck5Ary UEGO_DataSplyClsS1B1_I.flgNewUp0PckAry UEGO_DataSplyClsS1B1_I.flgNewUpPckAry UEGO_DataSplyClsS1B1_I.flgNewUpx3PckAry UEGO_DataSplyClsS1B1_I.flgNewUpx4PckAry UEGO_DataSplyClsS1B1_I.flgNewUriaPckVld UEGO_DataSplyClsS1B1_I.flgNewUriePckAry UEGO_DataSplyClsS1B1_I.flgNewUx6PckAry UEGO_DataSplyClsS1B1_I.flgNewUx7PckAry UEGO_DataSplyClsS1B1_I.flgNewUx8PckAry UEGO_DataSplyClsS1B1_I.flgNewUx9PckAry UEGO_DataSplyClsS1B1_I.flgNewUxPckAry UEGO_DataSplyClsS1B1_I.flgReStable UEGO_DataSplyClsS1B1_I.flgSngCell UEGO_DataSplyClsS1B1_I.flgUical0Vld UEGO_DataSplyClsS1B1_I.flgUicalVld UEGO_DataSplyClsS1B1_I.flgUoffipe1Vld UEGO_DataSplyClsS1B1_I.flgUoffipe2Vld UEGO_DataSplyClsS1B1_I.flgUoffipe3Vld UEGO_DataSplyClsS1B1_I.flgUoffvcc1Vld UEGO_DataSplyClsS1B1_I.flgUoffvcc2Vld UEGO_DataSplyClsS1B1_I.flgUoffvcc3Vld UEGO_DataSplyClsS1B1_I.flgUriaMeas UEGO_DataSplyClsS1B1_I.nrIPmpDacPckAry UEGO_DataSplyClsS1B1_I.nrIpPckAry UEGO_DataSplyClsS1B1_I.nrModeMeas UEGO_DataSplyClsS1B1_I.nrRamFailPosn UEGO_DataSplyClsS1B1_I.nrRamMod UEGO_DataSplyClsS1B1_I.nrRamRegMod UEGO_DataSplyClsS1B1_I.nrRamSts1 UEGO_DataSplyClsS1B1_I.nrRamSts2 UEGO_DataSplyClsS1B1_I.nrRamSts3 UEGO_DataSplyClsS1B1_I.nrURmVG4PckAry UEGO_DataSplyClsS1B1_I.nrUa2PckAry UEGO_DataSplyClsS1B1_I.nrUcalMaxCorrd UEGO_DataSplyClsS1B1_I.nrUg0PckAry UEGO_DataSplyClsS1B1_I.nrUg0iPckAry UEGO_DataSplyClsS1B1_I.nrUg0ix7PckAry UEGO_DataSplyClsS1B1_I.nrUg0ix9PckAry UEGO_DataSplyClsS1B1_I.nrUg0ixPckAry UEGO_DataSplyClsS1B1_I.nrUgaPckAry UEGO_DataSplyClsS1B1_I.nrUgiPckAry UEGO_DataSplyClsS1B1_I.nrUi21PckAry UEGO_DataSplyClsS1B1_I.nrUical0PckCorrd UEGO_DataSplyClsS1B1_I.nrUicalPckCorrd UEGO_DataSplyClsS1B1_I.nrUigPckAry UEGO_DataSplyClsS1B1_I.nrUigmkPckAry UEGO_DataSplyClsS1B1_I.nrUn0Pck4Ary UEGO_DataSplyClsS1B1_I.nrUn0Pck5Ary UEGO_DataSplyClsS1B1_I.nrUn0PckAry UEGO_DataSplyClsS1B1_I.nrUnPckAry UEGO_DataSplyClsS1B1_I.nrUnx3PckAry UEGO_DataSplyClsS1B1_I.nrUnx4PckAry UEGO_DataSplyClsS1B1_I.nrUoffipe1 UEGO_DataSplyClsS1B1_I.nrUoffipe2 UEGO_DataSplyClsS1B1_I.nrUoffipe3 UEGO_DataSplyClsS1B1_I.nrUoffvcc1 UEGO_DataSplyClsS1B1_I.nrUoffvcc2 UEGO_DataSplyClsS1B1_I.nrUoffvcc3 UEGO_DataSplyClsS1B1_I.nrUp0Pck5Ary UEGO_DataSplyClsS1B1_I.nrUp0PckAry UEGO_DataSplyClsS1B1_I.nrUpPckAry UEGO_DataSplyClsS1B1_I.nrUpx3PckAry UEGO_DataSplyClsS1B1_I.nrUpx4PckAry UEGO_DataSplyClsS1B1_I.nrUriePckAry UEGO_DataSplyClsS1B1_I.nrUx6PckAry UEGO_DataSplyClsS1B1_I.nrUx7PckAry UEGO_DataSplyClsS1B1_I.nrUx8PckAry UEGO_DataSplyClsS1B1_I.nrUx9PckAry UEGO_DataSplyClsS1B1_I.nrUxPckAry UEGO_DataSplyClsS1B1_I.stIPmpOK UEGO_DataSplyClsS1B1_I.stIPmpTM UEGO_DataSplyClsS1B1_I.stIPmpTM2L UEGO_DataSplyClsS1B1_I.stIPmpTM2R UEGO_DataSplyClsS1B1_I.stLsmRetValMod UEGO_DataSplyClsS1B1_I.stMKMeas UEGO_DataSplyClsS1B1_I.stOFFMeas UEGO_DataSplyClsS1B1_I.stOPTMeas UEGO_DataSplyClsS1B1_I.stREFMeas UEGO_DataSplyClsS1B1_I.stUa2PckAry UEGO_DataSplyClsS1B1_I.stUa2Z1PckAry UEGO_DataSplyClsS1B1_I.stUg0iPckAry UEGO_DataSplyClsS1B1_I.stUg0ix7IActvPckAry UEGO_DataSplyClsS1B1_I.stUg0ix7PmpIActvPckAry UEGO_DataSplyClsS1B1_I.stUg0ix9IActvPckAry UEGO_DataSplyClsS1B1_I.stUg0ix9PmpIActvPckAry UEGO_DataSplyClsS1B1_I.stUg0ixIActvPckAry UEGO_DataSplyClsS1B1_I.stUg0ixPmpIActvPckAry UEGO_DataSplyClsS1B1_I.stUi21PckAry UEGO_DataSplyClsS1B1_I.stUi21Z1PckAry UEGO_DataSplyClsS1B1_I.stUigmkNernstIActvPckAry UEGO_DataSplyClsS1B1_I.stUigmkPmpIActvPckAry UEGO_DataSplyClsS1B1_I.stUn0PckAry UEGO_DataSplyClsS1B1_I.stUn0Z2PckAry UEGO_DataSplyClsS1B1_I.stUnPckAry UEGO_DataSplyClsS1B1_I.stUnx3IActvAcrsNernstCellPckAry UEGO_DataSplyClsS1B1_I.stUnx3IActvAcrsPmpCellPckAry UEGO_DataSplyClsS1B1_I.stUnx4IActvAcrsNernstCellPckAry UEGO_DataSplyClsS1B1_I.stUnx4IActvAcrsPmpCellPckAry UEGO_DataSplyClsS1B1_I.stUp0PckAry UEGO_DataSplyClsS1B1_I.stUp0Z2PckAry UEGO_DataSplyClsS1B1_I.stUpPckAry UEGO_DataSplyClsS1B1_I.stUpZ2PckAry UEGO_DataSplyClsS1B1_I.stUpx3IActvAcrsNernstCellPckAry UEGO_DataSplyClsS1B1_I.stUpx3IActvAcrsPmpCellPckAry UEGO_DataSplyClsS1B1_I.stUpx4IActvAcrsNernstCellPckAry UEGO_DataSplyClsS1B1_I.stUpx4IActvAcrsPmpCellPckAry UEGO_DataSplyClsS1B1_I.stUriePckAry UEGO_DataSplyClsS1B1_I.stUx6IActvPckAry UEGO_DataSplyClsS1B1_I.stUx6MeasAcrsPmpCellPckAry UEGO_DataSplyClsS1B1_I.stUx7IActvPckAry UEGO_DataSplyClsS1B1_I.stUx7MeasAcrsPmpCellPckAry UEGO_DataSplyClsS1B1_I.stUx8IActvPckAry UEGO_DataSplyClsS1B1_I.stUx8MeasAcrsPmpCellPckAry UEGO_DataSplyClsS1B1_I.stUx9IActvPckAry UEGO_DataSplyClsS1B1_I.stUx9MeasAcrsPmpCellPckAry UEGO_DataSplyClsS1B1_I.stUxIActvPckAry UEGO_DataSplyClsS1B1_I.stUxMeasAcrsPmpCell UEGO_DataSplyClsS1B1_I.tiUEGOPck UEGO_DataSplyClsS1B1_I.uFkal1 UEGO_DataSplyClsS1B1_I.uFkal2 UEGO_DataSplyClsS1B1_I.uFkal3 UEGO_DataSplyClsS1B1_I.uUCalPck UEGO_DataSplyClsS1B1_I.uUa31Pck UEGO_DataSplyClsS1B1_I.uUa32Pck UEGO_DataSplyClsS1B1_I.uUa33Pck UEGO_DataSplyClsS1B1_I.uUamPck UEGO_DataSplyClsS1B1_I.uUapePck UEGO_DataSplyClsS1B1_I.uUcalMaxPck UEGO_DataSplyClsS1B1_I.uUg0Pck UEGO_DataSplyClsS1B1_I.uUg0aPck UEGO_DataSplyClsS1B1_I.uUg0ePck UEGO_DataSplyClsS1B1_I.uUg0iPck UEGO_DataSplyClsS1B1_I.uUg0iaiPck UEGO_DataSplyClsS1B1_I.uUg0ieiPck UEGO_DataSplyClsS1B1_I.uUg0mPck UEGO_DataSplyClsS1B1_I.uUgkAvrgPck UEGO_DataSplyClsS1B1_I.uUguaPck UEGO_DataSplyClsS1B1_I.uUguaZ2Pck UEGO_DataSplyClsS1B1_I.uUguiPck UEGO_DataSplyClsS1B1_I.uUguiZ1Pck UEGO_DataSplyClsS1B1_I.uUi22Pck UEGO_DataSplyClsS1B1_I.uUi23Pck UEGO_DataSplyClsS1B1_I.uUi24Pck UEGO_DataSplyClsS1B1_I.uUi4Pck UEGO_DataSplyClsS1B1_I.uUi4Z2Pck UEGO_DataSplyClsS1B1_I.uUipcalAvrgPck UEGO_DataSplyClsS1B1_I.uUn0Pck UEGO_DataSplyClsS1B1_I.uUnSet UEGO_DataSplyClsS1B1_I.uUp0Pck UEGO_DataSplyClsS1B1_I.uUp0Pck4 UEGO_DataSplyClsS1B1_I.uUriaPck UEGO_DataSplyClsS1B1_I.uVCC1Corrd UEGO_DataSplyClsS1B1_I.uVCC3Ref UEGO_flgIPmpPckHiPrcsnS1B1 UEGO_flgIPmpPckVldS1B1 UEGO_flgNernstIsqrVldS1B1 UEGO_flgNSyncn UEGO_flgPmpIsqrVldS1B1 UEGO_flgSysSuprtdS1B1 UEGO_iIPmpPckAryS1B1 UEGO_iNernstIsqrS1B1 UEGO_iPmpIsqrS1B1 UEGO_RegGetPrmS1B1_I.flgDlyBlcknNxtPckVld UEGO_RegGetPrmS1B1_I.flgDlyBlcknVld UEGO_RegGetPrmS1B1_I.flgDspDiagDis UEGO_RegGetPrmS1B1_I.flgDspDiagDisNxtPck UEGO_RegGetPrmS1B1_I.flgDspDiagDisNxtPckVld UEGO_RegGetPrmS1B1_I.flgDspDiagDisVld UEGO_RegGetPrmS1B1_I.flgEnSpA UEGO_RegGetPrmS1B1_I.flgEnSpAVld UEGO_RegGetPrmS1B1_I.flgEnSpE UEGO_RegGetPrmS1B1_I.flgEnSpEVld UEGO_RegGetPrmS1B1_I.flgEnSpNxtPckVld UEGO_RegGetPrmS1B1_I.flgEnSpVld UEGO_RegGetPrmS1B1_I.flgIPmpBlcknNxtPckVld UEGO_RegGetPrmS1B1_I.flgIPmpBlcknVld UEGO_RegGetPrmS1B1_I.flgIPmpLimnHiVld UEGO_RegGetPrmS1B1_I.flgIPmpLimnLoVld UEGO_RegGetPrmS1B1_I.flgIPmpRst UEGO_RegGetPrmS1B1_I.flgIPmpRstNxtPck UEGO_RegGetPrmS1B1_I.flgIPmpRstNxtPckVld UEGO_RegGetPrmS1B1_I.flgIPmpRstVld UEGO_RegGetPrmS1B1_I.flgIPmpSm UEGO_RegGetPrmS1B1_I.flgIPmpSmNxtPck UEGO_RegGetPrmS1B1_I.flgIPmpSmNxtPckVld UEGO_RegGetPrmS1B1_I.flgIPmpSmVld UEGO_RegGetPrmS1B1_I.flgLCal UEGO_RegGetPrmS1B1_I.flgLCalVld UEGO_RegGetPrmS1B1_I.flgLCurr UEGO_RegGetPrmS1B1_I.flgLCurrVld UEGO_RegGetPrmS1B1_I.flgLDAC UEGO_RegGetPrmS1B1_I.flgLDACConf UEGO_RegGetPrmS1B1_I.flgLDACConfVld UEGO_RegGetPrmS1B1_I.flgLDACVld UEGO_RegGetPrmS1B1_I.flgLG0 UEGO_RegGetPrmS1B1_I.flgLG0Vld UEGO_RegGetPrmS1B1_I.flgLN UEGO_RegGetPrmS1B1_I.flgLNNxtPck UEGO_RegGetPrmS1B1_I.flgLNNxtPckVld UEGO_RegGetPrmS1B1_I.flgLNVld UEGO_RegGetPrmS1B1_I.flgLP UEGO_RegGetPrmS1B1_I.flgLPNxtPck UEGO_RegGetPrmS1B1_I.flgLPNxtPckVld UEGO_RegGetPrmS1B1_I.flgLPVld UEGO_RegGetPrmS1B1_I.flgMKA UEGO_RegGetPrmS1B1_I.flgMKAVld UEGO_RegGetPrmS1B1_I.flgMKE UEGO_RegGetPrmS1B1_I.flgMKEVld UEGO_RegGetPrmS1B1_I.flgMKNxtPckVld UEGO_RegGetPrmS1B1_I.flgMKVld UEGO_RegGetPrmS1B1_I.flgN3MeasActvNxtPck UEGO_RegGetPrmS1B1_I.flgN3MeasActvNxtPckVld UEGO_RegGetPrmS1B1_I.flgOFFNxtPckVld UEGO_RegGetPrmS1B1_I.flgOFFVld UEGO_RegGetPrmS1B1_I.flgOPTNxtPckVld UEGO_RegGetPrmS1B1_I.flgOPTVld UEGO_RegGetPrmS1B1_I.flgPatNxtPckVld UEGO_RegGetPrmS1B1_I.flgPatVld UEGO_RegGetPrmS1B1_I.flgRCmpHeatrEdgeShiftAllwd UEGO_RegGetPrmS1B1_I.flgRCmpHeatrEdgeShiftAllwdNxtPck UEGO_RegGetPrmS1B1_I.flgRCmpHeatrEdgeShiftAllwdNxtPckVld UEGO_RegGetPrmS1B1_I.flgRCmpHeatrEdgeShiftAllwdVld UEGO_RegGetPrmS1B1_I.flgReStab UEGO_RegGetPrmS1B1_I.flgReStabVld UEGO_RegGetPrmS1B1_I.flgRefNxtPckVld UEGO_RegGetPrmS1B1_I.flgRefPatChng UEGO_RegGetPrmS1B1_I.flgRefPatNxtPckVld UEGO_RegGetPrmS1B1_I.flgRefPatVld UEGO_RegGetPrmS1B1_I.flgRefVld UEGO_RegGetPrmS1B1_I.flgRegIPmpSetNxtPckVld UEGO_RegGetPrmS1B1_I.flgRegIPmpSetVld UEGO_RegGetPrmS1B1_I.flgRegIpoffChng UEGO_RegGetPrmS1B1_I.flgRegIpoffNxtPckVld UEGO_RegGetPrmS1B1_I.flgRegIpoffVld UEGO_RegGetPrmS1B1_I.flgRegModNxtPckVld UEGO_RegGetPrmS1B1_I.flgRegModVld UEGO_RegGetPrmS1B1_I.flgRegPartModNxtPckVld UEGO_RegGetPrmS1B1_I.flgRegPartModVld UEGO_RegGetPrmS1B1_I.flgRegUnsetNxtPckVld UEGO_RegGetPrmS1B1_I.flgRiaPatChng UEGO_RegGetPrmS1B1_I.flgRiaPatVld UEGO_RegGetPrmS1B1_I.flgRipVld UEGO_RegGetPrmS1B1_I.flgSngCell UEGO_RegGetPrmS1B1_I.flgSngCellVld UEGO_RegGetPrmS1B1_I.flgSteerPatChng UEGO_RegGetPrmS1B1_I.flgSteerPatNxtPckVld UEGO_RegGetPrmS1B1_I.flgSteerPatVld UEGO_RegGetPrmS1B1_I.flgSubModMeasNxtPckVld UEGO_RegGetPrmS1B1_I.flgSubModMeasVld UEGO_RegGetPrmS1B1_I.flgSwVirtGnd UEGO_RegGetPrmS1B1_I.flgSwVirtGndVld UEGO_RegGetPrmS1B1_I.flgTrimSqChng UEGO_RegGetPrmS1B1_I.flgTrimSqrCalChng UEGO_RegGetPrmS1B1_I.flgTrimSqrChng UEGO_RegGetPrmS1B1_I.flgTrmNxtPckVld UEGO_RegGetPrmS1B1_I.flgTrmSqCalOffSet UEGO_RegGetPrmS1B1_I.flgTrmSqCalVld UEGO_RegGetPrmS1B1_I.flgTrmSqOffSet UEGO_RegGetPrmS1B1_I.flgTrmSqOffSetVld UEGO_RegGetPrmS1B1_I.flgTrmSqVld UEGO_RegGetPrmS1B1_I.flgTrmSqrCalOffSet UEGO_RegGetPrmS1B1_I.flgTrmSqrCalVld UEGO_RegGetPrmS1B1_I.flgTrmSqrOffSet UEGO_RegGetPrmS1B1_I.flgTrmSqrOffSetVld UEGO_RegGetPrmS1B1_I.flgTrmSqrVld UEGO_RegGetPrmS1B1_I.flgUnsetVld UEGO_RegGetPrmS1B1_I.flgUp0LeanNxtPckVld UEGO_RegGetPrmS1B1_I.flgUp0LeanVld UEGO_RegGetPrmS1B1_I.flgUp0RichNxtPckVld UEGO_RegGetPrmS1B1_I.flgUp0RichVld UEGO_RegGetPrmS1B1_I.flgUria UEGO_RegGetPrmS1B1_I.flgUriaNxtPck UEGO_RegGetPrmS1B1_I.flgUriaNxtPckVld UEGO_RegGetPrmS1B1_I.flgUriaVld UEGO_RegGetPrmS1B1_I.flgV1BF2NxtPckVld UEGO_RegGetPrmS1B1_I.flgV1BF2Vld UEGO_RegGetPrmS1B1_I.flgV1BF3NxtPckVld UEGO_RegGetPrmS1B1_I.flgV1BIT1 UEGO_RegGetPrmS1B1_I.flgV1BIT1NxtPck UEGO_RegGetPrmS1B1_I.flgV1BIT1NxtPckVld UEGO_RegGetPrmS1B1_I.flgV1BIT1Vld UEGO_RegGetPrmS1B1_I.flgV1BIT2 UEGO_RegGetPrmS1B1_I.flgV1BIT2NxtPck UEGO_RegGetPrmS1B1_I.flgV1BIT2NxtPckVld UEGO_RegGetPrmS1B1_I.flgV1BIT2Vld UEGO_RegGetPrmS1B1_I.flgV1BIT5 UEGO_RegGetPrmS1B1_I.flgV1BIT5NxtPck UEGO_RegGetPrmS1B1_I.flgV1BIT5NxtPckVld UEGO_RegGetPrmS1B1_I.flgV1BIT5Vld UEGO_RegGetPrmS1B1_I.flgWtrEleclyActv UEGO_RegGetPrmS1B1_I.flgWtrEleclyActvNxtPck UEGO_RegGetPrmS1B1_I.flgWtrEleclyActvNxtPckVld UEGO_RegGetPrmS1B1_I.flgWtrEleclyActvVld UEGO_RegGetPrmS1B1_I.flgZIsqrA UEGO_RegGetPrmS1B1_I.flgZIsqrAVld UEGO_RegGetPrmS1B1_I.flgZIsqrE UEGO_RegGetPrmS1B1_I.flgZIsqrEVld UEGO_RegGetPrmS1B1_I.nrIPmpBlcknNxtPck UEGO_RegGetPrmS1B1_I.nrIPmpLimnHi UEGO_RegGetPrmS1B1_I.nrIPmpLimnLo UEGO_RegGetPrmS1B1_I.nrPmpBlckn UEGO_RegGetPrmS1B1_I.nrRefPatNxtPck UEGO_RegGetPrmS1B1_I.nrRegIPmpSet UEGO_RegGetPrmS1B1_I.nrRegIPmpSetNxtPck UEGO_RegGetPrmS1B1_I.nrRegIpoff UEGO_RegGetPrmS1B1_I.nrRegMod UEGO_RegGetPrmS1B1_I.nrRegModNxtPck UEGO_RegGetPrmS1B1_I.nrRegPartMod UEGO_RegGetPrmS1B1_I.nrRegPartModNxtPck UEGO_RegGetPrmS1B1_I.nrRegTrmNxtPck UEGO_RegGetPrmS1B1_I.nrRegTrmSqNxtPck UEGO_RegGetPrmS1B1_I.nrRegTrmSqrNxtPck UEGO_RegGetPrmS1B1_I.nrRip UEGO_RegGetPrmS1B1_I.nrSteerPatNxtPck UEGO_RegGetPrmS1B1_I.nrSubModMeas UEGO_RegGetPrmS1B1_I.nrSubModMeasNxtPck UEGO_RegGetPrmS1B1_I.nrTrmSq UEGO_RegGetPrmS1B1_I.nrTrmSqCal UEGO_RegGetPrmS1B1_I.nrTrmSqr UEGO_RegGetPrmS1B1_I.nrTrmSqrCal UEGO_RegGetPrmS1B1_I.nrUnset UEGO_RegGetPrmS1B1_I.nrUnsetNxtPck UEGO_RegGetPrmS1B1_I.nrUp0Lean UEGO_RegGetPrmS1B1_I.nrUp0LeanNxtPck UEGO_RegGetPrmS1B1_I.nrUp0Rich UEGO_RegGetPrmS1B1_I.nrUp0RichNxtPck UEGO_RegGetPrmS1B1_I.stDlyBlckn UEGO_RegGetPrmS1B1_I.stDlyBlcknNxtPck UEGO_RegGetPrmS1B1_I.stEnSp UEGO_RegGetPrmS1B1_I.stEnSpNxtPck UEGO_RegGetPrmS1B1_I.stMK UEGO_RegGetPrmS1B1_I.stMKNxtPck UEGO_RegGetPrmS1B1_I.stOFF UEGO_RegGetPrmS1B1_I.stOFFNxtPck UEGO_RegGetPrmS1B1_I.stOPT UEGO_RegGetPrmS1B1_I.stOPTNxtPck UEGO_RegGetPrmS1B1_I.stPat UEGO_RegGetPrmS1B1_I.stPatNxtPck UEGO_RegGetPrmS1B1_I.stRef UEGO_RegGetPrmS1B1_I.stRefNxtPck UEGO_RegGetPrmS1B1_I.stRefPat UEGO_RegGetPrmS1B1_I.stRegIpoffNxtPck UEGO_RegGetPrmS1B1_I.stRiaPat UEGO_RegGetPrmS1B1_I.stSteerPat UEGO_RegGetPrmS1B1_I.stV1BF2 UEGO_RegGetPrmS1B1_I.stV1BF2NxtPck UEGO_RegGetPrmS1B1_I.stV1BF3NxtPck /end IN_MEASUREMENT
 /begin OUT_MEASUREMENT UEGO_flgIPmpHiPrcsnS1B1 UEGO_flgIPmpSegVldS1B1 UEGO_iIPmpPTCorrdS1B1 UEGO_iIPmpSegS1B1 /end OUT_MEASUREMENT
 /begin LOC_MEASUREMENT UEGO_IPmpSegS1B1_I.flgIPmpHiPrcsn UEGO_IPmpSegS1B1_I.flgIPmpSegFltVld UEGO_IPmpSegS1B1_I.flgIPmpSegFull UEGO_IPmpSegS1B1_I.flgIPmpSegNoAdpdVld UEGO_IPmpSegS1B1_I.flgIPmpSegVld UEGO_IPmpSegS1B1_I.iIPmpSegFild UEGO_IPmpSegS1B1_I.iIPmpSegNoAdpd UEGO_IPmpSegS1B1_I.iIPmpSegPartSumAry UEGO_IPmpSegS1B1_I.iIPmpSegUnFild UEGO_IPmpSegS1B1_I.nrCtrSegPartSumAry UEGO_IPmpSegS1B1_I.nrModIPmpSeg UEGO_IPmpSegS1B1_I.nrSegPartMax UEGO_IPmpSegS1B1_I.nrSegPartPosCurr UEGO_IPmpSegS1B1_I.UEGO_IPmpHIPrcsnTONV_I.outbit UEGO_IPmpSegS1B1_I.UEGO_IPmpHIPrcsnTONV_I.time UEGO_IPmpSegS1B1_I.iIPmpSegFilt_DL_I.flgFilVldy UEGO_IPmpSegS1B1_I.iIPmpSegFilt_DL_I.nrSampleCurr UEGO_IPmpSegS1B1_I.iIPmpSegFilt_DL_I.nrSampleRef UEGO_IPmpSegS1B1_I.iIPmpSegFilt_DL_I.nrSampleThd UEGO_IPmpSegS1B1_I.iIPmpSegFilt_DL_I.EvlnFil_DL_I.memory UEGO_tiSegLngth /end LOC_MEASUREMENT
 FUNCTION_VERSION "1.19.0" /end FUNCTION
/begin FUNCTION UEGO_ISrc "1.25.0    UEGO Current Source Adjustment"
 /begin DEF_CHARACTERISTIC UEGO_iIsqDesNorm_C UEGO_iIsqDesSwtOn_C UEGO_iIsqDesWrmUp_C UEGO_iIsqrDesNorm_C UEGO_iIsqrDesSwtOn_C UEGO_iIsqrDesWrmUp_C UEGO_facIsqrAFltConst_C UEGO_facIsqrEFltConst_C UEGO_facNernstExctFild_C UEGO_facPmpDeltaFild_C UEGO_facPmpExctFild_C UEGO_facUcalFltConst_C UEGO_facUcalMFltConst_C UEGO_facUg0FltConst_C UEGO_iIPmpDeltaMaxIni_C UEGO_iIsqrAMinThd_C UEGO_iIsqrEMinThd_C UEGO_iOffsIsqrAThd_C UEGO_iOffsIsqrEThd_C UEGO_resRCal_C UEGO_tiDlyiDeltaPmpVld_C UEGO_tiDlyIsqrVld_C UEGO_nrISrcRglnCntr_C UEGO_iIsqChgRglnPrimStep_C UEGO_iIsqChgRglnSecStep_C UEGO_iIsqrChgRglnPrimStep_C UEGO_iIsqrChgRglnSecStep_C UEGO_iIsqrMChgRglnPrimStep_C UEGO_iIsqrMChgRglnSecStep_C UEGO_iOffsIsqDes_C UEGO_iOffsIsqrDes_C UEGO_iOffsIsqrHwMeas_C UEGO_iSlopIsqDes_C UEGO_iSlopIsqrDes_C UEGO_resRGnd_C UEGO_stIsqrEvln_C UEGO_stISrcIsqRgln_C UEGO_stISrcIsqrMRgln_C UEGO_stISrcIsqrRgln_C /end DEF_CHARACTERISTIC
 /begin REF_CHARACTERISTIC UEGO_iIsqDesCMeas_C UEGO_iIsqDesRCmpEvln_C UEGO_iIsqDesWireScHiIsqEvln_C UEGO_iIsqDesWireScLoIsqEvln_C /end REF_CHARACTERISTIC
 /begin IN_MEASUREMENT UEGO_DataSplyClsS1B1_I.flgCj135An UEGO_DataSplyClsS1B1_I.flgDACOff UEGO_DataSplyClsS1B1_I.flgErrSpiRamRet UEGO_DataSplyClsS1B1_I.flgFKal1Vld UEGO_DataSplyClsS1B1_I.flgFKal2Vld UEGO_DataSplyClsS1B1_I.flgFKal3Vld UEGO_DataSplyClsS1B1_I.flgIPmpActvd UEGO_DataSplyClsS1B1_I.flgISQrA UEGO_DataSplyClsS1B1_I.flgISQrE UEGO_DataSplyClsS1B1_I.flgLCURR UEGO_DataSplyClsS1B1_I.flgLNMeas UEGO_DataSplyClsS1B1_I.flgLPMeas UEGO_DataSplyClsS1B1_I.flgLoupeCAL UEGO_DataSplyClsS1B1_I.flgLoupeG0 UEGO_DataSplyClsS1B1_I.flgLstPckAbort UEGO_DataSplyClsS1B1_I.flgMKA UEGO_DataSplyClsS1B1_I.flgMKE UEGO_DataSplyClsS1B1_I.flgNewIPmpDacPckAry UEGO_DataSplyClsS1B1_I.flgNewIPmpOK UEGO_DataSplyClsS1B1_I.flgNewIPmpPckAry UEGO_DataSplyClsS1B1_I.flgNewIPmpTM UEGO_DataSplyClsS1B1_I.flgNewPck UEGO_DataSplyClsS1B1_I.flgNewPckCstnc UEGO_DataSplyClsS1B1_I.flgNewPckMiss UEGO_DataSplyClsS1B1_I.flgNewPckVld UEGO_DataSplyClsS1B1_I.flgNewTiPck UEGO_DataSplyClsS1B1_I.flgNewURmVG4MeasAryVld UEGO_DataSplyClsS1B1_I.flgNewUa2Pck UEGO_DataSplyClsS1B1_I.flgNewUa31Pck UEGO_DataSplyClsS1B1_I.flgNewUa32Pck UEGO_DataSplyClsS1B1_I.flgNewUa33Pck UEGO_DataSplyClsS1B1_I.flgNewUamPck UEGO_DataSplyClsS1B1_I.flgNewUapePck UEGO_DataSplyClsS1B1_I.flgNewUcalMaxPck UEGO_DataSplyClsS1B1_I.flgNewUcalPck UEGO_DataSplyClsS1B1_I.flgNewUg0Pck UEGO_DataSplyClsS1B1_I.flgNewUg0PckAry UEGO_DataSplyClsS1B1_I.flgNewUg0aPck UEGO_DataSplyClsS1B1_I.flgNewUg0ePck UEGO_DataSplyClsS1B1_I.flgNewUg0iPck UEGO_DataSplyClsS1B1_I.flgNewUg0iPckAry UEGO_DataSplyClsS1B1_I.flgNewUg0iaiPck UEGO_DataSplyClsS1B1_I.flgNewUg0ieiPck UEGO_DataSplyClsS1B1_I.flgNewUg0ix7PckAry UEGO_DataSplyClsS1B1_I.flgNewUg0ix9PckAry UEGO_DataSplyClsS1B1_I.flgNewUg0ixPckAry UEGO_DataSplyClsS1B1_I.flgNewUg0mPck UEGO_DataSplyClsS1B1_I.flgNewUgaPck UEGO_DataSplyClsS1B1_I.flgNewUgiPckAry UEGO_DataSplyClsS1B1_I.flgNewUgkAvrgPck UEGO_DataSplyClsS1B1_I.flgNewUguaPck UEGO_DataSplyClsS1B1_I.flgNewUguaZ2Pck UEGO_DataSplyClsS1B1_I.flgNewUguiPck UEGO_DataSplyClsS1B1_I.flgNewUguiZ1Pck UEGO_DataSplyClsS1B1_I.flgNewUi21PckAry UEGO_DataSplyClsS1B1_I.flgNewUi22Pck UEGO_DataSplyClsS1B1_I.flgNewUi23Pck UEGO_DataSplyClsS1B1_I.flgNewUi24Pck UEGO_DataSplyClsS1B1_I.flgNewUi4Pck UEGO_DataSplyClsS1B1_I.flgNewUi4Z2Pck UEGO_DataSplyClsS1B1_I.flgNewUigPckAry UEGO_DataSplyClsS1B1_I.flgNewUigmkPckAry UEGO_DataSplyClsS1B1_I.flgNewUipcalAvrgPck UEGO_DataSplyClsS1B1_I.flgNewUn0Pck UEGO_DataSplyClsS1B1_I.flgNewUn0Pck4Ary UEGO_DataSplyClsS1B1_I.flgNewUn0Pck5Ary UEGO_DataSplyClsS1B1_I.flgNewUn0PckAry UEGO_DataSplyClsS1B1_I.flgNewUnPckAry UEGO_DataSplyClsS1B1_I.flgNewUnSetPck UEGO_DataSplyClsS1B1_I.flgNewUnx3PckAry UEGO_DataSplyClsS1B1_I.flgNewUnx4PckAry UEGO_DataSplyClsS1B1_I.flgNewUp0Pck UEGO_DataSplyClsS1B1_I.flgNewUp0Pck4 UEGO_DataSplyClsS1B1_I.flgNewUp0Pck5Ary UEGO_DataSplyClsS1B1_I.flgNewUp0PckAry UEGO_DataSplyClsS1B1_I.flgNewUpPckAry UEGO_DataSplyClsS1B1_I.flgNewUpx3PckAry UEGO_DataSplyClsS1B1_I.flgNewUpx4PckAry UEGO_DataSplyClsS1B1_I.flgNewUriaPckVld UEGO_DataSplyClsS1B1_I.flgNewUriePckAry UEGO_DataSplyClsS1B1_I.flgNewUx6PckAry UEGO_DataSplyClsS1B1_I.flgNewUx7PckAry UEGO_DataSplyClsS1B1_I.flgNewUx8PckAry UEGO_DataSplyClsS1B1_I.flgNewUx9PckAry UEGO_DataSplyClsS1B1_I.flgNewUxPckAry UEGO_DataSplyClsS1B1_I.flgReStable UEGO_DataSplyClsS1B1_I.flgSngCell UEGO_DataSplyClsS1B1_I.flgUical0Vld UEGO_DataSplyClsS1B1_I.flgUicalVld UEGO_DataSplyClsS1B1_I.flgUoffipe1Vld UEGO_DataSplyClsS1B1_I.flgUoffipe2Vld UEGO_DataSplyClsS1B1_I.flgUoffipe3Vld UEGO_DataSplyClsS1B1_I.flgUoffvcc1Vld UEGO_DataSplyClsS1B1_I.flgUoffvcc2Vld UEGO_DataSplyClsS1B1_I.flgUoffvcc3Vld UEGO_DataSplyClsS1B1_I.flgUriaMeas UEGO_DataSplyClsS1B1_I.nrIPmpDacPckAry UEGO_DataSplyClsS1B1_I.nrIpPckAry UEGO_DataSplyClsS1B1_I.nrModeMeas UEGO_DataSplyClsS1B1_I.nrRamFailPosn UEGO_DataSplyClsS1B1_I.nrRamMod UEGO_DataSplyClsS1B1_I.nrRamRegMod UEGO_DataSplyClsS1B1_I.nrRamSts1 UEGO_DataSplyClsS1B1_I.nrRamSts2 UEGO_DataSplyClsS1B1_I.nrRamSts3 UEGO_DataSplyClsS1B1_I.nrURmVG4PckAry UEGO_DataSplyClsS1B1_I.nrUa2PckAry UEGO_DataSplyClsS1B1_I.nrUcalMaxCorrd UEGO_DataSplyClsS1B1_I.nrUg0PckAry UEGO_DataSplyClsS1B1_I.nrUg0iPckAry UEGO_DataSplyClsS1B1_I.nrUg0ix7PckAry UEGO_DataSplyClsS1B1_I.nrUg0ix9PckAry UEGO_DataSplyClsS1B1_I.nrUg0ixPckAry UEGO_DataSplyClsS1B1_I.nrUgaPckAry UEGO_DataSplyClsS1B1_I.nrUgiPckAry UEGO_DataSplyClsS1B1_I.nrUi21PckAry UEGO_DataSplyClsS1B1_I.nrUical0PckCorrd UEGO_DataSplyClsS1B1_I.nrUicalPckCorrd UEGO_DataSplyClsS1B1_I.nrUigPckAry UEGO_DataSplyClsS1B1_I.nrUigmkPckAry UEGO_DataSplyClsS1B1_I.nrUn0Pck4Ary UEGO_DataSplyClsS1B1_I.nrUn0Pck5Ary UEGO_DataSplyClsS1B1_I.nrUn0PckAry UEGO_DataSplyClsS1B1_I.nrUnPckAry UEGO_DataSplyClsS1B1_I.nrUnx3PckAry UEGO_DataSplyClsS1B1_I.nrUnx4PckAry UEGO_DataSplyClsS1B1_I.nrUoffipe1 UEGO_DataSplyClsS1B1_I.nrUoffipe2 UEGO_DataSplyClsS1B1_I.nrUoffipe3 UEGO_DataSplyClsS1B1_I.nrUoffvcc1 UEGO_DataSplyClsS1B1_I.nrUoffvcc2 UEGO_DataSplyClsS1B1_I.nrUoffvcc3 UEGO_DataSplyClsS1B1_I.nrUp0Pck5Ary UEGO_DataSplyClsS1B1_I.nrUp0PckAry UEGO_DataSplyClsS1B1_I.nrUpPckAry UEGO_DataSplyClsS1B1_I.nrUpx3PckAry UEGO_DataSplyClsS1B1_I.nrUpx4PckAry UEGO_DataSplyClsS1B1_I.nrUriePckAry UEGO_DataSplyClsS1B1_I.nrUx6PckAry UEGO_DataSplyClsS1B1_I.nrUx7PckAry UEGO_DataSplyClsS1B1_I.nrUx8PckAry UEGO_DataSplyClsS1B1_I.nrUx9PckAry UEGO_DataSplyClsS1B1_I.nrUxPckAry UEGO_DataSplyClsS1B1_I.stIPmpOK UEGO_DataSplyClsS1B1_I.stIPmpTM UEGO_DataSplyClsS1B1_I.stIPmpTM2L UEGO_DataSplyClsS1B1_I.stIPmpTM2R UEGO_DataSplyClsS1B1_I.stLsmRetValMod UEGO_DataSplyClsS1B1_I.stMKMeas UEGO_DataSplyClsS1B1_I.stOFFMeas UEGO_DataSplyClsS1B1_I.stOPTMeas UEGO_DataSplyClsS1B1_I.stREFMeas UEGO_DataSplyClsS1B1_I.stUa2PckAry UEGO_DataSplyClsS1B1_I.stUa2Z1PckAry UEGO_DataSplyClsS1B1_I.stUg0iPckAry UEGO_DataSplyClsS1B1_I.stUg0ix7IActvPckAry UEGO_DataSplyClsS1B1_I.stUg0ix7PmpIActvPckAry UEGO_DataSplyClsS1B1_I.stUg0ix9IActvPckAry UEGO_DataSplyClsS1B1_I.stUg0ix9PmpIActvPckAry UEGO_DataSplyClsS1B1_I.stUg0ixIActvPckAry UEGO_DataSplyClsS1B1_I.stUg0ixPmpIActvPckAry UEGO_DataSplyClsS1B1_I.stUi21PckAry UEGO_DataSplyClsS1B1_I.stUi21Z1PckAry UEGO_DataSplyClsS1B1_I.stUigmkNernstIActvPckAry UEGO_DataSplyClsS1B1_I.stUigmkPmpIActvPckAry UEGO_DataSplyClsS1B1_I.stUn0PckAry UEGO_DataSplyClsS1B1_I.stUn0Z2PckAry UEGO_DataSplyClsS1B1_I.stUnPckAry UEGO_DataSplyClsS1B1_I.stUnx3IActvAcrsNernstCellPckAry UEGO_DataSplyClsS1B1_I.stUnx3IActvAcrsPmpCellPckAry UEGO_DataSplyClsS1B1_I.stUnx4IActvAcrsNernstCellPckAry UEGO_DataSplyClsS1B1_I.stUnx4IActvAcrsPmpCellPckAry UEGO_DataSplyClsS1B1_I.stUp0PckAry UEGO_DataSplyClsS1B1_I.stUp0Z2PckAry UEGO_DataSplyClsS1B1_I.stUpPckAry UEGO_DataSplyClsS1B1_I.stUpZ2PckAry UEGO_DataSplyClsS1B1_I.stUpx3IActvAcrsNernstCellPckAry UEGO_DataSplyClsS1B1_I.stUpx3IActvAcrsPmpCellPckAry UEGO_DataSplyClsS1B1_I.stUpx4IActvAcrsNernstCellPckAry UEGO_DataSplyClsS1B1_I.stUpx4IActvAcrsPmpCellPckAry UEGO_DataSplyClsS1B1_I.stUriePckAry UEGO_DataSplyClsS1B1_I.stUx6IActvPckAry UEGO_DataSplyClsS1B1_I.stUx6MeasAcrsPmpCellPckAry UEGO_DataSplyClsS1B1_I.stUx7IActvPckAry UEGO_DataSplyClsS1B1_I.stUx7MeasAcrsPmpCellPckAry UEGO_DataSplyClsS1B1_I.stUx8IActvPckAry UEGO_DataSplyClsS1B1_I.stUx8MeasAcrsPmpCellPckAry UEGO_DataSplyClsS1B1_I.stUx9IActvPckAry UEGO_DataSplyClsS1B1_I.stUx9MeasAcrsPmpCellPckAry UEGO_DataSplyClsS1B1_I.stUxIActvPckAry UEGO_DataSplyClsS1B1_I.stUxMeasAcrsPmpCell UEGO_DataSplyClsS1B1_I.tiUEGOPck UEGO_DataSplyClsS1B1_I.uFkal1 UEGO_DataSplyClsS1B1_I.uFkal2 UEGO_DataSplyClsS1B1_I.uFkal3 UEGO_DataSplyClsS1B1_I.uUCalPck UEGO_DataSplyClsS1B1_I.uUa31Pck UEGO_DataSplyClsS1B1_I.uUa32Pck UEGO_DataSplyClsS1B1_I.uUa33Pck UEGO_DataSplyClsS1B1_I.uUamPck UEGO_DataSplyClsS1B1_I.uUapePck UEGO_DataSplyClsS1B1_I.uUcalMaxPck UEGO_DataSplyClsS1B1_I.uUg0Pck UEGO_DataSplyClsS1B1_I.uUg0aPck UEGO_DataSplyClsS1B1_I.uUg0ePck UEGO_DataSplyClsS1B1_I.uUg0iPck UEGO_DataSplyClsS1B1_I.uUg0iaiPck UEGO_DataSplyClsS1B1_I.uUg0ieiPck UEGO_DataSplyClsS1B1_I.uUg0mPck UEGO_DataSplyClsS1B1_I.uUgkAvrgPck UEGO_DataSplyClsS1B1_I.uUguaPck UEGO_DataSplyClsS1B1_I.uUguaZ2Pck UEGO_DataSplyClsS1B1_I.uUguiPck UEGO_DataSplyClsS1B1_I.uUguiZ1Pck UEGO_DataSplyClsS1B1_I.uUi22Pck UEGO_DataSplyClsS1B1_I.uUi23Pck UEGO_DataSplyClsS1B1_I.uUi24Pck UEGO_DataSplyClsS1B1_I.uUi4Pck UEGO_DataSplyClsS1B1_I.uUi4Z2Pck UEGO_DataSplyClsS1B1_I.uUipcalAvrgPck UEGO_DataSplyClsS1B1_I.uUn0Pck UEGO_DataSplyClsS1B1_I.uUnSet UEGO_DataSplyClsS1B1_I.uUp0Pck UEGO_DataSplyClsS1B1_I.uUp0Pck4 UEGO_DataSplyClsS1B1_I.uUriaPck UEGO_DataSplyClsS1B1_I.uVCC1Corrd UEGO_DataSplyClsS1B1_I.uVCC3Ref UEGO_flgCJ135AnS1B1 UEGO_flgDiagSigEcuAsicRstS1B1 UEGO_flgDiagSigSnsrRstS1B1 UEGO_flgDiagSigWireOlRstS1B1 UEGO_flgDiagSigWireScRstS1B1 UEGO_flgIPmpRawAryVldS1B1 UEGO_flgSysSuprtdS1B1 UEGO_iIPmpRawAryS1B1 UEGO_ratIPmpRawS1B1 UEGO_RegGetPrmS1B1_I.flgDlyBlcknNxtPckVld UEGO_RegGetPrmS1B1_I.flgDlyBlcknVld UEGO_RegGetPrmS1B1_I.flgDspDiagDis UEGO_RegGetPrmS1B1_I.flgDspDiagDisNxtPck UEGO_RegGetPrmS1B1_I.flgDspDiagDisNxtPckVld UEGO_RegGetPrmS1B1_I.flgDspDiagDisVld UEGO_RegGetPrmS1B1_I.flgEnSpA UEGO_RegGetPrmS1B1_I.flgEnSpAVld UEGO_RegGetPrmS1B1_I.flgEnSpE UEGO_RegGetPrmS1B1_I.flgEnSpEVld UEGO_RegGetPrmS1B1_I.flgEnSpNxtPckVld UEGO_RegGetPrmS1B1_I.flgEnSpVld UEGO_RegGetPrmS1B1_I.flgIPmpBlcknNxtPckVld UEGO_RegGetPrmS1B1_I.flgIPmpBlcknVld UEGO_RegGetPrmS1B1_I.flgIPmpLimnHiVld UEGO_RegGetPrmS1B1_I.flgIPmpLimnLoVld UEGO_RegGetPrmS1B1_I.flgIPmpRst UEGO_RegGetPrmS1B1_I.flgIPmpRstNxtPck UEGO_RegGetPrmS1B1_I.flgIPmpRstNxtPckVld UEGO_RegGetPrmS1B1_I.flgIPmpRstVld UEGO_RegGetPrmS1B1_I.flgIPmpSm UEGO_RegGetPrmS1B1_I.flgIPmpSmNxtPck UEGO_RegGetPrmS1B1_I.flgIPmpSmNxtPckVld UEGO_RegGetPrmS1B1_I.flgIPmpSmVld UEGO_RegGetPrmS1B1_I.flgLCal UEGO_RegGetPrmS1B1_I.flgLCalVld UEGO_RegGetPrmS1B1_I.flgLCurr UEGO_RegGetPrmS1B1_I.flgLCurrVld UEGO_RegGetPrmS1B1_I.flgLDAC UEGO_RegGetPrmS1B1_I.flgLDACConf UEGO_RegGetPrmS1B1_I.flgLDACConfVld UEGO_RegGetPrmS1B1_I.flgLDACVld UEGO_RegGetPrmS1B1_I.flgLG0 UEGO_RegGetPrmS1B1_I.flgLG0Vld UEGO_RegGetPrmS1B1_I.flgLN UEGO_RegGetPrmS1B1_I.flgLNNxtPck UEGO_RegGetPrmS1B1_I.flgLNNxtPckVld UEGO_RegGetPrmS1B1_I.flgLNVld UEGO_RegGetPrmS1B1_I.flgLP UEGO_RegGetPrmS1B1_I.flgLPNxtPck UEGO_RegGetPrmS1B1_I.flgLPNxtPckVld UEGO_RegGetPrmS1B1_I.flgLPVld UEGO_RegGetPrmS1B1_I.flgMKA UEGO_RegGetPrmS1B1_I.flgMKAVld UEGO_RegGetPrmS1B1_I.flgMKE UEGO_RegGetPrmS1B1_I.flgMKEVld UEGO_RegGetPrmS1B1_I.flgMKNxtPckVld UEGO_RegGetPrmS1B1_I.flgMKVld UEGO_RegGetPrmS1B1_I.flgN3MeasActvNxtPck UEGO_RegGetPrmS1B1_I.flgN3MeasActvNxtPckVld UEGO_RegGetPrmS1B1_I.flgOFFNxtPckVld UEGO_RegGetPrmS1B1_I.flgOFFVld UEGO_RegGetPrmS1B1_I.flgOPTNxtPckVld UEGO_RegGetPrmS1B1_I.flgOPTVld UEGO_RegGetPrmS1B1_I.flgPatNxtPckVld UEGO_RegGetPrmS1B1_I.flgPatVld UEGO_RegGetPrmS1B1_I.flgRCmpHeatrEdgeShiftAllwd UEGO_RegGetPrmS1B1_I.flgRCmpHeatrEdgeShiftAllwdNxtPck UEGO_RegGetPrmS1B1_I.flgRCmpHeatrEdgeShiftAllwdNxtPckVld UEGO_RegGetPrmS1B1_I.flgRCmpHeatrEdgeShiftAllwdVld UEGO_RegGetPrmS1B1_I.flgReStab UEGO_RegGetPrmS1B1_I.flgReStabVld UEGO_RegGetPrmS1B1_I.flgRefNxtPckVld UEGO_RegGetPrmS1B1_I.flgRefPatChng UEGO_RegGetPrmS1B1_I.flgRefPatNxtPckVld UEGO_RegGetPrmS1B1_I.flgRefPatVld UEGO_RegGetPrmS1B1_I.flgRefVld UEGO_RegGetPrmS1B1_I.flgRegIPmpSetNxtPckVld UEGO_RegGetPrmS1B1_I.flgRegIPmpSetVld UEGO_RegGetPrmS1B1_I.flgRegIpoffChng UEGO_RegGetPrmS1B1_I.flgRegIpoffNxtPckVld UEGO_RegGetPrmS1B1_I.flgRegIpoffVld UEGO_RegGetPrmS1B1_I.flgRegModNxtPckVld UEGO_RegGetPrmS1B1_I.flgRegModVld UEGO_RegGetPrmS1B1_I.flgRegPartModNxtPckVld UEGO_RegGetPrmS1B1_I.flgRegPartModVld UEGO_RegGetPrmS1B1_I.flgRegUnsetNxtPckVld UEGO_RegGetPrmS1B1_I.flgRiaPatChng UEGO_RegGetPrmS1B1_I.flgRiaPatVld UEGO_RegGetPrmS1B1_I.flgRipVld UEGO_RegGetPrmS1B1_I.flgSngCell UEGO_RegGetPrmS1B1_I.flgSngCellVld UEGO_RegGetPrmS1B1_I.flgSteerPatChng UEGO_RegGetPrmS1B1_I.flgSteerPatNxtPckVld UEGO_RegGetPrmS1B1_I.flgSteerPatVld UEGO_RegGetPrmS1B1_I.flgSubModMeasNxtPckVld UEGO_RegGetPrmS1B1_I.flgSubModMeasVld UEGO_RegGetPrmS1B1_I.flgSwVirtGnd UEGO_RegGetPrmS1B1_I.flgSwVirtGndVld UEGO_RegGetPrmS1B1_I.flgTrimSqChng UEGO_RegGetPrmS1B1_I.flgTrimSqrCalChng UEGO_RegGetPrmS1B1_I.flgTrimSqrChng UEGO_RegGetPrmS1B1_I.flgTrmNxtPckVld UEGO_RegGetPrmS1B1_I.flgTrmSqCalOffSet UEGO_RegGetPrmS1B1_I.flgTrmSqCalVld UEGO_RegGetPrmS1B1_I.flgTrmSqOffSet UEGO_RegGetPrmS1B1_I.flgTrmSqOffSetVld UEGO_RegGetPrmS1B1_I.flgTrmSqVld UEGO_RegGetPrmS1B1_I.flgTrmSqrCalOffSet UEGO_RegGetPrmS1B1_I.flgTrmSqrCalVld UEGO_RegGetPrmS1B1_I.flgTrmSqrOffSet UEGO_RegGetPrmS1B1_I.flgTrmSqrOffSetVld UEGO_RegGetPrmS1B1_I.flgTrmSqrVld UEGO_RegGetPrmS1B1_I.flgUnsetVld UEGO_RegGetPrmS1B1_I.flgUp0LeanNxtPckVld UEGO_RegGetPrmS1B1_I.flgUp0LeanVld UEGO_RegGetPrmS1B1_I.flgUp0RichNxtPckVld UEGO_RegGetPrmS1B1_I.flgUp0RichVld UEGO_RegGetPrmS1B1_I.flgUria UEGO_RegGetPrmS1B1_I.flgUriaNxtPck UEGO_RegGetPrmS1B1_I.flgUriaNxtPckVld UEGO_RegGetPrmS1B1_I.flgUriaVld UEGO_RegGetPrmS1B1_I.flgV1BF2NxtPckVld UEGO_RegGetPrmS1B1_I.flgV1BF2Vld UEGO_RegGetPrmS1B1_I.flgV1BF3NxtPckVld UEGO_RegGetPrmS1B1_I.flgV1BIT1 UEGO_RegGetPrmS1B1_I.flgV1BIT1NxtPck UEGO_RegGetPrmS1B1_I.flgV1BIT1NxtPckVld UEGO_RegGetPrmS1B1_I.flgV1BIT1Vld UEGO_RegGetPrmS1B1_I.flgV1BIT2 UEGO_RegGetPrmS1B1_I.flgV1BIT2NxtPck UEGO_RegGetPrmS1B1_I.flgV1BIT2NxtPckVld UEGO_RegGetPrmS1B1_I.flgV1BIT2Vld UEGO_RegGetPrmS1B1_I.flgV1BIT5 UEGO_RegGetPrmS1B1_I.flgV1BIT5NxtPck UEGO_RegGetPrmS1B1_I.flgV1BIT5NxtPckVld UEGO_RegGetPrmS1B1_I.flgV1BIT5Vld UEGO_RegGetPrmS1B1_I.flgWtrEleclyActv UEGO_RegGetPrmS1B1_I.flgWtrEleclyActvNxtPck UEGO_RegGetPrmS1B1_I.flgWtrEleclyActvNxtPckVld UEGO_RegGetPrmS1B1_I.flgWtrEleclyActvVld UEGO_RegGetPrmS1B1_I.flgZIsqrA UEGO_RegGetPrmS1B1_I.flgZIsqrAVld UEGO_RegGetPrmS1B1_I.flgZIsqrE UEGO_RegGetPrmS1B1_I.flgZIsqrEVld UEGO_RegGetPrmS1B1_I.nrIPmpBlcknNxtPck UEGO_RegGetPrmS1B1_I.nrIPmpLimnHi UEGO_RegGetPrmS1B1_I.nrIPmpLimnLo UEGO_RegGetPrmS1B1_I.nrPmpBlckn UEGO_RegGetPrmS1B1_I.nrRefPatNxtPck UEGO_RegGetPrmS1B1_I.nrRegIPmpSet UEGO_RegGetPrmS1B1_I.nrRegIPmpSetNxtPck UEGO_RegGetPrmS1B1_I.nrRegIpoff UEGO_RegGetPrmS1B1_I.nrRegMod UEGO_RegGetPrmS1B1_I.nrRegModNxtPck UEGO_RegGetPrmS1B1_I.nrRegPartMod UEGO_RegGetPrmS1B1_I.nrRegPartModNxtPck UEGO_RegGetPrmS1B1_I.nrRegTrmNxtPck UEGO_RegGetPrmS1B1_I.nrRegTrmSqNxtPck UEGO_RegGetPrmS1B1_I.nrRegTrmSqrNxtPck UEGO_RegGetPrmS1B1_I.nrRip UEGO_RegGetPrmS1B1_I.nrSteerPatNxtPck UEGO_RegGetPrmS1B1_I.nrSubModMeas UEGO_RegGetPrmS1B1_I.nrSubModMeasNxtPck UEGO_RegGetPrmS1B1_I.nrTrmSq UEGO_RegGetPrmS1B1_I.nrTrmSqCal UEGO_RegGetPrmS1B1_I.nrTrmSqr UEGO_RegGetPrmS1B1_I.nrTrmSqrCal UEGO_RegGetPrmS1B1_I.nrUnset UEGO_RegGetPrmS1B1_I.nrUnsetNxtPck UEGO_RegGetPrmS1B1_I.nrUp0Lean UEGO_RegGetPrmS1B1_I.nrUp0LeanNxtPck UEGO_RegGetPrmS1B1_I.nrUp0Rich UEGO_RegGetPrmS1B1_I.nrUp0RichNxtPck UEGO_RegGetPrmS1B1_I.stDlyBlckn UEGO_RegGetPrmS1B1_I.stDlyBlcknNxtPck UEGO_RegGetPrmS1B1_I.stEnSp UEGO_RegGetPrmS1B1_I.stEnSpNxtPck UEGO_RegGetPrmS1B1_I.stMK UEGO_RegGetPrmS1B1_I.stMKNxtPck UEGO_RegGetPrmS1B1_I.stOFF UEGO_RegGetPrmS1B1_I.stOFFNxtPck UEGO_RegGetPrmS1B1_I.stOPT UEGO_RegGetPrmS1B1_I.stOPTNxtPck UEGO_RegGetPrmS1B1_I.stPat UEGO_RegGetPrmS1B1_I.stPatNxtPck UEGO_RegGetPrmS1B1_I.stRef UEGO_RegGetPrmS1B1_I.stRefNxtPck UEGO_RegGetPrmS1B1_I.stRefPat UEGO_RegGetPrmS1B1_I.stRegIpoffNxtPck UEGO_RegGetPrmS1B1_I.stRiaPat UEGO_RegGetPrmS1B1_I.stSteerPat UEGO_RegGetPrmS1B1_I.stV1BF2 UEGO_RegGetPrmS1B1_I.stV1BF2NxtPck UEGO_RegGetPrmS1B1_I.stV1BF3NxtPck UEGO_RegSetS1B1_I.cntrRegSet UEGO_RegSetS1B1_I.flgCJ135An UEGO_RegSetS1B1_I.flgConvVld UEGO_RegSetS1B1_I.flgIPmpDes UEGO_RegSetS1B1_I.flgIPmpPhyRels UEGO_RegSetS1B1_I.flgIniFinshd UEGO_RegSetS1B1_I.flgLoupeCURRDes UEGO_RegSetS1B1_I.flgLoupeDACDes UEGO_RegSetS1B1_I.flgLoupeNDes UEGO_RegSetS1B1_I.flgLoupePDes UEGO_RegSetS1B1_I.flgNewReq UEGO_RegSetS1B1_I.flgRegSetSt UEGO_RegSetS1B1_I.flgRegSetStVld UEGO_RegSetS1B1_I.flgReqAcptd UEGO_RegSetS1B1_I.flgSetRegOk UEGO_RegSetS1B1_I.flgTakeDataOk UEGO_RegSetS1B1_I.idxChp UEGO_RegSetS1B1_I.nrIdleSubMode UEGO_RegSetS1B1_I.nrModDes UEGO_RegSetS1B1_I.nrNormSubMode UEGO_RegSetS1B1_I.nrRegSet UEGO_RegSetS1B1_I.nrSubModDes UEGO_RegSetS1B1_I.nrSwtOnSubMode UEGO_RegSetS1B1_I.nrTrmSq UEGO_RegSetS1B1_I.nrWrmUpSubMode UEGO_RegSetS1B1_I.stRegSet UEGO_RegSetS1B1_I.stRegSetVld UEGO_RegSetS1B1_I.tmpVar UEGO_uUgaPckAryS1B1 UEGO_uUgiPckAryS1B1 /end IN_MEASUREMENT
 /begin OUT_MEASUREMENT UEGO_flgIPmpDeltaVldS1B1 UEGO_flgIPmpPlsFirstVldS1B1 UEGO_flgIPmpPlsSecVldS1B1 UEGO_flgIsqDesNomVldS1B1 UEGO_flgIsqMeasVldS1B1 UEGO_flgIsqrDesNomVldS1B1 UEGO_flgIsqrMeasVldS1B1 UEGO_flgRatINernstExctVldS1B1 UEGO_flgRatIPmpExctVldS1B1 UEGO_flgTrmSqRglnVldS1B1 UEGO_flgTrmSqrRglnVldS1B1 UEGO_iIPmpDeltaS1B1 UEGO_iIsqDesNomS1B1 UEGO_iIsqDesS1B1 UEGO_iIsqMeasRawS1B1 UEGO_iIsqMeasS1B1 UEGO_iIsqrDesNomS1B1 UEGO_iIsqrDesS1B1 UEGO_iIsqrMeasS1B1 UEGO_iOffsIsqrNernstS1B1 UEGO_iOffsIsqrPmpS1B1 UEGO_iPmpPlsFirstAryS1B1 UEGO_iPmpPlsSecAryS1B1 UEGO_nrTrmSqRglnS1B1 UEGO_nrTrmSqrRglnS1B1 UEGO_ratINernstExctS1B1 UEGO_ratIPmpExctS1B1 UEGO_stIsqrNernstS1B1 UEGO_stIsqrPmpS1B1 /end OUT_MEASUREMENT
 /begin LOC_MEASUREMENT UEGO_flgReStableS1B1 UEGO_ISrcCtrlS1B1_I.flgSetRegISq UEGO_ISrcCtrlS1B1_I.flgSetRegISqr UEGO_ISrcCtrlS1B1_I.iIsqDes UEGO_ISrcCtrlS1B1_I.iIsqrDes UEGO_ISrcCtrlS1B1_I.nrIsqDes UEGO_ISrcCtrlS1B1_I.nrIsqrDes UEGO_ISrcCtrlS1B1_I.nrModInt UEGO_ISrcCtrlS1B1_I.nrModIntOld UEGO_ISrcCtrlS1B1_I.UEGO_ISrcRglnClass_Isq.iISrcDes UEGO_ISrcCtrlS1B1_I.UEGO_ISrcRglnClass_Isq.iISrcRglnLowrThd UEGO_ISrcCtrlS1B1_I.UEGO_ISrcRglnClass_Isq.iISrcRglnUpprThd UEGO_ISrcCtrlS1B1_I.UEGO_ISrcRglnClass_Isq.nrISrcDes UEGO_ISrcCtrlS1B1_I.UEGO_ISrcRglnClass_Isq.nrISrcRglnCntr UEGO_ISrcCtrlS1B1_I.UEGO_ISrcRglnClass_Isq.nrModIntRgln UEGO_ISrcCtrlS1B1_I.UEGO_ISrcRglnClass_Isq.nrModIntRglnOld UEGO_ISrcCtrlS1B1_I.UEGO_ISrcRglnClass_Isqr.iISrcDes UEGO_ISrcCtrlS1B1_I.UEGO_ISrcRglnClass_Isqr.iISrcRglnLowrThd UEGO_ISrcCtrlS1B1_I.UEGO_ISrcRglnClass_Isqr.iISrcRglnUpprThd UEGO_ISrcCtrlS1B1_I.UEGO_ISrcRglnClass_Isqr.nrISrcDes UEGO_ISrcCtrlS1B1_I.UEGO_ISrcRglnClass_Isqr.nrISrcRglnCntr UEGO_ISrcCtrlS1B1_I.UEGO_ISrcRglnClass_Isqr.nrModIntRgln UEGO_ISrcCtrlS1B1_I.UEGO_ISrcRglnClass_Isqr.nrModIntRglnOld UEGO_ISrcEvlnS1B1_I.flgIPmpDeltaVld UEGO_ISrcEvlnS1B1_I.flgIPmpMeasAryISrcVld UEGO_ISrcEvlnS1B1_I.flgIPmpMeasAryScVld UEGO_ISrcEvlnS1B1_I.flgIPmpMeasAryVld UEGO_ISrcEvlnS1B1_I.flgIPmpMeasRCmpVld UEGO_ISrcEvlnS1B1_I.flgIPmpPlsFirstVld UEGO_ISrcEvlnS1B1_I.flgIPmpPlsSecVld UEGO_ISrcEvlnS1B1_I.flgIsqDesNomVld UEGO_ISrcEvlnS1B1_I.flgIsqMeasVld UEGO_ISrcEvlnS1B1_I.flgIsqrAAvrgRawVld UEGO_ISrcEvlnS1B1_I.flgIsqrAAvrgVld UEGO_ISrcEvlnS1B1_I.flgIsqrDesNomVld UEGO_ISrcEvlnS1B1_I.flgIsqrEAvrgRawVld UEGO_ISrcEvlnS1B1_I.flgIsqrEAvrgVld UEGO_ISrcEvlnS1B1_I.flgIsqrGndix7PckAryVld UEGO_ISrcEvlnS1B1_I.flgIsqrGndix9PckAryVld UEGO_ISrcEvlnS1B1_I.flgIsqrGndixPckAryVld UEGO_ISrcEvlnS1B1_I.flgIsqrMMeasVld UEGO_ISrcEvlnS1B1_I.flgIsqrMeasVld UEGO_ISrcEvlnS1B1_I.flgRatINernstExctVld UEGO_ISrcEvlnS1B1_I.flgRatIPmpExctVld UEGO_ISrcEvlnS1B1_I.flgReStabVld UEGO_ISrcEvlnS1B1_I.flgTrmSqRglnVld UEGO_ISrcEvlnS1B1_I.flgTrmSqrMRglnVld UEGO_ISrcEvlnS1B1_I.flgTrmSqrRglnVld UEGO_ISrcEvlnS1B1_I.flgUg0iAvrgCalcd UEGO_ISrcEvlnS1B1_I.iIPmpDelta UEGO_ISrcEvlnS1B1_I.iIPmpDeltaRaw UEGO_ISrcEvlnS1B1_I.iIPmpMeasAry UEGO_ISrcEvlnS1B1_I.iIPmpMeasRCmp UEGO_ISrcEvlnS1B1_I.iIsqDesNom UEGO_ISrcEvlnS1B1_I.iIsqMeas UEGO_ISrcEvlnS1B1_I.iIsqMeasRaw UEGO_ISrcEvlnS1B1_I.iIsqrAAry UEGO_ISrcEvlnS1B1_I.iIsqrAAvrg UEGO_ISrcEvlnS1B1_I.iIsqrAAvrgRaw UEGO_ISrcEvlnS1B1_I.iIsqrASum UEGO_ISrcEvlnS1B1_I.iIsqrDesNom UEGO_ISrcEvlnS1B1_I.iIsqrEAry UEGO_ISrcEvlnS1B1_I.iIsqrEAvrg UEGO_ISrcEvlnS1B1_I.iIsqrEAvrgRaw UEGO_ISrcEvlnS1B1_I.iIsqrESum UEGO_ISrcEvlnS1B1_I.iIsqrGndix7PckAry UEGO_ISrcEvlnS1B1_I.iIsqrGndix9PckAry UEGO_ISrcEvlnS1B1_I.iIsqrGndixPckAry UEGO_ISrcEvlnS1B1_I.iIsqrMMeas UEGO_ISrcEvlnS1B1_I.iIsqrMeas UEGO_ISrcEvlnS1B1_I.iIsqrMeasRaw UEGO_ISrcEvlnS1B1_I.iOffsIsqrNernst UEGO_ISrcEvlnS1B1_I.iOffsIsqrPmp UEGO_ISrcEvlnS1B1_I.iPmpMeasRawAry UEGO_ISrcEvlnS1B1_I.iPmpMeasZ0 UEGO_ISrcEvlnS1B1_I.iPmpMeasZ12 UEGO_ISrcEvlnS1B1_I.nrIsqrAAry UEGO_ISrcEvlnS1B1_I.nrIsqrEAry UEGO_ISrcEvlnS1B1_I.nrModInt UEGO_ISrcEvlnS1B1_I.nrModIntOld UEGO_ISrcEvlnS1B1_I.nrModRelErrInt UEGO_ISrcEvlnS1B1_I.nrTrmSqRgln UEGO_ISrcEvlnS1B1_I.nrTrmSqrMRgln UEGO_ISrcEvlnS1B1_I.nrTrmSqrRgln UEGO_ISrcEvlnS1B1_I.ratINernstExct UEGO_ISrcEvlnS1B1_I.ratIPmpExct UEGO_ISrcEvlnS1B1_I.stIsqrNernst UEGO_ISrcEvlnS1B1_I.stIsqrPmp UEGO_ISrcEvlnS1B1_I.uUg0iAvrg UEGO_ISrcEvlnS1B1_I.UcalEvalFil_I.flgEvlnStrtd UEGO_ISrcEvlnS1B1_I.UcalEvalFil_I.EvlnFil_DL_I.memory UEGO_ISrcEvlnS1B1_I.UcalMEvalFil_I.flgEvlnStrtd UEGO_ISrcEvlnS1B1_I.UcalMEvalFil_I.EvlnFil_DL_I.memory UEGO_ISrcEvlnS1B1_I.Uego_iIsqrTONVNM_I.time UEGO_ISrcEvlnS1B1_I.Ug0EvalFil_I.flgEvlnStrtd UEGO_ISrcEvlnS1B1_I.Ug0EvalFil_I.EvlnFil_DL_I.memory UEGO_ISrcEvlnS1B1_I.iDeltaPmpTONVNM_I.time UEGO_ISrcEvlnS1B1_I.iIPmpDeltaFil_I.flgEvlnStrtd UEGO_ISrcEvlnS1B1_I.iIPmpDeltaFil_I.EvlnFil_DL_I.memory UEGO_ISrcEvlnS1B1_I.iIPmpDeltaPeakFil_I.flgFilStrtd UEGO_ISrcEvlnS1B1_I.iIPmpDeltaPeakFil_I.uDeltaInOutpMax UEGO_ISrcEvlnS1B1_I.iIsqrAAvrg_I.flgEvlnStrtd UEGO_ISrcEvlnS1B1_I.iIsqrAAvrg_I.EvlnFil_DL_I.memory UEGO_ISrcEvlnS1B1_I.iIsqrEAvrg_I.flgEvlnStrtd UEGO_ISrcEvlnS1B1_I.iIsqrEAvrg_I.EvlnFil_DL_I.memory UEGO_ISrcEvlnS1B1_I.ratINernstExct_I.flgEvlnStrtd UEGO_ISrcEvlnS1B1_I.ratINernstExct_I.EvlnFil_DL_I.memory UEGO_ISrcEvlnS1B1_I.ratIPumpExct_I.flgEvlnStrtd UEGO_ISrcEvlnS1B1_I.ratIPumpExct_I.EvlnFil_DL_I.memory /end LOC_MEASUREMENT
 FUNCTION_VERSION "1.25.0" /end FUNCTION
/begin COMPU_METHOD ASCET_1 "" RAT_FUNC "%13.12" "A" COEFFS 0 98304000000 0 0 0 1 /end COMPU_METHOD
/begin COMPU_METHOD B_TRUE "" TAB_VERB "%6.3" "" COMPU_TAB_REF B_TRUE /end COMPU_METHOD
/begin COMPU_VTAB B_TRUE "" TAB_VERB 2 0 "FALSE" 1 "TRUE" /end COMPU_VTAB
/begin COMPU_METHOD c_q1Em7_F "" RAT_FUNC "%10.9" "F" COEFFS 0 10000000 0 0 0 1 /end COMPU_METHOD
/begin COMPU_METHOD dez "" RAT_FUNC "%6.2" "" COEFFS 0 1 0 0 0 1 /end COMPU_METHOD
/begin COMPU_METHOD fak_q1p201Em4 "" RAT_FUNC "%6.5" "-" COEFFS 0 8325 0 0 0 1 /end COMPU_METHOD
/begin COMPU_METHOD fak_q1p8329Em9 "" RAT_FUNC "%11.10" "-" COEFFS 0 545587200 0 0 0 1 /end COMPU_METHOD
/begin COMPU_METHOD fak_uw_b1 "" RAT_FUNC "%7.6" "-" COEFFS 0 65536 0 0 0 1 /end COMPU_METHOD
/begin COMPU_METHOD fak_uw_b2 "" RAT_FUNC "%7.6" "-" COEFFS 0 65536 0 0 0 2 /end COMPU_METHOD
/begin COMPU_METHOD fak_uw_b512 "" RAT_FUNC "%6.4" "-" COEFFS 0 65536 0 0 0 512 /end COMPU_METHOD
/begin COMPU_METHOD i_q1p01725Em11_A "" RAT_FUNC "%13.12" "A" COEFFS 0 98304 0 0 0 1e-006 /end COMPU_METHOD
/begin COMPU_METHOD i_q1p01725Em12_A "" RAT_FUNC "%14.13" "A" COEFFS 0 983040000000 0 0 0 1 /end COMPU_METHOD
/begin COMPU_METHOD i_q6p6667Em7_A "" RAT_FUNC "%9.8" "A" COEFFS 0 1500000 0 0 0 1 /end COMPU_METHOD
/begin COMPU_METHOD i_q6p667Em8_A "" RAT_FUNC "%10.9" "A" COEFFS 0 15000000 0 0 0 1 /end COMPU_METHOD
/begin COMPU_METHOD OneToOne "" RAT_FUNC "%6.2" "-" COEFFS 0 1 0 0 0 1 /end COMPU_METHOD
/begin COMPU_METHOD q0p1182_mA_DIV_V "" RAT_FUNC "%6.3" "mA/V" COEFFS 0 1 0 0 0 0.1182 /end COMPU_METHOD
/begin COMPU_METHOD q0p4728_mA_DIV_V "" RAT_FUNC "%6.3" "mA/V" COEFFS 0 1 0 0 0 0.4728 /end COMPU_METHOD
/begin COMPU_METHOD q7p3875Em4_mA_DIV_V "" RAT_FUNC "%6.5" "mA/V" COEFFS 0 100000000 0 0 0 73875 /end COMPU_METHOD
/begin COMPU_METHOD r_q0p1_Ohm "" RAT_FUNC "%6.3" "Ohm" COEFFS 0 10 0 0 0 1 /end COMPU_METHOD
/begin COMPU_METHOD spg_q2p3842Em7_V "" RAT_FUNC "%9.8" "V" COEFFS 0 4194304 0 0 0 1 /end COMPU_METHOD
/begin COMPU_METHOD spg_q3p2Em4_V "" RAT_FUNC "%6.5" "V" COEFFS 0 32768 0 0 0 10.48576 /end COMPU_METHOD
/begin COMPU_METHOD spg_q4p883Em9_V "" RAT_FUNC "%11.10" "V" COEFFS 0 204800000 0 0 0 1 /end COMPU_METHOD
/begin COMPU_METHOD temp_q0p0234_o273 "" RAT_FUNC "%6.1" "Grad C" COEFFS 0 1 273.15 0 0 0.0234375 /end COMPU_METHOD
/begin COMPU_METHOD t_q0p005 "" RAT_FUNC "%6.4" "s" COEFFS 0 1000 0 0 0 5 /end COMPU_METHOD
/begin COMPU_METHOD t_q0p01 "" RAT_FUNC "%6.4" "s" COEFFS 0 100 0 0 0 1 /end COMPU_METHOD
/begin COMPU_METHOD t_q0p01_us "" RAT_FUNC "%6.4" "us" COEFFS 0 100 0 0 0 1 /end COMPU_METHOD
/begin COMPU_METHOD t_q6p6666Em4 "" RAT_FUNC "%6.5" "s" COEFFS 0 1500 0 0 0 1 /end COMPU_METHOD
/begin COMPU_METHOD UEGO_ICS3B1_SY_Compu "" TAB_VERB "%6.3" "" COMPU_TAB_REF UEGO_ICS3B1_SY_Compu /end COMPU_METHOD
/begin COMPU_VTAB UEGO_ICS3B1_SY_Compu "" TAB_VERB 3 0 "0" 1 "1" 2 "2" /end COMPU_VTAB
/begin COMPU_METHOD UEGO_ICS3B2_SY_Compu "" TAB_VERB "%6.3" "" COMPU_TAB_REF UEGO_ICS3B2_SY_Compu /end COMPU_METHOD
/begin COMPU_VTAB UEGO_ICS3B2_SY_Compu "" TAB_VERB 3 0 "0" 1 "1" 2 "2" /end COMPU_VTAB
/begin COMPU_METHOD UEGO_IPELEAKPAVEEP_SC_Compu "" TAB_VERB "%6.3" "" COMPU_TAB_REF UEGO_IPELEAKPAVEEP_SC_Compu /end COMPU_METHOD
/begin COMPU_VTAB UEGO_IPELEAKPAVEEP_SC_Compu "" TAB_VERB 2 0 "False" 1 "True" /end COMPU_VTAB
/begin COMPU_METHOD UEGO_IPELEAKPAVUSG_SC_Compu "" TAB_VERB "%6.3" "" COMPU_TAB_REF UEGO_IPELEAKPAVUSG_SC_Compu /end COMPU_METHOD
/begin COMPU_VTAB UEGO_IPELEAKPAVUSG_SC_Compu "" TAB_VERB 2 0 "False" 1 "True" /end COMPU_VTAB
/begin COMPU_METHOD UEGO_IPmpCtrl_COMPU_VERB "" TAB_VERB "%6.3" "" COMPU_TAB_REF UEGO_IPmpCtrl_COMPU_VERB /end COMPU_METHOD
/begin COMPU_VTAB UEGO_IPmpCtrl_COMPU_VERB "" TAB_VERB 4 0 "PID_DEFAULT" 1 "PID_RGL" 2 "PID_SAFE" 3 "NO_PID" /end COMPU_VTAB
/begin COMPU_METHOD UEGO_IPMPOFFS_SC_Compu "" TAB_VERB "%6.3" "" COMPU_TAB_REF UEGO_IPMPOFFS_SC_Compu /end COMPU_METHOD
/begin COMPU_VTAB UEGO_IPMPOFFS_SC_Compu "" TAB_VERB 2 0 "False" 1 "True" /end COMPU_VTAB
/begin COMPU_METHOD UEGO_IPmpSeg_COMPU_VERB "" TAB_VERB "%6.3" "" COMPU_TAB_REF UEGO_IPmpSeg_COMPU_VERB /end COMPU_METHOD
/begin COMPU_VTAB UEGO_IPmpSeg_COMPU_VERB "" TAB_VERB 6 1 "IPMPSEG_DATA_RESET" 2 "IPMPSEG_RPC_RESET" 3 "IPMPSEG_RVS_CHRG" 4 "IPMPSEG_NONSTD_LOW_PRCSN" 5 "IPMPSEG_STD_LOW_PRCSN" 6 "IPMPSEG_STD_HIGH_PRCSN" /end COMPU_VTAB
/begin COMPU_METHOD UEGO_ISrc_COMPU_VERB "" TAB_VERB "%6.3" "" COMPU_TAB_REF UEGO_ISrc_COMPU_VERB /end COMPU_METHOD
/begin COMPU_VTAB UEGO_ISrc_COMPU_VERB "" TAB_VERB 8 0 "ISRC_DEFAULT" 1 "ISRC_SWITCHON" 2 "ISRC_SWITCHON_RCMP" 3 "ISRC_SWITCHON_LOISQ" 4 "ISRC_SWITCHON_HIISQ" 5 "ISRC_WARMUP" 6 "ISRC_NORMAL_STD" 7 "ISRC_NORMAL_RVSCHRG" /end COMPU_VTAB
/begin COMPU_METHOD UEGO_ISrc_RGLN_COMPU_VERB "" TAB_VERB "%6.3" "" COMPU_TAB_REF UEGO_ISrc_RGLN_COMPU_VERB /end COMPU_METHOD
/begin COMPU_VTAB UEGO_ISrc_RGLN_COMPU_VERB "" TAB_VERB 5 0 "ISRC_RGLN_INIT" 1 "ISRC_RGLN_WAIT" 2 "ISRC_RGLN_HIGH" 3 "ISRC_RGLN_LOW" 4 "ISRC_RGLN_SETPNT" /end COMPU_VTAB
/begin COMPU_METHOD UEGO_ModIPmpRefCtrl_COMPU_VERB "" TAB_VERB "%6.3" "" COMPU_TAB_REF UEGO_ModIPmpRefCtrl_COMPU_VERB /end COMPU_METHOD
/begin COMPU_VTAB UEGO_ModIPmpRefCtrl_COMPU_VERB "" TAB_VERB 9 1 "IPMPREF_DIA" 2 "IPMPREF_SWTON" 3 "IPMPREF_NORMAL_STOP" 4 "IPMPREF_NORMAL_INI" 5 "IPMPREF_NORMAL_RGL" 6 "IPMPREF_WRMUP_STOP" 7 "IPMPREF_WRMUP_INI" 8 "IPMPREF_WRMUP_RGL" 9 "IPMPREF_CTRL_IDLE" /end COMPU_VTAB
/begin COMPU_METHOD UEGO_ModIPmpRefEvalIsqr_COMPU_VERB "" TAB_VERB "%6.3" "" COMPU_TAB_REF UEGO_ModIPmpRefEvalIsqr_COMPU_VERB /end COMPU_METHOD
/begin COMPU_VTAB UEGO_ModIPmpRefEvalIsqr_COMPU_VERB "" TAB_VERB 12 1 "IPMPREF_EVLN_IDLE" 2 "IPMPREF_SWITCHONURIAON" 3 "IPMPREF_SWITCHONURIAOFF" 4 "IPMPREF_WARMUPREFPATSET" 5 "IPMPREF_WARMUPREFPATUNSET" 6 "IPMPREF_NORMALURIAOFF" 7 "IPMPREF_NORMALURIAONREFPATSET" 8 "IPMPREF_NORMALURIAONREFPATUNSET" 9 "IPMPREF_SWITCHONFA" 10 "IPMPREF_WARMUPFA" 11 "IPMPREF_NORMALFA" 12 "IPMPREF_FREEZE" /end COMPU_VTAB
/begin COMPU_METHOD UEGO_NRO2REFMDL_SC_Compu "" TAB_VERB "%6.3" "" COMPU_TAB_REF UEGO_NRO2REFMDL_SC_Compu /end COMPU_METHOD
/begin COMPU_VTAB UEGO_NRO2REFMDL_SC_Compu "" TAB_VERB 11 0 "0" 1 "1" 2 "2" 3 "3" 4 "4" 5 "5" 6 "6" 7 "7" 8 "8" 9 "9" 10 "10" /end COMPU_VTAB
/begin COMPU_METHOD UEGO_OLRCMPDSTCN_SC_Compu "" TAB_VERB "%6.3" "" COMPU_TAB_REF UEGO_OLRCMPDSTCN_SC_Compu /end COMPU_METHOD
/begin COMPU_VTAB UEGO_OLRCMPDSTCN_SC_Compu "" TAB_VERB 2 0 "False" 1 "True" /end COMPU_VTAB
/begin COMPU_METHOD UEGO_OVRHEATGPREVN_SC_Compu "" TAB_VERB "%6.3" "" COMPU_TAB_REF UEGO_OVRHEATGPREVN_SC_Compu /end COMPU_METHOD
/begin COMPU_VTAB UEGO_OVRHEATGPREVN_SC_Compu "" TAB_VERB 2 0 "False" 1 "True" /end COMPU_VTAB
/begin COMPU_METHOD UEGO_RCMPPRSNT_SC_Compu "" TAB_VERB "%6.3" "" COMPU_TAB_REF UEGO_RCMPPRSNT_SC_Compu /end COMPU_METHOD
/begin COMPU_VTAB UEGO_RCMPPRSNT_SC_Compu "" TAB_VERB 2 0 "False" 1 "True" /end COMPU_VTAB
/begin COMPU_METHOD UEGO_REDHEATGSTGYSIGWIRESC_SC_Compu "" TAB_VERB "%6.3" "" COMPU_TAB_REF UEGO_REDHEATGSTGYSIGWIRESC_SC_Compu /end COMPU_METHOD
/begin COMPU_VTAB UEGO_REDHEATGSTGYSIGWIRESC_SC_Compu "" TAB_VERB 2 0 "False" 1 "True" /end COMPU_VTAB
/begin COMPU_METHOD UEGO_RICHCPBYDIAG_SC_Compu "" TAB_VERB "%6.3" "" COMPU_TAB_REF UEGO_RICHCPBYDIAG_SC_Compu /end COMPU_METHOD
/begin COMPU_VTAB UEGO_RICHCPBYDIAG_SC_Compu "" TAB_VERB 2 0 "Deactivate" 1 "Activate" /end COMPU_VTAB
/begin COMPU_METHOD UEGO_RPC_SC_Compu "" TAB_VERB "%6.3" "" COMPU_TAB_REF UEGO_RPC_SC_Compu /end COMPU_METHOD
/begin COMPU_VTAB UEGO_RPC_SC_Compu "" TAB_VERB 2 0 "False" 1 "True" /end COMPU_VTAB
/begin COMPU_METHOD UEGO_SECCELL_SC_Compu "" TAB_VERB "%6.3" "" COMPU_TAB_REF UEGO_SECCELL_SC_Compu /end COMPU_METHOD
/begin COMPU_VTAB UEGO_SECCELL_SC_Compu "" TAB_VERB 2 0 "disable" 1 "enable" /end COMPU_VTAB
/begin COMPU_METHOD UEGO_SELTSKIPMPEVLN_SC_Compu "" TAB_VERB "%6.3" "" COMPU_TAB_REF UEGO_SELTSKIPMPEVLN_SC_Compu /end COMPU_METHOD
/begin COMPU_VTAB UEGO_SELTSKIPMPEVLN_SC_Compu "" TAB_VERB 5 0 "DISABLE" 1 "ONE_MS" 2 "TWO_MS" 3 "UNUSED" 4 "FOUR_MS" /end COMPU_VTAB
/begin COMPU_METHOD UEGO_SEPUBATTTHDRIDIAG_SC_Compu "" TAB_VERB "%6.3" "" COMPU_TAB_REF UEGO_SEPUBATTTHDRIDIAG_SC_Compu /end COMPU_METHOD
/begin COMPU_VTAB UEGO_SEPUBATTTHDRIDIAG_SC_Compu "" TAB_VERB 2 0 "False" 1 "True" /end COMPU_VTAB
/begin RECORD_LAYOUT RB_Val_Ws16 FNC_VALUES 1 SWORD COLUMN_DIR DIRECT /end RECORD_LAYOUT
/begin RECORD_LAYOUT RB_Val_Wu16 FNC_VALUES 1 UWORD COLUMN_DIR DIRECT /end RECORD_LAYOUT
/begin RECORD_LAYOUT RB_Val_Wu8 FNC_VALUES 1 UBYTE COLUMN_DIR DIRECT /end RECORD_LAYOUT
/end MODULE
/end PROJECT
