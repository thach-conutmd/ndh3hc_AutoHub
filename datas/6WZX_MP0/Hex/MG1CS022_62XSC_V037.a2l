ASAP2_VERSION 1 60
/begin PROJECT MG1CS022 "MG1CS022"
/begin HEADER "" VERSION "MG1CS022_62XSC_V037" PROJECT_NO MG1CS022 /end HEADER
/begin MODULE DIM ""
/begin MOD_COMMON "" BYTE_ORDER MSB_LAST ALIGNMENT_BYTE 1 ALIGNMENT_WORD 2 ALIGNMENT_LONG 4 ALIGNMENT_INT64 4 ALIGNMENT_FLOAT32_IEEE 4 ALIGNMENT_FLOAT64_IEEE 4 DATA_SIZE 32 /end MOD_COMMON
/begin CHARACTERISTIC AirMod_facCorrnInertGasDS "Corection factor for the calculation of direct start charge" CURVE 0x80521F20 RB_Curve_U8_S16_Static 1.999969 fak_sw_b1 -1.000000 0.999969 FORMAT "%8.6" EXTENDED_LIMITS -1.000000 0.9999695
 /begin AXIS_DESCR STD_AXIS AirMod_cntSegStoppingCyc OneToOne 9 0.00 255.0 FORMAT "%5.1" DEPOSIT ABSOLUTE /end AXIS_DESCR
/end CHARACTERISTIC
/begin CHARACTERISTIC AirMod_facCorrnInertGasLKS "Corection factor for the calculation of direct start charge (Low kinetic start)" CURVE 0x80521F3C RB_Curve_U8_S16_Static 1.999969 fak_sw_b1 -1.000000 0.999969 FORMAT "%8.6" EXTENDED_LIMITS -1.000000 0.9999695
 /begin AXIS_DESCR STD_AXIS AirMod_cntSegStoppingCyc OneToOne 9 0.00 255.0 FORMAT "%5.1" DEPOSIT ABSOLUTE /end AXIS_DESCR
/end CHARACTERISTIC
/begin CHARACTERISTIC AirMod_tiLoKinStrtInh_C "Time delay to inhibit air charge calculation for low kinetic start" VALUE 0x80521F58 RB_Val_Wu8 2.550 t_q0p01 0.00 2.550 FORMAT "%5.3" /end CHARACTERISTIC
/begin CHARACTERISTIC ASYNDIRSTO "Number of synchros after Start Request (Start/Stop); air charge for direct start is still calculated" VALUE 0x80521F59 RB_Val_Wu8 255.0 dez 0.00 255.0 FORMAT "%5.1" /end CHARACTERISTIC
/begin CHARACTERISTIC BFZGRLNBKV "Vehicle acceleration for rlmin calculation BKV" VALUE 0x80522080 RB_Val_Ws16 3555.556 bfzg_q0p1085069 -3555.556 0.00 FORMAT "%8.3" EXTENDED_LIMITS -3555.556 3555.447 /end CHARACTERISTIC
/begin CHARACTERISTIC ChrSet_facCorrnMinChrgTEngPEnv_M "Map Individual for minimum charge correction depending on pressure and temperature." MAP 0x80522082 RB_Map_S16U16_U16 3.999939 fak_q6p1035Em5 0.00 3.999939 FORMAT "%8.6"
 /begin AXIS_DESCR STD_AXIS Epm_nEng EngN 12 -16384.00 16383.50 FORMAT "%8.2" DEPOSIT ABSOLUTE /end AXIS_DESCR
 /begin AXIS_DESCR STD_AXIS CEngDsT_t Temp_Cels 7 -273.140 6280.360 FORMAT "%8.3" DEPOSIT ABSOLUTE /end AXIS_DESCR
/end CHARACTERISTIC
/begin CHARACTERISTIC ChrSet_facCorrnNormCdn_C "Weighting factor to include correction norm condition (temperature)" VALUE 0x80522444 RB_Val_Wu8 0.9961 fak_ub_b1 0.00 0.9961 /end CHARACTERISTIC
/begin CHARACTERISTIC ChrSet_facRelAirChrgMinEth_T "Factor of ethanol ratio to determine the minimal relative air charge" CURVE 0x80522154 RB_Curve_U16_U8_Static 0.9961 fak_ub_b1 0.00 0.9961
 /begin AXIS_DESCR STD_AXIS FfPrm_facEth fak_uw_b2 6 0.00 1.999969 FORMAT "%8.6" DEPOSIT ABSOLUTE /end AXIS_DESCR
/end CHARACTERISTIC
/begin CHARACTERISTIC ChrSet_facRelAirChrgMinPEnvFuCutOff_T "correction factor rlmin depending on altitude within the fuel cut-off" CURVE 0x80522168 RB_Curve_U16_U16 1.999969 fak_q3p0518Em5 0.00 1.999969 FORMAT "%8.6"
 /begin AXIS_DESCR STD_AXIS PEnv_p p_q0p039 5 0.00 2559.961 FORMAT "%8.3" DEPOSIT ABSOLUTE /end AXIS_DESCR
/end CHARACTERISTIC
/begin CHARACTERISTIC ChrSet_facRelAirChrgMinTEngFuCutOff_T "correction factor rlmin depending on engine temperature within the fuel cut-off" CURVE 0x8052217E RB_Curve_S16_U16_Static 1.999969 fak_q3p0518Em5 0.00 1.999969 FORMAT "%8.6"
 /begin AXIS_DESCR STD_AXIS CEngDsT_t Temp_Cels 5 -3549.940 3003.560 FORMAT "%8.3" DEPOSIT ABSOLUTE /end AXIS_DESCR
/end CHARACTERISTIC
/begin CHARACTERISTIC ChrSet_pAmbNormCdn_C "Ambient pressure at norm conditions (calibrateable)" VALUE 0x80522446 RB_Val_Wu16 23.00781 p_q0p039 990.000 1013.008 FORMAT "%8.3" EXTENDED_LIMITS 0.00 2559.961 /end CHARACTERISTIC
/begin CHARACTERISTIC ChrSet_ratChrgAirEthMin_T "Characteristic curve of minimum charge for ethanol" CURVE 0x80522194 RB_Curve_S16_U16_Static 1535.977 rel_q0p02344 0.00 1535.977 FORMAT "%8.3"
 /begin AXIS_DESCR STD_AXIS Epm_nEng EngN 12 -16384.00 16383.50 FORMAT "%8.2" DEPOSIT ABSOLUTE /end AXIS_DESCR
/end CHARACTERISTIC
/begin CHARACTERISTIC ChrSet_ratMinChrgFuFullDlvFailr_T "Characteristics minimum charge for fuel full delivery failure" CURVE 0x805221C6 RB_Curve_S16_U16_Static 1535.977 rel_uw_q0p0234 0.00 1535.977 FORMAT "%8.3"
 /begin AXIS_DESCR STD_AXIS Epm_nEng EngN 12 -16384.00 16383.50 FORMAT "%8.2" DEPOSIT ABSOLUTE /end AXIS_DESCR
/end CHARACTERISTIC
/begin CHARACTERISTIC ChrSet_tAmbNormCdn_C "Ambient temperature at norm conditions (calibrateable)" VALUE 0x80522448 RB_Val_Wu8 25.50 temp_ub_q0p75_o48 0.00 25.50 FORMAT "%5.2" EXTENDED_LIMITS -48.00 143.3 /end CHARACTERISTIC
/begin AXIS_PTS CoEOM_stEomDesReqd_AX "distribution for requested mode of operation - interpolation of group axis allowed only in synchro task" 0x80527A42 NO_INPUT_QUANTITY RB_Axis_U16 7951.00000000 CoEOM_stEomStgTot_VERB 26 0.00 7951.00000000 FORMAT "%13.8" DEPOSIT ABSOLUTE /end AXIS_PTS
/begin CHARACTERISTIC CWBGRLDIST "Codeword for %BGRLDIRST" VALUE 0x80521F5A RB_Val_Wu8 255.0 dez 0.00 255.0 FORMAT "%5.1" /end CHARACTERISTIC
/begin CHARACTERISTIC CWBGRLFGZS "code word for BGRLFGZS" VALUE 0x8052201C RB_Val_Wu8 255.0 OneToOne 0.00 255.0 FORMAT "%5.1" /end CHARACTERISTIC
/begin CHARACTERISTIC CWBGRLMIN "code word for %BGRLMIN" VALUE 0x805221F8 RB_Val_Wu8 255.0 dez 0.00 255.0 FORMAT "%5.1" /end CHARACTERISTIC
/begin CHARACTERISTIC CWBGRLMXKV "Codeword of function BGRLMXKV" VALUE 0x80522326 RB_Val_Wu8 255.0 dez 0.00 255.0 FORMAT "%5.1" /end CHARACTERISTIC
/begin CHARACTERISTIC CWBGRLMXS "Code word for functional component BGRLMXS" VALUE 0x80522378 RB_Val_Wu8 255.0 dez 0.00 255.0 FORMAT "%5.1" /end CHARACTERISTIC
/begin CHARACTERISTIC CWRLAPPL "codeword desired relative air charge from test bench during calibration phase" VALUE 0x80522449 RB_Val_Wu8 255.0 dez 0.00 255.0 FORMAT "%5.1" /end CHARACTERISTIC
/begin CHARACTERISTIC CWTFUELM "codeword tfuel for temperature model" VALUE 0x8052249C RB_Val_Wu8 255.0 dez 0.00 255.0 FORMAT "%5.1" /end CHARACTERISTIC
/begin CHARACTERISTIC CWTFUELM1 "codeword tfuel for temperature model" VALUE 0x8052249D RB_Val_Wu8 255.0 dez 0.00 255.0 FORMAT "%5.1" /end CHARACTERISTIC
/begin CHARACTERISTIC CWTFUELSQ "codeword tfuel temperature" VALUE 0x8052248E RB_Val_Wu8 255.0 dez 0.00 255.0 FORMAT "%5.1" /end CHARACTERISTIC
/begin CHARACTERISTIC CWTHDEVAPL "codeword thdev from application parameter" VALUE 0x80522A90 RB_Val_Wu8 255.0 dez 0.00 255.0 FORMAT "%5.1" /end CHARACTERISTIC
/begin CHARACTERISTIC DPLMDK "Permissible pressure delta between predicted delta pressure in intake manifold and delta pressure in intake manifold, throttle and main charge sensor based (via throttle valve tolerances)" VALUE 0x80522436 RB_Val_Ws16 2559.922 p_uw_q0p078 0.00 2559.922 FORMAT "%8.3" EXTENDED_LIMITS -2560.000 2559.922 /end CHARACTERISTIC
/begin CHARACTERISTIC DRLMINBG "Hysteresis for condition minimal achievable torque" VALUE 0x8052244A RB_Val_Wu16 5.015625 rel_q0p02344 0.00 5.015625 FORMAT "%8.6" EXTENDED_LIMITS 0.00 1535.977 /end CHARACTERISTIC
/begin CHARACTERISTIC DRLRLPMAX "Limit for steady delta of relative air charge and predicted relative air charge from monitoring" VALUE 0x80522438 RB_Val_Wu16 767.9766 rel_uw_q0p0234 0.00 767.9766 FORMAT "%8.4" EXTENDED_LIMITS 0.00 1535.977 /end CHARACTERISTIC
/begin CHARACTERISTIC DRLRLPU "delta relative air charge for predicted relative air charge - lower limit" VALUE 0x8052243A RB_Val_Wu16 1535.977 rel_uw_q0p0234 0.00 1535.977 FORMAT "%8.3" /end CHARACTERISTIC
/begin CHARACTERISTIC DRLSOLDYN "delta-rl-rlsol to recognize dynamic operation" VALUE 0x8052244C RB_Val_Wu16 1535.977 rel_q0p02344 0.00 1535.977 FORMAT "%8.3" /end CHARACTERISTIC
/begin CHARACTERISTIC DRLSOLHUM "delta-rl-rlsol for HOM switch" VALUE 0x8052244E RB_Val_Ws16 1535.977 rel_q0p02344 -768.0000 767.9766 FORMAT "%8.4" /end CHARACTERISTIC
/begin CHARACTERISTIC DRLSOLSTAT "delta-rl-rlsol to recognize steady state condition" VALUE 0x80522450 RB_Val_Wu16 1535.977 rel_q0p02344 0.00 1535.977 FORMAT "%8.3" /end CHARACTERISTIC
/begin CHARACTERISTIC DRLSTAT "delta-rl to recognize steady state condition" VALUE 0x80522452 RB_Val_Wu16 1535.977 rel_q0p02344 0.00 1535.977 FORMAT "%8.3" /end CHARACTERISTIC
/begin CHARACTERISTIC DTBRWDMOT "temperature delta between tmot and combustion chamber wall during engine stop" VALUE 0x80521F5C RB_Val_Wu16 100.0078 temp_q0p0234 0.00 100.0078 FORMAT "%8.4" EXTENDED_LIMITS 0.00 1535.977 /end CHARACTERISTIC
/begin CHARACTERISTIC DWDIRSTPRR "maximum change of stop angle per 10 ms" VALUE 0x80521F5E RB_Val_Wu16 60.00000 kw_q0p0156 0.00 60.00000 FORMAT "%8.5" EXTENDED_LIMITS 0.00 1023.984 /end CHARACTERISTIC
/begin CHARACTERISTIC DWMSVDRLMX "Threshold delivery duration of MSV for activating air charge limitation from fuel supply" VALUE 0x80522328 RB_Val_Wu16 6553.500 kw_q0p1 0.00 6553.500 FORMAT "%8.3" /end CHARACTERISTIC
/begin CHARACTERISTIC ETAAUFTEMN "Lower bound split efficiency for multiple injections" VALUE 0x80523680 RB_Val_Wu16 1.999969 fak_uw_b2 0.00 1.999969 FORMAT "%8.6" /end CHARACTERISTIC
/begin CHARACTERISTIC FGDPSMPDVS "weighting factor extrap. manifold pressure / manifold pressure of throttle" VALUE 0x8052243C RB_Val_Wu16 0.6999817 fak_uw_b1 0.3000031 0.9999847 FORMAT "%9.7" EXTENDED_LIMITS 0.00 0.9999847 /end CHARACTERISTIC
/begin CHARACTERISTIC FHORLVPSVD "Factor correction by altitude dependig on ratio intake manifold preassure to preassure upstream throttle valve" CURVE 0x80522454 RB_Curve_U16_U8_Static 0.9961 fak_ub_b1 0.00 0.9961
 /begin AXIS_DESCR STD_AXIS vpsrvdk_w_msg fak_uw_b2 6 0.00 1.999969 FORMAT "%8.6" DEPOSIT ABSOLUTE /end AXIS_DESCR
/end CHARACTERISTIC
/begin CHARACTERISTIC FKRLXVL "correction factor maximum air charge at full load" VALUE 0x8052237A RB_Val_Wu16 1.200012 fak_uw_b2 0.00 1.200012 FORMAT "%8.6" EXTENDED_LIMITS 0.00 1.999969 /end CHARACTERISTIC
/begin CHARACTERISTIC FlSplG_facFuDens_T "Factor positive gradient of air charge limitation from fuel supply" CURVE 0x8052232A RB_Curve_U8_U8 1.992188 fak_ub_b2 0.00 1.992188 FORMAT "%8.6"
 /begin AXIS_DESCR STD_AXIS tfuelm_msg temp_ub_q0p75_o48 6 -48.0 143.3 FORMAT "%5.1" DEPOSIT ABSOLUTE /end AXIS_DESCR
/end CHARACTERISTIC
/begin CHARACTERISTIC FlSplG_ratAirMChgMaxNeg_C "Maximum negative change allowed for rlmxkv_w in one 10ms-raster" VALUE 0x80522338 RB_Val_Wu16 1535.977 rel_uw_q0p0234 0.00 1535.977 FORMAT "%8.3" /end CHARACTERISTIC
/begin CHARACTERISTIC FlSplG_ratAirMChgMaxPos_C "Maximum positive change allowed for rlmxkv_w in one 10ms-raster." VALUE 0x8052233A RB_Val_Wu16 1535.977 rel_uw_q0p0234 0.00 1535.977 FORMAT "%8.3" /end CHARACTERISTIC
/begin CHARACTERISTIC FPSPULSMN "Factor reduced intake manifold pressure through pulsations is max" VALUE 0x80521FF6 RB_Val_Wu16 1.999969 fak_q3p0518Em5 0.00 1.999969 FORMAT "%8.6" /end CHARACTERISTIC
/begin CHARACTERISTIC FPSPULSMX "Factor: Increased intake manifold pressure due to pulsations" VALUE 0x80521FF8 RB_Val_Wu16 1.999969 fak_q3p0518Em5 0.00 1.999969 FORMAT "%8.6" /end CHARACTERISTIC
/begin CHARACTERISTIC FPVMXP "factor for pressure ratio maximum for load prediction" VALUE 0x8052243E RB_Val_Wu16 1.999969 fak_uw_b2 0.00 1.999969 FORMAT "%8.6" /end CHARACTERISTIC
/begin CHARACTERISTIC FPVMXP2 "factor for pressure ratio maximum for umlimited load predictiion" VALUE 0x80522440 RB_Val_Wu16 1.999969 fak_uw_b2 0.00 1.999969 FORMAT "%8.6" /end CHARACTERISTIC
/begin CHARACTERISTIC FPVMXST "factor for pressure ratio at cranking" VALUE 0x80521FFA RB_Val_Wu16 3.999939 fak_q6p1035Em5 0.00 3.999939 FORMAT "%8.6" /end CHARACTERISTIC
/begin CHARACTERISTIC FRKMK "Factor conversion rk to mk" VALUE 0x8052249E RB_Val_Wu8 0.003984 fak_q1p5625Em5_gdivUdivP 0.00 0.003984 FORMAT "%8.6" /end CHARACTERISTIC
/begin CHARACTERISTIC FRLMNPU "correction factor rlmin depending on altitude" CURVE 0x805221FA RB_Curve_U16_U16 1.999969 fak_q3p0518Em5 0.00 1.999969 FORMAT "%8.6"
 /begin AXIS_DESCR STD_AXIS PEnv_p p_q0p039 5 0.00 2559.961 FORMAT "%8.3" DEPOSIT ABSOLUTE /end AXIS_DESCR
/end CHARACTERISTIC
/begin CHARACTERISTIC FRLMNTMOT "correction factor rlmin depending on engine temperature" CURVE 0x80522210 RB_Curve_S16_U16_Static 1.999969 fak_q3p0518Em5 0.00 1.999969 FORMAT "%8.6"
 /begin AXIS_DESCR STD_AXIS CEngDsT_t Temp_Cels 5 -3549.940 3003.560 FORMAT "%8.3" DEPOSIT ABSOLUTE /end AXIS_DESCR
/end CHARACTERISTIC
/begin CHARACTERISTIC FRLMXKVMX "Factor max. air charge limitation from fuel supply dependent on max. air charge" VALUE 0x8052233C RB_Val_Wu8 0.3046875 fak_ub_b2 0.695313 1.000000 FORMAT "%8.6" EXTENDED_LIMITS 0.00 1.992188 /end CHARACTERISTIC
/begin CHARACTERISTIC FRLMXKVNL "Factor max. air charge limitation from fuel supply dependent on max. air charge during limp home operation" VALUE 0x8052233D RB_Val_Wu8 0.8437500 fak_ub_b2 0.156250 1.000000 FORMAT "%8.6" EXTENDED_LIMITS 0.00 1.992188 /end CHARACTERISTIC
/begin CHARACTERISTIC FTITHDEV "factor body temp." VALUE 0x80522A92 RB_Val_Wu16 1.023984 fak_q1p5625Em5_GradC_mul_min_div_U 0.00 1.023984 FORMAT "%8.6" /end CHARACTERISTIC
/begin CHARACTERISTIC FuPHi_FTIRAIL_T "curve pump control to body temperature" CURVE 0x805224A0 RB_Curve_U16_U16 1.023984 fak_q1p5625Em5_GradC_mul_min_div_U 0.00 1.023984 FORMAT "%8.6"
 /begin AXIS_DESCR STD_AXIS FuPHi_pRail_bgtfuelm_loc RBPtCel_p_0p002_1 10 0.00 131.0700 FORMAT "%8.4" DEPOSIT ABSOLUTE /end AXIS_DESCR
/end CHARACTERISTIC
/begin CHARACTERISTIC FuPHi_pThresRlPDeAirChrgLimn_C "threshold value for aircharge limitation" VALUE 0x8052233E RB_Val_Ws16 131.0700 RBPtCel_p_0p002_1 -65.53600 65.53400 FORMAT "%8.5" /end CHARACTERISTIC
/begin CHARACTERISTIC FuPHi_ratFuMDeltaRstLimn_C "Threshold for reset limitation based on the comparison of rkmxkv_w and rkvmeeff_w" VALUE 0x80522340 RB_Val_Wu16 3071.953 rel_uw_b3072 0.00 3071.953 FORMAT "%8.3" /end CHARACTERISTIC
/begin CHARACTERISTIC FuPHi_tiBattUFil "battery voltage" VALUE 0x80522342 RB_Val_Wu16 3276.7499992 zk50msxs_uw_b3276p8 0.0500008 3276.8000000 FORMAT "%12.7" EXTENDED_LIMITS 0.050000762951 3276.8000000 /end CHARACTERISTIC
/begin CHARACTERISTIC FuPHi_tiRatFuMRstLimn_C "Timer Threshold for reset limitation based on the comparison of rkmxkv_w and rkvmeeff_w" VALUE 0x80522344 RB_Val_Wu8 12.75 t_q0p05 0.00 12.75 FORMAT "%5.2" /end CHARACTERISTIC
/begin CHARACTERISTIC FVBRDIRST "Fact. volume f. input angle to stroke volume of a cylinder" CURVE 0x80521F60 RB_Curve_S16_U16_Static 1.999969 fak_uw_b2 0.00 1.999969 FORMAT "%8.6"
 /begin AXIS_DESCR STD_AXIS wdialwot_w kw_q0p0156 20 -512.0000 511.9844 FORMAT "%8.4" DEPOSIT ABSOLUTE /end AXIS_DESCR
/end CHARACTERISTIC
/begin CHARACTERISTIC KFCLTHDEV "map time constant for lowpass cooling" MAP 0x80522A94 RB_Map_U16U16_U16 13106.80 t_q0p2 0.20 13107.00 FORMAT "%8.2" EXTENDED_LIMITS 0.00 13107.00
 /begin AXIS_DESCR STD_AXIS NO_INPUT_QUANTITY temp_ub_q0p75_o48 8 -48.0000 143.2500 FORMAT "%8.4" EXTENDED_LIMITS -48.00000 49103.25 DEPOSIT ABSOLUTE /end AXIS_DESCR
 /begin AXIS_DESCR STD_AXIS NO_INPUT_QUANTITY temp_ub_q0p75_o48 8 -48.0000 143.2500 FORMAT "%8.4" EXTENDED_LIMITS -48.00000 49103.25 DEPOSIT ABSOLUTE /end AXIS_DESCR
/end CHARACTERISTIC
/begin CHARACTERISTIC KFFUELSHDP "map for time constant lowpass high pressure pump" MAP 0x805224CA RB_Map_U8U16_U16 13106.999997 zk200msxs_uw_b13107p2 0.200003 13107.200000 FORMAT "%12.6" EXTENDED_LIMITS 0.20000305180 13107.200000
 /begin AXIS_DESCR STD_AXIS tflhdp temp_ub_q0p75_o48 8 -48.0 143.3 FORMAT "%5.1" DEPOSIT ABSOLUTE /end AXIS_DESCR
 /begin AXIS_DESCR STD_AXIS tflmass_w_bgtfuelm_loc m_uw_q0p24 8 0.00 15728.40 FORMAT "%8.2" DEPOSIT ABSOLUTE /end AXIS_DESCR
/end CHARACTERISTIC
/begin CHARACTERISTIC KFMKHPTRL "map factor mass flow and engine temperature" MAP 0x80522564 RB_Map_U16U8_U8 1.992188 fak_ub_b2 0.00 1.992188 FORMAT "%8.6"
 /begin AXIS_DESCR STD_AXIS tflmass_w_bgtfuelm_loc m_uw_q0p24 8 0.00 15728.40 FORMAT "%8.2" DEPOSIT ABSOLUTE /end AXIS_DESCR
 /begin AXIS_DESCR STD_AXIS tambtfuel temp_ub_q0p75_o48 8 -48.0 143.3 FORMAT "%5.1" DEPOSIT ABSOLUTE /end AXIS_DESCR
/end CHARACTERISTIC
/begin CHARACTERISTIC KFMTTOSP "map correction waming factor" MAP 0x805225C0 RB_Map_U8U16_U8 3.984 fak_ub_b4 0.00 3.984 FORMAT "%5.3"
 /begin AXIS_DESCR STD_AXIS tfuelhpst temp_ub_q0p75_o48 9 -48.0 143.3 FORMAT "%5.1" DEPOSIT ABSOLUTE /end AXIS_DESCR
 /begin AXIS_DESCR STD_AXIS tnsezmot_w_bgtfuelm_loc t100msxs_uw_b6553p5 8 0.00 6553.500 FORMAT "%8.3" DEPOSIT ABSOLUTE /end AXIS_DESCR
/end CHARACTERISTIC
/begin CHARACTERISTIC KFTCONSTTP "Characteristic table for time constant of lowpass to modell dynamics correction of MAF" MAP 0x8052201E RB_Map_U16U16_U16 1.000000 fak_uw_b2 0.00 1.000000 FORMAT "%8.6" EXTENDED_LIMITS 0.00 1.999969
 /begin AXIS_DESCR STD_AXIS tiseg_w t_q0p0001_s 8 0.00 6.553500 FORMAT "%8.6" DEPOSIT ABSOLUTE /end AXIS_DESCR
 /begin AXIS_DESCR STD_AXIS vpsrvdb_w_msg fak_uw_b2 3 0.00 1.999969 FORMAT "%8.6" DEPOSIT ABSOLUTE /end AXIS_DESCR
/end CHARACTERISTIC
/begin CHARACTERISTIC KFTFLHPMASS "Map fuel mass on high pressure side depending on calculated fuel mass flow and ambient temperature" MAP 0x80522624 RB_Map_U8U16_U8 191.3 temp_ub_q0p75_o48 -48.0 143.3 FORMAT "%5.1"
 /begin AXIS_DESCR STD_AXIS tambtfuel temp_ub_q0p75_o48 7 -48.0 143.3 FORMAT "%5.1" DEPOSIT ABSOLUTE /end AXIS_DESCR
 /begin AXIS_DESCR STD_AXIS tflmass_w_bgtfuelm_loc m_uw_q0p24 7 0.00 15728.40 FORMAT "%8.2" DEPOSIT ABSOLUTE /end AXIS_DESCR
/end CHARACTERISTIC
/begin CHARACTERISTIC KFTFLRL "map itime constant for cooling low pass rail temperature" MAP 0x8052266E RB_Map_U16U16_U16 13106.999997 zk200msxs_uw_b13107p2 0.200003 13107.200000 FORMAT "%12.6" EXTENDED_LIMITS 0.20000305180 13107.200000
 /begin AXIS_DESCR STD_AXIS diffthptk temp_ub_q0p75_o48 8 -48.0000 143.2500 FORMAT "%8.4" EXTENDED_LIMITS -48.00000 49103.25 DEPOSIT ABSOLUTE /end AXIS_DESCR
 /begin AXIS_DESCR STD_AXIS coolhpbas temp_ub_q0p75_o48 8 -48.0000 143.2500 FORMAT "%8.4" EXTENDED_LIMITS -48.00000 49103.25 DEPOSIT ABSOLUTE /end AXIS_DESCR
/end CHARACTERISTIC
/begin CHARACTERISTIC KFTFLTLURL "map influence vehicle speed to fan control" MAP 0x80522712 RB_Map_U8U8_S8 1.992 fak_sb_b1 -1.000 0.992 FORMAT "%5.3" EXTENDED_LIMITS -1.000 0.9922
 /begin AXIS_DESCR STD_AXIS vfzg_bgtfuelm_loc vfzg_ub_q1p25 7 0.00 318.8 FORMAT "%5.1" DEPOSIT ABSOLUTE /end AXIS_DESCR
 /begin AXIS_DESCR STD_AXIS tvlueft_bgtfuelm_loc tv_ub_b100 7 0.00 99.61 FORMAT "%5.2" DEPOSIT ABSOLUTE /end AXIS_DESCR
/end CHARACTERISTIC
/begin CHARACTERISTIC KFTFLTUMRL "map influence vehicle speed to ambient temperature" MAP 0x80522754 RB_Map_U8U8_U8 0.9961 fak_ub_b1 0.00 0.9961
 /begin AXIS_DESCR STD_AXIS vfzg_bgtfuelm_loc vfzg_ub_q1p25 7 0.00 318.8 FORMAT "%5.1" DEPOSIT ABSOLUTE /end AXIS_DESCR
 /begin AXIS_DESCR STD_AXIS tambtfuel temp_ub_q0p75_o48 7 -48.0 143.3 FORMAT "%5.1" DEPOSIT ABSOLUTE /end AXIS_DESCR
/end CHARACTERISTIC
/begin CHARACTERISTIC KFTFSTHDP "map for time constant lowpass body temperature" MAP 0x80522796 RB_Map_U8U16_U16 13106.999997 zk200msxs_uw_b13107p2 0.200003 13107.200000 FORMAT "%12.6" EXTENDED_LIMITS 0.20000305180 13107.200000
 /begin AXIS_DESCR STD_AXIS diffsthdp temp_ub_q0p75_o48 8 -48.0 143.3 FORMAT "%5.1" DEPOSIT ABSOLUTE /end AXIS_DESCR
 /begin AXIS_DESCR STD_AXIS tflmass_w_bgtfuelm_loc m_uw_q0p24 8 0.00 15728.40 FORMAT "%8.2" DEPOSIT ABSOLUTE /end AXIS_DESCR
/end CHARACTERISTIC
/begin CHARACTERISTIC KFTFUELAB "map cool down curve" MAP 0x80522830 RB_Map_U16U8_U8 1.992188 fak_ub_b2 0.00 1.992188 FORMAT "%8.6"
 /begin AXIS_DESCR STD_AXIS tengsq1_w_bgtfuelm_loc t1sxs_uw_q1 8 0.00 65535.00 FORMAT "%8.2" DEPOSIT ABSOLUTE /end AXIS_DESCR
 /begin AXIS_DESCR STD_AXIS tmotab_bgtfuelm_loc temp_ub_q0p75_o48 4 -48.0 143.3 FORMAT "%5.1" DEPOSIT ABSOLUTE /end AXIS_DESCR
/end CHARACTERISTIC
/begin CHARACTERISTIC KFTHDEVST "map start value" MAP 0x80522B38 RB_Map_U16U8_U8 191.3 temp_ub_q0p75_o48 -48.0 143.3 FORMAT "%5.1"
 /begin AXIS_DESCR STD_AXIS InjSys_tiEngoff t1sxs_uw_q1 16 0.00 65535.00 FORMAT "%8.2" DEPOSIT ABSOLUTE /end AXIS_DESCR
 /begin AXIS_DESCR STD_AXIS difftmthdv temp_ub_q0p75_o48 10 -48.0 143.3 FORMAT "%5.1" DEPOSIT ABSOLUTE /end AXIS_DESCR
/end CHARACTERISTIC
/begin CHARACTERISTIC KFTITHDEV "curve for time constant lowpas, body temperature" MAP 0x80522C06 RB_Map_U8U16_U16 13106.80 t_q0p2 0.20 13107.00 FORMAT "%8.2" EXTENDED_LIMITS 0.00 13107.00
 /begin AXIS_DESCR STD_AXIS diffhdevti temp_ub_q0p75_o48 8 -48.0 143.3 FORMAT "%5.1" DEPOSIT ABSOLUTE /end AXIS_DESCR
 /begin AXIS_DESCR STD_AXIS mkroh_w m_uw_q0p24 8 0.00 15728.40 FORMAT "%8.2" DEPOSIT ABSOLUTE /end AXIS_DESCR
/end CHARACTERISTIC
/begin CHARACTERISTIC KFTMOHPTRL "map itime constant for basis low pass rail temperature" MAP 0x80522868 RB_Map_U8U16_U16 13106.999997 zk200msxs_uw_b13107p2 0.200003 13107.200000 FORMAT "%12.6" EXTENDED_LIMITS 0.20000305180 13107.200000
 /begin AXIS_DESCR STD_AXIS tambtfuel temp_ub_q0p75_o48 8 -48.0 143.3 FORMAT "%5.1" DEPOSIT ABSOLUTE /end AXIS_DESCR
 /begin AXIS_DESCR STD_AXIS tflmass_w_bgtfuelm_loc m_uw_q0p24 8 0.00 15728.40 FORMAT "%8.2" DEPOSIT ABSOLUTE /end AXIS_DESCR
/end CHARACTERISTIC
/begin CHARACTERISTIC KFTMOTHDEV "map time const" MAP 0x80522CA0 RB_Map_U8U16_U16 13107.00 t_q0p2 0.00 13107.00 FORMAT "%8.2"
 /begin AXIS_DESCR STD_AXIS thdevredf temp_ub_q0p75_o48 10 -48.0 143.3 FORMAT "%5.1" DEPOSIT ABSOLUTE /end AXIS_DESCR
 /begin AXIS_DESCR STD_AXIS mkroh_w m_uw_q0p24 10 0.00 15728.40 FORMAT "%8.2" DEPOSIT ABSOLUTE /end AXIS_DESCR
/end CHARACTERISTIC
/begin CHARACTERISTIC KFTMOTTOEL "map time constant, engineoil and tanktemperature" MAP 0x80522902 RB_Map_U16U16_U16 13106.999997 zk200msxs_uw_b13107p2 0.200003 13107.200000 FORMAT "%12.6" EXTENDED_LIMITS 0.20000305180 13107.200000
 /begin AXIS_DESCR STD_AXIS tambtfuel temp_ub_q0p75_o48 9 -48.0000 143.2500 FORMAT "%8.4" EXTENDED_LIMITS -48.00000 49103.25 DEPOSIT ABSOLUTE /end AXIS_DESCR
 /begin AXIS_DESCR STD_AXIS tmotred temp_ub_q0p75_o48 9 -48.0000 143.2500 FORMAT "%8.4" EXTENDED_LIMITS -48.00000 49103.25 DEPOSIT ABSOLUTE /end AXIS_DESCR
/end CHARACTERISTIC
/begin CHARACTERISTIC KFTMTHDEV "map engine time to engine temeprature for warming coefficient" MAP 0x80522D88 RB_Map_U8U16_U8 3.984 fak_ub_b4 0.00 3.984 FORMAT "%5.3"
 /begin AXIS_DESCR STD_AXIS InjSys_tStrtFrstHpInjVlv temp_ub_q0p75_o48 9 -48.0 143.3 FORMAT "%5.1" DEPOSIT ABSOLUTE /end AXIS_DESCR
 /begin AXIS_DESCR STD_AXIS tnsezmot_w_msg t100msxs_uw_b6553p5 8 0.00 6553.500 FORMAT "%8.3" DEPOSIT ABSOLUTE /end AXIS_DESCR
/end CHARACTERISTIC
/begin CHARACTERISTIC KFTREDHDEV "map time constant for lowpass REDHDEV" MAP 0x80522DEC RB_Map_U16U16_U16 13106.80 t_q0p2 0.20 13107.00 FORMAT "%8.2" EXTENDED_LIMITS 0.00 13107.00
 /begin AXIS_DESCR STD_AXIS NO_INPUT_QUANTITY temp_ub_q0p75_o48 9 -48.0000 143.2500 FORMAT "%8.4" EXTENDED_LIMITS -48.00000 49103.25 DEPOSIT ABSOLUTE /end AXIS_DESCR
 /begin AXIS_DESCR STD_AXIS NO_INPUT_QUANTITY temp_ub_q0p75_o48 9 -48.0000 143.2500 FORMAT "%8.4" EXTENDED_LIMITS -48.00000 49103.25 DEPOSIT ABSOLUTE /end AXIS_DESCR
/end CHARACTERISTIC
/begin CHARACTERISTIC KFTSRMAB "map for start temperature high pressure pump" MAP 0x805229CC RB_Map_U16U8_U8 1.992188 fak_ub_b2 0.00 1.992188 FORMAT "%8.6"
 /begin AXIS_DESCR STD_AXIS tengsq1_w_bgtfuelm_loc t1sxs_uw_q1 8 0.00 65535.00 FORMAT "%8.2" DEPOSIT ABSOLUTE /end AXIS_DESCR
 /begin AXIS_DESCR STD_AXIS tmotab_bgtfuelm_loc temp_ub_q0p75_o48 4 -48.0 143.3 FORMAT "%5.1" DEPOSIT ABSOLUTE /end AXIS_DESCR
/end CHARACTERISTIC
/begin CHARACTERISTIC KFTUMTHDEV "map ambient temperature to vehicle speed" MAP 0x80522EB6 RB_Map_U8U8_U8 0.9961 fak_ub_b1 0.00 0.9961
 /begin AXIS_DESCR STD_AXIS InjSys_vVehCalcdTHpInjVlv vfzg_ub_q1p25 7 0.00 318.8 FORMAT "%5.1" DEPOSIT ABSOLUTE /end AXIS_DESCR
 /begin AXIS_DESCR STD_AXIS tumthdev temp_ub_q0p75_o48 7 -48.0 143.3 FORMAT "%5.1" DEPOSIT ABSOLUTE /end AXIS_DESCR
/end CHARACTERISTIC
/begin CHARACTERISTIC KFVTFUEL "map influence vfzg" MAP 0x80522A04 RB_Map_U8U8_U8 0.9961 fak_ub_b1 0.00 0.9961
 /begin AXIS_DESCR STD_AXIS vfzg_bgtfuelm_loc vfzg_ub_q1p25 8 0.00 318.8 FORMAT "%5.1" DEPOSIT ABSOLUTE /end AXIS_DESCR
 /begin AXIS_DESCR STD_AXIS tvlueft_bgtfuelm_loc tv_ub_b100 6 0.00 99.61 FORMAT "%5.2" DEPOSIT ABSOLUTE /end AXIS_DESCR
/end CHARACTERISTIC
/begin CHARACTERISTIC KFVTHDEV "map influence vfzg" MAP 0x80522EF8 RB_Map_U8U8_S8 1.992 fak_sb_b1 -1.000 0.992 FORMAT "%5.3" EXTENDED_LIMITS -1.000 0.9922
 /begin AXIS_DESCR STD_AXIS InjSys_vVehCalcdTHpInjVlv vfzg_ub_q1p25 8 0.00 318.8 FORMAT "%5.1" DEPOSIT ABSOLUTE /end AXIS_DESCR
 /begin AXIS_DESCR STD_AXIS tvlueft_msg tv_ub_b100 6 0.00 99.61 FORMAT "%5.2" DEPOSIT ABSOLUTE /end AXIS_DESCR
/end CHARACTERISTIC
/begin CHARACTERISTIC KFZWOPK0 "Optimized model reference ignition angle, 2nd fuel type" MAP 0x80522F6A RB_MapGroup_S16 191.9971 zw_q2p9297Em3_deg_KW -96.00000 95.99707 FORMAT "%8.5"
 /begin AXIS_DESCR COM_AXIS NO_INPUT_QUANTITY nmot_uw_q0p25 16 0.00 16383.75 FORMAT "%8.2" AXIS_PTS_REF SNMOPUW /end AXIS_DESCR
 /begin AXIS_DESCR COM_AXIS NO_INPUT_QUANTITY rel_uw_q0p0234 20 0.00 1535.977 FORMAT "%8.3" AXIS_PTS_REF SRLOPUW /end AXIS_DESCR
/end CHARACTERISTIC
/begin CHARACTERISTIC KFZWOPVK0 "Optimized model reference ignition angle, 2nd fuel type for low lift" MAP 0x805231EA RB_MapGroup_S16 191.9971 zw_q2p9297Em3_deg_KW -96.00000 95.99707 FORMAT "%8.5"
 /begin AXIS_DESCR COM_AXIS NO_INPUT_QUANTITY nmot_uw_q0p25 16 0.00 16383.75 FORMAT "%8.2" AXIS_PTS_REF SNMOVUW /end AXIS_DESCR
 /begin AXIS_DESCR COM_AXIS NO_INPUT_QUANTITY rel_uw_q0p0234 20 0.00 1535.977 FORMAT "%8.3" AXIS_PTS_REF SRLOVUW /end AXIS_DESCR
/end CHARACTERISTIC
/begin CHARACTERISTIC KLF2KA "weighting factor of 2nd fuel - torque" CURVE 0x8052346A RB_Curve_U8_U8 1.000000 fak_ub_b2 0.00 1.000000 FORMAT "%8.6" EXTENDED_LIMITS 0.00 1.992188
 /begin AXIS_DESCR STD_AXIS NO_INPUT_QUANTITY fak_ub_b2 5 0.00 1.000000 FORMAT "%8.6" EXTENDED_LIMITS 0.00 1.992188 DEPOSIT ABSOLUTE /end AXIS_DESCR
/end CHARACTERISTIC
/begin CHARACTERISTIC KLF2KAZW "weighting factor of 2nd fuel - ignition" CURVE 0x80523475 RB_Curve_U8_U8 1.000000 fak_ub_b2 0.00 1.000000 FORMAT "%8.6" EXTENDED_LIMITS 0.00 1.992188
 /begin AXIS_DESCR STD_AXIS NO_INPUT_QUANTITY fak_ub_b2 5 0.00 1.000000 FORMAT "%8.6" EXTENDED_LIMITS 0.00 1.992188 DEPOSIT ABSOLUTE /end AXIS_DESCR
/end CHARACTERISTIC
/begin CHARACTERISTIC KLFETHRLMX "curve to limit maximum air charge based on ethanol concentration factor for flex fuel systems" CURVE 0x8052237C RB_Curve_U16_U8_Static 0.9961 fak_ub_b1 0.00 0.9961
 /begin AXIS_DESCR STD_AXIS FfPrm_facEth fak_uw_b2 5 0.00 1.999969 FORMAT "%8.6" DEPOSIT ABSOLUTE /end AXIS_DESCR
/end CHARACTERISTIC
/begin CHARACTERISTIC KLMKTFUEL "Temperature impact mk on fuel temperature" CURVE 0x80522A44 RB_Curve_U16_U8_Static 191.3 temp_ub_q0p75_o48 -48.0 143.3 FORMAT "%5.1"
 /begin AXIS_DESCR STD_AXIS tflmass_w_bgtfuelm_loc m_uw_q0p24 8 0.00 15728.40 FORMAT "%8.2" DEPOSIT ABSOLUTE /end AXIS_DESCR
/end CHARACTERISTIC
/begin CHARACTERISTIC KLMKTHDEV "tfuel mass influence to HDEV temperature" CURVE 0x80522F38 RB_Curve_U16_U16 0.9999847 fak_uw_b1 0.00 0.9999847 FORMAT "%9.7"
 /begin AXIS_DESCR STD_AXIS mkroh_w m_uw_q0p24 10 0.00 15728.40 FORMAT "%8.2" DEPOSIT ABSOLUTE /end AXIS_DESCR
/end CHARACTERISTIC
/begin CHARACTERISTIC KLMXRLAPIG "maximum air charge limitation to avoid Pre-ignition on low-speed and high-load condition" CURVE 0x8052238E RB_Curve_S16_U16_Static 1535.977 rel_uw_q0p0234 0.00 1535.977 FORMAT "%8.3"
 /begin AXIS_DESCR STD_AXIS NO_INPUT_QUANTITY EngN 10 -16384.00 16383.50 FORMAT "%8.2" DEPOSIT ABSOLUTE /end AXIS_DESCR
/end CHARACTERISTIC
/begin CHARACTERISTIC KLMXRLAPIGFF "maximum air charge limitation to avoid Pre-ignition on low-speed and high-load condition for flexible fuel" CURVE 0x805223B8 RB_Curve_S16_U16_Static 1535.977 rel_uw_q0p0234 0.00 1535.977 FORMAT "%8.3"
 /begin AXIS_DESCR STD_AXIS Epm_nEng EngN 10 -16384.00 16383.50 FORMAT "%8.2" DEPOSIT ABSOLUTE /end AXIS_DESCR
/end CHARACTERISTIC
/begin CHARACTERISTIC KLTANSCRF "Tempetrature correction based on tans" CURVE 0x805223E2 RB_Curve_U8_U16_Static 1.999969 fak_uw_b2 0.00 1.999969 FORMAT "%8.6"
 /begin AXIS_DESCR STD_AXIS tans_msg temp_ub_q0p75_o48 6 -48.0 143.3 FORMAT "%5.1" DEPOSIT ABSOLUTE /end AXIS_DESCR
/end CHARACTERISTIC
/begin CHARACTERISTIC KLTFLTANS "influence of tans to fuel temperature" CURVE 0x80522A5E RB_Curve_U8_U8 0.9961 fak_ub_b1 0.00 0.9961
 /begin AXIS_DESCR STD_AXIS tambtfuellp temp_ub_q0p75_o48 8 -48.0 143.3 FORMAT "%5.1" DEPOSIT ABSOLUTE /end AXIS_DESCR
/end CHARACTERISTIC
/begin CHARACTERISTIC KLTMOTCRF "Tempetrature correction based on tmot" CURVE 0x805223F6 RB_Curve_S16_U16_Static 1.999969 fak_uw_b2 0.00 1.999969 FORMAT "%8.6"
 /begin AXIS_DESCR STD_AXIS CEngDsT_t Temp_Cels 6 -3549.940 3003.560 FORMAT "%8.3" DEPOSIT ABSOLUTE /end AXIS_DESCR
/end CHARACTERISTIC
/begin CHARACTERISTIC KLTUMTFUEL "influence of ambient temperature to fuel mass" CURVE 0x80522A6F RB_Curve_U8_U8 3.984 fak_ub_b4 0.00 3.984 FORMAT "%5.3"
 /begin AXIS_DESCR STD_AXIS tumtfuel temp_ub_q0p75_o48 8 -48.0 143.3 FORMAT "%5.1" DEPOSIT ABSOLUTE /end AXIS_DESCR
/end CHARACTERISTIC
/begin CHARACTERISTIC KLVSKSEKP "Characteristic line Max. flow of low pressure fuel pump in l per h" CURVE 0x80522346 RB_Curve_U16_U16 1638.375 vol_q0p025 0.00 1638.375 FORMAT "%8.3"
 /begin AXIS_DESCR STD_AXIS FlSplG_uAltBatt spg_q0p00039 4 0.00 25.59961 FORMAT "%8.5" DEPOSIT ABSOLUTE /end AXIS_DESCR
/end CHARACTERISTIC
/begin CHARACTERISTIC KLVSKSHDP "Max. flow of high pressure pump in l/h" CURVE 0x80522358 RB_Curve_U16_U16 1638.375 vol_q0p025 0.00 1638.375 FORMAT "%8.3"
 /begin AXIS_DESCR STD_AXIS NO_INPUT_QUANTITY nmot_uw_q0p25 6 0.00 16383.75 FORMAT "%8.2" DEPOSIT ABSOLUTE /end AXIS_DESCR
/end CHARACTERISTIC
/begin CHARACTERISTIC KUMSIRL "conversion constant from mass flow to relative air charge" VALUE 0x80522068 RB_Val_Wu16 0.003999938965 kumsrl_uw_b0p004 0.00 0.003999938965 FORMAT "%14.12" /end CHARACTERISTIC
/begin CHARACTERISTIC NMOTDSTMN "Lower engine speed threshold of the charge cacluation for low kinetic start" VALUE 0x80521FB2 RB_Val_Ws16 32767.50 EngN -16384.00 16383.50 FORMAT "%8.2" /end CHARACTERISTIC
/begin CHARACTERISTIC NMOTDSTMX "Upper engine speed threshold of the charge cacluation for low kinetic start" VALUE 0x80521FB4 RB_Val_Ws16 32767.50 EngN -16384.00 16383.50 FORMAT "%8.2" /end CHARACTERISTIC
/begin CHARACTERISTIC NMOTRLNBKV "treshold for engine speed for rlmin calculation for break booster support" VALUE 0x80522226 RB_Val_Ws16 32767.50 EngN -16384.00 16383.50 FORMAT "%8.2" /end CHARACTERISTIC
/begin CHARACTERISTIC NWEPMMN "Engine speed threshold to switch between crankshaftsignal interfaces" VALUE 0x80521FB6 RB_Val_Wu16 32767.50 EngN 0.00 32767.50 FORMAT "%8.2" /end CHARACTERISTIC
/begin CHARACTERISTIC PSIREXHMN "minimal residual gas partial pressure of ext. EGR HOM-mode" VALUE 0x80521FFC RB_Val_Wu16 5119.922 p_q0p078 0.00 5119.922 FORMAT "%8.3" /end CHARACTERISTIC
/begin CHARACTERISTIC PSIREXHMX "maximal residual gas partial pressure of external EGR HOM-mode" VALUE 0x80521FFE RB_Val_Wu16 5119.922 p_q0p078 0.00 5119.922 FORMAT "%8.3" /end CHARACTERISTIC
/begin CHARACTERISTIC PSLREXHMN "minimal air partial pressure of external EGR HOM-mode" VALUE 0x80522000 RB_Val_Wu16 5119.922 p_q0p078 0.00 5119.922 FORMAT "%8.3" /end CHARACTERISTIC
/begin CHARACTERISTIC PSLREXHMX "maximal air partial pressure of external EGR HOM-mode" VALUE 0x80522002 RB_Val_Wu16 5119.922 p_q0p078 0.00 5119.922 FORMAT "%8.3" /end CHARACTERISTIC
/begin CHARACTERISTIC PSREMN "Min. replacement value for intake manifold pressure" VALUE 0x80522004 RB_Val_Wu16 5119.922 p_q0p078 0.00 5119.922 FORMAT "%8.3" /end CHARACTERISTIC
/begin CHARACTERISTIC PSREMX "Max. replacement value for intake manifold pressure" VALUE 0x80522006 RB_Val_Wu16 5119.922 p_q0p078 0.00 5119.922 FORMAT "%8.3" /end CHARACTERISTIC
/begin CHARACTERISTIC RLMNDSAN "Characteristic minimum charge at deactivated fuel cut-off" CURVE 0x80522228 RB_Curve_S16_U16_Static 1535.977 rel_q0p02344 0.00 1535.977 FORMAT "%8.3"
 /begin AXIS_DESCR STD_AXIS Epm_nEng EngN 12 -16384.00 16383.50 FORMAT "%8.2" DEPOSIT ABSOLUTE /end AXIS_DESCR
/end CHARACTERISTIC
/begin CHARACTERISTIC RLMNN "characteristic minimum charge" CURVE 0x8052225A RB_Curve_S16_U16_Static 1535.977 rel_q0p02344 0.00 1535.977 FORMAT "%8.3"
 /begin AXIS_DESCR STD_AXIS Epm_nEng EngN 12 -16384.00 16383.50 FORMAT "%8.2" DEPOSIT ABSOLUTE /end AXIS_DESCR
/end CHARACTERISTIC
/begin CHARACTERISTIC RLMNSABKV "rlmin for break booster support" VALUE 0x8052228C RB_Val_Wu16 1535.977 rel_q0p02344 0.00 1535.977 FORMAT "%8.3" /end CHARACTERISTIC
/begin CHARACTERISTIC RLMNSAN "characteristic minimum charge in overrun" CURVE 0x8052228E RB_Curve_S16_U16_Static 1535.977 rel_q0p02344 0.00 1535.977 FORMAT "%8.3"
 /begin AXIS_DESCR STD_AXIS Epm_nEng EngN 12 -16384.00 16383.50 FORMAT "%8.2" DEPOSIT ABSOLUTE /end AXIS_DESCR
/end CHARACTERISTIC
/begin CHARACTERISTIC RLMNVHEKN "Characteristic minimum charge(small valve lift)" CURVE 0x805222C0 RB_Curve_S16_U16_Static 1535.977 rel_q0p02344 0.00 1535.977 FORMAT "%8.3"
 /begin AXIS_DESCR STD_AXIS Epm_nEng EngN 12 -16384.00 16383.50 FORMAT "%8.2" DEPOSIT ABSOLUTE /end AXIS_DESCR
/end CHARACTERISTIC
/begin CHARACTERISTIC RLMNVHEKSAN "Characteristic minimum charge in overrun(small valve lift)" CURVE 0x805222F2 RB_Curve_S16_U16_Static 1535.977 rel_q0p02344 0.00 1535.977 FORMAT "%8.3"
 /begin AXIS_DESCR STD_AXIS Epm_nEng EngN 12 -16384.00 16383.50 FORMAT "%8.2" DEPOSIT ABSOLUTE /end AXIS_DESCR
/end CHARACTERISTIC
/begin CHARACTERISTIC RLNOT "limp-home relative air charge rl in case of E_DK and E_LM" CURVE 0x8052206A RB_Curve_U8_U16_Static 1535.977 rel_uw_q0p0234 0.00 1535.977 FORMAT "%8.3"
 /begin AXIS_DESCR STD_AXIS Epm_nEngLRes EngN_LRes 6 0.00 10200. FORMAT "%5.0" DEPOSIT ABSOLUTE /end AXIS_DESCR
/end CHARACTERISTIC
/begin CHARACTERISTIC RLSOLAP "desired relative air charge (application mode)" VALUE 0x80522468 RB_Val_Wu16 1535.977 rel_q0p02344 0.00 1535.977 FORMAT "%8.3" /end CHARACTERISTIC
/begin CHARACTERISTIC RLSOLAPW "rlsol-demand by characteristic line for application" CURVE 0x8052246A RB_Curve_S16_U16_Static 1535.977 rel_q0p02344 0.00 1535.977 FORMAT "%8.3"
 /begin AXIS_DESCR STD_AXIS APP_r Prc 6 -400.0000 399.9878 FORMAT "%8.4" DEPOSIT ABSOLUTE /end AXIS_DESCR
/end CHARACTERISTIC
/begin CHARACTERISTIC RSAGTVDMGX "max. EGR-Rate in intake manifold for modellization of temperature upstream throttle based on measured temperature in intake manifold" VALUE 0x8052248A RB_Val_Wu16 99.99847 rel_uw_b100 0.00 99.99847 FORMAT "%8.5" /end CHARACTERISTIC
/begin CHARACTERISTIC RVBRVL "relative volume of combustion chamber at full load" CURVE 0x80522410 RB_Curve_U8_U16_Static 199.9922 rel_uw_q0p0234 0.00 199.9922 FORMAT "%8.4" EXTENDED_LIMITS 0.00 1535.977
 /begin AXIS_DESCR STD_AXIS Epm_nEngLRes EngN_LRes 12 0.00 10200. FORMAT "%5.0" DEPOSIT ABSOLUTE /end AXIS_DESCR
/end CHARACTERISTIC
/begin AXIS_PTS SNMOPUW "set points engine speed" 0x80589218 NO_INPUT_QUANTITY RB_Axis_U16 16383.75 nmot_uw_q0p25 16 0.00 16383.75 FORMAT "%8.2" DEPOSIT ABSOLUTE /end AXIS_PTS
/begin AXIS_PTS SNMOVUW "set points engine speed for low valve lift" 0x8058923A NO_INPUT_QUANTITY RB_Axis_U16 16383.75 nmot_uw_q0p25 16 0.00 16383.75 FORMAT "%8.2" DEPOSIT ABSOLUTE /end AXIS_PTS
/begin AXIS_PTS SRLOPUW "set point distribution relative charge" 0x8058925C NO_INPUT_QUANTITY RB_Axis_U16 1535.977 rel_uw_q0p0234 20 0.00 1535.977 FORMAT "%8.3" DEPOSIT ABSOLUTE /end AXIS_PTS
/begin AXIS_PTS SRLOVUW "set point distribution relative charge for low valve lift" 0x80589286 NO_INPUT_QUANTITY RB_Axis_U16 1535.977 rel_uw_q0p0234 20 0.00 1535.977 FORMAT "%8.3" DEPOSIT ABSOLUTE /end AXIS_PTS
/begin CHARACTERISTIC TANSHLL "Threshold for tans to recognize a hot idle speed" VALUE 0x8052248F RB_Val_Wu8 191.3 temp_ub_q0p75_o48 -48.0 143.3 FORMAT "%5.1" /end CHARACTERISTIC
/begin CHARACTERISTIC TASRMEW "substitude value for modelled intake manifold temperature" VALUE 0x80522486 RB_Val_Wu16 1535.977 temp_q0p0234_o273 -273.150 1262.827 FORMAT "%8.3" /end CHARACTERISTIC
/begin CHARACTERISTIC TAVDKMEW "substitude value for temperature upstream throttle" VALUE 0x8052248C RB_Val_Wu16 1535.977 temp_q0p0234_o273 -273.150 1262.827 FORMAT "%8.3" /end CHARACTERISTIC
/begin CHARACTERISTIC TDMLST "debounce time fault detection air-mass meter during start" VALUE 0x8052207E RB_Val_Wu16 6553.500 t_q0p1 0.00 6553.500 FORMAT "%8.3" /end CHARACTERISTIC
/begin CHARACTERISTIC TDMWRLSTA "time delay mode change rl-stationary" VALUE 0x80522484 RB_Val_Wu8 5.100 t_q0p02 0.00 5.100 FORMAT "%5.3" /end CHARACTERISTIC
/begin CHARACTERISTIC TDMWRLSTADYN "time delay mode change rl-stationary at dynamic driver demand" VALUE 0x80522485 RB_Val_Wu8 5.100 t_q0p02 0.00 5.100 FORMAT "%5.3" /end CHARACTERISTIC
/begin CHARACTERISTIC TDRLMXEKP "Debouncing time for air charge limitation due to low pressure fuel pump" VALUE 0x80522372 RB_Val_Wu8 12.75 t_q0p05 0.00 12.75 FORMAT "%5.2" /end CHARACTERISTIC
/begin CHARACTERISTIC TDRLMXHDP "Debouncing time for air charge limitation due to high pressure pump" VALUE 0x80522373 RB_Val_Wu8 12.75 t_q0p05 0.00 12.75 FORMAT "%5.2" /end CHARACTERISTIC
/begin CHARACTERISTIC TDRLNBKV "time delay for rlmin for break booster support" VALUE 0x80522324 RB_Val_Wu8 2.550 t_q0p01 0.00 2.550 FORMAT "%5.3" /end CHARACTERISTIC
/begin CHARACTERISTIC TDRLRLPMAX "Debounce time for steady state condition of delta of relative air charge and predicted relative air charge" VALUE 0x80522442 RB_Val_Wu16 655.3500 t_q0p01 0.00 655.3500 FORMAT "%8.4" /end CHARACTERISTIC
/begin CHARACTERISTIC TFDWMSVD "Time constant for lp filter of delivery duration of MSV" VALUE 0x80522374 RB_Val_Wu16 3276.7499992 zk50msxs_uw_b3276p8 0.0500008 3276.8000000 FORMAT "%12.7" EXTENDED_LIMITS 0.050000762951 3276.8000000 /end CHARACTERISTIC
/begin CHARACTERISTIC TFLBSTDE "debounce time B_stend" VALUE 0x80522A80 RB_Val_Wu8 51.00 t_q0p2 0.00 51.00 FORMAT "%5.2" /end CHARACTERISTIC
/begin CHARACTERISTIC TFLHLL "Debouncing time to recognize a hot idle speed" VALUE 0x80522490 RB_Val_Wu16 13107.00 t_q0p2 0.00 13107.00 FORMAT "%8.2" /end CHARACTERISTIC
/begin CHARACTERISTIC TFLQUALI "time period for steady-state" VALUE 0x80522A82 RB_Val_Wu16 13107.00 t_q0p2 0.00 13107.00 FORMAT "%8.2" /end CHARACTERISTIC
/begin CHARACTERISTIC TFLTMOTMN "temperature limit of tmot to influence of vfzg" VALUE 0x80522A84 RB_Val_Wu8 191.3 temp_ub_q0p75_o48 -48.0 143.3 FORMAT "%5.1" /end CHARACTERISTIC
/begin CHARACTERISTIC TFUELE "fix substitude value at error model input value" VALUE 0x80522492 RB_Val_Wu8 191.3 temp_ub_q0p75_o48 -48.0 143.3 FORMAT "%5.1" /end CHARACTERISTIC
/begin CHARACTERISTIC TFUELHLL "Threshold for tfuelhpsq to recognize a hot idle speed" VALUE 0x80522493 RB_Val_Wu8 191.3 temp_ub_q0p75_o48 -48.0 143.3 FORMAT "%5.1" /end CHARACTERISTIC
/begin CHARACTERISTIC TFUELHPE "fix substitude value at error model input value for tfuelhpsq" VALUE 0x80522494 RB_Val_Wu8 191.3 temp_ub_q0p75_o48 -48.0 143.3 FORMAT "%5.1" /end CHARACTERISTIC
/begin CHARACTERISTIC TFUELNOHLL "Threshold to recognize that hot idle speed is no longer present" VALUE 0x80522495 RB_Val_Wu8 191.3 temp_ub_q0p75_o48 -48.0 143.3 FORMAT "%5.1" /end CHARACTERISTIC
/begin CHARACTERISTIC THDEVAPL "application parameter HDEV-temperature" VALUE 0x80522F62 RB_Val_Wu8 191.3 temp_ub_q0p75_o48 -48.0 143.3 FORMAT "%5.1" /end CHARACTERISTIC
/begin CHARACTERISTIC THDEVQUALI "time debounce for model valid" VALUE 0x80522F64 RB_Val_Wu16 13107.00 t_q0p2 0.00 13107.00 FORMAT "%8.2" /end CHARACTERISTIC
/begin CHARACTERISTIC THDEVTMOT "limnit value for warmstart" VALUE 0x80522F66 RB_Val_Wu8 191.3 temp_ub_q0p75_o48 -48.0 143.3 FORMAT "%5.1" /end CHARACTERISTIC
/begin CHARACTERISTIC THDEVTWRM "threshold for cold start" VALUE 0x80522F67 RB_Val_Wu8 191.3 temp_ub_q0p75_o48 -48.0 143.3 FORMAT "%5.1" /end CHARACTERISTIC
/begin CHARACTERISTIC THPMASSTFUEL "lowpass time constant hpmass_LT" VALUE 0x80522A86 RB_Val_Wu16 13106.999997 zk200msxs_uw_b13107p2 0.200003 13107.200000 FORMAT "%12.6" EXTENDED_LIMITS 0.20000305180 13107.200000 /end CHARACTERISTIC
/begin CHARACTERISTIC TMASSTFUEL "lowpass time constant mass_LT" VALUE 0x80522A88 RB_Val_Wu16 13106.999997 zk200msxs_uw_b13107p2 0.200003 13107.200000 FORMAT "%12.6" EXTENDED_LIMITS 0.20000305180 13107.200000 /end CHARACTERISTIC
/begin CHARACTERISTIC TMECmb_facEthCorrn_T "curve for correction of ethanol content for BGTMOHDI" CURVE 0x80523682 RB_Curve_U16_U8_Static 0.9961 fak_ub_b1 0.00 0.9961
 /begin AXIS_DESCR STD_AXIS fethmnmx_w fak_uw_b2 6 0.00 1.999969 FORMAT "%8.6" DEPOSIT ABSOLUTE /end AXIS_DESCR
/end CHARACTERISTIC
/begin CHARACTERISTIC TMECmb_HspMdl0_I.diaRef_M "HSP Model 0 / delte ignition angle" MAP 0x805236B0 RB_Map_S16U16_S16 191.9971 zw_q2p9297Em3_deg_KW -96.00000 95.99707 FORMAT "%8.5"
 /begin AXIS_DESCR STD_AXIS NO_INPUT_QUANTITY EngN 16 -16384.00 16383.50 FORMAT "%8.2" DEPOSIT ABSOLUTE /end AXIS_DESCR
 /begin AXIS_DESCR STD_AXIS NO_INPUT_QUANTITY rel_uw_q0p0234 12 0.00 1535.977 FORMAT "%8.3" DEPOSIT ABSOLUTE /end AXIS_DESCR
/end CHARACTERISTIC
/begin CHARACTERISTIC TMECmb_HspMdl0_I.eta_M "HSP Model 0 / efficiency" MAP 0x8052386C RB_Map_S16U16_U16 1.999969 fak_uw_b2 0.00 1.999969 FORMAT "%8.6"
 /begin AXIS_DESCR STD_AXIS NO_INPUT_QUANTITY EngN 16 -16384.00 16383.50 FORMAT "%8.2" DEPOSIT ABSOLUTE /end AXIS_DESCR
 /begin AXIS_DESCR STD_AXIS NO_INPUT_QUANTITY rel_uw_q0p0234 12 0.00 1535.977 FORMAT "%8.3" DEPOSIT ABSOLUTE /end AXIS_DESCR
/end CHARACTERISTIC
/begin CHARACTERISTIC TMECmb_HspMdl1_I.diaRef_M "HSP model / delte ignition angle" MAP 0x80523DA0 RB_Map_S16U16_S16 191.9971 zw_q2p9297Em3_deg_KW -96.00000 95.99707 FORMAT "%8.5"
 /begin AXIS_DESCR STD_AXIS NO_INPUT_QUANTITY EngN 16 -16384.00 16383.50 FORMAT "%8.2" DEPOSIT ABSOLUTE /end AXIS_DESCR
 /begin AXIS_DESCR STD_AXIS NO_INPUT_QUANTITY rel_uw_q0p0234 12 0.00 1535.977 FORMAT "%8.3" DEPOSIT ABSOLUTE /end AXIS_DESCR
/end CHARACTERISTIC
/begin CHARACTERISTIC TMECmb_HspMdl1_I.eta_M "HSP model / efficiency" MAP 0x80523F5C RB_Map_S16U16_U16 1.999969 fak_uw_b2 0.00 1.999969 FORMAT "%8.6"
 /begin AXIS_DESCR STD_AXIS NO_INPUT_QUANTITY EngN 16 -16384.00 16383.50 FORMAT "%8.2" DEPOSIT ABSOLUTE /end AXIS_DESCR
 /begin AXIS_DESCR STD_AXIS NO_INPUT_QUANTITY rel_uw_q0p0234 12 0.00 1535.977 FORMAT "%8.3" DEPOSIT ABSOLUTE /end AXIS_DESCR
/end CHARACTERISTIC
/begin CHARACTERISTIC TMECmb_HspMdl2_I.diaRef_M "HSP model / delte ignition angle" MAP 0x80524118 RB_Map_S16U16_S16 191.9971 zw_q2p9297Em3_deg_KW -96.00000 95.99707 FORMAT "%8.5"
 /begin AXIS_DESCR STD_AXIS NO_INPUT_QUANTITY EngN 16 -16384.00 16383.50 FORMAT "%8.2" DEPOSIT ABSOLUTE /end AXIS_DESCR
 /begin AXIS_DESCR STD_AXIS NO_INPUT_QUANTITY rel_uw_q0p0234 12 0.00 1535.977 FORMAT "%8.3" DEPOSIT ABSOLUTE /end AXIS_DESCR
/end CHARACTERISTIC
/begin CHARACTERISTIC TMECmb_HspMdl2_I.eta_M "HSP model / efficiency" MAP 0x805242D4 RB_Map_S16U16_U16 1.999969 fak_uw_b2 0.00 1.999969 FORMAT "%8.6"
 /begin AXIS_DESCR STD_AXIS NO_INPUT_QUANTITY EngN 16 -16384.00 16383.50 FORMAT "%8.2" DEPOSIT ABSOLUTE /end AXIS_DESCR
 /begin AXIS_DESCR STD_AXIS NO_INPUT_QUANTITY rel_uw_q0p0234 12 0.00 1535.977 FORMAT "%8.3" DEPOSIT ABSOLUTE /end AXIS_DESCR
/end CHARACTERISTIC
/begin CHARACTERISTIC TMECmb_HspMdlEth0_I.diaRef_M "HSP Modell 0 for flex fuel / delte ignition angle" MAP 0x80523A28 RB_Map_S16U16_S16 191.9971 zw_q2p9297Em3_deg_KW -96.00000 95.99707 FORMAT "%8.5"
 /begin AXIS_DESCR STD_AXIS NO_INPUT_QUANTITY EngN 16 -16384.00 16383.50 FORMAT "%8.2" DEPOSIT ABSOLUTE /end AXIS_DESCR
 /begin AXIS_DESCR STD_AXIS NO_INPUT_QUANTITY rel_uw_q0p0234 12 0.00 1535.977 FORMAT "%8.3" DEPOSIT ABSOLUTE /end AXIS_DESCR
/end CHARACTERISTIC
/begin CHARACTERISTIC TMECmb_HspMdlEth0_I.eta_M "HSP Modell 0 for flex fuel / efficiency" MAP 0x80523BE4 RB_Map_S16U16_U16 1.999969 fak_uw_b2 0.00 1.999969 FORMAT "%8.6"
 /begin AXIS_DESCR STD_AXIS NO_INPUT_QUANTITY EngN 16 -16384.00 16383.50 FORMAT "%8.2" DEPOSIT ABSOLUTE /end AXIS_DESCR
 /begin AXIS_DESCR STD_AXIS NO_INPUT_QUANTITY rel_uw_q0p0234 12 0.00 1535.977 FORMAT "%8.3" DEPOSIT ABSOLUTE /end AXIS_DESCR
/end CHARACTERISTIC
/begin CHARACTERISTIC TMECmb_HspMdlEth1_I.diaRef_M "HSP model ethanol / delte ignition angle" MAP 0x80524490 RB_Map_S16U16_S16 191.9971 zw_q2p9297Em3_deg_KW -96.00000 95.99707 FORMAT "%8.5"
 /begin AXIS_DESCR STD_AXIS NO_INPUT_QUANTITY EngN 16 -16384.00 16383.50 FORMAT "%8.2" DEPOSIT ABSOLUTE /end AXIS_DESCR
 /begin AXIS_DESCR STD_AXIS NO_INPUT_QUANTITY rel_uw_q0p0234 12 0.00 1535.977 FORMAT "%8.3" DEPOSIT ABSOLUTE /end AXIS_DESCR
/end CHARACTERISTIC
/begin CHARACTERISTIC TMECmb_HspMdlEth1_I.eta_M "HSP model ethanol / efficiency" MAP 0x8052464C RB_Map_S16U16_U16 1.999969 fak_uw_b2 0.00 1.999969 FORMAT "%8.6"
 /begin AXIS_DESCR STD_AXIS NO_INPUT_QUANTITY EngN 16 -16384.00 16383.50 FORMAT "%8.2" DEPOSIT ABSOLUTE /end AXIS_DESCR
 /begin AXIS_DESCR STD_AXIS NO_INPUT_QUANTITY rel_uw_q0p0234 12 0.00 1535.977 FORMAT "%8.3" DEPOSIT ABSOLUTE /end AXIS_DESCR
/end CHARACTERISTIC
/begin CHARACTERISTIC TMECmb_HspMdlEth2_I.diaRef_M "HSP model ethanol / delte ignition angle" MAP 0x80524808 RB_Map_S16U16_S16 191.9971 zw_q2p9297Em3_deg_KW -96.00000 95.99707 FORMAT "%8.5"
 /begin AXIS_DESCR STD_AXIS NO_INPUT_QUANTITY EngN 16 -16384.00 16383.50 FORMAT "%8.2" DEPOSIT ABSOLUTE /end AXIS_DESCR
 /begin AXIS_DESCR STD_AXIS NO_INPUT_QUANTITY rel_uw_q0p0234 12 0.00 1535.977 FORMAT "%8.3" DEPOSIT ABSOLUTE /end AXIS_DESCR
/end CHARACTERISTIC
/begin CHARACTERISTIC TMECmb_HspMdlEth2_I.eta_M "HSP model ethanol / efficiency" MAP 0x805249C4 RB_Map_S16U16_U16 1.999969 fak_uw_b2 0.00 1.999969 FORMAT "%8.6"
 /begin AXIS_DESCR STD_AXIS NO_INPUT_QUANTITY EngN 16 -16384.00 16383.50 FORMAT "%8.2" DEPOSIT ABSOLUTE /end AXIS_DESCR
 /begin AXIS_DESCR STD_AXIS NO_INPUT_QUANTITY rel_uw_q0p0234 12 0.00 1535.977 FORMAT "%8.3" DEPOSIT ABSOLUTE /end AXIS_DESCR
/end CHARACTERISTIC
/begin CHARACTERISTIC TMECmb_stEom2CmbMdl_GT "Mapping HSP models to engine operation modes (EOMs)" CURVE 0x80523696 RB_CurveGroup_U8 2.00000000000 TMECmb_HspMdl_Set_COMPU_VERB 0.00 2.00000000000 FORMAT "%13.11"
 /begin AXIS_DESCR COM_AXIS NO_INPUT_QUANTITY CoEOM_stEomStgTot_VERB 26 0.00 7951.00000000 FORMAT "%13.8" AXIS_PTS_REF CoEOM_stEomDesReqd_AX /end AXIS_DESCR
/end CHARACTERISTIC
/begin CHARACTERISTIC TMECmb_TqOptm2Fu_M "optimal torque for 2nd fuel" MAP 0x80523480 RB_Map_S16U16_U16 99.99847 rel_uw_b100 0.00 99.99847 FORMAT "%8.5"
 /begin AXIS_DESCR STD_AXIS Epm_nEng EngN 16 -16384.00 16383.50 FORMAT "%8.2" DEPOSIT ABSOLUTE /end AXIS_DESCR
 /begin AXIS_DESCR STD_AXIS NO_INPUT_QUANTITY rel_uw_q0p0234 14 0.00 1535.977 FORMAT "%8.3" DEPOSIT ABSOLUTE /end AXIS_DESCR
/end CHARACTERISTIC
/begin CHARACTERISTIC TMOTCOLD "threshold for cold start" VALUE 0x80522A8A RB_Val_Wu8 191.3 temp_ub_q0p75_o48 -48.0 143.3 FORMAT "%5.1" /end CHARACTERISTIC
/begin CHARACTERISTIC TMOTHLL "Threshold for tmot to recognize a hot idle speedL" VALUE 0x80522496 RB_Val_Wu8 191.3 temp_ub_q0p75_o48 -48.0 143.3 FORMAT "%5.1" /end CHARACTERISTIC
/begin CHARACTERISTIC TMOTTFMN "temperature limit for coldstart condition" VALUE 0x80522A8B RB_Val_Wu8 191.3 temp_ub_q0p75_o48 -48.0 143.3 FORMAT "%5.1" /end CHARACTERISTIC
/begin CHARACTERISTIC TNMNSRMDK "Time when ambient pressure in manifold" VALUE 0x80522008 RB_Val_Wu16 655.3500 t_q0p01 0.00 655.3500 FORMAT "%8.4" /end CHARACTERISTIC
/begin CHARACTERISTIC TNSTRLMXKV "Time after end of start for enabling air charge limitation from fuel supply" VALUE 0x80522376 RB_Val_Wu16 6553.500 t100msxs_uw_b6553p5 0.00 6553.500 FORMAT "%8.3" /end CHARACTERISTIC
/begin CHARACTERISTIC TNSTUNL "Time after start the release the switch over of the second load signal" VALUE 0x8052200A RB_Val_Wu16 655.3500 t10msxs_uw_b655p35 0.00 655.3500 FORMAT "%8.4" /end CHARACTERISTIC
/begin CHARACTERISTIC TPBRDIWD "filter time constant for combustion chamber pressure at angle for direct start" VALUE 0x80521FB8 RB_Val_Wu16 19.849393787 zk10msxs_uw_b655p36 0.010000153 19.859393939 FORMAT "%12.9" EXTENDED_LIMITS 0.010000152590 655.36000000 /end CHARACTERISTIC
/begin CHARACTERISTIC TPBRDIWEVO "filter time constant for combustion chamber pressure at angle for direct start and open inlet valve" VALUE 0x80521FBA RB_Val_Wu16 655.3400 t_q0p01 0.0100 655.3500 FORMAT "%8.4" EXTENDED_LIMITS 0.00 655.3500 /end CHARACTERISTIC
/begin CHARACTERISTIC TPSRMNXG "Debounce time for switch on the upper and lower intake manifold pressure model psrmmn and psrmmx" VALUE 0x8052200C RB_Val_Wu8 2.550 t_q0p01 0.00 2.550 FORMAT "%5.3" /end CHARACTERISTIC
/begin CHARACTERISTIC TPSRPUFIL "filter time constant for filtering intake manifold pressure to ambient pressure during B_nmin" VALUE 0x8052200E RB_Val_Wu16 655.34999985 zk10msxs_uw_b655p36 0.01000015 655.36000000 FORMAT "%12.8" EXTENDED_LIMITS 0.010000152590 655.36000000 /end CHARACTERISTIC
/begin CHARACTERISTIC TTBRDEVOND "filter time constant for fresh air temperature inside combsution chamber at angle for direct start and open inlet valve during change of position" VALUE 0x80521FBC RB_Val_Wu16 655.3400 t_q0p01 0.0100 655.3500 FORMAT "%8.4" EXTENDED_LIMITS 0.00 655.3500 /end CHARACTERISTIC
/begin CHARACTERISTIC TTBRDIWD "filter time constant for fresh air temperature inside combsution chamber at angle for direct start" VALUE 0x80521FBE RB_Val_Wu16 25.196153694 zk10msxs_uw_b655p36 0.010000153 25.206153846 FORMAT "%12.9" EXTENDED_LIMITS 0.010000152590 655.36000000 /end CHARACTERISTIC
/begin CHARACTERISTIC TTBRDIWEVO "filter time constant for fresh air temperature inside combsution chamber at angle for direct start and open inlet valve" VALUE 0x80521FC0 RB_Val_Wu16 655.3400 t_q0p01 0.0100 655.3500 FORMAT "%8.4" EXTENDED_LIMITS 0.00 655.3500 /end CHARACTERISTIC
/begin CHARACTERISTIC TTMOTTFUEL "time constant for lowpass filter" VALUE 0x80522A8C RB_Val_Wu16 13106.999997 zk200msxs_uw_b13107p2 0.200003 13107.200000 FORMAT "%12.6" EXTENDED_LIMITS 0.20000305180 13107.200000 /end CHARACTERISTIC
/begin CHARACTERISTIC TVCALCHDEV "delay time to recognize engine stop" VALUE 0x80522F68 RB_Val_Wu16 13107.00 t_q0p2 0.00 13107.00 FORMAT "%8.2" /end CHARACTERISTIC
/begin CHARACTERISTIC TVFZGTFUEL "lowpass time constant vfzg_LT" VALUE 0x80522A8E RB_Val_Wu16 13106.999997 zk200msxs_uw_b13107p2 0.200003 13107.200000 FORMAT "%12.6" EXTENDED_LIMITS 0.20000305180 13107.200000 /end CHARACTERISTIC
/begin CHARACTERISTIC TVSKSHLL "Time constant to filter the fuel consumption" VALUE 0x80522498 RB_Val_Wu16 13106.999997 zk200msxs_uw_b13107p2 0.200003 13107.200000 FORMAT "%12.6" EXTENDED_LIMITS 0.20000305180 13107.200000 /end CHARACTERISTIC
/begin CHARACTERISTIC VHUBZYL "combustion chamber volume" VALUE 0x80522010 RB_Val_Wu16 46.00562 vol_q0p702Em3_dm3 0.00 46.00562 FORMAT "%8.5" /end CHARACTERISTIC
/begin CHARACTERISTIC VPPSRMSM "ratio manifold pressure to pressure upstram throttle valve for switch of of extrapolation of modeled manifold prassure" VALUE 0x80522012 RB_Val_Wu16 1.999969 fak_q3p0518Em5 0.00 1.999969 FORMAT "%8.6" /end CHARACTERISTIC
/begin CHARACTERISTIC VPPSRMSMHY "hysteresis for switch off / activation of extrapolation of intake manifold pressure" VALUE 0x80522014 RB_Val_Wu16 1.999969 fak_q3p0518Em5 0.00 1.999969 FORMAT "%8.6" /end CHARACTERISTIC
/begin CHARACTERISTIC VSAUGROHNL "Intake manifold volume without intake manifold switch-over" VALUE 0x80522016 RB_Val_Wu16 46.00491 vol_q0p702Em3_dm3 0.00070 46.00562 FORMAT "%8.5" EXTENDED_LIMITS 0.00 46.00562 /end CHARACTERISTIC
/begin CHARACTERISTIC VSAUGROHR "Intake manifold volume without intake manifold switch-over" VALUE 0x80522018 RB_Val_Wu16 46.00491 vol_q0p702Em3_dm3 0.00070 46.00562 FORMAT "%8.5" EXTENDED_LIMITS 0.00 46.00562 /end CHARACTERISTIC
/begin CHARACTERISTIC VSKSHLL "Threshold for fuel consumption to recognize a hot idle speed" VALUE 0x8052249A RB_Val_Wu16 140.6229 vol_q0p002146 0.00 140.6229 FORMAT "%8.4" /end CHARACTERISTIC
/begin CHARACTERISTIC WDIZMX "Maximum angle threshold of destination cylinder" VALUE 0x80521FC2 RB_Val_Ws16 1439.978 AngleCrS -720.0000 719.9780 FORMAT "%8.4" /end CHARACTERISTIC
/begin CHARACTERISTIC XHKAPPA "curve x^Kappa" CURVE 0x80521FC4 RB_Curve_U16_U16 31.99951 fak_uw_b32 0.00 31.99951 FORMAT "%8.5"
 /begin AXIS_DESCR STD_AXIS fvbreswd_w fak_uw_b8 12 0.00 7.999878 FORMAT "%8.6" DEPOSIT ABSOLUTE /end AXIS_DESCR
/end CHARACTERISTIC
/begin CHARACTERISTIC ZKORFKISRM "correction factor for cylinder volume" VALUE 0x8052201A RB_Val_Wu16 1.999969 fak_q3p0518Em5 0.00 1.999969 FORMAT "%8.6" /end CHARACTERISTIC
/begin CHARACTERISTIC ZTMMBR "time constant, engine temperature for combustion chamber temp. model" VALUE 0x80522488 RB_Val_Wu16 6553.4999985 zk100msxs_uw_b6553 0.1000015 6553.6000000 FORMAT "%12.7" EXTENDED_LIMITS 0.10000152590 6553.6000000 /end CHARACTERISTIC
/begin MEASUREMENT AirMod_agCrksftForCylIntkClsd_MP "Camshaft angle relating to charge TDC for the last cylinder with closed intake valve" SWORD AngleCrS 1 100 -720.0000 719.9780 FORMAT "%8.4" ECU_ADDRESS 0x7000A7FE /end MEASUREMENT
/begin MEASUREMENT AirMod_agCrksftForCylIntkOpen_MP "Camshaft angle relating to charge TDC for the first cylinder with open intake valve" SWORD AngleCrS 1 100 -720.0000 719.9780 FORMAT "%8.4" ECU_ADDRESS 0x7000A7FC /end MEASUREMENT
/begin MEASUREMENT AirMod_agCrksftForCylInvld_MP "Camshaft angle relating to charge TDC for the cylinder leaving the modelling range" SWORD AngleCrS 1 100 -720.0000 719.9780 FORMAT "%8.4" ECU_ADDRESS 0x7000A7FA /end MEASUREMENT
/begin MEASUREMENT AirMod_agCrksftPosnRRS_MP "Current engine position relative to zero point of angle system" SWORD AngleCrS 1 100 -720.0000 719.9780 FORMAT "%8.4" ECU_ADDRESS 0x7000A7F8 /end MEASUREMENT
/begin MEASUREMENT AirMod_agCrksftPosn_MP "Current engine position relative to zero point of angle system" SWORD AngleCrS 1 100 -720.0000 719.9780 FORMAT "%8.4" ECU_ADDRESS 0x7000A7F6 /end MEASUREMENT
/begin MEASUREMENT AirMod_agIntkClsdForCylIntkClsd_MP "Closing angle of intake valve for the last cylinder with closed intake valve" SWORD kw_q0p0156 1 100 -512.0000 511.9844 FORMAT "%8.4" ECU_ADDRESS 0x7000A7F4 /end MEASUREMENT
/begin MEASUREMENT AirMod_agIntkClsdForCylIntkOpen_MP "Closing angle of intake valve for the first cylinder with open intake valve" SWORD kw_q0p0156 1 100 -512.0000 511.9844 FORMAT "%8.4" ECU_ADDRESS 0x7000A7F2 /end MEASUREMENT
/begin MEASUREMENT AirMod_agIntkOpenForCylIntkClsd_MP "Opening angle of intake valve for the last cylinder with closed intake valve" SWORD kw_q0p0156 1 100 -512.0000 511.9844 FORMAT "%8.4" ECU_ADDRESS 0x7000A7F0 /end MEASUREMENT
/begin MEASUREMENT AirMod_agIntkOpenForCylIntkOpen_MP "Opening angle of intake valve for the first cylinder with open intake valve" SWORD kw_q0p0156 1 100 -512.0000 511.9844 FORMAT "%8.4" ECU_ADDRESS 0x7000A7EE /end MEASUREMENT
/begin MEASUREMENT AirMod_cntSegStoppingCyc "counter to calculate number of time the synchro was lost" UBYTE OneToOne 1 100 0.00 255.0 FORMAT "%5.1" ECU_ADDRESS 0x7000314C /end MEASUREMENT
/begin MEASUREMENT AirMod_flgChrgAirCylSpstVld "Validity relative charge of air in the cylinder for start-stop" UBYTE B_TRUE 1 100 0.00 1.00000000000 FORMAT "%13.11" ARRAY_SIZE 4 ECU_ADDRESS 0x70003730 /end MEASUREMENT
/begin MEASUREMENT AirMod_flgLoKinStrtRels "Release air charge determination for low kinetic start functionality" UBYTE B_TRUE 1 100 0.00 1.00000000000 BIT_MASK 0x1 FORMAT "%13.11" ECU_ADDRESS 0x700003F7 /end MEASUREMENT
/begin MEASUREMENT AirMod_nEng_a "Engine speed array" SWORD EngN 1 100 -16384.00 16383.50 FORMAT "%8.2" ARRAY_SIZE 4 ECU_ADDRESS 0x500001BC /end MEASUREMENT
/begin MEASUREMENT AirMod_ratChrgAirCylSpst "Relative charge of air in the cylinder for start-stop" UWORD rel_uw_q0p0234 1 100 0.00 1535.977 FORMAT "%8.3" ARRAY_SIZE 4 ECU_ADDRESS 0x70003990 /end MEASUREMENT
/begin MEASUREMENT anzeshdev "No. of injections of the cylinder which is current in the monitoring window" UBYTE dez 1 100 0.00 255.0 FORMAT "%5.1" ECU_ADDRESS 0x6000F11C /end MEASUREMENT
/begin MEASUREMENT anzesmfhdv "No. of injections of the cylinder which is current in the monitoring window" UBYTE dez 1 100 0.00 255.0 FORMAT "%5.1" ECU_ADDRESS 0x6000F11B /end MEASUREMENT
/begin MEASUREMENT asyndirst "Counter for number of synchros after Start Request (Start/Stop)" UBYTE dez 1 100 0.00 255.0 FORMAT "%5.1" ECU_ADDRESS 0x7000314B /end MEASUREMENT
/begin MEASUREMENT bfzgbkv_w "vehicle acceleration for rlmin calculation BKV" SWORD bfzg_q0p1085069 1 100 -3555.556 3555.447 FORMAT "%8.3" ECU_ADDRESS 0x6000803A /end MEASUREMENT
/begin MEASUREMENT BGRLDIWDEVS0_I.B_dwdilwotX "Calculation of air charge in combustion chamber at closed intake valve for software cylinder 0 / condition: wdirst has changed for more than 2 CA" UBYTE B_TRUE 1 100 0.00 1.00000000000 BIT_MASK 0x1 FORMAT "%13.11" ECU_ADDRESS 0x600031EC /end MEASUREMENT
/begin MEASUREMENT BGRLDIWDEVS0_I.ftabresX_w "Calculation of air charge in combustion chamber at closed intake valve for software cylinder 0 / factor fresh air temperature inside combustion chamber at inlet valve closing" UWORD fak_uw_b2 1 100 0.00 1.999969 FORMAT "%8.6" ECU_ADDRESS 0x600031EE /end MEASUREMENT
/begin MEASUREMENT BGRLDIWDEVS0_I.fvbresX_w "Calculation of air charge in combustion chamber at closed intake valve for software cylinder 0 / factor combustion chamber volume at inlet valve closing" UWORD fak_uw_b2 1 100 0.00 1.999969 FORMAT "%8.6" ECU_ADDRESS 0x600031F0 /end MEASUREMENT
/begin MEASUREMENT BGRLDIWDEVS0_I.fvbreswdX_w "Calculation of air charge in combustion chamber at closed intake valve for software cylinder 0 / factor combustion chamber volume at inlet valve closing to combustion chamber volume at angle for direct start" UWORD fak_uw_b8 1 100 0.00 7.999878 FORMAT "%8.6" ECU_ADDRESS 0x600031F2 /end MEASUREMENT
/begin MEASUREMENT BGRLDIWDEVS0_I.pbradX_w "Calculation of air charge in combustion chamber at closed intake valve for software cylinder 0 / combustion chamber pressure after adiabatic expansion for direct start" UWORD p_q0p3125 1 100 0.00 20479.69 FORMAT "%8.2" ECU_ADDRESS 0x600031F4 /end MEASUREMENT
/begin MEASUREMENT BGRLDIWDEVS0_I.pbrdiwdX_w "Calculation of air charge in combustion chamber at closed intake valve for software cylinder 0 / combustion chamber pressure for calculation of direct start charge" UWORD p_q0p3125 1 100 0.00 20479.69 FORMAT "%8.2" ECU_ADDRESS 0x600031F6 /end MEASUREMENT
/begin MEASUREMENT BGRLDIWDEVS0_I.rldiwdobX_w "Calculation of air charge in combustion chamber at closed intake valve for software cylinder 0 / air charge at angle for direct start without limitation" UWORD rel_uw_q0p0234 1 100 0.00 1535.977 FORMAT "%8.3" ECU_ADDRESS 0x600031F8 /end MEASUREMENT
/begin MEASUREMENT BGRLDIWDEVS0_I.rldiwdxX_w "Calculation of air charge in combustion chamber at closed intake valve for software cylinder 0 / max. air charge at angle for direct start" UWORD rel_uw_q0p0234 1 100 0.00 1535.977 FORMAT "%8.3" ECU_ADDRESS 0x600031FA /end MEASUREMENT
/begin MEASUREMENT BGRLDIWDEVS0_I.tabrdiwdX_w "Calculation of air charge in combustion chamber at closed intake valve for software cylinder 0 / temperature in combustion chamber for calculation of direct start charge" UWORD temp_q0p0234_o273 1 100 -273.150 1262.827 FORMAT "%8.3" ECU_ADDRESS 0x600031FC /end MEASUREMENT
/begin MEASUREMENT BGRLDIWDEVS0_I.tahevadX_w "Calculation of air charge in combustion chamber at closed intake valve for software cylinder 0 / fresh air temperature inside combustion chamber after adiabatic expansion for direct start" UWORD temp_q0p0234_o273 1 100 -273.150 1262.827 FORMAT "%8.3" ECU_ADDRESS 0x600031FE /end MEASUREMENT
/begin MEASUREMENT BGRLDIWDEVS0_I.wdialwotX_w "Calculation of air charge in combustion chamber at closed intake valve for software cylinder 0 / old value of wdilwot_w" SWORD kw_q0p0156 1 100 -512.0000 511.9844 FORMAT "%8.4" ECU_ADDRESS 0x60003200 /end MEASUREMENT
/begin MEASUREMENT BGRLDIWDEVS0_I.BGRLZYL_CL.ftabrX_w "Calculation of air charge in combustion chamber at closed intake valve for software cylinder 0 / Calculation of cylinder air charge from ideal gas equation / factor fresh air temperature inside combustion chamber" UWORD fak_uw_b2 1 100 0.00 1.999969 FORMAT "%8.6" ECU_ADDRESS 0x60003202 /end MEASUREMENT
/begin MEASUREMENT BGRLDIWDEVS0_I.BGRLZYL_CL.fvbrwX_w "Calculation of air charge in combustion chamber at closed intake valve for software cylinder 0 / Calculation of cylinder air charge from ideal gas equation / factor combustion chamber volume" UWORD fak_uw_b2 1 100 0.00 1.999969 FORMAT "%8.6" ECU_ADDRESS 0x60003204 /end MEASUREMENT
/begin MEASUREMENT BGRLDIWDEVS1_I.B_dwdilwotX "Calculation of air charge in combustion chamber at closed intake valve for software cylinder 1 / condition: wdirst has changed for more than 2 CA" UBYTE B_TRUE 1 100 0.00 1.00000000000 BIT_MASK 0x1 FORMAT "%13.11" ECU_ADDRESS 0x600031C8 /end MEASUREMENT
/begin MEASUREMENT BGRLDIWDEVS1_I.ftabresX_w "Calculation of air charge in combustion chamber at closed intake valve for software cylinder 1 / factor fresh air temperature inside combustion chamber at inlet valve closing" UWORD fak_uw_b2 1 100 0.00 1.999969 FORMAT "%8.6" ECU_ADDRESS 0x600031CA /end MEASUREMENT
/begin MEASUREMENT BGRLDIWDEVS1_I.fvbresX_w "Calculation of air charge in combustion chamber at closed intake valve for software cylinder 1 / factor combustion chamber volume at inlet valve closing" UWORD fak_uw_b2 1 100 0.00 1.999969 FORMAT "%8.6" ECU_ADDRESS 0x600031CC /end MEASUREMENT
/begin MEASUREMENT BGRLDIWDEVS1_I.fvbreswdX_w "Calculation of air charge in combustion chamber at closed intake valve for software cylinder 1 / factor combustion chamber volume at inlet valve closing to combustion chamber volume at angle for direct start" UWORD fak_uw_b8 1 100 0.00 7.999878 FORMAT "%8.6" ECU_ADDRESS 0x600031CE /end MEASUREMENT
/begin MEASUREMENT BGRLDIWDEVS1_I.pbradX_w "Calculation of air charge in combustion chamber at closed intake valve for software cylinder 1 / combustion chamber pressure after adiabatic expansion for direct start" UWORD p_q0p3125 1 100 0.00 20479.69 FORMAT "%8.2" ECU_ADDRESS 0x600031D0 /end MEASUREMENT
/begin MEASUREMENT BGRLDIWDEVS1_I.pbrdiwdX_w "Calculation of air charge in combustion chamber at closed intake valve for software cylinder 1 / combustion chamber pressure for calculation of direct start charge" UWORD p_q0p3125 1 100 0.00 20479.69 FORMAT "%8.2" ECU_ADDRESS 0x600031D2 /end MEASUREMENT
/begin MEASUREMENT BGRLDIWDEVS1_I.rldiwdobX_w "Calculation of air charge in combustion chamber at closed intake valve for software cylinder 1 / air charge at angle for direct start without limitation" UWORD rel_uw_q0p0234 1 100 0.00 1535.977 FORMAT "%8.3" ECU_ADDRESS 0x600031D4 /end MEASUREMENT
/begin MEASUREMENT BGRLDIWDEVS1_I.rldiwdxX_w "Calculation of air charge in combustion chamber at closed intake valve for software cylinder 1 / max. air charge at angle for direct start" UWORD rel_uw_q0p0234 1 100 0.00 1535.977 FORMAT "%8.3" ECU_ADDRESS 0x600031D6 /end MEASUREMENT
/begin MEASUREMENT BGRLDIWDEVS1_I.tabrdiwdX_w "Calculation of air charge in combustion chamber at closed intake valve for software cylinder 1 / temperature in combustion chamber for calculation of direct start charge" UWORD temp_q0p0234_o273 1 100 -273.150 1262.827 FORMAT "%8.3" ECU_ADDRESS 0x600031D8 /end MEASUREMENT
/begin MEASUREMENT BGRLDIWDEVS1_I.tahevadX_w "Calculation of air charge in combustion chamber at closed intake valve for software cylinder 1 / fresh air temperature inside combustion chamber after adiabatic expansion for direct start" UWORD temp_q0p0234_o273 1 100 -273.150 1262.827 FORMAT "%8.3" ECU_ADDRESS 0x600031DA /end MEASUREMENT
/begin MEASUREMENT BGRLDIWDEVS1_I.wdialwotX_w "Calculation of air charge in combustion chamber at closed intake valve for software cylinder 1 / old value of wdilwot_w" SWORD kw_q0p0156 1 100 -512.0000 511.9844 FORMAT "%8.4" ECU_ADDRESS 0x600031DC /end MEASUREMENT
/begin MEASUREMENT BGRLDIWDEVS1_I.BGRLZYL_CL.ftabrX_w "Calculation of air charge in combustion chamber at closed intake valve for software cylinder 1 / Calculation of cylinder air charge from ideal gas equation / factor fresh air temperature inside combustion chamber" UWORD fak_uw_b2 1 100 0.00 1.999969 FORMAT "%8.6" ECU_ADDRESS 0x600031DE /end MEASUREMENT
/begin MEASUREMENT BGRLDIWDEVS1_I.BGRLZYL_CL.fvbrwX_w "Calculation of air charge in combustion chamber at closed intake valve for software cylinder 1 / Calculation of cylinder air charge from ideal gas equation / factor combustion chamber volume" UWORD fak_uw_b2 1 100 0.00 1.999969 FORMAT "%8.6" ECU_ADDRESS 0x600031E0 /end MEASUREMENT
/begin MEASUREMENT BGRLDIWDEVS2_I.B_dwdilwotX "Calculation of air charge in combustion chamber at closed intake valve for software cylinder 2 / condition: wdirst has changed for more than 2 CA" UBYTE B_TRUE 1 100 0.00 1.00000000000 BIT_MASK 0x1 FORMAT "%13.11" ECU_ADDRESS 0x600031A4 /end MEASUREMENT
/begin MEASUREMENT BGRLDIWDEVS2_I.ftabresX_w "Calculation of air charge in combustion chamber at closed intake valve for software cylinder 2 / factor fresh air temperature inside combustion chamber at inlet valve closing" UWORD fak_uw_b2 1 100 0.00 1.999969 FORMAT "%8.6" ECU_ADDRESS 0x600031A6 /end MEASUREMENT
/begin MEASUREMENT BGRLDIWDEVS2_I.fvbresX_w "Calculation of air charge in combustion chamber at closed intake valve for software cylinder 2 / factor combustion chamber volume at inlet valve closing" UWORD fak_uw_b2 1 100 0.00 1.999969 FORMAT "%8.6" ECU_ADDRESS 0x600031A8 /end MEASUREMENT
/begin MEASUREMENT BGRLDIWDEVS2_I.fvbreswdX_w "Calculation of air charge in combustion chamber at closed intake valve for software cylinder 2 / factor combustion chamber volume at inlet valve closing to combustion chamber volume at angle for direct start" UWORD fak_uw_b8 1 100 0.00 7.999878 FORMAT "%8.6" ECU_ADDRESS 0x600031AA /end MEASUREMENT
/begin MEASUREMENT BGRLDIWDEVS2_I.pbradX_w "Calculation of air charge in combustion chamber at closed intake valve for software cylinder 2 / combustion chamber pressure after adiabatic expansion for direct start" UWORD p_q0p3125 1 100 0.00 20479.69 FORMAT "%8.2" ECU_ADDRESS 0x600031AC /end MEASUREMENT
/begin MEASUREMENT BGRLDIWDEVS2_I.pbrdiwdX_w "Calculation of air charge in combustion chamber at closed intake valve for software cylinder 2 / combustion chamber pressure for calculation of direct start charge" UWORD p_q0p3125 1 100 0.00 20479.69 FORMAT "%8.2" ECU_ADDRESS 0x600031AE /end MEASUREMENT
/begin MEASUREMENT BGRLDIWDEVS2_I.rldiwdobX_w "Calculation of air charge in combustion chamber at closed intake valve for software cylinder 2 / air charge at angle for direct start without limitation" UWORD rel_uw_q0p0234 1 100 0.00 1535.977 FORMAT "%8.3" ECU_ADDRESS 0x600031B0 /end MEASUREMENT
/begin MEASUREMENT BGRLDIWDEVS2_I.rldiwdxX_w "Calculation of air charge in combustion chamber at closed intake valve for software cylinder 2 / max. air charge at angle for direct start" UWORD rel_uw_q0p0234 1 100 0.00 1535.977 FORMAT "%8.3" ECU_ADDRESS 0x600031B2 /end MEASUREMENT
/begin MEASUREMENT BGRLDIWDEVS2_I.tabrdiwdX_w "Calculation of air charge in combustion chamber at closed intake valve for software cylinder 2 / temperature in combustion chamber for calculation of direct start charge" UWORD temp_q0p0234_o273 1 100 -273.150 1262.827 FORMAT "%8.3" ECU_ADDRESS 0x600031B4 /end MEASUREMENT
/begin MEASUREMENT BGRLDIWDEVS2_I.tahevadX_w "Calculation of air charge in combustion chamber at closed intake valve for software cylinder 2 / fresh air temperature inside combustion chamber after adiabatic expansion for direct start" UWORD temp_q0p0234_o273 1 100 -273.150 1262.827 FORMAT "%8.3" ECU_ADDRESS 0x600031B6 /end MEASUREMENT
/begin MEASUREMENT BGRLDIWDEVS2_I.wdialwotX_w "Calculation of air charge in combustion chamber at closed intake valve for software cylinder 2 / old value of wdilwot_w" SWORD kw_q0p0156 1 100 -512.0000 511.9844 FORMAT "%8.4" ECU_ADDRESS 0x600031B8 /end MEASUREMENT
/begin MEASUREMENT BGRLDIWDEVS2_I.BGRLZYL_CL.ftabrX_w "Calculation of air charge in combustion chamber at closed intake valve for software cylinder 2 / Calculation of cylinder air charge from ideal gas equation / factor fresh air temperature inside combustion chamber" UWORD fak_uw_b2 1 100 0.00 1.999969 FORMAT "%8.6" ECU_ADDRESS 0x600031BA /end MEASUREMENT
/begin MEASUREMENT BGRLDIWDEVS2_I.BGRLZYL_CL.fvbrwX_w "Calculation of air charge in combustion chamber at closed intake valve for software cylinder 2 / Calculation of cylinder air charge from ideal gas equation / factor combustion chamber volume" UWORD fak_uw_b2 1 100 0.00 1.999969 FORMAT "%8.6" ECU_ADDRESS 0x600031BC /end MEASUREMENT
/begin MEASUREMENT BGRLDIWDEVS3_I.B_dwdilwotX "Calculation of air charge in combustion chamber at closed intake valve for software cylinder 3 / condition: wdirst has changed for more than 2 CA" UBYTE B_TRUE 1 100 0.00 1.00000000000 BIT_MASK 0x1 FORMAT "%13.11" ECU_ADDRESS 0x60003180 /end MEASUREMENT
/begin MEASUREMENT BGRLDIWDEVS3_I.ftabresX_w "Calculation of air charge in combustion chamber at closed intake valve for software cylinder 3 / factor fresh air temperature inside combustion chamber at inlet valve closing" UWORD fak_uw_b2 1 100 0.00 1.999969 FORMAT "%8.6" ECU_ADDRESS 0x60003182 /end MEASUREMENT
/begin MEASUREMENT BGRLDIWDEVS3_I.fvbresX_w "Calculation of air charge in combustion chamber at closed intake valve for software cylinder 3 / factor combustion chamber volume at inlet valve closing" UWORD fak_uw_b2 1 100 0.00 1.999969 FORMAT "%8.6" ECU_ADDRESS 0x60003184 /end MEASUREMENT
/begin MEASUREMENT BGRLDIWDEVS3_I.fvbreswdX_w "Calculation of air charge in combustion chamber at closed intake valve for software cylinder 3 / factor combustion chamber volume at inlet valve closing to combustion chamber volume at angle for direct start" UWORD fak_uw_b8 1 100 0.00 7.999878 FORMAT "%8.6" ECU_ADDRESS 0x60003186 /end MEASUREMENT
/begin MEASUREMENT BGRLDIWDEVS3_I.pbradX_w "Calculation of air charge in combustion chamber at closed intake valve for software cylinder 3 / combustion chamber pressure after adiabatic expansion for direct start" UWORD p_q0p3125 1 100 0.00 20479.69 FORMAT "%8.2" ECU_ADDRESS 0x60003188 /end MEASUREMENT
/begin MEASUREMENT BGRLDIWDEVS3_I.pbrdiwdX_w "Calculation of air charge in combustion chamber at closed intake valve for software cylinder 3 / combustion chamber pressure for calculation of direct start charge" UWORD p_q0p3125 1 100 0.00 20479.69 FORMAT "%8.2" ECU_ADDRESS 0x6000318A /end MEASUREMENT
/begin MEASUREMENT BGRLDIWDEVS3_I.rldiwdobX_w "Calculation of air charge in combustion chamber at closed intake valve for software cylinder 3 / air charge at angle for direct start without limitation" UWORD rel_uw_q0p0234 1 100 0.00 1535.977 FORMAT "%8.3" ECU_ADDRESS 0x6000318C /end MEASUREMENT
/begin MEASUREMENT BGRLDIWDEVS3_I.rldiwdxX_w "Calculation of air charge in combustion chamber at closed intake valve for software cylinder 3 / max. air charge at angle for direct start" UWORD rel_uw_q0p0234 1 100 0.00 1535.977 FORMAT "%8.3" ECU_ADDRESS 0x6000318E /end MEASUREMENT
/begin MEASUREMENT BGRLDIWDEVS3_I.tabrdiwdX_w "Calculation of air charge in combustion chamber at closed intake valve for software cylinder 3 / temperature in combustion chamber for calculation of direct start charge" UWORD temp_q0p0234_o273 1 100 -273.150 1262.827 FORMAT "%8.3" ECU_ADDRESS 0x60003190 /end MEASUREMENT
/begin MEASUREMENT BGRLDIWDEVS3_I.tahevadX_w "Calculation of air charge in combustion chamber at closed intake valve for software cylinder 3 / fresh air temperature inside combustion chamber after adiabatic expansion for direct start" UWORD temp_q0p0234_o273 1 100 -273.150 1262.827 FORMAT "%8.3" ECU_ADDRESS 0x60003192 /end MEASUREMENT
/begin MEASUREMENT BGRLDIWDEVS3_I.wdialwotX_w "Calculation of air charge in combustion chamber at closed intake valve for software cylinder 3 / old value of wdilwot_w" SWORD kw_q0p0156 1 100 -512.0000 511.9844 FORMAT "%8.4" ECU_ADDRESS 0x60003194 /end MEASUREMENT
/begin MEASUREMENT BGRLDIWDEVS3_I.BGRLZYL_CL.ftabrX_w "Calculation of air charge in combustion chamber at closed intake valve for software cylinder 3 / Calculation of cylinder air charge from ideal gas equation / factor fresh air temperature inside combustion chamber" UWORD fak_uw_b2 1 100 0.00 1.999969 FORMAT "%8.6" ECU_ADDRESS 0x60003196 /end MEASUREMENT
/begin MEASUREMENT BGRLDIWDEVS3_I.BGRLZYL_CL.fvbrwX_w "Calculation of air charge in combustion chamber at closed intake valve for software cylinder 3 / Calculation of cylinder air charge from ideal gas equation / factor combustion chamber volume" UWORD fak_uw_b2 1 100 0.00 1.999969 FORMAT "%8.6" ECU_ADDRESS 0x60003198 /end MEASUREMENT
/begin MEASUREMENT BGRLZYLDIRST_CL_I.ftabrX_w "Calculation of air charge in combustion chamber by ideal gas equation / factor fresh air temperature inside combustion chamber" UWORD fak_uw_b2 1 100 0.00 1.999969 FORMAT "%8.6" ECU_ADDRESS 0x6000803C /end MEASUREMENT
/begin MEASUREMENT BGRLZYLDIRST_CL_I.fvbrwX_w "Calculation of air charge in combustion chamber by ideal gas equation / factor combustion chamber volume" UWORD fak_uw_b2 1 100 0.00 1.999969 FORMAT "%8.6" ECU_ADDRESS 0x6000803E /end MEASUREMENT
/begin MEASUREMENT BGTHDEV_TOFFV.outbit "Turn Off Delay Variable / Output Bit" UBYTE B_TRUE 1 100 0.00 1.00000000000 BIT_MASK 0x1 FORMAT "%13.11" ECU_ADDRESS 0x6000800C /end MEASUREMENT
/begin MEASUREMENT BGTHDEV_TOFFV.time "Turn Off Delay Variable / Occured Time" UWORD t_q0p2 1 100 0.00 13107.00 FORMAT "%8.2" ECU_ADDRESS 0x6000800E /end MEASUREMENT
/begin MEASUREMENT B_abstgp "Condition soak time calculation is valid and plausible" UBYTE B_TRUE 1 100 0.00 1.00000000000 BIT_MASK 0x1 FORMAT "%13.11" ECU_ADDRESS 0x6000F11D /end MEASUREMENT
/begin MEASUREMENT B_abstgp_msg "Condition soak time calculation is valid and plausible" UBYTE B_TRUE 1 100 0.00 1.00000000000 BIT_MASK 0x1 FORMAT "%13.11" ECU_ADDRESS 0x70000C41 /end MEASUREMENT
/begin MEASUREMENT B_abstnpl "Condition soak time calculation is not plausible" UBYTE B_TRUE 1 100 0.00 1.00000000000 BIT_MASK 0x1 FORMAT "%13.11" ECU_ADDRESS 0x700003EF /end MEASUREMENT
/begin MEASUREMENT B_asyndist "Condition: number of synchros after Start Request (Start/Stop) n=ASYNDIRSTO reached (n injections executed)" UBYTE B_TRUE 1 100 0.00 1.00000000000 BIT_MASK 0x1 FORMAT "%13.11" ECU_ADDRESS 0x700003F6 /end MEASUREMENT
/begin MEASUREMENT B_bfuelpwf "powerfail condition" UBYTE B_TRUE 1 100 0.00 1.00000000000 BIT_MASK 0x1 FORMAT "%13.11" ECU_ADDRESS 0x60000136 /end MEASUREMENT
/begin MEASUREMENT B_bfzgbkv "condition: vehicle deceleration so much that rlmin is needed for BKV" UBYTE B_TRUE 1 100 0.00 1.00000000000 BIT_MASK 0x1 FORMAT "%13.11" ECU_ADDRESS 0x6000F121 /end MEASUREMENT
/begin MEASUREMENT B_calchdev "model in active calculation mode" UBYTE B_TRUE 1 100 0.00 1.00000000000 BIT_MASK 0x1 FORMAT "%13.11" ECU_ADDRESS 0x700003EE /end MEASUREMENT
/begin MEASUREMENT B_coldst "condition cold start" UBYTE B_TRUE 1 100 0.00 1.00000000000 BIT_MASK 0x1 FORMAT "%13.11" ECU_ADDRESS 0x6000012D /end MEASUREMENT
/begin MEASUREMENT B_dirstzyl "Condition cylinder lies in destination range for following start" UBYTE B_TRUE 1 100 0.00 1.00000000000 FORMAT "%13.11" ARRAY_SIZE 4 ECU_ADDRESS 0x6000F12F /end MEASUREMENT
/begin MEASUREMENT B_dizinv "Invalid cylinder air charge due to leaving the modelling range" UBYTE B_TRUE 1 100 0.00 1.00000000000 FORMAT "%13.11" ARRAY_SIZE 4 ECU_ADDRESS 0x6000F12B /end MEASUREMENT
/begin MEASUREMENT B_dmshfmdg_msg "Delta mass flow between compressor and DK through Delta pressure is valid" UBYTE B_TRUE 1 100 0.00 1.00000000000 BIT_MASK 0x1 FORMAT "%13.11" ECU_ADDRESS 0x60000240 /end MEASUREMENT
/begin MEASUREMENT B_dwdilwot "condition: wdirst has changed for more than 2 °CA" UBYTE B_TRUE 1 100 0.00 1.00000000000 BIT_MASK 0x1 FORMAT "%13.11" ECU_ADDRESS 0x700003F5 /end MEASUREMENT
/begin MEASUREMENT B_evodiza "Condition cylinder intake valve open" UBYTE B_TRUE 1 100 0.00 1.00000000000 FORMAT "%13.11" ARRAY_SIZE 4 ECU_ADDRESS 0x6000F127 /end MEASUREMENT
/begin MEASUREMENT B_fupivhegloc "local copy: condition pbrint and fupsrl calculation based on high valve lift" UBYTE B_TRUE 1 100 0.00 1.00000000000 BIT_MASK 0x1 FORMAT "%13.11" ECU_ADDRESS 0x700003F2 /end MEASUREMENT
/begin MEASUREMENT B_inirlda "Condition: general initialization of charge for direct start" UBYTE B_TRUE 1 100 0.00 1.00000000000 BIT_MASK 0x1 FORMAT "%13.11" ECU_ADDRESS 0x700003F4 /end MEASUREMENT
/begin MEASUREMENT B_mdmin_msg "Condition minimal possible indicated torque reached" UBYTE B_TRUE 1 100 0.00 1.00000000000 BIT_MASK 0x1 FORMAT "%13.11" ECU_ADDRESS 0x60000203 /end MEASUREMENT
/begin MEASUREMENT B_msdkhfmgloc "Condition Mass flow at the DK calculated from the sensor signal of the HFM valid (local copy)" UBYTE B_TRUE 1 100 0.00 1.00000000000 BIT_MASK 0x1 FORMAT "%13.11" ECU_ADDRESS 0x700003F1 /end MEASUREMENT
/begin MEASUREMENT B_msdkhfmg_msg "Condition Mass flow at the DK calculated from the sensor signal of the HFM valid" UBYTE B_TRUE 1 100 0.00 1.00000000000 BIT_MASK 0x1 FORMAT "%13.11" ECU_ADDRESS 0x70000B66 /end MEASUREMENT
/begin MEASUREMENT B_mszsdkb_msg "calculation air mass flow throttle based" UBYTE B_TRUE 1 100 0.00 1.00000000000 BIT_MASK 0x1 FORMAT "%13.11" ECU_ADDRESS 0x600001F7 /end MEASUREMENT
/begin MEASUREMENT B_mwrlsta_msg "Condition GDI mode change: air charge at steady state (acknowldegement signal)." UBYTE B_TRUE 1 100 0.00 1.00000000000 BIT_MASK 0x1 FORMAT "%13.11" ECU_ADDRESS 0x600001F5 /end MEASUREMENT
/begin MEASUREMENT B_psrmhg_msg "Condition modeled intake manifold pressure based on MAF (air mass flow sensor) or throttle blade is valid" UBYTE B_TRUE 1 100 0.00 1.00000000000 BIT_MASK 0x1 FORMAT "%13.11" ECU_ADDRESS 0x600001E2 /end MEASUREMENT
/begin MEASUREMENT B_psrmnxg_msg "Condition psrmn/mx valid" UBYTE B_TRUE 1 100 0.00 1.00000000000 BIT_MASK 0x1 FORMAT "%13.11" ECU_ADDRESS 0x600001E1 /end MEASUREMENT
/begin MEASUREMENT B_psrmozdg_msg "condition modelled manifold pressure independent of massflow over throttle blade valid" UBYTE B_TRUE 1 100 0.00 1.00000000000 BIT_MASK 0x1 FORMAT "%13.11" ECU_ADDRESS 0x600001E0 /end MEASUREMENT
/begin MEASUREMENT B_psrmozg_msg "Condition calculation of massflow out of intake manifold valid" UBYTE B_TRUE 1 100 0.00 1.00000000000 BIT_MASK 0x1 FORMAT "%13.11" ECU_ADDRESS 0x600001DF /end MEASUREMENT
/begin MEASUREMENT B_psrmozpnxg_msg "Condition calculation of massflow out of intake manifold for intake manifold pressure diagnosis valid" UBYTE B_TRUE 1 100 0.00 1.00000000000 BIT_MASK 0x1 FORMAT "%13.11" ECU_ADDRESS 0x600001DE /end MEASUREMENT
/begin MEASUREMENT B_psrmpb "Condition: extrapolated intake manifold pressure limited to maximum predicted intake manifold pressure" UBYTE B_TRUE 1 100 0.00 1.00000000000 BIT_MASK 0x1 FORMAT "%13.11" ECU_ADDRESS 0x700003F0 /end MEASUREMENT
/begin MEASUREMENT B_pvdrlseuvheg_msg "Condition desired boost pressurem freezed during switching to high valve lift" UBYTE B_TRUE 1 100 0.00 1.00000000000 BIT_MASK 0x1 FORMAT "%13.11" ECU_ADDRESS 0x600001DD /end MEASUREMENT
/begin MEASUREMENT B_pwfres "condition reset powerfail" UBYTE B_TRUE 1 100 0.00 1.00000000000 BIT_MASK 0x1 FORMAT "%13.11" ECU_ADDRESS 0x6000012C /end MEASUREMENT
/begin MEASUREMENT B_reszyl "Condition: reset of cylinder (for charge calculation for direct start)" UBYTE B_TRUE 1 100 0.00 1.00000000000 FORMAT "%13.11" ARRAY_SIZE 4 ECU_ADDRESS 0x6000F123 /end MEASUREMENT
/begin MEASUREMENT B_rldirsta_msg "condition: charge of corresponding cylinder for direct start valid" UBYTE B_TRUE 1 100 0.00 1.00000000000 FORMAT "%13.11" ARRAY_SIZE 2 ECU_ADDRESS 0x7000372B /end MEASUREMENT
/begin MEASUREMENT B_rlmdsg_msg "Condition rlmds_w_msg valid" UBYTE B_TRUE 1 100 0.00 1.00000000000 BIT_MASK 0x1 FORMAT "%13.11" ECU_ADDRESS 0x600001DB /end MEASUREMENT
/begin MEASUREMENT B_rlmxekp "Condition air charge limitation low pressure fuel pump active" UBYTE B_TRUE 1 100 0.00 1.00000000000 BIT_MASK 0x1 FORMAT "%13.11" ECU_ADDRESS 0x6000F120 /end MEASUREMENT
/begin MEASUREMENT B_rlmxhdev "Condition air charge limitation high pressure injectors active" UBYTE B_TRUE 1 100 0.00 1.00000000000 BIT_MASK 0x1 FORMAT "%13.11" ECU_ADDRESS 0x6000F11F /end MEASUREMENT
/begin MEASUREMENT B_rlmxhdp "Condition air charge limitation high pressure pump active" UBYTE B_TRUE 1 100 0.00 1.00000000000 BIT_MASK 0x1 FORMAT "%13.11" ECU_ADDRESS 0x6000F11E /end MEASUREMENT
/begin MEASUREMENT B_rlsolg_msg "condition: rlsol valid" UBYTE B_TRUE 1 100 0.00 1.00000000000 BIT_MASK 0x1 FORMAT "%13.11" ECU_ADDRESS 0x600001DA /end MEASUREMENT
/begin MEASUREMENT B_rlsrlpxs_msg "condition rlsol = rlpxs" UBYTE B_TRUE 1 100 0.00 1.00000000000 BIT_MASK 0x1 FORMAT "%13.11" ECU_ADDRESS 0x600001D9 /end MEASUREMENT
/begin MEASUREMENT B_ssyn "Condition synchro calculation inhibited" UBYTE B_TRUE 1 100 0.00 1.00000000000 BIT_MASK 0x1 FORMAT "%13.11" ECU_ADDRESS 0x700003F3 /end MEASUREMENT
/begin MEASUREMENT B_stendz_bgtfuelm_loc "condition first end of start in cycle local value BGTFUELM" UBYTE B_TRUE 1 100 0.00 1.00000000000 BIT_MASK 0x1 FORMAT "%13.11" ECU_ADDRESS 0x6000012B /end MEASUREMENT
/begin MEASUREMENT B_stendz_bgtfuel_loc "condition first end of start in cycle local value BGTFUEL" UBYTE B_TRUE 1 100 0.00 1.00000000000 BIT_MASK 0x1 FORMAT "%13.11" ECU_ADDRESS 0x60000135 /end MEASUREMENT
/begin MEASUREMENT B_stend_bgtfuelm_loc "condition end of start local value BGTFUELM" UBYTE B_TRUE 1 100 0.00 1.00000000000 BIT_MASK 0x1 FORMAT "%13.11" ECU_ADDRESS 0x6000012A /end MEASUREMENT
/begin MEASUREMENT B_stend_bgtfuel_loc "condition end of start local value BGTFUEL" UBYTE B_TRUE 1 100 0.00 1.00000000000 BIT_MASK 0x1 FORMAT "%13.11" ECU_ADDRESS 0x60000134 /end MEASUREMENT
/begin MEASUREMENT B_syn2fe_msg "condition 2nd segment in charge determination" UBYTE B_TRUE 1 100 0.00 1.00000000000 BIT_MASK 0x1 FORMAT "%13.11" ECU_ADDRESS 0x70000B1B /end MEASUREMENT
/begin MEASUREMENT B_tasrmg_msg "condition: modelled intake manifold temperature valid" UBYTE B_TRUE 1 100 0.00 1.00000000000 BIT_MASK 0x1 FORMAT "%13.11" ECU_ADDRESS 0x600001CA /end MEASUREMENT
/begin MEASUREMENT B_tavdkmg_msg "Condition: modelled temperature upstream throttle blade is valid" UBYTE B_TRUE 1 100 0.00 1.00000000000 BIT_MASK 0x1 FORMAT "%13.11" ECU_ADDRESS 0x6000F6D7 /end MEASUREMENT
/begin MEASUREMENT B_tengsi_msg "condition: tengsi_l is valid" UBYTE B_TRUE 1 100 0.00 1.00000000000 BIT_MASK 0x1 FORMAT "%13.11" ECU_ADDRESS 0x70000B13 /end MEASUREMENT
/begin MEASUREMENT B_tengsr_bgtfuel_loc "Flag: counters of soak time are reset (local value BGTFUEL)" UBYTE B_TRUE 1 100 0.00 1.00000000000 BIT_MASK 0x1 FORMAT "%13.11" ECU_ADDRESS 0x60000133 /end MEASUREMENT
/begin MEASUREMENT B_tfuelgg_bgtfuel_loc "condition fuel temperature sensor value valid (local value BGTFUEL)" UBYTE B_TRUE 1 100 0.00 1.00000000000 BIT_MASK 0x1 FORMAT "%13.11" ECU_ADDRESS 0x60000132 /end MEASUREMENT
/begin MEASUREMENT B_tfuelgg_msg "condition fuel temperature sensor value valid" UBYTE B_TRUE 1 100 0.00 1.00000000000 BIT_MASK 0x1 FORMAT "%13.11" ECU_ADDRESS 0x600001C8 /end MEASUREMENT
/begin MEASUREMENT B_tfuelg_bgtfuel_loc "condition fuel temperature value valid (sensor- or model value) local value BGTFUEL" UBYTE B_TRUE 1 100 0.00 1.00000000000 BIT_MASK 0x1 FORMAT "%13.11" ECU_ADDRESS 0x60000131 /end MEASUREMENT
/begin MEASUREMENT B_tfuelg_msg "condition fuel temperature value valid (sensor or model value)" UBYTE B_TRUE 1 100 0.00 1.00000000000 BIT_MASK 0x1 FORMAT "%13.11" ECU_ADDRESS 0x600001C9 /end MEASUREMENT
/begin MEASUREMENT B_tfuelhll_bgtfuel_loc "condition hot idling local value BGTFUEL" UBYTE B_TRUE 1 100 0.00 1.00000000000 BIT_MASK 0x1 FORMAT "%13.11" ECU_ADDRESS 0x60000130 /end MEASUREMENT
/begin MEASUREMENT B_tfuelhll_msg "condition hot idling" UBYTE B_TRUE 1 100 0.00 1.00000000000 BIT_MASK 0x1 FORMAT "%13.11" ECU_ADDRESS 0x600001C7 /end MEASUREMENT
/begin MEASUREMENT B_tfuelmc_bgtfuelm_loc "fuel model calculation active local value BGTFUELM" UBYTE B_TRUE 1 100 0.00 1.00000000000 BIT_MASK 0x1 FORMAT "%13.11" ECU_ADDRESS 0x60000129 /end MEASUREMENT
/begin MEASUREMENT B_tfuelmc_bgtfuel_loc "fuel model calculation active local value BGTFUEL" UBYTE B_TRUE 1 100 0.00 1.00000000000 BIT_MASK 0x1 FORMAT "%13.11" ECU_ADDRESS 0x6000012F /end MEASUREMENT
/begin MEASUREMENT B_tfuelmc_msg "fuel model calculation active" UBYTE B_TRUE 1 100 0.00 1.00000000000 BIT_MASK 0x1 FORMAT "%13.11" ECU_ADDRESS 0x600001C6 /end MEASUREMENT
/begin MEASUREMENT B_tfuelmg_bgtfuelm_loc "fuel temperature from model valid local value BGTFUELM" UBYTE B_TRUE 1 100 0.00 1.00000000000 BIT_MASK 0x1 FORMAT "%13.11" ECU_ADDRESS 0x60000128 /end MEASUREMENT
/begin MEASUREMENT B_tfuelmg_bgtfuel_loc "fuel temperature from model valid local value BGTFUEL" UBYTE B_TRUE 1 100 0.00 1.00000000000 BIT_MASK 0x1 FORMAT "%13.11" ECU_ADDRESS 0x6000012E /end MEASUREMENT
/begin MEASUREMENT B_tfuelmg_msg "fuel temperature from model valid" UBYTE B_TRUE 1 100 0.00 1.00000000000 BIT_MASK 0x1 FORMAT "%13.11" ECU_ADDRESS 0x600001C5 /end MEASUREMENT
/begin MEASUREMENT B_tfuelpwf "condition power failure for tfuelm" UBYTE B_TRUE 1 100 0.00 1.00000000000 BIT_MASK 0x1 FORMAT "%13.11" ECU_ADDRESS 0x60036DEF /end MEASUREMENT
/begin MEASUREMENT B_thdevmg_msg "HDEV(High pressure injector) temperature model valid" UBYTE B_TRUE 1 100 0.00 1.00000000000 BIT_MASK 0x1 FORMAT "%13.11" ECU_ADDRESS 0x70000B0E /end MEASUREMENT
/begin MEASUREMENT B_thdevpwf "condition for power failure" UBYTE B_TRUE 1 100 0.00 1.00000000000 BIT_MASK 0x1 FORMAT "%13.11" ECU_ADDRESS 0x60036DEE /end MEASUREMENT
/begin MEASUREMENT B_zwfrlmin_msg "Enable release of ignition angle while rl_w_msg close to rl_min" UBYTE B_TRUE 1 100 0.00 1.00000000000 BIT_MASK 0x1 FORMAT "%13.11" ECU_ADDRESS 0x600001B7 /end MEASUREMENT
/begin MEASUREMENT ChrSet_facCorrnMinChrg "Correction factor for minimum charge calculation depending on pressure and temperature" UWORD fak_q6p1035Em5 1 100 0.00 3.999939 FORMAT "%8.6" ECU_ADDRESS 0x60008030 /end MEASUREMENT
/begin MEASUREMENT ChrSet_facCptProtnMisfExhSys "Factor for Exhaust System Component Protction for Misfire" UWORD fak_uw_b2 1 100 0.00 1.999969 FORMAT "%8.6" ECU_ADDRESS 0x60008024 /end MEASUREMENT
/begin MEASUREMENT ChrSet_facRelAirChrgMinTEngPEnvFuCutOff "factor for rlmin correction (altitude and temerature) during fuel cutoff" UWORD fak_q6p1035Em5 1 100 0.00 3.999939 FORMAT "%8.6" ECU_ADDRESS 0x60008038 /end MEASUREMENT
/begin MEASUREMENT ChrSet_mfActTraDes "Setpoint exhaust masflow" UWORD m_q0p1 1 100 0.00 6553.500 FORMAT "%8.3" ECU_ADDRESS 0x6000161C /end MEASUREMENT
/begin MEASUREMENT ChrSet_ratChrgMeasmtPnt1 "Relative Charge Measurement Point 1" UWORD rel_uw_q0p0234 1 100 0.00 1535.977 FORMAT "%8.3" ECU_ADDRESS 0x60008F98 /end MEASUREMENT
/begin MEASUREMENT ChrSet_ratRelMinAirChrgFuCutOff "Minimum relative air charge during fuel cut off" UWORD rel_q0p02344 1 100 0.00 1535.977 FORMAT "%8.3" ECU_ADDRESS 0x60008036 /end MEASUREMENT
/begin MEASUREMENT coolbasf "filtered cooling influence to rail temperature" UBYTE temp_ub_q0p75_o48 1 100 -48.0 143.3 FORMAT "%5.1" ECU_ADDRESS 0x600010FB /end MEASUREMENT
/begin MEASUREMENT coolhpbas "cooling influence to rail temperature" UBYTE temp_ub_q0p75_o48 1 100 -48.0 143.3 FORMAT "%5.1" ECU_ADDRESS 0x600010FA /end MEASUREMENT
/begin MEASUREMENT diffhdevti "difference between old and actual body temperature" UBYTE temp_ub_q0p75_o48 1 100 -48.0 143.3 FORMAT "%5.1" ECU_ADDRESS 0x6000F11A /end MEASUREMENT
/begin MEASUREMENT diffsthdp "temperature differenz lowpass body temperature" UBYTE temp_ub_q0p75_o48 1 100 -48.0 143.3 FORMAT "%5.1" ECU_ADDRESS 0x600010F9 /end MEASUREMENT
/begin MEASUREMENT diffthptk "difference between rail and tank temperature" UBYTE temp_ub_q0p75_o48 1 100 -48.0 143.3 FORMAT "%5.1" ECU_ADDRESS 0x600010F8 /end MEASUREMENT
/begin MEASUREMENT difftmta "difference tmot - tans" UBYTE temp_ub_q0p75_o48 1 100 -48.0 143.3 FORMAT "%5.1" ECU_ADDRESS 0x600010F7 /end MEASUREMENT
/begin MEASUREMENT difftmthdv "difference between engine and actuatur tempeature at engine shut off" UBYTE temp_ub_q0p75_o48 1 100 -48.0 143.3 FORMAT "%5.1" ECU_ADDRESS 0x6000F119 /end MEASUREMENT
/begin MEASUREMENT dpsfdhfb_w "Delta fresh gas partial pressure in intake manifold from throttle valve and main charge sensor (limited)" SWORD p_sw_q0p078 1 100 -2560.000 2559.922 FORMAT "%8.3" ECU_ADDRESS 0x5000077A /end MEASUREMENT
/begin MEASUREMENT dpsrfdhf_w "Delta fresh gas part.press. in int.manif. from thrott.valve & main charge sens." SWORD p_sw_q0p078 1 100 -2560.000 2559.922 FORMAT "%8.3" ECU_ADDRESS 0x5000077C /end MEASUREMENT
/begin MEASUREMENT dpsrfgk_w "delta fresh air partial pressure in manifold corrected" SWORD p_sw_q0p078 1 100 -2560.000 2559.922 FORMAT "%8.3" ECU_ADDRESS 0x5000077E /end MEASUREMENT
/begin MEASUREMENT dpsrfgmh_w_msg "Delta, fresh-air partial pressure in int.- manifold betw. 2 calc. schedules, HFM" SWORD p_q0p078 1 100 -2560.000 2559.922 FORMAT "%8.3" ECU_ADDRESS 0x5000089C /end MEASUREMENT
/begin MEASUREMENT dpsrfgmp_w_msg "Delta Frischluftpartialdruck im Saugrohr zwischen zwei Rechenrastern beim DSS" SWORD p_q0p078 1 100 -2560.000 2559.922 FORMAT "%8.3" ECU_ADDRESS 0x5000089E /end MEASUREMENT
/begin MEASUREMENT dpsrfmp_w "Delta predicted fresh air partial pressure" SWORD p_sw_q0p078 1 100 -2560.000 2559.922 FORMAT "%8.3" ECU_ADDRESS 0x50000780 /end MEASUREMENT
/begin MEASUREMENT dpsrpps_w "predicted change of manifold pressure" SWORD p_sw_q0p078 1 100 -2560.000 2559.922 FORMAT "%8.3" ECU_ADDRESS 0x50000782 /end MEASUREMENT
/begin MEASUREMENT drlas_w_msg "change of air charge at one combustion cycle" SWORD rel_q0p02344 1 100 -768.0000 767.9766 FORMAT "%8.4" ECU_ADDRESS 0x60000780 /end MEASUREMENT
/begin MEASUREMENT drlp_w_msg "delta predicted load for injection time calculation (word)" SWORD rel_sw_q0p0234 1 100 -768.0000 767.9766 FORMAT "%8.4" ECU_ADDRESS 0x500008A6 /end MEASUREMENT
/begin MEASUREMENT drlrlpmx "used Limit for steady delta of relative air charge and predicted relative air charge from monitoring" UWORD rel_uw_q0p0234 1 100 0.00 767.9766 FORMAT "%8.4" ECU_ADDRESS 0x600005F0 /end MEASUREMENT
/begin MEASUREMENT dzwo2kaloc_w "ignition angle correction depending on 2nd fuel - local copy" SWORD zw_q2p9297Em3_deg_KW 1 100 -96.00000 95.99707 FORMAT "%8.5" ECU_ADDRESS 0x70003130 /end MEASUREMENT
/begin MEASUREMENT dzwo2ka_w_msg "ignition angle correction depending on 2nd fuel" SWORD zw_q2p9297Em3_deg_KW 1 100 -96.00000 95.99707 FORMAT "%8.5" ECU_ADDRESS 0x70003A1C /end MEASUREMENT
/begin MEASUREMENT dzwohsp_w_msg "shift of optimized model reference ignition angle in HSP mode" SWORD zw_q2p9297Em3_deg_KW 1 100 -96.00000 95.99707 FORMAT "%8.5" ECU_ADDRESS 0x70003A1A /end MEASUREMENT
/begin MEASUREMENT EngDa_tiEngOff "Engine off time" SLONG t_q1 1 100 0.00 2147483647.00 FORMAT "%13.2" ECU_ADDRESS 0x6000317C /end MEASUREMENT
/begin MEASUREMENT EngDa_tiEngOn "Engine on time" SLONG TimeEngOn 1 100 0.00 2147483647.00 FORMAT "%13.2" ECU_ADDRESS 0x600037DC /end MEASUREMENT
/begin MEASUREMENT eta2ka_w_msg "actual efficiency of 2nd fuel" UWORD fak_uw_b2 1 100 0.00 1.999969 FORMAT "%8.6" ECU_ADDRESS 0x700037AA /end MEASUREMENT
/begin MEASUREMENT etaaufte_w_msg "efficiency due to split injection" UWORD fak_uw_b2 1 100 0.00 1.999969 FORMAT "%8.6" ECU_ADDRESS 0x700037A8 /end MEASUREMENT
/begin MEASUREMENT f2kaloc "actual weighting factor of 2nd fuel - torque" UWORD fak_uw_b2 1 100 0.00 1.000000 FORMAT "%8.6" ECU_ADDRESS 0x7000312E /end MEASUREMENT
/begin MEASUREMENT f2kazwloc "actual weighting factor of 2nd fuel - ignition" UWORD fak_uw_b2 1 100 0.00 1.000000 FORMAT "%8.6" ECU_ADDRESS 0x7000312C /end MEASUREMENT
/begin MEASUREMENT f2kazw_msg "actual weighting factor of 2nd fuel - ignition" UBYTE fak_ub_b1 1 100 0.00 0.9961 ECU_ADDRESS 0x7000365F /end MEASUREMENT
/begin MEASUREMENT f2ka_msg "actual weighting factor of 2nd fuel - torque" UBYTE fak_ub_b1 1 100 0.00 0.9961 ECU_ADDRESS 0x70003660 /end MEASUREMENT
/begin MEASUREMENT fhorlnws_w "correction factor: altitude for rlsol" UWORD fak_q6p1035Em5 1 100 0.00 3.999939 FORMAT "%8.6" ECU_ADDRESS 0x60001110 /end MEASUREMENT
/begin MEASUREMENT fisrm_w_msg "Factor- integrator intake manifold model" UWORD fak1_q0p000407_hPa_div_percent 1 100 0.00 26.66626 FORMAT "%8.5" ECU_ADDRESS 0x60000CC8 /end MEASUREMENT
/begin MEASUREMENT fkisrm_w_msg "actual valid manifold model integrator constant" UWORD fak_q1p526Em5 1 100 0.00 0.9999847 FORMAT "%9.7" ECU_ADDRESS 0x60000CCE /end MEASUREMENT
/begin MEASUREMENT FlSplG_uAltBatt "Local variable for battery and alternator voltage" UWORD spg_q0p00039 1 100 0.00 25.59961 FORMAT "%8.5" ECU_ADDRESS 0x6000802E /end MEASUREMENT
/begin MEASUREMENT FlSplG_uBattLcy "battery voltage" UWORD spg_q0p00039 1 100 0.00 25.59961 FORMAT "%8.5" ECU_ADDRESS 0x6000802C /end MEASUREMENT
/begin MEASUREMENT frlmntp_w "factor for rlmin correction (altitude and temerature)" UWORD fak_q6p1035Em5 1 100 0.00 3.999939 FORMAT "%8.6" ECU_ADDRESS 0x60008034 /end MEASUREMENT
/begin MEASUREMENT ftabres_w "factor fresh air temperature inside combustion chamber at inlet valve closing" UWORD fak_uw_b2 1 100 0.00 1.999969 FORMAT "%8.6" ECU_ADDRESS 0x60008070 /end MEASUREMENT
/begin MEASUREMENT FUELCALC_TOFFV.outbit "Turn Off Delay Variable / Output Bit" UBYTE B_TRUE 1 100 0.00 1.00000000000 BIT_MASK 0x1 FORMAT "%13.11" ECU_ADDRESS 0x60008008 /end MEASUREMENT
/begin MEASUREMENT FUELCALC_TOFFV.time "Turn Off Delay Variable / Occured Time" UWORD t_q0p2 1 100 0.00 13107.00 FORMAT "%8.2" ECU_ADDRESS 0x6000800A /end MEASUREMENT
/begin MEASUREMENT fuelhpbasf "filtered basis rail temperature" UBYTE temp_ub_q0p75_o48 1 100 -48.0 143.3 FORMAT "%5.1" ECU_ADDRESS 0x600010F6 /end MEASUREMENT
/begin MEASUREMENT FuPHi_pRail_bgtfuelm_loc "Filtered rail pressure real value (absolut pressure) local value" UWORD RBPtCel_p_0p002_1 1 100 0.00 131.0700 FORMAT "%8.4" ECU_ADDRESS 0x600010F4 /end MEASUREMENT
/begin MEASUREMENT fupsrli_w "internal fupsrl: switch to target value during valve lifting (gas exchange valves inlet)" UWORD rel_uw_b0p3 1 100 0.00 0.2999954 FORMAT "%9.7" ECU_ADDRESS 0x50000784 /end MEASUREMENT
/begin MEASUREMENT fupsrlloc_w "local copy: factor system related transformation pressure to load (16-Bit)" UWORD rel_uw_b0p3 1 100 0.00 0.2999954 FORMAT "%9.7" ECU_ADDRESS 0x50005838 /end MEASUREMENT
/begin MEASUREMENT fvbreswd_w "factor combustion chamber volume at inlet valve closing to combustion chamber volume at angle for direct start" UWORD fak_uw_b8 1 100 0.00 7.999878 FORMAT "%8.6" ECU_ADDRESS 0x6000806E /end MEASUREMENT
/begin MEASUREMENT fvbres_w "factor combustion chamber volume at inlet valve closing" UWORD fak_uw_b2 1 100 0.00 1.999969 FORMAT "%8.6" ECU_ADDRESS 0x6000806C /end MEASUREMENT
/begin MEASUREMENT gdrlprlctr "debounce counter for big deviation between rlelative air charge and predicted relative air charge" UBYTE dez 1 100 0.00 255.0 FORMAT "%5.1" ECU_ADDRESS 0x60001112 /end MEASUREMENT
/begin MEASUREMENT grdpssol_w_msg "gradient of the desired manifold pressure (word)" SWORD grd_sw_q0p78 1 100 -25600.00 25599.22 FORMAT "%8.2" ECU_ADDRESS 0x700050AA /end MEASUREMENT
/begin MEASUREMENT InjSys_tEngCooltTStop "engine coolant temperature at engine stop (engine vs coolant)" SWORD Temp_Cels 1 100 -3549.940 3003.560 FORMAT "%8.3" ECU_ADDRESS 0x60008020 /end MEASUREMENT
/begin MEASUREMENT InjSys_tEngTSeln "Engine temperature (engine vs coolant)" SWORD Temp_Cels 1 100 -3549.940 3003.560 FORMAT "%8.3" ECU_ADDRESS 0x6000801E /end MEASUREMENT
/begin MEASUREMENT InjSys_tEngTStrt "engine temperature at first start (engine vs coolant)" SWORD Temp_Cels 1 100 -3549.940 3003.560 FORMAT "%8.3" ECU_ADDRESS 0x6000801C /end MEASUREMENT
/begin MEASUREMENT InjSys_tiEngoff "Local Engine off time" UWORD t1sxs_uw_q1 1 100 0.00 65535.00 FORMAT "%8.2" ECU_ADDRESS 0x6000801A /end MEASUREMENT
/begin MEASUREMENT InjSys_tStrtFrstHpInjVlv "Engine coolant downstream temperature during the first engine start of the driving cycle for calculation of HDEV-temperature" UBYTE temp_ub_q0p75_o48 1 100 -48.0 143.3 FORMAT "%5.1" ECU_ADDRESS 0x6000F118 /end MEASUREMENT
/begin MEASUREMENT InjSys_vVehCalcdTHpInjVlv "Vehicle speed for calculation of HDEV-temperature" UBYTE vfzg_ub_q1p25 1 100 0.00 318.8 FORMAT "%5.1" ECU_ADDRESS 0x6000F117 /end MEASUREMENT
/begin MEASUREMENT izevo "Index cylinder intake valve open" UBYTE OneToOne 1 100 0.00 15.00 FORMAT "%5.2" ECU_ADDRESS 0x7000314A /end MEASUREMENT
/begin MEASUREMENT izevoa "Index cylinder intake valve open (old value)" UBYTE OneToOne 1 100 0.00 15.00 FORMAT "%5.2" ECU_ADDRESS 0x6000F122 /end MEASUREMENT
/begin MEASUREMENT izevs "Index cylinder intake valve closed" UBYTE OneToOne 1 100 0.00 255.0 FORMAT "%5.1" ECU_ADDRESS 0x70003149 /end MEASUREMENT
/begin MEASUREMENT izug "Index cylinder invalid charge" UBYTE OneToOne 1 100 0.00 255.0 FORMAT "%5.1" ECU_ADDRESS 0x70003148 /end MEASUREMENT
/begin MEASUREMENT mkroh_w "calculated fuel mass flow" UWORD m_uw_q0p24 1 100 0.00 15728.40 FORMAT "%8.2" ECU_ADDRESS 0x60008018 /end MEASUREMENT
/begin MEASUREMENT msdkalm_w_msg "Mass flow over throttle (balance with HFM signal)" UWORD m_q0p1 1 100 0.00 6553.500 FORMAT "%8.3" ECU_ADDRESS 0x600015D6 /end MEASUREMENT
/begin MEASUREMENT msdkhfm_w_msg "Mass flow at the DK calculated from the sensor signal of the HFM" UWORD m_q0p1 1 100 0.00 6553.500 FORMAT "%8.3" ECU_ADDRESS 0x600007F6 /end MEASUREMENT
/begin MEASUREMENT nmotalt_w "engine speed one working cylce before" SWORD EngN 1 100 -16384.00 16383.50 FORMAT "%8.2" ECU_ADDRESS 0x5000078E /end MEASUREMENT
/begin MEASUREMENT nmot_bgtfuelm_loc "Engine speed local copy for BGTFUELM" UBYTE nmot_ub_q40 1 100 0.00 10200. FORMAT "%5.0" ECU_ADDRESS 0x600010F2 /end MEASUREMENT
/begin MEASUREMENT omsdhfm_w "Offset MAF dynamics correction from massstream over throttle valve" SWORD m_q0p1 1 100 -3276.800 3276.700 FORMAT "%8.3" ECU_ADDRESS 0x50000790 /end MEASUREMENT
/begin MEASUREMENT pbrad_w "combustion chamber pressure after adiabatic expansion for direct start" UWORD p_q0p3125 1 100 0.00 20479.69 FORMAT "%8.2" ECU_ADDRESS 0x6000806A /end MEASUREMENT
/begin MEASUREMENT pbrdies_w "combustion chamber pressure at ilet valve closing for direct start" UWORD p_uw_q0p078 1 100 0.00 5119.922 FORMAT "%8.3" ECU_ADDRESS 0x60008068 /end MEASUREMENT
/begin MEASUREMENT pbrini_w "combustion chamber pressure from last synchro" UWORD p_uw_q0p078 1 100 0.00 5119.922 FORMAT "%8.3" ARRAY_SIZE 4 ECU_ADDRESS 0x70003140 /end MEASUREMENT
/begin MEASUREMENT pbrintc_w "sum of partial pressure of natural gas + partial pressure (inert gas + air) in combustion compart through internal EGR" UWORD p_q0p078 1 100 0.00 5119.922 FORMAT "%8.3" ECU_ADDRESS 0x50000792 /end MEASUREMENT
/begin MEASUREMENT pbrintloc_w "local copy: Partial pressure (inert gas + air) in combustion compart through internal EGR" UWORD p_q0p039 1 100 0.00 2559.961 FORMAT "%8.3" ECU_ADDRESS 0x5000583A /end MEASUREMENT
/begin MEASUREMENT psrextmh_w "egr pressure (burned gas + air) in manifold caused by extern egr modelled by inflow" UWORD p_q0p078 1 100 0.00 5119.922 FORMAT "%8.3" ECU_ADDRESS 0x50000794 /end MEASUREMENT
/begin MEASUREMENT psrfgmh_w "fresh air partial pressure in intake manifold based on MAF-sensor" UWORD p_q0p078 1 100 0.00 5119.922 FORMAT "%8.3" ECU_ADDRESS 0x50000796 /end MEASUREMENT
/begin MEASUREMENT psrfgmh_w_msg "fresh air partial pressure in intake manifold based on MAF-sensor" UWORD p_q0p078 1 100 0.00 5119.922 FORMAT "%8.3" ECU_ADDRESS 0x50000900 /end MEASUREMENT
/begin MEASUREMENT psrfgmp_w_msg "Fresh-air partial pressure in intake manifold, DSS-based + internal residual gas" UWORD p_q0p078 1 100 0.00 5119.922 FORMAT "%8.3" ECU_ADDRESS 0x50000902 /end MEASUREMENT
/begin MEASUREMENT psrhoms_w_msg "Set intake manifold pressure in homogeneous mode" UWORD p_q0p078 1 100 0.00 5119.922 FORMAT "%8.3" ECU_ADDRESS 0x600015AE /end MEASUREMENT
/begin MEASUREMENT psrizext_w "Inert-gas partial pressure in intake manifold through external EGR modeled by inflow" UWORD p_q0p078 1 100 0.00 5119.922 FORMAT "%8.3" ECU_ADDRESS 0x5000079A /end MEASUREMENT
/begin MEASUREMENT psrlzext_w "Air partial pressure in intake manifold through external EGR modeled by inflow" UWORD p_q0p078 1 100 0.00 5119.922 FORMAT "%8.3" ECU_ADDRESS 0x5000079C /end MEASUREMENT
/begin MEASUREMENT psrmgx_w_msg "maximum threshold for modelled intake manifold pressure" UWORD p_q0p078 1 100 0.00 5119.922 FORMAT "%8.3" ECU_ADDRESS 0x60000818 /end MEASUREMENT
/begin MEASUREMENT psrmhmi_w_msg "with HFM modelled manifold pressure centre of iteration" UWORD p_q0p078 1 100 0.00 5119.922 FORMAT "%8.3" ECU_ADDRESS 0x50000908 /end MEASUREMENT
/begin MEASUREMENT PSRMH_2SYN_I.dpsrfgmh_w "class for psrmh / Delta, fresh-air partial pressure in int.- manifold betw. 2 calc. schedules, HFM" SWORD p_q0p078 1 100 -2560.000 2559.922 FORMAT "%8.3" ECU_ADDRESS 0x50000746 /end MEASUREMENT
/begin MEASUREMENT PSRMH_2SYN_I.dpsrmh_w "class for psrmh / Delta int. manifold pressure between 2 calc. schedules, HFM" SWORD p_q0p078 1 100 -2560.000 2559.922 FORMAT "%8.3" ECU_ADDRESS 0x50000748 /end MEASUREMENT
/begin MEASUREMENT PSRMH_2SYN_I.psrfgmh_w "class for psrmh / fresh air partial pressure in intake manifold based on MAF-sensor" UWORD p_q0p078 1 100 0.00 5119.922 FORMAT "%8.3" ECU_ADDRESS 0x5000074A /end MEASUREMENT
/begin MEASUREMENT PSRMH_2SYN_I.psrmh_w "class for psrmh / with HFM modelled manifold pressure end of segment" UWORD p_q0p078 1 100 0.078 5119.922 FORMAT "%8.3" ECU_ADDRESS 0x5000074C /end MEASUREMENT
/begin MEASUREMENT PSRMH_2SYN_I.psrmhmi_w "class for psrmh / with HFM modelled manifold pressure centre of iteration" UWORD p_q0p078 1 100 0.078 5119.922 FORMAT "%8.3" ECU_ADDRESS 0x5000074E /end MEASUREMENT
/begin MEASUREMENT PSRMH_2SYN_I.rlfsrbrh_w "class for psrmh / relative fresh air charge flowing from intake manifold to combustion chamber" UWORD rel_q0p0234 1 100 0.00 1535.977 FORMAT "%8.3" ECU_ADDRESS 0x50000752 /end MEASUREMENT
/begin MEASUREMENT PSRMH_2SYN_I.INT_PSRX_CL.dpsrmX_w "class for psrmh / Integrator manifold pressure / Delta int. manifold pressure between 2 calc. schedules" SWORD p_q0p078 1 100 -2560.000 2559.922 FORMAT "%8.3" ECU_ADDRESS 0x50000754 /end MEASUREMENT
/begin MEASUREMENT PSRMH_2SYN_I.INT_PSRX_CL.psrmXneu_w "class for psrmh / Integrator manifold pressure / modelled manifold pressure new integrator value (end of segment)" UWORD p_q0p078 1 100 0.00 5119.922 FORMAT "%8.3" ECU_ADDRESS 0x50000756 /end MEASUREMENT
/begin MEASUREMENT psrmh_w "with HFM modelled manifold pressure end of segment" UWORD p_q0p078 1 100 0.078 5119.922 FORMAT "%8.3" ECU_ADDRESS 0x5000079E /end MEASUREMENT
/begin MEASUREMENT psrmh_w_msg "with HFM modelled manifold pressure end of segment" UWORD p_q0p078 1 100 0.00 5119.922 FORMAT "%8.3" ECU_ADDRESS 0x6000081C /end MEASUREMENT
/begin MEASUREMENT PSRMMN_2SYN_I.psrmX_w "class for psrmmn / max manifold pressure from sensor signal wobble check" UWORD p_q0p078 1 100 0.00 5119.922 FORMAT "%8.3" ECU_ADDRESS 0x50000758 /end MEASUREMENT
/begin MEASUREMENT PSRMMN_2SYN_I.rfasrX_w "class for psrmmn / Relative out-flowing charge from SR" UWORD rel_q0p0234 1 100 0.00 1535.977 FORMAT "%8.3" ECU_ADDRESS 0x5000075A /end MEASUREMENT
/begin MEASUREMENT PSRMMN_2SYN_I.rfzsrX_w "class for psrmmn / Relative in-flowing charge from SR" UWORD rel_q0p0234 1 100 0.00 1535.977 FORMAT "%8.3" ECU_ADDRESS 0x5000075C /end MEASUREMENT
/begin MEASUREMENT psrmmn_w_msg "minimum modeled manifold pressure" UWORD p_q0p078 1 100 0.00 5119.922 FORMAT "%8.3" ECU_ADDRESS 0x60000822 /end MEASUREMENT
/begin MEASUREMENT PSRMMX_2SYN_I.psrmX_w "class for psrmmx / max manifold pressure from sensor signal wobble check" UWORD p_q0p078 1 100 0.00 5119.922 FORMAT "%8.3" ECU_ADDRESS 0x50000762 /end MEASUREMENT
/begin MEASUREMENT PSRMMX_2SYN_I.rfasrX_w "class for psrmmx / Relative out-flowing charge from SR" UWORD rel_q0p0234 1 100 0.00 1535.977 FORMAT "%8.3" ECU_ADDRESS 0x50000764 /end MEASUREMENT
/begin MEASUREMENT PSRMMX_2SYN_I.rfzsrX_w "class for psrmmx / Relative in-flowing charge from SR" UWORD rel_q0p0234 1 100 0.00 1535.977 FORMAT "%8.3" ECU_ADDRESS 0x50000766 /end MEASUREMENT
/begin MEASUREMENT psrmmx_w_msg "maximum modeled manifold pressure" UWORD p_q0p078 1 100 0.00 5119.922 FORMAT "%8.3" ECU_ADDRESS 0x60000824 /end MEASUREMENT
/begin MEASUREMENT psrmp_w_msg "extrapolated intake manifold pressure" UWORD p_uw_q0p078 1 100 0.00 5119.922 FORMAT "%8.3" ECU_ADDRESS 0x5000090A /end MEASUREMENT
/begin MEASUREMENT psrpmx_w "maximum predicted intake manifold pressure" UWORD p_uw_q0p078 1 100 0.00 5119.922 FORMAT "%8.3" ECU_ADDRESS 0x500007A0 /end MEASUREMENT
/begin MEASUREMENT psrpsrs_w "Set intake manifold pressure for acutal mode" UWORD p_q0p078 1 100 0.00 5119.922 FORMAT "%8.3" ECU_ADDRESS 0x6000110E /end MEASUREMENT
/begin MEASUREMENT psrpufil_w "intake manifold pressure filtered to ambient pressure during B_nmin" UWORD p_q0p078 1 100 0.00 5119.922 FORMAT "%8.3" ECU_ADDRESS 0x60001114 /end MEASUREMENT
/begin MEASUREMENT psrrext_w_msg "egr pressure (burned gas + air) in manifold caused by extern egr" UWORD p_q0p078 1 100 0.00 5119.922 FORMAT "%8.3" ECU_ADDRESS 0x6000082A /end MEASUREMENT
/begin MEASUREMENT psrrlpnb_w "unlimited pressure for calculation of unlimited predicted charge" UWORD p_uw_q0p078 1 100 0.00 5119.922 FORMAT "%8.3" ECU_ADDRESS 0x500007A2 /end MEASUREMENT
/begin MEASUREMENT psrsldr_w_msg "Set intake manifold preassre for boost preassure" UWORD p_q0p078 1 100 0.00 5119.922 FORMAT "%8.3" ECU_ADDRESS 0x600015A2 /end MEASUREMENT
/begin MEASUREMENT psrsuvhe_w_msg "Set intake manifold pressure after shifting valve lift" UWORD p_q0p078 1 100 0.00 5119.922 FORMAT "%8.3" ECU_ADDRESS 0x600015A0 /end MEASUREMENT
/begin MEASUREMENT psrs_w_msg "Set intake manifold pressure" UWORD p_q0p078 1 100 0.00 5119.922 FORMAT "%8.3" ECU_ADDRESS 0x600015A4 /end MEASUREMENT
/begin MEASUREMENT rfdsorgi_w_msg "Relative total charge, without DSS-based internal residual gas" UWORD rel_q0p0234 1 100 0.00 1535.977 FORMAT "%8.3" ECU_ADDRESS 0x70003766 /end MEASUREMENT
/begin MEASUREMENT rfdsorim_w_msg "Relative total charge, without internal residual gas DSS-based (middle synchro)" UWORD rel_q0p0234 1 100 0.00 1535.977 FORMAT "%8.3" ECU_ADDRESS 0x60000844 /end MEASUREMENT
/begin MEASUREMENT rfextmxi_w_msg "Relative charging over external EGR at pspvdkds = 1" UWORD rel_uw_q0p0234 1 100 0.00 1535.977 FORMAT "%8.3" ECU_ADDRESS 0x60008D2A /end MEASUREMENT
/begin MEASUREMENT rfextmx_w_msg "Relative charging over external EGR at ps/pvdkds = 1" UWORD rel_q0p02344 1 100 0.00 1535.977 FORMAT "%8.3" ECU_ADDRESS 0x60000D20 /end MEASUREMENT
/begin MEASUREMENT rfextugdi_w_msg "Relative charging over external EGR at pspvdkds = 0.95" UWORD rel_q0p02344 1 100 0.00 1535.977 FORMAT "%8.3" ECU_ADDRESS 0x60008D28 /end MEASUREMENT
/begin MEASUREMENT rfextugd_w_msg "Relative charging over external EGR at ps/pvdkds = 0.95" UWORD rel_q0p02344 1 100 0.00 1535.977 FORMAT "%8.3" ECU_ADDRESS 0x60000D22 /end MEASUREMENT
/begin MEASUREMENT rflmorgi_w_msg "Relative total charge, without HFM-based internal residual gas" UWORD rel_q0p0234 1 100 0.00 1535.977 FORMAT "%8.3" ECU_ADDRESS 0x60000848 /end MEASUREMENT
/begin MEASUREMENT rforidmx_w_msg "max. relative charge without internal residual gas depends of throttle blade" UWORD rel_q0p02344 1 100 0.00 1535.977 FORMAT "%8.3" ECU_ADDRESS 0x60000D24 /end MEASUREMENT
/begin MEASUREMENT rforidug_w "relative charage without internal residual gas at pressure ratio 0.95" UWORD rel_q0p02344 1 100 0.00 1535.977 FORMAT "%8.3" ECU_ADDRESS 0x6000110C /end MEASUREMENT
/begin MEASUREMENT rforiemx_w "max. relative charge without internal residual gas depends on EGR" UWORD rel_q0p02344 1 100 0.00 1535.977 FORMAT "%8.3" ECU_ADDRESS 0x60000CB4 /end MEASUREMENT
/begin MEASUREMENT rforieug_w "relative charge without internal residual gas depend on EGR at pressure ratio 0.95" UWORD rel_q0p02344 1 100 0.00 1535.977 FORMAT "%8.3" ECU_ADDRESS 0x60000CB6 /end MEASUREMENT
/begin MEASUREMENT rfreugds_w_msg "relative desired charge at EGR at pressure ratio 0.95" UWORD rel_q0p02344 1 100 0.00 1535.977 FORMAT "%8.3" ECU_ADDRESS 0x60001592 /end MEASUREMENT
/begin MEASUREMENT rfrext_w_msg "Relative charging (inert gas + air) over external EGR" UWORD rel_q0p0234 1 100 0.00 1535.977 FORMAT "%8.3" ECU_ADDRESS 0x50000914 /end MEASUREMENT
/begin MEASUREMENT rfzumxtx_w_msg "Maximal flow into the combustion chamber for max. boundary model" UWORD rel_q0p02344 1 100 0.00 1535.977 FORMAT "%8.3" ECU_ADDRESS 0x60001588 /end MEASUREMENT
/begin MEASUREMENT rfzuugpn_w_msg "Unthrottled flow into the combustion chamber for max. boundary model" UWORD rel_q0p02344 1 100 0.00 1535.977 FORMAT "%8.3" ECU_ADDRESS 0x60001586 /end MEASUREMENT
/begin MEASUREMENT rfzuugtn_w_msg "Unthrottled flow into the combustion chamber for min. boundary model" UWORD rel_q0p02344 1 100 0.00 1535.977 FORMAT "%8.3" ECU_ADDRESS 0x60001584 /end MEASUREMENT
/begin MEASUREMENT rfzuugtx_w_msg "Maximal flow into the combustion chamber for min. boundary model (pressure sensor based charge determination)" UWORD rel_q0p02344 1 100 0.00 1535.977 FORMAT "%8.3" ECU_ADDRESS 0x60001582 /end MEASUREMENT
/begin MEASUREMENT rirextmh_w "Relative inert-gas charge from external EGR modelled by inflow" UWORD rel_q0p0234 1 100 0.00 1535.977 FORMAT "%8.3" ECU_ADDRESS 0x500007A4 /end MEASUREMENT
/begin MEASUREMENT rirext_w_msg "Relative inert-gas charge from external EGR" UWORD rel_q0p0234 1 100 0.00 1535.977 FORMAT "%8.3" ECU_ADDRESS 0x60000852 /end MEASUREMENT
/begin MEASUREMENT rkmxkv_w "Min. relative fuel mass among EKP,HDP,HDEV pumps" UWORD rel_uw_b3072 1 100 0.00 3071.953 FORMAT "%8.3" ECU_ADDRESS 0x6000802A /end MEASUREMENT
/begin MEASUREMENT rkvmeeff_w_bgtfuelm_loc "Mean value of effective relative (incl. real cylinder cut-off step) volumetric injected fuel mass between two banks (STERVK) local value BGTFUELM" UWORD rel_uw_b3072 1 100 0.00 3071.953 FORMAT "%8.3" ECU_ADDRESS 0x600010F0 /end MEASUREMENT
/begin MEASUREMENT rkvmxekp_w "Max. relative fuel mass of low pressure fuel pump" UWORD rel_uw_b3072 1 100 0.00 3071.953 FORMAT "%8.3" ECU_ADDRESS 0x60008028 /end MEASUREMENT
/begin MEASUREMENT rkvmxhdp_w "Max. relative fuel mass of high pressure pump" UWORD rel_uw_b3072 1 100 0.00 3071.953 FORMAT "%8.3" ECU_ADDRESS 0x60008026 /end MEASUREMENT
/begin MEASUREMENT rlaltas_w "air charge for air charge gradient one combust. cycle before" UWORD rel_uw_q0p0234 1 100 0.00 1535.977 FORMAT "%8.3" ECU_ADDRESS 0x70003136 /end MEASUREMENT
/begin MEASUREMENT rldiesl_w "limited charge of cylinder for direct start with open inlet valve" UWORD rel_uw_q0p0234 1 100 0.00 1535.977 FORMAT "%8.3" ECU_ADDRESS 0x60008066 /end MEASUREMENT
/begin MEASUREMENT rldies_w "air charge for direct start at inlet valve closing" UWORD rel_uw_q0p0234 1 100 0.00 1535.977 FORMAT "%8.3" ECU_ADDRESS 0x60008064 /end MEASUREMENT
/begin MEASUREMENT rldipifu_w "air charge for direct start based on ambient pressure, pbrint and fupsrl" UWORD rel_uw_q0p0234 1 100 0.00 1535.977 FORMAT "%8.3" ECU_ADDRESS 0x60008062 /end MEASUREMENT
/begin MEASUREMENT rldirsta_w_msg "air charge for direct start array" UWORD rel_uw_q0p0234 1 100 0.00 1535.977 FORMAT "%8.3" ARRAY_SIZE 2 ECU_ADDRESS 0x7000375E /end MEASUREMENT
/begin MEASUREMENT rldiwdx1_w "max. air charge at angle for direct start (cylinder 1)" UWORD rel_uw_q0p0234 1 100 0.00 1535.977 FORMAT "%8.3" ECU_ADDRESS 0x60008060 /end MEASUREMENT
/begin MEASUREMENT rldiwd_w "air charge at angle for direct start" UWORD rel_uw_q0p0234 1 100 0.00 1535.977 FORMAT "%8.3" ARRAY_SIZE 4 ECU_ADDRESS 0x60008058 /end MEASUREMENT
/begin MEASUREMENT rldiwob1_w "air charge at angle for direct start without limitation (cylinder 1)" UWORD rel_uw_q0p0234 1 100 0.00 1535.977 FORMAT "%8.3" ECU_ADDRESS 0x60008056 /end MEASUREMENT
/begin MEASUREMENT rldkmx_w_msg "relative air charge through throttle valve at pspvdkds = 1" UWORD rel_q0p02344 1 100 0.00 1535.977 FORMAT "%8.3" ECU_ADDRESS 0x60001578 /end MEASUREMENT
/begin MEASUREMENT rldkugd_w_msg "relative air charge through throttle valve at ps/pvdkds = 0.95" UWORD rel_q0p02344 1 100 0.00 1535.977 FORMAT "%8.3" ECU_ADDRESS 0x60001576 /end MEASUREMENT
/begin MEASUREMENT rlfdkrohloc_w "rel. fresh air over throttle blade (unfilterd) measured by throttle blade (local copy)" UWORD rel_uw_q0p0234 1 100 0.00 1535.977 FORMAT "%8.3" ECU_ADDRESS 0x500007A6 /end MEASUREMENT
/begin MEASUREMENT rlfdkroh_w_msg "rel. fresh air over throttle blade (unfilterd) measured by throttle blade" UWORD rel_uw_q0p0234 1 100 0.00 1535.977 FORMAT "%8.3" ECU_ADDRESS 0x50000920 /end MEASUREMENT
/begin MEASUREMENT rlfgdssm_w_msg "Relative fresh air (air over DK and TEV), DSS-based (middle synchro)" UWORD rel_q0p0234 1 100 0.00 1535.977 FORMAT "%8.3" ECU_ADDRESS 0x50000926 /end MEASUREMENT
/begin MEASUREMENT rlfgds_w_msg "Relative fresh air (air over DK and TEV), DSS-based" UWORD rel_q0p0234 1 100 0.00 1535.977 FORMAT "%8.3" ECU_ADDRESS 0x50000924 /end MEASUREMENT
/begin MEASUREMENT rlfglm_w_msg "Relative fresh air (air over DK and TEV), HFM-based" UWORD rel_q0p0234 1 100 0.00 1535.977 FORMAT "%8.3" ECU_ADDRESS 0x50000928 /end MEASUREMENT
/begin MEASUREMENT rlfgmnho_w_msg "rel. min. charge over throttle blade in mode homogeneous" UWORD rel_q0p02344 1 100 0.00 1535.977 FORMAT "%8.3" ECU_ADDRESS 0x600092DC /end MEASUREMENT
/begin MEASUREMENT rlfgmp_w "Predicted relative fresh air in the combustion chamber" UWORD rel_uw_q0p0234 1 100 0.00 1535.977 FORMAT "%8.3" ECU_ADDRESS 0x70003134 /end MEASUREMENT
/begin MEASUREMENT rlfgroh_w_msg "Relative fresh air over throttle valve before inatke-manifold model (unfiltered)" UWORD rel_uw_q0p0234 1 100 0.00 1535.977 FORMAT "%8.3" ECU_ADDRESS 0x60000866 /end MEASUREMENT
/begin MEASUREMENT rlfgs_w_msg "rel. desired air charge (air from throttle and EEC)" UWORD rel_q0p02344 1 100 0.00 1535.977 FORMAT "%8.3" ECU_ADDRESS 0x60001572 /end MEASUREMENT
/begin MEASUREMENT rlflmrohloc_w "rel. fresh air over throttle blade (unfilterd) measured by HFM (local copy)" UWORD rel_uw_q0p0234 1 100 0.00 1535.977 FORMAT "%8.3" ECU_ADDRESS 0x500007A8 /end MEASUREMENT
/begin MEASUREMENT rlflmroh_w_msg "rel. fresh air over throttle blade (unfilterd) measured by HFM" UWORD rel_uw_q0p0234 1 100 0.00 1535.977 FORMAT "%8.3" ECU_ADDRESS 0x7000375C /end MEASUREMENT
/begin MEASUREMENT rlgas_w_msg "gradient of air charge at one combustion cycle" SWORD rel_q0p02344 1 100 -768.0000 767.9766 FORMAT "%8.4" ECU_ADDRESS 0x5000092A /end MEASUREMENT
/begin MEASUREMENT rlminhom_w_msg "minimum air for homogeneous mode" UWORD rel_q0p02344 1 100 0.00 1535.977 FORMAT "%8.3" ECU_ADDRESS 0x600092D2 /end MEASUREMENT
/begin MEASUREMENT rlmin_w_msg "minimum permissible rl" UWORD rel_q0p02344 1 100 0.00 1535.977 FORMAT "%8.3" ECU_ADDRESS 0x600092D4 /end MEASUREMENT
/begin MEASUREMENT rlmnsa_w_msg "minimum permissible rl for fuel cut-off" UWORD rel_q0p02344 1 100 0.00 1535.977 FORMAT "%8.3" ECU_ADDRESS 0x600092D0 /end MEASUREMENT
/begin MEASUREMENT rlmn_w "minimum permissible rl" UWORD rel_q0p02344 1 100 0.00 1535.977 FORMAT "%8.3" ECU_ADDRESS 0x60008032 /end MEASUREMENT
/begin MEASUREMENT rlmxhsps_w_msg "max. desired air charge in mode homogeneous split injection (HSP)" UWORD rel_q0p02344 1 100 0.00 1535.977 FORMAT "%8.3" ECU_ADDRESS 0x60001570 /end MEASUREMENT
/begin MEASUREMENT rlmxkv_w_msg "maximum air charge from fuel supply" UWORD rel_uw_q0p0234 1 100 0.00 1535.977 FORMAT "%8.3" ECU_ADDRESS 0x60008D20 /end MEASUREMENT
/begin MEASUREMENT rlmxs_w_msg "maximum desired air charge" UWORD rel_uw_q0p0234 1 100 0.00 1535.977 FORMAT "%8.3" ECU_ADDRESS 0x600092CE /end MEASUREMENT
/begin MEASUREMENT rlmxtemp_w "max. permissible air charge (intermediate value)" UWORD rel_q0p02344 1 100 0.00 1535.977 FORMAT "%8.3" ECU_ADDRESS 0x6000156E /end MEASUREMENT
/begin MEASUREMENT rlmxvheg_w_msg "max. desired air charge in mode VHE" UWORD rel_q0p02344 1 100 0.00 1535.977 FORMAT "%8.3" ECU_ADDRESS 0x6000156C /end MEASUREMENT
/begin MEASUREMENT rlmxvhek_w_msg "max. desired air charge in mode VHE small cam" UWORD rel_q0p02344 1 100 0.00 1535.977 FORMAT "%8.3" ECU_ADDRESS 0x6000156A /end MEASUREMENT
/begin MEASUREMENT rlmxvl_w_msg "maximum attainable air charge at full load" UWORD rel_uw_q0p0234 1 100 0.00 1535.977 FORMAT "%8.3" ECU_ADDRESS 0x600092CC /end MEASUREMENT
/begin MEASUREMENT rlnotn_w_msg "Relative air charge for main and sec. load error as a function of nmot (word)" UWORD rel_uw_q0p0234 1 100 0.00 1535.977 FORMAT "%8.3" ECU_ADDRESS 0x50000FA8 /end MEASUREMENT
/begin MEASUREMENT rlpnb_w "relative air charge predicted, not limited" UWORD rel_uw_q0p0234 1 100 0.00 1535.977 FORMAT "%8.3" ECU_ADDRESS 0x500007AA /end MEASUREMENT
/begin MEASUREMENT rlpu_w "relative air charge predicted, lower limit" UWORD rel_uw_q0p0234 1 100 0.00 1535.977 FORMAT "%8.3" ECU_ADDRESS 0x70003132 /end MEASUREMENT
/begin MEASUREMENT rlpxs_w_msg "Desired air charge at max. permissible intake manifold pressure" UWORD rel_q0p02344 1 100 0.00 1535.977 FORMAT "%8.3" ECU_ADDRESS 0x60001568 /end MEASUREMENT
/begin MEASUREMENT rlp_msg "relative air charge predicted for injection calculation" UBYTE rel_ub_q0p75 1 100 0.00 191.3 FORMAT "%5.1" ECU_ADDRESS 0x500009C1 /end MEASUREMENT
/begin MEASUREMENT rlp_w_msg "relative air charge predicted for injection calculation (Word)" UWORD rel_uw_q0p0234 1 100 0.00 1535.977 FORMAT "%8.3" ECU_ADDRESS 0x6000086A /end MEASUREMENT
/begin MEASUREMENT rlrextmh_w "Relative residual-air charge from external EGR modelled by inflow" UWORD rel_q0p0234 1 100 0.00 1535.977 FORMAT "%8.3" ECU_ADDRESS 0x500007AC /end MEASUREMENT
/begin MEASUREMENT rlrext_w_msg "Relative residual-air charge from external EGR" UWORD rel_q0p0234 1 100 0.00 1535.977 FORMAT "%8.3" ECU_ADDRESS 0x60000872 /end MEASUREMENT
/begin MEASUREMENT rlrohmp_w "Relative air charge intake manifold flow for extrapolated intake manifold pressure" UWORD rel_uw_q0p0234 1 100 0.00 1535.977 FORMAT "%8.3" ECU_ADDRESS 0x500007AE /end MEASUREMENT
/begin MEASUREMENT rlshhkid_w_msg "rel. desired air charge homogeneous operation mode corrected with Istdynamics" UWORD rel_q0p02344 1 100 0.00 1535.977 FORMAT "%8.3" ECU_ADDRESS 0x700050B2 /end MEASUREMENT
/begin MEASUREMENT rlshhk_w_msg "desired charge for current homogeneous operation mode corrected" UWORD rel_q0p02344 1 100 0.00 1535.977 FORMAT "%8.3" ECU_ADDRESS 0x60001560 /end MEASUREMENT
/begin MEASUREMENT rlshk_msg "desired relative air charge corrected by altitude" UBYTE rel_ub_q0p75 1 100 0.00 191.3 FORMAT "%5.1" ECU_ADDRESS 0x700050C0 /end MEASUREMENT
/begin MEASUREMENT rlshk_w_msg "desired relative air charge corrected by altitude" UWORD rel_q0p02344 1 100 0.00 1535.977 FORMAT "%8.3" ECU_ADDRESS 0x700050B4 /end MEASUREMENT
/begin MEASUREMENT rlsh_w_msg "desired charge for current homogeneous operation mode" UWORD rel_q0p02344 1 100 0.00 1535.977 FORMAT "%8.3" ECU_ADDRESS 0x700050B0 /end MEASUREMENT
/begin MEASUREMENT rlsolg_w_msg "desired valid charge (Error --> switch to actual charge)" UWORD rel_q0p02344 1 100 0.00 1535.977 FORMAT "%8.3" ECU_ADDRESS 0x6000155C /end MEASUREMENT
/begin MEASUREMENT rlsolhom_w_msg "desired relative air charge" UWORD rel_uw_q0p0234 1 100 0.00 1535.977 FORMAT "%8.3" ECU_ADDRESS 0x60000D2C /end MEASUREMENT
/begin MEASUREMENT rlsolubid_w_msg "desired relative air charge unlimited with Istdynamics" UWORD rel_q0p02344 1 100 0.00 1535.977 FORMAT "%8.3" ECU_ADDRESS 0x700050B6 /end MEASUREMENT
/begin MEASUREMENT rlsol_w_msg "desired relative air charge(message)" UWORD rel_q0p02344 1 100 0.00 1535.977 FORMAT "%8.3" ECU_ADDRESS 0x6000155E /end MEASUREMENT
/begin MEASUREMENT rlsw_w_msg "desired relative air charge for reuse for addressing the camshaft and calculating the desired boost pressure" UWORD rel_q0p02344 1 100 0.00 1535.977 FORMAT "%8.3" ECU_ADDRESS 0x6000155A /end MEASUREMENT
/begin MEASUREMENT rrext_w_msg "Residual-gas rate (inert gas + air) over external EGR" UWORD rel_uw_b100 1 100 0.00 99.99847 FORMAT "%8.5" ECU_ADDRESS 0x70003756 /end MEASUREMENT
/begin MEASUREMENT rriext_w_msg "desired inertgas ratio from ext. EGR (Exhaust Gas Recirculation)" UWORD rel_uw_b100 1 100 0.00 99.99847 FORMAT "%8.5" ECU_ADDRESS 0x60000880 /end MEASUREMENT
/begin MEASUREMENT rrlext_w "residual- air ratio by external EGR" UWORD rel_uw_b100 1 100 0.00 99.99847 FORMAT "%8.5" ECU_ADDRESS 0x500007B0 /end MEASUREMENT
/begin MEASUREMENT rrsdugds_w "desired relative ratio at throttle blade at pressure ratio 0.95" UWORD rel_q0p00153 1 100 0.00 99.99847 FORMAT "%8.5" ECU_ADDRESS 0x6000110A /end MEASUREMENT
/begin MEASUREMENT rrsexts_w_msg "rel. desired egr ratio in manifold" UWORD rel_q0p00153 1 100 0.00 99.99847 FORMAT "%8.5" ECU_ADDRESS 0x60001548 /end MEASUREMENT
/begin MEASUREMENT rrsext_w_msg "Rel. intake manif. rate: partial pressure ext. air + inert gas related to ps" UWORD rel_uw_b100 1 100 0.00 99.99847 FORMAT "%8.5" ECU_ADDRESS 0x60000886 /end MEASUREMENT
/begin MEASUREMENT rrsiexts_w_msg "rel. ratio nominal in manifold: partial pressure ext. burned gas / ps" UWORD rel_q0p00153 1 100 0.00 99.99847 FORMAT "%8.5" ECU_ADDRESS 0x60000D30 /end MEASUREMENT
/begin MEASUREMENT rrsiext_w_msg "Relative ratio in intake manifold: partial pressure external burned gas / pressure in intake manifold" UWORD rel_uw_b100 1 100 0.00 99.99847 FORMAT "%8.5" ECU_ADDRESS 0x6000088C /end MEASUREMENT
/begin MEASUREMENT rrslext_w "rel. ratio in manifold: partial pressure external air / ps" UWORD rel_uw_b100 1 100 0.00 99.99847 FORMAT "%8.5" ECU_ADDRESS 0x500007B2 /end MEASUREMENT
/begin MEASUREMENT split2ka "split factor 2nd fuel" UWORD fak_uw_b2 1 100 0.00 1.000000 FORMAT "%8.6" ECU_ADDRESS 0x7000312A /end MEASUREMENT
/begin MEASUREMENT tabmot_w_msg "Engine shut-down time (calculated from combined message)" UWORD t_q4_s 1 100 0.00 262140.0 FORMAT "%8.1" ECU_ADDRESS 0x60008D1C /end MEASUREMENT
/begin MEASUREMENT tabrdies_w "fresh air temperature inside combustion chamber at inlet valve closing for direct start" UWORD temp_q0p0234_o273 1 100 -273.150 1262.827 FORMAT "%8.3" ECU_ADDRESS 0x60008054 /end MEASUREMENT
/begin MEASUREMENT tabst_w "stop time" UWORD t_q1 1 100 0.00 65535.00 FORMAT "%8.2" ECU_ADDRESS 0x60008022 /end MEASUREMENT
/begin MEASUREMENT tabst_w_msg "stop time" UWORD t_q1 1 100 0.00 65535.00 FORMAT "%8.2" ECU_ADDRESS 0x60008D1A /end MEASUREMENT
/begin MEASUREMENT tadk_w_msg "intake air temperature at throttle" UWORD temp_q0p0234_o273 1 100 -273.150 1262.827 FORMAT "%8.3" ECU_ADDRESS 0x60008D18 /end MEASUREMENT
/begin MEASUREMENT tahevad_w "fresh air temperature inside combustion chamber after adiabatic expansion for direct start" UWORD temp_q0p0234_o273 1 100 -273.150 1262.827 FORMAT "%8.3" ECU_ADDRESS 0x60008052 /end MEASUREMENT
/begin MEASUREMENT tahevini_w "fresh air temperature inside combustion chamber from last synchro" UWORD temp_q0p0234_o273 1 100 -273.150 1262.827 FORMAT "%8.3" ARRAY_SIZE 4 ECU_ADDRESS 0x70003138 /end MEASUREMENT
/begin MEASUREMENT tambtfuel "intaike air oder ambient temperature for fuel temperature model" UBYTE temp_ub_q0p75_o48 1 100 -48.0 143.3 FORMAT "%5.1" ECU_ADDRESS 0x600010EF /end MEASUREMENT
/begin MEASUREMENT tambtfuellp "intaike air oder ambient temperature for low pressure fuel temperature model" UBYTE temp_ub_q0p75_o48 1 100 -48.0 143.3 FORMAT "%5.1" ECU_ADDRESS 0x600010EE /end MEASUREMENT
/begin MEASUREMENT tans_bgtfuelm_loc "intake air temperature local value BGTFUELM" UBYTE temp_ub_q0p75_o48 1 100 -48.0 143.3 FORMAT "%5.1" ECU_ADDRESS 0x600010ED /end MEASUREMENT
/begin MEASUREMENT tans_bgtfuel_loc "intake air temperature local value BGTFUEL" UBYTE temp_ub_q0p75_o48 1 100 -48.0 143.3 FORMAT "%5.1" ECU_ADDRESS 0x60001108 /end MEASUREMENT
/begin MEASUREMENT tasrm_w_msg "air temperature in manifold, modelled" UWORD temp_q0p0234_o273 1 100 -273.150 1262.827 FORMAT "%8.3" ECU_ADDRESS 0x50005F18 /end MEASUREMENT
/begin MEASUREMENT tas_w_msg "time during one working cycle for rlgas_w_msg" UWORD t_q16us 1 100 0.00 1048560. FORMAT "%8.0" ECU_ADDRESS 0x70003754 /end MEASUREMENT
/begin MEASUREMENT tavdkm_w_msg "air temperature upstream throttle, modelled" UWORD temp_q0p0234_o273 1 100 -273.150 1262.827 FORMAT "%8.3" ECU_ADDRESS 0x600149C2 /end MEASUREMENT
/begin MEASUREMENT tengslst_bgtfuelm_loc "state of variable tengs_l (local value BGTFUELM)" UBYTE OneToOne 1 100 0.00 255.0 FORMAT "%5.1" ECU_ADDRESS 0x600010EC /end MEASUREMENT
/begin MEASUREMENT tengsq1z_w_msg "Motorstandzeit zum Zeitpunkt des ersten Motordrehens im Fahrzyklus" UWORD t_q1 1 100 0.00 65535.00 FORMAT "%8.2" ECU_ADDRESS 0x7000540A /end MEASUREMENT
/begin MEASUREMENT tengsq1_w_bgtfuelm_loc "engine stop time (measured from each engine stop or stall) local value BGTFUELM" UWORD t1sxs_uw_q1 1 100 0.00 65535.00 FORMAT "%8.2" ECU_ADDRESS 0x600010EA /end MEASUREMENT
/begin MEASUREMENT tengsq1_w_msg "engine stop time (measured from each engine stop or stall)" UWORD t_q1 1 100 0.00 65535.00 FORMAT "%8.2" ECU_ADDRESS 0x600149C4 /end MEASUREMENT
/begin MEASUREMENT tengszlst_msg "state of variable tengsz_l" UBYTE dez 1 100 0.00 255.0 FORMAT "%5.1" ECU_ADDRESS 0x6000F71C /end MEASUREMENT
/begin MEASUREMENT tengsz_w_msg "engine stop time copied at the time of first engine start in the driving cycle" UWORD t_q4_s 1 100 0.00 262140.0 FORMAT "%8.1" ECU_ADDRESS 0x60008D0A /end MEASUREMENT
/begin MEASUREMENT tengs_w_msg "engine stop time (measured from each engine stop or stall)" UWORD t_q4_s 1 100 0.00 262140.0 FORMAT "%8.1" ECU_ADDRESS 0x70005408 /end MEASUREMENT
/begin MEASUREMENT tflcoolhp "difference between engine and tank temperature" UBYTE temp_ub_q0p75_o48 1 100 -48.0 143.3 FORMAT "%5.1" ECU_ADDRESS 0x600010E9 /end MEASUREMENT
/begin MEASUREMENT tflhdp "basis value fuel temperature high pressure pump" UBYTE temp_ub_q0p75_o48 1 100 -48.0 143.3 FORMAT "%5.1" ECU_ADDRESS 0x600010E8 /end MEASUREMENT
/begin MEASUREMENT tflhdpf "filtered basis value fuel temperature high pressure pump" UBYTE temp_ub_q0p75_o48 1 100 -48.0 143.3 FORMAT "%5.1" ECU_ADDRESS 0x600010E7 /end MEASUREMENT
/begin MEASUREMENT tflhpfakt "factor cooling influence to tfuelhpm" SBYTE fak_sb_b1 1 100 -1.000 0.992 FORMAT "%5.3" ECU_ADDRESS 0x600010E6 /end MEASUREMENT
/begin MEASUREMENT tflhpmass "calculated fuel mass flow on high pressure side" UBYTE temp_ub_q0p75_o48 1 100 -48.0 143.3 FORMAT "%5.1" ECU_ADDRESS 0x600010E5 /end MEASUREMENT
/begin MEASUREMENT tflhpmassf "filtered, calculated fuel mass flow on high pressure side" UBYTE temp_ub_q0p75_o48 1 100 -48.0 143.3 FORMAT "%5.1" ECU_ADDRESS 0x600010E4 /end MEASUREMENT
/begin MEASUREMENT tflmass_w_bgtfuelm_loc "calculated fuel mass flow (local value BGTFUELM)" UWORD m_uw_q0p24 1 100 0.00 15728.40 FORMAT "%8.2" ECU_ADDRESS 0x600010E2 /end MEASUREMENT
/begin MEASUREMENT tflmass_w_msg "calculated fuel mass flow" UWORD m_uw_q0p24 1 100 0.00 15728.40 FORMAT "%8.2" ECU_ADDRESS 0x6000142C /end MEASUREMENT
/begin MEASUREMENT tflsthdp "body temperature high pressure pump" UBYTE temp_ub_q0p75_o48 1 100 -48.0 143.3 FORMAT "%5.1" ECU_ADDRESS 0x600010E0 /end MEASUREMENT
/begin MEASUREMENT tflsthdpf "filtered body temperature high pressure pump" UBYTE temp_ub_q0p75_o48 1 100 -48.0 143.3 FORMAT "%5.1" ECU_ADDRESS 0x600010DF /end MEASUREMENT
/begin MEASUREMENT tfltum "factor ambient temperature to fuel mass" UBYTE fak_ub_b4 1 100 0.00 3.984 FORMAT "%5.3" ECU_ADDRESS 0x600010DE /end MEASUREMENT
/begin MEASUREMENT tfuelbas "main value of tfuel (calculation of tmot and tans)" UBYTE temp_ub_q0p75_o48 1 100 -48.0 143.3 FORMAT "%5.1" ECU_ADDRESS 0x600010DD /end MEASUREMENT
/begin MEASUREMENT tfuelbasf "filtered main value of tfuel (calculation of tmot and tans)" UBYTE temp_ub_q0p75_o48 1 100 -48.0 143.3 FORMAT "%5.1" ECU_ADDRESS 0x600010DC /end MEASUREMENT
/begin MEASUREMENT tfuelhdp_bgtfuelm_loc "fuel temperature high pressure pump (local value BGTFUELM)" UBYTE temp_ub_q0p75_o48 1 100 -48.0 143.3 FORMAT "%5.1" ECU_ADDRESS 0x600010DB /end MEASUREMENT
/begin MEASUREMENT tfuelhdp_bgtfuel_loc "fuel temperature high pressure pump (local value BGTFUEL)" UBYTE temp_ub_q0p75_o48 1 100 -48.0 143.3 FORMAT "%5.1" ECU_ADDRESS 0x60001107 /end MEASUREMENT
/begin MEASUREMENT tfuelhdp_msg "fuel temperature high pressure pump" UBYTE temp_ub_q0p75_o48 1 100 -48.0 143.3 FORMAT "%5.1" ECU_ADDRESS 0x6000140C /end MEASUREMENT
/begin MEASUREMENT tfuelhpab_bgtfuelm_loc "fuel rail temperature at engine stop (sensor, model or subsitute value) local value BGTFUELM" UBYTE temp_ub_q0p75_o48 1 100 -48.0 143.3 FORMAT "%5.1" ECU_ADDRESS 0x600010DA /end MEASUREMENT
/begin MEASUREMENT tfuelhpab_bgtfuel_loc "fuel rail temperature at engine stop (sensor, model or subsitute value) local value BGTFUEL" UBYTE temp_ub_q0p75_o48 1 100 -48.0 143.3 FORMAT "%5.1" ECU_ADDRESS 0x60039792 /end MEASUREMENT
/begin MEASUREMENT tfuelhpab_msg "fuel temperature high pressure rail at engine stop (sensor, model or substitute value)" UBYTE temp_ub_q0p75_o48 1 100 -48.0 143.3 FORMAT "%5.1" ECU_ADDRESS 0x6003985B /end MEASUREMENT
/begin MEASUREMENT tfuelhpbas "unfiltered modelled rail temperature tfuelhpm" UBYTE temp_ub_q0p75_o48 1 100 -48.0 143.3 FORMAT "%5.1" ECU_ADDRESS 0x600010D9 /end MEASUREMENT
/begin MEASUREMENT tfuelhpm_bgtfuelm_loc "model value of rail fuel temperature (local value BGTFUELM)" UBYTE temp_ub_q0p75_o48 1 100 -48.0 143.3 FORMAT "%5.1" ECU_ADDRESS 0x600010D8 /end MEASUREMENT
/begin MEASUREMENT tfuelhpm_bgtfuel_loc "model value of rail fuel temperature (local value BGTFUEL)" UBYTE temp_ub_q0p75_o48 1 100 -48.0 143.3 FORMAT "%5.1" ECU_ADDRESS 0x60001106 /end MEASUREMENT
/begin MEASUREMENT tfuelhpm_msg "model value of fuel temperature in high pressure rail" UBYTE temp_ub_q0p75_o48 1 100 -48.0 143.3 FORMAT "%5.1" ECU_ADDRESS 0x6000140B /end MEASUREMENT
/begin MEASUREMENT tfuelhpsq_bgtfuel_loc "fuel temperature (rail) local value BGTFUEL" UBYTE temp_ub_q0p75_o48 1 100 -48.0 143.3 FORMAT "%5.1" ECU_ADDRESS 0x60001105 /end MEASUREMENT
/begin MEASUREMENT tfuelhpsq_msg "fuel temperature high pressure rail (sensor, model or substitute value)" UBYTE temp_ub_q0p75_o48 1 100 -48.0 143.3 FORMAT "%5.1" ECU_ADDRESS 0x6000F71A /end MEASUREMENT
/begin MEASUREMENT tfuelhpst "model value of fuel temperature (rail) at start" UBYTE temp_ub_q0p75_o48 1 100 -48.0 143.3 FORMAT "%5.1" ECU_ADDRESS 0x600010D7 /end MEASUREMENT
/begin MEASUREMENT tfuelmass "calculated fuel mass flow" UBYTE temp_ub_q0p75_o48 1 100 -48.0 143.3 FORMAT "%5.1" ECU_ADDRESS 0x600010D6 /end MEASUREMENT
/begin MEASUREMENT tfuelmassf "filtered, calculated fuel mass flow" UBYTE temp_ub_q0p75_o48 1 100 -48.0 143.3 FORMAT "%5.1" ECU_ADDRESS 0x600010D5 /end MEASUREMENT
/begin MEASUREMENT tfuelmq_bgtfuelm_loc "state of fuel temperature model local value BGTFUELM" UBYTE OneToOne 1 100 0.00 255.0 FORMAT "%5.1" ECU_ADDRESS 0x600010D4 /end MEASUREMENT
/begin MEASUREMENT tfuelmq_msg "state of fuel temperature model" UBYTE OneToOne 1 100 0.00 255.0 FORMAT "%5.1" ECU_ADDRESS 0x60001409 /end MEASUREMENT
/begin MEASUREMENT tfuelm_bgtfuelm_loc "model value of fuel temperature local value BGTFUELM" UBYTE temp_ub_q0p75_o48 1 100 -48.0 143.3 FORMAT "%5.1" ECU_ADDRESS 0x600010D3 /end MEASUREMENT
/begin MEASUREMENT tfuelm_bgtfuel_loc "model value of fuel temperature local value BGTFUEL" UBYTE temp_ub_q0p75_o48 1 100 -48.0 143.3 FORMAT "%5.1" ECU_ADDRESS 0x60001104 /end MEASUREMENT
/begin MEASUREMENT tfuelm_msg "model value of fuel temperature in low pressure system" UBYTE temp_ub_q0p75_o48 1 100 -48.0 143.3 FORMAT "%5.1" ECU_ADDRESS 0x6000140A /end MEASUREMENT
/begin MEASUREMENT tfuelsqab_bgtfuelm_loc "fuel temperature at engine stop (sensor, model or subsitute value) local value BGTFUELM" UBYTE temp_ub_q0p75_o48 1 100 -48.0 143.3 FORMAT "%5.1" ECU_ADDRESS 0x600010D2 /end MEASUREMENT
/begin MEASUREMENT tfuelsqab_bgtfuel_loc "fuel temperature at engine stop (sensor, model or subsitute value) local value BGTFUEL" UBYTE temp_ub_q0p75_o48 1 100 -48.0 143.3 FORMAT "%5.1" ECU_ADDRESS 0x60039791 /end MEASUREMENT
/begin MEASUREMENT tfuelsqab_msg "fuel temperature at engine stop (sensor, model or subsitute value)" UBYTE temp_ub_q0p75_o48 1 100 -48.0 143.3 FORMAT "%5.1" ECU_ADDRESS 0x6003985A /end MEASUREMENT
/begin MEASUREMENT tfuelsqhdv "tfuel value for thdev calculation" UBYTE temp_ub_q0p75_o48 1 100 -48.0 143.3 FORMAT "%5.1" ECU_ADDRESS 0x6000F116 /end MEASUREMENT
/begin MEASUREMENT tfuelsq_bgtfuel_loc "fuel temperature (sensor, model or subsitute value) local value BGTFUEL" UBYTE temp_ub_q0p75_o48 1 100 -48.0 143.3 FORMAT "%5.1" ECU_ADDRESS 0x60001103 /end MEASUREMENT
/begin MEASUREMENT tfuelsq_msg "fuel temperature (sensor, model or substitute value)" UBYTE temp_ub_q0p75_o48 1 100 -48.0 143.3 FORMAT "%5.1" ECU_ADDRESS 0x6000F719 /end MEASUREMENT
/begin MEASUREMENT tfuelstart "model value of fuel temperature at start" UBYTE temp_ub_q0p75_o48 1 100 -48.0 143.3 FORMAT "%5.1" ECU_ADDRESS 0x600010D1 /end MEASUREMENT
/begin MEASUREMENT tfuelvfzg "influence of vfzg to tfuel calculation" UBYTE temp_ub_q0p75_o48 1 100 -48.0 143.3 FORMAT "%5.1" ECU_ADDRESS 0x600010D0 /end MEASUREMENT
/begin MEASUREMENT tfuelvfzgf "filtered influence of vfzg to tfuel calculation" UBYTE temp_ub_q0p75_o48 1 100 -48.0 143.3 FORMAT "%5.1" ECU_ADDRESS 0x600010CF /end MEASUREMENT
/begin MEASUREMENT thdevabst_msg "HDEV temperature at engine shut down" UBYTE temp_ub_q0p75_o48 1 100 -48.0 143.3 FORMAT "%5.1" ECU_ADDRESS 0x60039859 /end MEASUREMENT
/begin MEASUREMENT thdevarea "difference between engine - and fuel temperature" UBYTE temp_ub_q0p75_o48 1 100 -48.0 143.3 FORMAT "%5.1" ECU_ADDRESS 0x6000F115 /end MEASUREMENT
/begin MEASUREMENT thdevfakt "cooling influence factor" SBYTE fak_sb_b1 1 100 -1.000 0.992 FORMAT "%5.3" ECU_ADDRESS 0x6000F114 /end MEASUREMENT
/begin MEASUREMENT thdevgru "HDEV (tmot-tfuelsq)" UBYTE temp_ub_q0p75_o48 1 100 -48.0 143.3 FORMAT "%5.1" ECU_ADDRESS 0x6000F113 /end MEASUREMENT
/begin MEASUREMENT thdevgruf "HDEV (tmot-tfuelsq) filtered" UBYTE temp_ub_q0p75_o48 1 100 -48.0 143.3 FORMAT "%5.1" ECU_ADDRESS 0x6000F112 /end MEASUREMENT
/begin MEASUREMENT thdevred "limit for actuator temperature" UBYTE temp_ub_q0p75_o48 1 100 -48.0 143.3 FORMAT "%5.1" ECU_ADDRESS 0x6000F111 /end MEASUREMENT
/begin MEASUREMENT thdevredf "filtered limit for actuator temperature" UBYTE temp_ub_q0p75_o48 1 100 -48.0 143.3 FORMAT "%5.1" ECU_ADDRESS 0x6000F110 /end MEASUREMENT
/begin MEASUREMENT thdevstart "start HDEV temperature" UBYTE temp_ub_q0p75_o48 1 100 -48.0 143.3 FORMAT "%5.1" ECU_ADDRESS 0x6000F10F /end MEASUREMENT
/begin MEASUREMENT thdevti "influence of body temperature" UBYTE temp_ub_b191p25 1 100 0.00 191.3 FORMAT "%5.1" ECU_ADDRESS 0x6000F10E /end MEASUREMENT
/begin MEASUREMENT thdevtif "influence of body temperature, filtered" UBYTE temp_ub_b191p25 1 100 0.00 191.3 FORMAT "%5.1" ECU_ADDRESS 0x6000F10D /end MEASUREMENT
/begin MEASUREMENT thdevvfz "influence of vfzg" UBYTE temp_ub_q0p75_o48 1 100 -48.0 143.3 FORMAT "%5.1" ECU_ADDRESS 0x6000F10C /end MEASUREMENT
/begin MEASUREMENT thdevvfzgf "influence of vfzg, filtered" UBYTE temp_ub_q0p75_o48 1 100 -48.0 143.3 FORMAT "%5.1" ECU_ADDRESS 0x6000F10B /end MEASUREMENT
/begin MEASUREMENT thdev_msg "Temperature HDEV(High pressure injector)" UBYTE temp_ub_q0p75_o48 1 100 -48.0 143.3 FORMAT "%5.1" ECU_ADDRESS 0x6000F718 /end MEASUREMENT
/begin MEASUREMENT tiseg_w "time segment duration" UWORD t_q0p0001_s 1 100 0.00 6.553500 FORMAT "%8.6" ECU_ADDRESS 0x500007B4 /end MEASUREMENT
/begin MEASUREMENT TMECmb_diaRefSplitInj "shift of optimized model reference ignition angle in HSP mode for normal fuel" SWORD zw_q2p9297Em3_deg_KW 1 100 -96.00000 95.99707 FORMAT "%8.5" ECU_ADDRESS 0x70003128 /end MEASUREMENT
/begin MEASUREMENT TMECmb_diaRefSplitInjAdv_a "shift of optimized model reference ignition angle in HSP mode" SWORD zw_q2p9297Em3_deg_KW 1 100 -96.00000 95.99707 FORMAT "%8.5" ARRAY_SIZE 4 ECU_ADDRESS 0x70003A3A /end MEASUREMENT
/begin MEASUREMENT TMECmb_diaRefSplitInjEth "shift of optimized model reference ignition angle in HSP mode for flex fuel" SWORD zw_q2p9297Em3_deg_KW 1 100 -96.00000 95.99707 FORMAT "%8.5" ECU_ADDRESS 0x70003126 /end MEASUREMENT
/begin MEASUREMENT TMECmb_facFu2Adv_a "actual efficiency of 2nd fuel" UWORD fak_uw_b2 1 100 0.00 1.999969 FORMAT "%8.6" ARRAY_SIZE 4 ECU_ADDRESS 0x700037D8 /end MEASUREMENT
/begin MEASUREMENT TMECmb_facSplitInj "efficiency due to split injection for normal fuel" UWORD fak_uw_b2 1 100 0.00 1.999969 FORMAT "%8.6" ECU_ADDRESS 0x70003124 /end MEASUREMENT
/begin MEASUREMENT TMECmb_facSplitInjAdv_a "efficiency due to split injection" UWORD fak_uw_b2 1 100 0.00 1.999969 FORMAT "%8.6" ARRAY_SIZE 4 ECU_ADDRESS 0x700037B8 /end MEASUREMENT
/begin MEASUREMENT TMECmb_facSplitInjEth "efficiency due to split injection for flex fuel" UWORD fak_uw_b2 1 100 0.00 1.999969 FORMAT "%8.6" ECU_ADDRESS 0x70003122 /end MEASUREMENT
/begin MEASUREMENT TMECmb_idxHspMdl "acteive HSP model" UBYTE TMECmb_HspMdl_Set_COMPU_VERB 1 100 0.00 2.00000000000 FORMAT "%13.11" ECU_ADDRESS 0x70003120 /end MEASUREMENT
/begin MEASUREMENT TMECmb_IfEtaInjSplit_I.nEng "interface class to provide engine speed and charge / class in BGTMOHDI" SWORD EngN 1 100 -16384.00 16383.50 FORMAT "%8.2" ECU_ADDRESS 0x7000311C /end MEASUREMENT
/begin MEASUREMENT TMECmb_IfEtaInjSplit_I.ratChargeAir "interface class to provide engine speed and charge / class in BGTMOHDI" UWORD rel_uw_q0p0234 1 100 0.00 1535.977 FORMAT "%8.3" ECU_ADDRESS 0x7000311E /end MEASUREMENT
/begin MEASUREMENT tmotab_bgtfuelm_loc "engine coolant temperature at engine stop or cut-off cranking (local value BGTFUELM)" UBYTE temp_ub_q0p75_o48 1 100 -48.0 143.3 FORMAT "%5.1" ECU_ADDRESS 0x600010CE /end MEASUREMENT
/begin MEASUREMENT tmotfilk_w "filtered engine temperature" UWORD temp_q0p0234_o273 1 100 -273.150 1262.827 FORMAT "%8.3" ECU_ADDRESS 0x60039794 /end MEASUREMENT
/begin MEASUREMENT tmotred "threshold for rail temperature calculation" UBYTE temp_ub_q0p75_o48 1 100 -48.0 143.3 FORMAT "%5.1" ECU_ADDRESS 0x600010CD /end MEASUREMENT
/begin MEASUREMENT tmotredf "filtered mean value engine and oil temperature" UBYTE temp_ub_q0p75_o48 1 100 -48.0 143.3 FORMAT "%5.1" ECU_ADDRESS 0x600010CC /end MEASUREMENT
/begin MEASUREMENT tmotredr "filtered threshold for rail temperature calculation" UBYTE temp_ub_q0p75_o48 1 100 -48.0 143.3 FORMAT "%5.1" ECU_ADDRESS 0x600010CB /end MEASUREMENT
/begin MEASUREMENT tmot_bgtfuelm_loc "Engine temperature (local value BGTFUELM)" UBYTE temp_ub_q0p75_o48 1 100 -48.0 143.3 FORMAT "%5.1" ECU_ADDRESS 0x600010CA /end MEASUREMENT
/begin MEASUREMENT tmot_bgtfuel_loc "Engine temperature (local value BGTFUEL)" UBYTE temp_ub_q0p75_o48 1 100 -48.0 143.3 FORMAT "%5.1" ECU_ADDRESS 0x60001102 /end MEASUREMENT
/begin MEASUREMENT tmtomw "mean value of engine and oil temperature" UBYTE temp_ub_q0p75_o48 1 100 -48.0 143.3 FORMAT "%5.1" ECU_ADDRESS 0x6000F10A /end MEASUREMENT
/begin MEASUREMENT tnsezmot_w_bgtfuelm_loc "time of engine operation from first end of start (over ECU-cycle) local value BGTFUELM" UWORD t_q0p1 1 100 0.00 6553.500 FORMAT "%8.3" ECU_ADDRESS 0x600010C8 /end MEASUREMENT
/begin MEASUREMENT tnsez_w_bgtfuelm_loc "time counter at first end of start in cycle (16 bit) local value BGTFUELM" UWORD t_q0p1 1 100 0.00 6553.500 FORMAT "%8.3" ECU_ADDRESS 0x600010C6 /end MEASUREMENT
/begin MEASUREMENT top_w_msg "operating time" UWORD t6minxmin_q6 1 100 0.00 393210.0 FORMAT "%8.1" ECU_ADDRESS 0x50005F1C /end MEASUREMENT
/begin MEASUREMENT tosp_bgtfuelm_loc "Oil temperature in oil sump - measured or modeled local value BGTFUELM" UBYTE temp_ub_q0p75_o48 1 100 -48.0 143.3 FORMAT "%5.1" ECU_ADDRESS 0x600010C5 /end MEASUREMENT
/begin MEASUREMENT ttmothdv_w "time const. filtered" UWORD t_q0p2 1 100 0.20 13107.00 FORMAT "%8.2" ECU_ADDRESS 0x60008016 /end MEASUREMENT
/begin MEASUREMENT tumc_bgtfuelm_loc "Ambient temperature received CAN message local value BGTFUELM" UBYTE temp_ub_q0p75_o48 1 100 -48.0 143.3 FORMAT "%5.1" ECU_ADDRESS 0x600010C4 /end MEASUREMENT
/begin MEASUREMENT tumtfuel "ambient temperature in temperature model" UBYTE temp_ub_q0p75_o48 1 100 -48.0 143.3 FORMAT "%5.1" ECU_ADDRESS 0x600010C3 /end MEASUREMENT
/begin MEASUREMENT tumthdev "ambient temperature for temperature mdoel" UBYTE temp_ub_q0p75_o48 1 100 -48.0 143.3 FORMAT "%5.1" ECU_ADDRESS 0x6000F109 /end MEASUREMENT
/begin MEASUREMENT tum_bgtfuelm_loc "ambient (air) temperature local value BGTFUELM" UBYTE temp_ub_q0p75_o48 1 100 -48.0 143.3 FORMAT "%5.1" ECU_ADDRESS 0x600010C2 /end MEASUREMENT
/begin MEASUREMENT tvlueft_bgtfuelm_loc "duty cycle of fan for fuel temperature model local value BGTFUELM" UBYTE tv_ub_b100 1 100 0.00 99.61 FORMAT "%5.2" ECU_ADDRESS 0x600010C1 /end MEASUREMENT
/begin MEASUREMENT twvev_w_msg "wall temperature of intake manifold near inlet valve" UWORD temp_q0p0234_o273 1 100 -273.150 1262.827 FORMAT "%8.3" ECU_ADDRESS 0x60008CFA /end MEASUREMENT
/begin MEASUREMENT umsrln_w_msg "calculation factor load to mass flow" UWORD m_q0p0005 1 100 0.00 32.76750 FORMAT "%8.5" ECU_ADDRESS 0x60000894 /end MEASUREMENT
/begin MEASUREMENT vfzg_bgtfuelm_loc "vehicle speed (kmh) local value BGTFUELM" UBYTE vfzg_ub_q1p25 1 100 0.00 318.8 FORMAT "%5.1" ECU_ADDRESS 0x600010C0 /end MEASUREMENT
/begin MEASUREMENT vsaugr_w_msg "Volume, intake manifold" UWORD vol_q0p702Em3_dm3 1 100 0.00 46.00562 FORMAT "%8.5" ECU_ADDRESS 0x6000152E /end MEASUREMENT
/begin MEASUREMENT vskslhf_w "filtered Volumetric flow of fuel in Lh" UWORD vol_q0p002146 1 100 0.00 140.6229 FORMAT "%8.4" ECU_ADDRESS 0x60001100 /end MEASUREMENT
/begin MEASUREMENT vskslh_w "Volumetric flow of fuel in L/h" UWORD vol_q0p002146 1 100 0.00 140.6229 FORMAT "%8.4" ECU_ADDRESS 0x600010FE /end MEASUREMENT
/begin MEASUREMENT vsksml_w_bgtfuel_loc "volumetric flow of fuel in mls local value BGTFUEL" UWORD volgrd_q5p96Em4 1 100 0.00 39.06190 FORMAT "%8.5" ECU_ADDRESS 0x600010FC /end MEASUREMENT
/begin MEASUREMENT wdialwot_w "old value of wdilwot_w" SWORD kw_q0p0156 1 100 -512.0000 511.9844 FORMAT "%8.4" ECU_ADDRESS 0x60008050 /end MEASUREMENT
/begin MEASUREMENT wdiz_w "Cylinder angle relating to exchange top dead center" SWORD AngleCrS 1 100 -720.0000 719.9780 FORMAT "%8.4" ARRAY_SIZE 4 ECU_ADDRESS 0x60008048 /end MEASUREMENT
/begin MEASUREMENT wgvsedst_w "mean value angle gas change valve closes intake" SWORD kw_q0p0156 1 100 -512.0000 511.9844 FORMAT "%8.4" ARRAY_SIZE 4 ECU_ADDRESS 0x60008040 /end MEASUREMENT
/begin MEASUREMENT zkhdevcol_w "filter constant for cooling influence" UWORD t_q0p2 1 100 0.20 13107.00 FORMAT "%8.2" ECU_ADDRESS 0x60008014 /end MEASUREMENT
/begin MEASUREMENT zkhdevew_w "filter constant for body temperature" UWORD t_q0p2 1 100 0.20 13107.00 FORMAT "%8.2" ECU_ADDRESS 0x60008012 /end MEASUREMENT
/begin MEASUREMENT zkhdpms_w "filter constant for hdp temperature" UWORD zk200msxs_uw_b13107p2 1 100 0.200003 13107.200000 FORMAT "%12.6" ECU_ADDRESS 0x600010BE /end MEASUREMENT
/begin MEASUREMENT zkhdp_w "filter constant for hdp temperature" UWORD zk200msxs_uw_b13107p2 1 100 0.200003 13107.200000 FORMAT "%12.6" ECU_ADDRESS 0x600010BC /end MEASUREMENT
/begin MEASUREMENT zkhpmot_w "filter constant for rail temperature" UWORD zk200msxs_uw_b13107p2 1 100 0.200003 13107.200000 FORMAT "%12.6" ECU_ADDRESS 0x600010BA /end MEASUREMENT
/begin MEASUREMENT zkhpred_w "time constant for lowpass hpred" UWORD zk200msxs_uw_b13107p2 1 100 0.200003 13107.200000 FORMAT "%12.6" ECU_ADDRESS 0x600010B8 /end MEASUREMENT
/begin MEASUREMENT zkhpt_w "time constant cooling for tfuelhpm" UWORD zk200msxs_uw_b13107p2 1 100 0.200003 13107.200000 FORMAT "%12.6" ECU_ADDRESS 0x600010B6 /end MEASUREMENT
/begin MEASUREMENT zktmotr_w "filter constant for upper model limit" UWORD t_q0p2 1 100 0.20 13107.00 FORMAT "%8.2" ECU_ADDRESS 0x60008010 /end MEASUREMENT
/begin FUNCTION BGRLDIRST "6.7.2     Calculation of relative cylinder air charge for direct start"
 /begin DEF_CHARACTERISTIC AirMod_facCorrnInertGasDS AirMod_facCorrnInertGasLKS AirMod_tiLoKinStrtInh_C ASYNDIRSTO CWBGRLDIST DTBRWDMOT DWDIRSTPRR FVBRDIRST NMOTDSTMN NMOTDSTMX NWEPMMN TPBRDIWD TPBRDIWEVO TTBRDEVOND TTBRDIWD TTBRDIWEVO WDIZMX XHKAPPA /end DEF_CHARACTERISTIC
 /begin IN_MEASUREMENT CoEng_stMai destrange_msg Epm_nEng Epm_nEng10ms Epm_numCyl Epm_phiCyl Epm_stDirstaleReady Epm_stSpd ExhMod_tEng fupsrl_w_msg GEVCtl_agIntkClsd GEVCtl_agIntkOpen GEVCtl_agOutlOpen pbrint_w_msg PEnv_p PIntkVUs_pTiBasd psr_w_msg pvd_w_msg rlp_w_msg rl_w_msg SyC_stSub tahev_w_msg /end IN_MEASUREMENT
 /begin OUT_MEASUREMENT AirMod_flgChrgAirCylSpstVld AirMod_ratChrgAirCylSpst B_rldirsta_msg rldirsta_w_msg /end OUT_MEASUREMENT
 /begin LOC_MEASUREMENT AirMod_agCrksftForCylIntkClsd_MP AirMod_agCrksftForCylIntkOpen_MP AirMod_agCrksftForCylInvld_MP AirMod_agCrksftPosnRRS_MP AirMod_agCrksftPosn_MP AirMod_agIntkClsdForCylIntkClsd_MP AirMod_agIntkClsdForCylIntkOpen_MP AirMod_agIntkOpenForCylIntkClsd_MP AirMod_agIntkOpenForCylIntkOpen_MP AirMod_cntSegStoppingCyc AirMod_flgLoKinStrtRels asyndirst BGRLDIWDEVS0_I.B_dwdilwotX BGRLDIWDEVS0_I.ftabresX_w BGRLDIWDEVS0_I.fvbresX_w BGRLDIWDEVS0_I.fvbreswdX_w BGRLDIWDEVS0_I.pbradX_w BGRLDIWDEVS0_I.pbrdiwdX_w BGRLDIWDEVS0_I.rldiwdobX_w BGRLDIWDEVS0_I.rldiwdxX_w BGRLDIWDEVS0_I.tabrdiwdX_w BGRLDIWDEVS0_I.tahevadX_w BGRLDIWDEVS0_I.wdialwotX_w BGRLDIWDEVS0_I.BGRLZYL_CL.ftabrX_w BGRLDIWDEVS0_I.BGRLZYL_CL.fvbrwX_w BGRLDIWDEVS1_I.B_dwdilwotX BGRLDIWDEVS1_I.ftabresX_w BGRLDIWDEVS1_I.fvbresX_w BGRLDIWDEVS1_I.fvbreswdX_w BGRLDIWDEVS1_I.pbradX_w BGRLDIWDEVS1_I.pbrdiwdX_w BGRLDIWDEVS1_I.rldiwdobX_w BGRLDIWDEVS1_I.rldiwdxX_w BGRLDIWDEVS1_I.tabrdiwdX_w BGRLDIWDEVS1_I.tahevadX_w BGRLDIWDEVS1_I.wdialwotX_w BGRLDIWDEVS1_I.BGRLZYL_CL.ftabrX_w BGRLDIWDEVS1_I.BGRLZYL_CL.fvbrwX_w BGRLDIWDEVS2_I.B_dwdilwotX BGRLDIWDEVS2_I.ftabresX_w BGRLDIWDEVS2_I.fvbresX_w BGRLDIWDEVS2_I.fvbreswdX_w BGRLDIWDEVS2_I.pbradX_w BGRLDIWDEVS2_I.pbrdiwdX_w BGRLDIWDEVS2_I.rldiwdobX_w BGRLDIWDEVS2_I.rldiwdxX_w BGRLDIWDEVS2_I.tabrdiwdX_w BGRLDIWDEVS2_I.tahevadX_w BGRLDIWDEVS2_I.wdialwotX_w BGRLDIWDEVS2_I.BGRLZYL_CL.ftabrX_w BGRLDIWDEVS2_I.BGRLZYL_CL.fvbrwX_w BGRLDIWDEVS3_I.B_dwdilwotX BGRLDIWDEVS3_I.ftabresX_w BGRLDIWDEVS3_I.fvbresX_w BGRLDIWDEVS3_I.fvbreswdX_w BGRLDIWDEVS3_I.pbradX_w BGRLDIWDEVS3_I.pbrdiwdX_w BGRLDIWDEVS3_I.rldiwdobX_w BGRLDIWDEVS3_I.rldiwdxX_w BGRLDIWDEVS3_I.tabrdiwdX_w BGRLDIWDEVS3_I.tahevadX_w BGRLDIWDEVS3_I.wdialwotX_w BGRLDIWDEVS3_I.BGRLZYL_CL.ftabrX_w BGRLDIWDEVS3_I.BGRLZYL_CL.fvbrwX_w BGRLZYLDIRST_CL_I.ftabrX_w BGRLZYLDIRST_CL_I.fvbrwX_w B_asyndist B_dirstzyl B_dizinv B_dwdilwot B_evodiza B_inirlda B_reszyl B_ssyn ftabres_w fvbreswd_w fvbres_w izevo izevoa izevs izug pbrad_w pbrdies_w pbrini_w rldiesl_w rldies_w rldipifu_w rldiwdx1_w rldiwd_w rldiwob1_w tabrdies_w tahevad_w tahevini_w wdialwot_w wdiz_w wgvsedst_w /end LOC_MEASUREMENT
 FUNCTION_VERSION "6.7.2" /end FUNCTION
/begin FUNCTION BGRLFG "10.5.1    calculation of fresh air charge in combustion chamber"
 /begin DEF_CHARACTERISTIC FPSPULSMN FPSPULSMX FPVMXST PSIREXHMN PSIREXHMX PSLREXHMN PSLREXHMX PSREMN PSREMX TNMNSRMDK TNSTUNL TPSRMNXG TPSRPUFIL VHUBZYL VPPSRMSM VPPSRMSMHY VSAUGROHNL VSAUGROHR ZKORFKISRM /end DEF_CHARACTERISTIC
 /begin REF_CHARACTERISTIC MSNTEVO /end REF_CHARACTERISTIC
 /begin IN_MEASUREMENT B_cdagr_msg B_cdehfm_msg B_dugdtx_msg B_fedssb_msg B_fupivheg_msg B_msagrsrg_msg B_msddkg_msg B_msdkhfmg_msg B_msdkpnxg_msg B_mszsdkb_msg B_psrgg_msg B_pug_msg B_tahevg_msg B_vhegfe_msg ChrCtl_flgChrgCalcnTiBasd dpsrg_w_msg EngStrt_bStrtEnd Epm_nEng Epm_stSpd Epm_stSync ftsr_w_msg fupsrls_w_msg fupsrltn_w_msg fupsrltx_w_msg fupsrl_w_msg laaeoagr_w_msg msagrtn_w_msg msagrtx_w_msg msdkpmn_w_msg msdkpmx_w_msg pbrints_w_msg pbrinttn_w_msg pbrinttx_w_msg pbrint_w_msg PEnv_p psdkugdn_w_msg psrgsm_w_msg psrg_w_msg psr_w_msg pvdmn_w_msg pvdmx_w_msg pvd_w_msg rfges_w_msg rfrexroh_w_msg rlfgroh_w_msg SyC_stSub tnst_w_msg umsrln_w_msg /end IN_MEASUREMENT
 /begin OUT_MEASUREMENT B_psrmhg_msg B_psrmnxg_msg B_psrmozdg_msg B_psrmozg_msg B_psrmozpnxg_msg dpsrfgmh_w_msg dpsrfgmp_w_msg fisrm_w_msg fkisrm_w_msg psrfgmh_w_msg psrfgmp_w_msg psrmgx_w_msg psrmhmi_w_msg psrmh_w_msg psrmmn_w_msg psrmmx_w_msg psrrext_w_msg rfdsorgi_w_msg rfdsorim_w_msg rflmorgi_w_msg rfrext_w_msg rirext_w_msg rlfgdssm_w_msg rlfgds_w_msg rlfglm_w_msg rlrext_w_msg rrext_w_msg rriext_w_msg rrsext_w_msg rrsiext_w_msg vsaugr_w_msg /end OUT_MEASUREMENT
 /begin LOC_MEASUREMENT B_fupivhegloc fupsrli_w fupsrlloc_w pbrintc_w pbrintloc_w psrextmh_w psrfgmh_w psrizext_w psrlzext_w PSRMH_2SYN_I.dpsrfgmh_w PSRMH_2SYN_I.dpsrmh_w PSRMH_2SYN_I.psrfgmh_w PSRMH_2SYN_I.psrmh_w PSRMH_2SYN_I.psrmhmi_w PSRMH_2SYN_I.rlfsrbrh_w PSRMH_2SYN_I.INT_PSRX_CL.dpsrmX_w PSRMH_2SYN_I.INT_PSRX_CL.psrmXneu_w psrmh_w PSRMMN_2SYN_I.psrmX_w PSRMMN_2SYN_I.rfasrX_w PSRMMN_2SYN_I.rfzsrX_w PSRMMX_2SYN_I.psrmX_w PSRMMX_2SYN_I.rfasrX_w PSRMMX_2SYN_I.rfzsrX_w psrpufil_w rirextmh_w rlrextmh_w rrlext_w rrslext_w /end LOC_MEASUREMENT
 FUNCTION_VERSION "10.5.1" /end FUNCTION
/begin FUNCTION BGRLFGZS "11.6.0    Calculation of fresh air charge flowing into the intake manifold" /begin DEF_CHARACTERISTIC CWBGRLFGZS KFTCONSTTP KUMSIRL RLNOT TDMLST /end DEF_CHARACTERISTIC
 /begin IN_MEASUREMENT B_fedssb_msg B_msddkg_msg B_mshfmgg_msg B_syn2fe_msg ChrCtl_flgChrgCalcnTiBasd EpmCrS_tiSeg Epm_nEng Epm_nEngLRes msbkvsr_w_msg msdkosa_w_msg msdk_w_msg mshfms_w_msg mste_msg rrext_w_msg SyC_stSub ThrVlv_flgIrrvFuCutOffB1 tnse_w_msg vpsrvdb_w_msg /end IN_MEASUREMENT
 /begin OUT_MEASUREMENT B_dmshfmdg_msg B_msdkhfmg_msg B_mszsdkb_msg msdkalm_w_msg msdkhfm_w_msg rlfdkroh_w_msg rlfgroh_w_msg rlflmroh_w_msg rlnotn_w_msg umsrln_w_msg /end OUT_MEASUREMENT
 /begin LOC_MEASUREMENT B_msdkhfmgloc omsdhfm_w rlfdkrohloc_w rlflmrohloc_w tiseg_w /end LOC_MEASUREMENT
 FUNCTION_VERSION "11.6.0" /end FUNCTION
/begin FUNCTION BGRLG "4.0.0     Calculated value RL-GRADIENT" /begin IN_MEASUREMENT Epm_nEng rl_w_msg /end IN_MEASUREMENT /begin OUT_MEASUREMENT drlas_w_msg rlgas_w_msg tas_w_msg /end OUT_MEASUREMENT /begin LOC_MEASUREMENT AirMod_nEng_a nmotalt_w rlaltas_w /end LOC_MEASUREMENT FUNCTION_VERSION "4.0.0" /end FUNCTION
/begin FUNCTION BGRLMIN "35.2.0    Calculation of minimum air flow rlmin"
 /begin DEF_CHARACTERISTIC BFZGRLNBKV ChrSet_facCorrnMinChrgTEngPEnv_M ChrSet_facRelAirChrgMinEth_T ChrSet_facRelAirChrgMinPEnvFuCutOff_T ChrSet_facRelAirChrgMinTEngFuCutOff_T ChrSet_ratChrgAirEthMin_T ChrSet_ratMinChrgFuFullDlvFailr_T CWBGRLMIN FRLMNPU FRLMNTMOT NMOTRLNBKV RLMNDSAN RLMNN RLMNSABKV RLMNSAN RLMNVHEKN RLMNVHEKSAN TDRLNBKV /end DEF_CHARACTERISTIC
 /begin IN_MEASUREMENT B_invlvbcd_msg B_ll_msg B_sa_msg B_vheg_msg CEngDsT_t Epm_nEng FfPrm_facEth PEnv_p rlrints_w_msg VehV_v /end IN_MEASUREMENT
 /begin OUT_MEASUREMENT rlfgmnho_w_msg rlminhom_w_msg rlmin_w_msg rlmnsa_w_msg /end OUT_MEASUREMENT
 /begin LOC_MEASUREMENT bfzgbkv_w B_bfzgbkv ChrSet_facCorrnMinChrg ChrSet_facRelAirChrgMinTEngPEnvFuCutOff ChrSet_ratRelMinAirChrgFuCutOff frlmntp_w rlmn_w /end LOC_MEASUREMENT
 FUNCTION_VERSION "35.2.0" /end FUNCTION
/begin FUNCTION BGRLMXKV "51.8.0_1.4.0Calculation of maximum air charge for fuel supply"
 /begin DEF_CHARACTERISTIC CWBGRLMXKV DWMSVDRLMX FlSplG_facFuDens_T FlSplG_ratAirMChgMaxNeg_C FlSplG_ratAirMChgMaxPos_C FRLMXKVMX FRLMXKVNL FuPHi_pThresRlPDeAirChrgLimn_C FuPHi_ratFuMDeltaRstLimn_C FuPHi_tiBattUFil FuPHi_tiRatFuMRstLimn_C KLVSKSEKP KLVSKSHDP TDRLMXEKP TDRLMXHDP TFDWMSVD TNSTRLMXKV /end DEF_CHARACTERISTIC
 /begin REF_CHARACTERISTIC KUMSIRL /end REF_CHARACTERISTIC
 /begin IN_MEASUREMENT Alt_uDes BattU_u B_eprail_msg B_ll_msg dwmsvd_w_msg Epm_nEng FuPHi_pHpRglnDe PtCoornDyn_flgTrsmIntvDecActvDes rkvmeeff_w_msg rlmxvl_w_msg rl_w_msg SyC_stSub tfuelm_msg tnse_w_msg /end IN_MEASUREMENT
 /begin OUT_MEASUREMENT rlmxkv_w_msg /end OUT_MEASUREMENT
 /begin LOC_MEASUREMENT B_rlmxekp B_rlmxhdev B_rlmxhdp FlSplG_uAltBatt FlSplG_uBattLcy rkmxkv_w rkvmxekp_w rkvmxhdp_w /end LOC_MEASUREMENT
 FUNCTION_VERSION "51.8.0_1.4.0" /end FUNCTION
/begin FUNCTION BGRLMXS "56.1.0    Calculation maximum, desired filling"
 /begin DEF_CHARACTERISTIC CWBGRLMXS FKRLXVL KLFETHRLMX KLMXRLAPIG KLMXRLAPIGFF KLTANSCRF KLTMOTCRF RVBRVL /end DEF_CHARACTERISTIC
 /begin IN_MEASUREMENT CEngDsT_t Epm_nEng Epm_nEngLRes ExhMgT_facCptProtnMisf FfPrm_facEth frlmxbts_w_msg ftahevmx_w_msg IKCtl_facFillgRed_u16 PEnv_facCorrAlti rlmaxti_w_msg rlmxhdev_w_msg rlmxkv_w_msg tans_msg /end IN_MEASUREMENT
 /begin OUT_MEASUREMENT rlmxs_w_msg rlmxvl_w_msg /end OUT_MEASUREMENT
 /begin LOC_MEASUREMENT ChrSet_facCptProtnMisfExhSys ChrSet_ratChrgMeasmtPnt1 /end LOC_MEASUREMENT
 FUNCTION_VERSION "56.1.0" /end FUNCTION
/begin FUNCTION BGRLP "9.7.1     Calculation variable rlp: predicted air charge"
 /begin DEF_CHARACTERISTIC DPLMDK DRLRLPMAX DRLRLPU FGDPSMPDVS FPVMXP FPVMXP2 TDRLRLPMAX /end DEF_CHARACTERISTIC
 /begin REF_CHARACTERISTIC CWBGRLP /end REF_CHARACTERISTIC
 /begin IN_MEASUREMENT B_rlpdms_msg B_rlpdp_msg B_rlp_msg B_vhefeps_msg ChrCtl_flgChrgCalcnTiBasd dpsrfgmh_w_msg dpsrfg_w_msg fisrm_w_msg fupsrls_w_msg fupsrl_w_msg fwprs_w_msg msdp_w_msg pbrints_w_msg pbrint_w_msg psrrext_w_msg psrrl_w_msg psr_w_msg pvd_w_msg rlfdkroh_w_msg rlfg_w_msg rlr_w_msg rl_w_msg rrsext_w_msg SyC_stSub umsrln_w_msg /end IN_MEASUREMENT
 /begin OUT_MEASUREMENT B_syn2fe_msg drlp_w_msg psrmp_w_msg rlp_msg rlp_w_msg /end OUT_MEASUREMENT
 /begin LOC_MEASUREMENT B_psrmpb dpsfdhfb_w dpsrfdhf_w dpsrfgk_w dpsrfmp_w dpsrpps_w drlrlpmx gdrlprlctr psrpmx_w psrrlpnb_w rlfgmp_w rlpnb_w rlpu_w rlrohmp_w /end LOC_MEASUREMENT
 FUNCTION_VERSION "9.7.1" /end FUNCTION
/begin FUNCTION BGRLSOL "48.2.0    Calculation of desired air charge"
 /begin DEF_CHARACTERISTIC ChrSet_facCorrnNormCdn_C ChrSet_pAmbNormCdn_C ChrSet_tAmbNormCdn_C CWRLAPPL DRLMINBG DRLSOLDYN DRLSOLHUM DRLSOLSTAT DRLSTAT FHORLVPSVD RLSOLAP RLSOLAPW TDMWRLSTA TDMWRLSTADYN /end DEF_CHARACTERISTIC
 /begin IN_MEASUREMENT APP_r B_agrsg_msg B_ahfsnfsa_msg B_dkstrl_msg B_homfes_msg B_hspfes_msg B_msdksg_msg B_mwrlstas_msg B_rlvheg_msg B_vhegfes_msg B_vhegs_msg B_vheg_msg drldvmds_w_msg drl_w_msg EnvT_t Epm_stSpd fupshoms_w_msg fupshsps_w_msg fupsrlmx_w_msg fupsrls_w_msg fupsrltn_w_msg fupsrltx_w_msg fupsrlug_w_msg fupsrl_w_msg fupsvheg_w_msg fupsvhek_w_msg msnagrs_w_msg pbrihoms_w_msg pbrihsps_w_msg pbrintmx_w_msg pbrints_w_msg pbrinttn_w_msg pbrinttx_w_msg pbrintug_w_msg pbrint_w_msg pbrivheg_w_msg pbrivhek_w_msg PEnv_p psagrmx_w_msg psagrugd_w_msg psdkugdn_w_msg psdkugdx_w_msg psrdkugd_w_msg psrmxhsp_w_msg psrmxveg_w_msg psrmxvek_w_msg psrxs_w_msg pvdmx_w_msg pvd_w_msg reclagre_w_msg rfrexts_w_msg rfrihsps_w_msg rfrints_w_msg rfrivheg_w_msg rfrivhek_w_msg rirehsg_w_msg rirextsg_w_msg rirexts_w_msg rirext_w_msg rlmdhoms_w_msg rlmds_w_msg rlminhom_w_msg rlmin_w_msg rlmxs_w_msg rlrextsg_w_msg rlrints_w_msg rlrint_w_msg rl_w_msg rriehoms_w_msg rriextfs_w_msg rrsext_w_msg SyC_stSub trlrlsol_w_msg umsrln_w_msg vpsrvdk_w_msg /end IN_MEASUREMENT
 /begin OUT_MEASUREMENT B_mdmin_msg B_mwrlsta_msg B_pvdrlseuvheg_msg B_rlmdsg_msg B_rlsolg_msg B_rlsrlpxs_msg B_zwfrlmin_msg ChrSet_mfActTraDes grdpssol_w_msg psrhoms_w_msg psrsldr_w_msg psrsuvhe_w_msg psrs_w_msg rfextmxi_w_msg rfextmx_w_msg rfextugdi_w_msg rfextugd_w_msg rforidmx_w_msg rfreugds_w_msg rfzumxtx_w_msg rfzuugpn_w_msg rfzuugtn_w_msg rfzuugtx_w_msg rldkmx_w_msg rldkugd_w_msg rlfgs_w_msg rlmxhsps_w_msg rlmxvheg_w_msg rlmxvhek_w_msg rlpxs_w_msg rlshhkid_w_msg rlshhk_w_msg rlshk_msg rlshk_w_msg rlsh_w_msg rlsolg_w_msg rlsolhom_w_msg rlsolubid_w_msg rlsol_w_msg rlsw_w_msg rrsexts_w_msg rrsiexts_w_msg /end OUT_MEASUREMENT
 /begin LOC_MEASUREMENT fhorlnws_w psrpsrs_w rforidug_w rforiemx_w rforieug_w rlmxtemp_w rrsdugds_w /end LOC_MEASUREMENT
 FUNCTION_VERSION "48.2.0" /end FUNCTION
/begin FUNCTION BGTABSTAD "10.1.1    Engine Off Time TABST by Adapter"
 /begin IN_MEASUREMENT TiEngOff_bTiEngOffEcuActv TiEngOff_stTiFirstStrt TiEngOff_ti TiEngOff_tiFirstStrt TiEngOn_tiTotEngRt TiEngOn_tiTotIgnOn TiOff_stTiStrtEndOff TiOff_tiStrtEndOff /end IN_MEASUREMENT
 /begin OUT_MEASUREMENT B_abstgp B_abstgp_msg B_abstnpl B_tengsi_msg EngDa_tiEngOff EngDa_tiEngOn tabmot_w_msg tabst_w tabst_w_msg tengsq1z_w_msg tengsq1_w_msg tengszlst_msg tengsz_w_msg tengs_w_msg top_w_msg /end OUT_MEASUREMENT
 FUNCTION_VERSION "10.1.1" /end FUNCTION
/begin FUNCTION BGTASRM "2.7.0     Calculation value modelled temperature in intake manifold" /begin DEF_CHARACTERISTIC TASRMEW ZTMMBR /end DEF_CHARACTERISTIC
 /begin IN_MEASUREMENT CEngDsT_t Eep_EnvRamHist Eep_EnvRamInvld IntkAirT_tThrVlvUs SyC_stSub /end IN_MEASUREMENT
 /begin OUT_MEASUREMENT B_tasrmg_msg tadk_w_msg tasrm_w_msg twvev_w_msg /end OUT_MEASUREMENT
 /begin LOC_MEASUREMENT tmotfilk_w /end LOC_MEASUREMENT
 FUNCTION_VERSION "2.7.0" /end FUNCTION
/begin FUNCTION BGTAVDKM "15.2.0    Calculation value modelled temperature upstream throttle blade" /begin DEF_CHARACTERISTIC RSAGTVDMGX TAVDKMEW /end DEF_CHARACTERISTIC
 /begin IN_MEASUREMENT IntkAirT_flgIntkMnfldMeasdVld IntkAirT_tIntkMnfldMeasd rrsext_w_msg /end IN_MEASUREMENT
 /begin OUT_MEASUREMENT B_tavdkmg_msg tavdkm_w_msg /end OUT_MEASUREMENT
 FUNCTION_VERSION "15.2.0" /end FUNCTION
/begin FUNCTION BGTFUEL "51.3.0    Calculated variable fuel temperature"
 /begin DEF_CHARACTERISTIC CWTFUELSQ TANSHLL TFLHLL TFUELE TFUELHLL TFUELHPE TFUELNOHLL TMOTHLL TVSKSHLL VSKSHLL /end DEF_CHARACTERISTIC
 /begin IN_MEASUREMENT B_tfuelmc_msg B_tfuelmg_msg CEngDsT_t Eep_EnvRamHist Eep_EnvRamInvld EngStrt_bFrstStrtEnd EngStrt_bStrtEnd InjSys_dvolFumL SyC_stSub tans_msg tfuelhdp_msg tfuelhpm_msg tfuelm_msg TiEngOff_bRst /end IN_MEASUREMENT
 /begin OUT_MEASUREMENT B_tfuelgg_msg B_tfuelg_msg B_tfuelhll_msg tfuelhpab_msg tfuelhpsq_msg tfuelsqab_msg tfuelsq_msg /end OUT_MEASUREMENT
 /begin LOC_MEASUREMENT B_bfuelpwf B_stendz_bgtfuel_loc B_stend_bgtfuel_loc B_tengsr_bgtfuel_loc B_tfuelgg_bgtfuel_loc B_tfuelg_bgtfuel_loc B_tfuelhll_bgtfuel_loc B_tfuelmc_bgtfuel_loc B_tfuelmg_bgtfuel_loc tans_bgtfuel_loc tfuelhdp_bgtfuel_loc tfuelhpab_bgtfuel_loc tfuelhpm_bgtfuel_loc tfuelhpsq_bgtfuel_loc tfuelm_bgtfuel_loc tfuelsqab_bgtfuel_loc tfuelsq_bgtfuel_loc tmot_bgtfuel_loc vskslhf_w vskslh_w vsksml_w_bgtfuel_loc /end LOC_MEASUREMENT
 FUNCTION_VERSION "51.3.0" /end FUNCTION
/begin FUNCTION BGTFUELM "51.9.1    Model for calculation of fuel temperature"
 /begin DEF_CHARACTERISTIC CWTFUELM CWTFUELM1 FRKMK FuPHi_FTIRAIL_T KFFUELSHDP KFMKHPTRL KFMTTOSP KFTFLHPMASS KFTFLRL KFTFLTLURL KFTFLTUMRL KFTFSTHDP KFTFUELAB KFTMOHPTRL KFTMOTTOEL KFTSRMAB KFVTFUEL KLMKTFUEL KLTFLTANS KLTUMTFUEL TFLBSTDE TFLQUALI TFLTMOTMN THPMASSTFUEL TMASSTFUEL TMOTCOLD TMOTTFMN TTMOTTFUEL TVFZGTFUEL /end DEF_CHARACTERISTIC
 /begin IN_MEASUREMENT CEngDsT_t CEngDsT_tStop Eep_EnvRamHist Eep_EnvRamInvld EngStrt_bFrstStrtEnd EngStrt_bStrtEnd EnvT_t Epm_nEngLRes FanCtl_rFan1ActMdl FuPHi_pRail OilSwmpT_t rkvmeeff_w_msg SyC_stSub tans_msg tengsq1_w_msg tfuelhpab_msg tfuelsqab_msg TiEngOff_stTi tnsezmot_w_msg tnsez_w_msg tumc_msg VehV_v /end IN_MEASUREMENT
 /begin OUT_MEASUREMENT B_tfuelmc_msg B_tfuelmg_msg tflmass_w_msg tfuelhdp_msg tfuelhpm_msg tfuelmq_msg tfuelm_msg /end OUT_MEASUREMENT
 /begin LOC_MEASUREMENT B_coldst B_pwfres B_stendz_bgtfuelm_loc B_stend_bgtfuelm_loc B_tfuelmc_bgtfuelm_loc B_tfuelmg_bgtfuelm_loc B_tfuelpwf coolbasf coolhpbas diffsthdp diffthptk difftmta fuelhpbasf FuPHi_pRail_bgtfuelm_loc nmot_bgtfuelm_loc rkvmeeff_w_bgtfuelm_loc tambtfuel tambtfuellp tans_bgtfuelm_loc tengslst_bgtfuelm_loc tengsq1_w_bgtfuelm_loc tflcoolhp tflhdp tflhdpf tflhpfakt tflhpmass tflhpmassf tflmass_w_bgtfuelm_loc tflsthdp tflsthdpf tfltum tfuelbas tfuelbasf tfuelhdp_bgtfuelm_loc tfuelhpab_bgtfuelm_loc tfuelhpbas tfuelhpm_bgtfuelm_loc tfuelhpst tfuelmass tfuelmassf tfuelmq_bgtfuelm_loc tfuelm_bgtfuelm_loc tfuelsqab_bgtfuelm_loc tfuelstart tfuelvfzg tfuelvfzgf tmotab_bgtfuelm_loc tmotred tmotredf tmotredr tmot_bgtfuelm_loc tnsezmot_w_bgtfuelm_loc tnsez_w_bgtfuelm_loc tosp_bgtfuelm_loc tumc_bgtfuelm_loc tumtfuel tum_bgtfuelm_loc tvlueft_bgtfuelm_loc vfzg_bgtfuelm_loc zkhdpms_w zkhdp_w zkhpmot_w zkhpred_w zkhpt_w /end LOC_MEASUREMENT
 FUNCTION_VERSION "51.9.1" /end FUNCTION
/begin FUNCTION BGTHDEV "5.8.0     Calculation of HDEV-temperature"
 /begin DEF_CHARACTERISTIC CWTHDEVAPL FTITHDEV KFCLTHDEV KFTHDEVST KFTITHDEV KFTMOTHDEV KFTMTHDEV KFTREDHDEV KFTUMTHDEV KFVTHDEV KLMKTHDEV THDEVAPL THDEVQUALI THDEVTMOT THDEVTWRM TVCALCHDEV /end DEF_CHARACTERISTIC
 /begin IN_MEASUREMENT B_sa_msg B_tfuelg_msg B_tospg_msg CEngDsT_t CEngDsT_tStop CEngDsT_tStrtFrst Eep_EnvRamHist Eep_EnvRamInvld EngStrt_bFrstStrtEnd EngStrt_bStrtEnd EnvT_t Epm_nEngLRes FlSys_tFlHPSys FlSys_tFlLPSys InjSys_nrInjCyc OilSwmpT_t SyC_stSub tans_msg tflmass_w_msg TiEngOff_bRst TiEngOff_stTi TiEngOff_ti tnsezmot_w_msg tvlueft_msg VehV_v /end IN_MEASUREMENT
 /begin OUT_MEASUREMENT B_thdevmg_msg thdevabst_msg thdev_msg /end OUT_MEASUREMENT
 /begin LOC_MEASUREMENT anzeshdev anzesmfhdv BGTHDEV_TOFFV.outbit BGTHDEV_TOFFV.time B_calchdev B_thdevpwf diffhdevti difftmthdv FUELCALC_TOFFV.outbit FUELCALC_TOFFV.time InjSys_tEngCooltTStop InjSys_tEngTSeln InjSys_tEngTStrt InjSys_tiEngoff InjSys_tStrtFrstHpInjVlv InjSys_vVehCalcdTHpInjVlv mkroh_w tfuelsqhdv thdevarea thdevfakt thdevgru thdevgruf thdevred thdevredf thdevstart thdevti thdevtif thdevvfz thdevvfzgf tmtomw ttmothdv_w tumthdev zkhdevcol_w zkhdevew_w zktmotr_w /end LOC_MEASUREMENT
 FUNCTION_VERSION "5.8.0" /end FUNCTION
/begin FUNCTION BGTMO2KA "1.12.0    Influence of 2nd fuel on torque and ignition models" /begin DEF_CHARACTERISTIC KFZWOPK0 KFZWOPVK0 KLF2KA KLF2KAZW TMECmb_TqOptm2Fu_M /end DEF_CHARACTERISTIC /begin REF_CHARACTERISTIC SNMOPUW SNMOVUW SRLOPUW SRLOVUW /end REF_CHARACTERISTIC
 /begin IN_MEASUREMENT AirMod_ratChrgAirCylAdv_a Epm_nEng fethmnmx_w_msg Gen_ctCylAdv Ign_bVlvLInNxtIAs mioptl1h_w_msg zwoptl1_w_msg /end IN_MEASUREMENT
 /begin OUT_MEASUREMENT dzwo2ka_w_msg eta2ka_w_msg f2kazw_msg f2ka_msg TMECmb_facFu2Adv_a /end OUT_MEASUREMENT
 /begin LOC_MEASUREMENT dzwo2kaloc_w f2kaloc f2kazwloc split2ka /end LOC_MEASUREMENT
 FUNCTION_VERSION "1.12.0" /end FUNCTION
/begin FUNCTION BGTMOHDI "159.1.0   Computation of correction values for homogeneous double injection (HSP, HKS)"
 /begin DEF_CHARACTERISTIC ETAAUFTEMN TMECmb_facEthCorrn_T TMECmb_HspMdl0_I.diaRef_M TMECmb_HspMdl0_I.eta_M TMECmb_HspMdl1_I.diaRef_M TMECmb_HspMdl1_I.eta_M TMECmb_HspMdl2_I.diaRef_M TMECmb_HspMdl2_I.eta_M TMECmb_HspMdlEth0_I.diaRef_M TMECmb_HspMdlEth0_I.eta_M TMECmb_HspMdlEth1_I.diaRef_M TMECmb_HspMdlEth1_I.eta_M TMECmb_HspMdlEth2_I.diaRef_M TMECmb_HspMdlEth2_I.eta_M TMECmb_stEom2CmbMdl_GT /end DEF_CHARACTERISTIC
 /begin REF_CHARACTERISTIC CoEOM_stEomDesReqd_AX /end REF_CHARACTERISTIC
 /begin IN_MEASUREMENT AirMod_ratChrgAirCylAdv_a CoEOM_stEomCylAdv_a Epm_nEng fethmnmx_w Gen_ctCylAdv /end IN_MEASUREMENT
 /begin OUT_MEASUREMENT dzwohsp_w_msg etaaufte_w_msg TMECmb_diaRefSplitInjAdv_a TMECmb_facSplitInjAdv_a /end OUT_MEASUREMENT
 /begin LOC_MEASUREMENT TMECmb_diaRefSplitInj TMECmb_diaRefSplitInjEth TMECmb_facSplitInj TMECmb_facSplitInjEth TMECmb_idxHspMdl TMECmb_IfEtaInjSplit_I.nEng TMECmb_IfEtaInjSplit_I.ratChargeAir /end LOC_MEASUREMENT
 FUNCTION_VERSION "159.1.0" /end FUNCTION
/begin COMPU_METHOD AngleCrS "" RAT_FUNC "%6.4" "deg CrS" COEFFS 0 45.5111111111 0 0 0 1 /end COMPU_METHOD
/begin COMPU_METHOD bfzg_q0p1085069 "" RAT_FUNC "%6.3" "m/s^2" COEFFS 0 31248000 0 0 0 3390625 /end COMPU_METHOD
/begin COMPU_METHOD B_TRUE "" TAB_VERB "%6.3" "" COMPU_TAB_REF B_TRUE /end COMPU_METHOD
/begin COMPU_VTAB B_TRUE "" TAB_VERB 2 0 "FALSE" 1 "TRUE" /end COMPU_VTAB
/begin COMPU_METHOD COEOM_INJCRVPOI2NUMSWTDES_SY_Compu "" RAT_FUNC "%6.2" "" COEFFS 0 1 0 0 0 1 /end COMPU_METHOD
/begin COMPU_METHOD COEOM_INJCRVPOI3NUMMAP_SY_Compu "" RAT_FUNC "%6.2" "" COEFFS 0 1 0 0 0 1 /end COMPU_METHOD
/begin COMPU_METHOD COEOM_INJCRVPOI3NUMSWTDES_SY_Compu "" RAT_FUNC "%6.2" "" COEFFS 0 1 0 0 0 1 /end COMPU_METHOD
/begin COMPU_METHOD CoEOM_stEomStgTot_VERB "" TAB_VERB "%6.3" "-" COMPU_TAB_REF CoEOM_stEomStgTot_VERB /end COMPU_METHOD
/begin COMPU_VTAB CoEOM_stEomStgTot_VERB "" TAB_VERB 513 0 "Base_HOM-SNGL_FullLft" 1 "Base_HOM_FullLft" 2 "Base_HSP_FullLft" 3 "Base_HSPIC_FullLft" 4 "Base_HOM-SNGL_EIVC" 5 "Base_HOM_EIVC" 6 "Base_HSP_EIVC" 7 "Base_HSPIC_EIVC" 8 "n/a [00;08]" 9 "n/a [00;09]" 10 "n/a [00;10]" 11 "n/a [00;11]" 12 "n/a [00;12]" 13 "n/a [00;13]" 14 "n/a [00;14]" 15 "n/a [00;15]" 255 "No_Demand" 256 "WarmUp_HOM-SNGL_FullLft" 257 "WarmUp_HOM_FullLft" 258 "WarmUp_HSP_FullLft" 259 "WarmUp_HSPIC_FullLft" 260 "WarmUp_HOM-SNGL_EIVC" 261 "WarmUp_HOM_EIVC" 262 "WarmUp_HSP_EIVC" 263 "WarmUp_HSPIC_EIVC" 264 "n/a [01;08]" 265 "n/a [01;09]" 266 "n/a [01;10]" 267 "n/a [01;11]" 268 "n/a [01;12]" 269 "n/a [01;13]" 270 "n/a [01;14]" 271 "n/a [01;15]" 512 "CatHtg_HOM-SNGL_FullLft" 513 "CatHtg_HOM_FullLft" 514 "CatHtg_HSP_FullLft" 515 "CatHtg_HSPIC_FullLft" 516 "CatHtg_HOM-SNGL_EIVC" 517 "CatHtg_HOM_EIVC" 518 "CatHtg_HSP_EIVC" 519 "CatHtg_HSPIC_EIVC" 520 "n/a [02;08]" 521 "n/a [02;09]" 522 "n/a [02;10]" 523 "n/a [02;11]" 524 "n/a [02;12]" 525 "n/a [02;13]" 526 "n/a [02;14]" 527 "n/a [02;15]" 768 "Start_FullLft" 769 "n/a [03;01]" 770 "n/a [03;02]" 771 "n/a [03;03]" 772 "Start_EIVC" 773 "n/a [03;05]" 774 "n/a [03;06]" 775 "n/a [03;07]" 776 "n/a [03;08]" 777 "n/a [03;09]" 778 "n/a [03;10]" 779 "n/a [03;11]" 780 "n/a [03;12]" 781 "n/a [03;13]" 782 "n/a [03;14]" 783 "n/a [03;15]" 1024 "n/a [04;00]" 1025 "n/a [04;01]" 1026 "n/a [04;02]" 1027 "n/a [04;03]" 1028 "n/a [04;04]" 1029 "n/a [04;05]" 1030 "n/a [04;06]" 1031 "n/a [04;07]" 1032 "n/a [04;08]" 1033 "n/a [04;09]" 1034 "n/a [04;10]" 1035 "n/a [04;11]" 1036 "n/a [04;12]" 1037 "n/a [04;13]" 1038 "n/a [04;14]" 1039 "n/a [04;15]" 1280 "n/a [05;00]" 1281 "n/a [05;01]" 1282 "n/a [05;02]" 1283 "n/a [05;03]" 1284 "n/a [05;04]" 1285 "n/a [05;05]" 1286 "n/a [05;06]" 1287 "n/a [05;07]" 1288 "n/a [05;08]" 1289 "n/a [05;09]" 1290 "n/a [05;10]" 1291 "n/a [05;11]" 1292 "n/a [05;12]" 1293 "n/a [05;13]" 1294 "n/a [05;14]" 1295 "n/a [05;15]" 1536 "n/a [06;00]" 1537 "n/a [06;01]" 1538 "n/a [06;02]" 1539 "n/a [06;03]" 1540 "n/a [06;04]" 1541 "n/a [06;05]" 1542 "n/a [06;06]" 1543 "n/a [06;07]" 1544 "n/a [06;08]" 1545 "n/a [06;09]" 1546 "n/a [06;10]" 1547 "n/a [06;11]" 1548 "n/a [06;12]" 1549 "n/a [06;13]" 1550 "n/a [06;14]" 1551 "n/a [06;15]" 1792 "n/a [07;00]" 1793 "n/a [07;01]" 1794 "n/a [07;02]" 1795 "n/a [07;03]" 1796 "n/a [07;04]" 1797 "n/a [07;05]" 1798 "n/a [07;06]" 1799 "n/a [07;07]" 1800 "n/a [07;08]" 1801 "n/a [07;09]" 1802 "n/a [07;10]" 1803 "n/a [07;11]" 1804 "n/a [07;12]" 1805 "n/a [07;13]" 1806 "n/a [07;14]" 1807 "n/a [07;15]" 2048 "n/a [08;00]" 2049 "n/a [08;01]" 2050 "n/a [08;02]" 2051 "n/a [08;03]" 2052 "n/a [08;04]" 2053 "n/a [08;05]" 2054 "n/a [08;06]" 2055 "n/a [08;07]" 2056 "n/a [08;08]" 2057 "n/a [08;09]" 2058 "n/a [08;10]" 2059 "n/a [08;11]" 2060 "n/a [08;12]" 2061 "n/a [08;13]" 2062 "n/a [08;14]" 2063 "n/a [08;15]" 2304 "n/a [09;00]" 2305 "n/a [09;01]" 2306 "n/a [09;02]" 2307 "n/a [09;03]" 2308 "n/a [09;04]" 2309 "n/a [09;05]" 2310 "n/a [09;06]" 2311 "n/a [09;07]" 2312 "n/a [09;08]" 2313 "n/a [09;09]" 2314 "n/a [09;10]" 2315 "n/a [09;11]" 2316 "n/a [09;12]" 2317 "n/a [09;13]" 2318 "n/a [09;14]" 2319 "n/a [09;15]" 2560 "n/a [10;00]" 2561 "n/a [10;01]" 2562 "n/a [10;02]" 2563 "n/a [10;03]" 2564 "n/a [10;04]" 2565 "n/a [10;05]" 2566 "n/a [10;06]" 2567 "n/a [10;07]" 2568 "n/a [10;08]" 2569 "n/a [10;09]" 2570 "n/a [10;10]" 2571 "n/a [10;11]" 2572 "n/a [10;12]" 2573 "n/a [10;13]" 2574 "n/a [10;14]" 2575 "n/a [10;15]" 2816 "n/a [11;00]" 2817 "n/a [11;01]" 2818 "n/a [11;02]" 2819 "n/a [11;03]" 2820 "n/a [11;04]" 2821 "n/a [11;05]" 2822 "n/a [11;06]" 2823 "n/a [11;07]" 2824 "n/a [11;08]" 2825 "n/a [11;09]" 2826 "n/a [11;10]" 2827 "n/a [11;11]" 2828 "n/a [11;12]" 2829 "n/a [11;13]" 2830 "n/a [11;14]" 2831 "n/a [11;15]" 3072 "n/a [12;00]" 3073 "n/a [12;01]" 3074 "n/a [12;02]" 3075 "n/a [12;03]" 3076 "n/a [12;04]" 3077 "n/a [12;05]" 3078 "n/a [12;06]" 3079 "n/a [12;07]" 3080 "n/a [12;08]" 3081 "n/a [12;09]" 3082 "n/a [12;10]" 3083 "n/a [12;11]" 3084 "n/a [12;12]" 3085 "n/a [12;13]" 3086 "n/a [12;14]" 3087 "n/a [12;15]" 3328 "n/a [13;00]" 3329 "n/a [13;01]" 3330 "n/a [13;02]" 3331 "n/a [13;03]" 3332 "n/a [13;04]" 3333 "n/a [13;05]" 3334 "n/a [13;06]" 3335 "n/a [13;07]" 3336 "n/a [13;08]" 3337 "n/a [13;09]" 3338 "n/a [13;10]" 3339 "n/a [13;11]" 3340 "n/a [13;12]" 3341 "n/a [13;13]" 3342 "n/a [13;14]" 3343 "n/a [13;15]" 3584 "n/a [14;00]" 3585 "n/a [14;01]" 3586 "n/a [14;02]" 3587 "n/a [14;03]" 3588 "n/a [14;04]" 3589 "n/a [14;05]" 3590 "n/a [14;06]" 3591 "n/a [14;07]" 3592 "n/a [14;08]" 3593 "n/a [14;09]" 3594 "n/a [14;10]" 3595 "n/a [14;11]" 3596 "n/a [14;12]" 3597 "n/a [14;13]" 3598 "n/a [14;14]" 3599 "n/a [14;15]" 3840 "n/a [15;00]" 3841 "n/a [15;01]" 3842 "n/a [15;02]" 3843 "n/a [15;03]" 3844 "n/a [15;04]" 3845 "n/a [15;05]" 3846 "n/a [15;06]" 3847 "n/a [15;07]" 3848 "n/a [15;08]" 3849 "n/a [15;09]" 3850 "n/a [15;10]" 3851 "n/a [15;11]" 3852 "n/a [15;12]" 3853 "n/a [15;13]" 3854 "n/a [15;14]" 3855 "n/a [15;15]" 4096 "n/a [16;00]" 4097 "n/a [16;01]" 4098 "n/a [16;02]" 4099 "n/a [16;03]" 4100 "n/a [16;04]" 4101 "n/a [16;05]" 4102 "n/a [16;06]" 4103 "n/a [16;07]" 4104 "n/a [16;08]" 4105 "n/a [16;09]" 4106 "n/a [16;10]" 4107 "n/a [16;11]" 4108 "n/a [16;12]" 4109 "n/a [16;13]" 4110 "n/a [16;14]" 4111 "n/a [16;15]" 4352 "n/a [17;00]" 4353 "n/a [17;01]" 4354 "n/a [17;02]" 4355 "n/a [17;03]" 4356 "n/a [17;04]" 4357 "n/a [17;05]" 4358 "n/a [17;06]" 4359 "n/a [17;07]" 4360 "n/a [17;08]" 4361 "n/a [17;09]" 4362 "n/a [17;10]" 4363 "n/a [17;11]" 4364 "n/a [17;12]" 4365 "n/a [17;13]" 4366 "n/a [17;14]" 4367 "n/a [17;15]" 4608 "n/a [18;00]" 4609 "n/a [18;01]" 4610 "n/a [18;02]" 4611 "n/a [18;03]" 4612 "n/a [18;04]" 4613 "n/a [18;05]" 4614 "n/a [18;06]" 4615 "n/a [18;07]" 4616 "n/a [18;08]" 4617 "n/a [18;09]" 4618 "n/a [18;10]" 4619 "n/a [18;11]" 4620 "n/a [18;12]" 4621 "n/a [18;13]" 4622 "n/a [18;14]" 4623 "n/a [18;15]" 4864 "n/a [19;00]" 4865 "n/a [19;01]" 4866 "n/a [19;02]" 4867 "n/a [19;03]" 4868 "n/a [19;04]" 4869 "n/a [19;05]" 4870 "n/a [19;06]" 4871 "n/a [19;07]" 4872 "n/a [19;08]" 4873 "n/a [19;09]" 4874 "n/a [19;10]" 4875 "n/a [19;11]" 4876 "n/a [19;12]" 4877 "n/a [19;13]" 4878 "n/a [19;14]" 4879 "n/a [19;15]" 5120 "n/a [20;00]" 5121 "n/a [20;01]" 5122 "n/a [20;02]" 5123 "n/a [20;03]" 5124 "n/a [20;04]" 5125 "n/a [20;05]" 5126 "n/a [20;06]" 5127 "n/a [20;07]" 5128 "n/a [20;08]" 5129 "n/a [20;09]" 5130 "n/a [20;10]" 5131 "n/a [20;11]" 5132 "n/a [20;12]" 5133 "n/a [20;13]" 5134 "n/a [20;14]" 5135 "n/a [20;15]" 5376 "n/a [21;00]" 5377 "n/a [21;01]" 5378 "n/a [21;02]" 5379 "n/a [21;03]" 5380 "n/a [21;04]" 5381 "n/a [21;05]" 5382 "n/a [21;06]" 5383 "n/a [21;07]" 5384 "n/a [21;08]" 5385 "n/a [21;09]" 5386 "n/a [21;10]" 5387 "n/a [21;11]" 5388 "n/a [21;12]" 5389 "n/a [21;13]" 5390 "n/a [21;14]" 5391 "n/a [21;15]" 5632 "n/a [22;00]" 5633 "n/a [22;01]" 5634 "n/a [22;02]" 5635 "n/a [22;03]" 5636 "n/a [22;04]" 5637 "n/a [22;05]" 5638 "n/a [22;06]" 5639 "n/a [22;07]" 5640 "n/a [22;08]" 5641 "n/a [22;09]" 5642 "n/a [22;10]" 5643 "n/a [22;11]" 5644 "n/a [22;12]" 5645 "n/a [22;13]" 5646 "n/a [22;14]" 5647 "n/a [22;15]" 5888 "n/a [23;00]" 5889 "n/a [23;01]" 5890 "n/a [23;02]" 5891 "n/a [23;03]" 5892 "n/a [23;04]" 5893 "n/a [23;05]" 5894 "n/a [23;06]" 5895 "n/a [23;07]" 5896 "n/a [23;08]" 5897 "n/a [23;09]" 5898 "n/a [23;10]" 5899 "n/a [23;11]" 5900 "n/a [23;12]" 5901 "n/a [23;13]" 5902 "n/a [23;14]" 5903 "n/a [23;15]" 6144 "n/a [24;00]" 6145 "n/a [24;01]" 6146 "n/a [24;02]" 6147 "n/a [24;03]" 6148 "n/a [24;04]" 6149 "n/a [24;05]" 6150 "n/a [24;06]" 6151 "n/a [24;07]" 6152 "n/a [24;08]" 6153 "n/a [24;09]" 6154 "n/a [24;10]" 6155 "n/a [24;11]" 6156 "n/a [24;12]" 6157 "n/a [24;13]" 6158 "n/a [24;14]" 6159 "n/a [24;15]" 6400 "n/a [25;00]" 6401 "n/a [25;01]" 6402 "n/a [25;02]" 6403 "n/a [25;03]" 6404 "n/a [25;04]" 6405 "n/a [25;05]" 6406 "n/a [25;06]" 6407 "n/a [25;07]" 6408 "n/a [25;08]" 6409 "n/a [25;09]" 6410 "n/a [25;10]" 6411 "n/a [25;11]" 6412 "n/a [25;12]" 6413 "n/a [25;13]" 6414 "n/a [25;14]" 6415 "n/a [25;15]" 6656 "n/a [26;00]" 6657 "n/a [26;01]" 6658 "n/a [26;02]" 6659 "n/a [26;03]" 6660 "n/a [26;04]" 6661 "n/a [26;05]" 6662 "n/a [26;06]" 6663 "n/a [26;07]" 6664 "n/a [26;08]" 6665 "n/a [26;09]" 6666 "n/a [26;10]" 6667 "n/a [26;11]" 6668 "n/a [26;12]" 6669 "n/a [26;13]" 6670 "n/a [26;14]" 6671 "n/a [26;15]" 6912 "n/a [27;00]" 6913 "n/a [27;01]" 6914 "n/a [27;02]" 6915 "n/a [27;03]" 6916 "n/a [27;04]" 6917 "n/a [27;05]" 6918 "n/a [27;06]" 6919 "n/a [27;07]" 6920 "n/a [27;08]" 6921 "n/a [27;09]" 6922 "n/a [27;10]" 6923 "n/a [27;11]" 6924 "n/a [27;12]" 6925 "n/a [27;13]" 6926 "n/a [27;14]" 6927 "n/a [27;15]" 7168 "n/a [28;00]" 7169 "n/a [28;01]" 7170 "n/a [28;02]" 7171 "n/a [28;03]" 7172 "n/a [28;04]" 7173 "n/a [28;05]" 7174 "n/a [28;06]" 7175 "n/a [28;07]" 7176 "n/a [28;08]" 7177 "n/a [28;09]" 7178 "n/a [28;10]" 7179 "n/a [28;11]" 7180 "n/a [28;12]" 7181 "n/a [28;13]" 7182 "n/a [28;14]" 7183 "n/a [28;15]" 7424 "n/a [29;00]" 7425 "n/a [29;01]" 7426 "n/a [29;02]" 7427 "n/a [29;03]" 7428 "n/a [29;04]" 7429 "n/a [29;05]" 7430 "n/a [29;06]" 7431 "n/a [29;07]" 7432 "n/a [29;08]" 7433 "n/a [29;09]" 7434 "n/a [29;10]" 7435 "n/a [29;11]" 7436 "n/a [29;12]" 7437 "n/a [29;13]" 7438 "n/a [29;14]" 7439 "n/a [29;15]" 7680 "n/a [30;00]" 7681 "n/a [30;01]" 7682 "n/a [30;02]" 7683 "n/a [30;03]" 7684 "n/a [30;04]" 7685 "n/a [30;05]" 7686 "n/a [30;06]" 7687 "n/a [30;07]" 7688 "n/a [30;08]" 7689 "n/a [30;09]" 7690 "n/a [30;10]" 7691 "n/a [30;11]" 7692 "n/a [30;12]" 7693 "n/a [30;13]" 7694 "n/a [30;14]" 7695 "n/a [30;15]" 7936 "n/a [31;00]" 7937 "n/a [31;01]" 7938 "n/a [31;02]" 7939 "n/a [31;03]" 7940 "n/a [31;04]" 7941 "n/a [31;05]" 7942 "n/a [31;06]" 7943 "n/a [31;07]" 7944 "n/a [31;08]" 7945 "n/a [31;09]" 7946 "n/a [31;10]" 7947 "n/a [31;11]" 7948 "n/a [31;12]" 7949 "n/a [31;13]" 7950 "n/a [31;14]" 7951 "n/a [31;15]" /end COMPU_VTAB
/begin COMPU_METHOD COEOM_TYP_SY_Compu "" TAB_VERB "%6.3" "" COMPU_TAB_REF COEOM_TYP_SY_Compu /end COMPU_METHOD
/begin COMPU_VTAB COEOM_TYP_SY_Compu "" TAB_VERB 2 1 "HESRV_SNGLFLW" 2 "HESRV_TWFLW" /end COMPU_VTAB
/begin COMPU_METHOD COESS_RCPTMNG_SY_Compu "" TAB_VERB "%6.3" "" COMPU_TAB_REF COESS_RCPTMNG_SY_Compu /end COMPU_METHOD
/begin COMPU_VTAB COESS_RCPTMNG_SY_Compu "" TAB_VERB 2 0 "False" 1 "True" /end COMPU_VTAB
/begin COMPU_METHOD COLDSTRTHEATGCTRL_SC_Compu "" TAB_VERB "%6.3" "" COMPU_TAB_REF COLDSTRTHEATGCTRL_SC_Compu /end COMPU_METHOD
/begin COMPU_VTAB COLDSTRTHEATGCTRL_SC_Compu "" TAB_VERB 3 0 "NO_FHCU" 1 "FHCU_SER" 2 "FHCU_LIN" /end COMPU_VTAB
/begin COMPU_METHOD COLDSTRTVLV_SC_Compu "" TAB_VERB "%6.3" "" COMPU_TAB_REF COLDSTRTVLV_SC_Compu /end COMPU_METHOD
/begin COMPU_VTAB COLDSTRTVLV_SC_Compu "" TAB_VERB 4 0 "no cold start valve" 1 "angle sync. control" 2 "time sync. control" 3 "no_control_on_cold-start_valve" /end COMPU_VTAB
/begin COMPU_METHOD COMassPerTime "" RAT_FUNC "%6.4" "mg/s" COEFFS 0 20 0 0 0 1 /end COMPU_METHOD
/begin COMPU_METHOD COMCIL_COMTYPE_SY_Compu "" TAB_VERB "%6.3" "" COMPU_TAB_REF COMCIL_COMTYPE_SY_Compu /end COMPU_METHOD
/begin COMPU_VTAB COMCIL_COMTYPE_SY_Compu "" TAB_VERB 4 1 "CAN 11hex" 2 "CAN 12hex" 3 "FlexRay" 4 "BN35up" /end COMPU_VTAB
/begin COMPU_METHOD COMDIA_BITFAIFSUPRT_SC_Compu "" TAB_VERB "%6.3" "" COMPU_TAB_REF COMDIA_BITFAIFSUPRT_SC_Compu /end COMPU_METHOD
/begin COMPU_VTAB COMDIA_BITFAIFSUPRT_SC_Compu "" TAB_VERB 2 0 "False" 1 "True" /end COMPU_VTAB
/begin COMPU_METHOD COMDIA_RTEENA_SC_Compu "" TAB_VERB "%6.3" "" COMPU_TAB_REF COMDIA_RTEENA_SC_Compu /end COMPU_METHOD
/begin COMPU_VTAB COMDIA_RTEENA_SC_Compu "" TAB_VERB 2 0 "False" 1 "True" /end COMPU_VTAB
/begin COMPU_METHOD COMM_SC_Compu "" TAB_VERB "%6.3" "" COMPU_TAB_REF COMM_SC_Compu /end COMPU_METHOD
/begin COMPU_VTAB COMM_SC_Compu "" TAB_VERB 2 0 "False" 1 "True" /end COMPU_VTAB
/begin COMPU_METHOD COMVERS_SC_Compu "" TAB_VERB "%6.3" "" COMPU_TAB_REF COMVERS_SC_Compu /end COMPU_METHOD
/begin COMPU_VTAB COMVERS_SC_Compu "" TAB_VERB 4 0 "COMVERS_V4V5" 1 "COMVERS_MLB" 2 "COMVERS_MQB" 3 "COMVERS_MLBEVO" /end COMPU_VTAB
/begin COMPU_METHOD COM_ENADCDC_SC_Compu "" TAB_VERB "%6.3" "" COMPU_TAB_REF COM_ENADCDC_SC_Compu /end COMPU_METHOD
/begin COMPU_VTAB COM_ENADCDC_SC_Compu "" TAB_VERB 2 0 "False" 1 "True" /end COMPU_VTAB
/begin COMPU_METHOD COM_SC_Compu "" TAB_VERB "%6.3" "" COMPU_TAB_REF COM_SC_Compu /end COMPU_METHOD
/begin COMPU_VTAB COM_SC_Compu "" TAB_VERB 2 0 "False" 1 "True" /end COMPU_VTAB
/begin COMPU_METHOD CONDRDSFLDP_TYPAVL_SC_Compu "" TAB_VERB "%6.3" "" COMPU_TAB_REF CONDRDSFLDP_TYPAVL_SC_Compu /end COMPU_METHOD
/begin COMPU_VTAB CONDRDSFLDP_TYPAVL_SC_Compu "" TAB_VERB 2 0 "False" 1 "True" /end COMPU_VTAB
/begin COMPU_METHOD CONDRDSFLDT_TYPAVL_SC_Compu "" TAB_VERB "%6.3" "" COMPU_TAB_REF CONDRDSFLDT_TYPAVL_SC_Compu /end COMPU_METHOD
/begin COMPU_VTAB CONDRDSFLDT_TYPAVL_SC_Compu "" TAB_VERB 2 0 "False" 1 "True" /end COMPU_VTAB
/begin COMPU_METHOD CONDRUSFLDT_TYPAVL_SC_Compu "" TAB_VERB "%6.3" "" COMPU_TAB_REF CONDRUSFLDT_TYPAVL_SC_Compu /end COMPU_METHOD
/begin COMPU_VTAB CONDRUSFLDT_TYPAVL_SC_Compu "" TAB_VERB 2 0 "False" 1 "True" /end COMPU_VTAB
/begin COMPU_METHOD CONTPOSNEG_SY_Compu "" TAB_VERB "%6.3" "" COMPU_TAB_REF CONTPOSNEG_SY_Compu /end COMPU_METHOD
/begin COMPU_VTAB CONTPOSNEG_SY_Compu "" TAB_VERB 2 0 "FALSE" 1 "TRUE" /end COMPU_VTAB
/begin COMPU_METHOD CONV_LDOILCOOLRPMP_SY_Compu "" TAB_VERB "%6.3" "" COMPU_TAB_REF CONV_LDOILCOOLRPMP_SY_Compu /end COMPU_METHOD
/begin COMPU_VTAB CONV_LDOILCOOLRPMP_SY_Compu "" TAB_VERB 2 0 "False" 1 "True" /end COMPU_VTAB
/begin COMPU_METHOD COOLGVLVCTRLENA_SC_Compu "" TAB_VERB "%6.3" "" COMPU_TAB_REF COOLGVLVCTRLENA_SC_Compu /end COMPU_METHOD
/begin COMPU_VTAB COOLGVLVCTRLENA_SC_Compu "" TAB_VERB 2 0 "False" 1 "True" /end COMPU_VTAB
/begin COMPU_METHOD COOLTCTRLVLV_SC_Compu "" TAB_VERB "%6.3" "" COMPU_TAB_REF COOLTCTRLVLV_SC_Compu /end COMPU_METHOD
/begin COMPU_VTAB COOLTCTRLVLV_SC_Compu "" TAB_VERB 2 0 "NO" 1 "CCV_standard" /end COMPU_VTAB
/begin COMPU_METHOD COOLTPFANDMDVRNTSELN_SC_Compu "" TAB_VERB "%6.3" "" COMPU_TAB_REF COOLTPFANDMDVRNTSELN_SC_Compu /end COMPU_METHOD
/begin COMPU_VTAB COOLTPFANDMDVRNTSELN_SC_Compu "" TAB_VERB 2 1 "2WF_variant" 2 "GDI_variant" /end COMPU_VTAB
/begin COMPU_METHOD COOLTPIN_TYPAVL_SC_Compu "" TAB_VERB "%6.3" "" COMPU_TAB_REF COOLTPIN_TYPAVL_SC_Compu /end COMPU_METHOD
/begin COMPU_VTAB COOLTPIN_TYPAVL_SC_Compu "" TAB_VERB 2 0 "False" 1 "True" /end COMPU_VTAB
/begin COMPU_METHOD COOLTPOUT_TYPAVL_SC_Compu "" TAB_VERB "%6.3" "" COMPU_TAB_REF COOLTPOUT_TYPAVL_SC_Compu /end COMPU_METHOD
/begin COMPU_VTAB COOLTPOUT_TYPAVL_SC_Compu "" TAB_VERB 2 0 "False" 1 "True" /end COMPU_VTAB
/begin COMPU_METHOD COOLTTIN_TYPAVL_SC_Compu "" TAB_VERB "%6.3" "" COMPU_TAB_REF COOLTTIN_TYPAVL_SC_Compu /end COMPU_METHOD
/begin COMPU_VTAB COOLTTIN_TYPAVL_SC_Compu "" TAB_VERB 2 0 "False" 1 "True" /end COMPU_VTAB
/begin COMPU_METHOD COOLTTOUT_TYPAVL_SY_Compu "" TAB_VERB "%6.3" "" COMPU_TAB_REF COOLTTOUT_TYPAVL_SY_Compu /end COMPU_METHOD
/begin COMPU_VTAB COOLTTOUT_TYPAVL_SY_Compu "" TAB_VERB 2 0 "False" 1 "True" /end COMPU_VTAB
/begin COMPU_METHOD COOLTTRADROUT_TYPAVL_SC_Compu "" TAB_VERB "%6.3" "" COMPU_TAB_REF COOLTTRADROUT_TYPAVL_SC_Compu /end COMPU_METHOD
/begin COMPU_VTAB COOLTTRADROUT_TYPAVL_SC_Compu "" TAB_VERB 2 0 "False" 1 "True" /end COMPU_VTAB
/begin COMPU_METHOD COOPCLSTRCORE_SC_Compu "" TAB_VERB "%6.3" "" COMPU_TAB_REF COOPCLSTRCORE_SC_Compu /end COMPU_METHOD
/begin COMPU_VTAB COOPCLSTRCORE_SC_Compu "" TAB_VERB 3 0 "PeripheralCoreNo1" 1 "LockedCoreNo1" 2 "PerformanceCoreNo1" /end COMPU_VTAB
/begin COMPU_METHOD COPOM_INHOUSE_SC_Compu "" TAB_VERB "%6.3" "" COMPU_TAB_REF COPOM_INHOUSE_SC_Compu /end COMPU_METHOD
/begin COMPU_VTAB COPOM_INHOUSE_SC_Compu "" TAB_VERB 2 0 "False" 1 "True" /end COMPU_VTAB
/begin COMPU_METHOD CORRZLRSTMOT_SY_Compu "" TAB_VERB "%6.3" "" COMPU_TAB_REF CORRZLRSTMOT_SY_Compu /end COMPU_METHOD
/begin COMPU_VTAB CORRZLRSTMOT_SY_Compu "" TAB_VERB 2 0 "False" 1 "True" /end COMPU_VTAB
/begin COMPU_METHOD COVEH_STREETMODENA_SC_Compu "" TAB_VERB "%6.3" "" COMPU_TAB_REF COVEH_STREETMODENA_SC_Compu /end COMPU_METHOD
/begin COMPU_VTAB COVEH_STREETMODENA_SC_Compu "" TAB_VERB 2 0 "False" 1 "True" /end COMPU_VTAB
/begin COMPU_METHOD COVOMVERS_SC_Compu "" TAB_VERB "%6.3" "" COMPU_TAB_REF COVOMVERS_SC_Compu /end COMPU_METHOD
/begin COMPU_VTAB COVOMVERS_SC_Compu "" TAB_VERB 2 1 "COVOMVER_1_0" 2 "COVOMVER_2_0" /end COMPU_VTAB
/begin COMPU_METHOD CppFacCylVol "" RAT_FUNC "%7.6" "-" COEFFS 0 32768 0 0 0 1 /end COMPU_METHOD
/begin COMPU_METHOD CppOfsFact "" RAT_FUNC "%6.4" "-" COEFFS 0 256 0 0 0 1 /end COMPU_METHOD
/begin COMPU_METHOD CPUDEVICE_SC_Compu "" TAB_VERB "%6.3" "" COMPU_TAB_REF CPUDEVICE_SC_Compu /end COMPU_METHOD
/begin COMPU_VTAB CPUDEVICE_SC_Compu "" TAB_VERB 10 0 "None" 1 "Device1" 2 "Device2" 3 "Device3" 4 "Device4" 5 "Device5" 13 "Device3+" 14 "Device4+" 15 "Device5+" 16 "Device5_28" /end COMPU_VTAB
/begin COMPU_METHOD CPUVENDOR_SC_Compu "" TAB_VERB "%6.3" "" COMPU_TAB_REF CPUVENDOR_SC_Compu /end COMPU_METHOD
/begin COMPU_VTAB CPUVENDOR_SC_Compu "" TAB_VERB 4 0 "None" 1 "IFX" 2 "JDP" 3 "ST" /end COMPU_VTAB
/begin COMPU_METHOD CPVCLSNGIMP_SC_Compu "" TAB_VERB "%6.3" "" COMPU_TAB_REF CPVCLSNGIMP_SC_Compu /end COMPU_METHOD
/begin COMPU_VTAB CPVCLSNGIMP_SC_Compu "" TAB_VERB 2 0 "False" 1 "True" /end COMPU_VTAB
/begin COMPU_METHOD CPV_ATS_SY_Compu "" TAB_VERB "%6.3" "" COMPU_TAB_REF CPV_ATS_SY_Compu /end COMPU_METHOD
/begin COMPU_VTAB CPV_ATS_SY_Compu "" TAB_VERB 2 0 "False" 1 "True" /end COMPU_VTAB
/begin COMPU_METHOD CRCSP_TYPAVL_SC_Compu "" TAB_VERB "%6.3" "" COMPU_TAB_REF CRCSP_TYPAVL_SC_Compu /end COMPU_METHOD
/begin COMPU_VTAB CRCSP_TYPAVL_SC_Compu "" TAB_VERB 2 0 "False" 1 "True" /end COMPU_VTAB
/begin COMPU_METHOD CRCTL_SY_Compu "" TAB_VERB "%6.3" "" COMPU_TAB_REF CRCTL_SY_Compu /end COMPU_METHOD
/begin COMPU_VTAB CRCTL_SY_Compu "" TAB_VERB 2 0 "FALSE" 1 "TRUE" /end COMPU_VTAB
/begin COMPU_METHOD CRKCSPABSLT_TYPAVL_SY_Compu "" TAB_VERB "%6.3" "" COMPU_TAB_REF CRKCSPABSLT_TYPAVL_SY_Compu /end COMPU_METHOD
/begin COMPU_VTAB CRKCSPABSLT_TYPAVL_SY_Compu "" TAB_VERB 2 0 "False" 1 "True" /end COMPU_VTAB
/begin COMPU_METHOD CRKCSVENTDIAG_SC_Compu "" TAB_VERB "%6.3" "" COMPU_TAB_REF CRKCSVENTDIAG_SC_Compu /end COMPU_METHOD
/begin COMPU_VTAB CRKCSVENTDIAG_SC_Compu "" TAB_VERB 2 0 "NONE" 1 "VALVE_DELTA_PRESSURE" /end COMPU_VTAB
/begin COMPU_METHOD dez "" RAT_FUNC "%6.2" "" COEFFS 0 1 0 0 0 1 /end COMPU_METHOD
/begin COMPU_METHOD EngN "" RAT_FUNC "%6.3" "rpm" COEFFS 0 2 0 0 0 1 /end COMPU_METHOD
/begin COMPU_METHOD EngN_LRes "" RAT_FUNC "%6.1" "rpm" COEFFS 0 0.025 0 0 0 1 /end COMPU_METHOD
/begin COMPU_METHOD fak1_q0p000407_hPa_div_percent "" RAT_FUNC "%6.5" "hPa/%" COEFFS 0 12288 0 0 0 5 /end COMPU_METHOD
/begin COMPU_METHOD fak_q1p526Em5 "" RAT_FUNC "%7.6" "-" COEFFS 0 65536 0 0 0 1 /end COMPU_METHOD
/begin COMPU_METHOD fak_q1p5625Em5_gdivUdivP "" RAT_FUNC "%7.6" "g/(U%)" COEFFS 0 256 0 0 0 0.004 /end COMPU_METHOD
/begin COMPU_METHOD fak_q1p5625Em5_GradC_mul_min_div_U "" RAT_FUNC "%7.6" "Grad C*(min/U)" COEFFS 0 64000 0 0 0 1 /end COMPU_METHOD
/begin COMPU_METHOD fak_q3p0518Em5 "" RAT_FUNC "%7.6" "" COEFFS 0 32768 0 0 0 1 /end COMPU_METHOD
/begin COMPU_METHOD fak_q6p1035Em5 "" RAT_FUNC "%7.6" "-" COEFFS 0 65536 0 0 0 4 /end COMPU_METHOD
/begin COMPU_METHOD fak_sb_b1 "" RAT_FUNC "%6.4" "-" COEFFS 0 256 0 0 0 2 /end COMPU_METHOD
/begin COMPU_METHOD fak_sw_b1 "" RAT_FUNC "%7.6" "-" COEFFS 0 65536 0 0 0 2 /end COMPU_METHOD
/begin COMPU_METHOD fak_ub_b1 "" RAT_FUNC "%6.4" "-" COEFFS 0 256 0 0 0 1 /end COMPU_METHOD
/begin COMPU_METHOD fak_ub_b2 "" RAT_FUNC "%8.5" "-" COEFFS 0 256 0 0 0 2 /end COMPU_METHOD
/begin COMPU_METHOD fak_ub_b4 "" RAT_FUNC "%6.4" "-" COEFFS 0 256 0 0 0 4 /end COMPU_METHOD
/begin COMPU_METHOD fak_uw_b1 "" RAT_FUNC "%7.6" "-" COEFFS 0 65536 0 0 0 1 /end COMPU_METHOD
/begin COMPU_METHOD fak_uw_b2 "" RAT_FUNC "%7.6" "-" COEFFS 0 65536 0 0 0 2 /end COMPU_METHOD
/begin COMPU_METHOD fak_uw_b32 "" RAT_FUNC "%6.5" "-" COEFFS 0 65536 0 0 0 32 /end COMPU_METHOD
/begin COMPU_METHOD fak_uw_b8 "" RAT_FUNC "%6.5" "-" COEFFS 0 65536 0 0 0 8 /end COMPU_METHOD
/begin COMPU_METHOD grd_sw_q0p78 "" RAT_FUNC "%6.3" "hPa/s" COEFFS 0 65536 0 0 0 51200 /end COMPU_METHOD
/begin COMPU_METHOD kumsrl_uw_b0p004 "" RAT_FUNC "%13.12" "(kg/h)/(1/min)(%)" COEFFS 0 16384000 0 0 0 1 /end COMPU_METHOD
/begin COMPU_METHOD kw_q0p0156 "" RAT_FUNC "%6.4" "Grad KW" COEFFS 0 64 0 0 0 1 /end COMPU_METHOD
/begin COMPU_METHOD kw_q0p1 "" RAT_FUNC "%6.3" "Grad KW" COEFFS 0 10 0 0 0 1 /end COMPU_METHOD
/begin COMPU_METHOD m_q0p0005 "" RAT_FUNC "%6.5" "kg/(h*%)" COEFFS 0 1 0 0 0 0.0005 /end COMPU_METHOD
/begin COMPU_METHOD m_q0p1 "" RAT_FUNC "%6.3" "kg/h" COEFFS 0 10 0 0 0 1 /end COMPU_METHOD
/begin COMPU_METHOD m_uw_q0p24 "" RAT_FUNC "%6.3" "g/min" COEFFS 0 1 0 0 0 0.24 /end COMPU_METHOD
/begin COMPU_METHOD nmot_ub_q40 "" RAT_FUNC "%6.1" "1/min" COEFFS 0 1 0 0 0 40 /end COMPU_METHOD
/begin COMPU_METHOD nmot_uw_q0p25 "" RAT_FUNC "%6.3" "1/min" COEFFS 0 1 0 0 0 0.25 /end COMPU_METHOD
/begin COMPU_METHOD OneToOne "" RAT_FUNC "%6.2" "-" COEFFS 0 1 0 0 0 1 /end COMPU_METHOD
/begin COMPU_METHOD Prc "" RAT_FUNC "%6.4" "%" COEFFS 0 81.92 0 0 0 1 /end COMPU_METHOD
/begin COMPU_METHOD p_q0p039 "" RAT_FUNC "%6.4" "hPa" COEFFS 0 256 0 0 0 10 /end COMPU_METHOD
/begin COMPU_METHOD p_q0p078 "" RAT_FUNC "%6.4" "hPa" COEFFS 0 64 0 0 0 5 /end COMPU_METHOD
/begin COMPU_METHOD p_q0p3125 "" RAT_FUNC "%6.3" "hPa" COEFFS 0 256 0 0 0 80 /end COMPU_METHOD
/begin COMPU_METHOD p_sw_q0p078 "" RAT_FUNC "%6.4" "hPa" COEFFS 0 65536 0 0 0 5120 /end COMPU_METHOD
/begin COMPU_METHOD p_uw_q0p078 "" RAT_FUNC "%6.4" "hPa" COEFFS 0 256 0 0 0 20 /end COMPU_METHOD
/begin COMPU_METHOD RBPtCel_p_0p002_1 "" RAT_FUNC "%6.4" "MPa" COEFFS 0 1000 0 0 0 2 /end COMPU_METHOD
/begin COMPU_METHOD rel_q0p00153 "" RAT_FUNC "%6.4" "%" COEFFS 0 65536 0 0 0 100 /end COMPU_METHOD
/begin COMPU_METHOD rel_q0p0234 "" RAT_FUNC "%6.4" "%" COEFFS 0 128 0 0 0 3 /end COMPU_METHOD
/begin COMPU_METHOD rel_q0p02344 "" RAT_FUNC "%6.4" "%" COEFFS 0 32 0 0 0 0.75 /end COMPU_METHOD
/begin COMPU_METHOD rel_sw_q0p0234 "" RAT_FUNC "%6.4" "%/seg" COEFFS 0 32 0 0 0 0.75 /end COMPU_METHOD
/begin COMPU_METHOD rel_ub_q0p75 "" RAT_FUNC "%6.3" "%" COEFFS 0 1 0 0 0 0.75 /end COMPU_METHOD
/begin COMPU_METHOD rel_uw_b0p3 "" RAT_FUNC "%8.7" "%/hPa" COEFFS 0 65536 0 0 0 0.3 /end COMPU_METHOD
/begin COMPU_METHOD rel_uw_b100 "" RAT_FUNC "%6.4" "%" COEFFS 0 65536 0 0 0 100 /end COMPU_METHOD
/begin COMPU_METHOD rel_uw_b3072 "" RAT_FUNC "%6.4" "%" COEFFS 0 65536 0 0 0 3072 /end COMPU_METHOD
/begin COMPU_METHOD rel_uw_q0p0234 "" RAT_FUNC "%6.4" "%" COEFFS 0 32 0 0 0 0.75 /end COMPU_METHOD
/begin COMPU_METHOD spg_q0p00039 "" RAT_FUNC "%6.5" "V" COEFFS 0 1 0 0 0 0.000390625 /end COMPU_METHOD
/begin COMPU_METHOD t100msxs_uw_b6553p5 "" RAT_FUNC "%6.3" "s" COEFFS 0 1 0 0 0 0.1 /end COMPU_METHOD
/begin COMPU_METHOD t10msxs_uw_b655p35 "" RAT_FUNC "%6.4" "s" COEFFS 0 1 0 0 0 0.01 /end COMPU_METHOD
/begin COMPU_METHOD t1sxs_uw_q1 "" RAT_FUNC "%6.2" "s" COEFFS 0 1 0 0 0 1 /end COMPU_METHOD
/begin COMPU_METHOD t6minxmin_q6 "" RAT_FUNC "%6.2" "min" COEFFS 0 1 0 0 0 6 /end COMPU_METHOD
/begin COMPU_METHOD Temp_Cels "" RAT_FUNC "%6.1" "deg C" COEFFS 0 10 2731.4 0 0 1 /end COMPU_METHOD
/begin COMPU_METHOD temp_q0p0234 "" RAT_FUNC "%6.4" "K" COEFFS 0 256 0 0 0 6 /end COMPU_METHOD
/begin COMPU_METHOD temp_q0p0234_o273 "" RAT_FUNC "%6.1" "Grad C" COEFFS 0 1 273.15 0 0 0.0234375 /end COMPU_METHOD
/begin COMPU_METHOD temp_ub_b191p25 "" RAT_FUNC "%6.3" "Grad C" COEFFS 0 1 0 0 0 0.75 /end COMPU_METHOD
/begin COMPU_METHOD temp_ub_q0p75_o48 "" RAT_FUNC "%6.2" "Grad C" COEFFS 0 1 48 0 0 0.75 /end COMPU_METHOD
/begin COMPU_METHOD TimeEngOn "" RAT_FUNC "%6.2" "s" COEFFS 0 1 0 0 0 1 /end COMPU_METHOD
/begin COMPU_METHOD TMECmb_HspMdl_Set_COMPU_VERB "" TAB_VERB "%6.3" "-" COMPU_TAB_REF TMECmb_HspMdl_Set_COMPU_VERB /end COMPU_METHOD
/begin COMPU_VTAB TMECmb_HspMdl_Set_COMPU_VERB "" TAB_VERB 3 0 "TMECmb_HspMdl0_I" 1 "TMECmb_HspMdl1_I" 2 "TMECmb_HspMdl2_I" /end COMPU_VTAB
/begin COMPU_METHOD tv_ub_b100 "" RAT_FUNC "%6.3" "%TV" COEFFS 0 256 0 0 0 100 /end COMPU_METHOD
/begin COMPU_METHOD t_q0p0001_s "" RAT_FUNC "%7.6" "s" COEFFS 0 10000 0 0 0 1 /end COMPU_METHOD
/begin COMPU_METHOD t_q0p01 "" RAT_FUNC "%6.4" "s" COEFFS 0 100 0 0 0 1 /end COMPU_METHOD
/begin COMPU_METHOD t_q0p02 "" RAT_FUNC "%6.4" "s" COEFFS 0 100 0 0 0 2 /end COMPU_METHOD
/begin COMPU_METHOD t_q0p05 "" RAT_FUNC "%6.4" "s" COEFFS 0 100 0 0 0 5 /end COMPU_METHOD
/begin COMPU_METHOD t_q0p1 "" RAT_FUNC "%6.3" "s" COEFFS 0 10 0 0 0 1 /end COMPU_METHOD
/begin COMPU_METHOD t_q0p2 "" RAT_FUNC "%6.3" "s" COEFFS 0 10 0 0 0 2 /end COMPU_METHOD
/begin COMPU_METHOD t_q1 "" RAT_FUNC "%6.2" "s" COEFFS 0 1 0 0 0 1 /end COMPU_METHOD
/begin COMPU_METHOD t_q16us "" RAT_FUNC "%6.1" "us" COEFFS 0 1 0 0 0 16 /end COMPU_METHOD
/begin COMPU_METHOD t_q4_s "" RAT_FUNC "%6.2" "s" COEFFS 0 1 0 0 0 4 /end COMPU_METHOD
/begin COMPU_METHOD vfzg_ub_q1p25 "" RAT_FUNC "%6.2" "km/h" COEFFS 0 1 0 0 0 1.25 /end COMPU_METHOD
/begin COMPU_METHOD volgrd_q5p96Em4 "" RAT_FUNC "%6.5" "ml/s" COEFFS 0 65536 0 0 0 39.0625 /end COMPU_METHOD
/begin COMPU_METHOD vol_q0p002146 "" RAT_FUNC "%6.4" "l/h" COEFFS 0 65536 0 0 0 140.625 /end COMPU_METHOD
/begin COMPU_METHOD vol_q0p025 "" RAT_FUNC "%6.4" "l/h" COEFFS 0 40 0 0 0 1 /end COMPU_METHOD
/begin COMPU_METHOD vol_q0p702Em3_dm3 "" RAT_FUNC "%6.5" "dm^3" COEFFS 0 2849 0 0 0 2 /end COMPU_METHOD
/begin COMPU_METHOD zk100msxs_uw_b6553 "" RAT_FUNC "%6.1" "s" COEFFS 0 0 65536 0 10 0 /end COMPU_METHOD
/begin COMPU_METHOD zk10msxs_uw_b655p36 "" RAT_FUNC "%6.2" "s" COEFFS 0 0 65536 0 100 0 /end COMPU_METHOD
/begin COMPU_METHOD zk200msxs_uw_b13107p2 "" RAT_FUNC "%6.0" "s" COEFFS 0 0 65536 0 5 0 /end COMPU_METHOD
/begin COMPU_METHOD zk50msxs_uw_b3276p8 "" RAT_FUNC "%6.1" "s" COEFFS 0 0 65536 0 20 0 /end COMPU_METHOD
/begin COMPU_METHOD zw_q2p9297Em3_deg_KW "" RAT_FUNC "%6.4" "deg KW" COEFFS 0 1024 0 0 0 3 /end COMPU_METHOD
/begin RECORD_LAYOUT RB_Axis_U16 NO_AXIS_PTS_X 1 UWORD AXIS_PTS_X 2 UWORD INDEX_INCR DIRECT /end RECORD_LAYOUT
/begin RECORD_LAYOUT RB_CurveGroup_U8 FNC_VALUES 1 UBYTE COLUMN_DIR DIRECT /end RECORD_LAYOUT
/begin RECORD_LAYOUT RB_Curve_S16_U16_Static NO_AXIS_PTS_X 1 SWORD AXIS_PTS_X 2 SWORD INDEX_INCR DIRECT FNC_VALUES 3 UWORD COLUMN_DIR DIRECT STATIC_RECORD_LAYOUT /end RECORD_LAYOUT
/begin RECORD_LAYOUT RB_Curve_U16_U16 NO_AXIS_PTS_X 1 UWORD AXIS_PTS_X 2 UWORD INDEX_INCR DIRECT FNC_VALUES 3 UWORD COLUMN_DIR DIRECT /end RECORD_LAYOUT
/begin RECORD_LAYOUT RB_Curve_U16_U8_Static NO_AXIS_PTS_X 1 UWORD AXIS_PTS_X 2 UWORD INDEX_INCR DIRECT FNC_VALUES 3 UBYTE COLUMN_DIR DIRECT STATIC_RECORD_LAYOUT /end RECORD_LAYOUT
/begin RECORD_LAYOUT RB_Curve_U8_S16_Static NO_AXIS_PTS_X 1 UBYTE AXIS_PTS_X 2 UBYTE INDEX_INCR DIRECT FNC_VALUES 3 SWORD COLUMN_DIR DIRECT STATIC_RECORD_LAYOUT /end RECORD_LAYOUT
/begin RECORD_LAYOUT RB_Curve_U8_U16_Static NO_AXIS_PTS_X 1 UBYTE AXIS_PTS_X 2 UBYTE INDEX_INCR DIRECT FNC_VALUES 3 UWORD COLUMN_DIR DIRECT STATIC_RECORD_LAYOUT /end RECORD_LAYOUT
/begin RECORD_LAYOUT RB_Curve_U8_U8 NO_AXIS_PTS_X 1 UBYTE AXIS_PTS_X 2 UBYTE INDEX_INCR DIRECT FNC_VALUES 3 UBYTE COLUMN_DIR DIRECT /end RECORD_LAYOUT
/begin RECORD_LAYOUT RB_MapGroup_S16 FNC_VALUES 1 SWORD COLUMN_DIR DIRECT /end RECORD_LAYOUT
/begin RECORD_LAYOUT RB_Map_S16U16_S16 NO_AXIS_PTS_X 1 SWORD NO_AXIS_PTS_Y 2 SWORD AXIS_PTS_X 3 SWORD INDEX_INCR DIRECT AXIS_PTS_Y 4 UWORD INDEX_INCR DIRECT FNC_VALUES 5 SWORD ROW_DIR DIRECT /end RECORD_LAYOUT
/begin RECORD_LAYOUT RB_Map_S16U16_U16 NO_AXIS_PTS_X 1 SWORD NO_AXIS_PTS_Y 2 SWORD AXIS_PTS_X 3 SWORD INDEX_INCR DIRECT AXIS_PTS_Y 4 UWORD INDEX_INCR DIRECT FNC_VALUES 5 UWORD ROW_DIR DIRECT /end RECORD_LAYOUT
/begin RECORD_LAYOUT RB_Map_U16U16_U16 NO_AXIS_PTS_X 1 UWORD NO_AXIS_PTS_Y 2 UWORD AXIS_PTS_X 3 UWORD INDEX_INCR DIRECT AXIS_PTS_Y 4 UWORD INDEX_INCR DIRECT FNC_VALUES 5 UWORD COLUMN_DIR DIRECT /end RECORD_LAYOUT
/begin RECORD_LAYOUT RB_Map_U16U8_U8 NO_AXIS_PTS_X 1 UWORD NO_AXIS_PTS_Y 2 UWORD AXIS_PTS_X 3 UWORD INDEX_INCR DIRECT AXIS_PTS_Y 4 UBYTE INDEX_INCR DIRECT FNC_VALUES 5 UBYTE COLUMN_DIR DIRECT /end RECORD_LAYOUT
/begin RECORD_LAYOUT RB_Map_U8U16_U16 NO_AXIS_PTS_X 1 UBYTE NO_AXIS_PTS_Y 2 UBYTE AXIS_PTS_X 3 UBYTE INDEX_INCR DIRECT AXIS_PTS_Y 4 UWORD INDEX_INCR DIRECT FNC_VALUES 5 UWORD ROW_DIR DIRECT /end RECORD_LAYOUT
/begin RECORD_LAYOUT RB_Map_U8U16_U8 NO_AXIS_PTS_X 1 UBYTE NO_AXIS_PTS_Y 2 UBYTE AXIS_PTS_X 3 UBYTE INDEX_INCR DIRECT AXIS_PTS_Y 4 UWORD INDEX_INCR DIRECT FNC_VALUES 5 UBYTE ROW_DIR DIRECT /end RECORD_LAYOUT
/begin RECORD_LAYOUT RB_Map_U8U8_S8 NO_AXIS_PTS_X 1 UBYTE NO_AXIS_PTS_Y 2 UBYTE AXIS_PTS_X 3 UBYTE INDEX_INCR DIRECT AXIS_PTS_Y 4 UBYTE INDEX_INCR DIRECT FNC_VALUES 5 SBYTE COLUMN_DIR DIRECT /end RECORD_LAYOUT
/begin RECORD_LAYOUT RB_Map_U8U8_U8 NO_AXIS_PTS_X 1 UBYTE NO_AXIS_PTS_Y 2 UBYTE AXIS_PTS_X 3 UBYTE INDEX_INCR DIRECT AXIS_PTS_Y 4 UBYTE INDEX_INCR DIRECT FNC_VALUES 5 UBYTE COLUMN_DIR DIRECT /end RECORD_LAYOUT
/begin RECORD_LAYOUT RB_Val_Ws16 FNC_VALUES 1 SWORD COLUMN_DIR DIRECT /end RECORD_LAYOUT
/begin RECORD_LAYOUT RB_Val_Wu16 FNC_VALUES 1 UWORD COLUMN_DIR DIRECT /end RECORD_LAYOUT
/begin RECORD_LAYOUT RB_Val_Wu8 FNC_VALUES 1 UBYTE COLUMN_DIR DIRECT /end RECORD_LAYOUT
/end MODULE
/end PROJECT
