ASAP2_VERSION 1 60
/begin PROJECT MG1CS022 "MG1CS022"
/begin HEADER "" VERSION "MG1CS022_62XSC_V037" PROJECT_NO MG1CS022 /end HEADER
/begin MODULE DIM ""
/begin MOD_COMMON "" BYTE_ORDER MSB_LAST ALIGNMENT_BYTE 1 ALIGNMENT_WORD 2 ALIGNMENT_LONG 4 ALIGNMENT_INT64 4 ALIGNMENT_FLOAT32_IEEE 4 ALIGNMENT_FLOAT64_IEEE 4 DATA_SIZE 32 /end MOD_COMMON
/begin CHARACTERISTIC DFES_GrpRpr.DFC_ComAYCGRingCnt_C "common MIL debouncing / group representative for common MIL debouncing of DFC_ComAYCGRingCnt" VALUE 0x80505112 Val_Wu16 906.000000000 DFC_Verb 0.00 906.000000000 FORMAT "%13.9" /end CHARACTERISTIC
/begin CHARACTERISTIC DFES_GrpRpr.DFC_ComAYCGTOut_C "common MIL debouncing / group representative for common MIL debouncing of DFC_ComAYCGTOut" VALUE 0x80505114 Val_Wu16 906.000000000 DFC_Verb 0.00 906.000000000 FORMAT "%13.9" /end CHARACTERISTIC
/begin CHARACTERISTIC DFES_GrpRpr.DFC_ComAYCIChkSum_C "common MIL debouncing / group representative for common MIL debouncing of DFC_ComAYCIChkSum" VALUE 0x80505116 Val_Wu16 906.000000000 DFC_Verb 0.00 906.000000000 FORMAT "%13.9" /end CHARACTERISTIC
/begin CHARACTERISTIC DFES_GrpRpr.DFC_ComAYCIRingCnt_C "common MIL debouncing / group representative for common MIL debouncing of DFC_ComAYCIRingCnt" VALUE 0x80505118 Val_Wu16 906.000000000 DFC_Verb 0.00 906.000000000 FORMAT "%13.9" /end CHARACTERISTIC
/begin CHARACTERISTIC DFES_GrpRpr.DFC_ComAYCITOut_C "common MIL debouncing / group representative for common MIL debouncing of DFC_ComAYCITOut" VALUE 0x8050511A Val_Wu16 906.000000000 DFC_Verb 0.00 906.000000000 FORMAT "%13.9" /end CHARACTERISTIC
/begin CHARACTERISTIC DFES_GrpRpr.DFC_ComBCM1ChkSum_C "common MIL debouncing / group representative for common MIL debouncing of DFC_ComBCM1ChkSum" VALUE 0x8050511C Val_Wu16 906.000000000 DFC_Verb 0.00 906.000000000 FORMAT "%13.9" /end CHARACTERISTIC
/begin CHARACTERISTIC DFES_GrpRpr.DFC_ComBCM1RingCnt_C "common MIL debouncing / group representative for common MIL debouncing of DFC_ComBCM1RingCnt" VALUE 0x8050511E Val_Wu16 906.000000000 DFC_Verb 0.00 906.000000000 FORMAT "%13.9" /end CHARACTERISTIC
/begin CHARACTERISTIC DFES_GrpRpr.DFC_ComBCM1TOut_C "common MIL debouncing / group representative for common MIL debouncing of DFC_ComBCM1TOut" VALUE 0x80505120 Val_Wu16 906.000000000 DFC_Verb 0.00 906.000000000 FORMAT "%13.9" /end CHARACTERISTIC
/begin CHARACTERISTIC DFES_GrpRpr.DFC_ComCANABusOffErr_C "common MIL debouncing / group representative for common MIL debouncing of DFC_ComCANABusOffErr" VALUE 0x80505122 Val_Wu16 906.000000000 DFC_Verb 0.00 906.000000000 FORMAT "%13.9" /end CHARACTERISTIC
/begin CHARACTERISTIC DFES_GrpRpr.DFC_ComCANBBusOffErr_C "common MIL debouncing / group representative for common MIL debouncing of DFC_ComCANBBusOffErr" VALUE 0x80505124 Val_Wu16 906.000000000 DFC_Verb 0.00 906.000000000 FORMAT "%13.9" /end CHARACTERISTIC
/begin CHARACTERISTIC DFES_GrpRpr.DFC_ComCANCBusOffErr_C "common MIL debouncing / group representative for common MIL debouncing of DFC_ComCANCBusOffErr" VALUE 0x80505126 Val_Wu16 906.000000000 DFC_Verb 0.00 906.000000000 FORMAT "%13.9" /end CHARACTERISTIC
/begin CHARACTERISTIC DFES_GrpRpr.DFC_ComCGW1ChkSum_C "common MIL debouncing / group representative for common MIL debouncing of DFC_ComCGW1ChkSum" VALUE 0x80505128 Val_Wu16 906.000000000 DFC_Verb 0.00 906.000000000 FORMAT "%13.9" /end CHARACTERISTIC
/begin CHARACTERISTIC DFES_GrpRpr.DFC_ComCGW1RingCnt_C "common MIL debouncing / group representative for common MIL debouncing of DFC_ComCGW1RingCnt" VALUE 0x8050512A Val_Wu16 906.000000000 DFC_Verb 0.00 906.000000000 FORMAT "%13.9" /end CHARACTERISTIC
/begin CHARACTERISTIC DFES_GrpRpr.DFC_ComCGW1TOut_C "common MIL debouncing / group representative for common MIL debouncing of DFC_ComCGW1TOut" VALUE 0x8050512C Val_Wu16 906.000000000 DFC_Verb 0.00 906.000000000 FORMAT "%13.9" /end CHARACTERISTIC
/begin CHARACTERISTIC DFES_GrpRpr.DFC_ComConvBoostErr_C "common MIL debouncing / group representative for common MIL debouncing of DFC_ComConvBoostErr" VALUE 0x8050512E Val_Wu16 906.000000000 DFC_Verb 0.00 906.000000000 FORMAT "%13.9" /end CHARACTERISTIC
/begin CHARACTERISTIC DFES_GrpRpr.DFC_ComConvSlipErr_C "common MIL debouncing / group representative for common MIL debouncing of DFC_ComConvSlipErr" VALUE 0x80505130 Val_Wu16 906.000000000 DFC_Verb 0.00 906.000000000 FORMAT "%13.9" /end CHARACTERISTIC
/begin CHARACTERISTIC DFES_GrpRpr.DFC_ComDCDCPrfmncErr_C "common MIL debouncing / group representative for common MIL debouncing of DFC_ComDCDCPrfmncErr" VALUE 0x80505132 Val_Wu16 906.000000000 DFC_Verb 0.00 906.000000000 FORMAT "%13.9" /end CHARACTERISTIC
/begin CHARACTERISTIC DFES_GrpRpr.DFC_ComDCDCTempWarn_C "common MIL debouncing / group representative for common MIL debouncing of DFC_ComDCDCTempWarn" VALUE 0x80505134 Val_Wu16 906.000000000 DFC_Verb 0.00 906.000000000 FORMAT "%13.9" /end CHARACTERISTIC
/begin CHARACTERISTIC DFES_GrpRpr.DFC_ComEAT10Chksum_C "common MIL debouncing / group representative for common MIL debouncing of DFC_ComEAT10Chksum" VALUE 0x80505136 Val_Wu16 906.000000000 DFC_Verb 0.00 906.000000000 FORMAT "%13.9" /end CHARACTERISTIC
/begin CHARACTERISTIC DFES_GrpRpr.DFC_ComEAT10RingCnt_C "common MIL debouncing / group representative for common MIL debouncing of DFC_ComEAT10RingCnt" VALUE 0x80505138 Val_Wu16 906.000000000 DFC_Verb 0.00 906.000000000 FORMAT "%13.9" /end CHARACTERISTIC
/begin CHARACTERISTIC DFES_GrpRpr.DFC_ComEAT10TOut_C "common MIL debouncing / group representative for common MIL debouncing of DFC_ComEAT10TOut" VALUE 0x8050513A Val_Wu16 906.000000000 DFC_Verb 0.00 906.000000000 FORMAT "%13.9" /end CHARACTERISTIC
/begin CHARACTERISTIC DFES_GrpRpr.DFC_ComEAT11ChkSum_C "common MIL debouncing / group representative for common MIL debouncing of DFC_ComEAT11ChkSum" VALUE 0x8050513C Val_Wu16 906.000000000 DFC_Verb 0.00 906.000000000 FORMAT "%13.9" /end CHARACTERISTIC
/begin CHARACTERISTIC DFES_GrpRpr.DFC_ComEAT11RingCnt_C "common MIL debouncing / group representative for common MIL debouncing of DFC_ComEAT11RingCnt" VALUE 0x8050513E Val_Wu16 906.000000000 DFC_Verb 0.00 906.000000000 FORMAT "%13.9" /end CHARACTERISTIC
/begin CHARACTERISTIC DFES_GrpRpr.DFC_ComEAT11TOut_C "common MIL debouncing / group representative for common MIL debouncing of DFC_ComEAT11TOut" VALUE 0x80505140 Val_Wu16 906.000000000 DFC_Verb 0.00 906.000000000 FORMAT "%13.9" /end CHARACTERISTIC
/begin CHARACTERISTIC DFES_GrpRpr.DFC_ComEAT12ChkSum_C "common MIL debouncing / group representative for common MIL debouncing of DFC_ComEAT12ChkSum" VALUE 0x80505142 Val_Wu16 906.000000000 DFC_Verb 0.00 906.000000000 FORMAT "%13.9" /end CHARACTERISTIC
/begin CHARACTERISTIC DFES_GrpRpr.DFC_ComEAT12RingCnt_C "common MIL debouncing / group representative for common MIL debouncing of DFC_ComEAT12RingCnt" VALUE 0x80505144 Val_Wu16 906.000000000 DFC_Verb 0.00 906.000000000 FORMAT "%13.9" /end CHARACTERISTIC
/begin CHARACTERISTIC DFES_GrpRpr.DFC_ComEAT12TOut_C "common MIL debouncing / group representative for common MIL debouncing of DFC_ComEAT12TOut" VALUE 0x80505146 Val_Wu16 906.000000000 DFC_Verb 0.00 906.000000000 FORMAT "%13.9" /end CHARACTERISTIC
/begin CHARACTERISTIC DFES_GrpRpr.DFC_ComEAT13ChkSum_C "common MIL debouncing / group representative for common MIL debouncing of DFC_ComEAT13ChkSum" VALUE 0x80505148 Val_Wu16 906.000000000 DFC_Verb 0.00 906.000000000 FORMAT "%13.9" /end CHARACTERISTIC
/begin CHARACTERISTIC DFES_GrpRpr.DFC_ComEAT13RingCnt_C "common MIL debouncing / group representative for common MIL debouncing of DFC_ComEAT13RingCnt" VALUE 0x8050514A Val_Wu16 906.000000000 DFC_Verb 0.00 906.000000000 FORMAT "%13.9" /end CHARACTERISTIC
/begin CHARACTERISTIC DFES_GrpRpr.DFC_ComEAT13TOut_C "common MIL debouncing / group representative for common MIL debouncing of DFC_ComEAT13TOut" VALUE 0x8050514C Val_Wu16 906.000000000 DFC_Verb 0.00 906.000000000 FORMAT "%13.9" /end CHARACTERISTIC
/begin CHARACTERISTIC DFES_GrpRpr.DFC_ComEAT1Chksum_C "common MIL debouncing / group representative for common MIL debouncing of DFC_ComEAT1Chksum" VALUE 0x8050514E Val_Wu16 906.000000000 DFC_Verb 0.00 906.000000000 FORMAT "%13.9" /end CHARACTERISTIC
/begin CHARACTERISTIC DFES_GrpRpr.DFC_ComEAT1RingCnt_C "common MIL debouncing / group representative for common MIL debouncing of DFC_ComEAT1RingCnt" VALUE 0x80505150 Val_Wu16 906.000000000 DFC_Verb 0.00 906.000000000 FORMAT "%13.9" /end CHARACTERISTIC
/begin CHARACTERISTIC DFES_GrpRpr.DFC_ComEAT1TOut_C "common MIL debouncing / group representative for common MIL debouncing of DFC_ComEAT1TOut" VALUE 0x80505152 Val_Wu16 906.000000000 DFC_Verb 0.00 906.000000000 FORMAT "%13.9" /end CHARACTERISTIC
/begin CHARACTERISTIC DFES_GrpRpr.DFC_ComEAT2ChkSum_C "common MIL debouncing / group representative for common MIL debouncing of DFC_ComEAT2ChkSum" VALUE 0x80505154 Val_Wu16 906.000000000 DFC_Verb 0.00 906.000000000 FORMAT "%13.9" /end CHARACTERISTIC
/begin CHARACTERISTIC DFES_GrpRpr.DFC_ComEAT2RingCnt_C "common MIL debouncing / group representative for common MIL debouncing of DFC_ComEAT2RingCnt" VALUE 0x80505156 Val_Wu16 906.000000000 DFC_Verb 0.00 906.000000000 FORMAT "%13.9" /end CHARACTERISTIC
/begin CHARACTERISTIC DFES_GrpRpr.DFC_ComEAT2TOut_C "common MIL debouncing / group representative for common MIL debouncing of DFC_ComEAT2TOut" VALUE 0x80505158 Val_Wu16 906.000000000 DFC_Verb 0.00 906.000000000 FORMAT "%13.9" /end CHARACTERISTIC
/begin CHARACTERISTIC DFES_GrpRpr.DFC_ComEAT4ChkSum_C "common MIL debouncing / group representative for common MIL debouncing of DFC_ComEAT4ChkSum" VALUE 0x8050515A Val_Wu16 906.000000000 DFC_Verb 0.00 906.000000000 FORMAT "%13.9" /end CHARACTERISTIC
/begin CHARACTERISTIC DFES_GrpRpr.DFC_ComEAT4RingCnt_C "common MIL debouncing / group representative for common MIL debouncing of DFC_ComEAT4RingCnt" VALUE 0x8050515C Val_Wu16 906.000000000 DFC_Verb 0.00 906.000000000 FORMAT "%13.9" /end CHARACTERISTIC
/begin CHARACTERISTIC DFES_GrpRpr.DFC_ComEAT4TOut_C "common MIL debouncing / group representative for common MIL debouncing of DFC_ComEAT4TOut" VALUE 0x8050515E Val_Wu16 906.000000000 DFC_Verb 0.00 906.000000000 FORMAT "%13.9" /end CHARACTERISTIC
/begin CHARACTERISTIC DFES_GrpRpr.DFC_ComEAT6Chksum_C "common MIL debouncing / group representative for common MIL debouncing of DFC_ComEAT6Chksum" VALUE 0x80505160 Val_Wu16 906.000000000 DFC_Verb 0.00 906.000000000 FORMAT "%13.9" /end CHARACTERISTIC
/begin CHARACTERISTIC DFES_GrpRpr.DFC_ComEAT6RingCnt_C "common MIL debouncing / group representative for common MIL debouncing of DFC_ComEAT6RingCnt" VALUE 0x80505162 Val_Wu16 906.000000000 DFC_Verb 0.00 906.000000000 FORMAT "%13.9" /end CHARACTERISTIC
/begin CHARACTERISTIC DFES_GrpRpr.DFC_ComEAT6TOut_C "common MIL debouncing / group representative for common MIL debouncing of DFC_ComEAT6TOut" VALUE 0x80505164 Val_Wu16 906.000000000 DFC_Verb 0.00 906.000000000 FORMAT "%13.9" /end CHARACTERISTIC
/begin CHARACTERISTIC DFES_GrpRpr.DFC_ComEAT7Chksum_C "common MIL debouncing / group representative for common MIL debouncing of DFC_ComEAT7Chksum" VALUE 0x80505166 Val_Wu16 906.000000000 DFC_Verb 0.00 906.000000000 FORMAT "%13.9" /end CHARACTERISTIC
/begin CHARACTERISTIC DFES_GrpRpr.DFC_ComEAT7RingCnt_C "common MIL debouncing / group representative for common MIL debouncing of DFC_ComEAT7RingCnt" VALUE 0x80505168 Val_Wu16 906.000000000 DFC_Verb 0.00 906.000000000 FORMAT "%13.9" /end CHARACTERISTIC
/begin CHARACTERISTIC DFES_GrpRpr.DFC_ComEAT7TOut_C "common MIL debouncing / group representative for common MIL debouncing of DFC_ComEAT7TOut" VALUE 0x8050516A Val_Wu16 906.000000000 DFC_Verb 0.00 906.000000000 FORMAT "%13.9" /end CHARACTERISTIC
/begin CHARACTERISTIC DFES_GrpRpr.DFC_ComEAT8Chksum_C "common MIL debouncing / group representative for common MIL debouncing of DFC_ComEAT8Chksum" VALUE 0x8050516C Val_Wu16 906.000000000 DFC_Verb 0.00 906.000000000 FORMAT "%13.9" /end CHARACTERISTIC
/begin CHARACTERISTIC DFES_GrpRpr.DFC_ComEAT8RingCnt_C "common MIL debouncing / group representative for common MIL debouncing of DFC_ComEAT8RingCnt" VALUE 0x8050516E Val_Wu16 906.000000000 DFC_Verb 0.00 906.000000000 FORMAT "%13.9" /end CHARACTERISTIC
/begin CHARACTERISTIC DFES_GrpRpr.DFC_ComEAT8TOut_C "common MIL debouncing / group representative for common MIL debouncing of DFC_ComEAT8TOut" VALUE 0x80505170 Val_Wu16 906.000000000 DFC_Verb 0.00 906.000000000 FORMAT "%13.9" /end CHARACTERISTIC
/begin CHARACTERISTIC DFES_GrpRpr.DFC_ComEATAChksum_C "common MIL debouncing / group representative for common MIL debouncing of DFC_ComEATAChksum" VALUE 0x80505172 Val_Wu16 906.000000000 DFC_Verb 0.00 906.000000000 FORMAT "%13.9" /end CHARACTERISTIC
/begin CHARACTERISTIC DFES_GrpRpr.DFC_ComEATARingCnt_C "common MIL debouncing / group representative for common MIL debouncing of DFC_ComEATARingCnt" VALUE 0x80505174 Val_Wu16 906.000000000 DFC_Verb 0.00 906.000000000 FORMAT "%13.9" /end CHARACTERISTIC
/begin CHARACTERISTIC DFES_GrpRpr.DFC_ComEATATOut_C "common MIL debouncing / group representative for common MIL debouncing of DFC_ComEATATOut" VALUE 0x80505176 Val_Wu16 906.000000000 DFC_Verb 0.00 906.000000000 FORMAT "%13.9" /end CHARACTERISTIC
/begin CHARACTERISTIC DFES_GrpRpr.DFC_ComEATBChkSum_C "common MIL debouncing / group representative for common MIL debouncing of DFC_ComEATBChkSum" VALUE 0x80505178 Val_Wu16 906.000000000 DFC_Verb 0.00 906.000000000 FORMAT "%13.9" /end CHARACTERISTIC
/begin CHARACTERISTIC DFES_GrpRpr.DFC_ComEATBRingCnt_C "common MIL debouncing / group representative for common MIL debouncing of DFC_ComEATBRingCnt" VALUE 0x8050517A Val_Wu16 906.000000000 DFC_Verb 0.00 906.000000000 FORMAT "%13.9" /end CHARACTERISTIC
/begin CHARACTERISTIC DFES_GrpRpr.DFC_ComEATBTOut_C "common MIL debouncing / group representative for common MIL debouncing of DFC_ComEATBTOut" VALUE 0x8050517C Val_Wu16 906.000000000 DFC_Verb 0.00 906.000000000 FORMAT "%13.9" /end CHARACTERISTIC
/begin CHARACTERISTIC DFES_GrpRpr.DFC_ComEATCChksum_C "common MIL debouncing / group representative for common MIL debouncing of DFC_ComEATCChksum" VALUE 0x8050517E Val_Wu16 906.000000000 DFC_Verb 0.00 906.000000000 FORMAT "%13.9" /end CHARACTERISTIC
/begin CHARACTERISTIC DFES_GrpRpr.DFC_ComEATCRingCnt_C "common MIL debouncing / group representative for common MIL debouncing of DFC_ComEATCRingCnt" VALUE 0x80505180 Val_Wu16 906.000000000 DFC_Verb 0.00 906.000000000 FORMAT "%13.9" /end CHARACTERISTIC
/begin CHARACTERISTIC DFES_GrpRpr.DFC_ComEATCTOut_C "common MIL debouncing / group representative for common MIL debouncing of DFC_ComEATCTOut" VALUE 0x80505182 Val_Wu16 906.000000000 DFC_Verb 0.00 906.000000000 FORMAT "%13.9" /end CHARACTERISTIC
/begin CHARACTERISTIC DFES_GrpRpr.DFC_ComEPBBChkSum_C "common MIL debouncing / group representative for common MIL debouncing of DFC_ComEPBBChkSum" VALUE 0x80505184 Val_Wu16 906.000000000 DFC_Verb 0.00 906.000000000 FORMAT "%13.9" /end CHARACTERISTIC
/begin CHARACTERISTIC DFES_GrpRpr.DFC_ComEPBBRingCnt_C "common MIL debouncing / group representative for common MIL debouncing of DFC_ComEPBBRingCnt" VALUE 0x80505186 Val_Wu16 906.000000000 DFC_Verb 0.00 906.000000000 FORMAT "%13.9" /end CHARACTERISTIC
/begin CHARACTERISTIC DFES_GrpRpr.DFC_ComEPBBTOut_C "common MIL debouncing / group representative for common MIL debouncing of DFC_ComEPBBTOut" VALUE 0x80505188 Val_Wu16 906.000000000 DFC_Verb 0.00 906.000000000 FORMAT "%13.9" /end CHARACTERISTIC
/begin CHARACTERISTIC DFES_GrpRpr.DFC_ComEPBChksum_C "common MIL debouncing / group representative for common MIL debouncing of DFC_ComEPBChksum" VALUE 0x8050518A Val_Wu16 906.000000000 DFC_Verb 0.00 906.000000000 FORMAT "%13.9" /end CHARACTERISTIC
/begin CHARACTERISTIC DFES_GrpRpr.DFC_ComEPBTOut_C "common MIL debouncing / group representative for common MIL debouncing of DFC_ComEPBTOut" VALUE 0x8050518C Val_Wu16 906.000000000 DFC_Verb 0.00 906.000000000 FORMAT "%13.9" /end CHARACTERISTIC
/begin CHARACTERISTIC DFES_GrpRpr.DFC_ComEPBctRing_C "common MIL debouncing / group representative for common MIL debouncing of DFC_ComEPBctRing" VALUE 0x8050518E Val_Wu16 906.000000000 DFC_Verb 0.00 906.000000000 FORMAT "%13.9" /end CHARACTERISTIC
/begin CHARACTERISTIC DFES_GrpRpr.DFC_ComEPS1Chksum_C "common MIL debouncing / group representative for common MIL debouncing of DFC_ComEPS1Chksum" VALUE 0x80505190 Val_Wu16 906.000000000 DFC_Verb 0.00 906.000000000 FORMAT "%13.9" /end CHARACTERISTIC
/begin CHARACTERISTIC DFES_GrpRpr.DFC_ComEPS1RingCnt_C "common MIL debouncing / group representative for common MIL debouncing of DFC_ComEPS1RingCnt" VALUE 0x80505192 Val_Wu16 906.000000000 DFC_Verb 0.00 906.000000000 FORMAT "%13.9" /end CHARACTERISTIC
/begin CHARACTERISTIC DFES_GrpRpr.DFC_ComEPS1TOut_C "common MIL debouncing / group representative for common MIL debouncing of DFC_ComEPS1TOut" VALUE 0x80505194 Val_Wu16 906.000000000 DFC_Verb 0.00 906.000000000 FORMAT "%13.9" /end CHARACTERISTIC
/begin CHARACTERISTIC DFES_GrpRpr.DFC_ComEngCanRxErr_C "common MIL debouncing / group representative for common MIL debouncing of DFC_ComEngCanRxErr" VALUE 0x80505196 Val_Wu16 906.000000000 DFC_Verb 0.00 906.000000000 FORMAT "%13.9" /end CHARACTERISTIC
/begin CHARACTERISTIC DFES_GrpRpr.DFC_ComGrvySnsrErr_C "common MIL debouncing / group representative for common MIL debouncing of DFC_ComGrvySnsrErr" VALUE 0x80505198 Val_Wu16 906.000000000 DFC_Verb 0.00 906.000000000 FORMAT "%13.9" /end CHARACTERISTIC
/begin CHARACTERISTIC DFES_GrpRpr.DFC_ComGwIMG1ChkSum_C "common MIL debouncing / group representative for common MIL debouncing of DFC_ComGwIMG1ChkSum" VALUE 0x8050519A Val_Wu16 906.000000000 DFC_Verb 0.00 906.000000000 FORMAT "%13.9" /end CHARACTERISTIC
/begin CHARACTERISTIC DFES_GrpRpr.DFC_ComGwIMG1RingCnt_C "common MIL debouncing / group representative for common MIL debouncing of DFC_ComGwIMG1RingCnt" VALUE 0x8050519C Val_Wu16 906.000000000 DFC_Verb 0.00 906.000000000 FORMAT "%13.9" /end CHARACTERISTIC
/begin CHARACTERISTIC DFES_GrpRpr.DFC_ComGwIMG1TOut_C "common MIL debouncing / group representative for common MIL debouncing of DFC_ComGwIMG1TOut" VALUE 0x8050519E Val_Wu16 906.000000000 DFC_Verb 0.00 906.000000000 FORMAT "%13.9" /end CHARACTERISTIC
/begin CHARACTERISTIC DFES_GrpRpr.DFC_ComGwIMG3ChkSum_C "common MIL debouncing / group representative for common MIL debouncing of DFC_ComGwIMG3ChkSum" VALUE 0x805051A0 Val_Wu16 906.000000000 DFC_Verb 0.00 906.000000000 FORMAT "%13.9" /end CHARACTERISTIC
/begin CHARACTERISTIC DFES_GrpRpr.DFC_ComGwIMG3RingCnt_C "common MIL debouncing / group representative for common MIL debouncing of DFC_ComGwIMG3RingCnt" VALUE 0x805051A2 Val_Wu16 906.000000000 DFC_Verb 0.00 906.000000000 FORMAT "%13.9" /end CHARACTERISTIC
/begin CHARACTERISTIC DFES_GrpRpr.DFC_ComGwIMG3TOut_C "common MIL debouncing / group representative for common MIL debouncing of DFC_ComGwIMG3TOut" VALUE 0x805051A4 Val_Wu16 906.000000000 DFC_Verb 0.00 906.000000000 FORMAT "%13.9" /end CHARACTERISTIC
/begin CHARACTERISTIC DFES_GrpRpr.DFC_ComGwIMG4ChkSum_C "common MIL debouncing / group representative for common MIL debouncing of DFC_ComGwIMG4ChkSum" VALUE 0x805051A6 Val_Wu16 906.000000000 DFC_Verb 0.00 906.000000000 FORMAT "%13.9" /end CHARACTERISTIC
/begin CHARACTERISTIC DFES_GrpRpr.DFC_ComGwIMG4RingCnt_C "common MIL debouncing / group representative for common MIL debouncing of DFC_ComGwIMG4RingCnt" VALUE 0x805051A8 Val_Wu16 906.000000000 DFC_Verb 0.00 906.000000000 FORMAT "%13.9" /end CHARACTERISTIC
/begin CHARACTERISTIC DFES_GrpRpr.DFC_ComGwIMG4TOut_C "common MIL debouncing / group representative for common MIL debouncing of DFC_ComGwIMG4TOut" VALUE 0x805051AA Val_Wu16 906.000000000 DFC_Verb 0.00 906.000000000 FORMAT "%13.9" /end CHARACTERISTIC
/begin CHARACTERISTIC DFES_GrpRpr.DFC_ComGwIMG5ChkSum_C "common MIL debouncing / group representative for common MIL debouncing of DFC_ComGwIMG5ChkSum" VALUE 0x805051AC Val_Wu16 906.000000000 DFC_Verb 0.00 906.000000000 FORMAT "%13.9" /end CHARACTERISTIC
/begin CHARACTERISTIC DFES_GrpRpr.DFC_ComGwIMG5RingCnt_C "common MIL debouncing / group representative for common MIL debouncing of DFC_ComGwIMG5RingCnt" VALUE 0x805051AE Val_Wu16 906.000000000 DFC_Verb 0.00 906.000000000 FORMAT "%13.9" /end CHARACTERISTIC
/begin CHARACTERISTIC DFES_GrpRpr.DFC_ComGwIMG5TOut_C "common MIL debouncing / group representative for common MIL debouncing of DFC_ComGwIMG5TOut" VALUE 0x805051B0 Val_Wu16 906.000000000 DFC_Verb 0.00 906.000000000 FORMAT "%13.9" /end CHARACTERISTIC
/begin CHARACTERISTIC DFES_GrpRpr.DFC_ComGwIMG6ChkSum_C "common MIL debouncing / group representative for common MIL debouncing of DFC_ComGwIMG6ChkSum" VALUE 0x805051B2 Val_Wu16 906.000000000 DFC_Verb 0.00 906.000000000 FORMAT "%13.9" /end CHARACTERISTIC
/begin CHARACTERISTIC DFES_GrpRpr.DFC_ComGwIMG6RingCnt_C "common MIL debouncing / group representative for common MIL debouncing of DFC_ComGwIMG6RingCnt" VALUE 0x805051B4 Val_Wu16 906.000000000 DFC_Verb 0.00 906.000000000 FORMAT "%13.9" /end CHARACTERISTIC
/begin CHARACTERISTIC DFES_GrpRpr.DFC_ComGwIMG6TOut_C "common MIL debouncing / group representative for common MIL debouncing of DFC_ComGwIMG6TOut" VALUE 0x805051B6 Val_Wu16 906.000000000 DFC_Verb 0.00 906.000000000 FORMAT "%13.9" /end CHARACTERISTIC
/begin CHARACTERISTIC DFES_GrpRpr.DFC_ComIDASBChksum_C "common MIL debouncing / group representative for common MIL debouncing of DFC_ComIDASBChksum" VALUE 0x805051B8 Val_Wu16 906.000000000 DFC_Verb 0.00 906.000000000 FORMAT "%13.9" /end CHARACTERISTIC
/begin CHARACTERISTIC DFES_GrpRpr.DFC_ComIDASBRingCnt_C "common MIL debouncing / group representative for common MIL debouncing of DFC_ComIDASBRingCnt" VALUE 0x805051BA Val_Wu16 906.000000000 DFC_Verb 0.00 906.000000000 FORMAT "%13.9" /end CHARACTERISTIC
/begin CHARACTERISTIC DFES_GrpRpr.DFC_ComIDASBTOut_C "common MIL debouncing / group representative for common MIL debouncing of DFC_ComIDASBTOut" VALUE 0x805051BC Val_Wu16 906.000000000 DFC_Verb 0.00 906.000000000 FORMAT "%13.9" /end CHARACTERISTIC
/begin CHARACTERISTIC DFES_GrpRpr.DFC_ComIMGMILReq_C "common MIL debouncing / group representative for common MIL debouncing of DFC_ComIMGMILReq" VALUE 0x805051BE Val_Wu16 906.000000000 DFC_Verb 0.00 906.000000000 FORMAT "%13.9" /end CHARACTERISTIC
/begin CHARACTERISTIC DFES_GrpRpr.DFC_ComISSPrms_C "common MIL debouncing / group representative for common MIL debouncing of DFC_ComISSPrms" VALUE 0x805051C0 Val_Wu16 906.000000000 DFC_Verb 0.00 906.000000000 FORMAT "%13.9" /end CHARACTERISTIC
/begin CHARACTERISTIC DFES_GrpRpr.DFC_ComMETAChksum_C "common MIL debouncing / group representative for common MIL debouncing of DFC_ComMETAChksum" VALUE 0x805051C2 Val_Wu16 906.000000000 DFC_Verb 0.00 906.000000000 FORMAT "%13.9" /end CHARACTERISTIC
/begin CHARACTERISTIC DFES_GrpRpr.DFC_ComMETAChksumPstDrv_C "common MIL debouncing / group representative for common MIL debouncing of DFC_ComMETAChksumPstDrv" VALUE 0x805051C4 Val_Wu16 906.000000000 DFC_Verb 0.00 906.000000000 FORMAT "%13.9" /end CHARACTERISTIC
/begin CHARACTERISTIC DFES_GrpRpr.DFC_ComMETARingCnt_C "common MIL debouncing / group representative for common MIL debouncing of DFC_ComMETARingCnt" VALUE 0x805051C6 Val_Wu16 906.000000000 DFC_Verb 0.00 906.000000000 FORMAT "%13.9" /end CHARACTERISTIC
/begin CHARACTERISTIC DFES_GrpRpr.DFC_ComMETARingCntPstDrv_C "common MIL debouncing / group representative for common MIL debouncing of DFC_ComMETARingCntPstDrv" VALUE 0x805051C8 Val_Wu16 906.000000000 DFC_Verb 0.00 906.000000000 FORMAT "%13.9" /end CHARACTERISTIC
/begin CHARACTERISTIC DFES_GrpRpr.DFC_ComMETATOut_C "common MIL debouncing / group representative for common MIL debouncing of DFC_ComMETATOut" VALUE 0x805051CA Val_Wu16 906.000000000 DFC_Verb 0.00 906.000000000 FORMAT "%13.9" /end CHARACTERISTIC
/begin CHARACTERISTIC DFES_GrpRpr.DFC_ComMETATOutPstDrv_C "common MIL debouncing / group representative for common MIL debouncing of DFC_ComMETATOutPstDrv" VALUE 0x805051CC Val_Wu16 906.000000000 DFC_Verb 0.00 906.000000000 FORMAT "%13.9" /end CHARACTERISTIC
/begin CHARACTERISTIC DFES_GrpRpr.DFC_ComMETCChksum_C "common MIL debouncing / group representative for common MIL debouncing of DFC_ComMETCChksum" VALUE 0x805051CE Val_Wu16 906.000000000 DFC_Verb 0.00 906.000000000 FORMAT "%13.9" /end CHARACTERISTIC
/begin CHARACTERISTIC DFES_GrpRpr.DFC_ComMETCRingCnt_C "common MIL debouncing / group representative for common MIL debouncing of DFC_ComMETCRingCnt" VALUE 0x805051D0 Val_Wu16 906.000000000 DFC_Verb 0.00 906.000000000 FORMAT "%13.9" /end CHARACTERISTIC
/begin CHARACTERISTIC DFES_GrpRpr.DFC_ComMETCTOut_C "common MIL debouncing / group representative for common MIL debouncing of DFC_ComMETCTOut" VALUE 0x805051D2 Val_Wu16 906.000000000 DFC_Verb 0.00 906.000000000 FORMAT "%13.9" /end CHARACTERISTIC
/begin CHARACTERISTIC DFES_GrpRpr.DFC_ComMETDChksum_C "common MIL debouncing / group representative for common MIL debouncing of DFC_ComMETDChksum" VALUE 0x805051D4 Val_Wu16 906.000000000 DFC_Verb 0.00 906.000000000 FORMAT "%13.9" /end CHARACTERISTIC
/begin CHARACTERISTIC DFES_GrpRpr.DFC_ComMETDRingCnt_C "common MIL debouncing / group representative for common MIL debouncing of DFC_ComMETDRingCnt" VALUE 0x805051D6 Val_Wu16 906.000000000 DFC_Verb 0.00 906.000000000 FORMAT "%13.9" /end CHARACTERISTIC
/begin CHARACTERISTIC DFES_GrpRpr.DFC_ComMETDTOut_C "common MIL debouncing / group representative for common MIL debouncing of DFC_ComMETDTOut" VALUE 0x805051D8 Val_Wu16 906.000000000 DFC_Verb 0.00 906.000000000 FORMAT "%13.9" /end CHARACTERISTIC
/begin CHARACTERISTIC DFES_GrpRpr.DFC_ComMETE2Chksum_C "common MIL debouncing / group representative for common MIL debouncing of DFC_ComMETE2Chksum" VALUE 0x805051DA Val_Wu16 906.000000000 DFC_Verb 0.00 906.000000000 FORMAT "%13.9" /end CHARACTERISTIC
/begin CHARACTERISTIC DFES_GrpRpr.DFC_ComMETE2RingCnt_C "common MIL debouncing / group representative for common MIL debouncing of DFC_ComMETE2RingCnt" VALUE 0x805051DC Val_Wu16 906.000000000 DFC_Verb 0.00 906.000000000 FORMAT "%13.9" /end CHARACTERISTIC
/begin CHARACTERISTIC DFES_GrpRpr.DFC_ComMETE2TOut_C "common MIL debouncing / group representative for common MIL debouncing of DFC_ComMETE2TOut" VALUE 0x805051DE Val_Wu16 906.000000000 DFC_Verb 0.00 906.000000000 FORMAT "%13.9" /end CHARACTERISTIC
/begin CHARACTERISTIC DFES_GrpRpr.DFC_ComMETFChksum_C "common MIL debouncing / group representative for common MIL debouncing of DFC_ComMETFChksum" VALUE 0x805051E0 Val_Wu16 906.000000000 DFC_Verb 0.00 906.000000000 FORMAT "%13.9" /end CHARACTERISTIC
/begin CHARACTERISTIC DFES_GrpRpr.DFC_ComMETFRingCnt_C "common MIL debouncing / group representative for common MIL debouncing of DFC_ComMETFRingCnt" VALUE 0x805051E2 Val_Wu16 906.000000000 DFC_Verb 0.00 906.000000000 FORMAT "%13.9" /end CHARACTERISTIC
/begin CHARACTERISTIC DFES_GrpRpr.DFC_ComMETFTOut_C "common MIL debouncing / group representative for common MIL debouncing of DFC_ComMETFTOut" VALUE 0x805051E4 Val_Wu16 906.000000000 DFC_Verb 0.00 906.000000000 FORMAT "%13.9" /end CHARACTERISTIC
/begin CHARACTERISTIC DFES_GrpRpr.DFC_ComMETGChksum_C "common MIL debouncing / group representative for common MIL debouncing of DFC_ComMETGChksum" VALUE 0x805051E6 Val_Wu16 906.000000000 DFC_Verb 0.00 906.000000000 FORMAT "%13.9" /end CHARACTERISTIC
/begin CHARACTERISTIC DFES_GrpRpr.DFC_ComMETGRingCnt_C "common MIL debouncing / group representative for common MIL debouncing of DFC_ComMETGRingCnt" VALUE 0x805051E8 Val_Wu16 906.000000000 DFC_Verb 0.00 906.000000000 FORMAT "%13.9" /end CHARACTERISTIC
/begin CHARACTERISTIC DFES_GrpRpr.DFC_ComMETGTOut_C "common MIL debouncing / group representative for common MIL debouncing of DFC_ComMETGTOut" VALUE 0x805051EA Val_Wu16 906.000000000 DFC_Verb 0.00 906.000000000 FORMAT "%13.9" /end CHARACTERISTIC
/begin CHARACTERISTIC DFES_GrpRpr.DFC_ComMETH2Chksum_C "common MIL debouncing / group representative for common MIL debouncing of DFC_ComMETH2Chksum" VALUE 0x805051EC Val_Wu16 906.000000000 DFC_Verb 0.00 906.000000000 FORMAT "%13.9" /end CHARACTERISTIC
/begin CHARACTERISTIC DFES_GrpRpr.DFC_ComMETH2RingCnt_C "common MIL debouncing / group representative for common MIL debouncing of DFC_ComMETH2RingCnt" VALUE 0x805051EE Val_Wu16 906.000000000 DFC_Verb 0.00 906.000000000 FORMAT "%13.9" /end CHARACTERISTIC
/begin CHARACTERISTIC DFES_GrpRpr.DFC_ComMETH2TOut_C "common MIL debouncing / group representative for common MIL debouncing of DFC_ComMETH2TOut" VALUE 0x805051F0 Val_Wu16 906.000000000 DFC_Verb 0.00 906.000000000 FORMAT "%13.9" /end CHARACTERISTIC
/begin CHARACTERISTIC DFES_GrpRpr.DFC_ComMETHChksum_C "common MIL debouncing / group representative for common MIL debouncing of DFC_ComMETHChksum" VALUE 0x805051F2 Val_Wu16 906.000000000 DFC_Verb 0.00 906.000000000 FORMAT "%13.9" /end CHARACTERISTIC
/begin CHARACTERISTIC DFES_GrpRpr.DFC_ComMETHRingCnt_C "common MIL debouncing / group representative for common MIL debouncing of DFC_ComMETHRingCnt" VALUE 0x805051F4 Val_Wu16 906.000000000 DFC_Verb 0.00 906.000000000 FORMAT "%13.9" /end CHARACTERISTIC
/begin CHARACTERISTIC DFES_GrpRpr.DFC_ComMETHTOut_C "common MIL debouncing / group representative for common MIL debouncing of DFC_ComMETHTOut" VALUE 0x805051F6 Val_Wu16 906.000000000 DFC_Verb 0.00 906.000000000 FORMAT "%13.9" /end CHARACTERISTIC
/begin CHARACTERISTIC DFES_GrpRpr.DFC_ComMETIChksum_C "common MIL debouncing / group representative for common MIL debouncing of DFC_ComMETIChksum" VALUE 0x805051F8 Val_Wu16 906.000000000 DFC_Verb 0.00 906.000000000 FORMAT "%13.9" /end CHARACTERISTIC
/begin CHARACTERISTIC DFES_GrpRpr.DFC_ComMETIRingCnt_C "common MIL debouncing / group representative for common MIL debouncing of DFC_ComMETIRingCnt" VALUE 0x805051FA Val_Wu16 906.000000000 DFC_Verb 0.00 906.000000000 FORMAT "%13.9" /end CHARACTERISTIC
/begin CHARACTERISTIC DFES_GrpRpr.DFC_ComMETITOut_C "common MIL debouncing / group representative for common MIL debouncing of DFC_ComMETITOut" VALUE 0x805051FC Val_Wu16 906.000000000 DFC_Verb 0.00 906.000000000 FORMAT "%13.9" /end CHARACTERISTIC
/begin CHARACTERISTIC DFES_GrpRpr.DFC_ComMETKChksum_C "common MIL debouncing / group representative for common MIL debouncing of DFC_ComMETKChksum" VALUE 0x805051FE Val_Wu16 906.000000000 DFC_Verb 0.00 906.000000000 FORMAT "%13.9" /end CHARACTERISTIC
/begin CHARACTERISTIC DFES_GrpRpr.DFC_ComMETKRingCnt_C "common MIL debouncing / group representative for common MIL debouncing of DFC_ComMETKRingCnt" VALUE 0x80505200 Val_Wu16 906.000000000 DFC_Verb 0.00 906.000000000 FORMAT "%13.9" /end CHARACTERISTIC
/begin CHARACTERISTIC DFES_GrpRpr.DFC_ComMETKTOut_C "common MIL debouncing / group representative for common MIL debouncing of DFC_ComMETKTOut" VALUE 0x80505202 Val_Wu16 906.000000000 DFC_Verb 0.00 906.000000000 FORMAT "%13.9" /end CHARACTERISTIC
/begin CHARACTERISTIC DFES_GrpRpr.DFC_ComMETLChksum_C "common MIL debouncing / group representative for common MIL debouncing of DFC_ComMETLChksum" VALUE 0x80505204 Val_Wu16 906.000000000 DFC_Verb 0.00 906.000000000 FORMAT "%13.9" /end CHARACTERISTIC
/begin CHARACTERISTIC DFES_GrpRpr.DFC_ComMETLRingCnt_C "common MIL debouncing / group representative for common MIL debouncing of DFC_ComMETLRingCnt" VALUE 0x80505206 Val_Wu16 906.000000000 DFC_Verb 0.00 906.000000000 FORMAT "%13.9" /end CHARACTERISTIC
/begin CHARACTERISTIC DFES_GrpRpr.DFC_ComMETLTOut_C "common MIL debouncing / group representative for common MIL debouncing of DFC_ComMETLTOut" VALUE 0x80505208 Val_Wu16 906.000000000 DFC_Verb 0.00 906.000000000 FORMAT "%13.9" /end CHARACTERISTIC
/begin CHARACTERISTIC DFES_GrpRpr.DFC_ComMETMChksum_C "common MIL debouncing / group representative for common MIL debouncing of DFC_ComMETMChksum" VALUE 0x8050520A Val_Wu16 906.000000000 DFC_Verb 0.00 906.000000000 FORMAT "%13.9" /end CHARACTERISTIC
/begin CHARACTERISTIC DFES_GrpRpr.DFC_ComMETMRingCnt_C "common MIL debouncing / group representative for common MIL debouncing of DFC_ComMETMRingCnt" VALUE 0x8050520C Val_Wu16 906.000000000 DFC_Verb 0.00 906.000000000 FORMAT "%13.9" /end CHARACTERISTIC
/begin CHARACTERISTIC DFES_GrpRpr.DFC_ComMETMTOut_C "common MIL debouncing / group representative for common MIL debouncing of DFC_ComMETMTOut" VALUE 0x8050520E Val_Wu16 906.000000000 DFC_Verb 0.00 906.000000000 FORMAT "%13.9" /end CHARACTERISTIC
/begin CHARACTERISTIC DFES_GrpRpr.DFC_ComMETNChksum_C "common MIL debouncing / group representative for common MIL debouncing of DFC_ComMETNChksum" VALUE 0x80505210 Val_Wu16 906.000000000 DFC_Verb 0.00 906.000000000 FORMAT "%13.9" /end CHARACTERISTIC
/begin CHARACTERISTIC DFES_GrpRpr.DFC_ComMETNRingCnt_C "common MIL debouncing / group representative for common MIL debouncing of DFC_ComMETNRingCnt" VALUE 0x80505212 Val_Wu16 906.000000000 DFC_Verb 0.00 906.000000000 FORMAT "%13.9" /end CHARACTERISTIC
/begin CHARACTERISTIC DFES_GrpRpr.DFC_ComMETNTOut_C "common MIL debouncing / group representative for common MIL debouncing of DFC_ComMETNTOut" VALUE 0x80505214 Val_Wu16 906.000000000 DFC_Verb 0.00 906.000000000 FORMAT "%13.9" /end CHARACTERISTIC
/begin CHARACTERISTIC DFES_GrpRpr.DFC_ComMtrCom_C "common MIL debouncing / group representative for common MIL debouncing of DFC_ComMtrCom" VALUE 0x80505216 Val_Wu16 906.000000000 DFC_Verb 0.00 906.000000000 FORMAT "%13.9" /end CHARACTERISTIC
/begin CHARACTERISTIC DFES_GrpRpr.DFC_ComPCUChkSum_C "common MIL debouncing / group representative for common MIL debouncing of DFC_ComPCUChkSum" VALUE 0x80505218 Val_Wu16 906.000000000 DFC_Verb 0.00 906.000000000 FORMAT "%13.9" /end CHARACTERISTIC
/begin CHARACTERISTIC DFES_GrpRpr.DFC_ComPCURingCnt_C "common MIL debouncing / group representative for common MIL debouncing of DFC_ComPCURingCnt" VALUE 0x8050521A Val_Wu16 906.000000000 DFC_Verb 0.00 906.000000000 FORMAT "%13.9" /end CHARACTERISTIC
/begin CHARACTERISTIC DFES_GrpRpr.DFC_ComPCUTOut_C "common MIL debouncing / group representative for common MIL debouncing of DFC_ComPCUTOut" VALUE 0x8050521C Val_Wu16 906.000000000 DFC_Verb 0.00 906.000000000 FORMAT "%13.9" /end CHARACTERISTIC
/begin CHARACTERISTIC DFES_GrpRpr.DFC_ComSRSAChksum_C "common MIL debouncing / group representative for common MIL debouncing of DFC_ComSRSAChksum" VALUE 0x8050521E Val_Wu16 906.000000000 DFC_Verb 0.00 906.000000000 FORMAT "%13.9" /end CHARACTERISTIC
/begin CHARACTERISTIC DFES_GrpRpr.DFC_ComSRSARingCnt_C "common MIL debouncing / group representative for common MIL debouncing of DFC_ComSRSARingCnt" VALUE 0x80505220 Val_Wu16 906.000000000 DFC_Verb 0.00 906.000000000 FORMAT "%13.9" /end CHARACTERISTIC
/begin CHARACTERISTIC DFES_GrpRpr.DFC_ComSRSATOut_C "common MIL debouncing / group representative for common MIL debouncing of DFC_ComSRSATOut" VALUE 0x80505222 Val_Wu16 906.000000000 DFC_Verb 0.00 906.000000000 FORMAT "%13.9" /end CHARACTERISTIC
/begin CHARACTERISTIC DFES_GrpRpr.DFC_ComSRSBChksum_C "common MIL debouncing / group representative for common MIL debouncing of DFC_ComSRSBChksum" VALUE 0x80505224 Val_Wu16 906.000000000 DFC_Verb 0.00 906.000000000 FORMAT "%13.9" /end CHARACTERISTIC
/begin CHARACTERISTIC DFES_GrpRpr.DFC_ComSRSBRingCnt_C "common MIL debouncing / group representative for common MIL debouncing of DFC_ComSRSBRingCnt" VALUE 0x80505226 Val_Wu16 906.000000000 DFC_Verb 0.00 906.000000000 FORMAT "%13.9" /end CHARACTERISTIC
/begin CHARACTERISTIC DFES_GrpRpr.DFC_ComSRSBTOut_C "common MIL debouncing / group representative for common MIL debouncing of DFC_ComSRSBTOut" VALUE 0x80505228 Val_Wu16 906.000000000 DFC_Verb 0.00 906.000000000 FORMAT "%13.9" /end CHARACTERISTIC
/begin CHARACTERISTIC DFES_GrpRpr.DFC_ComSRSChksum_C "common MIL debouncing / group representative for common MIL debouncing of DFC_ComSRSChksum" VALUE 0x8050522A Val_Wu16 906.000000000 DFC_Verb 0.00 906.000000000 FORMAT "%13.9" /end CHARACTERISTIC
/begin CHARACTERISTIC DFES_GrpRpr.DFC_ComSRSErr_C "common MIL debouncing / group representative for common MIL debouncing of DFC_ComSRSErr" VALUE 0x8050522C Val_Wu16 906.000000000 DFC_Verb 0.00 906.000000000 FORMAT "%13.9" /end CHARACTERISTIC
/begin CHARACTERISTIC DFES_GrpRpr.DFC_ComSRSRingCnt_C "common MIL debouncing / group representative for common MIL debouncing of DFC_ComSRSRingCnt" VALUE 0x8050522E Val_Wu16 906.000000000 DFC_Verb 0.00 906.000000000 FORMAT "%13.9" /end CHARACTERISTIC
/begin CHARACTERISTIC DFES_GrpRpr.DFC_ComSRSTOut_C "common MIL debouncing / group representative for common MIL debouncing of DFC_ComSRSTOut" VALUE 0x80505230 Val_Wu16 906.000000000 DFC_Verb 0.00 906.000000000 FORMAT "%13.9" /end CHARACTERISTIC
/begin CHARACTERISTIC DFES_GrpRpr.DFC_ComVehSpdPndFltTCU_C "common MIL debouncing / group representative for common MIL debouncing of DFC_ComVehSpdPndFltTCU" VALUE 0x80505232 Val_Wu16 906.000000000 DFC_Verb 0.00 906.000000000 FORMAT "%13.9" /end CHARACTERISTIC
/begin CHARACTERISTIC DFES_GrpRpr.DFC_EbsChartcCurrErr_C "common MIL debouncing / group representative for common MIL debouncing of DFC_EbsChartcCurrErr" VALUE 0x80505234 Val_Wu16 906.000000000 DFC_Verb 0.00 906.000000000 FORMAT "%13.9" /end CHARACTERISTIC
/begin CHARACTERISTIC DFES_GrpRpr.DFC_EbsSelfDiagErr_C "common MIL debouncing / group representative for common MIL debouncing of DFC_EbsSelfDiagErr" VALUE 0x80505236 Val_Wu16 906.000000000 DFC_Verb 0.00 906.000000000 FORMAT "%13.9" /end CHARACTERISTIC
/begin CHARACTERISTIC DFES_GrpRpr.DFC_GEVlvPhaCsersIntkB1_C "common MIL debouncing / group representative for common MIL debouncing of DFC_GEVlvPhaCsersIntkB1" VALUE 0x80505238 Val_Wu16 906.000000000 DFC_Verb 0.00 906.000000000 FORMAT "%13.9" /end CHARACTERISTIC
/begin CHARACTERISTIC DFES_GrpRpr.DFC_GEVlvPhaPsOpenLoadIntkB1_C "common MIL debouncing / group representative for common MIL debouncing of DFC_GEVlvPhaPsOpenLoadIntkB1" VALUE 0x8050523A Val_Wu16 906.000000000 DFC_Verb 0.00 906.000000000 FORMAT "%13.9" /end CHARACTERISTIC
/begin CHARACTERISTIC DFES_GrpRpr.DFC_GEVlvPhaPsShoToBattIntkB1_C "common MIL debouncing / group representative for common MIL debouncing of DFC_GEVlvPhaPsShoToBattIntkB1" VALUE 0x8050523C Val_Wu16 906.000000000 DFC_Verb 0.00 906.000000000 FORMAT "%13.9" /end CHARACTERISTIC
/begin CHARACTERISTIC DFES_GrpRpr.DFC_GEVlvPhaPsShoToGndIntkB1_C "common MIL debouncing / group representative for common MIL debouncing of DFC_GEVlvPhaPsShoToGndIntkB1" VALUE 0x8050523E Val_Wu16 906.000000000 DFC_Verb 0.00 906.000000000 FORMAT "%13.9" /end CHARACTERISTIC
/begin CHARACTERISTIC DFES_GrpRpr.DFC_GbxCANDigPlausErr_C "common MIL debouncing / group representative for common MIL debouncing of DFC_GbxCANDigPlausErr" VALUE 0x80505240 Val_Wu16 906.000000000 DFC_Verb 0.00 906.000000000 FORMAT "%13.9" /end CHARACTERISTIC
/begin CHARACTERISTIC DFES_GrpRpr.DFC_GbxNPos1SRCMax_C "common MIL debouncing / group representative for common MIL debouncing of DFC_GbxNPos1SRCMax" VALUE 0x80505242 Val_Wu16 906.000000000 DFC_Verb 0.00 906.000000000 FORMAT "%13.9" /end CHARACTERISTIC
/begin CHARACTERISTIC DFES_GrpRpr.DFC_GbxNPos1SRCMin_C "common MIL debouncing / group representative for common MIL debouncing of DFC_GbxNPos1SRCMin" VALUE 0x80505244 Val_Wu16 906.000000000 DFC_Verb 0.00 906.000000000 FORMAT "%13.9" /end CHARACTERISTIC
/begin CHARACTERISTIC DFES_GrpRpr.DFC_GbxNPos2SRCMax_C "common MIL debouncing / group representative for common MIL debouncing of DFC_GbxNPos2SRCMax" VALUE 0x80505246 Val_Wu16 906.000000000 DFC_Verb 0.00 906.000000000 FORMAT "%13.9" /end CHARACTERISTIC
/begin CHARACTERISTIC DFES_GrpRpr.DFC_GbxNPos2SRCMin_C "common MIL debouncing / group representative for common MIL debouncing of DFC_GbxNPos2SRCMin" VALUE 0x80505248 Val_Wu16 906.000000000 DFC_Verb 0.00 906.000000000 FORMAT "%13.9" /end CHARACTERISTIC
/begin CHARACTERISTIC DFES_GrpRpr.DFC_GbxNPosAlvChk_C "common MIL debouncing / group representative for common MIL debouncing of DFC_GbxNPosAlvChk" VALUE 0x8050524A Val_Wu16 906.000000000 DFC_Verb 0.00 906.000000000 FORMAT "%13.9" /end CHARACTERISTIC
/begin CHARACTERISTIC DFES_GrpRpr.DFC_GbxNPosSyncErr_C "common MIL debouncing / group representative for common MIL debouncing of DFC_GbxNPosSyncErr" VALUE 0x8050524C Val_Wu16 906.000000000 DFC_Verb 0.00 906.000000000 FORMAT "%13.9" /end CHARACTERISTIC
/begin CHARACTERISTIC DFES_GrpRpr.DFC_HEGOS2B1HtrPsMax_C "common MIL debouncing / group representative for common MIL debouncing of DFC_HEGOS2B1HtrPsMax" VALUE 0x8050524E Val_Wu16 906.000000000 DFC_Verb 0.00 906.000000000 FORMAT "%13.9" /end CHARACTERISTIC
/begin CHARACTERISTIC DFES_GrpRpr.DFC_HEGOS2B1HtrPsMin_C "common MIL debouncing / group representative for common MIL debouncing of DFC_HEGOS2B1HtrPsMin" VALUE 0x80505250 Val_Wu16 906.000000000 DFC_Verb 0.00 906.000000000 FORMAT "%13.9" /end CHARACTERISTIC
/begin CHARACTERISTIC DFES_GrpRpr.DFC_HEGOS2B1HtrPsSig_C "common MIL debouncing / group representative for common MIL debouncing of DFC_HEGOS2B1HtrPsSig" VALUE 0x80505252 Val_Wu16 906.000000000 DFC_Verb 0.00 906.000000000 FORMAT "%13.9" /end CHARACTERISTIC
/begin CHARACTERISTIC DFES_GrpRpr.DFC_LinCSErrACG_C "common MIL debouncing / group representative for common MIL debouncing of DFC_LinCSErrACG" VALUE 0x80505254 Val_Wu16 906.000000000 DFC_Verb 0.00 906.000000000 FORMAT "%13.9" /end CHARACTERISTIC
/begin CHARACTERISTIC DFES_GrpRpr.DFC_LinCSErrAEV_C "common MIL debouncing / group representative for common MIL debouncing of DFC_LinCSErrAEV" VALUE 0x80505256 Val_Wu16 906.000000000 DFC_Verb 0.00 906.000000000 FORMAT "%13.9" /end CHARACTERISTIC
/begin CHARACTERISTIC DFES_GrpRpr.DFC_LinCSErrDCDC_C "common MIL debouncing / group representative for common MIL debouncing of DFC_LinCSErrDCDC" VALUE 0x80505258 Val_Wu16 906.000000000 DFC_Verb 0.00 906.000000000 FORMAT "%13.9" /end CHARACTERISTIC
/begin CHARACTERISTIC DFES_GrpRpr.DFC_LinCSErrEBS_C "common MIL debouncing / group representative for common MIL debouncing of DFC_LinCSErrEBS" VALUE 0x8050525A Val_Wu16 906.000000000 DFC_Verb 0.00 906.000000000 FORMAT "%13.9" /end CHARACTERISTIC
/begin CHARACTERISTIC DFES_GrpRpr.DFC_LinHdrTimeoutErrACG_C "common MIL debouncing / group representative for common MIL debouncing of DFC_LinHdrTimeoutErrACG" VALUE 0x8050525C Val_Wu16 906.000000000 DFC_Verb 0.00 906.000000000 FORMAT "%13.9" /end CHARACTERISTIC
/begin CHARACTERISTIC DFES_GrpRpr.DFC_LinHdrTimeoutErrAEV_C "common MIL debouncing / group representative for common MIL debouncing of DFC_LinHdrTimeoutErrAEV" VALUE 0x8050525E Val_Wu16 906.000000000 DFC_Verb 0.00 906.000000000 FORMAT "%13.9" /end CHARACTERISTIC
/begin CHARACTERISTIC DFES_GrpRpr.DFC_LinHdrTimeoutErrDCDC_C "common MIL debouncing / group representative for common MIL debouncing of DFC_LinHdrTimeoutErrDCDC" VALUE 0x80505260 Val_Wu16 906.000000000 DFC_Verb 0.00 906.000000000 FORMAT "%13.9" /end CHARACTERISTIC
/begin CHARACTERISTIC DFES_GrpRpr.DFC_LinHdrTimeoutErrEBS_C "common MIL debouncing / group representative for common MIL debouncing of DFC_LinHdrTimeoutErrEBS" VALUE 0x80505262 Val_Wu16 906.000000000 DFC_Verb 0.00 906.000000000 FORMAT "%13.9" /end CHARACTERISTIC
/begin CHARACTERISTIC DFES_GrpRpr.DFC_LinMsgTimeoutErrACG_C "common MIL debouncing / group representative for common MIL debouncing of DFC_LinMsgTimeoutErrACG" VALUE 0x80505264 Val_Wu16 906.000000000 DFC_Verb 0.00 906.000000000 FORMAT "%13.9" /end CHARACTERISTIC
/begin CHARACTERISTIC DFES_GrpRpr.DFC_LinMsgTimeoutErrAEV_C "common MIL debouncing / group representative for common MIL debouncing of DFC_LinMsgTimeoutErrAEV" VALUE 0x80505266 Val_Wu16 906.000000000 DFC_Verb 0.00 906.000000000 FORMAT "%13.9" /end CHARACTERISTIC
/begin CHARACTERISTIC DFES_GrpRpr.DFC_LinMsgTimeoutErrDCDC_C "common MIL debouncing / group representative for common MIL debouncing of DFC_LinMsgTimeoutErrDCDC" VALUE 0x80505268 Val_Wu16 906.000000000 DFC_Verb 0.00 906.000000000 FORMAT "%13.9" /end CHARACTERISTIC
/begin CHARACTERISTIC DFES_GrpRpr.DFC_LinMsgTimeoutErrEBS_C "common MIL debouncing / group representative for common MIL debouncing of DFC_LinMsgTimeoutErrEBS" VALUE 0x8050526A Val_Wu16 906.000000000 DFC_Verb 0.00 906.000000000 FORMAT "%13.9" /end CHARACTERISTIC
/begin CHARACTERISTIC DFES_GrpRpr.DFC_LinNoStrtComErr_C "common MIL debouncing / group representative for common MIL debouncing of DFC_LinNoStrtComErr" VALUE 0x8050526C Val_Wu16 906.000000000 DFC_Verb 0.00 906.000000000 FORMAT "%13.9" /end CHARACTERISTIC
/begin CHARACTERISTIC DFES_GrpRpr.DFC_LowPresOilP_C "common MIL debouncing / group representative for common MIL debouncing of DFC_LowPresOilP" VALUE 0x8050526E Val_Wu16 906.000000000 DFC_Verb 0.00 906.000000000 FORMAT "%13.9" /end CHARACTERISTIC
/begin CHARACTERISTIC DFES_GrpRpr.DFC_MisfDetVWhlFrntLeOORHi_C "common MIL debouncing / group representative for common MIL debouncing of DFC_MisfDetVWhlFrntLeOORHi" VALUE 0x80505270 Val_Wu16 906.000000000 DFC_Verb 0.00 906.000000000 FORMAT "%13.9" /end CHARACTERISTIC
/begin CHARACTERISTIC DFES_GrpRpr.DFC_MisfDetVWhlFrntLeRatyHi_C "common MIL debouncing / group representative for common MIL debouncing of DFC_MisfDetVWhlFrntLeRatyHi" VALUE 0x80505272 Val_Wu16 906.000000000 DFC_Verb 0.00 906.000000000 FORMAT "%13.9" /end CHARACTERISTIC
/begin CHARACTERISTIC DFES_GrpRpr.DFC_MisfDetVWhlFrntLeRatyLo_C "common MIL debouncing / group representative for common MIL debouncing of DFC_MisfDetVWhlFrntLeRatyLo" VALUE 0x80505274 Val_Wu16 906.000000000 DFC_Verb 0.00 906.000000000 FORMAT "%13.9" /end CHARACTERISTIC
/begin CHARACTERISTIC DFES_GrpRpr.DFC_MisfDetVWhlFrntLeStuck_C "common MIL debouncing / group representative for common MIL debouncing of DFC_MisfDetVWhlFrntLeStuck" VALUE 0x80505276 Val_Wu16 906.000000000 DFC_Verb 0.00 906.000000000 FORMAT "%13.9" /end CHARACTERISTIC
/begin CHARACTERISTIC DFES_GrpRpr.DFC_MisfDetVWhlFrntRiOORHi_C "common MIL debouncing / group representative for common MIL debouncing of DFC_MisfDetVWhlFrntRiOORHi" VALUE 0x80505278 Val_Wu16 906.000000000 DFC_Verb 0.00 906.000000000 FORMAT "%13.9" /end CHARACTERISTIC
/begin CHARACTERISTIC DFES_GrpRpr.DFC_MisfDetVWhlFrntRiRatyHi_C "common MIL debouncing / group representative for common MIL debouncing of DFC_MisfDetVWhlFrntRiRatyHi" VALUE 0x8050527A Val_Wu16 906.000000000 DFC_Verb 0.00 906.000000000 FORMAT "%13.9" /end CHARACTERISTIC
/begin CHARACTERISTIC DFES_GrpRpr.DFC_MisfDetVWhlFrntRiRatyLo_C "common MIL debouncing / group representative for common MIL debouncing of DFC_MisfDetVWhlFrntRiRatyLo" VALUE 0x8050527C Val_Wu16 906.000000000 DFC_Verb 0.00 906.000000000 FORMAT "%13.9" /end CHARACTERISTIC
/begin CHARACTERISTIC DFES_GrpRpr.DFC_MisfDetVWhlFrntRiStuck_C "common MIL debouncing / group representative for common MIL debouncing of DFC_MisfDetVWhlFrntRiStuck" VALUE 0x8050527E Val_Wu16 906.000000000 DFC_Verb 0.00 906.000000000 FORMAT "%13.9" /end CHARACTERISTIC
/begin CHARACTERISTIC DFES_GrpRpr.DFC_MisfDetVWhlReLeOORHi_C "common MIL debouncing / group representative for common MIL debouncing of DFC_MisfDetVWhlReLeOORHi" VALUE 0x80505280 Val_Wu16 906.000000000 DFC_Verb 0.00 906.000000000 FORMAT "%13.9" /end CHARACTERISTIC
/begin CHARACTERISTIC DFES_GrpRpr.DFC_MisfDetVWhlReLeRatyHi_C "common MIL debouncing / group representative for common MIL debouncing of DFC_MisfDetVWhlReLeRatyHi" VALUE 0x80505282 Val_Wu16 906.000000000 DFC_Verb 0.00 906.000000000 FORMAT "%13.9" /end CHARACTERISTIC
/begin CHARACTERISTIC DFES_GrpRpr.DFC_MisfDetVWhlReLeRatyLo_C "common MIL debouncing / group representative for common MIL debouncing of DFC_MisfDetVWhlReLeRatyLo" VALUE 0x80505284 Val_Wu16 906.000000000 DFC_Verb 0.00 906.000000000 FORMAT "%13.9" /end CHARACTERISTIC
/begin CHARACTERISTIC DFES_GrpRpr.DFC_MisfDetVWhlReLeStuck_C "common MIL debouncing / group representative for common MIL debouncing of DFC_MisfDetVWhlReLeStuck" VALUE 0x80505286 Val_Wu16 906.000000000 DFC_Verb 0.00 906.000000000 FORMAT "%13.9" /end CHARACTERISTIC
/begin CHARACTERISTIC DFES_GrpRpr.DFC_MisfDetVWhlReRiOORHi_C "common MIL debouncing / group representative for common MIL debouncing of DFC_MisfDetVWhlReRiOORHi" VALUE 0x80505288 Val_Wu16 906.000000000 DFC_Verb 0.00 906.000000000 FORMAT "%13.9" /end CHARACTERISTIC
/begin CHARACTERISTIC DFES_GrpRpr.DFC_MisfDetVWhlReRiRatyHi_C "common MIL debouncing / group representative for common MIL debouncing of DFC_MisfDetVWhlReRiRatyHi" VALUE 0x8050528A Val_Wu16 906.000000000 DFC_Verb 0.00 906.000000000 FORMAT "%13.9" /end CHARACTERISTIC
/begin CHARACTERISTIC DFES_GrpRpr.DFC_MisfDetVWhlReRiRatyLo_C "common MIL debouncing / group representative for common MIL debouncing of DFC_MisfDetVWhlReRiRatyLo" VALUE 0x8050528C Val_Wu16 906.000000000 DFC_Verb 0.00 906.000000000 FORMAT "%13.9" /end CHARACTERISTIC
/begin CHARACTERISTIC DFES_GrpRpr.DFC_MisfDetVWhlReRiStuck_C "common MIL debouncing / group representative for common MIL debouncing of DFC_MisfDetVWhlReRiStuck" VALUE 0x8050528E Val_Wu16 906.000000000 DFC_Verb 0.00 906.000000000 FORMAT "%13.9" /end CHARACTERISTIC
/begin CHARACTERISTIC DFES_GrpRpr.DFC_MisfDetdVWhlFrntLePlaus_C "common MIL debouncing / group representative for common MIL debouncing of DFC_MisfDetdVWhlFrntLePlaus" VALUE 0x80505290 Val_Wu16 906.000000000 DFC_Verb 0.00 906.000000000 FORMAT "%13.9" /end CHARACTERISTIC
/begin CHARACTERISTIC DFES_GrpRpr.DFC_MisfDetdVWhlFrntRiPlaus_C "common MIL debouncing / group representative for common MIL debouncing of DFC_MisfDetdVWhlFrntRiPlaus" VALUE 0x80505292 Val_Wu16 906.000000000 DFC_Verb 0.00 906.000000000 FORMAT "%13.9" /end CHARACTERISTIC
/begin CHARACTERISTIC DFES_GrpRpr.DFC_MisfDetdVWhlReLePlaus_C "common MIL debouncing / group representative for common MIL debouncing of DFC_MisfDetdVWhlReLePlaus" VALUE 0x80505294 Val_Wu16 906.000000000 DFC_Verb 0.00 906.000000000 FORMAT "%13.9" /end CHARACTERISTIC
/begin CHARACTERISTIC DFES_GrpRpr.DFC_MisfDetdVWhlReRiPlaus_C "common MIL debouncing / group representative for common MIL debouncing of DFC_MisfDetdVWhlReRiPlaus" VALUE 0x80505296 Val_Wu16 906.000000000 DFC_Verb 0.00 906.000000000 FORMAT "%13.9" /end CHARACTERISTIC
/begin CHARACTERISTIC DFES_GrpRpr.DFC_PEnvSigRngMax_C "common MIL debouncing / group representative for common MIL debouncing of DFC_PEnvSigRngMax" VALUE 0x80505298 Val_Wu16 906.000000000 DFC_Verb 0.00 906.000000000 FORMAT "%13.9" /end CHARACTERISTIC
/begin CHARACTERISTIC DFES_GrpRpr.DFC_PEnvSigRngMin_C "common MIL debouncing / group representative for common MIL debouncing of DFC_PEnvSigRngMin" VALUE 0x8050529A Val_Wu16 906.000000000 DFC_Verb 0.00 906.000000000 FORMAT "%13.9" /end CHARACTERISTIC
/begin CHARACTERISTIC DFES_GrpRpr.DFC_StmFault_C "common MIL debouncing / group representative for common MIL debouncing of DFC_StmFault" VALUE 0x8050529C Val_Wu16 906.000000000 DFC_Verb 0.00 906.000000000 FORMAT "%13.9" /end CHARACTERISTIC
/begin CHARACTERISTIC DFES_GrpRpr.DFC_StrtCtOffPth_C "common MIL debouncing / group representative for common MIL debouncing of DFC_StrtCtOffPth" VALUE 0x8050529E Val_Wu16 906.000000000 DFC_Verb 0.00 906.000000000 FORMAT "%13.9" /end CHARACTERISTIC
/begin CHARACTERISTIC DFES_GrpRpr.DFC_StrtCtlErr_C "common MIL debouncing / group representative for common MIL debouncing of DFC_StrtCtlErr" VALUE 0x805052A0 Val_Wu16 906.000000000 DFC_Verb 0.00 906.000000000 FORMAT "%13.9" /end CHARACTERISTIC
/begin CHARACTERISTIC DFES_GrpRpr.DFC_StrtFault_C "common MIL debouncing / group representative for common MIL debouncing of DFC_StrtFault" VALUE 0x805052A2 Val_Wu16 906.000000000 DFC_Verb 0.00 906.000000000 FORMAT "%13.9" /end CHARACTERISTIC
/begin CHARACTERISTIC DFES_GrpRpr.DFC_StrtLckJudg1_C "common MIL debouncing / group representative for common MIL debouncing of DFC_StrtLckJudg1" VALUE 0x805052A4 Val_Wu16 906.000000000 DFC_Verb 0.00 906.000000000 FORMAT "%13.9" /end CHARACTERISTIC
/begin CHARACTERISTIC DFES_GrpRpr.DFC_StrtLckJudg2_C "common MIL debouncing / group representative for common MIL debouncing of DFC_StrtLckJudg2" VALUE 0x805052A6 Val_Wu16 906.000000000 DFC_Verb 0.00 906.000000000 FORMAT "%13.9" /end CHARACTERISTIC
/begin CHARACTERISTIC DFES_GrpRpr.DFC_StrtOL_C "common MIL debouncing / group representative for common MIL debouncing of DFC_StrtOL" VALUE 0x805052A8 Val_Wu16 906.000000000 DFC_Verb 0.00 906.000000000 FORMAT "%13.9" /end CHARACTERISTIC
/begin CHARACTERISTIC DFES_GrpRpr.DFC_StrtOL2_C "common MIL debouncing / group representative for common MIL debouncing of DFC_StrtOL2" VALUE 0x805052AA Val_Wu16 906.000000000 DFC_Verb 0.00 906.000000000 FORMAT "%13.9" /end CHARACTERISTIC
/begin CHARACTERISTIC DFES_GrpRpr.DFC_StrtSCB_C "common MIL debouncing / group representative for common MIL debouncing of DFC_StrtSCB" VALUE 0x805052AC Val_Wu16 906.000000000 DFC_Verb 0.00 906.000000000 FORMAT "%13.9" /end CHARACTERISTIC
/begin CHARACTERISTIC DFES_GrpRpr.DFC_StrtSCB2_C "common MIL debouncing / group representative for common MIL debouncing of DFC_StrtSCB2" VALUE 0x805052AE Val_Wu16 906.000000000 DFC_Verb 0.00 906.000000000 FORMAT "%13.9" /end CHARACTERISTIC
/begin CHARACTERISTIC DFES_GrpRpr.DFC_StrtSCG_C "common MIL debouncing / group representative for common MIL debouncing of DFC_StrtSCG" VALUE 0x805052B0 Val_Wu16 906.000000000 DFC_Verb 0.00 906.000000000 FORMAT "%13.9" /end CHARACTERISTIC
/begin CHARACTERISTIC DFES_GrpRpr.DFC_StrtSCG2_C "common MIL debouncing / group representative for common MIL debouncing of DFC_StrtSCG2" VALUE 0x805052B2 Val_Wu16 906.000000000 DFC_Verb 0.00 906.000000000 FORMAT "%13.9" /end CHARACTERISTIC
/begin CHARACTERISTIC DFES_GrpRpr.DFC_StrtStkRly1_C "common MIL debouncing / group representative for common MIL debouncing of DFC_StrtStkRly1" VALUE 0x805052B4 Val_Wu16 906.000000000 DFC_Verb 0.00 906.000000000 FORMAT "%13.9" /end CHARACTERISTIC
/begin CHARACTERISTIC DFES_GrpRpr.DFC_StrtStkRly2_C "common MIL debouncing / group representative for common MIL debouncing of DFC_StrtStkRly2" VALUE 0x805052B6 Val_Wu16 906.000000000 DFC_Verb 0.00 906.000000000 FORMAT "%13.9" /end CHARACTERISTIC
/begin CHARACTERISTIC DFES_GrpRpr.DFC_TEVEmax_C "common MIL debouncing / group representative for common MIL debouncing of DFC_TEVEmax" VALUE 0x805052B8 Val_Wu16 906.000000000 DFC_Verb 0.00 906.000000000 FORMAT "%13.9" /end CHARACTERISTIC
/begin CHARACTERISTIC DFES_GrpRpr.DFC_TEVEmin_C "common MIL debouncing / group representative for common MIL debouncing of DFC_TEVEmin" VALUE 0x805052BA Val_Wu16 906.000000000 DFC_Verb 0.00 906.000000000 FORMAT "%13.9" /end CHARACTERISTIC
/begin CHARACTERISTIC DFES_GrpRpr.DFC_TEVEsig_C "common MIL debouncing / group representative for common MIL debouncing of DFC_TEVEsig" VALUE 0x805052BC Val_Wu16 906.000000000 DFC_Verb 0.00 906.000000000 FORMAT "%13.9" /end CHARACTERISTIC
/begin CHARACTERISTIC DFES_GrpRpr.DFC_UegoHeatrPrfmncLoS1B1_C "common MIL debouncing / group representative for common MIL debouncing of DFC_UegoHeatrPrfmncLoS1B1" VALUE 0x805052BE Val_Wu16 906.000000000 DFC_Verb 0.00 906.000000000 FORMAT "%13.9" /end CHARACTERISTIC
/begin CHARACTERISTIC DFES_GrpRpr.DFC_VehVAllPlaus_C "common MIL debouncing / group representative for common MIL debouncing of DFC_VehVAllPlaus" VALUE 0x805052C0 Val_Wu16 906.000000000 DFC_Verb 0.00 906.000000000 FORMAT "%13.9" /end CHARACTERISTIC
/begin CHARACTERISTIC DFES_GrpRpr.DFC_VehVNCSnsrElecFailr_C "common MIL debouncing / group representative for common MIL debouncing of DFC_VehVNCSnsrElecFailr" VALUE 0x805052C2 Val_Wu16 906.000000000 DFC_Verb 0.00 906.000000000 FORMAT "%13.9" /end CHARACTERISTIC
/begin CHARACTERISTIC DFES_GrpRpr.DFC_VehVPlausCan_C "common MIL debouncing / group representative for common MIL debouncing of DFC_VehVPlausCan" VALUE 0x805052C4 Val_Wu16 906.000000000 DFC_Verb 0.00 906.000000000 FORMAT "%13.9" /end CHARACTERISTIC
/begin CHARACTERISTIC DFES_GrpRpr.DFC_VehVPlausFco_C "common MIL debouncing / group representative for common MIL debouncing of DFC_VehVPlausFco" VALUE 0x805052C6 Val_Wu16 906.000000000 DFC_Verb 0.00 906.000000000 FORMAT "%13.9" /end CHARACTERISTIC
/begin CHARACTERISTIC DFES_GrpRpr.DFC_VehVPlausPwr_C "common MIL debouncing / group representative for common MIL debouncing of DFC_VehVPlausPwr" VALUE 0x805052C8 Val_Wu16 906.000000000 DFC_Verb 0.00 906.000000000 FORMAT "%13.9" /end CHARACTERISTIC
/begin CHARACTERISTIC DFES_GrpRpr.DFC_VehVPlausV2N_C "common MIL debouncing / group representative for common MIL debouncing of DFC_VehVPlausV2N" VALUE 0x805052CA Val_Wu16 906.000000000 DFC_Verb 0.00 906.000000000 FORMAT "%13.9" /end CHARACTERISTIC
/begin CHARACTERISTIC DFES_GrpRpr.DFC_VehVSpdSnsrAElecFailr_C "common MIL debouncing / group representative for common MIL debouncing of DFC_VehVSpdSnsrAElecFailr" VALUE 0x805052CC Val_Wu16 906.000000000 DFC_Verb 0.00 906.000000000 FORMAT "%13.9" /end CHARACTERISTIC
/begin CHARACTERISTIC DFES_GrpRpr.DFC_VehVSpdSnsrBElecFailr_C "common MIL debouncing / group representative for common MIL debouncing of DFC_VehVSpdSnsrBElecFailr" VALUE 0x805052CE Val_Wu16 906.000000000 DFC_Verb 0.00 906.000000000 FORMAT "%13.9" /end CHARACTERISTIC
/begin CHARACTERISTIC DFES_GrpRpr.DFC_ClthMax_C "common MIL debouncing / group representative for common MIL debouncing of DFC_ClthMax" VALUE 0x805052D0 Val_Wu16 906.000000000 DFC_Verb 0.00 906.000000000 FORMAT "%13.9" /end CHARACTERISTIC
/begin CHARACTERISTIC DFES_GrpRpr.DFC_IgnClPs_DevComErr_C "common MIL debouncing / group representative for common MIL debouncing of DFC_IgnClPs_DevComErr" VALUE 0x805052D2 Val_Wu16 906.000000000 DFC_Verb 0.00 906.000000000 FORMAT "%13.9" /end CHARACTERISTIC
/begin CHARACTERISTIC DFES_GrpRpr.DFC_IgnClPs_LineOl_0_C "common MIL debouncing / group representative for common MIL debouncing of DFC_IgnClPs_LineOl_0" VALUE 0x805052D4 Val_Wu16 906.000000000 DFC_Verb 0.00 906.000000000 FORMAT "%13.9" /end CHARACTERISTIC
/begin CHARACTERISTIC DFES_GrpRpr.DFC_IgnClPs_LineOl_1_C "common MIL debouncing / group representative for common MIL debouncing of DFC_IgnClPs_LineOl_1" VALUE 0x805052D6 Val_Wu16 906.000000000 DFC_Verb 0.00 906.000000000 FORMAT "%13.9" /end CHARACTERISTIC
/begin CHARACTERISTIC DFES_GrpRpr.DFC_IgnClPs_LineOl_2_C "common MIL debouncing / group representative for common MIL debouncing of DFC_IgnClPs_LineOl_2" VALUE 0x805052D8 Val_Wu16 906.000000000 DFC_Verb 0.00 906.000000000 FORMAT "%13.9" /end CHARACTERISTIC
/begin CHARACTERISTIC DFES_GrpRpr.DFC_IgnClPs_LineOl_3_C "common MIL debouncing / group representative for common MIL debouncing of DFC_IgnClPs_LineOl_3" VALUE 0x805052DA Val_Wu16 906.000000000 DFC_Verb 0.00 906.000000000 FORMAT "%13.9" /end CHARACTERISTIC
/begin CHARACTERISTIC DFES_GrpRpr.DFC_IgnClPs_LineScb_0_C "common MIL debouncing / group representative for common MIL debouncing of DFC_IgnClPs_LineScb_0" VALUE 0x805052DC Val_Wu16 906.000000000 DFC_Verb 0.00 906.000000000 FORMAT "%13.9" /end CHARACTERISTIC
/begin CHARACTERISTIC DFES_GrpRpr.DFC_IgnClPs_LineScb_1_C "common MIL debouncing / group representative for common MIL debouncing of DFC_IgnClPs_LineScb_1" VALUE 0x805052DE Val_Wu16 906.000000000 DFC_Verb 0.00 906.000000000 FORMAT "%13.9" /end CHARACTERISTIC
/begin CHARACTERISTIC DFES_GrpRpr.DFC_IgnClPs_LineScb_2_C "common MIL debouncing / group representative for common MIL debouncing of DFC_IgnClPs_LineScb_2" VALUE 0x805052E0 Val_Wu16 906.000000000 DFC_Verb 0.00 906.000000000 FORMAT "%13.9" /end CHARACTERISTIC
/begin CHARACTERISTIC DFES_GrpRpr.DFC_IgnClPs_LineScb_3_C "common MIL debouncing / group representative for common MIL debouncing of DFC_IgnClPs_LineScb_3" VALUE 0x805052E2 Val_Wu16 906.000000000 DFC_Verb 0.00 906.000000000 FORMAT "%13.9" /end CHARACTERISTIC
/begin CHARACTERISTIC DFES_GrpRpr.DFC_IgnClPs_LineScg_0_C "common MIL debouncing / group representative for common MIL debouncing of DFC_IgnClPs_LineScg_0" VALUE 0x805052E4 Val_Wu16 906.000000000 DFC_Verb 0.00 906.000000000 FORMAT "%13.9" /end CHARACTERISTIC
/begin CHARACTERISTIC DFES_GrpRpr.DFC_IgnClPs_LineScg_1_C "common MIL debouncing / group representative for common MIL debouncing of DFC_IgnClPs_LineScg_1" VALUE 0x805052E6 Val_Wu16 906.000000000 DFC_Verb 0.00 906.000000000 FORMAT "%13.9" /end CHARACTERISTIC
/begin CHARACTERISTIC DFES_GrpRpr.DFC_IgnClPs_LineScg_2_C "common MIL debouncing / group representative for common MIL debouncing of DFC_IgnClPs_LineScg_2" VALUE 0x805052E8 Val_Wu16 906.000000000 DFC_Verb 0.00 906.000000000 FORMAT "%13.9" /end CHARACTERISTIC
/begin CHARACTERISTIC DFES_GrpRpr.DFC_IgnClPs_LineScg_3_C "common MIL debouncing / group representative for common MIL debouncing of DFC_IgnClPs_LineScg_3" VALUE 0x805052EA Val_Wu16 906.000000000 DFC_Verb 0.00 906.000000000 FORMAT "%13.9" /end CHARACTERISTIC
/begin CHARACTERISTIC DFES_GrpRpr.DFC_KRVEKOEVAB_C "common MIL debouncing / group representative for common MIL debouncing of DFC_KRVEKOEVAB" VALUE 0x805052EC Val_Wu16 906.000000000 DFC_Verb 0.00 906.000000000 FORMAT "%13.9" /end CHARACTERISTIC
/begin CHARACTERISTIC DFES_GrpRpr.DFC_KRVEKOEVAB0_C "common MIL debouncing / group representative for common MIL debouncing of DFC_KRVEKOEVAB0" VALUE 0x805052EE Val_Wu16 906.000000000 DFC_Verb 0.00 906.000000000 FORMAT "%13.9" /end CHARACTERISTIC
/begin CHARACTERISTIC DFES_GrpRpr.DFC_KRVEKOEVAB1_C "common MIL debouncing / group representative for common MIL debouncing of DFC_KRVEKOEVAB1" VALUE 0x805052F0 Val_Wu16 906.000000000 DFC_Verb 0.00 906.000000000 FORMAT "%13.9" /end CHARACTERISTIC
/begin CHARACTERISTIC DFES_GrpRpr.DFC_KRVEKOEVAB2_C "common MIL debouncing / group representative for common MIL debouncing of DFC_KRVEKOEVAB2" VALUE 0x805052F2 Val_Wu16 906.000000000 DFC_Verb 0.00 906.000000000 FORMAT "%13.9" /end CHARACTERISTIC
/begin CHARACTERISTIC DFES_GrpRpr.DFC_KRVEKOEVAB3_C "common MIL debouncing / group representative for common MIL debouncing of DFC_KRVEKOEVAB3" VALUE 0x805052F4 Val_Wu16 906.000000000 DFC_Verb 0.00 906.000000000 FORMAT "%13.9" /end CHARACTERISTIC
/begin CHARACTERISTIC DFES_GrpRpr.DFC_UegoSigEcuAsicS1B1_C "common MIL debouncing / group representative for common MIL debouncing of DFC_UegoSigEcuAsicS1B1" VALUE 0x805052F6 Val_Wu16 906.000000000 DFC_Verb 0.00 906.000000000 FORMAT "%13.9" /end CHARACTERISTIC
/begin CHARACTERISTIC DFES_GrpRpr.DFC_UegoSigEcuComS1B1_C "common MIL debouncing / group representative for common MIL debouncing of DFC_UegoSigEcuComS1B1" VALUE 0x805052F8 Val_Wu16 906.000000000 DFC_Verb 0.00 906.000000000 FORMAT "%13.9" /end CHARACTERISTIC
/begin CHARACTERISTIC DFES_GrpRpr.DFC_UegoSigSnsrS1B1_C "common MIL debouncing / group representative for common MIL debouncing of DFC_UegoSigSnsrS1B1" VALUE 0x805052FA Val_Wu16 906.000000000 DFC_Verb 0.00 906.000000000 FORMAT "%13.9" /end CHARACTERISTIC
/begin CHARACTERISTIC DFES_GrpRpr.DFC_UegoSigWireOlApesS1B1_C "common MIL debouncing / group representative for common MIL debouncing of DFC_UegoSigWireOlApesS1B1" VALUE 0x805052FC Val_Wu16 906.000000000 DFC_Verb 0.00 906.000000000 FORMAT "%13.9" /end CHARACTERISTIC
/begin CHARACTERISTIC DFES_GrpRpr.DFC_UegoSigWireOlIpeS1B1_C "common MIL debouncing / group representative for common MIL debouncing of DFC_UegoSigWireOlIpeS1B1" VALUE 0x805052FE Val_Wu16 906.000000000 DFC_Verb 0.00 906.000000000 FORMAT "%13.9" /end CHARACTERISTIC
/begin CHARACTERISTIC DFES_GrpRpr.DFC_UegoSigWireOlReS1B1_C "common MIL debouncing / group representative for common MIL debouncing of DFC_UegoSigWireOlReS1B1" VALUE 0x80505300 Val_Wu16 906.000000000 DFC_Verb 0.00 906.000000000 FORMAT "%13.9" /end CHARACTERISTIC
/begin CHARACTERISTIC DFES_GrpRpr.DFC_UegoSigWireRCmpS1B1_C "common MIL debouncing / group representative for common MIL debouncing of DFC_UegoSigWireRCmpS1B1" VALUE 0x80505302 Val_Wu16 906.000000000 DFC_Verb 0.00 906.000000000 FORMAT "%13.9" /end CHARACTERISTIC
/begin CHARACTERISTIC DFES_GrpRpr.DFC_UegoSigWireScbS1B1_C "common MIL debouncing / group representative for common MIL debouncing of DFC_UegoSigWireScbS1B1" VALUE 0x80505304 Val_Wu16 906.000000000 DFC_Verb 0.00 906.000000000 FORMAT "%13.9" /end CHARACTERISTIC
/begin CHARACTERISTIC DFES_GrpRpr.DFC_UegoSigWireScgS1B1_C "common MIL debouncing / group representative for common MIL debouncing of DFC_UegoSigWireScgS1B1" VALUE 0x80505306 Val_Wu16 906.000000000 DFC_Verb 0.00 906.000000000 FORMAT "%13.9" /end CHARACTERISTIC
/begin CHARACTERISTIC DFES_GrpRpr.DFC_AfsPhyRngHiB1_C "common MIL debouncing / group representative for common MIL debouncing of DFC_AfsPhyRngHiB1" VALUE 0x80505308 Val_Wu16 906.000000000 DFC_Verb 0.00 906.000000000 FORMAT "%13.9" /end CHARACTERISTIC
/begin CHARACTERISTIC DFES_GrpRpr.DFC_AfsPhyRngLoB1_C "common MIL debouncing / group representative for common MIL debouncing of DFC_AfsPhyRngLoB1" VALUE 0x8050530A Val_Wu16 906.000000000 DFC_Verb 0.00 906.000000000 FORMAT "%13.9" /end CHARACTERISTIC
/begin CHARACTERISTIC DFES_GrpRpr.DFC_AirCCmprOL_C "common MIL debouncing / group representative for common MIL debouncing of DFC_AirCCmprOL" VALUE 0x8050530C Val_Wu16 906.000000000 DFC_Verb 0.00 906.000000000 FORMAT "%13.9" /end CHARACTERISTIC
/begin CHARACTERISTIC DFES_GrpRpr.DFC_AirCCmprOvrTemp_C "common MIL debouncing / group representative for common MIL debouncing of DFC_AirCCmprOvrTemp" VALUE 0x8050530E Val_Wu16 906.000000000 DFC_Verb 0.00 906.000000000 FORMAT "%13.9" /end CHARACTERISTIC
/begin CHARACTERISTIC DFES_GrpRpr.DFC_AirCCmprSCB_C "common MIL debouncing / group representative for common MIL debouncing of DFC_AirCCmprSCB" VALUE 0x80505310 Val_Wu16 906.000000000 DFC_Verb 0.00 906.000000000 FORMAT "%13.9" /end CHARACTERISTIC
/begin CHARACTERISTIC DFES_GrpRpr.DFC_AirCCmprSCG_C "common MIL debouncing / group representative for common MIL debouncing of DFC_AirCCmprSCG" VALUE 0x80505312 Val_Wu16 906.000000000 DFC_Verb 0.00 906.000000000 FORMAT "%13.9" /end CHARACTERISTIC
/begin CHARACTERISTIC DFES_GrpRpr.DFC_AltErr_C "common MIL debouncing / group representative for common MIL debouncing of DFC_AltErr" VALUE 0x80505314 Val_Wu16 906.000000000 DFC_Verb 0.00 906.000000000 FORMAT "%13.9" /end CHARACTERISTIC
/begin CHARACTERISTIC DFES_GrpRpr.DFC_BattUSRCMax_C "common MIL debouncing / group representative for common MIL debouncing of DFC_BattUSRCMax" VALUE 0x80505316 Val_Wu16 906.000000000 DFC_Verb 0.00 906.000000000 FORMAT "%13.9" /end CHARACTERISTIC
/begin CHARACTERISTIC DFES_GrpRpr.DFC_BattUSRCMin_C "common MIL debouncing / group representative for common MIL debouncing of DFC_BattUSRCMin" VALUE 0x80505318 Val_Wu16 906.000000000 DFC_Verb 0.00 906.000000000 FORMAT "%13.9" /end CHARACTERISTIC
/begin CHARACTERISTIC DFES_GrpRpr.DFC_ComChksTCU1_C "common MIL debouncing / group representative for common MIL debouncing of DFC_ComChksTCU1" VALUE 0x8050531A Val_Wu16 906.000000000 DFC_Verb 0.00 906.000000000 FORMAT "%13.9" /end CHARACTERISTIC
/begin CHARACTERISTIC DFES_GrpRpr.DFC_ComChksTCU11_C "common MIL debouncing / group representative for common MIL debouncing of DFC_ComChksTCU11" VALUE 0x8050531C Val_Wu16 906.000000000 DFC_Verb 0.00 906.000000000 FORMAT "%13.9" /end CHARACTERISTIC
/begin CHARACTERISTIC DFES_GrpRpr.DFC_ComChksTCU12_C "common MIL debouncing / group representative for common MIL debouncing of DFC_ComChksTCU12" VALUE 0x8050531E Val_Wu16 906.000000000 DFC_Verb 0.00 906.000000000 FORMAT "%13.9" /end CHARACTERISTIC
/begin CHARACTERISTIC DFES_GrpRpr.DFC_ComChksTCU13_C "common MIL debouncing / group representative for common MIL debouncing of DFC_ComChksTCU13" VALUE 0x80505320 Val_Wu16 906.000000000 DFC_Verb 0.00 906.000000000 FORMAT "%13.9" /end CHARACTERISTIC
/begin CHARACTERISTIC DFES_GrpRpr.DFC_ComChksTCU2_C "common MIL debouncing / group representative for common MIL debouncing of DFC_ComChksTCU2" VALUE 0x80505322 Val_Wu16 906.000000000 DFC_Verb 0.00 906.000000000 FORMAT "%13.9" /end CHARACTERISTIC
/begin CHARACTERISTIC DFES_GrpRpr.DFC_ComChksTCU3_C "common MIL debouncing / group representative for common MIL debouncing of DFC_ComChksTCU3" VALUE 0x80505324 Val_Wu16 906.000000000 DFC_Verb 0.00 906.000000000 FORMAT "%13.9" /end CHARACTERISTIC
/begin CHARACTERISTIC DFES_GrpRpr.DFC_ComChksTCU4_C "common MIL debouncing / group representative for common MIL debouncing of DFC_ComChksTCU4" VALUE 0x80505326 Val_Wu16 906.000000000 DFC_Verb 0.00 906.000000000 FORMAT "%13.9" /end CHARACTERISTIC
/begin CHARACTERISTIC DFES_GrpRpr.DFC_ComCntTCU1_C "common MIL debouncing / group representative for common MIL debouncing of DFC_ComCntTCU1" VALUE 0x80505328 Val_Wu16 906.000000000 DFC_Verb 0.00 906.000000000 FORMAT "%13.9" /end CHARACTERISTIC
/begin CHARACTERISTIC DFES_GrpRpr.DFC_ComCntTCU11_C "common MIL debouncing / group representative for common MIL debouncing of DFC_ComCntTCU11" VALUE 0x8050532A Val_Wu16 906.000000000 DFC_Verb 0.00 906.000000000 FORMAT "%13.9" /end CHARACTERISTIC
/begin CHARACTERISTIC DFES_GrpRpr.DFC_ComCntTCU12_C "common MIL debouncing / group representative for common MIL debouncing of DFC_ComCntTCU12" VALUE 0x8050532C Val_Wu16 906.000000000 DFC_Verb 0.00 906.000000000 FORMAT "%13.9" /end CHARACTERISTIC
/begin CHARACTERISTIC DFES_GrpRpr.DFC_ComCntTCU13_C "common MIL debouncing / group representative for common MIL debouncing of DFC_ComCntTCU13" VALUE 0x8050532E Val_Wu16 906.000000000 DFC_Verb 0.00 906.000000000 FORMAT "%13.9" /end CHARACTERISTIC
/begin CHARACTERISTIC DFES_GrpRpr.DFC_ComCntTCU2_C "common MIL debouncing / group representative for common MIL debouncing of DFC_ComCntTCU2" VALUE 0x80505330 Val_Wu16 906.000000000 DFC_Verb 0.00 906.000000000 FORMAT "%13.9" /end CHARACTERISTIC
/begin CHARACTERISTIC DFES_GrpRpr.DFC_ComCntTCU3_C "common MIL debouncing / group representative for common MIL debouncing of DFC_ComCntTCU3" VALUE 0x80505332 Val_Wu16 906.000000000 DFC_Verb 0.00 906.000000000 FORMAT "%13.9" /end CHARACTERISTIC
/begin CHARACTERISTIC DFES_GrpRpr.DFC_ComCntTCU4_C "common MIL debouncing / group representative for common MIL debouncing of DFC_ComCntTCU4" VALUE 0x80505334 Val_Wu16 906.000000000 DFC_Verb 0.00 906.000000000 FORMAT "%13.9" /end CHARACTERISTIC
/begin CHARACTERISTIC DFES_GrpRpr.DFC_ComTOutTCU01_C "common MIL debouncing / group representative for common MIL debouncing of DFC_ComTOutTCU01" VALUE 0x80505336 Val_Wu16 906.000000000 DFC_Verb 0.00 906.000000000 FORMAT "%13.9" /end CHARACTERISTIC
/begin CHARACTERISTIC DFES_GrpRpr.DFC_ComTOutTCU02_C "common MIL debouncing / group representative for common MIL debouncing of DFC_ComTOutTCU02" VALUE 0x80505338 Val_Wu16 906.000000000 DFC_Verb 0.00 906.000000000 FORMAT "%13.9" /end CHARACTERISTIC
/begin CHARACTERISTIC DFES_GrpRpr.DFC_ComTOutTCU1_C "common MIL debouncing / group representative for common MIL debouncing of DFC_ComTOutTCU1" VALUE 0x8050533A Val_Wu16 906.000000000 DFC_Verb 0.00 906.000000000 FORMAT "%13.9" /end CHARACTERISTIC
/begin CHARACTERISTIC DFES_GrpRpr.DFC_ComTOutTCU11_C "common MIL debouncing / group representative for common MIL debouncing of DFC_ComTOutTCU11" VALUE 0x8050533C Val_Wu16 906.000000000 DFC_Verb 0.00 906.000000000 FORMAT "%13.9" /end CHARACTERISTIC
/begin CHARACTERISTIC DFES_GrpRpr.DFC_ComTOutTCU12_C "common MIL debouncing / group representative for common MIL debouncing of DFC_ComTOutTCU12" VALUE 0x8050533E Val_Wu16 906.000000000 DFC_Verb 0.00 906.000000000 FORMAT "%13.9" /end CHARACTERISTIC
/begin CHARACTERISTIC DFES_GrpRpr.DFC_ComTOutTCU13_C "common MIL debouncing / group representative for common MIL debouncing of DFC_ComTOutTCU13" VALUE 0x80505340 Val_Wu16 906.000000000 DFC_Verb 0.00 906.000000000 FORMAT "%13.9" /end CHARACTERISTIC
/begin CHARACTERISTIC DFES_GrpRpr.DFC_ComTOutTCU14_C "common MIL debouncing / group representative for common MIL debouncing of DFC_ComTOutTCU14" VALUE 0x80505342 Val_Wu16 906.000000000 DFC_Verb 0.00 906.000000000 FORMAT "%13.9" /end CHARACTERISTIC
/begin CHARACTERISTIC DFES_GrpRpr.DFC_ComTOutTCU2_C "common MIL debouncing / group representative for common MIL debouncing of DFC_ComTOutTCU2" VALUE 0x80505344 Val_Wu16 906.000000000 DFC_Verb 0.00 906.000000000 FORMAT "%13.9" /end CHARACTERISTIC
/begin CHARACTERISTIC DFES_GrpRpr.DFC_ComTOutTCU3_C "common MIL debouncing / group representative for common MIL debouncing of DFC_ComTOutTCU3" VALUE 0x80505346 Val_Wu16 906.000000000 DFC_Verb 0.00 906.000000000 FORMAT "%13.9" /end CHARACTERISTIC
/begin CHARACTERISTIC DFES_GrpRpr.DFC_ComTOutTCU4_C "common MIL debouncing / group representative for common MIL debouncing of DFC_ComTOutTCU4" VALUE 0x80505348 Val_Wu16 906.000000000 DFC_Verb 0.00 906.000000000 FORMAT "%13.9" /end CHARACTERISTIC
/begin CHARACTERISTIC DFES_GrpRpr.DFC_DevLibBattUHi_C "common MIL debouncing / group representative for common MIL debouncing of DFC_DevLibBattUHi" VALUE 0x8050534A Val_Wu16 906.000000000 DFC_Verb 0.00 906.000000000 FORMAT "%13.9" /end CHARACTERISTIC
/begin CHARACTERISTIC DFES_GrpRpr.DFC_DevLibBattULo_C "common MIL debouncing / group representative for common MIL debouncing of DFC_DevLibBattULo" VALUE 0x8050534C Val_Wu16 906.000000000 DFC_Verb 0.00 906.000000000 FORMAT "%13.9" /end CHARACTERISTIC
/begin CHARACTERISTIC DFES_GrpRpr.DFC_EGRVlvFailSafeActv_C "common MIL debouncing / group representative for common MIL debouncing of DFC_EGRVlvFailSafeActv" VALUE 0x8050534E Val_Wu16 906.000000000 DFC_Verb 0.00 906.000000000 FORMAT "%13.9" /end CHARACTERISTIC
/begin CHARACTERISTIC DFES_GrpRpr.DFC_EGRVlvGovDvtCld_C "common MIL debouncing / group representative for common MIL debouncing of DFC_EGRVlvGovDvtCld" VALUE 0x80505350 Val_Wu16 906.000000000 DFC_Verb 0.00 906.000000000 FORMAT "%13.9" /end CHARACTERISTIC
/begin CHARACTERISTIC DFES_GrpRpr.DFC_EGRVlvPhysSRCMax_C "common MIL debouncing / group representative for common MIL debouncing of DFC_EGRVlvPhysSRCMax" VALUE 0x80505352 Val_Wu16 906.000000000 DFC_Verb 0.00 906.000000000 FORMAT "%13.9" /end CHARACTERISTIC
/begin CHARACTERISTIC DFES_GrpRpr.DFC_EGRVlvPhysSRCMin_C "common MIL debouncing / group representative for common MIL debouncing of DFC_EGRVlvPhysSRCMin" VALUE 0x80505354 Val_Wu16 906.000000000 DFC_Verb 0.00 906.000000000 FORMAT "%13.9" /end CHARACTERISTIC
/begin CHARACTERISTIC DFES_GrpRpr.DFC_FanDIOOL_0_C "common MIL debouncing / group representative for common MIL debouncing of DFC_FanDIOOL_0" VALUE 0x80505356 Val_Wu16 906.000000000 DFC_Verb 0.00 906.000000000 FORMAT "%13.9" /end CHARACTERISTIC
/begin CHARACTERISTIC DFES_GrpRpr.DFC_FanDIOOL_1_C "common MIL debouncing / group representative for common MIL debouncing of DFC_FanDIOOL_1" VALUE 0x80505358 Val_Wu16 906.000000000 DFC_Verb 0.00 906.000000000 FORMAT "%13.9" /end CHARACTERISTIC
/begin CHARACTERISTIC DFES_GrpRpr.DFC_FanDIOOvrTemp_0_C "common MIL debouncing / group representative for common MIL debouncing of DFC_FanDIOOvrTemp_0" VALUE 0x8050535A Val_Wu16 906.000000000 DFC_Verb 0.00 906.000000000 FORMAT "%13.9" /end CHARACTERISTIC
/begin CHARACTERISTIC DFES_GrpRpr.DFC_FanDIOOvrTemp_1_C "common MIL debouncing / group representative for common MIL debouncing of DFC_FanDIOOvrTemp_1" VALUE 0x8050535C Val_Wu16 906.000000000 DFC_Verb 0.00 906.000000000 FORMAT "%13.9" /end CHARACTERISTIC
/begin CHARACTERISTIC DFES_GrpRpr.DFC_FanDIOSCB_0_C "common MIL debouncing / group representative for common MIL debouncing of DFC_FanDIOSCB_0" VALUE 0x8050535E Val_Wu16 906.000000000 DFC_Verb 0.00 906.000000000 FORMAT "%13.9" /end CHARACTERISTIC
/begin CHARACTERISTIC DFES_GrpRpr.DFC_FanDIOSCB_1_C "common MIL debouncing / group representative for common MIL debouncing of DFC_FanDIOSCB_1" VALUE 0x80505360 Val_Wu16 906.000000000 DFC_Verb 0.00 906.000000000 FORMAT "%13.9" /end CHARACTERISTIC
/begin CHARACTERISTIC DFES_GrpRpr.DFC_FanDIOSCG_0_C "common MIL debouncing / group representative for common MIL debouncing of DFC_FanDIOSCG_0" VALUE 0x80505362 Val_Wu16 906.000000000 DFC_Verb 0.00 906.000000000 FORMAT "%13.9" /end CHARACTERISTIC
/begin CHARACTERISTIC DFES_GrpRpr.DFC_FanDIOSCG_1_C "common MIL debouncing / group representative for common MIL debouncing of DFC_FanDIOSCG_1" VALUE 0x80505364 Val_Wu16 906.000000000 DFC_Verb 0.00 906.000000000 FORMAT "%13.9" /end CHARACTERISTIC
/begin CHARACTERISTIC DFES_GrpRpr.DFC_MRlyDcOL_C "common MIL debouncing / group representative for common MIL debouncing of DFC_MRlyDcOL" VALUE 0x80505366 Val_Wu16 906.000000000 DFC_Verb 0.00 906.000000000 FORMAT "%13.9" /end CHARACTERISTIC
/begin CHARACTERISTIC DFES_GrpRpr.DFC_MRlyDcSCB_C "common MIL debouncing / group representative for common MIL debouncing of DFC_MRlyDcSCB" VALUE 0x80505368 Val_Wu16 906.000000000 DFC_Verb 0.00 906.000000000 FORMAT "%13.9" /end CHARACTERISTIC
/begin CHARACTERISTIC DFES_GrpRpr.DFC_MRlyDcSCG_C "common MIL debouncing / group representative for common MIL debouncing of DFC_MRlyDcSCG" VALUE 0x8050536A Val_Wu16 906.000000000 DFC_Verb 0.00 906.000000000 FORMAT "%13.9" /end CHARACTERISTIC
/begin CHARACTERISTIC DFES_GrpRpr.DFC_PSPOL_C "common MIL debouncing / group representative for common MIL debouncing of DFC_PSPOL" VALUE 0x8050536C Val_Wu16 906.000000000 DFC_Verb 0.00 906.000000000 FORMAT "%13.9" /end CHARACTERISTIC
/begin CHARACTERISTIC DFES_GrpRpr.DFC_PSPOvrTemp_C "common MIL debouncing / group representative for common MIL debouncing of DFC_PSPOvrTemp" VALUE 0x8050536E Val_Wu16 906.000000000 DFC_Verb 0.00 906.000000000 FORMAT "%13.9" /end CHARACTERISTIC
/begin CHARACTERISTIC DFES_GrpRpr.DFC_PSPSCB_C "common MIL debouncing / group representative for common MIL debouncing of DFC_PSPSCB" VALUE 0x80505370 Val_Wu16 906.000000000 DFC_Verb 0.00 906.000000000 FORMAT "%13.9" /end CHARACTERISTIC
/begin CHARACTERISTIC DFES_GrpRpr.DFC_PSPSCG_C "common MIL debouncing / group representative for common MIL debouncing of DFC_PSPSCG" VALUE 0x80505372 Val_Wu16 906.000000000 DFC_Verb 0.00 906.000000000 FORMAT "%13.9" /end CHARACTERISTIC
/begin CHARACTERISTIC DFES_GrpRpr.DFC_T50Err_C "common MIL debouncing / group representative for common MIL debouncing of DFC_T50Err" VALUE 0x80505374 Val_Wu16 906.000000000 DFC_Verb 0.00 906.000000000 FORMAT "%13.9" /end CHARACTERISTIC
/begin CHARACTERISTIC DFES_GrpRpr.DFC_ThrVlvLoBattB1_C "common MIL debouncing / group representative for common MIL debouncing of DFC_ThrVlvLoBattB1" VALUE 0x80505376 Val_Wu16 906.000000000 DFC_Verb 0.00 906.000000000 FORMAT "%13.9" /end CHARACTERISTIC
/begin CHARACTERISTIC DFES_GrpRpr.DFC_UegoSigOperPlausS1B1_C "common MIL debouncing / group representative for common MIL debouncing of DFC_UegoSigOperPlausS1B1" VALUE 0x80505378 Val_Wu16 906.000000000 DFC_Verb 0.00 906.000000000 FORMAT "%13.9" /end CHARACTERISTIC
/begin CHARACTERISTIC DFES_GrpRpr.DFC_VehVPhysRngHi_C "common MIL debouncing / group representative for common MIL debouncing of DFC_VehVPhysRngHi" VALUE 0x8050537A Val_Wu16 906.000000000 DFC_Verb 0.00 906.000000000 FORMAT "%13.9" /end CHARACTERISTIC
/begin CHARACTERISTIC DFES_GrpRpr.DFC_VehVSclOutOL_C "common MIL debouncing / group representative for common MIL debouncing of DFC_VehVSclOutOL" VALUE 0x8050537C Val_Wu16 906.000000000 DFC_Verb 0.00 906.000000000 FORMAT "%13.9" /end CHARACTERISTIC
/begin CHARACTERISTIC DFES_GrpRpr.DFC_VehVSclOutOT_C "common MIL debouncing / group representative for common MIL debouncing of DFC_VehVSclOutOT" VALUE 0x8050537E Val_Wu16 906.000000000 DFC_Verb 0.00 906.000000000 FORMAT "%13.9" /end CHARACTERISTIC
/begin CHARACTERISTIC DFES_GrpRpr.DFC_VehVSclOutSCB_C "common MIL debouncing / group representative for common MIL debouncing of DFC_VehVSclOutSCB" VALUE 0x80505380 Val_Wu16 906.000000000 DFC_Verb 0.00 906.000000000 FORMAT "%13.9" /end CHARACTERISTIC
/begin CHARACTERISTIC DFES_GrpRpr.DFC_VehVSclOutSCG_C "common MIL debouncing / group representative for common MIL debouncing of DFC_VehVSclOutSCG" VALUE 0x80505382 Val_Wu16 906.000000000 DFC_Verb 0.00 906.000000000 FORMAT "%13.9" /end CHARACTERISTIC
/begin CHARACTERISTIC DFES_GrpRpr.DFC_VehVSigFL_C "common MIL debouncing / group representative for common MIL debouncing of DFC_VehVSigFL" VALUE 0x80505384 Val_Wu16 906.000000000 DFC_Verb 0.00 906.000000000 FORMAT "%13.9" /end CHARACTERISTIC
/begin CHARACTERISTIC DFES_GrpRpr.DFC_VehVSigFR_C "common MIL debouncing / group representative for common MIL debouncing of DFC_VehVSigFR" VALUE 0x80505386 Val_Wu16 906.000000000 DFC_Verb 0.00 906.000000000 FORMAT "%13.9" /end CHARACTERISTIC
/begin CHARACTERISTIC DFES_GrpRpr.DFC_VehVSigRL_C "common MIL debouncing / group representative for common MIL debouncing of DFC_VehVSigRL" VALUE 0x80505388 Val_Wu16 906.000000000 DFC_Verb 0.00 906.000000000 FORMAT "%13.9" /end CHARACTERISTIC
/begin CHARACTERISTIC DFES_GrpRpr.DFC_VehVSigRR_C "common MIL debouncing / group representative for common MIL debouncing of DFC_VehVSigRR" VALUE 0x8050538A Val_Wu16 906.000000000 DFC_Verb 0.00 906.000000000 FORMAT "%13.9" /end CHARACTERISTIC
/begin CHARACTERISTIC DFES_GrpRpr.DFC_VehVSnsrARngHi_C "common MIL debouncing / group representative for common MIL debouncing of DFC_VehVSnsrARngHi" VALUE 0x8050538C Val_Wu16 906.000000000 DFC_Verb 0.00 906.000000000 FORMAT "%13.9" /end CHARACTERISTIC
/begin CHARACTERISTIC DFES_GrpRpr.DFC_VehVSnsrBRngHi_C "common MIL debouncing / group representative for common MIL debouncing of DFC_VehVSnsrBRngHi" VALUE 0x8050538E Val_Wu16 906.000000000 DFC_Verb 0.00 906.000000000 FORMAT "%13.9" /end CHARACTERISTIC
/begin CHARACTERISTIC DFES_GrpRpr.DFC_VehVSpdRtyDiag_C "common MIL debouncing / group representative for common MIL debouncing of DFC_VehVSpdRtyDiag" VALUE 0x80505390 Val_Wu16 906.000000000 DFC_Verb 0.00 906.000000000 FORMAT "%13.9" /end CHARACTERISTIC
/begin CHARACTERISTIC DFES_GrpRpr.DFC_DHFHD_C "common MIL debouncing / group representative for common MIL debouncing of DFC_DHFHD" VALUE 0x80505392 Val_Wu16 906.000000000 DFC_Verb 0.00 906.000000000 FORMAT "%13.9" /end CHARACTERISTIC
/begin CHARACTERISTIC DFES_GrpRpr.DFC_InjVlv_DI_DcDc_C "common MIL debouncing / group representative for common MIL debouncing of DFC_InjVlv_DI_DcDc" VALUE 0x80505394 Val_Wu16 906.000000000 DFC_Verb 0.00 906.000000000 FORMAT "%13.9" /end CHARACTERISTIC
/begin CHARACTERISTIC DFES_GrpRpr.DFC_InjVlv_DI_NoLd_0_C "common MIL debouncing / group representative for common MIL debouncing of DFC_InjVlv_DI_NoLd_0" VALUE 0x80505396 Val_Wu16 906.000000000 DFC_Verb 0.00 906.000000000 FORMAT "%13.9" /end CHARACTERISTIC
/begin CHARACTERISTIC DFES_GrpRpr.DFC_InjVlv_DI_NoLd_1_C "common MIL debouncing / group representative for common MIL debouncing of DFC_InjVlv_DI_NoLd_1" VALUE 0x80505398 Val_Wu16 906.000000000 DFC_Verb 0.00 906.000000000 FORMAT "%13.9" /end CHARACTERISTIC
/begin CHARACTERISTIC DFES_GrpRpr.DFC_InjVlv_DI_NoLd_2_C "common MIL debouncing / group representative for common MIL debouncing of DFC_InjVlv_DI_NoLd_2" VALUE 0x8050539A Val_Wu16 906.000000000 DFC_Verb 0.00 906.000000000 FORMAT "%13.9" /end CHARACTERISTIC
/begin CHARACTERISTIC DFES_GrpRpr.DFC_InjVlv_DI_NoLd_3_C "common MIL debouncing / group representative for common MIL debouncing of DFC_InjVlv_DI_NoLd_3" VALUE 0x8050539C Val_Wu16 906.000000000 DFC_Verb 0.00 906.000000000 FORMAT "%13.9" /end CHARACTERISTIC
/begin CHARACTERISTIC DFES_GrpRpr.DFC_InjVlv_DI_ScBnk_0_C "common MIL debouncing / group representative for common MIL debouncing of DFC_InjVlv_DI_ScBnk_0" VALUE 0x8050539E Val_Wu16 906.000000000 DFC_Verb 0.00 906.000000000 FORMAT "%13.9" /end CHARACTERISTIC
/begin CHARACTERISTIC DFES_GrpRpr.DFC_InjVlv_DI_ScBnk_1_C "common MIL debouncing / group representative for common MIL debouncing of DFC_InjVlv_DI_ScBnk_1" VALUE 0x805053A0 Val_Wu16 906.000000000 DFC_Verb 0.00 906.000000000 FORMAT "%13.9" /end CHARACTERISTIC
/begin CHARACTERISTIC DFES_GrpRpr.DFC_InjVlv_DI_ScBnk_2_C "common MIL debouncing / group representative for common MIL debouncing of DFC_InjVlv_DI_ScBnk_2" VALUE 0x805053A2 Val_Wu16 906.000000000 DFC_Verb 0.00 906.000000000 FORMAT "%13.9" /end CHARACTERISTIC
/begin CHARACTERISTIC DFES_GrpRpr.DFC_InjVlv_DI_ScBnk_3_C "common MIL debouncing / group representative for common MIL debouncing of DFC_InjVlv_DI_ScBnk_3" VALUE 0x805053A4 Val_Wu16 906.000000000 DFC_Verb 0.00 906.000000000 FORMAT "%13.9" /end CHARACTERISTIC
/begin CHARACTERISTIC DFES_GrpRpr.DFC_InjVlv_DI_ScCyl_0_C "common MIL debouncing / group representative for common MIL debouncing of DFC_InjVlv_DI_ScCyl_0" VALUE 0x805053A6 Val_Wu16 906.000000000 DFC_Verb 0.00 906.000000000 FORMAT "%13.9" /end CHARACTERISTIC
/begin CHARACTERISTIC DFES_GrpRpr.DFC_InjVlv_DI_ScCyl_1_C "common MIL debouncing / group representative for common MIL debouncing of DFC_InjVlv_DI_ScCyl_1" VALUE 0x805053A8 Val_Wu16 906.000000000 DFC_Verb 0.00 906.000000000 FORMAT "%13.9" /end CHARACTERISTIC
/begin CHARACTERISTIC DFES_GrpRpr.DFC_InjVlv_DI_ScCyl_2_C "common MIL debouncing / group representative for common MIL debouncing of DFC_InjVlv_DI_ScCyl_2" VALUE 0x805053AA Val_Wu16 906.000000000 DFC_Verb 0.00 906.000000000 FORMAT "%13.9" /end CHARACTERISTIC
/begin CHARACTERISTIC DFES_GrpRpr.DFC_InjVlv_DI_ScCyl_3_C "common MIL debouncing / group representative for common MIL debouncing of DFC_InjVlv_DI_ScCyl_3" VALUE 0x805053AC Val_Wu16 906.000000000 DFC_Verb 0.00 906.000000000 FORMAT "%13.9" /end CHARACTERISTIC
/begin CHARACTERISTIC DFES_GrpRpr.DFC_InjVlv_DI_ScHsLs_0_C "common MIL debouncing / group representative for common MIL debouncing of DFC_InjVlv_DI_ScHsLs_0" VALUE 0x805053AE Val_Wu16 906.000000000 DFC_Verb 0.00 906.000000000 FORMAT "%13.9" /end CHARACTERISTIC
/begin CHARACTERISTIC DFES_GrpRpr.DFC_InjVlv_DI_ScHsLs_1_C "common MIL debouncing / group representative for common MIL debouncing of DFC_InjVlv_DI_ScHsLs_1" VALUE 0x805053B0 Val_Wu16 906.000000000 DFC_Verb 0.00 906.000000000 FORMAT "%13.9" /end CHARACTERISTIC
/begin CHARACTERISTIC DFES_GrpRpr.DFC_InjVlv_DI_ScHsLs_2_C "common MIL debouncing / group representative for common MIL debouncing of DFC_InjVlv_DI_ScHsLs_2" VALUE 0x805053B2 Val_Wu16 906.000000000 DFC_Verb 0.00 906.000000000 FORMAT "%13.9" /end CHARACTERISTIC
/begin CHARACTERISTIC DFES_GrpRpr.DFC_InjVlv_DI_ScHsLs_3_C "common MIL debouncing / group representative for common MIL debouncing of DFC_InjVlv_DI_ScHsLs_3" VALUE 0x805053B4 Val_Wu16 906.000000000 DFC_Verb 0.00 906.000000000 FORMAT "%13.9" /end CHARACTERISTIC
/begin CHARACTERISTIC DFES_GrpRpr.DFC_MfPsDiaOpenLoad1_C "common MIL debouncing / group representative for common MIL debouncing of DFC_MfPsDiaOpenLoad1" VALUE 0x805053B6 Val_Wu16 906.000000000 DFC_Verb 0.00 906.000000000 FORMAT "%13.9" /end CHARACTERISTIC
/begin CHARACTERISTIC DFES_GrpRpr.DFC_MfPsDiaScHiS1_C "common MIL debouncing / group representative for common MIL debouncing of DFC_MfPsDiaScHiS1" VALUE 0x805053B8 Val_Wu16 906.000000000 DFC_Verb 0.00 906.000000000 FORMAT "%13.9" /end CHARACTERISTIC
/begin CHARACTERISTIC DFES_GrpRpr.DFC_MfPsDiaScHiSLowS1_C "common MIL debouncing / group representative for common MIL debouncing of DFC_MfPsDiaScHiSLowS1" VALUE 0x805053BA Val_Wu16 906.000000000 DFC_Verb 0.00 906.000000000 FORMAT "%13.9" /end CHARACTERISTIC
/begin CHARACTERISTIC DFES_GrpRpr.DFC_MfPsDiaScLowS1_C "common MIL debouncing / group representative for common MIL debouncing of DFC_MfPsDiaScLowS1" VALUE 0x805053BC Val_Wu16 906.000000000 DFC_Verb 0.00 906.000000000 FORMAT "%13.9" /end CHARACTERISTIC
/begin CHARACTERISTIC DFES_GrpRpr.DFC_ACEvpTPhysRngHi_C "common MIL debouncing / group representative for common MIL debouncing of DFC_ACEvpTPhysRngHi" VALUE 0x805053BE Val_Wu16 906.000000000 DFC_Verb 0.00 906.000000000 FORMAT "%13.9" /end CHARACTERISTIC
/begin CHARACTERISTIC DFES_GrpRpr.DFC_ACEvpTPhysRngLo_C "common MIL debouncing / group representative for common MIL debouncing of DFC_ACEvpTPhysRngLo" VALUE 0x805053C0 Val_Wu16 906.000000000 DFC_Verb 0.00 906.000000000 FORMAT "%13.9" /end CHARACTERISTIC
/begin CHARACTERISTIC DFES_GrpRpr.DFC_ACEvpTSRCMax_C "common MIL debouncing / group representative for common MIL debouncing of DFC_ACEvpTSRCMax" VALUE 0x805053C2 Val_Wu16 906.000000000 DFC_Verb 0.00 906.000000000 FORMAT "%13.9" /end CHARACTERISTIC
/begin CHARACTERISTIC DFES_GrpRpr.DFC_ACEvpTSRCMin_C "common MIL debouncing / group representative for common MIL debouncing of DFC_ACEvpTSRCMin" VALUE 0x805053C4 Val_Wu16 906.000000000 DFC_Verb 0.00 906.000000000 FORMAT "%13.9" /end CHARACTERISTIC
/begin CHARACTERISTIC DFES_GrpRpr.DFC_AfsRawSigRngHiB1_C "common MIL debouncing / group representative for common MIL debouncing of DFC_AfsRawSigRngHiB1" VALUE 0x805053C6 Val_Wu16 906.000000000 DFC_Verb 0.00 906.000000000 FORMAT "%13.9" /end CHARACTERISTIC
/begin CHARACTERISTIC DFES_GrpRpr.DFC_AfsRawSigRngLoB1_C "common MIL debouncing / group representative for common MIL debouncing of DFC_AfsRawSigRngLoB1" VALUE 0x805053C8 Val_Wu16 906.000000000 DFC_Verb 0.00 906.000000000 FORMAT "%13.9" /end CHARACTERISTIC
/begin CHARACTERISTIC DFES_GrpRpr.DFC_AfsSnsrErrB1_C "common MIL debouncing / group representative for common MIL debouncing of DFC_AfsSnsrErrB1" VALUE 0x805053CA Val_Wu16 906.000000000 DFC_Verb 0.00 906.000000000 FORMAT "%13.9" /end CHARACTERISTIC
/begin CHARACTERISTIC DFES_GrpRpr.DFC_AirCClntPAnaSRCMax_C "common MIL debouncing / group representative for common MIL debouncing of DFC_AirCClntPAnaSRCMax" VALUE 0x805053CC Val_Wu16 906.000000000 DFC_Verb 0.00 906.000000000 FORMAT "%13.9" /end CHARACTERISTIC
/begin CHARACTERISTIC DFES_GrpRpr.DFC_AirCClntPAnaSRCMin_C "common MIL debouncing / group representative for common MIL debouncing of DFC_AirCClntPAnaSRCMin" VALUE 0x805053CE Val_Wu16 906.000000000 DFC_Verb 0.00 906.000000000 FORMAT "%13.9" /end CHARACTERISTIC
/begin CHARACTERISTIC DFES_GrpRpr.DFC_AirCSwtNpl_C "common MIL debouncing / group representative for common MIL debouncing of DFC_AirCSwtNpl" VALUE 0x805053D0 Val_Wu16 906.000000000 DFC_Verb 0.00 906.000000000 FORMAT "%13.9" /end CHARACTERISTIC
/begin CHARACTERISTIC DFES_GrpRpr.DFC_AirCSwtSig_C "common MIL debouncing / group representative for common MIL debouncing of DFC_AirCSwtSig" VALUE 0x805053D2 Val_Wu16 906.000000000 DFC_Verb 0.00 906.000000000 FORMAT "%13.9" /end CHARACTERISTIC
/begin CHARACTERISTIC DFES_GrpRpr.DFC_Brk_C "common MIL debouncing / group representative for common MIL debouncing of DFC_Brk" VALUE 0x805053D4 Val_Wu16 906.000000000 DFC_Verb 0.00 906.000000000 FORMAT "%13.9" /end CHARACTERISTIC
/begin CHARACTERISTIC DFES_GrpRpr.DFC_BrkBstSensSCB_C "common MIL debouncing / group representative for common MIL debouncing of DFC_BrkBstSensSCB" VALUE 0x805053D6 Val_Wu16 906.000000000 DFC_Verb 0.00 906.000000000 FORMAT "%13.9" /end CHARACTERISTIC
/begin CHARACTERISTIC DFES_GrpRpr.DFC_BrkBstSensSCG_C "common MIL debouncing / group representative for common MIL debouncing of DFC_BrkBstSensSCG" VALUE 0x805053D8 Val_Wu16 906.000000000 DFC_Verb 0.00 906.000000000 FORMAT "%13.9" /end CHARACTERISTIC
/begin CHARACTERISTIC DFES_GrpRpr.DFC_BrkSig_C "common MIL debouncing / group representative for common MIL debouncing of DFC_BrkSig" VALUE 0x805053DA Val_Wu16 906.000000000 DFC_Verb 0.00 906.000000000 FORMAT "%13.9" /end CHARACTERISTIC
/begin CHARACTERISTIC DFES_GrpRpr.DFC_ClthSig_C "common MIL debouncing / group representative for common MIL debouncing of DFC_ClthSig" VALUE 0x805053DC Val_Wu16 906.000000000 DFC_Verb 0.00 906.000000000 FORMAT "%13.9" /end CHARACTERISTIC
/begin CHARACTERISTIC DFES_GrpRpr.DFC_EGRVlvCurrLim_C "common MIL debouncing / group representative for common MIL debouncing of DFC_EGRVlvCurrLim" VALUE 0x805053DE Val_Wu16 906.000000000 DFC_Verb 0.00 906.000000000 FORMAT "%13.9" /end CHARACTERISTIC
/begin CHARACTERISTIC DFES_GrpRpr.DFC_EGRVlvOL_C "common MIL debouncing / group representative for common MIL debouncing of DFC_EGRVlvOL" VALUE 0x805053E0 Val_Wu16 906.000000000 DFC_Verb 0.00 906.000000000 FORMAT "%13.9" /end CHARACTERISTIC
/begin CHARACTERISTIC DFES_GrpRpr.DFC_EGRVlvOvrTemp_C "common MIL debouncing / group representative for common MIL debouncing of DFC_EGRVlvOvrTemp" VALUE 0x805053E2 Val_Wu16 906.000000000 DFC_Verb 0.00 906.000000000 FORMAT "%13.9" /end CHARACTERISTIC
/begin CHARACTERISTIC DFES_GrpRpr.DFC_EGRVlvSCB_C "common MIL debouncing / group representative for common MIL debouncing of DFC_EGRVlvSCB" VALUE 0x805053E4 Val_Wu16 906.000000000 DFC_Verb 0.00 906.000000000 FORMAT "%13.9" /end CHARACTERISTIC
/begin CHARACTERISTIC DFES_GrpRpr.DFC_EGRVlvSCG_C "common MIL debouncing / group representative for common MIL debouncing of DFC_EGRVlvSCG" VALUE 0x805053E6 Val_Wu16 906.000000000 DFC_Verb 0.00 906.000000000 FORMAT "%13.9" /end CHARACTERISTIC
/begin CHARACTERISTIC DFES_GrpRpr.DFC_EGRVlvSRCMax_C "common MIL debouncing / group representative for common MIL debouncing of DFC_EGRVlvSRCMax" VALUE 0x805053E8 Val_Wu16 906.000000000 DFC_Verb 0.00 906.000000000 FORMAT "%13.9" /end CHARACTERISTIC
/begin CHARACTERISTIC DFES_GrpRpr.DFC_EGRVlvSRCMin_C "common MIL debouncing / group representative for common MIL debouncing of DFC_EGRVlvSRCMin" VALUE 0x805053EA Val_Wu16 906.000000000 DFC_Verb 0.00 906.000000000 FORMAT "%13.9" /end CHARACTERISTIC
/begin CHARACTERISTIC DFES_GrpRpr.DFC_HLSDemOvhtEngLim_C "common MIL debouncing / group representative for common MIL debouncing of DFC_HLSDemOvhtEngLim" VALUE 0x805053EC Val_Wu16 906.000000000 DFC_Verb 0.00 906.000000000 FORMAT "%13.9" /end CHARACTERISTIC
/begin CHARACTERISTIC DFES_GrpRpr.DFC_OilPSwmpSRCMax_C "common MIL debouncing / group representative for common MIL debouncing of DFC_OilPSwmpSRCMax" VALUE 0x805053EE Val_Wu16 906.000000000 DFC_Verb 0.00 906.000000000 FORMAT "%13.9" /end CHARACTERISTIC
/begin CHARACTERISTIC DFES_GrpRpr.DFC_OilPSwmpSRCMin_C "common MIL debouncing / group representative for common MIL debouncing of DFC_OilPSwmpSRCMin" VALUE 0x805053F0 Val_Wu16 906.000000000 DFC_Verb 0.00 906.000000000 FORMAT "%13.9" /end CHARACTERISTIC
/begin CHARACTERISTIC DFES_GrpRpr.DFC_PIntkVUsLineHiB1_C "common MIL debouncing / group representative for common MIL debouncing of DFC_PIntkVUsLineHiB1" VALUE 0x805053F2 Val_Wu16 906.000000000 DFC_Verb 0.00 906.000000000 FORMAT "%13.9" /end CHARACTERISTIC
/begin CHARACTERISTIC DFES_GrpRpr.DFC_PIntkVUsLineLoB1_C "common MIL debouncing / group representative for common MIL debouncing of DFC_PIntkVUsLineLoB1" VALUE 0x805053F4 Val_Wu16 906.000000000 DFC_Verb 0.00 906.000000000 FORMAT "%13.9" /end CHARACTERISTIC
/begin CHARACTERISTIC DFES_GrpRpr.DFC_VehVPhysRngLo_C "common MIL debouncing / group representative for common MIL debouncing of DFC_VehVPhysRngLo" VALUE 0x805053F6 Val_Wu16 906.000000000 DFC_Verb 0.00 906.000000000 FORMAT "%13.9" /end CHARACTERISTIC
/begin CHARACTERISTIC DFES_GrpRpr.DFC_VehVSigCan_C "common MIL debouncing / group representative for common MIL debouncing of DFC_VehVSigCan" VALUE 0x805053F8 Val_Wu16 906.000000000 DFC_Verb 0.00 906.000000000 FORMAT "%13.9" /end CHARACTERISTIC
/begin CHARACTERISTIC DFES_GrpRpr.DFC_VehVSigCanSafe_C "common MIL debouncing / group representative for common MIL debouncing of DFC_VehVSigCanSafe" VALUE 0x805053FA Val_Wu16 906.000000000 DFC_Verb 0.00 906.000000000 FORMAT "%13.9" /end CHARACTERISTIC
/begin CHARACTERISTIC DFES_GrpRpr.DFC_VlvLftFbOilPSnsrIntk11SRCMax_C "common MIL debouncing / group representative for common MIL debouncing of DFC_VlvLftFbOilPSnsrIntk11SRCMax" VALUE 0x805053FC Val_Wu16 906.000000000 DFC_Verb 0.00 906.000000000 FORMAT "%13.9" /end CHARACTERISTIC
/begin CHARACTERISTIC DFES_GrpRpr.DFC_VlvLftFbOilPSnsrIntk11SRCMin_C "common MIL debouncing / group representative for common MIL debouncing of DFC_VlvLftFbOilPSnsrIntk11SRCMin" VALUE 0x805053FE Val_Wu16 906.000000000 DFC_Verb 0.00 906.000000000 FORMAT "%13.9" /end CHARACTERISTIC
/begin CHARACTERISTIC DFES_GrpRpr.DFC_ClthNpl_C "common MIL debouncing / group representative for common MIL debouncing of DFC_ClthNpl" VALUE 0x80505400 Val_Wu16 906.000000000 DFC_Verb 0.00 906.000000000 FORMAT "%13.9" /end CHARACTERISTIC
/begin CHARACTERISTIC DFES_GrpRpr.DFC_GbxPNPosnDrvCdn_C "common MIL debouncing / group representative for common MIL debouncing of DFC_GbxPNPosnDrvCdn" VALUE 0x80505402 Val_Wu16 906.000000000 DFC_Verb 0.00 906.000000000 FORMAT "%13.9" /end CHARACTERISTIC
/begin CHARACTERISTIC DFES_GrpRpr.DFC_GbxPNPosnPlausy_C "common MIL debouncing / group representative for common MIL debouncing of DFC_GbxPNPosnPlausy" VALUE 0x80505404 Val_Wu16 906.000000000 DFC_Verb 0.00 906.000000000 FORMAT "%13.9" /end CHARACTERISTIC
/begin CHARACTERISTIC DFES_GrpRpr.DFC_AfsSigErrLineHiB1_C "common MIL debouncing / group representative for common MIL debouncing of DFC_AfsSigErrLineHiB1" VALUE 0x80505406 Val_Wu16 906.000000000 DFC_Verb 0.00 906.000000000 FORMAT "%13.9" /end CHARACTERISTIC
/begin CHARACTERISTIC DFES_GrpRpr.DFC_AfsSigErrLineLoB1_C "common MIL debouncing / group representative for common MIL debouncing of DFC_AfsSigErrLineLoB1" VALUE 0x80505408 Val_Wu16 906.000000000 DFC_Verb 0.00 906.000000000 FORMAT "%13.9" /end CHARACTERISTIC
/begin CHARACTERISTIC DFES_GrpRpr.DFC_PEnvCcMax_C "common MIL debouncing / group representative for common MIL debouncing of DFC_PEnvCcMax" VALUE 0x8050540A Val_Wu16 906.000000000 DFC_Verb 0.00 906.000000000 FORMAT "%13.9" /end CHARACTERISTIC
/begin CHARACTERISTIC DFES_GrpRpr.DFC_PEnvCcMin_C "common MIL debouncing / group representative for common MIL debouncing of DFC_PEnvCcMin" VALUE 0x8050540C Val_Wu16 906.000000000 DFC_Verb 0.00 906.000000000 FORMAT "%13.9" /end CHARACTERISTIC
/begin CHARACTERISTIC DFES_GrpRpr.DFC_PEnvRngChkMax_C "common MIL debouncing / group representative for common MIL debouncing of DFC_PEnvRngChkMax" VALUE 0x8050540E Val_Wu16 906.000000000 DFC_Verb 0.00 906.000000000 FORMAT "%13.9" /end CHARACTERISTIC
/begin CHARACTERISTIC DFES_GrpRpr.DFC_PEnvRngChkMin_C "common MIL debouncing / group representative for common MIL debouncing of DFC_PEnvRngChkMin" VALUE 0x80505410 Val_Wu16 906.000000000 DFC_Verb 0.00 906.000000000 FORMAT "%13.9" /end CHARACTERISTIC
/begin CHARACTERISTIC DFES_GrpRpr.DFC_PEnvSnsrPlaus_C "common MIL debouncing / group representative for common MIL debouncing of DFC_PEnvSnsrPlaus" VALUE 0x80505412 Val_Wu16 906.000000000 DFC_Verb 0.00 906.000000000 FORMAT "%13.9" /end CHARACTERISTIC
/begin CHARACTERISTIC DFES_GrpRpr.DFC_UEGOHeatrRlyPsOLS1B1_C "common MIL debouncing / group representative for common MIL debouncing of DFC_UEGOHeatrRlyPsOLS1B1" VALUE 0x80505414 Val_Wu16 906.000000000 DFC_Verb 0.00 906.000000000 FORMAT "%13.9" /end CHARACTERISTIC
/begin CHARACTERISTIC DFES_GrpRpr.DFC_UEGOHeatrRlyPsSCBS1B1_C "common MIL debouncing / group representative for common MIL debouncing of DFC_UEGOHeatrRlyPsSCBS1B1" VALUE 0x80505416 Val_Wu16 906.000000000 DFC_Verb 0.00 906.000000000 FORMAT "%13.9" /end CHARACTERISTIC
/begin CHARACTERISTIC DFES_GrpRpr.DFC_UEGOHeatrRlyPsSCGS1B1_C "common MIL debouncing / group representative for common MIL debouncing of DFC_UEGOHeatrRlyPsSCGS1B1" VALUE 0x80505418 Val_Wu16 906.000000000 DFC_Verb 0.00 906.000000000 FORMAT "%13.9" /end CHARACTERISTIC
/begin CHARACTERISTIC DFES_GrpRpr.DFC_UegoHeatrWireOlS1B1_C "common MIL debouncing / group representative for common MIL debouncing of DFC_UegoHeatrWireOlS1B1" VALUE 0x8050541A Val_Wu16 906.000000000 DFC_Verb 0.00 906.000000000 FORMAT "%13.9" /end CHARACTERISTIC
/begin CHARACTERISTIC DFES_GrpRpr.DFC_UegoHeatrWireScbS1B1_C "common MIL debouncing / group representative for common MIL debouncing of DFC_UegoHeatrWireScbS1B1" VALUE 0x8050541C Val_Wu16 906.000000000 DFC_Verb 0.00 906.000000000 FORMAT "%13.9" /end CHARACTERISTIC
/begin CHARACTERISTIC DFES_GrpRpr.DFC_UegoHeatrWireScgS1B1_C "common MIL debouncing / group representative for common MIL debouncing of DFC_UegoHeatrWireScgS1B1" VALUE 0x8050541E Val_Wu16 906.000000000 DFC_Verb 0.00 906.000000000 FORMAT "%13.9" /end CHARACTERISTIC
/begin CHARACTERISTIC DFES_GrpRpr.DFC_KnDetSens1PortAMax_C "common MIL debouncing / group representative for common MIL debouncing of DFC_KnDetSens1PortAMax" VALUE 0x80505420 Val_Wu16 906.000000000 DFC_Verb 0.00 906.000000000 FORMAT "%13.9" /end CHARACTERISTIC
/begin CHARACTERISTIC DFES_GrpRpr.DFC_KnDetSens1PortAMin_C "common MIL debouncing / group representative for common MIL debouncing of DFC_KnDetSens1PortAMin" VALUE 0x80505422 Val_Wu16 906.000000000 DFC_Verb 0.00 906.000000000 FORMAT "%13.9" /end CHARACTERISTIC
/begin CHARACTERISTIC DFES_GrpRpr.DFC_KnDetSens1PortBMax_C "common MIL debouncing / group representative for common MIL debouncing of DFC_KnDetSens1PortBMax" VALUE 0x80505424 Val_Wu16 906.000000000 DFC_Verb 0.00 906.000000000 FORMAT "%13.9" /end CHARACTERISTIC
/begin CHARACTERISTIC DFES_GrpRpr.DFC_KnDetSens1PortBMin_C "common MIL debouncing / group representative for common MIL debouncing of DFC_KnDetSens1PortBMin" VALUE 0x80505426 Val_Wu16 906.000000000 DFC_Verb 0.00 906.000000000 FORMAT "%13.9" /end CHARACTERISTIC
/begin CHARACTERISTIC DFES_GrpRpr.DFC_Clth2ONStuck_C "common MIL debouncing / group representative for common MIL debouncing of DFC_Clth2ONStuck" VALUE 0x80505428 Val_Wu16 906.000000000 DFC_Verb 0.00 906.000000000 FORMAT "%13.9" /end CHARACTERISTIC
/begin CHARACTERISTIC DFES_GrpRpr.DFC_Clth2ONStuckLdc_C "common MIL debouncing / group representative for common MIL debouncing of DFC_Clth2ONStuckLdc" VALUE 0x8050542A Val_Wu16 906.000000000 DFC_Verb 0.00 906.000000000 FORMAT "%13.9" /end CHARACTERISTIC
/begin CHARACTERISTIC DFES_GrpRpr.DFC_Clth3ONStuckLdc_C "common MIL debouncing / group representative for common MIL debouncing of DFC_Clth3ONStuckLdc" VALUE 0x8050542C Val_Wu16 906.000000000 DFC_Verb 0.00 906.000000000 FORMAT "%13.9" /end CHARACTERISTIC
/begin CHARACTERISTIC DFES_GrpRpr.DFC_Clth3ONStuckPostDrv_C "common MIL debouncing / group representative for common MIL debouncing of DFC_Clth3ONStuckPostDrv" VALUE 0x8050542E Val_Wu16 906.000000000 DFC_Verb 0.00 906.000000000 FORMAT "%13.9" /end CHARACTERISTIC
/begin CHARACTERISTIC DFES_GrpRpr.DFC_Clth4ONStuck_C "common MIL debouncing / group representative for common MIL debouncing of DFC_Clth4ONStuck" VALUE 0x80505430 Val_Wu16 906.000000000 DFC_Verb 0.00 906.000000000 FORMAT "%13.9" /end CHARACTERISTIC
/begin CHARACTERISTIC DFES_GrpRpr.DFC_Clth4ONStuckLdc_C "common MIL debouncing / group representative for common MIL debouncing of DFC_Clth4ONStuckLdc" VALUE 0x80505432 Val_Wu16 906.000000000 DFC_Verb 0.00 906.000000000 FORMAT "%13.9" /end CHARACTERISTIC
/begin CHARACTERISTIC DFES_GrpRpr.DFC_ComBCMUnit_C "common MIL debouncing / group representative for common MIL debouncing of DFC_ComBCMUnit" VALUE 0x80505434 Val_Wu16 906.000000000 DFC_Verb 0.00 906.000000000 FORMAT "%13.9" /end CHARACTERISTIC
/begin CHARACTERISTIC DFES_GrpRpr.DFC_ComDLCTCU01_C "common MIL debouncing / group representative for common MIL debouncing of DFC_ComDLCTCU01" VALUE 0x80505436 Val_Wu16 906.000000000 DFC_Verb 0.00 906.000000000 FORMAT "%13.9" /end CHARACTERISTIC
/begin CHARACTERISTIC DFES_GrpRpr.DFC_ComDLCTCU02_C "common MIL debouncing / group representative for common MIL debouncing of DFC_ComDLCTCU02" VALUE 0x80505438 Val_Wu16 906.000000000 DFC_Verb 0.00 906.000000000 FORMAT "%13.9" /end CHARACTERISTIC
/begin CHARACTERISTIC DFES_GrpRpr.DFC_ComDLCTCU1_C "common MIL debouncing / group representative for common MIL debouncing of DFC_ComDLCTCU1" VALUE 0x8050543A Val_Wu16 906.000000000 DFC_Verb 0.00 906.000000000 FORMAT "%13.9" /end CHARACTERISTIC
/begin CHARACTERISTIC DFES_GrpRpr.DFC_ComDLCTCU11_C "common MIL debouncing / group representative for common MIL debouncing of DFC_ComDLCTCU11" VALUE 0x8050543C Val_Wu16 906.000000000 DFC_Verb 0.00 906.000000000 FORMAT "%13.9" /end CHARACTERISTIC
/begin CHARACTERISTIC DFES_GrpRpr.DFC_ComDLCTCU12_C "common MIL debouncing / group representative for common MIL debouncing of DFC_ComDLCTCU12" VALUE 0x8050543E Val_Wu16 906.000000000 DFC_Verb 0.00 906.000000000 FORMAT "%13.9" /end CHARACTERISTIC
/begin CHARACTERISTIC DFES_GrpRpr.DFC_ComDLCTCU13_C "common MIL debouncing / group representative for common MIL debouncing of DFC_ComDLCTCU13" VALUE 0x80505440 Val_Wu16 906.000000000 DFC_Verb 0.00 906.000000000 FORMAT "%13.9" /end CHARACTERISTIC
/begin CHARACTERISTIC DFES_GrpRpr.DFC_ComDLCTCU14_C "common MIL debouncing / group representative for common MIL debouncing of DFC_ComDLCTCU14" VALUE 0x80505442 Val_Wu16 906.000000000 DFC_Verb 0.00 906.000000000 FORMAT "%13.9" /end CHARACTERISTIC
/begin CHARACTERISTIC DFES_GrpRpr.DFC_ComDLCTCU2_C "common MIL debouncing / group representative for common MIL debouncing of DFC_ComDLCTCU2" VALUE 0x80505444 Val_Wu16 906.000000000 DFC_Verb 0.00 906.000000000 FORMAT "%13.9" /end CHARACTERISTIC
/begin CHARACTERISTIC DFES_GrpRpr.DFC_ComDLCTCU3_C "common MIL debouncing / group representative for common MIL debouncing of DFC_ComDLCTCU3" VALUE 0x80505446 Val_Wu16 906.000000000 DFC_Verb 0.00 906.000000000 FORMAT "%13.9" /end CHARACTERISTIC
/begin CHARACTERISTIC DFES_GrpRpr.DFC_ComDLCTCU4_C "common MIL debouncing / group representative for common MIL debouncing of DFC_ComDLCTCU4" VALUE 0x80505448 Val_Wu16 906.000000000 DFC_Verb 0.00 906.000000000 FORMAT "%13.9" /end CHARACTERISTIC
/begin CHARACTERISTIC DFES_GrpRpr.DFC_ComEPSUnit_C "common MIL debouncing / group representative for common MIL debouncing of DFC_ComEPSUnit" VALUE 0x8050544A Val_Wu16 906.000000000 DFC_Verb 0.00 906.000000000 FORMAT "%13.9" /end CHARACTERISTIC
/begin CHARACTERISTIC DFES_GrpRpr.DFC_ComIDASBUnit_C "common MIL debouncing / group representative for common MIL debouncing of DFC_ComIDASBUnit" VALUE 0x8050544C Val_Wu16 906.000000000 DFC_Verb 0.00 906.000000000 FORMAT "%13.9" /end CHARACTERISTIC
/begin CHARACTERISTIC DFES_GrpRpr.DFC_ComIMGUnit_C "common MIL debouncing / group representative for common MIL debouncing of DFC_ComIMGUnit" VALUE 0x8050544E Val_Wu16 906.000000000 DFC_Verb 0.00 906.000000000 FORMAT "%13.9" /end CHARACTERISTIC
/begin CHARACTERISTIC DFES_GrpRpr.DFC_ComMETUnit_C "common MIL debouncing / group representative for common MIL debouncing of DFC_ComMETUnit" VALUE 0x80505450 Val_Wu16 906.000000000 DFC_Verb 0.00 906.000000000 FORMAT "%13.9" /end CHARACTERISTIC
/begin CHARACTERISTIC DFES_GrpRpr.DFC_ComSRSUnit_C "common MIL debouncing / group representative for common MIL debouncing of DFC_ComSRSUnit" VALUE 0x80505452 Val_Wu16 906.000000000 DFC_Verb 0.00 906.000000000 FORMAT "%13.9" /end CHARACTERISTIC
/begin CHARACTERISTIC DFES_GrpRpr.DFC_ComVSAUnit_C "common MIL debouncing / group representative for common MIL debouncing of DFC_ComVSAUnit" VALUE 0x80505454 Val_Wu16 906.000000000 DFC_Verb 0.00 906.000000000 FORMAT "%13.9" /end CHARACTERISTIC
/begin CHARACTERISTIC DFES_GrpRpr.DFC_EbsSocFlt_C "common MIL debouncing / group representative for common MIL debouncing of DFC_EbsSocFlt" VALUE 0x80505456 Val_Wu16 906.000000000 DFC_Verb 0.00 906.000000000 FORMAT "%13.9" /end CHARACTERISTIC
/begin CHARACTERISTIC DFES_GrpRpr.DFC_I14229VINErr_C "common MIL debouncing / group representative for common MIL debouncing of DFC_I14229VINErr" VALUE 0x80505458 Val_Wu16 906.000000000 DFC_Verb 0.00 906.000000000 FORMAT "%13.9" /end CHARACTERISTIC
/begin CHARACTERISTIC DFES_GrpRpr.DFC_InjCatHeatgErr_C "common MIL debouncing / group representative for common MIL debouncing of DFC_InjCatHeatgErr" VALUE 0x8050545A Val_Wu16 906.000000000 DFC_Verb 0.00 906.000000000 FORMAT "%13.9" /end CHARACTERISTIC
/begin CHARACTERISTIC DFES_GrpRpr.DFC_InjSysMulInjDiagErr_C "common MIL debouncing / group representative for common MIL debouncing of DFC_InjSysMulInjDiagErr" VALUE 0x8050545C Val_Wu16 906.000000000 DFC_Verb 0.00 906.000000000 FORMAT "%13.9" /end CHARACTERISTIC
/begin CHARACTERISTIC DFES_GrpRpr.DFC_LLRHmax_C "common MIL debouncing / group representative for common MIL debouncing of DFC_LLRHmax" VALUE 0x8050545E Val_Wu16 906.000000000 DFC_Verb 0.00 906.000000000 FORMAT "%13.9" /end CHARACTERISTIC
/begin CHARACTERISTIC DFES_GrpRpr.DFC_LLRHmin_C "common MIL debouncing / group representative for common MIL debouncing of DFC_LLRHmin" VALUE 0x80505460 Val_Wu16 906.000000000 DFC_Verb 0.00 906.000000000 FORMAT "%13.9" /end CHARACTERISTIC
/begin CHARACTERISTIC DFES_GrpRpr.DFC_LLRHnpl_C "common MIL debouncing / group representative for common MIL debouncing of DFC_LLRHnpl" VALUE 0x80505462 Val_Wu16 906.000000000 DFC_Verb 0.00 906.000000000 FORMAT "%13.9" /end CHARACTERISTIC
/begin CHARACTERISTIC DFES_GrpRpr.DFC_LLRKHmax_C "common MIL debouncing / group representative for common MIL debouncing of DFC_LLRKHmax" VALUE 0x80505464 Val_Wu16 906.000000000 DFC_Verb 0.00 906.000000000 FORMAT "%13.9" /end CHARACTERISTIC
/begin CHARACTERISTIC DFES_GrpRpr.DFC_LLRKHmin_C "common MIL debouncing / group representative for common MIL debouncing of DFC_LLRKHmin" VALUE 0x80505466 Val_Wu16 906.000000000 DFC_Verb 0.00 906.000000000 FORMAT "%13.9" /end CHARACTERISTIC
/begin CHARACTERISTIC DFES_GrpRpr.DFC_LLRKHnpl_C "common MIL debouncing / group representative for common MIL debouncing of DFC_LLRKHnpl" VALUE 0x80505468 Val_Wu16 906.000000000 DFC_Verb 0.00 906.000000000 FORMAT "%13.9" /end CHARACTERISTIC
/begin CHARACTERISTIC DFES_GrpRpr.DFC_LinACGUnit_C "common MIL debouncing / group representative for common MIL debouncing of DFC_LinACGUnit" VALUE 0x8050546A Val_Wu16 906.000000000 DFC_Verb 0.00 906.000000000 FORMAT "%13.9" /end CHARACTERISTIC
/begin CHARACTERISTIC DFES_GrpRpr.DFC_LinAEVUnit_C "common MIL debouncing / group representative for common MIL debouncing of DFC_LinAEVUnit" VALUE 0x8050546C Val_Wu16 906.000000000 DFC_Verb 0.00 906.000000000 FORMAT "%13.9" /end CHARACTERISTIC
/begin CHARACTERISTIC DFES_GrpRpr.DFC_LinEBSUnit_C "common MIL debouncing / group representative for common MIL debouncing of DFC_LinEBSUnit" VALUE 0x8050546E Val_Wu16 906.000000000 DFC_Verb 0.00 906.000000000 FORMAT "%13.9" /end CHARACTERISTIC
/begin CHARACTERISTIC DFES_GrpRpr.DFC_RoughRoad_C "common MIL debouncing / group representative for common MIL debouncing of DFC_RoughRoad" VALUE 0x80505470 Val_Wu16 906.000000000 DFC_Verb 0.00 906.000000000 FORMAT "%13.9" /end CHARACTERISTIC
/begin CHARACTERISTIC DFES_GrpRpr.DFC_SiaEEPRdErr_C "common MIL debouncing / group representative for common MIL debouncing of DFC_SiaEEPRdErr" VALUE 0x80505472 Val_Wu16 906.000000000 DFC_Verb 0.00 906.000000000 FORMAT "%13.9" /end CHARACTERISTIC
/begin CHARACTERISTIC DFES_GrpRpr.DFC_SiaEEPWrngCod_C "common MIL debouncing / group representative for common MIL debouncing of DFC_SiaEEPWrngCod" VALUE 0x80505474 Val_Wu16 906.000000000 DFC_Verb 0.00 906.000000000 FORMAT "%13.9" /end CHARACTERISTIC
/begin CHARACTERISTIC DFES_GrpRpr.DFC_UegoHeatrStrtS1B1_C "common MIL debouncing / group representative for common MIL debouncing of DFC_UegoHeatrStrtS1B1" VALUE 0x80505476 Val_Wu16 906.000000000 DFC_Verb 0.00 906.000000000 FORMAT "%13.9" /end CHARACTERISTIC
/begin CHARACTERISTIC DFES_GrpRpr.DFC_BusDiagCANAPPLBusOff_C "common MIL debouncing / group representative for common MIL debouncing of DFC_BusDiagCANAPPLBusOff" VALUE 0x80505478 Val_Wu16 906.000000000 DFC_Verb 0.00 906.000000000 FORMAT "%13.9" /end CHARACTERISTIC
/begin CHARACTERISTIC DFES_GrpRpr.DFC_BusDiagCANCANCBusOff_C "common MIL debouncing / group representative for common MIL debouncing of DFC_BusDiagCANCANCBusOff" VALUE 0x8050547A Val_Wu16 906.000000000 DFC_Verb 0.00 906.000000000 FORMAT "%13.9" /end CHARACTERISTIC
/begin CHARACTERISTIC DFES_GrpRpr.DFC_BusDiagCANVEHICLEBusOff_C "common MIL debouncing / group representative for common MIL debouncing of DFC_BusDiagCANVEHICLEBusOff" VALUE 0x8050547C Val_Wu16 906.000000000 DFC_Verb 0.00 906.000000000 FORMAT "%13.9" /end CHARACTERISTIC
/begin CHARACTERISTIC DFES_GrpRpr.DFC_RBA_IODIAGPWR_rba_IoExtCy329_SignalVltSply_0_C "common MIL debouncing / group representative for common MIL debouncing of DFC_RBA_IODIAGPWR_rba_IoExtCy329_SignalVltSply_0" VALUE 0x8050547E Val_Wu16 906.000000000 DFC_Verb 0.00 906.000000000 FORMAT "%13.9" /end CHARACTERISTIC
/begin CHARACTERISTIC DFES_GrpRpr.DFC_RBA_IODIAGPWR_rba_IoExtCy329_SignalVltSply_0OT_C "common MIL debouncing / group representative for common MIL debouncing of DFC_RBA_IODIAGPWR_rba_IoExtCy329_SignalVltSply_0OT" VALUE 0x80505480 Val_Wu16 906.000000000 DFC_Verb 0.00 906.000000000 FORMAT "%13.9" /end CHARACTERISTIC
/begin CHARACTERISTIC DFES_GrpRpr.DFC_RBA_IODIAGPWR_rba_IoExtCy329_SignalVltSply_0OV_C "common MIL debouncing / group representative for common MIL debouncing of DFC_RBA_IODIAGPWR_rba_IoExtCy329_SignalVltSply_0OV" VALUE 0x80505482 Val_Wu16 906.000000000 DFC_Verb 0.00 906.000000000 FORMAT "%13.9" /end CHARACTERISTIC
/begin CHARACTERISTIC DFES_GrpRpr.DFC_RBA_IODIAGPWR_rba_IoExtCy329_SignalVltSply_0SCG_C "common MIL debouncing / group representative for common MIL debouncing of DFC_RBA_IODIAGPWR_rba_IoExtCy329_SignalVltSply_0SCG" VALUE 0x80505484 Val_Wu16 906.000000000 DFC_Verb 0.00 906.000000000 FORMAT "%13.9" /end CHARACTERISTIC
/begin CHARACTERISTIC DFES_GrpRpr.DFC_RBA_IODIAGPWR_rba_IoExtCy329_SignalVltSply_0UV_C "common MIL debouncing / group representative for common MIL debouncing of DFC_RBA_IODIAGPWR_rba_IoExtCy329_SignalVltSply_0UV" VALUE 0x80505486 Val_Wu16 906.000000000 DFC_Verb 0.00 906.000000000 FORMAT "%13.9" /end CHARACTERISTIC
/begin CHARACTERISTIC DFES_GrpRpr.DFC_RBA_IODIAGPWR_rba_IoExtCy329_SignalVltSply_1_C "common MIL debouncing / group representative for common MIL debouncing of DFC_RBA_IODIAGPWR_rba_IoExtCy329_SignalVltSply_1" VALUE 0x80505488 Val_Wu16 906.000000000 DFC_Verb 0.00 906.000000000 FORMAT "%13.9" /end CHARACTERISTIC
/begin CHARACTERISTIC DFES_GrpRpr.DFC_RBA_IODIAGPWR_rba_IoExtCy329_SignalVltSply_1OT_C "common MIL debouncing / group representative for common MIL debouncing of DFC_RBA_IODIAGPWR_rba_IoExtCy329_SignalVltSply_1OT" VALUE 0x8050548A Val_Wu16 906.000000000 DFC_Verb 0.00 906.000000000 FORMAT "%13.9" /end CHARACTERISTIC
/begin CHARACTERISTIC DFES_GrpRpr.DFC_RBA_IODIAGPWR_rba_IoExtCy329_SignalVltSply_1OV_C "common MIL debouncing / group representative for common MIL debouncing of DFC_RBA_IODIAGPWR_rba_IoExtCy329_SignalVltSply_1OV" VALUE 0x8050548C Val_Wu16 906.000000000 DFC_Verb 0.00 906.000000000 FORMAT "%13.9" /end CHARACTERISTIC
/begin CHARACTERISTIC DFES_GrpRpr.DFC_RBA_IODIAGPWR_rba_IoExtCy329_SignalVltSply_1SCG_C "common MIL debouncing / group representative for common MIL debouncing of DFC_RBA_IODIAGPWR_rba_IoExtCy329_SignalVltSply_1SCG" VALUE 0x8050548E Val_Wu16 906.000000000 DFC_Verb 0.00 906.000000000 FORMAT "%13.9" /end CHARACTERISTIC
/begin CHARACTERISTIC DFES_GrpRpr.DFC_RBA_IODIAGPWR_rba_IoExtCy329_SignalVltSply_1UV_C "common MIL debouncing / group representative for common MIL debouncing of DFC_RBA_IODIAGPWR_rba_IoExtCy329_SignalVltSply_1UV" VALUE 0x80505490 Val_Wu16 906.000000000 DFC_Verb 0.00 906.000000000 FORMAT "%13.9" /end CHARACTERISTIC
/begin CHARACTERISTIC DFES_GrpRpr.DFC_RBA_IODIAGPWR_rba_IoExtCy329_SignalVltSply_2_C "common MIL debouncing / group representative for common MIL debouncing of DFC_RBA_IODIAGPWR_rba_IoExtCy329_SignalVltSply_2" VALUE 0x80505492 Val_Wu16 906.000000000 DFC_Verb 0.00 906.000000000 FORMAT "%13.9" /end CHARACTERISTIC
/begin CHARACTERISTIC DFES_GrpRpr.DFC_RBA_IODIAGPWR_rba_IoExtCy329_SignalVltSply_2OT_C "common MIL debouncing / group representative for common MIL debouncing of DFC_RBA_IODIAGPWR_rba_IoExtCy329_SignalVltSply_2OT" VALUE 0x80505494 Val_Wu16 906.000000000 DFC_Verb 0.00 906.000000000 FORMAT "%13.9" /end CHARACTERISTIC
/begin CHARACTERISTIC DFES_GrpRpr.DFC_RBA_IODIAGPWR_rba_IoExtCy329_SignalVltSply_2OV_C "common MIL debouncing / group representative for common MIL debouncing of DFC_RBA_IODIAGPWR_rba_IoExtCy329_SignalVltSply_2OV" VALUE 0x80505496 Val_Wu16 906.000000000 DFC_Verb 0.00 906.000000000 FORMAT "%13.9" /end CHARACTERISTIC
/begin CHARACTERISTIC DFES_GrpRpr.DFC_RBA_IODIAGPWR_rba_IoExtCy329_SignalVltSply_2SCG_C "common MIL debouncing / group representative for common MIL debouncing of DFC_RBA_IODIAGPWR_rba_IoExtCy329_SignalVltSply_2SCG" VALUE 0x80505498 Val_Wu16 906.000000000 DFC_Verb 0.00 906.000000000 FORMAT "%13.9" /end CHARACTERISTIC
/begin CHARACTERISTIC DFES_GrpRpr.DFC_RBA_IODIAGPWR_rba_IoExtCy329_SignalVltSply_2UV_C "common MIL debouncing / group representative for common MIL debouncing of DFC_RBA_IODIAGPWR_rba_IoExtCy329_SignalVltSply_2UV" VALUE 0x8050549A Val_Wu16 906.000000000 DFC_Verb 0.00 906.000000000 FORMAT "%13.9" /end CHARACTERISTIC
/begin CHARACTERISTIC DFES_GrpRpr.DFC_CAN_E_TIMEOUT_C "common MIL debouncing / group representative for common MIL debouncing of DFC_CAN_E_TIMEOUT" VALUE 0x8050549C Val_Wu16 906.000000000 DFC_Verb 0.00 906.000000000 FORMAT "%13.9" /end CHARACTERISTIC
/begin CHARACTERISTIC DFES_GrpRpr.DFC_LIN_E_TIMEOUT_C "common MIL debouncing / group representative for common MIL debouncing of DFC_LIN_E_TIMEOUT" VALUE 0x8050549E Val_Wu16 906.000000000 DFC_Verb 0.00 906.000000000 FORMAT "%13.9" /end CHARACTERISTIC
/begin CHARACTERISTIC DFES_GrpRpr.DFC_MRlyOL_C "common MIL debouncing / group representative for common MIL debouncing of DFC_MRlyOL" VALUE 0x805054A0 Val_Wu16 906.000000000 DFC_Verb 0.00 906.000000000 FORMAT "%13.9" /end CHARACTERISTIC
/begin CHARACTERISTIC DFES_GrpRpr.DFC_MRlySCB_C "common MIL debouncing / group representative for common MIL debouncing of DFC_MRlySCB" VALUE 0x805054A2 Val_Wu16 906.000000000 DFC_Verb 0.00 906.000000000 FORMAT "%13.9" /end CHARACTERISTIC
/begin CHARACTERISTIC DFES_GrpRpr.DFC_MRlySCG_C "common MIL debouncing / group representative for common MIL debouncing of DFC_MRlySCG" VALUE 0x805054A4 Val_Wu16 906.000000000 DFC_Verb 0.00 906.000000000 FORMAT "%13.9" /end CHARACTERISTIC
/begin CHARACTERISTIC DFES_GrpRpr.DFC_rba_MultiStackTrace_Threshold_C "common MIL debouncing / group representative for common MIL debouncing of DFC_rba_MultiStackTrace_Threshold" VALUE 0x805054A6 Val_Wu16 906.000000000 DFC_Verb 0.00 906.000000000 FORMAT "%13.9" /end CHARACTERISTIC
/begin CHARACTERISTIC DFES_GrpRpr.DFC_BSWM_E_ACTION_FAILED_C "common MIL debouncing / group representative for common MIL debouncing of DFC_BSWM_E_ACTION_FAILED" VALUE 0x805054A8 Val_Wu16 906.000000000 DFC_Verb 0.00 906.000000000 FORMAT "%13.9" /end CHARACTERISTIC
/begin CHARACTERISTIC DFES_GrpRpr.DFC_BSWM_E_INTRPTQUEUE_FULL_C "common MIL debouncing / group representative for common MIL debouncing of DFC_BSWM_E_INTRPTQUEUE_FULL" VALUE 0x805054AA Val_Wu16 906.000000000 DFC_Verb 0.00 906.000000000 FORMAT "%13.9" /end CHARACTERISTIC
/begin CHARACTERISTIC DFES_GrpRpr.DFC_RBA_IOEXTLIB_KEEPALIVE_DRV_C "common MIL debouncing / group representative for common MIL debouncing of DFC_RBA_IOEXTLIB_KEEPALIVE_DRV" VALUE 0x805054AC Val_Wu16 906.000000000 DFC_Verb 0.00 906.000000000 FORMAT "%13.9" /end CHARACTERISTIC
/begin CHARACTERISTIC DFES_GrpRpr.DFC_RBA_IOEXTLIB_KEEPALIVE_INI_C "common MIL debouncing / group representative for common MIL debouncing of DFC_RBA_IOEXTLIB_KEEPALIVE_INI" VALUE 0x805054AE Val_Wu16 906.000000000 DFC_Verb 0.00 906.000000000 FORMAT "%13.9" /end CHARACTERISTIC
/begin CHARACTERISTIC DFES_GrpRpr.DFC_rba_IoSigRtc_StopCounter_C "common MIL debouncing / group representative for common MIL debouncing of DFC_rba_IoSigRtc_StopCounter" VALUE 0x805054B0 Val_Wu16 906.000000000 DFC_Verb 0.00 906.000000000 FORMAT "%13.9" /end CHARACTERISTIC
/begin CHARACTERISTIC DFES_GrpRpr.DFC_rba_MRly_Diag_Stk_Event_C "common MIL debouncing / group representative for common MIL debouncing of DFC_rba_MRly_Diag_Stk_Event" VALUE 0x805054B2 Val_Wu16 906.000000000 DFC_Verb 0.00 906.000000000 FORMAT "%13.9" /end CHARACTERISTIC
/begin CHARACTERISTIC DFES_GrpRpr.DFC_rba_MemDiag_MemReadErr_C "common MIL debouncing / group representative for common MIL debouncing of DFC_rba_MemDiag_MemReadErr" VALUE 0x805054B4 Val_Wu16 906.000000000 DFC_Verb 0.00 906.000000000 FORMAT "%13.9" /end CHARACTERISTIC
/begin CHARACTERISTIC DFES_GrpRpr.DFC_rba_MemDiag_MemWrErr_C "common MIL debouncing / group representative for common MIL debouncing of DFC_rba_MemDiag_MemWrErr" VALUE 0x805054B6 Val_Wu16 906.000000000 DFC_Verb 0.00 906.000000000 FORMAT "%13.9" /end CHARACTERISTIC
/begin CHARACTERISTIC DFES_GrpRpr.DFC_rba_SyC_IrrSwOffTrigEngRun_Event_C "common MIL debouncing / group representative for common MIL debouncing of DFC_rba_SyC_IrrSwOffTrigEngRun_Event" VALUE 0x805054B8 Val_Wu16 906.000000000 DFC_Verb 0.00 906.000000000 FORMAT "%13.9" /end CHARACTERISTIC
/begin CHARACTERISTIC DFES_GrpRpr.DFC_rba_T15_Diag_ComInVld_Event_C "common MIL debouncing / group representative for common MIL debouncing of DFC_rba_T15_Diag_ComInVld_Event" VALUE 0x805054BA Val_Wu16 906.000000000 DFC_Verb 0.00 906.000000000 FORMAT "%13.9" /end CHARACTERISTIC
/begin CHARACTERISTIC DFES_GrpRpr.DFC_rba_T15_Diag_ComOff_HwOn_Event_C "common MIL debouncing / group representative for common MIL debouncing of DFC_rba_T15_Diag_ComOff_HwOn_Event" VALUE 0x805054BC Val_Wu16 906.000000000 DFC_Verb 0.00 906.000000000 FORMAT "%13.9" /end CHARACTERISTIC
/begin CHARACTERISTIC DFES_GrpRpr.DFC_rba_T15_Diag_ComOn_HwOff_Event_C "common MIL debouncing / group representative for common MIL debouncing of DFC_rba_T15_Diag_ComOn_HwOff_Event" VALUE 0x805054BE Val_Wu16 906.000000000 DFC_Verb 0.00 906.000000000 FORMAT "%13.9" /end CHARACTERISTIC
/begin CHARACTERISTIC DFES_GrpRpr.DFC_AAVmin_C "common MIL debouncing / group representative for common MIL debouncing of DFC_AAVmin" VALUE 0x805054C0 Val_Wu16 906.000000000 DFC_Verb 0.00 906.000000000 FORMAT "%13.9" /end CHARACTERISTIC
/begin CHARACTERISTIC DFES_GrpRpr.DFC_AGRSUS_C "common MIL debouncing / group representative for common MIL debouncing of DFC_AGRSUS" VALUE 0x805054C2 Val_Wu16 906.000000000 DFC_Verb 0.00 906.000000000 FORMAT "%13.9" /end CHARACTERISTIC
/begin CHARACTERISTIC DFES_GrpRpr.DFC_AfsPlausDiagHi_C "common MIL debouncing / group representative for common MIL debouncing of DFC_AfsPlausDiagHi" VALUE 0x805054C4 Val_Wu16 906.000000000 DFC_Verb 0.00 906.000000000 FORMAT "%13.9" /end CHARACTERISTIC
/begin CHARACTERISTIC DFES_GrpRpr.DFC_AfsPlausDiagLo_C "common MIL debouncing / group representative for common MIL debouncing of DFC_AfsPlausDiagLo" VALUE 0x805054C6 Val_Wu16 906.000000000 DFC_Verb 0.00 906.000000000 FORMAT "%13.9" /end CHARACTERISTIC
/begin CHARACTERISTIC DFES_GrpRpr.DFC_AfsVrntDiagErrB1_C "common MIL debouncing / group representative for common MIL debouncing of DFC_AfsVrntDiagErrB1" VALUE 0x805054C8 Val_Wu16 906.000000000 DFC_Verb 0.00 906.000000000 FORMAT "%13.9" /end CHARACTERISTIC
/begin CHARACTERISTIC DFES_GrpRpr.DFC_AppAllSnsrDfct_C "common MIL debouncing / group representative for common MIL debouncing of DFC_AppAllSnsrDfct" VALUE 0x805054CA Val_Wu16 906.000000000 DFC_Verb 0.00 906.000000000 FORMAT "%13.9" /end CHARACTERISTIC
/begin CHARACTERISTIC DFES_GrpRpr.DFC_BBKRnldg_C "common MIL debouncing / group representative for common MIL debouncing of DFC_BBKRnldg" VALUE 0x805054CC Val_Wu16 906.000000000 DFC_Verb 0.00 906.000000000 FORMAT "%13.9" /end CHARACTERISTIC
/begin CHARACTERISTIC DFES_GrpRpr.DFC_BBKRsyne_C "common MIL debouncing / group representative for common MIL debouncing of DFC_BBKRsyne" VALUE 0x805054CE Val_Wu16 906.000000000 DFC_Verb 0.00 906.000000000 FORMAT "%13.9" /end CHARACTERISTIC
/begin CHARACTERISTIC DFES_GrpRpr.DFC_BattUStdbyDiaOL_C "common MIL debouncing / group representative for common MIL debouncing of DFC_BattUStdbyDiaOL" VALUE 0x805054D0 Val_Wu16 906.000000000 DFC_Verb 0.00 906.000000000 FORMAT "%13.9" /end CHARACTERISTIC
/begin CHARACTERISTIC DFES_GrpRpr.DFC_BigLeakIntkMnfldEmiInfl_C "common MIL debouncing / group representative for common MIL debouncing of DFC_BigLeakIntkMnfldEmiInfl" VALUE 0x805054D2 Val_Wu16 906.000000000 DFC_Verb 0.00 906.000000000 FORMAT "%13.9" /end CHARACTERISTIC
/begin CHARACTERISTIC DFES_GrpRpr.DFC_BlkdLineTank_C "common MIL debouncing / group representative for common MIL debouncing of DFC_BlkdLineTank" VALUE 0x805054D4 Val_Wu16 906.000000000 DFC_Verb 0.00 906.000000000 FORMAT "%13.9" /end CHARACTERISTIC
/begin CHARACTERISTIC DFES_GrpRpr.DFC_BrkMnSwtContOnWarnLmp_C "common MIL debouncing / group representative for common MIL debouncing of DFC_BrkMnSwtContOnWarnLmp" VALUE 0x805054D6 Val_Wu16 906.000000000 DFC_Verb 0.00 906.000000000 FORMAT "%13.9" /end CHARACTERISTIC
/begin CHARACTERISTIC DFES_GrpRpr.DFC_BrkMnSwtNotStpWarnLmp_C "common MIL debouncing / group representative for common MIL debouncing of DFC_BrkMnSwtNotStpWarnLmp" VALUE 0x805054D8 Val_Wu16 906.000000000 DFC_Verb 0.00 906.000000000 FORMAT "%13.9" /end CHARACTERISTIC
/begin CHARACTERISTIC DFES_GrpRpr.DFC_BrkRdntSwtContOnWarnLmp_C "common MIL debouncing / group representative for common MIL debouncing of DFC_BrkRdntSwtContOnWarnLmp" VALUE 0x805054DA Val_Wu16 906.000000000 DFC_Verb 0.00 906.000000000 FORMAT "%13.9" /end CHARACTERISTIC
/begin CHARACTERISTIC DFES_GrpRpr.DFC_BrkRdntSwtNotStpWarnLmp_C "common MIL debouncing / group representative for common MIL debouncing of DFC_BrkRdntSwtNotStpWarnLmp" VALUE 0x805054DC Val_Wu16 906.000000000 DFC_Verb 0.00 906.000000000 FORMAT "%13.9" /end CHARACTERISTIC
/begin CHARACTERISTIC DFES_GrpRpr.DFC_CEngDsTColdStrtMax_C "common MIL debouncing / group representative for common MIL debouncing of DFC_CEngDsTColdStrtMax" VALUE 0x805054DE Val_Wu16 906.000000000 DFC_Verb 0.00 906.000000000 FORMAT "%13.9" /end CHARACTERISTIC
/begin CHARACTERISTIC DFES_GrpRpr.DFC_CEngDsTColdStrtMin_C "common MIL debouncing / group representative for common MIL debouncing of DFC_CEngDsTColdStrtMin" VALUE 0x805054E0 Val_Wu16 906.000000000 DFC_Verb 0.00 906.000000000 FORMAT "%13.9" /end CHARACTERISTIC
/begin CHARACTERISTIC DFES_GrpRpr.DFC_CEngDsTImps_C "common MIL debouncing / group representative for common MIL debouncing of DFC_CEngDsTImps" VALUE 0x805054E2 Val_Wu16 906.000000000 DFC_Verb 0.00 906.000000000 FORMAT "%13.9" /end CHARACTERISTIC
/begin CHARACTERISTIC DFES_GrpRpr.DFC_CEngDsTPlausHSC_C "common MIL debouncing / group representative for common MIL debouncing of DFC_CEngDsTPlausHSC" VALUE 0x805054E4 Val_Wu16 906.000000000 DFC_Verb 0.00 906.000000000 FORMAT "%13.9" /end CHARACTERISTIC
/begin CHARACTERISTIC DFES_GrpRpr.DFC_CEngDsTPlausLSC_C "common MIL debouncing / group representative for common MIL debouncing of DFC_CEngDsTPlausLSC" VALUE 0x805054E6 Val_Wu16 906.000000000 DFC_Verb 0.00 906.000000000 FORMAT "%13.9" /end CHARACTERISTIC
/begin CHARACTERISTIC DFES_GrpRpr.DFC_CEngDsTPlausSTC_C "common MIL debouncing / group representative for common MIL debouncing of DFC_CEngDsTPlausSTC" VALUE 0x805054E8 Val_Wu16 906.000000000 DFC_Verb 0.00 906.000000000 FORMAT "%13.9" /end CHARACTERISTIC
/begin CHARACTERISTIC DFES_GrpRpr.DFC_CEngDsTSRCMax_C "common MIL debouncing / group representative for common MIL debouncing of DFC_CEngDsTSRCMax" VALUE 0x805054EA Val_Wu16 906.000000000 DFC_Verb 0.00 906.000000000 FORMAT "%13.9" /end CHARACTERISTIC
/begin CHARACTERISTIC DFES_GrpRpr.DFC_CEngDsTSRCMin_C "common MIL debouncing / group representative for common MIL debouncing of DFC_CEngDsTSRCMin" VALUE 0x805054EC Val_Wu16 906.000000000 DFC_Verb 0.00 906.000000000 FORMAT "%13.9" /end CHARACTERISTIC
/begin CHARACTERISTIC DFES_GrpRpr.DFC_CEngDsTSig_C "common MIL debouncing / group representative for common MIL debouncing of DFC_CEngDsTSig" VALUE 0x805054EE Val_Wu16 906.000000000 DFC_Verb 0.00 906.000000000 FORMAT "%13.9" /end CHARACTERISTIC
/begin CHARACTERISTIC DFES_GrpRpr.DFC_CEngUsTColdStrtMax_C "common MIL debouncing / group representative for common MIL debouncing of DFC_CEngUsTColdStrtMax" VALUE 0x805054F0 Val_Wu16 906.000000000 DFC_Verb 0.00 906.000000000 FORMAT "%13.9" /end CHARACTERISTIC
/begin CHARACTERISTIC DFES_GrpRpr.DFC_CEngUsTColdStrtMin_C "common MIL debouncing / group representative for common MIL debouncing of DFC_CEngUsTColdStrtMin" VALUE 0x805054F2 Val_Wu16 906.000000000 DFC_Verb 0.00 906.000000000 FORMAT "%13.9" /end CHARACTERISTIC
/begin CHARACTERISTIC DFES_GrpRpr.DFC_CEngUsTLooseCnctn_C "common MIL debouncing / group representative for common MIL debouncing of DFC_CEngUsTLooseCnctn" VALUE 0x805054F4 Val_Wu16 906.000000000 DFC_Verb 0.00 906.000000000 FORMAT "%13.9" /end CHARACTERISTIC
/begin CHARACTERISTIC DFES_GrpRpr.DFC_CEngUsTSRCMax_C "common MIL debouncing / group representative for common MIL debouncing of DFC_CEngUsTSRCMax" VALUE 0x805054F6 Val_Wu16 906.000000000 DFC_Verb 0.00 906.000000000 FORMAT "%13.9" /end CHARACTERISTIC
/begin CHARACTERISTIC DFES_GrpRpr.DFC_CEngUsTSRCMin_C "common MIL debouncing / group representative for common MIL debouncing of DFC_CEngUsTSRCMin" VALUE 0x805054F8 Val_Wu16 906.000000000 DFC_Verb 0.00 906.000000000 FORMAT "%13.9" /end CHARACTERISTIC
/begin CHARACTERISTIC DFES_GrpRpr.DFC_ComDCDCACCFailr_C "common MIL debouncing / group representative for common MIL debouncing of DFC_ComDCDCACCFailr" VALUE 0x805054FA Val_Wu16 906.000000000 DFC_Verb 0.00 906.000000000 FORMAT "%13.9" /end CHARACTERISTIC
/begin CHARACTERISTIC DFES_GrpRpr.DFC_DCDCFltDet_C "common MIL debouncing / group representative for common MIL debouncing of DFC_DCDCFltDet" VALUE 0x805054FC Val_Wu16 906.000000000 DFC_Verb 0.00 906.000000000 FORMAT "%13.9" /end CHARACTERISTIC
/begin CHARACTERISTIC DFES_GrpRpr.DFC_DKRSA_C "common MIL debouncing / group representative for common MIL debouncing of DFC_DKRSA" VALUE 0x805054FE Val_Wu16 906.000000000 DFC_Verb 0.00 906.000000000 FORMAT "%13.9" /end CHARACTERISTIC
/begin CHARACTERISTIC DFES_GrpRpr.DFC_DKVSmax_C "common MIL debouncing / group representative for common MIL debouncing of DFC_DKVSmax" VALUE 0x80505500 Val_Wu16 906.000000000 DFC_Verb 0.00 906.000000000 FORMAT "%13.9" /end CHARACTERISTIC
/begin CHARACTERISTIC DFES_GrpRpr.DFC_DKnpl_C "common MIL debouncing / group representative for common MIL debouncing of DFC_DKnpl" VALUE 0x80505502 Val_Wu16 906.000000000 DFC_Verb 0.00 906.000000000 FORMAT "%13.9" /end CHARACTERISTIC
/begin CHARACTERISTIC DFES_GrpRpr.DFC_DSKVRmax_C "common MIL debouncing / group representative for common MIL debouncing of DFC_DSKVRmax" VALUE 0x80505504 Val_Wu16 906.000000000 DFC_Verb 0.00 906.000000000 FORMAT "%13.9" /end CHARACTERISTIC
/begin CHARACTERISTIC DFES_GrpRpr.DFC_DSKVRmin_C "common MIL debouncing / group representative for common MIL debouncing of DFC_DSKVRmin" VALUE 0x80505506 Val_Wu16 906.000000000 DFC_Verb 0.00 906.000000000 FORMAT "%13.9" /end CHARACTERISTIC
/begin CHARACTERISTIC DFES_GrpRpr.DFC_DSKVRnpl_C "common MIL debouncing / group representative for common MIL debouncing of DFC_DSKVRnpl" VALUE 0x80505508 Val_Wu16 906.000000000 DFC_Verb 0.00 906.000000000 FORMAT "%13.9" /end CHARACTERISTIC
/begin CHARACTERISTIC DFES_GrpRpr.DFC_DSKVRsig_C "common MIL debouncing / group representative for common MIL debouncing of DFC_DSKVRsig" VALUE 0x8050550A Val_Wu16 906.000000000 DFC_Verb 0.00 906.000000000 FORMAT "%13.9" /end CHARACTERISTIC
/begin CHARACTERISTIC DFES_GrpRpr.DFC_DSKVSsig_C "common MIL debouncing / group representative for common MIL debouncing of DFC_DSKVSsig" VALUE 0x8050550C Val_Wu16 906.000000000 DFC_Verb 0.00 906.000000000 FORMAT "%13.9" /end CHARACTERISTIC
/begin CHARACTERISTIC DFES_GrpRpr.DFC_DSSmax_C "common MIL debouncing / group representative for common MIL debouncing of DFC_DSSmax" VALUE 0x8050550E Val_Wu16 906.000000000 DFC_Verb 0.00 906.000000000 FORMAT "%13.9" /end CHARACTERISTIC
/begin CHARACTERISTIC DFES_GrpRpr.DFC_DSTDmax_C "common MIL debouncing / group representative for common MIL debouncing of DFC_DSTDmax" VALUE 0x80505510 Val_Wu16 906.000000000 DFC_Verb 0.00 906.000000000 FORMAT "%13.9" /end CHARACTERISTIC
/begin CHARACTERISTIC DFES_GrpRpr.DFC_DSTEmax_C "common MIL debouncing / group representative for common MIL debouncing of DFC_DSTEmax" VALUE 0x80505512 Val_Wu16 906.000000000 DFC_Verb 0.00 906.000000000 FORMAT "%13.9" /end CHARACTERISTIC
/begin CHARACTERISTIC DFES_GrpRpr.DFC_DSTEmin_C "common MIL debouncing / group representative for common MIL debouncing of DFC_DSTEmin" VALUE 0x80505514 Val_Wu16 906.000000000 DFC_Verb 0.00 906.000000000 FORMAT "%13.9" /end CHARACTERISTIC
/begin CHARACTERISTIC DFES_GrpRpr.DFC_DSTOFmax_C "common MIL debouncing / group representative for common MIL debouncing of DFC_DSTOFmax" VALUE 0x80505516 Val_Wu16 906.000000000 DFC_Verb 0.00 906.000000000 FORMAT "%13.9" /end CHARACTERISTIC
/begin CHARACTERISTIC DFES_GrpRpr.DFC_DSTRmax_C "common MIL debouncing / group representative for common MIL debouncing of DFC_DSTRmax" VALUE 0x80505518 Val_Wu16 906.000000000 DFC_Verb 0.00 906.000000000 FORMAT "%13.9" /end CHARACTERISTIC
/begin CHARACTERISTIC DFES_GrpRpr.DFC_DSTRmin_C "common MIL debouncing / group representative for common MIL debouncing of DFC_DSTRmin" VALUE 0x8050551A Val_Wu16 906.000000000 DFC_Verb 0.00 906.000000000 FORMAT "%13.9" /end CHARACTERISTIC
/begin CHARACTERISTIC DFES_GrpRpr.DFC_DSTRnpl_C "common MIL debouncing / group representative for common MIL debouncing of DFC_DSTRnpl" VALUE 0x8050551C Val_Wu16 906.000000000 DFC_Verb 0.00 906.000000000 FORMAT "%13.9" /end CHARACTERISTIC
/begin CHARACTERISTIC DFES_GrpRpr.DFC_DSTRsig_C "common MIL debouncing / group representative for common MIL debouncing of DFC_DSTRsig" VALUE 0x8050551E Val_Wu16 906.000000000 DFC_Verb 0.00 906.000000000 FORMAT "%13.9" /end CHARACTERISTIC
/begin CHARACTERISTIC DFES_GrpRpr.DFC_DSTTI_C "common MIL debouncing / group representative for common MIL debouncing of DFC_DSTTI" VALUE 0x80505520 Val_Wu16 906.000000000 DFC_Verb 0.00 906.000000000 FORMAT "%13.9" /end CHARACTERISTIC
/begin CHARACTERISTIC DFES_GrpRpr.DFC_DSUmax_C "common MIL debouncing / group representative for common MIL debouncing of DFC_DSUmax" VALUE 0x80505522 Val_Wu16 906.000000000 DFC_Verb 0.00 906.000000000 FORMAT "%13.9" /end CHARACTERISTIC
/begin CHARACTERISTIC DFES_GrpRpr.DFC_DiagCpv1DteskLoLoadStuckClsd_C "common MIL debouncing / group representative for common MIL debouncing of DFC_DiagCpv1DteskLoLoadStuckClsd" VALUE 0x80505524 Val_Wu16 906.000000000 DFC_Verb 0.00 906.000000000 FORMAT "%13.9" /end CHARACTERISTIC
/begin CHARACTERISTIC DFES_GrpRpr.DFC_DiagCpv1DteskLoLoadStuckOpen_C "common MIL debouncing / group representative for common MIL debouncing of DFC_DiagCpv1DteskLoLoadStuckOpen" VALUE 0x80505526 Val_Wu16 906.000000000 DFC_Verb 0.00 906.000000000 FORMAT "%13.9" /end CHARACTERISTIC
/begin CHARACTERISTIC DFES_GrpRpr.DFC_EGRVlvDrftClsd_C "common MIL debouncing / group representative for common MIL debouncing of DFC_EGRVlvDrftClsd" VALUE 0x80505528 Val_Wu16 906.000000000 DFC_Verb 0.00 906.000000000 FORMAT "%13.9" /end CHARACTERISTIC
/begin CHARACTERISTIC DFES_GrpRpr.DFC_EGRVlvDrftOpn_C "common MIL debouncing / group representative for common MIL debouncing of DFC_EGRVlvDrftOpn" VALUE 0x8050552A Val_Wu16 906.000000000 DFC_Verb 0.00 906.000000000 FORMAT "%13.9" /end CHARACTERISTIC
/begin CHARACTERISTIC DFES_GrpRpr.DFC_EGRVlvJamVlvClsd_C "common MIL debouncing / group representative for common MIL debouncing of DFC_EGRVlvJamVlvClsd" VALUE 0x8050552C Val_Wu16 906.000000000 DFC_Verb 0.00 906.000000000 FORMAT "%13.9" /end CHARACTERISTIC
/begin CHARACTERISTIC DFES_GrpRpr.DFC_EGRVlvJamVlvOpn_C "common MIL debouncing / group representative for common MIL debouncing of DFC_EGRVlvJamVlvOpn" VALUE 0x8050552E Val_Wu16 906.000000000 DFC_Verb 0.00 906.000000000 FORMAT "%13.9" /end CHARACTERISTIC
/begin CHARACTERISTIC DFES_GrpRpr.DFC_EGRVlvSprgBrk_C "common MIL debouncing / group representative for common MIL debouncing of DFC_EGRVlvSprgBrk" VALUE 0x80505530 Val_Wu16 906.000000000 DFC_Verb 0.00 906.000000000 FORMAT "%13.9" /end CHARACTERISTIC
/begin CHARACTERISTIC DFES_GrpRpr.DFC_EGRVlvTempMdlEEPErr_C "common MIL debouncing / group representative for common MIL debouncing of DFC_EGRVlvTempMdlEEPErr" VALUE 0x80505532 Val_Wu16 906.000000000 DFC_Verb 0.00 906.000000000 FORMAT "%13.9" /end CHARACTERISTIC
/begin CHARACTERISTIC DFES_GrpRpr.DFC_EGRVlvTmpErr_C "common MIL debouncing / group representative for common MIL debouncing of DFC_EGRVlvTmpErr" VALUE 0x80505534 Val_Wu16 906.000000000 DFC_Verb 0.00 906.000000000 FORMAT "%13.9" /end CHARACTERISTIC
/begin CHARACTERISTIC DFES_GrpRpr.DFC_EGSDUS2B1LtrDly_C "common MIL debouncing / group representative for common MIL debouncing of DFC_EGSDUS2B1LtrDly" VALUE 0x80505536 Val_Wu16 906.000000000 DFC_Verb 0.00 906.000000000 FORMAT "%13.9" /end CHARACTERISTIC
/begin CHARACTERISTIC DFES_GrpRpr.DFC_EGSDUS2B1LtrPT1_C "common MIL debouncing / group representative for common MIL debouncing of DFC_EGSDUS2B1LtrPT1" VALUE 0x80505538 Val_Wu16 906.000000000 DFC_Verb 0.00 906.000000000 FORMAT "%13.9" /end CHARACTERISTIC
/begin CHARACTERISTIC DFES_GrpRpr.DFC_EGSDUS2B1RtlDly_C "common MIL debouncing / group representative for common MIL debouncing of DFC_EGSDUS2B1RtlDly" VALUE 0x8050553A Val_Wu16 906.000000000 DFC_Verb 0.00 906.000000000 FORMAT "%13.9" /end CHARACTERISTIC
/begin CHARACTERISTIC DFES_GrpRpr.DFC_EGSDUS2B1RtlPT1_C "common MIL debouncing / group representative for common MIL debouncing of DFC_EGSDUS2B1RtlPT1" VALUE 0x8050553C Val_Wu16 906.000000000 DFC_Verb 0.00 906.000000000 FORMAT "%13.9" /end CHARACTERISTIC
/begin CHARACTERISTIC DFES_GrpRpr.DFC_EGSDUS2B1TarLean_C "common MIL debouncing / group representative for common MIL debouncing of DFC_EGSDUS2B1TarLean" VALUE 0x8050553E Val_Wu16 906.000000000 DFC_Verb 0.00 906.000000000 FORMAT "%13.9" /end CHARACTERISTIC
/begin CHARACTERISTIC DFES_GrpRpr.DFC_EGSDUS2B1TarRich_C "common MIL debouncing / group representative for common MIL debouncing of DFC_EGSDUS2B1TarRich" VALUE 0x80505540 Val_Wu16 906.000000000 DFC_Verb 0.00 906.000000000 FORMAT "%13.9" /end CHARACTERISTIC
/begin CHARACTERISTIC DFES_GrpRpr.DFC_EONVmax_C "common MIL debouncing / group representative for common MIL debouncing of DFC_EONVmax" VALUE 0x80505542 Val_Wu16 906.000000000 DFC_Verb 0.00 906.000000000 FORMAT "%13.9" /end CHARACTERISTIC
/begin CHARACTERISTIC DFES_GrpRpr.DFC_ETAKHLmax_C "common MIL debouncing / group representative for common MIL debouncing of DFC_ETAKHLmax" VALUE 0x80505544 Val_Wu16 906.000000000 DFC_Verb 0.00 906.000000000 FORMAT "%13.9" /end CHARACTERISTIC
/begin CHARACTERISTIC DFES_GrpRpr.DFC_ETAKHTmax_C "common MIL debouncing / group representative for common MIL debouncing of DFC_ETAKHTmax" VALUE 0x80505546 Val_Wu16 906.000000000 DFC_Verb 0.00 906.000000000 FORMAT "%13.9" /end CHARACTERISTIC
/begin CHARACTERISTIC DFES_GrpRpr.DFC_ETHSEmax_C "common MIL debouncing / group representative for common MIL debouncing of DFC_ETHSEmax" VALUE 0x80505548 Val_Wu16 906.000000000 DFC_Verb 0.00 906.000000000 FORMAT "%13.9" /end CHARACTERISTIC
/begin CHARACTERISTIC DFES_GrpRpr.DFC_ETHSEmin_C "common MIL debouncing / group representative for common MIL debouncing of DFC_ETHSEmin" VALUE 0x8050554A Val_Wu16 906.000000000 DFC_Verb 0.00 906.000000000 FORMAT "%13.9" /end CHARACTERISTIC
/begin CHARACTERISTIC DFES_GrpRpr.DFC_ETHSFmax_C "common MIL debouncing / group representative for common MIL debouncing of DFC_ETHSFmax" VALUE 0x8050554C Val_Wu16 906.000000000 DFC_Verb 0.00 906.000000000 FORMAT "%13.9" /end CHARACTERISTIC
/begin CHARACTERISTIC DFES_GrpRpr.DFC_ETHSFmin_C "common MIL debouncing / group representative for common MIL debouncing of DFC_ETHSFmin" VALUE 0x8050554E Val_Wu16 906.000000000 DFC_Verb 0.00 906.000000000 FORMAT "%13.9" /end CHARACTERISTIC
/begin CHARACTERISTIC DFES_GrpRpr.DFC_ETHSFsig_C "common MIL debouncing / group representative for common MIL debouncing of DFC_ETHSFsig" VALUE 0x80505550 Val_Wu16 906.000000000 DFC_Verb 0.00 906.000000000 FORMAT "%13.9" /end CHARACTERISTIC
/begin CHARACTERISTIC DFES_GrpRpr.DFC_ETHSNPWmax_C "common MIL debouncing / group representative for common MIL debouncing of DFC_ETHSNPWmax" VALUE 0x80505552 Val_Wu16 906.000000000 DFC_Verb 0.00 906.000000000 FORMAT "%13.9" /end CHARACTERISTIC
/begin CHARACTERISTIC DFES_GrpRpr.DFC_ETHSNPWmin_C "common MIL debouncing / group representative for common MIL debouncing of DFC_ETHSNPWmin" VALUE 0x80505554 Val_Wu16 906.000000000 DFC_Verb 0.00 906.000000000 FORMAT "%13.9" /end CHARACTERISTIC
/begin CHARACTERISTIC DFES_GrpRpr.DFC_ETHSNPWsig_C "common MIL debouncing / group representative for common MIL debouncing of DFC_ETHSNPWsig" VALUE 0x80505556 Val_Wu16 906.000000000 DFC_Verb 0.00 906.000000000 FORMAT "%13.9" /end CHARACTERISTIC
/begin CHARACTERISTIC DFES_GrpRpr.DFC_ETHSPLnpl_C "common MIL debouncing / group representative for common MIL debouncing of DFC_ETHSPLnpl" VALUE 0x80505558 Val_Wu16 906.000000000 DFC_Verb 0.00 906.000000000 FORMAT "%13.9" /end CHARACTERISTIC
/begin CHARACTERISTIC DFES_GrpRpr.DFC_ETHSTPLnpl_C "common MIL debouncing / group representative for common MIL debouncing of DFC_ETHSTPLnpl" VALUE 0x8050555A Val_Wu16 906.000000000 DFC_Verb 0.00 906.000000000 FORMAT "%13.9" /end CHARACTERISTIC
/begin CHARACTERISTIC DFES_GrpRpr.DFC_EngICO_C "common MIL debouncing / group representative for common MIL debouncing of DFC_EngICO" VALUE 0x8050555C Val_Wu16 906.000000000 DFC_Verb 0.00 906.000000000 FORMAT "%13.9" /end CHARACTERISTIC
/begin CHARACTERISTIC DFES_GrpRpr.DFC_EngPrtOvrSpdMon_C "common MIL debouncing / group representative for common MIL debouncing of DFC_EngPrtOvrSpdMon" VALUE 0x8050555E Val_Wu16 906.000000000 DFC_Verb 0.00 906.000000000 FORMAT "%13.9" /end CHARACTERISTIC
/begin CHARACTERISTIC DFES_GrpRpr.DFC_EpmCaSI1ErrSig_C "common MIL debouncing / group representative for common MIL debouncing of DFC_EpmCaSI1ErrSig" VALUE 0x80505560 Val_Wu16 906.000000000 DFC_Verb 0.00 906.000000000 FORMAT "%13.9" /end CHARACTERISTIC
/begin CHARACTERISTIC DFES_GrpRpr.DFC_EpmCaSI1MntErr_C "common MIL debouncing / group representative for common MIL debouncing of DFC_EpmCaSI1MntErr" VALUE 0x80505562 Val_Wu16 906.000000000 DFC_Verb 0.00 906.000000000 FORMAT "%13.9" /end CHARACTERISTIC
/begin CHARACTERISTIC DFES_GrpRpr.DFC_EpmCaSI1NoSigMax_C "common MIL debouncing / group representative for common MIL debouncing of DFC_EpmCaSI1NoSigMax" VALUE 0x80505564 Val_Wu16 906.000000000 DFC_Verb 0.00 906.000000000 FORMAT "%13.9" /end CHARACTERISTIC
/begin CHARACTERISTIC DFES_GrpRpr.DFC_EpmCaSI1NoSigMin_C "common MIL debouncing / group representative for common MIL debouncing of DFC_EpmCaSI1NoSigMin" VALUE 0x80505566 Val_Wu16 906.000000000 DFC_Verb 0.00 906.000000000 FORMAT "%13.9" /end CHARACTERISTIC
/begin CHARACTERISTIC DFES_GrpRpr.DFC_EpmCaSI1OfsErr_C "common MIL debouncing / group representative for common MIL debouncing of DFC_EpmCaSI1OfsErr" VALUE 0x80505568 Val_Wu16 906.000000000 DFC_Verb 0.00 906.000000000 FORMAT "%13.9" /end CHARACTERISTIC
/begin CHARACTERISTIC DFES_GrpRpr.DFC_EpmCrSDGI_C "common MIL debouncing / group representative for common MIL debouncing of DFC_EpmCrSDGI" VALUE 0x8050556A Val_Wu16 906.000000000 DFC_Verb 0.00 906.000000000 FORMAT "%13.9" /end CHARACTERISTIC
/begin CHARACTERISTIC DFES_GrpRpr.DFC_EpmCrSErrSig_C "common MIL debouncing / group representative for common MIL debouncing of DFC_EpmCrSErrSig" VALUE 0x8050556C Val_Wu16 906.000000000 DFC_Verb 0.00 906.000000000 FORMAT "%13.9" /end CHARACTERISTIC
/begin CHARACTERISTIC DFES_GrpRpr.DFC_EpmCrSNoSig_C "common MIL debouncing / group representative for common MIL debouncing of DFC_EpmCrSNoSig" VALUE 0x8050556E Val_Wu16 906.000000000 DFC_Verb 0.00 906.000000000 FORMAT "%13.9" /end CHARACTERISTIC
/begin CHARACTERISTIC DFES_GrpRpr.DFC_EtaEngIdleNonCsers_C "common MIL debouncing / group representative for common MIL debouncing of DFC_EtaEngIdleNonCsers" VALUE 0x80505570 Val_Wu16 906.000000000 DFC_Verb 0.00 906.000000000 FORMAT "%13.9" /end CHARACTERISTIC
/begin CHARACTERISTIC DFES_GrpRpr.DFC_EtaEngPtlNonCsers_C "common MIL debouncing / group representative for common MIL debouncing of DFC_EtaEngPtlNonCsers" VALUE 0x80505572 Val_Wu16 906.000000000 DFC_Verb 0.00 906.000000000 FORMAT "%13.9" /end CHARACTERISTIC
/begin CHARACTERISTIC DFES_GrpRpr.DFC_FRAmax_C "common MIL debouncing / group representative for common MIL debouncing of DFC_FRAmax" VALUE 0x80505574 Val_Wu16 906.000000000 DFC_Verb 0.00 906.000000000 FORMAT "%13.9" /end CHARACTERISTIC
/begin CHARACTERISTIC DFES_GrpRpr.DFC_FRAmin_C "common MIL debouncing / group representative for common MIL debouncing of DFC_FRAmin" VALUE 0x80505576 Val_Wu16 906.000000000 DFC_Verb 0.00 906.000000000 FORMAT "%13.9" /end CHARACTERISTIC
/begin CHARACTERISTIC DFES_GrpRpr.DFC_FSTEmax_C "common MIL debouncing / group representative for common MIL debouncing of DFC_FSTEmax" VALUE 0x80505578 Val_Wu16 906.000000000 DFC_Verb 0.00 906.000000000 FORMAT "%13.9" /end CHARACTERISTIC
/begin CHARACTERISTIC DFES_GrpRpr.DFC_FSTEmin_C "common MIL debouncing / group representative for common MIL debouncing of DFC_FSTEmin" VALUE 0x8050557A Val_Wu16 906.000000000 DFC_Verb 0.00 906.000000000 FORMAT "%13.9" /end CHARACTERISTIC
/begin CHARACTERISTIC DFES_GrpRpr.DFC_FSTRmax_C "common MIL debouncing / group representative for common MIL debouncing of DFC_FSTRmax" VALUE 0x8050557C Val_Wu16 906.000000000 DFC_Verb 0.00 906.000000000 FORMAT "%13.9" /end CHARACTERISTIC
/begin CHARACTERISTIC DFES_GrpRpr.DFC_FSTRmin_C "common MIL debouncing / group representative for common MIL debouncing of DFC_FSTRmin" VALUE 0x8050557E Val_Wu16 906.000000000 DFC_Verb 0.00 906.000000000 FORMAT "%13.9" /end CHARACTERISTIC
/begin CHARACTERISTIC DFES_GrpRpr.DFC_FSTRnpl_C "common MIL debouncing / group representative for common MIL debouncing of DFC_FSTRnpl" VALUE 0x80505580 Val_Wu16 906.000000000 DFC_Verb 0.00 906.000000000 FORMAT "%13.9" /end CHARACTERISTIC
/begin CHARACTERISTIC DFES_GrpRpr.DFC_FSTmax_C "common MIL debouncing / group representative for common MIL debouncing of DFC_FSTmax" VALUE 0x80505582 Val_Wu16 906.000000000 DFC_Verb 0.00 906.000000000 FORMAT "%13.9" /end CHARACTERISTIC
/begin CHARACTERISTIC DFES_GrpRpr.DFC_FTDLAmax_C "common MIL debouncing / group representative for common MIL debouncing of DFC_FTDLAmax" VALUE 0x80505584 Val_Wu16 906.000000000 DFC_Verb 0.00 906.000000000 FORMAT "%13.9" /end CHARACTERISTIC
/begin CHARACTERISTIC DFES_GrpRpr.DFC_FTDLAmin_C "common MIL debouncing / group representative for common MIL debouncing of DFC_FTDLAmin" VALUE 0x80505586 Val_Wu16 906.000000000 DFC_Verb 0.00 906.000000000 FORMAT "%13.9" /end CHARACTERISTIC
/begin CHARACTERISTIC DFES_GrpRpr.DFC_FuPHiSnsrEleclmax_C "common MIL debouncing / group representative for common MIL debouncing of DFC_FuPHiSnsrEleclmax" VALUE 0x80505588 Val_Wu16 906.000000000 DFC_Verb 0.00 906.000000000 FORMAT "%13.9" /end CHARACTERISTIC
/begin CHARACTERISTIC DFES_GrpRpr.DFC_FuPHiSnsrEleclmin_C "common MIL debouncing / group representative for common MIL debouncing of DFC_FuPHiSnsrEleclmin" VALUE 0x8050558A Val_Wu16 906.000000000 DFC_Verb 0.00 906.000000000 FORMAT "%13.9" /end CHARACTERISTIC
/begin CHARACTERISTIC DFES_GrpRpr.DFC_FuPHiSnsrEleclnpl_C "common MIL debouncing / group representative for common MIL debouncing of DFC_FuPHiSnsrEleclnpl" VALUE 0x8050558C Val_Wu16 906.000000000 DFC_Verb 0.00 906.000000000 FORMAT "%13.9" /end CHARACTERISTIC
/begin CHARACTERISTIC DFES_GrpRpr.DFC_FuPHiSnsrURngMax_C "common MIL debouncing / group representative for common MIL debouncing of DFC_FuPHiSnsrURngMax" VALUE 0x8050558E Val_Wu16 906.000000000 DFC_Verb 0.00 906.000000000 FORMAT "%13.9" /end CHARACTERISTIC
/begin CHARACTERISTIC DFES_GrpRpr.DFC_FuPHiSnsrURngMin_C "common MIL debouncing / group representative for common MIL debouncing of DFC_FuPHiSnsrURngMin" VALUE 0x80505590 Val_Wu16 906.000000000 DFC_Verb 0.00 906.000000000 FORMAT "%13.9" /end CHARACTERISTIC
/begin CHARACTERISTIC DFES_GrpRpr.DFC_FuSnsrPhyRngMaxErr_C "common MIL debouncing / group representative for common MIL debouncing of DFC_FuSnsrPhyRngMaxErr" VALUE 0x80505592 Val_Wu16 906.000000000 DFC_Verb 0.00 906.000000000 FORMAT "%13.9" /end CHARACTERISTIC
/begin CHARACTERISTIC DFES_GrpRpr.DFC_FuSnsrPhyRngMinErr_C "common MIL debouncing / group representative for common MIL debouncing of DFC_FuSnsrPhyRngMinErr" VALUE 0x80505594 Val_Wu16 906.000000000 DFC_Verb 0.00 906.000000000 FORMAT "%13.9" /end CHARACTERISTIC
/begin CHARACTERISTIC DFES_GrpRpr.DFC_GEVlvLockPinDiagIntkB1_C "common MIL debouncing / group representative for common MIL debouncing of DFC_GEVlvLockPinDiagIntkB1" VALUE 0x80505596 Val_Wu16 906.000000000 DFC_Verb 0.00 906.000000000 FORMAT "%13.9" /end CHARACTERISTIC
/begin CHARACTERISTIC DFES_GrpRpr.DFC_GEVlvPhaSlowIntkB1_C "common MIL debouncing / group representative for common MIL debouncing of DFC_GEVlvPhaSlowIntkB1" VALUE 0x80505598 Val_Wu16 906.000000000 DFC_Verb 0.00 906.000000000 FORMAT "%13.9" /end CHARACTERISTIC
/begin CHARACTERISTIC DFES_GrpRpr.DFC_GEVlvPhaTargIntkB1_C "common MIL debouncing / group representative for common MIL debouncing of DFC_GEVlvPhaTargIntkB1" VALUE 0x8050559A Val_Wu16 906.000000000 DFC_Verb 0.00 906.000000000 FORMAT "%13.9" /end CHARACTERISTIC
/begin CHARACTERISTIC DFES_GrpRpr.DFC_GbxRvsSwtStk_C "common MIL debouncing / group representative for common MIL debouncing of DFC_GbxRvsSwtStk" VALUE 0x8050559C Val_Wu16 906.000000000 DFC_Verb 0.00 906.000000000 FORMAT "%13.9" /end CHARACTERISTIC
/begin CHARACTERISTIC DFES_GrpRpr.DFC_HDRKHmax_C "common MIL debouncing / group representative for common MIL debouncing of DFC_HDRKHmax" VALUE 0x8050559E Val_Wu16 906.000000000 DFC_Verb 0.00 906.000000000 FORMAT "%13.9" /end CHARACTERISTIC
/begin CHARACTERISTIC DFES_GrpRpr.DFC_HDRKHmin_C "common MIL debouncing / group representative for common MIL debouncing of DFC_HDRKHmin" VALUE 0x805055A0 Val_Wu16 906.000000000 DFC_Verb 0.00 906.000000000 FORMAT "%13.9" /end CHARACTERISTIC
/begin CHARACTERISTIC DFES_GrpRpr.DFC_HDRPLmax_C "common MIL debouncing / group representative for common MIL debouncing of DFC_HDRPLmax" VALUE 0x805055A2 Val_Wu16 906.000000000 DFC_Verb 0.00 906.000000000 FORMAT "%13.9" /end CHARACTERISTIC
/begin CHARACTERISTIC DFES_GrpRpr.DFC_HDRPLmin_C "common MIL debouncing / group representative for common MIL debouncing of DFC_HDRPLmin" VALUE 0x805055A4 Val_Wu16 906.000000000 DFC_Verb 0.00 906.000000000 FORMAT "%13.9" /end CHARACTERISTIC
/begin CHARACTERISTIC DFES_GrpRpr.DFC_HDRmax_C "common MIL debouncing / group representative for common MIL debouncing of DFC_HDRmax" VALUE 0x805055A6 Val_Wu16 906.000000000 DFC_Verb 0.00 906.000000000 FORMAT "%13.9" /end CHARACTERISTIC
/begin CHARACTERISTIC DFES_GrpRpr.DFC_HDRmin_C "common MIL debouncing / group representative for common MIL debouncing of DFC_HDRmin" VALUE 0x805055A8 Val_Wu16 906.000000000 DFC_Verb 0.00 906.000000000 FORMAT "%13.9" /end CHARACTERISTIC
/begin CHARACTERISTIC DFES_GrpRpr.DFC_HEGOS2B1ElecMax_C "common MIL debouncing / group representative for common MIL debouncing of DFC_HEGOS2B1ElecMax" VALUE 0x805055AA Val_Wu16 906.000000000 DFC_Verb 0.00 906.000000000 FORMAT "%13.9" /end CHARACTERISTIC
/begin CHARACTERISTIC DFES_GrpRpr.DFC_HEGOS2B1ElecMin_C "common MIL debouncing / group representative for common MIL debouncing of DFC_HEGOS2B1ElecMin" VALUE 0x805055AC Val_Wu16 906.000000000 DFC_Verb 0.00 906.000000000 FORMAT "%13.9" /end CHARACTERISTIC
/begin CHARACTERISTIC DFES_GrpRpr.DFC_HEGOS2B1ElecSig_C "common MIL debouncing / group representative for common MIL debouncing of DFC_HEGOS2B1ElecSig" VALUE 0x805055AE Val_Wu16 906.000000000 DFC_Verb 0.00 906.000000000 FORMAT "%13.9" /end CHARACTERISTIC
/begin CHARACTERISTIC DFES_GrpRpr.DFC_HEGOS2B1HtgNpl_C "common MIL debouncing / group representative for common MIL debouncing of DFC_HEGOS2B1HtgNpl" VALUE 0x805055B0 Val_Wu16 906.000000000 DFC_Verb 0.00 906.000000000 FORMAT "%13.9" /end CHARACTERISTIC
/begin CHARACTERISTIC DFES_GrpRpr.DFC_HEV00max_C "common MIL debouncing / group representative for common MIL debouncing of DFC_HEV00max" VALUE 0x805055B2 Val_Wu16 906.000000000 DFC_Verb 0.00 906.000000000 FORMAT "%13.9" /end CHARACTERISTIC
/begin CHARACTERISTIC DFES_GrpRpr.DFC_HEV01max_C "common MIL debouncing / group representative for common MIL debouncing of DFC_HEV01max" VALUE 0x805055B4 Val_Wu16 906.000000000 DFC_Verb 0.00 906.000000000 FORMAT "%13.9" /end CHARACTERISTIC
/begin CHARACTERISTIC DFES_GrpRpr.DFC_HEV02max_C "common MIL debouncing / group representative for common MIL debouncing of DFC_HEV02max" VALUE 0x805055B6 Val_Wu16 906.000000000 DFC_Verb 0.00 906.000000000 FORMAT "%13.9" /end CHARACTERISTIC
/begin CHARACTERISTIC DFES_GrpRpr.DFC_HEV03max_C "common MIL debouncing / group representative for common MIL debouncing of DFC_HEV03max" VALUE 0x805055B8 Val_Wu16 906.000000000 DFC_Verb 0.00 906.000000000 FORMAT "%13.9" /end CHARACTERISTIC
/begin CHARACTERISTIC DFES_GrpRpr.DFC_HEVE0max_C "common MIL debouncing / group representative for common MIL debouncing of DFC_HEVE0max" VALUE 0x805055BA Val_Wu16 906.000000000 DFC_Verb 0.00 906.000000000 FORMAT "%13.9" /end CHARACTERISTIC
/begin CHARACTERISTIC DFES_GrpRpr.DFC_HEVE1max_C "common MIL debouncing / group representative for common MIL debouncing of DFC_HEVE1max" VALUE 0x805055BC Val_Wu16 906.000000000 DFC_Verb 0.00 906.000000000 FORMAT "%13.9" /end CHARACTERISTIC
/begin CHARACTERISTIC DFES_GrpRpr.DFC_HFMmax_C "common MIL debouncing / group representative for common MIL debouncing of DFC_HFMmax" VALUE 0x805055BE Val_Wu16 906.000000000 DFC_Verb 0.00 906.000000000 FORMAT "%13.9" /end CHARACTERISTIC
/begin CHARACTERISTIC DFES_GrpRpr.DFC_HiPSysHiPMaxLimExcdd_C "common MIL debouncing / group representative for common MIL debouncing of DFC_HiPSysHiPMaxLimExcdd" VALUE 0x805055C0 Val_Wu16 906.000000000 DFC_Verb 0.00 906.000000000 FORMAT "%13.9" /end CHARACTERISTIC
/begin CHARACTERISTIC DFES_GrpRpr.DFC_IVGdiCtlCvoErrMax_0_C "common MIL debouncing / group representative for common MIL debouncing of DFC_IVGdiCtlCvoErrMax_0" VALUE 0x805055C2 Val_Wu16 906.000000000 DFC_Verb 0.00 906.000000000 FORMAT "%13.9" /end CHARACTERISTIC
/begin CHARACTERISTIC DFES_GrpRpr.DFC_IVGdiCtlCvoErrMax_1_C "common MIL debouncing / group representative for common MIL debouncing of DFC_IVGdiCtlCvoErrMax_1" VALUE 0x805055C4 Val_Wu16 906.000000000 DFC_Verb 0.00 906.000000000 FORMAT "%13.9" /end CHARACTERISTIC
/begin CHARACTERISTIC DFES_GrpRpr.DFC_IVGdiCtlCvoErrMax_2_C "common MIL debouncing / group representative for common MIL debouncing of DFC_IVGdiCtlCvoErrMax_2" VALUE 0x805055C6 Val_Wu16 906.000000000 DFC_Verb 0.00 906.000000000 FORMAT "%13.9" /end CHARACTERISTIC
/begin CHARACTERISTIC DFES_GrpRpr.DFC_IVGdiCtlCvoErrMax_3_C "common MIL debouncing / group representative for common MIL debouncing of DFC_IVGdiCtlCvoErrMax_3" VALUE 0x805055C8 Val_Wu16 906.000000000 DFC_Verb 0.00 906.000000000 FORMAT "%13.9" /end CHARACTERISTIC
/begin CHARACTERISTIC DFES_GrpRpr.DFC_IVGdiCtlCvoErrMin_0_C "common MIL debouncing / group representative for common MIL debouncing of DFC_IVGdiCtlCvoErrMin_0" VALUE 0x805055CA Val_Wu16 906.000000000 DFC_Verb 0.00 906.000000000 FORMAT "%13.9" /end CHARACTERISTIC
/begin CHARACTERISTIC DFES_GrpRpr.DFC_IVGdiCtlCvoErrMin_1_C "common MIL debouncing / group representative for common MIL debouncing of DFC_IVGdiCtlCvoErrMin_1" VALUE 0x805055CC Val_Wu16 906.000000000 DFC_Verb 0.00 906.000000000 FORMAT "%13.9" /end CHARACTERISTIC
/begin CHARACTERISTIC DFES_GrpRpr.DFC_IVGdiCtlCvoErrMin_2_C "common MIL debouncing / group representative for common MIL debouncing of DFC_IVGdiCtlCvoErrMin_2" VALUE 0x805055CE Val_Wu16 906.000000000 DFC_Verb 0.00 906.000000000 FORMAT "%13.9" /end CHARACTERISTIC
/begin CHARACTERISTIC DFES_GrpRpr.DFC_IVGdiCtlCvoErrMin_3_C "common MIL debouncing / group representative for common MIL debouncing of DFC_IVGdiCtlCvoErrMin_3" VALUE 0x805055D0 Val_Wu16 906.000000000 DFC_Verb 0.00 906.000000000 FORMAT "%13.9" /end CHARACTERISTIC
/begin CHARACTERISTIC DFES_GrpRpr.DFC_IVGdiCtlCvoErrMinMax_C "common MIL debouncing / group representative for common MIL debouncing of DFC_IVGdiCtlCvoErrMinMax" VALUE 0x805055D2 Val_Wu16 906.000000000 DFC_Verb 0.00 906.000000000 FORMAT "%13.9" /end CHARACTERISTIC
/begin CHARACTERISTIC DFES_GrpRpr.DFC_IVGdiCtlCvoSigPlausErrSmrCdn_C "common MIL debouncing / group representative for common MIL debouncing of DFC_IVGdiCtlCvoSigPlausErrSmrCdn" VALUE 0x805055D4 Val_Wu16 906.000000000 DFC_Verb 0.00 906.000000000 FORMAT "%13.9" /end CHARACTERISTIC
/begin FUNCTION DFES "30000.73.0_2.0.0Diagnostic Fault Event Storage"
 /begin DEF_CHARACTERISTIC DFES_GrpRpr.DFC_ComAYCGRingCnt_C DFES_GrpRpr.DFC_ComAYCGTOut_C DFES_GrpRpr.DFC_ComAYCIChkSum_C DFES_GrpRpr.DFC_ComAYCIRingCnt_C DFES_GrpRpr.DFC_ComAYCITOut_C DFES_GrpRpr.DFC_ComBCM1ChkSum_C DFES_GrpRpr.DFC_ComBCM1RingCnt_C DFES_GrpRpr.DFC_ComBCM1TOut_C DFES_GrpRpr.DFC_ComCANABusOffErr_C DFES_GrpRpr.DFC_ComCANBBusOffErr_C DFES_GrpRpr.DFC_ComCANCBusOffErr_C DFES_GrpRpr.DFC_ComCGW1ChkSum_C DFES_GrpRpr.DFC_ComCGW1RingCnt_C DFES_GrpRpr.DFC_ComCGW1TOut_C DFES_GrpRpr.DFC_ComConvBoostErr_C DFES_GrpRpr.DFC_ComConvSlipErr_C DFES_GrpRpr.DFC_ComDCDCPrfmncErr_C DFES_GrpRpr.DFC_ComDCDCTempWarn_C DFES_GrpRpr.DFC_ComEAT10Chksum_C DFES_GrpRpr.DFC_ComEAT10RingCnt_C DFES_GrpRpr.DFC_ComEAT10TOut_C DFES_GrpRpr.DFC_ComEAT11ChkSum_C DFES_GrpRpr.DFC_ComEAT11RingCnt_C DFES_GrpRpr.DFC_ComEAT11TOut_C DFES_GrpRpr.DFC_ComEAT12ChkSum_C DFES_GrpRpr.DFC_ComEAT12RingCnt_C DFES_GrpRpr.DFC_ComEAT12TOut_C DFES_GrpRpr.DFC_ComEAT13ChkSum_C DFES_GrpRpr.DFC_ComEAT13RingCnt_C DFES_GrpRpr.DFC_ComEAT13TOut_C DFES_GrpRpr.DFC_ComEAT1Chksum_C DFES_GrpRpr.DFC_ComEAT1RingCnt_C DFES_GrpRpr.DFC_ComEAT1TOut_C DFES_GrpRpr.DFC_ComEAT2ChkSum_C DFES_GrpRpr.DFC_ComEAT2RingCnt_C DFES_GrpRpr.DFC_ComEAT2TOut_C DFES_GrpRpr.DFC_ComEAT4ChkSum_C DFES_GrpRpr.DFC_ComEAT4RingCnt_C DFES_GrpRpr.DFC_ComEAT4TOut_C DFES_GrpRpr.DFC_ComEAT6Chksum_C DFES_GrpRpr.DFC_ComEAT6RingCnt_C DFES_GrpRpr.DFC_ComEAT6TOut_C DFES_GrpRpr.DFC_ComEAT7Chksum_C DFES_GrpRpr.DFC_ComEAT7RingCnt_C DFES_GrpRpr.DFC_ComEAT7TOut_C DFES_GrpRpr.DFC_ComEAT8Chksum_C DFES_GrpRpr.DFC_ComEAT8RingCnt_C DFES_GrpRpr.DFC_ComEAT8TOut_C DFES_GrpRpr.DFC_ComEATAChksum_C DFES_GrpRpr.DFC_ComEATARingCnt_C DFES_GrpRpr.DFC_ComEATATOut_C DFES_GrpRpr.DFC_ComEATBChkSum_C DFES_GrpRpr.DFC_ComEATBRingCnt_C DFES_GrpRpr.DFC_ComEATBTOut_C DFES_GrpRpr.DFC_ComEATCChksum_C DFES_GrpRpr.DFC_ComEATCRingCnt_C DFES_GrpRpr.DFC_ComEATCTOut_C DFES_GrpRpr.DFC_ComEPBBChkSum_C DFES_GrpRpr.DFC_ComEPBBRingCnt_C DFES_GrpRpr.DFC_ComEPBBTOut_C DFES_GrpRpr.DFC_ComEPBChksum_C DFES_GrpRpr.DFC_ComEPBTOut_C DFES_GrpRpr.DFC_ComEPBctRing_C DFES_GrpRpr.DFC_ComEPS1Chksum_C DFES_GrpRpr.DFC_ComEPS1RingCnt_C DFES_GrpRpr.DFC_ComEPS1TOut_C DFES_GrpRpr.DFC_ComEngCanRxErr_C DFES_GrpRpr.DFC_ComGrvySnsrErr_C DFES_GrpRpr.DFC_ComGwIMG1ChkSum_C DFES_GrpRpr.DFC_ComGwIMG1RingCnt_C DFES_GrpRpr.DFC_ComGwIMG1TOut_C DFES_GrpRpr.DFC_ComGwIMG3ChkSum_C DFES_GrpRpr.DFC_ComGwIMG3RingCnt_C DFES_GrpRpr.DFC_ComGwIMG3TOut_C DFES_GrpRpr.DFC_ComGwIMG4ChkSum_C DFES_GrpRpr.DFC_ComGwIMG4RingCnt_C DFES_GrpRpr.DFC_ComGwIMG4TOut_C DFES_GrpRpr.DFC_ComGwIMG5ChkSum_C DFES_GrpRpr.DFC_ComGwIMG5RingCnt_C DFES_GrpRpr.DFC_ComGwIMG5TOut_C DFES_GrpRpr.DFC_ComGwIMG6ChkSum_C DFES_GrpRpr.DFC_ComGwIMG6RingCnt_C DFES_GrpRpr.DFC_ComGwIMG6TOut_C DFES_GrpRpr.DFC_ComIDASBChksum_C DFES_GrpRpr.DFC_ComIDASBRingCnt_C DFES_GrpRpr.DFC_ComIDASBTOut_C DFES_GrpRpr.DFC_ComIMGMILReq_C DFES_GrpRpr.DFC_ComISSPrms_C DFES_GrpRpr.DFC_ComMETAChksum_C DFES_GrpRpr.DFC_ComMETAChksumPstDrv_C DFES_GrpRpr.DFC_ComMETARingCnt_C DFES_GrpRpr.DFC_ComMETARingCntPstDrv_C DFES_GrpRpr.DFC_ComMETATOut_C DFES_GrpRpr.DFC_ComMETATOutPstDrv_C DFES_GrpRpr.DFC_ComMETCChksum_C DFES_GrpRpr.DFC_ComMETCRingCnt_C DFES_GrpRpr.DFC_ComMETCTOut_C DFES_GrpRpr.DFC_ComMETDChksum_C DFES_GrpRpr.DFC_ComMETDRingCnt_C DFES_GrpRpr.DFC_ComMETDTOut_C DFES_GrpRpr.DFC_ComMETE2Chksum_C DFES_GrpRpr.DFC_ComMETE2RingCnt_C DFES_GrpRpr.DFC_ComMETE2TOut_C DFES_GrpRpr.DFC_ComMETFChksum_C DFES_GrpRpr.DFC_ComMETFRingCnt_C DFES_GrpRpr.DFC_ComMETFTOut_C DFES_GrpRpr.DFC_ComMETGChksum_C DFES_GrpRpr.DFC_ComMETGRingCnt_C DFES_GrpRpr.DFC_ComMETGTOut_C DFES_GrpRpr.DFC_ComMETH2Chksum_C DFES_GrpRpr.DFC_ComMETH2RingCnt_C DFES_GrpRpr.DFC_ComMETH2TOut_C DFES_GrpRpr.DFC_ComMETHChksum_C DFES_GrpRpr.DFC_ComMETHRingCnt_C DFES_GrpRpr.DFC_ComMETHTOut_C DFES_GrpRpr.DFC_ComMETIChksum_C DFES_GrpRpr.DFC_ComMETIRingCnt_C DFES_GrpRpr.DFC_ComMETITOut_C DFES_GrpRpr.DFC_ComMETKChksum_C DFES_GrpRpr.DFC_ComMETKRingCnt_C DFES_GrpRpr.DFC_ComMETKTOut_C DFES_GrpRpr.DFC_ComMETLChksum_C DFES_GrpRpr.DFC_ComMETLRingCnt_C DFES_GrpRpr.DFC_ComMETLTOut_C DFES_GrpRpr.DFC_ComMETMChksum_C DFES_GrpRpr.DFC_ComMETMRingCnt_C DFES_GrpRpr.DFC_ComMETMTOut_C DFES_GrpRpr.DFC_ComMETNChksum_C DFES_GrpRpr.DFC_ComMETNRingCnt_C DFES_GrpRpr.DFC_ComMETNTOut_C DFES_GrpRpr.DFC_ComMtrCom_C DFES_GrpRpr.DFC_ComPCUChkSum_C DFES_GrpRpr.DFC_ComPCURingCnt_C DFES_GrpRpr.DFC_ComPCUTOut_C DFES_GrpRpr.DFC_ComSRSAChksum_C DFES_GrpRpr.DFC_ComSRSARingCnt_C DFES_GrpRpr.DFC_ComSRSATOut_C DFES_GrpRpr.DFC_ComSRSBChksum_C DFES_GrpRpr.DFC_ComSRSBRingCnt_C DFES_GrpRpr.DFC_ComSRSBTOut_C DFES_GrpRpr.DFC_ComSRSChksum_C DFES_GrpRpr.DFC_ComSRSErr_C DFES_GrpRpr.DFC_ComSRSRingCnt_C DFES_GrpRpr.DFC_ComSRSTOut_C DFES_GrpRpr.DFC_ComVehSpdPndFltTCU_C DFES_GrpRpr.DFC_EbsChartcCurrErr_C DFES_GrpRpr.DFC_EbsSelfDiagErr_C DFES_GrpRpr.DFC_GEVlvPhaCsersIntkB1_C DFES_GrpRpr.DFC_GEVlvPhaPsOpenLoadIntkB1_C DFES_GrpRpr.DFC_GEVlvPhaPsShoToBattIntkB1_C DFES_GrpRpr.DFC_GEVlvPhaPsShoToGndIntkB1_C DFES_GrpRpr.DFC_GbxCANDigPlausErr_C DFES_GrpRpr.DFC_GbxNPos1SRCMax_C DFES_GrpRpr.DFC_GbxNPos1SRCMin_C DFES_GrpRpr.DFC_GbxNPos2SRCMax_C DFES_GrpRpr.DFC_GbxNPos2SRCMin_C DFES_GrpRpr.DFC_GbxNPosAlvChk_C DFES_GrpRpr.DFC_GbxNPosSyncErr_C DFES_GrpRpr.DFC_HEGOS2B1HtrPsMax_C DFES_GrpRpr.DFC_HEGOS2B1HtrPsMin_C DFES_GrpRpr.DFC_HEGOS2B1HtrPsSig_C DFES_GrpRpr.DFC_LinCSErrACG_C DFES_GrpRpr.DFC_LinCSErrAEV_C DFES_GrpRpr.DFC_LinCSErrDCDC_C DFES_GrpRpr.DFC_LinCSErrEBS_C DFES_GrpRpr.DFC_LinHdrTimeoutErrACG_C DFES_GrpRpr.DFC_LinHdrTimeoutErrAEV_C DFES_GrpRpr.DFC_LinHdrTimeoutErrDCDC_C DFES_GrpRpr.DFC_LinHdrTimeoutErrEBS_C DFES_GrpRpr.DFC_LinMsgTimeoutErrACG_C DFES_GrpRpr.DFC_LinMsgTimeoutErrAEV_C DFES_GrpRpr.DFC_LinMsgTimeoutErrDCDC_C DFES_GrpRpr.DFC_LinMsgTimeoutErrEBS_C DFES_GrpRpr.DFC_LinNoStrtComErr_C DFES_GrpRpr.DFC_LowPresOilP_C DFES_GrpRpr.DFC_MisfDetVWhlFrntLeOORHi_C DFES_GrpRpr.DFC_MisfDetVWhlFrntLeRatyHi_C DFES_GrpRpr.DFC_MisfDetVWhlFrntLeRatyLo_C DFES_GrpRpr.DFC_MisfDetVWhlFrntLeStuck_C DFES_GrpRpr.DFC_MisfDetVWhlFrntRiOORHi_C DFES_GrpRpr.DFC_MisfDetVWhlFrntRiRatyHi_C DFES_GrpRpr.DFC_MisfDetVWhlFrntRiRatyLo_C DFES_GrpRpr.DFC_MisfDetVWhlFrntRiStuck_C DFES_GrpRpr.DFC_MisfDetVWhlReLeOORHi_C DFES_GrpRpr.DFC_MisfDetVWhlReLeRatyHi_C DFES_GrpRpr.DFC_MisfDetVWhlReLeRatyLo_C DFES_GrpRpr.DFC_MisfDetVWhlReLeStuck_C DFES_GrpRpr.DFC_MisfDetVWhlReRiOORHi_C DFES_GrpRpr.DFC_MisfDetVWhlReRiRatyHi_C DFES_GrpRpr.DFC_MisfDetVWhlReRiRatyLo_C DFES_GrpRpr.DFC_MisfDetVWhlReRiStuck_C DFES_GrpRpr.DFC_MisfDetdVWhlFrntLePlaus_C DFES_GrpRpr.DFC_MisfDetdVWhlFrntRiPlaus_C DFES_GrpRpr.DFC_MisfDetdVWhlReLePlaus_C DFES_GrpRpr.DFC_MisfDetdVWhlReRiPlaus_C DFES_GrpRpr.DFC_PEnvSigRngMax_C DFES_GrpRpr.DFC_PEnvSigRngMin_C DFES_GrpRpr.DFC_StmFault_C DFES_GrpRpr.DFC_StrtCtOffPth_C DFES_GrpRpr.DFC_StrtCtlErr_C DFES_GrpRpr.DFC_StrtFault_C DFES_GrpRpr.DFC_StrtLckJudg1_C DFES_GrpRpr.DFC_StrtLckJudg2_C DFES_GrpRpr.DFC_StrtOL_C DFES_GrpRpr.DFC_StrtOL2_C DFES_GrpRpr.DFC_StrtSCB_C DFES_GrpRpr.DFC_StrtSCB2_C DFES_GrpRpr.DFC_StrtSCG_C DFES_GrpRpr.DFC_StrtSCG2_C DFES_GrpRpr.DFC_StrtStkRly1_C DFES_GrpRpr.DFC_StrtStkRly2_C DFES_GrpRpr.DFC_TEVEmax_C DFES_GrpRpr.DFC_TEVEmin_C DFES_GrpRpr.DFC_TEVEsig_C DFES_GrpRpr.DFC_UegoHeatrPrfmncLoS1B1_C DFES_GrpRpr.DFC_VehVAllPlaus_C DFES_GrpRpr.DFC_VehVNCSnsrElecFailr_C DFES_GrpRpr.DFC_VehVPlausCan_C DFES_GrpRpr.DFC_VehVPlausFco_C DFES_GrpRpr.DFC_VehVPlausPwr_C DFES_GrpRpr.DFC_VehVPlausV2N_C DFES_GrpRpr.DFC_VehVSpdSnsrAElecFailr_C DFES_GrpRpr.DFC_VehVSpdSnsrBElecFailr_C DFES_GrpRpr.DFC_ClthMax_C DFES_GrpRpr.DFC_IgnClPs_DevComErr_C DFES_GrpRpr.DFC_IgnClPs_LineOl_0_C DFES_GrpRpr.DFC_IgnClPs_LineOl_1_C DFES_GrpRpr.DFC_IgnClPs_LineOl_2_C DFES_GrpRpr.DFC_IgnClPs_LineOl_3_C DFES_GrpRpr.DFC_IgnClPs_LineScb_0_C DFES_GrpRpr.DFC_IgnClPs_LineScb_1_C DFES_GrpRpr.DFC_IgnClPs_LineScb_2_C DFES_GrpRpr.DFC_IgnClPs_LineScb_3_C DFES_GrpRpr.DFC_IgnClPs_LineScg_0_C DFES_GrpRpr.DFC_IgnClPs_LineScg_1_C DFES_GrpRpr.DFC_IgnClPs_LineScg_2_C DFES_GrpRpr.DFC_IgnClPs_LineScg_3_C DFES_GrpRpr.DFC_KRVEKOEVAB_C DFES_GrpRpr.DFC_KRVEKOEVAB0_C DFES_GrpRpr.DFC_KRVEKOEVAB1_C DFES_GrpRpr.DFC_KRVEKOEVAB2_C DFES_GrpRpr.DFC_KRVEKOEVAB3_C DFES_GrpRpr.DFC_UegoSigEcuAsicS1B1_C DFES_GrpRpr.DFC_UegoSigEcuComS1B1_C DFES_GrpRpr.DFC_UegoSigSnsrS1B1_C DFES_GrpRpr.DFC_UegoSigWireOlApesS1B1_C DFES_GrpRpr.DFC_UegoSigWireOlIpeS1B1_C DFES_GrpRpr.DFC_UegoSigWireOlReS1B1_C DFES_GrpRpr.DFC_UegoSigWireRCmpS1B1_C DFES_GrpRpr.DFC_UegoSigWireScbS1B1_C DFES_GrpRpr.DFC_UegoSigWireScgS1B1_C DFES_GrpRpr.DFC_AfsPhyRngHiB1_C DFES_GrpRpr.DFC_AfsPhyRngLoB1_C DFES_GrpRpr.DFC_AirCCmprOL_C DFES_GrpRpr.DFC_AirCCmprOvrTemp_C DFES_GrpRpr.DFC_AirCCmprSCB_C DFES_GrpRpr.DFC_AirCCmprSCG_C DFES_GrpRpr.DFC_AltErr_C DFES_GrpRpr.DFC_BattUSRCMax_C DFES_GrpRpr.DFC_BattUSRCMin_C DFES_GrpRpr.DFC_ComChksTCU1_C DFES_GrpRpr.DFC_ComChksTCU11_C DFES_GrpRpr.DFC_ComChksTCU12_C DFES_GrpRpr.DFC_ComChksTCU13_C DFES_GrpRpr.DFC_ComChksTCU2_C DFES_GrpRpr.DFC_ComChksTCU3_C DFES_GrpRpr.DFC_ComChksTCU4_C DFES_GrpRpr.DFC_ComCntTCU1_C DFES_GrpRpr.DFC_ComCntTCU11_C DFES_GrpRpr.DFC_ComCntTCU12_C DFES_GrpRpr.DFC_ComCntTCU13_C DFES_GrpRpr.DFC_ComCntTCU2_C DFES_GrpRpr.DFC_ComCntTCU3_C DFES_GrpRpr.DFC_ComCntTCU4_C DFES_GrpRpr.DFC_ComTOutTCU01_C DFES_GrpRpr.DFC_ComTOutTCU02_C DFES_GrpRpr.DFC_ComTOutTCU1_C DFES_GrpRpr.DFC_ComTOutTCU11_C DFES_GrpRpr.DFC_ComTOutTCU12_C DFES_GrpRpr.DFC_ComTOutTCU13_C DFES_GrpRpr.DFC_ComTOutTCU14_C DFES_GrpRpr.DFC_ComTOutTCU2_C DFES_GrpRpr.DFC_ComTOutTCU3_C DFES_GrpRpr.DFC_ComTOutTCU4_C DFES_GrpRpr.DFC_DevLibBattUHi_C DFES_GrpRpr.DFC_DevLibBattULo_C DFES_GrpRpr.DFC_EGRVlvFailSafeActv_C DFES_GrpRpr.DFC_EGRVlvGovDvtCld_C DFES_GrpRpr.DFC_EGRVlvPhysSRCMax_C DFES_GrpRpr.DFC_EGRVlvPhysSRCMin_C DFES_GrpRpr.DFC_FanDIOOL_0_C DFES_GrpRpr.DFC_FanDIOOL_1_C DFES_GrpRpr.DFC_FanDIOOvrTemp_0_C DFES_GrpRpr.DFC_FanDIOOvrTemp_1_C DFES_GrpRpr.DFC_FanDIOSCB_0_C DFES_GrpRpr.DFC_FanDIOSCB_1_C DFES_GrpRpr.DFC_FanDIOSCG_0_C DFES_GrpRpr.DFC_FanDIOSCG_1_C DFES_GrpRpr.DFC_MRlyDcOL_C DFES_GrpRpr.DFC_MRlyDcSCB_C DFES_GrpRpr.DFC_MRlyDcSCG_C DFES_GrpRpr.DFC_PSPOL_C DFES_GrpRpr.DFC_PSPOvrTemp_C DFES_GrpRpr.DFC_PSPSCB_C DFES_GrpRpr.DFC_PSPSCG_C DFES_GrpRpr.DFC_T50Err_C DFES_GrpRpr.DFC_ThrVlvLoBattB1_C DFES_GrpRpr.DFC_UegoSigOperPlausS1B1_C DFES_GrpRpr.DFC_VehVPhysRngHi_C DFES_GrpRpr.DFC_VehVSclOutOL_C DFES_GrpRpr.DFC_VehVSclOutOT_C DFES_GrpRpr.DFC_VehVSclOutSCB_C DFES_GrpRpr.DFC_VehVSclOutSCG_C DFES_GrpRpr.DFC_VehVSigFL_C DFES_GrpRpr.DFC_VehVSigFR_C DFES_GrpRpr.DFC_VehVSigRL_C DFES_GrpRpr.DFC_VehVSigRR_C DFES_GrpRpr.DFC_VehVSnsrARngHi_C DFES_GrpRpr.DFC_VehVSnsrBRngHi_C DFES_GrpRpr.DFC_VehVSpdRtyDiag_C DFES_GrpRpr.DFC_DHFHD_C DFES_GrpRpr.DFC_InjVlv_DI_DcDc_C DFES_GrpRpr.DFC_InjVlv_DI_NoLd_0_C DFES_GrpRpr.DFC_InjVlv_DI_NoLd_1_C DFES_GrpRpr.DFC_InjVlv_DI_NoLd_2_C DFES_GrpRpr.DFC_InjVlv_DI_NoLd_3_C DFES_GrpRpr.DFC_InjVlv_DI_ScBnk_0_C DFES_GrpRpr.DFC_InjVlv_DI_ScBnk_1_C DFES_GrpRpr.DFC_InjVlv_DI_ScBnk_2_C DFES_GrpRpr.DFC_InjVlv_DI_ScBnk_3_C DFES_GrpRpr.DFC_InjVlv_DI_ScCyl_0_C DFES_GrpRpr.DFC_InjVlv_DI_ScCyl_1_C DFES_GrpRpr.DFC_InjVlv_DI_ScCyl_2_C DFES_GrpRpr.DFC_InjVlv_DI_ScCyl_3_C DFES_GrpRpr.DFC_InjVlv_DI_ScHsLs_0_C DFES_GrpRpr.DFC_InjVlv_DI_ScHsLs_1_C DFES_GrpRpr.DFC_InjVlv_DI_ScHsLs_2_C DFES_GrpRpr.DFC_InjVlv_DI_ScHsLs_3_C DFES_GrpRpr.DFC_MfPsDiaOpenLoad1_C DFES_GrpRpr.DFC_MfPsDiaScHiS1_C DFES_GrpRpr.DFC_MfPsDiaScHiSLowS1_C DFES_GrpRpr.DFC_MfPsDiaScLowS1_C DFES_GrpRpr.DFC_ACEvpTPhysRngHi_C DFES_GrpRpr.DFC_ACEvpTPhysRngLo_C DFES_GrpRpr.DFC_ACEvpTSRCMax_C DFES_GrpRpr.DFC_ACEvpTSRCMin_C DFES_GrpRpr.DFC_AfsRawSigRngHiB1_C DFES_GrpRpr.DFC_AfsRawSigRngLoB1_C DFES_GrpRpr.DFC_AfsSnsrErrB1_C DFES_GrpRpr.DFC_AirCClntPAnaSRCMax_C DFES_GrpRpr.DFC_AirCClntPAnaSRCMin_C DFES_GrpRpr.DFC_AirCSwtNpl_C DFES_GrpRpr.DFC_AirCSwtSig_C DFES_GrpRpr.DFC_Brk_C DFES_GrpRpr.DFC_BrkBstSensSCB_C DFES_GrpRpr.DFC_BrkBstSensSCG_C DFES_GrpRpr.DFC_BrkSig_C DFES_GrpRpr.DFC_ClthSig_C DFES_GrpRpr.DFC_EGRVlvCurrLim_C DFES_GrpRpr.DFC_EGRVlvOL_C DFES_GrpRpr.DFC_EGRVlvOvrTemp_C DFES_GrpRpr.DFC_EGRVlvSCB_C DFES_GrpRpr.DFC_EGRVlvSCG_C DFES_GrpRpr.DFC_EGRVlvSRCMax_C DFES_GrpRpr.DFC_EGRVlvSRCMin_C DFES_GrpRpr.DFC_HLSDemOvhtEngLim_C DFES_GrpRpr.DFC_OilPSwmpSRCMax_C DFES_GrpRpr.DFC_OilPSwmpSRCMin_C DFES_GrpRpr.DFC_PIntkVUsLineHiB1_C DFES_GrpRpr.DFC_PIntkVUsLineLoB1_C DFES_GrpRpr.DFC_VehVPhysRngLo_C DFES_GrpRpr.DFC_VehVSigCan_C DFES_GrpRpr.DFC_VehVSigCanSafe_C DFES_GrpRpr.DFC_VlvLftFbOilPSnsrIntk11SRCMax_C DFES_GrpRpr.DFC_VlvLftFbOilPSnsrIntk11SRCMin_C DFES_GrpRpr.DFC_ClthNpl_C DFES_GrpRpr.DFC_GbxPNPosnDrvCdn_C DFES_GrpRpr.DFC_GbxPNPosnPlausy_C DFES_GrpRpr.DFC_AfsSigErrLineHiB1_C DFES_GrpRpr.DFC_AfsSigErrLineLoB1_C DFES_GrpRpr.DFC_PEnvCcMax_C DFES_GrpRpr.DFC_PEnvCcMin_C DFES_GrpRpr.DFC_PEnvRngChkMax_C DFES_GrpRpr.DFC_PEnvRngChkMin_C DFES_GrpRpr.DFC_PEnvSnsrPlaus_C DFES_GrpRpr.DFC_UEGOHeatrRlyPsOLS1B1_C DFES_GrpRpr.DFC_UEGOHeatrRlyPsSCBS1B1_C DFES_GrpRpr.DFC_UEGOHeatrRlyPsSCGS1B1_C DFES_GrpRpr.DFC_UegoHeatrWireOlS1B1_C DFES_GrpRpr.DFC_UegoHeatrWireScbS1B1_C DFES_GrpRpr.DFC_UegoHeatrWireScgS1B1_C DFES_GrpRpr.DFC_KnDetSens1PortAMax_C DFES_GrpRpr.DFC_KnDetSens1PortAMin_C DFES_GrpRpr.DFC_KnDetSens1PortBMax_C DFES_GrpRpr.DFC_KnDetSens1PortBMin_C DFES_GrpRpr.DFC_Clth2ONStuck_C DFES_GrpRpr.DFC_Clth2ONStuckLdc_C DFES_GrpRpr.DFC_Clth3ONStuckLdc_C DFES_GrpRpr.DFC_Clth3ONStuckPostDrv_C DFES_GrpRpr.DFC_Clth4ONStuck_C DFES_GrpRpr.DFC_Clth4ONStuckLdc_C DFES_GrpRpr.DFC_ComBCMUnit_C DFES_GrpRpr.DFC_ComDLCTCU01_C DFES_GrpRpr.DFC_ComDLCTCU02_C DFES_GrpRpr.DFC_ComDLCTCU1_C DFES_GrpRpr.DFC_ComDLCTCU11_C DFES_GrpRpr.DFC_ComDLCTCU12_C DFES_GrpRpr.DFC_ComDLCTCU13_C DFES_GrpRpr.DFC_ComDLCTCU14_C DFES_GrpRpr.DFC_ComDLCTCU2_C DFES_GrpRpr.DFC_ComDLCTCU3_C DFES_GrpRpr.DFC_ComDLCTCU4_C DFES_GrpRpr.DFC_ComEPSUnit_C DFES_GrpRpr.DFC_ComIDASBUnit_C DFES_GrpRpr.DFC_ComIMGUnit_C DFES_GrpRpr.DFC_ComMETUnit_C DFES_GrpRpr.DFC_ComSRSUnit_C DFES_GrpRpr.DFC_ComVSAUnit_C DFES_GrpRpr.DFC_EbsSocFlt_C DFES_GrpRpr.DFC_I14229VINErr_C DFES_GrpRpr.DFC_InjCatHeatgErr_C DFES_GrpRpr.DFC_InjSysMulInjDiagErr_C DFES_GrpRpr.DFC_LLRHmax_C DFES_GrpRpr.DFC_LLRHmin_C DFES_GrpRpr.DFC_LLRHnpl_C DFES_GrpRpr.DFC_LLRKHmax_C DFES_GrpRpr.DFC_LLRKHmin_C DFES_GrpRpr.DFC_LLRKHnpl_C DFES_GrpRpr.DFC_LinACGUnit_C DFES_GrpRpr.DFC_LinAEVUnit_C DFES_GrpRpr.DFC_LinEBSUnit_C DFES_GrpRpr.DFC_RoughRoad_C DFES_GrpRpr.DFC_SiaEEPRdErr_C DFES_GrpRpr.DFC_SiaEEPWrngCod_C DFES_GrpRpr.DFC_UegoHeatrStrtS1B1_C DFES_GrpRpr.DFC_BusDiagCANAPPLBusOff_C DFES_GrpRpr.DFC_BusDiagCANCANCBusOff_C DFES_GrpRpr.DFC_BusDiagCANVEHICLEBusOff_C DFES_GrpRpr.DFC_RBA_IODIAGPWR_rba_IoExtCy329_SignalVltSply_0_C DFES_GrpRpr.DFC_RBA_IODIAGPWR_rba_IoExtCy329_SignalVltSply_0OT_C DFES_GrpRpr.DFC_RBA_IODIAGPWR_rba_IoExtCy329_SignalVltSply_0OV_C DFES_GrpRpr.DFC_RBA_IODIAGPWR_rba_IoExtCy329_SignalVltSply_0SCG_C DFES_GrpRpr.DFC_RBA_IODIAGPWR_rba_IoExtCy329_SignalVltSply_0UV_C DFES_GrpRpr.DFC_RBA_IODIAGPWR_rba_IoExtCy329_SignalVltSply_1_C DFES_GrpRpr.DFC_RBA_IODIAGPWR_rba_IoExtCy329_SignalVltSply_1OT_C DFES_GrpRpr.DFC_RBA_IODIAGPWR_rba_IoExtCy329_SignalVltSply_1OV_C DFES_GrpRpr.DFC_RBA_IODIAGPWR_rba_IoExtCy329_SignalVltSply_1SCG_C DFES_GrpRpr.DFC_RBA_IODIAGPWR_rba_IoExtCy329_SignalVltSply_1UV_C DFES_GrpRpr.DFC_RBA_IODIAGPWR_rba_IoExtCy329_SignalVltSply_2_C DFES_GrpRpr.DFC_RBA_IODIAGPWR_rba_IoExtCy329_SignalVltSply_2OT_C DFES_GrpRpr.DFC_RBA_IODIAGPWR_rba_IoExtCy329_SignalVltSply_2OV_C DFES_GrpRpr.DFC_RBA_IODIAGPWR_rba_IoExtCy329_SignalVltSply_2SCG_C DFES_GrpRpr.DFC_RBA_IODIAGPWR_rba_IoExtCy329_SignalVltSply_2UV_C DFES_GrpRpr.DFC_CAN_E_TIMEOUT_C DFES_GrpRpr.DFC_LIN_E_TIMEOUT_C DFES_GrpRpr.DFC_MRlyOL_C DFES_GrpRpr.DFC_MRlySCB_C DFES_GrpRpr.DFC_MRlySCG_C DFES_GrpRpr.DFC_rba_MultiStackTrace_Threshold_C DFES_GrpRpr.DFC_BSWM_E_ACTION_FAILED_C DFES_GrpRpr.DFC_BSWM_E_INTRPTQUEUE_FULL_C DFES_GrpRpr.DFC_RBA_IOEXTLIB_KEEPALIVE_DRV_C DFES_GrpRpr.DFC_RBA_IOEXTLIB_KEEPALIVE_INI_C DFES_GrpRpr.DFC_rba_IoSigRtc_StopCounter_C DFES_GrpRpr.DFC_rba_MRly_Diag_Stk_Event_C DFES_GrpRpr.DFC_rba_MemDiag_MemReadErr_C DFES_GrpRpr.DFC_rba_MemDiag_MemWrErr_C DFES_GrpRpr.DFC_rba_SyC_IrrSwOffTrigEngRun_Event_C DFES_GrpRpr.DFC_rba_T15_Diag_ComInVld_Event_C DFES_GrpRpr.DFC_rba_T15_Diag_ComOff_HwOn_Event_C DFES_GrpRpr.DFC_rba_T15_Diag_ComOn_HwOff_Event_C DFES_GrpRpr.DFC_AAVmin_C DFES_GrpRpr.DFC_AGRSUS_C DFES_GrpRpr.DFC_AfsPlausDiagHi_C DFES_GrpRpr.DFC_AfsPlausDiagLo_C DFES_GrpRpr.DFC_AfsVrntDiagErrB1_C DFES_GrpRpr.DFC_AppAllSnsrDfct_C DFES_GrpRpr.DFC_BBKRnldg_C DFES_GrpRpr.DFC_BBKRsyne_C DFES_GrpRpr.DFC_BattUStdbyDiaOL_C DFES_GrpRpr.DFC_BigLeakIntkMnfldEmiInfl_C DFES_GrpRpr.DFC_BlkdLineTank_C DFES_GrpRpr.DFC_BrkMnSwtContOnWarnLmp_C DFES_GrpRpr.DFC_BrkMnSwtNotStpWarnLmp_C DFES_GrpRpr.DFC_BrkRdntSwtContOnWarnLmp_C DFES_GrpRpr.DFC_BrkRdntSwtNotStpWarnLmp_C DFES_GrpRpr.DFC_CEngDsTColdStrtMax_C DFES_GrpRpr.DFC_CEngDsTColdStrtMin_C DFES_GrpRpr.DFC_CEngDsTImps_C DFES_GrpRpr.DFC_CEngDsTPlausHSC_C DFES_GrpRpr.DFC_CEngDsTPlausLSC_C DFES_GrpRpr.DFC_CEngDsTPlausSTC_C DFES_GrpRpr.DFC_CEngDsTSRCMax_C DFES_GrpRpr.DFC_CEngDsTSRCMin_C DFES_GrpRpr.DFC_CEngDsTSig_C DFES_GrpRpr.DFC_CEngUsTColdStrtMax_C DFES_GrpRpr.DFC_CEngUsTColdStrtMin_C DFES_GrpRpr.DFC_CEngUsTLooseCnctn_C DFES_GrpRpr.DFC_CEngUsTSRCMax_C DFES_GrpRpr.DFC_CEngUsTSRCMin_C DFES_GrpRpr.DFC_ComDCDCACCFailr_C DFES_GrpRpr.DFC_DCDCFltDet_C DFES_GrpRpr.DFC_DKRSA_C DFES_GrpRpr.DFC_DKVSmax_C DFES_GrpRpr.DFC_DKnpl_C DFES_GrpRpr.DFC_DSKVRmax_C DFES_GrpRpr.DFC_DSKVRmin_C DFES_GrpRpr.DFC_DSKVRnpl_C DFES_GrpRpr.DFC_DSKVRsig_C DFES_GrpRpr.DFC_DSKVSsig_C DFES_GrpRpr.DFC_DSSmax_C DFES_GrpRpr.DFC_DSTDmax_C DFES_GrpRpr.DFC_DSTEmax_C DFES_GrpRpr.DFC_DSTEmin_C DFES_GrpRpr.DFC_DSTOFmax_C DFES_GrpRpr.DFC_DSTRmax_C DFES_GrpRpr.DFC_DSTRmin_C DFES_GrpRpr.DFC_DSTRnpl_C DFES_GrpRpr.DFC_DSTRsig_C DFES_GrpRpr.DFC_DSTTI_C DFES_GrpRpr.DFC_DSUmax_C DFES_GrpRpr.DFC_DiagCpv1DteskLoLoadStuckClsd_C DFES_GrpRpr.DFC_DiagCpv1DteskLoLoadStuckOpen_C DFES_GrpRpr.DFC_EGRVlvDrftClsd_C DFES_GrpRpr.DFC_EGRVlvDrftOpn_C DFES_GrpRpr.DFC_EGRVlvJamVlvClsd_C DFES_GrpRpr.DFC_EGRVlvJamVlvOpn_C DFES_GrpRpr.DFC_EGRVlvSprgBrk_C DFES_GrpRpr.DFC_EGRVlvTempMdlEEPErr_C DFES_GrpRpr.DFC_EGRVlvTmpErr_C DFES_GrpRpr.DFC_EGSDUS2B1LtrDly_C DFES_GrpRpr.DFC_EGSDUS2B1LtrPT1_C DFES_GrpRpr.DFC_EGSDUS2B1RtlDly_C DFES_GrpRpr.DFC_EGSDUS2B1RtlPT1_C DFES_GrpRpr.DFC_EGSDUS2B1TarLean_C DFES_GrpRpr.DFC_EGSDUS2B1TarRich_C DFES_GrpRpr.DFC_EONVmax_C DFES_GrpRpr.DFC_ETAKHLmax_C DFES_GrpRpr.DFC_ETAKHTmax_C DFES_GrpRpr.DFC_ETHSEmax_C DFES_GrpRpr.DFC_ETHSEmin_C DFES_GrpRpr.DFC_ETHSFmax_C DFES_GrpRpr.DFC_ETHSFmin_C DFES_GrpRpr.DFC_ETHSFsig_C DFES_GrpRpr.DFC_ETHSNPWmax_C DFES_GrpRpr.DFC_ETHSNPWmin_C DFES_GrpRpr.DFC_ETHSNPWsig_C DFES_GrpRpr.DFC_ETHSPLnpl_C DFES_GrpRpr.DFC_ETHSTPLnpl_C DFES_GrpRpr.DFC_EngICO_C DFES_GrpRpr.DFC_EngPrtOvrSpdMon_C DFES_GrpRpr.DFC_EpmCaSI1ErrSig_C DFES_GrpRpr.DFC_EpmCaSI1MntErr_C DFES_GrpRpr.DFC_EpmCaSI1NoSigMax_C DFES_GrpRpr.DFC_EpmCaSI1NoSigMin_C DFES_GrpRpr.DFC_EpmCaSI1OfsErr_C DFES_GrpRpr.DFC_EpmCrSDGI_C DFES_GrpRpr.DFC_EpmCrSErrSig_C DFES_GrpRpr.DFC_EpmCrSNoSig_C DFES_GrpRpr.DFC_EtaEngIdleNonCsers_C DFES_GrpRpr.DFC_EtaEngPtlNonCsers_C DFES_GrpRpr.DFC_FRAmax_C DFES_GrpRpr.DFC_FRAmin_C DFES_GrpRpr.DFC_FSTEmax_C DFES_GrpRpr.DFC_FSTEmin_C DFES_GrpRpr.DFC_FSTRmax_C DFES_GrpRpr.DFC_FSTRmin_C DFES_GrpRpr.DFC_FSTRnpl_C DFES_GrpRpr.DFC_FSTmax_C DFES_GrpRpr.DFC_FTDLAmax_C DFES_GrpRpr.DFC_FTDLAmin_C DFES_GrpRpr.DFC_FuPHiSnsrEleclmax_C DFES_GrpRpr.DFC_FuPHiSnsrEleclmin_C DFES_GrpRpr.DFC_FuPHiSnsrEleclnpl_C DFES_GrpRpr.DFC_FuPHiSnsrURngMax_C DFES_GrpRpr.DFC_FuPHiSnsrURngMin_C DFES_GrpRpr.DFC_FuSnsrPhyRngMaxErr_C DFES_GrpRpr.DFC_FuSnsrPhyRngMinErr_C DFES_GrpRpr.DFC_GEVlvLockPinDiagIntkB1_C DFES_GrpRpr.DFC_GEVlvPhaSlowIntkB1_C DFES_GrpRpr.DFC_GEVlvPhaTargIntkB1_C DFES_GrpRpr.DFC_GbxRvsSwtStk_C DFES_GrpRpr.DFC_HDRKHmax_C DFES_GrpRpr.DFC_HDRKHmin_C DFES_GrpRpr.DFC_HDRPLmax_C DFES_GrpRpr.DFC_HDRPLmin_C DFES_GrpRpr.DFC_HDRmax_C DFES_GrpRpr.DFC_HDRmin_C DFES_GrpRpr.DFC_HEGOS2B1ElecMax_C DFES_GrpRpr.DFC_HEGOS2B1ElecMin_C DFES_GrpRpr.DFC_HEGOS2B1ElecSig_C DFES_GrpRpr.DFC_HEGOS2B1HtgNpl_C DFES_GrpRpr.DFC_HEV00max_C DFES_GrpRpr.DFC_HEV01max_C DFES_GrpRpr.DFC_HEV02max_C DFES_GrpRpr.DFC_HEV03max_C DFES_GrpRpr.DFC_HEVE0max_C DFES_GrpRpr.DFC_HEVE1max_C DFES_GrpRpr.DFC_HFMmax_C DFES_GrpRpr.DFC_HiPSysHiPMaxLimExcdd_C DFES_GrpRpr.DFC_IVGdiCtlCvoErrMax_0_C DFES_GrpRpr.DFC_IVGdiCtlCvoErrMax_1_C DFES_GrpRpr.DFC_IVGdiCtlCvoErrMax_2_C DFES_GrpRpr.DFC_IVGdiCtlCvoErrMax_3_C DFES_GrpRpr.DFC_IVGdiCtlCvoErrMin_0_C DFES_GrpRpr.DFC_IVGdiCtlCvoErrMin_1_C DFES_GrpRpr.DFC_IVGdiCtlCvoErrMin_2_C DFES_GrpRpr.DFC_IVGdiCtlCvoErrMin_3_C DFES_GrpRpr.DFC_IVGdiCtlCvoErrMinMax_C DFES_GrpRpr.DFC_IVGdiCtlCvoSigPlausErrSmrCdn_C /end DEF_CHARACTERISTIC
 FUNCTION_VERSION "30000.73.0_2.0.0" /end FUNCTION
/begin COMPU_METHOD DFC_Verb "" TAB_VERB "%6.3" "-" COMPU_TAB_REF DFC_Verb /end COMPU_METHOD
/begin COMPU_VTAB DFC_Verb "" TAB_VERB 907 0 "DFC_Unused" 1 "DFC_AAVEmax" 2 "DFC_AAVEmin" 3 "DFC_AAVEsig" 508 "DFC_AAVmin" 379 "DFC_ACEvpTPhysRngHi" 380 "DFC_ACEvpTPhysRngLo" 381 "DFC_ACEvpTSRCMax" 382 "DFC_ACEvpTSRCMin" 288 "DFC_AfsPhyRngHiB1" 289 "DFC_AfsPhyRngLoB1" 510 "DFC_AfsPlausDiagHi" 511 "DFC_AfsPlausDiagLo" 383 "DFC_AfsRawSigRngHiB1" 384 "DFC_AfsRawSigRngLoB1" 415 "DFC_AfsSigErrLineHiB1" 416 "DFC_AfsSigErrLineLoB1" 385 "DFC_AfsSnsrErrB1" 512 "DFC_AfsVrntDiagErrB1" 509 "DFC_AGRSUS" 386 "DFC_AirCClntPAnaSRCMax" 387 "DFC_AirCClntPAnaSRCMin" 290 "DFC_AirCCmprOL" 291 "DFC_AirCCmprOvrTemp" 292 "DFC_AirCCmprSCB" 293 "DFC_AirCCmprSCG" 388 "DFC_AirCSwtNpl" 389 "DFC_AirCSwtSig" 294 "DFC_AltErr" 4 "DFC_AltIOACGFailr" 5 "DFC_AltIOACGHiVltg" 6 "DFC_AltIOACGLoVltg" 7 "DFC_AltIOACGTHi" 8 "DFC_AltIODConnACG" 513 "DFC_AppAllSnsrDfct" 10 "DFC_BattUHiFailr" 11 "DFC_BattULoFailr" 295 "DFC_BattUSRCMax" 296 "DFC_BattUSRCMin" 516 "DFC_BattUStdbyDiaOL" 514 "DFC_BBKRnldg" 515 "DFC_BBKRsyne" 9 "DFC_BGOELWAF" 517 "DFC_BigLeakIntkMnfldEmiInfl" 518 "DFC_BlkdLineTank" 390 "DFC_Brk" 12 "DFC_BrkBstPDriftHiErr" 13 "DFC_BrkBstPDriftLoErr" 14 "DFC_BrkBstPSnsrStuck" 391 "DFC_BrkBstSensSCB" 392 "DFC_BrkBstSensSCG" 15 "DFC_BrkMnSwtContOn" 519 "DFC_BrkMnSwtContOnWarnLmp" 16 "DFC_BrkMnSwtNotStp" 520 "DFC_BrkMnSwtNotStpWarnLmp" 17 "DFC_BrkNpl" 18 "DFC_BrkRdntSwtContOn" 521 "DFC_BrkRdntSwtContOnWarnLmp" 19 "DFC_BrkRdntSwtNotStp" 522 "DFC_BrkRdntSwtNotStpWarnLmp" 393 "DFC_BrkSig" 496 "DFC_BSWM_E_ACTION_FAILED" 497 "DFC_BSWM_E_INTRPTQUEUE_FULL" 472 "DFC_BusDiagCANAPPLBusOff" 473 "DFC_BusDiagCANCANCBusOff" 474 "DFC_BusDiagCANVEHICLEBusOff" 490 "DFC_CAN_E_TIMEOUT" 523 "DFC_CEngDsTColdStrtMax" 524 "DFC_CEngDsTColdStrtMin" 525 "DFC_CEngDsTImps" 526 "DFC_CEngDsTPlausHSC" 527 "DFC_CEngDsTPlausLSC" 528 "DFC_CEngDsTPlausSTC" 531 "DFC_CEngDsTSig" 529 "DFC_CEngDsTSRCMax" 530 "DFC_CEngDsTSRCMin" 532 "DFC_CEngUsTColdStrtMax" 533 "DFC_CEngUsTColdStrtMin" 534 "DFC_CEngUsTLooseCnctn" 535 "DFC_CEngUsTSRCMax" 536 "DFC_CEngUsTSRCMin" 432 "DFC_Clth2ONStuck" 433 "DFC_Clth2ONStuckLdc" 20 "DFC_Clth3ONStuck" 434 "DFC_Clth3ONStuckLdc" 435 "DFC_Clth3ONStuckPostDrv" 21 "DFC_Clth4OFFStuck" 436 "DFC_Clth4ONStuck" 437 "DFC_Clth4ONStuckLdc" 260 "DFC_ClthMax" 412 "DFC_ClthNpl" 22 "DFC_ClthOFFStuck" 23 "DFC_ClthONStuck" 394 "DFC_ClthSig" 24 "DFC_ClthStkFailInfo" 25 "DFC_ComACFailInfo" 26 "DFC_ComATFTValErr" 27 "DFC_ComATMILReq" 28 "DFC_ComAYCAChksum" 29 "DFC_ComAYCARingCnt" 30 "DFC_ComAYCATOut" 31 "DFC_ComAYCDChkSum" 32 "DFC_ComAYCDTOut" 33 "DFC_ComAYCFChksum" 34 "DFC_ComAYCFRingCnt" 35 "DFC_ComAYCFTOut" 36 "DFC_ComAYCGChksum" 37 "DFC_ComAYCGRingCnt" 38 "DFC_ComAYCGTOut" 39 "DFC_ComAYCIChkSum" 40 "DFC_ComAYCIRingCnt" 41 "DFC_ComAYCITOut" 42 "DFC_ComBCM1ChkSum" 43 "DFC_ComBCM1RingCnt" 44 "DFC_ComBCM1TOut" 438 "DFC_ComBCMUnit" 45 "DFC_ComCANABusOffErr" 46 "DFC_ComCANBBusOffErr" 47 "DFC_ComCANCBusOffErr" 48 "DFC_ComCGW1ChkSum" 49 "DFC_ComCGW1RingCnt" 50 "DFC_ComCGW1TOut" 297 "DFC_ComChksTCU1" 298 "DFC_ComChksTCU11" 299 "DFC_ComChksTCU12" 300 "DFC_ComChksTCU13" 301 "DFC_ComChksTCU2" 302 "DFC_ComChksTCU3" 303 "DFC_ComChksTCU4" 304 "DFC_ComCntTCU1" 305 "DFC_ComCntTCU11" 306 "DFC_ComCntTCU12" 307 "DFC_ComCntTCU13" 308 "DFC_ComCntTCU2" 309 "DFC_ComCntTCU3" 310 "DFC_ComCntTCU4" 51 "DFC_ComConvBoostErr" 52 "DFC_ComConvSlipErr" 537 "DFC_ComDCDCACCFailr" 53 "DFC_ComDCDCPrfmncErr" 54 "DFC_ComDCDCTempWarn" 439 "DFC_ComDLCTCU01" 440 "DFC_ComDLCTCU02" 441 "DFC_ComDLCTCU1" 442 "DFC_ComDLCTCU11" 443 "DFC_ComDLCTCU12" 444 "DFC_ComDLCTCU13" 445 "DFC_ComDLCTCU14" 446 "DFC_ComDLCTCU2" 447 "DFC_ComDLCTCU3" 448 "DFC_ComDLCTCU4" 55 "DFC_ComEAT10Chksum" 56 "DFC_ComEAT10RingCnt" 57 "DFC_ComEAT10TOut" 58 "DFC_ComEAT11ChkSum" 59 "DFC_ComEAT11RingCnt" 60 "DFC_ComEAT11TOut" 61 "DFC_ComEAT12ChkSum" 62 "DFC_ComEAT12RingCnt" 63 "DFC_ComEAT12TOut" 64 "DFC_ComEAT13ChkSum" 65 "DFC_ComEAT13RingCnt" 66 "DFC_ComEAT13TOut" 67 "DFC_ComEAT1Chksum" 68 "DFC_ComEAT1RingCnt" 69 "DFC_ComEAT1TOut" 70 "DFC_ComEAT2ChkSum" 71 "DFC_ComEAT2RingCnt" 72 "DFC_ComEAT2TOut" 73 "DFC_ComEAT4ChkSum" 74 "DFC_ComEAT4RingCnt" 75 "DFC_ComEAT4TOut" 76 "DFC_ComEAT6Chksum" 77 "DFC_ComEAT6RingCnt" 78 "DFC_ComEAT6TOut" 79 "DFC_ComEAT7Chksum" 80 "DFC_ComEAT7RingCnt" 81 "DFC_ComEAT7TOut" 82 "DFC_ComEAT8Chksum" 83 "DFC_ComEAT8RingCnt" 84 "DFC_ComEAT8TOut" 85 "DFC_ComEATAChksum" 86 "DFC_ComEATARingCnt" 87 "DFC_ComEATATOut" 88 "DFC_ComEATBChkSum" 89 "DFC_ComEATBRingCnt" 90 "DFC_ComEATBTOut" 91 "DFC_ComEATCChksum" 92 "DFC_ComEATCRingCnt" 93 "DFC_ComEATCTOut" 103 "DFC_ComEngCanRxErr" 94 "DFC_ComEPBBChkSum" 95 "DFC_ComEPBBRingCnt" 96 "DFC_ComEPBBTOut" 97 "DFC_ComEPBChksum" 99 "DFC_ComEPBctRing" 98 "DFC_ComEPBTOut" 100 "DFC_ComEPS1Chksum" 101 "DFC_ComEPS1RingCnt" 102 "DFC_ComEPS1TOut" 449 "DFC_ComEPSUnit" 104 "DFC_ComGrvySnsrErr" 105 "DFC_ComGwIMG1ChkSum" 106 "DFC_ComGwIMG1RingCnt" 107 "DFC_ComGwIMG1TOut" 108 "DFC_ComGwIMG3ChkSum" 109 "DFC_ComGwIMG3RingCnt" 110 "DFC_ComGwIMG3TOut" 111 "DFC_ComGwIMG4ChkSum" 112 "DFC_ComGwIMG4RingCnt" 113 "DFC_ComGwIMG4TOut" 114 "DFC_ComGwIMG5ChkSum" 115 "DFC_ComGwIMG5RingCnt" 116 "DFC_ComGwIMG5TOut" 117 "DFC_ComGwIMG6ChkSum" 118 "DFC_ComGwIMG6RingCnt" 119 "DFC_ComGwIMG6TOut" 120 "DFC_ComIDASBChksum" 121 "DFC_ComIDASBRingCnt" 122 "DFC_ComIDASBTOut" 450 "DFC_ComIDASBUnit" 123 "DFC_ComIMGMILReq" 451 "DFC_ComIMGUnit" 124 "DFC_ComISSPrms" 125 "DFC_ComMETAChksum" 126 "DFC_ComMETAChksumPstDrv" 127 "DFC_ComMETARingCnt" 128 "DFC_ComMETARingCntPstDrv" 129 "DFC_ComMETATOut" 130 "DFC_ComMETATOutPstDrv" 131 "DFC_ComMETCChksum" 132 "DFC_ComMETCRingCnt" 133 "DFC_ComMETCTOut" 134 "DFC_ComMETDChksum" 135 "DFC_ComMETDRingCnt" 136 "DFC_ComMETDTOut" 137 "DFC_ComMETE2Chksum" 138 "DFC_ComMETE2RingCnt" 139 "DFC_ComMETE2TOut" 140 "DFC_ComMETFChksum" 141 "DFC_ComMETFRingCnt" 142 "DFC_ComMETFTOut" 143 "DFC_ComMETGChksum" 144 "DFC_ComMETGRingCnt" 145 "DFC_ComMETGTOut" 146 "DFC_ComMETH2Chksum" 147 "DFC_ComMETH2RingCnt" 148 "DFC_ComMETH2TOut" 149 "DFC_ComMETHChksum" 150 "DFC_ComMETHRingCnt" 151 "DFC_ComMETHTOut" 152 "DFC_ComMETIChksum" 153 "DFC_ComMETIRingCnt" 154 "DFC_ComMETITOut" 155 "DFC_ComMETKChksum" 156 "DFC_ComMETKRingCnt" 157 "DFC_ComMETKTOut" 158 "DFC_ComMETLChksum" 159 "DFC_ComMETLRingCnt" 160 "DFC_ComMETLTOut" 161 "DFC_ComMETMChksum" 162 "DFC_ComMETMRingCnt" 163 "DFC_ComMETMTOut" 164 "DFC_ComMETNChksum" 165 "DFC_ComMETNRingCnt" 166 "DFC_ComMETNTOut" 452 "DFC_ComMETUnit" 167 "DFC_ComMtrCom" 168 "DFC_ComPCUChkSum" 169 "DFC_ComPCURingCnt" 170 "DFC_ComPCUTOut" 171 "DFC_ComSRSAChksum" 172 "DFC_ComSRSARingCnt" 173 "DFC_ComSRSATOut" 174 "DFC_ComSRSBChksum" 175 "DFC_ComSRSBRingCnt" 176 "DFC_ComSRSBTOut" 177 "DFC_ComSRSChksum" 178 "DFC_ComSRSErr" 179 "DFC_ComSRSRingCnt" 180 "DFC_ComSRSTOut" 453 "DFC_ComSRSUnit" 311 "DFC_ComTOutTCU01" 312 "DFC_ComTOutTCU02" 313 "DFC_ComTOutTCU1" 314 "DFC_ComTOutTCU11" 315 "DFC_ComTOutTCU12" 316 "DFC_ComTOutTCU13" 317 "DFC_ComTOutTCU14" 318 "DFC_ComTOutTCU2" 319 "DFC_ComTOutTCU3" 320 "DFC_ComTOutTCU4" 181 "DFC_ComVehSpdPndFltTCU" 454 "DFC_ComVSAUnit" 538 "DFC_DCDCFltDet" 321 "DFC_DevLibBattUHi" 322 "DFC_DevLibBattULo" 357 "DFC_DHFHD" 558 "DFC_DiagCpv1DteskLoLoadStuckClsd" 559 "DFC_DiagCpv1DteskLoLoadStuckOpen" 541 "DFC_DKnpl" 539 "DFC_DKRSA" 540 "DFC_DKVSmax" 542 "DFC_DSKVRmax" 543 "DFC_DSKVRmin" 544 "DFC_DSKVRnpl" 545 "DFC_DSKVRsig" 546 "DFC_DSKVSsig" 547 "DFC_DSSmax" 548 "DFC_DSTDmax" 549 "DFC_DSTEmax" 550 "DFC_DSTEmin" 551 "DFC_DSTOFmax" 552 "DFC_DSTRmax" 553 "DFC_DSTRmin" 554 "DFC_DSTRnpl" 555 "DFC_DSTRsig" 556 "DFC_DSTTI" 557 "DFC_DSUmax" 182 "DFC_EbsChartcCurrErr" 183 "DFC_EbsSelfDiagErr" 455 "DFC_EbsSocFlt" 395 "DFC_EGRVlvCurrLim" 560 "DFC_EGRVlvDrftClsd" 561 "DFC_EGRVlvDrftOpn" 323 "DFC_EGRVlvFailSafeActv" 324 "DFC_EGRVlvGovDvtCld" 562 "DFC_EGRVlvJamVlvClsd" 563 "DFC_EGRVlvJamVlvOpn" 396 "DFC_EGRVlvOL" 397 "DFC_EGRVlvOvrTemp" 325 "DFC_EGRVlvPhysSRCMax" 326 "DFC_EGRVlvPhysSRCMin" 398 "DFC_EGRVlvSCB" 399 "DFC_EGRVlvSCG" 564 "DFC_EGRVlvSprgBrk" 400 "DFC_EGRVlvSRCMax" 401 "DFC_EGRVlvSRCMin" 565 "DFC_EGRVlvTempMdlEEPErr" 566 "DFC_EGRVlvTmpErr" 567 "DFC_EGSDUS2B1LtrDly" 568 "DFC_EGSDUS2B1LtrPT1" 569 "DFC_EGSDUS2B1RtlDly" 570 "DFC_EGSDUS2B1RtlPT1" 571 "DFC_EGSDUS2B1TarLean" 572 "DFC_EGSDUS2B1TarRich" 586 "DFC_EngICO" 587 "DFC_EngPrtOvrSpdMon" 573 "DFC_EONVmax" 588 "DFC_EpmCaSI1ErrSig" 589 "DFC_EpmCaSI1MntErr" 590 "DFC_EpmCaSI1NoSigMax" 591 "DFC_EpmCaSI1NoSigMin" 592 "DFC_EpmCaSI1OfsErr" 593 "DFC_EpmCrSDGI" 594 "DFC_EpmCrSErrSig" 595 "DFC_EpmCrSNoSig" 596 "DFC_EtaEngIdleNonCsers" 597 "DFC_EtaEngPtlNonCsers" 574 "DFC_ETAKHLmax" 575 "DFC_ETAKHTmax" 576 "DFC_ETHSEmax" 577 "DFC_ETHSEmin" 578 "DFC_ETHSFmax" 579 "DFC_ETHSFmin" 580 "DFC_ETHSFsig" 581 "DFC_ETHSNPWmax" 582 "DFC_ETHSNPWmin" 583 "DFC_ETHSNPWsig" 584 "DFC_ETHSPLnpl" 585 "DFC_ETHSTPLnpl" 327 "DFC_FanDIOOL_0" 328 "DFC_FanDIOOL_1" 329 "DFC_FanDIOOvrTemp_0" 330 "DFC_FanDIOOvrTemp_1" 331 "DFC_FanDIOSCB_0" 332 "DFC_FanDIOSCB_1" 333 "DFC_FanDIOSCG_0" 334 "DFC_FanDIOSCG_1" 598 "DFC_FRAmax" 599 "DFC_FRAmin" 600 "DFC_FSTEmax" 601 "DFC_FSTEmin" 605 "DFC_FSTmax" 602 "DFC_FSTRmax" 603 "DFC_FSTRmin" 604 "DFC_FSTRnpl" 606 "DFC_FTDLAmax" 607 "DFC_FTDLAmin" 608 "DFC_FuPHiSnsrEleclmax" 609 "DFC_FuPHiSnsrEleclmin" 610 "DFC_FuPHiSnsrEleclnpl" 611 "DFC_FuPHiSnsrURngMax" 612 "DFC_FuPHiSnsrURngMin" 613 "DFC_FuSnsrPhyRngMaxErr" 614 "DFC_FuSnsrPhyRngMinErr" 188 "DFC_GbxCANDigPlausErr" 189 "DFC_GbxNPos1SRCMax" 190 "DFC_GbxNPos1SRCMin" 191 "DFC_GbxNPos2SRCMax" 192 "DFC_GbxNPos2SRCMin" 193 "DFC_GbxNPosAlvChk" 194 "DFC_GbxNPosSyncErr" 413 "DFC_GbxPNPosnDrvCdn" 414 "DFC_GbxPNPosnPlausy" 618 "DFC_GbxRvsSwtStk" 615 "DFC_GEVlvLockPinDiagIntkB1" 184 "DFC_GEVlvPhaCsersIntkB1" 185 "DFC_GEVlvPhaPsOpenLoadIntkB1" 186 "DFC_GEVlvPhaPsShoToBattIntkB1" 187 "DFC_GEVlvPhaPsShoToGndIntkB1" 616 "DFC_GEVlvPhaSlowIntkB1" 617 "DFC_GEVlvPhaTargIntkB1" 619 "DFC_HDRKHmax" 620 "DFC_HDRKHmin" 623 "DFC_HDRmax" 624 "DFC_HDRmin" 621 "DFC_HDRPLmax" 622 "DFC_HDRPLmin" 625 "DFC_HEGOS2B1ElecMax" 626 "DFC_HEGOS2B1ElecMin" 627 "DFC_HEGOS2B1ElecSig" 628 "DFC_HEGOS2B1HtgNpl" 195 "DFC_HEGOS2B1HtrPsMax" 196 "DFC_HEGOS2B1HtrPsMin" 197 "DFC_HEGOS2B1HtrPsSig" 629 "DFC_HEV00max" 630 "DFC_HEV01max" 631 "DFC_HEV02max" 632 "DFC_HEV03max" 633 "DFC_HEVE0max" 634 "DFC_HEVE1max" 635 "DFC_HFMmax" 636 "DFC_HiPSysHiPMaxLimExcdd" 402 "DFC_HLSDemOvhtEngLim" 456 "DFC_I14229VINErr" 261 "DFC_IgnClPs_DevComErr" 262 "DFC_IgnClPs_LineOl_0" 263 "DFC_IgnClPs_LineOl_1" 264 "DFC_IgnClPs_LineOl_2" 265 "DFC_IgnClPs_LineOl_3" 266 "DFC_IgnClPs_LineScb_0" 267 "DFC_IgnClPs_LineScb_1" 268 "DFC_IgnClPs_LineScb_2" 269 "DFC_IgnClPs_LineScb_3" 270 "DFC_IgnClPs_LineScg_0" 271 "DFC_IgnClPs_LineScg_1" 272 "DFC_IgnClPs_LineScg_2" 273 "DFC_IgnClPs_LineScg_3" 457 "DFC_InjCatHeatgErr" 458 "DFC_InjSysMulInjDiagErr" 358 "DFC_InjVlv_DI_DcDc" 359 "DFC_InjVlv_DI_NoLd_0" 360 "DFC_InjVlv_DI_NoLd_1" 361 "DFC_InjVlv_DI_NoLd_2" 362 "DFC_InjVlv_DI_NoLd_3" 363 "DFC_InjVlv_DI_ScBnk_0" 364 "DFC_InjVlv_DI_ScBnk_1" 365 "DFC_InjVlv_DI_ScBnk_2" 366 "DFC_InjVlv_DI_ScBnk_3" 367 "DFC_InjVlv_DI_ScCyl_0" 368 "DFC_InjVlv_DI_ScCyl_1" 369 "DFC_InjVlv_DI_ScCyl_2" 370 "DFC_InjVlv_DI_ScCyl_3" 371 "DFC_InjVlv_DI_ScHsLs_0" 372 "DFC_InjVlv_DI_ScHsLs_1" 373 "DFC_InjVlv_DI_ScHsLs_2" 374 "DFC_InjVlv_DI_ScHsLs_3" 652 "DFC_IntkAirTAirFltDsCrssMax" 653 "DFC_IntkAirTAirFltDsCrssMin" 654 "DFC_IntkAirTAirFltDsHSCMax" 655 "DFC_IntkAirTAirFltDsImps" 656 "DFC_IntkAirTAirFltDsPRCMax" 657 "DFC_IntkAirTAirFltDsPRCMin" 658 "DFC_IntkAirTAirFltDsSRCMax" 659 "DFC_IntkAirTAirFltDsSRCMin" 660 "DFC_IntkAirTAirFltDsSTC" 661 "DFC_IntkAirTIntkMnfldCrssMax" 662 "DFC_IntkAirTIntkMnfldCrssMin" 663 "DFC_IntkAirTIntkMnfldHSCMax" 664 "DFC_IntkAirTIntkMnfldImps" 665 "DFC_IntkAirTIntkMnfldPRCMax" 666 "DFC_IntkAirTIntkMnfldPRCMin" 667 "DFC_IntkAirTIntkMnfldSRCMax" 668 "DFC_IntkAirTIntkMnfldSRCMin" 669 "DFC_IntkAirTIntkMnfldSTC" 647 "DFC_IVGdiCtl_CvoErr" 648 "DFC_IVGdiCtl_CvoSigPlaus_0" 649 "DFC_IVGdiCtl_CvoSigPlaus_1" 650 "DFC_IVGdiCtl_CvoSigPlaus_2" 651 "DFC_IVGdiCtl_CvoSigPlaus_3" 637 "DFC_IVGdiCtlCvoErrMax_0" 638 "DFC_IVGdiCtlCvoErrMax_1" 639 "DFC_IVGdiCtlCvoErrMax_2" 640 "DFC_IVGdiCtlCvoErrMax_3" 641 "DFC_IVGdiCtlCvoErrMin_0" 642 "DFC_IVGdiCtlCvoErrMin_1" 643 "DFC_IVGdiCtlCvoErrMin_2" 644 "DFC_IVGdiCtlCvoErrMin_3" 645 "DFC_IVGdiCtlCvoErrMinMax" 646 "DFC_IVGdiCtlCvoSigPlausErrSmrCdn" 428 "DFC_KnDetSens1PortAMax" 429 "DFC_KnDetSens1PortAMin" 430 "DFC_KnDetSens1PortBMax" 431 "DFC_KnDetSens1PortBMin" 670 "DFC_KRREGRLMX" 671 "DFC_KRVEKOCVLCI" 672 "DFC_KRVEKOENCHMT" 673 "DFC_KRVEKOENCHMT0" 674 "DFC_KRVEKOENCHMT1" 675 "DFC_KRVEKOENCHMT2" 676 "DFC_KRVEKOENCHMT3" 677 "DFC_KRVEKOENCHMT4" 678 "DFC_KRVEKOENCHMT5" 679 "DFC_KRVEKOENCHMT6" 680 "DFC_KRVEKOENCHMT7" 274 "DFC_KRVEKOEVAB" 275 "DFC_KRVEKOEVAB0" 276 "DFC_KRVEKOEVAB1" 277 "DFC_KRVEKOEVAB2" 278 "DFC_KRVEKOEVAB3" 681 "DFC_KRVEKORLMX" 682 "DFC_KRVEKORLMXL" 683 "DFC_KS1max" 684 "DFC_KS1min" 687 "DFC_LamDynDiagS1B1" 688 "DFC_LeakIntkMnfldEmiInfl" 491 "DFC_LIN_E_TIMEOUT" 465 "DFC_LinACGUnit" 466 "DFC_LinAEVUnit" 198 "DFC_LinCSErrACG" 199 "DFC_LinCSErrAEV" 200 "DFC_LinCSErrDCDC" 201 "DFC_LinCSErrEBS" 467 "DFC_LinEBSUnit" 689 "DFC_LinFrameErrDCDC" 202 "DFC_LinHdrTimeoutErrACG" 203 "DFC_LinHdrTimeoutErrAEV" 204 "DFC_LinHdrTimeoutErrDCDC" 205 "DFC_LinHdrTimeoutErrEBS" 206 "DFC_LinMsgTimeoutErrACG" 207 "DFC_LinMsgTimeoutErrAEV" 208 "DFC_LinMsgTimeoutErrDCDC" 209 "DFC_LinMsgTimeoutErrEBS" 210 "DFC_LinNoStrtComErr" 690 "DFC_LinOverrunErrDCDC" 459 "DFC_LLRHmax" 460 "DFC_LLRHmin" 461 "DFC_LLRHnpl" 462 "DFC_LLRKHmax" 463 "DFC_LLRKHmin" 464 "DFC_LLRKHnpl" 685 "DFC_LMmax" 211 "DFC_LowPresOilP" 686 "DFC_LZSRnpl" 691 "DFC_MD00max" 692 "DFC_MDBmax" 693 "DFC_MDCat" 694 "DFC_MDCatCrit" 695 "DFC_MDCatCurr" 696 "DFC_MDCyl_0" 697 "DFC_MDCyl_1" 698 "DFC_MDCyl_2" 699 "DFC_MDCyl_3" 700 "DFC_MDEmi" 701 "DFC_MDEmiStrt" 702 "DFC_MDFco" 705 "DFC_MDmax" 703 "DFC_MDMpl" 704 "DFC_MDSegTiAdpn" 375 "DFC_MfPsDiaOpenLoad1" 376 "DFC_MfPsDiaScHiS1" 377 "DFC_MfPsDiaScHiSLowS1" 378 "DFC_MfPsDiaScLowS1" 706 "DFC_MFuOilMax" 228 "DFC_MisfDetdVWhlFrntLePlaus" 229 "DFC_MisfDetdVWhlFrntRiPlaus" 230 "DFC_MisfDetdVWhlReLePlaus" 231 "DFC_MisfDetdVWhlReRiPlaus" 212 "DFC_MisfDetVWhlFrntLeOORHi" 213 "DFC_MisfDetVWhlFrntLeRatyHi" 214 "DFC_MisfDetVWhlFrntLeRatyLo" 215 "DFC_MisfDetVWhlFrntLeStuck" 216 "DFC_MisfDetVWhlFrntRiOORHi" 217 "DFC_MisfDetVWhlFrntRiRatyHi" 218 "DFC_MisfDetVWhlFrntRiRatyLo" 219 "DFC_MisfDetVWhlFrntRiStuck" 220 "DFC_MisfDetVWhlReLeOORHi" 221 "DFC_MisfDetVWhlReLeRatyHi" 222 "DFC_MisfDetVWhlReLeRatyLo" 223 "DFC_MisfDetVWhlReLeStuck" 224 "DFC_MisfDetVWhlReRiOORHi" 225 "DFC_MisfDetVWhlReRiRatyHi" 226 "DFC_MisfDetVWhlReRiRatyLo" 227 "DFC_MisfDetVWhlReRiStuck" 801 "DFC_MoCADCNTP" 802 "DFC_MoCADCTst" 803 "DFC_MoCSOPICO" 805 "DFC_MoFAirFilgPrdc" 806 "DFC_MoFAirFlCtOffGdi" 807 "DFC_MoFAirFlCylGdi" 808 "DFC_MoFAirFlFF" 809 "DFC_MoFAirFlIn" 810 "DFC_MoFAirFlMixCtlGdiChkAirFl" 811 "DFC_MoFAirFlMixCtlGdiChkCtrl" 812 "DFC_MoFAirFlMode" 804 "DFC_MoFAPP" 813 "DFC_MoFESpd" 814 "DFC_MoFIACo" 815 "DFC_MoFICOL1" 816 "DFC_MoFICOL2" 817 "DFC_MoFStrt" 818 "DFC_MoFTrqCmp" 819 "DFC_MoFTrqCmpMax" 820 "DFC_MoFTrqCmpMin" 821 "DFC_MoFVarPostBldSel" 707 "DFC_MOXEMM_SMU_ALM0_0" 708 "DFC_MOXEMM_SMU_ALM0_1" 709 "DFC_MOXEMM_SMU_ALM0_10" 710 "DFC_MOXEMM_SMU_ALM0_11" 711 "DFC_MOXEMM_SMU_ALM0_13" 712 "DFC_MOXEMM_SMU_ALM0_14" 713 "DFC_MOXEMM_SMU_ALM0_2" 714 "DFC_MOXEMM_SMU_ALM0_22" 715 "DFC_MOXEMM_SMU_ALM0_23" 716 "DFC_MOXEMM_SMU_ALM0_4" 717 "DFC_MOXEMM_SMU_ALM0_5" 718 "DFC_MOXEMM_SMU_ALM0_7" 719 "DFC_MOXEMM_SMU_ALM0_8" 720 "DFC_MOXEMM_SMU_ALM10_16" 721 "DFC_MOXEMM_SMU_ALM10_17" 722 "DFC_MOXEMM_SMU_ALM10_21" 723 "DFC_MOXEMM_SMU_ALM11_0" 724 "DFC_MOXEMM_SMU_ALM11_1" 725 "DFC_MOXEMM_SMU_ALM11_2" 726 "DFC_MOXEMM_SMU_ALM11_3" 727 "DFC_MOXEMM_SMU_ALM11_4" 728 "DFC_MOXEMM_SMU_ALM11_5" 729 "DFC_MOXEMM_SMU_ALM11_8" 730 "DFC_MOXEMM_SMU_ALM11_9" 731 "DFC_MOXEMM_SMU_ALM1_0" 732 "DFC_MOXEMM_SMU_ALM1_1" 733 "DFC_MOXEMM_SMU_ALM1_10" 734 "DFC_MOXEMM_SMU_ALM1_11" 735 "DFC_MOXEMM_SMU_ALM1_13" 736 "DFC_MOXEMM_SMU_ALM1_14" 737 "DFC_MOXEMM_SMU_ALM1_2" 738 "DFC_MOXEMM_SMU_ALM1_22" 739 "DFC_MOXEMM_SMU_ALM1_23" 740 "DFC_MOXEMM_SMU_ALM1_4" 741 "DFC_MOXEMM_SMU_ALM1_5" 742 "DFC_MOXEMM_SMU_ALM1_7" 743 "DFC_MOXEMM_SMU_ALM1_8" 744 "DFC_MOXEMM_SMU_ALM21_0" 745 "DFC_MOXEMM_SMU_ALM21_16" 746 "DFC_MOXEMM_SMU_ALM21_3" 747 "DFC_MOXEMM_SMU_ALM2_1" 748 "DFC_MOXEMM_SMU_ALM2_10" 749 "DFC_MOXEMM_SMU_ALM2_11" 750 "DFC_MOXEMM_SMU_ALM2_13" 751 "DFC_MOXEMM_SMU_ALM2_14" 752 "DFC_MOXEMM_SMU_ALM2_22" 753 "DFC_MOXEMM_SMU_ALM2_23" 754 "DFC_MOXEMM_SMU_ALM2_4" 755 "DFC_MOXEMM_SMU_ALM2_5" 756 "DFC_MOXEMM_SMU_ALM2_7" 757 "DFC_MOXEMM_SMU_ALM2_8" 758 "DFC_MOXEMM_SMU_ALM6_0" 759 "DFC_MOXEMM_SMU_ALM6_11" 760 "DFC_MOXEMM_SMU_ALM6_12" 761 "DFC_MOXEMM_SMU_ALM6_14" 762 "DFC_MOXEMM_SMU_ALM6_15" 763 "DFC_MOXEMM_SMU_ALM6_17" 764 "DFC_MOXEMM_SMU_ALM6_18" 765 "DFC_MOXEMM_SMU_ALM6_20" 766 "DFC_MOXEMM_SMU_ALM6_21" 767 "DFC_MOXEMM_SMU_ALM6_25" 768 "DFC_MOXEMM_SMU_ALM6_4" 769 "DFC_MOXEMM_SMU_ALM6_5" 770 "DFC_MOXEMM_SMU_ALM6_7" 771 "DFC_MOXEMM_SMU_ALM6_8" 772 "DFC_MOXEMM_SMU_ALM7_1" 773 "DFC_MOXEMM_SMU_ALM7_12" 774 "DFC_MOXEMM_SMU_ALM7_13" 775 "DFC_MOXEMM_SMU_ALM7_14" 776 "DFC_MOXEMM_SMU_ALM7_15" 777 "DFC_MOXEMM_SMU_ALM7_16" 778 "DFC_MOXEMM_SMU_ALM7_17" 779 "DFC_MOXEMM_SMU_ALM7_2" 780 "DFC_MOXEMM_SMU_ALM7_20" 781 "DFC_MOXEMM_SMU_ALM7_25" 782 "DFC_MOXEMM_SMU_ALM7_26" 783 "DFC_MOXEMM_SMU_ALM7_28" 784 "DFC_MOXEMM_SMU_ALM7_29" 785 "DFC_MOXEMM_SMU_ALM7_30" 786 "DFC_MOXEMM_SMU_ALM7_31" 787 "DFC_MOXEMM_SMU_ALM8_0" 788 "DFC_MOXEMM_SMU_ALM8_1" 789 "DFC_MOXEMM_SMU_ALM8_10" 790 "DFC_MOXEMM_SMU_ALM8_11" 791 "DFC_MOXEMM_SMU_ALM8_12" 792 "DFC_MOXEMM_SMU_ALM8_16" 793 "DFC_MOXEMM_SMU_ALM8_18" 794 "DFC_MOXEMM_SMU_ALM8_2" 795 "DFC_MOXEMM_SMU_ALM8_3" 796 "DFC_MOXEMM_SMU_ALM8_31" 797 "DFC_MOXEMM_SMU_ALM8_4" 798 "DFC_MOXEMM_SMU_ALM9_0" 799 "DFC_MOXEMM_SMU_ALM9_15" 800 "DFC_MOXEMM_SMU_ALM9_3" 822 "DFC_MoXEMMHwLTMCUFW" 823 "DFC_MoXEMMHwLTMonBIST" 824 "DFC_MoXEMMHwLTRegMonTest" 825 "DFC_MoXEMMHwLTStbySMUAlvTest" 826 "DFC_MoXEMMHwLTTempSens" 827 "DFC_MoXEMMHwLTUCBCfg" 335 "DFC_MRlyDcOL" 336 "DFC_MRlyDcSCB" 337 "DFC_MRlyDcSCG" 492 "DFC_MRlyOL" 493 "DFC_MRlySCB" 494 "DFC_MRlySCG" 828 "DFC_NWSEmax" 829 "DFC_NWSmax" 830 "DFC_OCWDAABEActv" 831 "DFC_OCWDACom" 832 "DFC_OCWDAErrPin" 833 "DFC_OCWDAOvrVltg" 836 "DFC_OilPPlaus" 403 "DFC_OilPSwmpSRCMax" 404 "DFC_OilPSwmpSRCMin" 834 "DFC_ORAmax" 835 "DFC_ORAmin" 847 "DFC_P_VSE11_OL" 848 "DFC_P_VSE11_SCB" 849 "DFC_P_VSE11_SCG" 417 "DFC_PEnvCcMax" 418 "DFC_PEnvCcMin" 419 "DFC_PEnvRngChkMax" 420 "DFC_PEnvRngChkMin" 232 "DFC_PEnvSigRngMax" 233 "DFC_PEnvSigRngMin" 421 "DFC_PEnvSnsrPlaus" 850 "DFC_PhyHighAPP1" 851 "DFC_PhyHighAPP2" 852 "DFC_PhyLowAPP1" 853 "DFC_PhyLowAPP2" 405 "DFC_PIntkVUsLineHiB1" 406 "DFC_PIntkVUsLineLoB1" 837 "DFC_PLLSUmax" 838 "DFC_PLLSUmin" 338 "DFC_PSPOL" 339 "DFC_PSPOvrTemp" 340 "DFC_PSPSCB" 341 "DFC_PSPSCG" 839 "DFC_PSR1max" 840 "DFC_PSRBmax" 841 "DFC_PSRBmin" 845 "DFC_PSRmax" 842 "DFC_PSRPmax" 843 "DFC_PSRPmin" 844 "DFC_PSRPsig" 846 "DFC_PUmax" 475 "DFC_RBA_IODIAGPWR_rba_IoExtCy329_SignalVltSply_0" 476 "DFC_RBA_IODIAGPWR_rba_IoExtCy329_SignalVltSply_0OT" 477 "DFC_RBA_IODIAGPWR_rba_IoExtCy329_SignalVltSply_0OV" 478 "DFC_RBA_IODIAGPWR_rba_IoExtCy329_SignalVltSply_0SCG" 479 "DFC_RBA_IODIAGPWR_rba_IoExtCy329_SignalVltSply_0UV" 480 "DFC_RBA_IODIAGPWR_rba_IoExtCy329_SignalVltSply_1" 481 "DFC_RBA_IODIAGPWR_rba_IoExtCy329_SignalVltSply_1OT" 482 "DFC_RBA_IODIAGPWR_rba_IoExtCy329_SignalVltSply_1OV" 483 "DFC_RBA_IODIAGPWR_rba_IoExtCy329_SignalVltSply_1SCG" 484 "DFC_RBA_IODIAGPWR_rba_IoExtCy329_SignalVltSply_1UV" 485 "DFC_RBA_IODIAGPWR_rba_IoExtCy329_SignalVltSply_2" 486 "DFC_RBA_IODIAGPWR_rba_IoExtCy329_SignalVltSply_2OT" 487 "DFC_RBA_IODIAGPWR_rba_IoExtCy329_SignalVltSply_2OV" 488 "DFC_RBA_IODIAGPWR_rba_IoExtCy329_SignalVltSply_2SCG" 489 "DFC_RBA_IODIAGPWR_rba_IoExtCy329_SignalVltSply_2UV" 498 "DFC_RBA_IOEXTLIB_KEEPALIVE_DRV" 499 "DFC_RBA_IOEXTLIB_KEEPALIVE_INI" 500 "DFC_rba_IoSigRtc_StopCounter" 502 "DFC_rba_MemDiag_MemReadErr" 503 "DFC_rba_MemDiag_MemWrErr" 501 "DFC_rba_MRly_Diag_Stk_Event" 495 "DFC_rba_MultiStackTrace_Threshold" 504 "DFC_rba_SyC_IrrSwOffTrigEngRun_Event" 505 "DFC_rba_T15_Diag_ComInVld_Event" 506 "DFC_rba_T15_Diag_ComOff_HwOn_Event" 507 "DFC_rba_T15_Diag_ComOn_HwOff_Event" 468 "DFC_RoughRoad" 469 "DFC_SiaEEPRdErr" 470 "DFC_SiaEEPWrngCod" 854 "DFC_SRCHighAPP1" 855 "DFC_SRCHighAPP2" 856 "DFC_SRCLowAPP1" 857 "DFC_SRCLowAPP2" 858 "DFC_SSpMon2" 859 "DFC_STHDRmax" 234 "DFC_StmFault" 236 "DFC_StrtCtlErr" 235 "DFC_StrtCtOffPth" 237 "DFC_StrtFault" 238 "DFC_StrtLckJudg1" 239 "DFC_StrtLckJudg2" 240 "DFC_StrtOL" 241 "DFC_StrtOL2" 242 "DFC_StrtSCB" 243 "DFC_StrtSCB2" 244 "DFC_StrtSCG" 245 "DFC_StrtSCG2" 246 "DFC_StrtStkRly1" 247 "DFC_StrtStkRly2" 860 "DFC_SWReset_0" 861 "DFC_SWReset_1" 862 "DFC_SWReset_2" 863 "DFC_SyncAPP" 342 "DFC_T50Err" 865 "DFC_TAmax_Dummy" 864 "DFC_TANKLnpl" 866 "DFC_TESFmax" 867 "DFC_TESGmax" 248 "DFC_TEVEmax" 249 "DFC_TEVEmin" 250 "DFC_TEVEsig" 875 "DFC_ThrVlvClsdPosnFirstOffsLrnImpoB1" 876 "DFC_ThrVlvClsdPosnOffsLrnImpoB1" 877 "DFC_ThrVlvClsdPosnOffsLrnMaxB1" 878 "DFC_ThrVlvClsdPosnOffsLrnMinB1" 879 "DFC_ThrVlvCtrlDeB1" 880 "DFC_ThrVlvDycB1" 881 "DFC_ThrVlvLimpAirPosnMaxAbsltDriftB1" 882 "DFC_ThrVlvLimpAirPosnMaxB1" 883 "DFC_ThrVlvLimpAirPosnMaxRelDriftB1" 884 "DFC_ThrVlvLimpAirPosnMinB1" 343 "DFC_ThrVlvLoBattB1" 885 "DFC_ThrVlvOpenLoadB1" 886 "DFC_ThrVlvOpenSprgB1" 887 "DFC_ThrVlvOpenSprgSprdB1" 888 "DFC_ThrVlvOpenSprgTwnB1" 889 "DFC_ThrVlvOverTB1" 890 "DFC_ThrVlvRetSprgB1" 891 "DFC_ThrVlvRetSprgSprdB1" 892 "DFC_ThrVlvRetSprgTwnB1" 893 "DFC_ThrVlvSens1MaxB1" 900 "DFC_ThrvlvSens1MinB1" 894 "DFC_ThrVlvSens1NplB1" 895 "DFC_ThrVlvSens2MaxB1" 896 "DFC_ThrVlvSens2MinB1" 897 "DFC_ThrVlvSens2NplB1" 898 "DFC_ThrVlvShoCircB1" 899 "DFC_ThrVlvSpiErrB1" 901 "DFC_TiOffTBasdChkFast" 902 "DFC_TiOffTBasdChkSlow" 868 "DFC_TKAEmax" 869 "DFC_TKAEmin" 870 "DFC_TKARmax" 871 "DFC_TKARnpl" 872 "DFC_TMmax_Dummy" 873 "DFC_TUMmax_Dummy" 874 "DFC_TWCDPriCatB1" 251 "DFC_UegoHeatrPrfmncLoS1B1" 422 "DFC_UEGOHeatrRlyPsOLS1B1" 423 "DFC_UEGOHeatrRlyPsSCBS1B1" 424 "DFC_UEGOHeatrRlyPsSCGS1B1" 471 "DFC_UegoHeatrStrtS1B1" 425 "DFC_UegoHeatrWireOlS1B1" 426 "DFC_UegoHeatrWireScbS1B1" 427 "DFC_UegoHeatrWireScgS1B1" 279 "DFC_UegoSigEcuAsicS1B1" 280 "DFC_UegoSigEcuComS1B1" 344 "DFC_UegoSigOperPlausS1B1" 281 "DFC_UegoSigSnsrS1B1" 282 "DFC_UegoSigWireOlApesS1B1" 283 "DFC_UegoSigWireOlIpeS1B1" 284 "DFC_UegoSigWireOlReS1B1" 285 "DFC_UegoSigWireRCmpS1B1" 286 "DFC_UegoSigWireScbS1B1" 287 "DFC_UegoSigWireScgS1B1" 903 "DFC_UEGOSnsrMntdS1B1" 252 "DFC_VehVAllPlaus" 253 "DFC_VehVNCSnsrElecFailr" 345 "DFC_VehVPhysRngHi" 407 "DFC_VehVPhysRngLo" 254 "DFC_VehVPlausCan" 255 "DFC_VehVPlausFco" 256 "DFC_VehVPlausPwr" 257 "DFC_VehVPlausV2N" 346 "DFC_VehVSclOutOL" 347 "DFC_VehVSclOutOT" 348 "DFC_VehVSclOutSCB" 349 "DFC_VehVSclOutSCG" 904 "DFC_VehVSig" 408 "DFC_VehVSigCan" 409 "DFC_VehVSigCanSafe" 350 "DFC_VehVSigFL" 351 "DFC_VehVSigFR" 352 "DFC_VehVSigRL" 353 "DFC_VehVSigRR" 354 "DFC_VehVSnsrARngHi" 355 "DFC_VehVSnsrBRngHi" 356 "DFC_VehVSpdRtyDiag" 258 "DFC_VehVSpdSnsrAElecFailr" 259 "DFC_VehVSpdSnsrBElecFailr" 410 "DFC_VlvLftFbOilPSnsrIntk11SRCMax" 411 "DFC_VlvLftFbOilPSnsrIntk11SRCMin" 905 "DFC_VlvLftFbSwtIntk11SpclFail" 906 "DFC_VlvLftFbSwtIntk11StdFail" DEFAULT_VALUE "---" /end COMPU_VTAB
/begin RECORD_LAYOUT Val_Wu16 FNC_VALUES 1 UWORD COLUMN_DIR DIRECT /end RECORD_LAYOUT
/end MODULE
/end PROJECT
