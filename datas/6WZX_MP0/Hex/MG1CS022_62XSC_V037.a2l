ASAP2_VERSION 1 60
/begin PROJECT MG1CS022 "MG1CS022"
/begin HEADER "" VERSION "MG1CS022_62XSC_V037" PROJECT_NO MG1CS022 /end HEADER
/begin MODULE DIM ""
/begin MOD_COMMON "" BYTE_ORDER MSB_LAST ALIGNMENT_BYTE 1 ALIGNMENT_WORD 2 ALIGNMENT_LONG 4 ALIGNMENT_INT64 4 ALIGNMENT_FLOAT32_IEEE 4 ALIGNMENT_FLOAT64_IEEE 4 DATA_SIZE 32 /end MOD_COMMON
/begin CHARACTERISTIC AFE22 "AF-ratio E22" VALUE 0x805498C0 RB_Val_Wu16 30.71953 fak_q4p6875Em4 0.00 30.71953 FORMAT "%8.5" /end CHARACTERISTIC
/begin CHARACTERISTIC AFSF "AF-ratio Secondary Fuel" VALUE 0x805498C2 RB_Val_Wu16 30.71953 fak_q4p6875Em4 0.00 30.71953 FORMAT "%8.5" /end CHARACTERISTIC
/begin CHARACTERISTIC DewDet_S1B1_I.egyThdSecFu_M "Instance of dew point end class of sensor 1 at bank 1 / map heat quantity threshold for dew-point end second fuel (CNG or flex-fuel)" MAP 0x80549268 RB_Map_S16S16_S16 32767.00 q_q1_kJ 0.00 32767.00 FORMAT "%8.2" EXTENDED_LIMITS -32768.00 32767.00
 /begin AXIS_DESCR STD_AXIS DewDet_S1B1_I.tSnsrStrt Temp_Cels 10 -3549.940 3003.560 FORMAT "%8.3" DEPOSIT ABSOLUTE /end AXIS_DESCR
 /begin AXIS_DESCR STD_AXIS ExhMod_tEngStrtDewDet Temp_Cels 10 -3549.940 3003.560 FORMAT "%8.3" DEPOSIT ABSOLUTE /end AXIS_DESCR
/end CHARACTERISTIC
/begin CHARACTERISTIC DewDet_S1B1_I.egyThd_M "Instance of dew point end class of sensor 1 at bank 1 / map heat quantity threshold for dew-point end" MAP 0x8054935C RB_Map_S16S16_S16 32767.00 q_q1_kJ 0.00 32767.00 FORMAT "%8.2" EXTENDED_LIMITS -32768.00 32767.00
 /begin AXIS_DESCR STD_AXIS DewDet_S1B1_I.tSnsrStrt Temp_Cels 10 -3549.940 3003.560 FORMAT "%8.3" DEPOSIT ABSOLUTE /end AXIS_DESCR
 /begin AXIS_DESCR STD_AXIS ExhMod_tEngStrtDewDet Temp_Cels 10 -3549.940 3003.560 FORMAT "%8.3" DEPOSIT ABSOLUTE /end AXIS_DESCR
/end CHARACTERISTIC
/begin CHARACTERISTIC DewDet_S1B1_I.facCatHeatgIntrpnWtrCntntGslSecFu_T "Instance of dew point end class of sensor 1 at bank 1 / interpolation factor can be varied depending on water content in different fuel types in catalyst heating block." CURVE 0x80549450 RB_Curve_U16_U16 1.999969 fak_uw_b2 0.00 1.999969 FORMAT "%8.6"
 /begin AXIS_DESCR STD_AXIS ExhMod_facIntrpnGslSecFu fak_uw_b2 5 0.00 1.999969 FORMAT "%8.6" DEPOSIT ABSOLUTE /end AXIS_DESCR
/end CHARACTERISTIC
/begin CHARACTERISTIC DewDet_S1B1_I.facCatHeatgSecFu_T "Instance of dew point end class of sensor 1 at bank 1 / Corrective characteristic for heat quantity while catalyst heating sensor second fuel (CNG)" CURVE 0x80549466 RB_CurveGroup_U8 31.88 fak_ub_b32 0.00 31.88 FORMAT "%5.2"
 /begin AXIS_DESCR COM_AXIS NO_INPUT_QUANTITY Temp_Cels 10 -3549.940 3003.560 FORMAT "%8.3" AXIS_PTS_REF STN10TMUB /end AXIS_DESCR
/end CHARACTERISTIC
/begin CHARACTERISTIC DewDet_S1B1_I.facCatHeatgWoExo_T "Instance of dew point end class of sensor 1 at bank 1 / Corrective characteristic for heat quantity while catalyst heating without thermal reaction sensor" CURVE 0x80549470 RB_CurveGroup_U8 31.88 fak_ub_b32 0.00 31.88 FORMAT "%5.2"
 /begin AXIS_DESCR COM_AXIS NO_INPUT_QUANTITY Temp_Cels 10 -3549.940 3003.560 FORMAT "%8.3" AXIS_PTS_REF STN10TMUB /end AXIS_DESCR
/end CHARACTERISTIC
/begin CHARACTERISTIC DewDet_S1B1_I.facCatHeatg_T "Instance of dew point end class of sensor 1 at bank 1 / corrective characteristic for heat quantity while catalyst heating sensor" CURVE 0x8054947A RB_CurveGroup_U8 31.88 fak_ub_b32 0.00 31.88 FORMAT "%5.2"
 /begin AXIS_DESCR COM_AXIS NO_INPUT_QUANTITY Temp_Cels 10 -3549.940 3003.560 FORMAT "%8.3" AXIS_PTS_REF STN10TMUB /end AXIS_DESCR
/end CHARACTERISTIC
/begin CHARACTERISTIC DewDet_S1B1_I.facCoolgAcmEgy_T "Instance of dew point end class of sensor 1 at bank 1 / weighting accumulated heat quantity (last trip) of sensor dependent on turn off time" CURVE 0x80549484 RB_Curve_U16_U8_Static 0.9961 fak_ub_b1 0.00 0.9961
 /begin AXIS_DESCR STD_AXIS DewDet_S1B1_I.tiShtDwn t1sxs_uw_q1 8 0.00 65535.00 FORMAT "%8.2" DEPOSIT ABSOLUTE /end AXIS_DESCR
/end CHARACTERISTIC
/begin CHARACTERISTIC DewDet_S1B1_I.facCoolgSnrs_T "Instance of dew point end class of sensor 1 at bank 1 / factor reduction of temperature of sensor = f(stop time)" CURVE 0x8054949E RB_CurveGroup_U8 1.000000 fak_ub_b2 0.00 1.000000 FORMAT "%8.6" EXTENDED_LIMITS 0.00 1.992188
 /begin AXIS_DESCR COM_AXIS DewDet_tiShDown t1sxs_uw_q1 8 0.00 65535.00 FORMAT "%8.2" AXIS_PTS_REF STS08TMUW /end AXIS_DESCR
/end CHARACTERISTIC
/begin CHARACTERISTIC DewDet_S1B1_I.facCoolgTWall_T "Instance of dew point end class of sensor 1 at bank 1 / factor reduction of temperature of sensor = f(stop time) in stop phase" CURVE 0x805494A6 RB_CurveGroup_U8 1.000000 fak_ub_b2 0.00 1.000000 FORMAT "%8.6" EXTENDED_LIMITS 0.00 1.992188
 /begin AXIS_DESCR COM_AXIS DewDet_tiShDown t1sxs_uw_q1 8 0.00 65535.00 FORMAT "%8.2" AXIS_PTS_REF STS08TMUW /end AXIS_DESCR
/end CHARACTERISTIC
/begin CHARACTERISTIC DewDet_S1B1_I.facCorrnMFlow_T "Instance of dew point end class of sensor 1 at bank 1 / Corrective characteristic for integrated heat quantity sensor dependent on mass flow exhaust gas" CURVE 0x805494B0 RB_Curve_R32_U16_Static 1.992188 fak_ub_b2 0.00 1.992188 FORMAT "%8.6" EXTENDED_LIMITS 0.00 511.9922
 /begin AXIS_DESCR STD_AXIS DewDet_S1B1_I.mfExhSnsr RBPtCel_mf_1p0_1 8 -100000.000 100000.000 FORMAT "%10.3" EXTENDED_LIMITS -3.40282347E+038 3.40282347E+038 DEPOSIT ABSOLUTE /end AXIS_DESCR
/end CHARACTERISTIC
/begin CHARACTERISTIC DewDet_S1B1_I.facHeatThdCldStrtCntr_T "Instance of dew point end class of sensor 1 at bank 1 / Factor to adjust the heat energy threshold depending on the could start counter and the start temperature" CURVE 0x805494E4 RB_Curve_S16_U8_Static 2.550 fak_q0p01 0.00 2.550 FORMAT "%5.3"
 /begin AXIS_DESCR STD_AXIS DewDet_S1B1_I.tSnsrStrt Temp_Cels 4 -3549.940 3003.560 FORMAT "%8.3" DEPOSIT ABSOLUTE /end AXIS_DESCR
/end CHARACTERISTIC
/begin CHARACTERISTIC DewDet_S1B1_I.facHeatThdIntrpnWtrCntntGslSecFu_T "Instance of dew point end class of sensor 1 at bank 1 / interpolation factor that varies depending on the water content for different fuel types in threshold block." CURVE 0x805494F2 RB_Curve_U16_U16 1.999969 fak_uw_b2 0.00 1.999969 FORMAT "%8.6"
 /begin AXIS_DESCR STD_AXIS ExhMod_facIntrpnGslSecFu fak_uw_b2 5 0.00 1.999969 FORMAT "%8.6" DEPOSIT ABSOLUTE /end AXIS_DESCR
/end CHARACTERISTIC
/begin CHARACTERISTIC DewDet_S1B1_I.facHeatThdOffs_T "Instance of dew point end class of sensor 1 at bank 1 / Factor for calculating the offset for the heat quantity threshold" CURVE 0x80549508 RB_Curve_S16_U8_Static 2.550 fak_q0p01 0.00 2.550 FORMAT "%5.3"
 /begin AXIS_DESCR STD_AXIS NO_INPUT_QUANTITY Temp_Cels 10 -3549.940 3003.560 FORMAT "%8.3" DEPOSIT ABSOLUTE /end AXIS_DESCR
/end CHARACTERISTIC
/begin CHARACTERISTIC DewDet_S1B1_I.facRednHeatFlowIntSec_C "Instance of dew point end class of sensor 1 at bank 1 / factor reduction heat quantity during engine stop sensor dt independent" VALUE 0x80549528 RB_Val_Wu16 63.99902 q9p7656Em4_kJ_DIV_K 0.00 63.99902 FORMAT "%8.5" /end CHARACTERISTIC
/begin CHARACTERISTIC DewDet_S1B1_I.nrCldStrtSnsrProdLine_C "Instance of dew point end class of sensor 1 at bank 1 / local powerfail information dew-point end" VALUE 0x8054952A RB_Val_Wu8 255.0 dez 0.00 255.0 FORMAT "%5.1" /end CHARACTERISTIC
/begin CHARACTERISTIC DewDet_S1B1_I.nrMaxCldStrtSnsr_C "Instance of dew point end class of sensor 1 at bank 1 / maximum cold start counter of sensor for dew point end" VALUE 0x8054952B RB_Val_Wu8 255.0 dez 0.00 255.0 FORMAT "%5.1" /end CHARACTERISTIC
/begin CHARACTERISTIC DewDet_S1B1_I.ratMinHeatThdCldStrt_T "Instance of dew point end class of sensor 1 at bank 1 / map minimum ratio heat-quantity to threshold for unchanged cold start counter sensor" CURVE 0x8054952C RB_Curve_S16_U16_Static 0.9960938 fak_ub_b1 0.00 0.9960938 FORMAT "%9.7" EXTENDED_LIMITS 0.00 255.9961
 /begin AXIS_DESCR STD_AXIS ExhMod_tEnvDewDet Temp_Cels 4 -3549.940 3003.560 FORMAT "%8.3" DEPOSIT ABSOLUTE /end AXIS_DESCR
/end CHARACTERISTIC
/begin CHARACTERISTIC DewDet_S1B1_I.ratThdNEngRelFuMSet_T "Instance of dew point end class of sensor 1 at bank 1 / threshold current energy input for dew-point end reset if dew-point end of sensor set" CURVE 0x8054953E RB_Curve_S16_U16_Static 50330880. relnmot_q768 0.00 50330880. FORMAT "%8.0"
 /begin AXIS_DESCR STD_AXIS ExhMod_tEnvDewDet Temp_Cels 4 -3549.940 3003.560 FORMAT "%8.3" DEPOSIT ABSOLUTE /end AXIS_DESCR
/end CHARACTERISTIC
/begin CHARACTERISTIC DewDet_S1B1_I.ratThdNEngRelFuM_T "Instance of dew point end class of sensor 1 at bank 1 / threshold current energy input for dew-point end reset" CURVE 0x80549550 RB_Curve_S16_U16_Static 50330880. relnmot_q768 0.00 50330880. FORMAT "%8.0"
 /begin AXIS_DESCR STD_AXIS ExhMod_tEnvDewDet Temp_Cels 4 -3549.940 3003.560 FORMAT "%8.3" DEPOSIT ABSOLUTE /end AXIS_DESCR
/end CHARACTERISTIC
/begin CHARACTERISTIC DewDet_S1B1_I.tMinNoRstIntEngOff_C "Instance of dew point end class of sensor 1 at bank 1 / temperature threshold for reset condition dew point end of sensor at engine stop" VALUE 0x80549562 RB_Val_Ws16 6553.500 Temp_Cels -3549.940 3003.560 FORMAT "%8.3" /end CHARACTERISTIC
/begin CHARACTERISTIC DewDet_S1B1_I.tMinNoRstInt_C "Instance of dew point end class of sensor 1 at bank 1 / minimum exhaust gas temperature sensor at which water still evaporates at idle" VALUE 0x80549564 RB_Val_Ws16 6553.500 Temp_Cels -3549.940 3003.560 FORMAT "%8.3" /end CHARACTERISTIC
/begin CHARACTERISTIC DewDet_S1B1_I.tThdHeatFlowInt_C "Instance of dew point end class of sensor 1 at bank 1 / representative wall temperature for heat quantity calculation sensor" VALUE 0x80549566 RB_Val_Ws16 6553.500 Temp_Cels -3549.940 3003.560 FORMAT "%8.3" /end CHARACTERISTIC
/begin CHARACTERISTIC DewDet_S1B1_I.tiDlyRstIntEngOff_T "Instance of dew point end class of sensor 1 at bank 1 / time delay to reset the heat quantity integrator at engine stop" CURVE 0x80549568 RB_Curve_S16_U16_Static 3276.750 t_q0p05 0.00 3276.750 FORMAT "%8.3"
 /begin AXIS_DESCR STD_AXIS ExhMod_tEnvDewDet Temp_Cels 5 -3549.940 3003.560 FORMAT "%8.3" DEPOSIT ABSOLUTE /end AXIS_DESCR
/end CHARACTERISTIC
/begin CHARACTERISTIC DewDet_S1B1_I.tiDlyRstInt_C "Instance of dew point end class of sensor 1 at bank 1 / time delay to reset the heat quantity integrator" VALUE 0x8054957E RB_Val_Wu16 3276.750 t_q0p05 0.00 3276.750 FORMAT "%8.3" /end CHARACTERISTIC
/begin CHARACTERISTIC DewDet_S2B1_I.egyThdSecFu_M "Instance of dew point end class of sensor 2 at bank 1 / map heat quantity threshold for dew-point end second fuel (CNG or flex-fuel)" MAP 0x80549588 RB_Map_S16S16_S16 32767.00 q_q1_kJ 0.00 32767.00 FORMAT "%8.2" EXTENDED_LIMITS -32768.00 32767.00
 /begin AXIS_DESCR STD_AXIS DewDet_S2B1_I.tSnsrStrt Temp_Cels 10 -3549.940 3003.560 FORMAT "%8.3" DEPOSIT ABSOLUTE /end AXIS_DESCR
 /begin AXIS_DESCR STD_AXIS ExhMod_tEngStrtDewDet Temp_Cels 10 -3549.940 3003.560 FORMAT "%8.3" DEPOSIT ABSOLUTE /end AXIS_DESCR
/end CHARACTERISTIC
/begin CHARACTERISTIC DewDet_S2B1_I.egyThd_M "Instance of dew point end class of sensor 2 at bank 1 / map heat quantity threshold for dew-point end" MAP 0x8054967C RB_Map_S16S16_S16 32767.00 q_q1_kJ 0.00 32767.00 FORMAT "%8.2" EXTENDED_LIMITS -32768.00 32767.00
 /begin AXIS_DESCR STD_AXIS DewDet_S2B1_I.tSnsrStrt Temp_Cels 10 -3549.940 3003.560 FORMAT "%8.3" DEPOSIT ABSOLUTE /end AXIS_DESCR
 /begin AXIS_DESCR STD_AXIS ExhMod_tEngStrtDewDet Temp_Cels 10 -3549.940 3003.560 FORMAT "%8.3" DEPOSIT ABSOLUTE /end AXIS_DESCR
/end CHARACTERISTIC
/begin CHARACTERISTIC DewDet_S2B1_I.facCatHeatgIntrpnWtrCntntGslSecFu_T "Instance of dew point end class of sensor 2 at bank 1 / interpolation factor can be varied depending on water content in different fuel types in catalyst heating block." CURVE 0x80549770 RB_Curve_U16_U16 1.999969 fak_uw_b2 0.00 1.999969 FORMAT "%8.6"
 /begin AXIS_DESCR STD_AXIS ExhMod_facIntrpnGslSecFu fak_uw_b2 5 0.00 1.999969 FORMAT "%8.6" DEPOSIT ABSOLUTE /end AXIS_DESCR
/end CHARACTERISTIC
/begin CHARACTERISTIC DewDet_S2B1_I.facCatHeatgSecFu_T "Instance of dew point end class of sensor 2 at bank 1 / Corrective characteristic for heat quantity while catalyst heating sensor second fuel (CNG)" CURVE 0x80549786 RB_CurveGroup_U8 31.88 fak_ub_b32 0.00 31.88 FORMAT "%5.2"
 /begin AXIS_DESCR COM_AXIS NO_INPUT_QUANTITY Temp_Cels 10 -3549.940 3003.560 FORMAT "%8.3" AXIS_PTS_REF STN10TMUB /end AXIS_DESCR
/end CHARACTERISTIC
/begin CHARACTERISTIC DewDet_S2B1_I.facCatHeatgWoExo_T "Instance of dew point end class of sensor 2 at bank 1 / Corrective characteristic for heat quantity while catalyst heating without thermal reaction sensor" CURVE 0x80549790 RB_CurveGroup_U8 31.88 fak_ub_b32 0.00 31.88 FORMAT "%5.2"
 /begin AXIS_DESCR COM_AXIS NO_INPUT_QUANTITY Temp_Cels 10 -3549.940 3003.560 FORMAT "%8.3" AXIS_PTS_REF STN10TMUB /end AXIS_DESCR
/end CHARACTERISTIC
/begin CHARACTERISTIC DewDet_S2B1_I.facCatHeatg_T "Instance of dew point end class of sensor 2 at bank 1 / corrective characteristic for heat quantity while catalyst heating sensor" CURVE 0x8054979A RB_CurveGroup_U8 31.88 fak_ub_b32 0.00 31.88 FORMAT "%5.2"
 /begin AXIS_DESCR COM_AXIS NO_INPUT_QUANTITY Temp_Cels 10 -3549.940 3003.560 FORMAT "%8.3" AXIS_PTS_REF STN10TMUB /end AXIS_DESCR
/end CHARACTERISTIC
/begin CHARACTERISTIC DewDet_S2B1_I.facCoolgAcmEgy_T "Instance of dew point end class of sensor 2 at bank 1 / weighting accumulated heat quantity (last trip) of sensor dependent on turn off time" CURVE 0x805497A4 RB_Curve_U16_U8_Static 0.9961 fak_ub_b1 0.00 0.9961
 /begin AXIS_DESCR STD_AXIS DewDet_S2B1_I.tiShtDwn t1sxs_uw_q1 8 0.00 65535.00 FORMAT "%8.2" DEPOSIT ABSOLUTE /end AXIS_DESCR
/end CHARACTERISTIC
/begin CHARACTERISTIC DewDet_S2B1_I.facCoolgSnrs_T "Instance of dew point end class of sensor 2 at bank 1 / factor reduction of temperature of sensor = f(stop time)" CURVE 0x805497BE RB_CurveGroup_U8 1.000000 fak_ub_b2 0.00 1.000000 FORMAT "%8.6" EXTENDED_LIMITS 0.00 1.992188
 /begin AXIS_DESCR COM_AXIS DewDet_tiShDown t1sxs_uw_q1 8 0.00 65535.00 FORMAT "%8.2" AXIS_PTS_REF STS08TMUW /end AXIS_DESCR
/end CHARACTERISTIC
/begin CHARACTERISTIC DewDet_S2B1_I.facCoolgTWall_T "Instance of dew point end class of sensor 2 at bank 1 / factor reduction of temperature of sensor = f(stop time) in stop phase" CURVE 0x805497C6 RB_CurveGroup_U8 1.000000 fak_ub_b2 0.00 1.000000 FORMAT "%8.6" EXTENDED_LIMITS 0.00 1.992188
 /begin AXIS_DESCR COM_AXIS DewDet_tiShDown t1sxs_uw_q1 8 0.00 65535.00 FORMAT "%8.2" AXIS_PTS_REF STS08TMUW /end AXIS_DESCR
/end CHARACTERISTIC
/begin CHARACTERISTIC DewDet_S2B1_I.facCorrnMFlow_T "Instance of dew point end class of sensor 2 at bank 1 / Corrective characteristic for integrated heat quantity sensor dependent on mass flow exhaust gas" CURVE 0x805497D0 RB_Curve_R32_U16_Static 1.992188 fak_ub_b2 0.00 1.992188 FORMAT "%8.6" EXTENDED_LIMITS 0.00 511.9922
 /begin AXIS_DESCR STD_AXIS DewDet_S2B1_I.mfExhSnsr RBPtCel_mf_1p0_1 8 -100000.000 100000.000 FORMAT "%10.3" EXTENDED_LIMITS -3.40282347E+038 3.40282347E+038 DEPOSIT ABSOLUTE /end AXIS_DESCR
/end CHARACTERISTIC
/begin CHARACTERISTIC DewDet_S2B1_I.facHeatThdCldStrtCntr_T "Instance of dew point end class of sensor 2 at bank 1 / Factor to adjust the heat energy threshold depending on the could start counter and the start temperature" CURVE 0x80549804 RB_Curve_S16_U8_Static 2.550 fak_q0p01 0.00 2.550 FORMAT "%5.3"
 /begin AXIS_DESCR STD_AXIS DewDet_S2B1_I.tSnsrStrt Temp_Cels 4 -3549.940 3003.560 FORMAT "%8.3" DEPOSIT ABSOLUTE /end AXIS_DESCR
/end CHARACTERISTIC
/begin CHARACTERISTIC DewDet_S2B1_I.facHeatThdIntrpnWtrCntntGslSecFu_T "Instance of dew point end class of sensor 2 at bank 1 / interpolation factor that varies depending on the water content for different fuel types in threshold block." CURVE 0x80549812 RB_Curve_U16_U16 1.999969 fak_uw_b2 0.00 1.999969 FORMAT "%8.6"
 /begin AXIS_DESCR STD_AXIS ExhMod_facIntrpnGslSecFu fak_uw_b2 5 0.00 1.999969 FORMAT "%8.6" DEPOSIT ABSOLUTE /end AXIS_DESCR
/end CHARACTERISTIC
/begin CHARACTERISTIC DewDet_S2B1_I.facHeatThdOffs_T "Instance of dew point end class of sensor 2 at bank 1 / Factor for calculating the offset for the heat quantity threshold" CURVE 0x80549828 RB_Curve_S16_U8_Static 2.550 fak_q0p01 0.00 2.550 FORMAT "%5.3"
 /begin AXIS_DESCR STD_AXIS NO_INPUT_QUANTITY Temp_Cels 10 -3549.940 3003.560 FORMAT "%8.3" DEPOSIT ABSOLUTE /end AXIS_DESCR
/end CHARACTERISTIC
/begin CHARACTERISTIC DewDet_S2B1_I.facRednHeatFlowIntSec_C "Instance of dew point end class of sensor 2 at bank 1 / factor reduction heat quantity during engine stop sensor dt independent" VALUE 0x80549848 RB_Val_Wu16 63.99902 q9p7656Em4_kJ_DIV_K 0.00 63.99902 FORMAT "%8.5" /end CHARACTERISTIC
/begin CHARACTERISTIC DewDet_S2B1_I.nrCldStrtSnsrProdLine_C "Instance of dew point end class of sensor 2 at bank 1 / local powerfail information dew-point end" VALUE 0x8054984A RB_Val_Wu8 255.0 dez 0.00 255.0 FORMAT "%5.1" /end CHARACTERISTIC
/begin CHARACTERISTIC DewDet_S2B1_I.nrMaxCldStrtSnsr_C "Instance of dew point end class of sensor 2 at bank 1 / maximum cold start counter of sensor for dew point end" VALUE 0x8054984B RB_Val_Wu8 255.0 dez 0.00 255.0 FORMAT "%5.1" /end CHARACTERISTIC
/begin CHARACTERISTIC DewDet_S2B1_I.ratMinHeatThdCldStrt_T "Instance of dew point end class of sensor 2 at bank 1 / map minimum ratio heat-quantity to threshold for unchanged cold start counter sensor" CURVE 0x8054984C RB_Curve_S16_U16_Static 0.9960938 fak_ub_b1 0.00 0.9960938 FORMAT "%9.7" EXTENDED_LIMITS 0.00 255.9961
 /begin AXIS_DESCR STD_AXIS ExhMod_tEnvDewDet Temp_Cels 4 -3549.940 3003.560 FORMAT "%8.3" DEPOSIT ABSOLUTE /end AXIS_DESCR
/end CHARACTERISTIC
/begin CHARACTERISTIC DewDet_S2B1_I.ratThdNEngRelFuMSet_T "Instance of dew point end class of sensor 2 at bank 1 / threshold current energy input for dew-point end reset if dew-point end of sensor set" CURVE 0x8054985E RB_Curve_S16_U16_Static 50330880. relnmot_q768 0.00 50330880. FORMAT "%8.0"
 /begin AXIS_DESCR STD_AXIS ExhMod_tEnvDewDet Temp_Cels 4 -3549.940 3003.560 FORMAT "%8.3" DEPOSIT ABSOLUTE /end AXIS_DESCR
/end CHARACTERISTIC
/begin CHARACTERISTIC DewDet_S2B1_I.ratThdNEngRelFuM_T "Instance of dew point end class of sensor 2 at bank 1 / threshold current energy input for dew-point end reset" CURVE 0x80549870 RB_Curve_S16_U16_Static 50330880. relnmot_q768 0.00 50330880. FORMAT "%8.0"
 /begin AXIS_DESCR STD_AXIS ExhMod_tEnvDewDet Temp_Cels 4 -3549.940 3003.560 FORMAT "%8.3" DEPOSIT ABSOLUTE /end AXIS_DESCR
/end CHARACTERISTIC
/begin CHARACTERISTIC DewDet_S2B1_I.tMinNoRstIntEngOff_C "Instance of dew point end class of sensor 2 at bank 1 / temperature threshold for reset condition dew point end of sensor at engine stop" VALUE 0x80549882 RB_Val_Ws16 6553.500 Temp_Cels -3549.940 3003.560 FORMAT "%8.3" /end CHARACTERISTIC
/begin CHARACTERISTIC DewDet_S2B1_I.tMinNoRstInt_C "Instance of dew point end class of sensor 2 at bank 1 / minimum exhaust gas temperature sensor at which water still evaporates at idle" VALUE 0x80549884 RB_Val_Ws16 6553.500 Temp_Cels -3549.940 3003.560 FORMAT "%8.3" /end CHARACTERISTIC
/begin CHARACTERISTIC DewDet_S2B1_I.tThdHeatFlowInt_C "Instance of dew point end class of sensor 2 at bank 1 / representative wall temperature for heat quantity calculation sensor" VALUE 0x80549886 RB_Val_Ws16 6553.500 Temp_Cels -3549.940 3003.560 FORMAT "%8.3" /end CHARACTERISTIC
/begin CHARACTERISTIC DewDet_S2B1_I.tiDlyRstIntEngOff_T "Instance of dew point end class of sensor 2 at bank 1 / time delay to reset the heat quantity integrator at engine stop" CURVE 0x80549888 RB_Curve_S16_U16_Static 3276.750 t_q0p05 0.00 3276.750 FORMAT "%8.3"
 /begin AXIS_DESCR STD_AXIS ExhMod_tEnvDewDet Temp_Cels 5 -3549.940 3003.560 FORMAT "%8.3" DEPOSIT ABSOLUTE /end AXIS_DESCR
/end CHARACTERISTIC
/begin CHARACTERISTIC DewDet_S2B1_I.tiDlyRstInt_C "Instance of dew point end class of sensor 2 at bank 1 / time delay to reset the heat quantity integrator" VALUE 0x8054989E RB_Val_Wu16 3276.750 t_q0p05 0.00 3276.750 FORMAT "%8.3" /end CHARACTERISTIC
/begin CHARACTERISTIC DewDet_stConfSnsrAryB1_CA "code word block to activate sensor specific dew point end features for sensors of bank 1" VAL_BLK 0x8054920A RB_ValA_Wu16 65535.00 dez 0.00 65535.00 FORMAT "%8.2" NUMBER 2 /end CHARACTERISTIC
/begin CHARACTERISTIC DewDet_stConf_C "Code word to activate features to determination for dew point end" VALUE 0x80549210 RB_Val_Wu32 4294967295.00 dez 0.00 4294967295.00 FORMAT "%13.2" /end CHARACTERISTIC
/begin CHARACTERISTIC DewDet_stOffTiConf_C "Codeword usage of engine turn off time for dew point end detection" VALUE 0x80549214 RB_Val_Wu8 255.0 dez 0.00 255.0 FORMAT "%5.1" /end CHARACTERISTIC
/begin CHARACTERISTIC DewDet_tEngStrtMinAcm_C "temperature threshold engine start temperature for setting of condition for calculation accumulation of heat-quantity" VALUE 0x80549216 RB_Val_Ws16 6553.500 Temp_Cels -3549.940 3003.560 FORMAT "%8.3" /end CHARACTERISTIC
/begin CHARACTERISTIC DewDet_tEnvMinAcm_C "minimum ambient temperature for setting of condition for calculation accumulation of heat-quantity" VALUE 0x80549218 RB_Val_Ws16 6553.500 Temp_Cels -3549.940 3003.560 FORMAT "%8.3" /end CHARACTERISTIC
/begin CHARACTERISTIC DewDet_tiDlyNEngRelFuM_C "" VALUE 0x80549200 RB_Val_Wu8 12.75 t_q0p05 0.00 12.75 FORMAT "%5.2" /end CHARACTERISTIC
/begin CHARACTERISTIC DewDet_tiMaxSwtOffCldStrt_C "maximum switch off time for logic cold start counter" VALUE 0x80549202 RB_Val_Wu16 65535.00 t1sxs_uw_q1 0.00 65535.00 FORMAT "%8.2" /end CHARACTERISTIC
/begin CHARACTERISTIC DewDet_tiMaxSwtOffWrmStrt_C "switch off time up to cold start can be assumed for logic cold start counter" VALUE 0x80549204 RB_Val_Wu16 65535.00 t1sxs_uw_q1 0.00 65535.00 FORMAT "%8.2" /end CHARACTERISTIC
/begin CHARACTERISTIC DewDet_tiProlgNEngRelFuM_C "turn off delay for flag current energy input lower threshold sensor or fuel cut-off" VALUE 0x80549206 RB_Val_Wu8 12.75 t_q0p05 0.00 12.75 FORMAT "%5.2" /end CHARACTERISTIC
/begin CHARACTERISTIC DewDet_tiProlgProdLine_C "Turn off delay for prolongation of B_fabe for cold start counter during end of line test" VALUE 0x8054921A RB_Val_Wu16 3276.750 t_q0p05 0.00 3276.750 FORMAT "%8.3" /end CHARACTERISTIC
/begin CHARACTERISTIC DewDet_tMinEnvCldStrt_C "minumum ambient temperature for logic cold start counter" VALUE 0x80549208 RB_Val_Ws16 6553.500 Temp_Cels -3549.940 3003.560 FORMAT "%8.3" /end CHARACTERISTIC
/begin CHARACTERISTIC ExhMgT_facDftlCptProtnGovr_M "factor for D-part of exhaust temperature controller, bench1" MAP 0x805483F0 RB_Map_S16S16_S16 655.3500 fak_q0p01 -327.6800 327.6700 FORMAT "%8.4"
 /begin AXIS_DESCR STD_AXIS ExhMgT_tMinTExhGovrCptProtnB1 temp_q0p1_K 12 -3276.800 3276.700 FORMAT "%8.3" DEPOSIT ABSOLUTE /end AXIS_DESCR
 /begin AXIS_DESCR STD_AXIS ExhMgT_tMinGrdtTExhGovrB1 temp_q0p1_K 12 -3276.800 3276.700 FORMAT "%8.3" DEPOSIT ABSOLUTE /end AXIS_DESCR
/end CHARACTERISTIC
/begin CHARACTERISTIC ExhMgT_facDftlTGovrCptProtnCorrnB1_C "correction factor for D-part of exhaust temperature controller" VALUE 0x80548544 RB_Val_Wu16 655.3500 fak_q0p01 0.00 655.3500 FORMAT "%8.4" /end CHARACTERISTIC
/begin CHARACTERISTIC ExhMgT_facIvsExhMassMax_C "inversereciprocal value of maximum possible exhaust gas flow for normalization of ATR" VALUE 0x80548546 RB_Val_Wu16 0.04999924 fak_uw_b0p05 0.00 0.04999924 FORMAT "%10.8" /end CHARACTERISTIC
/begin CHARACTERISTIC ExhMgT_facKiCptProtnGovr1B1_M "amplification factor for i-part of exhaust temperature controller, bench1 controler 1" MAP 0x80548548 RB_Map_S16U16_U16 99.99695 fak_uw_b100 0.00153 99.99847 FORMAT "%8.5" EXTENDED_LIMITS 0.00 99.99847
 /begin AXIS_DESCR STD_AXIS ExhMgT_tMinTExhGovrCptProtnB1 temp_q0p1_K 8 -3276.800 3276.700 FORMAT "%8.3" DEPOSIT ABSOLUTE /end AXIS_DESCR
 /begin AXIS_DESCR STD_AXIS NO_INPUT_QUANTITY m_uw_b6553p5 4 0.00 6553.500 FORMAT "%8.3" DEPOSIT ABSOLUTE /end AXIS_DESCR
/end CHARACTERISTIC
/begin CHARACTERISTIC ExhMgT_facKiCptProtnGovr_C "factor for i-part of exhaust temperature controller, bench1" VALUE 0x805485A4 RB_Val_Wu16 0.02441247 zk100msrtemp_q1p589em6 0.00000159 0.02441406 FORMAT "%10.8" EXTENDED_LIMITS 0.00 0.1041651 /end CHARACTERISTIC
/begin CHARACTERISTIC ExhMgT_facKpCptProtnGovr_T "proportional gain for exhaust temperature control over temperature deviation" CURVE 0x805485A6 RB_Curve_S16_U16_Static 0.08333206 tempr_q1p272Em6 0.00 0.08333206 FORMAT "%10.8"
 /begin AXIS_DESCR STD_AXIS ExhMgT_tMinTExhGovrCptProtnB1 temp_q0p1_K 5 -3276.800 3276.700 FORMAT "%8.3" DEPOSIT ABSOLUTE /end AXIS_DESCR
/end CHARACTERISTIC
/begin CHARACTERISTIC ExhMgT_nrTExhArySeldB1_C "choice of exhaust temperature from array ExhMod_tExhAryB1" VALUE 0x805485BC RB_Val_Wu16 32767.00 dez 0.00 32767.00 FORMAT "%8.2" EXTENDED_LIMITS 0.00 65535.00 /end CHARACTERISTIC
/begin CHARACTERISTIC ExhMgT_ratChrgExhCptProtn_M "minimum load for exhaust temperature control" MAP 0x805485BE RB_Map_S16S16_U16 1535.977 rel_uw_q0p0234 0.00 1535.977 FORMAT "%8.3"
 /begin AXIS_DESCR STD_AXIS Epm_nEng EngN 5 -16384.00 16383.50 FORMAT "%8.2" DEPOSIT ABSOLUTE /end AXIS_DESCR
 /begin AXIS_DESCR STD_AXIS IntkAirT_tThrVlvUs temp_q0p1_o273 5 -3549.940 3003.560 FORMAT "%8.3" DEPOSIT ABSOLUTE /end AXIS_DESCR
/end CHARACTERISTIC
/begin CHARACTERISTIC ExhMgT_ratDeltaCptProtnGovrCorrn1_C "negative value for d-part controller 1, from which the d-part will be set to 0 after a temperatur jump" VALUE 0x80548608 RB_Val_Ws16 8.000000 fak_sw_b8 -8.000000 0.00 FORMAT "%8.6" EXTENDED_LIMITS -8.000000 7.999756 /end CHARACTERISTIC
/begin CHARACTERISTIC ExhMgT_ratDeltaCptProtnGovrMin_M "minimum limit exhaust temperature controller" MAP 0x8054860A RB_Map_S16U16_S16 0.3999023 fak_sw_b8 -0.3999023 0.00 FORMAT "%9.7" EXTENDED_LIMITS -8.000000 7.999756
 /begin AXIS_DESCR STD_AXIS Epm_nEng EngN 16 -16384.00 16383.50 FORMAT "%8.2" DEPOSIT ABSOLUTE /end AXIS_DESCR
 /begin AXIS_DESCR STD_AXIS AirMod_ratChrgAirCyl rel_uw_q0p0234 15 0.00 1535.977 FORMAT "%8.3" DEPOSIT ABSOLUTE /end AXIS_DESCR
/end CHARACTERISTIC
/begin CHARACTERISTIC ExhMgT_ratDeltaLamCptProtnGovrMax_C "Maximum limit of actuator for exhaust gas temperature feedback control" VALUE 0x8054882C RB_Val_Ws16 0.1499023 fak_sw_b8 0.00 0.1499023 FORMAT "%9.7" EXTENDED_LIMITS -8.000000 7.999756 /end CHARACTERISTIC
/begin CHARACTERISTIC ExhMgT_ratDeltaLamDftlCptProtnGovr_M "D-part of exhaust temperature controller (Delta-Lambda)" MAP 0x8054882E RB_Map_S16S16_S16 8.000000 fak_sw_b8 -8.000000 0.00 FORMAT "%8.6" EXTENDED_LIMITS -8.000000 7.999756
 /begin AXIS_DESCR STD_AXIS ExhMgT_tMinTExhGovrCptProtnB1 temp_q0p1_K 12 -3276.800 3276.700 FORMAT "%8.3" DEPOSIT ABSOLUTE /end AXIS_DESCR
 /begin AXIS_DESCR STD_AXIS ExhMgT_tMinGrdtTExhGovrB1 temp_q0p1_K 12 -3276.800 3276.700 FORMAT "%8.3" DEPOSIT ABSOLUTE /end AXIS_DESCR
/end CHARACTERISTIC
/begin CHARACTERISTIC ExhMgT_ratLamDeltaLeanCat1_C "hysteresis for threshold for catalyst 1 for enable of fuel cut-off" VALUE 0x8054837C RB_Val_Wu16 15.99976 fak_uw_b16 0.00 15.99976 FORMAT "%8.5" /end CHARACTERISTIC
/begin CHARACTERISTIC ExhMgT_ratLamDeltaLeanCat2_C "hysteresis for threshold for catalyst 2 for enable of fuel cut-off" VALUE 0x8054837E RB_Val_Wu16 15.99976 fak_uw_b16 0.00 15.99976 FORMAT "%8.5" /end CHARACTERISTIC
/begin CHARACTERISTIC ExhMgT_ratLamLeanCat1_C "exhaust lambda threshold for catalyst 1 for enable of fuel cut-off" VALUE 0x80548380 RB_Val_Wu16 14.99976 fak_uw_b16 1.00000 15.99976 FORMAT "%8.5" EXTENDED_LIMITS 0.00 15.99976 /end CHARACTERISTIC
/begin CHARACTERISTIC ExhMgT_ratLamLeanCat2_C "exhaust lambda threshold for catalyst 2 for enable of fuel cut-off" VALUE 0x80548382 RB_Val_Wu16 14.99976 fak_uw_b16 1.00000 15.99976 FORMAT "%8.5" EXTENDED_LIMITS 0.00 15.99976 /end CHARACTERISTIC
/begin CHARACTERISTIC ExhMgT_stCptProtnFil_C "code word for the function release fuel cutoff for component protection" VALUE 0x80548384 RB_Val_Wu8 255.0 dez 0.00 255.0 FORMAT "%5.1" /end CHARACTERISTIC
/begin CHARACTERISTIC ExhMgT_stTExhFild_C "code word for the filtered temperatures for component protection" VALUE 0x80548385 RB_Val_Wu8 255.0 dez 0.00 255.0 FORMAT "%5.1" /end CHARACTERISTIC
/begin CHARACTERISTIC ExhMgT_stTGovr2_C "codeword of function ATR" VALUE 0x80548982 RB_Val_Wu8 255.0 dez 0.00 255.0 FORMAT "%5.1" /end CHARACTERISTIC
/begin CHARACTERISTIC ExhMgT_stTGovr3_C "codeword of function ATR" VALUE 0x80548983 RB_Val_Wu8 255.0 dez 0.00 255.0 FORMAT "%5.1" /end CHARACTERISTIC
/begin CHARACTERISTIC ExhMgT_stTGovr_C "codeword of function ATR" VALUE 0x80548984 RB_Val_Wu8 255.0 dez 0.00 255.0 FORMAT "%5.1" /end CHARACTERISTIC
/begin CHARACTERISTIC ExhMgT_tCat1MaxFcoMax_C "maximal temperature inside 1.catalyst for enable of cut off" VALUE 0x80548386 RB_Val_Ws16 3276.700 temp_q0p1_o273 -273.140 3003.560 FORMAT "%8.3" EXTENDED_LIMITS -3549.940 3003.560 /end CHARACTERISTIC
/begin CHARACTERISTIC ExhMgT_tCat1MaxFcoMin_C "minimum temperature in 1.catalyst for the release of the overrun fuel cut" VALUE 0x80548388 RB_Val_Ws16 3276.700 temp_q0p1_o273 -273.140 3003.560 FORMAT "%8.3" EXTENDED_LIMITS -3549.940 3003.560 /end CHARACTERISTIC
/begin CHARACTERISTIC ExhMgT_tCat2MaxFcoMax_C "maximal exhaust maximum temperature in catalyst 2 for enable of fuel cut off" VALUE 0x8054838A RB_Val_Ws16 3276.700 temp_q0p1_o273 -273.140 3003.560 FORMAT "%8.3" EXTENDED_LIMITS -3549.940 3003.560 /end CHARACTERISTIC
/begin CHARACTERISTIC ExhMgT_tCat2MaxFcoMin_C "minimum temperature in the 2nd catalyst for the release of the fuel cut" VALUE 0x8054838C RB_Val_Ws16 3276.700 temp_q0p1_o273 -273.140 3003.560 FORMAT "%8.3" EXTENDED_LIMITS -3549.940 3003.560 /end CHARACTERISTIC
/begin CHARACTERISTIC ExhMgT_tCatCritCorrn_M "critical temperature inside of cataylst for protection of mat between catalyst and catalyst body in dependence of actual operation point" MAP 0x80548986 RB_Map_S16S16_S16 6553.500 Temp_Cels -3549.940 3003.560 FORMAT "%8.3"
 /begin AXIS_DESCR STD_AXIS tumg_msg temp_ub_q0p75_o48 4 -24624.00 24527.25 FORMAT "%8.2" DEPOSIT ABSOLUTE /end AXIS_DESCR
 /begin AXIS_DESCR STD_AXIS NO_INPUT_QUANTITY vfzg_ub_q1p25 4 -40960.00 40958.75 FORMAT "%8.2" DEPOSIT ABSOLUTE /end AXIS_DESCR
/end CHARACTERISTIC
/begin CHARACTERISTIC ExhMgT_tCatCrit_M "critical temperature inside of cataylst for protection of mat between catalyst and catalyst body" MAP 0x805489BA RB_Map_S16U16_S16 6553.500 Temp_Cels -3549.940 3003.560 FORMAT "%8.3"
 /begin AXIS_DESCR STD_AXIS Epm_nEng EngN 4 -16384.00 16383.50 FORMAT "%8.2" DEPOSIT ABSOLUTE /end AXIS_DESCR
 /begin AXIS_DESCR STD_AXIS AirMod_ratChrgAirCyl rel_uw_q0p0234 4 0.00 1535.977 FORMAT "%8.3" DEPOSIT ABSOLUTE /end AXIS_DESCR
/end CHARACTERISTIC
/begin CHARACTERISTIC ExhMgT_tDifDftlCptProtnGovrLim_C "Threshold for the temperature of the for differential gain for exhaust gas temperature feedback control bench1" VALUE 0x805489EE RB_Val_Ws16 6553.500 temp_q0p1_K -3276.800 3276.700 FORMAT "%8.3" /end CHARACTERISTIC
/begin CHARACTERISTIC ExhMgT_tDifLimDftlCptProtnGovr1_C "Threshold for the difference of the temperature for differential gain for exhaust gas temperature feedback control bench 1" VALUE 0x805489F0 RB_Val_Ws32 6553.59999847 q1p52588Em6_K -3276.80000000 3276.79999847 FORMAT "%13.8" /end CHARACTERISTIC
/begin CHARACTERISTIC ExhMgT_tExhCat1CoolgMin_C "minimum temperature threshold in catalyst 1 for the release of the fuel cut-off relating to the minimum temperature" VALUE 0x8054838E RB_Val_Wu16 3276.700 temp_q0p1_o273 -273.140 3003.560 FORMAT "%8.3" EXTENDED_LIMITS -273.1400 6280.360 /end CHARACTERISTIC
/begin CHARACTERISTIC ExhMgT_tExhCat1FcoAvrgMin_C "minimum temperature threshold in catalyst 1 for the release of the fuel cut-off relating to the average temperature" VALUE 0x80548390 RB_Val_Wu16 3276.700 temp_q0p1_o273 -273.140 3003.560 FORMAT "%8.3" EXTENDED_LIMITS -273.1400 6280.360 /end CHARACTERISTIC
/begin CHARACTERISTIC ExhMgT_tExhCat1FcoAvrg_C "maximal average temperature of catalyst 1 for enable of fuel cut off" VALUE 0x80548392 RB_Val_Ws16 3276.700 temp_q0p1_o273 -273.140 3003.560 FORMAT "%8.3" EXTENDED_LIMITS -3549.940 3003.560 /end CHARACTERISTIC
/begin CHARACTERISTIC ExhMgT_tExhCat1FcoDsMax_C "maximal exhaust temperature downstream of catalyst 1 for enable of cut off" VALUE 0x80548394 RB_Val_Ws16 3276.700 temp_q0p1_o273 -273.140 3003.560 FORMAT "%8.3" EXTENDED_LIMITS -3549.940 3003.560 /end CHARACTERISTIC
/begin CHARACTERISTIC ExhMgT_tExhCat1FcoDsMin_C "minimum exhaust temperature downstream of catalyst 1 for enable of cut off" VALUE 0x80548396 RB_Val_Ws16 3276.700 temp_q0p1_o273 -273.140 3003.560 FORMAT "%8.3" EXTENDED_LIMITS -3549.940 3003.560 /end CHARACTERISTIC
/begin CHARACTERISTIC ExhMgT_tExhCat1FcoEndMin_C "minimum temperature threshold in catalyst 1 for the release of the fuel cut-off relating to the temperature at the end of catalyst 1" VALUE 0x80548398 RB_Val_Wu16 3276.700 temp_q0p1_o273 -273.140 3003.560 FORMAT "%8.3" EXTENDED_LIMITS -273.1400 6280.360 /end CHARACTERISTIC
/begin CHARACTERISTIC ExhMgT_tExhCat1FcoEnd_C "maximal temperature at the end of catalyst 1 for enable of cut off" VALUE 0x8054839A RB_Val_Ws16 3276.700 temp_q0p1_o273 -273.140 3003.560 FORMAT "%8.3" EXTENDED_LIMITS -3549.940 3003.560 /end CHARACTERISTIC
/begin CHARACTERISTIC ExhMgT_tExhCat1FcoMinMax_C "maximal threshold of the minimum temperature catalyst 1 for enable of cut off" VALUE 0x8054839C RB_Val_Ws16 3276.700 temp_q0p1_o273 -273.140 3003.560 FORMAT "%8.3" EXTENDED_LIMITS -3549.940 3003.560 /end CHARACTERISTIC
/begin CHARACTERISTIC ExhMgT_tExhCat1FcoMin_C "minimum temperature threshold in catalyst 1 for the release of the fuel cut-off relating to the temperature in catalyst 1" VALUE 0x8054839E RB_Val_Wu16 3276.700 temp_q0p1_o273 -273.140 3003.560 FORMAT "%8.3" EXTENDED_LIMITS -273.1400 6280.360 /end CHARACTERISTIC
/begin CHARACTERISTIC ExhMgT_tExhCat1FcoUsMax_C "maximal exhaust temperature upstream of catalyst 1 for enable of cut off" VALUE 0x805483A0 RB_Val_Ws16 3276.700 temp_q0p1_o273 -273.140 3003.560 FORMAT "%8.3" EXTENDED_LIMITS -3549.940 3003.560 /end CHARACTERISTIC
/begin CHARACTERISTIC ExhMgT_tExhCat1FcoUsMin_C "minimum temperature in front of 1st catalyst for the release of the fuel cut" VALUE 0x805483A2 RB_Val_Wu16 3276.700 temp_q0p1_o273 -273.140 3003.560 FORMAT "%8.3" EXTENDED_LIMITS -273.1400 6280.360 /end CHARACTERISTIC
/begin CHARACTERISTIC ExhMgT_tExhCat1Fco_C "maximal temperature in catalyst 1 for enable of cut off" VALUE 0x805483A4 RB_Val_Ws16 3276.700 temp_q0p1_o273 -273.140 3003.560 FORMAT "%8.3" EXTENDED_LIMITS -3549.940 3003.560 /end CHARACTERISTIC
/begin CHARACTERISTIC ExhMgT_tExhCat2CoolgMin_C "minimum temperature threshold in catalyst 2 for the release of the fuel cut-off relating to the minimum temperature" VALUE 0x805483A6 RB_Val_Wu16 3276.700 temp_q0p1_o273 -273.140 3003.560 FORMAT "%8.3" EXTENDED_LIMITS -273.1400 6280.360 /end CHARACTERISTIC
/begin CHARACTERISTIC ExhMgT_tExhCat2FcoAvrgMin_C "minimum temperature threshold in catalyst 2 for the release of the fuel cut-off relating to the average temperature" VALUE 0x805483A8 RB_Val_Wu16 3276.700 temp_q0p1_o273 -273.140 3003.560 FORMAT "%8.3" EXTENDED_LIMITS -273.1400 6280.360 /end CHARACTERISTIC
/begin CHARACTERISTIC ExhMgT_tExhCat2FcoAvrg_C "maximal average temperatur of catalyst 2 for enable of fuel cut off" VALUE 0x805483AA RB_Val_Ws16 3276.700 temp_q0p1_o273 -273.140 3003.560 FORMAT "%8.3" EXTENDED_LIMITS -3549.940 3003.560 /end CHARACTERISTIC
/begin CHARACTERISTIC ExhMgT_tExhCat2FcoDsMax_C "maximal exhaust temperatur downstream of catalyst 2 for enable of cut off" VALUE 0x805483AC RB_Val_Ws16 3276.700 temp_q0p1_o273 -273.140 3003.560 FORMAT "%8.3" EXTENDED_LIMITS -3549.940 3003.560 /end CHARACTERISTIC
/begin CHARACTERISTIC ExhMgT_tExhCat2FcoDsMin_C "minimum temperature after 2nd catalyst for the release of the fuel cut" VALUE 0x805483AE RB_Val_Ws16 3276.700 temp_q0p1_o273 -273.140 3003.560 FORMAT "%8.3" EXTENDED_LIMITS -3549.940 3003.560 /end CHARACTERISTIC
/begin CHARACTERISTIC ExhMgT_tExhCat2FcoEndMin_C "minimum temperature threshold in catalyst 2 for the release of the fuel cut-off relating to the temperature at the end of catalyst 2" VALUE 0x805483B0 RB_Val_Wu16 3276.700 temp_q0p1_o273 -273.140 3003.560 FORMAT "%8.3" EXTENDED_LIMITS -273.1400 6280.360 /end CHARACTERISTIC
/begin CHARACTERISTIC ExhMgT_tExhCat2FcoEnd_C "maximal temperature at the end of catalyst 2 for enable of cut off" VALUE 0x805483B2 RB_Val_Ws16 3276.700 temp_q0p1_o273 -273.140 3003.560 FORMAT "%8.3" EXTENDED_LIMITS -3549.940 3003.560 /end CHARACTERISTIC
/begin CHARACTERISTIC ExhMgT_tExhCat2FcoMinMax_C "maximal threshold of the minimum temperature catalyst 2 for enable of cut off" VALUE 0x805483B4 RB_Val_Ws16 3276.700 temp_q0p1_o273 -273.140 3003.560 FORMAT "%8.3" EXTENDED_LIMITS -3549.940 3003.560 /end CHARACTERISTIC
/begin CHARACTERISTIC ExhMgT_tExhCat2FcoMin_C "minimum temperature threshold in catalyst 2 for the release of the fuel cut-off relating to the temperature in catalyst 2" VALUE 0x805483B6 RB_Val_Wu16 3276.700 temp_q0p1_o273 -273.140 3003.560 FORMAT "%8.3" EXTENDED_LIMITS -273.1400 6280.360 /end CHARACTERISTIC
/begin CHARACTERISTIC ExhMgT_tExhCat2FcoUsMax_C "maximal exhaust temperature upstream of catalyst 2 for enable of fuel cut off" VALUE 0x805483B8 RB_Val_Ws16 3276.700 temp_q0p1_o273 -273.140 3003.560 FORMAT "%8.3" EXTENDED_LIMITS -3549.940 3003.560 /end CHARACTERISTIC
/begin CHARACTERISTIC ExhMgT_tExhCat2FcoUsMin_C "minimum temperature after 2nd catalyst for the release of the fuel cut" VALUE 0x805483BA RB_Val_Ws16 3276.700 temp_q0p1_o273 -273.140 3003.560 FORMAT "%8.3" EXTENDED_LIMITS -3549.940 3003.560 /end CHARACTERISTIC
/begin CHARACTERISTIC ExhMgT_tExhCat2Fco_C "maximal temperature in catalyst 2 for enable of cut off" VALUE 0x805483BC RB_Val_Ws16 3276.700 temp_q0p1_o273 -273.140 3003.560 FORMAT "%8.3" EXTENDED_LIMITS -3549.940 3003.560 /end CHARACTERISTIC
/begin CHARACTERISTIC ExhMgT_tiCutOffFirst_C "Time delay before renewed the release of the fuel cut-off to prevent cat cooling down" VALUE 0x805483BE RB_Val_Wu16 3276.750 t_q0p05 0.00 3276.750 FORMAT "%8.3" /end CHARACTERISTIC
/begin CHARACTERISTIC ExhMgT_tiRelsCptProtnGovr_C "time delay for operation condition for exhaust gas temperature feedback control" VALUE 0x805489F4 RB_Val_Wu8 25.50 t_q0p1 0.00 25.50 FORMAT "%5.2" /end CHARACTERISTIC
/begin CHARACTERISTIC ExhMgT_tiTCatCritFild_T "time constant for filtering of critical temperature inside of cataylst for protection of mat between catalyst and catalyst body in dependence of exhaust air mass flow" CURVE 0x805489F6 RB_Curve_U16_U16 6553.400 t_q0p1 0.100 6553.500 FORMAT "%8.3" EXTENDED_LIMITS 0.00 6553.500
 /begin AXIS_DESCR STD_AXIS NO_INPUT_QUANTITY m_uw_b6553p5 8 0.00 6553.500 FORMAT "%8.3" DEPOSIT ABSOLUTE /end AXIS_DESCR
/end CHARACTERISTIC
/begin CHARACTERISTIC ExhMgT_tiTDsVlvB1_C "filter time constant for the filtered value of the exhaust gas temperature downstream exhaust valve, modelled, bank 1" VALUE 0x80548A1C RB_Val_Wu16 3276.700 t_q0p05 0.050 3276.750 FORMAT "%8.3" EXTENDED_LIMITS 0.00 3276.750 /end CHARACTERISTIC
/begin CHARACTERISTIC ExhMgT_tiTFltCat1AvrgB1_C "filter time constant for average temperature catalyst 1 B1" VALUE 0x80548A1E RB_Val_Wu16 3276.700 t_q0p05 0.050 3276.750 FORMAT "%8.3" EXTENDED_LIMITS 0.00 3276.750 /end CHARACTERISTIC
/begin CHARACTERISTIC ExhMgT_tiTFltCat1B1_C "filter time constant for temperature catalyst 1 B1" VALUE 0x80548A20 RB_Val_Wu16 3276.700 t_q0p05 0.050 3276.750 FORMAT "%8.3" EXTENDED_LIMITS 0.00 3276.750 /end CHARACTERISTIC
/begin CHARACTERISTIC ExhMgT_tiTFltCat1EndB1_C "filter time constant for the temperature end of catalyst 1 B1" VALUE 0x80548A22 RB_Val_Wu16 3276.700 t_q0p05 0.050 3276.750 FORMAT "%8.3" EXTENDED_LIMITS 0.00 3276.750 /end CHARACTERISTIC
/begin CHARACTERISTIC ExhMgT_tiTFltCat1MaxB1_C "filter time constant for maximal temperature Catalyst 1 bench 1" VALUE 0x80548A24 RB_Val_Wu16 3276.700 t_q0p05 0.050 3276.750 FORMAT "%8.3" EXTENDED_LIMITS 0.00 3276.750 /end CHARACTERISTIC
/begin CHARACTERISTIC ExhMgT_tiTFltCat1MinB1_C "filter time constant for minimum temperature catalyst 1 B1" VALUE 0x80548A26 RB_Val_Wu16 3276.700 t_q0p05 0.050 3276.750 FORMAT "%8.3" EXTENDED_LIMITS 0.00 3276.750 /end CHARACTERISTIC
/begin CHARACTERISTIC ExhMgT_tiTFltCat2AvrgB1_C "filter time constant for average temperature catalyst 2 B1" VALUE 0x80548A28 RB_Val_Wu16 3276.700 t_q0p05 0.050 3276.750 FORMAT "%8.3" EXTENDED_LIMITS 0.00 3276.750 /end CHARACTERISTIC
/begin CHARACTERISTIC ExhMgT_tiTFltCat2B1_C "filter time constant for temperature catalyst 2 B1" VALUE 0x80548A2A RB_Val_Wu16 3276.700 t_q0p05 0.050 3276.750 FORMAT "%8.3" EXTENDED_LIMITS 0.00 3276.750 /end CHARACTERISTIC
/begin CHARACTERISTIC ExhMgT_tiTFltCat2EndB1_C "filter time constant for the temperature end of catalyst 2 B1" VALUE 0x80548A2C RB_Val_Wu16 3276.700 t_q0p05 0.050 3276.750 FORMAT "%8.3" EXTENDED_LIMITS 0.00 3276.750 /end CHARACTERISTIC
/begin CHARACTERISTIC ExhMgT_tiTFltCat2MaxB1_C "filter time constant for maximal temperature Kat 2 bench 1" VALUE 0x80548A2E RB_Val_Wu16 3276.700 t_q0p05 0.050 3276.750 FORMAT "%8.3" EXTENDED_LIMITS 0.00 3276.750 /end CHARACTERISTIC
/begin CHARACTERISTIC ExhMgT_tiTFltCat2MinB1_C "filter time constant for minimum temperature catalyst 2 B1" VALUE 0x80548A30 RB_Val_Wu16 3276.700 t_q0p05 0.050 3276.750 FORMAT "%8.3" EXTENDED_LIMITS 0.00 3276.750 /end CHARACTERISTIC
/begin CHARACTERISTIC ExhMgT_tiTFltExhMnfB1_T "filter time for exhaustgas temperature manifold, Bank 1" CURVE 0x80548A32 RB_Curve_U16_U16 3276.700 t_q0p05 0.050 3276.750 FORMAT "%8.3" EXTENDED_LIMITS 0.00 3276.750
 /begin AXIS_DESCR STD_AXIS NO_INPUT_QUANTITY m_uw_b6553p5 6 0.00 6553.500 FORMAT "%8.3" DEPOSIT ABSOLUTE /end AXIS_DESCR
/end CHARACTERISTIC
/begin CHARACTERISTIC ExhMgT_tiTnCptProtnGovr_C "Time constant for tracking of the D component of the exhaust gas temperature controller, bench1" VALUE 0x80548A18 RB_Val_Wu16 6553.400 t_q0p1 0.100 6553.500 FORMAT "%8.3" EXTENDED_LIMITS 0.00 6553.500 /end CHARACTERISTIC
/begin CHARACTERISTIC ExhMgT_tMinCat1CdaDelta_C "minimal temperature for 1. catalyst component protection" VALUE 0x805483C0 RB_Val_Ws16 3276.700 temp_q0p1_K 0.00 3276.700 FORMAT "%8.3" EXTENDED_LIMITS -3276.800 3276.700 /end CHARACTERISTIC
/begin CHARACTERISTIC ExhMgT_tMinCat1CdaHi_C "minimal temperature for 1. catalyst component protection" VALUE 0x805483C2 RB_Val_Ws16 3276.700 temp_q0p1_K 0.00 3276.700 FORMAT "%8.3" EXTENDED_LIMITS -3276.800 3276.700 /end CHARACTERISTIC
/begin CHARACTERISTIC ExhMgT_tMinCat1FcoCoolgDelta_C "minimum delta exhaust temperature of the first catalyst for the release of the overrun fuel cut (preventing cooling down)" VALUE 0x805483C4 RB_Val_Ws16 3276.700 temp_q0p1_K 0.00 3276.700 FORMAT "%8.3" EXTENDED_LIMITS -3276.800 3276.700 /end CHARACTERISTIC
/begin CHARACTERISTIC ExhMgT_tMinCat1FcoCoolgHi_C "minimum delta exhaust temperature of the first catalyst for the release of the overrun fuel cut (preventing cooling down) (Bank2)" VALUE 0x805483C6 RB_Val_Ws16 6553.500 temp_q0p1_K -3276.800 3276.700 FORMAT "%8.3" /end CHARACTERISTIC
/begin CHARACTERISTIC ExhMgT_tMinCat1FcoDelta_C "hysteresis for distance to temperature-threshold for cylinder-individual fuel cut-off, 1. catalyst" VALUE 0x805483C8 RB_Val_Ws16 3276.700 temp_q0p1_K 0.00 3276.700 FORMAT "%8.3" EXTENDED_LIMITS -3276.800 3276.700 /end CHARACTERISTIC
/begin CHARACTERISTIC ExhMgT_tMinCat1FcoHi_C "distance to temperature-threshold for cylinder-individual fuel cut-off, 1. catalyst" VALUE 0x805483CA RB_Val_Ws16 3276.700 temp_q0p1_K 0.00 3276.700 FORMAT "%8.3" EXTENDED_LIMITS -3276.800 3276.700 /end CHARACTERISTIC
/begin CHARACTERISTIC ExhMgT_tMinCat2CdaDelta_C "minimal temperature for 2. catalyst component protection" VALUE 0x805483CC RB_Val_Ws16 3276.700 temp_q0p1_K 0.00 3276.700 FORMAT "%8.3" EXTENDED_LIMITS -3276.800 3276.700 /end CHARACTERISTIC
/begin CHARACTERISTIC ExhMgT_tMinCat2CdaHi_C "minimal temperature for 2. catalyst component protection" VALUE 0x805483CE RB_Val_Ws16 3276.700 temp_q0p1_K 0.00 3276.700 FORMAT "%8.3" EXTENDED_LIMITS -3276.800 3276.700 /end CHARACTERISTIC
/begin CHARACTERISTIC ExhMgT_tMinCat2FcoCoolgDelta_C "Hysteresis for distance from the temperature limit for release of the fuel cut-off (preventing cooling down), 2. Catalyst" VALUE 0x805483D0 RB_Val_Ws16 3276.700 temp_q0p1_K 0.00 3276.700 FORMAT "%8.3" EXTENDED_LIMITS -3276.800 3276.700 /end CHARACTERISTIC
/begin CHARACTERISTIC ExhMgT_tMinCat2FcoCoolgHi_C "distance from the temperature limit for release of the fuel cut-off (preventing cooling down), 2. Catalyst" VALUE 0x805483D2 RB_Val_Ws16 6553.500 temp_q0p1_K -3276.800 3276.700 FORMAT "%8.3" /end CHARACTERISTIC
/begin CHARACTERISTIC ExhMgT_tMinCat2FcoDelta_C "hysteresis for distance to temperature-threshold for cylinder-individual fuel cut-off, 2. catalyst" VALUE 0x805483D4 RB_Val_Ws16 3276.700 temp_q0p1_K 0.00 3276.700 FORMAT "%8.3" EXTENDED_LIMITS -3276.800 3276.700 /end CHARACTERISTIC
/begin CHARACTERISTIC ExhMgT_tMinCat2FcoHi_C "distance to temperature-threshold for cylinder-individual fuel cut-off, 2. catalyst" VALUE 0x805483D6 RB_Val_Ws16 3276.700 temp_q0p1_K 0.00 3276.700 FORMAT "%8.3" EXTENDED_LIMITS -3276.800 3276.700 /end CHARACTERISTIC
/begin CHARACTERISTIC ExhMgT_tMinCatFco_T "Lower rich limit close above temperature threshold for fuel cut-off" CURVE 0x805483D8 RB_Curve_S16_U16_Static 15.99976 fak_uw_b16 0.00 15.99976 FORMAT "%8.5"
 /begin AXIS_DESCR STD_AXIS NO_INPUT_QUANTITY temp_q0p1_o273 4 -3549.940 3003.560 FORMAT "%8.3" DEPOSIT ABSOLUTE /end AXIS_DESCR
/end CHARACTERISTIC
/begin CHARACTERISTIC ExhMgT_vLimOverrunFco_C "Limiting speed f. overrun fuel cut-off" VALUE 0x805483EA RB_Val_Ws16 655.3500 Vel -327.6800 327.6700 FORMAT "%8.4" /end CHARACTERISTIC
/begin CHARACTERISTIC ExhMod_facCatAgiB1_C "Ageing factor for a catalyst bank 1" VALUE 0x80548D1C RB_Val_Wu16 1.000000 fak_uw_b2 0.00 1.000000 FORMAT "%8.6" EXTENDED_LIMITS 0.00 1.999969 /end CHARACTERISTIC
/begin CHARACTERISTIC ExhMod_facCoCnvnCpbyTLiOffAgedBrickB1_M "Temperature dependent light off CO conversion capability factor for aged bricks - map bank 1" MAP 0x80548D1E RB_Map_S16U8_U16 1.000000 fak_uw_b2 0.00 1.000000 FORMAT "%8.6" EXTENDED_LIMITS 0.00 1.999969
 /begin AXIS_DESCR STD_AXIS NO_INPUT_QUANTITY Temp_Cels 16 -3549.940 3003.560 FORMAT "%8.3" DEPOSIT ABSOLUTE /end AXIS_DESCR
 /begin AXIS_DESCR STD_AXIS NO_INPUT_QUANTITY OneToOne 5 0.00 4.000 FORMAT "%5.3" EXTENDED_LIMITS 0.00 255.0 DEPOSIT ABSOLUTE /end AXIS_DESCR
/end CHARACTERISTIC
/begin CHARACTERISTIC ExhMod_facCoCnvnCpbyTLiOffNewBrickB1_M "Temperature dependent light off CO conversion capability factor for new bricks - map bank 1" MAP 0x80548DE8 RB_Map_S16U8_U16 1.000000 fak_uw_b2 0.00 1.000000 FORMAT "%8.6" EXTENDED_LIMITS 0.00 1.999969
 /begin AXIS_DESCR STD_AXIS NO_INPUT_QUANTITY Temp_Cels 16 -3549.940 3003.560 FORMAT "%8.3" DEPOSIT ABSOLUTE /end AXIS_DESCR
 /begin AXIS_DESCR STD_AXIS NO_INPUT_QUANTITY OneToOne 5 0.00 4.000 FORMAT "%5.3" EXTENDED_LIMITS 0.00 255.0 DEPOSIT ABSOLUTE /end AXIS_DESCR
/end CHARACTERISTIC
/begin CHARACTERISTIC ExhMod_facHcCnvnCpbyTLiOffAgedBrickB1_M "Temperature dependent light off HC conversion capability factor for aged bricks - map bank 1" MAP 0x80548EB2 RB_Map_S16U8_U16 1.000000 fak_uw_b2 0.00 1.000000 FORMAT "%8.6" EXTENDED_LIMITS 0.00 1.999969
 /begin AXIS_DESCR STD_AXIS NO_INPUT_QUANTITY Temp_Cels 16 -3549.940 3003.560 FORMAT "%8.3" DEPOSIT ABSOLUTE /end AXIS_DESCR
 /begin AXIS_DESCR STD_AXIS NO_INPUT_QUANTITY OneToOne 5 0.00 4.000 FORMAT "%5.3" EXTENDED_LIMITS 0.00 255.0 DEPOSIT ABSOLUTE /end AXIS_DESCR
/end CHARACTERISTIC
/begin CHARACTERISTIC ExhMod_facHcCnvnCpbyTLiOffNewBrickB1_M "Temperature dependent light off HC conversion capability factor for new bricks - map bank 1" MAP 0x80548F7C RB_Map_S16U8_U16 1.000000 fak_uw_b2 0.00 1.000000 FORMAT "%8.6" EXTENDED_LIMITS 0.00 1.999969
 /begin AXIS_DESCR STD_AXIS NO_INPUT_QUANTITY Temp_Cels 16 -3549.940 3003.560 FORMAT "%8.3" DEPOSIT ABSOLUTE /end AXIS_DESCR
 /begin AXIS_DESCR STD_AXIS NO_INPUT_QUANTITY OneToOne 5 0.00 4.000 FORMAT "%5.3" EXTENDED_LIMITS 0.00 255.0 DEPOSIT ABSOLUTE /end AXIS_DESCR
/end CHARACTERISTIC
/begin CHARACTERISTIC ExhMod_facMfIntegEngStrtTiEngOff_T "Factor for reinitialization of Integrated air mass flow from engine start to max. value based on engine off time" CURVE 0x8054921C RB_Curve_U16_U8_Static 1.000 fak_uw_q0p01 0.00 1.000 FORMAT "%5.3" EXTENDED_LIMITS 0.00 2.550
 /begin AXIS_DESCR STD_AXIS ExhMod_tiEngOff t_q1 8 0.00 65535.00 FORMAT "%8.2" DEPOSIT ABSOLUTE /end AXIS_DESCR
/end CHARACTERISTIC
/begin CHARACTERISTIC ExhMod_facNoxCnvnCpbyTLiOffAgedBrickB1_M "Temperature dependent light off NOx conversion capability factor for aged bricks - map bank 1" MAP 0x80549046 RB_Map_S16U8_U16 1.000000 fak_uw_b2 0.00 1.000000 FORMAT "%8.6" EXTENDED_LIMITS 0.00 1.999969
 /begin AXIS_DESCR STD_AXIS NO_INPUT_QUANTITY Temp_Cels 16 -3549.940 3003.560 FORMAT "%8.3" DEPOSIT ABSOLUTE /end AXIS_DESCR
 /begin AXIS_DESCR STD_AXIS NO_INPUT_QUANTITY OneToOne 5 0.00 4.000 FORMAT "%5.3" EXTENDED_LIMITS 0.00 255.0 DEPOSIT ABSOLUTE /end AXIS_DESCR
/end CHARACTERISTIC
/begin CHARACTERISTIC ExhMod_facNoxCnvnCpbyTLiOffNewBrickB1_M "Temperature dependent light off NOx conversion capability factor for new bricks - map bank 1" MAP 0x80549110 RB_Map_S16U8_U16 1.000000 fak_uw_b2 0.00 1.000000 FORMAT "%8.6" EXTENDED_LIMITS 0.00 1.999969
 /begin AXIS_DESCR STD_AXIS NO_INPUT_QUANTITY Temp_Cels 16 -3549.940 3003.560 FORMAT "%8.3" DEPOSIT ABSOLUTE /end AXIS_DESCR
 /begin AXIS_DESCR STD_AXIS NO_INPUT_QUANTITY OneToOne 5 0.00 4.000 FORMAT "%5.3" EXTENDED_LIMITS 0.00 255.0 DEPOSIT ABSOLUTE /end AXIS_DESCR
/end CHARACTERISTIC
/begin CHARACTERISTIC ExhMod_facWghtCnvnCpbyTLiOffBrickB1_CA "Application factor for weighting individual bricks to the temperature dependent light off conversion capability factor of a catalyst - bank 1" VAL_BLK 0x805491DA RB_ValA_Wu16 1.000000 fak_uw_b2 0.00 1.000000 FORMAT "%8.6" EXTENDED_LIMITS 0.00 1.999969 NUMBER 6 /end CHARACTERISTIC
/begin CHARACTERISTIC ExhMod_facWghtCnvnCpbyTLiOffCatB1_CA "Application factor for weighting individual cats to the temperature dependent light off conversion capability factor of the bank 1" VAL_BLK 0x805491E6 RB_ValA_Wu16 1.000000 fak_uw_b2 0.00 1.000000 FORMAT "%8.6" EXTENDED_LIMITS 0.00 1.999969 NUMBER 2 /end CHARACTERISTIC
/begin CHARACTERISTIC ExhMod_mfCoCnvtbCurMaxBrickB1_M "current maximum convertible CO mass flow of the bricks - map bank 1" MAP 0x80548A4C RB_Map_R32U8_R32 50000.000000 AirMassPerTime_float 0.000000 50000.000000 FORMAT "%12.6" EXTENDED_LIMITS -3.402823E+038 3.402823E+038
 /begin AXIS_DESCR STD_AXIS NO_INPUT_QUANTITY RBPtCel_vf_1p0_1 8 -214748364.800000 214748364.700000 FORMAT "%12.6" EXTENDED_LIMITS -3.402823E+038 3.402823E+038 DEPOSIT ABSOLUTE /end AXIS_DESCR
 /begin AXIS_DESCR STD_AXIS NO_INPUT_QUANTITY OneToOne 6 0.00 255.0 FORMAT "%5.1" DEPOSIT ABSOLUTE /end AXIS_DESCR
/end CHARACTERISTIC
/begin CHARACTERISTIC ExhMod_mfHcCnvtbCurMaxBrickB1_M "current maximum convertible HC mass flow of the bricks - map bank 1" MAP 0x80548B3C RB_Map_R32U8_R32 50000.000000 AirMassPerTime_float 0.000000 50000.000000 FORMAT "%12.6" EXTENDED_LIMITS -3.402823E+038 3.402823E+038
 /begin AXIS_DESCR STD_AXIS NO_INPUT_QUANTITY RBPtCel_vf_1p0_1 8 -214748364.800000 214748364.700000 FORMAT "%12.6" EXTENDED_LIMITS -3.402823E+038 3.402823E+038 DEPOSIT ABSOLUTE /end AXIS_DESCR
 /begin AXIS_DESCR STD_AXIS NO_INPUT_QUANTITY OneToOne 6 0.00 255.0 FORMAT "%5.1" DEPOSIT ABSOLUTE /end AXIS_DESCR
/end CHARACTERISTIC
/begin CHARACTERISTIC ExhMod_mfNoxCnvtbCurMaxBrickB1_M "current maximum convertible NOx mass flow of the bricks - map bank 1" MAP 0x80548C2C RB_Map_R32U8_R32 50000.000000 AirMassPerTime_float 0.000000 50000.000000 FORMAT "%12.6" EXTENDED_LIMITS -3.402823E+038 3.402823E+038
 /begin AXIS_DESCR STD_AXIS NO_INPUT_QUANTITY RBPtCel_vf_1p0_1 8 -214748364.800000 214748364.700000 FORMAT "%12.6" EXTENDED_LIMITS -3.402823E+038 3.402823E+038 DEPOSIT ABSOLUTE /end AXIS_DESCR
 /begin AXIS_DESCR STD_AXIS NO_INPUT_QUANTITY OneToOne 6 0.00 255.0 FORMAT "%5.1" DEPOSIT ABSOLUTE /end AXIS_DESCR
/end CHARACTERISTIC
/begin CHARACTERISTIC ExhMod_posnPfil_C "Position (catalyst number) of particle filter in exhaust system" VALUE 0x805491F0 RB_Val_Wu8 255.0 dez 0.00 255.0 FORMAT "%5.1" /end CHARACTERISTIC
/begin CHARACTERISTIC ExhMod_stCfgExhSysB1_CA "configuration array exhaust system bank 1" VAL_BLK 0x805491F1 RB_ValA_Wu8 255.0 dez 0.00 255.0 FORMAT "%5.1" NUMBER 12 /end CHARACTERISTIC
/begin CHARACTERISTIC ExhMod_stLamCfg_C "Code word modelization of lambda values in exhaust gas system" VALUE 0x805498A4 RB_Val_Wu8 255.0 dez 0.00 255.0 FORMAT "%5.1" /end CHARACTERISTIC
/begin CHARACTERISTIC ExhMod_swtFacCnvnCpbyTLiOffB1_CA "Switch for the selection of the maps for the temperature dependent light off conversion capability factor array bank 1" VAL_BLK 0x805491EA RB_ValA_Wu8 4.000 OneToOne 0.00 4.000 FORMAT "%5.3" EXTENDED_LIMITS 0.00 255.0 NUMBER 6 /end CHARACTERISTIC
/begin CHARACTERISTIC ExhMod_volBtwCat1Cat2B1_C "Volume between sensor downstream catalyst 1 and catalyst 2 outlet" VALUE 0x805498A6 RB_Val_Wu16 98302.50 vol_q1p5_cm3 0.00 98302.50 FORMAT "%8.2" /end CHARACTERISTIC
/begin CHARACTERISTIC ExhMod_volBtwCat2SDsCat2B1_C "Volume between catalyst 2 outlet and sensor downstream catalyst 2" VALUE 0x805498A8 RB_Val_Wu16 98302.50 vol_q1p5_cm3 0.00 98302.50 FORMAT "%8.2" /end CHARACTERISTIC
/begin CHARACTERISTIC ExhMod_volBtwLS1Cat1B1_C "Volume between lambda sensor 1 and sensor downstream catalyst 1" VALUE 0x805498AA RB_Val_Wu16 98302.50 vol_q1p5_cm3 0.00 98302.50 FORMAT "%8.2" /end CHARACTERISTIC
/begin CHARACTERISTIC Lam_mO2CatStThd_C "oxygen threshold for catalyst state" VALUE 0x805498AC RB_Val_Wu16 0.00 m_q0p1_mg 0.00 0.00 FORMAT "%8.2" EXTENDED_LIMITS 0.00 6553.500 READ_ONLY /end CHARACTERISTIC
/begin CHARACTERISTIC Lam_mO2MaxCat1_C "Maximal value of the OSC of catalyst 1, for plausibility check" VALUE 0x805498B0 RB_Val_Wr32 199998.000 m_q1_mg -99999.0000 99999.0000 FORMAT "%10.4" EXTENDED_LIMITS -3.40282347E+038 3.40282347E+038 /end CHARACTERISTIC
/begin CHARACTERISTIC Lam_mO2StorgIni_C "oxygen capacity at engine start" VALUE 0x805498A0 RB_Val_Wu32 429496729.500 m_q0p1_mg 0.00 429496729.500 FORMAT "%13.3" /end CHARACTERISTIC
/begin CHARACTERISTIC Lam_ratConcO2ThdLean_C "Lean threshold for oxygen concentration for plausibility check" VALUE 0x805498B4 RB_Val_Ws16 15.99976 fak_sw_b8 -8.000000 7.999756 FORMAT "%8.6" /end CHARACTERISTIC
/begin CHARACTERISTIC Lam_ratConcO2ThdRich_C "Rich threshold for oxygen concentration for plausibility check" VALUE 0x805498B6 RB_Val_Ws16 15.99976 fak_sw_b8 -8.000000 7.999756 FORMAT "%8.6" /end CHARACTERISTIC
/begin CHARACTERISTIC Lam_tDlyLSNplFlg "Test time before setting non-plausibility-flag lambda sensor downstream of catalyst" VALUE 0x805498B8 RB_Val_Wu16 2.550000 t_q0p01 0.00 2.550000 FORMAT "%8.6" EXTENDED_LIMITS 0.00 655.3500 /end CHARACTERISTIC
/begin CHARACTERISTIC Lam_uLSCat1Empty_C "Threshold of rear lambda sensor voltage for defined catalyst 1 state empty" VALUE 0x805498BA RB_Val_Ws16 159.9951 spg_q0p00488 0.00 159.9951 FORMAT "%8.4" EXTENDED_LIMITS -160.0000 159.9951 /end CHARACTERISTIC
/begin CHARACTERISTIC Lam_uLSCat1Full_C "Threshold of rear lambda sensor voltage for defined catalyst 1 state full" VALUE 0x805498BC RB_Val_Ws16 159.9951 spg_q0p00488 0.00 159.9951 FORMAT "%8.4" EXTENDED_LIMITS -160.0000 159.9951 /end CHARACTERISTIC
/begin CHARACTERISTIC LBTSSAMX "Upper end-lambda for component protection before fuel cutoff is released" VALUE 0x805483EC RB_Val_Wu16 0.6999512 fak_uw_b16 0.800049 1.500000 FORMAT "%8.6" EXTENDED_LIMITS 0.00 15.99976 /end CHARACTERISTIC
/begin AXIS_PTS STN10TMUB "break point distribution: engine start temperature" 0x80549236 NO_INPUT_QUANTITY RB_Axis_S16 6553.500 Temp_Cels 10 -3549.940 3003.560 FORMAT "%8.3" DEPOSIT ABSOLUTE /end AXIS_PTS
/begin AXIS_PTS STS08TMUW "tabstatm dependent basic point (number 8)" 0x8054924C DewDet_tiShDown RB_Axis_U16 65535.00 t1sxs_uw_q1 8 0.00 65535.00 FORMAT "%8.2" DEPOSIT ABSOLUTE /end AXIS_PTS
/begin CHARACTERISTIC TDLBTSSA "Time for transient of lambda from ignited overrun to release of fuel cut-off" VALUE 0x805483EE RB_Val_Wu16 3276.7499992 zk50msxs_uw_b3276p8 0.0500008 3276.8000000 FORMAT "%12.7" EXTENDED_LIMITS 0.050000762951 3276.8000000 /end CHARACTERISTIC
/begin MEASUREMENT B_atrb "condition valid range for exhaust temperature control" UBYTE B_TRUE 1 100 0.00 1.00000000000 BIT_MASK 0x1 FORMAT "%13.11" ECU_ADDRESS 0x70000276 /end MEASUREMENT
/begin MEASUREMENT B_atr_msg "Condition: exhaust temperature control" UBYTE B_TRUE 1 100 0.00 1.00000000000 BIT_MASK 0x1 FORMAT "%13.11" ECU_ADDRESS 0x70000C3A /end MEASUREMENT
/begin MEASUREMENT B_bbatr "Operation condition for exhaust gas temperature feedback control" UBYTE B_TRUE 1 100 0.00 1.00000000000 BIT_MASK 0x1 FORMAT "%13.11" ECU_ADDRESS 0x70000275 /end MEASUREMENT
/begin MEASUREMENT B_fgsabts "Start of lambda-ramp of lower rich limit before fuel cut-off" UBYTE B_TRUE 1 100 0.00 1.00000000000 BIT_MASK 0x1 FORMAT "%13.11" ECU_ADDRESS 0x6000B919 /end MEASUREMENT
/begin MEASUREMENT B_sabbts_msg "condition fuel cut-off request by component protection" UBYTE B_TRUE 1 100 0.00 1.00000000000 BIT_MASK 0x1 FORMAT "%13.11" ECU_ADDRESS 0x6000F6DA /end MEASUREMENT
/begin MEASUREMENT B_tatmsa_msg "Temperatures in exhaust system permit fuel-cutoff (component protection)" UBYTE B_TRUE 1 100 0.00 1.00000000000 BIT_MASK 0x1 FORMAT "%13.11" ECU_ADDRESS 0x6000F6D8 /end MEASUREMENT
/begin MEASUREMENT DewDet_bFrstStrtEndERNM "condition first end of start in cycle rising edge" UBYTE B_TRUE 1 100 0.00 1.00000000000 BIT_MASK 0x1 FORMAT "%13.11" ECU_ADDRESS 0x7000026F /end MEASUREMENT
/begin MEASUREMENT DewDet_bStrtEndERNM "condition end of start rising edge" UBYTE B_TRUE 1 100 0.00 1.00000000000 BIT_MASK 0x1 FORMAT "%13.11" ECU_ADDRESS 0x7000026E /end MEASUREMENT
/begin MEASUREMENT DewDet_ctReIni "Counter for detecting interrupted postdrive (ReIni)" UBYTE OneToOne 1 100 0.00 255.0 FORMAT "%5.1" ECU_ADDRESS 0x6000B911 /end MEASUREMENT
/begin MEASUREMENT DewDet_flgAcmEgy "flag condition accumulation of heat quantity fullfilled" UBYTE B_TRUE 1 100 0.00 1.00000000000 BIT_MASK 0x1 FORMAT "%13.11" ECU_ADDRESS 0x70000A55 /end MEASUREMENT
/begin MEASUREMENT DewDet_flgAcmEgyBasc "flag basic condition accumulation of heat quantity fullfilled" UBYTE B_TRUE 1 100 0.00 1.00000000000 BIT_MASK 0x1 FORMAT "%13.11" ECU_ADDRESS 0x70000273 /end MEASUREMENT
/begin MEASUREMENT DewDet_flgCatHeatgWoExo "Condition catalyst heating for dewdet functions" UBYTE B_TRUE 1 100 0.00 1.00000000000 BIT_MASK 0x1 FORMAT "%13.11" ECU_ADDRESS 0x70000A54 /end MEASUREMENT
/begin MEASUREMENT DewDet_flgEngStopER "condition end of start (1-0) for dew point end" UBYTE B_TRUE 1 100 0.00 1.00000000000 BIT_MASK 0x1 FORMAT "%13.11" ECU_ADDRESS 0x7000026D /end MEASUREMENT
/begin MEASUREMENT DewDet_flgEngStopLdc "condition end of start (1-0) detected in cycle for dew point end" UBYTE B_TRUE 1 100 0.00 1.00000000000 BIT_MASK 0x1 FORMAT "%13.11" ECU_ADDRESS 0x70000272 /end MEASUREMENT
/begin MEASUREMENT DewDet_flgInfoStrdEngOff "information end of last engine run stored" UBYTE B_TRUE 1 100 0.00 1.00000000000 BIT_MASK 0x1 FORMAT "%13.11" ECU_ADDRESS 0x7000026C /end MEASUREMENT
/begin MEASUREMENT DewDet_flgProlgProdLine "prolongated B_fabe for cold start counter during end of line test" UBYTE B_TRUE 1 100 0.00 1.00000000000 BIT_MASK 0x1 FORMAT "%13.11" ECU_ADDRESS 0x7000026B /end MEASUREMENT
/begin MEASUREMENT DewDet_flgPwrFail "local powerfail information dew-point end" UBYTE B_TRUE 1 100 0.00 1.00000000000 BIT_MASK 0x1 FORMAT "%13.11" ECU_ADDRESS 0x60036DCD /end MEASUREMENT
/begin MEASUREMENT DewDet_flgTUpdEngStrt "condition update sensor start temperature due to engine start" UBYTE B_TRUE 1 100 0.00 1.00000000000 BIT_MASK 0x1 FORMAT "%13.11" ECU_ADDRESS 0x70000271 /end MEASUREMENT
/begin MEASUREMENT DewDet_flgTUpdTiShDown "condition update sensor start temperature due to an updated engine turn off time" UBYTE B_TRUE 1 100 0.00 1.00000000000 BIT_MASK 0x1 FORMAT "%13.11" ECU_ADDRESS 0x70000270 /end MEASUREMENT
/begin MEASUREMENT DewDet_S1B1_I.cntrCldStrtSnsr "Instance of dew point end class of sensor 1 at bank 1 / counter for repeated cold starts dew-point end not reached sensor" UBYTE dez 1 100 0.00 255.0 FORMAT "%5.1" ECU_ADDRESS 0x6003937A /end MEASUREMENT
/begin MEASUREMENT DewDet_S1B1_I.egyInteg "Instance of dew point end class of sensor 1 at bank 1 / heat quantity to dew-point end" SWORD q_q1_kJ 1 100 -32768.00 32767.00 FORMAT "%8.2" ECU_ADDRESS 0x5000142C /end MEASUREMENT
/begin MEASUREMENT DewDet_S1B1_I.egyIntegAcm "Instance of dew point end class of sensor 1 at bank 1 / accumulated of heat quantity for dew-point end" SWORD q_q1_kJ 1 100 -32768.00 32767.00 FORMAT "%8.2" ECU_ADDRESS 0x5000142E /end MEASUREMENT
/begin MEASUREMENT DewDet_S1B1_I.egyIntegAcmLst "Instance of dew point end class of sensor 1 at bank 1 / accumulated of heat quantity for dew-point end (last trip)" SWORD q_q1_kJ 1 100 -32768.00 32767.00 FORMAT "%8.2" ECU_ADDRESS 0x6003937C /end MEASUREMENT
/begin MEASUREMENT DewDet_S1B1_I.egyIntegHiResl "Instance of dew point end class of sensor 1 at bank 1 / heat quantity to dew-point end high resolution" SLONG q_q1p5259Em5_kJ 1 100 0.00 32767.9999847 FORMAT "%13.7" ECU_ADDRESS 0x50001430 /end MEASUREMENT
/begin MEASUREMENT DewDet_S1B1_I.egyIntegInp "Instance of dew point end class of sensor 1 at bank 1 / Inout for output egyInteg" SLONG q_q1p5259Em5_kJ 1 100 -32768.0000000 32767.9999847 FORMAT "%13.7" ECU_ADDRESS 0x50001434 /end MEASUREMENT
/begin MEASUREMENT DewDet_S1B1_I.egyThd "Instance of dew point end class of sensor 1 at bank 1 / heat quantity threshold for dew-point end" SWORD q_q1_kJ 1 100 0.00 32767.00 FORMAT "%8.2" ECU_ADDRESS 0x50001438 /end MEASUREMENT
/begin MEASUREMENT DewDet_S1B1_I.egyThdEngRunLst "Instance of dew point end class of sensor 1 at bank 1 / heat quantity threshold at end of last engine run for dew-point end downstream" SWORD q_q1_kJ 1 100 0.00 32767.00 FORMAT "%8.2" ECU_ADDRESS 0x5000143A /end MEASUREMENT
/begin MEASUREMENT DewDet_S1B1_I.egyThdHeat "Instance of dew point end class of sensor 1 at bank 1 / heat quantity threshold for dew-point end" SWORD q_q1_kJ 1 100 0.00 32767.00 FORMAT "%8.2" ECU_ADDRESS 0x5000143C /end MEASUREMENT
/begin MEASUREMENT DewDet_S1B1_I.egyThdLst "Instance of dew point end class of sensor 1 at bank 1 / heat quantity threshold for dew-point end (last trip)" SWORD q_q1_kJ 1 100 0.00 32767.00 FORMAT "%8.2" ECU_ADDRESS 0x6003937E /end MEASUREMENT
/begin MEASUREMENT DewDet_S1B1_I.egyThdRaw "Instance of dew point end class of sensor 1 at bank 1 / heat quantity threshold for dew-point end without cold start counter" SWORD q_q1_kJ 1 100 0.00 32767.00 FORMAT "%8.2" ECU_ADDRESS 0x5000143E /end MEASUREMENT
/begin MEASUREMENT DewDet_S1B1_I.egy_inc "Instance of dew point end class of sensor 1 at bank 1 / energy increment" SLONG q_q1p5259Em5_kJ 1 100 -32768.0000000 32767.9999847 FORMAT "%13.7" ECU_ADDRESS 0x50001440 /end MEASUREMENT
/begin MEASUREMENT DewDet_S1B1_I.facCoolgSnrs "Instance of dew point end class of sensor 1 at bank 1 / factor for decrease in temperature of sensor" UBYTE fak_ub_b2 1 100 0.00 1.000000 FORMAT "%8.6" ECU_ADDRESS 0x50001444 /end MEASUREMENT
/begin MEASUREMENT DewDet_S1B1_I.flgAcmEgySnsr "Instance of dew point end class of sensor 1 at bank 1 / flag calculation accumulation of heat quantity sensor" UBYTE B_TRUE 1 100 0.00 1.00000000000 BIT_MASK 0x1 FORMAT "%13.11" ECU_ADDRESS 0x5000144C /end MEASUREMENT
/begin MEASUREMENT DewDet_S1B1_I.flgCondRstInt "Instance of dew point end class of sensor 1 at bank 1 / flag condition for reset integrator for dew point fullfilled" UBYTE B_TRUE 1 100 0.00 1.00000000000 BIT_MASK 0x2 FORMAT "%13.11" ECU_ADDRESS 0x5000144C /end MEASUREMENT
/begin MEASUREMENT DewDet_S1B1_I.flgDewPntEnd "Instance of dew point end class of sensor 1 at bank 1 / flag dew-point end sensor" UBYTE B_TRUE 1 100 0.00 1.00000000000 BIT_MASK 0x4 FORMAT "%13.11" ECU_ADDRESS 0x5000144C /end MEASUREMENT
/begin MEASUREMENT DewDet_S1B1_I.flgDewPntEndLst "Instance of dew point end class of sensor 1 at bank 1 / flag dew-point end sensor (last trip)" UBYTE B_TRUE 1 100 0.00 1.00000000000 BIT_MASK 0x1 FORMAT "%13.11" ECU_ADDRESS 0x60039380 /end MEASUREMENT
/begin MEASUREMENT DewDet_S1B1_I.flgRatNEngRelFuM "Instance of dew point end class of sensor 1 at bank 1 / Flag current energy input lower threshold sensor" UBYTE B_TRUE 1 100 0.00 1.00000000000 BIT_MASK 0x40 FORMAT "%13.11" ECU_ADDRESS 0x5000144C /end MEASUREMENT
/begin MEASUREMENT DewDet_S1B1_I.flgRstDewDet "Instance of dew point end class of sensor 1 at bank 1 / falling edge dew point end" UBYTE B_TRUE 1 100 0.00 1.00000000000 BIT_MASK 0x8 FORMAT "%13.11" ECU_ADDRESS 0x5000144D /end MEASUREMENT
/begin MEASUREMENT DewDet_S1B1_I.flgRstDewPntEnd "Instance of dew point end class of sensor 1 at bank 1 / flag condition for reset dew-point end sensor" UBYTE B_TRUE 1 100 0.00 1.00000000000 BIT_MASK 0x80 FORMAT "%13.11" ECU_ADDRESS 0x5000144C /end MEASUREMENT
/begin MEASUREMENT DewDet_S1B1_I.flgRstEngOff "Instance of dew point end class of sensor 1 at bank 1 / condition dew point bit sensor reseted at engine stop" UBYTE B_TRUE 1 100 0.00 1.00000000000 BIT_MASK 0x1 FORMAT "%13.11" ECU_ADDRESS 0x5000144D /end MEASUREMENT
/begin MEASUREMENT DewDet_S1B1_I.flgRstEngOffStrt "Instance of dew point end class of sensor 1 at bank 1 / condition dew point bit sensor reseted at last engine stop" UBYTE B_TRUE 1 100 0.00 1.00000000000 BIT_MASK 0x10 FORMAT "%13.11" ECU_ADDRESS 0x5000144D /end MEASUREMENT
/begin MEASUREMENT DewDet_S1B1_I.flgRstInt "Instance of dew point end class of sensor 1 at bank 1 / flag for reset of heat flow integral sensor" UBYTE B_TRUE 1 100 0.00 1.00000000000 BIT_MASK 0x2 FORMAT "%13.11" ECU_ADDRESS 0x5000144D /end MEASUREMENT
/begin MEASUREMENT DewDet_S1B1_I.flgSetDewPntEnd "Instance of dew point end class of sensor 1 at bank 1 / flag set dew point end sensor" UBYTE B_TRUE 1 100 0.00 1.00000000000 BIT_MASK 0x4 FORMAT "%13.11" ECU_ADDRESS 0x5000144D /end MEASUREMENT
/begin MEASUREMENT DewDet_S1B1_I.flgTUpdFco "Instance of dew point end class of sensor 1 at bank 1 / condition update sensor start temperature due to reset of dew point end while FCO" UBYTE B_TRUE 1 100 0.00 1.00000000000 BIT_MASK 0x20 FORMAT "%13.11" ECU_ADDRESS 0x5000144D /end MEASUREMENT
/begin MEASUREMENT DewDet_S1B1_I.mfExhSnsr "Instance of dew point end class of sensor 1 at bank 1 / exhaust-gas mass flows" FLOAT32_IEEE RBPtCel_mf_1p0_1 1 100 -100000.0000 100000.0000 FORMAT "%10.4" ECU_ADDRESS 0x50001448 /end MEASUREMENT
/begin MEASUREMENT DewDet_S1B1_I.tSnsrCoolg "Instance of dew point end class of sensor 1 at bank 1 / temperature at sensor while engine stop" SWORD Temp_Cels 1 100 -3549.940 3003.560 FORMAT "%8.3" ECU_ADDRESS 0x5000144E /end MEASUREMENT
/begin MEASUREMENT DewDet_S1B1_I.tSnsrEnd "Instance of dew point end class of sensor 1 at bank 1 / temperature at sensor at switch off" SWORD Temp_Cels 1 100 -3549.940 3003.560 FORMAT "%8.3" ECU_ADDRESS 0x60039382 /end MEASUREMENT
/begin MEASUREMENT DewDet_S1B1_I.tSnsrStrt "Instance of dew point end class of sensor 1 at bank 1 / temperature at sensor at engine start" SWORD Temp_Cels 1 100 -3549.940 3003.560 FORMAT "%8.3" ECU_ADDRESS 0x50001450 /end MEASUREMENT
/begin MEASUREMENT DewDet_S1B1_I.tWallCoolg "Instance of dew point end class of sensor 1 at bank 1 / temperature wall of sensor = f(stop time) in stop phase" SWORD Temp_Cels 1 100 -3549.940 3003.560 FORMAT "%8.3" ECU_ADDRESS 0x50001452 /end MEASUREMENT
/begin MEASUREMENT DewDet_S1B1_I.tWallEngStop "Instance of dew point end class of sensor 1 at bank 1 / temperature wall of sensor bei start of stop phase" SWORD Temp_Cels 1 100 -3549.940 3003.560 FORMAT "%8.3" ECU_ADDRESS 0x50001454 /end MEASUREMENT
/begin MEASUREMENT DewDet_S1B1_I.tWallSnsrOld "Instance of dew point end class of sensor 1 at bank 1 / wall temperature sensor old" SWORD Temp_Cels 1 100 -3549.940 3003.560 FORMAT "%8.3" ECU_ADDRESS 0x50001456 /end MEASUREMENT
/begin MEASUREMENT DewDet_S1B1_I.tiShtDwn "Instance of dew point end class of sensor 1 at bank 1 / stop time dew-point end" UWORD t1sxs_uw_q1 1 100 0.00 65535.00 FORMAT "%8.2" ECU_ADDRESS 0x50001458 /end MEASUREMENT
/begin MEASUREMENT DewDet_S2B1_I.cntrCldStrtSnsr "Instance of dew point end class of sensor 2 at bank 1 / counter for repeated cold starts dew-point end not reached sensor" UBYTE dez 1 100 0.00 255.0 FORMAT "%5.1" ECU_ADDRESS 0x60039370 /end MEASUREMENT
/begin MEASUREMENT DewDet_S2B1_I.egyInteg "Instance of dew point end class of sensor 2 at bank 1 / heat quantity to dew-point end" SWORD q_q1_kJ 1 100 -32768.00 32767.00 FORMAT "%8.2" ECU_ADDRESS 0x50001464 /end MEASUREMENT
/begin MEASUREMENT DewDet_S2B1_I.egyIntegAcm "Instance of dew point end class of sensor 2 at bank 1 / accumulated of heat quantity for dew-point end" SWORD q_q1_kJ 1 100 -32768.00 32767.00 FORMAT "%8.2" ECU_ADDRESS 0x50001466 /end MEASUREMENT
/begin MEASUREMENT DewDet_S2B1_I.egyIntegAcmLst "Instance of dew point end class of sensor 2 at bank 1 / accumulated of heat quantity for dew-point end (last trip)" SWORD q_q1_kJ 1 100 -32768.00 32767.00 FORMAT "%8.2" ECU_ADDRESS 0x60039372 /end MEASUREMENT
/begin MEASUREMENT DewDet_S2B1_I.egyIntegHiResl "Instance of dew point end class of sensor 2 at bank 1 / heat quantity to dew-point end high resolution" SLONG q_q1p5259Em5_kJ 1 100 0.00 32767.9999847 FORMAT "%13.7" ECU_ADDRESS 0x50001468 /end MEASUREMENT
/begin MEASUREMENT DewDet_S2B1_I.egyIntegInp "Instance of dew point end class of sensor 2 at bank 1 / Inout for output egyInteg" SLONG q_q1p5259Em5_kJ 1 100 -32768.0000000 32767.9999847 FORMAT "%13.7" ECU_ADDRESS 0x5000146C /end MEASUREMENT
/begin MEASUREMENT DewDet_S2B1_I.egyThd "Instance of dew point end class of sensor 2 at bank 1 / heat quantity threshold for dew-point end" SWORD q_q1_kJ 1 100 0.00 32767.00 FORMAT "%8.2" ECU_ADDRESS 0x50001470 /end MEASUREMENT
/begin MEASUREMENT DewDet_S2B1_I.egyThdEngRunLst "Instance of dew point end class of sensor 2 at bank 1 / heat quantity threshold at end of last engine run for dew-point end downstream" SWORD q_q1_kJ 1 100 0.00 32767.00 FORMAT "%8.2" ECU_ADDRESS 0x50001472 /end MEASUREMENT
/begin MEASUREMENT DewDet_S2B1_I.egyThdHeat "Instance of dew point end class of sensor 2 at bank 1 / heat quantity threshold for dew-point end" SWORD q_q1_kJ 1 100 0.00 32767.00 FORMAT "%8.2" ECU_ADDRESS 0x50001474 /end MEASUREMENT
/begin MEASUREMENT DewDet_S2B1_I.egyThdLst "Instance of dew point end class of sensor 2 at bank 1 / heat quantity threshold for dew-point end (last trip)" SWORD q_q1_kJ 1 100 0.00 32767.00 FORMAT "%8.2" ECU_ADDRESS 0x60039374 /end MEASUREMENT
/begin MEASUREMENT DewDet_S2B1_I.egyThdRaw "Instance of dew point end class of sensor 2 at bank 1 / heat quantity threshold for dew-point end without cold start counter" SWORD q_q1_kJ 1 100 0.00 32767.00 FORMAT "%8.2" ECU_ADDRESS 0x50001476 /end MEASUREMENT
/begin MEASUREMENT DewDet_S2B1_I.egy_inc "Instance of dew point end class of sensor 2 at bank 1 / energy increment" SLONG q_q1p5259Em5_kJ 1 100 -32768.0000000 32767.9999847 FORMAT "%13.7" ECU_ADDRESS 0x50001478 /end MEASUREMENT
/begin MEASUREMENT DewDet_S2B1_I.facCoolgSnrs "Instance of dew point end class of sensor 2 at bank 1 / factor for decrease in temperature of sensor" UBYTE fak_ub_b2 1 100 0.00 1.000000 FORMAT "%8.6" ECU_ADDRESS 0x5000147C /end MEASUREMENT
/begin MEASUREMENT DewDet_S2B1_I.flgAcmEgySnsr "Instance of dew point end class of sensor 2 at bank 1 / flag calculation accumulation of heat quantity sensor" UBYTE B_TRUE 1 100 0.00 1.00000000000 BIT_MASK 0x1 FORMAT "%13.11" ECU_ADDRESS 0x50001484 /end MEASUREMENT
/begin MEASUREMENT DewDet_S2B1_I.flgCondRstInt "Instance of dew point end class of sensor 2 at bank 1 / flag condition for reset integrator for dew point fullfilled" UBYTE B_TRUE 1 100 0.00 1.00000000000 BIT_MASK 0x2 FORMAT "%13.11" ECU_ADDRESS 0x50001484 /end MEASUREMENT
/begin MEASUREMENT DewDet_S2B1_I.flgDewPntEnd "Instance of dew point end class of sensor 2 at bank 1 / flag dew-point end sensor" UBYTE B_TRUE 1 100 0.00 1.00000000000 BIT_MASK 0x4 FORMAT "%13.11" ECU_ADDRESS 0x50001484 /end MEASUREMENT
/begin MEASUREMENT DewDet_S2B1_I.flgDewPntEndLst "Instance of dew point end class of sensor 2 at bank 1 / flag dew-point end sensor (last trip)" UBYTE B_TRUE 1 100 0.00 1.00000000000 BIT_MASK 0x1 FORMAT "%13.11" ECU_ADDRESS 0x60039376 /end MEASUREMENT
/begin MEASUREMENT DewDet_S2B1_I.flgRatNEngRelFuM "Instance of dew point end class of sensor 2 at bank 1 / Flag current energy input lower threshold sensor" UBYTE B_TRUE 1 100 0.00 1.00000000000 BIT_MASK 0x40 FORMAT "%13.11" ECU_ADDRESS 0x50001484 /end MEASUREMENT
/begin MEASUREMENT DewDet_S2B1_I.flgRstDewDet "Instance of dew point end class of sensor 2 at bank 1 / falling edge dew point end" UBYTE B_TRUE 1 100 0.00 1.00000000000 BIT_MASK 0x8 FORMAT "%13.11" ECU_ADDRESS 0x50001485 /end MEASUREMENT
/begin MEASUREMENT DewDet_S2B1_I.flgRstDewPntEnd "Instance of dew point end class of sensor 2 at bank 1 / flag condition for reset dew-point end sensor" UBYTE B_TRUE 1 100 0.00 1.00000000000 BIT_MASK 0x80 FORMAT "%13.11" ECU_ADDRESS 0x50001484 /end MEASUREMENT
/begin MEASUREMENT DewDet_S2B1_I.flgRstEngOff "Instance of dew point end class of sensor 2 at bank 1 / condition dew point bit sensor reseted at engine stop" UBYTE B_TRUE 1 100 0.00 1.00000000000 BIT_MASK 0x1 FORMAT "%13.11" ECU_ADDRESS 0x50001485 /end MEASUREMENT
/begin MEASUREMENT DewDet_S2B1_I.flgRstEngOffStrt "Instance of dew point end class of sensor 2 at bank 1 / condition dew point bit sensor reseted at last engine stop" UBYTE B_TRUE 1 100 0.00 1.00000000000 BIT_MASK 0x10 FORMAT "%13.11" ECU_ADDRESS 0x50001485 /end MEASUREMENT
/begin MEASUREMENT DewDet_S2B1_I.flgRstInt "Instance of dew point end class of sensor 2 at bank 1 / flag for reset of heat flow integral sensor" UBYTE B_TRUE 1 100 0.00 1.00000000000 BIT_MASK 0x2 FORMAT "%13.11" ECU_ADDRESS 0x50001485 /end MEASUREMENT
/begin MEASUREMENT DewDet_S2B1_I.flgSetDewPntEnd "Instance of dew point end class of sensor 2 at bank 1 / flag set dew point end sensor" UBYTE B_TRUE 1 100 0.00 1.00000000000 BIT_MASK 0x4 FORMAT "%13.11" ECU_ADDRESS 0x50001485 /end MEASUREMENT
/begin MEASUREMENT DewDet_S2B1_I.flgTUpdFco "Instance of dew point end class of sensor 2 at bank 1 / condition update sensor start temperature due to reset of dew point end while FCO" UBYTE B_TRUE 1 100 0.00 1.00000000000 BIT_MASK 0x20 FORMAT "%13.11" ECU_ADDRESS 0x50001485 /end MEASUREMENT
/begin MEASUREMENT DewDet_S2B1_I.mfExhSnsr "Instance of dew point end class of sensor 2 at bank 1 / exhaust-gas mass flows" FLOAT32_IEEE RBPtCel_mf_1p0_1 1 100 -100000.0000 100000.0000 FORMAT "%10.4" ECU_ADDRESS 0x50001480 /end MEASUREMENT
/begin MEASUREMENT DewDet_S2B1_I.tSnsrCoolg "Instance of dew point end class of sensor 2 at bank 1 / temperature at sensor while engine stop" SWORD Temp_Cels 1 100 -3549.940 3003.560 FORMAT "%8.3" ECU_ADDRESS 0x50001486 /end MEASUREMENT
/begin MEASUREMENT DewDet_S2B1_I.tSnsrEnd "Instance of dew point end class of sensor 2 at bank 1 / temperature at sensor at switch off" SWORD Temp_Cels 1 100 -3549.940 3003.560 FORMAT "%8.3" ECU_ADDRESS 0x60039378 /end MEASUREMENT
/begin MEASUREMENT DewDet_S2B1_I.tSnsrStrt "Instance of dew point end class of sensor 2 at bank 1 / temperature at sensor at engine start" SWORD Temp_Cels 1 100 -3549.940 3003.560 FORMAT "%8.3" ECU_ADDRESS 0x50001488 /end MEASUREMENT
/begin MEASUREMENT DewDet_S2B1_I.tWallCoolg "Instance of dew point end class of sensor 2 at bank 1 / temperature wall of sensor = f(stop time) in stop phase" SWORD Temp_Cels 1 100 -3549.940 3003.560 FORMAT "%8.3" ECU_ADDRESS 0x5000148A /end MEASUREMENT
/begin MEASUREMENT DewDet_S2B1_I.tWallEngStop "Instance of dew point end class of sensor 2 at bank 1 / temperature wall of sensor bei start of stop phase" SWORD Temp_Cels 1 100 -3549.940 3003.560 FORMAT "%8.3" ECU_ADDRESS 0x5000148C /end MEASUREMENT
/begin MEASUREMENT DewDet_S2B1_I.tWallSnsrOld "Instance of dew point end class of sensor 2 at bank 1 / wall temperature sensor old" SWORD Temp_Cels 1 100 -3549.940 3003.560 FORMAT "%8.3" ECU_ADDRESS 0x5000148E /end MEASUREMENT
/begin MEASUREMENT DewDet_S2B1_I.tiShtDwn "Instance of dew point end class of sensor 2 at bank 1 / stop time dew-point end" UWORD t1sxs_uw_q1 1 100 0.00 65535.00 FORMAT "%8.2" ECU_ADDRESS 0x50001490 /end MEASUREMENT
/begin MEASUREMENT DewDet_tiShDown "stop time dew-point end" UWORD t_q1 1 100 0.00 65535.00 FORMAT "%8.2" ECU_ADDRESS 0x60008F96 /end MEASUREMENT
/begin MEASUREMENT dlamatr_w_msg "desired delta lambda of exhaust temperature control" SWORD fak_sw_b8 1 100 -8.000000 7.999756 FORMAT "%8.6" ECU_ADDRESS 0x60008FC0 /end MEASUREMENT
/begin MEASUREMENT dlambssa_w "Distance between lambda for component protection and release of fuel cut-off" SWORD fak_sw_b8 1 100 -7.999756 7.999756 FORMAT "%8.6" ECU_ADDRESS 0x600077F2 /end MEASUREMENT
/begin MEASUREMENT ECT_bFCOEnaCmpnPrt "condition: torque reduction by injection fade out due to temperature, component protection" UBYTE B_TRUE 1 100 0.00 1.00000000000 BIT_MASK 0x1 FORMAT "%13.11" ECU_ADDRESS 0x6000F6B2 /end MEASUREMENT
/begin MEASUREMENT ExhMgT_cntrIniDrvTExhCtrlrCptProtn "local drive cycle counter which is incremented when system state SyC_PostDrive is left" UBYTE OneToOne 1 100 0.00 255.0 FORMAT "%5.1" ECU_ADDRESS 0x6000B913 /end MEASUREMENT
/begin MEASUREMENT ExhMgT_cntrReIniRelsFcoTEgSys "counter reini ReIni ExhMgT_RelsFcoTEgSys" UBYTE OneToOne 1 100 0.00 255.0 FORMAT "%5.1" ECU_ADDRESS 0x6000B918 /end MEASUREMENT
/begin MEASUREMENT ExhMgT_cntrReIniTExhCtrlrCptProtn "local drive cycle counter which is incremented when system state SyC_PostDrive is left" UBYTE OneToOne 1 100 0.00 255.0 FORMAT "%5.1" ECU_ADDRESS 0x6000B912 /end MEASUREMENT
/begin MEASUREMENT ExhMgT_facDftlCptProtnGovrB1 "factor for D-part of exhaust temperature controller, bench1" SWORD fak_q0p01 1 100 -327.6800 327.6700 FORMAT "%8.4" ECU_ADDRESS 0x600077D0 /end MEASUREMENT
/begin MEASUREMENT ExhMgT_flgAllwdFuFco "component protection allowes fired thrust" UBYTE B_TRUE 1 100 0.00 1.00000000000 BIT_MASK 0x1 FORMAT "%13.11" ECU_ADDRESS 0x6000B917 /end MEASUREMENT
/begin MEASUREMENT ExhMgT_flgCtrlActvCptProtnB1 "condition exhaust temperature control bank 1" UBYTE B_TRUE 1 100 0.00 1.00000000000 BIT_MASK 0x1 FORMAT "%13.11" ECU_ADDRESS 0x7000096D /end MEASUREMENT
/begin MEASUREMENT ExhMgT_flgCutOffFirstTi "The release of the overrun fuel cut to prevent cooling down was at least once transacted" UBYTE B_TRUE 1 100 0.00 1.00000000000 BIT_MASK 0x1 FORMAT "%13.11" ECU_ADDRESS 0x6000B916 /end MEASUREMENT
/begin MEASUREMENT ExhMgT_flgLamFuFco "Activation of rich lambda by idle speed" UBYTE B_TRUE 1 100 0.00 1.00000000000 BIT_MASK 0x1 FORMAT "%13.11" ECU_ADDRESS 0x6000F69E /end MEASUREMENT
/begin MEASUREMENT ExhMgT_flgRelsCutOffTExhHi "cut-off released due to the exhaust gas temperatures in order to avoid possible overheating (temperature below the critical temperature in the exhaust gas catalyst)" UBYTE B_TRUE 1 100 0.00 1.00000000000 BIT_MASK 0x1 FORMAT "%13.11" ECU_ADDRESS 0x6000F69C /end MEASUREMENT
/begin MEASUREMENT ExhMgT_flgRelsCutOffTExhLo "cut-off released due to the exhaust gas temperatures in order to avoid possible cooling (temperature below the critical temperature in the exhaust gas catalyst)" UBYTE B_TRUE 1 100 0.00 1.00000000000 BIT_MASK 0x1 FORMAT "%13.11" ECU_ADDRESS 0x6000F69B /end MEASUREMENT
/begin MEASUREMENT ExhMgT_flgTFcoCat1 "release fuel cut-off only in dependence of first catalyst" UBYTE B_TRUE 1 100 0.00 1.00000000000 BIT_MASK 0x1 FORMAT "%13.11" ECU_ADDRESS 0x6000B915 /end MEASUREMENT
/begin MEASUREMENT ExhMgT_flgTFcoCat2 "release fuel cut-off only in dependence of second catalyst" UBYTE B_TRUE 1 100 0.00 1.00000000000 BIT_MASK 0x1 FORMAT "%13.11" ECU_ADDRESS 0x6000B914 /end MEASUREMENT
/begin MEASUREMENT ExhMgT_mfExhCptProtnGovr "Exhaust gas mass flow for exhaust gas temperature controller bank 1" FLOAT32_IEEE AirMassPerTime_float 1 100 0.00 50000.0000 FORMAT "%10.4" ECU_ADDRESS 0x60002AC4 /end MEASUREMENT
/begin MEASUREMENT ExhMgT_PidGovr_temp1_B1.ExhMgT_facDftlCptProtnGovrNoCorrn "CLASS_INSTANCE / factor D-Part exhaust temperature controller without correction" SWORD fak_sw_b8 1 100 -8.000000 7.999756 FORMAT "%8.6" ECU_ADDRESS 0x60002AAC /end MEASUREMENT
/begin MEASUREMENT ExhMgT_PidGovr_temp1_B1.ExhMgT_ratDeltaLamCptProtnGovrMax "CLASS_INSTANCE / Maximum limit of actuator for exhaust gas temperature feedback control" SWORD fak_sw_b8 1 100 -8.000000 7.999756 FORMAT "%8.6" ECU_ADDRESS 0x60002AAE /end MEASUREMENT
/begin MEASUREMENT ExhMgT_PidGovr_temp1_B1.ExhMgT_ratDeltaLamDftlCptProtnGovr "CLASS_INSTANCE / D-part of exhaust temperature controller (delta lambda)" SWORD fak_sw_b8 1 100 -8.000000 0.00 FORMAT "%8.6" ECU_ADDRESS 0x60002AB0 /end MEASUREMENT
/begin MEASUREMENT ExhMgT_PidGovr_temp1_B1.ExhMgT_ratDeltaLamKiCptProtnGovr "CLASS_INSTANCE / I-part of exhaust temperature controller (delta lambda)" SWORD fak_sw_b8 1 100 -8.000000 7.999756 FORMAT "%8.6" ECU_ADDRESS 0x60002AB2 /end MEASUREMENT
/begin MEASUREMENT ExhMgT_PidGovr_temp1_B1.ExhMgT_ratDeltaLamKpCptProtnGovr "CLASS_INSTANCE / P-part of exhaust temperature controller (delta lambda)" SWORD fak_sw_b8 1 100 -8.000000 7.999756 FORMAT "%8.6" ECU_ADDRESS 0x60002AB4 /end MEASUREMENT
/begin MEASUREMENT ExhMgT_PidGovr_temp1_B1.ExhMgT_tDftlCptProtnGovr "CLASS_INSTANCE / temperature of D-Part of exhaust temperature controler" SLONG q1p52588Em6_K 1 100 -3276.80000000 3276.79999847 FORMAT "%13.8" ECU_ADDRESS 0x60002AB8 /end MEASUREMENT
/begin MEASUREMENT ExhMgT_PidGovr_temp1_B1.ExhMgT_tDifCptProtnGovr "CLASS_INSTANCE / limited temperature of D-Part of exhaust temperature controler" SLONG q1p52588Em6_K 1 100 -3276.80000000 3276.79999847 FORMAT "%13.8" ECU_ADDRESS 0x60002ABC /end MEASUREMENT
/begin MEASUREMENT ExhMgT_PidGovr_temp1_B1.CmpPrt_dlatriIKL_I.memory "CLASS_INSTANCE / integrator for I-Part of exhaust temperature controller / Current Integrator value" SLONG dez 1 100 -2147483648.00 2147483647.00 FORMAT "%13.2" ECU_ADDRESS 0x60002AC0 /end MEASUREMENT
/begin MEASUREMENT ExhMgT_ratDeltaCptProtnGovr1Min "minimum limit exhaust temperature controller 1" SWORD fak_sw_b8 1 100 -0.3999023 0.00 FORMAT "%9.7" ECU_ADDRESS 0x600077CE /end MEASUREMENT
/begin MEASUREMENT ExhMgT_ratDeltaCptProtnGovrMin "minimal delta lambda of all controllers" SWORD fak_sw_b8 1 100 -8.000000 7.999756 FORMAT "%8.6" ECU_ADDRESS 0x600077CC /end MEASUREMENT
/begin MEASUREMENT ExhMgT_ratDeltaLamCtrlCptProtnB1 "desired delta lambda of exhaust temperature control bank 1" SWORD fak_sw_b8 1 100 -8.000000 7.999756 FORMAT "%8.6" ECU_ADDRESS 0x600091CA /end MEASUREMENT
/begin MEASUREMENT ExhMgT_ratDeltaLamDftlCptProtnGovr "D-part of exhaust temperature controller (Delta-Lambda), bench1" SWORD fak_sw_b8 1 100 -8.000000 0.00 FORMAT "%8.6" ECU_ADDRESS 0x600077CA /end MEASUREMENT
/begin MEASUREMENT ExhMgT_ratDeltaLamTGovrCptProtnB1 "Delta temperature for exhaust gas feedback control bench1" SWORD fak_sw_b8 1 100 -8.000000 7.999756 FORMAT "%8.6" ECU_ADDRESS 0x600077C8 /end MEASUREMENT
/begin MEASUREMENT ExhMgT_ratLamFuFco "fuel cut off lambda for component protection" UWORD fak_uw_b16 1 100 0.00 15.99976 FORMAT "%8.5" ECU_ADDRESS 0x60008F42 /end MEASUREMENT
/begin MEASUREMENT ExhMgT_RelsCptPrortnGovrTONV_I.outbit "time delay for release of exhaust temperature controler bench1 / return value" UBYTE B_TRUE 1 100 0.00 1.00000000000 BIT_MASK 0x1 FORMAT "%13.11" ECU_ADDRESS 0x600077BC /end MEASUREMENT
/begin MEASUREMENT ExhMgT_RelsCptPrortnGovrTONV_I.time "time delay for release of exhaust temperature controler bench1 / expired delay time" UBYTE t_q0p1 1 100 0.00 25.50 FORMAT "%5.2" ECU_ADDRESS 0x600077BD /end MEASUREMENT
/begin MEASUREMENT ExhMgT_tCat1AvrgFildB1 "filtered average temperature catalyst 1 Bank1" SWORD temp_q0p1_o273 1 100 -3549.940 3003.560 FORMAT "%8.3" ECU_ADDRESS 0x600091C6 /end MEASUREMENT
/begin MEASUREMENT ExhMgT_tCat1AvrgLocB1 "local average temperature catalyst 1 bank 1 for component protection" SWORD temp_q0p1_o273 1 100 -3549.940 3003.560 FORMAT "%8.3" ECU_ADDRESS 0x600077F0 /end MEASUREMENT
/begin MEASUREMENT ExhMgT_tCat1EndFildB1 "filtered temperature end of catalyst 1 Bank1" SWORD temp_q0p1_o273 1 100 -3549.940 3003.560 FORMAT "%8.3" ECU_ADDRESS 0x600091BE /end MEASUREMENT
/begin MEASUREMENT ExhMgT_tCat1EndLocB1 "local variable for the temperature at the end of catalyst 1 bank 1 for fuel cut-off" SWORD temp_q0p1_o273 1 100 -3549.940 3003.560 FORMAT "%8.3" ECU_ADDRESS 0x600077EE /end MEASUREMENT
/begin MEASUREMENT ExhMgT_tCat1FildB1 "filtered temperature of catalyst 1 Bank1" SWORD temp_q0p1_o273 1 100 -3549.940 3003.560 FORMAT "%8.3" ECU_ADDRESS 0x600091BC /end MEASUREMENT
/begin MEASUREMENT ExhMgT_tCat1LocB1 "local variable for the temperature in the catalyst 1 bank 1 for fuel cut-off" SWORD temp_q0p1_o273 1 100 -3549.940 3003.560 FORMAT "%8.3" ECU_ADDRESS 0x600077EC /end MEASUREMENT
/begin MEASUREMENT ExhMgT_tCat1MaxFildB1 "filtered maximum temperature catalyst 1" SWORD temp_q0p1_o273 1 100 -3549.940 3003.560 FORMAT "%8.3" ECU_ADDRESS 0x600091B6 /end MEASUREMENT
/begin MEASUREMENT ExhMgT_tCat1MaxLocB1 "local variable for the maximal temperature in the catalyst 1 bank 1 for fuel cut-off" SWORD temp_q0p1_o273 1 100 -3549.940 3003.560 FORMAT "%8.3" ECU_ADDRESS 0x600077EA /end MEASUREMENT
/begin MEASUREMENT ExhMgT_tCat1MinFildB1 "filtered minimum temperature of catalyst 1 B1" SWORD temp_q0p1_o273 1 100 -3549.940 3003.560 FORMAT "%8.3" ECU_ADDRESS 0x600091B4 /end MEASUREMENT
/begin MEASUREMENT ExhMgT_tCat1MinLocB1 "local variable for the minimal temperature in the catalyst 1 bank 1 for fuel cut-off" SWORD temp_q0p1_o273 1 100 -3549.940 3003.560 FORMAT "%8.3" ECU_ADDRESS 0x600077E8 /end MEASUREMENT
/begin MEASUREMENT ExhMgT_tCat2AvrgFildB1 "filtered average temperature catalyst 2 Bank1" SWORD temp_q0p1_o273 1 100 -3549.940 3003.560 FORMAT "%8.3" ECU_ADDRESS 0x600091AA /end MEASUREMENT
/begin MEASUREMENT ExhMgT_tCat2AvrgLocB1 "local average temperature catalyst 2 bank 1 for component protection" SWORD temp_q0p1_o273 1 100 -3549.940 3003.560 FORMAT "%8.3" ECU_ADDRESS 0x600077E6 /end MEASUREMENT
/begin MEASUREMENT ExhMgT_tCat2EndFildB1 "filtered temperature end of catalyst 2 Bank1" SWORD temp_q0p1_o273 1 100 -3549.940 3003.560 FORMAT "%8.3" ECU_ADDRESS 0x600091A6 /end MEASUREMENT
/begin MEASUREMENT ExhMgT_tCat2EndLocB1 "local variable for the temperature at the end of catalyst 2 bank 1 for fuel cut-off" SWORD temp_q0p1_o273 1 100 -3549.940 3003.560 FORMAT "%8.3" ECU_ADDRESS 0x600077E4 /end MEASUREMENT
/begin MEASUREMENT ExhMgT_tCat2FildB1 "filtered temperature of catalyst 2 Bank1" SWORD temp_q0p1_o273 1 100 -3549.940 3003.560 FORMAT "%8.3" ECU_ADDRESS 0x600091A4 /end MEASUREMENT
/begin MEASUREMENT ExhMgT_tCat2LocB1 "local variable for the temperature in the catalyst 2 bank 1 for fuel cut-off" SWORD temp_q0p1_o273 1 100 -3549.940 3003.560 FORMAT "%8.3" ECU_ADDRESS 0x600077E2 /end MEASUREMENT
/begin MEASUREMENT ExhMgT_tCat2MaxFildB1 "filtered maximum temperature catalyst 2" SWORD temp_q0p1_o273 1 100 -3549.940 3003.560 FORMAT "%8.3" ECU_ADDRESS 0x600091A2 /end MEASUREMENT
/begin MEASUREMENT ExhMgT_tCat2MaxLocB1 "local variable for the maximal temperature in the catalyst 2 bank 1 for fuel cut-off" SWORD temp_q0p1_o273 1 100 -3549.940 3003.560 FORMAT "%8.3" ECU_ADDRESS 0x600077E0 /end MEASUREMENT
/begin MEASUREMENT ExhMgT_tCat2MinFildB1 "filtered minimum temperature of catalyst 2 Bank1" SWORD temp_q0p1_o273 1 100 -3549.940 3003.560 FORMAT "%8.3" ECU_ADDRESS 0x600091A0 /end MEASUREMENT
/begin MEASUREMENT ExhMgT_tCat2MinLocB1 "local variable for the minimal temperature in the catalyst 2 bank 1 for fuel cut-off" SWORD temp_q0p1_o273 1 100 -3549.940 3003.560 FORMAT "%8.3" ECU_ADDRESS 0x600077DE /end MEASUREMENT
/begin MEASUREMENT ExhMgT_tCatCritFild "critical temperature inside of cataylst for protection of mat between catalyst and catalyst body (filtered)" SWORD Temp_Cels 1 100 -3549.940 3003.560 FORMAT "%8.3" ECU_ADDRESS 0x600077C6 /end MEASUREMENT
/begin MEASUREMENT ExhMgT_tCatCritLT_I.memory "LowpassT / current lowpass value" SLONG temp_q1p5259Em6_om273 1 100 -3549.94000000 3003.65999847 FORMAT "%13.8" ECU_ADDRESS 0x60002AA8 /end MEASUREMENT
/begin MEASUREMENT ExhMgT_tCatCritUnfild "critical temperature inside of cataylst for protection of mat between catalyst and catalyst body (unfiltered)" SWORD Temp_Cels 1 100 -3549.940 3003.560 FORMAT "%8.3" ECU_ADDRESS 0x600077C4 /end MEASUREMENT
/begin MEASUREMENT ExhMgT_tDiffCatCritB1 "temperature difference between critical temperature inside of cataylst for protection of mat between catalyst and catalyst body and modelled wall temperature (bank1)" SWORD temp_q0p1_K 1 100 -3276.800 3276.700 FORMAT "%8.3" ECU_ADDRESS 0x600077C2 /end MEASUREMENT
/begin MEASUREMENT ExhMgT_tExhDsVlvFildB1 "filtered exhaust gas temperature downstream exhaust valve, modelled, bank 1" SWORD temp_q0p1_o273 1 100 -3549.940 3003.560 FORMAT "%8.3" ECU_ADDRESS 0x60009184 /end MEASUREMENT
/begin MEASUREMENT ExhMgT_tExhMnfB1Prev "exhaustgas temperature manifold from the previous time grid, bank 1" SWORD temp_q0p1_o273 1 100 -3549.940 3003.560 FORMAT "%8.3" ECU_ADDRESS 0x600077BA /end MEASUREMENT
/begin MEASUREMENT ExhMgT_tExhMnfFildB1 "filtered exhaust gas temperature manifold, bank 1" SWORD temp_q0p1_o273 1 100 -3549.940 3003.560 FORMAT "%8.3" ECU_ADDRESS 0x60009180 /end MEASUREMENT
/begin MEASUREMENT ExhMgT_tExhMnfFildB1Prev "filtered exhaust gas temperature manifold from the previous time grid, bank 1" SWORD temp_q0p1_o273 1 100 -3549.940 3003.560 FORMAT "%8.3" ECU_ADDRESS 0x6000917E /end MEASUREMENT
/begin MEASUREMENT ExhMgT_tExhMnfFildGrdtB1 "filtered exhaust gas temperature gradient manifold, bank 1" SWORD temp_q0p1_K 1 100 -3276.800 3276.700 FORMAT "%8.3" ECU_ADDRESS 0x6000917C /end MEASUREMENT
/begin MEASUREMENT ExhMgT_tiTFltExhMnf "filter time for exhaustgas temperature manifold, Bank 1" UWORD t_q0p05 1 100 0.050 3276.750 FORMAT "%8.3" ECU_ADDRESS 0x600077B8 /end MEASUREMENT
/begin MEASUREMENT ExhMgT_tMinCat1FcoB1 "minmal delta exhaust temperature for 1.catalyst for release of cut off and for cylinder-individual fuel cut-off ( bench1)" SWORD temp_q0p1_K 1 100 -3276.800 3276.700 FORMAT "%8.3" ECU_ADDRESS 0x600077DC /end MEASUREMENT
/begin MEASUREMENT ExhMgT_tMinCat1FcoCoolgB1 "minimum delta exhaust temperature of the first catalyst for the release of the overrun fuel cut (preventing cooling down)" SWORD temp_q0p1_K 1 100 -3276.800 3276.700 FORMAT "%8.3" ECU_ADDRESS 0x600077DA /end MEASUREMENT
/begin MEASUREMENT ExhMgT_tMinCat2FcoB1 "minmal delta exhaust temperature for 2.catalyst for release of cut off and for cylinder-individual fuel cut-off ( bench1)" SWORD temp_q0p1_K 1 100 -3276.800 3276.700 FORMAT "%8.3" ECU_ADDRESS 0x600077D8 /end MEASUREMENT
/begin MEASUREMENT ExhMgT_tMinCat2FcoCoolgB1 "minimum delta exhaust gas temperature of the second catalyst for the release of the overrun fuel cut (preventing cooling down)" SWORD temp_q0p1_K 1 100 -3276.800 3276.700 FORMAT "%8.3" ECU_ADDRESS 0x600077D6 /end MEASUREMENT
/begin MEASUREMENT ExhMgT_tMinCatFco "minmal delta exhaust temperature for all .catalysts for release of cut off and for cylinder-individual fuel cut-off ( bench1)" SWORD temp_q0p1_K 1 100 -3276.800 3276.700 FORMAT "%8.3" ECU_ADDRESS 0x600077D4 /end MEASUREMENT
/begin MEASUREMENT ExhMgT_tMinCatFcoCoolg "minimum delta exhaust temperature of all catalysts for the release of the fuel cut-off (preventing cooling down)" SWORD temp_q0p1_K 1 100 -3276.800 3276.700 FORMAT "%8.3" ECU_ADDRESS 0x600077D2 /end MEASUREMENT
/begin MEASUREMENT ExhMgT_tMinGrdtTExhGovrB1 "Temperature gradient of the smallest minimum exhaust gas temperature (distance from the critical components temperatures), bench1" SWORD temp_q0p1_K 1 100 -3276.800 3276.700 FORMAT "%8.3" ECU_ADDRESS 0x600077C0 /end MEASUREMENT
/begin MEASUREMENT ExhMgT_tMinTExhGovrCptProtn "minimum distance of exhaust temperature from critical temperatures of components of all controllers, bench 1" SWORD temp_q0p1_K 1 100 -3276.800 3276.700 FORMAT "%8.3" ECU_ADDRESS 0x6000916C /end MEASUREMENT
/begin MEASUREMENT ExhMgT_tMinTExhGovrCptProtnB1 "minimum distance of exhaust temperature from critical temperatures of components, bench 1" SWORD temp_q0p1_K 1 100 -3276.800 3276.700 FORMAT "%8.3" ECU_ADDRESS 0x6000916A /end MEASUREMENT
/begin MEASUREMENT ExhMgT_tMinTExhGovrCptProtnB1old "minimum distance of exhaust temperature from critical temperatures of components, bench 1 (old value)" SWORD temp_q0p1_K 1 100 -3276.800 3276.700 FORMAT "%8.3" ECU_ADDRESS 0x600077BE /end MEASUREMENT
/begin MEASUREMENT ExhMod_cntrCldStrtAryB1 "array of cold start counter for sensors in bank1" UBYTE dez 1 100 0.00 255.0 FORMAT "%5.1" ARRAY_SIZE 2 ECU_ADDRESS 0x6000F7E3 /end MEASUREMENT
/begin MEASUREMENT ExhMod_cntrCldStrtS1B1 "counter for repeated cold starts dew-point end not reached sensor 1" UBYTE dez 1 100 0.00 255.0 FORMAT "%5.1" ECU_ADDRESS 0x6000F7E2 /end MEASUREMENT
/begin MEASUREMENT ExhMod_cntrCldStrtS2B1 "counter for repeated cold starts dew-point end not reached sensor 2" UBYTE dez 1 100 0.00 255.0 FORMAT "%5.1" ECU_ADDRESS 0x6000F7E1 /end MEASUREMENT
/begin MEASUREMENT ExhMod_dmAirB1 "air mass flow" SWORD m_q0p1 1 100 -3276.800 3276.700 FORMAT "%8.3" ECU_ADDRESS 0x60014884 /end MEASUREMENT
/begin MEASUREMENT ExhMod_dmEgrMflowB1 "Exhaust mass flow EGR bank 1" SWORD m_q0p1 1 100 -3276.800 3276.700 FORMAT "%8.3" ECU_ADDRESS 0x60014886 /end MEASUREMENT
/begin MEASUREMENT ExhMod_dmExhAryB1 "mass flow array exhaust gas" SWORD m_q0p1 1 100 -3276.800 3276.700 FORMAT "%8.3" ARRAY_SIZE 12 ECU_ADDRESS 0x50005D7E /end MEASUREMENT
/begin MEASUREMENT ExhMod_dmExhCat1B1 "mass flow exhaust gas catalyst 1" SWORD m_q0p1 1 100 -3276.800 3276.700 FORMAT "%8.3" ECU_ADDRESS 0x6000999A /end MEASUREMENT
/begin MEASUREMENT ExhMod_dmExhCat2B1 "mass flow exhaust gas catalyst 2" SWORD m_q0p1 1 100 -3276.800 3276.700 FORMAT "%8.3" ECU_ADDRESS 0x60014888 /end MEASUREMENT
/begin MEASUREMENT ExhMod_dmExhMnfB1 "mass flow exhaust gas, manifold" SWORD m_q0p1 1 100 -3276.800 3276.700 FORMAT "%8.3" ECU_ADDRESS 0x6001488A /end MEASUREMENT
/begin MEASUREMENT ExhMod_dmExhS1B1 "mass flow exhaust gas sensor 1" SWORD m_q0p1 1 100 -3276.800 3276.700 FORMAT "%8.3" ECU_ADDRESS 0x60009998 /end MEASUREMENT
/begin MEASUREMENT ExhMod_dmExhS2B1 "mass flow exhaust gas sensor 2" SWORD m_q0p1 1 100 -3276.800 3276.700 FORMAT "%8.3" ECU_ADDRESS 0x6001488C /end MEASUREMENT
/begin MEASUREMENT ExhMod_dmExhVlvB1 "exhaust gas mass flow at outlet valves" SWORD m_q0p1 1 100 -3276.800 3276.700 FORMAT "%8.3" ECU_ADDRESS 0x6001488E /end MEASUREMENT
/begin MEASUREMENT ExhMod_dmExhWoFuUsCat1B1 "Mass flow exhaust gas minus fuel part upstream of catalyst 1" SWORD m_q0p1 1 100 -3276.800 3276.700 FORMAT "%8.3" ECU_ADDRESS 0x60009996 /end MEASUREMENT
/begin MEASUREMENT ExhMod_dmExhWoFuUsCat2B1 "Mass flow exhaust gas minus fuel part upstream of catalyst 2" SWORD m_q0p1 1 100 -3276.800 3276.700 FORMAT "%8.3" ECU_ADDRESS 0x60009994 /end MEASUREMENT
/begin MEASUREMENT ExhMod_dmFuB1 "fuel mass flow" SWORD m_q0p1 1 100 -3276.800 3276.700 FORMAT "%8.3" ECU_ADDRESS 0x60014890 /end MEASUREMENT
/begin MEASUREMENT ExhMod_dmO2Cat1B1 "Oxygen mass flow in catalyst 1" SWORD m_q0p1_mgs 1 100 -3276.800 3276.700 FORMAT "%8.3" ECU_ADDRESS 0x60014892 /end MEASUREMENT
/begin MEASUREMENT ExhMod_dmO2Cat2B1 "Oxygen mass flow in catalyst 2" SWORD m_q0p1_mgs 1 100 -3276.800 3276.700 FORMAT "%8.3" ECU_ADDRESS 0x70005390 /end MEASUREMENT
/begin MEASUREMENT ExhMod_egyDewPntEndS1B1 "heat quantity for dew-point end detection sensor 1" SWORD q_q1_kJ 1 100 -32768.00 32767.00 FORMAT "%8.2" ECU_ADDRESS 0x6000915C /end MEASUREMENT
/begin MEASUREMENT ExhMod_egyDewPntEndS2B1 "heat quantity for dew-point end detection sensor 2" SWORD q_q1_kJ 1 100 -32768.00 32767.00 FORMAT "%8.2" ECU_ADDRESS 0x6000915A /end MEASUREMENT
/begin MEASUREMENT ExhMod_egyThdDewPntEndS1B1 "heat quantity threshold for dew-point end detection sensor 1" SWORD q_q1_kJ 1 100 -32768.00 32767.00 FORMAT "%8.2" ECU_ADDRESS 0x60009158 /end MEASUREMENT
/begin MEASUREMENT ExhMod_egyThdDewPntEndS2B1 "heat quantity threshold for dew-point end detection sensor 2" SWORD q_q1_kJ 1 100 -32768.00 32767.00 FORMAT "%8.2" ECU_ADDRESS 0x60009156 /end MEASUREMENT
/begin MEASUREMENT ExhMod_facCnvnCpbyTLiOffBrickAryB1 "Temperature dependent light off conversion capability factor of the brick - array bank 1" UWORD fak_uw_b2 1 100 0.00 1.999969 FORMAT "%8.6" ARRAY_SIZE 6 ECU_ADDRESS 0x60008F28 /end MEASUREMENT
/begin MEASUREMENT ExhMod_facCnvnCpbyTLiOffCatAryB1 "Temperature dependent light off conversion capability factor of the catalyst - array bank 1" UWORD fak_uw_b2 1 100 0.00 1.999969 FORMAT "%8.6" ARRAY_SIZE 2 ECU_ADDRESS 0x60008F24 /end MEASUREMENT
/begin MEASUREMENT ExhMod_facCoCnvnCpbyTLiOffBrickAryB1 "Temperature dependent light off CO conversion capability factor of the brick - array bank 1" UWORD fak_uw_b2 1 100 0.00 1.999969 FORMAT "%8.6" ARRAY_SIZE 6 ECU_ADDRESS 0x60008F18 /end MEASUREMENT
/begin MEASUREMENT ExhMod_facHcCnvnCpbyTLiOffBrickAryB1 "Temperature dependent light off HC conversion capability factor of the brick - array bank 1" UWORD fak_uw_b2 1 100 0.00 1.999969 FORMAT "%8.6" ARRAY_SIZE 6 ECU_ADDRESS 0x60008F00 /end MEASUREMENT
/begin MEASUREMENT ExhMod_facNoxCnvnCpbyTLiOffBrickAryB1 "Temperature dependent light off NOx conversion capability factor of the brick - array bank 1" UWORD fak_uw_b2 1 100 0.00 1.999969 FORMAT "%8.6" ARRAY_SIZE 6 ECU_ADDRESS 0x60008EF2 /end MEASUREMENT
/begin MEASUREMENT ExhMod_facTLiOffCatAryB1 "Temperature dependent light off conversion capability factor of the catalyst - array bank 1" UWORD fak_uw_b2 1 100 0.00 1.999969 FORMAT "%8.6" ARRAY_SIZE 3 ECU_ADDRESS 0x60008EEC /end MEASUREMENT
/begin MEASUREMENT ExhMod_facWghtCnvnCpbyTLiOffBrickAryB1 "Weighted temperature dependent light off conversion capability factor of the brick - array bank 1" UWORD fak_uw_b2 1 100 0.00 1.999969 FORMAT "%8.6" ARRAY_SIZE 6 ECU_ADDRESS 0x60008EE0 /end MEASUREMENT
/begin MEASUREMENT ExhMod_facWghtCnvnCpbyTLiOffCatAryB1 "Weighted temperature dependent light off conversion capability factor of the catalyst - array bank 1" UWORD fak_uw_b2 1 100 0.00 1.999969 FORMAT "%8.6" ARRAY_SIZE 2 ECU_ADDRESS 0x60008EDC /end MEASUREMENT
/begin MEASUREMENT ExhMod_flgCfgPlausB1 "bit configuration exhaust system plausibel bank 1" UBYTE B_TRUE 1 100 0.00 1.00000000000 BIT_MASK 0x1 FORMAT "%13.11" ECU_ADDRESS 0x70000274 /end MEASUREMENT
/begin MEASUREMENT ExhMod_flgDewPntEndLstNvS1B1 "flag dew-point end sensor 1 (last trip) NV" UBYTE B_TRUE 1 100 0.00 1.00000000000 BIT_MASK 0x1 FORMAT "%13.11" ECU_ADDRESS 0x60036DCE /end MEASUREMENT
/begin MEASUREMENT ExhMod_flgDewPntEndLstS1B1 "flag dew-point end sensor 1 (last trip)" UBYTE B_TRUE 1 100 0.00 1.00000000000 BIT_MASK 0x1 FORMAT "%13.11" ECU_ADDRESS 0x70000960 /end MEASUREMENT
/begin MEASUREMENT ExhMod_flgDewPntEndLstS2B1 "flag dew-point end sensor 2 (last trip)" UBYTE B_TRUE 1 100 0.00 1.00000000000 BIT_MASK 0x1 FORMAT "%13.11" ECU_ADDRESS 0x7000095F /end MEASUREMENT
/begin MEASUREMENT ExhMod_flgDewPntEndS1B1 "flag dew point end sensor 1" UBYTE B_TRUE 1 100 0.00 1.00000000000 BIT_MASK 0x1 FORMAT "%13.11" ECU_ADDRESS 0x7000095D /end MEASUREMENT
/begin MEASUREMENT ExhMod_flgDewPntEndS1B1Sig "flag dew point end sensor 1" UBYTE B_TRUE 1 100 0.00 1.00000000000 BIT_MASK 0x1 FORMAT "%13.11" ECU_ADDRESS 0x6000F698 /end MEASUREMENT
/begin MEASUREMENT ExhMod_flgDewPntEndS2B1 "flag dew point end sensor 2" UBYTE B_TRUE 1 100 0.00 1.00000000000 BIT_MASK 0x1 FORMAT "%13.11" ECU_ADDRESS 0x7000095C /end MEASUREMENT
/begin MEASUREMENT ExhMod_flgDewPntEndS2B1Sig "flag dew point end sensor 2" UBYTE B_TRUE 1 100 0.00 1.00000000000 BIT_MASK 0x1 FORMAT "%13.11" ECU_ADDRESS 0x6000F697 /end MEASUREMENT
/begin MEASUREMENT ExhMod_flgEmptyCat1B1 "flag no oxygen stored in catalyst 1" UBYTE B_TRUE 1 100 0.00 1.00000000000 BIT_MASK 0x1 FORMAT "%13.11" ECU_ADDRESS 0x7000095B /end MEASUREMENT
/begin MEASUREMENT ExhMod_flgEmptyCat2B1 "flag no oxygen stored in catalyst 2" UBYTE B_TRUE 1 100 0.00 1.00000000000 BIT_MASK 0x1 FORMAT "%13.11" ECU_ADDRESS 0x7000095A /end MEASUREMENT
/begin MEASUREMENT ExhMod_flgFullCat1B1 "flag catalyst 1 full of oxygen" UBYTE B_TRUE 1 100 0.00 1.00000000000 BIT_MASK 0x1 FORMAT "%13.11" ECU_ADDRESS 0x70000956 /end MEASUREMENT
/begin MEASUREMENT ExhMod_flgFullCat2B1 "flag catalyst 2 full of oxygen" UBYTE B_TRUE 1 100 0.00 1.00000000000 BIT_MASK 0x1 FORMAT "%13.11" ECU_ADDRESS 0x70000955 /end MEASUREMENT
/begin MEASUREMENT ExhMod_flgLSEmptyCat1B1 "Flag lambda sensor indicates that catalyst 1 is empty of oxygen" UBYTE B_TRUE 1 100 0.00 1.00000000000 BIT_MASK 0x1 FORMAT "%13.11" ECU_ADDRESS 0x7000094D /end MEASUREMENT
/begin MEASUREMENT ExhMod_flgLSEnaCat1B1 "Flag lambda sensor valid downstream catalyst1 bank1" UBYTE B_TRUE 1 100 0.00 1.00000000000 BIT_MASK 0x1 FORMAT "%13.11" ECU_ADDRESS 0x7000094C /end MEASUREMENT
/begin MEASUREMENT ExhMod_flgLSFullCat1B1 "Flag lambda sensor indicates that catalyst 1 is full of oxygen" UBYTE B_TRUE 1 100 0.00 1.00000000000 BIT_MASK 0x1 FORMAT "%13.11" ECU_ADDRESS 0x7000094B /end MEASUREMENT
/begin MEASUREMENT ExhMod_flgLSNplCat1B1 "Flag oxygen sensor voltage downstream of catalyst 1 not plausible" UBYTE B_TRUE 1 100 0.00 1.00000000000 BIT_MASK 0x1 FORMAT "%13.11" ECU_ADDRESS 0x7000094A /end MEASUREMENT
/begin MEASUREMENT ExhMod_flgLSNplEmptyCat1B1 "Flag sensor downstream catalyst 1 not plausible when catalyst empty of oxygen" UBYTE B_TRUE 1 100 0.00 1.00000000000 BIT_MASK 0x1 FORMAT "%13.11" ECU_ADDRESS 0x70000949 /end MEASUREMENT
/begin MEASUREMENT ExhMod_flgLSNplFullCat1B1 "Flag sensor downstream catalyst 1 not plausible when catalyst full of oxygen" UBYTE B_TRUE 1 100 0.00 1.00000000000 BIT_MASK 0x1 FORMAT "%13.11" ECU_ADDRESS 0x70000948 /end MEASUREMENT
/begin MEASUREMENT ExhMod_flgPrePostDrv "Flag to indicate predrive or postdrive" UBYTE B_TRUE 1 100 0.00 1.00000000000 BIT_MASK 0x1 FORMAT "%13.11" ECU_ADDRESS 0x6000B910 /end MEASUREMENT
/begin MEASUREMENT ExhMod_flgTSnsrStrtCalcdB1 "Flag sensor start temperatures in dew point end calculated" UBYTE B_TRUE 1 100 0.00 1.00000000000 BIT_MASK 0x1 FORMAT "%13.11" ECU_ADDRESS 0x70000941 /end MEASUREMENT
/begin MEASUREMENT ExhMod_HeatBalIf.HeatStorg1 "interface class of the function for all inputs / Class attribute" SLONG RBPtCel_fac_0p00001_1 1 100 -21474.8364800 21474.8364700 FORMAT "%13.7" ECU_ADDRESS 0x60002A04 /end MEASUREMENT
/begin MEASUREMENT ExhMod_HeatBalIf.HeatStorg2 "interface class of the function for all inputs / Class attribute" SLONG RBPtCel_fac_0p00001_1 1 100 -21474.8364800 21474.8364700 FORMAT "%13.7" ECU_ADDRESS 0x60002A08 /end MEASUREMENT
/begin MEASUREMENT ExhMod_HeatBalIf.HeatStorg3 "interface class of the function for all inputs / Class attribute" SLONG RBPtCel_fac_0p00001_1 1 100 -21474.8364800 21474.8364700 FORMAT "%13.7" ECU_ADDRESS 0x60002A0C /end MEASUREMENT
/begin MEASUREMENT ExhMod_HeatBalIf.HeatTrf0To1 "interface class of the function for all inputs / Class attribute" SLONG RBPtCel_fac_0p00001_1 1 100 -21474.8364800 21474.8364700 FORMAT "%13.7" ECU_ADDRESS 0x60002A10 /end MEASUREMENT
/begin MEASUREMENT ExhMod_HeatBalIf.HeatTrf1To2 "interface class of the function for all inputs / Class attribute" SLONG RBPtCel_fac_0p00001_1 1 100 -21474.8364800 21474.8364700 FORMAT "%13.7" ECU_ADDRESS 0x60002A14 /end MEASUREMENT
/begin MEASUREMENT ExhMod_HeatBalIf.HeatTrf2To3 "interface class of the function for all inputs / Class attribute" SLONG RBPtCel_fac_0p00001_1 1 100 -21474.8364800 21474.8364700 FORMAT "%13.7" ECU_ADDRESS 0x60002A18 /end MEASUREMENT
/begin MEASUREMENT ExhMod_HeatBalIf.HeatTrf3To4 "interface class of the function for all inputs / Class attribute" SLONG RBPtCel_fac_0p00001_1 1 100 -21474.8364800 21474.8364700 FORMAT "%13.7" ECU_ADDRESS 0x60002A1C /end MEASUREMENT
/begin MEASUREMENT ExhMod_HeatBalIf.egyExt1 "interface class of the function for all inputs / Class attribute" FLOAT32_IEEE RBPtCel_egy_1p0_2 1 100 -1.0000000E+037 1.0000000E+037 FORMAT "%15.7" ECU_ADDRESS 0x60002A20 /end MEASUREMENT
/begin MEASUREMENT ExhMod_HeatBalIf.egyExt2 "interface class of the function for all inputs / Class attribute" FLOAT32_IEEE RBPtCel_egy_1p0_2 1 100 -1.0000000E+037 1.0000000E+037 FORMAT "%15.7" ECU_ADDRESS 0x60002A24 /end MEASUREMENT
/begin MEASUREMENT ExhMod_HeatBalIf.egyExt3 "interface class of the function for all inputs / Class attribute" FLOAT32_IEEE RBPtCel_egy_1p0_2 1 100 -1.0000000E+037 1.0000000E+037 FORMAT "%15.7" ECU_ADDRESS 0x60002A28 /end MEASUREMENT
/begin MEASUREMENT ExhMod_HeatBalIf.flg3HeatBal "interface class of the function for all inputs / Class attribute" UBYTE B_TRUE 1 100 0.00 1.00000000000 BIT_MASK 0x1 FORMAT "%13.11" ECU_ADDRESS 0x60002A2C /end MEASUREMENT
/begin MEASUREMENT ExhMod_HeatBalIf.tHiResl0 "interface class of the function for all inputs / Class attribute" FLOAT32_IEEE TempK_float 1 100 -1.0000E+037 1.0000E+037 FORMAT "%10.4" ECU_ADDRESS 0x60002A30 /end MEASUREMENT
/begin MEASUREMENT ExhMod_HeatBalIf.tHiResl1 "interface class of the function for all inputs / Class attribute" FLOAT32_IEEE TempK_float 1 100 -1.0000E+037 1.0000E+037 FORMAT "%10.4" ECU_ADDRESS 0x60002A34 /end MEASUREMENT
/begin MEASUREMENT ExhMod_HeatBalIf.tHiResl2 "interface class of the function for all inputs / Class attribute" FLOAT32_IEEE TempK_float 1 100 -1.0000E+037 1.0000E+037 FORMAT "%10.4" ECU_ADDRESS 0x60002A38 /end MEASUREMENT
/begin MEASUREMENT ExhMod_HeatBalIf.tHiResl3 "interface class of the function for all inputs / Class attribute" FLOAT32_IEEE TempK_float 1 100 -1.0000E+037 1.0000E+037 FORMAT "%10.4" ECU_ADDRESS 0x60002A3C /end MEASUREMENT
/begin MEASUREMENT ExhMod_HeatBalIf.tHiResl4 "interface class of the function for all inputs / Class attribute" FLOAT32_IEEE TempK_float 1 100 -1.0000E+037 1.0000E+037 FORMAT "%10.4" ECU_ADDRESS 0x60002A40 /end MEASUREMENT
/begin MEASUREMENT ExhMod_HeatBal_I.tHiReslOutp1 "class instance of heat balance equation / high resolution temperature output1" FLOAT32_IEEE TempK_float 1 100 -1.0000E+037 1.0000E+037 FORMAT "%10.4" ECU_ADDRESS 0x600029F8 /end MEASUREMENT
/begin MEASUREMENT ExhMod_HeatBal_I.tHiReslOutp2 "class instance of heat balance equation / high resolution temperature output2" FLOAT32_IEEE TempK_float 1 100 -1.0000E+037 1.0000E+037 FORMAT "%10.4" ECU_ADDRESS 0x600029FC /end MEASUREMENT
/begin MEASUREMENT ExhMod_HeatBal_I.tHiReslOutp3 "class instance of heat balance equation / high resolution temperature output3" FLOAT32_IEEE TempK_float 1 100 -1.0000E+037 1.0000E+037 FORMAT "%10.4" ECU_ADDRESS 0x60002A00 /end MEASUREMENT
/begin MEASUREMENT ExhMod_idxEgrPosnB1 "Position EGR in structure vector" UBYTE dez 1 100 0.00 255.0 FORMAT "%5.1" ECU_ADDRESS 0x6000F7DF /end MEASUREMENT
/begin MEASUREMENT ExhMod_idxFirstBrickCat1B1 "index first brick catalyst 1" UBYTE dez 1 100 0.00 255.0 FORMAT "%5.1" ECU_ADDRESS 0x6000F7DE /end MEASUREMENT
/begin MEASUREMENT ExhMod_idxFirstBrickCat2B1 "index first brick catalyst 2" UBYTE dez 1 100 0.00 255.0 FORMAT "%5.1" ECU_ADDRESS 0x6000F7DD /end MEASUREMENT
/begin MEASUREMENT ExhMod_idxFrtBrickCatAryB1 "index first brick catalysts" UBYTE dez 1 100 0.00 255.0 FORMAT "%5.1" ARRAY_SIZE 2 ECU_ADDRESS 0x6000F7DB /end MEASUREMENT
/begin MEASUREMENT ExhMod_idxLstBrickCatAryB1 "index last brick catalysts" UBYTE dez 1 100 0.00 255.0 FORMAT "%5.1" ARRAY_SIZE 2 ECU_ADDRESS 0x6000F7D9 /end MEASUREMENT
/begin MEASUREMENT ExhMod_mAirMfIntegEngFirstStrt "integrated air mass flow from engine first start to max. value" UWORD m_uw_b23p3 1 100 0.00 23.30133 FORMAT "%8.5" ECU_ADDRESS 0x60008EDA /end MEASUREMENT
/begin MEASUREMENT ExhMod_mAirMfIntegEngStrt "integrated air mass flow from engine start to max. value" UWORD m_uw_b23p3 1 100 0.00 23.30133 FORMAT "%8.5" ECU_ADDRESS 0x60008ED8 /end MEASUREMENT
/begin MEASUREMENT ExhMod_mAirMfIntegEngStrtCalReini "integrated air mass flow from engine start to maximum value with a calibratable reinitialization" UWORD m_uw_b23p3 1 100 0.00 23.30133 FORMAT "%8.5" ECU_ADDRESS 0x60008ED6 /end MEASUREMENT
/begin MEASUREMENT ExhMod_mAirMfIntegEngStrtCalReiniNv "Non volatile value of integrated air mass flow from engine start to maximum value" UWORD m_uw_b23p3 1 100 0.00 23.30133 FORMAT "%8.5" ECU_ADDRESS 0x60039384 /end MEASUREMENT
/begin MEASUREMENT ExhMod_mfAirB1 "air mass flow" FLOAT32_IEEE AirMassPerTime_float 1 100 0.00 50000.0000 FORMAT "%10.4" ECU_ADDRESS 0x60013B18 /end MEASUREMENT
/begin MEASUREMENT ExhMod_mfCoCnvtbCurMaxB1 "current maximum convertible CO mass flow of the exhaust system bank 1" FLOAT32_IEEE AirMassPerTime_float 1 100 0.000000 65535.000000 FORMAT "%12.6" ECU_ADDRESS 0x600038B8 /end MEASUREMENT
/begin MEASUREMENT ExhMod_mfCoCnvtbCurMaxBrickAryB1 "current maximum convertible CO mass flow of the bricks - array bank 1" FLOAT32_IEEE AirMassPerTime_float 1 100 0.000000 65535.000000 FORMAT "%12.6" ARRAY_SIZE 6 ECU_ADDRESS 0x60002A90 /end MEASUREMENT
/begin MEASUREMENT ExhMod_mfCoCnvtbCurMaxCatAryB1 "current maximum convertible CO mass flow of the catalyst - array bank 1" FLOAT32_IEEE AirMassPerTime_float 1 100 0.000000 65535.000000 FORMAT "%12.6" ARRAY_SIZE 2 ECU_ADDRESS 0x60002A88 /end MEASUREMENT
/begin MEASUREMENT ExhMod_mfEgrB1 "Exhaust mass flow EGR bank 1" FLOAT32_IEEE AirMassPerTime_float 1 100 0.00 50000.0000 FORMAT "%10.4" ECU_ADDRESS 0x60013B1C /end MEASUREMENT
/begin MEASUREMENT ExhMod_mfExhAryB1 "mass flow array exhaust gas" FLOAT32_IEEE AirMassPerTime_float 1 100 0.00 50000.0000 FORMAT "%10.4" ARRAY_SIZE 12 ECU_ADDRESS 0x50004F44 /end MEASUREMENT
/begin MEASUREMENT ExhMod_mfExhB1 "mass flow exhaust gas" FLOAT32_IEEE AirMassPerTime_float 1 100 0.00 50000.0000 FORMAT "%10.4" ECU_ADDRESS 0x60003A84 /end MEASUREMENT
/begin MEASUREMENT ExhMod_mfExhCat1B1 "mass flow exhaust gas catalyst 1" FLOAT32_IEEE AirMassPerTime_float 1 100 0.00 50000.0000 FORMAT "%10.4" ECU_ADDRESS 0x60003A80 /end MEASUREMENT
/begin MEASUREMENT ExhMod_mfExhCat2B1 "mass flow exhaust gas catalyst 2" FLOAT32_IEEE AirMassPerTime_float 1 100 0.00 50000.0000 FORMAT "%10.4" ECU_ADDRESS 0x60003A7C /end MEASUREMENT
/begin MEASUREMENT ExhMod_mfExhCatAryB1 "mass flow exhaust gas catalysts" FLOAT32_IEEE AirMassPerTime_float 1 100 -1.00E+037 1.00E+037 FORMAT "%5.2" ARRAY_SIZE 2 ECU_ADDRESS 0x60003A74 /end MEASUREMENT
/begin MEASUREMENT ExhMod_mfExhMnfB1 "mass flow exhaust gas, manifold" FLOAT32_IEEE AirMassPerTime_float 1 100 0.00 50000.0000 FORMAT "%10.4" ECU_ADDRESS 0x60003A70 /end MEASUREMENT
/begin MEASUREMENT ExhMod_mfExhS1B1 "mass flow exhaust gas sensor 1" FLOAT32_IEEE AirMassPerTime_float 1 100 0.00 50000.0000 FORMAT "%10.4" ECU_ADDRESS 0x50004FBC /end MEASUREMENT
/begin MEASUREMENT ExhMod_mfExhS2B1 "mass flow exhaust gas sensor 2" FLOAT32_IEEE AirMassPerTime_float 1 100 0.00 50000.0000 FORMAT "%10.4" ECU_ADDRESS 0x50004FC0 /end MEASUREMENT
/begin MEASUREMENT ExhMod_mfExhSnsrAryB1 "mass flow exhaust gas array sensors" FLOAT32_IEEE AirMassPerTime_float 1 100 -1.00E+037 1.00E+037 FORMAT "%5.2" ARRAY_SIZE 2 ECU_ADDRESS 0x60003A68 /end MEASUREMENT
/begin MEASUREMENT ExhMod_mfExhVlvB1 "exhaust gas mass flow at outlet valves" FLOAT32_IEEE AirMassPerTime_float 1 100 0.00 50000.0000 FORMAT "%10.4" ECU_ADDRESS 0x60003A64 /end MEASUREMENT
/begin MEASUREMENT ExhMod_mfExhWoFuUsCat1B1 "Mass flow exhaust gas minus fuel part upstream of catalyst 1" FLOAT32_IEEE AirMassPerTime_float 1 100 0.00 50000.0000 FORMAT "%10.4" ECU_ADDRESS 0x60003A60 /end MEASUREMENT
/begin MEASUREMENT ExhMod_mfExhWoFuUsCat2B1 "Mass flow exhaust gas minus fuel part upstream of catalyst 2" FLOAT32_IEEE AirMassPerTime_float 1 100 0.00 50000.0000 FORMAT "%10.4" ECU_ADDRESS 0x60003A5C /end MEASUREMENT
/begin MEASUREMENT ExhMod_mfFuB1 "fuel mass flow" FLOAT32_IEEE AirMassPerTime_float 1 100 0.00 50000.0000 FORMAT "%10.4" ECU_ADDRESS 0x50004FCC /end MEASUREMENT
/begin MEASUREMENT ExhMod_mfHcCnvtbCurMaxB1 "current maximum convertible HC mass flow of the exhaust system bank 1" FLOAT32_IEEE AirMassPerTime_float 1 100 0.000000 65535.000000 FORMAT "%12.6" ECU_ADDRESS 0x600038B4 /end MEASUREMENT
/begin MEASUREMENT ExhMod_mfHcCnvtbCurMaxBrickAryB1 "current maximum convertible HC mass flow of the bricks - array bank 1" FLOAT32_IEEE AirMassPerTime_float 1 100 0.000000 65535.000000 FORMAT "%12.6" ARRAY_SIZE 6 ECU_ADDRESS 0x60002A70 /end MEASUREMENT
/begin MEASUREMENT ExhMod_mfHcCnvtbCurMaxCatAryB1 "current maximum convertible HC mass flow of the catalyst - array bank 1" FLOAT32_IEEE AirMassPerTime_float 1 100 0.000000 65535.000000 FORMAT "%12.6" ARRAY_SIZE 2 ECU_ADDRESS 0x60002A68 /end MEASUREMENT
/begin MEASUREMENT ExhMod_mfNoxCnvtbCurMaxB1 "current maximum convertible NOx mass flow of the exhaust system bank 1" FLOAT32_IEEE AirMassPerTime_float 1 100 0.000000 65535.000000 FORMAT "%12.6" ECU_ADDRESS 0x600038B0 /end MEASUREMENT
/begin MEASUREMENT ExhMod_mfNoxCnvtbCurMaxBrickAryB1 "current maximum convertible NOx mass flow of the bricks - array bank 1" FLOAT32_IEEE AirMassPerTime_float 1 100 0.000000 65535.000000 FORMAT "%12.6" ARRAY_SIZE 6 ECU_ADDRESS 0x60002A50 /end MEASUREMENT
/begin MEASUREMENT ExhMod_mfNoxCnvtbCurMaxCatAryB1 "current maximum convertible NOx mass flow of the catalyst - array bank 1" FLOAT32_IEEE AirMassPerTime_float 1 100 0.000000 65535.000000 FORMAT "%12.6" ARRAY_SIZE 2 ECU_ADDRESS 0x60002A48 /end MEASUREMENT
/begin MEASUREMENT ExhMod_mfO2Cat1B1 "oxygen mass flow in catalyst 1, bank 1" FLOAT32_IEEE mgrad_q1_mgdivs 1 100 0.00 100000.000 FORMAT "%10.3" ECU_ADDRESS 0x60003A58 /end MEASUREMENT
/begin MEASUREMENT ExhMod_mfO2Cat2B1 "oxygen mass flow in catalyst 2, bank 1" FLOAT32_IEEE mgrad_q1_mgdivs 1 100 0.00 100000.000 FORMAT "%10.3" ECU_ADDRESS 0x70005258 /end MEASUREMENT
/begin MEASUREMENT ExhMod_mO2Cat1B1 "oxygen storage level in catalyst 1" UWORD m_q0p1_mg 1 100 0.00 6553.500 FORMAT "%8.3" ECU_ADDRESS 0x70005392 /end MEASUREMENT
/begin MEASUREMENT ExhMod_mO2Cat2B1 "oxygen storage level in catalyst 2" UWORD m_q0p1_mg 1 100 0.00 6553.500 FORMAT "%8.3" ECU_ADDRESS 0x6000948C /end MEASUREMENT
/begin MEASUREMENT ExhMod_mO2ExtdCat1B1 "oxygen storage level in catalyst 1" ULONG m_q0p1_mg 1 100 0.00 429496729.500 FORMAT "%13.3" ECU_ADDRESS 0x70005250 /end MEASUREMENT
/begin MEASUREMENT ExhMod_mO2ExtdCat2B1 "oxygen storage level in catalyst 2" ULONG m_q0p1_mg 1 100 0.00 429496729.500 FORMAT "%13.3" ECU_ADDRESS 0x70005254 /end MEASUREMENT
/begin MEASUREMENT ExhMod_nrBrickCat1B1 "number of bricks catalyst 1" UBYTE dez 1 100 0.00 255.0 FORMAT "%5.1" ECU_ADDRESS 0x6000F7D8 /end MEASUREMENT
/begin MEASUREMENT ExhMod_nrBrickCat2B1 "number of bricks catalyst 2" UBYTE dez 1 100 0.00 255.0 FORMAT "%5.1" ECU_ADDRESS 0x6000F7D7 /end MEASUREMENT
/begin MEASUREMENT ExhMod_nrBrickCatAryB1 "number of bricks catalysts" UBYTE dez 1 100 0.00 255.0 FORMAT "%5.1" ARRAY_SIZE 2 ECU_ADDRESS 0x6000F7D5 /end MEASUREMENT
/begin MEASUREMENT ExhMod_nrCatB1 "Number of catalysts in Bank 1" UBYTE dez 1 100 0.00 255.0 FORMAT "%5.1" ECU_ADDRESS 0x6000F7D4 /end MEASUREMENT
/begin MEASUREMENT ExhMod_posnPfil "position GPF" UBYTE dez 1 100 0.00 255.0 FORMAT "%5.1" ECU_ADDRESS 0x6000F7D3 /end MEASUREMENT
/begin MEASUREMENT ExhMod_ratConcO2Cat1B1 "oxygen concentration of gas going into catalyst 1" SWORD fak_sw_b8 1 100 -8.000000 7.999756 FORMAT "%8.6" ECU_ADDRESS 0x600148A8 /end MEASUREMENT
/begin MEASUREMENT ExhMod_ratConcO2Cat2B1 "oxygen concentration of gas going into catalyst 2" SWORD fak_sw_b8 1 100 -8.000000 7.999756 FORMAT "%8.6" ECU_ADDRESS 0x70005396 /end MEASUREMENT
/begin MEASUREMENT ExhMod_ratMFlowVlvB1 "exhaust gas mass flow ratio at outlet valves" UWORD fak_uw_b2 1 100 0.00 1.000000 FORMAT "%8.6" ECU_ADDRESS 0x6000947C /end MEASUREMENT
/begin MEASUREMENT ExhMod_ratStoi "Air-to-fuel stoichiometric ratio" UWORD fak_q4p6875Em4 1 100 0.00 30.71953 FORMAT "%8.5" ECU_ADDRESS 0x60009470 /end MEASUREMENT
/begin MEASUREMENT ExhMod_rLamCat1DsB1 "exhaust lambda catalyst 1 downstream" UWORD fak_uw_b16 1 100 0.00 15.99976 FORMAT "%8.5" ECU_ADDRESS 0x60009488 /end MEASUREMENT
/begin MEASUREMENT ExhMod_rLamCat1UsB1 "exhaust lambda catalyst 1 upstream" UWORD fak_uw_b16 1 100 0.00 15.99976 FORMAT "%8.5" ECU_ADDRESS 0x60009486 /end MEASUREMENT
/begin MEASUREMENT ExhMod_rLamCat2DsB1 "exhaust lambda catalyst 2 downstream" UWORD fak_uw_b16 1 100 0.00 15.99976 FORMAT "%8.5" ECU_ADDRESS 0x600148A6 /end MEASUREMENT
/begin MEASUREMENT ExhMod_rLamCat2DsSB1 "exhaust lambda at sensor downstream catalyst 2" UWORD fak_uw_b16 1 100 0.00 15.99976 FORMAT "%8.5" ECU_ADDRESS 0x70005394 /end MEASUREMENT
/begin MEASUREMENT ExhMod_rLamCat2UsB1 "exhaust lambda catalyst 2 upstream" UWORD fak_uw_b16 1 100 0.00 15.99976 FORMAT "%8.5" ECU_ADDRESS 0x60009484 /end MEASUREMENT
/begin MEASUREMENT ExhMod_rLamCatUsAryB1 "Exhaust lambda upstream catalysts" UWORD fak_uw_b16 1 100 0.00 15.99976 FORMAT "%8.5" ARRAY_SIZE 2 ECU_ADDRESS 0x60009480 /end MEASUREMENT
/begin MEASUREMENT ExhMod_rLamLS1B1 "Lambda value first sensor bank 1" UWORD fak_uw_b16 1 100 0.00 15.99976 FORMAT "%8.5" ECU_ADDRESS 0x6000947E /end MEASUREMENT
/begin MEASUREMENT ExhMod_stCfgPlausB1 "state configuration pausible bank 1" ULONG dez 1 100 0.00 4294967295.00 FORMAT "%13.2" ECU_ADDRESS 0x60002A44 /end MEASUREMENT
/begin MEASUREMENT ExhMod_tEngStrtDewDet "engine temperature at start for dew point end calculation" SWORD Temp_Cels 1 100 -3549.940 3003.560 FORMAT "%8.3" ECU_ADDRESS 0x6000912A /end MEASUREMENT
/begin MEASUREMENT ExhMod_tEnvDewDet "Ambient temperature for dew point end with influences like block heater" SWORD Temp_Cels 1 100 -3549.940 3003.560 FORMAT "%8.3" ECU_ADDRESS 0x60009128 /end MEASUREMENT
/begin MEASUREMENT ExhMod_tExhStrtS1B1 "temperature at sensor 1 at engine start" SWORD Temp_Cels 1 100 -3549.940 3003.560 FORMAT "%8.3" ECU_ADDRESS 0x60009106 /end MEASUREMENT
/begin MEASUREMENT ExhMod_tExhStrtS2B1 "temperature at sensor 2 at engine start" SWORD Temp_Cels 1 100 -3549.940 3003.560 FORMAT "%8.3" ECU_ADDRESS 0x60009104 /end MEASUREMENT
/begin MEASUREMENT ExhMod_tiBtwLS1Cat1B1 "Exhaust gas transport time from lambda sensor 1 to catalyst 1" UWORD t_q0p01 1 100 0.00 655.3500 FORMAT "%8.4" ECU_ADDRESS 0x6000946E /end MEASUREMENT
/begin MEASUREMENT ExhMod_tiBtwLS1Cat2B1 "Exhaust gas transport time from lambda sensor 1 to catalyst 2" UWORD t_q0p01 1 100 0.00 655.3500 FORMAT "%8.4" ECU_ADDRESS 0x70005398 /end MEASUREMENT
/begin MEASUREMENT ExhMod_uCat1DsB1 "Sensor voltage downstream catalyst1 bank1" UWORD spg_q0p00488 1 100 0.00 319.9951 FORMAT "%8.4" ECU_ADDRESS 0x6000946C /end MEASUREMENT
/begin MEASUREMENT ExhMod_vfExhAryB1 "Exhaust gas volume flow array B1" FLOAT32_IEEE RBPtCel_vf_1p0_1 1 100 0.00 1.00000000E+037 FORMAT "%13.3" ARRAY_SIZE 12 ECU_ADDRESS 0x60003820 /end MEASUREMENT
/begin MEASUREMENT ExhMod_vfExhBrickAryB1 "Exhaust gas volume flow in the brick - array bank 1" FLOAT32_IEEE RBPtCel_vf_1p0_1 1 100 -214748364.800000 214748364.700000 FORMAT "%14.6" ARRAY_SIZE 6 ECU_ADDRESS 0x60003808 /end MEASUREMENT
/begin MEASUREMENT Lam_flgRstO2IntgCat1B1 "flag reset oxygen integrator catalyst 1" UBYTE B_TRUE 1 100 0.00 1.00000000000 BIT_MASK 0x1 FORMAT "%13.11" ECU_ADDRESS 0x7000026A /end MEASUREMENT
/begin MEASUREMENT Lam_flgRstO2IntgCat2B1 "flag reset oxygen integrator catalyst 2" UBYTE B_TRUE 1 100 0.00 1.00000000000 BIT_MASK 0x1 FORMAT "%13.11" ECU_ADDRESS 0x70000269 /end MEASUREMENT
/begin MEASUREMENT Lam_mO2RstValCat1B1 "Reset value of the oxygen integral of catalyst 1" ULONG m_q0p1_mg 1 100 0.00 429496729.500 FORMAT "%13.3" ECU_ADDRESS 0x70005178 /end MEASUREMENT
/begin MEASUREMENT Lam_mO2RstValCat2B1 "Reset value of the oxygen integral of catalyst 2" ULONG m_q0p1_mg 1 100 0.00 429496729.500 FORMAT "%13.3" ECU_ADDRESS 0x7000517C /end MEASUREMENT
/begin MEASUREMENT Lam_O2IntglExtdCat1B1_I.mfO2 "RB internal / Oxygen massflow" FLOAT32_IEEE mgrad_q1_mgdivs 1 100 -1.00000000E+037 1.00000000E+037 FORMAT "%13.3" ECU_ADDRESS 0x60012FF4 /end MEASUREMENT
/begin MEASUREMENT Lam_O2IntglExtdCat1B1_I.ratConcO2 "RB internal / Oxygen concentratoin" SWORD fak_q0p000244 1 100 -8.000000 7.999756 FORMAT "%8.6" ECU_ADDRESS 0x60012FF8 /end MEASUREMENT
/begin MEASUREMENT Lam_O2IntglExtdCat1B1_I.O2IKL_I.memory "RB internal / Integraotr Sauerstoffmassflow / Current Integrator value" FLOAT32_IEEE dez 1 100 -1.00000000E+037 1.00000000E+037 FORMAT "%13.3" ECU_ADDRESS 0x60012FFC /end MEASUREMENT
/begin MEASUREMENT Lam_O2IntglExtdCat2B1_I.mfO2 "RB internal / Oxygen massflow" FLOAT32_IEEE mgrad_q1_mgdivs 1 100 -1.00000000E+037 1.00000000E+037 FORMAT "%13.3" ECU_ADDRESS 0x60013000 /end MEASUREMENT
/begin MEASUREMENT Lam_O2IntglExtdCat2B1_I.ratConcO2 "RB internal / Oxygen concentratoin" SWORD fak_q0p000244 1 100 -8.000000 7.999756 FORMAT "%8.6" ECU_ADDRESS 0x60013004 /end MEASUREMENT
/begin MEASUREMENT Lam_O2IntglExtdCat2B1_I.O2IKL_I.memory "RB internal / Integraotr Sauerstoffmassflow / Current Integrator value" FLOAT32_IEEE dez 1 100 -1.00000000E+037 1.00000000E+037 FORMAT "%13.3" ECU_ADDRESS 0x60013008 /end MEASUREMENT
/begin MEASUREMENT Lam_PlausChkLSCat1B1_I.CatEmptyFF_I.status "RB internal / FlipFlop for catalyst empty / current value of RS-FF" UBYTE B_TRUE 1 100 0.00 1.00000000000 BIT_MASK 0x1 FORMAT "%13.11" ECU_ADDRESS 0x6001300C /end MEASUREMENT
/begin MEASUREMENT Lam_PlausChkLSCat1B1_I.CatFullFF_I.status "RB internal / FlipFlop for catalyst full / current value of RS-FF" UBYTE B_TRUE 1 100 0.00 1.00000000000 BIT_MASK 0x1 FORMAT "%13.11" ECU_ADDRESS 0x6001300D /end MEASUREMENT
/begin MEASUREMENT Lam_PlausChkLSCat1B1_I.NotLeanTONV_I.outbit "RB internal / TurnOnDelayVariable / return value" UBYTE B_TRUE 1 100 0.00 1.00000000000 BIT_MASK 0x1 FORMAT "%13.11" ECU_ADDRESS 0x6001300E /end MEASUREMENT
/begin MEASUREMENT Lam_PlausChkLSCat1B1_I.NotLeanTONV_I.time "RB internal / TurnOnDelayVariable / expired delay time" UWORD t_q0p01 1 100 0.00 655.3500 FORMAT "%8.4" ECU_ADDRESS 0x60013010 /end MEASUREMENT
/begin MEASUREMENT Lam_PlausChkLSCat1B1_I.NotRichTONV_I.outbit "RB internal / TurnOnDelayVariable / return value" UBYTE B_TRUE 1 100 0.00 1.00000000000 BIT_MASK 0x1 FORMAT "%13.11" ECU_ADDRESS 0x60013012 /end MEASUREMENT
/begin MEASUREMENT Lam_PlausChkLSCat1B1_I.NotRichTONV_I.time "RB internal / TurnOnDelayVariable / expired delay time" UWORD t_q0p01 1 100 0.00 655.3500 FORMAT "%8.4" ECU_ADDRESS 0x60013014 /end MEASUREMENT
/begin MEASUREMENT Lam_PlausChkLSCat1B1_I.oxplIK_I.memory "RB internal / IntegratorK / current integrator value" FLOAT32_IEEE m_q1_mg 1 100 -1.0000E+037 1.0000E+037 FORMAT "%10.4" ECU_ADDRESS 0x60013018 /end MEASUREMENT
/begin MEASUREMENT Lam_tiBtwCat1Cat2B1 "Exhaust gas transport time from catalyst 1 to catalyst 2" UWORD t_q0p01 1 100 0.00 655.3500 FORMAT "%8.4" ECU_ADDRESS 0x60013D78 /end MEASUREMENT
/begin MEASUREMENT Lam_tiBtwCat2SDsCat2B1 "Exhaust gas transport time from catalyst 2 to sensor downstream catalyst 2" UWORD t_q0p01 1 100 0.00 655.3500 FORMAT "%8.4" ECU_ADDRESS 0x60013D7A /end MEASUREMENT
/begin FUNCTION ExhMgT_RelsFcoTEgSys "1.10.0    Release of fuel cut-off because of temperature of the exhaust gas system"
 /begin DEF_CHARACTERISTIC ExhMgT_ratLamDeltaLeanCat1_C ExhMgT_ratLamDeltaLeanCat2_C ExhMgT_ratLamLeanCat1_C ExhMgT_ratLamLeanCat2_C ExhMgT_stCptProtnFil_C ExhMgT_stTExhFild_C ExhMgT_tCat1MaxFcoMax_C ExhMgT_tCat1MaxFcoMin_C ExhMgT_tCat2MaxFcoMax_C ExhMgT_tCat2MaxFcoMin_C ExhMgT_tExhCat1CoolgMin_C ExhMgT_tExhCat1FcoAvrgMin_C ExhMgT_tExhCat1FcoAvrg_C ExhMgT_tExhCat1FcoDsMax_C ExhMgT_tExhCat1FcoDsMin_C ExhMgT_tExhCat1FcoEndMin_C ExhMgT_tExhCat1FcoEnd_C ExhMgT_tExhCat1FcoMinMax_C ExhMgT_tExhCat1FcoMin_C ExhMgT_tExhCat1FcoUsMax_C ExhMgT_tExhCat1FcoUsMin_C ExhMgT_tExhCat1Fco_C ExhMgT_tExhCat2CoolgMin_C ExhMgT_tExhCat2FcoAvrgMin_C ExhMgT_tExhCat2FcoAvrg_C ExhMgT_tExhCat2FcoDsMax_C ExhMgT_tExhCat2FcoDsMin_C ExhMgT_tExhCat2FcoEndMin_C ExhMgT_tExhCat2FcoEnd_C ExhMgT_tExhCat2FcoMinMax_C ExhMgT_tExhCat2FcoMin_C ExhMgT_tExhCat2FcoUsMax_C ExhMgT_tExhCat2FcoUsMin_C ExhMgT_tExhCat2Fco_C ExhMgT_tiCutOffFirst_C ExhMgT_tMinCat1CdaDelta_C ExhMgT_tMinCat1CdaHi_C ExhMgT_tMinCat1FcoCoolgDelta_C ExhMgT_tMinCat1FcoCoolgHi_C ExhMgT_tMinCat1FcoDelta_C ExhMgT_tMinCat1FcoHi_C ExhMgT_tMinCat2CdaDelta_C ExhMgT_tMinCat2CdaHi_C ExhMgT_tMinCat2FcoCoolgDelta_C ExhMgT_tMinCat2FcoCoolgHi_C ExhMgT_tMinCat2FcoDelta_C ExhMgT_tMinCat2FcoHi_C ExhMgT_tMinCatFco_T ExhMgT_vLimOverrunFco_C LBTSSAMX TDLBTSSA /end DEF_CHARACTERISTIC
 /begin IN_MEASUREMENT B_evloc_msg B_lambts_msg B_ll_msg B_sa_msg CoEng_flgCpvClsForFco CoEng_stMai EngStrt_bStrtEnd ExhMgT_tCat1AvrgFildB1 ExhMgT_tCat1EndFildB1 ExhMgT_tCat1FildB1 ExhMgT_tCat1MaxFildB1 ExhMgT_tCat1MinFildB1 ExhMgT_tCat2AvrgFildB1 ExhMgT_tCat2EndFildB1 ExhMgT_tCat2FildB1 ExhMgT_tCat2MaxFildB1 ExhMgT_tCat2MinFildB1 ExhMod_rLamCat1DsB1 ExhMod_rLamCat1UsB1 ExhMod_rLamCat2DsB1 ExhMod_rLamCat2DsSB1 ExhMod_rLamCat2UsB1 ExhMod_tCat1AvrgB1 ExhMod_tCat1B1 ExhMod_tCat1EndB1 ExhMod_tCat1MaxB1 ExhMod_tCat1MinB1 ExhMod_tCat2AvrgB1 ExhMod_tCat2B1 ExhMod_tCat2EndB1 ExhMod_tCat2MaxB1 ExhMod_tCat2MinB1 ExhMod_tExhCat1DsB1 ExhMod_tExhCat1UsB1 ExhMod_tExhCat2DsB1 ExhMod_tExhCat2UsB1 lambts_w_msg SyC_ctPostDrvLeave SyC_stSub VehV_v /end IN_MEASUREMENT
 /begin OUT_MEASUREMENT B_sabbts_msg B_tatmsa_msg ECT_bFCOEnaCmpnPrt ExhMgT_flgLamFuFco ExhMgT_flgRelsCutOffTExhHi ExhMgT_flgRelsCutOffTExhLo ExhMgT_ratLamFuFco /end OUT_MEASUREMENT
 /begin LOC_MEASUREMENT B_fgsabts dlambssa_w ExhMgT_cntrReIniRelsFcoTEgSys ExhMgT_flgAllwdFuFco ExhMgT_flgCutOffFirstTi ExhMgT_flgTFcoCat1 ExhMgT_flgTFcoCat2 ExhMgT_tCat1AvrgLocB1 ExhMgT_tCat1EndLocB1 ExhMgT_tCat1LocB1 ExhMgT_tCat1MaxLocB1 ExhMgT_tCat1MinLocB1 ExhMgT_tCat2AvrgLocB1 ExhMgT_tCat2EndLocB1 ExhMgT_tCat2LocB1 ExhMgT_tCat2MaxLocB1 ExhMgT_tCat2MinLocB1 ExhMgT_tMinCat1FcoB1 ExhMgT_tMinCat1FcoCoolgB1 ExhMgT_tMinCat2FcoB1 ExhMgT_tMinCat2FcoCoolgB1 ExhMgT_tMinCatFco ExhMgT_tMinCatFcoCoolg /end LOC_MEASUREMENT
 FUNCTION_VERSION "1.10.0" /end FUNCTION
/begin FUNCTION ExhMgT_TExhCtrlrCptProtn "3.3.0_1.1.0exhaust temperature controller for component protection"
 /begin DEF_CHARACTERISTIC ExhMgT_facDftlCptProtnGovr_M ExhMgT_facDftlTGovrCptProtnCorrnB1_C ExhMgT_facIvsExhMassMax_C ExhMgT_facKiCptProtnGovr1B1_M ExhMgT_facKiCptProtnGovr_C ExhMgT_facKpCptProtnGovr_T ExhMgT_nrTExhArySeldB1_C ExhMgT_ratChrgExhCptProtn_M ExhMgT_ratDeltaCptProtnGovrCorrn1_C ExhMgT_ratDeltaCptProtnGovrMin_M ExhMgT_ratDeltaLamCptProtnGovrMax_C ExhMgT_ratDeltaLamDftlCptProtnGovr_M ExhMgT_stTGovr2_C ExhMgT_stTGovr3_C ExhMgT_stTGovr_C ExhMgT_tCatCritCorrn_M ExhMgT_tCatCrit_M ExhMgT_tDifDftlCptProtnGovrLim_C ExhMgT_tDifLimDftlCptProtnGovr1_C ExhMgT_tiRelsCptProtnGovr_C ExhMgT_tiTCatCritFild_T ExhMgT_tiTnCptProtnGovr_C /end DEF_CHARACTERISTIC
 /begin IN_MEASUREMENT AirMod_ratChrgAirCyl B_ate_msg B_bevab_msg CoEOM_bHOM EngStrt_bStrtEnd Epm_nEng ExhMgT_flgActvCptProtnTExh ExhMgT_tMinExhB1 ExhMgT_tMinTExhCptProtnB1 ExhMgT_tMinTWallCptProtnB1 ExhMod_mfExhB1 ExhMod_tExhAryB1 IntkAirT_tThrVlvUs lambs_w_msg SyC_ctDrvEnter SyC_ctPostDrvLeave SyC_stSub tumg_msg VehV_v /end IN_MEASUREMENT
 /begin OUT_MEASUREMENT B_atr_msg dlamatr_w_msg ExhMgT_flgCtrlActvCptProtnB1 ExhMgT_ratDeltaLamCtrlCptProtnB1 ExhMgT_tMinTExhGovrCptProtn ExhMgT_tMinTExhGovrCptProtnB1 /end OUT_MEASUREMENT
 /begin LOC_MEASUREMENT B_atrb B_bbatr ExhMgT_cntrIniDrvTExhCtrlrCptProtn ExhMgT_cntrReIniTExhCtrlrCptProtn ExhMgT_facDftlCptProtnGovrB1 ExhMgT_mfExhCptProtnGovr ExhMgT_PidGovr_temp1_B1.ExhMgT_facDftlCptProtnGovrNoCorrn ExhMgT_PidGovr_temp1_B1.ExhMgT_ratDeltaLamCptProtnGovrMax ExhMgT_PidGovr_temp1_B1.ExhMgT_ratDeltaLamDftlCptProtnGovr ExhMgT_PidGovr_temp1_B1.ExhMgT_ratDeltaLamKiCptProtnGovr ExhMgT_PidGovr_temp1_B1.ExhMgT_ratDeltaLamKpCptProtnGovr ExhMgT_PidGovr_temp1_B1.ExhMgT_tDftlCptProtnGovr ExhMgT_PidGovr_temp1_B1.ExhMgT_tDifCptProtnGovr ExhMgT_PidGovr_temp1_B1.CmpPrt_dlatriIKL_I.memory ExhMgT_ratDeltaCptProtnGovr1Min ExhMgT_ratDeltaCptProtnGovrMin ExhMgT_ratDeltaLamDftlCptProtnGovr ExhMgT_ratDeltaLamTGovrCptProtnB1 ExhMgT_RelsCptPrortnGovrTONV_I.outbit ExhMgT_RelsCptPrortnGovrTONV_I.time ExhMgT_tCatCritFild ExhMgT_tCatCritLT_I.memory ExhMgT_tCatCritUnfild ExhMgT_tDiffCatCritB1 ExhMgT_tMinGrdtTExhGovrB1 ExhMgT_tMinTExhGovrCptProtnB1old /end LOC_MEASUREMENT
 FUNCTION_VERSION "3.3.0_1.1.0" /end FUNCTION
/begin FUNCTION ExhMgT_TExhFild "1.5.0     Exhaust temperature filtered"
 /begin DEF_CHARACTERISTIC ExhMgT_tiTDsVlvB1_C ExhMgT_tiTFltCat1AvrgB1_C ExhMgT_tiTFltCat1B1_C ExhMgT_tiTFltCat1EndB1_C ExhMgT_tiTFltCat1MaxB1_C ExhMgT_tiTFltCat1MinB1_C ExhMgT_tiTFltCat2AvrgB1_C ExhMgT_tiTFltCat2B1_C ExhMgT_tiTFltCat2EndB1_C ExhMgT_tiTFltCat2MaxB1_C ExhMgT_tiTFltCat2MinB1_C ExhMgT_tiTFltExhMnfB1_T /end DEF_CHARACTERISTIC
 /begin IN_MEASUREMENT EngStrt_bStrtEnd ExhMod_mfExhB1 ExhMod_tCat1AvrgB1 ExhMod_tCat1B1 ExhMod_tCat1EndB1 ExhMod_tCat1MaxB1 ExhMod_tCat1MinB1 ExhMod_tCat2AvrgB1 ExhMod_tCat2B1 ExhMod_tCat2EndB1 ExhMod_tCat2MaxB1 ExhMod_tCat2MinB1 ExhMod_tExhDsVlvB1 ExhMod_tExhMnfB1 /end IN_MEASUREMENT
 /begin OUT_MEASUREMENT ExhMgT_tCat1AvrgFildB1 ExhMgT_tCat1EndFildB1 ExhMgT_tCat1FildB1 ExhMgT_tCat1MaxFildB1 ExhMgT_tCat1MinFildB1 ExhMgT_tCat2AvrgFildB1 ExhMgT_tCat2EndFildB1 ExhMgT_tCat2FildB1 ExhMgT_tCat2MaxFildB1 ExhMgT_tCat2MinFildB1 ExhMgT_tExhDsVlvFildB1 ExhMgT_tExhMnfFildB1 ExhMgT_tExhMnfFildB1Prev ExhMgT_tExhMnfFildGrdtB1 /end OUT_MEASUREMENT
 /begin LOC_MEASUREMENT ExhMgT_tExhMnfB1Prev ExhMgT_tiTFltExhMnf /end LOC_MEASUREMENT
 FUNCTION_VERSION "1.5.0" /end FUNCTION
/begin FUNCTION ExhMod_CatCnvnCpby "1.0.0     Exhaust model catalyst conversion capability"
 /begin DEF_CHARACTERISTIC ExhMod_mfCoCnvtbCurMaxBrickB1_M ExhMod_mfHcCnvtbCurMaxBrickB1_M ExhMod_mfNoxCnvtbCurMaxBrickB1_M /end DEF_CHARACTERISTIC
 /begin IN_MEASUREMENT ExhMod_facCoCnvnCpbyTLiOffBrickAryB1 ExhMod_facHcCnvnCpbyTLiOffBrickAryB1 ExhMod_facNoxCnvnCpbyTLiOffBrickAryB1 ExhMod_idxFrtBrickCatAryB1 ExhMod_mfExhAryB1 ExhMod_nrBrickCatAryB1 ExhMod_pExhAryB1 ExhMod_tCatBrickAryB1 /end IN_MEASUREMENT
 /begin OUT_MEASUREMENT ExhMod_mfCoCnvtbCurMaxB1 ExhMod_mfCoCnvtbCurMaxBrickAryB1 ExhMod_mfCoCnvtbCurMaxCatAryB1 ExhMod_mfHcCnvtbCurMaxB1 ExhMod_mfHcCnvtbCurMaxBrickAryB1 ExhMod_mfHcCnvtbCurMaxCatAryB1 ExhMod_mfNoxCnvtbCurMaxB1 ExhMod_mfNoxCnvtbCurMaxBrickAryB1 ExhMod_mfNoxCnvtbCurMaxCatAryB1 ExhMod_vfExhBrickAryB1 /end OUT_MEASUREMENT
 FUNCTION_VERSION "1.0.0" /end FUNCTION
/begin FUNCTION ExhMod_CatCnvnCpbyTLiOff "1.0.0     Exhaust model - conversion capability of the catalyst dependent on the light off temperature"
 /begin DEF_CHARACTERISTIC ExhMod_facCatAgiB1_C ExhMod_facCoCnvnCpbyTLiOffAgedBrickB1_M ExhMod_facCoCnvnCpbyTLiOffNewBrickB1_M ExhMod_facHcCnvnCpbyTLiOffAgedBrickB1_M ExhMod_facHcCnvnCpbyTLiOffNewBrickB1_M ExhMod_facNoxCnvnCpbyTLiOffAgedBrickB1_M ExhMod_facNoxCnvnCpbyTLiOffNewBrickB1_M ExhMod_facWghtCnvnCpbyTLiOffBrickB1_CA ExhMod_facWghtCnvnCpbyTLiOffCatB1_CA ExhMod_swtFacCnvnCpbyTLiOffB1_CA /end DEF_CHARACTERISTIC
 /begin IN_MEASUREMENT ExhMod_nrBrickCatAryB1 ExhMod_tCatBrickAryB1 /end IN_MEASUREMENT
 /begin OUT_MEASUREMENT ExhMod_facCnvnCpbyTLiOffBrickAryB1 ExhMod_facCnvnCpbyTLiOffCatAryB1 ExhMod_facCoCnvnCpbyTLiOffBrickAryB1 ExhMod_facHcCnvnCpbyTLiOffBrickAryB1 ExhMod_facNoxCnvnCpbyTLiOffBrickAryB1 ExhMod_facTLiOffCatAryB1 ExhMod_facWghtCnvnCpbyTLiOffBrickAryB1 ExhMod_facWghtCnvnCpbyTLiOffCatAryB1 /end OUT_MEASUREMENT
 FUNCTION_VERSION "1.0.0" /end FUNCTION
/begin FUNCTION ExhMod_DevPos "1.21.0    Calculation of device-postions in exhaust system" /begin DEF_CHARACTERISTIC ExhMod_posnPfil_C ExhMod_stCfgExhSysB1_CA /end DEF_CHARACTERISTIC
 /begin OUT_MEASUREMENT ExhMod_idxEgrPosnB1 ExhMod_idxFirstBrickCat1B1 ExhMod_idxFirstBrickCat2B1 ExhMod_idxFrtBrickCatAryB1 ExhMod_idxLstBrickCatAryB1 ExhMod_nrBrickCat1B1 ExhMod_nrBrickCat2B1 ExhMod_nrBrickCatAryB1 ExhMod_nrCatB1 ExhMod_posnPfil /end OUT_MEASUREMENT
 /begin LOC_MEASUREMENT ExhMod_flgCfgPlausB1 ExhMod_stCfgPlausB1 /end LOC_MEASUREMENT
 FUNCTION_VERSION "1.21.0" /end FUNCTION
/begin FUNCTION ExhMod_DewDetRels "2.45.0    Calculated value of dew point in exhaust system branch"
 /begin DEF_CHARACTERISTIC DewDet_tiDlyNEngRelFuM_C DewDet_tiMaxSwtOffCldStrt_C DewDet_tiMaxSwtOffWrmStrt_C DewDet_tiProlgNEngRelFuM_C DewDet_tMinEnvCldStrt_C DewDet_S1B1_I.egyThdSecFu_M DewDet_S1B1_I.egyThd_M DewDet_S1B1_I.facCatHeatgIntrpnWtrCntntGslSecFu_T DewDet_S1B1_I.facCatHeatgSecFu_T DewDet_S1B1_I.facCatHeatgWoExo_T DewDet_S1B1_I.facCatHeatg_T DewDet_S1B1_I.facCoolgAcmEgy_T DewDet_S1B1_I.facCoolgSnrs_T DewDet_S1B1_I.facCoolgTWall_T DewDet_S1B1_I.facCorrnMFlow_T DewDet_S1B1_I.facHeatThdCldStrtCntr_T DewDet_S1B1_I.facHeatThdIntrpnWtrCntntGslSecFu_T DewDet_S1B1_I.facHeatThdOffs_T DewDet_S1B1_I.facRednHeatFlowIntSec_C DewDet_S1B1_I.nrCldStrtSnsrProdLine_C DewDet_S1B1_I.nrMaxCldStrtSnsr_C DewDet_S1B1_I.ratMinHeatThdCldStrt_T DewDet_S1B1_I.ratThdNEngRelFuMSet_T DewDet_S1B1_I.ratThdNEngRelFuM_T DewDet_S1B1_I.tMinNoRstIntEngOff_C DewDet_S1B1_I.tMinNoRstInt_C DewDet_S1B1_I.tThdHeatFlowInt_C DewDet_S1B1_I.tiDlyRstIntEngOff_T DewDet_S1B1_I.tiDlyRstInt_C DewDet_S2B1_I.egyThdSecFu_M DewDet_S2B1_I.egyThd_M DewDet_S2B1_I.facCatHeatgIntrpnWtrCntntGslSecFu_T DewDet_S2B1_I.facCatHeatgSecFu_T DewDet_S2B1_I.facCatHeatgWoExo_T DewDet_S2B1_I.facCatHeatg_T DewDet_S2B1_I.facCoolgAcmEgy_T DewDet_S2B1_I.facCoolgSnrs_T DewDet_S2B1_I.facCoolgTWall_T DewDet_S2B1_I.facCorrnMFlow_T DewDet_S2B1_I.facHeatThdCldStrtCntr_T DewDet_S2B1_I.facHeatThdIntrpnWtrCntntGslSecFu_T DewDet_S2B1_I.facHeatThdOffs_T DewDet_S2B1_I.facRednHeatFlowIntSec_C DewDet_S2B1_I.nrCldStrtSnsrProdLine_C DewDet_S2B1_I.nrMaxCldStrtSnsr_C DewDet_S2B1_I.ratMinHeatThdCldStrt_T DewDet_S2B1_I.ratThdNEngRelFuMSet_T DewDet_S2B1_I.ratThdNEngRelFuM_T DewDet_S2B1_I.tMinNoRstIntEngOff_C DewDet_S2B1_I.tMinNoRstInt_C DewDet_S2B1_I.tThdHeatFlowInt_C DewDet_S2B1_I.tiDlyRstIntEngOff_T DewDet_S2B1_I.tiDlyRstInt_C DewDet_stConfSnsrAryB1_CA DewDet_stConf_C DewDet_stOffTiConf_C DewDet_tEngStrtMinAcm_C DewDet_tEnvMinAcm_C DewDet_tiProlgProdLine_C ExhMod_facMfIntegEngStrtTiEngOff_T STN10TMUB STS08TMUW /end DEF_CHARACTERISTIC
 /begin IN_MEASUREMENT B_ethadap_msg B_ethhte_msg CoEng_st ExhMod_facIntrpnGslSecFu ExhMod_mfExhSnsrAryB1 ExhMod_tExhSnsrAryB1 ExhMod_tWallSnsrAryB1 B_fabe_msg B_khakt_msg B_kh_msg B_trkonz_msg CEngDsT_tStrt CEngDsT_tStrtFrst Eep_EnvRamHist Eep_EnvRamInvld EnvT_t Epm_nEng ExhMod_flgEngRunngTiEngOff ExhMod_flgTiEngOffVld ExhMod_tiEngOff InjSys_ratFuMTot ml_w_msg PthSet_stOvrRun SyC_ctPostDrvLeave tka_msg /end IN_MEASUREMENT
 /begin OUT_MEASUREMENT DewDet_bFrstStrtEndERNM DewDet_bStrtEndERNM DewDet_flgAcmEgy DewDet_flgCatHeatgWoExo DewDet_flgEngStopER DewDet_flgInfoStrdEngOff DewDet_flgProlgProdLine DewDet_flgPwrFail DewDet_tiShDown ExhMod_cntrCldStrtAryB1 ExhMod_cntrCldStrtS1B1 ExhMod_cntrCldStrtS2B1 ExhMod_egyDewPntEndS1B1 ExhMod_egyDewPntEndS2B1 ExhMod_egyThdDewPntEndS1B1 ExhMod_egyThdDewPntEndS2B1 ExhMod_flgDewPntEndLstS1B1 ExhMod_flgDewPntEndLstS2B1 ExhMod_flgDewPntEndS1B1 ExhMod_flgDewPntEndS1B1Sig ExhMod_flgDewPntEndS2B1 ExhMod_flgDewPntEndS2B1Sig ExhMod_flgTSnsrStrtCalcdB1 ExhMod_mAirMfIntegEngFirstStrt ExhMod_mAirMfIntegEngStrt ExhMod_mAirMfIntegEngStrtCalReini ExhMod_tEngStrtDewDet ExhMod_tEnvDewDet ExhMod_tExhStrtS1B1 ExhMod_tExhStrtS2B1 /end OUT_MEASUREMENT
 /begin LOC_MEASUREMENT DewDet_ctReIni DewDet_flgAcmEgyBasc DewDet_flgEngStopLdc DewDet_flgTUpdEngStrt DewDet_flgTUpdTiShDown DewDet_S1B1_I.cntrCldStrtSnsr DewDet_S1B1_I.egyInteg DewDet_S1B1_I.egyIntegAcm DewDet_S1B1_I.egyIntegAcmLst DewDet_S1B1_I.egyIntegHiResl DewDet_S1B1_I.egyIntegInp DewDet_S1B1_I.egyThd DewDet_S1B1_I.egyThdEngRunLst DewDet_S1B1_I.egyThdHeat DewDet_S1B1_I.egyThdLst DewDet_S1B1_I.egyThdRaw DewDet_S1B1_I.egy_inc DewDet_S1B1_I.facCoolgSnrs DewDet_S1B1_I.flgAcmEgySnsr DewDet_S1B1_I.flgCondRstInt DewDet_S1B1_I.flgDewPntEnd DewDet_S1B1_I.flgDewPntEndLst DewDet_S1B1_I.flgRatNEngRelFuM DewDet_S1B1_I.flgRstDewDet DewDet_S1B1_I.flgRstDewPntEnd DewDet_S1B1_I.flgRstEngOff DewDet_S1B1_I.flgRstEngOffStrt DewDet_S1B1_I.flgRstInt DewDet_S1B1_I.flgSetDewPntEnd DewDet_S1B1_I.flgTUpdFco DewDet_S1B1_I.mfExhSnsr DewDet_S1B1_I.tSnsrCoolg DewDet_S1B1_I.tSnsrEnd DewDet_S1B1_I.tSnsrStrt DewDet_S1B1_I.tWallCoolg DewDet_S1B1_I.tWallEngStop DewDet_S1B1_I.tWallSnsrOld DewDet_S1B1_I.tiShtDwn DewDet_S2B1_I.cntrCldStrtSnsr DewDet_S2B1_I.egyInteg DewDet_S2B1_I.egyIntegAcm DewDet_S2B1_I.egyIntegAcmLst DewDet_S2B1_I.egyIntegHiResl DewDet_S2B1_I.egyIntegInp DewDet_S2B1_I.egyThd DewDet_S2B1_I.egyThdEngRunLst DewDet_S2B1_I.egyThdHeat DewDet_S2B1_I.egyThdLst DewDet_S2B1_I.egyThdRaw DewDet_S2B1_I.egy_inc DewDet_S2B1_I.facCoolgSnrs DewDet_S2B1_I.flgAcmEgySnsr DewDet_S2B1_I.flgCondRstInt DewDet_S2B1_I.flgDewPntEnd DewDet_S2B1_I.flgDewPntEndLst DewDet_S2B1_I.flgRatNEngRelFuM DewDet_S2B1_I.flgRstDewDet DewDet_S2B1_I.flgRstDewPntEnd DewDet_S2B1_I.flgRstEngOff DewDet_S2B1_I.flgRstEngOffStrt DewDet_S2B1_I.flgRstInt DewDet_S2B1_I.flgSetDewPntEnd DewDet_S2B1_I.flgTUpdFco DewDet_S2B1_I.mfExhSnsr DewDet_S2B1_I.tSnsrCoolg DewDet_S2B1_I.tSnsrEnd DewDet_S2B1_I.tSnsrStrt DewDet_S2B1_I.tWallCoolg DewDet_S2B1_I.tWallEngStop DewDet_S2B1_I.tWallSnsrOld DewDet_S2B1_I.tiShtDwn ExhMod_flgDewPntEndLstNvS1B1 ExhMod_mAirMfIntegEngStrtCalReiniNv /end LOC_MEASUREMENT
 FUNCTION_VERSION "2.45.0" /end FUNCTION
/begin FUNCTION ExhMod_LamMdl "1.16.0    Modelling Of Lambda In The Exhaust Gas System"
 /begin DEF_CHARACTERISTIC Lam_mO2StorgIni_C ExhMod_stLamCfg_C ExhMod_volBtwCat1Cat2B1_C ExhMod_volBtwCat2SDsCat2B1_C ExhMod_volBtwLS1Cat1B1_C Lam_mO2CatStThd_C Lam_mO2MaxCat1_C Lam_ratConcO2ThdLean_C Lam_ratConcO2ThdRich_C Lam_tDlyLSNplFlg Lam_uLSCat1Empty_C Lam_uLSCat1Full_C /end DEF_CHARACTERISTIC
 /begin IN_MEASUREMENT EngStrt_bStrtEnd B_bevab_msg B_sbblsu_msg ExhMod_flgLSEnaCat1B1 ExhMod_mfExhCat1B1 ExhMod_mfExhCat2B1 ExhMod_mfExhWoFuUsCat1B1 ExhMod_mfExhWoFuUsCat2B1 ExhMod_mO2StrExtdCat1B1 ExhMod_mO2StrExtdCat2B1 ExhMod_pDsLstCat ExhMod_pExhCat1UsB1 ExhMod_pExhCat2UsB1 ExhMod_tExhCat1UsAvrgB1 ExhMod_tExhCat2DsB1 ExhMod_tExhCat2UsAvrgB1 ExhMod_uCat1DsB1 lamsons_w_msg UEGO_rLamS1B1 /end IN_MEASUREMENT
 /begin OUT_MEASUREMENT ExhMod_dmO2Cat1B1 ExhMod_dmO2Cat2B1 ExhMod_flgEmptyCat1B1 ExhMod_flgEmptyCat2B1 ExhMod_flgFullCat1B1 ExhMod_flgFullCat2B1 ExhMod_flgLSEmptyCat1B1 ExhMod_flgLSFullCat1B1 ExhMod_flgLSNplCat1B1 ExhMod_flgLSNplEmptyCat1B1 ExhMod_flgLSNplFullCat1B1 ExhMod_mfO2Cat1B1 ExhMod_mfO2Cat2B1 ExhMod_mO2Cat1B1 ExhMod_mO2Cat2B1 ExhMod_mO2ExtdCat1B1 ExhMod_mO2ExtdCat2B1 ExhMod_ratConcO2Cat1B1 ExhMod_ratConcO2Cat2B1 ExhMod_rLamCat1DsB1 ExhMod_rLamCat1UsB1 ExhMod_rLamCat2DsB1 ExhMod_rLamCat2DsSB1 ExhMod_rLamCat2UsB1 ExhMod_rLamCatUsAryB1 ExhMod_rLamLS1B1 ExhMod_tiBtwLS1Cat1B1 ExhMod_tiBtwLS1Cat2B1 /end OUT_MEASUREMENT
 /begin LOC_MEASUREMENT Lam_flgRstO2IntgCat1B1 Lam_flgRstO2IntgCat2B1 Lam_mO2RstValCat1B1 Lam_mO2RstValCat2B1 Lam_O2IntglExtdCat1B1_I.mfO2 Lam_O2IntglExtdCat1B1_I.ratConcO2 Lam_O2IntglExtdCat1B1_I.O2IKL_I.memory Lam_O2IntglExtdCat2B1_I.mfO2 Lam_O2IntglExtdCat2B1_I.ratConcO2 Lam_O2IntglExtdCat2B1_I.O2IKL_I.memory Lam_PlausChkLSCat1B1_I.CatEmptyFF_I.status Lam_PlausChkLSCat1B1_I.CatFullFF_I.status Lam_PlausChkLSCat1B1_I.NotLeanTONV_I.outbit Lam_PlausChkLSCat1B1_I.NotLeanTONV_I.time Lam_PlausChkLSCat1B1_I.NotRichTONV_I.outbit Lam_PlausChkLSCat1B1_I.NotRichTONV_I.time Lam_PlausChkLSCat1B1_I.oxplIK_I.memory Lam_tiBtwCat1Cat2B1 Lam_tiBtwCat2SDsCat2B1 /end LOC_MEASUREMENT
 FUNCTION_VERSION "1.16.0" /end FUNCTION
/begin FUNCTION ExhMod_LibHeatBalEqutn "1.0.0     Library for Heat Balance Equations"
 /begin LOC_MEASUREMENT ExhMod_HeatBalIf.HeatStorg1 ExhMod_HeatBalIf.HeatStorg2 ExhMod_HeatBalIf.HeatStorg3 ExhMod_HeatBalIf.HeatTrf0To1 ExhMod_HeatBalIf.HeatTrf1To2 ExhMod_HeatBalIf.HeatTrf2To3 ExhMod_HeatBalIf.HeatTrf3To4 ExhMod_HeatBalIf.egyExt1 ExhMod_HeatBalIf.egyExt2 ExhMod_HeatBalIf.egyExt3 ExhMod_HeatBalIf.flg3HeatBal ExhMod_HeatBalIf.tHiResl0 ExhMod_HeatBalIf.tHiResl1 ExhMod_HeatBalIf.tHiResl2 ExhMod_HeatBalIf.tHiResl3 ExhMod_HeatBalIf.tHiResl4 ExhMod_HeatBal_I.tHiReslOutp1 ExhMod_HeatBal_I.tHiReslOutp2 ExhMod_HeatBal_I.tHiReslOutp3 /end LOC_MEASUREMENT
 FUNCTION_VERSION "1.0.0" /end FUNCTION
/begin FUNCTION ExhMod_MfIf "1.14.0    Converter Intern Exhaust Mass Flows To System" /begin REF_CHARACTERISTIC ExhMod_idxSnsrB1_CA /end REF_CHARACTERISTIC
 /begin IN_MEASUREMENT ExhMod_idxEgrPosnB1 ExhMod_idxFirstBrickCat1B1 ExhMod_idxFirstBrickCat2B1 ExhMod_mfExhAryB1 ExhMod_mfFuB1 /end IN_MEASUREMENT
 /begin OUT_MEASUREMENT ExhMod_dmExhCat1B1 ExhMod_dmExhCat2B1 ExhMod_dmExhMnfB1 ExhMod_dmExhS1B1 ExhMod_dmExhS2B1 ExhMod_dmExhWoFuUsCat1B1 ExhMod_dmExhWoFuUsCat2B1 ExhMod_mfExhB1 ExhMod_mfExhCat1B1 ExhMod_mfExhCat2B1 ExhMod_mfExhCatAryB1 ExhMod_mfExhMnfB1 ExhMod_mfExhS1B1 ExhMod_mfExhS2B1 ExhMod_mfExhSnsrAryB1 ExhMod_mfExhWoFuUsCat1B1 ExhMod_mfExhWoFuUsCat2B1 /end OUT_MEASUREMENT
 FUNCTION_VERSION "1.14.0" /end FUNCTION
/begin FUNCTION ExhMod_MfMdl "1.21.1    Calculation Of Exhaust Emission Mass Flow - Bank-Dependent" /begin DEF_CHARACTERISTIC AFE22 AFSF /end DEF_CHARACTERISTIC
 /begin IN_MEASUREMENT B_sa_msg Epm_stSpd ExhMod_facIntrpnGslSecFu ExhMod_idxEgrPosnB1 ExhMod_pExhAryB1 ExhMod_tExhAryB1 InjSys_ratFuMTot msagr_w_msg msfabr_w_msg redistb1_msg SyC_stSub umsrln_w_msg /end IN_MEASUREMENT
 /begin OUT_MEASUREMENT ExhMod_dmAirB1 ExhMod_dmEgrMflowB1 ExhMod_dmExhAryB1 ExhMod_dmExhVlvB1 ExhMod_dmFuB1 ExhMod_mfAirB1 ExhMod_mfEgrB1 ExhMod_mfExhAryB1 ExhMod_mfExhVlvB1 ExhMod_mfFuB1 ExhMod_ratMFlowVlvB1 ExhMod_ratStoi ExhMod_vfExhAryB1 /end OUT_MEASUREMENT
 /begin LOC_MEASUREMENT ExhMod_flgPrePostDrv /end LOC_MEASUREMENT
 FUNCTION_VERSION "1.21.1" /end FUNCTION
/begin FUNCTION ExhMod_O2StorgIf "1.5.0     Interface to Oxygen Storage capacity of catalyst Estimation"
 /begin IN_MEASUREMENT ExhMod_flgLSNplCat1B1 HEGO_bS2B1Vld HEGO_uS2B1Extd SyC_stSub /end IN_MEASUREMENT
 /begin OUT_MEASUREMENT ExhMod_flgLSEnaCat1B1 ExhMod_uCat1DsB1 /end OUT_MEASUREMENT
 FUNCTION_VERSION "1.5.0" /end FUNCTION
/begin COMPU_METHOD AirMassPerTime_float "" RAT_FUNC "%6.2" "Kg/h" COEFFS 0 1 0 0 0 1 /end COMPU_METHOD
/begin COMPU_METHOD B_TRUE "" TAB_VERB "%6.3" "" COMPU_TAB_REF B_TRUE /end COMPU_METHOD
/begin COMPU_VTAB B_TRUE "" TAB_VERB 2 0 "FALSE" 1 "TRUE" /end COMPU_VTAB
/begin COMPU_METHOD dez "" RAT_FUNC "%6.2" "" COEFFS 0 1 0 0 0 1 /end COMPU_METHOD
/begin COMPU_METHOD EngN "" RAT_FUNC "%6.3" "rpm" COEFFS 0 2 0 0 0 1 /end COMPU_METHOD
/begin COMPU_METHOD fak_q0p000244 "" RAT_FUNC "%6.5" "-" COEFFS 0 65536 0 0 0 16 /end COMPU_METHOD
/begin COMPU_METHOD fak_q0p01 "" RAT_FUNC "%6.4" "" COEFFS 0 100 0 0 0 1 /end COMPU_METHOD
/begin COMPU_METHOD fak_q4p6875Em4 "" RAT_FUNC "%6.5" "-" COEFFS 0 6400 0 0 0 3 /end COMPU_METHOD
/begin COMPU_METHOD fak_sw_b8 "" RAT_FUNC "%6.5" "-" COEFFS 0 65536 0 0 0 16 /end COMPU_METHOD
/begin COMPU_METHOD fak_ub_b1 "" RAT_FUNC "%6.4" "-" COEFFS 0 256 0 0 0 1 /end COMPU_METHOD
/begin COMPU_METHOD fak_ub_b2 "" RAT_FUNC "%8.5" "-" COEFFS 0 256 0 0 0 2 /end COMPU_METHOD
/begin COMPU_METHOD fak_ub_b32 "" RAT_FUNC "%6.3" "-" COEFFS 0 256 0 0 0 32 /end COMPU_METHOD
/begin COMPU_METHOD fak_uw_b0p05 "" RAT_FUNC "%9.8" "-" COEFFS 0 65536 0 0 0 0.05 /end COMPU_METHOD
/begin COMPU_METHOD fak_uw_b100 "" RAT_FUNC "%6.4" "-" COEFFS 0 65536 0 0 0 100 /end COMPU_METHOD
/begin COMPU_METHOD fak_uw_b16 "" RAT_FUNC "%6.5" "-" COEFFS 0 65536 0 0 0 16 /end COMPU_METHOD
/begin COMPU_METHOD fak_uw_b2 "" RAT_FUNC "%7.6" "-" COEFFS 0 65536 0 0 0 2 /end COMPU_METHOD
/begin COMPU_METHOD fak_uw_q0p01 "" RAT_FUNC "%6.4" "-" COEFFS 0 1 0 0 0 0.01 /end COMPU_METHOD
/begin COMPU_METHOD LOWSCAVRATE_SC_Compu "" TAB_VERB "%6.3" "" COMPU_TAB_REF LOWSCAVRATE_SC_Compu /end COMPU_METHOD
/begin COMPU_VTAB LOWSCAVRATE_SC_Compu "" TAB_VERB 2 0 "False" 1 "True" /end COMPU_VTAB
/begin COMPU_METHOD LPSYS_CTLTYP_SY_Compu "" TAB_VERB "%6.3" "" COMPU_TAB_REF LPSYS_CTLTYP_SY_Compu /end COMPU_METHOD
/begin COMPU_VTAB LPSYS_CTLTYP_SY_Compu "" TAB_VERB 3 0 "LPSYS_STD" 1 "LPSYS_CLSDLOP" 2 "LPSYS_OPNLOP" /end COMPU_VTAB
/begin COMPU_METHOD LSAEBCMTCENA_SC_Compu "" TAB_VERB "%6.3" "" COMPU_TAB_REF LSAEBCMTCENA_SC_Compu /end COMPU_METHOD
/begin COMPU_VTAB LSAEBCMTCENA_SC_Compu "" TAB_VERB 2 0 "False" 1 "True" /end COMPU_VTAB
/begin COMPU_METHOD LSFX4_SY_Compu "" TAB_VERB "%6.3" "" COMPU_TAB_REF LSFX4_SY_Compu /end COMPU_METHOD
/begin COMPU_VTAB LSFX4_SY_Compu "" TAB_VERB 2 0 "False" 1 "True" /end COMPU_VTAB
/begin COMPU_METHOD LSM_SY_Compu "" TAB_VERB "%6.3" "" COMPU_TAB_REF LSM_SY_Compu /end COMPU_METHOD
/begin COMPU_VTAB LSM_SY_Compu "" TAB_VERB 2 0 "0" 1 "1" /end COMPU_VTAB
/begin COMPU_METHOD LSUADV_SY_Compu "" TAB_VERB "%6.3" "" COMPU_TAB_REF LSUADV_SY_Compu /end COMPU_METHOD
/begin COMPU_VTAB LSUADV_SY_Compu "" TAB_VERB 2 0 "False" 1 "True" /end COMPU_VTAB
/begin COMPU_METHOD LSUDLYFLT_SY_Compu "" TAB_VERB "%6.3" "" COMPU_TAB_REF LSUDLYFLT_SY_Compu /end COMPU_METHOD
/begin COMPU_VTAB LSUDLYFLT_SY_Compu "" TAB_VERB 2 0 "False" 1 "True" /end COMPU_VTAB
/begin COMPU_METHOD LSUDYNEXCLADP_SY_Compu "" TAB_VERB "%6.3" "" COMPU_TAB_REF LSUDYNEXCLADP_SY_Compu /end COMPU_METHOD
/begin COMPU_VTAB LSUDYNEXCLADP_SY_Compu "" TAB_VERB 2 0 "False" 1 "True" /end COMPU_VTAB
/begin COMPU_METHOD LSUDYNMONINTR_SY_Compu "" TAB_VERB "%6.3" "" COMPU_TAB_REF LSUDYNMONINTR_SY_Compu /end COMPU_METHOD
/begin COMPU_VTAB LSUDYNMONINTR_SY_Compu "" TAB_VERB 2 0 "False" 1 "True" /end COMPU_VTAB
/begin COMPU_METHOD LSUHTRCPLMON_SY_Compu "" TAB_VERB "%6.3" "" COMPU_TAB_REF LSUHTRCPLMON_SY_Compu /end COMPU_METHOD
/begin COMPU_VTAB LSUHTRCPLMON_SY_Compu "" TAB_VERB 2 0 "False" 1 "True" /end COMPU_VTAB
/begin COMPU_METHOD LSU_CT_SENSORS_SY_Compu "" TAB_VERB "%6.3" "" COMPU_TAB_REF LSU_CT_SENSORS_SY_Compu /end COMPU_METHOD
/begin COMPU_VTAB LSU_CT_SENSORS_SY_Compu "" TAB_VERB 5 0 "0" 1 "1" 2 "2" 3 "3" 4 "4" /end COMPU_VTAB
/begin COMPU_METHOD MACENA_SC_Compu "" TAB_VERB "%6.3" "" COMPU_TAB_REF MACENA_SC_Compu /end COMPU_METHOD
/begin COMPU_VTAB MACENA_SC_Compu "" TAB_VERB 2 0 "False" 1 "True" /end COMPU_VTAB
/begin COMPU_METHOD Mass2Temp_q0p000003 "" RAT_FUNC "%8.7" "Kg/K" COEFFS 0 333333.333333333 0 0 0 1 /end COMPU_METHOD
/begin COMPU_METHOD MassPerTimeq0p00001 "" RAT_FUNC "%8.7" "g/s" COEFFS 0 100000 0 0 0 1 /end COMPU_METHOD
/begin COMPU_METHOD MassPerTimeq0p001 "" RAT_FUNC "%6.5" "g/s" COEFFS 0 1000 0 0 0 1 /end COMPU_METHOD
/begin COMPU_METHOD Mass_q1 "" RAT_FUNC "%6.2" "g" COEFFS 0 1 0 0 0 1 /end COMPU_METHOD
/begin COMPU_METHOD MAXPREDMODSWT_SC_Compu "" RAT_FUNC "%6.2" "" COEFFS 0 1 0 0 0 1 /end COMPU_METHOD
/begin COMPU_METHOD MAXRNGREQVEH_SY_Compu "" TAB_VERB "%6.3" "" COMPU_TAB_REF MAXRNGREQVEH_SY_Compu /end COMPU_METHOD
/begin COMPU_VTAB MAXRNGREQVEH_SY_Compu "" TAB_VERB 2 0 "MAXRNGREQVEHOFF" 1 "MAXRNGREQVEHON" /end COMPU_VTAB
/begin COMPU_METHOD MAXTQPRDN_SC_Compu "" TAB_VERB "%6.3" "" COMPU_TAB_REF MAXTQPRDN_SC_Compu /end COMPU_METHOD
/begin COMPU_VTAB MAXTQPRDN_SC_Compu "" TAB_VERB 2 0 "False" 1 "True" /end COMPU_VTAB
/begin COMPU_METHOD MAX_NUM_ADDINJ_SY_Compu "" TAB_VERB "%6.3" "" COMPU_TAB_REF MAX_NUM_ADDINJ_SY_Compu /end COMPU_METHOD
/begin COMPU_VTAB MAX_NUM_ADDINJ_SY_Compu "" TAB_VERB 2 0 "0" 1 "1" /end COMPU_VTAB
/begin COMPU_METHOD MAX_NUM_MAININJ_SY_Compu "" TAB_VERB "%6.3" "" COMPU_TAB_REF MAX_NUM_MAININJ_SY_Compu /end COMPU_METHOD
/begin COMPU_VTAB MAX_NUM_MAININJ_SY_Compu "" TAB_VERB 7 2 "2" 3 "3" 4 "4" 5 "5" 6 "6" 7 "7" 8 "8" /end COMPU_VTAB
/begin COMPU_METHOD MDG1CPUDEVICE_SC_Compu "" TAB_VERB "%6.3" "" COMPU_TAB_REF MDG1CPUDEVICE_SC_Compu /end COMPU_METHOD
/begin COMPU_VTAB MDG1CPUDEVICE_SC_Compu "" TAB_VERB 9 0 "None" 1 "Device1" 2 "Device2" 3 "Device3" 4 "Device4" 5 "Device5" 13 "Device3+" 14 "Device4+" 15 "Device5+" /end COMPU_VTAB
/begin COMPU_METHOD MDG1CPUSTEP_SC_Compu "" TAB_VERB "%6.3" "" COMPU_TAB_REF MDG1CPUSTEP_SC_Compu /end COMPU_METHOD
/begin COMPU_VTAB MDG1CPUSTEP_SC_Compu "" TAB_VERB 11 0 "None" 1 "1" 2 "2" 110 "110" 120 "120" 130 "130" 140 "140" 210 "210" 220 "220" 230 "230" 232 "232" /end COMPU_VTAB
/begin COMPU_METHOD MDG1CPUVENDOR_SC_Compu "" TAB_VERB "%6.3" "" COMPU_TAB_REF MDG1CPUVENDOR_SC_Compu /end COMPU_METHOD
/begin COMPU_VTAB MDG1CPUVENDOR_SC_Compu "" TAB_VERB 4 0 "None" 1 "IFX" 2 "JDP" 3 "ST" /end COMPU_VTAB
/begin COMPU_METHOD MDG1MSGCNCPT_SC_Compu "" TAB_VERB "%6.3" "" COMPU_TAB_REF MDG1MSGCNCPT_SC_Compu /end COMPU_METHOD
/begin COMPU_VTAB MDG1MSGCNCPT_SC_Compu "" TAB_VERB 2 0 "MSGCNCPT_DISABLED" 1 "MSGCNCPT_ENABLED" /end COMPU_VTAB
/begin COMPU_METHOD MEM_CENDIAGACTVD_SC_Compu "" TAB_VERB "%6.3" "" COMPU_TAB_REF MEM_CENDIAGACTVD_SC_Compu /end COMPU_METHOD
/begin COMPU_VTAB MEM_CENDIAGACTVD_SC_Compu "" TAB_VERB 2 0 "False" 1 "True" /end COMPU_VTAB
/begin COMPU_METHOD MEM_DIAGACTVDEXTD_SC_Compu "" TAB_VERB "%6.3" "" COMPU_TAB_REF MEM_DIAGACTVDEXTD_SC_Compu /end COMPU_METHOD
/begin COMPU_VTAB MEM_DIAGACTVDEXTD_SC_Compu "" TAB_VERB 2 0 "False" 1 "True" /end COMPU_VTAB
/begin COMPU_METHOD MESCTRLR_PFAVL_SC_Compu "" TAB_VERB "%6.3" "" COMPU_TAB_REF MESCTRLR_PFAVL_SC_Compu /end COMPU_METHOD
/begin COMPU_VTAB MESCTRLR_PFAVL_SC_Compu "" TAB_VERB 2 0 "MESCtrlr_NotAvl" 1 "MESCtrlr_Avl" /end COMPU_VTAB
/begin COMPU_METHOD MFCORRNEVAPSYS_SC_Compu "" TAB_VERB "%6.3" "" COMPU_TAB_REF MFCORRNEVAPSYS_SC_Compu /end COMPU_METHOD
/begin COMPU_VTAB MFCORRNEVAPSYS_SC_Compu "" TAB_VERB 2 0 "False" 1 "True" /end COMPU_VTAB
/begin COMPU_METHOD MFLOWCRKCSTINTKMNFMDL_SC_Compu "" TAB_VERB "%6.3" "" COMPU_TAB_REF MFLOWCRKCSTINTKMNFMDL_SC_Compu /end COMPU_METHOD
/begin COMPU_VTAB MFLOWCRKCSTINTKMNFMDL_SC_Compu "" TAB_VERB 3 0 "NONE" 1 "PRESSURE" 2 "DELTA" /end COMPU_VTAB
/begin COMPU_METHOD mgrad_q1_mgdivs "" RAT_FUNC "%6.2" "mg/s" COEFFS 0 1 0 0 0 1 /end COMPU_METHOD
/begin COMPU_METHOD m_q0p1 "" RAT_FUNC "%6.3" "kg/h" COEFFS 0 10 0 0 0 1 /end COMPU_METHOD
/begin COMPU_METHOD m_q0p1_mg "" RAT_FUNC "%6.3" "mg" COEFFS 0 1 0 0 0 0.1 /end COMPU_METHOD
/begin COMPU_METHOD m_q0p1_mgs "" RAT_FUNC "%6.3" "mg/s" COEFFS 0 1 0 0 0 0.1 /end COMPU_METHOD
/begin COMPU_METHOD m_q1_mg "" RAT_FUNC "%6.2" "mg" COEFFS 0 1 0 0 0 1 /end COMPU_METHOD
/begin COMPU_METHOD m_uw_b23p3 "" RAT_FUNC "%6.5" "kg" COEFFS 0 2812.5 0 0 0 1 /end COMPU_METHOD
/begin COMPU_METHOD m_uw_b6553p5 "" RAT_FUNC "%6.3" "kg/h" COEFFS 0 1 0 0 0 0.1 /end COMPU_METHOD
/begin COMPU_METHOD OneToOne "" RAT_FUNC "%6.2" "-" COEFFS 0 1 0 0 0 1 /end COMPU_METHOD
/begin COMPU_METHOD q1p52588Em6_K "" RAT_FUNC "%8.7" "K" COEFFS 0 655360 0 0 0 1 /end COMPU_METHOD
/begin COMPU_METHOD q9p7656Em4_kJ_DIV_K "" RAT_FUNC "%6.5" "KJ/K" COEFFS 0 1024 0 0 0 1 /end COMPU_METHOD
/begin COMPU_METHOD q_q1p5259Em5_kJ "" RAT_FUNC "%7.6" "kJ" COEFFS 0 65536 0 0 0 1 /end COMPU_METHOD
/begin COMPU_METHOD q_q1_kJ "" RAT_FUNC "%6.2" "kJ" COEFFS 0 1 0 0 0 1 /end COMPU_METHOD
/begin COMPU_METHOD RBPtCel_egy_1p0_2 "" RAT_FUNC "%6.2" "J" COEFFS 0 1 0 0 0 1 /end COMPU_METHOD
/begin COMPU_METHOD RBPtCel_fac_0p00001_1 "" RAT_FUNC "%8.7" "-" COEFFS 0 100000 0 0 0 1 /end COMPU_METHOD
/begin COMPU_METHOD RBPtCel_mf_1p0_1 "" RAT_FUNC "%6.2" "kg/h" COEFFS 0 1 0 0 0 1 /end COMPU_METHOD
/begin COMPU_METHOD RBPtCel_vf_1p0_1 "" RAT_FUNC "%6.2" "m^3/h" COEFFS 0 1 0 0 0 1 /end COMPU_METHOD
/begin COMPU_METHOD relnmot_q768 "" RAT_FUNC "%6.0" "%/min" COEFFS 0 1 0 0 0 768 /end COMPU_METHOD
/begin COMPU_METHOD rel_uw_q0p0234 "" RAT_FUNC "%6.4" "%" COEFFS 0 32 0 0 0 0.75 /end COMPU_METHOD
/begin COMPU_METHOD spg_q0p00488 "" RAT_FUNC "%6.4" "V" COEFFS 0 1024 0 0 0 5 /end COMPU_METHOD
/begin COMPU_METHOD t1sxs_uw_q1 "" RAT_FUNC "%6.2" "s" COEFFS 0 1 0 0 0 1 /end COMPU_METHOD
/begin COMPU_METHOD TempK_float "" RAT_FUNC "%6.2" "K" COEFFS 0 1 0 0 0 1 /end COMPU_METHOD
/begin COMPU_METHOD tempr_q1p272Em6 "" RAT_FUNC "%8.7" "1/K" COEFFS 0 786432 0 0 0 1 /end COMPU_METHOD
/begin COMPU_METHOD Temp_Cels "" RAT_FUNC "%6.1" "deg C" COEFFS 0 10 2731.4 0 0 1 /end COMPU_METHOD
/begin COMPU_METHOD temp_q0p1_K "" RAT_FUNC "%6.3" "K" COEFFS 0 10 0 0 0 1 /end COMPU_METHOD
/begin COMPU_METHOD temp_q0p1_o273 "" RAT_FUNC "%6.1" "Grad C" COEFFS 0 10 2731.4 0 0 1 /end COMPU_METHOD
/begin COMPU_METHOD temp_q1p5259Em6_om273 "" RAT_FUNC "%6.1" "°C" COEFFS 0 65536 17900503.04 0 0 0.1 /end COMPU_METHOD
/begin COMPU_METHOD temp_ub_q0p75_o48 "" RAT_FUNC "%6.2" "Grad C" COEFFS 0 1 48 0 0 0.75 /end COMPU_METHOD
/begin COMPU_METHOD t_q0p01 "" RAT_FUNC "%6.4" "s" COEFFS 0 100 0 0 0 1 /end COMPU_METHOD
/begin COMPU_METHOD t_q0p05 "" RAT_FUNC "%6.4" "s" COEFFS 0 100 0 0 0 5 /end COMPU_METHOD
/begin COMPU_METHOD t_q0p1 "" RAT_FUNC "%6.3" "s" COEFFS 0 10 0 0 0 1 /end COMPU_METHOD
/begin COMPU_METHOD t_q1 "" RAT_FUNC "%6.2" "s" COEFFS 0 1 0 0 0 1 /end COMPU_METHOD
/begin COMPU_METHOD Vel "" RAT_FUNC "%6.4" "km/h" COEFFS 0 100 0 0 0 1 /end COMPU_METHOD
/begin COMPU_METHOD vfzg_ub_q1p25 "" RAT_FUNC "%6.2" "km/h" COEFFS 0 1 0 0 0 1.25 /end COMPU_METHOD
/begin COMPU_METHOD vol_q1p5_cm3 "" RAT_FUNC "%6.2" "cm3" COEFFS 0 10 0 0 0 15 /end COMPU_METHOD
/begin COMPU_METHOD zk100msrtemp_q1p589em6 "" RAT_FUNC "%8.7" "1/sK" COEFFS 0 6291456 0 0 0 10 /end COMPU_METHOD
/begin COMPU_METHOD zk50msxs_uw_b3276p8 "" RAT_FUNC "%6.1" "s" COEFFS 0 0 65536 0 20 0 /end COMPU_METHOD
/begin RECORD_LAYOUT RB_Axis_S16 NO_AXIS_PTS_X 1 SWORD AXIS_PTS_X 2 SWORD INDEX_INCR DIRECT /end RECORD_LAYOUT
/begin RECORD_LAYOUT RB_Axis_U16 NO_AXIS_PTS_X 1 UWORD AXIS_PTS_X 2 UWORD INDEX_INCR DIRECT /end RECORD_LAYOUT
/begin RECORD_LAYOUT RB_CurveGroup_U8 FNC_VALUES 1 UBYTE COLUMN_DIR DIRECT /end RECORD_LAYOUT
/begin RECORD_LAYOUT RB_Curve_R32_U16_Static NO_AXIS_PTS_X 1 ULONG AXIS_PTS_X 2 FLOAT32_IEEE INDEX_INCR DIRECT FNC_VALUES 3 UWORD COLUMN_DIR DIRECT STATIC_RECORD_LAYOUT /end RECORD_LAYOUT
/begin RECORD_LAYOUT RB_Curve_S16_U16_Static NO_AXIS_PTS_X 1 SWORD AXIS_PTS_X 2 SWORD INDEX_INCR DIRECT FNC_VALUES 3 UWORD COLUMN_DIR DIRECT STATIC_RECORD_LAYOUT /end RECORD_LAYOUT
/begin RECORD_LAYOUT RB_Curve_S16_U8_Static NO_AXIS_PTS_X 1 SWORD AXIS_PTS_X 2 SWORD INDEX_INCR DIRECT FNC_VALUES 3 UBYTE COLUMN_DIR DIRECT STATIC_RECORD_LAYOUT /end RECORD_LAYOUT
/begin RECORD_LAYOUT RB_Curve_U16_U16 NO_AXIS_PTS_X 1 UWORD AXIS_PTS_X 2 UWORD INDEX_INCR DIRECT FNC_VALUES 3 UWORD COLUMN_DIR DIRECT /end RECORD_LAYOUT
/begin RECORD_LAYOUT RB_Curve_U16_U8_Static NO_AXIS_PTS_X 1 UWORD AXIS_PTS_X 2 UWORD INDEX_INCR DIRECT FNC_VALUES 3 UBYTE COLUMN_DIR DIRECT STATIC_RECORD_LAYOUT /end RECORD_LAYOUT
/begin RECORD_LAYOUT RB_Map_R32U8_R32 NO_AXIS_PTS_X 1 ULONG NO_AXIS_PTS_Y 2 ULONG AXIS_PTS_X 3 FLOAT32_IEEE INDEX_INCR DIRECT AXIS_PTS_Y 4 UBYTE INDEX_INCR DIRECT FNC_VALUES 5 FLOAT32_IEEE COLUMN_DIR DIRECT /end RECORD_LAYOUT
/begin RECORD_LAYOUT RB_Map_S16S16_S16 NO_AXIS_PTS_X 1 SWORD NO_AXIS_PTS_Y 2 SWORD AXIS_PTS_X 3 SWORD INDEX_INCR DIRECT AXIS_PTS_Y 4 SWORD INDEX_INCR DIRECT FNC_VALUES 5 SWORD COLUMN_DIR DIRECT /end RECORD_LAYOUT
/begin RECORD_LAYOUT RB_Map_S16S16_U16 NO_AXIS_PTS_X 1 SWORD NO_AXIS_PTS_Y 2 SWORD AXIS_PTS_X 3 SWORD INDEX_INCR DIRECT AXIS_PTS_Y 4 SWORD INDEX_INCR DIRECT FNC_VALUES 5 UWORD COLUMN_DIR DIRECT /end RECORD_LAYOUT
/begin RECORD_LAYOUT RB_Map_S16U16_S16 NO_AXIS_PTS_X 1 SWORD NO_AXIS_PTS_Y 2 SWORD AXIS_PTS_X 3 SWORD INDEX_INCR DIRECT AXIS_PTS_Y 4 UWORD INDEX_INCR DIRECT FNC_VALUES 5 SWORD ROW_DIR DIRECT /end RECORD_LAYOUT
/begin RECORD_LAYOUT RB_Map_S16U16_U16 NO_AXIS_PTS_X 1 SWORD NO_AXIS_PTS_Y 2 SWORD AXIS_PTS_X 3 SWORD INDEX_INCR DIRECT AXIS_PTS_Y 4 UWORD INDEX_INCR DIRECT FNC_VALUES 5 UWORD ROW_DIR DIRECT /end RECORD_LAYOUT
/begin RECORD_LAYOUT RB_Map_S16U8_U16 NO_AXIS_PTS_X 1 SWORD NO_AXIS_PTS_Y 2 SWORD AXIS_PTS_X 3 SWORD INDEX_INCR DIRECT AXIS_PTS_Y 4 UBYTE INDEX_INCR DIRECT FNC_VALUES 5 UWORD COLUMN_DIR DIRECT /end RECORD_LAYOUT
/begin RECORD_LAYOUT RB_ValA_Wu16 FNC_VALUES 1 UWORD COLUMN_DIR DIRECT /end RECORD_LAYOUT
/begin RECORD_LAYOUT RB_ValA_Wu8 FNC_VALUES 1 UBYTE COLUMN_DIR DIRECT /end RECORD_LAYOUT
/begin RECORD_LAYOUT RB_Val_Wr32 FNC_VALUES 1 FLOAT32_IEEE COLUMN_DIR DIRECT /end RECORD_LAYOUT
/begin RECORD_LAYOUT RB_Val_Ws16 FNC_VALUES 1 SWORD COLUMN_DIR DIRECT /end RECORD_LAYOUT
/begin RECORD_LAYOUT RB_Val_Ws32 FNC_VALUES 1 SLONG COLUMN_DIR DIRECT /end RECORD_LAYOUT
/begin RECORD_LAYOUT RB_Val_Wu16 FNC_VALUES 1 UWORD COLUMN_DIR DIRECT /end RECORD_LAYOUT
/begin RECORD_LAYOUT RB_Val_Wu32 FNC_VALUES 1 ULONG COLUMN_DIR DIRECT /end RECORD_LAYOUT
/begin RECORD_LAYOUT RB_Val_Wu8 FNC_VALUES 1 UBYTE COLUMN_DIR DIRECT /end RECORD_LAYOUT
/end MODULE
/end PROJECT
