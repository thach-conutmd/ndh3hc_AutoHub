ASAP2_VERSION 1 60
/begin PROJECT MG1CS022 "MG1CS022"
/begin HEADER "" VERSION "MG1CS022_62XSC_V037" PROJECT_NO MG1CS022 /end HEADER
/begin MODULE DIM ""
/begin MOD_COMMON "" BYTE_ORDER MSB_LAST ALIGNMENT_BYTE 1 ALIGNMENT_WORD 2 ALIGNMENT_LONG 4 ALIGNMENT_INT64 4 ALIGNMENT_FLOAT32_IEEE 4 ALIGNMENT_FLOAT64_IEEE 4 DATA_SIZE 32 /end MOD_COMMON
/begin CHARACTERISTIC CalcInjModDft.stInjMod_M "default subcoordinator for injection modes / injection mode" MAP 0x805593B8 RB_Map_U16U16_U16 19.0000000000 InjSys_InjMode_Set_COMPU_VERB 0.00 19.0000000000 FORMAT "%13.10"
 /begin AXIS_DESCR STD_AXIS NO_INPUT_QUANTITY EngN 16 0.00 32767.50 FORMAT "%8.2" DEPOSIT ABSOLUTE /end AXIS_DESCR
 /begin AXIS_DESCR STD_AXIS NO_INPUT_QUANTITY rel_uw_q0p0234 16 0.00 1535.977 FORMAT "%8.3" DEPOSIT ABSOLUTE /end AXIS_DESCR
/end CHARACTERISTIC
/begin CHARACTERISTIC CalcInjMod_HOM.stInjMod_M "class injection mode sub coordination / injection mode" MAP 0x80558A98 RB_Map_U16U16_U16 19.0000000000 InjSys_InjMode_Set_COMPU_VERB 0.00 19.0000000000 FORMAT "%13.10"
 /begin AXIS_DESCR STD_AXIS NO_INPUT_QUANTITY EngN 16 0.00 32767.50 FORMAT "%8.2" DEPOSIT ABSOLUTE /end AXIS_DESCR
 /begin AXIS_DESCR STD_AXIS NO_INPUT_QUANTITY rel_uw_q0p0234 16 0.00 1535.977 FORMAT "%8.3" DEPOSIT ABSOLUTE /end AXIS_DESCR
/end CHARACTERISTIC
/begin CHARACTERISTIC CalcInjMod_HOM_WU.stInjMod_M "class injection mode sub coordination / injection mode" MAP 0x80558CE0 RB_Map_U16U16_U16 19.0000000000 InjSys_InjMode_Set_COMPU_VERB 0.00 19.0000000000 FORMAT "%13.10"
 /begin AXIS_DESCR STD_AXIS NO_INPUT_QUANTITY EngN 16 0.00 32767.50 FORMAT "%8.2" DEPOSIT ABSOLUTE /end AXIS_DESCR
 /begin AXIS_DESCR STD_AXIS NO_INPUT_QUANTITY rel_uw_q0p0234 16 0.00 1535.977 FORMAT "%8.3" DEPOSIT ABSOLUTE /end AXIS_DESCR
/end CHARACTERISTIC
/begin CHARACTERISTIC CalcInjMod_HSP.stInjMod_M "class injection mode sub coordination / injection mode" MAP 0x80558F28 RB_Map_U16U16_U16 19.0000000000 InjSys_InjMode_Set_COMPU_VERB 0.00 19.0000000000 FORMAT "%13.10"
 /begin AXIS_DESCR STD_AXIS NO_INPUT_QUANTITY EngN 16 0.00 32767.50 FORMAT "%8.2" DEPOSIT ABSOLUTE /end AXIS_DESCR
 /begin AXIS_DESCR STD_AXIS NO_INPUT_QUANTITY rel_uw_q0p0234 16 0.00 1535.977 FORMAT "%8.3" DEPOSIT ABSOLUTE /end AXIS_DESCR
/end CHARACTERISTIC
/begin CHARACTERISTIC CalcInjMod_HSP_CH.stInjMod_M "class injection mode sub coordination / injection mode" MAP 0x80559170 RB_Map_U16U16_U16 19.0000000000 InjSys_InjMode_Set_COMPU_VERB 0.00 19.0000000000 FORMAT "%13.10"
 /begin AXIS_DESCR STD_AXIS NO_INPUT_QUANTITY EngN 16 0.00 32767.50 FORMAT "%8.2" DEPOSIT ABSOLUTE /end AXIS_DESCR
 /begin AXIS_DESCR STD_AXIS NO_INPUT_QUANTITY rel_uw_q0p0234 16 0.00 1535.977 FORMAT "%8.3" DEPOSIT ABSOLUTE /end AXIS_DESCR
/end CHARACTERISTIC
/begin AXIS_PTS CoEOM_stEomDesReqd_AX "distribution for requested mode of operation - interpolation of group axis allowed only in synchro task" 0x80527A42 NO_INPUT_QUANTITY RB_Axis_U16 7951.00000000 CoEOM_stEomStgTot_VERB 26 0.00 7951.00000000 FORMAT "%13.8" DEPOSIT ABSOLUTE /end AXIS_PTS
/begin CHARACTERISTIC GDIOff.stInjPktVrntInst_C "class intance GDI off / injection packet variant and class instance selector" VALUE 0x80559728 RB_Val_Wu32 4294967295.00 dez 0.00 4294967295.00 FORMAT "%13.2" /end CHARACTERISTIC
/begin CHARACTERISTIC HO1.stInjPktVrntInst_C "selection injection packet variant and class instance / injection packet variant and class instance selector" VALUE 0x805596DC RB_Val_Wu32 4294967295.00 dez 0.00 4294967295.00 FORMAT "%13.2" /end CHARACTERISTIC
/begin CHARACTERISTIC HO1_WU.stInjPktVrntInst_C "selection injection packet variant and class instance / injection packet variant and class instance selector" VALUE 0x805596E0 RB_Val_Wu32 4294967295.00 dez 0.00 4294967295.00 FORMAT "%13.2" /end CHARACTERISTIC
/begin CHARACTERISTIC HO2.stInjPktVrntInst_C "selection injection packet variant and class instance / injection packet variant and class instance selector" VALUE 0x805596E4 RB_Val_Wu32 4294967295.00 dez 0.00 4294967295.00 FORMAT "%13.2" /end CHARACTERISTIC
/begin CHARACTERISTIC HO2_WU.stInjPktVrntInst_C "selection injection packet variant and class instance / injection packet variant and class instance selector" VALUE 0x805596E8 RB_Val_Wu32 4294967295.00 dez 0.00 4294967295.00 FORMAT "%13.2" /end CHARACTERISTIC
/begin CHARACTERISTIC HO3.stInjPktVrntInst_C "selection injection packet variant and class instance / injection packet variant and class instance selector" VALUE 0x805596EC RB_Val_Wu32 4294967295.00 dez 0.00 4294967295.00 FORMAT "%13.2" /end CHARACTERISTIC
/begin CHARACTERISTIC HO3_WU.stInjPktVrntInst_C "selection injection packet variant and class instance / injection packet variant and class instance selector" VALUE 0x805596F0 RB_Val_Wu32 4294967295.00 dez 0.00 4294967295.00 FORMAT "%13.2" /end CHARACTERISTIC
/begin CHARACTERISTIC HP2.stInjPktVrntInst_C "selection injection packet variant and class instance / injection packet variant and class instance selector" VALUE 0x805596F4 RB_Val_Wu32 4294967295.00 dez 0.00 4294967295.00 FORMAT "%13.2" /end CHARACTERISTIC
/begin CHARACTERISTIC HP2Z.stInjPktVrntInst_C "selection injection packet variant and class instance / injection packet variant and class instance selector" VALUE 0x805596F8 RB_Val_Wu32 4294967295.00 dez 0.00 4294967295.00 FORMAT "%13.2" /end CHARACTERISTIC
/begin CHARACTERISTIC HP2_CH.stInjPktVrntInst_C "selection injection packet variant and class instance / injection packet variant and class instance selector" VALUE 0x805596FC RB_Val_Wu32 4294967295.00 dez 0.00 4294967295.00 FORMAT "%13.2" /end CHARACTERISTIC
/begin CHARACTERISTIC HP3.stInjPktVrntInst_C "selection injection packet variant and class instance / injection packet variant and class instance selector" VALUE 0x80559700 RB_Val_Wu32 4294967295.00 dez 0.00 4294967295.00 FORMAT "%13.2" /end CHARACTERISTIC
/begin CHARACTERISTIC HP3Z.stInjPktVrntInst_C "selection injection packet variant and class instance / injection packet variant and class instance selector" VALUE 0x80559704 RB_Val_Wu32 4294967295.00 dez 0.00 4294967295.00 FORMAT "%13.2" /end CHARACTERISTIC
/begin CHARACTERISTIC HP3_CH.stInjPktVrntInst_C "selection injection packet variant and class instance / injection packet variant and class instance selector" VALUE 0x80559708 RB_Val_Wu32 4294967295.00 dez 0.00 4294967295.00 FORMAT "%13.2" /end CHARACTERISTIC
/begin CHARACTERISTIC InjDDGdi_cntSyncThresSWPMT_C "Number of synchro tasks, function updating injection begin angle at every crankshaft teeth should be active." VALUE 0x80506048 KwWU16 65535.00 dez 0.00 65535.00 FORMAT "%8.2" /end CHARACTERISTIC
/begin CHARACTERISTIC InjDDGdi_DurVlvOffTimeHigh_C "minimum valve turn-off time for angle based pulses and motor start" VALUE 0x80558484 RB_Val_Wu16 65.53500 t_q0p001_ms 0.00 65.53500 FORMAT "%8.5" /end CHARACTERISTIC
/begin CHARACTERISTIC InjDDGdi_DurVlvOffTimeLow_C "minimum valve turn-off time for pause time based pulses" VALUE 0x80558486 RB_Val_Wu16 65.53500 t_q0p001_ms 0.00 65.53500 FORMAT "%8.5" /end CHARACTERISTIC
/begin CHARACTERISTIC InjDDGdi_nEngThresEnaSWPMT_C "Engine speed threshold to deactivate frequent recalculation of injection begin angle." VALUE 0x8050604A KwWS16 32767.50 EngN -16384.00 16383.50 FORMAT "%8.2" /end CHARACTERISTIC
/begin CHARACTERISTIC injddgdi_phiMrgPstInjMX_C "angle till a post injection can be merged with a main injection" VALUE 0x8050604C KwWS32 720.000000000 AngleCrS 0.00 720.000000000 FORMAT "%13.9" EXTENDED_LIMITS -47185920.0000 47185919.9780 /end CHARACTERISTIC
/begin CHARACTERISTIC InjSys_agDeltaInjDyn_C "delta injection angle for dynamic" VALUE 0x8055972C RB_Val_Wu8 191.3 kw_q0p75 0.00 191.3 FORMAT "%5.1" /end CHARACTERISTIC
/begin CHARACTERISTIC InjSys_agInjEoiMin_M "Minimum angle of injection based on engine speed" MAP 0x80558488 RB_Map_S16U16_S16 1535.977 kw_q0p0234 -768.0000 767.9766 FORMAT "%8.4"
 /begin AXIS_DESCR STD_AXIS Epm_nEng EngN 3 -16384.00 16383.50 FORMAT "%8.2" DEPOSIT ABSOLUTE /end AXIS_DESCR
 /begin AXIS_DESCR STD_AXIS InjSys_ratAirChrgPredAddlCalcn rel_uw_q0p0234 3 0.00 1535.977 FORMAT "%8.3" DEPOSIT ABSOLUTE /end AXIS_DESCR
/end CHARACTERISTIC
/begin CHARACTERISTIC InjSys_agInjMax_M "maximum injection angle" MAP 0x8055972E RB_Map_S16S16_U8 191.3 kw_q0p75_o210 210.0 401.3 FORMAT "%5.1"
 /begin AXIS_DESCR STD_AXIS Epm_nEng EngN 8 -16384.00 16383.50 FORMAT "%8.2" DEPOSIT ABSOLUTE /end AXIS_DESCR
 /begin AXIS_DESCR STD_AXIS CEngDsT_t Temp_Cels 6 -3549.940 3003.560 FORMAT "%8.3" DEPOSIT ABSOLUTE /end AXIS_DESCR
/end CHARACTERISTIC
/begin CHARACTERISTIC InjSys_agProhbEnd_M "." MAP 0x8055977E RB_Map_S16U16_S16 1535.977 kw_q0p0234 -768.0000 767.9766 FORMAT "%8.4"
 /begin AXIS_DESCR STD_AXIS Epm_nEng EngN 6 -16384.00 16383.50 FORMAT "%8.2" DEPOSIT ABSOLUTE /end AXIS_DESCR
 /begin AXIS_DESCR STD_AXIS InjSys_ratAirmPrdcLocChk rel_uw_q0p0234 6 0.00 1535.977 FORMAT "%8.3" DEPOSIT ABSOLUTE /end AXIS_DESCR
/end CHARACTERISTIC
/begin CHARACTERISTIC InjSys_agProhbStbOffs_C "." VALUE 0x805597E2 RB_Val_Ws16 1535.977 kw_q0p0234 -768.0000 767.9766 FORMAT "%8.4" /end CHARACTERISTIC
/begin CHARACTERISTIC InjSys_agProhbStrt_M "." MAP 0x805597E4 RB_Map_S16U16_S16 1535.977 kw_q0p0234 -768.0000 767.9766 FORMAT "%8.4"
 /begin AXIS_DESCR STD_AXIS Epm_nEng EngN 6 -16384.00 16383.50 FORMAT "%8.2" DEPOSIT ABSOLUTE /end AXIS_DESCR
 /begin AXIS_DESCR STD_AXIS InjSys_ratAirmPrdcLocChk rel_uw_q0p0234 6 0.00 1535.977 FORMAT "%8.3" DEPOSIT ABSOLUTE /end AXIS_DESCR
/end CHARACTERISTIC
/begin CHARACTERISTIC InjSys_agSpDeDiagMax_C "maximum permitted injection angle deviation for diagnosis of injection timing" VALUE 0x805588D8 RB_Val_Ws16 1535.977 kw_q0p0234 -768.0000 767.9766 FORMAT "%8.4" /end CHARACTERISTIC
/begin CHARACTERISTIC InjSys_facAgMidPosnSel_C "Factor to select the middle angle between injection begin and end angle" VALUE 0x805584AA RB_Val_Wu8 0.9961 fak_ub_b1 0.00 0.9961 /end CHARACTERISTIC
/begin CHARACTERISTIC InjSys_facCorFuDens_T "Curve for fuel density correction factor." CURVE 0x80558800 RB_Curve_U8_U8 1.992188 fak_ub_b2 0.00 1.992188 FORMAT "%8.6"
 /begin AXIS_DESCR STD_AXIS InjSys_facFuDens fak_ub_b2 4 0.00 1.992188 FORMAT "%8.6" DEPOSIT ABSOLUTE /end AXIS_DESCR
/end CHARACTERISTIC
/begin CHARACTERISTIC InjSys_facEnaTPistCorrn_M "Engine speed and load based map for enabling the TSA feature" MAP 0x80559914 RB_Map_S16U16_U8 1.000 dez 0.00 1.000 FORMAT "%5.3" EXTENDED_LIMITS 0.00 255.0
 /begin AXIS_DESCR STD_AXIS Epm_nEng EngN 12 -16384.00 16383.50 FORMAT "%8.2" DEPOSIT ABSOLUTE /end AXIS_DESCR
 /begin AXIS_DESCR STD_AXIS rlp_w_msg rel_uw_q0p0234 12 0.00 1535.977 FORMAT "%8.3" DEPOSIT ABSOLUTE /end AXIS_DESCR
/end CHARACTERISTIC
/begin CHARACTERISTIC InjSys_facInjWinMax_C "Maximum factor for injection window" VALUE 0x805584AC RB_Val_Wu16 1.999969 fak_uw_b2 0.00 1.999969 FORMAT "%8.6" /end CHARACTERISTIC
/begin CHARACTERISTIC InjSys_facLimAirInjWinGain_C "Gain factor for limited air injection window" VALUE 0x805584AE RB_Val_Wu16 655.3500 t10msxs_uw_b655p35 0.00 655.3500 FORMAT "%8.4" /end CHARACTERISTIC
/begin CHARACTERISTIC InjSys_facLimAirInjWinMin_C "Minimum factor for limited air injection window" VALUE 0x805584B0 RB_Val_Ws16 1.000000 fak_sw_b2 0.00 1.000000 FORMAT "%8.6" EXTENDED_LIMITS -2.000000 1.999939 /end CHARACTERISTIC
/begin CHARACTERISTIC InjSys_facRatEngLoadEngWrmUp_T "weighting factor for relative engine load during engine warm up" CURVE 0x80558980 RB_Curve_S16_U16_Static 1.999969 fak_q3p0518Em5 0.00 1.999969 FORMAT "%8.6"
 /begin AXIS_DESCR STD_AXIS InjSys_tEng Temp_Cels 10 -3549.940 3003.560 FORMAT "%8.3" DEPOSIT ABSOLUTE /end AXIS_DESCR
/end CHARACTERISTIC
/begin CHARACTERISTIC InjSys_idxMaskCvo_C "CVO mask to release the injection measurement" VALUE 0x805584DC RB_Val_Wu16 65535.00 dez 0.00 65535.00 FORMAT "%8.2" /end CHARACTERISTIC
/begin CHARACTERISTIC InjSys_idxPPntTran_C "Index-point rail pressure transition range CVO" VALUE 0x805584DE RB_Val_Wu8 255.0 dez 0.00 255.0 FORMAT "%5.1" /end CHARACTERISTIC
/begin CHARACTERISTIC InjSys_nDeltaHysCvo_C "Delta hysteresis of engine speed for enabling CVO(Controlled Valve Operation)" VALUE 0x80558908 RB_Val_Ws16 32767.50 EngN -16384.00 16383.50 FORMAT "%8.2" /end CHARACTERISTIC
/begin AXIS_PTS InjSys_nEng08Vers2_AX "base point distribution for engine speed with 8 base points (version 2)" 0x805585D6 Epm_nEng RB_Axis_S16 16383.50 EngN 8 0.00 16383.50 FORMAT "%8.2" EXTENDED_LIMITS -16384.00 16383.50 DEPOSIT ABSOLUTE /end AXIS_PTS
/begin AXIS_PTS InjSys_nEng08_AX "base point distribution for engine speed with 8 base points" 0x805585E8 Epm_nEng RB_Axis_S16 16383.50 EngN 8 0.00 16383.50 FORMAT "%8.2" EXTENDED_LIMITS -16384.00 16383.50 DEPOSIT ABSOLUTE /end AXIS_PTS
/begin AXIS_PTS InjSys_nEng10Vers2_AX "base point distribution for engine speed with 10 base points (version 2)" 0x805585FA Epm_nEng RB_Axis_S16 16383.50 EngN 10 0.00 16383.50 FORMAT "%8.2" EXTENDED_LIMITS -16384.00 16383.50 DEPOSIT ABSOLUTE /end AXIS_PTS
/begin AXIS_PTS InjSys_nEng10_AX "base point distribution for engine speed with 10 base points" 0x80558610 Epm_nEng RB_Axis_S16 16383.50 EngN 10 0.00 16383.50 FORMAT "%8.2" EXTENDED_LIMITS -16384.00 16383.50 DEPOSIT ABSOLUTE /end AXIS_PTS
/begin AXIS_PTS InjSys_nEng12Hpx_AX "Base point distribution for engine speed HPx with 12 base points" 0x80558626 Epm_nEng RB_Axis_S16 16383.50 EngN 12 0.00 16383.50 FORMAT "%8.2" EXTENDED_LIMITS -16384.00 16383.50 DEPOSIT ABSOLUTE /end AXIS_PTS
/begin AXIS_PTS InjSys_nEng12HspVers2_AX "base point distribution for engine speed with 12 base points (Version 2 HSP Mode)" 0x80558640 Epm_nEng RB_Axis_S16 16383.50 EngN 12 0.00 16383.50 FORMAT "%8.2" EXTENDED_LIMITS -16384.00 16383.50 DEPOSIT ABSOLUTE /end AXIS_PTS
/begin AXIS_PTS InjSys_nEng12Hsp_AX "base point distribution for engine speed with 12 base points (HSP Mode)" 0x8055865A Epm_nEng RB_Axis_S16 16383.50 EngN 12 0.00 16383.50 FORMAT "%8.2" EXTENDED_LIMITS -16384.00 16383.50 DEPOSIT ABSOLUTE /end AXIS_PTS
/begin AXIS_PTS InjSys_nEng12Vers2_AX "base point distribution for engine speed with 10 base points (version 2)" 0x80558674 Epm_nEng RB_Axis_S16 16383.50 EngN 12 0.00 16383.50 FORMAT "%8.2" EXTENDED_LIMITS -16384.00 16383.50 DEPOSIT ABSOLUTE /end AXIS_PTS
/begin AXIS_PTS InjSys_nEng12_AX "base point distribution for engine speed with 12 base points" 0x8055868E Epm_nEng RB_Axis_S16 16383.50 EngN 12 0.00 16383.50 FORMAT "%8.2" EXTENDED_LIMITS -16384.00 16383.50 DEPOSIT ABSOLUTE /end AXIS_PTS
/begin CHARACTERISTIC InjSys_nEngHysDelta_C "hysteresis for engine speed" VALUE 0x805589AA RB_Val_Ws16 32767.50 EngN -16384.00 16383.50 FORMAT "%8.2" /end CHARACTERISTIC
/begin CHARACTERISTIC InjSys_nEngMaxInjCvo_M "map based on number of main injections and battery voltage CVO to update engine speed limit for basic adaption CVO" MAP 0x8055890A RB_Map_U8S16_S16 32767.50 EngN -16384.00 16383.50 FORMAT "%8.2"
 /begin AXIS_DESCR STD_AXIS InjSys_nrMaiInjCycCvo OneToOne 4 0.00 255.0 FORMAT "%5.1" DEPOSIT ABSOLUTE /end AXIS_DESCR
 /begin AXIS_DESCR STD_AXIS InjSys_uBattCvo Volt_Batt 2 0.00 655340.0 FORMAT "%8.1" EXTENDED_LIMITS -655360.0 655340.0 DEPOSIT ABSOLUTE /end AXIS_DESCR
/end CHARACTERISTIC
/begin CHARACTERISTIC InjSys_nEngMaxNrInjHys_C "Maximum engine speed threshold for the number of injections (hysteresis value for standby injection mode)" VALUE 0x80559848 RB_Val_Ws16 16383.50 EngN 0.00 16383.50 FORMAT "%8.2" EXTENDED_LIMITS -16384.00 16383.50 /end CHARACTERISTIC
/begin CHARACTERISTIC InjSys_nEngMaxNrInj_M "Maximum engine speed for number of main injections" MAP 0x8055984A RB_Map_U8S16_S16 16383.50 EngN 0.00 16383.50 FORMAT "%8.2" EXTENDED_LIMITS -16384.00 16383.50
 /begin AXIS_DESCR STD_AXIS InjSys_nrInjPhy dez 4 0.00 255.0 FORMAT "%5.1" DEPOSIT ABSOLUTE /end AXIS_DESCR
 /begin AXIS_DESCR STD_AXIS BattU_u Volt_Batt 4 -655360.0 655340.0 FORMAT "%8.1" DEPOSIT ABSOLUTE /end AXIS_DESCR
/end CHARACTERISTIC
/begin CHARACTERISTIC InjSys_nEngMaxRtOpt_C "engine speed threshold for runtime optimization" VALUE 0x8055967C RB_Val_Ws16 32767.50 EngN -16384.00 16383.50 FORMAT "%8.2" /end CHARACTERISTIC
/begin CHARACTERISTIC InjSys_nEngMinBascCvo_C "minimum engine speed for release of CVO basic adaption" VALUE 0x80558924 RB_Val_Ws16 32767.50 EngN -16384.00 16383.50 FORMAT "%8.2" /end CHARACTERISTIC
/begin CHARACTERISTIC InjSys_nLowrThdCvo_C "Lower speed threshold of CVO allowed range" VALUE 0x80558926 RB_Val_Ws16 32767.50 EngN -16384.00 16383.50 FORMAT "%8.2" /end CHARACTERISTIC
/begin CHARACTERISTIC InjSys_nMaxSysRelsCvoDelta_C "Hysteresis delta to engine speed threshold for deactivating the CVO(Controlled Valve Operation)" VALUE 0x80558928 RB_Val_Ws16 32767.50 EngN -16384.00 16383.50 FORMAT "%8.2" /end CHARACTERISTIC
/begin CHARACTERISTIC InjSys_nMaxSysRelsCvoThd_C "Engine speed thresold for deactivating the CVO" VALUE 0x8055892A RB_Val_Ws16 32767.50 EngN -16384.00 16383.50 FORMAT "%8.2" /end CHARACTERISTIC
/begin AXIS_PTS InjSys_nrInj04_AX "Base point distribution number of injections with 4 base points" 0x805586A8 InjSys_nrInjLimdLoc RB_Axis_U16 65535.00 dez 4 0.00 65535.00 FORMAT "%8.2" DEPOSIT ABSOLUTE /end AXIS_PTS
/begin AXIS_PTS InjSys_nrInj08_AX "Base point distribution number of injections with 8 base points" 0x805586B2 InjSys_nrInjLimdLoc RB_Axis_U16 65535.00 dez 8 0.00 65535.00 FORMAT "%8.2" DEPOSIT ABSOLUTE /end AXIS_PTS
/begin CHARACTERISTIC InjSys_nrInjGapCvo_C "number of normal injections between two CVO-injections" VALUE 0x8055892C RB_Val_Wu8 255.0 dez 0.00 255.0 FORMAT "%5.1" /end CHARACTERISTIC
/begin CHARACTERISTIC InjSys_nrMinCmbCsers_C "Minimal Number of combustions under active CSERS Measures" VALUE 0x805588CE RB_Val_Wu16 65535.00 OneToOne 0.00 65535.00 FORMAT "%8.2" /end CHARACTERISTIC
/begin CHARACTERISTIC InjSys_nrMinCmbMulInj_C "Minimal Number of combustions under active multiple injection Measures" VALUE 0x805588D0 RB_Val_Wu16 65535.00 OneToOne 0.00 65535.00 FORMAT "%8.2" /end CHARACTERISTIC
/begin CHARACTERISTIC InjSys_nrPVcosPrioCvo1_GT "CVO adaptation pressure priority for viscosity step 1 array" CURVE 0x805584DF RB_CurveGroup_U8 10.00 dez 0.00 10.00 FORMAT "%5.2" EXTENDED_LIMITS 0.00 255.0
 /begin AXIS_DESCR COM_AXIS InjSys_pPRailCvoExtdRng RBPtCel_p_0p002_1 5 0.00 131.0700 FORMAT "%8.4" AXIS_PTS_REF InjSys_pCvoExtdRng_Ax /end AXIS_DESCR
/end CHARACTERISTIC
/begin CHARACTERISTIC InjSys_nrPVcosPrioCvo2_GT "CVO adaptation pressure priority for viscosity step 2 array" CURVE 0x805584E4 RB_CurveGroup_U8 10.00 dez 0.00 10.00 FORMAT "%5.2" EXTENDED_LIMITS 0.00 255.0
 /begin AXIS_DESCR COM_AXIS InjSys_pPRailCvoExtdRng RBPtCel_p_0p002_1 5 0.00 131.0700 FORMAT "%8.4" AXIS_PTS_REF InjSys_pCvoExtdRng_Ax /end AXIS_DESCR
/end CHARACTERISTIC
/begin CHARACTERISTIC InjSys_nrPVcosPrioCvo3_GT "CVO adaptation pressure priority for viscosity step 3 array" CURVE 0x805584E9 RB_CurveGroup_U8 10.00 dez 0.00 10.00 FORMAT "%5.2" EXTENDED_LIMITS 0.00 255.0
 /begin AXIS_DESCR COM_AXIS InjSys_pPRailCvoExtdRng RBPtCel_p_0p002_1 5 0.00 131.0700 FORMAT "%8.4" AXIS_PTS_REF InjSys_pCvoExtdRng_Ax /end AXIS_DESCR
/end CHARACTERISTIC
/begin CHARACTERISTIC InjSys_nrPVcosPrioCvo4_GT "CVO adaptation pressure priority for viscosity step 4 array" CURVE 0x805584EE RB_CurveGroup_U8 10.00 dez 0.00 10.00 FORMAT "%5.2" EXTENDED_LIMITS 0.00 255.0
 /begin AXIS_DESCR COM_AXIS InjSys_pPRailCvoExtdRng RBPtCel_p_0p002_1 5 0.00 131.0700 FORMAT "%8.4" AXIS_PTS_REF InjSys_pCvoExtdRng_Ax /end AXIS_DESCR
/end CHARACTERISTIC
/begin CHARACTERISTIC InjSys_nrPVcosPrioCvo5_GT "CVO adaptation pressure priority for viscosity step 5 array" CURVE 0x805584F3 RB_CurveGroup_U8 10.00 dez 0.00 10.00 FORMAT "%5.2" EXTENDED_LIMITS 0.00 255.0
 /begin AXIS_DESCR COM_AXIS InjSys_pPRailCvoExtdRng RBPtCel_p_0p002_1 5 0.00 131.0700 FORMAT "%8.4" AXIS_PTS_REF InjSys_pCvoExtdRng_Ax /end AXIS_DESCR
/end CHARACTERISTIC
/begin CHARACTERISTIC InjSys_nrPVcosPrioCvo6_GT "CVO adaptation pressure priority for viscosity step 6 array" CURVE 0x805584F8 RB_CurveGroup_U8 10.00 dez 0.00 10.00 FORMAT "%5.2" EXTENDED_LIMITS 0.00 255.0
 /begin AXIS_DESCR COM_AXIS InjSys_pPRailCvoExtdRng RBPtCel_p_0p002_1 5 0.00 131.0700 FORMAT "%8.4" AXIS_PTS_REF InjSys_pCvoExtdRng_Ax /end AXIS_DESCR
/end CHARACTERISTIC
/begin CHARACTERISTIC InjSys_nrTstrMedPrioUrgCvo_C "needed priority for DSM to run CVO-function with midle priority" VALUE 0x8055892D RB_Val_Wu8 255.0 dez 0.00 255.0 FORMAT "%5.1" /end CHARACTERISTIC
/begin CHARACTERISTIC InjSys_nrTstrUrgCvo_C "needed priority for DSM to run CVO-function with high priority" VALUE 0x8055892E RB_Val_Wu8 255.0 dez 0.00 255.0 FORMAT "%5.1" /end CHARACTERISTIC
/begin CHARACTERISTIC InjSys_nUpprThdCvo_C "Upper speed threshold of CVO allowed range" VALUE 0x80558930 RB_Val_Ws16 32767.50 EngN -16384.00 16383.50 FORMAT "%8.2" /end CHARACTERISTIC
/begin CHARACTERISTIC InjSys_P1APPL.agAux1_C "class instance packet 1 for calibration / angle auxiliary injection 1" VALUE 0x80563218 RB_Val_Ws16 1535.977 kw_q0p0234 -768.0000 767.9766 FORMAT "%8.4" /end CHARACTERISTIC
/begin CHARACTERISTIC InjSys_P1APPL.agAux2_C "class instance packet 1 for calibration / angle auxiliary injection 2" VALUE 0x8056321A RB_Val_Ws16 1535.977 kw_q0p0234 -768.0000 767.9766 FORMAT "%8.4" /end CHARACTERISTIC
/begin AXIS_PTS InjSys_pCvoExtdRng_Ax "CVO rail pressure group points" 0x805584FE InjSys_pPRailCvoExtdRng RB_Axis_U16 131.0700 RBPtCel_p_0p002_1 5 0.00 131.0700 FORMAT "%8.4" DEPOSIT ABSOLUTE /end AXIS_PTS
/begin CHARACTERISTIC InjSys_pDeltaOperCvoExtdRng_C "CVO operation pressure range around the pressure interpolation point" VALUE 0x8055850A RB_Val_Wu16 131.0700 RBPtCel_p_0p002_1 0.00 131.0700 FORMAT "%8.4" /end CHARACTERISTIC
/begin CHARACTERISTIC InjSys_pFuRailMinEnaCvo_C "CVO enable threshold to avoid adaption and crontrol in the fuel rail low pressure area" VALUE 0x80558932 RB_Val_Wu16 32.76750 q0p0005_MPa_DIV_rev 0.00 32.76750 FORMAT "%8.5" /end CHARACTERISTIC
/begin CHARACTERISTIC InjSys_pNoInjCnclStrt_C "Rail-pressure threshold for injection abort during engine start for GDI" VALUE 0x805584B2 RB_Val_Wu16 131.0700 RBPtCel_p_0p002_1 0.00 131.0700 FORMAT "%8.4" /end CHARACTERISTIC
/begin AXIS_PTS InjSys_ratAirChrgStrt8_AX "base point distribution relative air mass with 8 base points" 0x805586C4 InjSys_ratAirChrgPredLoc RB_Axis_U16 1535.977 rel_uw_q0p0234 8 0.00 1535.977 FORMAT "%8.3" DEPOSIT ABSOLUTE /end AXIS_PTS
/begin AXIS_PTS InjSys_ratAirM08Vers2_AX "base point distribution relative air mass with 8 base points" 0x805586D6 InjSys_ratAirMVers2AxisInp RB_Axis_U16 1535.977 rel_uw_q0p0234 8 0.00 1535.977 FORMAT "%8.3" DEPOSIT ABSOLUTE /end AXIS_PTS
/begin AXIS_PTS InjSys_ratAirM08_AX "base point distribution relative air mass with 8 base points" 0x805586E8 InjSys_ratAirMAxisInp RB_Axis_U16 1535.977 rel_uw_q0p0234 8 0.00 1535.977 FORMAT "%8.3" DEPOSIT ABSOLUTE /end AXIS_PTS
/begin AXIS_PTS InjSys_ratAirM12AgSpHspVers2_AX "base point distribution relative air mass with 12 base points (Version 2 HSP Mode)" 0x805586FA InjSys_ratAirMAgSpVers2AxisInp RB_Axis_U16 1535.977 rel_uw_q0p0234 12 0.00 1535.977 FORMAT "%8.3" DEPOSIT ABSOLUTE /end AXIS_PTS
/begin AXIS_PTS InjSys_ratAirM12AgSpHsp_AX "base point distribution relative air mass with 12 base points (HSP Mode)" 0x80558714 InjSys_ratAirMAgSpAxisInp RB_Axis_U16 1535.977 rel_uw_q0p0234 12 0.00 1535.977 FORMAT "%8.3" DEPOSIT ABSOLUTE /end AXIS_PTS
/begin AXIS_PTS InjSys_ratAirM12AgSpVers2_AX "base point distribution relative air mass with 12 base points" 0x8055872E InjSys_ratAirMAgSpVers2AxisInp RB_Axis_U16 1535.977 rel_uw_q0p0234 12 0.00 1535.977 FORMAT "%8.3" DEPOSIT ABSOLUTE /end AXIS_PTS
/begin AXIS_PTS InjSys_ratAirM12AgSp_AX "base point distribution relative air mass with 12 base points" 0x80558748 InjSys_ratAirMAgSpAxisInp RB_Axis_U16 1535.977 rel_uw_q0p0234 12 0.00 1535.977 FORMAT "%8.3" DEPOSIT ABSOLUTE /end AXIS_PTS
/begin AXIS_PTS InjSys_ratAirM12Hpx_AX "base point distribution relative air mass HPx with 12 base points" 0x80558762 InjSys_ratAirMAxisInp RB_Axis_U16 1535.977 rel_uw_q0p0234 12 0.00 1535.977 FORMAT "%8.3" DEPOSIT ABSOLUTE /end AXIS_PTS
/begin AXIS_PTS InjSys_ratAirM12Vers2_AX "base point distribution relative air mass with 12 base points" 0x8055877C InjSys_ratAirMVers2AxisInp RB_Axis_U16 1535.977 rel_uw_q0p0234 12 0.00 1535.977 FORMAT "%8.3" DEPOSIT ABSOLUTE /end AXIS_PTS
/begin AXIS_PTS InjSys_ratAirM12_AX "base point distribution relative air mass with 12 base points" 0x80558796 InjSys_ratAirMAxisInp RB_Axis_U16 1535.977 rel_uw_q0p0234 12 0.00 1535.977 FORMAT "%8.3" DEPOSIT ABSOLUTE /end AXIS_PTS
/begin CHARACTERISTIC InjSys_ratCmbErrCsersMax_C "Permitted fault ratio for CSERS diagnosis" VALUE 0x805588D2 RB_Val_Wu16 1.999969 fak_uw_b2 0.00 1.999969 FORMAT "%8.6" /end CHARACTERISTIC
/begin CHARACTERISTIC InjSys_ratCmbErrMulInjMax_C "Permitted fault ratio for multiple injection diagnosis" VALUE 0x805588D4 RB_Val_Wu16 1.999969 fak_uw_b2 0.00 1.999969 FORMAT "%8.6" /end CHARACTERISTIC
/begin CHARACTERISTIC InjSys_ratEngLoadHysDelta_C "hysteresis for relative engine load" VALUE 0x805589AC RB_Val_Wu16 1535.977 rel_uw_q0p0234 0.00 1535.977 FORMAT "%8.3" /end CHARACTERISTIC
/begin CHARACTERISTIC InjSys_ratEthPrtnBascFu_C "Ethanol content of the basic fuel" VALUE 0x8055880A RB_Val_Wu16 99.99847 rel_uw_b100 0.00 99.99847 FORMAT "%8.5" /end CHARACTERISTIC
/begin CHARACTERISTIC InjSys_ratEthPrtnMaxEthFu_C "Ethanol content of the fuel with maximum ethanol content" VALUE 0x8055880C RB_Val_Wu16 99.99847 rel_uw_b100 0.00 99.99847 FORMAT "%8.5" /end CHARACTERISTIC
/begin CHARACTERISTIC InjSys_ratFuMDeltaCvo_C "Hysterese delta value for minimal relative fuel charge during CVO basic adaption" VALUE 0x80558934 RB_Val_Wu16 3071.953 rel_uw_b3072 0.00 3071.953 FORMAT "%8.3" /end CHARACTERISTIC
/begin CHARACTERISTIC InjSys_ratFuMMinCvo_C "Minimal relative fuel charge during CVO basic adaption" VALUE 0x80558936 RB_Val_Wu16 3071.953 rel_uw_b3072 0.00 3071.953 FORMAT "%8.3" /end CHARACTERISTIC
/begin CHARACTERISTIC InjSys_ratStoicEthnl_T "Stoichiometric air-fuel ratio depending on Correction factor fuel blend for injection time" CURVE 0x8055880E RB_Curve_U16_U16 31.99951 fak_q0p000488 0.00 31.99951 FORMAT "%8.5"
 /begin AXIS_DESCR STD_AXIS InjSys_facFuInjTi fak_uw_b2 5 0.00 1.999969 FORMAT "%8.6" DEPOSIT ABSOLUTE /end AXIS_DESCR
/end CHARACTERISTIC
/begin CHARACTERISTIC InjSys_ratStoic_T "Stoichiometric air-fuel ratio depending on ethanol content" CURVE 0x80558824 RB_Curve_U16_U16 31.99951 fak_q0p000488 0.00 31.99951 FORMAT "%8.5"
 /begin AXIS_DESCR STD_AXIS InjSys_ratEthPrtnMaxEthFu rel_uw_b100 8 0.00 99.99847 FORMAT "%8.5" DEPOSIT ABSOLUTE /end AXIS_DESCR
/end CHARACTERISTIC
/begin CHARACTERISTIC InjSys_relFillgCvoMax_C "Maximal relative air charge during CVO basic adaption" VALUE 0x80558938 RB_Val_Wu16 1535.977 rel_q0p0234 0.00 1535.977 FORMAT "%8.3" /end CHARACTERISTIC
/begin CHARACTERISTIC InjSys_rhoAir_C "density air" VALUE 0x80558846 RB_Val_Wu16 15.99976 m_q2p44em4 0.00 15.99976 FORMAT "%8.5" /end CHARACTERISTIC
/begin CHARACTERISTIC InjSys_rhoFuEthnlStd_T "Fuel density at standard conditions" CURVE 0x80558848 RB_Curve_U16_U16 6553.500 m_q0p1_g_DIV_L 0.00 6553.500 FORMAT "%8.3"
 /begin AXIS_DESCR STD_AXIS InjSys_facEthnlCurr fak_uw_b2 5 0.00 1.999969 FORMAT "%8.6" DEPOSIT ABSOLUTE /end AXIS_DESCR
/end CHARACTERISTIC
/begin CHARACTERISTIC InjSys_rhoFuPTCor_M "Pressure correction of the fuel density" MAP 0x8055885E RB_Map_U16U8_U16 1.999969 fak_uw_b2 0.00 1.999969 FORMAT "%8.6"
 /begin AXIS_DESCR STD_AXIS InjSys_pFu RBPtCel_p_0p002_1 3 0.00 131.0700 FORMAT "%8.4" DEPOSIT ABSOLUTE /end AXIS_DESCR
 /begin AXIS_DESCR STD_AXIS InjSys_tFu temp_ub_q0p75_o48 4 -48.0 143.3 FORMAT "%5.1" DEPOSIT ABSOLUTE /end AXIS_DESCR
/end CHARACTERISTIC
/begin CHARACTERISTIC InjSys_rhoFuStd_T "Fuel density at standard conditions" CURVE 0x80558884 RB_Curve_U16_U16 6553.500 m_q0p1_g_DIV_L 0.00 6553.500 FORMAT "%8.3"
 /begin AXIS_DESCR STD_AXIS InjSys_ratEthPrtnMaxEthFu rel_uw_b100 5 0.00 99.99847 FORMAT "%8.5" DEPOSIT ABSOLUTE /end AXIS_DESCR
/end CHARACTERISTIC
/begin CHARACTERISTIC InjSys_rhoFu_M "Fuel density depending on ethanol content and temperature of the fuel" MAP 0x8055889A RB_Map_U16U8_U16 6553.500 m_q0p1_g_DIV_L 0.00 6553.500 FORMAT "%8.3"
 /begin AXIS_DESCR STD_AXIS InjSys_ratEthPrtnFuPerc rel_uw_b100 4 0.00 99.99847 FORMAT "%8.5" DEPOSIT ABSOLUTE /end AXIS_DESCR
 /begin AXIS_DESCR STD_AXIS InjSys_tFu temp_ub_q0p75_o48 4 -48.0 143.3 FORMAT "%5.1" DEPOSIT ABSOLUTE /end AXIS_DESCR
/end CHARACTERISTIC
/begin CHARACTERISTIC InjSys_stAddlCalcn_C "code word of FC InjSyG_AddlCalcn" VALUE 0x805584B4 RB_Val_Wu8 255.0 dez 0.00 255.0 FORMAT "%5.1" /end CHARACTERISTIC
/begin CHARACTERISTIC InjSys_stAirMAgSpHspVers1Sel_C "switch to select input interface for InjSys_ratAirM12AgSpHsp_AX" VALUE 0x805587B0 RB_Val_Wu8 255.0 OneToOne 0.00 255.0 FORMAT "%5.1" /end CHARACTERISTIC
/begin CHARACTERISTIC InjSys_stAirMAgSpHspVers2Sel_C "switch to select input interface for IInjSys_ratAirM12AgSpHspVers2_AX" VALUE 0x805587B1 RB_Val_Wu8 255.0 OneToOne 0.00 255.0 FORMAT "%5.1" /end CHARACTERISTIC
/begin CHARACTERISTIC InjSys_stAirMAgSpVers1Sel_C "switch to select input interface for InjSys_ratAirM12AgSp_AX" VALUE 0x805587B2 RB_Val_Wu8 255.0 OneToOne 0.00 255.0 FORMAT "%5.1" /end CHARACTERISTIC
/begin CHARACTERISTIC InjSys_stAirMAgSpVers2Sel_C "switch to select input interface for IInjSys_ratAirM12AgSpVers2_AX" VALUE 0x805587B3 RB_Val_Wu8 255.0 OneToOne 0.00 255.0 FORMAT "%5.1" /end CHARACTERISTIC
/begin CHARACTERISTIC InjSys_stAirMSel_C "switch to select input interface for InjSys_ratAirM08_AX and InjSys_ratAirM12_AX" VALUE 0x805587B4 RB_Val_Wu8 255.0 OneToOne 0.00 255.0 FORMAT "%5.1" /end CHARACTERISTIC
/begin CHARACTERISTIC InjSys_stAirMVers2Sel_C "switch to select input interface for InjSys_ratAirM08Vers2_AX and InjSys_ratAirM12Vers2_AX" VALUE 0x805587B5 RB_Val_Wu8 255.0 OneToOne 0.00 255.0 FORMAT "%5.1" /end CHARACTERISTIC
/begin CHARACTERISTIC InjSys_stAllwdModCvo_C "CVO codeword to allow the engine operation mode for adaption" VALUE 0x8055893C RB_Val_Wu32 4294967295.00 OneToOne 0.00 4294967295.00 FORMAT "%13.2" /end CHARACTERISTIC
/begin CHARACTERISTIC InjSys_stAllwdStgCvo_C "CVO codeword to define the engine operation stage for adaption" VALUE 0x80558940 RB_Val_Wu16 65535.00 OneToOne 0.00 65535.00 FORMAT "%8.2" /end CHARACTERISTIC
/begin CHARACTERISTIC InjSys_stCalcInjModDft_C "default subcoordinator for injection modes" VALUE 0x805589AE RB_Val_Wu8 4.00000000000 InjSys_CalcInjMod_Set_COMPU_VERB 0.00 4.00000000000 FORMAT "%13.11" /end CHARACTERISTIC
/begin CHARACTERISTIC InjSys_stCatHeatgDiag_C "Codeword for diagnosis catalyst heating with multiple injection" VALUE 0x805588D6 RB_Val_Wu8 255.0 dez 0.00 255.0 FORMAT "%5.1" /end CHARACTERISTIC
/begin CHARACTERISTIC InjSys_stChkAgRng_T "." CURVE 0x80559878 RB_Curve_U8_U8 255.0 dez 0.00 255.0 FORMAT "%5.1"
 /begin AXIS_DESCR STD_AXIS InjSys_stInjMod InjSys_InjMode_Set_COMPU_VERB 20 0.00 19.0000000000 FORMAT "%13.10" DEPOSIT ABSOLUTE /end AXIS_DESCR
/end CHARACTERISTIC
/begin CHARACTERISTIC InjSys_stChkInjModDiag_GT "state injection mode for diagnosis check" CURVE 0x805588DA RB_CurveGroup_U8 1.000 dez 0.00 1.000 FORMAT "%5.3" EXTENDED_LIMITS 0.00 255.0
 /begin AXIS_DESCR COM_AXIS NO_INPUT_QUANTITY InjSys_InjMode_Set_COMPU_VERB 20 0.00 19.0000000000 FORMAT "%13.10" AXIS_PTS_REF InjSys_stInjMod_AX /end AXIS_DESCR
/end CHARACTERISTIC
/begin CHARACTERISTIC InjSys_stChkInjModMplInj_GT "state injection mode for multiple injection mode diagnosis check" CURVE 0x805588EE RB_CurveGroup_U8 1.000 dez 0.00 1.000 FORMAT "%5.3" EXTENDED_LIMITS 0.00 255.0
 /begin AXIS_DESCR COM_AXIS NO_INPUT_QUANTITY InjSys_InjMode_Set_COMPU_VERB 20 0.00 19.0000000000 FORMAT "%13.10" AXIS_PTS_REF InjSys_stInjMod_AX /end AXIS_DESCR
/end CHARACTERISTIC
/begin CHARACTERISTIC InjSys_stChkTiInjOpen_T "configuration injection open time check" CURVE 0x805598A1 RB_Curve_U8_U8 255.0 dez 0.00 255.0 FORMAT "%5.1"
 /begin AXIS_DESCR STD_AXIS InjSys_stInjMod InjSys_InjMode_Set_COMPU_VERB 20 0.00 19.0000000000 FORMAT "%13.10" DEPOSIT ABSOLUTE /end AXIS_DESCR
/end CHARACTERISTIC
/begin CHARACTERISTIC InjSys_stCoApplCvo_C "CVO codeword for application control" VALUE 0x80558942 RB_Val_Wu8 255.0 dez 0.00 255.0 FORMAT "%5.1" /end CHARACTERISTIC
/begin CHARACTERISTIC InjSys_stEom2stCalcInjModDyn_I.OperMod2Val_GT "instance selection subcoordinator for injection modes / Curve for the mapping of group axis" CURVE 0x80559600 RB_CurveGroup_U8 4.00000000000 InjSys_CalcInjMod_Set_COMPU_VERB 0.00 4.00000000000 FORMAT "%13.11"
 /begin AXIS_DESCR COM_AXIS NO_INPUT_QUANTITY CoEOM_stEomStgTot_VERB 26 0.00 7951.00000000 FORMAT "%13.8" AXIS_PTS_REF CoEOM_stEomDesReqd_AX /end AXIS_DESCR
/end CHARACTERISTIC
/begin CHARACTERISTIC InjSys_stEom2stCalcInjMod_I.OperMod2Val_GT "instance selection subcoordinator for injection modes / Curve for the mapping of group axis" CURVE 0x80559620 RB_CurveGroup_U8 4.00000000000 InjSys_CalcInjMod_Set_COMPU_VERB 0.00 4.00000000000 FORMAT "%13.11"
 /begin AXIS_DESCR COM_AXIS NO_INPUT_QUANTITY CoEOM_stEomStgTot_VERB 26 0.00 7951.00000000 FORMAT "%13.8" AXIS_PTS_REF CoEOM_stEomDesReqd_AX /end AXIS_DESCR
/end CHARACTERISTIC
/begin CHARACTERISTIC InjSys_stEom2stInjMod_I.OperMod2Val_GT "instance selection injection mode / Curve for the mapping of group axis" CURVE 0x80559640 RB_CurveGroup_U8 19.0000000000 InjSys_InjMode_Set_COMPU_VERB 0.00 19.0000000000 FORMAT "%13.10"
 /begin AXIS_DESCR COM_AXIS NO_INPUT_QUANTITY CoEOM_stEomStgTot_VERB 26 0.00 7951.00000000 FORMAT "%13.8" AXIS_PTS_REF CoEOM_stEomDesReqd_AX /end AXIS_DESCR
/end CHARACTERISTIC
/begin CHARACTERISTIC InjSys_stEom2stSngMpg_I.OperMod2Val_GT "instance selection single mapping of injection mode / Curve for the mapping of group axis" CURVE 0x80559660 RB_CurveGroup_U8 255.0 dez 0.00 255.0 FORMAT "%5.1"
 /begin AXIS_DESCR COM_AXIS NO_INPUT_QUANTITY CoEOM_stEomStgTot_VERB 26 0.00 7951.00000000 FORMAT "%13.8" AXIS_PTS_REF CoEOM_stEomDesReqd_AX /end AXIS_DESCR
/end CHARACTERISTIC
/begin CHARACTERISTIC InjSys_stEomReqCvo_C "CVO codeword to request the engine operation mode for adaption" VALUE 0x80558943 RB_Val_Wu8 255.0 dez 0.00 255.0 FORMAT "%5.1" /end CHARACTERISTIC
/begin CHARACTERISTIC InjSys_stFastStrtInjMod_T "curve injection mode fast start" CURVE 0x805589B0 RB_Curve_U16_U8_Static 19.0000000000 InjSys_InjMode_Set_COMPU_VERB 0.00 19.0000000000 FORMAT "%13.10"
 /begin AXIS_DESCR STD_AXIS InjSys_stStrtReq ENGSTRT_STSTRTREQ_SET_COMPU_VERB 19 0.00 32770.0000000 FORMAT "%13.7" DEPOSIT ABSOLUTE /end AXIS_DESCR
/end CHARACTERISTIC
/begin CHARACTERISTIC InjSys_stFastStrtReq_T "Table fast start request" CURVE 0x805589EC RB_Curve_U16_U8_Static 255.0 dez 0.00 255.0 FORMAT "%5.1"
 /begin AXIS_DESCR STD_AXIS InjSys_stStrtReq ENGSTRT_STSTRTREQ_SET_COMPU_VERB 19 0.00 32770.0000000 FORMAT "%13.7" DEPOSIT ABSOLUTE /end AXIS_DESCR
/end CHARACTERISTIC
/begin CHARACTERISTIC InjSys_stGdiOff_C "state GDI off" VALUE 0x8055967E RB_Val_Wu8 19.0000000000 InjSys_InjMode_Set_COMPU_VERB 0.00 19.0000000000 FORMAT "%13.10" /end CHARACTERISTIC
/begin CHARACTERISTIC InjSys_stHiPrioReqCvo_C "CVO codeword to request a higher priority for adaption" VALUE 0x80558944 RB_Val_Wu8 255.0 dez 0.00 255.0 FORMAT "%5.1" /end CHARACTERISTIC
/begin CHARACTERISTIC InjSys_stInjChk_C "codeword for function InjChk" VALUE 0x805598CA RB_Val_Wu8 255.0 dez 0.00 255.0 FORMAT "%5.1" /end CHARACTERISTIC
/begin CHARACTERISTIC InjSys_stInjModAltv_T "alternative injection mode" CURVE 0x80558A28 RB_Curve_U8_U8 19.0000000000 InjSys_InjMode_Set_COMPU_VERB 0.00 19.0000000000 FORMAT "%13.10"
 /begin AXIS_DESCR STD_AXIS InjSys_stInjModTarRaw InjSys_InjMode_Set_COMPU_VERB 20 0.00 19.0000000000 FORMAT "%13.10" DEPOSIT ABSOLUTE /end AXIS_DESCR
/end CHARACTERISTIC
/begin CHARACTERISTIC InjSys_stInjModAppl_C "codeword injection mode application interface" VALUE 0x8055967F RB_Val_Wu8 255.0 dez 0.00 255.0 FORMAT "%5.1" /end CHARACTERISTIC
/begin CHARACTERISTIC InjSys_stInjModDft_C "default injection mode" VALUE 0x80558A51 RB_Val_Wu8 19.0000000000 InjSys_InjMode_Set_COMPU_VERB 0.00 19.0000000000 FORMAT "%13.10" /end CHARACTERISTIC
/begin AXIS_PTS InjSys_stInjModStb_AX "base point distribution standby injection mode" 0x80559680 InjSys_stInjModStbTarLoc RB_Axis_U8 19.0000000000 InjSys_InjMode_Set_COMPU_VERB 20 0.00 19.0000000000 FORMAT "%13.10" DEPOSIT ABSOLUTE /end AXIS_PTS
/begin CHARACTERISTIC InjSys_stInjModStb_C "constant injection mode standby" VALUE 0x80559695 RB_Val_Wu8 19.0000000000 InjSys_InjMode_Set_COMPU_VERB 0.00 19.0000000000 FORMAT "%13.10" /end CHARACTERISTIC
/begin CHARACTERISTIC InjSys_stInjModTarAppl_C "Injection mode coordinator codeword" VALUE 0x80558A52 RB_Val_Wu8 255.0 OneToOne 0.00 255.0 FORMAT "%5.1" /end CHARACTERISTIC
/begin CHARACTERISTIC InjSys_stInjModTarStb_C "Standby Injection mode target selection parameter" VALUE 0x80558A53 RB_Val_Wu8 19.0000000000 InjSys_InjMode_Set_COMPU_VERB 0.00 19.0000000000 FORMAT "%13.10" /end CHARACTERISTIC
/begin CHARACTERISTIC InjSys_stInjModTar_C "constant injection mode target" VALUE 0x80558A54 RB_Val_Wu8 19.0000000000 InjSys_InjMode_Set_COMPU_VERB 0.00 19.0000000000 FORMAT "%13.10" /end CHARACTERISTIC
/begin CHARACTERISTIC InjSys_stInjModTyp_T "curve injection mode type" CURVE 0x80559696 RB_CurveGroup_U16 65535.00 dez 0.00 65535.00 FORMAT "%8.2"
 /begin AXIS_DESCR COM_AXIS NO_INPUT_QUANTITY InjSys_InjMode_Set_COMPU_VERB 20 0.00 19.0000000000 FORMAT "%13.10" AXIS_PTS_REF InjSys_stInjMod_AX /end AXIS_DESCR
/end CHARACTERISTIC
/begin AXIS_PTS InjSys_stInjMod_AX "base point distribution current injection mode" 0x805596BE NO_INPUT_QUANTITY RB_Axis_U8 19.0000000000 InjSys_InjMode_Set_COMPU_VERB 20 0.00 19.0000000000 FORMAT "%13.10" DEPOSIT ABSOLUTE /end AXIS_PTS
/begin CHARACTERISTIC InjSys_stInjMod_C "parameter injection mode" VALUE 0x805596D3 RB_Val_Wu8 19.0000000000 InjSys_InjMode_Set_COMPU_VERB 0.00 19.0000000000 FORMAT "%13.10" /end CHARACTERISTIC
/begin CHARACTERISTIC InjSys_stOilTSel_C "switch to select oil temperature" VALUE 0x805587B6 RB_Val_Wboolean 1.00000000000 B_TRUE 0.00 1.00000000000 FORMAT "%13.11" /end CHARACTERISTIC
/begin CHARACTERISTIC InjSys_stOperModCvo_C "CVO codeword to define the engine operation mode for adaption" VALUE 0x80558948 RB_Val_Wu32 4294967295.00 OneToOne 0.00 4294967295.00 FORMAT "%13.2" /end CHARACTERISTIC
/begin CHARACTERISTIC InjSys_stOperModHiPrioCvo_C "CVO codeword to define the engine operation mode for adaption with higher priority" VALUE 0x8055894C RB_Val_Wu32 4294967295.00 OneToOne 0.00 4294967295.00 FORMAT "%13.2" /end CHARACTERISTIC
/begin CHARACTERISTIC InjSys_stOperModPrioCvo_C "Priority of engine operation mode request during Controlled Valve Operation (CVO) base adaptation" VALUE 0x80558950 RB_Val_Wu8 255.0 OneToOne 0.00 255.0 FORMAT "%5.1" /end CHARACTERISTIC
/begin CHARACTERISTIC InjSys_stOperModPrioHiPrioCvo_C "Priority of engine operation mode request during high priority CVO(Controlled Valve Operation) base adaptation" VALUE 0x80558951 RB_Val_Wu8 255.0 OneToOne 0.00 255.0 FORMAT "%5.1" /end CHARACTERISTIC
/begin CHARACTERISTIC InjSys_stOperModStgCvo_C "Mask for allowed engine operation mode stages during Controlled Valve Operation (CVO) base adaptation" VALUE 0x80558952 RB_Val_Wu16 65535.00 OneToOne 0.00 65535.00 FORMAT "%8.2" /end CHARACTERISTIC
/begin CHARACTERISTIC InjSys_stOperModStgHiPrioCvo_C "Mask for allowed engine operation mode stages during high priority CVO(Controlled Valve Operation) base adaptation" VALUE 0x80558954 RB_Val_Wu16 65535.00 OneToOne 0.00 65535.00 FORMAT "%8.2" /end CHARACTERISTIC
/begin CHARACTERISTIC InjSys_stStrtReq2InjMod_T "map start request to injection mode" CURVE 0x80558A56 RB_Curve_U16_U8_Static 19.0000000000 InjSys_InjMode_Set_COMPU_VERB 0.00 19.0000000000 FORMAT "%13.10"
 /begin AXIS_DESCR STD_AXIS InjSys_stStrtReq ENGSTRT_STSTRTREQ_SET_COMPU_VERB 19 0.00 32770.0000000 FORMAT "%13.7" DEPOSIT ABSOLUTE /end AXIS_DESCR
/end CHARACTERISTIC
/begin CHARACTERISTIC InjSys_stSyncDrctStrtEnaInj "Synchronization state for injection release at direct start" VALUE 0x805596D4 RB_Val_Wu8 30.0000000000 Epm_stSync_State_t 0.00 30.0000000000 FORMAT "%13.10" /end CHARACTERISTIC
/begin CHARACTERISTIC InjSys_stSyncEnaInj "Synchronization state for injection release" VALUE 0x805596D5 RB_Val_Wu8 30.0000000000 Epm_stSync_State_t 0.00 30.0000000000 FORMAT "%13.10" /end CHARACTERISTIC
/begin CHARACTERISTIC InjSys_stSyncHpStrtEnaInj "Synchronization state for injection release at high pressure start" VALUE 0x805596D6 RB_Val_Wu8 30.0000000000 Epm_stSync_State_t 0.00 30.0000000000 FORMAT "%13.10" /end CHARACTERISTIC
/begin CHARACTERISTIC InjSys_stTFuSel_C "parameter to chose the temperature for the fuel density correction" VALUE 0x805588CA RB_Val_Wu8 255.0 dez 0.00 255.0 FORMAT "%5.1" /end CHARACTERISTIC
/begin AXIS_PTS InjSys_tCat08_AX "Group axis for cat Temperature" 0x805587B8 ExhMod_tCat1B1 RB_Axis_S16 6553.500 Temp_Cels 8 -3549.940 3003.560 FORMAT "%8.3" DEPOSIT ABSOLUTE /end AXIS_PTS
/begin AXIS_PTS InjSys_tEng08_AX "base point distribution for engine temperature with 8 base points" 0x805587CA InjSys_tEng RB_Axis_S16 6553.500 Temp_Cels 8 -3549.940 3003.560 FORMAT "%8.3" DEPOSIT ABSOLUTE /end AXIS_PTS
/begin AXIS_PTS InjSys_tEngStrt08_AX "Base point distribution for engine temperature at start with 8 base points" 0x805587DC InjSys_tEngStrt RB_Axis_S16 6553.500 Temp_Cels 8 -3549.940 3003.560 FORMAT "%8.3" DEPOSIT ABSOLUTE /end AXIS_PTS
/begin CHARACTERISTIC InjSys_tiBreakThdStb_C "threshold minimum pause time between two injections (standby injection mode)" VALUE 0x805598CC RB_Val_Wu16 26.21400 t_q0p0004_ms 0.00 26.21400 FORMAT "%8.5" /end CHARACTERISTIC
/begin CHARACTERISTIC InjSys_tiBreakThd_C "threshold minimum pause time between two injections" VALUE 0x805598CE RB_Val_Wu16 26.21400 t_q0p0004_ms 0.00 26.21400 FORMAT "%8.5" /end CHARACTERISTIC
/begin CHARACTERISTIC InjSys_tiDebAllwd_C "debounce time for resetting of an operation mode prohibition" VALUE 0x805598D0 RB_Val_Wu8 2.550 t_q0p01 0.00 2.550 FORMAT "%5.3" /end CHARACTERISTIC
/begin CHARACTERISTIC InjSys_tiDebNotAllwd_C "debounce time for setting of an operation mode prohibition" VALUE 0x805598D1 RB_Val_Wu8 2.550 t_q0p01 0.00 2.550 FORMAT "%5.3" /end CHARACTERISTIC
/begin CHARACTERISTIC InjSys_tiDlyAbortEomCvo_C "Delay time to abort the operation mode request during CVO basic adaption" VALUE 0x80558956 RB_Val_Wu16 6553.500 t_q0p1 0.00 6553.500 FORMAT "%8.3" /end CHARACTERISTIC
/begin CHARACTERISTIC InjSys_tiInjModReqCvo_C "time delay for request injection mode CVO" VALUE 0x8055850C RB_Val_Wu8 5.100 t_q0p02 0.00 5.100 FORMAT "%5.3" /end CHARACTERISTIC
/begin CHARACTERISTIC InjSys_tiInjOpenThdStbOffs_C "threshold offset minimum valve open time (standby injection mode)" VALUE 0x805598D2 RB_Val_Wu16 26.21400 t_q0p0004_ms 0.00 26.21400 FORMAT "%8.5" /end CHARACTERISTIC
/begin CHARACTERISTIC InjSys_tiInjOpenThd_T "threshold minimum valve open time" CURVE 0x805598D4 RB_Curve_U8_U16_Static 26.21400 t_q0p0004_ms 0.00 26.21400 FORMAT "%8.5"
 /begin AXIS_DESCR STD_AXIS InjSys_stInjMod InjSys_InjMode_Set_COMPU_VERB 20 0.00 19.0000000000 FORMAT "%13.10" DEPOSIT ABSOLUTE /end AXIS_DESCR
/end CHARACTERISTIC
/begin CHARACTERISTIC InjSys_tiMaxMiReqEna_C "Threshold for maximum injection time for torque reserve request." VALUE 0x80558958 RB_Val_Wu16 65.53500 t_q0p001_ms 0.00 65.53500 FORMAT "%8.5" /end CHARACTERISTIC
/begin CHARACTERISTIC InjSys_tiMinTiInj_C "Minimal injection time limitation threshold for GDI" VALUE 0x805584B6 RB_Val_Wu16 26.21400 t_q0p0004_ms 0.00 26.21400 FORMAT "%8.5" /end CHARACTERISTIC
/begin CHARACTERISTIC InjSys_tiPostStrtCvo_C "Time after end of start for enabling CVO base adaptation" VALUE 0x8055895A RB_Val_Wu16 6553.500 t100msxs_uw_b6553p5 0.00 6553.500 FORMAT "%8.3" /end CHARACTERISTIC
/begin CHARACTERISTIC InjSys_tiPseSpDeDiagMax_C "maximum permitted pause time deviation for diagnosis of injection timing" VALUE 0x80558902 RB_Val_Ws16 65.53500 t_q0p001_ms -32.76800 32.76700 FORMAT "%8.5" /end CHARACTERISTIC
/begin CHARACTERISTIC InjSys_tiSpDeDiagMax_C "maximum permitted injection time deviation for diagnosis of injection timing" VALUE 0x80558904 RB_Val_Wu16 65.53500 t_q0p001_ms 0.00 65.53500 FORMAT "%8.5" /end CHARACTERISTIC
/begin CHARACTERISTIC InjSys_tLwrOperCvo_C "Lower CVO operation temperature" VALUE 0x8055895C RB_Val_Wu8 191.3 temp_ub_q0p75_o48 -48.0 143.3 FORMAT "%5.1" /end CHARACTERISTIC
/begin AXIS_PTS InjSys_tosp08_AX "base point distribution for oil temperature with 8 base points" 0x805587EE InjSys_tOilSp RB_Axis_S16 6553.500 Temp_Cels 8 -3549.940 3003.560 FORMAT "%8.3" DEPOSIT ABSOLUTE /end AXIS_PTS
/begin CHARACTERISTIC InjSys_tqResvMinMiCvo_CUR "Torque reserve request for CVO" CURVE 0x8055895E RB_Curve_U16_S16_Static 3276.700 md_q0p1 0.00 3276.700 FORMAT "%8.3" EXTENDED_LIMITS -3276.800 3276.700
 /begin AXIS_DESCR STD_AXIS InjSys_tiMinMiCvo t_q0p001_ms 6 0.00 65.53500 FORMAT "%8.5" DEPOSIT ABSOLUTE /end AXIS_DESCR
/end CHARACTERISTIC
/begin CHARACTERISTIC InjSys_tUpprOperCvo_C "Upper CVO operation temperature" VALUE 0x80558978 RB_Val_Wu8 191.3 temp_ub_q0p75_o48 -48.0 143.3 FORMAT "%5.1" /end CHARACTERISTIC
/begin CHARACTERISTIC InjSys_uBattLowrThdCvo_C "lower battery voltage level for CVO operation" VALUE 0x8055897A RB_Val_Ws16 655340.0 Volt_Batt 0.00 655340.0 FORMAT "%8.1" EXTENDED_LIMITS -655360.0 655340.0 /end CHARACTERISTIC
/begin CHARACTERISTIC InjSys_uBattUpprThdCvo_C "upper battery voltage level for CVO operation" VALUE 0x8055897C RB_Val_Ws16 655340.0 Volt_Batt 0.00 655340.0 FORMAT "%8.1" EXTENDED_LIMITS -655360.0 655340.0 /end CHARACTERISTIC
/begin AXIS_PTS InjSys_vcosCvo_Ax "CVO fuel viscosity group points" 0x8055850E InjSys_vcosPntCvo RB_Axis_U16 3.276750 RBPtCel_vcos_5p0em5_1 6 0.00 3.276750 FORMAT "%8.6" DEPOSIT ABSOLUTE /end AXIS_PTS
/begin CHARACTERISTIC InjSys_vcosFuTEthCvo10MegaPa_M "Map fuel viscosity dependent on injector temperature for the 10MPa set point of the extrapolation." MAP 0x8055851C RB_Map_U8U8_U16 3.276750 RBPtCel_vcos_5p0em5_1 0.00 3.276750 FORMAT "%8.6"
 /begin AXIS_DESCR STD_AXIS InjSys_tInjrCvo temp_ub_q0p75_o48 6 -48.0 143.3 FORMAT "%5.1" DEPOSIT ABSOLUTE /end AXIS_DESCR
 /begin AXIS_DESCR STD_AXIS InjSys_relEthAmnt rel_ub_b100 6 0.00 99.61 FORMAT "%5.2" DEPOSIT ABSOLUTE /end AXIS_DESCR
/end CHARACTERISTIC
/begin CHARACTERISTIC InjSys_vcosFuTEthCvo35MegaPa_M "Map fuel viscosity dependent on injector temperature for the 35MPa set point of the extrapolation." MAP 0x80558572 RB_Map_U8U8_U16 3.276750 RBPtCel_vcos_5p0em5_1 0.00 3.276750 FORMAT "%8.6"
 /begin AXIS_DESCR STD_AXIS InjSys_tInjrCvo temp_ub_q0p75_o48 6 -48.0 143.3 FORMAT "%5.1" DEPOSIT ABSOLUTE /end AXIS_DESCR
 /begin AXIS_DESCR STD_AXIS InjSys_relEthAmnt rel_ub_b100 6 0.00 99.61 FORMAT "%5.2" DEPOSIT ABSOLUTE /end AXIS_DESCR
/end CHARACTERISTIC
/begin CHARACTERISTIC InjSys_vcosHysCvo_C "viscosity hysteresis around the viscosity operation area" VALUE 0x805585C8 RB_Val_Wu16 3.276750 RBPtCel_vcos_5p0em5_1 0.00 3.276750 FORMAT "%8.6" /end CHARACTERISTIC
/begin CHARACTERISTIC InjSys_vcosOperDeltaCvo_GT "Operating viscosity area around the viscosity interpolation point" CURVE 0x805585CA RB_CurveGroup_U16 3.276750 RBPtCel_vcos_5p0em5_1 0.00 3.276750 FORMAT "%8.6"
 /begin AXIS_DESCR COM_AXIS InjSys_vcosPntCvo RBPtCel_vcos_5p0em5_1 6 0.00 3.276750 FORMAT "%8.6" AXIS_PTS_REF InjSys_vcosCvo_Ax /end AXIS_DESCR
/end CHARACTERISTIC
/begin CHARACTERISTIC InjSys_vMinVehBascAdpn_C "Minimum vehicle speed for CVO base adaptation" VALUE 0x8055897E RB_Val_Ws16 327.6700 Vel 0.00 327.6700 FORMAT "%8.4" EXTENDED_LIMITS -327.6800 327.6700 /end CHARACTERISTIC
/begin CHARACTERISTIC InjSys_volCyl_C "cylinder displacement" VALUE 0x805588CC RB_Val_Wu16 3.276750 vol_q5p0Em5_l 0.00 3.276750 FORMAT "%8.6" /end CHARACTERISTIC
/begin CHARACTERISTIC IVGdiCtl_ErrSimCyl_C "Selection of the software cylinder for CSERS error simulation" VALUE 0x80506050 KwUb 255.0 dez 0.00 255.0 FORMAT "%5.1" /end CHARACTERISTIC
/begin CHARACTERISTIC IVGdiCtl_ErrSimInjPls_C "Selection of injection pulse for CSERS error simulation" VALUE 0x80506052 KwUw 127.0000 dez 0.00 127.0000 FORMAT "%8.4" EXTENDED_LIMITS 0.00 65535.00 /end CHARACTERISTIC
/begin CHARACTERISTIC IVGdiCtl_ErrSimPhiOff_C "Selection of injection angle offset for CSERS error simulation" VALUE 0x80506054 KwSw 720.0000 kw_sw_q0p0219 -360.0000 360.0000 FORMAT "%8.4" EXTENDED_LIMITS -720.0000 719.9780 /end CHARACTERISTIC
/begin CHARACTERISTIC IVGdiCtl_ErrSimTiFac_C "Selection of injection time factor for CSERS error simulation" VALUE 0x80506056 KwUb 1.992188 fak_ub_b2 0.00 1.992188 FORMAT "%8.6" /end CHARACTERISTIC
/begin CHARACTERISTIC IVGdiCtl_ErrSimTyp_C "Selection of error type for CSERS error simulation" VALUE 0x80506057 KwUb 2.000 dez 0.00 2.000 FORMAT "%5.3" EXTENDED_LIMITS 0.00 255.0 /end CHARACTERISTIC
/begin CHARACTERISTIC KLFWFRL "curve factor max. injection angle range for calculation max. load" CURVE 0x805584B8 RB_Curve_U16_U8_Static 9337. q36p615_percent_GradKW_DIV_ms 0.00 9337. FORMAT "%5.0"
 /begin AXIS_DESCR STD_AXIS prfwfrl_w RBPtCel_p_0p002_1 3 0.00 131.0700 FORMAT "%8.4" DEPOSIT ABSOLUTE /end AXIS_DESCR
/end CHARACTERISTIC
/begin CHARACTERISTIC KLWESABR "Characteristic line of injection abortion angle" CURVE 0x805584C4 RB_Curve_U16_U8_Static 191.3 kw_q0p75 0.00 191.3 FORMAT "%5.1"
 /begin AXIS_DESCR STD_AXIS fktprps_w fak_uw_b64 6 0.00 63.99902 FORMAT "%8.5" DEPOSIT ABSOLUTE /end AXIS_DESCR
/end CHARACTERISTIC
/begin CHARACTERISTIC PRISTHPRCP "Rail pressure threshold for injection valve high pressure current profile" VALUE 0x805584D8 RB_Val_Wu16 131.0700 RBPtCel_p_0p002_1 0.00 131.0700 FORMAT "%8.4" /end CHARACTERISTIC
/begin CHARACTERISTIC PRNOESAB "Rail-pressure threshold for injection abort for GDI" VALUE 0x805584DA RB_Val_Wu16 131.0700 RBPtCel_p_0p002_1 0.00 131.0700 FORMAT "%8.4" /end CHARACTERISTIC
/begin CHARACTERISTIC SH1.stInjPktVrntInst_C "selection injection packet variant and class instance / injection packet variant and class instance selector" VALUE 0x8055970C RB_Val_Wu32 4294967295.00 dez 0.00 4294967295.00 FORMAT "%13.2" /end CHARACTERISTIC
/begin CHARACTERISTIC SH2.stInjPktVrntInst_C "selection injection packet variant and class instance / injection packet variant and class instance selector" VALUE 0x80559710 RB_Val_Wu32 4294967295.00 dez 0.00 4294967295.00 FORMAT "%13.2" /end CHARACTERISTIC
/begin CHARACTERISTIC SH3.stInjPktVrntInst_C "selection injection packet variant and class instance / injection packet variant and class instance selector" VALUE 0x80559714 RB_Val_Wu32 4294967295.00 dez 0.00 4294967295.00 FORMAT "%13.2" /end CHARACTERISTIC
/begin CHARACTERISTIC SHO1.stInjPktVrntInst_C "selection injection packet variant and class instance / injection packet variant and class instance selector" VALUE 0x80559718 RB_Val_Wu32 4294967295.00 dez 0.00 4294967295.00 FORMAT "%13.2" /end CHARACTERISTIC
/begin CHARACTERISTIC SHO2.stInjPktVrntInst_C "selection injection packet variant and class instance / injection packet variant and class instance selector" VALUE 0x8055971C RB_Val_Wu32 4294967295.00 dez 0.00 4294967295.00 FORMAT "%13.2" /end CHARACTERISTIC
/begin CHARACTERISTIC SHO3.stInjPktVrntInst_C "selection injection packet variant and class instance / injection packet variant and class instance selector" VALUE 0x80559720 RB_Val_Wu32 4294967295.00 dez 0.00 4294967295.00 FORMAT "%13.2" /end CHARACTERISTIC
/begin CHARACTERISTIC SHP3.stInjPktVrntInst_C "selection injection packet variant and class instance / injection packet variant and class instance selector" VALUE 0x80559724 RB_Val_Wu32 4294967295.00 dez 0.00 4294967295.00 FORMAT "%13.2" /end CHARACTERISTIC
/begin CHARACTERISTIC UBHYEAKO "Delta voltage for hysteresis permition of injection" VALUE 0x805596D8 RB_Val_Ws16 1310700. Volt_Batt -655360.0 655340.0 FORMAT "%8.1" /end CHARACTERISTIC
/begin CHARACTERISTIC UBRESMIN "lower threshold for onboard battery voltage via main relay to enable injection" VALUE 0x805596DA RB_Val_Ws16 1310700. Volt_Batt -655360.0 655340.0 FORMAT "%8.1" /end CHARACTERISTIC
/begin MEASUREMENT agKnkAvrgLocSp "Average value of ign. retarding by KC, generally (limp-home with safety) local" SBYTE kw_q0p75 1 100 -96.00 95.25 FORMAT "%5.2" ECU_ADDRESS 0x70002ADC /end MEASUREMENT
/begin MEASUREMENT anzesab_w_msg "Injection abortion counter" UWORD dez 1 100 0.00 65535.00 FORMAT "%8.2" ECU_ADDRESS 0x700037AC /end MEASUREMENT
/begin MEASUREMENT anztib_msg "injection counter limited" UBYTE dez 1 100 0.00 255.0 FORMAT "%5.1" ECU_ADDRESS 0x60000995 /end MEASUREMENT
/begin MEASUREMENT anztib_w_msg "injection counter with limit" UWORD dez 1 100 0.00 65535.00 FORMAT "%8.2" ECU_ADDRESS 0x6000076E /end MEASUREMENT
/begin MEASUREMENT anzti_msg "injection counter" UBYTE dez 1 100 0.00 255.0 FORMAT "%5.1" ECU_ADDRESS 0x500009B8 /end MEASUREMENT
/begin MEASUREMENT anzti_w_msg "injection counter" UWORD dez 1 100 0.00 65535.00 FORMAT "%8.2" ECU_ADDRESS 0x50000892 /end MEASUREMENT
/begin MEASUREMENT B_invlvhpr_msg "Condition injection valve high pressure current profile" UBYTE B_TRUE 1 100 0.00 1.00000000000 BIT_MASK 0x1 FORMAT "%13.11" ECU_ADDRESS 0x70000BA5 /end MEASUREMENT
/begin MEASUREMENT B_noesab_msg "condition: injection abortion disabled" UBYTE B_TRUE 1 100 0.00 1.00000000000 BIT_MASK 0x1 FORMAT "%13.11" ECU_ADDRESS 0x70000B5A /end MEASUREMENT
/begin MEASUREMENT fethstoeLocSp "ethanol content of current stoichiometric correction (ffuel_w) interpolation factor local" UBYTE fak_ub_b2 1 100 0.00 1.992188 FORMAT "%8.6" ECU_ADDRESS 0x70002ADB /end MEASUREMENT
/begin MEASUREMENT ffudens_msg "factor temperature dependent fuel density" UBYTE fak_ub_b2 1 100 0.00 1.992188 FORMAT "%8.6" ECU_ADDRESS 0x6000F740 /end MEASUREMENT
/begin MEASUREMENT fktprps_w "Factor ratio of rail pressure to manifold pressure" UWORD fak_uw_b64 1 100 0.00 63.99902 FORMAT "%8.5" ECU_ADDRESS 0x6000742A /end MEASUREMENT
/begin MEASUREMENT flgVlvLftLoc "condition: high valve lift for timing of air charge determination ( one calculation step before calculation of air charge for switched cylinder) local" UBYTE B_TRUE 1 100 0.00 1.00000000000 BIT_MASK 0x1 FORMAT "%13.11" ECU_ADDRESS 0x70002ADA /end MEASUREMENT
/begin MEASUREMENT frstinjcyl_msg "cylinder number first injection" UBYTE dez 1 100 0.00 255.0 FORMAT "%5.1" ECU_ADDRESS 0x500009BD /end MEASUREMENT
/begin MEASUREMENT fwfrl "factor max. injection angle range for calculation max. load" UBYTE q36p615_percent_GradKW_DIV_ms 1 100 0.00 9337. FORMAT "%5.0" ECU_ADDRESS 0x6000B7F1 /end MEASUREMENT
/begin MEASUREMENT InjAgBg_w "Array Monitoring injection begin angle" SLONG kw_sw_q0p0219 1 100 -47185920.0000 47185919.9780 FORMAT "%13.4" ARRAY_SIZE 16 ECU_ADDRESS 0x70002DFC /end MEASUREMENT
/begin MEASUREMENT InjDDGdi_AgBgInjPls "Relative begin angle of active injection pulse." SLONG kw_sw_q0p0219 1 100 -47185920.0000 47185919.9780 FORMAT "%13.4" ARRAY_SIZE 20 ECU_ADDRESS 0x70002DAC /end MEASUREMENT
/begin MEASUREMENT InjDDGdi_agRefTiBasd "Substitute safe injection angle for time based injections during wrong injection mode from application software." SWORD kw_q0p0234 1 100 -768.0000 767.9766 FORMAT "%8.4" ARRAY_SIZE 4 ECU_ADDRESS 0x70002DA4 /end MEASUREMENT
/begin MEASUREMENT InjDDGdi_bErrSimRun_msg "Message to show if CSERS (Cold Start Emission Reduction Strategy) is active" UBYTE OneToOne 1 100 0.00 255.0 BIT_MASK 0x1 FORMAT "%5.1" ECU_ADDRESS 0x7000360A /end MEASUREMENT
/begin MEASUREMENT InjDDGdi_cntSyncSWPMT "Number of synchro tasks, function updating injection begin angle at every crankshaft teeth will be active." UWORD dez 1 100 0.00 65535.00 FORMAT "%8.2" ECU_ADDRESS 0x70002DA2 /end MEASUREMENT
/begin MEASUREMENT injddgdi_cvomeasctr "counter for executed CVO measurements" UWORD dez 1 100 0.00 65535.00 FORMAT "%8.2" ECU_ADDRESS 0x70002DA0 /end MEASUREMENT
/begin MEASUREMENT injddgdi_cvomeasctrold "saved counter for executed CVO measurements" UWORD dez 1 100 0.00 65535.00 FORMAT "%8.2" ECU_ADDRESS 0x70002D9E /end MEASUREMENT
/begin MEASUREMENT injddgdi_dtiInj1 "delta time for 1st injection of CVO (Controlled Valve Operation)" SWORD t_q0p4us 1 100 -13107.20 13106.80 FORMAT "%8.2" ARRAY_SIZE 4 ECU_ADDRESS 0x70003A0A /end MEASUREMENT
/begin MEASUREMENT injddgdi_dtiInj2 "delta time for 2nd injection of CVO (Controlled Valve Operation)" SWORD t_q0p4us 1 100 -13107.20 13106.80 FORMAT "%8.2" ARRAY_SIZE 4 ECU_ADDRESS 0x70003A02 /end MEASUREMENT
/begin MEASUREMENT injddgdi_dtiInj3 "delta time for 3rd injection of CVO (Controlled Valve Operation)" SWORD t_q0p4us 1 100 -13107.20 13106.80 FORMAT "%8.2" ARRAY_SIZE 4 ECU_ADDRESS 0x700039FA /end MEASUREMENT
/begin MEASUREMENT injddgdi_dtiInj4 "delta time for 4th injection of CVO (Controlled Valve Operation)" SWORD t_q0p4us 1 100 -13107.20 13106.80 FORMAT "%8.2" ARRAY_SIZE 4 ECU_ADDRESS 0x700039F2 /end MEASUREMENT
/begin MEASUREMENT InjDDGdi_flgBitErrInjPlsCSERS "Error in requested injection pulse data having a missing reference angle for a pulse during CSERS" UWORD OneToOne 1 100 0.00 65535.00 FORMAT "%8.2" ECU_ADDRESS 0x70002D9C /end MEASUREMENT
/begin MEASUREMENT InjDDGdi_flgSWPMTEnabFreqReCalc "Flag showing function updating injection begin angle at every crankshaft teeth active." UBYTE OneToOne 1 100 0.00 255.0 BIT_MASK 0x1 FORMAT "%5.1" ECU_ADDRESS 0x70002D9A /end MEASUREMENT
/begin MEASUREMENT InjDDGdi_IdInjPls "Active injection pulse identifier assigned by injection hardware driver during injection." SBYTE dez 1 100 -128.0 127.0 FORMAT "%5.1" ARRAY_SIZE 20 ECU_ADDRESS 0x70002D86 /end MEASUREMENT
/begin MEASUREMENT injddgdi_injNo "Number of injections" UBYTE dez 1 100 0.00 255.0 FORMAT "%5.1" ARRAY_SIZE 4 ECU_ADDRESS 0x70002D78 /end MEASUREMENT
/begin MEASUREMENT InjDDGdi_InjPlsCntrMo "Injection Counter for Monitoring" ULONG dez 1 100 0.00 4294967295.00 FORMAT "%13.2" ECU_ADDRESS 0x70002D74 /end MEASUREMENT
/begin MEASUREMENT injddgdi_lstMeasPulse "Number of the last measured pulse" UBYTE dez 1 100 0.00 255.0 FORMAT "%5.1" ARRAY_SIZE 4 ECU_ADDRESS 0x70002D6E /end MEASUREMENT
/begin MEASUREMENT InjDDGdi_maskCVOPlsMeas "Bit mask for CVO (Controlled Valve Operation) pulse measure depending on requested injection pulse time" UWORD OneToOne 1 100 0.00 65535.00 FORMAT "%8.2" ARRAY_SIZE 4 ECU_ADDRESS 0x70002D66 /end MEASUREMENT
/begin MEASUREMENT InjDDGdi_measMskCur_a "Current measured pulses (bitmask)" UWORD dez 1 100 0.00 65535.00 FORMAT "%8.2" ARRAY_SIZE 4 ECU_ADDRESS 0x70002D5E /end MEASUREMENT
/begin MEASUREMENT InjDDGdi_measMskTrigCur_a "Current triggered pulses with CVO measurement" UWORD dez 1 100 0.00 65535.00 FORMAT "%8.2" ARRAY_SIZE 4 ECU_ADDRESS 0x70002D56 /end MEASUREMENT
/begin MEASUREMENT InjDDGdi_measMskTrig_a "Bitmask over triggered pulses for measuring" UWORD dez 1 100 0.00 65535.00 FORMAT "%8.2" ARRAY_SIZE 4 ECU_ADDRESS 0x70002D4E /end MEASUREMENT
/begin MEASUREMENT injddgdi_meastimeoutctr "Timeout counter for CVO (Controlled Valve Operation) measurement trigger" UBYTE dez 1 100 0.00 255.0 FORMAT "%5.1" ECU_ADDRESS 0x70002D4C /end MEASUREMENT
/begin MEASUREMENT InjDDGdi_nrInjLstCyc "Number of injection pulses for the previous injection cyle" UBYTE dez 1 100 0.00 255.0 FORMAT "%5.1" ARRAY_SIZE 4 ECU_ADDRESS 0x70002D48 /end MEASUREMENT
/begin MEASUREMENT injddgdi_outpCtlState "Injection internal state machine" UBYTE dez 1 100 0.00 255.0 FORMAT "%5.1" ARRAY_SIZE 4 ECU_ADDRESS 0x70002D44 /end MEASUREMENT
/begin MEASUREMENT injddgdi_phiEndofCycle "End angle of the injection cycle" SLONG AngleCrS 1 100 -47185920.0000 47185919.9780 FORMAT "%13.4" ARRAY_SIZE 4 ECU_ADDRESS 0x70002D34 /end MEASUREMENT
/begin MEASUREMENT injddgdi_piExpCtr "counter for explicit post injection" UWORD dez 1 100 0.00 65535.00 FORMAT "%8.2" ECU_ADDRESS 0x70002D30 /end MEASUREMENT
/begin MEASUREMENT injddgdi_piImpCtr "counter implicit post injection" UWORD dez 1 100 0.00 65535.00 FORMAT "%8.2" ECU_ADDRESS 0x70002D2E /end MEASUREMENT
/begin MEASUREMENT InjDDGdi_stSyncCntSWPMT "Status of the state machine controlling the switching of function updating injection begin angle at every crankshaft teeth." UBYTE dez 1 100 0.00 255.0 FORMAT "%5.1" ECU_ADDRESS 0x70002D2D /end MEASUREMENT
/begin MEASUREMENT injddgdi_Test_cyl "cylinder of Actuator Test Injection" UBYTE dez 1 100 0.00 255.0 FORMAT "%5.1" ECU_ADDRESS 0x70002D2C /end MEASUREMENT
/begin MEASUREMENT injddgdi_Test_nofPlss "number of pulses of Actuator Test injection" UWORD dez 1 100 0.00 65535.00 FORMAT "%8.2" ECU_ADDRESS 0x70002D2A /end MEASUREMENT
/begin MEASUREMENT injddgdi_Test_plsCnt "pulse counter of Actuator Test injection" UWORD dez 1 100 0.00 65535.00 FORMAT "%8.2" ECU_ADDRESS 0x70002D28 /end MEASUREMENT
/begin MEASUREMENT injddgdi_Test_plsDur "pulse duration of Actuator Test Injection" ULONG t_q0p001_ms 1 100 0.00 4294967.29500 FORMAT "%13.5" ECU_ADDRESS 0x70002D24 /end MEASUREMENT
/begin MEASUREMENT injddgdi_Test_plsPerCnt "pulse period of Actuator Test injection" UWORD t_q10_ms 1 100 0.00 655350.0 FORMAT "%8.1" ECU_ADDRESS 0x70002D20 /end MEASUREMENT
/begin MEASUREMENT injddgdi_Test_plsPeriod "pulse period of Actuator Test injection" UWORD t_q10_ms 1 100 0.00 655350.0 FORMAT "%8.1" ECU_ADDRESS 0x70002D1E /end MEASUREMENT
/begin MEASUREMENT injddgdi_Test_State "state of Actuator Test injection" UWORD dez 1 100 0.00 65535.00 FORMAT "%8.2" ECU_ADDRESS 0x70002D1C /end MEASUREMENT
/begin MEASUREMENT InjDDGdi_TiInjPls "Measure variable for injection ti" SLONG t_q0p0004_ms 1 100 -858993.459200 858993.458800 FORMAT "%13.6" ARRAY_SIZE 20 ECU_ADDRESS 0x70002CCC /end MEASUREMENT
/begin MEASUREMENT injddgdi_tPause "current pause time" UWORD t_q0p001_ms 1 100 0.00 65.53500 FORMAT "%8.5" ECU_ADDRESS 0x70002CC8 /end MEASUREMENT
/begin MEASUREMENT injddgdi_tPauseNxtPls "Pause time between the current pulse and next upcoming pulse" UWORD t_q0p001_ms 1 100 0.00 65.53500 FORMAT "%8.5" ECU_ADDRESS 0x70002CC6 /end MEASUREMENT
/begin MEASUREMENT InjDDGdi_Tpmin "minimum valve turn-off time" UWORD t_q0p001_ms 1 100 0.00 65.53500 FORMAT "%8.5" ARRAY_SIZE 20 ECU_ADDRESS 0x70002C9E /end MEASUREMENT
/begin MEASUREMENT injddgdi_trigCvoState "CVO (Controlled Valve Operation) Measurement trigger States" UBYTE InjDDGdi_CvoMeas_State_t 1 100 0.00 2.00000000000 FORMAT "%13.11" ECU_ADDRESS 0x70002C9C /end MEASUREMENT
/begin MEASUREMENT InjHGdi_ChlNumFinishedInj "channel specific counter for finished injections" ULONG DEZ 1 100 0.00 4294967295.00 FORMAT "%13.2" ARRAY_SIZE 4 ECU_ADDRESS 0x500044F8 /end MEASUREMENT
/begin MEASUREMENT InjHGdi_ChlNumRequestedInj "channel specific counter for injections which are passed to the hardware" ULONG DEZ 1 100 0.00 4294967295.00 FORMAT "%13.2" ARRAY_SIZE 4 ECU_ADDRESS 0x50004508 /end MEASUREMENT
/begin MEASUREMENT InjHGdi_ChlNumStartedInj "channel specific counter for started injections" ULONG DEZ 1 100 0.00 4294967295.00 FORMAT "%13.2" ARRAY_SIZE 4 ECU_ADDRESS 0x50004518 /end MEASUREMENT
/begin MEASUREMENT InjHGdi_InfoFlgs "information flag value" UWORD DEZ 1 100 0.00 65535.00 FORMAT "%8.2" ECU_ADDRESS 0x6000A142 /end MEASUREMENT
/begin MEASUREMENT InjHGdi_numAbortedInj "counter for injections aborted at the abort angle" ULONG DEZ 1 100 0.00 4294967295.00 FORMAT "%13.2" ECU_ADDRESS 0x50004C6C /end MEASUREMENT
/begin MEASUREMENT InjHGdi_numFinishedInj "counter for finished injections" ULONG DEZ 1 100 0.00 4294967295.00 FORMAT "%13.2" ECU_ADDRESS 0x50004C70 /end MEASUREMENT
/begin MEASUREMENT InjHGdi_numRequestedInj "counter for injections which are passed to the hardware" ULONG DEZ 1 100 0.00 4294967295.00 FORMAT "%13.2" ECU_ADDRESS 0x60013A5C /end MEASUREMENT
/begin MEASUREMENT InjHGdi_numStartedInj "counter for started injections" ULONG DEZ 1 100 0.00 4294967295.00 FORMAT "%13.2" ECU_ADDRESS 0x60013A60 /end MEASUREMENT
/begin MEASUREMENT InjHGdi_numWithdrawedInj "counter for withdrawed injections which are already passed to the hardware" ULONG DEZ 1 100 0.00 4294967295.00 FORMAT "%13.2" ECU_ADDRESS 0x6000400C /end MEASUREMENT
/begin MEASUREMENT InjMeasAccp "Acceppted status of a measurement by hardware driver" UBYTE OneToOne 1 100 0.00 255.0 FORMAT "%5.1" ARRAY_SIZE 16 ECU_ADDRESS 0x70002C8C /end MEASUREMENT
/begin MEASUREMENT injmoderdnt_l_msg "Redundancy for injmode_l_msg" ULONG dez 1 100 0.00 4294967295.00 FORMAT "%13.2" ARRAY_SIZE 4 ECU_ADDRESS 0x70003C58 /end MEASUREMENT
/begin MEASUREMENT injmode_l_msg "injection mode" ULONG dez 1 100 0.00 4294967295.00 FORMAT "%13.2" ARRAY_SIZE 4 ECU_ADDRESS 0x70003C68 /end MEASUREMENT
/begin MEASUREMENT injPlsEndCtr "injection pulse end counter" UWORD dez 1 100 0.00 65535.00 FORMAT "%8.2" ECU_ADDRESS 0x70002C8A /end MEASUREMENT
/begin MEASUREMENT InjPlsId "Injection pulse index from hardware driver" UBYTE dez 1 100 0.00 255.0 FORMAT "%5.1" ARRAY_SIZE 16 ECU_ADDRESS 0x70002C7A /end MEASUREMENT
/begin MEASUREMENT injPlsStrtCtr "injection pulse start counter" UWORD dez 1 100 0.00 65535.00 FORMAT "%8.2" ECU_ADDRESS 0x70002C78 /end MEASUREMENT
/begin MEASUREMENT InjSyG_InjChk_stIni "." UBYTE dez 1 100 0.00 255.0 FORMAT "%5.1" ECU_ADDRESS 0x70002B18 /end MEASUREMENT
/begin MEASUREMENT InjSyG_InjChk_stIni_MP "measurement point status initialization InjSyG_InjChk" UBYTE OneToOne 1 100 0.00 255.0 FORMAT "%5.1" ECU_ADDRESS 0x7000A246 /end MEASUREMENT
/begin MEASUREMENT InjSys_agBreakThd "threshold minimum angular spacing between two injections" SWORD kw_q0p0234 1 100 -768.0000 767.9766 FORMAT "%8.4" ECU_ADDRESS 0x70002B16 /end MEASUREMENT
/begin MEASUREMENT InjSys_agBreakThdStb "threshold minimum angular spacing between two injections (standby injection mode)" SWORD kw_q0p0234 1 100 -768.0000 767.9766 FORMAT "%8.4" ECU_ADDRESS 0x70002B14 /end MEASUREMENT
/begin MEASUREMENT InjSys_agDrctStrtLocSp "angle direct start local" UBYTE kw_q2 1 100 0.00 510.0 FORMAT "%5.1" ECU_ADDRESS 0x70002AD9 /end MEASUREMENT
/begin MEASUREMENT InjSys_agEoiLstSyn0 "injection end angle last injection" SWORD kw_q0p0234 1 100 -768.0000 767.9766 FORMAT "%8.4" ECU_ADDRESS 0x70002B12 /end MEASUREMENT
/begin MEASUREMENT InjSys_agInjLoc "injection angle local" SWORD kw_q0p0234 1 100 -768.0000 767.9766 FORMAT "%8.4" ARRAY_SIZE 4 ECU_ADDRESS 0x70002B34 /end MEASUREMENT
/begin MEASUREMENT InjSys_agInjWinMax "Max injection window based on angle of injection" SWORD kw_q0p0234 1 100 -768.0000 767.9766 FORMAT "%8.4" ECU_ADDRESS 0x60007428 /end MEASUREMENT
/begin MEASUREMENT InjSys_agMidInjPls_a "Array of mid injection angle of injection pulse" SWORD kw_q0p0234 1 100 -768.0000 767.9766 FORMAT "%8.4" ARRAY_SIZE 16 ECU_ADDRESS 0x70003B0C /end MEASUREMENT
/begin MEASUREMENT InjSys_agShiftInj "injection angle shift" SWORD kw_q0p0234 1 100 -768.0000 767.9766 FORMAT "%8.4" ECU_ADDRESS 0x70003B0A /end MEASUREMENT
/begin MEASUREMENT InjSys_agShiftInjAllwd "maximum allowed injection angle shift" SWORD kw_q0p0234 1 100 -768.0000 767.9766 FORMAT "%8.4" ECU_ADDRESS 0x70002B10 /end MEASUREMENT
/begin MEASUREMENT InjSys_agShiftInjRqrd "required injection angle shift" SWORD kw_q0p0234 1 100 -768.0000 767.9766 FORMAT "%8.4" ECU_ADDRESS 0x70002B0E /end MEASUREMENT
/begin MEASUREMENT InjSys_agSpCatHeatgDiag "Injection angle setpoint (injection individual) for diagnosis of injection timing" SWORD kw_q0p0234 1 100 -768.0000 767.9766 FORMAT "%8.4" ARRAY_SIZE 4 ECU_ADDRESS 0x70002B8C /end MEASUREMENT
/begin MEASUREMENT InjSys_agSpDeDiagMax "maximum injection angle deviation for diagnosis of injection timing" SWORD kw_q0p0234 1 100 -768.0000 767.9766 FORMAT "%8.4" ECU_ADDRESS 0x70002B8A /end MEASUREMENT
/begin MEASUREMENT InjSys_bMinPtdInjDurActv "Condition: TEMIN(minimal injection time) limitation active, bank 1" UBYTE B_TRUE 1 100 0.00 1.00000000000 BIT_MASK 0x1 FORMAT "%13.11" ECU_ADDRESS 0x70000894 /end MEASUREMENT
/begin MEASUREMENT InjSys_cntrInjLimdSyncS1 "injection counter limited for late calculated injection modes" UBYTE dez 1 100 0.00 255.0 FORMAT "%5.1" ECU_ADDRESS 0x700036F2 /end MEASUREMENT
/begin MEASUREMENT InjSys_ctPostDrvCntrStrd "Count variable to activate reinitialization of variables after ReIni task" UBYTE OneToOne 1 100 0.00 255.0 FORMAT "%5.1" ECU_ADDRESS 0x70002B89 /end MEASUREMENT
/begin MEASUREMENT InjSys_ctPostDrvStrd "Count variable to activate reinitialization of variables after ReIni task" UBYTE dez 1 100 0.00 255.0 FORMAT "%5.1" ECU_ADDRESS 0x6000B7EB /end MEASUREMENT
/begin MEASUREMENT InjSys_desCylMask "Released cylinders for Controlled Valve Operation (CVO) base adaption as bitmask" UWORD dez 1 100 0.00 65535.00 FORMAT "%8.2" ECU_ADDRESS 0x7000395A /end MEASUREMENT
/begin MEASUREMENT InjSys_EomCvoAllwd_I.stOperMod "CoEom(Coordination Engine Operation Mode) interface class instance / Priority-element of the operation mode structure" ULONG OneToOne 1 100 0.00 4294967295.00 FORMAT "%13.2" ECU_ADDRESS 0x70002B54 /end MEASUREMENT
/begin MEASUREMENT InjSys_EomCvoAllwd_I.stOperModPrio "CoEom(Coordination Engine Operation Mode) interface class instance / Stage-element of the operation mode structure" UBYTE OneToOne 1 100 0.00 255.0 FORMAT "%5.1" ECU_ADDRESS 0x70002B58 /end MEASUREMENT
/begin MEASUREMENT InjSys_EomCvoAllwd_I.stOperModStg "CoEom(Coordination Engine Operation Mode) interface class instance / Operation-mode element of the operation mode structure" UWORD OneToOne 1 100 0.00 65535.00 FORMAT "%8.2" ECU_ADDRESS 0x70002B5A /end MEASUREMENT
/begin MEASUREMENT InjSys_facCnvnRatFuM "factor conversion relative fuel mass to absolute fuel mass" UWORD m_q1Em7_g_DIV_pc 1 100 0.00 0.006553500 FORMAT "%11.9" ECU_ADDRESS 0x60008E26 /end MEASUREMENT
/begin MEASUREMENT InjSys_facEthLnrLoc "local copy ethanol content interpolation factor" UBYTE fak_ub_b2 1 100 0.00 1.992188 FORMAT "%8.6" ECU_ADDRESS 0x70002C0C /end MEASUREMENT
/begin MEASUREMENT InjSys_facEthLnrLocSp "ethanol content interpolation factor local" UBYTE fak_ub_b2 1 100 0.00 1.992188 FORMAT "%8.6" ECU_ADDRESS 0x70002AD8 /end MEASUREMENT
/begin MEASUREMENT InjSys_facEthnlCurr "Local variable for Ethanol content of current stoichiometric correction (ffuel_w) interpolation factor" UWORD fak_uw_b2 1 100 0.00 1.999969 FORMAT "%8.6" ECU_ADDRESS 0x600073F8 /end MEASUREMENT
/begin MEASUREMENT InjSys_facFrctInjPls_a "array of fuel injection fractions of injection pulse" UBYTE fak_ub_b1 1 100 0.00 0.9961 ARRAY_SIZE 16 ECU_ADDRESS 0x700036DF /end MEASUREMENT
/begin MEASUREMENT InjSys_facFuDens "Fuel density factor." UBYTE fak_ub_b2 1 100 0.00 1.992188 FORMAT "%8.6" ECU_ADDRESS 0x6000B7ED /end MEASUREMENT
/begin MEASUREMENT InjSys_facFuInjTi "Local variable for Correction factor fuel blend for injection time" UWORD fak_uw_b2 1 100 0.00 1.999969 FORMAT "%8.6" ECU_ADDRESS 0x600073F6 /end MEASUREMENT
/begin MEASUREMENT InjSys_facInjWin "factor for injection window" UWORD fak_uw_b2 1 100 0.00 1.999969 FORMAT "%8.6" ECU_ADDRESS 0x60007426 /end MEASUREMENT
/begin MEASUREMENT InjSys_facLamBasLocSp "factor base lambda local" UBYTE fak_ub_b2 1 100 0.00 1.992188 FORMAT "%8.6" ECU_ADDRESS 0x70002AD7 /end MEASUREMENT
/begin MEASUREMENT InjSys_facRampInjAirLim "ramp factor for Air limitation due to injection timing violation" SWORD fak_sw_b2 1 100 0.00 1.000000 FORMAT "%8.6" ECU_ADDRESS 0x60007424 /end MEASUREMENT
/begin MEASUREMENT InjSys_facStoiRhoMaxEthStd "conversion factor ffuel to fethmnmx" UWORD fak_uw_b2 1 100 0.00 1.999969 FORMAT "%8.6" ECU_ADDRESS 0x60008E24 /end MEASUREMENT
/begin MEASUREMENT InjSys_flgAdpnCvo "Release of Controlled Valve Operation (CVO) adaption" UBYTE B_TRUE 1 100 0.00 1.00000000000 BIT_MASK 0x1 FORMAT "%13.11" ECU_ADDRESS 0x70000893 /end MEASUREMENT
/begin MEASUREMENT InjSys_flgAdpnPlausb "basic adaption CVO(Controlled Valve Operation) possible" UBYTE B_TRUE 1 100 0.00 1.00000000000 BIT_MASK 0x1 FORMAT "%13.11" ECU_ADDRESS 0x70000892 /end MEASUREMENT
/begin MEASUREMENT InjSys_flgAllwdAgRngDebStb "." UBYTE B_TRUE 1 100 0.00 1.00000000000 BIT_MASK 0x1 FORMAT "%13.11" ECU_ADDRESS 0x70000209 /end MEASUREMENT
/begin MEASUREMENT InjSys_flgAllwdAgRngStb "." UBYTE B_TRUE 1 100 0.00 1.00000000000 BIT_MASK 0x1 FORMAT "%13.11" ECU_ADDRESS 0x70000208 /end MEASUREMENT
/begin MEASUREMENT InjSys_flgAllwdNEngDebStb "flag injection mode allowed with respect to engine speed debounced (standby injection mode)" UBYTE B_TRUE 1 100 0.00 1.00000000000 BIT_MASK 0x1 FORMAT "%13.11" ECU_ADDRESS 0x70000207 /end MEASUREMENT
/begin MEASUREMENT InjSys_flgAllwdNEngStb "flag injection mode allowed with respect to engine speed (standby injection mode)" UBYTE B_TRUE 1 100 0.00 1.00000000000 BIT_MASK 0x1 FORMAT "%13.11" ECU_ADDRESS 0x70000206 /end MEASUREMENT
/begin MEASUREMENT InjSys_flgAllwdTiBreakDebStb "flag injection mode allowed with respect to pause times debounced (standby injection mode)" UBYTE B_TRUE 1 100 0.00 1.00000000000 BIT_MASK 0x1 FORMAT "%13.11" ECU_ADDRESS 0x70000205 /end MEASUREMENT
/begin MEASUREMENT InjSys_flgAllwdTiBreakStb "flag injection mode allowed with respect to pause times (standby injection mode)" UBYTE B_TRUE 1 100 0.00 1.00000000000 BIT_MASK 0x1 FORMAT "%13.11" ECU_ADDRESS 0x70000204 /end MEASUREMENT
/begin MEASUREMENT InjSys_flgAllwdTiInjOpenDebStb "flag injection mode allowed with respect to valve open times debounced (standby injection mode)" UBYTE B_TRUE 1 100 0.00 1.00000000000 BIT_MASK 0x1 FORMAT "%13.11" ECU_ADDRESS 0x70000203 /end MEASUREMENT
/begin MEASUREMENT InjSys_flgAllwdTiInjOpenStb "flag injection mode allowed with respect to valve open times (standby injection mode)" UBYTE B_TRUE 1 100 0.00 1.00000000000 BIT_MASK 0x1 FORMAT "%13.11" ECU_ADDRESS 0x70000202 /end MEASUREMENT
/begin MEASUREMENT InjSys_flgAuxCdnCvo "Addition conditions on basic adaption CVO given" UBYTE B_TRUE 1 100 0.00 1.00000000000 BIT_MASK 0x1 FORMAT "%13.11" ECU_ADDRESS 0x70000216 /end MEASUREMENT
/begin MEASUREMENT InjSys_flgBascAdpnCvo "Flag Controlled Valve Operation (CVO) basic adaption" UBYTE B_TRUE 1 100 0.00 1.00000000000 BIT_MASK 0x1 FORMAT "%13.11" ECU_ADDRESS 0x70000891 /end MEASUREMENT
/begin MEASUREMENT InjSys_flgBascAdpnCvoPsbl "basic adaption Controlled Valve Operation (CVO) possible" UBYTE B_TRUE 1 100 0.00 1.00000000000 BIT_MASK 0x1 FORMAT "%13.11" ECU_ADDRESS 0x70000890 /end MEASUREMENT
/begin MEASUREMENT InjSys_flgCatHeatgDiagCopy "Condition copy values for diagnosis of injection timing" UBYTE B_TRUE 1 100 0.00 1.00000000000 BIT_MASK 0x1 FORMAT "%13.11" ECU_ADDRESS 0x70000217 /end MEASUREMENT
/begin MEASUREMENT InjSys_flgCatHeatgOpModDiag "Condition catalyst heating or warmup with desired injection mode for diagnosis of injection timing" UBYTE B_TRUE 1 100 0.00 1.00000000000 BIT_MASK 0x1 FORMAT "%13.11" ECU_ADDRESS 0x7000088F /end MEASUREMENT
/begin MEASUREMENT InjSys_flgChkCylCatHeatg "Condition check cylinder for diagnosis of injection timing" UBYTE B_TRUE 1 100 0.00 1.00000000000 BIT_MASK 0x1 FORMAT "%13.11" ECU_ADDRESS 0x7000088E /end MEASUREMENT
/begin MEASUREMENT InjSys_flgChkVld "flag check valid" UBYTE B_TRUE 1 100 0.00 1.00000000000 BIT_MASK 0x1 FORMAT "%13.11" ECU_ADDRESS 0x70000201 /end MEASUREMENT
/begin MEASUREMENT InjSys_flgChkVldStb "flag check valid (standby injection mode)" UBYTE B_TRUE 1 100 0.00 1.00000000000 BIT_MASK 0x1 FORMAT "%13.11" ECU_ADDRESS 0x70000200 /end MEASUREMENT
/begin MEASUREMENT InjSys_flgClbAssiCoorCvo "calibration assist CVO active" UBYTE B_TRUE 1 100 0.00 1.00000000000 BIT_MASK 0x1 FORMAT "%13.11" ECU_ADDRESS 0x7000088D /end MEASUREMENT
/begin MEASUREMENT InjSys_flgCldRstrtLoc "Condition cold restart local" UBYTE B_TRUE 1 100 0.00 1.00000000000 BIT_MASK 0x1 FORMAT "%13.11" ECU_ADDRESS 0x70002AD6 /end MEASUREMENT
/begin MEASUREMENT InjSys_flgCmbCatHeatgDiag "Condition combustion with catalyst heating or warmup measure was active for diagnosis of injection timing" UBYTE B_TRUE 1 100 0.00 1.00000000000 BIT_MASK 0x1 FORMAT "%13.11" ECU_ADDRESS 0x7000088C /end MEASUREMENT
/begin MEASUREMENT InjSys_flgCsersDiagRprt "Condition CSERS diagnosis reporting allowed" UBYTE B_TRUE 1 100 0.00 1.00000000000 BIT_MASK 0x1 FORMAT "%13.11" ECU_ADDRESS 0x7000021C /end MEASUREMENT
/begin MEASUREMENT InjSys_flgCsersInjModActv "CSERS injection mode is requested and active" UBYTE B_TRUE 1 100 0.00 1.00000000000 BIT_MASK 0x1 FORMAT "%13.11" ECU_ADDRESS 0x7000088B /end MEASUREMENT
/begin MEASUREMENT InjSys_flgCsersNrCmbPassd "Condition sufficient number of combustions passed for CSERS diagnosis decision" UBYTE B_TRUE 1 100 0.00 1.00000000000 BIT_MASK 0x1 FORMAT "%13.11" ECU_ADDRESS 0x7000021B /end MEASUREMENT
/begin MEASUREMENT InjSys_flgCsersReqActv "CSERS request active" UBYTE B_TRUE 1 100 0.00 1.00000000000 BIT_MASK 0x1 FORMAT "%13.11" ECU_ADDRESS 0x7000088A /end MEASUREMENT
/begin MEASUREMENT InjSys_flgCtrlCvo "Release of Controlled Valve Operation (CVO) control" UBYTE B_TRUE 1 100 0.00 1.00000000000 BIT_MASK 0x1 FORMAT "%13.11" ECU_ADDRESS 0x70000889 /end MEASUREMENT
/begin MEASUREMENT InjSys_flgCvoEnaMem "condition CVO basic adation cylinder individual memory" UBYTE B_TRUE 1 100 0.00 1.00000000000 FORMAT "%13.11" ARRAY_SIZE 4 ECU_ADDRESS 0x700036CA /end MEASUREMENT
/begin MEASUREMENT InjSys_flgCvoTestInjBall "flag active Controlled Valve Operation (CVO) ballistic test injection" UBYTE B_TRUE 1 100 0.00 1.00000000000 BIT_MASK 0x1 FORMAT "%13.11" ECU_ADDRESS 0x70000884 /end MEASUREMENT
/begin MEASUREMENT InjSys_flgDesCylCvo "Requested cylinders are present to the Controlled Valve Operation (CVO) measurement" UBYTE B_TRUE 1 100 0.00 1.00000000000 BIT_MASK 0x1 FORMAT "%13.11" ECU_ADDRESS 0x70000883 /end MEASUREMENT
/begin MEASUREMENT InjSys_flgDlyAbortReqEomCvo "Flag request CVO engine operation mode with delayed abortion" UBYTE B_TRUE 1 100 0.00 1.00000000000 BIT_MASK 0x1 FORMAT "%13.11" ECU_ADDRESS 0x70000215 /end MEASUREMENT
/begin MEASUREMENT InjSys_flgDsmBscAdpnCvo "DSM release for basic adaption CVO given" UBYTE B_TRUE 1 100 0.00 1.00000000000 BIT_MASK 0x1 FORMAT "%13.11" ECU_ADDRESS 0x70000214 /end MEASUREMENT
/begin MEASUREMENT InjSys_flgDsmCtrlAdpnCvo "DSM release for adaption or controlling CVO given" UBYTE B_TRUE 1 100 0.00 1.00000000000 BIT_MASK 0x1 FORMAT "%13.11" ECU_ADDRESS 0x70000882 /end MEASUREMENT
/begin MEASUREMENT InjSys_flgEmiRednDes "Emission reduction measures desired" UBYTE B_TRUE 1 100 0.00 1.00000000000 BIT_MASK 0x1 FORMAT "%13.11" ECU_ADDRESS 0x70000881 /end MEASUREMENT
/begin MEASUREMENT InjSys_flgEomCvoAllwd "condition engine operation mode for CVO basic adaption" UBYTE B_TRUE 1 100 0.00 1.00000000000 BIT_MASK 0x1 FORMAT "%13.11" ECU_ADDRESS 0x70000213 /end MEASUREMENT
/begin MEASUREMENT InjSys_flgEomReqAdpnCvo "Engine operation mode request for CVO adaption" UBYTE B_TRUE 1 100 0.00 1.00000000000 BIT_MASK 0x1 FORMAT "%13.11" ECU_ADDRESS 0x7000087F /end MEASUREMENT
/begin MEASUREMENT InjSys_flgGenCond "CVO general condition reached" UBYTE B_TRUE 1 100 0.00 1.00000000000 BIT_MASK 0x1 FORMAT "%13.11" ECU_ADDRESS 0x70000212 /end MEASUREMENT
/begin MEASUREMENT InjSys_flgHiPrioCvo "Condition for CVO with high priority (after tester request)" UBYTE B_TRUE 1 100 0.00 1.00000000000 BIT_MASK 0x1 FORMAT "%13.11" ECU_ADDRESS 0x7000087C /end MEASUREMENT
/begin MEASUREMENT InjSys_flgHiSeldRailPCvo "Requirement the highest rail pressure CVO" UBYTE B_TRUE 1 100 0.00 1.00000000000 BIT_MASK 0x1 FORMAT "%13.11" ECU_ADDRESS 0x7000087B /end MEASUREMENT
/begin MEASUREMENT InjSys_flgHysNEng "flag hysteresis engine speed" UBYTE B_TRUE 1 100 0.00 1.00000000000 BIT_MASK 0x1 FORMAT "%13.11" ECU_ADDRESS 0x7000020C /end MEASUREMENT
/begin MEASUREMENT InjSys_flgHysRatEngLoad "flag hysteresis relative engine load" UBYTE B_TRUE 1 100 0.00 1.00000000000 BIT_MASK 0x1 FORMAT "%13.11" ECU_ADDRESS 0x7000020B /end MEASUREMENT
/begin MEASUREMENT InjSys_flgInjEnad "condition injection enabled" UBYTE B_TRUE 1 100 0.00 1.00000000000 BIT_MASK 0x1 FORMAT "%13.11" ECU_ADDRESS 0x7000087A /end MEASUREMENT
/begin MEASUREMENT InjSys_flgInjModCvo "Request the operation of injection mode with Controlled Valve Operation (CVO) injection" UBYTE B_TRUE 1 100 0.00 1.00000000000 BIT_MASK 0x1 FORMAT "%13.11" ECU_ADDRESS 0x70000879 /end MEASUREMENT
/begin MEASUREMENT InjSys_flgInjModeCatHeatg "Condition catalyst heating with defined injection mode active for diagnosis of injection timing" UBYTE B_TRUE 1 100 0.00 1.00000000000 BIT_MASK 0x1 FORMAT "%13.11" ECU_ADDRESS 0x70000876 /end MEASUREMENT
/begin MEASUREMENT InjSys_flgInjModReqCvo "Condition injection mode request for CVO(Controlled Valve Operation)" UBYTE B_TRUE 1 100 0.00 1.00000000000 BIT_MASK 0x1 FORMAT "%13.11" ECU_ADDRESS 0x70000878 /end MEASUREMENT
/begin MEASUREMENT InjSys_flgInjModSngMpg "condition single mapping from operation mode to injection mode" UBYTE B_TRUE 1 100 0.00 1.00000000000 BIT_MASK 0x1 FORMAT "%13.11" ECU_ADDRESS 0x7000020A /end MEASUREMENT
/begin MEASUREMENT InjSys_flgInjModTran "condition transition injection mode (timing)" UBYTE B_TRUE 1 100 0.00 1.00000000000 BIT_MASK 0x1 FORMAT "%13.11" ECU_ADDRESS 0x70000877 /end MEASUREMENT
/begin MEASUREMENT InjSys_flgInjTmngErly "Condition early calculation of injection setpoints" UBYTE B_TRUE 1 100 0.00 1.00000000000 BIT_MASK 0x1 FORMAT "%13.11" ECU_ADDRESS 0x70000875 /end MEASUREMENT
/begin MEASUREMENT InjSys_flgMaiCdnCvo "main condition for basic adaption CVO given" UBYTE B_TRUE 1 100 0.00 1.00000000000 BIT_MASK 0x1 FORMAT "%13.11" ECU_ADDRESS 0x70000211 /end MEASUREMENT
/begin MEASUREMENT InjSys_flgMaxSpdSysRelsCvo "Result of hysteresis for deactivating the CVO" UBYTE B_TRUE 1 100 0.00 1.00000000000 BIT_MASK 0x1 FORMAT "%13.11" ECU_ADDRESS 0x70000210 /end MEASUREMENT
/begin MEASUREMENT InjSys_flgMaxTiRailErr "MaxTi limitation due to Rail pressure defect active" UBYTE B_TRUE 1 100 0.00 1.00000000000 BIT_MASK 0x1 FORMAT "%13.11" ECU_ADDRESS 0x7000021F /end MEASUREMENT
/begin MEASUREMENT InjSys_flgMaxTiSoiErr "MaxTi limitation due to Soi defect active" UBYTE B_TRUE 1 100 0.00 1.00000000000 BIT_MASK 0x1 FORMAT "%13.11" ECU_ADDRESS 0x7000021E /end MEASUREMENT
/begin MEASUREMENT InjSys_flgMeaStCvo "CVO Measure need present" UBYTE B_TRUE 1 100 0.00 1.00000000000 BIT_MASK 0x1 FORMAT "%13.11" ECU_ADDRESS 0x70000874 /end MEASUREMENT
/begin MEASUREMENT InjSys_flgMulInjModActv "multiple injections based injection mode is requested and active" UBYTE B_TRUE 1 100 0.00 1.00000000000 BIT_MASK 0x1 FORMAT "%13.11" ECU_ADDRESS 0x70000872 /end MEASUREMENT
/begin MEASUREMENT InjSys_flgMulInjNrCmbPassd "Condition sufficient number of combustions passed for multiple injections diagnosis decision" UBYTE B_TRUE 1 100 0.00 1.00000000000 BIT_MASK 0x1 FORMAT "%13.11" ECU_ADDRESS 0x7000021A /end MEASUREMENT
/begin MEASUREMENT InjSys_flgNotAllwdAgRng "." UBYTE B_TRUE 1 100 0.00 1.00000000000 BIT_MASK 0x1 FORMAT "%13.11" ECU_ADDRESS 0x700001FF /end MEASUREMENT
/begin MEASUREMENT InjSys_flgNotAllwdAgRngDeb "." UBYTE B_TRUE 1 100 0.00 1.00000000000 BIT_MASK 0x1 FORMAT "%13.11" ECU_ADDRESS 0x700001FE /end MEASUREMENT
/begin MEASUREMENT InjSys_flgNotAllwdNEng "flag injection mode not allowed with respect to engine speed" UBYTE B_TRUE 1 100 0.00 1.00000000000 BIT_MASK 0x1 FORMAT "%13.11" ECU_ADDRESS 0x700001FD /end MEASUREMENT
/begin MEASUREMENT InjSys_flgNotAllwdNEngDeb "flag injection mode not allowed with respect to engine speed debounced" UBYTE B_TRUE 1 100 0.00 1.00000000000 BIT_MASK 0x1 FORMAT "%13.11" ECU_ADDRESS 0x700001FC /end MEASUREMENT
/begin MEASUREMENT InjSys_flgNotAllwdTiBreak "flag injection mode not allowed with respect to pause times" UBYTE B_TRUE 1 100 0.00 1.00000000000 BIT_MASK 0x1 FORMAT "%13.11" ECU_ADDRESS 0x700001FB /end MEASUREMENT
/begin MEASUREMENT InjSys_flgNotAllwdTiBreakDeb "flag injection mode not allowed with respect to pause times debounced" UBYTE B_TRUE 1 100 0.00 1.00000000000 BIT_MASK 0x1 FORMAT "%13.11" ECU_ADDRESS 0x700001FA /end MEASUREMENT
/begin MEASUREMENT InjSys_flgNotAllwdTiInjOpen "flag injection mode not allowed with respect to valve open times" UBYTE B_TRUE 1 100 0.00 1.00000000000 BIT_MASK 0x1 FORMAT "%13.11" ECU_ADDRESS 0x700001F9 /end MEASUREMENT
/begin MEASUREMENT InjSys_flgNotAllwdTiInjOpenDeb "flag injection mode not allowed with respect to valve open times debounced" UBYTE B_TRUE 1 100 0.00 1.00000000000 BIT_MASK 0x1 FORMAT "%13.11" ECU_ADDRESS 0x700001F8 /end MEASUREMENT
/begin MEASUREMENT InjSys_flgReqCvoBascAdpnAVS "Request CVO basic adaption through AVS" UBYTE B_TRUE 1 100 0.00 1.00000000000 BIT_MASK 0x1 FORMAT "%13.11" ECU_ADDRESS 0x7000020F /end MEASUREMENT
/begin MEASUREMENT InjSys_flgReqPCvo "Request rail pressure set point for Controlled Valve Operation (CVO)" UBYTE B_TRUE 1 100 0.00 1.00000000000 BIT_MASK 0x1 FORMAT "%13.11" ECU_ADDRESS 0x7000086F /end MEASUREMENT
/begin MEASUREMENT InjSys_flgReqSpRailCvo "Request rail pressure set point for Controlled Valve Operation (CVO)" UBYTE B_TRUE 1 100 0.00 1.00000000000 BIT_MASK 0x1 FORMAT "%13.11" ECU_ADDRESS 0x7000086E /end MEASUREMENT
/begin MEASUREMENT InjSys_flgRstBascAdpnCvo "Flag Reset CVO basic adaption for current rail pressure" UBYTE B_TRUE 1 100 0.00 1.00000000000 BIT_MASK 0x1 FORMAT "%13.11" ECU_ADDRESS 0x7000086D /end MEASUREMENT
/begin MEASUREMENT InjSys_flgRtOptNEng "condition runtime optimization dependent on engine speed" UBYTE B_TRUE 1 100 0.00 1.00000000000 BIT_MASK 0x1 FORMAT "%13.11" ECU_ADDRESS 0x7000086C /end MEASUREMENT
/begin MEASUREMENT InjSys_flgSetCsersDiagDenom "Condition to increment NON-CSERS diagnosis denominator" UBYTE B_TRUE 1 100 0.00 1.00000000000 BIT_MASK 0x1 FORMAT "%13.11" ECU_ADDRESS 0x70000219 /end MEASUREMENT
/begin MEASUREMENT InjSys_flgSetMulInjDiagDenom "Condition to increment multiple injection diagnosis denominator" UBYTE B_TRUE 1 100 0.00 1.00000000000 BIT_MASK 0x1 FORMAT "%13.11" ECU_ADDRESS 0x70000218 /end MEASUREMENT
/begin MEASUREMENT InjSys_flgSpdEnaCvo "Condition motor speed reached" UBYTE B_TRUE 1 100 0.00 1.00000000000 BIT_MASK 0x1 FORMAT "%13.11" ECU_ADDRESS 0x7000020E /end MEASUREMENT
/begin MEASUREMENT InjSys_flgSysEnaCvo "CVO system condition eanable" UBYTE B_TRUE 1 100 0.00 1.00000000000 BIT_MASK 0x1 FORMAT "%13.11" ECU_ADDRESS 0x7000020D /end MEASUREMENT
/begin MEASUREMENT InjSys_flgSysGenRelsCvo "Flag Controlled Valve Operation (CVO) system general release for adaption and learning" UBYTE B_TRUE 1 100 0.00 1.00000000000 BIT_MASK 0x1 FORMAT "%13.11" ECU_ADDRESS 0x7000086B /end MEASUREMENT
/begin MEASUREMENT InjSys_flgSysRdnCvo "switch on condition for basic adaption CVO given" UBYTE B_TRUE 1 100 0.00 1.00000000000 BIT_MASK 0x1 FORMAT "%13.11" ECU_ADDRESS 0x7000086A /end MEASUREMENT
/begin MEASUREMENT InjSys_flgSysRdnReqCvo "Release of CVO basic adaption granted" UBYTE B_TRUE 1 100 0.00 1.00000000000 BIT_MASK 0x1 FORMAT "%13.11" ECU_ADDRESS 0x70000869 /end MEASUREMENT
/begin MEASUREMENT InjSys_flgTestInjCvo "local flag active CVO ballistic test injection" UBYTE B_TRUE 1 100 0.00 1.00000000000 BIT_MASK 0x1 FORMAT "%13.11" ECU_ADDRESS 0x70000868 /end MEASUREMENT
/begin MEASUREMENT InjSys_flgTiMinGdi "Minimal injection time limitation GDI active, bench 1" UBYTE B_TRUE 1 100 0.00 1.00000000000 BIT_MASK 0x1 FORMAT "%13.11" ECU_ADDRESS 0x7000021D /end MEASUREMENT
/begin MEASUREMENT InjSys_flgTPist "Flag to enable injection angle correction based on piston temperature" UBYTE B_TRUE 1 100 0.00 1.00000000000 BIT_MASK 0x1 FORMAT "%13.11" ECU_ADDRESS 0x70002AD5 /end MEASUREMENT
/begin MEASUREMENT InjSys_flgVcosOperCvo "Flag viscosity operation CVO ready" UBYTE B_TRUE 1 100 0.00 1.00000000000 BIT_MASK 0x1 FORMAT "%13.11" ECU_ADDRESS 0x70000867 /end MEASUREMENT
/begin MEASUREMENT InjSys_idxHiSeldRailPCvo "Index of the highest selected rail pressure CVO" UBYTE dez 1 100 0.00 255.0 FORMAT "%5.1" ECU_ADDRESS 0x6000FC36 /end MEASUREMENT
/begin MEASUREMENT InjSys_idxInst "index class instance" UBYTE dez 1 100 0.00 255.0 FORMAT "%5.1" ARRAY_SIZE 3 ECU_ADDRESS 0x700036C4 /end MEASUREMENT
/begin MEASUREMENT InjSys_idxInstStb "index class instance (standby injection mode)" UBYTE dez 1 100 0.00 255.0 FORMAT "%5.1" ARRAY_SIZE 3 ECU_ADDRESS 0x700036C7 /end MEASUREMENT
/begin MEASUREMENT InjSys_idxMaskCvo "CVO mask to release the injection measurement" UWORD dez 1 100 0.00 65535.00 FORMAT "%8.2" ECU_ADDRESS 0x7000393E /end MEASUREMENT
/begin MEASUREMENT InjSys_idxPkt "index packet variant" UBYTE dez 1 100 0.00 255.0 FORMAT "%5.1" ARRAY_SIZE 3 ECU_ADDRESS 0x700036BB /end MEASUREMENT
/begin MEASUREMENT InjSys_idxPktStb "index packet variant (standby injection mode)" UBYTE dez 1 100 0.00 255.0 FORMAT "%5.1" ARRAY_SIZE 3 ECU_ADDRESS 0x700036BE /end MEASUREMENT
/begin MEASUREMENT InjSys_mAirMfIntegEngFirstStrtLoc "local copy integrated air mass flow from engine first start to max. value" UWORD m_uw_b23p3 1 100 0.00 23.30133 FORMAT "%8.5" ECU_ADDRESS 0x70002C0A /end MEASUREMENT
/begin MEASUREMENT InjSys_mskCylInjActvDiag "bit mask injection active for diagnosis of injection timing" UBYTE dez 1 100 0.00 255.0 FORMAT "%5.1" ECU_ADDRESS 0x70002B88 /end MEASUREMENT
/begin MEASUREMENT InjSys_mskCylInjModeDiag "bit mask injection mode for catalyst heating or warmup diagnosis of injection timing" UBYTE dez 1 100 0.00 255.0 FORMAT "%5.1" ECU_ADDRESS 0x70002B87 /end MEASUREMENT
/begin MEASUREMENT InjSys_mskErrCatHeatgDiag "bit mask error diagnosis of injection timing" UBYTE dez 1 100 0.00 255.0 FORMAT "%5.1" ECU_ADDRESS 0x70002B86 /end MEASUREMENT
/begin MEASUREMENT InjSys_nEngHys "engine speed with hysteresis" SWORD EngN 1 100 -16384.00 16383.50 FORMAT "%8.2" ECU_ADDRESS 0x600073E2 /end MEASUREMENT
/begin MEASUREMENT InjSys_nEngMaxCvo "engine speed limit for basic adaption CVO" SWORD EngN 1 100 -16384.00 16383.50 FORMAT "%8.2" ECU_ADDRESS 0x70003AE6 /end MEASUREMENT
/begin MEASUREMENT InjSys_nrCmbCatHeatgDiag "Number of combustions under condition catalyst heating with multiple injection active for CSERS diagnosis" UWORD dez 1 100 0.00 65535.00 FORMAT "%8.2" ECU_ADDRESS 0x7000393C /end MEASUREMENT
/begin MEASUREMENT InjSys_nrCmbCsersStrd "stored value of total combustions at start of CSERS diagnosis" ULONG dez 1 100 0.00 4294967295.00 FORMAT "%13.2" ECU_ADDRESS 0x60002734 /end MEASUREMENT
/begin MEASUREMENT InjSys_nrCmbDurgEmiRedn "Number of combustions under emission reduction condition with multiple injection active for diagnosis" ULONG dez 1 100 0.00 4294967295.00 FORMAT "%13.2" ECU_ADDRESS 0x70003DC4 /end MEASUREMENT
/begin MEASUREMENT InjSys_nrCmbMulInjDelta "number of total combustion for diagnosis reporting." UWORD dez 1 100 0.00 65535.00 FORMAT "%8.2" ECU_ADDRESS 0x600073F2 /end MEASUREMENT
/begin MEASUREMENT InjSys_nrCmbMulInjPrev "previous value of count of total combustions" ULONG dez 1 100 0.00 4294967295.00 FORMAT "%13.2" ECU_ADDRESS 0x60002730 /end MEASUREMENT
/begin MEASUREMENT InjSys_nrCntrAgRngNotAllwd "." UWORD dez 1 100 0.00 65535.00 FORMAT "%8.2" ECU_ADDRESS 0x70002B0C /end MEASUREMENT
/begin MEASUREMENT InjSys_nrCntrNEngNotAllwd "counter engine speed not allowed" UWORD dez 1 100 0.00 65535.00 FORMAT "%8.2" ECU_ADDRESS 0x70002B0A /end MEASUREMENT
/begin MEASUREMENT InjSys_nrCntrTiBreakNotAllwd "counter injection pause time not allowed" UWORD dez 1 100 0.00 65535.00 FORMAT "%8.2" ECU_ADDRESS 0x70002B08 /end MEASUREMENT
/begin MEASUREMENT InjSys_nrCntrTiInjOpenNotAllwd "counter injection open time not allowed" UWORD dez 1 100 0.00 65535.00 FORMAT "%8.2" ECU_ADDRESS 0x70002B06 /end MEASUREMENT
/begin MEASUREMENT InjSys_nrErrCatHeatgDiag "Number of faulty combustions under condition catalyst heating with multiple injection active for CSERS diagnosis" UWORD dez 1 100 0.00 65535.00 FORMAT "%8.2" ECU_ADDRESS 0x7000393A /end MEASUREMENT
/begin MEASUREMENT InjSys_nrErrCmbCsersStrd "stored value of total erroneous combustions at start of CSERS diagnosis" ULONG dez 1 100 0.00 4294967295.00 FORMAT "%13.2" ECU_ADDRESS 0x6000272C /end MEASUREMENT
/begin MEASUREMENT InjSys_nrErrCmbDurgEmiRedn "Number of faulty combustions under emission reduction condition with multiple injection active for diagnosis" ULONG dez 1 100 0.00 4294967295.00 FORMAT "%13.2" ECU_ADDRESS 0x70003DC0 /end MEASUREMENT
/begin MEASUREMENT InjSys_nrErrCmbMulInjDelta "number of erroneous combustions for diagnosis reporting" UWORD dez 1 100 0.00 65535.00 FORMAT "%8.2" ECU_ADDRESS 0x600073F0 /end MEASUREMENT
/begin MEASUREMENT InjSys_nrErrCmbMulInjPrev "previous value of count of erroneous combustions" ULONG dez 1 100 0.00 4294967295.00 FORMAT "%13.2" ECU_ADDRESS 0x60002728 /end MEASUREMENT
/begin MEASUREMENT InjSys_nrErrCmbNumr "total number of faulty combustion during diagnosis for calculation of fault ratio." UWORD dez 1 100 0.00 65535.00 FORMAT "%8.2" ECU_ADDRESS 0x600073EE /end MEASUREMENT
/begin MEASUREMENT InjSys_nrInjCyc "number of injections per working cycle" UBYTE dez 1 100 0.00 255.0 FORMAT "%5.1" ECU_ADDRESS 0x700036B4 /end MEASUREMENT
/begin MEASUREMENT InjSys_nrInjCycSyn0Mem "number of injections per working cycle in S0 cylinder individual. Memory for mixed timing" UBYTE dez 1 100 0.00 255.0 FORMAT "%5.1" ARRAY_SIZE 4 ECU_ADDRESS 0x700036AE /end MEASUREMENT
/begin MEASUREMENT InjSys_nrInjLimdLoc "local copy injection counter with limit" UWORD dez 1 100 0.00 65535.00 FORMAT "%8.2" ECU_ADDRESS 0x70002C08 /end MEASUREMENT
/begin MEASUREMENT InjSys_nrInjLimdLteLocSp "local copy late injection counter with limit" UBYTE dez 1 100 0.00 255.0 FORMAT "%5.1" ECU_ADDRESS 0x70002AD4 /end MEASUREMENT
/begin MEASUREMENT InjSys_nrInjLoc "number of injections per packet (local value)" UWORD dez 1 100 0.00 65535.00 FORMAT "%8.2" ECU_ADDRESS 0x70002AD2 /end MEASUREMENT
/begin MEASUREMENT InjSys_nrInjPhy "number injections per working cycle" UBYTE dez 1 100 0.00 255.0 FORMAT "%5.1" ECU_ADDRESS 0x70002B05 /end MEASUREMENT
/begin MEASUREMENT InjSys_nrInjPhyStb "number injections per working cycle (standby injection mode)" UBYTE dez 1 100 0.00 255.0 FORMAT "%5.1" ECU_ADDRESS 0x70002B04 /end MEASUREMENT
/begin MEASUREMENT InjSys_nrInjPhySyn0 "number injections per working cycle S0 timing" UBYTE dez 1 100 0.00 255.0 FORMAT "%5.1" ECU_ADDRESS 0x70002B03 /end MEASUREMENT
/begin MEASUREMENT InjSys_nrInjPhySyn0Stb "number injections per working cycle S0 timing (standby injection mode)" UBYTE dez 1 100 0.00 255.0 FORMAT "%5.1" ECU_ADDRESS 0x70002B02 /end MEASUREMENT
/begin MEASUREMENT InjSys_nrInjPhySyn1 "number injections per working cycle S1 timing" UBYTE dez 1 100 0.00 255.0 FORMAT "%5.1" ECU_ADDRESS 0x70002B01 /end MEASUREMENT
/begin MEASUREMENT InjSys_nrInjPhySyn1Stb "number injections per working cycle S1 timing (standby injection mode)" UBYTE dez 1 100 0.00 255.0 FORMAT "%5.1" ECU_ADDRESS 0x70002B00 /end MEASUREMENT
/begin MEASUREMENT InjSys_nrInjSpCatHeatgDiag "setpoint for number of injections for diagnosis of injection timing" UBYTE dez 1 100 0.00 255.0 FORMAT "%5.1" ARRAY_SIZE 4 ECU_ADDRESS 0x70002B82 /end MEASUREMENT
/begin MEASUREMENT InjSys_nrMaiInjCyc "number of main injections in working cycle" UBYTE dez 1 100 0.00 255.0 FORMAT "%5.1" ECU_ADDRESS 0x700036A1 /end MEASUREMENT
/begin MEASUREMENT InjSys_nrMaiInjCycCvo "number of main injections local" UBYTE OneToOne 1 100 0.00 255.0 FORMAT "%5.1" ECU_ADDRESS 0x70002B5C /end MEASUREMENT
/begin MEASUREMENT InjSys_nrTotCmbDenom "total number of combustion during diagnosis for calculation of fault ratio." UWORD dez 1 100 0.00 65535.00 FORMAT "%8.2" ECU_ADDRESS 0x600073EC /end MEASUREMENT
/begin MEASUREMENT InjSys_P1V1I1_HO.agBgnEthnltmp "class instance packet 1 variant 1 / temporary base angle ethanol dependent" UBYTE kw_q0p75_o240 1 100 240.0 431.3 FORMAT "%5.1" ECU_ADDRESS 0x70002A4E /end MEASUREMENT
/begin MEASUREMENT InjSys_P1V1I1_HO.agBgnStdtmp "class instance packet 1 variant 1 / temporary standard base angle" UBYTE kw_q0p75_o240 1 100 240.0 431.3 FORMAT "%5.1" ECU_ADDRESS 0x70002A4F /end MEASUREMENT
/begin MEASUREMENT InjSys_P1V1I1_HO.agBgntmp "class instance packet 1 variant 1 / temporary base angle" UBYTE kw_q0p75_o240 1 100 240.0 431.3 FORMAT "%5.1" ECU_ADDRESS 0x70002A50 /end MEASUREMENT
/begin MEASUREMENT InjSys_P1V1I1_HO.flgAgBgnLamActv "class instance packet 1 variant 1 / flag for base angle lamda active" UBYTE B_TRUE 1 100 0.00 1.00000000000 BIT_MASK 0x1 FORMAT "%13.11" ECU_ADDRESS 0x70002A51 /end MEASUREMENT
/begin MEASUREMENT InjSys_P1V1I1_HO.flgTPistCorrnActv "class instance packet 1 variant 1 / Condition injection angle correction based on piston temperature active" UBYTE B_TRUE 1 100 0.00 1.00000000000 BIT_MASK 0x1 FORMAT "%13.11" ECU_ADDRESS 0x70002A52 /end MEASUREMENT
/begin MEASUREMENT InjSys_P1V1I2_HO.agBgnEthnltmp " / temporary base angle ethanol dependent" UBYTE kw_q0p75_o240 1 100 240.0 431.3 FORMAT "%5.1" ECU_ADDRESS 0x70002ABE /end MEASUREMENT
/begin MEASUREMENT InjSys_P1V1I2_HO.agBgnStdtmp " / temporary standard base angle" UBYTE kw_q0p75_o240 1 100 240.0 431.3 FORMAT "%5.1" ECU_ADDRESS 0x70002ABF /end MEASUREMENT
/begin MEASUREMENT InjSys_P1V1I2_HO.agBgntmp " / temporary base angle" UBYTE kw_q0p75_o240 1 100 240.0 431.3 FORMAT "%5.1" ECU_ADDRESS 0x70002AC0 /end MEASUREMENT
/begin MEASUREMENT InjSys_P1V1I2_HO.flgAgBgnLamActv " / flag for base angle lamda active" UBYTE B_TRUE 1 100 0.00 1.00000000000 BIT_MASK 0x1 FORMAT "%13.11" ECU_ADDRESS 0x70002AC1 /end MEASUREMENT
/begin MEASUREMENT InjSys_P1V1I2_HO.flgTPistCorrnActv " / Condition injection angle correction based on piston temperature active" UBYTE B_TRUE 1 100 0.00 1.00000000000 BIT_MASK 0x1 FORMAT "%13.11" ECU_ADDRESS 0x70002AC2 /end MEASUREMENT
/begin MEASUREMENT InjSys_P1V2I1_HO.agBgnEthnltmp "class instance packet 1 variant 2 / temporary base angle ethanol dependent" UBYTE kw_q0p75_o240 1 100 240.0 431.3 FORMAT "%5.1" ECU_ADDRESS 0x70002A48 /end MEASUREMENT
/begin MEASUREMENT InjSys_P1V2I1_HO.agBgnStdtmp "class instance packet 1 variant 2 / temporary standard base angle" UBYTE kw_q0p75_o240 1 100 240.0 431.3 FORMAT "%5.1" ECU_ADDRESS 0x70002A49 /end MEASUREMENT
/begin MEASUREMENT InjSys_P1V2I1_HO.agBgntmp "class instance packet 1 variant 2 / temporary base angle" UBYTE kw_q0p75_o240 1 100 240.0 431.3 FORMAT "%5.1" ECU_ADDRESS 0x70002A4A /end MEASUREMENT
/begin MEASUREMENT InjSys_P1V2I1_HO.flgAgBgnLamActv "class instance packet 1 variant 2 / ." UBYTE B_TRUE 1 100 0.00 1.00000000000 BIT_MASK 0x1 FORMAT "%13.11" ECU_ADDRESS 0x70002A4B /end MEASUREMENT
/begin MEASUREMENT InjSys_P1V2I1_HO.flgTPistCorrnActv "class instance packet 1 variant 2 / condition pilot injection" UBYTE B_TRUE 1 100 0.00 1.00000000000 BIT_MASK 0x1 FORMAT "%13.11" ECU_ADDRESS 0x70002A4C /end MEASUREMENT
/begin MEASUREMENT InjSys_P1V2I2_HO.agBgnEthnltmp " / temporary base angle ethanol dependent" UBYTE kw_q0p75_o240 1 100 240.0 431.3 FORMAT "%5.1" ECU_ADDRESS 0x70002AB8 /end MEASUREMENT
/begin MEASUREMENT InjSys_P1V2I2_HO.agBgnStdtmp " / temporary standard base angle" UBYTE kw_q0p75_o240 1 100 240.0 431.3 FORMAT "%5.1" ECU_ADDRESS 0x70002AB9 /end MEASUREMENT
/begin MEASUREMENT InjSys_P1V2I2_HO.agBgntmp " / temporary base angle" UBYTE kw_q0p75_o240 1 100 240.0 431.3 FORMAT "%5.1" ECU_ADDRESS 0x70002ABA /end MEASUREMENT
/begin MEASUREMENT InjSys_P1V2I2_HO.flgAgBgnLamActv " / ." UBYTE B_TRUE 1 100 0.00 1.00000000000 BIT_MASK 0x1 FORMAT "%13.11" ECU_ADDRESS 0x70002ABB /end MEASUREMENT
/begin MEASUREMENT InjSys_P1V2I2_HO.flgTPistCorrnActv " / condition pilot injection" UBYTE B_TRUE 1 100 0.00 1.00000000000 BIT_MASK 0x1 FORMAT "%13.11" ECU_ADDRESS 0x70002ABC /end MEASUREMENT
/begin MEASUREMENT InjSys_P1V3I1_HO.agBgnEthnltmp "class instance packet 1 variant 3 / ." UBYTE kw_q0p75_o240 1 100 240.0 431.3 FORMAT "%5.1" ECU_ADDRESS 0x70002A42 /end MEASUREMENT
/begin MEASUREMENT InjSys_P1V3I1_HO.agBgnStdtmp "class instance packet 1 variant 3 / ." UBYTE kw_q0p75_o240 1 100 240.0 431.3 FORMAT "%5.1" ECU_ADDRESS 0x70002A43 /end MEASUREMENT
/begin MEASUREMENT InjSys_P1V3I1_HO.agBgntmp "class instance packet 1 variant 3 / ." UBYTE kw_q0p75_o240 1 100 240.0 431.3 FORMAT "%5.1" ECU_ADDRESS 0x70002A44 /end MEASUREMENT
/begin MEASUREMENT InjSys_P1V3I1_HO.flgAgBgnLamActv "class instance packet 1 variant 3 / ." UBYTE B_TRUE 1 100 0.00 1.00000000000 BIT_MASK 0x1 FORMAT "%13.11" ECU_ADDRESS 0x70002A45 /end MEASUREMENT
/begin MEASUREMENT InjSys_P1V3I1_HO.flgTPistCorrnActv "class instance packet 1 variant 3 / condition pilot injection" UBYTE B_TRUE 1 100 0.00 1.00000000000 BIT_MASK 0x1 FORMAT "%13.11" ECU_ADDRESS 0x70002A46 /end MEASUREMENT
/begin MEASUREMENT InjSys_P1V3I2_HO.agBgnEthnltmp " / ." UBYTE kw_q0p75_o240 1 100 240.0 431.3 FORMAT "%5.1" ECU_ADDRESS 0x70002AB2 /end MEASUREMENT
/begin MEASUREMENT InjSys_P1V3I2_HO.agBgnStdtmp " / ." UBYTE kw_q0p75_o240 1 100 240.0 431.3 FORMAT "%5.1" ECU_ADDRESS 0x70002AB3 /end MEASUREMENT
/begin MEASUREMENT InjSys_P1V3I2_HO.agBgntmp " / ." UBYTE kw_q0p75_o240 1 100 240.0 431.3 FORMAT "%5.1" ECU_ADDRESS 0x70002AB4 /end MEASUREMENT
/begin MEASUREMENT InjSys_P1V3I2_HO.flgAgBgnLamActv " / ." UBYTE B_TRUE 1 100 0.00 1.00000000000 BIT_MASK 0x1 FORMAT "%13.11" ECU_ADDRESS 0x70002AB5 /end MEASUREMENT
/begin MEASUREMENT InjSys_P1V3I2_HO.flgTPistCorrnActv " / condition pilot injection" UBYTE B_TRUE 1 100 0.00 1.00000000000 BIT_MASK 0x1 FORMAT "%13.11" ECU_ADDRESS 0x70002AB6 /end MEASUREMENT
/begin MEASUREMENT InjSys_P1V4I1_HP.agBas1 "class instance packet 1 variant 4 / base angle" SWORD kw_q0p0234 1 100 -768.0000 767.9766 FORMAT "%8.4" ECU_ADDRESS 0x70002A36 /end MEASUREMENT
/begin MEASUREMENT InjSys_P1V4I1_HP.agBas2 "class instance packet 1 variant 4 / base angle from interpolation" SWORD kw_q0p0234 1 100 -768.0000 767.9766 FORMAT "%8.4" ECU_ADDRESS 0x70002A38 /end MEASUREMENT
/begin MEASUREMENT InjSys_P1V4I1_HP.agBgnEthnltmp "class instance packet 1 variant 4 / ." SWORD kw_q0p0234 1 100 -768.0000 767.9766 FORMAT "%8.4" ECU_ADDRESS 0x70002A3A /end MEASUREMENT
/begin MEASUREMENT InjSys_P1V4I1_HP.agBgnStdtmp "class instance packet 1 variant 4 / ." SWORD kw_q0p0234 1 100 -768.0000 767.9766 FORMAT "%8.4" ECU_ADDRESS 0x70002A3C /end MEASUREMENT
/begin MEASUREMENT InjSys_P1V4I1_HP.agBgntmp "class instance packet 1 variant 4 / ." SWORD kw_q0p0234 1 100 -768.0000 767.9766 FORMAT "%8.4" ECU_ADDRESS 0x70002A3E /end MEASUREMENT
/begin MEASUREMENT InjSys_P1V4I1_HP.flgAgBgnLamActv "class instance packet 1 variant 4 / ." UBYTE B_TRUE 1 100 0.00 1.00000000000 BIT_MASK 0x1 FORMAT "%13.11" ECU_ADDRESS 0x70002A40 /end MEASUREMENT
/begin MEASUREMENT InjSys_P1V4I1_HP.flgTPistCorrnActv "class instance packet 1 variant 4 / condition map selection with group axis in version 2" UBYTE B_TRUE 1 100 0.00 1.00000000000 BIT_MASK 0x1 FORMAT "%13.11" ECU_ADDRESS 0x70002A41 /end MEASUREMENT
/begin MEASUREMENT InjSys_P1V4I2_HP.agBas1 " / base angle" SWORD kw_q0p0234 1 100 -768.0000 767.9766 FORMAT "%8.4" ECU_ADDRESS 0x70002AA6 /end MEASUREMENT
/begin MEASUREMENT InjSys_P1V4I2_HP.agBas2 " / base angle from interpolation" SWORD kw_q0p0234 1 100 -768.0000 767.9766 FORMAT "%8.4" ECU_ADDRESS 0x70002AA8 /end MEASUREMENT
/begin MEASUREMENT InjSys_P1V4I2_HP.agBgnEthnltmp " / ." SWORD kw_q0p0234 1 100 -768.0000 767.9766 FORMAT "%8.4" ECU_ADDRESS 0x70002AAA /end MEASUREMENT
/begin MEASUREMENT InjSys_P1V4I2_HP.agBgnStdtmp " / ." SWORD kw_q0p0234 1 100 -768.0000 767.9766 FORMAT "%8.4" ECU_ADDRESS 0x70002AAC /end MEASUREMENT
/begin MEASUREMENT InjSys_P1V4I2_HP.agBgntmp " / ." SWORD kw_q0p0234 1 100 -768.0000 767.9766 FORMAT "%8.4" ECU_ADDRESS 0x70002AAE /end MEASUREMENT
/begin MEASUREMENT InjSys_P1V4I2_HP.flgAgBgnLamActv " / ." UBYTE B_TRUE 1 100 0.00 1.00000000000 BIT_MASK 0x1 FORMAT "%13.11" ECU_ADDRESS 0x70002AB0 /end MEASUREMENT
/begin MEASUREMENT InjSys_P1V4I2_HP.flgTPistCorrnActv " / condition map selection with group axis in version 2" UBYTE B_TRUE 1 100 0.00 1.00000000000 BIT_MASK 0x1 FORMAT "%13.11" ECU_ADDRESS 0x70002AB1 /end MEASUREMENT
/begin MEASUREMENT InjSys_P1V4I3_HP.agBas1 " / base angle" SWORD kw_q0p0234 1 100 -768.0000 767.9766 FORMAT "%8.4" ECU_ADDRESS 0x70002A9A /end MEASUREMENT
/begin MEASUREMENT InjSys_P1V4I3_HP.agBas2 " / base angle from interpolation" SWORD kw_q0p0234 1 100 -768.0000 767.9766 FORMAT "%8.4" ECU_ADDRESS 0x70002A9C /end MEASUREMENT
/begin MEASUREMENT InjSys_P1V4I3_HP.agBgnEthnltmp " / ." SWORD kw_q0p0234 1 100 -768.0000 767.9766 FORMAT "%8.4" ECU_ADDRESS 0x70002A9E /end MEASUREMENT
/begin MEASUREMENT InjSys_P1V4I3_HP.agBgnStdtmp " / ." SWORD kw_q0p0234 1 100 -768.0000 767.9766 FORMAT "%8.4" ECU_ADDRESS 0x70002AA0 /end MEASUREMENT
/begin MEASUREMENT InjSys_P1V4I3_HP.agBgntmp " / ." SWORD kw_q0p0234 1 100 -768.0000 767.9766 FORMAT "%8.4" ECU_ADDRESS 0x70002AA2 /end MEASUREMENT
/begin MEASUREMENT InjSys_P1V4I3_HP.flgAgBgnLamActv " / ." UBYTE B_TRUE 1 100 0.00 1.00000000000 BIT_MASK 0x1 FORMAT "%13.11" ECU_ADDRESS 0x70002AA4 /end MEASUREMENT
/begin MEASUREMENT InjSys_P1V4I3_HP.flgTPistCorrnActv " / condition map selection with group axis in version 2" UBYTE B_TRUE 1 100 0.00 1.00000000000 BIT_MASK 0x1 FORMAT "%13.11" ECU_ADDRESS 0x70002AA5 /end MEASUREMENT
/begin MEASUREMENT InjSys_P1V4I4_HP.agBas1 " / base angle" SWORD kw_q0p0234 1 100 -768.0000 767.9766 FORMAT "%8.4" ECU_ADDRESS 0x70002A8E /end MEASUREMENT
/begin MEASUREMENT InjSys_P1V4I4_HP.agBas2 " / base angle from interpolation" SWORD kw_q0p0234 1 100 -768.0000 767.9766 FORMAT "%8.4" ECU_ADDRESS 0x70002A90 /end MEASUREMENT
/begin MEASUREMENT InjSys_P1V4I4_HP.agBgnEthnltmp " / ." SWORD kw_q0p0234 1 100 -768.0000 767.9766 FORMAT "%8.4" ECU_ADDRESS 0x70002A92 /end MEASUREMENT
/begin MEASUREMENT InjSys_P1V4I4_HP.agBgnStdtmp " / ." SWORD kw_q0p0234 1 100 -768.0000 767.9766 FORMAT "%8.4" ECU_ADDRESS 0x70002A94 /end MEASUREMENT
/begin MEASUREMENT InjSys_P1V4I4_HP.agBgntmp " / ." SWORD kw_q0p0234 1 100 -768.0000 767.9766 FORMAT "%8.4" ECU_ADDRESS 0x70002A96 /end MEASUREMENT
/begin MEASUREMENT InjSys_P1V4I4_HP.flgAgBgnLamActv " / ." UBYTE B_TRUE 1 100 0.00 1.00000000000 BIT_MASK 0x1 FORMAT "%13.11" ECU_ADDRESS 0x70002A98 /end MEASUREMENT
/begin MEASUREMENT InjSys_P1V4I4_HP.flgTPistCorrnActv " / condition map selection with group axis in version 2" UBYTE B_TRUE 1 100 0.00 1.00000000000 BIT_MASK 0x1 FORMAT "%13.11" ECU_ADDRESS 0x70002A99 /end MEASUREMENT
/begin MEASUREMENT InjSys_P1V4I5_HP.agBas1 " / base angle" SWORD kw_q0p0234 1 100 -768.0000 767.9766 FORMAT "%8.4" ECU_ADDRESS 0x70002A82 /end MEASUREMENT
/begin MEASUREMENT InjSys_P1V4I5_HP.agBas2 " / base angle from interpolation" SWORD kw_q0p0234 1 100 -768.0000 767.9766 FORMAT "%8.4" ECU_ADDRESS 0x70002A84 /end MEASUREMENT
/begin MEASUREMENT InjSys_P1V4I5_HP.agBgnEthnltmp " / ." SWORD kw_q0p0234 1 100 -768.0000 767.9766 FORMAT "%8.4" ECU_ADDRESS 0x70002A86 /end MEASUREMENT
/begin MEASUREMENT InjSys_P1V4I5_HP.agBgnStdtmp " / ." SWORD kw_q0p0234 1 100 -768.0000 767.9766 FORMAT "%8.4" ECU_ADDRESS 0x70002A88 /end MEASUREMENT
/begin MEASUREMENT InjSys_P1V4I5_HP.agBgntmp " / ." SWORD kw_q0p0234 1 100 -768.0000 767.9766 FORMAT "%8.4" ECU_ADDRESS 0x70002A8A /end MEASUREMENT
/begin MEASUREMENT InjSys_P1V4I5_HP.flgAgBgnLamActv " / ." UBYTE B_TRUE 1 100 0.00 1.00000000000 BIT_MASK 0x1 FORMAT "%13.11" ECU_ADDRESS 0x70002A8C /end MEASUREMENT
/begin MEASUREMENT InjSys_P1V4I5_HP.flgTPistCorrnActv " / condition map selection with group axis in version 2" UBYTE B_TRUE 1 100 0.00 1.00000000000 BIT_MASK 0x1 FORMAT "%13.11" ECU_ADDRESS 0x70002A8D /end MEASUREMENT
/begin MEASUREMENT InjSys_P1V4I6_HP.agBas1 " / base angle" SWORD kw_q0p0234 1 100 -768.0000 767.9766 FORMAT "%8.4" ECU_ADDRESS 0x70002A76 /end MEASUREMENT
/begin MEASUREMENT InjSys_P1V4I6_HP.agBas2 " / base angle from interpolation" SWORD kw_q0p0234 1 100 -768.0000 767.9766 FORMAT "%8.4" ECU_ADDRESS 0x70002A78 /end MEASUREMENT
/begin MEASUREMENT InjSys_P1V4I6_HP.agBgnEthnltmp " / ." SWORD kw_q0p0234 1 100 -768.0000 767.9766 FORMAT "%8.4" ECU_ADDRESS 0x70002A7A /end MEASUREMENT
/begin MEASUREMENT InjSys_P1V4I6_HP.agBgnStdtmp " / ." SWORD kw_q0p0234 1 100 -768.0000 767.9766 FORMAT "%8.4" ECU_ADDRESS 0x70002A7C /end MEASUREMENT
/begin MEASUREMENT InjSys_P1V4I6_HP.agBgntmp " / ." SWORD kw_q0p0234 1 100 -768.0000 767.9766 FORMAT "%8.4" ECU_ADDRESS 0x70002A7E /end MEASUREMENT
/begin MEASUREMENT InjSys_P1V4I6_HP.flgAgBgnLamActv " / ." UBYTE B_TRUE 1 100 0.00 1.00000000000 BIT_MASK 0x1 FORMAT "%13.11" ECU_ADDRESS 0x70002A80 /end MEASUREMENT
/begin MEASUREMENT InjSys_P1V4I6_HP.flgTPistCorrnActv " / condition map selection with group axis in version 2" UBYTE B_TRUE 1 100 0.00 1.00000000000 BIT_MASK 0x1 FORMAT "%13.11" ECU_ADDRESS 0x70002A81 /end MEASUREMENT
/begin MEASUREMENT InjSys_P2V1I1_HP.agBasEthnltmp "class instance packet 2 variant 1 / ." SWORD kw_q0p0234 1 100 -768.0000 767.9766 FORMAT "%8.4" ECU_ADDRESS 0x70002A2A /end MEASUREMENT
/begin MEASUREMENT InjSys_P2V1I1_HP.agBasStdtmp "class instance packet 2 variant 1 / ." SWORD kw_q0p0234 1 100 -768.0000 767.9766 FORMAT "%8.4" ECU_ADDRESS 0x70002A2C /end MEASUREMENT
/begin MEASUREMENT InjSys_P2V1I1_HP.agBastmp "class instance packet 2 variant 1 / ." SWORD kw_q0p0234 1 100 -768.0000 767.9766 FORMAT "%8.4" ECU_ADDRESS 0x70002A2E /end MEASUREMENT
/begin MEASUREMENT InjSys_P2V1I1_HP.facFuMEthnltmp "class instance packet 2 variant 1 / temporary relative fuel mass ethanol dependent" UBYTE fak_ub_b1 1 100 0.00 0.9961 ECU_ADDRESS 0x70002A30 /end MEASUREMENT
/begin MEASUREMENT InjSys_P2V1I1_HP.facFuMtmp "class instance packet 2 variant 1 / Temporary variable" UBYTE fak_ub_b1 1 100 0.00 0.9961 ECU_ADDRESS 0x70002A31 /end MEASUREMENT
/begin MEASUREMENT InjSys_P2V1I1_HP.flgTPistCorrnActv "class instance packet 2 variant 1 / Flag to indicate TSA feature is active" UBYTE B_TRUE 1 100 0.00 1.00000000000 BIT_MASK 0x1 FORMAT "%13.11" ECU_ADDRESS 0x70002A32 /end MEASUREMENT
/begin MEASUREMENT InjSys_P2V1I1_HP.ratFuMStdtmp "class instance packet 2 variant 1 / standard relative fuel mass" UWORD rel_uw_b3072 1 100 0.00 3071.953 FORMAT "%8.3" ECU_ADDRESS 0x70002A34 /end MEASUREMENT
/begin MEASUREMENT InjSys_P2V1I2_HP.agBasEthnltmp " / ." SWORD kw_q0p0234 1 100 -768.0000 767.9766 FORMAT "%8.4" ECU_ADDRESS 0x70002A6A /end MEASUREMENT
/begin MEASUREMENT InjSys_P2V1I2_HP.agBasStdtmp " / ." SWORD kw_q0p0234 1 100 -768.0000 767.9766 FORMAT "%8.4" ECU_ADDRESS 0x70002A6C /end MEASUREMENT
/begin MEASUREMENT InjSys_P2V1I2_HP.agBastmp " / ." SWORD kw_q0p0234 1 100 -768.0000 767.9766 FORMAT "%8.4" ECU_ADDRESS 0x70002A6E /end MEASUREMENT
/begin MEASUREMENT InjSys_P2V1I2_HP.facFuMEthnltmp " / temporary relative fuel mass ethanol dependent" UBYTE fak_ub_b1 1 100 0.00 0.9961 ECU_ADDRESS 0x70002A70 /end MEASUREMENT
/begin MEASUREMENT InjSys_P2V1I2_HP.facFuMtmp " / Temporary variable" UBYTE fak_ub_b1 1 100 0.00 0.9961 ECU_ADDRESS 0x70002A71 /end MEASUREMENT
/begin MEASUREMENT InjSys_P2V1I2_HP.flgTPistCorrnActv " / Flag to indicate TSA feature is active" UBYTE B_TRUE 1 100 0.00 1.00000000000 BIT_MASK 0x1 FORMAT "%13.11" ECU_ADDRESS 0x70002A72 /end MEASUREMENT
/begin MEASUREMENT InjSys_P2V1I2_HP.ratFuMStdtmp " / standard relative fuel mass" UWORD rel_uw_b3072 1 100 0.00 3071.953 FORMAT "%8.3" ECU_ADDRESS 0x70002A74 /end MEASUREMENT
/begin MEASUREMENT InjSys_P2V1I3_HP.agBasEthnltmp " / ." SWORD kw_q0p0234 1 100 -768.0000 767.9766 FORMAT "%8.4" ECU_ADDRESS 0x70002A5E /end MEASUREMENT
/begin MEASUREMENT InjSys_P2V1I3_HP.agBasStdtmp " / ." SWORD kw_q0p0234 1 100 -768.0000 767.9766 FORMAT "%8.4" ECU_ADDRESS 0x70002A60 /end MEASUREMENT
/begin MEASUREMENT InjSys_P2V1I3_HP.agBastmp " / ." SWORD kw_q0p0234 1 100 -768.0000 767.9766 FORMAT "%8.4" ECU_ADDRESS 0x70002A62 /end MEASUREMENT
/begin MEASUREMENT InjSys_P2V1I3_HP.facFuMEthnltmp " / temporary relative fuel mass ethanol dependent" UBYTE fak_ub_b1 1 100 0.00 0.9961 ECU_ADDRESS 0x70002A64 /end MEASUREMENT
/begin MEASUREMENT InjSys_P2V1I3_HP.facFuMtmp " / Temporary variable" UBYTE fak_ub_b1 1 100 0.00 0.9961 ECU_ADDRESS 0x70002A65 /end MEASUREMENT
/begin MEASUREMENT InjSys_P2V1I3_HP.flgTPistCorrnActv " / Flag to indicate TSA feature is active" UBYTE B_TRUE 1 100 0.00 1.00000000000 BIT_MASK 0x1 FORMAT "%13.11" ECU_ADDRESS 0x70002A66 /end MEASUREMENT
/begin MEASUREMENT InjSys_P2V1I3_HP.ratFuMStdtmp " / standard relative fuel mass" UWORD rel_uw_b3072 1 100 0.00 3071.953 FORMAT "%8.3" ECU_ADDRESS 0x70002A68 /end MEASUREMENT
/begin MEASUREMENT InjSys_P2V2I1_HP.agBasEthnltmp "class instance packet 2 variant 2 / ." SWORD kw_q0p0234 1 100 -768.0000 767.9766 FORMAT "%8.4" ECU_ADDRESS 0x70002A22 /end MEASUREMENT
/begin MEASUREMENT InjSys_P2V2I1_HP.agBasStdtmp "class instance packet 2 variant 2 / ." SWORD kw_q0p0234 1 100 -768.0000 767.9766 FORMAT "%8.4" ECU_ADDRESS 0x70002A24 /end MEASUREMENT
/begin MEASUREMENT InjSys_P2V2I1_HP.agBastmp "class instance packet 2 variant 2 / ." SWORD kw_q0p0234 1 100 -768.0000 767.9766 FORMAT "%8.4" ECU_ADDRESS 0x70002A26 /end MEASUREMENT
/begin MEASUREMENT InjSys_P2V2I1_HP.flgTPistCorrnActv "class instance packet 2 variant 2 / Flag to indicate TSA feature is active" UBYTE B_TRUE 1 100 0.00 1.00000000000 BIT_MASK 0x1 FORMAT "%13.11" ECU_ADDRESS 0x70002A28 /end MEASUREMENT
/begin MEASUREMENT InjSys_P2V2I2_HP.agBasEthnltmp " / ." SWORD kw_q0p0234 1 100 -768.0000 767.9766 FORMAT "%8.4" ECU_ADDRESS 0x70002A56 /end MEASUREMENT
/begin MEASUREMENT InjSys_P2V2I2_HP.agBasStdtmp " / ." SWORD kw_q0p0234 1 100 -768.0000 767.9766 FORMAT "%8.4" ECU_ADDRESS 0x70002A58 /end MEASUREMENT
/begin MEASUREMENT InjSys_P2V2I2_HP.agBastmp " / ." SWORD kw_q0p0234 1 100 -768.0000 767.9766 FORMAT "%8.4" ECU_ADDRESS 0x70002A5A /end MEASUREMENT
/begin MEASUREMENT InjSys_P2V2I2_HP.flgTPistCorrnActv " / Flag to indicate TSA feature is active" UBYTE B_TRUE 1 100 0.00 1.00000000000 BIT_MASK 0x1 FORMAT "%13.11" ECU_ADDRESS 0x70002A5C /end MEASUREMENT
/begin MEASUREMENT InjSys_P2V3I1_HP.flgTPistCorrnActv "class instance packet 2 variant 3 / Flag to indicate TSA feature is active" UBYTE B_TRUE 1 100 0.00 1.00000000000 BIT_MASK 0x1 FORMAT "%13.11" ECU_ADDRESS 0x70002A21 /end MEASUREMENT
/begin MEASUREMENT InjSys_P2V4I1_HP.flgTPistCorrnActv "class instance packet 2 variant 2 / Flag to indicate TSA feature is active" UBYTE B_TRUE 1 100 0.00 1.00000000000 BIT_MASK 0x1 FORMAT "%13.11" ECU_ADDRESS 0x70002A20 /end MEASUREMENT
/begin MEASUREMENT InjSys_P2V5I1_HP.flgTPistCorrnActv "class instance packet 2 variant 5 / Flag to indicate TSA feature is active" UBYTE B_TRUE 1 100 0.00 1.00000000000 BIT_MASK 0x1 FORMAT "%13.11" ECU_ADDRESS 0x70002A1C /end MEASUREMENT
/begin MEASUREMENT InjSys_P3V5I1_HPZ.agDelta "class instance packet 3 variant 5 / delta angle" SBYTE kw_q0p375 1 100 -48.00 47.63 FORMAT "%5.2" ECU_ADDRESS 0x70002A1B /end MEASUREMENT
/begin MEASUREMENT InjSys_P3V5I2_HPZ.agDelta " / delta angle" SBYTE kw_q0p375 1 100 -48.00 47.63 FORMAT "%5.2" ECU_ADDRESS 0x70002A54 /end MEASUREMENT
/begin MEASUREMENT InjSys_pCvoExtdRng "copy of the pressure-setpoints for CVO" UWORD RBPtCel_p_0p002_1 1 100 0.00 131.0700 FORMAT "%8.4" ARRAY_SIZE 5 ECU_ADDRESS 0x6000942C /end MEASUREMENT
/begin MEASUREMENT InjSys_pFu "temporary local fuel rail pressure interpolation point" UWORD RBPtCel_p_0p002_1 1 100 0.00 131.0700 FORMAT "%8.4" ECU_ADDRESS 0x600073F4 /end MEASUREMENT
/begin MEASUREMENT InjSys_pHiSeldRailPCvo "The highest selected rail pressure CVO" UWORD RBPtCel_p_0p002_1 1 100 0.00 131.0700 FORMAT "%8.4" ECU_ADDRESS 0x6000942A /end MEASUREMENT
/begin MEASUREMENT InjSys_pPntOperCvoExtdRng "CVO pressure setpoint for the injection pulse" UWORD RBPtCel_p_0p002_1 1 100 0.00 131.0700 FORMAT "%8.4" ARRAY_SIZE 4 ECU_ADDRESS 0x70003908 /end MEASUREMENT
/begin MEASUREMENT InjSys_pPRailCvoExtdRng "CVO rail pressure to the priority characteristic curve" UWORD RBPtCel_p_0p002_1 1 100 0.00 131.0700 FORMAT "%8.4" ECU_ADDRESS 0x6000741A /end MEASUREMENT
/begin MEASUREMENT InjSys_pSpRailCvo "Rail pressure set point for CVO" UBYTE p_q0p128 1 100 0.00 32.64 FORMAT "%5.2" ECU_ADDRESS 0x6000FC34 /end MEASUREMENT
/begin MEASUREMENT InjSys_pSpRailCvoExtdRng "Rail pressure set point for CVO(Controlled Valve Operation)" UWORD RBPtCel_p_0p002_1 1 100 0.00 131.0700 FORMAT "%8.4" ECU_ADDRESS 0x60009428 /end MEASUREMENT
/begin MEASUREMENT InjSys_rAppLocSp "Standardized accelerator pedal position local" SWORD Prc 1 100 -400.0000 399.9878 FORMAT "%8.4" ECU_ADDRESS 0x70002AD0 /end MEASUREMENT
/begin MEASUREMENT InjSys_ratAirChrgPredAddlCalcn "relative air charge predicted for injection calculation local copy" UWORD rel_uw_q0p0234 1 100 0.00 1535.977 FORMAT "%8.3" ECU_ADDRESS 0x60007422 /end MEASUREMENT
/begin MEASUREMENT InjSys_ratAirChrgPredLoc "local copy rel. air charge predicted for injection calculation" UWORD rel_uw_q0p0234 1 100 0.00 1535.977 FORMAT "%8.3" ECU_ADDRESS 0x70002C06 /end MEASUREMENT
/begin MEASUREMENT InjSys_ratAirMAgSpAxisInp "Input interface for IInjSys_ratAirM12AgSp_AX" UWORD rel_uw_q0p0234 1 100 0.00 1535.977 FORMAT "%8.3" ECU_ADDRESS 0x70002C04 /end MEASUREMENT
/begin MEASUREMENT InjSys_ratAirMAgSpHspAxisInp "Input interface for IInjSys_ratAirM12AgSpHsp_AX" UWORD rel_uw_q0p0234 1 100 0.00 1535.977 FORMAT "%8.3" ECU_ADDRESS 0x70002C02 /end MEASUREMENT
/begin MEASUREMENT InjSys_ratAirMAgSpHspVers2AxisInp "Input interface for InjSys_ratAirM12AgSpHspVers2_AX" UWORD rel_uw_q0p0234 1 100 0.00 1535.977 FORMAT "%8.3" ECU_ADDRESS 0x70002C00 /end MEASUREMENT
/begin MEASUREMENT InjSys_ratAirMAgSpVers2AxisInp "Input interface for InjSys_ratAirM12AgSpVers2_AX" UWORD rel_uw_q0p0234 1 100 0.00 1535.977 FORMAT "%8.3" ECU_ADDRESS 0x70002BFE /end MEASUREMENT
/begin MEASUREMENT InjSys_ratAirMAxisInp "input interface for InjSys_ratAirM08_AX and InjSys_ratAirM12_AX" UWORD rel_uw_q0p0234 1 100 0.00 1535.977 FORMAT "%8.3" ECU_ADDRESS 0x70002BFC /end MEASUREMENT
/begin MEASUREMENT InjSys_ratAirmPrdcLocChk "." UWORD rel_uw_q0p0234 1 100 0.00 1535.977 FORMAT "%8.3" ECU_ADDRESS 0x70002AFE /end MEASUREMENT
/begin MEASUREMENT InjSys_ratAirMPredLocSp "relative air charge predicted local" UWORD rel_uw_q0p0234 1 100 0.00 1535.977 FORMAT "%8.3" ECU_ADDRESS 0x70002ACE /end MEASUREMENT
/begin MEASUREMENT InjSys_ratAirMVers2AxisInp "input interface for InjSys_ratAirM08Vers2_AX and InjSys_ratAirM12Vers2_AX" UWORD rel_uw_q0p0234 1 100 0.00 1535.977 FORMAT "%8.3" ECU_ADDRESS 0x70002BFA /end MEASUREMENT
/begin MEASUREMENT InjSys_ratCmbErrCsers "Fault ratio for CSERS diagnosis" UWORD fak_uw_b2 1 100 0.00 1.999969 FORMAT "%8.6" ECU_ADDRESS 0x600073EA /end MEASUREMENT
/begin MEASUREMENT InjSys_ratCmbErrMulInj "Fault ratio for multiple injection diagnosis" UWORD fak_uw_b2 1 100 0.00 1.999969 FORMAT "%8.6" ECU_ADDRESS 0x600073E8 /end MEASUREMENT
/begin MEASUREMENT InjSys_ratEngLoadHys "relative engine speed with hysteresis" UWORD rel_uw_q0p0234 1 100 0.00 1535.977 FORMAT "%8.3" ECU_ADDRESS 0x600073E0 /end MEASUREMENT
/begin MEASUREMENT InjSys_ratEthPrtnBascFu "Ethanol content of the basic fuel" UWORD rel_uw_b100 1 100 0.00 99.99847 FORMAT "%8.5" ECU_ADDRESS 0x60008E1C /end MEASUREMENT
/begin MEASUREMENT InjSys_ratEthPrtnFuPerc "Ethanol content of the actual used fuel blend" UWORD rel_uw_b100 1 100 0.00 99.99847 FORMAT "%8.5" ECU_ADDRESS 0x60008E1A /end MEASUREMENT
/begin MEASUREMENT InjSys_ratEthPrtnMaxEthFu "Ethanol content of the fuel with maximum ethanol content" UWORD rel_uw_b100 1 100 0.00 99.99847 FORMAT "%8.5" ECU_ADDRESS 0x60008E18 /end MEASUREMENT
/begin MEASUREMENT InjSys_ratMaxAirChrgRailErr "MaxTi limitation due to Rail error" UWORD rel_uw_q0p0234 1 100 0.00 1535.977 FORMAT "%8.3" ECU_ADDRESS 0x60007420 /end MEASUREMENT
/begin MEASUREMENT InjSys_ratMaxAirChrgSoiErr "MaxTi limitation due to Soi error" UWORD rel_uw_q0p0234 1 100 0.00 1535.977 FORMAT "%8.3" ECU_ADDRESS 0x6000741E /end MEASUREMENT
/begin MEASUREMENT InjSys_ratRelAirChrgLoc "local variable for relative air charge" UWORD rel_uw_q0p0234 1 100 0.00 1535.977 FORMAT "%8.3" ECU_ADDRESS 0x70002BF8 /end MEASUREMENT
/begin MEASUREMENT InjSys_ratStoic "stoichiometric ratio air fuel" UWORD fak_q0p000488 1 100 0.00 31.99951 FORMAT "%8.5" ECU_ADDRESS 0x60008E16 /end MEASUREMENT
/begin MEASUREMENT InjSys_ratStoicFuBascTyp "Stoichiometric air-fuel ratio basic fuel" UWORD fak_q0p000488 1 100 0.00 31.99951 FORMAT "%8.5" ECU_ADDRESS 0x60008E14 /end MEASUREMENT
/begin MEASUREMENT InjSys_ratStoicFuMaxEth "Stoichiometric air-fuel ratio of the fuel with maximum ethanol content" UWORD fak_q0p000488 1 100 0.00 31.99951 FORMAT "%8.5" ECU_ADDRESS 0x60008E12 /end MEASUREMENT
/begin MEASUREMENT InjSys_relEthAmnt "Relative ethanol amount in fuel" UBYTE rel_ub_b100 1 100 0.00 99.61 FORMAT "%5.2" ECU_ADDRESS 0x6000B7EF /end MEASUREMENT
/begin MEASUREMENT InjSys_relEthAmntTmp "Relative ethanol amount in fuel" UWORD rel_uw_b100 1 100 0.00 99.99847 FORMAT "%8.5" ECU_ADDRESS 0x600073E6 /end MEASUREMENT
/begin MEASUREMENT InjSys_rhoFu "density fuel" UWORD m_q0p1_g_DIV_L 1 100 0.00 6553.500 FORMAT "%8.3" ECU_ADDRESS 0x60008E10 /end MEASUREMENT
/begin MEASUREMENT InjSys_rhoFuBascTypStd "Fuel density of the basic fuel at standard conditions" UWORD m_q0p1_g_DIV_L 1 100 0.00 6553.500 FORMAT "%8.3" ECU_ADDRESS 0x60008E0E /end MEASUREMENT
/begin MEASUREMENT InjSys_rhoFuMaxEthStd "Fuel density of the fuel with maximum ethanol content at standard conditions" UWORD m_q0p1_g_DIV_L 1 100 0.00 6553.500 FORMAT "%8.3" ECU_ADDRESS 0x60008E0C /end MEASUREMENT
/begin MEASUREMENT InjSys_rhoFuStd "density fuel at standard conditions" UWORD m_q0p1_g_DIV_L 1 100 0.00 6553.500 FORMAT "%8.3" ECU_ADDRESS 0x60008E0A /end MEASUREMENT
/begin MEASUREMENT InjSys_stAllwdAgRng "." UBYTE dez 1 100 0.00 255.0 FORMAT "%5.1" ECU_ADDRESS 0x70002AFD /end MEASUREMENT
/begin MEASUREMENT InjSys_stAllwdAgRngStb "." UBYTE dez 1 100 0.00 255.0 FORMAT "%5.1" ECU_ADDRESS 0x70002AFC /end MEASUREMENT
/begin MEASUREMENT InjSys_stAllwdAgRngSyn0 "." UBYTE dez 1 100 0.00 255.0 FORMAT "%5.1" ECU_ADDRESS 0x70002AFB /end MEASUREMENT
/begin MEASUREMENT InjSys_stAllwdAgRngSyn0Stb "." UBYTE dez 1 100 0.00 255.0 FORMAT "%5.1" ECU_ADDRESS 0x70002AFA /end MEASUREMENT
/begin MEASUREMENT InjSys_stAllwdAgRngSyn1 "." UBYTE dez 1 100 0.00 255.0 FORMAT "%5.1" ECU_ADDRESS 0x70002AF9 /end MEASUREMENT
/begin MEASUREMENT InjSys_stAllwdAgRngSyn1Stb "." UBYTE dez 1 100 0.00 255.0 FORMAT "%5.1" ECU_ADDRESS 0x70002AF8 /end MEASUREMENT
/begin MEASUREMENT InjSys_stAllwdTiBreak "bitmask state injection pause time" UBYTE dez 1 100 0.00 255.0 FORMAT "%5.1" ECU_ADDRESS 0x70002AF7 /end MEASUREMENT
/begin MEASUREMENT InjSys_stAllwdTiBreakStb "bitmask state injection pause time (standby injection mode)" UBYTE dez 1 100 0.00 255.0 FORMAT "%5.1" ECU_ADDRESS 0x70002AF6 /end MEASUREMENT
/begin MEASUREMENT InjSys_stAllwdTiBreakSyn0 "bitmask state injection pause time S0 timing" UBYTE dez 1 100 0.00 255.0 FORMAT "%5.1" ECU_ADDRESS 0x70002AF5 /end MEASUREMENT
/begin MEASUREMENT InjSys_stAllwdTiBreakSyn0Stb "bitmask state injection pause time S0 timing (standby injection mode)" UBYTE dez 1 100 0.00 255.0 FORMAT "%5.1" ECU_ADDRESS 0x70002AF4 /end MEASUREMENT
/begin MEASUREMENT InjSys_stAllwdTiBreakSyn1 "bitmask state injection pause time S1 timing" UBYTE dez 1 100 0.00 255.0 FORMAT "%5.1" ECU_ADDRESS 0x70002AF3 /end MEASUREMENT
/begin MEASUREMENT InjSys_stAllwdTiBreakSyn1Stb "bitmask state injection pause time S1 timing (standby injection mode)" UBYTE dez 1 100 0.00 255.0 FORMAT "%5.1" ECU_ADDRESS 0x70002AF2 /end MEASUREMENT
/begin MEASUREMENT InjSys_stAllwdTiInjOpen "bitmask state injection open time" UBYTE dez 1 100 0.00 255.0 FORMAT "%5.1" ECU_ADDRESS 0x70002AF1 /end MEASUREMENT
/begin MEASUREMENT InjSys_stAllwdTiInjOpenStb "bitmask state injection open time (standby injection mode)" UBYTE dez 1 100 0.00 255.0 FORMAT "%5.1" ECU_ADDRESS 0x70002AF0 /end MEASUREMENT
/begin MEASUREMENT InjSys_stAllwdTiInjOpenSyn0 "bitmask state injection open time S0 timing" UBYTE dez 1 100 0.00 255.0 FORMAT "%5.1" ECU_ADDRESS 0x70002AEF /end MEASUREMENT
/begin MEASUREMENT InjSys_stAllwdTiInjOpenSyn0Stb "bitmask state injection open time S0 timing (standby injection mode)" UBYTE dez 1 100 0.00 255.0 FORMAT "%5.1" ECU_ADDRESS 0x70002AEE /end MEASUREMENT
/begin MEASUREMENT InjSys_stAllwdTiInjOpenSyn1 "bitmask state injection open time S1 timing" UBYTE dez 1 100 0.00 255.0 FORMAT "%5.1" ECU_ADDRESS 0x70002AED /end MEASUREMENT
/begin MEASUREMENT InjSys_stAllwdTiInjOpenSyn1Stb "bitmask state injection open time S1 timing (standby injection mode)" UBYTE dez 1 100 0.00 255.0 FORMAT "%5.1" ECU_ADDRESS 0x70002AEC /end MEASUREMENT
/begin MEASUREMENT InjSys_stCalcInjMod "selected subcoordinator for injection modes" UBYTE InjSys_CalcInjMod_Set_COMPU_VERB 1 100 0.00 4.00000000000 FORMAT "%13.11" ECU_ADDRESS 0x6000B7E5 /end MEASUREMENT
/begin MEASUREMENT InjSys_stCollctnActvReq "collection of active diagnosis requests" UBYTE dez 1 100 0.00 255.0 FORMAT "%5.1" ECU_ADDRESS 0x6000B7EA /end MEASUREMENT
/begin MEASUREMENT InjSys_stCollctnInjModActv "collection of active injection mode for diagnosis requests." UBYTE dez 1 100 0.00 255.0 FORMAT "%5.1" ECU_ADDRESS 0x6000B7E9 /end MEASUREMENT
/begin MEASUREMENT InjSys_stCsersDiag "Status of CSERS diagnosis" UBYTE dez 1 100 0.00 255.0 FORMAT "%5.1" ECU_ADDRESS 0x6000B7E8 /end MEASUREMENT
/begin MEASUREMENT InjSys_stEom2stCalcInjModDyn_I.idx "instance selection subcoordinator for injection modes / Intermediate result for group axis" UBYTE InjSys_CalcInjMod_Set_COMPU_VERB 1 100 0.00 4.00000000000 FORMAT "%13.11" ECU_ADDRESS 0x70002B49 /end MEASUREMENT
/begin MEASUREMENT InjSys_stEom2stCalcInjMod_I.idx "instance selection subcoordinator for injection modes / Intermediate result for group axis" UBYTE InjSys_CalcInjMod_Set_COMPU_VERB 1 100 0.00 4.00000000000 FORMAT "%13.11" ECU_ADDRESS 0x70002B48 /end MEASUREMENT
/begin MEASUREMENT InjSys_stEom2stInjMod_I.idx "instance selection injection mode / Intermediate result for group axis" UBYTE InjSys_InjMode_Set_COMPU_VERB 1 100 0.00 19.0000000000 FORMAT "%13.10" ECU_ADDRESS 0x70002B47 /end MEASUREMENT
/begin MEASUREMENT InjSys_stEom2stSngMpg_I.idx "instance selection single mapping of injection mode / Intermediate result for group axis" UBYTE dez 1 100 0.00 255.0 FORMAT "%5.1" ECU_ADDRESS 0x70002B46 /end MEASUREMENT
/begin MEASUREMENT InjSys_stEomTarInj "engine operation mode for the injection system" UWORD CoEOM_stEomStgTot_VERB 1 100 0.00 7951.00000000 FORMAT "%13.8" ECU_ADDRESS 0x70003870 /end MEASUREMENT
/begin MEASUREMENT InjSys_stEomTarInjRdnt "engine operation mode for the injection system (bitcomplement)" UWORD dez 1 100 0.00 65535.00 FORMAT "%8.2" ECU_ADDRESS 0x7000386E /end MEASUREMENT
/begin MEASUREMENT InjSys_stInjMod "injection mode" UBYTE InjSys_InjMode_Set_COMPU_VERB 1 100 0.00 19.0000000000 FORMAT "%13.10" ECU_ADDRESS 0x70003693 /end MEASUREMENT
/begin MEASUREMENT InjSys_stInjModAdvAry "cylider individual array injection mode with advanced horizon" UBYTE InjSys_InjMode_Set_COMPU_VERB 1 100 0.00 19.0000000000 FORMAT "%13.10" ARRAY_SIZE 4 ECU_ADDRESS 0x7000368F /end MEASUREMENT
/begin MEASUREMENT InjSys_stInjModAllwd "bitmask allowed injection modes" UBYTE dez 1 100 0.00 255.0 FORMAT "%5.1" ECU_ADDRESS 0x6000FC33 /end MEASUREMENT
/begin MEASUREMENT InjSys_stInjModAltv "alternative injection mode" UBYTE InjSys_InjMode_Set_COMPU_VERB 1 100 0.00 19.0000000000 FORMAT "%13.10" ECU_ADDRESS 0x6000B7E4 /end MEASUREMENT
/begin MEASUREMENT InjSys_stInjModAry "cylider individual array injection mode" UBYTE InjSys_InjMode_Set_COMPU_VERB 1 100 0.00 19.0000000000 FORMAT "%13.10" ARRAY_SIZE 4 ECU_ADDRESS 0x700041F4 /end MEASUREMENT
/begin MEASUREMENT InjSys_stInjModChkSyn0 "injection mode checked S0 timing" UBYTE InjSys_InjMode_Set_COMPU_VERB 1 100 0.00 19.0000000000 FORMAT "%13.10" ECU_ADDRESS 0x70002AEB /end MEASUREMENT
/begin MEASUREMENT InjSys_stInjModChkSyn0Stb "injection mode checked S0 timing (standby injection mode)" UBYTE InjSys_InjMode_Set_COMPU_VERB 1 100 0.00 19.0000000000 FORMAT "%13.10" ECU_ADDRESS 0x70002AEA /end MEASUREMENT
/begin MEASUREMENT InjSys_stInjModChkSyn1 "injection mode checked S1 timing" UBYTE InjSys_InjMode_Set_COMPU_VERB 1 100 0.00 19.0000000000 FORMAT "%13.10" ECU_ADDRESS 0x70002AE9 /end MEASUREMENT
/begin MEASUREMENT InjSys_stInjModChkSyn1Stb "injection mode checked S1 timing (standby injection mode)" UBYTE InjSys_InjMode_Set_COMPU_VERB 1 100 0.00 19.0000000000 FORMAT "%13.10" ECU_ADDRESS 0x70002AE8 /end MEASUREMENT
/begin MEASUREMENT InjSys_stInjModProhb1 "prohibited injection mode 1" UBYTE InjSys_InjMode_Set_COMPU_VERB 1 100 0.00 19.0000000000 FORMAT "%13.10" ECU_ADDRESS 0x6000FC32 /end MEASUREMENT
/begin MEASUREMENT InjSys_stInjModProhb2 "prohibited injection mode 2" UBYTE InjSys_InjMode_Set_COMPU_VERB 1 100 0.00 19.0000000000 FORMAT "%13.10" ECU_ADDRESS 0x6000FC31 /end MEASUREMENT
/begin MEASUREMENT InjSys_stInjModStb "injection mode standby" UBYTE InjSys_InjMode_Set_COMPU_VERB 1 100 0.00 19.0000000000 FORMAT "%13.10" ECU_ADDRESS 0x7000368E /end MEASUREMENT
/begin MEASUREMENT InjSys_stInjModStbTar "target standby injection mode" UBYTE InjSys_InjMode_Set_COMPU_VERB 1 100 0.00 19.0000000000 FORMAT "%13.10" ECU_ADDRESS 0x7000368D /end MEASUREMENT
/begin MEASUREMENT InjSys_stInjModStbTarEngRunng "target standby injection mode engine running" UBYTE InjSys_InjMode_Set_COMPU_VERB 1 100 0.00 19.0000000000 FORMAT "%13.10" ECU_ADDRESS 0x6000FC30 /end MEASUREMENT
/begin MEASUREMENT InjSys_stInjModStbTarLoc "target injection mode local" UBYTE InjSys_InjMode_Set_COMPU_VERB 1 100 0.00 19.0000000000 FORMAT "%13.10" ECU_ADDRESS 0x70002B45 /end MEASUREMENT
/begin MEASUREMENT InjSys_stInjModStbTarNxt "standby injection mode next synchro" UBYTE InjSys_InjMode_Set_COMPU_VERB 1 100 0.00 19.0000000000 FORMAT "%13.10" ECU_ADDRESS 0x7000368C /end MEASUREMENT
/begin MEASUREMENT InjSys_stInjModTar "injection mode target" UBYTE InjSys_InjMode_Set_COMPU_VERB 1 100 0.00 19.0000000000 FORMAT "%13.10" ECU_ADDRESS 0x7000368B /end MEASUREMENT
/begin MEASUREMENT InjSys_stInjModTarEngRunng "target injection mode engine running" UBYTE InjSys_InjMode_Set_COMPU_VERB 1 100 0.00 19.0000000000 FORMAT "%13.10" ECU_ADDRESS 0x6000FC2F /end MEASUREMENT
/begin MEASUREMENT InjSys_stInjModTarEngStrt "target injection mode engine start" UBYTE InjSys_InjMode_Set_COMPU_VERB 1 100 0.00 19.0000000000 FORMAT "%13.10" ECU_ADDRESS 0x70002B52 /end MEASUREMENT
/begin MEASUREMENT InjSys_stInjModTarLoc "target injection mode local" UBYTE InjSys_InjMode_Set_COMPU_VERB 1 100 0.00 19.0000000000 FORMAT "%13.10" ECU_ADDRESS 0x70002B44 /end MEASUREMENT
/begin MEASUREMENT InjSys_stInjModTarNxt "target injection mode next synchro" UBYTE InjSys_InjMode_Set_COMPU_VERB 1 100 0.00 19.0000000000 FORMAT "%13.10" ECU_ADDRESS 0x7000368A /end MEASUREMENT
/begin MEASUREMENT InjSys_stInjModTarRaw "target injection mode raw value" UBYTE InjSys_InjMode_Set_COMPU_VERB 1 100 0.00 19.0000000000 FORMAT "%13.10" ECU_ADDRESS 0x6000B7E3 /end MEASUREMENT
/begin MEASUREMENT InjSys_stInjModTyp "variable injection mode type" UWORD dez 1 100 0.00 65535.00 FORMAT "%8.2" ECU_ADDRESS 0x7000386C /end MEASUREMENT
/begin MEASUREMENT InjSys_stInjModTypRdnt "variable injection mode type (bitcomplement)" UWORD dez 1 100 0.00 65535.00 FORMAT "%8.2" ECU_ADDRESS 0x7000386A /end MEASUREMENT
/begin MEASUREMENT InjSys_stInjPlsAgTiChkActv "Monitoring condition for injection angle and inj time for all injection pulses." UBYTE dez 1 100 0.00 255.0 FORMAT "%5.1" ARRAY_SIZE 4 ECU_ADDRESS 0x70002B7E /end MEASUREMENT
/begin MEASUREMENT InjSys_stInjPlsBreakTiChkActv "Monitoring condition for inj pause time for all injection pulses." UBYTE dez 1 100 0.00 255.0 FORMAT "%5.1" ARRAY_SIZE 4 ECU_ADDRESS 0x70002B7A /end MEASUREMENT
/begin MEASUREMENT InjSys_stInjTmng "state injection timing" UBYTE dez 1 100 0.00 255.0 FORMAT "%5.1" ECU_ADDRESS 0x70003689 /end MEASUREMENT
/begin MEASUREMENT InjSys_stInjTmngRdnt "redundancy state injection timing for monitoring" UBYTE dez 1 100 0.00 255.0 FORMAT "%5.1" ECU_ADDRESS 0x70003688 /end MEASUREMENT
/begin MEASUREMENT InjSys_stMulInjDiag "Status of multiple injection diagnosis" UBYTE dez 1 100 0.00 255.0 FORMAT "%5.1" ECU_ADDRESS 0x6000B7E7 /end MEASUREMENT
/begin MEASUREMENT InjSys_stnjModChk "injection mode checked" UBYTE InjSys_InjMode_Set_COMPU_VERB 1 100 0.00 19.0000000000 FORMAT "%13.10" ECU_ADDRESS 0x70002AE7 /end MEASUREMENT
/begin MEASUREMENT InjSys_stnjModChkStb "standby injection mode checked" UBYTE InjSys_InjMode_Set_COMPU_VERB 1 100 0.00 19.0000000000 FORMAT "%13.10" ECU_ADDRESS 0x70002AE6 /end MEASUREMENT
/begin MEASUREMENT InjSys_stStrtReq "Start type" UWORD ENGSTRT_STSTRTREQ_SET_COMPU_VERB 1 100 0.00 32770.0000000 FORMAT "%13.7" ECU_ADDRESS 0x70002B50 /end MEASUREMENT
/begin MEASUREMENT InjSys_stTstrRstCvo "status of the tester request for Controlled Valve Operation (CVO)" UBYTE OneToOne 1 100 0.00 255.0 FORMAT "%5.1" ECU_ADDRESS 0x6000F7A7 /end MEASUREMENT
/begin MEASUREMENT InjSys_tEng "Engine temperature selected for the injection system" SWORD Temp_Cels 1 100 -3549.940 3003.560 FORMAT "%8.3" ECU_ADDRESS 0x60009074 /end MEASUREMENT
/begin MEASUREMENT InjSys_tEngStrt "Engine start temperature selected for the injection system" SWORD Temp_Cels 1 100 -3549.940 3003.560 FORMAT "%8.3" ECU_ADDRESS 0x60009072 /end MEASUREMENT
/begin MEASUREMENT InjSys_tFu "temporary fuel rail temperature interpolation point" UBYTE temp_ub_q0p75_o48 1 100 -48.0 143.3 FORMAT "%5.1" ECU_ADDRESS 0x6000B7EC /end MEASUREMENT
/begin MEASUREMENT InjSys_tiBreakHiReslLoc "pause time local (high resolution)" SWORD t_q0p001_ms 1 100 -32.76800 32.76700 FORMAT "%8.5" ARRAY_SIZE 4 ECU_ADDRESS 0x70002B2C /end MEASUREMENT
/begin MEASUREMENT InjSys_tiBreakMin "Minimum dwell time between injection pulses" SWORD t_q0p04_ms 1 100 0.00 1310.680 FORMAT "%8.3" ECU_ADDRESS 0x70002ACC /end MEASUREMENT
/begin MEASUREMENT InjSys_tiInjLoc "injection time local" ULONG t_q0p0004_ms 1 100 0.00 1717986.91800 FORMAT "%13.5" ARRAY_SIZE 4 ECU_ADDRESS 0x70002B1C /end MEASUREMENT
/begin MEASUREMENT InjSys_tiInjOpenThdStb "threshold minimum valve open time (standby injection mode)" UWORD t_q0p0004_ms 1 100 0.00 26.21400 FORMAT "%8.5" ECU_ADDRESS 0x70002AE4 /end MEASUREMENT
/begin MEASUREMENT InjSys_tiInjSumAry "Array for injection time sum" ULONG t_q0p0004_ms 1 100 0.00 1717986.91800 FORMAT "%13.5" ARRAY_SIZE 4 ECU_ADDRESS 0x70003D6C /end MEASUREMENT
/begin MEASUREMENT InjSys_tiInjWinMax "maximum injection window based on injection time" ULONG t_q0p0004_ms 1 100 0.00 1717986.91800 FORMAT "%13.5" ECU_ADDRESS 0x60002738 /end MEASUREMENT
/begin MEASUREMENT InjSys_tiMinMiCvo "minimal injection time offset between current main injection and minimum main injection" UWORD t_q0p001_ms 1 100 0.00 65.53500 FORMAT "%8.5" ECU_ADDRESS 0x600073E4 /end MEASUREMENT
/begin MEASUREMENT InjSys_tInjrCvo "Injection valve temperature" UBYTE temp_ub_q0p75_o48 1 100 -48.0 143.3 FORMAT "%5.1" ECU_ADDRESS 0x6000B7EE /end MEASUREMENT
/begin MEASUREMENT InjSys_tInjrTmp "temporary Injector temperature" UBYTE temp_ub_q0p75_o48 1 100 -48.0 143.3 FORMAT "%5.1" ECU_ADDRESS 0x6000B7E6 /end MEASUREMENT
/begin MEASUREMENT InjSys_tInjVlvLocSp "Injection valve temperature in injection setpoint calculation" UBYTE temp_ub_q0p75_o48 1 100 -48.0 143.3 FORMAT "%5.1" ECU_ADDRESS 0x70002ACA /end MEASUREMENT
/begin MEASUREMENT InjSys_tiOutp1CylInd_a "injection-time 1st injection cylinder-individual (array, high resolution)" ULONG t_q0p0004_ms 1 100 0.00 1717986.91800 FORMAT "%13.5" ARRAY_SIZE 4 ECU_ADDRESS 0x70003CE8 /end MEASUREMENT
/begin MEASUREMENT InjSys_tiOutp2CylInd_a "injection-time 2nd injection cylinder-individual (array, high resolution)" ULONG t_q0p0004_ms 1 100 0.00 1717986.91800 FORMAT "%13.5" ARRAY_SIZE 4 ECU_ADDRESS 0x70003CD8 /end MEASUREMENT
/begin MEASUREMENT InjSys_tiOutp3CylInd_a "injection-time 3th injection cylinder-individual (array, high resolution)" ULONG t_q0p0004_ms 1 100 0.00 1717986.91800 FORMAT "%13.5" ARRAY_SIZE 4 ECU_ADDRESS 0x70003CC8 /end MEASUREMENT
/begin MEASUREMENT InjSys_tiOutp4CylInd_a "injection-time 4th injection cylinder-individual (array, high resolution)" ULONG t_q0p0004_ms 1 100 0.00 1717986.91800 FORMAT "%13.5" ARRAY_SIZE 4 ECU_ADDRESS 0x70003CB8 /end MEASUREMENT
/begin MEASUREMENT InjSys_tiPseSpCatHeatgDiag "pause time setpoint (injection individual) for diagnosis of injection timing" SWORD t_q0p001_ms 1 100 -32.76800 32.76700 FORMAT "%8.5" ARRAY_SIZE 4 ECU_ADDRESS 0x70002B72 /end MEASUREMENT
/begin MEASUREMENT InjSys_tiPseSpDeDiagMax "maximum pause time deviation for diagnosis of injection timing" SWORD t_q0p001_ms 1 100 -32.76800 32.76700 FORMAT "%8.5" ECU_ADDRESS 0x70002B70 /end MEASUREMENT
/begin MEASUREMENT InjSys_tiSpCatHeatgDiag "Injection time setpoint (injection individual) for diagnosis of injection timing" ULONG t_q0p001_ms 1 100 0.00 4294967.29500 FORMAT "%13.5" ARRAY_SIZE 4 ECU_ADDRESS 0x70002B60 /end MEASUREMENT
/begin MEASUREMENT InjSys_tiSpDeDiagMax "maximum injection time deviation for diagnosis of injection timing" UWORD t_q0p001_ms 1 100 0.00 65.53500 FORMAT "%8.5" ECU_ADDRESS 0x70002B5E /end MEASUREMENT
/begin MEASUREMENT InjSys_tOilLocSp "oil temperature local" SWORD Temp_Cels 1 100 -3549.940 3003.560 FORMAT "%8.3" ECU_ADDRESS 0x70002AC8 /end MEASUREMENT
/begin MEASUREMENT InjSys_tOilSp "Oil temperature local" SWORD Temp_Cels 1 100 -3549.940 3003.560 FORMAT "%8.3" ECU_ADDRESS 0x70003AE2 /end MEASUREMENT
/begin MEASUREMENT InjSys_tPistBas "Piston temperature" SWORD Temp_Cels 1 100 -3549.940 3003.560 FORMAT "%8.3" ECU_ADDRESS 0x70002AC6 /end MEASUREMENT
/begin MEASUREMENT InjSys_tPistDelta "delta piston temperature" SWORD temp_q0p1 1 100 -3276.800 3276.700 FORMAT "%8.3" ECU_ADDRESS 0x70002AC4 /end MEASUREMENT
/begin MEASUREMENT InjSys_tqResvCvo "request torque reserve Controlled Valve Operation (CVO) adaption" SWORD md_q0p1 1 100 0.00 3276.700 FORMAT "%8.3" ECU_ADDRESS 0x600098BA /end MEASUREMENT
/begin MEASUREMENT InjSys_uBattCvo "batterie voltage for CVO" SWORD Volt_Batt 1 100 0.00 655340.0 FORMAT "%8.1" ECU_ADDRESS 0x600098B8 /end MEASUREMENT
/begin MEASUREMENT InjSys_vAgCrksft "angular speed of crankshaft" UWORD kwgrad_q0p00286 1 100 0.00 187.4971 FORMAT "%8.4" ECU_ADDRESS 0x70003830 /end MEASUREMENT
/begin MEASUREMENT InjSys_vcos10MegaPa "CVO fuel viscosity for for the 10MPa set point of the extrapolation." UWORD RBPtCel_vcos_5p0em5_1 1 100 0.00 3.276750 FORMAT "%8.6" ECU_ADDRESS 0x60007418 /end MEASUREMENT
/begin MEASUREMENT InjSys_vcos35MegaPa "CVO fuel viscosity for for the 35MPa set point of the extrapolation." UWORD RBPtCel_vcos_5p0em5_1 1 100 0.00 3.276750 FORMAT "%8.6" ECU_ADDRESS 0x60007416 /end MEASUREMENT
/begin MEASUREMENT InjSys_vcosCvoAry "copy of the viscosity-setpoints for CVO" UWORD RBPtCel_vcos_5p0em5_1 1 100 0.00 3.276750 FORMAT "%8.6" ARRAY_SIZE 6 ECU_ADDRESS 0x6000740A /end MEASUREMENT
/begin MEASUREMENT InjSys_vcosFuCvo "CVO fuel viscosity" UWORD RBPtCel_vcos_5p0em5_1 1 100 0.00 3.276750 FORMAT "%8.6" ECU_ADDRESS 0x60009426 /end MEASUREMENT
/begin MEASUREMENT InjSys_vcosFuRefPCvo "CVO fuel viscosity for the reference rail pressure" UWORD RBPtCel_vcos_5p0em5_1 1 100 0.00 3.276750 FORMAT "%8.6" ECU_ADDRESS 0x60009424 /end MEASUREMENT
/begin MEASUREMENT InjSys_vcosOperDeltaCvo "Operating viscosity area around the viscosity interpolation point" UWORD RBPtCel_vcos_5p0em5_1 1 100 0.00 3.276750 FORMAT "%8.6" ARRAY_SIZE 6 ECU_ADDRESS 0x600073FE /end MEASUREMENT
/begin MEASUREMENT InjSys_vcosOperLwrCvo "Operating viscosity area lower threshold" UWORD RBPtCel_vcos_5p0em5_1 1 100 0.00 3.276750 FORMAT "%8.6" ECU_ADDRESS 0x600073FC /end MEASUREMENT
/begin MEASUREMENT InjSys_vcosOperUpprCvo "Operating viscosity area upper threshold" UWORD RBPtCel_vcos_5p0em5_1 1 100 0.00 3.276750 FORMAT "%8.6" ECU_ADDRESS 0x600073FA /end MEASUREMENT
/begin MEASUREMENT InjSys_vcosPntCvo "CVO viscosity operation area" UWORD RBPtCel_vcos_5p0em5_1 1 100 0.00 3.276750 FORMAT "%8.6" ECU_ADDRESS 0x60009422 /end MEASUREMENT
/begin MEASUREMENT InjTi_l "output injection time" SLONG t_q0p0004_ms 1 100 -858993.459200 858993.458800 FORMAT "%13.6" ARRAY_SIZE 16 ECU_ADDRESS 0x70002C38 /end MEASUREMENT
/begin MEASUREMENT InjTpmin "minimum valve turn-off time" UWORD t_q0p001_ms 1 100 0.00 65.53500 FORMAT "%8.5" ARRAY_SIZE 16 ECU_ADDRESS 0x70002C16 /end MEASUREMENT
/begin MEASUREMENT InjVlvGdi_durVlvOffMn "Minimum injection valve off-time" UWORD t_q0p001_ms 1 100 0.00 65.53500 FORMAT "%8.5" ECU_ADDRESS 0x7000382E /end MEASUREMENT
/begin MEASUREMENT InjVvG_agInjPlsMeas "measured angle of injection pulse" SWORD kw_q0p0234 1 100 -768.0000 767.9766 FORMAT "%8.4" ARRAY_SIZE 4 ECU_ADDRESS 0x70003A94 /end MEASUREMENT
/begin MEASUREMENT InjVvG_cntCylInjPlsMeas "cylinder counter of measured injection pulses" UBYTE dez 1 100 0.00 255.0 FORMAT "%5.1" ECU_ADDRESS 0x7000367C /end MEASUREMENT
/begin MEASUREMENT InjVvG_nrInjGdi "GDI injection counter" UBYTE dez 1 100 0.00 255.0 FORMAT "%5.1" ECU_ADDRESS 0x7000367B /end MEASUREMENT
/begin MEASUREMENT InjVvG_nrInjGdiLim "GDI injection counter (limited)" UBYTE dez 1 100 0.00 255.0 FORMAT "%5.1" ECU_ADDRESS 0x7000367A /end MEASUREMENT
/begin MEASUREMENT InjVvG_nrInjGdiLimWd "GDI injection counter (limited, word)" UWORD dez 1 100 0.00 65535.00 FORMAT "%8.2" ECU_ADDRESS 0x7000382C /end MEASUREMENT
/begin MEASUREMENT InjVvG_nrInjGdiWd "GDI injection counter (word)" UWORD dez 1 100 0.00 65535.00 FORMAT "%8.2" ECU_ADDRESS 0x7000382A /end MEASUREMENT
/begin MEASUREMENT InjVvG_nrInjPlsMeas "number of measured injection pulses" UBYTE dez 1 100 0.00 255.0 FORMAT "%5.1" ECU_ADDRESS 0x70003679 /end MEASUREMENT
/begin MEASUREMENT InjVvG_PstInjMode "Post injection status" UBYTE InjVvg_PstInj_State_t 1 100 0.00 5.00000000000 FORMAT "%13.11" ARRAY_SIZE 4 ECU_ADDRESS 0x7000367D /end MEASUREMENT
/begin MEASUREMENT InjVvG_tiInjPlsMeas "measured injection time of injection pulse" ULONG t_q0p001_ms 1 100 0.00 4294967.29500 FORMAT "%13.5" ARRAY_SIZE 4 ECU_ADDRESS 0x70003C7C /end MEASUREMENT
/begin MEASUREMENT InjVvG_tiPseInjPlsMeas "measured pause time" SWORD t_q0p001_ms 1 100 -32.76800 32.76700 FORMAT "%8.5" ARRAY_SIZE 4 ECU_ADDRESS 0x70003A8C /end MEASUREMENT
/begin MEASUREMENT nmotloc "local copy of engine speed" UBYTE nmot_ub_q40 1 100 0.00 10200. FORMAT "%5.0" ECU_ADDRESS 0x6000B7F0 /end MEASUREMENT
/begin MEASUREMENT prfwfrl_w "rail pressure input for factor max. injection angle window for calculation max. load" UWORD RBPtCel_p_0p002_1 1 100 0.00 131.0700 FORMAT "%8.4" ECU_ADDRESS 0x6000741C /end MEASUREMENT
/begin MEASUREMENT rkmeeff_w_msg "Mean value of effective relative (incl. real cylinder cut-off step) injected fuel mass between two banks (STERVK)" UWORD rel_uw_b3072 1 100 0.00 3071.953 FORMAT "%8.3" ECU_ADDRESS 0x600092E4 /end MEASUREMENT
/begin MEASUREMENT rkme_w_msg "Mean value of relative injected fuel mass between two banks (STERVK)" UWORD rel_uw_b3072 1 100 0.00 3071.953 FORMAT "%8.3" ECU_ADDRESS 0x600092E6 /end MEASUREMENT
/begin MEASUREMENT rkm_w_msg "mean relative fuel mass for two bench system" UWORD rel_uw_b3072 1 100 0.00 3071.953 FORMAT "%8.3" ECU_ADDRESS 0x600092E8 /end MEASUREMENT
/begin MEASUREMENT rkvmeeff_w_msg "Mean value of effective relative (including real cylinder cut-off step) volumetric injected fuel mass between two banks" UWORD rel_uw_b3072 1 100 0.00 3071.953 FORMAT "%8.3" ECU_ADDRESS 0x600092E2 /end MEASUREMENT
/begin MEASUREMENT rlmaxti_w_msg "maximum air charge according to maximum possible injection time" UWORD rel_uw_q0p0234 1 100 0.00 1535.977 FORMAT "%8.3" ECU_ADDRESS 0x600092DA /end MEASUREMENT
/begin MEASUREMENT stInjModOld_MP "measure point injection mode old" UBYTE OneToOne 1 100 0.00 255.0 FORMAT "%5.1" ECU_ADDRESS 0x7000A247 /end MEASUREMENT
/begin MEASUREMENT ti1a_l_msg "injection-time 1st injection cylinder-individual (array)" ULONG t_q0p001_ms 1 100 0.00 4294967.29500 FORMAT "%13.5" ARRAY_SIZE 4 ECU_ADDRESS 0x70003C48 /end MEASUREMENT
/begin MEASUREMENT ti2a_l_msg "injection-time 2nd injection cylinder-individual (array)" ULONG t_q0p001_ms 1 100 0.00 4294967.29500 FORMAT "%13.5" ARRAY_SIZE 4 ECU_ADDRESS 0x70003C38 /end MEASUREMENT
/begin MEASUREMENT ti3a_l_msg "injection-time 3rd injection cylinder-individual (array)" ULONG t_q0p001_ms 1 100 0.00 4294967.29500 FORMAT "%13.5" ARRAY_SIZE 4 ECU_ADDRESS 0x70003C28 /end MEASUREMENT
/begin MEASUREMENT ti4a_l_msg "injection-time 4th injection cylinder-individual (array)" ULONG t_q0p001_ms 1 100 0.00 4294967.29500 FORMAT "%13.5" ARRAY_SIZE 4 ECU_ADDRESS 0x70003C18 /end MEASUREMENT
/begin MEASUREMENT tpes1a_w_msg "electrical pause time 1st injection" SWORD t_q0p001_ms 1 100 -32.76800 32.76700 FORMAT "%8.5" ARRAY_SIZE 4 ECU_ADDRESS 0x700039D0 /end MEASUREMENT
/begin MEASUREMENT tpes2a_w_msg "electrical pause time 2nd injection" SWORD t_q0p001_ms 1 100 -32.76800 32.76700 FORMAT "%8.5" ARRAY_SIZE 4 ECU_ADDRESS 0x700039C8 /end MEASUREMENT
/begin MEASUREMENT tpes3a_w_msg "electrical pause time 3rd injection" SWORD t_q0p001_ms 1 100 -32.76800 32.76700 FORMAT "%8.5" ARRAY_SIZE 4 ECU_ADDRESS 0x700039C0 /end MEASUREMENT
/begin MEASUREMENT tpes4a_w_msg "electrical pause time 4th injection" SWORD t_q0p001_ms 1 100 -32.76800 32.76700 FORMAT "%8.5" ARRAY_SIZE 4 ECU_ADDRESS 0x700039B8 /end MEASUREMENT
/begin MEASUREMENT wesabr_msg "Angle for injection abort" UBYTE kw_q0p75 1 100 0.00 191.3 FORMAT "%5.1" ECU_ADDRESS 0x6000FB14 /end MEASUREMENT
/begin MEASUREMENT wesot1a_w_msg "Injection angle first injection refferd to ITDC" SWORD kw_q0p0234 1 100 -768.0000 767.9766 FORMAT "%8.4" ARRAY_SIZE 4 ECU_ADDRESS 0x700039B0 /end MEASUREMENT
/begin MEASUREMENT wesot2a_w_msg "Injection angle second injection refferd to ITDC" SWORD kw_q0p0234 1 100 -768.0000 767.9766 FORMAT "%8.4" ARRAY_SIZE 4 ECU_ADDRESS 0x700039A8 /end MEASUREMENT
/begin MEASUREMENT wesot3a_w_msg "Injection angle third injection refferd to ITDC" SWORD kw_q0p0234 1 100 -768.0000 767.9766 FORMAT "%8.4" ARRAY_SIZE 4 ECU_ADDRESS 0x700039A0 /end MEASUREMENT
/begin MEASUREMENT wesot4a_w_msg "Injection angle fourth injection refferd to ITDC" SWORD kw_q0p0234 1 100 -768.0000 767.9766 FORMAT "%8.4" ARRAY_SIZE 4 ECU_ADDRESS 0x70003998 /end MEASUREMENT
/begin MEASUREMENT wrlbhom_w_msg "angle to TDC for charge calculation during homogeneous operation" UWORD kw_q0p75 1 100 0.00 49151.25 FORMAT "%8.2" ECU_ADDRESS 0x60008CF4 /end MEASUREMENT
/begin FUNCTION InjDDGdi "6.59.0    Device Driver GDI, electromagnetic injector"
 /begin DEF_CHARACTERISTIC InjDDGdi_cntSyncThresSWPMT_C InjDDGdi_DurVlvOffTimeHigh_C InjDDGdi_DurVlvOffTimeLow_C InjDDGdi_nEngThresEnaSWPMT_C injddgdi_phiMrgPstInjMX_C IVGdiCtl_ErrSimCyl_C IVGdiCtl_ErrSimInjPls_C IVGdiCtl_ErrSimPhiOff_C IVGdiCtl_ErrSimTiFac_C IVGdiCtl_ErrSimTyp_C /end DEF_CHARACTERISTIC
 /begin REF_CHARACTERISTIC EpmSeq_phiInt_CA /end REF_CHARACTERISTIC
 /begin IN_MEASUREMENT B_noesab_msg B_stendes_msg B_sthdrpre_msg CDRV_TDC_CYL EpmSeq_phiNxtInt_msg Epm_ctCyl Epm_nEng Epm_numCyl evz_austot_msg injmode_l_msg InjSys_flgBascAdpnCvo InjSys_flgCatHeatgOpModDiag InjSys_idxMaskCvo InjSys_pInjIndCvoExtdRng InjSys_pPntOperCvoExtdRng InjSys_tiDesOpenInjCvo1_Ary InjSys_tiDesOpenInjCvo2_Ary InjSys_tiDesOpenInjCvo3_Ary InjSys_tiDesOpenInjCvo4_Ary InjSys_vcosFuCvo InjSys_vcosPntCvo InjVlvPs_Dia_nrVlvToStrt IVGdiCtl_CvoSigAcq_AcqCtr MisfDet_maskMisfStiInj SyC_stSub thdev_msg ti1a_l_msg ti2a_l_msg ti3a_l_msg ti4a_l_msg tpes1a_w_msg tpes2a_w_msg tpes3a_w_msg tpes4a_w_msg wesabr_msg wesot1a_w_msg wesot2a_w_msg wesot3a_w_msg wesot4a_w_msg /end IN_MEASUREMENT
 /begin OUT_MEASUREMENT anzesab_w_msg frstinjcyl_msg InjDDGdi_bErrSimRun_msg injddgdi_dtiInj1 injddgdi_dtiInj2 injddgdi_dtiInj3 injddgdi_dtiInj4 InjVlvGdi_durVlvOffMn InjVvG_agInjPlsMeas InjVvG_cntCylInjPlsMeas InjVvG_nrInjGdi InjVvG_nrInjGdiLim InjVvG_nrInjGdiLimWd InjVvG_nrInjGdiWd InjVvG_nrInjPlsMeas InjVvG_PstInjMode InjVvG_tiInjPlsMeas InjVvG_tiPseInjPlsMeas /end OUT_MEASUREMENT
 /begin LOC_MEASUREMENT InjAgBg_w InjDDGdi_AgBgInjPls InjDDGdi_agRefTiBasd InjDDGdi_cntSyncSWPMT injddgdi_cvomeasctr injddgdi_cvomeasctrold InjDDGdi_flgBitErrInjPlsCSERS InjDDGdi_flgSWPMTEnabFreqReCalc InjDDGdi_IdInjPls injddgdi_injNo InjDDGdi_InjPlsCntrMo injddgdi_lstMeasPulse InjDDGdi_maskCVOPlsMeas InjDDGdi_measMskCur_a InjDDGdi_measMskTrigCur_a InjDDGdi_measMskTrig_a injddgdi_meastimeoutctr InjDDGdi_nrInjLstCyc injddgdi_outpCtlState injddgdi_phiEndofCycle injddgdi_piExpCtr injddgdi_piImpCtr InjDDGdi_stSyncCntSWPMT injddgdi_Test_cyl injddgdi_Test_nofPlss injddgdi_Test_plsCnt injddgdi_Test_plsDur injddgdi_Test_plsPerCnt injddgdi_Test_plsPeriod injddgdi_Test_State InjDDGdi_TiInjPls injddgdi_tPause injddgdi_tPauseNxtPls InjDDGdi_Tpmin injddgdi_trigCvoState InjMeasAccp injPlsEndCtr InjPlsId injPlsStrtCtr InjTi_l InjTpmin /end LOC_MEASUREMENT
 FUNCTION_VERSION "6.59.0" /end FUNCTION
/begin FUNCTION InjHGdi "20.27.1   Injection Hardware Driver, Solenoid Injectors"
 /begin LOC_MEASUREMENT InjHGdi_ChlNumFinishedInj InjHGdi_ChlNumRequestedInj InjHGdi_ChlNumStartedInj InjHGdi_InfoFlgs InjHGdi_numAbortedInj InjHGdi_numFinishedInj InjHGdi_numRequestedInj InjHGdi_numStartedInj InjHGdi_numWithdrawedInj /end LOC_MEASUREMENT
 FUNCTION_VERSION "20.27.1" /end FUNCTION
/begin FUNCTION InjHGdi_Auto "" /end FUNCTION
/begin FUNCTION InjSyG_AddlCalcn "1.22.0    Injection Additional Calculations"
 /begin DEF_CHARACTERISTIC InjSys_agInjEoiMin_M InjSys_facAgMidPosnSel_C InjSys_facInjWinMax_C InjSys_facLimAirInjWinGain_C InjSys_facLimAirInjWinMin_C InjSys_pNoInjCnclStrt_C InjSys_stAddlCalcn_C InjSys_tiMinTiInj_C KLFWFRL KLWESABR PRISTHPRCP PRNOESAB /end DEF_CHARACTERISTIC
 /begin IN_MEASUREMENT B_eprail_msg B_evzaush_msg B_ll_msg B_prmxnl_msg B_stendes_msg CEngDsT_t CEngDsT_tStrt Epm_nEng Epm_numCyl ffudens_msg ffuel_w_msg FuPHi_pMaxRailSpLimp FuPHi_pRail grundwert_msg Ign_ia_real_s8 InjSys_agEoiSyn0 InjSys_agInjSyn0 InjSys_agSoiSyn0 InjSys_idxMI InjSys_nrInjCyc InjSys_ofsCylCntrHom InjSys_ratFuM InjSys_ratFuMAvrg InjSys_ratFuMCylInd InjSys_ratFuMSyn0 InjSys_stInjTmng InjSys_tiInjMin InjSys_tiInjSum InjSys_tiInjSyn0 InjSys_vAgCrksft psr_w_msg redistar_msg rlmxvl_w_msg rlp_w_msg SyC_stSub zzylh_msg zzyls_msg /end IN_MEASUREMENT
 /begin OUT_MEASUREMENT B_invlvhpr_msg B_noesab_msg InjSys_agMidInjPls_a InjSys_bMinPtdInjDurActv InjSys_facFrctInjPls_a InjSys_tEng InjSys_tEngStrt InjSys_tiInjSumAry rkmeeff_w_msg rkme_w_msg rkm_w_msg rkvmeeff_w_msg rlmaxti_w_msg wesabr_msg wrlbhom_w_msg /end OUT_MEASUREMENT
 /begin LOC_MEASUREMENT fktprps_w fwfrl InjSys_agInjWinMax InjSys_facInjWin InjSys_facRampInjAirLim InjSys_flgMaxTiRailErr InjSys_flgMaxTiSoiErr InjSys_flgTiMinGdi InjSys_ratAirChrgPredAddlCalcn InjSys_ratMaxAirChrgRailErr InjSys_ratMaxAirChrgSoiErr InjSys_tiInjWinMax nmotloc prfwfrl_w /end LOC_MEASUREMENT
 FUNCTION_VERSION "1.22.0" /end FUNCTION
/begin FUNCTION InjSyG_AdpnCdnCvo "159.1.0   Adaptation conditions for Controlled valve operation(CVO)"
 /begin DEF_CHARACTERISTIC InjSys_idxMaskCvo_C InjSys_idxPPntTran_C InjSys_nrPVcosPrioCvo1_GT InjSys_nrPVcosPrioCvo2_GT InjSys_nrPVcosPrioCvo3_GT InjSys_nrPVcosPrioCvo4_GT InjSys_nrPVcosPrioCvo5_GT InjSys_nrPVcosPrioCvo6_GT InjSys_pCvoExtdRng_Ax InjSys_pDeltaOperCvoExtdRng_C InjSys_tiInjModReqCvo_C InjSys_vcosCvo_Ax InjSys_vcosFuTEthCvo10MegaPa_M InjSys_vcosFuTEthCvo35MegaPa_M InjSys_vcosHysCvo_C InjSys_vcosOperDeltaCvo_GT /end DEF_CHARACTERISTIC
 /begin IN_MEASUREMENT alchpct_msg B_stendes_msg FuPHi_pRail HPSys_bPresSetPntRea InjSys_flgDsmCtrlAdpnCvo InjSys_flgReqPCvo InjSys_pInjIndCvoExtdRng InjVvG_CvoAdpn_RmnPMask thdev_msg /end IN_MEASUREMENT
 /begin OUT_MEASUREMENT InjSys_flgAdpnPlausb InjSys_flgHiSeldRailPCvo InjSys_flgInjModReqCvo InjSys_flgReqSpRailCvo InjSys_flgRstBascAdpnCvo InjSys_flgVcosOperCvo InjSys_idxHiSeldRailPCvo InjSys_idxMaskCvo InjSys_pHiSeldRailPCvo InjSys_pPntOperCvoExtdRng InjSys_pSpRailCvo InjSys_pSpRailCvoExtdRng InjSys_vcosFuCvo InjSys_vcosFuRefPCvo InjSys_vcosPntCvo /end OUT_MEASUREMENT
 /begin LOC_MEASUREMENT InjSys_pCvoExtdRng InjSys_pPRailCvoExtdRng InjSys_relEthAmnt InjSys_tInjrCvo InjSys_vcos10MegaPa InjSys_vcos35MegaPa InjSys_vcosCvoAry InjSys_vcosOperDeltaCvo InjSys_vcosOperLwrCvo InjSys_vcosOperUpprCvo /end LOC_MEASUREMENT
 FUNCTION_VERSION "159.1.0" /end FUNCTION
/begin FUNCTION InjSyG_Axispoints "3.14.0    Definitions of axispoints for injection system"
 /begin DEF_CHARACTERISTIC InjSys_nEng08Vers2_AX InjSys_nEng08_AX InjSys_nEng10Vers2_AX InjSys_nEng10_AX InjSys_nEng12Hpx_AX InjSys_nEng12HspVers2_AX InjSys_nEng12Hsp_AX InjSys_nEng12Vers2_AX InjSys_nEng12_AX InjSys_nrInj04_AX InjSys_nrInj08_AX InjSys_ratAirChrgStrt8_AX InjSys_ratAirM08Vers2_AX InjSys_ratAirM08_AX InjSys_ratAirM12AgSpHspVers2_AX InjSys_ratAirM12AgSpHsp_AX InjSys_ratAirM12AgSpVers2_AX InjSys_ratAirM12AgSp_AX InjSys_ratAirM12Hpx_AX InjSys_ratAirM12Vers2_AX InjSys_ratAirM12_AX InjSys_stAirMAgSpHspVers1Sel_C InjSys_stAirMAgSpHspVers2Sel_C InjSys_stAirMAgSpVers1Sel_C InjSys_stAirMAgSpVers2Sel_C InjSys_stAirMSel_C InjSys_stAirMVers2Sel_C InjSys_stOilTSel_C InjSys_tCat08_AX InjSys_tEng08_AX InjSys_tEngStrt08_AX InjSys_tosp08_AX /end DEF_CHARACTERISTIC
 /begin IN_MEASUREMENT anztib_w_msg Epm_nEng ExhMod_mAirMfIntegEngFirstStrt ExhMod_tCat1B1 fethmnmx_msg InjSys_flgInjTmngErly InjSys_ratFuMAvrg InjSys_ratPrdcFuMLamDesAvrg InjSys_tEng InjSys_tEngStrt OilSwmpT_t rlp_w_msg rl_w_msg toch_w_msg /end IN_MEASUREMENT
 /begin LOC_MEASUREMENT InjSys_facEthLnrLoc InjSys_mAirMfIntegEngFirstStrtLoc InjSys_nrInjLimdLoc InjSys_ratAirChrgPredLoc InjSys_ratAirMAgSpAxisInp InjSys_ratAirMAgSpHspAxisInp InjSys_ratAirMAgSpHspVers2AxisInp InjSys_ratAirMAgSpVers2AxisInp InjSys_ratAirMAxisInp InjSys_ratAirMVers2AxisInp InjSys_ratRelAirChrgLoc InjSys_tOilSp /end LOC_MEASUREMENT
 FUNCTION_VERSION "3.14.0" /end FUNCTION
/begin FUNCTION InjSyG_CalcCnvnFac "159.0.0   Calculation Conversion Factors"
 /begin DEF_CHARACTERISTIC InjSys_facCorFuDens_T InjSys_ratEthPrtnBascFu_C InjSys_ratEthPrtnMaxEthFu_C InjSys_ratStoicEthnl_T InjSys_ratStoic_T InjSys_rhoAir_C InjSys_rhoFuEthnlStd_T InjSys_rhoFuPTCor_M InjSys_rhoFuStd_T InjSys_rhoFu_M InjSys_stTFuSel_C InjSys_volCyl_C /end DEF_CHARACTERISTIC
 /begin IN_MEASUREMENT FfPrm_facEthCurr ffuel_w_msg FlSys_tFlHPSys FuPHi_pRail thdev_msg /end IN_MEASUREMENT
 /begin OUT_MEASUREMENT ffudens_msg InjSys_facCnvnRatFuM InjSys_facStoiRhoMaxEthStd InjSys_ratEthPrtnBascFu InjSys_ratEthPrtnFuPerc InjSys_ratEthPrtnMaxEthFu InjSys_ratStoic InjSys_ratStoicFuBascTyp InjSys_ratStoicFuMaxEth InjSys_rhoFu InjSys_rhoFuBascTypStd InjSys_rhoFuMaxEthStd InjSys_rhoFuStd /end OUT_MEASUREMENT
 /begin LOC_MEASUREMENT InjSys_facEthnlCurr InjSys_facFuDens InjSys_facFuInjTi InjSys_pFu InjSys_tFu /end LOC_MEASUREMENT
 FUNCTION_VERSION "159.0.0" /end FUNCTION
/begin FUNCTION InjSyG_CatHeatgDsmDiag "3.1.0     Diagnosis of injection output while catalyst heating DSM interface"
 /begin DEF_CHARACTERISTIC InjSys_nrMinCmbCsers_C InjSys_nrMinCmbMulInj_C InjSys_ratCmbErrCsersMax_C InjSys_ratCmbErrMulInjMax_C InjSys_stCatHeatgDiag_C /end DEF_CHARACTERISTIC
 /begin IN_MEASUREMENT InjSys_flgCatHeatgOpModDiag InjSys_flgCsersInjModActv InjSys_flgCsersReqActv InjSys_flgMulInjModActv InjSys_nrCmbDurgEmiRedn InjSys_nrErrCmbDurgEmiRedn SyC_ctPostDrvLeave /end IN_MEASUREMENT
 /begin LOC_MEASUREMENT InjSys_ctPostDrvStrd InjSys_flgCsersDiagRprt InjSys_flgCsersNrCmbPassd InjSys_flgMulInjNrCmbPassd InjSys_flgSetCsersDiagDenom InjSys_flgSetMulInjDiagDenom InjSys_nrCmbCsersStrd InjSys_nrCmbMulInjDelta InjSys_nrCmbMulInjPrev InjSys_nrErrCmbCsersStrd InjSys_nrErrCmbMulInjDelta InjSys_nrErrCmbMulInjPrev InjSys_nrErrCmbNumr InjSys_nrTotCmbDenom InjSys_ratCmbErrCsers InjSys_ratCmbErrMulInj InjSys_stCollctnActvReq InjSys_stCollctnInjModActv InjSys_stCsersDiag InjSys_stMulInjDiag /end LOC_MEASUREMENT
 FUNCTION_VERSION "3.1.0" /end FUNCTION
/begin FUNCTION InjSyG_CatHeatgPlausDiag "5.6.0     Diagnosis plausibility of injection output while catalyst heating"
 /begin DEF_CHARACTERISTIC InjSys_agSpDeDiagMax_C InjSys_stChkInjModDiag_GT InjSys_stChkInjModMplInj_GT InjSys_tiPseSpDeDiagMax_C InjSys_tiSpDeDiagMax_C /end DEF_CHARACTERISTIC
 /begin REF_CHARACTERISTIC InjSys_stInjMod_AX /end REF_CHARACTERISTIC
 /begin IN_MEASUREMENT ExhMgT_flgCatHeatgCsers injddgdi_dtiInj1 injddgdi_dtiInj2 injddgdi_dtiInj3 injddgdi_dtiInj4 injmode_l_msg InjSys_nrInjCyc InjVvG_agInjPlsMeas InjVvG_cntCylInjPlsMeas InjVvG_nrInjPlsMeas InjVvG_tiInjPlsMeas InjVvG_tiPseInjPlsMeas SyC_ctPostDrvLeave ti1a_l_msg ti2a_l_msg ti3a_l_msg ti4a_l_msg tpes1a_w_msg tpes2a_w_msg tpes3a_w_msg tpes4a_w_msg wesot1a_w_msg wesot2a_w_msg wesot3a_w_msg wesot4a_w_msg zzylh_msg zzyls_msg /end IN_MEASUREMENT
 /begin OUT_MEASUREMENT InjSys_flgCatHeatgOpModDiag InjSys_flgChkCylCatHeatg InjSys_flgCmbCatHeatgDiag InjSys_flgCsersInjModActv InjSys_flgCsersReqActv InjSys_flgEmiRednDes InjSys_flgInjModeCatHeatg InjSys_flgMulInjModActv InjSys_nrCmbCatHeatgDiag InjSys_nrCmbDurgEmiRedn InjSys_nrErrCatHeatgDiag InjSys_nrErrCmbDurgEmiRedn /end OUT_MEASUREMENT
 /begin LOC_MEASUREMENT InjSys_agSpCatHeatgDiag InjSys_agSpDeDiagMax InjSys_ctPostDrvCntrStrd InjSys_flgCatHeatgDiagCopy InjSys_mskCylInjActvDiag InjSys_mskCylInjModeDiag InjSys_mskErrCatHeatgDiag InjSys_nrInjSpCatHeatgDiag InjSys_stInjPlsAgTiChkActv InjSys_stInjPlsBreakTiChkActv InjSys_tiPseSpCatHeatgDiag InjSys_tiPseSpDeDiagMax InjSys_tiSpCatHeatgDiag InjSys_tiSpDeDiagMax /end LOC_MEASUREMENT
 FUNCTION_VERSION "5.6.0" /end FUNCTION
/begin FUNCTION InjSyG_CoCvo "159.1.0   Coordinator controlled valve operation"
 /begin DEF_CHARACTERISTIC InjSys_nDeltaHysCvo_C InjSys_nEngMaxInjCvo_M InjSys_nEngMinBascCvo_C InjSys_nLowrThdCvo_C InjSys_nMaxSysRelsCvoDelta_C InjSys_nMaxSysRelsCvoThd_C InjSys_nrInjGapCvo_C InjSys_nrTstrMedPrioUrgCvo_C InjSys_nrTstrUrgCvo_C InjSys_nUpprThdCvo_C InjSys_pFuRailMinEnaCvo_C InjSys_ratFuMDeltaCvo_C InjSys_ratFuMMinCvo_C InjSys_relFillgCvoMax_C InjSys_stAllwdModCvo_C InjSys_stAllwdStgCvo_C InjSys_stCoApplCvo_C InjSys_stEomReqCvo_C InjSys_stHiPrioReqCvo_C InjSys_stOperModCvo_C InjSys_stOperModHiPrioCvo_C InjSys_stOperModPrioCvo_C InjSys_stOperModPrioHiPrioCvo_C InjSys_stOperModStgCvo_C InjSys_stOperModStgHiPrioCvo_C InjSys_tiDlyAbortEomCvo_C InjSys_tiMaxMiReqEna_C InjSys_tiPostStrtCvo_C InjSys_tLwrOperCvo_C InjSys_tqResvMinMiCvo_CUR InjSys_tUpprOperCvo_C InjSys_uBattLowrThdCvo_C InjSys_uBattUpprThdCvo_C InjSys_vMinVehBascAdpn_C /end DEF_CHARACTERISTIC
 /begin IN_MEASUREMENT alchpct_msg BattU_u B_ethg_msg B_khakt_msg B_khakw_msg B_ll_msg B_lr_msg B_nlhom_msg B_stendes_msg Epm_nEng Epm_numCyl Epm_stOpMode FuPHi_pRail InjSys_flgAdpnPlausb InjSys_flgCvoBascEna InjSys_flgEomCvoBasc InjSys_flgInjModReqCvo InjSys_flgMinTiBascCvo InjSys_flgReqSpRailCvo InjSys_nrMaiInjCyc InjSys_ratFuM InjSys_tiOffsMinMiCvo InjVvG_CvoAdpn_flgRelCtrl InjVvG_CvoAdpn_RmnPMask InjVvG_CvoAdpn_stReasBascAdpn InjVvG_desCylMsk InjVvG_desTiAry IVGdiCtl_stCvoTestInjBallReq rl_w_msg thdev_msg tnse_w_msg VehV_v zzylh_msg /end IN_MEASUREMENT
 /begin OUT_MEASUREMENT InjSys_desCylMask InjSys_EomCvoAllwd_I.stOperMod InjSys_EomCvoAllwd_I.stOperModPrio InjSys_EomCvoAllwd_I.stOperModStg InjSys_flgAdpnCvo InjSys_flgBascAdpnCvo InjSys_flgBascAdpnCvoPsbl InjSys_flgCtrlCvo InjSys_flgCvoTestInjBall InjSys_flgDesCylCvo InjSys_flgDsmCtrlAdpnCvo InjSys_flgHiPrioCvo InjSys_flgInjModCvo InjSys_flgReqPCvo InjSys_flgSysGenRelsCvo InjSys_stTstrRstCvo InjSys_tqResvCvo /end OUT_MEASUREMENT
 /begin LOC_MEASUREMENT InjSys_flgAuxCdnCvo InjSys_flgClbAssiCoorCvo InjSys_flgDlyAbortReqEomCvo InjSys_flgDsmBscAdpnCvo InjSys_flgEomCvoAllwd InjSys_flgEomReqAdpnCvo InjSys_flgGenCond InjSys_flgMaiCdnCvo InjSys_flgMaxSpdSysRelsCvo InjSys_flgMeaStCvo InjSys_flgReqCvoBascAdpnAVS InjSys_flgSpdEnaCvo InjSys_flgSysEnaCvo InjSys_flgSysRdnCvo InjSys_flgSysRdnReqCvo InjSys_flgTestInjCvo InjSys_nEngMaxCvo InjSys_nrMaiInjCycCvo InjSys_relEthAmntTmp InjSys_tiMinMiCvo InjSys_tInjrTmp InjSys_uBattCvo /end LOC_MEASUREMENT
 FUNCTION_VERSION "159.1.0" /end FUNCTION
/begin FUNCTION InjSyG_CoorrInjMod "2.5.0     Coordinator Injection Mode"
 /begin DEF_CHARACTERISTIC CalcInjModDft.stInjMod_M CalcInjMod_HOM.stInjMod_M CalcInjMod_HOM_WU.stInjMod_M CalcInjMod_HSP.stInjMod_M CalcInjMod_HSP_CH.stInjMod_M InjSys_facRatEngLoadEngWrmUp_T InjSys_nEngHysDelta_C InjSys_ratEngLoadHysDelta_C InjSys_stCalcInjModDft_C InjSys_stEom2stCalcInjModDyn_I.OperMod2Val_GT InjSys_stEom2stCalcInjMod_I.OperMod2Val_GT InjSys_stEom2stInjMod_I.OperMod2Val_GT InjSys_stEom2stSngMpg_I.OperMod2Val_GT InjSys_stFastStrtInjMod_T InjSys_stFastStrtReq_T InjSys_stInjModAltv_T InjSys_stInjModDft_C InjSys_stInjModTarAppl_C InjSys_stInjModTarStb_C InjSys_stInjModTar_C InjSys_stStrtReq2InjMod_T /end DEF_CHARACTERISTIC
 /begin REF_CHARACTERISTIC InjSys_stGdiOff_C InjSys_stInjModAppl_C /end REF_CHARACTERISTIC
 /begin IN_MEASUREMENT anztib_msg B_stendes_msg CoEng_stMai CoEOM_stEomCylAdv_a CoEOM_stEomTarInj EngStrt_stStrtReq EpmSeq_numInt Epm_nEng InjSys_ctCylAdvOffsHom InjSys_stInjModAllwd InjSys_stInjModProhb1 InjSys_stInjModProhb2 InjSys_stInjTmng InjSys_stTranTPist InjSys_tEng rlp_w_msg /end IN_MEASUREMENT
 /begin OUT_MEASUREMENT InjSys_stEomTarInj InjSys_stEomTarInjRdnt InjSys_stInjModStbTar InjSys_stInjModStbTarEngRunng InjSys_stInjModStbTarNxt InjSys_stInjModTar InjSys_stInjModTarEngRunng InjSys_stInjModTarNxt /end OUT_MEASUREMENT
 /begin LOC_MEASUREMENT InjSys_flgHysNEng InjSys_flgHysRatEngLoad InjSys_flgInjModSngMpg InjSys_nEngHys InjSys_ratEngLoadHys InjSys_stCalcInjMod InjSys_stEom2stCalcInjModDyn_I.idx InjSys_stEom2stCalcInjMod_I.idx InjSys_stEom2stInjMod_I.idx InjSys_stEom2stSngMpg_I.idx InjSys_stInjModAltv InjSys_stInjModTarEngStrt InjSys_stInjModTarRaw InjSys_stStrtReq /end LOC_MEASUREMENT
 FUNCTION_VERSION "2.5.0" /end FUNCTION
/begin FUNCTION InjSyG_CoorrInjTmng "2.4.0     Injection Timing Coordinator"
 /begin DEF_CHARACTERISTIC GDIOff.stInjPktVrntInst_C HO1.stInjPktVrntInst_C HO1_WU.stInjPktVrntInst_C HO2.stInjPktVrntInst_C HO2_WU.stInjPktVrntInst_C HO3.stInjPktVrntInst_C HO3_WU.stInjPktVrntInst_C HP2.stInjPktVrntInst_C HP2Z.stInjPktVrntInst_C HP2_CH.stInjPktVrntInst_C HP3.stInjPktVrntInst_C HP3Z.stInjPktVrntInst_C HP3_CH.stInjPktVrntInst_C InjSys_nEngMaxRtOpt_C InjSys_stGdiOff_C InjSys_stInjModAppl_C InjSys_stInjModStb_AX InjSys_stInjModStb_C InjSys_stInjModTyp_T InjSys_stInjMod_AX InjSys_stInjMod_C InjSys_stSyncDrctStrtEnaInj InjSys_stSyncEnaInj InjSys_stSyncHpStrtEnaInj SH1.stInjPktVrntInst_C SH2.stInjPktVrntInst_C SH3.stInjPktVrntInst_C SHO1.stInjPktVrntInst_C SHO2.stInjPktVrntInst_C SHO3.stInjPktVrntInst_C SHP3.stInjPktVrntInst_C UBHYEAKO UBRESMIN /end DEF_CHARACTERISTIC
 /begin IN_MEASUREMENT BattU_u B_evzaush_msg B_evzauss_msg B_stendes_msg B_sthdr_msg B_stostcom_msg EngStrt_flgDrctStrt EngStrt_stStrtReq Epm_nEng Epm_nEngTooth10ms Epm_numCyl Epm_stSync Gen_ctCylAdv InjSys_cntrSync0 InjSys_cntrSync1 InjSys_flgAgEndSyn0 InjSys_flgAgEndSyn1 InjSys_flgCvoBascCylIndEna InjSys_nrInjCycRaw InjSys_nrInjSyn0 InjSys_ofsCylCntrHom InjSys_ofsCylCntrStrat InjSys_stInjModStbTar InjSys_stInjModTar SyC_stSub zzylh_msg zzyls_msg /end IN_MEASUREMENT
 /begin OUT_MEASUREMENT injmoderdnt_l_msg injmode_l_msg InjSys_flgCvoEnaMem InjSys_flgInjEnad InjSys_flgInjModTran InjSys_flgInjTmngErly InjSys_flgRtOptNEng InjSys_idxInst InjSys_idxInstStb InjSys_idxPkt InjSys_idxPktStb InjSys_nrInjCyc InjSys_nrInjCycSyn0Mem InjSys_nrMaiInjCyc InjSys_stInjMod InjSys_stInjModAdvAry InjSys_stInjModStb InjSys_stInjModTyp InjSys_stInjModTypRdnt InjSys_stInjTmng InjSys_stInjTmngRdnt InjSys_vAgCrksft /end OUT_MEASUREMENT
 /begin LOC_MEASUREMENT InjSys_stInjModAry InjSys_stInjModStbTarLoc InjSys_stInjModTarLoc stInjModOld_MP /end LOC_MEASUREMENT
 FUNCTION_VERSION "2.4.0" /end FUNCTION
/begin FUNCTION InjSyG_DdIf "1.18.0    Interface Device Driver"
 /begin IN_MEASUREMENT Epm_numCyl InjSys_agInjSyn0 InjSys_agInjSyn1 InjSys_agShiftInj InjSys_agSoiCvo InjSys_flgAgEndSyn0 InjSys_flgAgEndSyn1 InjSys_flgCvoBascCylIndEna InjSys_flgInjTmngErly InjSys_nrInjCycSyn0Mem InjSys_nrMaiInjCyc InjSys_stInjTmng InjSys_tiBreakHiReslSyn0 InjSys_tiBreakHiReslSyn1 InjSys_tiDesCvo InjSys_tiInjSyn0 InjSys_tiInjSyn1 zzylh_msg zzyls_msg /end IN_MEASUREMENT
 /begin OUT_MEASUREMENT anztib_msg anztib_w_msg anzti_msg anzti_w_msg InjSys_cntrInjLimdSyncS1 InjSys_tiOutp1CylInd_a InjSys_tiOutp2CylInd_a InjSys_tiOutp3CylInd_a InjSys_tiOutp4CylInd_a ti1a_l_msg ti2a_l_msg ti3a_l_msg ti4a_l_msg tpes1a_w_msg tpes2a_w_msg tpes3a_w_msg tpes4a_w_msg wesot1a_w_msg wesot2a_w_msg wesot3a_w_msg wesot4a_w_msg /end OUT_MEASUREMENT
 /begin LOC_MEASUREMENT InjSys_agInjLoc InjSys_tiBreakHiReslLoc InjSys_tiInjLoc /end LOC_MEASUREMENT
 FUNCTION_VERSION "1.18.0" /end FUNCTION
/begin FUNCTION InjSyG_InjChk "1.12.1    Check Injection Timing"
 /begin DEF_CHARACTERISTIC InjSys_agDeltaInjDyn_C InjSys_agInjMax_M InjSys_agProhbEnd_M InjSys_agProhbStbOffs_C InjSys_agProhbStrt_M InjSys_nEngMaxNrInjHys_C InjSys_nEngMaxNrInj_M InjSys_stChkAgRng_T InjSys_stChkTiInjOpen_T InjSys_stInjChk_C InjSys_tiBreakThdStb_C InjSys_tiBreakThd_C InjSys_tiDebAllwd_C InjSys_tiDebNotAllwd_C InjSys_tiInjOpenThdStbOffs_C InjSys_tiInjOpenThd_T /end DEF_CHARACTERISTIC
 /begin REF_CHARACTERISTIC InjSys_stGdiOff_C InjSys_stInjModDft_C /end REF_CHARACTERISTIC
 /begin IN_MEASUREMENT BattU_u B_eprail_msg B_evzaush_msg B_evzauss_msg B_noesab_msg B_stendes_msg CEngDsT_t CoEng_stMai Epm_nEng InjSys_agEoiSyn0 InjSys_agEoiSyn0Stb InjSys_agEoiSyn1 InjSys_agEoiSyn1Stb InjSys_agSoiSyn0 InjSys_agSoiSyn0Stb InjSys_agSoiSyn1 InjSys_agSoiSyn1Stb InjSys_flgRtOptNEng InjSys_stInjMod InjSys_stInjModStb InjSys_stInjModTar InjSys_tiInjOpenSyn0 InjSys_tiInjOpenSyn0Stb InjSys_tiInjOpenSyn1 InjSys_tiInjOpenSyn1Stb InjSys_vAgCrksft rlp_w_msg wesabr_msg /end IN_MEASUREMENT
 /begin OUT_MEASUREMENT InjSys_agShiftInj InjSys_stInjModAllwd InjSys_stInjModProhb1 InjSys_stInjModProhb2 /end OUT_MEASUREMENT
 /begin LOC_MEASUREMENT InjSyG_InjChk_stIni InjSyG_InjChk_stIni_MP InjSys_agBreakThd InjSys_agBreakThdStb InjSys_agEoiLstSyn0 InjSys_agShiftInjAllwd InjSys_agShiftInjRqrd InjSys_flgAllwdAgRngDebStb InjSys_flgAllwdAgRngStb InjSys_flgAllwdNEngDebStb InjSys_flgAllwdNEngStb InjSys_flgAllwdTiBreakDebStb InjSys_flgAllwdTiBreakStb InjSys_flgAllwdTiInjOpenDebStb InjSys_flgAllwdTiInjOpenStb InjSys_flgChkVld InjSys_flgChkVldStb InjSys_flgNotAllwdAgRng InjSys_flgNotAllwdAgRngDeb InjSys_flgNotAllwdNEng InjSys_flgNotAllwdNEngDeb InjSys_flgNotAllwdTiBreak InjSys_flgNotAllwdTiBreakDeb InjSys_flgNotAllwdTiInjOpen InjSys_flgNotAllwdTiInjOpenDeb InjSys_nrCntrAgRngNotAllwd InjSys_nrCntrNEngNotAllwd InjSys_nrCntrTiBreakNotAllwd InjSys_nrCntrTiInjOpenNotAllwd InjSys_nrInjPhy InjSys_nrInjPhyStb InjSys_nrInjPhySyn0 InjSys_nrInjPhySyn0Stb InjSys_nrInjPhySyn1 InjSys_nrInjPhySyn1Stb InjSys_ratAirmPrdcLocChk InjSys_stAllwdAgRng InjSys_stAllwdAgRngStb InjSys_stAllwdAgRngSyn0 InjSys_stAllwdAgRngSyn0Stb InjSys_stAllwdAgRngSyn1 InjSys_stAllwdAgRngSyn1Stb InjSys_stAllwdTiBreak InjSys_stAllwdTiBreakStb InjSys_stAllwdTiBreakSyn0 InjSys_stAllwdTiBreakSyn0Stb InjSys_stAllwdTiBreakSyn1 InjSys_stAllwdTiBreakSyn1Stb InjSys_stAllwdTiInjOpen InjSys_stAllwdTiInjOpenStb InjSys_stAllwdTiInjOpenSyn0 InjSys_stAllwdTiInjOpenSyn0Stb InjSys_stAllwdTiInjOpenSyn1 InjSys_stAllwdTiInjOpenSyn1Stb InjSys_stInjModChkSyn0 InjSys_stInjModChkSyn0Stb InjSys_stInjModChkSyn1 InjSys_stInjModChkSyn1Stb InjSys_stnjModChk InjSys_stnjModChkStb InjSys_tiInjOpenThdStb /end LOC_MEASUREMENT
 FUNCTION_VERSION "1.12.1" /end FUNCTION
/begin FUNCTION InjSyG_InjSp "159.0.0   Injection Setpoints"
 /begin DEF_CHARACTERISTIC InjSys_facEnaTPistCorrn_M InjSys_P1APPL.agAux1_C InjSys_P1APPL.agAux2_C /end DEF_CHARACTERISTIC
 /begin REF_CHARACTERISTIC InjSys_nEng10_AX InjSys_nEng12Vers2_AX InjSys_nEng12_AX InjSys_ratAirM08_AX InjSys_ratAirM12AgSpVers2_AX InjSys_ratAirM12AgSp_AX InjSys_ratAirM12Vers2_AX InjSys_ratAirM12_AX InjSys_nEng08Vers2_AX InjSys_nEng08_AX InjSys_nEng12Hpx_AX InjSys_nEng12HspVers2_AX InjSys_nEng12Hsp_AX InjSys_nrInj04_AX InjSys_ratAirM08Vers2_AX InjSys_ratAirM12AgSpHspVers2_AX InjSys_ratAirM12AgSpHsp_AX InjSys_ratAirM12Hpx_AX InjSys_tEngStrt08_AX InjSys_nEng10Vers2_AX InjSys_nrInj08_AX InjSys_tEng08_AX InjSys_tosp08_AX InjSys_tCat08_AX /end REF_CHARACTERISTIC
 /begin IN_MEASUREMENT anztib_msg anztib_w_msg APP_r B_thdevmg_msg B_vhegfe_msg B_wks_msg EngStrt_flgDrctStrt Epm_nEng Epm_nEngTooth10ms ExhMod_tPistB1 ExhMod_tPistDeltaB1 ExhMod_tPistQstyB1 fethmnmx_msg fethstoe_msg fipoleth_msg Ign_iacalc_as8 IKCtl_agKnkAvrgGen_s8 InjSys_cntrInjLimdSyncS1 InjSys_flgInjModTran InjSys_ofsCylCntrHom InjSys_ratFuMMaxBall InjSys_ratFuMMinBall InjSys_tEng InjSys_tEngStrt lambas_msg OilSwmpT_t rlp_w_msg thdev_msg toch_w_msg wdirst_msg zzyls_msg /end IN_MEASUREMENT
 /begin LOC_MEASUREMENT agKnkAvrgLocSp fethstoeLocSp flgVlvLftLoc InjSys_agDrctStrtLocSp InjSys_facEthLnrLocSp InjSys_facLamBasLocSp InjSys_flgCldRstrtLoc InjSys_flgTPist InjSys_nrInjLimdLteLocSp InjSys_nrInjLoc InjSys_P1V1I1_HO.agBgnEthnltmp InjSys_P1V1I1_HO.agBgnStdtmp InjSys_P1V1I1_HO.agBgntmp InjSys_P1V1I1_HO.flgAgBgnLamActv InjSys_P1V1I1_HO.flgTPistCorrnActv InjSys_P1V1I2_HO.agBgnEthnltmp InjSys_P1V1I2_HO.agBgnStdtmp InjSys_P1V1I2_HO.agBgntmp InjSys_P1V1I2_HO.flgAgBgnLamActv InjSys_P1V1I2_HO.flgTPistCorrnActv InjSys_P1V2I1_HO.agBgnEthnltmp InjSys_P1V2I1_HO.agBgnStdtmp InjSys_P1V2I1_HO.agBgntmp InjSys_P1V2I1_HO.flgAgBgnLamActv InjSys_P1V2I1_HO.flgTPistCorrnActv InjSys_P1V2I2_HO.agBgnEthnltmp InjSys_P1V2I2_HO.agBgnStdtmp InjSys_P1V2I2_HO.agBgntmp InjSys_P1V2I2_HO.flgAgBgnLamActv InjSys_P1V2I2_HO.flgTPistCorrnActv InjSys_P1V3I1_HO.agBgnEthnltmp InjSys_P1V3I1_HO.agBgnStdtmp InjSys_P1V3I1_HO.agBgntmp InjSys_P1V3I1_HO.flgAgBgnLamActv InjSys_P1V3I1_HO.flgTPistCorrnActv InjSys_P1V3I2_HO.agBgnEthnltmp InjSys_P1V3I2_HO.agBgnStdtmp InjSys_P1V3I2_HO.agBgntmp InjSys_P1V3I2_HO.flgAgBgnLamActv InjSys_P1V3I2_HO.flgTPistCorrnActv InjSys_P1V4I1_HP.agBas1 InjSys_P1V4I1_HP.agBas2 InjSys_P1V4I1_HP.agBgnEthnltmp InjSys_P1V4I1_HP.agBgnStdtmp InjSys_P1V4I1_HP.agBgntmp InjSys_P1V4I1_HP.flgAgBgnLamActv InjSys_P1V4I1_HP.flgTPistCorrnActv InjSys_P1V4I2_HP.agBas1 InjSys_P1V4I2_HP.agBas2 InjSys_P1V4I2_HP.agBgnEthnltmp InjSys_P1V4I2_HP.agBgnStdtmp InjSys_P1V4I2_HP.agBgntmp InjSys_P1V4I2_HP.flgAgBgnLamActv InjSys_P1V4I2_HP.flgTPistCorrnActv InjSys_P1V4I3_HP.agBas1 InjSys_P1V4I3_HP.agBas2 InjSys_P1V4I3_HP.agBgnEthnltmp InjSys_P1V4I3_HP.agBgnStdtmp InjSys_P1V4I3_HP.agBgntmp InjSys_P1V4I3_HP.flgAgBgnLamActv InjSys_P1V4I3_HP.flgTPistCorrnActv InjSys_P1V4I4_HP.agBas1 InjSys_P1V4I4_HP.agBas2 InjSys_P1V4I4_HP.agBgnEthnltmp InjSys_P1V4I4_HP.agBgnStdtmp InjSys_P1V4I4_HP.agBgntmp InjSys_P1V4I4_HP.flgAgBgnLamActv InjSys_P1V4I4_HP.flgTPistCorrnActv InjSys_P1V4I5_HP.agBas1 InjSys_P1V4I5_HP.agBas2 InjSys_P1V4I5_HP.agBgnEthnltmp InjSys_P1V4I5_HP.agBgnStdtmp InjSys_P1V4I5_HP.agBgntmp InjSys_P1V4I5_HP.flgAgBgnLamActv InjSys_P1V4I5_HP.flgTPistCorrnActv InjSys_P1V4I6_HP.agBas1 InjSys_P1V4I6_HP.agBas2 InjSys_P1V4I6_HP.agBgnEthnltmp InjSys_P1V4I6_HP.agBgnStdtmp InjSys_P1V4I6_HP.agBgntmp InjSys_P1V4I6_HP.flgAgBgnLamActv InjSys_P1V4I6_HP.flgTPistCorrnActv InjSys_P2V1I1_HP.agBasEthnltmp InjSys_P2V1I1_HP.agBasStdtmp InjSys_P2V1I1_HP.agBastmp InjSys_P2V1I1_HP.facFuMEthnltmp InjSys_P2V1I1_HP.facFuMtmp InjSys_P2V1I1_HP.flgTPistCorrnActv InjSys_P2V1I1_HP.ratFuMStdtmp InjSys_P2V1I2_HP.agBasEthnltmp InjSys_P2V1I2_HP.agBasStdtmp InjSys_P2V1I2_HP.agBastmp InjSys_P2V1I2_HP.facFuMEthnltmp InjSys_P2V1I2_HP.facFuMtmp InjSys_P2V1I2_HP.flgTPistCorrnActv InjSys_P2V1I2_HP.ratFuMStdtmp InjSys_P2V1I3_HP.agBasEthnltmp InjSys_P2V1I3_HP.agBasStdtmp InjSys_P2V1I3_HP.agBastmp InjSys_P2V1I3_HP.facFuMEthnltmp InjSys_P2V1I3_HP.facFuMtmp InjSys_P2V1I3_HP.flgTPistCorrnActv InjSys_P2V1I3_HP.ratFuMStdtmp InjSys_P2V2I1_HP.agBasEthnltmp InjSys_P2V2I1_HP.agBasStdtmp InjSys_P2V2I1_HP.agBastmp InjSys_P2V2I1_HP.flgTPistCorrnActv InjSys_P2V2I2_HP.agBasEthnltmp InjSys_P2V2I2_HP.agBasStdtmp InjSys_P2V2I2_HP.agBastmp InjSys_P2V2I2_HP.flgTPistCorrnActv InjSys_P2V3I1_HP.flgTPistCorrnActv InjSys_P2V4I1_HP.flgTPistCorrnActv InjSys_P2V5I1_HP.flgTPistCorrnActv InjSys_P3V5I1_HPZ.agDelta InjSys_P3V5I2_HPZ.agDelta InjSys_rAppLocSp InjSys_ratAirMPredLocSp InjSys_tiBreakMin InjSys_tInjVlvLocSp InjSys_tOilLocSp InjSys_tPistBas InjSys_tPistDelta /end LOC_MEASUREMENT
 FUNCTION_VERSION "159.0.0" /end FUNCTION
/begin COMPU_METHOD AngleCrS "" RAT_FUNC "%6.4" "deg CrS" COEFFS 0 45.5111111111 0 0 0 1 /end COMPU_METHOD
/begin COMPU_METHOD B_TRUE "" TAB_VERB "%6.3" "" COMPU_TAB_REF B_TRUE /end COMPU_METHOD
/begin COMPU_VTAB B_TRUE "" TAB_VERB 2 0 "FALSE" 1 "TRUE" /end COMPU_VTAB
/begin COMPU_METHOD CoEOM_stEomStgTot_VERB "" TAB_VERB "%6.3" "-" COMPU_TAB_REF CoEOM_stEomStgTot_VERB /end COMPU_METHOD
/begin COMPU_VTAB CoEOM_stEomStgTot_VERB "" TAB_VERB 513 0 "Base_HOM-SNGL_FullLft" 1 "Base_HOM_FullLft" 2 "Base_HSP_FullLft" 3 "Base_HSPIC_FullLft" 4 "Base_HOM-SNGL_EIVC" 5 "Base_HOM_EIVC" 6 "Base_HSP_EIVC" 7 "Base_HSPIC_EIVC" 8 "n/a [00;08]" 9 "n/a [00;09]" 10 "n/a [00;10]" 11 "n/a [00;11]" 12 "n/a [00;12]" 13 "n/a [00;13]" 14 "n/a [00;14]" 15 "n/a [00;15]" 255 "No_Demand" 256 "WarmUp_HOM-SNGL_FullLft" 257 "WarmUp_HOM_FullLft" 258 "WarmUp_HSP_FullLft" 259 "WarmUp_HSPIC_FullLft" 260 "WarmUp_HOM-SNGL_EIVC" 261 "WarmUp_HOM_EIVC" 262 "WarmUp_HSP_EIVC" 263 "WarmUp_HSPIC_EIVC" 264 "n/a [01;08]" 265 "n/a [01;09]" 266 "n/a [01;10]" 267 "n/a [01;11]" 268 "n/a [01;12]" 269 "n/a [01;13]" 270 "n/a [01;14]" 271 "n/a [01;15]" 512 "CatHtg_HOM-SNGL_FullLft" 513 "CatHtg_HOM_FullLft" 514 "CatHtg_HSP_FullLft" 515 "CatHtg_HSPIC_FullLft" 516 "CatHtg_HOM-SNGL_EIVC" 517 "CatHtg_HOM_EIVC" 518 "CatHtg_HSP_EIVC" 519 "CatHtg_HSPIC_EIVC" 520 "n/a [02;08]" 521 "n/a [02;09]" 522 "n/a [02;10]" 523 "n/a [02;11]" 524 "n/a [02;12]" 525 "n/a [02;13]" 526 "n/a [02;14]" 527 "n/a [02;15]" 768 "Start_FullLft" 769 "n/a [03;01]" 770 "n/a [03;02]" 771 "n/a [03;03]" 772 "Start_EIVC" 773 "n/a [03;05]" 774 "n/a [03;06]" 775 "n/a [03;07]" 776 "n/a [03;08]" 777 "n/a [03;09]" 778 "n/a [03;10]" 779 "n/a [03;11]" 780 "n/a [03;12]" 781 "n/a [03;13]" 782 "n/a [03;14]" 783 "n/a [03;15]" 1024 "n/a [04;00]" 1025 "n/a [04;01]" 1026 "n/a [04;02]" 1027 "n/a [04;03]" 1028 "n/a [04;04]" 1029 "n/a [04;05]" 1030 "n/a [04;06]" 1031 "n/a [04;07]" 1032 "n/a [04;08]" 1033 "n/a [04;09]" 1034 "n/a [04;10]" 1035 "n/a [04;11]" 1036 "n/a [04;12]" 1037 "n/a [04;13]" 1038 "n/a [04;14]" 1039 "n/a [04;15]" 1280 "n/a [05;00]" 1281 "n/a [05;01]" 1282 "n/a [05;02]" 1283 "n/a [05;03]" 1284 "n/a [05;04]" 1285 "n/a [05;05]" 1286 "n/a [05;06]" 1287 "n/a [05;07]" 1288 "n/a [05;08]" 1289 "n/a [05;09]" 1290 "n/a [05;10]" 1291 "n/a [05;11]" 1292 "n/a [05;12]" 1293 "n/a [05;13]" 1294 "n/a [05;14]" 1295 "n/a [05;15]" 1536 "n/a [06;00]" 1537 "n/a [06;01]" 1538 "n/a [06;02]" 1539 "n/a [06;03]" 1540 "n/a [06;04]" 1541 "n/a [06;05]" 1542 "n/a [06;06]" 1543 "n/a [06;07]" 1544 "n/a [06;08]" 1545 "n/a [06;09]" 1546 "n/a [06;10]" 1547 "n/a [06;11]" 1548 "n/a [06;12]" 1549 "n/a [06;13]" 1550 "n/a [06;14]" 1551 "n/a [06;15]" 1792 "n/a [07;00]" 1793 "n/a [07;01]" 1794 "n/a [07;02]" 1795 "n/a [07;03]" 1796 "n/a [07;04]" 1797 "n/a [07;05]" 1798 "n/a [07;06]" 1799 "n/a [07;07]" 1800 "n/a [07;08]" 1801 "n/a [07;09]" 1802 "n/a [07;10]" 1803 "n/a [07;11]" 1804 "n/a [07;12]" 1805 "n/a [07;13]" 1806 "n/a [07;14]" 1807 "n/a [07;15]" 2048 "n/a [08;00]" 2049 "n/a [08;01]" 2050 "n/a [08;02]" 2051 "n/a [08;03]" 2052 "n/a [08;04]" 2053 "n/a [08;05]" 2054 "n/a [08;06]" 2055 "n/a [08;07]" 2056 "n/a [08;08]" 2057 "n/a [08;09]" 2058 "n/a [08;10]" 2059 "n/a [08;11]" 2060 "n/a [08;12]" 2061 "n/a [08;13]" 2062 "n/a [08;14]" 2063 "n/a [08;15]" 2304 "n/a [09;00]" 2305 "n/a [09;01]" 2306 "n/a [09;02]" 2307 "n/a [09;03]" 2308 "n/a [09;04]" 2309 "n/a [09;05]" 2310 "n/a [09;06]" 2311 "n/a [09;07]" 2312 "n/a [09;08]" 2313 "n/a [09;09]" 2314 "n/a [09;10]" 2315 "n/a [09;11]" 2316 "n/a [09;12]" 2317 "n/a [09;13]" 2318 "n/a [09;14]" 2319 "n/a [09;15]" 2560 "n/a [10;00]" 2561 "n/a [10;01]" 2562 "n/a [10;02]" 2563 "n/a [10;03]" 2564 "n/a [10;04]" 2565 "n/a [10;05]" 2566 "n/a [10;06]" 2567 "n/a [10;07]" 2568 "n/a [10;08]" 2569 "n/a [10;09]" 2570 "n/a [10;10]" 2571 "n/a [10;11]" 2572 "n/a [10;12]" 2573 "n/a [10;13]" 2574 "n/a [10;14]" 2575 "n/a [10;15]" 2816 "n/a [11;00]" 2817 "n/a [11;01]" 2818 "n/a [11;02]" 2819 "n/a [11;03]" 2820 "n/a [11;04]" 2821 "n/a [11;05]" 2822 "n/a [11;06]" 2823 "n/a [11;07]" 2824 "n/a [11;08]" 2825 "n/a [11;09]" 2826 "n/a [11;10]" 2827 "n/a [11;11]" 2828 "n/a [11;12]" 2829 "n/a [11;13]" 2830 "n/a [11;14]" 2831 "n/a [11;15]" 3072 "n/a [12;00]" 3073 "n/a [12;01]" 3074 "n/a [12;02]" 3075 "n/a [12;03]" 3076 "n/a [12;04]" 3077 "n/a [12;05]" 3078 "n/a [12;06]" 3079 "n/a [12;07]" 3080 "n/a [12;08]" 3081 "n/a [12;09]" 3082 "n/a [12;10]" 3083 "n/a [12;11]" 3084 "n/a [12;12]" 3085 "n/a [12;13]" 3086 "n/a [12;14]" 3087 "n/a [12;15]" 3328 "n/a [13;00]" 3329 "n/a [13;01]" 3330 "n/a [13;02]" 3331 "n/a [13;03]" 3332 "n/a [13;04]" 3333 "n/a [13;05]" 3334 "n/a [13;06]" 3335 "n/a [13;07]" 3336 "n/a [13;08]" 3337 "n/a [13;09]" 3338 "n/a [13;10]" 3339 "n/a [13;11]" 3340 "n/a [13;12]" 3341 "n/a [13;13]" 3342 "n/a [13;14]" 3343 "n/a [13;15]" 3584 "n/a [14;00]" 3585 "n/a [14;01]" 3586 "n/a [14;02]" 3587 "n/a [14;03]" 3588 "n/a [14;04]" 3589 "n/a [14;05]" 3590 "n/a [14;06]" 3591 "n/a [14;07]" 3592 "n/a [14;08]" 3593 "n/a [14;09]" 3594 "n/a [14;10]" 3595 "n/a [14;11]" 3596 "n/a [14;12]" 3597 "n/a [14;13]" 3598 "n/a [14;14]" 3599 "n/a [14;15]" 3840 "n/a [15;00]" 3841 "n/a [15;01]" 3842 "n/a [15;02]" 3843 "n/a [15;03]" 3844 "n/a [15;04]" 3845 "n/a [15;05]" 3846 "n/a [15;06]" 3847 "n/a [15;07]" 3848 "n/a [15;08]" 3849 "n/a [15;09]" 3850 "n/a [15;10]" 3851 "n/a [15;11]" 3852 "n/a [15;12]" 3853 "n/a [15;13]" 3854 "n/a [15;14]" 3855 "n/a [15;15]" 4096 "n/a [16;00]" 4097 "n/a [16;01]" 4098 "n/a [16;02]" 4099 "n/a [16;03]" 4100 "n/a [16;04]" 4101 "n/a [16;05]" 4102 "n/a [16;06]" 4103 "n/a [16;07]" 4104 "n/a [16;08]" 4105 "n/a [16;09]" 4106 "n/a [16;10]" 4107 "n/a [16;11]" 4108 "n/a [16;12]" 4109 "n/a [16;13]" 4110 "n/a [16;14]" 4111 "n/a [16;15]" 4352 "n/a [17;00]" 4353 "n/a [17;01]" 4354 "n/a [17;02]" 4355 "n/a [17;03]" 4356 "n/a [17;04]" 4357 "n/a [17;05]" 4358 "n/a [17;06]" 4359 "n/a [17;07]" 4360 "n/a [17;08]" 4361 "n/a [17;09]" 4362 "n/a [17;10]" 4363 "n/a [17;11]" 4364 "n/a [17;12]" 4365 "n/a [17;13]" 4366 "n/a [17;14]" 4367 "n/a [17;15]" 4608 "n/a [18;00]" 4609 "n/a [18;01]" 4610 "n/a [18;02]" 4611 "n/a [18;03]" 4612 "n/a [18;04]" 4613 "n/a [18;05]" 4614 "n/a [18;06]" 4615 "n/a [18;07]" 4616 "n/a [18;08]" 4617 "n/a [18;09]" 4618 "n/a [18;10]" 4619 "n/a [18;11]" 4620 "n/a [18;12]" 4621 "n/a [18;13]" 4622 "n/a [18;14]" 4623 "n/a [18;15]" 4864 "n/a [19;00]" 4865 "n/a [19;01]" 4866 "n/a [19;02]" 4867 "n/a [19;03]" 4868 "n/a [19;04]" 4869 "n/a [19;05]" 4870 "n/a [19;06]" 4871 "n/a [19;07]" 4872 "n/a [19;08]" 4873 "n/a [19;09]" 4874 "n/a [19;10]" 4875 "n/a [19;11]" 4876 "n/a [19;12]" 4877 "n/a [19;13]" 4878 "n/a [19;14]" 4879 "n/a [19;15]" 5120 "n/a [20;00]" 5121 "n/a [20;01]" 5122 "n/a [20;02]" 5123 "n/a [20;03]" 5124 "n/a [20;04]" 5125 "n/a [20;05]" 5126 "n/a [20;06]" 5127 "n/a [20;07]" 5128 "n/a [20;08]" 5129 "n/a [20;09]" 5130 "n/a [20;10]" 5131 "n/a [20;11]" 5132 "n/a [20;12]" 5133 "n/a [20;13]" 5134 "n/a [20;14]" 5135 "n/a [20;15]" 5376 "n/a [21;00]" 5377 "n/a [21;01]" 5378 "n/a [21;02]" 5379 "n/a [21;03]" 5380 "n/a [21;04]" 5381 "n/a [21;05]" 5382 "n/a [21;06]" 5383 "n/a [21;07]" 5384 "n/a [21;08]" 5385 "n/a [21;09]" 5386 "n/a [21;10]" 5387 "n/a [21;11]" 5388 "n/a [21;12]" 5389 "n/a [21;13]" 5390 "n/a [21;14]" 5391 "n/a [21;15]" 5632 "n/a [22;00]" 5633 "n/a [22;01]" 5634 "n/a [22;02]" 5635 "n/a [22;03]" 5636 "n/a [22;04]" 5637 "n/a [22;05]" 5638 "n/a [22;06]" 5639 "n/a [22;07]" 5640 "n/a [22;08]" 5641 "n/a [22;09]" 5642 "n/a [22;10]" 5643 "n/a [22;11]" 5644 "n/a [22;12]" 5645 "n/a [22;13]" 5646 "n/a [22;14]" 5647 "n/a [22;15]" 5888 "n/a [23;00]" 5889 "n/a [23;01]" 5890 "n/a [23;02]" 5891 "n/a [23;03]" 5892 "n/a [23;04]" 5893 "n/a [23;05]" 5894 "n/a [23;06]" 5895 "n/a [23;07]" 5896 "n/a [23;08]" 5897 "n/a [23;09]" 5898 "n/a [23;10]" 5899 "n/a [23;11]" 5900 "n/a [23;12]" 5901 "n/a [23;13]" 5902 "n/a [23;14]" 5903 "n/a [23;15]" 6144 "n/a [24;00]" 6145 "n/a [24;01]" 6146 "n/a [24;02]" 6147 "n/a [24;03]" 6148 "n/a [24;04]" 6149 "n/a [24;05]" 6150 "n/a [24;06]" 6151 "n/a [24;07]" 6152 "n/a [24;08]" 6153 "n/a [24;09]" 6154 "n/a [24;10]" 6155 "n/a [24;11]" 6156 "n/a [24;12]" 6157 "n/a [24;13]" 6158 "n/a [24;14]" 6159 "n/a [24;15]" 6400 "n/a [25;00]" 6401 "n/a [25;01]" 6402 "n/a [25;02]" 6403 "n/a [25;03]" 6404 "n/a [25;04]" 6405 "n/a [25;05]" 6406 "n/a [25;06]" 6407 "n/a [25;07]" 6408 "n/a [25;08]" 6409 "n/a [25;09]" 6410 "n/a [25;10]" 6411 "n/a [25;11]" 6412 "n/a [25;12]" 6413 "n/a [25;13]" 6414 "n/a [25;14]" 6415 "n/a [25;15]" 6656 "n/a [26;00]" 6657 "n/a [26;01]" 6658 "n/a [26;02]" 6659 "n/a [26;03]" 6660 "n/a [26;04]" 6661 "n/a [26;05]" 6662 "n/a [26;06]" 6663 "n/a [26;07]" 6664 "n/a [26;08]" 6665 "n/a [26;09]" 6666 "n/a [26;10]" 6667 "n/a [26;11]" 6668 "n/a [26;12]" 6669 "n/a [26;13]" 6670 "n/a [26;14]" 6671 "n/a [26;15]" 6912 "n/a [27;00]" 6913 "n/a [27;01]" 6914 "n/a [27;02]" 6915 "n/a [27;03]" 6916 "n/a [27;04]" 6917 "n/a [27;05]" 6918 "n/a [27;06]" 6919 "n/a [27;07]" 6920 "n/a [27;08]" 6921 "n/a [27;09]" 6922 "n/a [27;10]" 6923 "n/a [27;11]" 6924 "n/a [27;12]" 6925 "n/a [27;13]" 6926 "n/a [27;14]" 6927 "n/a [27;15]" 7168 "n/a [28;00]" 7169 "n/a [28;01]" 7170 "n/a [28;02]" 7171 "n/a [28;03]" 7172 "n/a [28;04]" 7173 "n/a [28;05]" 7174 "n/a [28;06]" 7175 "n/a [28;07]" 7176 "n/a [28;08]" 7177 "n/a [28;09]" 7178 "n/a [28;10]" 7179 "n/a [28;11]" 7180 "n/a [28;12]" 7181 "n/a [28;13]" 7182 "n/a [28;14]" 7183 "n/a [28;15]" 7424 "n/a [29;00]" 7425 "n/a [29;01]" 7426 "n/a [29;02]" 7427 "n/a [29;03]" 7428 "n/a [29;04]" 7429 "n/a [29;05]" 7430 "n/a [29;06]" 7431 "n/a [29;07]" 7432 "n/a [29;08]" 7433 "n/a [29;09]" 7434 "n/a [29;10]" 7435 "n/a [29;11]" 7436 "n/a [29;12]" 7437 "n/a [29;13]" 7438 "n/a [29;14]" 7439 "n/a [29;15]" 7680 "n/a [30;00]" 7681 "n/a [30;01]" 7682 "n/a [30;02]" 7683 "n/a [30;03]" 7684 "n/a [30;04]" 7685 "n/a [30;05]" 7686 "n/a [30;06]" 7687 "n/a [30;07]" 7688 "n/a [30;08]" 7689 "n/a [30;09]" 7690 "n/a [30;10]" 7691 "n/a [30;11]" 7692 "n/a [30;12]" 7693 "n/a [30;13]" 7694 "n/a [30;14]" 7695 "n/a [30;15]" 7936 "n/a [31;00]" 7937 "n/a [31;01]" 7938 "n/a [31;02]" 7939 "n/a [31;03]" 7940 "n/a [31;04]" 7941 "n/a [31;05]" 7942 "n/a [31;06]" 7943 "n/a [31;07]" 7944 "n/a [31;08]" 7945 "n/a [31;09]" 7946 "n/a [31;10]" 7947 "n/a [31;11]" 7948 "n/a [31;12]" 7949 "n/a [31;13]" 7950 "n/a [31;14]" 7951 "n/a [31;15]" /end COMPU_VTAB
/begin COMPU_METHOD DEZ "" RAT_FUNC "%6.2" "" COEFFS 0 1 0 0 0 1 /end COMPU_METHOD
/begin COMPU_METHOD dez "" RAT_FUNC "%6.2" "" COEFFS 0 1 0 0 0 1 /end COMPU_METHOD
/begin COMPU_METHOD EngN "" RAT_FUNC "%6.3" "rpm" COEFFS 0 2 0 0 0 1 /end COMPU_METHOD
/begin COMPU_METHOD ENGSTRT_STSTRTREQ_SET_COMPU_VERB "" TAB_VERB "%6.3" "-" COMPU_TAB_REF ENGSTRT_STSTRTREQ_SET_COMPU_VERB /end COMPU_METHOD
/begin COMPU_VTAB ENGSTRT_STSTRTREQ_SET_COMPU_VERB "" TAB_VERB 19 0 "ENGSTRT_NOSTRT" 1024 "ENGSTRT_LOP" 1028 "ENGSTRT_EOL" 1029 "ENGSTRT_PREINJ" 1031 "ENGSTRT_HIPEOL" 8192 "ENGSTRT_COMRUNNG" 8193 "ENGSTRT_COMSTRTG" 8194 "ENGSTRT_COMWAITSTRTR" 16384 "ENGSTRT_FOLW" 16385 "ENGSTRT_STRTR_DRCT" 32768 "ENGSTRT_HIPCOLD" 32769 "ENGSTRT_HIPMID" 32770 "ENGSTRT_HIPWRM" 256 "ENGSTRT_FOLWWRM" 257 "ENGSTRT_FOLWMID" 258 "ENGSTRT_FOLWCOLD" 259 "ENGSTRT_STRTR_DRCTWRM" 260 "ENGSTRT_STRTR_DRCTMID" 261 "ENGSTRT_STRTR_DRCTCOLD" /end COMPU_VTAB
/begin COMPU_METHOD Epm_stSync_State_t "" TAB_VERB "%6.3" "" COMPU_TAB_REF Epm_stSync_State_t /end COMPU_METHOD
/begin COMPU_VTAB Epm_stSync_State_t "" TAB_VERB 5 0 "EPM_NO_SYNC" 10 "EPM_ALE_SYNC" 20 "EPM_CAS_SYNC" 21 "EPM_DIRSTALE_SYNC" 30 "EPM_FULL_SYNC" /end COMPU_VTAB
/begin COMPU_METHOD fak_q0p000488 "" RAT_FUNC "%6.5" "-" COEFFS 0 65536 0 0 0 32 /end COMPU_METHOD
/begin COMPU_METHOD fak_q3p0518Em5 "" RAT_FUNC "%7.6" "" COEFFS 0 32768 0 0 0 1 /end COMPU_METHOD
/begin COMPU_METHOD fak_sw_b2 "" RAT_FUNC "%7.6" "-" COEFFS 0 65536 0 0 0 4 /end COMPU_METHOD
/begin COMPU_METHOD fak_ub_b1 "" RAT_FUNC "%6.4" "-" COEFFS 0 256 0 0 0 1 /end COMPU_METHOD
/begin COMPU_METHOD fak_ub_b2 "" RAT_FUNC "%8.5" "-" COEFFS 0 256 0 0 0 2 /end COMPU_METHOD
/begin COMPU_METHOD fak_uw_b2 "" RAT_FUNC "%7.6" "-" COEFFS 0 65536 0 0 0 2 /end COMPU_METHOD
/begin COMPU_METHOD fak_uw_b64 "" RAT_FUNC "%6.5" "-" COEFFS 0 65536 0 0 0 64 /end COMPU_METHOD
/begin COMPU_METHOD InjDDGdi_CvoMeas_State_t "" TAB_VERB "%6.3" "" COMPU_TAB_REF InjDDGdi_CvoMeas_State_t /end COMPU_METHOD
/begin COMPU_VTAB InjDDGdi_CvoMeas_State_t "" TAB_VERB 3 0 "CVO_MEAS_INACTIVE" 1 "CVO_MEAS_TRIGGERED" 2 "CVO_MEAS_ACTIVE" /end COMPU_VTAB
/begin COMPU_METHOD InjSys_CalcInjMod_Set_COMPU_VERB "" TAB_VERB "%6.3" "-" COMPU_TAB_REF InjSys_CalcInjMod_Set_COMPU_VERB /end COMPU_METHOD
/begin COMPU_VTAB InjSys_CalcInjMod_Set_COMPU_VERB "" TAB_VERB 5 0 "CalcInjModDft" 1 "CalcInjMod_HOM" 2 "CalcInjMod_HOM_WU" 3 "CalcInjMod_HSP" 4 "CalcInjMod_HSP_CH" /end COMPU_VTAB
/begin COMPU_METHOD InjSys_InjMode_Set_COMPU_VERB "" TAB_VERB "%6.3" "-" COMPU_TAB_REF InjSys_InjMode_Set_COMPU_VERB /end COMPU_METHOD
/begin COMPU_VTAB InjSys_InjMode_Set_COMPU_VERB "" TAB_VERB 20 0 "GDIOff" 1 "HO1" 2 "HO2" 3 "HO3" 4 "HO1_WU" 5 "HO2_WU" 6 "HO3_WU" 7 "HP2" 8 "HP3" 9 "HP2_CH" 10 "HP3_CH" 11 "HP2Z" 12 "HP3Z" 13 "SHO1" 14 "SHO2" 15 "SHO3" 16 "SHP3" 17 "SH1" 18 "SH2" 19 "SH3" /end COMPU_VTAB
/begin COMPU_METHOD InjVvg_PstInj_State_t "" TAB_VERB "%6.3" "" COMPU_TAB_REF InjVvg_PstInj_State_t /end COMPU_METHOD
/begin COMPU_VTAB InjVvg_PstInj_State_t "" TAB_VERB 6 0 "PSTINJ_NO_REQ" 1 "PSTINJ_IMPLICIT" 2 "PSTINJ_IMPLICIT_LIMITED" 3 "PSTINJ_EXPLICIT" 4 "PSTINJ_EXPLICIT_LIMITED" 5 "PSTINJ_SUPPRESSED" /end COMPU_VTAB
/begin COMPU_METHOD kwgrad_q0p00286 "" RAT_FUNC "%6.4" "deg KW/ms" COEFFS 0 131072 0 0 0 375 /end COMPU_METHOD
/begin COMPU_METHOD kw_q0p0234 "" RAT_FUNC "%6.4" "Grad KW" COEFFS 0 32768 0 0 0 768 /end COMPU_METHOD
/begin COMPU_METHOD kw_q0p375 "" RAT_FUNC "%6.3" "deg KW" COEFFS 0 1 0 0 0 0.375 /end COMPU_METHOD
/begin COMPU_METHOD kw_q0p75 "" RAT_FUNC "%6.3" "Grad KW" COEFFS 0 4 0 0 0 3 /end COMPU_METHOD
/begin COMPU_METHOD kw_q0p75_o210 "" RAT_FUNC "%6.1" "Grad KW" COEFFS 0 4 -840 0 0 3 /end COMPU_METHOD
/begin COMPU_METHOD kw_q0p75_o240 "" RAT_FUNC "%6.1" "Grad KW" COEFFS 0 4 -960 0 0 3 /end COMPU_METHOD
/begin COMPU_METHOD kw_q2 "" RAT_FUNC "%6.2" "deg KW" COEFFS 0 1 0 0 0 2 /end COMPU_METHOD
/begin COMPU_METHOD kw_sw_q0p0219 "" RAT_FUNC "%6.4" "Grad KW" COEFFS 0 32768 0 0 0 720 /end COMPU_METHOD
/begin COMPU_METHOD md_q0p1 "" RAT_FUNC "%6.3" "Nm" COEFFS 0 10 0 0 0 1 /end COMPU_METHOD
/begin COMPU_METHOD m_q0p1_g_DIV_L "" RAT_FUNC "%6.3" "g/l" COEFFS 0 10 0 0 0 1 /end COMPU_METHOD
/begin COMPU_METHOD m_q1Em7_g_DIV_pc "" RAT_FUNC "%10.9" "g/%" COEFFS 0 10000000 0 0 0 1 /end COMPU_METHOD
/begin COMPU_METHOD m_q2p44em4 "" RAT_FUNC "%6.5" "g/l" COEFFS 0 65536 0 0 0 16 /end COMPU_METHOD
/begin COMPU_METHOD m_uw_b23p3 "" RAT_FUNC "%6.5" "kg" COEFFS 0 2812.5 0 0 0 1 /end COMPU_METHOD
/begin COMPU_METHOD nmot_ub_q40 "" RAT_FUNC "%6.1" "1/min" COEFFS 0 1 0 0 0 40 /end COMPU_METHOD
/begin COMPU_METHOD OneToOne "" RAT_FUNC "%6.2" "-" COEFFS 0 1 0 0 0 1 /end COMPU_METHOD
/begin COMPU_METHOD Prc "" RAT_FUNC "%6.4" "%" COEFFS 0 81.92 0 0 0 1 /end COMPU_METHOD
/begin COMPU_METHOD p_q0p128 "" RAT_FUNC "%6.3" "MPa" COEFFS 0 1 0 0 0 0.128 /end COMPU_METHOD
/begin COMPU_METHOD q0p0005_MPa_DIV_rev "" RAT_FUNC "%6.5" "MPa/rev" COEFFS 0 10000 0 0 0 5 /end COMPU_METHOD
/begin COMPU_METHOD q36p615_percent_GradKW_DIV_ms "" RAT_FUNC "%6.1" "(%*deg KW)/ms" COEFFS 0 400 0 0 0 14646 /end COMPU_METHOD
/begin COMPU_METHOD RBPtCel_p_0p002_1 "" RAT_FUNC "%6.4" "MPa" COEFFS 0 1000 0 0 0 2 /end COMPU_METHOD
/begin COMPU_METHOD RBPtCel_vcos_5p0em5_1 "" RAT_FUNC "%7.6" "mPaSec" COEFFS 0 20000 0 0 0 1 /end COMPU_METHOD
/begin COMPU_METHOD rel_q0p0234 "" RAT_FUNC "%6.4" "%" COEFFS 0 128 0 0 0 3 /end COMPU_METHOD
/begin COMPU_METHOD rel_ub_b100 "" RAT_FUNC "%6.3" "%" COEFFS 0 256 0 0 0 100 /end COMPU_METHOD
/begin COMPU_METHOD rel_uw_b100 "" RAT_FUNC "%6.4" "%" COEFFS 0 65536 0 0 0 100 /end COMPU_METHOD
/begin COMPU_METHOD rel_uw_b3072 "" RAT_FUNC "%6.4" "%" COEFFS 0 65536 0 0 0 3072 /end COMPU_METHOD
/begin COMPU_METHOD rel_uw_q0p0234 "" RAT_FUNC "%6.4" "%" COEFFS 0 32 0 0 0 0.75 /end COMPU_METHOD
/begin COMPU_METHOD REMSTRTVRNT_SC_Compu "" TAB_VERB "%6.3" "" COMPU_TAB_REF REMSTRTVRNT_SC_Compu /end COMPU_METHOD
/begin COMPU_VTAB REMSTRTVRNT_SC_Compu "" TAB_VERB 3 0 "REMSTRTVRNT_NOREMSTRT" 1 "REMSTRTVRNT_FULLACTVN" 2 "REMSTRTVRNT_PTLACTVN" /end COMPU_VTAB
/begin COMPU_METHOD REQOILWRMUP_TSTRCOM_SC_Compu "" TAB_VERB "%6.3" "" COMPU_TAB_REF REQOILWRMUP_TSTRCOM_SC_Compu /end COMPU_METHOD
/begin COMPU_VTAB REQOILWRMUP_TSTRCOM_SC_Compu "" TAB_VERB 2 0 "False" 1 "True" /end COMPU_VTAB
/begin COMPU_METHOD Resist "" RAT_FUNC "%6.3" "Ohm" COEFFS 0 10 0 0 0 1 /end COMPU_METHOD
/begin COMPU_METHOD ResPerMass_hPaHrPerCM "" RAT_FUNC "%7.6" "(hPa(m^3/h))/g" COEFFS 0 10000 0 0 0 1 /end COMPU_METHOD
/begin COMPU_METHOD Res_hPaHrPerCM "" RAT_FUNC "%7.6" "hPa/(m^3/h)" COEFFS 0 10000 0 0 0 1 /end COMPU_METHOD
/begin COMPU_METHOD Res_hPaSPerCM "" RAT_FUNC "%6.5" "hPa/(m^3*s/h)" COEFFS 0 1000 0 0 0 1 /end COMPU_METHOD
/begin COMPU_METHOD ReynoldsNum "" RAT_FUNC "%6.0" "-" COEFFS 0 0.01 0 0 0 1 /end COMPU_METHOD
/begin COMPU_METHOD ReynoldsNum1 "" RAT_FUNC "%7.0" "-" COEFFS 0 0.001 0 0 0 1 /end COMPU_METHOD
/begin COMPU_METHOD RhoFuel "" RAT_FUNC "%6.3" "kg/m^3" COEFFS 0 10 0 0 0 1 /end COMPU_METHOD
/begin COMPU_METHOD rhoOilAsh_g_p_l "" RAT_FUNC "%6.3" "g/l" COEFFS 0 10 0 0 0 1 /end COMPU_METHOD
/begin COMPU_METHOD Rho_q0p001_COMPU "" RAT_FUNC "%6.5" "Kg/m^3" COEFFS 0 1000 0 0 0 1 /end COMPU_METHOD
/begin COMPU_METHOD RHUSTGYPRS_SY_Compu "" TAB_VERB "%6.3" "" COMPU_TAB_REF RHUSTGYPRS_SY_Compu /end COMPU_METHOD
/begin COMPU_VTAB RHUSTGYPRS_SY_Compu "" TAB_VERB 2 0 "False" 1 "True" /end COMPU_VTAB
/begin COMPU_METHOD RLXBF_SC_Compu "" TAB_VERB "%6.3" "" COMPU_TAB_REF RLXBF_SC_Compu /end COMPU_METHOD
/begin COMPU_VTAB RLXBF_SC_Compu "" TAB_VERB 2 0 "False" 1 "True" /end COMPU_VTAB
/begin COMPU_METHOD Rmp "" RAT_FUNC "%6.4" "1/s" COEFFS 0 65.536 0 0 0 1 /end COMPU_METHOD
/begin COMPU_METHOD RmpDtyCyc "" RAT_FUNC "%6.5" "%/s" COEFFS 0 6553.6 0 0 0 1 /end COMPU_METHOD
/begin COMPU_METHOD Rmp_1 "" RAT_FUNC "%6.5" "1/s" COEFFS 0 1000 0 0 0 1 /end COMPU_METHOD
/begin COMPU_METHOD RMTAPP_ENBL_SY_Compu "" TAB_VERB "%6.3" "" COMPU_TAB_REF RMTAPP_ENBL_SY_Compu /end COMPU_METHOD
/begin COMPU_VTAB RMTAPP_ENBL_SY_Compu "" TAB_VERB 2 0 "False" 1 "True" /end COMPU_VTAB
/begin COMPU_METHOD RNGMOD_TQFRICADPNGBXPHD_SC_Compu "" TAB_VERB "%6.3" "" COMPU_TAB_REF RNGMOD_TQFRICADPNGBXPHD_SC_Compu /end COMPU_METHOD
/begin COMPU_VTAB RNGMOD_TQFRICADPNGBXPHD_SC_Compu "" TAB_VERB 2 0 "False" 1 "True" /end COMPU_VTAB
/begin COMPU_METHOD RPLUSMOD_SC_Compu "" TAB_VERB "%6.3" "" COMPU_TAB_REF RPLUSMOD_SC_Compu /end COMPU_METHOD
/begin COMPU_VTAB RPLUSMOD_SC_Compu "" TAB_VERB 2 0 "False" 1 "True" /end COMPU_VTAB
/begin COMPU_METHOD RRDFOGSWT_HWACTV_SC_Compu "" TAB_VERB "%6.3" "" COMPU_TAB_REF RRDFOGSWT_HWACTV_SC_Compu /end COMPU_METHOD
/begin COMPU_VTAB RRDFOGSWT_HWACTV_SC_Compu "" TAB_VERB 2 0 "Inactive" 1 "Active" /end COMPU_VTAB
/begin COMPU_METHOD RTE_RIPSIMPLTIMEDCOM_SC_Compu "" TAB_VERB "%6.3" "" COMPU_TAB_REF RTE_RIPSIMPLTIMEDCOM_SC_Compu /end COMPU_METHOD
/begin COMPU_VTAB RTE_RIPSIMPLTIMEDCOM_SC_Compu "" TAB_VERB 2 0 "False" 1 "True" /end COMPU_VTAB
/begin COMPU_METHOD SAIL_SY_Compu "" TAB_VERB "%6.3" "" COMPU_TAB_REF SAIL_SY_Compu /end COMPU_METHOD
/begin COMPU_VTAB SAIL_SY_Compu "" TAB_VERB 2 0 "False" 1 "True" /end COMPU_VTAB
/begin COMPU_METHOD SCAV_INHOUSE_SY_Compu "" TAB_VERB "%6.3" "" COMPU_TAB_REF SCAV_INHOUSE_SY_Compu /end COMPU_METHOD
/begin COMPU_VTAB SCAV_INHOUSE_SY_Compu "" TAB_VERB 2 0 "False" 1 "True" /end COMPU_VTAB
/begin COMPU_METHOD SCRM_kg_q0p001_COMPU "" RAT_FUNC "%6.5" "kg" COEFFS 0 1000 0 0 0 1 /end COMPU_METHOD
/begin COMPU_METHOD SCR_DmStp0001 "" RAT_FUNC "%6.5" "mg/Step" COEFFS 0 1000 0 0 0 1 /end COMPU_METHOD
/begin COMPU_METHOD SCR_kPa_10 "" RAT_FUNC "%6.1" "kPa" COEFFS 0 0.1 0 0 0 1 /end COMPU_METHOD
/begin COMPU_METHOD SCR_kPa_100 "" RAT_FUNC "%6.0" "kPa" COEFFS 0 0.01 0 0 0 1 /end COMPU_METHOD
/begin COMPU_METHOD SCR_MSSENBL_SY_Compu "" TAB_VERB "%6.3" "" COMPU_TAB_REF SCR_MSSENBL_SY_Compu /end COMPU_METHOD
/begin COMPU_VTAB SCR_MSSENBL_SY_Compu "" TAB_VERB 2 0 "False" 1 "True" /end COMPU_VTAB
/begin COMPU_METHOD SCR_SY_Compu "" TAB_VERB "%6.3" "" COMPU_TAB_REF SCR_SY_Compu /end COMPU_METHOD
/begin COMPU_VTAB SCR_SY_Compu "" TAB_VERB 4 0 "NOSCR" 1 "RBSCR" 2 "INERGYSCR" 3 "AGKSCR" /end COMPU_VTAB
/begin COMPU_METHOD SCR_Volt_q0p0001227 "" RAT_FUNC "%6.5" "V" COEFFS 0 8192 0 0 0 1 /end COMPU_METHOD
/begin COMPU_METHOD SCTPMP1T_TYPAVL_SY_Compu "" TAB_VERB "%6.3" "" COMPU_TAB_REF SCTPMP1T_TYPAVL_SY_Compu /end COMPU_METHOD
/begin COMPU_VTAB SCTPMP1T_TYPAVL_SY_Compu "" TAB_VERB 2 0 "False" 1 "True" /end COMPU_VTAB
/begin COMPU_METHOD SCTPMP2_TYPAVL_SY_Compu "" TAB_VERB "%6.3" "" COMPU_TAB_REF SCTPMP2_TYPAVL_SY_Compu /end COMPU_METHOD
/begin COMPU_VTAB SCTPMP2_TYPAVL_SY_Compu "" TAB_VERB 2 0 "False" 1 "True" /end COMPU_VTAB
/begin COMPU_METHOD SCV_SY_Compu "" TAB_VERB "%6.3" "" COMPU_TAB_REF SCV_SY_Compu /end COMPU_METHOD
/begin COMPU_VTAB SCV_SY_Compu "" TAB_VERB 7 0 "no swirl control flap active" 1 "two-points SCV without position feedback" 2 "two-points SCV withposition feedback" 3 "continously SCV  with DC motor" 4 "continously SCV with stepper motor" 5 "continoulsy SCV with position regulation at the fa" 6 "continously SCV with position regulation in ECU" /end COMPU_VTAB
/begin COMPU_METHOD SEAWTRP_TYPAVL_SC_Compu "" TAB_VERB "%6.3" "" COMPU_TAB_REF SEAWTRP_TYPAVL_SC_Compu /end COMPU_METHOD
/begin COMPU_VTAB SEAWTRP_TYPAVL_SC_Compu "" TAB_VERB 2 0 "False" 1 "True" /end COMPU_VTAB
/begin COMPU_METHOD SEAWTRT_TYPAVL_SC_Compu "" TAB_VERB "%6.3" "" COMPU_TAB_REF SEAWTRT_TYPAVL_SC_Compu /end COMPU_METHOD
/begin COMPU_VTAB SEAWTRT_TYPAVL_SC_Compu "" TAB_VERB 2 0 "False" 1 "True" /end COMPU_VTAB
/begin COMPU_METHOD t100msxs_uw_b6553p5 "" RAT_FUNC "%6.3" "s" COEFFS 0 1 0 0 0 0.1 /end COMPU_METHOD
/begin COMPU_METHOD t10msxs_uw_b655p35 "" RAT_FUNC "%6.4" "s" COEFFS 0 1 0 0 0 0.01 /end COMPU_METHOD
/begin COMPU_METHOD Temp_Cels "" RAT_FUNC "%6.1" "deg C" COEFFS 0 10 2731.4 0 0 1 /end COMPU_METHOD
/begin COMPU_METHOD temp_q0p1 "" RAT_FUNC "%6.3" "Grad C" COEFFS 0 10 0 0 0 1 /end COMPU_METHOD
/begin COMPU_METHOD temp_ub_q0p75_o48 "" RAT_FUNC "%6.2" "Grad C" COEFFS 0 1 48 0 0 0.75 /end COMPU_METHOD
/begin COMPU_METHOD t_q0p0004_ms "" RAT_FUNC "%6.5" "ms" COEFFS 0 10000 0 0 0 4 /end COMPU_METHOD
/begin COMPU_METHOD t_q0p001_ms "" RAT_FUNC "%6.5" "ms" COEFFS 0 1 0 0 0 0.001 /end COMPU_METHOD
/begin COMPU_METHOD t_q0p01 "" RAT_FUNC "%6.4" "s" COEFFS 0 100 0 0 0 1 /end COMPU_METHOD
/begin COMPU_METHOD t_q0p02 "" RAT_FUNC "%6.4" "s" COEFFS 0 100 0 0 0 2 /end COMPU_METHOD
/begin COMPU_METHOD t_q0p04_ms "" RAT_FUNC "%6.4" "ms" COEFFS 0 1 0 0 0 0.04 /end COMPU_METHOD
/begin COMPU_METHOD t_q0p1 "" RAT_FUNC "%6.3" "s" COEFFS 0 10 0 0 0 1 /end COMPU_METHOD
/begin COMPU_METHOD t_q0p4us "" RAT_FUNC "%6.3" "us" COEFFS 0 1 0 0 0 0.4 /end COMPU_METHOD
/begin COMPU_METHOD t_q10_ms "" RAT_FUNC "%6.1" "ms" COEFFS 0 1 0 0 0 10 /end COMPU_METHOD
/begin COMPU_METHOD Vel "" RAT_FUNC "%6.4" "km/h" COEFFS 0 100 0 0 0 1 /end COMPU_METHOD
/begin COMPU_METHOD Volt_Batt "" RAT_FUNC "%6.1" "mV" COEFFS 0 0.05 0 0 0 1 /end COMPU_METHOD
/begin COMPU_METHOD vol_q5p0Em5_l "" RAT_FUNC "%7.6" "L" COEFFS 0 20000 0 0 0 1 /end COMPU_METHOD
/begin RECORD_LAYOUT KwSw FNC_VALUES 1 SWORD COLUMN_DIR DIRECT /end RECORD_LAYOUT
/begin RECORD_LAYOUT KwUb FNC_VALUES 1 UBYTE COLUMN_DIR DIRECT /end RECORD_LAYOUT
/begin RECORD_LAYOUT KwUw FNC_VALUES 1 UWORD COLUMN_DIR DIRECT /end RECORD_LAYOUT
/begin RECORD_LAYOUT KwWS16 FNC_VALUES 1 SWORD COLUMN_DIR DIRECT /end RECORD_LAYOUT
/begin RECORD_LAYOUT KwWS32 FNC_VALUES 1 SLONG COLUMN_DIR DIRECT /end RECORD_LAYOUT
/begin RECORD_LAYOUT KwWU16 FNC_VALUES 1 UWORD COLUMN_DIR DIRECT /end RECORD_LAYOUT
/begin RECORD_LAYOUT RB_Axis_S16 NO_AXIS_PTS_X 1 SWORD AXIS_PTS_X 2 SWORD INDEX_INCR DIRECT /end RECORD_LAYOUT
/begin RECORD_LAYOUT RB_Axis_U16 NO_AXIS_PTS_X 1 UWORD AXIS_PTS_X 2 UWORD INDEX_INCR DIRECT /end RECORD_LAYOUT
/begin RECORD_LAYOUT RB_Axis_U8 NO_AXIS_PTS_X 1 UBYTE AXIS_PTS_X 2 UBYTE INDEX_INCR DIRECT /end RECORD_LAYOUT
/begin RECORD_LAYOUT RB_CurveGroup_U16 FNC_VALUES 1 UWORD COLUMN_DIR DIRECT /end RECORD_LAYOUT
/begin RECORD_LAYOUT RB_CurveGroup_U8 FNC_VALUES 1 UBYTE COLUMN_DIR DIRECT /end RECORD_LAYOUT
/begin RECORD_LAYOUT RB_Curve_S16_U16_Static NO_AXIS_PTS_X 1 SWORD AXIS_PTS_X 2 SWORD INDEX_INCR DIRECT FNC_VALUES 3 UWORD COLUMN_DIR DIRECT STATIC_RECORD_LAYOUT /end RECORD_LAYOUT
/begin RECORD_LAYOUT RB_Curve_U16_S16_Static NO_AXIS_PTS_X 1 UWORD AXIS_PTS_X 2 UWORD INDEX_INCR DIRECT FNC_VALUES 3 SWORD COLUMN_DIR DIRECT STATIC_RECORD_LAYOUT /end RECORD_LAYOUT
/begin RECORD_LAYOUT RB_Curve_U16_U16 NO_AXIS_PTS_X 1 UWORD AXIS_PTS_X 2 UWORD INDEX_INCR DIRECT FNC_VALUES 3 UWORD COLUMN_DIR DIRECT /end RECORD_LAYOUT
/begin RECORD_LAYOUT RB_Curve_U16_U8_Static NO_AXIS_PTS_X 1 UWORD AXIS_PTS_X 2 UWORD INDEX_INCR DIRECT FNC_VALUES 3 UBYTE COLUMN_DIR DIRECT STATIC_RECORD_LAYOUT /end RECORD_LAYOUT
/begin RECORD_LAYOUT RB_Curve_U8_U16_Static NO_AXIS_PTS_X 1 UBYTE AXIS_PTS_X 2 UBYTE INDEX_INCR DIRECT FNC_VALUES 3 UWORD COLUMN_DIR DIRECT STATIC_RECORD_LAYOUT /end RECORD_LAYOUT
/begin RECORD_LAYOUT RB_Curve_U8_U8 NO_AXIS_PTS_X 1 UBYTE AXIS_PTS_X 2 UBYTE INDEX_INCR DIRECT FNC_VALUES 3 UBYTE COLUMN_DIR DIRECT /end RECORD_LAYOUT
/begin RECORD_LAYOUT RB_Map_S16S16_U8 NO_AXIS_PTS_X 1 SWORD NO_AXIS_PTS_Y 2 SWORD AXIS_PTS_X 3 SWORD INDEX_INCR DIRECT AXIS_PTS_Y 4 SWORD INDEX_INCR DIRECT FNC_VALUES 5 UBYTE COLUMN_DIR DIRECT /end RECORD_LAYOUT
/begin RECORD_LAYOUT RB_Map_S16U16_S16 NO_AXIS_PTS_X 1 SWORD NO_AXIS_PTS_Y 2 SWORD AXIS_PTS_X 3 SWORD INDEX_INCR DIRECT AXIS_PTS_Y 4 UWORD INDEX_INCR DIRECT FNC_VALUES 5 SWORD ROW_DIR DIRECT /end RECORD_LAYOUT
/begin RECORD_LAYOUT RB_Map_S16U16_U8 NO_AXIS_PTS_X 1 SWORD NO_AXIS_PTS_Y 2 SWORD AXIS_PTS_X 3 SWORD INDEX_INCR DIRECT AXIS_PTS_Y 4 UWORD INDEX_INCR DIRECT FNC_VALUES 5 UBYTE ROW_DIR DIRECT /end RECORD_LAYOUT
/begin RECORD_LAYOUT RB_Map_U16U16_U16 NO_AXIS_PTS_X 1 UWORD NO_AXIS_PTS_Y 2 UWORD AXIS_PTS_X 3 UWORD INDEX_INCR DIRECT AXIS_PTS_Y 4 UWORD INDEX_INCR DIRECT FNC_VALUES 5 UWORD COLUMN_DIR DIRECT /end RECORD_LAYOUT
/begin RECORD_LAYOUT RB_Map_U16U8_U16 NO_AXIS_PTS_X 1 UWORD NO_AXIS_PTS_Y 2 UWORD AXIS_PTS_X 3 UWORD INDEX_INCR DIRECT AXIS_PTS_Y 4 UBYTE INDEX_INCR DIRECT FNC_VALUES 5 UWORD COLUMN_DIR DIRECT /end RECORD_LAYOUT
/begin RECORD_LAYOUT RB_Map_U8S16_S16 NO_AXIS_PTS_X 1 UBYTE NO_AXIS_PTS_Y 2 UBYTE AXIS_PTS_X 3 UBYTE INDEX_INCR DIRECT AXIS_PTS_Y 4 SWORD INDEX_INCR DIRECT FNC_VALUES 5 SWORD ROW_DIR DIRECT /end RECORD_LAYOUT
/begin RECORD_LAYOUT RB_Map_U8U8_U16 NO_AXIS_PTS_X 1 UBYTE NO_AXIS_PTS_Y 2 UBYTE AXIS_PTS_X 3 UBYTE INDEX_INCR DIRECT AXIS_PTS_Y 4 UBYTE INDEX_INCR DIRECT FNC_VALUES 5 UWORD COLUMN_DIR DIRECT /end RECORD_LAYOUT
/begin RECORD_LAYOUT RB_Val_Wboolean FNC_VALUES 1 UBYTE COLUMN_DIR DIRECT /end RECORD_LAYOUT
/begin RECORD_LAYOUT RB_Val_Ws16 FNC_VALUES 1 SWORD COLUMN_DIR DIRECT /end RECORD_LAYOUT
/begin RECORD_LAYOUT RB_Val_Wu16 FNC_VALUES 1 UWORD COLUMN_DIR DIRECT /end RECORD_LAYOUT
/begin RECORD_LAYOUT RB_Val_Wu32 FNC_VALUES 1 ULONG COLUMN_DIR DIRECT /end RECORD_LAYOUT
/begin RECORD_LAYOUT RB_Val_Wu8 FNC_VALUES 1 UBYTE COLUMN_DIR DIRECT /end RECORD_LAYOUT
/end MODULE
/end PROJECT
