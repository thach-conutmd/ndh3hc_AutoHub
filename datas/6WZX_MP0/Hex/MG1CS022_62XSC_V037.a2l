ASAP2_VERSION 1 60
/begin PROJECT MG1CS022 "MG1CS022"
/begin HEADER "" VERSION "MG1CS022_62XSC_V037" PROJECT_NO MG1CS022 /end HEADER
/begin MODULE DIM ""
/begin MOD_COMMON "" BYTE_ORDER MSB_LAST ALIGNMENT_BYTE 1 ALIGNMENT_WORD 2 ALIGNMENT_LONG 4 ALIGNMENT_INT64 4 ALIGNMENT_FLOAT32_IEEE 4 ALIGNMENT_FLOAT64_IEEE 4 DATA_SIZE 32 /end MOD_COMMON
/begin CHARACTERISTIC CWMSUDKSOM "codeword MSUDKSOM" VALUE 0x80579DAC RB_Val_Wu8 255.0 OneToOne 0.00 255.0 FORMAT "%5.1" /end CHARACTERISTIC
/begin AXIS_PTS EngStrt_facCoorAltiAirPth_AX "Base point distribution over altitude correction for air path at start" 0x80579DAE PEnv_facCorrAlti RB_Axis_U16 3.999939 fak_uw_b4 4 0.00 3.999939 FORMAT "%8.6" DEPOSIT ABSOLUTE /end AXIS_PTS
/begin CHARACTERISTIC EngStrt_facCoorAltiMfAir_GT "Correction curve dependent on height of the filling feed forward control in the start to the avoidance of start problems on account of a too slightly precontrolled filling" CURVE 0x80579DB8 RB_CurveGroup_U8 1.992188 fak_ub_b2 0.00 1.992188 FORMAT "%8.6"
 /begin AXIS_DESCR COM_AXIS PEnv_facCorrAlti fak_uw_b4 4 0.00 3.999939 FORMAT "%8.6" AXIS_PTS_REF EngStrt_facCoorAltiAirPth_AX /end AXIS_DESCR
/end CHARACTERISTIC
/begin CHARACTERISTIC EngStrt_idxClassSelnTiFacAirPthTran_T "Curve class selector for filter time class" CURVE 0x80579DBC RB_Curve_U16_U8_Static 255.0 OneToOne 0.00 255.0 FORMAT "%5.1"
 /begin AXIS_DESCR STD_AXIS EngStrt_stStrtReq ENGSTRT_STSTRTREQ_SET_COMPU_VERB 19 0.00 32770.0000000 FORMAT "%13.7" DEPOSIT ABSOLUTE /end AXIS_DESCR
/end CHARACTERISTIC
/begin CHARACTERISTIC EngStrt_idxSelnMfAirWait_T "Curve class instance selector for air mass flow between start request and start beginning" CURVE 0x80579DF8 RB_Curve_U16_U8_Static 0.00 ENGSTRT_MFAIRWAIT_SET_COMPU_VERB 0.00 0.00 FORMAT "%13.2"
 /begin AXIS_DESCR STD_AXIS EngStrt_stStrtReq ENGSTRT_STSTRTREQ_SET_COMPU_VERB 19 0.00 32770.0000000 FORMAT "%13.7" DEPOSIT ABSOLUTE /end AXIS_DESCR
/end CHARACTERISTIC
/begin CHARACTERISTIC EngStrt_idxSelnMfAir_T "Curve class instance selector for air mass flow during start" CURVE 0x80579E34 RB_Curve_U16_U8_Static 3.00000000000 ENGSTRT_MFAIRSTRT_SET_COMPU_VERB 0.00 3.00000000000 FORMAT "%13.11"
 /begin AXIS_DESCR STD_AXIS EngStrt_stStrtReq ENGSTRT_STSTRTREQ_SET_COMPU_VERB 19 0.00 32770.0000000 FORMAT "%13.7" DEPOSIT ABSOLUTE /end AXIS_DESCR
/end CHARACTERISTIC
/begin CHARACTERISTIC EngStrt_idxSelnTiFacAirPthTranCon_T "Curve class instance selector for filter time parameter during start" CURVE 0x80579E70 RB_Curve_U16_U8_Static 1.00000000000 ENGSTRT_TIFACAIRPTHTRANCON_SET_COMPU_VERB 0.00 1.00000000000 FORMAT "%13.11"
 /begin AXIS_DESCR STD_AXIS EngStrt_stStrtReq ENGSTRT_STSTRTREQ_SET_COMPU_VERB 19 0.00 32770.0000000 FORMAT "%13.7" DEPOSIT ABSOLUTE /end AXIS_DESCR
/end CHARACTERISTIC
/begin CHARACTERISTIC EngStrt_idxSelnTiFacAirPthTran_T "Curve class instance selector for filter time table during start" CURVE 0x80579EAC RB_Curve_U16_U8_Static 1.00000000000 ENGSTRT_TIFACAIRPTHTRAN_SET_COMPU_VERB 0.00 1.00000000000 FORMAT "%13.11"
 /begin AXIS_DESCR STD_AXIS EngStrt_stStrtReq ENGSTRT_STSTRTREQ_SET_COMPU_VERB 19 0.00 32770.0000000 FORMAT "%13.7" DEPOSIT ABSOLUTE /end AXIS_DESCR
/end CHARACTERISTIC
/begin CHARACTERISTIC EngStrt_mAirOfsVapSuspc_T "Map for the Additonal Air Mass Offset during Vapor Lock Suspension" CURVE 0x80579EE8 RB_Curve_S16_U16_Static 6553.500 m_uw_b6553p5 0.00 6553.500 FORMAT "%8.3"
 /begin AXIS_DESCR STD_AXIS CEngDsT_t Temp_Cels 8 -3549.940 3003.560 FORMAT "%8.3" DEPOSIT ABSOLUTE /end AXIS_DESCR
/end CHARACTERISTIC
/begin CHARACTERISTIC EngStrt_mAirSnsrFail_C "Calibration for the Air Mass Offset during TW Sensor Failure" VALUE 0x80579F0A RB_Val_Wu16 6553.500 m_uw_b6553p5 0.00 6553.500 FORMAT "%8.3" /end CHARACTERISTIC
/begin CHARACTERISTIC EngStrt_mfAirEngOff_GT "Grouped curve desired standardised air mass flow at stopped engine" CURVE 0x80579F0C RB_CurveGroup_U16 6553.500 m_uw_b6553p5 0.00 6553.500 FORMAT "%8.3"
 /begin AXIS_DESCR COM_AXIS EngStrt_tStrtCoor Temp_Cels 12 -273.140 3003.560 FORMAT "%8.3" EXTENDED_LIMITS -3549.940 3003.560 AXIS_PTS_REF EngStrt_tStrtAirPth_AX /end AXIS_DESCR
/end CHARACTERISTIC
/begin AXIS_PTS EngStrt_nEngAirPth_AX "Base point distribution over engine speed for air path at start" 0x80579F24 Epm_nEng10ms RB_Axis_S16 32767.50 EngN 4 -16384.00 16383.50 FORMAT "%8.2" DEPOSIT ABSOLUTE /end AXIS_PTS
/begin CHARACTERISTIC EngStrt_nNxtStrtAirPthRst_T "Curve for the threshold COM for deactivation desired throttle position without torque structure" CURVE 0x80579F2E RB_Curve_S16_S16 32767.50 EngN -16384.00 16383.50 FORMAT "%8.2"
 /begin AXIS_DESCR STD_AXIS EngStrt_tStrtCoor Temp_Cels 6 -273.140 3003.560 FORMAT "%8.3" EXTENDED_LIMITS -3549.940 3003.560 DEPOSIT ABSOLUTE /end AXIS_DESCR
/end CHARACTERISTIC
/begin AXIS_PTS EngStrt_nrInjAirPth_AX "Base point distribution for the number of injection" 0x80579F48 EngStrt_nrInjAirPth RB_Axis_U8 255.0 OneToOne 8 0.00 255.0 FORMAT "%5.1" DEPOSIT ABSOLUTE /end AXIS_PTS
/begin AXIS_PTS EngStrt_rPedAirPth_AX "Base point distribution over accelerator pedal angle for air path at start" 0x80579F52 APP_r RB_Axis_S16 799.9878 Prc 10 -400.0000 399.9878 FORMAT "%8.4" DEPOSIT ABSOLUTE /end AXIS_PTS
/begin AXIS_PTS EngStrt_tStrtAirPth_AX "Base point distribution over start temperature for air path at start" 0x80579F68 EngStrt_tStrtCoor RB_Axis_S16 3276.700 Temp_Cels 12 -273.140 3003.560 FORMAT "%8.3" EXTENDED_LIMITS -3549.940 3003.560 DEPOSIT ABSOLUTE /end AXIS_PTS
/begin CHARACTERISTIC KFMSUDKSH "additional desired air mass flow at start with independent car heater" MAP 0x80579F82 RB_Map_U8S16_U16 6553.500 m_uw_b6553p5 0.00 6553.500 FORMAT "%8.3"
 /begin AXIS_DESCR STD_AXIS tumgsudksh temp_ub_q0p75_o48 6 -48.0 143.3 FORMAT "%5.1" DEPOSIT ABSOLUTE /end AXIS_DESCR
 /begin AXIS_DESCR STD_AXIS EngStrt_tStrtCoor Temp_Cels 6 -273.140 3003.560 FORMAT "%8.3" EXTENDED_LIMITS -3549.940 3003.560 DEPOSIT ABSOLUTE /end AXIS_DESCR
/end CHARACTERISTIC
/begin CHARACTERISTIC KLRSDKSST "characteristic line reset throttle conrol for start" CURVE 0x80579FDE RB_Curve_S16_S16 32767.50 EngN -16384.00 16383.50 FORMAT "%8.2"
 /begin AXIS_DESCR STD_AXIS EngStrt_tStrtCoor Temp_Cels 4 -273.140 3003.560 FORMAT "%8.3" EXTENDED_LIMITS -3549.940 3003.560 DEPOSIT ABSOLUTE /end AXIS_DESCR
/end CHARACTERISTIC
/begin CHARACTERISTIC KLTSSDKSST "characteristic line reset throttle conrol for start" CURVE 0x80579FF0 RB_Curve_S16_U16_Static 655.3500 t_q0p01 0.00 655.3500 FORMAT "%8.4"
 /begin AXIS_DESCR STD_AXIS EngStrt_tStrtCoor Temp_Cels 4 -273.140 3003.560 FORMAT "%8.3" EXTENDED_LIMITS -3549.940 3003.560 DEPOSIT ABSOLUTE /end AXIS_DESCR
/end CHARACTERISTIC
/begin CHARACTERISTIC KLWMSABST "correction desired standardised over critical air mass flow by soak time" CURVE 0x8057A002 RB_Curve_U16_U8_Static 1.992188 fak_ub_b2 0.00 1.992188 FORMAT "%8.6"
 /begin AXIS_DESCR STD_AXIS tabstloc_w t1sxs_uw_q1 4 0.00 65535.00 FORMAT "%8.2" DEPOSIT ABSOLUTE /end AXIS_DESCR
/end CHARACTERISTIC
/begin CHARACTERISTIC MFAIRSTRT_BASE.mfAirAccrPed_GM "Class instance for desired air mass flow at start / Offset grouped map desired standardised over critical air mass flow requested by the driver" MAP 0x8057A864 RB_MapGroup_U16 6553.500 m_uw_b6553p5 0.00 6553.500 FORMAT "%8.3"
 /begin AXIS_DESCR COM_AXIS APP_r Prc 10 -400.0000 399.9878 FORMAT "%8.4" AXIS_PTS_REF EngStrt_rPedAirPth_AX /end AXIS_DESCR
 /begin AXIS_DESCR COM_AXIS Epm_nEng10ms EngN 4 -16384.00 16383.50 FORMAT "%8.2" AXIS_PTS_REF EngStrt_nEngAirPth_AX /end AXIS_DESCR
/end CHARACTERISTIC
/begin CHARACTERISTIC MFAIRSTRT_BASE.mfAirBaseNrInj_GM "Class instance for desired air mass flow at start / Number of Injections" MAP 0x8057A8B4 RB_MapGroup_U16 6553.500 m_uw_b6553p5 0.00 6553.500 FORMAT "%8.3"
 /begin AXIS_DESCR COM_AXIS EngStrt_tStrtCoor Temp_Cels 12 -273.140 3003.560 FORMAT "%8.3" EXTENDED_LIMITS -3549.940 3003.560 AXIS_PTS_REF EngStrt_tStrtAirPth_AX /end AXIS_DESCR
 /begin AXIS_DESCR COM_AXIS EngStrt_nrInjAirPth OneToOne 8 0.00 255.0 FORMAT "%5.1" AXIS_PTS_REF EngStrt_nrInjAirPth_AX /end AXIS_DESCR
/end CHARACTERISTIC
/begin CHARACTERISTIC MFAIRSTRT_BASE.mfAirCatHeatgEth_GM "Class instance for desired air mass flow at start / Map air mass flow at start during catalyst heating with max. ethanol rate" MAP 0x8057A974 RB_MapGroup_U16 6553.500 m_uw_b6553p5 0.00 6553.500 FORMAT "%8.3"
 /begin AXIS_DESCR COM_AXIS EngStrt_tStrtCoor Temp_Cels 12 -273.140 3003.560 FORMAT "%8.3" EXTENDED_LIMITS -3549.940 3003.560 AXIS_PTS_REF EngStrt_tStrtAirPth_AX /end AXIS_DESCR
 /begin AXIS_DESCR COM_AXIS Epm_nEng10ms EngN 4 -16384.00 16383.50 FORMAT "%8.2" AXIS_PTS_REF EngStrt_nEngAirPth_AX /end AXIS_DESCR
/end CHARACTERISTIC
/begin CHARACTERISTIC MFAIRSTRT_BASE.mfAirCatHeatg_GM "Class instance for desired air mass flow at start / Map air mass flow at start during catalyst heating" MAP 0x8057A9D4 RB_MapGroup_U16 6553.500 m_uw_b6553p5 0.00 6553.500 FORMAT "%8.3"
 /begin AXIS_DESCR COM_AXIS EngStrt_tStrtCoor Temp_Cels 12 -273.140 3003.560 FORMAT "%8.3" EXTENDED_LIMITS -3549.940 3003.560 AXIS_PTS_REF EngStrt_tStrtAirPth_AX /end AXIS_DESCR
 /begin AXIS_DESCR COM_AXIS Epm_nEng10ms EngN 4 -16384.00 16383.50 FORMAT "%8.2" AXIS_PTS_REF EngStrt_nEngAirPth_AX /end AXIS_DESCR
/end CHARACTERISTIC
/begin CHARACTERISTIC MFAIRSTRT_BASE.mfAirEth_GM "Class instance for desired air mass flow at start / Map air mass flow at start with max. ethanol rate" MAP 0x8057AA34 RB_MapGroup_U16 6553.500 m_uw_b6553p5 0.00 6553.500 FORMAT "%8.3"
 /begin AXIS_DESCR COM_AXIS EngStrt_tStrtCoor Temp_Cels 12 -273.140 3003.560 FORMAT "%8.3" EXTENDED_LIMITS -3549.940 3003.560 AXIS_PTS_REF EngStrt_tStrtAirPth_AX /end AXIS_DESCR
 /begin AXIS_DESCR COM_AXIS Epm_nEng10ms EngN 4 -16384.00 16383.50 FORMAT "%8.2" AXIS_PTS_REF EngStrt_nEngAirPth_AX /end AXIS_DESCR
/end CHARACTERISTIC
/begin CHARACTERISTIC MFAIRSTRT_BASE.mfAir_GM "Class instance for desired air mass flow at start / Map air mass flow at start" MAP 0x8057AA94 RB_MapGroup_U16 6553.500 m_uw_b6553p5 0.00 6553.500 FORMAT "%8.3"
 /begin AXIS_DESCR COM_AXIS EngStrt_tStrtCoor Temp_Cels 12 -273.140 3003.560 FORMAT "%8.3" EXTENDED_LIMITS -3549.940 3003.560 AXIS_PTS_REF EngStrt_tStrtAirPth_AX /end AXIS_DESCR
 /begin AXIS_DESCR COM_AXIS Epm_nEng10ms EngN 4 -16384.00 16383.50 FORMAT "%8.2" AXIS_PTS_REF EngStrt_nEngAirPth_AX /end AXIS_DESCR
/end CHARACTERISTIC
/begin CHARACTERISTIC MFAIRSTRT_COM.mfAirAccrPed_GM " / Offset grouped map desired standardised over critical air mass flow requested by the driver" MAP 0x8057A06C RB_MapGroup_U16 6553.500 m_uw_b6553p5 0.00 6553.500 FORMAT "%8.3"
 /begin AXIS_DESCR COM_AXIS APP_r Prc 10 -400.0000 399.9878 FORMAT "%8.4" AXIS_PTS_REF EngStrt_rPedAirPth_AX /end AXIS_DESCR
 /begin AXIS_DESCR COM_AXIS Epm_nEng10ms EngN 4 -16384.00 16383.50 FORMAT "%8.2" AXIS_PTS_REF EngStrt_nEngAirPth_AX /end AXIS_DESCR
/end CHARACTERISTIC
/begin CHARACTERISTIC MFAIRSTRT_COM.mfAirBaseNrInj_GM " / Number of Injections" MAP 0x8057A0BC RB_MapGroup_U16 6553.500 m_uw_b6553p5 0.00 6553.500 FORMAT "%8.3"
 /begin AXIS_DESCR COM_AXIS EngStrt_tStrtCoor Temp_Cels 12 -273.140 3003.560 FORMAT "%8.3" EXTENDED_LIMITS -3549.940 3003.560 AXIS_PTS_REF EngStrt_tStrtAirPth_AX /end AXIS_DESCR
 /begin AXIS_DESCR COM_AXIS EngStrt_nrInjAirPth OneToOne 8 0.00 255.0 FORMAT "%5.1" AXIS_PTS_REF EngStrt_nrInjAirPth_AX /end AXIS_DESCR
/end CHARACTERISTIC
/begin CHARACTERISTIC MFAIRSTRT_COM.mfAirCatHeatgEth_GM " / Map air mass flow at start during catalyst heating with max. ethanol rate" MAP 0x8057A17C RB_MapGroup_U16 6553.500 m_uw_b6553p5 0.00 6553.500 FORMAT "%8.3"
 /begin AXIS_DESCR COM_AXIS EngStrt_tStrtCoor Temp_Cels 12 -273.140 3003.560 FORMAT "%8.3" EXTENDED_LIMITS -3549.940 3003.560 AXIS_PTS_REF EngStrt_tStrtAirPth_AX /end AXIS_DESCR
 /begin AXIS_DESCR COM_AXIS Epm_nEng10ms EngN 4 -16384.00 16383.50 FORMAT "%8.2" AXIS_PTS_REF EngStrt_nEngAirPth_AX /end AXIS_DESCR
/end CHARACTERISTIC
/begin CHARACTERISTIC MFAIRSTRT_COM.mfAirCatHeatg_GM " / Map air mass flow at start during catalyst heating" MAP 0x8057A1DC RB_MapGroup_U16 6553.500 m_uw_b6553p5 0.00 6553.500 FORMAT "%8.3"
 /begin AXIS_DESCR COM_AXIS EngStrt_tStrtCoor Temp_Cels 12 -273.140 3003.560 FORMAT "%8.3" EXTENDED_LIMITS -3549.940 3003.560 AXIS_PTS_REF EngStrt_tStrtAirPth_AX /end AXIS_DESCR
 /begin AXIS_DESCR COM_AXIS Epm_nEng10ms EngN 4 -16384.00 16383.50 FORMAT "%8.2" AXIS_PTS_REF EngStrt_nEngAirPth_AX /end AXIS_DESCR
/end CHARACTERISTIC
/begin CHARACTERISTIC MFAIRSTRT_COM.mfAirEth_GM " / Map air mass flow at start with max. ethanol rate" MAP 0x8057A23C RB_MapGroup_U16 6553.500 m_uw_b6553p5 0.00 6553.500 FORMAT "%8.3"
 /begin AXIS_DESCR COM_AXIS EngStrt_tStrtCoor Temp_Cels 12 -273.140 3003.560 FORMAT "%8.3" EXTENDED_LIMITS -3549.940 3003.560 AXIS_PTS_REF EngStrt_tStrtAirPth_AX /end AXIS_DESCR
 /begin AXIS_DESCR COM_AXIS Epm_nEng10ms EngN 4 -16384.00 16383.50 FORMAT "%8.2" AXIS_PTS_REF EngStrt_nEngAirPth_AX /end AXIS_DESCR
/end CHARACTERISTIC
/begin CHARACTERISTIC MFAIRSTRT_COM.mfAir_GM " / Map air mass flow at start" MAP 0x8057A29C RB_MapGroup_U16 6553.500 m_uw_b6553p5 0.00 6553.500 FORMAT "%8.3"
 /begin AXIS_DESCR COM_AXIS EngStrt_tStrtCoor Temp_Cels 12 -273.140 3003.560 FORMAT "%8.3" EXTENDED_LIMITS -3549.940 3003.560 AXIS_PTS_REF EngStrt_tStrtAirPth_AX /end AXIS_DESCR
 /begin AXIS_DESCR COM_AXIS Epm_nEng10ms EngN 4 -16384.00 16383.50 FORMAT "%8.2" AXIS_PTS_REF EngStrt_nEngAirPth_AX /end AXIS_DESCR
/end CHARACTERISTIC
/begin CHARACTERISTIC MFAIRSTRT_COMWAITSTRTR.mfAirAccrPed_GM " / Offset grouped map desired standardised over critical air mass flow requested by the driver" MAP 0x8057A300 RB_MapGroup_U16 6553.500 m_uw_b6553p5 0.00 6553.500 FORMAT "%8.3"
 /begin AXIS_DESCR COM_AXIS APP_r Prc 10 -400.0000 399.9878 FORMAT "%8.4" AXIS_PTS_REF EngStrt_rPedAirPth_AX /end AXIS_DESCR
 /begin AXIS_DESCR COM_AXIS Epm_nEng10ms EngN 4 -16384.00 16383.50 FORMAT "%8.2" AXIS_PTS_REF EngStrt_nEngAirPth_AX /end AXIS_DESCR
/end CHARACTERISTIC
/begin CHARACTERISTIC MFAIRSTRT_COMWAITSTRTR.mfAirBaseNrInj_GM " / Number of Injections" MAP 0x8057A350 RB_MapGroup_U16 6553.500 m_uw_b6553p5 0.00 6553.500 FORMAT "%8.3"
 /begin AXIS_DESCR COM_AXIS EngStrt_tStrtCoor Temp_Cels 12 -273.140 3003.560 FORMAT "%8.3" EXTENDED_LIMITS -3549.940 3003.560 AXIS_PTS_REF EngStrt_tStrtAirPth_AX /end AXIS_DESCR
 /begin AXIS_DESCR COM_AXIS EngStrt_nrInjAirPth OneToOne 8 0.00 255.0 FORMAT "%5.1" AXIS_PTS_REF EngStrt_nrInjAirPth_AX /end AXIS_DESCR
/end CHARACTERISTIC
/begin CHARACTERISTIC MFAIRSTRT_COMWAITSTRTR.mfAirCatHeatgEth_GM " / Map air mass flow at start during catalyst heating with max. ethanol rate" MAP 0x8057A410 RB_MapGroup_U16 6553.500 m_uw_b6553p5 0.00 6553.500 FORMAT "%8.3"
 /begin AXIS_DESCR COM_AXIS EngStrt_tStrtCoor Temp_Cels 12 -273.140 3003.560 FORMAT "%8.3" EXTENDED_LIMITS -3549.940 3003.560 AXIS_PTS_REF EngStrt_tStrtAirPth_AX /end AXIS_DESCR
 /begin AXIS_DESCR COM_AXIS Epm_nEng10ms EngN 4 -16384.00 16383.50 FORMAT "%8.2" AXIS_PTS_REF EngStrt_nEngAirPth_AX /end AXIS_DESCR
/end CHARACTERISTIC
/begin CHARACTERISTIC MFAIRSTRT_COMWAITSTRTR.mfAirCatHeatg_GM " / Map air mass flow at start during catalyst heating" MAP 0x8057A470 RB_MapGroup_U16 6553.500 m_uw_b6553p5 0.00 6553.500 FORMAT "%8.3"
 /begin AXIS_DESCR COM_AXIS EngStrt_tStrtCoor Temp_Cels 12 -273.140 3003.560 FORMAT "%8.3" EXTENDED_LIMITS -3549.940 3003.560 AXIS_PTS_REF EngStrt_tStrtAirPth_AX /end AXIS_DESCR
 /begin AXIS_DESCR COM_AXIS Epm_nEng10ms EngN 4 -16384.00 16383.50 FORMAT "%8.2" AXIS_PTS_REF EngStrt_nEngAirPth_AX /end AXIS_DESCR
/end CHARACTERISTIC
/begin CHARACTERISTIC MFAIRSTRT_COMWAITSTRTR.mfAirEth_GM " / Map air mass flow at start with max. ethanol rate" MAP 0x8057A4D0 RB_MapGroup_U16 6553.500 m_uw_b6553p5 0.00 6553.500 FORMAT "%8.3"
 /begin AXIS_DESCR COM_AXIS EngStrt_tStrtCoor Temp_Cels 12 -273.140 3003.560 FORMAT "%8.3" EXTENDED_LIMITS -3549.940 3003.560 AXIS_PTS_REF EngStrt_tStrtAirPth_AX /end AXIS_DESCR
 /begin AXIS_DESCR COM_AXIS Epm_nEng10ms EngN 4 -16384.00 16383.50 FORMAT "%8.2" AXIS_PTS_REF EngStrt_nEngAirPth_AX /end AXIS_DESCR
/end CHARACTERISTIC
/begin CHARACTERISTIC MFAIRSTRT_COMWAITSTRTR.mfAir_GM " / Map air mass flow at start" MAP 0x8057A530 RB_MapGroup_U16 6553.500 m_uw_b6553p5 0.00 6553.500 FORMAT "%8.3"
 /begin AXIS_DESCR COM_AXIS EngStrt_tStrtCoor Temp_Cels 12 -273.140 3003.560 FORMAT "%8.3" EXTENDED_LIMITS -3549.940 3003.560 AXIS_PTS_REF EngStrt_tStrtAirPth_AX /end AXIS_DESCR
 /begin AXIS_DESCR COM_AXIS Epm_nEng10ms EngN 4 -16384.00 16383.50 FORMAT "%8.2" AXIS_PTS_REF EngStrt_nEngAirPth_AX /end AXIS_DESCR
/end CHARACTERISTIC
/begin CHARACTERISTIC MFAIRSTRT_FOLW.mfAirAccrPed_GM " / Offset grouped map desired standardised over critical air mass flow requested by the driver" MAP 0x8057A594 RB_MapGroup_U16 6553.500 m_uw_b6553p5 0.00 6553.500 FORMAT "%8.3"
 /begin AXIS_DESCR COM_AXIS APP_r Prc 10 -400.0000 399.9878 FORMAT "%8.4" AXIS_PTS_REF EngStrt_rPedAirPth_AX /end AXIS_DESCR
 /begin AXIS_DESCR COM_AXIS Epm_nEng10ms EngN 4 -16384.00 16383.50 FORMAT "%8.2" AXIS_PTS_REF EngStrt_nEngAirPth_AX /end AXIS_DESCR
/end CHARACTERISTIC
/begin CHARACTERISTIC MFAIRSTRT_FOLW.mfAirBaseNrInj_GM " / Number of Injections" MAP 0x8057A5E4 RB_MapGroup_U16 6553.500 m_uw_b6553p5 0.00 6553.500 FORMAT "%8.3"
 /begin AXIS_DESCR COM_AXIS EngStrt_tStrtCoor Temp_Cels 12 -273.140 3003.560 FORMAT "%8.3" EXTENDED_LIMITS -3549.940 3003.560 AXIS_PTS_REF EngStrt_tStrtAirPth_AX /end AXIS_DESCR
 /begin AXIS_DESCR COM_AXIS EngStrt_nrInjAirPth OneToOne 8 0.00 255.0 FORMAT "%5.1" AXIS_PTS_REF EngStrt_nrInjAirPth_AX /end AXIS_DESCR
/end CHARACTERISTIC
/begin CHARACTERISTIC MFAIRSTRT_FOLW.mfAirCatHeatgEth_GM " / Map air mass flow at start during catalyst heating with max. ethanol rate" MAP 0x8057A6A4 RB_MapGroup_U16 6553.500 m_uw_b6553p5 0.00 6553.500 FORMAT "%8.3"
 /begin AXIS_DESCR COM_AXIS EngStrt_tStrtCoor Temp_Cels 12 -273.140 3003.560 FORMAT "%8.3" EXTENDED_LIMITS -3549.940 3003.560 AXIS_PTS_REF EngStrt_tStrtAirPth_AX /end AXIS_DESCR
 /begin AXIS_DESCR COM_AXIS Epm_nEng10ms EngN 4 -16384.00 16383.50 FORMAT "%8.2" AXIS_PTS_REF EngStrt_nEngAirPth_AX /end AXIS_DESCR
/end CHARACTERISTIC
/begin CHARACTERISTIC MFAIRSTRT_FOLW.mfAirCatHeatg_GM " / Map air mass flow at start during catalyst heating" MAP 0x8057A704 RB_MapGroup_U16 6553.500 m_uw_b6553p5 0.00 6553.500 FORMAT "%8.3"
 /begin AXIS_DESCR COM_AXIS EngStrt_tStrtCoor Temp_Cels 12 -273.140 3003.560 FORMAT "%8.3" EXTENDED_LIMITS -3549.940 3003.560 AXIS_PTS_REF EngStrt_tStrtAirPth_AX /end AXIS_DESCR
 /begin AXIS_DESCR COM_AXIS Epm_nEng10ms EngN 4 -16384.00 16383.50 FORMAT "%8.2" AXIS_PTS_REF EngStrt_nEngAirPth_AX /end AXIS_DESCR
/end CHARACTERISTIC
/begin CHARACTERISTIC MFAIRSTRT_FOLW.mfAirEth_GM " / Map air mass flow at start with max. ethanol rate" MAP 0x8057A764 RB_MapGroup_U16 6553.500 m_uw_b6553p5 0.00 6553.500 FORMAT "%8.3"
 /begin AXIS_DESCR COM_AXIS EngStrt_tStrtCoor Temp_Cels 12 -273.140 3003.560 FORMAT "%8.3" EXTENDED_LIMITS -3549.940 3003.560 AXIS_PTS_REF EngStrt_tStrtAirPth_AX /end AXIS_DESCR
 /begin AXIS_DESCR COM_AXIS Epm_nEng10ms EngN 4 -16384.00 16383.50 FORMAT "%8.2" AXIS_PTS_REF EngStrt_nEngAirPth_AX /end AXIS_DESCR
/end CHARACTERISTIC
/begin CHARACTERISTIC MFAIRSTRT_FOLW.mfAir_GM " / Map air mass flow at start" MAP 0x8057A7C4 RB_MapGroup_U16 6553.500 m_uw_b6553p5 0.00 6553.500 FORMAT "%8.3"
 /begin AXIS_DESCR COM_AXIS EngStrt_tStrtCoor Temp_Cels 12 -273.140 3003.560 FORMAT "%8.3" EXTENDED_LIMITS -3549.940 3003.560 AXIS_PTS_REF EngStrt_tStrtAirPth_AX /end AXIS_DESCR
 /begin AXIS_DESCR COM_AXIS Epm_nEng10ms EngN 4 -16384.00 16383.50 FORMAT "%8.2" AXIS_PTS_REF EngStrt_nEngAirPth_AX /end AXIS_DESCR
/end CHARACTERISTIC
/begin CHARACTERISTIC MFAIRWAIT_STRTR.mfAirWait_GM "Class instance for desired air mass flow between start request and start beginning / Grouped map Air mass flow between start request and start beginning" MAP 0x8057AAF8 RB_MapGroup_U16 6553.500 m_uw_b6553p5 0.00 6553.500 FORMAT "%8.3"
 /begin AXIS_DESCR COM_AXIS EngStrt_tStrtCoor Temp_Cels 12 -273.140 3003.560 FORMAT "%8.3" EXTENDED_LIMITS -3549.940 3003.560 AXIS_PTS_REF EngStrt_tStrtAirPth_AX /end AXIS_DESCR
 /begin AXIS_DESCR COM_AXIS Epm_nEng10ms EngN 4 -16384.00 16383.50 FORMAT "%8.2" AXIS_PTS_REF EngStrt_nEngAirPth_AX /end AXIS_DESCR
/end CHARACTERISTIC
/begin CHARACTERISTIC MoFClth_flgClthStrkFlt_C "Calibration to indicate clutch stroke error" VALUE 0x805920B4 Val_Wu8 1.00000000000 B_TRUE 0.00 1.00000000000 FORMAT "%13.11" /end CHARACTERISTIC
/begin CHARACTERISTIC MoFTrqPtd_cntrActvPostBldCfg_C "Number of debounce steps of error debounce due to an error in return of the active post-build configuration" VALUE 0x805920AE Val_Wu8 255.0 OneToOne 0.00 255.0 FORMAT "%5.1" /end CHARACTERISTIC
/begin CHARACTERISTIC MoFTrqPtd_cntrNegChkPostBldCfg_C "Number of debounce steps of error debounce due to an error in the negative check of the post-build configuration" VALUE 0x805920AF Val_Wu8 255.0 OneToOne 0.00 255.0 FORMAT "%5.1" /end CHARACTERISTIC
/begin CHARACTERISTIC MoFTrqPtd_cntrPosChkPostBldCfg_C "Number of debounce steps of error debounce due to an error in the positive check of the post-build configuration" VALUE 0x805920B0 Val_Wu8 255.0 OneToOne 0.00 255.0 FORMAT "%5.1" /end CHARACTERISTIC
/begin CHARACTERISTIC MoFTrqPtd_cntrRstPostBldSel_C "Number of software resets from MoFVar_PostBldSel before request of an error reaction" VALUE 0x805920B1 Val_Wu8 255.0 OneToOne 0.00 255.0 FORMAT "%5.1" /end CHARACTERISTIC
/begin CHARACTERISTIC MoFTrqPtd_cntrStabyChkPostBldCfg_C "Number of debounce steps of error debounce due to changed post-build configuration during driving cycle" VALUE 0x805920B2 Val_Wu8 255.0 OneToOne 0.00 255.0 FORMAT "%5.1" /end CHARACTERISTIC
/begin CHARACTERISTIC MoFTrqPtd_cntrTestPostBldSel_C "Debounce steps for setting the testflag in post-build selectable diagnosis in function monitoring" VALUE 0x805962D0 Val_Wu8 255.0 OneToOne 0.00 255.0 FORMAT "%5.1" /end CHARACTERISTIC
/begin CHARACTERISTIC MoFTrqPtd_nEngRlsStrtThdMax_C "Maximum engine speed threshold to select maximum permitted torque during engine start" VALUE 0x80592024 Val_Wu8 10200. nmot_q40 0.00 10200. FORMAT "%5.0" /end CHARACTERISTIC
/begin CHARACTERISTIC MoFTrqPtd_nEngRlsStrtThdMin_C "Engine speed threshold for releasing start" VALUE 0x80592025 Val_Wu8 10200. nmot_q40 0.00 10200. FORMAT "%5.0" /end CHARACTERISTIC
/begin CHARACTERISTIC MoFTrqPtd_rBltDrv_C "belt ratio" VALUE 0x80595EA6 Val_Wu16 655.3400 fak_q0p01 0.0100 655.3500 FORMAT "%8.4" EXTENDED_LIMITS 0.00 655.3500 /end CHARACTERISTIC
/begin CHARACTERISTIC MoFTrqPtd_rTrqPtdOffs_M "Offset for the filtered permissible inner torque in function monitoring" MAP 0x80592056 Map_Xu8Yu8Wu8 99.61 rel_q0p39 0.00 99.61 FORMAT "%5.2"
 /begin AXIS_DESCR STD_AXIS MoFESpd_nEng nmot_q40 8 0.00 10200. FORMAT "%5.0" DEPOSIT ABSOLUTE /end AXIS_DESCR
 /begin AXIS_DESCR STD_AXIS MoFTrqPtd_rTrqPtdFltWoOffs rel_q0p39 8 0.00 99.61 FORMAT "%5.2" DEPOSIT ABSOLUTE /end AXIS_DESCR
/end CHARACTERISTIC
/begin CHARACTERISTIC MoFTrqPtd_stSwtPbsChk_C "Switch for activation of the post-build selectable monitoring in the function monitoring" VALUE 0x805920B3 Val_Wu8 255.0 OneToOne 0.00 255.0 FORMAT "%5.1" /end CHARACTERISTIC
/begin CHARACTERISTIC MoFTrqPtd_stTqCtrldOperMod_C "Torque Controlled operating mode" VALUE 0x80592026 Val_Wu8 255.0 OneToOne 0.00 255.0 FORMAT "%5.1" /end CHARACTERISTIC
/begin CHARACTERISTIC MoFTrqPtd_stVoltCtrldOperMod_C "Voltage Controlled operating mode" VALUE 0x80592027 Val_Wu8 255.0 OneToOne 0.00 255.0 FORMAT "%5.1" /end CHARACTERISTIC
/begin CHARACTERISTIC MoFTrqPtd_tiDebComErrElDrvThd_C "Time threshold for detecting E-Drive communication error" VALUE 0x80592028 Val_Wu8 2.550 t_q0p01 0.00 2.550 FORMAT "%5.3" /end CHARACTERISTIC
/begin CHARACTERISTIC MoFTrqPtd_tiDebIrrvCmpErr_C "debounce time threshold, after irreversible torque comparision error was detected" VALUE 0x80592029 Val_Wu8 2.550 t_q0p01 0.00 2.550 FORMAT "%5.3" /end CHARACTERISTIC
/begin CHARACTERISTIC MoFTrqPtd_tiDebIrvErrElDrvThd_C "Time threshold for detecting E-Drive failure error" VALUE 0x8059202A Val_Wu8 2.550 t_q0p01 0.00 2.550 FORMAT "%5.3" /end CHARACTERISTIC
/begin CHARACTERISTIC MoFTrqPtd_tiDlyPtdEngArysize_C "Size of array for deathtime functionality of filter" VALUE 0x805920A8 Val_Wu8 31.00 OneToOne 1.00 32.00 FORMAT "%5.2" EXTENDED_LIMITS 0.00 255.0 /end CHARACTERISTIC
/begin CHARACTERISTIC MoFTrqPtd_tiDlyPtdTqEng_C "Delay time for negative gradient in the permitted engine torque" VALUE 0x805920A9 Val_Wu8 0.3100 t10msxs_ub_q0p01 0.0100 0.3200 EXTENDED_LIMITS 0.00 2.550 /end CHARACTERISTIC
/begin CHARACTERISTIC MoFTrqPtd_tiDlyTqPtdMaxArysize_C "Size of array for deathtime functionality of filter" VALUE 0x805920AA Val_Wu8 31.00 OneToOne 1.00 32.00 FORMAT "%5.2" EXTENDED_LIMITS 0.00 255.0 /end CHARACTERISTIC
/begin CHARACTERISTIC MoFTrqPtd_tiDlyTqPtdMax_C "deadtime of permitted Maximum-Sum-torque" VALUE 0x805920AB Val_Wu8 0.3100 t10msxs_ub_q0p01 0.0100 0.3200 EXTENDED_LIMITS 0.00 2.550 /end CHARACTERISTIC
/begin CHARACTERISTIC MoFTrqPtd_tiFilDlyTqPtdMin_C "Deadtime for permitted minimum torque filtering" VALUE 0x805920AC Val_Wu8 0.2800 t40msxs_ub_q0p04 0.0400 0.3200 EXTENDED_LIMITS 0.00 10.20 /end CHARACTERISTIC
/begin CHARACTERISTIC MoFTrqPtd_tiFiltgTqPtdEng_C "PT1 filter constant to filter negative gradient of the permitted inner combustion engine torque" VALUE 0x80595F16 Val_Wu16 655.34000000 zk10msxs_uw_b655p36PT1 0.01000000 655.35000000 FORMAT "%12.8" EXTENDED_LIMITS 0.000000152590219 655.35000000 /end CHARACTERISTIC
/begin CHARACTERISTIC MoFTrqPtd_tiFiltgTqPtdMax_C "PT1 filter time constant for the falling edges of the permitted sum torque" VALUE 0x80595F18 Val_Wu16 655.34000000 zk10msxs_uw_b655p36PT1 0.01000000 655.35000000 FORMAT "%12.8" EXTENDED_LIMITS 0.000000152590219 655.35000000 /end CHARACTERISTIC
/begin CHARACTERISTIC MoFTrqPtd_tiFiltgTqPtdMin_C "PT1 filter time constant for the rising edges of the permitted minimum torque" VALUE 0x80595FBE Val_Wu16 2621.3600000 zk40msxs_uw_b2621p44PT1 0.0400000 2621.4000000 FORMAT "%12.7" EXTENDED_LIMITS 0.000000610360876 2621.4000000 /end CHARACTERISTIC
/begin CHARACTERISTIC MoFTrqPtd_tqCkrsftStrtMaxEm_T "Engine speed dependent curve to adjust permitted maximum e-machine torque during engine start" CURVE 0x80595EA8 Mo_DataCurveSstS16WS16 6553.500 md_q0p1 -3276.800 3276.700 FORMAT "%8.3"
 /begin AXIS_DESCR STD_AXIS MoFESpd_nEng nmot_q40 6 0.00 10200.00 FORMAT "%8.2" EXTENDED_LIMITS -1310720. 1310680. DEPOSIT ABSOLUTE /end AXIS_DESCR
/end CHARACTERISTIC
/begin CHARACTERISTIC MoFTrqPtd_tqCrksftEmMinOffs_M "permitted engine speed dependent offset for minimum e-machine torque" MAP 0x80595FC0 Map_Xs16Ys16Ws16 6553.500 md_q0p1 -3276.800 3276.700 FORMAT "%8.3"
 /begin AXIS_DESCR STD_AXIS MoFTrqPtd_tqCrksftEmMinFild md_q0p1 8 -3276.800 3276.700 FORMAT "%8.3" DEPOSIT ABSOLUTE /end AXIS_DESCR
 /begin AXIS_DESCR STD_AXIS MoFESpd_nEng nmot_q40 8 0.00 10200.00 FORMAT "%8.2" EXTENDED_LIMITS -1310720. 1310680. DEPOSIT ABSOLUTE /end AXIS_DESCR
/end CHARACTERISTIC
/begin CHARACTERISTIC MoFTrqPtd_tqCrsMaxEM_T "Max. permitted torque: electrical drive at crankshaft level" CURVE 0x80595EC2 Mo_DataCurveSstS16WS16 6553.500 md_q0p1 -3276.800 3276.700 FORMAT "%8.3"
 /begin AXIS_DESCR STD_AXIS MoFESpd_nEng nmot_q40 10 0.00 10200.00 FORMAT "%8.2" EXTENDED_LIMITS -1310720. 1310680. DEPOSIT ABSOLUTE /end AXIS_DESCR
/end CHARACTERISTIC
/begin CHARACTERISTIC MoFTrqPtd_tqCrsMinEM_T "Min. permitted torque: electrical drive at crankshaft level" CURVE 0x80595EEC Mo_DataCurveSstS16WS16 6553.500 md_q0p1 -3276.800 3276.700 FORMAT "%8.3"
 /begin AXIS_DESCR STD_AXIS MoFESpd_nEng nmot_q40 10 0.00 10200.00 FORMAT "%8.2" EXTENDED_LIMITS -1310720. 1310680. DEPOSIT ABSOLUTE /end AXIS_DESCR
/end CHARACTERISTIC
/begin CHARACTERISTIC MoFTrqPtd_tqMaxEmOffs_T "Offset-factor-curve for maximum permitted E-Machine torque limit" CURVE 0x8059202B Mo_DataCurveSstU8WU8 12.70 md_q0p1 0.00 12.70 FORMAT "%5.2" EXTENDED_LIMITS 0.00 25.50
 /begin AXIS_DESCR STD_AXIS MoFESpd_nEng nmot_q40 10 0.00 10200. FORMAT "%5.0" DEPOSIT ABSOLUTE /end AXIS_DESCR
/end CHARACTERISTIC
/begin CHARACTERISTIC MoFTrqPtd_tqMinEmOffs_T "Offset-factor-curve for minimum permitted E-Machine torque limit" CURVE 0x80592040 Mo_DataCurveSstU8WU8 12.70 md_q0p1 0.00 12.70 FORMAT "%5.2" EXTENDED_LIMITS 0.00 25.50
 /begin AXIS_DESCR STD_AXIS MoFESpd_nEng nmot_q40 10 0.00 10200. FORMAT "%5.0" DEPOSIT ABSOLUTE /end AXIS_DESCR
/end CHARACTERISTIC
/begin CHARACTERISTIC MoFTrqPtd_tqOffsReslEmTq_C "robustness offset factor to consider resolution losses for calculation of E-Machine torque" VALUE 0x80592055 Val_Wu8 12.70 md_q0p1 0.00 12.70 FORMAT "%5.2" EXTENDED_LIMITS 0.00 25.50 /end CHARACTERISTIC
/begin CHARACTERISTIC MoFTrqPtd_tqSumPtdOffs_M "Offset-map for calculation of permitted Sum-torque" MAP 0x80595F1A Map_Xs16Ys16Ws16 6553.500 md_q0p1 -3276.800 3276.700 FORMAT "%8.3"
 /begin AXIS_DESCR STD_AXIS MoFTrqPtd_tqCluSumPtdFild md_q0p1 8 -3276.800 3276.700 FORMAT "%8.3" DEPOSIT ABSOLUTE /end AXIS_DESCR
 /begin AXIS_DESCR STD_AXIS MoFESpd_nEng nmot_q40 8 0.00 10200.00 FORMAT "%8.2" EXTENDED_LIMITS -1310720. 1310680. DEPOSIT ABSOLUTE /end AXIS_DESCR
/end CHARACTERISTIC
/begin CHARACTERISTIC MoFTrqRat_rTqPTMax_C "max. permitted PT transmission ratio in function monitoring" VALUE 0x80596064 Val_Wu16 655.3500 fak_q0p01 0.00 655.3500 FORMAT "%8.4" /end CHARACTERISTIC
/begin CHARACTERISTIC MoFTrqRat_rTqPTMin_C "min. permitted PT transmission ratio in function monitoring" VALUE 0x80596066 Val_Wu16 655.3500 fak_q0p01 0.00 655.3500 FORMAT "%8.4" /end CHARACTERISTIC
/begin CHARACTERISTIC MoF_stStrtStopEnaMsg_C "Calibration for MoF_stStrtStopEnaMsg" VALUE 0x805920B5 Val_Wu8 255.0 OneToOne 0.00 255.0 FORMAT "%5.1" /end CHARACTERISTIC
/begin CHARACTERISTIC MoF_stVar_C "parameter for variant coding" VALUE 0x805920AD Val_Wu8 255.0 dez 0.00 255.0 FORMAT "%5.1" /end CHARACTERISTIC
/begin CHARACTERISTIC MoXEMM_nrHwLTErrSimn_C "Test calibration parameter for simulation of Hardware Logic test errors for diagnosis purposes" VALUE 0x8057C70C RB_Val_Wu16 65535.0000000 MoXEMM_HwLTErrorSimnCode_VERB 0.00 65535.0000000 FORMAT "%13.7" /end CHARACTERISTIC
/begin CHARACTERISTIC MoXEMM_nrSmuAlmErrSimn_C "Test calibration parameter for simulation of SMU alarm errors for diagnosis purposes" VALUE 0x8057C70E RB_Val_Wu16 65535.0000000 MoXEMM_SMUErrorSimnCode_VERB 0.00 65535.0000000 FORMAT "%13.7" /end CHARACTERISTIC
/begin CHARACTERISTIC MoXSyncLos_nEngSyncMin_C "speed threshold for activation of detection of loss of synchronization in extended monitoring" VALUE 0x8057C710 RB_Val_Ws16 32767.50 EngN -16384.00 16383.50 FORMAT "%8.2" /end CHARACTERISTIC
/begin CHARACTERISTIC MoXTrqPtd_cntrDebErrMaxDisblTqEmThd_C "Error tolerance threshold to set the e-machine maximum torque limit to 0 Nm in case of pending maximum sum torque comparison error" VALUE 0x805962D2 Val_Wu8 255.0 OneToOne 0.00 255.0 FORMAT "%5.1" /end CHARACTERISTIC
/begin CHARACTERISTIC MoXTrqPtd_cntrDebErrMaxRedTqEmThd_C "Error tolerance threshold to set the e-machine maximum torque limit to 0 Nm in case of pending maximum sum torque comparison error" VALUE 0x805962D3 Val_Wu8 255.0 OneToOne 0.00 255.0 FORMAT "%5.1" /end CHARACTERISTIC
/begin CHARACTERISTIC MoXTrqPtd_cntrDebErrMinRedTqEmThd_C "Error tolerance threshold to reduce the minimum e-machine torque in case of pending minimum torque comparison error" VALUE 0x805962D4 Val_Wu8 255.0 OneToOne 0.00 255.0 FORMAT "%5.1" /end CHARACTERISTIC
/begin CHARACTERISTIC MoXTrqPtd_cntrDebErrTqMaxEmThd_C "Error tolerance threshold to reduce the maximum e-machine torque in case of maximum e-machine torque comparison error in extended function monitoring" VALUE 0x805962D5 Val_Wu8 255.0 OneToOne 0.00 255.0 FORMAT "%5.1" /end CHARACTERISTIC
/begin CHARACTERISTIC MoXTrqPtd_tiDlyFiltgTqEm_C "Delay time constant for permitted e-machine torque" VALUE 0x805962D6 Val_Wu8 80.00 Time_ms 0.00 80.00 FORMAT "%5.2" EXTENDED_LIMITS 0.00 2550. /end CHARACTERISTIC
/begin CHARACTERISTIC MoXTrqPtd_tiOffDlyErrMaxRedTqEm_C "Turn off delay for e-machine maximum torque limitation in case of maximum sum torque comparison error" VALUE 0x805962D7 Val_Wu8 2.550 t_q0p01 0.00 2.550 FORMAT "%5.3" /end CHARACTERISTIC
/begin CHARACTERISTIC MoXTrqPtd_tiOffDlyErrMinThd_C "Turn off delay for minimum torque limitation in case of minimum torque comparison error" VALUE 0x805962D8 Val_Wu8 2.550 t_q0p01 0.00 2.550 FORMAT "%5.3" /end CHARACTERISTIC
/begin CHARACTERISTIC MoXTrqPtd_tiOffDlyErrTqMaxEm_C "Turn off delay for e-machine maximum torque limitation in case of maximum e-machine torque comparison error" VALUE 0x805962D9 Val_Wu8 2.550 t_q0p01 0.00 2.550 FORMAT "%5.3" /end CHARACTERISTIC
/begin CHARACTERISTIC MoXTrqPtd_tiPT1FiltgTqEm_C "PT1 filter time constant for permitted e-machine torque" VALUE 0x805962DC Val_Ws32 4294967.3 TimeDelay_ms 0.0 4294967.3 FORMAT "%12.1" /end CHARACTERISTIC
/begin CHARACTERISTIC MoXTrqPtd_tqCrksftAltTqMax_T "Engine speed dependent curve to adjust typical alternator torque (1-3 KW)" CURVE 0x805962E2 Mo_DataCurveSstS16WS16 6553.500 md_q0p1 -3276.800 3276.700 FORMAT "%8.3"
 /begin AXIS_DESCR STD_AXIS Epm_nEng EngN 8 -16384.00 16383.50 FORMAT "%8.2" DEPOSIT ABSOLUTE /end AXIS_DESCR
/end CHARACTERISTIC
/begin CHARACTERISTIC MoXTrqPtd_tqCrksftEmOffs_T "Engine speed dependent curve to adjust permitted maximum e-machine permitted torque" CURVE 0x80596304 Mo_DataCurveSstS16WS16 3276.700 md_q0p1 0.00 3276.700 FORMAT "%8.3" EXTENDED_LIMITS -3276.800 3276.700
 /begin AXIS_DESCR STD_AXIS Epm_nEng EngN 8 -16384.00 16383.50 FORMAT "%8.2" DEPOSIT ABSOLUTE /end AXIS_DESCR
/end CHARACTERISTIC
/begin CHARACTERISTIC MoXTrqPtd_tqCrksftEmRedOffs_T "Engine speed dependent offset to adjust maximum permitted e-machine torque limit" CURVE 0x80596326 Mo_DataCurveSstS16WS16 3276.700 md_q0p1 0.00 3276.700 FORMAT "%8.3" EXTENDED_LIMITS -3276.800 3276.700
 /begin AXIS_DESCR STD_AXIS Epm_nEng EngN 8 -16384.00 16383.50 FORMAT "%8.2" DEPOSIT ABSOLUTE /end AXIS_DESCR
/end CHARACTERISTIC
/begin CHARACTERISTIC MoXTrqPtd_tqCrksftRedEmOffs_C "Offset to adjust maximum permitted e-machine torque limit" VALUE 0x80596348 Val_Wu16 3276.700 md_q0p1 0.00 3276.700 FORMAT "%8.3" EXTENDED_LIMITS 0.00 6553.500 /end CHARACTERISTIC
/begin CHARACTERISTIC Mo_cwMstSlave_C "Codeword master-slave configuration in function monitoring" VALUE 0x805920B6 Val_Wu8 255.0 OneToOne 0.00 255.0 FORMAT "%5.1" /end CHARACTERISTIC
/begin CHARACTERISTIC Mo_stSwtHyb_C "code word for hybrid vehicle in the function monitoring" VALUE 0x805920B7 Val_Wu8 255.0 OneToOne 0.00 255.0 FORMAT "%5.1" /end CHARACTERISTIC
/begin CHARACTERISTIC Mo_swtClrCntrMax_C "Condition reset drag counter in function monitoring" VALUE 0x805962DA Val_Wu8 255.0 OneToOne 0.00 255.0 FORMAT "%5.1" /end CHARACTERISTIC
/begin CHARACTERISTIC Mo_swtCyclCalUpdt_C "Switch to update level 2 calibration messages for level 1" VALUE 0x805920B8 Val_Wu8 255.0 OneToOne 0.00 255.0 FORMAT "%5.1" /end CHARACTERISTIC
/begin CHARACTERISTIC Mo_trqIdcMax_C "Maximum of inner engine torque from ECU monitoring package." VALUE 0x80596068 Val_Ws16 3276.600 md_q0p1 0.100 3276.700 FORMAT "%8.3" EXTENDED_LIMITS -3276.800 3276.700 /end CHARACTERISTIC
/begin CHARACTERISTIC MRly_VD_BattuMax_C "Maximum Valid Battery voltage" VALUE 0x80579DA4 RB_Val_Ws16 65.53500 spg_q0p001 -32.76800 32.76700 FORMAT "%8.5" /end CHARACTERISTIC
/begin CHARACTERISTIC MRly_VD_BattuMin_C "Minimum Valid Battery voltage check" VALUE 0x80579DA6 RB_Val_Ws16 65.53500 spg_q0p001 -32.76800 32.76700 FORMAT "%8.5" /end CHARACTERISTIC
/begin CHARACTERISTIC MRly_VD_SCB_OL_Plaus_Enable_C "Plausibility Enable check between SCB and OL" VALUE 0x80579DA8 RB_Val_Wboolean 1.00000000000 B_TRUE 0.00 1.00000000000 FORMAT "%13.11" /end CHARACTERISTIC
/begin CHARACTERISTIC MRly_VD_SCB_OL_Plaus_Threshold_C "SCB and OL Plausibility Threshold" VALUE 0x80579DA9 RB_Val_Wu8 255.0 OneToOne 0.00 255.0 FORMAT "%5.1" /end CHARACTERISTIC
/begin CHARACTERISTIC MSUDKSNLN "desired standardised over critical air mass flow at KL15 off" CURVE 0x8057A010 RB_Curve_S16_U16_Static 6553.500 m_uw_b6553p5 0.00 6553.500 FORMAT "%8.3"
 /begin AXIS_DESCR STD_AXIS Epm_nEng10ms EngN 8 -16384.00 16383.50 FORMAT "%8.2" DEPOSIT ABSOLUTE /end AXIS_DESCR
/end CHARACTERISTIC
/begin CHARACTERISTIC NWDKSSTKL "curve threshold for deactivation desired throttle position without torque structur" CURVE 0x8057A032 RB_Curve_S16_S16 32767.50 EngN -16384.00 16383.50 FORMAT "%8.2"
 /begin AXIS_DESCR STD_AXIS EngStrt_tStrtCoor Temp_Cels 6 -273.140 3003.560 FORMAT "%8.3" EXTENDED_LIMITS -3549.940 3003.560 DEPOSIT ABSOLUTE /end AXIS_DESCR
/end CHARACTERISTIC
/begin CHARACTERISTIC TIFACAIRPTHTRANCON_BASE.tiFacAirPthTran_C "class filter time parameter / parameter filter time" VALUE 0x8057AB5C RB_Val_Wu16 655.3400 t_q0p01 0.0100 655.3500 FORMAT "%8.4" EXTENDED_LIMITS 0.00 655.3500 /end CHARACTERISTIC
/begin CHARACTERISTIC TIFACAIRPTHTRANCON_FOLW.tiFacAirPthTran_C " / parameter filter time" VALUE 0x8057A828 RB_Val_Wu16 655.3400 t_q0p01 0.0100 655.3500 FORMAT "%8.4" EXTENDED_LIMITS 0.00 655.3500 /end CHARACTERISTIC
/begin CHARACTERISTIC TIFACAIRPTHTRAN_BASE.tiFacAirPthTranCatHeatg_GT "class filter time table / table filter time cat heating" CURVE 0x8057AB64 RB_CurveGroup_U16 655.3400 t_q0p01 0.0100 655.3500 FORMAT "%8.4" EXTENDED_LIMITS 0.00 655.3500
 /begin AXIS_DESCR COM_AXIS EngStrt_tStrtCoor Temp_Cels 12 -273.140 3003.560 FORMAT "%8.3" EXTENDED_LIMITS -3549.940 3003.560 AXIS_PTS_REF EngStrt_tStrtAirPth_AX /end AXIS_DESCR
/end CHARACTERISTIC
/begin CHARACTERISTIC TIFACAIRPTHTRAN_BASE.tiFacAirPthTran_GT "class filter time table / table filter time" CURVE 0x8057AB7C RB_CurveGroup_U16 655.3400 t_q0p01 0.0100 655.3500 FORMAT "%8.4" EXTENDED_LIMITS 0.00 655.3500
 /begin AXIS_DESCR COM_AXIS EngStrt_tStrtCoor Temp_Cels 12 -273.140 3003.560 FORMAT "%8.3" EXTENDED_LIMITS -3549.940 3003.560 AXIS_PTS_REF EngStrt_tStrtAirPth_AX /end AXIS_DESCR
/end CHARACTERISTIC
/begin CHARACTERISTIC TIFACAIRPTHTRAN_FOLW.tiFacAirPthTranCatHeatg_GT " / table filter time cat heating" CURVE 0x8057A830 RB_CurveGroup_U16 655.3400 t_q0p01 0.0100 655.3500 FORMAT "%8.4" EXTENDED_LIMITS 0.00 655.3500
 /begin AXIS_DESCR COM_AXIS EngStrt_tStrtCoor Temp_Cels 12 -273.140 3003.560 FORMAT "%8.3" EXTENDED_LIMITS -3549.940 3003.560 AXIS_PTS_REF EngStrt_tStrtAirPth_AX /end AXIS_DESCR
/end CHARACTERISTIC
/begin CHARACTERISTIC TIFACAIRPTHTRAN_FOLW.tiFacAirPthTran_GT " / table filter time" CURVE 0x8057A848 RB_CurveGroup_U16 655.3400 t_q0p01 0.0100 655.3500 FORMAT "%8.4" EXTENDED_LIMITS 0.00 655.3500
 /begin AXIS_DESCR COM_AXIS EngStrt_tStrtCoor Temp_Cels 12 -273.140 3003.560 FORMAT "%8.3" EXTENDED_LIMITS -3549.940 3003.560 AXIS_PTS_REF EngStrt_tStrtAirPth_AX /end AXIS_DESCR
/end CHARACTERISTIC
/begin CHARACTERISTIC TWDKSNSTKL "curve time constant for filtering of reference throttle blade position" CURVE 0x8057A04C RB_Curve_S16_U16_Static 655.3400 t10msxs_uw_b655p35 0.0100 655.3500 FORMAT "%8.4" EXTENDED_LIMITS 0.00 655.3500
 /begin AXIS_DESCR STD_AXIS EngStrt_tStrtCoor Temp_Cels 6 -273.140 3003.560 FORMAT "%8.3" EXTENDED_LIMITS -3549.940 3003.560 DEPOSIT ABSOLUTE /end AXIS_DESCR
/end CHARACTERISTIC
/begin MEASUREMENT B_deseehr_mrly_vld_msg "Valid Voltage check" UBYTE OneToOne 1 100 0.00 255.0 BIT_MASK 0x1 FORMAT "%5.1" ECU_ADDRESS 0x6001001E /end MEASUREMENT
/begin MEASUREMENT B_hr_msg "condition main relay on" UBYTE B_TRUE 1 100 0.00 1.00000000000 BIT_MASK 0x1 FORMAT "%13.11" ECU_ADDRESS 0x6000020E /end MEASUREMENT
/begin MEASUREMENT B_msudksom_msg "desired standardised critical air mass flow without torque structure active" UBYTE B_TRUE 1 100 0.00 1.00000000000 BIT_MASK 0x1 FORMAT "%13.11" ECU_ADDRESS 0x6000FA87 /end MEASUREMENT
/begin MEASUREMENT B_munst_msg "Condition allow intervention of torque monitoring" UBYTE B_TRUE 1 100 0.00 1.00000000000 BIT_MASK 0x1 FORMAT "%13.11" ECU_ADDRESS 0x6000FA86 /end MEASUREMENT
/begin MEASUREMENT B_tfwdksom_msg "time constant to filter desired throttle angle without torque structure active" UBYTE B_TRUE 1 100 0.00 1.00000000000 BIT_MASK 0x1 FORMAT "%13.11" ECU_ADDRESS 0x6000FA5F /end MEASUREMENT
/begin MEASUREMENT EngStrt_ctMSUDKSOMDrvEntr10ms "Local variable to store the global drive enter counter(SyC_ctDrvEnter)" UBYTE OneToOne 1 100 0.00 255.0 FORMAT "%5.1" ECU_ADDRESS 0x6000B6AC /end MEASUREMENT
/begin MEASUREMENT EngStrt_flgAccrPed "accelerator pedal pressed during start" UBYTE B_TRUE 1 100 0.00 1.00000000000 BIT_MASK 0x1 FORMAT "%13.11" ECU_ADDRESS 0x6000B6AB /end MEASUREMENT
/begin MEASUREMENT EngStrt_flgAirPthStrtRst "reset of air path at start" UBYTE B_TRUE 1 100 0.00 1.00000000000 BIT_MASK 0x1 FORMAT "%13.11" ECU_ADDRESS 0x6000B6AA /end MEASUREMENT
/begin MEASUREMENT EngStrt_flgEngShutDown "engine is shut down" UBYTE B_TRUE 1 100 0.00 1.00000000000 BIT_MASK 0x1 FORMAT "%13.11" ECU_ADDRESS 0x6000B6A9 /end MEASUREMENT
/begin MEASUREMENT EngStrt_flgEngShutDownDlyd "engine is shut down (with delay until next Proc EngReStrt)" UBYTE B_TRUE 1 100 0.00 1.00000000000 BIT_MASK 0x1 FORMAT "%13.11" ECU_ADDRESS 0x6000F985 /end MEASUREMENT
/begin MEASUREMENT EngStrt_flgInhbnCtrlVapLockLoc "Inhibition of the Controlled Vapor Lock Conition" UBYTE B_TRUE 1 100 0.00 1.00000000000 BIT_MASK 0x1 FORMAT "%13.11" ECU_ADDRESS 0x6000B6A8 /end MEASUREMENT
/begin MEASUREMENT EngStrt_flgTqActv "torque intervention during start" UBYTE B_TRUE 1 100 0.00 1.00000000000 BIT_MASK 0x1 FORMAT "%13.11" ECU_ADDRESS 0x6000B6A7 /end MEASUREMENT
/begin MEASUREMENT EngStrt_mAirOfsVapSuspc "Additional Air Mass Offset during Vapor Lock Suspension" UWORD m_uw_b6553p5 1 100 0.00 6553.500 FORMAT "%8.3" ECU_ADDRESS 0x60007258 /end MEASUREMENT
/begin MEASUREMENT EngStrt_mfAirAccrPed "correction desired standardised over critical air mass flow pedal value" UWORD m_uw_b6553p5 1 100 0.00 6553.500 FORMAT "%8.3" ECU_ADDRESS 0x7000528E /end MEASUREMENT
/begin MEASUREMENT EngStrt_nrInjAirPth "local variable injection counter for the air path at start" UBYTE OneToOne 1 100 0.00 255.0 FORMAT "%5.1" ECU_ADDRESS 0x7000545A /end MEASUREMENT
/begin MEASUREMENT EngStrt_tiSnceStrt "time since engine start" UWORD t_q0p01 1 100 0.00 655.3500 FORMAT "%8.4" ECU_ADDRESS 0x70005292 /end MEASUREMENT
/begin MEASUREMENT MFAIRSTRT_BASE.mfAir "Class instance for desired air mass flow at start / air mass flow at start" UWORD m_uw_b6553p5 1 100 0.00 6553.500 FORMAT "%8.3" ECU_ADDRESS 0x60013D7C /end MEASUREMENT
/begin MEASUREMENT MFAIRSTRT_COM.mfAir " / air mass flow at start" UWORD m_uw_b6553p5 1 100 0.00 6553.500 FORMAT "%8.3" ECU_ADDRESS 0x60007254 /end MEASUREMENT
/begin MEASUREMENT MFAIRSTRT_COMWAITSTRTR.mfAir " / air mass flow at start" UWORD m_uw_b6553p5 1 100 0.00 6553.500 FORMAT "%8.3" ECU_ADDRESS 0x60007250 /end MEASUREMENT
/begin MEASUREMENT MFAIRSTRT_FOLW.mfAir " / air mass flow at start" UWORD m_uw_b6553p5 1 100 0.00 6553.500 FORMAT "%8.3" ECU_ADDRESS 0x6000724C /end MEASUREMENT
/begin MEASUREMENT MFAIRWAIT_STRTR.mfAirWait "Class instance for desired air mass flow between start request and start beginning / Air mass flow between start request and start beginning" UWORD m_uw_b6553p5 1 100 0.00 6553.500 FORMAT "%8.3" ECU_ADDRESS 0x60007246 /end MEASUREMENT
/begin MEASUREMENT MoCMem_vblStructCpl_Core1_10ms_Nr1.MoCMem_ctDebErrChkRAMOld "Instance for specific core and task / Old value of counter how often the threshold for MaxValueIndicator for double storage and cyclic RAM-Test is exeeded" UBYTE OneToOne 1 100 0.00 255.0 FORMAT "%5.1" ECU_ADDRESS 0x6001865C /end MEASUREMENT
/begin MEASUREMENT MoCMem_vblStructCpl_Core1_10ms_Nr1.MoCMem_ctDebErrChkRAMCpl "Instance for specific core and task / RAM data redundancy for MoCMem_ctDebErrChkRAM" UBYTE OneToOne 1 100 0.00 255.0 FORMAT "%5.1" ECU_ADDRESS 0x6001865D /end MEASUREMENT
/begin MEASUREMENT MoCMem_vblStructCpl_Core1_10ms_Nr1.MoCMem_ctDebHealChkRAMCpl "Instance for specific core and task / complement of the error healing counter for double storage and cyclical RAM-test" UWORD OneToOne 1 100 0.00 65535.00 FORMAT "%8.2" ECU_ADDRESS 0x6001865E /end MEASUREMENT
/begin MEASUREMENT MoCMem_vblStructCpl_Core1_10ms_Nr1.MoCMem_nrRamChkCpl "Instance for specific core and task / complement of the number of words to be tested on the cyclic RAM check" UWORD OneToOne 1 100 0.00 65535.00 FORMAT "%8.2" ECU_ADDRESS 0x60018660 /end MEASUREMENT
/begin MEASUREMENT MoCMem_vblStructCpl_Core1_10ms_Nr1.MoCMem_nrStckChkCpl "Instance for specific core and task / Complement of the number of bytes to be checked on each call of the cyclic stack check" ULONG OneToOne 1 100 0.00 4294967295.00 FORMAT "%13.2" ECU_ADDRESS 0x60018664 /end MEASUREMENT
/begin MEASUREMENT MoCMem_vblStructCpl_Core1_10ms_Nr1.MoCMem_nrCSAChkCpl "Instance for specific core and task / Complement of the number of bytes to be checked on each call of the cyclic CSA check" ULONG OneToOne 1 100 0.00 4294967295.00 FORMAT "%13.2" ECU_ADDRESS 0x60018668 /end MEASUREMENT
/begin MEASUREMENT MoCMem_vblStructCpl_Core1_10ms_Nr1.MoCMem_RamOffsetPtrCpl "Instance for specific core and task / duplicate storage of MoCMem_RamOffsetPtr" ULONG OneToOne 1 100 0.00 4294967295.00 FORMAT "%13.2" ECU_ADDRESS 0x6001866C /end MEASUREMENT
/begin MEASUREMENT MoCMem_vblStructCpl_Core1_10ms_Nr1.MoCMem_CSAOffsetPtrCpl "Instance for specific core and task / Complement of CSA start address of the current CSA cyclic check complements" ULONG OneToOne 1 100 0.00 4294967295.00 FORMAT "%13.2" ECU_ADDRESS 0x60018674 /end MEASUREMENT
/begin MEASUREMENT MoCMem_vblStructCpl_Core1_10ms_Nr1.MoCMem_StckOffsetPtrCpl "Instance for specific core and task / Complement of the stack start address of the current stck cyclic check" ULONG OneToOne 1 100 0.00 4294967295.00 FORMAT "%13.2" ECU_ADDRESS 0x60018670 /end MEASUREMENT
/begin MEASUREMENT MoCMem_vblStructCpl_Core1_10ms_Nr1.Mo_RamCyclicCheckCpl "Instance for specific core and task / not used" ULONG OneToOne 1 100 0.00 4294967295.00 FORMAT "%13.2" ECU_ADDRESS 0x60018678 /end MEASUREMENT
/begin MEASUREMENT MoCMem_vblStructCpl_Core1_10ms_Nr1.MoCMem_ctLrnRAMCpl "Instance for specific core and task / Complement of the counter for the learn process of the RAM check" UBYTE OneToOne 1 100 0.00 255.0 FORMAT "%5.1" ECU_ADDRESS 0x6001867C /end MEASUREMENT
/begin MEASUREMENT MoCMem_vblStructCpl_Core1_10ms_Nr1.MoCMem_tiRAMusOldCpl "Instance for specific core and task / complement of the old time stamp of the cyclic RAM check" ULONG OneToOne 1 100 0.00 4294967295.00 FORMAT "%13.2" ECU_ADDRESS 0x60018680 /end MEASUREMENT
/begin MEASUREMENT MoCMem_vblStructCpl_Core1_10ms_Nr1.MoCMem_tiRAMAccusCpl "Instance for specific core and task / complement of the sum of the time intervals between calls to the cyclic RAM check" ULONG OneToOne 1 100 0.00 4294967295.00 FORMAT "%13.2" ECU_ADDRESS 0x60018688 /end MEASUREMENT
/begin MEASUREMENT MoCMem_vblStructCpl_Core1_10ms_Nr1.MoCMem_tiRAMusCpl "Instance for specific core and task / complement of the time stamp of the cyclic RAM check" ULONG OneToOne 1 100 0.00 4294967295.00 FORMAT "%13.2" ECU_ADDRESS 0x60018684 /end MEASUREMENT
/begin MEASUREMENT MoCMem_vblStructCpl_Core1_10ms_Nr1.MoCMem_ctLrnErrHdlrCpl "Instance for specific core and task / Complement of the counter of the learn process for the error handler" UBYTE OneToOne 1 100 0.00 255.0 FORMAT "%5.1" ECU_ADDRESS 0x6001868C /end MEASUREMENT
/begin MEASUREMENT MoCMem_vblStructCpl_Core1_10ms_Nr1.MoCMem_tiErrHdlrusOldCpl "Instance for specific core and task / Complement of the previous time stamp for the error handler" ULONG OneToOne 1 100 0.00 4294967295.00 FORMAT "%13.2" ECU_ADDRESS 0x60018694 /end MEASUREMENT
/begin MEASUREMENT MoCMem_vblStructCpl_Core1_10ms_Nr1.MoCMem_tiErrHdlrusCpl "Instance for specific core and task / Complement of the current time stamp for the error handler" ULONG OneToOne 1 100 0.00 4294967295.00 FORMAT "%13.2" ECU_ADDRESS 0x60018690 /end MEASUREMENT
/begin MEASUREMENT MoCMem_vblStructCpl_Core1_10ms_Nr1.MoCMem_tiErrHdlrAccusCpl "Instance for specific core and task / Complement of the sums of the intervals between calls for the error handler" ULONG OneToOne 1 100 0.00 4294967295.00 FORMAT "%13.2" ECU_ADDRESS 0x60018698 /end MEASUREMENT
/begin MEASUREMENT MoCMem_vblStructCpl_Core1_10ms_Nr1.MoCMem_numHealFacCpl "Instance for specific core and task / Complement of the compensation factor for the healing counter" UBYTE OneToOne 1 100 0.00 255.0 FORMAT "%5.1" ECU_ADDRESS 0x6001869C /end MEASUREMENT
/begin MEASUREMENT MoCMem_vblStructEarlyClearedRAM_Core1_10ms_Nr1.MoCMem_st "Instance for specific core and task / Request of a complete memory test during initialisation; status of complete ROM test" UBYTE OneToOne 1 100 0.00 255.0 FORMAT "%5.1" ECU_ADDRESS 0x70039B88 /end MEASUREMENT
/begin MEASUREMENT MoCMem_vblStructEarlyClearedRAM_Core1_10ms_Nr1.MoCMem_stCpl "Instance for specific core and task / Double storage for request of complete RAMROM-memory checks during initialization" UBYTE OneToOne 1 100 0.00 255.0 FORMAT "%5.1" ECU_ADDRESS 0x70039B89 /end MEASUREMENT
/begin MEASUREMENT MoCMem_vblStructNVRAM_Core1_10ms_Nr1.MoCMem_ctDebErrChkRAMMaxNv "Instance for specific core and task / MaxValueIndicator for double storage and cyclic RAM-Test" UBYTE OneToOne 1 100 0.00 255.0 FORMAT "%5.1" ECU_ADDRESS 0x6003997C /end MEASUREMENT
/begin MEASUREMENT MoCMem_vblStructNVRAM_Core1_10ms_Nr1.MoCMem_ctDebErrChkRAMExcddThdNv "Instance for specific core and task / Counter how often the threshold for MaxValueIndicator for double storage and cyclic RAM-Test is exeeded" UBYTE OneToOne 1 100 0.00 255.0 FORMAT "%5.1" ECU_ADDRESS 0x6003997D /end MEASUREMENT
/begin MEASUREMENT MoCMem_vblStruct_Core1_10ms_Nr1.MoCMem_ctDebErrChkRAM "Instance for specific core and task / error debounce counter for double storage and cyclical RAM-test" UBYTE OneToOne 1 100 0.00 255.0 FORMAT "%5.1" ECU_ADDRESS 0x60019000 /end MEASUREMENT
/begin MEASUREMENT MoCMem_vblStruct_Core1_10ms_Nr1.MoCMem_ctDebHealChkRAM "Instance for specific core and task / error healing counter for double storage and cyclical RAM-test" UWORD OneToOne 1 100 0.00 65535.00 FORMAT "%8.2" ECU_ADDRESS 0x60019002 /end MEASUREMENT
/begin MEASUREMENT MoCMem_vblStruct_Core1_10ms_Nr1.MoCMem_nrRamChkSize "Instance for specific core and task / Memory size in Byte that is tested in the cyclic RAM check" ULONG OneToOne 1 100 0.00 4294967295.00 FORMAT "%13.2" ECU_ADDRESS 0x60019004 /end MEASUREMENT
/begin MEASUREMENT MoCMem_vblStruct_Core1_10ms_Nr1.MoCMem_adrChkStckEnd "Instance for specific core and task / End address of the current tested stack memory" ULONG OneToOne 1 100 0.00 4294967295.00 FORMAT "%13.2" ECU_ADDRESS 0x6001900C /end MEASUREMENT
/begin MEASUREMENT MoCMem_vblStruct_Core1_10ms_Nr1.MoCMem_adrChkStckStrt "Instance for specific core and task / Start address of the current tested stack memory" ULONG OneToOne 1 100 0.00 4294967295.00 FORMAT "%13.2" ECU_ADDRESS 0x60019008 /end MEASUREMENT
/begin MEASUREMENT MoCMem_vblStruct_Core1_10ms_Nr1.MoCMem_adrChkCSAStrt "Instance for specific core and task / Start address of the current tested CSA region" ULONG OneToOne 1 100 0.00 4294967295.00 FORMAT "%13.2" ECU_ADDRESS 0x60019010 /end MEASUREMENT
/begin MEASUREMENT MoCMem_vblStruct_Core1_10ms_Nr1.MoCMem_adrChkCSAEnd "Instance for specific core and task / End address of the current tested CSA region" ULONG OneToOne 1 100 0.00 4294967295.00 FORMAT "%13.2" ECU_ADDRESS 0x60019014 /end MEASUREMENT
/begin MEASUREMENT MoCMem_vblStruct_Core1_10ms_Nr1.MoCMem_nrRamChk "Instance for specific core and task / Number of 32-bit memory cells to be tested in cyclical RAM check" UWORD OneToOne 1 100 0.00 65535.00 FORMAT "%8.2" ECU_ADDRESS 0x60019018 /end MEASUREMENT
/begin MEASUREMENT MoCMem_vblStruct_Core1_10ms_Nr1.MoCMem_nrStckChk "Instance for specific core and task / Number of bytes to be checked on each call of the cyclic stack check" ULONG OneToOne 1 100 0.00 4294967295.00 FORMAT "%13.2" ECU_ADDRESS 0x6001901C /end MEASUREMENT
/begin MEASUREMENT MoCMem_vblStruct_Core1_10ms_Nr1.MoCMem_nrCSAChk "Instance for specific core and task / Number of bytes to be checked on each call of the cyclic CSA check" ULONG OneToOne 1 100 0.00 4294967295.00 FORMAT "%13.2" ECU_ADDRESS 0x60019020 /end MEASUREMENT
/begin MEASUREMENT MoCMem_vblStruct_Core1_10ms_Nr1.MoCMem_StckOffsetPtr "Instance for specific core and task / Stack start address of the current stck cyclic check" ULONG OneToOne 1 100 0.00 4294967295.00 FORMAT "%13.2" ECU_ADDRESS 0x60019024 /end MEASUREMENT
/begin MEASUREMENT MoCMem_vblStruct_Core1_10ms_Nr1.MoCMem_CSAOffsetPtr "Instance for specific core and task / CSA start address of the current CSA cyclic check" ULONG OneToOne 1 100 0.00 4294967295.00 FORMAT "%13.2" ECU_ADDRESS 0x60019028 /end MEASUREMENT
/begin MEASUREMENT MoCMem_vblStruct_Core1_10ms_Nr1.MoCMem_adrChkStckSP "Instance for specific core and task / current test cycle start address of the stack region to be tested" ULONG OneToOne 1 100 0.00 4294967295.00 FORMAT "%13.2" ECU_ADDRESS 0x6001902C /end MEASUREMENT
/begin MEASUREMENT MoCMem_vblStruct_Core1_10ms_Nr1.MoCMem_RamOffsetPtr "Instance for specific core and task / pointer with the address for the cyclic checked RAM area which should be checkt at the next cyclic call of the cyclic RAM check" ULONG OneToOne 1 100 0.00 4294967295.00 FORMAT "%13.2" ECU_ADDRESS 0x60019030 /end MEASUREMENT
/begin MEASUREMENT MoCMem_vblStruct_Core1_10ms_Nr1.MoCMem_ChkRAMStck "Instance for specific core and task / temporary stack used during cyclic stack check" ULONG OneToOne 1 100 0.00 4294967295.00 FORMAT "%13.2" ARRAY_SIZE 80 ECU_ADDRESS 0x60019034 /end MEASUREMENT
/begin MEASUREMENT MoCMem_vblStruct_Core1_10ms_Nr1.MoCMem_ctLrnRAM "Instance for specific core and task / Counter for the learn process of the RAM check" UBYTE OneToOne 1 100 0.00 255.0 FORMAT "%5.1" ECU_ADDRESS 0x60019174 /end MEASUREMENT
/begin MEASUREMENT MoCMem_vblStruct_Core1_10ms_Nr1.MoCMem_tiRAMus "Instance for specific core and task / time stamp of the cyclic RAM check" ULONG OneToOne 1 100 0.00 4294967295.00 FORMAT "%13.2" ECU_ADDRESS 0x6001917C /end MEASUREMENT
/begin MEASUREMENT MoCMem_vblStruct_Core1_10ms_Nr1.MoCMem_tiRAMusOld "Instance for specific core and task / old time stamp of the cyclic RAM check" ULONG OneToOne 1 100 0.00 4294967295.00 FORMAT "%13.2" ECU_ADDRESS 0x60019178 /end MEASUREMENT
/begin MEASUREMENT MoCMem_vblStruct_Core1_10ms_Nr1.MoCMem_tiRAMAccus "Instance for specific core and task / sum of the time intervals between calls to the cyclic RAM check" ULONG OneToOne 1 100 0.00 4294967295.00 FORMAT "%13.2" ECU_ADDRESS 0x60019180 /end MEASUREMENT
/begin MEASUREMENT MoCMem_vblStruct_Core1_10ms_Nr1.MoCMem_ctLrnErrHdlr "Instance for specific core and task / Counter of the learn process for the error handler" UBYTE OneToOne 1 100 0.00 255.0 FORMAT "%5.1" ECU_ADDRESS 0x60019184 /end MEASUREMENT
/begin MEASUREMENT MoCMem_vblStruct_Core1_10ms_Nr1.MoCMem_tiErrHdlrusOld "Instance for specific core and task / Previous time stamp for the error handler" ULONG OneToOne 1 100 0.00 4294967295.00 FORMAT "%13.2" ECU_ADDRESS 0x60019188 /end MEASUREMENT
/begin MEASUREMENT MoCMem_vblStruct_Core1_10ms_Nr1.MoCMem_tiErrHdlrus "Instance for specific core and task / Current time stamp for the error handler" ULONG OneToOne 1 100 0.00 4294967295.00 FORMAT "%13.2" ECU_ADDRESS 0x6001918C /end MEASUREMENT
/begin MEASUREMENT MoCMem_vblStruct_Core1_10ms_Nr1.MoCMem_tiErrHdlrAccus "Instance for specific core and task / Sum of the intervals between calls for the error handler" ULONG OneToOne 1 100 0.00 4294967295.00 FORMAT "%13.2" ECU_ADDRESS 0x60019190 /end MEASUREMENT
/begin MEASUREMENT MoCMem_vblStruct_Core1_10ms_Nr1.MoCMem_numHealFac "Instance for specific core and task / Compensation factor for the healing counter" UBYTE OneToOne 1 100 0.00 255.0 FORMAT "%5.1" ECU_ADDRESS 0x60019194 /end MEASUREMENT
/begin MEASUREMENT MoCPFC_vblStructCpl_Core1_10ms_Nr1.MoCPFC_cntr "Instance for specific core and task / Module call counter" UBYTE OneToOne 1 100 0.00 255.0 FORMAT "%5.1" ECU_ADDRESS 0x6001861C /end MEASUREMENT
/begin MEASUREMENT MoCPFC_vblStructCpl_Core1_10ms_Nr1.MoCPFC_numChkword "Instance for specific core and task / Module specific checkword" ULONG OneToOne 1 100 0.00 4294967295.00 FORMAT "%13.2" ECU_ADDRESS 0x60018620 /end MEASUREMENT
/begin MEASUREMENT MoCPFC_vblStructCpl_Core1_10ms_Nr1.MoCPFC_numChks "Instance for specific core and task / Module specific total CRC checksum (from MISR algorithm)" ULONG OneToOne 1 100 0.00 4294967295.00 FORMAT "%13.2" ECU_ADDRESS 0x60018624 /end MEASUREMENT
/begin MEASUREMENT MoCPFC_vblStructCpl_Core1_10ms_Nr1.MoCPFC_numConCatVal "Instance for specific core and task / Task-core combination specific concatenated value" ULONG OneToOne 1 100 0.00 4294967295.00 FORMAT "%13.2" ECU_ADDRESS 0x60018628 /end MEASUREMENT
/begin MEASUREMENT MoCPFC_vblStructCpl_Core1_10ms_Nr1.MoCPFC_cntrRollg "Instance for specific core and task / Task-core combination specific Rolling counter" ULONG OneToOne 1 100 0.00 4294967295.00 FORMAT "%13.2" ECU_ADDRESS 0x6001862C /end MEASUREMENT
/begin MEASUREMENT MoCPFC_vblStructCpl_Core1_10ms_Nr1.MoCPFC_aryRingBuf "Instance for specific core and task / Task-core combination specific Ring Buffer" ULONG OneToOne 1 100 0.00 4294967295.00 FORMAT "%13.2" ARRAY_SIZE 6 ECU_ADDRESS 0x60018630 /end MEASUREMENT
/begin MEASUREMENT MoCPFC_vblStructCpl_Core1_10ms_Nr1.MoCPFC_stWrErr "Instance for specific core and task / Status of task-core combination specific ring buffer full error" UBYTE OneToOne 1 100 0.00 255.0 FORMAT "%5.1" ECU_ADDRESS 0x60018648 /end MEASUREMENT
/begin MEASUREMENT MoCPFC_vblStructCpl_Core1_10ms_Nr1.MoCPFC_RingBuf_pst.startAdr "Instance for specific core and task / Structure holding task-core combination specific Ring Buffer properties / start address of Ring buffer" ULONG default 1 100 0.00 4294967295.00 FORMAT "%13.2" ECU_ADDRESS 0x6001864C /end MEASUREMENT
/begin MEASUREMENT MoCPFC_vblStructCpl_Core1_10ms_Nr1.MoCPFC_RingBuf_pst.size "Instance for specific core and task / Structure holding task-core combination specific Ring Buffer properties / maximum number of elements in the buffer" UBYTE OneToOne 1 100 0.00 255.0 FORMAT "%5.1" ECU_ADDRESS 0x60018650 /end MEASUREMENT
/begin MEASUREMENT MoCPFC_vblStructCpl_Core1_10ms_Nr1.MoCPFC_RingBuf_pst.head "Instance for specific core and task / Structure holding task-core combination specific Ring Buffer properties / pointer to head of the ring buffer" ULONG default 1 100 0.00 4294967295.00 FORMAT "%13.2" ECU_ADDRESS 0x60018654 /end MEASUREMENT
/begin MEASUREMENT MoCPFC_vblStructCpl_Core1_10ms_Nr1.MoCPFC_RingBuf_pst.tail "Instance for specific core and task / Structure holding task-core combination specific Ring Buffer properties / pointer to head of the ring buffer" ULONG default 1 100 0.00 4294967295.00 FORMAT "%13.2" ECU_ADDRESS 0x60018658 /end MEASUREMENT
/begin MEASUREMENT MoCSCC_varStructCpl_Core1_10ms_Nr1.MoCSCC_stChpIdCpl "Instance for specific core and task / Complement of CPU version" ULONG OneToOne 1 100 0.00 4294967295.00 FORMAT "%13.2" ECU_ADDRESS 0x60018614 /end MEASUREMENT
/begin MEASUREMENT MoCSCC_varStructCpl_Core1_10ms_Nr1.MoCSCC_cntrDebCpl "Instance for specific core and task / Complement of debounce counter for configuration check error" UBYTE OneToOne 1 100 0.00 255.0 FORMAT "%5.1" ECU_ADDRESS 0x60018618 /end MEASUREMENT
/begin MEASUREMENT MoCSCC_varStructCpl_Core1_10ms_Nr1.MoCSCC_stTrmDevCpl "Instance for specific core and task / Complement of trimmed device" UBYTE OneToOne 1 100 0.00 255.0 FORMAT "%5.1" ECU_ADDRESS 0x60018619 /end MEASUREMENT
/begin MEASUREMENT MoCSCC_varStructCpl_Core1_10ms_Nr1.MoCSCC_cntrMPURegChkCpl "Instance for specific core and task / Complement of counter of MPU registers to be checked" UBYTE OneToOne 1 100 0.00 255.0 FORMAT "%5.1" ECU_ADDRESS 0x6001861A /end MEASUREMENT
/begin MEASUREMENT MoCSCC_varStructNVRAM_Core1_10ms_Nr1.MoCSCC_cntrDebMaxNv "Instance for specific core and task / Max value indicator for error debounce counter of configuration check error" UBYTE OneToOne 1 100 0.00 255.0 FORMAT "%5.1" ECU_ADDRESS 0x60039978 /end MEASUREMENT
/begin MEASUREMENT MoCSCC_varStructNVRAM_Core1_10ms_Nr1.MoCSCC_cntrDebExcddThdNv "Instance for specific core and task / Counter to store the number of times error debounce counter of configuration check error exceeds the threshold value" UBYTE OneToOne 1 100 0.00 255.0 FORMAT "%5.1" ECU_ADDRESS 0x60039979 /end MEASUREMENT
/begin MEASUREMENT MoCSCC_varStructNVRAM_Core1_10ms_Nr1.MoCSCC_cntrDebOld "Instance for specific core and task / Counter to store the old value of error debounce counter of configuration check error" UBYTE OneToOne 1 100 0.00 255.0 FORMAT "%5.1" ECU_ADDRESS 0x6003997A /end MEASUREMENT
/begin MEASUREMENT MoCSCC_varStruct_Core1_10ms_Nr1.MoCSCC_stErr "Instance for specific core and task / Status word to report configuration check error" UWORD OneToOne 1 100 0.00 65535.00 FORMAT "%8.2" ECU_ADDRESS 0x60018FF4 /end MEASUREMENT
/begin MEASUREMENT MoCSCC_varStruct_Core1_10ms_Nr1.MoCSCC_cntrDeb "Instance for specific core and task / Debounce counter for configuration check error" UBYTE OneToOne 1 100 0.00 255.0 FORMAT "%5.1" ECU_ADDRESS 0x60018FF6 /end MEASUREMENT
/begin MEASUREMENT MoCSCC_varStruct_Core1_10ms_Nr1.MoCSCC_stTrmDev "Instance for specific core and task / Trimmed device" UBYTE OneToOne 1 100 0.00 255.0 FORMAT "%5.1" ECU_ADDRESS 0x60018FF7 /end MEASUREMENT
/begin MEASUREMENT MoCSCC_varStruct_Core1_10ms_Nr1.MoCSCC_stChpId "Instance for specific core and task / Cpu version" ULONG OneToOne 1 100 0.00 4294967295.00 FORMAT "%13.2" ECU_ADDRESS 0x60018FF8 /end MEASUREMENT
/begin MEASUREMENT MoCSCC_varStruct_Core1_10ms_Nr1.MoCSCC_cntrMPURegChk "Instance for specific core and task / Counter of MPU registers to be checked" UBYTE OneToOne 1 100 0.00 255.0 FORMAT "%5.1" ECU_ADDRESS 0x60018FFC /end MEASUREMENT
/begin MEASUREMENT MoExe_varStructCpl_Core1_10ms_Nr1.MoExe_ctCycCpl "Instance for specific core and task / Instance for specific core and task" UBYTE OneToOne 1 100 0.00 255.0 FORMAT "%5.1" ECU_ADDRESS 0x60018610 /end MEASUREMENT
/begin MEASUREMENT MoExe_varStruct_Core1_10ms_Nr1.MoExe_ctCyc "Instance for specific core and task / Instance structure for MoExe_Co scheduling counter" UBYTE OneToOne 1 100 0.00 255.0 FORMAT "%5.1" ECU_ADDRESS 0x60018FF1 /end MEASUREMENT
/begin MEASUREMENT MoFClth_flgClthStrkFlt "Flag to indicate clutch stroke error" UBYTE B_TRUE 1 100 0.00 1.00000000000 BIT_MASK 0x1 FORMAT "%13.11" ECU_ADDRESS 0x6001871A /end MEASUREMENT
/begin MEASUREMENT MoFCoOfs_rTrqPtd "permissible inner engine torque" UBYTE rel_q0p39 1 100 0.00 99.61 FORMAT "%5.2" ECU_ADDRESS 0x600187BF /end MEASUREMENT
/begin MEASUREMENT MoFCoOfs_rTrqPtdCpl "double storage of permissible inner engine torque" UBYTE OneToOne 1 100 0.00 255.0 FORMAT "%5.1" ECU_ADDRESS 0x600180B0 /end MEASUREMENT
/begin MEASUREMENT MoFDrvPrgSwtCo_bbOut1Cpl "double storage variable for MoFDrvPrgSwtCo_bbOut1" UBYTE OneToOne 1 100 0.00 255.0 FORMAT "%5.1" ECU_ADDRESS 0x6001800A /end MEASUREMENT
/begin MEASUREMENT MoFTrqPtdEmac_bbOut1Cpl "Complement variable for MoFTrqPtdEmac_bbOut1" UBYTE OneToOne 1 100 0.00 255.0 FORMAT "%5.1" ECU_ADDRESS 0x600180C6 /end MEASUREMENT
/begin MEASUREMENT MoFTrqPtd_cntrActvPostBldCfg "Counter for error debounce due to an error in return of the active post-build configuration" UBYTE OneToOne 1 100 0.00 255.0 FORMAT "%5.1" ECU_ADDRESS 0x60018725 /end MEASUREMENT
/begin MEASUREMENT MoFTrqPtd_cntrActvPostBldCfgCpl "RAM data redundancy of MoFTrqPtd_cntrActvPostBldCfg" UBYTE OneToOne 1 100 0.00 255.0 FORMAT "%5.1" ECU_ADDRESS 0x60018015 /end MEASUREMENT
/begin MEASUREMENT MoFTrqPtd_cntrNegChkPostBldCfg "Counter for error debounce due to an error in the negative check of the post-build configuration" UBYTE OneToOne 1 100 0.00 255.0 FORMAT "%5.1" ECU_ADDRESS 0x60018724 /end MEASUREMENT
/begin MEASUREMENT MoFTrqPtd_cntrNegChkPostBldCfgCpl "RAM data redundancy of MoFTrqPtd_cntrNegChkPostBldCfg" UBYTE OneToOne 1 100 0.00 255.0 FORMAT "%5.1" ECU_ADDRESS 0x60018014 /end MEASUREMENT
/begin MEASUREMENT MoFTrqPtd_cntrPosChkPostBldCfg "Counter for error debounce due to an error in the positive check of the post-build configuration" UBYTE OneToOne 1 100 0.00 255.0 FORMAT "%5.1" ECU_ADDRESS 0x60018723 /end MEASUREMENT
/begin MEASUREMENT MoFTrqPtd_cntrPosChkPostBldCfgCpl "RAM data redundancy of MoFTrqPtd_cntrPosChkPostBldCfg" UBYTE OneToOne 1 100 0.00 255.0 FORMAT "%5.1" ECU_ADDRESS 0x60018013 /end MEASUREMENT
/begin MEASUREMENT MoFTrqPtd_cntrStabyChkPostBldCfg "Counter for the error debounce due to changed post-build configuration during driving cycle" UBYTE OneToOne 1 100 0.00 255.0 FORMAT "%5.1" ECU_ADDRESS 0x60018722 /end MEASUREMENT
/begin MEASUREMENT MoFTrqPtd_cntrStabyChkPostBldCfgCpl "RAM data redundancy of MoFTrqPtd_cntrStabyChkPostBldCfg" UBYTE OneToOne 1 100 0.00 255.0 FORMAT "%5.1" ECU_ADDRESS 0x60018012 /end MEASUREMENT
/begin MEASUREMENT MoFTrqPtd_cntrTestPostBldSel "Counter for setting the testflag in diagnosis of post-build selectable in function monitoring" UBYTE OneToOne 1 100 0.00 255.0 FORMAT "%5.1" ECU_ADDRESS 0x6000B6FC /end MEASUREMENT
/begin MEASUREMENT MoFTrqPtd_flgAlt "Alternating flag in post-build selectable monitoring" UBYTE B_TRUE 1 100 0.00 1.00000000000 BIT_MASK 0x8 FORMAT "%13.11" ECU_ADDRESS 0x6001871C /end MEASUREMENT
/begin MEASUREMENT MoFTrqPtd_flgClrPostBldSel "Condition DSM clearing in MoFVar_PostBldSel in function monitoring" UBYTE B_TRUE 1 100 0.00 1.00000000000 BIT_MASK 0x1 FORMAT "%13.11" ECU_ADDRESS 0x7000014B /end MEASUREMENT
/begin MEASUREMENT MoFTrqPtd_flgComErrDebElDrv "debounced E-Drive communication error in the strategy monitoring" UBYTE B_TRUE 1 100 0.00 1.00000000000 BIT_MASK 0x1 FORMAT "%13.11" ECU_ADDRESS 0x600187D3 /end MEASUREMENT
/begin MEASUREMENT MoFTrqPtd_flgErrActvPostBldCfg "Error during request of post-build index of BSW" UBYTE B_TRUE 1 100 0.00 1.00000000000 BIT_MASK 0x10 FORMAT "%13.11" ECU_ADDRESS 0x6001871C /end MEASUREMENT
/begin MEASUREMENT MoFTrqPtd_flgErrDcycStabyChk "Error of monitoring of the post-build variant on stability check over driving cycle" UBYTE B_TRUE 1 100 0.00 1.00000000000 BIT_MASK 0x20 FORMAT "%13.11" ECU_ADDRESS 0x6001871C /end MEASUREMENT
/begin MEASUREMENT MoFTrqPtd_flgErrElDrv "debounced error status: E-Drive Failure" UBYTE B_TRUE 1 100 0.00 1.00000000000 BIT_MASK 0x4 FORMAT "%13.11" ECU_ADDRESS 0x600187D3 /end MEASUREMENT
/begin MEASUREMENT MoFTrqPtd_flgErrIvsChkPostBld "Error in inverse check of post-build configuration" UBYTE B_TRUE 1 100 0.00 1.00000000000 BIT_MASK 0x80 FORMAT "%13.11" ECU_ADDRESS 0x6001871C /end MEASUREMENT
/begin MEASUREMENT MoFTrqPtd_flgErrPosChk "Wrong return value in positive check of post-build selectable monitoring received" UBYTE B_TRUE 1 100 0.00 1.00000000000 BIT_MASK 0x2 FORMAT "%13.11" ECU_ADDRESS 0x6001871C /end MEASUREMENT
/begin MEASUREMENT MoFTrqPtd_flgErrPosChk2 "Wrong return value in positive check of post-build selectable monitoring received" UBYTE B_TRUE 1 100 0.00 1.00000000000 BIT_MASK 0x4 FORMAT "%13.11" ECU_ADDRESS 0x6001871C /end MEASUREMENT
/begin MEASUREMENT MoFTrqPtd_flgErrPosChkPostBld "Error in positive check of post-build configuration" UBYTE B_TRUE 1 100 0.00 1.00000000000 BIT_MASK 0x40 FORMAT "%13.11" ECU_ADDRESS 0x6001871C /end MEASUREMENT
/begin MEASUREMENT MoFTrqPtd_flgFailErrDebElDrv "debounced error status: E-Drive System Failure" UBYTE B_TRUE 1 100 0.00 1.00000000000 BIT_MASK 0x2 FORMAT "%13.11" ECU_ADDRESS 0x600187D3 /end MEASUREMENT
/begin MEASUREMENT MoFTrqPtd_flgIrrvErrPostBldSel "Irreversible error flag from post-build selectable function monitoring" UBYTE B_TRUE 1 100 0.00 1.00000000000 BIT_MASK 0x1 FORMAT "%13.11" ECU_ADDRESS 0x6001871B /end MEASUREMENT
/begin MEASUREMENT MoFTrqPtd_flgIrrvErrPostBldSelMsg "Irreversible error flag from post-build selectable function monitoring to level 1" UBYTE B_TRUE 1 100 0.00 1.00000000000 BIT_MASK 0x1 FORMAT "%13.11" ECU_ADDRESS 0x700007D5 /end MEASUREMENT
/begin MEASUREMENT MoFTrqPtd_flgPostBldCfgRxd "Post-build configuration from BSW overtaken to level 2 variable" UBYTE B_TRUE 1 100 0.00 1.00000000000 BIT_MASK 0x1 FORMAT "%13.11" ECU_ADDRESS 0x6001871C /end MEASUREMENT
/begin MEASUREMENT MoFTrqPtd_flgTqEmLimdMsg "Flag Message to indicate that the E-machine torque is beyond monitoring limits" UBYTE B_TRUE 1 100 0.00 1.00000000000 BIT_MASK 0x1 FORMAT "%13.11" ECU_ADDRESS 0x700007D4 /end MEASUREMENT
/begin MEASUREMENT MoFTrqPtd_idxPostBldCfg "Active post-build configuration from BSW" UBYTE OneToOne 1 100 0.00 255.0 FORMAT "%5.1" ECU_ADDRESS 0x60018721 /end MEASUREMENT
/begin MEASUREMENT MoFTrqPtd_idxPostBldCfgCpl "RAM data redundancy of MoFTrqPtd_idxPostBldCfg" UBYTE OneToOne 1 100 0.00 255.0 FORMAT "%5.1" ECU_ADDRESS 0x60018011 /end MEASUREMENT
/begin MEASUREMENT MoFTrqPtd_idxPostBldCfgIni "After initialization in level 2 stored post-build configuration" UBYTE OneToOne 1 100 0.00 255.0 FORMAT "%5.1" ECU_ADDRESS 0x60018720 /end MEASUREMENT
/begin MEASUREMENT MoFTrqPtd_idxPostBldCfgIniCpl "RAM data redundancy of MoFTrqPtd_idxPostBldCfgIni" UBYTE OneToOne 1 100 0.00 255.0 FORMAT "%5.1" ECU_ADDRESS 0x60018010 /end MEASUREMENT
/begin MEASUREMENT MoFTrqPtd_rTrqPtdFltWoOffs "Permitted filtered torque ratio with offset" UBYTE rel_q0p39 1 100 0.00 99.61 FORMAT "%5.2" ECU_ADDRESS 0x600187C0 /end MEASUREMENT
/begin MEASUREMENT MoFTrqPtd_rTrqPtdFltWoOffsCpl "RAM data redundancy of MoFTrqPtd_rTrqPtdFltWoOffs" UBYTE OneToOne 1 100 0.00 255.0 FORMAT "%5.1" ECU_ADDRESS 0x600180AF /end MEASUREMENT
/begin MEASUREMENT MoFTrqPtd_stActvPostBldVrntIdx "Return value of the callback function EcuM_RbMoGetActivePostBuildVariantIndex" UBYTE OneToOne 1 100 0.00 255.0 FORMAT "%5.1" ECU_ADDRESS 0x6001871F /end MEASUREMENT
/begin MEASUREMENT MoFTrqPtd_stActvPostBldVrntIdxCpl "Complement of the return value of the callback function EcuM_RbMoGetActivePostBuildVariantIndex" UBYTE OneToOne 1 100 0.00 255.0 FORMAT "%5.1" ECU_ADDRESS 0x6001800F /end MEASUREMENT
/begin MEASUREMENT MoFTrqPtd_stMonIninChk "Return value of the callback function EcuM_RbMoInitCheck" UBYTE OneToOne 1 100 0.00 255.0 FORMAT "%5.1" ECU_ADDRESS 0x6001871E /end MEASUREMENT
/begin MEASUREMENT MoFTrqPtd_stMonIninChkCpl "Complement of the return value of the callback function EcuM_RbMoInitCheck" UBYTE OneToOne 1 100 0.00 255.0 FORMAT "%5.1" ECU_ADDRESS 0x6001800E /end MEASUREMENT
/begin MEASUREMENT MoFTrqPtd_stMonIninChkIvs "Return value of the callback function EcuM_RbMoInitCheckInverse" UBYTE OneToOne 1 100 0.00 255.0 FORMAT "%5.1" ECU_ADDRESS 0x6001871D /end MEASUREMENT
/begin MEASUREMENT MoFTrqPtd_stMonIninChkIvsCpl "Complement of the return value of the callback function EcuM_RbMoInitCheckInverse" UBYTE OneToOne 1 100 0.00 255.0 FORMAT "%5.1" ECU_ADDRESS 0x6001800D /end MEASUREMENT
/begin MEASUREMENT MoFTrqPtd_stOperModDesElDrv "e-drive operating mode request" UBYTE OneToOne 1 100 0.00 255.0 FORMAT "%5.1" ECU_ADDRESS 0x600187D2 /end MEASUREMENT
/begin MEASUREMENT MoFTrqPtd_stOperModDesElDrvCpl "RAM data redundancy for MoFTrqPtd_stOperModDesElDrv" UBYTE OneToOne 1 100 0.00 255.0 FORMAT "%5.1" ECU_ADDRESS 0x600180C5 /end MEASUREMENT
/begin MEASUREMENT MoFTrqPtd_stOperModDesElDrvMsg "E-drive operating mode request message" UBYTE OneToOne 1 100 0.00 255.0 FORMAT "%5.1" ECU_ADDRESS 0x6000FBCE /end MEASUREMENT
/begin MEASUREMENT MoFTrqPtd_tiDebComErrElDrv "Debouncing time for detecting E-Drive communication error" UBYTE t_q0p01 1 100 0.00 2.550 FORMAT "%5.3" ECU_ADDRESS 0x600187D6 /end MEASUREMENT
/begin MEASUREMENT MoFTrqPtd_tiDebComErrElDrvCpl "RAM data redundancy for MoFTrqPtd_tiDebComErrElDrv" UBYTE OneToOne 1 100 0.00 255.0 FORMAT "%5.1" ECU_ADDRESS 0x600180C4 /end MEASUREMENT
/begin MEASUREMENT MoFTrqPtd_tiDebIrrvCmpErr "debounce time counter after irreversible torque comparision error was detected" UBYTE t_q0p01 1 100 0.00 2.550 FORMAT "%5.3" ECU_ADDRESS 0x600187D5 /end MEASUREMENT
/begin MEASUREMENT MoFTrqPtd_tiDebIrrvCmpErrCpl "RAM data redundancy for MoFTrqPtd_tiDebIrrvCmpErr" UBYTE OneToOne 1 100 0.00 255.0 FORMAT "%5.1" ECU_ADDRESS 0x600180C3 /end MEASUREMENT
/begin MEASUREMENT MoFTrqPtd_tiDebIrvErrElDrv "Debouncing time for detecting E-Drive failure error" UBYTE t_q0p01 1 100 0.00 2.550 FORMAT "%5.3" ECU_ADDRESS 0x600187D4 /end MEASUREMENT
/begin MEASUREMENT MoFTrqPtd_tiDebIrvErrElDrvCpl "RAM data redundancy for MoFTrqPtd_tiDebIrvErrElDrv" UBYTE OneToOne 1 100 0.00 255.0 FORMAT "%5.1" ECU_ADDRESS 0x600180C2 /end MEASUREMENT
/begin MEASUREMENT MoFTrqPtd_tqCluSumPtd "Sum Permitted torque at clutch level" SWORD md_q0p1 1 100 -3276.800 3276.700 FORMAT "%8.3" ECU_ADDRESS 0x600187BC /end MEASUREMENT
/begin MEASUREMENT MoFTrqPtd_tqCluSumPtdCpl "RAM data redundancy of MoFTrqPtd_tqCluSumPtd" UWORD OneToOne 1 100 0.00 65535.00 FORMAT "%8.2" ECU_ADDRESS 0x600180AC /end MEASUREMENT
/begin MEASUREMENT MoFTrqPtd_tqCluSumPtdFild "Permitted inner sum torque including disturbance controller torque" SWORD md_q0p1 1 100 -3276.800 3276.700 FORMAT "%8.3" ECU_ADDRESS 0x60018776 /end MEASUREMENT
/begin MEASUREMENT MoFTrqPtd_tqCluSumPtdFildAry "Array for deathtime functionality of filter" SWORD md_q0p1 1 100 -3276.800 3276.700 FORMAT "%8.3" ARRAY_SIZE 32 ECU_ADDRESS 0x60018736 /end MEASUREMENT
/begin MEASUREMENT MoFTrqPtd_tqCluSumPtdFildAryCpl "Cpl Array for deathtime functionality of filter" UWORD OneToOne 1 100 0.00 65535.00 FORMAT "%8.2" ARRAY_SIZE 32 ECU_ADDRESS 0x60018028 /end MEASUREMENT
/begin MEASUREMENT MoFTrqPtd_tqCluSumPtdFildCpl "Complement of MoFTrqPtd_tqCluSumPtdFild" UWORD OneToOne 1 100 0.00 65535.00 FORMAT "%8.2" ECU_ADDRESS 0x60018026 /end MEASUREMENT
/begin MEASUREMENT MoFTrqPtd_tqCluSumPtdFildOffs "Permitted filtered inner sum torque with disturbance controller output and offset" SWORD md_q0p1 1 100 -3276.800 3276.700 FORMAT "%8.3" ECU_ADDRESS 0x60018734 /end MEASUREMENT
/begin MEASUREMENT MoFTrqPtd_tqCluSumPtdFildOffsCpl "Complement of MoFTrqPtd_tqCluSumPtdFildOffs" UWORD OneToOne 1 100 0.00 65535.00 FORMAT "%8.2" ECU_ADDRESS 0x60018024 /end MEASUREMENT
/begin MEASUREMENT MoFTrqPtd_tqCluSumPtdFildRaw "Permitted filtered inner sum torque without disturbance controller output and without offset" SWORD md_q0p1 1 100 -3276.800 3276.700 FORMAT "%8.3" ECU_ADDRESS 0x60018732 /end MEASUREMENT
/begin MEASUREMENT MoFTrqPtd_tqCluSumPtdFildRawCpl "Complement of MoFTrqPtd_tqCluSumPtdFildRaw" UWORD OneToOne 1 100 0.00 65535.00 FORMAT "%8.2" ECU_ADDRESS 0x60018022 /end MEASUREMENT
/begin MEASUREMENT MoFTrqPtd_tqCluSumPtdUnfild "permitted unfiltered sum torque at clutch level with all interventions in function monitoring" SWORD md_q0p1 1 100 -3276.800 3276.700 FORMAT "%8.3" ECU_ADDRESS 0x60018730 /end MEASUREMENT
/begin MEASUREMENT MoFTrqPtd_tqCluSumPtdUnfildCpl "Complement of MoFTrqPtd_tqCluSumPtdUnfild" UWORD OneToOne 1 100 0.00 65535.00 FORMAT "%8.2" ECU_ADDRESS 0x60018020 /end MEASUREMENT
/begin MEASUREMENT MoFTrqPtd_tqCompMsg "Message to MoX: compensated loss torque" SWORD md_q0p1 1 100 -3276.800 3276.700 FORMAT "%8.3" ECU_ADDRESS 0x60009892 /end MEASUREMENT
/begin MEASUREMENT MoFTrqPtd_tqCrksftEmMinFild "filtered permitted minimum e-machine torque without offset" SWORD md_q0p1 1 100 -3276.800 3276.700 FORMAT "%8.3" ECU_ADDRESS 0x6001872E /end MEASUREMENT
/begin MEASUREMENT MoFTrqPtd_tqCrksftEmMinFildCpl "Complement of MoFTrqPtd_tqCrksftEmMinFild" UWORD OneToOne 1 100 0.00 65535.00 FORMAT "%8.2" ECU_ADDRESS 0x6001801E /end MEASUREMENT
/begin MEASUREMENT MoFTrqPtd_tqCrksftEmMinFildOffs "filtered permitted minimum e-machine torque with offset" SWORD md_q0p1 1 100 -3276.800 3276.700 FORMAT "%8.3" ECU_ADDRESS 0x6001872C /end MEASUREMENT
/begin MEASUREMENT MoFTrqPtd_tqCrksftEmMinFildOffsCpl "Complement of MoFTrqPtd_tqCrksftEmMinFildOffs" UWORD OneToOne 1 100 0.00 65535.00 FORMAT "%8.2" ECU_ADDRESS 0x6001801C /end MEASUREMENT
/begin MEASUREMENT MoFTrqPtd_tqCrksftMaxEmOperMod "Maximum permitted e-machine torque on crankshaft level according to the current operating mode" SWORD md_q0p1 1 100 -3276.800 3276.700 FORMAT "%8.3" ECU_ADDRESS 0x600187CE /end MEASUREMENT
/begin MEASUREMENT MoFTrqPtd_tqCrksftMaxEmOperModCpl "RAM data redundancy of MoFTrqPtd_tqCrksftMaxEmOperMod" UWORD OneToOne 1 100 0.00 65535.00 FORMAT "%8.2" ECU_ADDRESS 0x600180C0 /end MEASUREMENT
/begin MEASUREMENT MoFTrqPtd_tqCrsEM "permitted torque demand: electrical drive (crankshaft level)" SWORD md_q0p1 1 100 -3276.800 3276.700 FORMAT "%8.3" ECU_ADDRESS 0x600187CC /end MEASUREMENT
/begin MEASUREMENT MoFTrqPtd_tqCrsEMCpl "RAM data redundancy for MoFTrqPtd_tqCrsEM" UWORD OneToOne 1 100 0.00 65535.00 FORMAT "%8.2" ECU_ADDRESS 0x600180BE /end MEASUREMENT
/begin MEASUREMENT MoFTrqPtd_tqCrsEmMaxMsg "Maximum permitted E-Machine torque on Crankshaft level, Message to L1" SWORD md_q0p1 1 100 -3276.800 3276.700 FORMAT "%8.3" ECU_ADDRESS 0x6000988E /end MEASUREMENT
/begin MEASUREMENT MoFTrqPtd_tqCrsEmMinMsg "Minimum permitted E-Machine torque on Crankshaft level, Message to L1" SWORD md_q0p1 1 100 -3276.800 3276.700 FORMAT "%8.3" ECU_ADDRESS 0x6000988C /end MEASUREMENT
/begin MEASUREMENT MoFTrqPtd_tqCrsEMMsg "permitted torque demand: electrical drive (crankshaft level) for Level 1" SWORD md_q0p1 1 100 -3276.800 3276.700 FORMAT "%8.3" ECU_ADDRESS 0x60009890 /end MEASUREMENT
/begin MEASUREMENT MoFTrqPtd_tqCrsMinEM "minimum permited e-machine torque on crankshaft level" SWORD md_q0p1 1 100 -3276.800 3276.700 FORMAT "%8.3" ECU_ADDRESS 0x600187CA /end MEASUREMENT
/begin MEASUREMENT MoFTrqPtd_tqCrsMinEMCpl "Complement variable for MoFTrqPtd_tqCrsMinEM" UWORD OneToOne 1 100 0.00 65535.00 FORMAT "%8.2" ECU_ADDRESS 0x600180BC /end MEASUREMENT
/begin MEASUREMENT MoFTrqPtd_tqEM "E-drive torque demand for level 2 (E-drive level)" SWORD md_q0p1 1 100 -3276.800 3276.700 FORMAT "%8.3" ECU_ADDRESS 0x600187C8 /end MEASUREMENT
/begin MEASUREMENT MoFTrqPtd_tqEMCpl "RAM data redundancy for MoFTrqPtd_tqEM" UWORD OneToOne 1 100 0.00 65535.00 FORMAT "%8.2" ECU_ADDRESS 0x600180BA /end MEASUREMENT
/begin MEASUREMENT MoFTrqPtd_tqEmMsg "E-drive torque demand for level 2 (E-drive level) message" SWORD RBPtCel_tq_0p5_1 1 100 -16384.00 16383.50 FORMAT "%8.2" ECU_ADDRESS 0x6000988A /end MEASUREMENT
/begin MEASUREMENT MoFTrqPtd_tqInnrPtdFild "Filtered inner permitted torque" SWORD md_q0p1 1 100 -3276.800 3276.700 FORMAT "%8.3" ECU_ADDRESS 0x600187BA /end MEASUREMENT
/begin MEASUREMENT MoFTrqPtd_tqInnrPtdFildAry "Array for deathtime functionality of filter" SWORD md_q0p1 1 100 -3276.800 3276.700 FORMAT "%8.3" ARRAY_SIZE 32 ECU_ADDRESS 0x6001877A /end MEASUREMENT
/begin MEASUREMENT MoFTrqPtd_tqInnrPtdFildAryCpl "Cpl Array for deathtime functionality of filter" UWORD OneToOne 1 100 0.00 65535.00 FORMAT "%8.2" ARRAY_SIZE 32 ECU_ADDRESS 0x6001806C /end MEASUREMENT
/begin MEASUREMENT MoFTrqPtd_tqInnrPtdFildCpl "RAM data redundancy of MoFTrqPtd_tqInnrPtdFild" UWORD OneToOne 1 100 0.00 65535.00 FORMAT "%8.2" ECU_ADDRESS 0x6001806A /end MEASUREMENT
/begin MEASUREMENT MoFTrqPtd_tqInrPtd "inner permissible torque in function monitoring" SWORD md_q0p1 1 100 -3276.800 3276.700 FORMAT "%8.3" ECU_ADDRESS 0x60018778 /end MEASUREMENT
/begin MEASUREMENT MoFTrqPtd_tqInrPtdCpl "RAM data redundancy for MoFTrqPtd_tqInrPtd" UWORD OneToOne 1 100 0.00 65535.00 FORMAT "%8.2" ECU_ADDRESS 0x60018068 /end MEASUREMENT
/begin MEASUREMENT MoFTrqPtd_tqInrPtdMsg "Message to Level1: permitted inner combustion engine torque" SWORD md_q0p1 1 100 -3276.800 3276.700 FORMAT "%8.3" ECU_ADDRESS 0x60009888 /end MEASUREMENT
/begin MEASUREMENT MoFTrqPtd_tqMaxEm "Permitted maximum e?machine torque on e-machine level" SWORD md_q0p1 1 100 -3276.800 3276.700 FORMAT "%8.3" ECU_ADDRESS 0x600187C6 /end MEASUREMENT
/begin MEASUREMENT MoFTrqPtd_tqMaxEmCpl "RAM data redundancy of MoFTrqPtd_tqMaxEm" UWORD OneToOne 1 100 0.00 65535.00 FORMAT "%8.2" ECU_ADDRESS 0x600180B8 /end MEASUREMENT
/begin MEASUREMENT MoFTrqPtd_tqMaxEmMsg "Permitted maximum e-machine torque on e-machine level Message" SWORD md_q0p1 1 100 -3276.800 3276.700 FORMAT "%8.3" ECU_ADDRESS 0x60009886 /end MEASUREMENT
/begin MEASUREMENT MoFTrqPtd_tqMinEM "minimum permitted e-machine torque" SWORD md_q0p1 1 100 -3276.800 3276.700 FORMAT "%8.3" ECU_ADDRESS 0x600187C4 /end MEASUREMENT
/begin MEASUREMENT MoFTrqPtd_tqMinEMCpl "Complement variable for MoFTrqPtd_tqMinEM" UWORD OneToOne 1 100 0.00 65535.00 FORMAT "%8.2" ECU_ADDRESS 0x600180B6 /end MEASUREMENT
/begin MEASUREMENT MoFTrqPtd_tqMinEmMsg "minimum permitted e-machine torque message" SWORD md_q0p1 1 100 -3276.800 3276.700 FORMAT "%8.3" ECU_ADDRESS 0x60009884 /end MEASUREMENT
/begin MEASUREMENT MoFTrqPtd_tqSelCrksftMaxEm "Maximum permitted e-machine torque according to the current operating mode, limitations from L1 and specified upper e-machine limit." SWORD md_q0p1 1 100 -3276.800 3276.700 FORMAT "%8.3" ECU_ADDRESS 0x600187D0 /end MEASUREMENT
/begin MEASUREMENT MoFTrqPtd_tqSelCrksftMaxEmCpl "RAM data redundancy of MoFTrqPtd_tqSelCrksftMaxEm" UWORD OneToOne 1 100 0.00 65535.00 FORMAT "%8.2" ECU_ADDRESS 0x600180B4 /end MEASUREMENT
/begin MEASUREMENT MoFTrqPtd_tqSelEM "maximum allowed e-maschine torque (failure free mode)" SWORD md_q0p1 1 100 -3276.800 3276.700 FORMAT "%8.3" ECU_ADDRESS 0x600187C2 /end MEASUREMENT
/begin MEASUREMENT MoFTrqPtd_tqSelEMCpl "Complement variable for MoFTrqPtd_tqSelEM" UWORD OneToOne 1 100 0.00 65535.00 FORMAT "%8.2" ECU_ADDRESS 0x600180B2 /end MEASUREMENT
/begin MEASUREMENT MoFTrqRat_ratTqPTPlaus "Plausible powertrain transmission ratio in the function monitoring" SWORD fak_q0p01 1 100 -327.6800 327.6700 FORMAT "%8.4" ECU_ADDRESS 0x60018718 /end MEASUREMENT
/begin MEASUREMENT MoFTrqRat_ratTqPTPlausCpl "Double storage for Plausible powertrain transmission ratio in the function monitoring" UWORD OneToOne 1 100 0.00 65535.00 FORMAT "%8.2" ECU_ADDRESS 0x60018008 /end MEASUREMENT
/begin MEASUREMENT MoFTrqRat_rTrqPT "Power train ratio in function monitoring" SWORD fak_q0p01 1 100 -327.6800 327.6700 FORMAT "%8.4" ECU_ADDRESS 0x6001872A /end MEASUREMENT
/begin MEASUREMENT MoFTrqRat_rTrqPTCpl "Double storage for MoFTrqRat_rTrqPT" UWORD OneToOne 1 100 0.00 65535.00 FORMAT "%8.2" ECU_ADDRESS 0x6001801A /end MEASUREMENT
/begin MEASUREMENT MoFVarPostBldSel_bbLoc1Cpl "RAM data redundancy of MoFVarPostBldSel_bbLoc1" UBYTE OneToOne 1 100 0.00 255.0 FORMAT "%5.1" ECU_ADDRESS 0x6001800C /end MEASUREMENT
/begin MEASUREMENT MoFVarPostBldSel_bbOut1Cpl "RAM data redundancy of MoFVarPostBldSel_bbOut1" UBYTE OneToOne 1 100 0.00 255.0 FORMAT "%5.1" ECU_ADDRESS 0x6001800B /end MEASUREMENT
/begin MEASUREMENT MoFVSS_v "Vehicle speed for function monitoring" SWORD vel_q0p01 1 100 -327.6800 327.6700 FORMAT "%8.4" ECU_ADDRESS 0x60018716 /end MEASUREMENT
/begin MEASUREMENT MoFVSS_vCpl "Double storage of meassurement point for vehicle speed over CAN" UWORD OneToOne 1 100 0.00 65535.00 FORMAT "%8.2" ECU_ADDRESS 0x60018006 /end MEASUREMENT
/begin MEASUREMENT MoF_rTrqPT "the power train transmission ratio in function monitoring" SWORD fak_q0p01 1 100 -327.6800 327.6700 FORMAT "%8.4" ECU_ADDRESS 0x60018728 /end MEASUREMENT
/begin MEASUREMENT MoF_rTrqPTCpl "RAM data redundancy for MoF_rTrqPT" UWORD OneToOne 1 100 0.00 65535.00 FORMAT "%8.2" ECU_ADDRESS 0x60018018 /end MEASUREMENT
/begin MEASUREMENT MoF_rTrqPtdFlt "relative permissible torque (filtered)" UBYTE rel_q0p39 1 100 0.00 99.61 FORMAT "%5.2" ECU_ADDRESS 0x600187BE /end MEASUREMENT
/begin MEASUREMENT MoF_rTrqPtdFltCpl "RAM data redundancy for MoF_rTrqPtdFlt" UBYTE OneToOne 1 100 0.00 255.0 FORMAT "%5.1" ECU_ADDRESS 0x600180AE /end MEASUREMENT
/begin MEASUREMENT MoF_stStrtMsg "state:powertrain active in function monitoring" UBYTE OneToOne 1 100 0.00 255.0 FORMAT "%5.1" ECU_ADDRESS 0x6000FBCD /end MEASUREMENT
/begin MEASUREMENT MoF_stStrtStopEnaMsg "Level 2 starter monitoring status" UBYTE OneToOne 1 100 0.00 255.0 FORMAT "%5.1" ECU_ADDRESS 0x6000FBCC /end MEASUREMENT
/begin MEASUREMENT MoF_stVar "status variant coding in the function monitoring" UBYTE OneToOne 1 100 0.00 255.0 FORMAT "%5.1" ECU_ADDRESS 0x60018726 /end MEASUREMENT
/begin MEASUREMENT MoF_stVarCpl "RAM data redundancy for MoF_stVar" UBYTE OneToOne 1 100 0.00 255.0 FORMAT "%5.1" ECU_ADDRESS 0x60018016 /end MEASUREMENT
/begin MEASUREMENT MoGlbl_bbLocExtdTskCpl "duplicate storage for MoGlbl_bbLocExtdTskCpl" UBYTE OneToOne 1 100 0.00 255.0 FORMAT "%5.1" ECU_ADDRESS 0x60018005 /end MEASUREMENT
/begin MEASUREMENT MoGlbl_vblStruct.Mo_stMoC "structure variable for instancing concept / Instance variable for Mo_stMoC" UBYTE OneToOne 1 100 0.00 255.0 FORMAT "%5.1" ECU_ADDRESS 0x60018710 /end MEASUREMENT
/begin MEASUREMENT MoGlbl_vblStructCpl.Mo_stCplChk "structure for instancing concept / Instance variable for Mo_stCplChk" ULONG OneToOne 1 100 0.00 4294967295.00 FORMAT "%13.2" ECU_ADDRESS 0x60017FF0 /end MEASUREMENT
/begin MEASUREMENT MoGlbl_vblStructCpl.Mo_stMoCCpl "structure for instancing concept / Instance variable for Mo_stMoCCpl" UBYTE OneToOne 1 100 0.00 255.0 FORMAT "%5.1" ECU_ADDRESS 0x60017FF4 /end MEASUREMENT
/begin MEASUREMENT MoGlbl_vblStructCpl_Core1_10ms_Nr1.Mo_stCplChk "Instance for specific core and task / Instance variable for Mo_stCplChk" ULONG OneToOne 1 100 0.00 4294967295.00 FORMAT "%13.2" ECU_ADDRESS 0x60018608 /end MEASUREMENT
/begin MEASUREMENT MoGlbl_vblStructCpl_Core1_10ms_Nr1.Mo_stMoCCpl "Instance for specific core and task / Instance variable for Mo_stMoCCpl" UBYTE OneToOne 1 100 0.00 255.0 FORMAT "%5.1" ECU_ADDRESS 0x6001860C /end MEASUREMENT
/begin MEASUREMENT MoGlbl_vblStruct_Core1_10ms_Nr1.Mo_stMoC "Instance for specific core and task / Instance variable for Mo_stMoC" UBYTE OneToOne 1 100 0.00 255.0 FORMAT "%5.1" ECU_ADDRESS 0x60018FF0 /end MEASUREMENT
/begin MEASUREMENT MoXAirFl_CdaIfClass_V4_I.bHemInjSync "Instance of data class for quantities in connection to Cda of function MoXAirFl_Adp / Member Variable" UBYTE B_TRUE 1 100 0.00 1.00000000000 BIT_MASK 0x1 FORMAT "%13.11" ECU_ADDRESS 0x700020F0 /end MEASUREMENT
/begin MEASUREMENT MoXAirFl_CdaIfClass_V4_I.bHmbv "Instance of data class for quantities in connection to Cda of function MoXAirFl_Adp / Member Variable" UBYTE B_TRUE 1 100 0.00 1.00000000000 BIT_MASK 0x1 FORMAT "%13.11" ECU_ADDRESS 0x700020F1 /end MEASUREMENT
/begin MEASUREMENT MoXAirFl_CdaIfClass_V4_I.bHmbzylsy "Instance of data class for quantities in connection to Cda of function MoXAirFl_Adp / Member Variable" UBYTE B_TRUE 1 100 0.00 1.00000000000 BIT_MASK 0x1 FORMAT "%13.11" ECU_ADDRESS 0x700020F2 /end MEASUREMENT
/begin MEASUREMENT MoXAirFl_CdaIfClass_V4_I.hmbcpl "Instance of data class for quantities in connection to Cda of function MoXAirFl_Adp / Member Variable" UBYTE OneToOne 1 100 0.00 255.0 FORMAT "%5.1" ECU_ADDRESS 0x700020F3 /end MEASUREMENT
/begin MEASUREMENT MoXAirFl_cntrComS0 "S0-counter of function MoXAirFl_Adp" UWORD OneToOne 1 100 0.00 65535.00 FORMAT "%8.2" ECU_ADDRESS 0x70003810 /end MEASUREMENT
/begin MEASUREMENT MoXAirFl_cntrComS0Rdnt "Redundancy for MoXAirFl_cntrComS0" UWORD OneToOne 1 100 0.00 65535.00 FORMAT "%8.2" ECU_ADDRESS 0x7000380E /end MEASUREMENT
/begin MEASUREMENT MoXAirFl_cntrComS1 "S1-counter of function MoXAirFl_Adp" UWORD OneToOne 1 100 0.00 65535.00 FORMAT "%8.2" ECU_ADDRESS 0x7000380C /end MEASUREMENT
/begin MEASUREMENT MoXAirFl_cntrComS1Rdnt "Redundancy for MoXAirFl_cntrComS1" UWORD OneToOne 1 100 0.00 65535.00 FORMAT "%8.2" ECU_ADDRESS 0x7000380A /end MEASUREMENT
/begin MEASUREMENT MoXAirFl_CtOffIfClass_V4_I.evz_auscpl "nstance of data class for quantities in connection to injection cut-off of function MoXAirFl_Adp / Member Variable" UBYTE OneToOne 1 100 0.00 255.0 FORMAT "%5.1" ECU_ADDRESS 0x700020B8 /end MEASUREMENT
/begin MEASUREMENT MoXAirFl_CtOffIfClass_V4_I.evz_auscpl_mem "nstance of data class for quantities in connection to injection cut-off of function MoXAirFl_Adp / Member Variable" UBYTE OneToOne 1 100 0.00 255.0 FORMAT "%5.1" ARRAY_SIZE 4 ECU_ADDRESS 0x700020B9 /end MEASUREMENT
/begin MEASUREMENT MoXAirFl_CtOffIfClass_V4_I.evz_austot "nstance of data class for quantities in connection to injection cut-off of function MoXAirFl_Adp / Member Variable" UBYTE OneToOne 1 100 0.00 255.0 FORMAT "%5.1" ECU_ADDRESS 0x700020BD /end MEASUREMENT
/begin MEASUREMENT MoXAirFl_CtOffIfClass_V4_I.evz_austot_mem "nstance of data class for quantities in connection to injection cut-off of function MoXAirFl_Adp / Member Variable" UBYTE OneToOne 1 100 0.00 255.0 FORMAT "%5.1" ARRAY_SIZE 4 ECU_ADDRESS 0x700020BE /end MEASUREMENT
/begin MEASUREMENT MoXAirFl_CtOffIfClass_V4_I.flgInjEnad "nstance of data class for quantities in connection to injection cut-off of function MoXAirFl_Adp / Member Variable" UBYTE B_TRUE 1 100 0.00 1.00000000000 BIT_MASK 0x1 FORMAT "%13.11" ECU_ADDRESS 0x700020C2 /end MEASUREMENT
/begin MEASUREMENT MoXAirFl_CtOffIfClass_V4_I.injTrigCylMsk "nstance of data class for quantities in connection to injection cut-off of function MoXAirFl_Adp / Member Variable" UWORD OneToOne 1 100 0.00 65535.00 FORMAT "%8.2" ECU_ADDRESS 0x700020C4 /end MEASUREMENT
/begin MEASUREMENT MoXAirFl_CtOffIfClass_V4_I.injTrigCylMskRdnt "nstance of data class for quantities in connection to injection cut-off of function MoXAirFl_Adp / Member Variable" UWORD OneToOne 1 100 0.00 65535.00 FORMAT "%8.2" ECU_ADDRESS 0x700020C6 /end MEASUREMENT
/begin MEASUREMENT MoXAirFl_CtOffIfClass_V4_I.injmode_zzylh "nstance of data class for quantities in connection to injection cut-off of function MoXAirFl_Adp / Member Variable" ULONG OneToOne 1 100 0.00 4294967295.00 FORMAT "%13.2" ECU_ADDRESS 0x700020C8 /end MEASUREMENT
/begin MEASUREMENT MoXAirFl_CtOffIfClass_V4_I.injmode_zzylh_rdnt "nstance of data class for quantities in connection to injection cut-off of function MoXAirFl_Adp / Member Variable" ULONG OneToOne 1 100 0.00 4294967295.00 FORMAT "%13.2" ECU_ADDRESS 0x700020CC /end MEASUREMENT
/begin MEASUREMENT MoXAirFl_CtOffIfClass_V4_I.injmode_zzyln "nstance of data class for quantities in connection to injection cut-off of function MoXAirFl_Adp / Member Variable" ULONG OneToOne 1 100 0.00 4294967295.00 FORMAT "%13.2" ECU_ADDRESS 0x700020D0 /end MEASUREMENT
/begin MEASUREMENT MoXAirFl_CtOffIfClass_V4_I.injmode_zzyln_rdnt "nstance of data class for quantities in connection to injection cut-off of function MoXAirFl_Adp / Member Variable" ULONG OneToOne 1 100 0.00 4294967295.00 FORMAT "%13.2" ECU_ADDRESS 0x700020D4 /end MEASUREMENT
/begin MEASUREMENT MoXAirFl_CtOffIfClass_V4_I.injmode_zzyls "nstance of data class for quantities in connection to injection cut-off of function MoXAirFl_Adp / Member Variable" ULONG OneToOne 1 100 0.00 4294967295.00 FORMAT "%13.2" ECU_ADDRESS 0x700020D8 /end MEASUREMENT
/begin MEASUREMENT MoXAirFl_CtOffIfClass_V4_I.injmode_zzyls_rdnt "nstance of data class for quantities in connection to injection cut-off of function MoXAirFl_Adp / Member Variable" ULONG OneToOne 1 100 0.00 4294967295.00 FORMAT "%13.2" ECU_ADDRESS 0x700020DC /end MEASUREMENT
/begin MEASUREMENT MoXAirFl_CtOffIfClass_V4_I.stInjPfiDeactvAry "nstance of data class for quantities in connection to injection cut-off of function MoXAirFl_Adp / Member Variable" UBYTE OneToOne 1 100 0.00 255.0 FORMAT "%5.1" ARRAY_SIZE 4 ECU_ADDRESS 0x700020E0 /end MEASUREMENT
/begin MEASUREMENT MoXAirFl_CtOffIfClass_V4_I.stInjPfiDeactvAryRdnt "nstance of data class for quantities in connection to injection cut-off of function MoXAirFl_Adp / Member Variable" UBYTE OneToOne 1 100 0.00 255.0 FORMAT "%5.1" ARRAY_SIZE 4 ECU_ADDRESS 0x700020E4 /end MEASUREMENT
/begin MEASUREMENT MoXAirFl_CtOffIfClass_V4_I.stInjPfiDeactvBkupAry "nstance of data class for quantities in connection to injection cut-off of function MoXAirFl_Adp / Member Variable" UBYTE OneToOne 1 100 0.00 255.0 FORMAT "%5.1" ARRAY_SIZE 4 ECU_ADDRESS 0x700020E8 /end MEASUREMENT
/begin MEASUREMENT MoXAirFl_CtOffIfClass_V4_I.stInjTiPfi "nstance of data class for quantities in connection to injection cut-off of function MoXAirFl_Adp / Member Variable" UBYTE OneToOne 1 100 0.00 255.0 FORMAT "%5.1" ECU_ADDRESS 0x700020EC /end MEASUREMENT
/begin MEASUREMENT MoXAirFl_CtOffIfClass_V4_I.stInjTiPfiRdnt "nstance of data class for quantities in connection to injection cut-off of function MoXAirFl_Adp / Member Variable" UBYTE OneToOne 1 100 0.00 255.0 FORMAT "%5.1" ECU_ADDRESS 0x700020ED /end MEASUREMENT
/begin MEASUREMENT MoXAirFl_FfIfClass_V4_I.B_ethgg "Instance of data class for quantities in connection to FlexFuel of function MoXAirFl_Adp / ethanol sensor, sensor value valid" UBYTE B_TRUE 1 100 0.00 1.00000000000 BIT_MASK 0x1 FORMAT "%13.11" ECU_ADDRESS 0x700020AE /end MEASUREMENT
/begin MEASUREMENT MoXAirFl_FfIfClass_V4_I.ethggRdnt "Instance of data class for quantities in connection to FlexFuel of function MoXAirFl_Adp / ethanol sensor, sensor value valid" UBYTE dez 1 100 0.00 255.0 FORMAT "%5.1" ECU_ADDRESS 0x700020AF /end MEASUREMENT
/begin MEASUREMENT MoXAirFl_FfIfClass_V4_I.facFuAdpn "Instance of data class for quantities in connection to FlexFuel of function MoXAirFl_Adp / Instance of data class for quantities in connection to FlexFuel of function MoXAirFl_Adp Member Variable" UWORD fak_uw_b2 1 100 0.00 1.999969 FORMAT "%8.6" ECU_ADDRESS 0x700020B0 /end MEASUREMENT
/begin MEASUREMENT MoXAirFl_FfIfClass_V4_I.flgEthVld "Instance of data class for quantities in connection to FlexFuel of function MoXAirFl_Adp / Instance of data class for quantities in connection to FlexFuel of function MoXAirFl_Adp Member Variable" UBYTE B_TRUE 1 100 0.00 1.00000000000 BIT_MASK 0x1 FORMAT "%13.11" ECU_ADDRESS 0x700020B2 /end MEASUREMENT
/begin MEASUREMENT MoXAirFl_FfIfClass_V4_I.stEthVldRdnt "Instance of data class for quantities in connection to FlexFuel of function MoXAirFl_Adp / Instance of data class for quantities in connection to FlexFuel of function MoXAirFl_Adp Member Variable" UBYTE OneToOne 1 100 0.00 255.0 FORMAT "%5.1" ECU_ADDRESS 0x700020B3 /end MEASUREMENT
/begin MEASUREMENT MoXAirFl_FfIfClass_V4_I.stFuAdpnRdnt "Instance of data class for quantities in connection to FlexFuel of function MoXAirFl_Adp / Instance of data class for quantities in connection to FlexFuel of function MoXAirFl_Adp Member Variable" UWORD dez 1 100 0.00 65535.00 FORMAT "%8.2" ECU_ADDRESS 0x700020B4 /end MEASUREMENT
/begin MEASUREMENT MoXAirFl_InjTmngIfClass_V4_I.bdemod "Instance of data class for quantities in connection to injection timing of function MoXAirFl_Adp / Member Variable" UBYTE OneToOne 1 100 0.00 255.0 FORMAT "%5.1" ECU_ADDRESS 0x700020A2 /end MEASUREMENT
/begin MEASUREMENT MoXAirFl_InjTmngIfClass_V4_I.bdemodRdnt "Instance of data class for quantities in connection to injection timing of function MoXAirFl_Adp / Member Variable" UBYTE OneToOne 1 100 0.00 255.0 FORMAT "%5.1" ECU_ADDRESS 0x700020A3 /end MEASUREMENT
/begin MEASUREMENT MoXAirFl_InjTmngIfClass_V4_I.cntrCylAdv "Instance of data class for quantities in connection to injection timing of function MoXAirFl_Adp / SW-cylinder counter doubled range for Extended Monitoring" UBYTE OneToOne 1 100 0.00 255.0 FORMAT "%5.1" ECU_ADDRESS 0x700020A4 /end MEASUREMENT
/begin MEASUREMENT MoXAirFl_InjTmngIfClass_V4_I.cntrCylAdvRdnt "Instance of data class for quantities in connection to injection timing of function MoXAirFl_Adp / SW-cylinder counter doubled range redundant for Extended Monitoring" UBYTE OneToOne 1 100 0.00 255.0 FORMAT "%5.1" ECU_ADDRESS 0x700020A5 /end MEASUREMENT
/begin MEASUREMENT MoXAirFl_InjTmngIfClass_V4_I.stInjTmng "Instance of data class for quantities in connection to injection timing of function MoXAirFl_Adp / Member Variable" UBYTE OneToOne 1 100 0.00 255.0 FORMAT "%5.1" ECU_ADDRESS 0x700020A6 /end MEASUREMENT
/begin MEASUREMENT MoXAirFl_InjTmngIfClass_V4_I.stInjTmngRdnt "Instance of data class for quantities in connection to injection timing of function MoXAirFl_Adp / Member Variable" UBYTE OneToOne 1 100 0.00 255.0 FORMAT "%5.1" ECU_ADDRESS 0x700020A7 /end MEASUREMENT
/begin MEASUREMENT MoXAirFl_InjTmngIfClass_V4_I.zzylh "Instance of data class for quantities in connection to injection timing of function MoXAirFl_Adp / Member Variable" UBYTE OneToOne 1 100 0.00 11.00 FORMAT "%5.2" ECU_ADDRESS 0x700020A8 /end MEASUREMENT
/begin MEASUREMENT MoXAirFl_InjTmngIfClass_V4_I.zzylhRdnt "Instance of data class for quantities in connection to injection timing of function MoXAirFl_Adp / Member Variable" UBYTE OneToOne 1 100 0.00 255.0 FORMAT "%5.1" ECU_ADDRESS 0x700020A9 /end MEASUREMENT
/begin MEASUREMENT MoXAirFl_InjTmngIfClass_V4_I.zzylnsp "Instance of data class for quantities in connection to injection timing of function MoXAirFl_Adp / Member Variable" UBYTE OneToOne 1 100 0.00 11.00 FORMAT "%5.2" ECU_ADDRESS 0x700020AA /end MEASUREMENT
/begin MEASUREMENT MoXAirFl_InjTmngIfClass_V4_I.zzylnspRdnt "Instance of data class for quantities in connection to injection timing of function MoXAirFl_Adp / Member Variable" UBYTE OneToOne 1 100 0.00 255.0 FORMAT "%5.1" ECU_ADDRESS 0x700020AB /end MEASUREMENT
/begin MEASUREMENT MoXAirFl_InjTmngIfClass_V4_I.zzyls "Instance of data class for quantities in connection to injection timing of function MoXAirFl_Adp / Member Variable" UBYTE OneToOne 1 100 0.00 11.00 FORMAT "%5.2" ECU_ADDRESS 0x700020AC /end MEASUREMENT
/begin MEASUREMENT MoXAirFl_InjTmngIfClass_V4_I.zzylsRdnt "Instance of data class for quantities in connection to injection timing of function MoXAirFl_Adp / Member Variable" UBYTE OneToOne 1 100 0.00 255.0 FORMAT "%5.1" ECU_ADDRESS 0x700020AD /end MEASUREMENT
/begin MEASUREMENT MoXAirFl_MixMngtIfClass_V4_I.B_afimreq "Instance of data class for quantities in connection to mixture management of function MoXAirFl_Adp / Member Variable" UBYTE B_TRUE 1 100 0.00 1.00000000000 BIT_MASK 0x1 FORMAT "%13.11" ECU_ADDRESS 0x70001FD8 /end MEASUREMENT
/begin MEASUREMENT MoXAirFl_MixMngtIfClass_V4_I.facLamCtlPfiAry "Instance of data class for quantities in connection to mixture management of function MoXAirFl_Adp / Member Variable" UWORD fak_uw_b2 1 100 0.00 1.999969 FORMAT "%8.6" ARRAY_SIZE 4 ECU_ADDRESS 0x70001FDA /end MEASUREMENT
/begin MEASUREMENT MoXAirFl_MixMngtIfClass_V4_I.facLamCtlPfiAryRdnt "Instance of data class for quantities in connection to mixture management of function MoXAirFl_Adp / Member Variable" UWORD OneToOne 1 100 0.00 65535.00 FORMAT "%8.2" ARRAY_SIZE 4 ECU_ADDRESS 0x70001FE2 /end MEASUREMENT
/begin MEASUREMENT MoXAirFl_MixMngtIfClass_V4_I.facLamCtlPfiBkupAry "Instance of data class for quantities in connection to mixture management of function MoXAirFl_Adp / Member Variable" UWORD fak_uw_b2 1 100 0.00 1.999969 FORMAT "%8.6" ARRAY_SIZE 4 ECU_ADDRESS 0x70001FEA /end MEASUREMENT
/begin MEASUREMENT MoXAirFl_MixMngtIfClass_V4_I.facMixCorrnLivc "Instance of data class for quantities in connection to mixture management of function MoXAirFl_Adp / Adaption factor Atkinson gasoline backflow for Extended Monitoring" UWORD fak_uw_b2 1 100 0.00 1.999969 FORMAT "%8.6" ECU_ADDRESS 0x70001FF2 /end MEASUREMENT
/begin MEASUREMENT MoXAirFl_MixMngtIfClass_V4_I.facPcPfiRest "Instance of data class for quantities in connection to mixture management of function MoXAirFl_Adp / Member Variable" UWORD fak_uw_b64 1 100 0.00 63.99902 FORMAT "%8.5" ECU_ADDRESS 0x70001FF4 /end MEASUREMENT
/begin MEASUREMENT MoXAirFl_MixMngtIfClass_V4_I.facPcRest "Instance of data class for quantities in connection to mixture management of function MoXAirFl_Adp / Member Variable" UWORD fak_uw_b64 1 100 0.00 63.99902 FORMAT "%8.5" ECU_ADDRESS 0x70001FF6 /end MEASUREMENT
/begin MEASUREMENT MoXAirFl_MixMngtIfClass_V4_I.facPrtnPfi "Instance of data class for quantities in connection to mixture management of function MoXAirFl_Adp / Member Variable" UBYTE fak_ub_b1 1 100 0.00 0.9961 ECU_ADDRESS 0x70001FF8 /end MEASUREMENT
/begin MEASUREMENT MoXAirFl_MixMngtIfClass_V4_I.facPrtnPfiAry "Instance of data class for quantities in connection to mixture management of function MoXAirFl_Adp / Member Variable" UBYTE fak_ub_b1 1 100 0.00 0.9961 ARRAY_SIZE 4 ECU_ADDRESS 0x70001FF9 /end MEASUREMENT
/begin MEASUREMENT MoXAirFl_MixMngtIfClass_V4_I.facPrtnPfiAryRdnt "Instance of data class for quantities in connection to mixture management of function MoXAirFl_Adp / Member Variable" UBYTE OneToOne 1 100 0.00 255.0 FORMAT "%5.1" ARRAY_SIZE 4 ECU_ADDRESS 0x70001FFD /end MEASUREMENT
/begin MEASUREMENT MoXAirFl_MixMngtIfClass_V4_I.facPrtnPfiBkupAry "Instance of data class for quantities in connection to mixture management of function MoXAirFl_Adp / Member Variable" UBYTE fak_ub_b1 1 100 0.00 0.9961 ARRAY_SIZE 4 ECU_ADDRESS 0x70002001 /end MEASUREMENT
/begin MEASUREMENT MoXAirFl_MixMngtIfClass_V4_I.ffuevali "Instance of data class for quantities in connection to mixture management of function MoXAirFl_Adp / Member Variable" UWORD fak_uw_b64 1 100 0.00 63.99902 FORMAT "%8.5" ECU_ADDRESS 0x70002006 /end MEASUREMENT
/begin MEASUREMENT MoXAirFl_MixMngtIfClass_V4_I.ffuevalipfi "Instance of data class for quantities in connection to mixture management of function MoXAirFl_Adp / Member Variable" UWORD fak_uw_b64 1 100 0.00 63.99902 FORMAT "%8.5" ECU_ADDRESS 0x70002008 /end MEASUREMENT
/begin MEASUREMENT MoXAirFl_MixMngtIfClass_V4_I.fkrkAry "Instance of data class for quantities in connection to mixture management of function MoXAirFl_Adp / Member Variable" UWORD fak_uw_b2 1 100 0.00 1.999969 FORMAT "%8.6" ARRAY_SIZE 4 ECU_ADDRESS 0x7000200A /end MEASUREMENT
/begin MEASUREMENT MoXAirFl_MixMngtIfClass_V4_I.fkrkPfiAry "Instance of data class for quantities in connection to mixture management of function MoXAirFl_Adp / Member Variable" UWORD fak_uw_b2 1 100 0.00 1.999969 FORMAT "%8.6" ARRAY_SIZE 4 ECU_ADDRESS 0x70002012 /end MEASUREMENT
/begin MEASUREMENT MoXAirFl_MixMngtIfClass_V4_I.fkrkPfiAryRdnt "Instance of data class for quantities in connection to mixture management of function MoXAirFl_Adp / Member Variable" UWORD OneToOne 1 100 0.00 65535.00 FORMAT "%8.2" ARRAY_SIZE 4 ECU_ADDRESS 0x7000201A /end MEASUREMENT
/begin MEASUREMENT MoXAirFl_MixMngtIfClass_V4_I.fnsad "Instance of data class for quantities in connection to mixture management of function MoXAirFl_Adp / Member Variable" UWORD fak_uw_b2 1 100 0.00 1.999969 FORMAT "%8.6" ECU_ADDRESS 0x70002022 /end MEASUREMENT
/begin MEASUREMENT MoXAirFl_MixMngtIfClass_V4_I.fr "Instance of data class for quantities in connection to mixture management of function MoXAirFl_Adp / Member Variable" UWORD fak_uw_b2 1 100 0.00 1.999969 FORMAT "%8.6" ECU_ADDRESS 0x70002024 /end MEASUREMENT
/begin MEASUREMENT MoXAirFl_MixMngtIfClass_V4_I.fr2 "Instance of data class for quantities in connection to mixture management of function MoXAirFl_Adp / Member Variable" UWORD fak_uw_b2 1 100 0.00 1.999969 FORMAT "%8.6" ECU_ADDRESS 0x70002026 /end MEASUREMENT
/begin MEASUREMENT MoXAirFl_MixMngtIfClass_V4_I.fragdi "Instance of data class for quantities in connection to mixture management of function MoXAirFl_Adp / Member Variable" UWORD fak_uw_b2 1 100 0.00 1.999969 FORMAT "%8.6" ECU_ADDRESS 0x70002028 /end MEASUREMENT
/begin MEASUREMENT MoXAirFl_MixMngtIfClass_V4_I.fragdi2 "Instance of data class for quantities in connection to mixture management of function MoXAirFl_Adp / Member Variable" UWORD fak_uw_b2 1 100 0.00 1.999969 FORMAT "%8.6" ECU_ADDRESS 0x7000202A /end MEASUREMENT
/begin MEASUREMENT MoXAirFl_MixMngtIfClass_V4_I.frapfi "Instance of data class for quantities in connection to mixture management of function MoXAirFl_Adp / Member Variable" UWORD fak_uw_b2 1 100 0.00 1.999969 FORMAT "%8.6" ECU_ADDRESS 0x7000202C /end MEASUREMENT
/begin MEASUREMENT MoXAirFl_MixMngtIfClass_V4_I.frapfi2 "Instance of data class for quantities in connection to mixture management of function MoXAirFl_Adp / Member Variable" UWORD fak_uw_b2 1 100 0.00 1.999969 FORMAT "%8.6" ECU_ADDRESS 0x7000202E /end MEASUREMENT
/begin MEASUREMENT MoXAirFl_MixMngtIfClass_V4_I.lamsbg "Instance of data class for quantities in connection to mixture management of function MoXAirFl_Adp / Member Variable" UWORD fak_uw_b16 1 100 0.00 15.99976 FORMAT "%8.5" ECU_ADDRESS 0x70002030 /end MEASUREMENT
/begin MEASUREMENT MoXAirFl_MixMngtIfClass_V4_I.lamsbg2 "Instance of data class for quantities in connection to mixture management of function MoXAirFl_Adp / Member Variable" UWORD fak_uw_b16 1 100 0.00 15.99976 FORMAT "%8.5" ECU_ADDRESS 0x70002032 /end MEASUREMENT
/begin MEASUREMENT MoXAirFl_MixMngtIfClass_V4_I.rCtlPriB1 "Instance of data class for quantities in connection to mixture management of function MoXAirFl_Adp / Member Variable" SWORD fak_sw_b1 1 100 -1.000000 0.999969 FORMAT "%8.6" ECU_ADDRESS 0x70002034 /end MEASUREMENT
/begin MEASUREMENT MoXAirFl_MixMngtIfClass_V4_I.rCtlPriB2 "Instance of data class for quantities in connection to mixture management of function MoXAirFl_Adp / Member Variable" SWORD fak_sw_b1 1 100 -1.000000 0.999969 FORMAT "%8.6" ECU_ADDRESS 0x70002036 /end MEASUREMENT
/begin MEASUREMENT MoXAirFl_MixMngtIfClass_V4_I.ratFuMCylInd "Instance of data class for quantities in connection to mixture management of function MoXAirFl_Adp / Member Variable" UWORD rel_uw_b3072 1 100 0.00 3071.953 FORMAT "%8.3" ECU_ADDRESS 0x70002038 /end MEASUREMENT
/begin MEASUREMENT MoXAirFl_MixMngtIfClass_V4_I.ratFuMGdi "Instance of data class for quantities in connection to mixture management of function MoXAirFl_Adp / Member Variable" UWORD rel_uw_b3072 1 100 0.00 3071.953 FORMAT "%8.3" ECU_ADDRESS 0x7000203A /end MEASUREMENT
/begin MEASUREMENT MoXAirFl_MixMngtIfClass_V4_I.ratFuMGdiBnk2 "Instance of data class for quantities in connection to mixture management of function MoXAirFl_Adp / Member Variable" UWORD rel_uw_b3072 1 100 0.00 3071.953 FORMAT "%8.3" ECU_ADDRESS 0x7000203C /end MEASUREMENT
/begin MEASUREMENT MoXAirFl_MixMngtIfClass_V4_I.ratFuMLivc "Instance of data class for quantities in connection to mixture management of function MoXAirFl_Adp / Cylinder-individual Atkinson fuel amount for Extended monitoring" UWORD rel_uw_b3072 1 100 0.00 3071.953 FORMAT "%8.3" ECU_ADDRESS 0x7000203E /end MEASUREMENT
/begin MEASUREMENT MoXAirFl_MixMngtIfClass_V4_I.ratFuMLivcRdnt "Instance of data class for quantities in connection to mixture management of function MoXAirFl_Adp / Cylinder-individual Atkinson fuel amount (ones complement) for Extended Monitoring" UWORD OneToOne 1 100 0.00 65535.00 FORMAT "%8.2" ECU_ADDRESS 0x70002040 /end MEASUREMENT
/begin MEASUREMENT MoXAirFl_MixMngtIfClass_V4_I.ratFuMPfi "Instance of data class for quantities in connection to mixture management of function MoXAirFl_Adp / Member Variable" UWORD rel_uw_b3072 1 100 0.00 3071.953 FORMAT "%8.3" ECU_ADDRESS 0x70002042 /end MEASUREMENT
/begin MEASUREMENT MoXAirFl_MixMngtIfClass_V4_I.ratFuMPfiBnk2 "Instance of data class for quantities in connection to mixture management of function MoXAirFl_Adp / Member Variable" UWORD rel_uw_b3072 1 100 0.00 3071.953 FORMAT "%8.3" ECU_ADDRESS 0x70002044 /end MEASUREMENT
/begin MEASUREMENT MoXAirFl_MixMngtIfClass_V4_I.ratFuPrtnPfiInjAry "Instance of data class for quantities in connection to mixture management of function MoXAirFl_Adp / Member Variable" UWORD rel_uw_b3072 1 100 0.00 3071.953 FORMAT "%8.3" ARRAY_SIZE 4 ECU_ADDRESS 0x70002046 /end MEASUREMENT
/begin MEASUREMENT MoXAirFl_MixMngtIfClass_V4_I.ratFuPrtnPfiInjAryRdnt "Instance of data class for quantities in connection to mixture management of function MoXAirFl_Adp / Member Variable" UWORD OneToOne 1 100 0.00 65535.00 FORMAT "%8.2" ARRAY_SIZE 4 ECU_ADDRESS 0x7000204E /end MEASUREMENT
/begin MEASUREMENT MoXAirFl_MixMngtIfClass_V4_I.ratFuPrtnPfiInjBkupAry "Instance of data class for quantities in connection to mixture management of function MoXAirFl_Adp / Member Variable" UWORD rel_uw_b3072 1 100 0.00 3071.953 FORMAT "%8.3" ARRAY_SIZE 4 ECU_ADDRESS 0x70002056 /end MEASUREMENT
/begin MEASUREMENT MoXAirFl_MixMngtIfClass_V4_I.ratPrdcAirPrtnPfiAry "Instance of data class for quantities in connection to mixture management of function MoXAirFl_Adp / Member Variable" UWORD rel_uw_q0p0234 1 100 0.00 1535.977 FORMAT "%8.3" ARRAY_SIZE 4 ECU_ADDRESS 0x7000205E /end MEASUREMENT
/begin MEASUREMENT MoXAirFl_MixMngtIfClass_V4_I.ratPrdcAirPrtnPfiAryRdnt "Instance of data class for quantities in connection to mixture management of function MoXAirFl_Adp / Member Variable" UWORD OneToOne 1 100 0.00 65535.00 FORMAT "%8.2" ARRAY_SIZE 4 ECU_ADDRESS 0x70002066 /end MEASUREMENT
/begin MEASUREMENT MoXAirFl_MixMngtIfClass_V4_I.ratPrdcAirPrtnPfiBkupAry "Instance of data class for quantities in connection to mixture management of function MoXAirFl_Adp / Member Variable" UWORD rel_uw_q0p0234 1 100 0.00 1535.977 FORMAT "%8.3" ARRAY_SIZE 4 ECU_ADDRESS 0x7000206E /end MEASUREMENT
/begin MEASUREMENT MoXAirFl_MixMngtIfClass_V4_I.rkagdi "Instance of data class for quantities in connection to mixture management of function MoXAirFl_Adp / Member Variable" SWORD rel_sw_b1536 1 100 -1536.000 1535.953 FORMAT "%8.3" ECU_ADDRESS 0x70002076 /end MEASUREMENT
/begin MEASUREMENT MoXAirFl_MixMngtIfClass_V4_I.rkagdi2 "Instance of data class for quantities in connection to mixture management of function MoXAirFl_Adp / Member Variable" SWORD rel_sw_b1536 1 100 -1536.000 1535.953 FORMAT "%8.3" ECU_ADDRESS 0x70002078 /end MEASUREMENT
/begin MEASUREMENT MoXAirFl_MixMngtIfClass_V4_I.rkapfi "Instance of data class for quantities in connection to mixture management of function MoXAirFl_Adp / Member Variable" SWORD rel_sw_b1536 1 100 -1536.000 1535.953 FORMAT "%8.3" ECU_ADDRESS 0x7000207A /end MEASUREMENT
/begin MEASUREMENT MoXAirFl_MixMngtIfClass_V4_I.rkapfi2 "Instance of data class for quantities in connection to mixture management of function MoXAirFl_Adp / Member Variable" SWORD rel_sw_b1536 1 100 -1536.000 1535.953 FORMAT "%8.3" ECU_ADDRESS 0x7000207C /end MEASUREMENT
/begin MEASUREMENT MoXAirFl_MixMngtIfClass_V4_I.rkausg "Instance of data class for quantities in connection to mixture management of function MoXAirFl_Adp / Member Variable" SWORD rel_sw_b1536 1 100 -1536.000 1535.953 FORMAT "%8.3" ECU_ADDRESS 0x7000207E /end MEASUREMENT
/begin MEASUREMENT MoXAirFl_MixMngtIfClass_V4_I.rkte "Instance of data class for quantities in connection to mixture management of function MoXAirFl_Adp / Member Variable" SWORD rel_sw_b1536 1 100 -1536.000 1535.953 FORMAT "%8.3" ECU_ADDRESS 0x70002080 /end MEASUREMENT
/begin MEASUREMENT MoXAirFl_MixMngtIfClass_V4_I.rkteBnk1 "Instance of data class for quantities in connection to mixture management of function MoXAirFl_Adp / Member Variable" SWORD rel_sw_b1536 1 100 -1536.000 1535.953 FORMAT "%8.3" ECU_ADDRESS 0x70002082 /end MEASUREMENT
/begin MEASUREMENT MoXAirFl_MixMngtIfClass_V4_I.rkteBnk2 "Instance of data class for quantities in connection to mixture management of function MoXAirFl_Adp / Member Variable" SWORD rel_sw_b1536 1 100 -1536.000 1535.953 FORMAT "%8.3" ECU_ADDRESS 0x70002084 /end MEASUREMENT
/begin MEASUREMENT MoXAirFl_MixMngtIfClass_V4_I.rkukg "Instance of data class for quantities in connection to mixture management of function MoXAirFl_Adp / Member Variable" SWORD rel_sw_b1536 1 100 -1536.000 1535.953 FORMAT "%8.3" ECU_ADDRESS 0x70002086 /end MEASUREMENT
/begin MEASUREMENT MoXAirFl_MixMngtIfClass_V4_I.rkukgpfi "Instance of data class for quantities in connection to mixture management of function MoXAirFl_Adp / Member Variable" SWORD rel_sw_b1536 1 100 -1536.000 1535.953 FORMAT "%8.3" ECU_ADDRESS 0x70002088 /end MEASUREMENT
/begin MEASUREMENT MoXAirFl_MixMngtIfClass_V4_I.rlfg "Instance of data class for quantities in connection to mixture management of function MoXAirFl_Adp / Member Variable" UWORD rel_uw_q0p0234 1 100 0.00 1535.977 FORMAT "%8.3" ECU_ADDRESS 0x7000208A /end MEASUREMENT
/begin MEASUREMENT MoXAirFl_MixMngtIfClass_V4_I.rlfgBnk1 "Instance of data class for quantities in connection to mixture management of function MoXAirFl_Adp / Member Variable" UWORD rel_uw_q0p0234 1 100 0.00 1535.977 FORMAT "%8.3" ECU_ADDRESS 0x7000208C /end MEASUREMENT
/begin MEASUREMENT MoXAirFl_MixMngtIfClass_V4_I.rlfgBnk2 "Instance of data class for quantities in connection to mixture management of function MoXAirFl_Adp / Member Variable" UWORD rel_uw_q0p0234 1 100 0.00 1535.977 FORMAT "%8.3" ECU_ADDRESS 0x7000208E /end MEASUREMENT
/begin MEASUREMENT MoXAirFl_MixMngtIfClass_V4_I.rlp "Instance of data class for quantities in connection to mixture management of function MoXAirFl_Adp / Member Variable" UWORD rel_uw_q0p0234 1 100 0.00 1535.977 FORMAT "%8.3" ECU_ADDRESS 0x70002090 /end MEASUREMENT
/begin MEASUREMENT MoXAirFl_MixMngtIfClass_V4_I.rlpBnk1 "Instance of data class for quantities in connection to mixture management of function MoXAirFl_Adp / Member Variable" UWORD rel_uw_q0p0234 1 100 0.00 1535.977 FORMAT "%8.3" ECU_ADDRESS 0x70002092 /end MEASUREMENT
/begin MEASUREMENT MoXAirFl_MixMngtIfClass_V4_I.rlpBnk2 "Instance of data class for quantities in connection to mixture management of function MoXAirFl_Adp / Member Variable" UWORD rel_uw_q0p0234 1 100 0.00 1535.977 FORMAT "%8.3" ECU_ADDRESS 0x70002094 /end MEASUREMENT
/begin MEASUREMENT MoXAirFl_MixMngtIfClass_V4_I.rlrext "Instance of data class for quantities in connection to mixture management of function MoXAirFl_Adp / Member Variable" UWORD rel_uw_q0p0234 1 100 0.00 1535.977 FORMAT "%8.3" ECU_ADDRESS 0x70002096 /end MEASUREMENT
/begin MEASUREMENT MoXAirFl_MixMngtIfClass_V4_I.rlrextBnk1 "Instance of data class for quantities in connection to mixture management of function MoXAirFl_Adp / Member Variable" UWORD rel_uw_q0p0234 1 100 0.00 1535.977 FORMAT "%8.3" ECU_ADDRESS 0x70002098 /end MEASUREMENT
/begin MEASUREMENT MoXAirFl_MixMngtIfClass_V4_I.rlrextBnk2 "Instance of data class for quantities in connection to mixture management of function MoXAirFl_Adp / Member Variable" UWORD rel_uw_q0p0234 1 100 0.00 1535.977 FORMAT "%8.3" ECU_ADDRESS 0x7000209A /end MEASUREMENT
/begin MEASUREMENT MoXAirFl_MixMngtIfClass_V4_I.rlrint "Instance of data class for quantities in connection to mixture management of function MoXAirFl_Adp / Member Variable" UWORD rel_uw_q0p0234 1 100 0.00 1535.977 FORMAT "%8.3" ECU_ADDRESS 0x7000209C /end MEASUREMENT
/begin MEASUREMENT MoXAirFl_MixMngtIfClass_V4_I.rlrintBnk1 "Instance of data class for quantities in connection to mixture management of function MoXAirFl_Adp / Member Variable" UWORD rel_uw_q0p0234 1 100 0.00 1535.977 FORMAT "%8.3" ECU_ADDRESS 0x7000209E /end MEASUREMENT
/begin MEASUREMENT MoXAirFl_MixMngtIfClass_V4_I.rlrintBnk2 "Instance of data class for quantities in connection to mixture management of function MoXAirFl_Adp / Member Variable" UWORD rel_uw_q0p0234 1 100 0.00 1535.977 FORMAT "%8.3" ECU_ADDRESS 0x700020A0 /end MEASUREMENT
/begin MEASUREMENT MoXAirFl_TrqActIfClass_V4_I.agIntkClsd "Instance of data class for quantities in connection to actual torque of function MoXAirFl_Adp / Actual position intake valve closed for extended monitoring" SWORD kw_q0p0156 1 100 -512.0000 511.9844 FORMAT "%8.4" ARRAY_SIZE 5 ECU_ADDRESS 0x70001FA0 /end MEASUREMENT
/begin MEASUREMENT MoXAirFl_TrqActIfClass_V4_I.agIntkClsdCpl "Instance of data class for quantities in connection to actual torque of function MoXAirFl_Adp / Actual position intake valve closed redundantly (ones complement) for extended monitoring" UWORD OneToOne 1 100 0.00 65535.00 FORMAT "%8.2" ARRAY_SIZE 5 ECU_ADDRESS 0x70001FAA /end MEASUREMENT
/begin MEASUREMENT MoXAirFl_TrqActIfClass_V4_I.etaaufte "Instance of data class for quantities in connection to actual torque of function MoXAirFl_Adp / Member Variable" UWORD fak_uw_b2 1 100 0.00 1.999969 FORMAT "%8.6" ECU_ADDRESS 0x70001FB4 /end MEASUREMENT
/begin MEASUREMENT MoXAirFl_TrqActIfClass_V4_I.etazwist "Instance of data class for quantities in connection to actual torque of function MoXAirFl_Adp / Member Variable" UWORD fak_uw_b2 1 100 0.00 1.999969 FORMAT "%8.6" ECU_ADDRESS 0x70001FB6 /end MEASUREMENT
/begin MEASUREMENT MoXAirFl_TrqActIfClass_V4_I.etazwistm "Instance of data class for quantities in connection to actual torque of function MoXAirFl_Adp / Member Variable" UWORD fak_uw_b2 1 100 0.00 1.999969 FORMAT "%8.6" ECU_ADDRESS 0x70001FB8 /end MEASUREMENT
/begin MEASUREMENT MoXAirFl_TrqActIfClass_V4_I.miist "Instance of data class for quantities in connection to actual torque of function MoXAirFl_Adp / Indicated real engine torque" UWORD rel_uw_b100 1 100 0.00 99.99847 FORMAT "%8.5" ECU_ADDRESS 0x70001FBA /end MEASUREMENT
/begin MEASUREMENT MoXAirFl_TrqActIfClass_V4_I.zwcalcar "Instance of data class for quantities in connection to actual torque of function MoXAirFl_Adp / Member Variable" SWORD zw_q0p05 1 100 -1638.400 1638.350 FORMAT "%8.3" ARRAY_SIZE 4 ECU_ADDRESS 0x70001FBC /end MEASUREMENT
/begin MEASUREMENT MoXAirFl_TrqActIfClass_V4_I.zwcalcar_zzylzue "Instance of data class for quantities in connection to actual torque of function MoXAirFl_Adp / Member Variable" SBYTE zw_sb_q0p75 1 100 -96.00 95.25 FORMAT "%5.2" ECU_ADDRESS 0x70001FC4 /end MEASUREMENT
/begin MEASUREMENT MoXAirFl_TrqActIfClass_V4_I.zwcalcarcp "Instance of data class for quantities in connection to actual torque of function MoXAirFl_Adp / Member Variable" UWORD OneToOne 1 100 0.00 65535.00 FORMAT "%8.2" ARRAY_SIZE 4 ECU_ADDRESS 0x70001FC6 /end MEASUREMENT
/begin MEASUREMENT MoXAirFl_TrqActIfClass_V4_I.zwopt "Instance of data class for quantities in connection to actual torque of function MoXAirFl_Adp / Member Variable" SWORD zw_q0p05 1 100 -1638.400 1638.350 FORMAT "%8.3" ECU_ADDRESS 0x70001FCE /end MEASUREMENT
/begin MEASUREMENT MoXAirFl_TrqActIfClass_V4_I.zwout "Instance of data class for quantities in connection to actual torque of function MoXAirFl_Adp / Member Variable" SBYTE zw_sb_q0p75 1 100 -96.00 95.25 FORMAT "%5.2" ECU_ADDRESS 0x70001FD0 /end MEASUREMENT
/begin MEASUREMENT MoXAirFl_TrqActIfClass_V4_I.zwoutcpl "Instance of data class for quantities in connection to actual torque of function MoXAirFl_Adp / Member Variable" UBYTE OneToOne 1 100 0.00 255.0 FORMAT "%5.1" ECU_ADDRESS 0x70001FD1 /end MEASUREMENT
/begin MEASUREMENT MoXAirFl_TrqActIfClass_V4_I.zwouthiresl "Instance of data class for quantities in connection to actual torque of function MoXAirFl_Adp / Instance of data class for quantities in connection to actual torque of function MoXAirFl_Adp Member Variable" SWORD zw_q0p1 1 100 -3276.800 3276.700 FORMAT "%8.3" ECU_ADDRESS 0x70001FD2 /end MEASUREMENT
/begin MEASUREMENT MoXAirFl_TrqActIfClass_V4_I.zwouthireslAry_zzylzue "Instance of data class for quantities in connection to actual torque of function MoXAirFl_Adp / Instance of data class for quantities in connection to actual torque of function MoXAirFl_Adp Member Variable" SWORD zw_q0p1 1 100 -3276.800 3276.700 FORMAT "%8.3" ECU_ADDRESS 0x70001FD4 /end MEASUREMENT
/begin MEASUREMENT MoXAirFl_TrqActIfClass_V4_I.zwouthireslRdnt "Instance of data class for quantities in connection to actual torque of function MoXAirFl_Adp / Instance of data class for quantities in connection to actual torque of function MoXAirFl_Adp Member Variable" UWORD OneToOne 1 100 0.00 65535.00 FORMAT "%8.2" ECU_ADDRESS 0x70001FD6 /end MEASUREMENT
/begin MEASUREMENT MoXEMM_stEMMAlrms "Status of EMM alarms of MoCEMM_stEmmAlrms" ULONG OneToOne 1 100 0.00 4294967295.00 FORMAT "%13.2" ARRAY_SIZE 22 ECU_ADDRESS 0x50001B80 /end MEASUREMENT
/begin MEASUREMENT MoXEMM_stEMMAlrmsAftRst "Status of EMM alarms after initialization (read out of hardware register)" ULONG OneToOne 1 100 0.00 4294967295.00 FORMAT "%13.2" ARRAY_SIZE 22 ECU_ADDRESS 0x50001BD8 /end MEASUREMENT
/begin MEASUREMENT MoXEMM_stHwLTResult "Status of Hardware Logic Test errors after initialization" ULONG OneToOne 1 100 0.00 4294967295.00 FORMAT "%13.2" ECU_ADDRESS 0x600026BC /end MEASUREMENT
/begin MEASUREMENT MoXFrm_Buf_AYCF "MoX receive buffer for AYCF" UBYTE OneToOne 1 100 0.00 255.0 FORMAT "%5.1" ARRAY_SIZE 8 ECU_ADDRESS 0x6000B6F4 /end MEASUREMENT
/begin MEASUREMENT MoXFrm_Buf_EAT1 "MoX receive buffer for EAT1" UBYTE OneToOne 1 100 0.00 255.0 FORMAT "%5.1" ARRAY_SIZE 8 ECU_ADDRESS 0x6000B6EC /end MEASUREMENT
/begin MEASUREMENT MoXFrm_Buf_EAT12 "MoX receive buffer for EAT12" UBYTE OneToOne 1 100 0.00 255.0 FORMAT "%5.1" ARRAY_SIZE 2 ECU_ADDRESS 0x6000B6EA /end MEASUREMENT
/begin MEASUREMENT MoXFrm_Buf_EAT13 "MoX receive buffer for EAT13" UBYTE OneToOne 1 100 0.00 255.0 FORMAT "%5.1" ARRAY_SIZE 3 ECU_ADDRESS 0x6000B6E7 /end MEASUREMENT
/begin MEASUREMENT MoXFrm_Buf_EAT4 "MoX receive buffer for EAT4" UBYTE OneToOne 1 100 0.00 255.0 FORMAT "%5.1" ARRAY_SIZE 8 ECU_ADDRESS 0x6000B6DF /end MEASUREMENT
/begin MEASUREMENT MoXFrm_Buf_EATB "MoX receive buffer for EATB" UBYTE OneToOne 1 100 0.00 255.0 FORMAT "%5.1" ARRAY_SIZE 8 ECU_ADDRESS 0x6000B6D7 /end MEASUREMENT
/begin MEASUREMENT MoXFrm_Buf_ENGA "ENGA MoX Buffer" UBYTE OneToOne 1 100 0.00 255.0 FORMAT "%5.1" ARRAY_SIZE 8 ECU_ADDRESS 0x6000B6CF /end MEASUREMENT
/begin MEASUREMENT MoXFrm_Buf_GWIMG3 "MoX receive buffer for GWIMG3" UBYTE OneToOne 1 100 0.00 255.0 FORMAT "%5.1" ARRAY_SIZE 8 ECU_ADDRESS 0x6000B6C7 /end MEASUREMENT
/begin MEASUREMENT MoXFrm_Buf_META "MoX receive buffer for META" UBYTE OneToOne 1 100 0.00 255.0 FORMAT "%5.1" ARRAY_SIZE 8 ECU_ADDRESS 0x6000B6BF /end MEASUREMENT
/begin MEASUREMENT MoXFrm_Buf_METL "MoX receive buffer for METL" UBYTE OneToOne 1 100 0.00 255.0 FORMAT "%5.1" ARRAY_SIZE 4 ECU_ADDRESS 0x6000B6BB /end MEASUREMENT
/begin MEASUREMENT MoXFrm_flgUpdAYCF "Info of updated CAN Data of AYCF" UBYTE B_TRUE 1 100 0.00 1.00000000000 BIT_MASK 0x1 FORMAT "%13.11" ECU_ADDRESS 0x6000B6BA /end MEASUREMENT
/begin MEASUREMENT MoXFrm_flgUpdEAT1 "Info of updated CAN Data of EAT" UBYTE B_TRUE 1 100 0.00 1.00000000000 BIT_MASK 0x1 FORMAT "%13.11" ECU_ADDRESS 0x6000B6B9 /end MEASUREMENT
/begin MEASUREMENT MoXFrm_flgUpdEAT12 "Info of updated CAN Data of EAT12" UBYTE B_TRUE 1 100 0.00 1.00000000000 BIT_MASK 0x1 FORMAT "%13.11" ECU_ADDRESS 0x6000B6B8 /end MEASUREMENT
/begin MEASUREMENT MoXFrm_flgUpdEAT13 "Info of updated CAN Data of EAT13" UBYTE B_TRUE 1 100 0.00 1.00000000000 BIT_MASK 0x1 FORMAT "%13.11" ECU_ADDRESS 0x6000B6B7 /end MEASUREMENT
/begin MEASUREMENT MoXFrm_flgUpdEAT4 "Info of updated CAN Data of EAT4" UBYTE B_TRUE 1 100 0.00 1.00000000000 BIT_MASK 0x1 FORMAT "%13.11" ECU_ADDRESS 0x6000B6B6 /end MEASUREMENT
/begin MEASUREMENT MoXFrm_flgUpdEATB "Info of updated CAN Data of EATB" UBYTE B_TRUE 1 100 0.00 1.00000000000 BIT_MASK 0x1 FORMAT "%13.11" ECU_ADDRESS 0x6000B6B5 /end MEASUREMENT
/begin MEASUREMENT MoXFrm_flgUpdENGA "ENGA frame update flag" UBYTE B_TRUE 1 100 0.00 1.00000000000 BIT_MASK 0x1 FORMAT "%13.11" ECU_ADDRESS 0x6000B6B4 /end MEASUREMENT
/begin MEASUREMENT MoXFrm_flgUpdGWIMG3 "Info of updated CAN Data of GWIMG3" UBYTE B_TRUE 1 100 0.00 1.00000000000 BIT_MASK 0x1 FORMAT "%13.11" ECU_ADDRESS 0x6000B6B3 /end MEASUREMENT
/begin MEASUREMENT MoXFrm_flgUpdMETA "Info of updated CAN Data of META" UBYTE B_TRUE 1 100 0.00 1.00000000000 BIT_MASK 0x1 FORMAT "%13.11" ECU_ADDRESS 0x6000B6B2 /end MEASUREMENT
/begin MEASUREMENT MoXFrm_flgUpdMETL "Info of updated CAN Data of METL" UBYTE B_TRUE 1 100 0.00 1.00000000000 BIT_MASK 0x1 FORMAT "%13.11" ECU_ADDRESS 0x6000B6B1 /end MEASUREMENT
/begin MEASUREMENT MoXSyncLos_cntrSyncCplMsg "synchro task counter complement in extended monitoring" UBYTE OneToOne 1 100 0.00 255.0 FORMAT "%5.1" ECU_ADDRESS 0x70003670 /end MEASUREMENT
/begin MEASUREMENT MoXSyncLos_cntrSyncMsg "synchro task counter in extended monitoring" UBYTE OneToOne 1 100 0.00 255.0 FORMAT "%5.1" ECU_ADDRESS 0x7000366F /end MEASUREMENT
/begin MEASUREMENT MoXSyncLos_nEng10msLocMsg "engine speed calculated in 10ms in extended monitoring" SWORD nmot_q0p5 1 100 -16384.00 16383.50 FORMAT "%8.2" ECU_ADDRESS 0x6000987E /end MEASUREMENT
/begin MEASUREMENT MoXSyncLos_nEng10msLoReslMsg "engine speed (low resolution) calculated in 10ms in extended monitoring" UBYTE nmot_q40 1 100 0.00 10200. FORMAT "%5.0" ECU_ADDRESS 0x6000FBCA /end MEASUREMENT
/begin MEASUREMENT MoXSyncLos_nEng10msMsg "engine speed calculated in 10ms in extended monitoring" SWORD nmot_q0p5 1 100 -16384.00 16383.50 FORMAT "%8.2" ECU_ADDRESS 0x6000987C /end MEASUREMENT
/begin MEASUREMENT MoXTrqPtd_cntrDebErrMaxDisblTqEm "Debounce counter to set the e-machine maximum torque limit to 0 Nm in case of pending maximum sum torque comparison error" UBYTE OneToOne 1 100 0.00 255.0 FORMAT "%5.1" ECU_ADDRESS 0x6000B6B0 /end MEASUREMENT
/begin MEASUREMENT MoXTrqPtd_cntrDebErrMaxRedTqEm "Debounce counter to reduce the maximum e-machine torque in case of pending maximum sum torque comparison error" UBYTE OneToOne 1 100 0.00 255.0 FORMAT "%5.1" ECU_ADDRESS 0x6000B6AF /end MEASUREMENT
/begin MEASUREMENT MoXTrqPtd_cntrDebErrMinRedTqEm "Debounce counter to reduce the minimum e-machine torque in case of pending minimum torque comparison error" UBYTE OneToOne 1 100 0.00 255.0 FORMAT "%5.1" ECU_ADDRESS 0x6000B6AE /end MEASUREMENT
/begin MEASUREMENT MoXTrqPtd_cntrDebErrTqMaxEm "Debounce counter to reduce the maximum e-machine torque in case of maximum e-machine torque comparison error in extended function monitoring" UBYTE OneToOne 1 100 0.00 255.0 FORMAT "%5.1" ECU_ADDRESS 0x6000B6AD /end MEASUREMENT
/begin MEASUREMENT MoXTrqPtd_flgErrLoadShiftTqEm "Load point shift activ in extended function monitoring in case of pending maximum sum torque comparison error" UBYTE B_TRUE 1 100 0.00 1.00000000000 BIT_MASK 0x1 FORMAT "%13.11" ECU_ADDRESS 0x70000149 /end MEASUREMENT
/begin MEASUREMENT MoXTrqPtd_flgErrMaxDisblTqEm "E-machine maximum torque limit set to 0 Nm in case of pending maximum sum torque comparison error" UBYTE B_TRUE 1 100 0.00 1.00000000000 BIT_MASK 0x1 FORMAT "%13.11" ECU_ADDRESS 0x70000148 /end MEASUREMENT
/begin MEASUREMENT MoXTrqPtd_flgErrMaxRedTqEm "The maximum e-machine torque is reduced in case of pending maximum sum torque comparison error" UBYTE B_TRUE 1 100 0.00 1.00000000000 BIT_MASK 0x1 FORMAT "%13.11" ECU_ADDRESS 0x70000147 /end MEASUREMENT
/begin MEASUREMENT MoXTrqPtd_flgErrMinEmDeb "The minimum e-machine torque is reduced in case of pending minimum torque comparison error" UBYTE B_TRUE 1 100 0.00 1.00000000000 BIT_MASK 0x1 FORMAT "%13.11" ECU_ADDRESS 0x70000146 /end MEASUREMENT
/begin MEASUREMENT MoXTrqPtd_flgErrTqMaxEm "Error detected in maximum e-machine torque comparison in extended function monitoring" UBYTE B_TRUE 1 100 0.00 1.00000000000 BIT_MASK 0x1 FORMAT "%13.11" ECU_ADDRESS 0x70000145 /end MEASUREMENT
/begin MEASUREMENT MoXTrqPtd_flgErrTqMaxEmDeb "Debounced maximum e-machine torque comparison error in extended function monitoring" UBYTE B_TRUE 1 100 0.00 1.00000000000 BIT_MASK 0x1 FORMAT "%13.11" ECU_ADDRESS 0x70000144 /end MEASUREMENT
/begin MEASUREMENT MoXTrqPtd_tqCrksftEmFild "Filtered e-machine permitted torque without offset" SWORD md_q0p1 1 100 -3276.800 3276.700 FORMAT "%8.3" ECU_ADDRESS 0x6000987A /end MEASUREMENT
/begin MEASUREMENT MoXTrqPtd_tqCrksftEmOffsFild "Filtered e-machine permitted torque with offset in extended function monitoring" SWORD md_q0p1 1 100 -3276.800 3276.700 FORMAT "%8.3" ECU_ADDRESS 0x60007262 /end MEASUREMENT
/begin MEASUREMENT MoXTrqPtd_tqCrksftEmPT1In "Delayed permitted e-machine torque" SWORD md_q0p1 1 100 -3276.800 3276.700 FORMAT "%8.3" ECU_ADDRESS 0x60007260 /end MEASUREMENT
/begin MEASUREMENT MoXTrqPtd_tqErrMaxDisblTqEm "Maximum permitted e-machine torque in case of torque disabling request in extended function monitoring" SWORD md_q0p1 1 100 -3276.800 3276.700 FORMAT "%8.3" ECU_ADDRESS 0x6000725E /end MEASUREMENT
/begin MEASUREMENT MoXTrqPtd_tqErrMaxRedTqEm "Maximum permitted e-machine torque in case of torque reduction request in extended function monitoring" SWORD md_q0p1 1 100 -3276.800 3276.700 FORMAT "%8.3" ECU_ADDRESS 0x6000725C /end MEASUREMENT
/begin MEASUREMENT MoXTrqPtd_tqMaxLimEm "Maximum E-machine torque from Extended monitoring" SWORD md_q0p1 1 100 -3276.800 3276.700 FORMAT "%8.3" ECU_ADDRESS 0x60009878 /end MEASUREMENT
/begin MEASUREMENT MoXTrqPtd_tqMaxLimEmOffs "Maximum permitted e-machine torque with offset in extended function monitoring" SWORD md_q0p1 1 100 -3276.800 3276.700 FORMAT "%8.3" ECU_ADDRESS 0x6000725A /end MEASUREMENT
/begin MEASUREMENT MoXTrqPtd_tqMinLimEm "Minimum E-machine torque from Extended monitoring" SWORD md_q0p1 1 100 -3276.800 3276.700 FORMAT "%8.3" ECU_ADDRESS 0x60009876 /end MEASUREMENT
/begin MEASUREMENT MoX_bSyncLos_msg "Message for condition loss of synchronization in extended monitoring with respect to MDG1" UBYTE B_TRUE 1 100 0.00 1.00000000000 BIT_MASK 0x1 FORMAT "%13.11" ECU_ADDRESS 0x700007D3 /end MEASUREMENT
/begin MEASUREMENT MoX_bSyncRecg "condition synchro recognized in extended monitoring" UBYTE B_TRUE 1 100 0.00 1.00000000000 BIT_MASK 0x1 FORMAT "%13.11" ECU_ADDRESS 0x7000014A /end MEASUREMENT
/begin MEASUREMENT MoX_trqInrMinWoCtOff "minimum inner torque in combusted operation in the extended monitoring" UBYTE md_q1p6 1 100 0.00 408.0 FORMAT "%5.1" ECU_ADDRESS 0x6000FBC9 /end MEASUREMENT
/begin MEASUREMENT Mo_bAddConPFC "Generation of additional Response Contributions to program Folw Check" UBYTE B_TRUE 1 100 0.00 1.00000000000 BIT_MASK 0x80 FORMAT "%13.11" ECU_ADDRESS 0x60018712 /end MEASUREMENT
/begin MEASUREMENT Mo_bAddConPFCExtdTsk "Generation of additional Response Contributions to program Folw Check in the extended task" UBYTE B_TRUE 1 100 0.00 1.00000000000 BIT_MASK 0x80 FORMAT "%13.11" ECU_ADDRESS 0x60018711 /end MEASUREMENT
/begin MEASUREMENT Mo_bAddDisblPreICORst "Additional condition disable Pre-ICO reset in function monitoring" UBYTE B_TRUE 1 100 0.00 1.00000000000 BIT_MASK 0x8 FORMAT "%13.11" ECU_ADDRESS 0x60018712 /end MEASUREMENT
/begin MEASUREMENT Mo_bAddDisblPreICORstExtdTsk "Additional condition disable Pre-ICO reset in function monitoring in the extended task" UBYTE B_TRUE 1 100 0.00 1.00000000000 BIT_MASK 0x8 FORMAT "%13.11" ECU_ADDRESS 0x60018711 /end MEASUREMENT
/begin MEASUREMENT Mo_bCplChk "Fault reaction requirement from cyclic RAM safeguarding in function monitoring" UBYTE B_TRUE 1 100 0.00 1.00000000000 BIT_MASK 0x1 FORMAT "%13.11" ECU_ADDRESS 0x60018714 /end MEASUREMENT
/begin MEASUREMENT Mo_bCplChkExtdTsk "Fault reaction requirement from cyclic RAM safeguarding in function monitoring in the extended task" UBYTE B_TRUE 1 100 0.00 1.00000000000 BIT_MASK 0x1 FORMAT "%13.11" ECU_ADDRESS 0x60018713 /end MEASUREMENT
/begin MEASUREMENT Mo_bEmgcyAir "Request standby air driving from level1 in function monitoring" UBYTE B_TRUE 1 100 0.00 1.00000000000 BIT_MASK 0x20 FORMAT "%13.11" ECU_ADDRESS 0x60018712 /end MEASUREMENT
/begin MEASUREMENT Mo_bICOL1 "Injection Cut Off demand from Level 1" UBYTE B_TRUE 1 100 0.00 1.00000000000 BIT_MASK 0x2 FORMAT "%13.11" ECU_ADDRESS 0x60018712 /end MEASUREMENT
/begin MEASUREMENT Mo_bICOL2 "Injection Cut Off demand from Level 2" UBYTE B_TRUE 1 100 0.00 1.00000000000 BIT_MASK 0x1 FORMAT "%13.11" ECU_ADDRESS 0x60018712 /end MEASUREMENT
/begin MEASUREMENT Mo_bICOL2ExtdTsk "Injection Cut Off demand from Level 2 in the extended task" UBYTE B_TRUE 1 100 0.00 1.00000000000 BIT_MASK 0x1 FORMAT "%13.11" ECU_ADDRESS 0x60018711 /end MEASUREMENT
/begin MEASUREMENT Mo_bIrvElMIdl "irreversible idle request for the electric motor" UBYTE B_TRUE 1 100 0.00 1.00000000000 BIT_MASK 0x20 FORMAT "%13.11" ECU_ADDRESS 0x60018715 /end MEASUREMENT
/begin MEASUREMENT Mo_bIrvHybLimpL1 "Irreversible hybrid-limp-home mode requested from level 1" UBYTE B_TRUE 1 100 0.00 1.00000000000 BIT_MASK 0x2 FORMAT "%13.11" ECU_ADDRESS 0x60018715 /end MEASUREMENT
/begin MEASUREMENT Mo_bIrvHybLimpL2 "Irreversible hybrid-limp-home mode requested from level 2" UBYTE B_TRUE 1 100 0.00 1.00000000000 BIT_MASK 0x1 FORMAT "%13.11" ECU_ADDRESS 0x60018715 /end MEASUREMENT
/begin MEASUREMENT Mo_bIrvHybP1LimpL2 "Irreversible limp home mode P1 hybrid from level 2 in function monitoring" UBYTE B_TRUE 1 100 0.00 1.00000000000 BIT_MASK 0x10 FORMAT "%13.11" ECU_ADDRESS 0x60018715 /end MEASUREMENT
/begin MEASUREMENT Mo_bIrvTrqLimL1 "Irreversible torque limitation from level 1 in function monitoring" UBYTE B_TRUE 1 100 0.00 1.00000000000 BIT_MASK 0x8 FORMAT "%13.11" ECU_ADDRESS 0x60018715 /end MEASUREMENT
/begin MEASUREMENT Mo_bIrvTrqLimL2 "Irreversible torque limitation from level 2 in function monitoring" UBYTE B_TRUE 1 100 0.00 1.00000000000 BIT_MASK 0x4 FORMAT "%13.11" ECU_ADDRESS 0x60018715 /end MEASUREMENT
/begin MEASUREMENT Mo_bLoVltg "Battery voltage not OK, undervoltage shut-off active" UBYTE B_TRUE 1 100 0.00 1.00000000000 BIT_MASK 0x4 FORMAT "%13.11" ECU_ADDRESS 0x60018712 /end MEASUREMENT
/begin MEASUREMENT Mo_bNlh "irreversible demand of non-lean operation mode from function monitoring" UBYTE B_TRUE 1 100 0.00 1.00000000000 BIT_MASK 0x10 FORMAT "%13.11" ECU_ADDRESS 0x60018712 /end MEASUREMENT
/begin MEASUREMENT Mo_bRamErr "RAM error occured in cyclic check" UBYTE B_TRUE 1 100 0.00 1.00000000000 BIT_MASK 0x2 FORMAT "%13.11" ECU_ADDRESS 0x60018714 /end MEASUREMENT
/begin MEASUREMENT Mo_bRamErrExtdTsk "RAM error occured in cyclic check" UBYTE B_TRUE 1 100 0.00 1.00000000000 BIT_MASK 0x2 FORMAT "%13.11" ECU_ADDRESS 0x60018713 /end MEASUREMENT
/begin MEASUREMENT Mo_bRomErr "ROM error occured in cyclic check" UBYTE B_TRUE 1 100 0.00 1.00000000000 BIT_MASK 0x4 FORMAT "%13.11" ECU_ADDRESS 0x60018714 /end MEASUREMENT
/begin MEASUREMENT Mo_bSyncLos "condition loss of synchronization in function monitoring" UBYTE B_TRUE 1 100 0.00 1.00000000000 BIT_MASK 0x40 FORMAT "%13.11" ECU_ADDRESS 0x60018712 /end MEASUREMENT
/begin MEASUREMENT Mo_ctRst "Reset counter" UBYTE OneToOne 1 100 0.00 255.0 FORMAT "%5.1" ECU_ADDRESS 0x600365DD /end MEASUREMENT
/begin MEASUREMENT Mo_ctRstCpl "RAM data redundancy of Mo_ctRst" UBYTE OneToOne 1 100 0.00 255.0 FORMAT "%5.1" ECU_ADDRESS 0x600365DC /end MEASUREMENT
/begin MEASUREMENT Mo_ctRstMsg "Reset counter" UBYTE OneToOne 1 100 0.00 255.0 FORMAT "%5.1" ECU_ADDRESS 0x6000FBC8 /end MEASUREMENT
/begin MEASUREMENT Mo_flgICOMsg "flag for layer 1: error reaction injection quantities limitation from the monitoring" UBYTE B_TRUE 1 100 0.00 1.00000000000 BIT_MASK 0x1 FORMAT "%13.11" ECU_ADDRESS 0x6000F92A /end MEASUREMENT
/begin MEASUREMENT Mo_stCplChk "Complementcheck failed" ULONG OneToOne 1 100 0.00 4294967295.00 FORMAT "%13.2" ECU_ADDRESS 0x60017FFC /end MEASUREMENT
/begin MEASUREMENT Mo_stErrHyb "Status Bits for demands of error reaction hybrid system in function monitoring" UBYTE OneToOne 1 100 0.00 255.0 FORMAT "%5.1" ECU_ADDRESS 0x60018715 /end MEASUREMENT
/begin MEASUREMENT Mo_stErrHybCpl "RAM data redundancy of Mo_stErrHyb" UBYTE OneToOne 1 100 0.00 255.0 FORMAT "%5.1" ECU_ADDRESS 0x60018004 /end MEASUREMENT
/begin MEASUREMENT Mo_stMoC "Status Bits for demands of error reaction in controller monitoring" UBYTE OneToOne 1 100 0.00 255.0 FORMAT "%5.1" ECU_ADDRESS 0x60018714 /end MEASUREMENT
/begin MEASUREMENT Mo_stMoCCpl "RAM data redundancy of Mo_stMoC" UBYTE OneToOne 1 100 0.00 255.0 FORMAT "%5.1" ECU_ADDRESS 0x60018003 /end MEASUREMENT
/begin MEASUREMENT Mo_stMoCExtdTsk "Status bits for the error reaction request in the monitoring processor" UBYTE OneToOne 1 100 0.00 255.0 FORMAT "%5.1" ECU_ADDRESS 0x60018713 /end MEASUREMENT
/begin MEASUREMENT Mo_stMoCExtdTskCpl "Complement value for Mo_stMoCExtdTsk" UBYTE OneToOne 1 100 0.00 255.0 FORMAT "%5.1" ECU_ADDRESS 0x60018002 /end MEASUREMENT
/begin MEASUREMENT Mo_stMoCExtdTskMsg "Message containing status bits for the error reaction request in the monitoring processor" UBYTE OneToOne 1 100 0.00 255.0 FORMAT "%5.1" ECU_ADDRESS 0x6000FBC7 /end MEASUREMENT
/begin MEASUREMENT Mo_stMoCMsg "Message containing status Bits for demands of error reaction in controller monitoring" UBYTE OneToOne 1 100 0.00 255.0 FORMAT "%5.1" ECU_ADDRESS 0x6000FBC6 /end MEASUREMENT
/begin MEASUREMENT Mo_stMoF "Status Bits for demands of error reaction in function monitoring" UBYTE OneToOne 1 100 0.00 255.0 FORMAT "%5.1" ECU_ADDRESS 0x60018712 /end MEASUREMENT
/begin MEASUREMENT Mo_stMoFCpl "RAM data redundancy of Mo_stMoF" UBYTE OneToOne 1 100 0.00 255.0 FORMAT "%5.1" ECU_ADDRESS 0x60018001 /end MEASUREMENT
/begin MEASUREMENT Mo_stMoFExtdTsk "Status Bits for demands of error reaction in function monitoring in the extended task" UBYTE OneToOne 1 100 0.00 255.0 FORMAT "%5.1" ECU_ADDRESS 0x60018711 /end MEASUREMENT
/begin MEASUREMENT Mo_stMoFExtdTskCpl "RAM data redundancy of Mo_stMoFExtdTsk" UBYTE OneToOne 1 100 0.00 255.0 FORMAT "%5.1" ECU_ADDRESS 0x60018000 /end MEASUREMENT
/begin MEASUREMENT Mo_stMoFExtdTskMsg "Message containing status Bits for demands of error reaction in function monitoring in the extended task" UBYTE OneToOne 1 100 0.00 255.0 FORMAT "%5.1" ECU_ADDRESS 0x6000FBC5 /end MEASUREMENT
/begin MEASUREMENT Mo_stMoFMsg "Msg for L1of Status Bits for demands of error reaction in function monitoring" UBYTE OneToOne 1 100 0.00 255.0 FORMAT "%5.1" ECU_ADDRESS 0x6000FBC4 /end MEASUREMENT
/begin MEASUREMENT Mo_stProtRAM "status of Prot RAM initialisation of error monitoring" UBYTE OneToOne 1 100 0.00 255.0 FORMAT "%5.1" ECU_ADDRESS 0x600365DE /end MEASUREMENT
/begin MEASUREMENT Mo_stVldR32Chk "status to determine if the ValidR32 check failed" ULONG OneToOne 1 100 0.00 4294967295.00 FORMAT "%13.2" ECU_ADDRESS 0x60017FF8 /end MEASUREMENT
/begin MEASUREMENT MRlyst_Sq "signal quality message for Main relay status" UBYTE SigQly_COMPU_VERB 1 100 0.00 15.0000000000 FORMAT "%13.10" ECU_ADDRESS 0x6000FBE8 /end MEASUREMENT
/begin MEASUREMENT MRly_st "Request to switch on and off the main relay" UBYTE OneToOne 1 100 0.00 255.0 BIT_MASK 0x1 FORMAT "%5.1" ECU_ADDRESS 0x6001000F /end MEASUREMENT
/begin MEASUREMENT MRly_stAct "Status of main relay" UBYTE OneToOne 1 100 0.00 255.0 FORMAT "%5.1" ECU_ADDRESS 0x6001002D /end MEASUREMENT
/begin MEASUREMENT msudksom_w_msg "desired standardized overcritical air mass flow without torque structure" UWORD m_uw_b6553p5 1 100 0.00 6553.500 FORMAT "%8.3" ECU_ADDRESS 0x600092FE /end MEASUREMENT
/begin MEASUREMENT tabstloc_w "Stop time" UWORD t1sxs_uw_q1 1 100 0.00 65535.00 FORMAT "%8.2" ECU_ADDRESS 0x700052CC /end MEASUREMENT
/begin MEASUREMENT tfwdksom_w_msg "time constant to filter desired throttle angle without torque structure" UWORD zk10msxs_uw_b655 1 100 0.01000015 655.36000000 FORMAT "%12.8" ECU_ADDRESS 0x600092AE /end MEASUREMENT
/begin MEASUREMENT TIFACAIRPTHTRANCON_BASE.tiFacAirPthTran "class filter time parameter / filter time" UWORD t_q0p01 1 100 0.0100 655.3500 FORMAT "%8.4" ECU_ADDRESS 0x60007244 /end MEASUREMENT
/begin MEASUREMENT TIFACAIRPTHTRANCON_FOLW.tiFacAirPthTran " / filter time" UWORD t_q0p01 1 100 0.0100 655.3500 FORMAT "%8.4" ECU_ADDRESS 0x6000724A /end MEASUREMENT
/begin MEASUREMENT TIFACAIRPTHTRAN_BASE.tiFacAirPthTran "class filter time table / filter time" UWORD t_q0p01 1 100 0.0100 655.3500 FORMAT "%8.4" ECU_ADDRESS 0x60007242 /end MEASUREMENT
/begin MEASUREMENT TIFACAIRPTHTRAN_FOLW.tiFacAirPthTran " / filter time" UWORD t_q0p01 1 100 0.0100 655.3500 FORMAT "%8.4" ECU_ADDRESS 0x60007248 /end MEASUREMENT
/begin MEASUREMENT tumgsudksh "environment temperature without independent car heater influence" UBYTE temp_ub_q0p75_o48 1 100 -48.0 143.3 FORMAT "%5.1" ECU_ADDRESS 0x6000B6A6 /end MEASUREMENT
/begin FUNCTION MoFTrqPtd_Emac "5.5.0     Function Monitoring: Maximum permitted torque for electrical machine"
 /begin DEF_CHARACTERISTIC MoFTrqPtd_nEngRlsStrtThdMax_C MoFTrqPtd_nEngRlsStrtThdMin_C MoFTrqPtd_rBltDrv_C MoFTrqPtd_stTqCtrldOperMod_C MoFTrqPtd_stVoltCtrldOperMod_C MoFTrqPtd_tiDebComErrElDrvThd_C MoFTrqPtd_tiDebIrrvCmpErr_C MoFTrqPtd_tiDebIrvErrElDrvThd_C MoFTrqPtd_tqCkrsftStrtMaxEm_T MoFTrqPtd_tqCrsMaxEM_T MoFTrqPtd_tqCrsMinEM_T MoFTrqPtd_tqMaxEmOffs_T MoFTrqPtd_tqMinEmOffs_T MoFTrqPtd_tqOffsReslEmTq_C /end DEF_CHARACTERISTIC
 /begin IN_MEASUREMENT ElM_stOperModDes ElM_tqDes ElM_tqMaxGenr ElM_tqMaxTqCtrl ElM_tqMinTqCtrl MoFESpd_nEng MoFHybRx_flgComErrElDrv MoFHybRx_flgIrvErrElDrv MoFStrt_flgStrtPtd MoFTrqCmp_flgIrrvErrMax MoFTrqCmp_flgIrrvErrMin MoFTrqPtd_tqCluSumPtdFildRaw MoFTrqPtd_tqVehPtdWoIntvMin MoF_trqLos MoXTrqPtd_tqMaxLimEm MoXTrqPtd_tqMinLimEm Mo_stCplChk Mo_stMoC Mo_stMoCCpl PTDist_flgEmStrtgTqActv /end IN_MEASUREMENT
 /begin OUT_MEASUREMENT MoFTrqPtd_flgComErrDebElDrv MoFTrqPtd_flgErrElDrv MoFTrqPtd_flgFailErrDebElDrv MoFTrqPtd_flgTqEmLimdMsg MoFTrqPtd_stOperModDesElDrv MoFTrqPtd_stOperModDesElDrvMsg MoFTrqPtd_tqCrksftMaxEmOperMod MoFTrqPtd_tqCrsEM MoFTrqPtd_tqCrsEmMaxMsg MoFTrqPtd_tqCrsEmMinMsg MoFTrqPtd_tqCrsEMMsg MoFTrqPtd_tqCrsMinEM MoFTrqPtd_tqEM MoFTrqPtd_tqEmMsg MoFTrqPtd_tqMaxEm MoFTrqPtd_tqMaxEmMsg MoFTrqPtd_tqMinEM MoFTrqPtd_tqMinEmMsg MoFTrqPtd_tqSelEM /end OUT_MEASUREMENT
 /begin LOC_MEASUREMENT MoFTrqPtdEmac_bbOut1Cpl MoFTrqPtd_stOperModDesElDrvCpl MoFTrqPtd_tiDebComErrElDrv MoFTrqPtd_tiDebComErrElDrvCpl MoFTrqPtd_tiDebIrrvCmpErr MoFTrqPtd_tiDebIrrvCmpErrCpl MoFTrqPtd_tiDebIrvErrElDrv MoFTrqPtd_tiDebIrvErrElDrvCpl MoFTrqPtd_tqCrksftMaxEmOperModCpl MoFTrqPtd_tqCrsEMCpl MoFTrqPtd_tqCrsMinEMCpl MoFTrqPtd_tqEMCpl MoFTrqPtd_tqMaxEmCpl MoFTrqPtd_tqMinEMCpl MoFTrqPtd_tqSelCrksftMaxEm MoFTrqPtd_tqSelCrksftMaxEmCpl MoFTrqPtd_tqSelEMCpl /end LOC_MEASUREMENT
 FUNCTION_VERSION "5.5.0" /end FUNCTION
/begin FUNCTION MoFTrqPtd_Eng "54.3.0    Function Monitoring: Maximum permitted engine torque"
 /begin DEF_CHARACTERISTIC MoFTrqPtd_rTrqPtdOffs_M MoFTrqPtd_tiDlyPtdEngArysize_C MoFTrqPtd_tiDlyPtdTqEng_C MoFTrqPtd_tiFiltgTqPtdEng_C /end DEF_CHARACTERISTIC
 /begin REF_CHARACTERISTIC Mo_trqIdcMax_C /end REF_CHARACTERISTIC
 /begin IN_MEASUREMENT MoFESpd_nEng MoFExtInt_tqCluPtdCoord MoFSpdG_tqPtd MoFTrqPtd_facCmpSpdGovr MoFTrqPtd_tqCmpSwilLoss MoFTrqPtd_tqCrsEM MoFTrqPtd_tqVehPtdWoInt MoF_trqInrMinWoCtOff MoF_trqLos Mo_stCplChk Mo_stMoC Mo_stMoCCpl /end IN_MEASUREMENT
 /begin OUT_MEASUREMENT MoFCoOfs_rTrqPtd MoFTrqPtd_tqCompMsg MoFTrqPtd_tqInrPtd MoFTrqPtd_tqInrPtdMsg MoF_rTrqPtdFlt /end OUT_MEASUREMENT
 /begin LOC_MEASUREMENT MoFCoOfs_rTrqPtdCpl MoFTrqPtd_rTrqPtdFltWoOffs MoFTrqPtd_rTrqPtdFltWoOffsCpl MoFTrqPtd_tqCluSumPtd MoFTrqPtd_tqCluSumPtdCpl MoFTrqPtd_tqInnrPtdFild MoFTrqPtd_tqInnrPtdFildAry MoFTrqPtd_tqInnrPtdFildAryCpl MoFTrqPtd_tqInnrPtdFildCpl MoFTrqPtd_tqInrPtdCpl MoF_rTrqPtdFltCpl /end LOC_MEASUREMENT
 FUNCTION_VERSION "54.3.0" /end FUNCTION
/begin FUNCTION MoFTrqPtd_Max "17.3.0    Function Monitoring: Maximum permitted sum torque"
 /begin DEF_CHARACTERISTIC MoFTrqPtd_tiDlyTqPtdMaxArysize_C MoFTrqPtd_tiDlyTqPtdMax_C MoFTrqPtd_tiFiltgTqPtdMax_C MoFTrqPtd_tqSumPtdOffs_M /end DEF_CHARACTERISTIC
 /begin IN_MEASUREMENT MoFESpd_nEng MoFExtInt_tqCluPtdCoord MoFSpdG_tqPtd MoFTrqPtd_facCmpSpdGovr MoFTrqPtd_tqCmpSwilLoss MoFTrqPtd_tqVehPtdWoInt MoF_trqInrMinWoCtOff MoF_trqLos Mo_stCplChk Mo_stMoC Mo_stMoCCpl /end IN_MEASUREMENT
 /begin OUT_MEASUREMENT MoFTrqPtd_tqCluSumPtdFildOffs MoFTrqPtd_tqCluSumPtdFildRaw MoFTrqPtd_tqCluSumPtdUnfild /end OUT_MEASUREMENT
 /begin LOC_MEASUREMENT MoFTrqPtd_tqCluSumPtdFild MoFTrqPtd_tqCluSumPtdFildAry MoFTrqPtd_tqCluSumPtdFildAryCpl MoFTrqPtd_tqCluSumPtdFildCpl MoFTrqPtd_tqCluSumPtdFildOffsCpl MoFTrqPtd_tqCluSumPtdFildRawCpl MoFTrqPtd_tqCluSumPtdUnfildCpl /end LOC_MEASUREMENT
 FUNCTION_VERSION "17.3.0" /end FUNCTION
/begin FUNCTION MoFTrqPtd_Min "16.0.0    Function Monitoring: Minimum permitted sum torque"
 /begin DEF_CHARACTERISTIC MoFTrqPtd_tiFilDlyTqPtdMin_C MoFTrqPtd_tiFiltgTqPtdMin_C MoFTrqPtd_tqCrksftEmMinOffs_M /end DEF_CHARACTERISTIC
 /begin IN_MEASUREMENT MoFESpd_nEng MoFTrqPtd_tqCrsMinEM Mo_stCplChk Mo_stMoC Mo_stMoCCpl /end IN_MEASUREMENT
 /begin OUT_MEASUREMENT MoFTrqPtd_tqCrksftEmMinFild MoFTrqPtd_tqCrksftEmMinFildOffs /end OUT_MEASUREMENT
 /begin LOC_MEASUREMENT MoFTrqPtd_tqCrksftEmMinFildCpl MoFTrqPtd_tqCrksftEmMinFildOffsCpl /end LOC_MEASUREMENT
 FUNCTION_VERSION "16.0.0" /end FUNCTION
/begin FUNCTION MoFTrqRat_Co "25.1.0    Function Monitoring: Torque ratio power train" /begin DEF_CHARACTERISTIC MoFTrqRat_rTqPTMax_C MoFTrqRat_rTqPTMin_C /end DEF_CHARACTERISTIC /begin IN_MEASUREMENT AccPed_rTrq Mo_stCplChk Mo_stMoC Mo_stMoCCpl /end IN_MEASUREMENT /begin OUT_MEASUREMENT MoFTrqRat_rTrqPT MoF_rTrqPT /end OUT_MEASUREMENT /begin LOC_MEASUREMENT MoFTrqRat_rTrqPTCpl MoF_rTrqPTCpl /end LOC_MEASUREMENT FUNCTION_VERSION "25.1.0" /end FUNCTION
/begin FUNCTION MoFVar_Co "24.1.0    Function Monitoring: Variant coding" /begin DEF_CHARACTERISTIC MoF_stVar_C /end DEF_CHARACTERISTIC /begin IN_MEASUREMENT Mo_stCplChk Mo_stMoC Mo_stMoCCpl /end IN_MEASUREMENT /begin OUT_MEASUREMENT MoF_stVar /end OUT_MEASUREMENT /begin LOC_MEASUREMENT MoF_stVarCpl /end LOC_MEASUREMENT FUNCTION_VERSION "24.1.0" /end FUNCTION
/begin FUNCTION MoFVar_PostBldSel "2.2.0     Function Monitoring: Post-Build Selectable"
 /begin DEF_CHARACTERISTIC MoFTrqPtd_cntrActvPostBldCfg_C MoFTrqPtd_cntrNegChkPostBldCfg_C MoFTrqPtd_cntrPosChkPostBldCfg_C MoFTrqPtd_cntrRstPostBldSel_C MoFTrqPtd_cntrStabyChkPostBldCfg_C MoFTrqPtd_cntrTestPostBldSel_C MoFTrqPtd_stSwtPbsChk_C /end DEF_CHARACTERISTIC
 /begin IN_MEASUREMENT Mo_ctRst Mo_ctRstCpl Mo_stCplChk Mo_stMoC Mo_stMoCCpl Mo_stMoF Mo_stMoFCpl /end IN_MEASUREMENT
 /begin OUT_MEASUREMENT MoFTrqPtd_flgIrrvErrPostBldSel MoFTrqPtd_flgIrrvErrPostBldSelMsg /end OUT_MEASUREMENT
 /begin LOC_MEASUREMENT MoFTrqPtd_cntrActvPostBldCfg MoFTrqPtd_cntrActvPostBldCfgCpl MoFTrqPtd_cntrNegChkPostBldCfg MoFTrqPtd_cntrNegChkPostBldCfgCpl MoFTrqPtd_cntrPosChkPostBldCfg MoFTrqPtd_cntrPosChkPostBldCfgCpl MoFTrqPtd_cntrStabyChkPostBldCfg MoFTrqPtd_cntrStabyChkPostBldCfgCpl MoFTrqPtd_cntrTestPostBldSel MoFTrqPtd_flgAlt MoFTrqPtd_flgClrPostBldSel MoFTrqPtd_flgErrActvPostBldCfg MoFTrqPtd_flgErrDcycStabyChk MoFTrqPtd_flgErrIvsChkPostBld MoFTrqPtd_flgErrPosChk MoFTrqPtd_flgErrPosChk2 MoFTrqPtd_flgErrPosChkPostBld MoFTrqPtd_flgPostBldCfgRxd MoFTrqPtd_idxPostBldCfg MoFTrqPtd_idxPostBldCfgCpl MoFTrqPtd_idxPostBldCfgIni MoFTrqPtd_idxPostBldCfgIniCpl MoFTrqPtd_stActvPostBldVrntIdx MoFTrqPtd_stActvPostBldVrntIdxCpl MoFTrqPtd_stMonIninChk MoFTrqPtd_stMonIninChkCpl MoFTrqPtd_stMonIninChkIvs MoFTrqPtd_stMonIninChkIvsCpl MoFVarPostBldSel_bbLoc1Cpl MoFVarPostBldSel_bbOut1Cpl /end LOC_MEASUREMENT
 FUNCTION_VERSION "2.2.0" /end FUNCTION
/begin FUNCTION MoFVehIfc_IfAdp1 "81.1.0    Function Monitoring: Interface adapter 1 MoFVehIfc" /begin DEF_CHARACTERISTIC MoFClth_flgClthStrkFlt_C MoF_stStrtStopEnaMsg_C /end DEF_CHARACTERISTIC
 /begin IN_MEASUREMENT MoFStrt_stStrtMsg MoF_rTrqPT Mo_stCplChk Mo_stMoC Mo_stMoCCpl /end IN_MEASUREMENT
 /begin OUT_MEASUREMENT MoFClth_flgClthStrkFlt MoFTrqRat_ratTqPTPlaus MoF_stStrtMsg MoF_stStrtStopEnaMsg /end OUT_MEASUREMENT
 /begin LOC_MEASUREMENT MoFDrvPrgSwtCo_bbOut1Cpl MoFTrqRat_ratTqPTPlausCpl /end LOC_MEASUREMENT
 FUNCTION_VERSION "81.1.0" /end FUNCTION
/begin FUNCTION MoFVSS_Co "87.0.0    Function Monitoring: Vehicle speed" /begin IN_MEASUREMENT Mo_stCplChk Mo_stMoC Mo_stMoCCpl VehV_v /end IN_MEASUREMENT /begin OUT_MEASUREMENT MoFVSS_v /end OUT_MEASUREMENT /begin LOC_MEASUREMENT MoFVSS_vCpl /end LOC_MEASUREMENT FUNCTION_VERSION "87.0.0" /end FUNCTION
/begin FUNCTION MoFWDA_Co "16.0.0    Function Monitoring: Fault reaction from function monitoring via WDA" /begin IN_MEASUREMENT Mo_stMoF /end IN_MEASUREMENT FUNCTION_VERSION "16.0.0" /end FUNCTION
/begin FUNCTION MoSysCtrl_Co "5.0.0     Monitoring: System Control" /begin IN_MEASUREMENT Mo_stCplChk Mo_stMoC Mo_stMoCCpl /end IN_MEASUREMENT FUNCTION_VERSION "5.0.0" /end FUNCTION
/begin FUNCTION MoXAirFl_Adp "69.2.0    Extended Monitoring: Adapter for function monitoring air and fuel"
 /begin IN_MEASUREMENT bdemodrdnt_msg bdemod_msg B_ethgg_msg Epm_ctCyl Epm_numCyl etaaufte_w_msg etazwist_w_msg ethggcpl_msg evz_auscpl_msg evz_austot_msg FfPrm_facFuAdpn FfPrm_flgEthVld FfPrm_stEthVldRdnt FfPrm_stFuAdpnRdnt fkrk_w_msg fnsad_w_msg fra_w_msg fr_w_msg IgCtl_iaOutpRdnt Ign_ia_real_s16 injmoderdnt_l_msg injmode_l_msg InjSys_facPc InjSys_flgInjEnad InjSys_ofsCylCntrHom InjSys_ofsCylCntrStrat InjSys_ratFuM InjSys_ratFuMCylInd InjSys_stInjTmng InjSys_stInjTmngRdnt lamsbg_w_msg miist_w_msg rkausg_w_msg rka_w_msg rkte_w_msg rkukg_w_msg rlfg_w_msg rlp_w_msg rlrext_w_msg rlrint_w_msg zwopt_w_msg zwoutzyl_w_msg zzylh_msg zzyls_msg /end IN_MEASUREMENT
 /begin OUT_MEASUREMENT MoXAirFl_CdaIfClass_V4_I.bHemInjSync MoXAirFl_CdaIfClass_V4_I.bHmbv MoXAirFl_CdaIfClass_V4_I.bHmbzylsy MoXAirFl_CdaIfClass_V4_I.hmbcpl MoXAirFl_cntrComS0 MoXAirFl_cntrComS0Rdnt MoXAirFl_cntrComS1 MoXAirFl_cntrComS1Rdnt MoXAirFl_CtOffIfClass_V4_I.evz_auscpl MoXAirFl_CtOffIfClass_V4_I.evz_auscpl_mem MoXAirFl_CtOffIfClass_V4_I.evz_austot MoXAirFl_CtOffIfClass_V4_I.evz_austot_mem MoXAirFl_CtOffIfClass_V4_I.flgInjEnad MoXAirFl_CtOffIfClass_V4_I.injTrigCylMsk MoXAirFl_CtOffIfClass_V4_I.injTrigCylMskRdnt MoXAirFl_CtOffIfClass_V4_I.injmode_zzylh MoXAirFl_CtOffIfClass_V4_I.injmode_zzylh_rdnt MoXAirFl_CtOffIfClass_V4_I.injmode_zzyln MoXAirFl_CtOffIfClass_V4_I.injmode_zzyln_rdnt MoXAirFl_CtOffIfClass_V4_I.injmode_zzyls MoXAirFl_CtOffIfClass_V4_I.injmode_zzyls_rdnt MoXAirFl_CtOffIfClass_V4_I.stInjPfiDeactvAry MoXAirFl_CtOffIfClass_V4_I.stInjPfiDeactvAryRdnt MoXAirFl_CtOffIfClass_V4_I.stInjPfiDeactvBkupAry MoXAirFl_CtOffIfClass_V4_I.stInjTiPfi MoXAirFl_CtOffIfClass_V4_I.stInjTiPfiRdnt MoXAirFl_FfIfClass_V4_I.B_ethgg MoXAirFl_FfIfClass_V4_I.ethggRdnt MoXAirFl_FfIfClass_V4_I.facFuAdpn MoXAirFl_FfIfClass_V4_I.flgEthVld MoXAirFl_FfIfClass_V4_I.stEthVldRdnt MoXAirFl_FfIfClass_V4_I.stFuAdpnRdnt MoXAirFl_InjTmngIfClass_V4_I.bdemod MoXAirFl_InjTmngIfClass_V4_I.bdemodRdnt MoXAirFl_InjTmngIfClass_V4_I.cntrCylAdv MoXAirFl_InjTmngIfClass_V4_I.cntrCylAdvRdnt MoXAirFl_InjTmngIfClass_V4_I.stInjTmng MoXAirFl_InjTmngIfClass_V4_I.stInjTmngRdnt MoXAirFl_InjTmngIfClass_V4_I.zzylh MoXAirFl_InjTmngIfClass_V4_I.zzylhRdnt MoXAirFl_InjTmngIfClass_V4_I.zzylnsp MoXAirFl_InjTmngIfClass_V4_I.zzylnspRdnt MoXAirFl_InjTmngIfClass_V4_I.zzyls MoXAirFl_InjTmngIfClass_V4_I.zzylsRdnt MoXAirFl_MixMngtIfClass_V4_I.B_afimreq MoXAirFl_MixMngtIfClass_V4_I.facLamCtlPfiAry MoXAirFl_MixMngtIfClass_V4_I.facLamCtlPfiAryRdnt MoXAirFl_MixMngtIfClass_V4_I.facLamCtlPfiBkupAry MoXAirFl_MixMngtIfClass_V4_I.facMixCorrnLivc MoXAirFl_MixMngtIfClass_V4_I.facPcPfiRest MoXAirFl_MixMngtIfClass_V4_I.facPcRest MoXAirFl_MixMngtIfClass_V4_I.facPrtnPfi MoXAirFl_MixMngtIfClass_V4_I.facPrtnPfiAry MoXAirFl_MixMngtIfClass_V4_I.facPrtnPfiAryRdnt MoXAirFl_MixMngtIfClass_V4_I.facPrtnPfiBkupAry MoXAirFl_MixMngtIfClass_V4_I.ffuevali MoXAirFl_MixMngtIfClass_V4_I.ffuevalipfi MoXAirFl_MixMngtIfClass_V4_I.fkrkAry MoXAirFl_MixMngtIfClass_V4_I.fkrkPfiAry MoXAirFl_MixMngtIfClass_V4_I.fkrkPfiAryRdnt MoXAirFl_MixMngtIfClass_V4_I.fnsad MoXAirFl_MixMngtIfClass_V4_I.fr MoXAirFl_MixMngtIfClass_V4_I.fr2 MoXAirFl_MixMngtIfClass_V4_I.fragdi MoXAirFl_MixMngtIfClass_V4_I.fragdi2 MoXAirFl_MixMngtIfClass_V4_I.frapfi MoXAirFl_MixMngtIfClass_V4_I.frapfi2 MoXAirFl_MixMngtIfClass_V4_I.lamsbg MoXAirFl_MixMngtIfClass_V4_I.lamsbg2 MoXAirFl_MixMngtIfClass_V4_I.rCtlPriB1 MoXAirFl_MixMngtIfClass_V4_I.rCtlPriB2 MoXAirFl_MixMngtIfClass_V4_I.ratFuMCylInd MoXAirFl_MixMngtIfClass_V4_I.ratFuMGdi MoXAirFl_MixMngtIfClass_V4_I.ratFuMGdiBnk2 MoXAirFl_MixMngtIfClass_V4_I.ratFuMLivc MoXAirFl_MixMngtIfClass_V4_I.ratFuMLivcRdnt MoXAirFl_MixMngtIfClass_V4_I.ratFuMPfi MoXAirFl_MixMngtIfClass_V4_I.ratFuMPfiBnk2 MoXAirFl_MixMngtIfClass_V4_I.ratFuPrtnPfiInjAry MoXAirFl_MixMngtIfClass_V4_I.ratFuPrtnPfiInjAryRdnt MoXAirFl_MixMngtIfClass_V4_I.ratFuPrtnPfiInjBkupAry MoXAirFl_MixMngtIfClass_V4_I.ratPrdcAirPrtnPfiAry MoXAirFl_MixMngtIfClass_V4_I.ratPrdcAirPrtnPfiAryRdnt MoXAirFl_MixMngtIfClass_V4_I.ratPrdcAirPrtnPfiBkupAry MoXAirFl_MixMngtIfClass_V4_I.rkagdi MoXAirFl_MixMngtIfClass_V4_I.rkagdi2 MoXAirFl_MixMngtIfClass_V4_I.rkapfi MoXAirFl_MixMngtIfClass_V4_I.rkapfi2 MoXAirFl_MixMngtIfClass_V4_I.rkausg MoXAirFl_MixMngtIfClass_V4_I.rkte MoXAirFl_MixMngtIfClass_V4_I.rkteBnk1 MoXAirFl_MixMngtIfClass_V4_I.rkteBnk2 MoXAirFl_MixMngtIfClass_V4_I.rkukg MoXAirFl_MixMngtIfClass_V4_I.rkukgpfi MoXAirFl_MixMngtIfClass_V4_I.rlfg MoXAirFl_MixMngtIfClass_V4_I.rlfgBnk1 MoXAirFl_MixMngtIfClass_V4_I.rlfgBnk2 MoXAirFl_MixMngtIfClass_V4_I.rlp MoXAirFl_MixMngtIfClass_V4_I.rlpBnk1 MoXAirFl_MixMngtIfClass_V4_I.rlpBnk2 MoXAirFl_MixMngtIfClass_V4_I.rlrext MoXAirFl_MixMngtIfClass_V4_I.rlrextBnk1 MoXAirFl_MixMngtIfClass_V4_I.rlrextBnk2 MoXAirFl_MixMngtIfClass_V4_I.rlrint MoXAirFl_MixMngtIfClass_V4_I.rlrintBnk1 MoXAirFl_MixMngtIfClass_V4_I.rlrintBnk2 MoXAirFl_TrqActIfClass_V4_I.agIntkClsd MoXAirFl_TrqActIfClass_V4_I.agIntkClsdCpl MoXAirFl_TrqActIfClass_V4_I.etaaufte MoXAirFl_TrqActIfClass_V4_I.etazwist MoXAirFl_TrqActIfClass_V4_I.etazwistm MoXAirFl_TrqActIfClass_V4_I.miist MoXAirFl_TrqActIfClass_V4_I.zwcalcar MoXAirFl_TrqActIfClass_V4_I.zwcalcar_zzylzue MoXAirFl_TrqActIfClass_V4_I.zwcalcarcp MoXAirFl_TrqActIfClass_V4_I.zwopt MoXAirFl_TrqActIfClass_V4_I.zwout MoXAirFl_TrqActIfClass_V4_I.zwoutcpl MoXAirFl_TrqActIfClass_V4_I.zwouthiresl MoXAirFl_TrqActIfClass_V4_I.zwouthireslAry_zzylzue MoXAirFl_TrqActIfClass_V4_I.zwouthireslRdnt /end OUT_MEASUREMENT
 FUNCTION_VERSION "69.2.0" /end FUNCTION
/begin FUNCTION MoXEMM_Co "20.4.1    Extended Monitoring: Diagnosis Function for EMM-Module" /begin DEF_CHARACTERISTIC MoXEMM_nrHwLTErrSimn_C MoXEMM_nrSmuAlmErrSimn_C /end DEF_CHARACTERISTIC /begin IN_MEASUREMENT MoCEMM_stEmmAlrmsMsg /end IN_MEASUREMENT /begin OUT_MEASUREMENT MoXEMM_stEMMAlrms MoXEMM_stEMMAlrmsAftRst /end OUT_MEASUREMENT /begin LOC_MEASUREMENT MoXEMM_stHwLTResult /end LOC_MEASUREMENT FUNCTION_VERSION "20.4.1" /end FUNCTION
/begin FUNCTION MoXFrm_Co "224.1.0   Extended Monitoring: Frame configuration"
 /begin OUT_MEASUREMENT MoXFrm_Buf_AYCF MoXFrm_Buf_EAT1 MoXFrm_Buf_EAT12 MoXFrm_Buf_EAT13 MoXFrm_Buf_EAT4 MoXFrm_Buf_EATB MoXFrm_Buf_ENGA MoXFrm_Buf_GWIMG3 MoXFrm_Buf_META MoXFrm_Buf_METL MoXFrm_flgUpdAYCF MoXFrm_flgUpdEAT1 MoXFrm_flgUpdEAT12 MoXFrm_flgUpdEAT13 MoXFrm_flgUpdEAT4 MoXFrm_flgUpdEATB MoXFrm_flgUpdENGA MoXFrm_flgUpdGWIMG3 MoXFrm_flgUpdMETA MoXFrm_flgUpdMETL /end OUT_MEASUREMENT
 FUNCTION_VERSION "224.1.0" /end FUNCTION
/begin FUNCTION MoXSyncLos_Co "5.1.1     Extended Monitoring: Detection loss of synchronization" /begin DEF_CHARACTERISTIC MoXSyncLos_nEngSyncMin_C /end DEF_CHARACTERISTIC /begin IN_MEASUREMENT Epm_nEng10ms /end IN_MEASUREMENT
 /begin OUT_MEASUREMENT MoXSyncLos_cntrSyncCplMsg MoXSyncLos_cntrSyncMsg MoXSyncLos_nEng10msLoReslMsg MoXSyncLos_nEng10msMsg MoX_bSyncLos_msg /end OUT_MEASUREMENT
 /begin LOC_MEASUREMENT MoXSyncLos_nEng10msLocMsg MoX_bSyncRecg /end LOC_MEASUREMENT
 FUNCTION_VERSION "5.1.1" /end FUNCTION
/begin FUNCTION MoXTrqDist_Co "11.0.0    Extended Monitoring: Torque distribution"
 /begin DEF_CHARACTERISTIC MoXTrqPtd_cntrDebErrMaxDisblTqEmThd_C MoXTrqPtd_cntrDebErrMaxRedTqEmThd_C MoXTrqPtd_cntrDebErrMinRedTqEmThd_C MoXTrqPtd_cntrDebErrTqMaxEmThd_C MoXTrqPtd_tiDlyFiltgTqEm_C MoXTrqPtd_tiOffDlyErrMaxRedTqEm_C MoXTrqPtd_tiOffDlyErrMinThd_C MoXTrqPtd_tiOffDlyErrTqMaxEm_C MoXTrqPtd_tiPT1FiltgTqEm_C MoXTrqPtd_tqCrksftAltTqMax_T MoXTrqPtd_tqCrksftEmOffs_T MoXTrqPtd_tqCrksftEmRedOffs_T MoXTrqPtd_tqCrksftRedEmOffs_C /end DEF_CHARACTERISTIC
 /begin IN_MEASUREMENT ElM_tqDes Epm_nEng MoFTrqAct_tqCrksftEmMsg MoFTrqCmp_flgErrMaxPndMsg MoFTrqCmp_flgErrMinPndMsg MoFTrqPtd_tqCrsEMMsg TrsmEmac_ratElmTrsm /end IN_MEASUREMENT
 /begin OUT_MEASUREMENT MoXTrqPtd_tqCrksftEmFild MoXTrqPtd_tqMaxLimEm MoXTrqPtd_tqMinLimEm /end OUT_MEASUREMENT
 /begin LOC_MEASUREMENT MoXTrqPtd_cntrDebErrMaxDisblTqEm MoXTrqPtd_cntrDebErrMaxRedTqEm MoXTrqPtd_cntrDebErrMinRedTqEm MoXTrqPtd_cntrDebErrTqMaxEm MoXTrqPtd_flgErrLoadShiftTqEm MoXTrqPtd_flgErrMaxDisblTqEm MoXTrqPtd_flgErrMaxRedTqEm MoXTrqPtd_flgErrMinEmDeb MoXTrqPtd_flgErrTqMaxEm MoXTrqPtd_flgErrTqMaxEmDeb MoXTrqPtd_tqCrksftEmOffsFild MoXTrqPtd_tqCrksftEmPT1In MoXTrqPtd_tqErrMaxDisblTqEm MoXTrqPtd_tqErrMaxRedTqEm MoXTrqPtd_tqMaxLimEmOffs /end LOC_MEASUREMENT
 FUNCTION_VERSION "11.0.0" /end FUNCTION
/begin FUNCTION Mo_Adap "148.0.0   Extended Monitoring: Interface adapter" /begin IN_MEASUREMENT Mo_stCplChk Mo_stMoC Mo_stMoCCpl RngMod_trqInrMinWoCtOff /end IN_MEASUREMENT /begin OUT_MEASUREMENT MoX_trqInrMinWoCtOff /end OUT_MEASUREMENT FUNCTION_VERSION "148.0.0" /end FUNCTION
/begin FUNCTION Mo_Conf "MO.18.37_3.3.0Configuration Monitoring" FUNCTION_VERSION "MO.18.37_3.3.0" /end FUNCTION
/begin FUNCTION Mo_Glbl "97.14.0   Monitoring: Global definitions"
 /begin DEF_CHARACTERISTIC Mo_cwMstSlave_C Mo_stSwtHyb_C Mo_swtClrCntrMax_C Mo_swtCyclCalUpdt_C Mo_trqIdcMax_C /end DEF_CHARACTERISTIC
 /begin IN_MEASUREMENT SyC_stSub /end IN_MEASUREMENT
 /begin OUT_MEASUREMENT MoGlbl_vblStruct.Mo_stMoC MoGlbl_vblStructCpl.Mo_stCplChk MoGlbl_vblStructCpl.Mo_stMoCCpl Mo_ctRst Mo_ctRstCpl Mo_ctRstMsg Mo_flgICOMsg Mo_stCplChk Mo_stErrHyb Mo_stErrHybCpl Mo_stMoC Mo_stMoCCpl Mo_stMoCExtdTsk Mo_stMoCExtdTskCpl Mo_stMoCExtdTskMsg Mo_stMoCMsg Mo_stMoF Mo_stMoFCpl Mo_stMoFExtdTsk Mo_stMoFExtdTskCpl Mo_stMoFExtdTskMsg Mo_stMoFMsg Mo_stVldR32Chk /end OUT_MEASUREMENT
 /begin LOC_MEASUREMENT MoGlbl_bbLocExtdTskCpl Mo_bAddConPFC Mo_bAddConPFCExtdTsk Mo_bAddDisblPreICORst Mo_bAddDisblPreICORstExtdTsk Mo_bCplChk Mo_bCplChkExtdTsk Mo_bEmgcyAir Mo_bICOL1 Mo_bICOL2 Mo_bICOL2ExtdTsk Mo_bIrvElMIdl Mo_bIrvHybLimpL1 Mo_bIrvHybLimpL2 Mo_bIrvHybP1LimpL2 Mo_bIrvTrqLimL1 Mo_bIrvTrqLimL2 Mo_bLoVltg Mo_bNlh Mo_bRamErr Mo_bRamErrExtdTsk Mo_bRomErr Mo_bSyncLos Mo_stProtRAM /end LOC_MEASUREMENT
 FUNCTION_VERSION "97.14.0" /end FUNCTION
/begin FUNCTION Mo_Inst "640.0.0   Function Monitoring: Instances for MultiCore Structs"
 /begin LOC_MEASUREMENT MoCMem_vblStructCpl_Core1_10ms_Nr1.MoCMem_ctDebErrChkRAMOld MoCMem_vblStructCpl_Core1_10ms_Nr1.MoCMem_ctDebErrChkRAMCpl MoCMem_vblStructCpl_Core1_10ms_Nr1.MoCMem_ctDebHealChkRAMCpl MoCMem_vblStructCpl_Core1_10ms_Nr1.MoCMem_nrRamChkCpl MoCMem_vblStructCpl_Core1_10ms_Nr1.MoCMem_nrStckChkCpl MoCMem_vblStructCpl_Core1_10ms_Nr1.MoCMem_nrCSAChkCpl MoCMem_vblStructCpl_Core1_10ms_Nr1.MoCMem_RamOffsetPtrCpl MoCMem_vblStructCpl_Core1_10ms_Nr1.MoCMem_CSAOffsetPtrCpl MoCMem_vblStructCpl_Core1_10ms_Nr1.MoCMem_StckOffsetPtrCpl MoCMem_vblStructCpl_Core1_10ms_Nr1.Mo_RamCyclicCheckCpl MoCMem_vblStructCpl_Core1_10ms_Nr1.MoCMem_ctLrnRAMCpl MoCMem_vblStructCpl_Core1_10ms_Nr1.MoCMem_tiRAMusOldCpl MoCMem_vblStructCpl_Core1_10ms_Nr1.MoCMem_tiRAMAccusCpl MoCMem_vblStructCpl_Core1_10ms_Nr1.MoCMem_tiRAMusCpl MoCMem_vblStructCpl_Core1_10ms_Nr1.MoCMem_ctLrnErrHdlrCpl MoCMem_vblStructCpl_Core1_10ms_Nr1.MoCMem_tiErrHdlrusOldCpl MoCMem_vblStructCpl_Core1_10ms_Nr1.MoCMem_tiErrHdlrusCpl MoCMem_vblStructCpl_Core1_10ms_Nr1.MoCMem_tiErrHdlrAccusCpl MoCMem_vblStructCpl_Core1_10ms_Nr1.MoCMem_numHealFacCpl MoCMem_vblStructEarlyClearedRAM_Core1_10ms_Nr1.MoCMem_st MoCMem_vblStructEarlyClearedRAM_Core1_10ms_Nr1.MoCMem_stCpl MoCMem_vblStructNVRAM_Core1_10ms_Nr1.MoCMem_ctDebErrChkRAMMaxNv MoCMem_vblStructNVRAM_Core1_10ms_Nr1.MoCMem_ctDebErrChkRAMExcddThdNv MoCMem_vblStruct_Core1_10ms_Nr1.MoCMem_ctDebErrChkRAM MoCMem_vblStruct_Core1_10ms_Nr1.MoCMem_ctDebHealChkRAM MoCMem_vblStruct_Core1_10ms_Nr1.MoCMem_nrRamChkSize MoCMem_vblStruct_Core1_10ms_Nr1.MoCMem_adrChkStckEnd MoCMem_vblStruct_Core1_10ms_Nr1.MoCMem_adrChkStckStrt MoCMem_vblStruct_Core1_10ms_Nr1.MoCMem_adrChkCSAStrt MoCMem_vblStruct_Core1_10ms_Nr1.MoCMem_adrChkCSAEnd MoCMem_vblStruct_Core1_10ms_Nr1.MoCMem_nrRamChk MoCMem_vblStruct_Core1_10ms_Nr1.MoCMem_nrStckChk MoCMem_vblStruct_Core1_10ms_Nr1.MoCMem_nrCSAChk MoCMem_vblStruct_Core1_10ms_Nr1.MoCMem_StckOffsetPtr MoCMem_vblStruct_Core1_10ms_Nr1.MoCMem_CSAOffsetPtr MoCMem_vblStruct_Core1_10ms_Nr1.MoCMem_adrChkStckSP MoCMem_vblStruct_Core1_10ms_Nr1.MoCMem_RamOffsetPtr MoCMem_vblStruct_Core1_10ms_Nr1.MoCMem_ChkRAMStck MoCMem_vblStruct_Core1_10ms_Nr1.MoCMem_ctLrnRAM MoCMem_vblStruct_Core1_10ms_Nr1.MoCMem_tiRAMus MoCMem_vblStruct_Core1_10ms_Nr1.MoCMem_tiRAMusOld MoCMem_vblStruct_Core1_10ms_Nr1.MoCMem_tiRAMAccus MoCMem_vblStruct_Core1_10ms_Nr1.MoCMem_ctLrnErrHdlr MoCMem_vblStruct_Core1_10ms_Nr1.MoCMem_tiErrHdlrusOld MoCMem_vblStruct_Core1_10ms_Nr1.MoCMem_tiErrHdlrus MoCMem_vblStruct_Core1_10ms_Nr1.MoCMem_tiErrHdlrAccus MoCMem_vblStruct_Core1_10ms_Nr1.MoCMem_numHealFac MoCPFC_vblStructCpl_Core1_10ms_Nr1.MoCPFC_cntr MoCPFC_vblStructCpl_Core1_10ms_Nr1.MoCPFC_numChkword MoCPFC_vblStructCpl_Core1_10ms_Nr1.MoCPFC_numChks MoCPFC_vblStructCpl_Core1_10ms_Nr1.MoCPFC_numConCatVal MoCPFC_vblStructCpl_Core1_10ms_Nr1.MoCPFC_cntrRollg MoCPFC_vblStructCpl_Core1_10ms_Nr1.MoCPFC_aryRingBuf MoCPFC_vblStructCpl_Core1_10ms_Nr1.MoCPFC_stWrErr MoCPFC_vblStructCpl_Core1_10ms_Nr1.MoCPFC_RingBuf_pst.startAdr MoCPFC_vblStructCpl_Core1_10ms_Nr1.MoCPFC_RingBuf_pst.size MoCPFC_vblStructCpl_Core1_10ms_Nr1.MoCPFC_RingBuf_pst.head MoCPFC_vblStructCpl_Core1_10ms_Nr1.MoCPFC_RingBuf_pst.tail MoCSCC_varStructCpl_Core1_10ms_Nr1.MoCSCC_stChpIdCpl MoCSCC_varStructCpl_Core1_10ms_Nr1.MoCSCC_cntrDebCpl MoCSCC_varStructCpl_Core1_10ms_Nr1.MoCSCC_stTrmDevCpl MoCSCC_varStructCpl_Core1_10ms_Nr1.MoCSCC_cntrMPURegChkCpl MoCSCC_varStructNVRAM_Core1_10ms_Nr1.MoCSCC_cntrDebMaxNv MoCSCC_varStructNVRAM_Core1_10ms_Nr1.MoCSCC_cntrDebExcddThdNv MoCSCC_varStructNVRAM_Core1_10ms_Nr1.MoCSCC_cntrDebOld MoCSCC_varStruct_Core1_10ms_Nr1.MoCSCC_stErr MoCSCC_varStruct_Core1_10ms_Nr1.MoCSCC_cntrDeb MoCSCC_varStruct_Core1_10ms_Nr1.MoCSCC_stTrmDev MoCSCC_varStruct_Core1_10ms_Nr1.MoCSCC_stChpId MoCSCC_varStruct_Core1_10ms_Nr1.MoCSCC_cntrMPURegChk MoExe_varStructCpl_Core1_10ms_Nr1.MoExe_ctCycCpl MoExe_varStruct_Core1_10ms_Nr1.MoExe_ctCyc MoGlbl_vblStructCpl_Core1_10ms_Nr1.Mo_stCplChk MoGlbl_vblStructCpl_Core1_10ms_Nr1.Mo_stMoCCpl MoGlbl_vblStruct_Core1_10ms_Nr1.Mo_stMoC /end LOC_MEASUREMENT
 FUNCTION_VERSION "640.0.0" /end FUNCTION
/begin FUNCTION MRly2MED "10.6.0    Interface Adapter MRly to MED" /begin IN_MEASUREMENT MRly_st /end IN_MEASUREMENT /begin OUT_MEASUREMENT B_hr_msg /end OUT_MEASUREMENT FUNCTION_VERSION "10.6.0" /end FUNCTION
/begin FUNCTION MRly_Vld2Lcy "1.11.0_1.1.0SW Adapter Main Relay Component Package: Mapping Valid to Legacy Interface Elements"
 /begin DEF_CHARACTERISTIC MRly_VD_BattuMax_C MRly_VD_BattuMin_C MRly_VD_SCB_OL_Plaus_Enable_C MRly_VD_SCB_OL_Plaus_Threshold_C /end DEF_CHARACTERISTIC
 /begin IN_MEASUREMENT BattuT30C_uRaw BattU_uSens DSM_TripChgAndClrFinshd /end IN_MEASUREMENT
 /begin OUT_MEASUREMENT B_deseehr_mrly_vld_msg MRlyst_Sq MRly_st MRly_stAct /end OUT_MEASUREMENT
 FUNCTION_VERSION "1.11.0_1.1.0" /end FUNCTION
/begin FUNCTION MSUDKSOM "15.27.0_1.2.0Overcritical set value air charge without torque stucture"
 /begin DEF_CHARACTERISTIC CWMSUDKSOM EngStrt_facCoorAltiAirPth_AX EngStrt_facCoorAltiMfAir_GT EngStrt_idxClassSelnTiFacAirPthTran_T EngStrt_idxSelnMfAirWait_T EngStrt_idxSelnMfAir_T EngStrt_idxSelnTiFacAirPthTranCon_T EngStrt_idxSelnTiFacAirPthTran_T EngStrt_mAirOfsVapSuspc_T EngStrt_mAirSnsrFail_C EngStrt_mfAirEngOff_GT EngStrt_nEngAirPth_AX EngStrt_nNxtStrtAirPthRst_T EngStrt_nrInjAirPth_AX EngStrt_rPedAirPth_AX EngStrt_tStrtAirPth_AX KFMSUDKSH KLRSDKSST KLTSSDKSST KLWMSABST MFAIRSTRT_BASE.mfAirAccrPed_GM MFAIRSTRT_BASE.mfAirBaseNrInj_GM MFAIRSTRT_BASE.mfAirCatHeatgEth_GM MFAIRSTRT_BASE.mfAirCatHeatg_GM MFAIRSTRT_BASE.mfAirEth_GM MFAIRSTRT_BASE.mfAir_GM MFAIRSTRT_COM.mfAirAccrPed_GM MFAIRSTRT_COM.mfAirBaseNrInj_GM MFAIRSTRT_COM.mfAirCatHeatgEth_GM MFAIRSTRT_COM.mfAirCatHeatg_GM MFAIRSTRT_COM.mfAirEth_GM MFAIRSTRT_COM.mfAir_GM MFAIRSTRT_COMWAITSTRTR.mfAirAccrPed_GM MFAIRSTRT_COMWAITSTRTR.mfAirBaseNrInj_GM MFAIRSTRT_COMWAITSTRTR.mfAirCatHeatgEth_GM MFAIRSTRT_COMWAITSTRTR.mfAirCatHeatg_GM MFAIRSTRT_COMWAITSTRTR.mfAirEth_GM MFAIRSTRT_COMWAITSTRTR.mfAir_GM MFAIRSTRT_FOLW.mfAirAccrPed_GM MFAIRSTRT_FOLW.mfAirBaseNrInj_GM MFAIRSTRT_FOLW.mfAirCatHeatgEth_GM MFAIRSTRT_FOLW.mfAirCatHeatg_GM MFAIRSTRT_FOLW.mfAirEth_GM MFAIRSTRT_FOLW.mfAir_GM MFAIRWAIT_STRTR.mfAirWait_GM MSUDKSNLN NWDKSSTKL TIFACAIRPTHTRANCON_BASE.tiFacAirPthTran_C TIFACAIRPTHTRANCON_FOLW.tiFacAirPthTran_C TIFACAIRPTHTRAN_BASE.tiFacAirPthTranCatHeatg_GT TIFACAIRPTHTRAN_BASE.tiFacAirPthTran_GT TIFACAIRPTHTRAN_FOLW.tiFacAirPthTranCatHeatg_GT TIFACAIRPTHTRAN_FOLW.tiFacAirPthTran_GT TWDKSNSTKL /end DEF_CHARACTERISTIC
 /begin IN_MEASUREMENT ActMod_trqInr anztib_msg APP_r AuxHtg_bActv B_dtmbh_msg B_enllri_msg B_kha_msg CEngDsT_flgSnsrElecVld CEngDsT_t CoEng_stMai EngStrt_bStrtEnd EngStrt_flgStrtEndTqStruct EngStrt_stStrtReq EngStrt_stStrtSit EngStrt_tStrtCoor EngTrqPtd_trqSet EnvT_t Epm_nEng10ms fipoleth_msg PEnv_facCorrAlti PSPCtl_flgRmnVapSuspc SyC_ctDrvEnter TiOff_tiStrtEndOff tka_msg /end IN_MEASUREMENT
 /begin OUT_MEASUREMENT B_msudksom_msg B_munst_msg B_tfwdksom_msg msudksom_w_msg tfwdksom_w_msg /end OUT_MEASUREMENT
 /begin LOC_MEASUREMENT EngStrt_ctMSUDKSOMDrvEntr10ms EngStrt_flgAccrPed EngStrt_flgAirPthStrtRst EngStrt_flgEngShutDown EngStrt_flgEngShutDownDlyd EngStrt_flgInhbnCtrlVapLockLoc EngStrt_flgTqActv EngStrt_mAirOfsVapSuspc EngStrt_mfAirAccrPed EngStrt_nrInjAirPth EngStrt_tiSnceStrt MFAIRSTRT_BASE.mfAir MFAIRSTRT_COM.mfAir MFAIRSTRT_COMWAITSTRTR.mfAir MFAIRSTRT_FOLW.mfAir MFAIRWAIT_STRTR.mfAirWait tabstloc_w TIFACAIRPTHTRANCON_BASE.tiFacAirPthTran TIFACAIRPTHTRANCON_FOLW.tiFacAirPthTran TIFACAIRPTHTRAN_BASE.tiFacAirPthTran TIFACAIRPTHTRAN_FOLW.tiFacAirPthTran tumgsudksh /end LOC_MEASUREMENT
 FUNCTION_VERSION "15.27.0_1.2.0" /end FUNCTION
/begin COMPU_METHOD B_TRUE "" TAB_VERB "%6.3" "" COMPU_TAB_REF B_TRUE /end COMPU_METHOD
/begin COMPU_VTAB B_TRUE "" TAB_VERB 2 0 "FALSE" 1 "TRUE" /end COMPU_VTAB
/begin COMPU_METHOD dez "" RAT_FUNC "%6.2" "" COEFFS 0 1 0 0 0 1 /end COMPU_METHOD
/begin COMPU_METHOD EngN "" RAT_FUNC "%6.3" "rpm" COEFFS 0 2 0 0 0 1 /end COMPU_METHOD
/begin COMPU_METHOD ENGSTRT_MFAIRSTRT_SET_COMPU_VERB "" TAB_VERB "%6.3" "-" COMPU_TAB_REF ENGSTRT_MFAIRSTRT_SET_COMPU_VERB /end COMPU_METHOD
/begin COMPU_VTAB ENGSTRT_MFAIRSTRT_SET_COMPU_VERB "" TAB_VERB 4 0 "MFAIRSTRT_BASE" 1 "MFAIRSTRT_FOLW" 2 "MFAIRSTRT_COM" 3 "MFAIRSTRT_COMWAITSTRTR" /end COMPU_VTAB
/begin COMPU_METHOD ENGSTRT_MFAIRWAIT_SET_COMPU_VERB "" TAB_VERB "%6.3" "-" COMPU_TAB_REF ENGSTRT_MFAIRWAIT_SET_COMPU_VERB /end COMPU_METHOD
/begin COMPU_VTAB ENGSTRT_MFAIRWAIT_SET_COMPU_VERB "" TAB_VERB 1 0 "MFAIRWAIT_STRTR" /end COMPU_VTAB
/begin COMPU_METHOD ENGSTRT_STSTRTREQ_SET_COMPU_VERB "" TAB_VERB "%6.3" "-" COMPU_TAB_REF ENGSTRT_STSTRTREQ_SET_COMPU_VERB /end COMPU_METHOD
/begin COMPU_VTAB ENGSTRT_STSTRTREQ_SET_COMPU_VERB "" TAB_VERB 19 0 "ENGSTRT_NOSTRT" 1024 "ENGSTRT_LOP" 1028 "ENGSTRT_EOL" 1029 "ENGSTRT_PREINJ" 1031 "ENGSTRT_HIPEOL" 8192 "ENGSTRT_COMRUNNG" 8193 "ENGSTRT_COMSTRTG" 8194 "ENGSTRT_COMWAITSTRTR" 16384 "ENGSTRT_FOLW" 16385 "ENGSTRT_STRTR_DRCT" 32768 "ENGSTRT_HIPCOLD" 32769 "ENGSTRT_HIPMID" 32770 "ENGSTRT_HIPWRM" 256 "ENGSTRT_FOLWWRM" 257 "ENGSTRT_FOLWMID" 258 "ENGSTRT_FOLWCOLD" 259 "ENGSTRT_STRTR_DRCTWRM" 260 "ENGSTRT_STRTR_DRCTMID" 261 "ENGSTRT_STRTR_DRCTCOLD" /end COMPU_VTAB
/begin COMPU_METHOD ENGSTRT_TIFACAIRPTHTRANCON_SET_COMPU_VERB "" TAB_VERB "%6.3" "-" COMPU_TAB_REF ENGSTRT_TIFACAIRPTHTRANCON_SET_COMPU_VERB /end COMPU_METHOD
/begin COMPU_VTAB ENGSTRT_TIFACAIRPTHTRANCON_SET_COMPU_VERB "" TAB_VERB 2 0 "TIFACAIRPTHTRANCON_BASE" 1 "TIFACAIRPTHTRANCON_FOLW" /end COMPU_VTAB
/begin COMPU_METHOD ENGSTRT_TIFACAIRPTHTRAN_SET_COMPU_VERB "" TAB_VERB "%6.3" "-" COMPU_TAB_REF ENGSTRT_TIFACAIRPTHTRAN_SET_COMPU_VERB /end COMPU_METHOD
/begin COMPU_VTAB ENGSTRT_TIFACAIRPTHTRAN_SET_COMPU_VERB "" TAB_VERB 2 0 "TIFACAIRPTHTRAN_BASE" 1 "TIFACAIRPTHTRAN_FOLW" /end COMPU_VTAB
/begin COMPU_METHOD fak_q0p01 "" RAT_FUNC "%6.4" "" COEFFS 0 100 0 0 0 1 /end COMPU_METHOD
/begin COMPU_METHOD fak_sw_b1 "" RAT_FUNC "%7.6" "-" COEFFS 0 65536 0 0 0 2 /end COMPU_METHOD
/begin COMPU_METHOD fak_ub_b1 "" RAT_FUNC "%6.4" "-" COEFFS 0 256 0 0 0 1 /end COMPU_METHOD
/begin COMPU_METHOD fak_ub_b2 "" RAT_FUNC "%8.5" "-" COEFFS 0 256 0 0 0 2 /end COMPU_METHOD
/begin COMPU_METHOD fak_uw_b16 "" RAT_FUNC "%6.5" "-" COEFFS 0 65536 0 0 0 16 /end COMPU_METHOD
/begin COMPU_METHOD fak_uw_b2 "" RAT_FUNC "%7.6" "-" COEFFS 0 65536 0 0 0 2 /end COMPU_METHOD
/begin COMPU_METHOD fak_uw_b4 "" RAT_FUNC "%7.6" "-" COEFFS 0 65536 0 0 0 4 /end COMPU_METHOD
/begin COMPU_METHOD fak_uw_b64 "" RAT_FUNC "%6.5" "-" COEFFS 0 65536 0 0 0 64 /end COMPU_METHOD
/begin COMPU_METHOD kw_q0p0156 "" RAT_FUNC "%6.4" "Grad KW" COEFFS 0 64 0 0 0 1 /end COMPU_METHOD
/begin COMPU_METHOD md_q0p1 "" RAT_FUNC "%6.3" "Nm" COEFFS 0 10 0 0 0 1 /end COMPU_METHOD
/begin COMPU_METHOD md_q1p6 "" RAT_FUNC "%6.2" "Nm" COEFFS 0 10 0 0 0 16 /end COMPU_METHOD
/begin COMPU_METHOD MoXEMM_HwLTErrorSimnCode_VERB "" TAB_VERB "%6.3" "" COMPU_TAB_REF MoXEMM_HwLTErrorSimnCode_VERB /end COMPU_METHOD
/begin COMPU_VTAB MoXEMM_HwLTErrorSimnCode_VERB "" TAB_VERB 12 0 "MoXEMM_NO_ERROR" 1 "MoXEMMHwLTMCUFW" 2 "MoXEMMHwLTStbySMUAlvTest" 3 "MoXEMMHwLTMonBIST" 4 "MoXEMMHwLTRegMonTest" 5 "MoXEMMHwLTTempSens" 6 "MoXEMMHwLTUCBCfg" 7 "RESERVED_7" 8 "RESERVED_8" 9 "MoXEMMHwLTMBIST" 10 "MoXEMMHwLTLBIST" 65535 "MoXEMM_CLR_ERROR" /end COMPU_VTAB
/begin COMPU_METHOD MoXEMM_SMUErrorSimnCode_VERB "" TAB_VERB "%6.3" "" COMPU_TAB_REF MoXEMM_SMUErrorSimnCode_VERB /end COMPU_METHOD
/begin COMPU_VTAB MoXEMM_SMUErrorSimnCode_VERB "" TAB_VERB 450 0 "MoXEMM_NO_ERROR" 1 "MoXEMM_SMU_ALM_0_0" 2 "MoXEMM_SMU_ALM_0_1" 3 "MoXEMM_SMU_ALM_0_2" 4 "MoXEMM_reserved_0_3" 5 "MoXEMM_SMU_ALM_0_4" 6 "MoXEMM_SMU_ALM_0_5" 7 "MoXEMM_reserved_0_6" 8 "MoXEMM_SMU_ALM_0_7" 9 "MoXEMM_SMU_ALM_0_8" 10 "MoXEMM_reserved_0_9" 11 "MoXEMM_SMU_ALM_0_10" 12 "MoXEMM_SMU_ALM_0_11" 13 "MoXEMM_reserved_0_12" 14 "MoXEMM_SMU_ALM_0_13" 15 "MoXEMM_SMU_ALM_0_14" 16 "MoXEMM_reserved_0_15" 17 "MoXEMM_reserved_0_16" 18 "MoXEMM_reserved_0_17" 19 "MoXEMM_reserved_0_18" 20 "MoXEMM_reserved_0_19" 21 "MoXEMM_reserved_0_20" 22 "MoXEMM_reserved_0_21" 23 "MoXEMM_SMU_ALM_0_22" 24 "MoXEMM_SMU_ALM_0_23" 25 "MoXEMM_reserved_0_24" 26 "MoXEMM_reserved_0_25" 27 "MoXEMM_reserved_0_26" 28 "MoXEMM_reserved_0_27" 29 "MoXEMM_reserved_0_28" 30 "MoXEMM_reserved_0_29" 31 "MoXEMM_reserved_0_30" 32 "MoXEMM_reserved_0_31" 33 "MoXEMM_SMU_ALM_1_0" 34 "MoXEMM_SMU_ALM_1_1" 35 "MoXEMM_SMU_ALM_1_2" 36 "MoXEMM_reserved_1_3" 37 "MoXEMM_SMU_ALM_1_4" 38 "MoXEMM_SMU_ALM_1_5" 39 "MoXEMM_reserved_1_6" 40 "MoXEMM_SMU_ALM_1_7" 41 "MoXEMM_SMU_ALM_1_8" 42 "MoXEMM_reserved_1_9" 43 "MoXEMM_SMU_ALM_1_10" 44 "MoXEMM_SMU_ALM_1_11" 45 "MoXEMM_reserved_1_12" 46 "MoXEMM_SMU_ALM_1_13" 47 "MoXEMM_SMU_ALM_1_14" 48 "MoXEMM_reserved_1_15" 49 "MoXEMM_reserved_1_16" 50 "MoXEMM_reserved_1_17" 51 "MoXEMM_reserved_1_18" 52 "MoXEMM_reserved_1_19" 53 "MoXEMM_reserved_1_20" 54 "MoXEMM_reserved_1_21" 55 "MoXEMM_SMU_ALM_1_22" 56 "MoXEMM_SMU_ALM_1_23" 57 "MoXEMM_reserved_1_24" 58 "MoXEMM_reserved_1_25" 59 "MoXEMM_reserved_1_26" 60 "MoXEMM_reserved_1_27" 61 "MoXEMM_reserved_1_28" 62 "MoXEMM_reserved_1_29" 63 "MoXEMM_reserved_1_30" 64 "MoXEMM_reserved_1_31" 65 "MoXEMM_reserved_2_0" 66 "MoXEMM_SMU_ALM_2_1" 67 "MoXEMM_reserved_2_2" 68 "MoXEMM_reserved_2_3" 69 "MoXEMM_SMU_ALM_2_4" 70 "MoXEMM_SMU_ALM_2_5" 71 "MoXEMM_reserved_2_6" 72 "MoXEMM_SMU_ALM_2_7" 73 "MoXEMM_SMU_ALM_2_8" 74 "MoXEMM_reserved_2_9" 75 "MoXEMM_SMU_ALM_2_10" 76 "MoXEMM_SMU_ALM_2_11" 77 "MoXEMM_reserved_2_12" 78 "MoXEMM_SMU_ALM_2_13" 79 "MoXEMM_SMU_ALM_2_14" 80 "MoXEMM_reserved_2_15" 81 "MoXEMM_reserved_2_16" 82 "MoXEMM_reserved_2_17" 83 "MoXEMM_reserved_2_18" 84 "MoXEMM_reserved_2_19" 85 "MoXEMM_reserved_2_20" 86 "MoXEMM_reserved_2_21" 87 "MoXEMM_SMU_ALM_2_22" 88 "MoXEMM_SMU_ALM_2_23" 89 "MoXEMM_reserved_2_24" 90 "MoXEMM_reserved_2_25" 91 "MoXEMM_reserved_2_26" 92 "MoXEMM_reserved_2_27" 93 "MoXEMM_reserved_2_28" 94 "MoXEMM_reserved_2_29" 95 "MoXEMM_reserved_2_30" 96 "MoXEMM_reserved_2_31" 97 "MoXEMM_reserved_3_0" 98 "MoXEMM_reserved_3_1" 99 "MoXEMM_reserved_3_2" 100 "MoXEMM_reserved_3_3" 101 "MoXEMM_reserved_3_4" 102 "MoXEMM_reserved_3_5" 103 "MoXEMM_reserved_3_6" 104 "MoXEMM_reserved_3_7" 105 "MoXEMM_reserved_3_8" 106 "MoXEMM_reserved_3_9" 107 "MoXEMM_reserved_3_10" 108 "MoXEMM_reserved_3_11" 109 "MoXEMM_reserved_3_12" 110 "MoXEMM_reserved_3_13" 111 "MoXEMM_reserved_3_14" 112 "MoXEMM_reserved_3_15" 113 "MoXEMM_reserved_3_16" 114 "MoXEMM_reserved_3_17" 115 "MoXEMM_reserved_3_18" 116 "MoXEMM_reserved_3_19" 117 "MoXEMM_reserved_3_20" 118 "MoXEMM_reserved_3_21" 119 "MoXEMM_reserved_3_22" 120 "MoXEMM_reserved_3_23" 121 "MoXEMM_reserved_3_24" 122 "MoXEMM_reserved_3_25" 123 "MoXEMM_reserved_3_26" 124 "MoXEMM_reserved_3_27" 125 "MoXEMM_reserved_3_28" 126 "MoXEMM_reserved_3_29" 127 "MoXEMM_reserved_3_30" 128 "MoXEMM_reserved_3_31" 129 "MoXEMM_reserved_4_0" 130 "MoXEMM_reserved_4_1" 131 "MoXEMM_reserved_4_2" 132 "MoXEMM_reserved_4_3" 133 "MoXEMM_reserved_4_4" 134 "MoXEMM_reserved_4_5" 135 "MoXEMM_reserved_4_6" 136 "MoXEMM_reserved_4_7" 137 "MoXEMM_reserved_4_8" 138 "MoXEMM_reserved_4_9" 139 "MoXEMM_reserved_4_10" 140 "MoXEMM_reserved_4_11" 141 "MoXEMM_reserved_4_12" 142 "MoXEMM_reserved_4_13" 143 "MoXEMM_reserved_4_14" 144 "MoXEMM_reserved_4_15" 145 "MoXEMM_reserved_4_16" 146 "MoXEMM_reserved_4_17" 147 "MoXEMM_reserved_4_18" 148 "MoXEMM_reserved_4_19" 149 "MoXEMM_reserved_4_20" 150 "MoXEMM_reserved_4_21" 151 "MoXEMM_reserved_4_22" 152 "MoXEMM_reserved_4_23" 153 "MoXEMM_reserved_4_24" 154 "MoXEMM_reserved_4_25" 155 "MoXEMM_reserved_4_26" 156 "MoXEMM_reserved_4_27" 157 "MoXEMM_reserved_4_28" 158 "MoXEMM_reserved_4_29" 159 "MoXEMM_reserved_4_30" 160 "MoXEMM_reserved_4_31" 161 "MoXEMM_reserved_5_0" 162 "MoXEMM_reserved_5_1" 163 "MoXEMM_reserved_5_2" 164 "MoXEMM_reserved_5_3" 165 "MoXEMM_reserved_5_4" 166 "MoXEMM_reserved_5_5" 167 "MoXEMM_reserved_5_6" 168 "MoXEMM_reserved_5_7" 169 "MoXEMM_reserved_5_8" 170 "MoXEMM_reserved_5_9" 171 "MoXEMM_reserved_5_10" 172 "MoXEMM_reserved_5_11" 173 "MoXEMM_reserved_5_12" 174 "MoXEMM_reserved_5_13" 175 "MoXEMM_reserved_5_14" 176 "MoXEMM_reserved_5_15" 177 "MoXEMM_reserved_5_16" 178 "MoXEMM_reserved_5_17" 179 "MoXEMM_reserved_5_18" 180 "MoXEMM_reserved_5_19" 181 "MoXEMM_reserved_5_20" 182 "MoXEMM_reserved_5_21" 183 "MoXEMM_reserved_5_22" 184 "MoXEMM_reserved_5_23" 185 "MoXEMM_reserved_5_24" 186 "MoXEMM_reserved_5_25" 187 "MoXEMM_reserved_5_26" 188 "MoXEMM_reserved_5_27" 189 "MoXEMM_reserved_5_28" 190 "MoXEMM_reserved_5_29" 191 "MoXEMM_reserved_5_30" 192 "MoXEMM_reserved_5_31" 193 "MoXEMM_SMU_ALM_6_0" 194 "MoXEMM_reserved_6_1" 195 "MoXEMM_reserved_6_2" 196 "MoXEMM_reserved_6_3" 197 "MoXEMM_SMU_ALM_6_4" 198 "MoXEMM_SMU_ALM_6_5" 199 "MoXEMM_reserved_6_6" 200 "MoXEMM_SMU_ALM_6_7" 201 "MoXEMM_SMU_ALM_6_8" 202 "MoXEMM_reserved_6_9" 203 "MoXEMM_reserved_6_10" 204 "MoXEMM_SMU_ALM_6_11" 205 "MoXEMM_SMU_ALM_6_12" 206 "MoXEMM_reserved_6_13" 207 "MoXEMM_SMU_ALM_6_14" 208 "MoXEMM_SMU_ALM_6_15" 209 "MoXEMM_reserved_6_16" 210 "MoXEMM_SMU_ALM_6_17" 211 "MoXEMM_SMU_ALM_6_18" 212 "MoXEMM_reserved_6_19" 213 "MoXEMM_SMU_ALM_6_20" 214 "MoXEMM_SMU_ALM_6_21" 215 "MoXEMM_reserved_6_22" 216 "MoXEMM_reserved_6_23" 217 "MoXEMM_reserved_6_24" 218 "MoXEMM_SMU_ALM_6_25" 219 "MoXEMM_reserved_6_26" 220 "MoXEMM_reserved_6_27" 221 "MoXEMM_reserved_6_28" 222 "MoXEMM_reserved_6_29" 223 "MoXEMM_reserved_6_30" 224 "MoXEMM_reserved_6_31" 225 "MoXEMM_reserved_7_0" 226 "MoXEMM_SMU_ALM_7_1" 227 "MoXEMM_SMU_ALM_7_2" 228 "MoXEMM_reserved_7_3" 229 "MoXEMM_reserved_7_4" 230 "MoXEMM_reserved_7_5" 231 "MoXEMM_reserved_7_6" 232 "MoXEMM_reserved_7_7" 233 "MoXEMM_reserved_7_8" 234 "MoXEMM_reserved_7_9" 235 "MoXEMM_reserved_7_10" 236 "MoXEMM_reserved_7_11" 237 "MoXEMM_SMU_ALM_7_12" 238 "MoXEMM_SMU_ALM_7_13" 239 "MoXEMM_SMU_ALM_7_14" 240 "MoXEMM_SMU_ALM_7_15" 241 "MoXEMM_SMU_ALM_7_16" 242 "MoXEMM_SMU_ALM_7_17" 243 "MoXEMM_reserved_7_18" 244 "MoXEMM_reserved_7_19" 245 "MoXEMM_SMU_ALM_7_20" 246 "MoXEMM_reserved_7_21" 247 "MoXEMM_reserved_7_22" 248 "MoXEMM_reserved_7_23" 249 "MoXEMM_reserved_7_24" 250 "MoXEMM_SMU_ALM_7_25" 251 "MoXEMM_SMU_ALM_7_26" 252 "MoXEMM_reserved_7_27" 253 "MoXEMM_SMU_ALM_7_28" 254 "MoXEMM_SMU_ALM_7_29" 255 "MoXEMM_SMU_ALM_7_30" 256 "MoXEMM_SMU_ALM_7_31" 257 "MoXEMM_SMU_ALM_8_0" 258 "MoXEMM_SMU_ALM_8_1" 259 "MoXEMM_SMU_ALM_8_2" 260 "MoXEMM_SMU_ALM_8_3" 261 "MoXEMM_SMU_ALM_8_4" 262 "MoXEMM_reserved_8_5" 263 "MoXEMM_reserved_8_6" 264 "MoXEMM_reserved_8_7" 265 "MoXEMM_SMU_ALM_8_8" 266 "MoXEMM_SMU_ALM_8_9" 267 "MoXEMM_SMU_ALM_8_10" 268 "MoXEMM_SMU_ALM_8_11" 269 "MoXEMM_SMU_ALM_8_12" 270 "MoXEMM_reserved_8_13" 271 "MoXEMM_reserved_8_14" 272 "MoXEMM_reserved_8_15" 273 "MoXEMM_SMU_ALM_8_16" 274 "MoXEMM_reserved_8_17" 275 "MoXEMM_SMU_ALM_8_18" 276 "MoXEMM_reserved_8_19" 277 "MoXEMM_reserved_8_20" 278 "MoXEMM_reserved_8_21" 279 "MoXEMM_reserved_8_22" 280 "MoXEMM_reserved_8_23" 281 "MoXEMM_reserved_8_24" 282 "MoXEMM_reserved_8_25" 283 "MoXEMM_reserved_8_26" 284 "MoXEMM_reserved_8_27" 285 "MoXEMM_reserved_8_28" 286 "MoXEMM_reserved_8_29" 287 "MoXEMM_SMU_ALM_8_30" 288 "MoXEMM_SMU_ALM_8_31" 289 "MoXEMM_SMU_ALM_9_0" 290 "MoXEMM_SMU_ALM_9_1" 291 "MoXEMM_reserved_9_2" 292 "MoXEMM_SMU_ALM_9_3" 293 "MoXEMM_reserved_9_4" 294 "MoXEMM_reserved_9_5" 295 "MoXEMM_reserved_9_6" 296 "MoXEMM_reserved_9_7" 297 "MoXEMM_reserved_9_8" 298 "MoXEMM_reserved_9_9" 299 "MoXEMM_reserved_9_10" 300 "MoXEMM_reserved_9_11" 301 "MoXEMM_reserved_9_12" 302 "MoXEMM_reserved_9_13" 303 "MoXEMM_reserved_9_14" 304 "MoXEMM_SMU_ALM_9_15" 305 "MoXEMM_reserved_9_16" 306 "MoXEMM_reserved_9_17" 307 "MoXEMM_reserved_9_18" 308 "MoXEMM_reserved_9_19" 309 "MoXEMM_reserved_9_20" 310 "MoXEMM_reserved_9_21" 311 "MoXEMM_reserved_9_22" 312 "MoXEMM_reserved_9_23" 313 "MoXEMM_reserved_9_24" 314 "MoXEMM_reserved_9_25" 315 "MoXEMM_reserved_9_26" 316 "MoXEMM_reserved_9_27" 317 "MoXEMM_reserved_9_28" 318 "MoXEMM_reserved_9_29" 319 "MoXEMM_reserved_9_30" 320 "MoXEMM_reserved_9_31" 321 "MoXEMM_reserved_10_0" 322 "MoXEMM_reserved_10_1" 323 "MoXEMM_reserved_10_2" 324 "MoXEMM_reserved_10_3" 325 "MoXEMM_reserved_10_4" 326 "MoXEMM_reserved_10_5" 327 "MoXEMM_reserved_10_6" 328 "MoXEMM_reserved_10_7" 329 "MoXEMM_reserved_10_8" 330 "MoXEMM_reserved_10_9" 331 "MoXEMM_reserved_10_10" 332 "MoXEMM_reserved_10_11" 333 "MoXEMM_reserved_10_12" 334 "MoXEMM_reserved_10_13" 335 "MoXEMM_reserved_10_14" 336 "MoXEMM_reserved_10_15" 337 "MoXEMM_SMU_ALM_10_16" 338 "MoXEMM_SMU_ALM_10_17" 339 "MoXEMM_reserved_10_18" 340 "MoXEMM_reserved_10_19" 341 "MoXEMM_reserved_10_20" 342 "MoXEMM_SMU_ALM_10_21" 343 "MoXEMM_reserved_10_22" 344 "MoXEMM_reserved_10_23" 345 "MoXEMM_reserved_10_24" 346 "MoXEMM_reserved_10_25" 347 "MoXEMM_reserved_10_26" 348 "MoXEMM_reserved_10_27" 349 "MoXEMM_reserved_10_28" 350 "MoXEMM_reserved_10_29" 351 "MoXEMM_reserved_10_30" 352 "MoXEMM_reserved_10_31" 353 "MoXEMM_SMU_ALM_11_0" 354 "MoXEMM_SMU_ALM_11_1" 355 "MoXEMM_SMU_ALM_11_2" 356 "MoXEMM_SMU_ALM_11_3" 357 "MoXEMM_SMU_ALM_11_4" 358 "MoXEMM_SMU_ALM_11_5" 359 "MoXEMM_reserved_11_6" 360 "MoXEMM_reserved_11_7" 361 "MoXEMM_SMU_ALM_11_8" 362 "MoXEMM_SMU_ALM_11_9" 363 "MoXEMM_reserved_11_10" 364 "MoXEMM_reserved_11_11" 365 "MoXEMM_reserved_11_12" 366 "MoXEMM_reserved_11_13" 367 "MoXEMM_reserved_11_14" 368 "MoXEMM_reserved_11_15" 369 "MoXEMM_reserved_11_16" 370 "MoXEMM_reserved_11_17" 371 "MoXEMM_reserved_11_18" 372 "MoXEMM_reserved_11_19" 373 "MoXEMM_reserved_11_20" 374 "MoXEMM_reserved_11_21" 375 "MoXEMM_reserved_11_22" 376 "MoXEMM_reserved_11_23" 377 "MoXEMM_reserved_11_24" 378 "MoXEMM_reserved_11_25" 379 "MoXEMM_reserved_11_26" 380 "MoXEMM_reserved_11_27" 381 "MoXEMM_reserved_11_28" 382 "MoXEMM_reserved_11_29" 383 "MoXEMM_reserved_11_30" 384 "MoXEMM_reserved_11_31" 641 "MoXEMM_reserved_20_0" 642 "MoXEMM_reserved_20_1" 643 "MoXEMM_reserved_20_2" 644 "MoXEMM_reserved_20_3" 645 "MoXEMM_reserved_20_4" 646 "MoXEMM_reserved_20_5" 647 "MoXEMM_reserved_20_6" 648 "MoXEMM_reserved_20_7" 649 "MoXEMM_reserved_20_8" 650 "MoXEMM_reserved_20_9" 651 "MoXEMM_reserved_20_10" 652 "MoXEMM_reserved_20_11" 653 "MoXEMM_reserved_20_12" 654 "MoXEMM_reserved_20_13" 655 "MoXEMM_reserved_20_14" 656 "MoXEMM_reserved_20_15" 657 "MoXEMM_reserved_20_16" 658 "MoXEMM_reserved_20_17" 659 "MoXEMM_reserved_20_18" 660 "MoXEMM_reserved_20_19" 661 "MoXEMM_reserved_20_20" 662 "MoXEMM_reserved_20_21" 663 "MoXEMM_reserved_20_22" 664 "MoXEMM_reserved_20_23" 665 "MoXEMM_reserved_20_24" 666 "MoXEMM_reserved_20_25" 667 "MoXEMM_reserved_20_26" 668 "MoXEMM_reserved_20_27" 669 "MoXEMM_reserved_20_28" 670 "MoXEMM_reserved_20_29" 671 "MoXEMM_reserved_20_30" 672 "MoXEMM_reserved_20_31" 673 "MoXEMM_SMU_ALM_21_0" 674 "MoXEMM_reserved_21_1" 675 "MoXEMM_reserved_21_2" 676 "MoXEMM_SMU_ALM_21_3" 677 "MoXEMM_reserved_21_4" 678 "MoXEMM_reserved_21_5" 679 "MoXEMM_reserved_21_6" 680 "MoXEMM_reserved_21_7" 681 "MoXEMM_reserved_21_8" 682 "MoXEMM_reserved_21_9" 683 "MoXEMM_reserved_21_10" 684 "MoXEMM_reserved_21_11" 685 "MoXEMM_reserved_21_12" 686 "MoXEMM_reserved_21_13" 687 "MoXEMM_reserved_21_14" 688 "MoXEMM_reserved_21_15" 689 "MoXEMM_SMU_ALM_21_16" 690 "MoXEMM_reserved_21_17" 691 "MoXEMM_reserved_21_18" 692 "MoXEMM_reserved_21_19" 693 "MoXEMM_reserved_21_20" 694 "MoXEMM_reserved_21_21" 695 "MoXEMM_reserved_21_22" 696 "MoXEMM_reserved_21_23" 697 "MoXEMM_reserved_21_24" 698 "MoXEMM_reserved_21_25" 699 "MoXEMM_reserved_21_26" 700 "MoXEMM_reserved_21_27" 701 "MoXEMM_reserved_21_28" 702 "MoXEMM_reserved_21_29" 703 "MoXEMM_reserved_21_30" 704 "MoXEMM_reserved_21_31" 65535 "MoXEMM_CLR_ERROR" /end COMPU_VTAB
/begin COMPU_METHOD m_uw_b6553p5 "" RAT_FUNC "%6.3" "kg/h" COEFFS 0 1 0 0 0 0.1 /end COMPU_METHOD
/begin COMPU_METHOD nmot_q0p5 "" RAT_FUNC "%6.3" "1/min" COEFFS 0 2 0 0 0 1 /end COMPU_METHOD
/begin COMPU_METHOD nmot_q40 "" RAT_FUNC "%6.1" "1/min" COEFFS 0 1 0 0 0 40 /end COMPU_METHOD
/begin COMPU_METHOD OneToOne "" RAT_FUNC "%6.2" "-" COEFFS 0 1 0 0 0 1 /end COMPU_METHOD
/begin COMPU_METHOD Prc "" RAT_FUNC "%6.4" "%" COEFFS 0 81.92 0 0 0 1 /end COMPU_METHOD
/begin COMPU_METHOD RBPtCel_tq_0p5_1 "" RAT_FUNC "%6.3" "Nm" COEFFS 0 2 0 0 0 1 /end COMPU_METHOD
/begin COMPU_METHOD rel_q0p39 "" RAT_FUNC "%6.3" "%" COEFFS 0 256 0 0 0 100 /end COMPU_METHOD
/begin COMPU_METHOD rel_sw_b1536 "" RAT_FUNC "%6.4" "%" COEFFS 0 65536 0 0 0 3072 /end COMPU_METHOD
/begin COMPU_METHOD rel_uw_b100 "" RAT_FUNC "%6.4" "%" COEFFS 0 65536 0 0 0 100 /end COMPU_METHOD
/begin COMPU_METHOD rel_uw_b3072 "" RAT_FUNC "%6.4" "%" COEFFS 0 65536 0 0 0 3072 /end COMPU_METHOD
/begin COMPU_METHOD rel_uw_q0p0234 "" RAT_FUNC "%6.4" "%" COEFFS 0 32 0 0 0 0.75 /end COMPU_METHOD
/begin COMPU_METHOD SigQly_COMPU_VERB "" TAB_VERB "%6.3" "" COMPU_TAB_REF SigQly_COMPU_VERB /end COMPU_METHOD
/begin COMPU_VTAB SigQly_COMPU_VERB "" TAB_VERB 16 0 "SIGQLY_NOTCALC" 1 "SIGQLY_INIT" 2 "SIGQLY_OK" 3 "SIGQLY_MODEL" 4 "SIGQLY_REPLACEMENT" 5 "SIGQLY_FROZEN" 6 "SIGQLY_INVALID" 7 "SIGQLY_RESERVED_7" 8 "SIGQLY_RESERVED_8" 9 "SIGQLY_RESERVED_9" 10 "SIGQLY_RESERVED_10" 11 "SIGQLY_RESERVED_11" 12 "SIGQLY_RESERVED_12" 13 "SIGQLY_RESERVED_13" 14 "SIGQLY_RESERVED_14" 15 "SIGQLY_RESERVED_15" /end COMPU_VTAB
/begin COMPU_METHOD spg_q0p001 "" RAT_FUNC "%6.5" "V" COEFFS 0 1000 0 0 0 1 /end COMPU_METHOD
/begin COMPU_METHOD SY_NSFLX_Compu "" RAT_FUNC "%6.2" "" COEFFS 0 1 0 0 0 1 /end COMPU_METHOD
/begin COMPU_METHOD SY_NSGEN_Compu "" RAT_FUNC "%6.2" "" COEFFS 0 1 0 0 0 1 /end COMPU_METHOD
/begin COMPU_METHOD SY_NSHTD_Compu "" RAT_FUNC "%6.2" "" COEFFS 0 1 0 0 0 1 /end COMPU_METHOD
/begin COMPU_METHOD SY_NSHTI_Compu "" RAT_FUNC "%6.2" "" COEFFS 0 1 0 0 0 1 /end COMPU_METHOD
/begin COMPU_METHOD SY_NSKO_Compu "" RAT_FUNC "%6.2" "" COEFFS 0 1 0 0 0 1 /end COMPU_METHOD
/begin COMPU_METHOD SY_NSLPH_Compu "" RAT_FUNC "%6.2" "" COEFFS 0 1 0 0 0 1 /end COMPU_METHOD
/begin COMPU_METHOD SY_NSLWR_Compu "" RAT_FUNC "%6.2" "" COEFFS 0 1 0 0 0 1 /end COMPU_METHOD
/begin COMPU_METHOD SY_NSPST_Compu "" RAT_FUNC "%6.2" "" COEFFS 0 1 0 0 0 1 /end COMPU_METHOD
/begin COMPU_METHOD SY_NSPTS_Compu "" RAT_FUNC "%6.2" "" COEFFS 0 1 0 0 0 1 /end COMPU_METHOD
/begin COMPU_METHOD SY_NSPWG_Compu "" RAT_FUNC "%6.2" "" COEFFS 0 1 0 0 0 1 /end COMPU_METHOD
/begin COMPU_METHOD SY_NSP_Compu "" TAB_VERB "%6.3" "" COMPU_TAB_REF SY_NSP_Compu /end COMPU_METHOD
/begin COMPU_VTAB SY_NSP_Compu "" TAB_VERB 2 0 "NO_POSTINJ" 1 "POSTINJ" /end COMPU_VTAB
/begin COMPU_METHOD SY_NSREC_Compu "" RAT_FUNC "%6.2" "" COEFFS 0 1 0 0 0 1 /end COMPU_METHOD
/begin COMPU_METHOD SY_NSRNG_Compu "" RAT_FUNC "%6.2" "" COEFFS 0 1 0 0 0 1 /end COMPU_METHOD
/begin COMPU_METHOD SY_NSSTR_Compu "" RAT_FUNC "%6.2" "" COEFFS 0 1 0 0 0 1 /end COMPU_METHOD
/begin COMPU_METHOD SY_NSTCU_Compu "" RAT_FUNC "%6.2" "" COEFFS 0 1 0 0 0 1 /end COMPU_METHOD
/begin COMPU_METHOD SY_NSTST_Compu "" RAT_FUNC "%6.2" "" COEFFS 0 1 0 0 0 1 /end COMPU_METHOD
/begin COMPU_METHOD SY_NSVSP_Compu "" RAT_FUNC "%6.2" "" COEFFS 0 1 0 0 0 1 /end COMPU_METHOD
/begin COMPU_METHOD SY_NSWIH_Compu "" RAT_FUNC "%6.2" "" COEFFS 0 1 0 0 0 1 /end COMPU_METHOD
/begin COMPU_METHOD SY_NVLD_Compu "" TAB_VERB "%6.3" "" COMPU_TAB_REF SY_NVLD_Compu /end COMPU_METHOD
/begin COMPU_VTAB SY_NVLD_Compu "" TAB_VERB 2 0 "False" 1 "True" /end COMPU_VTAB
/begin COMPU_METHOD SY_NVRAMBK_Compu "" TAB_VERB "%6.3" "" COMPU_TAB_REF SY_NVRAMBK_Compu /end COMPU_METHOD
/begin COMPU_VTAB SY_NVRAMBK_Compu "" TAB_VERB 2 0 "kein nonvolatileRAM backup" 1 "nonvolatileRAM backup" /end COMPU_VTAB
/begin COMPU_METHOD SY_NWGA2_Compu "" TAB_VERB "%6.3" "" COMPU_TAB_REF SY_NWGA2_Compu /end COMPU_METHOD
/begin COMPU_VTAB SY_NWGA2_Compu "" TAB_VERB 5 0 "kein Phasengeber auf Nockenwelle verbaut" 1 "Phasengeber 1 auf Nockenwelle Auslass 2" 2 "Phasengeber 2 auf Nockenwelle Auslass 2" 3 "Phasengeber 3 auf Nockenwelle Auslass 2" 4 "Phasengeber 4 auf Nockenwelle Auslass 2" /end COMPU_VTAB
/begin COMPU_METHOD SY_NWGA_Compu "" TAB_VERB "%6.3" "" COMPU_TAB_REF SY_NWGA_Compu /end COMPU_METHOD
/begin COMPU_VTAB SY_NWGA_Compu "" TAB_VERB 5 0 "kein Phasengeber auf Nockenwelle verbaut" 1 "Phasengeber 1 auf Nockenwelle Auslass" 2 "Phasengeber 2 auf Nockenwelle Auslass" 3 "Phasengeber 3 auf Nockenwelle Auslass" 4 "Phasengeber 4 auf Nockenwelle Auslass" /end COMPU_VTAB
/begin COMPU_METHOD SY_NWGE2_Compu "" TAB_VERB "%6.3" "" COMPU_TAB_REF SY_NWGE2_Compu /end COMPU_METHOD
/begin COMPU_VTAB SY_NWGE2_Compu "" TAB_VERB 5 0 "kein Phasengeber auf Nockenwelle verbaut" 1 "Phasengeber 1 auf Nockenwelle Einlass 2" 2 "Phasengeber 2 auf Nockenwelle Einlass 2" 3 "Phasengeber 3 auf Nockenwelle Einlass 2" 4 "Phasengeber 4 auf Nockenwelle Einlass 2" /end COMPU_VTAB
/begin COMPU_METHOD SY_NWGE_Compu "" TAB_VERB "%6.3" "" COMPU_TAB_REF SY_NWGE_Compu /end COMPU_METHOD
/begin COMPU_VTAB SY_NWGE_Compu "" TAB_VERB 5 0 "kein Phasengeber auf Nockenwelle verbaut" 1 "Phasengeber 1 auf Nockenwelle Einlass" 2 "Phasengeber 2 auf Nockenwelle Einlass" 3 "Phasengeber 3 auf Nockenwelle Einlass" 4 "Phasengeber 4 auf Nockenwelle Einlass" /end COMPU_VTAB
/begin COMPU_METHOD SY_NWMSV_Compu "" TAB_VERB "%6.3" "" COMPU_TAB_REF SY_NWMSV_Compu /end COMPU_METHOD
/begin COMPU_VTAB SY_NWMSV_Compu "" TAB_VERB 9 0 "HDP mounted on fixed camshaft" 1 "HDP mounted on camshaft customer controlled" 2 "HDP mounted on inlet valve camshaft controlled" 3 "HDP mounted on outlet valve camshaft controlled" 4 "HDP mounted on inlet valve camshaft bank 2" 5 "HDP mounted on outlet valve camshaft bank 2" 6 "HDP mounted on intermediate shaft" 7 "HDP mounted on intermediate shaft with asymmetric" 8 "mounting of HDP is calibrated" /end COMPU_VTAB
/begin COMPU_METHOD SY_NWSA_Compu "" TAB_VERB "%6.3" "" COMPU_TAB_REF SY_NWSA_Compu /end COMPU_METHOD
/begin COMPU_VTAB SY_NWSA_Compu "" TAB_VERB 3 0 "no outlet camshaft control" 1 "2 point outlet camshaft control" 2 "continuous outlet camshaft control" /end COMPU_VTAB
/begin COMPU_METHOD SY_NWSHSS_Compu "" TAB_VERB "%6.3" "" COMPU_TAB_REF SY_NWSHSS_Compu /end COMPU_METHOD
/begin COMPU_VTAB SY_NWSHSS_Compu "" TAB_VERB 2 0 "False" 1 "True" /end COMPU_VTAB
/begin COMPU_METHOD SY_NWSKR_Compu "" TAB_VERB "%6.3" "" COMPU_TAB_REF SY_NWSKR_Compu /end COMPU_METHOD
/begin COMPU_VTAB SY_NWSKR_Compu "" TAB_VERB 2 0 "ErkennungDerVentilVerstellungDynamik_Unaktiv" 1 "ErkennungDerVentilVerstellungDynamik_Aktiv" /end COMPU_VTAB
/begin COMPU_METHOD SY_NWSV_Compu "" TAB_VERB "%6.3" "" COMPU_TAB_REF SY_NWSV_Compu /end COMPU_METHOD
/begin COMPU_VTAB SY_NWSV_Compu "" TAB_VERB 4 0 "DICP" 1 "DECP" 2 "DDCPI" 3 "DDCPE" /end COMPU_VTAB
/begin COMPU_METHOD SY_NWS_Compu "" TAB_VERB "%6.3" "" COMPU_TAB_REF SY_NWS_Compu /end COMPU_METHOD
/begin COMPU_VTAB SY_NWS_Compu "" TAB_VERB 3 0 "keine Nockenwellensteuerung vorhanden" 1 "2 Punkt Nockenwellensteuerung vorhanden" 2 "kontinuierliche Nockenwellensteuerung vorhanden" /end COMPU_VTAB
/begin COMPU_METHOD SY_OBDBR05_Compu "" TAB_VERB "%6.3" "" COMPU_TAB_REF SY_OBDBR05_Compu /end COMPU_METHOD
/begin COMPU_VTAB SY_OBDBR05_Compu "" TAB_VERB 2 0 "OBD2 2005 Biennial Review will be deactivated" 1 "OBD2 2005 Biennial Review will be activated" /end COMPU_VTAB
/begin COMPU_METHOD SY_OBMD_Compu "" TAB_VERB "%6.3" "" COMPU_TAB_REF SY_OBMD_Compu /end COMPU_METHOD
/begin COMPU_VTAB SY_OBMD_Compu "" TAB_VERB 2 0 "Overboost füllungsbasiert" 1 "Overboost momentenbasiert" /end COMPU_VTAB
/begin COMPU_METHOD SY_OSTERST_Compu "" TAB_VERB "%6.3" "" COMPU_TAB_REF SY_OSTERST_Compu /end COMPU_METHOD
/begin COMPU_VTAB SY_OSTERST_Compu "" TAB_VERB 2 0 "SY_OSTERST == 0" 1 "SY_OSTERST > 0" /end COMPU_VTAB
/begin COMPU_METHOD SY_OSTNOFF_Compu "" TAB_VERB "%6.3" "" COMPU_TAB_REF SY_OSTNOFF_Compu /end COMPU_METHOD
/begin COMPU_VTAB SY_OSTNOFF_Compu "" TAB_VERB 2 0 "FALSE" 1 "TRUE" /end COMPU_VTAB
/begin COMPU_METHOD SY_OTMERST_Compu "" TAB_VERB "%6.3" "" COMPU_TAB_REF SY_OTMERST_Compu /end COMPU_METHOD
/begin COMPU_VTAB SY_OTMERST_Compu "" TAB_VERB 2 0 "SY_OTMERST==0" 1 "SY_OTMERST>0" /end COMPU_VTAB
/begin COMPU_METHOD SY_PABMODU_Compu "" TAB_VERB "%6.3" "" COMPU_TAB_REF SY_PABMODU_Compu /end COMPU_METHOD
/begin COMPU_VTAB SY_PABMODU_Compu "" TAB_VERB 4 0 "SY_PABMODU_0" 1 "SY_PABMODU_1" 2 "SY_PABMODU_2" 3 "SY_PABMODU_3" /end COMPU_VTAB
/begin COMPU_METHOD SY_PAFGBE_Compu "" TAB_VERB "%6.3" "" COMPU_TAB_REF SY_PAFGBE_Compu /end COMPU_METHOD
/begin COMPU_VTAB SY_PAFGBE_Compu "" TAB_VERB 2 0 "end of line features not activated" 1 "end of line features activated" /end COMPU_VTAB
/begin COMPU_METHOD SY_PEMDIA_Compu "" TAB_VERB "%6.3" "" COMPU_TAB_REF SY_PEMDIA_Compu /end COMPU_METHOD
/begin COMPU_VTAB SY_PEMDIA_Compu "" TAB_VERB 6 0 "no_PEM_Diagnosis" 1 "PEM_Diag_on" 2 "PWMDIAG_20HZ" 3 "PWMDIAG_100Hz" 4 "PWMDIAG" 5 "pwm" /end COMPU_VTAB
/begin COMPU_METHOD SY_PID41_Compu "" TAB_VERB "%6.3" "" COMPU_TAB_REF SY_PID41_Compu /end COMPU_METHOD
/begin COMPU_VTAB SY_PID41_Compu "" TAB_VERB 2 0 "False" 1 "True" /end COMPU_VTAB
/begin COMPU_METHOD SY_PLNGFIL_Compu "" TAB_VERB "%6.3" "" COMPU_TAB_REF SY_PLNGFIL_Compu /end COMPU_METHOD
/begin COMPU_VTAB SY_PLNGFIL_Compu "" TAB_VERB 2 0 "false" 1 "true" /end COMPU_VTAB
/begin COMPU_METHOD SY_PRIOHOM_Compu "" RAT_FUNC "%6.2" "" COEFFS 0 1 0 0 0 1 /end COMPU_METHOD
/begin COMPU_METHOD SY_PRIOHSP_Compu "" RAT_FUNC "%6.2" "" COEFFS 0 1 0 0 0 1 /end COMPU_METHOD
/begin COMPU_METHOD SY_PRIOMOD_Compu "" RAT_FUNC "%6.2" "" COEFFS 0 1 0 0 0 1 /end COMPU_METHOD
/begin COMPU_METHOD SY_PRSOLAD_Compu "" TAB_VERB "%6.3" "" COMPU_TAB_REF SY_PRSOLAD_Compu /end COMPU_METHOD
/begin COMPU_VTAB SY_PRSOLAD_Compu "" TAB_VERB 2 0 "False" 1 "True" /end COMPU_VTAB
/begin COMPU_METHOD SY_PSF_Compu "" TAB_VERB "%6.3" "" COMPU_TAB_REF SY_PSF_Compu /end COMPU_METHOD
/begin COMPU_VTAB SY_PSF_Compu "" TAB_VERB 2 0 "gefilterter Saugrohrdruck nicht verwendet" 1 "gefilterter Saugrohrdruck verwendet" /end COMPU_VTAB
/begin COMPU_METHOD SY_PSMXAPP_Compu "" TAB_VERB "%6.3" "" COMPU_TAB_REF SY_PSMXAPP_Compu /end COMPU_METHOD
/begin COMPU_VTAB SY_PSMXAPP_Compu "" TAB_VERB 3 0 "not for test bench" 1 "also for test bench (1 map for all lean modes)" 2 "also for test bench (maps for all lean modes)" /end COMPU_VTAB
/begin COMPU_METHOD SY_PSR2SYN_Compu "" TAB_VERB "%6.3" "" COMPU_TAB_REF SY_PSR2SYN_Compu /end COMPU_METHOD
/begin COMPU_VTAB SY_PSR2SYN_Compu "" TAB_VERB 2 0 "False" 1 "True" /end COMPU_VTAB
/begin COMPU_METHOD SY_PSTDRST_Compu "" TAB_VERB "%6.3" "" COMPU_TAB_REF SY_PSTDRST_Compu /end COMPU_METHOD
/begin COMPU_VTAB SY_PSTDRST_Compu "" TAB_VERB 2 0 "false" 1 "true" /end COMPU_VTAB
/begin COMPU_METHOD SY_PSUV_Compu "" TAB_VERB "%6.3" "" COMPU_TAB_REF SY_PSUV_Compu /end COMPU_METHOD
/begin COMPU_VTAB SY_PSUV_Compu "" TAB_VERB 2 0 "False" 1 "True" /end COMPU_VTAB
/begin COMPU_METHOD SY_PTLHC_Compu "" TAB_VERB "%6.3" "" COMPU_TAB_REF SY_PTLHC_Compu /end COMPU_METHOD
/begin COMPU_VTAB SY_PTLHC_Compu "" TAB_VERB 2 0 "False" 1 "True" /end COMPU_VTAB
/begin COMPU_METHOD SY_PTL_Compu "" TAB_VERB "%6.3" "" COMPU_TAB_REF SY_PTL_Compu /end COMPU_METHOD
/begin COMPU_VTAB SY_PTL_Compu "" TAB_VERB 2 0 "relative inner moment" 1 "Physical Torque Levels" /end COMPU_VTAB
/begin COMPU_METHOD SY_PTO_Compu "" TAB_VERB "%6.3" "" COMPU_TAB_REF SY_PTO_Compu /end COMPU_METHOD
/begin COMPU_VTAB SY_PTO_Compu "" TAB_VERB 2 0 "False" 1 "True" /end COMPU_VTAB
/begin COMPU_METHOD SY_RDE_Compu "" TAB_VERB "%6.3" "" COMPU_TAB_REF SY_RDE_Compu /end COMPU_METHOD
/begin COMPU_VTAB SY_RDE_Compu "" TAB_VERB 5 0 "inaktiv bzw. keine RDE" 1 "über Auswertung des Zahnsignals der Kurbelwelle" 2 "über Nockenwellen-Muster" 3 "über Zahnsignal der KW und NW-Muster" 4 "wie 3 und zusätzlich über Saugrohrdruck" /end COMPU_VTAB
/begin COMPU_METHOD SY_RDYTLDX_Compu "" TAB_VERB "%6.3" "" COMPU_TAB_REF SY_RDYTLDX_Compu /end COMPU_METHOD
/begin COMPU_VTAB SY_RDYTLDX_Compu "" TAB_VERB 2 0 "no calculation" 1 "calculation" /end COMPU_VTAB
/begin COMPU_METHOD SY_REDEX_Compu "" TAB_VERB "%6.3" "" COMPU_TAB_REF SY_REDEX_Compu /end COMPU_METHOD
/begin COMPU_VTAB SY_REDEX_Compu "" TAB_VERB 2 0 "0" 1 "1" /end COMPU_VTAB
/begin COMPU_METHOD SY_REDMI_Compu "" TAB_VERB "%6.3" "" COMPU_TAB_REF SY_REDMI_Compu /end COMPU_METHOD
/begin COMPU_VTAB SY_REDMI_Compu "" TAB_VERB 2 0 "False" 1 "True" /end COMPU_VTAB
/begin COMPU_METHOD SY_REDSTAR_Compu "" TAB_VERB "%6.3" "" COMPU_TAB_REF SY_REDSTAR_Compu /end COMPU_METHOD
/begin COMPU_VTAB SY_REDSTAR_Compu "" TAB_VERB 2 0 "FALSE" 1 "TRUE" /end COMPU_VTAB
/begin COMPU_METHOD SY_RLAPP_Compu "" TAB_VERB "%6.3" "" COMPU_TAB_REF SY_RLAPP_Compu /end COMPU_METHOD
/begin COMPU_VTAB SY_RLAPP_Compu "" TAB_VERB 2 0 "keine rlsol-Regelung vorhanden" 1 "rlsol-Regelung vorhanden" /end COMPU_VTAB
/begin COMPU_METHOD t10msxs_ub_q0p01 "" RAT_FUNC "%6.4" "s" COEFFS 0 1 0 0 0 0.01 /end COMPU_METHOD
/begin COMPU_METHOD t10msxs_uw_b655p35 "" RAT_FUNC "%6.4" "s" COEFFS 0 1 0 0 0 0.01 /end COMPU_METHOD
/begin COMPU_METHOD t1sxs_uw_q1 "" RAT_FUNC "%6.2" "s" COEFFS 0 1 0 0 0 1 /end COMPU_METHOD
/begin COMPU_METHOD t40msxs_ub_q0p04 "" RAT_FUNC "%6.4" "s" COEFFS 0 1 0 0 0 0.04 /end COMPU_METHOD
/begin COMPU_METHOD Temp_Cels "" RAT_FUNC "%6.1" "deg C" COEFFS 0 10 2731.4 0 0 1 /end COMPU_METHOD
/begin COMPU_METHOD temp_ub_q0p75_o48 "" RAT_FUNC "%6.2" "Grad C" COEFFS 0 1 48 0 0 0.75 /end COMPU_METHOD
/begin COMPU_METHOD TimeDelay_ms "" RAT_FUNC "%13.2" "ms" COEFFS 0 0 1 0 2.3283064365387e-007 0 /end COMPU_METHOD
/begin COMPU_METHOD Time_ms "" RAT_FUNC "%6.1" "ms" COEFFS 0 0.1 0 0 0 1 /end COMPU_METHOD
/begin COMPU_METHOD t_q0p01 "" RAT_FUNC "%6.4" "s" COEFFS 0 100 0 0 0 1 /end COMPU_METHOD
/begin COMPU_METHOD vel_q0p01 "" RAT_FUNC "%6.4" "km/h" COEFFS 0 100 0 0 0 1 /end COMPU_METHOD
/begin COMPU_METHOD zk10msxs_uw_b655 "" RAT_FUNC "%6.2" "s" COEFFS 0 0 65536 0 100 0 /end COMPU_METHOD
/begin COMPU_METHOD zk10msxs_uw_b655p36PT1 "" RAT_FUNC "%6.2" "s" COEFFS 0 0 65536 0 100 1 /end COMPU_METHOD
/begin COMPU_METHOD zk40msxs_uw_b2621p44PT1 "" RAT_FUNC "%6.1" "s" COEFFS 0 0 65536 0 25 1 /end COMPU_METHOD
/begin COMPU_METHOD zw_q0p05 "" RAT_FUNC "%6.4" "Grad KW" COEFFS 0 20 0 0 0 1 /end COMPU_METHOD
/begin COMPU_METHOD zw_q0p1 "" RAT_FUNC "%6.3" "Grad KW" COEFFS 0 10 0 0 0 1 /end COMPU_METHOD
/begin COMPU_METHOD zw_sb_q0p75 "" RAT_FUNC "%6.3" "Grad KW" COEFFS 0 255 0 0 0 191.25 /end COMPU_METHOD
/begin COMPU_METHOD default "" RAT_FUNC "%6.2" "" COEFFS 0 1 0 0 0 1 /end COMPU_METHOD
/begin RECORD_LAYOUT Map_Xs16Ys16Ws16 NO_AXIS_PTS_X 1 SWORD NO_AXIS_PTS_Y 2 SWORD AXIS_PTS_X 3 SWORD INDEX_INCR DIRECT AXIS_PTS_Y 4 SWORD INDEX_INCR DIRECT FNC_VALUES 5 SWORD COLUMN_DIR DIRECT /end RECORD_LAYOUT
/begin RECORD_LAYOUT Map_Xu8Yu8Wu8 NO_AXIS_PTS_X 1 UBYTE NO_AXIS_PTS_Y 2 UBYTE AXIS_PTS_X 3 UBYTE INDEX_INCR DIRECT AXIS_PTS_Y 4 UBYTE INDEX_INCR DIRECT FNC_VALUES 5 UBYTE COLUMN_DIR DIRECT /end RECORD_LAYOUT
/begin RECORD_LAYOUT Mo_DataCurveSstS16WS16 NO_AXIS_PTS_X 1 SWORD AXIS_PTS_X 2 SWORD INDEX_INCR DIRECT FNC_VALUES 3 SWORD COLUMN_DIR DIRECT /end RECORD_LAYOUT
/begin RECORD_LAYOUT Mo_DataCurveSstU8WU8 NO_AXIS_PTS_X 1 UBYTE AXIS_PTS_X 2 UBYTE INDEX_INCR DIRECT FNC_VALUES 3 UBYTE COLUMN_DIR DIRECT /end RECORD_LAYOUT
/begin RECORD_LAYOUT RB_Axis_S16 NO_AXIS_PTS_X 1 SWORD AXIS_PTS_X 2 SWORD INDEX_INCR DIRECT /end RECORD_LAYOUT
/begin RECORD_LAYOUT RB_Axis_U16 NO_AXIS_PTS_X 1 UWORD AXIS_PTS_X 2 UWORD INDEX_INCR DIRECT /end RECORD_LAYOUT
/begin RECORD_LAYOUT RB_Axis_U8 NO_AXIS_PTS_X 1 UBYTE AXIS_PTS_X 2 UBYTE INDEX_INCR DIRECT /end RECORD_LAYOUT
/begin RECORD_LAYOUT RB_CurveGroup_U16 FNC_VALUES 1 UWORD COLUMN_DIR DIRECT /end RECORD_LAYOUT
/begin RECORD_LAYOUT RB_CurveGroup_U8 FNC_VALUES 1 UBYTE COLUMN_DIR DIRECT /end RECORD_LAYOUT
/begin RECORD_LAYOUT RB_Curve_S16_S16 NO_AXIS_PTS_X 1 SWORD AXIS_PTS_X 2 SWORD INDEX_INCR DIRECT FNC_VALUES 3 SWORD COLUMN_DIR DIRECT /end RECORD_LAYOUT
/begin RECORD_LAYOUT RB_Curve_S16_U16_Static NO_AXIS_PTS_X 1 SWORD AXIS_PTS_X 2 SWORD INDEX_INCR DIRECT FNC_VALUES 3 UWORD COLUMN_DIR DIRECT STATIC_RECORD_LAYOUT /end RECORD_LAYOUT
/begin RECORD_LAYOUT RB_Curve_U16_U8_Static NO_AXIS_PTS_X 1 UWORD AXIS_PTS_X 2 UWORD INDEX_INCR DIRECT FNC_VALUES 3 UBYTE COLUMN_DIR DIRECT STATIC_RECORD_LAYOUT /end RECORD_LAYOUT
/begin RECORD_LAYOUT RB_MapGroup_U16 FNC_VALUES 1 UWORD COLUMN_DIR DIRECT /end RECORD_LAYOUT
/begin RECORD_LAYOUT RB_Map_U8S16_U16 NO_AXIS_PTS_X 1 UBYTE NO_AXIS_PTS_Y 2 UBYTE AXIS_PTS_X 3 UBYTE INDEX_INCR DIRECT AXIS_PTS_Y 4 SWORD INDEX_INCR DIRECT FNC_VALUES 5 UWORD ROW_DIR DIRECT /end RECORD_LAYOUT
/begin RECORD_LAYOUT RB_Val_Wboolean FNC_VALUES 1 UBYTE COLUMN_DIR DIRECT /end RECORD_LAYOUT
/begin RECORD_LAYOUT RB_Val_Ws16 FNC_VALUES 1 SWORD COLUMN_DIR DIRECT /end RECORD_LAYOUT
/begin RECORD_LAYOUT RB_Val_Wu16 FNC_VALUES 1 UWORD COLUMN_DIR DIRECT /end RECORD_LAYOUT
/begin RECORD_LAYOUT RB_Val_Wu8 FNC_VALUES 1 UBYTE COLUMN_DIR DIRECT /end RECORD_LAYOUT
/begin RECORD_LAYOUT Val_Ws16 FNC_VALUES 1 SWORD COLUMN_DIR DIRECT /end RECORD_LAYOUT
/begin RECORD_LAYOUT Val_Ws32 FNC_VALUES 1 SLONG COLUMN_DIR DIRECT /end RECORD_LAYOUT
/begin RECORD_LAYOUT Val_Wu16 FNC_VALUES 1 UWORD COLUMN_DIR DIRECT /end RECORD_LAYOUT
/begin RECORD_LAYOUT Val_Wu8 FNC_VALUES 1 UBYTE COLUMN_DIR DIRECT /end RECORD_LAYOUT
/end MODULE
/end PROJECT
