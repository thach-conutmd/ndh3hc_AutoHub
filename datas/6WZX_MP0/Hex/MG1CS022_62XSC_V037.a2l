ASAP2_VERSION 1 60
/begin PROJECT MG1CS022 "MG1CS022"
/begin HEADER "" VERSION "MG1CS022_62XSC_V037" PROJECT_NO MG1CS022 /end HEADER
/begin MODULE DIM ""
/begin MOD_COMMON "" BYTE_ORDER MSB_LAST ALIGNMENT_BYTE 1 ALIGNMENT_WORD 2 ALIGNMENT_LONG 4 ALIGNMENT_INT64 4 ALIGNMENT_FLOAT32_IEEE 4 ALIGNMENT_FLOAT64_IEEE 4 DATA_SIZE 32 /end MOD_COMMON
/begin CHARACTERISTIC UEGO_facDesUpFltCon_C "Filter Desired time constant." VALUE 0x805820D2 RB_Val_Wu16 0.9999847 fak_uw_b1 0.00 0.9999847 FORMAT "%9.7" /end CHARACTERISTIC
/begin CHARACTERISTIC UEGO_facUpFltCon_C "Filter time constant." VALUE 0x805820D4 RB_Val_Wu16 0.9999847 fak_uw_b1 0.00 0.9999847 FORMAT "%9.7" /end CHARACTERISTIC
/begin CHARACTERISTIC UEGO_iIPmpBlckn_C "Replacement pump current for Analog ASIC." VALUE 0x805820C2 RB_Val_Ws16 0.04369000 i_q6p6667Em7_A -0.02184533 0.02184467 FORMAT "%10.8" /end CHARACTERISTIC
/begin CHARACTERISTIC UEGO_nrIPmpBlckn_C "Replacement pump current for Digital ASIC." VALUE 0x805820C4 RB_Val_Ws16 12024.00 OneToOne -6012.000 6012.000 FORMAT "%8.3" EXTENDED_LIMITS -32768.00 32767.00 /end CHARACTERISTIC
/begin CHARACTERISTIC UEGO_nrIPmpNotOKThd_C "Number of invalid pump current cycles threshold to determine blackening protection activation status." VALUE 0x805820D6 RB_Val_Wu8 255.0 OneToOne 0.00 255.0 FORMAT "%5.1" /end CHARACTERISTIC
/begin CHARACTERISTIC UEGO_stUNernstCtrl_C "Codeword for Feature Activation of Funktion UEGO_UNernstCtrl" VALUE 0x805820A0 RB_Val_Wu8 255.0 dez 0.00 255.0 FORMAT "%5.1" /end CHARACTERISTIC
/begin CHARACTERISTIC UEGO_stUPmpLimn_C "RPmp Calculation enabling condition." VALUE 0x805820C6 RB_Val_Wu16 65535.00 OneToOne 0.00 65535.00 FORMAT "%8.2" /end CHARACTERISTIC
/begin CHARACTERISTIC UEGO_tiDlyDeltaUn_C "Waiting time for the Timer based UNernst register data resend" VALUE 0x805820A2 RB_Val_Wu16 655.3500 t_q0p01 0.00 655.3500 FORMAT "%8.4" /end CHARACTERISTIC
/begin CHARACTERISTIC UEGO_tiRegReclcUpLimn_C "Time period for resending of registers related to blackening protection." VALUE 0x805820C8 RB_Val_Wu16 655.3500 t_q0p01 0.00 655.3500 FORMAT "%8.4" /end CHARACTERISTIC
/begin CHARACTERISTIC UEGO_tiRegResendTmr_C "Waiting time for the Timer based UNernst register data resend" VALUE 0x805820A4 RB_Val_Wu16 655.3500 t_q0p01 0.00 655.3500 FORMAT "%8.4" /end CHARACTERISTIC
/begin CHARACTERISTIC UEGO_tiUPhyRawFilConLrg_C "Filter Constant for Strong Filtering when delta Unernst Raw voltage is Large" VALUE 0x805820A6 RB_Val_Wu16 655.3400 t_q0p01 0.0100 655.3500 FORMAT "%8.4" EXTENDED_LIMITS 0.00 655.3500 /end CHARACTERISTIC
/begin CHARACTERISTIC UEGO_tiUPhyRawFilConSml_C "Filter Constant for Strong Filtering when delta Unernst Raw voltage is small" VALUE 0x805820A8 RB_Val_Wu16 655.3400 t_q0p01 0.0100 655.3500 FORMAT "%8.4" EXTENDED_LIMITS 0.00 655.3500 /end CHARACTERISTIC
/begin CHARACTERISTIC UEGO_tiUPmpLimnHys_C "Return time hysterisis of blackening protection (input to register THYS_BLACK)" VALUE 0x805820CA RB_Val_Wu16 43.69000 t_q6p6666Em4 0.00 43.69000 FORMAT "%8.5" /end CHARACTERISTIC
/begin CHARACTERISTIC UEGO_tUNernstSafeModHysDelta_C "Lower Hysteresis Threshold for re-entry into Safe Modus" VALUE 0x805820AA RB_Val_Wu16 1535.977 temp_q0p0234_o273 -273.150 1262.827 FORMAT "%8.3" /end CHARACTERISTIC
/begin CHARACTERISTIC UEGO_tUNernstSafeModHysDi_C "Delta for the Safe mode Hysteresis Threshold" VALUE 0x805820AC RB_Val_Wu16 1535.977 temp_q0p0234_o273 -273.150 1262.827 FORMAT "%8.3" /end CHARACTERISTIC
/begin CHARACTERISTIC UEGO_uDeltaUn_C "" VALUE 0x805820AE RB_Val_Ws16 20.97120 spg_q3p2Em4_V -10.48576 10.48544 FORMAT "%8.5" /end CHARACTERISTIC
/begin CHARACTERISTIC UEGO_uPhyRawDeltaFilThd_C "Threshold for delta UNernst physical Raw voltage above which Strong filter constant is set to the Filter." VALUE 0x805820B0 RB_Val_Ws16 20.97120 spg_q3p2Em4_V -10.48576 10.48544 FORMAT "%8.5" /end CHARACTERISTIC
/begin CHARACTERISTIC UEGO_uUNernstDiagFilMaxIni_C "" VALUE 0x805820B8 RB_Val_Wu16 10.48544 spg_q3p2Em4_V 0.00 10.48544 FORMAT "%8.5" EXTENDED_LIMITS 0.00 20.97120 /end CHARACTERISTIC
/begin CHARACTERISTIC UEGO_uUNernstEntryDeltaLowrMaxThd_C "Lower entry threshold for setting flgUNersntInRng" VALUE 0x805820BA RB_Val_Ws16 20.97120 spg_q3p2Em4_V -10.48576 10.48544 FORMAT "%8.5" /end CHARACTERISTIC
/begin CHARACTERISTIC UEGO_uUNernstEntryDeltaUpprMaxThd_C "Upper entry threshold for setting flgUNersntInRng" VALUE 0x805820BC RB_Val_Ws16 20.97120 spg_q3p2Em4_V -10.48576 10.48544 FORMAT "%8.5" /end CHARACTERISTIC
/begin CHARACTERISTIC UEGO_uUNernstExDeltaLowrMaxThd_C "Lower exit threshold for unsetting flgUNersntInRng" VALUE 0x805820BE RB_Val_Ws16 20.97120 spg_q3p2Em4_V -10.48576 10.48544 FORMAT "%8.5" /end CHARACTERISTIC
/begin CHARACTERISTIC UEGO_uUNernstExDeltaUpprMaxThd_C "Upper exit threshold for unsetting flgUNersntInRng" VALUE 0x805820C0 RB_Val_Ws16 20.97120 spg_q3p2Em4_V -10.48576 10.48544 FORMAT "%8.5" /end CHARACTERISTIC
/begin CHARACTERISTIC UEGO_uUNernstSafe_C "UNernst Voltage for Safe Mode to Protect the Sensor" VALUE 0x805820B2 RB_Val_Ws16 20.97120 spg_q3p2Em4_V -10.48576 10.48544 FORMAT "%8.5" /end CHARACTERISTIC
/begin CHARACTERISTIC UEGO_uUNernstStd_C "UNernst voltage for Standard Mode" VALUE 0x805820B4 RB_Val_Ws16 20.97120 spg_q3p2Em4_V -10.48576 10.48544 FORMAT "%8.5" /end CHARACTERISTIC
/begin CHARACTERISTIC UEGO_uUNernstStopPhaSafe_C "UNernst voltage for Stop Phase Mode" VALUE 0x805820B6 RB_Val_Ws16 20.97120 spg_q3p2Em4_V -10.48576 10.48544 FORMAT "%8.5" /end CHARACTERISTIC
/begin CHARACTERISTIC UEGO_uUPmpLimnHys_C "Return voltage hysterisis of blackening protection (input to register FU0HYS)" VALUE 0x805820CC RB_Val_Wu8 1.200 spg_q0p08_V 0.00 1.200 FORMAT "%5.3" EXTENDED_LIMITS 0.00 20.40 /end CHARACTERISTIC
/begin CHARACTERISTIC UEGO_uUPmpLimnLean_C "Lean pump voltage threshold to activate blackening protection(input to register UP0LEAN)" VALUE 0x805820CE RB_Val_Ws16 20.97120 spg_q3p2Em4_V -10.48576 10.48544 FORMAT "%8.5" /end CHARACTERISTIC
/begin CHARACTERISTIC UEGO_uUPmpLimnRich_C "Rich pump voltage threshold to activate blackening protection(input to register UP0RICH)" VALUE 0x805820D0 RB_Val_Ws16 20.97120 spg_q3p2Em4_V -10.48576 10.48544 FORMAT "%8.5" /end CHARACTERISTIC
/begin CHARACTERISTIC VehMot2ME_CW "Codeword for adapter function %VehMot2ME" VALUE 0x8058230C RB_Val_Wu8 255.0 dez 0.00 255.0 FORMAT "%5.1" /end CHARACTERISTIC
/begin CHARACTERISTIC VehMot2ME_trqAccPed_CUR "adpter curve maximum torque accelerator pedal angle" CURVE 0x8058230E RB_Curve_S16_U16_Static 199.9969 rel_uw_b200 0.00 199.9969 FORMAT "%8.4"
 /begin AXIS_DESCR STD_AXIS APP_r Prc 5 -400.0000 399.9878 FORMAT "%8.4" DEPOSIT ABSOLUTE /end AXIS_DESCR
/end CHARACTERISTIC
/begin CHARACTERISTIC VehMot_mInrt_C "total vehicle inertia" VALUE 0x80582360 RB_Val_Ws16 65535.00 Mass -32768.00 32767.00 FORMAT "%8.2" /end CHARACTERISTIC
/begin CHARACTERISTIC VehMot_nEngSpdThd_C "Engine speed threshold to detect high load condition" VALUE 0x8058237C RB_Val_Ws16 32767.50 EngN -16384.00 16383.50 FORMAT "%8.2" /end CHARACTERISTIC
/begin CHARACTERISTIC VehMot_rAppNegDiff_C "Negative threshold slope for accelerator pedal" VALUE 0x8058237E RB_Val_Ws16 39999.39 PrcPerSec -20000.00 19999.39 FORMAT "%8.2" /end CHARACTERISTIC
/begin CHARACTERISTIC VehMot_rAppPosDiff_C "Positive threshold slope for accelerator pedal" VALUE 0x80582380 RB_Val_Ws16 39999.39 PrcPerSec -20000.00 19999.39 FORMAT "%8.2" /end CHARACTERISTIC
/begin CHARACTERISTIC VehMot_rAppThd2VehDyn_C "Accped threshold to detect high load condition" VALUE 0x80582382 RB_Val_Ws16 799.9878 Prc -400.0000 399.9878 FORMAT "%8.4" /end CHARACTERISTIC
/begin CHARACTERISTIC VehMot_rAppThd3VehDyn_C "Accelerator pedal Threshold 3." VALUE 0x80582384 RB_Val_Ws16 799.9878 Prc -400.0000 399.9878 FORMAT "%8.4" /end CHARACTERISTIC
/begin CHARACTERISTIC VehMot_rAppThdVehDyn_C "Accped threshold above which vehicle dynamic state is set" VALUE 0x80582386 RB_Val_Ws16 799.9878 Prc -400.0000 399.9878 FORMAT "%8.4" /end CHARACTERISTIC
/begin CHARACTERISTIC VehMot_tiAppVartnDly_C "Time delay to hold the status,after accped crosses positive or negetive threholds" VALUE 0x80582388 RB_Val_Wu8 2.550 t_q0p01 0.00 2.550 FORMAT "%5.3" /end CHARACTERISTIC
/begin CHARACTERISTIC VehMot_tiFastLearn_C "Time for fast learn modus" VALUE 0x80582362 RB_Val_Ws16 65.53500 Time_s_1 -32.76800 32.76700 FORMAT "%8.5" /end CHARACTERISTIC
/begin CHARACTERISTIC VehMot_tiTrqDragMin_C "Minimum time constant for filtering drag esimation" VALUE 0x80582364 RB_Val_Ws16 65.53500 Time_s_1 -32.76800 32.76700 FORMAT "%8.5" /end CHARACTERISTIC
/begin CHARACTERISTIC VehMot_tiTrqDragVx_CUR "Characteristic line of time constant dependend from velocity" CURVE 0x80582366 RB_Curve_S16_S16 65.53500 Time_s_1 -32.76800 32.76700 FORMAT "%8.5"
 /begin AXIS_DESCR STD_AXIS GlbDa_vX Vel 2 -327.6800 327.6700 FORMAT "%8.4" DEPOSIT ABSOLUTE /end AXIS_DESCR
/end CHARACTERISTIC
/begin CHARACTERISTIC VehMot_tiTrqPrpPT1_C "Time constant for torque filter" VALUE 0x80582370 RB_Val_Ws32 4294.9672940000000 TimeDelay_s 0.0000020000000 4294.9672959999998 FORMAT "%19.14" EXTENDED_LIMITS 0.000002000000001 4294.9672959999998 /end CHARACTERISTIC
/begin CHARACTERISTIC VehMot_trqDragMax_C "Maximum drag torque" VALUE 0x80582374 RB_Val_Ws32 429496729.500 TrqPrpHigh -214748364.800 214748364.700 FORMAT "%13.3" /end CHARACTERISTIC
/begin CHARACTERISTIC VehMot_vMinDragEst_C "Minimum velocity for drag esimation" VALUE 0x80582378 RB_Val_Ws16 655.3500 Vel -327.6800 327.6700 FORMAT "%8.4" /end CHARACTERISTIC
/begin CHARACTERISTIC VehMot_wThd2rlsol_C "Load threshold to detect high load condition" VALUE 0x8058238A RB_Val_Wu16 1535.977 rel_q0p02344 0.00 1535.977 FORMAT "%8.3" /end CHARACTERISTIC
/begin CHARACTERISTIC VehMot_wThdrlsol_C "Load threshold" VALUE 0x8058238C RB_Val_Wu16 1535.977 rel_q0p02344 0.00 1535.977 FORMAT "%8.3" /end CHARACTERISTIC
/begin CHARACTERISTIC VehStc_nEngHi3000_C "Engine speed over 3000rpm" VALUE 0x80582390 RB_Val_Ws16 32767.50 EngN -16384.00 16383.50 FORMAT "%8.2" /end CHARACTERISTIC
/begin CHARACTERISTIC VehStc_nEngHi4500_C "Engine speed under 4500rpm" VALUE 0x80582392 RB_Val_Ws16 32767.50 EngN -16384.00 16383.50 FORMAT "%8.2" /end CHARACTERISTIC
/begin CHARACTERISTIC VehStc_nEngLo1000_C "Engine speed over 1000rpm" VALUE 0x80582394 RB_Val_Ws16 32767.50 EngN -16384.00 16383.50 FORMAT "%8.2" /end CHARACTERISTIC
/begin CHARACTERISTIC VehStc_nEngLo2000_C "Engine speed under 2000rpm" VALUE 0x80582396 RB_Val_Ws16 32767.50 EngN -16384.00 16383.50 FORMAT "%8.2" /end CHARACTERISTIC
/begin CHARACTERISTIC VehStc_nEngLowr1000_C "Engine speed under 1000rpm" VALUE 0x80582398 RB_Val_Ws16 32767.50 EngN -16384.00 16383.50 FORMAT "%8.2" /end CHARACTERISTIC
/begin CHARACTERISTIC VehStc_nEngMed2000_C "Engine speed over 2000rpm" VALUE 0x8058239A RB_Val_Ws16 32767.50 EngN -16384.00 16383.50 FORMAT "%8.2" /end CHARACTERISTIC
/begin CHARACTERISTIC VehStc_nEngMed3000_C "Engine speed under 3000rpm" VALUE 0x8058239C RB_Val_Ws16 32767.50 EngN -16384.00 16383.50 FORMAT "%8.2" /end CHARACTERISTIC
/begin CHARACTERISTIC VehStc_nEngSpdThd_C "engine speed threshold" VALUE 0x8058239E RB_Val_Ws16 32767.50 EngN -16384.00 16383.50 FORMAT "%8.2" /end CHARACTERISTIC
/begin CHARACTERISTIC VehStc_nEngTop4500_C "Engine speed over 4500rpm" VALUE 0x805823A0 RB_Val_Ws16 32767.50 EngN -16384.00 16383.50 FORMAT "%8.2" /end CHARACTERISTIC
/begin CHARACTERISTIC VehStc_pIntkHi450_C "Intake manifold pressure over 450mmHG" VALUE 0x805823A4 RB_Val_Wu32 125839807.057 p_uw_q0p039_mmHg 0.00 125839807.057 FORMAT "%13.3" /end CHARACTERISTIC
/begin CHARACTERISTIC VehStc_pIntkHi600_C "Intake manifold pressure under 450mmHg" VALUE 0x805823A8 RB_Val_Wu32 125839807.057 p_uw_q0p039_mmHg 0.00 125839807.057 FORMAT "%13.3" /end CHARACTERISTIC
/begin CHARACTERISTIC VehStc_pIntkLo_C "Intake manifold pressure under 300mmHg" VALUE 0x805823AC RB_Val_Wu32 125839807.057 p_uw_q0p039_mmHg 0.00 125839807.057 FORMAT "%13.3" /end CHARACTERISTIC
/begin CHARACTERISTIC VehStc_pIntkMed300_C "Intake manifold pressure over 300mmHg" VALUE 0x805823B0 RB_Val_Wu32 125839807.057 p_uw_q0p039_mmHg 0.00 125839807.057 FORMAT "%13.3" /end CHARACTERISTIC
/begin CHARACTERISTIC VehStc_pIntkMed450_C "Intake manifold pressure under 450mmHg" VALUE 0x805823B4 RB_Val_Wu32 125839807.057 p_uw_q0p039_mmHg 0.00 125839807.057 FORMAT "%13.3" /end CHARACTERISTIC
/begin CHARACTERISTIC VehStc_pIntkTop600_C "Intake manifold pressure over 600mmHg" VALUE 0x805823B8 RB_Val_Wu32 125839807.057 p_uw_q0p039_mmHg 0.00 125839807.057 FORMAT "%13.3" /end CHARACTERISTIC
/begin CHARACTERISTIC VehStc_stAutoRstrtEna_C "autorestart enable\disable calibration" VALUE 0x805823BC RB_Val_Wboolean 1.00000000000 B_TRUE 0.00 1.00000000000 FORMAT "%13.11" /end CHARACTERISTIC
/begin CHARACTERISTIC VehStc_stISSOffACMsk_C "Bit mask for Idle Stop off due to air conditioning" VALUE 0x805823BE RB_Val_Wu16 65535.00 OneToOne 0.00 65535.00 FORMAT "%8.2" /end CHARACTERISTIC
/begin CHARACTERISTIC VehStc_stISSOffATMsk_C "Bit mask for Idle Stop off due to AT request" VALUE 0x805823C0 RB_Val_Wu16 65535.00 OneToOne 0.00 65535.00 FORMAT "%8.2" /end CHARACTERISTIC
/begin CHARACTERISTIC VehStc_stISSOffATSlopeMsk_C "Bit mask for Idle Stop off due to slope detection of AT" VALUE 0x805823C2 RB_Val_Wu16 65535.00 OneToOne 0.00 65535.00 FORMAT "%8.2" /end CHARACTERISTIC
/begin CHARACTERISTIC VehStc_stISSOffBatMsk_C "Bit mask for Idle Stop off due to battery charging" VALUE 0x805823C4 RB_Val_Wu16 65535.00 OneToOne 0.00 65535.00 FORMAT "%8.2" /end CHARACTERISTIC
/begin CHARACTERISTIC VehStc_stISSOffBrkBoostMsk_C "Bit mask for Idle Stop off due to request of brake booster" VALUE 0x805823C6 RB_Val_Wu16 65535.00 OneToOne 0.00 65535.00 FORMAT "%8.2" /end CHARACTERISTIC
/begin CHARACTERISTIC VehStc_stISSOffDCDCMsk_C "Bit mask for Idle Stop off due to DCDC converter" VALUE 0x805823C8 RB_Val_Wu16 65535.00 OneToOne 0.00 65535.00 FORMAT "%8.2" /end CHARACTERISTIC
/begin CHARACTERISTIC VehStc_stISSOffPwrSteerMsk_C "Bit mask for Idle Stop off due to power steering" VALUE 0x805823CA RB_Val_Wu16 65535.00 OneToOne 0.00 65535.00 FORMAT "%8.2" /end CHARACTERISTIC
/begin CHARACTERISTIC VehStc_stISSOffTempEngMsk_C "Bit mask for Idle Stop off due to engine temperature" VALUE 0x805823CC RB_Val_Wu16 65535.00 OneToOne 0.00 65535.00 FORMAT "%8.2" /end CHARACTERISTIC
/begin CHARACTERISTIC VehStc_stISSOffUserMsk_C "Bit mask for Idle Stop off due to user turned off" VALUE 0x805823CE RB_Val_Wu16 65535.00 OneToOne 0.00 65535.00 FORMAT "%8.2" /end CHARACTERISTIC
/begin CHARACTERISTIC VehStc_stISSOffvVehMsk_C "Bit mask for Idle Stop off due to vehicle speed condition" VALUE 0x805823D0 RB_Val_Wu16 65535.00 OneToOne 0.00 65535.00 FORMAT "%8.2" /end CHARACTERISTIC
/begin CHARACTERISTIC VehStc_stStalEngReasMsk_C "engine stall mask calibration" VALUE 0x805823D2 RB_Val_Wu8 255.0 OneToOne 0.00 255.0 FORMAT "%5.1" /end CHARACTERISTIC
/begin CHARACTERISTIC VehStc_tClntThd_C "Threshold engine coolant temperature" VALUE 0x805823D4 RB_Val_Ws16 6553.500 Temp_Cels -3549.940 3003.560 FORMAT "%8.3" /end CHARACTERISTIC
/begin CHARACTERISTIC VehStc_tiSSEChgOfMindOff_C "parameter to set the change of mind time" VALUE 0x805823D6 RB_Val_Wu16 655350.0 Time_ms 0.00 655350.0 FORMAT "%8.1" /end CHARACTERISTIC
/begin CHARACTERISTIC VehStc_tiStopTrigDly_C "calibration to set the stop trigger delay" VALUE 0x805823D8 RB_Val_Ws16 327.6700 Time_s 0.00 327.6700 FORMAT "%8.4" EXTENDED_LIMITS -327.6800 327.6700 /end CHARACTERISTIC
/begin CHARACTERISTIC VehStc_volInputSel_C "Calibration to select the vehicle fuel consumption input" VALUE 0x805823DA RB_Val_Wu8 255.0 OneToOne 0.00 255.0 FORMAT "%5.1" /end CHARACTERISTIC
/begin CHARACTERISTIC VehStc_vVehZonSeln_C "vehicle zone selection parameter" VALUE 0x805823DC RB_Val_Ws16 655.3500 Vel -327.6800 327.6700 FORMAT "%8.4" /end CHARACTERISTIC
/begin CHARACTERISTIC VehStc_vWhlSpdThresHi_C "vehicle speed threshold value" VALUE 0x805823DE RB_Val_Ws16 655.3500 Vel -327.6800 327.6700 FORMAT "%8.4" /end CHARACTERISTIC
/begin CHARACTERISTIC VehV_ctDvtMax_C "Maximum number of deviations below which wheel error is detected" VALUE 0x805823E0 RB_Val_Wu8 255.0 OneToOne 0.00 255.0 FORMAT "%5.1" /end CHARACTERISTIC
/begin CHARACTERISTIC VehV_ctDvtMin_C "Minimum number of deviations above which wheel error is detected" VALUE 0x805823E1 RB_Val_Wu8 255.0 OneToOne 0.00 255.0 FORMAT "%5.1" /end CHARACTERISTIC
/begin CHARACTERISTIC VehV_ctTolrPerd_C "Amount of impulses which are tolerated, during two calculation cycles of the process." VALUE 0x805823E2 RB_Val_Wu16 65535.00 OneToOne 0.00 65535.00 FORMAT "%8.2" /end CHARACTERISTIC
/begin CHARACTERISTIC VehV_dstPerImp_C "The calculated distance per impulse value" VALUE 0x805823E4 RB_Val_Wu16 0.5965200 LengthCpp 0.00 0.5965200 FORMAT "%9.7" EXTENDED_LIMITS 0.00 0.6553500 /end CHARACTERISTIC
/begin CHARACTERISTIC VehV_facTireAxlCorrMax_C "Upper limit of the tire and axle correction factor" VALUE 0x805823E8 RB_Val_Wu32 16033212.0000 PerKm 10000.0000 16043212.0000 FORMAT "%13.4" EXTENDED_LIMITS 0.00 4294967295.00 /end CHARACTERISTIC
/begin CHARACTERISTIC VehV_facTireAxlCorrMin_C "Lower limit of the tire and axle correction factor" VALUE 0x805823EC RB_Val_Wu32 16041535.0000 PerKm 1677.0000 16043212.0000 FORMAT "%13.4" EXTENDED_LIMITS 0.00 4294967295.00 /end CHARACTERISTIC
/begin CHARACTERISTIC VehV_flgExcdLim_C "VehV_flgExcdLim is set to this value if the minimum speed was reached at least once in the current driving cycle" VALUE 0x80582434 RB_Val_Wu8 1.00000000000 B_TRUE 0.00 1.00000000000 FORMAT "%13.11" /end CHARACTERISTIC
/begin CHARACTERISTIC VehV_flgPtCdnSel_C "Switch for powertrain condition selection for plausibility check" VALUE 0x80582435 RB_Val_Wu8 1.00000000000 B_TRUE 0.00 1.00000000000 FORMAT "%13.11" /end CHARACTERISTIC
/begin CHARACTERISTIC VehV_flgPwrPlausHealEna_C "Flag for heal enable condition selection" VALUE 0x80582436 RB_Val_Wu8 1.00000000000 B_TRUE 0.00 1.00000000000 FORMAT "%13.11" /end CHARACTERISTIC
/begin CHARACTERISTIC VehV_nEngThresMinPinPnt_C "Minimun Engine Speed (Threshold) for checking PIN point Funtion" VALUE 0x805823F0 RB_Val_Ws16 32767.50 EngN -16384.00 16383.50 FORMAT "%8.2" /end CHARACTERISTIC
/begin CHARACTERISTIC VehV_nThresPlaFcoMax_C "Maximum engine speed limit for vehicle speed fuel cut off plausibilisation" VALUE 0x80582438 RB_Val_Ws16 32767.50 EngN -16384.00 16383.50 FORMAT "%8.2" /end CHARACTERISTIC
/begin CHARACTERISTIC VehV_nThresPlaFcoMin_C "Minimum engine speed limit for vehicle speed fuel cut off plausibilisation" VALUE 0x8058243A RB_Val_Ws16 32767.50 EngN -16384.00 16383.50 FORMAT "%8.2" /end CHARACTERISTIC
/begin CHARACTERISTIC VehV_nThresPlaMinV2N_C "Minimum engine speed limit to enable vehicle speed V2N plausibilisation" VALUE 0x8058243C RB_Val_Ws16 32767.50 EngN -16384.00 16383.50 FORMAT "%8.2" /end CHARACTERISTIC
/begin CHARACTERISTIC VehV_nThresPlaPwrMaxDfct_C "Maximum engine speed threshold value to activate the defect enable condition" VALUE 0x8058243E RB_Val_Ws16 32767.50 EngN -16384.00 16383.50 FORMAT "%8.2" /end CHARACTERISTIC
/begin CHARACTERISTIC VehV_nThresPlaPwrMaxOk_C "Maximum engine speed threshold value to activate the heal enable condition" VALUE 0x80582440 RB_Val_Ws16 32767.50 EngN -16384.00 16383.50 FORMAT "%8.2" /end CHARACTERISTIC
/begin CHARACTERISTIC VehV_nThresPlaPwrMinDfct_C "Minimum engine speed threshold value to activate the defect enable condition" VALUE 0x80582442 RB_Val_Ws16 32767.50 EngN -16384.00 16383.50 FORMAT "%8.2" /end CHARACTERISTIC
/begin CHARACTERISTIC VehV_nThresPlaPwrMinOk_C "Minimum engine speed threshold value to activate the heal enable condition" VALUE 0x80582444 RB_Val_Ws16 32767.00 EngN -16383.50 16383.50 FORMAT "%8.2" EXTENDED_LIMITS -16384.00 16383.50 /end CHARACTERISTIC
/begin CHARACTERISTIC VehV_numSclOut_C "Time scaling number for vehicle speed output" VALUE 0x80582418 Val_Wu8 255.0 OneToOne 0.00 255.0 FORMAT "%5.1" /end CHARACTERISTIC
/begin CHARACTERISTIC VehV_numSegSens_C "Number of teeth of Tone wheel" VALUE 0x805823F2 RB_Val_Wu8 49.00 OneToOne 1.00 50.00 FORMAT "%5.2" EXTENDED_LIMITS 0.00 255.0 /end CHARACTERISTIC
/begin CHARACTERISTIC VehV_PwmOut.rMin_C "Structure for the PWM out signal / Minimum threshold for the duty cycle" VALUE 0x80591ADE Kw_Ws16 100.0000 DtyCyc 0.00 100.0000 FORMAT "%8.4" EXTENDED_LIMITS -327.6800 327.6700 /end CHARACTERISTIC
/begin CHARACTERISTIC VehV_PwmOut.rMax_C "Structure for the PWM out signal / Maximum threshold for the duty cycle" VALUE 0x80591AE0 Kw_Ws16 100.0000 DtyCyc 0.00 100.0000 FORMAT "%8.4" EXTENDED_LIMITS -327.6800 327.6700 /end CHARACTERISTIC
/begin CHARACTERISTIC VehV_PwmOut.tiBtwTstSCB_C "Structure for the PWM out signal / Time between recurring test for SCB error" VALUE 0x80591AE2 Kw_Ws16 1000.000 Time_ms 0.00 1000.000 FORMAT "%8.3" EXTENDED_LIMITS -327680.0 327670.0 /end CHARACTERISTIC
/begin CHARACTERISTIC VehV_PwmOut.tiBtwTstOT_C "Structure for the PWM out signal / Time between recurring test for OT error" VALUE 0x80591AE4 Kw_Ws16 327.6700 Time_s 0.00 327.6700 FORMAT "%8.4" EXTENDED_LIMITS -327.6800 327.6700 /end CHARACTERISTIC
/begin CHARACTERISTIC VehV_PwmOut.numTstMax_C "Structure for the PWM out signal / Maximum number of tests allowed on permanent defect" VALUE 0x80591AE6 Kw_Wu16 65535.00 OneToOne 0.00 65535.00 FORMAT "%8.2" /end CHARACTERISTIC
/begin CHARACTERISTIC VehV_PwmOut.swtBattCor_C "Structure for the PWM out signal / Switch to enable battery correction" VALUE 0x80591AE8 Kw_Wu8 1.000 OneToOne 0.00 1.000 FORMAT "%5.3" EXTENDED_LIMITS 0.00 255.0 /end CHARACTERISTIC
/begin CHARACTERISTIC VehV_rAxl_C "Rear axle drive ratio" VALUE 0x805823F4 RB_Val_Wu16 4.000000 Fact0002 2.000000 6.000000 FORMAT "%8.6" EXTENDED_LIMITS 0.00 13.10700 /end CHARACTERISTIC
/begin CHARACTERISTIC VehV_rDifPlaus_C "Threshold value of transmission gear ratio difference" VALUE 0x80582446 RB_Val_Ws16 65.53500 Fact1000 -32.76800 32.76700 FORMAT "%8.5" /end CHARACTERISTIC
/begin CHARACTERISTIC VehV_rMaxDty_C "Maximum duty cycle for the PWM out configuration" VALUE 0x8058241A Val_Ws16 100.0000 DtyCyc 0.00 100.0000 FORMAT "%8.4" EXTENDED_LIMITS -327.6800 327.6700 /end CHARACTERISTIC
/begin CHARACTERISTIC VehV_rSclOut_C "Scale out ratio for vehicle speed output" VALUE 0x8058241C Val_Ws16 100.0000 DtyCyc 0.00 100.0000 FORMAT "%8.4" EXTENDED_LIMITS -327.6800 327.6700 /end CHARACTERISTIC
/begin CHARACTERISTIC VehV_rSpdDiffCorrnFac_C "correction factor for Average value of sensor A and sensor B" VALUE 0x80582448 RB_Val_Wu16 655.3500 Prc_Fact100 0.00 655.3500 FORMAT "%8.4" /end CHARACTERISTIC
/begin CHARACTERISTIC VehV_rThresWhlErr_C "Threshold value for the percentage deviation to detect an error" VALUE 0x805823F6 RB_Val_Ws16 655.3500 Prc_q0p01_COMPU -327.6800 327.6700 FORMAT "%8.4" /end CHARACTERISTIC
/begin CHARACTERISTIC VehV_rV2NDifThd_CUR "Curve for V2N ratio" CURVE 0x8058244A RB_Curve_S16_S16 65.53500 Fact1000 -32.76800 32.76700 FORMAT "%8.5"
 /begin AXIS_DESCR STD_AXIS VehV_vSnsrAbslt_MP Vel 6 -327.6800 327.6700 FORMAT "%8.4" DEPOSIT ABSOLUTE /end AXIS_DESCR
/end CHARACTERISTIC
/begin CHARACTERISTIC VehV_stCfg_C "vehicle configuration (all wheel drive, front wheel drive, rear wheel drive)" VALUE 0x805823F8 RB_Val_Wu8 255.0 OneToOne 0.00 255.0 FORMAT "%5.1" /end CHARACTERISTIC
/begin CHARACTERISTIC VehV_stLvl_C "State of power stage voltage level for vehicle speed output" VALUE 0x8058241E Val_Wu8 255.0 OneToOne 0.00 255.0 FORMAT "%5.1" /end CHARACTERISTIC
/begin CHARACTERISTIC VehV_stPsDiaDisbl_C "Parameter to disable vehicle speed diagnosis" VALUE 0x80582420 Val_Wu16 65535.00 OneToOne 0.00 65535.00 FORMAT "%8.2" /end CHARACTERISTIC
/begin CHARACTERISTIC VehV_stPsDisbl_C "Parameter to disable vehicle speed output" VALUE 0x80582422 Val_Wu16 65535.00 OneToOne 0.00 65535.00 FORMAT "%8.2" /end CHARACTERISTIC
/begin CHARACTERISTIC VehV_stPsInv_C "Parameter to inverse the output to the powerstage" VALUE 0x80582424 Val_Wu8 1.000 OneToOne 0.00 1.000 FORMAT "%5.3" EXTENDED_LIMITS 0.00 255.0 /end CHARACTERISTIC
/begin CHARACTERISTIC VehV_swtDftT15Off_C "Switch to select default vehicle speed when T15 is switched off" VALUE 0x80582464 RB_Val_Wu8 1.00000000000 B_TRUE 0.00 1.00000000000 FORMAT "%13.11" /end CHARACTERISTIC
/begin CHARACTERISTIC VehV_swtDrctDstPerImp_C "Selection between the direct distance per impulse value or the calculated value" VALUE 0x805823F9 RB_Val_Wu8 1.00000000000 B_TRUE 0.00 1.00000000000 FORMAT "%13.11" /end CHARACTERISTIC
/begin CHARACTERISTIC VehV_swtPlausSel_C "Selection of the Plausibility Checks of the vehicle velocity (bit coded)" VALUE 0x80582465 RB_Val_Wu8 255.0 OneToOne 0.00 255.0 FORMAT "%5.1" /end CHARACTERISTIC
/begin CHARACTERISTIC VehV_swtPwrExcdLim_C "Switch wether condition shall be used for power plausibility check: minimum speed was reached at least once in the current driving cycle" VALUE 0x80582466 RB_Val_Wu8 1.00000000000 B_TRUE 0.00 1.00000000000 FORMAT "%13.11" /end CHARACTERISTIC
/begin CHARACTERISTIC VehV_swtSigPWMOut_C "Switch to select input source for vehicle speed to calculate PWM output signal" VALUE 0x80582425 Val_Wu8 255.0 OneToOne 0.00 255.0 FORMAT "%5.1" /end CHARACTERISTIC
/begin CHARACTERISTIC VehV_swtSigSafe_C "Switch to select vehicle speed from safe input source" VALUE 0x80582467 RB_Val_Wu8 255.0 OneToOne 0.00 255.0 FORMAT "%5.1" /end CHARACTERISTIC
/begin CHARACTERISTIC VehV_swtSigStd_C "Switch to select vehicle speed from standard input source" VALUE 0x80582468 RB_Val_Wu8 255.0 OneToOne 0.00 255.0 FORMAT "%5.1" /end CHARACTERISTIC
/begin CHARACTERISTIC VehV_tiAPT1_C "Time constant for low pass filtering of the vehicle acceleration" VALUE 0x8058246A RB_Val_Ws16 655.3500 Time_s -327.6800 327.6700 FORMAT "%8.4" /end CHARACTERISTIC
/begin CHARACTERISTIC VehV_tiDebImpsCan_C "Debounce time for detection of vehicle speed plausibility error via CAN" VALUE 0x8058246C RB_Val_Ws16 327.6700 Time_s 0.00 327.6700 FORMAT "%8.4" EXTENDED_LIMITS -327.6800 327.6700 /end CHARACTERISTIC
/begin CHARACTERISTIC VehV_tiDebImpsFco_C "Debounce time for detection of vehicle speed plausibility error from fuel cut off plausibility check" VALUE 0x8058246E RB_Val_Ws16 327.6700 Time_s 0.00 327.6700 FORMAT "%8.4" EXTENDED_LIMITS -327.6800 327.6700 /end CHARACTERISTIC
/begin CHARACTERISTIC VehV_tiDebImpsPwr_C "Debounce time for detection of vehicle speed plausibility error from fuel power plausibility check" VALUE 0x80582470 RB_Val_Ws16 327.6700 Time_s 0.00 327.6700 FORMAT "%8.4" EXTENDED_LIMITS -327.6800 327.6700 /end CHARACTERISTIC
/begin CHARACTERISTIC VehV_tiDebImpsV2NTrsm_C "Delay time to confirm V2N plausibilisation error for CVT" VALUE 0x80582472 RB_Val_Ws16 327.6700 Time_s 0.00 327.6700 FORMAT "%8.4" EXTENDED_LIMITS -327.6800 327.6700 /end CHARACTERISTIC
/begin CHARACTERISTIC VehV_tiOffDlyAvdInitPls_C "Defines the additional delay to avoid the initial PWM pulse.Thus the calculation of vehicle speed is started after this additional delay" VALUE 0x805823FA RB_Val_Ws16 655350.0 Time_ms -327680.0 327670.0 FORMAT "%8.1" /end CHARACTERISTIC
/begin CHARACTERISTIC VehV_tiOutMax_C "Maximum period to output vehicl speed pulse" VALUE 0x80582428 Val_Ws32 3299.00000000 Period_1000 1.00000000 3300.00000000 FORMAT "%13.8" EXTENDED_LIMITS -2147483.64800 2147483.64700 /end CHARACTERISTIC
/begin CHARACTERISTIC VehV_tiOutMin_C "Miniimum period to output vehicl speed pulse" VALUE 0x8058242C Val_Ws32 3299.00000000 Period_1000 1.00000000 3300.00000000 FORMAT "%13.8" EXTENDED_LIMITS -2147483.64800 2147483.64700 /end CHARACTERISTIC
/begin CHARACTERISTIC VehV_tiPerMax_C "Max. period duration of vehicle speed sensor signal" VALUE 0x805823FC RB_Val_Ws32 214748364.750 Time_PwmHigh -107374182.400 107374182.350 FORMAT "%13.3" /end CHARACTERISTIC
/begin CHARACTERISTIC VehV_tiPh_C "Phase timer value of PWM signal for vehicle speed output" VALUE 0x80582430 Val_Ws16 3276.700 Period 0.00 3276.700 FORMAT "%8.3" EXTENDED_LIMITS -3276.800 3276.700 /end CHARACTERISTIC
/begin CHARACTERISTIC VehV_tiPwrPlausDfctEna_C "Debounce time for power plausibility defect enable condition" VALUE 0x80582474 RB_Val_Ws16 327.6700 Time_s 0.00 327.6700 FORMAT "%8.4" EXTENDED_LIMITS -327.6800 327.6700 /end CHARACTERISTIC
/begin CHARACTERISTIC VehV_tiPwrPlausHealEna_C "Debounce time for power plausibility healing enable condition" VALUE 0x80582476 RB_Val_Ws16 327.6700 Time_s 0.00 327.6700 FORMAT "%8.4" EXTENDED_LIMITS -327.6800 327.6700 /end CHARACTERISTIC
/begin CHARACTERISTIC VehV_tiT15ON_C "Turn on delay for accepting the vehicle speed PWM signal when T15_st is turned ON." VALUE 0x80582400 RB_Val_Ws16 327670.0 Time_ms 0.00 327670.0 FORMAT "%8.1" EXTENDED_LIMITS -327680.0 327670.0 /end CHARACTERISTIC
/begin CHARACTERISTIC VehV_tiThdExcdLim_C "Debounce time for detection minimum speed was reached at least once in the current driving cycle" VALUE 0x80582478 RB_Val_Ws16 327.6700 Time_s 0.00 327.6700 FORMAT "%8.4" EXTENDED_LIMITS -327.6800 327.6700 /end CHARACTERISTIC
/begin CHARACTERISTIC VehV_tiUnJit_C "Turn on delay for using the old value for vehicle speed when the jitters are there in the signal." VALUE 0x80582402 RB_Val_Ws16 327670.0 Time_ms 0.00 327670.0 FORMAT "%8.1" EXTENDED_LIMITS -327680.0 327670.0 /end CHARACTERISTIC
/begin CHARACTERISTIC VehV_tiVAccPT1_C "PT1 filter time constant for the vehicle speed used in acceleration calculation" VALUE 0x8058247C RB_Val_Wr32 9.99900000 Time_s_float 0.0010000 10.0000000 FORMAT "%10.7" EXTENDED_LIMITS -3.40282347E+038 3.40282347E+038 /end CHARACTERISTIC
/begin CHARACTERISTIC VehV_tiVPT1_C "Time constant for low pass filtering of the vehicle speed" VALUE 0x80582480 RB_Val_Ws16 655.3500 Time_s -327.6800 327.6700 FORMAT "%8.4" /end CHARACTERISTIC
/begin CHARACTERISTIC VehV_tiWhlSensErr_C "Time Delay for setting the Sensor Error" VALUE 0x80582404 RB_Val_Ws16 327.6700 Time_s 0.00 327.6700 FORMAT "%8.4" EXTENDED_LIMITS -327.6800 327.6700 /end CHARACTERISTIC
/begin CHARACTERISTIC VehV_trqThresPlaDef_C "Engine torque threshold for detecting the plausibility error in vehicle speed" VALUE 0x80582482 RB_Val_Ws16 6553.500 Trq -3276.800 3276.700 FORMAT "%8.3" /end CHARACTERISTIC
/begin CHARACTERISTIC VehV_trqThresPlaOk_C "Engine torque threshold for healing the plausibility error in vehicle speed" VALUE 0x80582484 RB_Val_Ws16 6553.500 Trq -3276.800 3276.700 FORMAT "%8.3" /end CHARACTERISTIC
/begin CHARACTERISTIC VehV_tThresPlaFco_C "Minimum engine temperature limit above which vehicle speed fuel cutoff plausibilisation is enabled" VALUE 0x80582486 RB_Val_Ws16 6553.500 Temp_Cels -3549.940 3003.560 FORMAT "%8.3" /end CHARACTERISTIC
/begin CHARACTERISTIC VehV_tThresPlaPwr_C "Minimum engine temperature limit above which vehicle speed power plausibilisation is enabled" VALUE 0x80582488 RB_Val_Ws16 6553.500 Temp_Cels -3549.940 3003.560 FORMAT "%8.3" /end CHARACTERISTIC
/begin CHARACTERISTIC VehV_vDflOBD_C "Default value for OBD relevent vehicle speed in case of permanent error" VALUE 0x8058248A RB_Val_Ws16 655.3500 Vel -327.6800 327.6700 FORMAT "%8.4" /end CHARACTERISTIC
/begin CHARACTERISTIC VehV_vDfl_C "Default vehicle speed value in case the sensed vehicle speed crosses Min or Max limits" VALUE 0x8058248C RB_Val_Ws16 655.3500 Vel -327.6800 327.6700 FORMAT "%8.4" /end CHARACTERISTIC
/begin CHARACTERISTIC VehV_vDftT15Off_C "Default value for VehV_vSens when T15 is Off" VALUE 0x8058248E RB_Val_Ws16 655.3500 Vel -327.6800 327.6700 FORMAT "%8.4" /end CHARACTERISTIC
/begin CHARACTERISTIC VehV_vFLWhlSpdDfl_C "Default front left wheel speed when CAN signal is not valid" VALUE 0x80582406 RB_Val_Ws16 655.3500 Vel -327.6800 327.6700 FORMAT "%8.4" /end CHARACTERISTIC
/begin CHARACTERISTIC VehV_vFRWhlSpdDfl_C "Default front right wheel speed when CAN signal is not valid" VALUE 0x80582408 RB_Val_Ws16 655.3500 Vel -327.6800 327.6700 FORMAT "%8.4" /end CHARACTERISTIC
/begin CHARACTERISTIC VehV_vLowThres_C "Top_Vehicle_Speed_Low_Threshold" VALUE 0x80582490 RB_Val_Ws16 655.3500 Vel -327.6800 327.6700 FORMAT "%8.4" /end CHARACTERISTIC
/begin CHARACTERISTIC VehV_vMaxFix_C "Max limit for the top speed calculation" VALUE 0x80582492 RB_Val_Ws16 655.3500 Vel -327.6800 327.6700 FORMAT "%8.4" /end CHARACTERISTIC
/begin CHARACTERISTIC VehV_vMin_C "min. sensed vehicle speed for calculation of outputted vehicle speed" VALUE 0x80582494 RB_Val_Ws16 655.3500 Vel -327.6800 327.6700 FORMAT "%8.4" /end CHARACTERISTIC
/begin CHARACTERISTIC VehV_vPhysRngMax_C "Maximum value of vehicle speed above which physical range max error is reported" VALUE 0x80582496 RB_Val_Ws16 655.3500 Vel -327.6800 327.6700 FORMAT "%8.4" /end CHARACTERISTIC
/begin CHARACTERISTIC VehV_vPhysRngMin_C "Minimum value of vehicle speed below which physical range min error is reported" VALUE 0x80582498 RB_Val_Ws16 655.3500 Vel -327.6800 327.6700 FORMAT "%8.4" /end CHARACTERISTIC
/begin CHARACTERISTIC VehV_vRLWhlSpdDfl_C "Default rear left wheel speed when CAN signal is not valid" VALUE 0x8058240A RB_Val_Ws16 655.3500 Vel -327.6800 327.6700 FORMAT "%8.4" /end CHARACTERISTIC
/begin CHARACTERISTIC VehV_vRRWhlSpdDfl_C "Default rear right wheel speed when CAN signal is not valid" VALUE 0x8058240C RB_Val_Ws16 655.3500 Vel -327.6800 327.6700 FORMAT "%8.4" /end CHARACTERISTIC
/begin CHARACTERISTIC VehV_vSensDiffLim_C "Limit to decide if the vehicle speed signal is jitter." VALUE 0x8058240E RB_Val_Ws16 327.6700 Vel 0.00 327.6700 FORMAT "%8.4" EXTENDED_LIMITS -327.6800 327.6700 /end CHARACTERISTIC
/begin CHARACTERISTIC VehV_vSnsrFailrThd_C "Threshold for indicating sensor failure condition" VALUE 0x8058249A RB_Val_Ws16 655.3500 Vel -327.6800 327.6700 FORMAT "%8.4" /end CHARACTERISTIC
/begin CHARACTERISTIC VehV_vSnsrSpdDiffThd_C "Threshold value for speed sensor rationality diagnosis" VALUE 0x8058249C RB_Val_Ws16 655.3500 Vel -327.6800 327.6700 FORMAT "%8.4" /end CHARACTERISTIC
/begin CHARACTERISTIC VehV_vSpdPinPnt_C "Threshold speed difference allowed for PIN POINT" VALUE 0x80582410 RB_Val_Ws16 655.3500 Vel -327.6800 327.6700 FORMAT "%8.4" /end CHARACTERISTIC
/begin CHARACTERISTIC VehV_vThdExcdLim_C "Velocity for detection minimum speed was reached at least once in the current driving cycle" VALUE 0x8058249E RB_Val_Ws16 655.3500 Vel -327.6800 327.6700 FORMAT "%8.4" /end CHARACTERISTIC
/begin CHARACTERISTIC VehV_vThresPlaFco_C "Vehicle speed threshold for detection of vehicle speed Fuel cuttoff plausibilisation error" VALUE 0x805824A0 RB_Val_Ws16 655.3500 Vel -327.6800 327.6700 FORMAT "%8.4" /end CHARACTERISTIC
/begin CHARACTERISTIC VehV_vThresPlaPwrDef_C "Vehicle speed threshold for detecting the plausibility error in vehicle speed" VALUE 0x805824A2 RB_Val_Ws16 655.3500 Vel -327.6800 327.6700 FORMAT "%8.4" /end CHARACTERISTIC
/begin CHARACTERISTIC VehV_vThresPlaPwrOk_C "Vehicle speed threshold for healing the plausibility error in vehicle speed" VALUE 0x805824A4 RB_Val_Ws16 655.3500 Vel -327.6800 327.6700 FORMAT "%8.4" /end CHARACTERISTIC
/begin CHARACTERISTIC VehV_vThresPlaV2N_C "Vehicle speed threshold for detecting V2N plausibility error" VALUE 0x805824A6 RB_Val_Ws16 655.3500 Vel -327.6800 327.6700 FORMAT "%8.4" /end CHARACTERISTIC
/begin CHARACTERISTIC VehV_vWhlErrMax_C "Maximum vehicle velocity below which the wheel error detection is enabled" VALUE 0x80582412 RB_Val_Ws16 655.3500 Vel -327.6800 327.6700 FORMAT "%8.4" /end CHARACTERISTIC
/begin CHARACTERISTIC VehV_vWhlErrMin_C "Minimum vehicle velocity above which the wheel error detection is enabled" VALUE 0x80582414 RB_Val_Ws16 655.3500 Vel -327.6800 327.6700 FORMAT "%8.4" /end CHARACTERISTIC
/begin CHARACTERISTIC VF2ME_MRFAVLN_CUR "Full load recognition threshold driver's demand" CURVE 0x80582324 RB_Curve_U16_U16 199.9969 rel_uw_b200 0.00 199.9969 FORMAT "%8.4"
 /begin AXIS_DESCR STD_AXIS Epm_nEng EngN 14 0.00 32767.50 FORMAT "%8.2" DEPOSIT ABSOLUTE /end AXIS_DESCR
/end CHARACTERISTIC
/begin CHARACTERISTIC VF2ME_MRMAX_C "maximum relative torque ofr driver's demand from adapter VF2ME" VALUE 0x8058235E RB_Val_Wu16 199.9969 rel_uw_b200 0.00 199.9969 FORMAT "%8.4" /end CHARACTERISTIC
/begin CHARACTERISTIC VMD_rDrvModCorrnCmft_T "Curve to adjust the Virtual accelerator pedal position in Comfort drive mode" CURVE 0x805820D8 RB_Curve_S16_S16 799.9878 Prc -400.0000 399.9878 FORMAT "%8.4"
 /begin AXIS_DESCR STD_AXIS VMD_rASLCC Prc 10 -400.0000 399.9878 FORMAT "%8.4" DEPOSIT ABSOLUTE /end AXIS_DESCR
/end CHARACTERISTIC
/begin CHARACTERISTIC VMD_rDrvModCorrnEco_T "Curve to adjust the Virtual accelerator pedal position in Economy drive mode" CURVE 0x80582102 RB_Curve_S16_S16 799.9878 Prc -400.0000 399.9878 FORMAT "%8.4"
 /begin AXIS_DESCR STD_AXIS VMD_rASLCC Prc 10 -400.0000 399.9878 FORMAT "%8.4" DEPOSIT ABSOLUTE /end AXIS_DESCR
/end CHARACTERISTIC
/begin CHARACTERISTIC VMD_rDrvModCorrnNorm_T "Curve to adjust the Virtual accelerator pedal position in Normal drive mode" CURVE 0x8058212C RB_Curve_S16_S16 799.9878 Prc -400.0000 399.9878 FORMAT "%8.4"
 /begin AXIS_DESCR STD_AXIS VMD_rASLCC Prc 10 -400.0000 399.9878 FORMAT "%8.4" DEPOSIT ABSOLUTE /end AXIS_DESCR
/end CHARACTERISTIC
/begin CHARACTERISTIC VMD_rDrvModCorrnSnow_T "Curve to adjust the Virtual accelerator pedal position in Snow drive mode" CURVE 0x80582156 RB_Curve_S16_S16 799.9878 Prc -400.0000 399.9878 FORMAT "%8.4"
 /begin AXIS_DESCR STD_AXIS VMD_rASLCC Prc 10 -400.0000 399.9878 FORMAT "%8.4" DEPOSIT ABSOLUTE /end AXIS_DESCR
/end CHARACTERISTIC
/begin CHARACTERISTIC VMD_rDrvModCorrnSpt_T "Curve to adjust the Virtual accelerator pedal position in Sport drive mode" CURVE 0x80582180 RB_Curve_S16_S16 799.9878 Prc -400.0000 399.9878 FORMAT "%8.4"
 /begin AXIS_DESCR STD_AXIS VMD_rASLCC Prc 10 -400.0000 399.9878 FORMAT "%8.4" DEPOSIT ABSOLUTE /end AXIS_DESCR
/end CHARACTERISTIC
/begin CHARACTERISTIC VMD_rMinWoRamp_C "Minimum accped ratio difference for ramping of torque during drive mode change to be activated" VALUE 0x805821AA RB_Val_Ws16 799.9878 Prc -400.0000 399.9878 FORMAT "%8.4" /end CHARACTERISTIC
/begin CHARACTERISTIC VMD_stAslAccSel_C "Status of Switch for selection of ASL or CC value" VALUE 0x805821AC RB_Val_Wu8 255.0 OneToOne 0.00 255.0 FORMAT "%5.1" /end CHARACTERISTIC
/begin CHARACTERISTIC VMD_tiRampSlopModChg_CA "Time period within which ramping of accped ratio during drive mode change should be finished" VAL_BLK 0x805821AE RB_Val_Ws16 655.3500 Time_s -327.6800 327.6700 FORMAT "%8.4" NUMBER 12 /end CHARACTERISTIC
/begin CHARACTERISTIC VMSI_dtqRmpDCSP.Neg_C "Ramp gradient for shut down of increasing intervention DCS / Ramp structure" VALUE 0x805821DC RB_Val_Ws32 6553599.99847 RmpTrqPrpHigh -3276800.00000 3276799.99847 FORMAT "%13.5" /end CHARACTERISTIC
/begin CHARACTERISTIC VMSI_dtqRmpDCSP.Pos_C "Ramp gradient for shut down of increasing intervention DCS / Ramp structure" VALUE 0x805821E0 RB_Val_Ws32 6553599.99847 RmpTrqPrpHigh -3276800.00000 3276799.99847 FORMAT "%13.5" /end CHARACTERISTIC
/begin CHARACTERISTIC VMSI_dtqRmpTCSP.Neg_C "Ramp gradient for shut down of decreasing intervention TCS / Ramp structure" VALUE 0x805821E4 RB_Val_Ws32 6553599.99847 RmpTrqPrpHigh -3276800.00000 3276799.99847 FORMAT "%13.5" /end CHARACTERISTIC
/begin CHARACTERISTIC VMSI_dtqRmpTCSP.Pos_C "Ramp gradient for shut down of decreasing intervention TCS / Ramp structure" VALUE 0x805821E8 RB_Val_Ws32 6553599.99847 RmpTrqPrpHigh -3276800.00000 3276799.99847 FORMAT "%13.5" /end CHARACTERISTIC
/begin CHARACTERISTIC VMSI_stCfg_C "DCS shut off configuration" VALUE 0x805821C8 RB_Val_Wu8 255.0 OneToOne 0.00 255.0 FORMAT "%5.1" /end CHARACTERISTIC
/begin CHARACTERISTIC VMSI_swtSlipCtl_C "Switch for available stabilty intervention" VALUE 0x805821C9 RB_Val_Wu8 255.0 OneToOne 0.00 255.0 FORMAT "%5.1" /end CHARACTERISTIC
/begin CHARACTERISTIC VMSI_tiPlusOff_C "DCS torque control disable timer" VALUE 0x805821CA RB_Val_Wu16 327460.0 Time_ms 0.00 327460.0 FORMAT "%8.1" EXTENDED_LIMITS 0.00 655350.0 /end CHARACTERISTIC
/begin CHARACTERISTIC VMSI_tiPlus_C "DCS torque control enable timer" VALUE 0x805821CC RB_Val_Wu16 327460.0 Time_ms 0.00 327460.0 FORMAT "%8.1" EXTENDED_LIMITS 0.00 655350.0 /end CHARACTERISTIC
/begin CHARACTERISTIC VMSI_trqLimDCSNorm_C "DCS torque control normal limit value" VALUE 0x805821D0 RB_Val_Ws32 1500.00000000 TrqPrpHigh -500.00000000 1000.00000000 FORMAT "%13.8" EXTENDED_LIMITS -214748364.800 214748364.700 /end CHARACTERISTIC
/begin CHARACTERISTIC VMSI_trqLimDCSPlus_C "DCS torque control plus limit value" VALUE 0x805821D4 RB_Val_Ws32 1500.00000000 TrqPrpHigh -500.00000000 1000.00000000 FORMAT "%13.8" EXTENDED_LIMITS -214748364.800 214748364.700 /end CHARACTERISTIC
/begin CHARACTERISTIC VMSI_trqMin_C "Testvalue for DCS Intervention" VALUE 0x805821D8 RB_Val_Ws32 100000.000000 TrqPrpHigh -50000.0000000 50000.0000000 FORMAT "%13.7" EXTENDED_LIMITS -214748364.800 214748364.700 /end CHARACTERISTIC
/begin MEASUREMENT B_asr_msg "condition for ASR active" UBYTE B_TRUE 1 100 0.00 1.00000000000 BIT_MASK 0x1 FORMAT "%13.11" ECU_ADDRESS 0x70000C3C /end MEASUREMENT
/begin MEASUREMENT B_fgr_msg "condition: drivers set engine torque determined by cruise control" UBYTE B_TRUE 1 100 0.00 1.00000000000 BIT_MASK 0x1 FORMAT "%13.11" ECU_ADDRESS 0x70000BC2 /end MEASUREMENT
/begin MEASUREMENT B_ll_msg "Idle speed from drivers sight" UBYTE B_TRUE 1 100 0.00 1.00000000000 BIT_MASK 0x1 FORMAT "%13.11" ECU_ADDRESS 0x70000B84 /end MEASUREMENT
/begin MEASUREMENT B_msr_msg "Condition MSR" UBYTE B_TRUE 1 100 0.00 1.00000000000 BIT_MASK 0x1 FORMAT "%13.11" ECU_ADDRESS 0x70000B64 /end MEASUREMENT
/begin MEASUREMENT B_vl_msg "Condition for wide open throttle" UBYTE B_TRUE 1 100 0.00 1.00000000000 BIT_MASK 0x1 FORMAT "%13.11" ECU_ADDRESS 0x70000AEF /end MEASUREMENT
/begin MEASUREMENT mivbeb_w_msg "Indicated torque before slope limitation, limited to mimax_w" UWORD rel_uw_b100 1 100 0.00 99.99847 FORMAT "%8.5" ECU_ADDRESS 0x6000932A /end MEASUREMENT
/begin MEASUREMENT mivbeg_w_msg "Indicated torque requested by driver before slope limitation" UWORD rel_uw_b100 1 100 0.00 99.99847 FORMAT "%8.5" ECU_ADDRESS 0x60009328 /end MEASUREMENT
/begin MEASUREMENT mrfa_w_msg "relative driver request torque from cruise control and pedal" UWORD rel_uw_b200 1 100 0.00 199.9969 FORMAT "%8.4" ECU_ADDRESS 0x50005F06 /end MEASUREMENT
/begin MEASUREMENT UEGO_flgUNernstDiagVldS1B1 "Validity flag for Peak filtered UNernst Voltage" UBYTE B_TRUE 1 100 0.00 1.00000000000 BIT_MASK 0x1 FORMAT "%13.11" ECU_ADDRESS 0x700006DF /end MEASUREMENT
/begin MEASUREMENT UEGO_flgUNernstInRngS1B1 "Nernst voltage in range for Sensor 1 Bank 1" UBYTE B_TRUE 1 100 0.00 1.00000000000 BIT_MASK 0x1 FORMAT "%13.11" ECU_ADDRESS 0x700006DE /end MEASUREMENT
/begin MEASUREMENT UEGO_flgUNernstVldS1B1 "Validity flag of the Nernst cell voltage sensor 1 bank 1" UBYTE B_TRUE 1 100 0.00 1.00000000000 BIT_MASK 0x1 FORMAT "%13.11" ECU_ADDRESS 0x700006DD /end MEASUREMENT
/begin MEASUREMENT UEGO_flgUPmpLimnActvS1B1 "Blackening protection activation status." UBYTE B_TRUE 1 100 0.00 1.00000000000 BIT_MASK 0x1 FORMAT "%13.11" ECU_ADDRESS 0x700006DC /end MEASUREMENT
/begin MEASUREMENT UEGO_flgUPmpLimnActvVldS1B1 "Validity of the blackening protection activation status." UBYTE B_TRUE 1 100 0.00 1.00000000000 BIT_MASK 0x1 FORMAT "%13.11" ECU_ADDRESS 0x700006DB /end MEASUREMENT
/begin MEASUREMENT UEGO_flgUPmpVldS1B1 "Validity of the pump voltage." UBYTE B_TRUE 1 100 0.00 1.00000000000 BIT_MASK 0x1 FORMAT "%13.11" ECU_ADDRESS 0x700006DA /end MEASUREMENT
/begin MEASUREMENT UEGO_UNernstCtrlS1B1_I.flgDeltaUnErr "Control class of UEGO_UNernstCtrl / Measured Un Error is greater than a threshold" UBYTE B_TRUE 1 100 0.00 1.00000000000 BIT_MASK 0x1 FORMAT "%13.11" ECU_ADDRESS 0x60001E40 /end MEASUREMENT
/begin MEASUREMENT UEGO_UNernstCtrlS1B1_I.flgIniFinshd "Control class of UEGO_UNernstCtrl / flag to show that Initialisation of Variables and Elements required for the Function is done" UBYTE B_TRUE 1 100 0.00 1.00000000000 BIT_MASK 0x1 FORMAT "%13.11" ECU_ADDRESS 0x60001E41 /end MEASUREMENT
/begin MEASUREMENT UEGO_UNernstCtrlS1B1_I.flgLoT "Control class of UEGO_UNernstCtrl / Sensor Temperature Low" UBYTE B_TRUE 1 100 0.00 1.00000000000 BIT_MASK 0x1 FORMAT "%13.11" ECU_ADDRESS 0x60001E42 /end MEASUREMENT
/begin MEASUREMENT UEGO_UNernstCtrlS1B1_I.flgLoupNDesOld "Control class of UEGO_UNernstCtrl / Previous value of flgLoupNDes" UBYTE B_TRUE 1 100 0.00 1.00000000000 BIT_MASK 0x1 FORMAT "%13.11" ECU_ADDRESS 0x60001E43 /end MEASUREMENT
/begin MEASUREMENT UEGO_UNernstCtrlS1B1_I.flgSetRegUnCtrlOk "Control class of UEGO_UNernstCtrl / Successful setting of Un value to Register" UBYTE B_TRUE 1 100 0.00 1.00000000000 BIT_MASK 0x1 FORMAT "%13.11" ECU_ADDRESS 0x60001E44 /end MEASUREMENT
/begin MEASUREMENT UEGO_UNernstCtrlS1B1_I.flgStopPhaSafe "Control class of UEGO_UNernstCtrl / Engine Stop Phase active" UBYTE B_TRUE 1 100 0.00 1.00000000000 BIT_MASK 0x1 FORMAT "%13.11" ECU_ADDRESS 0x60001E45 /end MEASUREMENT
/begin MEASUREMENT UEGO_UNernstCtrlS1B1_I.nrModInt "Control class of UEGO_UNernstCtrl / Internal Mode Info" UBYTE UEGO_UNernstCtrl_COMPU_VERB 1 100 2.0000000000 10.0000000000 FORMAT "%13.10" ECU_ADDRESS 0x60001E46 /end MEASUREMENT
/begin MEASUREMENT UEGO_UNernstCtrlS1B1_I.nrModIntOld "Control class of UEGO_UNernstCtrl / Previous Mode Info" UBYTE UEGO_UNernstCtrl_COMPU_VERB 1 100 2.0000000000 10.0000000000 FORMAT "%13.10" ECU_ADDRESS 0x60001E47 /end MEASUREMENT
/begin MEASUREMENT UEGO_UNernstCtrlS1B1_I.nrUnSetDig "Control class of UEGO_UNernstCtrl / Digital UNernst voltage value send to the Register" SWORD dez 1 100 -32768.00 32767.00 FORMAT "%8.2" ECU_ADDRESS 0x60001E48 /end MEASUREMENT
/begin MEASUREMENT UEGO_UNernstCtrlS1B1_I.tiPT1FilCon "Control class of UEGO_UNernstCtrl / Filter constant for UNernst Voltage Filter" UWORD t_q0p01 1 100 0.0100 655.3500 FORMAT "%8.4" ECU_ADDRESS 0x60001E4A /end MEASUREMENT
/begin MEASUREMENT UEGO_UNernstCtrlS1B1_I.uPhyDes "Control class of UEGO_UNernstCtrl / Desired UNernst Voltage after Filtering" SWORD spg_q3p2Em4_V 1 100 -10.48576 10.48544 FORMAT "%8.5" ECU_ADDRESS 0x60001E4C /end MEASUREMENT
/begin MEASUREMENT UEGO_UNernstCtrlS1B1_I.uPhyRaw "Control class of UEGO_UNernstCtrl / Raw UNernst Voltage" SWORD spg_q3p2Em4_V 1 100 -10.48576 10.48544 FORMAT "%8.5" ECU_ADDRESS 0x60001E4E /end MEASUREMENT
/begin MEASUREMENT UEGO_UNernstCtrlS1B1_I.uPhyRawDelta "Control class of UEGO_UNernstCtrl / Delta of UNernst Raw Voltage (compared with new and previous)" SWORD spg_q3p2Em4_V 1 100 -10.48576 10.48544 FORMAT "%8.5" ECU_ADDRESS 0x60001E50 /end MEASUREMENT
/begin MEASUREMENT UEGO_UNernstCtrlS1B1_I.RegResendTmrTR_I.timeCounter "Control class of UEGO_UNernstCtrl / Timer for Time based Register Resend of UNernst Voltage / Remaining time of the timer" UWORD t_q0p01 1 100 0.00 655.3500 FORMAT "%8.4" ECU_ADDRESS 0x60001E52 /end MEASUREMENT
/begin MEASUREMENT UEGO_UNernstCtrlS1B1_I.UEGO_uPhyRawLT_I.memory "Control class of UEGO_UNernstCtrl / Filter for Raw UNernst Voltage / current lowpass value" SLONG spg_q4p883Em9_V 1 100 -10.4857600000 10.4857599951 FORMAT "%13.10" ECU_ADDRESS 0x60001E54 /end MEASUREMENT
/begin MEASUREMENT UEGO_UNernstCtrlS1B1_I.flgDeltaUnExcddTOFFV_I.outbit "Control class of UEGO_UNernstCtrl / TurnOffDelay for the evaluation of flgDeltaUnErr / Output Bit" UBYTE B_TRUE 1 100 0.00 1.00000000000 BIT_MASK 0x1 FORMAT "%13.11" ECU_ADDRESS 0x60001E58 /end MEASUREMENT
/begin MEASUREMENT UEGO_UNernstCtrlS1B1_I.flgDeltaUnExcddTOFFV_I.time "Control class of UEGO_UNernstCtrl / TurnOffDelay for the evaluation of flgDeltaUnErr / Occured Time" UWORD t_q0p01 1 100 0.00 655.3500 FORMAT "%8.4" ECU_ADDRESS 0x60001E5A /end MEASUREMENT
/begin MEASUREMENT UEGO_UNernstCtrlS1B1_I.flgDeltaUnExcddTONV_I.outbit "Control class of UEGO_UNernstCtrl / TurnOnDelay for the evaluation of flgDeltaUnErr / return value" UBYTE B_TRUE 1 100 0.00 1.00000000000 BIT_MASK 0x1 FORMAT "%13.11" ECU_ADDRESS 0x60001E5C /end MEASUREMENT
/begin MEASUREMENT UEGO_UNernstCtrlS1B1_I.flgDeltaUnExcddTONV_I.time "Control class of UEGO_UNernstCtrl / TurnOnDelay for the evaluation of flgDeltaUnErr / expired delay time" UWORD t_q0p01 1 100 0.00 655.3500 FORMAT "%8.4" ECU_ADDRESS 0x60001E5E /end MEASUREMENT
/begin MEASUREMENT UEGO_UNernstEvlnS1B1_I.flgUNernstDiagVld "Evaluation Class UEGO_UNernstCtrl / Peak Filtered Measured nernst Voltage Validity" UBYTE B_TRUE 1 100 0.00 1.00000000000 BIT_MASK 0x1 FORMAT "%13.11" ECU_ADDRESS 0x60006D74 /end MEASUREMENT
/begin MEASUREMENT UEGO_UNernstEvlnS1B1_I.flgUNernstInRng "Evaluation Class UEGO_UNernstCtrl / Optimal functioning of UNernst Voltage regulator" UBYTE B_TRUE 1 100 0.00 1.00000000000 BIT_MASK 0x1 FORMAT "%13.11" ECU_ADDRESS 0x60006D75 /end MEASUREMENT
/begin MEASUREMENT UEGO_UNernstEvlnS1B1_I.flgUNernstVld "Evaluation Class UEGO_UNernstCtrl / Validity flag of uNernst" UBYTE B_TRUE 1 100 0.00 1.00000000000 BIT_MASK 0x1 FORMAT "%13.11" ECU_ADDRESS 0x60006D76 /end MEASUREMENT
/begin MEASUREMENT UEGO_UNernstEvlnS1B1_I.uUNernst "Evaluation Class UEGO_UNernstCtrl / Measured UNernst Voltage" SWORD spg_q3p2Em4_V 1 100 -10.48576 10.48544 FORMAT "%8.5" ECU_ADDRESS 0x60006D78 /end MEASUREMENT
/begin MEASUREMENT UEGO_UNernstEvlnS1B1_I.uUNernstDiag "Evaluation Class UEGO_UNernstCtrl / Peak Filtered Measured Nernst Voltage for Diagnosis Purposes" SWORD spg_q3p2Em4_V 1 100 -10.48576 10.48544 FORMAT "%8.5" ECU_ADDRESS 0x60006D7A /end MEASUREMENT
/begin MEASUREMENT UEGO_UNernstEvlnS1B1_I.uUNernstDiagFilOld "Evaluation Class UEGO_UNernstCtrl / Previous Peak filtered UNernst Voltage" SWORD spg_q3p2Em4_V 1 100 -10.48576 10.48544 FORMAT "%8.5" ECU_ADDRESS 0x60006D7C /end MEASUREMENT
/begin MEASUREMENT UEGO_UNernstEvlnS1B1_I.uUNernstEntryLowrDelta "Evaluation Class UEGO_UNernstCtrl / Deviation in negative direction of Un from setpoint" SWORD spg_q3p2Em4_V 1 100 -10.48576 10.48544 FORMAT "%8.5" ECU_ADDRESS 0x60006D7E /end MEASUREMENT
/begin MEASUREMENT UEGO_UNernstEvlnS1B1_I.uUNernstEntryUpprDelta "Evaluation Class UEGO_UNernstCtrl / Deviation in positive direction of Un from setpoint" SWORD spg_q3p2Em4_V 1 100 -10.48576 10.48544 FORMAT "%8.5" ECU_ADDRESS 0x60006D80 /end MEASUREMENT
/begin MEASUREMENT UEGO_UNernstEvlnS1B1_I.uUNernstExLowrDelta "Evaluation Class UEGO_UNernstCtrl / Deviation in negative direction of Un from setpoint" SWORD spg_q3p2Em4_V 1 100 -10.48576 10.48544 FORMAT "%8.5" ECU_ADDRESS 0x60006D82 /end MEASUREMENT
/begin MEASUREMENT UEGO_UNernstEvlnS1B1_I.uUNernstExUpprDelta "Evaluation Class UEGO_UNernstCtrl / Deviation in positive direction of Un from setpoint" SWORD spg_q3p2Em4_V 1 100 -10.48576 10.48544 FORMAT "%8.5" ECU_ADDRESS 0x60006D84 /end MEASUREMENT
/begin MEASUREMENT UEGO_UNernstEvlnS1B1_I.uUnPckAryDiagFilNorm "Evaluation Class UEGO_UNernstCtrl / Array for Peak filtered UNernst voltage" SWORD spg_q3p2Em4_V 1 100 -10.48576 10.48544 FORMAT "%8.5" ARRAY_SIZE 15 ECU_ADDRESS 0x60006D86 /end MEASUREMENT
/begin MEASUREMENT UEGO_UNernstEvlnS1B1_I.uUNernstPeakFil_I.flgFilStrtd "Evaluation Class UEGO_UNernstCtrl / Peak Filter for filtering measured UNernst Voltage / Temporary variables used inside Peak Filter in UNernstCtrl" UBYTE B_TRUE 1 100 0.00 1.00000000000 BIT_MASK 0x1 FORMAT "%13.11" ECU_ADDRESS 0x60006DA4 /end MEASUREMENT
/begin MEASUREMENT UEGO_UNernstEvlnS1B1_I.uUNernstPeakFil_I.uDeltaInOutpMax "Evaluation Class UEGO_UNernstCtrl / Peak Filter for filtering measured UNernst Voltage / Temporary variables used inside Peak Filter in UNernstCtrl" SWORD spg_q3p2Em4_V 1 100 -10.48576 10.48544 FORMAT "%8.5" ECU_ADDRESS 0x60006DA6 /end MEASUREMENT
/begin MEASUREMENT UEGO_UPmpLimnCtrlS1B1_I.flgIPmpBlckn "Class instance to set different registers related to blackening protection. / Validity of IPBlack Register setting." UBYTE B_TRUE 1 100 0.00 1.00000000000 BIT_MASK 0x1 FORMAT "%13.11" ECU_ADDRESS 0x60006D53 /end MEASUREMENT
/begin MEASUREMENT UEGO_UPmpLimnCtrlS1B1_I.flgLoupCURRDes "Class instance to set different registers related to blackening protection. / LCURR current operating mode" UBYTE B_TRUE 1 100 0.00 1.00000000000 BIT_MASK 0x1 FORMAT "%13.11" ECU_ADDRESS 0x60006D54 /end MEASUREMENT
/begin MEASUREMENT UEGO_UPmpLimnCtrlS1B1_I.flgLoupCURRDesOld "Class instance to set different registers related to blackening protection. / LCURR previous operating mode" UBYTE B_TRUE 1 100 0.00 1.00000000000 BIT_MASK 0x1 FORMAT "%13.11" ECU_ADDRESS 0x60006D55 /end MEASUREMENT
/begin MEASUREMENT UEGO_UPmpLimnCtrlS1B1_I.flgLoupPDes "Class instance to set different registers related to blackening protection. / Pump voltage amplification status" UBYTE B_TRUE 1 100 0.00 1.00000000000 BIT_MASK 0x1 FORMAT "%13.11" ECU_ADDRESS 0x60006D56 /end MEASUREMENT
/begin MEASUREMENT UEGO_UPmpLimnCtrlS1B1_I.flgLoupPDesOld "Class instance to set different registers related to blackening protection. / Pump voltage amplification status of the previous raster." UBYTE B_TRUE 1 100 0.00 1.00000000000 BIT_MASK 0x1 FORMAT "%13.11" ECU_ADDRESS 0x60006D57 /end MEASUREMENT
/begin MEASUREMENT UEGO_UPmpLimnCtrlS1B1_I.flgSetReguPmpLimnOk "Class instance to set different registers related to blackening protection. / Flag to determine if resending of blackening protection related registers is required." UBYTE B_TRUE 1 100 0.00 1.00000000000 BIT_MASK 0x1 FORMAT "%13.11" ECU_ADDRESS 0x60006D52 /end MEASUREMENT
/begin MEASUREMENT UEGO_UPmpLimnCtrlS1B1_I.nrIPmpBlckn "Class instance to set different registers related to blackening protection. / Replacement pump current during blackening." SWORD OneToOne 1 100 -6012.000 6012.000 FORMAT "%8.3" ECU_ADDRESS 0x60006D58 /end MEASUREMENT
/begin MEASUREMENT UEGO_UPmpLimnCtrlS1B1_I.nrModInt "Class instance to set different registers related to blackening protection. / SCODE Internal mode of UEGO_UPmpLimnCtrlClass." UBYTE UEGO_UPmpLimn_COMPU_VERB 1 100 0.00 1.00000000000 FORMAT "%13.11" ECU_ADDRESS 0x60006D5A /end MEASUREMENT
/begin MEASUREMENT UEGO_UPmpLimnCtrlS1B1_I.nrModIntOld "Class instance to set different registers related to blackening protection. / Previous raster SCODE Internal mode of UEGO_UPmpLimnCtrlClass." UBYTE UEGO_UPmpLimn_COMPU_VERB 1 100 0.00 1.00000000000 FORMAT "%13.11" ECU_ADDRESS 0x60006D5B /end MEASUREMENT
/begin MEASUREMENT UEGO_UPmpLimnCtrlS1B1_I.nrRPmp "Class instance to set different registers related to blackening protection. / Pump cell Resistance(Rip) Value" UWORD OneToOne 1 100 0.00 65535.00 FORMAT "%8.2" ECU_ADDRESS 0x60006D5C /end MEASUREMENT
/begin MEASUREMENT UEGO_UPmpLimnCtrlS1B1_I.nrUPmpLimnHys "Class instance to set different registers related to blackening protection. / Hysterisis value (both time and voltage)" UWORD OneToOne 1 100 0.00 65535.00 FORMAT "%8.2" ECU_ADDRESS 0x60006D5E /end MEASUREMENT
/begin MEASUREMENT UEGO_UPmpLimnCtrlS1B1_I.nrUPmpLimnLean "Class instance to set different registers related to blackening protection. / Lean Pump Voltage threshold" SWORD OneToOne 1 100 -32768.00 32767.00 FORMAT "%8.2" ECU_ADDRESS 0x60006D60 /end MEASUREMENT
/begin MEASUREMENT UEGO_UPmpLimnCtrlS1B1_I.nrUPmpLimnRich "Class instance to set different registers related to blackening protection. / Rich Pump Voltage threshold" SWORD OneToOne 1 100 -32768.00 32767.00 FORMAT "%8.2" ECU_ADDRESS 0x60006D62 /end MEASUREMENT
/begin MEASUREMENT UEGO_UPmpLimnCtrlS1B1_I.RegReclcUpLimnTR_I.timeCounter "Class instance to set different registers related to blackening protection. / Timer to trigger periodic resending of registers related to blackening protection. / Remaining time of the timer" UWORD t_q0p01 1 100 0.00 655.3500 FORMAT "%8.4" ECU_ADDRESS 0x60006D64 /end MEASUREMENT
/begin MEASUREMENT UEGO_UPmpLimnEvlnS1B1_I.flgUPmpLimnActv "Class instance to evaluate pump voltage and blackening protection status. / Blackening protection activation status." UBYTE B_TRUE 1 100 0.00 1.00000000000 BIT_MASK 0x1 FORMAT "%13.11" ECU_ADDRESS 0x60001E28 /end MEASUREMENT
/begin MEASUREMENT UEGO_UPmpLimnEvlnS1B1_I.flgUPmpLimnActvVld "Class instance to evaluate pump voltage and blackening protection status. / Validity of the blackening protection activation status." UBYTE B_TRUE 1 100 0.00 1.00000000000 BIT_MASK 0x1 FORMAT "%13.11" ECU_ADDRESS 0x60001E29 /end MEASUREMENT
/begin MEASUREMENT UEGO_UPmpLimnEvlnS1B1_I.flgUPmpVld "Class instance to evaluate pump voltage and blackening protection status. / Validity of the pump voltage." UBYTE B_TRUE 1 100 0.00 1.00000000000 BIT_MASK 0x1 FORMAT "%13.11" ECU_ADDRESS 0x60001E2A /end MEASUREMENT
/begin MEASUREMENT UEGO_UPmpLimnEvlnS1B1_I.nrIPmpNotOKPck "Class instance to evaluate pump voltage and blackening protection status. / Number of invalid pump current cycles to determine blackening protection activation status." UBYTE OneToOne 1 100 0.00 255.0 FORMAT "%5.1" ECU_ADDRESS 0x60001E2B /end MEASUREMENT
/begin MEASUREMENT UEGO_UPmpLimnEvlnS1B1_I.uUPmp "Class instance to evaluate pump voltage and blackening protection status. / Pump voltage evaluated" SWORD spg_q3p2Em4_V 1 100 -10.48576 10.48544 FORMAT "%8.5" ECU_ADDRESS 0x60001E2C /end MEASUREMENT
/begin MEASUREMENT UEGO_UPmpLimnEvlnS1B1_I.uUPmpAvg "Class instance to evaluate pump voltage and blackening protection status. / Average pump voltage" SWORD spg_q3p2Em4_V 1 100 -10.48576 10.48544 FORMAT "%8.5" ECU_ADDRESS 0x60001E2E /end MEASUREMENT
/begin MEASUREMENT UEGO_UPmpLimnEvlnS1B1_I.UEGO_uEvlnFilDlydVldy_S16_spg_q3p2Em4.flgFilVldy "Class instance to evaluate pump voltage and blackening protection status. / Filter instance / Validity Flag." UBYTE B_TRUE 1 100 0.00 1.00000000000 BIT_MASK 0x1 FORMAT "%13.11" ECU_ADDRESS 0x60001E30 /end MEASUREMENT
/begin MEASUREMENT UEGO_UPmpLimnEvlnS1B1_I.UEGO_uEvlnFilDlydVldy_S16_spg_q3p2Em4.nrSampleCurr "Class instance to evaluate pump voltage and blackening protection status. / Filter instance / Current sample count." UWORD OneToOne 1 100 0.00 65535.00 FORMAT "%8.2" ECU_ADDRESS 0x60001E32 /end MEASUREMENT
/begin MEASUREMENT UEGO_UPmpLimnEvlnS1B1_I.UEGO_uEvlnFilDlydVldy_S16_spg_q3p2Em4.nrSampleRef "Class instance to evaluate pump voltage and blackening protection status. / Filter instance / Reciprocal of Filter time constant." ULONG fak_uw_b2 1 100 0.00 131071.999969 FORMAT "%13.6" ECU_ADDRESS 0x60001E34 /end MEASUREMENT
/begin MEASUREMENT UEGO_UPmpLimnEvlnS1B1_I.UEGO_uEvlnFilDlydVldy_S16_spg_q3p2Em4.nrSampleThd "Class instance to evaluate pump voltage and blackening protection status. / Filter instance / Total number of samples." UWORD OneToOne 1 100 1.00 65535.00 FORMAT "%8.2" ECU_ADDRESS 0x60001E38 /end MEASUREMENT
/begin MEASUREMENT UEGO_UPmpLimnEvlnS1B1_I.UEGO_uEvlnFilDlydVldy_S16_spg_q3p2Em4.EvlnFil_DL_I.memory "Class instance to evaluate pump voltage and blackening protection status. / Filter instance / Filter functionality with delayed validity. / current lowpass value" SLONG spg_q4p883Em9_V 1 100 -10.4857600000 10.4857599951 FORMAT "%13.10" ECU_ADDRESS 0x60001E3C /end MEASUREMENT
/begin MEASUREMENT UEGO_uUNernstDiagS1B1 "Peak Filtered UNernst Voltage" SWORD spg_q3p2Em4_V 1 100 -10.48576 10.48544 FORMAT "%8.5" ECU_ADDRESS 0x6000967E /end MEASUREMENT
/begin MEASUREMENT UEGO_uUNernstPhyDesS1B1 "Desired Physical UNernst Volatge" SWORD spg_q3p2Em4_V 1 100 -10.48576 10.48544 FORMAT "%8.5" ECU_ADDRESS 0x6000967C /end MEASUREMENT
/begin MEASUREMENT UEGO_uUNernstS1B1 "Measured UNernst Voltage" SWORD spg_q3p2Em4_V 1 100 -10.48576 10.48544 FORMAT "%8.5" ECU_ADDRESS 0x6000967A /end MEASUREMENT
/begin MEASUREMENT UEGO_uUp0Pck5Dummy "Dummy Variable." SWORD spg_q3p2Em4_V 1 100 -10.48576 10.48544 FORMAT "%8.5" ARRAY_SIZE 2 ECU_ADDRESS 0x60006D70 /end MEASUREMENT
/begin MEASUREMENT UEGO_uUpDummy "Dummy interface to avoid interface issues for different ASIC types." SWORD spg_q3p2Em4_V 1 100 -10.48576 10.48544 FORMAT "%8.5" ARRAY_SIZE 5 ECU_ADDRESS 0x60006D66 /end MEASUREMENT
/begin MEASUREMENT UEGO_uUPmpS1B1 "Pump voltage evaluated" SWORD spg_q3p2Em4_V 1 100 -10.48576 10.48544 FORMAT "%8.5" ECU_ADDRESS 0x60009678 /end MEASUREMENT
/begin MEASUREMENT VehMot_a2trq "Conversion factor acceleration to propulsion torque" SWORD MassLength 1 100 -6553.600 6553.400 FORMAT "%8.3" ECU_ADDRESS 0x60009638 /end MEASUREMENT
/begin MEASUREMENT VehMot_aPrpCurr "Current estimated acceleration" SWORD Acc 1 100 -32.76800 32.76700 FORMAT "%8.5" ECU_ADDRESS 0x60009636 /end MEASUREMENT
/begin MEASUREMENT VehMot_aPrpMax "Maximum estimated acceleration at current engaged gear" SWORD Acc 1 100 -32.76800 32.76700 FORMAT "%8.5" ECU_ADDRESS 0x60009634 /end MEASUREMENT
/begin MEASUREMENT VehMot_aPrpMin "Minimum estimated acceleration at current engaged gear" SWORD Acc 1 100 -32.76800 32.76700 FORMAT "%8.5" ECU_ADDRESS 0x60009632 /end MEASUREMENT
/begin MEASUREMENT VehMot_flgAppVartn "Flag which is set when acc.ped. Slope is higher than positive or negetive threshold" UBYTE B_TRUE 1 100 0.00 1.00000000000 BIT_MASK 0x1 FORMAT "%13.11" ECU_ADDRESS 0x6000B59C /end MEASUREMENT
/begin MEASUREMENT VehMot_flgDlyAppVartn "Flag which remains set for a delay time after acc.ped slope has crossed positive or negetice threshold" UBYTE B_TRUE 1 100 0.00 1.00000000000 BIT_MASK 0x1 FORMAT "%13.11" ECU_ADDRESS 0x6000B59B /end MEASUREMENT
/begin MEASUREMENT VehMot_flgHighLdVehDyn "Flag to indicate high load condition" UBYTE B_TRUE 1 100 0.00 1.00000000000 BIT_MASK 0x1 FORMAT "%13.11" ECU_ADDRESS 0x6000B59A /end MEASUREMENT
/begin MEASUREMENT VehMot_rApp "Accelerator pedal position based on driver, CC, and ASL demanded ratio" SWORD Prc 1 100 -400.0000 399.9878 FORMAT "%8.4" ECU_ADDRESS 0x60006D50 /end MEASUREMENT
/begin MEASUREMENT VehMot_rAppDiff "Difference between the current and 20ms previous value of accelerator pedal expressed in PrcPerSec" SWORD PrcPerSec 1 100 -20000.00 19999.39 FORMAT "%8.2" ECU_ADDRESS 0x60006D4E /end MEASUREMENT
/begin MEASUREMENT VehMot_rAppPrev1 "Previous raster(10ms) vaule of accped" SWORD Prc 1 100 -400.0000 399.9878 FORMAT "%8.4" ECU_ADDRESS 0x60006D4C /end MEASUREMENT
/begin MEASUREMENT VehMot_rAppPrev2 "Second previous raster(20ms) value of accped" SWORD Prc 1 100 -400.0000 399.9878 FORMAT "%8.4" ECU_ADDRESS 0x60006D4A /end MEASUREMENT
/begin MEASUREMENT VehMot_tiTrqDragPT1 "Time constant for filtering drag esimation" SWORD Time_s_1 1 100 -32.76800 32.76700 FORMAT "%8.5" ECU_ADDRESS 0x60009626 /end MEASUREMENT
/begin MEASUREMENT VehMot_tqWhlMax "Maximum wheel torque from engine" SLONG TrqPrpHigh 1 100 -214748364.800 214748364.700 FORMAT "%13.3" ECU_ADDRESS 0x60003948 /end MEASUREMENT
/begin MEASUREMENT VehMot_trqDrag "calculated driving resistance" SLONG TrqPrpHigh 1 100 -214748364.800 214748364.700 FORMAT "%13.3" ECU_ADDRESS 0x60003944 /end MEASUREMENT
/begin MEASUREMENT VehMot_trqDragEst_mp "Estimated drag torque" SLONG TrqPrpHigh 1 100 -214748364.800 214748364.700 FORMAT "%13.3" ECU_ADDRESS 0x7000A040 /end MEASUREMENT
/begin MEASUREMENT VehMot_trqPrpFlt_mp "Current torque, filtered" SLONG TrqPrpHigh 1 100 -214748364.800 214748364.700 FORMAT "%13.3" ECU_ADDRESS 0x7000A03C /end MEASUREMENT
/begin MEASUREMENT VehMot_trqWoComp_mp "Propulsion torque without compensation term" SLONG TrqPrpHigh 1 100 -214748364.800 214748364.700 FORMAT "%13.3" ECU_ADDRESS 0x7000A038 /end MEASUREMENT
/begin MEASUREMENT VehStc_cntBattSnsrPOR "Total count of battery sensor POR" UBYTE OneToOne 1 100 0.00 255.0 FORMAT "%5.1" ECU_ADDRESS 0x6000F767 /end MEASUREMENT
/begin MEASUREMENT VehStc_cntDcyc "Total count of Driving cycle" UWORD OneToOne 1 100 0.00 65535.00 FORMAT "%8.2" ECU_ADDRESS 0x60008DDC /end MEASUREMENT
/begin MEASUREMENT VehStc_cntFuDiagRecA "Fuel system diagnos counter is recording parameter" ULONG OneToOne 1 100 0.00 4294967295.00 FORMAT "%13.2" ARRAY_SIZE 21 ECU_ADDRESS 0x60001C20 /end MEASUREMENT
/begin MEASUREMENT VehStc_cntIS "Total count of Idling Stop" ULONG OneToOne 1 100 0.00 4294967295.00 FORMAT "%13.2" ECU_ADDRESS 0x60003784 /end MEASUREMENT
/begin MEASUREMENT VehStc_cntISInhbSwt "Total count of the user push ISINHBIT Switch" UWORD OneToOne 1 100 0.00 65535.00 FORMAT "%8.2" ECU_ADDRESS 0x60008DDA /end MEASUREMENT
/begin MEASUREMENT VehStc_cntISStrtrActvn "Total count of activate starter" ULONG OneToOne 1 100 0.00 4294967295.00 FORMAT "%13.2" ECU_ADDRESS 0x60003780 /end MEASUREMENT
/begin MEASUREMENT VehStc_cntJS "Total count of Jump start" UBYTE OneToOne 1 100 0.00 255.0 FORMAT "%5.1" ECU_ADDRESS 0x6000F766 /end MEASUREMENT
/begin MEASUREMENT VehStc_cntrBattROth "Counter for temperature compensate" ULONG OneToOne 1 100 0.00 4294967295.00 FORMAT "%13.2" ECU_ADDRESS 0x60001E24 /end MEASUREMENT
/begin MEASUREMENT VehStc_cntrBattROthMean "Battery resistance ROthMean for 4 DC array counter" UBYTE OneToOne 1 100 0.00 255.0 FORMAT "%5.1" ECU_ADDRESS 0x6000B599 /end MEASUREMENT
/begin MEASUREMENT VehStc_cntrBattROthMeanOld "Array index of Batt resistance ROthMean 4 DC old" UBYTE OneToOne 1 100 0.00 255.0 FORMAT "%5.1" ECU_ADDRESS 0x6000B598 /end MEASUREMENT
/begin MEASUREMENT VehStc_cntrDataAltLoadHstg "Distribution of ACGFAVE counter" UBYTE OneToOne 1 100 0.00 255.0 FORMAT "%5.1" ECU_ADDRESS 0x6000B597 /end MEASUREMENT
/begin MEASUREMENT VehStc_cntrDataDrkDchaDistbn "Dark discharge distribution counter" UBYTE OneToOne 1 100 0.00 255.0 FORMAT "%5.1" ECU_ADDRESS 0x6000B596 /end MEASUREMENT
/begin MEASUREMENT VehStc_cntrDataDurAftIgnOffHstg "Distribution of IG off time counter" UBYTE OneToOne 1 100 0.00 255.0 FORMAT "%5.1" ECU_ADDRESS 0x6000B595 /end MEASUREMENT
/begin MEASUREMENT VehStc_cntrDataEngOnHstg "Distribution of Engine run time counter" UBYTE OneToOne 1 100 0.00 255.0 FORMAT "%5.1" ECU_ADDRESS 0x6000B594 /end MEASUREMENT
/begin MEASUREMENT VehStc_cntrDataIBattEBSDurgISHstg "Battery current distribution during IS counter" UBYTE OneToOne 1 100 0.00 255.0 FORMAT "%5.1" ECU_ADDRESS 0x6000B593 /end MEASUREMENT
/begin MEASUREMENT VehStc_cntrDataIExctHstg "Distribution of excitation duty cycle counter" UBYTE OneToOne 1 100 0.00 255.0 FORMAT "%5.1" ECU_ADDRESS 0x6000B592 /end MEASUREMENT
/begin MEASUREMENT VehStc_cntrDataISDurnHstg "IS duration distribution counter" UBYTE OneToOne 1 100 0.00 255.0 FORMAT "%5.1" ECU_ADDRESS 0x6000B591 /end MEASUREMENT
/begin MEASUREMENT VehStc_cntrDataRatSOCHstg "Distribution of 12V battery sensor SOC counter" UBYTE OneToOne 1 100 0.00 255.0 FORMAT "%5.1" ECU_ADDRESS 0x6000B590 /end MEASUREMENT
/begin MEASUREMENT VehStc_cntrDataTAirOutdHstg "Distribution of atomospheric temperature counter" UBYTE OneToOne 1 100 0.00 255.0 FORMAT "%5.1" ECU_ADDRESS 0x6000B58F /end MEASUREMENT
/begin MEASUREMENT VehStc_cntrDataTBattEBSHstg "Distribution of 12V battery temperature counter" UBYTE OneToOne 1 100 0.00 255.0 FORMAT "%5.1" ECU_ADDRESS 0x6000B58E /end MEASUREMENT
/begin MEASUREMENT VehStc_cntrDataUBattEBSDurgISHstg "Battery voltage distribution during IS counter" UBYTE OneToOne 1 100 0.00 255.0 FORMAT "%5.1" ECU_ADDRESS 0x6000B58D /end MEASUREMENT
/begin MEASUREMENT VehStc_cntrDataUBattEBSHstg "Distribution of vehicle system voltage counter" UBYTE OneToOne 1 100 0.00 255.0 FORMAT "%5.1" ECU_ADDRESS 0x6000B58C /end MEASUREMENT
/begin MEASUREMENT VehStc_cntrDataUnstyDrkDchaI "Non-steady dark discharge current distribution counter" UBYTE OneToOne 1 100 0.00 255.0 FORMAT "%5.1" ECU_ADDRESS 0x6000B58B /end MEASUREMENT
/begin MEASUREMENT VehStc_cntrMisfDetn "Counter for Number of misfire every 100ms" UWORD OneToOne 1 100 0.00 65535.00 FORMAT "%8.2" ECU_ADDRESS 0x60006CE0 /end MEASUREMENT
/begin MEASUREMENT VehStc_cntrPostDrvLve "Counter reinitialization" UBYTE OneToOne 1 100 0.00 255.0 FORMAT "%5.1" ECU_ADDRESS 0x6000B58A /end MEASUREMENT
/begin MEASUREMENT VehStc_cntSt1Tran "Total count of status transition, from BMSTATUS = 1 to BMSTATUS = 2" UBYTE OneToOne 1 100 0.00 255.0 FORMAT "%5.1" ECU_ADDRESS 0x6000F765 /end MEASUREMENT
/begin MEASUREMENT VehStc_cntSt4Tran "Total count of status transition, from BMSTATUS = 4 to BMSTATUS = 7" UWORD OneToOne 1 100 0.00 4095.000 FORMAT "%8.3" ECU_ADDRESS 0x60008DD8 /end MEASUREMENT
/begin MEASUREMENT VehStc_cntSt8Tran "Total count of status transition, from BMSTATUS = 8 to BMSTATUS = 1 or 7" UBYTE OneToOne 1 100 0.00 255.0 FORMAT "%5.1" ECU_ADDRESS 0x6000F764 /end MEASUREMENT
/begin MEASUREMENT VehStc_dataAltLoadCmprHstg "Distribution of ACGFAVE (compressed)" UBYTE OneToOne 1 100 0.00 255.0 FORMAT "%5.1" ARRAY_SIZE 5 ECU_ADDRESS 0x6000B558 /end MEASUREMENT
/begin MEASUREMENT VehStc_dataAltLoadHstg "Distribution of ACGFAVE (uncompressed)" ULONG OneToOne 1 100 0.00 4294967295.00 FORMAT "%13.2" ARRAY_SIZE 5 ECU_ADDRESS 0x60001E00 /end MEASUREMENT
/begin MEASUREMENT VehStc_dataDrkDchaDistbn "Dark discharge distribution" UWORD OneToOne 1 100 0.00 65535.00 FORMAT "%8.2" ARRAY_SIZE 25 ECU_ADDRESS 0x60006D00 /end MEASUREMENT
/begin MEASUREMENT VehStc_dataDurAftIgnOffCmprHstg "Distribution of IG off time (compressed)" UBYTE OneToOne 1 100 0.00 255.0 FORMAT "%5.1" ARRAY_SIZE 8 ECU_ADDRESS 0x6000B550 /end MEASUREMENT
/begin MEASUREMENT VehStc_dataDurAftIgnOffHstg "Distribution of IG off time (uncompressed)" ULONG OneToOne 1 100 0.00 4294967295.00 FORMAT "%13.2" ARRAY_SIZE 8 ECU_ADDRESS 0x60001DE0 /end MEASUREMENT
/begin MEASUREMENT VehStc_dataEngOnCmprHstg "Distribution of Engine run time (compressed)" UBYTE OneToOne 1 100 0.00 255.0 FORMAT "%5.1" ARRAY_SIZE 9 ECU_ADDRESS 0x6000B547 /end MEASUREMENT
/begin MEASUREMENT VehStc_dataEngOnHstg "Distribution of Engine run time (uncompressed)" ULONG OneToOne 1 100 0.00 4294967295.00 FORMAT "%13.2" ARRAY_SIZE 9 ECU_ADDRESS 0x60001DBC /end MEASUREMENT
/begin MEASUREMENT VehStc_dataIBattEBSDurgISCmprHstg "Battery current distribution during IS (compressed)" UBYTE OneToOne 1 100 0.00 255.0 FORMAT "%5.1" ARRAY_SIZE 6 ECU_ADDRESS 0x6000B541 /end MEASUREMENT
/begin MEASUREMENT VehStc_dataIBattEBSDurgISHstg "Battery current distribution during IS (uncompressed)" ULONG OneToOne 1 100 0.00 4294967295.00 FORMAT "%13.2" ARRAY_SIZE 6 ECU_ADDRESS 0x60001DA4 /end MEASUREMENT
/begin MEASUREMENT VehStc_dataIExctCmprHstg "Distribution of excitation duty cycle (compressed)" UBYTE OneToOne 1 100 0.00 255.0 FORMAT "%5.1" ARRAY_SIZE 5 ECU_ADDRESS 0x6000B53C /end MEASUREMENT
/begin MEASUREMENT VehStc_dataIExctHstg "Distribution of excitation duty cycle (uncompressed)" ULONG OneToOne 1 100 0.00 4294967295.00 FORMAT "%13.2" ARRAY_SIZE 5 ECU_ADDRESS 0x60001D90 /end MEASUREMENT
/begin MEASUREMENT VehStc_dataISDurnCmprHstg "IS duration distribution (compressed)" UBYTE OneToOne 1 100 0.00 255.0 FORMAT "%5.1" ARRAY_SIZE 9 ECU_ADDRESS 0x6000B533 /end MEASUREMENT
/begin MEASUREMENT VehStc_dataISDurnHstg "IS duration distribution (uncompressed)" ULONG OneToOne 1 100 0.00 4294967295.00 FORMAT "%13.2" ARRAY_SIZE 9 ECU_ADDRESS 0x60001D6C /end MEASUREMENT
/begin MEASUREMENT VehStc_dataRatSocCmprHstg "Distribution of 12V battery sensor SOC (compressed)" UBYTE OneToOne 1 100 0.00 255.0 FORMAT "%5.1" ARRAY_SIZE 13 ECU_ADDRESS 0x6000B526 /end MEASUREMENT
/begin MEASUREMENT VehStc_dataRatSocHstg "Distribution of 12V battery sensor SOC (uncompressed)" ULONG OneToOne 1 100 0.00 4294967295.00 FORMAT "%13.2" ARRAY_SIZE 13 ECU_ADDRESS 0x60001D38 /end MEASUREMENT
/begin MEASUREMENT VehStc_dataTAirOutdCmprHstg "Distribution of atomospheric temperature (compressed)" UBYTE OneToOne 1 100 0.00 255.0 FORMAT "%5.1" ARRAY_SIZE 10 ECU_ADDRESS 0x6000B51C /end MEASUREMENT
/begin MEASUREMENT VehStc_dataTAirOutdHstg "Distribution of atomospheric temperature (uncompressed)" ULONG OneToOne 1 100 0.00 4294967295.00 FORMAT "%13.2" ARRAY_SIZE 10 ECU_ADDRESS 0x60001D10 /end MEASUREMENT
/begin MEASUREMENT VehStc_dataTBattEBSCmprHstg "Distribution of 12V battery temperature (compressed)" UBYTE OneToOne 1 100 0.00 255.0 FORMAT "%5.1" ARRAY_SIZE 10 ECU_ADDRESS 0x6000B512 /end MEASUREMENT
/begin MEASUREMENT VehStc_dataTBattEBSHstg "Distribution of 12V battery temperature (uncompressed)" ULONG OneToOne 1 100 0.00 4294967295.00 FORMAT "%13.2" ARRAY_SIZE 10 ECU_ADDRESS 0x60001CE8 /end MEASUREMENT
/begin MEASUREMENT VehStc_dataUBattEBSCmprHstg "Distribution of vehicle system voltage (Battery sensor voltage) (compressed)" UBYTE OneToOne 1 100 0.00 255.0 FORMAT "%5.1" ARRAY_SIZE 20 ECU_ADDRESS 0x6000B4FE /end MEASUREMENT
/begin MEASUREMENT VehStc_dataUBattEBSDurgISCmprHstg "Battery voltage distribution during IS (compressed)" UBYTE OneToOne 1 100 0.00 255.0 FORMAT "%5.1" ARRAY_SIZE 9 ECU_ADDRESS 0x6000B4F5 /end MEASUREMENT
/begin MEASUREMENT VehStc_dataUBattEBSDurgISHstg "Battery voltage distribution during IS (uncompressed)" ULONG OneToOne 1 100 0.00 4294967295.00 FORMAT "%13.2" ARRAY_SIZE 9 ECU_ADDRESS 0x60001CC4 /end MEASUREMENT
/begin MEASUREMENT VehStc_dataUBattEBSHstg "Distribution of vehicle system voltage (Battery sensor voltage) (uncompressed)" ULONG OneToOne 1 100 0.00 4294967295.00 FORMAT "%13.2" ARRAY_SIZE 20 ECU_ADDRESS 0x60001C74 /end MEASUREMENT
/begin MEASUREMENT VehStc_dataUnstyDrkDchaIDistbn "Non-steady dark discharge current distribution" UWORD OneToOne 1 100 0.00 65535.00 FORMAT "%8.2" ARRAY_SIZE 15 ECU_ADDRESS 0x60006CE2 /end MEASUREMENT
/begin MEASUREMENT VehStc_divdAirOutdCmprPrm "Compression parameter for atomospheric temperature" UBYTE OneToOne 1 100 0.00 255.0 FORMAT "%5.1" ECU_ADDRESS 0x6000F763 /end MEASUREMENT
/begin MEASUREMENT VehStc_divdAltLoadCmprPrm "Compression parameter for ACGFAVE" UBYTE OneToOne 1 100 0.00 255.0 FORMAT "%5.1" ECU_ADDRESS 0x6000F762 /end MEASUREMENT
/begin MEASUREMENT VehStc_divdDurAftIgnOffCmprPrm "Compression parameter for IG off time" UBYTE OneToOne 1 100 0.00 255.0 FORMAT "%5.1" ECU_ADDRESS 0x6000F761 /end MEASUREMENT
/begin MEASUREMENT VehStc_divdEngOnCmprPrm "Compression parameter for Engine run" UBYTE OneToOne 1 100 0.00 255.0 FORMAT "%5.1" ECU_ADDRESS 0x6000F760 /end MEASUREMENT
/begin MEASUREMENT VehStc_divdIBattEBSDurgISCmprPrm "Compression parameter for battery current during IS" UBYTE OneToOne 1 100 0.00 255.0 FORMAT "%5.1" ECU_ADDRESS 0x6000F75F /end MEASUREMENT
/begin MEASUREMENT VehStc_divdIExctCmprPrm "Compression parameter for excitation duty cycle" UBYTE OneToOne 1 100 0.00 255.0 FORMAT "%5.1" ECU_ADDRESS 0x6000F75E /end MEASUREMENT
/begin MEASUREMENT VehStc_divdISDurnCmprPrm "Compression parameter for IS duration" UBYTE OneToOne 1 100 0.00 255.0 FORMAT "%5.1" ECU_ADDRESS 0x6000F75D /end MEASUREMENT
/begin MEASUREMENT VehStc_divdRatSOCCmprPrm "Compression parameter for battery SOC" UBYTE OneToOne 1 100 0.00 255.0 FORMAT "%5.1" ECU_ADDRESS 0x6000F75C /end MEASUREMENT
/begin MEASUREMENT VehStc_divdTBattEBSCmprPrm "Compression parameter for battery temperature" UBYTE OneToOne 1 100 0.00 255.0 FORMAT "%5.1" ECU_ADDRESS 0x6000F75B /end MEASUREMENT
/begin MEASUREMENT VehStc_divdUBattEBSCmprPrm "Compression parameter for battery voltage" UBYTE OneToOne 1 100 0.00 255.0 FORMAT "%5.1" ECU_ADDRESS 0x6000F75A /end MEASUREMENT
/begin MEASUREMENT VehStc_divdUBattEBSDurgISCmprPrm "Compression parameter for battery voltage during IS" UBYTE OneToOne 1 100 0.00 255.0 FORMAT "%5.1" ECU_ADDRESS 0x6000F759 /end MEASUREMENT
/begin MEASUREMENT VehStc_flgBattMngtFailr "History information of Battery management system failure (1: Failure)" UBYTE B_TRUE 1 100 0.00 1.00000000000 BIT_MASK 0x1 FORMAT "%13.11" ECU_ADDRESS 0x60038D71 /end MEASUREMENT
/begin MEASUREMENT VehStc_flgBMSTATUS1 "BMSTATUS1 Completion flag Last DC final value (1: Completed)" UBYTE B_TRUE 1 100 0.00 1.00000000000 BIT_MASK 0x1 FORMAT "%13.11" ECU_ADDRESS 0x60038D70 /end MEASUREMENT
/begin MEASUREMENT VehStc_flgBMSTATUS7 "Transition to BMSTATUS 7 Complete flag Last DC final value (1: Completed)" UBYTE B_TRUE 1 100 0.00 1.00000000000 BIT_MASK 0x1 FORMAT "%13.11" ECU_ADDRESS 0x60038D6F /end MEASUREMENT
/begin MEASUREMENT VehStc_flgCalDrkDchaHist "History information for calculating dark current discharge amount (1: Calculated)" UBYTE B_TRUE 1 100 0.00 1.00000000000 BIT_MASK 0x1 FORMAT "%13.11" ECU_ADDRESS 0x6000B589 /end MEASUREMENT
/begin MEASUREMENT VehStc_flgComEna "Communication enable flag" UBYTE B_TRUE 1 100 0.00 1.00000000000 BIT_MASK 0x1 FORMAT "%13.11" ECU_ADDRESS 0x6000B588 /end MEASUREMENT
/begin MEASUREMENT VehStc_flgEnvRamVld "EnvRam valid and battery power no failed flag" UBYTE B_TRUE 1 100 0.00 1.00000000000 BIT_MASK 0x1 FORMAT "%13.11" ECU_ADDRESS 0x6000B587 /end MEASUREMENT
/begin MEASUREMENT VehStc_flgIMonUpdEna "Status active IMON operation" UBYTE B_TRUE 1 100 0.00 1.00000000000 BIT_MASK 0x1 FORMAT "%13.11" ECU_ADDRESS 0x6000B586 /end MEASUREMENT
/begin MEASUREMENT VehStc_flgIniProcnJdg "Initial processing judgment flag after ECU reset" UBYTE B_TRUE 1 100 0.00 1.00000000000 BIT_MASK 0x1 FORMAT "%13.11" ECU_ADDRESS 0x60038D6E /end MEASUREMENT
/begin MEASUREMENT VehStc_flgISRstrt "IS restart flag" UBYTE B_TRUE 1 100 0.00 1.00000000000 BIT_MASK 0x1 FORMAT "%13.11" ECU_ADDRESS 0x6000B585 /end MEASUREMENT
/begin MEASUREMENT VehStc_flgMisfDetd "Flag to indicate misfire to be detected" UBYTE B_TRUE 1 100 0.00 1.00000000000 BIT_MASK 0x1 FORMAT "%13.11" ECU_ADDRESS 0x60000E5F /end MEASUREMENT
/begin MEASUREMENT VehStc_flgMisfDetn "Flag of the misfire detection" UBYTE B_TRUE 1 100 0.00 1.00000000000 BIT_MASK 0x1 FORMAT "%13.11" ECU_ADDRESS 0x60038D3C /end MEASUREMENT
/begin MEASUREMENT VehStc_flgOverWrPrevn3 "Overwritten prevention flag" UBYTE B_TRUE 1 100 0.00 1.00000000000 BIT_MASK 0x1 FORMAT "%13.11" ECU_ADDRESS 0x6000B584 /end MEASUREMENT
/begin MEASUREMENT VehStc_flgOverWrPrevn4 "Ig off duration overwritten prevention flag" UBYTE B_TRUE 1 100 0.00 1.00000000000 BIT_MASK 0x1 FORMAT "%13.11" ECU_ADDRESS 0x6000B583 /end MEASUREMENT
/begin MEASUREMENT VehStc_flgOverWrPrevn5 "Histogram 2 overwritten prevention flag" UBYTE B_TRUE 1 100 0.00 1.00000000000 BIT_MASK 0x1 FORMAT "%13.11" ECU_ADDRESS 0x6000B582 /end MEASUREMENT
/begin MEASUREMENT VehStc_flgPwrSteerRstrtActv "Power steering auto restart is activated" UBYTE B_TRUE 1 100 0.00 1.00000000000 BIT_MASK 0x1 FORMAT "%13.11" ECU_ADDRESS 0x60000E5E /end MEASUREMENT
/begin MEASUREMENT VehStc_flgROthMean "Battery resistance ROthMean for 4 DC flag" UBYTE B_TRUE 1 100 0.00 1.00000000000 BIT_MASK 0x1 FORMAT "%13.11" ECU_ADDRESS 0x6000B581 /end MEASUREMENT
/begin MEASUREMENT VehStc_flgRstrtFromIdleStop "flag indicating auto restart happend from idle stop" UBYTE B_TRUE 1 100 0.00 1.00000000000 BIT_MASK 0x1 FORMAT "%13.11" ECU_ADDRESS 0x6000F65F /end MEASUREMENT
/begin MEASUREMENT VehStc_flgSSEChgOfMind "flag indicating the change of mind happend" UBYTE B_TRUE 1 100 0.00 1.00000000000 BIT_MASK 0x1 FORMAT "%13.11" ECU_ADDRESS 0x60000E60 /end MEASUREMENT
/begin MEASUREMENT VehStc_flgStopInhbCdnChkEna "flag to block the inhibiting condition updating after the auto restart" UBYTE B_TRUE 1 100 0.00 1.00000000000 BIT_MASK 0x1 FORMAT "%13.11" ECU_ADDRESS 0x6000F65E /end MEASUREMENT
/begin MEASUREMENT VehStc_flgStopTrigDly "flag indicating the stop trigger status" UBYTE B_TRUE 1 100 0.00 1.00000000000 BIT_MASK 0x1 FORMAT "%13.11" ECU_ADDRESS 0x6000F65D /end MEASUREMENT
/begin MEASUREMENT VehStc_flgStopTrigDlyFinshd "flag indicating the stop trigger is finished" UBYTE B_TRUE 1 100 0.00 1.00000000000 BIT_MASK 0x1 FORMAT "%13.11" ECU_ADDRESS 0x60000E5D /end MEASUREMENT
/begin MEASUREMENT VehStc_flgSubRcdrBit0 "Sub recorder status bit 0" UBYTE B_TRUE 1 100 0.00 1.00000000000 BIT_MASK 0x1 FORMAT "%13.11" ECU_ADDRESS 0x6000B580 /end MEASUREMENT
/begin MEASUREMENT VehStc_flgSubRcdrBit1 "Sub recorder status bit 1" UBYTE B_TRUE 1 100 0.00 1.00000000000 BIT_MASK 0x1 FORMAT "%13.11" ECU_ADDRESS 0x6000B57F /end MEASUREMENT
/begin MEASUREMENT VehStc_flgSubRcdrBit2 "Sub recorder status bit 2" UBYTE B_TRUE 1 100 0.00 1.00000000000 BIT_MASK 0x1 FORMAT "%13.11" ECU_ADDRESS 0x6000B57E /end MEASUREMENT
/begin MEASUREMENT VehStc_flgUnstyDrkCurrActvnPerms "History information of Unsteady dark current device activation permission flag (1:Permitted)" UBYTE B_TRUE 1 100 0.00 1.00000000000 BIT_MASK 0x1 FORMAT "%13.11" ECU_ADDRESS 0x60038D6D /end MEASUREMENT
/begin MEASUREMENT VehStc_flgUnstyDrkIHistOvf "Unsteady Dark Current Control History Information Overflow Flag" UBYTE B_TRUE 1 100 0.00 1.00000000000 BIT_MASK 0x1 FORMAT "%13.11" ECU_ADDRESS 0x6000B57D /end MEASUREMENT
/begin MEASUREMENT VehStc_flgUserRstrtActv "flag indicating the auto restart is activated by user" UBYTE B_TRUE 1 100 0.00 1.00000000000 BIT_MASK 0x1 FORMAT "%13.11" ECU_ADDRESS 0x60000E5C /end MEASUREMENT
/begin MEASUREMENT VehStc_flgWrRamFaild1 "EEP write ram failed flag 1" UBYTE B_TRUE 1 100 0.00 1.00000000000 BIT_MASK 0x1 FORMAT "%13.11" ECU_ADDRESS 0x6000B57C /end MEASUREMENT
/begin MEASUREMENT VehStc_flgWrRamFaild10 "EEP write ram failed flag 10" UBYTE B_TRUE 1 100 0.00 1.00000000000 BIT_MASK 0x1 FORMAT "%13.11" ECU_ADDRESS 0x6000B57B /end MEASUREMENT
/begin MEASUREMENT VehStc_flgWrRamFaild11 "EEP write ram failed flag 11" UBYTE B_TRUE 1 100 0.00 1.00000000000 BIT_MASK 0x1 FORMAT "%13.11" ECU_ADDRESS 0x6000B57A /end MEASUREMENT
/begin MEASUREMENT VehStc_flgWrRamFaild12 "EEP write ram failed flag 12" UBYTE B_TRUE 1 100 0.00 1.00000000000 BIT_MASK 0x1 FORMAT "%13.11" ECU_ADDRESS 0x6000B579 /end MEASUREMENT
/begin MEASUREMENT VehStc_flgWrRamFaild13 "EEP write ram failed flag 13" UBYTE B_TRUE 1 100 0.00 1.00000000000 BIT_MASK 0x1 FORMAT "%13.11" ECU_ADDRESS 0x6000B578 /end MEASUREMENT
/begin MEASUREMENT VehStc_flgWrRamFaild14 "EEP write ram failed flag 14" UBYTE B_TRUE 1 100 0.00 1.00000000000 BIT_MASK 0x1 FORMAT "%13.11" ECU_ADDRESS 0x6000B577 /end MEASUREMENT
/begin MEASUREMENT VehStc_flgWrRamFaild15 "EEP write ram failed flag 15" UBYTE B_TRUE 1 100 0.00 1.00000000000 BIT_MASK 0x1 FORMAT "%13.11" ECU_ADDRESS 0x6000B576 /end MEASUREMENT
/begin MEASUREMENT VehStc_flgWrRamFaild16 "EEP write ram failed flag 16" UBYTE B_TRUE 1 100 0.00 1.00000000000 BIT_MASK 0x1 FORMAT "%13.11" ECU_ADDRESS 0x6000B575 /end MEASUREMENT
/begin MEASUREMENT VehStc_flgWrRamFaild17 "EEP write ram failed flag 17" UBYTE B_TRUE 1 100 0.00 1.00000000000 BIT_MASK 0x1 FORMAT "%13.11" ECU_ADDRESS 0x6000B574 /end MEASUREMENT
/begin MEASUREMENT VehStc_flgWrRamFaild18 "EEP write ram failed flag 18" UBYTE B_TRUE 1 100 0.00 1.00000000000 BIT_MASK 0x1 FORMAT "%13.11" ECU_ADDRESS 0x6000B573 /end MEASUREMENT
/begin MEASUREMENT VehStc_flgWrRamFaild19 "EEP write ram failed flag 19" UBYTE B_TRUE 1 100 0.00 1.00000000000 BIT_MASK 0x1 FORMAT "%13.11" ECU_ADDRESS 0x6000B572 /end MEASUREMENT
/begin MEASUREMENT VehStc_flgWrRamFaild2 "EEP write ram failed flag 2" UBYTE B_TRUE 1 100 0.00 1.00000000000 BIT_MASK 0x1 FORMAT "%13.11" ECU_ADDRESS 0x6000B571 /end MEASUREMENT
/begin MEASUREMENT VehStc_flgWrRamFaild20 "EEP write ram failed flag 20" UBYTE B_TRUE 1 100 0.00 1.00000000000 BIT_MASK 0x1 FORMAT "%13.11" ECU_ADDRESS 0x6000B570 /end MEASUREMENT
/begin MEASUREMENT VehStc_flgWrRamFaild21 "EEP write ram failed flag 21" UBYTE B_TRUE 1 100 0.00 1.00000000000 BIT_MASK 0x1 FORMAT "%13.11" ECU_ADDRESS 0x6000B56F /end MEASUREMENT
/begin MEASUREMENT VehStc_flgWrRamFaild22 "EEP write ram failed flag 22" UBYTE B_TRUE 1 100 0.00 1.00000000000 BIT_MASK 0x1 FORMAT "%13.11" ECU_ADDRESS 0x6000B56E /end MEASUREMENT
/begin MEASUREMENT VehStc_flgWrRamFaild23 "EEP write ram failed flag 23" UBYTE B_TRUE 1 100 0.00 1.00000000000 BIT_MASK 0x1 FORMAT "%13.11" ECU_ADDRESS 0x6000B56D /end MEASUREMENT
/begin MEASUREMENT VehStc_flgWrRamFaild24 "EEP write ram failed flag 24" UBYTE B_TRUE 1 100 0.00 1.00000000000 BIT_MASK 0x1 FORMAT "%13.11" ECU_ADDRESS 0x6000B56C /end MEASUREMENT
/begin MEASUREMENT VehStc_flgWrRamFaild25 "EEP write ram failed flag 25" UBYTE B_TRUE 1 100 0.00 1.00000000000 BIT_MASK 0x1 FORMAT "%13.11" ECU_ADDRESS 0x6000B56B /end MEASUREMENT
/begin MEASUREMENT VehStc_flgWrRamFaild26 "EEP write ram failed flag 26" UBYTE B_TRUE 1 100 0.00 1.00000000000 BIT_MASK 0x1 FORMAT "%13.11" ECU_ADDRESS 0x6000B56A /end MEASUREMENT
/begin MEASUREMENT VehStc_flgWrRamFaild27 "EEP write ram failed flag 27" UBYTE B_TRUE 1 100 0.00 1.00000000000 BIT_MASK 0x1 FORMAT "%13.11" ECU_ADDRESS 0x6000B569 /end MEASUREMENT
/begin MEASUREMENT VehStc_flgWrRamFaild28 "EEP write ram failed flag 28" UBYTE B_TRUE 1 100 0.00 1.00000000000 BIT_MASK 0x1 FORMAT "%13.11" ECU_ADDRESS 0x6000B568 /end MEASUREMENT
/begin MEASUREMENT VehStc_flgWrRamFaild29 "EEP write ram failed flag 29" UBYTE B_TRUE 1 100 0.00 1.00000000000 BIT_MASK 0x1 FORMAT "%13.11" ECU_ADDRESS 0x6000B567 /end MEASUREMENT
/begin MEASUREMENT VehStc_flgWrRamFaild3 "EEP write ram failed flag 3" UBYTE B_TRUE 1 100 0.00 1.00000000000 BIT_MASK 0x1 FORMAT "%13.11" ECU_ADDRESS 0x6000B566 /end MEASUREMENT
/begin MEASUREMENT VehStc_flgWrRamFaild4 "EEP write ram failed flag 4" UBYTE B_TRUE 1 100 0.00 1.00000000000 BIT_MASK 0x1 FORMAT "%13.11" ECU_ADDRESS 0x6000B565 /end MEASUREMENT
/begin MEASUREMENT VehStc_flgWrRamFaild5 "EEP write ram failed flag 5" UBYTE B_TRUE 1 100 0.00 1.00000000000 BIT_MASK 0x1 FORMAT "%13.11" ECU_ADDRESS 0x6000B564 /end MEASUREMENT
/begin MEASUREMENT VehStc_flgWrRamFaild6 "EEP write ram failed flag 6" UBYTE B_TRUE 1 100 0.00 1.00000000000 BIT_MASK 0x1 FORMAT "%13.11" ECU_ADDRESS 0x6000B563 /end MEASUREMENT
/begin MEASUREMENT VehStc_flgWrRamFaild7 "EEP write ram failed flag 7" UBYTE B_TRUE 1 100 0.00 1.00000000000 BIT_MASK 0x1 FORMAT "%13.11" ECU_ADDRESS 0x6000B562 /end MEASUREMENT
/begin MEASUREMENT VehStc_iBattMinDurgIS "Battery maximum discharge current during IS" SWORD Curr_A 1 100 -163.8400 163.8300 FORMAT "%8.4" ECU_ADDRESS 0x60008FC8 /end MEASUREMENT
/begin MEASUREMENT VehStc_idxCalcnAry "Calculation index for array" UBYTE OneToOne 1 100 0.00 255.0 FORMAT "%5.1" ECU_ADDRESS 0x60000E5B /end MEASUREMENT
/begin MEASUREMENT VehStc_idxDiagRsltB1A "Index for catalyst monitor array" UBYTE OneToOne 1 100 0.00 255.0 FORMAT "%5.1" ECU_ADDRESS 0x60000E5A /end MEASUREMENT
/begin MEASUREMENT VehStc_idxRDcycOld "Previous value of internal index for driving cycle buffer" UBYTE OneToOne 1 100 0.00 255.0 FORMAT "%5.1" ECU_ADDRESS 0x60038D6C /end MEASUREMENT
/begin MEASUREMENT VehStc_iUBattMinDurgIS "Current when Battery minimum voltage during IS" SWORD Curr_A 1 100 -163.8400 163.8300 FORMAT "%8.4" ECU_ADDRESS 0x60008FC6 /end MEASUREMENT
/begin MEASUREMENT VehStc_lDeltaDst "Delta distance travelled in a Driving cycle" UWORD Length 1 100 0.00 65535.00 FORMAT "%8.2" ECU_ADDRESS 0x60000E58 /end MEASUREMENT
/begin MEASUREMENT VehStc_lDstCity "Delta distance travelled in a Driving cycle of city zone" ULONG Length 1 100 0.00 4294967295.00 FORMAT "%13.2" ECU_ADDRESS 0x60038D38 /end MEASUREMENT
/begin MEASUREMENT VehStc_lDstCityEco "Delta distance travelled in a Driving cycle of city zone during Economy mode ON" ULONG Length 1 100 0.00 4294967295.00 FORMAT "%13.2" ECU_ADDRESS 0x60038D34 /end MEASUREMENT
/begin MEASUREMENT VehStc_lDstHighWay "Delta distance travelled in a Driving cycle of highway zone" ULONG Length 1 100 0.00 4294967295.00 FORMAT "%13.2" ECU_ADDRESS 0x60038D30 /end MEASUREMENT
/begin MEASUREMENT VehStc_lDstHighWayEco "Delta distance travelled in a Driving cycle of Highway zone during ECO mode ON" ULONG Length 1 100 0.00 4294967295.00 FORMAT "%13.2" ECU_ADDRESS 0x60038D2C /end MEASUREMENT
/begin MEASUREMENT VehStc_lDstold "Delta distance travelled in a previous Driving Cycle" SLONG Length 1 100 -2147483648.00 2147483647.00 FORMAT "%13.2" ECU_ADDRESS 0x60000E54 /end MEASUREMENT
/begin MEASUREMENT VehStc_NrOfMisfOldA "array for number of misfire per cylinder Old Value" UWORD dez 1 100 0.00 65535.00 FORMAT "%8.2" ARRAY_SIZE 4 ECU_ADDRESS 0x60006CD8 /end MEASUREMENT
/begin MEASUREMENT VehStc_numFuDiagRecA "Fuel system diagnos average is recording parameter" UWORD fak_uw_b2 1 100 0.00 1.999969 FORMAT "%8.6" ARRAY_SIZE 21 ECU_ADDRESS 0x60008DAE /end MEASUREMENT
/begin MEASUREMENT VehStc_numMisfDetnHiEct0 "Misfire diagnos is recording parameter - High ECT_0" ULONG OneToOne 1 100 0.00 4294967295.00 FORMAT "%13.2" ECU_ADDRESS 0x60038D28 /end MEASUREMENT
/begin MEASUREMENT VehStc_numMisfDetnHiEct1 "Misfire diagnos is recording parameter - High ECT_1" ULONG OneToOne 1 100 0.00 4294967295.00 FORMAT "%13.2" ECU_ADDRESS 0x60038D24 /end MEASUREMENT
/begin MEASUREMENT VehStc_numMisfDetnHiEct10 "Misfire diagnos is recording parameter - High ECT_10" ULONG OneToOne 1 100 0.00 4294967295.00 FORMAT "%13.2" ECU_ADDRESS 0x60038D20 /end MEASUREMENT
/begin MEASUREMENT VehStc_numMisfDetnHiEct11 "Misfire diagnos is recording parameter - High ECT_11" ULONG OneToOne 1 100 0.00 4294967295.00 FORMAT "%13.2" ECU_ADDRESS 0x60038D1C /end MEASUREMENT
/begin MEASUREMENT VehStc_numMisfDetnHiEct12 "Misfire diagnos is recording parameter - High ECT_12" ULONG OneToOne 1 100 0.00 4294967295.00 FORMAT "%13.2" ECU_ADDRESS 0x60038D18 /end MEASUREMENT
/begin MEASUREMENT VehStc_numMisfDetnHiEct13 "Misfire diagnos is recording parameter - High ECT_13" ULONG OneToOne 1 100 0.00 4294967295.00 FORMAT "%13.2" ECU_ADDRESS 0x60038D14 /end MEASUREMENT
/begin MEASUREMENT VehStc_numMisfDetnHiEct14 "Misfire diagnos is recording parameter - High ECT_14" ULONG OneToOne 1 100 0.00 4294967295.00 FORMAT "%13.2" ECU_ADDRESS 0x60038D10 /end MEASUREMENT
/begin MEASUREMENT VehStc_numMisfDetnHiEct15 "Misfire diagnos is recording parameter - High ECT_15" ULONG OneToOne 1 100 0.00 4294967295.00 FORMAT "%13.2" ECU_ADDRESS 0x60038D0C /end MEASUREMENT
/begin MEASUREMENT VehStc_numMisfDetnHiEct16 "Misfire diagnos is recording parameter - High ECT_16" ULONG OneToOne 1 100 0.00 4294967295.00 FORMAT "%13.2" ECU_ADDRESS 0x60038D08 /end MEASUREMENT
/begin MEASUREMENT VehStc_numMisfDetnHiEct17 "Misfire diagnos is recording parameter - High ECT_17" ULONG OneToOne 1 100 0.00 4294967295.00 FORMAT "%13.2" ECU_ADDRESS 0x60038D04 /end MEASUREMENT
/begin MEASUREMENT VehStc_numMisfDetnHiEct18 "Misfire diagnos is recording parameter - High ECT_18" ULONG OneToOne 1 100 0.00 4294967295.00 FORMAT "%13.2" ECU_ADDRESS 0x60038D00 /end MEASUREMENT
/begin MEASUREMENT VehStc_numMisfDetnHiEct19 "Misfire diagnos is recording parameter - High ECT_19" ULONG OneToOne 1 100 0.00 4294967295.00 FORMAT "%13.2" ECU_ADDRESS 0x60038CFC /end MEASUREMENT
/begin MEASUREMENT VehStc_numMisfDetnHiEct2 "Misfire diagnos is recording parameter - High ECT_2" ULONG OneToOne 1 100 0.00 4294967295.00 FORMAT "%13.2" ECU_ADDRESS 0x60038CF8 /end MEASUREMENT
/begin MEASUREMENT VehStc_numMisfDetnHiEct20 "Misfire diagnos is recording parameter - High ECT_20" ULONG OneToOne 1 100 0.00 4294967295.00 FORMAT "%13.2" ECU_ADDRESS 0x60038CF4 /end MEASUREMENT
/begin MEASUREMENT VehStc_numMisfDetnHiEct3 "Misfire diagnos is recording parameter - High ECT_3" ULONG OneToOne 1 100 0.00 4294967295.00 FORMAT "%13.2" ECU_ADDRESS 0x60038CF0 /end MEASUREMENT
/begin MEASUREMENT VehStc_numMisfDetnHiEct4 "Misfire diagnos is recording parameter - High ECT_4" ULONG OneToOne 1 100 0.00 4294967295.00 FORMAT "%13.2" ECU_ADDRESS 0x60038CEC /end MEASUREMENT
/begin MEASUREMENT VehStc_numMisfDetnHiEct5 "Misfire diagnos is recording parameter - High ECT_5" ULONG OneToOne 1 100 0.00 4294967295.00 FORMAT "%13.2" ECU_ADDRESS 0x60038CE8 /end MEASUREMENT
/begin MEASUREMENT VehStc_numMisfDetnHiEct6 "Misfire diagnos is recording parameter - High ECT_6" ULONG OneToOne 1 100 0.00 4294967295.00 FORMAT "%13.2" ECU_ADDRESS 0x60038CE4 /end MEASUREMENT
/begin MEASUREMENT VehStc_numMisfDetnHiEct7 "Misfire diagnos is recording parameter - High ECT_7" ULONG OneToOne 1 100 0.00 4294967295.00 FORMAT "%13.2" ECU_ADDRESS 0x60038CE0 /end MEASUREMENT
/begin MEASUREMENT VehStc_numMisfDetnHiEct8 "Misfire diagnos is recording parameter - High ECT_8" ULONG OneToOne 1 100 0.00 4294967295.00 FORMAT "%13.2" ECU_ADDRESS 0x60038CDC /end MEASUREMENT
/begin MEASUREMENT VehStc_numMisfDetnHiEct9 "Misfire diagnos is recording parameter - High ECT_9" ULONG OneToOne 1 100 0.00 4294967295.00 FORMAT "%13.2" ECU_ADDRESS 0x60038CD8 /end MEASUREMENT
/begin MEASUREMENT VehStc_numMisfDetnHiEctA "Misfire diagnos is recording parameter - High ECT_Array" ULONG OneToOne 1 100 0.00 4294967295.00 FORMAT "%13.2" ARRAY_SIZE 21 ECU_ADDRESS 0x6000372C /end MEASUREMENT
/begin MEASUREMENT VehStc_numMisfDetnLo0 "Misfire diagnos is recording parameter- Low ECT_0" ULONG OneToOne 1 100 0.00 4294967295.00 FORMAT "%13.2" ECU_ADDRESS 0x60038CD4 /end MEASUREMENT
/begin MEASUREMENT VehStc_numMisfDetnLo1 "Misfire diagnos is recording parameter- Low ECT_1" ULONG OneToOne 1 100 0.00 4294967295.00 FORMAT "%13.2" ECU_ADDRESS 0x60038CD0 /end MEASUREMENT
/begin MEASUREMENT VehStc_numMisfDetnLo10 "Misfire diagnos is recording parameter- Low ECT_10" ULONG OneToOne 1 100 0.00 4294967295.00 FORMAT "%13.2" ECU_ADDRESS 0x60038CCC /end MEASUREMENT
/begin MEASUREMENT VehStc_numMisfDetnLo11 "Misfire diagnos is recording parameter- Low ECT_11" ULONG OneToOne 1 100 0.00 4294967295.00 FORMAT "%13.2" ECU_ADDRESS 0x60038CC8 /end MEASUREMENT
/begin MEASUREMENT VehStc_numMisfDetnLo12 "Misfire diagnos is recording parameter- Low ECT_12" ULONG OneToOne 1 100 0.00 4294967295.00 FORMAT "%13.2" ECU_ADDRESS 0x60038CC4 /end MEASUREMENT
/begin MEASUREMENT VehStc_numMisfDetnLo13 "Misfire diagnos is recording parameter- Low ECT_13" ULONG OneToOne 1 100 0.00 4294967295.00 FORMAT "%13.2" ECU_ADDRESS 0x60038CC0 /end MEASUREMENT
/begin MEASUREMENT VehStc_numMisfDetnLo14 "Misfire diagnos is recording parameter- Low ECT_14" ULONG OneToOne 1 100 0.00 4294967295.00 FORMAT "%13.2" ECU_ADDRESS 0x60038CBC /end MEASUREMENT
/begin MEASUREMENT VehStc_numMisfDetnLo15 "Misfire diagnos is recording parameter- Low ECT_15" ULONG OneToOne 1 100 0.00 4294967295.00 FORMAT "%13.2" ECU_ADDRESS 0x60038CB8 /end MEASUREMENT
/begin MEASUREMENT VehStc_numMisfDetnLo16 "Misfire diagnos is recording parameter- Low ECT_16" ULONG OneToOne 1 100 0.00 4294967295.00 FORMAT "%13.2" ECU_ADDRESS 0x60038CB4 /end MEASUREMENT
/begin MEASUREMENT VehStc_numMisfDetnLo17 "Misfire diagnos is recording parameter- Low ECT_17" ULONG OneToOne 1 100 0.00 4294967295.00 FORMAT "%13.2" ECU_ADDRESS 0x60038CB0 /end MEASUREMENT
/begin MEASUREMENT VehStc_numMisfDetnLo18 "Misfire diagnos is recording parameter- Low ECT_18" ULONG OneToOne 1 100 0.00 4294967295.00 FORMAT "%13.2" ECU_ADDRESS 0x60038CAC /end MEASUREMENT
/begin MEASUREMENT VehStc_numMisfDetnLo19 "Misfire diagnos is recording parameter- Low ECT_19" ULONG OneToOne 1 100 0.00 4294967295.00 FORMAT "%13.2" ECU_ADDRESS 0x60038CA8 /end MEASUREMENT
/begin MEASUREMENT VehStc_numMisfDetnLo2 "Misfire diagnos is recording parameter- Low ECT_2" ULONG OneToOne 1 100 0.00 4294967295.00 FORMAT "%13.2" ECU_ADDRESS 0x60038CA4 /end MEASUREMENT
/begin MEASUREMENT VehStc_numMisfDetnLo20 "Misfire diagnos is recording parameter- Low ECT_20" ULONG OneToOne 1 100 0.00 4294967295.00 FORMAT "%13.2" ECU_ADDRESS 0x60038CA0 /end MEASUREMENT
/begin MEASUREMENT VehStc_numMisfDetnLo3 "Misfire diagnos is recording parameter- Low ECT_3" ULONG OneToOne 1 100 0.00 4294967295.00 FORMAT "%13.2" ECU_ADDRESS 0x60038C9C /end MEASUREMENT
/begin MEASUREMENT VehStc_numMisfDetnLo4 "Misfire diagnos is recording parameter- Low ECT_4" ULONG OneToOne 1 100 0.00 4294967295.00 FORMAT "%13.2" ECU_ADDRESS 0x60038C98 /end MEASUREMENT
/begin MEASUREMENT VehStc_numMisfDetnLo5 "Misfire diagnos is recording parameter- Low ECT_5" ULONG OneToOne 1 100 0.00 4294967295.00 FORMAT "%13.2" ECU_ADDRESS 0x60038C94 /end MEASUREMENT
/begin MEASUREMENT VehStc_numMisfDetnLo6 "Misfire diagnos is recording parameter- Low ECT_6" ULONG OneToOne 1 100 0.00 4294967295.00 FORMAT "%13.2" ECU_ADDRESS 0x60038C90 /end MEASUREMENT
/begin MEASUREMENT VehStc_numMisfDetnLo7 "Misfire diagnos is recording parameter- Low ECT_7" ULONG OneToOne 1 100 0.00 4294967295.00 FORMAT "%13.2" ECU_ADDRESS 0x60038C8C /end MEASUREMENT
/begin MEASUREMENT VehStc_numMisfDetnLo8 "Misfire diagnos is recording parameter- Low ECT_8" ULONG OneToOne 1 100 0.00 4294967295.00 FORMAT "%13.2" ECU_ADDRESS 0x60038C88 /end MEASUREMENT
/begin MEASUREMENT VehStc_numMisfDetnLo9 "Misfire diagnos is recording parameter- Low ECT_9" ULONG OneToOne 1 100 0.00 4294967295.00 FORMAT "%13.2" ECU_ADDRESS 0x60038C84 /end MEASUREMENT
/begin MEASUREMENT VehStc_numMisfDetnLoEctA "Misfire diagnos is recording parameter- Low ECT_Array" ULONG OneToOne 1 100 0.00 4294967295.00 FORMAT "%13.2" ARRAY_SIZE 21 ECU_ADDRESS 0x600036D8 /end MEASUREMENT
/begin MEASUREMENT VehStc_numMisfDetnNormA "Misfire diagnos is recording parameter" ULONG OneToOne 1 100 0.00 4294967295.00 FORMAT "%13.2" ARRAY_SIZE 21 ECU_ADDRESS 0x60003684 /end MEASUREMENT
/begin MEASUREMENT VehStc_pIntkMnfld "Intake manifold pressure (mmHg)" ULONG p_uw_q0p039_mmHg 1 100 0.00 125839807.057 FORMAT "%13.3" ECU_ADDRESS 0x60000E50 /end MEASUREMENT
/begin MEASUREMENT VehStc_qBattChrg "Total amount of 12V battery charging" ULONG q0p1_A_h 1 100 0.00 65535.9000000 FORMAT "%13.7" ECU_ADDRESS 0x60003680 /end MEASUREMENT
/begin MEASUREMENT VehStc_qBattChrgSub "Total amount of 12V battery charging sub" ULONG RBPtCel_q_9p7656em4_1 1 100 0.00 4194303.99902 FORMAT "%13.5" ECU_ADDRESS 0x60038D68 /end MEASUREMENT
/begin MEASUREMENT VehStc_qBattDcha "Total amount of 12V battery discharging" ULONG q0p1_A_h 1 100 0.00 65535.9000000 FORMAT "%13.7" ECU_ADDRESS 0x6000367C /end MEASUREMENT
/begin MEASUREMENT VehStc_qBattDchaSub "Total amount of 12V battery discharging sub" ULONG RBPtCel_q_9p7656em4_1 1 100 0.00 4194303.99902 FORMAT "%13.5" ECU_ADDRESS 0x60038D64 /end MEASUREMENT
/begin MEASUREMENT VehStc_qBattEBSTmp "Total amount of 12V battery temp" SLONG RBPtCel_q_9p7656em4_1 1 100 -2097152.00000 2097151.99902 FORMAT "%13.5" ECU_ADDRESS 0x60001E20 /end MEASUREMENT
/begin MEASUREMENT VehStc_ratDChaAmntPerDay "Discharge amount per 1 day" SWORD RBPtCel_Perc_0p01_1 1 100 -163.8400 163.8300 FORMAT "%8.4" ECU_ADDRESS 0x60006D48 /end MEASUREMENT
/begin MEASUREMENT VehStc_ratDchaSOC "Discharge SOC ratio" SWORD RBPtCel_Perc_0p01_1 1 100 -327.6800 327.6700 FORMAT "%8.4" ECU_ADDRESS 0x60006D46 /end MEASUREMENT
/begin MEASUREMENT VehStc_ratIBSUMH "Value of IBSUMH converted to percentage" SWORD RBPtCel_Perc_0p01_1 1 100 -163.8400 163.8300 FORMAT "%8.4" ECU_ADDRESS 0x60038D60 /end MEASUREMENT
/begin MEASUREMENT VehStc_ratIBSUML "Value of IBSUML converted to percentage" SWORD RBPtCel_Perc_0p01_1 1 100 -163.8400 163.8300 FORMAT "%8.4" ECU_ADDRESS 0x60038D5E /end MEASUREMENT
/begin MEASUREMENT VehStc_ratSOCIgnOffLstDcyc "SOC of last DC end" UBYTE RBPtCel_Perc_0p5_1 1 100 0.00 127.5 FORMAT "%5.1" ECU_ADDRESS 0x6000F758 /end MEASUREMENT
/begin MEASUREMENT VehStc_ratSOCIgnOffLstDcycTmp "SOC of last DC end temp" UBYTE RBPtCel_Perc_0p5_1 1 100 0.00 127.5 FORMAT "%5.1" ECU_ADDRESS 0x60038D5C /end MEASUREMENT
/begin MEASUREMENT VehStc_ratSOCIgnOnCurrDcyc "SOC of this DC" UBYTE RBPtCel_Perc_0p5_1 1 100 0.00 127.5 FORMAT "%5.1" ECU_ADDRESS 0x6000F757 /end MEASUREMENT
/begin MEASUREMENT VehStc_ratSOCIgnOnLstDcyc "SOC of last DC" UBYTE RBPtCel_Perc_0p5_1 1 100 0.00 127.5 FORMAT "%5.1" ECU_ADDRESS 0x6000F756 /end MEASUREMENT
/begin MEASUREMENT VehStc_ratSOCIgnOnLstDcycTmp "SOC of last DC temp" UBYTE RBPtCel_Perc_0p5_1 1 100 0.00 127.5 FORMAT "%5.1" ECU_ADDRESS 0x60038D5B /end MEASUREMENT
/begin MEASUREMENT VehStc_rDiagRsltB10 "Result catalyst diagnosis _ first element" UWORD fak_uw_b16 1 100 0.00 15.99976 FORMAT "%8.5" ECU_ADDRESS 0x60038C80 /end MEASUREMENT
/begin MEASUREMENT VehStc_rDiagRsltB11 "Result catalyst diagnosis _ second element" UWORD fak_uw_b16 1 100 0.00 15.99976 FORMAT "%8.5" ECU_ADDRESS 0x60038C7E /end MEASUREMENT
/begin MEASUREMENT VehStc_rDiagRsltB12 "Result catalyst diagnosis _ third element" UWORD fak_uw_b16 1 100 0.00 15.99976 FORMAT "%8.5" ECU_ADDRESS 0x60038C7C /end MEASUREMENT
/begin MEASUREMENT VehStc_rDiagRsltB13 "Result catalyst diagnosis _ fourth element" UWORD fak_uw_b16 1 100 0.00 15.99976 FORMAT "%8.5" ECU_ADDRESS 0x60038C7A /end MEASUREMENT
/begin MEASUREMENT VehStc_rDiagRsltB14 "Result catalyst diagnosis _ fifth element" UWORD fak_uw_b16 1 100 0.00 15.99976 FORMAT "%8.5" ECU_ADDRESS 0x60038C78 /end MEASUREMENT
/begin MEASUREMENT VehStc_rDiagRsltB1A "The latest 5 times of catalyst monitor test result" UWORD fak_uw_b16 1 100 0.00 15.99976 FORMAT "%8.5" ARRAY_SIZE 5 ECU_ADDRESS 0x60006CCE /end MEASUREMENT
/begin MEASUREMENT VehStc_resBattROthMean "Temperature compensate average during DC" UWORD Resist_mOhm_q0p01 1 100 0.00 655.3500 FORMAT "%8.4" ECU_ADDRESS 0x60006D44 /end MEASUREMENT
/begin MEASUREMENT VehStc_resBattROthMean4Dcyc "Temperature compensate average for 4 DC" UWORD Resist_mOhm_q0p01 1 100 0.00 327.6700 FORMAT "%8.4" ECU_ADDRESS 0x60008DAC /end MEASUREMENT
/begin MEASUREMENT VehStc_resBattROthMean4DcycHistAry "Array to store temperature compensate average for 4 DC history depending on In use duration" UBYTE q0p1_mOhm 1 100 0.00 25.50 FORMAT "%5.2" ARRAY_SIZE 10 ECU_ADDRESS 0x6000B4EB /end MEASUREMENT
/begin MEASUREMENT VehStc_resBattROthMeanAry "Array of Batt resistance ROthMean for 4 DC" UWORD Resist_mOhm_q0p01 1 100 0.00 655.3500 FORMAT "%8.4" ARRAY_SIZE 4 ECU_ADDRESS 0x60006D3C /end MEASUREMENT
/begin MEASUREMENT VehStc_resBattROthSum "Sum of multi internal resistance with factor" ULONG Resist_mOhm_q0p01 1 100 0.00 42949672.9500 FORMAT "%13.4" ECU_ADDRESS 0x60001E1C /end MEASUREMENT
/begin MEASUREMENT VehStc_resEBSMeasdBattROthOld "Previous value of internal resistance" SLONG Resist_mOhm_q0p01 1 100 -21474836.4800 21474836.4700 FORMAT "%13.4" ECU_ADDRESS 0x60001E18 /end MEASUREMENT
/begin MEASUREMENT VehStc_restBattROthTmp "Multi of internal resistance with factor" UWORD Resist_mOhm_q0p01 1 100 0.00 655.3500 FORMAT "%8.4" ECU_ADDRESS 0x60006D3A /end MEASUREMENT
/begin MEASUREMENT VehStc_rMeanHistAry "Internal resistance mean over 4DC history depending on In use duration" UBYTE q0p1_mOhm 1 100 0.00 25.50 FORMAT "%5.2" ARRAY_SIZE 10 ECU_ADDRESS 0x6000B4E1 /end MEASUREMENT
/begin MEASUREMENT VehStc_stbasalCdn "flag indicating the basal condition status" UBYTE B_TRUE 1 100 0.00 1.00000000000 BIT_MASK 0x1 FORMAT "%13.11" ECU_ADDRESS 0x60000E4F /end MEASUREMENT
/begin MEASUREMENT VehStc_stBattCalcOld "Previous status of battery calculation" UBYTE OneToOne 1 100 0.00 255.0 FORMAT "%5.1" ECU_ADDRESS 0x6000B561 /end MEASUREMENT
/begin MEASUREMENT VehStc_stCmprnCalc "Histogram compression calculation status" UWORD OneToOne 1 100 0.00 65535.00 FORMAT "%8.2" ECU_ADDRESS 0x60006D38 /end MEASUREMENT
/begin MEASUREMENT VehStc_stEEP "EEP written status" UBYTE OneToOne 1 100 0.00 255.0 FORMAT "%5.1" ECU_ADDRESS 0x6000B560 /end MEASUREMENT
/begin MEASUREMENT VehStc_stEngManStrtd "status indicating engine manually started" UBYTE B_TRUE 1 100 0.00 1.00000000000 BIT_MASK 0x1 FORMAT "%13.11" ECU_ADDRESS 0x60000E4E /end MEASUREMENT
/begin MEASUREMENT VehStc_stEngSpdLo "Engine speed status low" UBYTE B_TRUE 1 100 0.00 1.00000000000 BIT_MASK 0x1 FORMAT "%13.11" ECU_ADDRESS 0x60000E4D /end MEASUREMENT
/begin MEASUREMENT VehStc_stEngSpdLowr "Engine speed status lower 1000rpm" UBYTE B_TRUE 1 100 0.00 1.00000000000 BIT_MASK 0x1 FORMAT "%13.11" ECU_ADDRESS 0x60000E4C /end MEASUREMENT
/begin MEASUREMENT VehStc_stEngSpdMed "Engine speed status medium" UBYTE B_TRUE 1 100 0.00 1.00000000000 BIT_MASK 0x1 FORMAT "%13.11" ECU_ADDRESS 0x60000E4B /end MEASUREMENT
/begin MEASUREMENT VehStc_stEngSpdSHi "Engine speed status high" UBYTE B_TRUE 1 100 0.00 1.00000000000 BIT_MASK 0x1 FORMAT "%13.11" ECU_ADDRESS 0x60000E4A /end MEASUREMENT
/begin MEASUREMENT VehStc_stEngSpdTop "Engine speed status top" UBYTE B_TRUE 1 100 0.00 1.00000000000 BIT_MASK 0x1 FORMAT "%13.11" ECU_ADDRESS 0x60000E49 /end MEASUREMENT
/begin MEASUREMENT VehStc_stEntryCdn "entry condition indicating status ISS fault" UBYTE B_TRUE 1 100 0.00 1.00000000000 BIT_MASK 0x1 FORMAT "%13.11" ECU_ADDRESS 0x60000E48 /end MEASUREMENT
/begin MEASUREMENT VehStc_stHoodOpenFirstEngStrt "History information of Bonnet open at first ENG start (1: open)" UBYTE OneToOne 1 100 0.00 255.0 FORMAT "%5.1" ECU_ADDRESS 0x60038D5A /end MEASUREMENT
/begin MEASUREMENT VehStc_stIntkPHi "Intake manifold pressure high" UBYTE B_TRUE 1 100 0.00 1.00000000000 BIT_MASK 0x1 FORMAT "%13.11" ECU_ADDRESS 0x60000E47 /end MEASUREMENT
/begin MEASUREMENT VehStc_stIntkPLo "Intake manifold pressure low" UBYTE B_TRUE 1 100 0.00 1.00000000000 BIT_MASK 0x1 FORMAT "%13.11" ECU_ADDRESS 0x60000E46 /end MEASUREMENT
/begin MEASUREMENT VehStc_stIntkPMed "Intake manifold pressure medium" UBYTE B_TRUE 1 100 0.00 1.00000000000 BIT_MASK 0x1 FORMAT "%13.11" ECU_ADDRESS 0x60000E45 /end MEASUREMENT
/begin MEASUREMENT VehStc_stIntkPTop "Intake manifold pressure top" UBYTE B_TRUE 1 100 0.00 1.00000000000 BIT_MASK 0x1 FORMAT "%13.11" ECU_ADDRESS 0x60000E44 /end MEASUREMENT
/begin MEASUREMENT VehStc_stISSOff "Status indicates reasons caused the Idle Stop off" UWORD OneToOne 1 100 0.00 65535.00 FORMAT "%8.2" ECU_ADDRESS 0x60000E42 /end MEASUREMENT
/begin MEASUREMENT VehStc_stOverWrPrevn1 "Resistance mean history overwritten prevention" UBYTE OneToOne 1 100 0.00 255.0 FORMAT "%5.1" ECU_ADDRESS 0x6000B55F /end MEASUREMENT
/begin MEASUREMENT VehStc_stOverWrPrevn2 "Temp compensation mean history overwritten prevention" UBYTE OneToOne 1 100 0.00 255.0 FORMAT "%5.1" ECU_ADDRESS 0x6000B55E /end MEASUREMENT
/begin MEASUREMENT VehStc_stRetEep "Return EEP status" UBYTE OneToOne 1 100 0.00 255.0 FORMAT "%5.1" ECU_ADDRESS 0x6000B55D /end MEASUREMENT
/begin MEASUREMENT VehStc_stSOCIgnOffLstDcyc "SOC status of last DC end" UBYTE OneToOne 1 100 0.00 255.0 FORMAT "%5.1" ECU_ADDRESS 0x6000F755 /end MEASUREMENT
/begin MEASUREMENT VehStc_stSOCIgnOffLstDcycTmp "SOC status of last DC end temp" UBYTE OneToOne 1 100 0.00 255.0 FORMAT "%5.1" ECU_ADDRESS 0x60038D59 /end MEASUREMENT
/begin MEASUREMENT VehStc_stSOCIgnOnCurrDcyc "SOC status of this DC" UBYTE OneToOne 1 100 0.00 255.0 FORMAT "%5.1" ECU_ADDRESS 0x6000F754 /end MEASUREMENT
/begin MEASUREMENT VehStc_stSOCIgnOnLstDcyc "SOC status of last DC" UBYTE OneToOne 1 100 0.00 255.0 FORMAT "%5.1" ECU_ADDRESS 0x6000F753 /end MEASUREMENT
/begin MEASUREMENT VehStc_stSOCIgnOnLstDcycTmp "SOC status of last DC temp" UBYTE OneToOne 1 100 0.00 255.0 FORMAT "%5.1" ECU_ADDRESS 0x60038D58 /end MEASUREMENT
/begin MEASUREMENT VehStc_stSSE "COVOM current status" UBYTE OneToOne 1 100 0.00 255.0 FORMAT "%5.1" ECU_ADDRESS 0x60000E41 /end MEASUREMENT
/begin MEASUREMENT VehStc_stSSEOld "COVOM old staus" UBYTE OneToOne 1 100 0.00 255.0 FORMAT "%5.1" ECU_ADDRESS 0x60000E40 /end MEASUREMENT
/begin MEASUREMENT VehStc_stStopReqCdn "status Stop Request Condition in Off AT" UBYTE B_TRUE 1 100 0.00 1.00000000000 BIT_MASK 0x1 FORMAT "%13.11" ECU_ADDRESS 0x60000E3F /end MEASUREMENT
/begin MEASUREMENT VehStc_stSubRcdr "Sub recorder status" UBYTE OneToOne 1 100 0.00 255.0 FORMAT "%5.1" ECU_ADDRESS 0x6000F752 /end MEASUREMENT
/begin MEASUREMENT VehStc_stVehSpdCdn "status of the vehicle speed condition" UBYTE B_TRUE 1 100 0.00 1.00000000000 BIT_MASK 0x1 FORMAT "%13.11" ECU_ADDRESS 0x60000E3E /end MEASUREMENT
/begin MEASUREMENT VehStc_sumFuDiagRecA "Fuel system diagnos sum is recording parameter" ULONG fak_uw_b2 1 100 0.00 131071.999969 FORMAT "%13.6" ARRAY_SIZE 21 ECU_ADDRESS 0x60001BCC /end MEASUREMENT
/begin MEASUREMENT VehStc_tBattIgnOffLstDcyc "TBATT of last DC end" UBYTE RBPtCel_t_1p0_om40_1 1 100 -40.0 215.0 FORMAT "%5.1" ECU_ADDRESS 0x6000F751 /end MEASUREMENT
/begin MEASUREMENT VehStc_tBattIgnOffLstDcycTmp "TBATT of last DC end temp" UBYTE RBPtCel_t_1p0_om40_1 1 100 -40.0 215.0 FORMAT "%5.1" ECU_ADDRESS 0x60038D57 /end MEASUREMENT
/begin MEASUREMENT VehStc_tBattIgnOnCurrDcyc "TBATT of this DC" UBYTE RBPtCel_t_1p0_om40_1 1 100 -40.0 215.0 FORMAT "%5.1" ECU_ADDRESS 0x6000F750 /end MEASUREMENT
/begin MEASUREMENT VehStc_tBattIgnOnLstDcyc "TBATT of last DC" UBYTE RBPtCel_t_1p0_om40_1 1 100 -40.0 215.0 FORMAT "%5.1" ECU_ADDRESS 0x6000F74F /end MEASUREMENT
/begin MEASUREMENT VehStc_tBattIgnOnLstDcycTmp "TBATT of last DC temp" UBYTE RBPtCel_t_1p0_om40_1 1 100 -40.0 215.0 FORMAT "%5.1" ECU_ADDRESS 0x60038D56 /end MEASUREMENT
/begin MEASUREMENT VehStc_tiBattChrg "Total time of 12V battery charging" UWORD RBPtCel_ti_1p0_6 1 100 0.00 4095.000 FORMAT "%8.3" ECU_ADDRESS 0x60008DAA /end MEASUREMENT
/begin MEASUREMENT VehStc_tiBattChrgSub "Total time of 12V battery charging sub" UWORD RBPtCel_ti_0p1_1 1 100 0.00 6553.500 FORMAT "%8.3" ECU_ADDRESS 0x60038D54 /end MEASUREMENT
/begin MEASUREMENT VehStc_tiBattDcha "Total time of 12V battery discharging" UWORD RBPtCel_ti_1p0_6 1 100 0.00 4095.000 FORMAT "%8.3" ECU_ADDRESS 0x60008DA8 /end MEASUREMENT
/begin MEASUREMENT VehStc_tiBattDchaSub "Total time of 12V battery discharging sub" UWORD RBPtCel_ti_0p1_1 1 100 0.00 6553.500 FORMAT "%8.3" ECU_ADDRESS 0x60038D52 /end MEASUREMENT
/begin MEASUREMENT VehStc_tiCurrISDurn "Current IS duration" UWORD RBPtCel_ti_0p1_1 1 100 0.00 6553.500 FORMAT "%8.3" ECU_ADDRESS 0x60006D36 /end MEASUREMENT
/begin MEASUREMENT VehStc_tiDrvg "Vehicle moving time" UWORD RBPtCel_ti_1p0_6 1 100 0.00 4095.000 FORMAT "%8.3" ECU_ADDRESS 0x60008DA6 /end MEASUREMENT
/begin MEASUREMENT VehStc_tiDrvgTiSub "Vehicle moving time sub" UWORD RBPtCel_ti_0p1_1 1 100 0.00 6553.500 FORMAT "%8.3" ECU_ADDRESS 0x60038D50 /end MEASUREMENT
/begin MEASUREMENT VehStc_tiDurAftIgnOff "IG Off time" UWORD RBPtCel_ti_1p0_6 1 100 0.00 65535.00 FORMAT "%8.2" ECU_ADDRESS 0x60006D34 /end MEASUREMENT
/begin MEASUREMENT VehStc_tiEngOn "Engine run time" UWORD RBPtCel_ti_0p1_1 1 100 0.00 6553.500 FORMAT "%8.3" ECU_ADDRESS 0x60038D4E /end MEASUREMENT
/begin MEASUREMENT VehStc_tiEngOnDurn "Total time of Ready to drive" UWORD RBPtCel_ti_1p0_6 1 100 0.00 4095.000 FORMAT "%8.3" ECU_ADDRESS 0x60008DA4 /end MEASUREMENT
/begin MEASUREMENT VehStc_tiEngOnSubDurn "Total time of Ready to drive sub" UWORD RBPtCel_ti_0p1_1 1 100 0.00 6553.500 FORMAT "%8.3" ECU_ADDRESS 0x60038D4C /end MEASUREMENT
/begin MEASUREMENT VehStc_tiHdLiOn "Total time of Head light On" UWORD RBPtCel_ti_1p0_6 1 100 0.00 65535.00 FORMAT "%8.2" ECU_ADDRESS 0x60008DA2 /end MEASUREMENT
/begin MEASUREMENT VehStc_tiHdLiOnSub "Total time of Head light On sub" UWORD RBPtCel_ti_0p1_1 1 100 0.00 6553.500 FORMAT "%8.3" ECU_ADDRESS 0x60038D4A /end MEASUREMENT
/begin MEASUREMENT VehStc_tiIgnOnDurn "Total time of IG On" UWORD RBPtCel_ti_1p0_6 1 100 0.00 65535.00 FORMAT "%8.2" ECU_ADDRESS 0x60008D9E /end MEASUREMENT
/begin MEASUREMENT VehStc_tiIgnOnSubDurn "Total time of IG On sub" UWORD RBPtCel_ti_0p1_1 1 100 0.00 6553.500 FORMAT "%8.3" ECU_ADDRESS 0x60038D48 /end MEASUREMENT
/begin MEASUREMENT VehStc_tiIGPOnDurn "Total time of IGP On" UWORD RBPtCel_ti_1p0_6 1 100 0.00 4095.000 FORMAT "%8.3" ECU_ADDRESS 0x60008DA0 /end MEASUREMENT
/begin MEASUREMENT VehStc_tiIGPOnSubDurn "Total time of IGP On sub" ULONG RBPtCel_ti_0p1_1 1 100 0.00 429496729.500 FORMAT "%13.3" ECU_ADDRESS 0x60038D44 /end MEASUREMENT
/begin MEASUREMENT VehStc_tiInUseDurn "Total duration count for battery In use" UWORD RBPtCel_ti_1p0_6 1 100 0.00 65535.00 FORMAT "%8.2" ECU_ADDRESS 0x60006D32 /end MEASUREMENT
/begin MEASUREMENT VehStc_tiISInhbMod "Total time of the user use ISINHBIT mode" ULONG RBPtCel_ti_0p1_1 1 100 0.00 429496729.500 FORMAT "%13.3" ECU_ADDRESS 0x60003678 /end MEASUREMENT
/begin MEASUREMENT VehStc_tiISSubDurn "IS duration sub" UWORD RBPtCel_ti_0p1_1 1 100 0.00 6553.500 FORMAT "%8.3" ECU_ADDRESS 0x60038D40 /end MEASUREMENT
/begin MEASUREMENT VehStc_tiRtCity "Time taken by the vehicle in city zone during current driving cycle" ULONG t_q0p1 1 100 0.00 429496729.500 FORMAT "%13.3" ECU_ADDRESS 0x60038C74 /end MEASUREMENT
/begin MEASUREMENT VehStc_tiRtCityEco "Time taken by the vehicle in city zone during current driving cycle with Economy mode ON" ULONG t_q0p1 1 100 0.00 429496729.500 FORMAT "%13.3" ECU_ADDRESS 0x60038C70 /end MEASUREMENT
/begin MEASUREMENT VehStc_tiRtHighWay "Time taken by the vehicle in Highway zone during current driving cycle" ULONG t_q0p1 1 100 0.00 429496729.500 FORMAT "%13.3" ECU_ADDRESS 0x60038C6C /end MEASUREMENT
/begin MEASUREMENT VehStc_tiRtHighWayEco "Time taken by the vehicle in Highway zone during current driving cycle with Economy Mode ON" ULONG t_q0p1 1 100 0.00 429496729.500 FORMAT "%13.3" ECU_ADDRESS 0x60038C68 /end MEASUREMENT
/begin MEASUREMENT VehStc_tiRtISSOffAC "Time taken to prevent the vehicle from Idle Stop due to air conditioning" ULONG t_q0p1 1 100 0.00 429496729.500 FORMAT "%13.3" ECU_ADDRESS 0x60038C64 /end MEASUREMENT
/begin MEASUREMENT VehStc_tiRtISSOffAT "Time taken to prevent the vehicle from Idle Stop due to AT request" ULONG t_q0p1 1 100 0.00 429496729.500 FORMAT "%13.3" ECU_ADDRESS 0x60038C60 /end MEASUREMENT
/begin MEASUREMENT VehStc_tiRtISSOffATSlope "Time taken to prevent the vehicle from Idle Stop due to slope detection of AT" ULONG t_q0p1 1 100 0.00 429496729.500 FORMAT "%13.3" ECU_ADDRESS 0x60038C5C /end MEASUREMENT
/begin MEASUREMENT VehStc_tiRtISSOffBat "Time taken to prevent the vehicle from Idle Stop due to battery charging" ULONG t_q0p1 1 100 0.00 429496729.500 FORMAT "%13.3" ECU_ADDRESS 0x60038C58 /end MEASUREMENT
/begin MEASUREMENT VehStc_tiRtISSOffBrkBoost "Time taken to prevent the vehicle from Idle Stop due to request of brake booster" ULONG t_q0p1 1 100 0.00 429496729.500 FORMAT "%13.3" ECU_ADDRESS 0x60038C54 /end MEASUREMENT
/begin MEASUREMENT VehStc_tiRtISSOffDCDC "Time taken to prevent the vehicle from Idle Stop due to DCDC converter" ULONG t_q0p1 1 100 0.00 429496729.500 FORMAT "%13.3" ECU_ADDRESS 0x60038C50 /end MEASUREMENT
/begin MEASUREMENT VehStc_tiRtISSOffPwrSteer "Time taken to prevent the vehicle from Idle Stop due to power steering" ULONG t_q0p1 1 100 0.00 429496729.500 FORMAT "%13.3" ECU_ADDRESS 0x60038C4C /end MEASUREMENT
/begin MEASUREMENT VehStc_tiRtISSOffSys "Time taken to prevent the vehicle from Idle Stop due to system failure, or driver absent" ULONG t_q0p1 1 100 0.00 429496729.500 FORMAT "%13.3" ECU_ADDRESS 0x60038C48 /end MEASUREMENT
/begin MEASUREMENT VehStc_tiRtISSOffTempEng "Time taken to prevent the vehicle from Idle Stop due to engine temperature" ULONG t_q0p1 1 100 0.00 429496729.500 FORMAT "%13.3" ECU_ADDRESS 0x60038C44 /end MEASUREMENT
/begin MEASUREMENT VehStc_tiRtISSOffUser "Time taken to prevent the vehicle from Idle Stop due to user turned off" ULONG t_q0p1 1 100 0.00 429496729.500 FORMAT "%13.3" ECU_ADDRESS 0x60038C40 /end MEASUREMENT
/begin MEASUREMENT VehStc_tiRtISSOffvVeh "Time taken to prevent the vehicle from Idle Stop due to vehicle speed condition" ULONG t_q0p1 1 100 0.00 429496729.500 FORMAT "%13.3" ECU_ADDRESS 0x60038C3C /end MEASUREMENT
/begin MEASUREMENT VehStc_tiRtISSStop "Time taken by the vehicle when the vehicle being in Idle stop" ULONG t_q0p1 1 100 0.00 429496729.500 FORMAT "%13.3" ECU_ADDRESS 0x60038C38 /end MEASUREMENT
/begin MEASUREMENT VehStc_tiRtStop "Time taken by the vehicle in Stop zone during current driving cycle" ULONG t_q0p1 1 100 0.00 429496729.500 FORMAT "%13.3" ECU_ADDRESS 0x60038C34 /end MEASUREMENT
/begin MEASUREMENT VehStc_tiRtStopSpstOn "Time Taken by the vehicle in Idle Stop condition" ULONG t_q0p1 1 100 0.00 429496729.500 FORMAT "%13.3" ECU_ADDRESS 0x60038C30 /end MEASUREMENT
/begin MEASUREMENT VehStc_tiRtStopStspDrvrOff "Time the ISS Inhibit switch is Enabled intentionally by the Driver" ULONG t_q0p1 1 100 0.00 429496729.500 FORMAT "%13.3" ECU_ADDRESS 0x60038C2C /end MEASUREMENT
/begin MEASUREMENT VehStc_tiRtStopStspOffSysReq "Time taken to prevent the vehicle from Idle Stop due to System Requirements not satisfied for ISS" ULONG t_q0p1 1 100 0.00 429496729.500 FORMAT "%13.3" ECU_ADDRESS 0x60038C28 /end MEASUREMENT
/begin MEASUREMENT VehStc_tiTotIgnOff "Total time of IG Off" UWORD RBPtCel_ti_1p0_6 1 100 0.00 65535.00 FORMAT "%8.2" ECU_ADDRESS 0x60008D9A /end MEASUREMENT
/begin MEASUREMENT VehStc_tiTotIgnOnLstDcyc "Total time of IG On of the last driving cycle" UWORD RBPtCel_ti_1p0_2 1 100 0.00 65535.00 FORMAT "%8.2" ECU_ADDRESS 0x60008D98 /end MEASUREMENT
/begin MEASUREMENT VehStc_tiTotIgnOnLstDcycSub "Total time of IG On of the last driving cycle sub" ULONG RBPtCel_ti_0p1_1 1 100 0.00 65535.0000000 FORMAT "%13.7" ECU_ADDRESS 0x60001E14 /end MEASUREMENT
/begin MEASUREMENT VehStc_tiTotIgnOnLstDcycTmp "Total time of IG On of the last driving cycle temp" UWORD RBPtCel_ti_1p0_2 1 100 0.00 65535.00 FORMAT "%8.2" ECU_ADDRESS 0x60038D3E /end MEASUREMENT
/begin MEASUREMENT VehStc_tiTotIS "Total time of Idling stop" UWORD RBPtCel_ti_1p0_6 1 100 0.00 4095.000 FORMAT "%8.3" ECU_ADDRESS 0x60008D9C /end MEASUREMENT
/begin MEASUREMENT VehStc_uBattMinDurgIS "Battery minimum voltage during IS" ULONG q0p1_mV 1 100 0.00 429496729.500 FORMAT "%13.3" ECU_ADDRESS 0x60003674 /end MEASUREMENT
/begin MEASUREMENT VehStc_uIBattMinDurgIS "Voltage when battery maximum discharge during IS" ULONG q0p1_mV 1 100 0.00 429496729.500 FORMAT "%13.3" ECU_ADDRESS 0x60003670 /end MEASUREMENT
/begin MEASUREMENT VehStc_uMinBattEbs "Minimum voltage of 12V battery (During downverter is on, while ACG generates)" UWORD RBPtCel_u_0p05_1 1 100 0.00 3276.750 FORMAT "%8.3" ECU_ADDRESS 0x60008D96 /end MEASUREMENT
/begin MEASUREMENT VehStc_volActFuCns "Actual volume of Fuel consumed by the vehicle" UWORD volFilgLvl_ml 1 100 0.00 65535.00 FORMAT "%8.2" ECU_ADDRESS 0x60000E3C /end MEASUREMENT
/begin MEASUREMENT VehStc_volCnsCityDcyc "Volume consumed in current driving cycle by the vehicle in the city zone" ULONG volFilgLvl_ml 1 100 0.00 4294967295.00 FORMAT "%13.2" ECU_ADDRESS 0x60038C24 /end MEASUREMENT
/begin MEASUREMENT VehStc_volCnsCityEcoDcyc "Volume consumed in current driving cycle by the vehicle in the city zone with Economy mode ON" ULONG volFilgLvl_ml 1 100 0.00 4294967295.00 FORMAT "%13.2" ECU_ADDRESS 0x60038C20 /end MEASUREMENT
/begin MEASUREMENT VehStc_volCnsHighWayDcyc "Volume Consumed by the vehicle in the highway zone for current driving cycle" ULONG volFilgLvl_ml 1 100 0.00 4294967295.00 FORMAT "%13.2" ECU_ADDRESS 0x60038C1C /end MEASUREMENT
/begin MEASUREMENT VehStc_volCnsHighWayEcoDcyc "Volume Consumed by the vehicle in the highway zone for current driving cycle with Economy Mode ON" ULONG volFilgLvl_ml 1 100 0.00 4294967295.00 FORMAT "%13.2" ECU_ADDRESS 0x60038C18 /end MEASUREMENT
/begin MEASUREMENT VehStc_volCnsStopDcyc "Volume Consumed by the vehicle in the Stop zone for current driving cycle" ULONG volFilgLvl_ml 1 100 0.00 4294967295.00 FORMAT "%13.2" ECU_ADDRESS 0x60038C14 /end MEASUREMENT
/begin MEASUREMENT VehStc_volFuCnsOld "Value in the previous raster (in 100ms) of cumulative fuel quantity that has been injected since the start of the driving cycle." ULONG volFilgLvl_ml 1 100 0.00 4294967295.00 FORMAT "%13.2" ECU_ADDRESS 0x60000E38 /end MEASUREMENT
/begin MEASUREMENT VehVDDOut_ctReIni "Re-Init value for global drive cycle counter which is incremented when system state SyC_PostDrive is left" UBYTE OneToOne 1 100 0.00 255.0 FORMAT "%5.1" ECU_ADDRESS 0x6000B4DF /end MEASUREMENT
/begin MEASUREMENT VehV_a "Vehicle Acceleration" SWORD Acc 1 100 -32.76800 32.76700 FORMAT "%8.5" ECU_ADDRESS 0x6000961A /end MEASUREMENT
/begin MEASUREMENT VehV_aFilt_MP "Measurement of Filtered vehicle acceleration" SWORD Acc 1 100 -32.76800 32.76700 FORMAT "%8.5" ECU_ADDRESS 0x7000A014 /end MEASUREMENT
/begin MEASUREMENT VehV_aRawUnFlt "Raw vehicle acceleration" SWORD Acc 1 100 -32.76800 32.76700 FORMAT "%8.5" ECU_ADDRESS 0x6001496A /end MEASUREMENT
/begin MEASUREMENT VehV_ctPeriodOld_mp "Mesuring point to hold the previous PWM pulse count" ULONG OneToOne 1 100 0.00 4294967295.00 FORMAT "%13.2" ECU_ADDRESS 0x7000A034 /end MEASUREMENT
/begin MEASUREMENT VehV_ctPeriod_mp "Mesuring point to hold the present PWM pulse count" ULONG OneToOne 1 100 0.00 4294967295.00 FORMAT "%13.2" ECU_ADDRESS 0x7000A030 /end MEASUREMENT
/begin MEASUREMENT VehV_DSQSafe_MP "Safe Signal Quality raw vehicle speed signal" UBYTE OneToOne 1 100 0.00 255.0 FORMAT "%5.1" ECU_ADDRESS 0x7000A012 /end MEASUREMENT
/begin MEASUREMENT VehV_DSQStd_MP "standard Signal Quality raw vehicle speed signal" UBYTE OneToOne 1 100 0.00 255.0 FORMAT "%5.1" ECU_ADDRESS 0x7000A011 /end MEASUREMENT
/begin MEASUREMENT VehV_facTireAxlCorr "Tire Axle correction factor" ULONG PerKm 1 100 0.00 4294967295.00 FORMAT "%13.2" ECU_ADDRESS 0x60013B5C /end MEASUREMENT
/begin MEASUREMENT VehV_flgExcdLim "minimum speed was reached at least once in the current driving cycle" UBYTE B_TRUE 1 100 0.00 1.00000000000 BIT_MASK 0x1 FORMAT "%13.11" ECU_ADDRESS 0x60014AD4 /end MEASUREMENT
/begin MEASUREMENT VehV_flgFLSnsrErr_MP "Front Left Sensor Error Status" UBYTE B_TRUE 1 100 0.00 1.00000000000 BIT_MASK 0x1 FORMAT "%13.11" ECU_ADDRESS 0x7000A02F /end MEASUREMENT
/begin MEASUREMENT VehV_flgFRSnsrErr_MP "Front Right Sensor Error Status" UBYTE B_TRUE 1 100 0.00 1.00000000000 BIT_MASK 0x1 FORMAT "%13.11" ECU_ADDRESS 0x7000A02E /end MEASUREMENT
/begin MEASUREMENT VehV_flgRLSnsrErr_MP "Rear Left Sensor Error Status" UBYTE B_TRUE 1 100 0.00 1.00000000000 BIT_MASK 0x1 FORMAT "%13.11" ECU_ADDRESS 0x7000A02D /end MEASUREMENT
/begin MEASUREMENT VehV_flgRRSnsrErr_MP "Rear Right Sensor Error Status" UBYTE B_TRUE 1 100 0.00 1.00000000000 BIT_MASK 0x1 FORMAT "%13.11" ECU_ADDRESS 0x7000A02C /end MEASUREMENT
/begin MEASUREMENT VehV_flgV2NEna_MP "Measuring point to detect enabling of V2N plausibilisation check" UBYTE B_TRUE 1 100 0.00 1.00000000000 BIT_MASK 0x1 FORMAT "%13.11" ECU_ADDRESS 0x7000A010 /end MEASUREMENT
/begin MEASUREMENT VehV_flgV2NErr "Flag to detect error condition for V2N plausibilisation" UBYTE B_TRUE 1 100 0.00 1.00000000000 BIT_MASK 0x1 FORMAT "%13.11" ECU_ADDRESS 0x6000B4DE /end MEASUREMENT
/begin MEASUREMENT VehV_flgV2NGearChkEna "Flag to enable V2N plausibilisation in case of .Manual transmission" UBYTE B_TRUE 1 100 0.00 1.00000000000 BIT_MASK 0x1 FORMAT "%13.11" ECU_ADDRESS 0x700000CB /end MEASUREMENT
/begin MEASUREMENT VehV_flgV2NHeal "Flag to detect healing condition for V2N plausibilisation" UBYTE B_TRUE 1 100 0.00 1.00000000000 BIT_MASK 0x1 FORMAT "%13.11" ECU_ADDRESS 0x6000B4DD /end MEASUREMENT
/begin MEASUREMENT VehV_nArySpdCntr "vehicle speed array counter" UBYTE OneToOne 1 100 0.00 255.0 FORMAT "%5.1" ECU_ADDRESS 0x6000FB55 /end MEASUREMENT
/begin MEASUREMENT VehV_rTraGearDif_MP "Difference between powertrain and computed gear transmission ratio" SWORD Fact1000 1 100 -32.76800 32.76700 FORMAT "%8.5" ECU_ADDRESS 0x7000A00E /end MEASUREMENT
/begin MEASUREMENT VehV_rTraGearFild "Filtered gear transmission ratio" SWORD Fact1000 1 100 -32.76800 32.76700 FORMAT "%8.5" ECU_ADDRESS 0x60006CCC /end MEASUREMENT
/begin MEASUREMENT VehV_rTraGearFild_MP "Measuring point for filtered gear transmission ratio" SWORD Fact1000 1 100 -32.76800 32.76700 FORMAT "%8.5" ECU_ADDRESS 0x7000A00C /end MEASUREMENT
/begin MEASUREMENT VehV_rTraGear_MP "Measuring point for gear transmission ratio" SWORD Fact1000 1 100 -32.76800 32.76700 FORMAT "%8.5" ECU_ADDRESS 0x7000A00A /end MEASUREMENT
/begin MEASUREMENT VehV_rV2N_MP "Measuring point for vehicle to engine speed ratio" SWORD Fact1000 1 100 -32.76800 32.76700 FORMAT "%8.5" ECU_ADDRESS 0x7000A008 /end MEASUREMENT
/begin MEASUREMENT VehV_stSigSrc "Current active Signal Source for vehicle speed sensing" UBYTE OneToOne 1 100 0.00 255.0 FORMAT "%5.1" ECU_ADDRESS 0x60014AD5 /end MEASUREMENT
/begin MEASUREMENT VehV_stT15WaitEdg "status of wait for 2 rising edges for the speed sensor" UBYTE B_TRUE 1 100 0.00 1.00000000000 BIT_MASK 0x1 FORMAT "%13.11" ECU_ADDRESS 0x6000B4E0 /end MEASUREMENT
/begin MEASUREMENT VehV_stTopSpdLim "Status Top Speed Limit" UBYTE OneToOne 1 100 0.00 255.0 FORMAT "%5.1" ECU_ADDRESS 0x60014AD6 /end MEASUREMENT
/begin MEASUREMENT VehV_tiPerAvrg "Aerage time period between 2VSS impluse" SLONG Time_PwmHigh 1 100 0.00 107374182.350 FORMAT "%13.3" ECU_ADDRESS 0x5000504C /end MEASUREMENT
/begin MEASUREMENT VehV_tiPeriodOld_mp "Mesuring point to hold the previous time period" ULONG Time_PwmHigh 1 100 0.00 107374182.350 FORMAT "%13.3" ECU_ADDRESS 0x7000A028 /end MEASUREMENT
/begin MEASUREMENT VehV_tiPeriod_mp "Mesuring point to hold the present time period" ULONG Time_PwmHigh 1 100 0.00 107374182.350 FORMAT "%13.3" ECU_ADDRESS 0x7000A024 /end MEASUREMENT
/begin MEASUREMENT VehV_tiSclOut_mp "Measuring point for scaled out time of vehicle speed output" SLONG Period_1000 1 100 -2147483.64800 2147483.64700 FORMAT "%13.5" ECU_ADDRESS 0x7000A018 /end MEASUREMENT
/begin MEASUREMENT VehV_v "" SWORD Vel 1 100 -327.6800 327.6700 FORMAT "%8.4" ECU_ADDRESS 0x50005EEC /end MEASUREMENT
/begin MEASUREMENT VehV_vAcclFlt_mp "vehicle speed used in acceleration calculation" SLONG Vel_High 1 100 -2147483.64800 2147483.64700 FORMAT "%13.5" ECU_ADDRESS 0x7000A004 /end MEASUREMENT
/begin MEASUREMENT VehV_vAvrgSpdWoMax_MP "Average Wheel Speed without Maximum value" SWORD Vel 1 100 -327.6800 327.6700 FORMAT "%8.4" ECU_ADDRESS 0x7000A022 /end MEASUREMENT
/begin MEASUREMENT VehV_vAvrgSpdWoMin_MP "Average Wheel Speed without Minimum value" SWORD Vel 1 100 -327.6800 327.6700 FORMAT "%8.4" ECU_ADDRESS 0x7000A020 /end MEASUREMENT
/begin MEASUREMENT VehV_vErrFrzVal "Freezed vehicle speed during error" SWORD Vel 1 100 -327.6800 327.6700 FORMAT "%8.4" ECU_ADDRESS 0x6001496C /end MEASUREMENT
/begin MEASUREMENT VehV_vFltOld_mp "Previous value of Filtered raw vehicle speed" SLONG Vel_High 1 100 -2147483.64800 2147483.64700 FORMAT "%13.5" ECU_ADDRESS 0x7000A000 /end MEASUREMENT
/begin MEASUREMENT VehV_vFLWhlSpd "Wheel speed front left" SWORD Vel 1 100 -327.6800 327.6700 FORMAT "%8.4" ECU_ADDRESS 0x60009618 /end MEASUREMENT
/begin MEASUREMENT VehV_vFRWhlSpd "Wheel speed front right" SWORD Vel 1 100 -327.6800 327.6700 FORMAT "%8.4" ECU_ADDRESS 0x60009616 /end MEASUREMENT
/begin MEASUREMENT VehV_vNCSnsrAryVal "NC sensor vehicle speed array value" SWORD Vel 1 100 -327.6800 327.6700 FORMAT "%8.4" ECU_ADDRESS 0x60009614 /end MEASUREMENT
/begin MEASUREMENT VehV_vNCSnsrAvg "NC sensor vehicle speed average formula" SWORD Vel 1 100 -327.6800 327.6700 FORMAT "%8.4" ECU_ADDRESS 0x60009612 /end MEASUREMENT
/begin MEASUREMENT VehV_vNCSnsrSum "NC sensor vehicle speed sum formula" SLONG Vel 1 100 -21474836.4800 21474836.4700 FORMAT "%13.4" ECU_ADDRESS 0x50005050 /end MEASUREMENT
/begin MEASUREMENT VehV_vNCSpdSnsrAry "NC sensor vehicle speed array" SWORD Vel 1 100 -327.6800 327.6700 FORMAT "%8.4" ARRAY_SIZE 5 ECU_ADDRESS 0x50005812 /end MEASUREMENT
/begin MEASUREMENT VehV_vRefAvrgSpd_MP "Reference Wheel Speed for PIN point" SWORD Vel 1 100 -327.6800 327.6700 FORMAT "%8.4" ECU_ADDRESS 0x7000A01E /end MEASUREMENT
/begin MEASUREMENT VehV_vRLWhlSpd "Wheel speed rear left" SWORD Vel 1 100 -327.6800 327.6700 FORMAT "%8.4" ECU_ADDRESS 0x60009610 /end MEASUREMENT
/begin MEASUREMENT VehV_vRRWhlSpd "Wheel speed rear right" SWORD Vel 1 100 -327.6800 327.6700 FORMAT "%8.4" ECU_ADDRESS 0x6000960E /end MEASUREMENT
/begin MEASUREMENT VehV_vSens "Sensed vehicle speed" SWORD Vel 1 100 -327.6800 327.6700 FORMAT "%8.4" ECU_ADDRESS 0x6001496E /end MEASUREMENT
/begin MEASUREMENT VehV_vSensHw "sensed vehicle speed from hardware" SWORD Vel 1 100 -327.6800 327.6700 FORMAT "%8.4" ECU_ADDRESS 0x6000960C /end MEASUREMENT
/begin MEASUREMENT VehV_vSensOBD "Sensed vehicle speed for OBD" SWORD Vel 1 100 -327.6800 327.6700 FORMAT "%8.4" ECU_ADDRESS 0x60014970 /end MEASUREMENT
/begin MEASUREMENT VehV_vSensPre_mp "Vehicle speed signal prior to checking the signal if it is jitter." SWORD Vel 1 100 -327.6800 327.6700 FORMAT "%8.4" ECU_ADDRESS 0x7000A01C /end MEASUREMENT
/begin MEASUREMENT VehV_vSensSngWhlCan "sensed vehicle speed from single wheel CAN source" SWORD Vel 1 100 -327.6800 327.6700 FORMAT "%8.4" ECU_ADDRESS 0x6000960A /end MEASUREMENT
/begin MEASUREMENT VehV_vSnsrAbslt_MP "Absolute value of sensed vehicle speed." SWORD Vel 1 100 -327.6800 327.6700 FORMAT "%8.4" ECU_ADDRESS 0x70009FFC /end MEASUREMENT
/begin MEASUREMENT VehV_vSnsrSafe_MP "Safe Signal Sensed vehicle speed" SWORD Vel 1 100 -327.6800 327.6700 FORMAT "%8.4" ECU_ADDRESS 0x70009FFA /end MEASUREMENT
/begin MEASUREMENT VehV_vSnsrSpdDiffAbslt "Differential absolute value of vehicle speed sensor" SWORD Vel 1 100 -327.6800 327.6700 FORMAT "%8.4" ECU_ADDRESS 0x60009608 /end MEASUREMENT
/begin MEASUREMENT VehV_vSnsrSpdDiffThd "Threshold of vehicle speed average formula" SWORD Vel 1 100 -327.6800 327.6700 FORMAT "%8.4" ECU_ADDRESS 0x60009606 /end MEASUREMENT
/begin MEASUREMENT VehV_vSnsrStd_MP "standard signal Sensed vehicle speed" SWORD Vel 1 100 -327.6800 327.6700 FORMAT "%8.4" ECU_ADDRESS 0x70009FF8 /end MEASUREMENT
/begin MEASUREMENT VehV_vSpdSnsrAAry "wheel A vehicle speed sensorA array" SWORD Vel 1 100 -327.6800 327.6700 FORMAT "%8.4" ARRAY_SIZE 5 ECU_ADDRESS 0x5000581C /end MEASUREMENT
/begin MEASUREMENT VehV_vSpdSnsrAAryVal "wheel A vehicle speed sensor array value" SWORD Vel 1 100 -327.6800 327.6700 FORMAT "%8.4" ECU_ADDRESS 0x60009604 /end MEASUREMENT
/begin MEASUREMENT VehV_vSpdSnsrAAvg "vehicle speed sensor average value for wheel A" SWORD Vel 1 100 -327.6800 327.6700 FORMAT "%8.4" ECU_ADDRESS 0x60009602 /end MEASUREMENT
/begin MEASUREMENT VehV_vSpdSnsrASum "Wheel A vehicle speed sensor sum" SLONG Vel 1 100 -21474836.4800 21474836.4700 FORMAT "%13.4" ECU_ADDRESS 0x60003940 /end MEASUREMENT
/begin MEASUREMENT VehV_vSpdSnsrBAry "Wheel B vehicle speed sensor array" SWORD Vel 1 100 -327.6800 327.6700 FORMAT "%8.4" ARRAY_SIZE 5 ECU_ADDRESS 0x50005826 /end MEASUREMENT
/begin MEASUREMENT VehV_vSpdSnsrBAryVal "Wheel B vehicle speed sensor array value" SWORD Vel 1 100 -327.6800 327.6700 FORMAT "%8.4" ECU_ADDRESS 0x60009600 /end MEASUREMENT
/begin MEASUREMENT VehV_vSpdSnsrBAvg "Wheel B vehicle speed sensor average formula" SWORD Vel 1 100 -327.6800 327.6700 FORMAT "%8.4" ECU_ADDRESS 0x600095FE /end MEASUREMENT
/begin MEASUREMENT VehV_vSpdSnsrBSum "Wheel B vehicle speed sensor sum formula" SLONG Vel 1 100 -21474836.4800 21474836.4700 FORMAT "%13.4" ECU_ADDRESS 0x6000393C /end MEASUREMENT
/begin MEASUREMENT VehV_vUnFlt "Unfiltered value of vehicle velocity" SWORD Vel 1 100 -327.6800 327.6700 FORMAT "%8.4" ECU_ADDRESS 0x600095FC /end MEASUREMENT
/begin MEASUREMENT Veh_flgDyn "Vehicle state dynamic drive active" UBYTE B_TRUE 1 100 0.00 1.00000000000 BIT_MASK 0x1 FORMAT "%13.11" ECU_ADDRESS 0x6000F8AC /end MEASUREMENT
/begin MEASUREMENT VMD_facDasModSwt "Factor for ramping of accped ratio value during change in drive mode for driver assistance demand" SLONG Fact 1 100 -262144.000000 262143.999878 FORMAT "%13.6" ECU_ADDRESS 0x60003968 /end MEASUREMENT
/begin MEASUREMENT VMD_facDasModSwtStep "Factor for step change in slope used for ramping of accped ratio during change in drive mode for driver assistance demand" SLONG Fact 1 100 -262144.000000 262143.999878 FORMAT "%13.6" ECU_ADDRESS 0x60003964 /end MEASUREMENT
/begin MEASUREMENT VMD_facModSwt "Factor for ramping of accped ratio value during change in drive mode" SLONG Fact 1 100 -262144.000000 262143.999878 FORMAT "%13.6" ECU_ADDRESS 0x60003960 /end MEASUREMENT
/begin MEASUREMENT VMD_facModSwtLrn "Factor for ramping of accped ratio value during change in drive mode for learn functionality" SLONG Fact 1 100 -262144.000000 262143.999878 FORMAT "%13.6" ECU_ADDRESS 0x6000395C /end MEASUREMENT
/begin MEASUREMENT VMD_facModSwtStep "Factor for step change in slope used for ramping of accped ratio during change in drive mode" SLONG Fact 1 100 -262144.000000 262143.999878 FORMAT "%13.6" ECU_ADDRESS 0x60003958 /end MEASUREMENT
/begin MEASUREMENT VMD_facModSwtStepLrn "Factor for step change in slope used for ramping of accped ratio during change in drive mode for learn functionality" SLONG Fact 1 100 -262144.000000 262143.999878 FORMAT "%13.6" ECU_ADDRESS 0x60003954 /end MEASUREMENT
/begin MEASUREMENT VMD_rAslAccLrnTmp "Temporary learn ratio of ASL and ACC" SWORD Prc 1 100 -400.0000 399.9878 FORMAT "%8.4" ECU_ADDRESS 0x60006CCA /end MEASUREMENT
/begin MEASUREMENT VMD_rAslAccTmp "Temporary ratio of ASL and ACC" SWORD Prc 1 100 -400.0000 399.9878 FORMAT "%8.4" ECU_ADDRESS 0x60006CC8 /end MEASUREMENT
/begin MEASUREMENT VMD_rASLCC "Virtual accelerator pedal position based on driver ,CC and ASL demanded ratio" SWORD Prc 1 100 -400.0000 399.9878 FORMAT "%8.4" ECU_ADDRESS 0x60009676 /end MEASUREMENT
/begin MEASUREMENT VMD_rASLCCLrn "Virtual accelerator pedal position based on driver ,CC and ASL demanded ratio for learn functionality" SWORD Prc 1 100 -400.0000 399.9878 FORMAT "%8.4" ECU_ADDRESS 0x60009674 /end MEASUREMENT
/begin MEASUREMENT VMD_rDasDrvMod "Virtual accelerator pedal position after drive mode driver assistance demand" SWORD Prc 1 100 -400.0000 399.9878 FORMAT "%8.4" ECU_ADDRESS 0x60009672 /end MEASUREMENT
/begin MEASUREMENT VMD_rDasDrvModCorrd "Virtual accelerator pedal position after drive mode correction for driver assistance demand" SWORD Prc 1 100 -400.0000 399.9878 FORMAT "%8.4" ECU_ADDRESS 0x60009670 /end MEASUREMENT
/begin MEASUREMENT VMD_rDasDrvModCorrdEco "Virtual accelerator pedal position after Eco drive mode correction for driver assistance demand" SWORD Prc 1 100 -400.0000 399.9878 FORMAT "%8.4" ECU_ADDRESS 0x6000966E /end MEASUREMENT
/begin MEASUREMENT VMD_rDasDrvModCorrdNew "Virtual accelerator pedal position based on current drive mode for driver assistance demand" SWORD Prc 1 100 -400.0000 399.9878 FORMAT "%8.4" ECU_ADDRESS 0x6000966C /end MEASUREMENT
/begin MEASUREMENT VMD_rDasDrvModCorrdNewTmp "Temporary value of Virtual accelerator pedal position based on current drive mode for driver assistance demand" SWORD Prc 1 100 -400.0000 399.9878 FORMAT "%8.4" ECU_ADDRESS 0x6000966A /end MEASUREMENT
/begin MEASUREMENT VMD_rDasDrvModCorrdNorm "Virtual accelerator pedal position after Eco drive mode correction for driver assistance demand" SWORD Prc 1 100 -400.0000 399.9878 FORMAT "%8.4" ECU_ADDRESS 0x60009668 /end MEASUREMENT
/begin MEASUREMENT VMD_rDasDrvModCorrdOld "Virtual accelerator pedal position based on previous drive mode for driver assistance demand" SWORD Prc 1 100 -400.0000 399.9878 FORMAT "%8.4" ECU_ADDRESS 0x60009666 /end MEASUREMENT
/begin MEASUREMENT VMD_rDasDrvModCorrdOldTmp "Temporary value of Virtual accelerator pedal position based on previous drive mode for driver assistance demand" SWORD Prc 1 100 -400.0000 399.9878 FORMAT "%8.4" ECU_ADDRESS 0x60009664 /end MEASUREMENT
/begin MEASUREMENT VMD_rDasVirtAPP "inverse calculated accelerator pedal value for driver assistance demand" SWORD Prc 1 100 -400.0000 399.9878 FORMAT "%8.4" ECU_ADDRESS 0x60009662 /end MEASUREMENT
/begin MEASUREMENT VMD_rDrvModCorrd "Virtual accelerator pedal position after drive mode correction" SWORD Prc 1 100 -400.0000 399.9878 FORMAT "%8.4" ECU_ADDRESS 0x60009660 /end MEASUREMENT
/begin MEASUREMENT VMD_rDrvModCorrdEco "Virtual accelerator pedal position after Eco drive mode correction" SWORD Prc 1 100 -400.0000 399.9878 FORMAT "%8.4" ECU_ADDRESS 0x6000965E /end MEASUREMENT
/begin MEASUREMENT VMD_rDrvModCorrdEcoLrn "Virtual accelerator pedal position after Eco drive mode correction for learn functionality" SWORD Prc 1 100 -400.0000 399.9878 FORMAT "%8.4" ECU_ADDRESS 0x6000965C /end MEASUREMENT
/begin MEASUREMENT VMD_rDrvModCorrdLrn "Virtual accelerator pedal position after drive mode correction for learn functionality" SWORD Prc 1 100 -400.0000 399.9878 FORMAT "%8.4" ECU_ADDRESS 0x6000965A /end MEASUREMENT
/begin MEASUREMENT VMD_rDrvModCorrdNew "Virtual accelerator pedal position based on current drive mode" SWORD Prc 1 100 -400.0000 399.9878 FORMAT "%8.4" ECU_ADDRESS 0x60009658 /end MEASUREMENT
/begin MEASUREMENT VMD_rDrvModCorrdNewLrn "Virtual accelerator pedal position based on current drive mode for learn functionality" SWORD Prc 1 100 -400.0000 399.9878 FORMAT "%8.4" ECU_ADDRESS 0x60009656 /end MEASUREMENT
/begin MEASUREMENT VMD_rDrvModCorrdNewTmp "Temporary value of Virtual accelerator pedal position based on current drive mode" SWORD Prc 1 100 -400.0000 399.9878 FORMAT "%8.4" ECU_ADDRESS 0x60009654 /end MEASUREMENT
/begin MEASUREMENT VMD_rDrvModCorrdNewTmpLrn "Temporary value of Virtual accelerator pedal position based on current drive mode for learn functionality" SWORD Prc 1 100 -400.0000 399.9878 FORMAT "%8.4" ECU_ADDRESS 0x60009652 /end MEASUREMENT
/begin MEASUREMENT VMD_rDrvModCorrdNorm "Virtual accelerator pedal position after Eco drive mode correction" SWORD Prc 1 100 -400.0000 399.9878 FORMAT "%8.4" ECU_ADDRESS 0x60009650 /end MEASUREMENT
/begin MEASUREMENT VMD_rDrvModCorrdNormLrn "Virtual accelerator pedal position after Eco drive mode correction for learn functionality" SWORD Prc 1 100 -400.0000 399.9878 FORMAT "%8.4" ECU_ADDRESS 0x6000964E /end MEASUREMENT
/begin MEASUREMENT VMD_rDrvModCorrdOld "Virtual accelerator pedal position based on previous drive mode" SWORD Prc 1 100 -400.0000 399.9878 FORMAT "%8.4" ECU_ADDRESS 0x6000964C /end MEASUREMENT
/begin MEASUREMENT VMD_rDrvModCorrdOldLrn "Virtual accelerator pedal position based on previous drive mode for learn functionality" SWORD Prc 1 100 -400.0000 399.9878 FORMAT "%8.4" ECU_ADDRESS 0x6000964A /end MEASUREMENT
/begin MEASUREMENT VMD_rDrvModCorrdOldTmp "Temporary value of Virtual accelerator pedal position based on previous drive mode" SWORD Prc 1 100 -400.0000 399.9878 FORMAT "%8.4" ECU_ADDRESS 0x60009648 /end MEASUREMENT
/begin MEASUREMENT VMD_rDrvModCorrdOldTmpLrn "Temporary value of Virtual accelerator pedal position based on previous drive mode for learn functionality" SWORD Prc 1 100 -400.0000 399.9878 FORMAT "%8.4" ECU_ADDRESS 0x60009646 /end MEASUREMENT
/begin MEASUREMENT VMD_rVirtAPP "inverse calculated accelerator pedal value" SWORD Prc 1 100 -400.0000 399.9878 FORMAT "%8.4" ECU_ADDRESS 0x60009644 /end MEASUREMENT
/begin MEASUREMENT VMD_rVirtAPPLrn "Inverse calculated accelerator pedal value for learn functionality" SWORD Prc 1 100 -400.0000 399.9878 FORMAT "%8.4" ECU_ADDRESS 0x60009642 /end MEASUREMENT
/begin MEASUREMENT VMD_stDasRampActv "Status of accped ratio ramp during mode change for driver assistance demand" UBYTE OneToOne 1 100 0.00 1.000 FORMAT "%5.3" ECU_ADDRESS 0x6000FB5E /end MEASUREMENT
/begin MEASUREMENT VMD_stRampActv "Status of accped ratio ramp during mode change" UBYTE OneToOne 1 100 0.00 1.000 FORMAT "%5.3" ECU_ADDRESS 0x6000FB5D /end MEASUREMENT
/begin MEASUREMENT VMD_stRampActvLrn "Status of accped ratio ramp during mode change for learn functionality" UBYTE OneToOne 1 100 0.00 1.000 FORMAT "%5.3" ECU_ADDRESS 0x6000FB5C /end MEASUREMENT
/begin MEASUREMENT VMSI_flgDCSPlusChk "Signal check Plus torque not requested during DCS operations in Disable mode" UBYTE B_TRUE 1 100 0.00 1.00000000000 BIT_MASK 0x1 FORMAT "%13.11" ECU_ADDRESS 0x6000B4DC /end MEASUREMENT
/begin MEASUREMENT VMSI_flgRampShtOffCdnDCS "Flag to indicate the ramp shutoff condition for DCS intervention" UBYTE B_TRUE 1 100 0.00 1.00000000000 BIT_MASK 0x1 FORMAT "%13.11" ECU_ADDRESS 0x6000B4DB /end MEASUREMENT
/begin MEASUREMENT VMSI_flgRampShtOffCdnTCS "Flag to indicate the ramp shutoff condition for TCS intervention" UBYTE B_TRUE 1 100 0.00 1.00000000000 BIT_MASK 0x1 FORMAT "%13.11" ECU_ADDRESS 0x6000B4DA /end MEASUREMENT
/begin MEASUREMENT VMSI_flgShtOffCdnDCS "flag to indicate the shutoff condition for DCS intervention" UBYTE B_TRUE 1 100 0.00 1.00000000000 BIT_MASK 0x1 FORMAT "%13.11" ECU_ADDRESS 0x6000B4D9 /end MEASUREMENT
/begin MEASUREMENT VMSI_flgShtOffCdnTCS "Flag to indicate the shutoff condition for TCS intervention" UBYTE B_TRUE 1 100 0.00 1.00000000000 BIT_MASK 0x1 FORMAT "%13.11" ECU_ADDRESS 0x6000B4D8 /end MEASUREMENT
/begin MEASUREMENT VMSI_stDCSPlusCtrl "DCS torque plus control state" UBYTE OneToOne 1 100 0.00 255.0 FORMAT "%5.1" ECU_ADDRESS 0x6000B4D7 /end MEASUREMENT
/begin MEASUREMENT VMSI_stDCSPlusOK "DCS torque plus control OK flag" UBYTE OneToOne 1 100 0.00 255.0 FORMAT "%5.1" ECU_ADDRESS 0x6000FB5B /end MEASUREMENT
/begin MEASUREMENT VMSI_stDCSPtd "Application parameter for Raising stability intervention from level 1 is not allowed" UBYTE OneToOne 1 100 0.00 255.0 FORMAT "%5.1" ECU_ADDRESS 0x6000FB5A /end MEASUREMENT
/begin MEASUREMENT VMSI_tqCluDesMax "Decreasing torque intervention from stability program (ESP) at clutch level" SWORD Trq 1 100 -3276.800 3276.700 FORMAT "%8.3" ECU_ADDRESS 0x6000963E /end MEASUREMENT
/begin MEASUREMENT VMSI_tqCluLeadMax "Decreasing lead torque intervention from stability program (ESP) at clutch level" SWORD Trq 1 100 -3276.800 3276.700 FORMAT "%8.3" ECU_ADDRESS 0x6000963C /end MEASUREMENT
/begin MEASUREMENT VMSI_tqCluMin "Increasing torque intervention from stability program (ESP) at clutch level" SWORD Trq 1 100 -3276.800 3276.700 FORMAT "%8.3" ECU_ADDRESS 0x6000963A /end MEASUREMENT
/begin MEASUREMENT VMSI_tqDCSRampOut_MP "Measuring point for the ramp output of the shutdown ramp of increasing stability intervention" SLONG TrqPrpHigh 1 100 -214748364.800 214748364.700 FORMAT "%13.3" ECU_ADDRESS 0x70009FF4 /end MEASUREMENT
/begin MEASUREMENT VMSI_tqTCSRampOut_MP "Measuring point for the ramp output of the cut-off ramp of the decreasing stability intervention" SLONG TrqPrpHigh 1 100 -214748364.800 214748364.700 FORMAT "%13.3" ECU_ADDRESS 0x70009FF0 /end MEASUREMENT
/begin MEASUREMENT VMSI_trqDesMax "Decreasing torque intervention by stability program" SLONG TrqPrpHigh 1 100 -50000.0000000 50000.0000000 FORMAT "%13.7" ECU_ADDRESS 0x5000503C /end MEASUREMENT
/begin MEASUREMENT VMSI_trqLeadMax "Decreasing lead torque intervention by stability program" SLONG TrqPrpHigh 1 100 -50000.0000000 50000.0000000 FORMAT "%13.7" ECU_ADDRESS 0x6000394C /end MEASUREMENT
/begin MEASUREMENT VMSI_trqMin "Increasing torque intervention by stability program" SLONG TrqPrpHigh 1 100 -50000.0000000 50000.0000000 FORMAT "%13.7" ECU_ADDRESS 0x50005040 /end MEASUREMENT
/begin MEASUREMENT VMSI_trqMinLowrLim "Increasing torque intervention by stability program lower limit" SLONG TrqPrpHigh 1 100 -50000.0000000 50000.0000000 FORMAT "%13.7" ECU_ADDRESS 0x60001BC8 /end MEASUREMENT
/begin FUNCTION UEGO_UNernstCtrl "1.16.0    UEGO Nernst voltage setpoint determination"
 /begin DEF_CHARACTERISTIC UEGO_stUNernstCtrl_C UEGO_tiDlyDeltaUn_C UEGO_tiRegResendTmr_C UEGO_tiUPhyRawFilConLrg_C UEGO_tiUPhyRawFilConSml_C UEGO_tUNernstSafeModHysDelta_C UEGO_tUNernstSafeModHysDi_C UEGO_uDeltaUn_C UEGO_uPhyRawDeltaFilThd_C UEGO_uUNernstSafe_C UEGO_uUNernstStd_C UEGO_uUNernstStopPhaSafe_C UEGO_uUNernstDiagFilMaxIni_C UEGO_uUNernstEntryDeltaLowrMaxThd_C UEGO_uUNernstEntryDeltaUpprMaxThd_C UEGO_uUNernstExDeltaLowrMaxThd_C UEGO_uUNernstExDeltaUpprMaxThd_C /end DEF_CHARACTERISTIC
 /begin IN_MEASUREMENT UEGO_DataSplyClsS1B1_I.flgCj135An UEGO_DataSplyClsS1B1_I.flgDACOff UEGO_DataSplyClsS1B1_I.flgErrSpiRamRet UEGO_DataSplyClsS1B1_I.flgFKal1Vld UEGO_DataSplyClsS1B1_I.flgFKal2Vld UEGO_DataSplyClsS1B1_I.flgFKal3Vld UEGO_DataSplyClsS1B1_I.flgIPmpActvd UEGO_DataSplyClsS1B1_I.flgISQrA UEGO_DataSplyClsS1B1_I.flgISQrE UEGO_DataSplyClsS1B1_I.flgLCURR UEGO_DataSplyClsS1B1_I.flgLNMeas UEGO_DataSplyClsS1B1_I.flgLPMeas UEGO_DataSplyClsS1B1_I.flgLoupeCAL UEGO_DataSplyClsS1B1_I.flgLoupeG0 UEGO_DataSplyClsS1B1_I.flgLstPckAbort UEGO_DataSplyClsS1B1_I.flgMKA UEGO_DataSplyClsS1B1_I.flgMKE UEGO_DataSplyClsS1B1_I.flgNewIPmpDacPckAry UEGO_DataSplyClsS1B1_I.flgNewIPmpOK UEGO_DataSplyClsS1B1_I.flgNewIPmpPckAry UEGO_DataSplyClsS1B1_I.flgNewIPmpTM UEGO_DataSplyClsS1B1_I.flgNewPck UEGO_DataSplyClsS1B1_I.flgNewPckCstnc UEGO_DataSplyClsS1B1_I.flgNewPckMiss UEGO_DataSplyClsS1B1_I.flgNewPckVld UEGO_DataSplyClsS1B1_I.flgNewTiPck UEGO_DataSplyClsS1B1_I.flgNewURmVG4MeasAryVld UEGO_DataSplyClsS1B1_I.flgNewUa2Pck UEGO_DataSplyClsS1B1_I.flgNewUa31Pck UEGO_DataSplyClsS1B1_I.flgNewUa32Pck UEGO_DataSplyClsS1B1_I.flgNewUa33Pck UEGO_DataSplyClsS1B1_I.flgNewUamPck UEGO_DataSplyClsS1B1_I.flgNewUapePck UEGO_DataSplyClsS1B1_I.flgNewUcalMaxPck UEGO_DataSplyClsS1B1_I.flgNewUcalPck UEGO_DataSplyClsS1B1_I.flgNewUg0Pck UEGO_DataSplyClsS1B1_I.flgNewUg0PckAry UEGO_DataSplyClsS1B1_I.flgNewUg0aPck UEGO_DataSplyClsS1B1_I.flgNewUg0ePck UEGO_DataSplyClsS1B1_I.flgNewUg0iPck UEGO_DataSplyClsS1B1_I.flgNewUg0iPckAry UEGO_DataSplyClsS1B1_I.flgNewUg0iaiPck UEGO_DataSplyClsS1B1_I.flgNewUg0ieiPck UEGO_DataSplyClsS1B1_I.flgNewUg0ix7PckAry UEGO_DataSplyClsS1B1_I.flgNewUg0ix9PckAry UEGO_DataSplyClsS1B1_I.flgNewUg0ixPckAry UEGO_DataSplyClsS1B1_I.flgNewUg0mPck UEGO_DataSplyClsS1B1_I.flgNewUgaPck UEGO_DataSplyClsS1B1_I.flgNewUgiPckAry UEGO_DataSplyClsS1B1_I.flgNewUgkAvrgPck UEGO_DataSplyClsS1B1_I.flgNewUguaPck UEGO_DataSplyClsS1B1_I.flgNewUguaZ2Pck UEGO_DataSplyClsS1B1_I.flgNewUguiPck UEGO_DataSplyClsS1B1_I.flgNewUguiZ1Pck UEGO_DataSplyClsS1B1_I.flgNewUi21PckAry UEGO_DataSplyClsS1B1_I.flgNewUi22Pck UEGO_DataSplyClsS1B1_I.flgNewUi23Pck UEGO_DataSplyClsS1B1_I.flgNewUi24Pck UEGO_DataSplyClsS1B1_I.flgNewUi4Pck UEGO_DataSplyClsS1B1_I.flgNewUi4Z2Pck UEGO_DataSplyClsS1B1_I.flgNewUigPckAry UEGO_DataSplyClsS1B1_I.flgNewUigmkPckAry UEGO_DataSplyClsS1B1_I.flgNewUipcalAvrgPck UEGO_DataSplyClsS1B1_I.flgNewUn0Pck UEGO_DataSplyClsS1B1_I.flgNewUn0Pck4Ary UEGO_DataSplyClsS1B1_I.flgNewUn0Pck5Ary UEGO_DataSplyClsS1B1_I.flgNewUn0PckAry UEGO_DataSplyClsS1B1_I.flgNewUnPckAry UEGO_DataSplyClsS1B1_I.flgNewUnSetPck UEGO_DataSplyClsS1B1_I.flgNewUnx3PckAry UEGO_DataSplyClsS1B1_I.flgNewUnx4PckAry UEGO_DataSplyClsS1B1_I.flgNewUp0Pck UEGO_DataSplyClsS1B1_I.flgNewUp0Pck4 UEGO_DataSplyClsS1B1_I.flgNewUp0Pck5Ary UEGO_DataSplyClsS1B1_I.flgNewUp0PckAry UEGO_DataSplyClsS1B1_I.flgNewUpPckAry UEGO_DataSplyClsS1B1_I.flgNewUpx3PckAry UEGO_DataSplyClsS1B1_I.flgNewUpx4PckAry UEGO_DataSplyClsS1B1_I.flgNewUriaPckVld UEGO_DataSplyClsS1B1_I.flgNewUriePckAry UEGO_DataSplyClsS1B1_I.flgNewUx6PckAry UEGO_DataSplyClsS1B1_I.flgNewUx7PckAry UEGO_DataSplyClsS1B1_I.flgNewUx8PckAry UEGO_DataSplyClsS1B1_I.flgNewUx9PckAry UEGO_DataSplyClsS1B1_I.flgNewUxPckAry UEGO_DataSplyClsS1B1_I.flgReStable UEGO_DataSplyClsS1B1_I.flgSngCell UEGO_DataSplyClsS1B1_I.flgUical0Vld UEGO_DataSplyClsS1B1_I.flgUicalVld UEGO_DataSplyClsS1B1_I.flgUoffipe1Vld UEGO_DataSplyClsS1B1_I.flgUoffipe2Vld UEGO_DataSplyClsS1B1_I.flgUoffipe3Vld UEGO_DataSplyClsS1B1_I.flgUoffvcc1Vld UEGO_DataSplyClsS1B1_I.flgUoffvcc2Vld UEGO_DataSplyClsS1B1_I.flgUoffvcc3Vld UEGO_DataSplyClsS1B1_I.flgUriaMeas UEGO_DataSplyClsS1B1_I.nrIPmpDacPckAry UEGO_DataSplyClsS1B1_I.nrIpPckAry UEGO_DataSplyClsS1B1_I.nrModeMeas UEGO_DataSplyClsS1B1_I.nrRamFailPosn UEGO_DataSplyClsS1B1_I.nrRamMod UEGO_DataSplyClsS1B1_I.nrRamRegMod UEGO_DataSplyClsS1B1_I.nrRamSts1 UEGO_DataSplyClsS1B1_I.nrRamSts2 UEGO_DataSplyClsS1B1_I.nrRamSts3 UEGO_DataSplyClsS1B1_I.nrURmVG4PckAry UEGO_DataSplyClsS1B1_I.nrUa2PckAry UEGO_DataSplyClsS1B1_I.nrUcalMaxCorrd UEGO_DataSplyClsS1B1_I.nrUg0PckAry UEGO_DataSplyClsS1B1_I.nrUg0iPckAry UEGO_DataSplyClsS1B1_I.nrUg0ix7PckAry UEGO_DataSplyClsS1B1_I.nrUg0ix9PckAry UEGO_DataSplyClsS1B1_I.nrUg0ixPckAry UEGO_DataSplyClsS1B1_I.nrUgaPckAry UEGO_DataSplyClsS1B1_I.nrUgiPckAry UEGO_DataSplyClsS1B1_I.nrUi21PckAry UEGO_DataSplyClsS1B1_I.nrUical0PckCorrd UEGO_DataSplyClsS1B1_I.nrUicalPckCorrd UEGO_DataSplyClsS1B1_I.nrUigPckAry UEGO_DataSplyClsS1B1_I.nrUigmkPckAry UEGO_DataSplyClsS1B1_I.nrUn0Pck4Ary UEGO_DataSplyClsS1B1_I.nrUn0Pck5Ary UEGO_DataSplyClsS1B1_I.nrUn0PckAry UEGO_DataSplyClsS1B1_I.nrUnPckAry UEGO_DataSplyClsS1B1_I.nrUnx3PckAry UEGO_DataSplyClsS1B1_I.nrUnx4PckAry UEGO_DataSplyClsS1B1_I.nrUoffipe1 UEGO_DataSplyClsS1B1_I.nrUoffipe2 UEGO_DataSplyClsS1B1_I.nrUoffipe3 UEGO_DataSplyClsS1B1_I.nrUoffvcc1 UEGO_DataSplyClsS1B1_I.nrUoffvcc2 UEGO_DataSplyClsS1B1_I.nrUoffvcc3 UEGO_DataSplyClsS1B1_I.nrUp0Pck5Ary UEGO_DataSplyClsS1B1_I.nrUp0PckAry UEGO_DataSplyClsS1B1_I.nrUpPckAry UEGO_DataSplyClsS1B1_I.nrUpx3PckAry UEGO_DataSplyClsS1B1_I.nrUpx4PckAry UEGO_DataSplyClsS1B1_I.nrUriePckAry UEGO_DataSplyClsS1B1_I.nrUx6PckAry UEGO_DataSplyClsS1B1_I.nrUx7PckAry UEGO_DataSplyClsS1B1_I.nrUx8PckAry UEGO_DataSplyClsS1B1_I.nrUx9PckAry UEGO_DataSplyClsS1B1_I.nrUxPckAry UEGO_DataSplyClsS1B1_I.stIPmpOK UEGO_DataSplyClsS1B1_I.stIPmpTM UEGO_DataSplyClsS1B1_I.stIPmpTM2L UEGO_DataSplyClsS1B1_I.stIPmpTM2R UEGO_DataSplyClsS1B1_I.stLsmRetValMod UEGO_DataSplyClsS1B1_I.stMKMeas UEGO_DataSplyClsS1B1_I.stOFFMeas UEGO_DataSplyClsS1B1_I.stOPTMeas UEGO_DataSplyClsS1B1_I.stREFMeas UEGO_DataSplyClsS1B1_I.stUa2PckAry UEGO_DataSplyClsS1B1_I.stUa2Z1PckAry UEGO_DataSplyClsS1B1_I.stUg0iPckAry UEGO_DataSplyClsS1B1_I.stUg0ix7IActvPckAry UEGO_DataSplyClsS1B1_I.stUg0ix7PmpIActvPckAry UEGO_DataSplyClsS1B1_I.stUg0ix9IActvPckAry UEGO_DataSplyClsS1B1_I.stUg0ix9PmpIActvPckAry UEGO_DataSplyClsS1B1_I.stUg0ixIActvPckAry UEGO_DataSplyClsS1B1_I.stUg0ixPmpIActvPckAry UEGO_DataSplyClsS1B1_I.stUi21PckAry UEGO_DataSplyClsS1B1_I.stUi21Z1PckAry UEGO_DataSplyClsS1B1_I.stUigmkNernstIActvPckAry UEGO_DataSplyClsS1B1_I.stUigmkPmpIActvPckAry UEGO_DataSplyClsS1B1_I.stUn0PckAry UEGO_DataSplyClsS1B1_I.stUn0Z2PckAry UEGO_DataSplyClsS1B1_I.stUnPckAry UEGO_DataSplyClsS1B1_I.stUnx3IActvAcrsNernstCellPckAry UEGO_DataSplyClsS1B1_I.stUnx3IActvAcrsPmpCellPckAry UEGO_DataSplyClsS1B1_I.stUnx4IActvAcrsNernstCellPckAry UEGO_DataSplyClsS1B1_I.stUnx4IActvAcrsPmpCellPckAry UEGO_DataSplyClsS1B1_I.stUp0PckAry UEGO_DataSplyClsS1B1_I.stUp0Z2PckAry UEGO_DataSplyClsS1B1_I.stUpPckAry UEGO_DataSplyClsS1B1_I.stUpZ2PckAry UEGO_DataSplyClsS1B1_I.stUpx3IActvAcrsNernstCellPckAry UEGO_DataSplyClsS1B1_I.stUpx3IActvAcrsPmpCellPckAry UEGO_DataSplyClsS1B1_I.stUpx4IActvAcrsNernstCellPckAry UEGO_DataSplyClsS1B1_I.stUpx4IActvAcrsPmpCellPckAry UEGO_DataSplyClsS1B1_I.stUriePckAry UEGO_DataSplyClsS1B1_I.stUx6IActvPckAry UEGO_DataSplyClsS1B1_I.stUx6MeasAcrsPmpCellPckAry UEGO_DataSplyClsS1B1_I.stUx7IActvPckAry UEGO_DataSplyClsS1B1_I.stUx7MeasAcrsPmpCellPckAry UEGO_DataSplyClsS1B1_I.stUx8IActvPckAry UEGO_DataSplyClsS1B1_I.stUx8MeasAcrsPmpCellPckAry UEGO_DataSplyClsS1B1_I.stUx9IActvPckAry UEGO_DataSplyClsS1B1_I.stUx9MeasAcrsPmpCellPckAry UEGO_DataSplyClsS1B1_I.stUxIActvPckAry UEGO_DataSplyClsS1B1_I.stUxMeasAcrsPmpCell UEGO_DataSplyClsS1B1_I.tiUEGOPck UEGO_DataSplyClsS1B1_I.uFkal1 UEGO_DataSplyClsS1B1_I.uFkal2 UEGO_DataSplyClsS1B1_I.uFkal3 UEGO_DataSplyClsS1B1_I.uUCalPck UEGO_DataSplyClsS1B1_I.uUa31Pck UEGO_DataSplyClsS1B1_I.uUa32Pck UEGO_DataSplyClsS1B1_I.uUa33Pck UEGO_DataSplyClsS1B1_I.uUamPck UEGO_DataSplyClsS1B1_I.uUapePck UEGO_DataSplyClsS1B1_I.uUcalMaxPck UEGO_DataSplyClsS1B1_I.uUg0Pck UEGO_DataSplyClsS1B1_I.uUg0aPck UEGO_DataSplyClsS1B1_I.uUg0ePck UEGO_DataSplyClsS1B1_I.uUg0iPck UEGO_DataSplyClsS1B1_I.uUg0iaiPck UEGO_DataSplyClsS1B1_I.uUg0ieiPck UEGO_DataSplyClsS1B1_I.uUg0mPck UEGO_DataSplyClsS1B1_I.uUgkAvrgPck UEGO_DataSplyClsS1B1_I.uUguaPck UEGO_DataSplyClsS1B1_I.uUguaZ2Pck UEGO_DataSplyClsS1B1_I.uUguiPck UEGO_DataSplyClsS1B1_I.uUguiZ1Pck UEGO_DataSplyClsS1B1_I.uUi22Pck UEGO_DataSplyClsS1B1_I.uUi23Pck UEGO_DataSplyClsS1B1_I.uUi24Pck UEGO_DataSplyClsS1B1_I.uUi4Pck UEGO_DataSplyClsS1B1_I.uUi4Z2Pck UEGO_DataSplyClsS1B1_I.uUipcalAvrgPck UEGO_DataSplyClsS1B1_I.uUn0Pck UEGO_DataSplyClsS1B1_I.uUnSet UEGO_DataSplyClsS1B1_I.uUp0Pck UEGO_DataSplyClsS1B1_I.uUp0Pck4 UEGO_DataSplyClsS1B1_I.uUriaPck UEGO_DataSplyClsS1B1_I.uVCC1Corrd UEGO_DataSplyClsS1B1_I.uVCC3Ref UEGO_flgCJ135AnS1B1 UEGO_flgCmbEngTmpStop UEGO_flgDeltaUnVldS1B1 UEGO_flgDiagSigWireOlRstS1B1 UEGO_flgDiagSigWireScRstS1B1 UEGO_flgSysSuprtdS1B1 UEGO_flgTCeramicVldS1B1 UEGO_RegSetS1B1_I.cntrRegSet UEGO_RegSetS1B1_I.flgCJ135An UEGO_RegSetS1B1_I.flgConvVld UEGO_RegSetS1B1_I.flgIPmpDes UEGO_RegSetS1B1_I.flgIPmpPhyRels UEGO_RegSetS1B1_I.flgIniFinshd UEGO_RegSetS1B1_I.flgLoupeCURRDes UEGO_RegSetS1B1_I.flgLoupeDACDes UEGO_RegSetS1B1_I.flgLoupeNDes UEGO_RegSetS1B1_I.flgLoupePDes UEGO_RegSetS1B1_I.flgNewReq UEGO_RegSetS1B1_I.flgRegSetSt UEGO_RegSetS1B1_I.flgRegSetStVld UEGO_RegSetS1B1_I.flgReqAcptd UEGO_RegSetS1B1_I.flgSetRegOk UEGO_RegSetS1B1_I.flgTakeDataOk UEGO_RegSetS1B1_I.idxChp UEGO_RegSetS1B1_I.nrIdleSubMode UEGO_RegSetS1B1_I.nrModDes UEGO_RegSetS1B1_I.nrNormSubMode UEGO_RegSetS1B1_I.nrRegSet UEGO_RegSetS1B1_I.nrSubModDes UEGO_RegSetS1B1_I.nrSwtOnSubMode UEGO_RegSetS1B1_I.nrTrmSq UEGO_RegSetS1B1_I.nrWrmUpSubMode UEGO_RegSetS1B1_I.stRegSet UEGO_RegSetS1B1_I.stRegSetVld UEGO_RegSetS1B1_I.tmpVar UEGO_tCeramicS1B1 UEGO_uDeltaUnS1B1 UEGO_uUn0PckAryS1B1 /end IN_MEASUREMENT
 /begin OUT_MEASUREMENT UEGO_flgUNernstDiagVldS1B1 UEGO_flgUNernstInRngS1B1 UEGO_flgUNernstVldS1B1 UEGO_uUNernstDiagS1B1 UEGO_uUNernstPhyDesS1B1 UEGO_uUNernstS1B1 /end OUT_MEASUREMENT
 /begin LOC_MEASUREMENT UEGO_UNernstCtrlS1B1_I.flgDeltaUnErr UEGO_UNernstCtrlS1B1_I.flgIniFinshd UEGO_UNernstCtrlS1B1_I.flgLoT UEGO_UNernstCtrlS1B1_I.flgLoupNDesOld UEGO_UNernstCtrlS1B1_I.flgSetRegUnCtrlOk UEGO_UNernstCtrlS1B1_I.flgStopPhaSafe UEGO_UNernstCtrlS1B1_I.nrModInt UEGO_UNernstCtrlS1B1_I.nrModIntOld UEGO_UNernstCtrlS1B1_I.nrUnSetDig UEGO_UNernstCtrlS1B1_I.tiPT1FilCon UEGO_UNernstCtrlS1B1_I.uPhyDes UEGO_UNernstCtrlS1B1_I.uPhyRaw UEGO_UNernstCtrlS1B1_I.uPhyRawDelta UEGO_UNernstCtrlS1B1_I.RegResendTmrTR_I.timeCounter UEGO_UNernstCtrlS1B1_I.UEGO_uPhyRawLT_I.memory UEGO_UNernstCtrlS1B1_I.flgDeltaUnExcddTOFFV_I.outbit UEGO_UNernstCtrlS1B1_I.flgDeltaUnExcddTOFFV_I.time UEGO_UNernstCtrlS1B1_I.flgDeltaUnExcddTONV_I.outbit UEGO_UNernstCtrlS1B1_I.flgDeltaUnExcddTONV_I.time UEGO_UNernstEvlnS1B1_I.flgUNernstDiagVld UEGO_UNernstEvlnS1B1_I.flgUNernstInRng UEGO_UNernstEvlnS1B1_I.flgUNernstVld UEGO_UNernstEvlnS1B1_I.uUNernst UEGO_UNernstEvlnS1B1_I.uUNernstDiag UEGO_UNernstEvlnS1B1_I.uUNernstDiagFilOld UEGO_UNernstEvlnS1B1_I.uUNernstEntryLowrDelta UEGO_UNernstEvlnS1B1_I.uUNernstEntryUpprDelta UEGO_UNernstEvlnS1B1_I.uUNernstExLowrDelta UEGO_UNernstEvlnS1B1_I.uUNernstExUpprDelta UEGO_UNernstEvlnS1B1_I.uUnPckAryDiagFilNorm UEGO_UNernstEvlnS1B1_I.uUNernstPeakFil_I.flgFilStrtd UEGO_UNernstEvlnS1B1_I.uUNernstPeakFil_I.uDeltaInOutpMax /end LOC_MEASUREMENT
 FUNCTION_VERSION "1.16.0" /end FUNCTION
/begin FUNCTION UEGO_UPmpLimn "1.19.0    UEGO Pump cell voltage limitation"
 /begin DEF_CHARACTERISTIC UEGO_iIPmpBlckn_C UEGO_nrIPmpBlckn_C UEGO_stUPmpLimn_C UEGO_tiRegReclcUpLimn_C UEGO_tiUPmpLimnHys_C UEGO_uUPmpLimnHys_C UEGO_uUPmpLimnLean_C UEGO_uUPmpLimnRich_C UEGO_facDesUpFltCon_C UEGO_facUpFltCon_C UEGO_nrIPmpNotOKThd_C /end DEF_CHARACTERISTIC
 /begin IN_MEASUREMENT UEGO_DataSplyClsS1B1_I.flgCj135An UEGO_DataSplyClsS1B1_I.flgDACOff UEGO_DataSplyClsS1B1_I.flgErrSpiRamRet UEGO_DataSplyClsS1B1_I.flgFKal1Vld UEGO_DataSplyClsS1B1_I.flgFKal2Vld UEGO_DataSplyClsS1B1_I.flgFKal3Vld UEGO_DataSplyClsS1B1_I.flgIPmpActvd UEGO_DataSplyClsS1B1_I.flgISQrA UEGO_DataSplyClsS1B1_I.flgISQrE UEGO_DataSplyClsS1B1_I.flgLCURR UEGO_DataSplyClsS1B1_I.flgLNMeas UEGO_DataSplyClsS1B1_I.flgLPMeas UEGO_DataSplyClsS1B1_I.flgLoupeCAL UEGO_DataSplyClsS1B1_I.flgLoupeG0 UEGO_DataSplyClsS1B1_I.flgLstPckAbort UEGO_DataSplyClsS1B1_I.flgMKA UEGO_DataSplyClsS1B1_I.flgMKE UEGO_DataSplyClsS1B1_I.flgNewIPmpDacPckAry UEGO_DataSplyClsS1B1_I.flgNewIPmpOK UEGO_DataSplyClsS1B1_I.flgNewIPmpPckAry UEGO_DataSplyClsS1B1_I.flgNewIPmpTM UEGO_DataSplyClsS1B1_I.flgNewPck UEGO_DataSplyClsS1B1_I.flgNewPckCstnc UEGO_DataSplyClsS1B1_I.flgNewPckMiss UEGO_DataSplyClsS1B1_I.flgNewPckVld UEGO_DataSplyClsS1B1_I.flgNewTiPck UEGO_DataSplyClsS1B1_I.flgNewURmVG4MeasAryVld UEGO_DataSplyClsS1B1_I.flgNewUa2Pck UEGO_DataSplyClsS1B1_I.flgNewUa31Pck UEGO_DataSplyClsS1B1_I.flgNewUa32Pck UEGO_DataSplyClsS1B1_I.flgNewUa33Pck UEGO_DataSplyClsS1B1_I.flgNewUamPck UEGO_DataSplyClsS1B1_I.flgNewUapePck UEGO_DataSplyClsS1B1_I.flgNewUcalMaxPck UEGO_DataSplyClsS1B1_I.flgNewUcalPck UEGO_DataSplyClsS1B1_I.flgNewUg0Pck UEGO_DataSplyClsS1B1_I.flgNewUg0PckAry UEGO_DataSplyClsS1B1_I.flgNewUg0aPck UEGO_DataSplyClsS1B1_I.flgNewUg0ePck UEGO_DataSplyClsS1B1_I.flgNewUg0iPck UEGO_DataSplyClsS1B1_I.flgNewUg0iPckAry UEGO_DataSplyClsS1B1_I.flgNewUg0iaiPck UEGO_DataSplyClsS1B1_I.flgNewUg0ieiPck UEGO_DataSplyClsS1B1_I.flgNewUg0ix7PckAry UEGO_DataSplyClsS1B1_I.flgNewUg0ix9PckAry UEGO_DataSplyClsS1B1_I.flgNewUg0ixPckAry UEGO_DataSplyClsS1B1_I.flgNewUg0mPck UEGO_DataSplyClsS1B1_I.flgNewUgaPck UEGO_DataSplyClsS1B1_I.flgNewUgiPckAry UEGO_DataSplyClsS1B1_I.flgNewUgkAvrgPck UEGO_DataSplyClsS1B1_I.flgNewUguaPck UEGO_DataSplyClsS1B1_I.flgNewUguaZ2Pck UEGO_DataSplyClsS1B1_I.flgNewUguiPck UEGO_DataSplyClsS1B1_I.flgNewUguiZ1Pck UEGO_DataSplyClsS1B1_I.flgNewUi21PckAry UEGO_DataSplyClsS1B1_I.flgNewUi22Pck UEGO_DataSplyClsS1B1_I.flgNewUi23Pck UEGO_DataSplyClsS1B1_I.flgNewUi24Pck UEGO_DataSplyClsS1B1_I.flgNewUi4Pck UEGO_DataSplyClsS1B1_I.flgNewUi4Z2Pck UEGO_DataSplyClsS1B1_I.flgNewUigPckAry UEGO_DataSplyClsS1B1_I.flgNewUigmkPckAry UEGO_DataSplyClsS1B1_I.flgNewUipcalAvrgPck UEGO_DataSplyClsS1B1_I.flgNewUn0Pck UEGO_DataSplyClsS1B1_I.flgNewUn0Pck4Ary UEGO_DataSplyClsS1B1_I.flgNewUn0Pck5Ary UEGO_DataSplyClsS1B1_I.flgNewUn0PckAry UEGO_DataSplyClsS1B1_I.flgNewUnPckAry UEGO_DataSplyClsS1B1_I.flgNewUnSetPck UEGO_DataSplyClsS1B1_I.flgNewUnx3PckAry UEGO_DataSplyClsS1B1_I.flgNewUnx4PckAry UEGO_DataSplyClsS1B1_I.flgNewUp0Pck UEGO_DataSplyClsS1B1_I.flgNewUp0Pck4 UEGO_DataSplyClsS1B1_I.flgNewUp0Pck5Ary UEGO_DataSplyClsS1B1_I.flgNewUp0PckAry UEGO_DataSplyClsS1B1_I.flgNewUpPckAry UEGO_DataSplyClsS1B1_I.flgNewUpx3PckAry UEGO_DataSplyClsS1B1_I.flgNewUpx4PckAry UEGO_DataSplyClsS1B1_I.flgNewUriaPckVld UEGO_DataSplyClsS1B1_I.flgNewUriePckAry UEGO_DataSplyClsS1B1_I.flgNewUx6PckAry UEGO_DataSplyClsS1B1_I.flgNewUx7PckAry UEGO_DataSplyClsS1B1_I.flgNewUx8PckAry UEGO_DataSplyClsS1B1_I.flgNewUx9PckAry UEGO_DataSplyClsS1B1_I.flgNewUxPckAry UEGO_DataSplyClsS1B1_I.flgReStable UEGO_DataSplyClsS1B1_I.flgSngCell UEGO_DataSplyClsS1B1_I.flgUical0Vld UEGO_DataSplyClsS1B1_I.flgUicalVld UEGO_DataSplyClsS1B1_I.flgUoffipe1Vld UEGO_DataSplyClsS1B1_I.flgUoffipe2Vld UEGO_DataSplyClsS1B1_I.flgUoffipe3Vld UEGO_DataSplyClsS1B1_I.flgUoffvcc1Vld UEGO_DataSplyClsS1B1_I.flgUoffvcc2Vld UEGO_DataSplyClsS1B1_I.flgUoffvcc3Vld UEGO_DataSplyClsS1B1_I.flgUriaMeas UEGO_DataSplyClsS1B1_I.nrIPmpDacPckAry UEGO_DataSplyClsS1B1_I.nrIpPckAry UEGO_DataSplyClsS1B1_I.nrModeMeas UEGO_DataSplyClsS1B1_I.nrRamFailPosn UEGO_DataSplyClsS1B1_I.nrRamMod UEGO_DataSplyClsS1B1_I.nrRamRegMod UEGO_DataSplyClsS1B1_I.nrRamSts1 UEGO_DataSplyClsS1B1_I.nrRamSts2 UEGO_DataSplyClsS1B1_I.nrRamSts3 UEGO_DataSplyClsS1B1_I.nrURmVG4PckAry UEGO_DataSplyClsS1B1_I.nrUa2PckAry UEGO_DataSplyClsS1B1_I.nrUcalMaxCorrd UEGO_DataSplyClsS1B1_I.nrUg0PckAry UEGO_DataSplyClsS1B1_I.nrUg0iPckAry UEGO_DataSplyClsS1B1_I.nrUg0ix7PckAry UEGO_DataSplyClsS1B1_I.nrUg0ix9PckAry UEGO_DataSplyClsS1B1_I.nrUg0ixPckAry UEGO_DataSplyClsS1B1_I.nrUgaPckAry UEGO_DataSplyClsS1B1_I.nrUgiPckAry UEGO_DataSplyClsS1B1_I.nrUi21PckAry UEGO_DataSplyClsS1B1_I.nrUical0PckCorrd UEGO_DataSplyClsS1B1_I.nrUicalPckCorrd UEGO_DataSplyClsS1B1_I.nrUigPckAry UEGO_DataSplyClsS1B1_I.nrUigmkPckAry UEGO_DataSplyClsS1B1_I.nrUn0Pck4Ary UEGO_DataSplyClsS1B1_I.nrUn0Pck5Ary UEGO_DataSplyClsS1B1_I.nrUn0PckAry UEGO_DataSplyClsS1B1_I.nrUnPckAry UEGO_DataSplyClsS1B1_I.nrUnx3PckAry UEGO_DataSplyClsS1B1_I.nrUnx4PckAry UEGO_DataSplyClsS1B1_I.nrUoffipe1 UEGO_DataSplyClsS1B1_I.nrUoffipe2 UEGO_DataSplyClsS1B1_I.nrUoffipe3 UEGO_DataSplyClsS1B1_I.nrUoffvcc1 UEGO_DataSplyClsS1B1_I.nrUoffvcc2 UEGO_DataSplyClsS1B1_I.nrUoffvcc3 UEGO_DataSplyClsS1B1_I.nrUp0Pck5Ary UEGO_DataSplyClsS1B1_I.nrUp0PckAry UEGO_DataSplyClsS1B1_I.nrUpPckAry UEGO_DataSplyClsS1B1_I.nrUpx3PckAry UEGO_DataSplyClsS1B1_I.nrUpx4PckAry UEGO_DataSplyClsS1B1_I.nrUriePckAry UEGO_DataSplyClsS1B1_I.nrUx6PckAry UEGO_DataSplyClsS1B1_I.nrUx7PckAry UEGO_DataSplyClsS1B1_I.nrUx8PckAry UEGO_DataSplyClsS1B1_I.nrUx9PckAry UEGO_DataSplyClsS1B1_I.nrUxPckAry UEGO_DataSplyClsS1B1_I.stIPmpOK UEGO_DataSplyClsS1B1_I.stIPmpTM UEGO_DataSplyClsS1B1_I.stIPmpTM2L UEGO_DataSplyClsS1B1_I.stIPmpTM2R UEGO_DataSplyClsS1B1_I.stLsmRetValMod UEGO_DataSplyClsS1B1_I.stMKMeas UEGO_DataSplyClsS1B1_I.stOFFMeas UEGO_DataSplyClsS1B1_I.stOPTMeas UEGO_DataSplyClsS1B1_I.stREFMeas UEGO_DataSplyClsS1B1_I.stUa2PckAry UEGO_DataSplyClsS1B1_I.stUa2Z1PckAry UEGO_DataSplyClsS1B1_I.stUg0iPckAry UEGO_DataSplyClsS1B1_I.stUg0ix7IActvPckAry UEGO_DataSplyClsS1B1_I.stUg0ix7PmpIActvPckAry UEGO_DataSplyClsS1B1_I.stUg0ix9IActvPckAry UEGO_DataSplyClsS1B1_I.stUg0ix9PmpIActvPckAry UEGO_DataSplyClsS1B1_I.stUg0ixIActvPckAry UEGO_DataSplyClsS1B1_I.stUg0ixPmpIActvPckAry UEGO_DataSplyClsS1B1_I.stUi21PckAry UEGO_DataSplyClsS1B1_I.stUi21Z1PckAry UEGO_DataSplyClsS1B1_I.stUigmkNernstIActvPckAry UEGO_DataSplyClsS1B1_I.stUigmkPmpIActvPckAry UEGO_DataSplyClsS1B1_I.stUn0PckAry UEGO_DataSplyClsS1B1_I.stUn0Z2PckAry UEGO_DataSplyClsS1B1_I.stUnPckAry UEGO_DataSplyClsS1B1_I.stUnx3IActvAcrsNernstCellPckAry UEGO_DataSplyClsS1B1_I.stUnx3IActvAcrsPmpCellPckAry UEGO_DataSplyClsS1B1_I.stUnx4IActvAcrsNernstCellPckAry UEGO_DataSplyClsS1B1_I.stUnx4IActvAcrsPmpCellPckAry UEGO_DataSplyClsS1B1_I.stUp0PckAry UEGO_DataSplyClsS1B1_I.stUp0Z2PckAry UEGO_DataSplyClsS1B1_I.stUpPckAry UEGO_DataSplyClsS1B1_I.stUpZ2PckAry UEGO_DataSplyClsS1B1_I.stUpx3IActvAcrsNernstCellPckAry UEGO_DataSplyClsS1B1_I.stUpx3IActvAcrsPmpCellPckAry UEGO_DataSplyClsS1B1_I.stUpx4IActvAcrsNernstCellPckAry UEGO_DataSplyClsS1B1_I.stUpx4IActvAcrsPmpCellPckAry UEGO_DataSplyClsS1B1_I.stUriePckAry UEGO_DataSplyClsS1B1_I.stUx6IActvPckAry UEGO_DataSplyClsS1B1_I.stUx6MeasAcrsPmpCellPckAry UEGO_DataSplyClsS1B1_I.stUx7IActvPckAry UEGO_DataSplyClsS1B1_I.stUx7MeasAcrsPmpCellPckAry UEGO_DataSplyClsS1B1_I.stUx8IActvPckAry UEGO_DataSplyClsS1B1_I.stUx8MeasAcrsPmpCellPckAry UEGO_DataSplyClsS1B1_I.stUx9IActvPckAry UEGO_DataSplyClsS1B1_I.stUx9MeasAcrsPmpCellPckAry UEGO_DataSplyClsS1B1_I.stUxIActvPckAry UEGO_DataSplyClsS1B1_I.stUxMeasAcrsPmpCell UEGO_DataSplyClsS1B1_I.tiUEGOPck UEGO_DataSplyClsS1B1_I.uFkal1 UEGO_DataSplyClsS1B1_I.uFkal2 UEGO_DataSplyClsS1B1_I.uFkal3 UEGO_DataSplyClsS1B1_I.uUCalPck UEGO_DataSplyClsS1B1_I.uUa31Pck UEGO_DataSplyClsS1B1_I.uUa32Pck UEGO_DataSplyClsS1B1_I.uUa33Pck UEGO_DataSplyClsS1B1_I.uUamPck UEGO_DataSplyClsS1B1_I.uUapePck UEGO_DataSplyClsS1B1_I.uUcalMaxPck UEGO_DataSplyClsS1B1_I.uUg0Pck UEGO_DataSplyClsS1B1_I.uUg0aPck UEGO_DataSplyClsS1B1_I.uUg0ePck UEGO_DataSplyClsS1B1_I.uUg0iPck UEGO_DataSplyClsS1B1_I.uUg0iaiPck UEGO_DataSplyClsS1B1_I.uUg0ieiPck UEGO_DataSplyClsS1B1_I.uUg0mPck UEGO_DataSplyClsS1B1_I.uUgkAvrgPck UEGO_DataSplyClsS1B1_I.uUguaPck UEGO_DataSplyClsS1B1_I.uUguaZ2Pck UEGO_DataSplyClsS1B1_I.uUguiPck UEGO_DataSplyClsS1B1_I.uUguiZ1Pck UEGO_DataSplyClsS1B1_I.uUi22Pck UEGO_DataSplyClsS1B1_I.uUi23Pck UEGO_DataSplyClsS1B1_I.uUi24Pck UEGO_DataSplyClsS1B1_I.uUi4Pck UEGO_DataSplyClsS1B1_I.uUi4Z2Pck UEGO_DataSplyClsS1B1_I.uUipcalAvrgPck UEGO_DataSplyClsS1B1_I.uUn0Pck UEGO_DataSplyClsS1B1_I.uUnSet UEGO_DataSplyClsS1B1_I.uUp0Pck UEGO_DataSplyClsS1B1_I.uUp0Pck4 UEGO_DataSplyClsS1B1_I.uUriaPck UEGO_DataSplyClsS1B1_I.uVCC1Corrd UEGO_DataSplyClsS1B1_I.uVCC3Ref UEGO_flgCJ135AnS1B1 UEGO_flgDiagSigSnsrRstS1B1 UEGO_flgIPmpPckVldS1B1 UEGO_flgOPM1GainVldS1B1 UEGO_flgOPM2GainVldS1B1 UEGO_flgOPM3GainVldS1B1 UEGO_flgRNernstVldS1B1 UEGO_flgRPmpVldS1B1 UEGO_flgSysSuprtdS1B1 UEGO_iIPmpPckAryS1B1 UEGO_RegSetS1B1_I.cntrRegSet UEGO_RegSetS1B1_I.flgCJ135An UEGO_RegSetS1B1_I.flgConvVld UEGO_RegSetS1B1_I.flgIPmpDes UEGO_RegSetS1B1_I.flgIPmpPhyRels UEGO_RegSetS1B1_I.flgIniFinshd UEGO_RegSetS1B1_I.flgLoupeCURRDes UEGO_RegSetS1B1_I.flgLoupeDACDes UEGO_RegSetS1B1_I.flgLoupeNDes UEGO_RegSetS1B1_I.flgLoupePDes UEGO_RegSetS1B1_I.flgNewReq UEGO_RegSetS1B1_I.flgRegSetSt UEGO_RegSetS1B1_I.flgRegSetStVld UEGO_RegSetS1B1_I.flgReqAcptd UEGO_RegSetS1B1_I.flgSetRegOk UEGO_RegSetS1B1_I.flgTakeDataOk UEGO_RegSetS1B1_I.idxChp UEGO_RegSetS1B1_I.nrIdleSubMode UEGO_RegSetS1B1_I.nrModDes UEGO_RegSetS1B1_I.nrNormSubMode UEGO_RegSetS1B1_I.nrRegSet UEGO_RegSetS1B1_I.nrSubModDes UEGO_RegSetS1B1_I.nrSwtOnSubMode UEGO_RegSetS1B1_I.nrTrmSq UEGO_RegSetS1B1_I.nrWrmUpSubMode UEGO_RegSetS1B1_I.stRegSet UEGO_RegSetS1B1_I.stRegSetVld UEGO_RegSetS1B1_I.tmpVar UEGO_rRNernstS1B1 UEGO_rRPmpS1B1 UEGO_uOPM1GainS1B1 UEGO_uOPM2GainS1B1 UEGO_uOPM3GainS1B1 UEGO_uUp0PckAryS1B1 /end IN_MEASUREMENT
 /begin OUT_MEASUREMENT UEGO_flgUPmpLimnActvS1B1 UEGO_flgUPmpLimnActvVldS1B1 UEGO_flgUPmpVldS1B1 UEGO_uUPmpS1B1 /end OUT_MEASUREMENT
 /begin LOC_MEASUREMENT UEGO_UPmpLimnCtrlS1B1_I.flgIPmpBlckn UEGO_UPmpLimnCtrlS1B1_I.flgLoupCURRDes UEGO_UPmpLimnCtrlS1B1_I.flgLoupCURRDesOld UEGO_UPmpLimnCtrlS1B1_I.flgLoupPDes UEGO_UPmpLimnCtrlS1B1_I.flgLoupPDesOld UEGO_UPmpLimnCtrlS1B1_I.flgSetReguPmpLimnOk UEGO_UPmpLimnCtrlS1B1_I.nrIPmpBlckn UEGO_UPmpLimnCtrlS1B1_I.nrModInt UEGO_UPmpLimnCtrlS1B1_I.nrModIntOld UEGO_UPmpLimnCtrlS1B1_I.nrRPmp UEGO_UPmpLimnCtrlS1B1_I.nrUPmpLimnHys UEGO_UPmpLimnCtrlS1B1_I.nrUPmpLimnLean UEGO_UPmpLimnCtrlS1B1_I.nrUPmpLimnRich UEGO_UPmpLimnCtrlS1B1_I.RegReclcUpLimnTR_I.timeCounter UEGO_UPmpLimnEvlnS1B1_I.flgUPmpLimnActv UEGO_UPmpLimnEvlnS1B1_I.flgUPmpLimnActvVld UEGO_UPmpLimnEvlnS1B1_I.flgUPmpVld UEGO_UPmpLimnEvlnS1B1_I.nrIPmpNotOKPck UEGO_UPmpLimnEvlnS1B1_I.uUPmp UEGO_UPmpLimnEvlnS1B1_I.uUPmpAvg UEGO_UPmpLimnEvlnS1B1_I.UEGO_uEvlnFilDlydVldy_S16_spg_q3p2Em4.flgFilVldy UEGO_UPmpLimnEvlnS1B1_I.UEGO_uEvlnFilDlydVldy_S16_spg_q3p2Em4.nrSampleCurr UEGO_UPmpLimnEvlnS1B1_I.UEGO_uEvlnFilDlydVldy_S16_spg_q3p2Em4.nrSampleRef UEGO_UPmpLimnEvlnS1B1_I.UEGO_uEvlnFilDlydVldy_S16_spg_q3p2Em4.nrSampleThd UEGO_UPmpLimnEvlnS1B1_I.UEGO_uEvlnFilDlydVldy_S16_spg_q3p2Em4.EvlnFil_DL_I.memory UEGO_uUp0Pck5Dummy UEGO_uUpDummy /end LOC_MEASUREMENT
 FUNCTION_VERSION "1.19.0" /end FUNCTION
/begin FUNCTION VehMot2ME "135.4.1   Interface Adapter VehMot to MED 7/9"
 /begin DEF_CHARACTERISTIC VehMot2ME_CW VehMot2ME_trqAccPed_CUR VF2ME_MRFAVLN_CUR VF2ME_MRMAX_C /end DEF_CHARACTERISTIC
 /begin REF_CHARACTERISTIC MDNORM /end REF_CHARACTERISTIC
 /begin IN_MEASUREMENT AccPed_rTrq AccPed_trqDes APP_r CoVeh_trqAcs CoVMD_trqCrCtl CoVM_bSIActvLead Epm_nEng GlbDa_stTrqDem mimax_w_msg PthSet_stOvrRunEna PT_rTrq PT_trqLos RngMod_trqCrSMax RngMod_trqCrSMin VehMot_rTrqDfftl VehMot_stPrpAccPed VehMot_stPrpCrCtl /end IN_MEASUREMENT
 /begin OUT_MEASUREMENT B_asr_msg B_fgr_msg B_ll_msg B_msr_msg B_vl_msg mivbeb_w_msg mivbeg_w_msg mrfa_w_msg /end OUT_MEASUREMENT
 /begin LOC_MEASUREMENT VehMot_tqWhlMax /end LOC_MEASUREMENT
 FUNCTION_VERSION "135.4.1" /end FUNCTION
/begin FUNCTION VehMot_CalcTrqDrag "37.0.0    Vehicle Motion Drag Torque Calculation"
 /begin DEF_CHARACTERISTIC VehMot_mInrt_C VehMot_tiFastLearn_C VehMot_tiTrqDragMin_C VehMot_tiTrqDragVx_CUR VehMot_tiTrqPrpPT1_C VehMot_trqDragMax_C VehMot_vMinDragEst_C /end DEF_CHARACTERISTIC
 /begin IN_MEASUREMENT ActMod_trqCrS CoVeh_trqAcs GlbDa_aX GlbDa_lWhlCirc GlbDa_vX PT_bGrip PT_bNoGrip PT_rTrq PT_stTraType PT_trqLos RngMod_trqCrSMax RngMod_trqCrSMin VehMot_rTrqDfftl VehMot_stBrkPed VMD_trqDes /end IN_MEASUREMENT
 /begin OUT_MEASUREMENT VehMot_a2trq VehMot_aPrpCurr VehMot_aPrpMax VehMot_aPrpMin VehMot_tiTrqDragPT1 VehMot_trqDrag /end OUT_MEASUREMENT
 /begin LOC_MEASUREMENT VehMot_trqDragEst_mp VehMot_trqPrpFlt_mp VehMot_trqWoComp_mp /end LOC_MEASUREMENT
 FUNCTION_VERSION "37.0.0" /end FUNCTION
/begin FUNCTION VehMot_DSD "233.0.0   Drive State Detection"
 /begin DEF_CHARACTERISTIC VehMot_nEngSpdThd_C VehMot_rAppNegDiff_C VehMot_rAppPosDiff_C VehMot_rAppThd2VehDyn_C VehMot_rAppThd3VehDyn_C VehMot_rAppThdVehDyn_C VehMot_tiAppVartnDly_C VehMot_wThd2rlsol_C VehMot_wThdrlsol_C /end DEF_CHARACTERISTIC
 /begin IN_MEASUREMENT APP_r CoVMD_stLoLimActv CrCtl_stActive Epm_nEng LLim_stActive rlsol_w_msg T15_st VMD_rVirtAPP /end IN_MEASUREMENT
 /begin OUT_MEASUREMENT Veh_flgDyn /end OUT_MEASUREMENT
 /begin LOC_MEASUREMENT VehMot_flgAppVartn VehMot_flgDlyAppVartn VehMot_flgHighLdVehDyn VehMot_rApp VehMot_rAppDiff VehMot_rAppPrev1 VehMot_rAppPrev2 /end LOC_MEASUREMENT
 FUNCTION_VERSION "233.0.0" /end FUNCTION
/begin FUNCTION VehStc_BattUHstg "2.0.0     ECM Battery Voltage Histogram"
 /begin IN_MEASUREMENT AltIO_nEngThdACGFailr AltIO_rAltLoad BattU_stPwrFail Batt_flgDarkIAllwCondA Batt_flgSt1Cmpl Batt_flgSt7Tran Batt_idxRDcyc Batt_qCap20 Batt_qSumHi Batt_qSumLo Batt_rMean Batt_stCalc BdInt_stHoodOpenDurgEngStrt ComAlt_iExctCrnt ComEBS_resMeasdBattROth ComEBS_tiDurAftIgnOff Com_cntrIntResUpd Com_iBattEBS Com_lDst Com_ratSoc Com_stDstMETK Com_stSoc Com_tAirOutside Com_tBattEBS Com_uBattEBS CoVOM_bSSEEngStopPassed CoVOM_bSysOff CoVOM_stSSE Ebs_facRCorrn Ebs_flgBliChrgCalcnCmpl Ebs_flgRst Ebs_qTotBliDcha Ebs_stEbsPlausyChk Ebs_tiT15OnDly Eep_EnvRamHist Eep_EnvRamInvld EngStrt_bFrstStrtEnd EngStrt_bStrtEnd Epm_nEng HdLi_flgActv Linappl_stFrstFrmRxd StSpSwt_st SyC_ctPostDrvLeave T15_st VehV_v /end IN_MEASUREMENT
 /begin OUT_MEASUREMENT VehStc_cntBattSnsrPOR VehStc_cntDcyc VehStc_cntIS VehStc_cntISInhbSwt VehStc_cntISStrtrActvn VehStc_cntJS VehStc_cntSt1Tran VehStc_cntSt4Tran VehStc_cntSt8Tran VehStc_dataAltLoadCmprHstg VehStc_dataAltLoadHstg VehStc_dataDrkDchaDistbn VehStc_dataDurAftIgnOffCmprHstg VehStc_dataDurAftIgnOffHstg VehStc_dataEngOnCmprHstg VehStc_dataEngOnHstg VehStc_dataIBattEBSDurgISCmprHstg VehStc_dataIBattEBSDurgISHstg VehStc_dataIExctCmprHstg VehStc_dataIExctHstg VehStc_dataISDurnCmprHstg VehStc_dataISDurnHstg VehStc_dataRatSocCmprHstg VehStc_dataRatSocHstg VehStc_dataTAirOutdCmprHstg VehStc_dataTAirOutdHstg VehStc_dataTBattEBSCmprHstg VehStc_dataTBattEBSHstg VehStc_dataUBattEBSCmprHstg VehStc_dataUBattEBSDurgISCmprHstg VehStc_dataUBattEBSDurgISHstg VehStc_dataUBattEBSHstg VehStc_dataUnstyDrkDchaIDistbn VehStc_divdAirOutdCmprPrm VehStc_divdAltLoadCmprPrm VehStc_divdDurAftIgnOffCmprPrm VehStc_divdEngOnCmprPrm VehStc_divdIBattEBSDurgISCmprPrm VehStc_divdIExctCmprPrm VehStc_divdISDurnCmprPrm VehStc_divdRatSOCCmprPrm VehStc_divdTBattEBSCmprPrm VehStc_divdUBattEBSCmprPrm VehStc_divdUBattEBSDurgISCmprPrm VehStc_iUBattMinDurgIS VehStc_qBattChrg VehStc_qBattDcha VehStc_ratSOCIgnOffLstDcyc VehStc_ratSOCIgnOnCurrDcyc VehStc_ratSOCIgnOnLstDcyc VehStc_resBattROthMean4Dcyc VehStc_resBattROthMean4DcycHistAry VehStc_rMeanHistAry VehStc_stSOCIgnOffLstDcyc VehStc_stSOCIgnOnCurrDcyc VehStc_stSOCIgnOnLstDcyc VehStc_stSubRcdr VehStc_tBattIgnOffLstDcyc VehStc_tBattIgnOnCurrDcyc VehStc_tBattIgnOnLstDcyc VehStc_tiBattChrg VehStc_tiBattDcha VehStc_tiDrvg VehStc_tiEngOnDurn VehStc_tiHdLiOn VehStc_tiIgnOnDurn VehStc_tiIGPOnDurn VehStc_tiISInhbMod VehStc_tiTotIgnOff VehStc_tiTotIgnOnLstDcyc VehStc_tiTotIS VehStc_uBattMinDurgIS VehStc_uIBattMinDurgIS VehStc_uMinBattEbs /end OUT_MEASUREMENT
 /begin LOC_MEASUREMENT VehStc_cntrBattROth VehStc_cntrBattROthMean VehStc_cntrBattROthMeanOld VehStc_cntrDataAltLoadHstg VehStc_cntrDataDrkDchaDistbn VehStc_cntrDataDurAftIgnOffHstg VehStc_cntrDataEngOnHstg VehStc_cntrDataIBattEBSDurgISHstg VehStc_cntrDataIExctHstg VehStc_cntrDataISDurnHstg VehStc_cntrDataRatSOCHstg VehStc_cntrDataTAirOutdHstg VehStc_cntrDataTBattEBSHstg VehStc_cntrDataUBattEBSDurgISHstg VehStc_cntrDataUBattEBSHstg VehStc_cntrDataUnstyDrkDchaI VehStc_cntrPostDrvLve VehStc_flgBattMngtFailr VehStc_flgBMSTATUS1 VehStc_flgBMSTATUS7 VehStc_flgCalDrkDchaHist VehStc_flgComEna VehStc_flgEnvRamVld VehStc_flgIMonUpdEna VehStc_flgIniProcnJdg VehStc_flgISRstrt VehStc_flgOverWrPrevn3 VehStc_flgOverWrPrevn4 VehStc_flgOverWrPrevn5 VehStc_flgROthMean VehStc_flgSubRcdrBit0 VehStc_flgSubRcdrBit1 VehStc_flgSubRcdrBit2 VehStc_flgUnstyDrkCurrActvnPerms VehStc_flgUnstyDrkIHistOvf VehStc_flgWrRamFaild1 VehStc_flgWrRamFaild10 VehStc_flgWrRamFaild11 VehStc_flgWrRamFaild12 VehStc_flgWrRamFaild13 VehStc_flgWrRamFaild14 VehStc_flgWrRamFaild15 VehStc_flgWrRamFaild16 VehStc_flgWrRamFaild17 VehStc_flgWrRamFaild18 VehStc_flgWrRamFaild19 VehStc_flgWrRamFaild2 VehStc_flgWrRamFaild20 VehStc_flgWrRamFaild21 VehStc_flgWrRamFaild22 VehStc_flgWrRamFaild23 VehStc_flgWrRamFaild24 VehStc_flgWrRamFaild25 VehStc_flgWrRamFaild26 VehStc_flgWrRamFaild27 VehStc_flgWrRamFaild28 VehStc_flgWrRamFaild29 VehStc_flgWrRamFaild3 VehStc_flgWrRamFaild4 VehStc_flgWrRamFaild5 VehStc_flgWrRamFaild6 VehStc_flgWrRamFaild7 VehStc_iBattMinDurgIS VehStc_idxRDcycOld VehStc_qBattChrgSub VehStc_qBattDchaSub VehStc_qBattEBSTmp VehStc_ratDChaAmntPerDay VehStc_ratDchaSOC VehStc_ratIBSUMH VehStc_ratIBSUML VehStc_ratSOCIgnOffLstDcycTmp VehStc_ratSOCIgnOnLstDcycTmp VehStc_resBattROthMean VehStc_resBattROthMeanAry VehStc_resBattROthSum VehStc_resEBSMeasdBattROthOld VehStc_restBattROthTmp VehStc_stBattCalcOld VehStc_stCmprnCalc VehStc_stEEP VehStc_stHoodOpenFirstEngStrt VehStc_stOverWrPrevn1 VehStc_stOverWrPrevn2 VehStc_stRetEep VehStc_stSOCIgnOffLstDcycTmp VehStc_stSOCIgnOnLstDcycTmp VehStc_tBattIgnOffLstDcycTmp VehStc_tBattIgnOnLstDcycTmp VehStc_tiBattChrgSub VehStc_tiBattDchaSub VehStc_tiCurrISDurn VehStc_tiDrvgTiSub VehStc_tiDurAftIgnOff VehStc_tiEngOn VehStc_tiEngOnSubDurn VehStc_tiHdLiOnSub VehStc_tiIgnOnSubDurn VehStc_tiIGPOnSubDurn VehStc_tiInUseDurn VehStc_tiISSubDurn VehStc_tiTotIgnOnLstDcycSub VehStc_tiTotIgnOnLstDcycTmp /end LOC_MEASUREMENT
 FUNCTION_VERSION "2.0.0" /end FUNCTION
/begin FUNCTION VehStc_FuCnsData "2.0.0     Fuel Consumption Data for Vehicle Statistics"
 /begin DEF_CHARACTERISTIC VehStc_nEngHi3000_C VehStc_nEngHi4500_C VehStc_nEngLo1000_C VehStc_nEngLo2000_C VehStc_nEngLowr1000_C VehStc_nEngMed2000_C VehStc_nEngMed3000_C VehStc_nEngSpdThd_C VehStc_nEngTop4500_C VehStc_pIntkHi450_C VehStc_pIntkHi600_C VehStc_pIntkLo_C VehStc_pIntkMed300_C VehStc_pIntkMed450_C VehStc_pIntkTop600_C VehStc_stAutoRstrtEna_C VehStc_stISSOffACMsk_C VehStc_stISSOffATMsk_C VehStc_stISSOffATSlopeMsk_C VehStc_stISSOffBatMsk_C VehStc_stISSOffBrkBoostMsk_C VehStc_stISSOffDCDCMsk_C VehStc_stISSOffPwrSteerMsk_C VehStc_stISSOffTempEngMsk_C VehStc_stISSOffUserMsk_C VehStc_stISSOffvVehMsk_C VehStc_stStalEngReasMsk_C VehStc_tClntThd_C VehStc_tiSSEChgOfMindOff_C VehStc_tiStopTrigDly_C VehStc_volInputSel_C VehStc_vVehZonSeln_C VehStc_vWhlSpdThresHi_C /end DEF_CHARACTERISTIC
 /begin IN_MEASUREMENT BrkPed_flgSwtISABAvl BrkPed_flgVehStandStill B_ll_msg CEngDsT_t CoEng_st CoEng_stStalEngReas Com_stECON Com_stEngHoodOpn Com_stEPSISSInhbReq Com_stSeatBltInfo CoVeh_stEngStrtOrd CoVOM_bChangeOfMind CoVOM_bSSEEngStopPassed CoVOM_bStopDrvReq CoVOM_bStopTraReq CoVOM_bSysOff CoVOM_bVehCdnStopTrig CoVOM_stISGoJud CoVOM_stSSE CoVOM_stStopRelsMask CoVOM_stStopReqCdn CoVOM_stStopReqMask CoVOM_stStopRls CoVOM_stStrtReqBefMsk CoVOM_stStrtReqCluPosn CoVOM_stStrtReqMask Eep_EnvRamInvld Epm_nEng frm_w_msg fzmdzyl_w_msg GlbDa_lTotDst InjSys_volFuConsDrvCyc InjSys_volFuConsDrvCycCAN psr_w_msg PT_stTraType StSpSwt_st T15_st Tra_stEcoLmpIdc TWCD_flgMeasFinB1 TWCD_rDiagRsltB1 VehV_v /end IN_MEASUREMENT
 /begin OUT_MEASUREMENT VehStc_flgRstrtFromIdleStop VehStc_flgStopInhbCdnChkEna VehStc_flgStopTrigDly VehStc_numFuDiagRecA VehStc_numMisfDetnHiEctA VehStc_numMisfDetnLoEctA VehStc_numMisfDetnNormA /end OUT_MEASUREMENT
 /begin LOC_MEASUREMENT VehStc_cntFuDiagRecA VehStc_cntrMisfDetn VehStc_flgMisfDetd VehStc_flgMisfDetn VehStc_flgPwrSteerRstrtActv VehStc_flgSSEChgOfMind VehStc_flgStopTrigDlyFinshd VehStc_flgUserRstrtActv VehStc_idxCalcnAry VehStc_idxDiagRsltB1A VehStc_lDeltaDst VehStc_lDstCity VehStc_lDstCityEco VehStc_lDstHighWay VehStc_lDstHighWayEco VehStc_lDstold VehStc_NrOfMisfOldA VehStc_numMisfDetnHiEct0 VehStc_numMisfDetnHiEct1 VehStc_numMisfDetnHiEct10 VehStc_numMisfDetnHiEct11 VehStc_numMisfDetnHiEct12 VehStc_numMisfDetnHiEct13 VehStc_numMisfDetnHiEct14 VehStc_numMisfDetnHiEct15 VehStc_numMisfDetnHiEct16 VehStc_numMisfDetnHiEct17 VehStc_numMisfDetnHiEct18 VehStc_numMisfDetnHiEct19 VehStc_numMisfDetnHiEct2 VehStc_numMisfDetnHiEct20 VehStc_numMisfDetnHiEct3 VehStc_numMisfDetnHiEct4 VehStc_numMisfDetnHiEct5 VehStc_numMisfDetnHiEct6 VehStc_numMisfDetnHiEct7 VehStc_numMisfDetnHiEct8 VehStc_numMisfDetnHiEct9 VehStc_numMisfDetnLo0 VehStc_numMisfDetnLo1 VehStc_numMisfDetnLo10 VehStc_numMisfDetnLo11 VehStc_numMisfDetnLo12 VehStc_numMisfDetnLo13 VehStc_numMisfDetnLo14 VehStc_numMisfDetnLo15 VehStc_numMisfDetnLo16 VehStc_numMisfDetnLo17 VehStc_numMisfDetnLo18 VehStc_numMisfDetnLo19 VehStc_numMisfDetnLo2 VehStc_numMisfDetnLo20 VehStc_numMisfDetnLo3 VehStc_numMisfDetnLo4 VehStc_numMisfDetnLo5 VehStc_numMisfDetnLo6 VehStc_numMisfDetnLo7 VehStc_numMisfDetnLo8 VehStc_numMisfDetnLo9 VehStc_pIntkMnfld VehStc_rDiagRsltB10 VehStc_rDiagRsltB11 VehStc_rDiagRsltB12 VehStc_rDiagRsltB13 VehStc_rDiagRsltB14 VehStc_rDiagRsltB1A VehStc_stbasalCdn VehStc_stEngManStrtd VehStc_stEngSpdLo VehStc_stEngSpdLowr VehStc_stEngSpdMed VehStc_stEngSpdSHi VehStc_stEngSpdTop VehStc_stEntryCdn VehStc_stIntkPHi VehStc_stIntkPLo VehStc_stIntkPMed VehStc_stIntkPTop VehStc_stISSOff VehStc_stSSE VehStc_stSSEOld VehStc_stStopReqCdn VehStc_stVehSpdCdn VehStc_sumFuDiagRecA VehStc_tiRtCity VehStc_tiRtCityEco VehStc_tiRtHighWay VehStc_tiRtHighWayEco VehStc_tiRtISSOffAC VehStc_tiRtISSOffAT VehStc_tiRtISSOffATSlope VehStc_tiRtISSOffBat VehStc_tiRtISSOffBrkBoost VehStc_tiRtISSOffDCDC VehStc_tiRtISSOffPwrSteer VehStc_tiRtISSOffSys VehStc_tiRtISSOffTempEng VehStc_tiRtISSOffUser VehStc_tiRtISSOffvVeh VehStc_tiRtISSStop VehStc_tiRtStop VehStc_tiRtStopSpstOn VehStc_tiRtStopStspDrvrOff VehStc_tiRtStopStspOffSysReq VehStc_volActFuCns VehStc_volCnsCityDcyc VehStc_volCnsCityEcoDcyc VehStc_volCnsHighWayDcyc VehStc_volCnsHighWayEcoDcyc VehStc_volCnsStopDcyc VehStc_volFuCnsOld /end LOC_MEASUREMENT
 FUNCTION_VERSION "2.0.0" /end FUNCTION
/begin FUNCTION VehV2MED "5.6.0     Interface adapter VehV to MED" FUNCTION_VERSION "5.6.0" /end FUNCTION
/begin FUNCTION VehV_DD "169.1.0   Vehicle Speed - Device Driver"
 /begin DEF_CHARACTERISTIC VehV_ctDvtMax_C VehV_ctDvtMin_C VehV_ctTolrPerd_C VehV_dstPerImp_C VehV_facTireAxlCorrMax_C VehV_facTireAxlCorrMin_C VehV_nEngThresMinPinPnt_C VehV_numSegSens_C VehV_rAxl_C VehV_rThresWhlErr_C VehV_stCfg_C VehV_swtDrctDstPerImp_C VehV_tiOffDlyAvdInitPls_C VehV_tiPerMax_C VehV_tiT15ON_C VehV_tiUnJit_C VehV_tiWhlSensErr_C VehV_vFLWhlSpdDfl_C VehV_vFRWhlSpdDfl_C VehV_vRLWhlSpdDfl_C VehV_vRRWhlSpdDfl_C VehV_vSensDiffLim_C VehV_vSpdPinPnt_C VehV_vWhlErrMax_C VehV_vWhlErrMin_C /end DEF_CHARACTERISTIC
 /begin IN_MEASUREMENT Clth_st Com_flgFLWhlSpdInvld Com_flgFRWhlSpdInvld Com_flgRLWhlSpdInvld Com_flgRRWhlSpdInvld Com_vFLWhlSpd Com_vFRWhlSpd Com_vRLWhlSpd Com_vRRWhlSpd Epm_nEng Gbx_stPNPos GlbDa_lWhlCirc T15_st VehMot_stStabIntv /end IN_MEASUREMENT
 /begin OUT_MEASUREMENT VehV_facTireAxlCorr VehV_tiPerAvrg VehV_vFLWhlSpd VehV_vFRWhlSpd VehV_vRLWhlSpd VehV_vRRWhlSpd VehV_vSensHw VehV_vSensSngWhlCan /end OUT_MEASUREMENT
 /begin LOC_MEASUREMENT VehV_ctPeriodOld_mp VehV_ctPeriod_mp VehV_flgFLSnsrErr_MP VehV_flgFRSnsrErr_MP VehV_flgRLSnsrErr_MP VehV_flgRRSnsrErr_MP VehV_stT15WaitEdg VehV_tiPeriodOld_mp VehV_tiPeriod_mp VehV_vAvrgSpdWoMax_MP VehV_vAvrgSpdWoMin_MP VehV_vRefAvrgSpd_MP VehV_vSensPre_mp /end LOC_MEASUREMENT
 FUNCTION_VERSION "169.1.0" /end FUNCTION
/begin FUNCTION VehV_DDOut "9.0.0     PWM output"
 /begin DEF_CHARACTERISTIC VehV_numSclOut_C VehV_PwmOut.rMin_C VehV_PwmOut.rMax_C VehV_PwmOut.tiBtwTstSCB_C VehV_PwmOut.tiBtwTstOT_C VehV_PwmOut.numTstMax_C VehV_PwmOut.swtBattCor_C VehV_rMaxDty_C VehV_rSclOut_C VehV_stLvl_C VehV_stPsDiaDisbl_C VehV_stPsDisbl_C VehV_stPsInv_C VehV_swtSigPWMOut_C VehV_tiOutMax_C VehV_tiOutMin_C VehV_tiPh_C /end DEF_CHARACTERISTIC
 /begin IN_MEASUREMENT Com_vVeh DevLib_stPwrStgEnaCond SyC_ctPostDrvLeave VehV_tiPerAvrg /end IN_MEASUREMENT
 /begin LOC_MEASUREMENT VehVDDOut_ctReIni VehV_tiSclOut_mp /end LOC_MEASUREMENT
 FUNCTION_VERSION "9.0.0" /end FUNCTION
/begin FUNCTION VehV_VD "170.0.0   Vehicle Speed - Virtual Device"
 /begin DEF_CHARACTERISTIC VehV_flgExcdLim_C VehV_flgPtCdnSel_C VehV_flgPwrPlausHealEna_C VehV_nThresPlaFcoMax_C VehV_nThresPlaFcoMin_C VehV_nThresPlaMinV2N_C VehV_nThresPlaPwrMaxDfct_C VehV_nThresPlaPwrMaxOk_C VehV_nThresPlaPwrMinDfct_C VehV_nThresPlaPwrMinOk_C VehV_rDifPlaus_C VehV_rSpdDiffCorrnFac_C VehV_rV2NDifThd_CUR VehV_swtDftT15Off_C VehV_swtPlausSel_C VehV_swtPwrExcdLim_C VehV_swtSigSafe_C VehV_swtSigStd_C VehV_tiAPT1_C VehV_tiDebImpsCan_C VehV_tiDebImpsFco_C VehV_tiDebImpsPwr_C VehV_tiDebImpsV2NTrsm_C VehV_tiPwrPlausDfctEna_C VehV_tiPwrPlausHealEna_C VehV_tiThdExcdLim_C VehV_tiVAccPT1_C VehV_tiVPT1_C VehV_trqThresPlaDef_C VehV_trqThresPlaOk_C VehV_tThresPlaFco_C VehV_tThresPlaPwr_C VehV_vDflOBD_C VehV_vDfl_C VehV_vDftT15Off_C VehV_vLowThres_C VehV_vMaxFix_C VehV_vMin_C VehV_vPhysRngMax_C VehV_vPhysRngMin_C VehV_vSnsrFailrThd_C VehV_vSnsrSpdDiffThd_C VehV_vThdExcdLim_C VehV_vThresPlaFco_C VehV_vThresPlaPwrDef_C VehV_vThresPlaPwrOk_C VehV_vThresPlaV2N_C /end DEF_CHARACTERISTIC
 /begin IN_MEASUREMENT ActMod_trqInr Clth_st Com_stMon Com_stVehSpdSensErr Com_vVeh Com_vVeh2 Conv_rTrq EngDa_tEng Epm_nEng Gbx_bLimp Gbx_stPNPos GlbDa_lWhlCirc PthSet_bOvrRun PT_bGrip PT_rTraGear PT_stTraType StbIntv_vWhlSpd T15_st VehMot_rTrqDfftl VehV_vSensHw VehV_vSensSngWhlCan /end IN_MEASUREMENT
 /begin OUT_MEASUREMENT VehV_a VehV_aRawUnFlt VehV_flgExcdLim VehV_stSigSrc VehV_stTopSpdLim VehV_v VehV_vErrFrzVal VehV_vSens VehV_vSensOBD VehV_vUnFlt /end OUT_MEASUREMENT
 /begin LOC_MEASUREMENT VehV_aFilt_MP VehV_DSQSafe_MP VehV_DSQStd_MP VehV_flgV2NEna_MP VehV_flgV2NErr VehV_flgV2NGearChkEna VehV_flgV2NHeal VehV_nArySpdCntr VehV_rTraGearDif_MP VehV_rTraGearFild VehV_rTraGearFild_MP VehV_rTraGear_MP VehV_rV2N_MP VehV_vAcclFlt_mp VehV_vFltOld_mp VehV_vNCSnsrAryVal VehV_vNCSnsrAvg VehV_vNCSnsrSum VehV_vNCSpdSnsrAry VehV_vSnsrAbslt_MP VehV_vSnsrSafe_MP VehV_vSnsrSpdDiffAbslt VehV_vSnsrSpdDiffThd VehV_vSnsrStd_MP VehV_vSpdSnsrAAry VehV_vSpdSnsrAAryVal VehV_vSpdSnsrAAvg VehV_vSpdSnsrASum VehV_vSpdSnsrBAry VehV_vSpdSnsrBAryVal VehV_vSpdSnsrBAvg VehV_vSpdSnsrBSum /end LOC_MEASUREMENT
 FUNCTION_VERSION "170.0.0" /end FUNCTION
/begin FUNCTION VlvLft_GlbDefn "1.1.0     Global definitions for VlvLft" FUNCTION_VERSION "1.1.0" /end FUNCTION
/begin FUNCTION VMD_Axispoints "26.1.0    Vehicle Motion Demand data set points" FUNCTION_VERSION "26.1.0" /end FUNCTION
/begin FUNCTION VMD_VirtAPP "233.0.0   virtual accelerator pedal position"
 /begin DEF_CHARACTERISTIC VMD_rDrvModCorrnCmft_T VMD_rDrvModCorrnEco_T VMD_rDrvModCorrnNorm_T VMD_rDrvModCorrnSnow_T VMD_rDrvModCorrnSpt_T VMD_rMinWoRamp_C VMD_stAslAccSel_C VMD_tiRampSlopModChg_CA /end DEF_CHARACTERISTIC
 /begin REF_CHARACTERISTIC AccPed_swtDrvModSeln_C /end REF_CHARACTERISTIC
 /begin IN_MEASUREMENT AccPed_flgDrvModChg AccPed_nrGearFildTmp AccPed_stDrvModPrev AccPed_swtDrvMod APP_r APP_rMaxLrnUnFlt CoVMD_r CoVMD_rCMTCLsAEBReq CoVMD_stLoLimActv CrCtl_stActive LLim_stActive T15_st /end IN_MEASUREMENT
 /begin OUT_MEASUREMENT VMD_facDasModSwt VMD_facDasModSwtStep VMD_facModSwt VMD_facModSwtLrn VMD_facModSwtStep VMD_facModSwtStepLrn VMD_rASLCC VMD_rASLCCLrn VMD_rDasDrvMod VMD_rDasDrvModCorrd VMD_rDasDrvModCorrdEco VMD_rDasDrvModCorrdNew VMD_rDasDrvModCorrdNewTmp VMD_rDasDrvModCorrdNorm VMD_rDasDrvModCorrdOld VMD_rDasDrvModCorrdOldTmp VMD_rDasVirtAPP VMD_rDrvModCorrd VMD_rDrvModCorrdEco VMD_rDrvModCorrdEcoLrn VMD_rDrvModCorrdLrn VMD_rDrvModCorrdNew VMD_rDrvModCorrdNewLrn VMD_rDrvModCorrdNewTmp VMD_rDrvModCorrdNewTmpLrn VMD_rDrvModCorrdNorm VMD_rDrvModCorrdNormLrn VMD_rDrvModCorrdOld VMD_rDrvModCorrdOldLrn VMD_rDrvModCorrdOldTmp VMD_rDrvModCorrdOldTmpLrn VMD_rVirtAPP VMD_rVirtAPPLrn VMD_stDasRampActv VMD_stRampActv VMD_stRampActvLrn /end OUT_MEASUREMENT
 /begin LOC_MEASUREMENT VMD_rAslAccLrnTmp VMD_rAslAccTmp /end LOC_MEASUREMENT
 FUNCTION_VERSION "233.0.0" /end FUNCTION
/begin FUNCTION VMSI_PlausTrqIntv "40.1.0    Vehicle motion stability intervention"
 /begin DEF_CHARACTERISTIC VMSI_dtqRmpDCSP.Neg_C VMSI_dtqRmpDCSP.Pos_C VMSI_dtqRmpTCSP.Neg_C VMSI_dtqRmpTCSP.Pos_C VMSI_stCfg_C VMSI_swtSlipCtl_C VMSI_tiPlusOff_C VMSI_tiPlus_C VMSI_trqLimDCSNorm_C VMSI_trqLimDCSPlus_C VMSI_trqMin_C /end DEF_CHARACTERISTIC
 /begin IN_MEASUREMENT MoFExtInt_stDCSPtdMsg PtCoornDyn_flgStabyIntvDecActvDes PtCoornDyn_flgStabyIntvIncActvDes PT_rTrq PT_trqLos StbIntv_bDCSIntv StbIntv_bDCSNeutr StbIntv_bTCSIntv StbIntv_bTCSNeutr StbIntv_flgDCSPlusTrqReqd StbIntv_trqDCSDes StbIntv_trqTCSDes StbIntv_trqTCSLead T15_st VehMot_rTrqDfftl /end IN_MEASUREMENT
 /begin OUT_MEASUREMENT VMSI_stDCSPlusOK VMSI_stDCSPtd VMSI_tqCluDesMax VMSI_tqCluLeadMax VMSI_tqCluMin VMSI_trqDesMax VMSI_trqLeadMax VMSI_trqMin /end OUT_MEASUREMENT
 /begin LOC_MEASUREMENT VMSI_flgDCSPlusChk VMSI_flgRampShtOffCdnDCS VMSI_flgRampShtOffCdnTCS VMSI_flgShtOffCdnDCS VMSI_flgShtOffCdnTCS VMSI_stDCSPlusCtrl VMSI_tqDCSRampOut_MP VMSI_tqTCSRampOut_MP VMSI_trqMinLowrLim /end LOC_MEASUREMENT
 FUNCTION_VERSION "40.1.0" /end FUNCTION
/begin COMPU_METHOD Acc "" RAT_FUNC "%6.5" "m/s^2" COEFFS 0 1000 0 0 0 1 /end COMPU_METHOD
/begin COMPU_METHOD B_TRUE "" TAB_VERB "%6.3" "" COMPU_TAB_REF B_TRUE /end COMPU_METHOD
/begin COMPU_VTAB B_TRUE "" TAB_VERB 2 0 "FALSE" 1 "TRUE" /end COMPU_VTAB
/begin COMPU_METHOD Curr_A "" RAT_FUNC "%6.4" "A" COEFFS 0 100 0 0 0 1 /end COMPU_METHOD
/begin COMPU_METHOD dez "" RAT_FUNC "%6.2" "" COEFFS 0 1 0 0 0 1 /end COMPU_METHOD
/begin COMPU_METHOD DtyCyc "" RAT_FUNC "%6.4" "%" COEFFS 0 100 0 0 0 1 /end COMPU_METHOD
/begin COMPU_METHOD EngN "" RAT_FUNC "%6.3" "rpm" COEFFS 0 2 0 0 0 1 /end COMPU_METHOD
/begin COMPU_METHOD Fact "" RAT_FUNC "%6.5" "-" COEFFS 0 8192 0 0 0 1 /end COMPU_METHOD
/begin COMPU_METHOD Fact0002 "" RAT_FUNC "%6.5" "-" COEFFS 0 5000 0 0 0 1 /end COMPU_METHOD
/begin COMPU_METHOD Fact1000 "" RAT_FUNC "%6.5" "-" COEFFS 0 1000 0 0 0 1 /end COMPU_METHOD
/begin COMPU_METHOD fak_uw_b1 "" RAT_FUNC "%7.6" "-" COEFFS 0 65536 0 0 0 1 /end COMPU_METHOD
/begin COMPU_METHOD fak_uw_b16 "" RAT_FUNC "%6.5" "-" COEFFS 0 65536 0 0 0 16 /end COMPU_METHOD
/begin COMPU_METHOD fak_uw_b2 "" RAT_FUNC "%7.6" "-" COEFFS 0 65536 0 0 0 2 /end COMPU_METHOD
/begin COMPU_METHOD i_q6p6667Em7_A "" RAT_FUNC "%9.8" "A" COEFFS 0 1500000 0 0 0 1 /end COMPU_METHOD
/begin COMPU_METHOD Length "" RAT_FUNC "%6.2" "m" COEFFS 0 1 0 0 0 1 /end COMPU_METHOD
/begin COMPU_METHOD LengthCpp "" RAT_FUNC "%8.7" "m" COEFFS 0 100000 0 0 0 1 /end COMPU_METHOD
/begin COMPU_METHOD Mass "" RAT_FUNC "%6.2" "-" COEFFS 0 1 0 0 0 1 /end COMPU_METHOD
/begin COMPU_METHOD MassLength "" RAT_FUNC "%6.3" "" COEFFS 0 5 0 0 0 1 /end COMPU_METHOD
/begin COMPU_METHOD OneToOne "" RAT_FUNC "%6.2" "-" COEFFS 0 1 0 0 0 1 /end COMPU_METHOD
/begin COMPU_METHOD Period "" RAT_FUNC "%6.3" "ms" COEFFS 0 10 0 0 0 1 /end COMPU_METHOD
/begin COMPU_METHOD Period_1000 "" RAT_FUNC "%6.5" "ms" COEFFS 0 1000 0 0 0 1 /end COMPU_METHOD
/begin COMPU_METHOD PerKm "" RAT_FUNC "%6.2" "l/km" COEFFS 0 1 0 0 0 1 /end COMPU_METHOD
/begin COMPU_METHOD Prc "" RAT_FUNC "%6.4" "%" COEFFS 0 81.92 0 0 0 1 /end COMPU_METHOD
/begin COMPU_METHOD PrcPerSec "" RAT_FUNC "%6.3" "%/s" COEFFS 0 1.6384 0 0 0 1 /end COMPU_METHOD
/begin COMPU_METHOD Prc_Fact100 "" RAT_FUNC "%6.4" "%" COEFFS 0 100 0 0 0 1 /end COMPU_METHOD
/begin COMPU_METHOD Prc_q0p01_COMPU "" RAT_FUNC "%6.4" "%" COEFFS 0 100 0 0 0 1 /end COMPU_METHOD
/begin COMPU_METHOD p_uw_q0p039_mmHg "" RAT_FUNC "%6.4" "mmHg" COEFFS 0 256 0 0 0 7.500637 /end COMPU_METHOD
/begin COMPU_METHOD q0p1_A_h "" RAT_FUNC "%6.3" "A*h" COEFFS 0 10 0 0 0 1 /end COMPU_METHOD
/begin COMPU_METHOD q0p1_mOhm "" RAT_FUNC "%6.3" "mOhm" COEFFS 0 10 0 0 0 1 /end COMPU_METHOD
/begin COMPU_METHOD q0p1_mV "" RAT_FUNC "%6.3" "mV" COEFFS 0 10 0 0 0 1 /end COMPU_METHOD
/begin COMPU_METHOD RBPtCel_Perc_0p01_1 "" RAT_FUNC "%6.4" "%" COEFFS 0 100 0 0 0 1 /end COMPU_METHOD
/begin COMPU_METHOD RBPtCel_Perc_0p5_1 "" RAT_FUNC "%6.3" "%" COEFFS 0 2 0 0 0 1 /end COMPU_METHOD
/begin COMPU_METHOD RBPtCel_q_9p7656em4_1 "" RAT_FUNC "%6.5" "As" COEFFS 0 1024 0 0 0 1 /end COMPU_METHOD
/begin COMPU_METHOD RBPtCel_ti_0p1_1 "" RAT_FUNC "%6.3" "s" COEFFS 0 10 0 0 0 1 /end COMPU_METHOD
/begin COMPU_METHOD RBPtCel_ti_1p0_2 "" RAT_FUNC "%6.2" "s" COEFFS 0 1 0 0 0 1 /end COMPU_METHOD
/begin COMPU_METHOD RBPtCel_ti_1p0_6 "" RAT_FUNC "%6.2" "h" COEFFS 0 1 0 0 0 1 /end COMPU_METHOD
/begin COMPU_METHOD RBPtCel_t_1p0_om40_1 "" RAT_FUNC "%6.2" "Deg C" COEFFS 0 1 40 0 0 1 /end COMPU_METHOD
/begin COMPU_METHOD RBPtCel_u_0p05_1 "" RAT_FUNC "%6.4" "V" COEFFS 0 20 0 0 0 1 /end COMPU_METHOD
/begin COMPU_METHOD rel_q0p02344 "" RAT_FUNC "%6.4" "%" COEFFS 0 32 0 0 0 0.75 /end COMPU_METHOD
/begin COMPU_METHOD rel_uw_b100 "" RAT_FUNC "%6.4" "%" COEFFS 0 65536 0 0 0 100 /end COMPU_METHOD
/begin COMPU_METHOD rel_uw_b200 "" RAT_FUNC "%6.4" "%" COEFFS 0 65536 0 0 0 200 /end COMPU_METHOD
/begin COMPU_METHOD Resist_mOhm_q0p01 "" RAT_FUNC "%6.4" "mOhm" COEFFS 0 100 0 0 0 1 /end COMPU_METHOD
/begin COMPU_METHOD RmpTrqPrpHigh "" RAT_FUNC "%6.4" "Nm/s" COEFFS 0 655.36 0 0 0 1 /end COMPU_METHOD
/begin COMPU_METHOD spg_q0p08_V "" RAT_FUNC "%6.3" "V" COEFFS 0 1 0 0 0 0.08 /end COMPU_METHOD
/begin COMPU_METHOD spg_q3p2Em4_V "" RAT_FUNC "%6.5" "V" COEFFS 0 32768 0 0 0 10.48576 /end COMPU_METHOD
/begin COMPU_METHOD spg_q4p883Em9_V "" RAT_FUNC "%11.10" "V" COEFFS 0 204800000 0 0 0 1 /end COMPU_METHOD
/begin COMPU_METHOD Temp_Cels "" RAT_FUNC "%6.1" "deg C" COEFFS 0 10 2731.4 0 0 1 /end COMPU_METHOD
/begin COMPU_METHOD temp_q0p0234_o273 "" RAT_FUNC "%6.1" "Grad C" COEFFS 0 1 273.15 0 0 0.0234375 /end COMPU_METHOD
/begin COMPU_METHOD TimeDelay_s "" RAT_FUNC "%6.1" "s" COEFFS 0 0 1 0 0.00023283064365387 0 /end COMPU_METHOD
/begin COMPU_METHOD Time_ms "" RAT_FUNC "%6.1" "ms" COEFFS 0 0.1 0 0 0 1 /end COMPU_METHOD
/begin COMPU_METHOD Time_PwmHigh "" RAT_FUNC "%6.4" "us" COEFFS 0 20 0 0 0 1 /end COMPU_METHOD
/begin COMPU_METHOD Time_s "" RAT_FUNC "%6.4" "s" COEFFS 0 100 0 0 0 1 /end COMPU_METHOD
/begin COMPU_METHOD Time_s_1 "" RAT_FUNC "%6.5" "" COEFFS 0 1000 0 0 0 1 /end COMPU_METHOD
/begin COMPU_METHOD Time_s_float "" RAT_FUNC "%6.2" "s" COEFFS 0 1 0 0 0 1 /end COMPU_METHOD
/begin COMPU_METHOD Trq "" RAT_FUNC "%6.3" "Nm" COEFFS 0 10 0 0 0 1 /end COMPU_METHOD
/begin COMPU_METHOD TrqPrpHigh "" RAT_FUNC "%6.3" "Nm" COEFFS 0 10 0 0 0 1 /end COMPU_METHOD
/begin COMPU_METHOD t_q0p01 "" RAT_FUNC "%6.4" "s" COEFFS 0 100 0 0 0 1 /end COMPU_METHOD
/begin COMPU_METHOD t_q0p1 "" RAT_FUNC "%6.3" "s" COEFFS 0 10 0 0 0 1 /end COMPU_METHOD
/begin COMPU_METHOD t_q6p6666Em4 "" RAT_FUNC "%6.5" "s" COEFFS 0 1500 0 0 0 1 /end COMPU_METHOD
/begin COMPU_METHOD UEGO_UNernstCtrl_COMPU_VERB "" TAB_VERB "%6.3" "" COMPU_TAB_REF UEGO_UNernstCtrl_COMPU_VERB /end COMPU_METHOD
/begin COMPU_VTAB UEGO_UNernstCtrl_COMPU_VERB "" TAB_VERB 9 2 "UNERNST_WTRELECLY" 3 "UNERNST_CPSNSR_FROZEN" 4 "UNERNST_CPSNSR_OFFSET" 5 "UNERNST_WTRELECLYDIAG_NORMAL" 6 "UNERNST_WTRELECLYDIAG_SET" 7 "UNERNST_STOPPHASESAFE" 8 "UNERNST_SAFE" 9 "UNERNST_STD" 10 "UNERNST_DEFAULT" /end COMPU_VTAB
/begin COMPU_METHOD UEGO_UPmpLimn_COMPU_VERB "" TAB_VERB "%6.3" "" COMPU_TAB_REF UEGO_UPmpLimn_COMPU_VERB /end COMPU_METHOD
/begin COMPU_VTAB UEGO_UPmpLimn_COMPU_VERB "" TAB_VERB 2 0 "UPMPLIMN_DFT" 1 "UPMPLIMN_ACTIVE" /end COMPU_VTAB
/begin COMPU_METHOD VEHVPWMOUT_SC_Compu "" TAB_VERB "%6.3" "" COMPU_TAB_REF VEHVPWMOUT_SC_Compu /end COMPU_METHOD
/begin COMPU_VTAB VEHVPWMOUT_SC_Compu "" TAB_VERB 2 0 "False" 1 "True" /end COMPU_VTAB
/begin COMPU_METHOD VEHV_CANSAFE_SC_Compu "" TAB_VERB "%6.3" "" COMPU_TAB_REF VEHV_CANSAFE_SC_Compu /end COMPU_METHOD
/begin COMPU_VTAB VEHV_CANSAFE_SC_Compu "" TAB_VERB 4 0 "0" 1 "1" 2 "2" 3 "3" /end COMPU_VTAB
/begin COMPU_METHOD VEHV_CAN_SC_Compu "" TAB_VERB "%6.3" "" COMPU_TAB_REF VEHV_CAN_SC_Compu /end COMPU_METHOD
/begin COMPU_VTAB VEHV_CAN_SC_Compu "" TAB_VERB 4 0 "No_CAN" 1 "CONSOLIDATED_CAN" 2 "SINGLEWHEELSPEED_CAN" 3 "CONSOLIDATED_SINGLEWHEELSPEED" /end COMPU_VTAB
/begin COMPU_METHOD VEHV_DUALCANSRCACTV_SC_Compu "" TAB_VERB "%6.3" "" COMPU_TAB_REF VEHV_DUALCANSRCACTV_SC_Compu /end COMPU_METHOD
/begin COMPU_VTAB VEHV_DUALCANSRCACTV_SC_Compu "" TAB_VERB 2 0 "NOT_ACTIVE" 1 "ACTIVE" /end COMPU_VTAB
/begin COMPU_METHOD VEHV_DUALSIG_SC_Compu "" TAB_VERB "%6.3" "" COMPU_TAB_REF VEHV_DUALSIG_SC_Compu /end COMPU_METHOD
/begin COMPU_VTAB VEHV_DUALSIG_SC_Compu "" TAB_VERB 2 0 "False" 1 "True" /end COMPU_VTAB
/begin COMPU_METHOD VEHV_FCOPLAUS_SY_Compu "" TAB_VERB "%6.3" "" COMPU_TAB_REF VEHV_FCOPLAUS_SY_Compu /end COMPU_METHOD
/begin COMPU_VTAB VEHV_FCOPLAUS_SY_Compu "" TAB_VERB 2 0 "False" 1 "True" /end COMPU_VTAB
/begin COMPU_METHOD VEHV_INHOUSE_SC_Compu "" TAB_VERB "%6.3" "" COMPU_TAB_REF VEHV_INHOUSE_SC_Compu /end COMPU_METHOD
/begin COMPU_VTAB VEHV_INHOUSE_SC_Compu "" TAB_VERB 2 0 "False" 1 "True" /end COMPU_VTAB
/begin COMPU_METHOD VEHV_NUMTTHWHL_SY_Compu "" RAT_FUNC "%6.2" "" COEFFS 0 1 0 0 0 1 /end COMPU_METHOD
/begin COMPU_METHOD VEHV_OBDPLAUS_SY_Compu "" TAB_VERB "%6.3" "" COMPU_TAB_REF VEHV_OBDPLAUS_SY_Compu /end COMPU_METHOD
/begin COMPU_VTAB VEHV_OBDPLAUS_SY_Compu "" TAB_VERB 2 0 "False" 1 "True" /end COMPU_VTAB
/begin COMPU_METHOD VEHV_PHYSRNGCHK_SY_Compu "" TAB_VERB "%6.3" "" COMPU_TAB_REF VEHV_PHYSRNGCHK_SY_Compu /end COMPU_METHOD
/begin COMPU_VTAB VEHV_PHYSRNGCHK_SY_Compu "" TAB_VERB 2 0 "False" 1 "True" /end COMPU_VTAB
/begin COMPU_METHOD VEHV_PWMSAFE_SC_Compu "" TAB_VERB "%6.3" "" COMPU_TAB_REF VEHV_PWMSAFE_SC_Compu /end COMPU_METHOD
/begin COMPU_VTAB VEHV_PWMSAFE_SC_Compu "" TAB_VERB 2 0 "False" 1 "True" /end COMPU_VTAB
/begin COMPU_METHOD VEHV_PWMVLDYCHK_SC_Compu "" TAB_VERB "%6.3" "" COMPU_TAB_REF VEHV_PWMVLDYCHK_SC_Compu /end COMPU_METHOD
/begin COMPU_VTAB VEHV_PWMVLDYCHK_SC_Compu "" TAB_VERB 2 0 "deactivated" 1 "activated" /end COMPU_VTAB
/begin COMPU_METHOD VEHV_PWM_SC_Compu "" TAB_VERB "%6.3" "" COMPU_TAB_REF VEHV_PWM_SC_Compu /end COMPU_METHOD
/begin COMPU_VTAB VEHV_PWM_SC_Compu "" TAB_VERB 4 0 "No PWM" 1 "Pwm_InXt" 2 "Pwm_InPer" 3 "Pwm_In" /end COMPU_VTAB
/begin COMPU_METHOD VEHV_SC_Compu "" TAB_VERB "%6.3" "" COMPU_TAB_REF VEHV_SC_Compu /end COMPU_METHOD
/begin COMPU_VTAB VEHV_SC_Compu "" TAB_VERB 2 0 "False" 1 "True" /end COMPU_VTAB
/begin COMPU_METHOD VEHV_SELCOMSIG_SC_Compu "" TAB_VERB "%6.3" "" COMPU_TAB_REF VEHV_SELCOMSIG_SC_Compu /end COMPU_METHOD
/begin COMPU_VTAB VEHV_SELCOMSIG_SC_Compu "" TAB_VERB 4 0 "Vehicle_velocity" 1 "Displayed_Vehicle_Speed" 2 "single_wheel_speed_CAN" 3 "TCM_vehicle_velocity" /end COMPU_VTAB
/begin COMPU_METHOD VEHV_SGLWHLDIAG_SY_Compu "" TAB_VERB "%6.3" "" COMPU_TAB_REF VEHV_SGLWHLDIAG_SY_Compu /end COMPU_METHOD
/begin COMPU_VTAB VEHV_SGLWHLDIAG_SY_Compu "" TAB_VERB 3 0 "0" 1 "1" 2 "2" /end COMPU_VTAB
/begin COMPU_METHOD VEHV_SWTASRC_SC_Compu "" TAB_VERB "%6.3" "" COMPU_TAB_REF VEHV_SWTASRC_SC_Compu /end COMPU_METHOD
/begin COMPU_VTAB VEHV_SWTASRC_SC_Compu "" TAB_VERB 2 1 "A_VEHV" 2 "A_CAN" /end COMPU_VTAB
/begin COMPU_METHOD VEHV_SWTPLAUSCAN_SC_Compu "" TAB_VERB "%6.3" "" COMPU_TAB_REF VEHV_SWTPLAUSCAN_SC_Compu /end COMPU_METHOD
/begin COMPU_VTAB VEHV_SWTPLAUSCAN_SC_Compu "" TAB_VERB 2 0 "False" 1 "True" /end COMPU_VTAB
/begin COMPU_METHOD VEHV_SWTPLAUSFCO_SC_Compu "" TAB_VERB "%6.3" "" COMPU_TAB_REF VEHV_SWTPLAUSFCO_SC_Compu /end COMPU_METHOD
/begin COMPU_VTAB VEHV_SWTPLAUSFCO_SC_Compu "" TAB_VERB 2 0 "False" 1 "True" /end COMPU_VTAB
/begin COMPU_METHOD VEHV_SWTPLAUSPWR_SC_Compu "" TAB_VERB "%6.3" "" COMPU_TAB_REF VEHV_SWTPLAUSPWR_SC_Compu /end COMPU_METHOD
/begin COMPU_VTAB VEHV_SWTPLAUSPWR_SC_Compu "" TAB_VERB 2 0 "False" 1 "True" /end COMPU_VTAB
/begin COMPU_METHOD VEHV_SWTPLAUSREF_SC_Compu "" TAB_VERB "%6.3" "" COMPU_TAB_REF VEHV_SWTPLAUSREF_SC_Compu /end COMPU_METHOD
/begin COMPU_VTAB VEHV_SWTPLAUSREF_SC_Compu "" TAB_VERB 2 0 "False" 1 "True" /end COMPU_VTAB
/begin COMPU_METHOD VEHV_SWTPLAUSV2N_SC_Compu "" TAB_VERB "%6.3" "" COMPU_TAB_REF VEHV_SWTPLAUSV2N_SC_Compu /end COMPU_METHOD
/begin COMPU_VTAB VEHV_SWTPLAUSV2N_SC_Compu "" TAB_VERB 2 0 "False" 1 "True" /end COMPU_VTAB
/begin COMPU_METHOD VEHV_SWTPWRMDL_SC_Compu "" TAB_VERB "%6.3" "" COMPU_TAB_REF VEHV_SWTPWRMDL_SC_Compu /end COMPU_METHOD
/begin COMPU_VTAB VEHV_SWTPWRMDL_SC_Compu "" TAB_VERB 2 1 "1" 2 "2" /end COMPU_VTAB
/begin COMPU_METHOD VEHV_SWTSIGSELNEEP_SC_Compu "" TAB_VERB "%6.3" "" COMPU_TAB_REF VEHV_SWTSIGSELNEEP_SC_Compu /end COMPU_METHOD
/begin COMPU_VTAB VEHV_SWTSIGSELNEEP_SC_Compu "" TAB_VERB 2 0 "False" 1 "True" /end COMPU_VTAB
/begin COMPU_METHOD Vel "" RAT_FUNC "%6.4" "km/h" COEFFS 0 100 0 0 0 1 /end COMPU_METHOD
/begin COMPU_METHOD Velocity "" RAT_FUNC "%6.4" "m/s" COEFFS 0 178.571428571429 0 0 0 1 /end COMPU_METHOD
/begin COMPU_METHOD Vel_High "" RAT_FUNC "%6.5" "km/h" COEFFS 0 1000 0 0 0 1 /end COMPU_METHOD
/begin COMPU_METHOD Vel_High_float "" RAT_FUNC "%6.2" "km/h" COEFFS 0 1 0 0 0 1 /end COMPU_METHOD
/begin COMPU_METHOD Vel_SI "" RAT_FUNC "%6.4" "m/s" COEFFS 0 360 0 0 0 1 /end COMPU_METHOD
/begin COMPU_METHOD VERSSTOPMISFGDETNBYINJ_SY_Compu "" TAB_VERB "%6.3" "" COMPU_TAB_REF VERSSTOPMISFGDETNBYINJ_SY_Compu /end COMPU_METHOD
/begin COMPU_VTAB VERSSTOPMISFGDETNBYINJ_SY_Compu "" TAB_VERB 2 0 "0" 1 "1" /end COMPU_VTAB
/begin COMPU_METHOD VLVI_SY_Compu "" TAB_VERB "%6.3" "" COMPU_TAB_REF VLVI_SY_Compu /end COMPU_METHOD
/begin COMPU_VTAB VLVI_SY_Compu "" TAB_VERB 3 0 "VLVI_NONE" 1 "VLVI_2POINT" 2 "VLVI_CONT" /end COMPU_VTAB
/begin COMPU_METHOD VLVLFTI_TYPAVL_SC_Compu "" TAB_VERB "%6.3" "" COMPU_TAB_REF VLVLFTI_TYPAVL_SC_Compu /end COMPU_METHOD
/begin COMPU_VTAB VLVLFTI_TYPAVL_SC_Compu "" TAB_VERB 2 0 "False" 1 "True" /end COMPU_VTAB
/begin COMPU_METHOD VLVLFT_FBEXHSWT_SC_Compu "" TAB_VERB "%6.3" "" COMPU_TAB_REF VLVLFT_FBEXHSWT_SC_Compu /end COMPU_METHOD
/begin COMPU_VTAB VLVLFT_FBEXHSWT_SC_Compu "" TAB_VERB 2 0 "Absent" 1 "Present" /end COMPU_VTAB
/begin COMPU_METHOD VLVLFT_FBINTKSWT_SC_Compu "" TAB_VERB "%6.3" "" COMPU_TAB_REF VLVLFT_FBINTKSWT_SC_Compu /end COMPU_METHOD
/begin COMPU_VTAB VLVLFT_FBINTKSWT_SC_Compu "" TAB_VERB 2 0 "Absent" 1 "Present" /end COMPU_VTAB
/begin COMPU_METHOD VLVLFT_INTK_SC_Compu "" TAB_VERB "%6.3" "" COMPU_TAB_REF VLVLFT_INTK_SC_Compu /end COMPU_METHOD
/begin COMPU_VTAB VLVLFT_INTK_SC_Compu "" TAB_VERB 3 0 "NoLft" 1 "2PtLft" 2 "ContLft" /end COMPU_VTAB
/begin COMPU_METHOD VLVLFT_OUTL_SC_Compu "" TAB_VERB "%6.3" "" COMPU_TAB_REF VLVLFT_OUTL_SC_Compu /end COMPU_METHOD
/begin COMPU_VTAB VLVLFT_OUTL_SC_Compu "" TAB_VERB 3 0 "NoLft" 1 "2PtLft" 2 "ContLft" /end COMPU_VTAB
/begin COMPU_METHOD VLVLFT_POSNOFSPCLLFTINTK_SC_Compu "" TAB_VERB "%6.3" "" COMPU_TAB_REF VLVLFT_POSNOFSPCLLFTINTK_SC_Compu /end COMPU_METHOD
/begin COMPU_VTAB VLVLFT_POSNOFSPCLLFTINTK_SC_Compu "" TAB_VERB 2 0 "SPCL_LOW_CAM" 1 "SPCL_HIGH_CAM" /end COMPU_VTAB
/begin COMPU_METHOD VLVLFT_TYPINTK_SC_Compu "" TAB_VERB "%6.3" "" COMPU_TAB_REF VLVLFT_TYPINTK_SC_Compu /end COMPU_METHOD
/begin COMPU_VTAB VLVLFT_TYPINTK_SC_Compu "" TAB_VERB 8 0 "NoLift" 1 "ValveTronic" 2 "VarioCam+" 3 "AVS" 4 "VTEC" 5 "UniAir" 6 "CamTronic" 7 "UniValve" /end COMPU_VTAB
/begin COMPU_METHOD volFilgLvl_ml "" RAT_FUNC "%6.2" "ml" COEFFS 0 1 0 0 0 1 /end COMPU_METHOD
/begin RECORD_LAYOUT Kw_Ws16 FNC_VALUES 1 SWORD COLUMN_DIR DIRECT /end RECORD_LAYOUT
/begin RECORD_LAYOUT Kw_Wu16 FNC_VALUES 1 UWORD COLUMN_DIR DIRECT /end RECORD_LAYOUT
/begin RECORD_LAYOUT Kw_Wu8 FNC_VALUES 1 UBYTE COLUMN_DIR DIRECT /end RECORD_LAYOUT
/begin RECORD_LAYOUT RB_Curve_S16_S16 NO_AXIS_PTS_X 1 SWORD AXIS_PTS_X 2 SWORD INDEX_INCR DIRECT FNC_VALUES 3 SWORD COLUMN_DIR DIRECT /end RECORD_LAYOUT
/begin RECORD_LAYOUT RB_Curve_S16_U16_Static NO_AXIS_PTS_X 1 SWORD AXIS_PTS_X 2 SWORD INDEX_INCR DIRECT FNC_VALUES 3 UWORD COLUMN_DIR DIRECT STATIC_RECORD_LAYOUT /end RECORD_LAYOUT
/begin RECORD_LAYOUT RB_Curve_U16_U16 NO_AXIS_PTS_X 1 UWORD AXIS_PTS_X 2 UWORD INDEX_INCR DIRECT FNC_VALUES 3 UWORD COLUMN_DIR DIRECT /end RECORD_LAYOUT
/begin RECORD_LAYOUT RB_Val_Wboolean FNC_VALUES 1 UBYTE COLUMN_DIR DIRECT /end RECORD_LAYOUT
/begin RECORD_LAYOUT RB_Val_Wr32 FNC_VALUES 1 FLOAT32_IEEE COLUMN_DIR DIRECT /end RECORD_LAYOUT
/begin RECORD_LAYOUT RB_Val_Ws16 FNC_VALUES 1 SWORD COLUMN_DIR DIRECT /end RECORD_LAYOUT
/begin RECORD_LAYOUT RB_Val_Ws32 FNC_VALUES 1 SLONG COLUMN_DIR DIRECT /end RECORD_LAYOUT
/begin RECORD_LAYOUT RB_Val_Wu16 FNC_VALUES 1 UWORD COLUMN_DIR DIRECT /end RECORD_LAYOUT
/begin RECORD_LAYOUT RB_Val_Wu32 FNC_VALUES 1 ULONG COLUMN_DIR DIRECT /end RECORD_LAYOUT
/begin RECORD_LAYOUT RB_Val_Wu8 FNC_VALUES 1 UBYTE COLUMN_DIR DIRECT /end RECORD_LAYOUT
/begin RECORD_LAYOUT Val_Ws16 FNC_VALUES 1 SWORD COLUMN_DIR DIRECT /end RECORD_LAYOUT
/begin RECORD_LAYOUT Val_Ws32 FNC_VALUES 1 SLONG COLUMN_DIR DIRECT /end RECORD_LAYOUT
/begin RECORD_LAYOUT Val_Wu16 FNC_VALUES 1 UWORD COLUMN_DIR DIRECT /end RECORD_LAYOUT
/begin RECORD_LAYOUT Val_Wu8 FNC_VALUES 1 UBYTE COLUMN_DIR DIRECT /end RECORD_LAYOUT
/end MODULE
/end PROJECT
