ASAP2_VERSION 1 60
/begin PROJECT MG1CS022 "MG1CS022"
/begin HEADER "" VERSION "MG1CS022_62XSC_V037" PROJECT_NO MG1CS022 /end HEADER
/begin MODULE DIM ""
/begin MOD_COMMON "" BYTE_ORDER MSB_LAST ALIGNMENT_BYTE 1 ALIGNMENT_WORD 2 ALIGNMENT_LONG 4 ALIGNMENT_INT64 4 ALIGNMENT_FLOAT32_IEEE 4 ALIGNMENT_FLOAT64_IEEE 4 DATA_SIZE 32 /end MOD_COMMON
/begin CHARACTERISTIC DINH_FId.DFC_MOXEMM_SMU_ALM7_26_CA "inhibitable FIds / FIds to be inhibited by inhibit source DFC_MOXEMM_SMU_ALM7_26" VAL_BLK 0x804F0882 ValA_Wu16 968.000000000 DINH_FIdVerb 0.00 968.000000000 FORMAT "%13.9" NUMBER 50 /end CHARACTERISTIC
/begin CHARACTERISTIC DINH_FId.DFC_MOXEMM_SMU_ALM7_28_CA "inhibitable FIds / FIds to be inhibited by inhibit source DFC_MOXEMM_SMU_ALM7_28" VAL_BLK 0x804F08E6 ValA_Wu16 968.000000000 DINH_FIdVerb 0.00 968.000000000 FORMAT "%13.9" NUMBER 50 /end CHARACTERISTIC
/begin CHARACTERISTIC DINH_FId.DFC_MOXEMM_SMU_ALM7_29_CA "inhibitable FIds / FIds to be inhibited by inhibit source DFC_MOXEMM_SMU_ALM7_29" VAL_BLK 0x804F094A ValA_Wu16 968.000000000 DINH_FIdVerb 0.00 968.000000000 FORMAT "%13.9" NUMBER 50 /end CHARACTERISTIC
/begin CHARACTERISTIC DINH_FId.DFC_MOXEMM_SMU_ALM7_30_CA "inhibitable FIds / FIds to be inhibited by inhibit source DFC_MOXEMM_SMU_ALM7_30" VAL_BLK 0x804F09AE ValA_Wu16 968.000000000 DINH_FIdVerb 0.00 968.000000000 FORMAT "%13.9" NUMBER 50 /end CHARACTERISTIC
/begin CHARACTERISTIC DINH_FId.DFC_MOXEMM_SMU_ALM7_31_CA "inhibitable FIds / FIds to be inhibited by inhibit source DFC_MOXEMM_SMU_ALM7_31" VAL_BLK 0x804F0A12 ValA_Wu16 968.000000000 DINH_FIdVerb 0.00 968.000000000 FORMAT "%13.9" NUMBER 50 /end CHARACTERISTIC
/begin CHARACTERISTIC DINH_FId.DFC_MOXEMM_SMU_ALM8_0_CA "inhibitable FIds / FIds to be inhibited by inhibit source DFC_MOXEMM_SMU_ALM8_0" VAL_BLK 0x804F0A76 ValA_Wu16 968.000000000 DINH_FIdVerb 0.00 968.000000000 FORMAT "%13.9" NUMBER 50 /end CHARACTERISTIC
/begin CHARACTERISTIC DINH_FId.DFC_MOXEMM_SMU_ALM8_1_CA "inhibitable FIds / FIds to be inhibited by inhibit source DFC_MOXEMM_SMU_ALM8_1" VAL_BLK 0x804F0ADA ValA_Wu16 968.000000000 DINH_FIdVerb 0.00 968.000000000 FORMAT "%13.9" NUMBER 50 /end CHARACTERISTIC
/begin CHARACTERISTIC DINH_FId.DFC_MOXEMM_SMU_ALM8_10_CA "inhibitable FIds / FIds to be inhibited by inhibit source DFC_MOXEMM_SMU_ALM8_10" VAL_BLK 0x804F0B3E ValA_Wu16 968.000000000 DINH_FIdVerb 0.00 968.000000000 FORMAT "%13.9" NUMBER 50 /end CHARACTERISTIC
/begin CHARACTERISTIC DINH_FId.DFC_MOXEMM_SMU_ALM8_11_CA "inhibitable FIds / FIds to be inhibited by inhibit source DFC_MOXEMM_SMU_ALM8_11" VAL_BLK 0x804F0BA2 ValA_Wu16 968.000000000 DINH_FIdVerb 0.00 968.000000000 FORMAT "%13.9" NUMBER 50 /end CHARACTERISTIC
/begin CHARACTERISTIC DINH_FId.DFC_MOXEMM_SMU_ALM8_12_CA "inhibitable FIds / FIds to be inhibited by inhibit source DFC_MOXEMM_SMU_ALM8_12" VAL_BLK 0x804F0C06 ValA_Wu16 968.000000000 DINH_FIdVerb 0.00 968.000000000 FORMAT "%13.9" NUMBER 50 /end CHARACTERISTIC
/begin CHARACTERISTIC DINH_FId.DFC_MOXEMM_SMU_ALM8_16_CA "inhibitable FIds / FIds to be inhibited by inhibit source DFC_MOXEMM_SMU_ALM8_16" VAL_BLK 0x804F0C6A ValA_Wu16 968.000000000 DINH_FIdVerb 0.00 968.000000000 FORMAT "%13.9" NUMBER 50 /end CHARACTERISTIC
/begin CHARACTERISTIC DINH_FId.DFC_MOXEMM_SMU_ALM8_18_CA "inhibitable FIds / FIds to be inhibited by inhibit source DFC_MOXEMM_SMU_ALM8_18" VAL_BLK 0x804F0CCE ValA_Wu16 968.000000000 DINH_FIdVerb 0.00 968.000000000 FORMAT "%13.9" NUMBER 50 /end CHARACTERISTIC
/begin CHARACTERISTIC DINH_FId.DFC_MOXEMM_SMU_ALM8_2_CA "inhibitable FIds / FIds to be inhibited by inhibit source DFC_MOXEMM_SMU_ALM8_2" VAL_BLK 0x804F0D32 ValA_Wu16 968.000000000 DINH_FIdVerb 0.00 968.000000000 FORMAT "%13.9" NUMBER 50 /end CHARACTERISTIC
/begin CHARACTERISTIC DINH_FId.DFC_MOXEMM_SMU_ALM8_3_CA "inhibitable FIds / FIds to be inhibited by inhibit source DFC_MOXEMM_SMU_ALM8_3" VAL_BLK 0x804F0D96 ValA_Wu16 968.000000000 DINH_FIdVerb 0.00 968.000000000 FORMAT "%13.9" NUMBER 50 /end CHARACTERISTIC
/begin CHARACTERISTIC DINH_FId.DFC_MOXEMM_SMU_ALM8_31_CA "inhibitable FIds / FIds to be inhibited by inhibit source DFC_MOXEMM_SMU_ALM8_31" VAL_BLK 0x804F0DFA ValA_Wu16 968.000000000 DINH_FIdVerb 0.00 968.000000000 FORMAT "%13.9" NUMBER 50 /end CHARACTERISTIC
/begin CHARACTERISTIC DINH_FId.DFC_MOXEMM_SMU_ALM8_4_CA "inhibitable FIds / FIds to be inhibited by inhibit source DFC_MOXEMM_SMU_ALM8_4" VAL_BLK 0x804F0E5E ValA_Wu16 968.000000000 DINH_FIdVerb 0.00 968.000000000 FORMAT "%13.9" NUMBER 50 /end CHARACTERISTIC
/begin CHARACTERISTIC DINH_FId.DFC_MOXEMM_SMU_ALM9_0_CA "inhibitable FIds / FIds to be inhibited by inhibit source DFC_MOXEMM_SMU_ALM9_0" VAL_BLK 0x804F0EC2 ValA_Wu16 968.000000000 DINH_FIdVerb 0.00 968.000000000 FORMAT "%13.9" NUMBER 50 /end CHARACTERISTIC
/begin CHARACTERISTIC DINH_FId.DFC_MOXEMM_SMU_ALM9_15_CA "inhibitable FIds / FIds to be inhibited by inhibit source DFC_MOXEMM_SMU_ALM9_15" VAL_BLK 0x804F0F26 ValA_Wu16 968.000000000 DINH_FIdVerb 0.00 968.000000000 FORMAT "%13.9" NUMBER 50 /end CHARACTERISTIC
/begin CHARACTERISTIC DINH_FId.DFC_MOXEMM_SMU_ALM9_3_CA "inhibitable FIds / FIds to be inhibited by inhibit source DFC_MOXEMM_SMU_ALM9_3" VAL_BLK 0x804F0F8A ValA_Wu16 968.000000000 DINH_FIdVerb 0.00 968.000000000 FORMAT "%13.9" NUMBER 50 /end CHARACTERISTIC
/begin CHARACTERISTIC DINH_FId.DFC_MoCADCNTP_CA "inhibitable FIds / FIds to be inhibited by inhibit source DFC_MoCADCNTP" VAL_BLK 0x804F0FEE ValA_Wu16 968.000000000 DINH_FIdVerb 0.00 968.000000000 FORMAT "%13.9" NUMBER 66 /end CHARACTERISTIC
/begin CHARACTERISTIC DINH_FId.DFC_MoCADCTst_CA "inhibitable FIds / FIds to be inhibited by inhibit source DFC_MoCADCTst" VAL_BLK 0x804F1072 ValA_Wu16 968.000000000 DINH_FIdVerb 0.00 968.000000000 FORMAT "%13.9" NUMBER 66 /end CHARACTERISTIC
/begin CHARACTERISTIC DINH_FId.DFC_MoCSOPICO_CA "inhibitable FIds / FIds to be inhibited by inhibit source DFC_MoCSOPICO" VAL_BLK 0x804F10F6 ValA_Wu16 968.000000000 DINH_FIdVerb 0.00 968.000000000 FORMAT "%13.9" NUMBER 51 /end CHARACTERISTIC
/begin CHARACTERISTIC DINH_FId.DFC_MoFAPP_CA "inhibitable FIds / FIds to be inhibited by inhibit source DFC_MoFAPP" VAL_BLK 0x804F115C ValA_Wu16 968.000000000 DINH_FIdVerb 0.00 968.000000000 FORMAT "%13.9" NUMBER 66 /end CHARACTERISTIC
/begin CHARACTERISTIC DINH_FId.DFC_MoFAirFilgPrdc_CA "inhibitable FIds / FIds to be inhibited by inhibit source DFC_MoFAirFilgPrdc" VAL_BLK 0x804F11E0 ValA_Wu16 968.000000000 DINH_FIdVerb 0.00 968.000000000 FORMAT "%13.9" NUMBER 65 /end CHARACTERISTIC
/begin CHARACTERISTIC DINH_FId.DFC_MoFAirFlCtOffGdi_CA "inhibitable FIds / FIds to be inhibited by inhibit source DFC_MoFAirFlCtOffGdi" VAL_BLK 0x804F1262 ValA_Wu16 968.000000000 DINH_FIdVerb 0.00 968.000000000 FORMAT "%13.9" NUMBER 51 /end CHARACTERISTIC
/begin CHARACTERISTIC DINH_FId.DFC_MoFAirFlCylGdi_CA "inhibitable FIds / FIds to be inhibited by inhibit source DFC_MoFAirFlCylGdi" VAL_BLK 0x804F12C8 ValA_Wu16 968.000000000 DINH_FIdVerb 0.00 968.000000000 FORMAT "%13.9" NUMBER 51 /end CHARACTERISTIC
/begin CHARACTERISTIC DINH_FId.DFC_MoFAirFlFF_CA "inhibitable FIds / FIds to be inhibited by inhibit source DFC_MoFAirFlFF" VAL_BLK 0x804F132E ValA_Wu16 968.000000000 DINH_FIdVerb 0.00 968.000000000 FORMAT "%13.9" NUMBER 51 /end CHARACTERISTIC
/begin CHARACTERISTIC DINH_FId.DFC_MoFAirFlIn_CA "inhibitable FIds / FIds to be inhibited by inhibit source DFC_MoFAirFlIn" VAL_BLK 0x804F1394 ValA_Wu16 968.000000000 DINH_FIdVerb 0.00 968.000000000 FORMAT "%13.9" NUMBER 51 /end CHARACTERISTIC
/begin CHARACTERISTIC DINH_FId.DFC_MoFAirFlMixCtlGdiChkAirFl_CA "inhibitable FIds / FIds to be inhibited by inhibit source DFC_MoFAirFlMixCtlGdiChkAirFl" VAL_BLK 0x804F13FA ValA_Wu16 968.000000000 DINH_FIdVerb 0.00 968.000000000 FORMAT "%13.9" NUMBER 51 /end CHARACTERISTIC
/begin CHARACTERISTIC DINH_FId.DFC_MoFAirFlMixCtlGdiChkCtrl_CA "inhibitable FIds / FIds to be inhibited by inhibit source DFC_MoFAirFlMixCtlGdiChkCtrl" VAL_BLK 0x804F1460 ValA_Wu16 968.000000000 DINH_FIdVerb 0.00 968.000000000 FORMAT "%13.9" NUMBER 51 /end CHARACTERISTIC
/begin CHARACTERISTIC DINH_FId.DFC_MoFAirFlMode_CA "inhibitable FIds / FIds to be inhibited by inhibit source DFC_MoFAirFlMode" VAL_BLK 0x804F14C6 ValA_Wu16 968.000000000 DINH_FIdVerb 0.00 968.000000000 FORMAT "%13.9" NUMBER 52 /end CHARACTERISTIC
/begin CHARACTERISTIC DINH_FId.DFC_MoFESpd_CA "inhibitable FIds / FIds to be inhibited by inhibit source DFC_MoFESpd" VAL_BLK 0x804F152E ValA_Wu16 968.000000000 DINH_FIdVerb 0.00 968.000000000 FORMAT "%13.9" NUMBER 66 /end CHARACTERISTIC
/begin CHARACTERISTIC DINH_FId.DFC_MoFIACo_CA "inhibitable FIds / FIds to be inhibited by inhibit source DFC_MoFIACo" VAL_BLK 0x804F15B2 ValA_Wu16 968.000000000 DINH_FIdVerb 0.00 968.000000000 FORMAT "%13.9" NUMBER 52 /end CHARACTERISTIC
/begin CHARACTERISTIC DINH_FId.DFC_MoFICOL1_CA "inhibitable FIds / FIds to be inhibited by inhibit source DFC_MoFICOL1" VAL_BLK 0x804F161A ValA_Wu16 968.000000000 DINH_FIdVerb 0.00 968.000000000 FORMAT "%13.9" NUMBER 64 /end CHARACTERISTIC
/begin CHARACTERISTIC DINH_FId.DFC_MoFICOL2_CA "inhibitable FIds / FIds to be inhibited by inhibit source DFC_MoFICOL2" VAL_BLK 0x804F169A ValA_Wu16 968.000000000 DINH_FIdVerb 0.00 968.000000000 FORMAT "%13.9" NUMBER 60 /end CHARACTERISTIC
/begin CHARACTERISTIC DINH_FId.DFC_MoFStrt_CA "inhibitable FIds / FIds to be inhibited by inhibit source DFC_MoFStrt" VAL_BLK 0x804F1712 ValA_Wu16 968.000000000 DINH_FIdVerb 0.00 968.000000000 FORMAT "%13.9" NUMBER 61 /end CHARACTERISTIC
/begin CHARACTERISTIC DINH_FId.DFC_MoFTrqCmp_CA "inhibitable FIds / FIds to be inhibited by inhibit source DFC_MoFTrqCmp" VAL_BLK 0x804F178C ValA_Wu16 968.000000000 DINH_FIdVerb 0.00 968.000000000 FORMAT "%13.9" NUMBER 65 /end CHARACTERISTIC
/begin CHARACTERISTIC DINH_FId.DFC_MoFTrqCmpMax_CA "inhibitable FIds / FIds to be inhibited by inhibit source DFC_MoFTrqCmpMax" VAL_BLK 0x804F180E ValA_Wu16 968.000000000 DINH_FIdVerb 0.00 968.000000000 FORMAT "%13.9" NUMBER 50 /end CHARACTERISTIC
/begin CHARACTERISTIC DINH_FId.DFC_MoFTrqCmpMin_CA "inhibitable FIds / FIds to be inhibited by inhibit source DFC_MoFTrqCmpMin" VAL_BLK 0x804F1872 ValA_Wu16 968.000000000 DINH_FIdVerb 0.00 968.000000000 FORMAT "%13.9" NUMBER 50 /end CHARACTERISTIC
/begin CHARACTERISTIC DINH_FId.DFC_MoFVarPostBldSel_CA "inhibitable FIds / FIds to be inhibited by inhibit source DFC_MoFVarPostBldSel" VAL_BLK 0x804F18D6 ValA_Wu16 968.000000000 DINH_FIdVerb 0.00 968.000000000 FORMAT "%13.9" NUMBER 50 /end CHARACTERISTIC
/begin CHARACTERISTIC DINH_FId.DFC_MoXEMMHwLTMCUFW_CA "inhibitable FIds / FIds to be inhibited by inhibit source DFC_MoXEMMHwLTMCUFW" VAL_BLK 0x804F193A ValA_Wu16 968.000000000 DINH_FIdVerb 0.00 968.000000000 FORMAT "%13.9" NUMBER 50 /end CHARACTERISTIC
/begin CHARACTERISTIC DINH_FId.DFC_MoXEMMHwLTMonBIST_CA "inhibitable FIds / FIds to be inhibited by inhibit source DFC_MoXEMMHwLTMonBIST" VAL_BLK 0x804F199E ValA_Wu16 968.000000000 DINH_FIdVerb 0.00 968.000000000 FORMAT "%13.9" NUMBER 50 /end CHARACTERISTIC
/begin CHARACTERISTIC DINH_FId.DFC_MoXEMMHwLTRegMonTest_CA "inhibitable FIds / FIds to be inhibited by inhibit source DFC_MoXEMMHwLTRegMonTest" VAL_BLK 0x804F1A02 ValA_Wu16 968.000000000 DINH_FIdVerb 0.00 968.000000000 FORMAT "%13.9" NUMBER 50 /end CHARACTERISTIC
/begin CHARACTERISTIC DINH_FId.DFC_MoXEMMHwLTStbySMUAlvTest_CA "inhibitable FIds / FIds to be inhibited by inhibit source DFC_MoXEMMHwLTStbySMUAlvTest" VAL_BLK 0x804F1A66 ValA_Wu16 968.000000000 DINH_FIdVerb 0.00 968.000000000 FORMAT "%13.9" NUMBER 50 /end CHARACTERISTIC
/begin CHARACTERISTIC DINH_FId.DFC_MoXEMMHwLTTempSens_CA "inhibitable FIds / FIds to be inhibited by inhibit source DFC_MoXEMMHwLTTempSens" VAL_BLK 0x804F1ACA ValA_Wu16 968.000000000 DINH_FIdVerb 0.00 968.000000000 FORMAT "%13.9" NUMBER 50 /end CHARACTERISTIC
/begin CHARACTERISTIC DINH_FId.DFC_MoXEMMHwLTUCBCfg_CA "inhibitable FIds / FIds to be inhibited by inhibit source DFC_MoXEMMHwLTUCBCfg" VAL_BLK 0x804F1B2E ValA_Wu16 968.000000000 DINH_FIdVerb 0.00 968.000000000 FORMAT "%13.9" NUMBER 50 /end CHARACTERISTIC
/begin CHARACTERISTIC DINH_FId.DFC_NWSEmax_CA "inhibitable FIds / FIds to be inhibited by inhibit source DFC_NWSEmax" VAL_BLK 0x804F1B92 ValA_Wu16 968.000000000 DINH_FIdVerb 0.00 968.000000000 FORMAT "%13.9" NUMBER 50 /end CHARACTERISTIC
/begin CHARACTERISTIC DINH_FId.DFC_NWSmax_CA "inhibitable FIds / FIds to be inhibited by inhibit source DFC_NWSmax" VAL_BLK 0x804F1BF6 ValA_Wu16 968.000000000 DINH_FIdVerb 0.00 968.000000000 FORMAT "%13.9" NUMBER 50 /end CHARACTERISTIC
/begin CHARACTERISTIC DINH_FId.DFC_OCWDAABEActv_CA "inhibitable FIds / FIds to be inhibited by inhibit source DFC_OCWDAABEActv" VAL_BLK 0x804F1C5A ValA_Wu16 968.000000000 DINH_FIdVerb 0.00 968.000000000 FORMAT "%13.9" NUMBER 51 /end CHARACTERISTIC
/begin CHARACTERISTIC DINH_FId.DFC_OCWDACom_CA "inhibitable FIds / FIds to be inhibited by inhibit source DFC_OCWDACom" VAL_BLK 0x804F1CC0 ValA_Wu16 968.000000000 DINH_FIdVerb 0.00 968.000000000 FORMAT "%13.9" NUMBER 53 /end CHARACTERISTIC
/begin CHARACTERISTIC DINH_FId.DFC_OCWDAErrPin_CA "inhibitable FIds / FIds to be inhibited by inhibit source DFC_OCWDAErrPin" VAL_BLK 0x804F1D2A ValA_Wu16 968.000000000 DINH_FIdVerb 0.00 968.000000000 FORMAT "%13.9" NUMBER 51 /end CHARACTERISTIC
/begin CHARACTERISTIC DINH_FId.DFC_OCWDAOvrVltg_CA "inhibitable FIds / FIds to be inhibited by inhibit source DFC_OCWDAOvrVltg" VAL_BLK 0x804F1D90 ValA_Wu16 968.000000000 DINH_FIdVerb 0.00 968.000000000 FORMAT "%13.9" NUMBER 51 /end CHARACTERISTIC
/begin CHARACTERISTIC DINH_FId.DFC_ORAmax_CA "inhibitable FIds / FIds to be inhibited by inhibit source DFC_ORAmax" VAL_BLK 0x804F1DF6 ValA_Wu16 968.000000000 DINH_FIdVerb 0.00 968.000000000 FORMAT "%13.9" NUMBER 73 /end CHARACTERISTIC
/begin CHARACTERISTIC DINH_FId.DFC_ORAmin_CA "inhibitable FIds / FIds to be inhibited by inhibit source DFC_ORAmin" VAL_BLK 0x804F1E88 ValA_Wu16 968.000000000 DINH_FIdVerb 0.00 968.000000000 FORMAT "%13.9" NUMBER 73 /end CHARACTERISTIC
/begin CHARACTERISTIC DINH_FId.DFC_OilPPlaus_CA "inhibitable FIds / FIds to be inhibited by inhibit source DFC_OilPPlaus" VAL_BLK 0x804F1F1A ValA_Wu16 968.000000000 DINH_FIdVerb 0.00 968.000000000 FORMAT "%13.9" NUMBER 52 /end CHARACTERISTIC
/begin CHARACTERISTIC DINH_FId.DFC_PLLSUmax_CA "inhibitable FIds / FIds to be inhibited by inhibit source DFC_PLLSUmax" VAL_BLK 0x804F1F82 ValA_Wu16 968.000000000 DINH_FIdVerb 0.00 968.000000000 FORMAT "%13.9" NUMBER 76 /end CHARACTERISTIC
/begin CHARACTERISTIC DINH_FId.DFC_PLLSUmin_CA "inhibitable FIds / FIds to be inhibited by inhibit source DFC_PLLSUmin" VAL_BLK 0x804F201A ValA_Wu16 968.000000000 DINH_FIdVerb 0.00 968.000000000 FORMAT "%13.9" NUMBER 76 /end CHARACTERISTIC
/begin CHARACTERISTIC DINH_FId.DFC_PSR1max_CA "inhibitable FIds / FIds to be inhibited by inhibit source DFC_PSR1max" VAL_BLK 0x804F20B2 ValA_Wu16 968.000000000 DINH_FIdVerb 0.00 968.000000000 FORMAT "%13.9" NUMBER 50 /end CHARACTERISTIC
/begin CHARACTERISTIC DINH_FId.DFC_PSRBmax_CA "inhibitable FIds / FIds to be inhibited by inhibit source DFC_PSRBmax" VAL_BLK 0x804F2116 ValA_Wu16 968.000000000 DINH_FIdVerb 0.00 968.000000000 FORMAT "%13.9" NUMBER 96 /end CHARACTERISTIC
/begin CHARACTERISTIC DINH_FId.DFC_PSRBmin_CA "inhibitable FIds / FIds to be inhibited by inhibit source DFC_PSRBmin" VAL_BLK 0x804F21D6 ValA_Wu16 968.000000000 DINH_FIdVerb 0.00 968.000000000 FORMAT "%13.9" NUMBER 96 /end CHARACTERISTIC
/begin CHARACTERISTIC DINH_FId.DFC_PSRPmax_CA "inhibitable FIds / FIds to be inhibited by inhibit source DFC_PSRPmax" VAL_BLK 0x804F2296 ValA_Wu16 968.000000000 DINH_FIdVerb 0.00 968.000000000 FORMAT "%13.9" NUMBER 95 /end CHARACTERISTIC
/begin CHARACTERISTIC DINH_FId.DFC_PSRPmin_CA "inhibitable FIds / FIds to be inhibited by inhibit source DFC_PSRPmin" VAL_BLK 0x804F2354 ValA_Wu16 968.000000000 DINH_FIdVerb 0.00 968.000000000 FORMAT "%13.9" NUMBER 95 /end CHARACTERISTIC
/begin CHARACTERISTIC DINH_FId.DFC_PSRPsig_CA "inhibitable FIds / FIds to be inhibited by inhibit source DFC_PSRPsig" VAL_BLK 0x804F2412 ValA_Wu16 968.000000000 DINH_FIdVerb 0.00 968.000000000 FORMAT "%13.9" NUMBER 89 /end CHARACTERISTIC
/begin CHARACTERISTIC DINH_FId.DFC_PSRmax_CA "inhibitable FIds / FIds to be inhibited by inhibit source DFC_PSRmax" VAL_BLK 0x804F24C4 ValA_Wu16 968.000000000 DINH_FIdVerb 0.00 968.000000000 FORMAT "%13.9" NUMBER 50 /end CHARACTERISTIC
/begin CHARACTERISTIC DINH_FId.DFC_PUmax_CA "inhibitable FIds / FIds to be inhibited by inhibit source DFC_PUmax" VAL_BLK 0x804F2528 ValA_Wu16 968.000000000 DINH_FIdVerb 0.00 968.000000000 FORMAT "%13.9" NUMBER 50 /end CHARACTERISTIC
/begin CHARACTERISTIC DINH_FId.DFC_P_VSE11_OL_CA "inhibitable FIds / FIds to be inhibited by inhibit source DFC_P_VSE11_OL" VAL_BLK 0x804F258C ValA_Wu16 968.000000000 DINH_FIdVerb 0.00 968.000000000 FORMAT "%13.9" NUMBER 82 /end CHARACTERISTIC
/begin CHARACTERISTIC DINH_FId.DFC_P_VSE11_SCB_CA "inhibitable FIds / FIds to be inhibited by inhibit source DFC_P_VSE11_SCB" VAL_BLK 0x804F2630 ValA_Wu16 968.000000000 DINH_FIdVerb 0.00 968.000000000 FORMAT "%13.9" NUMBER 82 /end CHARACTERISTIC
/begin CHARACTERISTIC DINH_FId.DFC_P_VSE11_SCG_CA "inhibitable FIds / FIds to be inhibited by inhibit source DFC_P_VSE11_SCG" VAL_BLK 0x804F26D4 ValA_Wu16 968.000000000 DINH_FIdVerb 0.00 968.000000000 FORMAT "%13.9" NUMBER 82 /end CHARACTERISTIC
/begin CHARACTERISTIC DINH_FId.DFC_PhyHighAPP1_CA "inhibitable FIds / FIds to be inhibited by inhibit source DFC_PhyHighAPP1" VAL_BLK 0x804F2778 ValA_Wu16 968.000000000 DINH_FIdVerb 0.00 968.000000000 FORMAT "%13.9" NUMBER 58 /end CHARACTERISTIC
/begin CHARACTERISTIC DINH_FId.DFC_PhyHighAPP2_CA "inhibitable FIds / FIds to be inhibited by inhibit source DFC_PhyHighAPP2" VAL_BLK 0x804F27EC ValA_Wu16 968.000000000 DINH_FIdVerb 0.00 968.000000000 FORMAT "%13.9" NUMBER 57 /end CHARACTERISTIC
/begin CHARACTERISTIC DINH_FId.DFC_PhyLowAPP1_CA "inhibitable FIds / FIds to be inhibited by inhibit source DFC_PhyLowAPP1" VAL_BLK 0x804F285E ValA_Wu16 968.000000000 DINH_FIdVerb 0.00 968.000000000 FORMAT "%13.9" NUMBER 58 /end CHARACTERISTIC
/begin CHARACTERISTIC DINH_FId.DFC_PhyLowAPP2_CA "inhibitable FIds / FIds to be inhibited by inhibit source DFC_PhyLowAPP2" VAL_BLK 0x804F28D2 ValA_Wu16 968.000000000 DINH_FIdVerb 0.00 968.000000000 FORMAT "%13.9" NUMBER 57 /end CHARACTERISTIC
/begin CHARACTERISTIC DINH_FId.DFC_SRCHighAPP1_CA "inhibitable FIds / FIds to be inhibited by inhibit source DFC_SRCHighAPP1" VAL_BLK 0x804F2944 ValA_Wu16 968.000000000 DINH_FIdVerb 0.00 968.000000000 FORMAT "%13.9" NUMBER 70 /end CHARACTERISTIC
/begin CHARACTERISTIC DINH_FId.DFC_SRCHighAPP2_CA "inhibitable FIds / FIds to be inhibited by inhibit source DFC_SRCHighAPP2" VAL_BLK 0x804F29D0 ValA_Wu16 968.000000000 DINH_FIdVerb 0.00 968.000000000 FORMAT "%13.9" NUMBER 69 /end CHARACTERISTIC
/begin CHARACTERISTIC DINH_FId.DFC_SRCLowAPP1_CA "inhibitable FIds / FIds to be inhibited by inhibit source DFC_SRCLowAPP1" VAL_BLK 0x804F2A5A ValA_Wu16 968.000000000 DINH_FIdVerb 0.00 968.000000000 FORMAT "%13.9" NUMBER 71 /end CHARACTERISTIC
/begin CHARACTERISTIC DINH_FId.DFC_SRCLowAPP2_CA "inhibitable FIds / FIds to be inhibited by inhibit source DFC_SRCLowAPP2" VAL_BLK 0x804F2AE8 ValA_Wu16 968.000000000 DINH_FIdVerb 0.00 968.000000000 FORMAT "%13.9" NUMBER 70 /end CHARACTERISTIC
/begin CHARACTERISTIC DINH_FId.DFC_SSpMon2_CA "inhibitable FIds / FIds to be inhibited by inhibit source DFC_SSpMon2" VAL_BLK 0x804F2B74 ValA_Wu16 968.000000000 DINH_FIdVerb 0.00 968.000000000 FORMAT "%13.9" NUMBER 79 /end CHARACTERISTIC
/begin CHARACTERISTIC DINH_FId.DFC_STHDRmax_CA "inhibitable FIds / FIds to be inhibited by inhibit source DFC_STHDRmax" VAL_BLK 0x804F2C12 ValA_Wu16 968.000000000 DINH_FIdVerb 0.00 968.000000000 FORMAT "%13.9" NUMBER 50 /end CHARACTERISTIC
/begin CHARACTERISTIC DINH_FId.DFC_SWReset_0_CA "inhibitable FIds / FIds to be inhibited by inhibit source DFC_SWReset_0" VAL_BLK 0x804F2C76 ValA_Wu16 968.000000000 DINH_FIdVerb 0.00 968.000000000 FORMAT "%13.9" NUMBER 50 /end CHARACTERISTIC
/begin CHARACTERISTIC DINH_FId.DFC_SWReset_1_CA "inhibitable FIds / FIds to be inhibited by inhibit source DFC_SWReset_1" VAL_BLK 0x804F2CDA ValA_Wu16 968.000000000 DINH_FIdVerb 0.00 968.000000000 FORMAT "%13.9" NUMBER 50 /end CHARACTERISTIC
/begin CHARACTERISTIC DINH_FId.DFC_SWReset_2_CA "inhibitable FIds / FIds to be inhibited by inhibit source DFC_SWReset_2" VAL_BLK 0x804F2D3E ValA_Wu16 968.000000000 DINH_FIdVerb 0.00 968.000000000 FORMAT "%13.9" NUMBER 50 /end CHARACTERISTIC
/begin CHARACTERISTIC DINH_FId.DFC_SyncAPP_CA "inhibitable FIds / FIds to be inhibited by inhibit source DFC_SyncAPP" VAL_BLK 0x804F2DA2 ValA_Wu16 968.000000000 DINH_FIdVerb 0.00 968.000000000 FORMAT "%13.9" NUMBER 74 /end CHARACTERISTIC
/begin CHARACTERISTIC DINH_FId.DFC_TANKLnpl_CA "inhibitable FIds / FIds to be inhibited by inhibit source DFC_TANKLnpl" VAL_BLK 0x804F2E36 ValA_Wu16 968.000000000 DINH_FIdVerb 0.00 968.000000000 FORMAT "%13.9" NUMBER 50 /end CHARACTERISTIC
/begin CHARACTERISTIC DINH_FId.DFC_TAmax_Dummy_CA "inhibitable FIds / FIds to be inhibited by inhibit source DFC_TAmax_Dummy" VAL_BLK 0x804F2E9A ValA_Wu16 968.000000000 DINH_FIdVerb 0.00 968.000000000 FORMAT "%13.9" NUMBER 50 /end CHARACTERISTIC
/begin CHARACTERISTIC DINH_FId.DFC_TESFmax_CA "inhibitable FIds / FIds to be inhibited by inhibit source DFC_TESFmax" VAL_BLK 0x804F2EFE ValA_Wu16 968.000000000 DINH_FIdVerb 0.00 968.000000000 FORMAT "%13.9" NUMBER 51 /end CHARACTERISTIC
/begin CHARACTERISTIC DINH_FId.DFC_TESGmax_CA "inhibitable FIds / FIds to be inhibited by inhibit source DFC_TESGmax" VAL_BLK 0x804F2F64 ValA_Wu16 968.000000000 DINH_FIdVerb 0.00 968.000000000 FORMAT "%13.9" NUMBER 53 /end CHARACTERISTIC
/begin CHARACTERISTIC DINH_FId.DFC_TKAEmax_CA "inhibitable FIds / FIds to be inhibited by inhibit source DFC_TKAEmax" VAL_BLK 0x804F2FCE ValA_Wu16 968.000000000 DINH_FIdVerb 0.00 968.000000000 FORMAT "%13.9" NUMBER 51 /end CHARACTERISTIC
/begin CHARACTERISTIC DINH_FId.DFC_TKAEmin_CA "inhibitable FIds / FIds to be inhibited by inhibit source DFC_TKAEmin" VAL_BLK 0x804F3034 ValA_Wu16 968.000000000 DINH_FIdVerb 0.00 968.000000000 FORMAT "%13.9" NUMBER 51 /end CHARACTERISTIC
/begin CHARACTERISTIC DINH_FId.DFC_TKARmax_CA "inhibitable FIds / FIds to be inhibited by inhibit source DFC_TKARmax" VAL_BLK 0x804F309A ValA_Wu16 968.000000000 DINH_FIdVerb 0.00 968.000000000 FORMAT "%13.9" NUMBER 51 /end CHARACTERISTIC
/begin CHARACTERISTIC DINH_FId.DFC_TKARnpl_CA "inhibitable FIds / FIds to be inhibited by inhibit source DFC_TKARnpl" VAL_BLK 0x804F3100 ValA_Wu16 968.000000000 DINH_FIdVerb 0.00 968.000000000 FORMAT "%13.9" NUMBER 51 /end CHARACTERISTIC
/begin CHARACTERISTIC DINH_FId.DFC_TMmax_Dummy_CA "inhibitable FIds / FIds to be inhibited by inhibit source DFC_TMmax_Dummy" VAL_BLK 0x804F3166 ValA_Wu16 968.000000000 DINH_FIdVerb 0.00 968.000000000 FORMAT "%13.9" NUMBER 50 /end CHARACTERISTIC
/begin CHARACTERISTIC DINH_FId.DFC_TUMmax_Dummy_CA "inhibitable FIds / FIds to be inhibited by inhibit source DFC_TUMmax_Dummy" VAL_BLK 0x804F31CA ValA_Wu16 968.000000000 DINH_FIdVerb 0.00 968.000000000 FORMAT "%13.9" NUMBER 50 /end CHARACTERISTIC
/begin CHARACTERISTIC DINH_FId.DFC_TWCDPriCatB1_CA "inhibitable FIds / FIds to be inhibited by inhibit source DFC_TWCDPriCatB1" VAL_BLK 0x804F322E ValA_Wu16 968.000000000 DINH_FIdVerb 0.00 968.000000000 FORMAT "%13.9" NUMBER 54 /end CHARACTERISTIC
/begin CHARACTERISTIC DINH_FId.DFC_ThrVlvClsdPosnFirstOffsLrnImpoB1_CA "inhibitable FIds / FIds to be inhibited by inhibit source DFC_ThrVlvClsdPosnFirstOffsLrnImpoB1" VAL_BLK 0x804F329A ValA_Wu16 968.000000000 DINH_FIdVerb 0.00 968.000000000 FORMAT "%13.9" NUMBER 75 /end CHARACTERISTIC
/begin CHARACTERISTIC DINH_FId.DFC_ThrVlvClsdPosnOffsLrnImpoB1_CA "inhibitable FIds / FIds to be inhibited by inhibit source DFC_ThrVlvClsdPosnOffsLrnImpoB1" VAL_BLK 0x804F3330 ValA_Wu16 968.000000000 DINH_FIdVerb 0.00 968.000000000 FORMAT "%13.9" NUMBER 59 /end CHARACTERISTIC
/begin CHARACTERISTIC DINH_FId.DFC_ThrVlvClsdPosnOffsLrnMaxB1_CA "inhibitable FIds / FIds to be inhibited by inhibit source DFC_ThrVlvClsdPosnOffsLrnMaxB1" VAL_BLK 0x804F33A6 ValA_Wu16 968.000000000 DINH_FIdVerb 0.00 968.000000000 FORMAT "%13.9" NUMBER 59 /end CHARACTERISTIC
/begin CHARACTERISTIC DINH_FId.DFC_ThrVlvClsdPosnOffsLrnMinB1_CA "inhibitable FIds / FIds to be inhibited by inhibit source DFC_ThrVlvClsdPosnOffsLrnMinB1" VAL_BLK 0x804F341C ValA_Wu16 968.000000000 DINH_FIdVerb 0.00 968.000000000 FORMAT "%13.9" NUMBER 59 /end CHARACTERISTIC
/begin CHARACTERISTIC DINH_FId.DFC_ThrVlvCtrlDeB1_CA "inhibitable FIds / FIds to be inhibited by inhibit source DFC_ThrVlvCtrlDeB1" VAL_BLK 0x804F3492 ValA_Wu16 968.000000000 DINH_FIdVerb 0.00 968.000000000 FORMAT "%13.9" NUMBER 70 /end CHARACTERISTIC
/begin CHARACTERISTIC DINH_FId.DFC_ThrVlvDycB1_CA "inhibitable FIds / FIds to be inhibited by inhibit source DFC_ThrVlvDycB1" VAL_BLK 0x804F351E ValA_Wu16 968.000000000 DINH_FIdVerb 0.00 968.000000000 FORMAT "%13.9" NUMBER 70 /end CHARACTERISTIC
/begin CHARACTERISTIC DINH_FId.DFC_ThrVlvLimpAirPosnMaxAbsltDriftB1_CA "inhibitable FIds / FIds to be inhibited by inhibit source DFC_ThrVlvLimpAirPosnMaxAbsltDriftB1" VAL_BLK 0x804F35AA ValA_Wu16 968.000000000 DINH_FIdVerb 0.00 968.000000000 FORMAT "%13.9" NUMBER 54 /end CHARACTERISTIC
/begin CHARACTERISTIC DINH_FId.DFC_ThrVlvLimpAirPosnMaxB1_CA "inhibitable FIds / FIds to be inhibited by inhibit source DFC_ThrVlvLimpAirPosnMaxB1" VAL_BLK 0x804F3616 ValA_Wu16 968.000000000 DINH_FIdVerb 0.00 968.000000000 FORMAT "%13.9" NUMBER 54 /end CHARACTERISTIC
/begin CHARACTERISTIC DINH_FId.DFC_ThrVlvLimpAirPosnMaxRelDriftB1_CA "inhibitable FIds / FIds to be inhibited by inhibit source DFC_ThrVlvLimpAirPosnMaxRelDriftB1" VAL_BLK 0x804F3682 ValA_Wu16 968.000000000 DINH_FIdVerb 0.00 968.000000000 FORMAT "%13.9" NUMBER 54 /end CHARACTERISTIC
/begin CHARACTERISTIC DINH_FId.DFC_ThrVlvLimpAirPosnMinB1_CA "inhibitable FIds / FIds to be inhibited by inhibit source DFC_ThrVlvLimpAirPosnMinB1" VAL_BLK 0x804F36EE ValA_Wu16 968.000000000 DINH_FIdVerb 0.00 968.000000000 FORMAT "%13.9" NUMBER 54 /end CHARACTERISTIC
/begin CHARACTERISTIC DINH_FId.DFC_ThrVlvOpenLoadB1_CA "inhibitable FIds / FIds to be inhibited by inhibit source DFC_ThrVlvOpenLoadB1" VAL_BLK 0x804F375A ValA_Wu16 968.000000000 DINH_FIdVerb 0.00 968.000000000 FORMAT "%13.9" NUMBER 67 /end CHARACTERISTIC
/begin CHARACTERISTIC DINH_FId.DFC_ThrVlvOpenSprgB1_CA "inhibitable FIds / FIds to be inhibited by inhibit source DFC_ThrVlvOpenSprgB1" VAL_BLK 0x804F37E0 ValA_Wu16 968.000000000 DINH_FIdVerb 0.00 968.000000000 FORMAT "%13.9" NUMBER 65 /end CHARACTERISTIC
/begin CHARACTERISTIC DINH_FId.DFC_ThrVlvOpenSprgSprdB1_CA "inhibitable FIds / FIds to be inhibited by inhibit source DFC_ThrVlvOpenSprgSprdB1" VAL_BLK 0x804F3862 ValA_Wu16 968.000000000 DINH_FIdVerb 0.00 968.000000000 FORMAT "%13.9" NUMBER 53 /end CHARACTERISTIC
/begin CHARACTERISTIC DINH_FId.DFC_ThrVlvOpenSprgTwnB1_CA "inhibitable FIds / FIds to be inhibited by inhibit source DFC_ThrVlvOpenSprgTwnB1" VAL_BLK 0x804F38CC ValA_Wu16 968.000000000 DINH_FIdVerb 0.00 968.000000000 FORMAT "%13.9" NUMBER 52 /end CHARACTERISTIC
/begin CHARACTERISTIC DINH_FId.DFC_ThrVlvOverTB1_CA "inhibitable FIds / FIds to be inhibited by inhibit source DFC_ThrVlvOverTB1" VAL_BLK 0x804F3934 ValA_Wu16 968.000000000 DINH_FIdVerb 0.00 968.000000000 FORMAT "%13.9" NUMBER 67 /end CHARACTERISTIC
/begin CHARACTERISTIC DINH_FId.DFC_ThrVlvRetSprgB1_CA "inhibitable FIds / FIds to be inhibited by inhibit source DFC_ThrVlvRetSprgB1" VAL_BLK 0x804F39BA ValA_Wu16 968.000000000 DINH_FIdVerb 0.00 968.000000000 FORMAT "%13.9" NUMBER 67 /end CHARACTERISTIC
/begin CHARACTERISTIC DINH_FId.DFC_ThrVlvRetSprgSprdB1_CA "inhibitable FIds / FIds to be inhibited by inhibit source DFC_ThrVlvRetSprgSprdB1" VAL_BLK 0x804F3A40 ValA_Wu16 968.000000000 DINH_FIdVerb 0.00 968.000000000 FORMAT "%13.9" NUMBER 53 /end CHARACTERISTIC
/begin CHARACTERISTIC DINH_FId.DFC_ThrVlvRetSprgTwnB1_CA "inhibitable FIds / FIds to be inhibited by inhibit source DFC_ThrVlvRetSprgTwnB1" VAL_BLK 0x804F3AAA ValA_Wu16 968.000000000 DINH_FIdVerb 0.00 968.000000000 FORMAT "%13.9" NUMBER 52 /end CHARACTERISTIC
/begin CHARACTERISTIC DINH_FId.DFC_ThrVlvSens1MaxB1_CA "inhibitable FIds / FIds to be inhibited by inhibit source DFC_ThrVlvSens1MaxB1" VAL_BLK 0x804F3B12 ValA_Wu16 968.000000000 DINH_FIdVerb 0.00 968.000000000 FORMAT "%13.9" NUMBER 96 /end CHARACTERISTIC
/begin CHARACTERISTIC DINH_FId.DFC_ThrVlvSens1NplB1_CA "inhibitable FIds / FIds to be inhibited by inhibit source DFC_ThrVlvSens1NplB1" VAL_BLK 0x804F3BD2 ValA_Wu16 968.000000000 DINH_FIdVerb 0.00 968.000000000 FORMAT "%13.9" NUMBER 96 /end CHARACTERISTIC
/begin CHARACTERISTIC DINH_FId.DFC_ThrVlvSens2MaxB1_CA "inhibitable FIds / FIds to be inhibited by inhibit source DFC_ThrVlvSens2MaxB1" VAL_BLK 0x804F3C92 ValA_Wu16 968.000000000 DINH_FIdVerb 0.00 968.000000000 FORMAT "%13.9" NUMBER 96 /end CHARACTERISTIC
/begin CHARACTERISTIC DINH_FId.DFC_ThrVlvSens2MinB1_CA "inhibitable FIds / FIds to be inhibited by inhibit source DFC_ThrVlvSens2MinB1" VAL_BLK 0x804F3D52 ValA_Wu16 968.000000000 DINH_FIdVerb 0.00 968.000000000 FORMAT "%13.9" NUMBER 96 /end CHARACTERISTIC
/begin CHARACTERISTIC DINH_FId.DFC_ThrVlvSens2NplB1_CA "inhibitable FIds / FIds to be inhibited by inhibit source DFC_ThrVlvSens2NplB1" VAL_BLK 0x804F3E12 ValA_Wu16 968.000000000 DINH_FIdVerb 0.00 968.000000000 FORMAT "%13.9" NUMBER 96 /end CHARACTERISTIC
/begin CHARACTERISTIC DINH_FId.DFC_ThrVlvShoCircB1_CA "inhibitable FIds / FIds to be inhibited by inhibit source DFC_ThrVlvShoCircB1" VAL_BLK 0x804F3ED2 ValA_Wu16 968.000000000 DINH_FIdVerb 0.00 968.000000000 FORMAT "%13.9" NUMBER 67 /end CHARACTERISTIC
/begin CHARACTERISTIC DINH_FId.DFC_ThrVlvSpiErrB1_CA "inhibitable FIds / FIds to be inhibited by inhibit source DFC_ThrVlvSpiErrB1" VAL_BLK 0x804F3F58 ValA_Wu16 968.000000000 DINH_FIdVerb 0.00 968.000000000 FORMAT "%13.9" NUMBER 67 /end CHARACTERISTIC
/begin CHARACTERISTIC DINH_FId.DFC_ThrvlvSens1MinB1_CA "inhibitable FIds / FIds to be inhibited by inhibit source DFC_ThrvlvSens1MinB1" VAL_BLK 0x804F3FDE ValA_Wu16 968.000000000 DINH_FIdVerb 0.00 968.000000000 FORMAT "%13.9" NUMBER 96 /end CHARACTERISTIC
/begin CHARACTERISTIC DINH_FId.DFC_TiOffTBasdChkFast_CA "inhibitable FIds / FIds to be inhibited by inhibit source DFC_TiOffTBasdChkFast" VAL_BLK 0x804F409E ValA_Wu16 968.000000000 DINH_FIdVerb 0.00 968.000000000 FORMAT "%13.9" NUMBER 55 /end CHARACTERISTIC
/begin CHARACTERISTIC DINH_FId.DFC_TiOffTBasdChkSlow_CA "inhibitable FIds / FIds to be inhibited by inhibit source DFC_TiOffTBasdChkSlow" VAL_BLK 0x804F410C ValA_Wu16 968.000000000 DINH_FIdVerb 0.00 968.000000000 FORMAT "%13.9" NUMBER 55 /end CHARACTERISTIC
/begin CHARACTERISTIC DINH_FId.DFC_UEGOSnsrMntdS1B1_CA "inhibitable FIds / FIds to be inhibited by inhibit source DFC_UEGOSnsrMntdS1B1" VAL_BLK 0x804F417A ValA_Wu16 968.000000000 DINH_FIdVerb 0.00 968.000000000 FORMAT "%13.9" NUMBER 75 /end CHARACTERISTIC
/begin CHARACTERISTIC DINH_FId.DFC_VehVSig_CA "inhibitable FIds / FIds to be inhibited by inhibit source DFC_VehVSig" VAL_BLK 0x804F4210 ValA_Wu16 968.000000000 DINH_FIdVerb 0.00 968.000000000 FORMAT "%13.9" NUMBER 92 /end CHARACTERISTIC
/begin CHARACTERISTIC DINH_FId.DFC_VlvLftFbSwtIntk11SpclFail_CA "inhibitable FIds / FIds to be inhibited by inhibit source DFC_VlvLftFbSwtIntk11SpclFail" VAL_BLK 0x804F42C8 ValA_Wu16 968.000000000 DINH_FIdVerb 0.00 968.000000000 FORMAT "%13.9" NUMBER 84 /end CHARACTERISTIC
/begin CHARACTERISTIC DINH_FId.DFC_VlvLftFbSwtIntk11StdFail_CA "inhibitable FIds / FIds to be inhibited by inhibit source DFC_VlvLftFbSwtIntk11StdFail" VAL_BLK 0x804F4370 ValA_Wu16 968.000000000 DINH_FIdVerb 0.00 968.000000000 FORMAT "%13.9" NUMBER 84 /end CHARACTERISTIC
/begin CHARACTERISTIC DINH_FId.DSQ_ACClntP_CA "inhibitable FIds / FIds to be inhibited by inhibit source DSQ_ACClntP" VAL_BLK 0x804F4418 ValA_Wu16 968.000000000 DINH_FIdVerb 0.00 968.000000000 FORMAT "%13.9" NUMBER 50 /end CHARACTERISTIC
/begin CHARACTERISTIC DINH_FId.DSQ_ACEvpT_CA "inhibitable FIds / FIds to be inhibited by inhibit source DSQ_ACEvpT" VAL_BLK 0x804F447C ValA_Wu16 968.000000000 DINH_FIdVerb 0.00 968.000000000 FORMAT "%13.9" NUMBER 50 /end CHARACTERISTIC
/begin CHARACTERISTIC DINH_FId.DSQ_AirCCmprActr_CA "inhibitable FIds / FIds to be inhibited by inhibit source DSQ_AirCCmprActr" VAL_BLK 0x804F44E0 ValA_Wu16 968.000000000 DINH_FIdVerb 0.00 968.000000000 FORMAT "%13.9" NUMBER 50 /end CHARACTERISTIC
/begin CHARACTERISTIC DINH_FId.DSQ_BattU_CA "inhibitable FIds / FIds to be inhibited by inhibit source DSQ_BattU" VAL_BLK 0x804F4544 ValA_Wu16 968.000000000 DINH_FIdVerb 0.00 968.000000000 FORMAT "%13.9" NUMBER 53 /end CHARACTERISTIC
/begin CHARACTERISTIC DINH_FId.DSQ_BattULo_CA "inhibitable FIds / FIds to be inhibited by inhibit source DSQ_BattULo" VAL_BLK 0x804F45AE ValA_Wu16 968.000000000 DINH_FIdVerb 0.00 968.000000000 FORMAT "%13.9" NUMBER 51 /end CHARACTERISTIC
/begin CHARACTERISTIC DINH_FId.DSQ_BrkBstPMdl_CA "inhibitable FIds / FIds to be inhibited by inhibit source DSQ_BrkBstPMdl" VAL_BLK 0x804F4614 ValA_Wu16 968.000000000 DINH_FIdVerb 0.00 968.000000000 FORMAT "%13.9" NUMBER 50 /end CHARACTERISTIC
/begin CHARACTERISTIC DINH_FId.DSQ_BrkP_CA "inhibitable FIds / FIds to be inhibited by inhibit source DSQ_BrkP" VAL_BLK 0x804F4678 ValA_Wu16 968.000000000 DINH_FIdVerb 0.00 968.000000000 FORMAT "%13.9" NUMBER 51 /end CHARACTERISTIC
/begin CHARACTERISTIC DINH_FId.DSQ_BrkPSnsr_CA "inhibitable FIds / FIds to be inhibited by inhibit source DSQ_BrkPSnsr" VAL_BLK 0x804F46DE ValA_Wu16 968.000000000 DINH_FIdVerb 0.00 968.000000000 FORMAT "%13.9" NUMBER 52 /end CHARACTERISTIC
/begin CHARACTERISTIC DINH_FId.DSQ_CoVMDIDASFail_CA "inhibitable FIds / FIds to be inhibited by inhibit source DSQ_CoVMDIDASFail" VAL_BLK 0x804F4746 ValA_Wu16 968.000000000 DINH_FIdVerb 0.00 968.000000000 FORMAT "%13.9" NUMBER 50 /end CHARACTERISTIC
/begin CHARACTERISTIC DINH_FId.DSQ_DSMInhibitAlways_CA "inhibitable FIds / FIds to be inhibited by inhibit source DSQ_DSMInhibitAlways" VAL_BLK 0x804F47AA ValA_Wu16 968.000000000 DINH_FIdVerb 0.00 968.000000000 FORMAT "%13.9" NUMBER 51 /end CHARACTERISTIC
/begin CHARACTERISTIC DINH_FId.DSQ_EGRVlv_GovDesVal_CA "inhibitable FIds / FIds to be inhibited by inhibit source DSQ_EGRVlv_GovDesVal" VAL_BLK 0x804F4810 ValA_Wu16 968.000000000 DINH_FIdVerb 0.00 968.000000000 FORMAT "%13.9" NUMBER 51 /end CHARACTERISTIC
/begin CHARACTERISTIC DINH_FId.DSQ_ElecLd_CA "inhibitable FIds / FIds to be inhibited by inhibit source DSQ_ElecLd" VAL_BLK 0x804F4876 ValA_Wu16 968.000000000 DINH_FIdVerb 0.00 968.000000000 FORMAT "%13.9" NUMBER 51 /end CHARACTERISTIC
/begin CHARACTERISTIC DINH_FId.DSQ_EngICO_CA "inhibitable FIds / FIds to be inhibited by inhibit source DSQ_EngICO" VAL_BLK 0x804F48DC ValA_Wu16 968.000000000 DINH_FIdVerb 0.00 968.000000000 FORMAT "%13.9" NUMBER 50 /end CHARACTERISTIC
/begin CHARACTERISTIC DINH_FId.DSQ_EpmCaSSigQuality_CA "inhibitable FIds / FIds to be inhibited by inhibit source DSQ_EpmCaSSigQuality" VAL_BLK 0x804F4940 ValA_Wu16 968.000000000 DINH_FIdVerb 0.00 968.000000000 FORMAT "%13.9" NUMBER 55 /end CHARACTERISTIC
/begin CHARACTERISTIC DINH_FId.DSQ_EpmReverseRun_CA "inhibitable FIds / FIds to be inhibited by inhibit source DSQ_EpmReverseRun" VAL_BLK 0x804F49AE ValA_Wu16 968.000000000 DINH_FIdVerb 0.00 968.000000000 FORMAT "%13.9" NUMBER 52 /end CHARACTERISTIC
/begin CHARACTERISTIC DINH_FId.DSQ_FanDIO_0_CA "inhibitable FIds / FIds to be inhibited by inhibit source DSQ_FanDIO_0" VAL_BLK 0x804F4A16 ValA_Wu16 968.000000000 DINH_FIdVerb 0.00 968.000000000 FORMAT "%13.9" NUMBER 50 /end CHARACTERISTIC
/begin CHARACTERISTIC DINH_FId.DSQ_FanDIO_1_CA "inhibitable FIds / FIds to be inhibited by inhibit source DSQ_FanDIO_1" VAL_BLK 0x804F4A7A ValA_Wu16 968.000000000 DINH_FIdVerb 0.00 968.000000000 FORMAT "%13.9" NUMBER 50 /end CHARACTERISTIC
/begin CHARACTERISTIC DINH_FId.DSQ_FuelP_CA "inhibitable FIds / FIds to be inhibited by inhibit source DSQ_FuelP" VAL_BLK 0x804F4ADE ValA_Wu16 968.000000000 DINH_FIdVerb 0.00 968.000000000 FORMAT "%13.9" NUMBER 50 /end CHARACTERISTIC
/begin CHARACTERISTIC DINH_FId.DSQ_FuelT_CA "inhibitable FIds / FIds to be inhibited by inhibit source DSQ_FuelT" VAL_BLK 0x804F4B42 ValA_Wu16 968.000000000 DINH_FIdVerb 0.00 968.000000000 FORMAT "%13.9" NUMBER 50 /end CHARACTERISTIC
/begin CHARACTERISTIC DINH_FId.DSQ_GEVCtlTOilCylHd_CA "inhibitable FIds / FIds to be inhibited by inhibit source DSQ_GEVCtlTOilCylHd" VAL_BLK 0x804F4BA6 ValA_Wu16 968.000000000 DINH_FIdVerb 0.00 968.000000000 FORMAT "%13.9" NUMBER 54 /end CHARACTERISTIC
/begin CHARACTERISTIC DINH_FId.DSQ_GEVlvAgIntkB1_CA "inhibitable FIds / FIds to be inhibited by inhibit source DSQ_GEVlvAgIntkB1" VAL_BLK 0x804F4C12 ValA_Wu16 968.000000000 DINH_FIdVerb 0.00 968.000000000 FORMAT "%13.9" NUMBER 51 /end CHARACTERISTIC
/begin CHARACTERISTIC DINH_FId.DSQ_GbxPNPos_CA "inhibitable FIds / FIds to be inhibited by inhibit source DSQ_GbxPNPos" VAL_BLK 0x804F4C78 ValA_Wu16 968.000000000 DINH_FIdVerb 0.00 968.000000000 FORMAT "%13.9" NUMBER 51 /end CHARACTERISTIC
/begin CHARACTERISTIC DINH_FId.DSQ_GbxPosNotPN_CA "inhibitable FIds / FIds to be inhibited by inhibit source DSQ_GbxPosNotPN" VAL_BLK 0x804F4CDE ValA_Wu16 968.000000000 DINH_FIdVerb 0.00 968.000000000 FORMAT "%13.9" NUMBER 51 /end CHARACTERISTIC
/begin CHARACTERISTIC DINH_FId.DSQ_InjVlv_DI_CylOk_CA "inhibitable FIds / FIds to be inhibited by inhibit source DSQ_InjVlv_DI_CylOk" VAL_BLK 0x804F4D44 ValA_Wu16 968.000000000 DINH_FIdVerb 0.00 968.000000000 FORMAT "%13.9" NUMBER 50 /end CHARACTERISTIC
/begin CHARACTERISTIC DINH_FId.DSQ_MRly_CA "inhibitable FIds / FIds to be inhibited by inhibit source DSQ_MRly" VAL_BLK 0x804F4DA8 ValA_Wu16 968.000000000 DINH_FIdVerb 0.00 968.000000000 FORMAT "%13.9" NUMBER 50 /end CHARACTERISTIC
/begin CHARACTERISTIC DINH_FId.DSQ_OilP_CA "inhibitable FIds / FIds to be inhibited by inhibit source DSQ_OilP" VAL_BLK 0x804F4E0C ValA_Wu16 968.000000000 DINH_FIdVerb 0.00 968.000000000 FORMAT "%13.9" NUMBER 50 /end CHARACTERISTIC
/begin CHARACTERISTIC DINH_FId.DSQ_PEnvMeasVld_CA "inhibitable FIds / FIds to be inhibited by inhibit source DSQ_PEnvMeasVld" VAL_BLK 0x804F4E70 ValA_Wu16 968.000000000 DINH_FIdVerb 0.00 968.000000000 FORMAT "%13.9" NUMBER 52 /end CHARACTERISTIC
/begin CHARACTERISTIC DINH_FId.DSQ_PEnvVld_CA "inhibitable FIds / FIds to be inhibited by inhibit source DSQ_PEnvVld" VAL_BLK 0x804F4ED8 ValA_Wu16 968.000000000 DINH_FIdVerb 0.00 968.000000000 FORMAT "%13.9" NUMBER 54 /end CHARACTERISTIC
/begin CHARACTERISTIC DINH_FId.DSQ_PEnv_pRaw_CA "inhibitable FIds / FIds to be inhibited by inhibit source DSQ_PEnv_pRaw" VAL_BLK 0x804F4F44 ValA_Wu16 968.000000000 DINH_FIdVerb 0.00 968.000000000 FORMAT "%13.9" NUMBER 51 /end CHARACTERISTIC
/begin CHARACTERISTIC DINH_FId.DSQ_PRail_CA "inhibitable FIds / FIds to be inhibited by inhibit source DSQ_PRail" VAL_BLK 0x804F4FAA ValA_Wu16 968.000000000 DINH_FIdVerb 0.00 968.000000000 FORMAT "%13.9" NUMBER 50 /end CHARACTERISTIC
/begin CHARACTERISTIC DINH_FId.DSQ_PThrVlvUs_CA "inhibitable FIds / FIds to be inhibited by inhibit source DSQ_PThrVlvUs" VAL_BLK 0x804F500E ValA_Wu16 968.000000000 DINH_FIdVerb 0.00 968.000000000 FORMAT "%13.9" NUMBER 50 /end CHARACTERISTIC
/begin CHARACTERISTIC DINH_FId.DSQ_PThrVlvUsB1_CA "inhibitable FIds / FIds to be inhibited by inhibit source DSQ_PThrVlvUsB1" VAL_BLK 0x804F5072 ValA_Wu16 968.000000000 DINH_FIdVerb 0.00 968.000000000 FORMAT "%13.9" NUMBER 50 /end CHARACTERISTIC
/begin CHARACTERISTIC DINH_FId.DSQ_StrtImobChk_CA "inhibitable FIds / FIds to be inhibited by inhibit source DSQ_StrtImobChk" VAL_BLK 0x804F50D6 ValA_Wu16 968.000000000 DINH_FIdVerb 0.00 968.000000000 FORMAT "%13.9" NUMBER 50 /end CHARACTERISTIC
/begin CHARACTERISTIC DINH_FId.DSQ_TDevCenColdStrt_CA "inhibitable FIds / FIds to be inhibited by inhibit source DSQ_TDevCenColdStrt" VAL_BLK 0x804F513A ValA_Wu16 968.000000000 DINH_FIdVerb 0.00 968.000000000 FORMAT "%13.9" NUMBER 55 /end CHARACTERISTIC
/begin CHARACTERISTIC DINH_FId.DSQ_VehV_CA "inhibitable FIds / FIds to be inhibited by inhibit source DSQ_VehV" VAL_BLK 0x804F51A8 ValA_Wu16 968.000000000 DINH_FIdVerb 0.00 968.000000000 FORMAT "%13.9" NUMBER 58 /end CHARACTERISTIC
/begin CHARACTERISTIC DINH_FId.DSQ_VehVSens_CA "inhibitable FIds / FIds to be inhibited by inhibit source DSQ_VehVSens" VAL_BLK 0x804F521C ValA_Wu16 968.000000000 DINH_FIdVerb 0.00 968.000000000 FORMAT "%13.9" NUMBER 53 /end CHARACTERISTIC
/begin CHARACTERISTIC DINH_FId.DSQ_VehVSnsr_CA "inhibitable FIds / FIds to be inhibited by inhibit source DSQ_VehVSnsr" VAL_BLK 0x804F5286 ValA_Wu16 968.000000000 DINH_FIdVerb 0.00 968.000000000 FORMAT "%13.9" NUMBER 62 /end CHARACTERISTIC
/begin CHARACTERISTIC DINH_FId.DSQ_stAPP_CA "inhibitable FIds / FIds to be inhibited by inhibit source DSQ_stAPP" VAL_BLK 0x804F5302 ValA_Wu16 968.000000000 DINH_FIdVerb 0.00 968.000000000 FORMAT "%13.9" NUMBER 58 /end CHARACTERISTIC
/begin CHARACTERISTIC DINH_FId.DSQ_stComEAT4_CA "inhibitable FIds / FIds to be inhibited by inhibit source DSQ_stComEAT4" VAL_BLK 0x804F5376 ValA_Wu16 968.000000000 DINH_FIdVerb 0.00 968.000000000 FORMAT "%13.9" NUMBER 50 /end CHARACTERISTIC
/begin CHARACTERISTIC DINH_Lim.DFC_AAVEmax_CA "inhibit conditions / inhibit limit conditions for inhibit source DFC_AAVEmax" VAL_BLK 0x804F6218 ValA_Wu8 17.0000000000 DINH_LimDFCVerb 0.00 17.0000000000 FORMAT "%13.10" NUMBER 59 /end CHARACTERISTIC
/begin CHARACTERISTIC DINH_Lim.DFC_AAVEmin_CA "inhibit conditions / inhibit limit conditions for inhibit source DFC_AAVEmin" VAL_BLK 0x804F6253 ValA_Wu8 17.0000000000 DINH_LimDFCVerb 0.00 17.0000000000 FORMAT "%13.10" NUMBER 60 /end CHARACTERISTIC
/begin CHARACTERISTIC DINH_Lim.DFC_AAVEsig_CA "inhibit conditions / inhibit limit conditions for inhibit source DFC_AAVEsig" VAL_BLK 0x804F628F ValA_Wu8 17.0000000000 DINH_LimDFCVerb 0.00 17.0000000000 FORMAT "%13.10" NUMBER 59 /end CHARACTERISTIC
/begin CHARACTERISTIC DINH_Lim.DFC_AltIOACGFailr_CA "inhibit conditions / inhibit limit conditions for inhibit source DFC_AltIOACGFailr" VAL_BLK 0x804F62CA ValA_Wu8 17.0000000000 DINH_LimDFCVerb 0.00 17.0000000000 FORMAT "%13.10" NUMBER 65 /end CHARACTERISTIC
/begin CHARACTERISTIC DINH_Lim.DFC_AltIOACGHiVltg_CA "inhibit conditions / inhibit limit conditions for inhibit source DFC_AltIOACGHiVltg" VAL_BLK 0x804F630B ValA_Wu8 17.0000000000 DINH_LimDFCVerb 0.00 17.0000000000 FORMAT "%13.10" NUMBER 65 /end CHARACTERISTIC
/begin CHARACTERISTIC DINH_Lim.DFC_AltIOACGLoVltg_CA "inhibit conditions / inhibit limit conditions for inhibit source DFC_AltIOACGLoVltg" VAL_BLK 0x804F634C ValA_Wu8 17.0000000000 DINH_LimDFCVerb 0.00 17.0000000000 FORMAT "%13.10" NUMBER 65 /end CHARACTERISTIC
/begin CHARACTERISTIC DINH_Lim.DFC_AltIOACGTHi_CA "inhibit conditions / inhibit limit conditions for inhibit source DFC_AltIOACGTHi" VAL_BLK 0x804F638D ValA_Wu8 17.0000000000 DINH_LimDFCVerb 0.00 17.0000000000 FORMAT "%13.10" NUMBER 59 /end CHARACTERISTIC
/begin CHARACTERISTIC DINH_Lim.DFC_AltIODConnACG_CA "inhibit conditions / inhibit limit conditions for inhibit source DFC_AltIODConnACG" VAL_BLK 0x804F63C8 ValA_Wu8 17.0000000000 DINH_LimDFCVerb 0.00 17.0000000000 FORMAT "%13.10" NUMBER 65 /end CHARACTERISTIC
/begin CHARACTERISTIC DINH_Lim.DFC_BGOELWAF_CA "inhibit conditions / inhibit limit conditions for inhibit source DFC_BGOELWAF" VAL_BLK 0x804F6409 ValA_Wu8 17.0000000000 DINH_LimDFCVerb 0.00 17.0000000000 FORMAT "%13.10" NUMBER 50 /end CHARACTERISTIC
/begin CHARACTERISTIC DINH_Lim.DFC_BattUHiFailr_CA "inhibit conditions / inhibit limit conditions for inhibit source DFC_BattUHiFailr" VAL_BLK 0x804F643B ValA_Wu8 17.0000000000 DINH_LimDFCVerb 0.00 17.0000000000 FORMAT "%13.10" NUMBER 51 /end CHARACTERISTIC
/begin CHARACTERISTIC DINH_Lim.DFC_BattULoFailr_CA "inhibit conditions / inhibit limit conditions for inhibit source DFC_BattULoFailr" VAL_BLK 0x804F646E ValA_Wu8 17.0000000000 DINH_LimDFCVerb 0.00 17.0000000000 FORMAT "%13.10" NUMBER 51 /end CHARACTERISTIC
/begin CHARACTERISTIC DINH_Lim.DFC_BrkBstPDriftHiErr_CA "inhibit conditions / inhibit limit conditions for inhibit source DFC_BrkBstPDriftHiErr" VAL_BLK 0x804F64A1 ValA_Wu8 17.0000000000 DINH_LimDFCVerb 0.00 17.0000000000 FORMAT "%13.10" NUMBER 55 /end CHARACTERISTIC
/begin CHARACTERISTIC DINH_Lim.DFC_BrkBstPDriftLoErr_CA "inhibit conditions / inhibit limit conditions for inhibit source DFC_BrkBstPDriftLoErr" VAL_BLK 0x804F64D8 ValA_Wu8 17.0000000000 DINH_LimDFCVerb 0.00 17.0000000000 FORMAT "%13.10" NUMBER 55 /end CHARACTERISTIC
/begin CHARACTERISTIC DINH_Lim.DFC_BrkBstPSnsrStuck_CA "inhibit conditions / inhibit limit conditions for inhibit source DFC_BrkBstPSnsrStuck" VAL_BLK 0x804F650F ValA_Wu8 17.0000000000 DINH_LimDFCVerb 0.00 17.0000000000 FORMAT "%13.10" NUMBER 56 /end CHARACTERISTIC
/begin CHARACTERISTIC DINH_Lim.DFC_BrkMnSwtContOn_CA "inhibit conditions / inhibit limit conditions for inhibit source DFC_BrkMnSwtContOn" VAL_BLK 0x804F6547 ValA_Wu8 17.0000000000 DINH_LimDFCVerb 0.00 17.0000000000 FORMAT "%13.10" NUMBER 55 /end CHARACTERISTIC
/begin CHARACTERISTIC DINH_Lim.DFC_BrkMnSwtNotStp_CA "inhibit conditions / inhibit limit conditions for inhibit source DFC_BrkMnSwtNotStp" VAL_BLK 0x804F657E ValA_Wu8 17.0000000000 DINH_LimDFCVerb 0.00 17.0000000000 FORMAT "%13.10" NUMBER 55 /end CHARACTERISTIC
/begin CHARACTERISTIC DINH_Lim.DFC_BrkNpl_CA "inhibit conditions / inhibit limit conditions for inhibit source DFC_BrkNpl" VAL_BLK 0x804F65B5 ValA_Wu8 17.0000000000 DINH_LimDFCVerb 0.00 17.0000000000 FORMAT "%13.10" NUMBER 54 /end CHARACTERISTIC
/begin CHARACTERISTIC DINH_Lim.DFC_BrkRdntSwtContOn_CA "inhibit conditions / inhibit limit conditions for inhibit source DFC_BrkRdntSwtContOn" VAL_BLK 0x804F65EB ValA_Wu8 17.0000000000 DINH_LimDFCVerb 0.00 17.0000000000 FORMAT "%13.10" NUMBER 55 /end CHARACTERISTIC
/begin CHARACTERISTIC DINH_Lim.DFC_BrkRdntSwtNotStp_CA "inhibit conditions / inhibit limit conditions for inhibit source DFC_BrkRdntSwtNotStp" VAL_BLK 0x804F6622 ValA_Wu8 17.0000000000 DINH_LimDFCVerb 0.00 17.0000000000 FORMAT "%13.10" NUMBER 55 /end CHARACTERISTIC
/begin CHARACTERISTIC DINH_Lim.DFC_Clth3ONStuck_CA "inhibit conditions / inhibit limit conditions for inhibit source DFC_Clth3ONStuck" VAL_BLK 0x804F6659 ValA_Wu8 17.0000000000 DINH_LimDFCVerb 0.00 17.0000000000 FORMAT "%13.10" NUMBER 63 /end CHARACTERISTIC
/begin CHARACTERISTIC DINH_Lim.DFC_Clth4OFFStuck_CA "inhibit conditions / inhibit limit conditions for inhibit source DFC_Clth4OFFStuck" VAL_BLK 0x804F6698 ValA_Wu8 17.0000000000 DINH_LimDFCVerb 0.00 17.0000000000 FORMAT "%13.10" NUMBER 59 /end CHARACTERISTIC
/begin CHARACTERISTIC DINH_Lim.DFC_ClthOFFStuck_CA "inhibit conditions / inhibit limit conditions for inhibit source DFC_ClthOFFStuck" VAL_BLK 0x804F66D3 ValA_Wu8 17.0000000000 DINH_LimDFCVerb 0.00 17.0000000000 FORMAT "%13.10" NUMBER 60 /end CHARACTERISTIC
/begin CHARACTERISTIC DINH_Lim.DFC_ClthONStuck_CA "inhibit conditions / inhibit limit conditions for inhibit source DFC_ClthONStuck" VAL_BLK 0x804F670F ValA_Wu8 17.0000000000 DINH_LimDFCVerb 0.00 17.0000000000 FORMAT "%13.10" NUMBER 60 /end CHARACTERISTIC
/begin CHARACTERISTIC DINH_Lim.DFC_ClthStkFailInfo_CA "inhibit conditions / inhibit limit conditions for inhibit source DFC_ClthStkFailInfo" VAL_BLK 0x804F674B ValA_Wu8 17.0000000000 DINH_LimDFCVerb 0.00 17.0000000000 FORMAT "%13.10" NUMBER 68 /end CHARACTERISTIC
/begin CHARACTERISTIC DINH_Lim.DFC_ComACFailInfo_CA "inhibit conditions / inhibit limit conditions for inhibit source DFC_ComACFailInfo" VAL_BLK 0x804F678F ValA_Wu8 17.0000000000 DINH_LimDFCVerb 0.00 17.0000000000 FORMAT "%13.10" NUMBER 53 /end CHARACTERISTIC
/begin CHARACTERISTIC DINH_Lim.DFC_ComATFTValErr_CA "inhibit conditions / inhibit limit conditions for inhibit source DFC_ComATFTValErr" VAL_BLK 0x804F67C4 ValA_Wu8 17.0000000000 DINH_LimDFCVerb 0.00 17.0000000000 FORMAT "%13.10" NUMBER 50 /end CHARACTERISTIC
/begin CHARACTERISTIC DINH_Lim.DFC_ComATMILReq_CA "inhibit conditions / inhibit limit conditions for inhibit source DFC_ComATMILReq" VAL_BLK 0x804F67F6 ValA_Wu8 17.0000000000 DINH_LimDFCVerb 0.00 17.0000000000 FORMAT "%13.10" NUMBER 50 /end CHARACTERISTIC
/begin CHARACTERISTIC DINH_Lim.DFC_ComAYCAChksum_CA "inhibit conditions / inhibit limit conditions for inhibit source DFC_ComAYCAChksum" VAL_BLK 0x804F6828 ValA_Wu8 17.0000000000 DINH_LimDFCVerb 0.00 17.0000000000 FORMAT "%13.10" NUMBER 67 /end CHARACTERISTIC
/begin CHARACTERISTIC DINH_Lim.DFC_ComAYCARingCnt_CA "inhibit conditions / inhibit limit conditions for inhibit source DFC_ComAYCARingCnt" VAL_BLK 0x804F686B ValA_Wu8 17.0000000000 DINH_LimDFCVerb 0.00 17.0000000000 FORMAT "%13.10" NUMBER 67 /end CHARACTERISTIC
/begin CHARACTERISTIC DINH_Lim.DFC_ComAYCATOut_CA "inhibit conditions / inhibit limit conditions for inhibit source DFC_ComAYCATOut" VAL_BLK 0x804F68AE ValA_Wu8 17.0000000000 DINH_LimDFCVerb 0.00 17.0000000000 FORMAT "%13.10" NUMBER 67 /end CHARACTERISTIC
/begin CHARACTERISTIC DINH_Lim.DFC_ComAYCDChkSum_CA "inhibit conditions / inhibit limit conditions for inhibit source DFC_ComAYCDChkSum" VAL_BLK 0x804F68F1 ValA_Wu8 17.0000000000 DINH_LimDFCVerb 0.00 17.0000000000 FORMAT "%13.10" NUMBER 66 /end CHARACTERISTIC
/begin CHARACTERISTIC DINH_Lim.DFC_ComAYCDTOut_CA "inhibit conditions / inhibit limit conditions for inhibit source DFC_ComAYCDTOut" VAL_BLK 0x804F6933 ValA_Wu8 17.0000000000 DINH_LimDFCVerb 0.00 17.0000000000 FORMAT "%13.10" NUMBER 66 /end CHARACTERISTIC
/begin CHARACTERISTIC DINH_Lim.DFC_ComAYCFChksum_CA "inhibit conditions / inhibit limit conditions for inhibit source DFC_ComAYCFChksum" VAL_BLK 0x804F6975 ValA_Wu8 17.0000000000 DINH_LimDFCVerb 0.00 17.0000000000 FORMAT "%13.10" NUMBER 69 /end CHARACTERISTIC
/begin CHARACTERISTIC DINH_Lim.DFC_ComAYCFRingCnt_CA "inhibit conditions / inhibit limit conditions for inhibit source DFC_ComAYCFRingCnt" VAL_BLK 0x804F69BA ValA_Wu8 17.0000000000 DINH_LimDFCVerb 0.00 17.0000000000 FORMAT "%13.10" NUMBER 69 /end CHARACTERISTIC
/begin CHARACTERISTIC DINH_Lim.DFC_ComAYCFTOut_CA "inhibit conditions / inhibit limit conditions for inhibit source DFC_ComAYCFTOut" VAL_BLK 0x804F69FF ValA_Wu8 17.0000000000 DINH_LimDFCVerb 0.00 17.0000000000 FORMAT "%13.10" NUMBER 69 /end CHARACTERISTIC
/begin CHARACTERISTIC DINH_Lim.DFC_ComAYCGChksum_CA "inhibit conditions / inhibit limit conditions for inhibit source DFC_ComAYCGChksum" VAL_BLK 0x804F6A44 ValA_Wu8 17.0000000000 DINH_LimDFCVerb 0.00 17.0000000000 FORMAT "%13.10" NUMBER 64 /end CHARACTERISTIC
/begin CHARACTERISTIC DINH_Lim.DFC_ComAYCGRingCnt_CA "inhibit conditions / inhibit limit conditions for inhibit source DFC_ComAYCGRingCnt" VAL_BLK 0x804F6A84 ValA_Wu8 17.0000000000 DINH_LimDFCVerb 0.00 17.0000000000 FORMAT "%13.10" NUMBER 64 /end CHARACTERISTIC
/begin CHARACTERISTIC DINH_Lim.DFC_ComAYCGTOut_CA "inhibit conditions / inhibit limit conditions for inhibit source DFC_ComAYCGTOut" VAL_BLK 0x804F6AC4 ValA_Wu8 17.0000000000 DINH_LimDFCVerb 0.00 17.0000000000 FORMAT "%13.10" NUMBER 64 /end CHARACTERISTIC
/begin CHARACTERISTIC DINH_Lim.DFC_ComAYCIChkSum_CA "inhibit conditions / inhibit limit conditions for inhibit source DFC_ComAYCIChkSum" VAL_BLK 0x804F6B04 ValA_Wu8 17.0000000000 DINH_LimDFCVerb 0.00 17.0000000000 FORMAT "%13.10" NUMBER 58 /end CHARACTERISTIC
/begin CHARACTERISTIC DINH_Lim.DFC_ComAYCIRingCnt_CA "inhibit conditions / inhibit limit conditions for inhibit source DFC_ComAYCIRingCnt" VAL_BLK 0x804F6B3E ValA_Wu8 17.0000000000 DINH_LimDFCVerb 0.00 17.0000000000 FORMAT "%13.10" NUMBER 58 /end CHARACTERISTIC
/begin CHARACTERISTIC DINH_Lim.DFC_ComAYCITOut_CA "inhibit conditions / inhibit limit conditions for inhibit source DFC_ComAYCITOut" VAL_BLK 0x804F6B78 ValA_Wu8 17.0000000000 DINH_LimDFCVerb 0.00 17.0000000000 FORMAT "%13.10" NUMBER 58 /end CHARACTERISTIC
/begin CHARACTERISTIC DINH_Lim.DFC_ComBCM1ChkSum_CA "inhibit conditions / inhibit limit conditions for inhibit source DFC_ComBCM1ChkSum" VAL_BLK 0x804F6BB2 ValA_Wu8 17.0000000000 DINH_LimDFCVerb 0.00 17.0000000000 FORMAT "%13.10" NUMBER 55 /end CHARACTERISTIC
/begin CHARACTERISTIC DINH_Lim.DFC_ComBCM1RingCnt_CA "inhibit conditions / inhibit limit conditions for inhibit source DFC_ComBCM1RingCnt" VAL_BLK 0x804F6BE9 ValA_Wu8 17.0000000000 DINH_LimDFCVerb 0.00 17.0000000000 FORMAT "%13.10" NUMBER 55 /end CHARACTERISTIC
/begin CHARACTERISTIC DINH_Lim.DFC_ComBCM1TOut_CA "inhibit conditions / inhibit limit conditions for inhibit source DFC_ComBCM1TOut" VAL_BLK 0x804F6C20 ValA_Wu8 17.0000000000 DINH_LimDFCVerb 0.00 17.0000000000 FORMAT "%13.10" NUMBER 55 /end CHARACTERISTIC
/begin CHARACTERISTIC DINH_Lim.DFC_ComCANABusOffErr_CA "inhibit conditions / inhibit limit conditions for inhibit source DFC_ComCANABusOffErr" VAL_BLK 0x804F6C57 ValA_Wu8 17.0000000000 DINH_LimDFCVerb 0.00 17.0000000000 FORMAT "%13.10" NUMBER 201 /end CHARACTERISTIC
/begin CHARACTERISTIC DINH_Lim.DFC_ComCANBBusOffErr_CA "inhibit conditions / inhibit limit conditions for inhibit source DFC_ComCANBBusOffErr" VAL_BLK 0x804F6D20 ValA_Wu8 17.0000000000 DINH_LimDFCVerb 0.00 17.0000000000 FORMAT "%13.10" NUMBER 200 /end CHARACTERISTIC
/begin CHARACTERISTIC DINH_Lim.DFC_ComCANCBusOffErr_CA "inhibit conditions / inhibit limit conditions for inhibit source DFC_ComCANCBusOffErr" VAL_BLK 0x804F6DE8 ValA_Wu8 17.0000000000 DINH_LimDFCVerb 0.00 17.0000000000 FORMAT "%13.10" NUMBER 200 /end CHARACTERISTIC
/begin CHARACTERISTIC DINH_Lim.DFC_ComCGW1ChkSum_CA "inhibit conditions / inhibit limit conditions for inhibit source DFC_ComCGW1ChkSum" VAL_BLK 0x804F6EB0 ValA_Wu8 17.0000000000 DINH_LimDFCVerb 0.00 17.0000000000 FORMAT "%13.10" NUMBER 53 /end CHARACTERISTIC
/begin CHARACTERISTIC DINH_Lim.DFC_ComCGW1RingCnt_CA "inhibit conditions / inhibit limit conditions for inhibit source DFC_ComCGW1RingCnt" VAL_BLK 0x804F6EE5 ValA_Wu8 17.0000000000 DINH_LimDFCVerb 0.00 17.0000000000 FORMAT "%13.10" NUMBER 53 /end CHARACTERISTIC
/begin CHARACTERISTIC DINH_Lim.DFC_ComCGW1TOut_CA "inhibit conditions / inhibit limit conditions for inhibit source DFC_ComCGW1TOut" VAL_BLK 0x804F6F1A ValA_Wu8 17.0000000000 DINH_LimDFCVerb 0.00 17.0000000000 FORMAT "%13.10" NUMBER 53 /end CHARACTERISTIC
/begin CHARACTERISTIC DINH_Lim.DFC_ComConvBoostErr_CA "inhibit conditions / inhibit limit conditions for inhibit source DFC_ComConvBoostErr" VAL_BLK 0x804F6F4F ValA_Wu8 17.0000000000 DINH_LimDFCVerb 0.00 17.0000000000 FORMAT "%13.10" NUMBER 51 /end CHARACTERISTIC
/begin CHARACTERISTIC DINH_Lim.DFC_ComConvSlipErr_CA "inhibit conditions / inhibit limit conditions for inhibit source DFC_ComConvSlipErr" VAL_BLK 0x804F6F82 ValA_Wu8 17.0000000000 DINH_LimDFCVerb 0.00 17.0000000000 FORMAT "%13.10" NUMBER 51 /end CHARACTERISTIC
/begin CHARACTERISTIC DINH_Lim.DFC_ComDCDCPrfmncErr_CA "inhibit conditions / inhibit limit conditions for inhibit source DFC_ComDCDCPrfmncErr" VAL_BLK 0x804F6FB5 ValA_Wu8 17.0000000000 DINH_LimDFCVerb 0.00 17.0000000000 FORMAT "%13.10" NUMBER 57 /end CHARACTERISTIC
/begin CHARACTERISTIC DINH_Lim.DFC_ComDCDCTempWarn_CA "inhibit conditions / inhibit limit conditions for inhibit source DFC_ComDCDCTempWarn" VAL_BLK 0x804F6FEE ValA_Wu8 17.0000000000 DINH_LimDFCVerb 0.00 17.0000000000 FORMAT "%13.10" NUMBER 54 /end CHARACTERISTIC
/begin CHARACTERISTIC DINH_Lim.DFC_ComEAT10Chksum_CA "inhibit conditions / inhibit limit conditions for inhibit source DFC_ComEAT10Chksum" VAL_BLK 0x804F7024 ValA_Wu8 17.0000000000 DINH_LimDFCVerb 0.00 17.0000000000 FORMAT "%13.10" NUMBER 60 /end CHARACTERISTIC
/begin CHARACTERISTIC DINH_Lim.DFC_ComEAT10RingCnt_CA "inhibit conditions / inhibit limit conditions for inhibit source DFC_ComEAT10RingCnt" VAL_BLK 0x804F7060 ValA_Wu8 17.0000000000 DINH_LimDFCVerb 0.00 17.0000000000 FORMAT "%13.10" NUMBER 60 /end CHARACTERISTIC
/begin CHARACTERISTIC DINH_Lim.DFC_ComEAT10TOut_CA "inhibit conditions / inhibit limit conditions for inhibit source DFC_ComEAT10TOut" VAL_BLK 0x804F709C ValA_Wu8 17.0000000000 DINH_LimDFCVerb 0.00 17.0000000000 FORMAT "%13.10" NUMBER 60 /end CHARACTERISTIC
/begin CHARACTERISTIC DINH_Lim.DFC_ComEAT11ChkSum_CA "inhibit conditions / inhibit limit conditions for inhibit source DFC_ComEAT11ChkSum" VAL_BLK 0x804F70D8 ValA_Wu8 17.0000000000 DINH_LimDFCVerb 0.00 17.0000000000 FORMAT "%13.10" NUMBER 53 /end CHARACTERISTIC
/begin CHARACTERISTIC DINH_Lim.DFC_ComEAT11RingCnt_CA "inhibit conditions / inhibit limit conditions for inhibit source DFC_ComEAT11RingCnt" VAL_BLK 0x804F710D ValA_Wu8 17.0000000000 DINH_LimDFCVerb 0.00 17.0000000000 FORMAT "%13.10" NUMBER 53 /end CHARACTERISTIC
/begin CHARACTERISTIC DINH_Lim.DFC_ComEAT11TOut_CA "inhibit conditions / inhibit limit conditions for inhibit source DFC_ComEAT11TOut" VAL_BLK 0x804F7142 ValA_Wu8 17.0000000000 DINH_LimDFCVerb 0.00 17.0000000000 FORMAT "%13.10" NUMBER 53 /end CHARACTERISTIC
/begin CHARACTERISTIC DINH_Lim.DFC_ComEAT12ChkSum_CA "inhibit conditions / inhibit limit conditions for inhibit source DFC_ComEAT12ChkSum" VAL_BLK 0x804F7177 ValA_Wu8 17.0000000000 DINH_LimDFCVerb 0.00 17.0000000000 FORMAT "%13.10" NUMBER 53 /end CHARACTERISTIC
/begin CHARACTERISTIC DINH_Lim.DFC_ComEAT12RingCnt_CA "inhibit conditions / inhibit limit conditions for inhibit source DFC_ComEAT12RingCnt" VAL_BLK 0x804F71AC ValA_Wu8 17.0000000000 DINH_LimDFCVerb 0.00 17.0000000000 FORMAT "%13.10" NUMBER 53 /end CHARACTERISTIC
/begin CHARACTERISTIC DINH_Lim.DFC_ComEAT12TOut_CA "inhibit conditions / inhibit limit conditions for inhibit source DFC_ComEAT12TOut" VAL_BLK 0x804F71E1 ValA_Wu8 17.0000000000 DINH_LimDFCVerb 0.00 17.0000000000 FORMAT "%13.10" NUMBER 53 /end CHARACTERISTIC
/begin CHARACTERISTIC DINH_Lim.DFC_ComEAT13ChkSum_CA "inhibit conditions / inhibit limit conditions for inhibit source DFC_ComEAT13ChkSum" VAL_BLK 0x804F7216 ValA_Wu8 17.0000000000 DINH_LimDFCVerb 0.00 17.0000000000 FORMAT "%13.10" NUMBER 57 /end CHARACTERISTIC
/begin CHARACTERISTIC DINH_Lim.DFC_ComEAT13RingCnt_CA "inhibit conditions / inhibit limit conditions for inhibit source DFC_ComEAT13RingCnt" VAL_BLK 0x804F724F ValA_Wu8 17.0000000000 DINH_LimDFCVerb 0.00 17.0000000000 FORMAT "%13.10" NUMBER 57 /end CHARACTERISTIC
/begin CHARACTERISTIC DINH_Lim.DFC_ComEAT13TOut_CA "inhibit conditions / inhibit limit conditions for inhibit source DFC_ComEAT13TOut" VAL_BLK 0x804F7288 ValA_Wu8 17.0000000000 DINH_LimDFCVerb 0.00 17.0000000000 FORMAT "%13.10" NUMBER 57 /end CHARACTERISTIC
/begin CHARACTERISTIC DINH_Lim.DFC_ComEAT1Chksum_CA "inhibit conditions / inhibit limit conditions for inhibit source DFC_ComEAT1Chksum" VAL_BLK 0x804F72C1 ValA_Wu8 17.0000000000 DINH_LimDFCVerb 0.00 17.0000000000 FORMAT "%13.10" NUMBER 57 /end CHARACTERISTIC
/begin CHARACTERISTIC DINH_Lim.DFC_ComEAT1RingCnt_CA "inhibit conditions / inhibit limit conditions for inhibit source DFC_ComEAT1RingCnt" VAL_BLK 0x804F72FA ValA_Wu8 17.0000000000 DINH_LimDFCVerb 0.00 17.0000000000 FORMAT "%13.10" NUMBER 57 /end CHARACTERISTIC
/begin CHARACTERISTIC DINH_Lim.DFC_ComEAT1TOut_CA "inhibit conditions / inhibit limit conditions for inhibit source DFC_ComEAT1TOut" VAL_BLK 0x804F7333 ValA_Wu8 17.0000000000 DINH_LimDFCVerb 0.00 17.0000000000 FORMAT "%13.10" NUMBER 57 /end CHARACTERISTIC
/begin CHARACTERISTIC DINH_Lim.DFC_ComEAT2ChkSum_CA "inhibit conditions / inhibit limit conditions for inhibit source DFC_ComEAT2ChkSum" VAL_BLK 0x804F736C ValA_Wu8 17.0000000000 DINH_LimDFCVerb 0.00 17.0000000000 FORMAT "%13.10" NUMBER 58 /end CHARACTERISTIC
/begin CHARACTERISTIC DINH_Lim.DFC_ComEAT2RingCnt_CA "inhibit conditions / inhibit limit conditions for inhibit source DFC_ComEAT2RingCnt" VAL_BLK 0x804F73A6 ValA_Wu8 17.0000000000 DINH_LimDFCVerb 0.00 17.0000000000 FORMAT "%13.10" NUMBER 58 /end CHARACTERISTIC
/begin CHARACTERISTIC DINH_Lim.DFC_ComEAT2TOut_CA "inhibit conditions / inhibit limit conditions for inhibit source DFC_ComEAT2TOut" VAL_BLK 0x804F73E0 ValA_Wu8 17.0000000000 DINH_LimDFCVerb 0.00 17.0000000000 FORMAT "%13.10" NUMBER 58 /end CHARACTERISTIC
/begin CHARACTERISTIC DINH_Lim.DFC_ComEAT4ChkSum_CA "inhibit conditions / inhibit limit conditions for inhibit source DFC_ComEAT4ChkSum" VAL_BLK 0x804F741A ValA_Wu8 17.0000000000 DINH_LimDFCVerb 0.00 17.0000000000 FORMAT "%13.10" NUMBER 58 /end CHARACTERISTIC
/begin CHARACTERISTIC DINH_Lim.DFC_ComEAT4RingCnt_CA "inhibit conditions / inhibit limit conditions for inhibit source DFC_ComEAT4RingCnt" VAL_BLK 0x804F7454 ValA_Wu8 17.0000000000 DINH_LimDFCVerb 0.00 17.0000000000 FORMAT "%13.10" NUMBER 58 /end CHARACTERISTIC
/begin CHARACTERISTIC DINH_Lim.DFC_ComEAT4TOut_CA "inhibit conditions / inhibit limit conditions for inhibit source DFC_ComEAT4TOut" VAL_BLK 0x804F748E ValA_Wu8 17.0000000000 DINH_LimDFCVerb 0.00 17.0000000000 FORMAT "%13.10" NUMBER 58 /end CHARACTERISTIC
/begin CHARACTERISTIC DINH_Lim.DFC_ComEAT6Chksum_CA "inhibit conditions / inhibit limit conditions for inhibit source DFC_ComEAT6Chksum" VAL_BLK 0x804F74C8 ValA_Wu8 17.0000000000 DINH_LimDFCVerb 0.00 17.0000000000 FORMAT "%13.10" NUMBER 59 /end CHARACTERISTIC
/begin CHARACTERISTIC DINH_Lim.DFC_ComEAT6RingCnt_CA "inhibit conditions / inhibit limit conditions for inhibit source DFC_ComEAT6RingCnt" VAL_BLK 0x804F7503 ValA_Wu8 17.0000000000 DINH_LimDFCVerb 0.00 17.0000000000 FORMAT "%13.10" NUMBER 59 /end CHARACTERISTIC
/begin CHARACTERISTIC DINH_Lim.DFC_ComEAT6TOut_CA "inhibit conditions / inhibit limit conditions for inhibit source DFC_ComEAT6TOut" VAL_BLK 0x804F753E ValA_Wu8 17.0000000000 DINH_LimDFCVerb 0.00 17.0000000000 FORMAT "%13.10" NUMBER 59 /end CHARACTERISTIC
/begin CHARACTERISTIC DINH_Lim.DFC_ComEAT7Chksum_CA "inhibit conditions / inhibit limit conditions for inhibit source DFC_ComEAT7Chksum" VAL_BLK 0x804F7579 ValA_Wu8 17.0000000000 DINH_LimDFCVerb 0.00 17.0000000000 FORMAT "%13.10" NUMBER 58 /end CHARACTERISTIC
/begin CHARACTERISTIC DINH_Lim.DFC_ComEAT7RingCnt_CA "inhibit conditions / inhibit limit conditions for inhibit source DFC_ComEAT7RingCnt" VAL_BLK 0x804F75B3 ValA_Wu8 17.0000000000 DINH_LimDFCVerb 0.00 17.0000000000 FORMAT "%13.10" NUMBER 58 /end CHARACTERISTIC
/begin CHARACTERISTIC DINH_Lim.DFC_ComEAT7TOut_CA "inhibit conditions / inhibit limit conditions for inhibit source DFC_ComEAT7TOut" VAL_BLK 0x804F75ED ValA_Wu8 17.0000000000 DINH_LimDFCVerb 0.00 17.0000000000 FORMAT "%13.10" NUMBER 58 /end CHARACTERISTIC
/begin CHARACTERISTIC DINH_Lim.DFC_ComEAT8Chksum_CA "inhibit conditions / inhibit limit conditions for inhibit source DFC_ComEAT8Chksum" VAL_BLK 0x804F7627 ValA_Wu8 17.0000000000 DINH_LimDFCVerb 0.00 17.0000000000 FORMAT "%13.10" NUMBER 59 /end CHARACTERISTIC
/begin CHARACTERISTIC DINH_Lim.DFC_ComEAT8RingCnt_CA "inhibit conditions / inhibit limit conditions for inhibit source DFC_ComEAT8RingCnt" VAL_BLK 0x804F7662 ValA_Wu8 17.0000000000 DINH_LimDFCVerb 0.00 17.0000000000 FORMAT "%13.10" NUMBER 59 /end CHARACTERISTIC
/begin CHARACTERISTIC DINH_Lim.DFC_ComEAT8TOut_CA "inhibit conditions / inhibit limit conditions for inhibit source DFC_ComEAT8TOut" VAL_BLK 0x804F769D ValA_Wu8 17.0000000000 DINH_LimDFCVerb 0.00 17.0000000000 FORMAT "%13.10" NUMBER 59 /end CHARACTERISTIC
/begin CHARACTERISTIC DINH_Lim.DFC_ComEATAChksum_CA "inhibit conditions / inhibit limit conditions for inhibit source DFC_ComEATAChksum" VAL_BLK 0x804F76D8 ValA_Wu8 17.0000000000 DINH_LimDFCVerb 0.00 17.0000000000 FORMAT "%13.10" NUMBER 59 /end CHARACTERISTIC
/begin CHARACTERISTIC DINH_Lim.DFC_ComEATARingCnt_CA "inhibit conditions / inhibit limit conditions for inhibit source DFC_ComEATARingCnt" VAL_BLK 0x804F7713 ValA_Wu8 17.0000000000 DINH_LimDFCVerb 0.00 17.0000000000 FORMAT "%13.10" NUMBER 59 /end CHARACTERISTIC
/begin CHARACTERISTIC DINH_Lim.DFC_ComEATATOut_CA "inhibit conditions / inhibit limit conditions for inhibit source DFC_ComEATATOut" VAL_BLK 0x804F774E ValA_Wu8 17.0000000000 DINH_LimDFCVerb 0.00 17.0000000000 FORMAT "%13.10" NUMBER 59 /end CHARACTERISTIC
/begin CHARACTERISTIC DINH_Lim.DFC_ComEATBChkSum_CA "inhibit conditions / inhibit limit conditions for inhibit source DFC_ComEATBChkSum" VAL_BLK 0x804F7789 ValA_Wu8 17.0000000000 DINH_LimDFCVerb 0.00 17.0000000000 FORMAT "%13.10" NUMBER 65 /end CHARACTERISTIC
/begin CHARACTERISTIC DINH_Lim.DFC_ComEATBRingCnt_CA "inhibit conditions / inhibit limit conditions for inhibit source DFC_ComEATBRingCnt" VAL_BLK 0x804F77CA ValA_Wu8 17.0000000000 DINH_LimDFCVerb 0.00 17.0000000000 FORMAT "%13.10" NUMBER 65 /end CHARACTERISTIC
/begin CHARACTERISTIC DINH_Lim.DFC_ComEATBTOut_CA "inhibit conditions / inhibit limit conditions for inhibit source DFC_ComEATBTOut" VAL_BLK 0x804F780B ValA_Wu8 17.0000000000 DINH_LimDFCVerb 0.00 17.0000000000 FORMAT "%13.10" NUMBER 65 /end CHARACTERISTIC
/begin CHARACTERISTIC DINH_Lim.DFC_ComEATCChksum_CA "inhibit conditions / inhibit limit conditions for inhibit source DFC_ComEATCChksum" VAL_BLK 0x804F784C ValA_Wu8 17.0000000000 DINH_LimDFCVerb 0.00 17.0000000000 FORMAT "%13.10" NUMBER 52 /end CHARACTERISTIC
/begin CHARACTERISTIC DINH_Lim.DFC_ComEATCRingCnt_CA "inhibit conditions / inhibit limit conditions for inhibit source DFC_ComEATCRingCnt" VAL_BLK 0x804F7880 ValA_Wu8 17.0000000000 DINH_LimDFCVerb 0.00 17.0000000000 FORMAT "%13.10" NUMBER 52 /end CHARACTERISTIC
/begin CHARACTERISTIC DINH_Lim.DFC_ComEATCTOut_CA "inhibit conditions / inhibit limit conditions for inhibit source DFC_ComEATCTOut" VAL_BLK 0x804F78B4 ValA_Wu8 17.0000000000 DINH_LimDFCVerb 0.00 17.0000000000 FORMAT "%13.10" NUMBER 52 /end CHARACTERISTIC
/begin CHARACTERISTIC DINH_Lim.DFC_ComEPBBChkSum_CA "inhibit conditions / inhibit limit conditions for inhibit source DFC_ComEPBBChkSum" VAL_BLK 0x804F78E8 ValA_Wu8 17.0000000000 DINH_LimDFCVerb 0.00 17.0000000000 FORMAT "%13.10" NUMBER 53 /end CHARACTERISTIC
/begin CHARACTERISTIC DINH_Lim.DFC_ComEPBBRingCnt_CA "inhibit conditions / inhibit limit conditions for inhibit source DFC_ComEPBBRingCnt" VAL_BLK 0x804F791D ValA_Wu8 17.0000000000 DINH_LimDFCVerb 0.00 17.0000000000 FORMAT "%13.10" NUMBER 53 /end CHARACTERISTIC
/begin CHARACTERISTIC DINH_Lim.DFC_ComEPBBTOut_CA "inhibit conditions / inhibit limit conditions for inhibit source DFC_ComEPBBTOut" VAL_BLK 0x804F7952 ValA_Wu8 17.0000000000 DINH_LimDFCVerb 0.00 17.0000000000 FORMAT "%13.10" NUMBER 53 /end CHARACTERISTIC
/begin CHARACTERISTIC DINH_Lim.DFC_ComEPBChksum_CA "inhibit conditions / inhibit limit conditions for inhibit source DFC_ComEPBChksum" VAL_BLK 0x804F7987 ValA_Wu8 17.0000000000 DINH_LimDFCVerb 0.00 17.0000000000 FORMAT "%13.10" NUMBER 65 /end CHARACTERISTIC
/begin CHARACTERISTIC DINH_Lim.DFC_ComEPBTOut_CA "inhibit conditions / inhibit limit conditions for inhibit source DFC_ComEPBTOut" VAL_BLK 0x804F79C8 ValA_Wu8 17.0000000000 DINH_LimDFCVerb 0.00 17.0000000000 FORMAT "%13.10" NUMBER 65 /end CHARACTERISTIC
/begin CHARACTERISTIC DINH_Lim.DFC_ComEPBctRing_CA "inhibit conditions / inhibit limit conditions for inhibit source DFC_ComEPBctRing" VAL_BLK 0x804F7A09 ValA_Wu8 17.0000000000 DINH_LimDFCVerb 0.00 17.0000000000 FORMAT "%13.10" NUMBER 65 /end CHARACTERISTIC
/begin CHARACTERISTIC DINH_Lim.DFC_ComEPS1Chksum_CA "inhibit conditions / inhibit limit conditions for inhibit source DFC_ComEPS1Chksum" VAL_BLK 0x804F7A4A ValA_Wu8 17.0000000000 DINH_LimDFCVerb 0.00 17.0000000000 FORMAT "%13.10" NUMBER 59 /end CHARACTERISTIC
/begin CHARACTERISTIC DINH_Lim.DFC_ComEPS1RingCnt_CA "inhibit conditions / inhibit limit conditions for inhibit source DFC_ComEPS1RingCnt" VAL_BLK 0x804F7A85 ValA_Wu8 17.0000000000 DINH_LimDFCVerb 0.00 17.0000000000 FORMAT "%13.10" NUMBER 59 /end CHARACTERISTIC
/begin CHARACTERISTIC DINH_Lim.DFC_ComEPS1TOut_CA "inhibit conditions / inhibit limit conditions for inhibit source DFC_ComEPS1TOut" VAL_BLK 0x804F7AC0 ValA_Wu8 17.0000000000 DINH_LimDFCVerb 0.00 17.0000000000 FORMAT "%13.10" NUMBER 59 /end CHARACTERISTIC
/begin CHARACTERISTIC DINH_Lim.DFC_ComEngCanRxErr_CA "inhibit conditions / inhibit limit conditions for inhibit source DFC_ComEngCanRxErr" VAL_BLK 0x804F7AFB ValA_Wu8 17.0000000000 DINH_LimDFCVerb 0.00 17.0000000000 FORMAT "%13.10" NUMBER 53 /end CHARACTERISTIC
/begin CHARACTERISTIC DINH_Lim.DFC_ComGrvySnsrErr_CA "inhibit conditions / inhibit limit conditions for inhibit source DFC_ComGrvySnsrErr" VAL_BLK 0x804F7B30 ValA_Wu8 17.0000000000 DINH_LimDFCVerb 0.00 17.0000000000 FORMAT "%13.10" NUMBER 50 /end CHARACTERISTIC
/begin CHARACTERISTIC DINH_Lim.DFC_ComGwIMG1ChkSum_CA "inhibit conditions / inhibit limit conditions for inhibit source DFC_ComGwIMG1ChkSum" VAL_BLK 0x804F7B62 ValA_Wu8 17.0000000000 DINH_LimDFCVerb 0.00 17.0000000000 FORMAT "%13.10" NUMBER 58 /end CHARACTERISTIC
/begin CHARACTERISTIC DINH_Lim.DFC_ComGwIMG1RingCnt_CA "inhibit conditions / inhibit limit conditions for inhibit source DFC_ComGwIMG1RingCnt" VAL_BLK 0x804F7B9C ValA_Wu8 17.0000000000 DINH_LimDFCVerb 0.00 17.0000000000 FORMAT "%13.10" NUMBER 58 /end CHARACTERISTIC
/begin CHARACTERISTIC DINH_Lim.DFC_ComGwIMG1TOut_CA "inhibit conditions / inhibit limit conditions for inhibit source DFC_ComGwIMG1TOut" VAL_BLK 0x804F7BD6 ValA_Wu8 17.0000000000 DINH_LimDFCVerb 0.00 17.0000000000 FORMAT "%13.10" NUMBER 58 /end CHARACTERISTIC
/begin CHARACTERISTIC DINH_Lim.DFC_ComGwIMG3ChkSum_CA "inhibit conditions / inhibit limit conditions for inhibit source DFC_ComGwIMG3ChkSum" VAL_BLK 0x804F7C10 ValA_Wu8 17.0000000000 DINH_LimDFCVerb 0.00 17.0000000000 FORMAT "%13.10" NUMBER 60 /end CHARACTERISTIC
/begin CHARACTERISTIC DINH_Lim.DFC_ComGwIMG3RingCnt_CA "inhibit conditions / inhibit limit conditions for inhibit source DFC_ComGwIMG3RingCnt" VAL_BLK 0x804F7C4C ValA_Wu8 17.0000000000 DINH_LimDFCVerb 0.00 17.0000000000 FORMAT "%13.10" NUMBER 60 /end CHARACTERISTIC
/begin CHARACTERISTIC DINH_Lim.DFC_ComGwIMG3TOut_CA "inhibit conditions / inhibit limit conditions for inhibit source DFC_ComGwIMG3TOut" VAL_BLK 0x804F7C88 ValA_Wu8 17.0000000000 DINH_LimDFCVerb 0.00 17.0000000000 FORMAT "%13.10" NUMBER 60 /end CHARACTERISTIC
/begin CHARACTERISTIC DINH_Lim.DFC_ComGwIMG4ChkSum_CA "inhibit conditions / inhibit limit conditions for inhibit source DFC_ComGwIMG4ChkSum" VAL_BLK 0x804F7CC4 ValA_Wu8 17.0000000000 DINH_LimDFCVerb 0.00 17.0000000000 FORMAT "%13.10" NUMBER 58 /end CHARACTERISTIC
/begin CHARACTERISTIC DINH_Lim.DFC_ComGwIMG4RingCnt_CA "inhibit conditions / inhibit limit conditions for inhibit source DFC_ComGwIMG4RingCnt" VAL_BLK 0x804F7CFE ValA_Wu8 17.0000000000 DINH_LimDFCVerb 0.00 17.0000000000 FORMAT "%13.10" NUMBER 58 /end CHARACTERISTIC
/begin CHARACTERISTIC DINH_Lim.DFC_ComGwIMG4TOut_CA "inhibit conditions / inhibit limit conditions for inhibit source DFC_ComGwIMG4TOut" VAL_BLK 0x804F7D38 ValA_Wu8 17.0000000000 DINH_LimDFCVerb 0.00 17.0000000000 FORMAT "%13.10" NUMBER 58 /end CHARACTERISTIC
/begin CHARACTERISTIC DINH_Lim.DFC_ComGwIMG5ChkSum_CA "inhibit conditions / inhibit limit conditions for inhibit source DFC_ComGwIMG5ChkSum" VAL_BLK 0x804F7D72 ValA_Wu8 17.0000000000 DINH_LimDFCVerb 0.00 17.0000000000 FORMAT "%13.10" NUMBER 57 /end CHARACTERISTIC
/begin CHARACTERISTIC DINH_Lim.DFC_ComGwIMG5RingCnt_CA "inhibit conditions / inhibit limit conditions for inhibit source DFC_ComGwIMG5RingCnt" VAL_BLK 0x804F7DAB ValA_Wu8 17.0000000000 DINH_LimDFCVerb 0.00 17.0000000000 FORMAT "%13.10" NUMBER 57 /end CHARACTERISTIC
/begin CHARACTERISTIC DINH_Lim.DFC_ComGwIMG5TOut_CA "inhibit conditions / inhibit limit conditions for inhibit source DFC_ComGwIMG5TOut" VAL_BLK 0x804F7DE4 ValA_Wu8 17.0000000000 DINH_LimDFCVerb 0.00 17.0000000000 FORMAT "%13.10" NUMBER 57 /end CHARACTERISTIC
/begin CHARACTERISTIC DINH_Lim.DFC_ComGwIMG6ChkSum_CA "inhibit conditions / inhibit limit conditions for inhibit source DFC_ComGwIMG6ChkSum" VAL_BLK 0x804F7E1D ValA_Wu8 17.0000000000 DINH_LimDFCVerb 0.00 17.0000000000 FORMAT "%13.10" NUMBER 52 /end CHARACTERISTIC
/begin CHARACTERISTIC DINH_Lim.DFC_ComGwIMG6RingCnt_CA "inhibit conditions / inhibit limit conditions for inhibit source DFC_ComGwIMG6RingCnt" VAL_BLK 0x804F7E51 ValA_Wu8 17.0000000000 DINH_LimDFCVerb 0.00 17.0000000000 FORMAT "%13.10" NUMBER 52 /end CHARACTERISTIC
/begin CHARACTERISTIC DINH_Lim.DFC_ComGwIMG6TOut_CA "inhibit conditions / inhibit limit conditions for inhibit source DFC_ComGwIMG6TOut" VAL_BLK 0x804F7E85 ValA_Wu8 17.0000000000 DINH_LimDFCVerb 0.00 17.0000000000 FORMAT "%13.10" NUMBER 52 /end CHARACTERISTIC
/begin CHARACTERISTIC DINH_Lim.DFC_ComIDASBChksum_CA "inhibit conditions / inhibit limit conditions for inhibit source DFC_ComIDASBChksum" VAL_BLK 0x804F7EB9 ValA_Wu8 17.0000000000 DINH_LimDFCVerb 0.00 17.0000000000 FORMAT "%13.10" NUMBER 54 /end CHARACTERISTIC
/begin CHARACTERISTIC DINH_Lim.DFC_ComIDASBRingCnt_CA "inhibit conditions / inhibit limit conditions for inhibit source DFC_ComIDASBRingCnt" VAL_BLK 0x804F7EEF ValA_Wu8 17.0000000000 DINH_LimDFCVerb 0.00 17.0000000000 FORMAT "%13.10" NUMBER 54 /end CHARACTERISTIC
/begin CHARACTERISTIC DINH_Lim.DFC_ComIDASBTOut_CA "inhibit conditions / inhibit limit conditions for inhibit source DFC_ComIDASBTOut" VAL_BLK 0x804F7F25 ValA_Wu8 17.0000000000 DINH_LimDFCVerb 0.00 17.0000000000 FORMAT "%13.10" NUMBER 54 /end CHARACTERISTIC
/begin CHARACTERISTIC DINH_Lim.DFC_ComIMGMILReq_CA "inhibit conditions / inhibit limit conditions for inhibit source DFC_ComIMGMILReq" VAL_BLK 0x804F7F5B ValA_Wu8 17.0000000000 DINH_LimDFCVerb 0.00 17.0000000000 FORMAT "%13.10" NUMBER 50 /end CHARACTERISTIC
/begin CHARACTERISTIC DINH_Lim.DFC_ComISSPrms_CA "inhibit conditions / inhibit limit conditions for inhibit source DFC_ComISSPrms" VAL_BLK 0x804F7F8D ValA_Wu8 17.0000000000 DINH_LimDFCVerb 0.00 17.0000000000 FORMAT "%13.10" NUMBER 51 /end CHARACTERISTIC
/begin CHARACTERISTIC DINH_Lim.DFC_ComMETAChksum_CA "inhibit conditions / inhibit limit conditions for inhibit source DFC_ComMETAChksum" VAL_BLK 0x804F7FC0 ValA_Wu8 17.0000000000 DINH_LimDFCVerb 0.00 17.0000000000 FORMAT "%13.10" NUMBER 65 /end CHARACTERISTIC
/begin CHARACTERISTIC DINH_Lim.DFC_ComMETAChksumPstDrv_CA "inhibit conditions / inhibit limit conditions for inhibit source DFC_ComMETAChksumPstDrv" VAL_BLK 0x804F8001 ValA_Wu8 17.0000000000 DINH_LimDFCVerb 0.00 17.0000000000 FORMAT "%13.10" NUMBER 50 /end CHARACTERISTIC
/begin CHARACTERISTIC DINH_Lim.DFC_ComMETARingCnt_CA "inhibit conditions / inhibit limit conditions for inhibit source DFC_ComMETARingCnt" VAL_BLK 0x804F8033 ValA_Wu8 17.0000000000 DINH_LimDFCVerb 0.00 17.0000000000 FORMAT "%13.10" NUMBER 65 /end CHARACTERISTIC
/begin CHARACTERISTIC DINH_Lim.DFC_ComMETARingCntPstDrv_CA "inhibit conditions / inhibit limit conditions for inhibit source DFC_ComMETARingCntPstDrv" VAL_BLK 0x804F8074 ValA_Wu8 17.0000000000 DINH_LimDFCVerb 0.00 17.0000000000 FORMAT "%13.10" NUMBER 50 /end CHARACTERISTIC
/begin CHARACTERISTIC DINH_Lim.DFC_ComMETATOut_CA "inhibit conditions / inhibit limit conditions for inhibit source DFC_ComMETATOut" VAL_BLK 0x804F80A6 ValA_Wu8 17.0000000000 DINH_LimDFCVerb 0.00 17.0000000000 FORMAT "%13.10" NUMBER 65 /end CHARACTERISTIC
/begin CHARACTERISTIC DINH_Lim.DFC_ComMETATOutPstDrv_CA "inhibit conditions / inhibit limit conditions for inhibit source DFC_ComMETATOutPstDrv" VAL_BLK 0x804F80E7 ValA_Wu8 17.0000000000 DINH_LimDFCVerb 0.00 17.0000000000 FORMAT "%13.10" NUMBER 50 /end CHARACTERISTIC
/begin CHARACTERISTIC DINH_Lim.DFC_ComMETCChksum_CA "inhibit conditions / inhibit limit conditions for inhibit source DFC_ComMETCChksum" VAL_BLK 0x804F8119 ValA_Wu8 17.0000000000 DINH_LimDFCVerb 0.00 17.0000000000 FORMAT "%13.10" NUMBER 64 /end CHARACTERISTIC
/begin CHARACTERISTIC DINH_Lim.DFC_ComMETCRingCnt_CA "inhibit conditions / inhibit limit conditions for inhibit source DFC_ComMETCRingCnt" VAL_BLK 0x804F8159 ValA_Wu8 17.0000000000 DINH_LimDFCVerb 0.00 17.0000000000 FORMAT "%13.10" NUMBER 64 /end CHARACTERISTIC
/begin CHARACTERISTIC DINH_Lim.DFC_ComMETCTOut_CA "inhibit conditions / inhibit limit conditions for inhibit source DFC_ComMETCTOut" VAL_BLK 0x804F8199 ValA_Wu8 17.0000000000 DINH_LimDFCVerb 0.00 17.0000000000 FORMAT "%13.10" NUMBER 64 /end CHARACTERISTIC
/begin CHARACTERISTIC DINH_Lim.DFC_ComMETDChksum_CA "inhibit conditions / inhibit limit conditions for inhibit source DFC_ComMETDChksum" VAL_BLK 0x804F81D9 ValA_Wu8 17.0000000000 DINH_LimDFCVerb 0.00 17.0000000000 FORMAT "%13.10" NUMBER 63 /end CHARACTERISTIC
/begin CHARACTERISTIC DINH_Lim.DFC_ComMETDRingCnt_CA "inhibit conditions / inhibit limit conditions for inhibit source DFC_ComMETDRingCnt" VAL_BLK 0x804F8218 ValA_Wu8 17.0000000000 DINH_LimDFCVerb 0.00 17.0000000000 FORMAT "%13.10" NUMBER 63 /end CHARACTERISTIC
/begin CHARACTERISTIC DINH_Lim.DFC_ComMETDTOut_CA "inhibit conditions / inhibit limit conditions for inhibit source DFC_ComMETDTOut" VAL_BLK 0x804F8257 ValA_Wu8 17.0000000000 DINH_LimDFCVerb 0.00 17.0000000000 FORMAT "%13.10" NUMBER 63 /end CHARACTERISTIC
/begin CHARACTERISTIC DINH_Lim.DFC_ComMETE2Chksum_CA "inhibit conditions / inhibit limit conditions for inhibit source DFC_ComMETE2Chksum" VAL_BLK 0x804F8296 ValA_Wu8 17.0000000000 DINH_LimDFCVerb 0.00 17.0000000000 FORMAT "%13.10" NUMBER 62 /end CHARACTERISTIC
/begin CHARACTERISTIC DINH_Lim.DFC_ComMETE2RingCnt_CA "inhibit conditions / inhibit limit conditions for inhibit source DFC_ComMETE2RingCnt" VAL_BLK 0x804F82D4 ValA_Wu8 17.0000000000 DINH_LimDFCVerb 0.00 17.0000000000 FORMAT "%13.10" NUMBER 62 /end CHARACTERISTIC
/begin CHARACTERISTIC DINH_Lim.DFC_ComMETE2TOut_CA "inhibit conditions / inhibit limit conditions for inhibit source DFC_ComMETE2TOut" VAL_BLK 0x804F8312 ValA_Wu8 17.0000000000 DINH_LimDFCVerb 0.00 17.0000000000 FORMAT "%13.10" NUMBER 62 /end CHARACTERISTIC
/begin CHARACTERISTIC DINH_Lim.DFC_ComMETFChksum_CA "inhibit conditions / inhibit limit conditions for inhibit source DFC_ComMETFChksum" VAL_BLK 0x804F8350 ValA_Wu8 17.0000000000 DINH_LimDFCVerb 0.00 17.0000000000 FORMAT "%13.10" NUMBER 62 /end CHARACTERISTIC
/begin CHARACTERISTIC DINH_Lim.DFC_ComMETFRingCnt_CA "inhibit conditions / inhibit limit conditions for inhibit source DFC_ComMETFRingCnt" VAL_BLK 0x804F838E ValA_Wu8 17.0000000000 DINH_LimDFCVerb 0.00 17.0000000000 FORMAT "%13.10" NUMBER 62 /end CHARACTERISTIC
/begin CHARACTERISTIC DINH_Lim.DFC_ComMETFTOut_CA "inhibit conditions / inhibit limit conditions for inhibit source DFC_ComMETFTOut" VAL_BLK 0x804F83CC ValA_Wu8 17.0000000000 DINH_LimDFCVerb 0.00 17.0000000000 FORMAT "%13.10" NUMBER 62 /end CHARACTERISTIC
/begin CHARACTERISTIC DINH_Lim.DFC_ComMETGChksum_CA "inhibit conditions / inhibit limit conditions for inhibit source DFC_ComMETGChksum" VAL_BLK 0x804F840A ValA_Wu8 17.0000000000 DINH_LimDFCVerb 0.00 17.0000000000 FORMAT "%13.10" NUMBER 62 /end CHARACTERISTIC
/begin CHARACTERISTIC DINH_Lim.DFC_ComMETGRingCnt_CA "inhibit conditions / inhibit limit conditions for inhibit source DFC_ComMETGRingCnt" VAL_BLK 0x804F8448 ValA_Wu8 17.0000000000 DINH_LimDFCVerb 0.00 17.0000000000 FORMAT "%13.10" NUMBER 62 /end CHARACTERISTIC
/begin CHARACTERISTIC DINH_Lim.DFC_ComMETGTOut_CA "inhibit conditions / inhibit limit conditions for inhibit source DFC_ComMETGTOut" VAL_BLK 0x804F8486 ValA_Wu8 17.0000000000 DINH_LimDFCVerb 0.00 17.0000000000 FORMAT "%13.10" NUMBER 62 /end CHARACTERISTIC
/begin CHARACTERISTIC DINH_Lim.DFC_ComMETH2Chksum_CA "inhibit conditions / inhibit limit conditions for inhibit source DFC_ComMETH2Chksum" VAL_BLK 0x804F84C4 ValA_Wu8 17.0000000000 DINH_LimDFCVerb 0.00 17.0000000000 FORMAT "%13.10" NUMBER 62 /end CHARACTERISTIC
/begin CHARACTERISTIC DINH_Lim.DFC_ComMETH2RingCnt_CA "inhibit conditions / inhibit limit conditions for inhibit source DFC_ComMETH2RingCnt" VAL_BLK 0x804F8502 ValA_Wu8 17.0000000000 DINH_LimDFCVerb 0.00 17.0000000000 FORMAT "%13.10" NUMBER 62 /end CHARACTERISTIC
/begin CHARACTERISTIC DINH_Lim.DFC_ComMETH2TOut_CA "inhibit conditions / inhibit limit conditions for inhibit source DFC_ComMETH2TOut" VAL_BLK 0x804F8540 ValA_Wu8 17.0000000000 DINH_LimDFCVerb 0.00 17.0000000000 FORMAT "%13.10" NUMBER 62 /end CHARACTERISTIC
/begin CHARACTERISTIC DINH_Lim.DFC_ComMETHChksum_CA "inhibit conditions / inhibit limit conditions for inhibit source DFC_ComMETHChksum" VAL_BLK 0x804F857E ValA_Wu8 17.0000000000 DINH_LimDFCVerb 0.00 17.0000000000 FORMAT "%13.10" NUMBER 62 /end CHARACTERISTIC
/begin CHARACTERISTIC DINH_Lim.DFC_ComMETHRingCnt_CA "inhibit conditions / inhibit limit conditions for inhibit source DFC_ComMETHRingCnt" VAL_BLK 0x804F85BC ValA_Wu8 17.0000000000 DINH_LimDFCVerb 0.00 17.0000000000 FORMAT "%13.10" NUMBER 62 /end CHARACTERISTIC
/begin CHARACTERISTIC DINH_Lim.DFC_ComMETHTOut_CA "inhibit conditions / inhibit limit conditions for inhibit source DFC_ComMETHTOut" VAL_BLK 0x804F85FA ValA_Wu8 17.0000000000 DINH_LimDFCVerb 0.00 17.0000000000 FORMAT "%13.10" NUMBER 62 /end CHARACTERISTIC
/begin CHARACTERISTIC DINH_Lim.DFC_ComMETIChksum_CA "inhibit conditions / inhibit limit conditions for inhibit source DFC_ComMETIChksum" VAL_BLK 0x804F8638 ValA_Wu8 17.0000000000 DINH_LimDFCVerb 0.00 17.0000000000 FORMAT "%13.10" NUMBER 69 /end CHARACTERISTIC
/begin CHARACTERISTIC DINH_Lim.DFC_ComMETIRingCnt_CA "inhibit conditions / inhibit limit conditions for inhibit source DFC_ComMETIRingCnt" VAL_BLK 0x804F867D ValA_Wu8 17.0000000000 DINH_LimDFCVerb 0.00 17.0000000000 FORMAT "%13.10" NUMBER 69 /end CHARACTERISTIC
/begin CHARACTERISTIC DINH_Lim.DFC_ComMETITOut_CA "inhibit conditions / inhibit limit conditions for inhibit source DFC_ComMETITOut" VAL_BLK 0x804F86C2 ValA_Wu8 17.0000000000 DINH_LimDFCVerb 0.00 17.0000000000 FORMAT "%13.10" NUMBER 69 /end CHARACTERISTIC
/begin CHARACTERISTIC DINH_Lim.DFC_ComMETKChksum_CA "inhibit conditions / inhibit limit conditions for inhibit source DFC_ComMETKChksum" VAL_BLK 0x804F8707 ValA_Wu8 17.0000000000 DINH_LimDFCVerb 0.00 17.0000000000 FORMAT "%13.10" NUMBER 62 /end CHARACTERISTIC
/begin CHARACTERISTIC DINH_Lim.DFC_ComMETKRingCnt_CA "inhibit conditions / inhibit limit conditions for inhibit source DFC_ComMETKRingCnt" VAL_BLK 0x804F8745 ValA_Wu8 17.0000000000 DINH_LimDFCVerb 0.00 17.0000000000 FORMAT "%13.10" NUMBER 62 /end CHARACTERISTIC
/begin CHARACTERISTIC DINH_Lim.DFC_ComMETKTOut_CA "inhibit conditions / inhibit limit conditions for inhibit source DFC_ComMETKTOut" VAL_BLK 0x804F8783 ValA_Wu8 17.0000000000 DINH_LimDFCVerb 0.00 17.0000000000 FORMAT "%13.10" NUMBER 62 /end CHARACTERISTIC
/begin CHARACTERISTIC DINH_Lim.DFC_ComMETLChksum_CA "inhibit conditions / inhibit limit conditions for inhibit source DFC_ComMETLChksum" VAL_BLK 0x804F87C1 ValA_Wu8 17.0000000000 DINH_LimDFCVerb 0.00 17.0000000000 FORMAT "%13.10" NUMBER 62 /end CHARACTERISTIC
/begin CHARACTERISTIC DINH_Lim.DFC_ComMETLRingCnt_CA "inhibit conditions / inhibit limit conditions for inhibit source DFC_ComMETLRingCnt" VAL_BLK 0x804F87FF ValA_Wu8 17.0000000000 DINH_LimDFCVerb 0.00 17.0000000000 FORMAT "%13.10" NUMBER 62 /end CHARACTERISTIC
/begin CHARACTERISTIC DINH_Lim.DFC_ComMETLTOut_CA "inhibit conditions / inhibit limit conditions for inhibit source DFC_ComMETLTOut" VAL_BLK 0x804F883D ValA_Wu8 17.0000000000 DINH_LimDFCVerb 0.00 17.0000000000 FORMAT "%13.10" NUMBER 62 /end CHARACTERISTIC
/begin CHARACTERISTIC DINH_Lim.DFC_ComMETMChksum_CA "inhibit conditions / inhibit limit conditions for inhibit source DFC_ComMETMChksum" VAL_BLK 0x804F887B ValA_Wu8 17.0000000000 DINH_LimDFCVerb 0.00 17.0000000000 FORMAT "%13.10" NUMBER 61 /end CHARACTERISTIC
/begin CHARACTERISTIC DINH_Lim.DFC_ComMETMRingCnt_CA "inhibit conditions / inhibit limit conditions for inhibit source DFC_ComMETMRingCnt" VAL_BLK 0x804F88B8 ValA_Wu8 17.0000000000 DINH_LimDFCVerb 0.00 17.0000000000 FORMAT "%13.10" NUMBER 61 /end CHARACTERISTIC
/begin CHARACTERISTIC DINH_Lim.DFC_ComMETMTOut_CA "inhibit conditions / inhibit limit conditions for inhibit source DFC_ComMETMTOut" VAL_BLK 0x804F88F5 ValA_Wu8 17.0000000000 DINH_LimDFCVerb 0.00 17.0000000000 FORMAT "%13.10" NUMBER 61 /end CHARACTERISTIC
/begin CHARACTERISTIC DINH_Lim.DFC_ComMETNChksum_CA "inhibit conditions / inhibit limit conditions for inhibit source DFC_ComMETNChksum" VAL_BLK 0x804F8932 ValA_Wu8 17.0000000000 DINH_LimDFCVerb 0.00 17.0000000000 FORMAT "%13.10" NUMBER 62 /end CHARACTERISTIC
/begin CHARACTERISTIC DINH_Lim.DFC_ComMETNRingCnt_CA "inhibit conditions / inhibit limit conditions for inhibit source DFC_ComMETNRingCnt" VAL_BLK 0x804F8970 ValA_Wu8 17.0000000000 DINH_LimDFCVerb 0.00 17.0000000000 FORMAT "%13.10" NUMBER 62 /end CHARACTERISTIC
/begin CHARACTERISTIC DINH_Lim.DFC_ComMETNTOut_CA "inhibit conditions / inhibit limit conditions for inhibit source DFC_ComMETNTOut" VAL_BLK 0x804F89AE ValA_Wu8 17.0000000000 DINH_LimDFCVerb 0.00 17.0000000000 FORMAT "%13.10" NUMBER 62 /end CHARACTERISTIC
/begin CHARACTERISTIC DINH_Lim.DFC_ComMtrCom_CA "inhibit conditions / inhibit limit conditions for inhibit source DFC_ComMtrCom" VAL_BLK 0x804F89EC ValA_Wu8 17.0000000000 DINH_LimDFCVerb 0.00 17.0000000000 FORMAT "%13.10" NUMBER 51 /end CHARACTERISTIC
/begin CHARACTERISTIC DINH_Lim.DFC_ComPCUChkSum_CA "inhibit conditions / inhibit limit conditions for inhibit source DFC_ComPCUChkSum" VAL_BLK 0x804F8A1F ValA_Wu8 17.0000000000 DINH_LimDFCVerb 0.00 17.0000000000 FORMAT "%13.10" NUMBER 58 /end CHARACTERISTIC
/begin CHARACTERISTIC DINH_Lim.DFC_ComPCURingCnt_CA "inhibit conditions / inhibit limit conditions for inhibit source DFC_ComPCURingCnt" VAL_BLK 0x804F8A59 ValA_Wu8 17.0000000000 DINH_LimDFCVerb 0.00 17.0000000000 FORMAT "%13.10" NUMBER 58 /end CHARACTERISTIC
/begin CHARACTERISTIC DINH_Lim.DFC_ComPCUTOut_CA "inhibit conditions / inhibit limit conditions for inhibit source DFC_ComPCUTOut" VAL_BLK 0x804F8A93 ValA_Wu8 17.0000000000 DINH_LimDFCVerb 0.00 17.0000000000 FORMAT "%13.10" NUMBER 58 /end CHARACTERISTIC
/begin CHARACTERISTIC DINH_Lim.DFC_ComSRSAChksum_CA "inhibit conditions / inhibit limit conditions for inhibit source DFC_ComSRSAChksum" VAL_BLK 0x804F8ACD ValA_Wu8 17.0000000000 DINH_LimDFCVerb 0.00 17.0000000000 FORMAT "%13.10" NUMBER 58 /end CHARACTERISTIC
/begin CHARACTERISTIC DINH_Lim.DFC_ComSRSARingCnt_CA "inhibit conditions / inhibit limit conditions for inhibit source DFC_ComSRSARingCnt" VAL_BLK 0x804F8B07 ValA_Wu8 17.0000000000 DINH_LimDFCVerb 0.00 17.0000000000 FORMAT "%13.10" NUMBER 58 /end CHARACTERISTIC
/begin CHARACTERISTIC DINH_Lim.DFC_ComSRSATOut_CA "inhibit conditions / inhibit limit conditions for inhibit source DFC_ComSRSATOut" VAL_BLK 0x804F8B41 ValA_Wu8 17.0000000000 DINH_LimDFCVerb 0.00 17.0000000000 FORMAT "%13.10" NUMBER 58 /end CHARACTERISTIC
/begin CHARACTERISTIC DINH_Lim.DFC_ComSRSBChksum_CA "inhibit conditions / inhibit limit conditions for inhibit source DFC_ComSRSBChksum" VAL_BLK 0x804F8B7B ValA_Wu8 17.0000000000 DINH_LimDFCVerb 0.00 17.0000000000 FORMAT "%13.10" NUMBER 57 /end CHARACTERISTIC
/begin CHARACTERISTIC DINH_Lim.DFC_ComSRSBRingCnt_CA "inhibit conditions / inhibit limit conditions for inhibit source DFC_ComSRSBRingCnt" VAL_BLK 0x804F8BB4 ValA_Wu8 17.0000000000 DINH_LimDFCVerb 0.00 17.0000000000 FORMAT "%13.10" NUMBER 57 /end CHARACTERISTIC
/begin CHARACTERISTIC DINH_Lim.DFC_ComSRSBTOut_CA "inhibit conditions / inhibit limit conditions for inhibit source DFC_ComSRSBTOut" VAL_BLK 0x804F8BED ValA_Wu8 17.0000000000 DINH_LimDFCVerb 0.00 17.0000000000 FORMAT "%13.10" NUMBER 57 /end CHARACTERISTIC
/begin CHARACTERISTIC DINH_Lim.DFC_ComSRSChksum_CA "inhibit conditions / inhibit limit conditions for inhibit source DFC_ComSRSChksum" VAL_BLK 0x804F8C26 ValA_Wu8 17.0000000000 DINH_LimDFCVerb 0.00 17.0000000000 FORMAT "%13.10" NUMBER 57 /end CHARACTERISTIC
/begin CHARACTERISTIC DINH_Lim.DFC_ComSRSErr_CA "inhibit conditions / inhibit limit conditions for inhibit source DFC_ComSRSErr" VAL_BLK 0x804F8C5F ValA_Wu8 17.0000000000 DINH_LimDFCVerb 0.00 17.0000000000 FORMAT "%13.10" NUMBER 50 /end CHARACTERISTIC
/begin CHARACTERISTIC DINH_Lim.DFC_ComSRSRingCnt_CA "inhibit conditions / inhibit limit conditions for inhibit source DFC_ComSRSRingCnt" VAL_BLK 0x804F8C91 ValA_Wu8 17.0000000000 DINH_LimDFCVerb 0.00 17.0000000000 FORMAT "%13.10" NUMBER 57 /end CHARACTERISTIC
/begin CHARACTERISTIC DINH_Lim.DFC_ComSRSTOut_CA "inhibit conditions / inhibit limit conditions for inhibit source DFC_ComSRSTOut" VAL_BLK 0x804F8CCA ValA_Wu8 17.0000000000 DINH_LimDFCVerb 0.00 17.0000000000 FORMAT "%13.10" NUMBER 57 /end CHARACTERISTIC
/begin CHARACTERISTIC DINH_Lim.DFC_ComVehSpdPndFltTCU_CA "inhibit conditions / inhibit limit conditions for inhibit source DFC_ComVehSpdPndFltTCU" VAL_BLK 0x804F8D03 ValA_Wu8 17.0000000000 DINH_LimDFCVerb 0.00 17.0000000000 FORMAT "%13.10" NUMBER 50 /end CHARACTERISTIC
/begin CHARACTERISTIC DINH_Lim.DFC_EbsChartcCurrErr_CA "inhibit conditions / inhibit limit conditions for inhibit source DFC_EbsChartcCurrErr" VAL_BLK 0x804F8D35 ValA_Wu8 17.0000000000 DINH_LimDFCVerb 0.00 17.0000000000 FORMAT "%13.10" NUMBER 63 /end CHARACTERISTIC
/begin CHARACTERISTIC DINH_Lim.DFC_EbsSelfDiagErr_CA "inhibit conditions / inhibit limit conditions for inhibit source DFC_EbsSelfDiagErr" VAL_BLK 0x804F8D74 ValA_Wu8 17.0000000000 DINH_LimDFCVerb 0.00 17.0000000000 FORMAT "%13.10" NUMBER 63 /end CHARACTERISTIC
/begin CHARACTERISTIC DINH_Lim.DFC_GEVlvPhaCsersIntkB1_CA "inhibit conditions / inhibit limit conditions for inhibit source DFC_GEVlvPhaCsersIntkB1" VAL_BLK 0x804F8DB3 ValA_Wu8 17.0000000000 DINH_LimDFCVerb 0.00 17.0000000000 FORMAT "%13.10" NUMBER 58 /end CHARACTERISTIC
/begin CHARACTERISTIC DINH_Lim.DFC_GEVlvPhaPsOpenLoadIntkB1_CA "inhibit conditions / inhibit limit conditions for inhibit source DFC_GEVlvPhaPsOpenLoadIntkB1" VAL_BLK 0x804F8DED ValA_Wu8 17.0000000000 DINH_LimDFCVerb 0.00 17.0000000000 FORMAT "%13.10" NUMBER 94 /end CHARACTERISTIC
/begin CHARACTERISTIC DINH_Lim.DFC_GEVlvPhaPsShoToBattIntkB1_CA "inhibit conditions / inhibit limit conditions for inhibit source DFC_GEVlvPhaPsShoToBattIntkB1" VAL_BLK 0x804F8E4B ValA_Wu8 17.0000000000 DINH_LimDFCVerb 0.00 17.0000000000 FORMAT "%13.10" NUMBER 94 /end CHARACTERISTIC
/begin CHARACTERISTIC DINH_Lim.DFC_GEVlvPhaPsShoToGndIntkB1_CA "inhibit conditions / inhibit limit conditions for inhibit source DFC_GEVlvPhaPsShoToGndIntkB1" VAL_BLK 0x804F8EA9 ValA_Wu8 17.0000000000 DINH_LimDFCVerb 0.00 17.0000000000 FORMAT "%13.10" NUMBER 94 /end CHARACTERISTIC
/begin CHARACTERISTIC DINH_Lim.DFC_GbxCANDigPlausErr_CA "inhibit conditions / inhibit limit conditions for inhibit source DFC_GbxCANDigPlausErr" VAL_BLK 0x804F8F07 ValA_Wu8 17.0000000000 DINH_LimDFCVerb 0.00 17.0000000000 FORMAT "%13.10" NUMBER 52 /end CHARACTERISTIC
/begin CHARACTERISTIC DINH_Lim.DFC_GbxNPos1SRCMax_CA "inhibit conditions / inhibit limit conditions for inhibit source DFC_GbxNPos1SRCMax" VAL_BLK 0x804F8F3B ValA_Wu8 17.0000000000 DINH_LimDFCVerb 0.00 17.0000000000 FORMAT "%13.10" NUMBER 60 /end CHARACTERISTIC
/begin CHARACTERISTIC DINH_Lim.DFC_GbxNPos1SRCMin_CA "inhibit conditions / inhibit limit conditions for inhibit source DFC_GbxNPos1SRCMin" VAL_BLK 0x804F8F77 ValA_Wu8 17.0000000000 DINH_LimDFCVerb 0.00 17.0000000000 FORMAT "%13.10" NUMBER 60 /end CHARACTERISTIC
/begin CHARACTERISTIC DINH_Lim.DFC_GbxNPos2SRCMax_CA "inhibit conditions / inhibit limit conditions for inhibit source DFC_GbxNPos2SRCMax" VAL_BLK 0x804F8FB3 ValA_Wu8 17.0000000000 DINH_LimDFCVerb 0.00 17.0000000000 FORMAT "%13.10" NUMBER 60 /end CHARACTERISTIC
/begin CHARACTERISTIC DINH_Lim.DFC_GbxNPos2SRCMin_CA "inhibit conditions / inhibit limit conditions for inhibit source DFC_GbxNPos2SRCMin" VAL_BLK 0x804F8FEF ValA_Wu8 17.0000000000 DINH_LimDFCVerb 0.00 17.0000000000 FORMAT "%13.10" NUMBER 60 /end CHARACTERISTIC
/begin CHARACTERISTIC DINH_Lim.DFC_GbxNPosAlvChk_CA "inhibit conditions / inhibit limit conditions for inhibit source DFC_GbxNPosAlvChk" VAL_BLK 0x804F902B ValA_Wu8 17.0000000000 DINH_LimDFCVerb 0.00 17.0000000000 FORMAT "%13.10" NUMBER 50 /end CHARACTERISTIC
/begin CHARACTERISTIC DINH_Lim.DFC_GbxNPosSyncErr_CA "inhibit conditions / inhibit limit conditions for inhibit source DFC_GbxNPosSyncErr" VAL_BLK 0x804F905D ValA_Wu8 17.0000000000 DINH_LimDFCVerb 0.00 17.0000000000 FORMAT "%13.10" NUMBER 58 /end CHARACTERISTIC
/begin CHARACTERISTIC DINH_Lim.DFC_HEGOS2B1HtrPsMax_CA "inhibit conditions / inhibit limit conditions for inhibit source DFC_HEGOS2B1HtrPsMax" VAL_BLK 0x804F9097 ValA_Wu8 17.0000000000 DINH_LimDFCVerb 0.00 17.0000000000 FORMAT "%13.10" NUMBER 70 /end CHARACTERISTIC
/begin CHARACTERISTIC DINH_Lim.DFC_HEGOS2B1HtrPsMin_CA "inhibit conditions / inhibit limit conditions for inhibit source DFC_HEGOS2B1HtrPsMin" VAL_BLK 0x804F90DD ValA_Wu8 17.0000000000 DINH_LimDFCVerb 0.00 17.0000000000 FORMAT "%13.10" NUMBER 70 /end CHARACTERISTIC
/begin CHARACTERISTIC DINH_Lim.DFC_HEGOS2B1HtrPsSig_CA "inhibit conditions / inhibit limit conditions for inhibit source DFC_HEGOS2B1HtrPsSig" VAL_BLK 0x804F9123 ValA_Wu8 17.0000000000 DINH_LimDFCVerb 0.00 17.0000000000 FORMAT "%13.10" NUMBER 70 /end CHARACTERISTIC
/begin CHARACTERISTIC DINH_Lim.DFC_LinCSErrACG_CA "inhibit conditions / inhibit limit conditions for inhibit source DFC_LinCSErrACG" VAL_BLK 0x804F9169 ValA_Wu8 17.0000000000 DINH_LimDFCVerb 0.00 17.0000000000 FORMAT "%13.10" NUMBER 68 /end CHARACTERISTIC
/begin CHARACTERISTIC DINH_Lim.DFC_LinCSErrAEV_CA "inhibit conditions / inhibit limit conditions for inhibit source DFC_LinCSErrAEV" VAL_BLK 0x804F91AD ValA_Wu8 17.0000000000 DINH_LimDFCVerb 0.00 17.0000000000 FORMAT "%13.10" NUMBER 52 /end CHARACTERISTIC
/begin CHARACTERISTIC DINH_Lim.DFC_LinCSErrDCDC_CA "inhibit conditions / inhibit limit conditions for inhibit source DFC_LinCSErrDCDC" VAL_BLK 0x804F91E1 ValA_Wu8 17.0000000000 DINH_LimDFCVerb 0.00 17.0000000000 FORMAT "%13.10" NUMBER 57 /end CHARACTERISTIC
/begin CHARACTERISTIC DINH_Lim.DFC_LinCSErrEBS_CA "inhibit conditions / inhibit limit conditions for inhibit source DFC_LinCSErrEBS" VAL_BLK 0x804F921A ValA_Wu8 17.0000000000 DINH_LimDFCVerb 0.00 17.0000000000 FORMAT "%13.10" NUMBER 67 /end CHARACTERISTIC
/begin CHARACTERISTIC DINH_Lim.DFC_LinHdrTimeoutErrACG_CA "inhibit conditions / inhibit limit conditions for inhibit source DFC_LinHdrTimeoutErrACG" VAL_BLK 0x804F925D ValA_Wu8 17.0000000000 DINH_LimDFCVerb 0.00 17.0000000000 FORMAT "%13.10" NUMBER 68 /end CHARACTERISTIC
/begin CHARACTERISTIC DINH_Lim.DFC_LinHdrTimeoutErrAEV_CA "inhibit conditions / inhibit limit conditions for inhibit source DFC_LinHdrTimeoutErrAEV" VAL_BLK 0x804F92A1 ValA_Wu8 17.0000000000 DINH_LimDFCVerb 0.00 17.0000000000 FORMAT "%13.10" NUMBER 52 /end CHARACTERISTIC
/begin CHARACTERISTIC DINH_Lim.DFC_LinHdrTimeoutErrDCDC_CA "inhibit conditions / inhibit limit conditions for inhibit source DFC_LinHdrTimeoutErrDCDC" VAL_BLK 0x804F92D5 ValA_Wu8 17.0000000000 DINH_LimDFCVerb 0.00 17.0000000000 FORMAT "%13.10" NUMBER 57 /end CHARACTERISTIC
/begin CHARACTERISTIC DINH_Lim.DFC_LinHdrTimeoutErrEBS_CA "inhibit conditions / inhibit limit conditions for inhibit source DFC_LinHdrTimeoutErrEBS" VAL_BLK 0x804F930E ValA_Wu8 17.0000000000 DINH_LimDFCVerb 0.00 17.0000000000 FORMAT "%13.10" NUMBER 67 /end CHARACTERISTIC
/begin CHARACTERISTIC DINH_Lim.DFC_LinMsgTimeoutErrACG_CA "inhibit conditions / inhibit limit conditions for inhibit source DFC_LinMsgTimeoutErrACG" VAL_BLK 0x804F9351 ValA_Wu8 17.0000000000 DINH_LimDFCVerb 0.00 17.0000000000 FORMAT "%13.10" NUMBER 68 /end CHARACTERISTIC
/begin CHARACTERISTIC DINH_Lim.DFC_LinMsgTimeoutErrAEV_CA "inhibit conditions / inhibit limit conditions for inhibit source DFC_LinMsgTimeoutErrAEV" VAL_BLK 0x804F9395 ValA_Wu8 17.0000000000 DINH_LimDFCVerb 0.00 17.0000000000 FORMAT "%13.10" NUMBER 52 /end CHARACTERISTIC
/begin CHARACTERISTIC DINH_Lim.DFC_LinMsgTimeoutErrDCDC_CA "inhibit conditions / inhibit limit conditions for inhibit source DFC_LinMsgTimeoutErrDCDC" VAL_BLK 0x804F93C9 ValA_Wu8 17.0000000000 DINH_LimDFCVerb 0.00 17.0000000000 FORMAT "%13.10" NUMBER 57 /end CHARACTERISTIC
/begin CHARACTERISTIC DINH_Lim.DFC_LinMsgTimeoutErrEBS_CA "inhibit conditions / inhibit limit conditions for inhibit source DFC_LinMsgTimeoutErrEBS" VAL_BLK 0x804F9402 ValA_Wu8 17.0000000000 DINH_LimDFCVerb 0.00 17.0000000000 FORMAT "%13.10" NUMBER 67 /end CHARACTERISTIC
/begin CHARACTERISTIC DINH_Lim.DFC_LinNoStrtComErr_CA "inhibit conditions / inhibit limit conditions for inhibit source DFC_LinNoStrtComErr" VAL_BLK 0x804F9445 ValA_Wu8 17.0000000000 DINH_LimDFCVerb 0.00 17.0000000000 FORMAT "%13.10" NUMBER 65 /end CHARACTERISTIC
/begin CHARACTERISTIC DINH_Lim.DFC_LowPresOilP_CA "inhibit conditions / inhibit limit conditions for inhibit source DFC_LowPresOilP" VAL_BLK 0x804F9486 ValA_Wu8 17.0000000000 DINH_LimDFCVerb 0.00 17.0000000000 FORMAT "%13.10" NUMBER 50 /end CHARACTERISTIC
/begin CHARACTERISTIC DINH_Lim.DFC_MisfDetVWhlFrntLeOORHi_CA "inhibit conditions / inhibit limit conditions for inhibit source DFC_MisfDetVWhlFrntLeOORHi" VAL_BLK 0x804F94B8 ValA_Wu8 17.0000000000 DINH_LimDFCVerb 0.00 17.0000000000 FORMAT "%13.10" NUMBER 50 /end CHARACTERISTIC
/begin CHARACTERISTIC DINH_Lim.DFC_MisfDetVWhlFrntLeRatyHi_CA "inhibit conditions / inhibit limit conditions for inhibit source DFC_MisfDetVWhlFrntLeRatyHi" VAL_BLK 0x804F94EA ValA_Wu8 17.0000000000 DINH_LimDFCVerb 0.00 17.0000000000 FORMAT "%13.10" NUMBER 50 /end CHARACTERISTIC
/begin CHARACTERISTIC DINH_Lim.DFC_MisfDetVWhlFrntLeRatyLo_CA "inhibit conditions / inhibit limit conditions for inhibit source DFC_MisfDetVWhlFrntLeRatyLo" VAL_BLK 0x804F951C ValA_Wu8 17.0000000000 DINH_LimDFCVerb 0.00 17.0000000000 FORMAT "%13.10" NUMBER 50 /end CHARACTERISTIC
/begin CHARACTERISTIC DINH_Lim.DFC_MisfDetVWhlFrntLeStuck_CA "inhibit conditions / inhibit limit conditions for inhibit source DFC_MisfDetVWhlFrntLeStuck" VAL_BLK 0x804F954E ValA_Wu8 17.0000000000 DINH_LimDFCVerb 0.00 17.0000000000 FORMAT "%13.10" NUMBER 50 /end CHARACTERISTIC
/begin CHARACTERISTIC DINH_Lim.DFC_MisfDetVWhlFrntRiOORHi_CA "inhibit conditions / inhibit limit conditions for inhibit source DFC_MisfDetVWhlFrntRiOORHi" VAL_BLK 0x804F9580 ValA_Wu8 17.0000000000 DINH_LimDFCVerb 0.00 17.0000000000 FORMAT "%13.10" NUMBER 50 /end CHARACTERISTIC
/begin CHARACTERISTIC DINH_Lim.DFC_MisfDetVWhlFrntRiRatyHi_CA "inhibit conditions / inhibit limit conditions for inhibit source DFC_MisfDetVWhlFrntRiRatyHi" VAL_BLK 0x804F95B2 ValA_Wu8 17.0000000000 DINH_LimDFCVerb 0.00 17.0000000000 FORMAT "%13.10" NUMBER 50 /end CHARACTERISTIC
/begin CHARACTERISTIC DINH_Lim.DFC_MisfDetVWhlFrntRiRatyLo_CA "inhibit conditions / inhibit limit conditions for inhibit source DFC_MisfDetVWhlFrntRiRatyLo" VAL_BLK 0x804F95E4 ValA_Wu8 17.0000000000 DINH_LimDFCVerb 0.00 17.0000000000 FORMAT "%13.10" NUMBER 50 /end CHARACTERISTIC
/begin CHARACTERISTIC DINH_Lim.DFC_MisfDetVWhlFrntRiStuck_CA "inhibit conditions / inhibit limit conditions for inhibit source DFC_MisfDetVWhlFrntRiStuck" VAL_BLK 0x804F9616 ValA_Wu8 17.0000000000 DINH_LimDFCVerb 0.00 17.0000000000 FORMAT "%13.10" NUMBER 50 /end CHARACTERISTIC
/begin CHARACTERISTIC DINH_Lim.DFC_MisfDetVWhlReLeOORHi_CA "inhibit conditions / inhibit limit conditions for inhibit source DFC_MisfDetVWhlReLeOORHi" VAL_BLK 0x804F9648 ValA_Wu8 17.0000000000 DINH_LimDFCVerb 0.00 17.0000000000 FORMAT "%13.10" NUMBER 50 /end CHARACTERISTIC
/begin CHARACTERISTIC DINH_Lim.DFC_MisfDetVWhlReLeRatyHi_CA "inhibit conditions / inhibit limit conditions for inhibit source DFC_MisfDetVWhlReLeRatyHi" VAL_BLK 0x804F967A ValA_Wu8 17.0000000000 DINH_LimDFCVerb 0.00 17.0000000000 FORMAT "%13.10" NUMBER 50 /end CHARACTERISTIC
/begin CHARACTERISTIC DINH_Lim.DFC_MisfDetVWhlReLeRatyLo_CA "inhibit conditions / inhibit limit conditions for inhibit source DFC_MisfDetVWhlReLeRatyLo" VAL_BLK 0x804F96AC ValA_Wu8 17.0000000000 DINH_LimDFCVerb 0.00 17.0000000000 FORMAT "%13.10" NUMBER 50 /end CHARACTERISTIC
/begin CHARACTERISTIC DINH_Lim.DFC_MisfDetVWhlReLeStuck_CA "inhibit conditions / inhibit limit conditions for inhibit source DFC_MisfDetVWhlReLeStuck" VAL_BLK 0x804F96DE ValA_Wu8 17.0000000000 DINH_LimDFCVerb 0.00 17.0000000000 FORMAT "%13.10" NUMBER 50 /end CHARACTERISTIC
/begin CHARACTERISTIC DINH_Lim.DFC_MisfDetVWhlReRiOORHi_CA "inhibit conditions / inhibit limit conditions for inhibit source DFC_MisfDetVWhlReRiOORHi" VAL_BLK 0x804F9710 ValA_Wu8 17.0000000000 DINH_LimDFCVerb 0.00 17.0000000000 FORMAT "%13.10" NUMBER 50 /end CHARACTERISTIC
/begin CHARACTERISTIC DINH_Lim.DFC_MisfDetVWhlReRiRatyHi_CA "inhibit conditions / inhibit limit conditions for inhibit source DFC_MisfDetVWhlReRiRatyHi" VAL_BLK 0x804F9742 ValA_Wu8 17.0000000000 DINH_LimDFCVerb 0.00 17.0000000000 FORMAT "%13.10" NUMBER 50 /end CHARACTERISTIC
/begin CHARACTERISTIC DINH_Lim.DFC_MisfDetVWhlReRiRatyLo_CA "inhibit conditions / inhibit limit conditions for inhibit source DFC_MisfDetVWhlReRiRatyLo" VAL_BLK 0x804F9774 ValA_Wu8 17.0000000000 DINH_LimDFCVerb 0.00 17.0000000000 FORMAT "%13.10" NUMBER 50 /end CHARACTERISTIC
/begin CHARACTERISTIC DINH_Lim.DFC_MisfDetVWhlReRiStuck_CA "inhibit conditions / inhibit limit conditions for inhibit source DFC_MisfDetVWhlReRiStuck" VAL_BLK 0x804F97A6 ValA_Wu8 17.0000000000 DINH_LimDFCVerb 0.00 17.0000000000 FORMAT "%13.10" NUMBER 50 /end CHARACTERISTIC
/begin CHARACTERISTIC DINH_Lim.DFC_MisfDetdVWhlFrntLePlaus_CA "inhibit conditions / inhibit limit conditions for inhibit source DFC_MisfDetdVWhlFrntLePlaus" VAL_BLK 0x804F97D8 ValA_Wu8 17.0000000000 DINH_LimDFCVerb 0.00 17.0000000000 FORMAT "%13.10" NUMBER 50 /end CHARACTERISTIC
/begin CHARACTERISTIC DINH_Lim.DFC_MisfDetdVWhlFrntRiPlaus_CA "inhibit conditions / inhibit limit conditions for inhibit source DFC_MisfDetdVWhlFrntRiPlaus" VAL_BLK 0x804F980A ValA_Wu8 17.0000000000 DINH_LimDFCVerb 0.00 17.0000000000 FORMAT "%13.10" NUMBER 50 /end CHARACTERISTIC
/begin CHARACTERISTIC DINH_Lim.DFC_MisfDetdVWhlReLePlaus_CA "inhibit conditions / inhibit limit conditions for inhibit source DFC_MisfDetdVWhlReLePlaus" VAL_BLK 0x804F983C ValA_Wu8 17.0000000000 DINH_LimDFCVerb 0.00 17.0000000000 FORMAT "%13.10" NUMBER 50 /end CHARACTERISTIC
/begin CHARACTERISTIC DINH_Lim.DFC_MisfDetdVWhlReRiPlaus_CA "inhibit conditions / inhibit limit conditions for inhibit source DFC_MisfDetdVWhlReRiPlaus" VAL_BLK 0x804F986E ValA_Wu8 17.0000000000 DINH_LimDFCVerb 0.00 17.0000000000 FORMAT "%13.10" NUMBER 50 /end CHARACTERISTIC
/begin CHARACTERISTIC DINH_Lim.DFC_PEnvSigRngMax_CA "inhibit conditions / inhibit limit conditions for inhibit source DFC_PEnvSigRngMax" VAL_BLK 0x804F98A0 ValA_Wu8 17.0000000000 DINH_LimDFCVerb 0.00 17.0000000000 FORMAT "%13.10" NUMBER 91 /end CHARACTERISTIC
/begin CHARACTERISTIC DINH_Lim.DFC_PEnvSigRngMin_CA "inhibit conditions / inhibit limit conditions for inhibit source DFC_PEnvSigRngMin" VAL_BLK 0x804F98FB ValA_Wu8 17.0000000000 DINH_LimDFCVerb 0.00 17.0000000000 FORMAT "%13.10" NUMBER 91 /end CHARACTERISTIC
/begin CHARACTERISTIC DINH_Lim.DFC_StmFault_CA "inhibit conditions / inhibit limit conditions for inhibit source DFC_StmFault" VAL_BLK 0x804F9956 ValA_Wu8 17.0000000000 DINH_LimDFCVerb 0.00 17.0000000000 FORMAT "%13.10" NUMBER 53 /end CHARACTERISTIC
/begin CHARACTERISTIC DINH_Lim.DFC_StrtCtOffPth_CA "inhibit conditions / inhibit limit conditions for inhibit source DFC_StrtCtOffPth" VAL_BLK 0x804F998B ValA_Wu8 17.0000000000 DINH_LimDFCVerb 0.00 17.0000000000 FORMAT "%13.10" NUMBER 58 /end CHARACTERISTIC
/begin CHARACTERISTIC DINH_Lim.DFC_StrtCtlErr_CA "inhibit conditions / inhibit limit conditions for inhibit source DFC_StrtCtlErr" VAL_BLK 0x804F99C5 ValA_Wu8 17.0000000000 DINH_LimDFCVerb 0.00 17.0000000000 FORMAT "%13.10" NUMBER 51 /end CHARACTERISTIC
/begin CHARACTERISTIC DINH_Lim.DFC_StrtFault_CA "inhibit conditions / inhibit limit conditions for inhibit source DFC_StrtFault" VAL_BLK 0x804F99F8 ValA_Wu8 17.0000000000 DINH_LimDFCVerb 0.00 17.0000000000 FORMAT "%13.10" NUMBER 52 /end CHARACTERISTIC
/begin CHARACTERISTIC DINH_Lim.DFC_StrtLckJudg1_CA "inhibit conditions / inhibit limit conditions for inhibit source DFC_StrtLckJudg1" VAL_BLK 0x804F9A2C ValA_Wu8 17.0000000000 DINH_LimDFCVerb 0.00 17.0000000000 FORMAT "%13.10" NUMBER 57 /end CHARACTERISTIC
/begin CHARACTERISTIC DINH_Lim.DFC_StrtLckJudg2_CA "inhibit conditions / inhibit limit conditions for inhibit source DFC_StrtLckJudg2" VAL_BLK 0x804F9A65 ValA_Wu8 17.0000000000 DINH_LimDFCVerb 0.00 17.0000000000 FORMAT "%13.10" NUMBER 57 /end CHARACTERISTIC
/begin CHARACTERISTIC DINH_Lim.DFC_StrtOL_CA "inhibit conditions / inhibit limit conditions for inhibit source DFC_StrtOL" VAL_BLK 0x804F9A9E ValA_Wu8 17.0000000000 DINH_LimDFCVerb 0.00 17.0000000000 FORMAT "%13.10" NUMBER 57 /end CHARACTERISTIC
/begin CHARACTERISTIC DINH_Lim.DFC_StrtOL2_CA "inhibit conditions / inhibit limit conditions for inhibit source DFC_StrtOL2" VAL_BLK 0x804F9AD7 ValA_Wu8 17.0000000000 DINH_LimDFCVerb 0.00 17.0000000000 FORMAT "%13.10" NUMBER 57 /end CHARACTERISTIC
/begin CHARACTERISTIC DINH_Lim.DFC_StrtSCB_CA "inhibit conditions / inhibit limit conditions for inhibit source DFC_StrtSCB" VAL_BLK 0x804F9B10 ValA_Wu8 17.0000000000 DINH_LimDFCVerb 0.00 17.0000000000 FORMAT "%13.10" NUMBER 58 /end CHARACTERISTIC
/begin CHARACTERISTIC DINH_Lim.DFC_StrtSCB2_CA "inhibit conditions / inhibit limit conditions for inhibit source DFC_StrtSCB2" VAL_BLK 0x804F9B4A ValA_Wu8 17.0000000000 DINH_LimDFCVerb 0.00 17.0000000000 FORMAT "%13.10" NUMBER 58 /end CHARACTERISTIC
/begin CHARACTERISTIC DINH_Lim.DFC_StrtSCG_CA "inhibit conditions / inhibit limit conditions for inhibit source DFC_StrtSCG" VAL_BLK 0x804F9B84 ValA_Wu8 17.0000000000 DINH_LimDFCVerb 0.00 17.0000000000 FORMAT "%13.10" NUMBER 58 /end CHARACTERISTIC
/begin CHARACTERISTIC DINH_Lim.DFC_StrtSCG2_CA "inhibit conditions / inhibit limit conditions for inhibit source DFC_StrtSCG2" VAL_BLK 0x804F9BBE ValA_Wu8 17.0000000000 DINH_LimDFCVerb 0.00 17.0000000000 FORMAT "%13.10" NUMBER 58 /end CHARACTERISTIC
/begin CHARACTERISTIC DINH_Lim.DFC_StrtStkRly1_CA "inhibit conditions / inhibit limit conditions for inhibit source DFC_StrtStkRly1" VAL_BLK 0x804F9BF8 ValA_Wu8 17.0000000000 DINH_LimDFCVerb 0.00 17.0000000000 FORMAT "%13.10" NUMBER 56 /end CHARACTERISTIC
/begin CHARACTERISTIC DINH_Lim.DFC_StrtStkRly2_CA "inhibit conditions / inhibit limit conditions for inhibit source DFC_StrtStkRly2" VAL_BLK 0x804F9C30 ValA_Wu8 17.0000000000 DINH_LimDFCVerb 0.00 17.0000000000 FORMAT "%13.10" NUMBER 56 /end CHARACTERISTIC
/begin CHARACTERISTIC DINH_Lim.DFC_TEVEmax_CA "inhibit conditions / inhibit limit conditions for inhibit source DFC_TEVEmax" VAL_BLK 0x804F9C68 ValA_Wu8 17.0000000000 DINH_LimDFCVerb 0.00 17.0000000000 FORMAT "%13.10" NUMBER 82 /end CHARACTERISTIC
/begin CHARACTERISTIC DINH_Lim.DFC_TEVEmin_CA "inhibit conditions / inhibit limit conditions for inhibit source DFC_TEVEmin" VAL_BLK 0x804F9CBA ValA_Wu8 17.0000000000 DINH_LimDFCVerb 0.00 17.0000000000 FORMAT "%13.10" NUMBER 83 /end CHARACTERISTIC
/begin CHARACTERISTIC DINH_Lim.DFC_TEVEsig_CA "inhibit conditions / inhibit limit conditions for inhibit source DFC_TEVEsig" VAL_BLK 0x804F9D0D ValA_Wu8 17.0000000000 DINH_LimDFCVerb 0.00 17.0000000000 FORMAT "%13.10" NUMBER 82 /end CHARACTERISTIC
/begin CHARACTERISTIC DINH_Lim.DFC_UegoHeatrPrfmncLoS1B1_CA "inhibit conditions / inhibit limit conditions for inhibit source DFC_UegoHeatrPrfmncLoS1B1" VAL_BLK 0x804F9D5F ValA_Wu8 17.0000000000 DINH_LimDFCVerb 0.00 17.0000000000 FORMAT "%13.10" NUMBER 53 /end CHARACTERISTIC
/begin CHARACTERISTIC DINH_Lim.DFC_VehVAllPlaus_CA "inhibit conditions / inhibit limit conditions for inhibit source DFC_VehVAllPlaus" VAL_BLK 0x804F9D94 ValA_Wu8 17.0000000000 DINH_LimDFCVerb 0.00 17.0000000000 FORMAT "%13.10" NUMBER 67 /end CHARACTERISTIC
/begin CHARACTERISTIC DINH_Lim.DFC_VehVNCSnsrElecFailr_CA "inhibit conditions / inhibit limit conditions for inhibit source DFC_VehVNCSnsrElecFailr" VAL_BLK 0x804F9DD7 ValA_Wu8 17.0000000000 DINH_LimDFCVerb 0.00 17.0000000000 FORMAT "%13.10" NUMBER 55 /end CHARACTERISTIC
/begin CHARACTERISTIC DINH_Lim.DFC_VehVPlausCan_CA "inhibit conditions / inhibit limit conditions for inhibit source DFC_VehVPlausCan" VAL_BLK 0x804F9E0E ValA_Wu8 17.0000000000 DINH_LimDFCVerb 0.00 17.0000000000 FORMAT "%13.10" NUMBER 81 /end CHARACTERISTIC
/begin CHARACTERISTIC DINH_Lim.DFC_VehVPlausFco_CA "inhibit conditions / inhibit limit conditions for inhibit source DFC_VehVPlausFco" VAL_BLK 0x804F9E5F ValA_Wu8 17.0000000000 DINH_LimDFCVerb 0.00 17.0000000000 FORMAT "%13.10" NUMBER 90 /end CHARACTERISTIC
/begin CHARACTERISTIC DINH_Lim.DFC_VehVPlausPwr_CA "inhibit conditions / inhibit limit conditions for inhibit source DFC_VehVPlausPwr" VAL_BLK 0x804F9EB9 ValA_Wu8 17.0000000000 DINH_LimDFCVerb 0.00 17.0000000000 FORMAT "%13.10" NUMBER 76 /end CHARACTERISTIC
/begin CHARACTERISTIC DINH_Lim.DFC_VehVPlausV2N_CA "inhibit conditions / inhibit limit conditions for inhibit source DFC_VehVPlausV2N" VAL_BLK 0x804F9F05 ValA_Wu8 17.0000000000 DINH_LimDFCVerb 0.00 17.0000000000 FORMAT "%13.10" NUMBER 76 /end CHARACTERISTIC
/begin CHARACTERISTIC DINH_Lim.DFC_VehVSpdSnsrAElecFailr_CA "inhibit conditions / inhibit limit conditions for inhibit source DFC_VehVSpdSnsrAElecFailr" VAL_BLK 0x804F9F51 ValA_Wu8 17.0000000000 DINH_LimDFCVerb 0.00 17.0000000000 FORMAT "%13.10" NUMBER 54 /end CHARACTERISTIC
/begin CHARACTERISTIC DINH_Lim.DFC_VehVSpdSnsrBElecFailr_CA "inhibit conditions / inhibit limit conditions for inhibit source DFC_VehVSpdSnsrBElecFailr" VAL_BLK 0x804F9F87 ValA_Wu8 17.0000000000 DINH_LimDFCVerb 0.00 17.0000000000 FORMAT "%13.10" NUMBER 54 /end CHARACTERISTIC
/begin CHARACTERISTIC DINH_Lim.DFC_ClthMax_CA "inhibit conditions / inhibit limit conditions for inhibit source DFC_ClthMax" VAL_BLK 0x804F9FBD ValA_Wu8 17.0000000000 DINH_LimDFCVerb 0.00 17.0000000000 FORMAT "%13.10" NUMBER 65 /end CHARACTERISTIC
/begin CHARACTERISTIC DINH_Lim.DFC_IgnClPs_DevComErr_CA "inhibit conditions / inhibit limit conditions for inhibit source DFC_IgnClPs_DevComErr" VAL_BLK 0x804F9FFE ValA_Wu8 17.0000000000 DINH_LimDFCVerb 0.00 17.0000000000 FORMAT "%13.10" NUMBER 51 /end CHARACTERISTIC
/begin CHARACTERISTIC DINH_Lim.DFC_IgnClPs_LineOl_0_CA "inhibit conditions / inhibit limit conditions for inhibit source DFC_IgnClPs_LineOl_0" VAL_BLK 0x804FA031 ValA_Wu8 17.0000000000 DINH_LimDFCVerb 0.00 17.0000000000 FORMAT "%13.10" NUMBER 55 /end CHARACTERISTIC
/begin CHARACTERISTIC DINH_Lim.DFC_IgnClPs_LineOl_1_CA "inhibit conditions / inhibit limit conditions for inhibit source DFC_IgnClPs_LineOl_1" VAL_BLK 0x804FA068 ValA_Wu8 17.0000000000 DINH_LimDFCVerb 0.00 17.0000000000 FORMAT "%13.10" NUMBER 55 /end CHARACTERISTIC
/begin CHARACTERISTIC DINH_Lim.DFC_IgnClPs_LineOl_2_CA "inhibit conditions / inhibit limit conditions for inhibit source DFC_IgnClPs_LineOl_2" VAL_BLK 0x804FA09F ValA_Wu8 17.0000000000 DINH_LimDFCVerb 0.00 17.0000000000 FORMAT "%13.10" NUMBER 55 /end CHARACTERISTIC
/begin CHARACTERISTIC DINH_Lim.DFC_IgnClPs_LineOl_3_CA "inhibit conditions / inhibit limit conditions for inhibit source DFC_IgnClPs_LineOl_3" VAL_BLK 0x804FA0D6 ValA_Wu8 17.0000000000 DINH_LimDFCVerb 0.00 17.0000000000 FORMAT "%13.10" NUMBER 55 /end CHARACTERISTIC
/begin CHARACTERISTIC DINH_Lim.DFC_IgnClPs_LineScb_0_CA "inhibit conditions / inhibit limit conditions for inhibit source DFC_IgnClPs_LineScb_0" VAL_BLK 0x804FA10D ValA_Wu8 17.0000000000 DINH_LimDFCVerb 0.00 17.0000000000 FORMAT "%13.10" NUMBER 55 /end CHARACTERISTIC
/begin CHARACTERISTIC DINH_Lim.DFC_IgnClPs_LineScb_1_CA "inhibit conditions / inhibit limit conditions for inhibit source DFC_IgnClPs_LineScb_1" VAL_BLK 0x804FA144 ValA_Wu8 17.0000000000 DINH_LimDFCVerb 0.00 17.0000000000 FORMAT "%13.10" NUMBER 55 /end CHARACTERISTIC
/begin CHARACTERISTIC DINH_Lim.DFC_IgnClPs_LineScb_2_CA "inhibit conditions / inhibit limit conditions for inhibit source DFC_IgnClPs_LineScb_2" VAL_BLK 0x804FA17B ValA_Wu8 17.0000000000 DINH_LimDFCVerb 0.00 17.0000000000 FORMAT "%13.10" NUMBER 55 /end CHARACTERISTIC
/begin CHARACTERISTIC DINH_Lim.DFC_IgnClPs_LineScb_3_CA "inhibit conditions / inhibit limit conditions for inhibit source DFC_IgnClPs_LineScb_3" VAL_BLK 0x804FA1B2 ValA_Wu8 17.0000000000 DINH_LimDFCVerb 0.00 17.0000000000 FORMAT "%13.10" NUMBER 55 /end CHARACTERISTIC
/begin CHARACTERISTIC DINH_Lim.DFC_IgnClPs_LineScg_0_CA "inhibit conditions / inhibit limit conditions for inhibit source DFC_IgnClPs_LineScg_0" VAL_BLK 0x804FA1E9 ValA_Wu8 17.0000000000 DINH_LimDFCVerb 0.00 17.0000000000 FORMAT "%13.10" NUMBER 55 /end CHARACTERISTIC
/begin CHARACTERISTIC DINH_Lim.DFC_IgnClPs_LineScg_1_CA "inhibit conditions / inhibit limit conditions for inhibit source DFC_IgnClPs_LineScg_1" VAL_BLK 0x804FA220 ValA_Wu8 17.0000000000 DINH_LimDFCVerb 0.00 17.0000000000 FORMAT "%13.10" NUMBER 55 /end CHARACTERISTIC
/begin CHARACTERISTIC DINH_Lim.DFC_IgnClPs_LineScg_2_CA "inhibit conditions / inhibit limit conditions for inhibit source DFC_IgnClPs_LineScg_2" VAL_BLK 0x804FA257 ValA_Wu8 17.0000000000 DINH_LimDFCVerb 0.00 17.0000000000 FORMAT "%13.10" NUMBER 55 /end CHARACTERISTIC
/begin CHARACTERISTIC DINH_Lim.DFC_IgnClPs_LineScg_3_CA "inhibit conditions / inhibit limit conditions for inhibit source DFC_IgnClPs_LineScg_3" VAL_BLK 0x804FA28E ValA_Wu8 17.0000000000 DINH_LimDFCVerb 0.00 17.0000000000 FORMAT "%13.10" NUMBER 55 /end CHARACTERISTIC
/begin CHARACTERISTIC DINH_Lim.DFC_KRVEKOEVAB_CA "inhibit conditions / inhibit limit conditions for inhibit source DFC_KRVEKOEVAB" VAL_BLK 0x804FA2C5 ValA_Wu8 17.0000000000 DINH_LimDFCVerb 0.00 17.0000000000 FORMAT "%13.10" NUMBER 50 /end CHARACTERISTIC
/begin CHARACTERISTIC DINH_Lim.DFC_KRVEKOEVAB0_CA "inhibit conditions / inhibit limit conditions for inhibit source DFC_KRVEKOEVAB0" VAL_BLK 0x804FA2F7 ValA_Wu8 17.0000000000 DINH_LimDFCVerb 0.00 17.0000000000 FORMAT "%13.10" NUMBER 50 /end CHARACTERISTIC
/begin CHARACTERISTIC DINH_Lim.DFC_KRVEKOEVAB1_CA "inhibit conditions / inhibit limit conditions for inhibit source DFC_KRVEKOEVAB1" VAL_BLK 0x804FA329 ValA_Wu8 17.0000000000 DINH_LimDFCVerb 0.00 17.0000000000 FORMAT "%13.10" NUMBER 50 /end CHARACTERISTIC
/begin CHARACTERISTIC DINH_Lim.DFC_KRVEKOEVAB2_CA "inhibit conditions / inhibit limit conditions for inhibit source DFC_KRVEKOEVAB2" VAL_BLK 0x804FA35B ValA_Wu8 17.0000000000 DINH_LimDFCVerb 0.00 17.0000000000 FORMAT "%13.10" NUMBER 50 /end CHARACTERISTIC
/begin CHARACTERISTIC DINH_Lim.DFC_KRVEKOEVAB3_CA "inhibit conditions / inhibit limit conditions for inhibit source DFC_KRVEKOEVAB3" VAL_BLK 0x804FA38D ValA_Wu8 17.0000000000 DINH_LimDFCVerb 0.00 17.0000000000 FORMAT "%13.10" NUMBER 50 /end CHARACTERISTIC
/begin CHARACTERISTIC DINH_Lim.DFC_UegoSigEcuAsicS1B1_CA "inhibit conditions / inhibit limit conditions for inhibit source DFC_UegoSigEcuAsicS1B1" VAL_BLK 0x804FA3BF ValA_Wu8 17.0000000000 DINH_LimDFCVerb 0.00 17.0000000000 FORMAT "%13.10" NUMBER 85 /end CHARACTERISTIC
/begin CHARACTERISTIC DINH_Lim.DFC_UegoSigEcuComS1B1_CA "inhibit conditions / inhibit limit conditions for inhibit source DFC_UegoSigEcuComS1B1" VAL_BLK 0x804FA414 ValA_Wu8 17.0000000000 DINH_LimDFCVerb 0.00 17.0000000000 FORMAT "%13.10" NUMBER 85 /end CHARACTERISTIC
/begin CHARACTERISTIC DINH_Lim.DFC_UegoSigSnsrS1B1_CA "inhibit conditions / inhibit limit conditions for inhibit source DFC_UegoSigSnsrS1B1" VAL_BLK 0x804FA469 ValA_Wu8 17.0000000000 DINH_LimDFCVerb 0.00 17.0000000000 FORMAT "%13.10" NUMBER 53 /end CHARACTERISTIC
/begin CHARACTERISTIC DINH_Lim.DFC_UegoSigWireOlApesS1B1_CA "inhibit conditions / inhibit limit conditions for inhibit source DFC_UegoSigWireOlApesS1B1" VAL_BLK 0x804FA49E ValA_Wu8 17.0000000000 DINH_LimDFCVerb 0.00 17.0000000000 FORMAT "%13.10" NUMBER 82 /end CHARACTERISTIC
/begin CHARACTERISTIC DINH_Lim.DFC_UegoSigWireOlIpeS1B1_CA "inhibit conditions / inhibit limit conditions for inhibit source DFC_UegoSigWireOlIpeS1B1" VAL_BLK 0x804FA4F0 ValA_Wu8 17.0000000000 DINH_LimDFCVerb 0.00 17.0000000000 FORMAT "%13.10" NUMBER 85 /end CHARACTERISTIC
/begin CHARACTERISTIC DINH_Lim.DFC_UegoSigWireOlReS1B1_CA "inhibit conditions / inhibit limit conditions for inhibit source DFC_UegoSigWireOlReS1B1" VAL_BLK 0x804FA545 ValA_Wu8 17.0000000000 DINH_LimDFCVerb 0.00 17.0000000000 FORMAT "%13.10" NUMBER 85 /end CHARACTERISTIC
/begin CHARACTERISTIC DINH_Lim.DFC_UegoSigWireRCmpS1B1_CA "inhibit conditions / inhibit limit conditions for inhibit source DFC_UegoSigWireRCmpS1B1" VAL_BLK 0x804FA59A ValA_Wu8 17.0000000000 DINH_LimDFCVerb 0.00 17.0000000000 FORMAT "%13.10" NUMBER 83 /end CHARACTERISTIC
/begin CHARACTERISTIC DINH_Lim.DFC_UegoSigWireScbS1B1_CA "inhibit conditions / inhibit limit conditions for inhibit source DFC_UegoSigWireScbS1B1" VAL_BLK 0x804FA5ED ValA_Wu8 17.0000000000 DINH_LimDFCVerb 0.00 17.0000000000 FORMAT "%13.10" NUMBER 86 /end CHARACTERISTIC
/begin CHARACTERISTIC DINH_Lim.DFC_UegoSigWireScgS1B1_CA "inhibit conditions / inhibit limit conditions for inhibit source DFC_UegoSigWireScgS1B1" VAL_BLK 0x804FA643 ValA_Wu8 17.0000000000 DINH_LimDFCVerb 0.00 17.0000000000 FORMAT "%13.10" NUMBER 86 /end CHARACTERISTIC
/begin CHARACTERISTIC DINH_Lim.DFC_AfsPhyRngHiB1_CA "inhibit conditions / inhibit limit conditions for inhibit source DFC_AfsPhyRngHiB1" VAL_BLK 0x804FA699 ValA_Wu8 17.0000000000 DINH_LimDFCVerb 0.00 17.0000000000 FORMAT "%13.10" NUMBER 56 /end CHARACTERISTIC
/begin CHARACTERISTIC DINH_Lim.DFC_AfsPhyRngLoB1_CA "inhibit conditions / inhibit limit conditions for inhibit source DFC_AfsPhyRngLoB1" VAL_BLK 0x804FA6D1 ValA_Wu8 17.0000000000 DINH_LimDFCVerb 0.00 17.0000000000 FORMAT "%13.10" NUMBER 56 /end CHARACTERISTIC
/begin CHARACTERISTIC DINH_Lim.DFC_AirCCmprOL_CA "inhibit conditions / inhibit limit conditions for inhibit source DFC_AirCCmprOL" VAL_BLK 0x804FA709 ValA_Wu8 17.0000000000 DINH_LimDFCVerb 0.00 17.0000000000 FORMAT "%13.10" NUMBER 50 /end CHARACTERISTIC
/begin CHARACTERISTIC DINH_Lim.DFC_AirCCmprOvrTemp_CA "inhibit conditions / inhibit limit conditions for inhibit source DFC_AirCCmprOvrTemp" VAL_BLK 0x804FA73B ValA_Wu8 17.0000000000 DINH_LimDFCVerb 0.00 17.0000000000 FORMAT "%13.10" NUMBER 50 /end CHARACTERISTIC
/begin CHARACTERISTIC DINH_Lim.DFC_AirCCmprSCB_CA "inhibit conditions / inhibit limit conditions for inhibit source DFC_AirCCmprSCB" VAL_BLK 0x804FA76D ValA_Wu8 17.0000000000 DINH_LimDFCVerb 0.00 17.0000000000 FORMAT "%13.10" NUMBER 50 /end CHARACTERISTIC
/begin CHARACTERISTIC DINH_Lim.DFC_AirCCmprSCG_CA "inhibit conditions / inhibit limit conditions for inhibit source DFC_AirCCmprSCG" VAL_BLK 0x804FA79F ValA_Wu8 17.0000000000 DINH_LimDFCVerb 0.00 17.0000000000 FORMAT "%13.10" NUMBER 50 /end CHARACTERISTIC
/begin CHARACTERISTIC DINH_Lim.DFC_AltErr_CA "inhibit conditions / inhibit limit conditions for inhibit source DFC_AltErr" VAL_BLK 0x804FA7D1 ValA_Wu8 17.0000000000 DINH_LimDFCVerb 0.00 17.0000000000 FORMAT "%13.10" NUMBER 51 /end CHARACTERISTIC
/begin CHARACTERISTIC DINH_Lim.DFC_BattUSRCMax_CA "inhibit conditions / inhibit limit conditions for inhibit source DFC_BattUSRCMax" VAL_BLK 0x804FA804 ValA_Wu8 17.0000000000 DINH_LimDFCVerb 0.00 17.0000000000 FORMAT "%13.10" NUMBER 58 /end CHARACTERISTIC
/begin CHARACTERISTIC DINH_Lim.DFC_BattUSRCMin_CA "inhibit conditions / inhibit limit conditions for inhibit source DFC_BattUSRCMin" VAL_BLK 0x804FA83E ValA_Wu8 17.0000000000 DINH_LimDFCVerb 0.00 17.0000000000 FORMAT "%13.10" NUMBER 58 /end CHARACTERISTIC
/begin CHARACTERISTIC DINH_Lim.DFC_ComChksTCU1_CA "inhibit conditions / inhibit limit conditions for inhibit source DFC_ComChksTCU1" VAL_BLK 0x804FA878 ValA_Wu8 17.0000000000 DINH_LimDFCVerb 0.00 17.0000000000 FORMAT "%13.10" NUMBER 50 /end CHARACTERISTIC
/begin CHARACTERISTIC DINH_Lim.DFC_ComChksTCU11_CA "inhibit conditions / inhibit limit conditions for inhibit source DFC_ComChksTCU11" VAL_BLK 0x804FA8AA ValA_Wu8 17.0000000000 DINH_LimDFCVerb 0.00 17.0000000000 FORMAT "%13.10" NUMBER 51 /end CHARACTERISTIC
/begin CHARACTERISTIC DINH_Lim.DFC_ComChksTCU12_CA "inhibit conditions / inhibit limit conditions for inhibit source DFC_ComChksTCU12" VAL_BLK 0x804FA8DD ValA_Wu8 17.0000000000 DINH_LimDFCVerb 0.00 17.0000000000 FORMAT "%13.10" NUMBER 52 /end CHARACTERISTIC
/begin CHARACTERISTIC DINH_Lim.DFC_ComChksTCU13_CA "inhibit conditions / inhibit limit conditions for inhibit source DFC_ComChksTCU13" VAL_BLK 0x804FA911 ValA_Wu8 17.0000000000 DINH_LimDFCVerb 0.00 17.0000000000 FORMAT "%13.10" NUMBER 52 /end CHARACTERISTIC
/begin CHARACTERISTIC DINH_Lim.DFC_ComChksTCU2_CA "inhibit conditions / inhibit limit conditions for inhibit source DFC_ComChksTCU2" VAL_BLK 0x804FA945 ValA_Wu8 17.0000000000 DINH_LimDFCVerb 0.00 17.0000000000 FORMAT "%13.10" NUMBER 50 /end CHARACTERISTIC
/begin CHARACTERISTIC DINH_Lim.DFC_ComChksTCU3_CA "inhibit conditions / inhibit limit conditions for inhibit source DFC_ComChksTCU3" VAL_BLK 0x804FA977 ValA_Wu8 17.0000000000 DINH_LimDFCVerb 0.00 17.0000000000 FORMAT "%13.10" NUMBER 50 /end CHARACTERISTIC
/begin CHARACTERISTIC DINH_Lim.DFC_ComChksTCU4_CA "inhibit conditions / inhibit limit conditions for inhibit source DFC_ComChksTCU4" VAL_BLK 0x804FA9A9 ValA_Wu8 17.0000000000 DINH_LimDFCVerb 0.00 17.0000000000 FORMAT "%13.10" NUMBER 50 /end CHARACTERISTIC
/begin CHARACTERISTIC DINH_Lim.DFC_ComCntTCU1_CA "inhibit conditions / inhibit limit conditions for inhibit source DFC_ComCntTCU1" VAL_BLK 0x804FA9DB ValA_Wu8 17.0000000000 DINH_LimDFCVerb 0.00 17.0000000000 FORMAT "%13.10" NUMBER 50 /end CHARACTERISTIC
/begin CHARACTERISTIC DINH_Lim.DFC_ComCntTCU11_CA "inhibit conditions / inhibit limit conditions for inhibit source DFC_ComCntTCU11" VAL_BLK 0x804FAA0D ValA_Wu8 17.0000000000 DINH_LimDFCVerb 0.00 17.0000000000 FORMAT "%13.10" NUMBER 51 /end CHARACTERISTIC
/begin CHARACTERISTIC DINH_Lim.DFC_ComCntTCU12_CA "inhibit conditions / inhibit limit conditions for inhibit source DFC_ComCntTCU12" VAL_BLK 0x804FAA40 ValA_Wu8 17.0000000000 DINH_LimDFCVerb 0.00 17.0000000000 FORMAT "%13.10" NUMBER 52 /end CHARACTERISTIC
/begin CHARACTERISTIC DINH_Lim.DFC_ComCntTCU13_CA "inhibit conditions / inhibit limit conditions for inhibit source DFC_ComCntTCU13" VAL_BLK 0x804FAA74 ValA_Wu8 17.0000000000 DINH_LimDFCVerb 0.00 17.0000000000 FORMAT "%13.10" NUMBER 52 /end CHARACTERISTIC
/begin CHARACTERISTIC DINH_Lim.DFC_ComCntTCU2_CA "inhibit conditions / inhibit limit conditions for inhibit source DFC_ComCntTCU2" VAL_BLK 0x804FAAA8 ValA_Wu8 17.0000000000 DINH_LimDFCVerb 0.00 17.0000000000 FORMAT "%13.10" NUMBER 50 /end CHARACTERISTIC
/begin CHARACTERISTIC DINH_Lim.DFC_ComCntTCU3_CA "inhibit conditions / inhibit limit conditions for inhibit source DFC_ComCntTCU3" VAL_BLK 0x804FAADA ValA_Wu8 17.0000000000 DINH_LimDFCVerb 0.00 17.0000000000 FORMAT "%13.10" NUMBER 50 /end CHARACTERISTIC
/begin CHARACTERISTIC DINH_Lim.DFC_ComCntTCU4_CA "inhibit conditions / inhibit limit conditions for inhibit source DFC_ComCntTCU4" VAL_BLK 0x804FAB0C ValA_Wu8 17.0000000000 DINH_LimDFCVerb 0.00 17.0000000000 FORMAT "%13.10" NUMBER 50 /end CHARACTERISTIC
/begin CHARACTERISTIC DINH_Lim.DFC_ComTOutTCU01_CA "inhibit conditions / inhibit limit conditions for inhibit source DFC_ComTOutTCU01" VAL_BLK 0x804FAB3E ValA_Wu8 17.0000000000 DINH_LimDFCVerb 0.00 17.0000000000 FORMAT "%13.10" NUMBER 51 /end CHARACTERISTIC
/begin CHARACTERISTIC DINH_Lim.DFC_ComTOutTCU02_CA "inhibit conditions / inhibit limit conditions for inhibit source DFC_ComTOutTCU02" VAL_BLK 0x804FAB71 ValA_Wu8 17.0000000000 DINH_LimDFCVerb 0.00 17.0000000000 FORMAT "%13.10" NUMBER 51 /end CHARACTERISTIC
/begin CHARACTERISTIC DINH_Lim.DFC_ComTOutTCU1_CA "inhibit conditions / inhibit limit conditions for inhibit source DFC_ComTOutTCU1" VAL_BLK 0x804FABA4 ValA_Wu8 17.0000000000 DINH_LimDFCVerb 0.00 17.0000000000 FORMAT "%13.10" NUMBER 55 /end CHARACTERISTIC
/begin CHARACTERISTIC DINH_Lim.DFC_ComTOutTCU11_CA "inhibit conditions / inhibit limit conditions for inhibit source DFC_ComTOutTCU11" VAL_BLK 0x804FABDB ValA_Wu8 17.0000000000 DINH_LimDFCVerb 0.00 17.0000000000 FORMAT "%13.10" NUMBER 54 /end CHARACTERISTIC
/begin CHARACTERISTIC DINH_Lim.DFC_ComTOutTCU12_CA "inhibit conditions / inhibit limit conditions for inhibit source DFC_ComTOutTCU12" VAL_BLK 0x804FAC11 ValA_Wu8 17.0000000000 DINH_LimDFCVerb 0.00 17.0000000000 FORMAT "%13.10" NUMBER 52 /end CHARACTERISTIC
/begin CHARACTERISTIC DINH_Lim.DFC_ComTOutTCU13_CA "inhibit conditions / inhibit limit conditions for inhibit source DFC_ComTOutTCU13" VAL_BLK 0x804FAC45 ValA_Wu8 17.0000000000 DINH_LimDFCVerb 0.00 17.0000000000 FORMAT "%13.10" NUMBER 52 /end CHARACTERISTIC
/begin CHARACTERISTIC DINH_Lim.DFC_ComTOutTCU14_CA "inhibit conditions / inhibit limit conditions for inhibit source DFC_ComTOutTCU14" VAL_BLK 0x804FAC79 ValA_Wu8 17.0000000000 DINH_LimDFCVerb 0.00 17.0000000000 FORMAT "%13.10" NUMBER 51 /end CHARACTERISTIC
/begin CHARACTERISTIC DINH_Lim.DFC_ComTOutTCU2_CA "inhibit conditions / inhibit limit conditions for inhibit source DFC_ComTOutTCU2" VAL_BLK 0x804FACAC ValA_Wu8 17.0000000000 DINH_LimDFCVerb 0.00 17.0000000000 FORMAT "%13.10" NUMBER 52 /end CHARACTERISTIC
/begin CHARACTERISTIC DINH_Lim.DFC_ComTOutTCU3_CA "inhibit conditions / inhibit limit conditions for inhibit source DFC_ComTOutTCU3" VAL_BLK 0x804FACE0 ValA_Wu8 17.0000000000 DINH_LimDFCVerb 0.00 17.0000000000 FORMAT "%13.10" NUMBER 52 /end CHARACTERISTIC
/begin CHARACTERISTIC DINH_Lim.DFC_ComTOutTCU4_CA "inhibit conditions / inhibit limit conditions for inhibit source DFC_ComTOutTCU4" VAL_BLK 0x804FAD14 ValA_Wu8 17.0000000000 DINH_LimDFCVerb 0.00 17.0000000000 FORMAT "%13.10" NUMBER 51 /end CHARACTERISTIC
/begin CHARACTERISTIC DINH_Lim.DFC_DevLibBattUHi_CA "inhibit conditions / inhibit limit conditions for inhibit source DFC_DevLibBattUHi" VAL_BLK 0x804FAD47 ValA_Wu8 17.0000000000 DINH_LimDFCVerb 0.00 17.0000000000 FORMAT "%13.10" NUMBER 50 /end CHARACTERISTIC
/begin CHARACTERISTIC DINH_Lim.DFC_DevLibBattULo_CA "inhibit conditions / inhibit limit conditions for inhibit source DFC_DevLibBattULo" VAL_BLK 0x804FAD79 ValA_Wu8 17.0000000000 DINH_LimDFCVerb 0.00 17.0000000000 FORMAT "%13.10" NUMBER 50 /end CHARACTERISTIC
/begin CHARACTERISTIC DINH_Lim.DFC_EGRVlvFailSafeActv_CA "inhibit conditions / inhibit limit conditions for inhibit source DFC_EGRVlvFailSafeActv" VAL_BLK 0x804FADAB ValA_Wu8 17.0000000000 DINH_LimDFCVerb 0.00 17.0000000000 FORMAT "%13.10" NUMBER 51 /end CHARACTERISTIC
/begin CHARACTERISTIC DINH_Lim.DFC_EGRVlvGovDvtCld_CA "inhibit conditions / inhibit limit conditions for inhibit source DFC_EGRVlvGovDvtCld" VAL_BLK 0x804FADDE ValA_Wu8 17.0000000000 DINH_LimDFCVerb 0.00 17.0000000000 FORMAT "%13.10" NUMBER 51 /end CHARACTERISTIC
/begin CHARACTERISTIC DINH_Lim.DFC_EGRVlvPhysSRCMax_CA "inhibit conditions / inhibit limit conditions for inhibit source DFC_EGRVlvPhysSRCMax" VAL_BLK 0x804FAE11 ValA_Wu8 17.0000000000 DINH_LimDFCVerb 0.00 17.0000000000 FORMAT "%13.10" NUMBER 54 /end CHARACTERISTIC
/begin CHARACTERISTIC DINH_Lim.DFC_EGRVlvPhysSRCMin_CA "inhibit conditions / inhibit limit conditions for inhibit source DFC_EGRVlvPhysSRCMin" VAL_BLK 0x804FAE47 ValA_Wu8 17.0000000000 DINH_LimDFCVerb 0.00 17.0000000000 FORMAT "%13.10" NUMBER 54 /end CHARACTERISTIC
/begin CHARACTERISTIC DINH_Lim.DFC_FanDIOOL_0_CA "inhibit conditions / inhibit limit conditions for inhibit source DFC_FanDIOOL_0" VAL_BLK 0x804FAE7D ValA_Wu8 17.0000000000 DINH_LimDFCVerb 0.00 17.0000000000 FORMAT "%13.10" NUMBER 51 /end CHARACTERISTIC
/begin CHARACTERISTIC DINH_Lim.DFC_FanDIOOL_1_CA "inhibit conditions / inhibit limit conditions for inhibit source DFC_FanDIOOL_1" VAL_BLK 0x804FAEB0 ValA_Wu8 17.0000000000 DINH_LimDFCVerb 0.00 17.0000000000 FORMAT "%13.10" NUMBER 51 /end CHARACTERISTIC
/begin CHARACTERISTIC DINH_Lim.DFC_FanDIOOvrTemp_0_CA "inhibit conditions / inhibit limit conditions for inhibit source DFC_FanDIOOvrTemp_0" VAL_BLK 0x804FAEE3 ValA_Wu8 17.0000000000 DINH_LimDFCVerb 0.00 17.0000000000 FORMAT "%13.10" NUMBER 50 /end CHARACTERISTIC
/begin CHARACTERISTIC DINH_Lim.DFC_FanDIOOvrTemp_1_CA "inhibit conditions / inhibit limit conditions for inhibit source DFC_FanDIOOvrTemp_1" VAL_BLK 0x804FAF15 ValA_Wu8 17.0000000000 DINH_LimDFCVerb 0.00 17.0000000000 FORMAT "%13.10" NUMBER 50 /end CHARACTERISTIC
/begin CHARACTERISTIC DINH_Lim.DFC_FanDIOSCB_0_CA "inhibit conditions / inhibit limit conditions for inhibit source DFC_FanDIOSCB_0" VAL_BLK 0x804FAF47 ValA_Wu8 17.0000000000 DINH_LimDFCVerb 0.00 17.0000000000 FORMAT "%13.10" NUMBER 51 /end CHARACTERISTIC
/begin CHARACTERISTIC DINH_Lim.DFC_FanDIOSCB_1_CA "inhibit conditions / inhibit limit conditions for inhibit source DFC_FanDIOSCB_1" VAL_BLK 0x804FAF7A ValA_Wu8 17.0000000000 DINH_LimDFCVerb 0.00 17.0000000000 FORMAT "%13.10" NUMBER 51 /end CHARACTERISTIC
/begin CHARACTERISTIC DINH_Lim.DFC_FanDIOSCG_0_CA "inhibit conditions / inhibit limit conditions for inhibit source DFC_FanDIOSCG_0" VAL_BLK 0x804FAFAD ValA_Wu8 17.0000000000 DINH_LimDFCVerb 0.00 17.0000000000 FORMAT "%13.10" NUMBER 51 /end CHARACTERISTIC
/begin CHARACTERISTIC DINH_Lim.DFC_FanDIOSCG_1_CA "inhibit conditions / inhibit limit conditions for inhibit source DFC_FanDIOSCG_1" VAL_BLK 0x804FAFE0 ValA_Wu8 17.0000000000 DINH_LimDFCVerb 0.00 17.0000000000 FORMAT "%13.10" NUMBER 51 /end CHARACTERISTIC
/begin CHARACTERISTIC DINH_Lim.DFC_MRlyDcOL_CA "inhibit conditions / inhibit limit conditions for inhibit source DFC_MRlyDcOL" VAL_BLK 0x804FB013 ValA_Wu8 17.0000000000 DINH_LimDFCVerb 0.00 17.0000000000 FORMAT "%13.10" NUMBER 50 /end CHARACTERISTIC
/begin CHARACTERISTIC DINH_Lim.DFC_MRlyDcSCB_CA "inhibit conditions / inhibit limit conditions for inhibit source DFC_MRlyDcSCB" VAL_BLK 0x804FB045 ValA_Wu8 17.0000000000 DINH_LimDFCVerb 0.00 17.0000000000 FORMAT "%13.10" NUMBER 50 /end CHARACTERISTIC
/begin CHARACTERISTIC DINH_Lim.DFC_MRlyDcSCG_CA "inhibit conditions / inhibit limit conditions for inhibit source DFC_MRlyDcSCG" VAL_BLK 0x804FB077 ValA_Wu8 17.0000000000 DINH_LimDFCVerb 0.00 17.0000000000 FORMAT "%13.10" NUMBER 50 /end CHARACTERISTIC
/begin CHARACTERISTIC DINH_Lim.DFC_PSPOL_CA "inhibit conditions / inhibit limit conditions for inhibit source DFC_PSPOL" VAL_BLK 0x804FB0A9 ValA_Wu8 17.0000000000 DINH_LimDFCVerb 0.00 17.0000000000 FORMAT "%13.10" NUMBER 50 /end CHARACTERISTIC
/begin CHARACTERISTIC DINH_Lim.DFC_PSPOvrTemp_CA "inhibit conditions / inhibit limit conditions for inhibit source DFC_PSPOvrTemp" VAL_BLK 0x804FB0DB ValA_Wu8 17.0000000000 DINH_LimDFCVerb 0.00 17.0000000000 FORMAT "%13.10" NUMBER 50 /end CHARACTERISTIC
/begin CHARACTERISTIC DINH_Lim.DFC_PSPSCB_CA "inhibit conditions / inhibit limit conditions for inhibit source DFC_PSPSCB" VAL_BLK 0x804FB10D ValA_Wu8 17.0000000000 DINH_LimDFCVerb 0.00 17.0000000000 FORMAT "%13.10" NUMBER 50 /end CHARACTERISTIC
/begin CHARACTERISTIC DINH_Lim.DFC_PSPSCG_CA "inhibit conditions / inhibit limit conditions for inhibit source DFC_PSPSCG" VAL_BLK 0x804FB13F ValA_Wu8 17.0000000000 DINH_LimDFCVerb 0.00 17.0000000000 FORMAT "%13.10" NUMBER 50 /end CHARACTERISTIC
/begin CHARACTERISTIC DINH_Lim.DFC_T50Err_CA "inhibit conditions / inhibit limit conditions for inhibit source DFC_T50Err" VAL_BLK 0x804FB171 ValA_Wu8 17.0000000000 DINH_LimDFCVerb 0.00 17.0000000000 FORMAT "%13.10" NUMBER 51 /end CHARACTERISTIC
/begin CHARACTERISTIC DINH_Lim.DFC_ThrVlvLoBattB1_CA "inhibit conditions / inhibit limit conditions for inhibit source DFC_ThrVlvLoBattB1" VAL_BLK 0x804FB1A4 ValA_Wu8 17.0000000000 DINH_LimDFCVerb 0.00 17.0000000000 FORMAT "%13.10" NUMBER 50 /end CHARACTERISTIC
/begin CHARACTERISTIC DINH_Lim.DFC_UegoSigOperPlausS1B1_CA "inhibit conditions / inhibit limit conditions for inhibit source DFC_UegoSigOperPlausS1B1" VAL_BLK 0x804FB1D6 ValA_Wu8 17.0000000000 DINH_LimDFCVerb 0.00 17.0000000000 FORMAT "%13.10" NUMBER 73 /end CHARACTERISTIC
/begin CHARACTERISTIC DINH_Lim.DFC_VehVPhysRngHi_CA "inhibit conditions / inhibit limit conditions for inhibit source DFC_VehVPhysRngHi" VAL_BLK 0x804FB21F ValA_Wu8 17.0000000000 DINH_LimDFCVerb 0.00 17.0000000000 FORMAT "%13.10" NUMBER 99 /end CHARACTERISTIC
/begin CHARACTERISTIC DINH_Lim.DFC_VehVSclOutOL_CA "inhibit conditions / inhibit limit conditions for inhibit source DFC_VehVSclOutOL" VAL_BLK 0x804FB282 ValA_Wu8 17.0000000000 DINH_LimDFCVerb 0.00 17.0000000000 FORMAT "%13.10" NUMBER 50 /end CHARACTERISTIC
/begin CHARACTERISTIC DINH_Lim.DFC_VehVSclOutOT_CA "inhibit conditions / inhibit limit conditions for inhibit source DFC_VehVSclOutOT" VAL_BLK 0x804FB2B4 ValA_Wu8 17.0000000000 DINH_LimDFCVerb 0.00 17.0000000000 FORMAT "%13.10" NUMBER 50 /end CHARACTERISTIC
/begin CHARACTERISTIC DINH_Lim.DFC_VehVSclOutSCB_CA "inhibit conditions / inhibit limit conditions for inhibit source DFC_VehVSclOutSCB" VAL_BLK 0x804FB2E6 ValA_Wu8 17.0000000000 DINH_LimDFCVerb 0.00 17.0000000000 FORMAT "%13.10" NUMBER 50 /end CHARACTERISTIC
/begin CHARACTERISTIC DINH_Lim.DFC_VehVSclOutSCG_CA "inhibit conditions / inhibit limit conditions for inhibit source DFC_VehVSclOutSCG" VAL_BLK 0x804FB318 ValA_Wu8 17.0000000000 DINH_LimDFCVerb 0.00 17.0000000000 FORMAT "%13.10" NUMBER 50 /end CHARACTERISTIC
/begin CHARACTERISTIC DINH_Lim.DFC_VehVSigFL_CA "inhibit conditions / inhibit limit conditions for inhibit source DFC_VehVSigFL" VAL_BLK 0x804FB34A ValA_Wu8 17.0000000000 DINH_LimDFCVerb 0.00 17.0000000000 FORMAT "%13.10" NUMBER 51 /end CHARACTERISTIC
/begin CHARACTERISTIC DINH_Lim.DFC_VehVSigFR_CA "inhibit conditions / inhibit limit conditions for inhibit source DFC_VehVSigFR" VAL_BLK 0x804FB37D ValA_Wu8 17.0000000000 DINH_LimDFCVerb 0.00 17.0000000000 FORMAT "%13.10" NUMBER 51 /end CHARACTERISTIC
/begin CHARACTERISTIC DINH_Lim.DFC_VehVSigRL_CA "inhibit conditions / inhibit limit conditions for inhibit source DFC_VehVSigRL" VAL_BLK 0x804FB3B0 ValA_Wu8 17.0000000000 DINH_LimDFCVerb 0.00 17.0000000000 FORMAT "%13.10" NUMBER 51 /end CHARACTERISTIC
/begin CHARACTERISTIC DINH_Lim.DFC_VehVSigRR_CA "inhibit conditions / inhibit limit conditions for inhibit source DFC_VehVSigRR" VAL_BLK 0x804FB3E3 ValA_Wu8 17.0000000000 DINH_LimDFCVerb 0.00 17.0000000000 FORMAT "%13.10" NUMBER 51 /end CHARACTERISTIC
/begin CHARACTERISTIC DINH_Lim.DFC_VehVSnsrARngHi_CA "inhibit conditions / inhibit limit conditions for inhibit source DFC_VehVSnsrARngHi" VAL_BLK 0x804FB416 ValA_Wu8 17.0000000000 DINH_LimDFCVerb 0.00 17.0000000000 FORMAT "%13.10" NUMBER 50 /end CHARACTERISTIC
/begin CHARACTERISTIC DINH_Lim.DFC_VehVSnsrBRngHi_CA "inhibit conditions / inhibit limit conditions for inhibit source DFC_VehVSnsrBRngHi" VAL_BLK 0x804FB448 ValA_Wu8 17.0000000000 DINH_LimDFCVerb 0.00 17.0000000000 FORMAT "%13.10" NUMBER 50 /end CHARACTERISTIC
/begin CHARACTERISTIC DINH_Lim.DFC_VehVSpdRtyDiag_CA "inhibit conditions / inhibit limit conditions for inhibit source DFC_VehVSpdRtyDiag" VAL_BLK 0x804FB47A ValA_Wu8 17.0000000000 DINH_LimDFCVerb 0.00 17.0000000000 FORMAT "%13.10" NUMBER 51 /end CHARACTERISTIC
/begin CHARACTERISTIC DINH_Lim.DFC_DHFHD_CA "inhibit conditions / inhibit limit conditions for inhibit source DFC_DHFHD" VAL_BLK 0x804FB4AD ValA_Wu8 17.0000000000 DINH_LimDFCVerb 0.00 17.0000000000 FORMAT "%13.10" NUMBER 51 /end CHARACTERISTIC
/begin CHARACTERISTIC DINH_Lim.DFC_InjVlv_DI_DcDc_CA "inhibit conditions / inhibit limit conditions for inhibit source DFC_InjVlv_DI_DcDc" VAL_BLK 0x804FB4E0 ValA_Wu8 17.0000000000 DINH_LimDFCVerb 0.00 17.0000000000 FORMAT "%13.10" NUMBER 50 /end CHARACTERISTIC
/begin CHARACTERISTIC DINH_Lim.DFC_InjVlv_DI_NoLd_0_CA "inhibit conditions / inhibit limit conditions for inhibit source DFC_InjVlv_DI_NoLd_0" VAL_BLK 0x804FB512 ValA_Wu8 17.0000000000 DINH_LimDFCVerb 0.00 17.0000000000 FORMAT "%13.10" NUMBER 60 /end CHARACTERISTIC
/begin CHARACTERISTIC DINH_Lim.DFC_InjVlv_DI_NoLd_1_CA "inhibit conditions / inhibit limit conditions for inhibit source DFC_InjVlv_DI_NoLd_1" VAL_BLK 0x804FB54E ValA_Wu8 17.0000000000 DINH_LimDFCVerb 0.00 17.0000000000 FORMAT "%13.10" NUMBER 60 /end CHARACTERISTIC
/begin CHARACTERISTIC DINH_Lim.DFC_InjVlv_DI_NoLd_2_CA "inhibit conditions / inhibit limit conditions for inhibit source DFC_InjVlv_DI_NoLd_2" VAL_BLK 0x804FB58A ValA_Wu8 17.0000000000 DINH_LimDFCVerb 0.00 17.0000000000 FORMAT "%13.10" NUMBER 60 /end CHARACTERISTIC
/begin CHARACTERISTIC DINH_Lim.DFC_InjVlv_DI_NoLd_3_CA "inhibit conditions / inhibit limit conditions for inhibit source DFC_InjVlv_DI_NoLd_3" VAL_BLK 0x804FB5C6 ValA_Wu8 17.0000000000 DINH_LimDFCVerb 0.00 17.0000000000 FORMAT "%13.10" NUMBER 60 /end CHARACTERISTIC
/begin CHARACTERISTIC DINH_Lim.DFC_InjVlv_DI_ScBnk_0_CA "inhibit conditions / inhibit limit conditions for inhibit source DFC_InjVlv_DI_ScBnk_0" VAL_BLK 0x804FB602 ValA_Wu8 17.0000000000 DINH_LimDFCVerb 0.00 17.0000000000 FORMAT "%13.10" NUMBER 60 /end CHARACTERISTIC
/begin CHARACTERISTIC DINH_Lim.DFC_InjVlv_DI_ScBnk_1_CA "inhibit conditions / inhibit limit conditions for inhibit source DFC_InjVlv_DI_ScBnk_1" VAL_BLK 0x804FB63E ValA_Wu8 17.0000000000 DINH_LimDFCVerb 0.00 17.0000000000 FORMAT "%13.10" NUMBER 60 /end CHARACTERISTIC
/begin CHARACTERISTIC DINH_Lim.DFC_InjVlv_DI_ScBnk_2_CA "inhibit conditions / inhibit limit conditions for inhibit source DFC_InjVlv_DI_ScBnk_2" VAL_BLK 0x804FB67A ValA_Wu8 17.0000000000 DINH_LimDFCVerb 0.00 17.0000000000 FORMAT "%13.10" NUMBER 60 /end CHARACTERISTIC
/begin CHARACTERISTIC DINH_Lim.DFC_InjVlv_DI_ScBnk_3_CA "inhibit conditions / inhibit limit conditions for inhibit source DFC_InjVlv_DI_ScBnk_3" VAL_BLK 0x804FB6B6 ValA_Wu8 17.0000000000 DINH_LimDFCVerb 0.00 17.0000000000 FORMAT "%13.10" NUMBER 60 /end CHARACTERISTIC
/begin CHARACTERISTIC DINH_Lim.DFC_InjVlv_DI_ScCyl_0_CA "inhibit conditions / inhibit limit conditions for inhibit source DFC_InjVlv_DI_ScCyl_0" VAL_BLK 0x804FB6F2 ValA_Wu8 17.0000000000 DINH_LimDFCVerb 0.00 17.0000000000 FORMAT "%13.10" NUMBER 60 /end CHARACTERISTIC
/begin CHARACTERISTIC DINH_Lim.DFC_InjVlv_DI_ScCyl_1_CA "inhibit conditions / inhibit limit conditions for inhibit source DFC_InjVlv_DI_ScCyl_1" VAL_BLK 0x804FB72E ValA_Wu8 17.0000000000 DINH_LimDFCVerb 0.00 17.0000000000 FORMAT "%13.10" NUMBER 60 /end CHARACTERISTIC
/begin CHARACTERISTIC DINH_Lim.DFC_InjVlv_DI_ScCyl_2_CA "inhibit conditions / inhibit limit conditions for inhibit source DFC_InjVlv_DI_ScCyl_2" VAL_BLK 0x804FB76A ValA_Wu8 17.0000000000 DINH_LimDFCVerb 0.00 17.0000000000 FORMAT "%13.10" NUMBER 60 /end CHARACTERISTIC
/begin CHARACTERISTIC DINH_Lim.DFC_InjVlv_DI_ScCyl_3_CA "inhibit conditions / inhibit limit conditions for inhibit source DFC_InjVlv_DI_ScCyl_3" VAL_BLK 0x804FB7A6 ValA_Wu8 17.0000000000 DINH_LimDFCVerb 0.00 17.0000000000 FORMAT "%13.10" NUMBER 60 /end CHARACTERISTIC
/begin CHARACTERISTIC DINH_Lim.DFC_InjVlv_DI_ScHsLs_0_CA "inhibit conditions / inhibit limit conditions for inhibit source DFC_InjVlv_DI_ScHsLs_0" VAL_BLK 0x804FB7E2 ValA_Wu8 17.0000000000 DINH_LimDFCVerb 0.00 17.0000000000 FORMAT "%13.10" NUMBER 60 /end CHARACTERISTIC
/begin CHARACTERISTIC DINH_Lim.DFC_InjVlv_DI_ScHsLs_1_CA "inhibit conditions / inhibit limit conditions for inhibit source DFC_InjVlv_DI_ScHsLs_1" VAL_BLK 0x804FB81E ValA_Wu8 17.0000000000 DINH_LimDFCVerb 0.00 17.0000000000 FORMAT "%13.10" NUMBER 60 /end CHARACTERISTIC
/begin CHARACTERISTIC DINH_Lim.DFC_InjVlv_DI_ScHsLs_2_CA "inhibit conditions / inhibit limit conditions for inhibit source DFC_InjVlv_DI_ScHsLs_2" VAL_BLK 0x804FB85A ValA_Wu8 17.0000000000 DINH_LimDFCVerb 0.00 17.0000000000 FORMAT "%13.10" NUMBER 60 /end CHARACTERISTIC
/begin CHARACTERISTIC DINH_Lim.DFC_InjVlv_DI_ScHsLs_3_CA "inhibit conditions / inhibit limit conditions for inhibit source DFC_InjVlv_DI_ScHsLs_3" VAL_BLK 0x804FB896 ValA_Wu8 17.0000000000 DINH_LimDFCVerb 0.00 17.0000000000 FORMAT "%13.10" NUMBER 60 /end CHARACTERISTIC
/begin CHARACTERISTIC DINH_Lim.DFC_MfPsDiaOpenLoad1_CA "inhibit conditions / inhibit limit conditions for inhibit source DFC_MfPsDiaOpenLoad1" VAL_BLK 0x804FB8D2 ValA_Wu8 17.0000000000 DINH_LimDFCVerb 0.00 17.0000000000 FORMAT "%13.10" NUMBER 65 /end CHARACTERISTIC
/begin CHARACTERISTIC DINH_Lim.DFC_MfPsDiaScHiS1_CA "inhibit conditions / inhibit limit conditions for inhibit source DFC_MfPsDiaScHiS1" VAL_BLK 0x804FB913 ValA_Wu8 17.0000000000 DINH_LimDFCVerb 0.00 17.0000000000 FORMAT "%13.10" NUMBER 65 /end CHARACTERISTIC
/begin CHARACTERISTIC DINH_Lim.DFC_MfPsDiaScHiSLowS1_CA "inhibit conditions / inhibit limit conditions for inhibit source DFC_MfPsDiaScHiSLowS1" VAL_BLK 0x804FB954 ValA_Wu8 17.0000000000 DINH_LimDFCVerb 0.00 17.0000000000 FORMAT "%13.10" NUMBER 65 /end CHARACTERISTIC
/begin CHARACTERISTIC DINH_Lim.DFC_MfPsDiaScLowS1_CA "inhibit conditions / inhibit limit conditions for inhibit source DFC_MfPsDiaScLowS1" VAL_BLK 0x804FB995 ValA_Wu8 17.0000000000 DINH_LimDFCVerb 0.00 17.0000000000 FORMAT "%13.10" NUMBER 65 /end CHARACTERISTIC
/begin CHARACTERISTIC DINH_Lim.DFC_ACEvpTPhysRngHi_CA "inhibit conditions / inhibit limit conditions for inhibit source DFC_ACEvpTPhysRngHi" VAL_BLK 0x804FB9D6 ValA_Wu8 17.0000000000 DINH_LimDFCVerb 0.00 17.0000000000 FORMAT "%13.10" NUMBER 52 /end CHARACTERISTIC
/begin CHARACTERISTIC DINH_Lim.DFC_ACEvpTPhysRngLo_CA "inhibit conditions / inhibit limit conditions for inhibit source DFC_ACEvpTPhysRngLo" VAL_BLK 0x804FBA0A ValA_Wu8 17.0000000000 DINH_LimDFCVerb 0.00 17.0000000000 FORMAT "%13.10" NUMBER 52 /end CHARACTERISTIC
/begin CHARACTERISTIC DINH_Lim.DFC_ACEvpTSRCMax_CA "inhibit conditions / inhibit limit conditions for inhibit source DFC_ACEvpTSRCMax" VAL_BLK 0x804FBA3E ValA_Wu8 17.0000000000 DINH_LimDFCVerb 0.00 17.0000000000 FORMAT "%13.10" NUMBER 53 /end CHARACTERISTIC
/begin CHARACTERISTIC DINH_Lim.DFC_ACEvpTSRCMin_CA "inhibit conditions / inhibit limit conditions for inhibit source DFC_ACEvpTSRCMin" VAL_BLK 0x804FBA73 ValA_Wu8 17.0000000000 DINH_LimDFCVerb 0.00 17.0000000000 FORMAT "%13.10" NUMBER 53 /end CHARACTERISTIC
/begin CHARACTERISTIC DINH_Lim.DFC_AfsRawSigRngHiB1_CA "inhibit conditions / inhibit limit conditions for inhibit source DFC_AfsRawSigRngHiB1" VAL_BLK 0x804FBAA8 ValA_Wu8 17.0000000000 DINH_LimDFCVerb 0.00 17.0000000000 FORMAT "%13.10" NUMBER 57 /end CHARACTERISTIC
/begin CHARACTERISTIC DINH_Lim.DFC_AfsRawSigRngLoB1_CA "inhibit conditions / inhibit limit conditions for inhibit source DFC_AfsRawSigRngLoB1" VAL_BLK 0x804FBAE1 ValA_Wu8 17.0000000000 DINH_LimDFCVerb 0.00 17.0000000000 FORMAT "%13.10" NUMBER 57 /end CHARACTERISTIC
/begin CHARACTERISTIC DINH_Lim.DFC_AfsSnsrErrB1_CA "inhibit conditions / inhibit limit conditions for inhibit source DFC_AfsSnsrErrB1" VAL_BLK 0x804FBB1A ValA_Wu8 17.0000000000 DINH_LimDFCVerb 0.00 17.0000000000 FORMAT "%13.10" NUMBER 57 /end CHARACTERISTIC
/begin CHARACTERISTIC DINH_Lim.DFC_AirCClntPAnaSRCMax_CA "inhibit conditions / inhibit limit conditions for inhibit source DFC_AirCClntPAnaSRCMax" VAL_BLK 0x804FBB53 ValA_Wu8 17.0000000000 DINH_LimDFCVerb 0.00 17.0000000000 FORMAT "%13.10" NUMBER 56 /end CHARACTERISTIC
/begin CHARACTERISTIC DINH_Lim.DFC_AirCClntPAnaSRCMin_CA "inhibit conditions / inhibit limit conditions for inhibit source DFC_AirCClntPAnaSRCMin" VAL_BLK 0x804FBB8B ValA_Wu8 17.0000000000 DINH_LimDFCVerb 0.00 17.0000000000 FORMAT "%13.10" NUMBER 56 /end CHARACTERISTIC
/begin CHARACTERISTIC DINH_Lim.DFC_AirCSwtNpl_CA "inhibit conditions / inhibit limit conditions for inhibit source DFC_AirCSwtNpl" VAL_BLK 0x804FBBC3 ValA_Wu8 17.0000000000 DINH_LimDFCVerb 0.00 17.0000000000 FORMAT "%13.10" NUMBER 51 /end CHARACTERISTIC
/begin CHARACTERISTIC DINH_Lim.DFC_AirCSwtSig_CA "inhibit conditions / inhibit limit conditions for inhibit source DFC_AirCSwtSig" VAL_BLK 0x804FBBF6 ValA_Wu8 17.0000000000 DINH_LimDFCVerb 0.00 17.0000000000 FORMAT "%13.10" NUMBER 51 /end CHARACTERISTIC
/begin CHARACTERISTIC DINH_Lim.DFC_Brk_CA "inhibit conditions / inhibit limit conditions for inhibit source DFC_Brk" VAL_BLK 0x804FBC29 ValA_Wu8 17.0000000000 DINH_LimDFCVerb 0.00 17.0000000000 FORMAT "%13.10" NUMBER 50 /end CHARACTERISTIC
/begin CHARACTERISTIC DINH_Lim.DFC_BrkBstSensSCB_CA "inhibit conditions / inhibit limit conditions for inhibit source DFC_BrkBstSensSCB" VAL_BLK 0x804FBC5B ValA_Wu8 17.0000000000 DINH_LimDFCVerb 0.00 17.0000000000 FORMAT "%13.10" NUMBER 53 /end CHARACTERISTIC
/begin CHARACTERISTIC DINH_Lim.DFC_BrkBstSensSCG_CA "inhibit conditions / inhibit limit conditions for inhibit source DFC_BrkBstSensSCG" VAL_BLK 0x804FBC90 ValA_Wu8 17.0000000000 DINH_LimDFCVerb 0.00 17.0000000000 FORMAT "%13.10" NUMBER 53 /end CHARACTERISTIC
/begin CHARACTERISTIC DINH_Lim.DFC_BrkSig_CA "inhibit conditions / inhibit limit conditions for inhibit source DFC_BrkSig" VAL_BLK 0x804FBCC5 ValA_Wu8 17.0000000000 DINH_LimDFCVerb 0.00 17.0000000000 FORMAT "%13.10" NUMBER 54 /end CHARACTERISTIC
/begin CHARACTERISTIC DINH_Lim.DFC_ClthSig_CA "inhibit conditions / inhibit limit conditions for inhibit source DFC_ClthSig" VAL_BLK 0x804FBCFB ValA_Wu8 17.0000000000 DINH_LimDFCVerb 0.00 17.0000000000 FORMAT "%13.10" NUMBER 63 /end CHARACTERISTIC
/begin CHARACTERISTIC DINH_Lim.DFC_EGRVlvCurrLim_CA "inhibit conditions / inhibit limit conditions for inhibit source DFC_EGRVlvCurrLim" VAL_BLK 0x804FBD3A ValA_Wu8 17.0000000000 DINH_LimDFCVerb 0.00 17.0000000000 FORMAT "%13.10" NUMBER 54 /end CHARACTERISTIC
/begin CHARACTERISTIC DINH_Lim.DFC_EGRVlvOL_CA "inhibit conditions / inhibit limit conditions for inhibit source DFC_EGRVlvOL" VAL_BLK 0x804FBD70 ValA_Wu8 17.0000000000 DINH_LimDFCVerb 0.00 17.0000000000 FORMAT "%13.10" NUMBER 68 /end CHARACTERISTIC
/begin CHARACTERISTIC DINH_Lim.DFC_EGRVlvOvrTemp_CA "inhibit conditions / inhibit limit conditions for inhibit source DFC_EGRVlvOvrTemp" VAL_BLK 0x804FBDB4 ValA_Wu8 17.0000000000 DINH_LimDFCVerb 0.00 17.0000000000 FORMAT "%13.10" NUMBER 50 /end CHARACTERISTIC
/begin CHARACTERISTIC DINH_Lim.DFC_EGRVlvSCB_CA "inhibit conditions / inhibit limit conditions for inhibit source DFC_EGRVlvSCB" VAL_BLK 0x804FBDE6 ValA_Wu8 17.0000000000 DINH_LimDFCVerb 0.00 17.0000000000 FORMAT "%13.10" NUMBER 69 /end CHARACTERISTIC
/begin CHARACTERISTIC DINH_Lim.DFC_EGRVlvSCG_CA "inhibit conditions / inhibit limit conditions for inhibit source DFC_EGRVlvSCG" VAL_BLK 0x804FBE2B ValA_Wu8 17.0000000000 DINH_LimDFCVerb 0.00 17.0000000000 FORMAT "%13.10" NUMBER 68 /end CHARACTERISTIC
/begin CHARACTERISTIC DINH_Lim.DFC_EGRVlvSRCMax_CA "inhibit conditions / inhibit limit conditions for inhibit source DFC_EGRVlvSRCMax" VAL_BLK 0x804FBE6F ValA_Wu8 17.0000000000 DINH_LimDFCVerb 0.00 17.0000000000 FORMAT "%13.10" NUMBER 61 /end CHARACTERISTIC
/begin CHARACTERISTIC DINH_Lim.DFC_EGRVlvSRCMin_CA "inhibit conditions / inhibit limit conditions for inhibit source DFC_EGRVlvSRCMin" VAL_BLK 0x804FBEAC ValA_Wu8 17.0000000000 DINH_LimDFCVerb 0.00 17.0000000000 FORMAT "%13.10" NUMBER 60 /end CHARACTERISTIC
/begin CHARACTERISTIC DINH_Lim.DFC_HLSDemOvhtEngLim_CA "inhibit conditions / inhibit limit conditions for inhibit source DFC_HLSDemOvhtEngLim" VAL_BLK 0x804FBEE8 ValA_Wu8 17.0000000000 DINH_LimDFCVerb 0.00 17.0000000000 FORMAT "%13.10" NUMBER 50 /end CHARACTERISTIC
/begin CHARACTERISTIC DINH_Lim.DFC_OilPSwmpSRCMax_CA "inhibit conditions / inhibit limit conditions for inhibit source DFC_OilPSwmpSRCMax" VAL_BLK 0x804FBF1A ValA_Wu8 17.0000000000 DINH_LimDFCVerb 0.00 17.0000000000 FORMAT "%13.10" NUMBER 59 /end CHARACTERISTIC
/begin CHARACTERISTIC DINH_Lim.DFC_OilPSwmpSRCMin_CA "inhibit conditions / inhibit limit conditions for inhibit source DFC_OilPSwmpSRCMin" VAL_BLK 0x804FBF55 ValA_Wu8 17.0000000000 DINH_LimDFCVerb 0.00 17.0000000000 FORMAT "%13.10" NUMBER 60 /end CHARACTERISTIC
/begin CHARACTERISTIC DINH_Lim.DFC_PIntkVUsLineHiB1_CA "inhibit conditions / inhibit limit conditions for inhibit source DFC_PIntkVUsLineHiB1" VAL_BLK 0x804FBF91 ValA_Wu8 17.0000000000 DINH_LimDFCVerb 0.00 17.0000000000 FORMAT "%13.10" NUMBER 97 /end CHARACTERISTIC
/begin CHARACTERISTIC DINH_Lim.DFC_PIntkVUsLineLoB1_CA "inhibit conditions / inhibit limit conditions for inhibit source DFC_PIntkVUsLineLoB1" VAL_BLK 0x804FBFF2 ValA_Wu8 17.0000000000 DINH_LimDFCVerb 0.00 17.0000000000 FORMAT "%13.10" NUMBER 97 /end CHARACTERISTIC
/begin CHARACTERISTIC DINH_Lim.DFC_VehVPhysRngLo_CA "inhibit conditions / inhibit limit conditions for inhibit source DFC_VehVPhysRngLo" VAL_BLK 0x804FC053 ValA_Wu8 17.0000000000 DINH_LimDFCVerb 0.00 17.0000000000 FORMAT "%13.10" NUMBER 82 /end CHARACTERISTIC
/begin CHARACTERISTIC DINH_Lim.DFC_VehVSigCan_CA "inhibit conditions / inhibit limit conditions for inhibit source DFC_VehVSigCan" VAL_BLK 0x804FC0A5 ValA_Wu8 17.0000000000 DINH_LimDFCVerb 0.00 17.0000000000 FORMAT "%13.10" NUMBER 54 /end CHARACTERISTIC
/begin CHARACTERISTIC DINH_Lim.DFC_VehVSigCanSafe_CA "inhibit conditions / inhibit limit conditions for inhibit source DFC_VehVSigCanSafe" VAL_BLK 0x804FC0DB ValA_Wu8 17.0000000000 DINH_LimDFCVerb 0.00 17.0000000000 FORMAT "%13.10" NUMBER 57 /end CHARACTERISTIC
/begin CHARACTERISTIC DINH_Lim.DFC_VlvLftFbOilPSnsrIntk11SRCMax_CA "inhibit conditions / inhibit limit conditions for inhibit source DFC_VlvLftFbOilPSnsrIntk11SRCMax" VAL_BLK 0x804FC114 ValA_Wu8 17.0000000000 DINH_LimDFCVerb 0.00 17.0000000000 FORMAT "%13.10" NUMBER 79 /end CHARACTERISTIC
/begin CHARACTERISTIC DINH_Lim.DFC_VlvLftFbOilPSnsrIntk11SRCMin_CA "inhibit conditions / inhibit limit conditions for inhibit source DFC_VlvLftFbOilPSnsrIntk11SRCMin" VAL_BLK 0x804FC163 ValA_Wu8 17.0000000000 DINH_LimDFCVerb 0.00 17.0000000000 FORMAT "%13.10" NUMBER 79 /end CHARACTERISTIC
/begin CHARACTERISTIC DINH_Lim.DFC_ClthNpl_CA "inhibit conditions / inhibit limit conditions for inhibit source DFC_ClthNpl" VAL_BLK 0x804FC1B2 ValA_Wu8 17.0000000000 DINH_LimDFCVerb 0.00 17.0000000000 FORMAT "%13.10" NUMBER 64 /end CHARACTERISTIC
/begin CHARACTERISTIC DINH_Lim.DFC_GbxPNPosnDrvCdn_CA "inhibit conditions / inhibit limit conditions for inhibit source DFC_GbxPNPosnDrvCdn" VAL_BLK 0x804FC1F2 ValA_Wu8 17.0000000000 DINH_LimDFCVerb 0.00 17.0000000000 FORMAT "%13.10" NUMBER 61 /end CHARACTERISTIC
/begin CHARACTERISTIC DINH_Lim.DFC_GbxPNPosnPlausy_CA "inhibit conditions / inhibit limit conditions for inhibit source DFC_GbxPNPosnPlausy" VAL_BLK 0x804FC22F ValA_Wu8 17.0000000000 DINH_LimDFCVerb 0.00 17.0000000000 FORMAT "%13.10" NUMBER 55 /end CHARACTERISTIC
/begin CHARACTERISTIC DINH_Lim.DFC_AfsSigErrLineHiB1_CA "inhibit conditions / inhibit limit conditions for inhibit source DFC_AfsSigErrLineHiB1" VAL_BLK 0x804FC266 ValA_Wu8 17.0000000000 DINH_LimDFCVerb 0.00 17.0000000000 FORMAT "%13.10" NUMBER 58 /end CHARACTERISTIC
/begin CHARACTERISTIC DINH_Lim.DFC_AfsSigErrLineLoB1_CA "inhibit conditions / inhibit limit conditions for inhibit source DFC_AfsSigErrLineLoB1" VAL_BLK 0x804FC2A0 ValA_Wu8 17.0000000000 DINH_LimDFCVerb 0.00 17.0000000000 FORMAT "%13.10" NUMBER 58 /end CHARACTERISTIC
/begin CHARACTERISTIC DINH_Lim.DFC_PEnvCcMax_CA "inhibit conditions / inhibit limit conditions for inhibit source DFC_PEnvCcMax" VAL_BLK 0x804FC2DA ValA_Wu8 17.0000000000 DINH_LimDFCVerb 0.00 17.0000000000 FORMAT "%13.10" NUMBER 85 /end CHARACTERISTIC
/begin CHARACTERISTIC DINH_Lim.DFC_PEnvCcMin_CA "inhibit conditions / inhibit limit conditions for inhibit source DFC_PEnvCcMin" VAL_BLK 0x804FC32F ValA_Wu8 17.0000000000 DINH_LimDFCVerb 0.00 17.0000000000 FORMAT "%13.10" NUMBER 85 /end CHARACTERISTIC
/begin CHARACTERISTIC DINH_Lim.DFC_PEnvRngChkMax_CA "inhibit conditions / inhibit limit conditions for inhibit source DFC_PEnvRngChkMax" VAL_BLK 0x804FC384 ValA_Wu8 17.0000000000 DINH_LimDFCVerb 0.00 17.0000000000 FORMAT "%13.10" NUMBER 86 /end CHARACTERISTIC
/begin CHARACTERISTIC DINH_Lim.DFC_PEnvRngChkMin_CA "inhibit conditions / inhibit limit conditions for inhibit source DFC_PEnvRngChkMin" VAL_BLK 0x804FC3DA ValA_Wu8 17.0000000000 DINH_LimDFCVerb 0.00 17.0000000000 FORMAT "%13.10" NUMBER 86 /end CHARACTERISTIC
/begin CHARACTERISTIC DINH_Lim.DFC_PEnvSnsrPlaus_CA "inhibit conditions / inhibit limit conditions for inhibit source DFC_PEnvSnsrPlaus" VAL_BLK 0x804FC430 ValA_Wu8 17.0000000000 DINH_LimDFCVerb 0.00 17.0000000000 FORMAT "%13.10" NUMBER 82 /end CHARACTERISTIC
/begin CHARACTERISTIC DINH_Lim.DFC_UEGOHeatrRlyPsOLS1B1_CA "inhibit conditions / inhibit limit conditions for inhibit source DFC_UEGOHeatrRlyPsOLS1B1" VAL_BLK 0x804FC482 ValA_Wu8 17.0000000000 DINH_LimDFCVerb 0.00 17.0000000000 FORMAT "%13.10" NUMBER 84 /end CHARACTERISTIC
/begin CHARACTERISTIC DINH_Lim.DFC_UEGOHeatrRlyPsSCBS1B1_CA "inhibit conditions / inhibit limit conditions for inhibit source DFC_UEGOHeatrRlyPsSCBS1B1" VAL_BLK 0x804FC4D6 ValA_Wu8 17.0000000000 DINH_LimDFCVerb 0.00 17.0000000000 FORMAT "%13.10" NUMBER 84 /end CHARACTERISTIC
/begin CHARACTERISTIC DINH_Lim.DFC_UEGOHeatrRlyPsSCGS1B1_CA "inhibit conditions / inhibit limit conditions for inhibit source DFC_UEGOHeatrRlyPsSCGS1B1" VAL_BLK 0x804FC52A ValA_Wu8 17.0000000000 DINH_LimDFCVerb 0.00 17.0000000000 FORMAT "%13.10" NUMBER 82 /end CHARACTERISTIC
/begin CHARACTERISTIC DINH_Lim.DFC_UegoHeatrWireOlS1B1_CA "inhibit conditions / inhibit limit conditions for inhibit source DFC_UegoHeatrWireOlS1B1" VAL_BLK 0x804FC57C ValA_Wu8 17.0000000000 DINH_LimDFCVerb 0.00 17.0000000000 FORMAT "%13.10" NUMBER 84 /end CHARACTERISTIC
/begin CHARACTERISTIC DINH_Lim.DFC_UegoHeatrWireScbS1B1_CA "inhibit conditions / inhibit limit conditions for inhibit source DFC_UegoHeatrWireScbS1B1" VAL_BLK 0x804FC5D0 ValA_Wu8 17.0000000000 DINH_LimDFCVerb 0.00 17.0000000000 FORMAT "%13.10" NUMBER 84 /end CHARACTERISTIC
/begin CHARACTERISTIC DINH_Lim.DFC_UegoHeatrWireScgS1B1_CA "inhibit conditions / inhibit limit conditions for inhibit source DFC_UegoHeatrWireScgS1B1" VAL_BLK 0x804FC624 ValA_Wu8 17.0000000000 DINH_LimDFCVerb 0.00 17.0000000000 FORMAT "%13.10" NUMBER 85 /end CHARACTERISTIC
/begin CHARACTERISTIC DINH_Lim.DFC_KnDetSens1PortAMax_CA "inhibit conditions / inhibit limit conditions for inhibit source DFC_KnDetSens1PortAMax" VAL_BLK 0x804FC679 ValA_Wu8 17.0000000000 DINH_LimDFCVerb 0.00 17.0000000000 FORMAT "%13.10" NUMBER 58 /end CHARACTERISTIC
/begin CHARACTERISTIC DINH_Lim.DFC_KnDetSens1PortAMin_CA "inhibit conditions / inhibit limit conditions for inhibit source DFC_KnDetSens1PortAMin" VAL_BLK 0x804FC6B3 ValA_Wu8 17.0000000000 DINH_LimDFCVerb 0.00 17.0000000000 FORMAT "%13.10" NUMBER 58 /end CHARACTERISTIC
/begin CHARACTERISTIC DINH_Lim.DFC_KnDetSens1PortBMax_CA "inhibit conditions / inhibit limit conditions for inhibit source DFC_KnDetSens1PortBMax" VAL_BLK 0x804FC6ED ValA_Wu8 17.0000000000 DINH_LimDFCVerb 0.00 17.0000000000 FORMAT "%13.10" NUMBER 58 /end CHARACTERISTIC
/begin CHARACTERISTIC DINH_Lim.DFC_KnDetSens1PortBMin_CA "inhibit conditions / inhibit limit conditions for inhibit source DFC_KnDetSens1PortBMin" VAL_BLK 0x804FC727 ValA_Wu8 17.0000000000 DINH_LimDFCVerb 0.00 17.0000000000 FORMAT "%13.10" NUMBER 58 /end CHARACTERISTIC
/begin CHARACTERISTIC DINH_Lim.DFC_Clth2ONStuck_CA "inhibit conditions / inhibit limit conditions for inhibit source DFC_Clth2ONStuck" VAL_BLK 0x804FC761 ValA_Wu8 17.0000000000 DINH_LimDFCVerb 0.00 17.0000000000 FORMAT "%13.10" NUMBER 52 /end CHARACTERISTIC
/begin CHARACTERISTIC DINH_Lim.DFC_Clth2ONStuckLdc_CA "inhibit conditions / inhibit limit conditions for inhibit source DFC_Clth2ONStuckLdc" VAL_BLK 0x804FC795 ValA_Wu8 17.0000000000 DINH_LimDFCVerb 0.00 17.0000000000 FORMAT "%13.10" NUMBER 52 /end CHARACTERISTIC
/begin CHARACTERISTIC DINH_Lim.DFC_Clth3ONStuckLdc_CA "inhibit conditions / inhibit limit conditions for inhibit source DFC_Clth3ONStuckLdc" VAL_BLK 0x804FC7C9 ValA_Wu8 17.0000000000 DINH_LimDFCVerb 0.00 17.0000000000 FORMAT "%13.10" NUMBER 55 /end CHARACTERISTIC
/begin CHARACTERISTIC DINH_Lim.DFC_Clth3ONStuckPostDrv_CA "inhibit conditions / inhibit limit conditions for inhibit source DFC_Clth3ONStuckPostDrv" VAL_BLK 0x804FC800 ValA_Wu8 17.0000000000 DINH_LimDFCVerb 0.00 17.0000000000 FORMAT "%13.10" NUMBER 54 /end CHARACTERISTIC
/begin CHARACTERISTIC DINH_Lim.DFC_Clth4ONStuck_CA "inhibit conditions / inhibit limit conditions for inhibit source DFC_Clth4ONStuck" VAL_BLK 0x804FC836 ValA_Wu8 17.0000000000 DINH_LimDFCVerb 0.00 17.0000000000 FORMAT "%13.10" NUMBER 51 /end CHARACTERISTIC
/begin CHARACTERISTIC DINH_Lim.DFC_Clth4ONStuckLdc_CA "inhibit conditions / inhibit limit conditions for inhibit source DFC_Clth4ONStuckLdc" VAL_BLK 0x804FC869 ValA_Wu8 17.0000000000 DINH_LimDFCVerb 0.00 17.0000000000 FORMAT "%13.10" NUMBER 59 /end CHARACTERISTIC
/begin CHARACTERISTIC DINH_Lim.DFC_ComBCMUnit_CA "inhibit conditions / inhibit limit conditions for inhibit source DFC_ComBCMUnit" VAL_BLK 0x804FC8A4 ValA_Wu8 17.0000000000 DINH_LimDFCVerb 0.00 17.0000000000 FORMAT "%13.10" NUMBER 50 /end CHARACTERISTIC
/begin CHARACTERISTIC DINH_Lim.DFC_ComDLCTCU01_CA "inhibit conditions / inhibit limit conditions for inhibit source DFC_ComDLCTCU01" VAL_BLK 0x804FC8D6 ValA_Wu8 17.0000000000 DINH_LimDFCVerb 0.00 17.0000000000 FORMAT "%13.10" NUMBER 51 /end CHARACTERISTIC
/begin CHARACTERISTIC DINH_Lim.DFC_ComDLCTCU02_CA "inhibit conditions / inhibit limit conditions for inhibit source DFC_ComDLCTCU02" VAL_BLK 0x804FC909 ValA_Wu8 17.0000000000 DINH_LimDFCVerb 0.00 17.0000000000 FORMAT "%13.10" NUMBER 51 /end CHARACTERISTIC
/begin FUNCTION DINH "30000.27.0_1.0.0Diagnostic Inhibit Handler"
 /begin DEF_CHARACTERISTIC DINH_FId.DFC_MOXEMM_SMU_ALM7_26_CA DINH_FId.DFC_MOXEMM_SMU_ALM7_28_CA DINH_FId.DFC_MOXEMM_SMU_ALM7_29_CA DINH_FId.DFC_MOXEMM_SMU_ALM7_30_CA DINH_FId.DFC_MOXEMM_SMU_ALM7_31_CA DINH_FId.DFC_MOXEMM_SMU_ALM8_0_CA DINH_FId.DFC_MOXEMM_SMU_ALM8_1_CA DINH_FId.DFC_MOXEMM_SMU_ALM8_10_CA DINH_FId.DFC_MOXEMM_SMU_ALM8_11_CA DINH_FId.DFC_MOXEMM_SMU_ALM8_12_CA DINH_FId.DFC_MOXEMM_SMU_ALM8_16_CA DINH_FId.DFC_MOXEMM_SMU_ALM8_18_CA DINH_FId.DFC_MOXEMM_SMU_ALM8_2_CA DINH_FId.DFC_MOXEMM_SMU_ALM8_3_CA DINH_FId.DFC_MOXEMM_SMU_ALM8_31_CA DINH_FId.DFC_MOXEMM_SMU_ALM8_4_CA DINH_FId.DFC_MOXEMM_SMU_ALM9_0_CA DINH_FId.DFC_MOXEMM_SMU_ALM9_15_CA DINH_FId.DFC_MOXEMM_SMU_ALM9_3_CA DINH_FId.DFC_MoCADCNTP_CA DINH_FId.DFC_MoCADCTst_CA DINH_FId.DFC_MoCSOPICO_CA DINH_FId.DFC_MoFAPP_CA DINH_FId.DFC_MoFAirFilgPrdc_CA DINH_FId.DFC_MoFAirFlCtOffGdi_CA DINH_FId.DFC_MoFAirFlCylGdi_CA DINH_FId.DFC_MoFAirFlFF_CA DINH_FId.DFC_MoFAirFlIn_CA DINH_FId.DFC_MoFAirFlMixCtlGdiChkAirFl_CA DINH_FId.DFC_MoFAirFlMixCtlGdiChkCtrl_CA DINH_FId.DFC_MoFAirFlMode_CA DINH_FId.DFC_MoFESpd_CA DINH_FId.DFC_MoFIACo_CA DINH_FId.DFC_MoFICOL1_CA DINH_FId.DFC_MoFICOL2_CA DINH_FId.DFC_MoFStrt_CA DINH_FId.DFC_MoFTrqCmp_CA DINH_FId.DFC_MoFTrqCmpMax_CA DINH_FId.DFC_MoFTrqCmpMin_CA DINH_FId.DFC_MoFVarPostBldSel_CA DINH_FId.DFC_MoXEMMHwLTMCUFW_CA DINH_FId.DFC_MoXEMMHwLTMonBIST_CA DINH_FId.DFC_MoXEMMHwLTRegMonTest_CA DINH_FId.DFC_MoXEMMHwLTStbySMUAlvTest_CA DINH_FId.DFC_MoXEMMHwLTTempSens_CA DINH_FId.DFC_MoXEMMHwLTUCBCfg_CA DINH_FId.DFC_NWSEmax_CA DINH_FId.DFC_NWSmax_CA DINH_FId.DFC_OCWDAABEActv_CA DINH_FId.DFC_OCWDACom_CA DINH_FId.DFC_OCWDAErrPin_CA DINH_FId.DFC_OCWDAOvrVltg_CA DINH_FId.DFC_ORAmax_CA DINH_FId.DFC_ORAmin_CA DINH_FId.DFC_OilPPlaus_CA DINH_FId.DFC_PLLSUmax_CA DINH_FId.DFC_PLLSUmin_CA DINH_FId.DFC_PSR1max_CA DINH_FId.DFC_PSRBmax_CA DINH_FId.DFC_PSRBmin_CA DINH_FId.DFC_PSRPmax_CA DINH_FId.DFC_PSRPmin_CA DINH_FId.DFC_PSRPsig_CA DINH_FId.DFC_PSRmax_CA DINH_FId.DFC_PUmax_CA DINH_FId.DFC_P_VSE11_OL_CA DINH_FId.DFC_P_VSE11_SCB_CA DINH_FId.DFC_P_VSE11_SCG_CA DINH_FId.DFC_PhyHighAPP1_CA DINH_FId.DFC_PhyHighAPP2_CA DINH_FId.DFC_PhyLowAPP1_CA DINH_FId.DFC_PhyLowAPP2_CA DINH_FId.DFC_SRCHighAPP1_CA DINH_FId.DFC_SRCHighAPP2_CA DINH_FId.DFC_SRCLowAPP1_CA DINH_FId.DFC_SRCLowAPP2_CA DINH_FId.DFC_SSpMon2_CA DINH_FId.DFC_STHDRmax_CA DINH_FId.DFC_SWReset_0_CA DINH_FId.DFC_SWReset_1_CA DINH_FId.DFC_SWReset_2_CA DINH_FId.DFC_SyncAPP_CA DINH_FId.DFC_TANKLnpl_CA DINH_FId.DFC_TAmax_Dummy_CA DINH_FId.DFC_TESFmax_CA DINH_FId.DFC_TESGmax_CA DINH_FId.DFC_TKAEmax_CA DINH_FId.DFC_TKAEmin_CA DINH_FId.DFC_TKARmax_CA DINH_FId.DFC_TKARnpl_CA DINH_FId.DFC_TMmax_Dummy_CA DINH_FId.DFC_TUMmax_Dummy_CA DINH_FId.DFC_TWCDPriCatB1_CA DINH_FId.DFC_ThrVlvClsdPosnFirstOffsLrnImpoB1_CA DINH_FId.DFC_ThrVlvClsdPosnOffsLrnImpoB1_CA DINH_FId.DFC_ThrVlvClsdPosnOffsLrnMaxB1_CA DINH_FId.DFC_ThrVlvClsdPosnOffsLrnMinB1_CA DINH_FId.DFC_ThrVlvCtrlDeB1_CA DINH_FId.DFC_ThrVlvDycB1_CA DINH_FId.DFC_ThrVlvLimpAirPosnMaxAbsltDriftB1_CA DINH_FId.DFC_ThrVlvLimpAirPosnMaxB1_CA DINH_FId.DFC_ThrVlvLimpAirPosnMaxRelDriftB1_CA DINH_FId.DFC_ThrVlvLimpAirPosnMinB1_CA DINH_FId.DFC_ThrVlvOpenLoadB1_CA DINH_FId.DFC_ThrVlvOpenSprgB1_CA DINH_FId.DFC_ThrVlvOpenSprgSprdB1_CA DINH_FId.DFC_ThrVlvOpenSprgTwnB1_CA DINH_FId.DFC_ThrVlvOverTB1_CA DINH_FId.DFC_ThrVlvRetSprgB1_CA DINH_FId.DFC_ThrVlvRetSprgSprdB1_CA DINH_FId.DFC_ThrVlvRetSprgTwnB1_CA DINH_FId.DFC_ThrVlvSens1MaxB1_CA DINH_FId.DFC_ThrVlvSens1NplB1_CA DINH_FId.DFC_ThrVlvSens2MaxB1_CA DINH_FId.DFC_ThrVlvSens2MinB1_CA DINH_FId.DFC_ThrVlvSens2NplB1_CA DINH_FId.DFC_ThrVlvShoCircB1_CA DINH_FId.DFC_ThrVlvSpiErrB1_CA DINH_FId.DFC_ThrvlvSens1MinB1_CA DINH_FId.DFC_TiOffTBasdChkFast_CA DINH_FId.DFC_TiOffTBasdChkSlow_CA DINH_FId.DFC_UEGOSnsrMntdS1B1_CA DINH_FId.DFC_VehVSig_CA DINH_FId.DFC_VlvLftFbSwtIntk11SpclFail_CA DINH_FId.DFC_VlvLftFbSwtIntk11StdFail_CA DINH_FId.DSQ_ACClntP_CA DINH_FId.DSQ_ACEvpT_CA DINH_FId.DSQ_AirCCmprActr_CA DINH_FId.DSQ_BattU_CA DINH_FId.DSQ_BattULo_CA DINH_FId.DSQ_BrkBstPMdl_CA DINH_FId.DSQ_BrkP_CA DINH_FId.DSQ_BrkPSnsr_CA DINH_FId.DSQ_CoVMDIDASFail_CA DINH_FId.DSQ_DSMInhibitAlways_CA DINH_FId.DSQ_EGRVlv_GovDesVal_CA DINH_FId.DSQ_ElecLd_CA DINH_FId.DSQ_EngICO_CA DINH_FId.DSQ_EpmCaSSigQuality_CA DINH_FId.DSQ_EpmReverseRun_CA DINH_FId.DSQ_FanDIO_0_CA DINH_FId.DSQ_FanDIO_1_CA DINH_FId.DSQ_FuelP_CA DINH_FId.DSQ_FuelT_CA DINH_FId.DSQ_GEVCtlTOilCylHd_CA DINH_FId.DSQ_GEVlvAgIntkB1_CA DINH_FId.DSQ_GbxPNPos_CA DINH_FId.DSQ_GbxPosNotPN_CA DINH_FId.DSQ_InjVlv_DI_CylOk_CA DINH_FId.DSQ_MRly_CA DINH_FId.DSQ_OilP_CA DINH_FId.DSQ_PEnvMeasVld_CA DINH_FId.DSQ_PEnvVld_CA DINH_FId.DSQ_PEnv_pRaw_CA DINH_FId.DSQ_PRail_CA DINH_FId.DSQ_PThrVlvUs_CA DINH_FId.DSQ_PThrVlvUsB1_CA DINH_FId.DSQ_StrtImobChk_CA DINH_FId.DSQ_TDevCenColdStrt_CA DINH_FId.DSQ_VehV_CA DINH_FId.DSQ_VehVSens_CA DINH_FId.DSQ_VehVSnsr_CA DINH_FId.DSQ_stAPP_CA DINH_FId.DSQ_stComEAT4_CA DINH_Lim.DFC_AAVEmax_CA DINH_Lim.DFC_AAVEmin_CA DINH_Lim.DFC_AAVEsig_CA DINH_Lim.DFC_AltIOACGFailr_CA DINH_Lim.DFC_AltIOACGHiVltg_CA DINH_Lim.DFC_AltIOACGLoVltg_CA DINH_Lim.DFC_AltIOACGTHi_CA DINH_Lim.DFC_AltIODConnACG_CA DINH_Lim.DFC_BGOELWAF_CA DINH_Lim.DFC_BattUHiFailr_CA DINH_Lim.DFC_BattULoFailr_CA DINH_Lim.DFC_BrkBstPDriftHiErr_CA DINH_Lim.DFC_BrkBstPDriftLoErr_CA DINH_Lim.DFC_BrkBstPSnsrStuck_CA DINH_Lim.DFC_BrkMnSwtContOn_CA DINH_Lim.DFC_BrkMnSwtNotStp_CA DINH_Lim.DFC_BrkNpl_CA DINH_Lim.DFC_BrkRdntSwtContOn_CA DINH_Lim.DFC_BrkRdntSwtNotStp_CA DINH_Lim.DFC_Clth3ONStuck_CA DINH_Lim.DFC_Clth4OFFStuck_CA DINH_Lim.DFC_ClthOFFStuck_CA DINH_Lim.DFC_ClthONStuck_CA DINH_Lim.DFC_ClthStkFailInfo_CA DINH_Lim.DFC_ComACFailInfo_CA DINH_Lim.DFC_ComATFTValErr_CA DINH_Lim.DFC_ComATMILReq_CA DINH_Lim.DFC_ComAYCAChksum_CA DINH_Lim.DFC_ComAYCARingCnt_CA DINH_Lim.DFC_ComAYCATOut_CA DINH_Lim.DFC_ComAYCDChkSum_CA DINH_Lim.DFC_ComAYCDTOut_CA DINH_Lim.DFC_ComAYCFChksum_CA DINH_Lim.DFC_ComAYCFRingCnt_CA DINH_Lim.DFC_ComAYCFTOut_CA DINH_Lim.DFC_ComAYCGChksum_CA DINH_Lim.DFC_ComAYCGRingCnt_CA DINH_Lim.DFC_ComAYCGTOut_CA DINH_Lim.DFC_ComAYCIChkSum_CA DINH_Lim.DFC_ComAYCIRingCnt_CA DINH_Lim.DFC_ComAYCITOut_CA DINH_Lim.DFC_ComBCM1ChkSum_CA DINH_Lim.DFC_ComBCM1RingCnt_CA DINH_Lim.DFC_ComBCM1TOut_CA DINH_Lim.DFC_ComCANABusOffErr_CA DINH_Lim.DFC_ComCANBBusOffErr_CA DINH_Lim.DFC_ComCANCBusOffErr_CA DINH_Lim.DFC_ComCGW1ChkSum_CA DINH_Lim.DFC_ComCGW1RingCnt_CA DINH_Lim.DFC_ComCGW1TOut_CA DINH_Lim.DFC_ComConvBoostErr_CA DINH_Lim.DFC_ComConvSlipErr_CA DINH_Lim.DFC_ComDCDCPrfmncErr_CA DINH_Lim.DFC_ComDCDCTempWarn_CA DINH_Lim.DFC_ComEAT10Chksum_CA DINH_Lim.DFC_ComEAT10RingCnt_CA DINH_Lim.DFC_ComEAT10TOut_CA DINH_Lim.DFC_ComEAT11ChkSum_CA DINH_Lim.DFC_ComEAT11RingCnt_CA DINH_Lim.DFC_ComEAT11TOut_CA DINH_Lim.DFC_ComEAT12ChkSum_CA DINH_Lim.DFC_ComEAT12RingCnt_CA DINH_Lim.DFC_ComEAT12TOut_CA DINH_Lim.DFC_ComEAT13ChkSum_CA DINH_Lim.DFC_ComEAT13RingCnt_CA DINH_Lim.DFC_ComEAT13TOut_CA DINH_Lim.DFC_ComEAT1Chksum_CA DINH_Lim.DFC_ComEAT1RingCnt_CA DINH_Lim.DFC_ComEAT1TOut_CA DINH_Lim.DFC_ComEAT2ChkSum_CA DINH_Lim.DFC_ComEAT2RingCnt_CA DINH_Lim.DFC_ComEAT2TOut_CA DINH_Lim.DFC_ComEAT4ChkSum_CA DINH_Lim.DFC_ComEAT4RingCnt_CA DINH_Lim.DFC_ComEAT4TOut_CA DINH_Lim.DFC_ComEAT6Chksum_CA DINH_Lim.DFC_ComEAT6RingCnt_CA DINH_Lim.DFC_ComEAT6TOut_CA DINH_Lim.DFC_ComEAT7Chksum_CA DINH_Lim.DFC_ComEAT7RingCnt_CA DINH_Lim.DFC_ComEAT7TOut_CA DINH_Lim.DFC_ComEAT8Chksum_CA DINH_Lim.DFC_ComEAT8RingCnt_CA DINH_Lim.DFC_ComEAT8TOut_CA DINH_Lim.DFC_ComEATAChksum_CA DINH_Lim.DFC_ComEATARingCnt_CA DINH_Lim.DFC_ComEATATOut_CA DINH_Lim.DFC_ComEATBChkSum_CA DINH_Lim.DFC_ComEATBRingCnt_CA DINH_Lim.DFC_ComEATBTOut_CA DINH_Lim.DFC_ComEATCChksum_CA DINH_Lim.DFC_ComEATCRingCnt_CA DINH_Lim.DFC_ComEATCTOut_CA DINH_Lim.DFC_ComEPBBChkSum_CA DINH_Lim.DFC_ComEPBBRingCnt_CA DINH_Lim.DFC_ComEPBBTOut_CA DINH_Lim.DFC_ComEPBChksum_CA DINH_Lim.DFC_ComEPBTOut_CA DINH_Lim.DFC_ComEPBctRing_CA DINH_Lim.DFC_ComEPS1Chksum_CA DINH_Lim.DFC_ComEPS1RingCnt_CA DINH_Lim.DFC_ComEPS1TOut_CA DINH_Lim.DFC_ComEngCanRxErr_CA DINH_Lim.DFC_ComGrvySnsrErr_CA DINH_Lim.DFC_ComGwIMG1ChkSum_CA DINH_Lim.DFC_ComGwIMG1RingCnt_CA DINH_Lim.DFC_ComGwIMG1TOut_CA DINH_Lim.DFC_ComGwIMG3ChkSum_CA DINH_Lim.DFC_ComGwIMG3RingCnt_CA DINH_Lim.DFC_ComGwIMG3TOut_CA DINH_Lim.DFC_ComGwIMG4ChkSum_CA DINH_Lim.DFC_ComGwIMG4RingCnt_CA DINH_Lim.DFC_ComGwIMG4TOut_CA DINH_Lim.DFC_ComGwIMG5ChkSum_CA DINH_Lim.DFC_ComGwIMG5RingCnt_CA DINH_Lim.DFC_ComGwIMG5TOut_CA DINH_Lim.DFC_ComGwIMG6ChkSum_CA DINH_Lim.DFC_ComGwIMG6RingCnt_CA DINH_Lim.DFC_ComGwIMG6TOut_CA DINH_Lim.DFC_ComIDASBChksum_CA DINH_Lim.DFC_ComIDASBRingCnt_CA DINH_Lim.DFC_ComIDASBTOut_CA DINH_Lim.DFC_ComIMGMILReq_CA DINH_Lim.DFC_ComISSPrms_CA DINH_Lim.DFC_ComMETAChksum_CA DINH_Lim.DFC_ComMETAChksumPstDrv_CA DINH_Lim.DFC_ComMETARingCnt_CA DINH_Lim.DFC_ComMETARingCntPstDrv_CA DINH_Lim.DFC_ComMETATOut_CA DINH_Lim.DFC_ComMETATOutPstDrv_CA DINH_Lim.DFC_ComMETCChksum_CA DINH_Lim.DFC_ComMETCRingCnt_CA DINH_Lim.DFC_ComMETCTOut_CA DINH_Lim.DFC_ComMETDChksum_CA DINH_Lim.DFC_ComMETDRingCnt_CA DINH_Lim.DFC_ComMETDTOut_CA DINH_Lim.DFC_ComMETE2Chksum_CA DINH_Lim.DFC_ComMETE2RingCnt_CA DINH_Lim.DFC_ComMETE2TOut_CA DINH_Lim.DFC_ComMETFChksum_CA DINH_Lim.DFC_ComMETFRingCnt_CA DINH_Lim.DFC_ComMETFTOut_CA DINH_Lim.DFC_ComMETGChksum_CA DINH_Lim.DFC_ComMETGRingCnt_CA DINH_Lim.DFC_ComMETGTOut_CA DINH_Lim.DFC_ComMETH2Chksum_CA DINH_Lim.DFC_ComMETH2RingCnt_CA DINH_Lim.DFC_ComMETH2TOut_CA DINH_Lim.DFC_ComMETHChksum_CA DINH_Lim.DFC_ComMETHRingCnt_CA DINH_Lim.DFC_ComMETHTOut_CA DINH_Lim.DFC_ComMETIChksum_CA DINH_Lim.DFC_ComMETIRingCnt_CA DINH_Lim.DFC_ComMETITOut_CA DINH_Lim.DFC_ComMETKChksum_CA DINH_Lim.DFC_ComMETKRingCnt_CA DINH_Lim.DFC_ComMETKTOut_CA DINH_Lim.DFC_ComMETLChksum_CA DINH_Lim.DFC_ComMETLRingCnt_CA DINH_Lim.DFC_ComMETLTOut_CA DINH_Lim.DFC_ComMETMChksum_CA DINH_Lim.DFC_ComMETMRingCnt_CA DINH_Lim.DFC_ComMETMTOut_CA DINH_Lim.DFC_ComMETNChksum_CA DINH_Lim.DFC_ComMETNRingCnt_CA DINH_Lim.DFC_ComMETNTOut_CA DINH_Lim.DFC_ComMtrCom_CA DINH_Lim.DFC_ComPCUChkSum_CA DINH_Lim.DFC_ComPCURingCnt_CA DINH_Lim.DFC_ComPCUTOut_CA DINH_Lim.DFC_ComSRSAChksum_CA DINH_Lim.DFC_ComSRSARingCnt_CA DINH_Lim.DFC_ComSRSATOut_CA DINH_Lim.DFC_ComSRSBChksum_CA DINH_Lim.DFC_ComSRSBRingCnt_CA DINH_Lim.DFC_ComSRSBTOut_CA DINH_Lim.DFC_ComSRSChksum_CA DINH_Lim.DFC_ComSRSErr_CA DINH_Lim.DFC_ComSRSRingCnt_CA DINH_Lim.DFC_ComSRSTOut_CA DINH_Lim.DFC_ComVehSpdPndFltTCU_CA DINH_Lim.DFC_EbsChartcCurrErr_CA DINH_Lim.DFC_EbsSelfDiagErr_CA DINH_Lim.DFC_GEVlvPhaCsersIntkB1_CA DINH_Lim.DFC_GEVlvPhaPsOpenLoadIntkB1_CA DINH_Lim.DFC_GEVlvPhaPsShoToBattIntkB1_CA DINH_Lim.DFC_GEVlvPhaPsShoToGndIntkB1_CA DINH_Lim.DFC_GbxCANDigPlausErr_CA DINH_Lim.DFC_GbxNPos1SRCMax_CA DINH_Lim.DFC_GbxNPos1SRCMin_CA DINH_Lim.DFC_GbxNPos2SRCMax_CA DINH_Lim.DFC_GbxNPos2SRCMin_CA DINH_Lim.DFC_GbxNPosAlvChk_CA DINH_Lim.DFC_GbxNPosSyncErr_CA DINH_Lim.DFC_HEGOS2B1HtrPsMax_CA DINH_Lim.DFC_HEGOS2B1HtrPsMin_CA DINH_Lim.DFC_HEGOS2B1HtrPsSig_CA DINH_Lim.DFC_LinCSErrACG_CA DINH_Lim.DFC_LinCSErrAEV_CA DINH_Lim.DFC_LinCSErrDCDC_CA DINH_Lim.DFC_LinCSErrEBS_CA DINH_Lim.DFC_LinHdrTimeoutErrACG_CA DINH_Lim.DFC_LinHdrTimeoutErrAEV_CA DINH_Lim.DFC_LinHdrTimeoutErrDCDC_CA DINH_Lim.DFC_LinHdrTimeoutErrEBS_CA DINH_Lim.DFC_LinMsgTimeoutErrACG_CA DINH_Lim.DFC_LinMsgTimeoutErrAEV_CA DINH_Lim.DFC_LinMsgTimeoutErrDCDC_CA DINH_Lim.DFC_LinMsgTimeoutErrEBS_CA DINH_Lim.DFC_LinNoStrtComErr_CA DINH_Lim.DFC_LowPresOilP_CA DINH_Lim.DFC_MisfDetVWhlFrntLeOORHi_CA DINH_Lim.DFC_MisfDetVWhlFrntLeRatyHi_CA DINH_Lim.DFC_MisfDetVWhlFrntLeRatyLo_CA DINH_Lim.DFC_MisfDetVWhlFrntLeStuck_CA DINH_Lim.DFC_MisfDetVWhlFrntRiOORHi_CA DINH_Lim.DFC_MisfDetVWhlFrntRiRatyHi_CA DINH_Lim.DFC_MisfDetVWhlFrntRiRatyLo_CA DINH_Lim.DFC_MisfDetVWhlFrntRiStuck_CA DINH_Lim.DFC_MisfDetVWhlReLeOORHi_CA DINH_Lim.DFC_MisfDetVWhlReLeRatyHi_CA DINH_Lim.DFC_MisfDetVWhlReLeRatyLo_CA DINH_Lim.DFC_MisfDetVWhlReLeStuck_CA DINH_Lim.DFC_MisfDetVWhlReRiOORHi_CA DINH_Lim.DFC_MisfDetVWhlReRiRatyHi_CA DINH_Lim.DFC_MisfDetVWhlReRiRatyLo_CA DINH_Lim.DFC_MisfDetVWhlReRiStuck_CA DINH_Lim.DFC_MisfDetdVWhlFrntLePlaus_CA DINH_Lim.DFC_MisfDetdVWhlFrntRiPlaus_CA DINH_Lim.DFC_MisfDetdVWhlReLePlaus_CA DINH_Lim.DFC_MisfDetdVWhlReRiPlaus_CA DINH_Lim.DFC_PEnvSigRngMax_CA DINH_Lim.DFC_PEnvSigRngMin_CA DINH_Lim.DFC_StmFault_CA DINH_Lim.DFC_StrtCtOffPth_CA DINH_Lim.DFC_StrtCtlErr_CA DINH_Lim.DFC_StrtFault_CA DINH_Lim.DFC_StrtLckJudg1_CA DINH_Lim.DFC_StrtLckJudg2_CA DINH_Lim.DFC_StrtOL_CA DINH_Lim.DFC_StrtOL2_CA DINH_Lim.DFC_StrtSCB_CA DINH_Lim.DFC_StrtSCB2_CA DINH_Lim.DFC_StrtSCG_CA DINH_Lim.DFC_StrtSCG2_CA DINH_Lim.DFC_StrtStkRly1_CA DINH_Lim.DFC_StrtStkRly2_CA DINH_Lim.DFC_TEVEmax_CA DINH_Lim.DFC_TEVEmin_CA DINH_Lim.DFC_TEVEsig_CA DINH_Lim.DFC_UegoHeatrPrfmncLoS1B1_CA DINH_Lim.DFC_VehVAllPlaus_CA DINH_Lim.DFC_VehVNCSnsrElecFailr_CA DINH_Lim.DFC_VehVPlausCan_CA DINH_Lim.DFC_VehVPlausFco_CA DINH_Lim.DFC_VehVPlausPwr_CA DINH_Lim.DFC_VehVPlausV2N_CA DINH_Lim.DFC_VehVSpdSnsrAElecFailr_CA DINH_Lim.DFC_VehVSpdSnsrBElecFailr_CA DINH_Lim.DFC_ClthMax_CA DINH_Lim.DFC_IgnClPs_DevComErr_CA DINH_Lim.DFC_IgnClPs_LineOl_0_CA DINH_Lim.DFC_IgnClPs_LineOl_1_CA DINH_Lim.DFC_IgnClPs_LineOl_2_CA DINH_Lim.DFC_IgnClPs_LineOl_3_CA DINH_Lim.DFC_IgnClPs_LineScb_0_CA DINH_Lim.DFC_IgnClPs_LineScb_1_CA DINH_Lim.DFC_IgnClPs_LineScb_2_CA DINH_Lim.DFC_IgnClPs_LineScb_3_CA DINH_Lim.DFC_IgnClPs_LineScg_0_CA DINH_Lim.DFC_IgnClPs_LineScg_1_CA DINH_Lim.DFC_IgnClPs_LineScg_2_CA DINH_Lim.DFC_IgnClPs_LineScg_3_CA DINH_Lim.DFC_KRVEKOEVAB_CA DINH_Lim.DFC_KRVEKOEVAB0_CA DINH_Lim.DFC_KRVEKOEVAB1_CA DINH_Lim.DFC_KRVEKOEVAB2_CA DINH_Lim.DFC_KRVEKOEVAB3_CA DINH_Lim.DFC_UegoSigEcuAsicS1B1_CA DINH_Lim.DFC_UegoSigEcuComS1B1_CA DINH_Lim.DFC_UegoSigSnsrS1B1_CA DINH_Lim.DFC_UegoSigWireOlApesS1B1_CA DINH_Lim.DFC_UegoSigWireOlIpeS1B1_CA DINH_Lim.DFC_UegoSigWireOlReS1B1_CA DINH_Lim.DFC_UegoSigWireRCmpS1B1_CA DINH_Lim.DFC_UegoSigWireScbS1B1_CA DINH_Lim.DFC_UegoSigWireScgS1B1_CA DINH_Lim.DFC_AfsPhyRngHiB1_CA DINH_Lim.DFC_AfsPhyRngLoB1_CA DINH_Lim.DFC_AirCCmprOL_CA DINH_Lim.DFC_AirCCmprOvrTemp_CA DINH_Lim.DFC_AirCCmprSCB_CA DINH_Lim.DFC_AirCCmprSCG_CA DINH_Lim.DFC_AltErr_CA DINH_Lim.DFC_BattUSRCMax_CA DINH_Lim.DFC_BattUSRCMin_CA DINH_Lim.DFC_ComChksTCU1_CA DINH_Lim.DFC_ComChksTCU11_CA DINH_Lim.DFC_ComChksTCU12_CA DINH_Lim.DFC_ComChksTCU13_CA DINH_Lim.DFC_ComChksTCU2_CA DINH_Lim.DFC_ComChksTCU3_CA DINH_Lim.DFC_ComChksTCU4_CA DINH_Lim.DFC_ComCntTCU1_CA DINH_Lim.DFC_ComCntTCU11_CA DINH_Lim.DFC_ComCntTCU12_CA DINH_Lim.DFC_ComCntTCU13_CA DINH_Lim.DFC_ComCntTCU2_CA DINH_Lim.DFC_ComCntTCU3_CA DINH_Lim.DFC_ComCntTCU4_CA DINH_Lim.DFC_ComTOutTCU01_CA DINH_Lim.DFC_ComTOutTCU02_CA DINH_Lim.DFC_ComTOutTCU1_CA DINH_Lim.DFC_ComTOutTCU11_CA DINH_Lim.DFC_ComTOutTCU12_CA DINH_Lim.DFC_ComTOutTCU13_CA DINH_Lim.DFC_ComTOutTCU14_CA DINH_Lim.DFC_ComTOutTCU2_CA DINH_Lim.DFC_ComTOutTCU3_CA DINH_Lim.DFC_ComTOutTCU4_CA DINH_Lim.DFC_DevLibBattUHi_CA DINH_Lim.DFC_DevLibBattULo_CA DINH_Lim.DFC_EGRVlvFailSafeActv_CA DINH_Lim.DFC_EGRVlvGovDvtCld_CA DINH_Lim.DFC_EGRVlvPhysSRCMax_CA DINH_Lim.DFC_EGRVlvPhysSRCMin_CA DINH_Lim.DFC_FanDIOOL_0_CA DINH_Lim.DFC_FanDIOOL_1_CA DINH_Lim.DFC_FanDIOOvrTemp_0_CA DINH_Lim.DFC_FanDIOOvrTemp_1_CA DINH_Lim.DFC_FanDIOSCB_0_CA DINH_Lim.DFC_FanDIOSCB_1_CA DINH_Lim.DFC_FanDIOSCG_0_CA DINH_Lim.DFC_FanDIOSCG_1_CA DINH_Lim.DFC_MRlyDcOL_CA DINH_Lim.DFC_MRlyDcSCB_CA DINH_Lim.DFC_MRlyDcSCG_CA DINH_Lim.DFC_PSPOL_CA DINH_Lim.DFC_PSPOvrTemp_CA DINH_Lim.DFC_PSPSCB_CA DINH_Lim.DFC_PSPSCG_CA DINH_Lim.DFC_T50Err_CA DINH_Lim.DFC_ThrVlvLoBattB1_CA DINH_Lim.DFC_UegoSigOperPlausS1B1_CA DINH_Lim.DFC_VehVPhysRngHi_CA DINH_Lim.DFC_VehVSclOutOL_CA DINH_Lim.DFC_VehVSclOutOT_CA DINH_Lim.DFC_VehVSclOutSCB_CA DINH_Lim.DFC_VehVSclOutSCG_CA DINH_Lim.DFC_VehVSigFL_CA DINH_Lim.DFC_VehVSigFR_CA DINH_Lim.DFC_VehVSigRL_CA DINH_Lim.DFC_VehVSigRR_CA DINH_Lim.DFC_VehVSnsrARngHi_CA DINH_Lim.DFC_VehVSnsrBRngHi_CA DINH_Lim.DFC_VehVSpdRtyDiag_CA DINH_Lim.DFC_DHFHD_CA DINH_Lim.DFC_InjVlv_DI_DcDc_CA DINH_Lim.DFC_InjVlv_DI_NoLd_0_CA DINH_Lim.DFC_InjVlv_DI_NoLd_1_CA DINH_Lim.DFC_InjVlv_DI_NoLd_2_CA DINH_Lim.DFC_InjVlv_DI_NoLd_3_CA DINH_Lim.DFC_InjVlv_DI_ScBnk_0_CA DINH_Lim.DFC_InjVlv_DI_ScBnk_1_CA DINH_Lim.DFC_InjVlv_DI_ScBnk_2_CA DINH_Lim.DFC_InjVlv_DI_ScBnk_3_CA DINH_Lim.DFC_InjVlv_DI_ScCyl_0_CA DINH_Lim.DFC_InjVlv_DI_ScCyl_1_CA DINH_Lim.DFC_InjVlv_DI_ScCyl_2_CA DINH_Lim.DFC_InjVlv_DI_ScCyl_3_CA DINH_Lim.DFC_InjVlv_DI_ScHsLs_0_CA DINH_Lim.DFC_InjVlv_DI_ScHsLs_1_CA DINH_Lim.DFC_InjVlv_DI_ScHsLs_2_CA DINH_Lim.DFC_InjVlv_DI_ScHsLs_3_CA DINH_Lim.DFC_MfPsDiaOpenLoad1_CA DINH_Lim.DFC_MfPsDiaScHiS1_CA DINH_Lim.DFC_MfPsDiaScHiSLowS1_CA DINH_Lim.DFC_MfPsDiaScLowS1_CA DINH_Lim.DFC_ACEvpTPhysRngHi_CA DINH_Lim.DFC_ACEvpTPhysRngLo_CA DINH_Lim.DFC_ACEvpTSRCMax_CA DINH_Lim.DFC_ACEvpTSRCMin_CA DINH_Lim.DFC_AfsRawSigRngHiB1_CA DINH_Lim.DFC_AfsRawSigRngLoB1_CA DINH_Lim.DFC_AfsSnsrErrB1_CA DINH_Lim.DFC_AirCClntPAnaSRCMax_CA DINH_Lim.DFC_AirCClntPAnaSRCMin_CA DINH_Lim.DFC_AirCSwtNpl_CA DINH_Lim.DFC_AirCSwtSig_CA DINH_Lim.DFC_Brk_CA DINH_Lim.DFC_BrkBstSensSCB_CA DINH_Lim.DFC_BrkBstSensSCG_CA DINH_Lim.DFC_BrkSig_CA DINH_Lim.DFC_ClthSig_CA DINH_Lim.DFC_EGRVlvCurrLim_CA DINH_Lim.DFC_EGRVlvOL_CA DINH_Lim.DFC_EGRVlvOvrTemp_CA DINH_Lim.DFC_EGRVlvSCB_CA DINH_Lim.DFC_EGRVlvSCG_CA DINH_Lim.DFC_EGRVlvSRCMax_CA DINH_Lim.DFC_EGRVlvSRCMin_CA DINH_Lim.DFC_HLSDemOvhtEngLim_CA DINH_Lim.DFC_OilPSwmpSRCMax_CA DINH_Lim.DFC_OilPSwmpSRCMin_CA DINH_Lim.DFC_PIntkVUsLineHiB1_CA DINH_Lim.DFC_PIntkVUsLineLoB1_CA DINH_Lim.DFC_VehVPhysRngLo_CA DINH_Lim.DFC_VehVSigCan_CA DINH_Lim.DFC_VehVSigCanSafe_CA DINH_Lim.DFC_VlvLftFbOilPSnsrIntk11SRCMax_CA DINH_Lim.DFC_VlvLftFbOilPSnsrIntk11SRCMin_CA DINH_Lim.DFC_ClthNpl_CA DINH_Lim.DFC_GbxPNPosnDrvCdn_CA DINH_Lim.DFC_GbxPNPosnPlausy_CA DINH_Lim.DFC_AfsSigErrLineHiB1_CA DINH_Lim.DFC_AfsSigErrLineLoB1_CA DINH_Lim.DFC_PEnvCcMax_CA DINH_Lim.DFC_PEnvCcMin_CA DINH_Lim.DFC_PEnvRngChkMax_CA DINH_Lim.DFC_PEnvRngChkMin_CA DINH_Lim.DFC_PEnvSnsrPlaus_CA DINH_Lim.DFC_UEGOHeatrRlyPsOLS1B1_CA DINH_Lim.DFC_UEGOHeatrRlyPsSCBS1B1_CA DINH_Lim.DFC_UEGOHeatrRlyPsSCGS1B1_CA DINH_Lim.DFC_UegoHeatrWireOlS1B1_CA DINH_Lim.DFC_UegoHeatrWireScbS1B1_CA DINH_Lim.DFC_UegoHeatrWireScgS1B1_CA DINH_Lim.DFC_KnDetSens1PortAMax_CA DINH_Lim.DFC_KnDetSens1PortAMin_CA DINH_Lim.DFC_KnDetSens1PortBMax_CA DINH_Lim.DFC_KnDetSens1PortBMin_CA DINH_Lim.DFC_Clth2ONStuck_CA DINH_Lim.DFC_Clth2ONStuckLdc_CA DINH_Lim.DFC_Clth3ONStuckLdc_CA DINH_Lim.DFC_Clth3ONStuckPostDrv_CA DINH_Lim.DFC_Clth4ONStuck_CA DINH_Lim.DFC_Clth4ONStuckLdc_CA DINH_Lim.DFC_ComBCMUnit_CA DINH_Lim.DFC_ComDLCTCU01_CA DINH_Lim.DFC_ComDLCTCU02_CA /end DEF_CHARACTERISTIC
 FUNCTION_VERSION "30000.27.0_1.0.0" /end FUNCTION
/begin COMPU_METHOD DINH_FIdVerb "" TAB_VERB "%6.3" "-" COMPU_TAB_REF DINH_FIdVerb /end COMPU_METHOD
/begin COMPU_VTAB DINH_FIdVerb "" TAB_VERB 969 0 "FId_Unused" 1 "FID_AFRA" 2 "FID_AORA" 3 "FID_ATEH" 4 "FID_ATEL" 5 "FID_ATEN" 6 "FID_ATLDI" 7 "FID_ATLDO" 8 "FID_BEONV" 9 "FId_EGSDCmnSeg1B1Parl" 10 "FID_BAGRA" 11 "FID_BAGRASD" 12 "FID_BDSTOF" 13 "FID_BFVDFRM" 14 "FID_BHOM" 15 "FID_BLLRH" 16 "FID_BLLRKH" 17 "FID_BPLSU" 18 "FID_FRAMBAVMB" 19 "FId_CatHeatgColdStrtReq" 20 "FId_CatHeatgWrmReq" 21 "FId_DSMBDEPHSpOpMode" 22 "FId_EGRVlvCoord" 23 "FId_EGSDO2FuTrmB1" 24 "FId_EGSDO2SnsrMntdRelsS1B1" 25 "FId_EGSDO2_LamOffsFastS1B1" 26 "FId_MisfDetDnAdpnNv" 27 "FId_bascadpncvo" 28 "FID_AGRS" 29 "FID_BBAGR" 30 "FID_BBAGRA" 31 "FID_BGFKMS" 32 "FID_BGMSDKS" 33 "FID_CAGRSUS" 34 "FID_CBGTFUELM" 35 "FID_CBGTHDEV" 36 "FID_CDESVF" 37 "FID_CDETHS" 38 "FID_CDRCTSTRT" 39 "FID_CDSKV" 40 "FID_CDSKVRNO" 41 "FID_CDSKVRPO" 42 "FID_CDSKVRaty" 43 "FID_CDSKVRng" 44 "FID_CDSKVS" 45 "FID_CDSTR" 46 "FID_CDSTTI" 47 "FID_CETHG" 48 "FID_CETHSPLnpl" 49 "FID_CETHSTPLnpl" 50 "FID_CETKHL" 51 "FID_CETKHT" 52 "FID_CGDISTRT" 53 "FID_CGLSRDP" 54 "FID_CHDR" 55 "FID_CHDRKH" 56 "FID_CHDRPL" 57 "FID_CLLKHV" 58 "FID_CLLRHV" 59 "FID_CLZSRDP" 60 "FID_CLZSRHP" 61 "FID_CNLHP" 62 "FID_CNLHP2" 63 "FID_CNLKO2" 64 "FID_CNLKO3" 65 "FID_CNLLP" 66 "FID_CNLPL" 67 "FID_CNLPS" 68 "FID_CNSAD" 69 "FID_CNSAD2" 70 "FID_CPSRB" 71 "FID_CPSRP" 72 "FID_CSTHDR" 73 "FID_CSTRTCTL" 74 "FID_CTESF" 75 "FID_CTESG" 76 "FID_CTHIPSTRT" 77 "FID_CTKACS" 78 "FID_CTMSV" 79 "FID_CTOSP" 80 "FID_DHFERR" 81 "FID_DKRSA" 82 "FID_DLLRBandEndTst" 83 "FID_DLLRShrtTrpSpdRmp" 84 "FID_FEDKAHB" 85 "FID_FEDKAPB" 86 "FID_FEDSSB" 87 "FID_FOFSTP" 88 "FID_FONSTP" 89 "FID_FUEDK" 90 "FID_FVLRA" 91 "FID_KRREGact" 92 "FID_KRREGloc" 93 "FID_LRADLSU" 94 "FID_LRALSVErr" 95 "FID_LRAPLLSU" 96 "FID_LUSTP" 97 "FID_LnKS1" 98 "FID_PLSUV" 99 "FID_PSRMOZDG" 100 "FID_PSRMOZG" 101 "FID_STRTDIA" 102 "FID_STRTSTM" 103 "FID_TFA1CSMW" 104 "FID_TFA2CSMW" 105 "FID_TKACSMW" 106 "FID_TMCSMW" 107 "FID_TOCHOilSwmpTQly" 108 "FID_TOCHTME" 109 "FID_TOSPCSMW" 110 "FID_TSRLX" 111 "FID_UEGOHeatrRlyS1B1" 112 "FID_VehStvSSEOk" 113 "FID_VldtLamPlausMaxS1B1" 114 "FID_VldtLamPlausMinS1B1" 115 "FId_ACClntPSSPMon" 116 "FId_ACCompComCANBusOff" 117 "FId_ACCompComCANErrMtr" 118 "FId_ACComp_HiUTWSnsrErr" 119 "FId_ACComp_LoUTWSnsrErr" 120 "FId_ACComp_PDSnsrErr" 121 "FId_ACComp_VehSpdSnsrErr" 122 "FId_ACCtl_ACStrtCut" 123 "FId_ACCtl_APP1" 124 "FId_ACCtl_APP2" 125 "FId_ACCtl_APPSync" 126 "FId_ACCtl_AcOff" 127 "FId_ACCtl_Clmb" 128 "FId_ACCtl_DK1" 129 "FId_ACCtl_DK2" 130 "FId_ACCtl_DKSync" 131 "FId_ACCtl_VehSpdSnsrErr" 132 "FId_ACCtl_pAC" 133 "FId_ACEvpTCANErr" 134 "FId_ACEvpTFrzVal" 135 "FId_ACEvpTPhysRng" 136 "FId_ACEvpTRplVal" 137 "FId_AFCLFailr" 138 "FId_AFS" 139 "FId_AFSPhyRng" 140 "FId_APP1SigPath" 141 "FId_APP2SigPath" 142 "FId_APPBrkErr" 143 "FId_APPLETVldnErr" 144 "FId_APPLrn" 145 "FId_APPVehVErr" 146 "FId_AccPedDrvModComErr" 147 "FId_AccPedDrvModFailr" 148 "FId_AccPedNMaxLim" 149 "FId_AccPedNMinLim" 150 "FId_AccPedNMinLimBrkApp" 151 "FId_AccPedTrqLim" 152 "FId_AfsDdDiag" 153 "FId_AfsDiagErr" 154 "FId_AfsDiagTst" 155 "FId_AfsPlausDiag" 156 "FId_AfsVrntDiag" 157 "FId_AirCClntPFrzVal" 158 "FId_AirCClntPRplVal" 159 "FId_AirCSwt" 160 "FId_AirDvPAdpnPEnv" 161 "FId_AirDvPAdpnPIntkVUsB1" 162 "FId_AirDvPPSnsrAdpn_PModeActv" 163 "FId_AltACGFailr" 164 "FId_AltAPPErrSt" 165 "FId_AltBattMngtFailr" 166 "FId_AltBrkErrSt" 167 "FId_AltComErr" 168 "FId_AltENGB" 169 "FId_AltElecLoadErr" 170 "FId_AltEnvTErr" 171 "FId_AltFFAltLoadFast" 172 "FId_AltFFAltLoadSlow" 173 "FId_AltIOACGErr" 174 "FId_AltIOACGLinComFailr" 175 "FId_AltIOComErr" 176 "FId_AltLinErr" 177 "FId_AltPwr" 178 "FId_AltVehVErrSt" 179 "FId_AltvCluFail" 180 "FId_BGAGRTS" 181 "FId_BGFKMSEPSR" 182 "FId_BGFKMSEPU" 183 "FId_BGFKMSESumClr" 184 "FId_BGFKMSHFME" 185 "FId_BGFKMSHFMZ" 186 "FId_BGFKMSZPSR" 187 "FId_BGOSCCat1B1" 188 "FId_BGOSCCat2B1" 189 "FId_BattAltFailr" 190 "FId_BattMngtFailr" 191 "FId_BattSigPtd" 192 "FId_BattU2MEDSRC" 193 "FId_BattUDrpPrvOff" 194 "FId_BattUFrzVal" 195 "FId_BattUHiFailrEna" 196 "FId_BattUIMGTCUCANFailr" 197 "FId_BattULoFailrEna" 198 "FId_BattUReplVal" 199 "FId_BattUSRC" 200 "FId_BlwrComErr" 201 "FId_BrkBstMdl" 202 "FId_BrkBstMdlBrkP" 203 "FId_BrkBstMdlBrkSt" 204 "FId_BrkBstMdlEnvP" 205 "FId_BrkBstPDetnInhbn" 206 "FId_BrkBstPMstCylPSnsrFail" 207 "FId_BrkBstPSnsrStuckDetn" 208 "FId_BrkBstSigPath" 209 "FId_BrkBstVehVv" 210 "FId_BrkMnSwtErr" 211 "FId_BrkPFrzVal" 212 "FId_BrkPOilPres" 213 "FId_BrkPReplVal" 214 "FId_BrkPedEngStopEna" 215 "FId_BrkRdntSwtErr" 216 "FId_CAGRSDS" 217 "FId_CEngDsTColdStrt" 218 "FId_CEngDsTColdStrtErr" 219 "FId_CEngDsTHSC" 220 "FId_CEngDsTLSC" 221 "FId_CEngDsTPlausErr" 222 "FId_CEngDsTReplMdlEngStop" 223 "FId_CEngDsTSTC" 224 "FId_CEngDsTSnsrElec" 225 "FId_CEngDsTSwtReplMdl" 226 "FId_CEngUsTColdChkErr" 227 "FId_CEngUsTCrssChk" 228 "FId_CEngUsTElecErr" 229 "FId_CEngUsTSnsrElecErr" 230 "FId_CEngUsTSwtReplMdl" 231 "FId_CInjCatHeatgDiag" 232 "FId_CMSUDKSOM1" 233 "FId_CMSUDKSOM2" 234 "FId_CatHeatgEomShtrpAct" 235 "FId_ChrctlAgrsErr" 236 "FId_ChrctlAgrscf" 237 "FId_ClntTempENGB" 238 "FId_Clth" 239 "FId_Clth2" 240 "FId_Clth3StuckOn" 241 "FId_Clth4" 242 "FId_ClthCAN" 243 "FId_ClthMax" 244 "FId_ClthStk" 245 "FId_ClthStkErr" 246 "FId_ClthStkFailr" 247 "FId_ClthStkOFFStuck" 248 "FId_ClthStkONStuck" 249 "FId_ClthSwtFailr" 250 "FId_CntrShaftFailr" 251 "FId_CoEOMGdiEomErrLcy" 252 "FId_CoESSBlowrVld" 253 "FId_CoETM" 254 "FId_CoETS_StTrqLimErr1" 255 "FId_CoETS_StTrqLimErr2" 256 "FId_CoEngStopEnblStSpEngT" 257 "FId_CoEngStopEnblStSpLSU" 258 "FId_CoEngStopEnblStSpTcT" 259 "FId_CoEngStopEnblSysErr" 260 "FId_CoEngVlvLftSpIntk" 261 "FId_CoPOMStrtgDevStrtr" 262 "FId_CoPOM_FirstStrtAut" 263 "FId_CoTS_SwtOff" 264 "FId_CoVOMACCComFailr" 265 "FId_CoVOMBrkPedISABSigFailr" 266 "FId_CoVOMEngCrkAbort" 267 "FId_CoVOMEngRstrtEnaCdn" 268 "FId_CoVOMISSEng" 269 "FId_ComACRly" 270 "FId_ComAPPSensFail" 271 "FId_ComAPedl" 272 "FId_ComAYCA" 273 "FId_ComAYCAMon" 274 "FId_ComAYCD" 275 "FId_ComAYCDMon" 276 "FId_ComAYCF" 277 "FId_ComAYCFMon" 278 "FId_ComAYCG" 279 "FId_ComAYCGMon" 280 "FId_ComAYCI" 281 "FId_ComAYCIMon" 282 "FId_ComAirPThrUsSnsrErr" 283 "FId_ComAltFail" 284 "FId_ComAppVehSnsrFailr" 285 "FId_ComBCM1" 286 "FId_ComBCM1Mon" 287 "FId_ComBCMUnitCfmdErr" 288 "FId_ComBCMUnitNotTstd" 289 "FId_ComBstCtrl" 290 "FId_ComCANVEHICLEBusOff" 291 "FId_ComCGW1" 292 "FId_ComCGW1Mon" 293 "FId_ComClthSt" 294 "FId_ComConvClth" 295 "FId_ComCrCtlReq" 296 "FId_ComCrsMaiIndcnLampReq" 297 "FId_ComCrsSetIndcnLampReq" 298 "FId_ComDCDCCdn" 299 "FId_ComDCDCErr" 300 "FId_ComDesGearCurr" 301 "FId_ComDetrmAirM" 302 "FId_ComDwnShiftCtrlReq" 303 "FId_ComEAT1" 304 "FId_ComEAT10" 305 "FId_ComEAT10Mon" 306 "FId_ComEAT11" 307 "FId_ComEAT11Mon" 308 "FId_ComEAT12" 309 "FId_ComEAT12Mon" 310 "FId_ComEAT13" 311 "FId_ComEAT13Mon" 312 "FId_ComEAT1Mon" 313 "FId_ComEAT2" 314 "FId_ComEAT2Mon" 315 "FId_ComEAT4" 316 "FId_ComEAT4Mon" 317 "FId_ComEAT6" 318 "FId_ComEAT6Mon" 319 "FId_ComEAT7" 320 "FId_ComEAT7Mon" 321 "FId_ComEAT8" 322 "FId_ComEAT8Mon" 323 "FId_ComEATA" 324 "FId_ComEATAMon" 325 "FId_ComEATB" 326 "FId_ComEATBMon" 327 "FId_ComEATC" 328 "FId_ComEATCMon" 329 "FId_ComEBSSelfDiagErr" 330 "FId_ComECUHwErr" 331 "FId_ComEGRVlvErr" 332 "FId_ComEMSIntAirTemp" 333 "FId_ComEPB" 334 "FId_ComEPBB" 335 "FId_ComEPBBMon" 336 "FId_ComEPBMon" 337 "FId_ComEPS1" 338 "FId_ComEPS1Mon" 339 "FId_ComEPSUnitCfmdErr" 340 "FId_ComEPSUnitNotTstd" 341 "FId_ComEngBrkOvrdInfo" 342 "FId_ComEngBrkOvrdMtr" 343 "FId_ComEngBrkSwErr" 344 "FId_ComEngPosng" 345 "FId_ComEngRPMLim" 346 "FId_ComEngTrqLim" 347 "FId_ComEnvtlAirPSnsrErr" 348 "FId_ComEstmTqNormJdg" 349 "FId_ComEthnlSErr" 350 "FId_ComFlSply" 351 "FId_ComFuCnsBitDurgIdleStop" 352 "FId_ComGEVCntrl" 353 "FId_ComGbxNPosFail" 354 "FId_ComGbxTemp" 355 "FId_ComGwIMG1" 356 "FId_ComGwIMG1Mon" 357 "FId_ComGwIMG3" 358 "FId_ComGwIMG3Mon" 359 "FId_ComGwIMG4" 360 "FId_ComGwIMG4Mon" 361 "FId_ComGwIMG5" 362 "FId_ComGwIMG5Mon" 363 "FId_ComGwIMG6" 364 "FId_ComGwIMG6Mon" 365 "FId_ComHFMSnsrErr" 366 "FId_ComIDASB" 367 "FId_ComIDASBMon" 368 "FId_ComIDASBUnitCfmdErr" 369 "FId_ComIDASBUnitNotTstd" 370 "FId_ComIDASEngFail" 371 "FId_ComIDASEngFailMil" 372 "FId_ComIMGUnitCfmdErr" 373 "FId_ComIMGUnitNotTstd" 374 "FId_ComISG2" 375 "FId_ComIgnCtrl" 376 "FId_ComInjCtrl" 377 "FId_ComIntkAirPSnsrErr" 378 "FId_ComLamCtrl" 379 "FId_ComMETA" 380 "FId_ComMETAMon" 381 "FId_ComMETC" 382 "FId_ComMETCMon" 383 "FId_ComMETD" 384 "FId_ComMETDMon" 385 "FId_ComMETE2" 386 "FId_ComMETE2Mon" 387 "FId_ComMETF" 388 "FId_ComMETFMon" 389 "FId_ComMETG" 390 "FId_ComMETGMon" 391 "FId_ComMETH" 392 "FId_ComMETH2" 393 "FId_ComMETH2Mon" 394 "FId_ComMETHMon" 395 "FId_ComMETI" 396 "FId_ComMETIMon" 397 "FId_ComMETK" 398 "FId_ComMETKMon" 399 "FId_ComMETL" 400 "FId_ComMETLMon" 401 "FId_ComMETM" 402 "FId_ComMETMMon" 403 "FId_ComMETN" 404 "FId_ComMETNMon" 405 "FId_ComMETUnitCfmdErr" 406 "FId_ComMETUnitNotTstd" 407 "FId_ComMisf" 408 "FId_ComMon" 409 "FId_ComNTrbn" 410 "FId_ComODOff" 411 "FId_ComOilLvlLamp" 412 "FId_ComOilPWarnLamp" 413 "FId_ComPASensFail" 414 "FId_ComPBSensFail" 415 "FId_ComPCU" 416 "FId_ComPCUMon" 417 "FId_ComPosActnSpdLimrFctReq" 418 "FId_ComSRS" 419 "FId_ComSRSA" 420 "FId_ComSRSAMon" 421 "FId_ComSRSB" 422 "FId_ComSRSBMon" 423 "FId_ComSRSMon" 424 "FId_ComSRSUnitCfmdErr" 425 "FId_ComSRSUnitNotTstd" 426 "FId_ComSTFlt" 427 "FId_ComSpdLimrDevActvn" 428 "FId_ComTCU01" 429 "FId_ComTCU02" 430 "FId_ComTCU1" 431 "FId_ComTCU11" 432 "FId_ComTCU12" 433 "FId_ComTCU13" 434 "FId_ComTCU14" 435 "FId_ComTCU2" 436 "FId_ComTCU3" 437 "FId_ComTCU4" 438 "FId_ComTCUGear" 439 "FId_ComTarGearDwnShift" 440 "FId_ComTarGearUpShift" 441 "FId_ComThrPosnFail" 442 "FId_ComThrVlv" 443 "FId_ComTrboChrgnErr" 444 "FId_ComTrqAccuracySlow" 445 "FId_ComTrqReqFast" 446 "FId_ComTrqReqSlow" 447 "FId_ComVSAErr" 448 "FId_ComVSAUnitCfmdErr" 449 "FId_ComVSAUnitNotTstd" 450 "FId_ComVehSpdFlLvl" 451 "FId_ComVehSpdFltChk" 452 "FId_ComVehSpdImpsErr" 453 "FId_ComVlvLftCtrl" 454 "FId_ComvolEng" 455 "FId_ConvLdCalcLvrPos" 456 "FId_ConvLdNTrbnCan" 457 "FId_ConvLdOilCoolrPmp" 458 "FId_ConvLdOilTemp" 459 "FId_ConvLdTrqLdCan" 460 "FId_ConvLdVel" 461 "FId_CooltTVldyTMdl" 462 "FId_CptProtnCamsft" 463 "FId_CptProtnExhTempMdl" 464 "FId_CptProtnO2SnsrB1" 465 "FId_CptProtnVVeh" 466 "FId_CrCUI1EFRxErr" 467 "FId_CrCUICANRxErr" 468 "FId_CrCUIFCMRxErr" 469 "FId_CrCUIMETDRxErr" 470 "FId_CrCtlACCRxErr" 471 "FId_CrCtlAppSnsrErr" 472 "FId_CrCtlShutOffEng" 473 "FId_CstrPurgGnrlTstrReq" 474 "FId_DAGRS" 475 "FId_DELibBrkBstP" 476 "FId_DELibCEngDsT" 477 "FId_DELibCEngUsT" 478 "FId_DELibEngDatEng" 479 "FId_DELibEnvP" 480 "FId_DELibEnvT" 481 "FId_DELibFuelT" 482 "FId_DELibIntkAirT" 483 "FId_DELibNRCat" 484 "FId_DELibOilP" 485 "FId_DELibOilSwmpT" 486 "FId_DELibPRelPfilDs" 487 "FId_DELibTEGRClrLPDs" 488 "FId_DEONVEBPEnv" 489 "FId_DEONVTCCpv1DteskLoLoadStuckClsd" 490 "FId_DEONVTCCpv1DteskLoLoadStuckOpen" 491 "FId_DIUMPRCldStrtMon" 492 "FId_DIUMPREvapMon" 493 "FId_DIUMPRGenDenom1" 494 "FId_DIUMPRGenDenom1PDTC" 495 "FId_DIUMPRGenDenom2" 496 "FId_DIUMPRGenDenom3" 497 "FId_DIUMPRIgn" 498 "FId_DOGov" 499 "FId_DSMWarmUpCycle" 500 "FId_DTESKEBCpv1DteskLoLoadStuckClsd" 501 "FId_DTESKEBCpv1DteskLoLoadStuckOpen" 502 "FId_DTESKEnvCondVld" 503 "FId_DTESKFuLvlCondVld" 504 "FId_DTESKvfz" 505 "FId_DdskvFraTstd" 506 "FId_DdskvOraTstd" 507 "FId_DewDetTKAMax" 508 "FId_DiagBlkdLine" 509 "FId_DiagCpv1DteskLoLoad" 510 "FId_DkrsaEpmNoSig" 511 "FId_EBBCANErrFrzVal" 512 "FId_EBBCANErrReplVal" 513 "FId_EGLZSR" 514 "FId_EGRVlvActrOff" 515 "FId_EGRVlvCldStrt" 516 "FId_EGRVlvClnVrfy" 517 "FId_EGRVlvCtrlErr" 518 "FId_EGRVlvEngTempDef" 519 "FId_EGRVlvFailSafeActv" 520 "FId_EGRVlvFrzVal" 521 "FId_EGRVlvGovOn" 522 "FId_EGRVlvGovOnCld" 523 "FId_EGRVlvGovrOnRelsFct" 524 "FId_EGRVlvILimn" 525 "FId_EGRVlvIni" 526 "FId_EGRVlvMon" 527 "FId_EGRVlvOfsLrnInhib" 528 "FId_EGRVlvPhysRng" 529 "FId_EGRVlvPsSwtOff" 530 "FId_EGRVlvPwrStgMonDis" 531 "FId_EGRVlvRplVal" 532 "FId_EGRVlvSSpMon" 533 "FId_EGRVlvSnsrErr" 534 "FId_EGRVlvTempCmp" 535 "FId_EGRVlvTempMdlEEPErr" 536 "FId_EGRVlvTmpErrCnt" 537 "FId_EGRVlvTrlPtr" 538 "FId_EGRVlv_VehvErr" 539 "FId_EGRVlviActIEfcLimn" 540 "FId_EGRVlvpDsbcInvld" 541 "FId_EGSDO2OffsRstDsmS1B1" 542 "FId_EGSDO2_LamOffsSlowS1" 543 "FId_EGSDO2_RstFltSuspcnOffsB1" 544 "FId_EGSDUS2B1DlyEvln" 545 "FId_EGSDUS2B1LtrDly" 546 "FId_EGSDUS2B1LtrPT1" 547 "FId_EGSDUS2B1PT1Evln" 548 "FId_EGSDUS2B1RtlDly" 549 "FId_EGSDUS2B1RtlPT1" 550 "FId_EGSDUS2B1TarEvln" 551 "FId_EGSDUS2B1TarLean" 552 "FId_EGSDUS2B1TarRich" 553 "FId_EGSSigO2S1B1" 554 "FId_ELZSR" 555 "FId_EPBErr" 556 "FId_EPBFrmErr" 557 "FId_EPBFrmErrClth" 558 "FId_ETHSCPErrDrvCyc" 559 "FId_EVPComFailr" 560 "FId_EbsLinErr" 561 "FId_ElecLdComErr" 562 "FId_ElecLdFrzVal" 563 "FId_ElecLdHdLiComErr" 564 "FId_ElecLdRplVal" 565 "FId_ElecLoadEPSComErr" 566 "FId_EngBlkTWrn" 567 "FId_EngCooltTFail" 568 "FId_EngDemTqLimnCamsftErr" 569 "FId_EngDemTqLimnErrThmstHeatCtrlCirc" 570 "FId_EngDemTqLimnOilPmp" 571 "FId_EngDemTrqLimErrAPP" 572 "FId_EngIntkAirFail" 573 "FId_EngPrtErrVehV" 574 "FId_EngSpd30DegFail" 575 "FId_EngStrtEnaEthAdap" 576 "FId_EngStrt_EnaCep" 577 "FId_EngStrt_InjProhb" 578 "FId_EngStrt_VehVInhb" 579 "FId_EngTqRvsnEnaFlg" 580 "FId_EnvTPrimMod" 581 "FId_EnvTPrimModIniVal" 582 "FId_EnvTSensSum" 583 "FId_EnvTtAirFltDs" 584 "FId_EnvTtCEngDsT" 585 "FId_EnvTtIntkMnfld" 586 "FId_EomCvoAllwd" 587 "FId_EpmBCr" 588 "FId_EpmCaSAdapCaSI1" 589 "FId_EpmCaSAdapRstI1" 590 "FId_EpmCaSDiagI1" 591 "FId_EpmCaSErrCaSI1" 592 "FId_EpmCaSOfsDiagCaSI1" 593 "FId_EpmCaSOfsErrCaSI1" 594 "FId_EpmCaSSegI1" 595 "FId_EpmCaSSpdPlausI1" 596 "FId_EpmCrSDiag" 597 "FId_EpmCrSDiagVeh" 598 "FId_EpmCrSErr" 599 "FId_EpmOpMode_ALELock" 600 "FId_EpmOpMode_DirStLock" 601 "FId_EpmRRSCrSFaultCheck" 602 "FId_EpmRRSDGIFaultCheck" 603 "FId_EpmRRSRdCheck" 604 "FId_EpmRRSVehVFaultChck" 605 "FId_EpmSynLockCaSSync" 606 "FId_EpmTmpSuppRvsRotCASI1" 607 "FId_EtaEngIdleNonCsers" 608 "FId_EtaEngPtlNonCsers" 609 "FId_EthnlSnsrErrCdn" 610 "FId_EvapActrCcvElecDiag" 611 "FId_EvapPSnsrTankPhyRngChk" 612 "FId_FanCtlACClntP" 613 "FId_FanCtlACGModFail" 614 "FId_FanCtlAPP1" 615 "FId_FanCtlAPP2" 616 "FId_FanCtlAPPSync" 617 "FId_FanCtlBlowrU" 618 "FId_FanCtlCooltT" 619 "FId_FanCtlCooltT2" 620 "FId_FanCtlEnvT" 621 "FId_FanCtlLiSwtInfo" 622 "FId_FanCtlSpd" 623 "FId_FanCtlTSnsrErr" 624 "FId_FanCtlThr1" 625 "FId_FanCtlThr2" 626 "FId_FcoReq" 627 "FId_FiMFID_rba_MRly_Diag_Stk" 628 "FId_FlComErr" 629 "FId_FlDevPlauDiagFuSnsr" 630 "FId_FlLvlNoSigErr" 631 "FId_FlLvlVehSpdSigErr" 632 "FId_FlLvlVehVErr" 633 "FId_FlMALamDynDiag" 634 "FId_FlSplGAltLin" 635 "FId_FlTnkQnt" 636 "FId_FuMixHotFilmErr" 637 "FId_FuMixUegoErrExcl" 638 "FId_FuPHiRailEthnlSnsrErr" 639 "FId_FuPurg_TEVError" 640 "FId_FuSnsrPhyRngErr" 641 "FId_GEVCtlAVCAdprCBBNWEErrIntk" 642 "FId_GEVCtlAVCAdprIntkB1" 643 "FId_GEVCtlAVCAdprNWSEErrIntk" 644 "FId_GEVCtlAdpnEnaIntk" 645 "FId_GEVCtlAdpnEnaShtrpActv" 646 "FId_GEVCtlClngIntk" 647 "FId_GEVCtlMinOvlIntk" 648 "FId_GEVCtlPOilSnsr" 649 "FId_GEVCtlPhaEnaIntk" 650 "FId_GEVCtlPhaSpTstrIntk" 651 "FId_GEVCtlRefAdpnMntChck" 652 "FId_GEVCtlRefAdpnMntChckTstd" 653 "FId_GEVCtlReqRefAdpnTstrIntk" 654 "FId_GEVCtlReqRefAdpnTstrIntkTstd" 655 "FId_GEVCtlVlvLftEnaIntk" 656 "FId_GEVCtlVlvOpenClsdIntkB1" 657 "FId_GEVlvLockPinDiagIntkB1" 658 "FId_GEVlvPhaDiagEnaCsersIntkB1" 659 "FId_GEVlvPhaDiagEnaIntkB1" 660 "FId_GEVlvPhaPsIntkB1" 661 "FId_GbxAnNeutPosnErr" 662 "FId_GbxCANDigPlausErr" 663 "FId_GbxCANNeutSigErr" 664 "FId_GbxPNPosSig" 665 "FId_GbxPNPosnComErr" 666 "FId_GbxPNPosnDiagDrvCdnRels" 667 "FId_GbxPNPosnDiagDrvCodnHealRels" 668 "FId_GbxPNPosnDiagPlausyRels" 669 "FId_GbxPNPosnSubsVal" 670 "FId_GbxRvsSwtStk" 671 "FId_GbxSnsrSplyUErr" 672 "FId_GbxSpstReqOk" 673 "FId_GlbDaLSumvXPtd" 674 "FId_GslThrVlvSnsrDiagB1" 675 "FId_HEGOS2B1DElec" 676 "FId_HEGOS2B1DHtg" 677 "FId_HEGOS2B1Htg" 678 "FId_HEGOS2B1HtrPsSt" 679 "FId_HEGOS2B1InVld" 680 "FId_HEGOS2B1LSPsDiaDi" 681 "FId_HLSDemBrkFlt" 682 "FId_HLSDemErr1" 683 "FId_HLSDemErr2" 684 "FId_HLSDemIntkAirTemp" 685 "FId_HLSDemMotTemp" 686 "FId_HLSDemMstCyldpVld" 687 "FId_HLSDemSpdClthGearAccrSigErr" 688 "FId_HLSDem_DrvOffSuprt" 689 "FId_HLSDem_DrvOffSuprtBrkHldSys" 690 "FId_HLSDem_DrvOffSuprtLAS" 691 "FId_HLSDem_PModeActv" 692 "FId_HLSDem_TModeActv" 693 "FId_HLSDem_TraSubFcn" 694 "FId_HLSDem_nMaxLimErr1" 695 "FId_HLSDem_nMaxLimErr2" 696 "FId_HLSDem_nMaxLimErr3" 697 "FId_HLSDem_nMaxVErr" 698 "FId_I14229APP" 699 "FId_I14229CANErr" 700 "FId_I14229FlLvlFltComErr" 701 "FId_I14229VTCErr" 702 "FId_IMGISABComErr" 703 "FId_InhbLamDynS1B1" 704 "FId_InhbnBlkdLineDiag" 705 "FId_InhibitAlways" 706 "FId_InhibitNever" 707 "FId_InjSysMulInjDiagErr" 708 "FId_InjVlvPs_Bank1OnlyErr" 709 "FId_InjVlvPs_Bank1Tested" 710 "FId_InjVlvPs_Bank2OnlyErr" 711 "FId_InjVlvPs_Bank2Tested" 712 "FId_InjVlvPs_Bank3OnlyErr" 713 "FId_InjVlvPs_Bank3Tested" 714 "FId_IntkAirTAirFltDsCrssChk" 715 "FId_IntkAirTAirFltDsPlausChk" 716 "FId_IntkAirTIntkMnfldCrssChk" 717 "FId_IntkAirTIntkMnfldPlausChk" 718 "FId_IntkAirTIntkMnfldRepl" 719 "FId_IntkAirTSnsr1Elec" 720 "FId_IntkAirTSnsr1PRC" 721 "FId_IntkAirTSnsr1Sum" 722 "FId_IntkAirTSnsr2Elec" 723 "FId_IntkAirTSnsr2PRC" 724 "FId_IntkAirTSnsr2Sum" 725 "FId_IntkArTempENGB" 726 "FId_LIGovDfrstI" 727 "FId_LIGovUndrBrk" 728 "FId_LINDCDCRxErr" 729 "FId_LLimAppSnsrErr" 730 "FId_LLimAppSnsrSyncErr" 731 "FId_LLimMTVehSpdSnsrErr" 732 "FId_LLimShutOffEng" 733 "FId_LRSEBMisf" 734 "FId_LZSR" 735 "FId_LeakToMnfld" 736 "FId_LeakToMnfldTstd" 737 "FId_LimpHomPsErrInjtr" 738 "FId_LinACGUnitCfmdErr" 739 "FId_LinACGUnitNotTstd" 740 "FId_LinAEVUnitCfmdErr" 741 "FId_LinAEVUnitNotTstd" 742 "FId_LinEBSUnitCfmdErr" 743 "FId_LinEBSUnitNotTstd" 744 "FId_LowPresOilP" 745 "FId_MFlowAirCrkcsSubVal" 746 "FId_MFuOilMax" 747 "FId_MaiLoadSnsr" 748 "FId_MaiShaftFailr" 749 "FId_MfPsDia1" 750 "FId_MisfDetDnAdpn" 751 "FId_MisfDetDnAdpnPlaus" 752 "FId_MisfDetEnvP" 753 "FId_MisfDetSegTiAdpnFco" 754 "FId_MisfDetShtrpAct" 755 "FId_MisfDetStc" 756 "FId_MisfDetV" 757 "FId_MisfDetVWhlFrntLe" 758 "FId_MisfDetVWhlFrntRi" 759 "FId_MisfDetVWhlReLe" 760 "FId_MisfDetVWhlReRi" 761 "FId_NLimVehHalt" 762 "FId_NSHTDAmbT" 763 "FId_NSHTDEngT" 764 "FId_NSHTILimHiAltiLoIdleSp" 765 "FId_NeutPosnFailr" 766 "FId_O2StorgMdlMD" 767 "FId_OilCmbdSen_LvlDfctHW" 768 "FId_OilPCtrlVlvNpl" 769 "FId_OilPFrzVal" 770 "FId_OilPPlaus" 771 "FId_OilPPlausAftRun" 772 "FId_OilPPlausMax" 773 "FId_OilPPlausMin" 774 "FId_OilPPlausT15" 775 "FId_OilPRplVal" 776 "FId_OilPSnsrErr" 777 "FId_OilPSwmpSRC" 778 "FId_OilSwmpTCEngDsTWrmUp" 779 "FId_OilSwmpT_B_tospg" 780 "FId_OilSwmpT_B_tospgg" 781 "FId_OilSwmpT_CmbdSnsrErr" 782 "FId_OilSwmpT_CmbdSnsrTiTErr" 783 "FId_OilSwmpT_EnvT" 784 "FId_OilSwmpT_TSnsrErr" 785 "FId_PEnvMeasVld" 786 "FId_PEnvModel" 787 "FId_PEnvPlausDiagVDD" 788 "FId_PEnvRawVldVDD" 789 "FId_PEnvRefSnsr" 790 "FId_PEnvSigRngVld" 791 "FId_PEnvSnsrPlausVDD" 792 "FId_PEnvVldVDD" 793 "FId_PIDA6SigSrcErr" 794 "FId_PIntkMnfldPlaus" 795 "FId_PIntkVUsElecDiagB1" 796 "FId_PSPCtlDisbl" 797 "FId_PSPCtlIntkAirVapLock" 798 "FId_PSPCtlPreRun" 799 "FId_PSPCtlVapLock" 800 "FId_PSPDiagDisbl" 801 "FId_PTGripConv" 802 "FId_PTGripConvStrt" 803 "FId_PTGripMnlClth" 804 "FId_PTGripMnlClthStrt" 805 "FId_PTTrqRatCANPtd" 806 "FId_PThrVlVUsVldB1" 807 "FId_PThrVlvUsMeasdVldB1" 808 "FId_P_VSE11_Diag" 809 "FId_PrmId03_FltRdnS1B1" 810 "FId_PrmId03_FltUegoS1B1" 811 "FId_RevLck" 812 "FId_RstAdpnPIntkMnfldAfs" 813 "FId_RvsPosnFailr" 814 "FId_SSEEPBRelease" 815 "FId_SSEFCANPRelease" 816 "FId_SSEPTCANPRelease" 817 "FId_SSEStartRelease" 818 "FId_SSEStartReleaseMTCl10" 819 "FId_SSEStartReleaseMTCl100" 820 "FId_SSEStartReleaseMTCl20" 821 "FId_SSEStartReleaseMTCl90" 822 "FId_SSEStartRequest" 823 "FId_SSEStopRelease" 824 "FId_SSEStrtStopRelease" 825 "FId_SSESysOff" 826 "FId_SSEUI2DCSysFailr" 827 "FId_SSEUIBCANErr" 828 "FId_SSEUISysFail" 829 "FId_SiaEEPErr" 830 "FId_SnglWhlErrDiagEna" 831 "FId_StrtCtlAutoCrkModeCdn" 832 "FId_StrtCtlComEngStrtErr" 833 "FId_StrtCtlNPCdnCncl" 834 "FId_StrtCtlNoCpuFailr" 835 "FId_StrtCtlNoFailCanLine" 836 "FId_StrtCtlNoFailPTCanLine" 837 "FId_StrtCtlPNPosnSubsVal" 838 "FId_StrtCtlSTMFailr" 839 "FId_StrtErrShaft" 840 "FId_SumErrHndlg" 841 "FId_SysDiagComErr" 842 "FId_SysDiagModInhbErr" 843 "FId_TOSPM" 844 "FId_TWCCILck" 845 "FId_TWCCILckExtd" 846 "FId_TWCCIRstB1" 847 "FId_TWCCIRstDSMClearB1" 848 "FId_TWCCLsuB1" 849 "FId_TWCCLsuCyc" 850 "FId_TWCCLsuDynB1" 851 "FId_TWCCMisfDetn" 852 "FId_TWCDPriCatParB1" 853 "FId_TWCDPriCatVldnB1" 854 "FId_TankPCpv1DteskLoLoadStuckClsd" 855 "FId_TankPCpv1DteskLoLoadStuckOpen" 856 "FId_TankPSnsrElecChkVld" 857 "FId_ThrVlvMon" 858 "FId_ThrVlvOffsLrnPrmsB1" 859 "FId_TiOffTBasdChkFast" 860 "FId_TiOffTBasdChkSlow" 861 "FId_TiOffVdClk" 862 "FId_TqDecelOffsInhb" 863 "FId_TraAddAirCANPtd" 864 "FId_TraAddClntCANPtd" 865 "FId_TraFwdRvsCluInfo" 866 "FId_TraGbxNPos" 867 "FId_TraGearInfoCanCom" 868 "FId_TraGearInfoDet" 869 "FId_TraGearInfoGearShftActv" 870 "FId_TraGearInfoInfoCan" 871 "FId_TraGearInfoLevPos" 872 "FId_TraGearInfoLoRng" 873 "FId_TraGearInfoRTra" 874 "FId_TraGearInfoRevGear" 875 "FId_TraGearReq" 876 "FId_TraNoShftIdctr" 877 "FId_TraPrtGearCANPtd" 878 "FId_TraPrtGearIndpdtProblem" 879 "FId_TraRPosn" 880 "FId_TraRtnIntfcASTIntv" 881 "FId_TraRtnIntfcIdlSetP" 882 "FId_TraRtnIntfcNMaxCan" 883 "FId_TraRtnIntfcNMaxVel" 884 "FId_TraTrqRedLmpHmeDec" 885 "FId_TraTrqRedLmpHmeInc" 886 "FId_TraTrqRedPTCanErr" 887 "FId_TraTrqRedTIIntvDes" 888 "FId_TraTrqRedTIIntvLead" 889 "FId_TraTrqRedTSCIntvDes" 890 "FId_TraTrqRedTSCIntvLead" 891 "FId_TraTrsmTypHw" 892 "FId_TranIdleDes" 893 "FId_UEGOHeatgUpRglS1B1" 894 "FId_UEGOHeatrCtrlS1B1" 895 "FId_UEGOHeatrPrfmncDiagRelsS1B1" 896 "FId_UEGOHeatrPwrStgDiagRelsS1B1" 897 "FId_UEGOModCtrlRelsS1B1" 898 "FId_UEGOStrtDiagInhRprtErrS1B1" 899 "FId_UEGOStrtDiagRelsS1B1" 900 "FId_UEGOTCeramicRelsS1B1" 901 "FId_UegoDiagRelsBattSplyOk" 902 "FId_UegoDiagSigEcuAsicS1B1" 903 "FId_UegoDiagSigEcuComS1B1" 904 "FId_UegoDiagSigOperPlausS1B1" 905 "FId_UegoDiagSigSnsrS1B1" 906 "FId_UegoDiagSigWireOlS1B1" 907 "FId_UegoDiagSigWireScS1B1" 908 "FId_UegoDiagSigWireScTstdS1B1" 909 "FId_UegoInhbOperRelsS1B1" 910 "FId_UegoO2HiPrcsnS1B1" 911 "FId_UegoO2PlausErrS1B1" 912 "FId_UegoO2VldS1B1" 913 "FId_UegoOperPlausBattSplyOk" 914 "FId_UegoPlausErrHndlg" 915 "FId_VMSIDCSRmpShOff" 916 "FId_VMSIDCSShOff" 917 "FId_VMSITCSRmpShOff" 918 "FId_VMSITCSShOff" 919 "FId_VSACANErr" 920 "FId_VehStcACGFailr" 921 "FId_VehStcBattMngFailr" 922 "FId_VehStcDCDCFailr" 923 "FId_VehStcEBSFailr" 924 "FId_VehStcMisf" 925 "FId_VehStcMtrComFailr" 926 "FId_VehStcNVMFailr" 927 "FId_VehVCANFrzVal" 928 "FId_VehVCANReplVal" 929 "FId_VehVCanSafeFrzVal" 930 "FId_VehVCanSafeReplVal" 931 "FId_VehVCom" 932 "FId_VehVExcdLim" 933 "FId_VehVFrzVal" 934 "FId_VehVNCSnsrElecFailr" 935 "FId_VehVOBDFrzVal" 936 "FId_VehVOBDReplVal" 937 "FId_VehVOutCanErr" 938 "FId_VehVPWMFrzVal" 939 "FId_VehVPWMReplVal" 940 "FId_VehVPhysRng" 941 "FId_VehVPlaus" 942 "FId_VehVPlausCan" 943 "FId_VehVPlausFco" 944 "FId_VehVPlausPwr" 945 "FId_VehVPlausV2N" 946 "FId_VehVReplVal" 947 "FId_VehVSigCan" 948 "FId_VehVSigCanSafe" 949 "FId_VehVSngWhlCanFrzVal" 950 "FId_VehVSngWhlCanReplVal" 951 "FId_VehVSnsrARngHi" 952 "FId_VehVSnsrBRngHi" 953 "FId_VehVSpdRtyDiag" 954 "FId_VehVSpdSnsrAElecFailr" 955 "FId_VehVSpdSnsrBElecFailr" 956 "FId_VehVvFLWhlSpd" 957 "FId_VehVvFRWhlSpd" 958 "FId_VehVvRLWhlSpd" 959 "FId_VehVvRRWhlSpd" 960 "FId_VldtLamDynS1B1" 961 "FId_VlvLftFbIntkOilPSnsr11SRC" 962 "FId_VlvLftFbSwtIntk11Diag" 963 "FId_ZGLZSR" 964 "FId_airIntkFltSnsrKnkPrtnIgn" 965 "FId_ctrladpncvo" 966 "FId_stChkChgnSys" 967 "FId_stChkChgnSys2DC" 968 "FId_tFltSnsrKnkPrtnIgn" DEFAULT_VALUE "---" /end COMPU_VTAB
/begin COMPU_METHOD DINH_LimDFCVerb "" TAB_VERB "%6.3" "-" COMPU_TAB_REF DINH_LimDFCVerb /end COMPU_METHOD
/begin COMPU_VTAB DINH_LimDFCVerb "" TAB_VERB 18 0 "No_Inhibit" 1 "Def50_Deb100" 2 "Def100_Deb100" 3 "Def50_Deb100_Tst" 4 "Def100_Deb100_Tst" 5 "Def50_Deb100_or_NTst" 6 "Def100_Deb100_or_NTst" 7 "Tested" 8 "NotTested" 9 "Def100_Deb0" 10 "Def50_Deb0" 11 "Def25_Deb0" 12 "Def0_Deb0" 13 "Def50_Deb100_Tst_Trip" 14 "Def100_Deb100_Tst_Trip" 15 "Def50_Deb100_MILOn" 16 "Def50_Deb100_Trip" 17 "Def100_Deb100_Trip" /end COMPU_VTAB
/begin RECORD_LAYOUT ValA_Wu16 FNC_VALUES 1 UWORD COLUMN_DIR DIRECT /end RECORD_LAYOUT
/begin RECORD_LAYOUT ValA_Wu8 FNC_VALUES 1 UBYTE COLUMN_DIR DIRECT /end RECORD_LAYOUT
/end MODULE
/end PROJECT
