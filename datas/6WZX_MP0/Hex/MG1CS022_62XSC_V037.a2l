ASAP2_VERSION 1 60
/begin PROJECT MG1CS022 "MG1CS022"
/begin HEADER "" VERSION "MG1CS022_62XSC_V037" PROJECT_NO MG1CS022 /end HEADER
/begin MODULE DIM ""
/begin MOD_COMMON "" BYTE_ORDER MSB_LAST ALIGNMENT_BYTE 1 ALIGNMENT_WORD 2 ALIGNMENT_LONG 4 ALIGNMENT_INT64 4 ALIGNMENT_FLOAT32_IEEE 4 ALIGNMENT_FLOAT64_IEEE 4 DATA_SIZE 32 /end MOD_COMMON
/begin CHARACTERISTIC MoFAirFl_cntrErrDebMaxFilgPrdc_C "Max. allowed error debounce time in function MoFAir_FilgPrdc" VALUE 0x80591BBA Val_Wu8 255.0 OneToOne 0.00 255.0 FORMAT "%5.1" /end CHARACTERISTIC
/begin CHARACTERISTIC MoFAirFl_cntrErrDebMaxMode_C "Max. allowed error debounce time in function MoFAirFl_Mode" VALUE 0x80591BB6 Val_Wu8 255.0 OneToOne 0.00 255.0 FORMAT "%5.1" /end CHARACTERISTIC
/begin CHARACTERISTIC MoFAirFl_cntrFillgHiDeDlyMax_C "Max. allowed counter for high deviation of charge in function monitoring" VALUE 0x80591BBB Val_Wu8 255.0 OneToOne 0.00 255.0 FORMAT "%5.1" /end CHARACTERISTIC
/begin CHARACTERISTIC MoFAirFl_cntrRstMaxFilgPrdc_C "Maximum number of Pre-ICO-Resets in function MoFAirFl_FilgPrdc" VALUE 0x80591BBC Val_Wu8 255.0 OneToOne 0.00 255.0 FORMAT "%5.1" /end CHARACTERISTIC
/begin CHARACTERISTIC MoFAirFl_cntrRstMaxMode_C "Maximum number of Pre-ICO-Resets in function MoFAirFl_Mode" VALUE 0x80591BB7 Val_Wu8 255.0 OneToOne 0.00 255.0 FORMAT "%5.1" /end CHARACTERISTIC
/begin CHARACTERISTIC MoFAirFl_facCnvnRatFillgMFlow_C "Factor conversion charge into mass flow in function monitoring" VALUE 0x80591BBD Val_Wu8 0.003984 q1p5625Em5_kg_DIV_h_min_pc 0.00 0.003984 FORMAT "%8.6" /end CHARACTERISTIC
/begin CHARACTERISTIC MoFAirFl_nErrHndlgActvnFilgPrdc_C "Engine speed threshold for activation of error handling in function MoFAir_FilgPrdc" VALUE 0x80591BBE Val_Wu8 10200. nmot_q40 0.00 10200. FORMAT "%5.0" /end CHARACTERISTIC
/begin CHARACTERISTIC MoFAirFl_nErrHndlgActvnMode_C "Engine speed threshold for activation of error handling in function MoFAirFl_Mode" VALUE 0x80591BB8 Val_Wu8 10200. nmot_q40 0.00 10200. FORMAT "%5.0" /end CHARACTERISTIC
/begin CHARACTERISTIC MoFAirFl_ofsRatFillgPrdc_C "Offset in check of predicted air charge in function monitoring" VALUE 0x80591BBF Val_Wu8 191.3 rel_ub_q0p75 0.00 191.3 FORMAT "%5.1" /end CHARACTERISTIC
/begin CHARACTERISTIC MoFAirFl_ratLamExpdMaxStoi_C "Max. lambda in homogeneous operation in function monitoring" VALUE 0x805952B2 Val_Wu16 15.99976 fak_uw_b16 0.00 15.99976 FORMAT "%8.5" /end CHARACTERISTIC
/begin CHARACTERISTIC MoFAirFl_ratLamExpdMinStoi_C "Min. lambda in homogeneous operation in function monitoring" VALUE 0x805952B4 Val_Wu16 15.99976 fak_uw_b16 0.00 15.99976 FORMAT "%8.5" /end CHARACTERISTIC
/begin CHARACTERISTIC MoFAirFl_ratLamMaxMFlow_C "Max. lambda for calculation of mass flow in function monitoring" VALUE 0x805952B6 Val_Wu16 15.99951 fak_q0p000244 0.00024 15.99976 FORMAT "%8.5" EXTENDED_LIMITS 0.00 15.99976 /end CHARACTERISTIC
/begin CHARACTERISTIC MoFAirFl_ratLamMinMFlow_C "Min. lambda for calculation of mass flow in function monitoring" VALUE 0x805952B8 Val_Wu16 15.99951 fak_q0p000244 0.00024 15.99976 FORMAT "%8.5" EXTENDED_LIMITS 0.00 15.99976 /end CHARACTERISTIC
/begin CHARACTERISTIC MoFAPP_cntrDeb_C "Error time for pedal signals which are implausible to each other during the monitoring" VALUE 0x80591B2C Val_Wu8 255.0 OneToOne 0.00 255.0 FORMAT "%5.1" /end CHARACTERISTIC
/begin CHARACTERISTIC MoFAPP_cntrRst_C "Number of permissible resets in case of plausibility error between the two APP sensors" VALUE 0x80591B2D Val_Wu8 255.0 OneToOne 0.00 255.0 FORMAT "%5.1" /end CHARACTERISTIC
/begin CHARACTERISTIC MoFAPP_cntrTestAPP_C "Counter limit for setting test flag in diagnosis MoFAPP in function monitoring" VALUE 0x805962C4 Val_Wu8 255.0 OneToOne 0.00 255.0 FORMAT "%5.1" /end CHARACTERISTIC
/begin AXIS_PTS MoFAPP_ratApp_DST "Accelerator pedal position distribution in function monitoring" 0x80591B30 MoF_rAPP Axis_Xu8 99.61 rel_q0p39 8 0.00 99.61 FORMAT "%5.2" DEPOSIT ABSOLUTE /end AXIS_PTS
/begin AXIS_PTS MoFAPP_ratHiResl_DST "Distribution for relative high resolution pedal position in monitoring" 0x80592126 MoFAPP_ratHiResl Axis_Xu16 1599.976 relPED_q0p02441 8 0.00 1599.976 FORMAT "%8.3" DEPOSIT ABSOLUTE /end AXIS_PTS
/begin CHARACTERISTIC MoFAPP_swtMinSel_C "Switch to enable Minimum value selection between APP1 and APP2" VALUE 0x80591B2E Val_Wu8 1.00000000000 B_TRUE 0.00 1.00000000000 FORMAT "%13.11" /end CHARACTERISTIC
/begin CHARACTERISTIC MoFAPP_uFL_C "Full throttle- set value- threshold" VALUE 0x8059211E Val_Wu16 319.9951 spg_q0p00488 0.00 319.9951 FORMAT "%8.4" /end CHARACTERISTIC
/begin CHARACTERISTIC MoFAPP_uHiReslMaxLimp_C "maximum App voltage threshold in case of Limp home mode in function monitoring" VALUE 0x80592138 Val_Wu16 319.9951 spg_q0p00488 0.00 319.9951 FORMAT "%8.4" /end CHARACTERISTIC
/begin CHARACTERISTIC MoFAPP_uHiReslMax_C "maximal value of driving pedal signal in the function monitoring" VALUE 0x8059213A Val_Wu16 319.9951 spg_q0p00488 0.00 319.9951 FORMAT "%8.4" /end CHARACTERISTIC
/begin CHARACTERISTIC MoFAPP_uHiReslMinLimp_C "Minimum App voltage threshold in case of Limp home mode in function monitoring" VALUE 0x8059213C Val_Wu16 319.9951 spg_q0p00488 0.00 319.9951 FORMAT "%8.4" /end CHARACTERISTIC
/begin CHARACTERISTIC MoFAPP_uHiReslMin_C "minimal value of driving pedal signal in the function monitoring" VALUE 0x8059213E Val_Wu16 319.9951 spg_q0p00488 0.00 319.9951 FORMAT "%8.4" /end CHARACTERISTIC
/begin CHARACTERISTIC MoFAPP_uLoLim_C "Lower threshold of the APP voltages for plausibility test" VALUE 0x80592120 Val_Wu16 319.9951 spg_q0p00488 0.00 319.9951 FORMAT "%8.4" /end CHARACTERISTIC
/begin CHARACTERISTIC MoFAPP_uMaxDiffFL_C "Maximum permitted difference between the accelerator pedal signals above the full throttle threshold" VALUE 0x80592122 Val_Wu16 319.9951 spg_q0p00488 0.00 319.9951 FORMAT "%8.4" /end CHARACTERISTIC
/begin CHARACTERISTIC MoFAPP_uMaxDiffPL_C "Maximum permitted difference between the accelerator pedal signals beneath full throttle threshold" VALUE 0x80592124 Val_Wu16 319.9951 spg_q0p00488 0.00 319.9951 FORMAT "%8.4" /end CHARACTERISTIC
/begin CHARACTERISTIC MoFBrk_cntrBrkAcc_C "Debounce time for the brake signal for ACC deactivation in function monitoring" VALUE 0x80591BC0 Val_Wu8 255.0 OneToOne 0.00 255.0 FORMAT "%5.1" /end CHARACTERISTIC
/begin CHARACTERISTIC MoFBrk_cntrBrkApp_C "Debounce time for the brake signal for APP limp-home-mode in function monitoring" VALUE 0x80591BC1 Val_Wu8 255.0 OneToOne 0.00 255.0 FORMAT "%5.1" /end CHARACTERISTIC
/begin CHARACTERISTIC MoFBrk_cntrBrkCrsCtrl_C "Debounce time for the brake signal for cruise control deactivation in function monitoring" VALUE 0x80591BC2 Val_Wu8 255.0 OneToOne 0.00 255.0 FORMAT "%5.1" /end CHARACTERISTIC
/begin CHARACTERISTIC MoFBrk_cntrBrkMai_C "Debounce time for main brake signal in function monitoring" VALUE 0x80591BC3 Val_Wu8 255.0 OneToOne 0.00 255.0 FORMAT "%5.1" /end CHARACTERISTIC
/begin CHARACTERISTIC MoFBrk_cntrBrkRdnt_C "Debounce time for redundant brake signal in function monitoring" VALUE 0x80591BC4 Val_Wu8 255.0 OneToOne 0.00 255.0 FORMAT "%5.1" /end CHARACTERISTIC
/begin CHARACTERISTIC MoFBrk_flgEnaFrmEBBA_C "Flag to enable EBBA CAN frame in level2" VALUE 0x80591BC5 Val_Wu8 1.000 OneToOne 0.00 1.000 FORMAT "%5.3" EXTENDED_LIMITS 0.00 255.0 /end CHARACTERISTIC
/begin CHARACTERISTIC MoFCCtl_cntrCrsCtrlActvDeb_C "Maximum Threshold for Cruise Control Active Debounce" VALUE 0x80591BC6 Val_Wu8 255.0 OneToOne 0.00 255.0 FORMAT "%5.1" /end CHARACTERISTIC
/begin CHARACTERISTIC MoFCCtl_ratAppPsd_C "Accelerator pedal ratio above which LSF is permitted by Level 2" VALUE 0x805952BA Val_Wu16 1599.976 relPED_q0p02441 0.00 1599.976 FORMAT "%8.3" /end CHARACTERISTIC
/begin CHARACTERISTIC MoFCCtl_swtEnaAppPsd_C "Switch to enable LSF activation by Accelerator Pedal press" VALUE 0x80591BC7 Val_Wu8 255.0 OneToOne 0.00 255.0 FORMAT "%5.1" /end CHARACTERISTIC
/begin CHARACTERISTIC MoFCCtl_swtEnblMon_C "Bit to enable different function in cruise control monitoring" VALUE 0x80591BC8 Val_Wu8 255.0 OneToOne 0.00 255.0 FORMAT "%5.1" /end CHARACTERISTIC
/begin CHARACTERISTIC MoFClth_cntrBotmCluTurnOffDly_C "debounce time for detecting 90 percent clutch released" VALUE 0x80591BCA Val_Wu8 255.0 OneToOne 0.00 255.0 FORMAT "%5.1" /end CHARACTERISTIC
/begin CHARACTERISTIC MoFClth_cntrBotmCluTurnOnDly_C "debounce time for detecting 90 percent clutch pressed" VALUE 0x80591BCB Val_Wu8 255.0 OneToOne 0.00 255.0 FORMAT "%5.1" /end CHARACTERISTIC
/begin CHARACTERISTIC MoFClth_cntrT15OnDeb_C "Debounce time since kl15 after which the evaluation" VALUE 0x80591BCC Val_Wu8 255.0 OneToOne 0.00 255.0 FORMAT "%5.1" /end CHARACTERISTIC
/begin CHARACTERISTIC MoFClth_cntrTopCluTurnOffDly_C "debounce time for detecting 10 percent clutch released" VALUE 0x80591BCD Val_Wu8 255.0 OneToOne 0.00 255.0 FORMAT "%5.1" /end CHARACTERISTIC
/begin CHARACTERISTIC MoFClth_cntrTopCluTurnOnDly_C "debounce time for detecting 10 percent clutch pressed" VALUE 0x80591BCE Val_Wu8 255.0 OneToOne 0.00 255.0 FORMAT "%5.1" /end CHARACTERISTIC
/begin CHARACTERISTIC MoFClth_flgSwt_C "Calibration switch for Clutch signal selection" VALUE 0x80591BCF Val_Wu8 1.000 OneToOne 0.00 1.000 FORMAT "%5.3" EXTENDED_LIMITS 0.00 255.0 /end CHARACTERISTIC
/begin CHARACTERISTIC MoFDCS_cntrDebDCSDeactv_C "Threshold for DCS deactivation counter" VALUE 0x80591BD2 Val_Wu8 255.0 OneToOne 0.00 255.0 FORMAT "%5.1" /end CHARACTERISTIC
/begin CHARACTERISTIC MoFDCS_cntrStbErrDeb_C "debounce-threshold stabilizer unit error" VALUE 0x80591BD3 Val_Wu8 255.0 OneToOne 0.00 255.0 FORMAT "%5.1" /end CHARACTERISTIC
/begin CHARACTERISTIC MoFDCS_rTqBoostMinLim_C "Minimum Boost Ratio Value" VALUE 0x805952E6 Val_Wu16 655.3500 TransR 0.00 655.3500 FORMAT "%8.4" /end CHARACTERISTIC
/begin CHARACTERISTIC MoFDCS_tqLimDCSNorm_C "Maximum Torque Permissible" VALUE 0x805952E8 Val_Ws16 6553.500 Mo_trq_nm_q0p1 -3276.800 3276.700 FORMAT "%8.3" /end CHARACTERISTIC
/begin CHARACTERISTIC MoFDCS_tqLimDCSPlus_C "Maximum Torque Permissible when DCS Plus is Set" VALUE 0x805952EA Val_Ws16 6553.500 Mo_trq_nm_q0p1 -3276.800 3276.700 FORMAT "%8.3" /end CHARACTERISTIC
/begin CHARACTERISTIC MoFDrAs_cntrACC_C "delay time for Turn on Delay ACC" VALUE 0x80591BD4 Val_Wu8 255.0 OneToOne 0.00 255.0 FORMAT "%5.1" /end CHARACTERISTIC
/begin CHARACTERISTIC MoFDrAs_cntrCrsCtrl_C "delay time for Turn on Delay cruise control" VALUE 0x80591BD5 Val_Wu8 255.0 OneToOne 0.00 255.0 FORMAT "%5.1" /end CHARACTERISTIC
/begin CHARACTERISTIC MoFDrAs_swtEBB_C "Switch to read driver brake pressed information from EBB" VALUE 0x80591BD6 Val_Wu8 1.00000000000 B_TRUE 0.00 1.00000000000 FORMAT "%13.11" /end CHARACTERISTIC
/begin CHARACTERISTIC MoFDrAs_vACCMin_C "Comparative value minimum speed ACC" VALUE 0x805952EC Val_Ws16 655.3500 vfzg_q0p01 -327.6800 327.6700 FORMAT "%8.4" /end CHARACTERISTIC
/begin CHARACTERISTIC MoFDrAs_vCrsCtrlMin_C "vehicle speed threshold for cruise control activation in the function monitoring" VALUE 0x805952EE Val_Ws16 655.3500 vfzg_q0p01 -327.6800 327.6700 FORMAT "%8.4" /end CHARACTERISTIC
/begin CHARACTERISTIC MoFDrDem_dfacRampDwn_M "Rate of change of torque during ramp down in function monitoring" MAP 0x805952F0 Map_Xs16Ys16Ws16 1.000000 Fact1000 0.00 1.000000 FORMAT "%8.6" EXTENDED_LIMITS -32.76800 32.76700
 /begin AXIS_DESCR STD_AXIS MoFESpd_nEng nmot_q40 8 0.00 10200.00 FORMAT "%8.2" EXTENDED_LIMITS -1310720. 1310680. DEPOSIT ABSOLUTE /end AXIS_DESCR
 /begin AXIS_DESCR STD_AXIS MoF_rAPP rel_q0p39 8 0.00 99.60938 FORMAT "%8.5" EXTENDED_LIMITS -12800.00 12799.61 DEPOSIT ABSOLUTE /end AXIS_DESCR
/end CHARACTERISTIC
/begin CHARACTERISTIC MoFDrDem_dfacRampUp_M "Rate of change of torque during ramp up in function monitoring" MAP 0x80595394 Map_Xs16Ys16Ws16 1.000000 Fact1000 0.00 1.000000 FORMAT "%8.6" EXTENDED_LIMITS -32.76800 32.76700
 /begin AXIS_DESCR STD_AXIS MoFESpd_nEng nmot_q40 8 0.00 10200.00 FORMAT "%8.2" EXTENDED_LIMITS -1310720. 1310680. DEPOSIT ABSOLUTE /end AXIS_DESCR
 /begin AXIS_DESCR STD_AXIS MoF_rAPP rel_q0p39 8 0.00 99.60938 FORMAT "%8.5" EXTENDED_LIMITS -12800.00 12799.61 DEPOSIT ABSOLUTE /end AXIS_DESCR
/end CHARACTERISTIC
/begin CHARACTERISTIC MoFDrDem_dfacSptOff_M "Delta multiplication factor for turning off sports mode" MAP 0x80595438 Map_Xs16Ys16Ws16 2.000000 Fact1000 -1.000000 1.000000 FORMAT "%8.6" EXTENDED_LIMITS -32.76800 32.76700
 /begin AXIS_DESCR STD_AXIS MoFESpd_nEng nmot_q40 8 0.00 10200.00 FORMAT "%8.2" EXTENDED_LIMITS -1310720. 1310680. DEPOSIT ABSOLUTE /end AXIS_DESCR
 /begin AXIS_DESCR STD_AXIS MoF_rAPP rel_q0p39 8 0.00 99.60938 FORMAT "%8.5" EXTENDED_LIMITS -12800.00 12799.61 DEPOSIT ABSOLUTE /end AXIS_DESCR
/end CHARACTERISTIC
/begin CHARACTERISTIC MoFDrDem_dfacSptOn_M "Delta multiplication factor for turning on sports mode" MAP 0x805954DC Map_Xs16Ys16Ws16 2.000000 Fact1000 -1.000000 1.000000 FORMAT "%8.6" EXTENDED_LIMITS -32.76800 32.76700
 /begin AXIS_DESCR STD_AXIS MoFESpd_nEng nmot_q40 8 0.00 10200.00 FORMAT "%8.2" EXTENDED_LIMITS -1310720. 1310680. DEPOSIT ABSOLUTE /end AXIS_DESCR
 /begin AXIS_DESCR STD_AXIS MoF_rAPP rel_q0p39 8 0.00 99.60938 FORMAT "%8.5" EXTENDED_LIMITS -12800.00 12799.61 DEPOSIT ABSOLUTE /end AXIS_DESCR
/end CHARACTERISTIC
/begin CHARACTERISTIC MoFDrDem_stDrvModPrevSwt_C "Default Previous drive mode in function monitoring" VALUE 0x80591BD8 Val_Wu8 1.000 OneToOne 0.00 1.000 FORMAT "%5.3" EXTENDED_LIMITS 0.00 255.0 /end CHARACTERISTIC
/begin CHARACTERISTIC MoFDrDem_stDrvModSwt_C "Default drive mode in function monitoring" VALUE 0x80591BD9 Val_Wu8 1.000 OneToOne 0.00 1.000 FORMAT "%5.3" EXTENDED_LIMITS 0.00 255.0 /end CHARACTERISTIC
/begin CHARACTERISTIC MoFDrDem_swtDrvModSeln_C "Drive mode selection switch in function monitoring" VALUE 0x80591BDA Val_Wu8 1.000 OneToOne 0.00 1.000 FORMAT "%5.3" EXTENDED_LIMITS 0.00 255.0 /end CHARACTERISTIC
/begin CHARACTERISTIC MoFDrDem_tqEngEcoOrCmft_M "Accelerator pedal map in case of Eco or Comfort mode in function monitoring" MAP 0x80595580 Map_Xs16Ys16Ws16 6553.500 md_q0p1 -3276.800 3276.700 FORMAT "%8.3"
 /begin AXIS_DESCR STD_AXIS MoFESpd_nEng nmot_q40 8 0.00 10200.00 FORMAT "%8.2" EXTENDED_LIMITS -1310720. 1310680. DEPOSIT ABSOLUTE /end AXIS_DESCR
 /begin AXIS_DESCR STD_AXIS MoF_rAPP rel_q0p39 8 0.00 99.60938 FORMAT "%8.5" EXTENDED_LIMITS -12800.00 12799.61 DEPOSIT ABSOLUTE /end AXIS_DESCR
/end CHARACTERISTIC
/begin CHARACTERISTIC MoFDrDem_tqEngSnow_M "Accelerator pedal map in case of snow mode in function monitoring" MAP 0x80595624 Map_Xs16Ys16Ws16 6553.500 md_q0p1 -3276.800 3276.700 FORMAT "%8.3"
 /begin AXIS_DESCR STD_AXIS MoFESpd_nEng nmot_q40 8 0.00 10200.00 FORMAT "%8.2" EXTENDED_LIMITS -1310720. 1310680. DEPOSIT ABSOLUTE /end AXIS_DESCR
 /begin AXIS_DESCR STD_AXIS MoF_rAPP rel_q0p39 8 0.00 99.60938 FORMAT "%8.5" EXTENDED_LIMITS -12800.00 12799.61 DEPOSIT ABSOLUTE /end AXIS_DESCR
/end CHARACTERISTIC
/begin CHARACTERISTIC MoFDrDem_tqEngSpt_M "Accelerator pedal map in case of sports mode" MAP 0x805956C8 Map_Xs16Ys16Ws16 6553.500 md_q0p1 -3276.800 3276.700 FORMAT "%8.3"
 /begin AXIS_DESCR STD_AXIS MoFESpd_nEng nmot_q40 8 0.00 10200.00 FORMAT "%8.2" EXTENDED_LIMITS -1310720. 1310680. DEPOSIT ABSOLUTE /end AXIS_DESCR
 /begin AXIS_DESCR STD_AXIS MoF_rAPP rel_q0p39 8 0.00 99.60938 FORMAT "%8.5" EXTENDED_LIMITS -12800.00 12799.61 DEPOSIT ABSOLUTE /end AXIS_DESCR
/end CHARACTERISTIC
/begin CHARACTERISTIC MoFDrDem_tqMinWoRamp_C "Minimum torque difference for ramping of torque during drive mode change to be activated in function monitoring" VALUE 0x8059576C Val_Wu16 3276.700 md_q0p1 0.00 3276.700 FORMAT "%8.3" EXTENDED_LIMITS 0.00 6553.500 /end CHARACTERISTIC
/begin CHARACTERISTIC MoFDrvPrgSwt_stDrvModSel_CA "Selection drive mode for IDS" VAL_BLK 0x80591BE2 ValA_Wu8 255.0 OneToOne 0.00 255.0 FORMAT "%5.1" NUMBER 16 /end CHARACTERISTIC
/begin CHARACTERISTIC MoFDrvPrgSwt_swtDrvModSeln_C "switch to select between two drive and five drive mode" VALUE 0x80591BF2 Val_Wu8 255.0 OneToOne 0.00 255.0 FORMAT "%5.1" /end CHARACTERISTIC
/begin CHARACTERISTIC MoFDrvPrgSwt_swtEcoModMaskL1_C "Mask to compare with Level 1 drive mode status" VALUE 0x80591BF3 Val_Wu8 255.0 OneToOne 0.00 255.0 FORMAT "%5.1" /end CHARACTERISTIC
/begin CHARACTERISTIC MoFESpd_cntrDebMaxSeln_C "Limit for activation engine speed max selection in function monitoring" VALUE 0x80591BF4 Val_Wu8 255.0 OneToOne 0.00 255.0 FORMAT "%5.1" /end CHARACTERISTIC
/begin CHARACTERISTIC MoFESpd_cntrNoSyncDeb_C "maximum debounce time for synchro loss in function monitoring" VALUE 0x80591BF5 Val_Wu8 255.0 OneToOne 0.00 255.0 FORMAT "%5.1" /end CHARACTERISTIC
/begin CHARACTERISTIC MoFESpd_cntrTstDeb_C "counter limit for setting testflag in diagnosis MoFESpd in function monitoring" VALUE 0x805962C5 Val_Wu8 255.0 OneToOne 0.00 255.0 FORMAT "%5.1" /end CHARACTERISTIC
/begin CHARACTERISTIC MoFESpd_ctDeb_C "Error counter value for engine speed comparison during function monitoring" VALUE 0x80591BF6 Val_Wu8 255.0 OneToOne 0.00 255.0 FORMAT "%5.1" /end CHARACTERISTIC
/begin CHARACTERISTIC MoFESpd_ctRst_C "Number of permissible resets in case of error in engine speed comparison" VALUE 0x80591BF7 Val_Wu8 255.0 OneToOne 0.00 255.0 FORMAT "%5.1" /end CHARACTERISTIC
/begin CHARACTERISTIC MoFESpd_nDiffMaxHiResl_C "Permitted difference between calculated engine speeds in level 1 and level 2" VALUE 0x80595AAE Val_Ws16 16383.50 nmot_q0p5 0.00 16383.50 FORMAT "%8.2" EXTENDED_LIMITS -16384.00 16383.50 /end CHARACTERISTIC
/begin AXIS_PTS MoFESpd_nEng_Ax "Data point distribution for engine speed in engine speed monitoring" 0x80591BF8 MoFESpd_nEng Axis_Xu8 10200. nmot_q40 8 0.00 10200. FORMAT "%5.0" DEPOSIT ABSOLUTE /end AXIS_PTS
/begin CHARACTERISTIC MoFESpd_nMinHiResl_C "Minimum engine speed during engine speed monitoring" VALUE 0x80595AB0 Val_Ws16 16383.50 nmot_q0p5 0.00 16383.50 FORMAT "%8.2" EXTENDED_LIMITS -16384.00 16383.50 /end CHARACTERISTIC
/begin CHARACTERISTIC MoFESpd_tiGradNEngErrDeb_C "Maximum debounce time for recognized engine speed slope error in engine speed monitoring" VALUE 0x80591C01 Val_Wu8 2.540 t_q0p01 0.010 2.550 FORMAT "%5.3" EXTENDED_LIMITS 0.00 2.550 /end CHARACTERISTIC
/begin CHARACTERISTIC MoFETC_cntrCurRunTestReq_C "Debounce threshold of test request from level 1 for engine test" VALUE 0x80591C0C Val_Wu8 255.0 OneToOne 0.00 255.0 FORMAT "%5.1" /end CHARACTERISTIC
/begin CHARACTERISTIC MoFETC_cntrTestIdleUpTOffDly_C "High Idle engine speed tester request turn off delay threshold" VALUE 0x80591C0D Val_Wu8 255.0 OneToOne 0.00 255.0 FORMAT "%5.1" /end CHARACTERISTIC
/begin CHARACTERISTIC MoFETC_cntrTestIdleUp_C "Maximum permissible duration of High Idle engine speed tester request threshold" VALUE 0x80592100 Val_Wu32 4294967295.00 OneToOne 0.00 4294967295.00 FORMAT "%13.2" /end CHARACTERISTIC
/begin CHARACTERISTIC MoFETC_cntrTestTOffDly_C "Debounce threshold for reset of the diagnosis state for engine test" VALUE 0x80591C0E Val_Wu8 255.0 OneToOne 0.00 255.0 FORMAT "%5.1" /end CHARACTERISTIC
/begin CHARACTERISTIC MoFETC_cntrTest_C "Maximum threshold to determine if the engine test active has elapsed for a Time Out" VALUE 0x80592104 Val_Wu32 4294967295.00 OneToOne 0.00 4294967295.00 FORMAT "%13.2" /end CHARACTERISTIC
/begin CHARACTERISTIC MoFETC_flgMonDiagDisblLck_C "Deactivationlabel for permission lock" VALUE 0x80591C0F Val_Wu8 1.00000000000 B_TRUE 0.00 1.00000000000 FORMAT "%13.11" /end CHARACTERISTIC
/begin CHARACTERISTIC MoFETC_rAppLETThd_C "instruction test label for monitoring" VALUE 0x80595AB2 Val_Ws16 799.9878 Prc -400.0000 399.9878 FORMAT "%8.4" /end CHARACTERISTIC
/begin CHARACTERISTIC MoFETC_rAppThd_C "High Idle engine speed tester request is permitted below this accelerator pedal ratio" VALUE 0x80591C10 Val_Wu8 99.61 rel_q0p39 0.00 99.61 FORMAT "%5.2" /end CHARACTERISTIC
/begin CHARACTERISTIC MoFETC_swtInactvTO_C "Deactivationlabel for timeout check" VALUE 0x80591C11 Val_Wu8 255.0 OneToOne 0.00 255.0 FORMAT "%5.1" /end CHARACTERISTIC
/begin CHARACTERISTIC MoFETC_vVehThd_C "velocity limit in additional external Intervention in function monitoring" VALUE 0x80595AB4 Val_Ws16 655.3500 Mo_v_kmh_q0p01 -327.6800 327.6700 FORMAT "%8.4" /end CHARACTERISTIC
/begin CHARACTERISTIC MoFExtInt_ctDebDCSMax_C "Maximum value of Debouncing counter for extention of MSR intervention, until the intervention of level 1 is ramped" VALUE 0x80591C12 Val_Wu8 255.0 OneToOne 0.00 255.0 FORMAT "%5.1" /end CHARACTERISTIC
/begin CHARACTERISTIC MoFExtInt_ctDebTSCMax_C "Maximum value of debouncing counter for extension of gearbox intervention, until the intervention of level 1 is ramped" VALUE 0x80591C13 Val_Wu8 255.0 OneToOne 0.00 255.0 FORMAT "%5.1" /end CHARACTERISTIC
/begin CHARACTERISTIC MoFExtInt_flgSwtIncTSCIntvActvTq_C "Select L2 TSC intervention release condition" VALUE 0x80591C14 Val_Wu8 1.00000000000 B_TRUE 0.00 1.00000000000 FORMAT "%13.11" /end CHARACTERISTIC
/begin CHARACTERISTIC MoFExtInt_tqIncTSCIntvDesMin_C "Lower torque release threshold for TSC intervention in L2" VALUE 0x80591C15 Val_Wu8 408.0 md_q1p6 0.00 408.0 FORMAT "%5.1" /end CHARACTERISTIC
/begin CHARACTERISTIC MoFFrmCoorrCust_HiReslOffs_C "Offset for high resolution accelerator pedal ratio in Lv2" VALUE 0x80595AB6 Val_Wu16 1599.976 relPED_q0p02441 0.00 1599.976 FORMAT "%8.3" /end CHARACTERISTIC
/begin CHARACTERISTIC MoFFrmCoorrCust_HiReslThd_C "Threshold of maximum allowed difference between Level1 and Level2 for LSF functionality" VALUE 0x80595AB8 Val_Wu16 1599.976 relPED_q0p02441 0.00 1599.976 FORMAT "%8.3" /end CHARACTERISTIC
/begin CHARACTERISTIC MoFFrmCoorrCust_Rx_swtEnaEATPlaus_C "Switch to select EAT12 or EAT13 frame" VALUE 0x80591C16 Val_Wu8 1.00000000000 B_TRUE 0.00 1.00000000000 FORMAT "%13.11" /end CHARACTERISTIC
/begin CHARACTERISTIC MoFFrm_Lib_CRC16H1021Tab_CA "Calibration array used for checksum calculation with H1021 as first element" VAL_BLK 0x80595ABA ValA_Wu16 65535.00 OneToOne 0.00 65535.00 FORMAT "%8.2" READ_ONLY NUMBER 256 /end CHARACTERISTIC
/begin CHARACTERISTIC MoFFrm_Lib_CRC82FHTab_CA "Calibration array used for checksum calculation with 2F as first element" VAL_BLK 0x80591C18 ValA_Wu8 255.0 OneToOne 0.00 255.0 FORMAT "%5.1" READ_ONLY NUMBER 256 /end CHARACTERISTIC
/begin CHARACTERISTIC MoFFrm_Lib_CRC8H1DTab_CA "Calibration array used for checksum calculation with 1D as first element" VAL_BLK 0x80591D18 ValA_Wu8 255.0 OneToOne 0.00 255.0 FORMAT "%5.1" READ_ONLY NUMBER 256 /end CHARACTERISTIC
/begin CHARACTERISTIC MoFFrm_Lib_DataApplSigInstance.divFac_C "Structure variable of data application signal / Signal divisor." VALUE 0x8059606C Val_Wu32 4294967295.00 OneToOne 0.00 4294967295.00 FORMAT "%13.2" READ_ONLY /end CHARACTERISTIC
/begin CHARACTERISTIC MoFFrm_Lib_DataApplSigInstance.mulFac_C "Structure variable of data application signal / Signal multiplier" VALUE 0x80596070 Val_Wu32 4294967295.00 OneToOne 0.00 4294967295.00 FORMAT "%13.2" READ_ONLY /end CHARACTERISTIC
/begin CHARACTERISTIC MoFFrm_Lib_DataApplSigInstance.offsFac_C "Structure variable of data application signal / Signal offset" VALUE 0x80596074 Val_Ws32 4294967295.00 OneToOne -2147483648.00 2147483647.00 FORMAT "%13.2" READ_ONLY /end CHARACTERISTIC
/begin CHARACTERISTIC MoFFrm_Lib_DataPduRxInstance.bufLen_C "Structure variable for Rx PDU / parameter to indicate the buffer length of the receiving PDU" VALUE 0x80596088 Val_Wu8 255.0 OneToOne 0.00 255.0 FORMAT "%5.1" READ_ONLY /end CHARACTERISTIC
/begin CHARACTERISTIC MoFFrm_Lib_DataPduRxInstance.bytOrderAlvCntr_C "Structure variable for Rx PDU / Alive counter calibration of RX Data Pdu" VALUE 0x80596089 Val_Wu8 1.000 OneToOne 0.00 1.000 FORMAT "%5.3" EXTENDED_LIMITS 0.00 255.0 READ_ONLY /end CHARACTERISTIC
/begin CHARACTERISTIC MoFFrm_Lib_DataPduRxInstance.bytOrderCrc_C "Structure variable for Rx PDU / CRC calibration of RX Data Pdu" VALUE 0x8059608A Val_Wu8 1.000 OneToOne 0.00 1.000 FORMAT "%5.3" EXTENDED_LIMITS 0.00 255.0 READ_ONLY /end CHARACTERISTIC
/begin CHARACTERISTIC MoFFrm_Lib_DataPduRxInstance.cntrAlvErrDeb_C "Structure variable for Rx PDU / Alive counter debounce error calibration of RX Data Pdu" VALUE 0x8059608C Val_Wu16 65535.00 OneToOne 0.00 65535.00 FORMAT "%8.2" /end CHARACTERISTIC
/begin CHARACTERISTIC MoFFrm_Lib_DataPduRxInstance.cntrCrcErrDeb_C "Structure variable for Rx PDU / Alive counter debounce error calibration of RX Data Pdu" VALUE 0x8059608E Val_Wu16 65535.00 OneToOne 0.00 65535.00 FORMAT "%8.2" /end CHARACTERISTIC
/begin CHARACTERISTIC MoFFrm_Lib_DataPduRxInstance.cntrMaxAlvDif_C "Structure variable for Rx PDU / Complement of Counter cyclic calibration of RX Data Pdu" VALUE 0x80596090 Val_Wu8 255.0 OneToOne 0.00 255.0 FORMAT "%5.1" /end CHARACTERISTIC
/begin CHARACTERISTIC MoFFrm_Lib_DataPduRxInstance.cntrTiOutDeb_C "Structure variable for Rx PDU / Counter time out debounce calibration of Rx data PDU" VALUE 0x80596092 Val_Wu16 65535.00 OneToOne 0.00 65535.00 FORMAT "%8.2" /end CHARACTERISTIC
/begin CHARACTERISTIC MoFFrm_Lib_DataPduRxInstance.crcId_C "Structure variable for Rx PDU / CRC ID of Rx data PDU" VALUE 0x80596094 Val_Wu32 4294967295.00 OneToOne 0.00 4294967295.00 FORMAT "%13.2" /end CHARACTERISTIC
/begin CHARACTERISTIC MoFFrm_Lib_DataPduRxInstance.cycTi_C "Structure variable for Rx PDU / cycle time from bus matrix" VALUE 0x80596098 Val_Wu16 65535.00 OneToOne 0.00 65535.00 FORMAT "%8.2" READ_ONLY /end CHARACTERISTIC
/begin CHARACTERISTIC MoFFrm_Lib_DataPduRxInstance.diChks_C "Structure variable for Rx PDU / parameter to enable or disable manipulation of various checks" VALUE 0x8059609A Val_Wu8 255.0 OneToOne 0.00 255.0 FORMAT "%5.1" /end CHARACTERISTIC
/begin CHARACTERISTIC MoFFrm_Lib_DataPduRxInstance.evalType_C "Structure variable for Rx PDU / evaluation type" VALUE 0x8059609B Val_Wu8 255.0 OneToOne 0.00 255.0 FORMAT "%5.1" READ_ONLY /end CHARACTERISTIC
/begin CHARACTERISTIC MoFFrm_Lib_DataPduRxInstance.maskAlvCntr_C "Structure variable for Rx PDU / Alive counter start bit position of Rx data PDU" VALUE 0x8059609C Val_Wu8 255.0 OneToOne 0.00 255.0 FORMAT "%5.1" /end CHARACTERISTIC
/begin CHARACTERISTIC MoFFrm_Lib_DataPduRxInstance.posnAlvCntrStrtBit_C "Structure variable for Rx PDU / Alive counter start bit calibration of of Data PDU Rx" VALUE 0x8059609E Val_Wu16 65535.00 OneToOne 0.00 65535.00 FORMAT "%8.2" READ_ONLY /end CHARACTERISTIC
/begin CHARACTERISTIC MoFFrm_Lib_DataPduRxInstance.posnCrcCalcEndByte_C "Structure variable for Rx PDU / End byte of CRC calculation position of Data PDU Rx" VALUE 0x805960A0 Val_Wu8 255.0 OneToOne 0.00 255.0 FORMAT "%5.1" /end CHARACTERISTIC
/begin CHARACTERISTIC MoFFrm_Lib_DataPduRxInstance.posnCrcCalcStrtByte_C "Structure variable for Rx PDU / Start byte of CRC calculation position of Data PDU Rx" VALUE 0x805960A1 Val_Wu8 255.0 OneToOne 0.00 255.0 FORMAT "%5.1" /end CHARACTERISTIC
/begin CHARACTERISTIC MoFFrm_Lib_DataPduRxInstance.posnCrcStrtBit_C "Structure variable for Rx PDU / CRC start bit position of Rx data PDU" VALUE 0x805960A2 Val_Wu16 65535.00 OneToOne 0.00 65535.00 FORMAT "%8.2" READ_ONLY /end CHARACTERISTIC
/begin CHARACTERISTIC MoFFrm_Lib_DataPduRxInstance.sigLenAlvCntr_C "Structure variable for Rx PDU / Alive counter signal length of Rx data PDU" VALUE 0x805960A4 Val_Wu8 31.00 OneToOne 1.00 32.00 FORMAT "%5.2" EXTENDED_LIMITS 0.00 255.0 READ_ONLY /end CHARACTERISTIC
/begin CHARACTERISTIC MoFFrm_Lib_DataPduRxInstance.sigLenCrc_C "Structure variable for Rx PDU / CRC calibration signal length of Rx data PDU" VALUE 0x805960A5 Val_Wu8 31.00 OneToOne 1.00 32.00 FORMAT "%5.2" EXTENDED_LIMITS 0.00 255.0 READ_ONLY /end CHARACTERISTIC
/begin CHARACTERISTIC MoFFrm_Lib_DataPduTxInstance.bufLen_C "Structure variable for Tx PDU / Buffer length of the transmission PDU" VALUE 0x805960B0 Val_Wu8 255.0 OneToOne 0.00 255.0 FORMAT "%5.1" READ_ONLY /end CHARACTERISTIC
/begin CHARACTERISTIC MoFFrm_Lib_DataPduTxInstance.bytOrderAlvCntr_C "Structure variable for Tx PDU / Alive counter byte order" VALUE 0x805960B1 Val_Wu8 1.000 OneToOne 0.00 1.000 FORMAT "%5.3" EXTENDED_LIMITS 0.00 255.0 READ_ONLY /end CHARACTERISTIC
/begin CHARACTERISTIC MoFFrm_Lib_DataPduTxInstance.bytOrderCrc_C "Structure variable for Tx PDU / CRC byte order" VALUE 0x805960B2 Val_Wu8 1.000 OneToOne 0.00 1.000 FORMAT "%5.3" EXTENDED_LIMITS 0.00 255.0 READ_ONLY /end CHARACTERISTIC
/begin CHARACTERISTIC MoFFrm_Lib_DataPduTxInstance.crcId_C "Structure variable for Tx PDU / CRC iD calibration of Tx data PDU" VALUE 0x805960B4 Val_Wu32 4294967295.00 OneToOne 0.00 4294967295.00 FORMAT "%13.2" /end CHARACTERISTIC
/begin CHARACTERISTIC MoFFrm_Lib_DataPduTxInstance.evalType_C "Structure variable for Tx PDU / evaluation type of the Tx message" VALUE 0x805960B8 Val_Wu8 255.0 OneToOne 0.00 255.0 FORMAT "%5.1" READ_ONLY /end CHARACTERISTIC
/begin CHARACTERISTIC MoFFrm_Lib_DataPduTxInstance.posnAlvCntrStrtBit_C "Structure variable for Tx PDU / alive counter start bit position" VALUE 0x805960BA Val_Wu16 65535.00 OneToOne 0.00 65535.00 FORMAT "%8.2" READ_ONLY /end CHARACTERISTIC
/begin CHARACTERISTIC MoFFrm_Lib_DataPduTxInstance.posnCrcCalcEndByte_C "Structure variable for Tx PDU / Start byte of CRC calculation position of Data PDU Tx" VALUE 0x805960BC Val_Wu8 255.0 OneToOne 0.00 255.0 FORMAT "%5.1" /end CHARACTERISTIC
/begin CHARACTERISTIC MoFFrm_Lib_DataPduTxInstance.posnCrcCalcStrtByte_C "Structure variable for Tx PDU / Start byte of CRC calculation position of Data PDU Tx" VALUE 0x805960BD Val_Wu8 255.0 OneToOne 0.00 255.0 FORMAT "%5.1" /end CHARACTERISTIC
/begin CHARACTERISTIC MoFFrm_Lib_DataPduTxInstance.posnCrcStrtBit_C "Structure variable for Tx PDU / CRC start bit position" VALUE 0x805960BE Val_Wu16 65535.00 OneToOne 0.00 65535.00 FORMAT "%8.2" READ_ONLY /end CHARACTERISTIC
/begin CHARACTERISTIC MoFFrm_Lib_DataPduTxInstance.sigLenAlvCntr_C "Structure variable for Tx PDU / alive counter signal length" VALUE 0x805960C0 Val_Wu8 31.00 OneToOne 1.00 32.00 FORMAT "%5.2" EXTENDED_LIMITS 0.00 255.0 READ_ONLY /end CHARACTERISTIC
/begin CHARACTERISTIC MoFFrm_Lib_DataPduTxInstance.sigLenCrc_C "Structure variable for Tx PDU / CRC signal length" VALUE 0x805960C1 Val_Wu8 31.00 OneToOne 1.00 32.00 FORMAT "%5.2" EXTENDED_LIMITS 0.00 255.0 READ_ONLY /end CHARACTERISTIC
/begin CHARACTERISTIC MoFTrqPtd_cntrDebRecupFrbdn_C "Debounce counter threshold to inhibit recuperation in case of an active vehicle stability intervention" VALUE 0x80591BD0 Val_Wu8 255.0 OneToOne 0.00 255.0 FORMAT "%5.1" /end CHARACTERISTIC
/begin CHARACTERISTIC MoFTrqPtd_flgNotSwilLossCmp_C "Switch to enable the compensation of not switchable losses using the accelerator pedal position" VALUE 0x80591BDB Val_Wu8 1.00000000000 B_TRUE 0.00 1.00000000000 FORMAT "%13.11" /end CHARACTERISTIC
/begin CHARACTERISTIC MoFTrqPtd_ratThdMaxCmp_C "Upper threshold for full loss torque compensation based on accelerator pedal position" VALUE 0x80591BDC Val_Wu8 99.61 rel_q0p39 0.00 99.61 FORMAT "%5.2" /end CHARACTERISTIC
/begin CHARACTERISTIC MoFTrqPtd_ratThdNoCmp_C "Lower threshold to turn off the loss torque compensation based on accelerator pedal position" VALUE 0x80591BDD Val_Wu8 99.61 rel_q0p39 0.00 99.61 FORMAT "%5.2" /end CHARACTERISTIC
/begin CHARACTERISTIC MoFTrqPtd_ratWoCutOff_C "Accelerator Pedal threshold ratio above which minimal inner torque MoF_trqInrMinWoCtOff is to be considered along with driver demand torque" VALUE 0x80591BDE Val_Wu8 99.61 rel_q0p39 0.00 99.61 FORMAT "%5.2" /end CHARACTERISTIC
/begin CHARACTERISTIC MoFTrqPtd_tiFltTqPtdVehMax_C "PT1 filter constant for permitted sum torque (ASDrf filter emulation in L2)" VALUE 0x805952BC Val_Wu16 655.34999985 zk10msxs_uw_b655p36PT1 0.00000015 655.35000000 FORMAT "%12.8" EXTENDED_LIMITS 0.000000152590219 655.35000000 /end CHARACTERISTIC
/begin CHARACTERISTIC MoFTrqPtd_tiFltTqPtdVehMin_C "PT1 filter constant for permitted minimum torque (ASDrf filter emulation in L2)" VALUE 0x805952BE Val_Wu16 655.34999985 zk10msxs_uw_b655p36PT1 0.00000015 655.35000000 FORMAT "%12.8" EXTENDED_LIMITS 0.000000152590219 655.35000000 /end CHARACTERISTIC
/begin CHARACTERISTIC MoFTrqPtd_tiOffDlyBrkRels_C "Turn off delay timer threshold for Brake release condition" VALUE 0x80591BE0 Val_Wu8 2.550 t_q0p01 0.00 2.550 FORMAT "%5.3" /end CHARACTERISTIC
/begin CHARACTERISTIC MoFTrqPtd_tqAltMaxABSErr_C "permitted remaining recuperation torque, if recuperation is inhibited" VALUE 0x805952C0 Val_Ws16 6553.500 md_q0p1 -3276.800 3276.700 FORMAT "%8.3" /end CHARACTERISTIC
/begin CHARACTERISTIC MoFTrqPtd_tqAltTqMaxErr_T "Engine speed dependent curve to adjust typical alternator torque (1-3 KW)" CURVE 0x805952C2 Mo_DataCurveSstS16WS16 3276.800 md_q0p1 -3276.800 0.00 FORMAT "%8.3" EXTENDED_LIMITS -3276.800 3276.700
 /begin AXIS_DESCR STD_AXIS MoFESpd_nEng nmot_q40 8 0.00 10200.00 FORMAT "%8.2" EXTENDED_LIMITS -1310720. 1310680. DEPOSIT ABSOLUTE /end AXIS_DESCR
/end CHARACTERISTIC
/begin CHARACTERISTIC MoFTrqPtd_tqDecExtIntOffsMax_C "Maximum additional recuperation torque while external intervention" VALUE 0x805952E4 Val_Wu16 6553.500 Trq 0.00 6553.500 FORMAT "%8.3" /end CHARACTERISTIC
/begin CHARACTERISTIC MoFTrqPtd_tqEngApp_M "permitted driver demand (inner torque) based on engine speed and accelerator pedal position" MAP 0x8059576E Map_Xs16Ys16Ws16 6553.500 md_q0p1 -3276.800 3276.700 FORMAT "%8.3"
 /begin AXIS_DESCR STD_AXIS MoFESpd_nEng nmot_q40 8 0.00 10200.00 FORMAT "%8.2" EXTENDED_LIMITS -1310720. 1310680. DEPOSIT ABSOLUTE /end AXIS_DESCR
 /begin AXIS_DESCR STD_AXIS MoF_rAPP rel_q0p39 8 0.00 99.60938 FORMAT "%8.5" EXTENDED_LIMITS -12800.00 12799.61 DEPOSIT ABSOLUTE /end AXIS_DESCR
/end CHARACTERISTIC
/begin CHARACTERISTIC MoFTrqPtd_tqEngSptApp_M "Accelerator-pedal map for sport mode" MAP 0x80595812 Map_Xs16Ys16Ws16 6553.500 md_q0p1 -3276.800 3276.700 FORMAT "%8.3"
 /begin AXIS_DESCR STD_AXIS MoFESpd_nEng nmot_q40 8 0.00 10200.00 FORMAT "%8.2" EXTENDED_LIMITS -1310720. 1310680. DEPOSIT ABSOLUTE /end AXIS_DESCR
 /begin AXIS_DESCR STD_AXIS MoF_rAPP rel_q0p39 8 0.00 99.60938 FORMAT "%8.5" EXTENDED_LIMITS -12800.00 12799.61 DEPOSIT ABSOLUTE /end AXIS_DESCR
/end CHARACTERISTIC
/begin CHARACTERISTIC MoFTrqPtd_tqRecupInhibOffs_C "Offset for recuperation inhibit condition" VALUE 0x80591BD1 Val_Wu8 25.50 md_q0p1 0.00 25.50 FORMAT "%5.2" /end CHARACTERISTIC
/begin CHARACTERISTIC MoFTrqPtd_tqWhlBrkMin_M "Map to obtain the minimum allowed Brake torque at wheel level" MAP 0x8059595A Map_Xs16Ys16Ws16 104856.0 md_q1p6 -52428.80 52427.20 FORMAT "%8.2"
 /begin AXIS_DESCR STD_AXIS MoFTrqRat_rTrqPT fak_q0p01 6 0.00 327.6700 FORMAT "%8.4" EXTENDED_LIMITS -327.6800 327.6700 DEPOSIT ABSOLUTE /end AXIS_DESCR
 /begin AXIS_DESCR STD_AXIS MoFVSS_v vel_q0p01 11 -327.6800 327.6700 FORMAT "%8.4" DEPOSIT ABSOLUTE /end AXIS_DESCR
/end CHARACTERISTIC
/begin CHARACTERISTIC MoFTrqPtd_tqWhlMin_M "Min. allowed torque in wheel level in case of no brake demand from driver" MAP 0x80595A04 Map_Xs16Ys16Ws16 104856.0 md_q1p6 -52428.80 52427.20 FORMAT "%8.2"
 /begin AXIS_DESCR STD_AXIS MoFTrqRat_rTrqPT fak_q0p01 6 0.00 327.6700 FORMAT "%8.4" EXTENDED_LIMITS -327.6800 327.6700 DEPOSIT ABSOLUTE /end AXIS_DESCR
 /begin AXIS_DESCR STD_AXIS MoFVSS_v vel_q0p01 11 -327.6800 327.6700 FORMAT "%8.4" DEPOSIT ABSOLUTE /end AXIS_DESCR
/end CHARACTERISTIC
/begin AXIS_PTS MoF_nEng_DST "interpolation node distribution for engine speed in the function monitoring" 0x80591C02 MoF_nEng Axis_Xu8 10200. nmot_q40 8 0.00 10200. FORMAT "%5.0" DEPOSIT ABSOLUTE /end AXIS_PTS
/begin AXIS_PTS MoF_rAPP_DST "accelerator pedal position distribution in function monitoring" 0x80591B39 MoF_rAPP Axis_Xu8 99.61 rel_q0p39 8 0.00 99.61 FORMAT "%5.2" DEPOSIT ABSOLUTE /end AXIS_PTS
/begin CHARACTERISTIC MoF_trqEngAPP_M "accelerator pedal map(engine speed, accelerator pedal position) in function monitoring" MAP 0x805958B6 Map_Xs16Ys16Ws16 6553.500 md_q0p1 -3276.800 3276.700 FORMAT "%8.3"
 /begin AXIS_DESCR STD_AXIS MoFESpd_nEng nmot_q40 8 0.00 10200.00 FORMAT "%8.2" EXTENDED_LIMITS -1310720. 1310680. DEPOSIT ABSOLUTE /end AXIS_DESCR
 /begin AXIS_DESCR STD_AXIS MoF_rAPP rel_q0p39 8 0.00 99.60938 FORMAT "%8.5" EXTENDED_LIMITS -12800.00 12799.61 DEPOSIT ABSOLUTE /end AXIS_DESCR
/end CHARACTERISTIC
/begin MEASUREMENT dummyRx "Dummy variable in Reception side" UBYTE OneToOne 1 100 0.00 255.0 FORMAT "%5.1" ECU_ADDRESS 0x6001892D /end MEASUREMENT
/begin MEASUREMENT dummyTx "Dummy variable in Transmission side" UBYTE OneToOne 1 100 0.00 255.0 FORMAT "%5.1" ECU_ADDRESS 0x6001892C /end MEASUREMENT
/begin MEASUREMENT MoFAirFilgPrdc_flgClr "Condition clear FCM in function MoFAir_FilgPrdc" UBYTE B_TRUE 1 100 0.00 1.00000000000 BIT_MASK 0x1 FORMAT "%13.11" ECU_ADDRESS 0x70000154 /end MEASUREMENT
/begin MEASUREMENT MoFAirFlMode_flgClr "Condition clear FCM in function MoFAirFl_Mode" UBYTE B_TRUE 1 100 0.00 1.00000000000 BIT_MASK 0x1 FORMAT "%13.11" ECU_ADDRESS 0x70000155 /end MEASUREMENT
/begin MEASUREMENT MoFAirFl_cntrDiagDebFilgPrdc "Diagnosis counter in function MoFAir_FilgPrdc" UBYTE OneToOne 1 100 0.00 255.0 FORMAT "%5.1" ECU_ADDRESS 0x6000B70D /end MEASUREMENT
/begin MEASUREMENT MoFAirFl_cntrDiagDebMode "Diagnosis counter in function MoFAirFl_Mode" UBYTE OneToOne 1 100 0.00 255.0 FORMAT "%5.1" ECU_ADDRESS 0x6000B70E /end MEASUREMENT
/begin MEASUREMENT MoFAirFl_cntrErrDebFilgPrdc "Error debounce counter in function MoFAir_FilgPrdc" UBYTE OneToOne 1 100 0.00 255.0 FORMAT "%5.1" ECU_ADDRESS 0x600189F6 /end MEASUREMENT
/begin MEASUREMENT MoFAirFl_cntrErrDebFilgPrdcCpl "Ram data redundancy for MoFAirFl_cntrErrDebFilgPrdc" UBYTE OneToOne 1 100 0.00 255.0 FORMAT "%5.1" ECU_ADDRESS 0x600182B6 /end MEASUREMENT
/begin MEASUREMENT MoFAirFl_cntrErrDebMode "Error debounce counter in function MoFAirFl_Mode" UBYTE OneToOne 1 100 0.00 255.0 FORMAT "%5.1" ECU_ADDRESS 0x600189F9 /end MEASUREMENT
/begin MEASUREMENT MoFAirFl_cntrErrDebModeCpl "Ram data redundancy for MoFAirFl_cntrErrDebMode" UBYTE OneToOne 1 100 0.00 255.0 FORMAT "%5.1" ECU_ADDRESS 0x600182B7 /end MEASUREMENT
/begin MEASUREMENT MoFAirFl_cntrFillgHiDeDly "Counter for high deviation of charge in function monitoring" UBYTE OneToOne 1 100 0.00 255.0 FORMAT "%5.1" ECU_ADDRESS 0x600189F5 /end MEASUREMENT
/begin MEASUREMENT MoFAirFl_cntrFillgHiDeDlyCpl "RAM data redundancy for MoFAirFl_cntrFillgHiDeDly" UBYTE OneToOne 1 100 0.00 255.0 FORMAT "%5.1" ECU_ADDRESS 0x600182B5 /end MEASUREMENT
/begin MEASUREMENT MoFAirFl_flgEomStoiReqMsg "Request lambda=1 operation from function monitoring" UBYTE B_TRUE 1 100 0.00 1.00000000000 BIT_MASK 0x1 FORMAT "%13.11" ECU_ADDRESS 0x700007F8 /end MEASUREMENT
/begin MEASUREMENT MoFAirFl_flgIrrvErrFilgPrdcMsg "Irreversible error bit in function MoFAirFl_FilgPrdc" UBYTE B_TRUE 1 100 0.00 1.00000000000 BIT_MASK 0x1 FORMAT "%13.11" ECU_ADDRESS 0x700007F4 /end MEASUREMENT
/begin MEASUREMENT MoFAirFl_flgIrrvErrModeMsg "Irreversible error bit in function MoFAirFl_Mode" UBYTE B_TRUE 1 100 0.00 1.00000000000 BIT_MASK 0x1 FORMAT "%13.11" ECU_ADDRESS 0x700007F0 /end MEASUREMENT
/begin MEASUREMENT MoFAirFl_flgTestFilgPrdcMsg "Bit test conditions for diagnosis in function MoFAirFl_FilgPrdc" UBYTE B_TRUE 1 100 0.00 1.00000000000 BIT_MASK 0x1 FORMAT "%13.11" ECU_ADDRESS 0x700007EC /end MEASUREMENT
/begin MEASUREMENT MoFAirFl_flgTestModeMsg "Bit test conditions for diagnosis in function MoFAirFl_Mode" UBYTE B_TRUE 1 100 0.00 1.00000000000 BIT_MASK 0x1 FORMAT "%13.11" ECU_ADDRESS 0x700007E8 /end MEASUREMENT
/begin MEASUREMENT MoFAirFl_ratFillg "Relative air charge in function monitoring" UWORD rel_uw_q0p0234 1 100 0.00 1535.977 FORMAT "%8.3" ECU_ADDRESS 0x600189EC /end MEASUREMENT
/begin MEASUREMENT MoFAirFl_ratFillgBnk1 "Relative air charge (bank1) in function monitoring" UWORD rel_uw_q0p0234 1 100 0.00 1535.977 FORMAT "%8.3" ECU_ADDRESS 0x600189F2 /end MEASUREMENT
/begin MEASUREMENT MoFAirFl_ratFillgBnk1Cpl "RAM data redundancy of MoFAirFl_ratFillgBnk1" UWORD OneToOne 1 100 0.00 65535.00 FORMAT "%8.2" ECU_ADDRESS 0x600182B2 /end MEASUREMENT
/begin MEASUREMENT MoFAirFl_ratFillgBnk2 "Relative air charge (bank2) in function monitoring" UWORD rel_uw_q0p0234 1 100 0.00 1535.977 FORMAT "%8.3" ECU_ADDRESS 0x600189F0 /end MEASUREMENT
/begin MEASUREMENT MoFAirFl_ratFillgBnk2Cpl "RAM data redundancy of MoFAirFl_ratFillgBnk2" UWORD OneToOne 1 100 0.00 65535.00 FORMAT "%8.2" ECU_ADDRESS 0x600182B0 /end MEASUREMENT
/begin MEASUREMENT MoFAirFl_ratFillgCpl "RAM data redundancy of MoFAirFl_ratFillg" UWORD OneToOne 1 100 0.00 65535.00 FORMAT "%8.2" ECU_ADDRESS 0x600182AE /end MEASUREMENT
/begin MEASUREMENT MoFAirFl_ratFillgFrsh "Relative air charge (fresh air) in function monitoring" UWORD rel_uw_q0p0234 1 100 0.00 1535.977 FORMAT "%8.3" ECU_ADDRESS 0x600189EA /end MEASUREMENT
/begin MEASUREMENT MoFAirFl_ratFillgFrshCpl "RAM data redundancy of MoFAirFl_ratFillgFrsh" UWORD OneToOne 1 100 0.00 65535.00 FORMAT "%8.2" ECU_ADDRESS 0x600182AC /end MEASUREMENT
/begin MEASUREMENT MoFAirFl_ratFillgPrdc "Relative air charge predicted in function monitoring." UWORD rel_uw_q0p0234 1 100 0.00 1535.977 FORMAT "%8.3" ECU_ADDRESS 0x600189EE /end MEASUREMENT
/begin MEASUREMENT MoFAirFl_ratFillgPrdcCpl "RAM redundant variable for MoFAirFl_ratFillgPrdc" UWORD OneToOne 1 100 0.00 65535.00 FORMAT "%8.2" ECU_ADDRESS 0x600182AA /end MEASUREMENT
/begin MEASUREMENT MoFAirFl_ratFillgTot "Relative air charge (total) in function monitoring" UWORD rel_uw_q0p0234 1 100 0.00 1535.977 FORMAT "%8.3" ECU_ADDRESS 0x600189E8 /end MEASUREMENT
/begin MEASUREMENT MoFAirFl_ratFillgTotCpl "RAM data redundancy of MoFAirFl_ratFillgTot" UWORD OneToOne 1 100 0.00 65535.00 FORMAT "%8.2" ECU_ADDRESS 0x600182A8 /end MEASUREMENT
/begin MEASUREMENT MoFAirFl_stErrMode "State error information from MoFAirFl_Mode" UBYTE OneToOne 1 100 0.00 255.0 FORMAT "%5.1" ECU_ADDRESS 0x600189F8 /end MEASUREMENT
/begin MEASUREMENT MoFAirFl_stErrModeCpl "State error information from MoFAirFl_Mode complement" UBYTE OneToOne 1 100 0.00 255.0 FORMAT "%5.1" ECU_ADDRESS 0x600189F7 /end MEASUREMENT
/begin MEASUREMENT MoFAirFl_stErrModeMsg "State error information from MoFAirFl_Mode (exported)" UBYTE OneToOne 1 100 0.00 255.0 FORMAT "%5.1" ECU_ADDRESS 0x6000FBDA /end MEASUREMENT
/begin MEASUREMENT MoFAPPCo_bbLoc1Cpl "Complement for bit basis MoFAPPCo_bbLoc1" UBYTE OneToOne 1 100 0.00 255.0 FORMAT "%5.1" ECU_ADDRESS 0x600182A7 /end MEASUREMENT
/begin MEASUREMENT MoFAPPCo_bbOut1Cpl "Complement variable for MoFAPPCo_bbOut1." UBYTE OneToOne 1 100 0.00 255.0 FORMAT "%5.1" ECU_ADDRESS 0x600182A6 /end MEASUREMENT
/begin MEASUREMENT MoFAPP_cntrDeb "Debounce counter for Error time for pedal signals which are implausible to each other during the monitoring" UBYTE OneToOne 1 100 0.00 255.0 FORMAT "%5.1" ECU_ADDRESS 0x600189E6 /end MEASUREMENT
/begin MEASUREMENT MoFAPP_cntrDebCpl "Complement of Debounce counter for Error time for pedal signals which are implausible to each other during the monitoring" UBYTE OneToOne 1 100 0.00 255.0 FORMAT "%5.1" ECU_ADDRESS 0x600182A5 /end MEASUREMENT
/begin MEASUREMENT MoFAPP_cntrTestAPP "counter of testflag in diagnosis for monitoring of accelerator pedal position in function monitoring" UBYTE OneToOne 1 100 0.00 255.0 FORMAT "%5.1" ECU_ADDRESS 0x6000B70C /end MEASUREMENT
/begin MEASUREMENT MoFAPP_flgAdcErr1 "Error while reading ADC value for APP1 in level 2" UBYTE B_TRUE 1 100 0.00 1.00000000000 BIT_MASK 0x8 FORMAT "%13.11" ECU_ADDRESS 0x600189E7 /end MEASUREMENT
/begin MEASUREMENT MoFAPP_flgAdcErr2 "Error while reading ADC value for APP2 in level 2" UBYTE B_TRUE 1 100 0.00 1.00000000000 BIT_MASK 0x10 FORMAT "%13.11" ECU_ADDRESS 0x600189E7 /end MEASUREMENT
/begin MEASUREMENT MoFAPP_flgClr "Diagnosis fault clear bit for the diagnosis monitoring" UBYTE B_TRUE 1 100 0.00 1.00000000000 BIT_MASK 0x1 FORMAT "%13.11" ECU_ADDRESS 0x70000153 /end MEASUREMENT
/begin MEASUREMENT MoFAPP_flgExtErr "Flag indicates the external error status of the accelerator pedal for the function monitoring" UBYTE B_TRUE 1 100 0.00 1.00000000000 BIT_MASK 0x2 FORMAT "%13.11" ECU_ADDRESS 0x600189E7 /end MEASUREMENT
/begin MEASUREMENT MoFAPP_flgIrrvErrMsg "Irreversible error status for level1 in function monitoring." UBYTE B_TRUE 1 100 0.00 1.00000000000 BIT_MASK 0x1 FORMAT "%13.11" ECU_ADDRESS 0x700007FA /end MEASUREMENT
/begin MEASUREMENT MoFAPP_flgNTPRel "Flag for extension of the no load test pulse (NTP)" UBYTE B_TRUE 1 100 0.00 1.00000000000 BIT_MASK 0x4 FORMAT "%13.11" ECU_ADDRESS 0x600189E7 /end MEASUREMENT
/begin MEASUREMENT MoFAPP_flgPlausErr "Plausibility error of the accelerator pedal signals in function monitoring" UBYTE B_TRUE 1 100 0.00 1.00000000000 BIT_MASK 0x1 FORMAT "%13.11" ECU_ADDRESS 0x600189E7 /end MEASUREMENT
/begin MEASUREMENT MoFAPP_flgPlausErrDeb "Flag debounced error in APP" UBYTE B_TRUE 1 100 0.00 1.00000000000 BIT_MASK 0x1 FORMAT "%13.11" ECU_ADDRESS 0x600189E5 /end MEASUREMENT
/begin MEASUREMENT MoFAPP_flgTestMsg "status of tested flag for App Diagnosis monitoring" UBYTE B_TRUE 1 100 0.00 1.00000000000 BIT_MASK 0x1 FORMAT "%13.11" ECU_ADDRESS 0x700007F9 /end MEASUREMENT
/begin MEASUREMENT MoFAPP_ratApp_DST_result "Result of distribution search in MoFAPP_ratApp_DST" SLONG dez 1 100 -2147483648.00 2147483647.00 FORMAT "%13.2" ECU_ADDRESS 0x600189D8 /end MEASUREMENT
/begin MEASUREMENT MoFAPP_ratApp_DST_resultCpl "Complement of MoFAPP_ratApp_DST_result in monitoring." ULONG OneToOne 1 100 0.00 4294967295.00 FORMAT "%13.2" ECU_ADDRESS 0x60018298 /end MEASUREMENT
/begin MEASUREMENT MoFAPP_ratHiResl "Position of accelerator pedal in high resolution for the function monitoring" UWORD relPED_q0p02441 1 100 0.00 1599.976 FORMAT "%8.3" ECU_ADDRESS 0x600189CC /end MEASUREMENT
/begin MEASUREMENT MoFAPP_ratHiReslCpl "RAM data redundancy for MoFAPP_ratHiResl" UWORD OneToOne 1 100 0.00 65535.00 FORMAT "%8.2" ECU_ADDRESS 0x6001828C /end MEASUREMENT
/begin MEASUREMENT MoFAPP_ratHiResl_DST_result "Result of distribution search in MoFAPP_ratHiResl_DST" SLONG dez 1 100 -2147483648.00 2147483647.00 FORMAT "%13.2" ECU_ADDRESS 0x600189D4 /end MEASUREMENT
/begin MEASUREMENT MoFAPP_ratHiResl_DST_resultCpl "Complement of MoFAPP_ratHiResl_DST_result in monitoring" ULONG OneToOne 1 100 0.00 4294967295.00 FORMAT "%13.2" ECU_ADDRESS 0x60018294 /end MEASUREMENT
/begin MEASUREMENT MoFAPP_stAPPMsg "State of APP signal in monitoring" UBYTE OneToOne 1 100 0.00 255.0 FORMAT "%5.1" ECU_ADDRESS 0x6000FBE0 /end MEASUREMENT
/begin MEASUREMENT MoFAPP_stLimpMsg "Info for level 1: Error reaction from level 2 is requested" UBYTE OneToOne 1 100 0.00 255.0 FORMAT "%5.1" ECU_ADDRESS 0x6000FBDF /end MEASUREMENT
/begin MEASUREMENT MoFAPP_stSigSrc "Status of accelerator pedal in level 2" UBYTE OneToOne 1 100 0.00 255.0 FORMAT "%5.1" ECU_ADDRESS 0x600189E4 /end MEASUREMENT
/begin MEASUREMENT MoFAPP_stSigSrcCpl "Double storage of Status of accelerator pedal in level 2" UBYTE OneToOne 1 100 0.00 255.0 FORMAT "%5.1" ECU_ADDRESS 0x600182A4 /end MEASUREMENT
/begin MEASUREMENT MoFAPP_uApp1 "Current voltage at Signal 1 from accelerator pedal" UWORD spg_q0p00488 1 100 0.00 319.9951 FORMAT "%8.4" ECU_ADDRESS 0x600189E2 /end MEASUREMENT
/begin MEASUREMENT MoFAPP_uApp1Cpl "Complement of current voltage at Signal 1 from accelerator pedal" UWORD OneToOne 1 100 0.00 65535.00 FORMAT "%8.2" ECU_ADDRESS 0x600182A2 /end MEASUREMENT
/begin MEASUREMENT MoFAPP_uApp2 "Current voltage at Signal 2 from accelerator pedal" UWORD spg_q0p00488 1 100 0.00 319.9951 FORMAT "%8.4" ECU_ADDRESS 0x600189E0 /end MEASUREMENT
/begin MEASUREMENT MoFAPP_uApp2Cpl "Complement of current voltage at Signal 2 from accelerator pedal" UWORD OneToOne 1 100 0.00 65535.00 FORMAT "%8.2" ECU_ADDRESS 0x600182A0 /end MEASUREMENT
/begin MEASUREMENT MoFAPP_uHiResl "High resolution accelerator pedal voltage in the function monitoring" UWORD spg_q0p00488 1 100 0.00 319.9951 FORMAT "%8.4" ECU_ADDRESS 0x600189DE /end MEASUREMENT
/begin MEASUREMENT MoFAPP_uHiReslCpl "Complement of High resolution accelerator pedal voltage in the function monitoring" UWORD OneToOne 1 100 0.00 65535.00 FORMAT "%8.2" ECU_ADDRESS 0x6001829E /end MEASUREMENT
/begin MEASUREMENT MoFBrkCo_bbLoc1Cpl "RAM data redundancy for MoFBrkCo_bbLoc1" UBYTE OneToOne 1 100 0.00 255.0 FORMAT "%5.1" ECU_ADDRESS 0x6001828B /end MEASUREMENT
/begin MEASUREMENT MoFBrkCo_bbOut1Cpl "RAM data redundancy for MoFBrkCo_bbOut1" UBYTE OneToOne 1 100 0.00 255.0 FORMAT "%5.1" ECU_ADDRESS 0x6001828A /end MEASUREMENT
/begin MEASUREMENT MoFBrk_cntrBrkDeb "Debounce counter for the brake signal in function monitoring" UBYTE OneToOne 1 100 0.00 255.0 FORMAT "%5.1" ECU_ADDRESS 0x600189CA /end MEASUREMENT
/begin MEASUREMENT MoFBrk_cntrBrkDebCpl "RAM data redundancy for MoF_ctBrkDeb" UBYTE OneToOne 1 100 0.00 255.0 FORMAT "%5.1" ECU_ADDRESS 0x60018289 /end MEASUREMENT
/begin MEASUREMENT MoFBrk_cntrBrkMaiDeb "Debounce counter for main brake signal in function monitoring" UBYTE OneToOne 1 100 0.00 255.0 FORMAT "%5.1" ECU_ADDRESS 0x600189C9 /end MEASUREMENT
/begin MEASUREMENT MoFBrk_cntrBrkMaiDebCpl "RAM data redundancy for MoFBrk_cntrBrkMaiDeb" UBYTE OneToOne 1 100 0.00 255.0 FORMAT "%5.1" ECU_ADDRESS 0x60018288 /end MEASUREMENT
/begin MEASUREMENT MoFBrk_cntrBrkRdntDeb "Debounce counter for redundant brake signal in function monitoring" UBYTE OneToOne 1 100 0.00 255.0 FORMAT "%5.1" ECU_ADDRESS 0x600189C8 /end MEASUREMENT
/begin MEASUREMENT MoFBrk_cntrBrkRdntDebCpl "RAM data redundancy for MoFBrk_cntrBrkRdntDeb" UBYTE OneToOne 1 100 0.00 255.0 FORMAT "%5.1" ECU_ADDRESS 0x60018287 /end MEASUREMENT
/begin MEASUREMENT MoFBrk_flgBrk "Brake status in Level2 Function monitoring" UBYTE B_TRUE 1 100 0.00 1.00000000000 BIT_MASK 0x1 FORMAT "%13.11" ECU_ADDRESS 0x600189C7 /end MEASUREMENT
/begin MEASUREMENT MoFBrk_flgBrkAcc "Brake pressed signal for adaptive cruise control (ACC)" UBYTE B_TRUE 1 100 0.00 1.00000000000 BIT_MASK 0x4 FORMAT "%13.11" ECU_ADDRESS 0x600189C7 /end MEASUREMENT
/begin MEASUREMENT MoFBrk_flgBrkApp "Brake pressed signal for APP in funcion monitoring" UBYTE B_TRUE 1 100 0.00 1.00000000000 BIT_MASK 0x2 FORMAT "%13.11" ECU_ADDRESS 0x600189C7 /end MEASUREMENT
/begin MEASUREMENT MoFBrk_flgBrkCrsCtrl "Brake pressed signal for cruise control" UBYTE B_TRUE 1 100 0.00 1.00000000000 BIT_MASK 0x8 FORMAT "%13.11" ECU_ADDRESS 0x600189C7 /end MEASUREMENT
/begin MEASUREMENT MoFBrk_flgDioMaiBrkErr "Error while reading Main Brake DIO in level 2" UBYTE B_TRUE 1 100 0.00 1.00000000000 BIT_MASK 0x1 FORMAT "%13.11" ECU_ADDRESS 0x600189CB /end MEASUREMENT
/begin MEASUREMENT MoFBrk_flgDioRdntBrkErr "Error while reading Redundant Brake DIO in level 2" UBYTE B_TRUE 1 100 0.00 1.00000000000 BIT_MASK 0x2 FORMAT "%13.11" ECU_ADDRESS 0x600189CB /end MEASUREMENT
/begin MEASUREMENT MoFBrk_flgEBBBrkPedlOn "Brake Pedal On Flag. Indicates that driver pressing brake pedal" UBYTE B_TRUE 1 100 0.00 1.00000000000 BIT_MASK 0x40 FORMAT "%13.11" ECU_ADDRESS 0x600189C7 /end MEASUREMENT
/begin MEASUREMENT MoFBrk_flgMaiBrk "Brake Main switch status in Function Monitoring" UBYTE B_TRUE 1 100 0.00 1.00000000000 BIT_MASK 0x10 FORMAT "%13.11" ECU_ADDRESS 0x600189C7 /end MEASUREMENT
/begin MEASUREMENT MoFBrk_flgRdntBrk "Brake Redundant switch status in Function Monitoring" UBYTE B_TRUE 1 100 0.00 1.00000000000 BIT_MASK 0x20 FORMAT "%13.11" ECU_ADDRESS 0x600189C7 /end MEASUREMENT
/begin MEASUREMENT MoFCCtlCo_bbLoc1Cpl "Complement of MoFCCtlCo_bbLoc1Cpl" UBYTE OneToOne 1 100 0.00 255.0 FORMAT "%5.1" ECU_ADDRESS 0x60018286 /end MEASUREMENT
/begin MEASUREMENT MoFCCtlCo_bbLoc2Cpl "Complement of MoFCCtlCo_bbLoc2Cpl" UBYTE OneToOne 1 100 0.00 255.0 FORMAT "%5.1" ECU_ADDRESS 0x60018285 /end MEASUREMENT
/begin MEASUREMENT MoFCCtlCo_bbOut1Cpl "Complement of MoFCCtlCo_bbOut1Cpl" UBYTE OneToOne 1 100 0.00 255.0 FORMAT "%5.1" ECU_ADDRESS 0x60018284 /end MEASUREMENT
/begin MEASUREMENT MoFCCtl_cntrCrsCtrlActvDeb "Debounce Counter for Cruise Control Active" UBYTE OneToOne 1 100 0.00 255.0 FORMAT "%5.1" ECU_ADDRESS 0x600189C4 /end MEASUREMENT
/begin MEASUREMENT MoFCCtl_cntrCrsCtrlActvDebCpl "Double Storage for Cruise Control Active Debounce" UBYTE OneToOne 1 100 0.00 255.0 FORMAT "%5.1" ECU_ADDRESS 0x60018283 /end MEASUREMENT
/begin MEASUREMENT MoFCCtl_flgAct "Activation flag for cruise control" UBYTE B_TRUE 1 100 0.00 1.00000000000 BIT_MASK 0x1 FORMAT "%13.11" ECU_ADDRESS 0x600189C3 /end MEASUREMENT
/begin MEASUREMENT MoFCCtl_flgAppLoDetn "Flag is active when Accelerator pedal is not pressed" UBYTE B_TRUE 1 100 0.00 1.00000000000 BIT_MASK 0x40 FORMAT "%13.11" ECU_ADDRESS 0x600189C6 /end MEASUREMENT
/begin MEASUREMENT MoFCCtl_flgAppPsdDetn "Flag is active when Accelerator pedal is pressed" UBYTE B_TRUE 1 100 0.00 1.00000000000 BIT_MASK 0x80 FORMAT "%13.11" ECU_ADDRESS 0x600189C6 /end MEASUREMENT
/begin MEASUREMENT MoFCCtl_flgBtnActvResu "Flag activation by Resume" UBYTE B_TRUE 1 100 0.00 1.00000000000 BIT_MASK 0x1 FORMAT "%13.11" ECU_ADDRESS 0x600189C5 /end MEASUREMENT
/begin MEASUREMENT MoFCCtl_flgBtnActvSet "Flag activation by Set" UBYTE B_TRUE 1 100 0.00 1.00000000000 BIT_MASK 0x2 FORMAT "%13.11" ECU_ADDRESS 0x600189C5 /end MEASUREMENT
/begin MEASUREMENT MoFCCtl_flgBtnLoDetnResu "Rising Edge Recognised Resume" UBYTE B_TRUE 1 100 0.00 1.00000000000 BIT_MASK 0x4 FORMAT "%13.11" ECU_ADDRESS 0x600189C5 /end MEASUREMENT
/begin MEASUREMENT MoFCCtl_flgBtnLoDetnSet "Rising Edge Recognised Set" UBYTE B_TRUE 1 100 0.00 1.00000000000 BIT_MASK 0x40 FORMAT "%13.11" ECU_ADDRESS 0x600189C5 /end MEASUREMENT
/begin MEASUREMENT MoFCCtl_flgCnclSwt "Flag activation by Cancel switch" UBYTE B_TRUE 1 100 0.00 1.00000000000 BIT_MASK 0x1 FORMAT "%13.11" ECU_ADDRESS 0x600189C6 /end MEASUREMENT
/begin MEASUREMENT MoFCCtl_flgCrsCtrlVldSig "Flag valid CrCtl activation recognized" UBYTE B_TRUE 1 100 0.00 1.00000000000 BIT_MASK 0x8 FORMAT "%13.11" ECU_ADDRESS 0x600189C5 /end MEASUREMENT
/begin MEASUREMENT MoFCCtl_flgErrHw "Hardware error flag (via CAN)" UBYTE B_TRUE 1 100 0.00 1.00000000000 BIT_MASK 0x80 FORMAT "%13.11" ECU_ADDRESS 0x600189C5 /end MEASUREMENT
/begin MEASUREMENT MoFCCtl_flgFallEdgeResu "detected falling edge at cruise control lever set switch in function monitoring" UBYTE B_TRUE 1 100 0.00 1.00000000000 BIT_MASK 0x10 FORMAT "%13.11" ECU_ADDRESS 0x600189C5 /end MEASUREMENT
/begin MEASUREMENT MoFCCtl_flgFallEdgeSet "detected falling edge at cruise control lever resume switch in function monitoring" UBYTE B_TRUE 1 100 0.00 1.00000000000 BIT_MASK 0x20 FORMAT "%13.11" ECU_ADDRESS 0x600189C5 /end MEASUREMENT
/begin MEASUREMENT MoFCCtl_flgMaiSwt "cruise control main switch information in function monitoring" UBYTE B_TRUE 1 100 0.00 1.00000000000 BIT_MASK 0x2 FORMAT "%13.11" ECU_ADDRESS 0x600189C6 /end MEASUREMENT
/begin MEASUREMENT MoFCCtl_flgResuSwt "Flag activation by Resume switch" UBYTE B_TRUE 1 100 0.00 1.00000000000 BIT_MASK 0x10 FORMAT "%13.11" ECU_ADDRESS 0x600189C6 /end MEASUREMENT
/begin MEASUREMENT MoFCCtl_flgSetSwt "Flag activation by Set switch" UBYTE B_TRUE 1 100 0.00 1.00000000000 BIT_MASK 0x20 FORMAT "%13.11" ECU_ADDRESS 0x600189C6 /end MEASUREMENT
/begin MEASUREMENT MoFCCtl_flgShOff "L2 cruise control shutoff value" UBYTE B_TRUE 1 100 0.00 1.00000000000 BIT_MASK 0x2 FORMAT "%13.11" ECU_ADDRESS 0x600189C3 /end MEASUREMENT
/begin MEASUREMENT MoFCCtl_flgTipDwnLo "detected low level at FGR control lever switch tip-down in function monitoring" UBYTE B_TRUE 1 100 0.00 1.00000000000 BIT_MASK 0x4 FORMAT "%13.11" ECU_ADDRESS 0x600189C6 /end MEASUREMENT
/begin MEASUREMENT MoFCCtl_flgTipUpLo "detected low level at FGR control lever switch tip-up in function monitoring" UBYTE B_TRUE 1 100 0.00 1.00000000000 BIT_MASK 0x8 FORMAT "%13.11" ECU_ADDRESS 0x600189C6 /end MEASUREMENT
/begin MEASUREMENT MoFClthCo_bbLoc1Cpl "Complement for bit basis MoFClthCo_bbLoc1" UBYTE OneToOne 1 100 0.00 255.0 FORMAT "%5.1" ECU_ADDRESS 0x60018282 /end MEASUREMENT
/begin MEASUREMENT MoFClthCo_bbOut1Cpl "complement value" UBYTE OneToOne 1 100 0.00 255.0 FORMAT "%5.1" ECU_ADDRESS 0x60018281 /end MEASUREMENT
/begin MEASUREMENT MoFClth_cntrBotmCluDeb "Debounce counter for bottom clutch" UBYTE OneToOne 1 100 0.00 255.0 FORMAT "%5.1" ECU_ADDRESS 0x600189C1 /end MEASUREMENT
/begin MEASUREMENT MoFClth_cntrBotmCluDebCpl "Complement of debounce counter for bottom clutch" UBYTE OneToOne 1 100 0.00 255.0 FORMAT "%5.1" ECU_ADDRESS 0x60018280 /end MEASUREMENT
/begin MEASUREMENT MoFClth_cntrT15OnDeb "Debounce counter since kl15 after which the evaluation of the Clutch signal is aktiv" UBYTE OneToOne 1 100 0.00 255.0 FORMAT "%5.1" ECU_ADDRESS 0x600189C0 /end MEASUREMENT
/begin MEASUREMENT MoFClth_cntrT15OnDebCpl "complement of Debounce counter since kl15 after which the evaluation of the Clutch signal is aktiv" UBYTE OneToOne 1 100 0.00 255.0 FORMAT "%5.1" ECU_ADDRESS 0x6001827F /end MEASUREMENT
/begin MEASUREMENT MoFClth_cntrTopCluDeb "Debounce counter for top clutch" UBYTE OneToOne 1 100 0.00 255.0 FORMAT "%5.1" ECU_ADDRESS 0x600189BF /end MEASUREMENT
/begin MEASUREMENT MoFClth_cntrTopCluDebCpl "Complement of debounce counter for top clutch" UBYTE OneToOne 1 100 0.00 255.0 FORMAT "%5.1" ECU_ADDRESS 0x6001827E /end MEASUREMENT
/begin MEASUREMENT MoFClth_flgClthBot "Flag for top clutch info" UBYTE B_TRUE 1 100 0.00 1.00000000000 BIT_MASK 0x1 FORMAT "%13.11" ECU_ADDRESS 0x600189BE /end MEASUREMENT
/begin MEASUREMENT MoFClth_flgClthTop "Flag for bottom clutch info" UBYTE B_TRUE 1 100 0.00 1.00000000000 BIT_MASK 0x2 FORMAT "%13.11" ECU_ADDRESS 0x600189BE /end MEASUREMENT
/begin MEASUREMENT MoFClth_flgCluBotRaw "Top clucth status read from DIO pin" UBYTE B_TRUE 1 100 0.00 1.00000000000 BIT_MASK 0x1 FORMAT "%13.11" ECU_ADDRESS 0x600189C2 /end MEASUREMENT
/begin MEASUREMENT MoFClth_flgCluTopRaw "Bottom Clucth status read from DIO pin" UBYTE B_TRUE 1 100 0.00 1.00000000000 BIT_MASK 0x2 FORMAT "%13.11" ECU_ADDRESS 0x600189C2 /end MEASUREMENT
/begin MEASUREMENT MoFCoVehCo_bbOut1Cpl "RAM data redundancy of MoFCoVehCo_bbOut1" UBYTE OneToOne 1 100 0.00 255.0 FORMAT "%5.1" ECU_ADDRESS 0x6001827D /end MEASUREMENT
/begin MEASUREMENT MoFDCSCo_bbOut1Cpl "Complement variable for MoFDCSCo_bbOut1." UBYTE OneToOne 1 100 0.00 255.0 FORMAT "%5.1" ECU_ADDRESS 0x60018262 /end MEASUREMENT
/begin MEASUREMENT MoFDCS_cntrDebDCSDeactv "DCS deactivation counter from L2" UBYTE OneToOne 1 100 0.00 255.0 FORMAT "%5.1" ECU_ADDRESS 0x600189A2 /end MEASUREMENT
/begin MEASUREMENT MoFDCS_cntrDebDCSDeactvCpl "Double Storage for DCS deactiavtion counter" UBYTE OneToOne 1 100 0.00 255.0 FORMAT "%5.1" ECU_ADDRESS 0x60018261 /end MEASUREMENT
/begin MEASUREMENT MoFDCS_cntrStbErrDeb "debounce-counter Stabili. Unit Error" UBYTE OneToOne 1 100 0.00 255.0 FORMAT "%5.1" ECU_ADDRESS 0x600189A1 /end MEASUREMENT
/begin MEASUREMENT MoFDCS_cntrStbErrDebCpl "Complement variable for MoFDCS_cntrStbErrDeb" UBYTE OneToOne 1 100 0.00 255.0 FORMAT "%5.1" ECU_ADDRESS 0x60018260 /end MEASUREMENT
/begin MEASUREMENT MoFDCS_flgComErrESP "Flag communication with the ESP error detected" UBYTE B_TRUE 1 100 0.00 1.00000000000 BIT_MASK 0x1 FORMAT "%13.11" ECU_ADDRESS 0x600189A0 /end MEASUREMENT
/begin MEASUREMENT MoFDCS_flgDecIntvActv "Decreasing torque request of ESP (DCS) is active" UBYTE B_TRUE 1 100 0.00 1.00000000000 BIT_MASK 0x2 FORMAT "%13.11" ECU_ADDRESS 0x600189A0 /end MEASUREMENT
/begin MEASUREMENT MoFDCS_flgIntvActv "Flag indicating DCS Activation status" UBYTE B_TRUE 1 100 0.00 1.00000000000 BIT_MASK 0x4 FORMAT "%13.11" ECU_ADDRESS 0x600189A0 /end MEASUREMENT
/begin MEASUREMENT MoFDCS_flgPtd "condition DCS permitted in in function monitoring" UBYTE B_TRUE 1 100 0.00 1.00000000000 BIT_MASK 0x8 FORMAT "%13.11" ECU_ADDRESS 0x600189A0 /end MEASUREMENT
/begin MEASUREMENT MoFDCS_flgStbErr "stabilizer unit error status" UBYTE B_TRUE 1 100 0.00 1.00000000000 BIT_MASK 0x10 FORMAT "%13.11" ECU_ADDRESS 0x600189A0 /end MEASUREMENT
/begin MEASUREMENT MoFDCS_tqCluPtd "Permitted increasing intervention of brake system on clutch level" SWORD md_q0p1 1 100 -3276.800 3276.700 FORMAT "%8.3" ECU_ADDRESS 0x6001899C /end MEASUREMENT
/begin MEASUREMENT MoFDCS_tqCluPtdCpl "Complement variable for Permitted increasing intervention of brake system on clutch level" UWORD OneToOne 1 100 0.00 65535.00 FORMAT "%8.2" ECU_ADDRESS 0x6001825E /end MEASUREMENT
/begin MEASUREMENT MoFDCS_tqDesWhl "Desired Wheel Torque" SWORD md_q0p1 1 100 -3276.800 3276.700 FORMAT "%8.3" ECU_ADDRESS 0x6001899E /end MEASUREMENT
/begin MEASUREMENT MoFDCS_tqDesWhlCpl "Double Storage for Desired Wheel Torque" UWORD OneToOne 1 100 0.00 65535.00 FORMAT "%8.2" ECU_ADDRESS 0x6001825C /end MEASUREMENT
/begin MEASUREMENT MoFDCS_tqWhlPtd "Permitted torque of DCS" SWORD md_q1p6 1 100 -52428.80 52427.20 FORMAT "%8.2" ECU_ADDRESS 0x6001899A /end MEASUREMENT
/begin MEASUREMENT MoFDCS_tqWhlPtdCpl "Complement variable for MoFDCS_tqWhlPtd" UWORD OneToOne 1 100 0.00 65535.00 FORMAT "%8.2" ECU_ADDRESS 0x6001825A /end MEASUREMENT
/begin MEASUREMENT MoFDCS_trqDem "Demanded engine torque from MRS control" SWORD md_q0p1 1 100 -3276.800 3276.700 FORMAT "%8.3" ECU_ADDRESS 0x60018998 /end MEASUREMENT
/begin MEASUREMENT MoFDCS_trqDemCpl "Double storage for demanded engine torque from MSR control" UWORD OneToOne 1 100 0.00 65535.00 FORMAT "%8.2" ECU_ADDRESS 0x60018258 /end MEASUREMENT
/begin MEASUREMENT MoFDrAsCo_bbLocCpl "Bit basis complement for local flags" UBYTE OneToOne 1 100 0.00 255.0 FORMAT "%5.1" ECU_ADDRESS 0x60018256 /end MEASUREMENT
/begin MEASUREMENT MoFDrAs_cntrACC "counter for Turn on Delay ACC (brake operated)" UBYTE OneToOne 1 100 0.00 255.0 FORMAT "%5.1" ECU_ADDRESS 0x60018995 /end MEASUREMENT
/begin MEASUREMENT MoFDrAs_cntrACCCpl "RAM data redundancy for MoFDrAs_cntrACC" UBYTE OneToOne 1 100 0.00 255.0 FORMAT "%5.1" ECU_ADDRESS 0x60018255 /end MEASUREMENT
/begin MEASUREMENT MoFDrAs_cntrCrsCtrl "counter for Turn on Delay cruise control (brake operated)" UBYTE OneToOne 1 100 0.00 255.0 FORMAT "%5.1" ECU_ADDRESS 0x60018994 /end MEASUREMENT
/begin MEASUREMENT MoFDrAs_cntrCrsCtrlCpl "RAM data redundancy for MoFDrAs_cntrCrsCtrl" UBYTE OneToOne 1 100 0.00 255.0 FORMAT "%5.1" ECU_ADDRESS 0x60018254 /end MEASUREMENT
/begin MEASUREMENT MoFDrAs_flgACCPtd "ACC permitted information of driver assistance" UBYTE B_TRUE 1 100 0.00 1.00000000000 BIT_MASK 0x10 FORMAT "%13.11" ECU_ADDRESS 0x60018996 /end MEASUREMENT
/begin MEASUREMENT MoFDrAs_flgActv "Condition for DrAS active from L2" UBYTE B_TRUE 1 100 0.00 1.00000000000 BIT_MASK 0x8 FORMAT "%13.11" ECU_ADDRESS 0x60018996 /end MEASUREMENT
/begin MEASUREMENT MoFDrAs_flgBrkACC "break status for ACC active in function monitoring." UBYTE B_TRUE 1 100 0.00 1.00000000000 BIT_MASK 0x2 FORMAT "%13.11" ECU_ADDRESS 0x60018996 /end MEASUREMENT
/begin MEASUREMENT MoFDrAs_flgBrkCrCtl "brake status for CrCtl active" UBYTE B_TRUE 1 100 0.00 1.00000000000 BIT_MASK 0x4 FORMAT "%13.11" ECU_ADDRESS 0x60018996 /end MEASUREMENT
/begin MEASUREMENT MoFDrAs_flgCrsCtrlPtd "Condition Cruise control enabled" UBYTE B_TRUE 1 100 0.00 1.00000000000 BIT_MASK 0x1 FORMAT "%13.11" ECU_ADDRESS 0x60018996 /end MEASUREMENT
/begin MEASUREMENT MoFDrAs_stACCPtdMsg "ACC from sight of the monitoring released" UBYTE OneToOne 1 100 0.00 255.0 FORMAT "%5.1" ECU_ADDRESS 0x6000FBD9 /end MEASUREMENT
/begin MEASUREMENT MoFDrAs_stCCtlPtdMsg "cruise control from sight of the monitoring released" UBYTE OneToOne 1 100 0.00 255.0 FORMAT "%5.1" ECU_ADDRESS 0x6000FBD8 /end MEASUREMENT
/begin MEASUREMENT MoFDrAs_stPtdMsg "driver's assistant from sight of the monitoring released." UBYTE OneToOne 1 100 0.00 255.0 FORMAT "%5.1" ECU_ADDRESS 0x6000FBD7 /end MEASUREMENT
/begin MEASUREMENT MoFDrAs_trqPtd "Permissible wheel torque of driver assistant systems" SWORD md_q1p6 1 100 -52428.80 52427.20 FORMAT "%8.2" ECU_ADDRESS 0x60018992 /end MEASUREMENT
/begin MEASUREMENT MoFDrAs_trqPtdCpl "complement of permissible wheel torque of driver assistant systems" UWORD OneToOne 1 100 0.00 65535.00 FORMAT "%8.2" ECU_ADDRESS 0x60018252 /end MEASUREMENT
/begin MEASUREMENT MoFDrDemCo_bbLoc1Cpl "Ram data redundancy for MoFDrDemCo_bbLoc1" UBYTE OneToOne 1 100 0.00 255.0 FORMAT "%5.1" ECU_ADDRESS 0x60018251 /end MEASUREMENT
/begin MEASUREMENT MoFDrDemMin_bbOut1Cpl "Complement variable of MoFDrDemMin_bbOut1" UBYTE OneToOne 1 100 0.00 255.0 FORMAT "%5.1" ECU_ADDRESS 0x60018237 /end MEASUREMENT
/begin MEASUREMENT MoFDrDem_dfacFiveMod "Delta multiplication factor for different torque mode" UWORD Fact1000 1 100 0.00 1.000000 FORMAT "%8.6" ECU_ADDRESS 0x60018988 /end MEASUREMENT
/begin MEASUREMENT MoFDrDem_dfacFiveModCpl "Ram data redundancy for MoFDrDem_dfacFiveMod" UWORD OneToOne 1 100 0.00 65535.00 FORMAT "%8.2" ECU_ADDRESS 0x60018248 /end MEASUREMENT
/begin MEASUREMENT MoFDrDem_dfacSpt "Delta multiplication factor for sports mode torque" UWORD Fact1000 1 100 0.00 1.000000 FORMAT "%8.6" ECU_ADDRESS 0x60018986 /end MEASUREMENT
/begin MEASUREMENT MoFDrDem_dfacSptCpl "Complement of MoFDrDem_dfacSpt" UWORD OneToOne 1 100 0.00 65535.00 FORMAT "%8.2" ECU_ADDRESS 0x60018246 /end MEASUREMENT
/begin MEASUREMENT MoFDrDem_flgDrvModChg "Flag indicating driver mode change in fuction monitoring" UBYTE B_TRUE 1 100 0.00 1.00000000000 BIT_MASK 0x1 FORMAT "%13.11" ECU_ADDRESS 0x60018991 /end MEASUREMENT
/begin MEASUREMENT MoFDrDem_swtDrvMod "Drive mode selection switch in fucntion monitoring" UBYTE OneToOne 1 100 0.00 255.0 FORMAT "%5.1" ECU_ADDRESS 0x60018990 /end MEASUREMENT
/begin MEASUREMENT MoFDrDem_swtDrvModCpl "Ram data redundancy for MoFDrDem_swtDrvMod" UBYTE OneToOne 1 100 0.00 255.0 FORMAT "%5.1" ECU_ADDRESS 0x60018250 /end MEASUREMENT
/begin MEASUREMENT MoFDrDem_swtDrvModPrev "Previous drive mode information used as reference to calculate old torque and to ramp to new torque based on new driving mode in fucntion monitoring" UBYTE OneToOne 1 100 0.00 255.0 FORMAT "%5.1" ECU_ADDRESS 0x6001898F /end MEASUREMENT
/begin MEASUREMENT MoFDrDem_swtDrvModPrevCpl "Ram data redundancy for MoFDrDem_swtDrvModPrev" UBYTE OneToOne 1 100 0.00 255.0 FORMAT "%5.1" ECU_ADDRESS 0x6001824F /end MEASUREMENT
/begin MEASUREMENT MoFDrDem_tqCmpLoss "Torque comp loss" SWORD md_q1p6 1 100 -52428.80 52427.20 FORMAT "%8.2" ECU_ADDRESS 0x60018984 /end MEASUREMENT
/begin MEASUREMENT MoFDrDem_tqCmpLossCpl "Torque comp loss Complement" UWORD OneToOne 1 100 0.00 65535.00 FORMAT "%8.2" ECU_ADDRESS 0x60018244 /end MEASUREMENT
/begin MEASUREMENT MoFDrDem_tqCmpNotSwilLoss "Torque comp not swi loss" UBYTE md_q1p6 1 100 0.00 408.0 FORMAT "%5.1" ECU_ADDRESS 0x6001898E /end MEASUREMENT
/begin MEASUREMENT MoFDrDem_tqCmpNotSwilLossCpl "Torque comp not swi loss complement" UBYTE OneToOne 1 100 0.00 255.0 FORMAT "%5.1" ECU_ADDRESS 0x6001824E /end MEASUREMENT
/begin MEASUREMENT MoFDrDem_tqCmpSwilLoss "Torque comp swi loss" UBYTE md_q1p6 1 100 0.00 408.0 FORMAT "%5.1" ECU_ADDRESS 0x6001898D /end MEASUREMENT
/begin MEASUREMENT MoFDrDem_tqCmpSwilLossCpl "Torque comp swi loss complement" UBYTE OneToOne 1 100 0.00 255.0 FORMAT "%5.1" ECU_ADDRESS 0x6001824D /end MEASUREMENT
/begin MEASUREMENT MoFDrDem_tqEng "Permitted driver demanded torque without overrun behaviour at engine torque level in function monitoring" SWORD Trq 1 100 -3276.800 3276.700 FORMAT "%8.3" ECU_ADDRESS 0x60018982 /end MEASUREMENT
/begin MEASUREMENT MoFDrDem_tqEngApp "Driver demand torque for the chosen drive mode" SWORD md_q0p1 1 100 -3276.800 3276.700 FORMAT "%8.3" ECU_ADDRESS 0x60018980 /end MEASUREMENT
/begin MEASUREMENT MoFDrDem_tqEngAppCpl "Double storage for MoFDrDem_tqEngApp" UWORD OneToOne 1 100 0.00 65535.00 FORMAT "%8.2" ECU_ADDRESS 0x60018242 /end MEASUREMENT
/begin MEASUREMENT MoFDrDem_tqEngCpl "Complement of sum of driver demanded torque for all driver modes in function monitoring" UWORD OneToOne 1 100 0.00 65535.00 FORMAT "%8.2" ECU_ADDRESS 0x60018240 /end MEASUREMENT
/begin MEASUREMENT MoFDrDem_tqInrMinWoCtOff "Minimal inner torque without cutoff for calculation of limitation torque in MoFDrDem" UBYTE md_q1p6 1 100 0.00 408.0 FORMAT "%5.1" ECU_ADDRESS 0x6001898C /end MEASUREMENT
/begin MEASUREMENT MoFDrDem_tqInrMinWoCtOffCpl "Complement of Minimal inner torque without cutoff for calculation of limitation torque in MoFDrDem" UBYTE OneToOne 1 100 0.00 255.0 FORMAT "%5.1" ECU_ADDRESS 0x6001824C /end MEASUREMENT
/begin MEASUREMENT MoFDrDem_tqModNew "Driver demanded pull torque based on current drive mode in function monitoring" SWORD md_q0p1 1 100 -3276.800 3276.700 FORMAT "%8.3" ECU_ADDRESS 0x6001897E /end MEASUREMENT
/begin MEASUREMENT MoFDrDem_tqModNewCpl "Ram data redundancy for MoFDrDem_tqModNew" UWORD OneToOne 1 100 0.00 65535.00 FORMAT "%8.2" ECU_ADDRESS 0x6001823E /end MEASUREMENT
/begin MEASUREMENT MoFDrDem_tqModOld "Driver demanded pull torque based on previous drive mode in function monitoring" SWORD md_q0p1 1 100 -3276.800 3276.700 FORMAT "%8.3" ECU_ADDRESS 0x6001897C /end MEASUREMENT
/begin MEASUREMENT MoFDrDem_tqModOldCpl "Ram data redundancy for MoFDrDem_tqModOld" UWORD OneToOne 1 100 0.00 65535.00 FORMAT "%8.2" ECU_ADDRESS 0x6001823C /end MEASUREMENT
/begin MEASUREMENT MoFDrDem_tqWhlDrvDem "Final driver demanded torque with compensation torque in function monitoring" SWORD md_q1p6 1 100 -52428.80 52427.20 FORMAT "%8.2" ECU_ADDRESS 0x6001897A /end MEASUREMENT
/begin MEASUREMENT MoFDrDem_tqWhlDrvDemCpl "Complement of Final driver demanded torque with compensation torque in function monitoring" UWORD OneToOne 1 100 0.00 65535.00 FORMAT "%8.2" ECU_ADDRESS 0x6001823A /end MEASUREMENT
/begin MEASUREMENT MoFDrvPrgSwt_stDrvModSwt "Status for five drive modes" UBYTE OneToOne 1 100 0.00 255.0 FORMAT "%5.1" ECU_ADDRESS 0x60018971 /end MEASUREMENT
/begin MEASUREMENT MoFDrvPrgSwt_stDrvModSwtCpl "Complement for Status for different drive modes" UBYTE OneToOne 1 100 0.00 255.0 FORMAT "%5.1" ECU_ADDRESS 0x60018233 /end MEASUREMENT
/begin MEASUREMENT MoFDrvPrgSwt_stDrvModSwtL1 "Status for IDS drive modes. Status corresponds to lvl1." UBYTE OneToOne 1 100 0.00 15.00 FORMAT "%5.2" ECU_ADDRESS 0x60018973 /end MEASUREMENT
/begin MEASUREMENT MoFDrvPrgSwt_stDrvModSwtL1Cpl "Status complement for IDS drive modes." UBYTE OneToOne 1 100 0.00 255.0 FORMAT "%5.1" ECU_ADDRESS 0x60018232 /end MEASUREMENT
/begin MEASUREMENT MoFDrvPrgSwt_stDrvModSwtL1Old "Status last cycle of IDS drive modes." UBYTE OneToOne 1 100 0.00 255.0 FORMAT "%5.1" ECU_ADDRESS 0x60018972 /end MEASUREMENT
/begin MEASUREMENT MoFDrvPrgSwt_stDrvModSwtL1OldCpl "Status complement last cycle of IDS drive modes." UBYTE OneToOne 1 100 0.00 255.0 FORMAT "%5.1" ECU_ADDRESS 0x60018231 /end MEASUREMENT
/begin MEASUREMENT MoFESpdCo_bbLoc1Cpl "RAM data redundancy of MoFESpdCo_bbLoc1" UBYTE OneToOne 1 100 0.00 255.0 FORMAT "%5.1" ECU_ADDRESS 0x60018230 /end MEASUREMENT
/begin MEASUREMENT MoFESpdCo_bbOutCpl "RAM data redundancy of MoFESpdCo_bbOut" UBYTE OneToOne 1 100 0.00 255.0 FORMAT "%5.1" ECU_ADDRESS 0x6001822F /end MEASUREMENT
/begin MEASUREMENT MoFESpd_cntrNoSyncDeb "counter for synchro loss in function monitoring" UBYTE OneToOne 1 100 0.00 255.0 FORMAT "%5.1" ECU_ADDRESS 0x6001896F /end MEASUREMENT
/begin MEASUREMENT MoFESpd_cntrNoSyncDebCpl "RAM data redundancy for MoFESpd_cntrNoSyncDeb" UBYTE OneToOne 1 100 0.00 255.0 FORMAT "%5.1" ECU_ADDRESS 0x6001822E /end MEASUREMENT
/begin MEASUREMENT MoFESpd_cntrSyncLvl1Old "synchro task counter level 1 (last value) in function monitoring" UBYTE OneToOne 1 100 0.00 255.0 FORMAT "%5.1" ECU_ADDRESS 0x6001896E /end MEASUREMENT
/begin MEASUREMENT MoFESpd_cntrSyncLvl1OldCpl "RAM data redundancy for MoFESpd_cntrSyncLvl1Old" UBYTE OneToOne 1 100 0.00 255.0 FORMAT "%5.1" ECU_ADDRESS 0x6001822D /end MEASUREMENT
/begin MEASUREMENT MoFESpd_ctDeb "Error counter for engine speed comparison during function monitoring" UBYTE OneToOne 1 100 0.00 255.0 FORMAT "%5.1" ECU_ADDRESS 0x6001896D /end MEASUREMENT
/begin MEASUREMENT MoFESpd_ctDebCpl "Double storage of error counter for engine speed comparison during function monitoring" UBYTE OneToOne 1 100 0.00 255.0 FORMAT "%5.1" ECU_ADDRESS 0x6001822C /end MEASUREMENT
/begin MEASUREMENT MoFESpd_deltaGT1Signd_MP "signed angle counter difference in engine speed monitoring" SLONG OneToOne 1 100 -2147483648.00 2147483647.00 FORMAT "%13.2" ECU_ADDRESS 0x7000A14C /end MEASUREMENT
/begin MEASUREMENT MoFESpd_flgClr "condition DSM clearing in function monitoring" UBYTE B_TRUE 1 100 0.00 1.00000000000 BIT_MASK 0x1 FORMAT "%13.11" ECU_ADDRESS 0x70000152 /end MEASUREMENT
/begin MEASUREMENT MoFESpd_flgErrESpd "error engine speed in function monitoring" UBYTE B_TRUE 1 100 0.00 1.00000000000 BIT_MASK 0x2 FORMAT "%13.11" ECU_ADDRESS 0x6001896B /end MEASUREMENT
/begin MEASUREMENT MoFESpd_flgGrdtNEngErr "Debounced engine speed gradient error flag in engine speed monitoring" UBYTE B_TRUE 1 100 0.00 1.00000000000 BIT_MASK 0x1 FORMAT "%13.11" ECU_ADDRESS 0x60018970 /end MEASUREMENT
/begin MEASUREMENT MoFESpd_flgICOESpd "Fault reaction demand from function monitoring irrev. SKA (fuel cut-off)" UBYTE B_TRUE 1 100 0.00 1.00000000000 BIT_MASK 0x1 FORMAT "%13.11" ECU_ADDRESS 0x6001896B /end MEASUREMENT
/begin MEASUREMENT MoFESpd_flgIrrvErrMsg "Irreversibles Fehler-Bit" UBYTE B_TRUE 1 100 0.00 1.00000000000 BIT_MASK 0x1 FORMAT "%13.11" ECU_ADDRESS 0x700007E7 /end MEASUREMENT
/begin MEASUREMENT MoFESpd_flgNoSyncActv "Condition synchro not active in engine speed monitoring" UBYTE B_TRUE 1 100 0.00 1.00000000000 BIT_MASK 0x2 FORMAT "%13.11" ECU_ADDRESS 0x60018970 /end MEASUREMENT
/begin MEASUREMENT MoFESpd_flgSigVld "condition engine speed signal plausible in function monitoring" UBYTE B_TRUE 1 100 0.00 1.00000000000 BIT_MASK 0x4 FORMAT "%13.11" ECU_ADDRESS 0x6001896B /end MEASUREMENT
/begin MEASUREMENT MoFESpd_flgTestMsg "Pruefbedingung fuer Diagnose Fehlerpfad" UBYTE B_TRUE 1 100 0.00 1.00000000000 BIT_MASK 0x1 FORMAT "%13.11" ECU_ADDRESS 0x700007E6 /end MEASUREMENT
/begin MEASUREMENT MoFESpd_frqTsk_MP "task frequency in engine speed monitoring" ULONG freq_q0p001 1 100 0.00 4294967.29500 FORMAT "%13.5" ECU_ADDRESS 0x7000A148 /end MEASUREMENT
/begin MEASUREMENT MoFESpd_GT1Diff_MP "angle counter difference in engine speed monitoring" ULONG OneToOne 1 100 0.00 4294967295.00 FORMAT "%13.2" ECU_ADDRESS 0x7000A144 /end MEASUREMENT
/begin MEASUREMENT MoFESpd_GT1_MP "Angle counter (ticks) in engine speed monitoring" ULONG OneToOne 1 100 0.00 4294967295.00 FORMAT "%13.2" ECU_ADDRESS 0x7000A140 /end MEASUREMENT
/begin MEASUREMENT MoFESpd_nDiffHiResl_MP "difference between calculated engine speeds in level 1 and level 2" SWORD nmot_q0p5 1 100 -16384.00 16383.50 FORMAT "%8.2" ECU_ADDRESS 0x7000A13C /end MEASUREMENT
/begin MEASUREMENT MoFESpd_nEng "Engine speed in function monitoring" UBYTE nmot_q40 1 100 0.00 10200. FORMAT "%5.0" ECU_ADDRESS 0x6001896A /end MEASUREMENT
/begin MEASUREMENT MoFESpd_nEngCpl "Double storage of engine speed during function monitoring" UBYTE OneToOne 1 100 0.00 255.0 FORMAT "%5.1" ECU_ADDRESS 0x6001822B /end MEASUREMENT
/begin MEASUREMENT MoFESpd_nEngCurr_MP "engine speed in function monitoring" UWORD nmot_q0p5 1 100 0.00 32767.50 FORMAT "%8.2" ECU_ADDRESS 0x7000A13A /end MEASUREMENT
/begin MEASUREMENT MoFESpd_nEngHiRes "High resolution part of engine speed in function monitoring" SWORD nmot_q0p5 1 100 -16384.00 16383.50 FORMAT "%8.2" ECU_ADDRESS 0x60018954 /end MEASUREMENT
/begin MEASUREMENT MoFESpd_nEngHiResCpl "Double storage of the high resolution part of engine speed in the function monitoring" UWORD OneToOne 1 100 0.00 65535.00 FORMAT "%8.2" ECU_ADDRESS 0x60018214 /end MEASUREMENT
/begin MEASUREMENT MoFESpd_nEngHiReslL2_MP "calculated high resolution engine speed in function monitoring" SWORD nmot_q0p5 1 100 -16384.00 16383.50 FORMAT "%8.2" ECU_ADDRESS 0x7000A138 /end MEASUREMENT
/begin MEASUREMENT MoFESpd_nEng_Ax_result "Supporting coordinate for engine speed during function monitoring" SLONG dez 1 100 -2147483648.00 2147483647.00 FORMAT "%13.2" ECU_ADDRESS 0x6001895C /end MEASUREMENT
/begin MEASUREMENT MoFESpd_nEng_Ax_result_Cpl "Double storage of supporting coordinate for engine speed during function monitoring" ULONG OneToOne 1 100 0.00 4294967295.00 FORMAT "%13.2" ECU_ADDRESS 0x60018224 /end MEASUREMENT
/begin MEASUREMENT MoFESpd_stSync "Synchronisation status of engine speed monitoring" UBYTE OneToOne 1 100 0.00 255.0 FORMAT "%5.1" ECU_ADDRESS 0x60018969 /end MEASUREMENT
/begin MEASUREMENT MoFESpd_stSyncCpl "Double Storage of Synchronisation status of engine speed monitoring" UBYTE OneToOne 1 100 0.00 255.0 FORMAT "%5.1" ECU_ADDRESS 0x6001822A /end MEASUREMENT
/begin MEASUREMENT MoFESpd_tiCurr_MP "System time (ticks) in engine speed monitoring" ULONG OneToOne 1 100 0.00 4294967295.00 FORMAT "%13.2" ECU_ADDRESS 0x7000A134 /end MEASUREMENT
/begin MEASUREMENT MoFETCCo_bbLocCpl "Complement for MoFETCCo_bbLoc" UBYTE OneToOne 1 100 0.00 255.0 FORMAT "%5.1" ECU_ADDRESS 0x60018213 /end MEASUREMENT
/begin MEASUREMENT MoFETCCo_bbOutCpl "Complement variable for MoFETCCo_bbOut" UBYTE OneToOne 1 100 0.00 255.0 FORMAT "%5.1" ECU_ADDRESS 0x60018212 /end MEASUREMENT
/begin MEASUREMENT MoFETC_cntrCurRunTestReq "Debounce counter of test request from level 1 for engine test" UBYTE OneToOne 1 100 0.00 255.0 FORMAT "%5.1" ECU_ADDRESS 0x60018952 /end MEASUREMENT
/begin MEASUREMENT MoFETC_cntrCurRunTestReqCpl "Complement for MoFETC_cntrCurRunTestReq" UBYTE OneToOne 1 100 0.00 255.0 FORMAT "%5.1" ECU_ADDRESS 0x60018211 /end MEASUREMENT
/begin MEASUREMENT MoFETC_cntrTest "Counter to determine if the engine test active has elapsed for a Time Out" ULONG OneToOne 1 100 0.00 4294967295.00 FORMAT "%13.2" ECU_ADDRESS 0x60018948 /end MEASUREMENT
/begin MEASUREMENT MoFETC_cntrTestCpl "Complement for MoFETC_cntrTest" ULONG OneToOne 1 100 0.00 4294967295.00 FORMAT "%13.2" ECU_ADDRESS 0x60018208 /end MEASUREMENT
/begin MEASUREMENT MoFETC_cntrTestIdleUp "Maximum permissible duration of High Idle engine speed tester request" ULONG OneToOne 1 100 0.00 4294967295.00 FORMAT "%13.2" ECU_ADDRESS 0x60018944 /end MEASUREMENT
/begin MEASUREMENT MoFETC_cntrTestIdleUpCpl "Complement for MoFETC_cntrTestIdleUp" ULONG OneToOne 1 100 0.00 4294967295.00 FORMAT "%13.2" ECU_ADDRESS 0x60018204 /end MEASUREMENT
/begin MEASUREMENT MoFETC_cntrTestIdleUpTOffDly "High Idle engine speed tester request turn off delay" UBYTE OneToOne 1 100 0.00 255.0 FORMAT "%5.1" ECU_ADDRESS 0x60018951 /end MEASUREMENT
/begin MEASUREMENT MoFETC_cntrTestIdleUpTOffDlyCpl "Complement for MoFETC_cntrTestIdleUpTOffDly" UBYTE OneToOne 1 100 0.00 255.0 FORMAT "%5.1" ECU_ADDRESS 0x60018210 /end MEASUREMENT
/begin MEASUREMENT MoFETC_cntrTestTOffDly "debounce counter for reset of the diagnosis state for engine test" UBYTE OneToOne 1 100 0.00 255.0 FORMAT "%5.1" ECU_ADDRESS 0x60018950 /end MEASUREMENT
/begin MEASUREMENT MoFETC_cntrTestTOffDlyCpl "Complement for MoFETC_cntrTestTOffDly" UBYTE OneToOne 1 100 0.00 255.0 FORMAT "%5.1" ECU_ADDRESS 0x6001820F /end MEASUREMENT
/begin MEASUREMENT MoFETC_flgIdleUpstatus "Status of IdleUp for LET check" UBYTE B_TRUE 1 100 0.00 1.00000000000 BIT_MASK 0x2 FORMAT "%13.11" ECU_ADDRESS 0x60018953 /end MEASUREMENT
/begin MEASUREMENT MoFETC_flgMonDiagEnaPlausMsg "Flag to indicate Level 2 does not allow the LET request" UBYTE B_TRUE 1 100 0.00 1.00000000000 BIT_MASK 0x1 FORMAT "%13.11" ECU_ADDRESS 0x6000F92B /end MEASUREMENT
/begin MEASUREMENT MoFETC_flgPosEdg "Line End Tester Positive Edge" UBYTE B_TRUE 1 100 0.00 1.00000000000 BIT_MASK 0x1 FORMAT "%13.11" ECU_ADDRESS 0x60018953 /end MEASUREMENT
/begin MEASUREMENT MoFETC_stDiagTO "Status of Diagnostic Time Out provided by DiagCom" UBYTE dez 1 100 0.00 255.0 FORMAT "%5.1" ECU_ADDRESS 0x6000FBD6 /end MEASUREMENT
/begin MEASUREMENT MoFETC_stTest "Engine test status for function monitoring" UBYTE dez 1 100 0.00 255.0 FORMAT "%5.1" ECU_ADDRESS 0x6001894C /end MEASUREMENT
/begin MEASUREMENT MoFETC_stTestActv "Idle up test active status" UBYTE OneToOne 1 100 0.00 255.0 FORMAT "%5.1" ECU_ADDRESS 0x6001894F /end MEASUREMENT
/begin MEASUREMENT MoFETC_stTestActvCpl "Complement for MoFETC_stTestActv" UBYTE OneToOne 1 100 0.00 255.0 FORMAT "%5.1" ECU_ADDRESS 0x6001820E /end MEASUREMENT
/begin MEASUREMENT MoFETC_stTestCpl "Complement for MoFETC_stTest" UBYTE OneToOne 1 100 0.00 255.0 FORMAT "%5.1" ECU_ADDRESS 0x6001820D /end MEASUREMENT
/begin MEASUREMENT MoFETC_stTestPtd "Idle up permission status for current driving cycle" UBYTE OneToOne 1 100 0.00 255.0 FORMAT "%5.1" ECU_ADDRESS 0x6001894E /end MEASUREMENT
/begin MEASUREMENT MoFETC_stTestPtdCpl "Complement for MoFETC_stTestPtd" UBYTE OneToOne 1 100 0.00 255.0 FORMAT "%5.1" ECU_ADDRESS 0x6001820C /end MEASUREMENT
/begin MEASUREMENT MoFETC_stTstMsg "Engine test status from level 2 to level 1" UBYTE dez 1 100 0.00 255.0 FORMAT "%5.1" ECU_ADDRESS 0x6000FBD5 /end MEASUREMENT
/begin MEASUREMENT MoFExtInt_ctDebDCS "Debouncing counter for extention of MSR intervention, until the intervention of level 1 is ramped" UBYTE OneToOne 1 100 0.00 255.0 FORMAT "%5.1" ECU_ADDRESS 0x60018943 /end MEASUREMENT
/begin MEASUREMENT MoFExtInt_ctDebDCSCpl "Double storage of debouncing counter for extension of MSR intervention" UBYTE OneToOne 1 100 0.00 255.0 FORMAT "%5.1" ECU_ADDRESS 0x60018203 /end MEASUREMENT
/begin MEASUREMENT MoFExtInt_ctDebTSC "Debouncing counter for extension of gearbox intervention, until the intervention of level 1 is ramped" UBYTE OneToOne 1 100 0.00 255.0 FORMAT "%5.1" ECU_ADDRESS 0x60018942 /end MEASUREMENT
/begin MEASUREMENT MoFExtInt_ctDebTSCCpl "Double storage of debouncing counter for extension of gearbox intervention" UBYTE OneToOne 1 100 0.00 255.0 FORMAT "%5.1" ECU_ADDRESS 0x60018202 /end MEASUREMENT
/begin MEASUREMENT MoFExtInt_stDCSPtdMsg "Status of permissibility of MSR intervention from the level 2 to level 1" UBYTE OneToOne 1 100 0.00 255.0 FORMAT "%5.1" ECU_ADDRESS 0x6000FBD4 /end MEASUREMENT
/begin MEASUREMENT MoFExtInt_stTSCPtdMsg "Status of permissibility of gearbox intervention from the level 2 to level 1" UBYTE OneToOne 1 100 0.00 255.0 FORMAT "%5.1" ECU_ADDRESS 0x6000FBD3 /end MEASUREMENT
/begin MEASUREMENT MoFExtInt_tqCluPtdCoord "Permitted External intervention torque at clutch level" SWORD md_q0p1 1 100 -3276.800 3276.700 FORMAT "%8.3" ECU_ADDRESS 0x60018940 /end MEASUREMENT
/begin MEASUREMENT MoFExtInt_tqCluPtdCoordCpl "RAM data redundancy of MoFExtInt_tqCluPtdCoord" UWORD OneToOne 1 100 0.00 65535.00 FORMAT "%8.2" ECU_ADDRESS 0x60018200 /end MEASUREMENT
/begin MEASUREMENT MoFExtInt_tqCluPtdDCS "Permitted DCS torque intervention at clutch level" SWORD md_q0p1 1 100 -3276.800 3276.700 FORMAT "%8.3" ECU_ADDRESS 0x6001893E /end MEASUREMENT
/begin MEASUREMENT MoFExtInt_tqCluPtdDCSCpl "RAM data redundancy of MoFExtInt_tqCluPtdDCS" UWORD OneToOne 1 100 0.00 65535.00 FORMAT "%8.2" ECU_ADDRESS 0x600181FE /end MEASUREMENT
/begin MEASUREMENT MoFExtInt_tqCluPtdTSC "Permitted TSC torque intervention at clutch level" SWORD md_q0p1 1 100 -3276.800 3276.700 FORMAT "%8.3" ECU_ADDRESS 0x6001893C /end MEASUREMENT
/begin MEASUREMENT MoFExtInt_tqCluPtdTSCCpl "RAM data redundancy of MoFExtInt_tqCluPtdTSC" UWORD OneToOne 1 100 0.00 65535.00 FORMAT "%8.2" ECU_ADDRESS 0x600181FC /end MEASUREMENT
/begin MEASUREMENT MoFFrmCoorrCust_Rx_bbOut1Cpl "Complement of export bit basis for moffrmcoorrcust_rx" UBYTE OneToOne 1 100 0.00 255.0 FORMAT "%5.1" ECU_ADDRESS 0x600181FB /end MEASUREMENT
/begin MEASUREMENT MoFFrmCoorrCust_Rx_bbOutCpl "Complement for MoFFrmCoorrCust_Rx_bbOut" UBYTE OneToOne 1 100 0.00 255.0 FORMAT "%5.1" ECU_ADDRESS 0x600181FA /end MEASUREMENT
/begin MEASUREMENT MoFFrmCoorrCust_stAPPSensFail "APP sensor failure status from Lv1" UBYTE OneToOne 1 100 0.00 255.0 FORMAT "%5.1" ECU_ADDRESS 0x60018931 /end MEASUREMENT
/begin MEASUREMENT MoFFrmCoorrCust_stAPPSensFailCpl "Complement of APP sensor failure status from Lv1" UBYTE OneToOne 1 100 0.00 255.0 FORMAT "%5.1" ECU_ADDRESS 0x600181F1 /end MEASUREMENT
/begin MEASUREMENT MoFFrmCoorrCust_Tx_bbOutCpl "Complement of bit base of MoFFrmCoorCust_Tx in function monitoring" UBYTE OneToOne 1 100 0.00 255.0 FORMAT "%5.1" ECU_ADDRESS 0x600181F0 /end MEASUREMENT
/begin MEASUREMENT MoFFrmCoorrCust_Tx_flgAppErr "Flag to indicate APP error status" UBYTE B_TRUE 1 100 0.00 1.00000000000 BIT_MASK 0x1 FORMAT "%13.11" ECU_ADDRESS 0x60018930 /end MEASUREMENT
/begin MEASUREMENT MoFFrmCoorrCust_Tx_rAPP "Relative accelerator pedal position" UWORD Prc 1 100 0.00 799.9878 FORMAT "%8.4" ECU_ADDRESS 0x6001892E /end MEASUREMENT
/begin MEASUREMENT MoFFrmCoorrCust_Tx_rAPPCpl "Complement of relative accelerator pedal position" UWORD OneToOne 1 100 0.00 65535.00 FORMAT "%8.2" ECU_ADDRESS 0x600181EE /end MEASUREMENT
/begin MEASUREMENT MoFFrm_flgATCVTShiftN "Flag indicating N position" UBYTE B_TRUE 1 100 0.00 1.00000000000 BIT_MASK 0x1 FORMAT "%13.11" ECU_ADDRESS 0x6001893B /end MEASUREMENT
/begin MEASUREMENT MoFFrm_flgATCVTShiftP "Flag indicating P position" UBYTE B_TRUE 1 100 0.00 1.00000000000 BIT_MASK 0x2 FORMAT "%13.11" ECU_ADDRESS 0x6001893B /end MEASUREMENT
/begin MEASUREMENT MoFFrm_flgBrkHldActv "Flag Brake Hold active" UBYTE B_TRUE 1 100 0.00 1.00000000000 BIT_MASK 0x4 FORMAT "%13.11" ECU_ADDRESS 0x6001893B /end MEASUREMENT
/begin MEASUREMENT MoFFrm_flgComErrDCS "Info, of CAN communication error with DCS" UBYTE B_TRUE 1 100 0.00 1.00000000000 BIT_MASK 0x1 FORMAT "%13.11" ECU_ADDRESS 0x6001893A /end MEASUREMENT
/begin MEASUREMENT MoFFrm_flgCrsCtrlMaiSwt "Cruise Control Main switch status" UBYTE B_TRUE 1 100 0.00 1.00000000000 BIT_MASK 0x8 FORMAT "%13.11" ECU_ADDRESS 0x6001893B /end MEASUREMENT
/begin MEASUREMENT MoFFrm_flgCVTShiftSure "ndicates that shift position signal is confirmed" UBYTE B_TRUE 1 100 0.00 1.00000000000 BIT_MASK 0x10 FORMAT "%13.11" ECU_ADDRESS 0x6001893B /end MEASUREMENT
/begin MEASUREMENT MoFFrm_flgDCSPlus "Flag indicating DCS Plus is active" UBYTE B_TRUE 1 100 0.00 1.00000000000 BIT_MASK 0x20 FORMAT "%13.11" ECU_ADDRESS 0x6001893B /end MEASUREMENT
/begin MEASUREMENT MoFFrm_flgEBBBrkPedlOn "Brake Pedal On Flag. Indicates that driver pressing brake pedal" UBYTE B_TRUE 1 100 0.00 1.00000000000 BIT_MASK 0x40 FORMAT "%13.11" ECU_ADDRESS 0x6001893B /end MEASUREMENT
/begin MEASUREMENT MoFFrm_flgStbErr "Stabilisation Unit Error status" UBYTE B_TRUE 1 100 0.00 1.00000000000 BIT_MASK 0x8 FORMAT "%13.11" ECU_ADDRESS 0x6001893A /end MEASUREMENT
/begin MEASUREMENT MoFFrm_flgTMStrtEna "Flag indicating that disen- gaged gear information is transmitted" UBYTE B_TRUE 1 100 0.00 1.00000000000 BIT_MASK 0x80 FORMAT "%13.11" ECU_ADDRESS 0x6001893B /end MEASUREMENT
/begin MEASUREMENT MoFFrm_flgTqUpReqDCS "on CAN received info of increasing torque intervention" UBYTE B_TRUE 1 100 0.00 1.00000000000 BIT_MASK 0x2 FORMAT "%13.11" ECU_ADDRESS 0x6001893A /end MEASUREMENT
/begin MEASUREMENT MoFFrm_flgTqUpReqTra "From CAN received information of increasing torque request" UBYTE B_TRUE 1 100 0.00 1.00000000000 BIT_MASK 0x4 FORMAT "%13.11" ECU_ADDRESS 0x6001893A /end MEASUREMENT
/begin MEASUREMENT MoFFrm_Lib_DataPduRxInstance.cntrAlvErrDeb "Structure variable for Rx PDU / Alive counter debounce error calibration of RX Data Pdu" UWORD OneToOne 1 100 0.00 65535.00 FORMAT "%8.2" ECU_ADDRESS 0x60018918 /end MEASUREMENT
/begin MEASUREMENT MoFFrm_Lib_DataPduRxInstance.cntrAlvErrDebCpl "Structure variable for Rx PDU / complement of alive counter debounce error calibration of RX Data Pdu" UWORD OneToOne 1 100 0.00 65535.00 FORMAT "%8.2" ECU_ADDRESS 0x600181E0 /end MEASUREMENT
/begin MEASUREMENT MoFFrm_Lib_DataPduRxInstance.cntrAlvOld "Structure variable for Rx PDU / old alive counter calibration of RX Data Pdu" UBYTE OneToOne 1 100 0.00 255.0 FORMAT "%5.1" ECU_ADDRESS 0x6001891A /end MEASUREMENT
/begin MEASUREMENT MoFFrm_Lib_DataPduRxInstance.cntrAlvOldCpl "Structure variable for Rx PDU / Complement of old Alive counter calibration of RX Data Pdu" UBYTE OneToOne 1 100 0.00 255.0 FORMAT "%5.1" ECU_ADDRESS 0x600181E2 /end MEASUREMENT
/begin MEASUREMENT MoFFrm_Lib_DataPduRxInstance.cntrCrcErrDeb "Structure variable for Rx PDU / Alive counter error debounce calibration of RX Data Pdu" UWORD OneToOne 1 100 0.00 65535.00 FORMAT "%8.2" ECU_ADDRESS 0x6001891C /end MEASUREMENT
/begin MEASUREMENT MoFFrm_Lib_DataPduRxInstance.cntrCrcErrDebCpl "Structure variable for Rx PDU / Complement of old Alive counter calibration of RX Data Pdu" UWORD OneToOne 1 100 0.00 65535.00 FORMAT "%8.2" ECU_ADDRESS 0x600181E4 /end MEASUREMENT
/begin MEASUREMENT MoFFrm_Lib_DataPduRxInstance.cntrCycTi "Structure variable for Rx PDU / Alive counter debounce error calibration of RX Data Pdu" UWORD OneToOne 1 100 0.00 65535.00 FORMAT "%8.2" ECU_ADDRESS 0x6001891E /end MEASUREMENT
/begin MEASUREMENT MoFFrm_Lib_DataPduRxInstance.cntrCycTiCpl "Structure variable for Rx PDU / Counter cyclic calibration of RX Data Pdu" UWORD OneToOne 1 100 0.00 65535.00 FORMAT "%8.2" ECU_ADDRESS 0x600181E6 /end MEASUREMENT
/begin MEASUREMENT MoFFrm_Lib_DataPduRxInstance.cntrTiOutDeb "Structure variable for Rx PDU / Counter time out debounce of Rx data PDU" UWORD OneToOne 1 100 0.00 65535.00 FORMAT "%8.2" ECU_ADDRESS 0x60018920 /end MEASUREMENT
/begin MEASUREMENT MoFFrm_Lib_DataPduRxInstance.cntrTiOutDebCpl "Structure variable for Rx PDU / Complement of Counter time out debounce of Rx data PDU" UWORD OneToOne 1 100 0.00 65535.00 FORMAT "%8.2" ECU_ADDRESS 0x600181E8 /end MEASUREMENT
/begin MEASUREMENT MoFFrm_Lib_DataPduRxInstance.crcData "Structure variable for Rx PDU / CRC data of Rx data PDU" UWORD OneToOne 1 100 0.00 65535.00 FORMAT "%8.2" ECU_ADDRESS 0x60018922 /end MEASUREMENT
/begin MEASUREMENT MoFFrm_Lib_DataPduRxInstance.crcDataCpl "Structure variable for Rx PDU / Comlement of CRC data of Rx data PDU" UWORD OneToOne 1 100 0.00 65535.00 FORMAT "%8.2" ECU_ADDRESS 0x600181EA /end MEASUREMENT
/begin MEASUREMENT MoFFrm_Lib_DataPduRxInstance.flgPduUpd "Structure variable for Rx PDU / PDU update flag" UBYTE B_TRUE 1 100 0.00 1.00000000000 BIT_MASK 0x1 FORMAT "%13.11" ECU_ADDRESS 0x60018924 /end MEASUREMENT
/begin MEASUREMENT MoFFrm_Lib_DataPduRxInstance.flgPduUpdCpl "Structure variable for Rx PDU / complement of PDU update flag" UBYTE B_TRUE 1 100 0.00 1.00000000000 BIT_MASK 0x1 FORMAT "%13.11" ECU_ADDRESS 0x600181EC /end MEASUREMENT
/begin MEASUREMENT MoFFrm_Lib_DataPduTxInstance.cntrAlvOld "Structure variable for Tx PDU / old alive counter" UBYTE OneToOne 1 100 0.00 255.0 FORMAT "%5.1" ECU_ADDRESS 0x60018912 /end MEASUREMENT
/begin MEASUREMENT MoFFrm_Lib_DataPduTxInstance.cntrAlvOldCpl "Structure variable for Tx PDU / complement of oold alive counter" UBYTE OneToOne 1 100 0.00 255.0 FORMAT "%5.1" ECU_ADDRESS 0x600181DA /end MEASUREMENT
/begin MEASUREMENT MoFFrm_Lib_DataPduTxInstance.crcData "Structure variable for Tx PDU / crc data" UWORD OneToOne 1 100 0.00 65535.00 FORMAT "%8.2" ECU_ADDRESS 0x60018914 /end MEASUREMENT
/begin MEASUREMENT MoFFrm_Lib_DataPduTxInstance.crcDataCpl "Structure variable for Tx PDU / complement of crc data" UWORD OneToOne 1 100 0.00 65535.00 FORMAT "%8.2" ECU_ADDRESS 0x600181DC /end MEASUREMENT
/begin MEASUREMENT MoFFrm_Lib_DataPduTxInstance.flgAswTrigTx "Structure variable for Tx PDU / ASW Tx trigger flag" UBYTE B_TRUE 1 100 0.00 1.00000000000 BIT_MASK 0x1 FORMAT "%13.11" ECU_ADDRESS 0x60018916 /end MEASUREMENT
/begin MEASUREMENT MoFFrm_Lib_DataPduTxInstance.flgAswTrigTxCpl "Structure variable for Tx PDU / complement of ASW Tx trigger flag" UBYTE B_TRUE 1 100 0.00 1.00000000000 BIT_MASK 0x1 FORMAT "%13.11" ECU_ADDRESS 0x600181DE /end MEASUREMENT
/begin MEASUREMENT MoFFrm_rTqCnvrBoost "Torque Converter Boost Ratio from CAN" UWORD TransR 1 100 0.00 655.3500 FORMAT "%8.4" ECU_ADDRESS 0x60018936 /end MEASUREMENT
/begin MEASUREMENT MoFFrm_rTqCnvrBoostCpl "RAM data redundancy of MoFFrm_rTqCnvrBoost" UWORD OneToOne 1 100 0.00 65535.00 FORMAT "%8.2" ECU_ADDRESS 0x600181F6 /end MEASUREMENT
/begin MEASUREMENT MoFFrm_Rx_flgACCActv "ACC active status" UBYTE B_TRUE 1 100 0.00 1.00000000000 BIT_MASK 0x10 FORMAT "%13.11" ECU_ADDRESS 0x6001893A /end MEASUREMENT
/begin MEASUREMENT MoFFrm_Rx_stEcoModOn "ECo Mode" UBYTE OneToOne 1 100 0.00 1.000 FORMAT "%5.3" ECU_ADDRESS 0x60018939 /end MEASUREMENT
/begin MEASUREMENT MoFFrm_Rx_stEcoModOnCpl "Cpl for MoFFrm_Rx_stEcoModOn" UBYTE OneToOne 1 100 0.00 255.0 FORMAT "%5.1" ECU_ADDRESS 0x600181F9 /end MEASUREMENT
/begin MEASUREMENT MoFFrm_stCrsCtrlSwt "Cruise Control Switch states" UBYTE OneToOne 1 100 0.00 7.000 FORMAT "%5.3" ECU_ADDRESS 0x60018938 /end MEASUREMENT
/begin MEASUREMENT MoFFrm_stCrsCtrlSwtCpl "RAM data redundancy of MoFFrm_stCrsCtrlSwt" UBYTE OneToOne 1 100 0.00 255.0 FORMAT "%5.1" ECU_ADDRESS 0x600181F8 /end MEASUREMENT
/begin MEASUREMENT MoFFrm_tqCluTra "From CAN received transmission intervention torque on Clutch level" SWORD md_q0p1 1 100 -3276.800 3276.700 FORMAT "%8.3" ECU_ADDRESS 0x60018934 /end MEASUREMENT
/begin MEASUREMENT MoFFrm_tqCluTraCpl "RAM data redundancy of MoFFrm_tqCluTra" UWORD OneToOne 1 100 0.00 65535.00 FORMAT "%8.2" ECU_ADDRESS 0x600181F4 /end MEASUREMENT
/begin MEASUREMENT MoFFrm_tqWhlDCS "On CAN received DCS torque at wheel level" SWORD md_q0p1 1 100 -3276.800 3276.700 FORMAT "%8.3" ECU_ADDRESS 0x60018932 /end MEASUREMENT
/begin MEASUREMENT MoFFrm_tqWhlDCSCpl "RAM data redundancy of MoFFrm_tqWhlDCS" UWORD OneToOne 1 100 0.00 65535.00 FORMAT "%8.2" ECU_ADDRESS 0x600181F2 /end MEASUREMENT
/begin MEASUREMENT MoFTrqPtd_cntrDebRecupFrbdn "Debounce counter to inhibit recuperation in case of an active vehicle stability control intervention" UBYTE OneToOne 1 100 0.00 255.0 FORMAT "%5.1" ECU_ADDRESS 0x600189BD /end MEASUREMENT
/begin MEASUREMENT MoFTrqPtd_cntrDebRecupFrbdnCpl "RAM data redundancy of MoFTrqPtd_cntrDebRecupFrbdn" UBYTE OneToOne 1 100 0.00 255.0 FORMAT "%5.1" ECU_ADDRESS 0x6001827C /end MEASUREMENT
/begin MEASUREMENT MoFTrqPtd_facCmpAcs "Weighting factor for loss compensation of switchable losses" UBYTE fak_q0p01 1 100 0.00 2.550 FORMAT "%5.3" ECU_ADDRESS 0x6001898B /end MEASUREMENT
/begin MEASUREMENT MoFTrqPtd_facCmpAcsCpl "Complement of MoFTrqPtd_facCmpAcs" UBYTE OneToOne 1 100 0.00 255.0 FORMAT "%5.1" ECU_ADDRESS 0x6001824B /end MEASUREMENT
/begin MEASUREMENT MoFTrqPtd_facMaxCmp "Weighting factor for loss compensation of not switchable losses" UBYTE fak_q0p01 1 100 0.00 2.550 FORMAT "%5.3" ECU_ADDRESS 0x6001898A /end MEASUREMENT
/begin MEASUREMENT MoFTrqPtd_facMaxCmpCpl "Complement of MoFTrqPtd_facMaxCmp" UBYTE OneToOne 1 100 0.00 255.0 FORMAT "%5.1" ECU_ADDRESS 0x6001824A /end MEASUREMENT
/begin MEASUREMENT MoFTrqPtd_flgOperModRecupFrbdn "Recuperation in the function monitoring prohibited" UBYTE B_TRUE 1 100 0.00 1.00000000000 BIT_MASK 0x1 FORMAT "%13.11" ECU_ADDRESS 0x600189BC /end MEASUREMENT
/begin MEASUREMENT MoFTrqPtd_flgSelAltMod "Flag to reduce recuperation torque to a typical alternator mode" UBYTE B_TRUE 1 100 0.00 1.00000000000 BIT_MASK 0x2 FORMAT "%13.11" ECU_ADDRESS 0x600189BC /end MEASUREMENT
/begin MEASUREMENT MoFTrqPtd_flgSelBrkMin "Flag to select permitted minimum torque depending on driver brake demand" UBYTE B_TRUE 1 100 0.00 1.00000000000 BIT_MASK 0x1 FORMAT "%13.11" ECU_ADDRESS 0x60018976 /end MEASUREMENT
/begin MEASUREMENT MoFTrqPtd_tiOffDlyBrkRels "Turn off delay timer for Brake release condition" UBYTE t_q0p01 1 100 0.00 2.550 FORMAT "%5.3" ECU_ADDRESS 0x60018977 /end MEASUREMENT
/begin MEASUREMENT MoFTrqPtd_tiOffDlyBrkRelsCpl "Complement variable of MoFTrqPtd_tiOffDlyBrkRels" UBYTE OneToOne 1 100 0.00 255.0 FORMAT "%5.1" ECU_ADDRESS 0x60018236 /end MEASUREMENT
/begin MEASUREMENT MoFTrqPtd_tqAltTqMaxErr "Currently permitted typical alternator torque of e-machine (1-3 KW power)" SWORD md_q0p1 1 100 -3276.800 0.00 FORMAT "%8.3" ECU_ADDRESS 0x600189BA /end MEASUREMENT
/begin MEASUREMENT MoFTrqPtd_tqAltTqMaxErrCpl "RAM data redundancy of MoFTrqPtd_tqAltTqMaxErr" UWORD OneToOne 1 100 0.00 65535.00 FORMAT "%8.2" ECU_ADDRESS 0x6001827A /end MEASUREMENT
/begin MEASUREMENT MoFTrqPtd_tqDecExtIntOffs "permitted additional recuperation torque while external intervention" SWORD md_q0p1 1 100 -3276.800 3276.700 FORMAT "%8.3" ECU_ADDRESS 0x600189B8 /end MEASUREMENT
/begin MEASUREMENT MoFTrqPtd_tqDecExtIntOffsCpl "RAM redundancy of MoFTrqPtd_tqDecExtIntOffs" UWORD OneToOne 1 100 0.00 65535.00 FORMAT "%8.2" ECU_ADDRESS 0x60018278 /end MEASUREMENT
/begin MEASUREMENT MoFTrqPtd_tqMinSeld "Filtered permitted minimum e-machine torque including possible limitations, debounced errors or inhibited recuperation." SWORD md_q0p1 1 100 -3276.800 3276.700 FORMAT "%8.3" ECU_ADDRESS 0x600189B6 /end MEASUREMENT
/begin MEASUREMENT MoFTrqPtd_tqMinSeldCpl "RAM data redundancy of MoFTrqPtd_tqMinSeld" UWORD OneToOne 1 100 0.00 65535.00 FORMAT "%8.2" ECU_ADDRESS 0x60018276 /end MEASUREMENT
/begin MEASUREMENT MoFTrqPtd_tqMinSeldUnfild "Unfiltered permitted e-machine torque including possible limitations due to e-machine communication errors or already exceeded torque limits from L2" SWORD md_q0p1 1 100 -3276.800 0.00 FORMAT "%8.3" ECU_ADDRESS 0x600189B4 /end MEASUREMENT
/begin MEASUREMENT MoFTrqPtd_tqMinSeldUnfildCpl "RAM data redundancy of MoFTrqPtd_tqMinSeldUnfild" UWORD OneToOne 1 100 0.00 65535.00 FORMAT "%8.2" ECU_ADDRESS 0x60018274 /end MEASUREMENT
/begin MEASUREMENT MoFTrqPtd_tqRecupInhibDem "torque, used for ESP recuperation inhibit condition, based on driver demand" SWORD md_q0p1 1 100 -3276.800 3276.700 FORMAT "%8.3" ECU_ADDRESS 0x600189B2 /end MEASUREMENT
/begin MEASUREMENT MoFTrqPtd_tqRecupInhibDemCpl "RAM redundancy of MoFTrqPtd_tqRecupInhibDem" UWORD OneToOne 1 100 0.00 65535.00 FORMAT "%8.2" ECU_ADDRESS 0x60018272 /end MEASUREMENT
/begin MEASUREMENT MoFTrqPtd_tqVehPtdMinRaw "filtered permitted minimum e-machine torque on crankshaft level (inhibited recuperation not considered)" SWORD md_q0p1 1 100 -3276.800 3276.700 FORMAT "%8.3" ECU_ADDRESS 0x600189A8 /end MEASUREMENT
/begin MEASUREMENT MoFTrqPtd_tqVehPtdMinRawCpl "RAM data redundancy of MoFTrqPtd_tqVehPtdMinRaw" UWORD OneToOne 1 100 0.00 65535.00 FORMAT "%8.2" ECU_ADDRESS 0x60018270 /end MEASUREMENT
/begin MEASUREMENT MoFTrqPtd_tqVehPtdMinRawLo "Intermediate result of filtered permitted minimum torque (lower 16 bit)" UWORD OneToOne 1 100 0.00 65535.00 FORMAT "%8.2" ECU_ADDRESS 0x600189B0 /end MEASUREMENT
/begin MEASUREMENT MoFTrqPtd_tqVehPtdMinRawLoCpl "RAM data redundancy of MoFTrqPtd_tqVehPtdMinRawLo" UWORD OneToOne 1 100 0.00 65535.00 FORMAT "%8.2" ECU_ADDRESS 0x6001826E /end MEASUREMENT
/begin MEASUREMENT MoFTrqPtd_tqVehPtdWoInt "Permitted propulsion demand of the vehicle, without external interventions" SWORD md_q0p1 1 100 -3276.800 3276.700 FORMAT "%8.3" ECU_ADDRESS 0x600189A6 /end MEASUREMENT
/begin MEASUREMENT MoFTrqPtd_tqVehPtdWoIntCpl "RAM data redundancy for MoFCoVeh_tqVehPtdWoInt" UWORD OneToOne 1 100 0.00 65535.00 FORMAT "%8.2" ECU_ADDRESS 0x6001826C /end MEASUREMENT
/begin MEASUREMENT MoFTrqPtd_tqVehPtdWoIntvMin "Filtered permitted minimum e-machine torque without interventions" SWORD md_q0p1 1 100 -3276.800 3276.700 FORMAT "%8.3" ECU_ADDRESS 0x600189A4 /end MEASUREMENT
/begin MEASUREMENT MoFTrqPtd_tqVehPtdWoIntvMinCpl "RAM data redundancy of MoFTrqPtd_tqVehPtdWoIntvMin" UWORD OneToOne 1 100 0.00 65535.00 FORMAT "%8.2" ECU_ADDRESS 0x6001826A /end MEASUREMENT
/begin MEASUREMENT MoFTrqPtd_tqVehPtdWoIntvMinMsg "Filtered permitted minimum e-machine torque without interventions sent from Function monitoring to Level 1" SWORD md_q0p1 1 100 -3276.800 3276.700 FORMAT "%8.3" ECU_ADDRESS 0x60009882 /end MEASUREMENT
/begin MEASUREMENT MoFTrqPtd_tqVehPtdWoIntvMsg "filtered permitted sum torque without interventions in L2 on clutch level" SWORD md_q0p1 1 100 -3276.800 3276.700 FORMAT "%8.3" ECU_ADDRESS 0x60009880 /end MEASUREMENT
/begin MEASUREMENT MoFTrqPtd_tqVehPtdWoIntvRaw "Filtered permitted sum torque on clutch level without interventions in L2 as upper limit for L1 reference filter output" SWORD md_q0p1 1 100 -3276.800 3276.700 FORMAT "%8.3" ECU_ADDRESS 0x600189AE /end MEASUREMENT
/begin MEASUREMENT MoFTrqPtd_tqVehPtdWoIntvRawCpl "RAM data redundancy of MoFTrqPtd_tqVehPtdWoIntvRaw" UWORD OneToOne 1 100 0.00 65535.00 FORMAT "%8.2" ECU_ADDRESS 0x60018268 /end MEASUREMENT
/begin MEASUREMENT MoFTrqPtd_tqVehPtdWoIntvRawFildLo "intermediate result of filtered permitted sum torque (lower 16 bit)" UWORD OneToOne 1 100 0.00 65535.00 FORMAT "%8.2" ECU_ADDRESS 0x600189AC /end MEASUREMENT
/begin MEASUREMENT MoFTrqPtd_tqVehPtdWoIntvRawFildLoCpl "RAM data redundancy of MoFTrqPtd_tqVehPtdWoIntvRawFildLo" UWORD OneToOne 1 100 0.00 65535.00 FORMAT "%8.2" ECU_ADDRESS 0x60018266 /end MEASUREMENT
/begin MEASUREMENT MoFTrqPtd_tqVehPtdWoIntvRawUnfild "unfiltered permitted sum torque without interventions in L2 on clutch level" SWORD md_q0p1 1 100 -3276.800 3276.700 FORMAT "%8.3" ECU_ADDRESS 0x600189AA /end MEASUREMENT
/begin MEASUREMENT MoFTrqPtd_tqVehPtdWoIntvRawUnfildCpl "RAM data redundancy of MoFTrqPtd_tqVehPtdWoIntvRawUnfild" UWORD OneToOne 1 100 0.00 65535.00 FORMAT "%8.2" ECU_ADDRESS 0x60018264 /end MEASUREMENT
/begin MEASUREMENT MoFTrqPtd_tqWhlBrkMin_MP "Minimum wheel torque in function monitoring with brake demand by driver" SWORD md_q1p6 1 100 -52428.80 52427.20 FORMAT "%8.2" ECU_ADDRESS 0x7000A152 /end MEASUREMENT
/begin MEASUREMENT MoFTrqPtd_tqWhlDrvDem "requested torque from driver in the function monitoring" SWORD md_q1p6 1 100 -52428.80 52427.20 FORMAT "%8.2" ECU_ADDRESS 0x60018978 /end MEASUREMENT
/begin MEASUREMENT MoFTrqPtd_tqWhlDrvDemCpl "duplicate storage for MoFTrqPtd_tqWhlDrvDem" UWORD OneToOne 1 100 0.00 65535.00 FORMAT "%8.2" ECU_ADDRESS 0x60018238 /end MEASUREMENT
/begin MEASUREMENT MoFTrqPtd_tqWhlMin "Minimum total wheel torque in function monitoring" SWORD md_q1p6 1 100 -52428.80 52427.20 FORMAT "%8.2" ECU_ADDRESS 0x60018974 /end MEASUREMENT
/begin MEASUREMENT MoFTrqPtd_tqWhlMinCpl "RAM-data redundancy for MoFTrqPtd_tqWhlMin" UWORD OneToOne 1 100 0.00 65535.00 FORMAT "%8.2" ECU_ADDRESS 0x60018234 /end MEASUREMENT
/begin MEASUREMENT MoFTrqPtd_tqWhlMin_MP "Minimum wheel torque in function monitoring without driver brake demand" SWORD md_q1p6 1 100 -52428.80 52427.20 FORMAT "%8.2" ECU_ADDRESS 0x7000A150 /end MEASUREMENT
/begin MEASUREMENT MoF_bAirFlChkDisbl "State air-fuel-check disabled in function monitoring" UBYTE B_TRUE 1 100 0.00 1.00000000000 BIT_MASK 0x4 FORMAT "%13.11" ECU_ADDRESS 0x6001894D /end MEASUREMENT
/begin MEASUREMENT MoF_ctTstESpd "counter for putting of the test flag in diagnosis of engine speed plausibility check" UBYTE OneToOne 1 100 0.00 255.0 FORMAT "%5.1" ECU_ADDRESS 0x6000B70B /end MEASUREMENT
/begin MEASUREMENT MoF_nEng "engine speed in the function monitoring" UBYTE nmot_q40 1 100 0.00 10200. FORMAT "%5.0" ECU_ADDRESS 0x60018968 /end MEASUREMENT
/begin MEASUREMENT MoF_nEngCpl "RAM data redundancy for MoF_nEng" UBYTE OneToOne 1 100 0.00 255.0 FORMAT "%5.1" ECU_ADDRESS 0x60018229 /end MEASUREMENT
/begin MEASUREMENT MoF_nEng_DST_result "result of distribution search in MoF_nEng_DST" SLONG dez 1 100 -2147483648.00 2147483647.00 FORMAT "%13.2" ECU_ADDRESS 0x60018958 /end MEASUREMENT
/begin MEASUREMENT MoF_nEng_DST_result_Cpl "RAM data redundancy for MoF_nEng_DST_result" ULONG OneToOne 1 100 0.00 4294967295.00 FORMAT "%13.2" ECU_ADDRESS 0x60018220 /end MEASUREMENT
/begin MEASUREMENT MoF_phiGT1Diff_mp "angle counter difference in engine speed monitoring" ULONG kw_sw_q0p0219 1 100 0.00 94371839.9780 FORMAT "%13.4" ECU_ADDRESS 0x7000A130 /end MEASUREMENT
/begin MEASUREMENT MoF_phiGT1Last "angle watch-state from the previous call of the engine speed monitoring" ULONG OneToOne 1 100 0.00 4294967295.00 FORMAT "%13.2" ECU_ADDRESS 0x60018964 /end MEASUREMENT
/begin MEASUREMENT MoF_phiGT1LastCpl "RAM data redundancy for MoF_phiGT1Last" ULONG OneToOne 1 100 0.00 4294967295.00 FORMAT "%13.2" ECU_ADDRESS 0x6001821C /end MEASUREMENT
/begin MEASUREMENT MoF_rAMPTLam "Lambda divided by air mass flow in the function monitoring" UBYTE m_ub_b1020 1 100 0.00 1020. FORMAT "%5.0" ECU_ADDRESS 0x600189F4 /end MEASUREMENT
/begin MEASUREMENT MoF_rAMPTLamCpl "RAM data redundancy for MoF_rAMPTLam" UBYTE OneToOne 1 100 0.00 255.0 FORMAT "%5.1" ECU_ADDRESS 0x600182B4 /end MEASUREMENT
/begin MEASUREMENT MoF_rAPP "relative pedal position in function monitoring" UBYTE rel_q0p39 1 100 0.00 99.61 FORMAT "%5.2" ECU_ADDRESS 0x600189DC /end MEASUREMENT
/begin MEASUREMENT MoF_rAPPCpl "RAM data redundancy for MoF_rAPP" UBYTE OneToOne 1 100 0.00 255.0 FORMAT "%5.1" ECU_ADDRESS 0x6001829C /end MEASUREMENT
/begin MEASUREMENT MoF_rAPP_DST_result "result of distribution search in MoF_rAPP_DST" SLONG dez 1 100 -2147483648.00 2147483647.00 FORMAT "%13.2" ECU_ADDRESS 0x600189D0 /end MEASUREMENT
/begin MEASUREMENT MoF_rAPP_DST_resultCpl "Double storage for MoF_rAPP_DST_result" ULONG OneToOne 1 100 0.00 4294967295.00 FORMAT "%13.2" ECU_ADDRESS 0x60018290 /end MEASUREMENT
/begin MEASUREMENT MoF_tiCurrDiff_mp "system time difference in engine speed monitoring" ULONG OneToOne 1 100 0.00 4294967295.00 FORMAT "%13.2" ECU_ADDRESS 0x7000A12C /end MEASUREMENT
/begin MEASUREMENT MoF_tiDiff_mp "time difference in engine speed monitoring" ULONG t_q1p0_us 1 100 0.00 4294967295.00 FORMAT "%13.2" ECU_ADDRESS 0x7000A128 /end MEASUREMENT
/begin MEASUREMENT MoF_tiGradNEngErrDeb "Debounce time for engine speed gradient in functione monitoring" UBYTE t_q0p01 1 100 0.00 2.550 FORMAT "%5.3" ECU_ADDRESS 0x6001896C /end MEASUREMENT
/begin MEASUREMENT MoF_tiGradNEngErrDebCpl "RAM data redundancy for MoF_tiGradNEngErrDeb" UBYTE OneToOne 1 100 0.00 255.0 FORMAT "%5.1" ECU_ADDRESS 0x60018228 /end MEASUREMENT
/begin MEASUREMENT MoF_tiLast "system time from the previous call of the engine speed monitoring" ULONG OneToOne 1 100 0.00 4294967295.00 FORMAT "%13.2" ECU_ADDRESS 0x60018960 /end MEASUREMENT
/begin MEASUREMENT MoF_tiLastCpl "RAM data redundancy for MoF_tiLast" ULONG OneToOne 1 100 0.00 4294967295.00 FORMAT "%13.2" ECU_ADDRESS 0x60018218 /end MEASUREMENT
/begin FUNCTION MoFAirFl_Mode "37.0.0    Function Monitoring: Operation mode"
 /begin DEF_CHARACTERISTIC MoFAirFl_cntrErrDebMaxMode_C MoFAirFl_cntrRstMaxMode_C MoFAirFl_nErrHndlgActvnMode_C MoFAirFl_ratLamExpdMaxStoi_C MoFAirFl_ratLamExpdMinStoi_C /end DEF_CHARACTERISTIC
 /begin REF_CHARACTERISTIC MoFAirFl_stCfgMoFAirFl_C MoFAirFl_stOperModHks_C MoFAirFl_stOperModHom_C MoFAirFl_stOperModHsp_C /end REF_CHARACTERISTIC
 /begin IN_MEASUREMENT MoFAirFl_InjTmngIfClass_V4_I.bdemod MoFAirFl_InjTmngIfClass_V4_I.bdemodRdnt MoFAirFl_InjTmngIfClass_V4_I.cntrCylAdv MoFAirFl_InjTmngIfClass_V4_I.cntrCylAdvRdnt MoFAirFl_InjTmngIfClass_V4_I.stInjTmng MoFAirFl_InjTmngIfClass_V4_I.stInjTmngRdnt MoFAirFl_InjTmngIfClass_V4_I.zzylh MoFAirFl_InjTmngIfClass_V4_I.zzylhRdnt MoFAirFl_InjTmngIfClass_V4_I.zzylnsp MoFAirFl_InjTmngIfClass_V4_I.zzylnspRdnt MoFAirFl_InjTmngIfClass_V4_I.zzyls MoFAirFl_InjTmngIfClass_V4_I.zzylsRdnt MoFAirFl_MixMngtIfClass_V4_I.B_afimreq MoFAirFl_MixMngtIfClass_V4_I.facLamCtlPfiAry MoFAirFl_MixMngtIfClass_V4_I.facLamCtlPfiAryRdnt MoFAirFl_MixMngtIfClass_V4_I.facLamCtlPfiBkupAry MoFAirFl_MixMngtIfClass_V4_I.facMixCorrnLivc MoFAirFl_MixMngtIfClass_V4_I.facPcPfiRest MoFAirFl_MixMngtIfClass_V4_I.facPcRest MoFAirFl_MixMngtIfClass_V4_I.facPrtnPfi MoFAirFl_MixMngtIfClass_V4_I.facPrtnPfiAry MoFAirFl_MixMngtIfClass_V4_I.facPrtnPfiAryRdnt MoFAirFl_MixMngtIfClass_V4_I.facPrtnPfiBkupAry MoFAirFl_MixMngtIfClass_V4_I.ffuevali MoFAirFl_MixMngtIfClass_V4_I.ffuevalipfi MoFAirFl_MixMngtIfClass_V4_I.fkrkAry MoFAirFl_MixMngtIfClass_V4_I.fkrkPfiAry MoFAirFl_MixMngtIfClass_V4_I.fkrkPfiAryRdnt MoFAirFl_MixMngtIfClass_V4_I.fnsad MoFAirFl_MixMngtIfClass_V4_I.fr MoFAirFl_MixMngtIfClass_V4_I.fr2 MoFAirFl_MixMngtIfClass_V4_I.fragdi MoFAirFl_MixMngtIfClass_V4_I.fragdi2 MoFAirFl_MixMngtIfClass_V4_I.frapfi MoFAirFl_MixMngtIfClass_V4_I.frapfi2 MoFAirFl_MixMngtIfClass_V4_I.lamsbg MoFAirFl_MixMngtIfClass_V4_I.lamsbg2 MoFAirFl_MixMngtIfClass_V4_I.rCtlPriB1 MoFAirFl_MixMngtIfClass_V4_I.rCtlPriB2 MoFAirFl_MixMngtIfClass_V4_I.ratFuMCylInd MoFAirFl_MixMngtIfClass_V4_I.ratFuMGdi MoFAirFl_MixMngtIfClass_V4_I.ratFuMGdiBnk2 MoFAirFl_MixMngtIfClass_V4_I.ratFuMLivc MoFAirFl_MixMngtIfClass_V4_I.ratFuMLivcRdnt MoFAirFl_MixMngtIfClass_V4_I.ratFuMPfi MoFAirFl_MixMngtIfClass_V4_I.ratFuMPfiBnk2 MoFAirFl_MixMngtIfClass_V4_I.ratFuPrtnPfiInjAry MoFAirFl_MixMngtIfClass_V4_I.ratFuPrtnPfiInjAryRdnt MoFAirFl_MixMngtIfClass_V4_I.ratFuPrtnPfiInjBkupAry MoFAirFl_MixMngtIfClass_V4_I.ratPrdcAirPrtnPfiAry MoFAirFl_MixMngtIfClass_V4_I.ratPrdcAirPrtnPfiAryRdnt MoFAirFl_MixMngtIfClass_V4_I.ratPrdcAirPrtnPfiBkupAry MoFAirFl_MixMngtIfClass_V4_I.rkagdi MoFAirFl_MixMngtIfClass_V4_I.rkagdi2 MoFAirFl_MixMngtIfClass_V4_I.rkapfi MoFAirFl_MixMngtIfClass_V4_I.rkapfi2 MoFAirFl_MixMngtIfClass_V4_I.rkausg MoFAirFl_MixMngtIfClass_V4_I.rkte MoFAirFl_MixMngtIfClass_V4_I.rkteBnk1 MoFAirFl_MixMngtIfClass_V4_I.rkteBnk2 MoFAirFl_MixMngtIfClass_V4_I.rkukg MoFAirFl_MixMngtIfClass_V4_I.rkukgpfi MoFAirFl_MixMngtIfClass_V4_I.rlfg MoFAirFl_MixMngtIfClass_V4_I.rlfgBnk1 MoFAirFl_MixMngtIfClass_V4_I.rlfgBnk2 MoFAirFl_MixMngtIfClass_V4_I.rlp MoFAirFl_MixMngtIfClass_V4_I.rlpBnk1 MoFAirFl_MixMngtIfClass_V4_I.rlpBnk2 MoFAirFl_MixMngtIfClass_V4_I.rlrext MoFAirFl_MixMngtIfClass_V4_I.rlrextBnk1 MoFAirFl_MixMngtIfClass_V4_I.rlrextBnk2 MoFAirFl_MixMngtIfClass_V4_I.rlrint MoFAirFl_MixMngtIfClass_V4_I.rlrintBnk1 MoFAirFl_MixMngtIfClass_V4_I.rlrintBnk2 MoFESpd_nEng MoF_bAirFlChkDisbl Mo_bPostDrv Mo_bPreDrv Mo_ctRst Mo_ctRstCpl Mo_stCplChk Mo_stMoC Mo_stMoCCpl Mo_stMoF Mo_stMoFCpl /end IN_MEASUREMENT
 /begin OUT_MEASUREMENT MoFAirFl_flgEomStoiReqMsg MoFAirFl_flgIrrvErrModeMsg MoFAirFl_flgTestModeMsg MoFAirFl_stErrModeMsg /end OUT_MEASUREMENT
 /begin LOC_MEASUREMENT MoFAirFlMode_flgClr MoFAirFl_cntrDiagDebMode MoFAirFl_cntrErrDebMode MoFAirFl_cntrErrDebModeCpl MoFAirFl_stErrMode MoFAirFl_stErrModeCpl /end LOC_MEASUREMENT
 FUNCTION_VERSION "37.0.0" /end FUNCTION
/begin FUNCTION MoFAir_FilgPrdc "52.0.0    Function Monitoring: Relative air charge predicted"
 /begin DEF_CHARACTERISTIC MoFAirFl_cntrErrDebMaxFilgPrdc_C MoFAirFl_cntrFillgHiDeDlyMax_C MoFAirFl_cntrRstMaxFilgPrdc_C MoFAirFl_facCnvnRatFillgMFlow_C MoFAirFl_nErrHndlgActvnFilgPrdc_C MoFAirFl_ofsRatFillgPrdc_C MoFAirFl_ratLamMaxMFlow_C MoFAirFl_ratLamMinMFlow_C /end DEF_CHARACTERISTIC
 /begin REF_CHARACTERISTIC MoFAirFl_stCfgMoFAirFl_C /end REF_CHARACTERISTIC
 /begin IN_MEASUREMENT MoFAirFl_CdaIfClass_V4_I.bHemInjSync MoFAirFl_CdaIfClass_V4_I.bHmbv MoFAirFl_CdaIfClass_V4_I.bHmbzylsy MoFAirFl_CdaIfClass_V4_I.hmbcpl MoFAirFl_etaInjCtOff MoFAirFl_MixMngtIfClass_V4_I.B_afimreq MoFAirFl_MixMngtIfClass_V4_I.facLamCtlPfiAry MoFAirFl_MixMngtIfClass_V4_I.facLamCtlPfiAryRdnt MoFAirFl_MixMngtIfClass_V4_I.facLamCtlPfiBkupAry MoFAirFl_MixMngtIfClass_V4_I.facMixCorrnLivc MoFAirFl_MixMngtIfClass_V4_I.facPcPfiRest MoFAirFl_MixMngtIfClass_V4_I.facPcRest MoFAirFl_MixMngtIfClass_V4_I.facPrtnPfi MoFAirFl_MixMngtIfClass_V4_I.facPrtnPfiAry MoFAirFl_MixMngtIfClass_V4_I.facPrtnPfiAryRdnt MoFAirFl_MixMngtIfClass_V4_I.facPrtnPfiBkupAry MoFAirFl_MixMngtIfClass_V4_I.ffuevali MoFAirFl_MixMngtIfClass_V4_I.ffuevalipfi MoFAirFl_MixMngtIfClass_V4_I.fkrkAry MoFAirFl_MixMngtIfClass_V4_I.fkrkPfiAry MoFAirFl_MixMngtIfClass_V4_I.fkrkPfiAryRdnt MoFAirFl_MixMngtIfClass_V4_I.fnsad MoFAirFl_MixMngtIfClass_V4_I.fr MoFAirFl_MixMngtIfClass_V4_I.fr2 MoFAirFl_MixMngtIfClass_V4_I.fragdi MoFAirFl_MixMngtIfClass_V4_I.fragdi2 MoFAirFl_MixMngtIfClass_V4_I.frapfi MoFAirFl_MixMngtIfClass_V4_I.frapfi2 MoFAirFl_MixMngtIfClass_V4_I.lamsbg MoFAirFl_MixMngtIfClass_V4_I.lamsbg2 MoFAirFl_MixMngtIfClass_V4_I.rCtlPriB1 MoFAirFl_MixMngtIfClass_V4_I.rCtlPriB2 MoFAirFl_MixMngtIfClass_V4_I.ratFuMCylInd MoFAirFl_MixMngtIfClass_V4_I.ratFuMGdi MoFAirFl_MixMngtIfClass_V4_I.ratFuMGdiBnk2 MoFAirFl_MixMngtIfClass_V4_I.ratFuMLivc MoFAirFl_MixMngtIfClass_V4_I.ratFuMLivcRdnt MoFAirFl_MixMngtIfClass_V4_I.ratFuMPfi MoFAirFl_MixMngtIfClass_V4_I.ratFuMPfiBnk2 MoFAirFl_MixMngtIfClass_V4_I.ratFuPrtnPfiInjAry MoFAirFl_MixMngtIfClass_V4_I.ratFuPrtnPfiInjAryRdnt MoFAirFl_MixMngtIfClass_V4_I.ratFuPrtnPfiInjBkupAry MoFAirFl_MixMngtIfClass_V4_I.ratPrdcAirPrtnPfiAry MoFAirFl_MixMngtIfClass_V4_I.ratPrdcAirPrtnPfiAryRdnt MoFAirFl_MixMngtIfClass_V4_I.ratPrdcAirPrtnPfiBkupAry MoFAirFl_MixMngtIfClass_V4_I.rkagdi MoFAirFl_MixMngtIfClass_V4_I.rkagdi2 MoFAirFl_MixMngtIfClass_V4_I.rkapfi MoFAirFl_MixMngtIfClass_V4_I.rkapfi2 MoFAirFl_MixMngtIfClass_V4_I.rkausg MoFAirFl_MixMngtIfClass_V4_I.rkte MoFAirFl_MixMngtIfClass_V4_I.rkteBnk1 MoFAirFl_MixMngtIfClass_V4_I.rkteBnk2 MoFAirFl_MixMngtIfClass_V4_I.rkukg MoFAirFl_MixMngtIfClass_V4_I.rkukgpfi MoFAirFl_MixMngtIfClass_V4_I.rlfg MoFAirFl_MixMngtIfClass_V4_I.rlfgBnk1 MoFAirFl_MixMngtIfClass_V4_I.rlfgBnk2 MoFAirFl_MixMngtIfClass_V4_I.rlp MoFAirFl_MixMngtIfClass_V4_I.rlpBnk1 MoFAirFl_MixMngtIfClass_V4_I.rlpBnk2 MoFAirFl_MixMngtIfClass_V4_I.rlrext MoFAirFl_MixMngtIfClass_V4_I.rlrextBnk1 MoFAirFl_MixMngtIfClass_V4_I.rlrextBnk2 MoFAirFl_MixMngtIfClass_V4_I.rlrint MoFAirFl_MixMngtIfClass_V4_I.rlrintBnk1 MoFAirFl_MixMngtIfClass_V4_I.rlrintBnk2 MoFESpd_nEng MoF_bAirFlChkDisbl Mo_bPostDrv Mo_bPreDrv Mo_ctRst Mo_ctRstCpl Mo_stCplChk Mo_stMoC Mo_stMoCCpl Mo_stMoF Mo_stMoFCpl /end IN_MEASUREMENT
 /begin OUT_MEASUREMENT MoFAirFl_flgIrrvErrFilgPrdcMsg MoFAirFl_flgTestFilgPrdcMsg MoFAirFl_ratFillg MoFAirFl_ratFillgFrsh MoFAirFl_ratFillgTot MoF_rAMPTLam /end OUT_MEASUREMENT
 /begin LOC_MEASUREMENT MoFAirFilgPrdc_flgClr MoFAirFl_cntrDiagDebFilgPrdc MoFAirFl_cntrErrDebFilgPrdc MoFAirFl_cntrErrDebFilgPrdcCpl MoFAirFl_cntrFillgHiDeDly MoFAirFl_cntrFillgHiDeDlyCpl MoFAirFl_ratFillgBnk1 MoFAirFl_ratFillgBnk1Cpl MoFAirFl_ratFillgBnk2 MoFAirFl_ratFillgBnk2Cpl MoFAirFl_ratFillgCpl MoFAirFl_ratFillgFrshCpl MoFAirFl_ratFillgPrdc MoFAirFl_ratFillgPrdcCpl MoFAirFl_ratFillgTotCpl MoF_rAMPTLamCpl /end LOC_MEASUREMENT
 FUNCTION_VERSION "52.0.0" /end FUNCTION
/begin FUNCTION MoFAPP_Co "120.0.0   Function Monitoring: Accelerator pedal position"
 /begin DEF_CHARACTERISTIC MoFAPP_cntrDeb_C MoFAPP_cntrRst_C MoFAPP_cntrTestAPP_C MoFAPP_swtMinSel_C MoFAPP_uFL_C MoFAPP_uLoLim_C MoFAPP_uMaxDiffFL_C MoFAPP_uMaxDiffPL_C /end DEF_CHARACTERISTIC
 /begin IN_MEASUREMENT APP_stSigSrc MoCADC_bDef MoCADC_bNTPActv MoFBrk_flgBrkApp Mo_ctRst Mo_ctRstCpl Mo_stCplChk Mo_stMoC Mo_stMoCCpl Mo_stMoF Mo_stMoFCpl /end IN_MEASUREMENT
 /begin OUT_MEASUREMENT MoFAPP_flgIrrvErrMsg MoFAPP_flgPlausErrDeb MoFAPP_flgTestMsg MoFAPP_stAPPMsg MoFAPP_stLimpMsg MoFAPP_stSigSrc MoFAPP_uHiResl /end OUT_MEASUREMENT
 /begin LOC_MEASUREMENT MoFAPPCo_bbLoc1Cpl MoFAPPCo_bbOut1Cpl MoFAPP_cntrDeb MoFAPP_cntrDebCpl MoFAPP_cntrTestAPP MoFAPP_flgAdcErr1 MoFAPP_flgAdcErr2 MoFAPP_flgClr MoFAPP_flgExtErr MoFAPP_flgNTPRel MoFAPP_flgPlausErr MoFAPP_stSigSrcCpl MoFAPP_uApp1 MoFAPP_uApp1Cpl MoFAPP_uApp2 MoFAPP_uApp2Cpl MoFAPP_uHiReslCpl /end LOC_MEASUREMENT
 FUNCTION_VERSION "120.0.0" /end FUNCTION
/begin FUNCTION MoFAPP_Rel "28.0.0    Function Monitoring: Relative accelerator pedal position"
 /begin DEF_CHARACTERISTIC MoFAPP_ratApp_DST MoFAPP_ratHiResl_DST MoFAPP_uHiReslMaxLimp_C MoFAPP_uHiReslMax_C MoFAPP_uHiReslMinLimp_C MoFAPP_uHiReslMin_C MoF_rAPP_DST /end DEF_CHARACTERISTIC
 /begin IN_MEASUREMENT MoFAPP_stSigSrc MoFAPP_uHiResl Mo_stCplChk Mo_stMoC Mo_stMoCCpl /end IN_MEASUREMENT
 /begin OUT_MEASUREMENT MoFAPP_ratApp_DST_result MoFAPP_ratHiResl MoFAPP_ratHiResl_DST_result MoF_rAPP MoF_rAPP_DST_result /end OUT_MEASUREMENT
 /begin LOC_MEASUREMENT MoFAPP_ratApp_DST_resultCpl MoFAPP_ratHiReslCpl MoFAPP_ratHiResl_DST_resultCpl MoF_rAPPCpl MoF_rAPP_DST_resultCpl /end LOC_MEASUREMENT
 FUNCTION_VERSION "28.0.0" /end FUNCTION
/begin FUNCTION MoFBrk_Co "179.0.1   Function Monitoring: Brake"
 /begin DEF_CHARACTERISTIC MoFBrk_cntrBrkAcc_C MoFBrk_cntrBrkApp_C MoFBrk_cntrBrkCrsCtrl_C MoFBrk_cntrBrkMai_C MoFBrk_cntrBrkRdnt_C MoFBrk_flgEnaFrmEBBA_C /end DEF_CHARACTERISTIC
 /begin IN_MEASUREMENT MoFFrm_flgEBBBrkPedlOn Mo_stCplChk Mo_stMoC Mo_stMoCCpl /end IN_MEASUREMENT
 /begin OUT_MEASUREMENT MoFBrk_flgBrk MoFBrk_flgBrkAcc MoFBrk_flgBrkApp MoFBrk_flgBrkCrsCtrl MoFBrk_flgEBBBrkPedlOn MoFBrk_flgMaiBrk MoFBrk_flgRdntBrk /end OUT_MEASUREMENT
 /begin LOC_MEASUREMENT MoFBrkCo_bbLoc1Cpl MoFBrkCo_bbOut1Cpl MoFBrk_cntrBrkDeb MoFBrk_cntrBrkDebCpl MoFBrk_cntrBrkMaiDeb MoFBrk_cntrBrkMaiDebCpl MoFBrk_cntrBrkRdntDeb MoFBrk_cntrBrkRdntDebCpl MoFBrk_flgDioMaiBrkErr MoFBrk_flgDioRdntBrkErr /end LOC_MEASUREMENT
 FUNCTION_VERSION "179.0.1" /end FUNCTION
/begin FUNCTION MoFCCtl_Co "131.0.0   Function Monitoring: Cruise control"
 /begin DEF_CHARACTERISTIC MoFCCtl_cntrCrsCtrlActvDeb_C MoFCCtl_ratAppPsd_C MoFCCtl_swtEnaAppPsd_C MoFCCtl_swtEnblMon_C /end DEF_CHARACTERISTIC
 /begin IN_MEASUREMENT MoFAPP_ratHiResl MoFFrm_flgCrsCtrlMaiSwt MoFFrm_stCrsCtrlSwt MoFStrt_flgBrkHldActv Mo_stCplChk Mo_stMoC Mo_stMoCCpl /end IN_MEASUREMENT
 /begin OUT_MEASUREMENT MoFCCtl_flgAct MoFCCtl_flgShOff /end OUT_MEASUREMENT
 /begin LOC_MEASUREMENT MoFCCtlCo_bbLoc1Cpl MoFCCtlCo_bbLoc2Cpl MoFCCtlCo_bbOut1Cpl MoFCCtl_cntrCrsCtrlActvDeb MoFCCtl_cntrCrsCtrlActvDebCpl MoFCCtl_flgAppLoDetn MoFCCtl_flgAppPsdDetn MoFCCtl_flgBtnActvResu MoFCCtl_flgBtnActvSet MoFCCtl_flgBtnLoDetnResu MoFCCtl_flgBtnLoDetnSet MoFCCtl_flgCnclSwt MoFCCtl_flgCrsCtrlVldSig MoFCCtl_flgErrHw MoFCCtl_flgFallEdgeResu MoFCCtl_flgFallEdgeSet MoFCCtl_flgMaiSwt MoFCCtl_flgResuSwt MoFCCtl_flgSetSwt MoFCCtl_flgTipDwnLo MoFCCtl_flgTipUpLo /end LOC_MEASUREMENT
 FUNCTION_VERSION "131.0.0" /end FUNCTION
/begin FUNCTION MoFClth_Co "84.0.0    Function Monitoring: Clutch"
 /begin DEF_CHARACTERISTIC MoFClth_cntrBotmCluTurnOffDly_C MoFClth_cntrBotmCluTurnOnDly_C MoFClth_cntrT15OnDeb_C MoFClth_cntrTopCluTurnOffDly_C MoFClth_cntrTopCluTurnOnDly_C MoFClth_flgSwt_C /end DEF_CHARACTERISTIC
 /begin IN_MEASUREMENT Mo_stCplChk Mo_stMoC Mo_stMoCCpl /end IN_MEASUREMENT
 /begin OUT_MEASUREMENT MoFClth_flgClthBot MoFClth_flgClthTop /end OUT_MEASUREMENT
 /begin LOC_MEASUREMENT MoFClthCo_bbLoc1Cpl MoFClthCo_bbOut1Cpl MoFClth_cntrBotmCluDeb MoFClth_cntrBotmCluDebCpl MoFClth_cntrT15OnDeb MoFClth_cntrT15OnDebCpl MoFClth_cntrTopCluDeb MoFClth_cntrTopCluDebCpl MoFClth_flgCluBotRaw MoFClth_flgCluTopRaw /end LOC_MEASUREMENT
 FUNCTION_VERSION "84.0.0" /end FUNCTION
/begin FUNCTION MoFCoVeh_Co "50.1.0    Function Monitoring: Torque coordination vehicle"
 /begin DEF_CHARACTERISTIC MoFTrqPtd_cntrDebRecupFrbdn_C MoFTrqPtd_tiFltTqPtdVehMax_C MoFTrqPtd_tiFltTqPtdVehMin_C MoFTrqPtd_tqAltMaxABSErr_C MoFTrqPtd_tqAltTqMaxErr_T MoFTrqPtd_tqDecExtIntOffsMax_C MoFTrqPtd_tqRecupInhibOffs_C /end DEF_CHARACTERISTIC
 /begin IN_MEASUREMENT ASDrf_trqClthFlt LsComp_tqSwilLossNotFild MoFDCS_flgComErrESP MoFDCS_flgDecIntvActv MoFDCS_flgIntvActv MoFDCS_tqCluPtd MoFDrAs_trqPtd MoFESpd_nEng MoFSpdG_tqPtd MoFTra_flgDecIntvActv MoFTrqCmp_flgIrrvErrMax MoFTrqCmp_flgIrrvErrMin MoFTrqPtd_facCmpSpdGovr MoFTrqPtd_tqCmpSwilLoss MoFTrqPtd_tqWhlDrvDem MoFTrqPtd_tqWhlMin MoFTrqRat_ratTqPTPlaus MoFTrqRat_rTrqPT MoF_trqLos MoF_trqLosPT Mo_stCplChk Mo_stMoC Mo_stMoCCpl Mo_stMoF PTDist_tqCrksftSet /end IN_MEASUREMENT
 /begin OUT_MEASUREMENT MoFTrqPtd_flgOperModRecupFrbdn MoFTrqPtd_flgSelAltMod MoFTrqPtd_tqVehPtdMinRaw MoFTrqPtd_tqVehPtdWoInt MoFTrqPtd_tqVehPtdWoIntvMin MoFTrqPtd_tqVehPtdWoIntvMinMsg MoFTrqPtd_tqVehPtdWoIntvMsg /end OUT_MEASUREMENT
 /begin LOC_MEASUREMENT MoFCoVehCo_bbOut1Cpl MoFTrqPtd_cntrDebRecupFrbdn MoFTrqPtd_cntrDebRecupFrbdnCpl MoFTrqPtd_tqAltTqMaxErr MoFTrqPtd_tqAltTqMaxErrCpl MoFTrqPtd_tqDecExtIntOffs MoFTrqPtd_tqDecExtIntOffsCpl MoFTrqPtd_tqMinSeld MoFTrqPtd_tqMinSeldCpl MoFTrqPtd_tqMinSeldUnfild MoFTrqPtd_tqMinSeldUnfildCpl MoFTrqPtd_tqRecupInhibDem MoFTrqPtd_tqRecupInhibDemCpl MoFTrqPtd_tqVehPtdMinRawCpl MoFTrqPtd_tqVehPtdMinRawLo MoFTrqPtd_tqVehPtdMinRawLoCpl MoFTrqPtd_tqVehPtdWoIntCpl MoFTrqPtd_tqVehPtdWoIntvMinCpl MoFTrqPtd_tqVehPtdWoIntvRaw MoFTrqPtd_tqVehPtdWoIntvRawCpl MoFTrqPtd_tqVehPtdWoIntvRawFildLo MoFTrqPtd_tqVehPtdWoIntvRawFildLoCpl MoFTrqPtd_tqVehPtdWoIntvRawUnfild MoFTrqPtd_tqVehPtdWoIntvRawUnfildCpl /end LOC_MEASUREMENT
 FUNCTION_VERSION "50.1.0" /end FUNCTION
/begin FUNCTION MoFDCS_Co "143.0.0   Function Monitoring: Drag-torque control system"
 /begin DEF_CHARACTERISTIC MoFDCS_cntrDebDCSDeactv_C MoFDCS_cntrStbErrDeb_C MoFDCS_rTqBoostMinLim_C MoFDCS_tqLimDCSNorm_C MoFDCS_tqLimDCSPlus_C /end DEF_CHARACTERISTIC
 /begin IN_MEASUREMENT MoFFrm_flgComErrDCS MoFFrm_flgDCSPlus MoFFrm_flgDecIntvActvDCS MoFFrm_flgStbErr MoFFrm_flgTqUpReqDCS MoFFrm_tqWhlDCS MoFTra_rTqCnvrBoost MoF_rTrqPT MoF_trqLosPT Mo_stCplChk Mo_stMoC Mo_stMoCCpl VMSI_trqMin /end IN_MEASUREMENT
 /begin OUT_MEASUREMENT MoFDCS_flgComErrESP MoFDCS_flgDecIntvActv MoFDCS_flgIntvActv MoFDCS_flgPtd MoFDCS_flgStbErr MoFDCS_tqCluPtd MoFDCS_tqWhlPtd MoFDCS_trqDem /end OUT_MEASUREMENT
 /begin LOC_MEASUREMENT MoFDCSCo_bbOut1Cpl MoFDCS_cntrDebDCSDeactv MoFDCS_cntrDebDCSDeactvCpl MoFDCS_cntrStbErrDeb MoFDCS_cntrStbErrDebCpl MoFDCS_tqCluPtdCpl MoFDCS_tqDesWhl MoFDCS_tqDesWhlCpl MoFDCS_tqWhlPtdCpl MoFDCS_trqDemCpl /end LOC_MEASUREMENT
 FUNCTION_VERSION "143.0.0" /end FUNCTION
/begin FUNCTION MoFDrAs_Co "126.1.0   Function Monitoring: Driver assistance systems (ACC/CCtl)"
 /begin DEF_CHARACTERISTIC MoFDrAs_cntrACC_C MoFDrAs_cntrCrsCtrl_C MoFDrAs_swtEBB_C MoFDrAs_vACCMin_C MoFDrAs_vCrsCtrlMin_C /end DEF_CHARACTERISTIC
 /begin IN_MEASUREMENT CoVMD_trqCrCtl CrCtl_stPtd MoFACC_flgPtd MoFBrk_flgBrkAcc MoFBrk_flgBrkCrsCtrl MoFBrk_flgEBBBrkPedlOn MoFCCtl_flgAct MoFCCtl_flgShOff MoFVSS_v Mo_stCplChk Mo_stMoC Mo_stMoCCpl VehMot_stPrpCrCtl /end IN_MEASUREMENT
 /begin OUT_MEASUREMENT MoFDrAs_stACCPtdMsg MoFDrAs_stCCtlPtdMsg MoFDrAs_stPtdMsg MoFDrAs_trqPtd /end OUT_MEASUREMENT
 /begin LOC_MEASUREMENT MoFDrAsCo_bbLocCpl MoFDrAs_cntrACC MoFDrAs_cntrACCCpl MoFDrAs_cntrCrsCtrl MoFDrAs_cntrCrsCtrlCpl MoFDrAs_flgACCPtd MoFDrAs_flgActv MoFDrAs_flgBrkACC MoFDrAs_flgBrkCrCtl MoFDrAs_flgCrsCtrlPtd MoFDrAs_trqPtdCpl /end LOC_MEASUREMENT
 FUNCTION_VERSION "126.1.0" /end FUNCTION
/begin FUNCTION MoFDrDem_Co "173.1.0   Function Monitoring: Driver torque demand"
 /begin DEF_CHARACTERISTIC MoFDrDem_dfacRampDwn_M MoFDrDem_dfacRampUp_M MoFDrDem_dfacSptOff_M MoFDrDem_dfacSptOn_M MoFDrDem_stDrvModPrevSwt_C MoFDrDem_stDrvModSwt_C MoFDrDem_swtDrvModSeln_C MoFDrDem_tqEngEcoOrCmft_M MoFDrDem_tqEngSnow_M MoFDrDem_tqEngSpt_M MoFDrDem_tqMinWoRamp_C MoFTrqPtd_flgNotSwilLossCmp_C MoFTrqPtd_ratThdMaxCmp_C MoFTrqPtd_ratThdNoCmp_C MoFTrqPtd_ratWoCutOff_C MoFTrqPtd_tqEngApp_M MoFTrqPtd_tqEngSptApp_M MoF_trqEngAPP_M /end DEF_CHARACTERISTIC
 /begin IN_MEASUREMENT AccPed_trqDes MoFDrvPrgSwt_stDrvModSwt MoFESpd_nEng MoFTrqPtd_facCmpSpdGovr MoFTrqPtd_tqCmpNotSwilLoss MoFTrqPtd_tqCmpSwilLoss MoFTrqRat_rTrqPT MoF_rAPP MoF_trqInrMinWoCtOff MoF_trqLosTot Mo_stCplChk Mo_stMoC Mo_stMoCCpl /end IN_MEASUREMENT
 /begin OUT_MEASUREMENT MoFTrqPtd_tqWhlDrvDem /end OUT_MEASUREMENT
 /begin LOC_MEASUREMENT MoFDrDemCo_bbLoc1Cpl MoFDrDem_dfacFiveMod MoFDrDem_dfacFiveModCpl MoFDrDem_dfacSpt MoFDrDem_dfacSptCpl MoFDrDem_flgDrvModChg MoFDrDem_swtDrvMod MoFDrDem_swtDrvModCpl MoFDrDem_swtDrvModPrev MoFDrDem_swtDrvModPrevCpl MoFDrDem_tqCmpLoss MoFDrDem_tqCmpLossCpl MoFDrDem_tqCmpNotSwilLoss MoFDrDem_tqCmpNotSwilLossCpl MoFDrDem_tqCmpSwilLoss MoFDrDem_tqCmpSwilLossCpl MoFDrDem_tqEng MoFDrDem_tqEngApp MoFDrDem_tqEngAppCpl MoFDrDem_tqEngCpl MoFDrDem_tqInrMinWoCtOff MoFDrDem_tqInrMinWoCtOffCpl MoFDrDem_tqModNew MoFDrDem_tqModNewCpl MoFDrDem_tqModOld MoFDrDem_tqModOldCpl MoFDrDem_tqWhlDrvDem MoFDrDem_tqWhlDrvDemCpl MoFTrqPtd_facCmpAcs MoFTrqPtd_facCmpAcsCpl MoFTrqPtd_facMaxCmp MoFTrqPtd_facMaxCmpCpl MoFTrqPtd_tqWhlDrvDemCpl /end LOC_MEASUREMENT
 FUNCTION_VERSION "173.1.0" /end FUNCTION
/begin FUNCTION MoFDrDem_Min "2.1.0     Function Monitoring: Minimum driver torque demand"
 /begin DEF_CHARACTERISTIC MoFTrqPtd_tiOffDlyBrkRels_C MoFTrqPtd_tqWhlBrkMin_M MoFTrqPtd_tqWhlMin_M /end DEF_CHARACTERISTIC
 /begin IN_MEASUREMENT MoFBrk_flgMaiBrk MoFBrk_flgRdntBrk MoFTrqRat_rTrqPT MoFVSS_v Mo_stCplChk Mo_stMoC Mo_stMoCCpl /end IN_MEASUREMENT
 /begin OUT_MEASUREMENT MoFTrqPtd_flgSelBrkMin MoFTrqPtd_tqWhlMin /end OUT_MEASUREMENT
 /begin LOC_MEASUREMENT MoFDrDemMin_bbOut1Cpl MoFTrqPtd_tiOffDlyBrkRels MoFTrqPtd_tiOffDlyBrkRelsCpl MoFTrqPtd_tqWhlBrkMin_MP MoFTrqPtd_tqWhlMinCpl MoFTrqPtd_tqWhlMin_MP /end LOC_MEASUREMENT
 FUNCTION_VERSION "2.1.0" /end FUNCTION
/begin FUNCTION MoFDrvPrgSwt_Co "28.1.0    Function Monitoring: Desired driver program"
 /begin DEF_CHARACTERISTIC MoFDrvPrgSwt_stDrvModSel_CA MoFDrvPrgSwt_swtDrvModSeln_C MoFDrvPrgSwt_swtEcoModMaskL1_C /end DEF_CHARACTERISTIC
 /begin IN_MEASUREMENT AccPed_swtDrvMod AccPed_swtDrvModCpl MoFFrm_Rx_stEcoModOn Mo_stCplChk Mo_stMoC Mo_stMoCCpl /end IN_MEASUREMENT
 /begin OUT_MEASUREMENT MoFDrvPrgSwt_stDrvModSwt /end OUT_MEASUREMENT
 /begin LOC_MEASUREMENT MoFDrvPrgSwt_stDrvModSwtCpl MoFDrvPrgSwt_stDrvModSwtL1 MoFDrvPrgSwt_stDrvModSwtL1Cpl MoFDrvPrgSwt_stDrvModSwtL1Old MoFDrvPrgSwt_stDrvModSwtL1OldCpl /end LOC_MEASUREMENT
 FUNCTION_VERSION "28.1.0" /end FUNCTION
/begin FUNCTION MoFESpd_Co "37.10.0   Function Monitoring: Engine speed"
 /begin DEF_CHARACTERISTIC MoFESpd_cntrDebMaxSeln_C MoFESpd_cntrNoSyncDeb_C MoFESpd_cntrTstDeb_C MoFESpd_ctDeb_C MoFESpd_ctRst_C MoFESpd_nDiffMaxHiResl_C MoFESpd_nEng_Ax MoFESpd_nMinHiResl_C MoFESpd_tiGradNEngErrDeb_C MoF_nEng_DST /end DEF_CHARACTERISTIC
 /begin IN_MEASUREMENT MoXSyncLos_cntrSyncCplMsg MoXSyncLos_cntrSyncMsg MoXSyncLos_nEng10msMsg MoX_bSyncLos_msg Mo_ctRst Mo_ctRstCpl Mo_stCplChk Mo_stMoC Mo_stMoCCpl Mo_stMoF Mo_stMoFCpl /end IN_MEASUREMENT
 /begin OUT_MEASUREMENT MoFESpd_flgErrESpd MoFESpd_flgICOESpd MoFESpd_flgIrrvErrMsg MoFESpd_flgSigVld MoFESpd_nEng MoFESpd_nEngHiRes MoFESpd_nEng_Ax_result MoFESpd_stSync MoF_nEng MoF_nEng_DST_result /end OUT_MEASUREMENT
 /begin LOC_MEASUREMENT MoFESpdCo_bbLoc1Cpl MoFESpdCo_bbOutCpl MoFESpd_cntrNoSyncDeb MoFESpd_cntrNoSyncDebCpl MoFESpd_cntrSyncLvl1Old MoFESpd_cntrSyncLvl1OldCpl MoFESpd_ctDeb MoFESpd_ctDebCpl MoFESpd_deltaGT1Signd_MP MoFESpd_flgClr MoFESpd_flgGrdtNEngErr MoFESpd_flgNoSyncActv MoFESpd_flgTestMsg MoFESpd_frqTsk_MP MoFESpd_GT1Diff_MP MoFESpd_GT1_MP MoFESpd_nDiffHiResl_MP MoFESpd_nEngCpl MoFESpd_nEngCurr_MP MoFESpd_nEngHiResCpl MoFESpd_nEngHiReslL2_MP MoFESpd_nEng_Ax_result_Cpl MoFESpd_stSyncCpl MoFESpd_tiCurr_MP MoF_ctTstESpd MoF_nEngCpl MoF_nEng_DST_result_Cpl MoF_phiGT1Diff_mp MoF_phiGT1Last MoF_phiGT1LastCpl MoF_tiCurrDiff_mp MoF_tiDiff_mp MoF_tiGradNEngErrDeb MoF_tiGradNEngErrDebCpl MoF_tiLast MoF_tiLastCpl /end LOC_MEASUREMENT
 FUNCTION_VERSION "37.10.0" /end FUNCTION
/begin FUNCTION MoFETC_Co "109.1.0   Function Monitoring: Engine Test Coordinator"
 /begin DEF_CHARACTERISTIC MoFETC_cntrCurRunTestReq_C MoFETC_cntrTestIdleUpTOffDly_C MoFETC_cntrTestIdleUp_C MoFETC_cntrTestTOffDly_C MoFETC_cntrTest_C MoFETC_flgMonDiagDisblLck_C MoFETC_rAppLETThd_C MoFETC_rAppThd_C MoFETC_swtInactvTO_C MoFETC_vVehThd_C /end DEF_CHARACTERISTIC
 /begin IN_MEASUREMENT APP_flgATSActv APP_rLET APP_stLETAbort Etc_ctCurRunTst MoFBrk_flgBrk MoFVSS_v MoF_rAPP Mo_stCplChk Mo_stMoC Mo_stMoCCpl /end IN_MEASUREMENT
 /begin OUT_MEASUREMENT MoFETC_flgMonDiagEnaPlausMsg MoFETC_stTest MoFETC_stTstMsg MoF_bAirFlChkDisbl /end OUT_MEASUREMENT
 /begin LOC_MEASUREMENT MoFETCCo_bbLocCpl MoFETCCo_bbOutCpl MoFETC_cntrCurRunTestReq MoFETC_cntrCurRunTestReqCpl MoFETC_cntrTest MoFETC_cntrTestCpl MoFETC_cntrTestIdleUp MoFETC_cntrTestIdleUpCpl MoFETC_cntrTestIdleUpTOffDly MoFETC_cntrTestIdleUpTOffDlyCpl MoFETC_cntrTestTOffDly MoFETC_cntrTestTOffDlyCpl MoFETC_flgIdleUpstatus MoFETC_flgPosEdg MoFETC_stDiagTO MoFETC_stTestActv MoFETC_stTestActvCpl MoFETC_stTestCpl MoFETC_stTestPtd MoFETC_stTestPtdCpl /end LOC_MEASUREMENT
 FUNCTION_VERSION "109.1.0" /end FUNCTION
/begin FUNCTION MoFExtInt_Co "70.0.0    Function Monitoring: Coordination of ESP and transmission interventions"
 /begin DEF_CHARACTERISTIC MoFExtInt_ctDebDCSMax_C MoFExtInt_ctDebTSCMax_C MoFExtInt_flgSwtIncTSCIntvActvTq_C MoFExtInt_tqIncTSCIntvDesMin_C /end DEF_CHARACTERISTIC
 /begin IN_MEASUREMENT MoFDCS_flgPtd MoFDCS_tqCluPtd MoFTra_flgTSCPtd MoFTra_tqClthPtd Mo_stCplChk Mo_stMoC Mo_stMoCCpl Tra_stTSCPtd Tra_trqDesMin VMSI_stDCSPtd VMSI_tqCluMin /end IN_MEASUREMENT
 /begin OUT_MEASUREMENT MoFExtInt_stDCSPtdMsg MoFExtInt_stTSCPtdMsg MoFExtInt_tqCluPtdCoord MoFExtInt_tqCluPtdDCS MoFExtInt_tqCluPtdTSC /end OUT_MEASUREMENT
 /begin LOC_MEASUREMENT MoFExtInt_ctDebDCS MoFExtInt_ctDebDCSCpl MoFExtInt_ctDebTSC MoFExtInt_ctDebTSCCpl MoFExtInt_tqCluPtdCoordCpl MoFExtInt_tqCluPtdDCSCpl MoFExtInt_tqCluPtdTSCCpl /end LOC_MEASUREMENT
 FUNCTION_VERSION "70.0.0" /end FUNCTION
/begin FUNCTION MoFFrmCoorrCust_Rx "76.0.0    Function Monitoring: Frame Manager Customer Specific Coordinator Read Messages" /begin DEF_CHARACTERISTIC MoFFrmCoorrCust_Rx_swtEnaEATPlaus_C /end DEF_CHARACTERISTIC
 /begin IN_MEASUREMENT MoFFrm_Rx_flgATCVTShiftN_EATB MoFFrm_Rx_flgATCVTShiftP_EATB MoFFrm_Rx_flgCVTShiftSure_EATB MoFFrm_Rx_flgDCSPlus_AYCF MoFFrm_Rx_flgMaiSwt_META MoFFrm_Rx_flgTMStrtEna_EAT12 MoFFrm_Rx_flgTMStrtEna_EAT13 MoFFrm_Rx_rTrqCnvBoost_EAT1 MoFFrm_Rx_stACCActv_GWIMG3 MoFFrm_Rx_stButtonRaw_METL MoFFrm_Rx_stTqUpReqDCS_AYCF MoFFrm_Rx_tqCluTra_EAT4 MoFFrm_Rx_tqWhlDCS_AYCF Mo_stCplChk Mo_stMoC Mo_stMoCCpl /end IN_MEASUREMENT
 /begin OUT_MEASUREMENT MoFFrm_flgATCVTShiftN MoFFrm_flgATCVTShiftP MoFFrm_flgBrkHldActv MoFFrm_flgComErrDCS MoFFrm_flgCrsCtrlMaiSwt MoFFrm_flgCVTShiftSure MoFFrm_flgDCSPlus MoFFrm_flgEBBBrkPedlOn MoFFrm_flgStbErr MoFFrm_flgTMStrtEna MoFFrm_flgTqUpReqDCS MoFFrm_flgTqUpReqTra MoFFrm_rTqCnvrBoost MoFFrm_Rx_flgACCActv MoFFrm_Rx_stEcoModOn MoFFrm_stCrsCtrlSwt MoFFrm_tqCluTra MoFFrm_tqWhlDCS /end OUT_MEASUREMENT
 /begin LOC_MEASUREMENT MoFFrmCoorrCust_Rx_bbOut1Cpl MoFFrmCoorrCust_Rx_bbOutCpl MoFFrm_rTqCnvrBoostCpl MoFFrm_Rx_stEcoModOnCpl MoFFrm_stCrsCtrlSwtCpl MoFFrm_tqCluTraCpl MoFFrm_tqWhlDCSCpl /end LOC_MEASUREMENT
 FUNCTION_VERSION "76.0.0" /end FUNCTION
/begin FUNCTION MoFFrmCoorrCust_Tx "159.0.0   Function Monitoring: Frame Manager Customer Specific Coordinator Sent Messages" /begin DEF_CHARACTERISTIC MoFFrmCoorrCust_HiReslOffs_C MoFFrmCoorrCust_HiReslThd_C /end DEF_CHARACTERISTIC
 /begin IN_MEASUREMENT APP_r Com_stAPPSensFail MoCADC_bDef MoFAPP_flgPlausErrDeb MoFAPP_ratHiResl MoFAPP_stSigSrc Mo_stCplChk Mo_stMoC Mo_stMoCCpl /end IN_MEASUREMENT
 /begin OUT_MEASUREMENT MoFFrmCoorrCust_Tx_flgAppErr MoFFrmCoorrCust_Tx_rAPP /end OUT_MEASUREMENT
 /begin LOC_MEASUREMENT MoFFrmCoorrCust_stAPPSensFail MoFFrmCoorrCust_stAPPSensFailCpl MoFFrmCoorrCust_Tx_bbOutCpl MoFFrmCoorrCust_Tx_rAPPCpl /end LOC_MEASUREMENT
 FUNCTION_VERSION "159.0.0" /end FUNCTION
/begin FUNCTION MoFFrm_Lib "159.0.0   Function Monitoring: Library for Flexray sending and receiving"
 /begin DEF_CHARACTERISTIC MoFFrm_Lib_CRC16H1021Tab_CA MoFFrm_Lib_CRC82FHTab_CA MoFFrm_Lib_CRC8H1DTab_CA MoFFrm_Lib_DataApplSigInstance.divFac_C MoFFrm_Lib_DataApplSigInstance.mulFac_C MoFFrm_Lib_DataApplSigInstance.offsFac_C MoFFrm_Lib_DataPduRxInstance.bufLen_C MoFFrm_Lib_DataPduRxInstance.bytOrderAlvCntr_C MoFFrm_Lib_DataPduRxInstance.bytOrderCrc_C MoFFrm_Lib_DataPduRxInstance.cntrAlvErrDeb_C MoFFrm_Lib_DataPduRxInstance.cntrCrcErrDeb_C MoFFrm_Lib_DataPduRxInstance.cntrMaxAlvDif_C MoFFrm_Lib_DataPduRxInstance.cntrTiOutDeb_C MoFFrm_Lib_DataPduRxInstance.crcId_C MoFFrm_Lib_DataPduRxInstance.cycTi_C MoFFrm_Lib_DataPduRxInstance.diChks_C MoFFrm_Lib_DataPduRxInstance.evalType_C MoFFrm_Lib_DataPduRxInstance.maskAlvCntr_C MoFFrm_Lib_DataPduRxInstance.posnAlvCntrStrtBit_C MoFFrm_Lib_DataPduRxInstance.posnCrcCalcEndByte_C MoFFrm_Lib_DataPduRxInstance.posnCrcCalcStrtByte_C MoFFrm_Lib_DataPduRxInstance.posnCrcStrtBit_C MoFFrm_Lib_DataPduRxInstance.sigLenAlvCntr_C MoFFrm_Lib_DataPduRxInstance.sigLenCrc_C MoFFrm_Lib_DataPduTxInstance.bufLen_C MoFFrm_Lib_DataPduTxInstance.bytOrderAlvCntr_C MoFFrm_Lib_DataPduTxInstance.bytOrderCrc_C MoFFrm_Lib_DataPduTxInstance.crcId_C MoFFrm_Lib_DataPduTxInstance.evalType_C MoFFrm_Lib_DataPduTxInstance.posnAlvCntrStrtBit_C MoFFrm_Lib_DataPduTxInstance.posnCrcCalcEndByte_C MoFFrm_Lib_DataPduTxInstance.posnCrcCalcStrtByte_C MoFFrm_Lib_DataPduTxInstance.posnCrcStrtBit_C MoFFrm_Lib_DataPduTxInstance.sigLenAlvCntr_C MoFFrm_Lib_DataPduTxInstance.sigLenCrc_C /end DEF_CHARACTERISTIC
 /begin IN_MEASUREMENT Mo_stCplChk Mo_stMoC Mo_stMoCCpl /end IN_MEASUREMENT
 /begin OUT_MEASUREMENT dummyRx dummyTx MoFFrm_Lib_DataPduRxInstance.cntrAlvErrDeb MoFFrm_Lib_DataPduRxInstance.cntrAlvErrDebCpl MoFFrm_Lib_DataPduRxInstance.cntrAlvOld MoFFrm_Lib_DataPduRxInstance.cntrAlvOldCpl MoFFrm_Lib_DataPduRxInstance.cntrCrcErrDeb MoFFrm_Lib_DataPduRxInstance.cntrCrcErrDebCpl MoFFrm_Lib_DataPduRxInstance.cntrCycTi MoFFrm_Lib_DataPduRxInstance.cntrCycTiCpl MoFFrm_Lib_DataPduRxInstance.cntrTiOutDeb MoFFrm_Lib_DataPduRxInstance.cntrTiOutDebCpl MoFFrm_Lib_DataPduRxInstance.crcData MoFFrm_Lib_DataPduRxInstance.crcDataCpl MoFFrm_Lib_DataPduRxInstance.flgPduUpd MoFFrm_Lib_DataPduRxInstance.flgPduUpdCpl MoFFrm_Lib_DataPduTxInstance.cntrAlvOld MoFFrm_Lib_DataPduTxInstance.cntrAlvOldCpl MoFFrm_Lib_DataPduTxInstance.crcData MoFFrm_Lib_DataPduTxInstance.crcDataCpl MoFFrm_Lib_DataPduTxInstance.flgAswTrigTx MoFFrm_Lib_DataPduTxInstance.flgAswTrigTxCpl /end OUT_MEASUREMENT
 FUNCTION_VERSION "159.0.0" /end FUNCTION
/begin COMPU_METHOD B_TRUE "" TAB_VERB "%6.3" "" COMPU_TAB_REF B_TRUE /end COMPU_METHOD
/begin COMPU_VTAB B_TRUE "" TAB_VERB 2 0 "FALSE" 1 "TRUE" /end COMPU_VTAB
/begin COMPU_METHOD dez "" RAT_FUNC "%6.2" "" COEFFS 0 1 0 0 0 1 /end COMPU_METHOD
/begin COMPU_METHOD Fact1000 "" RAT_FUNC "%6.5" "-" COEFFS 0 1000 0 0 0 1 /end COMPU_METHOD
/begin COMPU_METHOD fak_q0p000244 "" RAT_FUNC "%6.5" "-" COEFFS 0 65536 0 0 0 16 /end COMPU_METHOD
/begin COMPU_METHOD fak_q0p01 "" RAT_FUNC "%6.4" "" COEFFS 0 100 0 0 0 1 /end COMPU_METHOD
/begin COMPU_METHOD fak_uw_b16 "" RAT_FUNC "%6.5" "-" COEFFS 0 65536 0 0 0 16 /end COMPU_METHOD
/begin COMPU_METHOD freq_q0p001 "" RAT_FUNC "%6.5" "Hz" COEFFS 0 1000 0 0 0 1 /end COMPU_METHOD
/begin COMPU_METHOD kw_sw_q0p0219 "" RAT_FUNC "%6.4" "Grad KW" COEFFS 0 32768 0 0 0 720 /end COMPU_METHOD
/begin COMPU_METHOD md_q0p1 "" RAT_FUNC "%6.3" "Nm" COEFFS 0 10 0 0 0 1 /end COMPU_METHOD
/begin COMPU_METHOD md_q1p6 "" RAT_FUNC "%6.2" "Nm" COEFFS 0 10 0 0 0 16 /end COMPU_METHOD
/begin COMPU_METHOD Mo_trq_nm_q0p1 "" RAT_FUNC "%6.3" "Nm" COEFFS 0 10 0 0 0 1 /end COMPU_METHOD
/begin COMPU_METHOD Mo_v_kmh_q0p01 "" RAT_FUNC "%6.4" "km/h" COEFFS 0 100 0 0 0 1 /end COMPU_METHOD
/begin COMPU_METHOD m_ub_b1020 "" RAT_FUNC "%6.2" "kg/h" COEFFS 0 1 0 0 0 4 /end COMPU_METHOD
/begin COMPU_METHOD nmot_q0p5 "" RAT_FUNC "%6.3" "1/min" COEFFS 0 2 0 0 0 1 /end COMPU_METHOD
/begin COMPU_METHOD nmot_q40 "" RAT_FUNC "%6.1" "1/min" COEFFS 0 1 0 0 0 40 /end COMPU_METHOD
/begin COMPU_METHOD OneToOne "" RAT_FUNC "%6.2" "-" COEFFS 0 1 0 0 0 1 /end COMPU_METHOD
/begin COMPU_METHOD Prc "" RAT_FUNC "%6.4" "%" COEFFS 0 81.92 0 0 0 1 /end COMPU_METHOD
/begin COMPU_METHOD q1p5625Em5_kg_DIV_h_min_pc "" RAT_FUNC "%7.6" "(kg/h)/(1/min*%)" COEFFS 0 64000 0 0 0 1 /end COMPU_METHOD
/begin COMPU_METHOD relPED_q0p02441 "" RAT_FUNC "%6.4" "% PED" COEFFS 0 4096 0 0 0 100 /end COMPU_METHOD
/begin COMPU_METHOD rel_q0p39 "" RAT_FUNC "%6.3" "%" COEFFS 0 256 0 0 0 100 /end COMPU_METHOD
/begin COMPU_METHOD rel_ub_q0p75 "" RAT_FUNC "%6.3" "%" COEFFS 0 1 0 0 0 0.75 /end COMPU_METHOD
/begin COMPU_METHOD rel_uw_q0p0234 "" RAT_FUNC "%6.4" "%" COEFFS 0 32 0 0 0 0.75 /end COMPU_METHOD
/begin COMPU_METHOD spg_q0p00488 "" RAT_FUNC "%6.4" "V" COEFFS 0 1024 0 0 0 5 /end COMPU_METHOD
/begin COMPU_METHOD SY_KRADPZI_Compu "" TAB_VERB "%6.3" "" COMPU_TAB_REF SY_KRADPZI_Compu /end COMPU_METHOD
/begin COMPU_VTAB SY_KRADPZI_Compu "" TAB_VERB 2 0 "0" 1 "1" /end COMPU_VTAB
/begin COMPU_METHOD SY_KRK_Compu "" TAB_VERB "%6.3" "" COMPU_TAB_REF SY_KRK_Compu /end COMPU_METHOD
/begin COMPU_VTAB SY_KRK_Compu "" TAB_VERB 2 0 "False" 1 "True" /end COMPU_VTAB
/begin COMPU_METHOD SY_KRLZ_Compu "" TAB_VERB "%6.3" "" COMPU_TAB_REF SY_KRLZ_Compu /end COMPU_METHOD
/begin COMPU_VTAB SY_KRLZ_Compu "" TAB_VERB 2 0 "%KRLZ nicht vorhanden" 1 "%KRLZ vorhanden" /end COMPU_VTAB
/begin COMPU_METHOD SY_KRSAINT_Compu "" TAB_VERB "%6.3" "" COMPU_TAB_REF SY_KRSAINT_Compu /end COMPU_METHOD
/begin COMPU_VTAB SY_KRSAINT_Compu "" TAB_VERB 2 0 "False" 1 "True" /end COMPU_VTAB
/begin COMPU_METHOD SY_KRSASW_Compu "" TAB_VERB "%6.3" "" COMPU_TAB_REF SY_KRSASW_Compu /end COMPU_METHOD
/begin COMPU_VTAB SY_KRSASW_Compu "" TAB_VERB 2 0 "KNOCKCONTROLEXTERNALSIGNALEVALUATION" 1 "KNOCKCONTROLINTERNALSIGNALEVALUATIONMx17" /end COMPU_VTAB
/begin COMPU_METHOD SY_KRZMF_Compu "" TAB_VERB "%6.3" "" COMPU_TAB_REF SY_KRZMF_Compu /end COMPU_METHOD
/begin COMPU_VTAB SY_KRZMF_Compu "" TAB_VERB 2 0 "False" 1 "True" /end COMPU_VTAB
/begin COMPU_METHOD SY_KS1_Compu "" RAT_FUNC "%6.2" "" COEFFS 0 1 0 0 0 1 /end COMPU_METHOD
/begin COMPU_METHOD SY_KS2_Compu "" RAT_FUNC "%6.2" "" COEFFS 0 1 0 0 0 1 /end COMPU_METHOD
/begin COMPU_METHOD SY_KS3_Compu "" RAT_FUNC "%6.2" "" COEFFS 0 1 0 0 0 1 /end COMPU_METHOD
/begin COMPU_METHOD SY_KS4_Compu "" RAT_FUNC "%6.2" "" COEFFS 0 1 0 0 0 1 /end COMPU_METHOD
/begin COMPU_METHOD SY_KSENCHN_Compu "" RAT_FUNC "%6.2" "" COEFFS 0 1 0 0 0 1 /end COMPU_METHOD
/begin COMPU_METHOD SY_KSENFLT_Compu "" RAT_FUNC "%6.2" "" COEFFS 0 1 0 0 0 1 /end COMPU_METHOD
/begin COMPU_METHOD SY_KSZA_Compu "" TAB_VERB "%6.3" "" COMPU_TAB_REF SY_KSZA_Compu /end COMPU_METHOD
/begin COMPU_VTAB SY_KSZA_Compu "" TAB_VERB 5 0 "number of knock sensors is 0" 1 "number of knock sensors is 1" 2 "number of knock sensors is 2" 3 "number of knock sensors is 3" 4 "number of knock sensors is 4" /end COMPU_VTAB
/begin COMPU_METHOD SY_KT_Compu "" RAT_FUNC "%6.2" "" COEFFS 0 1 0 0 0 1 /end COMPU_METHOD
/begin COMPU_METHOD SY_KUPOT_Compu "" TAB_VERB "%6.3" "" COMPU_TAB_REF SY_KUPOT_Compu /end COMPU_METHOD
/begin COMPU_VTAB SY_KUPOT_Compu "" TAB_VERB 2 0 "kein Kupplungspoti verbaut" 1 "Kupplungspoti verbaut" /end COMPU_VTAB
/begin COMPU_METHOD SY_LAMKAPP_Compu "" TAB_VERB "%6.3" "" COMPU_TAB_REF SY_LAMKAPP_Compu /end COMPU_METHOD
/begin COMPU_VTAB SY_LAMKAPP_Compu "" TAB_VERB 2 0 "SY_LAMKAPP_NO" 1 "SY_LAMKAPP_YES" /end COMPU_VTAB
/begin COMPU_METHOD SY_LAMNSWLP_Compu "" TAB_VERB "%6.3" "" COMPU_TAB_REF SY_LAMNSWLP_Compu /end COMPU_METHOD
/begin COMPU_VTAB SY_LAMNSWLP_Compu "" TAB_VERB 2 0 "False" 1 "True" /end COMPU_VTAB
/begin COMPU_METHOD SY_LAYER_Compu "" TAB_VERB "%6.3" "" COMPU_TAB_REF SY_LAYER_Compu /end COMPU_METHOD
/begin COMPU_VTAB SY_LAYER_Compu "" TAB_VERB 2 0 "False" 1 "True" /end COMPU_VTAB
/begin COMPU_METHOD SY_LBKMD_Compu "" TAB_VERB "%6.3" "" COMPU_TAB_REF SY_LBKMD_Compu /end COMPU_METHOD
/begin COMPU_VTAB SY_LBKMD_Compu "" TAB_VERB 2 0 "einfache Md-Modellierung LBK" 1 "erweiterte Md-Modellierung LBK (ETADZWL)" /end COMPU_VTAB
/begin COMPU_METHOD SY_LBK_Compu "" TAB_VERB "%6.3" "" COMPU_TAB_REF SY_LBK_Compu /end COMPU_METHOD
/begin COMPU_VTAB SY_LBK_Compu "" TAB_VERB 7 0 "keine Ladungsbewegungsklappe vorhanden" 1 "Ladungsbewegungsklappe ohne Lagerückmeldung vorhan" 2 "Ladungsbewegungsklappe mit Lagerückmeldung vorhand" 3 "Ladungsbewegungsklappe kontiniuierlich mit DC Moto" 4 "Ladungsbewegungsklappe kontinuierlich mit Stepper" 5 "kontinuierliche LBK mit Lageregelung vor Ort" 6 "kontinuierliche LBK mit Lageregelung im SG" /end COMPU_VTAB
/begin COMPU_METHOD SY_LCSS_Compu "" TAB_VERB "%6.3" "" COMPU_TAB_REF SY_LCSS_Compu /end COMPU_METHOD
/begin COMPU_VTAB SY_LCSS_Compu "" TAB_VERB 2 0 "false" 1 "true" /end COMPU_VTAB
/begin COMPU_METHOD SY_LEITMOD_Compu "" TAB_VERB "%6.3" "" COMPU_TAB_REF SY_LEITMOD_Compu /end COMPU_METHOD
/begin COMPU_VTAB SY_LEITMOD_Compu "" TAB_VERB 2 0 "Leitungsmodell nicht aktiv" 1 "Leitungsmodell aktiv" /end COMPU_VTAB
/begin COMPU_METHOD SY_LENKH_Compu "" TAB_VERB "%6.3" "" COMPU_TAB_REF SY_LENKH_Compu /end COMPU_METHOD
/begin COMPU_VTAB SY_LENKH_Compu "" TAB_VERB 2 0 "keine Servolenkung vorhanden" 1 "Servolenkung vorhanden" /end COMPU_VTAB
/begin COMPU_METHOD SY_LF2B_Compu "" TAB_VERB "%6.3" "" COMPU_TAB_REF SY_LF2B_Compu /end COMPU_METHOD
/begin COMPU_VTAB SY_LF2B_Compu "" TAB_VERB 6 0 "0" 1 "1" 2 "2" 3 "3" 4 "4" 255 "255" /end COMPU_VTAB
/begin COMPU_METHOD SY_LLKEO_Compu "" TAB_VERB "%6.3" "" COMPU_TAB_REF SY_LLKEO_Compu /end COMPU_METHOD
/begin COMPU_VTAB SY_LLKEO_Compu "" TAB_VERB 4 0 "NO_INTCOOL" 1 "INTCOOL_US" 2 "INTCOOL_DS" 3 "INTCOOL_US_AND_DS" /end COMPU_VTAB
/begin COMPU_METHOD SY_LOWRA_Compu "" TAB_VERB "%6.3" "" COMPU_TAB_REF SY_LOWRA_Compu /end COMPU_METHOD
/begin COMPU_VTAB SY_LOWRA_Compu "" TAB_VERB 2 0 "FALSE" 1 "TRUE" /end COMPU_VTAB
/begin COMPU_METHOD SY_LPG_Compu "" TAB_VERB "%6.3" "" COMPU_TAB_REF SY_LPG_Compu /end COMPU_METHOD
/begin COMPU_VTAB SY_LPG_Compu "" TAB_VERB 4 0 "NO_LPG" 1 "SY_LPG_PFI_GAS" 2 "SY_LPG_PFI_LIQUID" 3 "LPG_DI_injection" /end COMPU_VTAB
/begin COMPU_METHOD SY_LPI_Compu "" TAB_VERB "%6.3" "" COMPU_TAB_REF SY_LPI_Compu /end COMPU_METHOD
/begin COMPU_VTAB SY_LPI_Compu "" TAB_VERB 3 0 "No LPI used" 1 "LPI with external Interface Box ( external LPI-ECU" 2 "n ECU integrated LPI functionality" /end COMPU_VTAB
/begin COMPU_METHOD SY_LR2PAR_Compu "" TAB_VERB "%6.3" "" COMPU_TAB_REF SY_LR2PAR_Compu /end COMPU_METHOD
/begin COMPU_VTAB SY_LR2PAR_Compu "" TAB_VERB 2 0 "Gemeinsame Lambdaregelungsparameter Bank 1/ 2" 1 "Separate Lambdaregelungsparameter Bank 1/ 2" /end COMPU_VTAB
/begin COMPU_METHOD SY_LRATKG_Compu "" TAB_VERB "%6.3" "" COMPU_TAB_REF SY_LRATKG_Compu /end COMPU_METHOD
/begin COMPU_VTAB SY_LRATKG_Compu "" TAB_VERB 2 0 "FALSE" 1 "TRUE" /end COMPU_VTAB
/begin COMPU_METHOD SY_LRAT_Compu "" TAB_VERB "%6.3" "" COMPU_TAB_REF SY_LRAT_Compu /end COMPU_METHOD
/begin COMPU_VTAB SY_LRAT_Compu "" TAB_VERB 2 0 "False" 1 "True" /end COMPU_VTAB
/begin COMPU_METHOD SY_LREBPS_Compu "" TAB_VERB "%6.3" "" COMPU_TAB_REF SY_LREBPS_Compu /end COMPU_METHOD
/begin COMPU_VTAB SY_LREBPS_Compu "" TAB_VERB 2 0 "False" 1 "True" /end COMPU_VTAB
/begin COMPU_METHOD SY_LRFK2_Compu "" TAB_VERB "%6.3" "" COMPU_TAB_REF SY_LRFK2_Compu /end COMPU_METHOD
/begin COMPU_VTAB SY_LRFK2_Compu "" TAB_VERB 2 0 "0" 1 "1" /end COMPU_VTAB
/begin COMPU_METHOD SY_LRFKEF_Compu "" TAB_VERB "%6.3" "" COMPU_TAB_REF SY_LRFKEF_Compu /end COMPU_METHOD
/begin COMPU_VTAB SY_LRFKEF_Compu "" TAB_VERB 2 0 "keine Eigenfrequenzregelung hinter Frontkat" 1 "Eigenfrequenzregelung hinter Frontkat" /end COMPU_VTAB
/begin COMPU_METHOD SY_LRFK_Compu "" TAB_VERB "%6.3" "" COMPU_TAB_REF SY_LRFK_Compu /end COMPU_METHOD
/begin COMPU_VTAB SY_LRFK_Compu "" TAB_VERB 2 0 "0" 1 "1" /end COMPU_VTAB
/begin COMPU_METHOD SY_LRSEZ_Compu "" TAB_VERB "%6.3" "" COMPU_TAB_REF SY_LRSEZ_Compu /end COMPU_METHOD
/begin COMPU_VTAB SY_LRSEZ_Compu "" TAB_VERB 2 0 "keine zylinderindividuelle Lambdaregelung" 1 "zylinderindividuelle Lambdaregelung" /end COMPU_VTAB
/begin COMPU_METHOD SY_LSAGETR_Compu "" TAB_VERB "%6.3" "" COMPU_TAB_REF SY_LSAGETR_Compu /end COMPU_METHOD
/begin COMPU_VTAB SY_LSAGETR_Compu "" TAB_VERB 2 0 "False kein Lastschalt Automatikgetriebe eingebaut" 1 "True Lastschalt Automatikgetriebe eingebaut" /end COMPU_VTAB
/begin COMPU_METHOD SY_LSFIKR2_Compu "" TAB_VERB "%6.3" "" COMPU_TAB_REF SY_LSFIKR2_Compu /end COMPU_METHOD
/begin COMPU_VTAB SY_LSFIKR2_Compu "" TAB_VERB 2 0 "False" 1 "True" /end COMPU_VTAB
/begin COMPU_METHOD SY_LSFIKR_Compu "" TAB_VERB "%6.3" "" COMPU_TAB_REF SY_LSFIKR_Compu /end COMPU_METHOD
/begin COMPU_VTAB SY_LSFIKR_Compu "" TAB_VERB 2 0 "0" 1 "1" /end COMPU_VTAB
/begin COMPU_METHOD SY_LSFNHK2_Compu "" TAB_VERB "%6.3" "" COMPU_TAB_REF SY_LSFNHK2_Compu /end COMPU_METHOD
/begin COMPU_VTAB SY_LSFNHK2_Compu "" TAB_VERB 2 0 "keine LSF nach Hauptkat in Bank2 verbaut" 1 "LSF nach Hauptkat in Bank2 verbaut" /end COMPU_VTAB
/begin COMPU_METHOD SY_LSFNHK_Compu "" TAB_VERB "%6.3" "" COMPU_TAB_REF SY_LSFNHK_Compu /end COMPU_METHOD
/begin COMPU_VTAB SY_LSFNHK_Compu "" TAB_VERB 2 0 "keine LSF nach Hauptkat verbaut" 1 "LSF nach Hauptkat verbaut" /end COMPU_VTAB
/begin COMPU_METHOD SY_LSFNTL2_Compu "" TAB_VERB "%6.3" "" COMPU_TAB_REF SY_LSFNTL2_Compu /end COMPU_METHOD
/begin COMPU_VTAB SY_LSFNTL2_Compu "" TAB_VERB 2 0 "False" 1 "True" /end COMPU_VTAB
/begin COMPU_METHOD SY_LSFNTL_Compu "" TAB_VERB "%6.3" "" COMPU_TAB_REF SY_LSFNTL_Compu /end COMPU_METHOD
/begin COMPU_VTAB SY_LSFNTL_Compu "" TAB_VERB 2 0 "False" 1 "True" /end COMPU_VTAB
/begin COMPU_METHOD SY_LSFNVK2_Compu "" TAB_VERB "%6.3" "" COMPU_TAB_REF SY_LSFNVK2_Compu /end COMPU_METHOD
/begin COMPU_VTAB SY_LSFNVK2_Compu "" TAB_VERB 2 0 "keine Lambdasonde hinter Frontakat Bank 2" 1 "Lambdasonde hinter Frontakat Bank 2" /end COMPU_VTAB
/begin COMPU_METHOD SY_LSFNVK_Compu "" TAB_VERB "%6.3" "" COMPU_TAB_REF SY_LSFNVK_Compu /end COMPU_METHOD
/begin COMPU_VTAB SY_LSFNVK_Compu "" TAB_VERB 2 0 "keine Lambdasonde hinter dem Frontakat vorhanden" 1 "Lambdasonde hinter dem Frontakat vorhanden" /end COMPU_VTAB
/begin COMPU_METHOD SY_LSFVHK2_Compu "" TAB_VERB "%6.3" "" COMPU_TAB_REF SY_LSFVHK2_Compu /end COMPU_METHOD
/begin COMPU_VTAB SY_LSFVHK2_Compu "" TAB_VERB 2 0 "False" 1 "True" /end COMPU_VTAB
/begin COMPU_METHOD SY_LSFVHK_Compu "" TAB_VERB "%6.3" "" COMPU_TAB_REF SY_LSFVHK_Compu /end COMPU_METHOD
/begin COMPU_VTAB SY_LSFVHK_Compu "" TAB_VERB 2 0 "False" 1 "True" /end COMPU_VTAB
/begin COMPU_METHOD SY_LSFVVK2_Compu "" TAB_VERB "%6.3" "" COMPU_TAB_REF SY_LSFVVK2_Compu /end COMPU_METHOD
/begin COMPU_VTAB SY_LSFVVK2_Compu "" TAB_VERB 2 0 "keine LSF vor Vorkatalysator, Bank2 vorhanden" 1 "LSF vor Vorkatalysator, Bank2 vorhanden" /end COMPU_VTAB
/begin COMPU_METHOD TransR "" RAT_FUNC "%6.4" "-" COEFFS 0 100 0 0 0 1 /end COMPU_METHOD
/begin COMPU_METHOD Trq "" RAT_FUNC "%6.3" "Nm" COEFFS 0 10 0 0 0 1 /end COMPU_METHOD
/begin COMPU_METHOD t_q0p01 "" RAT_FUNC "%6.4" "s" COEFFS 0 100 0 0 0 1 /end COMPU_METHOD
/begin COMPU_METHOD t_q1p0_us "" RAT_FUNC "%6.2" "us" COEFFS 0 1 0 0 0 1 /end COMPU_METHOD
/begin COMPU_METHOD vel_q0p01 "" RAT_FUNC "%6.4" "km/h" COEFFS 0 100 0 0 0 1 /end COMPU_METHOD
/begin COMPU_METHOD vfzg_q0p01 "" RAT_FUNC "%6.4" "km/h" COEFFS 0 1 0 0 0 0.01 /end COMPU_METHOD
/begin COMPU_METHOD zk10msxs_uw_b655p36PT1 "" RAT_FUNC "%6.2" "s" COEFFS 0 0 65536 0 100 1 /end COMPU_METHOD
/begin RECORD_LAYOUT Axis_Xu16 NO_AXIS_PTS_X 1 UWORD AXIS_PTS_X 2 UWORD INDEX_INCR DIRECT /end RECORD_LAYOUT
/begin RECORD_LAYOUT Axis_Xu8 NO_AXIS_PTS_X 1 UBYTE AXIS_PTS_X 2 UBYTE INDEX_INCR DIRECT /end RECORD_LAYOUT
/begin RECORD_LAYOUT Map_Xs16Ys16Ws16 NO_AXIS_PTS_X 1 SWORD NO_AXIS_PTS_Y 2 SWORD AXIS_PTS_X 3 SWORD INDEX_INCR DIRECT AXIS_PTS_Y 4 SWORD INDEX_INCR DIRECT FNC_VALUES 5 SWORD COLUMN_DIR DIRECT /end RECORD_LAYOUT
/begin RECORD_LAYOUT Mo_DataCurveSstS16WS16 NO_AXIS_PTS_X 1 SWORD AXIS_PTS_X 2 SWORD INDEX_INCR DIRECT FNC_VALUES 3 SWORD COLUMN_DIR DIRECT /end RECORD_LAYOUT
/begin RECORD_LAYOUT ValA_Wu16 FNC_VALUES 1 UWORD COLUMN_DIR DIRECT /end RECORD_LAYOUT
/begin RECORD_LAYOUT ValA_Wu8 FNC_VALUES 1 UBYTE COLUMN_DIR DIRECT /end RECORD_LAYOUT
/begin RECORD_LAYOUT Val_Ws16 FNC_VALUES 1 SWORD COLUMN_DIR DIRECT /end RECORD_LAYOUT
/begin RECORD_LAYOUT Val_Ws32 FNC_VALUES 1 SLONG COLUMN_DIR DIRECT /end RECORD_LAYOUT
/begin RECORD_LAYOUT Val_Wu16 FNC_VALUES 1 UWORD COLUMN_DIR DIRECT /end RECORD_LAYOUT
/begin RECORD_LAYOUT Val_Wu32 FNC_VALUES 1 ULONG COLUMN_DIR DIRECT /end RECORD_LAYOUT
/begin RECORD_LAYOUT Val_Wu8 FNC_VALUES 1 UBYTE COLUMN_DIR DIRECT /end RECORD_LAYOUT
/end MODULE
/end PROJECT
