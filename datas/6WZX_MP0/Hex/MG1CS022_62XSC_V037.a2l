ASAP2_VERSION 1 60
/begin PROJECT MG1CS022 "MG1CS022"
/begin HEADER "" VERSION "MG1CS022_62XSC_V037" PROJECT_NO MG1CS022 /end HEADER
/begin MODULE DIM ""
/begin MOD_COMMON "" BYTE_ORDER MSB_LAST ALIGNMENT_BYTE 1 ALIGNMENT_WORD 2 ALIGNMENT_LONG 4 ALIGNMENT_INT64 4 ALIGNMENT_FLOAT32_IEEE 4 ALIGNMENT_FLOAT64_IEEE 4 DATA_SIZE 32 /end MOD_COMMON
/begin CHARACTERISTIC DFC_CtlMsk.DFC_ComMETLTOut_C "Behaviour control mask / Behaviour control masks of check DFC_ComMETLTOut" VALUE 0x804D90FE Val_Wu16 65535.00 DFES_OneToOne 0.00 65535.00 FORMAT "%8.2" /end CHARACTERISTIC
/begin CHARACTERISTIC DFC_CtlMsk.DFC_ComMETMChksum_C "Behaviour control mask / Behaviour control masks of check DFC_ComMETMChksum" VALUE 0x804D9100 Val_Wu16 65535.00 DFES_OneToOne 0.00 65535.00 FORMAT "%8.2" /end CHARACTERISTIC
/begin CHARACTERISTIC DFC_CtlMsk.DFC_ComMETMRingCnt_C "Behaviour control mask / Behaviour control masks of check DFC_ComMETMRingCnt" VALUE 0x804D9102 Val_Wu16 65535.00 DFES_OneToOne 0.00 65535.00 FORMAT "%8.2" /end CHARACTERISTIC
/begin CHARACTERISTIC DFC_CtlMsk.DFC_ComMETMTOut_C "Behaviour control mask / Behaviour control masks of check DFC_ComMETMTOut" VALUE 0x804D9104 Val_Wu16 65535.00 DFES_OneToOne 0.00 65535.00 FORMAT "%8.2" /end CHARACTERISTIC
/begin CHARACTERISTIC DFC_CtlMsk.DFC_ComMETNChksum_C "Behaviour control mask / Behaviour control masks of check DFC_ComMETNChksum" VALUE 0x804D9106 Val_Wu16 65535.00 DFES_OneToOne 0.00 65535.00 FORMAT "%8.2" /end CHARACTERISTIC
/begin CHARACTERISTIC DFC_CtlMsk.DFC_ComMETNRingCnt_C "Behaviour control mask / Behaviour control masks of check DFC_ComMETNRingCnt" VALUE 0x804D9108 Val_Wu16 65535.00 DFES_OneToOne 0.00 65535.00 FORMAT "%8.2" /end CHARACTERISTIC
/begin CHARACTERISTIC DFC_CtlMsk.DFC_ComMETNTOut_C "Behaviour control mask / Behaviour control masks of check DFC_ComMETNTOut" VALUE 0x804D910A Val_Wu16 65535.00 DFES_OneToOne 0.00 65535.00 FORMAT "%8.2" /end CHARACTERISTIC
/begin CHARACTERISTIC DFC_CtlMsk.DFC_ComMtrCom_C "Behaviour control mask / Behaviour control masks of check DFC_ComMtrCom" VALUE 0x804D910C Val_Wu16 65535.00 DFES_OneToOne 0.00 65535.00 FORMAT "%8.2" /end CHARACTERISTIC
/begin CHARACTERISTIC DFC_CtlMsk.DFC_ComPCUChkSum_C "Behaviour control mask / Behaviour control masks of check DFC_ComPCUChkSum" VALUE 0x804D910E Val_Wu16 65535.00 DFES_OneToOne 0.00 65535.00 FORMAT "%8.2" /end CHARACTERISTIC
/begin CHARACTERISTIC DFC_CtlMsk.DFC_ComPCURingCnt_C "Behaviour control mask / Behaviour control masks of check DFC_ComPCURingCnt" VALUE 0x804D9110 Val_Wu16 65535.00 DFES_OneToOne 0.00 65535.00 FORMAT "%8.2" /end CHARACTERISTIC
/begin CHARACTERISTIC DFC_CtlMsk.DFC_ComPCUTOut_C "Behaviour control mask / Behaviour control masks of check DFC_ComPCUTOut" VALUE 0x804D9112 Val_Wu16 65535.00 DFES_OneToOne 0.00 65535.00 FORMAT "%8.2" /end CHARACTERISTIC
/begin CHARACTERISTIC DFC_CtlMsk.DFC_ComSRSAChksum_C "Behaviour control mask / Behaviour control masks of check DFC_ComSRSAChksum" VALUE 0x804D9114 Val_Wu16 65535.00 DFES_OneToOne 0.00 65535.00 FORMAT "%8.2" /end CHARACTERISTIC
/begin CHARACTERISTIC DFC_CtlMsk.DFC_ComSRSARingCnt_C "Behaviour control mask / Behaviour control masks of check DFC_ComSRSARingCnt" VALUE 0x804D9116 Val_Wu16 65535.00 DFES_OneToOne 0.00 65535.00 FORMAT "%8.2" /end CHARACTERISTIC
/begin CHARACTERISTIC DFC_CtlMsk.DFC_ComSRSATOut_C "Behaviour control mask / Behaviour control masks of check DFC_ComSRSATOut" VALUE 0x804D9118 Val_Wu16 65535.00 DFES_OneToOne 0.00 65535.00 FORMAT "%8.2" /end CHARACTERISTIC
/begin CHARACTERISTIC DFC_CtlMsk.DFC_ComSRSBChksum_C "Behaviour control mask / Behaviour control masks of check DFC_ComSRSBChksum" VALUE 0x804D911A Val_Wu16 65535.00 DFES_OneToOne 0.00 65535.00 FORMAT "%8.2" /end CHARACTERISTIC
/begin CHARACTERISTIC DFC_CtlMsk.DFC_ComSRSBRingCnt_C "Behaviour control mask / Behaviour control masks of check DFC_ComSRSBRingCnt" VALUE 0x804D911C Val_Wu16 65535.00 DFES_OneToOne 0.00 65535.00 FORMAT "%8.2" /end CHARACTERISTIC
/begin CHARACTERISTIC DFC_CtlMsk.DFC_ComSRSBTOut_C "Behaviour control mask / Behaviour control masks of check DFC_ComSRSBTOut" VALUE 0x804D911E Val_Wu16 65535.00 DFES_OneToOne 0.00 65535.00 FORMAT "%8.2" /end CHARACTERISTIC
/begin CHARACTERISTIC DFC_CtlMsk.DFC_ComSRSChksum_C "Behaviour control mask / Behaviour control masks of check DFC_ComSRSChksum" VALUE 0x804D9120 Val_Wu16 65535.00 DFES_OneToOne 0.00 65535.00 FORMAT "%8.2" /end CHARACTERISTIC
/begin CHARACTERISTIC DFC_CtlMsk.DFC_ComSRSErr_C "Behaviour control mask / Behaviour control masks of check DFC_ComSRSErr" VALUE 0x804D9122 Val_Wu16 65535.00 DFES_OneToOne 0.00 65535.00 FORMAT "%8.2" /end CHARACTERISTIC
/begin CHARACTERISTIC DFC_CtlMsk.DFC_ComSRSRingCnt_C "Behaviour control mask / Behaviour control masks of check DFC_ComSRSRingCnt" VALUE 0x804D9124 Val_Wu16 65535.00 DFES_OneToOne 0.00 65535.00 FORMAT "%8.2" /end CHARACTERISTIC
/begin CHARACTERISTIC DFC_CtlMsk.DFC_ComSRSTOut_C "Behaviour control mask / Behaviour control masks of check DFC_ComSRSTOut" VALUE 0x804D9126 Val_Wu16 65535.00 DFES_OneToOne 0.00 65535.00 FORMAT "%8.2" /end CHARACTERISTIC
/begin CHARACTERISTIC DFC_CtlMsk.DFC_ComVehSpdPndFltTCU_C "Behaviour control mask / Behaviour control masks of check DFC_ComVehSpdPndFltTCU" VALUE 0x804D9128 Val_Wu16 65535.00 DFES_OneToOne 0.00 65535.00 FORMAT "%8.2" /end CHARACTERISTIC
/begin CHARACTERISTIC DFC_CtlMsk.DFC_EbsChartcCurrErr_C "Behaviour control mask / Behaviour control masks of check DFC_EbsChartcCurrErr" VALUE 0x804D912A Val_Wu16 65535.00 DFES_OneToOne 0.00 65535.00 FORMAT "%8.2" /end CHARACTERISTIC
/begin CHARACTERISTIC DFC_CtlMsk.DFC_EbsSelfDiagErr_C "Behaviour control mask / Behaviour control masks of check DFC_EbsSelfDiagErr" VALUE 0x804D912C Val_Wu16 65535.00 DFES_OneToOne 0.00 65535.00 FORMAT "%8.2" /end CHARACTERISTIC
/begin CHARACTERISTIC DFC_CtlMsk.DFC_GEVlvPhaCsersIntkB1_C "Behaviour control mask / Behaviour control masks of check DFC_GEVlvPhaCsersIntkB1" VALUE 0x804D912E Val_Wu16 65535.00 DFES_OneToOne 0.00 65535.00 FORMAT "%8.2" /end CHARACTERISTIC
/begin CHARACTERISTIC DFC_CtlMsk.DFC_GEVlvPhaPsOpenLoadIntkB1_C "Behaviour control mask / Behaviour control masks of check DFC_GEVlvPhaPsOpenLoadIntkB1" VALUE 0x804D9130 Val_Wu16 65535.00 DFES_OneToOne 0.00 65535.00 FORMAT "%8.2" /end CHARACTERISTIC
/begin CHARACTERISTIC DFC_CtlMsk.DFC_GEVlvPhaPsShoToBattIntkB1_C "Behaviour control mask / Behaviour control masks of check DFC_GEVlvPhaPsShoToBattIntkB1" VALUE 0x804D9132 Val_Wu16 65535.00 DFES_OneToOne 0.00 65535.00 FORMAT "%8.2" /end CHARACTERISTIC
/begin CHARACTERISTIC DFC_CtlMsk.DFC_GEVlvPhaPsShoToGndIntkB1_C "Behaviour control mask / Behaviour control masks of check DFC_GEVlvPhaPsShoToGndIntkB1" VALUE 0x804D9134 Val_Wu16 65535.00 DFES_OneToOne 0.00 65535.00 FORMAT "%8.2" /end CHARACTERISTIC
/begin CHARACTERISTIC DFC_CtlMsk.DFC_GbxCANDigPlausErr_C "Behaviour control mask / Behaviour control masks of check DFC_GbxCANDigPlausErr" VALUE 0x804D9136 Val_Wu16 65535.00 DFES_OneToOne 0.00 65535.00 FORMAT "%8.2" /end CHARACTERISTIC
/begin CHARACTERISTIC DFC_CtlMsk.DFC_GbxNPos1SRCMax_C "Behaviour control mask / Behaviour control masks of check DFC_GbxNPos1SRCMax" VALUE 0x804D9138 Val_Wu16 65535.00 DFES_OneToOne 0.00 65535.00 FORMAT "%8.2" /end CHARACTERISTIC
/begin CHARACTERISTIC DFC_CtlMsk.DFC_GbxNPos1SRCMin_C "Behaviour control mask / Behaviour control masks of check DFC_GbxNPos1SRCMin" VALUE 0x804D913A Val_Wu16 65535.00 DFES_OneToOne 0.00 65535.00 FORMAT "%8.2" /end CHARACTERISTIC
/begin CHARACTERISTIC DFC_CtlMsk.DFC_GbxNPos2SRCMax_C "Behaviour control mask / Behaviour control masks of check DFC_GbxNPos2SRCMax" VALUE 0x804D913C Val_Wu16 65535.00 DFES_OneToOne 0.00 65535.00 FORMAT "%8.2" /end CHARACTERISTIC
/begin CHARACTERISTIC DFC_CtlMsk.DFC_GbxNPos2SRCMin_C "Behaviour control mask / Behaviour control masks of check DFC_GbxNPos2SRCMin" VALUE 0x804D913E Val_Wu16 65535.00 DFES_OneToOne 0.00 65535.00 FORMAT "%8.2" /end CHARACTERISTIC
/begin CHARACTERISTIC DFC_CtlMsk.DFC_GbxNPosAlvChk_C "Behaviour control mask / Behaviour control masks of check DFC_GbxNPosAlvChk" VALUE 0x804D9140 Val_Wu16 65535.00 DFES_OneToOne 0.00 65535.00 FORMAT "%8.2" /end CHARACTERISTIC
/begin CHARACTERISTIC DFC_CtlMsk.DFC_GbxNPosSyncErr_C "Behaviour control mask / Behaviour control masks of check DFC_GbxNPosSyncErr" VALUE 0x804D9142 Val_Wu16 65535.00 DFES_OneToOne 0.00 65535.00 FORMAT "%8.2" /end CHARACTERISTIC
/begin CHARACTERISTIC DFC_CtlMsk.DFC_HEGOS2B1HtrPsMax_C "Behaviour control mask / Behaviour control masks of check DFC_HEGOS2B1HtrPsMax" VALUE 0x804D9144 Val_Wu16 65535.00 DFES_OneToOne 0.00 65535.00 FORMAT "%8.2" /end CHARACTERISTIC
/begin CHARACTERISTIC DFC_CtlMsk.DFC_HEGOS2B1HtrPsMin_C "Behaviour control mask / Behaviour control masks of check DFC_HEGOS2B1HtrPsMin" VALUE 0x804D9146 Val_Wu16 65535.00 DFES_OneToOne 0.00 65535.00 FORMAT "%8.2" /end CHARACTERISTIC
/begin CHARACTERISTIC DFC_CtlMsk.DFC_HEGOS2B1HtrPsSig_C "Behaviour control mask / Behaviour control masks of check DFC_HEGOS2B1HtrPsSig" VALUE 0x804D9148 Val_Wu16 65535.00 DFES_OneToOne 0.00 65535.00 FORMAT "%8.2" /end CHARACTERISTIC
/begin CHARACTERISTIC DFC_CtlMsk.DFC_LinCSErrACG_C "Behaviour control mask / Behaviour control masks of check DFC_LinCSErrACG" VALUE 0x804D914A Val_Wu16 65535.00 DFES_OneToOne 0.00 65535.00 FORMAT "%8.2" /end CHARACTERISTIC
/begin CHARACTERISTIC DFC_CtlMsk.DFC_LinCSErrAEV_C "Behaviour control mask / Behaviour control masks of check DFC_LinCSErrAEV" VALUE 0x804D914C Val_Wu16 65535.00 DFES_OneToOne 0.00 65535.00 FORMAT "%8.2" /end CHARACTERISTIC
/begin CHARACTERISTIC DFC_CtlMsk.DFC_LinCSErrDCDC_C "Behaviour control mask / Behaviour control masks of check DFC_LinCSErrDCDC" VALUE 0x804D914E Val_Wu16 65535.00 DFES_OneToOne 0.00 65535.00 FORMAT "%8.2" /end CHARACTERISTIC
/begin CHARACTERISTIC DFC_CtlMsk.DFC_LinCSErrEBS_C "Behaviour control mask / Behaviour control masks of check DFC_LinCSErrEBS" VALUE 0x804D9150 Val_Wu16 65535.00 DFES_OneToOne 0.00 65535.00 FORMAT "%8.2" /end CHARACTERISTIC
/begin CHARACTERISTIC DFC_CtlMsk.DFC_LinHdrTimeoutErrACG_C "Behaviour control mask / Behaviour control masks of check DFC_LinHdrTimeoutErrACG" VALUE 0x804D9152 Val_Wu16 65535.00 DFES_OneToOne 0.00 65535.00 FORMAT "%8.2" /end CHARACTERISTIC
/begin CHARACTERISTIC DFC_CtlMsk.DFC_LinHdrTimeoutErrAEV_C "Behaviour control mask / Behaviour control masks of check DFC_LinHdrTimeoutErrAEV" VALUE 0x804D9154 Val_Wu16 65535.00 DFES_OneToOne 0.00 65535.00 FORMAT "%8.2" /end CHARACTERISTIC
/begin CHARACTERISTIC DFC_CtlMsk.DFC_LinHdrTimeoutErrDCDC_C "Behaviour control mask / Behaviour control masks of check DFC_LinHdrTimeoutErrDCDC" VALUE 0x804D9156 Val_Wu16 65535.00 DFES_OneToOne 0.00 65535.00 FORMAT "%8.2" /end CHARACTERISTIC
/begin CHARACTERISTIC DFC_CtlMsk.DFC_LinHdrTimeoutErrEBS_C "Behaviour control mask / Behaviour control masks of check DFC_LinHdrTimeoutErrEBS" VALUE 0x804D9158 Val_Wu16 65535.00 DFES_OneToOne 0.00 65535.00 FORMAT "%8.2" /end CHARACTERISTIC
/begin CHARACTERISTIC DFC_CtlMsk.DFC_LinMsgTimeoutErrACG_C "Behaviour control mask / Behaviour control masks of check DFC_LinMsgTimeoutErrACG" VALUE 0x804D915A Val_Wu16 65535.00 DFES_OneToOne 0.00 65535.00 FORMAT "%8.2" /end CHARACTERISTIC
/begin CHARACTERISTIC DFC_CtlMsk.DFC_LinMsgTimeoutErrAEV_C "Behaviour control mask / Behaviour control masks of check DFC_LinMsgTimeoutErrAEV" VALUE 0x804D915C Val_Wu16 65535.00 DFES_OneToOne 0.00 65535.00 FORMAT "%8.2" /end CHARACTERISTIC
/begin CHARACTERISTIC DFC_CtlMsk.DFC_LinMsgTimeoutErrDCDC_C "Behaviour control mask / Behaviour control masks of check DFC_LinMsgTimeoutErrDCDC" VALUE 0x804D915E Val_Wu16 65535.00 DFES_OneToOne 0.00 65535.00 FORMAT "%8.2" /end CHARACTERISTIC
/begin CHARACTERISTIC DFC_CtlMsk.DFC_LinMsgTimeoutErrEBS_C "Behaviour control mask / Behaviour control masks of check DFC_LinMsgTimeoutErrEBS" VALUE 0x804D9160 Val_Wu16 65535.00 DFES_OneToOne 0.00 65535.00 FORMAT "%8.2" /end CHARACTERISTIC
/begin CHARACTERISTIC DFC_CtlMsk.DFC_LinNoStrtComErr_C "Behaviour control mask / Behaviour control masks of check DFC_LinNoStrtComErr" VALUE 0x804D9162 Val_Wu16 65535.00 DFES_OneToOne 0.00 65535.00 FORMAT "%8.2" /end CHARACTERISTIC
/begin CHARACTERISTIC DFC_CtlMsk.DFC_LowPresOilP_C "Behaviour control mask / Behaviour control masks of check DFC_LowPresOilP" VALUE 0x804D9164 Val_Wu16 65535.00 DFES_OneToOne 0.00 65535.00 FORMAT "%8.2" /end CHARACTERISTIC
/begin CHARACTERISTIC DFC_CtlMsk.DFC_MisfDetVWhlFrntLeOORHi_C "Behaviour control mask / Behaviour control masks of check DFC_MisfDetVWhlFrntLeOORHi" VALUE 0x804D9166 Val_Wu16 65535.00 DFES_OneToOne 0.00 65535.00 FORMAT "%8.2" /end CHARACTERISTIC
/begin CHARACTERISTIC DFC_CtlMsk.DFC_MisfDetVWhlFrntLeRatyHi_C "Behaviour control mask / Behaviour control masks of check DFC_MisfDetVWhlFrntLeRatyHi" VALUE 0x804D9168 Val_Wu16 65535.00 DFES_OneToOne 0.00 65535.00 FORMAT "%8.2" /end CHARACTERISTIC
/begin CHARACTERISTIC DFC_CtlMsk.DFC_MisfDetVWhlFrntLeRatyLo_C "Behaviour control mask / Behaviour control masks of check DFC_MisfDetVWhlFrntLeRatyLo" VALUE 0x804D916A Val_Wu16 65535.00 DFES_OneToOne 0.00 65535.00 FORMAT "%8.2" /end CHARACTERISTIC
/begin CHARACTERISTIC DFC_CtlMsk.DFC_MisfDetVWhlFrntLeStuck_C "Behaviour control mask / Behaviour control masks of check DFC_MisfDetVWhlFrntLeStuck" VALUE 0x804D916C Val_Wu16 65535.00 DFES_OneToOne 0.00 65535.00 FORMAT "%8.2" /end CHARACTERISTIC
/begin CHARACTERISTIC DFC_CtlMsk.DFC_MisfDetVWhlFrntRiOORHi_C "Behaviour control mask / Behaviour control masks of check DFC_MisfDetVWhlFrntRiOORHi" VALUE 0x804D916E Val_Wu16 65535.00 DFES_OneToOne 0.00 65535.00 FORMAT "%8.2" /end CHARACTERISTIC
/begin CHARACTERISTIC DFC_CtlMsk.DFC_MisfDetVWhlFrntRiRatyHi_C "Behaviour control mask / Behaviour control masks of check DFC_MisfDetVWhlFrntRiRatyHi" VALUE 0x804D9170 Val_Wu16 65535.00 DFES_OneToOne 0.00 65535.00 FORMAT "%8.2" /end CHARACTERISTIC
/begin CHARACTERISTIC DFC_CtlMsk.DFC_MisfDetVWhlFrntRiRatyLo_C "Behaviour control mask / Behaviour control masks of check DFC_MisfDetVWhlFrntRiRatyLo" VALUE 0x804D9172 Val_Wu16 65535.00 DFES_OneToOne 0.00 65535.00 FORMAT "%8.2" /end CHARACTERISTIC
/begin CHARACTERISTIC DFC_CtlMsk.DFC_MisfDetVWhlFrntRiStuck_C "Behaviour control mask / Behaviour control masks of check DFC_MisfDetVWhlFrntRiStuck" VALUE 0x804D9174 Val_Wu16 65535.00 DFES_OneToOne 0.00 65535.00 FORMAT "%8.2" /end CHARACTERISTIC
/begin CHARACTERISTIC DFC_CtlMsk.DFC_MisfDetVWhlReLeOORHi_C "Behaviour control mask / Behaviour control masks of check DFC_MisfDetVWhlReLeOORHi" VALUE 0x804D9176 Val_Wu16 65535.00 DFES_OneToOne 0.00 65535.00 FORMAT "%8.2" /end CHARACTERISTIC
/begin CHARACTERISTIC DFC_CtlMsk.DFC_MisfDetVWhlReLeRatyHi_C "Behaviour control mask / Behaviour control masks of check DFC_MisfDetVWhlReLeRatyHi" VALUE 0x804D9178 Val_Wu16 65535.00 DFES_OneToOne 0.00 65535.00 FORMAT "%8.2" /end CHARACTERISTIC
/begin CHARACTERISTIC DFC_CtlMsk.DFC_MisfDetVWhlReLeRatyLo_C "Behaviour control mask / Behaviour control masks of check DFC_MisfDetVWhlReLeRatyLo" VALUE 0x804D917A Val_Wu16 65535.00 DFES_OneToOne 0.00 65535.00 FORMAT "%8.2" /end CHARACTERISTIC
/begin CHARACTERISTIC DFC_CtlMsk.DFC_MisfDetVWhlReLeStuck_C "Behaviour control mask / Behaviour control masks of check DFC_MisfDetVWhlReLeStuck" VALUE 0x804D917C Val_Wu16 65535.00 DFES_OneToOne 0.00 65535.00 FORMAT "%8.2" /end CHARACTERISTIC
/begin CHARACTERISTIC DFC_CtlMsk.DFC_MisfDetVWhlReRiOORHi_C "Behaviour control mask / Behaviour control masks of check DFC_MisfDetVWhlReRiOORHi" VALUE 0x804D917E Val_Wu16 65535.00 DFES_OneToOne 0.00 65535.00 FORMAT "%8.2" /end CHARACTERISTIC
/begin CHARACTERISTIC DFC_CtlMsk.DFC_MisfDetVWhlReRiRatyHi_C "Behaviour control mask / Behaviour control masks of check DFC_MisfDetVWhlReRiRatyHi" VALUE 0x804D9180 Val_Wu16 65535.00 DFES_OneToOne 0.00 65535.00 FORMAT "%8.2" /end CHARACTERISTIC
/begin CHARACTERISTIC DFC_CtlMsk.DFC_MisfDetVWhlReRiRatyLo_C "Behaviour control mask / Behaviour control masks of check DFC_MisfDetVWhlReRiRatyLo" VALUE 0x804D9182 Val_Wu16 65535.00 DFES_OneToOne 0.00 65535.00 FORMAT "%8.2" /end CHARACTERISTIC
/begin CHARACTERISTIC DFC_CtlMsk.DFC_MisfDetVWhlReRiStuck_C "Behaviour control mask / Behaviour control masks of check DFC_MisfDetVWhlReRiStuck" VALUE 0x804D9184 Val_Wu16 65535.00 DFES_OneToOne 0.00 65535.00 FORMAT "%8.2" /end CHARACTERISTIC
/begin CHARACTERISTIC DFC_CtlMsk.DFC_MisfDetdVWhlFrntLePlaus_C "Behaviour control mask / Behaviour control masks of check DFC_MisfDetdVWhlFrntLePlaus" VALUE 0x804D9186 Val_Wu16 65535.00 DFES_OneToOne 0.00 65535.00 FORMAT "%8.2" /end CHARACTERISTIC
/begin CHARACTERISTIC DFC_CtlMsk.DFC_MisfDetdVWhlFrntRiPlaus_C "Behaviour control mask / Behaviour control masks of check DFC_MisfDetdVWhlFrntRiPlaus" VALUE 0x804D9188 Val_Wu16 65535.00 DFES_OneToOne 0.00 65535.00 FORMAT "%8.2" /end CHARACTERISTIC
/begin CHARACTERISTIC DFC_CtlMsk.DFC_MisfDetdVWhlReLePlaus_C "Behaviour control mask / Behaviour control masks of check DFC_MisfDetdVWhlReLePlaus" VALUE 0x804D918A Val_Wu16 65535.00 DFES_OneToOne 0.00 65535.00 FORMAT "%8.2" /end CHARACTERISTIC
/begin CHARACTERISTIC DFC_CtlMsk.DFC_MisfDetdVWhlReRiPlaus_C "Behaviour control mask / Behaviour control masks of check DFC_MisfDetdVWhlReRiPlaus" VALUE 0x804D918C Val_Wu16 65535.00 DFES_OneToOne 0.00 65535.00 FORMAT "%8.2" /end CHARACTERISTIC
/begin CHARACTERISTIC DFC_CtlMsk.DFC_PEnvSigRngMax_C "Behaviour control mask / Behaviour control masks of check DFC_PEnvSigRngMax" VALUE 0x804D918E Val_Wu16 65535.00 DFES_OneToOne 0.00 65535.00 FORMAT "%8.2" /end CHARACTERISTIC
/begin CHARACTERISTIC DFC_CtlMsk.DFC_PEnvSigRngMin_C "Behaviour control mask / Behaviour control masks of check DFC_PEnvSigRngMin" VALUE 0x804D9190 Val_Wu16 65535.00 DFES_OneToOne 0.00 65535.00 FORMAT "%8.2" /end CHARACTERISTIC
/begin CHARACTERISTIC DFC_CtlMsk.DFC_StmFault_C "Behaviour control mask / Behaviour control masks of check DFC_StmFault" VALUE 0x804D9192 Val_Wu16 65535.00 DFES_OneToOne 0.00 65535.00 FORMAT "%8.2" /end CHARACTERISTIC
/begin CHARACTERISTIC DFC_CtlMsk.DFC_StrtCtOffPth_C "Behaviour control mask / Behaviour control masks of check DFC_StrtCtOffPth" VALUE 0x804D9194 Val_Wu16 65535.00 DFES_OneToOne 0.00 65535.00 FORMAT "%8.2" /end CHARACTERISTIC
/begin CHARACTERISTIC DFC_CtlMsk.DFC_StrtCtlErr_C "Behaviour control mask / Behaviour control masks of check DFC_StrtCtlErr" VALUE 0x804D9196 Val_Wu16 65535.00 DFES_OneToOne 0.00 65535.00 FORMAT "%8.2" /end CHARACTERISTIC
/begin CHARACTERISTIC DFC_CtlMsk.DFC_StrtFault_C "Behaviour control mask / Behaviour control masks of check DFC_StrtFault" VALUE 0x804D9198 Val_Wu16 65535.00 DFES_OneToOne 0.00 65535.00 FORMAT "%8.2" /end CHARACTERISTIC
/begin CHARACTERISTIC DFC_CtlMsk.DFC_StrtLckJudg1_C "Behaviour control mask / Behaviour control masks of check DFC_StrtLckJudg1" VALUE 0x804D919A Val_Wu16 65535.00 DFES_OneToOne 0.00 65535.00 FORMAT "%8.2" /end CHARACTERISTIC
/begin CHARACTERISTIC DFC_CtlMsk.DFC_StrtLckJudg2_C "Behaviour control mask / Behaviour control masks of check DFC_StrtLckJudg2" VALUE 0x804D919C Val_Wu16 65535.00 DFES_OneToOne 0.00 65535.00 FORMAT "%8.2" /end CHARACTERISTIC
/begin CHARACTERISTIC DFC_CtlMsk.DFC_StrtOL_C "Behaviour control mask / Behaviour control masks of check DFC_StrtOL" VALUE 0x804D919E Val_Wu16 65535.00 DFES_OneToOne 0.00 65535.00 FORMAT "%8.2" /end CHARACTERISTIC
/begin CHARACTERISTIC DFC_CtlMsk.DFC_StrtOL2_C "Behaviour control mask / Behaviour control masks of check DFC_StrtOL2" VALUE 0x804D91A0 Val_Wu16 65535.00 DFES_OneToOne 0.00 65535.00 FORMAT "%8.2" /end CHARACTERISTIC
/begin CHARACTERISTIC DFC_CtlMsk.DFC_StrtSCB_C "Behaviour control mask / Behaviour control masks of check DFC_StrtSCB" VALUE 0x804D91A2 Val_Wu16 65535.00 DFES_OneToOne 0.00 65535.00 FORMAT "%8.2" /end CHARACTERISTIC
/begin CHARACTERISTIC DFC_CtlMsk.DFC_StrtSCB2_C "Behaviour control mask / Behaviour control masks of check DFC_StrtSCB2" VALUE 0x804D91A4 Val_Wu16 65535.00 DFES_OneToOne 0.00 65535.00 FORMAT "%8.2" /end CHARACTERISTIC
/begin CHARACTERISTIC DFC_CtlMsk.DFC_StrtSCG_C "Behaviour control mask / Behaviour control masks of check DFC_StrtSCG" VALUE 0x804D91A6 Val_Wu16 65535.00 DFES_OneToOne 0.00 65535.00 FORMAT "%8.2" /end CHARACTERISTIC
/begin CHARACTERISTIC DFC_CtlMsk.DFC_StrtSCG2_C "Behaviour control mask / Behaviour control masks of check DFC_StrtSCG2" VALUE 0x804D91A8 Val_Wu16 65535.00 DFES_OneToOne 0.00 65535.00 FORMAT "%8.2" /end CHARACTERISTIC
/begin CHARACTERISTIC DFC_CtlMsk.DFC_StrtStkRly1_C "Behaviour control mask / Behaviour control masks of check DFC_StrtStkRly1" VALUE 0x804D91AA Val_Wu16 65535.00 DFES_OneToOne 0.00 65535.00 FORMAT "%8.2" /end CHARACTERISTIC
/begin CHARACTERISTIC DFC_CtlMsk.DFC_StrtStkRly2_C "Behaviour control mask / Behaviour control masks of check DFC_StrtStkRly2" VALUE 0x804D91AC Val_Wu16 65535.00 DFES_OneToOne 0.00 65535.00 FORMAT "%8.2" /end CHARACTERISTIC
/begin CHARACTERISTIC DFC_CtlMsk.DFC_TEVEmax_C "Behaviour control mask / Behaviour control masks of check DFC_TEVEmax" VALUE 0x804D91AE Val_Wu16 65535.00 DFES_OneToOne 0.00 65535.00 FORMAT "%8.2" /end CHARACTERISTIC
/begin CHARACTERISTIC DFC_CtlMsk.DFC_TEVEmin_C "Behaviour control mask / Behaviour control masks of check DFC_TEVEmin" VALUE 0x804D91B0 Val_Wu16 65535.00 DFES_OneToOne 0.00 65535.00 FORMAT "%8.2" /end CHARACTERISTIC
/begin CHARACTERISTIC DFC_CtlMsk.DFC_TEVEsig_C "Behaviour control mask / Behaviour control masks of check DFC_TEVEsig" VALUE 0x804D91B2 Val_Wu16 65535.00 DFES_OneToOne 0.00 65535.00 FORMAT "%8.2" /end CHARACTERISTIC
/begin CHARACTERISTIC DFC_CtlMsk.DFC_UegoHeatrPrfmncLoS1B1_C "Behaviour control mask / Behaviour control masks of check DFC_UegoHeatrPrfmncLoS1B1" VALUE 0x804D91B4 Val_Wu16 65535.00 DFES_OneToOne 0.00 65535.00 FORMAT "%8.2" /end CHARACTERISTIC
/begin CHARACTERISTIC DFC_CtlMsk.DFC_VehVAllPlaus_C "Behaviour control mask / Behaviour control masks of check DFC_VehVAllPlaus" VALUE 0x804D91B6 Val_Wu16 65535.00 DFES_OneToOne 0.00 65535.00 FORMAT "%8.2" /end CHARACTERISTIC
/begin CHARACTERISTIC DFC_CtlMsk.DFC_VehVNCSnsrElecFailr_C "Behaviour control mask / Behaviour control masks of check DFC_VehVNCSnsrElecFailr" VALUE 0x804D91B8 Val_Wu16 65535.00 DFES_OneToOne 0.00 65535.00 FORMAT "%8.2" /end CHARACTERISTIC
/begin CHARACTERISTIC DFC_CtlMsk.DFC_VehVPlausCan_C "Behaviour control mask / Behaviour control masks of check DFC_VehVPlausCan" VALUE 0x804D91BA Val_Wu16 65535.00 DFES_OneToOne 0.00 65535.00 FORMAT "%8.2" /end CHARACTERISTIC
/begin CHARACTERISTIC DFC_CtlMsk.DFC_VehVPlausFco_C "Behaviour control mask / Behaviour control masks of check DFC_VehVPlausFco" VALUE 0x804D91BC Val_Wu16 65535.00 DFES_OneToOne 0.00 65535.00 FORMAT "%8.2" /end CHARACTERISTIC
/begin CHARACTERISTIC DFC_CtlMsk.DFC_VehVPlausPwr_C "Behaviour control mask / Behaviour control masks of check DFC_VehVPlausPwr" VALUE 0x804D91BE Val_Wu16 65535.00 DFES_OneToOne 0.00 65535.00 FORMAT "%8.2" /end CHARACTERISTIC
/begin CHARACTERISTIC DFC_CtlMsk.DFC_VehVPlausV2N_C "Behaviour control mask / Behaviour control masks of check DFC_VehVPlausV2N" VALUE 0x804D91C0 Val_Wu16 65535.00 DFES_OneToOne 0.00 65535.00 FORMAT "%8.2" /end CHARACTERISTIC
/begin CHARACTERISTIC DFC_CtlMsk.DFC_VehVSpdSnsrAElecFailr_C "Behaviour control mask / Behaviour control masks of check DFC_VehVSpdSnsrAElecFailr" VALUE 0x804D91C2 Val_Wu16 65535.00 DFES_OneToOne 0.00 65535.00 FORMAT "%8.2" /end CHARACTERISTIC
/begin CHARACTERISTIC DFC_CtlMsk.DFC_VehVSpdSnsrBElecFailr_C "Behaviour control mask / Behaviour control masks of check DFC_VehVSpdSnsrBElecFailr" VALUE 0x804D91C4 Val_Wu16 65535.00 DFES_OneToOne 0.00 65535.00 FORMAT "%8.2" /end CHARACTERISTIC
/begin CHARACTERISTIC DFC_CtlMsk.DFC_ClthMax_C "Behaviour control mask / Behaviour control masks of check DFC_ClthMax" VALUE 0x804D91C6 Val_Wu16 65535.00 DFES_OneToOne 0.00 65535.00 FORMAT "%8.2" /end CHARACTERISTIC
/begin CHARACTERISTIC DFC_CtlMsk.DFC_IgnClPs_DevComErr_C "Behaviour control mask / Behaviour control masks of check DFC_IgnClPs_DevComErr" VALUE 0x804D91C8 Val_Wu16 65535.00 DFES_OneToOne 0.00 65535.00 FORMAT "%8.2" /end CHARACTERISTIC
/begin CHARACTERISTIC DFC_CtlMsk.DFC_IgnClPs_LineOl_0_C "Behaviour control mask / Behaviour control masks of check DFC_IgnClPs_LineOl_0" VALUE 0x804D91CA Val_Wu16 65535.00 DFES_OneToOne 0.00 65535.00 FORMAT "%8.2" /end CHARACTERISTIC
/begin CHARACTERISTIC DFC_CtlMsk.DFC_IgnClPs_LineOl_1_C "Behaviour control mask / Behaviour control masks of check DFC_IgnClPs_LineOl_1" VALUE 0x804D91CC Val_Wu16 65535.00 DFES_OneToOne 0.00 65535.00 FORMAT "%8.2" /end CHARACTERISTIC
/begin CHARACTERISTIC DFC_CtlMsk.DFC_IgnClPs_LineOl_2_C "Behaviour control mask / Behaviour control masks of check DFC_IgnClPs_LineOl_2" VALUE 0x804D91CE Val_Wu16 65535.00 DFES_OneToOne 0.00 65535.00 FORMAT "%8.2" /end CHARACTERISTIC
/begin CHARACTERISTIC DFC_CtlMsk.DFC_IgnClPs_LineOl_3_C "Behaviour control mask / Behaviour control masks of check DFC_IgnClPs_LineOl_3" VALUE 0x804D91D0 Val_Wu16 65535.00 DFES_OneToOne 0.00 65535.00 FORMAT "%8.2" /end CHARACTERISTIC
/begin CHARACTERISTIC DFC_CtlMsk.DFC_IgnClPs_LineScb_0_C "Behaviour control mask / Behaviour control masks of check DFC_IgnClPs_LineScb_0" VALUE 0x804D91D2 Val_Wu16 65535.00 DFES_OneToOne 0.00 65535.00 FORMAT "%8.2" /end CHARACTERISTIC
/begin CHARACTERISTIC DFC_CtlMsk.DFC_IgnClPs_LineScb_1_C "Behaviour control mask / Behaviour control masks of check DFC_IgnClPs_LineScb_1" VALUE 0x804D91D4 Val_Wu16 65535.00 DFES_OneToOne 0.00 65535.00 FORMAT "%8.2" /end CHARACTERISTIC
/begin CHARACTERISTIC DFC_CtlMsk.DFC_IgnClPs_LineScb_2_C "Behaviour control mask / Behaviour control masks of check DFC_IgnClPs_LineScb_2" VALUE 0x804D91D6 Val_Wu16 65535.00 DFES_OneToOne 0.00 65535.00 FORMAT "%8.2" /end CHARACTERISTIC
/begin CHARACTERISTIC DFC_CtlMsk.DFC_IgnClPs_LineScb_3_C "Behaviour control mask / Behaviour control masks of check DFC_IgnClPs_LineScb_3" VALUE 0x804D91D8 Val_Wu16 65535.00 DFES_OneToOne 0.00 65535.00 FORMAT "%8.2" /end CHARACTERISTIC
/begin CHARACTERISTIC DFC_CtlMsk.DFC_IgnClPs_LineScg_0_C "Behaviour control mask / Behaviour control masks of check DFC_IgnClPs_LineScg_0" VALUE 0x804D91DA Val_Wu16 65535.00 DFES_OneToOne 0.00 65535.00 FORMAT "%8.2" /end CHARACTERISTIC
/begin CHARACTERISTIC DFC_CtlMsk.DFC_IgnClPs_LineScg_1_C "Behaviour control mask / Behaviour control masks of check DFC_IgnClPs_LineScg_1" VALUE 0x804D91DC Val_Wu16 65535.00 DFES_OneToOne 0.00 65535.00 FORMAT "%8.2" /end CHARACTERISTIC
/begin CHARACTERISTIC DFC_CtlMsk.DFC_IgnClPs_LineScg_2_C "Behaviour control mask / Behaviour control masks of check DFC_IgnClPs_LineScg_2" VALUE 0x804D91DE Val_Wu16 65535.00 DFES_OneToOne 0.00 65535.00 FORMAT "%8.2" /end CHARACTERISTIC
/begin CHARACTERISTIC DFC_CtlMsk.DFC_IgnClPs_LineScg_3_C "Behaviour control mask / Behaviour control masks of check DFC_IgnClPs_LineScg_3" VALUE 0x804D91E0 Val_Wu16 65535.00 DFES_OneToOne 0.00 65535.00 FORMAT "%8.2" /end CHARACTERISTIC
/begin CHARACTERISTIC DFC_CtlMsk.DFC_KRVEKOEVAB_C "Behaviour control mask / Behaviour control masks of check DFC_KRVEKOEVAB" VALUE 0x804D91E2 Val_Wu16 65535.00 DFES_OneToOne 0.00 65535.00 FORMAT "%8.2" /end CHARACTERISTIC
/begin CHARACTERISTIC DFC_CtlMsk.DFC_KRVEKOEVAB0_C "Behaviour control mask / Behaviour control masks of check DFC_KRVEKOEVAB0" VALUE 0x804D91E4 Val_Wu16 65535.00 DFES_OneToOne 0.00 65535.00 FORMAT "%8.2" /end CHARACTERISTIC
/begin CHARACTERISTIC DFC_CtlMsk.DFC_KRVEKOEVAB1_C "Behaviour control mask / Behaviour control masks of check DFC_KRVEKOEVAB1" VALUE 0x804D91E6 Val_Wu16 65535.00 DFES_OneToOne 0.00 65535.00 FORMAT "%8.2" /end CHARACTERISTIC
/begin CHARACTERISTIC DFC_CtlMsk.DFC_KRVEKOEVAB2_C "Behaviour control mask / Behaviour control masks of check DFC_KRVEKOEVAB2" VALUE 0x804D91E8 Val_Wu16 65535.00 DFES_OneToOne 0.00 65535.00 FORMAT "%8.2" /end CHARACTERISTIC
/begin CHARACTERISTIC DFC_CtlMsk.DFC_KRVEKOEVAB3_C "Behaviour control mask / Behaviour control masks of check DFC_KRVEKOEVAB3" VALUE 0x804D91EA Val_Wu16 65535.00 DFES_OneToOne 0.00 65535.00 FORMAT "%8.2" /end CHARACTERISTIC
/begin CHARACTERISTIC DFC_CtlMsk.DFC_UegoSigEcuAsicS1B1_C "Behaviour control mask / Behaviour control masks of check DFC_UegoSigEcuAsicS1B1" VALUE 0x804D91EC Val_Wu16 65535.00 DFES_OneToOne 0.00 65535.00 FORMAT "%8.2" /end CHARACTERISTIC
/begin CHARACTERISTIC DFC_CtlMsk.DFC_UegoSigEcuComS1B1_C "Behaviour control mask / Behaviour control masks of check DFC_UegoSigEcuComS1B1" VALUE 0x804D91EE Val_Wu16 65535.00 DFES_OneToOne 0.00 65535.00 FORMAT "%8.2" /end CHARACTERISTIC
/begin CHARACTERISTIC DFC_CtlMsk.DFC_UegoSigSnsrS1B1_C "Behaviour control mask / Behaviour control masks of check DFC_UegoSigSnsrS1B1" VALUE 0x804D91F0 Val_Wu16 65535.00 DFES_OneToOne 0.00 65535.00 FORMAT "%8.2" /end CHARACTERISTIC
/begin CHARACTERISTIC DFC_CtlMsk.DFC_UegoSigWireOlApesS1B1_C "Behaviour control mask / Behaviour control masks of check DFC_UegoSigWireOlApesS1B1" VALUE 0x804D91F2 Val_Wu16 65535.00 DFES_OneToOne 0.00 65535.00 FORMAT "%8.2" /end CHARACTERISTIC
/begin CHARACTERISTIC DFC_CtlMsk.DFC_UegoSigWireOlIpeS1B1_C "Behaviour control mask / Behaviour control masks of check DFC_UegoSigWireOlIpeS1B1" VALUE 0x804D91F4 Val_Wu16 65535.00 DFES_OneToOne 0.00 65535.00 FORMAT "%8.2" /end CHARACTERISTIC
/begin CHARACTERISTIC DFC_CtlMsk.DFC_UegoSigWireOlReS1B1_C "Behaviour control mask / Behaviour control masks of check DFC_UegoSigWireOlReS1B1" VALUE 0x804D91F6 Val_Wu16 65535.00 DFES_OneToOne 0.00 65535.00 FORMAT "%8.2" /end CHARACTERISTIC
/begin CHARACTERISTIC DFC_CtlMsk.DFC_UegoSigWireRCmpS1B1_C "Behaviour control mask / Behaviour control masks of check DFC_UegoSigWireRCmpS1B1" VALUE 0x804D91F8 Val_Wu16 65535.00 DFES_OneToOne 0.00 65535.00 FORMAT "%8.2" /end CHARACTERISTIC
/begin CHARACTERISTIC DFC_CtlMsk.DFC_UegoSigWireScbS1B1_C "Behaviour control mask / Behaviour control masks of check DFC_UegoSigWireScbS1B1" VALUE 0x804D91FA Val_Wu16 65535.00 DFES_OneToOne 0.00 65535.00 FORMAT "%8.2" /end CHARACTERISTIC
/begin CHARACTERISTIC DFC_CtlMsk.DFC_UegoSigWireScgS1B1_C "Behaviour control mask / Behaviour control masks of check DFC_UegoSigWireScgS1B1" VALUE 0x804D91FC Val_Wu16 65535.00 DFES_OneToOne 0.00 65535.00 FORMAT "%8.2" /end CHARACTERISTIC
/begin CHARACTERISTIC DFC_CtlMsk.DFC_AfsPhyRngHiB1_C "Behaviour control mask / Behaviour control masks of check DFC_AfsPhyRngHiB1" VALUE 0x804D91FE Val_Wu16 65535.00 DFES_OneToOne 0.00 65535.00 FORMAT "%8.2" /end CHARACTERISTIC
/begin CHARACTERISTIC DFC_CtlMsk.DFC_AfsPhyRngLoB1_C "Behaviour control mask / Behaviour control masks of check DFC_AfsPhyRngLoB1" VALUE 0x804D9200 Val_Wu16 65535.00 DFES_OneToOne 0.00 65535.00 FORMAT "%8.2" /end CHARACTERISTIC
/begin CHARACTERISTIC DFC_CtlMsk.DFC_AirCCmprOL_C "Behaviour control mask / Behaviour control masks of check DFC_AirCCmprOL" VALUE 0x804D9202 Val_Wu16 65535.00 DFES_OneToOne 0.00 65535.00 FORMAT "%8.2" /end CHARACTERISTIC
/begin CHARACTERISTIC DFC_CtlMsk.DFC_AirCCmprOvrTemp_C "Behaviour control mask / Behaviour control masks of check DFC_AirCCmprOvrTemp" VALUE 0x804D9204 Val_Wu16 65535.00 DFES_OneToOne 0.00 65535.00 FORMAT "%8.2" /end CHARACTERISTIC
/begin CHARACTERISTIC DFC_CtlMsk.DFC_AirCCmprSCB_C "Behaviour control mask / Behaviour control masks of check DFC_AirCCmprSCB" VALUE 0x804D9206 Val_Wu16 65535.00 DFES_OneToOne 0.00 65535.00 FORMAT "%8.2" /end CHARACTERISTIC
/begin CHARACTERISTIC DFC_CtlMsk.DFC_AirCCmprSCG_C "Behaviour control mask / Behaviour control masks of check DFC_AirCCmprSCG" VALUE 0x804D9208 Val_Wu16 65535.00 DFES_OneToOne 0.00 65535.00 FORMAT "%8.2" /end CHARACTERISTIC
/begin CHARACTERISTIC DFC_CtlMsk.DFC_AltErr_C "Behaviour control mask / Behaviour control masks of check DFC_AltErr" VALUE 0x804D920A Val_Wu16 65535.00 DFES_OneToOne 0.00 65535.00 FORMAT "%8.2" /end CHARACTERISTIC
/begin CHARACTERISTIC DFC_CtlMsk.DFC_BattUSRCMax_C "Behaviour control mask / Behaviour control masks of check DFC_BattUSRCMax" VALUE 0x804D920C Val_Wu16 65535.00 DFES_OneToOne 0.00 65535.00 FORMAT "%8.2" /end CHARACTERISTIC
/begin CHARACTERISTIC DFC_CtlMsk.DFC_BattUSRCMin_C "Behaviour control mask / Behaviour control masks of check DFC_BattUSRCMin" VALUE 0x804D920E Val_Wu16 65535.00 DFES_OneToOne 0.00 65535.00 FORMAT "%8.2" /end CHARACTERISTIC
/begin CHARACTERISTIC DFC_CtlMsk.DFC_ComChksTCU1_C "Behaviour control mask / Behaviour control masks of check DFC_ComChksTCU1" VALUE 0x804D9210 Val_Wu16 65535.00 DFES_OneToOne 0.00 65535.00 FORMAT "%8.2" /end CHARACTERISTIC
/begin CHARACTERISTIC DFC_CtlMsk.DFC_ComChksTCU11_C "Behaviour control mask / Behaviour control masks of check DFC_ComChksTCU11" VALUE 0x804D9212 Val_Wu16 65535.00 DFES_OneToOne 0.00 65535.00 FORMAT "%8.2" /end CHARACTERISTIC
/begin CHARACTERISTIC DFC_CtlMsk.DFC_ComChksTCU12_C "Behaviour control mask / Behaviour control masks of check DFC_ComChksTCU12" VALUE 0x804D9214 Val_Wu16 65535.00 DFES_OneToOne 0.00 65535.00 FORMAT "%8.2" /end CHARACTERISTIC
/begin CHARACTERISTIC DFC_CtlMsk.DFC_ComChksTCU13_C "Behaviour control mask / Behaviour control masks of check DFC_ComChksTCU13" VALUE 0x804D9216 Val_Wu16 65535.00 DFES_OneToOne 0.00 65535.00 FORMAT "%8.2" /end CHARACTERISTIC
/begin CHARACTERISTIC DFC_CtlMsk.DFC_ComChksTCU2_C "Behaviour control mask / Behaviour control masks of check DFC_ComChksTCU2" VALUE 0x804D9218 Val_Wu16 65535.00 DFES_OneToOne 0.00 65535.00 FORMAT "%8.2" /end CHARACTERISTIC
/begin CHARACTERISTIC DFC_CtlMsk.DFC_ComChksTCU3_C "Behaviour control mask / Behaviour control masks of check DFC_ComChksTCU3" VALUE 0x804D921A Val_Wu16 65535.00 DFES_OneToOne 0.00 65535.00 FORMAT "%8.2" /end CHARACTERISTIC
/begin CHARACTERISTIC DFC_CtlMsk.DFC_ComChksTCU4_C "Behaviour control mask / Behaviour control masks of check DFC_ComChksTCU4" VALUE 0x804D921C Val_Wu16 65535.00 DFES_OneToOne 0.00 65535.00 FORMAT "%8.2" /end CHARACTERISTIC
/begin CHARACTERISTIC DFC_CtlMsk.DFC_ComCntTCU1_C "Behaviour control mask / Behaviour control masks of check DFC_ComCntTCU1" VALUE 0x804D921E Val_Wu16 65535.00 DFES_OneToOne 0.00 65535.00 FORMAT "%8.2" /end CHARACTERISTIC
/begin CHARACTERISTIC DFC_CtlMsk.DFC_ComCntTCU11_C "Behaviour control mask / Behaviour control masks of check DFC_ComCntTCU11" VALUE 0x804D9220 Val_Wu16 65535.00 DFES_OneToOne 0.00 65535.00 FORMAT "%8.2" /end CHARACTERISTIC
/begin CHARACTERISTIC DFC_CtlMsk.DFC_ComCntTCU12_C "Behaviour control mask / Behaviour control masks of check DFC_ComCntTCU12" VALUE 0x804D9222 Val_Wu16 65535.00 DFES_OneToOne 0.00 65535.00 FORMAT "%8.2" /end CHARACTERISTIC
/begin CHARACTERISTIC DFC_CtlMsk.DFC_ComCntTCU13_C "Behaviour control mask / Behaviour control masks of check DFC_ComCntTCU13" VALUE 0x804D9224 Val_Wu16 65535.00 DFES_OneToOne 0.00 65535.00 FORMAT "%8.2" /end CHARACTERISTIC
/begin CHARACTERISTIC DFC_CtlMsk.DFC_ComCntTCU2_C "Behaviour control mask / Behaviour control masks of check DFC_ComCntTCU2" VALUE 0x804D9226 Val_Wu16 65535.00 DFES_OneToOne 0.00 65535.00 FORMAT "%8.2" /end CHARACTERISTIC
/begin CHARACTERISTIC DFC_CtlMsk.DFC_ComCntTCU3_C "Behaviour control mask / Behaviour control masks of check DFC_ComCntTCU3" VALUE 0x804D9228 Val_Wu16 65535.00 DFES_OneToOne 0.00 65535.00 FORMAT "%8.2" /end CHARACTERISTIC
/begin CHARACTERISTIC DFC_CtlMsk.DFC_ComCntTCU4_C "Behaviour control mask / Behaviour control masks of check DFC_ComCntTCU4" VALUE 0x804D922A Val_Wu16 65535.00 DFES_OneToOne 0.00 65535.00 FORMAT "%8.2" /end CHARACTERISTIC
/begin CHARACTERISTIC DFC_CtlMsk.DFC_ComTOutTCU01_C "Behaviour control mask / Behaviour control masks of check DFC_ComTOutTCU01" VALUE 0x804D922C Val_Wu16 65535.00 DFES_OneToOne 0.00 65535.00 FORMAT "%8.2" /end CHARACTERISTIC
/begin CHARACTERISTIC DFC_CtlMsk.DFC_ComTOutTCU02_C "Behaviour control mask / Behaviour control masks of check DFC_ComTOutTCU02" VALUE 0x804D922E Val_Wu16 65535.00 DFES_OneToOne 0.00 65535.00 FORMAT "%8.2" /end CHARACTERISTIC
/begin CHARACTERISTIC DFC_CtlMsk.DFC_ComTOutTCU1_C "Behaviour control mask / Behaviour control masks of check DFC_ComTOutTCU1" VALUE 0x804D9230 Val_Wu16 65535.00 DFES_OneToOne 0.00 65535.00 FORMAT "%8.2" /end CHARACTERISTIC
/begin CHARACTERISTIC DFC_CtlMsk.DFC_ComTOutTCU11_C "Behaviour control mask / Behaviour control masks of check DFC_ComTOutTCU11" VALUE 0x804D9232 Val_Wu16 65535.00 DFES_OneToOne 0.00 65535.00 FORMAT "%8.2" /end CHARACTERISTIC
/begin CHARACTERISTIC DFC_CtlMsk.DFC_ComTOutTCU12_C "Behaviour control mask / Behaviour control masks of check DFC_ComTOutTCU12" VALUE 0x804D9234 Val_Wu16 65535.00 DFES_OneToOne 0.00 65535.00 FORMAT "%8.2" /end CHARACTERISTIC
/begin CHARACTERISTIC DFC_CtlMsk.DFC_ComTOutTCU13_C "Behaviour control mask / Behaviour control masks of check DFC_ComTOutTCU13" VALUE 0x804D9236 Val_Wu16 65535.00 DFES_OneToOne 0.00 65535.00 FORMAT "%8.2" /end CHARACTERISTIC
/begin CHARACTERISTIC DFC_CtlMsk.DFC_ComTOutTCU14_C "Behaviour control mask / Behaviour control masks of check DFC_ComTOutTCU14" VALUE 0x804D9238 Val_Wu16 65535.00 DFES_OneToOne 0.00 65535.00 FORMAT "%8.2" /end CHARACTERISTIC
/begin CHARACTERISTIC DFC_CtlMsk.DFC_ComTOutTCU2_C "Behaviour control mask / Behaviour control masks of check DFC_ComTOutTCU2" VALUE 0x804D923A Val_Wu16 65535.00 DFES_OneToOne 0.00 65535.00 FORMAT "%8.2" /end CHARACTERISTIC
/begin CHARACTERISTIC DFC_CtlMsk.DFC_ComTOutTCU3_C "Behaviour control mask / Behaviour control masks of check DFC_ComTOutTCU3" VALUE 0x804D923C Val_Wu16 65535.00 DFES_OneToOne 0.00 65535.00 FORMAT "%8.2" /end CHARACTERISTIC
/begin CHARACTERISTIC DFC_CtlMsk.DFC_ComTOutTCU4_C "Behaviour control mask / Behaviour control masks of check DFC_ComTOutTCU4" VALUE 0x804D923E Val_Wu16 65535.00 DFES_OneToOne 0.00 65535.00 FORMAT "%8.2" /end CHARACTERISTIC
/begin CHARACTERISTIC DFC_CtlMsk.DFC_DevLibBattUHi_C "Behaviour control mask / Behaviour control masks of check DFC_DevLibBattUHi" VALUE 0x804D9240 Val_Wu16 65535.00 DFES_OneToOne 0.00 65535.00 FORMAT "%8.2" /end CHARACTERISTIC
/begin CHARACTERISTIC DFC_CtlMsk.DFC_DevLibBattULo_C "Behaviour control mask / Behaviour control masks of check DFC_DevLibBattULo" VALUE 0x804D9242 Val_Wu16 65535.00 DFES_OneToOne 0.00 65535.00 FORMAT "%8.2" /end CHARACTERISTIC
/begin CHARACTERISTIC DFC_CtlMsk.DFC_EGRVlvFailSafeActv_C "Behaviour control mask / Behaviour control masks of check DFC_EGRVlvFailSafeActv" VALUE 0x804D9244 Val_Wu16 65535.00 DFES_OneToOne 0.00 65535.00 FORMAT "%8.2" /end CHARACTERISTIC
/begin CHARACTERISTIC DFC_CtlMsk.DFC_EGRVlvGovDvtCld_C "Behaviour control mask / Behaviour control masks of check DFC_EGRVlvGovDvtCld" VALUE 0x804D9246 Val_Wu16 65535.00 DFES_OneToOne 0.00 65535.00 FORMAT "%8.2" /end CHARACTERISTIC
/begin CHARACTERISTIC DFC_CtlMsk.DFC_EGRVlvPhysSRCMax_C "Behaviour control mask / Behaviour control masks of check DFC_EGRVlvPhysSRCMax" VALUE 0x804D9248 Val_Wu16 65535.00 DFES_OneToOne 0.00 65535.00 FORMAT "%8.2" /end CHARACTERISTIC
/begin CHARACTERISTIC DFC_CtlMsk.DFC_EGRVlvPhysSRCMin_C "Behaviour control mask / Behaviour control masks of check DFC_EGRVlvPhysSRCMin" VALUE 0x804D924A Val_Wu16 65535.00 DFES_OneToOne 0.00 65535.00 FORMAT "%8.2" /end CHARACTERISTIC
/begin CHARACTERISTIC DFC_CtlMsk.DFC_FanDIOOL_0_C "Behaviour control mask / Behaviour control masks of check DFC_FanDIOOL_0" VALUE 0x804D924C Val_Wu16 65535.00 DFES_OneToOne 0.00 65535.00 FORMAT "%8.2" /end CHARACTERISTIC
/begin CHARACTERISTIC DFC_CtlMsk.DFC_FanDIOOL_1_C "Behaviour control mask / Behaviour control masks of check DFC_FanDIOOL_1" VALUE 0x804D924E Val_Wu16 65535.00 DFES_OneToOne 0.00 65535.00 FORMAT "%8.2" /end CHARACTERISTIC
/begin CHARACTERISTIC DFC_CtlMsk.DFC_FanDIOOvrTemp_0_C "Behaviour control mask / Behaviour control masks of check DFC_FanDIOOvrTemp_0" VALUE 0x804D9250 Val_Wu16 65535.00 DFES_OneToOne 0.00 65535.00 FORMAT "%8.2" /end CHARACTERISTIC
/begin CHARACTERISTIC DFC_CtlMsk.DFC_FanDIOOvrTemp_1_C "Behaviour control mask / Behaviour control masks of check DFC_FanDIOOvrTemp_1" VALUE 0x804D9252 Val_Wu16 65535.00 DFES_OneToOne 0.00 65535.00 FORMAT "%8.2" /end CHARACTERISTIC
/begin CHARACTERISTIC DFC_CtlMsk.DFC_FanDIOSCB_0_C "Behaviour control mask / Behaviour control masks of check DFC_FanDIOSCB_0" VALUE 0x804D9254 Val_Wu16 65535.00 DFES_OneToOne 0.00 65535.00 FORMAT "%8.2" /end CHARACTERISTIC
/begin CHARACTERISTIC DFC_CtlMsk.DFC_FanDIOSCB_1_C "Behaviour control mask / Behaviour control masks of check DFC_FanDIOSCB_1" VALUE 0x804D9256 Val_Wu16 65535.00 DFES_OneToOne 0.00 65535.00 FORMAT "%8.2" /end CHARACTERISTIC
/begin CHARACTERISTIC DFC_CtlMsk.DFC_FanDIOSCG_0_C "Behaviour control mask / Behaviour control masks of check DFC_FanDIOSCG_0" VALUE 0x804D9258 Val_Wu16 65535.00 DFES_OneToOne 0.00 65535.00 FORMAT "%8.2" /end CHARACTERISTIC
/begin CHARACTERISTIC DFC_CtlMsk.DFC_FanDIOSCG_1_C "Behaviour control mask / Behaviour control masks of check DFC_FanDIOSCG_1" VALUE 0x804D925A Val_Wu16 65535.00 DFES_OneToOne 0.00 65535.00 FORMAT "%8.2" /end CHARACTERISTIC
/begin CHARACTERISTIC DFC_CtlMsk.DFC_MRlyDcOL_C "Behaviour control mask / Behaviour control masks of check DFC_MRlyDcOL" VALUE 0x804D925C Val_Wu16 65535.00 DFES_OneToOne 0.00 65535.00 FORMAT "%8.2" /end CHARACTERISTIC
/begin CHARACTERISTIC DFC_CtlMsk.DFC_MRlyDcSCB_C "Behaviour control mask / Behaviour control masks of check DFC_MRlyDcSCB" VALUE 0x804D925E Val_Wu16 65535.00 DFES_OneToOne 0.00 65535.00 FORMAT "%8.2" /end CHARACTERISTIC
/begin CHARACTERISTIC DFC_CtlMsk.DFC_MRlyDcSCG_C "Behaviour control mask / Behaviour control masks of check DFC_MRlyDcSCG" VALUE 0x804D9260 Val_Wu16 65535.00 DFES_OneToOne 0.00 65535.00 FORMAT "%8.2" /end CHARACTERISTIC
/begin CHARACTERISTIC DFC_CtlMsk.DFC_PSPOL_C "Behaviour control mask / Behaviour control masks of check DFC_PSPOL" VALUE 0x804D9262 Val_Wu16 65535.00 DFES_OneToOne 0.00 65535.00 FORMAT "%8.2" /end CHARACTERISTIC
/begin CHARACTERISTIC DFC_CtlMsk.DFC_PSPOvrTemp_C "Behaviour control mask / Behaviour control masks of check DFC_PSPOvrTemp" VALUE 0x804D9264 Val_Wu16 65535.00 DFES_OneToOne 0.00 65535.00 FORMAT "%8.2" /end CHARACTERISTIC
/begin CHARACTERISTIC DFC_CtlMsk.DFC_PSPSCB_C "Behaviour control mask / Behaviour control masks of check DFC_PSPSCB" VALUE 0x804D9266 Val_Wu16 65535.00 DFES_OneToOne 0.00 65535.00 FORMAT "%8.2" /end CHARACTERISTIC
/begin CHARACTERISTIC DFC_CtlMsk.DFC_PSPSCG_C "Behaviour control mask / Behaviour control masks of check DFC_PSPSCG" VALUE 0x804D9268 Val_Wu16 65535.00 DFES_OneToOne 0.00 65535.00 FORMAT "%8.2" /end CHARACTERISTIC
/begin CHARACTERISTIC DFC_CtlMsk.DFC_T50Err_C "Behaviour control mask / Behaviour control masks of check DFC_T50Err" VALUE 0x804D926A Val_Wu16 65535.00 DFES_OneToOne 0.00 65535.00 FORMAT "%8.2" /end CHARACTERISTIC
/begin CHARACTERISTIC DFC_CtlMsk.DFC_ThrVlvLoBattB1_C "Behaviour control mask / Behaviour control masks of check DFC_ThrVlvLoBattB1" VALUE 0x804D926C Val_Wu16 65535.00 DFES_OneToOne 0.00 65535.00 FORMAT "%8.2" /end CHARACTERISTIC
/begin CHARACTERISTIC DFC_CtlMsk.DFC_UegoSigOperPlausS1B1_C "Behaviour control mask / Behaviour control masks of check DFC_UegoSigOperPlausS1B1" VALUE 0x804D926E Val_Wu16 65535.00 DFES_OneToOne 0.00 65535.00 FORMAT "%8.2" /end CHARACTERISTIC
/begin CHARACTERISTIC DFC_CtlMsk.DFC_VehVPhysRngHi_C "Behaviour control mask / Behaviour control masks of check DFC_VehVPhysRngHi" VALUE 0x804D9270 Val_Wu16 65535.00 DFES_OneToOne 0.00 65535.00 FORMAT "%8.2" /end CHARACTERISTIC
/begin CHARACTERISTIC DFC_CtlMsk.DFC_VehVSclOutOL_C "Behaviour control mask / Behaviour control masks of check DFC_VehVSclOutOL" VALUE 0x804D9272 Val_Wu16 65535.00 DFES_OneToOne 0.00 65535.00 FORMAT "%8.2" /end CHARACTERISTIC
/begin CHARACTERISTIC DFC_CtlMsk.DFC_VehVSclOutOT_C "Behaviour control mask / Behaviour control masks of check DFC_VehVSclOutOT" VALUE 0x804D9274 Val_Wu16 65535.00 DFES_OneToOne 0.00 65535.00 FORMAT "%8.2" /end CHARACTERISTIC
/begin CHARACTERISTIC DFC_CtlMsk.DFC_VehVSclOutSCB_C "Behaviour control mask / Behaviour control masks of check DFC_VehVSclOutSCB" VALUE 0x804D9276 Val_Wu16 65535.00 DFES_OneToOne 0.00 65535.00 FORMAT "%8.2" /end CHARACTERISTIC
/begin CHARACTERISTIC DFC_CtlMsk.DFC_VehVSclOutSCG_C "Behaviour control mask / Behaviour control masks of check DFC_VehVSclOutSCG" VALUE 0x804D9278 Val_Wu16 65535.00 DFES_OneToOne 0.00 65535.00 FORMAT "%8.2" /end CHARACTERISTIC
/begin CHARACTERISTIC DFC_CtlMsk.DFC_VehVSigFL_C "Behaviour control mask / Behaviour control masks of check DFC_VehVSigFL" VALUE 0x804D927A Val_Wu16 65535.00 DFES_OneToOne 0.00 65535.00 FORMAT "%8.2" /end CHARACTERISTIC
/begin CHARACTERISTIC DFC_CtlMsk.DFC_VehVSigFR_C "Behaviour control mask / Behaviour control masks of check DFC_VehVSigFR" VALUE 0x804D927C Val_Wu16 65535.00 DFES_OneToOne 0.00 65535.00 FORMAT "%8.2" /end CHARACTERISTIC
/begin CHARACTERISTIC DFC_CtlMsk.DFC_VehVSigRL_C "Behaviour control mask / Behaviour control masks of check DFC_VehVSigRL" VALUE 0x804D927E Val_Wu16 65535.00 DFES_OneToOne 0.00 65535.00 FORMAT "%8.2" /end CHARACTERISTIC
/begin CHARACTERISTIC DFC_CtlMsk.DFC_VehVSigRR_C "Behaviour control mask / Behaviour control masks of check DFC_VehVSigRR" VALUE 0x804D9280 Val_Wu16 65535.00 DFES_OneToOne 0.00 65535.00 FORMAT "%8.2" /end CHARACTERISTIC
/begin CHARACTERISTIC DFC_CtlMsk.DFC_VehVSnsrARngHi_C "Behaviour control mask / Behaviour control masks of check DFC_VehVSnsrARngHi" VALUE 0x804D9282 Val_Wu16 65535.00 DFES_OneToOne 0.00 65535.00 FORMAT "%8.2" /end CHARACTERISTIC
/begin CHARACTERISTIC DFC_CtlMsk.DFC_VehVSnsrBRngHi_C "Behaviour control mask / Behaviour control masks of check DFC_VehVSnsrBRngHi" VALUE 0x804D9284 Val_Wu16 65535.00 DFES_OneToOne 0.00 65535.00 FORMAT "%8.2" /end CHARACTERISTIC
/begin CHARACTERISTIC DFC_CtlMsk.DFC_VehVSpdRtyDiag_C "Behaviour control mask / Behaviour control masks of check DFC_VehVSpdRtyDiag" VALUE 0x804D9286 Val_Wu16 65535.00 DFES_OneToOne 0.00 65535.00 FORMAT "%8.2" /end CHARACTERISTIC
/begin CHARACTERISTIC DFC_CtlMsk.DFC_DHFHD_C "Behaviour control mask / Behaviour control masks of check DFC_DHFHD" VALUE 0x804D9288 Val_Wu16 65535.00 DFES_OneToOne 0.00 65535.00 FORMAT "%8.2" /end CHARACTERISTIC
/begin CHARACTERISTIC DFC_CtlMsk.DFC_InjVlv_DI_DcDc_C "Behaviour control mask / Behaviour control masks of check DFC_InjVlv_DI_DcDc" VALUE 0x804D928A Val_Wu16 65535.00 DFES_OneToOne 0.00 65535.00 FORMAT "%8.2" /end CHARACTERISTIC
/begin CHARACTERISTIC DFC_CtlMsk.DFC_InjVlv_DI_NoLd_0_C "Behaviour control mask / Behaviour control masks of check DFC_InjVlv_DI_NoLd_0" VALUE 0x804D928C Val_Wu16 65535.00 DFES_OneToOne 0.00 65535.00 FORMAT "%8.2" /end CHARACTERISTIC
/begin CHARACTERISTIC DFC_CtlMsk.DFC_InjVlv_DI_NoLd_1_C "Behaviour control mask / Behaviour control masks of check DFC_InjVlv_DI_NoLd_1" VALUE 0x804D928E Val_Wu16 65535.00 DFES_OneToOne 0.00 65535.00 FORMAT "%8.2" /end CHARACTERISTIC
/begin CHARACTERISTIC DFC_CtlMsk.DFC_InjVlv_DI_NoLd_2_C "Behaviour control mask / Behaviour control masks of check DFC_InjVlv_DI_NoLd_2" VALUE 0x804D9290 Val_Wu16 65535.00 DFES_OneToOne 0.00 65535.00 FORMAT "%8.2" /end CHARACTERISTIC
/begin CHARACTERISTIC DFC_CtlMsk.DFC_InjVlv_DI_NoLd_3_C "Behaviour control mask / Behaviour control masks of check DFC_InjVlv_DI_NoLd_3" VALUE 0x804D9292 Val_Wu16 65535.00 DFES_OneToOne 0.00 65535.00 FORMAT "%8.2" /end CHARACTERISTIC
/begin CHARACTERISTIC DFC_CtlMsk.DFC_InjVlv_DI_ScBnk_0_C "Behaviour control mask / Behaviour control masks of check DFC_InjVlv_DI_ScBnk_0" VALUE 0x804D9294 Val_Wu16 65535.00 DFES_OneToOne 0.00 65535.00 FORMAT "%8.2" /end CHARACTERISTIC
/begin CHARACTERISTIC DFC_CtlMsk.DFC_InjVlv_DI_ScBnk_1_C "Behaviour control mask / Behaviour control masks of check DFC_InjVlv_DI_ScBnk_1" VALUE 0x804D9296 Val_Wu16 65535.00 DFES_OneToOne 0.00 65535.00 FORMAT "%8.2" /end CHARACTERISTIC
/begin CHARACTERISTIC DFC_CtlMsk.DFC_InjVlv_DI_ScBnk_2_C "Behaviour control mask / Behaviour control masks of check DFC_InjVlv_DI_ScBnk_2" VALUE 0x804D9298 Val_Wu16 65535.00 DFES_OneToOne 0.00 65535.00 FORMAT "%8.2" /end CHARACTERISTIC
/begin CHARACTERISTIC DFC_CtlMsk.DFC_InjVlv_DI_ScBnk_3_C "Behaviour control mask / Behaviour control masks of check DFC_InjVlv_DI_ScBnk_3" VALUE 0x804D929A Val_Wu16 65535.00 DFES_OneToOne 0.00 65535.00 FORMAT "%8.2" /end CHARACTERISTIC
/begin CHARACTERISTIC DFC_CtlMsk.DFC_InjVlv_DI_ScCyl_0_C "Behaviour control mask / Behaviour control masks of check DFC_InjVlv_DI_ScCyl_0" VALUE 0x804D929C Val_Wu16 65535.00 DFES_OneToOne 0.00 65535.00 FORMAT "%8.2" /end CHARACTERISTIC
/begin CHARACTERISTIC DFC_CtlMsk.DFC_InjVlv_DI_ScCyl_1_C "Behaviour control mask / Behaviour control masks of check DFC_InjVlv_DI_ScCyl_1" VALUE 0x804D929E Val_Wu16 65535.00 DFES_OneToOne 0.00 65535.00 FORMAT "%8.2" /end CHARACTERISTIC
/begin CHARACTERISTIC DFC_CtlMsk.DFC_InjVlv_DI_ScCyl_2_C "Behaviour control mask / Behaviour control masks of check DFC_InjVlv_DI_ScCyl_2" VALUE 0x804D92A0 Val_Wu16 65535.00 DFES_OneToOne 0.00 65535.00 FORMAT "%8.2" /end CHARACTERISTIC
/begin CHARACTERISTIC DFC_CtlMsk.DFC_InjVlv_DI_ScCyl_3_C "Behaviour control mask / Behaviour control masks of check DFC_InjVlv_DI_ScCyl_3" VALUE 0x804D92A2 Val_Wu16 65535.00 DFES_OneToOne 0.00 65535.00 FORMAT "%8.2" /end CHARACTERISTIC
/begin CHARACTERISTIC DFC_CtlMsk.DFC_InjVlv_DI_ScHsLs_0_C "Behaviour control mask / Behaviour control masks of check DFC_InjVlv_DI_ScHsLs_0" VALUE 0x804D92A4 Val_Wu16 65535.00 DFES_OneToOne 0.00 65535.00 FORMAT "%8.2" /end CHARACTERISTIC
/begin CHARACTERISTIC DFC_CtlMsk.DFC_InjVlv_DI_ScHsLs_1_C "Behaviour control mask / Behaviour control masks of check DFC_InjVlv_DI_ScHsLs_1" VALUE 0x804D92A6 Val_Wu16 65535.00 DFES_OneToOne 0.00 65535.00 FORMAT "%8.2" /end CHARACTERISTIC
/begin CHARACTERISTIC DFC_CtlMsk.DFC_InjVlv_DI_ScHsLs_2_C "Behaviour control mask / Behaviour control masks of check DFC_InjVlv_DI_ScHsLs_2" VALUE 0x804D92A8 Val_Wu16 65535.00 DFES_OneToOne 0.00 65535.00 FORMAT "%8.2" /end CHARACTERISTIC
/begin CHARACTERISTIC DFC_CtlMsk.DFC_InjVlv_DI_ScHsLs_3_C "Behaviour control mask / Behaviour control masks of check DFC_InjVlv_DI_ScHsLs_3" VALUE 0x804D92AA Val_Wu16 65535.00 DFES_OneToOne 0.00 65535.00 FORMAT "%8.2" /end CHARACTERISTIC
/begin CHARACTERISTIC DFC_CtlMsk.DFC_MfPsDiaOpenLoad1_C "Behaviour control mask / Behaviour control masks of check DFC_MfPsDiaOpenLoad1" VALUE 0x804D92AC Val_Wu16 65535.00 DFES_OneToOne 0.00 65535.00 FORMAT "%8.2" /end CHARACTERISTIC
/begin CHARACTERISTIC DFC_CtlMsk.DFC_MfPsDiaScHiS1_C "Behaviour control mask / Behaviour control masks of check DFC_MfPsDiaScHiS1" VALUE 0x804D92AE Val_Wu16 65535.00 DFES_OneToOne 0.00 65535.00 FORMAT "%8.2" /end CHARACTERISTIC
/begin CHARACTERISTIC DFC_CtlMsk.DFC_MfPsDiaScHiSLowS1_C "Behaviour control mask / Behaviour control masks of check DFC_MfPsDiaScHiSLowS1" VALUE 0x804D92B0 Val_Wu16 65535.00 DFES_OneToOne 0.00 65535.00 FORMAT "%8.2" /end CHARACTERISTIC
/begin CHARACTERISTIC DFC_CtlMsk.DFC_MfPsDiaScLowS1_C "Behaviour control mask / Behaviour control masks of check DFC_MfPsDiaScLowS1" VALUE 0x804D92B2 Val_Wu16 65535.00 DFES_OneToOne 0.00 65535.00 FORMAT "%8.2" /end CHARACTERISTIC
/begin CHARACTERISTIC DFC_CtlMsk.DFC_ACEvpTPhysRngHi_C "Behaviour control mask / Behaviour control masks of check DFC_ACEvpTPhysRngHi" VALUE 0x804D92B4 Val_Wu16 65535.00 DFES_OneToOne 0.00 65535.00 FORMAT "%8.2" /end CHARACTERISTIC
/begin CHARACTERISTIC DFC_CtlMsk.DFC_ACEvpTPhysRngLo_C "Behaviour control mask / Behaviour control masks of check DFC_ACEvpTPhysRngLo" VALUE 0x804D92B6 Val_Wu16 65535.00 DFES_OneToOne 0.00 65535.00 FORMAT "%8.2" /end CHARACTERISTIC
/begin CHARACTERISTIC DFC_CtlMsk.DFC_ACEvpTSRCMax_C "Behaviour control mask / Behaviour control masks of check DFC_ACEvpTSRCMax" VALUE 0x804D92B8 Val_Wu16 65535.00 DFES_OneToOne 0.00 65535.00 FORMAT "%8.2" /end CHARACTERISTIC
/begin CHARACTERISTIC DFC_CtlMsk.DFC_ACEvpTSRCMin_C "Behaviour control mask / Behaviour control masks of check DFC_ACEvpTSRCMin" VALUE 0x804D92BA Val_Wu16 65535.00 DFES_OneToOne 0.00 65535.00 FORMAT "%8.2" /end CHARACTERISTIC
/begin CHARACTERISTIC DFC_CtlMsk.DFC_AfsRawSigRngHiB1_C "Behaviour control mask / Behaviour control masks of check DFC_AfsRawSigRngHiB1" VALUE 0x804D92BC Val_Wu16 65535.00 DFES_OneToOne 0.00 65535.00 FORMAT "%8.2" /end CHARACTERISTIC
/begin CHARACTERISTIC DFC_CtlMsk.DFC_AfsRawSigRngLoB1_C "Behaviour control mask / Behaviour control masks of check DFC_AfsRawSigRngLoB1" VALUE 0x804D92BE Val_Wu16 65535.00 DFES_OneToOne 0.00 65535.00 FORMAT "%8.2" /end CHARACTERISTIC
/begin CHARACTERISTIC DFC_CtlMsk.DFC_AfsSnsrErrB1_C "Behaviour control mask / Behaviour control masks of check DFC_AfsSnsrErrB1" VALUE 0x804D92C0 Val_Wu16 65535.00 DFES_OneToOne 0.00 65535.00 FORMAT "%8.2" /end CHARACTERISTIC
/begin CHARACTERISTIC DFC_CtlMsk.DFC_AirCClntPAnaSRCMax_C "Behaviour control mask / Behaviour control masks of check DFC_AirCClntPAnaSRCMax" VALUE 0x804D92C2 Val_Wu16 65535.00 DFES_OneToOne 0.00 65535.00 FORMAT "%8.2" /end CHARACTERISTIC
/begin CHARACTERISTIC DFC_CtlMsk.DFC_AirCClntPAnaSRCMin_C "Behaviour control mask / Behaviour control masks of check DFC_AirCClntPAnaSRCMin" VALUE 0x804D92C4 Val_Wu16 65535.00 DFES_OneToOne 0.00 65535.00 FORMAT "%8.2" /end CHARACTERISTIC
/begin CHARACTERISTIC DFC_CtlMsk.DFC_AirCSwtNpl_C "Behaviour control mask / Behaviour control masks of check DFC_AirCSwtNpl" VALUE 0x804D92C6 Val_Wu16 65535.00 DFES_OneToOne 0.00 65535.00 FORMAT "%8.2" /end CHARACTERISTIC
/begin CHARACTERISTIC DFC_CtlMsk.DFC_AirCSwtSig_C "Behaviour control mask / Behaviour control masks of check DFC_AirCSwtSig" VALUE 0x804D92C8 Val_Wu16 65535.00 DFES_OneToOne 0.00 65535.00 FORMAT "%8.2" /end CHARACTERISTIC
/begin CHARACTERISTIC DFC_CtlMsk.DFC_Brk_C "Behaviour control mask / Behaviour control masks of check DFC_Brk" VALUE 0x804D92CA Val_Wu16 65535.00 DFES_OneToOne 0.00 65535.00 FORMAT "%8.2" /end CHARACTERISTIC
/begin CHARACTERISTIC DFC_CtlMsk.DFC_BrkBstSensSCB_C "Behaviour control mask / Behaviour control masks of check DFC_BrkBstSensSCB" VALUE 0x804D92CC Val_Wu16 65535.00 DFES_OneToOne 0.00 65535.00 FORMAT "%8.2" /end CHARACTERISTIC
/begin CHARACTERISTIC DFC_CtlMsk.DFC_BrkBstSensSCG_C "Behaviour control mask / Behaviour control masks of check DFC_BrkBstSensSCG" VALUE 0x804D92CE Val_Wu16 65535.00 DFES_OneToOne 0.00 65535.00 FORMAT "%8.2" /end CHARACTERISTIC
/begin CHARACTERISTIC DFC_CtlMsk.DFC_BrkSig_C "Behaviour control mask / Behaviour control masks of check DFC_BrkSig" VALUE 0x804D92D0 Val_Wu16 65535.00 DFES_OneToOne 0.00 65535.00 FORMAT "%8.2" /end CHARACTERISTIC
/begin CHARACTERISTIC DFC_CtlMsk.DFC_ClthSig_C "Behaviour control mask / Behaviour control masks of check DFC_ClthSig" VALUE 0x804D92D2 Val_Wu16 65535.00 DFES_OneToOne 0.00 65535.00 FORMAT "%8.2" /end CHARACTERISTIC
/begin CHARACTERISTIC DFC_CtlMsk.DFC_EGRVlvCurrLim_C "Behaviour control mask / Behaviour control masks of check DFC_EGRVlvCurrLim" VALUE 0x804D92D4 Val_Wu16 65535.00 DFES_OneToOne 0.00 65535.00 FORMAT "%8.2" /end CHARACTERISTIC
/begin CHARACTERISTIC DFC_CtlMsk.DFC_EGRVlvOL_C "Behaviour control mask / Behaviour control masks of check DFC_EGRVlvOL" VALUE 0x804D92D6 Val_Wu16 65535.00 DFES_OneToOne 0.00 65535.00 FORMAT "%8.2" /end CHARACTERISTIC
/begin CHARACTERISTIC DFC_CtlMsk.DFC_EGRVlvOvrTemp_C "Behaviour control mask / Behaviour control masks of check DFC_EGRVlvOvrTemp" VALUE 0x804D92D8 Val_Wu16 65535.00 DFES_OneToOne 0.00 65535.00 FORMAT "%8.2" /end CHARACTERISTIC
/begin CHARACTERISTIC DFC_CtlMsk.DFC_EGRVlvSCB_C "Behaviour control mask / Behaviour control masks of check DFC_EGRVlvSCB" VALUE 0x804D92DA Val_Wu16 65535.00 DFES_OneToOne 0.00 65535.00 FORMAT "%8.2" /end CHARACTERISTIC
/begin CHARACTERISTIC DFC_CtlMsk.DFC_EGRVlvSCG_C "Behaviour control mask / Behaviour control masks of check DFC_EGRVlvSCG" VALUE 0x804D92DC Val_Wu16 65535.00 DFES_OneToOne 0.00 65535.00 FORMAT "%8.2" /end CHARACTERISTIC
/begin CHARACTERISTIC DFC_CtlMsk.DFC_EGRVlvSRCMax_C "Behaviour control mask / Behaviour control masks of check DFC_EGRVlvSRCMax" VALUE 0x804D92DE Val_Wu16 65535.00 DFES_OneToOne 0.00 65535.00 FORMAT "%8.2" /end CHARACTERISTIC
/begin CHARACTERISTIC DFC_CtlMsk.DFC_EGRVlvSRCMin_C "Behaviour control mask / Behaviour control masks of check DFC_EGRVlvSRCMin" VALUE 0x804D92E0 Val_Wu16 65535.00 DFES_OneToOne 0.00 65535.00 FORMAT "%8.2" /end CHARACTERISTIC
/begin CHARACTERISTIC DFC_CtlMsk.DFC_HLSDemOvhtEngLim_C "Behaviour control mask / Behaviour control masks of check DFC_HLSDemOvhtEngLim" VALUE 0x804D92E2 Val_Wu16 65535.00 DFES_OneToOne 0.00 65535.00 FORMAT "%8.2" /end CHARACTERISTIC
/begin CHARACTERISTIC DFC_CtlMsk.DFC_OilPSwmpSRCMax_C "Behaviour control mask / Behaviour control masks of check DFC_OilPSwmpSRCMax" VALUE 0x804D92E4 Val_Wu16 65535.00 DFES_OneToOne 0.00 65535.00 FORMAT "%8.2" /end CHARACTERISTIC
/begin CHARACTERISTIC DFC_CtlMsk.DFC_OilPSwmpSRCMin_C "Behaviour control mask / Behaviour control masks of check DFC_OilPSwmpSRCMin" VALUE 0x804D92E6 Val_Wu16 65535.00 DFES_OneToOne 0.00 65535.00 FORMAT "%8.2" /end CHARACTERISTIC
/begin CHARACTERISTIC DFC_CtlMsk.DFC_PIntkVUsLineHiB1_C "Behaviour control mask / Behaviour control masks of check DFC_PIntkVUsLineHiB1" VALUE 0x804D92E8 Val_Wu16 65535.00 DFES_OneToOne 0.00 65535.00 FORMAT "%8.2" /end CHARACTERISTIC
/begin CHARACTERISTIC DFC_CtlMsk.DFC_PIntkVUsLineLoB1_C "Behaviour control mask / Behaviour control masks of check DFC_PIntkVUsLineLoB1" VALUE 0x804D92EA Val_Wu16 65535.00 DFES_OneToOne 0.00 65535.00 FORMAT "%8.2" /end CHARACTERISTIC
/begin CHARACTERISTIC DFC_CtlMsk.DFC_VehVPhysRngLo_C "Behaviour control mask / Behaviour control masks of check DFC_VehVPhysRngLo" VALUE 0x804D92EC Val_Wu16 65535.00 DFES_OneToOne 0.00 65535.00 FORMAT "%8.2" /end CHARACTERISTIC
/begin CHARACTERISTIC DFC_CtlMsk.DFC_VehVSigCan_C "Behaviour control mask / Behaviour control masks of check DFC_VehVSigCan" VALUE 0x804D92EE Val_Wu16 65535.00 DFES_OneToOne 0.00 65535.00 FORMAT "%8.2" /end CHARACTERISTIC
/begin CHARACTERISTIC DFC_CtlMsk.DFC_VehVSigCanSafe_C "Behaviour control mask / Behaviour control masks of check DFC_VehVSigCanSafe" VALUE 0x804D92F0 Val_Wu16 65535.00 DFES_OneToOne 0.00 65535.00 FORMAT "%8.2" /end CHARACTERISTIC
/begin CHARACTERISTIC DFC_CtlMsk.DFC_VlvLftFbOilPSnsrIntk11SRCMax_C "Behaviour control mask / Behaviour control masks of check DFC_VlvLftFbOilPSnsrIntk11SRCMax" VALUE 0x804D92F2 Val_Wu16 65535.00 DFES_OneToOne 0.00 65535.00 FORMAT "%8.2" /end CHARACTERISTIC
/begin CHARACTERISTIC DFC_CtlMsk.DFC_VlvLftFbOilPSnsrIntk11SRCMin_C "Behaviour control mask / Behaviour control masks of check DFC_VlvLftFbOilPSnsrIntk11SRCMin" VALUE 0x804D92F4 Val_Wu16 65535.00 DFES_OneToOne 0.00 65535.00 FORMAT "%8.2" /end CHARACTERISTIC
/begin CHARACTERISTIC DFC_CtlMsk.DFC_ClthNpl_C "Behaviour control mask / Behaviour control masks of check DFC_ClthNpl" VALUE 0x804D92F6 Val_Wu16 65535.00 DFES_OneToOne 0.00 65535.00 FORMAT "%8.2" /end CHARACTERISTIC
/begin CHARACTERISTIC DFC_CtlMsk.DFC_GbxPNPosnDrvCdn_C "Behaviour control mask / Behaviour control masks of check DFC_GbxPNPosnDrvCdn" VALUE 0x804D92F8 Val_Wu16 65535.00 DFES_OneToOne 0.00 65535.00 FORMAT "%8.2" /end CHARACTERISTIC
/begin CHARACTERISTIC DFC_CtlMsk.DFC_GbxPNPosnPlausy_C "Behaviour control mask / Behaviour control masks of check DFC_GbxPNPosnPlausy" VALUE 0x804D92FA Val_Wu16 65535.00 DFES_OneToOne 0.00 65535.00 FORMAT "%8.2" /end CHARACTERISTIC
/begin CHARACTERISTIC DFC_CtlMsk.DFC_AfsSigErrLineHiB1_C "Behaviour control mask / Behaviour control masks of check DFC_AfsSigErrLineHiB1" VALUE 0x804D92FC Val_Wu16 65535.00 DFES_OneToOne 0.00 65535.00 FORMAT "%8.2" /end CHARACTERISTIC
/begin CHARACTERISTIC DFC_CtlMsk.DFC_AfsSigErrLineLoB1_C "Behaviour control mask / Behaviour control masks of check DFC_AfsSigErrLineLoB1" VALUE 0x804D92FE Val_Wu16 65535.00 DFES_OneToOne 0.00 65535.00 FORMAT "%8.2" /end CHARACTERISTIC
/begin CHARACTERISTIC DFC_CtlMsk.DFC_PEnvCcMax_C "Behaviour control mask / Behaviour control masks of check DFC_PEnvCcMax" VALUE 0x804D9300 Val_Wu16 65535.00 DFES_OneToOne 0.00 65535.00 FORMAT "%8.2" /end CHARACTERISTIC
/begin CHARACTERISTIC DFC_CtlMsk.DFC_PEnvCcMin_C "Behaviour control mask / Behaviour control masks of check DFC_PEnvCcMin" VALUE 0x804D9302 Val_Wu16 65535.00 DFES_OneToOne 0.00 65535.00 FORMAT "%8.2" /end CHARACTERISTIC
/begin CHARACTERISTIC DFC_CtlMsk.DFC_PEnvRngChkMax_C "Behaviour control mask / Behaviour control masks of check DFC_PEnvRngChkMax" VALUE 0x804D9304 Val_Wu16 65535.00 DFES_OneToOne 0.00 65535.00 FORMAT "%8.2" /end CHARACTERISTIC
/begin CHARACTERISTIC DFC_CtlMsk.DFC_PEnvRngChkMin_C "Behaviour control mask / Behaviour control masks of check DFC_PEnvRngChkMin" VALUE 0x804D9306 Val_Wu16 65535.00 DFES_OneToOne 0.00 65535.00 FORMAT "%8.2" /end CHARACTERISTIC
/begin CHARACTERISTIC DFC_CtlMsk.DFC_PEnvSnsrPlaus_C "Behaviour control mask / Behaviour control masks of check DFC_PEnvSnsrPlaus" VALUE 0x804D9308 Val_Wu16 65535.00 DFES_OneToOne 0.00 65535.00 FORMAT "%8.2" /end CHARACTERISTIC
/begin CHARACTERISTIC DFC_CtlMsk.DFC_UEGOHeatrRlyPsOLS1B1_C "Behaviour control mask / Behaviour control masks of check DFC_UEGOHeatrRlyPsOLS1B1" VALUE 0x804D930A Val_Wu16 65535.00 DFES_OneToOne 0.00 65535.00 FORMAT "%8.2" /end CHARACTERISTIC
/begin CHARACTERISTIC DFC_CtlMsk.DFC_UEGOHeatrRlyPsSCBS1B1_C "Behaviour control mask / Behaviour control masks of check DFC_UEGOHeatrRlyPsSCBS1B1" VALUE 0x804D930C Val_Wu16 65535.00 DFES_OneToOne 0.00 65535.00 FORMAT "%8.2" /end CHARACTERISTIC
/begin CHARACTERISTIC DFC_CtlMsk.DFC_UEGOHeatrRlyPsSCGS1B1_C "Behaviour control mask / Behaviour control masks of check DFC_UEGOHeatrRlyPsSCGS1B1" VALUE 0x804D930E Val_Wu16 65535.00 DFES_OneToOne 0.00 65535.00 FORMAT "%8.2" /end CHARACTERISTIC
/begin CHARACTERISTIC DFC_CtlMsk.DFC_UegoHeatrWireOlS1B1_C "Behaviour control mask / Behaviour control masks of check DFC_UegoHeatrWireOlS1B1" VALUE 0x804D9310 Val_Wu16 65535.00 DFES_OneToOne 0.00 65535.00 FORMAT "%8.2" /end CHARACTERISTIC
/begin CHARACTERISTIC DFC_CtlMsk.DFC_UegoHeatrWireScbS1B1_C "Behaviour control mask / Behaviour control masks of check DFC_UegoHeatrWireScbS1B1" VALUE 0x804D9312 Val_Wu16 65535.00 DFES_OneToOne 0.00 65535.00 FORMAT "%8.2" /end CHARACTERISTIC
/begin CHARACTERISTIC DFC_CtlMsk.DFC_UegoHeatrWireScgS1B1_C "Behaviour control mask / Behaviour control masks of check DFC_UegoHeatrWireScgS1B1" VALUE 0x804D9314 Val_Wu16 65535.00 DFES_OneToOne 0.00 65535.00 FORMAT "%8.2" /end CHARACTERISTIC
/begin CHARACTERISTIC DFC_CtlMsk.DFC_KnDetSens1PortAMax_C "Behaviour control mask / Behaviour control masks of check DFC_KnDetSens1PortAMax" VALUE 0x804D9316 Val_Wu16 65535.00 DFES_OneToOne 0.00 65535.00 FORMAT "%8.2" /end CHARACTERISTIC
/begin CHARACTERISTIC DFC_CtlMsk.DFC_KnDetSens1PortAMin_C "Behaviour control mask / Behaviour control masks of check DFC_KnDetSens1PortAMin" VALUE 0x804D9318 Val_Wu16 65535.00 DFES_OneToOne 0.00 65535.00 FORMAT "%8.2" /end CHARACTERISTIC
/begin CHARACTERISTIC DFC_CtlMsk.DFC_KnDetSens1PortBMax_C "Behaviour control mask / Behaviour control masks of check DFC_KnDetSens1PortBMax" VALUE 0x804D931A Val_Wu16 65535.00 DFES_OneToOne 0.00 65535.00 FORMAT "%8.2" /end CHARACTERISTIC
/begin CHARACTERISTIC DFC_CtlMsk.DFC_KnDetSens1PortBMin_C "Behaviour control mask / Behaviour control masks of check DFC_KnDetSens1PortBMin" VALUE 0x804D931C Val_Wu16 65535.00 DFES_OneToOne 0.00 65535.00 FORMAT "%8.2" /end CHARACTERISTIC
/begin CHARACTERISTIC DFC_CtlMsk.DFC_Clth2ONStuck_C "Behaviour control mask / Behaviour control masks of check DFC_Clth2ONStuck" VALUE 0x804D931E Val_Wu16 65535.00 DFES_OneToOne 0.00 65535.00 FORMAT "%8.2" /end CHARACTERISTIC
/begin CHARACTERISTIC DFC_CtlMsk.DFC_Clth2ONStuckLdc_C "Behaviour control mask / Behaviour control masks of check DFC_Clth2ONStuckLdc" VALUE 0x804D9320 Val_Wu16 65535.00 DFES_OneToOne 0.00 65535.00 FORMAT "%8.2" /end CHARACTERISTIC
/begin CHARACTERISTIC DFC_CtlMsk.DFC_Clth3ONStuckLdc_C "Behaviour control mask / Behaviour control masks of check DFC_Clth3ONStuckLdc" VALUE 0x804D9322 Val_Wu16 65535.00 DFES_OneToOne 0.00 65535.00 FORMAT "%8.2" /end CHARACTERISTIC
/begin CHARACTERISTIC DFC_CtlMsk.DFC_Clth3ONStuckPostDrv_C "Behaviour control mask / Behaviour control masks of check DFC_Clth3ONStuckPostDrv" VALUE 0x804D9324 Val_Wu16 65535.00 DFES_OneToOne 0.00 65535.00 FORMAT "%8.2" /end CHARACTERISTIC
/begin CHARACTERISTIC DFC_CtlMsk.DFC_Clth4ONStuck_C "Behaviour control mask / Behaviour control masks of check DFC_Clth4ONStuck" VALUE 0x804D9326 Val_Wu16 65535.00 DFES_OneToOne 0.00 65535.00 FORMAT "%8.2" /end CHARACTERISTIC
/begin CHARACTERISTIC DFC_CtlMsk.DFC_Clth4ONStuckLdc_C "Behaviour control mask / Behaviour control masks of check DFC_Clth4ONStuckLdc" VALUE 0x804D9328 Val_Wu16 65535.00 DFES_OneToOne 0.00 65535.00 FORMAT "%8.2" /end CHARACTERISTIC
/begin CHARACTERISTIC DFC_CtlMsk.DFC_ComBCMUnit_C "Behaviour control mask / Behaviour control masks of check DFC_ComBCMUnit" VALUE 0x804D932A Val_Wu16 65535.00 DFES_OneToOne 0.00 65535.00 FORMAT "%8.2" /end CHARACTERISTIC
/begin CHARACTERISTIC DFC_CtlMsk.DFC_ComDLCTCU01_C "Behaviour control mask / Behaviour control masks of check DFC_ComDLCTCU01" VALUE 0x804D932C Val_Wu16 65535.00 DFES_OneToOne 0.00 65535.00 FORMAT "%8.2" /end CHARACTERISTIC
/begin CHARACTERISTIC DFC_CtlMsk.DFC_ComDLCTCU02_C "Behaviour control mask / Behaviour control masks of check DFC_ComDLCTCU02" VALUE 0x804D932E Val_Wu16 65535.00 DFES_OneToOne 0.00 65535.00 FORMAT "%8.2" /end CHARACTERISTIC
/begin CHARACTERISTIC DFC_CtlMsk.DFC_ComDLCTCU1_C "Behaviour control mask / Behaviour control masks of check DFC_ComDLCTCU1" VALUE 0x804D9330 Val_Wu16 65535.00 DFES_OneToOne 0.00 65535.00 FORMAT "%8.2" /end CHARACTERISTIC
/begin CHARACTERISTIC DFC_CtlMsk.DFC_ComDLCTCU11_C "Behaviour control mask / Behaviour control masks of check DFC_ComDLCTCU11" VALUE 0x804D9332 Val_Wu16 65535.00 DFES_OneToOne 0.00 65535.00 FORMAT "%8.2" /end CHARACTERISTIC
/begin CHARACTERISTIC DFC_CtlMsk.DFC_ComDLCTCU12_C "Behaviour control mask / Behaviour control masks of check DFC_ComDLCTCU12" VALUE 0x804D9334 Val_Wu16 65535.00 DFES_OneToOne 0.00 65535.00 FORMAT "%8.2" /end CHARACTERISTIC
/begin CHARACTERISTIC DFC_CtlMsk.DFC_ComDLCTCU13_C "Behaviour control mask / Behaviour control masks of check DFC_ComDLCTCU13" VALUE 0x804D9336 Val_Wu16 65535.00 DFES_OneToOne 0.00 65535.00 FORMAT "%8.2" /end CHARACTERISTIC
/begin CHARACTERISTIC DFC_CtlMsk.DFC_ComDLCTCU14_C "Behaviour control mask / Behaviour control masks of check DFC_ComDLCTCU14" VALUE 0x804D9338 Val_Wu16 65535.00 DFES_OneToOne 0.00 65535.00 FORMAT "%8.2" /end CHARACTERISTIC
/begin CHARACTERISTIC DFC_CtlMsk.DFC_ComDLCTCU2_C "Behaviour control mask / Behaviour control masks of check DFC_ComDLCTCU2" VALUE 0x804D933A Val_Wu16 65535.00 DFES_OneToOne 0.00 65535.00 FORMAT "%8.2" /end CHARACTERISTIC
/begin CHARACTERISTIC DFC_CtlMsk.DFC_ComDLCTCU3_C "Behaviour control mask / Behaviour control masks of check DFC_ComDLCTCU3" VALUE 0x804D933C Val_Wu16 65535.00 DFES_OneToOne 0.00 65535.00 FORMAT "%8.2" /end CHARACTERISTIC
/begin CHARACTERISTIC DFC_CtlMsk.DFC_ComDLCTCU4_C "Behaviour control mask / Behaviour control masks of check DFC_ComDLCTCU4" VALUE 0x804D933E Val_Wu16 65535.00 DFES_OneToOne 0.00 65535.00 FORMAT "%8.2" /end CHARACTERISTIC
/begin CHARACTERISTIC DFC_CtlMsk.DFC_ComEPSUnit_C "Behaviour control mask / Behaviour control masks of check DFC_ComEPSUnit" VALUE 0x804D9340 Val_Wu16 65535.00 DFES_OneToOne 0.00 65535.00 FORMAT "%8.2" /end CHARACTERISTIC
/begin CHARACTERISTIC DFC_CtlMsk.DFC_ComIDASBUnit_C "Behaviour control mask / Behaviour control masks of check DFC_ComIDASBUnit" VALUE 0x804D9342 Val_Wu16 65535.00 DFES_OneToOne 0.00 65535.00 FORMAT "%8.2" /end CHARACTERISTIC
/begin CHARACTERISTIC DFC_CtlMsk.DFC_ComIMGUnit_C "Behaviour control mask / Behaviour control masks of check DFC_ComIMGUnit" VALUE 0x804D9344 Val_Wu16 65535.00 DFES_OneToOne 0.00 65535.00 FORMAT "%8.2" /end CHARACTERISTIC
/begin CHARACTERISTIC DFC_CtlMsk.DFC_ComMETUnit_C "Behaviour control mask / Behaviour control masks of check DFC_ComMETUnit" VALUE 0x804D9346 Val_Wu16 65535.00 DFES_OneToOne 0.00 65535.00 FORMAT "%8.2" /end CHARACTERISTIC
/begin CHARACTERISTIC DFC_CtlMsk.DFC_ComSRSUnit_C "Behaviour control mask / Behaviour control masks of check DFC_ComSRSUnit" VALUE 0x804D9348 Val_Wu16 65535.00 DFES_OneToOne 0.00 65535.00 FORMAT "%8.2" /end CHARACTERISTIC
/begin CHARACTERISTIC DFC_CtlMsk.DFC_ComVSAUnit_C "Behaviour control mask / Behaviour control masks of check DFC_ComVSAUnit" VALUE 0x804D934A Val_Wu16 65535.00 DFES_OneToOne 0.00 65535.00 FORMAT "%8.2" /end CHARACTERISTIC
/begin CHARACTERISTIC DFC_CtlMsk.DFC_EbsSocFlt_C "Behaviour control mask / Behaviour control masks of check DFC_EbsSocFlt" VALUE 0x804D934C Val_Wu16 65535.00 DFES_OneToOne 0.00 65535.00 FORMAT "%8.2" /end CHARACTERISTIC
/begin CHARACTERISTIC DFC_CtlMsk.DFC_I14229VINErr_C "Behaviour control mask / Behaviour control masks of check DFC_I14229VINErr" VALUE 0x804D934E Val_Wu16 65535.00 DFES_OneToOne 0.00 65535.00 FORMAT "%8.2" /end CHARACTERISTIC
/begin CHARACTERISTIC DFC_CtlMsk.DFC_InjCatHeatgErr_C "Behaviour control mask / Behaviour control masks of check DFC_InjCatHeatgErr" VALUE 0x804D9350 Val_Wu16 65535.00 DFES_OneToOne 0.00 65535.00 FORMAT "%8.2" /end CHARACTERISTIC
/begin CHARACTERISTIC DFC_CtlMsk.DFC_InjSysMulInjDiagErr_C "Behaviour control mask / Behaviour control masks of check DFC_InjSysMulInjDiagErr" VALUE 0x804D9352 Val_Wu16 65535.00 DFES_OneToOne 0.00 65535.00 FORMAT "%8.2" /end CHARACTERISTIC
/begin CHARACTERISTIC DFC_CtlMsk.DFC_LLRHmax_C "Behaviour control mask / Behaviour control masks of check DFC_LLRHmax" VALUE 0x804D9354 Val_Wu16 65535.00 DFES_OneToOne 0.00 65535.00 FORMAT "%8.2" /end CHARACTERISTIC
/begin CHARACTERISTIC DFC_CtlMsk.DFC_LLRHmin_C "Behaviour control mask / Behaviour control masks of check DFC_LLRHmin" VALUE 0x804D9356 Val_Wu16 65535.00 DFES_OneToOne 0.00 65535.00 FORMAT "%8.2" /end CHARACTERISTIC
/begin CHARACTERISTIC DFC_CtlMsk.DFC_LLRHnpl_C "Behaviour control mask / Behaviour control masks of check DFC_LLRHnpl" VALUE 0x804D9358 Val_Wu16 65535.00 DFES_OneToOne 0.00 65535.00 FORMAT "%8.2" /end CHARACTERISTIC
/begin CHARACTERISTIC DFC_CtlMsk.DFC_LLRKHmax_C "Behaviour control mask / Behaviour control masks of check DFC_LLRKHmax" VALUE 0x804D935A Val_Wu16 65535.00 DFES_OneToOne 0.00 65535.00 FORMAT "%8.2" /end CHARACTERISTIC
/begin CHARACTERISTIC DFC_CtlMsk.DFC_LLRKHmin_C "Behaviour control mask / Behaviour control masks of check DFC_LLRKHmin" VALUE 0x804D935C Val_Wu16 65535.00 DFES_OneToOne 0.00 65535.00 FORMAT "%8.2" /end CHARACTERISTIC
/begin CHARACTERISTIC DFC_CtlMsk.DFC_LLRKHnpl_C "Behaviour control mask / Behaviour control masks of check DFC_LLRKHnpl" VALUE 0x804D935E Val_Wu16 65535.00 DFES_OneToOne 0.00 65535.00 FORMAT "%8.2" /end CHARACTERISTIC
/begin CHARACTERISTIC DFC_CtlMsk.DFC_LinACGUnit_C "Behaviour control mask / Behaviour control masks of check DFC_LinACGUnit" VALUE 0x804D9360 Val_Wu16 65535.00 DFES_OneToOne 0.00 65535.00 FORMAT "%8.2" /end CHARACTERISTIC
/begin CHARACTERISTIC DFC_CtlMsk.DFC_LinAEVUnit_C "Behaviour control mask / Behaviour control masks of check DFC_LinAEVUnit" VALUE 0x804D9362 Val_Wu16 65535.00 DFES_OneToOne 0.00 65535.00 FORMAT "%8.2" /end CHARACTERISTIC
/begin CHARACTERISTIC DFC_CtlMsk.DFC_LinEBSUnit_C "Behaviour control mask / Behaviour control masks of check DFC_LinEBSUnit" VALUE 0x804D9364 Val_Wu16 65535.00 DFES_OneToOne 0.00 65535.00 FORMAT "%8.2" /end CHARACTERISTIC
/begin CHARACTERISTIC DFC_CtlMsk.DFC_RoughRoad_C "Behaviour control mask / Behaviour control masks of check DFC_RoughRoad" VALUE 0x804D9366 Val_Wu16 65535.00 DFES_OneToOne 0.00 65535.00 FORMAT "%8.2" /end CHARACTERISTIC
/begin CHARACTERISTIC DFC_CtlMsk.DFC_SiaEEPRdErr_C "Behaviour control mask / Behaviour control masks of check DFC_SiaEEPRdErr" VALUE 0x804D9368 Val_Wu16 65535.00 DFES_OneToOne 0.00 65535.00 FORMAT "%8.2" /end CHARACTERISTIC
/begin CHARACTERISTIC DFC_CtlMsk.DFC_SiaEEPWrngCod_C "Behaviour control mask / Behaviour control masks of check DFC_SiaEEPWrngCod" VALUE 0x804D936A Val_Wu16 65535.00 DFES_OneToOne 0.00 65535.00 FORMAT "%8.2" /end CHARACTERISTIC
/begin CHARACTERISTIC DFC_CtlMsk.DFC_UegoHeatrStrtS1B1_C "Behaviour control mask / Behaviour control masks of check DFC_UegoHeatrStrtS1B1" VALUE 0x804D936C Val_Wu16 65535.00 DFES_OneToOne 0.00 65535.00 FORMAT "%8.2" /end CHARACTERISTIC
/begin CHARACTERISTIC DFC_CtlMsk.DFC_BusDiagCANAPPLBusOff_C "Behaviour control mask / Behaviour control masks of check DFC_BusDiagCANAPPLBusOff" VALUE 0x804D936E Val_Wu16 65535.00 DFES_OneToOne 0.00 65535.00 FORMAT "%8.2" /end CHARACTERISTIC
/begin CHARACTERISTIC DFC_CtlMsk.DFC_BusDiagCANCANCBusOff_C "Behaviour control mask / Behaviour control masks of check DFC_BusDiagCANCANCBusOff" VALUE 0x804D9370 Val_Wu16 65535.00 DFES_OneToOne 0.00 65535.00 FORMAT "%8.2" /end CHARACTERISTIC
/begin CHARACTERISTIC DFC_CtlMsk.DFC_BusDiagCANVEHICLEBusOff_C "Behaviour control mask / Behaviour control masks of check DFC_BusDiagCANVEHICLEBusOff" VALUE 0x804D9372 Val_Wu16 65535.00 DFES_OneToOne 0.00 65535.00 FORMAT "%8.2" /end CHARACTERISTIC
/begin CHARACTERISTIC DFC_CtlMsk.DFC_RBA_IODIAGPWR_rba_IoExtCy329_SignalVltSply_0_C "Behaviour control mask / Behaviour control masks of check DFC_RBA_IODIAGPWR_rba_IoExtCy329_SignalVltSply_0" VALUE 0x804D9374 Val_Wu16 65535.00 DFES_OneToOne 0.00 65535.00 FORMAT "%8.2" /end CHARACTERISTIC
/begin CHARACTERISTIC DFC_CtlMsk.DFC_RBA_IODIAGPWR_rba_IoExtCy329_SignalVltSply_0OT_C "Behaviour control mask / Behaviour control masks of check DFC_RBA_IODIAGPWR_rba_IoExtCy329_SignalVltSply_0OT" VALUE 0x804D9376 Val_Wu16 65535.00 DFES_OneToOne 0.00 65535.00 FORMAT "%8.2" /end CHARACTERISTIC
/begin CHARACTERISTIC DFC_CtlMsk.DFC_RBA_IODIAGPWR_rba_IoExtCy329_SignalVltSply_0OV_C "Behaviour control mask / Behaviour control masks of check DFC_RBA_IODIAGPWR_rba_IoExtCy329_SignalVltSply_0OV" VALUE 0x804D9378 Val_Wu16 65535.00 DFES_OneToOne 0.00 65535.00 FORMAT "%8.2" /end CHARACTERISTIC
/begin CHARACTERISTIC DFC_CtlMsk.DFC_RBA_IODIAGPWR_rba_IoExtCy329_SignalVltSply_0SCG_C "Behaviour control mask / Behaviour control masks of check DFC_RBA_IODIAGPWR_rba_IoExtCy329_SignalVltSply_0SCG" VALUE 0x804D937A Val_Wu16 65535.00 DFES_OneToOne 0.00 65535.00 FORMAT "%8.2" /end CHARACTERISTIC
/begin CHARACTERISTIC DFC_CtlMsk.DFC_RBA_IODIAGPWR_rba_IoExtCy329_SignalVltSply_0UV_C "Behaviour control mask / Behaviour control masks of check DFC_RBA_IODIAGPWR_rba_IoExtCy329_SignalVltSply_0UV" VALUE 0x804D937C Val_Wu16 65535.00 DFES_OneToOne 0.00 65535.00 FORMAT "%8.2" /end CHARACTERISTIC
/begin CHARACTERISTIC DFC_CtlMsk.DFC_RBA_IODIAGPWR_rba_IoExtCy329_SignalVltSply_1_C "Behaviour control mask / Behaviour control masks of check DFC_RBA_IODIAGPWR_rba_IoExtCy329_SignalVltSply_1" VALUE 0x804D937E Val_Wu16 65535.00 DFES_OneToOne 0.00 65535.00 FORMAT "%8.2" /end CHARACTERISTIC
/begin CHARACTERISTIC DFC_CtlMsk.DFC_RBA_IODIAGPWR_rba_IoExtCy329_SignalVltSply_1OT_C "Behaviour control mask / Behaviour control masks of check DFC_RBA_IODIAGPWR_rba_IoExtCy329_SignalVltSply_1OT" VALUE 0x804D9380 Val_Wu16 65535.00 DFES_OneToOne 0.00 65535.00 FORMAT "%8.2" /end CHARACTERISTIC
/begin CHARACTERISTIC DFC_CtlMsk.DFC_RBA_IODIAGPWR_rba_IoExtCy329_SignalVltSply_1OV_C "Behaviour control mask / Behaviour control masks of check DFC_RBA_IODIAGPWR_rba_IoExtCy329_SignalVltSply_1OV" VALUE 0x804D9382 Val_Wu16 65535.00 DFES_OneToOne 0.00 65535.00 FORMAT "%8.2" /end CHARACTERISTIC
/begin CHARACTERISTIC DFC_CtlMsk.DFC_RBA_IODIAGPWR_rba_IoExtCy329_SignalVltSply_1SCG_C "Behaviour control mask / Behaviour control masks of check DFC_RBA_IODIAGPWR_rba_IoExtCy329_SignalVltSply_1SCG" VALUE 0x804D9384 Val_Wu16 65535.00 DFES_OneToOne 0.00 65535.00 FORMAT "%8.2" /end CHARACTERISTIC
/begin CHARACTERISTIC DFC_CtlMsk.DFC_RBA_IODIAGPWR_rba_IoExtCy329_SignalVltSply_1UV_C "Behaviour control mask / Behaviour control masks of check DFC_RBA_IODIAGPWR_rba_IoExtCy329_SignalVltSply_1UV" VALUE 0x804D9386 Val_Wu16 65535.00 DFES_OneToOne 0.00 65535.00 FORMAT "%8.2" /end CHARACTERISTIC
/begin CHARACTERISTIC DFC_CtlMsk.DFC_RBA_IODIAGPWR_rba_IoExtCy329_SignalVltSply_2_C "Behaviour control mask / Behaviour control masks of check DFC_RBA_IODIAGPWR_rba_IoExtCy329_SignalVltSply_2" VALUE 0x804D9388 Val_Wu16 65535.00 DFES_OneToOne 0.00 65535.00 FORMAT "%8.2" /end CHARACTERISTIC
/begin CHARACTERISTIC DFC_CtlMsk.DFC_RBA_IODIAGPWR_rba_IoExtCy329_SignalVltSply_2OT_C "Behaviour control mask / Behaviour control masks of check DFC_RBA_IODIAGPWR_rba_IoExtCy329_SignalVltSply_2OT" VALUE 0x804D938A Val_Wu16 65535.00 DFES_OneToOne 0.00 65535.00 FORMAT "%8.2" /end CHARACTERISTIC
/begin CHARACTERISTIC DFC_CtlMsk.DFC_RBA_IODIAGPWR_rba_IoExtCy329_SignalVltSply_2OV_C "Behaviour control mask / Behaviour control masks of check DFC_RBA_IODIAGPWR_rba_IoExtCy329_SignalVltSply_2OV" VALUE 0x804D938C Val_Wu16 65535.00 DFES_OneToOne 0.00 65535.00 FORMAT "%8.2" /end CHARACTERISTIC
/begin CHARACTERISTIC DFC_CtlMsk.DFC_RBA_IODIAGPWR_rba_IoExtCy329_SignalVltSply_2SCG_C "Behaviour control mask / Behaviour control masks of check DFC_RBA_IODIAGPWR_rba_IoExtCy329_SignalVltSply_2SCG" VALUE 0x804D938E Val_Wu16 65535.00 DFES_OneToOne 0.00 65535.00 FORMAT "%8.2" /end CHARACTERISTIC
/begin CHARACTERISTIC DFC_CtlMsk.DFC_RBA_IODIAGPWR_rba_IoExtCy329_SignalVltSply_2UV_C "Behaviour control mask / Behaviour control masks of check DFC_RBA_IODIAGPWR_rba_IoExtCy329_SignalVltSply_2UV" VALUE 0x804D9390 Val_Wu16 65535.00 DFES_OneToOne 0.00 65535.00 FORMAT "%8.2" /end CHARACTERISTIC
/begin CHARACTERISTIC DFC_CtlMsk.DFC_CAN_E_TIMEOUT_C "Behaviour control mask / Behaviour control masks of check DFC_CAN_E_TIMEOUT" VALUE 0x804D9392 Val_Wu16 65535.00 DFES_OneToOne 0.00 65535.00 FORMAT "%8.2" /end CHARACTERISTIC
/begin CHARACTERISTIC DFC_CtlMsk.DFC_LIN_E_TIMEOUT_C "Behaviour control mask / Behaviour control masks of check DFC_LIN_E_TIMEOUT" VALUE 0x804D9394 Val_Wu16 65535.00 DFES_OneToOne 0.00 65535.00 FORMAT "%8.2" /end CHARACTERISTIC
/begin CHARACTERISTIC DFC_CtlMsk.DFC_MRlyOL_C "Behaviour control mask / Behaviour control masks of check DFC_MRlyOL" VALUE 0x804D9396 Val_Wu16 65535.00 DFES_OneToOne 0.00 65535.00 FORMAT "%8.2" /end CHARACTERISTIC
/begin CHARACTERISTIC DFC_CtlMsk.DFC_MRlySCB_C "Behaviour control mask / Behaviour control masks of check DFC_MRlySCB" VALUE 0x804D9398 Val_Wu16 65535.00 DFES_OneToOne 0.00 65535.00 FORMAT "%8.2" /end CHARACTERISTIC
/begin CHARACTERISTIC DFC_CtlMsk.DFC_MRlySCG_C "Behaviour control mask / Behaviour control masks of check DFC_MRlySCG" VALUE 0x804D939A Val_Wu16 65535.00 DFES_OneToOne 0.00 65535.00 FORMAT "%8.2" /end CHARACTERISTIC
/begin CHARACTERISTIC DFC_CtlMsk.DFC_rba_MultiStackTrace_Threshold_C "Behaviour control mask / Behaviour control masks of check DFC_rba_MultiStackTrace_Threshold" VALUE 0x804D939C Val_Wu16 65535.00 DFES_OneToOne 0.00 65535.00 FORMAT "%8.2" /end CHARACTERISTIC
/begin CHARACTERISTIC DFC_CtlMsk.DFC_BSWM_E_ACTION_FAILED_C "Behaviour control mask / Behaviour control masks of check DFC_BSWM_E_ACTION_FAILED" VALUE 0x804D939E Val_Wu16 65535.00 DFES_OneToOne 0.00 65535.00 FORMAT "%8.2" /end CHARACTERISTIC
/begin CHARACTERISTIC DFC_CtlMsk.DFC_BSWM_E_INTRPTQUEUE_FULL_C "Behaviour control mask / Behaviour control masks of check DFC_BSWM_E_INTRPTQUEUE_FULL" VALUE 0x804D93A0 Val_Wu16 65535.00 DFES_OneToOne 0.00 65535.00 FORMAT "%8.2" /end CHARACTERISTIC
/begin CHARACTERISTIC DFC_CtlMsk.DFC_RBA_IOEXTLIB_KEEPALIVE_DRV_C "Behaviour control mask / Behaviour control masks of check DFC_RBA_IOEXTLIB_KEEPALIVE_DRV" VALUE 0x804D93A2 Val_Wu16 65535.00 DFES_OneToOne 0.00 65535.00 FORMAT "%8.2" /end CHARACTERISTIC
/begin CHARACTERISTIC DFC_CtlMsk.DFC_RBA_IOEXTLIB_KEEPALIVE_INI_C "Behaviour control mask / Behaviour control masks of check DFC_RBA_IOEXTLIB_KEEPALIVE_INI" VALUE 0x804D93A4 Val_Wu16 65535.00 DFES_OneToOne 0.00 65535.00 FORMAT "%8.2" /end CHARACTERISTIC
/begin CHARACTERISTIC DFC_CtlMsk.DFC_rba_IoSigRtc_StopCounter_C "Behaviour control mask / Behaviour control masks of check DFC_rba_IoSigRtc_StopCounter" VALUE 0x804D93A6 Val_Wu16 65535.00 DFES_OneToOne 0.00 65535.00 FORMAT "%8.2" /end CHARACTERISTIC
/begin CHARACTERISTIC DFC_CtlMsk.DFC_rba_MRly_Diag_Stk_Event_C "Behaviour control mask / Behaviour control masks of check DFC_rba_MRly_Diag_Stk_Event" VALUE 0x804D93A8 Val_Wu16 65535.00 DFES_OneToOne 0.00 65535.00 FORMAT "%8.2" /end CHARACTERISTIC
/begin CHARACTERISTIC DFC_CtlMsk.DFC_rba_MemDiag_MemReadErr_C "Behaviour control mask / Behaviour control masks of check DFC_rba_MemDiag_MemReadErr" VALUE 0x804D93AA Val_Wu16 65535.00 DFES_OneToOne 0.00 65535.00 FORMAT "%8.2" /end CHARACTERISTIC
/begin CHARACTERISTIC DFC_CtlMsk.DFC_rba_MemDiag_MemWrErr_C "Behaviour control mask / Behaviour control masks of check DFC_rba_MemDiag_MemWrErr" VALUE 0x804D93AC Val_Wu16 65535.00 DFES_OneToOne 0.00 65535.00 FORMAT "%8.2" /end CHARACTERISTIC
/begin CHARACTERISTIC DFC_CtlMsk.DFC_rba_SyC_IrrSwOffTrigEngRun_Event_C "Behaviour control mask / Behaviour control masks of check DFC_rba_SyC_IrrSwOffTrigEngRun_Event" VALUE 0x804D93AE Val_Wu16 65535.00 DFES_OneToOne 0.00 65535.00 FORMAT "%8.2" /end CHARACTERISTIC
/begin CHARACTERISTIC DFC_CtlMsk.DFC_rba_T15_Diag_ComInVld_Event_C "Behaviour control mask / Behaviour control masks of check DFC_rba_T15_Diag_ComInVld_Event" VALUE 0x804D93B0 Val_Wu16 65535.00 DFES_OneToOne 0.00 65535.00 FORMAT "%8.2" /end CHARACTERISTIC
/begin CHARACTERISTIC DFC_CtlMsk.DFC_rba_T15_Diag_ComOff_HwOn_Event_C "Behaviour control mask / Behaviour control masks of check DFC_rba_T15_Diag_ComOff_HwOn_Event" VALUE 0x804D93B2 Val_Wu16 65535.00 DFES_OneToOne 0.00 65535.00 FORMAT "%8.2" /end CHARACTERISTIC
/begin CHARACTERISTIC DFC_CtlMsk.DFC_rba_T15_Diag_ComOn_HwOff_Event_C "Behaviour control mask / Behaviour control masks of check DFC_rba_T15_Diag_ComOn_HwOff_Event" VALUE 0x804D93B4 Val_Wu16 65535.00 DFES_OneToOne 0.00 65535.00 FORMAT "%8.2" /end CHARACTERISTIC
/begin CHARACTERISTIC DFC_CtlMsk.DFC_AAVmin_C "Behaviour control mask / Behaviour control masks of check DFC_AAVmin" VALUE 0x804D93B6 Val_Wu16 65535.00 DFES_OneToOne 0.00 65535.00 FORMAT "%8.2" /end CHARACTERISTIC
/begin CHARACTERISTIC DFC_CtlMsk.DFC_AGRSUS_C "Behaviour control mask / Behaviour control masks of check DFC_AGRSUS" VALUE 0x804D93B8 Val_Wu16 65535.00 DFES_OneToOne 0.00 65535.00 FORMAT "%8.2" /end CHARACTERISTIC
/begin CHARACTERISTIC DFC_CtlMsk.DFC_AfsPlausDiagHi_C "Behaviour control mask / Behaviour control masks of check DFC_AfsPlausDiagHi" VALUE 0x804D93BA Val_Wu16 65535.00 DFES_OneToOne 0.00 65535.00 FORMAT "%8.2" /end CHARACTERISTIC
/begin CHARACTERISTIC DFC_CtlMsk.DFC_AfsPlausDiagLo_C "Behaviour control mask / Behaviour control masks of check DFC_AfsPlausDiagLo" VALUE 0x804D93BC Val_Wu16 65535.00 DFES_OneToOne 0.00 65535.00 FORMAT "%8.2" /end CHARACTERISTIC
/begin CHARACTERISTIC DFC_CtlMsk.DFC_AfsVrntDiagErrB1_C "Behaviour control mask / Behaviour control masks of check DFC_AfsVrntDiagErrB1" VALUE 0x804D93BE Val_Wu16 65535.00 DFES_OneToOne 0.00 65535.00 FORMAT "%8.2" /end CHARACTERISTIC
/begin CHARACTERISTIC DFC_CtlMsk.DFC_AppAllSnsrDfct_C "Behaviour control mask / Behaviour control masks of check DFC_AppAllSnsrDfct" VALUE 0x804D93C0 Val_Wu16 65535.00 DFES_OneToOne 0.00 65535.00 FORMAT "%8.2" /end CHARACTERISTIC
/begin CHARACTERISTIC DFC_CtlMsk.DFC_BBKRnldg_C "Behaviour control mask / Behaviour control masks of check DFC_BBKRnldg" VALUE 0x804D93C2 Val_Wu16 65535.00 DFES_OneToOne 0.00 65535.00 FORMAT "%8.2" /end CHARACTERISTIC
/begin CHARACTERISTIC DFC_CtlMsk.DFC_BBKRsyne_C "Behaviour control mask / Behaviour control masks of check DFC_BBKRsyne" VALUE 0x804D93C4 Val_Wu16 65535.00 DFES_OneToOne 0.00 65535.00 FORMAT "%8.2" /end CHARACTERISTIC
/begin CHARACTERISTIC DFC_CtlMsk.DFC_BattUStdbyDiaOL_C "Behaviour control mask / Behaviour control masks of check DFC_BattUStdbyDiaOL" VALUE 0x804D93C6 Val_Wu16 65535.00 DFES_OneToOne 0.00 65535.00 FORMAT "%8.2" /end CHARACTERISTIC
/begin CHARACTERISTIC DFC_CtlMsk.DFC_BigLeakIntkMnfldEmiInfl_C "Behaviour control mask / Behaviour control masks of check DFC_BigLeakIntkMnfldEmiInfl" VALUE 0x804D93C8 Val_Wu16 65535.00 DFES_OneToOne 0.00 65535.00 FORMAT "%8.2" /end CHARACTERISTIC
/begin CHARACTERISTIC DFC_CtlMsk.DFC_BlkdLineTank_C "Behaviour control mask / Behaviour control masks of check DFC_BlkdLineTank" VALUE 0x804D93CA Val_Wu16 65535.00 DFES_OneToOne 0.00 65535.00 FORMAT "%8.2" /end CHARACTERISTIC
/begin CHARACTERISTIC DFC_CtlMsk.DFC_BrkMnSwtContOnWarnLmp_C "Behaviour control mask / Behaviour control masks of check DFC_BrkMnSwtContOnWarnLmp" VALUE 0x804D93CC Val_Wu16 65535.00 DFES_OneToOne 0.00 65535.00 FORMAT "%8.2" /end CHARACTERISTIC
/begin CHARACTERISTIC DFC_CtlMsk.DFC_BrkMnSwtNotStpWarnLmp_C "Behaviour control mask / Behaviour control masks of check DFC_BrkMnSwtNotStpWarnLmp" VALUE 0x804D93CE Val_Wu16 65535.00 DFES_OneToOne 0.00 65535.00 FORMAT "%8.2" /end CHARACTERISTIC
/begin CHARACTERISTIC DFC_CtlMsk.DFC_BrkRdntSwtContOnWarnLmp_C "Behaviour control mask / Behaviour control masks of check DFC_BrkRdntSwtContOnWarnLmp" VALUE 0x804D93D0 Val_Wu16 65535.00 DFES_OneToOne 0.00 65535.00 FORMAT "%8.2" /end CHARACTERISTIC
/begin CHARACTERISTIC DFC_CtlMsk.DFC_BrkRdntSwtNotStpWarnLmp_C "Behaviour control mask / Behaviour control masks of check DFC_BrkRdntSwtNotStpWarnLmp" VALUE 0x804D93D2 Val_Wu16 65535.00 DFES_OneToOne 0.00 65535.00 FORMAT "%8.2" /end CHARACTERISTIC
/begin CHARACTERISTIC DFC_CtlMsk.DFC_CEngDsTColdStrtMax_C "Behaviour control mask / Behaviour control masks of check DFC_CEngDsTColdStrtMax" VALUE 0x804D93D4 Val_Wu16 65535.00 DFES_OneToOne 0.00 65535.00 FORMAT "%8.2" /end CHARACTERISTIC
/begin CHARACTERISTIC DFC_CtlMsk.DFC_CEngDsTColdStrtMin_C "Behaviour control mask / Behaviour control masks of check DFC_CEngDsTColdStrtMin" VALUE 0x804D93D6 Val_Wu16 65535.00 DFES_OneToOne 0.00 65535.00 FORMAT "%8.2" /end CHARACTERISTIC
/begin CHARACTERISTIC DFC_CtlMsk.DFC_CEngDsTImps_C "Behaviour control mask / Behaviour control masks of check DFC_CEngDsTImps" VALUE 0x804D93D8 Val_Wu16 65535.00 DFES_OneToOne 0.00 65535.00 FORMAT "%8.2" /end CHARACTERISTIC
/begin CHARACTERISTIC DFC_CtlMsk.DFC_CEngDsTPlausHSC_C "Behaviour control mask / Behaviour control masks of check DFC_CEngDsTPlausHSC" VALUE 0x804D93DA Val_Wu16 65535.00 DFES_OneToOne 0.00 65535.00 FORMAT "%8.2" /end CHARACTERISTIC
/begin CHARACTERISTIC DFC_CtlMsk.DFC_CEngDsTPlausLSC_C "Behaviour control mask / Behaviour control masks of check DFC_CEngDsTPlausLSC" VALUE 0x804D93DC Val_Wu16 65535.00 DFES_OneToOne 0.00 65535.00 FORMAT "%8.2" /end CHARACTERISTIC
/begin CHARACTERISTIC DFC_CtlMsk.DFC_CEngDsTPlausSTC_C "Behaviour control mask / Behaviour control masks of check DFC_CEngDsTPlausSTC" VALUE 0x804D93DE Val_Wu16 65535.00 DFES_OneToOne 0.00 65535.00 FORMAT "%8.2" /end CHARACTERISTIC
/begin CHARACTERISTIC DFC_CtlMsk.DFC_CEngDsTSRCMax_C "Behaviour control mask / Behaviour control masks of check DFC_CEngDsTSRCMax" VALUE 0x804D93E0 Val_Wu16 65535.00 DFES_OneToOne 0.00 65535.00 FORMAT "%8.2" /end CHARACTERISTIC
/begin CHARACTERISTIC DFC_CtlMsk.DFC_CEngDsTSRCMin_C "Behaviour control mask / Behaviour control masks of check DFC_CEngDsTSRCMin" VALUE 0x804D93E2 Val_Wu16 65535.00 DFES_OneToOne 0.00 65535.00 FORMAT "%8.2" /end CHARACTERISTIC
/begin CHARACTERISTIC DFC_CtlMsk.DFC_CEngDsTSig_C "Behaviour control mask / Behaviour control masks of check DFC_CEngDsTSig" VALUE 0x804D93E4 Val_Wu16 65535.00 DFES_OneToOne 0.00 65535.00 FORMAT "%8.2" /end CHARACTERISTIC
/begin CHARACTERISTIC DFC_CtlMsk.DFC_CEngUsTColdStrtMax_C "Behaviour control mask / Behaviour control masks of check DFC_CEngUsTColdStrtMax" VALUE 0x804D93E6 Val_Wu16 65535.00 DFES_OneToOne 0.00 65535.00 FORMAT "%8.2" /end CHARACTERISTIC
/begin CHARACTERISTIC DFC_CtlMsk.DFC_CEngUsTColdStrtMin_C "Behaviour control mask / Behaviour control masks of check DFC_CEngUsTColdStrtMin" VALUE 0x804D93E8 Val_Wu16 65535.00 DFES_OneToOne 0.00 65535.00 FORMAT "%8.2" /end CHARACTERISTIC
/begin CHARACTERISTIC DFC_CtlMsk.DFC_CEngUsTLooseCnctn_C "Behaviour control mask / Behaviour control masks of check DFC_CEngUsTLooseCnctn" VALUE 0x804D93EA Val_Wu16 65535.00 DFES_OneToOne 0.00 65535.00 FORMAT "%8.2" /end CHARACTERISTIC
/begin CHARACTERISTIC DFC_CtlMsk.DFC_CEngUsTSRCMax_C "Behaviour control mask / Behaviour control masks of check DFC_CEngUsTSRCMax" VALUE 0x804D93EC Val_Wu16 65535.00 DFES_OneToOne 0.00 65535.00 FORMAT "%8.2" /end CHARACTERISTIC
/begin CHARACTERISTIC DFC_CtlMsk.DFC_CEngUsTSRCMin_C "Behaviour control mask / Behaviour control masks of check DFC_CEngUsTSRCMin" VALUE 0x804D93EE Val_Wu16 65535.00 DFES_OneToOne 0.00 65535.00 FORMAT "%8.2" /end CHARACTERISTIC
/begin CHARACTERISTIC DFC_CtlMsk.DFC_ComDCDCACCFailr_C "Behaviour control mask / Behaviour control masks of check DFC_ComDCDCACCFailr" VALUE 0x804D93F0 Val_Wu16 65535.00 DFES_OneToOne 0.00 65535.00 FORMAT "%8.2" /end CHARACTERISTIC
/begin CHARACTERISTIC DFC_CtlMsk.DFC_DCDCFltDet_C "Behaviour control mask / Behaviour control masks of check DFC_DCDCFltDet" VALUE 0x804D93F2 Val_Wu16 65535.00 DFES_OneToOne 0.00 65535.00 FORMAT "%8.2" /end CHARACTERISTIC
/begin CHARACTERISTIC DFC_CtlMsk.DFC_DKRSA_C "Behaviour control mask / Behaviour control masks of check DFC_DKRSA" VALUE 0x804D93F4 Val_Wu16 65535.00 DFES_OneToOne 0.00 65535.00 FORMAT "%8.2" /end CHARACTERISTIC
/begin CHARACTERISTIC DFC_CtlMsk.DFC_DKVSmax_C "Behaviour control mask / Behaviour control masks of check DFC_DKVSmax" VALUE 0x804D93F6 Val_Wu16 65535.00 DFES_OneToOne 0.00 65535.00 FORMAT "%8.2" /end CHARACTERISTIC
/begin CHARACTERISTIC DFC_CtlMsk.DFC_DKnpl_C "Behaviour control mask / Behaviour control masks of check DFC_DKnpl" VALUE 0x804D93F8 Val_Wu16 65535.00 DFES_OneToOne 0.00 65535.00 FORMAT "%8.2" /end CHARACTERISTIC
/begin CHARACTERISTIC DFC_CtlMsk.DFC_DSKVRmax_C "Behaviour control mask / Behaviour control masks of check DFC_DSKVRmax" VALUE 0x804D93FA Val_Wu16 65535.00 DFES_OneToOne 0.00 65535.00 FORMAT "%8.2" /end CHARACTERISTIC
/begin CHARACTERISTIC DFC_CtlMsk.DFC_DSKVRmin_C "Behaviour control mask / Behaviour control masks of check DFC_DSKVRmin" VALUE 0x804D93FC Val_Wu16 65535.00 DFES_OneToOne 0.00 65535.00 FORMAT "%8.2" /end CHARACTERISTIC
/begin CHARACTERISTIC DFC_CtlMsk.DFC_DSKVRnpl_C "Behaviour control mask / Behaviour control masks of check DFC_DSKVRnpl" VALUE 0x804D93FE Val_Wu16 65535.00 DFES_OneToOne 0.00 65535.00 FORMAT "%8.2" /end CHARACTERISTIC
/begin CHARACTERISTIC DFC_CtlMsk.DFC_DSKVRsig_C "Behaviour control mask / Behaviour control masks of check DFC_DSKVRsig" VALUE 0x804D9400 Val_Wu16 65535.00 DFES_OneToOne 0.00 65535.00 FORMAT "%8.2" /end CHARACTERISTIC
/begin CHARACTERISTIC DFC_CtlMsk.DFC_DSKVSsig_C "Behaviour control mask / Behaviour control masks of check DFC_DSKVSsig" VALUE 0x804D9402 Val_Wu16 65535.00 DFES_OneToOne 0.00 65535.00 FORMAT "%8.2" /end CHARACTERISTIC
/begin CHARACTERISTIC DFC_CtlMsk.DFC_DSSmax_C "Behaviour control mask / Behaviour control masks of check DFC_DSSmax" VALUE 0x804D9404 Val_Wu16 65535.00 DFES_OneToOne 0.00 65535.00 FORMAT "%8.2" /end CHARACTERISTIC
/begin CHARACTERISTIC DFC_CtlMsk.DFC_DSTDmax_C "Behaviour control mask / Behaviour control masks of check DFC_DSTDmax" VALUE 0x804D9406 Val_Wu16 65535.00 DFES_OneToOne 0.00 65535.00 FORMAT "%8.2" /end CHARACTERISTIC
/begin CHARACTERISTIC DFC_CtlMsk.DFC_DSTEmax_C "Behaviour control mask / Behaviour control masks of check DFC_DSTEmax" VALUE 0x804D9408 Val_Wu16 65535.00 DFES_OneToOne 0.00 65535.00 FORMAT "%8.2" /end CHARACTERISTIC
/begin CHARACTERISTIC DFC_CtlMsk.DFC_DSTEmin_C "Behaviour control mask / Behaviour control masks of check DFC_DSTEmin" VALUE 0x804D940A Val_Wu16 65535.00 DFES_OneToOne 0.00 65535.00 FORMAT "%8.2" /end CHARACTERISTIC
/begin CHARACTERISTIC DFC_CtlMsk.DFC_DSTOFmax_C "Behaviour control mask / Behaviour control masks of check DFC_DSTOFmax" VALUE 0x804D940C Val_Wu16 65535.00 DFES_OneToOne 0.00 65535.00 FORMAT "%8.2" /end CHARACTERISTIC
/begin CHARACTERISTIC DFC_CtlMsk.DFC_DSTRmax_C "Behaviour control mask / Behaviour control masks of check DFC_DSTRmax" VALUE 0x804D940E Val_Wu16 65535.00 DFES_OneToOne 0.00 65535.00 FORMAT "%8.2" /end CHARACTERISTIC
/begin CHARACTERISTIC DFC_CtlMsk.DFC_DSTRmin_C "Behaviour control mask / Behaviour control masks of check DFC_DSTRmin" VALUE 0x804D9410 Val_Wu16 65535.00 DFES_OneToOne 0.00 65535.00 FORMAT "%8.2" /end CHARACTERISTIC
/begin CHARACTERISTIC DFC_CtlMsk.DFC_DSTRnpl_C "Behaviour control mask / Behaviour control masks of check DFC_DSTRnpl" VALUE 0x804D9412 Val_Wu16 65535.00 DFES_OneToOne 0.00 65535.00 FORMAT "%8.2" /end CHARACTERISTIC
/begin CHARACTERISTIC DFC_CtlMsk.DFC_DSTRsig_C "Behaviour control mask / Behaviour control masks of check DFC_DSTRsig" VALUE 0x804D9414 Val_Wu16 65535.00 DFES_OneToOne 0.00 65535.00 FORMAT "%8.2" /end CHARACTERISTIC
/begin CHARACTERISTIC DFC_CtlMsk.DFC_DSTTI_C "Behaviour control mask / Behaviour control masks of check DFC_DSTTI" VALUE 0x804D9416 Val_Wu16 65535.00 DFES_OneToOne 0.00 65535.00 FORMAT "%8.2" /end CHARACTERISTIC
/begin CHARACTERISTIC DFC_CtlMsk.DFC_DSUmax_C "Behaviour control mask / Behaviour control masks of check DFC_DSUmax" VALUE 0x804D9418 Val_Wu16 65535.00 DFES_OneToOne 0.00 65535.00 FORMAT "%8.2" /end CHARACTERISTIC
/begin CHARACTERISTIC DFC_CtlMsk.DFC_DiagCpv1DteskLoLoadStuckClsd_C "Behaviour control mask / Behaviour control masks of check DFC_DiagCpv1DteskLoLoadStuckClsd" VALUE 0x804D941A Val_Wu16 65535.00 DFES_OneToOne 0.00 65535.00 FORMAT "%8.2" /end CHARACTERISTIC
/begin CHARACTERISTIC DFC_CtlMsk.DFC_DiagCpv1DteskLoLoadStuckOpen_C "Behaviour control mask / Behaviour control masks of check DFC_DiagCpv1DteskLoLoadStuckOpen" VALUE 0x804D941C Val_Wu16 65535.00 DFES_OneToOne 0.00 65535.00 FORMAT "%8.2" /end CHARACTERISTIC
/begin CHARACTERISTIC DFC_CtlMsk.DFC_EGRVlvDrftClsd_C "Behaviour control mask / Behaviour control masks of check DFC_EGRVlvDrftClsd" VALUE 0x804D941E Val_Wu16 65535.00 DFES_OneToOne 0.00 65535.00 FORMAT "%8.2" /end CHARACTERISTIC
/begin CHARACTERISTIC DFC_CtlMsk.DFC_EGRVlvDrftOpn_C "Behaviour control mask / Behaviour control masks of check DFC_EGRVlvDrftOpn" VALUE 0x804D9420 Val_Wu16 65535.00 DFES_OneToOne 0.00 65535.00 FORMAT "%8.2" /end CHARACTERISTIC
/begin CHARACTERISTIC DFC_CtlMsk.DFC_EGRVlvJamVlvClsd_C "Behaviour control mask / Behaviour control masks of check DFC_EGRVlvJamVlvClsd" VALUE 0x804D9422 Val_Wu16 65535.00 DFES_OneToOne 0.00 65535.00 FORMAT "%8.2" /end CHARACTERISTIC
/begin CHARACTERISTIC DFC_CtlMsk.DFC_EGRVlvJamVlvOpn_C "Behaviour control mask / Behaviour control masks of check DFC_EGRVlvJamVlvOpn" VALUE 0x804D9424 Val_Wu16 65535.00 DFES_OneToOne 0.00 65535.00 FORMAT "%8.2" /end CHARACTERISTIC
/begin CHARACTERISTIC DFC_CtlMsk.DFC_EGRVlvSprgBrk_C "Behaviour control mask / Behaviour control masks of check DFC_EGRVlvSprgBrk" VALUE 0x804D9426 Val_Wu16 65535.00 DFES_OneToOne 0.00 65535.00 FORMAT "%8.2" /end CHARACTERISTIC
/begin CHARACTERISTIC DFC_CtlMsk.DFC_EGRVlvTempMdlEEPErr_C "Behaviour control mask / Behaviour control masks of check DFC_EGRVlvTempMdlEEPErr" VALUE 0x804D9428 Val_Wu16 65535.00 DFES_OneToOne 0.00 65535.00 FORMAT "%8.2" /end CHARACTERISTIC
/begin CHARACTERISTIC DFC_CtlMsk.DFC_EGRVlvTmpErr_C "Behaviour control mask / Behaviour control masks of check DFC_EGRVlvTmpErr" VALUE 0x804D942A Val_Wu16 65535.00 DFES_OneToOne 0.00 65535.00 FORMAT "%8.2" /end CHARACTERISTIC
/begin CHARACTERISTIC DFC_CtlMsk.DFC_EGSDUS2B1LtrDly_C "Behaviour control mask / Behaviour control masks of check DFC_EGSDUS2B1LtrDly" VALUE 0x804D942C Val_Wu16 65535.00 DFES_OneToOne 0.00 65535.00 FORMAT "%8.2" /end CHARACTERISTIC
/begin CHARACTERISTIC DFC_CtlMsk.DFC_EGSDUS2B1LtrPT1_C "Behaviour control mask / Behaviour control masks of check DFC_EGSDUS2B1LtrPT1" VALUE 0x804D942E Val_Wu16 65535.00 DFES_OneToOne 0.00 65535.00 FORMAT "%8.2" /end CHARACTERISTIC
/begin CHARACTERISTIC DFC_CtlMsk.DFC_EGSDUS2B1RtlDly_C "Behaviour control mask / Behaviour control masks of check DFC_EGSDUS2B1RtlDly" VALUE 0x804D9430 Val_Wu16 65535.00 DFES_OneToOne 0.00 65535.00 FORMAT "%8.2" /end CHARACTERISTIC
/begin CHARACTERISTIC DFC_CtlMsk.DFC_EGSDUS2B1RtlPT1_C "Behaviour control mask / Behaviour control masks of check DFC_EGSDUS2B1RtlPT1" VALUE 0x804D9432 Val_Wu16 65535.00 DFES_OneToOne 0.00 65535.00 FORMAT "%8.2" /end CHARACTERISTIC
/begin CHARACTERISTIC DFC_CtlMsk.DFC_EGSDUS2B1TarLean_C "Behaviour control mask / Behaviour control masks of check DFC_EGSDUS2B1TarLean" VALUE 0x804D9434 Val_Wu16 65535.00 DFES_OneToOne 0.00 65535.00 FORMAT "%8.2" /end CHARACTERISTIC
/begin CHARACTERISTIC DFC_CtlMsk.DFC_EGSDUS2B1TarRich_C "Behaviour control mask / Behaviour control masks of check DFC_EGSDUS2B1TarRich" VALUE 0x804D9436 Val_Wu16 65535.00 DFES_OneToOne 0.00 65535.00 FORMAT "%8.2" /end CHARACTERISTIC
/begin CHARACTERISTIC DFC_CtlMsk.DFC_EONVmax_C "Behaviour control mask / Behaviour control masks of check DFC_EONVmax" VALUE 0x804D9438 Val_Wu16 65535.00 DFES_OneToOne 0.00 65535.00 FORMAT "%8.2" /end CHARACTERISTIC
/begin CHARACTERISTIC DFC_CtlMsk.DFC_ETAKHLmax_C "Behaviour control mask / Behaviour control masks of check DFC_ETAKHLmax" VALUE 0x804D943A Val_Wu16 65535.00 DFES_OneToOne 0.00 65535.00 FORMAT "%8.2" /end CHARACTERISTIC
/begin CHARACTERISTIC DFC_CtlMsk.DFC_ETAKHTmax_C "Behaviour control mask / Behaviour control masks of check DFC_ETAKHTmax" VALUE 0x804D943C Val_Wu16 65535.00 DFES_OneToOne 0.00 65535.00 FORMAT "%8.2" /end CHARACTERISTIC
/begin CHARACTERISTIC DFC_CtlMsk.DFC_ETHSEmax_C "Behaviour control mask / Behaviour control masks of check DFC_ETHSEmax" VALUE 0x804D943E Val_Wu16 65535.00 DFES_OneToOne 0.00 65535.00 FORMAT "%8.2" /end CHARACTERISTIC
/begin CHARACTERISTIC DFC_CtlMsk.DFC_ETHSEmin_C "Behaviour control mask / Behaviour control masks of check DFC_ETHSEmin" VALUE 0x804D9440 Val_Wu16 65535.00 DFES_OneToOne 0.00 65535.00 FORMAT "%8.2" /end CHARACTERISTIC
/begin CHARACTERISTIC DFC_CtlMsk.DFC_ETHSFmax_C "Behaviour control mask / Behaviour control masks of check DFC_ETHSFmax" VALUE 0x804D9442 Val_Wu16 65535.00 DFES_OneToOne 0.00 65535.00 FORMAT "%8.2" /end CHARACTERISTIC
/begin CHARACTERISTIC DFC_CtlMsk.DFC_ETHSFmin_C "Behaviour control mask / Behaviour control masks of check DFC_ETHSFmin" VALUE 0x804D9444 Val_Wu16 65535.00 DFES_OneToOne 0.00 65535.00 FORMAT "%8.2" /end CHARACTERISTIC
/begin CHARACTERISTIC DFC_CtlMsk.DFC_ETHSFsig_C "Behaviour control mask / Behaviour control masks of check DFC_ETHSFsig" VALUE 0x804D9446 Val_Wu16 65535.00 DFES_OneToOne 0.00 65535.00 FORMAT "%8.2" /end CHARACTERISTIC
/begin CHARACTERISTIC DFC_CtlMsk.DFC_ETHSNPWmax_C "Behaviour control mask / Behaviour control masks of check DFC_ETHSNPWmax" VALUE 0x804D9448 Val_Wu16 65535.00 DFES_OneToOne 0.00 65535.00 FORMAT "%8.2" /end CHARACTERISTIC
/begin CHARACTERISTIC DFC_CtlMsk.DFC_ETHSNPWmin_C "Behaviour control mask / Behaviour control masks of check DFC_ETHSNPWmin" VALUE 0x804D944A Val_Wu16 65535.00 DFES_OneToOne 0.00 65535.00 FORMAT "%8.2" /end CHARACTERISTIC
/begin CHARACTERISTIC DFC_CtlMsk.DFC_ETHSNPWsig_C "Behaviour control mask / Behaviour control masks of check DFC_ETHSNPWsig" VALUE 0x804D944C Val_Wu16 65535.00 DFES_OneToOne 0.00 65535.00 FORMAT "%8.2" /end CHARACTERISTIC
/begin CHARACTERISTIC DFC_CtlMsk.DFC_ETHSPLnpl_C "Behaviour control mask / Behaviour control masks of check DFC_ETHSPLnpl" VALUE 0x804D944E Val_Wu16 65535.00 DFES_OneToOne 0.00 65535.00 FORMAT "%8.2" /end CHARACTERISTIC
/begin CHARACTERISTIC DFC_CtlMsk.DFC_ETHSTPLnpl_C "Behaviour control mask / Behaviour control masks of check DFC_ETHSTPLnpl" VALUE 0x804D9450 Val_Wu16 65535.00 DFES_OneToOne 0.00 65535.00 FORMAT "%8.2" /end CHARACTERISTIC
/begin CHARACTERISTIC DFC_CtlMsk.DFC_EngICO_C "Behaviour control mask / Behaviour control masks of check DFC_EngICO" VALUE 0x804D9452 Val_Wu16 65535.00 DFES_OneToOne 0.00 65535.00 FORMAT "%8.2" /end CHARACTERISTIC
/begin CHARACTERISTIC DFC_CtlMsk.DFC_EngPrtOvrSpdMon_C "Behaviour control mask / Behaviour control masks of check DFC_EngPrtOvrSpdMon" VALUE 0x804D9454 Val_Wu16 65535.00 DFES_OneToOne 0.00 65535.00 FORMAT "%8.2" /end CHARACTERISTIC
/begin CHARACTERISTIC DFC_CtlMsk.DFC_EpmCaSI1ErrSig_C "Behaviour control mask / Behaviour control masks of check DFC_EpmCaSI1ErrSig" VALUE 0x804D9456 Val_Wu16 65535.00 DFES_OneToOne 0.00 65535.00 FORMAT "%8.2" /end CHARACTERISTIC
/begin CHARACTERISTIC DFC_CtlMsk.DFC_EpmCaSI1MntErr_C "Behaviour control mask / Behaviour control masks of check DFC_EpmCaSI1MntErr" VALUE 0x804D9458 Val_Wu16 65535.00 DFES_OneToOne 0.00 65535.00 FORMAT "%8.2" /end CHARACTERISTIC
/begin CHARACTERISTIC DFC_CtlMsk.DFC_EpmCaSI1NoSigMax_C "Behaviour control mask / Behaviour control masks of check DFC_EpmCaSI1NoSigMax" VALUE 0x804D945A Val_Wu16 65535.00 DFES_OneToOne 0.00 65535.00 FORMAT "%8.2" /end CHARACTERISTIC
/begin CHARACTERISTIC DFC_CtlMsk.DFC_EpmCaSI1NoSigMin_C "Behaviour control mask / Behaviour control masks of check DFC_EpmCaSI1NoSigMin" VALUE 0x804D945C Val_Wu16 65535.00 DFES_OneToOne 0.00 65535.00 FORMAT "%8.2" /end CHARACTERISTIC
/begin CHARACTERISTIC DFC_CtlMsk.DFC_EpmCaSI1OfsErr_C "Behaviour control mask / Behaviour control masks of check DFC_EpmCaSI1OfsErr" VALUE 0x804D945E Val_Wu16 65535.00 DFES_OneToOne 0.00 65535.00 FORMAT "%8.2" /end CHARACTERISTIC
/begin CHARACTERISTIC DFC_CtlMsk.DFC_EpmCrSDGI_C "Behaviour control mask / Behaviour control masks of check DFC_EpmCrSDGI" VALUE 0x804D9460 Val_Wu16 65535.00 DFES_OneToOne 0.00 65535.00 FORMAT "%8.2" /end CHARACTERISTIC
/begin CHARACTERISTIC DFC_CtlMsk.DFC_EpmCrSErrSig_C "Behaviour control mask / Behaviour control masks of check DFC_EpmCrSErrSig" VALUE 0x804D9462 Val_Wu16 65535.00 DFES_OneToOne 0.00 65535.00 FORMAT "%8.2" /end CHARACTERISTIC
/begin CHARACTERISTIC DFC_CtlMsk.DFC_EpmCrSNoSig_C "Behaviour control mask / Behaviour control masks of check DFC_EpmCrSNoSig" VALUE 0x804D9464 Val_Wu16 65535.00 DFES_OneToOne 0.00 65535.00 FORMAT "%8.2" /end CHARACTERISTIC
/begin CHARACTERISTIC DFC_CtlMsk.DFC_EtaEngIdleNonCsers_C "Behaviour control mask / Behaviour control masks of check DFC_EtaEngIdleNonCsers" VALUE 0x804D9466 Val_Wu16 65535.00 DFES_OneToOne 0.00 65535.00 FORMAT "%8.2" /end CHARACTERISTIC
/begin CHARACTERISTIC DFC_CtlMsk.DFC_EtaEngPtlNonCsers_C "Behaviour control mask / Behaviour control masks of check DFC_EtaEngPtlNonCsers" VALUE 0x804D9468 Val_Wu16 65535.00 DFES_OneToOne 0.00 65535.00 FORMAT "%8.2" /end CHARACTERISTIC
/begin CHARACTERISTIC DFC_CtlMsk.DFC_FRAmax_C "Behaviour control mask / Behaviour control masks of check DFC_FRAmax" VALUE 0x804D946A Val_Wu16 65535.00 DFES_OneToOne 0.00 65535.00 FORMAT "%8.2" /end CHARACTERISTIC
/begin CHARACTERISTIC DFC_CtlMsk.DFC_FRAmin_C "Behaviour control mask / Behaviour control masks of check DFC_FRAmin" VALUE 0x804D946C Val_Wu16 65535.00 DFES_OneToOne 0.00 65535.00 FORMAT "%8.2" /end CHARACTERISTIC
/begin CHARACTERISTIC DFC_CtlMsk.DFC_FSTEmax_C "Behaviour control mask / Behaviour control masks of check DFC_FSTEmax" VALUE 0x804D946E Val_Wu16 65535.00 DFES_OneToOne 0.00 65535.00 FORMAT "%8.2" /end CHARACTERISTIC
/begin CHARACTERISTIC DFC_CtlMsk.DFC_FSTEmin_C "Behaviour control mask / Behaviour control masks of check DFC_FSTEmin" VALUE 0x804D9470 Val_Wu16 65535.00 DFES_OneToOne 0.00 65535.00 FORMAT "%8.2" /end CHARACTERISTIC
/begin CHARACTERISTIC DFC_CtlMsk.DFC_FSTRmax_C "Behaviour control mask / Behaviour control masks of check DFC_FSTRmax" VALUE 0x804D9472 Val_Wu16 65535.00 DFES_OneToOne 0.00 65535.00 FORMAT "%8.2" /end CHARACTERISTIC
/begin CHARACTERISTIC DFC_CtlMsk.DFC_FSTRmin_C "Behaviour control mask / Behaviour control masks of check DFC_FSTRmin" VALUE 0x804D9474 Val_Wu16 65535.00 DFES_OneToOne 0.00 65535.00 FORMAT "%8.2" /end CHARACTERISTIC
/begin CHARACTERISTIC DFC_CtlMsk.DFC_FSTRnpl_C "Behaviour control mask / Behaviour control masks of check DFC_FSTRnpl" VALUE 0x804D9476 Val_Wu16 65535.00 DFES_OneToOne 0.00 65535.00 FORMAT "%8.2" /end CHARACTERISTIC
/begin CHARACTERISTIC DFC_CtlMsk.DFC_FSTmax_C "Behaviour control mask / Behaviour control masks of check DFC_FSTmax" VALUE 0x804D9478 Val_Wu16 65535.00 DFES_OneToOne 0.00 65535.00 FORMAT "%8.2" /end CHARACTERISTIC
/begin CHARACTERISTIC DFC_CtlMsk.DFC_FTDLAmax_C "Behaviour control mask / Behaviour control masks of check DFC_FTDLAmax" VALUE 0x804D947A Val_Wu16 65535.00 DFES_OneToOne 0.00 65535.00 FORMAT "%8.2" /end CHARACTERISTIC
/begin CHARACTERISTIC DFC_CtlMsk.DFC_FTDLAmin_C "Behaviour control mask / Behaviour control masks of check DFC_FTDLAmin" VALUE 0x804D947C Val_Wu16 65535.00 DFES_OneToOne 0.00 65535.00 FORMAT "%8.2" /end CHARACTERISTIC
/begin CHARACTERISTIC DFC_CtlMsk.DFC_FuPHiSnsrEleclmax_C "Behaviour control mask / Behaviour control masks of check DFC_FuPHiSnsrEleclmax" VALUE 0x804D947E Val_Wu16 65535.00 DFES_OneToOne 0.00 65535.00 FORMAT "%8.2" /end CHARACTERISTIC
/begin CHARACTERISTIC DFC_CtlMsk.DFC_FuPHiSnsrEleclmin_C "Behaviour control mask / Behaviour control masks of check DFC_FuPHiSnsrEleclmin" VALUE 0x804D9480 Val_Wu16 65535.00 DFES_OneToOne 0.00 65535.00 FORMAT "%8.2" /end CHARACTERISTIC
/begin CHARACTERISTIC DFC_CtlMsk.DFC_FuPHiSnsrEleclnpl_C "Behaviour control mask / Behaviour control masks of check DFC_FuPHiSnsrEleclnpl" VALUE 0x804D9482 Val_Wu16 65535.00 DFES_OneToOne 0.00 65535.00 FORMAT "%8.2" /end CHARACTERISTIC
/begin CHARACTERISTIC DFC_CtlMsk.DFC_FuPHiSnsrURngMax_C "Behaviour control mask / Behaviour control masks of check DFC_FuPHiSnsrURngMax" VALUE 0x804D9484 Val_Wu16 65535.00 DFES_OneToOne 0.00 65535.00 FORMAT "%8.2" /end CHARACTERISTIC
/begin CHARACTERISTIC DFC_CtlMsk.DFC_FuPHiSnsrURngMin_C "Behaviour control mask / Behaviour control masks of check DFC_FuPHiSnsrURngMin" VALUE 0x804D9486 Val_Wu16 65535.00 DFES_OneToOne 0.00 65535.00 FORMAT "%8.2" /end CHARACTERISTIC
/begin CHARACTERISTIC DFC_CtlMsk.DFC_FuSnsrPhyRngMaxErr_C "Behaviour control mask / Behaviour control masks of check DFC_FuSnsrPhyRngMaxErr" VALUE 0x804D9488 Val_Wu16 65535.00 DFES_OneToOne 0.00 65535.00 FORMAT "%8.2" /end CHARACTERISTIC
/begin CHARACTERISTIC DFC_CtlMsk.DFC_FuSnsrPhyRngMinErr_C "Behaviour control mask / Behaviour control masks of check DFC_FuSnsrPhyRngMinErr" VALUE 0x804D948A Val_Wu16 65535.00 DFES_OneToOne 0.00 65535.00 FORMAT "%8.2" /end CHARACTERISTIC
/begin CHARACTERISTIC DFC_CtlMsk.DFC_GEVlvLockPinDiagIntkB1_C "Behaviour control mask / Behaviour control masks of check DFC_GEVlvLockPinDiagIntkB1" VALUE 0x804D948C Val_Wu16 65535.00 DFES_OneToOne 0.00 65535.00 FORMAT "%8.2" /end CHARACTERISTIC
/begin CHARACTERISTIC DFC_CtlMsk.DFC_GEVlvPhaSlowIntkB1_C "Behaviour control mask / Behaviour control masks of check DFC_GEVlvPhaSlowIntkB1" VALUE 0x804D948E Val_Wu16 65535.00 DFES_OneToOne 0.00 65535.00 FORMAT "%8.2" /end CHARACTERISTIC
/begin CHARACTERISTIC DFC_CtlMsk.DFC_GEVlvPhaTargIntkB1_C "Behaviour control mask / Behaviour control masks of check DFC_GEVlvPhaTargIntkB1" VALUE 0x804D9490 Val_Wu16 65535.00 DFES_OneToOne 0.00 65535.00 FORMAT "%8.2" /end CHARACTERISTIC
/begin CHARACTERISTIC DFC_CtlMsk.DFC_GbxRvsSwtStk_C "Behaviour control mask / Behaviour control masks of check DFC_GbxRvsSwtStk" VALUE 0x804D9492 Val_Wu16 65535.00 DFES_OneToOne 0.00 65535.00 FORMAT "%8.2" /end CHARACTERISTIC
/begin CHARACTERISTIC DFC_CtlMsk.DFC_HDRKHmax_C "Behaviour control mask / Behaviour control masks of check DFC_HDRKHmax" VALUE 0x804D9494 Val_Wu16 65535.00 DFES_OneToOne 0.00 65535.00 FORMAT "%8.2" /end CHARACTERISTIC
/begin CHARACTERISTIC DFC_CtlMsk.DFC_HDRKHmin_C "Behaviour control mask / Behaviour control masks of check DFC_HDRKHmin" VALUE 0x804D9496 Val_Wu16 65535.00 DFES_OneToOne 0.00 65535.00 FORMAT "%8.2" /end CHARACTERISTIC
/begin CHARACTERISTIC DFC_CtlMsk.DFC_HDRPLmax_C "Behaviour control mask / Behaviour control masks of check DFC_HDRPLmax" VALUE 0x804D9498 Val_Wu16 65535.00 DFES_OneToOne 0.00 65535.00 FORMAT "%8.2" /end CHARACTERISTIC
/begin CHARACTERISTIC DFC_CtlMsk.DFC_HDRPLmin_C "Behaviour control mask / Behaviour control masks of check DFC_HDRPLmin" VALUE 0x804D949A Val_Wu16 65535.00 DFES_OneToOne 0.00 65535.00 FORMAT "%8.2" /end CHARACTERISTIC
/begin CHARACTERISTIC DFC_CtlMsk.DFC_HDRmax_C "Behaviour control mask / Behaviour control masks of check DFC_HDRmax" VALUE 0x804D949C Val_Wu16 65535.00 DFES_OneToOne 0.00 65535.00 FORMAT "%8.2" /end CHARACTERISTIC
/begin CHARACTERISTIC DFC_CtlMsk.DFC_HDRmin_C "Behaviour control mask / Behaviour control masks of check DFC_HDRmin" VALUE 0x804D949E Val_Wu16 65535.00 DFES_OneToOne 0.00 65535.00 FORMAT "%8.2" /end CHARACTERISTIC
/begin CHARACTERISTIC DFC_CtlMsk.DFC_HEGOS2B1ElecMax_C "Behaviour control mask / Behaviour control masks of check DFC_HEGOS2B1ElecMax" VALUE 0x804D94A0 Val_Wu16 65535.00 DFES_OneToOne 0.00 65535.00 FORMAT "%8.2" /end CHARACTERISTIC
/begin CHARACTERISTIC DFC_CtlMsk.DFC_HEGOS2B1ElecMin_C "Behaviour control mask / Behaviour control masks of check DFC_HEGOS2B1ElecMin" VALUE 0x804D94A2 Val_Wu16 65535.00 DFES_OneToOne 0.00 65535.00 FORMAT "%8.2" /end CHARACTERISTIC
/begin CHARACTERISTIC DFC_CtlMsk.DFC_HEGOS2B1ElecSig_C "Behaviour control mask / Behaviour control masks of check DFC_HEGOS2B1ElecSig" VALUE 0x804D94A4 Val_Wu16 65535.00 DFES_OneToOne 0.00 65535.00 FORMAT "%8.2" /end CHARACTERISTIC
/begin CHARACTERISTIC DFC_CtlMsk.DFC_HEGOS2B1HtgNpl_C "Behaviour control mask / Behaviour control masks of check DFC_HEGOS2B1HtgNpl" VALUE 0x804D94A6 Val_Wu16 65535.00 DFES_OneToOne 0.00 65535.00 FORMAT "%8.2" /end CHARACTERISTIC
/begin CHARACTERISTIC DFC_CtlMsk.DFC_HEV00max_C "Behaviour control mask / Behaviour control masks of check DFC_HEV00max" VALUE 0x804D94A8 Val_Wu16 65535.00 DFES_OneToOne 0.00 65535.00 FORMAT "%8.2" /end CHARACTERISTIC
/begin CHARACTERISTIC DFC_CtlMsk.DFC_HEV01max_C "Behaviour control mask / Behaviour control masks of check DFC_HEV01max" VALUE 0x804D94AA Val_Wu16 65535.00 DFES_OneToOne 0.00 65535.00 FORMAT "%8.2" /end CHARACTERISTIC
/begin CHARACTERISTIC DFC_CtlMsk.DFC_HEV02max_C "Behaviour control mask / Behaviour control masks of check DFC_HEV02max" VALUE 0x804D94AC Val_Wu16 65535.00 DFES_OneToOne 0.00 65535.00 FORMAT "%8.2" /end CHARACTERISTIC
/begin CHARACTERISTIC DFC_CtlMsk.DFC_HEV03max_C "Behaviour control mask / Behaviour control masks of check DFC_HEV03max" VALUE 0x804D94AE Val_Wu16 65535.00 DFES_OneToOne 0.00 65535.00 FORMAT "%8.2" /end CHARACTERISTIC
/begin CHARACTERISTIC DFC_CtlMsk.DFC_HEVE0max_C "Behaviour control mask / Behaviour control masks of check DFC_HEVE0max" VALUE 0x804D94B0 Val_Wu16 65535.00 DFES_OneToOne 0.00 65535.00 FORMAT "%8.2" /end CHARACTERISTIC
/begin CHARACTERISTIC DFC_CtlMsk.DFC_HEVE1max_C "Behaviour control mask / Behaviour control masks of check DFC_HEVE1max" VALUE 0x804D94B2 Val_Wu16 65535.00 DFES_OneToOne 0.00 65535.00 FORMAT "%8.2" /end CHARACTERISTIC
/begin CHARACTERISTIC DFC_CtlMsk.DFC_HFMmax_C "Behaviour control mask / Behaviour control masks of check DFC_HFMmax" VALUE 0x804D94B4 Val_Wu16 65535.00 DFES_OneToOne 0.00 65535.00 FORMAT "%8.2" /end CHARACTERISTIC
/begin CHARACTERISTIC DFC_CtlMsk.DFC_HiPSysHiPMaxLimExcdd_C "Behaviour control mask / Behaviour control masks of check DFC_HiPSysHiPMaxLimExcdd" VALUE 0x804D94B6 Val_Wu16 65535.00 DFES_OneToOne 0.00 65535.00 FORMAT "%8.2" /end CHARACTERISTIC
/begin CHARACTERISTIC DFC_CtlMsk.DFC_IVGdiCtlCvoErrMax_0_C "Behaviour control mask / Behaviour control masks of check DFC_IVGdiCtlCvoErrMax_0" VALUE 0x804D94B8 Val_Wu16 65535.00 DFES_OneToOne 0.00 65535.00 FORMAT "%8.2" /end CHARACTERISTIC
/begin CHARACTERISTIC DFC_CtlMsk.DFC_IVGdiCtlCvoErrMax_1_C "Behaviour control mask / Behaviour control masks of check DFC_IVGdiCtlCvoErrMax_1" VALUE 0x804D94BA Val_Wu16 65535.00 DFES_OneToOne 0.00 65535.00 FORMAT "%8.2" /end CHARACTERISTIC
/begin CHARACTERISTIC DFC_CtlMsk.DFC_IVGdiCtlCvoErrMax_2_C "Behaviour control mask / Behaviour control masks of check DFC_IVGdiCtlCvoErrMax_2" VALUE 0x804D94BC Val_Wu16 65535.00 DFES_OneToOne 0.00 65535.00 FORMAT "%8.2" /end CHARACTERISTIC
/begin CHARACTERISTIC DFC_CtlMsk.DFC_IVGdiCtlCvoErrMax_3_C "Behaviour control mask / Behaviour control masks of check DFC_IVGdiCtlCvoErrMax_3" VALUE 0x804D94BE Val_Wu16 65535.00 DFES_OneToOne 0.00 65535.00 FORMAT "%8.2" /end CHARACTERISTIC
/begin CHARACTERISTIC DFC_CtlMsk.DFC_IVGdiCtlCvoErrMin_0_C "Behaviour control mask / Behaviour control masks of check DFC_IVGdiCtlCvoErrMin_0" VALUE 0x804D94C0 Val_Wu16 65535.00 DFES_OneToOne 0.00 65535.00 FORMAT "%8.2" /end CHARACTERISTIC
/begin CHARACTERISTIC DFC_CtlMsk.DFC_IVGdiCtlCvoErrMin_1_C "Behaviour control mask / Behaviour control masks of check DFC_IVGdiCtlCvoErrMin_1" VALUE 0x804D94C2 Val_Wu16 65535.00 DFES_OneToOne 0.00 65535.00 FORMAT "%8.2" /end CHARACTERISTIC
/begin CHARACTERISTIC DFC_CtlMsk.DFC_IVGdiCtlCvoErrMin_2_C "Behaviour control mask / Behaviour control masks of check DFC_IVGdiCtlCvoErrMin_2" VALUE 0x804D94C4 Val_Wu16 65535.00 DFES_OneToOne 0.00 65535.00 FORMAT "%8.2" /end CHARACTERISTIC
/begin CHARACTERISTIC DFC_CtlMsk.DFC_IVGdiCtlCvoErrMin_3_C "Behaviour control mask / Behaviour control masks of check DFC_IVGdiCtlCvoErrMin_3" VALUE 0x804D94C6 Val_Wu16 65535.00 DFES_OneToOne 0.00 65535.00 FORMAT "%8.2" /end CHARACTERISTIC
/begin CHARACTERISTIC DFC_CtlMsk.DFC_IVGdiCtlCvoErrMinMax_C "Behaviour control mask / Behaviour control masks of check DFC_IVGdiCtlCvoErrMinMax" VALUE 0x804D94C8 Val_Wu16 65535.00 DFES_OneToOne 0.00 65535.00 FORMAT "%8.2" /end CHARACTERISTIC
/begin CHARACTERISTIC DFC_CtlMsk.DFC_IVGdiCtlCvoSigPlausErrSmrCdn_C "Behaviour control mask / Behaviour control masks of check DFC_IVGdiCtlCvoSigPlausErrSmrCdn" VALUE 0x804D94CA Val_Wu16 65535.00 DFES_OneToOne 0.00 65535.00 FORMAT "%8.2" /end CHARACTERISTIC
/begin CHARACTERISTIC DFC_CtlMsk.DFC_IVGdiCtl_CvoErr_C "Behaviour control mask / Behaviour control masks of check DFC_IVGdiCtl_CvoErr" VALUE 0x804D94CC Val_Wu16 65535.00 DFES_OneToOne 0.00 65535.00 FORMAT "%8.2" /end CHARACTERISTIC
/begin CHARACTERISTIC DFC_CtlMsk.DFC_IVGdiCtl_CvoSigPlaus_0_C "Behaviour control mask / Behaviour control masks of check DFC_IVGdiCtl_CvoSigPlaus_0" VALUE 0x804D94CE Val_Wu16 65535.00 DFES_OneToOne 0.00 65535.00 FORMAT "%8.2" /end CHARACTERISTIC
/begin CHARACTERISTIC DFC_CtlMsk.DFC_IVGdiCtl_CvoSigPlaus_1_C "Behaviour control mask / Behaviour control masks of check DFC_IVGdiCtl_CvoSigPlaus_1" VALUE 0x804D94D0 Val_Wu16 65535.00 DFES_OneToOne 0.00 65535.00 FORMAT "%8.2" /end CHARACTERISTIC
/begin CHARACTERISTIC DFC_CtlMsk.DFC_IVGdiCtl_CvoSigPlaus_2_C "Behaviour control mask / Behaviour control masks of check DFC_IVGdiCtl_CvoSigPlaus_2" VALUE 0x804D94D2 Val_Wu16 65535.00 DFES_OneToOne 0.00 65535.00 FORMAT "%8.2" /end CHARACTERISTIC
/begin CHARACTERISTIC DFC_CtlMsk.DFC_IVGdiCtl_CvoSigPlaus_3_C "Behaviour control mask / Behaviour control masks of check DFC_IVGdiCtl_CvoSigPlaus_3" VALUE 0x804D94D4 Val_Wu16 65535.00 DFES_OneToOne 0.00 65535.00 FORMAT "%8.2" /end CHARACTERISTIC
/begin CHARACTERISTIC DFC_CtlMsk.DFC_IntkAirTAirFltDsCrssMax_C "Behaviour control mask / Behaviour control masks of check DFC_IntkAirTAirFltDsCrssMax" VALUE 0x804D94D6 Val_Wu16 65535.00 DFES_OneToOne 0.00 65535.00 FORMAT "%8.2" /end CHARACTERISTIC
/begin CHARACTERISTIC DFC_CtlMsk.DFC_IntkAirTAirFltDsCrssMin_C "Behaviour control mask / Behaviour control masks of check DFC_IntkAirTAirFltDsCrssMin" VALUE 0x804D94D8 Val_Wu16 65535.00 DFES_OneToOne 0.00 65535.00 FORMAT "%8.2" /end CHARACTERISTIC
/begin CHARACTERISTIC DFC_CtlMsk.DFC_IntkAirTAirFltDsHSCMax_C "Behaviour control mask / Behaviour control masks of check DFC_IntkAirTAirFltDsHSCMax" VALUE 0x804D94DA Val_Wu16 65535.00 DFES_OneToOne 0.00 65535.00 FORMAT "%8.2" /end CHARACTERISTIC
/begin CHARACTERISTIC DFC_CtlMsk.DFC_IntkAirTAirFltDsImps_C "Behaviour control mask / Behaviour control masks of check DFC_IntkAirTAirFltDsImps" VALUE 0x804D94DC Val_Wu16 65535.00 DFES_OneToOne 0.00 65535.00 FORMAT "%8.2" /end CHARACTERISTIC
/begin CHARACTERISTIC DFC_CtlMsk.DFC_IntkAirTAirFltDsPRCMax_C "Behaviour control mask / Behaviour control masks of check DFC_IntkAirTAirFltDsPRCMax" VALUE 0x804D94DE Val_Wu16 65535.00 DFES_OneToOne 0.00 65535.00 FORMAT "%8.2" /end CHARACTERISTIC
/begin CHARACTERISTIC DFC_CtlMsk.DFC_IntkAirTAirFltDsPRCMin_C "Behaviour control mask / Behaviour control masks of check DFC_IntkAirTAirFltDsPRCMin" VALUE 0x804D94E0 Val_Wu16 65535.00 DFES_OneToOne 0.00 65535.00 FORMAT "%8.2" /end CHARACTERISTIC
/begin CHARACTERISTIC DFC_CtlMsk.DFC_IntkAirTAirFltDsSRCMax_C "Behaviour control mask / Behaviour control masks of check DFC_IntkAirTAirFltDsSRCMax" VALUE 0x804D94E2 Val_Wu16 65535.00 DFES_OneToOne 0.00 65535.00 FORMAT "%8.2" /end CHARACTERISTIC
/begin CHARACTERISTIC DFC_CtlMsk.DFC_IntkAirTAirFltDsSRCMin_C "Behaviour control mask / Behaviour control masks of check DFC_IntkAirTAirFltDsSRCMin" VALUE 0x804D94E4 Val_Wu16 65535.00 DFES_OneToOne 0.00 65535.00 FORMAT "%8.2" /end CHARACTERISTIC
/begin CHARACTERISTIC DFC_CtlMsk.DFC_IntkAirTAirFltDsSTC_C "Behaviour control mask / Behaviour control masks of check DFC_IntkAirTAirFltDsSTC" VALUE 0x804D94E6 Val_Wu16 65535.00 DFES_OneToOne 0.00 65535.00 FORMAT "%8.2" /end CHARACTERISTIC
/begin CHARACTERISTIC DFC_CtlMsk.DFC_IntkAirTIntkMnfldCrssMax_C "Behaviour control mask / Behaviour control masks of check DFC_IntkAirTIntkMnfldCrssMax" VALUE 0x804D94E8 Val_Wu16 65535.00 DFES_OneToOne 0.00 65535.00 FORMAT "%8.2" /end CHARACTERISTIC
/begin CHARACTERISTIC DFC_CtlMsk.DFC_IntkAirTIntkMnfldCrssMin_C "Behaviour control mask / Behaviour control masks of check DFC_IntkAirTIntkMnfldCrssMin" VALUE 0x804D94EA Val_Wu16 65535.00 DFES_OneToOne 0.00 65535.00 FORMAT "%8.2" /end CHARACTERISTIC
/begin CHARACTERISTIC DFC_CtlMsk.DFC_IntkAirTIntkMnfldHSCMax_C "Behaviour control mask / Behaviour control masks of check DFC_IntkAirTIntkMnfldHSCMax" VALUE 0x804D94EC Val_Wu16 65535.00 DFES_OneToOne 0.00 65535.00 FORMAT "%8.2" /end CHARACTERISTIC
/begin CHARACTERISTIC DFC_CtlMsk.DFC_IntkAirTIntkMnfldImps_C "Behaviour control mask / Behaviour control masks of check DFC_IntkAirTIntkMnfldImps" VALUE 0x804D94EE Val_Wu16 65535.00 DFES_OneToOne 0.00 65535.00 FORMAT "%8.2" /end CHARACTERISTIC
/begin CHARACTERISTIC DFC_CtlMsk.DFC_IntkAirTIntkMnfldPRCMax_C "Behaviour control mask / Behaviour control masks of check DFC_IntkAirTIntkMnfldPRCMax" VALUE 0x804D94F0 Val_Wu16 65535.00 DFES_OneToOne 0.00 65535.00 FORMAT "%8.2" /end CHARACTERISTIC
/begin CHARACTERISTIC DFC_CtlMsk.DFC_IntkAirTIntkMnfldPRCMin_C "Behaviour control mask / Behaviour control masks of check DFC_IntkAirTIntkMnfldPRCMin" VALUE 0x804D94F2 Val_Wu16 65535.00 DFES_OneToOne 0.00 65535.00 FORMAT "%8.2" /end CHARACTERISTIC
/begin CHARACTERISTIC DFC_CtlMsk.DFC_IntkAirTIntkMnfldSRCMax_C "Behaviour control mask / Behaviour control masks of check DFC_IntkAirTIntkMnfldSRCMax" VALUE 0x804D94F4 Val_Wu16 65535.00 DFES_OneToOne 0.00 65535.00 FORMAT "%8.2" /end CHARACTERISTIC
/begin CHARACTERISTIC DFC_CtlMsk.DFC_IntkAirTIntkMnfldSRCMin_C "Behaviour control mask / Behaviour control masks of check DFC_IntkAirTIntkMnfldSRCMin" VALUE 0x804D94F6 Val_Wu16 65535.00 DFES_OneToOne 0.00 65535.00 FORMAT "%8.2" /end CHARACTERISTIC
/begin CHARACTERISTIC DFC_CtlMsk.DFC_IntkAirTIntkMnfldSTC_C "Behaviour control mask / Behaviour control masks of check DFC_IntkAirTIntkMnfldSTC" VALUE 0x804D94F8 Val_Wu16 65535.00 DFES_OneToOne 0.00 65535.00 FORMAT "%8.2" /end CHARACTERISTIC
/begin CHARACTERISTIC DFC_CtlMsk.DFC_KRREGRLMX_C "Behaviour control mask / Behaviour control masks of check DFC_KRREGRLMX" VALUE 0x804D94FA Val_Wu16 65535.00 DFES_OneToOne 0.00 65535.00 FORMAT "%8.2" /end CHARACTERISTIC
/begin CHARACTERISTIC DFC_CtlMsk.DFC_KRVEKOCVLCI_C "Behaviour control mask / Behaviour control masks of check DFC_KRVEKOCVLCI" VALUE 0x804D94FC Val_Wu16 65535.00 DFES_OneToOne 0.00 65535.00 FORMAT "%8.2" /end CHARACTERISTIC
/begin CHARACTERISTIC DFC_CtlMsk.DFC_KRVEKOENCHMT_C "Behaviour control mask / Behaviour control masks of check DFC_KRVEKOENCHMT" VALUE 0x804D94FE Val_Wu16 65535.00 DFES_OneToOne 0.00 65535.00 FORMAT "%8.2" /end CHARACTERISTIC
/begin CHARACTERISTIC DFC_CtlMsk.DFC_KRVEKOENCHMT0_C "Behaviour control mask / Behaviour control masks of check DFC_KRVEKOENCHMT0" VALUE 0x804D9500 Val_Wu16 65535.00 DFES_OneToOne 0.00 65535.00 FORMAT "%8.2" /end CHARACTERISTIC
/begin CHARACTERISTIC DFC_CtlMsk.DFC_KRVEKOENCHMT1_C "Behaviour control mask / Behaviour control masks of check DFC_KRVEKOENCHMT1" VALUE 0x804D9502 Val_Wu16 65535.00 DFES_OneToOne 0.00 65535.00 FORMAT "%8.2" /end CHARACTERISTIC
/begin CHARACTERISTIC DFC_CtlMsk.DFC_KRVEKOENCHMT2_C "Behaviour control mask / Behaviour control masks of check DFC_KRVEKOENCHMT2" VALUE 0x804D9504 Val_Wu16 65535.00 DFES_OneToOne 0.00 65535.00 FORMAT "%8.2" /end CHARACTERISTIC
/begin CHARACTERISTIC DFC_CtlMsk.DFC_KRVEKOENCHMT3_C "Behaviour control mask / Behaviour control masks of check DFC_KRVEKOENCHMT3" VALUE 0x804D9506 Val_Wu16 65535.00 DFES_OneToOne 0.00 65535.00 FORMAT "%8.2" /end CHARACTERISTIC
/begin CHARACTERISTIC DFC_CtlMsk.DFC_KRVEKOENCHMT4_C "Behaviour control mask / Behaviour control masks of check DFC_KRVEKOENCHMT4" VALUE 0x804D9508 Val_Wu16 65535.00 DFES_OneToOne 0.00 65535.00 FORMAT "%8.2" /end CHARACTERISTIC
/begin CHARACTERISTIC DFC_CtlMsk.DFC_KRVEKOENCHMT5_C "Behaviour control mask / Behaviour control masks of check DFC_KRVEKOENCHMT5" VALUE 0x804D950A Val_Wu16 65535.00 DFES_OneToOne 0.00 65535.00 FORMAT "%8.2" /end CHARACTERISTIC
/begin CHARACTERISTIC DFC_CtlMsk.DFC_KRVEKOENCHMT6_C "Behaviour control mask / Behaviour control masks of check DFC_KRVEKOENCHMT6" VALUE 0x804D950C Val_Wu16 65535.00 DFES_OneToOne 0.00 65535.00 FORMAT "%8.2" /end CHARACTERISTIC
/begin CHARACTERISTIC DFC_CtlMsk.DFC_KRVEKOENCHMT7_C "Behaviour control mask / Behaviour control masks of check DFC_KRVEKOENCHMT7" VALUE 0x804D950E Val_Wu16 65535.00 DFES_OneToOne 0.00 65535.00 FORMAT "%8.2" /end CHARACTERISTIC
/begin CHARACTERISTIC DFC_CtlMsk.DFC_KRVEKORLMX_C "Behaviour control mask / Behaviour control masks of check DFC_KRVEKORLMX" VALUE 0x804D9510 Val_Wu16 65535.00 DFES_OneToOne 0.00 65535.00 FORMAT "%8.2" /end CHARACTERISTIC
/begin CHARACTERISTIC DFC_CtlMsk.DFC_KRVEKORLMXL_C "Behaviour control mask / Behaviour control masks of check DFC_KRVEKORLMXL" VALUE 0x804D9512 Val_Wu16 65535.00 DFES_OneToOne 0.00 65535.00 FORMAT "%8.2" /end CHARACTERISTIC
/begin CHARACTERISTIC DFC_CtlMsk.DFC_KS1max_C "Behaviour control mask / Behaviour control masks of check DFC_KS1max" VALUE 0x804D9514 Val_Wu16 65535.00 DFES_OneToOne 0.00 65535.00 FORMAT "%8.2" /end CHARACTERISTIC
/begin CHARACTERISTIC DFC_CtlMsk.DFC_KS1min_C "Behaviour control mask / Behaviour control masks of check DFC_KS1min" VALUE 0x804D9516 Val_Wu16 65535.00 DFES_OneToOne 0.00 65535.00 FORMAT "%8.2" /end CHARACTERISTIC
/begin CHARACTERISTIC DFC_CtlMsk.DFC_LMmax_C "Behaviour control mask / Behaviour control masks of check DFC_LMmax" VALUE 0x804D9518 Val_Wu16 65535.00 DFES_OneToOne 0.00 65535.00 FORMAT "%8.2" /end CHARACTERISTIC
/begin CHARACTERISTIC DFC_CtlMsk.DFC_LZSRnpl_C "Behaviour control mask / Behaviour control masks of check DFC_LZSRnpl" VALUE 0x804D951A Val_Wu16 65535.00 DFES_OneToOne 0.00 65535.00 FORMAT "%8.2" /end CHARACTERISTIC
/begin CHARACTERISTIC DFC_CtlMsk.DFC_LamDynDiagS1B1_C "Behaviour control mask / Behaviour control masks of check DFC_LamDynDiagS1B1" VALUE 0x804D951C Val_Wu16 65535.00 DFES_OneToOne 0.00 65535.00 FORMAT "%8.2" /end CHARACTERISTIC
/begin CHARACTERISTIC DFC_CtlMsk.DFC_LeakIntkMnfldEmiInfl_C "Behaviour control mask / Behaviour control masks of check DFC_LeakIntkMnfldEmiInfl" VALUE 0x804D951E Val_Wu16 65535.00 DFES_OneToOne 0.00 65535.00 FORMAT "%8.2" /end CHARACTERISTIC
/begin CHARACTERISTIC DFC_CtlMsk.DFC_LinFrameErrDCDC_C "Behaviour control mask / Behaviour control masks of check DFC_LinFrameErrDCDC" VALUE 0x804D9520 Val_Wu16 65535.00 DFES_OneToOne 0.00 65535.00 FORMAT "%8.2" /end CHARACTERISTIC
/begin CHARACTERISTIC DFC_CtlMsk.DFC_LinOverrunErrDCDC_C "Behaviour control mask / Behaviour control masks of check DFC_LinOverrunErrDCDC" VALUE 0x804D9522 Val_Wu16 65535.00 DFES_OneToOne 0.00 65535.00 FORMAT "%8.2" /end CHARACTERISTIC
/begin CHARACTERISTIC DFC_CtlMsk.DFC_MD00max_C "Behaviour control mask / Behaviour control masks of check DFC_MD00max" VALUE 0x804D9524 Val_Wu16 65535.00 DFES_OneToOne 0.00 65535.00 FORMAT "%8.2" /end CHARACTERISTIC
/begin CHARACTERISTIC DFC_CtlMsk.DFC_MDBmax_C "Behaviour control mask / Behaviour control masks of check DFC_MDBmax" VALUE 0x804D9526 Val_Wu16 65535.00 DFES_OneToOne 0.00 65535.00 FORMAT "%8.2" /end CHARACTERISTIC
/begin CHARACTERISTIC DFC_CtlMsk.DFC_MDCat_C "Behaviour control mask / Behaviour control masks of check DFC_MDCat" VALUE 0x804D9528 Val_Wu16 65535.00 DFES_OneToOne 0.00 65535.00 FORMAT "%8.2" /end CHARACTERISTIC
/begin CHARACTERISTIC DFC_CtlMsk.DFC_MDCatCrit_C "Behaviour control mask / Behaviour control masks of check DFC_MDCatCrit" VALUE 0x804D952A Val_Wu16 65535.00 DFES_OneToOne 0.00 65535.00 FORMAT "%8.2" /end CHARACTERISTIC
/begin CHARACTERISTIC DFC_CtlMsk.DFC_MDCatCurr_C "Behaviour control mask / Behaviour control masks of check DFC_MDCatCurr" VALUE 0x804D952C Val_Wu16 65535.00 DFES_OneToOne 0.00 65535.00 FORMAT "%8.2" /end CHARACTERISTIC
/begin CHARACTERISTIC DFC_CtlMsk.DFC_MDCyl_0_C "Behaviour control mask / Behaviour control masks of check DFC_MDCyl_0" VALUE 0x804D952E Val_Wu16 65535.00 DFES_OneToOne 0.00 65535.00 FORMAT "%8.2" /end CHARACTERISTIC
/begin CHARACTERISTIC DFC_CtlMsk.DFC_MDCyl_1_C "Behaviour control mask / Behaviour control masks of check DFC_MDCyl_1" VALUE 0x804D9530 Val_Wu16 65535.00 DFES_OneToOne 0.00 65535.00 FORMAT "%8.2" /end CHARACTERISTIC
/begin CHARACTERISTIC DFC_CtlMsk.DFC_MDCyl_2_C "Behaviour control mask / Behaviour control masks of check DFC_MDCyl_2" VALUE 0x804D9532 Val_Wu16 65535.00 DFES_OneToOne 0.00 65535.00 FORMAT "%8.2" /end CHARACTERISTIC
/begin CHARACTERISTIC DFC_CtlMsk.DFC_MDCyl_3_C "Behaviour control mask / Behaviour control masks of check DFC_MDCyl_3" VALUE 0x804D9534 Val_Wu16 65535.00 DFES_OneToOne 0.00 65535.00 FORMAT "%8.2" /end CHARACTERISTIC
/begin CHARACTERISTIC DFC_CtlMsk.DFC_MDEmi_C "Behaviour control mask / Behaviour control masks of check DFC_MDEmi" VALUE 0x804D9536 Val_Wu16 65535.00 DFES_OneToOne 0.00 65535.00 FORMAT "%8.2" /end CHARACTERISTIC
/begin CHARACTERISTIC DFC_CtlMsk.DFC_MDEmiStrt_C "Behaviour control mask / Behaviour control masks of check DFC_MDEmiStrt" VALUE 0x804D9538 Val_Wu16 65535.00 DFES_OneToOne 0.00 65535.00 FORMAT "%8.2" /end CHARACTERISTIC
/begin CHARACTERISTIC DFC_CtlMsk.DFC_MDFco_C "Behaviour control mask / Behaviour control masks of check DFC_MDFco" VALUE 0x804D953A Val_Wu16 65535.00 DFES_OneToOne 0.00 65535.00 FORMAT "%8.2" /end CHARACTERISTIC
/begin CHARACTERISTIC DFC_CtlMsk.DFC_MDMpl_C "Behaviour control mask / Behaviour control masks of check DFC_MDMpl" VALUE 0x804D953C Val_Wu16 65535.00 DFES_OneToOne 0.00 65535.00 FORMAT "%8.2" /end CHARACTERISTIC
/begin CHARACTERISTIC DFC_CtlMsk.DFC_MDSegTiAdpn_C "Behaviour control mask / Behaviour control masks of check DFC_MDSegTiAdpn" VALUE 0x804D953E Val_Wu16 65535.00 DFES_OneToOne 0.00 65535.00 FORMAT "%8.2" /end CHARACTERISTIC
/begin CHARACTERISTIC DFC_CtlMsk.DFC_MDmax_C "Behaviour control mask / Behaviour control masks of check DFC_MDmax" VALUE 0x804D9540 Val_Wu16 65535.00 DFES_OneToOne 0.00 65535.00 FORMAT "%8.2" /end CHARACTERISTIC
/begin CHARACTERISTIC DFC_CtlMsk.DFC_MFuOilMax_C "Behaviour control mask / Behaviour control masks of check DFC_MFuOilMax" VALUE 0x804D9542 Val_Wu16 65535.00 DFES_OneToOne 0.00 65535.00 FORMAT "%8.2" /end CHARACTERISTIC
/begin CHARACTERISTIC DFC_CtlMsk.DFC_MOXEMM_SMU_ALM0_0_C "Behaviour control mask / Behaviour control masks of check DFC_MOXEMM_SMU_ALM0_0" VALUE 0x804D9544 Val_Wu16 65535.00 DFES_OneToOne 0.00 65535.00 FORMAT "%8.2" /end CHARACTERISTIC
/begin CHARACTERISTIC DFC_CtlMsk.DFC_MOXEMM_SMU_ALM0_1_C "Behaviour control mask / Behaviour control masks of check DFC_MOXEMM_SMU_ALM0_1" VALUE 0x804D9546 Val_Wu16 65535.00 DFES_OneToOne 0.00 65535.00 FORMAT "%8.2" /end CHARACTERISTIC
/begin CHARACTERISTIC DFC_CtlMsk.DFC_MOXEMM_SMU_ALM0_10_C "Behaviour control mask / Behaviour control masks of check DFC_MOXEMM_SMU_ALM0_10" VALUE 0x804D9548 Val_Wu16 65535.00 DFES_OneToOne 0.00 65535.00 FORMAT "%8.2" /end CHARACTERISTIC
/begin CHARACTERISTIC DFC_CtlMsk.DFC_MOXEMM_SMU_ALM0_11_C "Behaviour control mask / Behaviour control masks of check DFC_MOXEMM_SMU_ALM0_11" VALUE 0x804D954A Val_Wu16 65535.00 DFES_OneToOne 0.00 65535.00 FORMAT "%8.2" /end CHARACTERISTIC
/begin CHARACTERISTIC DFC_CtlMsk.DFC_MOXEMM_SMU_ALM0_13_C "Behaviour control mask / Behaviour control masks of check DFC_MOXEMM_SMU_ALM0_13" VALUE 0x804D954C Val_Wu16 65535.00 DFES_OneToOne 0.00 65535.00 FORMAT "%8.2" /end CHARACTERISTIC
/begin CHARACTERISTIC DFC_CtlMsk.DFC_MOXEMM_SMU_ALM0_14_C "Behaviour control mask / Behaviour control masks of check DFC_MOXEMM_SMU_ALM0_14" VALUE 0x804D954E Val_Wu16 65535.00 DFES_OneToOne 0.00 65535.00 FORMAT "%8.2" /end CHARACTERISTIC
/begin CHARACTERISTIC DFC_CtlMsk.DFC_MOXEMM_SMU_ALM0_2_C "Behaviour control mask / Behaviour control masks of check DFC_MOXEMM_SMU_ALM0_2" VALUE 0x804D9550 Val_Wu16 65535.00 DFES_OneToOne 0.00 65535.00 FORMAT "%8.2" /end CHARACTERISTIC
/begin CHARACTERISTIC DFC_CtlMsk.DFC_MOXEMM_SMU_ALM0_22_C "Behaviour control mask / Behaviour control masks of check DFC_MOXEMM_SMU_ALM0_22" VALUE 0x804D9552 Val_Wu16 65535.00 DFES_OneToOne 0.00 65535.00 FORMAT "%8.2" /end CHARACTERISTIC
/begin CHARACTERISTIC DFC_CtlMsk.DFC_MOXEMM_SMU_ALM0_23_C "Behaviour control mask / Behaviour control masks of check DFC_MOXEMM_SMU_ALM0_23" VALUE 0x804D9554 Val_Wu16 65535.00 DFES_OneToOne 0.00 65535.00 FORMAT "%8.2" /end CHARACTERISTIC
/begin CHARACTERISTIC DFC_CtlMsk.DFC_MOXEMM_SMU_ALM0_4_C "Behaviour control mask / Behaviour control masks of check DFC_MOXEMM_SMU_ALM0_4" VALUE 0x804D9556 Val_Wu16 65535.00 DFES_OneToOne 0.00 65535.00 FORMAT "%8.2" /end CHARACTERISTIC
/begin CHARACTERISTIC DFC_CtlMsk.DFC_MOXEMM_SMU_ALM0_5_C "Behaviour control mask / Behaviour control masks of check DFC_MOXEMM_SMU_ALM0_5" VALUE 0x804D9558 Val_Wu16 65535.00 DFES_OneToOne 0.00 65535.00 FORMAT "%8.2" /end CHARACTERISTIC
/begin CHARACTERISTIC DFC_CtlMsk.DFC_MOXEMM_SMU_ALM0_7_C "Behaviour control mask / Behaviour control masks of check DFC_MOXEMM_SMU_ALM0_7" VALUE 0x804D955A Val_Wu16 65535.00 DFES_OneToOne 0.00 65535.00 FORMAT "%8.2" /end CHARACTERISTIC
/begin CHARACTERISTIC DFC_CtlMsk.DFC_MOXEMM_SMU_ALM0_8_C "Behaviour control mask / Behaviour control masks of check DFC_MOXEMM_SMU_ALM0_8" VALUE 0x804D955C Val_Wu16 65535.00 DFES_OneToOne 0.00 65535.00 FORMAT "%8.2" /end CHARACTERISTIC
/begin CHARACTERISTIC DFC_CtlMsk.DFC_MOXEMM_SMU_ALM10_16_C "Behaviour control mask / Behaviour control masks of check DFC_MOXEMM_SMU_ALM10_16" VALUE 0x804D955E Val_Wu16 65535.00 DFES_OneToOne 0.00 65535.00 FORMAT "%8.2" /end CHARACTERISTIC
/begin CHARACTERISTIC DFC_CtlMsk.DFC_MOXEMM_SMU_ALM10_17_C "Behaviour control mask / Behaviour control masks of check DFC_MOXEMM_SMU_ALM10_17" VALUE 0x804D9560 Val_Wu16 65535.00 DFES_OneToOne 0.00 65535.00 FORMAT "%8.2" /end CHARACTERISTIC
/begin CHARACTERISTIC DFC_CtlMsk.DFC_MOXEMM_SMU_ALM10_21_C "Behaviour control mask / Behaviour control masks of check DFC_MOXEMM_SMU_ALM10_21" VALUE 0x804D9562 Val_Wu16 65535.00 DFES_OneToOne 0.00 65535.00 FORMAT "%8.2" /end CHARACTERISTIC
/begin CHARACTERISTIC DFC_CtlMsk.DFC_MOXEMM_SMU_ALM11_0_C "Behaviour control mask / Behaviour control masks of check DFC_MOXEMM_SMU_ALM11_0" VALUE 0x804D9564 Val_Wu16 65535.00 DFES_OneToOne 0.00 65535.00 FORMAT "%8.2" /end CHARACTERISTIC
/begin CHARACTERISTIC DFC_CtlMsk.DFC_MOXEMM_SMU_ALM11_1_C "Behaviour control mask / Behaviour control masks of check DFC_MOXEMM_SMU_ALM11_1" VALUE 0x804D9566 Val_Wu16 65535.00 DFES_OneToOne 0.00 65535.00 FORMAT "%8.2" /end CHARACTERISTIC
/begin CHARACTERISTIC DFC_CtlMsk.DFC_MOXEMM_SMU_ALM11_2_C "Behaviour control mask / Behaviour control masks of check DFC_MOXEMM_SMU_ALM11_2" VALUE 0x804D9568 Val_Wu16 65535.00 DFES_OneToOne 0.00 65535.00 FORMAT "%8.2" /end CHARACTERISTIC
/begin CHARACTERISTIC DFC_CtlMsk.DFC_MOXEMM_SMU_ALM11_3_C "Behaviour control mask / Behaviour control masks of check DFC_MOXEMM_SMU_ALM11_3" VALUE 0x804D956A Val_Wu16 65535.00 DFES_OneToOne 0.00 65535.00 FORMAT "%8.2" /end CHARACTERISTIC
/begin CHARACTERISTIC DFC_CtlMsk.DFC_MOXEMM_SMU_ALM11_4_C "Behaviour control mask / Behaviour control masks of check DFC_MOXEMM_SMU_ALM11_4" VALUE 0x804D956C Val_Wu16 65535.00 DFES_OneToOne 0.00 65535.00 FORMAT "%8.2" /end CHARACTERISTIC
/begin CHARACTERISTIC DFC_CtlMsk.DFC_MOXEMM_SMU_ALM11_5_C "Behaviour control mask / Behaviour control masks of check DFC_MOXEMM_SMU_ALM11_5" VALUE 0x804D956E Val_Wu16 65535.00 DFES_OneToOne 0.00 65535.00 FORMAT "%8.2" /end CHARACTERISTIC
/begin CHARACTERISTIC DFC_CtlMsk.DFC_MOXEMM_SMU_ALM11_8_C "Behaviour control mask / Behaviour control masks of check DFC_MOXEMM_SMU_ALM11_8" VALUE 0x804D9570 Val_Wu16 65535.00 DFES_OneToOne 0.00 65535.00 FORMAT "%8.2" /end CHARACTERISTIC
/begin CHARACTERISTIC DFC_CtlMsk.DFC_MOXEMM_SMU_ALM11_9_C "Behaviour control mask / Behaviour control masks of check DFC_MOXEMM_SMU_ALM11_9" VALUE 0x804D9572 Val_Wu16 65535.00 DFES_OneToOne 0.00 65535.00 FORMAT "%8.2" /end CHARACTERISTIC
/begin CHARACTERISTIC DFC_CtlMsk.DFC_MOXEMM_SMU_ALM1_0_C "Behaviour control mask / Behaviour control masks of check DFC_MOXEMM_SMU_ALM1_0" VALUE 0x804D9574 Val_Wu16 65535.00 DFES_OneToOne 0.00 65535.00 FORMAT "%8.2" /end CHARACTERISTIC
/begin CHARACTERISTIC DFC_CtlMsk.DFC_MOXEMM_SMU_ALM1_1_C "Behaviour control mask / Behaviour control masks of check DFC_MOXEMM_SMU_ALM1_1" VALUE 0x804D9576 Val_Wu16 65535.00 DFES_OneToOne 0.00 65535.00 FORMAT "%8.2" /end CHARACTERISTIC
/begin CHARACTERISTIC DFC_CtlMsk.DFC_MOXEMM_SMU_ALM1_10_C "Behaviour control mask / Behaviour control masks of check DFC_MOXEMM_SMU_ALM1_10" VALUE 0x804D9578 Val_Wu16 65535.00 DFES_OneToOne 0.00 65535.00 FORMAT "%8.2" /end CHARACTERISTIC
/begin CHARACTERISTIC DFC_CtlMsk.DFC_MOXEMM_SMU_ALM1_11_C "Behaviour control mask / Behaviour control masks of check DFC_MOXEMM_SMU_ALM1_11" VALUE 0x804D957A Val_Wu16 65535.00 DFES_OneToOne 0.00 65535.00 FORMAT "%8.2" /end CHARACTERISTIC
/begin CHARACTERISTIC DFC_CtlMsk.DFC_MOXEMM_SMU_ALM1_13_C "Behaviour control mask / Behaviour control masks of check DFC_MOXEMM_SMU_ALM1_13" VALUE 0x804D957C Val_Wu16 65535.00 DFES_OneToOne 0.00 65535.00 FORMAT "%8.2" /end CHARACTERISTIC
/begin CHARACTERISTIC DFC_CtlMsk.DFC_MOXEMM_SMU_ALM1_14_C "Behaviour control mask / Behaviour control masks of check DFC_MOXEMM_SMU_ALM1_14" VALUE 0x804D957E Val_Wu16 65535.00 DFES_OneToOne 0.00 65535.00 FORMAT "%8.2" /end CHARACTERISTIC
/begin CHARACTERISTIC DFC_CtlMsk.DFC_MOXEMM_SMU_ALM1_2_C "Behaviour control mask / Behaviour control masks of check DFC_MOXEMM_SMU_ALM1_2" VALUE 0x804D9580 Val_Wu16 65535.00 DFES_OneToOne 0.00 65535.00 FORMAT "%8.2" /end CHARACTERISTIC
/begin CHARACTERISTIC DFC_CtlMsk.DFC_MOXEMM_SMU_ALM1_22_C "Behaviour control mask / Behaviour control masks of check DFC_MOXEMM_SMU_ALM1_22" VALUE 0x804D9582 Val_Wu16 65535.00 DFES_OneToOne 0.00 65535.00 FORMAT "%8.2" /end CHARACTERISTIC
/begin CHARACTERISTIC DFC_CtlMsk.DFC_MOXEMM_SMU_ALM1_23_C "Behaviour control mask / Behaviour control masks of check DFC_MOXEMM_SMU_ALM1_23" VALUE 0x804D9584 Val_Wu16 65535.00 DFES_OneToOne 0.00 65535.00 FORMAT "%8.2" /end CHARACTERISTIC
/begin CHARACTERISTIC DFC_CtlMsk.DFC_MOXEMM_SMU_ALM1_4_C "Behaviour control mask / Behaviour control masks of check DFC_MOXEMM_SMU_ALM1_4" VALUE 0x804D9586 Val_Wu16 65535.00 DFES_OneToOne 0.00 65535.00 FORMAT "%8.2" /end CHARACTERISTIC
/begin CHARACTERISTIC DFC_CtlMsk.DFC_MOXEMM_SMU_ALM1_5_C "Behaviour control mask / Behaviour control masks of check DFC_MOXEMM_SMU_ALM1_5" VALUE 0x804D9588 Val_Wu16 65535.00 DFES_OneToOne 0.00 65535.00 FORMAT "%8.2" /end CHARACTERISTIC
/begin CHARACTERISTIC DFC_CtlMsk.DFC_MOXEMM_SMU_ALM1_7_C "Behaviour control mask / Behaviour control masks of check DFC_MOXEMM_SMU_ALM1_7" VALUE 0x804D958A Val_Wu16 65535.00 DFES_OneToOne 0.00 65535.00 FORMAT "%8.2" /end CHARACTERISTIC
/begin CHARACTERISTIC DFC_CtlMsk.DFC_MOXEMM_SMU_ALM1_8_C "Behaviour control mask / Behaviour control masks of check DFC_MOXEMM_SMU_ALM1_8" VALUE 0x804D958C Val_Wu16 65535.00 DFES_OneToOne 0.00 65535.00 FORMAT "%8.2" /end CHARACTERISTIC
/begin CHARACTERISTIC DFC_CtlMsk.DFC_MOXEMM_SMU_ALM21_0_C "Behaviour control mask / Behaviour control masks of check DFC_MOXEMM_SMU_ALM21_0" VALUE 0x804D958E Val_Wu16 65535.00 DFES_OneToOne 0.00 65535.00 FORMAT "%8.2" /end CHARACTERISTIC
/begin CHARACTERISTIC DFC_CtlMsk.DFC_MOXEMM_SMU_ALM21_16_C "Behaviour control mask / Behaviour control masks of check DFC_MOXEMM_SMU_ALM21_16" VALUE 0x804D9590 Val_Wu16 65535.00 DFES_OneToOne 0.00 65535.00 FORMAT "%8.2" /end CHARACTERISTIC
/begin CHARACTERISTIC DFC_CtlMsk.DFC_MOXEMM_SMU_ALM21_3_C "Behaviour control mask / Behaviour control masks of check DFC_MOXEMM_SMU_ALM21_3" VALUE 0x804D9592 Val_Wu16 65535.00 DFES_OneToOne 0.00 65535.00 FORMAT "%8.2" /end CHARACTERISTIC
/begin CHARACTERISTIC DFC_CtlMsk.DFC_MOXEMM_SMU_ALM2_1_C "Behaviour control mask / Behaviour control masks of check DFC_MOXEMM_SMU_ALM2_1" VALUE 0x804D9594 Val_Wu16 65535.00 DFES_OneToOne 0.00 65535.00 FORMAT "%8.2" /end CHARACTERISTIC
/begin CHARACTERISTIC DFC_CtlMsk.DFC_MOXEMM_SMU_ALM2_10_C "Behaviour control mask / Behaviour control masks of check DFC_MOXEMM_SMU_ALM2_10" VALUE 0x804D9596 Val_Wu16 65535.00 DFES_OneToOne 0.00 65535.00 FORMAT "%8.2" /end CHARACTERISTIC
/begin CHARACTERISTIC DFC_CtlMsk.DFC_MOXEMM_SMU_ALM2_11_C "Behaviour control mask / Behaviour control masks of check DFC_MOXEMM_SMU_ALM2_11" VALUE 0x804D9598 Val_Wu16 65535.00 DFES_OneToOne 0.00 65535.00 FORMAT "%8.2" /end CHARACTERISTIC
/begin CHARACTERISTIC DFC_CtlMsk.DFC_MOXEMM_SMU_ALM2_13_C "Behaviour control mask / Behaviour control masks of check DFC_MOXEMM_SMU_ALM2_13" VALUE 0x804D959A Val_Wu16 65535.00 DFES_OneToOne 0.00 65535.00 FORMAT "%8.2" /end CHARACTERISTIC
/begin CHARACTERISTIC DFC_CtlMsk.DFC_MOXEMM_SMU_ALM2_14_C "Behaviour control mask / Behaviour control masks of check DFC_MOXEMM_SMU_ALM2_14" VALUE 0x804D959C Val_Wu16 65535.00 DFES_OneToOne 0.00 65535.00 FORMAT "%8.2" /end CHARACTERISTIC
/begin CHARACTERISTIC DFC_CtlMsk.DFC_MOXEMM_SMU_ALM2_22_C "Behaviour control mask / Behaviour control masks of check DFC_MOXEMM_SMU_ALM2_22" VALUE 0x804D959E Val_Wu16 65535.00 DFES_OneToOne 0.00 65535.00 FORMAT "%8.2" /end CHARACTERISTIC
/begin CHARACTERISTIC DFC_CtlMsk.DFC_MOXEMM_SMU_ALM2_23_C "Behaviour control mask / Behaviour control masks of check DFC_MOXEMM_SMU_ALM2_23" VALUE 0x804D95A0 Val_Wu16 65535.00 DFES_OneToOne 0.00 65535.00 FORMAT "%8.2" /end CHARACTERISTIC
/begin CHARACTERISTIC DFC_CtlMsk.DFC_MOXEMM_SMU_ALM2_4_C "Behaviour control mask / Behaviour control masks of check DFC_MOXEMM_SMU_ALM2_4" VALUE 0x804D95A2 Val_Wu16 65535.00 DFES_OneToOne 0.00 65535.00 FORMAT "%8.2" /end CHARACTERISTIC
/begin CHARACTERISTIC DFC_CtlMsk.DFC_MOXEMM_SMU_ALM2_5_C "Behaviour control mask / Behaviour control masks of check DFC_MOXEMM_SMU_ALM2_5" VALUE 0x804D95A4 Val_Wu16 65535.00 DFES_OneToOne 0.00 65535.00 FORMAT "%8.2" /end CHARACTERISTIC
/begin CHARACTERISTIC DFC_CtlMsk.DFC_MOXEMM_SMU_ALM2_7_C "Behaviour control mask / Behaviour control masks of check DFC_MOXEMM_SMU_ALM2_7" VALUE 0x804D95A6 Val_Wu16 65535.00 DFES_OneToOne 0.00 65535.00 FORMAT "%8.2" /end CHARACTERISTIC
/begin CHARACTERISTIC DFC_CtlMsk.DFC_MOXEMM_SMU_ALM2_8_C "Behaviour control mask / Behaviour control masks of check DFC_MOXEMM_SMU_ALM2_8" VALUE 0x804D95A8 Val_Wu16 65535.00 DFES_OneToOne 0.00 65535.00 FORMAT "%8.2" /end CHARACTERISTIC
/begin CHARACTERISTIC DFC_CtlMsk.DFC_MOXEMM_SMU_ALM6_0_C "Behaviour control mask / Behaviour control masks of check DFC_MOXEMM_SMU_ALM6_0" VALUE 0x804D95AA Val_Wu16 65535.00 DFES_OneToOne 0.00 65535.00 FORMAT "%8.2" /end CHARACTERISTIC
/begin CHARACTERISTIC DFC_CtlMsk.DFC_MOXEMM_SMU_ALM6_11_C "Behaviour control mask / Behaviour control masks of check DFC_MOXEMM_SMU_ALM6_11" VALUE 0x804D95AC Val_Wu16 65535.00 DFES_OneToOne 0.00 65535.00 FORMAT "%8.2" /end CHARACTERISTIC
/begin CHARACTERISTIC DFC_CtlMsk.DFC_MOXEMM_SMU_ALM6_12_C "Behaviour control mask / Behaviour control masks of check DFC_MOXEMM_SMU_ALM6_12" VALUE 0x804D95AE Val_Wu16 65535.00 DFES_OneToOne 0.00 65535.00 FORMAT "%8.2" /end CHARACTERISTIC
/begin CHARACTERISTIC DFC_CtlMsk.DFC_MOXEMM_SMU_ALM6_14_C "Behaviour control mask / Behaviour control masks of check DFC_MOXEMM_SMU_ALM6_14" VALUE 0x804D95B0 Val_Wu16 65535.00 DFES_OneToOne 0.00 65535.00 FORMAT "%8.2" /end CHARACTERISTIC
/begin CHARACTERISTIC DFC_CtlMsk.DFC_MOXEMM_SMU_ALM6_15_C "Behaviour control mask / Behaviour control masks of check DFC_MOXEMM_SMU_ALM6_15" VALUE 0x804D95B2 Val_Wu16 65535.00 DFES_OneToOne 0.00 65535.00 FORMAT "%8.2" /end CHARACTERISTIC
/begin CHARACTERISTIC DFC_CtlMsk.DFC_MOXEMM_SMU_ALM6_17_C "Behaviour control mask / Behaviour control masks of check DFC_MOXEMM_SMU_ALM6_17" VALUE 0x804D95B4 Val_Wu16 65535.00 DFES_OneToOne 0.00 65535.00 FORMAT "%8.2" /end CHARACTERISTIC
/begin CHARACTERISTIC DFC_CtlMsk.DFC_MOXEMM_SMU_ALM6_18_C "Behaviour control mask / Behaviour control masks of check DFC_MOXEMM_SMU_ALM6_18" VALUE 0x804D95B6 Val_Wu16 65535.00 DFES_OneToOne 0.00 65535.00 FORMAT "%8.2" /end CHARACTERISTIC
/begin CHARACTERISTIC DFC_CtlMsk.DFC_MOXEMM_SMU_ALM6_20_C "Behaviour control mask / Behaviour control masks of check DFC_MOXEMM_SMU_ALM6_20" VALUE 0x804D95B8 Val_Wu16 65535.00 DFES_OneToOne 0.00 65535.00 FORMAT "%8.2" /end CHARACTERISTIC
/begin CHARACTERISTIC DFC_CtlMsk.DFC_MOXEMM_SMU_ALM6_21_C "Behaviour control mask / Behaviour control masks of check DFC_MOXEMM_SMU_ALM6_21" VALUE 0x804D95BA Val_Wu16 65535.00 DFES_OneToOne 0.00 65535.00 FORMAT "%8.2" /end CHARACTERISTIC
/begin CHARACTERISTIC DFC_CtlMsk.DFC_MOXEMM_SMU_ALM6_25_C "Behaviour control mask / Behaviour control masks of check DFC_MOXEMM_SMU_ALM6_25" VALUE 0x804D95BC Val_Wu16 65535.00 DFES_OneToOne 0.00 65535.00 FORMAT "%8.2" /end CHARACTERISTIC
/begin CHARACTERISTIC DFC_CtlMsk.DFC_MOXEMM_SMU_ALM6_4_C "Behaviour control mask / Behaviour control masks of check DFC_MOXEMM_SMU_ALM6_4" VALUE 0x804D95BE Val_Wu16 65535.00 DFES_OneToOne 0.00 65535.00 FORMAT "%8.2" /end CHARACTERISTIC
/begin CHARACTERISTIC DFC_CtlMsk.DFC_MOXEMM_SMU_ALM6_5_C "Behaviour control mask / Behaviour control masks of check DFC_MOXEMM_SMU_ALM6_5" VALUE 0x804D95C0 Val_Wu16 65535.00 DFES_OneToOne 0.00 65535.00 FORMAT "%8.2" /end CHARACTERISTIC
/begin CHARACTERISTIC DFC_CtlMsk.DFC_MOXEMM_SMU_ALM6_7_C "Behaviour control mask / Behaviour control masks of check DFC_MOXEMM_SMU_ALM6_7" VALUE 0x804D95C2 Val_Wu16 65535.00 DFES_OneToOne 0.00 65535.00 FORMAT "%8.2" /end CHARACTERISTIC
/begin CHARACTERISTIC DFC_CtlMsk.DFC_MOXEMM_SMU_ALM6_8_C "Behaviour control mask / Behaviour control masks of check DFC_MOXEMM_SMU_ALM6_8" VALUE 0x804D95C4 Val_Wu16 65535.00 DFES_OneToOne 0.00 65535.00 FORMAT "%8.2" /end CHARACTERISTIC
/begin CHARACTERISTIC DFC_CtlMsk.DFC_MOXEMM_SMU_ALM7_1_C "Behaviour control mask / Behaviour control masks of check DFC_MOXEMM_SMU_ALM7_1" VALUE 0x804D95C6 Val_Wu16 65535.00 DFES_OneToOne 0.00 65535.00 FORMAT "%8.2" /end CHARACTERISTIC
/begin CHARACTERISTIC DFC_CtlMsk.DFC_MOXEMM_SMU_ALM7_12_C "Behaviour control mask / Behaviour control masks of check DFC_MOXEMM_SMU_ALM7_12" VALUE 0x804D95C8 Val_Wu16 65535.00 DFES_OneToOne 0.00 65535.00 FORMAT "%8.2" /end CHARACTERISTIC
/begin CHARACTERISTIC DFC_CtlMsk.DFC_MOXEMM_SMU_ALM7_13_C "Behaviour control mask / Behaviour control masks of check DFC_MOXEMM_SMU_ALM7_13" VALUE 0x804D95CA Val_Wu16 65535.00 DFES_OneToOne 0.00 65535.00 FORMAT "%8.2" /end CHARACTERISTIC
/begin CHARACTERISTIC DFC_CtlMsk.DFC_MOXEMM_SMU_ALM7_14_C "Behaviour control mask / Behaviour control masks of check DFC_MOXEMM_SMU_ALM7_14" VALUE 0x804D95CC Val_Wu16 65535.00 DFES_OneToOne 0.00 65535.00 FORMAT "%8.2" /end CHARACTERISTIC
/begin CHARACTERISTIC DFC_CtlMsk.DFC_MOXEMM_SMU_ALM7_15_C "Behaviour control mask / Behaviour control masks of check DFC_MOXEMM_SMU_ALM7_15" VALUE 0x804D95CE Val_Wu16 65535.00 DFES_OneToOne 0.00 65535.00 FORMAT "%8.2" /end CHARACTERISTIC
/begin CHARACTERISTIC DFC_CtlMsk.DFC_MOXEMM_SMU_ALM7_16_C "Behaviour control mask / Behaviour control masks of check DFC_MOXEMM_SMU_ALM7_16" VALUE 0x804D95D0 Val_Wu16 65535.00 DFES_OneToOne 0.00 65535.00 FORMAT "%8.2" /end CHARACTERISTIC
/begin CHARACTERISTIC DFC_CtlMsk.DFC_MOXEMM_SMU_ALM7_17_C "Behaviour control mask / Behaviour control masks of check DFC_MOXEMM_SMU_ALM7_17" VALUE 0x804D95D2 Val_Wu16 65535.00 DFES_OneToOne 0.00 65535.00 FORMAT "%8.2" /end CHARACTERISTIC
/begin CHARACTERISTIC DFC_CtlMsk.DFC_MOXEMM_SMU_ALM7_2_C "Behaviour control mask / Behaviour control masks of check DFC_MOXEMM_SMU_ALM7_2" VALUE 0x804D95D4 Val_Wu16 65535.00 DFES_OneToOne 0.00 65535.00 FORMAT "%8.2" /end CHARACTERISTIC
/begin CHARACTERISTIC DFC_CtlMsk.DFC_MOXEMM_SMU_ALM7_20_C "Behaviour control mask / Behaviour control masks of check DFC_MOXEMM_SMU_ALM7_20" VALUE 0x804D95D6 Val_Wu16 65535.00 DFES_OneToOne 0.00 65535.00 FORMAT "%8.2" /end CHARACTERISTIC
/begin CHARACTERISTIC DFC_CtlMsk.DFC_MOXEMM_SMU_ALM7_25_C "Behaviour control mask / Behaviour control masks of check DFC_MOXEMM_SMU_ALM7_25" VALUE 0x804D95D8 Val_Wu16 65535.00 DFES_OneToOne 0.00 65535.00 FORMAT "%8.2" /end CHARACTERISTIC
/begin CHARACTERISTIC DFC_CtlMsk.DFC_MOXEMM_SMU_ALM7_26_C "Behaviour control mask / Behaviour control masks of check DFC_MOXEMM_SMU_ALM7_26" VALUE 0x804D95DA Val_Wu16 65535.00 DFES_OneToOne 0.00 65535.00 FORMAT "%8.2" /end CHARACTERISTIC
/begin CHARACTERISTIC DFC_CtlMsk.DFC_MOXEMM_SMU_ALM7_28_C "Behaviour control mask / Behaviour control masks of check DFC_MOXEMM_SMU_ALM7_28" VALUE 0x804D95DC Val_Wu16 65535.00 DFES_OneToOne 0.00 65535.00 FORMAT "%8.2" /end CHARACTERISTIC
/begin CHARACTERISTIC DFC_CtlMsk.DFC_MOXEMM_SMU_ALM7_29_C "Behaviour control mask / Behaviour control masks of check DFC_MOXEMM_SMU_ALM7_29" VALUE 0x804D95DE Val_Wu16 65535.00 DFES_OneToOne 0.00 65535.00 FORMAT "%8.2" /end CHARACTERISTIC
/begin CHARACTERISTIC DFC_CtlMsk.DFC_MOXEMM_SMU_ALM7_30_C "Behaviour control mask / Behaviour control masks of check DFC_MOXEMM_SMU_ALM7_30" VALUE 0x804D95E0 Val_Wu16 65535.00 DFES_OneToOne 0.00 65535.00 FORMAT "%8.2" /end CHARACTERISTIC
/begin CHARACTERISTIC DFC_CtlMsk.DFC_MOXEMM_SMU_ALM7_31_C "Behaviour control mask / Behaviour control masks of check DFC_MOXEMM_SMU_ALM7_31" VALUE 0x804D95E2 Val_Wu16 65535.00 DFES_OneToOne 0.00 65535.00 FORMAT "%8.2" /end CHARACTERISTIC
/begin CHARACTERISTIC DFC_CtlMsk.DFC_MOXEMM_SMU_ALM8_0_C "Behaviour control mask / Behaviour control masks of check DFC_MOXEMM_SMU_ALM8_0" VALUE 0x804D95E4 Val_Wu16 65535.00 DFES_OneToOne 0.00 65535.00 FORMAT "%8.2" /end CHARACTERISTIC
/begin CHARACTERISTIC DFC_CtlMsk.DFC_MOXEMM_SMU_ALM8_1_C "Behaviour control mask / Behaviour control masks of check DFC_MOXEMM_SMU_ALM8_1" VALUE 0x804D95E6 Val_Wu16 65535.00 DFES_OneToOne 0.00 65535.00 FORMAT "%8.2" /end CHARACTERISTIC
/begin CHARACTERISTIC DFC_CtlMsk.DFC_MOXEMM_SMU_ALM8_10_C "Behaviour control mask / Behaviour control masks of check DFC_MOXEMM_SMU_ALM8_10" VALUE 0x804D95E8 Val_Wu16 65535.00 DFES_OneToOne 0.00 65535.00 FORMAT "%8.2" /end CHARACTERISTIC
/begin CHARACTERISTIC DFC_CtlMsk.DFC_MOXEMM_SMU_ALM8_11_C "Behaviour control mask / Behaviour control masks of check DFC_MOXEMM_SMU_ALM8_11" VALUE 0x804D95EA Val_Wu16 65535.00 DFES_OneToOne 0.00 65535.00 FORMAT "%8.2" /end CHARACTERISTIC
/begin CHARACTERISTIC DFC_CtlMsk.DFC_MOXEMM_SMU_ALM8_12_C "Behaviour control mask / Behaviour control masks of check DFC_MOXEMM_SMU_ALM8_12" VALUE 0x804D95EC Val_Wu16 65535.00 DFES_OneToOne 0.00 65535.00 FORMAT "%8.2" /end CHARACTERISTIC
/begin CHARACTERISTIC DFC_CtlMsk.DFC_MOXEMM_SMU_ALM8_16_C "Behaviour control mask / Behaviour control masks of check DFC_MOXEMM_SMU_ALM8_16" VALUE 0x804D95EE Val_Wu16 65535.00 DFES_OneToOne 0.00 65535.00 FORMAT "%8.2" /end CHARACTERISTIC
/begin CHARACTERISTIC DFC_CtlMsk.DFC_MOXEMM_SMU_ALM8_18_C "Behaviour control mask / Behaviour control masks of check DFC_MOXEMM_SMU_ALM8_18" VALUE 0x804D95F0 Val_Wu16 65535.00 DFES_OneToOne 0.00 65535.00 FORMAT "%8.2" /end CHARACTERISTIC
/begin CHARACTERISTIC DFC_CtlMsk.DFC_MOXEMM_SMU_ALM8_2_C "Behaviour control mask / Behaviour control masks of check DFC_MOXEMM_SMU_ALM8_2" VALUE 0x804D95F2 Val_Wu16 65535.00 DFES_OneToOne 0.00 65535.00 FORMAT "%8.2" /end CHARACTERISTIC
/begin CHARACTERISTIC DFC_CtlMsk.DFC_MOXEMM_SMU_ALM8_3_C "Behaviour control mask / Behaviour control masks of check DFC_MOXEMM_SMU_ALM8_3" VALUE 0x804D95F4 Val_Wu16 65535.00 DFES_OneToOne 0.00 65535.00 FORMAT "%8.2" /end CHARACTERISTIC
/begin CHARACTERISTIC DFC_CtlMsk.DFC_MOXEMM_SMU_ALM8_31_C "Behaviour control mask / Behaviour control masks of check DFC_MOXEMM_SMU_ALM8_31" VALUE 0x804D95F6 Val_Wu16 65535.00 DFES_OneToOne 0.00 65535.00 FORMAT "%8.2" /end CHARACTERISTIC
/begin CHARACTERISTIC DFC_CtlMsk.DFC_MOXEMM_SMU_ALM8_4_C "Behaviour control mask / Behaviour control masks of check DFC_MOXEMM_SMU_ALM8_4" VALUE 0x804D95F8 Val_Wu16 65535.00 DFES_OneToOne 0.00 65535.00 FORMAT "%8.2" /end CHARACTERISTIC
/begin CHARACTERISTIC DFC_CtlMsk.DFC_MOXEMM_SMU_ALM9_0_C "Behaviour control mask / Behaviour control masks of check DFC_MOXEMM_SMU_ALM9_0" VALUE 0x804D95FA Val_Wu16 65535.00 DFES_OneToOne 0.00 65535.00 FORMAT "%8.2" /end CHARACTERISTIC
/begin CHARACTERISTIC DFC_CtlMsk.DFC_MOXEMM_SMU_ALM9_15_C "Behaviour control mask / Behaviour control masks of check DFC_MOXEMM_SMU_ALM9_15" VALUE 0x804D95FC Val_Wu16 65535.00 DFES_OneToOne 0.00 65535.00 FORMAT "%8.2" /end CHARACTERISTIC
/begin CHARACTERISTIC DFC_CtlMsk.DFC_MOXEMM_SMU_ALM9_3_C "Behaviour control mask / Behaviour control masks of check DFC_MOXEMM_SMU_ALM9_3" VALUE 0x804D95FE Val_Wu16 65535.00 DFES_OneToOne 0.00 65535.00 FORMAT "%8.2" /end CHARACTERISTIC
/begin CHARACTERISTIC DFC_CtlMsk.DFC_MoCADCNTP_C "Behaviour control mask / Behaviour control masks of check DFC_MoCADCNTP" VALUE 0x804D9600 Val_Wu16 65535.00 DFES_OneToOne 0.00 65535.00 FORMAT "%8.2" /end CHARACTERISTIC
/begin CHARACTERISTIC DFC_CtlMsk.DFC_MoCADCTst_C "Behaviour control mask / Behaviour control masks of check DFC_MoCADCTst" VALUE 0x804D9602 Val_Wu16 65535.00 DFES_OneToOne 0.00 65535.00 FORMAT "%8.2" /end CHARACTERISTIC
/begin CHARACTERISTIC DFC_CtlMsk.DFC_MoCSOPICO_C "Behaviour control mask / Behaviour control masks of check DFC_MoCSOPICO" VALUE 0x804D9604 Val_Wu16 65535.00 DFES_OneToOne 0.00 65535.00 FORMAT "%8.2" /end CHARACTERISTIC
/begin CHARACTERISTIC DFC_CtlMsk.DFC_MoFAPP_C "Behaviour control mask / Behaviour control masks of check DFC_MoFAPP" VALUE 0x804D9606 Val_Wu16 65535.00 DFES_OneToOne 0.00 65535.00 FORMAT "%8.2" /end CHARACTERISTIC
/begin CHARACTERISTIC DFC_CtlMsk.DFC_MoFAirFilgPrdc_C "Behaviour control mask / Behaviour control masks of check DFC_MoFAirFilgPrdc" VALUE 0x804D9608 Val_Wu16 65535.00 DFES_OneToOne 0.00 65535.00 FORMAT "%8.2" /end CHARACTERISTIC
/begin CHARACTERISTIC DFC_CtlMsk.DFC_MoFAirFlCtOffGdi_C "Behaviour control mask / Behaviour control masks of check DFC_MoFAirFlCtOffGdi" VALUE 0x804D960A Val_Wu16 65535.00 DFES_OneToOne 0.00 65535.00 FORMAT "%8.2" /end CHARACTERISTIC
/begin CHARACTERISTIC DFC_CtlMsk.DFC_MoFAirFlCylGdi_C "Behaviour control mask / Behaviour control masks of check DFC_MoFAirFlCylGdi" VALUE 0x804D960C Val_Wu16 65535.00 DFES_OneToOne 0.00 65535.00 FORMAT "%8.2" /end CHARACTERISTIC
/begin CHARACTERISTIC DFC_CtlMsk.DFC_MoFAirFlFF_C "Behaviour control mask / Behaviour control masks of check DFC_MoFAirFlFF" VALUE 0x804D960E Val_Wu16 65535.00 DFES_OneToOne 0.00 65535.00 FORMAT "%8.2" /end CHARACTERISTIC
/begin CHARACTERISTIC DFC_CtlMsk.DFC_MoFAirFlIn_C "Behaviour control mask / Behaviour control masks of check DFC_MoFAirFlIn" VALUE 0x804D9610 Val_Wu16 65535.00 DFES_OneToOne 0.00 65535.00 FORMAT "%8.2" /end CHARACTERISTIC
/begin CHARACTERISTIC DFC_CtlMsk.DFC_MoFAirFlMixCtlGdiChkAirFl_C "Behaviour control mask / Behaviour control masks of check DFC_MoFAirFlMixCtlGdiChkAirFl" VALUE 0x804D9612 Val_Wu16 65535.00 DFES_OneToOne 0.00 65535.00 FORMAT "%8.2" /end CHARACTERISTIC
/begin CHARACTERISTIC DFC_CtlMsk.DFC_MoFAirFlMixCtlGdiChkCtrl_C "Behaviour control mask / Behaviour control masks of check DFC_MoFAirFlMixCtlGdiChkCtrl" VALUE 0x804D9614 Val_Wu16 65535.00 DFES_OneToOne 0.00 65535.00 FORMAT "%8.2" /end CHARACTERISTIC
/begin CHARACTERISTIC DFC_CtlMsk.DFC_MoFAirFlMode_C "Behaviour control mask / Behaviour control masks of check DFC_MoFAirFlMode" VALUE 0x804D9616 Val_Wu16 65535.00 DFES_OneToOne 0.00 65535.00 FORMAT "%8.2" /end CHARACTERISTIC
/begin CHARACTERISTIC DFC_CtlMsk.DFC_MoFESpd_C "Behaviour control mask / Behaviour control masks of check DFC_MoFESpd" VALUE 0x804D9618 Val_Wu16 65535.00 DFES_OneToOne 0.00 65535.00 FORMAT "%8.2" /end CHARACTERISTIC
/begin CHARACTERISTIC DFC_CtlMsk.DFC_MoFIACo_C "Behaviour control mask / Behaviour control masks of check DFC_MoFIACo" VALUE 0x804D961A Val_Wu16 65535.00 DFES_OneToOne 0.00 65535.00 FORMAT "%8.2" /end CHARACTERISTIC
/begin CHARACTERISTIC DFC_CtlMsk.DFC_MoFICOL1_C "Behaviour control mask / Behaviour control masks of check DFC_MoFICOL1" VALUE 0x804D961C Val_Wu16 65535.00 DFES_OneToOne 0.00 65535.00 FORMAT "%8.2" /end CHARACTERISTIC
/begin CHARACTERISTIC DFC_CtlMsk.DFC_MoFICOL2_C "Behaviour control mask / Behaviour control masks of check DFC_MoFICOL2" VALUE 0x804D961E Val_Wu16 65535.00 DFES_OneToOne 0.00 65535.00 FORMAT "%8.2" /end CHARACTERISTIC
/begin CHARACTERISTIC DFC_CtlMsk.DFC_MoFStrt_C "Behaviour control mask / Behaviour control masks of check DFC_MoFStrt" VALUE 0x804D9620 Val_Wu16 65535.00 DFES_OneToOne 0.00 65535.00 FORMAT "%8.2" /end CHARACTERISTIC
/begin CHARACTERISTIC DFC_CtlMsk.DFC_MoFTrqCmp_C "Behaviour control mask / Behaviour control masks of check DFC_MoFTrqCmp" VALUE 0x804D9622 Val_Wu16 65535.00 DFES_OneToOne 0.00 65535.00 FORMAT "%8.2" /end CHARACTERISTIC
/begin CHARACTERISTIC DFC_CtlMsk.DFC_MoFTrqCmpMax_C "Behaviour control mask / Behaviour control masks of check DFC_MoFTrqCmpMax" VALUE 0x804D9624 Val_Wu16 65535.00 DFES_OneToOne 0.00 65535.00 FORMAT "%8.2" /end CHARACTERISTIC
/begin CHARACTERISTIC DFC_CtlMsk.DFC_MoFTrqCmpMin_C "Behaviour control mask / Behaviour control masks of check DFC_MoFTrqCmpMin" VALUE 0x804D9626 Val_Wu16 65535.00 DFES_OneToOne 0.00 65535.00 FORMAT "%8.2" /end CHARACTERISTIC
/begin CHARACTERISTIC DFC_CtlMsk.DFC_MoFVarPostBldSel_C "Behaviour control mask / Behaviour control masks of check DFC_MoFVarPostBldSel" VALUE 0x804D9628 Val_Wu16 65535.00 DFES_OneToOne 0.00 65535.00 FORMAT "%8.2" /end CHARACTERISTIC
/begin CHARACTERISTIC DFC_CtlMsk.DFC_MoXEMMHwLTMCUFW_C "Behaviour control mask / Behaviour control masks of check DFC_MoXEMMHwLTMCUFW" VALUE 0x804D962A Val_Wu16 65535.00 DFES_OneToOne 0.00 65535.00 FORMAT "%8.2" /end CHARACTERISTIC
/begin CHARACTERISTIC DFC_CtlMsk.DFC_MoXEMMHwLTMonBIST_C "Behaviour control mask / Behaviour control masks of check DFC_MoXEMMHwLTMonBIST" VALUE 0x804D962C Val_Wu16 65535.00 DFES_OneToOne 0.00 65535.00 FORMAT "%8.2" /end CHARACTERISTIC
/begin CHARACTERISTIC DFC_CtlMsk.DFC_MoXEMMHwLTRegMonTest_C "Behaviour control mask / Behaviour control masks of check DFC_MoXEMMHwLTRegMonTest" VALUE 0x804D962E Val_Wu16 65535.00 DFES_OneToOne 0.00 65535.00 FORMAT "%8.2" /end CHARACTERISTIC
/begin CHARACTERISTIC DFC_CtlMsk.DFC_MoXEMMHwLTStbySMUAlvTest_C "Behaviour control mask / Behaviour control masks of check DFC_MoXEMMHwLTStbySMUAlvTest" VALUE 0x804D9630 Val_Wu16 65535.00 DFES_OneToOne 0.00 65535.00 FORMAT "%8.2" /end CHARACTERISTIC
/begin CHARACTERISTIC DFC_CtlMsk.DFC_MoXEMMHwLTTempSens_C "Behaviour control mask / Behaviour control masks of check DFC_MoXEMMHwLTTempSens" VALUE 0x804D9632 Val_Wu16 65535.00 DFES_OneToOne 0.00 65535.00 FORMAT "%8.2" /end CHARACTERISTIC
/begin CHARACTERISTIC DFC_CtlMsk.DFC_MoXEMMHwLTUCBCfg_C "Behaviour control mask / Behaviour control masks of check DFC_MoXEMMHwLTUCBCfg" VALUE 0x804D9634 Val_Wu16 65535.00 DFES_OneToOne 0.00 65535.00 FORMAT "%8.2" /end CHARACTERISTIC
/begin CHARACTERISTIC DFC_CtlMsk.DFC_NWSEmax_C "Behaviour control mask / Behaviour control masks of check DFC_NWSEmax" VALUE 0x804D9636 Val_Wu16 65535.00 DFES_OneToOne 0.00 65535.00 FORMAT "%8.2" /end CHARACTERISTIC
/begin CHARACTERISTIC DFC_CtlMsk.DFC_NWSmax_C "Behaviour control mask / Behaviour control masks of check DFC_NWSmax" VALUE 0x804D9638 Val_Wu16 65535.00 DFES_OneToOne 0.00 65535.00 FORMAT "%8.2" /end CHARACTERISTIC
/begin CHARACTERISTIC DFC_CtlMsk.DFC_OCWDAABEActv_C "Behaviour control mask / Behaviour control masks of check DFC_OCWDAABEActv" VALUE 0x804D963A Val_Wu16 65535.00 DFES_OneToOne 0.00 65535.00 FORMAT "%8.2" /end CHARACTERISTIC
/begin CHARACTERISTIC DFC_CtlMsk.DFC_OCWDACom_C "Behaviour control mask / Behaviour control masks of check DFC_OCWDACom" VALUE 0x804D963C Val_Wu16 65535.00 DFES_OneToOne 0.00 65535.00 FORMAT "%8.2" /end CHARACTERISTIC
/begin CHARACTERISTIC DFC_CtlMsk.DFC_OCWDAErrPin_C "Behaviour control mask / Behaviour control masks of check DFC_OCWDAErrPin" VALUE 0x804D963E Val_Wu16 65535.00 DFES_OneToOne 0.00 65535.00 FORMAT "%8.2" /end CHARACTERISTIC
/begin CHARACTERISTIC DFC_CtlMsk.DFC_OCWDAOvrVltg_C "Behaviour control mask / Behaviour control masks of check DFC_OCWDAOvrVltg" VALUE 0x804D9640 Val_Wu16 65535.00 DFES_OneToOne 0.00 65535.00 FORMAT "%8.2" /end CHARACTERISTIC
/begin CHARACTERISTIC DFC_CtlMsk.DFC_ORAmax_C "Behaviour control mask / Behaviour control masks of check DFC_ORAmax" VALUE 0x804D9642 Val_Wu16 65535.00 DFES_OneToOne 0.00 65535.00 FORMAT "%8.2" /end CHARACTERISTIC
/begin CHARACTERISTIC DFC_CtlMsk.DFC_ORAmin_C "Behaviour control mask / Behaviour control masks of check DFC_ORAmin" VALUE 0x804D9644 Val_Wu16 65535.00 DFES_OneToOne 0.00 65535.00 FORMAT "%8.2" /end CHARACTERISTIC
/begin CHARACTERISTIC DFC_CtlMsk.DFC_OilPPlaus_C "Behaviour control mask / Behaviour control masks of check DFC_OilPPlaus" VALUE 0x804D9646 Val_Wu16 65535.00 DFES_OneToOne 0.00 65535.00 FORMAT "%8.2" /end CHARACTERISTIC
/begin CHARACTERISTIC DFC_CtlMsk.DFC_PLLSUmax_C "Behaviour control mask / Behaviour control masks of check DFC_PLLSUmax" VALUE 0x804D9648 Val_Wu16 65535.00 DFES_OneToOne 0.00 65535.00 FORMAT "%8.2" /end CHARACTERISTIC
/begin CHARACTERISTIC DFC_CtlMsk.DFC_PLLSUmin_C "Behaviour control mask / Behaviour control masks of check DFC_PLLSUmin" VALUE 0x804D964A Val_Wu16 65535.00 DFES_OneToOne 0.00 65535.00 FORMAT "%8.2" /end CHARACTERISTIC
/begin CHARACTERISTIC DFC_CtlMsk.DFC_PSR1max_C "Behaviour control mask / Behaviour control masks of check DFC_PSR1max" VALUE 0x804D964C Val_Wu16 65535.00 DFES_OneToOne 0.00 65535.00 FORMAT "%8.2" /end CHARACTERISTIC
/begin CHARACTERISTIC DFC_CtlMsk.DFC_PSRBmax_C "Behaviour control mask / Behaviour control masks of check DFC_PSRBmax" VALUE 0x804D964E Val_Wu16 65535.00 DFES_OneToOne 0.00 65535.00 FORMAT "%8.2" /end CHARACTERISTIC
/begin CHARACTERISTIC DFC_CtlMsk.DFC_PSRBmin_C "Behaviour control mask / Behaviour control masks of check DFC_PSRBmin" VALUE 0x804D9650 Val_Wu16 65535.00 DFES_OneToOne 0.00 65535.00 FORMAT "%8.2" /end CHARACTERISTIC
/begin CHARACTERISTIC DFC_CtlMsk.DFC_PSRPmax_C "Behaviour control mask / Behaviour control masks of check DFC_PSRPmax" VALUE 0x804D9652 Val_Wu16 65535.00 DFES_OneToOne 0.00 65535.00 FORMAT "%8.2" /end CHARACTERISTIC
/begin CHARACTERISTIC DFC_CtlMsk.DFC_PSRPmin_C "Behaviour control mask / Behaviour control masks of check DFC_PSRPmin" VALUE 0x804D9654 Val_Wu16 65535.00 DFES_OneToOne 0.00 65535.00 FORMAT "%8.2" /end CHARACTERISTIC
/begin CHARACTERISTIC DFC_CtlMsk.DFC_PSRPsig_C "Behaviour control mask / Behaviour control masks of check DFC_PSRPsig" VALUE 0x804D9656 Val_Wu16 65535.00 DFES_OneToOne 0.00 65535.00 FORMAT "%8.2" /end CHARACTERISTIC
/begin CHARACTERISTIC DFC_CtlMsk.DFC_PSRmax_C "Behaviour control mask / Behaviour control masks of check DFC_PSRmax" VALUE 0x804D9658 Val_Wu16 65535.00 DFES_OneToOne 0.00 65535.00 FORMAT "%8.2" /end CHARACTERISTIC
/begin CHARACTERISTIC DFC_CtlMsk.DFC_PUmax_C "Behaviour control mask / Behaviour control masks of check DFC_PUmax" VALUE 0x804D965A Val_Wu16 65535.00 DFES_OneToOne 0.00 65535.00 FORMAT "%8.2" /end CHARACTERISTIC
/begin CHARACTERISTIC DFC_CtlMsk.DFC_P_VSE11_OL_C "Behaviour control mask / Behaviour control masks of check DFC_P_VSE11_OL" VALUE 0x804D965C Val_Wu16 65535.00 DFES_OneToOne 0.00 65535.00 FORMAT "%8.2" /end CHARACTERISTIC
/begin CHARACTERISTIC DFC_CtlMsk.DFC_P_VSE11_SCB_C "Behaviour control mask / Behaviour control masks of check DFC_P_VSE11_SCB" VALUE 0x804D965E Val_Wu16 65535.00 DFES_OneToOne 0.00 65535.00 FORMAT "%8.2" /end CHARACTERISTIC
/begin CHARACTERISTIC DFC_CtlMsk.DFC_P_VSE11_SCG_C "Behaviour control mask / Behaviour control masks of check DFC_P_VSE11_SCG" VALUE 0x804D9660 Val_Wu16 65535.00 DFES_OneToOne 0.00 65535.00 FORMAT "%8.2" /end CHARACTERISTIC
/begin CHARACTERISTIC DFC_CtlMsk.DFC_PhyHighAPP1_C "Behaviour control mask / Behaviour control masks of check DFC_PhyHighAPP1" VALUE 0x804D9662 Val_Wu16 65535.00 DFES_OneToOne 0.00 65535.00 FORMAT "%8.2" /end CHARACTERISTIC
/begin CHARACTERISTIC DFC_CtlMsk.DFC_PhyHighAPP2_C "Behaviour control mask / Behaviour control masks of check DFC_PhyHighAPP2" VALUE 0x804D9664 Val_Wu16 65535.00 DFES_OneToOne 0.00 65535.00 FORMAT "%8.2" /end CHARACTERISTIC
/begin CHARACTERISTIC DFC_CtlMsk.DFC_PhyLowAPP1_C "Behaviour control mask / Behaviour control masks of check DFC_PhyLowAPP1" VALUE 0x804D9666 Val_Wu16 65535.00 DFES_OneToOne 0.00 65535.00 FORMAT "%8.2" /end CHARACTERISTIC
/begin CHARACTERISTIC DFC_CtlMsk.DFC_PhyLowAPP2_C "Behaviour control mask / Behaviour control masks of check DFC_PhyLowAPP2" VALUE 0x804D9668 Val_Wu16 65535.00 DFES_OneToOne 0.00 65535.00 FORMAT "%8.2" /end CHARACTERISTIC
/begin CHARACTERISTIC DFC_CtlMsk.DFC_SRCHighAPP1_C "Behaviour control mask / Behaviour control masks of check DFC_SRCHighAPP1" VALUE 0x804D966A Val_Wu16 65535.00 DFES_OneToOne 0.00 65535.00 FORMAT "%8.2" /end CHARACTERISTIC
/begin CHARACTERISTIC DFC_CtlMsk.DFC_SRCHighAPP2_C "Behaviour control mask / Behaviour control masks of check DFC_SRCHighAPP2" VALUE 0x804D966C Val_Wu16 65535.00 DFES_OneToOne 0.00 65535.00 FORMAT "%8.2" /end CHARACTERISTIC
/begin CHARACTERISTIC DFC_CtlMsk.DFC_SRCLowAPP1_C "Behaviour control mask / Behaviour control masks of check DFC_SRCLowAPP1" VALUE 0x804D966E Val_Wu16 65535.00 DFES_OneToOne 0.00 65535.00 FORMAT "%8.2" /end CHARACTERISTIC
/begin CHARACTERISTIC DFC_CtlMsk.DFC_SRCLowAPP2_C "Behaviour control mask / Behaviour control masks of check DFC_SRCLowAPP2" VALUE 0x804D9670 Val_Wu16 65535.00 DFES_OneToOne 0.00 65535.00 FORMAT "%8.2" /end CHARACTERISTIC
/begin CHARACTERISTIC DFC_CtlMsk.DFC_SSpMon2_C "Behaviour control mask / Behaviour control masks of check DFC_SSpMon2" VALUE 0x804D9672 Val_Wu16 65535.00 DFES_OneToOne 0.00 65535.00 FORMAT "%8.2" /end CHARACTERISTIC
/begin CHARACTERISTIC DFC_CtlMsk.DFC_STHDRmax_C "Behaviour control mask / Behaviour control masks of check DFC_STHDRmax" VALUE 0x804D9674 Val_Wu16 65535.00 DFES_OneToOne 0.00 65535.00 FORMAT "%8.2" /end CHARACTERISTIC
/begin CHARACTERISTIC DFC_CtlMsk.DFC_SWReset_0_C "Behaviour control mask / Behaviour control masks of check DFC_SWReset_0" VALUE 0x804D9676 Val_Wu16 65535.00 DFES_OneToOne 0.00 65535.00 FORMAT "%8.2" /end CHARACTERISTIC
/begin CHARACTERISTIC DFC_CtlMsk.DFC_SWReset_1_C "Behaviour control mask / Behaviour control masks of check DFC_SWReset_1" VALUE 0x804D9678 Val_Wu16 65535.00 DFES_OneToOne 0.00 65535.00 FORMAT "%8.2" /end CHARACTERISTIC
/begin CHARACTERISTIC DFC_CtlMsk.DFC_SWReset_2_C "Behaviour control mask / Behaviour control masks of check DFC_SWReset_2" VALUE 0x804D967A Val_Wu16 65535.00 DFES_OneToOne 0.00 65535.00 FORMAT "%8.2" /end CHARACTERISTIC
/begin CHARACTERISTIC DFC_CtlMsk.DFC_SyncAPP_C "Behaviour control mask / Behaviour control masks of check DFC_SyncAPP" VALUE 0x804D967C Val_Wu16 65535.00 DFES_OneToOne 0.00 65535.00 FORMAT "%8.2" /end CHARACTERISTIC
/begin CHARACTERISTIC DFC_CtlMsk.DFC_TANKLnpl_C "Behaviour control mask / Behaviour control masks of check DFC_TANKLnpl" VALUE 0x804D967E Val_Wu16 65535.00 DFES_OneToOne 0.00 65535.00 FORMAT "%8.2" /end CHARACTERISTIC
/begin CHARACTERISTIC DFC_CtlMsk.DFC_TAmax_Dummy_C "Behaviour control mask / Behaviour control masks of check DFC_TAmax_Dummy" VALUE 0x804D9680 Val_Wu16 65535.00 DFES_OneToOne 0.00 65535.00 FORMAT "%8.2" /end CHARACTERISTIC
/begin CHARACTERISTIC DFC_CtlMsk.DFC_TESFmax_C "Behaviour control mask / Behaviour control masks of check DFC_TESFmax" VALUE 0x804D9682 Val_Wu16 65535.00 DFES_OneToOne 0.00 65535.00 FORMAT "%8.2" /end CHARACTERISTIC
/begin CHARACTERISTIC DFC_CtlMsk.DFC_TESGmax_C "Behaviour control mask / Behaviour control masks of check DFC_TESGmax" VALUE 0x804D9684 Val_Wu16 65535.00 DFES_OneToOne 0.00 65535.00 FORMAT "%8.2" /end CHARACTERISTIC
/begin CHARACTERISTIC DFC_CtlMsk.DFC_TKAEmax_C "Behaviour control mask / Behaviour control masks of check DFC_TKAEmax" VALUE 0x804D9686 Val_Wu16 65535.00 DFES_OneToOne 0.00 65535.00 FORMAT "%8.2" /end CHARACTERISTIC
/begin CHARACTERISTIC DFC_CtlMsk.DFC_TKAEmin_C "Behaviour control mask / Behaviour control masks of check DFC_TKAEmin" VALUE 0x804D9688 Val_Wu16 65535.00 DFES_OneToOne 0.00 65535.00 FORMAT "%8.2" /end CHARACTERISTIC
/begin CHARACTERISTIC DFC_CtlMsk.DFC_TKARmax_C "Behaviour control mask / Behaviour control masks of check DFC_TKARmax" VALUE 0x804D968A Val_Wu16 65535.00 DFES_OneToOne 0.00 65535.00 FORMAT "%8.2" /end CHARACTERISTIC
/begin CHARACTERISTIC DFC_CtlMsk.DFC_TKARnpl_C "Behaviour control mask / Behaviour control masks of check DFC_TKARnpl" VALUE 0x804D968C Val_Wu16 65535.00 DFES_OneToOne 0.00 65535.00 FORMAT "%8.2" /end CHARACTERISTIC
/begin CHARACTERISTIC DFC_CtlMsk.DFC_TMmax_Dummy_C "Behaviour control mask / Behaviour control masks of check DFC_TMmax_Dummy" VALUE 0x804D968E Val_Wu16 65535.00 DFES_OneToOne 0.00 65535.00 FORMAT "%8.2" /end CHARACTERISTIC
/begin CHARACTERISTIC DFC_CtlMsk.DFC_TUMmax_Dummy_C "Behaviour control mask / Behaviour control masks of check DFC_TUMmax_Dummy" VALUE 0x804D9690 Val_Wu16 65535.00 DFES_OneToOne 0.00 65535.00 FORMAT "%8.2" /end CHARACTERISTIC
/begin CHARACTERISTIC DFC_CtlMsk.DFC_TWCDPriCatB1_C "Behaviour control mask / Behaviour control masks of check DFC_TWCDPriCatB1" VALUE 0x804D9692 Val_Wu16 65535.00 DFES_OneToOne 0.00 65535.00 FORMAT "%8.2" /end CHARACTERISTIC
/begin CHARACTERISTIC DFC_CtlMsk.DFC_ThrVlvClsdPosnFirstOffsLrnImpoB1_C "Behaviour control mask / Behaviour control masks of check DFC_ThrVlvClsdPosnFirstOffsLrnImpoB1" VALUE 0x804D9694 Val_Wu16 65535.00 DFES_OneToOne 0.00 65535.00 FORMAT "%8.2" /end CHARACTERISTIC
/begin CHARACTERISTIC DFC_CtlMsk.DFC_ThrVlvClsdPosnOffsLrnImpoB1_C "Behaviour control mask / Behaviour control masks of check DFC_ThrVlvClsdPosnOffsLrnImpoB1" VALUE 0x804D9696 Val_Wu16 65535.00 DFES_OneToOne 0.00 65535.00 FORMAT "%8.2" /end CHARACTERISTIC
/begin CHARACTERISTIC DFC_CtlMsk.DFC_ThrVlvClsdPosnOffsLrnMaxB1_C "Behaviour control mask / Behaviour control masks of check DFC_ThrVlvClsdPosnOffsLrnMaxB1" VALUE 0x804D9698 Val_Wu16 65535.00 DFES_OneToOne 0.00 65535.00 FORMAT "%8.2" /end CHARACTERISTIC
/begin CHARACTERISTIC DFC_CtlMsk.DFC_ThrVlvClsdPosnOffsLrnMinB1_C "Behaviour control mask / Behaviour control masks of check DFC_ThrVlvClsdPosnOffsLrnMinB1" VALUE 0x804D969A Val_Wu16 65535.00 DFES_OneToOne 0.00 65535.00 FORMAT "%8.2" /end CHARACTERISTIC
/begin CHARACTERISTIC DFC_CtlMsk.DFC_ThrVlvCtrlDeB1_C "Behaviour control mask / Behaviour control masks of check DFC_ThrVlvCtrlDeB1" VALUE 0x804D969C Val_Wu16 65535.00 DFES_OneToOne 0.00 65535.00 FORMAT "%8.2" /end CHARACTERISTIC
/begin CHARACTERISTIC DFC_CtlMsk.DFC_ThrVlvDycB1_C "Behaviour control mask / Behaviour control masks of check DFC_ThrVlvDycB1" VALUE 0x804D969E Val_Wu16 65535.00 DFES_OneToOne 0.00 65535.00 FORMAT "%8.2" /end CHARACTERISTIC
/begin CHARACTERISTIC DFC_CtlMsk.DFC_ThrVlvLimpAirPosnMaxAbsltDriftB1_C "Behaviour control mask / Behaviour control masks of check DFC_ThrVlvLimpAirPosnMaxAbsltDriftB1" VALUE 0x804D96A0 Val_Wu16 65535.00 DFES_OneToOne 0.00 65535.00 FORMAT "%8.2" /end CHARACTERISTIC
/begin CHARACTERISTIC DFC_CtlMsk.DFC_ThrVlvLimpAirPosnMaxB1_C "Behaviour control mask / Behaviour control masks of check DFC_ThrVlvLimpAirPosnMaxB1" VALUE 0x804D96A2 Val_Wu16 65535.00 DFES_OneToOne 0.00 65535.00 FORMAT "%8.2" /end CHARACTERISTIC
/begin CHARACTERISTIC DFC_CtlMsk.DFC_ThrVlvLimpAirPosnMaxRelDriftB1_C "Behaviour control mask / Behaviour control masks of check DFC_ThrVlvLimpAirPosnMaxRelDriftB1" VALUE 0x804D96A4 Val_Wu16 65535.00 DFES_OneToOne 0.00 65535.00 FORMAT "%8.2" /end CHARACTERISTIC
/begin CHARACTERISTIC DFC_CtlMsk.DFC_ThrVlvLimpAirPosnMinB1_C "Behaviour control mask / Behaviour control masks of check DFC_ThrVlvLimpAirPosnMinB1" VALUE 0x804D96A6 Val_Wu16 65535.00 DFES_OneToOne 0.00 65535.00 FORMAT "%8.2" /end CHARACTERISTIC
/begin CHARACTERISTIC DFC_CtlMsk.DFC_ThrVlvOpenLoadB1_C "Behaviour control mask / Behaviour control masks of check DFC_ThrVlvOpenLoadB1" VALUE 0x804D96A8 Val_Wu16 65535.00 DFES_OneToOne 0.00 65535.00 FORMAT "%8.2" /end CHARACTERISTIC
/begin CHARACTERISTIC DFC_CtlMsk.DFC_ThrVlvOpenSprgB1_C "Behaviour control mask / Behaviour control masks of check DFC_ThrVlvOpenSprgB1" VALUE 0x804D96AA Val_Wu16 65535.00 DFES_OneToOne 0.00 65535.00 FORMAT "%8.2" /end CHARACTERISTIC
/begin CHARACTERISTIC DFC_CtlMsk.DFC_ThrVlvOpenSprgSprdB1_C "Behaviour control mask / Behaviour control masks of check DFC_ThrVlvOpenSprgSprdB1" VALUE 0x804D96AC Val_Wu16 65535.00 DFES_OneToOne 0.00 65535.00 FORMAT "%8.2" /end CHARACTERISTIC
/begin CHARACTERISTIC DFC_CtlMsk.DFC_ThrVlvOpenSprgTwnB1_C "Behaviour control mask / Behaviour control masks of check DFC_ThrVlvOpenSprgTwnB1" VALUE 0x804D96AE Val_Wu16 65535.00 DFES_OneToOne 0.00 65535.00 FORMAT "%8.2" /end CHARACTERISTIC
/begin CHARACTERISTIC DFC_CtlMsk.DFC_ThrVlvOverTB1_C "Behaviour control mask / Behaviour control masks of check DFC_ThrVlvOverTB1" VALUE 0x804D96B0 Val_Wu16 65535.00 DFES_OneToOne 0.00 65535.00 FORMAT "%8.2" /end CHARACTERISTIC
/begin CHARACTERISTIC DFC_CtlMsk.DFC_ThrVlvRetSprgB1_C "Behaviour control mask / Behaviour control masks of check DFC_ThrVlvRetSprgB1" VALUE 0x804D96B2 Val_Wu16 65535.00 DFES_OneToOne 0.00 65535.00 FORMAT "%8.2" /end CHARACTERISTIC
/begin CHARACTERISTIC DFC_CtlMsk.DFC_ThrVlvRetSprgSprdB1_C "Behaviour control mask / Behaviour control masks of check DFC_ThrVlvRetSprgSprdB1" VALUE 0x804D96B4 Val_Wu16 65535.00 DFES_OneToOne 0.00 65535.00 FORMAT "%8.2" /end CHARACTERISTIC
/begin CHARACTERISTIC DFC_CtlMsk.DFC_ThrVlvRetSprgTwnB1_C "Behaviour control mask / Behaviour control masks of check DFC_ThrVlvRetSprgTwnB1" VALUE 0x804D96B6 Val_Wu16 65535.00 DFES_OneToOne 0.00 65535.00 FORMAT "%8.2" /end CHARACTERISTIC
/begin CHARACTERISTIC DFC_CtlMsk.DFC_ThrVlvSens1MaxB1_C "Behaviour control mask / Behaviour control masks of check DFC_ThrVlvSens1MaxB1" VALUE 0x804D96B8 Val_Wu16 65535.00 DFES_OneToOne 0.00 65535.00 FORMAT "%8.2" /end CHARACTERISTIC
/begin CHARACTERISTIC DFC_CtlMsk.DFC_ThrVlvSens1NplB1_C "Behaviour control mask / Behaviour control masks of check DFC_ThrVlvSens1NplB1" VALUE 0x804D96BA Val_Wu16 65535.00 DFES_OneToOne 0.00 65535.00 FORMAT "%8.2" /end CHARACTERISTIC
/begin CHARACTERISTIC DFC_CtlMsk.DFC_ThrVlvSens2MaxB1_C "Behaviour control mask / Behaviour control masks of check DFC_ThrVlvSens2MaxB1" VALUE 0x804D96BC Val_Wu16 65535.00 DFES_OneToOne 0.00 65535.00 FORMAT "%8.2" /end CHARACTERISTIC
/begin CHARACTERISTIC DFC_CtlMsk.DFC_ThrVlvSens2MinB1_C "Behaviour control mask / Behaviour control masks of check DFC_ThrVlvSens2MinB1" VALUE 0x804D96BE Val_Wu16 65535.00 DFES_OneToOne 0.00 65535.00 FORMAT "%8.2" /end CHARACTERISTIC
/begin CHARACTERISTIC DFC_CtlMsk.DFC_ThrVlvSens2NplB1_C "Behaviour control mask / Behaviour control masks of check DFC_ThrVlvSens2NplB1" VALUE 0x804D96C0 Val_Wu16 65535.00 DFES_OneToOne 0.00 65535.00 FORMAT "%8.2" /end CHARACTERISTIC
/begin CHARACTERISTIC DFC_CtlMsk.DFC_ThrVlvShoCircB1_C "Behaviour control mask / Behaviour control masks of check DFC_ThrVlvShoCircB1" VALUE 0x804D96C2 Val_Wu16 65535.00 DFES_OneToOne 0.00 65535.00 FORMAT "%8.2" /end CHARACTERISTIC
/begin CHARACTERISTIC DFC_CtlMsk.DFC_ThrVlvSpiErrB1_C "Behaviour control mask / Behaviour control masks of check DFC_ThrVlvSpiErrB1" VALUE 0x804D96C4 Val_Wu16 65535.00 DFES_OneToOne 0.00 65535.00 FORMAT "%8.2" /end CHARACTERISTIC
/begin CHARACTERISTIC DFC_CtlMsk.DFC_ThrvlvSens1MinB1_C "Behaviour control mask / Behaviour control masks of check DFC_ThrvlvSens1MinB1" VALUE 0x804D96C6 Val_Wu16 65535.00 DFES_OneToOne 0.00 65535.00 FORMAT "%8.2" /end CHARACTERISTIC
/begin CHARACTERISTIC DFC_CtlMsk.DFC_TiOffTBasdChkFast_C "Behaviour control mask / Behaviour control masks of check DFC_TiOffTBasdChkFast" VALUE 0x804D96C8 Val_Wu16 65535.00 DFES_OneToOne 0.00 65535.00 FORMAT "%8.2" /end CHARACTERISTIC
/begin CHARACTERISTIC DFC_CtlMsk.DFC_TiOffTBasdChkSlow_C "Behaviour control mask / Behaviour control masks of check DFC_TiOffTBasdChkSlow" VALUE 0x804D96CA Val_Wu16 65535.00 DFES_OneToOne 0.00 65535.00 FORMAT "%8.2" /end CHARACTERISTIC
/begin CHARACTERISTIC DFC_CtlMsk.DFC_UEGOSnsrMntdS1B1_C "Behaviour control mask / Behaviour control masks of check DFC_UEGOSnsrMntdS1B1" VALUE 0x804D96CC Val_Wu16 65535.00 DFES_OneToOne 0.00 65535.00 FORMAT "%8.2" /end CHARACTERISTIC
/begin CHARACTERISTIC DFC_CtlMsk.DFC_VehVSig_C "Behaviour control mask / Behaviour control masks of check DFC_VehVSig" VALUE 0x804D96CE Val_Wu16 65535.00 DFES_OneToOne 0.00 65535.00 FORMAT "%8.2" /end CHARACTERISTIC
/begin CHARACTERISTIC DFC_CtlMsk.DFC_VlvLftFbSwtIntk11SpclFail_C "Behaviour control mask / Behaviour control masks of check DFC_VlvLftFbSwtIntk11SpclFail" VALUE 0x804D96D0 Val_Wu16 65535.00 DFES_OneToOne 0.00 65535.00 FORMAT "%8.2" /end CHARACTERISTIC
/begin CHARACTERISTIC DFC_CtlMsk.DFC_VlvLftFbSwtIntk11StdFail_C "Behaviour control mask / Behaviour control masks of check DFC_VlvLftFbSwtIntk11StdFail" VALUE 0x804D96D2 Val_Wu16 65535.00 DFES_OneToOne 0.00 65535.00 FORMAT "%8.2" /end CHARACTERISTIC
/begin CHARACTERISTIC DFC_DisblMsk.DFC_Unused_C "disable mask / " VALUE 0x804F5B02 Val_Wu16 65535.00 DFES_OneToOne 0.00 65535.00 FORMAT "%8.2" READ_ONLY /end CHARACTERISTIC
/begin CHARACTERISTIC DFC_DisblMsk.DFC_AAVEmax_C "disable mask / Disable masks of check DFC_AAVEmax" VALUE 0x804F5B04 Val_Wu16 65535.00 DFES_OneToOne 0.00 65535.00 FORMAT "%8.2" /end CHARACTERISTIC
/begin CHARACTERISTIC DFC_DisblMsk.DFC_AAVEmin_C "disable mask / Disable masks of check DFC_AAVEmin" VALUE 0x804F5B06 Val_Wu16 65535.00 DFES_OneToOne 0.00 65535.00 FORMAT "%8.2" /end CHARACTERISTIC
/begin CHARACTERISTIC DFC_DisblMsk.DFC_AAVEsig_C "disable mask / Disable masks of check DFC_AAVEsig" VALUE 0x804F5B08 Val_Wu16 65535.00 DFES_OneToOne 0.00 65535.00 FORMAT "%8.2" /end CHARACTERISTIC
/begin FUNCTION DFC "30000.33.0_1.1.0Diagnostic Fault Check"
 /begin DEF_CHARACTERISTIC DFC_CtlMsk.DFC_ComMETLTOut_C DFC_CtlMsk.DFC_ComMETMChksum_C DFC_CtlMsk.DFC_ComMETMRingCnt_C DFC_CtlMsk.DFC_ComMETMTOut_C DFC_CtlMsk.DFC_ComMETNChksum_C DFC_CtlMsk.DFC_ComMETNRingCnt_C DFC_CtlMsk.DFC_ComMETNTOut_C DFC_CtlMsk.DFC_ComMtrCom_C DFC_CtlMsk.DFC_ComPCUChkSum_C DFC_CtlMsk.DFC_ComPCURingCnt_C DFC_CtlMsk.DFC_ComPCUTOut_C DFC_CtlMsk.DFC_ComSRSAChksum_C DFC_CtlMsk.DFC_ComSRSARingCnt_C DFC_CtlMsk.DFC_ComSRSATOut_C DFC_CtlMsk.DFC_ComSRSBChksum_C DFC_CtlMsk.DFC_ComSRSBRingCnt_C DFC_CtlMsk.DFC_ComSRSBTOut_C DFC_CtlMsk.DFC_ComSRSChksum_C DFC_CtlMsk.DFC_ComSRSErr_C DFC_CtlMsk.DFC_ComSRSRingCnt_C DFC_CtlMsk.DFC_ComSRSTOut_C DFC_CtlMsk.DFC_ComVehSpdPndFltTCU_C DFC_CtlMsk.DFC_EbsChartcCurrErr_C DFC_CtlMsk.DFC_EbsSelfDiagErr_C DFC_CtlMsk.DFC_GEVlvPhaCsersIntkB1_C DFC_CtlMsk.DFC_GEVlvPhaPsOpenLoadIntkB1_C DFC_CtlMsk.DFC_GEVlvPhaPsShoToBattIntkB1_C DFC_CtlMsk.DFC_GEVlvPhaPsShoToGndIntkB1_C DFC_CtlMsk.DFC_GbxCANDigPlausErr_C DFC_CtlMsk.DFC_GbxNPos1SRCMax_C DFC_CtlMsk.DFC_GbxNPos1SRCMin_C DFC_CtlMsk.DFC_GbxNPos2SRCMax_C DFC_CtlMsk.DFC_GbxNPos2SRCMin_C DFC_CtlMsk.DFC_GbxNPosAlvChk_C DFC_CtlMsk.DFC_GbxNPosSyncErr_C DFC_CtlMsk.DFC_HEGOS2B1HtrPsMax_C DFC_CtlMsk.DFC_HEGOS2B1HtrPsMin_C DFC_CtlMsk.DFC_HEGOS2B1HtrPsSig_C DFC_CtlMsk.DFC_LinCSErrACG_C DFC_CtlMsk.DFC_LinCSErrAEV_C DFC_CtlMsk.DFC_LinCSErrDCDC_C DFC_CtlMsk.DFC_LinCSErrEBS_C DFC_CtlMsk.DFC_LinHdrTimeoutErrACG_C DFC_CtlMsk.DFC_LinHdrTimeoutErrAEV_C DFC_CtlMsk.DFC_LinHdrTimeoutErrDCDC_C DFC_CtlMsk.DFC_LinHdrTimeoutErrEBS_C DFC_CtlMsk.DFC_LinMsgTimeoutErrACG_C DFC_CtlMsk.DFC_LinMsgTimeoutErrAEV_C DFC_CtlMsk.DFC_LinMsgTimeoutErrDCDC_C DFC_CtlMsk.DFC_LinMsgTimeoutErrEBS_C DFC_CtlMsk.DFC_LinNoStrtComErr_C DFC_CtlMsk.DFC_LowPresOilP_C DFC_CtlMsk.DFC_MisfDetVWhlFrntLeOORHi_C DFC_CtlMsk.DFC_MisfDetVWhlFrntLeRatyHi_C DFC_CtlMsk.DFC_MisfDetVWhlFrntLeRatyLo_C DFC_CtlMsk.DFC_MisfDetVWhlFrntLeStuck_C DFC_CtlMsk.DFC_MisfDetVWhlFrntRiOORHi_C DFC_CtlMsk.DFC_MisfDetVWhlFrntRiRatyHi_C DFC_CtlMsk.DFC_MisfDetVWhlFrntRiRatyLo_C DFC_CtlMsk.DFC_MisfDetVWhlFrntRiStuck_C DFC_CtlMsk.DFC_MisfDetVWhlReLeOORHi_C DFC_CtlMsk.DFC_MisfDetVWhlReLeRatyHi_C DFC_CtlMsk.DFC_MisfDetVWhlReLeRatyLo_C DFC_CtlMsk.DFC_MisfDetVWhlReLeStuck_C DFC_CtlMsk.DFC_MisfDetVWhlReRiOORHi_C DFC_CtlMsk.DFC_MisfDetVWhlReRiRatyHi_C DFC_CtlMsk.DFC_MisfDetVWhlReRiRatyLo_C DFC_CtlMsk.DFC_MisfDetVWhlReRiStuck_C DFC_CtlMsk.DFC_MisfDetdVWhlFrntLePlaus_C DFC_CtlMsk.DFC_MisfDetdVWhlFrntRiPlaus_C DFC_CtlMsk.DFC_MisfDetdVWhlReLePlaus_C DFC_CtlMsk.DFC_MisfDetdVWhlReRiPlaus_C DFC_CtlMsk.DFC_PEnvSigRngMax_C DFC_CtlMsk.DFC_PEnvSigRngMin_C DFC_CtlMsk.DFC_StmFault_C DFC_CtlMsk.DFC_StrtCtOffPth_C DFC_CtlMsk.DFC_StrtCtlErr_C DFC_CtlMsk.DFC_StrtFault_C DFC_CtlMsk.DFC_StrtLckJudg1_C DFC_CtlMsk.DFC_StrtLckJudg2_C DFC_CtlMsk.DFC_StrtOL_C DFC_CtlMsk.DFC_StrtOL2_C DFC_CtlMsk.DFC_StrtSCB_C DFC_CtlMsk.DFC_StrtSCB2_C DFC_CtlMsk.DFC_StrtSCG_C DFC_CtlMsk.DFC_StrtSCG2_C DFC_CtlMsk.DFC_StrtStkRly1_C DFC_CtlMsk.DFC_StrtStkRly2_C DFC_CtlMsk.DFC_TEVEmax_C DFC_CtlMsk.DFC_TEVEmin_C DFC_CtlMsk.DFC_TEVEsig_C DFC_CtlMsk.DFC_UegoHeatrPrfmncLoS1B1_C DFC_CtlMsk.DFC_VehVAllPlaus_C DFC_CtlMsk.DFC_VehVNCSnsrElecFailr_C DFC_CtlMsk.DFC_VehVPlausCan_C DFC_CtlMsk.DFC_VehVPlausFco_C DFC_CtlMsk.DFC_VehVPlausPwr_C DFC_CtlMsk.DFC_VehVPlausV2N_C DFC_CtlMsk.DFC_VehVSpdSnsrAElecFailr_C DFC_CtlMsk.DFC_VehVSpdSnsrBElecFailr_C DFC_CtlMsk.DFC_ClthMax_C DFC_CtlMsk.DFC_IgnClPs_DevComErr_C DFC_CtlMsk.DFC_IgnClPs_LineOl_0_C DFC_CtlMsk.DFC_IgnClPs_LineOl_1_C DFC_CtlMsk.DFC_IgnClPs_LineOl_2_C DFC_CtlMsk.DFC_IgnClPs_LineOl_3_C DFC_CtlMsk.DFC_IgnClPs_LineScb_0_C DFC_CtlMsk.DFC_IgnClPs_LineScb_1_C DFC_CtlMsk.DFC_IgnClPs_LineScb_2_C DFC_CtlMsk.DFC_IgnClPs_LineScb_3_C DFC_CtlMsk.DFC_IgnClPs_LineScg_0_C DFC_CtlMsk.DFC_IgnClPs_LineScg_1_C DFC_CtlMsk.DFC_IgnClPs_LineScg_2_C DFC_CtlMsk.DFC_IgnClPs_LineScg_3_C DFC_CtlMsk.DFC_KRVEKOEVAB_C DFC_CtlMsk.DFC_KRVEKOEVAB0_C DFC_CtlMsk.DFC_KRVEKOEVAB1_C DFC_CtlMsk.DFC_KRVEKOEVAB2_C DFC_CtlMsk.DFC_KRVEKOEVAB3_C DFC_CtlMsk.DFC_UegoSigEcuAsicS1B1_C DFC_CtlMsk.DFC_UegoSigEcuComS1B1_C DFC_CtlMsk.DFC_UegoSigSnsrS1B1_C DFC_CtlMsk.DFC_UegoSigWireOlApesS1B1_C DFC_CtlMsk.DFC_UegoSigWireOlIpeS1B1_C DFC_CtlMsk.DFC_UegoSigWireOlReS1B1_C DFC_CtlMsk.DFC_UegoSigWireRCmpS1B1_C DFC_CtlMsk.DFC_UegoSigWireScbS1B1_C DFC_CtlMsk.DFC_UegoSigWireScgS1B1_C DFC_CtlMsk.DFC_AfsPhyRngHiB1_C DFC_CtlMsk.DFC_AfsPhyRngLoB1_C DFC_CtlMsk.DFC_AirCCmprOL_C DFC_CtlMsk.DFC_AirCCmprOvrTemp_C DFC_CtlMsk.DFC_AirCCmprSCB_C DFC_CtlMsk.DFC_AirCCmprSCG_C DFC_CtlMsk.DFC_AltErr_C DFC_CtlMsk.DFC_BattUSRCMax_C DFC_CtlMsk.DFC_BattUSRCMin_C DFC_CtlMsk.DFC_ComChksTCU1_C DFC_CtlMsk.DFC_ComChksTCU11_C DFC_CtlMsk.DFC_ComChksTCU12_C DFC_CtlMsk.DFC_ComChksTCU13_C DFC_CtlMsk.DFC_ComChksTCU2_C DFC_CtlMsk.DFC_ComChksTCU3_C DFC_CtlMsk.DFC_ComChksTCU4_C DFC_CtlMsk.DFC_ComCntTCU1_C DFC_CtlMsk.DFC_ComCntTCU11_C DFC_CtlMsk.DFC_ComCntTCU12_C DFC_CtlMsk.DFC_ComCntTCU13_C DFC_CtlMsk.DFC_ComCntTCU2_C DFC_CtlMsk.DFC_ComCntTCU3_C DFC_CtlMsk.DFC_ComCntTCU4_C DFC_CtlMsk.DFC_ComTOutTCU01_C DFC_CtlMsk.DFC_ComTOutTCU02_C DFC_CtlMsk.DFC_ComTOutTCU1_C DFC_CtlMsk.DFC_ComTOutTCU11_C DFC_CtlMsk.DFC_ComTOutTCU12_C DFC_CtlMsk.DFC_ComTOutTCU13_C DFC_CtlMsk.DFC_ComTOutTCU14_C DFC_CtlMsk.DFC_ComTOutTCU2_C DFC_CtlMsk.DFC_ComTOutTCU3_C DFC_CtlMsk.DFC_ComTOutTCU4_C DFC_CtlMsk.DFC_DevLibBattUHi_C DFC_CtlMsk.DFC_DevLibBattULo_C DFC_CtlMsk.DFC_EGRVlvFailSafeActv_C DFC_CtlMsk.DFC_EGRVlvGovDvtCld_C DFC_CtlMsk.DFC_EGRVlvPhysSRCMax_C DFC_CtlMsk.DFC_EGRVlvPhysSRCMin_C DFC_CtlMsk.DFC_FanDIOOL_0_C DFC_CtlMsk.DFC_FanDIOOL_1_C DFC_CtlMsk.DFC_FanDIOOvrTemp_0_C DFC_CtlMsk.DFC_FanDIOOvrTemp_1_C DFC_CtlMsk.DFC_FanDIOSCB_0_C DFC_CtlMsk.DFC_FanDIOSCB_1_C DFC_CtlMsk.DFC_FanDIOSCG_0_C DFC_CtlMsk.DFC_FanDIOSCG_1_C DFC_CtlMsk.DFC_MRlyDcOL_C DFC_CtlMsk.DFC_MRlyDcSCB_C DFC_CtlMsk.DFC_MRlyDcSCG_C DFC_CtlMsk.DFC_PSPOL_C DFC_CtlMsk.DFC_PSPOvrTemp_C DFC_CtlMsk.DFC_PSPSCB_C DFC_CtlMsk.DFC_PSPSCG_C DFC_CtlMsk.DFC_T50Err_C DFC_CtlMsk.DFC_ThrVlvLoBattB1_C DFC_CtlMsk.DFC_UegoSigOperPlausS1B1_C DFC_CtlMsk.DFC_VehVPhysRngHi_C DFC_CtlMsk.DFC_VehVSclOutOL_C DFC_CtlMsk.DFC_VehVSclOutOT_C DFC_CtlMsk.DFC_VehVSclOutSCB_C DFC_CtlMsk.DFC_VehVSclOutSCG_C DFC_CtlMsk.DFC_VehVSigFL_C DFC_CtlMsk.DFC_VehVSigFR_C DFC_CtlMsk.DFC_VehVSigRL_C DFC_CtlMsk.DFC_VehVSigRR_C DFC_CtlMsk.DFC_VehVSnsrARngHi_C DFC_CtlMsk.DFC_VehVSnsrBRngHi_C DFC_CtlMsk.DFC_VehVSpdRtyDiag_C DFC_CtlMsk.DFC_DHFHD_C DFC_CtlMsk.DFC_InjVlv_DI_DcDc_C DFC_CtlMsk.DFC_InjVlv_DI_NoLd_0_C DFC_CtlMsk.DFC_InjVlv_DI_NoLd_1_C DFC_CtlMsk.DFC_InjVlv_DI_NoLd_2_C DFC_CtlMsk.DFC_InjVlv_DI_NoLd_3_C DFC_CtlMsk.DFC_InjVlv_DI_ScBnk_0_C DFC_CtlMsk.DFC_InjVlv_DI_ScBnk_1_C DFC_CtlMsk.DFC_InjVlv_DI_ScBnk_2_C DFC_CtlMsk.DFC_InjVlv_DI_ScBnk_3_C DFC_CtlMsk.DFC_InjVlv_DI_ScCyl_0_C DFC_CtlMsk.DFC_InjVlv_DI_ScCyl_1_C DFC_CtlMsk.DFC_InjVlv_DI_ScCyl_2_C DFC_CtlMsk.DFC_InjVlv_DI_ScCyl_3_C DFC_CtlMsk.DFC_InjVlv_DI_ScHsLs_0_C DFC_CtlMsk.DFC_InjVlv_DI_ScHsLs_1_C DFC_CtlMsk.DFC_InjVlv_DI_ScHsLs_2_C DFC_CtlMsk.DFC_InjVlv_DI_ScHsLs_3_C DFC_CtlMsk.DFC_MfPsDiaOpenLoad1_C DFC_CtlMsk.DFC_MfPsDiaScHiS1_C DFC_CtlMsk.DFC_MfPsDiaScHiSLowS1_C DFC_CtlMsk.DFC_MfPsDiaScLowS1_C DFC_CtlMsk.DFC_ACEvpTPhysRngHi_C DFC_CtlMsk.DFC_ACEvpTPhysRngLo_C DFC_CtlMsk.DFC_ACEvpTSRCMax_C DFC_CtlMsk.DFC_ACEvpTSRCMin_C DFC_CtlMsk.DFC_AfsRawSigRngHiB1_C DFC_CtlMsk.DFC_AfsRawSigRngLoB1_C DFC_CtlMsk.DFC_AfsSnsrErrB1_C DFC_CtlMsk.DFC_AirCClntPAnaSRCMax_C DFC_CtlMsk.DFC_AirCClntPAnaSRCMin_C DFC_CtlMsk.DFC_AirCSwtNpl_C DFC_CtlMsk.DFC_AirCSwtSig_C DFC_CtlMsk.DFC_Brk_C DFC_CtlMsk.DFC_BrkBstSensSCB_C DFC_CtlMsk.DFC_BrkBstSensSCG_C DFC_CtlMsk.DFC_BrkSig_C DFC_CtlMsk.DFC_ClthSig_C DFC_CtlMsk.DFC_EGRVlvCurrLim_C DFC_CtlMsk.DFC_EGRVlvOL_C DFC_CtlMsk.DFC_EGRVlvOvrTemp_C DFC_CtlMsk.DFC_EGRVlvSCB_C DFC_CtlMsk.DFC_EGRVlvSCG_C DFC_CtlMsk.DFC_EGRVlvSRCMax_C DFC_CtlMsk.DFC_EGRVlvSRCMin_C DFC_CtlMsk.DFC_HLSDemOvhtEngLim_C DFC_CtlMsk.DFC_OilPSwmpSRCMax_C DFC_CtlMsk.DFC_OilPSwmpSRCMin_C DFC_CtlMsk.DFC_PIntkVUsLineHiB1_C DFC_CtlMsk.DFC_PIntkVUsLineLoB1_C DFC_CtlMsk.DFC_VehVPhysRngLo_C DFC_CtlMsk.DFC_VehVSigCan_C DFC_CtlMsk.DFC_VehVSigCanSafe_C DFC_CtlMsk.DFC_VlvLftFbOilPSnsrIntk11SRCMax_C DFC_CtlMsk.DFC_VlvLftFbOilPSnsrIntk11SRCMin_C DFC_CtlMsk.DFC_ClthNpl_C DFC_CtlMsk.DFC_GbxPNPosnDrvCdn_C DFC_CtlMsk.DFC_GbxPNPosnPlausy_C DFC_CtlMsk.DFC_AfsSigErrLineHiB1_C DFC_CtlMsk.DFC_AfsSigErrLineLoB1_C DFC_CtlMsk.DFC_PEnvCcMax_C DFC_CtlMsk.DFC_PEnvCcMin_C DFC_CtlMsk.DFC_PEnvRngChkMax_C DFC_CtlMsk.DFC_PEnvRngChkMin_C DFC_CtlMsk.DFC_PEnvSnsrPlaus_C DFC_CtlMsk.DFC_UEGOHeatrRlyPsOLS1B1_C DFC_CtlMsk.DFC_UEGOHeatrRlyPsSCBS1B1_C DFC_CtlMsk.DFC_UEGOHeatrRlyPsSCGS1B1_C DFC_CtlMsk.DFC_UegoHeatrWireOlS1B1_C DFC_CtlMsk.DFC_UegoHeatrWireScbS1B1_C DFC_CtlMsk.DFC_UegoHeatrWireScgS1B1_C DFC_CtlMsk.DFC_KnDetSens1PortAMax_C DFC_CtlMsk.DFC_KnDetSens1PortAMin_C DFC_CtlMsk.DFC_KnDetSens1PortBMax_C DFC_CtlMsk.DFC_KnDetSens1PortBMin_C DFC_CtlMsk.DFC_Clth2ONStuck_C DFC_CtlMsk.DFC_Clth2ONStuckLdc_C DFC_CtlMsk.DFC_Clth3ONStuckLdc_C DFC_CtlMsk.DFC_Clth3ONStuckPostDrv_C DFC_CtlMsk.DFC_Clth4ONStuck_C DFC_CtlMsk.DFC_Clth4ONStuckLdc_C DFC_CtlMsk.DFC_ComBCMUnit_C DFC_CtlMsk.DFC_ComDLCTCU01_C DFC_CtlMsk.DFC_ComDLCTCU02_C DFC_CtlMsk.DFC_ComDLCTCU1_C DFC_CtlMsk.DFC_ComDLCTCU11_C DFC_CtlMsk.DFC_ComDLCTCU12_C DFC_CtlMsk.DFC_ComDLCTCU13_C DFC_CtlMsk.DFC_ComDLCTCU14_C DFC_CtlMsk.DFC_ComDLCTCU2_C DFC_CtlMsk.DFC_ComDLCTCU3_C DFC_CtlMsk.DFC_ComDLCTCU4_C DFC_CtlMsk.DFC_ComEPSUnit_C DFC_CtlMsk.DFC_ComIDASBUnit_C DFC_CtlMsk.DFC_ComIMGUnit_C DFC_CtlMsk.DFC_ComMETUnit_C DFC_CtlMsk.DFC_ComSRSUnit_C DFC_CtlMsk.DFC_ComVSAUnit_C DFC_CtlMsk.DFC_EbsSocFlt_C DFC_CtlMsk.DFC_I14229VINErr_C DFC_CtlMsk.DFC_InjCatHeatgErr_C DFC_CtlMsk.DFC_InjSysMulInjDiagErr_C DFC_CtlMsk.DFC_LLRHmax_C DFC_CtlMsk.DFC_LLRHmin_C DFC_CtlMsk.DFC_LLRHnpl_C DFC_CtlMsk.DFC_LLRKHmax_C DFC_CtlMsk.DFC_LLRKHmin_C DFC_CtlMsk.DFC_LLRKHnpl_C DFC_CtlMsk.DFC_LinACGUnit_C DFC_CtlMsk.DFC_LinAEVUnit_C DFC_CtlMsk.DFC_LinEBSUnit_C DFC_CtlMsk.DFC_RoughRoad_C DFC_CtlMsk.DFC_SiaEEPRdErr_C DFC_CtlMsk.DFC_SiaEEPWrngCod_C DFC_CtlMsk.DFC_UegoHeatrStrtS1B1_C DFC_CtlMsk.DFC_BusDiagCANAPPLBusOff_C DFC_CtlMsk.DFC_BusDiagCANCANCBusOff_C DFC_CtlMsk.DFC_BusDiagCANVEHICLEBusOff_C DFC_CtlMsk.DFC_RBA_IODIAGPWR_rba_IoExtCy329_SignalVltSply_0_C DFC_CtlMsk.DFC_RBA_IODIAGPWR_rba_IoExtCy329_SignalVltSply_0OT_C DFC_CtlMsk.DFC_RBA_IODIAGPWR_rba_IoExtCy329_SignalVltSply_0OV_C DFC_CtlMsk.DFC_RBA_IODIAGPWR_rba_IoExtCy329_SignalVltSply_0SCG_C DFC_CtlMsk.DFC_RBA_IODIAGPWR_rba_IoExtCy329_SignalVltSply_0UV_C DFC_CtlMsk.DFC_RBA_IODIAGPWR_rba_IoExtCy329_SignalVltSply_1_C DFC_CtlMsk.DFC_RBA_IODIAGPWR_rba_IoExtCy329_SignalVltSply_1OT_C DFC_CtlMsk.DFC_RBA_IODIAGPWR_rba_IoExtCy329_SignalVltSply_1OV_C DFC_CtlMsk.DFC_RBA_IODIAGPWR_rba_IoExtCy329_SignalVltSply_1SCG_C DFC_CtlMsk.DFC_RBA_IODIAGPWR_rba_IoExtCy329_SignalVltSply_1UV_C DFC_CtlMsk.DFC_RBA_IODIAGPWR_rba_IoExtCy329_SignalVltSply_2_C DFC_CtlMsk.DFC_RBA_IODIAGPWR_rba_IoExtCy329_SignalVltSply_2OT_C DFC_CtlMsk.DFC_RBA_IODIAGPWR_rba_IoExtCy329_SignalVltSply_2OV_C DFC_CtlMsk.DFC_RBA_IODIAGPWR_rba_IoExtCy329_SignalVltSply_2SCG_C DFC_CtlMsk.DFC_RBA_IODIAGPWR_rba_IoExtCy329_SignalVltSply_2UV_C DFC_CtlMsk.DFC_CAN_E_TIMEOUT_C DFC_CtlMsk.DFC_LIN_E_TIMEOUT_C DFC_CtlMsk.DFC_MRlyOL_C DFC_CtlMsk.DFC_MRlySCB_C DFC_CtlMsk.DFC_MRlySCG_C DFC_CtlMsk.DFC_rba_MultiStackTrace_Threshold_C DFC_CtlMsk.DFC_BSWM_E_ACTION_FAILED_C DFC_CtlMsk.DFC_BSWM_E_INTRPTQUEUE_FULL_C DFC_CtlMsk.DFC_RBA_IOEXTLIB_KEEPALIVE_DRV_C DFC_CtlMsk.DFC_RBA_IOEXTLIB_KEEPALIVE_INI_C DFC_CtlMsk.DFC_rba_IoSigRtc_StopCounter_C DFC_CtlMsk.DFC_rba_MRly_Diag_Stk_Event_C DFC_CtlMsk.DFC_rba_MemDiag_MemReadErr_C DFC_CtlMsk.DFC_rba_MemDiag_MemWrErr_C DFC_CtlMsk.DFC_rba_SyC_IrrSwOffTrigEngRun_Event_C DFC_CtlMsk.DFC_rba_T15_Diag_ComInVld_Event_C DFC_CtlMsk.DFC_rba_T15_Diag_ComOff_HwOn_Event_C DFC_CtlMsk.DFC_rba_T15_Diag_ComOn_HwOff_Event_C DFC_CtlMsk.DFC_AAVmin_C DFC_CtlMsk.DFC_AGRSUS_C DFC_CtlMsk.DFC_AfsPlausDiagHi_C DFC_CtlMsk.DFC_AfsPlausDiagLo_C DFC_CtlMsk.DFC_AfsVrntDiagErrB1_C DFC_CtlMsk.DFC_AppAllSnsrDfct_C DFC_CtlMsk.DFC_BBKRnldg_C DFC_CtlMsk.DFC_BBKRsyne_C DFC_CtlMsk.DFC_BattUStdbyDiaOL_C DFC_CtlMsk.DFC_BigLeakIntkMnfldEmiInfl_C DFC_CtlMsk.DFC_BlkdLineTank_C DFC_CtlMsk.DFC_BrkMnSwtContOnWarnLmp_C DFC_CtlMsk.DFC_BrkMnSwtNotStpWarnLmp_C DFC_CtlMsk.DFC_BrkRdntSwtContOnWarnLmp_C DFC_CtlMsk.DFC_BrkRdntSwtNotStpWarnLmp_C DFC_CtlMsk.DFC_CEngDsTColdStrtMax_C DFC_CtlMsk.DFC_CEngDsTColdStrtMin_C DFC_CtlMsk.DFC_CEngDsTImps_C DFC_CtlMsk.DFC_CEngDsTPlausHSC_C DFC_CtlMsk.DFC_CEngDsTPlausLSC_C DFC_CtlMsk.DFC_CEngDsTPlausSTC_C DFC_CtlMsk.DFC_CEngDsTSRCMax_C DFC_CtlMsk.DFC_CEngDsTSRCMin_C DFC_CtlMsk.DFC_CEngDsTSig_C DFC_CtlMsk.DFC_CEngUsTColdStrtMax_C DFC_CtlMsk.DFC_CEngUsTColdStrtMin_C DFC_CtlMsk.DFC_CEngUsTLooseCnctn_C DFC_CtlMsk.DFC_CEngUsTSRCMax_C DFC_CtlMsk.DFC_CEngUsTSRCMin_C DFC_CtlMsk.DFC_ComDCDCACCFailr_C DFC_CtlMsk.DFC_DCDCFltDet_C DFC_CtlMsk.DFC_DKRSA_C DFC_CtlMsk.DFC_DKVSmax_C DFC_CtlMsk.DFC_DKnpl_C DFC_CtlMsk.DFC_DSKVRmax_C DFC_CtlMsk.DFC_DSKVRmin_C DFC_CtlMsk.DFC_DSKVRnpl_C DFC_CtlMsk.DFC_DSKVRsig_C DFC_CtlMsk.DFC_DSKVSsig_C DFC_CtlMsk.DFC_DSSmax_C DFC_CtlMsk.DFC_DSTDmax_C DFC_CtlMsk.DFC_DSTEmax_C DFC_CtlMsk.DFC_DSTEmin_C DFC_CtlMsk.DFC_DSTOFmax_C DFC_CtlMsk.DFC_DSTRmax_C DFC_CtlMsk.DFC_DSTRmin_C DFC_CtlMsk.DFC_DSTRnpl_C DFC_CtlMsk.DFC_DSTRsig_C DFC_CtlMsk.DFC_DSTTI_C DFC_CtlMsk.DFC_DSUmax_C DFC_CtlMsk.DFC_DiagCpv1DteskLoLoadStuckClsd_C DFC_CtlMsk.DFC_DiagCpv1DteskLoLoadStuckOpen_C DFC_CtlMsk.DFC_EGRVlvDrftClsd_C DFC_CtlMsk.DFC_EGRVlvDrftOpn_C DFC_CtlMsk.DFC_EGRVlvJamVlvClsd_C DFC_CtlMsk.DFC_EGRVlvJamVlvOpn_C DFC_CtlMsk.DFC_EGRVlvSprgBrk_C DFC_CtlMsk.DFC_EGRVlvTempMdlEEPErr_C DFC_CtlMsk.DFC_EGRVlvTmpErr_C DFC_CtlMsk.DFC_EGSDUS2B1LtrDly_C DFC_CtlMsk.DFC_EGSDUS2B1LtrPT1_C DFC_CtlMsk.DFC_EGSDUS2B1RtlDly_C DFC_CtlMsk.DFC_EGSDUS2B1RtlPT1_C DFC_CtlMsk.DFC_EGSDUS2B1TarLean_C DFC_CtlMsk.DFC_EGSDUS2B1TarRich_C DFC_CtlMsk.DFC_EONVmax_C DFC_CtlMsk.DFC_ETAKHLmax_C DFC_CtlMsk.DFC_ETAKHTmax_C DFC_CtlMsk.DFC_ETHSEmax_C DFC_CtlMsk.DFC_ETHSEmin_C DFC_CtlMsk.DFC_ETHSFmax_C DFC_CtlMsk.DFC_ETHSFmin_C DFC_CtlMsk.DFC_ETHSFsig_C DFC_CtlMsk.DFC_ETHSNPWmax_C DFC_CtlMsk.DFC_ETHSNPWmin_C DFC_CtlMsk.DFC_ETHSNPWsig_C DFC_CtlMsk.DFC_ETHSPLnpl_C DFC_CtlMsk.DFC_ETHSTPLnpl_C DFC_CtlMsk.DFC_EngICO_C DFC_CtlMsk.DFC_EngPrtOvrSpdMon_C DFC_CtlMsk.DFC_EpmCaSI1ErrSig_C DFC_CtlMsk.DFC_EpmCaSI1MntErr_C DFC_CtlMsk.DFC_EpmCaSI1NoSigMax_C DFC_CtlMsk.DFC_EpmCaSI1NoSigMin_C DFC_CtlMsk.DFC_EpmCaSI1OfsErr_C DFC_CtlMsk.DFC_EpmCrSDGI_C DFC_CtlMsk.DFC_EpmCrSErrSig_C DFC_CtlMsk.DFC_EpmCrSNoSig_C DFC_CtlMsk.DFC_EtaEngIdleNonCsers_C DFC_CtlMsk.DFC_EtaEngPtlNonCsers_C DFC_CtlMsk.DFC_FRAmax_C DFC_CtlMsk.DFC_FRAmin_C DFC_CtlMsk.DFC_FSTEmax_C DFC_CtlMsk.DFC_FSTEmin_C DFC_CtlMsk.DFC_FSTRmax_C DFC_CtlMsk.DFC_FSTRmin_C DFC_CtlMsk.DFC_FSTRnpl_C DFC_CtlMsk.DFC_FSTmax_C DFC_CtlMsk.DFC_FTDLAmax_C DFC_CtlMsk.DFC_FTDLAmin_C DFC_CtlMsk.DFC_FuPHiSnsrEleclmax_C DFC_CtlMsk.DFC_FuPHiSnsrEleclmin_C DFC_CtlMsk.DFC_FuPHiSnsrEleclnpl_C DFC_CtlMsk.DFC_FuPHiSnsrURngMax_C DFC_CtlMsk.DFC_FuPHiSnsrURngMin_C DFC_CtlMsk.DFC_FuSnsrPhyRngMaxErr_C DFC_CtlMsk.DFC_FuSnsrPhyRngMinErr_C DFC_CtlMsk.DFC_GEVlvLockPinDiagIntkB1_C DFC_CtlMsk.DFC_GEVlvPhaSlowIntkB1_C DFC_CtlMsk.DFC_GEVlvPhaTargIntkB1_C DFC_CtlMsk.DFC_GbxRvsSwtStk_C DFC_CtlMsk.DFC_HDRKHmax_C DFC_CtlMsk.DFC_HDRKHmin_C DFC_CtlMsk.DFC_HDRPLmax_C DFC_CtlMsk.DFC_HDRPLmin_C DFC_CtlMsk.DFC_HDRmax_C DFC_CtlMsk.DFC_HDRmin_C DFC_CtlMsk.DFC_HEGOS2B1ElecMax_C DFC_CtlMsk.DFC_HEGOS2B1ElecMin_C DFC_CtlMsk.DFC_HEGOS2B1ElecSig_C DFC_CtlMsk.DFC_HEGOS2B1HtgNpl_C DFC_CtlMsk.DFC_HEV00max_C DFC_CtlMsk.DFC_HEV01max_C DFC_CtlMsk.DFC_HEV02max_C DFC_CtlMsk.DFC_HEV03max_C DFC_CtlMsk.DFC_HEVE0max_C DFC_CtlMsk.DFC_HEVE1max_C DFC_CtlMsk.DFC_HFMmax_C DFC_CtlMsk.DFC_HiPSysHiPMaxLimExcdd_C DFC_CtlMsk.DFC_IVGdiCtlCvoErrMax_0_C DFC_CtlMsk.DFC_IVGdiCtlCvoErrMax_1_C DFC_CtlMsk.DFC_IVGdiCtlCvoErrMax_2_C DFC_CtlMsk.DFC_IVGdiCtlCvoErrMax_3_C DFC_CtlMsk.DFC_IVGdiCtlCvoErrMin_0_C DFC_CtlMsk.DFC_IVGdiCtlCvoErrMin_1_C DFC_CtlMsk.DFC_IVGdiCtlCvoErrMin_2_C DFC_CtlMsk.DFC_IVGdiCtlCvoErrMin_3_C DFC_CtlMsk.DFC_IVGdiCtlCvoErrMinMax_C DFC_CtlMsk.DFC_IVGdiCtlCvoSigPlausErrSmrCdn_C DFC_CtlMsk.DFC_IVGdiCtl_CvoErr_C DFC_CtlMsk.DFC_IVGdiCtl_CvoSigPlaus_0_C DFC_CtlMsk.DFC_IVGdiCtl_CvoSigPlaus_1_C DFC_CtlMsk.DFC_IVGdiCtl_CvoSigPlaus_2_C DFC_CtlMsk.DFC_IVGdiCtl_CvoSigPlaus_3_C DFC_CtlMsk.DFC_IntkAirTAirFltDsCrssMax_C DFC_CtlMsk.DFC_IntkAirTAirFltDsCrssMin_C DFC_CtlMsk.DFC_IntkAirTAirFltDsHSCMax_C DFC_CtlMsk.DFC_IntkAirTAirFltDsImps_C DFC_CtlMsk.DFC_IntkAirTAirFltDsPRCMax_C DFC_CtlMsk.DFC_IntkAirTAirFltDsPRCMin_C DFC_CtlMsk.DFC_IntkAirTAirFltDsSRCMax_C DFC_CtlMsk.DFC_IntkAirTAirFltDsSRCMin_C DFC_CtlMsk.DFC_IntkAirTAirFltDsSTC_C DFC_CtlMsk.DFC_IntkAirTIntkMnfldCrssMax_C DFC_CtlMsk.DFC_IntkAirTIntkMnfldCrssMin_C DFC_CtlMsk.DFC_IntkAirTIntkMnfldHSCMax_C DFC_CtlMsk.DFC_IntkAirTIntkMnfldImps_C DFC_CtlMsk.DFC_IntkAirTIntkMnfldPRCMax_C DFC_CtlMsk.DFC_IntkAirTIntkMnfldPRCMin_C DFC_CtlMsk.DFC_IntkAirTIntkMnfldSRCMax_C DFC_CtlMsk.DFC_IntkAirTIntkMnfldSRCMin_C DFC_CtlMsk.DFC_IntkAirTIntkMnfldSTC_C DFC_CtlMsk.DFC_KRREGRLMX_C DFC_CtlMsk.DFC_KRVEKOCVLCI_C DFC_CtlMsk.DFC_KRVEKOENCHMT_C DFC_CtlMsk.DFC_KRVEKOENCHMT0_C DFC_CtlMsk.DFC_KRVEKOENCHMT1_C DFC_CtlMsk.DFC_KRVEKOENCHMT2_C DFC_CtlMsk.DFC_KRVEKOENCHMT3_C DFC_CtlMsk.DFC_KRVEKOENCHMT4_C DFC_CtlMsk.DFC_KRVEKOENCHMT5_C DFC_CtlMsk.DFC_KRVEKOENCHMT6_C DFC_CtlMsk.DFC_KRVEKOENCHMT7_C DFC_CtlMsk.DFC_KRVEKORLMX_C DFC_CtlMsk.DFC_KRVEKORLMXL_C DFC_CtlMsk.DFC_KS1max_C DFC_CtlMsk.DFC_KS1min_C DFC_CtlMsk.DFC_LMmax_C DFC_CtlMsk.DFC_LZSRnpl_C DFC_CtlMsk.DFC_LamDynDiagS1B1_C DFC_CtlMsk.DFC_LeakIntkMnfldEmiInfl_C DFC_CtlMsk.DFC_LinFrameErrDCDC_C DFC_CtlMsk.DFC_LinOverrunErrDCDC_C DFC_CtlMsk.DFC_MD00max_C DFC_CtlMsk.DFC_MDBmax_C DFC_CtlMsk.DFC_MDCat_C DFC_CtlMsk.DFC_MDCatCrit_C DFC_CtlMsk.DFC_MDCatCurr_C DFC_CtlMsk.DFC_MDCyl_0_C DFC_CtlMsk.DFC_MDCyl_1_C DFC_CtlMsk.DFC_MDCyl_2_C DFC_CtlMsk.DFC_MDCyl_3_C DFC_CtlMsk.DFC_MDEmi_C DFC_CtlMsk.DFC_MDEmiStrt_C DFC_CtlMsk.DFC_MDFco_C DFC_CtlMsk.DFC_MDMpl_C DFC_CtlMsk.DFC_MDSegTiAdpn_C DFC_CtlMsk.DFC_MDmax_C DFC_CtlMsk.DFC_MFuOilMax_C DFC_CtlMsk.DFC_MOXEMM_SMU_ALM0_0_C DFC_CtlMsk.DFC_MOXEMM_SMU_ALM0_1_C DFC_CtlMsk.DFC_MOXEMM_SMU_ALM0_10_C DFC_CtlMsk.DFC_MOXEMM_SMU_ALM0_11_C DFC_CtlMsk.DFC_MOXEMM_SMU_ALM0_13_C DFC_CtlMsk.DFC_MOXEMM_SMU_ALM0_14_C DFC_CtlMsk.DFC_MOXEMM_SMU_ALM0_2_C DFC_CtlMsk.DFC_MOXEMM_SMU_ALM0_22_C DFC_CtlMsk.DFC_MOXEMM_SMU_ALM0_23_C DFC_CtlMsk.DFC_MOXEMM_SMU_ALM0_4_C DFC_CtlMsk.DFC_MOXEMM_SMU_ALM0_5_C DFC_CtlMsk.DFC_MOXEMM_SMU_ALM0_7_C DFC_CtlMsk.DFC_MOXEMM_SMU_ALM0_8_C DFC_CtlMsk.DFC_MOXEMM_SMU_ALM10_16_C DFC_CtlMsk.DFC_MOXEMM_SMU_ALM10_17_C DFC_CtlMsk.DFC_MOXEMM_SMU_ALM10_21_C DFC_CtlMsk.DFC_MOXEMM_SMU_ALM11_0_C DFC_CtlMsk.DFC_MOXEMM_SMU_ALM11_1_C DFC_CtlMsk.DFC_MOXEMM_SMU_ALM11_2_C DFC_CtlMsk.DFC_MOXEMM_SMU_ALM11_3_C DFC_CtlMsk.DFC_MOXEMM_SMU_ALM11_4_C DFC_CtlMsk.DFC_MOXEMM_SMU_ALM11_5_C DFC_CtlMsk.DFC_MOXEMM_SMU_ALM11_8_C DFC_CtlMsk.DFC_MOXEMM_SMU_ALM11_9_C DFC_CtlMsk.DFC_MOXEMM_SMU_ALM1_0_C DFC_CtlMsk.DFC_MOXEMM_SMU_ALM1_1_C DFC_CtlMsk.DFC_MOXEMM_SMU_ALM1_10_C DFC_CtlMsk.DFC_MOXEMM_SMU_ALM1_11_C DFC_CtlMsk.DFC_MOXEMM_SMU_ALM1_13_C DFC_CtlMsk.DFC_MOXEMM_SMU_ALM1_14_C DFC_CtlMsk.DFC_MOXEMM_SMU_ALM1_2_C DFC_CtlMsk.DFC_MOXEMM_SMU_ALM1_22_C DFC_CtlMsk.DFC_MOXEMM_SMU_ALM1_23_C DFC_CtlMsk.DFC_MOXEMM_SMU_ALM1_4_C DFC_CtlMsk.DFC_MOXEMM_SMU_ALM1_5_C DFC_CtlMsk.DFC_MOXEMM_SMU_ALM1_7_C DFC_CtlMsk.DFC_MOXEMM_SMU_ALM1_8_C DFC_CtlMsk.DFC_MOXEMM_SMU_ALM21_0_C DFC_CtlMsk.DFC_MOXEMM_SMU_ALM21_16_C DFC_CtlMsk.DFC_MOXEMM_SMU_ALM21_3_C DFC_CtlMsk.DFC_MOXEMM_SMU_ALM2_1_C DFC_CtlMsk.DFC_MOXEMM_SMU_ALM2_10_C DFC_CtlMsk.DFC_MOXEMM_SMU_ALM2_11_C DFC_CtlMsk.DFC_MOXEMM_SMU_ALM2_13_C DFC_CtlMsk.DFC_MOXEMM_SMU_ALM2_14_C DFC_CtlMsk.DFC_MOXEMM_SMU_ALM2_22_C DFC_CtlMsk.DFC_MOXEMM_SMU_ALM2_23_C DFC_CtlMsk.DFC_MOXEMM_SMU_ALM2_4_C DFC_CtlMsk.DFC_MOXEMM_SMU_ALM2_5_C DFC_CtlMsk.DFC_MOXEMM_SMU_ALM2_7_C DFC_CtlMsk.DFC_MOXEMM_SMU_ALM2_8_C DFC_CtlMsk.DFC_MOXEMM_SMU_ALM6_0_C DFC_CtlMsk.DFC_MOXEMM_SMU_ALM6_11_C DFC_CtlMsk.DFC_MOXEMM_SMU_ALM6_12_C DFC_CtlMsk.DFC_MOXEMM_SMU_ALM6_14_C DFC_CtlMsk.DFC_MOXEMM_SMU_ALM6_15_C DFC_CtlMsk.DFC_MOXEMM_SMU_ALM6_17_C DFC_CtlMsk.DFC_MOXEMM_SMU_ALM6_18_C DFC_CtlMsk.DFC_MOXEMM_SMU_ALM6_20_C DFC_CtlMsk.DFC_MOXEMM_SMU_ALM6_21_C DFC_CtlMsk.DFC_MOXEMM_SMU_ALM6_25_C DFC_CtlMsk.DFC_MOXEMM_SMU_ALM6_4_C DFC_CtlMsk.DFC_MOXEMM_SMU_ALM6_5_C DFC_CtlMsk.DFC_MOXEMM_SMU_ALM6_7_C DFC_CtlMsk.DFC_MOXEMM_SMU_ALM6_8_C DFC_CtlMsk.DFC_MOXEMM_SMU_ALM7_1_C DFC_CtlMsk.DFC_MOXEMM_SMU_ALM7_12_C DFC_CtlMsk.DFC_MOXEMM_SMU_ALM7_13_C DFC_CtlMsk.DFC_MOXEMM_SMU_ALM7_14_C DFC_CtlMsk.DFC_MOXEMM_SMU_ALM7_15_C DFC_CtlMsk.DFC_MOXEMM_SMU_ALM7_16_C DFC_CtlMsk.DFC_MOXEMM_SMU_ALM7_17_C DFC_CtlMsk.DFC_MOXEMM_SMU_ALM7_2_C DFC_CtlMsk.DFC_MOXEMM_SMU_ALM7_20_C DFC_CtlMsk.DFC_MOXEMM_SMU_ALM7_25_C DFC_CtlMsk.DFC_MOXEMM_SMU_ALM7_26_C DFC_CtlMsk.DFC_MOXEMM_SMU_ALM7_28_C DFC_CtlMsk.DFC_MOXEMM_SMU_ALM7_29_C DFC_CtlMsk.DFC_MOXEMM_SMU_ALM7_30_C DFC_CtlMsk.DFC_MOXEMM_SMU_ALM7_31_C DFC_CtlMsk.DFC_MOXEMM_SMU_ALM8_0_C DFC_CtlMsk.DFC_MOXEMM_SMU_ALM8_1_C DFC_CtlMsk.DFC_MOXEMM_SMU_ALM8_10_C DFC_CtlMsk.DFC_MOXEMM_SMU_ALM8_11_C DFC_CtlMsk.DFC_MOXEMM_SMU_ALM8_12_C DFC_CtlMsk.DFC_MOXEMM_SMU_ALM8_16_C DFC_CtlMsk.DFC_MOXEMM_SMU_ALM8_18_C DFC_CtlMsk.DFC_MOXEMM_SMU_ALM8_2_C DFC_CtlMsk.DFC_MOXEMM_SMU_ALM8_3_C DFC_CtlMsk.DFC_MOXEMM_SMU_ALM8_31_C DFC_CtlMsk.DFC_MOXEMM_SMU_ALM8_4_C DFC_CtlMsk.DFC_MOXEMM_SMU_ALM9_0_C DFC_CtlMsk.DFC_MOXEMM_SMU_ALM9_15_C DFC_CtlMsk.DFC_MOXEMM_SMU_ALM9_3_C DFC_CtlMsk.DFC_MoCADCNTP_C DFC_CtlMsk.DFC_MoCADCTst_C DFC_CtlMsk.DFC_MoCSOPICO_C DFC_CtlMsk.DFC_MoFAPP_C DFC_CtlMsk.DFC_MoFAirFilgPrdc_C DFC_CtlMsk.DFC_MoFAirFlCtOffGdi_C DFC_CtlMsk.DFC_MoFAirFlCylGdi_C DFC_CtlMsk.DFC_MoFAirFlFF_C DFC_CtlMsk.DFC_MoFAirFlIn_C DFC_CtlMsk.DFC_MoFAirFlMixCtlGdiChkAirFl_C DFC_CtlMsk.DFC_MoFAirFlMixCtlGdiChkCtrl_C DFC_CtlMsk.DFC_MoFAirFlMode_C DFC_CtlMsk.DFC_MoFESpd_C DFC_CtlMsk.DFC_MoFIACo_C DFC_CtlMsk.DFC_MoFICOL1_C DFC_CtlMsk.DFC_MoFICOL2_C DFC_CtlMsk.DFC_MoFStrt_C DFC_CtlMsk.DFC_MoFTrqCmp_C DFC_CtlMsk.DFC_MoFTrqCmpMax_C DFC_CtlMsk.DFC_MoFTrqCmpMin_C DFC_CtlMsk.DFC_MoFVarPostBldSel_C DFC_CtlMsk.DFC_MoXEMMHwLTMCUFW_C DFC_CtlMsk.DFC_MoXEMMHwLTMonBIST_C DFC_CtlMsk.DFC_MoXEMMHwLTRegMonTest_C DFC_CtlMsk.DFC_MoXEMMHwLTStbySMUAlvTest_C DFC_CtlMsk.DFC_MoXEMMHwLTTempSens_C DFC_CtlMsk.DFC_MoXEMMHwLTUCBCfg_C DFC_CtlMsk.DFC_NWSEmax_C DFC_CtlMsk.DFC_NWSmax_C DFC_CtlMsk.DFC_OCWDAABEActv_C DFC_CtlMsk.DFC_OCWDACom_C DFC_CtlMsk.DFC_OCWDAErrPin_C DFC_CtlMsk.DFC_OCWDAOvrVltg_C DFC_CtlMsk.DFC_ORAmax_C DFC_CtlMsk.DFC_ORAmin_C DFC_CtlMsk.DFC_OilPPlaus_C DFC_CtlMsk.DFC_PLLSUmax_C DFC_CtlMsk.DFC_PLLSUmin_C DFC_CtlMsk.DFC_PSR1max_C DFC_CtlMsk.DFC_PSRBmax_C DFC_CtlMsk.DFC_PSRBmin_C DFC_CtlMsk.DFC_PSRPmax_C DFC_CtlMsk.DFC_PSRPmin_C DFC_CtlMsk.DFC_PSRPsig_C DFC_CtlMsk.DFC_PSRmax_C DFC_CtlMsk.DFC_PUmax_C DFC_CtlMsk.DFC_P_VSE11_OL_C DFC_CtlMsk.DFC_P_VSE11_SCB_C DFC_CtlMsk.DFC_P_VSE11_SCG_C DFC_CtlMsk.DFC_PhyHighAPP1_C DFC_CtlMsk.DFC_PhyHighAPP2_C DFC_CtlMsk.DFC_PhyLowAPP1_C DFC_CtlMsk.DFC_PhyLowAPP2_C DFC_CtlMsk.DFC_SRCHighAPP1_C DFC_CtlMsk.DFC_SRCHighAPP2_C DFC_CtlMsk.DFC_SRCLowAPP1_C DFC_CtlMsk.DFC_SRCLowAPP2_C DFC_CtlMsk.DFC_SSpMon2_C DFC_CtlMsk.DFC_STHDRmax_C DFC_CtlMsk.DFC_SWReset_0_C DFC_CtlMsk.DFC_SWReset_1_C DFC_CtlMsk.DFC_SWReset_2_C DFC_CtlMsk.DFC_SyncAPP_C DFC_CtlMsk.DFC_TANKLnpl_C DFC_CtlMsk.DFC_TAmax_Dummy_C DFC_CtlMsk.DFC_TESFmax_C DFC_CtlMsk.DFC_TESGmax_C DFC_CtlMsk.DFC_TKAEmax_C DFC_CtlMsk.DFC_TKAEmin_C DFC_CtlMsk.DFC_TKARmax_C DFC_CtlMsk.DFC_TKARnpl_C DFC_CtlMsk.DFC_TMmax_Dummy_C DFC_CtlMsk.DFC_TUMmax_Dummy_C DFC_CtlMsk.DFC_TWCDPriCatB1_C DFC_CtlMsk.DFC_ThrVlvClsdPosnFirstOffsLrnImpoB1_C DFC_CtlMsk.DFC_ThrVlvClsdPosnOffsLrnImpoB1_C DFC_CtlMsk.DFC_ThrVlvClsdPosnOffsLrnMaxB1_C DFC_CtlMsk.DFC_ThrVlvClsdPosnOffsLrnMinB1_C DFC_CtlMsk.DFC_ThrVlvCtrlDeB1_C DFC_CtlMsk.DFC_ThrVlvDycB1_C DFC_CtlMsk.DFC_ThrVlvLimpAirPosnMaxAbsltDriftB1_C DFC_CtlMsk.DFC_ThrVlvLimpAirPosnMaxB1_C DFC_CtlMsk.DFC_ThrVlvLimpAirPosnMaxRelDriftB1_C DFC_CtlMsk.DFC_ThrVlvLimpAirPosnMinB1_C DFC_CtlMsk.DFC_ThrVlvOpenLoadB1_C DFC_CtlMsk.DFC_ThrVlvOpenSprgB1_C DFC_CtlMsk.DFC_ThrVlvOpenSprgSprdB1_C DFC_CtlMsk.DFC_ThrVlvOpenSprgTwnB1_C DFC_CtlMsk.DFC_ThrVlvOverTB1_C DFC_CtlMsk.DFC_ThrVlvRetSprgB1_C DFC_CtlMsk.DFC_ThrVlvRetSprgSprdB1_C DFC_CtlMsk.DFC_ThrVlvRetSprgTwnB1_C DFC_CtlMsk.DFC_ThrVlvSens1MaxB1_C DFC_CtlMsk.DFC_ThrVlvSens1NplB1_C DFC_CtlMsk.DFC_ThrVlvSens2MaxB1_C DFC_CtlMsk.DFC_ThrVlvSens2MinB1_C DFC_CtlMsk.DFC_ThrVlvSens2NplB1_C DFC_CtlMsk.DFC_ThrVlvShoCircB1_C DFC_CtlMsk.DFC_ThrVlvSpiErrB1_C DFC_CtlMsk.DFC_ThrvlvSens1MinB1_C DFC_CtlMsk.DFC_TiOffTBasdChkFast_C DFC_CtlMsk.DFC_TiOffTBasdChkSlow_C DFC_CtlMsk.DFC_UEGOSnsrMntdS1B1_C DFC_CtlMsk.DFC_VehVSig_C DFC_CtlMsk.DFC_VlvLftFbSwtIntk11SpclFail_C DFC_CtlMsk.DFC_VlvLftFbSwtIntk11StdFail_C DFC_DisblMsk.DFC_Unused_C DFC_DisblMsk.DFC_AAVEmax_C DFC_DisblMsk.DFC_AAVEmin_C DFC_DisblMsk.DFC_AAVEsig_C /end DEF_CHARACTERISTIC
 FUNCTION_VERSION "30000.33.0_1.1.0" /end FUNCTION
/begin COMPU_METHOD DFES_OneToOne "" RAT_FUNC "%6.2" "-" COEFFS 0 1 0 0 0 1 /end COMPU_METHOD
/begin RECORD_LAYOUT Val_Wu16 FNC_VALUES 1 UWORD COLUMN_DIR DIRECT /end RECORD_LAYOUT
/end MODULE
/end PROJECT
