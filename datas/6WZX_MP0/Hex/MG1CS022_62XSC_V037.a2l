ASAP2_VERSION 1 60
/begin PROJECT MG1CS022 "MG1CS022"
/begin HEADER "" VERSION "MG1CS022_62XSC_V037" PROJECT_NO MG1CS022 /end HEADER
/begin MODULE DIM ""
/begin MOD_COMMON "" BYTE_ORDER MSB_LAST ALIGNMENT_BYTE 1 ALIGNMENT_WORD 2 ALIGNMENT_LONG 4 ALIGNMENT_INT64 4 ALIGNMENT_FLOAT32_IEEE 4 ALIGNMENT_FLOAT64_IEEE 4 DATA_SIZE 32 /end MOD_COMMON
/begin CHARACTERISTIC DFC_CtlMsk.DFC_Unused_C "Behaviour control mask / " VALUE 0x804D8FBE Val_Wu16 65535.00 DFES_OneToOne 0.00 65535.00 FORMAT "%8.2" READ_ONLY /end CHARACTERISTIC
/begin CHARACTERISTIC DFC_CtlMsk.DFC_AAVEmax_C "Behaviour control mask / Behaviour control masks of check DFC_AAVEmax" VALUE 0x804D8FC0 Val_Wu16 65535.00 DFES_OneToOne 0.00 65535.00 FORMAT "%8.2" /end CHARACTERISTIC
/begin CHARACTERISTIC DFC_CtlMsk.DFC_AAVEmin_C "Behaviour control mask / Behaviour control masks of check DFC_AAVEmin" VALUE 0x804D8FC2 Val_Wu16 65535.00 DFES_OneToOne 0.00 65535.00 FORMAT "%8.2" /end CHARACTERISTIC
/begin CHARACTERISTIC DFC_CtlMsk.DFC_AAVEsig_C "Behaviour control mask / Behaviour control masks of check DFC_AAVEsig" VALUE 0x804D8FC4 Val_Wu16 65535.00 DFES_OneToOne 0.00 65535.00 FORMAT "%8.2" /end CHARACTERISTIC
/begin CHARACTERISTIC DFC_CtlMsk.DFC_AltIOACGFailr_C "Behaviour control mask / Behaviour control masks of check DFC_AltIOACGFailr" VALUE 0x804D8FC6 Val_Wu16 65535.00 DFES_OneToOne 0.00 65535.00 FORMAT "%8.2" /end CHARACTERISTIC
/begin CHARACTERISTIC DFC_CtlMsk.DFC_AltIOACGHiVltg_C "Behaviour control mask / Behaviour control masks of check DFC_AltIOACGHiVltg" VALUE 0x804D8FC8 Val_Wu16 65535.00 DFES_OneToOne 0.00 65535.00 FORMAT "%8.2" /end CHARACTERISTIC
/begin CHARACTERISTIC DFC_CtlMsk.DFC_AltIOACGLoVltg_C "Behaviour control mask / Behaviour control masks of check DFC_AltIOACGLoVltg" VALUE 0x804D8FCA Val_Wu16 65535.00 DFES_OneToOne 0.00 65535.00 FORMAT "%8.2" /end CHARACTERISTIC
/begin CHARACTERISTIC DFC_CtlMsk.DFC_AltIOACGTHi_C "Behaviour control mask / Behaviour control masks of check DFC_AltIOACGTHi" VALUE 0x804D8FCC Val_Wu16 65535.00 DFES_OneToOne 0.00 65535.00 FORMAT "%8.2" /end CHARACTERISTIC
/begin CHARACTERISTIC DFC_CtlMsk.DFC_AltIODConnACG_C "Behaviour control mask / Behaviour control masks of check DFC_AltIODConnACG" VALUE 0x804D8FCE Val_Wu16 65535.00 DFES_OneToOne 0.00 65535.00 FORMAT "%8.2" /end CHARACTERISTIC
/begin CHARACTERISTIC DFC_CtlMsk.DFC_BGOELWAF_C "Behaviour control mask / Behaviour control masks of check DFC_BGOELWAF" VALUE 0x804D8FD0 Val_Wu16 65535.00 DFES_OneToOne 0.00 65535.00 FORMAT "%8.2" /end CHARACTERISTIC
/begin CHARACTERISTIC DFC_CtlMsk.DFC_BattUHiFailr_C "Behaviour control mask / Behaviour control masks of check DFC_BattUHiFailr" VALUE 0x804D8FD2 Val_Wu16 65535.00 DFES_OneToOne 0.00 65535.00 FORMAT "%8.2" /end CHARACTERISTIC
/begin CHARACTERISTIC DFC_CtlMsk.DFC_BattULoFailr_C "Behaviour control mask / Behaviour control masks of check DFC_BattULoFailr" VALUE 0x804D8FD4 Val_Wu16 65535.00 DFES_OneToOne 0.00 65535.00 FORMAT "%8.2" /end CHARACTERISTIC
/begin CHARACTERISTIC DFC_CtlMsk.DFC_BrkBstPDriftHiErr_C "Behaviour control mask / Behaviour control masks of check DFC_BrkBstPDriftHiErr" VALUE 0x804D8FD6 Val_Wu16 65535.00 DFES_OneToOne 0.00 65535.00 FORMAT "%8.2" /end CHARACTERISTIC
/begin CHARACTERISTIC DFC_CtlMsk.DFC_BrkBstPDriftLoErr_C "Behaviour control mask / Behaviour control masks of check DFC_BrkBstPDriftLoErr" VALUE 0x804D8FD8 Val_Wu16 65535.00 DFES_OneToOne 0.00 65535.00 FORMAT "%8.2" /end CHARACTERISTIC
/begin CHARACTERISTIC DFC_CtlMsk.DFC_BrkBstPSnsrStuck_C "Behaviour control mask / Behaviour control masks of check DFC_BrkBstPSnsrStuck" VALUE 0x804D8FDA Val_Wu16 65535.00 DFES_OneToOne 0.00 65535.00 FORMAT "%8.2" /end CHARACTERISTIC
/begin CHARACTERISTIC DFC_CtlMsk.DFC_BrkMnSwtContOn_C "Behaviour control mask / Behaviour control masks of check DFC_BrkMnSwtContOn" VALUE 0x804D8FDC Val_Wu16 65535.00 DFES_OneToOne 0.00 65535.00 FORMAT "%8.2" /end CHARACTERISTIC
/begin CHARACTERISTIC DFC_CtlMsk.DFC_BrkMnSwtNotStp_C "Behaviour control mask / Behaviour control masks of check DFC_BrkMnSwtNotStp" VALUE 0x804D8FDE Val_Wu16 65535.00 DFES_OneToOne 0.00 65535.00 FORMAT "%8.2" /end CHARACTERISTIC
/begin CHARACTERISTIC DFC_CtlMsk.DFC_BrkNpl_C "Behaviour control mask / Behaviour control masks of check DFC_BrkNpl" VALUE 0x804D8FE0 Val_Wu16 65535.00 DFES_OneToOne 0.00 65535.00 FORMAT "%8.2" /end CHARACTERISTIC
/begin CHARACTERISTIC DFC_CtlMsk.DFC_BrkRdntSwtContOn_C "Behaviour control mask / Behaviour control masks of check DFC_BrkRdntSwtContOn" VALUE 0x804D8FE2 Val_Wu16 65535.00 DFES_OneToOne 0.00 65535.00 FORMAT "%8.2" /end CHARACTERISTIC
/begin CHARACTERISTIC DFC_CtlMsk.DFC_BrkRdntSwtNotStp_C "Behaviour control mask / Behaviour control masks of check DFC_BrkRdntSwtNotStp" VALUE 0x804D8FE4 Val_Wu16 65535.00 DFES_OneToOne 0.00 65535.00 FORMAT "%8.2" /end CHARACTERISTIC
/begin CHARACTERISTIC DFC_CtlMsk.DFC_Clth3ONStuck_C "Behaviour control mask / Behaviour control masks of check DFC_Clth3ONStuck" VALUE 0x804D8FE6 Val_Wu16 65535.00 DFES_OneToOne 0.00 65535.00 FORMAT "%8.2" /end CHARACTERISTIC
/begin CHARACTERISTIC DFC_CtlMsk.DFC_Clth4OFFStuck_C "Behaviour control mask / Behaviour control masks of check DFC_Clth4OFFStuck" VALUE 0x804D8FE8 Val_Wu16 65535.00 DFES_OneToOne 0.00 65535.00 FORMAT "%8.2" /end CHARACTERISTIC
/begin CHARACTERISTIC DFC_CtlMsk.DFC_ClthOFFStuck_C "Behaviour control mask / Behaviour control masks of check DFC_ClthOFFStuck" VALUE 0x804D8FEA Val_Wu16 65535.00 DFES_OneToOne 0.00 65535.00 FORMAT "%8.2" /end CHARACTERISTIC
/begin CHARACTERISTIC DFC_CtlMsk.DFC_ClthONStuck_C "Behaviour control mask / Behaviour control masks of check DFC_ClthONStuck" VALUE 0x804D8FEC Val_Wu16 65535.00 DFES_OneToOne 0.00 65535.00 FORMAT "%8.2" /end CHARACTERISTIC
/begin CHARACTERISTIC DFC_CtlMsk.DFC_ClthStkFailInfo_C "Behaviour control mask / Behaviour control masks of check DFC_ClthStkFailInfo" VALUE 0x804D8FEE Val_Wu16 65535.00 DFES_OneToOne 0.00 65535.00 FORMAT "%8.2" /end CHARACTERISTIC
/begin CHARACTERISTIC DFC_CtlMsk.DFC_ComACFailInfo_C "Behaviour control mask / Behaviour control masks of check DFC_ComACFailInfo" VALUE 0x804D8FF0 Val_Wu16 65535.00 DFES_OneToOne 0.00 65535.00 FORMAT "%8.2" /end CHARACTERISTIC
/begin CHARACTERISTIC DFC_CtlMsk.DFC_ComATFTValErr_C "Behaviour control mask / Behaviour control masks of check DFC_ComATFTValErr" VALUE 0x804D8FF2 Val_Wu16 65535.00 DFES_OneToOne 0.00 65535.00 FORMAT "%8.2" /end CHARACTERISTIC
/begin CHARACTERISTIC DFC_CtlMsk.DFC_ComATMILReq_C "Behaviour control mask / Behaviour control masks of check DFC_ComATMILReq" VALUE 0x804D8FF4 Val_Wu16 65535.00 DFES_OneToOne 0.00 65535.00 FORMAT "%8.2" /end CHARACTERISTIC
/begin CHARACTERISTIC DFC_CtlMsk.DFC_ComAYCAChksum_C "Behaviour control mask / Behaviour control masks of check DFC_ComAYCAChksum" VALUE 0x804D8FF6 Val_Wu16 65535.00 DFES_OneToOne 0.00 65535.00 FORMAT "%8.2" /end CHARACTERISTIC
/begin CHARACTERISTIC DFC_CtlMsk.DFC_ComAYCARingCnt_C "Behaviour control mask / Behaviour control masks of check DFC_ComAYCARingCnt" VALUE 0x804D8FF8 Val_Wu16 65535.00 DFES_OneToOne 0.00 65535.00 FORMAT "%8.2" /end CHARACTERISTIC
/begin CHARACTERISTIC DFC_CtlMsk.DFC_ComAYCATOut_C "Behaviour control mask / Behaviour control masks of check DFC_ComAYCATOut" VALUE 0x804D8FFA Val_Wu16 65535.00 DFES_OneToOne 0.00 65535.00 FORMAT "%8.2" /end CHARACTERISTIC
/begin CHARACTERISTIC DFC_CtlMsk.DFC_ComAYCDChkSum_C "Behaviour control mask / Behaviour control masks of check DFC_ComAYCDChkSum" VALUE 0x804D8FFC Val_Wu16 65535.00 DFES_OneToOne 0.00 65535.00 FORMAT "%8.2" /end CHARACTERISTIC
/begin CHARACTERISTIC DFC_CtlMsk.DFC_ComAYCDTOut_C "Behaviour control mask / Behaviour control masks of check DFC_ComAYCDTOut" VALUE 0x804D8FFE Val_Wu16 65535.00 DFES_OneToOne 0.00 65535.00 FORMAT "%8.2" /end CHARACTERISTIC
/begin CHARACTERISTIC DFC_CtlMsk.DFC_ComAYCFChksum_C "Behaviour control mask / Behaviour control masks of check DFC_ComAYCFChksum" VALUE 0x804D9000 Val_Wu16 65535.00 DFES_OneToOne 0.00 65535.00 FORMAT "%8.2" /end CHARACTERISTIC
/begin CHARACTERISTIC DFC_CtlMsk.DFC_ComAYCFRingCnt_C "Behaviour control mask / Behaviour control masks of check DFC_ComAYCFRingCnt" VALUE 0x804D9002 Val_Wu16 65535.00 DFES_OneToOne 0.00 65535.00 FORMAT "%8.2" /end CHARACTERISTIC
/begin CHARACTERISTIC DFC_CtlMsk.DFC_ComAYCFTOut_C "Behaviour control mask / Behaviour control masks of check DFC_ComAYCFTOut" VALUE 0x804D9004 Val_Wu16 65535.00 DFES_OneToOne 0.00 65535.00 FORMAT "%8.2" /end CHARACTERISTIC
/begin CHARACTERISTIC DFC_CtlMsk.DFC_ComAYCGChksum_C "Behaviour control mask / Behaviour control masks of check DFC_ComAYCGChksum" VALUE 0x804D9006 Val_Wu16 65535.00 DFES_OneToOne 0.00 65535.00 FORMAT "%8.2" /end CHARACTERISTIC
/begin CHARACTERISTIC DFC_CtlMsk.DFC_ComAYCGRingCnt_C "Behaviour control mask / Behaviour control masks of check DFC_ComAYCGRingCnt" VALUE 0x804D9008 Val_Wu16 65535.00 DFES_OneToOne 0.00 65535.00 FORMAT "%8.2" /end CHARACTERISTIC
/begin CHARACTERISTIC DFC_CtlMsk.DFC_ComAYCGTOut_C "Behaviour control mask / Behaviour control masks of check DFC_ComAYCGTOut" VALUE 0x804D900A Val_Wu16 65535.00 DFES_OneToOne 0.00 65535.00 FORMAT "%8.2" /end CHARACTERISTIC
/begin CHARACTERISTIC DFC_CtlMsk.DFC_ComAYCIChkSum_C "Behaviour control mask / Behaviour control masks of check DFC_ComAYCIChkSum" VALUE 0x804D900C Val_Wu16 65535.00 DFES_OneToOne 0.00 65535.00 FORMAT "%8.2" /end CHARACTERISTIC
/begin CHARACTERISTIC DFC_CtlMsk.DFC_ComAYCIRingCnt_C "Behaviour control mask / Behaviour control masks of check DFC_ComAYCIRingCnt" VALUE 0x804D900E Val_Wu16 65535.00 DFES_OneToOne 0.00 65535.00 FORMAT "%8.2" /end CHARACTERISTIC
/begin CHARACTERISTIC DFC_CtlMsk.DFC_ComAYCITOut_C "Behaviour control mask / Behaviour control masks of check DFC_ComAYCITOut" VALUE 0x804D9010 Val_Wu16 65535.00 DFES_OneToOne 0.00 65535.00 FORMAT "%8.2" /end CHARACTERISTIC
/begin CHARACTERISTIC DFC_CtlMsk.DFC_ComBCM1ChkSum_C "Behaviour control mask / Behaviour control masks of check DFC_ComBCM1ChkSum" VALUE 0x804D9012 Val_Wu16 65535.00 DFES_OneToOne 0.00 65535.00 FORMAT "%8.2" /end CHARACTERISTIC
/begin CHARACTERISTIC DFC_CtlMsk.DFC_ComBCM1RingCnt_C "Behaviour control mask / Behaviour control masks of check DFC_ComBCM1RingCnt" VALUE 0x804D9014 Val_Wu16 65535.00 DFES_OneToOne 0.00 65535.00 FORMAT "%8.2" /end CHARACTERISTIC
/begin CHARACTERISTIC DFC_CtlMsk.DFC_ComBCM1TOut_C "Behaviour control mask / Behaviour control masks of check DFC_ComBCM1TOut" VALUE 0x804D9016 Val_Wu16 65535.00 DFES_OneToOne 0.00 65535.00 FORMAT "%8.2" /end CHARACTERISTIC
/begin CHARACTERISTIC DFC_CtlMsk.DFC_ComCANABusOffErr_C "Behaviour control mask / Behaviour control masks of check DFC_ComCANABusOffErr" VALUE 0x804D9018 Val_Wu16 65535.00 DFES_OneToOne 0.00 65535.00 FORMAT "%8.2" /end CHARACTERISTIC
/begin CHARACTERISTIC DFC_CtlMsk.DFC_ComCANBBusOffErr_C "Behaviour control mask / Behaviour control masks of check DFC_ComCANBBusOffErr" VALUE 0x804D901A Val_Wu16 65535.00 DFES_OneToOne 0.00 65535.00 FORMAT "%8.2" /end CHARACTERISTIC
/begin CHARACTERISTIC DFC_CtlMsk.DFC_ComCANCBusOffErr_C "Behaviour control mask / Behaviour control masks of check DFC_ComCANCBusOffErr" VALUE 0x804D901C Val_Wu16 65535.00 DFES_OneToOne 0.00 65535.00 FORMAT "%8.2" /end CHARACTERISTIC
/begin CHARACTERISTIC DFC_CtlMsk.DFC_ComCGW1ChkSum_C "Behaviour control mask / Behaviour control masks of check DFC_ComCGW1ChkSum" VALUE 0x804D901E Val_Wu16 65535.00 DFES_OneToOne 0.00 65535.00 FORMAT "%8.2" /end CHARACTERISTIC
/begin CHARACTERISTIC DFC_CtlMsk.DFC_ComCGW1RingCnt_C "Behaviour control mask / Behaviour control masks of check DFC_ComCGW1RingCnt" VALUE 0x804D9020 Val_Wu16 65535.00 DFES_OneToOne 0.00 65535.00 FORMAT "%8.2" /end CHARACTERISTIC
/begin CHARACTERISTIC DFC_CtlMsk.DFC_ComCGW1TOut_C "Behaviour control mask / Behaviour control masks of check DFC_ComCGW1TOut" VALUE 0x804D9022 Val_Wu16 65535.00 DFES_OneToOne 0.00 65535.00 FORMAT "%8.2" /end CHARACTERISTIC
/begin CHARACTERISTIC DFC_CtlMsk.DFC_ComConvBoostErr_C "Behaviour control mask / Behaviour control masks of check DFC_ComConvBoostErr" VALUE 0x804D9024 Val_Wu16 65535.00 DFES_OneToOne 0.00 65535.00 FORMAT "%8.2" /end CHARACTERISTIC
/begin CHARACTERISTIC DFC_CtlMsk.DFC_ComConvSlipErr_C "Behaviour control mask / Behaviour control masks of check DFC_ComConvSlipErr" VALUE 0x804D9026 Val_Wu16 65535.00 DFES_OneToOne 0.00 65535.00 FORMAT "%8.2" /end CHARACTERISTIC
/begin CHARACTERISTIC DFC_CtlMsk.DFC_ComDCDCPrfmncErr_C "Behaviour control mask / Behaviour control masks of check DFC_ComDCDCPrfmncErr" VALUE 0x804D9028 Val_Wu16 65535.00 DFES_OneToOne 0.00 65535.00 FORMAT "%8.2" /end CHARACTERISTIC
/begin CHARACTERISTIC DFC_CtlMsk.DFC_ComDCDCTempWarn_C "Behaviour control mask / Behaviour control masks of check DFC_ComDCDCTempWarn" VALUE 0x804D902A Val_Wu16 65535.00 DFES_OneToOne 0.00 65535.00 FORMAT "%8.2" /end CHARACTERISTIC
/begin CHARACTERISTIC DFC_CtlMsk.DFC_ComEAT10Chksum_C "Behaviour control mask / Behaviour control masks of check DFC_ComEAT10Chksum" VALUE 0x804D902C Val_Wu16 65535.00 DFES_OneToOne 0.00 65535.00 FORMAT "%8.2" /end CHARACTERISTIC
/begin CHARACTERISTIC DFC_CtlMsk.DFC_ComEAT10RingCnt_C "Behaviour control mask / Behaviour control masks of check DFC_ComEAT10RingCnt" VALUE 0x804D902E Val_Wu16 65535.00 DFES_OneToOne 0.00 65535.00 FORMAT "%8.2" /end CHARACTERISTIC
/begin CHARACTERISTIC DFC_CtlMsk.DFC_ComEAT10TOut_C "Behaviour control mask / Behaviour control masks of check DFC_ComEAT10TOut" VALUE 0x804D9030 Val_Wu16 65535.00 DFES_OneToOne 0.00 65535.00 FORMAT "%8.2" /end CHARACTERISTIC
/begin CHARACTERISTIC DFC_CtlMsk.DFC_ComEAT11ChkSum_C "Behaviour control mask / Behaviour control masks of check DFC_ComEAT11ChkSum" VALUE 0x804D9032 Val_Wu16 65535.00 DFES_OneToOne 0.00 65535.00 FORMAT "%8.2" /end CHARACTERISTIC
/begin CHARACTERISTIC DFC_CtlMsk.DFC_ComEAT11RingCnt_C "Behaviour control mask / Behaviour control masks of check DFC_ComEAT11RingCnt" VALUE 0x804D9034 Val_Wu16 65535.00 DFES_OneToOne 0.00 65535.00 FORMAT "%8.2" /end CHARACTERISTIC
/begin CHARACTERISTIC DFC_CtlMsk.DFC_ComEAT11TOut_C "Behaviour control mask / Behaviour control masks of check DFC_ComEAT11TOut" VALUE 0x804D9036 Val_Wu16 65535.00 DFES_OneToOne 0.00 65535.00 FORMAT "%8.2" /end CHARACTERISTIC
/begin CHARACTERISTIC DFC_CtlMsk.DFC_ComEAT12ChkSum_C "Behaviour control mask / Behaviour control masks of check DFC_ComEAT12ChkSum" VALUE 0x804D9038 Val_Wu16 65535.00 DFES_OneToOne 0.00 65535.00 FORMAT "%8.2" /end CHARACTERISTIC
/begin CHARACTERISTIC DFC_CtlMsk.DFC_ComEAT12RingCnt_C "Behaviour control mask / Behaviour control masks of check DFC_ComEAT12RingCnt" VALUE 0x804D903A Val_Wu16 65535.00 DFES_OneToOne 0.00 65535.00 FORMAT "%8.2" /end CHARACTERISTIC
/begin CHARACTERISTIC DFC_CtlMsk.DFC_ComEAT12TOut_C "Behaviour control mask / Behaviour control masks of check DFC_ComEAT12TOut" VALUE 0x804D903C Val_Wu16 65535.00 DFES_OneToOne 0.00 65535.00 FORMAT "%8.2" /end CHARACTERISTIC
/begin CHARACTERISTIC DFC_CtlMsk.DFC_ComEAT13ChkSum_C "Behaviour control mask / Behaviour control masks of check DFC_ComEAT13ChkSum" VALUE 0x804D903E Val_Wu16 65535.00 DFES_OneToOne 0.00 65535.00 FORMAT "%8.2" /end CHARACTERISTIC
/begin CHARACTERISTIC DFC_CtlMsk.DFC_ComEAT13RingCnt_C "Behaviour control mask / Behaviour control masks of check DFC_ComEAT13RingCnt" VALUE 0x804D9040 Val_Wu16 65535.00 DFES_OneToOne 0.00 65535.00 FORMAT "%8.2" /end CHARACTERISTIC
/begin CHARACTERISTIC DFC_CtlMsk.DFC_ComEAT13TOut_C "Behaviour control mask / Behaviour control masks of check DFC_ComEAT13TOut" VALUE 0x804D9042 Val_Wu16 65535.00 DFES_OneToOne 0.00 65535.00 FORMAT "%8.2" /end CHARACTERISTIC
/begin CHARACTERISTIC DFC_CtlMsk.DFC_ComEAT1Chksum_C "Behaviour control mask / Behaviour control masks of check DFC_ComEAT1Chksum" VALUE 0x804D9044 Val_Wu16 65535.00 DFES_OneToOne 0.00 65535.00 FORMAT "%8.2" /end CHARACTERISTIC
/begin CHARACTERISTIC DFC_CtlMsk.DFC_ComEAT1RingCnt_C "Behaviour control mask / Behaviour control masks of check DFC_ComEAT1RingCnt" VALUE 0x804D9046 Val_Wu16 65535.00 DFES_OneToOne 0.00 65535.00 FORMAT "%8.2" /end CHARACTERISTIC
/begin CHARACTERISTIC DFC_CtlMsk.DFC_ComEAT1TOut_C "Behaviour control mask / Behaviour control masks of check DFC_ComEAT1TOut" VALUE 0x804D9048 Val_Wu16 65535.00 DFES_OneToOne 0.00 65535.00 FORMAT "%8.2" /end CHARACTERISTIC
/begin CHARACTERISTIC DFC_CtlMsk.DFC_ComEAT2ChkSum_C "Behaviour control mask / Behaviour control masks of check DFC_ComEAT2ChkSum" VALUE 0x804D904A Val_Wu16 65535.00 DFES_OneToOne 0.00 65535.00 FORMAT "%8.2" /end CHARACTERISTIC
/begin CHARACTERISTIC DFC_CtlMsk.DFC_ComEAT2RingCnt_C "Behaviour control mask / Behaviour control masks of check DFC_ComEAT2RingCnt" VALUE 0x804D904C Val_Wu16 65535.00 DFES_OneToOne 0.00 65535.00 FORMAT "%8.2" /end CHARACTERISTIC
/begin CHARACTERISTIC DFC_CtlMsk.DFC_ComEAT2TOut_C "Behaviour control mask / Behaviour control masks of check DFC_ComEAT2TOut" VALUE 0x804D904E Val_Wu16 65535.00 DFES_OneToOne 0.00 65535.00 FORMAT "%8.2" /end CHARACTERISTIC
/begin CHARACTERISTIC DFC_CtlMsk.DFC_ComEAT4ChkSum_C "Behaviour control mask / Behaviour control masks of check DFC_ComEAT4ChkSum" VALUE 0x804D9050 Val_Wu16 65535.00 DFES_OneToOne 0.00 65535.00 FORMAT "%8.2" /end CHARACTERISTIC
/begin CHARACTERISTIC DFC_CtlMsk.DFC_ComEAT4RingCnt_C "Behaviour control mask / Behaviour control masks of check DFC_ComEAT4RingCnt" VALUE 0x804D9052 Val_Wu16 65535.00 DFES_OneToOne 0.00 65535.00 FORMAT "%8.2" /end CHARACTERISTIC
/begin CHARACTERISTIC DFC_CtlMsk.DFC_ComEAT4TOut_C "Behaviour control mask / Behaviour control masks of check DFC_ComEAT4TOut" VALUE 0x804D9054 Val_Wu16 65535.00 DFES_OneToOne 0.00 65535.00 FORMAT "%8.2" /end CHARACTERISTIC
/begin CHARACTERISTIC DFC_CtlMsk.DFC_ComEAT6Chksum_C "Behaviour control mask / Behaviour control masks of check DFC_ComEAT6Chksum" VALUE 0x804D9056 Val_Wu16 65535.00 DFES_OneToOne 0.00 65535.00 FORMAT "%8.2" /end CHARACTERISTIC
/begin CHARACTERISTIC DFC_CtlMsk.DFC_ComEAT6RingCnt_C "Behaviour control mask / Behaviour control masks of check DFC_ComEAT6RingCnt" VALUE 0x804D9058 Val_Wu16 65535.00 DFES_OneToOne 0.00 65535.00 FORMAT "%8.2" /end CHARACTERISTIC
/begin CHARACTERISTIC DFC_CtlMsk.DFC_ComEAT6TOut_C "Behaviour control mask / Behaviour control masks of check DFC_ComEAT6TOut" VALUE 0x804D905A Val_Wu16 65535.00 DFES_OneToOne 0.00 65535.00 FORMAT "%8.2" /end CHARACTERISTIC
/begin CHARACTERISTIC DFC_CtlMsk.DFC_ComEAT7Chksum_C "Behaviour control mask / Behaviour control masks of check DFC_ComEAT7Chksum" VALUE 0x804D905C Val_Wu16 65535.00 DFES_OneToOne 0.00 65535.00 FORMAT "%8.2" /end CHARACTERISTIC
/begin CHARACTERISTIC DFC_CtlMsk.DFC_ComEAT7RingCnt_C "Behaviour control mask / Behaviour control masks of check DFC_ComEAT7RingCnt" VALUE 0x804D905E Val_Wu16 65535.00 DFES_OneToOne 0.00 65535.00 FORMAT "%8.2" /end CHARACTERISTIC
/begin CHARACTERISTIC DFC_CtlMsk.DFC_ComEAT7TOut_C "Behaviour control mask / Behaviour control masks of check DFC_ComEAT7TOut" VALUE 0x804D9060 Val_Wu16 65535.00 DFES_OneToOne 0.00 65535.00 FORMAT "%8.2" /end CHARACTERISTIC
/begin CHARACTERISTIC DFC_CtlMsk.DFC_ComEAT8Chksum_C "Behaviour control mask / Behaviour control masks of check DFC_ComEAT8Chksum" VALUE 0x804D9062 Val_Wu16 65535.00 DFES_OneToOne 0.00 65535.00 FORMAT "%8.2" /end CHARACTERISTIC
/begin CHARACTERISTIC DFC_CtlMsk.DFC_ComEAT8RingCnt_C "Behaviour control mask / Behaviour control masks of check DFC_ComEAT8RingCnt" VALUE 0x804D9064 Val_Wu16 65535.00 DFES_OneToOne 0.00 65535.00 FORMAT "%8.2" /end CHARACTERISTIC
/begin CHARACTERISTIC DFC_CtlMsk.DFC_ComEAT8TOut_C "Behaviour control mask / Behaviour control masks of check DFC_ComEAT8TOut" VALUE 0x804D9066 Val_Wu16 65535.00 DFES_OneToOne 0.00 65535.00 FORMAT "%8.2" /end CHARACTERISTIC
/begin CHARACTERISTIC DFC_CtlMsk.DFC_ComEATAChksum_C "Behaviour control mask / Behaviour control masks of check DFC_ComEATAChksum" VALUE 0x804D9068 Val_Wu16 65535.00 DFES_OneToOne 0.00 65535.00 FORMAT "%8.2" /end CHARACTERISTIC
/begin CHARACTERISTIC DFC_CtlMsk.DFC_ComEATARingCnt_C "Behaviour control mask / Behaviour control masks of check DFC_ComEATARingCnt" VALUE 0x804D906A Val_Wu16 65535.00 DFES_OneToOne 0.00 65535.00 FORMAT "%8.2" /end CHARACTERISTIC
/begin CHARACTERISTIC DFC_CtlMsk.DFC_ComEATATOut_C "Behaviour control mask / Behaviour control masks of check DFC_ComEATATOut" VALUE 0x804D906C Val_Wu16 65535.00 DFES_OneToOne 0.00 65535.00 FORMAT "%8.2" /end CHARACTERISTIC
/begin CHARACTERISTIC DFC_CtlMsk.DFC_ComEATBChkSum_C "Behaviour control mask / Behaviour control masks of check DFC_ComEATBChkSum" VALUE 0x804D906E Val_Wu16 65535.00 DFES_OneToOne 0.00 65535.00 FORMAT "%8.2" /end CHARACTERISTIC
/begin CHARACTERISTIC DFC_CtlMsk.DFC_ComEATBRingCnt_C "Behaviour control mask / Behaviour control masks of check DFC_ComEATBRingCnt" VALUE 0x804D9070 Val_Wu16 65535.00 DFES_OneToOne 0.00 65535.00 FORMAT "%8.2" /end CHARACTERISTIC
/begin CHARACTERISTIC DFC_CtlMsk.DFC_ComEATBTOut_C "Behaviour control mask / Behaviour control masks of check DFC_ComEATBTOut" VALUE 0x804D9072 Val_Wu16 65535.00 DFES_OneToOne 0.00 65535.00 FORMAT "%8.2" /end CHARACTERISTIC
/begin CHARACTERISTIC DFC_CtlMsk.DFC_ComEATCChksum_C "Behaviour control mask / Behaviour control masks of check DFC_ComEATCChksum" VALUE 0x804D9074 Val_Wu16 65535.00 DFES_OneToOne 0.00 65535.00 FORMAT "%8.2" /end CHARACTERISTIC
/begin CHARACTERISTIC DFC_CtlMsk.DFC_ComEATCRingCnt_C "Behaviour control mask / Behaviour control masks of check DFC_ComEATCRingCnt" VALUE 0x804D9076 Val_Wu16 65535.00 DFES_OneToOne 0.00 65535.00 FORMAT "%8.2" /end CHARACTERISTIC
/begin CHARACTERISTIC DFC_CtlMsk.DFC_ComEATCTOut_C "Behaviour control mask / Behaviour control masks of check DFC_ComEATCTOut" VALUE 0x804D9078 Val_Wu16 65535.00 DFES_OneToOne 0.00 65535.00 FORMAT "%8.2" /end CHARACTERISTIC
/begin CHARACTERISTIC DFC_CtlMsk.DFC_ComEPBBChkSum_C "Behaviour control mask / Behaviour control masks of check DFC_ComEPBBChkSum" VALUE 0x804D907A Val_Wu16 65535.00 DFES_OneToOne 0.00 65535.00 FORMAT "%8.2" /end CHARACTERISTIC
/begin CHARACTERISTIC DFC_CtlMsk.DFC_ComEPBBRingCnt_C "Behaviour control mask / Behaviour control masks of check DFC_ComEPBBRingCnt" VALUE 0x804D907C Val_Wu16 65535.00 DFES_OneToOne 0.00 65535.00 FORMAT "%8.2" /end CHARACTERISTIC
/begin CHARACTERISTIC DFC_CtlMsk.DFC_ComEPBBTOut_C "Behaviour control mask / Behaviour control masks of check DFC_ComEPBBTOut" VALUE 0x804D907E Val_Wu16 65535.00 DFES_OneToOne 0.00 65535.00 FORMAT "%8.2" /end CHARACTERISTIC
/begin CHARACTERISTIC DFC_CtlMsk.DFC_ComEPBChksum_C "Behaviour control mask / Behaviour control masks of check DFC_ComEPBChksum" VALUE 0x804D9080 Val_Wu16 65535.00 DFES_OneToOne 0.00 65535.00 FORMAT "%8.2" /end CHARACTERISTIC
/begin CHARACTERISTIC DFC_CtlMsk.DFC_ComEPBTOut_C "Behaviour control mask / Behaviour control masks of check DFC_ComEPBTOut" VALUE 0x804D9082 Val_Wu16 65535.00 DFES_OneToOne 0.00 65535.00 FORMAT "%8.2" /end CHARACTERISTIC
/begin CHARACTERISTIC DFC_CtlMsk.DFC_ComEPBctRing_C "Behaviour control mask / Behaviour control masks of check DFC_ComEPBctRing" VALUE 0x804D9084 Val_Wu16 65535.00 DFES_OneToOne 0.00 65535.00 FORMAT "%8.2" /end CHARACTERISTIC
/begin CHARACTERISTIC DFC_CtlMsk.DFC_ComEPS1Chksum_C "Behaviour control mask / Behaviour control masks of check DFC_ComEPS1Chksum" VALUE 0x804D9086 Val_Wu16 65535.00 DFES_OneToOne 0.00 65535.00 FORMAT "%8.2" /end CHARACTERISTIC
/begin CHARACTERISTIC DFC_CtlMsk.DFC_ComEPS1RingCnt_C "Behaviour control mask / Behaviour control masks of check DFC_ComEPS1RingCnt" VALUE 0x804D9088 Val_Wu16 65535.00 DFES_OneToOne 0.00 65535.00 FORMAT "%8.2" /end CHARACTERISTIC
/begin CHARACTERISTIC DFC_CtlMsk.DFC_ComEPS1TOut_C "Behaviour control mask / Behaviour control masks of check DFC_ComEPS1TOut" VALUE 0x804D908A Val_Wu16 65535.00 DFES_OneToOne 0.00 65535.00 FORMAT "%8.2" /end CHARACTERISTIC
/begin CHARACTERISTIC DFC_CtlMsk.DFC_ComEngCanRxErr_C "Behaviour control mask / Behaviour control masks of check DFC_ComEngCanRxErr" VALUE 0x804D908C Val_Wu16 65535.00 DFES_OneToOne 0.00 65535.00 FORMAT "%8.2" /end CHARACTERISTIC
/begin CHARACTERISTIC DFC_CtlMsk.DFC_ComGrvySnsrErr_C "Behaviour control mask / Behaviour control masks of check DFC_ComGrvySnsrErr" VALUE 0x804D908E Val_Wu16 65535.00 DFES_OneToOne 0.00 65535.00 FORMAT "%8.2" /end CHARACTERISTIC
/begin CHARACTERISTIC DFC_CtlMsk.DFC_ComGwIMG1ChkSum_C "Behaviour control mask / Behaviour control masks of check DFC_ComGwIMG1ChkSum" VALUE 0x804D9090 Val_Wu16 65535.00 DFES_OneToOne 0.00 65535.00 FORMAT "%8.2" /end CHARACTERISTIC
/begin CHARACTERISTIC DFC_CtlMsk.DFC_ComGwIMG1RingCnt_C "Behaviour control mask / Behaviour control masks of check DFC_ComGwIMG1RingCnt" VALUE 0x804D9092 Val_Wu16 65535.00 DFES_OneToOne 0.00 65535.00 FORMAT "%8.2" /end CHARACTERISTIC
/begin CHARACTERISTIC DFC_CtlMsk.DFC_ComGwIMG1TOut_C "Behaviour control mask / Behaviour control masks of check DFC_ComGwIMG1TOut" VALUE 0x804D9094 Val_Wu16 65535.00 DFES_OneToOne 0.00 65535.00 FORMAT "%8.2" /end CHARACTERISTIC
/begin CHARACTERISTIC DFC_CtlMsk.DFC_ComGwIMG3ChkSum_C "Behaviour control mask / Behaviour control masks of check DFC_ComGwIMG3ChkSum" VALUE 0x804D9096 Val_Wu16 65535.00 DFES_OneToOne 0.00 65535.00 FORMAT "%8.2" /end CHARACTERISTIC
/begin CHARACTERISTIC DFC_CtlMsk.DFC_ComGwIMG3RingCnt_C "Behaviour control mask / Behaviour control masks of check DFC_ComGwIMG3RingCnt" VALUE 0x804D9098 Val_Wu16 65535.00 DFES_OneToOne 0.00 65535.00 FORMAT "%8.2" /end CHARACTERISTIC
/begin CHARACTERISTIC DFC_CtlMsk.DFC_ComGwIMG3TOut_C "Behaviour control mask / Behaviour control masks of check DFC_ComGwIMG3TOut" VALUE 0x804D909A Val_Wu16 65535.00 DFES_OneToOne 0.00 65535.00 FORMAT "%8.2" /end CHARACTERISTIC
/begin CHARACTERISTIC DFC_CtlMsk.DFC_ComGwIMG4ChkSum_C "Behaviour control mask / Behaviour control masks of check DFC_ComGwIMG4ChkSum" VALUE 0x804D909C Val_Wu16 65535.00 DFES_OneToOne 0.00 65535.00 FORMAT "%8.2" /end CHARACTERISTIC
/begin CHARACTERISTIC DFC_CtlMsk.DFC_ComGwIMG4RingCnt_C "Behaviour control mask / Behaviour control masks of check DFC_ComGwIMG4RingCnt" VALUE 0x804D909E Val_Wu16 65535.00 DFES_OneToOne 0.00 65535.00 FORMAT "%8.2" /end CHARACTERISTIC
/begin CHARACTERISTIC DFC_CtlMsk.DFC_ComGwIMG4TOut_C "Behaviour control mask / Behaviour control masks of check DFC_ComGwIMG4TOut" VALUE 0x804D90A0 Val_Wu16 65535.00 DFES_OneToOne 0.00 65535.00 FORMAT "%8.2" /end CHARACTERISTIC
/begin CHARACTERISTIC DFC_CtlMsk.DFC_ComGwIMG5ChkSum_C "Behaviour control mask / Behaviour control masks of check DFC_ComGwIMG5ChkSum" VALUE 0x804D90A2 Val_Wu16 65535.00 DFES_OneToOne 0.00 65535.00 FORMAT "%8.2" /end CHARACTERISTIC
/begin CHARACTERISTIC DFC_CtlMsk.DFC_ComGwIMG5RingCnt_C "Behaviour control mask / Behaviour control masks of check DFC_ComGwIMG5RingCnt" VALUE 0x804D90A4 Val_Wu16 65535.00 DFES_OneToOne 0.00 65535.00 FORMAT "%8.2" /end CHARACTERISTIC
/begin CHARACTERISTIC DFC_CtlMsk.DFC_ComGwIMG5TOut_C "Behaviour control mask / Behaviour control masks of check DFC_ComGwIMG5TOut" VALUE 0x804D90A6 Val_Wu16 65535.00 DFES_OneToOne 0.00 65535.00 FORMAT "%8.2" /end CHARACTERISTIC
/begin CHARACTERISTIC DFC_CtlMsk.DFC_ComGwIMG6ChkSum_C "Behaviour control mask / Behaviour control masks of check DFC_ComGwIMG6ChkSum" VALUE 0x804D90A8 Val_Wu16 65535.00 DFES_OneToOne 0.00 65535.00 FORMAT "%8.2" /end CHARACTERISTIC
/begin CHARACTERISTIC DFC_CtlMsk.DFC_ComGwIMG6RingCnt_C "Behaviour control mask / Behaviour control masks of check DFC_ComGwIMG6RingCnt" VALUE 0x804D90AA Val_Wu16 65535.00 DFES_OneToOne 0.00 65535.00 FORMAT "%8.2" /end CHARACTERISTIC
/begin CHARACTERISTIC DFC_CtlMsk.DFC_ComGwIMG6TOut_C "Behaviour control mask / Behaviour control masks of check DFC_ComGwIMG6TOut" VALUE 0x804D90AC Val_Wu16 65535.00 DFES_OneToOne 0.00 65535.00 FORMAT "%8.2" /end CHARACTERISTIC
/begin CHARACTERISTIC DFC_CtlMsk.DFC_ComIDASBChksum_C "Behaviour control mask / Behaviour control masks of check DFC_ComIDASBChksum" VALUE 0x804D90AE Val_Wu16 65535.00 DFES_OneToOne 0.00 65535.00 FORMAT "%8.2" /end CHARACTERISTIC
/begin CHARACTERISTIC DFC_CtlMsk.DFC_ComIDASBRingCnt_C "Behaviour control mask / Behaviour control masks of check DFC_ComIDASBRingCnt" VALUE 0x804D90B0 Val_Wu16 65535.00 DFES_OneToOne 0.00 65535.00 FORMAT "%8.2" /end CHARACTERISTIC
/begin CHARACTERISTIC DFC_CtlMsk.DFC_ComIDASBTOut_C "Behaviour control mask / Behaviour control masks of check DFC_ComIDASBTOut" VALUE 0x804D90B2 Val_Wu16 65535.00 DFES_OneToOne 0.00 65535.00 FORMAT "%8.2" /end CHARACTERISTIC
/begin CHARACTERISTIC DFC_CtlMsk.DFC_ComIMGMILReq_C "Behaviour control mask / Behaviour control masks of check DFC_ComIMGMILReq" VALUE 0x804D90B4 Val_Wu16 65535.00 DFES_OneToOne 0.00 65535.00 FORMAT "%8.2" /end CHARACTERISTIC
/begin CHARACTERISTIC DFC_CtlMsk.DFC_ComISSPrms_C "Behaviour control mask / Behaviour control masks of check DFC_ComISSPrms" VALUE 0x804D90B6 Val_Wu16 65535.00 DFES_OneToOne 0.00 65535.00 FORMAT "%8.2" /end CHARACTERISTIC
/begin CHARACTERISTIC DFC_CtlMsk.DFC_ComMETAChksum_C "Behaviour control mask / Behaviour control masks of check DFC_ComMETAChksum" VALUE 0x804D90B8 Val_Wu16 65535.00 DFES_OneToOne 0.00 65535.00 FORMAT "%8.2" /end CHARACTERISTIC
/begin CHARACTERISTIC DFC_CtlMsk.DFC_ComMETAChksumPstDrv_C "Behaviour control mask / Behaviour control masks of check DFC_ComMETAChksumPstDrv" VALUE 0x804D90BA Val_Wu16 65535.00 DFES_OneToOne 0.00 65535.00 FORMAT "%8.2" /end CHARACTERISTIC
/begin CHARACTERISTIC DFC_CtlMsk.DFC_ComMETARingCnt_C "Behaviour control mask / Behaviour control masks of check DFC_ComMETARingCnt" VALUE 0x804D90BC Val_Wu16 65535.00 DFES_OneToOne 0.00 65535.00 FORMAT "%8.2" /end CHARACTERISTIC
/begin CHARACTERISTIC DFC_CtlMsk.DFC_ComMETARingCntPstDrv_C "Behaviour control mask / Behaviour control masks of check DFC_ComMETARingCntPstDrv" VALUE 0x804D90BE Val_Wu16 65535.00 DFES_OneToOne 0.00 65535.00 FORMAT "%8.2" /end CHARACTERISTIC
/begin CHARACTERISTIC DFC_CtlMsk.DFC_ComMETATOut_C "Behaviour control mask / Behaviour control masks of check DFC_ComMETATOut" VALUE 0x804D90C0 Val_Wu16 65535.00 DFES_OneToOne 0.00 65535.00 FORMAT "%8.2" /end CHARACTERISTIC
/begin CHARACTERISTIC DFC_CtlMsk.DFC_ComMETATOutPstDrv_C "Behaviour control mask / Behaviour control masks of check DFC_ComMETATOutPstDrv" VALUE 0x804D90C2 Val_Wu16 65535.00 DFES_OneToOne 0.00 65535.00 FORMAT "%8.2" /end CHARACTERISTIC
/begin CHARACTERISTIC DFC_CtlMsk.DFC_ComMETCChksum_C "Behaviour control mask / Behaviour control masks of check DFC_ComMETCChksum" VALUE 0x804D90C4 Val_Wu16 65535.00 DFES_OneToOne 0.00 65535.00 FORMAT "%8.2" /end CHARACTERISTIC
/begin CHARACTERISTIC DFC_CtlMsk.DFC_ComMETCRingCnt_C "Behaviour control mask / Behaviour control masks of check DFC_ComMETCRingCnt" VALUE 0x804D90C6 Val_Wu16 65535.00 DFES_OneToOne 0.00 65535.00 FORMAT "%8.2" /end CHARACTERISTIC
/begin CHARACTERISTIC DFC_CtlMsk.DFC_ComMETCTOut_C "Behaviour control mask / Behaviour control masks of check DFC_ComMETCTOut" VALUE 0x804D90C8 Val_Wu16 65535.00 DFES_OneToOne 0.00 65535.00 FORMAT "%8.2" /end CHARACTERISTIC
/begin CHARACTERISTIC DFC_CtlMsk.DFC_ComMETDChksum_C "Behaviour control mask / Behaviour control masks of check DFC_ComMETDChksum" VALUE 0x804D90CA Val_Wu16 65535.00 DFES_OneToOne 0.00 65535.00 FORMAT "%8.2" /end CHARACTERISTIC
/begin CHARACTERISTIC DFC_CtlMsk.DFC_ComMETDRingCnt_C "Behaviour control mask / Behaviour control masks of check DFC_ComMETDRingCnt" VALUE 0x804D90CC Val_Wu16 65535.00 DFES_OneToOne 0.00 65535.00 FORMAT "%8.2" /end CHARACTERISTIC
/begin CHARACTERISTIC DFC_CtlMsk.DFC_ComMETDTOut_C "Behaviour control mask / Behaviour control masks of check DFC_ComMETDTOut" VALUE 0x804D90CE Val_Wu16 65535.00 DFES_OneToOne 0.00 65535.00 FORMAT "%8.2" /end CHARACTERISTIC
/begin CHARACTERISTIC DFC_CtlMsk.DFC_ComMETE2Chksum_C "Behaviour control mask / Behaviour control masks of check DFC_ComMETE2Chksum" VALUE 0x804D90D0 Val_Wu16 65535.00 DFES_OneToOne 0.00 65535.00 FORMAT "%8.2" /end CHARACTERISTIC
/begin CHARACTERISTIC DFC_CtlMsk.DFC_ComMETE2RingCnt_C "Behaviour control mask / Behaviour control masks of check DFC_ComMETE2RingCnt" VALUE 0x804D90D2 Val_Wu16 65535.00 DFES_OneToOne 0.00 65535.00 FORMAT "%8.2" /end CHARACTERISTIC
/begin CHARACTERISTIC DFC_CtlMsk.DFC_ComMETE2TOut_C "Behaviour control mask / Behaviour control masks of check DFC_ComMETE2TOut" VALUE 0x804D90D4 Val_Wu16 65535.00 DFES_OneToOne 0.00 65535.00 FORMAT "%8.2" /end CHARACTERISTIC
/begin CHARACTERISTIC DFC_CtlMsk.DFC_ComMETFChksum_C "Behaviour control mask / Behaviour control masks of check DFC_ComMETFChksum" VALUE 0x804D90D6 Val_Wu16 65535.00 DFES_OneToOne 0.00 65535.00 FORMAT "%8.2" /end CHARACTERISTIC
/begin CHARACTERISTIC DFC_CtlMsk.DFC_ComMETFRingCnt_C "Behaviour control mask / Behaviour control masks of check DFC_ComMETFRingCnt" VALUE 0x804D90D8 Val_Wu16 65535.00 DFES_OneToOne 0.00 65535.00 FORMAT "%8.2" /end CHARACTERISTIC
/begin CHARACTERISTIC DFC_CtlMsk.DFC_ComMETFTOut_C "Behaviour control mask / Behaviour control masks of check DFC_ComMETFTOut" VALUE 0x804D90DA Val_Wu16 65535.00 DFES_OneToOne 0.00 65535.00 FORMAT "%8.2" /end CHARACTERISTIC
/begin CHARACTERISTIC DFC_CtlMsk.DFC_ComMETGChksum_C "Behaviour control mask / Behaviour control masks of check DFC_ComMETGChksum" VALUE 0x804D90DC Val_Wu16 65535.00 DFES_OneToOne 0.00 65535.00 FORMAT "%8.2" /end CHARACTERISTIC
/begin CHARACTERISTIC DFC_CtlMsk.DFC_ComMETGRingCnt_C "Behaviour control mask / Behaviour control masks of check DFC_ComMETGRingCnt" VALUE 0x804D90DE Val_Wu16 65535.00 DFES_OneToOne 0.00 65535.00 FORMAT "%8.2" /end CHARACTERISTIC
/begin CHARACTERISTIC DFC_CtlMsk.DFC_ComMETGTOut_C "Behaviour control mask / Behaviour control masks of check DFC_ComMETGTOut" VALUE 0x804D90E0 Val_Wu16 65535.00 DFES_OneToOne 0.00 65535.00 FORMAT "%8.2" /end CHARACTERISTIC
/begin CHARACTERISTIC DFC_CtlMsk.DFC_ComMETH2Chksum_C "Behaviour control mask / Behaviour control masks of check DFC_ComMETH2Chksum" VALUE 0x804D90E2 Val_Wu16 65535.00 DFES_OneToOne 0.00 65535.00 FORMAT "%8.2" /end CHARACTERISTIC
/begin CHARACTERISTIC DFC_CtlMsk.DFC_ComMETH2RingCnt_C "Behaviour control mask / Behaviour control masks of check DFC_ComMETH2RingCnt" VALUE 0x804D90E4 Val_Wu16 65535.00 DFES_OneToOne 0.00 65535.00 FORMAT "%8.2" /end CHARACTERISTIC
/begin CHARACTERISTIC DFC_CtlMsk.DFC_ComMETH2TOut_C "Behaviour control mask / Behaviour control masks of check DFC_ComMETH2TOut" VALUE 0x804D90E6 Val_Wu16 65535.00 DFES_OneToOne 0.00 65535.00 FORMAT "%8.2" /end CHARACTERISTIC
/begin CHARACTERISTIC DFC_CtlMsk.DFC_ComMETHChksum_C "Behaviour control mask / Behaviour control masks of check DFC_ComMETHChksum" VALUE 0x804D90E8 Val_Wu16 65535.00 DFES_OneToOne 0.00 65535.00 FORMAT "%8.2" /end CHARACTERISTIC
/begin CHARACTERISTIC DFC_CtlMsk.DFC_ComMETHRingCnt_C "Behaviour control mask / Behaviour control masks of check DFC_ComMETHRingCnt" VALUE 0x804D90EA Val_Wu16 65535.00 DFES_OneToOne 0.00 65535.00 FORMAT "%8.2" /end CHARACTERISTIC
/begin CHARACTERISTIC DFC_CtlMsk.DFC_ComMETHTOut_C "Behaviour control mask / Behaviour control masks of check DFC_ComMETHTOut" VALUE 0x804D90EC Val_Wu16 65535.00 DFES_OneToOne 0.00 65535.00 FORMAT "%8.2" /end CHARACTERISTIC
/begin CHARACTERISTIC DFC_CtlMsk.DFC_ComMETIChksum_C "Behaviour control mask / Behaviour control masks of check DFC_ComMETIChksum" VALUE 0x804D90EE Val_Wu16 65535.00 DFES_OneToOne 0.00 65535.00 FORMAT "%8.2" /end CHARACTERISTIC
/begin CHARACTERISTIC DFC_CtlMsk.DFC_ComMETIRingCnt_C "Behaviour control mask / Behaviour control masks of check DFC_ComMETIRingCnt" VALUE 0x804D90F0 Val_Wu16 65535.00 DFES_OneToOne 0.00 65535.00 FORMAT "%8.2" /end CHARACTERISTIC
/begin CHARACTERISTIC DFC_CtlMsk.DFC_ComMETITOut_C "Behaviour control mask / Behaviour control masks of check DFC_ComMETITOut" VALUE 0x804D90F2 Val_Wu16 65535.00 DFES_OneToOne 0.00 65535.00 FORMAT "%8.2" /end CHARACTERISTIC
/begin CHARACTERISTIC DFC_CtlMsk.DFC_ComMETKChksum_C "Behaviour control mask / Behaviour control masks of check DFC_ComMETKChksum" VALUE 0x804D90F4 Val_Wu16 65535.00 DFES_OneToOne 0.00 65535.00 FORMAT "%8.2" /end CHARACTERISTIC
/begin CHARACTERISTIC DFC_CtlMsk.DFC_ComMETKRingCnt_C "Behaviour control mask / Behaviour control masks of check DFC_ComMETKRingCnt" VALUE 0x804D90F6 Val_Wu16 65535.00 DFES_OneToOne 0.00 65535.00 FORMAT "%8.2" /end CHARACTERISTIC
/begin CHARACTERISTIC DFC_CtlMsk.DFC_ComMETKTOut_C "Behaviour control mask / Behaviour control masks of check DFC_ComMETKTOut" VALUE 0x804D90F8 Val_Wu16 65535.00 DFES_OneToOne 0.00 65535.00 FORMAT "%8.2" /end CHARACTERISTIC
/begin CHARACTERISTIC DFC_CtlMsk.DFC_ComMETLChksum_C "Behaviour control mask / Behaviour control masks of check DFC_ComMETLChksum" VALUE 0x804D90FA Val_Wu16 65535.00 DFES_OneToOne 0.00 65535.00 FORMAT "%8.2" /end CHARACTERISTIC
/begin CHARACTERISTIC DFC_CtlMsk.DFC_ComMETLRingCnt_C "Behaviour control mask / Behaviour control masks of check DFC_ComMETLRingCnt" VALUE 0x804D90FC Val_Wu16 65535.00 DFES_OneToOne 0.00 65535.00 FORMAT "%8.2" /end CHARACTERISTIC
/begin MEASUREMENT DFC_lenMaxCllsn "Measurement longest DFC Kollision" ULONG OneToOne 1 100 0.00 4294967295.00 FORMAT "%13.2" ECU_ADDRESS 0x60039778 /end MEASUREMENT
/begin MEASUREMENT DFC_nrCllsnClear "Number of DFC collisions at fcmclear" ULONG OneToOne 1 100 0.00 4294967295.00 FORMAT "%13.2" ECU_ADDRESS 0x50000200 /end MEASUREMENT
/begin MEASUREMENT DFC_nrCllsnReInit "Number of DFC collisions at reInit" ULONG OneToOne 1 100 0.00 4294967295.00 FORMAT "%13.2" ECU_ADDRESS 0x600002F0 /end MEASUREMENT
/begin MEASUREMENT DFC_nrCllsnReport "Number of DFC collisions at report" ULONG OneToOne 1 100 0.00 4294967295.00 FORMAT "%13.2" ECU_ADDRESS 0x50000204 /end MEASUREMENT
/begin MEASUREMENT DFC_numDfcMaxCllsn "DFC which encountered the longest collision" UWORD DFCDFP_Verb 1 100 0.00 989.000000000 FORMAT "%13.9" ECU_ADDRESS 0x60039776 /end MEASUREMENT
/begin MEASUREMENT DFC_st.DFC_AirCClntPAnaSRCMin "Status of DFC / Status of diagnostic fault check DFC_AirCClntPAnaSRCMin" UBYTE DFC_OneToOne 1 100 0.00 255.0 FORMAT "%5.1" ECU_ADDRESS 0x6003703D /end MEASUREMENT
/begin MEASUREMENT DFC_st.DFC_AirCSwtNpl "Status of DFC / Status of diagnostic fault check DFC_AirCSwtNpl" UBYTE DFC_OneToOne 1 100 0.00 255.0 FORMAT "%5.1" ECU_ADDRESS 0x6003703E /end MEASUREMENT
/begin MEASUREMENT DFC_st.DFC_AirCSwtSig "Status of DFC / Status of diagnostic fault check DFC_AirCSwtSig" UBYTE DFC_OneToOne 1 100 0.00 255.0 FORMAT "%5.1" ECU_ADDRESS 0x6003703F /end MEASUREMENT
/begin MEASUREMENT DFC_st.DFC_Brk "Status of DFC / Status of diagnostic fault check DFC_Brk" UBYTE DFC_OneToOne 1 100 0.00 255.0 FORMAT "%5.1" ECU_ADDRESS 0x60037040 /end MEASUREMENT
/begin MEASUREMENT DFC_st.DFC_BrkBstSensSCB "Status of DFC / Status of diagnostic fault check DFC_BrkBstSensSCB" UBYTE DFC_OneToOne 1 100 0.00 255.0 FORMAT "%5.1" ECU_ADDRESS 0x60037041 /end MEASUREMENT
/begin MEASUREMENT DFC_st.DFC_BrkBstSensSCG "Status of DFC / Status of diagnostic fault check DFC_BrkBstSensSCG" UBYTE DFC_OneToOne 1 100 0.00 255.0 FORMAT "%5.1" ECU_ADDRESS 0x60037042 /end MEASUREMENT
/begin MEASUREMENT DFC_st.DFC_BrkSig "Status of DFC / Status of diagnostic fault check DFC_BrkSig" UBYTE DFC_OneToOne 1 100 0.00 255.0 FORMAT "%5.1" ECU_ADDRESS 0x60037043 /end MEASUREMENT
/begin MEASUREMENT DFC_st.DFC_ClthSig "Status of DFC / Status of diagnostic fault check DFC_ClthSig" UBYTE DFC_OneToOne 1 100 0.00 255.0 FORMAT "%5.1" ECU_ADDRESS 0x60037044 /end MEASUREMENT
/begin MEASUREMENT DFC_st.DFC_EGRVlvCurrLim "Status of DFC / Status of diagnostic fault check DFC_EGRVlvCurrLim" UBYTE DFC_OneToOne 1 100 0.00 255.0 FORMAT "%5.1" ECU_ADDRESS 0x60037045 /end MEASUREMENT
/begin MEASUREMENT DFC_st.DFC_EGRVlvOL "Status of DFC / Status of diagnostic fault check DFC_EGRVlvOL" UBYTE DFC_OneToOne 1 100 0.00 255.0 FORMAT "%5.1" ECU_ADDRESS 0x60037046 /end MEASUREMENT
/begin MEASUREMENT DFC_st.DFC_EGRVlvOvrTemp "Status of DFC / Status of diagnostic fault check DFC_EGRVlvOvrTemp" UBYTE DFC_OneToOne 1 100 0.00 255.0 FORMAT "%5.1" ECU_ADDRESS 0x60037047 /end MEASUREMENT
/begin MEASUREMENT DFC_st.DFC_EGRVlvSCB "Status of DFC / Status of diagnostic fault check DFC_EGRVlvSCB" UBYTE DFC_OneToOne 1 100 0.00 255.0 FORMAT "%5.1" ECU_ADDRESS 0x60037048 /end MEASUREMENT
/begin MEASUREMENT DFC_st.DFC_EGRVlvSCG "Status of DFC / Status of diagnostic fault check DFC_EGRVlvSCG" UBYTE DFC_OneToOne 1 100 0.00 255.0 FORMAT "%5.1" ECU_ADDRESS 0x60037049 /end MEASUREMENT
/begin MEASUREMENT DFC_st.DFC_EGRVlvSRCMax "Status of DFC / Status of diagnostic fault check DFC_EGRVlvSRCMax" UBYTE DFC_OneToOne 1 100 0.00 255.0 FORMAT "%5.1" ECU_ADDRESS 0x6003704A /end MEASUREMENT
/begin MEASUREMENT DFC_st.DFC_EGRVlvSRCMin "Status of DFC / Status of diagnostic fault check DFC_EGRVlvSRCMin" UBYTE DFC_OneToOne 1 100 0.00 255.0 FORMAT "%5.1" ECU_ADDRESS 0x6003704B /end MEASUREMENT
/begin MEASUREMENT DFC_st.DFC_HLSDemOvhtEngLim "Status of DFC / Status of diagnostic fault check DFC_HLSDemOvhtEngLim" UBYTE DFC_OneToOne 1 100 0.00 255.0 FORMAT "%5.1" ECU_ADDRESS 0x6003704C /end MEASUREMENT
/begin MEASUREMENT DFC_st.DFC_OilPSwmpSRCMax "Status of DFC / Status of diagnostic fault check DFC_OilPSwmpSRCMax" UBYTE DFC_OneToOne 1 100 0.00 255.0 FORMAT "%5.1" ECU_ADDRESS 0x6003704D /end MEASUREMENT
/begin MEASUREMENT DFC_st.DFC_OilPSwmpSRCMin "Status of DFC / Status of diagnostic fault check DFC_OilPSwmpSRCMin" UBYTE DFC_OneToOne 1 100 0.00 255.0 FORMAT "%5.1" ECU_ADDRESS 0x6003704E /end MEASUREMENT
/begin MEASUREMENT DFC_st.DFC_PIntkVUsLineHiB1 "Status of DFC / Status of diagnostic fault check DFC_PIntkVUsLineHiB1" UBYTE DFC_OneToOne 1 100 0.00 255.0 FORMAT "%5.1" ECU_ADDRESS 0x6003704F /end MEASUREMENT
/begin MEASUREMENT DFC_st.DFC_PIntkVUsLineLoB1 "Status of DFC / Status of diagnostic fault check DFC_PIntkVUsLineLoB1" UBYTE DFC_OneToOne 1 100 0.00 255.0 FORMAT "%5.1" ECU_ADDRESS 0x60037050 /end MEASUREMENT
/begin MEASUREMENT DFC_st.DFC_VehVPhysRngLo "Status of DFC / Status of diagnostic fault check DFC_VehVPhysRngLo" UBYTE DFC_OneToOne 1 100 0.00 255.0 FORMAT "%5.1" ECU_ADDRESS 0x60037051 /end MEASUREMENT
/begin MEASUREMENT DFC_st.DFC_VehVSigCan "Status of DFC / Status of diagnostic fault check DFC_VehVSigCan" UBYTE DFC_OneToOne 1 100 0.00 255.0 FORMAT "%5.1" ECU_ADDRESS 0x60037052 /end MEASUREMENT
/begin MEASUREMENT DFC_st.DFC_VehVSigCanSafe "Status of DFC / Status of diagnostic fault check DFC_VehVSigCanSafe" UBYTE DFC_OneToOne 1 100 0.00 255.0 FORMAT "%5.1" ECU_ADDRESS 0x60037053 /end MEASUREMENT
/begin MEASUREMENT DFC_st.DFC_VlvLftFbOilPSnsrIntk11SRCMax "Status of DFC / Status of diagnostic fault check DFC_VlvLftFbOilPSnsrIntk11SRCMax" UBYTE DFC_OneToOne 1 100 0.00 255.0 FORMAT "%5.1" ECU_ADDRESS 0x60037054 /end MEASUREMENT
/begin MEASUREMENT DFC_st.DFC_VlvLftFbOilPSnsrIntk11SRCMin "Status of DFC / Status of diagnostic fault check DFC_VlvLftFbOilPSnsrIntk11SRCMin" UBYTE DFC_OneToOne 1 100 0.00 255.0 FORMAT "%5.1" ECU_ADDRESS 0x60037055 /end MEASUREMENT
/begin MEASUREMENT DFC_st.DFC_ClthNpl "Status of DFC / Status of diagnostic fault check DFC_ClthNpl" UBYTE DFC_OneToOne 1 100 0.00 255.0 FORMAT "%5.1" ECU_ADDRESS 0x60037056 /end MEASUREMENT
/begin MEASUREMENT DFC_st.DFC_GbxPNPosnDrvCdn "Status of DFC / Status of diagnostic fault check DFC_GbxPNPosnDrvCdn" UBYTE DFC_OneToOne 1 100 0.00 255.0 FORMAT "%5.1" ECU_ADDRESS 0x60037057 /end MEASUREMENT
/begin MEASUREMENT DFC_st.DFC_GbxPNPosnPlausy "Status of DFC / Status of diagnostic fault check DFC_GbxPNPosnPlausy" UBYTE DFC_OneToOne 1 100 0.00 255.0 FORMAT "%5.1" ECU_ADDRESS 0x60037058 /end MEASUREMENT
/begin MEASUREMENT DFC_st.DFC_AfsSigErrLineHiB1 "Status of DFC / Status of diagnostic fault check DFC_AfsSigErrLineHiB1" UBYTE DFC_OneToOne 1 100 0.00 255.0 FORMAT "%5.1" ECU_ADDRESS 0x60037059 /end MEASUREMENT
/begin MEASUREMENT DFC_st.DFC_AfsSigErrLineLoB1 "Status of DFC / Status of diagnostic fault check DFC_AfsSigErrLineLoB1" UBYTE DFC_OneToOne 1 100 0.00 255.0 FORMAT "%5.1" ECU_ADDRESS 0x6003705A /end MEASUREMENT
/begin MEASUREMENT DFC_st.DFC_PEnvCcMax "Status of DFC / Status of diagnostic fault check DFC_PEnvCcMax" UBYTE DFC_OneToOne 1 100 0.00 255.0 FORMAT "%5.1" ECU_ADDRESS 0x6003705B /end MEASUREMENT
/begin MEASUREMENT DFC_st.DFC_PEnvCcMin "Status of DFC / Status of diagnostic fault check DFC_PEnvCcMin" UBYTE DFC_OneToOne 1 100 0.00 255.0 FORMAT "%5.1" ECU_ADDRESS 0x6003705C /end MEASUREMENT
/begin MEASUREMENT DFC_st.DFC_PEnvRngChkMax "Status of DFC / Status of diagnostic fault check DFC_PEnvRngChkMax" UBYTE DFC_OneToOne 1 100 0.00 255.0 FORMAT "%5.1" ECU_ADDRESS 0x6003705D /end MEASUREMENT
/begin MEASUREMENT DFC_st.DFC_PEnvRngChkMin "Status of DFC / Status of diagnostic fault check DFC_PEnvRngChkMin" UBYTE DFC_OneToOne 1 100 0.00 255.0 FORMAT "%5.1" ECU_ADDRESS 0x6003705E /end MEASUREMENT
/begin MEASUREMENT DFC_st.DFC_PEnvSnsrPlaus "Status of DFC / Status of diagnostic fault check DFC_PEnvSnsrPlaus" UBYTE DFC_OneToOne 1 100 0.00 255.0 FORMAT "%5.1" ECU_ADDRESS 0x6003705F /end MEASUREMENT
/begin MEASUREMENT DFC_st.DFC_UEGOHeatrRlyPsOLS1B1 "Status of DFC / Status of diagnostic fault check DFC_UEGOHeatrRlyPsOLS1B1" UBYTE DFC_OneToOne 1 100 0.00 255.0 FORMAT "%5.1" ECU_ADDRESS 0x60037060 /end MEASUREMENT
/begin MEASUREMENT DFC_st.DFC_UEGOHeatrRlyPsSCBS1B1 "Status of DFC / Status of diagnostic fault check DFC_UEGOHeatrRlyPsSCBS1B1" UBYTE DFC_OneToOne 1 100 0.00 255.0 FORMAT "%5.1" ECU_ADDRESS 0x60037061 /end MEASUREMENT
/begin MEASUREMENT DFC_st.DFC_UEGOHeatrRlyPsSCGS1B1 "Status of DFC / Status of diagnostic fault check DFC_UEGOHeatrRlyPsSCGS1B1" UBYTE DFC_OneToOne 1 100 0.00 255.0 FORMAT "%5.1" ECU_ADDRESS 0x60037062 /end MEASUREMENT
/begin MEASUREMENT DFC_st.DFC_UegoHeatrWireOlS1B1 "Status of DFC / Status of diagnostic fault check DFC_UegoHeatrWireOlS1B1" UBYTE DFC_OneToOne 1 100 0.00 255.0 FORMAT "%5.1" ECU_ADDRESS 0x60037063 /end MEASUREMENT
/begin MEASUREMENT DFC_st.DFC_UegoHeatrWireScbS1B1 "Status of DFC / Status of diagnostic fault check DFC_UegoHeatrWireScbS1B1" UBYTE DFC_OneToOne 1 100 0.00 255.0 FORMAT "%5.1" ECU_ADDRESS 0x60037064 /end MEASUREMENT
/begin MEASUREMENT DFC_st.DFC_UegoHeatrWireScgS1B1 "Status of DFC / Status of diagnostic fault check DFC_UegoHeatrWireScgS1B1" UBYTE DFC_OneToOne 1 100 0.00 255.0 FORMAT "%5.1" ECU_ADDRESS 0x60037065 /end MEASUREMENT
/begin MEASUREMENT DFC_st.DFC_KnDetSens1PortAMax "Status of DFC / Status of diagnostic fault check DFC_KnDetSens1PortAMax" UBYTE DFC_OneToOne 1 100 0.00 255.0 FORMAT "%5.1" ECU_ADDRESS 0x60037066 /end MEASUREMENT
/begin MEASUREMENT DFC_st.DFC_KnDetSens1PortAMin "Status of DFC / Status of diagnostic fault check DFC_KnDetSens1PortAMin" UBYTE DFC_OneToOne 1 100 0.00 255.0 FORMAT "%5.1" ECU_ADDRESS 0x60037067 /end MEASUREMENT
/begin MEASUREMENT DFC_st.DFC_KnDetSens1PortBMax "Status of DFC / Status of diagnostic fault check DFC_KnDetSens1PortBMax" UBYTE DFC_OneToOne 1 100 0.00 255.0 FORMAT "%5.1" ECU_ADDRESS 0x60037068 /end MEASUREMENT
/begin MEASUREMENT DFC_st.DFC_KnDetSens1PortBMin "Status of DFC / Status of diagnostic fault check DFC_KnDetSens1PortBMin" UBYTE DFC_OneToOne 1 100 0.00 255.0 FORMAT "%5.1" ECU_ADDRESS 0x60037069 /end MEASUREMENT
/begin MEASUREMENT DFC_st.DFC_Clth2ONStuck "Status of DFC / Status of diagnostic fault check DFC_Clth2ONStuck" UBYTE DFC_OneToOne 1 100 0.00 255.0 FORMAT "%5.1" ECU_ADDRESS 0x6003706A /end MEASUREMENT
/begin MEASUREMENT DFC_st.DFC_Clth2ONStuckLdc "Status of DFC / Status of diagnostic fault check DFC_Clth2ONStuckLdc" UBYTE DFC_OneToOne 1 100 0.00 255.0 FORMAT "%5.1" ECU_ADDRESS 0x6003706B /end MEASUREMENT
/begin MEASUREMENT DFC_st.DFC_Clth3ONStuckLdc "Status of DFC / Status of diagnostic fault check DFC_Clth3ONStuckLdc" UBYTE DFC_OneToOne 1 100 0.00 255.0 FORMAT "%5.1" ECU_ADDRESS 0x6003706C /end MEASUREMENT
/begin MEASUREMENT DFC_st.DFC_Clth3ONStuckPostDrv "Status of DFC / Status of diagnostic fault check DFC_Clth3ONStuckPostDrv" UBYTE DFC_OneToOne 1 100 0.00 255.0 FORMAT "%5.1" ECU_ADDRESS 0x6003706D /end MEASUREMENT
/begin MEASUREMENT DFC_st.DFC_Clth4ONStuck "Status of DFC / Status of diagnostic fault check DFC_Clth4ONStuck" UBYTE DFC_OneToOne 1 100 0.00 255.0 FORMAT "%5.1" ECU_ADDRESS 0x6003706E /end MEASUREMENT
/begin MEASUREMENT DFC_st.DFC_Clth4ONStuckLdc "Status of DFC / Status of diagnostic fault check DFC_Clth4ONStuckLdc" UBYTE DFC_OneToOne 1 100 0.00 255.0 FORMAT "%5.1" ECU_ADDRESS 0x6003706F /end MEASUREMENT
/begin MEASUREMENT DFC_st.DFC_ComBCMUnit "Status of DFC / Status of diagnostic fault check DFC_ComBCMUnit" UBYTE DFC_OneToOne 1 100 0.00 255.0 FORMAT "%5.1" ECU_ADDRESS 0x60037070 /end MEASUREMENT
/begin MEASUREMENT DFC_st.DFC_ComDLCTCU01 "Status of DFC / Status of diagnostic fault check DFC_ComDLCTCU01" UBYTE DFC_OneToOne 1 100 0.00 255.0 FORMAT "%5.1" ECU_ADDRESS 0x60037071 /end MEASUREMENT
/begin MEASUREMENT DFC_st.DFC_ComDLCTCU02 "Status of DFC / Status of diagnostic fault check DFC_ComDLCTCU02" UBYTE DFC_OneToOne 1 100 0.00 255.0 FORMAT "%5.1" ECU_ADDRESS 0x60037072 /end MEASUREMENT
/begin MEASUREMENT DFC_st.DFC_ComDLCTCU1 "Status of DFC / Status of diagnostic fault check DFC_ComDLCTCU1" UBYTE DFC_OneToOne 1 100 0.00 255.0 FORMAT "%5.1" ECU_ADDRESS 0x60037073 /end MEASUREMENT
/begin MEASUREMENT DFC_st.DFC_ComDLCTCU11 "Status of DFC / Status of diagnostic fault check DFC_ComDLCTCU11" UBYTE DFC_OneToOne 1 100 0.00 255.0 FORMAT "%5.1" ECU_ADDRESS 0x60037074 /end MEASUREMENT
/begin MEASUREMENT DFC_st.DFC_ComDLCTCU12 "Status of DFC / Status of diagnostic fault check DFC_ComDLCTCU12" UBYTE DFC_OneToOne 1 100 0.00 255.0 FORMAT "%5.1" ECU_ADDRESS 0x60037075 /end MEASUREMENT
/begin MEASUREMENT DFC_st.DFC_ComDLCTCU13 "Status of DFC / Status of diagnostic fault check DFC_ComDLCTCU13" UBYTE DFC_OneToOne 1 100 0.00 255.0 FORMAT "%5.1" ECU_ADDRESS 0x60037076 /end MEASUREMENT
/begin MEASUREMENT DFC_st.DFC_ComDLCTCU14 "Status of DFC / Status of diagnostic fault check DFC_ComDLCTCU14" UBYTE DFC_OneToOne 1 100 0.00 255.0 FORMAT "%5.1" ECU_ADDRESS 0x60037077 /end MEASUREMENT
/begin MEASUREMENT DFC_st.DFC_ComDLCTCU2 "Status of DFC / Status of diagnostic fault check DFC_ComDLCTCU2" UBYTE DFC_OneToOne 1 100 0.00 255.0 FORMAT "%5.1" ECU_ADDRESS 0x60037078 /end MEASUREMENT
/begin MEASUREMENT DFC_st.DFC_ComDLCTCU3 "Status of DFC / Status of diagnostic fault check DFC_ComDLCTCU3" UBYTE DFC_OneToOne 1 100 0.00 255.0 FORMAT "%5.1" ECU_ADDRESS 0x60037079 /end MEASUREMENT
/begin MEASUREMENT DFC_st.DFC_ComDLCTCU4 "Status of DFC / Status of diagnostic fault check DFC_ComDLCTCU4" UBYTE DFC_OneToOne 1 100 0.00 255.0 FORMAT "%5.1" ECU_ADDRESS 0x6003707A /end MEASUREMENT
/begin MEASUREMENT DFC_st.DFC_ComEPSUnit "Status of DFC / Status of diagnostic fault check DFC_ComEPSUnit" UBYTE DFC_OneToOne 1 100 0.00 255.0 FORMAT "%5.1" ECU_ADDRESS 0x6003707B /end MEASUREMENT
/begin MEASUREMENT DFC_st.DFC_ComIDASBUnit "Status of DFC / Status of diagnostic fault check DFC_ComIDASBUnit" UBYTE DFC_OneToOne 1 100 0.00 255.0 FORMAT "%5.1" ECU_ADDRESS 0x6003707C /end MEASUREMENT
/begin MEASUREMENT DFC_st.DFC_ComIMGUnit "Status of DFC / Status of diagnostic fault check DFC_ComIMGUnit" UBYTE DFC_OneToOne 1 100 0.00 255.0 FORMAT "%5.1" ECU_ADDRESS 0x6003707D /end MEASUREMENT
/begin MEASUREMENT DFC_st.DFC_ComMETUnit "Status of DFC / Status of diagnostic fault check DFC_ComMETUnit" UBYTE DFC_OneToOne 1 100 0.00 255.0 FORMAT "%5.1" ECU_ADDRESS 0x6003707E /end MEASUREMENT
/begin MEASUREMENT DFC_st.DFC_ComSRSUnit "Status of DFC / Status of diagnostic fault check DFC_ComSRSUnit" UBYTE DFC_OneToOne 1 100 0.00 255.0 FORMAT "%5.1" ECU_ADDRESS 0x6003707F /end MEASUREMENT
/begin MEASUREMENT DFC_st.DFC_ComVSAUnit "Status of DFC / Status of diagnostic fault check DFC_ComVSAUnit" UBYTE DFC_OneToOne 1 100 0.00 255.0 FORMAT "%5.1" ECU_ADDRESS 0x60037080 /end MEASUREMENT
/begin MEASUREMENT DFC_st.DFC_EbsSocFlt "Status of DFC / Status of diagnostic fault check DFC_EbsSocFlt" UBYTE DFC_OneToOne 1 100 0.00 255.0 FORMAT "%5.1" ECU_ADDRESS 0x60037081 /end MEASUREMENT
/begin MEASUREMENT DFC_st.DFC_I14229VINErr "Status of DFC / Status of diagnostic fault check DFC_I14229VINErr" UBYTE DFC_OneToOne 1 100 0.00 255.0 FORMAT "%5.1" ECU_ADDRESS 0x60037082 /end MEASUREMENT
/begin MEASUREMENT DFC_st.DFC_InjCatHeatgErr "Status of DFC / Status of diagnostic fault check DFC_InjCatHeatgErr" UBYTE DFC_OneToOne 1 100 0.00 255.0 FORMAT "%5.1" ECU_ADDRESS 0x60037083 /end MEASUREMENT
/begin MEASUREMENT DFC_st.DFC_InjSysMulInjDiagErr "Status of DFC / Status of diagnostic fault check DFC_InjSysMulInjDiagErr" UBYTE DFC_OneToOne 1 100 0.00 255.0 FORMAT "%5.1" ECU_ADDRESS 0x60037084 /end MEASUREMENT
/begin MEASUREMENT DFC_st.DFC_LLRHmax "Status of DFC / Status of diagnostic fault check DFC_LLRHmax" UBYTE DFC_OneToOne 1 100 0.00 255.0 FORMAT "%5.1" ECU_ADDRESS 0x60037085 /end MEASUREMENT
/begin MEASUREMENT DFC_st.DFC_LLRHmin "Status of DFC / Status of diagnostic fault check DFC_LLRHmin" UBYTE DFC_OneToOne 1 100 0.00 255.0 FORMAT "%5.1" ECU_ADDRESS 0x60037086 /end MEASUREMENT
/begin MEASUREMENT DFC_st.DFC_LLRHnpl "Status of DFC / Status of diagnostic fault check DFC_LLRHnpl" UBYTE DFC_OneToOne 1 100 0.00 255.0 FORMAT "%5.1" ECU_ADDRESS 0x60037087 /end MEASUREMENT
/begin MEASUREMENT DFC_st.DFC_LLRKHmax "Status of DFC / Status of diagnostic fault check DFC_LLRKHmax" UBYTE DFC_OneToOne 1 100 0.00 255.0 FORMAT "%5.1" ECU_ADDRESS 0x60037088 /end MEASUREMENT
/begin MEASUREMENT DFC_st.DFC_LLRKHmin "Status of DFC / Status of diagnostic fault check DFC_LLRKHmin" UBYTE DFC_OneToOne 1 100 0.00 255.0 FORMAT "%5.1" ECU_ADDRESS 0x60037089 /end MEASUREMENT
/begin MEASUREMENT DFC_st.DFC_LLRKHnpl "Status of DFC / Status of diagnostic fault check DFC_LLRKHnpl" UBYTE DFC_OneToOne 1 100 0.00 255.0 FORMAT "%5.1" ECU_ADDRESS 0x6003708A /end MEASUREMENT
/begin MEASUREMENT DFC_st.DFC_LinACGUnit "Status of DFC / Status of diagnostic fault check DFC_LinACGUnit" UBYTE DFC_OneToOne 1 100 0.00 255.0 FORMAT "%5.1" ECU_ADDRESS 0x6003708B /end MEASUREMENT
/begin MEASUREMENT DFC_st.DFC_LinAEVUnit "Status of DFC / Status of diagnostic fault check DFC_LinAEVUnit" UBYTE DFC_OneToOne 1 100 0.00 255.0 FORMAT "%5.1" ECU_ADDRESS 0x6003708C /end MEASUREMENT
/begin MEASUREMENT DFC_st.DFC_LinEBSUnit "Status of DFC / Status of diagnostic fault check DFC_LinEBSUnit" UBYTE DFC_OneToOne 1 100 0.00 255.0 FORMAT "%5.1" ECU_ADDRESS 0x6003708D /end MEASUREMENT
/begin MEASUREMENT DFC_st.DFC_RoughRoad "Status of DFC / Status of diagnostic fault check DFC_RoughRoad" UBYTE DFC_OneToOne 1 100 0.00 255.0 FORMAT "%5.1" ECU_ADDRESS 0x6003708E /end MEASUREMENT
/begin MEASUREMENT DFC_st.DFC_SiaEEPRdErr "Status of DFC / Status of diagnostic fault check DFC_SiaEEPRdErr" UBYTE DFC_OneToOne 1 100 0.00 255.0 FORMAT "%5.1" ECU_ADDRESS 0x6003708F /end MEASUREMENT
/begin MEASUREMENT DFC_st.DFC_SiaEEPWrngCod "Status of DFC / Status of diagnostic fault check DFC_SiaEEPWrngCod" UBYTE DFC_OneToOne 1 100 0.00 255.0 FORMAT "%5.1" ECU_ADDRESS 0x60037090 /end MEASUREMENT
/begin MEASUREMENT DFC_st.DFC_UegoHeatrStrtS1B1 "Status of DFC / Status of diagnostic fault check DFC_UegoHeatrStrtS1B1" UBYTE DFC_OneToOne 1 100 0.00 255.0 FORMAT "%5.1" ECU_ADDRESS 0x60037091 /end MEASUREMENT
/begin MEASUREMENT DFC_st.DFC_BusDiagCANAPPLBusOff "Status of DFC / Status of diagnostic fault check DFC_BusDiagCANAPPLBusOff" UBYTE DFC_OneToOne 1 100 0.00 255.0 FORMAT "%5.1" ECU_ADDRESS 0x60037092 /end MEASUREMENT
/begin MEASUREMENT DFC_st.DFC_BusDiagCANCANCBusOff "Status of DFC / Status of diagnostic fault check DFC_BusDiagCANCANCBusOff" UBYTE DFC_OneToOne 1 100 0.00 255.0 FORMAT "%5.1" ECU_ADDRESS 0x60037093 /end MEASUREMENT
/begin MEASUREMENT DFC_st.DFC_BusDiagCANVEHICLEBusOff "Status of DFC / Status of diagnostic fault check DFC_BusDiagCANVEHICLEBusOff" UBYTE DFC_OneToOne 1 100 0.00 255.0 FORMAT "%5.1" ECU_ADDRESS 0x60037094 /end MEASUREMENT
/begin MEASUREMENT DFC_st.DFC_RBA_IODIAGPWR_rba_IoExtCy329_SignalVltSply_0 "Status of DFC / Status of diagnostic fault check DFC_RBA_IODIAGPWR_rba_IoExtCy329_SignalVltSply_0" UBYTE DFC_OneToOne 1 100 0.00 255.0 FORMAT "%5.1" ECU_ADDRESS 0x60037095 /end MEASUREMENT
/begin MEASUREMENT DFC_st.DFC_RBA_IODIAGPWR_rba_IoExtCy329_SignalVltSply_0OT "Status of DFC / Status of diagnostic fault check DFC_RBA_IODIAGPWR_rba_IoExtCy329_SignalVltSply_0OT" UBYTE DFC_OneToOne 1 100 0.00 255.0 FORMAT "%5.1" ECU_ADDRESS 0x60037096 /end MEASUREMENT
/begin MEASUREMENT DFC_st.DFC_RBA_IODIAGPWR_rba_IoExtCy329_SignalVltSply_0OV "Status of DFC / Status of diagnostic fault check DFC_RBA_IODIAGPWR_rba_IoExtCy329_SignalVltSply_0OV" UBYTE DFC_OneToOne 1 100 0.00 255.0 FORMAT "%5.1" ECU_ADDRESS 0x60037097 /end MEASUREMENT
/begin MEASUREMENT DFC_st.DFC_RBA_IODIAGPWR_rba_IoExtCy329_SignalVltSply_0SCG "Status of DFC / Status of diagnostic fault check DFC_RBA_IODIAGPWR_rba_IoExtCy329_SignalVltSply_0SCG" UBYTE DFC_OneToOne 1 100 0.00 255.0 FORMAT "%5.1" ECU_ADDRESS 0x60037098 /end MEASUREMENT
/begin MEASUREMENT DFC_st.DFC_RBA_IODIAGPWR_rba_IoExtCy329_SignalVltSply_0UV "Status of DFC / Status of diagnostic fault check DFC_RBA_IODIAGPWR_rba_IoExtCy329_SignalVltSply_0UV" UBYTE DFC_OneToOne 1 100 0.00 255.0 FORMAT "%5.1" ECU_ADDRESS 0x60037099 /end MEASUREMENT
/begin MEASUREMENT DFC_st.DFC_RBA_IODIAGPWR_rba_IoExtCy329_SignalVltSply_1 "Status of DFC / Status of diagnostic fault check DFC_RBA_IODIAGPWR_rba_IoExtCy329_SignalVltSply_1" UBYTE DFC_OneToOne 1 100 0.00 255.0 FORMAT "%5.1" ECU_ADDRESS 0x6003709A /end MEASUREMENT
/begin MEASUREMENT DFC_st.DFC_RBA_IODIAGPWR_rba_IoExtCy329_SignalVltSply_1OT "Status of DFC / Status of diagnostic fault check DFC_RBA_IODIAGPWR_rba_IoExtCy329_SignalVltSply_1OT" UBYTE DFC_OneToOne 1 100 0.00 255.0 FORMAT "%5.1" ECU_ADDRESS 0x6003709B /end MEASUREMENT
/begin MEASUREMENT DFC_st.DFC_RBA_IODIAGPWR_rba_IoExtCy329_SignalVltSply_1OV "Status of DFC / Status of diagnostic fault check DFC_RBA_IODIAGPWR_rba_IoExtCy329_SignalVltSply_1OV" UBYTE DFC_OneToOne 1 100 0.00 255.0 FORMAT "%5.1" ECU_ADDRESS 0x6003709C /end MEASUREMENT
/begin MEASUREMENT DFC_st.DFC_RBA_IODIAGPWR_rba_IoExtCy329_SignalVltSply_1SCG "Status of DFC / Status of diagnostic fault check DFC_RBA_IODIAGPWR_rba_IoExtCy329_SignalVltSply_1SCG" UBYTE DFC_OneToOne 1 100 0.00 255.0 FORMAT "%5.1" ECU_ADDRESS 0x6003709D /end MEASUREMENT
/begin MEASUREMENT DFC_st.DFC_RBA_IODIAGPWR_rba_IoExtCy329_SignalVltSply_1UV "Status of DFC / Status of diagnostic fault check DFC_RBA_IODIAGPWR_rba_IoExtCy329_SignalVltSply_1UV" UBYTE DFC_OneToOne 1 100 0.00 255.0 FORMAT "%5.1" ECU_ADDRESS 0x6003709E /end MEASUREMENT
/begin MEASUREMENT DFC_st.DFC_RBA_IODIAGPWR_rba_IoExtCy329_SignalVltSply_2 "Status of DFC / Status of diagnostic fault check DFC_RBA_IODIAGPWR_rba_IoExtCy329_SignalVltSply_2" UBYTE DFC_OneToOne 1 100 0.00 255.0 FORMAT "%5.1" ECU_ADDRESS 0x6003709F /end MEASUREMENT
/begin MEASUREMENT DFC_st.DFC_RBA_IODIAGPWR_rba_IoExtCy329_SignalVltSply_2OT "Status of DFC / Status of diagnostic fault check DFC_RBA_IODIAGPWR_rba_IoExtCy329_SignalVltSply_2OT" UBYTE DFC_OneToOne 1 100 0.00 255.0 FORMAT "%5.1" ECU_ADDRESS 0x600370A0 /end MEASUREMENT
/begin MEASUREMENT DFC_st.DFC_RBA_IODIAGPWR_rba_IoExtCy329_SignalVltSply_2OV "Status of DFC / Status of diagnostic fault check DFC_RBA_IODIAGPWR_rba_IoExtCy329_SignalVltSply_2OV" UBYTE DFC_OneToOne 1 100 0.00 255.0 FORMAT "%5.1" ECU_ADDRESS 0x600370A1 /end MEASUREMENT
/begin MEASUREMENT DFC_st.DFC_RBA_IODIAGPWR_rba_IoExtCy329_SignalVltSply_2SCG "Status of DFC / Status of diagnostic fault check DFC_RBA_IODIAGPWR_rba_IoExtCy329_SignalVltSply_2SCG" UBYTE DFC_OneToOne 1 100 0.00 255.0 FORMAT "%5.1" ECU_ADDRESS 0x600370A2 /end MEASUREMENT
/begin MEASUREMENT DFC_st.DFC_RBA_IODIAGPWR_rba_IoExtCy329_SignalVltSply_2UV "Status of DFC / Status of diagnostic fault check DFC_RBA_IODIAGPWR_rba_IoExtCy329_SignalVltSply_2UV" UBYTE DFC_OneToOne 1 100 0.00 255.0 FORMAT "%5.1" ECU_ADDRESS 0x600370A3 /end MEASUREMENT
/begin MEASUREMENT DFC_st.DFC_CAN_E_TIMEOUT "Status of DFC / Status of diagnostic fault check DFC_CAN_E_TIMEOUT" UBYTE DFC_OneToOne 1 100 0.00 255.0 FORMAT "%5.1" ECU_ADDRESS 0x600370A4 /end MEASUREMENT
/begin MEASUREMENT DFC_st.DFC_LIN_E_TIMEOUT "Status of DFC / Status of diagnostic fault check DFC_LIN_E_TIMEOUT" UBYTE DFC_OneToOne 1 100 0.00 255.0 FORMAT "%5.1" ECU_ADDRESS 0x600370A5 /end MEASUREMENT
/begin MEASUREMENT DFC_st.DFC_MRlyOL "Status of DFC / Status of diagnostic fault check DFC_MRlyOL" UBYTE DFC_OneToOne 1 100 0.00 255.0 FORMAT "%5.1" ECU_ADDRESS 0x600370A6 /end MEASUREMENT
/begin MEASUREMENT DFC_st.DFC_MRlySCB "Status of DFC / Status of diagnostic fault check DFC_MRlySCB" UBYTE DFC_OneToOne 1 100 0.00 255.0 FORMAT "%5.1" ECU_ADDRESS 0x600370A7 /end MEASUREMENT
/begin MEASUREMENT DFC_st.DFC_MRlySCG "Status of DFC / Status of diagnostic fault check DFC_MRlySCG" UBYTE DFC_OneToOne 1 100 0.00 255.0 FORMAT "%5.1" ECU_ADDRESS 0x600370A8 /end MEASUREMENT
/begin MEASUREMENT DFC_st.DFC_rba_MultiStackTrace_Threshold "Status of DFC / Status of diagnostic fault check DFC_rba_MultiStackTrace_Threshold" UBYTE DFC_OneToOne 1 100 0.00 255.0 FORMAT "%5.1" ECU_ADDRESS 0x600370A9 /end MEASUREMENT
/begin MEASUREMENT DFC_st.DFC_BSWM_E_ACTION_FAILED "Status of DFC / Status of diagnostic fault check DFC_BSWM_E_ACTION_FAILED" UBYTE DFC_OneToOne 1 100 0.00 255.0 FORMAT "%5.1" ECU_ADDRESS 0x600370AA /end MEASUREMENT
/begin MEASUREMENT DFC_st.DFC_BSWM_E_INTRPTQUEUE_FULL "Status of DFC / Status of diagnostic fault check DFC_BSWM_E_INTRPTQUEUE_FULL" UBYTE DFC_OneToOne 1 100 0.00 255.0 FORMAT "%5.1" ECU_ADDRESS 0x600370AB /end MEASUREMENT
/begin MEASUREMENT DFC_st.DFC_RBA_IOEXTLIB_KEEPALIVE_DRV "Status of DFC / Status of diagnostic fault check DFC_RBA_IOEXTLIB_KEEPALIVE_DRV" UBYTE DFC_OneToOne 1 100 0.00 255.0 FORMAT "%5.1" ECU_ADDRESS 0x600370AC /end MEASUREMENT
/begin MEASUREMENT DFC_st.DFC_RBA_IOEXTLIB_KEEPALIVE_INI "Status of DFC / Status of diagnostic fault check DFC_RBA_IOEXTLIB_KEEPALIVE_INI" UBYTE DFC_OneToOne 1 100 0.00 255.0 FORMAT "%5.1" ECU_ADDRESS 0x600370AD /end MEASUREMENT
/begin MEASUREMENT DFC_st.DFC_rba_IoSigRtc_StopCounter "Status of DFC / Status of diagnostic fault check DFC_rba_IoSigRtc_StopCounter" UBYTE DFC_OneToOne 1 100 0.00 255.0 FORMAT "%5.1" ECU_ADDRESS 0x600370AE /end MEASUREMENT
/begin MEASUREMENT DFC_st.DFC_rba_MRly_Diag_Stk_Event "Status of DFC / Status of diagnostic fault check DFC_rba_MRly_Diag_Stk_Event" UBYTE DFC_OneToOne 1 100 0.00 255.0 FORMAT "%5.1" ECU_ADDRESS 0x600370AF /end MEASUREMENT
/begin MEASUREMENT DFC_st.DFC_rba_MemDiag_MemReadErr "Status of DFC / Status of diagnostic fault check DFC_rba_MemDiag_MemReadErr" UBYTE DFC_OneToOne 1 100 0.00 255.0 FORMAT "%5.1" ECU_ADDRESS 0x600370B0 /end MEASUREMENT
/begin MEASUREMENT DFC_st.DFC_rba_MemDiag_MemWrErr "Status of DFC / Status of diagnostic fault check DFC_rba_MemDiag_MemWrErr" UBYTE DFC_OneToOne 1 100 0.00 255.0 FORMAT "%5.1" ECU_ADDRESS 0x600370B1 /end MEASUREMENT
/begin MEASUREMENT DFC_st.DFC_rba_SyC_IrrSwOffTrigEngRun_Event "Status of DFC / Status of diagnostic fault check DFC_rba_SyC_IrrSwOffTrigEngRun_Event" UBYTE DFC_OneToOne 1 100 0.00 255.0 FORMAT "%5.1" ECU_ADDRESS 0x600370B2 /end MEASUREMENT
/begin MEASUREMENT DFC_st.DFC_rba_T15_Diag_ComInVld_Event "Status of DFC / Status of diagnostic fault check DFC_rba_T15_Diag_ComInVld_Event" UBYTE DFC_OneToOne 1 100 0.00 255.0 FORMAT "%5.1" ECU_ADDRESS 0x600370B3 /end MEASUREMENT
/begin MEASUREMENT DFC_st.DFC_rba_T15_Diag_ComOff_HwOn_Event "Status of DFC / Status of diagnostic fault check DFC_rba_T15_Diag_ComOff_HwOn_Event" UBYTE DFC_OneToOne 1 100 0.00 255.0 FORMAT "%5.1" ECU_ADDRESS 0x600370B4 /end MEASUREMENT
/begin MEASUREMENT DFC_st.DFC_rba_T15_Diag_ComOn_HwOff_Event "Status of DFC / Status of diagnostic fault check DFC_rba_T15_Diag_ComOn_HwOff_Event" UBYTE DFC_OneToOne 1 100 0.00 255.0 FORMAT "%5.1" ECU_ADDRESS 0x600370B5 /end MEASUREMENT
/begin MEASUREMENT DFC_st.DFC_AAVmin "Status of DFC / Status of diagnostic fault check DFC_AAVmin" UBYTE DFC_OneToOne 1 100 0.00 255.0 FORMAT "%5.1" ECU_ADDRESS 0x600370B6 /end MEASUREMENT
/begin MEASUREMENT DFC_st.DFC_AGRSUS "Status of DFC / Status of diagnostic fault check DFC_AGRSUS" UBYTE DFC_OneToOne 1 100 0.00 255.0 FORMAT "%5.1" ECU_ADDRESS 0x600370B7 /end MEASUREMENT
/begin MEASUREMENT DFC_st.DFC_AfsPlausDiagHi "Status of DFC / Status of diagnostic fault check DFC_AfsPlausDiagHi" UBYTE DFC_OneToOne 1 100 0.00 255.0 FORMAT "%5.1" ECU_ADDRESS 0x600370B8 /end MEASUREMENT
/begin MEASUREMENT DFC_st.DFC_AfsPlausDiagLo "Status of DFC / Status of diagnostic fault check DFC_AfsPlausDiagLo" UBYTE DFC_OneToOne 1 100 0.00 255.0 FORMAT "%5.1" ECU_ADDRESS 0x600370B9 /end MEASUREMENT
/begin MEASUREMENT DFC_st.DFC_AfsVrntDiagErrB1 "Status of DFC / Status of diagnostic fault check DFC_AfsVrntDiagErrB1" UBYTE DFC_OneToOne 1 100 0.00 255.0 FORMAT "%5.1" ECU_ADDRESS 0x600370BA /end MEASUREMENT
/begin MEASUREMENT DFC_st.DFC_AppAllSnsrDfct "Status of DFC / Status of diagnostic fault check DFC_AppAllSnsrDfct" UBYTE DFC_OneToOne 1 100 0.00 255.0 FORMAT "%5.1" ECU_ADDRESS 0x600370BB /end MEASUREMENT
/begin MEASUREMENT DFC_st.DFC_BBKRnldg "Status of DFC / Status of diagnostic fault check DFC_BBKRnldg" UBYTE DFC_OneToOne 1 100 0.00 255.0 FORMAT "%5.1" ECU_ADDRESS 0x600370BC /end MEASUREMENT
/begin MEASUREMENT DFC_st.DFC_BBKRsyne "Status of DFC / Status of diagnostic fault check DFC_BBKRsyne" UBYTE DFC_OneToOne 1 100 0.00 255.0 FORMAT "%5.1" ECU_ADDRESS 0x600370BD /end MEASUREMENT
/begin MEASUREMENT DFC_st.DFC_BattUStdbyDiaOL "Status of DFC / Status of diagnostic fault check DFC_BattUStdbyDiaOL" UBYTE DFC_OneToOne 1 100 0.00 255.0 FORMAT "%5.1" ECU_ADDRESS 0x600370BE /end MEASUREMENT
/begin MEASUREMENT DFC_st.DFC_BigLeakIntkMnfldEmiInfl "Status of DFC / Status of diagnostic fault check DFC_BigLeakIntkMnfldEmiInfl" UBYTE DFC_OneToOne 1 100 0.00 255.0 FORMAT "%5.1" ECU_ADDRESS 0x600370BF /end MEASUREMENT
/begin MEASUREMENT DFC_st.DFC_BlkdLineTank "Status of DFC / Status of diagnostic fault check DFC_BlkdLineTank" UBYTE DFC_OneToOne 1 100 0.00 255.0 FORMAT "%5.1" ECU_ADDRESS 0x600370C0 /end MEASUREMENT
/begin MEASUREMENT DFC_st.DFC_BrkMnSwtContOnWarnLmp "Status of DFC / Status of diagnostic fault check DFC_BrkMnSwtContOnWarnLmp" UBYTE DFC_OneToOne 1 100 0.00 255.0 FORMAT "%5.1" ECU_ADDRESS 0x600370C1 /end MEASUREMENT
/begin MEASUREMENT DFC_st.DFC_BrkMnSwtNotStpWarnLmp "Status of DFC / Status of diagnostic fault check DFC_BrkMnSwtNotStpWarnLmp" UBYTE DFC_OneToOne 1 100 0.00 255.0 FORMAT "%5.1" ECU_ADDRESS 0x600370C2 /end MEASUREMENT
/begin MEASUREMENT DFC_st.DFC_BrkRdntSwtContOnWarnLmp "Status of DFC / Status of diagnostic fault check DFC_BrkRdntSwtContOnWarnLmp" UBYTE DFC_OneToOne 1 100 0.00 255.0 FORMAT "%5.1" ECU_ADDRESS 0x600370C3 /end MEASUREMENT
/begin MEASUREMENT DFC_st.DFC_BrkRdntSwtNotStpWarnLmp "Status of DFC / Status of diagnostic fault check DFC_BrkRdntSwtNotStpWarnLmp" UBYTE DFC_OneToOne 1 100 0.00 255.0 FORMAT "%5.1" ECU_ADDRESS 0x600370C4 /end MEASUREMENT
/begin MEASUREMENT DFC_st.DFC_CEngDsTColdStrtMax "Status of DFC / Status of diagnostic fault check DFC_CEngDsTColdStrtMax" UBYTE DFC_OneToOne 1 100 0.00 255.0 FORMAT "%5.1" ECU_ADDRESS 0x600370C5 /end MEASUREMENT
/begin MEASUREMENT DFC_st.DFC_CEngDsTColdStrtMin "Status of DFC / Status of diagnostic fault check DFC_CEngDsTColdStrtMin" UBYTE DFC_OneToOne 1 100 0.00 255.0 FORMAT "%5.1" ECU_ADDRESS 0x600370C6 /end MEASUREMENT
/begin MEASUREMENT DFC_st.DFC_CEngDsTImps "Status of DFC / Status of diagnostic fault check DFC_CEngDsTImps" UBYTE DFC_OneToOne 1 100 0.00 255.0 FORMAT "%5.1" ECU_ADDRESS 0x600370C7 /end MEASUREMENT
/begin MEASUREMENT DFC_st.DFC_CEngDsTPlausHSC "Status of DFC / Status of diagnostic fault check DFC_CEngDsTPlausHSC" UBYTE DFC_OneToOne 1 100 0.00 255.0 FORMAT "%5.1" ECU_ADDRESS 0x600370C8 /end MEASUREMENT
/begin MEASUREMENT DFC_st.DFC_CEngDsTPlausLSC "Status of DFC / Status of diagnostic fault check DFC_CEngDsTPlausLSC" UBYTE DFC_OneToOne 1 100 0.00 255.0 FORMAT "%5.1" ECU_ADDRESS 0x600370C9 /end MEASUREMENT
/begin MEASUREMENT DFC_st.DFC_CEngDsTPlausSTC "Status of DFC / Status of diagnostic fault check DFC_CEngDsTPlausSTC" UBYTE DFC_OneToOne 1 100 0.00 255.0 FORMAT "%5.1" ECU_ADDRESS 0x600370CA /end MEASUREMENT
/begin MEASUREMENT DFC_st.DFC_CEngDsTSRCMax "Status of DFC / Status of diagnostic fault check DFC_CEngDsTSRCMax" UBYTE DFC_OneToOne 1 100 0.00 255.0 FORMAT "%5.1" ECU_ADDRESS 0x600370CB /end MEASUREMENT
/begin MEASUREMENT DFC_st.DFC_CEngDsTSRCMin "Status of DFC / Status of diagnostic fault check DFC_CEngDsTSRCMin" UBYTE DFC_OneToOne 1 100 0.00 255.0 FORMAT "%5.1" ECU_ADDRESS 0x600370CC /end MEASUREMENT
/begin MEASUREMENT DFC_st.DFC_CEngDsTSig "Status of DFC / Status of diagnostic fault check DFC_CEngDsTSig" UBYTE DFC_OneToOne 1 100 0.00 255.0 FORMAT "%5.1" ECU_ADDRESS 0x600370CD /end MEASUREMENT
/begin MEASUREMENT DFC_st.DFC_CEngUsTColdStrtMax "Status of DFC / Status of diagnostic fault check DFC_CEngUsTColdStrtMax" UBYTE DFC_OneToOne 1 100 0.00 255.0 FORMAT "%5.1" ECU_ADDRESS 0x600370CE /end MEASUREMENT
/begin MEASUREMENT DFC_st.DFC_CEngUsTColdStrtMin "Status of DFC / Status of diagnostic fault check DFC_CEngUsTColdStrtMin" UBYTE DFC_OneToOne 1 100 0.00 255.0 FORMAT "%5.1" ECU_ADDRESS 0x600370CF /end MEASUREMENT
/begin MEASUREMENT DFC_st.DFC_CEngUsTLooseCnctn "Status of DFC / Status of diagnostic fault check DFC_CEngUsTLooseCnctn" UBYTE DFC_OneToOne 1 100 0.00 255.0 FORMAT "%5.1" ECU_ADDRESS 0x600370D0 /end MEASUREMENT
/begin MEASUREMENT DFC_st.DFC_CEngUsTSRCMax "Status of DFC / Status of diagnostic fault check DFC_CEngUsTSRCMax" UBYTE DFC_OneToOne 1 100 0.00 255.0 FORMAT "%5.1" ECU_ADDRESS 0x600370D1 /end MEASUREMENT
/begin MEASUREMENT DFC_st.DFC_CEngUsTSRCMin "Status of DFC / Status of diagnostic fault check DFC_CEngUsTSRCMin" UBYTE DFC_OneToOne 1 100 0.00 255.0 FORMAT "%5.1" ECU_ADDRESS 0x600370D2 /end MEASUREMENT
/begin MEASUREMENT DFC_st.DFC_ComDCDCACCFailr "Status of DFC / Status of diagnostic fault check DFC_ComDCDCACCFailr" UBYTE DFC_OneToOne 1 100 0.00 255.0 FORMAT "%5.1" ECU_ADDRESS 0x600370D3 /end MEASUREMENT
/begin MEASUREMENT DFC_st.DFC_DCDCFltDet "Status of DFC / Status of diagnostic fault check DFC_DCDCFltDet" UBYTE DFC_OneToOne 1 100 0.00 255.0 FORMAT "%5.1" ECU_ADDRESS 0x600370D4 /end MEASUREMENT
/begin MEASUREMENT DFC_st.DFC_DKRSA "Status of DFC / Status of diagnostic fault check DFC_DKRSA" UBYTE DFC_OneToOne 1 100 0.00 255.0 FORMAT "%5.1" ECU_ADDRESS 0x600370D5 /end MEASUREMENT
/begin MEASUREMENT DFC_st.DFC_DKVSmax "Status of DFC / Status of diagnostic fault check DFC_DKVSmax" UBYTE DFC_OneToOne 1 100 0.00 255.0 FORMAT "%5.1" ECU_ADDRESS 0x600370D6 /end MEASUREMENT
/begin MEASUREMENT DFC_st.DFC_DKnpl "Status of DFC / Status of diagnostic fault check DFC_DKnpl" UBYTE DFC_OneToOne 1 100 0.00 255.0 FORMAT "%5.1" ECU_ADDRESS 0x600370D7 /end MEASUREMENT
/begin MEASUREMENT DFC_st.DFC_DSKVRmax "Status of DFC / Status of diagnostic fault check DFC_DSKVRmax" UBYTE DFC_OneToOne 1 100 0.00 255.0 FORMAT "%5.1" ECU_ADDRESS 0x600370D8 /end MEASUREMENT
/begin MEASUREMENT DFC_st.DFC_DSKVRmin "Status of DFC / Status of diagnostic fault check DFC_DSKVRmin" UBYTE DFC_OneToOne 1 100 0.00 255.0 FORMAT "%5.1" ECU_ADDRESS 0x600370D9 /end MEASUREMENT
/begin MEASUREMENT DFC_st.DFC_DSKVRnpl "Status of DFC / Status of diagnostic fault check DFC_DSKVRnpl" UBYTE DFC_OneToOne 1 100 0.00 255.0 FORMAT "%5.1" ECU_ADDRESS 0x600370DA /end MEASUREMENT
/begin MEASUREMENT DFC_st.DFC_DSKVRsig "Status of DFC / Status of diagnostic fault check DFC_DSKVRsig" UBYTE DFC_OneToOne 1 100 0.00 255.0 FORMAT "%5.1" ECU_ADDRESS 0x600370DB /end MEASUREMENT
/begin MEASUREMENT DFC_st.DFC_DSKVSsig "Status of DFC / Status of diagnostic fault check DFC_DSKVSsig" UBYTE DFC_OneToOne 1 100 0.00 255.0 FORMAT "%5.1" ECU_ADDRESS 0x600370DC /end MEASUREMENT
/begin MEASUREMENT DFC_st.DFC_DSSmax "Status of DFC / Status of diagnostic fault check DFC_DSSmax" UBYTE DFC_OneToOne 1 100 0.00 255.0 FORMAT "%5.1" ECU_ADDRESS 0x600370DD /end MEASUREMENT
/begin MEASUREMENT DFC_st.DFC_DSTDmax "Status of DFC / Status of diagnostic fault check DFC_DSTDmax" UBYTE DFC_OneToOne 1 100 0.00 255.0 FORMAT "%5.1" ECU_ADDRESS 0x600370DE /end MEASUREMENT
/begin MEASUREMENT DFC_st.DFC_DSTEmax "Status of DFC / Status of diagnostic fault check DFC_DSTEmax" UBYTE DFC_OneToOne 1 100 0.00 255.0 FORMAT "%5.1" ECU_ADDRESS 0x600370DF /end MEASUREMENT
/begin MEASUREMENT DFC_st.DFC_DSTEmin "Status of DFC / Status of diagnostic fault check DFC_DSTEmin" UBYTE DFC_OneToOne 1 100 0.00 255.0 FORMAT "%5.1" ECU_ADDRESS 0x600370E0 /end MEASUREMENT
/begin MEASUREMENT DFC_st.DFC_DSTOFmax "Status of DFC / Status of diagnostic fault check DFC_DSTOFmax" UBYTE DFC_OneToOne 1 100 0.00 255.0 FORMAT "%5.1" ECU_ADDRESS 0x600370E1 /end MEASUREMENT
/begin MEASUREMENT DFC_st.DFC_DSTRmax "Status of DFC / Status of diagnostic fault check DFC_DSTRmax" UBYTE DFC_OneToOne 1 100 0.00 255.0 FORMAT "%5.1" ECU_ADDRESS 0x600370E2 /end MEASUREMENT
/begin MEASUREMENT DFC_st.DFC_DSTRmin "Status of DFC / Status of diagnostic fault check DFC_DSTRmin" UBYTE DFC_OneToOne 1 100 0.00 255.0 FORMAT "%5.1" ECU_ADDRESS 0x600370E3 /end MEASUREMENT
/begin MEASUREMENT DFC_st.DFC_DSTRnpl "Status of DFC / Status of diagnostic fault check DFC_DSTRnpl" UBYTE DFC_OneToOne 1 100 0.00 255.0 FORMAT "%5.1" ECU_ADDRESS 0x600370E4 /end MEASUREMENT
/begin MEASUREMENT DFC_st.DFC_DSTRsig "Status of DFC / Status of diagnostic fault check DFC_DSTRsig" UBYTE DFC_OneToOne 1 100 0.00 255.0 FORMAT "%5.1" ECU_ADDRESS 0x600370E5 /end MEASUREMENT
/begin MEASUREMENT DFC_st.DFC_DSTTI "Status of DFC / Status of diagnostic fault check DFC_DSTTI" UBYTE DFC_OneToOne 1 100 0.00 255.0 FORMAT "%5.1" ECU_ADDRESS 0x600370E6 /end MEASUREMENT
/begin MEASUREMENT DFC_st.DFC_DSUmax "Status of DFC / Status of diagnostic fault check DFC_DSUmax" UBYTE DFC_OneToOne 1 100 0.00 255.0 FORMAT "%5.1" ECU_ADDRESS 0x600370E7 /end MEASUREMENT
/begin MEASUREMENT DFC_st.DFC_DiagCpv1DteskLoLoadStuckClsd "Status of DFC / Status of diagnostic fault check DFC_DiagCpv1DteskLoLoadStuckClsd" UBYTE DFC_OneToOne 1 100 0.00 255.0 FORMAT "%5.1" ECU_ADDRESS 0x600370E8 /end MEASUREMENT
/begin MEASUREMENT DFC_st.DFC_DiagCpv1DteskLoLoadStuckOpen "Status of DFC / Status of diagnostic fault check DFC_DiagCpv1DteskLoLoadStuckOpen" UBYTE DFC_OneToOne 1 100 0.00 255.0 FORMAT "%5.1" ECU_ADDRESS 0x600370E9 /end MEASUREMENT
/begin MEASUREMENT DFC_st.DFC_EGRVlvDrftClsd "Status of DFC / Status of diagnostic fault check DFC_EGRVlvDrftClsd" UBYTE DFC_OneToOne 1 100 0.00 255.0 FORMAT "%5.1" ECU_ADDRESS 0x600370EA /end MEASUREMENT
/begin MEASUREMENT DFC_st.DFC_EGRVlvDrftOpn "Status of DFC / Status of diagnostic fault check DFC_EGRVlvDrftOpn" UBYTE DFC_OneToOne 1 100 0.00 255.0 FORMAT "%5.1" ECU_ADDRESS 0x600370EB /end MEASUREMENT
/begin MEASUREMENT DFC_st.DFC_EGRVlvJamVlvClsd "Status of DFC / Status of diagnostic fault check DFC_EGRVlvJamVlvClsd" UBYTE DFC_OneToOne 1 100 0.00 255.0 FORMAT "%5.1" ECU_ADDRESS 0x600370EC /end MEASUREMENT
/begin MEASUREMENT DFC_st.DFC_EGRVlvJamVlvOpn "Status of DFC / Status of diagnostic fault check DFC_EGRVlvJamVlvOpn" UBYTE DFC_OneToOne 1 100 0.00 255.0 FORMAT "%5.1" ECU_ADDRESS 0x600370ED /end MEASUREMENT
/begin MEASUREMENT DFC_st.DFC_EGRVlvSprgBrk "Status of DFC / Status of diagnostic fault check DFC_EGRVlvSprgBrk" UBYTE DFC_OneToOne 1 100 0.00 255.0 FORMAT "%5.1" ECU_ADDRESS 0x600370EE /end MEASUREMENT
/begin MEASUREMENT DFC_st.DFC_EGRVlvTempMdlEEPErr "Status of DFC / Status of diagnostic fault check DFC_EGRVlvTempMdlEEPErr" UBYTE DFC_OneToOne 1 100 0.00 255.0 FORMAT "%5.1" ECU_ADDRESS 0x600370EF /end MEASUREMENT
/begin MEASUREMENT DFC_st.DFC_EGRVlvTmpErr "Status of DFC / Status of diagnostic fault check DFC_EGRVlvTmpErr" UBYTE DFC_OneToOne 1 100 0.00 255.0 FORMAT "%5.1" ECU_ADDRESS 0x600370F0 /end MEASUREMENT
/begin MEASUREMENT DFC_st.DFC_EGSDUS2B1LtrDly "Status of DFC / Status of diagnostic fault check DFC_EGSDUS2B1LtrDly" UBYTE DFC_OneToOne 1 100 0.00 255.0 FORMAT "%5.1" ECU_ADDRESS 0x600370F1 /end MEASUREMENT
/begin MEASUREMENT DFC_st.DFC_EGSDUS2B1LtrPT1 "Status of DFC / Status of diagnostic fault check DFC_EGSDUS2B1LtrPT1" UBYTE DFC_OneToOne 1 100 0.00 255.0 FORMAT "%5.1" ECU_ADDRESS 0x600370F2 /end MEASUREMENT
/begin MEASUREMENT DFC_st.DFC_EGSDUS2B1RtlDly "Status of DFC / Status of diagnostic fault check DFC_EGSDUS2B1RtlDly" UBYTE DFC_OneToOne 1 100 0.00 255.0 FORMAT "%5.1" ECU_ADDRESS 0x600370F3 /end MEASUREMENT
/begin MEASUREMENT DFC_st.DFC_EGSDUS2B1RtlPT1 "Status of DFC / Status of diagnostic fault check DFC_EGSDUS2B1RtlPT1" UBYTE DFC_OneToOne 1 100 0.00 255.0 FORMAT "%5.1" ECU_ADDRESS 0x600370F4 /end MEASUREMENT
/begin MEASUREMENT DFC_st.DFC_EGSDUS2B1TarLean "Status of DFC / Status of diagnostic fault check DFC_EGSDUS2B1TarLean" UBYTE DFC_OneToOne 1 100 0.00 255.0 FORMAT "%5.1" ECU_ADDRESS 0x600370F5 /end MEASUREMENT
/begin MEASUREMENT DFC_st.DFC_EGSDUS2B1TarRich "Status of DFC / Status of diagnostic fault check DFC_EGSDUS2B1TarRich" UBYTE DFC_OneToOne 1 100 0.00 255.0 FORMAT "%5.1" ECU_ADDRESS 0x600370F6 /end MEASUREMENT
/begin MEASUREMENT DFC_st.DFC_EONVmax "Status of DFC / Status of diagnostic fault check DFC_EONVmax" UBYTE DFC_OneToOne 1 100 0.00 255.0 FORMAT "%5.1" ECU_ADDRESS 0x600370F7 /end MEASUREMENT
/begin MEASUREMENT DFC_st.DFC_ETAKHLmax "Status of DFC / Status of diagnostic fault check DFC_ETAKHLmax" UBYTE DFC_OneToOne 1 100 0.00 255.0 FORMAT "%5.1" ECU_ADDRESS 0x600370F8 /end MEASUREMENT
/begin MEASUREMENT DFC_st.DFC_ETAKHTmax "Status of DFC / Status of diagnostic fault check DFC_ETAKHTmax" UBYTE DFC_OneToOne 1 100 0.00 255.0 FORMAT "%5.1" ECU_ADDRESS 0x600370F9 /end MEASUREMENT
/begin MEASUREMENT DFC_st.DFC_ETHSEmax "Status of DFC / Status of diagnostic fault check DFC_ETHSEmax" UBYTE DFC_OneToOne 1 100 0.00 255.0 FORMAT "%5.1" ECU_ADDRESS 0x600370FA /end MEASUREMENT
/begin MEASUREMENT DFC_st.DFC_ETHSEmin "Status of DFC / Status of diagnostic fault check DFC_ETHSEmin" UBYTE DFC_OneToOne 1 100 0.00 255.0 FORMAT "%5.1" ECU_ADDRESS 0x600370FB /end MEASUREMENT
/begin MEASUREMENT DFC_st.DFC_ETHSFmax "Status of DFC / Status of diagnostic fault check DFC_ETHSFmax" UBYTE DFC_OneToOne 1 100 0.00 255.0 FORMAT "%5.1" ECU_ADDRESS 0x600370FC /end MEASUREMENT
/begin MEASUREMENT DFC_st.DFC_ETHSFmin "Status of DFC / Status of diagnostic fault check DFC_ETHSFmin" UBYTE DFC_OneToOne 1 100 0.00 255.0 FORMAT "%5.1" ECU_ADDRESS 0x600370FD /end MEASUREMENT
/begin MEASUREMENT DFC_st.DFC_ETHSFsig "Status of DFC / Status of diagnostic fault check DFC_ETHSFsig" UBYTE DFC_OneToOne 1 100 0.00 255.0 FORMAT "%5.1" ECU_ADDRESS 0x600370FE /end MEASUREMENT
/begin MEASUREMENT DFC_st.DFC_ETHSNPWmax "Status of DFC / Status of diagnostic fault check DFC_ETHSNPWmax" UBYTE DFC_OneToOne 1 100 0.00 255.0 FORMAT "%5.1" ECU_ADDRESS 0x600370FF /end MEASUREMENT
/begin MEASUREMENT DFC_st.DFC_ETHSNPWmin "Status of DFC / Status of diagnostic fault check DFC_ETHSNPWmin" UBYTE DFC_OneToOne 1 100 0.00 255.0 FORMAT "%5.1" ECU_ADDRESS 0x60037100 /end MEASUREMENT
/begin MEASUREMENT DFC_st.DFC_ETHSNPWsig "Status of DFC / Status of diagnostic fault check DFC_ETHSNPWsig" UBYTE DFC_OneToOne 1 100 0.00 255.0 FORMAT "%5.1" ECU_ADDRESS 0x60037101 /end MEASUREMENT
/begin MEASUREMENT DFC_st.DFC_ETHSPLnpl "Status of DFC / Status of diagnostic fault check DFC_ETHSPLnpl" UBYTE DFC_OneToOne 1 100 0.00 255.0 FORMAT "%5.1" ECU_ADDRESS 0x60037102 /end MEASUREMENT
/begin MEASUREMENT DFC_st.DFC_ETHSTPLnpl "Status of DFC / Status of diagnostic fault check DFC_ETHSTPLnpl" UBYTE DFC_OneToOne 1 100 0.00 255.0 FORMAT "%5.1" ECU_ADDRESS 0x60037103 /end MEASUREMENT
/begin MEASUREMENT DFC_st.DFC_EngICO "Status of DFC / Status of diagnostic fault check DFC_EngICO" UBYTE DFC_OneToOne 1 100 0.00 255.0 FORMAT "%5.1" ECU_ADDRESS 0x60037104 /end MEASUREMENT
/begin MEASUREMENT DFC_st.DFC_EngPrtOvrSpdMon "Status of DFC / Status of diagnostic fault check DFC_EngPrtOvrSpdMon" UBYTE DFC_OneToOne 1 100 0.00 255.0 FORMAT "%5.1" ECU_ADDRESS 0x60037105 /end MEASUREMENT
/begin MEASUREMENT DFC_st.DFC_EpmCaSI1ErrSig "Status of DFC / Status of diagnostic fault check DFC_EpmCaSI1ErrSig" UBYTE DFC_OneToOne 1 100 0.00 255.0 FORMAT "%5.1" ECU_ADDRESS 0x60037106 /end MEASUREMENT
/begin MEASUREMENT DFC_st.DFC_EpmCaSI1MntErr "Status of DFC / Status of diagnostic fault check DFC_EpmCaSI1MntErr" UBYTE DFC_OneToOne 1 100 0.00 255.0 FORMAT "%5.1" ECU_ADDRESS 0x60037107 /end MEASUREMENT
/begin MEASUREMENT DFC_st.DFC_EpmCaSI1NoSigMax "Status of DFC / Status of diagnostic fault check DFC_EpmCaSI1NoSigMax" UBYTE DFC_OneToOne 1 100 0.00 255.0 FORMAT "%5.1" ECU_ADDRESS 0x60037108 /end MEASUREMENT
/begin MEASUREMENT DFC_st.DFC_EpmCaSI1NoSigMin "Status of DFC / Status of diagnostic fault check DFC_EpmCaSI1NoSigMin" UBYTE DFC_OneToOne 1 100 0.00 255.0 FORMAT "%5.1" ECU_ADDRESS 0x60037109 /end MEASUREMENT
/begin MEASUREMENT DFC_st.DFC_EpmCaSI1OfsErr "Status of DFC / Status of diagnostic fault check DFC_EpmCaSI1OfsErr" UBYTE DFC_OneToOne 1 100 0.00 255.0 FORMAT "%5.1" ECU_ADDRESS 0x6003710A /end MEASUREMENT
/begin MEASUREMENT DFC_st.DFC_EpmCrSDGI "Status of DFC / Status of diagnostic fault check DFC_EpmCrSDGI" UBYTE DFC_OneToOne 1 100 0.00 255.0 FORMAT "%5.1" ECU_ADDRESS 0x6003710B /end MEASUREMENT
/begin MEASUREMENT DFC_st.DFC_EpmCrSErrSig "Status of DFC / Status of diagnostic fault check DFC_EpmCrSErrSig" UBYTE DFC_OneToOne 1 100 0.00 255.0 FORMAT "%5.1" ECU_ADDRESS 0x6003710C /end MEASUREMENT
/begin MEASUREMENT DFC_st.DFC_EpmCrSNoSig "Status of DFC / Status of diagnostic fault check DFC_EpmCrSNoSig" UBYTE DFC_OneToOne 1 100 0.00 255.0 FORMAT "%5.1" ECU_ADDRESS 0x6003710D /end MEASUREMENT
/begin MEASUREMENT DFC_st.DFC_EtaEngIdleNonCsers "Status of DFC / Status of diagnostic fault check DFC_EtaEngIdleNonCsers" UBYTE DFC_OneToOne 1 100 0.00 255.0 FORMAT "%5.1" ECU_ADDRESS 0x6003710E /end MEASUREMENT
/begin MEASUREMENT DFC_st.DFC_EtaEngPtlNonCsers "Status of DFC / Status of diagnostic fault check DFC_EtaEngPtlNonCsers" UBYTE DFC_OneToOne 1 100 0.00 255.0 FORMAT "%5.1" ECU_ADDRESS 0x6003710F /end MEASUREMENT
/begin MEASUREMENT DFC_st.DFC_FRAmax "Status of DFC / Status of diagnostic fault check DFC_FRAmax" UBYTE DFC_OneToOne 1 100 0.00 255.0 FORMAT "%5.1" ECU_ADDRESS 0x60037110 /end MEASUREMENT
/begin MEASUREMENT DFC_st.DFC_FRAmin "Status of DFC / Status of diagnostic fault check DFC_FRAmin" UBYTE DFC_OneToOne 1 100 0.00 255.0 FORMAT "%5.1" ECU_ADDRESS 0x60037111 /end MEASUREMENT
/begin MEASUREMENT DFC_st.DFC_FSTEmax "Status of DFC / Status of diagnostic fault check DFC_FSTEmax" UBYTE DFC_OneToOne 1 100 0.00 255.0 FORMAT "%5.1" ECU_ADDRESS 0x60037112 /end MEASUREMENT
/begin MEASUREMENT DFC_st.DFC_FSTEmin "Status of DFC / Status of diagnostic fault check DFC_FSTEmin" UBYTE DFC_OneToOne 1 100 0.00 255.0 FORMAT "%5.1" ECU_ADDRESS 0x60037113 /end MEASUREMENT
/begin MEASUREMENT DFC_st.DFC_FSTRmax "Status of DFC / Status of diagnostic fault check DFC_FSTRmax" UBYTE DFC_OneToOne 1 100 0.00 255.0 FORMAT "%5.1" ECU_ADDRESS 0x60037114 /end MEASUREMENT
/begin MEASUREMENT DFC_st.DFC_FSTRmin "Status of DFC / Status of diagnostic fault check DFC_FSTRmin" UBYTE DFC_OneToOne 1 100 0.00 255.0 FORMAT "%5.1" ECU_ADDRESS 0x60037115 /end MEASUREMENT
/begin MEASUREMENT DFC_st.DFC_FSTRnpl "Status of DFC / Status of diagnostic fault check DFC_FSTRnpl" UBYTE DFC_OneToOne 1 100 0.00 255.0 FORMAT "%5.1" ECU_ADDRESS 0x60037116 /end MEASUREMENT
/begin MEASUREMENT DFC_st.DFC_FSTmax "Status of DFC / Status of diagnostic fault check DFC_FSTmax" UBYTE DFC_OneToOne 1 100 0.00 255.0 FORMAT "%5.1" ECU_ADDRESS 0x60037117 /end MEASUREMENT
/begin MEASUREMENT DFC_st.DFC_FTDLAmax "Status of DFC / Status of diagnostic fault check DFC_FTDLAmax" UBYTE DFC_OneToOne 1 100 0.00 255.0 FORMAT "%5.1" ECU_ADDRESS 0x60037118 /end MEASUREMENT
/begin MEASUREMENT DFC_st.DFC_FTDLAmin "Status of DFC / Status of diagnostic fault check DFC_FTDLAmin" UBYTE DFC_OneToOne 1 100 0.00 255.0 FORMAT "%5.1" ECU_ADDRESS 0x60037119 /end MEASUREMENT
/begin MEASUREMENT DFC_st.DFC_FuPHiSnsrEleclmax "Status of DFC / Status of diagnostic fault check DFC_FuPHiSnsrEleclmax" UBYTE DFC_OneToOne 1 100 0.00 255.0 FORMAT "%5.1" ECU_ADDRESS 0x6003711A /end MEASUREMENT
/begin MEASUREMENT DFC_st.DFC_FuPHiSnsrEleclmin "Status of DFC / Status of diagnostic fault check DFC_FuPHiSnsrEleclmin" UBYTE DFC_OneToOne 1 100 0.00 255.0 FORMAT "%5.1" ECU_ADDRESS 0x6003711B /end MEASUREMENT
/begin MEASUREMENT DFC_st.DFC_FuPHiSnsrEleclnpl "Status of DFC / Status of diagnostic fault check DFC_FuPHiSnsrEleclnpl" UBYTE DFC_OneToOne 1 100 0.00 255.0 FORMAT "%5.1" ECU_ADDRESS 0x6003711C /end MEASUREMENT
/begin MEASUREMENT DFC_st.DFC_FuPHiSnsrURngMax "Status of DFC / Status of diagnostic fault check DFC_FuPHiSnsrURngMax" UBYTE DFC_OneToOne 1 100 0.00 255.0 FORMAT "%5.1" ECU_ADDRESS 0x6003711D /end MEASUREMENT
/begin MEASUREMENT DFC_st.DFC_FuPHiSnsrURngMin "Status of DFC / Status of diagnostic fault check DFC_FuPHiSnsrURngMin" UBYTE DFC_OneToOne 1 100 0.00 255.0 FORMAT "%5.1" ECU_ADDRESS 0x6003711E /end MEASUREMENT
/begin MEASUREMENT DFC_st.DFC_FuSnsrPhyRngMaxErr "Status of DFC / Status of diagnostic fault check DFC_FuSnsrPhyRngMaxErr" UBYTE DFC_OneToOne 1 100 0.00 255.0 FORMAT "%5.1" ECU_ADDRESS 0x6003711F /end MEASUREMENT
/begin MEASUREMENT DFC_st.DFC_FuSnsrPhyRngMinErr "Status of DFC / Status of diagnostic fault check DFC_FuSnsrPhyRngMinErr" UBYTE DFC_OneToOne 1 100 0.00 255.0 FORMAT "%5.1" ECU_ADDRESS 0x60037120 /end MEASUREMENT
/begin MEASUREMENT DFC_st.DFC_GEVlvLockPinDiagIntkB1 "Status of DFC / Status of diagnostic fault check DFC_GEVlvLockPinDiagIntkB1" UBYTE DFC_OneToOne 1 100 0.00 255.0 FORMAT "%5.1" ECU_ADDRESS 0x60037121 /end MEASUREMENT
/begin MEASUREMENT DFC_st.DFC_GEVlvPhaSlowIntkB1 "Status of DFC / Status of diagnostic fault check DFC_GEVlvPhaSlowIntkB1" UBYTE DFC_OneToOne 1 100 0.00 255.0 FORMAT "%5.1" ECU_ADDRESS 0x60037122 /end MEASUREMENT
/begin MEASUREMENT DFC_st.DFC_GEVlvPhaTargIntkB1 "Status of DFC / Status of diagnostic fault check DFC_GEVlvPhaTargIntkB1" UBYTE DFC_OneToOne 1 100 0.00 255.0 FORMAT "%5.1" ECU_ADDRESS 0x60037123 /end MEASUREMENT
/begin MEASUREMENT DFC_st.DFC_GbxRvsSwtStk "Status of DFC / Status of diagnostic fault check DFC_GbxRvsSwtStk" UBYTE DFC_OneToOne 1 100 0.00 255.0 FORMAT "%5.1" ECU_ADDRESS 0x60037124 /end MEASUREMENT
/begin MEASUREMENT DFC_st.DFC_HDRKHmax "Status of DFC / Status of diagnostic fault check DFC_HDRKHmax" UBYTE DFC_OneToOne 1 100 0.00 255.0 FORMAT "%5.1" ECU_ADDRESS 0x60037125 /end MEASUREMENT
/begin MEASUREMENT DFC_st.DFC_HDRKHmin "Status of DFC / Status of diagnostic fault check DFC_HDRKHmin" UBYTE DFC_OneToOne 1 100 0.00 255.0 FORMAT "%5.1" ECU_ADDRESS 0x60037126 /end MEASUREMENT
/begin MEASUREMENT DFC_st.DFC_HDRPLmax "Status of DFC / Status of diagnostic fault check DFC_HDRPLmax" UBYTE DFC_OneToOne 1 100 0.00 255.0 FORMAT "%5.1" ECU_ADDRESS 0x60037127 /end MEASUREMENT
/begin MEASUREMENT DFC_st.DFC_HDRPLmin "Status of DFC / Status of diagnostic fault check DFC_HDRPLmin" UBYTE DFC_OneToOne 1 100 0.00 255.0 FORMAT "%5.1" ECU_ADDRESS 0x60037128 /end MEASUREMENT
/begin MEASUREMENT DFC_st.DFC_HDRmax "Status of DFC / Status of diagnostic fault check DFC_HDRmax" UBYTE DFC_OneToOne 1 100 0.00 255.0 FORMAT "%5.1" ECU_ADDRESS 0x60037129 /end MEASUREMENT
/begin MEASUREMENT DFC_st.DFC_HDRmin "Status of DFC / Status of diagnostic fault check DFC_HDRmin" UBYTE DFC_OneToOne 1 100 0.00 255.0 FORMAT "%5.1" ECU_ADDRESS 0x6003712A /end MEASUREMENT
/begin MEASUREMENT DFC_st.DFC_HEGOS2B1ElecMax "Status of DFC / Status of diagnostic fault check DFC_HEGOS2B1ElecMax" UBYTE DFC_OneToOne 1 100 0.00 255.0 FORMAT "%5.1" ECU_ADDRESS 0x6003712B /end MEASUREMENT
/begin MEASUREMENT DFC_st.DFC_HEGOS2B1ElecMin "Status of DFC / Status of diagnostic fault check DFC_HEGOS2B1ElecMin" UBYTE DFC_OneToOne 1 100 0.00 255.0 FORMAT "%5.1" ECU_ADDRESS 0x6003712C /end MEASUREMENT
/begin MEASUREMENT DFC_st.DFC_HEGOS2B1ElecSig "Status of DFC / Status of diagnostic fault check DFC_HEGOS2B1ElecSig" UBYTE DFC_OneToOne 1 100 0.00 255.0 FORMAT "%5.1" ECU_ADDRESS 0x6003712D /end MEASUREMENT
/begin MEASUREMENT DFC_st.DFC_HEGOS2B1HtgNpl "Status of DFC / Status of diagnostic fault check DFC_HEGOS2B1HtgNpl" UBYTE DFC_OneToOne 1 100 0.00 255.0 FORMAT "%5.1" ECU_ADDRESS 0x6003712E /end MEASUREMENT
/begin MEASUREMENT DFC_st.DFC_HEV00max "Status of DFC / Status of diagnostic fault check DFC_HEV00max" UBYTE DFC_OneToOne 1 100 0.00 255.0 FORMAT "%5.1" ECU_ADDRESS 0x6003712F /end MEASUREMENT
/begin MEASUREMENT DFC_st.DFC_HEV01max "Status of DFC / Status of diagnostic fault check DFC_HEV01max" UBYTE DFC_OneToOne 1 100 0.00 255.0 FORMAT "%5.1" ECU_ADDRESS 0x60037130 /end MEASUREMENT
/begin MEASUREMENT DFC_st.DFC_HEV02max "Status of DFC / Status of diagnostic fault check DFC_HEV02max" UBYTE DFC_OneToOne 1 100 0.00 255.0 FORMAT "%5.1" ECU_ADDRESS 0x60037131 /end MEASUREMENT
/begin MEASUREMENT DFC_st.DFC_HEV03max "Status of DFC / Status of diagnostic fault check DFC_HEV03max" UBYTE DFC_OneToOne 1 100 0.00 255.0 FORMAT "%5.1" ECU_ADDRESS 0x60037132 /end MEASUREMENT
/begin MEASUREMENT DFC_st.DFC_HEVE0max "Status of DFC / Status of diagnostic fault check DFC_HEVE0max" UBYTE DFC_OneToOne 1 100 0.00 255.0 FORMAT "%5.1" ECU_ADDRESS 0x60037133 /end MEASUREMENT
/begin MEASUREMENT DFC_st.DFC_HEVE1max "Status of DFC / Status of diagnostic fault check DFC_HEVE1max" UBYTE DFC_OneToOne 1 100 0.00 255.0 FORMAT "%5.1" ECU_ADDRESS 0x60037134 /end MEASUREMENT
/begin MEASUREMENT DFC_st.DFC_HFMmax "Status of DFC / Status of diagnostic fault check DFC_HFMmax" UBYTE DFC_OneToOne 1 100 0.00 255.0 FORMAT "%5.1" ECU_ADDRESS 0x60037135 /end MEASUREMENT
/begin MEASUREMENT DFC_st.DFC_HiPSysHiPMaxLimExcdd "Status of DFC / Status of diagnostic fault check DFC_HiPSysHiPMaxLimExcdd" UBYTE DFC_OneToOne 1 100 0.00 255.0 FORMAT "%5.1" ECU_ADDRESS 0x60037136 /end MEASUREMENT
/begin MEASUREMENT DFC_st.DFC_IVGdiCtlCvoErrMax_0 "Status of DFC / Status of diagnostic fault check DFC_IVGdiCtlCvoErrMax_0" UBYTE DFC_OneToOne 1 100 0.00 255.0 FORMAT "%5.1" ECU_ADDRESS 0x60037137 /end MEASUREMENT
/begin MEASUREMENT DFC_st.DFC_IVGdiCtlCvoErrMax_1 "Status of DFC / Status of diagnostic fault check DFC_IVGdiCtlCvoErrMax_1" UBYTE DFC_OneToOne 1 100 0.00 255.0 FORMAT "%5.1" ECU_ADDRESS 0x60037138 /end MEASUREMENT
/begin MEASUREMENT DFC_st.DFC_IVGdiCtlCvoErrMax_2 "Status of DFC / Status of diagnostic fault check DFC_IVGdiCtlCvoErrMax_2" UBYTE DFC_OneToOne 1 100 0.00 255.0 FORMAT "%5.1" ECU_ADDRESS 0x60037139 /end MEASUREMENT
/begin MEASUREMENT DFC_st.DFC_IVGdiCtlCvoErrMax_3 "Status of DFC / Status of diagnostic fault check DFC_IVGdiCtlCvoErrMax_3" UBYTE DFC_OneToOne 1 100 0.00 255.0 FORMAT "%5.1" ECU_ADDRESS 0x6003713A /end MEASUREMENT
/begin MEASUREMENT DFC_st.DFC_IVGdiCtlCvoErrMin_0 "Status of DFC / Status of diagnostic fault check DFC_IVGdiCtlCvoErrMin_0" UBYTE DFC_OneToOne 1 100 0.00 255.0 FORMAT "%5.1" ECU_ADDRESS 0x6003713B /end MEASUREMENT
/begin MEASUREMENT DFC_st.DFC_IVGdiCtlCvoErrMin_1 "Status of DFC / Status of diagnostic fault check DFC_IVGdiCtlCvoErrMin_1" UBYTE DFC_OneToOne 1 100 0.00 255.0 FORMAT "%5.1" ECU_ADDRESS 0x6003713C /end MEASUREMENT
/begin MEASUREMENT DFC_st.DFC_IVGdiCtlCvoErrMin_2 "Status of DFC / Status of diagnostic fault check DFC_IVGdiCtlCvoErrMin_2" UBYTE DFC_OneToOne 1 100 0.00 255.0 FORMAT "%5.1" ECU_ADDRESS 0x6003713D /end MEASUREMENT
/begin MEASUREMENT DFC_st.DFC_IVGdiCtlCvoErrMin_3 "Status of DFC / Status of diagnostic fault check DFC_IVGdiCtlCvoErrMin_3" UBYTE DFC_OneToOne 1 100 0.00 255.0 FORMAT "%5.1" ECU_ADDRESS 0x6003713E /end MEASUREMENT
/begin MEASUREMENT DFC_st.DFC_IVGdiCtlCvoErrMinMax "Status of DFC / Status of diagnostic fault check DFC_IVGdiCtlCvoErrMinMax" UBYTE DFC_OneToOne 1 100 0.00 255.0 FORMAT "%5.1" ECU_ADDRESS 0x6003713F /end MEASUREMENT
/begin MEASUREMENT DFC_st.DFC_IVGdiCtlCvoSigPlausErrSmrCdn "Status of DFC / Status of diagnostic fault check DFC_IVGdiCtlCvoSigPlausErrSmrCdn" UBYTE DFC_OneToOne 1 100 0.00 255.0 FORMAT "%5.1" ECU_ADDRESS 0x60037140 /end MEASUREMENT
/begin MEASUREMENT DFC_st.DFC_IVGdiCtl_CvoErr "Status of DFC / Status of diagnostic fault check DFC_IVGdiCtl_CvoErr" UBYTE DFC_OneToOne 1 100 0.00 255.0 FORMAT "%5.1" ECU_ADDRESS 0x60037141 /end MEASUREMENT
/begin MEASUREMENT DFC_st.DFC_IVGdiCtl_CvoSigPlaus_0 "Status of DFC / Status of diagnostic fault check DFC_IVGdiCtl_CvoSigPlaus_0" UBYTE DFC_OneToOne 1 100 0.00 255.0 FORMAT "%5.1" ECU_ADDRESS 0x60037142 /end MEASUREMENT
/begin MEASUREMENT DFC_st.DFC_IVGdiCtl_CvoSigPlaus_1 "Status of DFC / Status of diagnostic fault check DFC_IVGdiCtl_CvoSigPlaus_1" UBYTE DFC_OneToOne 1 100 0.00 255.0 FORMAT "%5.1" ECU_ADDRESS 0x60037143 /end MEASUREMENT
/begin MEASUREMENT DFC_st.DFC_IVGdiCtl_CvoSigPlaus_2 "Status of DFC / Status of diagnostic fault check DFC_IVGdiCtl_CvoSigPlaus_2" UBYTE DFC_OneToOne 1 100 0.00 255.0 FORMAT "%5.1" ECU_ADDRESS 0x60037144 /end MEASUREMENT
/begin MEASUREMENT DFC_st.DFC_IVGdiCtl_CvoSigPlaus_3 "Status of DFC / Status of diagnostic fault check DFC_IVGdiCtl_CvoSigPlaus_3" UBYTE DFC_OneToOne 1 100 0.00 255.0 FORMAT "%5.1" ECU_ADDRESS 0x60037145 /end MEASUREMENT
/begin MEASUREMENT DFC_st.DFC_IntkAirTAirFltDsCrssMax "Status of DFC / Status of diagnostic fault check DFC_IntkAirTAirFltDsCrssMax" UBYTE DFC_OneToOne 1 100 0.00 255.0 FORMAT "%5.1" ECU_ADDRESS 0x60037146 /end MEASUREMENT
/begin MEASUREMENT DFC_st.DFC_IntkAirTAirFltDsCrssMin "Status of DFC / Status of diagnostic fault check DFC_IntkAirTAirFltDsCrssMin" UBYTE DFC_OneToOne 1 100 0.00 255.0 FORMAT "%5.1" ECU_ADDRESS 0x60037147 /end MEASUREMENT
/begin MEASUREMENT DFC_st.DFC_IntkAirTAirFltDsHSCMax "Status of DFC / Status of diagnostic fault check DFC_IntkAirTAirFltDsHSCMax" UBYTE DFC_OneToOne 1 100 0.00 255.0 FORMAT "%5.1" ECU_ADDRESS 0x60037148 /end MEASUREMENT
/begin MEASUREMENT DFC_st.DFC_IntkAirTAirFltDsImps "Status of DFC / Status of diagnostic fault check DFC_IntkAirTAirFltDsImps" UBYTE DFC_OneToOne 1 100 0.00 255.0 FORMAT "%5.1" ECU_ADDRESS 0x60037149 /end MEASUREMENT
/begin MEASUREMENT DFC_st.DFC_IntkAirTAirFltDsPRCMax "Status of DFC / Status of diagnostic fault check DFC_IntkAirTAirFltDsPRCMax" UBYTE DFC_OneToOne 1 100 0.00 255.0 FORMAT "%5.1" ECU_ADDRESS 0x6003714A /end MEASUREMENT
/begin MEASUREMENT DFC_st.DFC_IntkAirTAirFltDsPRCMin "Status of DFC / Status of diagnostic fault check DFC_IntkAirTAirFltDsPRCMin" UBYTE DFC_OneToOne 1 100 0.00 255.0 FORMAT "%5.1" ECU_ADDRESS 0x6003714B /end MEASUREMENT
/begin MEASUREMENT DFC_st.DFC_IntkAirTAirFltDsSRCMax "Status of DFC / Status of diagnostic fault check DFC_IntkAirTAirFltDsSRCMax" UBYTE DFC_OneToOne 1 100 0.00 255.0 FORMAT "%5.1" ECU_ADDRESS 0x6003714C /end MEASUREMENT
/begin MEASUREMENT DFC_st.DFC_IntkAirTAirFltDsSRCMin "Status of DFC / Status of diagnostic fault check DFC_IntkAirTAirFltDsSRCMin" UBYTE DFC_OneToOne 1 100 0.00 255.0 FORMAT "%5.1" ECU_ADDRESS 0x6003714D /end MEASUREMENT
/begin MEASUREMENT DFC_st.DFC_IntkAirTAirFltDsSTC "Status of DFC / Status of diagnostic fault check DFC_IntkAirTAirFltDsSTC" UBYTE DFC_OneToOne 1 100 0.00 255.0 FORMAT "%5.1" ECU_ADDRESS 0x6003714E /end MEASUREMENT
/begin MEASUREMENT DFC_st.DFC_IntkAirTIntkMnfldCrssMax "Status of DFC / Status of diagnostic fault check DFC_IntkAirTIntkMnfldCrssMax" UBYTE DFC_OneToOne 1 100 0.00 255.0 FORMAT "%5.1" ECU_ADDRESS 0x6003714F /end MEASUREMENT
/begin MEASUREMENT DFC_st.DFC_IntkAirTIntkMnfldCrssMin "Status of DFC / Status of diagnostic fault check DFC_IntkAirTIntkMnfldCrssMin" UBYTE DFC_OneToOne 1 100 0.00 255.0 FORMAT "%5.1" ECU_ADDRESS 0x60037150 /end MEASUREMENT
/begin MEASUREMENT DFC_st.DFC_IntkAirTIntkMnfldHSCMax "Status of DFC / Status of diagnostic fault check DFC_IntkAirTIntkMnfldHSCMax" UBYTE DFC_OneToOne 1 100 0.00 255.0 FORMAT "%5.1" ECU_ADDRESS 0x60037151 /end MEASUREMENT
/begin MEASUREMENT DFC_st.DFC_IntkAirTIntkMnfldImps "Status of DFC / Status of diagnostic fault check DFC_IntkAirTIntkMnfldImps" UBYTE DFC_OneToOne 1 100 0.00 255.0 FORMAT "%5.1" ECU_ADDRESS 0x60037152 /end MEASUREMENT
/begin MEASUREMENT DFC_st.DFC_IntkAirTIntkMnfldPRCMax "Status of DFC / Status of diagnostic fault check DFC_IntkAirTIntkMnfldPRCMax" UBYTE DFC_OneToOne 1 100 0.00 255.0 FORMAT "%5.1" ECU_ADDRESS 0x60037153 /end MEASUREMENT
/begin MEASUREMENT DFC_st.DFC_IntkAirTIntkMnfldPRCMin "Status of DFC / Status of diagnostic fault check DFC_IntkAirTIntkMnfldPRCMin" UBYTE DFC_OneToOne 1 100 0.00 255.0 FORMAT "%5.1" ECU_ADDRESS 0x60037154 /end MEASUREMENT
/begin MEASUREMENT DFC_st.DFC_IntkAirTIntkMnfldSRCMax "Status of DFC / Status of diagnostic fault check DFC_IntkAirTIntkMnfldSRCMax" UBYTE DFC_OneToOne 1 100 0.00 255.0 FORMAT "%5.1" ECU_ADDRESS 0x60037155 /end MEASUREMENT
/begin MEASUREMENT DFC_st.DFC_IntkAirTIntkMnfldSRCMin "Status of DFC / Status of diagnostic fault check DFC_IntkAirTIntkMnfldSRCMin" UBYTE DFC_OneToOne 1 100 0.00 255.0 FORMAT "%5.1" ECU_ADDRESS 0x60037156 /end MEASUREMENT
/begin MEASUREMENT DFC_st.DFC_IntkAirTIntkMnfldSTC "Status of DFC / Status of diagnostic fault check DFC_IntkAirTIntkMnfldSTC" UBYTE DFC_OneToOne 1 100 0.00 255.0 FORMAT "%5.1" ECU_ADDRESS 0x60037157 /end MEASUREMENT
/begin MEASUREMENT DFC_st.DFC_KRREGRLMX "Status of DFC / Status of diagnostic fault check DFC_KRREGRLMX" UBYTE DFC_OneToOne 1 100 0.00 255.0 FORMAT "%5.1" ECU_ADDRESS 0x60037158 /end MEASUREMENT
/begin MEASUREMENT DFC_st.DFC_KRVEKOCVLCI "Status of DFC / Status of diagnostic fault check DFC_KRVEKOCVLCI" UBYTE DFC_OneToOne 1 100 0.00 255.0 FORMAT "%5.1" ECU_ADDRESS 0x60037159 /end MEASUREMENT
/begin MEASUREMENT DFC_st.DFC_KRVEKOENCHMT "Status of DFC / Status of diagnostic fault check DFC_KRVEKOENCHMT" UBYTE DFC_OneToOne 1 100 0.00 255.0 FORMAT "%5.1" ECU_ADDRESS 0x6003715A /end MEASUREMENT
/begin MEASUREMENT DFC_st.DFC_KRVEKOENCHMT0 "Status of DFC / Status of diagnostic fault check DFC_KRVEKOENCHMT0" UBYTE DFC_OneToOne 1 100 0.00 255.0 FORMAT "%5.1" ECU_ADDRESS 0x6003715B /end MEASUREMENT
/begin MEASUREMENT DFC_st.DFC_KRVEKOENCHMT1 "Status of DFC / Status of diagnostic fault check DFC_KRVEKOENCHMT1" UBYTE DFC_OneToOne 1 100 0.00 255.0 FORMAT "%5.1" ECU_ADDRESS 0x6003715C /end MEASUREMENT
/begin MEASUREMENT DFC_st.DFC_KRVEKOENCHMT2 "Status of DFC / Status of diagnostic fault check DFC_KRVEKOENCHMT2" UBYTE DFC_OneToOne 1 100 0.00 255.0 FORMAT "%5.1" ECU_ADDRESS 0x6003715D /end MEASUREMENT
/begin MEASUREMENT DFC_st.DFC_KRVEKOENCHMT3 "Status of DFC / Status of diagnostic fault check DFC_KRVEKOENCHMT3" UBYTE DFC_OneToOne 1 100 0.00 255.0 FORMAT "%5.1" ECU_ADDRESS 0x6003715E /end MEASUREMENT
/begin MEASUREMENT DFC_st.DFC_KRVEKOENCHMT4 "Status of DFC / Status of diagnostic fault check DFC_KRVEKOENCHMT4" UBYTE DFC_OneToOne 1 100 0.00 255.0 FORMAT "%5.1" ECU_ADDRESS 0x6003715F /end MEASUREMENT
/begin MEASUREMENT DFC_st.DFC_KRVEKOENCHMT5 "Status of DFC / Status of diagnostic fault check DFC_KRVEKOENCHMT5" UBYTE DFC_OneToOne 1 100 0.00 255.0 FORMAT "%5.1" ECU_ADDRESS 0x60037160 /end MEASUREMENT
/begin MEASUREMENT DFC_st.DFC_KRVEKOENCHMT6 "Status of DFC / Status of diagnostic fault check DFC_KRVEKOENCHMT6" UBYTE DFC_OneToOne 1 100 0.00 255.0 FORMAT "%5.1" ECU_ADDRESS 0x60037161 /end MEASUREMENT
/begin MEASUREMENT DFC_st.DFC_KRVEKOENCHMT7 "Status of DFC / Status of diagnostic fault check DFC_KRVEKOENCHMT7" UBYTE DFC_OneToOne 1 100 0.00 255.0 FORMAT "%5.1" ECU_ADDRESS 0x60037162 /end MEASUREMENT
/begin MEASUREMENT DFC_st.DFC_KRVEKORLMX "Status of DFC / Status of diagnostic fault check DFC_KRVEKORLMX" UBYTE DFC_OneToOne 1 100 0.00 255.0 FORMAT "%5.1" ECU_ADDRESS 0x60037163 /end MEASUREMENT
/begin MEASUREMENT DFC_st.DFC_KRVEKORLMXL "Status of DFC / Status of diagnostic fault check DFC_KRVEKORLMXL" UBYTE DFC_OneToOne 1 100 0.00 255.0 FORMAT "%5.1" ECU_ADDRESS 0x60037164 /end MEASUREMENT
/begin MEASUREMENT DFC_st.DFC_KS1max "Status of DFC / Status of diagnostic fault check DFC_KS1max" UBYTE DFC_OneToOne 1 100 0.00 255.0 FORMAT "%5.1" ECU_ADDRESS 0x60037165 /end MEASUREMENT
/begin MEASUREMENT DFC_st.DFC_KS1min "Status of DFC / Status of diagnostic fault check DFC_KS1min" UBYTE DFC_OneToOne 1 100 0.00 255.0 FORMAT "%5.1" ECU_ADDRESS 0x60037166 /end MEASUREMENT
/begin MEASUREMENT DFC_st.DFC_LMmax "Status of DFC / Status of diagnostic fault check DFC_LMmax" UBYTE DFC_OneToOne 1 100 0.00 255.0 FORMAT "%5.1" ECU_ADDRESS 0x60037167 /end MEASUREMENT
/begin MEASUREMENT DFC_st.DFC_LZSRnpl "Status of DFC / Status of diagnostic fault check DFC_LZSRnpl" UBYTE DFC_OneToOne 1 100 0.00 255.0 FORMAT "%5.1" ECU_ADDRESS 0x60037168 /end MEASUREMENT
/begin MEASUREMENT DFC_st.DFC_LamDynDiagS1B1 "Status of DFC / Status of diagnostic fault check DFC_LamDynDiagS1B1" UBYTE DFC_OneToOne 1 100 0.00 255.0 FORMAT "%5.1" ECU_ADDRESS 0x60037169 /end MEASUREMENT
/begin MEASUREMENT DFC_st.DFC_LeakIntkMnfldEmiInfl "Status of DFC / Status of diagnostic fault check DFC_LeakIntkMnfldEmiInfl" UBYTE DFC_OneToOne 1 100 0.00 255.0 FORMAT "%5.1" ECU_ADDRESS 0x6003716A /end MEASUREMENT
/begin MEASUREMENT DFC_st.DFC_LinFrameErrDCDC "Status of DFC / Status of diagnostic fault check DFC_LinFrameErrDCDC" UBYTE DFC_OneToOne 1 100 0.00 255.0 FORMAT "%5.1" ECU_ADDRESS 0x6003716B /end MEASUREMENT
/begin MEASUREMENT DFC_st.DFC_LinOverrunErrDCDC "Status of DFC / Status of diagnostic fault check DFC_LinOverrunErrDCDC" UBYTE DFC_OneToOne 1 100 0.00 255.0 FORMAT "%5.1" ECU_ADDRESS 0x6003716C /end MEASUREMENT
/begin MEASUREMENT DFC_st.DFC_MD00max "Status of DFC / Status of diagnostic fault check DFC_MD00max" UBYTE DFC_OneToOne 1 100 0.00 255.0 FORMAT "%5.1" ECU_ADDRESS 0x6003716D /end MEASUREMENT
/begin MEASUREMENT DFC_st.DFC_MDBmax "Status of DFC / Status of diagnostic fault check DFC_MDBmax" UBYTE DFC_OneToOne 1 100 0.00 255.0 FORMAT "%5.1" ECU_ADDRESS 0x6003716E /end MEASUREMENT
/begin MEASUREMENT DFC_st.DFC_MDCat "Status of DFC / Status of diagnostic fault check DFC_MDCat" UBYTE DFC_OneToOne 1 100 0.00 255.0 FORMAT "%5.1" ECU_ADDRESS 0x6003716F /end MEASUREMENT
/begin MEASUREMENT DFC_st.DFC_MDCatCrit "Status of DFC / Status of diagnostic fault check DFC_MDCatCrit" UBYTE DFC_OneToOne 1 100 0.00 255.0 FORMAT "%5.1" ECU_ADDRESS 0x60037170 /end MEASUREMENT
/begin MEASUREMENT DFC_st.DFC_MDCatCurr "Status of DFC / Status of diagnostic fault check DFC_MDCatCurr" UBYTE DFC_OneToOne 1 100 0.00 255.0 FORMAT "%5.1" ECU_ADDRESS 0x60037171 /end MEASUREMENT
/begin MEASUREMENT DFC_st.DFC_MDCyl_0 "Status of DFC / Status of diagnostic fault check DFC_MDCyl_0" UBYTE DFC_OneToOne 1 100 0.00 255.0 FORMAT "%5.1" ECU_ADDRESS 0x60037172 /end MEASUREMENT
/begin MEASUREMENT DFC_st.DFC_MDCyl_1 "Status of DFC / Status of diagnostic fault check DFC_MDCyl_1" UBYTE DFC_OneToOne 1 100 0.00 255.0 FORMAT "%5.1" ECU_ADDRESS 0x60037173 /end MEASUREMENT
/begin MEASUREMENT DFC_st.DFC_MDCyl_2 "Status of DFC / Status of diagnostic fault check DFC_MDCyl_2" UBYTE DFC_OneToOne 1 100 0.00 255.0 FORMAT "%5.1" ECU_ADDRESS 0x60037174 /end MEASUREMENT
/begin MEASUREMENT DFC_st.DFC_MDCyl_3 "Status of DFC / Status of diagnostic fault check DFC_MDCyl_3" UBYTE DFC_OneToOne 1 100 0.00 255.0 FORMAT "%5.1" ECU_ADDRESS 0x60037175 /end MEASUREMENT
/begin MEASUREMENT DFC_st.DFC_MDEmi "Status of DFC / Status of diagnostic fault check DFC_MDEmi" UBYTE DFC_OneToOne 1 100 0.00 255.0 FORMAT "%5.1" ECU_ADDRESS 0x60037176 /end MEASUREMENT
/begin MEASUREMENT DFC_st.DFC_MDEmiStrt "Status of DFC / Status of diagnostic fault check DFC_MDEmiStrt" UBYTE DFC_OneToOne 1 100 0.00 255.0 FORMAT "%5.1" ECU_ADDRESS 0x60037177 /end MEASUREMENT
/begin MEASUREMENT DFC_st.DFC_MDFco "Status of DFC / Status of diagnostic fault check DFC_MDFco" UBYTE DFC_OneToOne 1 100 0.00 255.0 FORMAT "%5.1" ECU_ADDRESS 0x60037178 /end MEASUREMENT
/begin MEASUREMENT DFC_st.DFC_MDMpl "Status of DFC / Status of diagnostic fault check DFC_MDMpl" UBYTE DFC_OneToOne 1 100 0.00 255.0 FORMAT "%5.1" ECU_ADDRESS 0x60037179 /end MEASUREMENT
/begin MEASUREMENT DFC_st.DFC_MDSegTiAdpn "Status of DFC / Status of diagnostic fault check DFC_MDSegTiAdpn" UBYTE DFC_OneToOne 1 100 0.00 255.0 FORMAT "%5.1" ECU_ADDRESS 0x6003717A /end MEASUREMENT
/begin MEASUREMENT DFC_st.DFC_MDmax "Status of DFC / Status of diagnostic fault check DFC_MDmax" UBYTE DFC_OneToOne 1 100 0.00 255.0 FORMAT "%5.1" ECU_ADDRESS 0x6003717B /end MEASUREMENT
/begin MEASUREMENT DFC_st.DFC_MFuOilMax "Status of DFC / Status of diagnostic fault check DFC_MFuOilMax" UBYTE DFC_OneToOne 1 100 0.00 255.0 FORMAT "%5.1" ECU_ADDRESS 0x6003717C /end MEASUREMENT
/begin MEASUREMENT DFC_st.DFC_MOXEMM_SMU_ALM0_0 "Status of DFC / Status of diagnostic fault check DFC_MOXEMM_SMU_ALM0_0" UBYTE DFC_OneToOne 1 100 0.00 255.0 FORMAT "%5.1" ECU_ADDRESS 0x6003717D /end MEASUREMENT
/begin MEASUREMENT DFC_st.DFC_MOXEMM_SMU_ALM0_1 "Status of DFC / Status of diagnostic fault check DFC_MOXEMM_SMU_ALM0_1" UBYTE DFC_OneToOne 1 100 0.00 255.0 FORMAT "%5.1" ECU_ADDRESS 0x6003717E /end MEASUREMENT
/begin MEASUREMENT DFC_st.DFC_MOXEMM_SMU_ALM0_10 "Status of DFC / Status of diagnostic fault check DFC_MOXEMM_SMU_ALM0_10" UBYTE DFC_OneToOne 1 100 0.00 255.0 FORMAT "%5.1" ECU_ADDRESS 0x6003717F /end MEASUREMENT
/begin MEASUREMENT DFC_st.DFC_MOXEMM_SMU_ALM0_11 "Status of DFC / Status of diagnostic fault check DFC_MOXEMM_SMU_ALM0_11" UBYTE DFC_OneToOne 1 100 0.00 255.0 FORMAT "%5.1" ECU_ADDRESS 0x60037180 /end MEASUREMENT
/begin MEASUREMENT DFC_st.DFC_MOXEMM_SMU_ALM0_13 "Status of DFC / Status of diagnostic fault check DFC_MOXEMM_SMU_ALM0_13" UBYTE DFC_OneToOne 1 100 0.00 255.0 FORMAT "%5.1" ECU_ADDRESS 0x60037181 /end MEASUREMENT
/begin MEASUREMENT DFC_st.DFC_MOXEMM_SMU_ALM0_14 "Status of DFC / Status of diagnostic fault check DFC_MOXEMM_SMU_ALM0_14" UBYTE DFC_OneToOne 1 100 0.00 255.0 FORMAT "%5.1" ECU_ADDRESS 0x60037182 /end MEASUREMENT
/begin MEASUREMENT DFC_st.DFC_MOXEMM_SMU_ALM0_2 "Status of DFC / Status of diagnostic fault check DFC_MOXEMM_SMU_ALM0_2" UBYTE DFC_OneToOne 1 100 0.00 255.0 FORMAT "%5.1" ECU_ADDRESS 0x60037183 /end MEASUREMENT
/begin MEASUREMENT DFC_st.DFC_MOXEMM_SMU_ALM0_22 "Status of DFC / Status of diagnostic fault check DFC_MOXEMM_SMU_ALM0_22" UBYTE DFC_OneToOne 1 100 0.00 255.0 FORMAT "%5.1" ECU_ADDRESS 0x60037184 /end MEASUREMENT
/begin MEASUREMENT DFC_st.DFC_MOXEMM_SMU_ALM0_23 "Status of DFC / Status of diagnostic fault check DFC_MOXEMM_SMU_ALM0_23" UBYTE DFC_OneToOne 1 100 0.00 255.0 FORMAT "%5.1" ECU_ADDRESS 0x60037185 /end MEASUREMENT
/begin MEASUREMENT DFC_st.DFC_MOXEMM_SMU_ALM0_4 "Status of DFC / Status of diagnostic fault check DFC_MOXEMM_SMU_ALM0_4" UBYTE DFC_OneToOne 1 100 0.00 255.0 FORMAT "%5.1" ECU_ADDRESS 0x60037186 /end MEASUREMENT
/begin MEASUREMENT DFC_st.DFC_MOXEMM_SMU_ALM0_5 "Status of DFC / Status of diagnostic fault check DFC_MOXEMM_SMU_ALM0_5" UBYTE DFC_OneToOne 1 100 0.00 255.0 FORMAT "%5.1" ECU_ADDRESS 0x60037187 /end MEASUREMENT
/begin MEASUREMENT DFC_st.DFC_MOXEMM_SMU_ALM0_7 "Status of DFC / Status of diagnostic fault check DFC_MOXEMM_SMU_ALM0_7" UBYTE DFC_OneToOne 1 100 0.00 255.0 FORMAT "%5.1" ECU_ADDRESS 0x60037188 /end MEASUREMENT
/begin MEASUREMENT DFC_st.DFC_MOXEMM_SMU_ALM0_8 "Status of DFC / Status of diagnostic fault check DFC_MOXEMM_SMU_ALM0_8" UBYTE DFC_OneToOne 1 100 0.00 255.0 FORMAT "%5.1" ECU_ADDRESS 0x60037189 /end MEASUREMENT
/begin MEASUREMENT DFC_st.DFC_MOXEMM_SMU_ALM10_16 "Status of DFC / Status of diagnostic fault check DFC_MOXEMM_SMU_ALM10_16" UBYTE DFC_OneToOne 1 100 0.00 255.0 FORMAT "%5.1" ECU_ADDRESS 0x6003718A /end MEASUREMENT
/begin MEASUREMENT DFC_st.DFC_MOXEMM_SMU_ALM10_17 "Status of DFC / Status of diagnostic fault check DFC_MOXEMM_SMU_ALM10_17" UBYTE DFC_OneToOne 1 100 0.00 255.0 FORMAT "%5.1" ECU_ADDRESS 0x6003718B /end MEASUREMENT
/begin MEASUREMENT DFC_st.DFC_MOXEMM_SMU_ALM10_21 "Status of DFC / Status of diagnostic fault check DFC_MOXEMM_SMU_ALM10_21" UBYTE DFC_OneToOne 1 100 0.00 255.0 FORMAT "%5.1" ECU_ADDRESS 0x6003718C /end MEASUREMENT
/begin MEASUREMENT DFC_st.DFC_MOXEMM_SMU_ALM11_0 "Status of DFC / Status of diagnostic fault check DFC_MOXEMM_SMU_ALM11_0" UBYTE DFC_OneToOne 1 100 0.00 255.0 FORMAT "%5.1" ECU_ADDRESS 0x6003718D /end MEASUREMENT
/begin MEASUREMENT DFC_st.DFC_MOXEMM_SMU_ALM11_1 "Status of DFC / Status of diagnostic fault check DFC_MOXEMM_SMU_ALM11_1" UBYTE DFC_OneToOne 1 100 0.00 255.0 FORMAT "%5.1" ECU_ADDRESS 0x6003718E /end MEASUREMENT
/begin MEASUREMENT DFC_st.DFC_MOXEMM_SMU_ALM11_2 "Status of DFC / Status of diagnostic fault check DFC_MOXEMM_SMU_ALM11_2" UBYTE DFC_OneToOne 1 100 0.00 255.0 FORMAT "%5.1" ECU_ADDRESS 0x6003718F /end MEASUREMENT
/begin MEASUREMENT DFC_st.DFC_MOXEMM_SMU_ALM11_3 "Status of DFC / Status of diagnostic fault check DFC_MOXEMM_SMU_ALM11_3" UBYTE DFC_OneToOne 1 100 0.00 255.0 FORMAT "%5.1" ECU_ADDRESS 0x60037190 /end MEASUREMENT
/begin MEASUREMENT DFC_st.DFC_MOXEMM_SMU_ALM11_4 "Status of DFC / Status of diagnostic fault check DFC_MOXEMM_SMU_ALM11_4" UBYTE DFC_OneToOne 1 100 0.00 255.0 FORMAT "%5.1" ECU_ADDRESS 0x60037191 /end MEASUREMENT
/begin MEASUREMENT DFC_st.DFC_MOXEMM_SMU_ALM11_5 "Status of DFC / Status of diagnostic fault check DFC_MOXEMM_SMU_ALM11_5" UBYTE DFC_OneToOne 1 100 0.00 255.0 FORMAT "%5.1" ECU_ADDRESS 0x60037192 /end MEASUREMENT
/begin MEASUREMENT DFC_st.DFC_MOXEMM_SMU_ALM11_8 "Status of DFC / Status of diagnostic fault check DFC_MOXEMM_SMU_ALM11_8" UBYTE DFC_OneToOne 1 100 0.00 255.0 FORMAT "%5.1" ECU_ADDRESS 0x60037193 /end MEASUREMENT
/begin MEASUREMENT DFC_st.DFC_MOXEMM_SMU_ALM11_9 "Status of DFC / Status of diagnostic fault check DFC_MOXEMM_SMU_ALM11_9" UBYTE DFC_OneToOne 1 100 0.00 255.0 FORMAT "%5.1" ECU_ADDRESS 0x60037194 /end MEASUREMENT
/begin MEASUREMENT DFC_st.DFC_MOXEMM_SMU_ALM1_0 "Status of DFC / Status of diagnostic fault check DFC_MOXEMM_SMU_ALM1_0" UBYTE DFC_OneToOne 1 100 0.00 255.0 FORMAT "%5.1" ECU_ADDRESS 0x60037195 /end MEASUREMENT
/begin MEASUREMENT DFC_st.DFC_MOXEMM_SMU_ALM1_1 "Status of DFC / Status of diagnostic fault check DFC_MOXEMM_SMU_ALM1_1" UBYTE DFC_OneToOne 1 100 0.00 255.0 FORMAT "%5.1" ECU_ADDRESS 0x60037196 /end MEASUREMENT
/begin MEASUREMENT DFC_st.DFC_MOXEMM_SMU_ALM1_10 "Status of DFC / Status of diagnostic fault check DFC_MOXEMM_SMU_ALM1_10" UBYTE DFC_OneToOne 1 100 0.00 255.0 FORMAT "%5.1" ECU_ADDRESS 0x60037197 /end MEASUREMENT
/begin MEASUREMENT DFC_st.DFC_MOXEMM_SMU_ALM1_11 "Status of DFC / Status of diagnostic fault check DFC_MOXEMM_SMU_ALM1_11" UBYTE DFC_OneToOne 1 100 0.00 255.0 FORMAT "%5.1" ECU_ADDRESS 0x60037198 /end MEASUREMENT
/begin MEASUREMENT DFC_st.DFC_MOXEMM_SMU_ALM1_13 "Status of DFC / Status of diagnostic fault check DFC_MOXEMM_SMU_ALM1_13" UBYTE DFC_OneToOne 1 100 0.00 255.0 FORMAT "%5.1" ECU_ADDRESS 0x60037199 /end MEASUREMENT
/begin MEASUREMENT DFC_st.DFC_MOXEMM_SMU_ALM1_14 "Status of DFC / Status of diagnostic fault check DFC_MOXEMM_SMU_ALM1_14" UBYTE DFC_OneToOne 1 100 0.00 255.0 FORMAT "%5.1" ECU_ADDRESS 0x6003719A /end MEASUREMENT
/begin MEASUREMENT DFC_st.DFC_MOXEMM_SMU_ALM1_2 "Status of DFC / Status of diagnostic fault check DFC_MOXEMM_SMU_ALM1_2" UBYTE DFC_OneToOne 1 100 0.00 255.0 FORMAT "%5.1" ECU_ADDRESS 0x6003719B /end MEASUREMENT
/begin MEASUREMENT DFC_st.DFC_MOXEMM_SMU_ALM1_22 "Status of DFC / Status of diagnostic fault check DFC_MOXEMM_SMU_ALM1_22" UBYTE DFC_OneToOne 1 100 0.00 255.0 FORMAT "%5.1" ECU_ADDRESS 0x6003719C /end MEASUREMENT
/begin MEASUREMENT DFC_st.DFC_MOXEMM_SMU_ALM1_23 "Status of DFC / Status of diagnostic fault check DFC_MOXEMM_SMU_ALM1_23" UBYTE DFC_OneToOne 1 100 0.00 255.0 FORMAT "%5.1" ECU_ADDRESS 0x6003719D /end MEASUREMENT
/begin MEASUREMENT DFC_st.DFC_MOXEMM_SMU_ALM1_4 "Status of DFC / Status of diagnostic fault check DFC_MOXEMM_SMU_ALM1_4" UBYTE DFC_OneToOne 1 100 0.00 255.0 FORMAT "%5.1" ECU_ADDRESS 0x6003719E /end MEASUREMENT
/begin MEASUREMENT DFC_st.DFC_MOXEMM_SMU_ALM1_5 "Status of DFC / Status of diagnostic fault check DFC_MOXEMM_SMU_ALM1_5" UBYTE DFC_OneToOne 1 100 0.00 255.0 FORMAT "%5.1" ECU_ADDRESS 0x6003719F /end MEASUREMENT
/begin MEASUREMENT DFC_st.DFC_MOXEMM_SMU_ALM1_7 "Status of DFC / Status of diagnostic fault check DFC_MOXEMM_SMU_ALM1_7" UBYTE DFC_OneToOne 1 100 0.00 255.0 FORMAT "%5.1" ECU_ADDRESS 0x600371A0 /end MEASUREMENT
/begin MEASUREMENT DFC_st.DFC_MOXEMM_SMU_ALM1_8 "Status of DFC / Status of diagnostic fault check DFC_MOXEMM_SMU_ALM1_8" UBYTE DFC_OneToOne 1 100 0.00 255.0 FORMAT "%5.1" ECU_ADDRESS 0x600371A1 /end MEASUREMENT
/begin MEASUREMENT DFC_st.DFC_MOXEMM_SMU_ALM21_0 "Status of DFC / Status of diagnostic fault check DFC_MOXEMM_SMU_ALM21_0" UBYTE DFC_OneToOne 1 100 0.00 255.0 FORMAT "%5.1" ECU_ADDRESS 0x600371A2 /end MEASUREMENT
/begin MEASUREMENT DFC_st.DFC_MOXEMM_SMU_ALM21_16 "Status of DFC / Status of diagnostic fault check DFC_MOXEMM_SMU_ALM21_16" UBYTE DFC_OneToOne 1 100 0.00 255.0 FORMAT "%5.1" ECU_ADDRESS 0x600371A3 /end MEASUREMENT
/begin MEASUREMENT DFC_st.DFC_MOXEMM_SMU_ALM21_3 "Status of DFC / Status of diagnostic fault check DFC_MOXEMM_SMU_ALM21_3" UBYTE DFC_OneToOne 1 100 0.00 255.0 FORMAT "%5.1" ECU_ADDRESS 0x600371A4 /end MEASUREMENT
/begin MEASUREMENT DFC_st.DFC_MOXEMM_SMU_ALM2_1 "Status of DFC / Status of diagnostic fault check DFC_MOXEMM_SMU_ALM2_1" UBYTE DFC_OneToOne 1 100 0.00 255.0 FORMAT "%5.1" ECU_ADDRESS 0x600371A5 /end MEASUREMENT
/begin MEASUREMENT DFC_st.DFC_MOXEMM_SMU_ALM2_10 "Status of DFC / Status of diagnostic fault check DFC_MOXEMM_SMU_ALM2_10" UBYTE DFC_OneToOne 1 100 0.00 255.0 FORMAT "%5.1" ECU_ADDRESS 0x600371A6 /end MEASUREMENT
/begin MEASUREMENT DFC_st.DFC_MOXEMM_SMU_ALM2_11 "Status of DFC / Status of diagnostic fault check DFC_MOXEMM_SMU_ALM2_11" UBYTE DFC_OneToOne 1 100 0.00 255.0 FORMAT "%5.1" ECU_ADDRESS 0x600371A7 /end MEASUREMENT
/begin MEASUREMENT DFC_st.DFC_MOXEMM_SMU_ALM2_13 "Status of DFC / Status of diagnostic fault check DFC_MOXEMM_SMU_ALM2_13" UBYTE DFC_OneToOne 1 100 0.00 255.0 FORMAT "%5.1" ECU_ADDRESS 0x600371A8 /end MEASUREMENT
/begin MEASUREMENT DFC_st.DFC_MOXEMM_SMU_ALM2_14 "Status of DFC / Status of diagnostic fault check DFC_MOXEMM_SMU_ALM2_14" UBYTE DFC_OneToOne 1 100 0.00 255.0 FORMAT "%5.1" ECU_ADDRESS 0x600371A9 /end MEASUREMENT
/begin MEASUREMENT DFC_st.DFC_MOXEMM_SMU_ALM2_22 "Status of DFC / Status of diagnostic fault check DFC_MOXEMM_SMU_ALM2_22" UBYTE DFC_OneToOne 1 100 0.00 255.0 FORMAT "%5.1" ECU_ADDRESS 0x600371AA /end MEASUREMENT
/begin MEASUREMENT DFC_st.DFC_MOXEMM_SMU_ALM2_23 "Status of DFC / Status of diagnostic fault check DFC_MOXEMM_SMU_ALM2_23" UBYTE DFC_OneToOne 1 100 0.00 255.0 FORMAT "%5.1" ECU_ADDRESS 0x600371AB /end MEASUREMENT
/begin MEASUREMENT DFC_st.DFC_MOXEMM_SMU_ALM2_4 "Status of DFC / Status of diagnostic fault check DFC_MOXEMM_SMU_ALM2_4" UBYTE DFC_OneToOne 1 100 0.00 255.0 FORMAT "%5.1" ECU_ADDRESS 0x600371AC /end MEASUREMENT
/begin MEASUREMENT DFC_st.DFC_MOXEMM_SMU_ALM2_5 "Status of DFC / Status of diagnostic fault check DFC_MOXEMM_SMU_ALM2_5" UBYTE DFC_OneToOne 1 100 0.00 255.0 FORMAT "%5.1" ECU_ADDRESS 0x600371AD /end MEASUREMENT
/begin MEASUREMENT DFC_st.DFC_MOXEMM_SMU_ALM2_7 "Status of DFC / Status of diagnostic fault check DFC_MOXEMM_SMU_ALM2_7" UBYTE DFC_OneToOne 1 100 0.00 255.0 FORMAT "%5.1" ECU_ADDRESS 0x600371AE /end MEASUREMENT
/begin MEASUREMENT DFC_st.DFC_MOXEMM_SMU_ALM2_8 "Status of DFC / Status of diagnostic fault check DFC_MOXEMM_SMU_ALM2_8" UBYTE DFC_OneToOne 1 100 0.00 255.0 FORMAT "%5.1" ECU_ADDRESS 0x600371AF /end MEASUREMENT
/begin MEASUREMENT DFC_st.DFC_MOXEMM_SMU_ALM6_0 "Status of DFC / Status of diagnostic fault check DFC_MOXEMM_SMU_ALM6_0" UBYTE DFC_OneToOne 1 100 0.00 255.0 FORMAT "%5.1" ECU_ADDRESS 0x600371B0 /end MEASUREMENT
/begin MEASUREMENT DFC_st.DFC_MOXEMM_SMU_ALM6_11 "Status of DFC / Status of diagnostic fault check DFC_MOXEMM_SMU_ALM6_11" UBYTE DFC_OneToOne 1 100 0.00 255.0 FORMAT "%5.1" ECU_ADDRESS 0x600371B1 /end MEASUREMENT
/begin MEASUREMENT DFC_st.DFC_MOXEMM_SMU_ALM6_12 "Status of DFC / Status of diagnostic fault check DFC_MOXEMM_SMU_ALM6_12" UBYTE DFC_OneToOne 1 100 0.00 255.0 FORMAT "%5.1" ECU_ADDRESS 0x600371B2 /end MEASUREMENT
/begin MEASUREMENT DFC_st.DFC_MOXEMM_SMU_ALM6_14 "Status of DFC / Status of diagnostic fault check DFC_MOXEMM_SMU_ALM6_14" UBYTE DFC_OneToOne 1 100 0.00 255.0 FORMAT "%5.1" ECU_ADDRESS 0x600371B3 /end MEASUREMENT
/begin MEASUREMENT DFC_st.DFC_MOXEMM_SMU_ALM6_15 "Status of DFC / Status of diagnostic fault check DFC_MOXEMM_SMU_ALM6_15" UBYTE DFC_OneToOne 1 100 0.00 255.0 FORMAT "%5.1" ECU_ADDRESS 0x600371B4 /end MEASUREMENT
/begin MEASUREMENT DFC_st.DFC_MOXEMM_SMU_ALM6_17 "Status of DFC / Status of diagnostic fault check DFC_MOXEMM_SMU_ALM6_17" UBYTE DFC_OneToOne 1 100 0.00 255.0 FORMAT "%5.1" ECU_ADDRESS 0x600371B5 /end MEASUREMENT
/begin MEASUREMENT DFC_st.DFC_MOXEMM_SMU_ALM6_18 "Status of DFC / Status of diagnostic fault check DFC_MOXEMM_SMU_ALM6_18" UBYTE DFC_OneToOne 1 100 0.00 255.0 FORMAT "%5.1" ECU_ADDRESS 0x600371B6 /end MEASUREMENT
/begin MEASUREMENT DFC_st.DFC_MOXEMM_SMU_ALM6_20 "Status of DFC / Status of diagnostic fault check DFC_MOXEMM_SMU_ALM6_20" UBYTE DFC_OneToOne 1 100 0.00 255.0 FORMAT "%5.1" ECU_ADDRESS 0x600371B7 /end MEASUREMENT
/begin MEASUREMENT DFC_st.DFC_MOXEMM_SMU_ALM6_21 "Status of DFC / Status of diagnostic fault check DFC_MOXEMM_SMU_ALM6_21" UBYTE DFC_OneToOne 1 100 0.00 255.0 FORMAT "%5.1" ECU_ADDRESS 0x600371B8 /end MEASUREMENT
/begin MEASUREMENT DFC_st.DFC_MOXEMM_SMU_ALM6_25 "Status of DFC / Status of diagnostic fault check DFC_MOXEMM_SMU_ALM6_25" UBYTE DFC_OneToOne 1 100 0.00 255.0 FORMAT "%5.1" ECU_ADDRESS 0x600371B9 /end MEASUREMENT
/begin MEASUREMENT DFC_st.DFC_MOXEMM_SMU_ALM6_4 "Status of DFC / Status of diagnostic fault check DFC_MOXEMM_SMU_ALM6_4" UBYTE DFC_OneToOne 1 100 0.00 255.0 FORMAT "%5.1" ECU_ADDRESS 0x600371BA /end MEASUREMENT
/begin MEASUREMENT DFC_st.DFC_MOXEMM_SMU_ALM6_5 "Status of DFC / Status of diagnostic fault check DFC_MOXEMM_SMU_ALM6_5" UBYTE DFC_OneToOne 1 100 0.00 255.0 FORMAT "%5.1" ECU_ADDRESS 0x600371BB /end MEASUREMENT
/begin MEASUREMENT DFC_st.DFC_MOXEMM_SMU_ALM6_7 "Status of DFC / Status of diagnostic fault check DFC_MOXEMM_SMU_ALM6_7" UBYTE DFC_OneToOne 1 100 0.00 255.0 FORMAT "%5.1" ECU_ADDRESS 0x600371BC /end MEASUREMENT
/begin MEASUREMENT DFC_st.DFC_MOXEMM_SMU_ALM6_8 "Status of DFC / Status of diagnostic fault check DFC_MOXEMM_SMU_ALM6_8" UBYTE DFC_OneToOne 1 100 0.00 255.0 FORMAT "%5.1" ECU_ADDRESS 0x600371BD /end MEASUREMENT
/begin MEASUREMENT DFC_st.DFC_MOXEMM_SMU_ALM7_1 "Status of DFC / Status of diagnostic fault check DFC_MOXEMM_SMU_ALM7_1" UBYTE DFC_OneToOne 1 100 0.00 255.0 FORMAT "%5.1" ECU_ADDRESS 0x600371BE /end MEASUREMENT
/begin MEASUREMENT DFC_st.DFC_MOXEMM_SMU_ALM7_12 "Status of DFC / Status of diagnostic fault check DFC_MOXEMM_SMU_ALM7_12" UBYTE DFC_OneToOne 1 100 0.00 255.0 FORMAT "%5.1" ECU_ADDRESS 0x600371BF /end MEASUREMENT
/begin MEASUREMENT DFC_st.DFC_MOXEMM_SMU_ALM7_13 "Status of DFC / Status of diagnostic fault check DFC_MOXEMM_SMU_ALM7_13" UBYTE DFC_OneToOne 1 100 0.00 255.0 FORMAT "%5.1" ECU_ADDRESS 0x600371C0 /end MEASUREMENT
/begin MEASUREMENT DFC_st.DFC_MOXEMM_SMU_ALM7_14 "Status of DFC / Status of diagnostic fault check DFC_MOXEMM_SMU_ALM7_14" UBYTE DFC_OneToOne 1 100 0.00 255.0 FORMAT "%5.1" ECU_ADDRESS 0x600371C1 /end MEASUREMENT
/begin MEASUREMENT DFC_st.DFC_MOXEMM_SMU_ALM7_15 "Status of DFC / Status of diagnostic fault check DFC_MOXEMM_SMU_ALM7_15" UBYTE DFC_OneToOne 1 100 0.00 255.0 FORMAT "%5.1" ECU_ADDRESS 0x600371C2 /end MEASUREMENT
/begin MEASUREMENT DFC_st.DFC_MOXEMM_SMU_ALM7_16 "Status of DFC / Status of diagnostic fault check DFC_MOXEMM_SMU_ALM7_16" UBYTE DFC_OneToOne 1 100 0.00 255.0 FORMAT "%5.1" ECU_ADDRESS 0x600371C3 /end MEASUREMENT
/begin MEASUREMENT DFC_st.DFC_MOXEMM_SMU_ALM7_17 "Status of DFC / Status of diagnostic fault check DFC_MOXEMM_SMU_ALM7_17" UBYTE DFC_OneToOne 1 100 0.00 255.0 FORMAT "%5.1" ECU_ADDRESS 0x600371C4 /end MEASUREMENT
/begin MEASUREMENT DFC_st.DFC_MOXEMM_SMU_ALM7_2 "Status of DFC / Status of diagnostic fault check DFC_MOXEMM_SMU_ALM7_2" UBYTE DFC_OneToOne 1 100 0.00 255.0 FORMAT "%5.1" ECU_ADDRESS 0x600371C5 /end MEASUREMENT
/begin MEASUREMENT DFC_st.DFC_MOXEMM_SMU_ALM7_20 "Status of DFC / Status of diagnostic fault check DFC_MOXEMM_SMU_ALM7_20" UBYTE DFC_OneToOne 1 100 0.00 255.0 FORMAT "%5.1" ECU_ADDRESS 0x600371C6 /end MEASUREMENT
/begin MEASUREMENT DFC_st.DFC_MOXEMM_SMU_ALM7_25 "Status of DFC / Status of diagnostic fault check DFC_MOXEMM_SMU_ALM7_25" UBYTE DFC_OneToOne 1 100 0.00 255.0 FORMAT "%5.1" ECU_ADDRESS 0x600371C7 /end MEASUREMENT
/begin MEASUREMENT DFC_st.DFC_MOXEMM_SMU_ALM7_26 "Status of DFC / Status of diagnostic fault check DFC_MOXEMM_SMU_ALM7_26" UBYTE DFC_OneToOne 1 100 0.00 255.0 FORMAT "%5.1" ECU_ADDRESS 0x600371C8 /end MEASUREMENT
/begin MEASUREMENT DFC_st.DFC_MOXEMM_SMU_ALM7_28 "Status of DFC / Status of diagnostic fault check DFC_MOXEMM_SMU_ALM7_28" UBYTE DFC_OneToOne 1 100 0.00 255.0 FORMAT "%5.1" ECU_ADDRESS 0x600371C9 /end MEASUREMENT
/begin MEASUREMENT DFC_st.DFC_MOXEMM_SMU_ALM7_29 "Status of DFC / Status of diagnostic fault check DFC_MOXEMM_SMU_ALM7_29" UBYTE DFC_OneToOne 1 100 0.00 255.0 FORMAT "%5.1" ECU_ADDRESS 0x600371CA /end MEASUREMENT
/begin MEASUREMENT DFC_st.DFC_MOXEMM_SMU_ALM7_30 "Status of DFC / Status of diagnostic fault check DFC_MOXEMM_SMU_ALM7_30" UBYTE DFC_OneToOne 1 100 0.00 255.0 FORMAT "%5.1" ECU_ADDRESS 0x600371CB /end MEASUREMENT
/begin MEASUREMENT DFC_st.DFC_MOXEMM_SMU_ALM7_31 "Status of DFC / Status of diagnostic fault check DFC_MOXEMM_SMU_ALM7_31" UBYTE DFC_OneToOne 1 100 0.00 255.0 FORMAT "%5.1" ECU_ADDRESS 0x600371CC /end MEASUREMENT
/begin MEASUREMENT DFC_st.DFC_MOXEMM_SMU_ALM8_0 "Status of DFC / Status of diagnostic fault check DFC_MOXEMM_SMU_ALM8_0" UBYTE DFC_OneToOne 1 100 0.00 255.0 FORMAT "%5.1" ECU_ADDRESS 0x600371CD /end MEASUREMENT
/begin MEASUREMENT DFC_st.DFC_MOXEMM_SMU_ALM8_1 "Status of DFC / Status of diagnostic fault check DFC_MOXEMM_SMU_ALM8_1" UBYTE DFC_OneToOne 1 100 0.00 255.0 FORMAT "%5.1" ECU_ADDRESS 0x600371CE /end MEASUREMENT
/begin MEASUREMENT DFC_st.DFC_MOXEMM_SMU_ALM8_10 "Status of DFC / Status of diagnostic fault check DFC_MOXEMM_SMU_ALM8_10" UBYTE DFC_OneToOne 1 100 0.00 255.0 FORMAT "%5.1" ECU_ADDRESS 0x600371CF /end MEASUREMENT
/begin MEASUREMENT DFC_st.DFC_MOXEMM_SMU_ALM8_11 "Status of DFC / Status of diagnostic fault check DFC_MOXEMM_SMU_ALM8_11" UBYTE DFC_OneToOne 1 100 0.00 255.0 FORMAT "%5.1" ECU_ADDRESS 0x600371D0 /end MEASUREMENT
/begin MEASUREMENT DFC_st.DFC_MOXEMM_SMU_ALM8_12 "Status of DFC / Status of diagnostic fault check DFC_MOXEMM_SMU_ALM8_12" UBYTE DFC_OneToOne 1 100 0.00 255.0 FORMAT "%5.1" ECU_ADDRESS 0x600371D1 /end MEASUREMENT
/begin MEASUREMENT DFC_st.DFC_MOXEMM_SMU_ALM8_16 "Status of DFC / Status of diagnostic fault check DFC_MOXEMM_SMU_ALM8_16" UBYTE DFC_OneToOne 1 100 0.00 255.0 FORMAT "%5.1" ECU_ADDRESS 0x600371D2 /end MEASUREMENT
/begin MEASUREMENT DFC_st.DFC_MOXEMM_SMU_ALM8_18 "Status of DFC / Status of diagnostic fault check DFC_MOXEMM_SMU_ALM8_18" UBYTE DFC_OneToOne 1 100 0.00 255.0 FORMAT "%5.1" ECU_ADDRESS 0x600371D3 /end MEASUREMENT
/begin MEASUREMENT DFC_st.DFC_MOXEMM_SMU_ALM8_2 "Status of DFC / Status of diagnostic fault check DFC_MOXEMM_SMU_ALM8_2" UBYTE DFC_OneToOne 1 100 0.00 255.0 FORMAT "%5.1" ECU_ADDRESS 0x600371D4 /end MEASUREMENT
/begin MEASUREMENT DFC_st.DFC_MOXEMM_SMU_ALM8_3 "Status of DFC / Status of diagnostic fault check DFC_MOXEMM_SMU_ALM8_3" UBYTE DFC_OneToOne 1 100 0.00 255.0 FORMAT "%5.1" ECU_ADDRESS 0x600371D5 /end MEASUREMENT
/begin MEASUREMENT DFC_st.DFC_MOXEMM_SMU_ALM8_31 "Status of DFC / Status of diagnostic fault check DFC_MOXEMM_SMU_ALM8_31" UBYTE DFC_OneToOne 1 100 0.00 255.0 FORMAT "%5.1" ECU_ADDRESS 0x600371D6 /end MEASUREMENT
/begin MEASUREMENT DFC_st.DFC_MOXEMM_SMU_ALM8_4 "Status of DFC / Status of diagnostic fault check DFC_MOXEMM_SMU_ALM8_4" UBYTE DFC_OneToOne 1 100 0.00 255.0 FORMAT "%5.1" ECU_ADDRESS 0x600371D7 /end MEASUREMENT
/begin MEASUREMENT DFC_st.DFC_MOXEMM_SMU_ALM9_0 "Status of DFC / Status of diagnostic fault check DFC_MOXEMM_SMU_ALM9_0" UBYTE DFC_OneToOne 1 100 0.00 255.0 FORMAT "%5.1" ECU_ADDRESS 0x600371D8 /end MEASUREMENT
/begin MEASUREMENT DFC_st.DFC_MOXEMM_SMU_ALM9_15 "Status of DFC / Status of diagnostic fault check DFC_MOXEMM_SMU_ALM9_15" UBYTE DFC_OneToOne 1 100 0.00 255.0 FORMAT "%5.1" ECU_ADDRESS 0x600371D9 /end MEASUREMENT
/begin MEASUREMENT DFC_st.DFC_MOXEMM_SMU_ALM9_3 "Status of DFC / Status of diagnostic fault check DFC_MOXEMM_SMU_ALM9_3" UBYTE DFC_OneToOne 1 100 0.00 255.0 FORMAT "%5.1" ECU_ADDRESS 0x600371DA /end MEASUREMENT
/begin MEASUREMENT DFC_st.DFC_MoCADCNTP "Status of DFC / Status of diagnostic fault check DFC_MoCADCNTP" UBYTE DFC_OneToOne 1 100 0.00 255.0 FORMAT "%5.1" ECU_ADDRESS 0x600371DB /end MEASUREMENT
/begin MEASUREMENT DFC_st.DFC_MoCADCTst "Status of DFC / Status of diagnostic fault check DFC_MoCADCTst" UBYTE DFC_OneToOne 1 100 0.00 255.0 FORMAT "%5.1" ECU_ADDRESS 0x600371DC /end MEASUREMENT
/begin MEASUREMENT DFC_st.DFC_MoCSOPICO "Status of DFC / Status of diagnostic fault check DFC_MoCSOPICO" UBYTE DFC_OneToOne 1 100 0.00 255.0 FORMAT "%5.1" ECU_ADDRESS 0x600371DD /end MEASUREMENT
/begin MEASUREMENT DFC_st.DFC_MoFAPP "Status of DFC / Status of diagnostic fault check DFC_MoFAPP" UBYTE DFC_OneToOne 1 100 0.00 255.0 FORMAT "%5.1" ECU_ADDRESS 0x600371DE /end MEASUREMENT
/begin MEASUREMENT DFC_st.DFC_MoFAirFilgPrdc "Status of DFC / Status of diagnostic fault check DFC_MoFAirFilgPrdc" UBYTE DFC_OneToOne 1 100 0.00 255.0 FORMAT "%5.1" ECU_ADDRESS 0x600371DF /end MEASUREMENT
/begin MEASUREMENT DFC_st.DFC_MoFAirFlCtOffGdi "Status of DFC / Status of diagnostic fault check DFC_MoFAirFlCtOffGdi" UBYTE DFC_OneToOne 1 100 0.00 255.0 FORMAT "%5.1" ECU_ADDRESS 0x600371E0 /end MEASUREMENT
/begin MEASUREMENT DFC_st.DFC_MoFAirFlCylGdi "Status of DFC / Status of diagnostic fault check DFC_MoFAirFlCylGdi" UBYTE DFC_OneToOne 1 100 0.00 255.0 FORMAT "%5.1" ECU_ADDRESS 0x600371E1 /end MEASUREMENT
/begin MEASUREMENT DFC_st.DFC_MoFAirFlFF "Status of DFC / Status of diagnostic fault check DFC_MoFAirFlFF" UBYTE DFC_OneToOne 1 100 0.00 255.0 FORMAT "%5.1" ECU_ADDRESS 0x600371E2 /end MEASUREMENT
/begin MEASUREMENT DFC_st.DFC_MoFAirFlIn "Status of DFC / Status of diagnostic fault check DFC_MoFAirFlIn" UBYTE DFC_OneToOne 1 100 0.00 255.0 FORMAT "%5.1" ECU_ADDRESS 0x600371E3 /end MEASUREMENT
/begin MEASUREMENT DFC_st.DFC_MoFAirFlMixCtlGdiChkAirFl "Status of DFC / Status of diagnostic fault check DFC_MoFAirFlMixCtlGdiChkAirFl" UBYTE DFC_OneToOne 1 100 0.00 255.0 FORMAT "%5.1" ECU_ADDRESS 0x600371E4 /end MEASUREMENT
/begin MEASUREMENT DFC_st.DFC_MoFAirFlMixCtlGdiChkCtrl "Status of DFC / Status of diagnostic fault check DFC_MoFAirFlMixCtlGdiChkCtrl" UBYTE DFC_OneToOne 1 100 0.00 255.0 FORMAT "%5.1" ECU_ADDRESS 0x600371E5 /end MEASUREMENT
/begin MEASUREMENT DFC_st.DFC_MoFAirFlMode "Status of DFC / Status of diagnostic fault check DFC_MoFAirFlMode" UBYTE DFC_OneToOne 1 100 0.00 255.0 FORMAT "%5.1" ECU_ADDRESS 0x600371E6 /end MEASUREMENT
/begin MEASUREMENT DFC_st.DFC_MoFESpd "Status of DFC / Status of diagnostic fault check DFC_MoFESpd" UBYTE DFC_OneToOne 1 100 0.00 255.0 FORMAT "%5.1" ECU_ADDRESS 0x600371E7 /end MEASUREMENT
/begin MEASUREMENT DFC_st.DFC_MoFIACo "Status of DFC / Status of diagnostic fault check DFC_MoFIACo" UBYTE DFC_OneToOne 1 100 0.00 255.0 FORMAT "%5.1" ECU_ADDRESS 0x600371E8 /end MEASUREMENT
/begin MEASUREMENT DFC_st.DFC_MoFICOL1 "Status of DFC / Status of diagnostic fault check DFC_MoFICOL1" UBYTE DFC_OneToOne 1 100 0.00 255.0 FORMAT "%5.1" ECU_ADDRESS 0x600371E9 /end MEASUREMENT
/begin MEASUREMENT DFC_st.DFC_MoFICOL2 "Status of DFC / Status of diagnostic fault check DFC_MoFICOL2" UBYTE DFC_OneToOne 1 100 0.00 255.0 FORMAT "%5.1" ECU_ADDRESS 0x600371EA /end MEASUREMENT
/begin MEASUREMENT DFC_st.DFC_MoFStrt "Status of DFC / Status of diagnostic fault check DFC_MoFStrt" UBYTE DFC_OneToOne 1 100 0.00 255.0 FORMAT "%5.1" ECU_ADDRESS 0x600371EB /end MEASUREMENT
/begin MEASUREMENT DFC_st.DFC_MoFTrqCmp "Status of DFC / Status of diagnostic fault check DFC_MoFTrqCmp" UBYTE DFC_OneToOne 1 100 0.00 255.0 FORMAT "%5.1" ECU_ADDRESS 0x600371EC /end MEASUREMENT
/begin MEASUREMENT DFC_st.DFC_MoFTrqCmpMax "Status of DFC / Status of diagnostic fault check DFC_MoFTrqCmpMax" UBYTE DFC_OneToOne 1 100 0.00 255.0 FORMAT "%5.1" ECU_ADDRESS 0x600371ED /end MEASUREMENT
/begin MEASUREMENT DFC_st.DFC_MoFTrqCmpMin "Status of DFC / Status of diagnostic fault check DFC_MoFTrqCmpMin" UBYTE DFC_OneToOne 1 100 0.00 255.0 FORMAT "%5.1" ECU_ADDRESS 0x600371EE /end MEASUREMENT
/begin MEASUREMENT DFC_st.DFC_MoFVarPostBldSel "Status of DFC / Status of diagnostic fault check DFC_MoFVarPostBldSel" UBYTE DFC_OneToOne 1 100 0.00 255.0 FORMAT "%5.1" ECU_ADDRESS 0x600371EF /end MEASUREMENT
/begin MEASUREMENT DFC_st.DFC_MoXEMMHwLTMCUFW "Status of DFC / Status of diagnostic fault check DFC_MoXEMMHwLTMCUFW" UBYTE DFC_OneToOne 1 100 0.00 255.0 FORMAT "%5.1" ECU_ADDRESS 0x600371F0 /end MEASUREMENT
/begin MEASUREMENT DFC_st.DFC_MoXEMMHwLTMonBIST "Status of DFC / Status of diagnostic fault check DFC_MoXEMMHwLTMonBIST" UBYTE DFC_OneToOne 1 100 0.00 255.0 FORMAT "%5.1" ECU_ADDRESS 0x600371F1 /end MEASUREMENT
/begin MEASUREMENT DFC_st.DFC_MoXEMMHwLTRegMonTest "Status of DFC / Status of diagnostic fault check DFC_MoXEMMHwLTRegMonTest" UBYTE DFC_OneToOne 1 100 0.00 255.0 FORMAT "%5.1" ECU_ADDRESS 0x600371F2 /end MEASUREMENT
/begin MEASUREMENT DFC_st.DFC_MoXEMMHwLTStbySMUAlvTest "Status of DFC / Status of diagnostic fault check DFC_MoXEMMHwLTStbySMUAlvTest" UBYTE DFC_OneToOne 1 100 0.00 255.0 FORMAT "%5.1" ECU_ADDRESS 0x600371F3 /end MEASUREMENT
/begin MEASUREMENT DFC_st.DFC_MoXEMMHwLTTempSens "Status of DFC / Status of diagnostic fault check DFC_MoXEMMHwLTTempSens" UBYTE DFC_OneToOne 1 100 0.00 255.0 FORMAT "%5.1" ECU_ADDRESS 0x600371F4 /end MEASUREMENT
/begin MEASUREMENT DFC_st.DFC_MoXEMMHwLTUCBCfg "Status of DFC / Status of diagnostic fault check DFC_MoXEMMHwLTUCBCfg" UBYTE DFC_OneToOne 1 100 0.00 255.0 FORMAT "%5.1" ECU_ADDRESS 0x600371F5 /end MEASUREMENT
/begin MEASUREMENT DFC_st.DFC_NWSEmax "Status of DFC / Status of diagnostic fault check DFC_NWSEmax" UBYTE DFC_OneToOne 1 100 0.00 255.0 FORMAT "%5.1" ECU_ADDRESS 0x600371F6 /end MEASUREMENT
/begin MEASUREMENT DFC_st.DFC_NWSmax "Status of DFC / Status of diagnostic fault check DFC_NWSmax" UBYTE DFC_OneToOne 1 100 0.00 255.0 FORMAT "%5.1" ECU_ADDRESS 0x600371F7 /end MEASUREMENT
/begin MEASUREMENT DFC_st.DFC_OCWDAABEActv "Status of DFC / Status of diagnostic fault check DFC_OCWDAABEActv" UBYTE DFC_OneToOne 1 100 0.00 255.0 FORMAT "%5.1" ECU_ADDRESS 0x600371F8 /end MEASUREMENT
/begin MEASUREMENT DFC_st.DFC_OCWDACom "Status of DFC / Status of diagnostic fault check DFC_OCWDACom" UBYTE DFC_OneToOne 1 100 0.00 255.0 FORMAT "%5.1" ECU_ADDRESS 0x600371F9 /end MEASUREMENT
/begin MEASUREMENT DFC_st.DFC_OCWDAErrPin "Status of DFC / Status of diagnostic fault check DFC_OCWDAErrPin" UBYTE DFC_OneToOne 1 100 0.00 255.0 FORMAT "%5.1" ECU_ADDRESS 0x600371FA /end MEASUREMENT
/begin MEASUREMENT DFC_st.DFC_OCWDAOvrVltg "Status of DFC / Status of diagnostic fault check DFC_OCWDAOvrVltg" UBYTE DFC_OneToOne 1 100 0.00 255.0 FORMAT "%5.1" ECU_ADDRESS 0x600371FB /end MEASUREMENT
/begin MEASUREMENT DFC_st.DFC_ORAmax "Status of DFC / Status of diagnostic fault check DFC_ORAmax" UBYTE DFC_OneToOne 1 100 0.00 255.0 FORMAT "%5.1" ECU_ADDRESS 0x600371FC /end MEASUREMENT
/begin MEASUREMENT DFC_st.DFC_ORAmin "Status of DFC / Status of diagnostic fault check DFC_ORAmin" UBYTE DFC_OneToOne 1 100 0.00 255.0 FORMAT "%5.1" ECU_ADDRESS 0x600371FD /end MEASUREMENT
/begin MEASUREMENT DFC_st.DFC_OilPPlaus "Status of DFC / Status of diagnostic fault check DFC_OilPPlaus" UBYTE DFC_OneToOne 1 100 0.00 255.0 FORMAT "%5.1" ECU_ADDRESS 0x600371FE /end MEASUREMENT
/begin MEASUREMENT DFC_st.DFC_PLLSUmax "Status of DFC / Status of diagnostic fault check DFC_PLLSUmax" UBYTE DFC_OneToOne 1 100 0.00 255.0 FORMAT "%5.1" ECU_ADDRESS 0x600371FF /end MEASUREMENT
/begin MEASUREMENT DFC_st.DFC_PLLSUmin "Status of DFC / Status of diagnostic fault check DFC_PLLSUmin" UBYTE DFC_OneToOne 1 100 0.00 255.0 FORMAT "%5.1" ECU_ADDRESS 0x60037200 /end MEASUREMENT
/begin MEASUREMENT DFC_st.DFC_PSR1max "Status of DFC / Status of diagnostic fault check DFC_PSR1max" UBYTE DFC_OneToOne 1 100 0.00 255.0 FORMAT "%5.1" ECU_ADDRESS 0x60037201 /end MEASUREMENT
/begin MEASUREMENT DFC_st.DFC_PSRBmax "Status of DFC / Status of diagnostic fault check DFC_PSRBmax" UBYTE DFC_OneToOne 1 100 0.00 255.0 FORMAT "%5.1" ECU_ADDRESS 0x60037202 /end MEASUREMENT
/begin MEASUREMENT DFC_st.DFC_PSRBmin "Status of DFC / Status of diagnostic fault check DFC_PSRBmin" UBYTE DFC_OneToOne 1 100 0.00 255.0 FORMAT "%5.1" ECU_ADDRESS 0x60037203 /end MEASUREMENT
/begin MEASUREMENT DFC_st.DFC_PSRPmax "Status of DFC / Status of diagnostic fault check DFC_PSRPmax" UBYTE DFC_OneToOne 1 100 0.00 255.0 FORMAT "%5.1" ECU_ADDRESS 0x60037204 /end MEASUREMENT
/begin MEASUREMENT DFC_st.DFC_PSRPmin "Status of DFC / Status of diagnostic fault check DFC_PSRPmin" UBYTE DFC_OneToOne 1 100 0.00 255.0 FORMAT "%5.1" ECU_ADDRESS 0x60037205 /end MEASUREMENT
/begin MEASUREMENT DFC_st.DFC_PSRPsig "Status of DFC / Status of diagnostic fault check DFC_PSRPsig" UBYTE DFC_OneToOne 1 100 0.00 255.0 FORMAT "%5.1" ECU_ADDRESS 0x60037206 /end MEASUREMENT
/begin MEASUREMENT DFC_st.DFC_PSRmax "Status of DFC / Status of diagnostic fault check DFC_PSRmax" UBYTE DFC_OneToOne 1 100 0.00 255.0 FORMAT "%5.1" ECU_ADDRESS 0x60037207 /end MEASUREMENT
/begin MEASUREMENT DFC_st.DFC_PUmax "Status of DFC / Status of diagnostic fault check DFC_PUmax" UBYTE DFC_OneToOne 1 100 0.00 255.0 FORMAT "%5.1" ECU_ADDRESS 0x60037208 /end MEASUREMENT
/begin MEASUREMENT DFC_st.DFC_P_VSE11_OL "Status of DFC / Status of diagnostic fault check DFC_P_VSE11_OL" UBYTE DFC_OneToOne 1 100 0.00 255.0 FORMAT "%5.1" ECU_ADDRESS 0x60037209 /end MEASUREMENT
/begin MEASUREMENT DFC_st.DFC_P_VSE11_SCB "Status of DFC / Status of diagnostic fault check DFC_P_VSE11_SCB" UBYTE DFC_OneToOne 1 100 0.00 255.0 FORMAT "%5.1" ECU_ADDRESS 0x6003720A /end MEASUREMENT
/begin MEASUREMENT DFC_st.DFC_P_VSE11_SCG "Status of DFC / Status of diagnostic fault check DFC_P_VSE11_SCG" UBYTE DFC_OneToOne 1 100 0.00 255.0 FORMAT "%5.1" ECU_ADDRESS 0x6003720B /end MEASUREMENT
/begin MEASUREMENT DFC_st.DFC_PhyHighAPP1 "Status of DFC / Status of diagnostic fault check DFC_PhyHighAPP1" UBYTE DFC_OneToOne 1 100 0.00 255.0 FORMAT "%5.1" ECU_ADDRESS 0x6003720C /end MEASUREMENT
/begin MEASUREMENT DFC_st.DFC_PhyHighAPP2 "Status of DFC / Status of diagnostic fault check DFC_PhyHighAPP2" UBYTE DFC_OneToOne 1 100 0.00 255.0 FORMAT "%5.1" ECU_ADDRESS 0x6003720D /end MEASUREMENT
/begin MEASUREMENT DFC_st.DFC_PhyLowAPP1 "Status of DFC / Status of diagnostic fault check DFC_PhyLowAPP1" UBYTE DFC_OneToOne 1 100 0.00 255.0 FORMAT "%5.1" ECU_ADDRESS 0x6003720E /end MEASUREMENT
/begin MEASUREMENT DFC_st.DFC_PhyLowAPP2 "Status of DFC / Status of diagnostic fault check DFC_PhyLowAPP2" UBYTE DFC_OneToOne 1 100 0.00 255.0 FORMAT "%5.1" ECU_ADDRESS 0x6003720F /end MEASUREMENT
/begin MEASUREMENT DFC_st.DFC_SRCHighAPP1 "Status of DFC / Status of diagnostic fault check DFC_SRCHighAPP1" UBYTE DFC_OneToOne 1 100 0.00 255.0 FORMAT "%5.1" ECU_ADDRESS 0x60037210 /end MEASUREMENT
/begin MEASUREMENT DFC_st.DFC_SRCHighAPP2 "Status of DFC / Status of diagnostic fault check DFC_SRCHighAPP2" UBYTE DFC_OneToOne 1 100 0.00 255.0 FORMAT "%5.1" ECU_ADDRESS 0x60037211 /end MEASUREMENT
/begin MEASUREMENT DFC_st.DFC_SRCLowAPP1 "Status of DFC / Status of diagnostic fault check DFC_SRCLowAPP1" UBYTE DFC_OneToOne 1 100 0.00 255.0 FORMAT "%5.1" ECU_ADDRESS 0x60037212 /end MEASUREMENT
/begin MEASUREMENT DFC_st.DFC_SRCLowAPP2 "Status of DFC / Status of diagnostic fault check DFC_SRCLowAPP2" UBYTE DFC_OneToOne 1 100 0.00 255.0 FORMAT "%5.1" ECU_ADDRESS 0x60037213 /end MEASUREMENT
/begin MEASUREMENT DFC_st.DFC_SSpMon2 "Status of DFC / Status of diagnostic fault check DFC_SSpMon2" UBYTE DFC_OneToOne 1 100 0.00 255.0 FORMAT "%5.1" ECU_ADDRESS 0x60037214 /end MEASUREMENT
/begin MEASUREMENT DFC_st.DFC_STHDRmax "Status of DFC / Status of diagnostic fault check DFC_STHDRmax" UBYTE DFC_OneToOne 1 100 0.00 255.0 FORMAT "%5.1" ECU_ADDRESS 0x60037215 /end MEASUREMENT
/begin MEASUREMENT DFC_st.DFC_SWReset_0 "Status of DFC / Status of diagnostic fault check DFC_SWReset_0" UBYTE DFC_OneToOne 1 100 0.00 255.0 FORMAT "%5.1" ECU_ADDRESS 0x60037216 /end MEASUREMENT
/begin MEASUREMENT DFC_st.DFC_SWReset_1 "Status of DFC / Status of diagnostic fault check DFC_SWReset_1" UBYTE DFC_OneToOne 1 100 0.00 255.0 FORMAT "%5.1" ECU_ADDRESS 0x60037217 /end MEASUREMENT
/begin MEASUREMENT DFC_st.DFC_SWReset_2 "Status of DFC / Status of diagnostic fault check DFC_SWReset_2" UBYTE DFC_OneToOne 1 100 0.00 255.0 FORMAT "%5.1" ECU_ADDRESS 0x60037218 /end MEASUREMENT
/begin MEASUREMENT DFC_st.DFC_SyncAPP "Status of DFC / Status of diagnostic fault check DFC_SyncAPP" UBYTE DFC_OneToOne 1 100 0.00 255.0 FORMAT "%5.1" ECU_ADDRESS 0x60037219 /end MEASUREMENT
/begin MEASUREMENT DFC_st.DFC_TANKLnpl "Status of DFC / Status of diagnostic fault check DFC_TANKLnpl" UBYTE DFC_OneToOne 1 100 0.00 255.0 FORMAT "%5.1" ECU_ADDRESS 0x6003721A /end MEASUREMENT
/begin MEASUREMENT DFC_st.DFC_TAmax_Dummy "Status of DFC / Status of diagnostic fault check DFC_TAmax_Dummy" UBYTE DFC_OneToOne 1 100 0.00 255.0 FORMAT "%5.1" ECU_ADDRESS 0x6003721B /end MEASUREMENT
/begin MEASUREMENT DFC_st.DFC_TESFmax "Status of DFC / Status of diagnostic fault check DFC_TESFmax" UBYTE DFC_OneToOne 1 100 0.00 255.0 FORMAT "%5.1" ECU_ADDRESS 0x6003721C /end MEASUREMENT
/begin MEASUREMENT DFC_st.DFC_TESGmax "Status of DFC / Status of diagnostic fault check DFC_TESGmax" UBYTE DFC_OneToOne 1 100 0.00 255.0 FORMAT "%5.1" ECU_ADDRESS 0x6003721D /end MEASUREMENT
/begin MEASUREMENT DFC_st.DFC_TKAEmax "Status of DFC / Status of diagnostic fault check DFC_TKAEmax" UBYTE DFC_OneToOne 1 100 0.00 255.0 FORMAT "%5.1" ECU_ADDRESS 0x6003721E /end MEASUREMENT
/begin MEASUREMENT DFC_st.DFC_TKAEmin "Status of DFC / Status of diagnostic fault check DFC_TKAEmin" UBYTE DFC_OneToOne 1 100 0.00 255.0 FORMAT "%5.1" ECU_ADDRESS 0x6003721F /end MEASUREMENT
/begin MEASUREMENT DFC_st.DFC_TKARmax "Status of DFC / Status of diagnostic fault check DFC_TKARmax" UBYTE DFC_OneToOne 1 100 0.00 255.0 FORMAT "%5.1" ECU_ADDRESS 0x60037220 /end MEASUREMENT
/begin MEASUREMENT DFC_st.DFC_TKARnpl "Status of DFC / Status of diagnostic fault check DFC_TKARnpl" UBYTE DFC_OneToOne 1 100 0.00 255.0 FORMAT "%5.1" ECU_ADDRESS 0x60037221 /end MEASUREMENT
/begin MEASUREMENT DFC_st.DFC_TMmax_Dummy "Status of DFC / Status of diagnostic fault check DFC_TMmax_Dummy" UBYTE DFC_OneToOne 1 100 0.00 255.0 FORMAT "%5.1" ECU_ADDRESS 0x60037222 /end MEASUREMENT
/begin MEASUREMENT DFC_st.DFC_TUMmax_Dummy "Status of DFC / Status of diagnostic fault check DFC_TUMmax_Dummy" UBYTE DFC_OneToOne 1 100 0.00 255.0 FORMAT "%5.1" ECU_ADDRESS 0x60037223 /end MEASUREMENT
/begin MEASUREMENT DFC_st.DFC_TWCDPriCatB1 "Status of DFC / Status of diagnostic fault check DFC_TWCDPriCatB1" UBYTE DFC_OneToOne 1 100 0.00 255.0 FORMAT "%5.1" ECU_ADDRESS 0x60037224 /end MEASUREMENT
/begin MEASUREMENT DFC_st.DFC_ThrVlvClsdPosnFirstOffsLrnImpoB1 "Status of DFC / Status of diagnostic fault check DFC_ThrVlvClsdPosnFirstOffsLrnImpoB1" UBYTE DFC_OneToOne 1 100 0.00 255.0 FORMAT "%5.1" ECU_ADDRESS 0x60037225 /end MEASUREMENT
/begin MEASUREMENT DFC_st.DFC_ThrVlvClsdPosnOffsLrnImpoB1 "Status of DFC / Status of diagnostic fault check DFC_ThrVlvClsdPosnOffsLrnImpoB1" UBYTE DFC_OneToOne 1 100 0.00 255.0 FORMAT "%5.1" ECU_ADDRESS 0x60037226 /end MEASUREMENT
/begin MEASUREMENT DFC_st.DFC_ThrVlvClsdPosnOffsLrnMaxB1 "Status of DFC / Status of diagnostic fault check DFC_ThrVlvClsdPosnOffsLrnMaxB1" UBYTE DFC_OneToOne 1 100 0.00 255.0 FORMAT "%5.1" ECU_ADDRESS 0x60037227 /end MEASUREMENT
/begin MEASUREMENT DFC_st.DFC_ThrVlvClsdPosnOffsLrnMinB1 "Status of DFC / Status of diagnostic fault check DFC_ThrVlvClsdPosnOffsLrnMinB1" UBYTE DFC_OneToOne 1 100 0.00 255.0 FORMAT "%5.1" ECU_ADDRESS 0x60037228 /end MEASUREMENT
/begin MEASUREMENT DFC_st.DFC_ThrVlvCtrlDeB1 "Status of DFC / Status of diagnostic fault check DFC_ThrVlvCtrlDeB1" UBYTE DFC_OneToOne 1 100 0.00 255.0 FORMAT "%5.1" ECU_ADDRESS 0x60037229 /end MEASUREMENT
/begin MEASUREMENT DFC_st.DFC_ThrVlvDycB1 "Status of DFC / Status of diagnostic fault check DFC_ThrVlvDycB1" UBYTE DFC_OneToOne 1 100 0.00 255.0 FORMAT "%5.1" ECU_ADDRESS 0x6003722A /end MEASUREMENT
/begin MEASUREMENT DFC_st.DFC_ThrVlvLimpAirPosnMaxAbsltDriftB1 "Status of DFC / Status of diagnostic fault check DFC_ThrVlvLimpAirPosnMaxAbsltDriftB1" UBYTE DFC_OneToOne 1 100 0.00 255.0 FORMAT "%5.1" ECU_ADDRESS 0x6003722B /end MEASUREMENT
/begin MEASUREMENT DFC_st.DFC_ThrVlvLimpAirPosnMaxB1 "Status of DFC / Status of diagnostic fault check DFC_ThrVlvLimpAirPosnMaxB1" UBYTE DFC_OneToOne 1 100 0.00 255.0 FORMAT "%5.1" ECU_ADDRESS 0x6003722C /end MEASUREMENT
/begin MEASUREMENT DFC_st.DFC_ThrVlvLimpAirPosnMaxRelDriftB1 "Status of DFC / Status of diagnostic fault check DFC_ThrVlvLimpAirPosnMaxRelDriftB1" UBYTE DFC_OneToOne 1 100 0.00 255.0 FORMAT "%5.1" ECU_ADDRESS 0x6003722D /end MEASUREMENT
/begin MEASUREMENT DFC_st.DFC_ThrVlvLimpAirPosnMinB1 "Status of DFC / Status of diagnostic fault check DFC_ThrVlvLimpAirPosnMinB1" UBYTE DFC_OneToOne 1 100 0.00 255.0 FORMAT "%5.1" ECU_ADDRESS 0x6003722E /end MEASUREMENT
/begin MEASUREMENT DFC_st.DFC_ThrVlvOpenLoadB1 "Status of DFC / Status of diagnostic fault check DFC_ThrVlvOpenLoadB1" UBYTE DFC_OneToOne 1 100 0.00 255.0 FORMAT "%5.1" ECU_ADDRESS 0x6003722F /end MEASUREMENT
/begin MEASUREMENT DFC_st.DFC_ThrVlvOpenSprgB1 "Status of DFC / Status of diagnostic fault check DFC_ThrVlvOpenSprgB1" UBYTE DFC_OneToOne 1 100 0.00 255.0 FORMAT "%5.1" ECU_ADDRESS 0x60037230 /end MEASUREMENT
/begin MEASUREMENT DFC_st.DFC_ThrVlvOpenSprgSprdB1 "Status of DFC / Status of diagnostic fault check DFC_ThrVlvOpenSprgSprdB1" UBYTE DFC_OneToOne 1 100 0.00 255.0 FORMAT "%5.1" ECU_ADDRESS 0x60037231 /end MEASUREMENT
/begin MEASUREMENT DFC_st.DFC_ThrVlvOpenSprgTwnB1 "Status of DFC / Status of diagnostic fault check DFC_ThrVlvOpenSprgTwnB1" UBYTE DFC_OneToOne 1 100 0.00 255.0 FORMAT "%5.1" ECU_ADDRESS 0x60037232 /end MEASUREMENT
/begin MEASUREMENT DFC_st.DFC_ThrVlvOverTB1 "Status of DFC / Status of diagnostic fault check DFC_ThrVlvOverTB1" UBYTE DFC_OneToOne 1 100 0.00 255.0 FORMAT "%5.1" ECU_ADDRESS 0x60037233 /end MEASUREMENT
/begin MEASUREMENT DFC_st.DFC_ThrVlvRetSprgB1 "Status of DFC / Status of diagnostic fault check DFC_ThrVlvRetSprgB1" UBYTE DFC_OneToOne 1 100 0.00 255.0 FORMAT "%5.1" ECU_ADDRESS 0x60037234 /end MEASUREMENT
/begin MEASUREMENT DFC_st.DFC_ThrVlvRetSprgSprdB1 "Status of DFC / Status of diagnostic fault check DFC_ThrVlvRetSprgSprdB1" UBYTE DFC_OneToOne 1 100 0.00 255.0 FORMAT "%5.1" ECU_ADDRESS 0x60037235 /end MEASUREMENT
/begin MEASUREMENT DFC_st.DFC_ThrVlvRetSprgTwnB1 "Status of DFC / Status of diagnostic fault check DFC_ThrVlvRetSprgTwnB1" UBYTE DFC_OneToOne 1 100 0.00 255.0 FORMAT "%5.1" ECU_ADDRESS 0x60037236 /end MEASUREMENT
/begin MEASUREMENT DFC_st.DFC_ThrVlvSens1MaxB1 "Status of DFC / Status of diagnostic fault check DFC_ThrVlvSens1MaxB1" UBYTE DFC_OneToOne 1 100 0.00 255.0 FORMAT "%5.1" ECU_ADDRESS 0x60037237 /end MEASUREMENT
/begin MEASUREMENT DFC_st.DFC_ThrVlvSens1NplB1 "Status of DFC / Status of diagnostic fault check DFC_ThrVlvSens1NplB1" UBYTE DFC_OneToOne 1 100 0.00 255.0 FORMAT "%5.1" ECU_ADDRESS 0x60037238 /end MEASUREMENT
/begin MEASUREMENT DFC_st.DFC_ThrVlvSens2MaxB1 "Status of DFC / Status of diagnostic fault check DFC_ThrVlvSens2MaxB1" UBYTE DFC_OneToOne 1 100 0.00 255.0 FORMAT "%5.1" ECU_ADDRESS 0x60037239 /end MEASUREMENT
/begin MEASUREMENT DFC_st.DFC_ThrVlvSens2MinB1 "Status of DFC / Status of diagnostic fault check DFC_ThrVlvSens2MinB1" UBYTE DFC_OneToOne 1 100 0.00 255.0 FORMAT "%5.1" ECU_ADDRESS 0x6003723A /end MEASUREMENT
/begin MEASUREMENT DFC_st.DFC_ThrVlvSens2NplB1 "Status of DFC / Status of diagnostic fault check DFC_ThrVlvSens2NplB1" UBYTE DFC_OneToOne 1 100 0.00 255.0 FORMAT "%5.1" ECU_ADDRESS 0x6003723B /end MEASUREMENT
/begin MEASUREMENT DFC_st.DFC_ThrVlvShoCircB1 "Status of DFC / Status of diagnostic fault check DFC_ThrVlvShoCircB1" UBYTE DFC_OneToOne 1 100 0.00 255.0 FORMAT "%5.1" ECU_ADDRESS 0x6003723C /end MEASUREMENT
/begin MEASUREMENT DFC_st.DFC_ThrVlvSpiErrB1 "Status of DFC / Status of diagnostic fault check DFC_ThrVlvSpiErrB1" UBYTE DFC_OneToOne 1 100 0.00 255.0 FORMAT "%5.1" ECU_ADDRESS 0x6003723D /end MEASUREMENT
/begin MEASUREMENT DFC_st.DFC_ThrvlvSens1MinB1 "Status of DFC / Status of diagnostic fault check DFC_ThrvlvSens1MinB1" UBYTE DFC_OneToOne 1 100 0.00 255.0 FORMAT "%5.1" ECU_ADDRESS 0x6003723E /end MEASUREMENT
/begin MEASUREMENT DFC_st.DFC_TiOffTBasdChkFast "Status of DFC / Status of diagnostic fault check DFC_TiOffTBasdChkFast" UBYTE DFC_OneToOne 1 100 0.00 255.0 FORMAT "%5.1" ECU_ADDRESS 0x6003723F /end MEASUREMENT
/begin MEASUREMENT DFC_st.DFC_TiOffTBasdChkSlow "Status of DFC / Status of diagnostic fault check DFC_TiOffTBasdChkSlow" UBYTE DFC_OneToOne 1 100 0.00 255.0 FORMAT "%5.1" ECU_ADDRESS 0x60037240 /end MEASUREMENT
/begin MEASUREMENT DFC_st.DFC_UEGOSnsrMntdS1B1 "Status of DFC / Status of diagnostic fault check DFC_UEGOSnsrMntdS1B1" UBYTE DFC_OneToOne 1 100 0.00 255.0 FORMAT "%5.1" ECU_ADDRESS 0x60037241 /end MEASUREMENT
/begin MEASUREMENT DFC_st.DFC_VehVSig "Status of DFC / Status of diagnostic fault check DFC_VehVSig" UBYTE DFC_OneToOne 1 100 0.00 255.0 FORMAT "%5.1" ECU_ADDRESS 0x60037242 /end MEASUREMENT
/begin MEASUREMENT DFC_st.DFC_VlvLftFbSwtIntk11SpclFail "Status of DFC / Status of diagnostic fault check DFC_VlvLftFbSwtIntk11SpclFail" UBYTE DFC_OneToOne 1 100 0.00 255.0 FORMAT "%5.1" ECU_ADDRESS 0x60037243 /end MEASUREMENT
/begin MEASUREMENT DFC_st.DFC_VlvLftFbSwtIntk11StdFail "Status of DFC / Status of diagnostic fault check DFC_VlvLftFbSwtIntk11StdFail" UBYTE DFC_OneToOne 1 100 0.00 255.0 FORMAT "%5.1" ECU_ADDRESS 0x60037244 /end MEASUREMENT
/begin MEASUREMENT DFC_stClctFault_mp "Collected error states of all fault checks" UWORD DFC_OneToOne 1 100 0.00 65535.00 FORMAT "%8.2" ARRAY_SIZE 57 ECU_ADDRESS 0x70009E66 /end MEASUREMENT
/begin MEASUREMENT DFC_stClctTst_mp "Collected tested states of all fault checks" UWORD DFC_OneToOne 1 100 0.00 65535.00 FORMAT "%8.2" ARRAY_SIZE 57 ECU_ADDRESS 0x70009DF4 /end MEASUREMENT
/begin MEASUREMENT DFC_stFinal "Disable (or check finished) status of all DFCs (for PID$41 calculation)" UWORD DFC_OneToOne 1 100 0.00 65535.00 FORMAT "%8.2" ARRAY_SIZE 57 ECU_ADDRESS 0x50005946 /end MEASUREMENT
/begin MEASUREMENT DFC_stMem "Fault entry exists - per DFC" UWORD DFC_OneToOne 1 100 0.00 65535.00 FORMAT "%8.2" ARRAY_SIZE 57 ECU_ADDRESS 0x60036E48 /end MEASUREMENT
/begin MEASUREMENT DFC_stRdy "Ready state due to ""OK"" per DFC" UWORD DFC_OneToOne 1 100 0.00 65535.00 FORMAT "%8.2" ARRAY_SIZE 57 ECU_ADDRESS 0x60038734 /end MEASUREMENT
/begin MEASUREMENT DFC_stTestFaildInhb "" UWORD DFC_OneToOne 1 100 0.00 65535.00 FORMAT "%8.2" ARRAY_SIZE 57 ECU_ADDRESS 0x600386C2 /end MEASUREMENT
/begin MEASUREMENT DSQ_st.DSQ_ACClntP "Status signal quality / Status of signal quality DSQ_ACClntP" UBYTE DFC_OneToOne 1 100 0.00 255.0 FORMAT "%5.1" ECU_ADDRESS 0x60010A18 /end MEASUREMENT
/begin MEASUREMENT DSQ_st.DSQ_ACEvpT "Status signal quality / Status of signal quality DSQ_ACEvpT" UBYTE DFC_OneToOne 1 100 0.00 255.0 FORMAT "%5.1" ECU_ADDRESS 0x60010A19 /end MEASUREMENT
/begin MEASUREMENT DSQ_st.DSQ_AirCCmprActr "Status signal quality / Status of signal quality DSQ_AirCCmprActr" UBYTE DFC_OneToOne 1 100 0.00 255.0 FORMAT "%5.1" ECU_ADDRESS 0x60010A1A /end MEASUREMENT
/begin MEASUREMENT DSQ_st.DSQ_BattU "Status signal quality / Status of signal quality DSQ_BattU" UBYTE DFC_OneToOne 1 100 0.00 255.0 FORMAT "%5.1" ECU_ADDRESS 0x60010A1B /end MEASUREMENT
/begin MEASUREMENT DSQ_st.DSQ_BattULo "Status signal quality / Status of signal quality DSQ_BattULo" UBYTE DFC_OneToOne 1 100 0.00 255.0 FORMAT "%5.1" ECU_ADDRESS 0x60010A1C /end MEASUREMENT
/begin MEASUREMENT DSQ_st.DSQ_BrkBstPMdl "Status signal quality / Status of signal quality DSQ_BrkBstPMdl" UBYTE DFC_OneToOne 1 100 0.00 255.0 FORMAT "%5.1" ECU_ADDRESS 0x60010A1D /end MEASUREMENT
/begin MEASUREMENT DSQ_st.DSQ_BrkP "Status signal quality / Status of signal quality DSQ_BrkP" UBYTE DFC_OneToOne 1 100 0.00 255.0 FORMAT "%5.1" ECU_ADDRESS 0x60010A1E /end MEASUREMENT
/begin MEASUREMENT DSQ_st.DSQ_BrkPSnsr "Status signal quality / Status of signal quality DSQ_BrkPSnsr" UBYTE DFC_OneToOne 1 100 0.00 255.0 FORMAT "%5.1" ECU_ADDRESS 0x60010A1F /end MEASUREMENT
/begin MEASUREMENT DSQ_st.DSQ_CoVMDIDASFail "Status signal quality / Status of signal quality DSQ_CoVMDIDASFail" UBYTE DFC_OneToOne 1 100 0.00 255.0 FORMAT "%5.1" ECU_ADDRESS 0x60010A20 /end MEASUREMENT
/begin MEASUREMENT DSQ_st.DSQ_DSMInhibitAlways "Status signal quality / Status of signal quality DSQ_DSMInhibitAlways" UBYTE DFC_OneToOne 1 100 0.00 255.0 FORMAT "%5.1" ECU_ADDRESS 0x60010A21 /end MEASUREMENT
/begin MEASUREMENT DSQ_st.DSQ_EGRVlv_GovDesVal "Status signal quality / Status of signal quality DSQ_EGRVlv_GovDesVal" UBYTE DFC_OneToOne 1 100 0.00 255.0 FORMAT "%5.1" ECU_ADDRESS 0x60010A22 /end MEASUREMENT
/begin MEASUREMENT DSQ_st.DSQ_ElecLd "Status signal quality / Status of signal quality DSQ_ElecLd" UBYTE DFC_OneToOne 1 100 0.00 255.0 FORMAT "%5.1" ECU_ADDRESS 0x60010A23 /end MEASUREMENT
/begin MEASUREMENT DSQ_st.DSQ_EngICO "Status signal quality / Status of signal quality DSQ_EngICO" UBYTE DFC_OneToOne 1 100 0.00 255.0 FORMAT "%5.1" ECU_ADDRESS 0x60010A24 /end MEASUREMENT
/begin MEASUREMENT DSQ_st.DSQ_EpmCaSSigQuality "Status signal quality / Status of signal quality DSQ_EpmCaSSigQuality" UBYTE DFC_OneToOne 1 100 0.00 255.0 FORMAT "%5.1" ECU_ADDRESS 0x60010A25 /end MEASUREMENT
/begin MEASUREMENT DSQ_st.DSQ_EpmReverseRun "Status signal quality / Status of signal quality DSQ_EpmReverseRun" UBYTE DFC_OneToOne 1 100 0.00 255.0 FORMAT "%5.1" ECU_ADDRESS 0x60010A26 /end MEASUREMENT
/begin MEASUREMENT DSQ_st.DSQ_FanDIO_0 "Status signal quality / Status of signal quality DSQ_FanDIO_0" UBYTE DFC_OneToOne 1 100 0.00 255.0 FORMAT "%5.1" ECU_ADDRESS 0x60010A27 /end MEASUREMENT
/begin MEASUREMENT DSQ_st.DSQ_FanDIO_1 "Status signal quality / Status of signal quality DSQ_FanDIO_1" UBYTE DFC_OneToOne 1 100 0.00 255.0 FORMAT "%5.1" ECU_ADDRESS 0x60010A28 /end MEASUREMENT
/begin MEASUREMENT DSQ_st.DSQ_FuelP "Status signal quality / Status of signal quality DSQ_FuelP" UBYTE DFC_OneToOne 1 100 0.00 255.0 FORMAT "%5.1" ECU_ADDRESS 0x60010A29 /end MEASUREMENT
/begin MEASUREMENT DSQ_st.DSQ_FuelT "Status signal quality / Status of signal quality DSQ_FuelT" UBYTE DFC_OneToOne 1 100 0.00 255.0 FORMAT "%5.1" ECU_ADDRESS 0x60010A2A /end MEASUREMENT
/begin MEASUREMENT DSQ_st.DSQ_GEVCtlTOilCylHd "Status signal quality / Status of signal quality DSQ_GEVCtlTOilCylHd" UBYTE DFC_OneToOne 1 100 0.00 255.0 FORMAT "%5.1" ECU_ADDRESS 0x60010A2B /end MEASUREMENT
/begin MEASUREMENT DSQ_st.DSQ_GEVlvAgIntkB1 "Status signal quality / Status of signal quality DSQ_GEVlvAgIntkB1" UBYTE DFC_OneToOne 1 100 0.00 255.0 FORMAT "%5.1" ECU_ADDRESS 0x60010A2C /end MEASUREMENT
/begin MEASUREMENT DSQ_st.DSQ_GbxPNPos "Status signal quality / Status of signal quality DSQ_GbxPNPos" UBYTE DFC_OneToOne 1 100 0.00 255.0 FORMAT "%5.1" ECU_ADDRESS 0x60010A2D /end MEASUREMENT
/begin MEASUREMENT DSQ_st.DSQ_GbxPosNotPN "Status signal quality / Status of signal quality DSQ_GbxPosNotPN" UBYTE DFC_OneToOne 1 100 0.00 255.0 FORMAT "%5.1" ECU_ADDRESS 0x60010A2E /end MEASUREMENT
/begin MEASUREMENT DSQ_st.DSQ_InjVlv_DI_CylOk "Status signal quality / Status of signal quality DSQ_InjVlv_DI_CylOk" UBYTE DFC_OneToOne 1 100 0.00 255.0 FORMAT "%5.1" ECU_ADDRESS 0x60010A2F /end MEASUREMENT
/begin MEASUREMENT DSQ_st.DSQ_MRly "Status signal quality / Status of signal quality DSQ_MRly" UBYTE DFC_OneToOne 1 100 0.00 255.0 FORMAT "%5.1" ECU_ADDRESS 0x60010A30 /end MEASUREMENT
/begin MEASUREMENT DSQ_st.DSQ_OilP "Status signal quality / Status of signal quality DSQ_OilP" UBYTE DFC_OneToOne 1 100 0.00 255.0 FORMAT "%5.1" ECU_ADDRESS 0x60010A31 /end MEASUREMENT
/begin MEASUREMENT DSQ_st.DSQ_PEnvMeasVld "Status signal quality / Status of signal quality DSQ_PEnvMeasVld" UBYTE DFC_OneToOne 1 100 0.00 255.0 FORMAT "%5.1" ECU_ADDRESS 0x60010A32 /end MEASUREMENT
/begin MEASUREMENT DSQ_st.DSQ_PEnvVld "Status signal quality / Status of signal quality DSQ_PEnvVld" UBYTE DFC_OneToOne 1 100 0.00 255.0 FORMAT "%5.1" ECU_ADDRESS 0x60010A33 /end MEASUREMENT
/begin MEASUREMENT DSQ_st.DSQ_PEnv_pRaw "Status signal quality / Status of signal quality DSQ_PEnv_pRaw" UBYTE DFC_OneToOne 1 100 0.00 255.0 FORMAT "%5.1" ECU_ADDRESS 0x60010A34 /end MEASUREMENT
/begin MEASUREMENT DSQ_st.DSQ_PRail "Status signal quality / Status of signal quality DSQ_PRail" UBYTE DFC_OneToOne 1 100 0.00 255.0 FORMAT "%5.1" ECU_ADDRESS 0x60010A35 /end MEASUREMENT
/begin MEASUREMENT DSQ_st.DSQ_PThrVlvUs "Status signal quality / Status of signal quality DSQ_PThrVlvUs" UBYTE DFC_OneToOne 1 100 0.00 255.0 FORMAT "%5.1" ECU_ADDRESS 0x60010A36 /end MEASUREMENT
/begin MEASUREMENT DSQ_st.DSQ_PThrVlvUsB1 "Status signal quality / Status of signal quality DSQ_PThrVlvUsB1" UBYTE DFC_OneToOne 1 100 0.00 255.0 FORMAT "%5.1" ECU_ADDRESS 0x60010A37 /end MEASUREMENT
/begin MEASUREMENT DSQ_st.DSQ_StrtImobChk "Status signal quality / Status of signal quality DSQ_StrtImobChk" UBYTE DFC_OneToOne 1 100 0.00 255.0 FORMAT "%5.1" ECU_ADDRESS 0x60010A38 /end MEASUREMENT
/begin MEASUREMENT DSQ_st.DSQ_TDevCenColdStrt "Status signal quality / Status of signal quality DSQ_TDevCenColdStrt" UBYTE DFC_OneToOne 1 100 0.00 255.0 FORMAT "%5.1" ECU_ADDRESS 0x60010A39 /end MEASUREMENT
/begin MEASUREMENT DSQ_st.DSQ_VehV "Status signal quality / Status of signal quality DSQ_VehV" UBYTE DFC_OneToOne 1 100 0.00 255.0 FORMAT "%5.1" ECU_ADDRESS 0x60010A3A /end MEASUREMENT
/begin MEASUREMENT DSQ_st.DSQ_VehVSens "Status signal quality / Status of signal quality DSQ_VehVSens" UBYTE DFC_OneToOne 1 100 0.00 255.0 FORMAT "%5.1" ECU_ADDRESS 0x60010A3B /end MEASUREMENT
/begin MEASUREMENT DSQ_st.DSQ_VehVSnsr "Status signal quality / Status of signal quality DSQ_VehVSnsr" UBYTE DFC_OneToOne 1 100 0.00 255.0 FORMAT "%5.1" ECU_ADDRESS 0x60010A3C /end MEASUREMENT
/begin MEASUREMENT DSQ_st.DSQ_stAPP "Status signal quality / Status of signal quality DSQ_stAPP" UBYTE DFC_OneToOne 1 100 0.00 255.0 FORMAT "%5.1" ECU_ADDRESS 0x60010A3D /end MEASUREMENT
/begin MEASUREMENT DSQ_st.DSQ_stComEAT4 "Status signal quality / Status of signal quality DSQ_stComEAT4" UBYTE DFC_OneToOne 1 100 0.00 255.0 FORMAT "%5.1" ECU_ADDRESS 0x60010A3E /end MEASUREMENT
/begin FUNCTION DFC "30000.33.0_1.1.0Diagnostic Fault Check"
 /begin DEF_CHARACTERISTIC DFC_CtlMsk.DFC_Unused_C DFC_CtlMsk.DFC_AAVEmax_C DFC_CtlMsk.DFC_AAVEmin_C DFC_CtlMsk.DFC_AAVEsig_C DFC_CtlMsk.DFC_AltIOACGFailr_C DFC_CtlMsk.DFC_AltIOACGHiVltg_C DFC_CtlMsk.DFC_AltIOACGLoVltg_C DFC_CtlMsk.DFC_AltIOACGTHi_C DFC_CtlMsk.DFC_AltIODConnACG_C DFC_CtlMsk.DFC_BGOELWAF_C DFC_CtlMsk.DFC_BattUHiFailr_C DFC_CtlMsk.DFC_BattULoFailr_C DFC_CtlMsk.DFC_BrkBstPDriftHiErr_C DFC_CtlMsk.DFC_BrkBstPDriftLoErr_C DFC_CtlMsk.DFC_BrkBstPSnsrStuck_C DFC_CtlMsk.DFC_BrkMnSwtContOn_C DFC_CtlMsk.DFC_BrkMnSwtNotStp_C DFC_CtlMsk.DFC_BrkNpl_C DFC_CtlMsk.DFC_BrkRdntSwtContOn_C DFC_CtlMsk.DFC_BrkRdntSwtNotStp_C DFC_CtlMsk.DFC_Clth3ONStuck_C DFC_CtlMsk.DFC_Clth4OFFStuck_C DFC_CtlMsk.DFC_ClthOFFStuck_C DFC_CtlMsk.DFC_ClthONStuck_C DFC_CtlMsk.DFC_ClthStkFailInfo_C DFC_CtlMsk.DFC_ComACFailInfo_C DFC_CtlMsk.DFC_ComATFTValErr_C DFC_CtlMsk.DFC_ComATMILReq_C DFC_CtlMsk.DFC_ComAYCAChksum_C DFC_CtlMsk.DFC_ComAYCARingCnt_C DFC_CtlMsk.DFC_ComAYCATOut_C DFC_CtlMsk.DFC_ComAYCDChkSum_C DFC_CtlMsk.DFC_ComAYCDTOut_C DFC_CtlMsk.DFC_ComAYCFChksum_C DFC_CtlMsk.DFC_ComAYCFRingCnt_C DFC_CtlMsk.DFC_ComAYCFTOut_C DFC_CtlMsk.DFC_ComAYCGChksum_C DFC_CtlMsk.DFC_ComAYCGRingCnt_C DFC_CtlMsk.DFC_ComAYCGTOut_C DFC_CtlMsk.DFC_ComAYCIChkSum_C DFC_CtlMsk.DFC_ComAYCIRingCnt_C DFC_CtlMsk.DFC_ComAYCITOut_C DFC_CtlMsk.DFC_ComBCM1ChkSum_C DFC_CtlMsk.DFC_ComBCM1RingCnt_C DFC_CtlMsk.DFC_ComBCM1TOut_C DFC_CtlMsk.DFC_ComCANABusOffErr_C DFC_CtlMsk.DFC_ComCANBBusOffErr_C DFC_CtlMsk.DFC_ComCANCBusOffErr_C DFC_CtlMsk.DFC_ComCGW1ChkSum_C DFC_CtlMsk.DFC_ComCGW1RingCnt_C DFC_CtlMsk.DFC_ComCGW1TOut_C DFC_CtlMsk.DFC_ComConvBoostErr_C DFC_CtlMsk.DFC_ComConvSlipErr_C DFC_CtlMsk.DFC_ComDCDCPrfmncErr_C DFC_CtlMsk.DFC_ComDCDCTempWarn_C DFC_CtlMsk.DFC_ComEAT10Chksum_C DFC_CtlMsk.DFC_ComEAT10RingCnt_C DFC_CtlMsk.DFC_ComEAT10TOut_C DFC_CtlMsk.DFC_ComEAT11ChkSum_C DFC_CtlMsk.DFC_ComEAT11RingCnt_C DFC_CtlMsk.DFC_ComEAT11TOut_C DFC_CtlMsk.DFC_ComEAT12ChkSum_C DFC_CtlMsk.DFC_ComEAT12RingCnt_C DFC_CtlMsk.DFC_ComEAT12TOut_C DFC_CtlMsk.DFC_ComEAT13ChkSum_C DFC_CtlMsk.DFC_ComEAT13RingCnt_C DFC_CtlMsk.DFC_ComEAT13TOut_C DFC_CtlMsk.DFC_ComEAT1Chksum_C DFC_CtlMsk.DFC_ComEAT1RingCnt_C DFC_CtlMsk.DFC_ComEAT1TOut_C DFC_CtlMsk.DFC_ComEAT2ChkSum_C DFC_CtlMsk.DFC_ComEAT2RingCnt_C DFC_CtlMsk.DFC_ComEAT2TOut_C DFC_CtlMsk.DFC_ComEAT4ChkSum_C DFC_CtlMsk.DFC_ComEAT4RingCnt_C DFC_CtlMsk.DFC_ComEAT4TOut_C DFC_CtlMsk.DFC_ComEAT6Chksum_C DFC_CtlMsk.DFC_ComEAT6RingCnt_C DFC_CtlMsk.DFC_ComEAT6TOut_C DFC_CtlMsk.DFC_ComEAT7Chksum_C DFC_CtlMsk.DFC_ComEAT7RingCnt_C DFC_CtlMsk.DFC_ComEAT7TOut_C DFC_CtlMsk.DFC_ComEAT8Chksum_C DFC_CtlMsk.DFC_ComEAT8RingCnt_C DFC_CtlMsk.DFC_ComEAT8TOut_C DFC_CtlMsk.DFC_ComEATAChksum_C DFC_CtlMsk.DFC_ComEATARingCnt_C DFC_CtlMsk.DFC_ComEATATOut_C DFC_CtlMsk.DFC_ComEATBChkSum_C DFC_CtlMsk.DFC_ComEATBRingCnt_C DFC_CtlMsk.DFC_ComEATBTOut_C DFC_CtlMsk.DFC_ComEATCChksum_C DFC_CtlMsk.DFC_ComEATCRingCnt_C DFC_CtlMsk.DFC_ComEATCTOut_C DFC_CtlMsk.DFC_ComEPBBChkSum_C DFC_CtlMsk.DFC_ComEPBBRingCnt_C DFC_CtlMsk.DFC_ComEPBBTOut_C DFC_CtlMsk.DFC_ComEPBChksum_C DFC_CtlMsk.DFC_ComEPBTOut_C DFC_CtlMsk.DFC_ComEPBctRing_C DFC_CtlMsk.DFC_ComEPS1Chksum_C DFC_CtlMsk.DFC_ComEPS1RingCnt_C DFC_CtlMsk.DFC_ComEPS1TOut_C DFC_CtlMsk.DFC_ComEngCanRxErr_C DFC_CtlMsk.DFC_ComGrvySnsrErr_C DFC_CtlMsk.DFC_ComGwIMG1ChkSum_C DFC_CtlMsk.DFC_ComGwIMG1RingCnt_C DFC_CtlMsk.DFC_ComGwIMG1TOut_C DFC_CtlMsk.DFC_ComGwIMG3ChkSum_C DFC_CtlMsk.DFC_ComGwIMG3RingCnt_C DFC_CtlMsk.DFC_ComGwIMG3TOut_C DFC_CtlMsk.DFC_ComGwIMG4ChkSum_C DFC_CtlMsk.DFC_ComGwIMG4RingCnt_C DFC_CtlMsk.DFC_ComGwIMG4TOut_C DFC_CtlMsk.DFC_ComGwIMG5ChkSum_C DFC_CtlMsk.DFC_ComGwIMG5RingCnt_C DFC_CtlMsk.DFC_ComGwIMG5TOut_C DFC_CtlMsk.DFC_ComGwIMG6ChkSum_C DFC_CtlMsk.DFC_ComGwIMG6RingCnt_C DFC_CtlMsk.DFC_ComGwIMG6TOut_C DFC_CtlMsk.DFC_ComIDASBChksum_C DFC_CtlMsk.DFC_ComIDASBRingCnt_C DFC_CtlMsk.DFC_ComIDASBTOut_C DFC_CtlMsk.DFC_ComIMGMILReq_C DFC_CtlMsk.DFC_ComISSPrms_C DFC_CtlMsk.DFC_ComMETAChksum_C DFC_CtlMsk.DFC_ComMETAChksumPstDrv_C DFC_CtlMsk.DFC_ComMETARingCnt_C DFC_CtlMsk.DFC_ComMETARingCntPstDrv_C DFC_CtlMsk.DFC_ComMETATOut_C DFC_CtlMsk.DFC_ComMETATOutPstDrv_C DFC_CtlMsk.DFC_ComMETCChksum_C DFC_CtlMsk.DFC_ComMETCRingCnt_C DFC_CtlMsk.DFC_ComMETCTOut_C DFC_CtlMsk.DFC_ComMETDChksum_C DFC_CtlMsk.DFC_ComMETDRingCnt_C DFC_CtlMsk.DFC_ComMETDTOut_C DFC_CtlMsk.DFC_ComMETE2Chksum_C DFC_CtlMsk.DFC_ComMETE2RingCnt_C DFC_CtlMsk.DFC_ComMETE2TOut_C DFC_CtlMsk.DFC_ComMETFChksum_C DFC_CtlMsk.DFC_ComMETFRingCnt_C DFC_CtlMsk.DFC_ComMETFTOut_C DFC_CtlMsk.DFC_ComMETGChksum_C DFC_CtlMsk.DFC_ComMETGRingCnt_C DFC_CtlMsk.DFC_ComMETGTOut_C DFC_CtlMsk.DFC_ComMETH2Chksum_C DFC_CtlMsk.DFC_ComMETH2RingCnt_C DFC_CtlMsk.DFC_ComMETH2TOut_C DFC_CtlMsk.DFC_ComMETHChksum_C DFC_CtlMsk.DFC_ComMETHRingCnt_C DFC_CtlMsk.DFC_ComMETHTOut_C DFC_CtlMsk.DFC_ComMETIChksum_C DFC_CtlMsk.DFC_ComMETIRingCnt_C DFC_CtlMsk.DFC_ComMETITOut_C DFC_CtlMsk.DFC_ComMETKChksum_C DFC_CtlMsk.DFC_ComMETKRingCnt_C DFC_CtlMsk.DFC_ComMETKTOut_C DFC_CtlMsk.DFC_ComMETLChksum_C DFC_CtlMsk.DFC_ComMETLRingCnt_C /end DEF_CHARACTERISTIC
 /begin OUT_MEASUREMENT DFC_st.DFC_AirCClntPAnaSRCMin DFC_st.DFC_AirCSwtNpl DFC_st.DFC_AirCSwtSig DFC_st.DFC_Brk DFC_st.DFC_BrkBstSensSCB DFC_st.DFC_BrkBstSensSCG DFC_st.DFC_BrkSig DFC_st.DFC_ClthSig DFC_st.DFC_EGRVlvCurrLim DFC_st.DFC_EGRVlvOL DFC_st.DFC_EGRVlvOvrTemp DFC_st.DFC_EGRVlvSCB DFC_st.DFC_EGRVlvSCG DFC_st.DFC_EGRVlvSRCMax DFC_st.DFC_EGRVlvSRCMin DFC_st.DFC_HLSDemOvhtEngLim DFC_st.DFC_OilPSwmpSRCMax DFC_st.DFC_OilPSwmpSRCMin DFC_st.DFC_PIntkVUsLineHiB1 DFC_st.DFC_PIntkVUsLineLoB1 DFC_st.DFC_VehVPhysRngLo DFC_st.DFC_VehVSigCan DFC_st.DFC_VehVSigCanSafe DFC_st.DFC_VlvLftFbOilPSnsrIntk11SRCMax DFC_st.DFC_VlvLftFbOilPSnsrIntk11SRCMin DFC_st.DFC_ClthNpl DFC_st.DFC_GbxPNPosnDrvCdn DFC_st.DFC_GbxPNPosnPlausy DFC_st.DFC_AfsSigErrLineHiB1 DFC_st.DFC_AfsSigErrLineLoB1 DFC_st.DFC_PEnvCcMax DFC_st.DFC_PEnvCcMin DFC_st.DFC_PEnvRngChkMax DFC_st.DFC_PEnvRngChkMin DFC_st.DFC_PEnvSnsrPlaus DFC_st.DFC_UEGOHeatrRlyPsOLS1B1 DFC_st.DFC_UEGOHeatrRlyPsSCBS1B1 DFC_st.DFC_UEGOHeatrRlyPsSCGS1B1 DFC_st.DFC_UegoHeatrWireOlS1B1 DFC_st.DFC_UegoHeatrWireScbS1B1 DFC_st.DFC_UegoHeatrWireScgS1B1 DFC_st.DFC_KnDetSens1PortAMax DFC_st.DFC_KnDetSens1PortAMin DFC_st.DFC_KnDetSens1PortBMax DFC_st.DFC_KnDetSens1PortBMin DFC_st.DFC_Clth2ONStuck DFC_st.DFC_Clth2ONStuckLdc DFC_st.DFC_Clth3ONStuckLdc DFC_st.DFC_Clth3ONStuckPostDrv DFC_st.DFC_Clth4ONStuck DFC_st.DFC_Clth4ONStuckLdc DFC_st.DFC_ComBCMUnit DFC_st.DFC_ComDLCTCU01 DFC_st.DFC_ComDLCTCU02 DFC_st.DFC_ComDLCTCU1 DFC_st.DFC_ComDLCTCU11 DFC_st.DFC_ComDLCTCU12 DFC_st.DFC_ComDLCTCU13 DFC_st.DFC_ComDLCTCU14 DFC_st.DFC_ComDLCTCU2 DFC_st.DFC_ComDLCTCU3 DFC_st.DFC_ComDLCTCU4 DFC_st.DFC_ComEPSUnit DFC_st.DFC_ComIDASBUnit DFC_st.DFC_ComIMGUnit DFC_st.DFC_ComMETUnit DFC_st.DFC_ComSRSUnit DFC_st.DFC_ComVSAUnit DFC_st.DFC_EbsSocFlt DFC_st.DFC_I14229VINErr DFC_st.DFC_InjCatHeatgErr DFC_st.DFC_InjSysMulInjDiagErr DFC_st.DFC_LLRHmax DFC_st.DFC_LLRHmin DFC_st.DFC_LLRHnpl DFC_st.DFC_LLRKHmax DFC_st.DFC_LLRKHmin DFC_st.DFC_LLRKHnpl DFC_st.DFC_LinACGUnit DFC_st.DFC_LinAEVUnit DFC_st.DFC_LinEBSUnit DFC_st.DFC_RoughRoad DFC_st.DFC_SiaEEPRdErr DFC_st.DFC_SiaEEPWrngCod DFC_st.DFC_UegoHeatrStrtS1B1 DFC_st.DFC_BusDiagCANAPPLBusOff DFC_st.DFC_BusDiagCANCANCBusOff DFC_st.DFC_BusDiagCANVEHICLEBusOff DFC_st.DFC_RBA_IODIAGPWR_rba_IoExtCy329_SignalVltSply_0 DFC_st.DFC_RBA_IODIAGPWR_rba_IoExtCy329_SignalVltSply_0OT DFC_st.DFC_RBA_IODIAGPWR_rba_IoExtCy329_SignalVltSply_0OV DFC_st.DFC_RBA_IODIAGPWR_rba_IoExtCy329_SignalVltSply_0SCG DFC_st.DFC_RBA_IODIAGPWR_rba_IoExtCy329_SignalVltSply_0UV DFC_st.DFC_RBA_IODIAGPWR_rba_IoExtCy329_SignalVltSply_1 DFC_st.DFC_RBA_IODIAGPWR_rba_IoExtCy329_SignalVltSply_1OT DFC_st.DFC_RBA_IODIAGPWR_rba_IoExtCy329_SignalVltSply_1OV DFC_st.DFC_RBA_IODIAGPWR_rba_IoExtCy329_SignalVltSply_1SCG DFC_st.DFC_RBA_IODIAGPWR_rba_IoExtCy329_SignalVltSply_1UV DFC_st.DFC_RBA_IODIAGPWR_rba_IoExtCy329_SignalVltSply_2 DFC_st.DFC_RBA_IODIAGPWR_rba_IoExtCy329_SignalVltSply_2OT DFC_st.DFC_RBA_IODIAGPWR_rba_IoExtCy329_SignalVltSply_2OV DFC_st.DFC_RBA_IODIAGPWR_rba_IoExtCy329_SignalVltSply_2SCG DFC_st.DFC_RBA_IODIAGPWR_rba_IoExtCy329_SignalVltSply_2UV DFC_st.DFC_CAN_E_TIMEOUT DFC_st.DFC_LIN_E_TIMEOUT DFC_st.DFC_MRlyOL DFC_st.DFC_MRlySCB DFC_st.DFC_MRlySCG DFC_st.DFC_rba_MultiStackTrace_Threshold DFC_st.DFC_BSWM_E_ACTION_FAILED DFC_st.DFC_BSWM_E_INTRPTQUEUE_FULL DFC_st.DFC_RBA_IOEXTLIB_KEEPALIVE_DRV DFC_st.DFC_RBA_IOEXTLIB_KEEPALIVE_INI DFC_st.DFC_rba_IoSigRtc_StopCounter DFC_st.DFC_rba_MRly_Diag_Stk_Event DFC_st.DFC_rba_MemDiag_MemReadErr DFC_st.DFC_rba_MemDiag_MemWrErr DFC_st.DFC_rba_SyC_IrrSwOffTrigEngRun_Event DFC_st.DFC_rba_T15_Diag_ComInVld_Event DFC_st.DFC_rba_T15_Diag_ComOff_HwOn_Event DFC_st.DFC_rba_T15_Diag_ComOn_HwOff_Event DFC_st.DFC_AAVmin DFC_st.DFC_AGRSUS DFC_st.DFC_AfsPlausDiagHi DFC_st.DFC_AfsPlausDiagLo DFC_st.DFC_AfsVrntDiagErrB1 DFC_st.DFC_AppAllSnsrDfct DFC_st.DFC_BBKRnldg DFC_st.DFC_BBKRsyne DFC_st.DFC_BattUStdbyDiaOL DFC_st.DFC_BigLeakIntkMnfldEmiInfl DFC_st.DFC_BlkdLineTank DFC_st.DFC_BrkMnSwtContOnWarnLmp DFC_st.DFC_BrkMnSwtNotStpWarnLmp DFC_st.DFC_BrkRdntSwtContOnWarnLmp DFC_st.DFC_BrkRdntSwtNotStpWarnLmp DFC_st.DFC_CEngDsTColdStrtMax DFC_st.DFC_CEngDsTColdStrtMin DFC_st.DFC_CEngDsTImps DFC_st.DFC_CEngDsTPlausHSC DFC_st.DFC_CEngDsTPlausLSC DFC_st.DFC_CEngDsTPlausSTC DFC_st.DFC_CEngDsTSRCMax DFC_st.DFC_CEngDsTSRCMin DFC_st.DFC_CEngDsTSig DFC_st.DFC_CEngUsTColdStrtMax DFC_st.DFC_CEngUsTColdStrtMin DFC_st.DFC_CEngUsTLooseCnctn DFC_st.DFC_CEngUsTSRCMax DFC_st.DFC_CEngUsTSRCMin DFC_st.DFC_ComDCDCACCFailr DFC_st.DFC_DCDCFltDet DFC_st.DFC_DKRSA DFC_st.DFC_DKVSmax DFC_st.DFC_DKnpl DFC_st.DFC_DSKVRmax DFC_st.DFC_DSKVRmin DFC_st.DFC_DSKVRnpl DFC_st.DFC_DSKVRsig DFC_st.DFC_DSKVSsig DFC_st.DFC_DSSmax DFC_st.DFC_DSTDmax DFC_st.DFC_DSTEmax DFC_st.DFC_DSTEmin DFC_st.DFC_DSTOFmax DFC_st.DFC_DSTRmax DFC_st.DFC_DSTRmin DFC_st.DFC_DSTRnpl DFC_st.DFC_DSTRsig DFC_st.DFC_DSTTI DFC_st.DFC_DSUmax DFC_st.DFC_DiagCpv1DteskLoLoadStuckClsd DFC_st.DFC_DiagCpv1DteskLoLoadStuckOpen DFC_st.DFC_EGRVlvDrftClsd DFC_st.DFC_EGRVlvDrftOpn DFC_st.DFC_EGRVlvJamVlvClsd DFC_st.DFC_EGRVlvJamVlvOpn DFC_st.DFC_EGRVlvSprgBrk DFC_st.DFC_EGRVlvTempMdlEEPErr DFC_st.DFC_EGRVlvTmpErr DFC_st.DFC_EGSDUS2B1LtrDly DFC_st.DFC_EGSDUS2B1LtrPT1 DFC_st.DFC_EGSDUS2B1RtlDly DFC_st.DFC_EGSDUS2B1RtlPT1 DFC_st.DFC_EGSDUS2B1TarLean DFC_st.DFC_EGSDUS2B1TarRich DFC_st.DFC_EONVmax DFC_st.DFC_ETAKHLmax DFC_st.DFC_ETAKHTmax DFC_st.DFC_ETHSEmax DFC_st.DFC_ETHSEmin DFC_st.DFC_ETHSFmax DFC_st.DFC_ETHSFmin DFC_st.DFC_ETHSFsig DFC_st.DFC_ETHSNPWmax DFC_st.DFC_ETHSNPWmin DFC_st.DFC_ETHSNPWsig DFC_st.DFC_ETHSPLnpl DFC_st.DFC_ETHSTPLnpl DFC_st.DFC_EngICO DFC_st.DFC_EngPrtOvrSpdMon DFC_st.DFC_EpmCaSI1ErrSig DFC_st.DFC_EpmCaSI1MntErr DFC_st.DFC_EpmCaSI1NoSigMax DFC_st.DFC_EpmCaSI1NoSigMin DFC_st.DFC_EpmCaSI1OfsErr DFC_st.DFC_EpmCrSDGI DFC_st.DFC_EpmCrSErrSig DFC_st.DFC_EpmCrSNoSig DFC_st.DFC_EtaEngIdleNonCsers DFC_st.DFC_EtaEngPtlNonCsers DFC_st.DFC_FRAmax DFC_st.DFC_FRAmin DFC_st.DFC_FSTEmax DFC_st.DFC_FSTEmin DFC_st.DFC_FSTRmax DFC_st.DFC_FSTRmin DFC_st.DFC_FSTRnpl DFC_st.DFC_FSTmax DFC_st.DFC_FTDLAmax DFC_st.DFC_FTDLAmin DFC_st.DFC_FuPHiSnsrEleclmax DFC_st.DFC_FuPHiSnsrEleclmin DFC_st.DFC_FuPHiSnsrEleclnpl DFC_st.DFC_FuPHiSnsrURngMax DFC_st.DFC_FuPHiSnsrURngMin DFC_st.DFC_FuSnsrPhyRngMaxErr DFC_st.DFC_FuSnsrPhyRngMinErr DFC_st.DFC_GEVlvLockPinDiagIntkB1 DFC_st.DFC_GEVlvPhaSlowIntkB1 DFC_st.DFC_GEVlvPhaTargIntkB1 DFC_st.DFC_GbxRvsSwtStk DFC_st.DFC_HDRKHmax DFC_st.DFC_HDRKHmin DFC_st.DFC_HDRPLmax DFC_st.DFC_HDRPLmin DFC_st.DFC_HDRmax DFC_st.DFC_HDRmin DFC_st.DFC_HEGOS2B1ElecMax DFC_st.DFC_HEGOS2B1ElecMin DFC_st.DFC_HEGOS2B1ElecSig DFC_st.DFC_HEGOS2B1HtgNpl DFC_st.DFC_HEV00max DFC_st.DFC_HEV01max DFC_st.DFC_HEV02max DFC_st.DFC_HEV03max DFC_st.DFC_HEVE0max DFC_st.DFC_HEVE1max DFC_st.DFC_HFMmax DFC_st.DFC_HiPSysHiPMaxLimExcdd DFC_st.DFC_IVGdiCtlCvoErrMax_0 DFC_st.DFC_IVGdiCtlCvoErrMax_1 DFC_st.DFC_IVGdiCtlCvoErrMax_2 DFC_st.DFC_IVGdiCtlCvoErrMax_3 DFC_st.DFC_IVGdiCtlCvoErrMin_0 DFC_st.DFC_IVGdiCtlCvoErrMin_1 DFC_st.DFC_IVGdiCtlCvoErrMin_2 DFC_st.DFC_IVGdiCtlCvoErrMin_3 DFC_st.DFC_IVGdiCtlCvoErrMinMax DFC_st.DFC_IVGdiCtlCvoSigPlausErrSmrCdn DFC_st.DFC_IVGdiCtl_CvoErr DFC_st.DFC_IVGdiCtl_CvoSigPlaus_0 DFC_st.DFC_IVGdiCtl_CvoSigPlaus_1 DFC_st.DFC_IVGdiCtl_CvoSigPlaus_2 DFC_st.DFC_IVGdiCtl_CvoSigPlaus_3 DFC_st.DFC_IntkAirTAirFltDsCrssMax DFC_st.DFC_IntkAirTAirFltDsCrssMin DFC_st.DFC_IntkAirTAirFltDsHSCMax DFC_st.DFC_IntkAirTAirFltDsImps DFC_st.DFC_IntkAirTAirFltDsPRCMax DFC_st.DFC_IntkAirTAirFltDsPRCMin DFC_st.DFC_IntkAirTAirFltDsSRCMax DFC_st.DFC_IntkAirTAirFltDsSRCMin DFC_st.DFC_IntkAirTAirFltDsSTC DFC_st.DFC_IntkAirTIntkMnfldCrssMax DFC_st.DFC_IntkAirTIntkMnfldCrssMin DFC_st.DFC_IntkAirTIntkMnfldHSCMax DFC_st.DFC_IntkAirTIntkMnfldImps DFC_st.DFC_IntkAirTIntkMnfldPRCMax DFC_st.DFC_IntkAirTIntkMnfldPRCMin DFC_st.DFC_IntkAirTIntkMnfldSRCMax DFC_st.DFC_IntkAirTIntkMnfldSRCMin DFC_st.DFC_IntkAirTIntkMnfldSTC DFC_st.DFC_KRREGRLMX DFC_st.DFC_KRVEKOCVLCI DFC_st.DFC_KRVEKOENCHMT DFC_st.DFC_KRVEKOENCHMT0 DFC_st.DFC_KRVEKOENCHMT1 DFC_st.DFC_KRVEKOENCHMT2 DFC_st.DFC_KRVEKOENCHMT3 DFC_st.DFC_KRVEKOENCHMT4 DFC_st.DFC_KRVEKOENCHMT5 DFC_st.DFC_KRVEKOENCHMT6 DFC_st.DFC_KRVEKOENCHMT7 DFC_st.DFC_KRVEKORLMX DFC_st.DFC_KRVEKORLMXL DFC_st.DFC_KS1max DFC_st.DFC_KS1min DFC_st.DFC_LMmax DFC_st.DFC_LZSRnpl DFC_st.DFC_LamDynDiagS1B1 DFC_st.DFC_LeakIntkMnfldEmiInfl DFC_st.DFC_LinFrameErrDCDC DFC_st.DFC_LinOverrunErrDCDC DFC_st.DFC_MD00max DFC_st.DFC_MDBmax DFC_st.DFC_MDCat DFC_st.DFC_MDCatCrit DFC_st.DFC_MDCatCurr DFC_st.DFC_MDCyl_0 DFC_st.DFC_MDCyl_1 DFC_st.DFC_MDCyl_2 DFC_st.DFC_MDCyl_3 DFC_st.DFC_MDEmi DFC_st.DFC_MDEmiStrt DFC_st.DFC_MDFco DFC_st.DFC_MDMpl DFC_st.DFC_MDSegTiAdpn DFC_st.DFC_MDmax DFC_st.DFC_MFuOilMax DFC_st.DFC_MOXEMM_SMU_ALM0_0 DFC_st.DFC_MOXEMM_SMU_ALM0_1 DFC_st.DFC_MOXEMM_SMU_ALM0_10 DFC_st.DFC_MOXEMM_SMU_ALM0_11 DFC_st.DFC_MOXEMM_SMU_ALM0_13 DFC_st.DFC_MOXEMM_SMU_ALM0_14 DFC_st.DFC_MOXEMM_SMU_ALM0_2 DFC_st.DFC_MOXEMM_SMU_ALM0_22 DFC_st.DFC_MOXEMM_SMU_ALM0_23 DFC_st.DFC_MOXEMM_SMU_ALM0_4 DFC_st.DFC_MOXEMM_SMU_ALM0_5 DFC_st.DFC_MOXEMM_SMU_ALM0_7 DFC_st.DFC_MOXEMM_SMU_ALM0_8 DFC_st.DFC_MOXEMM_SMU_ALM10_16 DFC_st.DFC_MOXEMM_SMU_ALM10_17 DFC_st.DFC_MOXEMM_SMU_ALM10_21 DFC_st.DFC_MOXEMM_SMU_ALM11_0 DFC_st.DFC_MOXEMM_SMU_ALM11_1 DFC_st.DFC_MOXEMM_SMU_ALM11_2 DFC_st.DFC_MOXEMM_SMU_ALM11_3 DFC_st.DFC_MOXEMM_SMU_ALM11_4 DFC_st.DFC_MOXEMM_SMU_ALM11_5 DFC_st.DFC_MOXEMM_SMU_ALM11_8 DFC_st.DFC_MOXEMM_SMU_ALM11_9 DFC_st.DFC_MOXEMM_SMU_ALM1_0 DFC_st.DFC_MOXEMM_SMU_ALM1_1 DFC_st.DFC_MOXEMM_SMU_ALM1_10 DFC_st.DFC_MOXEMM_SMU_ALM1_11 DFC_st.DFC_MOXEMM_SMU_ALM1_13 DFC_st.DFC_MOXEMM_SMU_ALM1_14 DFC_st.DFC_MOXEMM_SMU_ALM1_2 DFC_st.DFC_MOXEMM_SMU_ALM1_22 DFC_st.DFC_MOXEMM_SMU_ALM1_23 DFC_st.DFC_MOXEMM_SMU_ALM1_4 DFC_st.DFC_MOXEMM_SMU_ALM1_5 DFC_st.DFC_MOXEMM_SMU_ALM1_7 DFC_st.DFC_MOXEMM_SMU_ALM1_8 DFC_st.DFC_MOXEMM_SMU_ALM21_0 DFC_st.DFC_MOXEMM_SMU_ALM21_16 DFC_st.DFC_MOXEMM_SMU_ALM21_3 DFC_st.DFC_MOXEMM_SMU_ALM2_1 DFC_st.DFC_MOXEMM_SMU_ALM2_10 DFC_st.DFC_MOXEMM_SMU_ALM2_11 DFC_st.DFC_MOXEMM_SMU_ALM2_13 DFC_st.DFC_MOXEMM_SMU_ALM2_14 DFC_st.DFC_MOXEMM_SMU_ALM2_22 DFC_st.DFC_MOXEMM_SMU_ALM2_23 DFC_st.DFC_MOXEMM_SMU_ALM2_4 DFC_st.DFC_MOXEMM_SMU_ALM2_5 DFC_st.DFC_MOXEMM_SMU_ALM2_7 DFC_st.DFC_MOXEMM_SMU_ALM2_8 DFC_st.DFC_MOXEMM_SMU_ALM6_0 DFC_st.DFC_MOXEMM_SMU_ALM6_11 DFC_st.DFC_MOXEMM_SMU_ALM6_12 DFC_st.DFC_MOXEMM_SMU_ALM6_14 DFC_st.DFC_MOXEMM_SMU_ALM6_15 DFC_st.DFC_MOXEMM_SMU_ALM6_17 DFC_st.DFC_MOXEMM_SMU_ALM6_18 DFC_st.DFC_MOXEMM_SMU_ALM6_20 DFC_st.DFC_MOXEMM_SMU_ALM6_21 DFC_st.DFC_MOXEMM_SMU_ALM6_25 DFC_st.DFC_MOXEMM_SMU_ALM6_4 DFC_st.DFC_MOXEMM_SMU_ALM6_5 DFC_st.DFC_MOXEMM_SMU_ALM6_7 DFC_st.DFC_MOXEMM_SMU_ALM6_8 DFC_st.DFC_MOXEMM_SMU_ALM7_1 DFC_st.DFC_MOXEMM_SMU_ALM7_12 DFC_st.DFC_MOXEMM_SMU_ALM7_13 DFC_st.DFC_MOXEMM_SMU_ALM7_14 DFC_st.DFC_MOXEMM_SMU_ALM7_15 DFC_st.DFC_MOXEMM_SMU_ALM7_16 DFC_st.DFC_MOXEMM_SMU_ALM7_17 DFC_st.DFC_MOXEMM_SMU_ALM7_2 DFC_st.DFC_MOXEMM_SMU_ALM7_20 DFC_st.DFC_MOXEMM_SMU_ALM7_25 DFC_st.DFC_MOXEMM_SMU_ALM7_26 DFC_st.DFC_MOXEMM_SMU_ALM7_28 DFC_st.DFC_MOXEMM_SMU_ALM7_29 DFC_st.DFC_MOXEMM_SMU_ALM7_30 DFC_st.DFC_MOXEMM_SMU_ALM7_31 DFC_st.DFC_MOXEMM_SMU_ALM8_0 DFC_st.DFC_MOXEMM_SMU_ALM8_1 DFC_st.DFC_MOXEMM_SMU_ALM8_10 DFC_st.DFC_MOXEMM_SMU_ALM8_11 DFC_st.DFC_MOXEMM_SMU_ALM8_12 DFC_st.DFC_MOXEMM_SMU_ALM8_16 DFC_st.DFC_MOXEMM_SMU_ALM8_18 DFC_st.DFC_MOXEMM_SMU_ALM8_2 DFC_st.DFC_MOXEMM_SMU_ALM8_3 DFC_st.DFC_MOXEMM_SMU_ALM8_31 DFC_st.DFC_MOXEMM_SMU_ALM8_4 DFC_st.DFC_MOXEMM_SMU_ALM9_0 DFC_st.DFC_MOXEMM_SMU_ALM9_15 DFC_st.DFC_MOXEMM_SMU_ALM9_3 DFC_st.DFC_MoCADCNTP DFC_st.DFC_MoCADCTst DFC_st.DFC_MoCSOPICO DFC_st.DFC_MoFAPP DFC_st.DFC_MoFAirFilgPrdc DFC_st.DFC_MoFAirFlCtOffGdi DFC_st.DFC_MoFAirFlCylGdi DFC_st.DFC_MoFAirFlFF DFC_st.DFC_MoFAirFlIn DFC_st.DFC_MoFAirFlMixCtlGdiChkAirFl DFC_st.DFC_MoFAirFlMixCtlGdiChkCtrl DFC_st.DFC_MoFAirFlMode DFC_st.DFC_MoFESpd DFC_st.DFC_MoFIACo DFC_st.DFC_MoFICOL1 DFC_st.DFC_MoFICOL2 DFC_st.DFC_MoFStrt DFC_st.DFC_MoFTrqCmp DFC_st.DFC_MoFTrqCmpMax DFC_st.DFC_MoFTrqCmpMin DFC_st.DFC_MoFVarPostBldSel DFC_st.DFC_MoXEMMHwLTMCUFW DFC_st.DFC_MoXEMMHwLTMonBIST DFC_st.DFC_MoXEMMHwLTRegMonTest DFC_st.DFC_MoXEMMHwLTStbySMUAlvTest DFC_st.DFC_MoXEMMHwLTTempSens DFC_st.DFC_MoXEMMHwLTUCBCfg DFC_st.DFC_NWSEmax DFC_st.DFC_NWSmax DFC_st.DFC_OCWDAABEActv DFC_st.DFC_OCWDACom DFC_st.DFC_OCWDAErrPin DFC_st.DFC_OCWDAOvrVltg DFC_st.DFC_ORAmax DFC_st.DFC_ORAmin DFC_st.DFC_OilPPlaus DFC_st.DFC_PLLSUmax DFC_st.DFC_PLLSUmin DFC_st.DFC_PSR1max DFC_st.DFC_PSRBmax DFC_st.DFC_PSRBmin DFC_st.DFC_PSRPmax DFC_st.DFC_PSRPmin DFC_st.DFC_PSRPsig DFC_st.DFC_PSRmax DFC_st.DFC_PUmax DFC_st.DFC_P_VSE11_OL DFC_st.DFC_P_VSE11_SCB DFC_st.DFC_P_VSE11_SCG DFC_st.DFC_PhyHighAPP1 DFC_st.DFC_PhyHighAPP2 DFC_st.DFC_PhyLowAPP1 DFC_st.DFC_PhyLowAPP2 DFC_st.DFC_SRCHighAPP1 DFC_st.DFC_SRCHighAPP2 DFC_st.DFC_SRCLowAPP1 DFC_st.DFC_SRCLowAPP2 DFC_st.DFC_SSpMon2 DFC_st.DFC_STHDRmax DFC_st.DFC_SWReset_0 DFC_st.DFC_SWReset_1 DFC_st.DFC_SWReset_2 DFC_st.DFC_SyncAPP DFC_st.DFC_TANKLnpl DFC_st.DFC_TAmax_Dummy DFC_st.DFC_TESFmax DFC_st.DFC_TESGmax DFC_st.DFC_TKAEmax DFC_st.DFC_TKAEmin DFC_st.DFC_TKARmax DFC_st.DFC_TKARnpl DFC_st.DFC_TMmax_Dummy DFC_st.DFC_TUMmax_Dummy DFC_st.DFC_TWCDPriCatB1 DFC_st.DFC_ThrVlvClsdPosnFirstOffsLrnImpoB1 DFC_st.DFC_ThrVlvClsdPosnOffsLrnImpoB1 DFC_st.DFC_ThrVlvClsdPosnOffsLrnMaxB1 DFC_st.DFC_ThrVlvClsdPosnOffsLrnMinB1 DFC_st.DFC_ThrVlvCtrlDeB1 DFC_st.DFC_ThrVlvDycB1 DFC_st.DFC_ThrVlvLimpAirPosnMaxAbsltDriftB1 DFC_st.DFC_ThrVlvLimpAirPosnMaxB1 DFC_st.DFC_ThrVlvLimpAirPosnMaxRelDriftB1 DFC_st.DFC_ThrVlvLimpAirPosnMinB1 DFC_st.DFC_ThrVlvOpenLoadB1 DFC_st.DFC_ThrVlvOpenSprgB1 DFC_st.DFC_ThrVlvOpenSprgSprdB1 DFC_st.DFC_ThrVlvOpenSprgTwnB1 DFC_st.DFC_ThrVlvOverTB1 DFC_st.DFC_ThrVlvRetSprgB1 DFC_st.DFC_ThrVlvRetSprgSprdB1 DFC_st.DFC_ThrVlvRetSprgTwnB1 DFC_st.DFC_ThrVlvSens1MaxB1 DFC_st.DFC_ThrVlvSens1NplB1 DFC_st.DFC_ThrVlvSens2MaxB1 DFC_st.DFC_ThrVlvSens2MinB1 DFC_st.DFC_ThrVlvSens2NplB1 DFC_st.DFC_ThrVlvShoCircB1 DFC_st.DFC_ThrVlvSpiErrB1 DFC_st.DFC_ThrvlvSens1MinB1 DFC_st.DFC_TiOffTBasdChkFast DFC_st.DFC_TiOffTBasdChkSlow DFC_st.DFC_UEGOSnsrMntdS1B1 DFC_st.DFC_VehVSig DFC_st.DFC_VlvLftFbSwtIntk11SpclFail DFC_st.DFC_VlvLftFbSwtIntk11StdFail DSQ_st.DSQ_ACClntP DSQ_st.DSQ_ACEvpT DSQ_st.DSQ_AirCCmprActr DSQ_st.DSQ_BattU DSQ_st.DSQ_BattULo DSQ_st.DSQ_BrkBstPMdl DSQ_st.DSQ_BrkP DSQ_st.DSQ_BrkPSnsr DSQ_st.DSQ_CoVMDIDASFail DSQ_st.DSQ_DSMInhibitAlways DSQ_st.DSQ_EGRVlv_GovDesVal DSQ_st.DSQ_ElecLd DSQ_st.DSQ_EngICO DSQ_st.DSQ_EpmCaSSigQuality DSQ_st.DSQ_EpmReverseRun DSQ_st.DSQ_FanDIO_0 DSQ_st.DSQ_FanDIO_1 DSQ_st.DSQ_FuelP DSQ_st.DSQ_FuelT DSQ_st.DSQ_GEVCtlTOilCylHd DSQ_st.DSQ_GEVlvAgIntkB1 DSQ_st.DSQ_GbxPNPos DSQ_st.DSQ_GbxPosNotPN DSQ_st.DSQ_InjVlv_DI_CylOk DSQ_st.DSQ_MRly DSQ_st.DSQ_OilP DSQ_st.DSQ_PEnvMeasVld DSQ_st.DSQ_PEnvVld DSQ_st.DSQ_PEnv_pRaw DSQ_st.DSQ_PRail DSQ_st.DSQ_PThrVlvUs DSQ_st.DSQ_PThrVlvUsB1 DSQ_st.DSQ_StrtImobChk DSQ_st.DSQ_TDevCenColdStrt DSQ_st.DSQ_VehV DSQ_st.DSQ_VehVSens DSQ_st.DSQ_VehVSnsr DSQ_st.DSQ_stAPP DSQ_st.DSQ_stComEAT4 /end OUT_MEASUREMENT
 /begin LOC_MEASUREMENT DFC_lenMaxCllsn DFC_nrCllsnClear DFC_nrCllsnReInit DFC_nrCllsnReport DFC_numDfcMaxCllsn DFC_stClctFault_mp DFC_stClctTst_mp DFC_stFinal DFC_stMem DFC_stRdy DFC_stTestFaildInhb /end LOC_MEASUREMENT
 FUNCTION_VERSION "30000.33.0_1.1.0" /end FUNCTION
/begin COMPU_METHOD DFCDFP_Verb "" TAB_VERB "%6.3" "-" COMPU_TAB_REF DFCDFP_Verb /end COMPU_METHOD
/begin COMPU_VTAB DFCDFP_Verb "" TAB_VERB 990 0 "NoEntry" 1 "DFC_AAVEmax" 2 "DFC_AAVEmin" 3 "DFC_AAVEsig" 4 "DFC_AltIOACGFailr" 5 "DFC_AltIOACGHiVltg" 6 "DFC_AltIOACGLoVltg" 7 "DFC_AltIOACGTHi" 8 "DFC_AltIODConnACG" 9 "DFC_BGOELWAF" 10 "DFC_BattUHiFailr" 11 "DFC_BattULoFailr" 12 "DFC_BrkBstPDriftHiErr" 13 "DFC_BrkBstPDriftLoErr" 14 "DFC_BrkBstPSnsrStuck" 15 "DFC_BrkMnSwtContOn" 16 "DFC_BrkMnSwtNotStp" 17 "DFC_BrkNpl" 18 "DFC_BrkRdntSwtContOn" 19 "DFC_BrkRdntSwtNotStp" 20 "DFC_Clth3ONStuck" 21 "DFC_Clth4OFFStuck" 22 "DFC_ClthOFFStuck" 23 "DFC_ClthONStuck" 24 "DFC_ClthStkFailInfo" 25 "DFC_ComACFailInfo" 26 "DFC_ComATFTValErr" 27 "DFC_ComATMILReq" 28 "DFC_ComAYCAChksum" 29 "DFC_ComAYCARingCnt" 30 "DFC_ComAYCATOut" 31 "DFC_ComAYCDChkSum" 32 "DFC_ComAYCDTOut" 33 "DFC_ComAYCFChksum" 34 "DFC_ComAYCFRingCnt" 35 "DFC_ComAYCFTOut" 36 "DFC_ComAYCGChksum" 37 "DFC_ComAYCGRingCnt" 38 "DFC_ComAYCGTOut" 39 "DFC_ComAYCIChkSum" 40 "DFC_ComAYCIRingCnt" 41 "DFC_ComAYCITOut" 42 "DFC_ComBCM1ChkSum" 43 "DFC_ComBCM1RingCnt" 44 "DFC_ComBCM1TOut" 45 "DFC_ComCANABusOffErr" 46 "DFC_ComCANBBusOffErr" 47 "DFC_ComCANCBusOffErr" 48 "DFC_ComCGW1ChkSum" 49 "DFC_ComCGW1RingCnt" 50 "DFC_ComCGW1TOut" 51 "DFC_ComConvBoostErr" 52 "DFC_ComConvSlipErr" 53 "DFC_ComDCDCPrfmncErr" 54 "DFC_ComDCDCTempWarn" 55 "DFC_ComEAT10Chksum" 56 "DFC_ComEAT10RingCnt" 57 "DFC_ComEAT10TOut" 58 "DFC_ComEAT11ChkSum" 59 "DFC_ComEAT11RingCnt" 60 "DFC_ComEAT11TOut" 61 "DFC_ComEAT12ChkSum" 62 "DFC_ComEAT12RingCnt" 63 "DFC_ComEAT12TOut" 64 "DFC_ComEAT13ChkSum" 65 "DFC_ComEAT13RingCnt" 66 "DFC_ComEAT13TOut" 67 "DFC_ComEAT1Chksum" 68 "DFC_ComEAT1RingCnt" 69 "DFC_ComEAT1TOut" 70 "DFC_ComEAT2ChkSum" 71 "DFC_ComEAT2RingCnt" 72 "DFC_ComEAT2TOut" 73 "DFC_ComEAT4ChkSum" 74 "DFC_ComEAT4RingCnt" 75 "DFC_ComEAT4TOut" 76 "DFC_ComEAT6Chksum" 77 "DFC_ComEAT6RingCnt" 78 "DFC_ComEAT6TOut" 79 "DFC_ComEAT7Chksum" 80 "DFC_ComEAT7RingCnt" 81 "DFC_ComEAT7TOut" 82 "DFC_ComEAT8Chksum" 83 "DFC_ComEAT8RingCnt" 84 "DFC_ComEAT8TOut" 85 "DFC_ComEATAChksum" 86 "DFC_ComEATARingCnt" 87 "DFC_ComEATATOut" 88 "DFC_ComEATBChkSum" 89 "DFC_ComEATBRingCnt" 90 "DFC_ComEATBTOut" 91 "DFC_ComEATCChksum" 92 "DFC_ComEATCRingCnt" 93 "DFC_ComEATCTOut" 94 "DFC_ComEPBBChkSum" 95 "DFC_ComEPBBRingCnt" 96 "DFC_ComEPBBTOut" 97 "DFC_ComEPBChksum" 98 "DFC_ComEPBTOut" 99 "DFC_ComEPBctRing" 100 "DFC_ComEPS1Chksum" 101 "DFC_ComEPS1RingCnt" 102 "DFC_ComEPS1TOut" 103 "DFC_ComEngCanRxErr" 104 "DFC_ComGrvySnsrErr" 105 "DFC_ComGwIMG1ChkSum" 106 "DFC_ComGwIMG1RingCnt" 107 "DFC_ComGwIMG1TOut" 108 "DFC_ComGwIMG3ChkSum" 109 "DFC_ComGwIMG3RingCnt" 110 "DFC_ComGwIMG3TOut" 111 "DFC_ComGwIMG4ChkSum" 112 "DFC_ComGwIMG4RingCnt" 113 "DFC_ComGwIMG4TOut" 114 "DFC_ComGwIMG5ChkSum" 115 "DFC_ComGwIMG5RingCnt" 116 "DFC_ComGwIMG5TOut" 117 "DFC_ComGwIMG6ChkSum" 118 "DFC_ComGwIMG6RingCnt" 119 "DFC_ComGwIMG6TOut" 120 "DFC_ComIDASBChksum" 121 "DFC_ComIDASBRingCnt" 122 "DFC_ComIDASBTOut" 123 "DFC_ComIMGMILReq" 124 "DFC_ComISSPrms" 125 "DFC_ComMETAChksum" 126 "DFC_ComMETAChksumPstDrv" 127 "DFC_ComMETARingCnt" 128 "DFC_ComMETARingCntPstDrv" 129 "DFC_ComMETATOut" 130 "DFC_ComMETATOutPstDrv" 131 "DFC_ComMETCChksum" 132 "DFC_ComMETCRingCnt" 133 "DFC_ComMETCTOut" 134 "DFC_ComMETDChksum" 135 "DFC_ComMETDRingCnt" 136 "DFC_ComMETDTOut" 137 "DFC_ComMETE2Chksum" 138 "DFC_ComMETE2RingCnt" 139 "DFC_ComMETE2TOut" 140 "DFC_ComMETFChksum" 141 "DFC_ComMETFRingCnt" 142 "DFC_ComMETFTOut" 143 "DFC_ComMETGChksum" 144 "DFC_ComMETGRingCnt" 145 "DFC_ComMETGTOut" 146 "DFC_ComMETH2Chksum" 147 "DFC_ComMETH2RingCnt" 148 "DFC_ComMETH2TOut" 149 "DFC_ComMETHChksum" 150 "DFC_ComMETHRingCnt" 151 "DFC_ComMETHTOut" 152 "DFC_ComMETIChksum" 153 "DFC_ComMETIRingCnt" 154 "DFC_ComMETITOut" 155 "DFC_ComMETKChksum" 156 "DFC_ComMETKRingCnt" 157 "DFC_ComMETKTOut" 158 "DFC_ComMETLChksum" 159 "DFC_ComMETLRingCnt" 160 "DFC_ComMETLTOut" 161 "DFC_ComMETMChksum" 162 "DFC_ComMETMRingCnt" 163 "DFC_ComMETMTOut" 164 "DFC_ComMETNChksum" 165 "DFC_ComMETNRingCnt" 166 "DFC_ComMETNTOut" 167 "DFC_ComMtrCom" 168 "DFC_ComPCUChkSum" 169 "DFC_ComPCURingCnt" 170 "DFC_ComPCUTOut" 171 "DFC_ComSRSAChksum" 172 "DFC_ComSRSARingCnt" 173 "DFC_ComSRSATOut" 174 "DFC_ComSRSBChksum" 175 "DFC_ComSRSBRingCnt" 176 "DFC_ComSRSBTOut" 177 "DFC_ComSRSChksum" 178 "DFC_ComSRSErr" 179 "DFC_ComSRSRingCnt" 180 "DFC_ComSRSTOut" 181 "DFC_ComVehSpdPndFltTCU" 182 "DFC_EbsChartcCurrErr" 183 "DFC_EbsSelfDiagErr" 184 "DFC_GEVlvPhaCsersIntkB1" 185 "DFC_GEVlvPhaPsOpenLoadIntkB1" 186 "DFC_GEVlvPhaPsShoToBattIntkB1" 187 "DFC_GEVlvPhaPsShoToGndIntkB1" 188 "DFC_GbxCANDigPlausErr" 189 "DFC_GbxNPos1SRCMax" 190 "DFC_GbxNPos1SRCMin" 191 "DFC_GbxNPos2SRCMax" 192 "DFC_GbxNPos2SRCMin" 193 "DFC_GbxNPosAlvChk" 194 "DFC_GbxNPosSyncErr" 195 "DFC_HEGOS2B1HtrPsMax" 196 "DFC_HEGOS2B1HtrPsMin" 197 "DFC_HEGOS2B1HtrPsSig" 198 "DFC_LinCSErrACG" 199 "DFC_LinCSErrAEV" 200 "DFC_LinCSErrDCDC" 201 "DFC_LinCSErrEBS" 202 "DFC_LinHdrTimeoutErrACG" 203 "DFC_LinHdrTimeoutErrAEV" 204 "DFC_LinHdrTimeoutErrDCDC" 205 "DFC_LinHdrTimeoutErrEBS" 206 "DFC_LinMsgTimeoutErrACG" 207 "DFC_LinMsgTimeoutErrAEV" 208 "DFC_LinMsgTimeoutErrDCDC" 209 "DFC_LinMsgTimeoutErrEBS" 210 "DFC_LinNoStrtComErr" 211 "DFC_LowPresOilP" 212 "DFC_MisfDetVWhlFrntLeOORHi" 213 "DFC_MisfDetVWhlFrntLeRatyHi" 214 "DFC_MisfDetVWhlFrntLeRatyLo" 215 "DFC_MisfDetVWhlFrntLeStuck" 216 "DFC_MisfDetVWhlFrntRiOORHi" 217 "DFC_MisfDetVWhlFrntRiRatyHi" 218 "DFC_MisfDetVWhlFrntRiRatyLo" 219 "DFC_MisfDetVWhlFrntRiStuck" 220 "DFC_MisfDetVWhlReLeOORHi" 221 "DFC_MisfDetVWhlReLeRatyHi" 222 "DFC_MisfDetVWhlReLeRatyLo" 223 "DFC_MisfDetVWhlReLeStuck" 224 "DFC_MisfDetVWhlReRiOORHi" 225 "DFC_MisfDetVWhlReRiRatyHi" 226 "DFC_MisfDetVWhlReRiRatyLo" 227 "DFC_MisfDetVWhlReRiStuck" 228 "DFC_MisfDetdVWhlFrntLePlaus" 229 "DFC_MisfDetdVWhlFrntRiPlaus" 230 "DFC_MisfDetdVWhlReLePlaus" 231 "DFC_MisfDetdVWhlReRiPlaus" 232 "DFC_PEnvSigRngMax" 233 "DFC_PEnvSigRngMin" 234 "DFC_StmFault" 235 "DFC_StrtCtOffPth" 236 "DFC_StrtCtlErr" 237 "DFC_StrtFault" 238 "DFC_StrtLckJudg1" 239 "DFC_StrtLckJudg2" 240 "DFC_StrtOL" 241 "DFC_StrtOL2" 242 "DFC_StrtSCB" 243 "DFC_StrtSCB2" 244 "DFC_StrtSCG" 245 "DFC_StrtSCG2" 246 "DFC_StrtStkRly1" 247 "DFC_StrtStkRly2" 248 "DFC_TEVEmax" 249 "DFC_TEVEmin" 250 "DFC_TEVEsig" 251 "DFC_UegoHeatrPrfmncLoS1B1" 252 "DFC_VehVAllPlaus" 253 "DFC_VehVNCSnsrElecFailr" 254 "DFC_VehVPlausCan" 255 "DFC_VehVPlausFco" 256 "DFC_VehVPlausPwr" 257 "DFC_VehVPlausV2N" 258 "DFC_VehVSpdSnsrAElecFailr" 259 "DFC_VehVSpdSnsrBElecFailr" 260 "DFC_ClthMax" 261 "DFC_IgnClPs_DevComErr" 262 "DFC_IgnClPs_LineOl_0" 263 "DFC_IgnClPs_LineOl_1" 264 "DFC_IgnClPs_LineOl_2" 265 "DFC_IgnClPs_LineOl_3" 266 "DFC_IgnClPs_LineScb_0" 267 "DFC_IgnClPs_LineScb_1" 268 "DFC_IgnClPs_LineScb_2" 269 "DFC_IgnClPs_LineScb_3" 270 "DFC_IgnClPs_LineScg_0" 271 "DFC_IgnClPs_LineScg_1" 272 "DFC_IgnClPs_LineScg_2" 273 "DFC_IgnClPs_LineScg_3" 274 "DFC_KRVEKOEVAB" 275 "DFC_KRVEKOEVAB0" 276 "DFC_KRVEKOEVAB1" 277 "DFC_KRVEKOEVAB2" 278 "DFC_KRVEKOEVAB3" 279 "DFC_UegoSigEcuAsicS1B1" 280 "DFC_UegoSigEcuComS1B1" 281 "DFC_UegoSigSnsrS1B1" 282 "DFC_UegoSigWireOlApesS1B1" 283 "DFC_UegoSigWireOlIpeS1B1" 284 "DFC_UegoSigWireOlReS1B1" 285 "DFC_UegoSigWireRCmpS1B1" 286 "DFC_UegoSigWireScbS1B1" 287 "DFC_UegoSigWireScgS1B1" 288 "DFC_AfsPhyRngHiB1" 289 "DFC_AfsPhyRngLoB1" 290 "DFC_AirCCmprOL" 291 "DFC_AirCCmprOvrTemp" 292 "DFC_AirCCmprSCB" 293 "DFC_AirCCmprSCG" 294 "DFC_AltErr" 295 "DFC_BattUSRCMax" 296 "DFC_BattUSRCMin" 297 "DFC_ComChksTCU1" 298 "DFC_ComChksTCU11" 299 "DFC_ComChksTCU12" 300 "DFC_ComChksTCU13" 301 "DFC_ComChksTCU2" 302 "DFC_ComChksTCU3" 303 "DFC_ComChksTCU4" 304 "DFC_ComCntTCU1" 305 "DFC_ComCntTCU11" 306 "DFC_ComCntTCU12" 307 "DFC_ComCntTCU13" 308 "DFC_ComCntTCU2" 309 "DFC_ComCntTCU3" 310 "DFC_ComCntTCU4" 311 "DFC_ComTOutTCU01" 312 "DFC_ComTOutTCU02" 313 "DFC_ComTOutTCU1" 314 "DFC_ComTOutTCU11" 315 "DFC_ComTOutTCU12" 316 "DFC_ComTOutTCU13" 317 "DFC_ComTOutTCU14" 318 "DFC_ComTOutTCU2" 319 "DFC_ComTOutTCU3" 320 "DFC_ComTOutTCU4" 321 "DFC_DevLibBattUHi" 322 "DFC_DevLibBattULo" 323 "DFC_EGRVlvFailSafeActv" 324 "DFC_EGRVlvGovDvtCld" 325 "DFC_EGRVlvPhysSRCMax" 326 "DFC_EGRVlvPhysSRCMin" 327 "DFC_FanDIOOL_0" 328 "DFC_FanDIOOL_1" 329 "DFC_FanDIOOvrTemp_0" 330 "DFC_FanDIOOvrTemp_1" 331 "DFC_FanDIOSCB_0" 332 "DFC_FanDIOSCB_1" 333 "DFC_FanDIOSCG_0" 334 "DFC_FanDIOSCG_1" 335 "DFC_MRlyDcOL" 336 "DFC_MRlyDcSCB" 337 "DFC_MRlyDcSCG" 338 "DFC_PSPOL" 339 "DFC_PSPOvrTemp" 340 "DFC_PSPSCB" 341 "DFC_PSPSCG" 342 "DFC_T50Err" 343 "DFC_ThrVlvLoBattB1" 344 "DFC_UegoSigOperPlausS1B1" 345 "DFC_VehVPhysRngHi" 346 "DFC_VehVSclOutOL" 347 "DFC_VehVSclOutOT" 348 "DFC_VehVSclOutSCB" 349 "DFC_VehVSclOutSCG" 350 "DFC_VehVSigFL" 351 "DFC_VehVSigFR" 352 "DFC_VehVSigRL" 353 "DFC_VehVSigRR" 354 "DFC_VehVSnsrARngHi" 355 "DFC_VehVSnsrBRngHi" 356 "DFC_VehVSpdRtyDiag" 357 "DFC_DHFHD" 358 "DFC_InjVlv_DI_DcDc" 359 "DFC_InjVlv_DI_NoLd_0" 360 "DFC_InjVlv_DI_NoLd_1" 361 "DFC_InjVlv_DI_NoLd_2" 362 "DFC_InjVlv_DI_NoLd_3" 363 "DFC_InjVlv_DI_ScBnk_0" 364 "DFC_InjVlv_DI_ScBnk_1" 365 "DFC_InjVlv_DI_ScBnk_2" 366 "DFC_InjVlv_DI_ScBnk_3" 367 "DFC_InjVlv_DI_ScCyl_0" 368 "DFC_InjVlv_DI_ScCyl_1" 369 "DFC_InjVlv_DI_ScCyl_2" 370 "DFC_InjVlv_DI_ScCyl_3" 371 "DFC_InjVlv_DI_ScHsLs_0" 372 "DFC_InjVlv_DI_ScHsLs_1" 373 "DFC_InjVlv_DI_ScHsLs_2" 374 "DFC_InjVlv_DI_ScHsLs_3" 375 "DFC_MfPsDiaOpenLoad1" 376 "DFC_MfPsDiaScHiS1" 377 "DFC_MfPsDiaScHiSLowS1" 378 "DFC_MfPsDiaScLowS1" 379 "DFC_ACEvpTPhysRngHi" 380 "DFC_ACEvpTPhysRngLo" 381 "DFC_ACEvpTSRCMax" 382 "DFC_ACEvpTSRCMin" 383 "DFC_AfsRawSigRngHiB1" 384 "DFC_AfsRawSigRngLoB1" 385 "DFC_AfsSnsrErrB1" 386 "DFC_AirCClntPAnaSRCMax" 387 "DFC_AirCClntPAnaSRCMin" 388 "DFC_AirCSwtNpl" 389 "DFC_AirCSwtSig" 390 "DFC_Brk" 391 "DFC_BrkBstSensSCB" 392 "DFC_BrkBstSensSCG" 393 "DFC_BrkSig" 394 "DFC_ClthSig" 395 "DFC_EGRVlvCurrLim" 396 "DFC_EGRVlvOL" 397 "DFC_EGRVlvOvrTemp" 398 "DFC_EGRVlvSCB" 399 "DFC_EGRVlvSCG" 400 "DFC_EGRVlvSRCMax" 401 "DFC_EGRVlvSRCMin" 402 "DFC_HLSDemOvhtEngLim" 403 "DFC_OilPSwmpSRCMax" 404 "DFC_OilPSwmpSRCMin" 405 "DFC_PIntkVUsLineHiB1" 406 "DFC_PIntkVUsLineLoB1" 407 "DFC_VehVPhysRngLo" 408 "DFC_VehVSigCan" 409 "DFC_VehVSigCanSafe" 410 "DFC_VlvLftFbOilPSnsrIntk11SRCMax" 411 "DFC_VlvLftFbOilPSnsrIntk11SRCMin" 412 "DFC_ClthNpl" 413 "DFC_GbxPNPosnDrvCdn" 414 "DFC_GbxPNPosnPlausy" 415 "DFC_AfsSigErrLineHiB1" 416 "DFC_AfsSigErrLineLoB1" 417 "DFC_PEnvCcMax" 418 "DFC_PEnvCcMin" 419 "DFC_PEnvRngChkMax" 420 "DFC_PEnvRngChkMin" 421 "DFC_PEnvSnsrPlaus" 422 "DFC_UEGOHeatrRlyPsOLS1B1" 423 "DFC_UEGOHeatrRlyPsSCBS1B1" 424 "DFC_UEGOHeatrRlyPsSCGS1B1" 425 "DFC_UegoHeatrWireOlS1B1" 426 "DFC_UegoHeatrWireScbS1B1" 427 "DFC_UegoHeatrWireScgS1B1" 428 "DFC_KnDetSens1PortAMax" 429 "DFC_KnDetSens1PortAMin" 430 "DFC_KnDetSens1PortBMax" 431 "DFC_KnDetSens1PortBMin" 432 "DFC_Clth2ONStuck" 433 "DFC_Clth2ONStuckLdc" 434 "DFC_Clth3ONStuckLdc" 435 "DFC_Clth3ONStuckPostDrv" 436 "DFC_Clth4ONStuck" 437 "DFC_Clth4ONStuckLdc" 438 "DFC_ComBCMUnit" 439 "DFC_ComDLCTCU01" 440 "DFC_ComDLCTCU02" 441 "DFC_ComDLCTCU1" 442 "DFC_ComDLCTCU11" 443 "DFC_ComDLCTCU12" 444 "DFC_ComDLCTCU13" 445 "DFC_ComDLCTCU14" 446 "DFC_ComDLCTCU2" 447 "DFC_ComDLCTCU3" 448 "DFC_ComDLCTCU4" 449 "DFC_ComEPSUnit" 450 "DFC_ComIDASBUnit" 451 "DFC_ComIMGUnit" 452 "DFC_ComMETUnit" 453 "DFC_ComSRSUnit" 454 "DFC_ComVSAUnit" 455 "DFC_EbsSocFlt" 456 "DFC_I14229VINErr" 457 "DFC_InjCatHeatgErr" 458 "DFC_InjSysMulInjDiagErr" 459 "DFC_LLRHmax" 460 "DFC_LLRHmin" 461 "DFC_LLRHnpl" 462 "DFC_LLRKHmax" 463 "DFC_LLRKHmin" 464 "DFC_LLRKHnpl" 465 "DFC_LinACGUnit" 466 "DFC_LinAEVUnit" 467 "DFC_LinEBSUnit" 468 "DFC_RoughRoad" 469 "DFC_SiaEEPRdErr" 470 "DFC_SiaEEPWrngCod" 471 "DFC_UegoHeatrStrtS1B1" 472 "DFC_BusDiagCANAPPLBusOff" 473 "DFC_BusDiagCANCANCBusOff" 474 "DFC_BusDiagCANVEHICLEBusOff" 475 "DFC_RBA_IODIAGPWR_rba_IoExtCy329_SignalVltSply_0" 476 "DFC_RBA_IODIAGPWR_rba_IoExtCy329_SignalVltSply_0OT" 477 "DFC_RBA_IODIAGPWR_rba_IoExtCy329_SignalVltSply_0OV" 478 "DFC_RBA_IODIAGPWR_rba_IoExtCy329_SignalVltSply_0SCG" 479 "DFC_RBA_IODIAGPWR_rba_IoExtCy329_SignalVltSply_0UV" 480 "DFC_RBA_IODIAGPWR_rba_IoExtCy329_SignalVltSply_1" 481 "DFC_RBA_IODIAGPWR_rba_IoExtCy329_SignalVltSply_1OT" 482 "DFC_RBA_IODIAGPWR_rba_IoExtCy329_SignalVltSply_1OV" 483 "DFC_RBA_IODIAGPWR_rba_IoExtCy329_SignalVltSply_1SCG" 484 "DFC_RBA_IODIAGPWR_rba_IoExtCy329_SignalVltSply_1UV" 485 "DFC_RBA_IODIAGPWR_rba_IoExtCy329_SignalVltSply_2" 486 "DFC_RBA_IODIAGPWR_rba_IoExtCy329_SignalVltSply_2OT" 487 "DFC_RBA_IODIAGPWR_rba_IoExtCy329_SignalVltSply_2OV" 488 "DFC_RBA_IODIAGPWR_rba_IoExtCy329_SignalVltSply_2SCG" 489 "DFC_RBA_IODIAGPWR_rba_IoExtCy329_SignalVltSply_2UV" 490 "DFC_CAN_E_TIMEOUT" 491 "DFC_LIN_E_TIMEOUT" 492 "DFC_MRlyOL" 493 "DFC_MRlySCB" 494 "DFC_MRlySCG" 495 "DFC_rba_MultiStackTrace_Threshold" 496 "DFC_BSWM_E_ACTION_FAILED" 497 "DFC_BSWM_E_INTRPTQUEUE_FULL" 498 "DFC_RBA_IOEXTLIB_KEEPALIVE_DRV" 499 "DFC_RBA_IOEXTLIB_KEEPALIVE_INI" 500 "DFC_rba_IoSigRtc_StopCounter" 501 "DFC_rba_MRly_Diag_Stk_Event" 502 "DFC_rba_MemDiag_MemReadErr" 503 "DFC_rba_MemDiag_MemWrErr" 504 "DFC_rba_SyC_IrrSwOffTrigEngRun_Event" 505 "DFC_rba_T15_Diag_ComInVld_Event" 506 "DFC_rba_T15_Diag_ComOff_HwOn_Event" 507 "DFC_rba_T15_Diag_ComOn_HwOff_Event" 508 "DFC_AAVmin" 509 "DFC_AGRSUS" 510 "DFC_AfsPlausDiagHi" 511 "DFC_AfsPlausDiagLo" 512 "DFC_AfsVrntDiagErrB1" 513 "DFC_AppAllSnsrDfct" 514 "DFC_BBKRnldg" 515 "DFC_BBKRsyne" 516 "DFC_BattUStdbyDiaOL" 517 "DFC_BigLeakIntkMnfldEmiInfl" 518 "DFC_BlkdLineTank" 519 "DFC_BrkMnSwtContOnWarnLmp" 520 "DFC_BrkMnSwtNotStpWarnLmp" 521 "DFC_BrkRdntSwtContOnWarnLmp" 522 "DFC_BrkRdntSwtNotStpWarnLmp" 523 "DFC_CEngDsTColdStrtMax" 524 "DFC_CEngDsTColdStrtMin" 525 "DFC_CEngDsTImps" 526 "DFC_CEngDsTPlausHSC" 527 "DFC_CEngDsTPlausLSC" 528 "DFC_CEngDsTPlausSTC" 529 "DFC_CEngDsTSRCMax" 530 "DFC_CEngDsTSRCMin" 531 "DFC_CEngDsTSig" 532 "DFC_CEngUsTColdStrtMax" 533 "DFC_CEngUsTColdStrtMin" 534 "DFC_CEngUsTLooseCnctn" 535 "DFC_CEngUsTSRCMax" 536 "DFC_CEngUsTSRCMin" 537 "DFC_ComDCDCACCFailr" 538 "DFC_DCDCFltDet" 539 "DFC_DKRSA" 540 "DFC_DKVSmax" 541 "DFC_DKnpl" 542 "DFC_DSKVRmax" 543 "DFC_DSKVRmin" 544 "DFC_DSKVRnpl" 545 "DFC_DSKVRsig" 546 "DFC_DSKVSsig" 547 "DFC_DSSmax" 548 "DFC_DSTDmax" 549 "DFC_DSTEmax" 550 "DFC_DSTEmin" 551 "DFC_DSTOFmax" 552 "DFC_DSTRmax" 553 "DFC_DSTRmin" 554 "DFC_DSTRnpl" 555 "DFC_DSTRsig" 556 "DFC_DSTTI" 557 "DFC_DSUmax" 558 "DFC_DiagCpv1DteskLoLoadStuckClsd" 559 "DFC_DiagCpv1DteskLoLoadStuckOpen" 560 "DFC_EGRVlvDrftClsd" 561 "DFC_EGRVlvDrftOpn" 562 "DFC_EGRVlvJamVlvClsd" 563 "DFC_EGRVlvJamVlvOpn" 564 "DFC_EGRVlvSprgBrk" 565 "DFC_EGRVlvTempMdlEEPErr" 566 "DFC_EGRVlvTmpErr" 567 "DFC_EGSDUS2B1LtrDly" 568 "DFC_EGSDUS2B1LtrPT1" 569 "DFC_EGSDUS2B1RtlDly" 570 "DFC_EGSDUS2B1RtlPT1" 571 "DFC_EGSDUS2B1TarLean" 572 "DFC_EGSDUS2B1TarRich" 573 "DFC_EONVmax" 574 "DFC_ETAKHLmax" 575 "DFC_ETAKHTmax" 576 "DFC_ETHSEmax" 577 "DFC_ETHSEmin" 578 "DFC_ETHSFmax" 579 "DFC_ETHSFmin" 580 "DFC_ETHSFsig" 581 "DFC_ETHSNPWmax" 582 "DFC_ETHSNPWmin" 583 "DFC_ETHSNPWsig" 584 "DFC_ETHSPLnpl" 585 "DFC_ETHSTPLnpl" 586 "DFC_EngICO" 587 "DFC_EngPrtOvrSpdMon" 588 "DFC_EpmCaSI1ErrSig" 589 "DFC_EpmCaSI1MntErr" 590 "DFC_EpmCaSI1NoSigMax" 591 "DFC_EpmCaSI1NoSigMin" 592 "DFC_EpmCaSI1OfsErr" 593 "DFC_EpmCrSDGI" 594 "DFC_EpmCrSErrSig" 595 "DFC_EpmCrSNoSig" 596 "DFC_EtaEngIdleNonCsers" 597 "DFC_EtaEngPtlNonCsers" 598 "DFC_FRAmax" 599 "DFC_FRAmin" 600 "DFC_FSTEmax" 601 "DFC_FSTEmin" 602 "DFC_FSTRmax" 603 "DFC_FSTRmin" 604 "DFC_FSTRnpl" 605 "DFC_FSTmax" 606 "DFC_FTDLAmax" 607 "DFC_FTDLAmin" 608 "DFC_FuPHiSnsrEleclmax" 609 "DFC_FuPHiSnsrEleclmin" 610 "DFC_FuPHiSnsrEleclnpl" 611 "DFC_FuPHiSnsrURngMax" 612 "DFC_FuPHiSnsrURngMin" 613 "DFC_FuSnsrPhyRngMaxErr" 614 "DFC_FuSnsrPhyRngMinErr" 615 "DFC_GEVlvLockPinDiagIntkB1" 616 "DFC_GEVlvPhaSlowIntkB1" 617 "DFC_GEVlvPhaTargIntkB1" 618 "DFC_GbxRvsSwtStk" 619 "DFC_HDRKHmax" 620 "DFC_HDRKHmin" 621 "DFC_HDRPLmax" 622 "DFC_HDRPLmin" 623 "DFC_HDRmax" 624 "DFC_HDRmin" 625 "DFC_HEGOS2B1ElecMax" 626 "DFC_HEGOS2B1ElecMin" 627 "DFC_HEGOS2B1ElecSig" 628 "DFC_HEGOS2B1HtgNpl" 629 "DFC_HEV00max" 630 "DFC_HEV01max" 631 "DFC_HEV02max" 632 "DFC_HEV03max" 633 "DFC_HEVE0max" 634 "DFC_HEVE1max" 635 "DFC_HFMmax" 636 "DFC_HiPSysHiPMaxLimExcdd" 637 "DFC_IVGdiCtlCvoErrMax_0" 638 "DFC_IVGdiCtlCvoErrMax_1" 639 "DFC_IVGdiCtlCvoErrMax_2" 640 "DFC_IVGdiCtlCvoErrMax_3" 641 "DFC_IVGdiCtlCvoErrMin_0" 642 "DFC_IVGdiCtlCvoErrMin_1" 643 "DFC_IVGdiCtlCvoErrMin_2" 644 "DFC_IVGdiCtlCvoErrMin_3" 645 "DFC_IVGdiCtlCvoErrMinMax" 646 "DFC_IVGdiCtlCvoSigPlausErrSmrCdn" 647 "DFC_IVGdiCtl_CvoErr" 648 "DFC_IVGdiCtl_CvoSigPlaus_0" 649 "DFC_IVGdiCtl_CvoSigPlaus_1" 650 "DFC_IVGdiCtl_CvoSigPlaus_2" 651 "DFC_IVGdiCtl_CvoSigPlaus_3" 652 "DFC_IntkAirTAirFltDsCrssMax" 653 "DFC_IntkAirTAirFltDsCrssMin" 654 "DFC_IntkAirTAirFltDsHSCMax" 655 "DFC_IntkAirTAirFltDsImps" 656 "DFC_IntkAirTAirFltDsPRCMax" 657 "DFC_IntkAirTAirFltDsPRCMin" 658 "DFC_IntkAirTAirFltDsSRCMax" 659 "DFC_IntkAirTAirFltDsSRCMin" 660 "DFC_IntkAirTAirFltDsSTC" 661 "DFC_IntkAirTIntkMnfldCrssMax" 662 "DFC_IntkAirTIntkMnfldCrssMin" 663 "DFC_IntkAirTIntkMnfldHSCMax" 664 "DFC_IntkAirTIntkMnfldImps" 665 "DFC_IntkAirTIntkMnfldPRCMax" 666 "DFC_IntkAirTIntkMnfldPRCMin" 667 "DFC_IntkAirTIntkMnfldSRCMax" 668 "DFC_IntkAirTIntkMnfldSRCMin" 669 "DFC_IntkAirTIntkMnfldSTC" 670 "DFC_KRREGRLMX" 671 "DFC_KRVEKOCVLCI" 672 "DFC_KRVEKOENCHMT" 673 "DFC_KRVEKOENCHMT0" 674 "DFC_KRVEKOENCHMT1" 675 "DFC_KRVEKOENCHMT2" 676 "DFC_KRVEKOENCHMT3" 677 "DFC_KRVEKOENCHMT4" 678 "DFC_KRVEKOENCHMT5" 679 "DFC_KRVEKOENCHMT6" 680 "DFC_KRVEKOENCHMT7" 681 "DFC_KRVEKORLMX" 682 "DFC_KRVEKORLMXL" 683 "DFC_KS1max" 684 "DFC_KS1min" 685 "DFC_LMmax" 686 "DFC_LZSRnpl" 687 "DFC_LamDynDiagS1B1" 688 "DFC_LeakIntkMnfldEmiInfl" 689 "DFC_LinFrameErrDCDC" 690 "DFC_LinOverrunErrDCDC" 691 "DFC_MD00max" 692 "DFC_MDBmax" 693 "DFC_MDCat" 694 "DFC_MDCatCrit" 695 "DFC_MDCatCurr" 696 "DFC_MDCyl_0" 697 "DFC_MDCyl_1" 698 "DFC_MDCyl_2" 699 "DFC_MDCyl_3" 700 "DFC_MDEmi" 701 "DFC_MDEmiStrt" 702 "DFC_MDFco" 703 "DFC_MDMpl" 704 "DFC_MDSegTiAdpn" 705 "DFC_MDmax" 706 "DFC_MFuOilMax" 707 "DFC_MOXEMM_SMU_ALM0_0" 708 "DFC_MOXEMM_SMU_ALM0_1" 709 "DFC_MOXEMM_SMU_ALM0_10" 710 "DFC_MOXEMM_SMU_ALM0_11" 711 "DFC_MOXEMM_SMU_ALM0_13" 712 "DFC_MOXEMM_SMU_ALM0_14" 713 "DFC_MOXEMM_SMU_ALM0_2" 714 "DFC_MOXEMM_SMU_ALM0_22" 715 "DFC_MOXEMM_SMU_ALM0_23" 716 "DFC_MOXEMM_SMU_ALM0_4" 717 "DFC_MOXEMM_SMU_ALM0_5" 718 "DFC_MOXEMM_SMU_ALM0_7" 719 "DFC_MOXEMM_SMU_ALM0_8" 720 "DFC_MOXEMM_SMU_ALM10_16" 721 "DFC_MOXEMM_SMU_ALM10_17" 722 "DFC_MOXEMM_SMU_ALM10_21" 723 "DFC_MOXEMM_SMU_ALM11_0" 724 "DFC_MOXEMM_SMU_ALM11_1" 725 "DFC_MOXEMM_SMU_ALM11_2" 726 "DFC_MOXEMM_SMU_ALM11_3" 727 "DFC_MOXEMM_SMU_ALM11_4" 728 "DFC_MOXEMM_SMU_ALM11_5" 729 "DFC_MOXEMM_SMU_ALM11_8" 730 "DFC_MOXEMM_SMU_ALM11_9" 731 "DFC_MOXEMM_SMU_ALM1_0" 732 "DFC_MOXEMM_SMU_ALM1_1" 733 "DFC_MOXEMM_SMU_ALM1_10" 734 "DFC_MOXEMM_SMU_ALM1_11" 735 "DFC_MOXEMM_SMU_ALM1_13" 736 "DFC_MOXEMM_SMU_ALM1_14" 737 "DFC_MOXEMM_SMU_ALM1_2" 738 "DFC_MOXEMM_SMU_ALM1_22" 739 "DFC_MOXEMM_SMU_ALM1_23" 740 "DFC_MOXEMM_SMU_ALM1_4" 741 "DFC_MOXEMM_SMU_ALM1_5" 742 "DFC_MOXEMM_SMU_ALM1_7" 743 "DFC_MOXEMM_SMU_ALM1_8" 744 "DFC_MOXEMM_SMU_ALM21_0" 745 "DFC_MOXEMM_SMU_ALM21_16" 746 "DFC_MOXEMM_SMU_ALM21_3" 747 "DFC_MOXEMM_SMU_ALM2_1" 748 "DFC_MOXEMM_SMU_ALM2_10" 749 "DFC_MOXEMM_SMU_ALM2_11" 750 "DFC_MOXEMM_SMU_ALM2_13" 751 "DFC_MOXEMM_SMU_ALM2_14" 752 "DFC_MOXEMM_SMU_ALM2_22" 753 "DFC_MOXEMM_SMU_ALM2_23" 754 "DFC_MOXEMM_SMU_ALM2_4" 755 "DFC_MOXEMM_SMU_ALM2_5" 756 "DFC_MOXEMM_SMU_ALM2_7" 757 "DFC_MOXEMM_SMU_ALM2_8" 758 "DFC_MOXEMM_SMU_ALM6_0" 759 "DFC_MOXEMM_SMU_ALM6_11" 760 "DFC_MOXEMM_SMU_ALM6_12" 761 "DFC_MOXEMM_SMU_ALM6_14" 762 "DFC_MOXEMM_SMU_ALM6_15" 763 "DFC_MOXEMM_SMU_ALM6_17" 764 "DFC_MOXEMM_SMU_ALM6_18" 765 "DFC_MOXEMM_SMU_ALM6_20" 766 "DFC_MOXEMM_SMU_ALM6_21" 767 "DFC_MOXEMM_SMU_ALM6_25" 768 "DFC_MOXEMM_SMU_ALM6_4" 769 "DFC_MOXEMM_SMU_ALM6_5" 770 "DFC_MOXEMM_SMU_ALM6_7" 771 "DFC_MOXEMM_SMU_ALM6_8" 772 "DFC_MOXEMM_SMU_ALM7_1" 773 "DFC_MOXEMM_SMU_ALM7_12" 774 "DFC_MOXEMM_SMU_ALM7_13" 775 "DFC_MOXEMM_SMU_ALM7_14" 776 "DFC_MOXEMM_SMU_ALM7_15" 777 "DFC_MOXEMM_SMU_ALM7_16" 778 "DFC_MOXEMM_SMU_ALM7_17" 779 "DFC_MOXEMM_SMU_ALM7_2" 780 "DFC_MOXEMM_SMU_ALM7_20" 781 "DFC_MOXEMM_SMU_ALM7_25" 782 "DFC_MOXEMM_SMU_ALM7_26" 783 "DFC_MOXEMM_SMU_ALM7_28" 784 "DFC_MOXEMM_SMU_ALM7_29" 785 "DFC_MOXEMM_SMU_ALM7_30" 786 "DFC_MOXEMM_SMU_ALM7_31" 787 "DFC_MOXEMM_SMU_ALM8_0" 788 "DFC_MOXEMM_SMU_ALM8_1" 789 "DFC_MOXEMM_SMU_ALM8_10" 790 "DFC_MOXEMM_SMU_ALM8_11" 791 "DFC_MOXEMM_SMU_ALM8_12" 792 "DFC_MOXEMM_SMU_ALM8_16" 793 "DFC_MOXEMM_SMU_ALM8_18" 794 "DFC_MOXEMM_SMU_ALM8_2" 795 "DFC_MOXEMM_SMU_ALM8_3" 796 "DFC_MOXEMM_SMU_ALM8_31" 797 "DFC_MOXEMM_SMU_ALM8_4" 798 "DFC_MOXEMM_SMU_ALM9_0" 799 "DFC_MOXEMM_SMU_ALM9_15" 800 "DFC_MOXEMM_SMU_ALM9_3" 801 "DFC_MoCADCNTP" 802 "DFC_MoCADCTst" 803 "DFC_MoCSOPICO" 804 "DFC_MoFAPP" 805 "DFC_MoFAirFilgPrdc" 806 "DFC_MoFAirFlCtOffGdi" 807 "DFC_MoFAirFlCylGdi" 808 "DFC_MoFAirFlFF" 809 "DFC_MoFAirFlIn" 810 "DFC_MoFAirFlMixCtlGdiChkAirFl" 811 "DFC_MoFAirFlMixCtlGdiChkCtrl" 812 "DFC_MoFAirFlMode" 813 "DFC_MoFESpd" 814 "DFC_MoFIACo" 815 "DFC_MoFICOL1" 816 "DFC_MoFICOL2" 817 "DFC_MoFStrt" 818 "DFC_MoFTrqCmp" 819 "DFC_MoFTrqCmpMax" 820 "DFC_MoFTrqCmpMin" 821 "DFC_MoFVarPostBldSel" 822 "DFC_MoXEMMHwLTMCUFW" 823 "DFC_MoXEMMHwLTMonBIST" 824 "DFC_MoXEMMHwLTRegMonTest" 825 "DFC_MoXEMMHwLTStbySMUAlvTest" 826 "DFC_MoXEMMHwLTTempSens" 827 "DFC_MoXEMMHwLTUCBCfg" 828 "DFC_NWSEmax" 829 "DFC_NWSmax" 830 "DFC_OCWDAABEActv" 831 "DFC_OCWDACom" 832 "DFC_OCWDAErrPin" 833 "DFC_OCWDAOvrVltg" 834 "DFC_ORAmax" 835 "DFC_ORAmin" 836 "DFC_OilPPlaus" 837 "DFC_PLLSUmax" 838 "DFC_PLLSUmin" 839 "DFC_PSR1max" 840 "DFC_PSRBmax" 841 "DFC_PSRBmin" 842 "DFC_PSRPmax" 843 "DFC_PSRPmin" 844 "DFC_PSRPsig" 845 "DFC_PSRmax" 846 "DFC_PUmax" 847 "DFC_P_VSE11_OL" 848 "DFC_P_VSE11_SCB" 849 "DFC_P_VSE11_SCG" 850 "DFC_PhyHighAPP1" 851 "DFC_PhyHighAPP2" 852 "DFC_PhyLowAPP1" 853 "DFC_PhyLowAPP2" 854 "DFC_SRCHighAPP1" 855 "DFC_SRCHighAPP2" 856 "DFC_SRCLowAPP1" 857 "DFC_SRCLowAPP2" 858 "DFC_SSpMon2" 859 "DFC_STHDRmax" 860 "DFC_SWReset_0" 861 "DFC_SWReset_1" 862 "DFC_SWReset_2" 863 "DFC_SyncAPP" 864 "DFC_TANKLnpl" 865 "DFC_TAmax_Dummy" 866 "DFC_TESFmax" 867 "DFC_TESGmax" 868 "DFC_TKAEmax" 869 "DFC_TKAEmin" 870 "DFC_TKARmax" 871 "DFC_TKARnpl" 872 "DFC_TMmax_Dummy" 873 "DFC_TUMmax_Dummy" 874 "DFC_TWCDPriCatB1" 875 "DFC_ThrVlvClsdPosnFirstOffsLrnImpoB1" 876 "DFC_ThrVlvClsdPosnOffsLrnImpoB1" 877 "DFC_ThrVlvClsdPosnOffsLrnMaxB1" 878 "DFC_ThrVlvClsdPosnOffsLrnMinB1" 879 "DFC_ThrVlvCtrlDeB1" 880 "DFC_ThrVlvDycB1" 881 "DFC_ThrVlvLimpAirPosnMaxAbsltDriftB1" 882 "DFC_ThrVlvLimpAirPosnMaxB1" 883 "DFC_ThrVlvLimpAirPosnMaxRelDriftB1" 884 "DFC_ThrVlvLimpAirPosnMinB1" 885 "DFC_ThrVlvOpenLoadB1" 886 "DFC_ThrVlvOpenSprgB1" 887 "DFC_ThrVlvOpenSprgSprdB1" 888 "DFC_ThrVlvOpenSprgTwnB1" 889 "DFC_ThrVlvOverTB1" 890 "DFC_ThrVlvRetSprgB1" 891 "DFC_ThrVlvRetSprgSprdB1" 892 "DFC_ThrVlvRetSprgTwnB1" 893 "DFC_ThrVlvSens1MaxB1" 894 "DFC_ThrVlvSens1NplB1" 895 "DFC_ThrVlvSens2MaxB1" 896 "DFC_ThrVlvSens2MinB1" 897 "DFC_ThrVlvSens2NplB1" 898 "DFC_ThrVlvShoCircB1" 899 "DFC_ThrVlvSpiErrB1" 900 "DFC_ThrvlvSens1MinB1" 901 "DFC_TiOffTBasdChkFast" 902 "DFC_TiOffTBasdChkSlow" 903 "DFC_UEGOSnsrMntdS1B1" 904 "DFC_VehVSig" 905 "DFC_VlvLftFbSwtIntk11SpclFail" 906 "DFC_VlvLftFbSwtIntk11StdFail" 907 "DFP_AAA" 908 "DFP_AAV" 909 "DFP_AAVE" 910 "DFP_AGRE" 911 "DFP_AGRS" 912 "DFP_DHFHD" 913 "DFP_DK" 914 "DFP_DK1P" 915 "DFP_DK2P" 916 "DFP_DKVS" 917 "DFP_DSKV" 918 "DFP_DSKVR" 919 "DFP_DSKVS" 920 "DFP_DSS" 921 "DFP_DSU" 922 "DFP_DVEE" 923 "DFP_DVEF" 924 "DFP_DVEFO" 925 "DFP_DVEL" 926 "DFP_DVEN" 927 "DFP_DVER" 928 "DFP_DVEU" 929 "DFP_DVEUB" 930 "DFP_DVEUW" 931 "DFP_DYLSU" 932 "DFP_ENWCS" 933 "DFP_ENWS" 934 "DFP_ENWSE" 935 "DFP_EONV" 936 "DFP_FP1P" 937 "DFP_FP2P" 938 "DFP_FRA" 939 "DFP_FST" 940 "DFP_FSTE" 941 "DFP_FSTR" 942 "DFP_FTDLA" 943 "DFP_HDR" 944 "DFP_HDRKH" 945 "DFP_HDRPL" 946 "DFP_HFM" 947 "DFP_HSH" 948 "DFP_HSHE" 949 "DFP_KAT" 950 "DFP_KPE" 951 "DFP_KS1" 952 "DFP_LLRH" 953 "DFP_LLRKH" 954 "DFP_LM" 955 "DFP_LSH" 956 "DFP_LZSR" 957 "DFP_MD" 958 "DFP_NWS" 959 "DFP_NWSE" 960 "DFP_ORA" 961 "DFP_PLLSU" 962 "DFP_PSR" 963 "DFP_PSR1" 964 "DFP_PSRB" 965 "DFP_PSRE" 966 "DFP_PSRP" 967 "DFP_PU" 968 "DFP_PUE" 969 "DFP_PUPL" 970 "DFP_PUR" 971 "DFP_STHDR" 972 "DFP_TA" 973 "DFP_TANKL" 974 "DFP_TANLCS" 975 "DFP_TANLPRC" 976 "DFP_TANLR" 977 "DFP_TASRCS" 978 "DFP_TASRE" 979 "DFP_TASRPRC" 980 "DFP_TASRR" 981 "DFP_TESF" 982 "DFP_TESG" 983 "DFP_TM" 984 "DFP_TMCS" 985 "DFP_TME" 986 "DFP_TMP" 987 "DFP_UB" 988 "DFP_VFZ" 989 "DFP_ZZZ" DEFAULT_VALUE "---" /end COMPU_VTAB
/begin COMPU_METHOD DFC_OneToOne "" RAT_FUNC "%6.2" "-" COEFFS 0 1 0 0 0 1 /end COMPU_METHOD
/begin COMPU_METHOD DFES_OneToOne "" RAT_FUNC "%6.2" "-" COEFFS 0 1 0 0 0 1 /end COMPU_METHOD
/begin COMPU_METHOD OneToOne "" RAT_FUNC "%6.2" "-" COEFFS 0 1 0 0 0 1 /end COMPU_METHOD
/begin RECORD_LAYOUT Val_Wu16 FNC_VALUES 1 UWORD COLUMN_DIR DIRECT /end RECORD_LAYOUT
/end MODULE
/end PROJECT
