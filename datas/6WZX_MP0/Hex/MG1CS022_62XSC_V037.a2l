ASAP2_VERSION 1 60
/begin PROJECT MG1CS022 "MG1CS022"
/begin HEADER "" VERSION "MG1CS022_62XSC_V037" PROJECT_NO MG1CS022 /end HEADER
/begin MODULE DIM ""
/begin MOD_COMMON "" BYTE_ORDER MSB_LAST ALIGNMENT_BYTE 1 ALIGNMENT_WORD 2 ALIGNMENT_LONG 4 ALIGNMENT_INT64 4 ALIGNMENT_FLOAT32_IEEE 4 ALIGNMENT_FLOAT64_IEEE 4 DATA_SIZE 32 /end MOD_COMMON
/begin CHARACTERISTIC ACTR_TST_HDP_ATS_ATS.LimitTypeMsk_C "Actuator test ACTR_TST_HDP_ATS_ATS / Tester demand monitoring enable mask for actuators" VALUE 0x8058ACB0 Val_Wu8 255.0 OneToOne 0.00 255.0 FORMAT "%5.1" /end CHARACTERISTIC
/begin CHARACTERISTIC ACTR_TST_HDP_ATS_ATS.CnvNorm_C "Actuator test ACTR_TST_HDP_ATS_ATS / Conversion norm used for conversion to/from internal scaling" VALUE 0x8058ACB1 Val_Wu8 255.0 OneToOne 0.00 255.0 FORMAT "%5.1" /end CHARACTERISTIC
/begin CHARACTERISTIC ACTR_TST_HDP_ATS_ATS.LowLim_C "Actuator test ACTR_TST_HDP_ATS_ATS / Lower limit for monitoring" VALUE 0x8058ACB2 Val_Ws16 65535.00 OneToOne -32768.00 32767.00 FORMAT "%8.2" /end CHARACTERISTIC
/begin CHARACTERISTIC ACTR_TST_HDP_ATS_ATS.UpLim_C "Actuator test ACTR_TST_HDP_ATS_ATS / Upper limit for monitoring" VALUE 0x8058ACB4 Val_Ws16 65535.00 OneToOne -32768.00 32767.00 FORMAT "%8.2" /end CHARACTERISTIC
/begin CHARACTERISTIC ACTR_TST_HDP_ATS_ATS.CnvFac_C "Actuator test ACTR_TST_HDP_ATS_ATS / Factor used for conversion to/from internal scaling" VALUE 0x8058ACB8 Val_Ws32 4294967295.00 OneToOne -2147483648.00 2147483647.00 FORMAT "%13.2" /end CHARACTERISTIC
/begin CHARACTERISTIC ACTR_TST_HDP_ATS_ATS.CnvOfs_C "Actuator test ACTR_TST_HDP_ATS_ATS / Offset used for conversion to/from internal scaling" VALUE 0x8058ACBC Val_Ws16 65535.00 OneToOne -32768.00 32767.00 FORMAT "%8.2" /end CHARACTERISTIC
/begin CHARACTERISTIC ACTR_TST_HDP_ATS_ATS.DfltVal_C "Actuator test ACTR_TST_HDP_ATS_ATS / Default value for standbytest" VALUE 0x8058ACBE Val_Ws16 65535.00 OneToOne -32768.00 32767.00 FORMAT "%8.2" /end CHARACTERISTIC
/begin CHARACTERISTIC AFSTB "debounce counter fuel tank conditions" VALUE 0x80555712 RB_Val_Wu8 25.50 t_q0p1 0.00 25.50 FORMAT "%5.2" /end CHARACTERISTIC
/begin CHARACTERISTIC Com_dCGW1MaxDiff_C "CGW1 Ring counter MAX Difference value" VALUE 0x80555C70 RB_Val_Wu8 255.0 OneToOne 0.00 255.0 FORMAT "%5.1" /end CHARACTERISTIC
/begin CHARACTERISTIC Com_dCGW1MaxPer_C "CGW1 Ring counter MAX Period value" VALUE 0x80555C71 RB_Val_Wu8 255.0 OneToOne 0.00 255.0 FORMAT "%5.1" /end CHARACTERISTIC
/begin CHARACTERISTIC Com_dGwCGW1SigSel_C "Signal selection data for CGW1 Rx frame" VALUE 0x80555C72 RB_Val_Wu8 255.0 OneToOne 0.00 255.0 FORMAT "%5.1" /end CHARACTERISTIC
/begin CHARACTERISTIC Com_dGwIMG1MaxDiff_C "GwIMG1 calibration for max difference" VALUE 0x80555C74 RB_Val_Wu8 255.0 OneToOne 0.00 255.0 FORMAT "%5.1" /end CHARACTERISTIC
/begin CHARACTERISTIC Com_dGwIMG1MaxPer_C "GwIMG1 calibration for max period" VALUE 0x80555C75 RB_Val_Wu8 255.0 OneToOne 0.00 255.0 FORMAT "%5.1" /end CHARACTERISTIC
/begin CHARACTERISTIC Com_dGwIMG1SigSel_C "Signal selection data for GwIMG1 frame" VALUE 0x80555C76 RB_Val_Wu8 255.0 OneToOne 0.00 255.0 FORMAT "%5.1" /end CHARACTERISTIC
/begin CHARACTERISTIC Com_dGwIMG3MaxDiff_C "GwIMG3 calibration for max difference" VALUE 0x80555C78 RB_Val_Wu8 255.0 OneToOne 0.00 255.0 FORMAT "%5.1" /end CHARACTERISTIC
/begin CHARACTERISTIC Com_dGwIMG3MaxPer_C "GwIMG3 calibration for max period" VALUE 0x80555C79 RB_Val_Wu8 255.0 OneToOne 0.00 255.0 FORMAT "%5.1" /end CHARACTERISTIC
/begin CHARACTERISTIC Com_dGwIMG4MaxDiff_C "GwIMG4 calibration for max difference" VALUE 0x80555C7C RB_Val_Wu8 255.0 OneToOne 0.00 255.0 FORMAT "%5.1" /end CHARACTERISTIC
/begin CHARACTERISTIC Com_dGwIMG4MaxPer_C "GwIMG4 calibration for max period" VALUE 0x80555C7D RB_Val_Wu8 255.0 OneToOne 0.00 255.0 FORMAT "%5.1" /end CHARACTERISTIC
/begin CHARACTERISTIC Com_dGwIMG5MaxDiff_C "IMG5 calibartion for Max difference" VALUE 0x80555C7E RB_Val_Wu8 255.0 OneToOne 0.00 255.0 FORMAT "%5.1" /end CHARACTERISTIC
/begin CHARACTERISTIC Com_dGwIMG5MaxPer_C "IMG5 calibration for maximum period" VALUE 0x80555C7F RB_Val_Wu8 255.0 OneToOne 0.00 255.0 FORMAT "%5.1" /end CHARACTERISTIC
/begin CHARACTERISTIC Com_dGwIMG6MaxDiff_C "GwIMG6 calibartion for max difference" VALUE 0x80555C80 RB_Val_Wu8 255.0 OneToOne 0.00 255.0 FORMAT "%5.1" /end CHARACTERISTIC
/begin CHARACTERISTIC Com_dGwIMG6MaxPer_C "GwIMG6 calibration for max period" VALUE 0x80555C81 RB_Val_Wu8 255.0 OneToOne 0.00 255.0 FORMAT "%5.1" /end CHARACTERISTIC
/begin CHARACTERISTIC Com_tqIMGSuppReq_C "IMG Request Suppression Torque parameter" VALUE 0x80555C7A RB_Val_Ws16 65535.00 Trq_float -32768.00 32767.00 FORMAT "%8.2" /end CHARACTERISTIC
/begin CHARACTERISTIC CWDKRZMF "code word: kc additional measurment window" VALUE 0x8055592C RB_Val_Wu8 255.0 dez 0.00 255.0 FORMAT "%5.1" /end CHARACTERISTIC
/begin CHARACTERISTIC CWGGFST "codeword fuel level sensor" VALUE 0x80555713 RB_Val_Wu8 255.0 dez 0.00 255.0 FORMAT "%5.1" /end CHARACTERISTIC
/begin CHARACTERISTIC CWGGTFETH "Codeword for configuration of %GGTETHS" VALUE 0x80555AC8 RB_Val_Wu8 255.0 dez 0.00 255.0 FORMAT "%5.1" /end CHARACTERISTIC
/begin CHARACTERISTIC CWHDRPIST "Codeword for configuration HDRPIST" VALUE 0x80555CDA RB_Val_Wu16 65535.00 dez 0.00 65535.00 FORMAT "%8.2" /end CHARACTERISTIC
/begin CHARACTERISTIC CWHDRPSOL "Codeword for function HDRPSOL" VALUE 0x80555D28 RB_Val_Wu8 255.0 dez 0.00 255.0 FORMAT "%5.1" /end CHARACTERISTIC
/begin CHARACTERISTIC CWPRSOLAP "Codeword to activate calibration interface of rail pressure setpoint" VALUE 0x80555D29 RB_Val_Wu8 255.0 dez 0.00 255.0 FORMAT "%5.1" /end CHARACTERISTIC
/begin CHARACTERISTIC DFSTBTKFSA "delta fuel level before/after filter for fast uptdate after refueling" VALUE 0x80555714 RB_Val_Wu16 6553.500 vol_q0p1_l 0.00 6553.500 FORMAT "%8.3" /end CHARACTERISTIC
/begin CHARACTERISTIC FGPRSOLP "Factor rail pressure setpoint gradient dependent on actual rail pressure" VALUE 0x80555D2A RB_Val_Wu8 1.992188 fak_ub_b2 0.00 1.992188 FORMAT "%8.6" /end CHARACTERISTIC
/begin CHARACTERISTIC FlLvl_fuSnsrPhyErrTiDeb_C "Debounce for setting physical range errors" VALUE 0x80555716 RB_Val_Wu8 255.0 t_q1 0.00 255.0 FORMAT "%5.1" /end CHARACTERISTIC
/begin CHARACTERISTIC FlLvl_stBreakCdnSwt_C "break condition enable-disable switch" VALUE 0x80555717 RB_Val_Wboolean 1.00000000000 B_TRUE 0.00 1.00000000000 FORMAT "%13.11" /end CHARACTERISTIC
/begin CHARACTERISTIC FlLvl_stFlSnsrErrEnad_C "Check for error due to a defect fuel sensor enabled." VALUE 0x8055576A RB_Val_Wu8 255.0 OneToOne 0.00 255.0 FORMAT "%5.1" /end CHARACTERISTIC
/begin CHARACTERISTIC FlLvl_stFlSnsrPlausyChkEnad_C "Enabling of fuel level sensor plausibility check" VALUE 0x8055576B RB_Val_Wu8 255.0 OneToOne 0.00 255.0 FORMAT "%5.1" /end CHARACTERISTIC
/begin CHARACTERISTIC Fllvl_tiDlyFuLvlDiagcFct_C "Time delay for defining fuel level conditions" VALUE 0x80555718 RB_Val_Wu8 2.550 t_q0p01 0.00 2.550 FORMAT "%5.3" /end CHARACTERISTIC
/begin CHARACTERISTIC FlLvl_tiDlyKl15FuLvlCdn_C "Time delay after IG-key ON for enable condition of fuel level filtering" VALUE 0x8055571A RB_Val_Wu16 6553.500 t_q0p1 0.00 6553.500 FORMAT "%8.3" /end CHARACTERISTIC
/begin CHARACTERISTIC FlLvl_tiRefuDeb_C "Deboucing time interval of refuelling" VALUE 0x8055571C RB_Val_Wu16 6553.500 t_q0p1 0.00 6553.500 FORMAT "%8.3" /end CHARACTERISTIC
/begin CHARACTERISTIC FlLvl_tiTnFilMdnFuLvl_C "Timeconstant for lowpass fuel level filter of Median_5 value" VALUE 0x8055571E RB_Val_Wu16 6553.400 t_q0p1 0.100 6553.500 FORMAT "%8.3" EXTENDED_LIMITS 0.00 6553.500 /end CHARACTERISTIC
/begin CHARACTERISTIC FlLvl_tiTnRefFuLvl_C "time threshold for fast filtering of fuel level for slope detection" VALUE 0x80555720 RB_Val_Wu16 6553.500 t_q0p1 0.00 6553.500 FORMAT "%8.3" /end CHARACTERISTIC
/begin CHARACTERISTIC FlLvl_uBattUMaxFuLvl_C "maximum battery voltage for enable condition of fuel level filtering" VALUE 0x80555722 RB_Val_Wu16 1310700. Volt_Batt 0.00 1310700. FORMAT "%8.0" /end CHARACTERISTIC
/begin CHARACTERISTIC FlLvl_uBattUMinFuLvl_C "minimum battery voltage for enable condition of fuel level filtering" VALUE 0x80555724 RB_Val_Wu16 1310700. Volt_Batt 0.00 1310700. FORMAT "%8.0" /end CHARACTERISTIC
/begin CHARACTERISTIC FlLvl_uFuSnsrPhyRngMax_C "Threshold for max fuel sensor physical range error" VALUE 0x80555726 RB_Val_Wu16 320.3351 spg_uw_q0p004888 0.00 320.3351 FORMAT "%8.4" /end CHARACTERISTIC
/begin CHARACTERISTIC FlLvl_uFuSnsrPhyRngMin_C "Threshold for min fuel sensor physical range error" VALUE 0x80555728 RB_Val_Wu16 320.3351 spg_uw_q0p004888 0.00 320.3351 FORMAT "%8.4" /end CHARACTERISTIC
/begin CHARACTERISTIC FlLvl_volFuTankLvlMax_C "Maximum threshold fuel tank level for dead zone" VALUE 0x8055572A RB_Val_Wu16 6553.500 vol_q0p1_l 0.00 6553.500 FORMAT "%8.3" /end CHARACTERISTIC
/begin CHARACTERISTIC FlLvl_volFuTankLvlThd_C "Minimum threshold fuel tank level for dead zone" VALUE 0x8055572C RB_Val_Wu16 6553.500 vol_q0p1_l 0.00 6553.500 FORMAT "%8.3" /end CHARACTERISTIC
/begin CHARACTERISTIC FlLvl_volHysFuLvlDiagcFct_C "Hysteresis for fuel level thresholds" VALUE 0x8055572E RB_Val_Wu16 6553.500 vol_q0p1_l 0.00 6553.500 FORMAT "%8.3" /end CHARACTERISTIC
/begin CHARACTERISTIC FlLvl_volMaxFuLvlDiagcFct_C "maximum fuel level for diagnostic function" VALUE 0x80555730 RB_Val_Wu16 6553.500 vol_q0p1_l 0.00 6553.500 FORMAT "%8.3" /end CHARACTERISTIC
/begin CHARACTERISTIC FlLvl_volMinFuLvlDiagcFct_C "minimum fuel level for diagnostic function" VALUE 0x80555732 RB_Val_Wu16 6553.500 vol_q0p1_l 0.00 6553.500 FORMAT "%8.3" /end CHARACTERISTIC
/begin CHARACTERISTIC FlLvl_volThdRefuDetn_C "Threshold of fuel volume difference during dynamic detection" VALUE 0x80555734 RB_Val_Wu16 6553.500 Vol_q0p1_l 0.00 6553.500 FORMAT "%8.3" /end CHARACTERISTIC
/begin CHARACTERISTIC FMFKRZN "filter selection knock control" MAP 0x8055576E RB_Map_U8U8_S16 4096.000 dez 0.00 4096.000 FORMAT "%8.3" EXTENDED_LIMITS -32768.00 32767.00
 /begin AXIS_DESCR STD_AXIS stkrfmf_tmp dez 5 0.00 255.0 FORMAT "%5.1" DEPOSIT ABSOLUTE /end AXIS_DESCR
 /begin AXIS_DESCR STD_AXIS NO_INPUT_QUANTITY dez 8 0.00 255.0 FORMAT "%5.1" DEPOSIT ABSOLUTE /end AXIS_DESCR
/end CHARACTERISTIC
/begin CHARACTERISTIC FPHDRTF "factor P-part HDR if fuel temperature is not valid" VALUE 0x80555C82 RB_Val_Wu8 1.992188 fak_ub_b2 0.00 1.992188 FORMAT "%8.6" /end CHARACTERISTIC
/begin CHARACTERISTIC FSTDMN "minimum fuel level for diagnostic functions" VALUE 0x80555736 RB_Val_Wu16 6553.500 vol_q0p1_l 0.00 6553.500 FORMAT "%8.3" /end CHARACTERISTIC
/begin CHARACTERISTIC FSTDMX "maximum fuel level for diagnostic functions" VALUE 0x80555738 RB_Val_Wu16 6553.500 vol_q0p1_l 0.00 6553.500 FORMAT "%8.3" /end CHARACTERISTIC
/begin CHARACTERISTIC FSTDTOL "tolerance fuel level dynamic" VALUE 0x8055573A RB_Val_Wu16 6553.500 vol_q0p1_l 0.00 6553.500 FORMAT "%8.3" /end CHARACTERISTIC
/begin CHARACTERISTIC FSTHYS "Hysteresis for fuel level thresholds" VALUE 0x8055573C RB_Val_Wu16 6553.500 vol_q0p1_l 0.00 6553.500 FORMAT "%8.3" /end CHARACTERISTIC
/begin CHARACTERISTIC FSTTAL "Low-fuel level threshold" VALUE 0x8055573E RB_Val_Wu16 6553.500 vol_q0p1_l 0.00 6553.500 FORMAT "%8.3" /end CHARACTERISTIC
/begin CHARACTERISTIC FSTTAV "high level threshold" VALUE 0x80555740 RB_Val_Wu16 6553.500 vol_q0p1_l 0.00 6553.500 FORMAT "%8.3" /end CHARACTERISTIC
/begin CHARACTERISTIC FSTTEW "fuel level replacement value" VALUE 0x80555742 RB_Val_Wu16 6553.500 vol_q0p1_l 0.00 6553.500 FORMAT "%8.3" /end CHARACTERISTIC
/begin CHARACTERISTIC FSTTMX "maximum fuel tank capacity" VALUE 0x8055576C RB_Val_Wu16 6553.400 vol_q0p1_l 0.100 6553.500 FORMAT "%8.3" EXTENDED_LIMITS 0.00 6553.500 /end CHARACTERISTIC
/begin CHARACTERISTIC FuPHi_cntrCrksftRevAftStrtRailPPrdn_C "Threshold counter crankshaft revolutions since engine start for railpressure prediction" VALUE 0x80555CDC RB_Val_Ws16 32767.00 OneToOne 0.00 32767.00 FORMAT "%8.2" EXTENDED_LIMITS -32768.00 32767.00 /end CHARACTERISTIC
/begin CHARACTERISTIC FuPHi_EomMpg_I.OperMod2Idx_M "Class to convert new CoEOM function states into legacy states / Mapping-Table for the conversion of the operation-mode-information in an other format" MAP 0x805566A4 RB_Map_U8U8_U8 255.0 OneToOne 0.00 255.0 FORMAT "%5.1"
 /begin AXIS_DESCR STD_AXIS NO_INPUT_QUANTITY CoEOM_idxOperModCfgd_VERB 4 0.00 3.00000000000 FORMAT "%13.11" DEPOSIT ABSOLUTE /end AXIS_DESCR
 /begin AXIS_DESCR STD_AXIS NO_INPUT_QUANTITY CoEOM_idxOperModStgTot_VERB 8 0.00 15.0000000000 FORMAT "%13.10" DEPOSIT ABSOLUTE /end AXIS_DESCR
/end CHARACTERISTIC
/begin CHARACTERISTIC FuPHi_facRailPPrdnNeg_T "Factor for weighting of the prediction at negative transients of the desired pressure" CURVE 0x80555CDE RB_Curve_U8_U8 7.969 fak_q0p03125 0.00 7.969 FORMAT "%5.3"
 /begin AXIS_DESCR STD_AXIS Epm_nEngLRes EngN_LRes 4 0.00 10200. FORMAT "%5.0" DEPOSIT ABSOLUTE /end AXIS_DESCR
/end CHARACTERISTIC
/begin CHARACTERISTIC FuPHi_facRailPPrdnOldMax_C "Max. Factor for weighting of the next to last delta of the rail pressure for prediction" VALUE 0x80555CE8 RB_Val_Wu16 1.999969 fak_q3p0518Em5 0.00 1.999969 FORMAT "%8.6" /end CHARACTERISTIC
/begin CHARACTERISTIC FuPHi_facRailPPrdnOldMin_C "Min. Factor for weighting of the next to last delta of the rail pressure for prediction" VALUE 0x80555CEA RB_Val_Wu16 1.999969 fak_q3p0518Em5 0.00 1.999969 FORMAT "%8.6" /end CHARACTERISTIC
/begin CHARACTERISTIC FuPHi_facRailPPrdnPos_T "Factor for weighting of the prediction at positive transients of the desired pressure" CURVE 0x80555CEC RB_Curve_U8_U8 7.969 fak_q0p03125 0.00 7.969 FORMAT "%5.3"
 /begin AXIS_DESCR STD_AXIS Epm_nEngLRes EngN_LRes 4 0.00 10200. FORMAT "%5.0" DEPOSIT ABSOLUTE /end AXIS_DESCR
/end CHARACTERISTIC
/begin CHARACTERISTIC FuPHi_facRailSpEngTempEthCntnt_M "Factor rail pressure setpoint gradient dependant onEthanol content and Engine temperature" MAP 0x80555D2C RB_Map_U16U8_U16 131.0700 RBPtCel_p_0p002_1 0.00 131.0700 FORMAT "%8.4"
 /begin AXIS_DESCR STD_AXIS FfPrm_facEthCurr fak_uw_b2 4 0.00 1.999969 FORMAT "%8.6" DEPOSIT ABSOLUTE /end AXIS_DESCR
 /begin AXIS_DESCR STD_AXIS NO_INPUT_QUANTITY temp_ub_q0p75_o48 6 -48.0 143.3 FORMAT "%5.1" DEPOSIT ABSOLUTE /end AXIS_DESCR
/end CHARACTERISTIC
/begin CHARACTERISTIC FuPHi_facRailSpNVCoornEth_M "factor for high pressure canister load" MAP 0x80555D6E RB_Map_U8U16_U8 0.9961 fak_ub_b1 0.00 0.9961
 /begin AXIS_DESCR STD_AXIS teths_msg temp_ub_q0p75_o48 6 -48.0 143.3 FORMAT "%5.1" DEPOSIT ABSOLUTE /end AXIS_DESCR
 /begin AXIS_DESCR STD_AXIS NO_INPUT_QUANTITY fak_uw_b2 6 0.00 1.999969 FORMAT "%8.6" DEPOSIT ABSOLUTE /end AXIS_DESCR
/end CHARACTERISTIC
/begin CHARACTERISTIC FuPHi_maxSpValRailP_GC "max.setpoint-value rail pressure at engine speed limiter" CURVE 0x80555DA6 RB_Curve_S8_U16_Static 131.0700 RBPtCel_p_0p002_1 0.00 131.0700 FORMAT "%8.4"
 /begin AXIS_DESCR STD_AXIS gangsist_msg dez 3 -128.0 127.0 FORMAT "%5.1" DEPOSIT ABSOLUTE /end AXIS_DESCR
/end CHARACTERISTIC
/begin CHARACTERISTIC FuPHi_pDifStrtActThdHys_C "Difference of start pressure vs. measured value; threshold" VALUE 0x80555CF6 RB_Val_Wu16 131.0700 RBPtCel_p_0p002_1 0.00 131.0700 FORMAT "%8.4" /end CHARACTERISTIC
/begin CHARACTERISTIC FuPHi_pDifStrtActThd_C "Difference of start pressure vs. measured value; threshold-hysteresis" VALUE 0x80555CF8 RB_Val_Wu16 131.0700 RBPtCel_p_0p002_1 0.00 131.0700 FORMAT "%8.4" /end CHARACTERISTIC
/begin CHARACTERISTIC FuPHi_pDpnHiPPmp_C "Pressure loss caused by HDP" VALUE 0x80555CFA RB_Val_Wu16 131.0700 RBPtCel_p_0p002_1 0.00 131.0700 FORMAT "%8.4" /end CHARACTERISTIC
/begin CHARACTERISTIC FuPHi_pHpDeMaxLimInteg_C "Limiter maximum value integrator part" VALUE 0x80555C84 RB_Val_Ws16 131.0700 RBPtCel_p_0p002_1 -65.53600 65.53400 FORMAT "%8.5" /end CHARACTERISTIC
/begin CHARACTERISTIC FuPHi_pHpDeMinLimInteg_C "Limiter minimum value integrator part" VALUE 0x80555C86 RB_Val_Ws16 131.0700 RBPtCel_p_0p002_1 -65.53600 65.53400 FORMAT "%8.5" /end CHARACTERISTIC
/begin CHARACTERISTIC FuPHi_pRailDesHiCstrLoad_MEXTD "map for high pressure canister load" MAP 0x80555DB0 RB_Map_S16U16_U16 131.0700 RBPtCel_p_0p002_1 0.00 131.0700 FORMAT "%8.4"
 /begin AXIS_DESCR STD_AXIS Epm_nEng EngN 12 -16384.00 16383.50 FORMAT "%8.2" DEPOSIT ABSOLUTE /end AXIS_DESCR
 /begin AXIS_DESCR STD_AXIS rmiprsol_w rel_uw_b3072 8 0.00 3071.953 FORMAT "%8.3" DEPOSIT ABSOLUTE /end AXIS_DESCR
/end CHARACTERISTIC
/begin CHARACTERISTIC FuPHi_pRailEthnlFacSp2_GC "Map 2 of rail pressure setpoint" CURVE 0x80555E9C RB_Curve_U8_U8 0.9961 fak_ub_b1 0.00 0.9961
 /begin AXIS_DESCR STD_AXIS NO_INPUT_QUANTITY fak_ub_b2 6 0.00 1.992188 FORMAT "%8.6" DEPOSIT ABSOLUTE /end AXIS_DESCR
/end CHARACTERISTIC
/begin CHARACTERISTIC FuPHi_pRailEthnlFacSp3_GC "Map 3 of rail pressure setpoint" CURVE 0x80555EA9 RB_Curve_U8_U8 0.9961 fak_ub_b1 0.00 0.9961
 /begin AXIS_DESCR STD_AXIS NO_INPUT_QUANTITY fak_ub_b2 6 0.00 1.992188 FORMAT "%8.6" DEPOSIT ABSOLUTE /end AXIS_DESCR
/end CHARACTERISTIC
/begin CHARACTERISTIC FuPHi_pRailEthnlFacSp4_GC "Map 4 of rail pressure setpoint" CURVE 0x80555EB6 RB_Curve_U8_U8 0.9961 fak_ub_b1 0.00 0.9961
 /begin AXIS_DESCR STD_AXIS NO_INPUT_QUANTITY fak_ub_b2 6 0.00 1.992188 FORMAT "%8.6" DEPOSIT ABSOLUTE /end AXIS_DESCR
/end CHARACTERISTIC
/begin CHARACTERISTIC FuPHi_pRailEthnlFacSp_GC "Map of rail pressure setpoint" CURVE 0x80555EC3 RB_Curve_U8_U8 0.9961 fak_ub_b1 0.00 0.9961
 /begin AXIS_DESCR STD_AXIS NO_INPUT_QUANTITY fak_ub_b2 6 0.00 1.992188 FORMAT "%8.6" DEPOSIT ABSOLUTE /end AXIS_DESCR
/end CHARACTERISTIC
/begin CHARACTERISTIC FuPHi_pRailEthnlSp2_GM "Map 2 of rail pressure setpoint" MAP 0x80555ED0 RB_Map_S16U16_U16 131.0700 RBPtCel_p_0p002_1 0.00 131.0700 FORMAT "%8.4"
 /begin AXIS_DESCR STD_AXIS Epm_nEng EngN 8 -16384.00 16383.50 FORMAT "%8.2" DEPOSIT ABSOLUTE /end AXIS_DESCR
 /begin AXIS_DESCR STD_AXIS rmiprsol_w rel_uw_b3072 8 0.00 3071.953 FORMAT "%8.3" DEPOSIT ABSOLUTE /end AXIS_DESCR
/end CHARACTERISTIC
/begin CHARACTERISTIC FuPHi_pRailEthnlSp3_GM "Map 2 of rail pressure setpoint" MAP 0x80555F74 RB_Map_S16U16_U16 131.0700 RBPtCel_p_0p002_1 0.00 131.0700 FORMAT "%8.4"
 /begin AXIS_DESCR STD_AXIS Epm_nEng EngN 8 -16384.00 16383.50 FORMAT "%8.2" DEPOSIT ABSOLUTE /end AXIS_DESCR
 /begin AXIS_DESCR STD_AXIS rmiprsol_w rel_uw_b3072 8 0.00 3071.953 FORMAT "%8.3" DEPOSIT ABSOLUTE /end AXIS_DESCR
/end CHARACTERISTIC
/begin CHARACTERISTIC FuPHi_pRailEthnlSp4_GM "Map 4 of rail pressure setpoint" MAP 0x80556018 RB_Map_S16U16_U16 131.0700 RBPtCel_p_0p002_1 0.00 131.0700 FORMAT "%8.4"
 /begin AXIS_DESCR STD_AXIS Epm_nEng EngN 8 -16384.00 16383.50 FORMAT "%8.2" DEPOSIT ABSOLUTE /end AXIS_DESCR
 /begin AXIS_DESCR STD_AXIS rmiprsol_w rel_uw_b3072 8 0.00 3071.953 FORMAT "%8.3" DEPOSIT ABSOLUTE /end AXIS_DESCR
/end CHARACTERISTIC
/begin CHARACTERISTIC FuPHi_pRailEthnlSp_GM "Map of rail pressure setpoint" MAP 0x805560BC RB_Map_S16U16_U16 131.0700 RBPtCel_p_0p002_1 0.00 131.0700 FORMAT "%8.4"
 /begin AXIS_DESCR STD_AXIS Epm_nEng EngN 8 -16384.00 16383.50 FORMAT "%8.2" DEPOSIT ABSOLUTE /end AXIS_DESCR
 /begin AXIS_DESCR STD_AXIS rmiprsol_w rel_uw_b3072 8 0.00 3071.953 FORMAT "%8.3" DEPOSIT ABSOLUTE /end AXIS_DESCR
/end CHARACTERISTIC
/begin CHARACTERISTIC FuPHi_pRailPrdnActMax_C "Max. rail pressure for activation of rail pressure prediction" VALUE 0x80555CFC RB_Val_Wu16 131.0700 RBPtCel_p_0p002_1 0.00 131.0700 FORMAT "%8.4" /end CHARACTERISTIC
/begin CHARACTERISTIC FuPHi_pRailPrdnActMin_C "Min. rail pressure for activation of rail pressure prediction" VALUE 0x80555CFE RB_Val_Wu16 131.0700 RBPtCel_p_0p002_1 0.00 131.0700 FORMAT "%8.4" /end CHARACTERISTIC
/begin CHARACTERISTIC FuPHi_pRailPrdnSpActMin_C "Min. rail pressure setpoint delta for activation of rail pressure prediction" VALUE 0x80555D00 RB_Val_Wu16 131.0700 RBPtCel_p_0p002_1 0.00 131.0700 FORMAT "%8.4" /end CHARACTERISTIC
/begin CHARACTERISTIC FuPHi_pRailSp2_GM "Map 2 of rail pressure setpoint" MAP 0x80556160 RB_Map_S16U16_U16 131.0700 RBPtCel_p_0p002_1 0.00 131.0700 FORMAT "%8.4"
 /begin AXIS_DESCR STD_AXIS Epm_nEng EngN 8 -16384.00 16383.50 FORMAT "%8.2" DEPOSIT ABSOLUTE /end AXIS_DESCR
 /begin AXIS_DESCR STD_AXIS rmiprsol_w rel_uw_b3072 8 0.00 3071.953 FORMAT "%8.3" DEPOSIT ABSOLUTE /end AXIS_DESCR
/end CHARACTERISTIC
/begin CHARACTERISTIC FuPHi_pRailSp3_GM "Map 3 of rail pressure setpoint" MAP 0x80556204 RB_Map_S16U16_U16 131.0700 RBPtCel_p_0p002_1 0.00 131.0700 FORMAT "%8.4"
 /begin AXIS_DESCR STD_AXIS Epm_nEng EngN 8 -16384.00 16383.50 FORMAT "%8.2" DEPOSIT ABSOLUTE /end AXIS_DESCR
 /begin AXIS_DESCR STD_AXIS rmiprsol_w rel_uw_b3072 8 0.00 3071.953 FORMAT "%8.3" DEPOSIT ABSOLUTE /end AXIS_DESCR
/end CHARACTERISTIC
/begin CHARACTERISTIC FuPHi_pRailSp4_GM "curve for GPF soot model and filtration efficiency improvement" MAP 0x805562A8 RB_Map_S16U16_U16 131.0700 RBPtCel_p_0p002_1 0.00 131.0700 FORMAT "%8.4"
 /begin AXIS_DESCR STD_AXIS Epm_nEng EngN 8 -16384.00 16383.50 FORMAT "%8.2" DEPOSIT ABSOLUTE /end AXIS_DESCR
 /begin AXIS_DESCR STD_AXIS rmiprsol_w rel_uw_b3072 8 0.00 3071.953 FORMAT "%8.3" DEPOSIT ABSOLUTE /end AXIS_DESCR
/end CHARACTERISTIC
/begin CHARACTERISTIC FuPHi_pRailSpAppl_C "Application value setpoint rail-pressure" VALUE 0x8055634C RB_Val_Wu16 131.0700 RBPtCel_p_0p002_1 0.00 131.0700 FORMAT "%8.4" /end CHARACTERISTIC
/begin CHARACTERISTIC FuPHi_pRailSpEngTSpd_GM "factor weighting offset for rail pressure setpoint dependent on engine temperature and ethanol content interpolation factor" MAP 0x8055634E RB_Map_S16S16_S16 511.9922 fak_ub_b2 -256.0000 255.9922 FORMAT "%8.4"
 /begin AXIS_DESCR STD_AXIS CEngDsT_t Temp_Cels 5 -3549.940 3003.560 FORMAT "%8.3" DEPOSIT ABSOLUTE /end AXIS_DESCR
 /begin AXIS_DESCR STD_AXIS fethmnmx_msg fak_ub_b2 5 0.00 1.992188 FORMAT "%8.6" EXTENDED_LIMITS -256.0000 255.9922 DEPOSIT ABSOLUTE /end AXIS_DESCR
/end CHARACTERISTIC
/begin CHARACTERISTIC FuPHi_pRailSpEth_M "Target pressure offset depending on engine speed and ethanol content." MAP 0x80556398 RB_Map_U8U8_U16 131.0700 RBPtCel_p_0p002_1 0.00 131.0700 FORMAT "%8.4"
 /begin AXIS_DESCR STD_AXIS Epm_nEngLRes EngN_LRes 5 0.00 10200. FORMAT "%5.0" DEPOSIT ABSOLUTE /end AXIS_DESCR
 /begin AXIS_DESCR STD_AXIS fethmnmx_msg fak_ub_b2 5 0.00 1.992188 FORMAT "%8.6" DEPOSIT ABSOLUTE /end AXIS_DESCR
/end CHARACTERISTIC
/begin CHARACTERISTIC FuPHi_pRailSpMap4Act_C "calibration for GPF soot model and filtration efficiency improvement" VALUE 0x805563D6 RB_Val_Wu8 255.0 dez 0.00 255.0 FORMAT "%5.1" /end CHARACTERISTIC
/begin CHARACTERISTIC FuPHi_pRailSpMaxSmlInj_C "Maximum value for limitation of pressure set point in case of small injection times" VALUE 0x805563D8 RB_Val_Wu16 131.0700 RBPtCel_p_0p002_1 0.00 131.0700 FORMAT "%8.4" /end CHARACTERISTIC
/begin CHARACTERISTIC FuPHi_pRailSpMax_C "Maximum rail pressure" VALUE 0x805563DA RB_Val_Wu16 131.0700 RBPtCel_p_0p002_1 0.00 131.0700 FORMAT "%8.4" /end CHARACTERISTIC
/begin CHARACTERISTIC FuPHi_pRailSpMin_C "Minimum setpoint value rail pressure" VALUE 0x805563DC RB_Val_Wu16 131.0700 RBPtCel_p_0p002_1 0.00 131.0700 FORMAT "%8.4" /end CHARACTERISTIC
/begin CHARACTERISTIC FuPHi_pRailSpNVCorrn_M "map for high pressure canister load" MAP 0x805563DE RB_Map_S16U16_U16 131.0700 RBPtCel_p_0p002_1 0.00 131.0700 FORMAT "%8.4"
 /begin AXIS_DESCR STD_AXIS Epm_nEng EngN 12 -16384.00 16383.50 FORMAT "%8.2" DEPOSIT ABSOLUTE /end AXIS_DESCR
 /begin AXIS_DESCR STD_AXIS NO_INPUT_QUANTITY rel_uw_b100 8 0.00 99.99847 FORMAT "%8.5" DEPOSIT ABSOLUTE /end AXIS_DESCR
/end CHARACTERISTIC
/begin CHARACTERISTIC FuPHi_pRailSpTstrDmd_C "threashold value for tester demand value" VALUE 0x805564CA RB_Val_Wu16 131.0700 RBPtCel_p_0p002_1 0.00 131.0700 FORMAT "%8.4" /end CHARACTERISTIC
/begin CHARACTERISTIC FuPHi_pRailSp_GM "Map of rail pressure setpoint" MAP 0x805564CC RB_Map_S16U16_U16 131.0700 RBPtCel_p_0p002_1 0.00 131.0700 FORMAT "%8.4"
 /begin AXIS_DESCR STD_AXIS Epm_nEng EngN 8 -16384.00 16383.50 FORMAT "%8.2" DEPOSIT ABSOLUTE /end AXIS_DESCR
 /begin AXIS_DESCR STD_AXIS rmiprsol_w rel_uw_b3072 8 0.00 3071.953 FORMAT "%8.3" DEPOSIT ABSOLUTE /end AXIS_DESCR
/end CHARACTERISTIC
/begin CHARACTERISTIC FuPHi_pRalIdleDrv_M "Map of rail pressure setpoint" MAP 0x80556570 RB_Map_S16U16_U16 131.0700 RBPtCel_p_0p002_1 0.00 131.0700 FORMAT "%8.4"
 /begin AXIS_DESCR STD_AXIS Epm_nEng EngN 8 -16384.00 16383.50 FORMAT "%8.2" DEPOSIT ABSOLUTE /end AXIS_DESCR
 /begin AXIS_DESCR STD_AXIS rmiprsol_w rel_uw_b3072 8 0.00 3071.953 FORMAT "%8.3" DEPOSIT ABSOLUTE /end AXIS_DESCR
/end CHARACTERISTIC
/begin CHARACTERISTIC FuPHi_pRlSpNgvGrad_GM "Group map for Negative gradient for Gradient Limiter- rail-pressure Setpoint." MAP 0x80556614 RB_MapGroup_U16 131.0700 RBPtCel_p_0p002_1 0.00 131.0700 FORMAT "%8.4"
 /begin AXIS_DESCR COM_AXIS Epm_nEng EngN 5 0.00 32767.50 FORMAT "%8.2" AXIS_PTS_REF SNM05HDUW /end AXIS_DESCR
 /begin AXIS_DESCR COM_AXIS rkvmeeff_w_msg rel_uw_b3072 5 0.00 3071.953 FORMAT "%8.3" AXIS_PTS_REF SRK05HDUW /end AXIS_DESCR
/end CHARACTERISTIC
/begin CHARACTERISTIC FuPHi_pRlSpPosGrad_GM "Group map for Positive gradient for Gradient Limiter- rail-pressure setpoint" MAP 0x80556646 RB_MapGroup_U16 131.0700 RBPtCel_p_0p002_1 0.00 131.0700 FORMAT "%8.4"
 /begin AXIS_DESCR COM_AXIS Epm_nEng EngN 5 0.00 32767.50 FORMAT "%8.2" AXIS_PTS_REF SNM05HDUW /end AXIS_DESCR
 /begin AXIS_DESCR COM_AXIS rkvmeeff_w_msg rel_uw_b3072 5 0.00 3071.953 FORMAT "%8.3" AXIS_PTS_REF SRK05HDUW /end AXIS_DESCR
/end CHARACTERISTIC
/begin CHARACTERISTIC FuPHi_pSubStrtLoP_C "Rail pressure setpoint substitue value during start" VALUE 0x80555D02 RB_Val_Wu16 131.0700 RBPtCel_p_0p002_1 0.00 131.0700 FORMAT "%8.4" /end CHARACTERISTIC
/begin CHARACTERISTIC FuPHi_tiFilPPrdnDelta_C "Time constant to filter the pressure deviation between measured and predicted rail pressure" CURVE 0x80555D04 RB_Curve_U8_U8 2.540 t_q0p01 0.010 2.550 FORMAT "%5.3" EXTENDED_LIMITS 0.00 2.550
 /begin AXIS_DESCR STD_AXIS Epm_nEngLRes EngN_LRes 4 0.00 10200. FORMAT "%5.0" DEPOSIT ABSOLUTE /end AXIS_DESCR
/end CHARACTERISTIC
/begin CHARACTERISTIC FuPHi_tiRailPPrdnAct_C "Activation time of rail pressure prediction after a sepoint delta" VALUE 0x80555D0E RB_Val_Wu16 655.3500 t_q0p01 0.00 655.3500 FORMAT "%8.4" /end CHARACTERISTIC
/begin CHARACTERISTIC FWIHDR "Calibration factor PI-controller parameter HDR; integrational part" CURVE 0x80555C88 RB_Curve_U8_U8 1.992188 fak_ub_b2 0.00 1.992188 FORMAT "%8.6"
 /begin AXIS_DESCR STD_AXIS Epm_nEngLRes nmot_ub_q40 8 0.00 10200. FORMAT "%5.0" DEPOSIT ABSOLUTE /end AXIS_DESCR
/end CHARACTERISTIC
/begin CHARACTERISTIC FWPHDR "Calibration factor PI-controller parameter HDR; proportional part" CURVE 0x80555C99 RB_Curve_U8_U8 1.992188 fak_ub_b2 0.00 1.992188 FORMAT "%8.6"
 /begin AXIS_DESCR STD_AXIS Epm_nEngLRes nmot_ub_q40 8 0.00 10200. FORMAT "%5.0" DEPOSIT ABSOLUTE /end AXIS_DESCR
/end CHARACTERISTIC
/begin CHARACTERISTIC GlbDa_aX_C "parameter for vehicle longitudinal acceleration" VALUE 0x80555C50 RB_Val_Ws16 65.53500 Acc -32.76800 32.76700 FORMAT "%8.5" /end CHARACTERISTIC
/begin CHARACTERISTIC GlbDa_dlyTiDrvgCycCntr_C "Turn on delay that will allow the global driving cycle counter to stabilize before incrementing the counter" VALUE 0x80555C48 RB_Val_Ws32 4294.96729500 Time_Dt -2147.48364800 2147.48364700 FORMAT "%13.8" /end CHARACTERISTIC
/begin CHARACTERISTIC GlbDa_lDstLim_C "travelled distance, after which value will be written into EEPROM" VALUE 0x80555C4C RB_Val_Ws32 2147473647.00 Length 10000.00 2147483647.00 FORMAT "%13.2" EXTENDED_LIMITS -2147483648.00 2147483647.00 /end CHARACTERISTIC
/begin CHARACTERISTIC GlbDa_lWhlCirc_C "parameter for wheel circumference" VALUE 0x80555C52 RB_Val_Ws16 65.53500 Length_fine -32.76800 32.76700 FORMAT "%8.5" /end CHARACTERISTIC
/begin CHARACTERISTIC GlbDa_pEnv_C "parameter for environment pressure" VALUE 0x80555C54 RB_Val_Ws16 65535.00 Pres_hPa -32768.00 32767.00 FORMAT "%8.2" /end CHARACTERISTIC
/begin CHARACTERISTIC GlbDa_rTrqDfl_C "Default value for total ratio of the power train" VALUE 0x80555C56 RB_Val_Ws16 655.3500 TransR -327.6800 327.6700 FORMAT "%8.4" /end CHARACTERISTIC
/begin CHARACTERISTIC GlbDa_tEnv_C "parameter for environment temperature" VALUE 0x80555C58 RB_Val_Ws16 6553.500 Temp_Cels -3549.940 3003.560 FORMAT "%8.3" /end CHARACTERISTIC
/begin CHARACTERISTIC GlbDa_tiFltAX_C "Filter time constant for longitudinal vehicle acceleration" VALUE 0x80555C5C RB_Val_Ws32 4294.9672940000000 TimeDelay_s 0.0000020000000 4294.9672959999998 FORMAT "%19.14" EXTENDED_LIMITS 0.000002000000001 4294.9672959999998 /end CHARACTERISTIC
/begin CHARACTERISTIC GlbDa_tiFltVX_C "Filter time constant for the vehicle longitudinal speed" VALUE 0x80555C60 RB_Val_Ws32 4294.9672940000000 TimeDelay_s 0.0000020000000 4294.9672959999998 FORMAT "%19.14" EXTENDED_LIMITS 0.000002000000001 4294.9672959999998 /end CHARACTERISTIC
/begin CHARACTERISTIC GlbDa_tIndAir_C "parameter for induction air temperature" VALUE 0x80555C64 RB_Val_Ws16 6553.500 Temp_Cels -3549.940 3003.560 FORMAT "%8.3" /end CHARACTERISTIC
/begin CHARACTERISTIC GlbDa_tiWhlSpdFlt_C "PT1 delay parameter for wheel speed over CAN" VALUE 0x80555C68 RB_Val_Ws32 4294967.3 TimeDelay_ms 0.0 4294967.3 FORMAT "%12.1" /end CHARACTERISTIC
/begin CHARACTERISTIC GlbDa_vWhlSpdMin_C "Minimum speed threshold for filtered wheel speed." VALUE 0x80555C6C RB_Val_Ws16 655.3500 Vel -327.6800 327.6700 FORMAT "%8.4" /end CHARACTERISTIC
/begin CHARACTERISTIC GlbDa_vX_C "parameter for vehicle longitudinal velocity" VALUE 0x80555C6E RB_Val_Ws16 655.3500 Vel -327.6800 327.6700 FORMAT "%8.4" /end CHARACTERISTIC
/begin CHARACTERISTIC GVTMX "maximum gas capacity fuel tank" VALUE 0x80555744 RB_Val_Wu16 6553.500 vol_q0p1_l 0.00 6553.500 FORMAT "%8.3" /end CHARACTERISTIC
/begin CHARACTERISTIC HEGOD_stDynSimn_CW "Codeword for configuration of dynamic simulation of binary sensor" VALUE 0x805566D4 RB_Val_Wu8 255.0 dez 0.00 255.0 FORMAT "%5.1" /end CHARACTERISTIC
/begin CHARACTERISTIC HEGOD_stPosnSimn_CW "Code word of sensor position for dynamic simulation of binear sensor" VALUE 0x805566EA RB_Val_Wu8 255.0 dez 0.00 255.0 FORMAT "%5.1" /end CHARACTERISTIC
/begin CHARACTERISTIC HEGOD_tiFltSimn_C "lowpass time constant for holdphase" VALUE 0x805566D6 RB_Val_Wu16 655.34999985 zk10msxs_uw_b655p36 0.01000015 655.36000000 FORMAT "%12.8" EXTENDED_LIMITS 0.010000152590 655.36000000 /end CHARACTERISTIC
/begin CHARACTERISTIC HEGOD_tiFolwLRSimn_C "the time constant of the slow transition from lean to rich for asymmetric fault" VALUE 0x805566D8 RB_Val_Wu16 655.34999985 zk10msxs_uw_b655p36 0.01000015 655.36000000 FORMAT "%12.8" EXTENDED_LIMITS 0.010000152590 655.36000000 /end CHARACTERISTIC
/begin CHARACTERISTIC HEGOD_tiFolwRLSimn_C "the time constant of the slow transition from rich to lean for asymmetric fault" VALUE 0x805566DA RB_Val_Wu16 655.34999985 zk10msxs_uw_b655p36 0.01000015 655.36000000 FORMAT "%12.8" EXTENDED_LIMITS 0.010000152590 655.36000000 /end CHARACTERISTIC
/begin CHARACTERISTIC HEGOD_tiFolwSimn_C "the time constant of the slow transition for symmetric fault" VALUE 0x805566DC RB_Val_Wu16 655.34999985 zk10msxs_uw_b655p36 0.01000015 655.36000000 FORMAT "%12.8" EXTENDED_LIMITS 0.010000152590 655.36000000 /end CHARACTERISTIC
/begin CHARACTERISTIC HEGOD_tiHldLRSimn_C "the delay time from lean to rich for asymmetric fault" VALUE 0x805566DE RB_Val_Wu16 655.3500 t_q0p01 0.00 655.3500 FORMAT "%8.4" /end CHARACTERISTIC
/begin CHARACTERISTIC HEGOD_tiHldRLSimn_C "the delay time from rich to lean for the asymmetric fault" VALUE 0x805566E0 RB_Val_Wu16 655.3500 t_q0p01 0.00 655.3500 FORMAT "%8.4" /end CHARACTERISTIC
/begin CHARACTERISTIC HEGOD_tiHldSimn_C "the delay time for the symmetric fault" VALUE 0x805566E2 RB_Val_Wu16 655.3500 t_q0p01 0.00 655.3500 FORMAT "%8.4" /end CHARACTERISTIC
/begin CHARACTERISTIC HEGOD_tiVltFltSimn_C "lowpass time constant for smoothing of original signal" VALUE 0x805566E4 RB_Val_Wu16 655.34999985 zk10msxs_uw_b655p36 0.01000015 655.36000000 FORMAT "%12.8" EXTENDED_LIMITS 0.010000152590 655.36000000 /end CHARACTERISTIC
/begin CHARACTERISTIC HEGOD_uLimdMaxSimn_C "Upper threshold of sensor voltage for simulation of restricted sensor voltage failure" VALUE 0x805566E6 RB_Val_Wu16 4.998779 spg_q1p221Em3_V 0.00 4.998779 FORMAT "%8.6" EXTENDED_LIMITS 0.00 79.99878 /end CHARACTERISTIC
/begin CHARACTERISTIC HEGOD_uLimdMinSimn_C "Lower threshold of sensor voltage for simulation of restricted sensor voltage" VALUE 0x805566E8 RB_Val_Wu16 4.998779 spg_q1p221Em3_V 0.00 4.998779 FORMAT "%8.6" EXTENDED_LIMITS 0.00 79.99878 /end CHARACTERISTIC
/begin CHARACTERISTIC HEGO_duHtgMapMax_C "Maximum heating voltage offset for map controlled heating" VALUE 0x805566EC RB_Val_Wu16 25.59961 spg_q0p00039 0.00 25.59961 FORMAT "%8.5" /end CHARACTERISTIC
/begin CHARACTERISTIC HEGO_duNomHtgIMax_C "Maximum limit for heater voltage difference, I-part" VALUE 0x805566EE RB_Val_Ws16 25.59961 spg_q0p00039 -12.80000 12.79961 FORMAT "%8.5" /end CHARACTERISTIC
/begin CHARACTERISTIC HEGO_duNomHtgIMin_C "Minimum limit for heater voltage difference, I-part" VALUE 0x805566F0 RB_Val_Ws16 25.59961 spg_q0p00039 -12.80000 12.79961 FORMAT "%8.5" /end CHARACTERISTIC
/begin CHARACTERISTIC HEGO_duNomHtgPMax_C "Maximum limit for heater voltage difference, P-part" VALUE 0x805566F2 RB_Val_Ws16 25.59961 spg_q0p00039 -12.80000 12.79961 FORMAT "%8.5" /end CHARACTERISTIC
/begin CHARACTERISTIC HEGO_duNomHtgPMin_C "Minimum limit for heater voltage difference, P-part" VALUE 0x805566F4 RB_Val_Ws16 25.59961 spg_q0p00039 -12.80000 12.79961 FORMAT "%8.5" /end CHARACTERISTIC
/begin CHARACTERISTIC HEGO_duNomHtgRedErrElecMin_C "Heater voltage reduction in case of ElecMin error suspect" VALUE 0x805566F6 RB_Val_Wu16 25.59961 spg_q0p00039 0.00 25.59961 FORMAT "%8.5" /end CHARACTERISTIC
/begin CHARACTERISTIC HEGO_facHtgIGn_C "I-part gain of closed loop heating control" VALUE 0x805566F8 RB_Val_Wu16 12.79980 q1p953125Em4_V_DIV_s_Ohm 0.00 12.79980 FORMAT "%8.5" /end CHARACTERISTIC
/begin CHARACTERISTIC HEGO_facHtgPGn_CUR "P-part gain of closed loop heating control" CURVE 0x805566FA RB_Curve_S16_U16_Static 12.79980 q1p953125Em4_V_DIV_Ohm 0.00 12.79980 FORMAT "%8.5"
 /begin AXIS_DESCR STD_AXIS NO_INPUT_QUANTITY r_uw_q2 11 -65536.00 65534.00 FORMAT "%8.2" DEPOSIT ABSOLUTE /end AXIS_DESCR
/end CHARACTERISTIC
/begin CHARACTERISTIC HEGO_flgDewPntEndFreeSnsr_C "Flag to bypass dew point end for dew point end free sensors" VALUE 0x80556728 RB_Val_Wu8 1.00000000000 B_TRUE 0.00 1.00000000000 FORMAT "%13.11" /end CHARACTERISTIC
/begin CHARACTERISTIC HEGO_HtgS2B1_I.duHtgRmpDwn_C "Heating, HEGO sensor 2 bank 1 / Heating voltage gradient during ramp down" VALUE 0x80556774 RB_Val_Wu16 255.9961 spgg_q0p0039 0.00 255.9961 FORMAT "%8.4" /end CHARACTERISTIC
/begin CHARACTERISTIC HEGO_HtgS2B1_I.duHtgRmpUp_C "Heating, HEGO sensor 2 bank 1 / Heating voltage gradient during ramp up" VALUE 0x80556776 RB_Val_Wu16 255.9961 spgg_q0p0039 0.00 255.9961 FORMAT "%8.4" /end CHARACTERISTIC
/begin CHARACTERISTIC HEGO_HtgS2B1_I.pwrHtgSuffMin_C "Heating, HEGO sensor 2 bank 1 / Minimum normalized heating power for sufficient heating" VALUE 0x80556778 RB_Val_Wu8 2.550 fak_q0p01 0.00 2.550 FORMAT "%5.3" /end CHARACTERISTIC
/begin CHARACTERISTIC HEGO_HtgS2B1_I.resRiDBndMax_C "Heating, HEGO sensor 2 bank 1 / Maximum value for Ri deadband" VALUE 0x8055677A RB_Val_Ws16 131070.0 r_uw_q2 -65536.00 65534.00 FORMAT "%8.2" /end CHARACTERISTIC
/begin CHARACTERISTIC HEGO_HtgS2B1_I.resRiDBndMin_C "Heating, HEGO sensor 2 bank 1 / Minimum value for Ri deadband" VALUE 0x8055677C RB_Val_Ws16 131070.0 r_uw_q2 -65536.00 65534.00 FORMAT "%8.2" /end CHARACTERISTIC
/begin CHARACTERISTIC HEGO_HtgS2B1_I.resRiNom_C "Heating, HEGO sensor 2 bank 1 / Nominal internal resistance Ri of HEGO sensors" VALUE 0x8055677E RB_Val_Ws16 131070.0 r_uw_q2 -65536.00 65534.00 FORMAT "%8.2" /end CHARACTERISTIC
/begin CHARACTERISTIC HEGO_HtgS2B1_I.stHtg_CW "Heating, HEGO sensor 2 bank 1 / Code word HEGO sensor heating" VALUE 0x80556780 RB_Val_Wu8 255.0 dez 0.00 255.0 FORMAT "%5.1" /end CHARACTERISTIC
/begin CHARACTERISTIC HEGO_HtgS2B1_I.tEGHtgSuffMin_C "Heating, HEGO sensor 2 bank 1 / Minimum exhaust gas temperature for sufficient heating" VALUE 0x80556782 RB_Val_Wu16 1535.977 temp_q0p0234_o273 -273.150 1262.827 FORMAT "%8.3" /end CHARACTERISTIC
/begin CHARACTERISTIC HEGO_HtgS2B1_I.tiDebHtgMax_C "Heating, HEGO sensor 2 bank 1 / Debouncing time for maximum heating" VALUE 0x80556784 RB_Val_Wu16 6553.500 t_q0p1 0.00 6553.500 FORMAT "%8.3" /end CHARACTERISTIC
/begin CHARACTERISTIC HEGO_HtgS2B1_I.tiDebHtgStrtUs_C "Heating, HEGO sensor 2 bank 1 / Debouncing time for heating during start phase depending on upstream sensor" VALUE 0x80556786 RB_Val_Wu8 25.50 t_q0p1 0.00 25.50 FORMAT "%5.2" /end CHARACTERISTIC
/begin CHARACTERISTIC HEGO_HtgS2B1_I.tiHtgSuffDeb_C "Heating, HEGO sensor 2 bank 1 / Debouncing time for sufficient heating" VALUE 0x80556787 RB_Val_Wu8 25.50 t_q0p1 0.00 25.50 FORMAT "%5.2" /end CHARACTERISTIC
/begin CHARACTERISTIC HEGO_HtgS2B1_I.tiMaxHtgRedEngOff_CUR "Heating, HEGO sensor 2 bank 1 / Maximum time until heater power reduction based on engine off time" CURVE 0x80556788 RB_Curve_U16_U16 6553.500 t_q0p1 0.00 6553.500 FORMAT "%8.3"
 /begin AXIS_DESCR STD_AXIS NO_INPUT_QUANTITY t_q1 5 0.00 65535.00 FORMAT "%8.2" DEPOSIT ABSOLUTE /end AXIS_DESCR
/end CHARACTERISTIC
/begin CHARACTERISTIC HEGO_HtgS2B1_I.tiMaxHtgRedPrt_CUR "Heating, HEGO sensor 2 bank 1 / Maximum time until heater power reduction based on protective heating duration sensor" CURVE 0x8055679E RB_Curve_U16_U16 6553.500 t_q0p1 0.00 6553.500 FORMAT "%8.3"
 /begin AXIS_DESCR STD_AXIS HEGO_HtgS2B1_I.tiHtgPrt t_q0p1 5 0.00 6553.500 FORMAT "%8.3" DEPOSIT ABSOLUTE /end AXIS_DESCR
/end CHARACTERISTIC
/begin CHARACTERISTIC HEGO_HtgS2B1_I.tiMaxHtgRed_C "Heating, HEGO sensor 2 bank 1 / Maximum time until heating power is reduced" VALUE 0x805567B4 RB_Val_Wu16 6553.500 t_q0p1 0.00 6553.500 FORMAT "%8.3" /end CHARACTERISTIC
/begin CHARACTERISTIC HEGO_HtgS2B1_I.tiTExhSnsrFil_M "Heating, HEGO sensor 2 bank 1 / Exhaust gas temperature filter-time-constant for sensor heating" MAP 0x805567B6 RB_Map_U16S16_U16 6553.4999985 zk100msxs_uw_b6553p6 0.1000015 6553.6000000 FORMAT "%12.7" EXTENDED_LIMITS 0.10000152590 6553.6000000
 /begin AXIS_DESCR STD_AXIS HEGO_HtgS2B1_I.mEGHtg m_uw_b6553p5 5 0.00 6553.500 FORMAT "%8.3" DEPOSIT ABSOLUTE /end AXIS_DESCR
 /begin AXIS_DESCR STD_AXIS HEGO_HtgS2B1_I.tExhSnsrDyn temp_q0p0234_o273 3 -1041.150 494.827 FORMAT "%8.3" EXTENDED_LIMITS -1041.150 494.8266 DEPOSIT ABSOLUTE /end AXIS_DESCR
/end CHARACTERISTIC
/begin CHARACTERISTIC HEGO_HtgS2B1_I.uDrpHtg_C "Heating, HEGO sensor 2 bank 1 / Voltage drop in the wiring harness for sensor heating" VALUE 0x805567E8 RB_Val_Wu16 25.59961 spg_q0p00039 0.00 25.59961 FORMAT "%8.5" /end CHARACTERISTIC
/begin CHARACTERISTIC HEGO_HtgS2B1_I.uHtgAftPrt_CUR "Heating, HEGO sensor 2 bank 1 / Nominal heater voltage after protective heating is finished" CURVE 0x805567EA RB_Curve_U16_U16 25.59961 spg_q0p00039 0.00 25.59961 FORMAT "%8.5"
 /begin AXIS_DESCR STD_AXIS HEGO_HtgS2B1_I.tEg temp_q0p0234_o273 6 -273.150 1262.827 FORMAT "%8.3" DEPOSIT ABSOLUTE /end AXIS_DESCR
/end CHARACTERISTIC
/begin CHARACTERISTIC HEGO_HtgS2B1_I.uHtgMapCtl_MAP "Heating, HEGO sensor 2 bank 1 / Map to control sensor heating voltage" MAP 0x80556804 RB_Map_U16U16_U16 25.59961 spg_q0p00039 0.00 25.59961 FORMAT "%8.5"
 /begin AXIS_DESCR STD_AXIS HEGO_HtgS2B1_I.mEGHtg m_uw_b6553p5 7 0.00 6553.500 FORMAT "%8.3" DEPOSIT ABSOLUTE /end AXIS_DESCR
 /begin AXIS_DESCR STD_AXIS HEGO_HtgS2B1_I.tEGFltHtg temp_q0p0234_o273 8 -273.150 1262.827 FORMAT "%8.3" DEPOSIT ABSOLUTE /end AXIS_DESCR
/end CHARACTERISTIC
/begin CHARACTERISTIC HEGO_HtgS2B1_I.uHtgMaxDeb_C "Heating, HEGO sensor 2 bank 1 / Maximum heating voltage, debounced" VALUE 0x80556896 RB_Val_Wu16 23.64648 spg_q0p00039 1.95313 25.59961 FORMAT "%8.5" EXTENDED_LIMITS 0.00 25.59961 /end CHARACTERISTIC
/begin CHARACTERISTIC HEGO_HtgS2B1_I.uHtgMaxHtUp_C "Heating, HEGO sensor 2 bank 1 / Maximum heating voltage during heat-up phase" VALUE 0x80556898 RB_Val_Wu16 25.59961 spg_q0p00039 0.00 25.59961 FORMAT "%8.5" /end CHARACTERISTIC
/begin CHARACTERISTIC HEGO_HtgS2B1_I.uHtgMax_C "Heating, HEGO sensor 2 bank 1 / Maximum heating voltage" VALUE 0x8055689A RB_Val_Wu16 23.64648 spg_q0p00039 1.95313 25.59961 FORMAT "%8.5" EXTENDED_LIMITS 0.00 25.59961 /end CHARACTERISTIC
/begin CHARACTERISTIC HEGO_HtgS2B1_I.uHtgNom_C "Heating, HEGO sensor 2 bank 1 / Nominal heating voltage" VALUE 0x8055689C RB_Val_Wu16 23.64648 spg_q0p00039 1.95313 25.59961 FORMAT "%8.5" EXTENDED_LIMITS 0.00 25.59961 /end CHARACTERISTIC
/begin CHARACTERISTIC HEGO_HtgS2B1_I.uHtgPrt_C "Heating, HEGO sensor 2 bank 1 / Protective heating voltage" VALUE 0x8055689E RB_Val_Wu16 25.59961 spg_q0p00039 0.00 25.59961 FORMAT "%8.5" /end CHARACTERISTIC
/begin CHARACTERISTIC HEGO_resRiCorrdHtgRed_C "Corrected intenal resistance threshold for heating reduction" VALUE 0x8055672A RB_Val_Wu16 131070.0 r_uw_q2 0.00 131070.0 FORMAT "%8.1" /end CHARACTERISTIC
/begin CHARACTERISTIC HEGO_resRiHtgOffLo_C "Internal resistance threshold for HEGO sensor closed loop heating control shut-off" VALUE 0x8055672C RB_Val_Wu16 131070.0 r_uw_q2 0.00 131070.0 FORMAT "%8.1" /end CHARACTERISTIC
/begin CHARACTERISTIC HEGO_resRiHtgOff_C "Internal resistance threshold for HEGO sensor heating shut-off" VALUE 0x8055672E RB_Val_Wu16 131070.0 r_uw_q2 0.00 131070.0 FORMAT "%8.1" /end CHARACTERISTIC
/begin CHARACTERISTIC HEGO_resRiImpsThdHtgStrt_C "Ri threshold above which make heating start time dependent on eng.-off-time or time of protective-htg" VALUE 0x80556730 RB_Val_Wu16 131070.0 r_uw_q2 0.00 131070.0 FORMAT "%8.1" /end CHARACTERISTIC
/begin CHARACTERISTIC HEGO_resRiOffsHysHtgRed_C "hysteresis offset for increased Ri-threshold for return to heating up phase from map- or closed loop -heater control in case sensor is cooling down again within the allowed heating up time." VALUE 0x80556732 RB_Val_Wu16 131070.0 r_uw_q2 0.00 131070.0 FORMAT "%8.1" /end CHARACTERISTIC
/begin CHARACTERISTIC HEGO_resRiSwtHeatgMapThd_C "Threshold for internal resistance to switch back to Map based control heater voltage" VALUE 0x80556734 RB_Val_Wu16 131070.0 r_uw_q2 0.00 131070.0 FORMAT "%8.1" /end CHARACTERISTIC
/begin CHARACTERISTIC HEGO_rHtgMaxAntiWindUp_C "Maximum heating duty ratio for anti wind up" VALUE 0x80556736 RB_Val_Wu16 2.559961 fak_q3p906Em5 0.00 2.559961 FORMAT "%8.6" /end CHARACTERISTIC
/begin CHARACTERISTIC HEGO_rHtgMinAntiWindUp_C "Minimum heating duty ratio for anti wind up" VALUE 0x80556738 RB_Val_Wu16 2.559961 fak_q3p906Em5 0.00 2.559961 FORMAT "%8.6" /end CHARACTERISTIC
/begin CHARACTERISTIC HEGO_stHtgEna_CW "Code word enable conditions for HEGO sensor heating" VALUE 0x8055673A RB_Val_Wu8 255.0 dez 0.00 255.0 FORMAT "%5.1" /end CHARACTERISTIC
/begin CHARACTERISTIC HEGO_stHtg_CW "Code word HEGO sensor heating" VALUE 0x8055673B RB_Val_Wu8 255.0 dez 0.00 255.0 FORMAT "%5.1" /end CHARACTERISTIC
/begin CHARACTERISTIC HEGO_tEGHtgOffStop_C "Exhaust gas temperature threshold to switch off heating in stop phase" VALUE 0x8055673C RB_Val_Wu16 1535.977 temp_q0p0234_o273 -273.150 1262.827 FORMAT "%8.3" /end CHARACTERISTIC
/begin CHARACTERISTIC HEGO_tEGHtgRed_C "Exhaust gas temperature threshold for reduced heating power" VALUE 0x8055673E RB_Val_Wu16 1535.977 temp_q0p0234_o273 -273.150 1262.827 FORMAT "%8.3" /end CHARACTERISTIC
/begin CHARACTERISTIC HEGO_tEGMaxHtgEna_C "Maximum exhaust gas temperature for heating of HEGO sensors" VALUE 0x80556740 RB_Val_Wu16 1535.977 temp_q0p0234_o273 -273.150 1262.827 FORMAT "%8.3" /end CHARACTERISTIC
/begin CHARACTERISTIC HEGO_tEGMinHtg_C "Start value: 100°C (only relevant for LSF Xfour or LSF Xfour TSP in combination with 2.2 A power stage of CJ930)" VALUE 0x80556742 RB_Val_Wu16 1535.977 temp_q0p0234_o273 -273.150 1262.827 FORMAT "%8.3" /end CHARACTERISTIC
/begin CHARACTERISTIC HEGO_tEngHotHtg_C "Engine temperature hot enough for sensor heating" VALUE 0x80556744 RB_Val_Wu8 191.3 temp_ub_q0p75_o48 -48.0 143.3 FORMAT "%5.1" /end CHARACTERISTIC
/begin CHARACTERISTIC HEGO_tEngMinHeatgProtn_C "Minimum engine temperature limit for enabling protective heating" VALUE 0x80556745 RB_Val_Wu8 191.3 temp_ub_q0p75_o48 -48.0 143.3 FORMAT "%5.1" /end CHARACTERISTIC
/begin CHARACTERISTIC HEGO_tExhStrtMinMapHtg_C "Calibratable minimum exhaust gas temperature at engine start for enabling map control sensor heating" VALUE 0x80556746 RB_Val_Ws16 6553.500 Temp_Cels -3549.940 3003.560 FORMAT "%8.3" /end CHARACTERISTIC
/begin CHARACTERISTIC HEGO_tExhStrt_C "calibratable exhaust gas temperature at engine start for enabling (protective) sensor heater" VALUE 0x80556748 RB_Val_Ws16 6553.500 Temp_Cels -3549.940 3003.560 FORMAT "%8.3" /end CHARACTERISTIC
/begin CHARACTERISTIC HEGO_tiDebBattHtgOff_C "Debouncing time for heating switch off at high battery voltage" VALUE 0x8055674A RB_Val_Wu8 25.50 t_q0p1 0.00 25.50 FORMAT "%5.2" /end CHARACTERISTIC
/begin CHARACTERISTIC HEGO_tiDebHeatgStrt_C "delay time for reset of heating start information avoids reset during transition from cold operation to normal mode" VALUE 0x8055674C RB_Val_Wu16 6553.500 t_q0p1 0.00 6553.500 FORMAT "%8.3" /end CHARACTERISTIC
/begin CHARACTERISTIC HEGO_tiDebHtgMapClsdLop_C "Debouncing time for activation of closed loop heating control" VALUE 0x8055674E RB_Val_Wu16 6553.500 t_q0p1 0.00 6553.500 FORMAT "%8.3" /end CHARACTERISTIC
/begin CHARACTERISTIC HEGO_tiDebHtgMaxHys_C "Debouncing time for maximum heating hysteresis" VALUE 0x80556750 RB_Val_Wu16 6553.500 t_q0p1 0.00 6553.500 FORMAT "%8.3" /end CHARACTERISTIC
/begin CHARACTERISTIC HEGO_tiDebHtgPreDrive_C "Debouncing time for HEGO sensor heating during predrive" VALUE 0x80556752 RB_Val_Wu16 6553.500 t_q0p1 0.00 6553.500 FORMAT "%8.3" /end CHARACTERISTIC
/begin CHARACTERISTIC HEGO_tiDebNewRiAvlHtg_C "Deboucing time to disable closed loop heating control" VALUE 0x80556754 RB_Val_Wu16 6553.500 t_q0p1 0.00 6553.500 FORMAT "%8.3" /end CHARACTERISTIC
/begin CHARACTERISTIC HEGO_tiDebNewRiHtg_C "maximum time between two Ri measurements for closed loop heater control before requesting new Ri-measurement by HEGO_Htg." VALUE 0x80556756 RB_Val_Wu16 6553.500 t_q0p1 0.00 6553.500 FORMAT "%8.3" /end CHARACTERISTIC
/begin CHARACTERISTIC HEGO_tiDebRiActAvlHtg_C "Debouncing time for internal resistance actual available" VALUE 0x80556758 RB_Val_Wu8 25.50 t_q0p1 0.00 25.50 FORMAT "%5.2" /end CHARACTERISTIC
/begin CHARACTERISTIC HEGO_tiEngStop_C "minimum engine off time for activating of (protective) heating" VALUE 0x8055675A RB_Val_Wu16 65535.00 t_q1 0.00 65535.00 FORMAT "%8.2" /end CHARACTERISTIC
/begin CHARACTERISTIC HEGO_tiFltRiHtg_C "Ri Filter time constant for heating control" VALUE 0x8055675C RB_Val_Wu16 6553.4999985 zk100msxs_uw_b6553p6 0.1000015 6553.6000000 FORMAT "%12.7" EXTENDED_LIMITS 0.10000152590 6553.6000000 /end CHARACTERISTIC
/begin CHARACTERISTIC HEGO_tiPerdHtg_C "Time period for heating of HEGO Sensor" VALUE 0x8055675E RB_Val_Wu8 245.0 t_q1_ms 10.0 255.0 FORMAT "%5.1" EXTENDED_LIMITS 0.00 255.0 /end CHARACTERISTIC
/begin CHARACTERISTIC HEGO_tiTExhSnsrDyn_C "Time constant for calculation of exhaust temperature gradient" VALUE 0x80556760 RB_Val_Wu16 6553.4999985 zk100msxs_uw_b6553p6 0.1000015 6553.6000000 FORMAT "%12.7" EXTENDED_LIMITS 0.10000152590 6553.6000000 /end CHARACTERISTIC
/begin CHARACTERISTIC HEGO_uBattHtgOff_C "Battery voltage threshold for heating switch off" VALUE 0x80556762 RB_Val_Wu16 25.59961 spg_q0p00039 0.00 25.59961 FORMAT "%8.5" /end CHARACTERISTIC
/begin CHARACTERISTIC HiPSys_pSpMaxDe_C "Threshold for detection that actual rail pressure is adjusted to its setpoint" VALUE 0x80556678 RB_Val_Wu16 131.0700 RBPtCel_p_0p002_1 0.00 131.0700 FORMAT "%8.4" /end CHARACTERISTIC
/begin CHARACTERISTIC HiPSys_pSpSTSP_C "Maximum positive rail pressure setpoint gradient during StartStop." VALUE 0x8055667A RB_Val_Wu16 131.0700 RBPtCel_p_0p002_1 0.00 131.0700 FORMAT "%8.4" /end CHARACTERISTIC
/begin CHARACTERISTIC HiPSys_tiSpRea_C "Delay time for setting the condition that the actual rail pressure is adjusted to its setpoint" VALUE 0x8055667C RB_Val_Ws32 4294.96729500 Time_Dt -2147.48364800 2147.48364700 FORMAT "%13.8" /end CHARACTERISTIC
/begin CHARACTERISTIC IKCtl_agOffsNInltAirTempKnkMeasWin_M "Offset angle map for start of knock measurement window based on inlet air temperature and engine speed" MAP 0x805557CE RB_Map_S16U8_S8 191.3 kw_q0p75 -96.00 95.25 FORMAT "%5.2"
 /begin AXIS_DESCR STD_AXIS Epm_nEng EngN 6 -16384.00 16383.50 FORMAT "%8.2" DEPOSIT ABSOLUTE /end AXIS_DESCR
 /begin AXIS_DESCR STD_AXIS tans_msg temp_ub_q0p75_o48 5 -48.0 143.3 FORMAT "%5.1" DEPOSIT ABSOLUTE /end AXIS_DESCR
/end CHARACTERISTIC
/begin CHARACTERISTIC IKCtl_agOffsPreIgnMeasWin_M "Offset for pre-ignition measurement window" MAP 0x8055592E RB_Map_S16U8_S8 191.3 kw_q0p75 -96.00 95.25 FORMAT "%5.2"
 /begin AXIS_DESCR STD_AXIS Epm_nEng EngN 6 -16384.00 16383.50 FORMAT "%8.2" DEPOSIT ABSOLUTE /end AXIS_DESCR
 /begin AXIS_DESCR STD_AXIS tans_msg temp_ub_q0p75_o48 5 -48.0 143.3 FORMAT "%5.1" DEPOSIT ABSOLUTE /end AXIS_DESCR
/end CHARACTERISTIC
/begin CHARACTERISTIC IKCtl_facDgnsSnsr "knock control: engine speed threshold anbale short circuit diagnosis" VALUE 0x80555802 RB_Val_Ws16 32767.50 EngN -16384.00 16383.50 FORMAT "%8.2" /end CHARACTERISTIC
/begin CHARACTERISTIC IKCtl_facFilSwt1 "revolution threshold for filter mean frequency area 1" VALUE 0x80555804 RB_Val_Ws16 32767.50 EngN -16384.00 16383.50 FORMAT "%8.2" /end CHARACTERISTIC
/begin CHARACTERISTIC IKCtl_facFilSwt2 "revolution threshold for filter mean frequency area 2" VALUE 0x80555806 RB_Val_Ws16 32767.50 EngN -16384.00 16383.50 FORMAT "%8.2" /end CHARACTERISTIC
/begin CHARACTERISTIC IKCtl_facFilSwt3 "revolution threshold for filter mean frequency area 3" VALUE 0x80555808 RB_Val_Ws16 32767.50 EngN -16384.00 16383.50 FORMAT "%8.2" /end CHARACTERISTIC
/begin CHARACTERISTIC IKCtl_facFilSwt4 "revolution threshold for filter mean frequency area 4" VALUE 0x8055580A RB_Val_Ws16 32767.50 EngN -16384.00 16383.50 FORMAT "%8.2" /end CHARACTERISTIC
/begin CHARACTERISTIC IKCtl_facMeasWinBgnHiRtdtIgn_GM "measuring window begin map at high retard ignition" MAP 0x8055580C RB_MapGroup_S8 39.75 kw_q0p75 0.75 40.50 FORMAT "%5.2" EXTENDED_LIMITS -96.00 95.25
 /begin AXIS_DESCR COM_AXIS Epm_nEng EngN 13 -16384.00 16383.50 FORMAT "%8.2" AXIS_PTS_REF IKCtl_nEngVar13_X_AX /end AXIS_DESCR
 /begin AXIS_DESCR COM_AXIS AirMod_ratChrgAirCyl rel_uw_q0p0234 8 0.00 1535.977 FORMAT "%8.3" AXIS_PTS_REF IKCtl_Load08_X_AX /end AXIS_DESCR
/end CHARACTERISTIC
/begin CHARACTERISTIC IKCtl_facMeasWinBgnLoRtdtIgn_GM "measuring window begin map at low retard ignition" MAP 0x80555874 RB_MapGroup_S8 39.75 kw_q0p75 0.75 40.50 FORMAT "%5.2" EXTENDED_LIMITS -96.00 95.25
 /begin AXIS_DESCR COM_AXIS Epm_nEng EngN 13 -16384.00 16383.50 FORMAT "%8.2" AXIS_PTS_REF IKCtl_nEngVar13_X_AX /end AXIS_DESCR
 /begin AXIS_DESCR COM_AXIS AirMod_ratChrgAirCyl rel_uw_q0p0234 8 0.00 1535.977 FORMAT "%8.3" AXIS_PTS_REF IKCtl_Load08_X_AX /end AXIS_DESCR
/end CHARACTERISTIC
/begin CHARACTERISTIC IKCtl_facMeasWinBgnMax_T "characteristic curve for high ignition retardation for the knock measurement window interpolation" CURVE 0x805558DC RB_Curve_S16_S8_Static 96.00 kw_q0p75 -96.00 0.00 FORMAT "%5.2" EXTENDED_LIMITS -96.00 95.25
 /begin AXIS_DESCR STD_AXIS Epm_nEng EngN 4 -16384.00 16383.50 FORMAT "%8.2" DEPOSIT ABSOLUTE /end AXIS_DESCR
/end CHARACTERISTIC
/begin CHARACTERISTIC IKCtl_facMeasWinBgnShftFFV_M "map for offset of measurement window begin for knock control for flexfuel" MAP 0x805558EA RB_Map_S16U8_S8 191.3 kw_q0p75 -96.00 95.25 FORMAT "%5.2"
 /begin AXIS_DESCR STD_AXIS Epm_nEng EngN 6 -16384.00 16383.50 FORMAT "%8.2" DEPOSIT ABSOLUTE /end AXIS_DESCR
 /begin AXIS_DESCR STD_AXIS fethmnmx_msg fak_ub_b2 4 0.00 1.992188 FORMAT "%8.6" DEPOSIT ABSOLUTE /end AXIS_DESCR
/end CHARACTERISTIC
/begin CHARACTERISTIC IKCtl_facMeasWinLngth_GT "length of the sampling window for knock control" CURVE 0x80555916 RB_CurveGroup_S8 60.00 zw_sb_q0p75 9.75 69.75 FORMAT "%5.2" EXTENDED_LIMITS -96.00 95.25
 /begin AXIS_DESCR COM_AXIS Epm_nEng EngN 13 -16384.00 16383.50 FORMAT "%8.2" AXIS_PTS_REF IKCtl_nEngVar13_X_AX /end AXIS_DESCR
/end CHARACTERISTIC
/begin CHARACTERISTIC IKCtl_facPreIgnMeasWinBgnLrg_GM "measuring window begin map at high retard ignition (high resolution)" MAP 0x80555962 RB_MapGroup_S8 191.3 zw_sb_q0p75 -96.00 95.25 FORMAT "%5.2"
 /begin AXIS_DESCR COM_AXIS Epm_nEng EngN 13 -16384.00 16383.50 FORMAT "%8.2" AXIS_PTS_REF IKCtl_nEngVar13_X_AX /end AXIS_DESCR
 /begin AXIS_DESCR COM_AXIS AirMod_ratChrgAirCyl rel_uw_q0p0234 8 0.00 1535.977 FORMAT "%8.3" AXIS_PTS_REF IKCtl_Load08_X_AX /end AXIS_DESCR
/end CHARACTERISTIC
/begin CHARACTERISTIC IKCtl_facPreIgnMeasWinBgnShftFFV_M "map for offset of measurement window begin for knock control for flexfuel" MAP 0x805559CA RB_Map_S16U8_S8 191.3 kw_q0p75 -96.00 95.25 FORMAT "%5.2"
 /begin AXIS_DESCR STD_AXIS Epm_nEng EngN 6 -16384.00 16383.50 FORMAT "%8.2" DEPOSIT ABSOLUTE /end AXIS_DESCR
 /begin AXIS_DESCR STD_AXIS fethmnmx_msg fak_ub_b2 4 0.00 1.992188 FORMAT "%8.6" DEPOSIT ABSOLUTE /end AXIS_DESCR
/end CHARACTERISTIC
/begin CHARACTERISTIC IKCtl_facPreIgnMeasWinBgnSml_GM "measuring window begin map at low retard ignition (high resolution)" MAP 0x805559F6 RB_MapGroup_S8 191.3 zw_sb_q0p75 -96.00 95.25 FORMAT "%5.2"
 /begin AXIS_DESCR COM_AXIS Epm_nEng EngN 13 -16384.00 16383.50 FORMAT "%8.2" AXIS_PTS_REF IKCtl_nEngVar13_X_AX /end AXIS_DESCR
 /begin AXIS_DESCR COM_AXIS AirMod_ratChrgAirCyl rel_uw_q0p0234 8 0.00 1535.977 FORMAT "%8.3" AXIS_PTS_REF IKCtl_Load08_X_AX /end AXIS_DESCR
/end CHARACTERISTIC
/begin CHARACTERISTIC IKCtl_facPreIgnMeasWinLngth_GT "length of the measurement window (additional measurement window) at high resolution" MAP 0x80555A5E RB_MapGroup_S8 191.3 zw_sb_q0p75 -96.00 95.25 FORMAT "%5.2"
 /begin AXIS_DESCR COM_AXIS Epm_nEng EngN 13 -16384.00 16383.50 FORMAT "%8.2" AXIS_PTS_REF IKCtl_nEngVar13_X_AX /end AXIS_DESCR
 /begin AXIS_DESCR COM_AXIS AirMod_ratChrgAirCyl rel_uw_q0p0234 8 0.00 1535.977 FORMAT "%8.3" AXIS_PTS_REF IKCtl_Load08_X_AX /end AXIS_DESCR
/end CHARACTERISTIC
/begin CHARACTERISTIC IKCtl_idxAsgnSnsr_CA "knock sensors for sw-cylinder counter 0-7" VAL_BLK 0x80555923 RB_ValA_Wu8 3.000 dezsub1 1.000 4.000 FORMAT "%5.3" EXTENDED_LIMITS 1.000 256.0 NUMBER 4 /end CHARACTERISTIC
/begin AXIS_PTS IKCtl_Load08_X_AX "datapoint distribution relative charge, 8 datapoints" 0x805578D0 AirMod_ratChrgAirCyl RB_Axis_U16 1535.977 rel_uw_q0p0234 8 0.00 1535.977 FORMAT "%8.3" DEPOSIT ABSOLUTE /end AXIS_PTS
/begin CHARACTERISTIC IKCtl_MeasWinCorr_C "measurement window begin ccorrection behaviour" VALUE 0x80555927 RB_Val_Wu8 255.0 OneToOne 0.00 255.0 FORMAT "%5.1" /end CHARACTERISTIC
/begin AXIS_PTS IKCtl_nEngVar13_X_AX "KC: Datapoint distribution engine speed of group A" 0x80557930 Epm_nEng RB_Axis_S16 32767.50 EngN 13 -16384.00 16383.50 FORMAT "%8.2" DEPOSIT ABSOLUTE /end AXIS_PTS
/begin CHARACTERISTIC IKCtl_SpdHys_C "n hysterisis for adaptation maps" VALUE 0x80555928 RB_Val_Ws16 32767.50 EngN -16384.00 16383.50 FORMAT "%8.2" /end CHARACTERISTIC
/begin CHARACTERISTIC KLGPRSOLDP "Factor rail pressure setpoint gradient dependent on pressure difference" CURVE 0x80556680 RB_CurveGroup_U8 15.94 fak_ub_b16 0.00 15.94 FORMAT "%5.2"
 /begin AXIS_DESCR COM_AXIS Epm_nEng EngN 5 0.00 32767.50 FORMAT "%8.2" AXIS_PTS_REF SNM05HDUW /end AXIS_DESCR
/end CHARACTERISTIC
/begin CHARACTERISTIC KLIHDR "Integrator part for high pressure control" CURVE 0x80555CAA RB_CurveGroup_U16 7.999878 fak_uw_b8 0.00 7.999878 FORMAT "%8.6"
 /begin AXIS_DESCR COM_AXIS FuPHi_pHpRglnDeLoc RBPtCel_p_0p002_1 6 -65.53600 65.53400 FORMAT "%8.5" AXIS_PTS_REF SPD06HDSW /end AXIS_DESCR
/end CHARACTERISTIC
/begin CHARACTERISTIC KLPHDR "Proportional part for high pressure control" CURVE 0x80555CB6 RB_CurveGroup_U16 7.999878 fak_uw_b8 0.00 7.999878 FORMAT "%8.6"
 /begin AXIS_DESCR COM_AXIS FuPHi_pHpRglnDeLoc RBPtCel_p_0p002_1 6 -65.53600 65.53400 FORMAT "%8.5" AXIS_PTS_REF SPD06HDSW /end AXIS_DESCR
/end CHARACTERISTIC
/begin CHARACTERISTIC KLPHDRTF "factor p-part HDR as function of temperature" CURVE 0x80555CC2 RB_Curve_U8_U8 1.992188 fak_ub_b2 0.00 1.992188 FORMAT "%8.6"
 /begin AXIS_DESCR STD_AXIS tfuelsq_msg temp_ub_q0p75_o48 4 -48.0 143.3 FORMAT "%5.1" DEPOSIT ABSOLUTE /end AXIS_DESCR
/end CHARACTERISTIC
/begin CHARACTERISTIC KLTFETHQES "Curve: ethanol sensor signal negative duty cycle time duration into ethanol content interpolation factor" CURVE 0x80555ACA RB_Curve_U16_U16 180.0000 temp_q0p1_om40 -40.0000 140.0000 FORMAT "%8.4" EXTENDED_LIMITS -40.00000 6513.500
 /begin AXIS_DESCR STD_AXIS npwethsr_w_msg t_q0p0001_ms 2 0.00 6.553500 FORMAT "%8.6" DEPOSIT ABSOLUTE /end AXIS_DESCR
/end CHARACTERISTIC
/begin CHARACTERISTIC KLTFPRIST "Time constant for low-pass filter, rail pressure actual value" CURVE 0x80555D10 RB_Curve_U8_U8 2.550 t_q0p01 0.00 2.550 FORMAT "%5.3"
 /begin AXIS_DESCR STD_AXIS Epm_nEngLRes EngN_LRes 4 0.00 10200. FORMAT "%5.0" DEPOSIT ABSOLUTE /end AXIS_DESCR
/end CHARACTERISTIC
/begin CHARACTERISTIC KLTFPRISTDYN "curve to define time constant for pressure filtering" CURVE 0x80555D1A RB_Curve_U16_U8_Static 2.550 t_q0p01 0.00 2.550 FORMAT "%5.3"
 /begin AXIS_DESCR STD_AXIS NO_INPUT_QUANTITY p_q0p0005 4 0.00 32.76750 FORMAT "%8.5" DEPOSIT ABSOLUTE /end AXIS_DESCR
/end CHARACTERISTIC
/begin CHARACTERISTIC KLTFSTFV "characteristiv line time constant fuel level filter" CURVE 0x80555746 RB_Curve_S16_U16_Static 6553.500 t_q0p1 0.00 6553.500 FORMAT "%8.3"
 /begin AXIS_DESCR STD_AXIS VehV_v Vel 4 -327.6800 327.6700 FORMAT "%8.4" DEPOSIT ABSOLUTE /end AXIS_DESCR
/end CHARACTERISTIC
/begin CHARACTERISTIC MODPRSOL2 "operation modes for setpoint map KFPRSOL2" VALUE 0x80556685 RB_Val_Wu8 255.0 dez 0.00 255.0 FORMAT "%5.1" /end CHARACTERISTIC
/begin CHARACTERISTIC MODPRSOL3 "operation modes for setpoint map KFPRSOL3" VALUE 0x80556686 RB_Val_Wu8 255.0 dez 0.00 255.0 FORMAT "%5.1" /end CHARACTERISTIC
/begin CHARACTERISTIC NPTETHMFMN_C "negative duty-cycle time duration from ethanol sensor in case of temperature measurement failure Min Value" VALUE 0x80555AD4 RB_Val_Wu16 6.553500 t_q0p0001_ms 0.00 6.553500 FORMAT "%8.6" /end CHARACTERISTIC
/begin CHARACTERISTIC NPTETHMFMX_C "negative duty-cycle time duration from ethanol sensor in case of temperature measurement failure Max Value" VALUE 0x80555AD6 RB_Val_Wu16 6.553500 t_q0p0001_ms 0.00 6.553500 FORMAT "%8.6" /end CHARACTERISTIC
/begin CHARACTERISTIC NPTETHSPMN_C "negative duty-cycle time duration from ethanol sensor Min Value" VALUE 0x80555AD8 RB_Val_Wu16 6.553500 t_q0p0001_ms 0.00 6.553500 FORMAT "%8.6" /end CHARACTERISTIC
/begin CHARACTERISTIC NPTETHSPMX_C "negative duty-cycle time duration from ethanol sensor Max Value" VALUE 0x80555ADA RB_Val_Wu16 6.553500 t_q0p0001_ms 0.00 6.553500 FORMAT "%8.6" /end CHARACTERISTIC
/begin AXIS_PTS SNM05HDUW "distribution of engine speed for rail pressure setpoint gradient limiter" 0x80556688 Epm_nEng RB_Axis_U16 32767.50 EngN 5 0.00 32767.50 FORMAT "%8.2" DEPOSIT ABSOLUTE /end AXIS_PTS
/begin AXIS_PTS SPD06HDSW "Distribution for controller deviation rail pressure" 0x80555CCC FuPHi_pHpRglnDeLoc RB_Axis_S16 131.0700 RBPtCel_p_0p002_1 6 -65.53600 65.53400 FORMAT "%8.5" DEPOSIT ABSOLUTE /end AXIS_PTS
/begin AXIS_PTS SRK05HDUW "distribution of relative fuel mass for rail pressure setpoint gradient limiter" 0x80556694 rkvmeeff_w_msg RB_Axis_U16 3071.953 rel_uw_b3072 5 0.00 3071.953 FORMAT "%8.3" DEPOSIT ABSOLUTE /end AXIS_PTS
/begin CHARACTERISTIC TDFSTBTKF "debounce time for fast uptdate fuel level after refueling" VALUE 0x80555758 RB_Val_Wu16 6553.500 t_q0p1 0.00 6553.500 FORMAT "%8.3" /end CHARACTERISTIC
/begin CHARACTERISTIC TDFSTU "time constant fuel level LP for HP" VALUE 0x8055575A RB_Val_Wu16 6553.500 t_q0p1 0.00 6553.500 FORMAT "%8.3" /end CHARACTERISTIC
/begin CHARACTERISTIC TDPRMXNMX "Turn off delay time of rail pressure setpoint limitation at engine speed limiter" VALUE 0x805566A0 RB_Val_Wu8 2.540 t_q0p02 0.00 2.540 FORMAT "%5.3" EXTENDED_LIMITS 0.00 5.100 /end CHARACTERISTIC
/begin CHARACTERISTIC TFSTFBTK "time constant fuel level filter for fast uptdate fuel level after refueling" VALUE 0x8055575C RB_Val_Wu16 6553.500 t_q0p1 0.00 6553.500 FORMAT "%8.3" /end CHARACTERISTIC
/begin CHARACTERISTIC TVFSTD "delay time fuel level sensor diagnostic" VALUE 0x8055575E RB_Val_Wu8 255.0 t_q1 0.00 255.0 FORMAT "%5.1" /end CHARACTERISTIC
/begin CHARACTERISTIC TVFSTTRG "Delay for sampling fuel level value after value is valid" VALUE 0x80555760 RB_Val_Wu16 6553.500 t_q0p1 0.00 6553.500 FORMAT "%8.3" /end CHARACTERISTIC
/begin CHARACTERISTIC TVHALT "delay time after vehicle halt" VALUE 0x80555762 RB_Val_Wu16 6553.500 t_q0p1 0.00 6553.500 FORMAT "%8.3" /end CHARACTERISTIC
/begin CHARACTERISTIC TVHDRPSLST "time threshold for start setpoint after end of start" VALUE 0x805566A2 RB_Val_Wu16 2.000000 t_q0p1 0.00 2.000000 FORMAT "%8.6" EXTENDED_LIMITS 0.00 6553.500 /end CHARACTERISTIC
/begin CHARACTERISTIC UBSQDFSTMN "Minimum battery voltage for fuel-level diagnostics" VALUE 0x80555764 RB_Val_Wu8 25.50 spg_q0p1 0.00 25.50 FORMAT "%5.2" /end CHARACTERISTIC
/begin CHARACTERISTIC UBSQDFSTMX "Maximum battery voltage for fuel-level diagnostics" VALUE 0x80555765 RB_Val_Wu8 25.50 spg_q0p1 0.00 25.50 FORMAT "%5.2" /end CHARACTERISTIC
/begin CHARACTERISTIC UFSTMN "Lower fault threshold fluid level sensor in the tank" VALUE 0x80555766 RB_Val_Wu16 320.3351 spg_uw_q0p004888 0.00 320.3351 FORMAT "%8.4" /end CHARACTERISTIC
/begin CHARACTERISTIC UFSTMX "Upper fault threshold fluid level sensor in the tank" VALUE 0x80555768 RB_Val_Wu16 320.3351 spg_uw_q0p004888 0.00 320.3351 FORMAT "%8.4" /end CHARACTERISTIC
/begin CHARACTERISTIC ZWRETKRMN "lower threshold for knock window begin interpolation for low ignition retardation" VALUE 0x8055592A RB_Val_Wu8 12.00 kw_q0p75 0.00 12.00 FORMAT "%5.2" EXTENDED_LIMITS 0.00 191.3 /end CHARACTERISTIC
/begin CHARACTERISTIC ZWRETKRMNZ "lower threshold for additional knock window begin interpolation for low ignition retardation" VALUE 0x80555AC6 RB_Val_Ws8 191.3 zw_sb_q0p75 -96.00 95.25 FORMAT "%5.2" /end CHARACTERISTIC
/begin CHARACTERISTIC ZWRETKRMXZ "upper threshold for additional knock window begin interpolation for high ignition retardation" VALUE 0x80555AC7 RB_Val_Ws8 191.3 zw_sb_q0p75 -96.00 95.25 FORMAT "%5.2" /end CHARACTERISTIC
/begin MEASUREMENT akrcderz_w "knock control: number of complex driver errors additinal measurement window" UWORD dez 1 100 0.00 65535.00 FORMAT "%8.2" ECU_ADDRESS 0x70002E8E /end MEASUREMENT
/begin MEASUREMENT B_efstmn_msg "Condition fuel level sender (1) minimum error (only for communication with fault memory)" UBYTE B_TRUE 1 100 0.00 1.00000000000 BIT_MASK 0x1 FORMAT "%13.11" ECU_ADDRESS 0x600013ED /end MEASUREMENT
/begin MEASUREMENT B_efstmx_msg "Condition fuel level sender (1) maximum error (only for communication with fault memory)" UBYTE B_TRUE 1 100 0.00 1.00000000000 BIT_MASK 0x1 FORMAT "%13.11" ECU_ADDRESS 0x600013EC /end MEASUREMENT
/begin MEASUREMENT B_ethspwmn_msg "ethanol sensor, signal error min. negative pulse width" UBYTE B_TRUE 1 100 0.00 1.00000000000 BIT_MASK 0x1 FORMAT "%13.11" ECU_ADDRESS 0x6000F6F2 /end MEASUREMENT
/begin MEASUREMENT B_ethspwmx_msg "ethanol sensor, signal error max. negative pulse width" UBYTE B_TRUE 1 100 0.00 1.00000000000 BIT_MASK 0x1 FORMAT "%13.11" ECU_ADDRESS 0x6000F6F1 /end MEASUREMENT
/begin MEASUREMENT B_ethspwsi_msg "ethanol sensor, signal error measurement fault temperature (sensor internal diagnosis)" UBYTE B_TRUE 1 100 0.00 1.00000000000 BIT_MASK 0x1 FORMAT "%13.11" ECU_ADDRESS 0x6000F6F0 /end MEASUREMENT
/begin MEASUREMENT B_fstdmn_msg "condition minimum fuel level for diagnostic function" UBYTE B_TRUE 1 100 0.00 1.00000000000 BIT_MASK 0x1 FORMAT "%13.11" ECU_ADDRESS 0x600013DB /end MEASUREMENT
/begin MEASUREMENT B_fstdmx_msg "condition maximum fuel level for diagnostic function" UBYTE B_TRUE 1 100 0.00 1.00000000000 BIT_MASK 0x1 FORMAT "%13.11" ECU_ADDRESS 0x600013DA /end MEASUREMENT
/begin MEASUREMENT B_fstdy "condition dynamic fuel level" UBYTE B_TRUE 1 100 0.00 1.00000000000 BIT_MASK 0x1 FORMAT "%13.11" ECU_ADDRESS 0x60000F21 /end MEASUREMENT
/begin MEASUREMENT B_fstfbtk "condition for fast uptdate fuel level after refueling" UBYTE B_TRUE 1 100 0.00 1.00000000000 BIT_MASK 0x1 FORMAT "%13.11" ECU_ADDRESS 0x60000F20 /end MEASUREMENT
/begin MEASUREMENT B_fstsok1_msg "Condition fuel level sender 1 without el./CAN-signal error (healing, ok-check)" UBYTE B_TRUE 1 100 0.00 1.00000000000 BIT_MASK 0x1 FORMAT "%13.11" ECU_ADDRESS 0x600013D9 /end MEASUREMENT
/begin MEASUREMENT B_fstsok_msg "Condition: fuel-level signal(min-max)-check is OK" UBYTE B_TRUE 1 100 0.00 1.00000000000 BIT_MASK 0x1 FORMAT "%13.11" ECU_ADDRESS 0x600013D8 /end MEASUREMENT
/begin MEASUREMENT B_fststa "Condition fuel level after start" UBYTE B_TRUE 1 100 0.00 1.00000000000 BIT_MASK 0x1 FORMAT "%13.11" ECU_ADDRESS 0x60000F1F /end MEASUREMENT
/begin MEASUREMENT B_fsttg_msg "fuel level valid (even during control unit afterrun)" UBYTE B_TRUE 1 100 0.00 1.00000000000 BIT_MASK 0x1 FORMAT "%13.11" ECU_ADDRESS 0x600013D7 /end MEASUREMENT
/begin MEASUREMENT B_fsttrg_msg "Condition: fuel-level raw signal valid (not debounced)" UBYTE B_TRUE 1 100 0.00 1.00000000000 BIT_MASK 0x1 FORMAT "%13.11" ECU_ADDRESS 0x600013D6 /end MEASUREMENT
/begin MEASUREMENT B_fsttsh_msg "condition sample/hold fuel level" UBYTE B_TRUE 1 100 0.00 1.00000000000 BIT_MASK 0x1 FORMAT "%13.11" ECU_ADDRESS 0x600013D5 /end MEASUREMENT
/begin MEASUREMENT B_fsttval_msg "condition fuel level valid" UBYTE B_TRUE 1 100 0.00 1.00000000000 BIT_MASK 0x1 FORMAT "%13.11" ECU_ADDRESS 0x600013D4 /end MEASUREMENT
/begin MEASUREMENT B_prsolgrb "condition gradient limitation of rail pressure setpoint enabled" UBYTE B_TRUE 1 100 0.00 1.00000000000 BIT_MASK 0x1 FORMAT "%13.11" ECU_ADDRESS 0x6000B81C /end MEASUREMENT
/begin MEASUREMENT B_prsolst "condition setpoint at start" UBYTE B_TRUE 1 100 0.00 1.00000000000 BIT_MASK 0x1 FORMAT "%13.11" ECU_ADDRESS 0x6000B81B /end MEASUREMENT
/begin MEASUREMENT B_talval_msg "condition ; bit empty tank valid" UBYTE B_TRUE 1 100 0.00 1.00000000000 BIT_MASK 0x1 FORMAT "%13.11" ECU_ADDRESS 0x600013BD /end MEASUREMENT
/begin MEASUREMENT B_tal_msg "Reserve;Condition: tank empty or reserve" UBYTE B_TRUE 1 100 0.00 1.00000000000 BIT_MASK 0x1 FORMAT "%13.11" ECU_ADDRESS 0x600013BE /end MEASUREMENT
/begin MEASUREMENT B_tav_msg "condition fuel tank full" UBYTE B_TRUE 1 100 0.00 1.00000000000 BIT_MASK 0x1 FORMAT "%13.11" ECU_ADDRESS 0x600013BA /end MEASUREMENT
/begin MEASUREMENT B_tethsrg_msg "ethanolsensor, el. validity temperature signal" UBYTE B_TRUE 1 100 0.00 1.00000000000 BIT_MASK 0x1 FORMAT "%13.11" ECU_ADDRESS 0x6000F6D2 /end MEASUREMENT
/begin MEASUREMENT Com_ctReIni10msCGW1 "ReInit Counter for CGW1 frame" UBYTE OneToOne 1 100 0.00 255.0 FORMAT "%5.1" ECU_ADDRESS 0x6000B820 /end MEASUREMENT
/begin MEASUREMENT Com_ctReIni10msGwIMG6 "ReInit Counter for GwIMG6 frame" UBYTE OneToOne 1 100 0.00 255.0 FORMAT "%5.1" ECU_ADDRESS 0x6000B81F /end MEASUREMENT
/begin MEASUREMENT Com_flgGwIMG3Norm "ComGwIMG3 Frame communication normal flag. (FId_ComGwIMG3 is not inhibited)" UBYTE B_TRUE 1 100 0.00 1.00000000000 BIT_MASK 0x1 FORMAT "%13.11" ECU_ADDRESS 0x6000F9C0 /end MEASUREMENT
/begin MEASUREMENT dprstt_w "Difference of start pressure vs. measured value" SWORD RBPtCel_p_0p002_1 1 100 -65.53600 65.53400 FORMAT "%8.5" ECU_ADDRESS 0x600074B6 /end MEASUREMENT
/begin MEASUREMENT ETHSCP_tFuHiRes "High resolution temperature ethanolsensor" UWORD temp_q0p1_om40 1 100 -40.0000 140.0000 FORMAT "%8.4" ECU_ADDRESS 0x60039890 /end MEASUREMENT
/begin MEASUREMENT FlLvl_flgCdnMdnFuLvl "median_5 value of fuel level flag" UBYTE B_TRUE 1 100 0.00 1.00000000000 BIT_MASK 0x1 FORMAT "%13.11" ECU_ADDRESS 0x6000139B /end MEASUREMENT
/begin MEASUREMENT FlLvl_flgFuSnsrPhyRngMaxErr "Fuel sensor max physical range error" UBYTE B_TRUE 1 100 0.00 1.00000000000 BIT_MASK 0x1 FORMAT "%13.11" ECU_ADDRESS 0x6000139A /end MEASUREMENT
/begin MEASUREMENT FlLvl_flgFuSnsrPhyRngMinErr "Fuel sensor min physical range error" UBYTE B_TRUE 1 100 0.00 1.00000000000 BIT_MASK 0x1 FORMAT "%13.11" ECU_ADDRESS 0x60001399 /end MEASUREMENT
/begin MEASUREMENT FlLvl_flgMaxFuLvlDiagcFct "condition maximum fuel level for diagnostic function" UBYTE B_TRUE 1 100 0.00 1.00000000000 BIT_MASK 0x1 FORMAT "%13.11" ECU_ADDRESS 0x600014DC /end MEASUREMENT
/begin MEASUREMENT FlLvl_flgMinFuLvlDiagcFct "condition minimum fuel level for diagnostic function" UBYTE B_TRUE 1 100 0.00 1.00000000000 BIT_MASK 0x1 FORMAT "%13.11" ECU_ADDRESS 0x600014DB /end MEASUREMENT
/begin MEASUREMENT FlLvl_flgRefuInProgs "Refuelling in progress flag" UBYTE B_TRUE 1 100 0.00 1.00000000000 BIT_MASK 0x1 FORMAT "%13.11" ECU_ADDRESS 0x60001398 /end MEASUREMENT
/begin MEASUREMENT FlLvl_idxFuLvlAvrg200 "index for calculating average of fuel level per 2km distance" UBYTE OneToOne 1 100 0.00 255.0 FORMAT "%5.1" ECU_ADDRESS 0x60000F2C /end MEASUREMENT
/begin MEASUREMENT FlLvl_idxFuLvlAvrg5 "index for calculating average of fuel level per 10km distance" UBYTE OneToOne 1 100 0.00 255.0 FORMAT "%5.1" ECU_ADDRESS 0x600392B2 /end MEASUREMENT
/begin MEASUREMENT FlLvl_idxMdnFuLvl "index for coping raw fuel level of 5elements in to buffer for determining Median_5" UBYTE OneToOne 1 100 0.00 255.0 FORMAT "%5.1" ECU_ADDRESS 0x60000F1E /end MEASUREMENT
/begin MEASUREMENT FlLvl_lTotDstFuLvlAvrg "local copy of total distance since start for fuel level averaging" SLONG Length 1 100 -2147483648.00 2147483647.00 FORMAT "%13.2" ECU_ADDRESS 0x60000F28 /end MEASUREMENT
/begin MEASUREMENT FlLvl_rOBDSig "Relative fuel level intended for display on OBD Scan Tool" UBYTE Prc_q0p392157_COMPU 1 100 0.00 100.0 FORMAT "%5.1" ECU_ADDRESS 0x60001421 /end MEASUREMENT
/begin MEASUREMENT FlLvl_volAvrgFuLvl_msg "fuel level, filtered and avearage value per 10km distance for diagnostic function" UWORD vol_q0p1_l 1 100 0.00 6553.500 FORMAT "%8.3" ECU_ADDRESS 0x60039880 /end MEASUREMENT
/begin MEASUREMENT FlLvl_volDiffFuLvl "Difference in fuel level during fuel level changes" SWORD vol_q0p1_l 1 100 -3276.800 3276.700 FORMAT "%8.3" ECU_ADDRESS 0x60000F1C /end MEASUREMENT
/begin MEASUREMENT FlLvl_volFuForDynDetn "fuel level for dynamic detection" UWORD vol_q0p1_l 1 100 0.00 6553.500 FORMAT "%8.3" ECU_ADDRESS 0x60000F1A /end MEASUREMENT
/begin MEASUREMENT FlLvl_volFuLvlAvrg200 "fuel level sum of 2km per every 10m distance" ULONG vol_q0p1_l 1 100 0.00 429496729.500 FORMAT "%13.3" ECU_ADDRESS 0x60000F24 /end MEASUREMENT
/begin MEASUREMENT FlLvl_volFuLvlAvrg5 "fuel level sum of 10km per every 2km distance" UWORD vol_q0p1_l 1 100 0.00 6553.500 FORMAT "%8.3" ECU_ADDRESS 0x60000F22 /end MEASUREMENT
/begin MEASUREMENT FlLvl_volFuLvlAvrgAry "fuel level average per 2km distance" UWORD vol_q0p1_l 1 100 0.00 6553.500 FORMAT "%8.3" ARRAY_SIZE 5 ECU_ADDRESS 0x600392A8 /end MEASUREMENT
/begin MEASUREMENT FlLvl_volMdnFuLvlFild "fuel level, filtered" UWORD vol_q0p1_l 1 100 0.00 6553.500 FORMAT "%8.3" ECU_ADDRESS 0x600014A4 /end MEASUREMENT
/begin MEASUREMENT FlLvl_volMdnValFuLvl "Median_5 value of fuel level, unfiltered" UWORD vol_q0p1_l 1 100 0.00 6553.500 FORMAT "%8.3" ECU_ADDRESS 0x60000F18 /end MEASUREMENT
/begin MEASUREMENT FlLvl_volRawFuLvlAry "fuel level, unfiltered" UWORD vol_q0p1_l 1 100 0.00 6553.500 FORMAT "%8.3" ARRAY_SIZE 5 ECU_ADDRESS 0x60000F0E /end MEASUREMENT
/begin MEASUREMENT FlLvl_volRefuFuLvlFild "Fast filtered fuel level for slope detection" UWORD vol_q0p1_l 1 100 0.00 6553.500 FORMAT "%8.3" ECU_ADDRESS 0x600014A0 /end MEASUREMENT
/begin MEASUREMENT FlLvl_volTnkTot "Added fuel level of all the fuel tanks in the vehicle" SWORD Vol_q0p1_l 1 100 -3276.800 3276.700 FORMAT "%8.3" ECU_ADDRESS 0x600398C6 /end MEASUREMENT
/begin MEASUREMENT fstadf_w "differential filtered fuel level" UWORD vol_q0p1_l 1 100 0.00 6553.500 FORMAT "%8.3" ECU_ADDRESS 0x60000F0C /end MEASUREMENT
/begin MEASUREMENT fstof1_w "unfiltered fuel level tank 1" UWORD vol_q0p1_l 1 100 0.00 6553.500 FORMAT "%8.3" ECU_ADDRESS 0x60000F0A /end MEASUREMENT
/begin MEASUREMENT fstof_w_msg "unfiltered fuel level" UWORD vol_q0p1_l 1 100 0.00 6553.500 FORMAT "%8.3" ECU_ADDRESS 0x60001482 /end MEASUREMENT
/begin MEASUREMENT fsttval_w "valid fuel level" UWORD vol_q0p1_l 1 100 0.00 6553.500 FORMAT "%8.3" ECU_ADDRESS 0x600392A6 /end MEASUREMENT
/begin MEASUREMENT fstt_msg "fuel level" UBYTE vol_q1 1 100 0.00 255.0 FORMAT "%5.1" ECU_ADDRESS 0x60001416 /end MEASUREMENT
/begin MEASUREMENT fstt_w_msg "fuel level" UWORD vol_q0p1_l 1 100 0.00 6553.500 FORMAT "%8.3" ECU_ADDRESS 0x60001480 /end MEASUREMENT
/begin MEASUREMENT fstu_w_msg "Fuel Level (16-Bit)" UWORD vol_q0p1_l 1 100 0.00 6553.500 FORMAT "%8.3" ECU_ADDRESS 0x6000147C /end MEASUREMENT
/begin MEASUREMENT FuPHi_fGrdtChgPRailSp "difference pressure for calculation of time constant for rail pressure filtering" UWORD p_q0p0005 1 100 0.00 32.76750 FORMAT "%8.5" ECU_ADDRESS 0x600074B4 /end MEASUREMENT
/begin MEASUREMENT FuPHi_flgPPrdnEna "Condition rail pressure prediction active" UBYTE B_TRUE 1 100 0.00 1.00000000000 BIT_MASK 0x1 FORMAT "%13.11" ECU_ADDRESS 0x70002E78 /end MEASUREMENT
/begin MEASUREMENT FuPHi_flgTstrReqActvRailP "Condition tester request is active for rail pressure sepoint" UBYTE B_TRUE 1 100 0.00 1.00000000000 BIT_MASK 0x1 FORMAT "%13.11" ECU_ADDRESS 0x6000F96E /end MEASUREMENT
/begin MEASUREMENT FuPHi_flgTstrReqActvRailPLoc "flag to indicate if tester request is active" UBYTE B_TRUE 1 100 0.00 1.00000000000 BIT_MASK 0x1 FORMAT "%13.11" ECU_ADDRESS 0x6000B81A /end MEASUREMENT
/begin MEASUREMENT FuPHi_pHpCtrlrOut "output high pressure controller" SWORD RBPtCel_p_0p002_1 1 100 -65.53600 65.53400 FORMAT "%8.5" ECU_ADDRESS 0x60001658 /end MEASUREMENT
/begin MEASUREMENT FuPHi_pHpRglnDe "High pressure regulation: System deviation" SWORD RBPtCel_p_0p002_1 1 100 -65.53600 65.53400 FORMAT "%8.5" ECU_ADDRESS 0x60001654 /end MEASUREMENT
/begin MEASUREMENT FuPHi_pHpRglnDeLoc "temporary variable for FuPHi_pHpRglnDe" SWORD RBPtCel_p_0p002_1 1 100 -65.53600 65.53400 FORMAT "%8.5" ECU_ADDRESS 0x60000F06 /end MEASUREMENT
/begin MEASUREMENT FuPHi_pPrdnDelta "Delta of raiil pressure since last calculation" SWORD RBPtCel_p_0p002_1 1 100 -65.53600 65.53400 FORMAT "%8.5" ECU_ADDRESS 0x70002E76 /end MEASUREMENT
/begin MEASUREMENT FuPHi_pPrdnDeltaOld "internal value delta of rail pressure from last calculation" SWORD RBPtCel_p_0p002_1 1 100 -65.53600 65.53400 FORMAT "%8.5" ECU_ADDRESS 0x70002E74 /end MEASUREMENT
/begin MEASUREMENT FuPHi_pPrdnOff "Prediction part of rail pressure detection" SWORD RBPtCel_p_0p002_1 1 100 -65.53600 65.53400 FORMAT "%8.5" ECU_ADDRESS 0x70002E72 /end MEASUREMENT
/begin MEASUREMENT FuPHi_pPrdnOld "internal value old rail pressure" UWORD RBPtCel_p_0p002_1 1 100 0.00 131.0700 FORMAT "%8.4" ECU_ADDRESS 0x70002E70 /end MEASUREMENT
/begin MEASUREMENT FuPHi_pRail "Filtered fuel rail pressure real value (absolute pressure)" UWORD RBPtCel_p_0p002_1 1 100 0.00 131.0700 FORMAT "%8.4" ECU_ADDRESS 0x60009468 /end MEASUREMENT
/begin MEASUREMENT FuPHi_pRailInj "Synchronously averaged fuel rail pressure real value for injection (absolut pressure)" UWORD RBPtCel_p_0p002_1 1 100 0.00 131.0700 FORMAT "%8.4" ECU_ADDRESS 0x7000397C /end MEASUREMENT
/begin MEASUREMENT FuPHi_pRailLoc "Rail pressure set point Local variable" UWORD RBPtCel_p_0p002_1 1 100 0.00 131.0700 FORMAT "%8.4" ECU_ADDRESS 0x600074B2 /end MEASUREMENT
/begin MEASUREMENT FuPHi_pRailSp "rail pressure setpoint" UWORD RBPtCel_p_0p002_1 1 100 0.00 131.0700 FORMAT "%8.4" ECU_ADDRESS 0x60009466 /end MEASUREMENT
/begin MEASUREMENT FuPHi_pRailSpBefLimn "Rail pressure value before limitation" UWORD RBPtCel_p_0p002_1 1 100 0.00 131.0700 FORMAT "%8.4" ECU_ADDRESS 0x600074B0 /end MEASUREMENT
/begin MEASUREMENT FuPHi_pRailSpGradLimd "Target pressure after gradient limitation" UWORD RBPtCel_p_0p002_1 1 100 0.00 131.0700 FORMAT "%8.4" ECU_ADDRESS 0x600074AE /end MEASUREMENT
/begin MEASUREMENT FuPHi_pRailSpGrdt "Rail setpoint pressure gradient value" SWORD RBPtCel_p_0p002_1 1 100 -65.53600 65.53400 FORMAT "%8.5" ECU_ADDRESS 0x6000164E /end MEASUREMENT
/begin MEASUREMENT FuPHi_pRailSpGrdtloc "Rail setpoint pressure gradient local value for Bank 1" UWORD RBPtCel_p_0p002_1 1 100 0.00 131.0700 FORMAT "%8.4" ECU_ADDRESS 0x60000F00 /end MEASUREMENT
/begin MEASUREMENT FuPHi_pRailSpLoc "Base target pressure before corrections depending on engine speed, temperature and ethanol content" UWORD RBPtCel_p_0p002_1 1 100 0.00 131.0700 FORMAT "%8.4" ECU_ADDRESS 0x600074AC /end MEASUREMENT
/begin MEASUREMENT FuPHi_pRailSpNoCatHeatg "rail pressure setpoint without consideration of catalyst heating" UWORD RBPtCel_p_0p002_1 1 100 0.00 131.0700 FORMAT "%8.4" ECU_ADDRESS 0x60009464 /end MEASUREMENT
/begin MEASUREMENT FuPHi_pRailSpUnlim "rail pressure setpoint before filtering" UWORD RBPtCel_p_0p002_1 1 100 0.00 131.0700 FORMAT "%8.4" ECU_ADDRESS 0x60009462 /end MEASUREMENT
/begin MEASUREMENT FuPHi_pRailStrt "Fuel rail pressure (absolut pressure) during start" UWORD RBPtCel_p_0p002_1 1 100 0.00 131.0700 FORMAT "%8.4" ECU_ADDRESS 0x60009460 /end MEASUREMENT
/begin MEASUREMENT FuPHi_pria "High pressure regulation: integrator part" SWORD RBPtCel_p_0p002_1 1 100 -65.53600 65.53400 FORMAT "%8.5" ECU_ADDRESS 0x60000F04 /end MEASUREMENT
/begin MEASUREMENT FuPHi_pRlSpMaxLoc "maximum setpoint value rail pressure" UWORD RBPtCel_p_0p002_1 1 100 0.00 131.0700 FORMAT "%8.4" ECU_ADDRESS 0x70002E6C /end MEASUREMENT
/begin MEASUREMENT FuPHi_pRlSpNgvGradLoc "Negative gradient for Gradient Limiter- rail-pressure Setpoint." UWORD RBPtCel_p_0p002_1 1 100 0.0080 131.0700 FORMAT "%8.4" ECU_ADDRESS 0x600074AA /end MEASUREMENT
/begin MEASUREMENT FuPHi_pRlSpPosGradLoc "Positive gradient for Gradient Limiter- rail-pressure setpoint" UWORD RBPtCel_p_0p002_1 1 100 0.0080 131.0700 FORMAT "%8.4" ECU_ADDRESS 0x600074A8 /end MEASUREMENT
/begin MEASUREMENT FuPHi_prpa "High pressure regulation: Proportional part" SWORD RBPtCel_p_0p002_1 1 100 -65.53600 65.53400 FORMAT "%8.5" ECU_ADDRESS 0x60000F02 /end MEASUREMENT
/begin MEASUREMENT FuPHi_tnPRailPT1 "Time constant for low-pass filter of actual rail pressure in 10-ms task" UBYTE t_q0p01 1 100 0.00 2.550 FORMAT "%5.3" ECU_ADDRESS 0x6000B81D /end MEASUREMENT
/begin MEASUREMENT GlbDa_aX "vehicle longitudinal acceleration" SWORD Acc 1 100 -32.76800 32.76700 FORMAT "%8.5" ECU_ADDRESS 0x60009906 /end MEASUREMENT
/begin MEASUREMENT GlbDa_aXFlt "vehicle longitudinal acceleration filtered" SWORD Acc 1 100 -32.76800 32.76700 FORMAT "%8.5" ECU_ADDRESS 0x60009904 /end MEASUREMENT
/begin MEASUREMENT GlbDa_cntrDrvgCyc "Counter for storing the global driving cycle happened during the lifecycle of the ECU" ULONG OneToOne 1 100 0.00 4294967295.00 FORMAT "%13.2" ECU_ADDRESS 0x600037AC /end MEASUREMENT
/begin MEASUREMENT GlbDa_cntrReIni "ReIni counter" UBYTE OneToOne 1 100 0.00 255.0 FORMAT "%5.1" ECU_ADDRESS 0x6000B823 /end MEASUREMENT
/begin MEASUREMENT GlbDa_flgDrvgCycCntr "Flag for global driving cycle counter message when incremented by one unit" UBYTE B_TRUE 1 100 0.00 1.00000000000 BIT_MASK 0x1 FORMAT "%13.11" ECU_ADDRESS 0x6000B826 /end MEASUREMENT
/begin MEASUREMENT GlbDa_lDst "total travelled distance" SLONG Length 1 100 -2147483648.00 2147483647.00 FORMAT "%13.2" ECU_ADDRESS 0x60013B2C /end MEASUREMENT
/begin MEASUREMENT GlbDa_lDstLstStored "last value of total distance in EEP" SLONG Length 1 100 -2147483648.00 2147483647.00 FORMAT "%13.2" ECU_ADDRESS 0x60012FA4 /end MEASUREMENT
/begin MEASUREMENT GlbDa_lDstLstStoredProtd "last value of total distance in EEP" SLONG Length 1 100 -2147483648.00 2147483647.00 FORMAT "%13.2" ECU_ADDRESS 0x600365F0 /end MEASUREMENT
/begin MEASUREMENT GlbDa_lenTotDstDcyc "Total distance travelled in the current driving cycle" SLONG LengthKm1 1 100 -2147483648.00 2147483647.00 FORMAT "%13.2" ECU_ADDRESS 0x600039BC /end MEASUREMENT
/begin MEASUREMENT GlbDa_lenTotDstDcycHiResl "Total distance travelled in the current driving cycle with a high resolution" UWORD Length_10m 1 100 0.00 655350.0 FORMAT "%8.1" ECU_ADDRESS 0x60009458 /end MEASUREMENT
/begin MEASUREMENT GlbDa_lenTotDstPrevDcyc "Total distance travelled till the previous driving cycle" SLONG Length 1 100 -2147483648.00 2147483647.00 FORMAT "%13.2" ECU_ADDRESS 0x600027B4 /end MEASUREMENT
/begin MEASUREMENT GlbDa_lTotDst "total distance since first start" SLONG Length 1 100 -2147483648.00 2147483647.00 FORMAT "%13.2" ECU_ADDRESS 0x50004FD0 /end MEASUREMENT
/begin MEASUREMENT GlbDa_lTotDstProtd "total distance since first start" SLONG Length 1 100 -2147483648.00 2147483647.00 FORMAT "%13.2" ECU_ADDRESS 0x600365EC /end MEASUREMENT
/begin MEASUREMENT GlbDa_lWhlCirc "wheel circumference" SWORD Length_fine 1 100 -32.76800 32.76700 FORMAT "%8.5" ECU_ADDRESS 0x60009902 /end MEASUREMENT
/begin MEASUREMENT GlbDa_nrWhlSpdAryIdx1 "Number loop array index 1 for value of wheel speed" UBYTE OneToOne 1 100 0.00 255.0 FORMAT "%5.1" ECU_ADDRESS 0x6000B822 /end MEASUREMENT
/begin MEASUREMENT GlbDa_nrWhlSpdAryIdx2 "Number loop array index 2 for value of wheel speed" UBYTE OneToOne 1 100 0.00 255.0 FORMAT "%5.1" ECU_ADDRESS 0x6000B821 /end MEASUREMENT
/begin MEASUREMENT GlbDa_pEnv "environmental pressure" SWORD Pres_hPa 1 100 -32768.00 32767.00 FORMAT "%8.2" ECU_ADDRESS 0x60009900 /end MEASUREMENT
/begin MEASUREMENT GlbDa_rTrqTot "total ratio of the power train inclusive the differential and the converter torque ratio" SWORD TransR 1 100 -327.6800 327.6700 FORMAT "%8.4" ECU_ADDRESS 0x700053A4 /end MEASUREMENT
/begin MEASUREMENT GlbDa_rTrqTotWoConvRat "total ratio of the power train inclusive the differential ratio and without the converter torque ratio" SWORD TransR 1 100 -327.6800 327.6700 FORMAT "%8.4" ECU_ADDRESS 0x700053A6 /end MEASUREMENT
/begin MEASUREMENT GlbDa_stEepOrder "return value of EEP write function" UBYTE OneToOne 1 100 0.00 255.0 FORMAT "%5.1" ECU_ADDRESS 0x6000B825 /end MEASUREMENT
/begin MEASUREMENT GlbDa_stEepWrite "state machine for direct write to EEP" UBYTE OneToOne 1 100 0.00 255.0 FORMAT "%5.1" ECU_ADDRESS 0x6000B824 /end MEASUREMENT
/begin MEASUREMENT GlbDa_stTrqDem "contains highest prior function with torque demand" UWORD OneToOne 1 100 0.00 65535.00 FORMAT "%8.2" ECU_ADDRESS 0x600148EE /end MEASUREMENT
/begin MEASUREMENT GlbDa_tEnv "environment temperature" SWORD Temp_Cels 1 100 -3549.940 3003.560 FORMAT "%8.3" ECU_ADDRESS 0x600098FE /end MEASUREMENT
/begin MEASUREMENT GlbDa_tIndAir "induction air temperature" SWORD Temp_Cels 1 100 -3549.940 3003.560 FORMAT "%8.3" ECU_ADDRESS 0x600098FC /end MEASUREMENT
/begin MEASUREMENT GlbDa_vAvrgWhlSpd "Average processed Wheel speeds." SWORD Vel 1 100 -327.6800 327.6700 FORMAT "%8.4" ECU_ADDRESS 0x600098F8 /end MEASUREMENT
/begin MEASUREMENT GlbDa_vWhlSpdFlt "Filtered value of wheel speed." SWORD Vel 1 100 -327.6800 327.6700 FORMAT "%8.4" ARRAY_SIZE 4 ECU_ADDRESS 0x5000573C /end MEASUREMENT
/begin MEASUREMENT GlbDa_vWhlSpdFltAryVal "Value for Filtered value of wheel speed" SWORD Vel 1 100 -327.6800 327.6700 FORMAT "%8.4" ECU_ADDRESS 0x600074B8 /end MEASUREMENT
/begin MEASUREMENT GlbDa_vX "vehicle longitudinal velocity" SWORD Vel 1 100 -327.6800 327.6700 FORMAT "%8.4" ECU_ADDRESS 0x600098F6 /end MEASUREMENT
/begin MEASUREMENT GlbDa_vXFlt "vehicle velocity filtered" SWORD Vel 1 100 -327.6800 327.6700 FORMAT "%8.4" ECU_ADDRESS 0x600098F4 /end MEASUREMENT
/begin MEASUREMENT gvtaf_w_msg "free gas capacity in fuel tank" UWORD vol_q0p1_l 1 100 0.00 6553.500 FORMAT "%8.3" ECU_ADDRESS 0x6000145C /end MEASUREMENT
/begin MEASUREMENT GwECU_ctCGW1RngCnt_MP "Alive counter measurement point" UBYTE OneToOne 1 100 0.00 255.0 FORMAT "%5.1" ECU_ADDRESS 0x7000A269 /end MEASUREMENT
/begin MEASUREMENT GwECU_ctGwIMG1RngCnt_MP "IMG! Ring counter Mesuring Point" UBYTE OneToOne 1 100 0.00 3.000 FORMAT "%5.3" ECU_ADDRESS 0x7000A268 /end MEASUREMENT
/begin MEASUREMENT GwECU_ctGwIMG4RngCnt_MP "GWIMG4 Ring counter measuring point" UBYTE OneToOne 1 100 0.00 3.000 FORMAT "%5.3" ECU_ADDRESS 0x7000A267 /end MEASUREMENT
/begin MEASUREMENT GwECU_ctGwIMG5RngCnt_MP "Alive counter measurement point" UBYTE OneToOne 1 100 0.00 3.000 FORMAT "%5.3" ECU_ADDRESS 0x7000A266 /end MEASUREMENT
/begin MEASUREMENT GwECU_ctGwIMG6RngCnt "Indicated for Measurement point for GWIMG6 frame ring counter" UBYTE OneToOne 1 100 0.00 255.0 FORMAT "%5.1" ECU_ADDRESS 0x6000B81E /end MEASUREMENT
/begin MEASUREMENT hdrpist_ctReIni10ms "ReIni counter for HDRPIST 10ms" UBYTE OneToOne 1 100 0.00 255.0 FORMAT "%5.1" ECU_ADDRESS 0x70002E6E /end MEASUREMENT
/begin MEASUREMENT HDRPSOL_ctInit "counter of check of initilization status of variable of function HDRPSOL" UWORD OneToOne 1 100 0.00 65535.00 FORMAT "%8.2" ECU_ADDRESS 0x600074A6 /end MEASUREMENT
/begin MEASUREMENT HEGOD_S2B1Simn_I.bFolwLR "Dynamics simulation lambda sensor 2, bank 1 / Flag slow-down simulation, follow-phase lean-rich" UBYTE B_TRUE 1 100 0.00 1.00000000000 BIT_MASK 0x1 FORMAT "%13.11" ECU_ADDRESS 0x50001968 /end MEASUREMENT
/begin MEASUREMENT HEGOD_S2B1Simn_I.bFolwRL "Dynamics simulation lambda sensor 2, bank 1 / Flag slow-down simulation, follow-phase rich-lean" UBYTE B_TRUE 1 100 0.00 1.00000000000 BIT_MASK 0x2 FORMAT "%13.11" ECU_ADDRESS 0x50001968 /end MEASUREMENT
/begin MEASUREMENT HEGOD_S2B1Simn_I.bHldLR "Dynamics simulation lambda sensor 2, bank 1 / Flag slow-down simulation, hold-phase lean-rich" UBYTE B_TRUE 1 100 0.00 1.00000000000 BIT_MASK 0x4 FORMAT "%13.11" ECU_ADDRESS 0x50001968 /end MEASUREMENT
/begin MEASUREMENT HEGOD_S2B1Simn_I.bHldRL "Dynamics simulation lambda sensor 2, bank 1 / Flag slow-down simulation, hold-phase rich-lean" UBYTE B_TRUE 1 100 0.00 1.00000000000 BIT_MASK 0x8 FORMAT "%13.11" ECU_ADDRESS 0x50001968 /end MEASUREMENT
/begin MEASUREMENT HEGOD_S2B1Simn_I.bVltgFall "Dynamics simulation lambda sensor 2, bank 1 / smoothed original signal decreasing" UBYTE B_TRUE 1 100 0.00 1.00000000000 BIT_MASK 0x10 FORMAT "%13.11" ECU_ADDRESS 0x50001968 /end MEASUREMENT
/begin MEASUREMENT HEGOD_S2B1Simn_I.bVltgRise "Dynamics simulation lambda sensor 2, bank 1 / smoothed original signal increasing" UBYTE B_TRUE 1 100 0.00 1.00000000000 BIT_MASK 0x20 FORMAT "%13.11" ECU_ADDRESS 0x50001968 /end MEASUREMENT
/begin MEASUREMENT HEGOD_S2B1Simn_I.tiHld "Dynamics simulation lambda sensor 2, bank 1 / the delay time from rich to lean for the asymmetric fault" UWORD t_q0p01 1 100 0.00 655.3500 FORMAT "%8.4" ECU_ADDRESS 0x5000196A /end MEASUREMENT
/begin MEASUREMENT HEGOD_S2B1Simn_I.uWiSimnHiRes "Dynamics simulation lambda sensor 2, bank 1 / Voltage of sensor with dynamics simulation, high resolution" UWORD spg_q1p221Em3_V 1 100 0.00 4.998779 FORMAT "%8.6" ECU_ADDRESS 0x5000196C /end MEASUREMENT
/begin MEASUREMENT HEGOD_S2B1Simn_I.uWoSimnFltHiRes "Dynamics simulation lambda sensor 2, bank 1 / Voltage of sensor with dynamics simulation, high resolution" UWORD spg_q1p221Em3_V 1 100 0.00 4.998779 FORMAT "%8.6" ECU_ADDRESS 0x5000196E /end MEASUREMENT
/begin MEASUREMENT HEGOD_S2B1Simn_I.DlyTtOpt_I.buffer "Dynamics simulation lambda sensor 2, bank 1 / DlyTtOpt_I / buffer" UWORD spg_q1p221Em3_V 1 100 0.00 4.998779 FORMAT "%8.6" ARRAY_SIZE 21 ECU_ADDRESS 0x50001970 /end MEASUREMENT
/begin MEASUREMENT HEGOD_S2B1Simn_I.DlyTtOpt_I.counter "Dynamics simulation lambda sensor 2, bank 1 / DlyTtOpt_I / counter" UWORD fak_uw_b2 1 100 0.00 1.000000 FORMAT "%8.6" ECU_ADDRESS 0x5000199A /end MEASUREMENT
/begin MEASUREMENT HEGOD_S2B1Simn_I.DlyTtOpt_I.ds "Dynamics simulation lambda sensor 2, bank 1 / DlyTtOpt_I / ds" UWORD fak_uw_b2 1 100 0.00 1.000000 FORMAT "%8.6" ECU_ADDRESS 0x5000199C /end MEASUREMENT
/begin MEASUREMENT HEGOD_S2B1Simn_I.DlyTtOpt_I.pointer "Dynamics simulation lambda sensor 2, bank 1 / DlyTtOpt_I / pointer" UBYTE dez 1 100 0.00 255.0 FORMAT "%5.1" ECU_ADDRESS 0x5000199E /end MEASUREMENT
/begin MEASUREMENT HEGOD_S2B1Simn_I.FolwSimnHiResLT_I.memory "Dynamics simulation lambda sensor 2, bank 1 / Low pass filter: dynamic simulation, high resolution / current lowpass value" ULONG spg_q1p8626Em8_V 1 100 0.00 4.99999998137 FORMAT "%13.11" ECU_ADDRESS 0x500019A0 /end MEASUREMENT
/begin MEASUREMENT HEGOD_S2B1Simn_I.VltFltHiResLT_I.memory "Dynamics simulation lambda sensor 2, bank 1 / Low pass filter: dynamic simulation, high resolution / current lowpass value" ULONG spg_q1p8626Em8_V 1 100 0.00 4.99999998137 FORMAT "%13.11" ECU_ADDRESS 0x500019A4 /end MEASUREMENT
/begin MEASUREMENT HEGOD_S2B1Simn_I.VltgFallER_I.buffer "Dynamics simulation lambda sensor 2, bank 1 / Edgerising: Voltage fall detected / rising edge detected" UBYTE B_TRUE 1 100 0.00 1.00000000000 BIT_MASK 0x1 FORMAT "%13.11" ECU_ADDRESS 0x500019A8 /end MEASUREMENT
/begin MEASUREMENT HEGOD_S2B1Simn_I.VltgFallER_I.oldSignal "Dynamics simulation lambda sensor 2, bank 1 / Edgerising: Voltage fall detected / flag rising edge" UBYTE B_TRUE 1 100 0.00 1.00000000000 BIT_MASK 0x1 FORMAT "%13.11" ECU_ADDRESS 0x500019A9 /end MEASUREMENT
/begin MEASUREMENT HEGOD_S2B1Simn_I.VltgRiseER_I.buffer "Dynamics simulation lambda sensor 2, bank 1 / Edrising: Rising voltage detected / rising edge detected" UBYTE B_TRUE 1 100 0.00 1.00000000000 BIT_MASK 0x1 FORMAT "%13.11" ECU_ADDRESS 0x500019AA /end MEASUREMENT
/begin MEASUREMENT HEGOD_S2B1Simn_I.VltgRiseER_I.oldSignal "Dynamics simulation lambda sensor 2, bank 1 / Edrising: Rising voltage detected / flag rising edge" UBYTE B_TRUE 1 100 0.00 1.00000000000 BIT_MASK 0x1 FORMAT "%13.11" ECU_ADDRESS 0x500019AB /end MEASUREMENT
/begin MEASUREMENT HEGOD_S2B1Simn_I.bFolwLRER_I.buffer "Dynamics simulation lambda sensor 2, bank 1 / Edgerising: Flag slow-down simulation, follow-phase lean-rich / rising edge detected" UBYTE B_TRUE 1 100 0.00 1.00000000000 BIT_MASK 0x1 FORMAT "%13.11" ECU_ADDRESS 0x500019AC /end MEASUREMENT
/begin MEASUREMENT HEGOD_S2B1Simn_I.bFolwLRER_I.oldSignal "Dynamics simulation lambda sensor 2, bank 1 / Edgerising: Flag slow-down simulation, follow-phase lean-rich / flag rising edge" UBYTE B_TRUE 1 100 0.00 1.00000000000 BIT_MASK 0x1 FORMAT "%13.11" ECU_ADDRESS 0x500019AD /end MEASUREMENT
/begin MEASUREMENT HEGOD_S2B1Simn_I.bFolwRLER_I.buffer "Dynamics simulation lambda sensor 2, bank 1 / Edgerising: Flag slow-down simulation, follow-phase rich-lean / rising edge detected" UBYTE B_TRUE 1 100 0.00 1.00000000000 BIT_MASK 0x1 FORMAT "%13.11" ECU_ADDRESS 0x500019AE /end MEASUREMENT
/begin MEASUREMENT HEGOD_S2B1Simn_I.bFolwRLER_I.oldSignal "Dynamics simulation lambda sensor 2, bank 1 / Edgerising: Flag slow-down simulation, follow-phase rich-lean / flag rising edge" UBYTE B_TRUE 1 100 0.00 1.00000000000 BIT_MASK 0x1 FORMAT "%13.11" ECU_ADDRESS 0x500019AF /end MEASUREMENT
/begin MEASUREMENT HEGOD_S2B1Simn_I.bHldLRER_I.buffer "Dynamics simulation lambda sensor 2, bank 1 / Edgerising: Flag slow-down simulation, hold-phase lean-rich / rising edge detected" UBYTE B_TRUE 1 100 0.00 1.00000000000 BIT_MASK 0x1 FORMAT "%13.11" ECU_ADDRESS 0x500019B0 /end MEASUREMENT
/begin MEASUREMENT HEGOD_S2B1Simn_I.bHldLRER_I.oldSignal "Dynamics simulation lambda sensor 2, bank 1 / Edgerising: Flag slow-down simulation, hold-phase lean-rich / flag rising edge" UBYTE B_TRUE 1 100 0.00 1.00000000000 BIT_MASK 0x1 FORMAT "%13.11" ECU_ADDRESS 0x500019B1 /end MEASUREMENT
/begin MEASUREMENT HEGOD_S2B1Simn_I.bHldRLER_I.buffer "Dynamics simulation lambda sensor 2, bank 1 / Edgerising: Flag slow-down simulation, hold-phase rich-lean / rising edge detected" UBYTE B_TRUE 1 100 0.00 1.00000000000 BIT_MASK 0x1 FORMAT "%13.11" ECU_ADDRESS 0x500019B2 /end MEASUREMENT
/begin MEASUREMENT HEGOD_S2B1Simn_I.bHldRLER_I.oldSignal "Dynamics simulation lambda sensor 2, bank 1 / Edgerising: Flag slow-down simulation, hold-phase rich-lean / flag rising edge" UBYTE B_TRUE 1 100 0.00 1.00000000000 BIT_MASK 0x1 FORMAT "%13.11" ECU_ADDRESS 0x500019B3 /end MEASUREMENT
/begin MEASUREMENT HEGO_bS2B1HtgEna "Bit heating enabled, HEGO sensor 2, bank 1" UBYTE B_TRUE 1 100 0.00 1.00000000000 BIT_MASK 0x1 FORMAT "%13.11" ECU_ADDRESS 0x700008E0 /end MEASUREMENT
/begin MEASUREMENT HEGO_bS2B1HtgOffTiImpsMem "Bit heating off due to implausible heater timing, HEGO sensor 2 bank 1" UBYTE B_TRUE 1 100 0.00 1.00000000000 BIT_MASK 0x1 FORMAT "%13.11" ECU_ADDRESS 0x70000230 /end MEASUREMENT
/begin MEASUREMENT HEGO_bS2B1HtgOn "Bit heating on, HEGO sensor 2 bank 1" UBYTE B_TRUE 1 100 0.00 1.00000000000 BIT_MASK 0x1 FORMAT "%13.11" ECU_ADDRESS 0x700008DF /end MEASUREMENT
/begin MEASUREMENT HEGO_bS2B1HtgPrtFin "Bit protective heating finished, HEGO sensor 2 bank 1" UBYTE B_TRUE 1 100 0.00 1.00000000000 BIT_MASK 0x1 FORMAT "%13.11" ECU_ADDRESS 0x700008DE /end MEASUREMENT
/begin MEASUREMENT HEGO_bS2B1HtgRiReq "Bit Ri measurement request for closed loop heater control, HEGO sensor 2 bank 1" UBYTE B_TRUE 1 100 0.00 1.00000000000 BIT_MASK 0x1 FORMAT "%13.11" ECU_ADDRESS 0x700008DD /end MEASUREMENT
/begin MEASUREMENT HEGO_bS2B1HtgStrt "Bit heating during start phase, HEGO sensor 2 bank 1" UBYTE B_TRUE 1 100 0.00 1.00000000000 BIT_MASK 0x1 FORMAT "%13.11" ECU_ADDRESS 0x700008DC /end MEASUREMENT
/begin MEASUREMENT HEGO_bS2B1HtgSuff "Bit sufficient heating, HEGO sensor 2 bank 1" UBYTE B_TRUE 1 100 0.00 1.00000000000 BIT_MASK 0x1 FORMAT "%13.11" ECU_ADDRESS 0x700008DB /end MEASUREMENT
/begin MEASUREMENT HEGO_flgHtgClsdLopEnaS2B1 "Condition closed loop heater control enabled for sensor 2 bank 1" UBYTE B_TRUE 1 100 0.00 1.00000000000 BIT_MASK 0x1 FORMAT "%13.11" ECU_ADDRESS 0x700008C9 /end MEASUREMENT
/begin MEASUREMENT HEGO_flgS2B1HtgOnDes "Desired condition for Heaer ON is set for Sensor 2 bank 1" UBYTE B_TRUE 1 100 0.00 1.00000000000 BIT_MASK 0x1 FORMAT "%13.11" ECU_ADDRESS 0x7000022F /end MEASUREMENT
/begin MEASUREMENT HEGO_flgS2B1InhbRiMeasmtElDiag "flag for inhibit of Ri measurement S2B1 during heater OFF state for voltage acquisition for ElecMax diagnosis." UBYTE B_TRUE 1 100 0.00 1.00000000000 BIT_MASK 0x1 FORMAT "%13.11" ECU_ADDRESS 0x700008C4 /end MEASUREMENT
/begin MEASUREMENT HEGO_HtgEnaS2B1_I.bEngStrtFinFF "Enable conditions for heating sensor 2 bank 1 / Bit enginge start finished (flip-flop)" UBYTE B_TRUE 1 100 0.00 1.00000000000 BIT_MASK 0x1 FORMAT "%13.11" ECU_ADDRESS 0x6000749A /end MEASUREMENT
/begin MEASUREMENT HEGO_HtgEnaS2B1_I.bHtgEna "Enable conditions for heating sensor 2 bank 1 / Bit heating enabled" UBYTE B_TRUE 1 100 0.00 1.00000000000 BIT_MASK 0x1 FORMAT "%13.11" ECU_ADDRESS 0x6000749B /end MEASUREMENT
/begin MEASUREMENT HEGO_HtgEnaS2B1_I.flgPhysEna "Enable conditions for heating sensor 2 bank 1 / Flag heating release by physical conditions" UBYTE B_TRUE 1 100 0.00 1.00000000000 BIT_MASK 0x1 FORMAT "%13.11" ECU_ADDRESS 0x6000749C /end MEASUREMENT
/begin MEASUREMENT HEGO_HtgEnaS2B1_I.BattHtgOffTONV_I.outbit "Enable conditions for heating sensor 2 bank 1 / Delay for heater turn-off in case of too high battery voltage / return value" UBYTE B_TRUE 1 100 0.00 1.00000000000 BIT_MASK 0x1 FORMAT "%13.11" ECU_ADDRESS 0x6000749E /end MEASUREMENT
/begin MEASUREMENT HEGO_HtgEnaS2B1_I.BattHtgOffTONV_I.time "Enable conditions for heating sensor 2 bank 1 / Delay for heater turn-off in case of too high battery voltage / expired delay time" UBYTE t_q0p1 1 100 0.00 25.50 FORMAT "%5.2" ECU_ADDRESS 0x6000749F /end MEASUREMENT
/begin MEASUREMENT HEGO_HtgEnaS2B1_I.DebHtgPreDriveTOFFV_I.outbit "Enable conditions for heating sensor 2 bank 1 / Debouncing of HEGO sensor heating during predrive / Output Bit" UBYTE B_TRUE 1 100 0.00 1.00000000000 BIT_MASK 0x1 FORMAT "%13.11" ECU_ADDRESS 0x600074A0 /end MEASUREMENT
/begin MEASUREMENT HEGO_HtgEnaS2B1_I.DebHtgPreDriveTOFFV_I.time "Enable conditions for heating sensor 2 bank 1 / Debouncing of HEGO sensor heating during predrive / Occured Time" UWORD t_q0p1 1 100 0.00 6553.500 FORMAT "%8.3" ECU_ADDRESS 0x600074A2 /end MEASUREMENT
/begin MEASUREMENT HEGO_HtgS2B1_I.bDebHtgStrt "Heating, HEGO sensor 2 bank 1 / Bit condition for heating during start phase debounced" UBYTE B_TRUE 1 100 0.00 1.00000000000 BIT_MASK 0x1 FORMAT "%13.11" ECU_ADDRESS 0x600392A4 /end MEASUREMENT
/begin MEASUREMENT HEGO_HtgS2B1_I.bHtgClsdLopAntiWndUp "Heating, HEGO sensor 2 bank 1 / Bit anti wind up of for closed loop heating control" UBYTE B_TRUE 1 100 0.00 1.00000000000 BIT_MASK 0x1 FORMAT "%13.11" ECU_ADDRESS 0x500019B4 /end MEASUREMENT
/begin MEASUREMENT HEGO_HtgS2B1_I.bHtgClsdLopEna "Heating, HEGO sensor 2 bank 1 / Bit enable closed loop heating control" UBYTE B_TRUE 1 100 0.00 1.00000000000 BIT_MASK 0x1 FORMAT "%13.11" ECU_ADDRESS 0x500019B6 /end MEASUREMENT
/begin MEASUREMENT HEGO_HtgS2B1_I.bHtgClsdLopRiReq "Heating, HEGO sensor 2 bank 1 / Bit Ri request from closed loop heating control" UBYTE B_TRUE 1 100 0.00 1.00000000000 BIT_MASK 0x4 FORMAT "%13.11" ECU_ADDRESS 0x500019B5 /end MEASUREMENT
/begin MEASUREMENT HEGO_HtgS2B1_I.bHtgEna "Heating, HEGO sensor 2 bank 1 / Flag heating released" UBYTE B_TRUE 1 100 0.00 1.00000000000 BIT_MASK 0x1 FORMAT "%13.11" ECU_ADDRESS 0x6000B818 /end MEASUREMENT
/begin MEASUREMENT HEGO_HtgS2B1_I.bHtgMap "Heating, HEGO sensor 2 bank 1 / Bit map controlled heating" UBYTE B_TRUE 1 100 0.00 1.00000000000 BIT_MASK 0x2 FORMAT "%13.11" ECU_ADDRESS 0x500019B4 /end MEASUREMENT
/begin MEASUREMENT HEGO_HtgS2B1_I.bHtgOffHiTemp "Heating, HEGO sensor 2 bank 1 / Bit heating turned of because of too high temperature" UBYTE B_TRUE 1 100 0.00 1.00000000000 BIT_MASK 0x4 FORMAT "%13.11" ECU_ADDRESS 0x500019B4 /end MEASUREMENT
/begin MEASUREMENT HEGO_HtgS2B1_I.bHtgPrtFin "Heating, HEGO sensor 2 bank 1 / Bit protective heating finisihed" UBYTE B_TRUE 1 100 0.00 1.00000000000 BIT_MASK 0x8 FORMAT "%13.11" ECU_ADDRESS 0x500019B5 /end MEASUREMENT
/begin MEASUREMENT HEGO_HtgS2B1_I.bHtgPrtInhb "Heating, HEGO sensor 2 bank 1 / Bit protective heating inhibited" UBYTE B_TRUE 1 100 0.00 1.00000000000 BIT_MASK 0x10 FORMAT "%13.11" ECU_ADDRESS 0x500019B5 /end MEASUREMENT
/begin MEASUREMENT HEGO_HtgS2B1_I.bHtgStrt "Heating, HEGO sensor 2 bank 1 / Bit heating during start phase" UBYTE B_TRUE 1 100 0.00 1.00000000000 BIT_MASK 0x1 FORMAT "%13.11" ECU_ADDRESS 0x500019B7 /end MEASUREMENT
/begin MEASUREMENT HEGO_HtgS2B1_I.bHtgStrtInhb "Heating, HEGO sensor 2 bank 1 / Bit heating during start phase inhibited" UBYTE B_TRUE 1 100 0.00 1.00000000000 BIT_MASK 0x20 FORMAT "%13.11" ECU_ADDRESS 0x500019B5 /end MEASUREMENT
/begin MEASUREMENT HEGO_HtgS2B1_I.bHtgStrtPwrRed "Heating, HEGO sensor 2 bank 1 / Bit reduced heating power during start phase" UBYTE B_TRUE 1 100 0.00 1.00000000000 BIT_MASK 0x8 FORMAT "%13.11" ECU_ADDRESS 0x500019B4 /end MEASUREMENT
/begin MEASUREMENT HEGO_HtgS2B1_I.bHtgSuff "Heating, HEGO sensor 2 bank 1 / Bit sufficient heating" UBYTE B_TRUE 1 100 0.00 1.00000000000 BIT_MASK 0x1 FORMAT "%13.11" ECU_ADDRESS 0x500019B8 /end MEASUREMENT
/begin MEASUREMENT HEGO_HtgS2B1_I.bRiActAvl "Heating, HEGO sensor 2 bank 1 / Actual Ri value available" UBYTE B_TRUE 1 100 0.00 1.00000000000 BIT_MASK 0x80 FORMAT "%13.11" ECU_ADDRESS 0x500019B5 /end MEASUREMENT
/begin MEASUREMENT HEGO_HtgS2B1_I.cycHtgCntr "Heating, HEGO sensor 2 bank 1 / Counter of remaining heating cycles in heating period" UBYTE dez 1 100 0.00 250.0 FORMAT "%5.1" ECU_ADDRESS 0x50000280 /end MEASUREMENT
/begin MEASUREMENT HEGO_HtgS2B1_I.dresRi "Heating, HEGO sensor 2 bank 1 / Internal resistance difference for closed loop heating controller" SWORD r_uw_q2 1 100 -65536.00 65534.00 FORMAT "%8.2" ECU_ADDRESS 0x500019BA /end MEASUREMENT
/begin MEASUREMENT HEGO_HtgS2B1_I.duNomHtgClsdLop "Heating, HEGO sensor 2 bank 1 / Nominal heating voltage correction of closed loop heating control" SWORD spg_q0p00039 1 100 -12.80000 12.79961 FORMAT "%8.5" ECU_ADDRESS 0x500019BC /end MEASUREMENT
/begin MEASUREMENT HEGO_HtgS2B1_I.duNomHtgI "Heating, HEGO sensor 2 bank 1 / Nominal heating voltage correction of closed loop heating control, I-part" SWORD spg_q0p00039 1 100 -12.80000 12.79961 FORMAT "%8.5" ECU_ADDRESS 0x500019BE /end MEASUREMENT
/begin MEASUREMENT HEGO_HtgS2B1_I.duNomHtgP "Heating, HEGO sensor 2 bank 1 / Nominal heating voltage correction of closed loop heating control, P-part" SWORD spg_q0p00039 1 100 -12.80000 12.79961 FORMAT "%8.5" ECU_ADDRESS 0x500019C0 /end MEASUREMENT
/begin MEASUREMENT HEGO_HtgS2B1_I.flgHtgOnReq "Heating, HEGO sensor 2 bank 1 / Flag heating on request" UBYTE B_TRUE 1 100 0.00 1.00000000000 BIT_MASK 0x1 FORMAT "%13.11" ECU_ADDRESS 0x50000281 /end MEASUREMENT
/begin MEASUREMENT HEGO_HtgS2B1_I.flgInhbRiElecMax "Heating, HEGO sensor 2 bank 1 / flag for inhibit of Ri measurement during heater OFF state for voltage acquisition for ElecMax diagnosis." UBYTE B_TRUE 1 100 0.00 1.00000000000 BIT_MASK 0x1 FORMAT "%13.11" ECU_ADDRESS 0x50000282 /end MEASUREMENT
/begin MEASUREMENT HEGO_HtgS2B1_I.flgRiHtgStrtPwrRed "Heating, HEGO sensor 2 bank 1 / Flag to start heating power reduction based of sensor resistance treshold" UBYTE B_TRUE 1 100 0.00 1.00000000000 BIT_MASK 0x40 FORMAT "%13.11" ECU_ADDRESS 0x500019B4 /end MEASUREMENT
/begin MEASUREMENT HEGO_HtgS2B1_I.mEGHtg "Heating, HEGO sensor 2 bank 1 / Exhaust gass mass flow for sensor heating" UWORD m_uw_b6553p5 1 100 0.00 6553.500 FORMAT "%8.3" ECU_ADDRESS 0x500019C2 /end MEASUREMENT
/begin MEASUREMENT HEGO_HtgS2B1_I.numHtgCycDif "Heating, HEGO sensor 2 bank 1 / Difference between number of heating on cycles setpoint and actual value" UWORD fak_q3p906Em5 1 100 0.00 2.559961 FORMAT "%8.6" ECU_ADDRESS 0x50000284 /end MEASUREMENT
/begin MEASUREMENT HEGO_HtgS2B1_I.numHtgCycOffReq "Heating, HEGO sensor 2 bank 1 / Requested number of heating off cycles in heating period" UBYTE dez 1 100 0.00 250.0 FORMAT "%5.1" ECU_ADDRESS 0x50000286 /end MEASUREMENT
/begin MEASUREMENT HEGO_HtgS2B1_I.numHtgCycOnReq "Heating, HEGO sensor 2 bank 1 / Requested number of heating on cycles in heating period" UBYTE dez 1 100 0.00 250.0 FORMAT "%5.1" ECU_ADDRESS 0x50000287 /end MEASUREMENT
/begin MEASUREMENT HEGO_HtgS2B1_I.numVoltMeasmtElecMaxPrev "Heating, HEGO sensor 2 bank 1 / lalst value of numVoltMeasmtElecMax for indication of new voltage measurement for ElecMax diagnosis" UBYTE dez 1 100 0.00 255.0 FORMAT "%5.1" ECU_ADDRESS 0x50000288 /end MEASUREMENT
/begin MEASUREMENT HEGO_HtgS2B1_I.pwrHtg "Heating, HEGO sensor 2 bank 1 / Normalized heating power" UBYTE fak_q0p01 1 100 0.00 2.550 FORMAT "%5.3" ECU_ADDRESS 0x500019C4 /end MEASUREMENT
/begin MEASUREMENT HEGO_HtgS2B1_I.pwrHtgOnRls "Heating, HEGO sensor 2 bank 1 / Normalized heating power with released heating" UBYTE fak_q0p01 1 100 0.00 2.550 FORMAT "%5.3" ECU_ADDRESS 0x500019C5 /end MEASUREMENT
/begin MEASUREMENT HEGO_HtgS2B1_I.rHtg "Heating, HEGO sensor 2 bank 1 / Sensor heating duty ratio" UWORD fak_q3p906Em5 1 100 0.00 2.559961 FORMAT "%8.6" ECU_ADDRESS 0x500019C6 /end MEASUREMENT
/begin MEASUREMENT HEGO_HtgS2B1_I.rHtgLim "Heating, HEGO sensor 2 bank 1 / Sensor limited heating duty ratio" UWORD fak_q3p906Em5 1 100 0.00 1.000000 FORMAT "%8.6" ECU_ADDRESS 0x500019C8 /end MEASUREMENT
/begin MEASUREMENT HEGO_HtgS2B1_I.resRiAct "Heating, HEGO sensor 2 bank 1 / Actual internal resistance" UWORD r_uw_q2 1 100 0.00 131070.0 FORMAT "%8.1" ECU_ADDRESS 0x500019CA /end MEASUREMENT
/begin MEASUREMENT HEGO_HtgS2B1_I.resRiNom "Heating, HEGO sensor 2 bank 1 / Nominal internal resistance" SWORD r_uw_q2 1 100 -65536.00 65534.00 FORMAT "%8.2" ECU_ADDRESS 0x500019CC /end MEASUREMENT
/begin MEASUREMENT HEGO_HtgS2B1_I.tEGFltHtg "Heating, HEGO sensor 2 bank 1 / Filtered exhaust gas temperature for sensor heating" UWORD temp_q0p0234_o273 1 100 -273.150 1262.827 FORMAT "%8.3" ECU_ADDRESS 0x500019CE /end MEASUREMENT
/begin MEASUREMENT HEGO_HtgS2B1_I.tEg "Heating, HEGO sensor 2 bank 1 / Exhaust gas temperature at lambda sensor" UWORD temp_q0p0234_o273 1 100 -273.150 1262.827 FORMAT "%8.3" ECU_ADDRESS 0x500019D0 /end MEASUREMENT
/begin MEASUREMENT HEGO_HtgS2B1_I.tExhSnsrDyn "Heating, HEGO sensor 2 bank 1 / exhasut temperature gradient at sensor position" SWORD temp_q0p0234_o273 1 100 -1041.150 494.827 FORMAT "%8.3" ECU_ADDRESS 0x500019D2 /end MEASUREMENT
/begin MEASUREMENT HEGO_HtgS2B1_I.tiFilTExhSn "Heating, HEGO sensor 2 bank 1 / filter time constant of low pass exhaust gas temperature filter" UWORD zk100msxs_uw_b6553p6 1 100 0.1000015 6553.6000000 FORMAT "%12.7" ECU_ADDRESS 0x500019D4 /end MEASUREMENT
/begin MEASUREMENT HEGO_HtgS2B1_I.tiHtgOn "Heating, HEGO sensor 2 bank 1 / Heater on-time" UBYTE t_q0p001 1 100 0.00 0.2550 FORMAT "%6.4" ECU_ADDRESS 0x500019D6 /end MEASUREMENT
/begin MEASUREMENT HEGO_HtgS2B1_I.tiHtgPrt "Heating, HEGO sensor 2 bank 1 / Duration of protective heating" UWORD t_q0p1 1 100 0.00 6553.500 FORMAT "%8.3" ECU_ADDRESS 0x500019D8 /end MEASUREMENT
/begin MEASUREMENT HEGO_HtgS2B1_I.uBattHtg "Heating, HEGO sensor 2 bank 1 / Corrected battery voltage for sensor heating" UWORD spg_q0p00039 1 100 0.00 25.59961 FORMAT "%8.5" ECU_ADDRESS 0x500019DA /end MEASUREMENT
/begin MEASUREMENT HEGO_HtgS2B1_I.uNomHtg "Heating, HEGO sensor 2 bank 1 / Nominal heating voltage" UWORD spg_q0p00039 1 100 0.00 25.59961 FORMAT "%8.5" ECU_ADDRESS 0x500019DC /end MEASUREMENT
/begin MEASUREMENT HEGO_HtgS2B1_I.uNomHtgAftPrt "Heating, HEGO sensor 2 bank 1 / Nominal heating voltage after protective heating" UWORD spg_q0p00039 1 100 0.00 25.59961 FORMAT "%8.5" ECU_ADDRESS 0x500019DE /end MEASUREMENT
/begin MEASUREMENT HEGO_HtgS2B1_I.uNomHtgLim "Heating, HEGO sensor 2 bank 1 / Limited nominal heating voltage" UWORD spg_q0p00039 1 100 0.00 25.59961 FORMAT "%8.5" ECU_ADDRESS 0x500019E0 /end MEASUREMENT
/begin MEASUREMENT HEGO_HtgS2B1_I.uNomHtgMap "Heating, HEGO sensor 2 bank 1 / Nominal heating voltage during open loop control (map)" UWORD spg_q0p00039 1 100 0.00 25.59961 FORMAT "%8.5" ECU_ADDRESS 0x500019E2 /end MEASUREMENT
/begin MEASUREMENT HEGO_HtgS2B1_I.uNomHtgNoLim "Heating, HEGO sensor 2 bank 1 / Nominal heating voltage without limiting" UWORD spg_q0p00039 1 100 0.00 25.59961 FORMAT "%8.5" ECU_ADDRESS 0x500019E4 /end MEASUREMENT
/begin MEASUREMENT HEGO_HtgS2B1_I.uNomHtgStrt "Heating, HEGO sensor 2 bank 1 / Nominal heating voltage during start phase" UWORD spg_q0p00039 1 100 0.00 25.59961 FORMAT "%8.5" ECU_ADDRESS 0x500019E6 /end MEASUREMENT
/begin MEASUREMENT HEGO_HtgS2B1_I.DebAtmstTONV_I.outbit "Heating, HEGO sensor 2 bank 1 / TONV: Debounced condition sensor temperature calculated from dew-point / return value" UBYTE B_TRUE 1 100 0.00 1.00000000000 BIT_MASK 0x1 FORMAT "%13.11" ECU_ADDRESS 0x500019E8 /end MEASUREMENT
/begin MEASUREMENT HEGO_HtgS2B1_I.DebAtmstTONV_I.time "Heating, HEGO sensor 2 bank 1 / TONV: Debounced condition sensor temperature calculated from dew-point / expired delay time" UWORD t_q0p1 1 100 0.00 6553.500 FORMAT "%8.3" ECU_ADDRESS 0x500019EA /end MEASUREMENT
/begin MEASUREMENT HEGO_HtgS2B1_I.DebHeatgStrtTONV_I.outbit "Heating, HEGO sensor 2 bank 1 / TONV: Condition for heating during start phase / return value" UBYTE B_TRUE 1 100 0.00 1.00000000000 BIT_MASK 0x1 FORMAT "%13.11" ECU_ADDRESS 0x500019EC /end MEASUREMENT
/begin MEASUREMENT HEGO_HtgS2B1_I.DebHeatgStrtTONV_I.time "Heating, HEGO sensor 2 bank 1 / TONV: Condition for heating during start phase / expired delay time" UWORD t_q0p1 1 100 0.00 6553.500 FORMAT "%8.3" ECU_ADDRESS 0x500019EE /end MEASUREMENT
/begin MEASUREMENT HEGO_HtgS2B1_I.DebHtgMapClsdLopTONV_I.outbit "Heating, HEGO sensor 2 bank 1 / Debouncing for activation of closed loop heating control / return value" UBYTE B_TRUE 1 100 0.00 1.00000000000 BIT_MASK 0x1 FORMAT "%13.11" ECU_ADDRESS 0x500019F0 /end MEASUREMENT
/begin MEASUREMENT HEGO_HtgS2B1_I.DebHtgMapClsdLopTONV_I.time "Heating, HEGO sensor 2 bank 1 / Debouncing for activation of closed loop heating control / expired delay time" UWORD t_q0p1 1 100 0.00 6553.500 FORMAT "%8.3" ECU_ADDRESS 0x500019F2 /end MEASUREMENT
/begin MEASUREMENT HEGO_HtgS2B1_I.DebHtgMaxTOFFV_I.outbit "Heating, HEGO sensor 2 bank 1 / Debouncing of heating with maximum allowable power / Output Bit" UBYTE B_TRUE 1 100 0.00 1.00000000000 BIT_MASK 0x1 FORMAT "%13.11" ECU_ADDRESS 0x500019F4 /end MEASUREMENT
/begin MEASUREMENT HEGO_HtgS2B1_I.DebHtgMaxTOFFV_I.time "Heating, HEGO sensor 2 bank 1 / Debouncing of heating with maximum allowable power / Occured Time" UWORD t_q0p1 1 100 0.00 6553.500 FORMAT "%8.3" ECU_ADDRESS 0x500019F6 /end MEASUREMENT
/begin MEASUREMENT HEGO_HtgS2B1_I.DebHtgStrtUsTONV_I.outbit "Heating, HEGO sensor 2 bank 1 / Debouncing of heating during start phase depending on upstream sensor / return value" UBYTE B_TRUE 1 100 0.00 1.00000000000 BIT_MASK 0x1 FORMAT "%13.11" ECU_ADDRESS 0x500019FA /end MEASUREMENT
/begin MEASUREMENT HEGO_HtgS2B1_I.DebHtgStrtUsTONV_I.time "Heating, HEGO sensor 2 bank 1 / Debouncing of heating during start phase depending on upstream sensor / expired delay time" UBYTE t_q0p1 1 100 0.00 25.50 FORMAT "%5.2" ECU_ADDRESS 0x500019FB /end MEASUREMENT
/begin MEASUREMENT HEGO_HtgS2B1_I.DebNewRiAvlTOFFV_I.outbit "Heating, HEGO sensor 2 bank 1 / TOFFV: Debounced new internal resistance value availble / Output Bit" UBYTE B_TRUE 1 100 0.00 1.00000000000 BIT_MASK 0x1 FORMAT "%13.11" ECU_ADDRESS 0x500019FC /end MEASUREMENT
/begin MEASUREMENT HEGO_HtgS2B1_I.DebNewRiAvlTOFFV_I.time "Heating, HEGO sensor 2 bank 1 / TOFFV: Debounced new internal resistance value availble / Occured Time" UWORD t_q0p1 1 100 0.00 6553.500 FORMAT "%8.3" ECU_ADDRESS 0x500019FE /end MEASUREMENT
/begin MEASUREMENT HEGO_HtgS2B1_I.DebNewRiTOFFV_I.outbit "Heating, HEGO sensor 2 bank 1 / Debounce for new internal resistance request / Output Bit" UBYTE B_TRUE 1 100 0.00 1.00000000000 BIT_MASK 0x1 FORMAT "%13.11" ECU_ADDRESS 0x50001A00 /end MEASUREMENT
/begin MEASUREMENT HEGO_HtgS2B1_I.DebNewRiTOFFV_I.time "Heating, HEGO sensor 2 bank 1 / Debounce for new internal resistance request / Occured Time" UWORD t_q0p1 1 100 0.00 6553.500 FORMAT "%8.3" ECU_ADDRESS 0x50001A02 /end MEASUREMENT
/begin MEASUREMENT HEGO_HtgS2B1_I.DebRiActAvlTOFFV_I.outbit "Heating, HEGO sensor 2 bank 1 / Debouncing for internal resistance actual available / Output Bit" UBYTE B_TRUE 1 100 0.00 1.00000000000 BIT_MASK 0x1 FORMAT "%13.11" ECU_ADDRESS 0x50001A04 /end MEASUREMENT
/begin MEASUREMENT HEGO_HtgS2B1_I.DebRiActAvlTOFFV_I.time "Heating, HEGO sensor 2 bank 1 / Debouncing for internal resistance actual available / Occured Time" UBYTE t_q0p1 1 100 0.00 25.50 FORMAT "%5.2" ECU_ADDRESS 0x50001A05 /end MEASUREMENT
/begin MEASUREMENT HEGO_HtgS2B1_I.HtgRedTONV_I.outbit "Heating, HEGO sensor 2 bank 1 / Delay until reduction of heating power / return value" UBYTE B_TRUE 1 100 0.00 1.00000000000 BIT_MASK 0x1 FORMAT "%13.11" ECU_ADDRESS 0x50001A06 /end MEASUREMENT
/begin MEASUREMENT HEGO_HtgS2B1_I.HtgRedTONV_I.time "Heating, HEGO sensor 2 bank 1 / Delay until reduction of heating power / expired delay time" UWORD t_q0p1 1 100 0.00 6553.500 FORMAT "%8.3" ECU_ADDRESS 0x50001A08 /end MEASUREMENT
/begin MEASUREMENT HEGO_HtgS2B1_I.RiHtgLT_I.memory "Heating, HEGO sensor 2 bank 1 / Filtered internal resistance for heating / current lowpass value" ULONG r_q3p0518Em5 1 100 0.00 131071.999969 FORMAT "%13.6" ECU_ADDRESS 0x50001A0C /end MEASUREMENT
/begin MEASUREMENT HEGO_HtgS2B1_I.bHtgStrtEF_I.buffer "Heating, HEGO sensor 2 bank 1 / Falling edge of bHtgStrt / memory to detect falling edge" UBYTE B_TRUE 1 100 0.00 1.00000000000 BIT_MASK 0x1 FORMAT "%13.11" ECU_ADDRESS 0x50001A10 /end MEASUREMENT
/begin MEASUREMENT HEGO_HtgS2B1_I.bHtgStrtEF_I.oldSignal "Heating, HEGO sensor 2 bank 1 / Falling edge of bHtgStrt / memory to detect falling edge" UBYTE B_TRUE 1 100 0.00 1.00000000000 BIT_MASK 0x1 FORMAT "%13.11" ECU_ADDRESS 0x50001A11 /end MEASUREMENT
/begin MEASUREMENT HEGO_HtgS2B1_I.bHtgStrtPwrRedEF_I.buffer "Heating, HEGO sensor 2 bank 1 / Edge falling of bit heating start of power reduction / memory to detect falling edge" UBYTE B_TRUE 1 100 0.00 1.00000000000 BIT_MASK 0x1 FORMAT "%13.11" ECU_ADDRESS 0x50001A14 /end MEASUREMENT
/begin MEASUREMENT HEGO_HtgS2B1_I.bHtgStrtPwrRedEF_I.oldSignal "Heating, HEGO sensor 2 bank 1 / Edge falling of bit heating start of power reduction / memory to detect falling edge" UBYTE B_TRUE 1 100 0.00 1.00000000000 BIT_MASK 0x1 FORMAT "%13.11" ECU_ADDRESS 0x50001A15 /end MEASUREMENT
/begin MEASUREMENT HEGO_HtgS2B1_I.bRiActAvlER_I.buffer "Heating, HEGO sensor 2 bank 1 / Rising edge of bRiActAvl / rising edge detected" UBYTE B_TRUE 1 100 0.00 1.00000000000 BIT_MASK 0x1 FORMAT "%13.11" ECU_ADDRESS 0x50001A18 /end MEASUREMENT
/begin MEASUREMENT HEGO_HtgS2B1_I.bRiActAvlER_I.oldSignal "Heating, HEGO sensor 2 bank 1 / Rising edge of bRiActAvl / flag rising edge" UBYTE B_TRUE 1 100 0.00 1.00000000000 BIT_MASK 0x1 FORMAT "%13.11" ECU_ADDRESS 0x50001A19 /end MEASUREMENT
/begin MEASUREMENT HEGO_HtgS2B1_I.duNomHtgITL_I.memory "Heating, HEGO sensor 2 bank 1 / Nominal heating voltage correction of closed loop heating control, integrator / current integrator value" SLONG dez 1 100 -2147483648.00 2147483647.00 FORMAT "%13.2" ECU_ADDRESS 0x50001A1C /end MEASUREMENT
/begin MEASUREMENT HEGO_HtgS2B1_I.flgIntrptHeatgElDiagSW_I.timeCounter "Heating, HEGO sensor 2 bank 1 / stop watch i.o.t. guarantee interrupting heater for diagnosis each 500ms / expired time since start" UWORD t_q1_ms 1 100 0.00 65535.00 FORMAT "%8.2" ECU_ADDRESS 0x5000028A /end MEASUREMENT
/begin MEASUREMENT HEGO_HtgS2B1_I.tEGHtgLT_I.memory "Heating, HEGO sensor 2 bank 1 / Low-pass filter for exhaust gas temperature / current lowpass value" ULONG temp_q3p57Em7_om273 1 100 -273.15000000 1262.84999964 FORMAT "%13.8" ECU_ADDRESS 0x50001A20 /end MEASUREMENT
/begin MEASUREMENT HEGO_HtgS2B1_I.tExhSnsrLT_I.memory "Heating, HEGO sensor 2 bank 1 / Lowpass for exhaustgas temperature / current lowpass value" ULONG temp_q3p57Em7_om273 1 100 -273.15000000 1262.84999964 FORMAT "%13.8" ECU_ADDRESS 0x50001A24 /end MEASUREMENT
/begin MEASUREMENT HEGO_HtgS2B1_I.tiHtgPrtSW_I.timeCounter "Heating, HEGO sensor 2 bank 1 / Protective heating duration / expired time since start" UWORD t_q0p1 1 100 0.00 6553.500 FORMAT "%8.3" ECU_ADDRESS 0x50001A28 /end MEASUREMENT
/begin MEASUREMENT HEGO_HtgS2B1_I.uNomHtgStrtAL_I.memory "Heating, HEGO sensor 2 bank 1 / Nominal heating voltage during start phase / Accumulator" SLONG spg_q0p00039 1 100 -838860.800000 838860.799609 FORMAT "%13.6" ECU_ADDRESS 0x50001A2C /end MEASUREMENT
/begin MEASUREMENT HEGO_Htg_ctReIni "Counter for Re-Initialization request for HEGO_Htg" UBYTE OneToOne 1 100 0.00 255.0 FORMAT "%5.1" ECU_ADDRESS 0x6000B819 /end MEASUREMENT
/begin MEASUREMENT HEGO_pwrS2B1Htg "Normalized heating power, HEGO sensor 2 bank 1" UBYTE fak_q0p01 1 100 0.00 2.550 FORMAT "%5.3" ECU_ADDRESS 0x6000F7B3 /end MEASUREMENT
/begin MEASUREMENT HEGO_pwrS2B1HtgOnRls "Normalized heating power with released heating, HEGO sensor 2 bank 1" UBYTE fak_q0p01 1 100 0.00 2.550 FORMAT "%5.3" ECU_ADDRESS 0x6000F7B2 /end MEASUREMENT
/begin MEASUREMENT HEGO_resS2B1RiNom "nominal Ri sensor 2 bank 1" UWORD r_uw_q2 1 100 0.00 131070.0 FORMAT "%8.1" ECU_ADDRESS 0x60008E3E /end MEASUREMENT
/begin MEASUREMENT HEGO_rS2B1HtgLim "HEGO sensor 2 bank 1 duty cycle limited" UWORD fak_q3p906Em5 1 100 0.00 2.559961 FORMAT "%8.6" ECU_ADDRESS 0x60008E46 /end MEASUREMENT
/begin MEASUREMENT HEGO_tiS2B1HtgOn "Heater on-time, HEGO sensor 2 bank 1" UBYTE t_q0p001 1 100 0.00 0.2550 FORMAT "%6.4" ECU_ADDRESS 0x6000F7B1 /end MEASUREMENT
/begin MEASUREMENT HEGO_uS2B1NomHtgLim "Limited nominal heating voltage, HEGO sensor 2 bank 1" UWORD spg_q0p00039 1 100 0.00 25.59961 FORMAT "%8.5" ECU_ADDRESS 0x60008E36 /end MEASUREMENT
/begin MEASUREMENT HEGO_uS2B1WiDynSimHiRes "Output voltage of HEGO sensor 2 bank 1, with dynamics simulation, high resolution" UWORD spg_q1p221Em3_V 1 100 0.00 4.998779 FORMAT "%8.6" ECU_ADDRESS 0x600148F4 /end MEASUREMENT
/begin MEASUREMENT HPSys_bPresSetPntRea "Condition actual rail pressure is adjusted to setpoint" UBYTE B_TRUE 1 100 0.00 1.00000000000 BIT_MASK 0x1 FORMAT "%13.11" ECU_ADDRESS 0x6000F93F /end MEASUREMENT
/begin MEASUREMENT IKCtl_cntrCyl "cylinder counter of knock control" UBYTE dez 1 100 0.00 255.0 FORMAT "%5.1" ECU_ADDRESS 0x5000098D /end MEASUREMENT
/begin MEASUREMENT IKCtl_ctReIniGGKR "Local counter in GGKR for number of driving cycles (leave postdrive) to enable reinitialization" UBYTE OneToOne 1 100 0.00 255.0 FORMAT "%5.1" ECU_ADDRESS 0x60014A48 /end MEASUREMENT
/begin MEASUREMENT IKCtl_flgFilSwt "filter mean frequency is switched" UBYTE B_TRUE 1 100 0.00 1.00000000000 BIT_MASK 0x1 FORMAT "%13.11" ECU_ADDRESS 0x700008AF /end MEASUREMENT
/begin MEASUREMENT IKCtl_iaMeasWinBgn_s8 "beginning of measurement window in degree crank angle" SBYTE zw_sb_q0p75 1 100 -96.00 95.25 FORMAT "%5.2" ECU_ADDRESS 0x50006084 /end MEASUREMENT
/begin MEASUREMENT IKCtl_iaMeasWinLngth_s8 "duration of measurement window in degree crank angle" SBYTE zw_sb_q0p75 1 100 -96.00 95.25 FORMAT "%5.2" ECU_ADDRESS 0x50006085 /end MEASUREMENT
/begin MEASUREMENT IKCtl_iaMeasWin_s8 "IKC: effective retard ignition" SBYTE kw_q0p75 1 100 -96.00 95.25 FORMAT "%5.2" ECU_ADDRESS 0x50006086 /end MEASUREMENT
/begin MEASUREMENT IKCtl_iaPreIgnMeasWinBgn_s8 "beginning of measurement window (additional measurement window)" SBYTE zw_sb_q0p75 1 100 -96.00 95.25 FORMAT "%5.2" ECU_ADDRESS 0x70002E7F /end MEASUREMENT
/begin MEASUREMENT IKCtl_iaPreIgnMeasWinLngth_s8 "length of measurement window (additional measurement window)" SBYTE zw_sb_q0p75 1 100 -96.00 95.25 FORMAT "%5.2" ECU_ADDRESS 0x70002E7E /end MEASUREMENT
/begin MEASUREMENT IKCtl_iaPreIgnWinBgnIni_s8 "Local variable : Pre-ignition measurement window begin value during initialisation" SBYTE zw_sb_q0p75 1 100 -96.00 95.25 FORMAT "%5.2" ECU_ADDRESS 0x70002E8D /end MEASUREMENT
/begin MEASUREMENT IKCtl_iaPreIgnWinLngthIni_s8 "Local variable : Pre-ignition measurement window length value during initialisation" SBYTE zw_sb_q0p75 1 100 -96.00 95.25 FORMAT "%5.2" ECU_ADDRESS 0x70002E8C /end MEASUREMENT
/begin MEASUREMENT IKCtl_iaPreIgnWinLngthLoc_s8 "Length of pre-ignition measurement window(local variable)" SBYTE zw_sb_q0p75 1 100 -96.00 95.25 FORMAT "%5.2" ECU_ADDRESS 0x6000B829 /end MEASUREMENT
/begin MEASUREMENT IKCtl_idxFilSwt "index of nmot-specific filter mean frequency" UBYTE dez 1 100 0.00 255.0 FORMAT "%5.1" ECU_ADDRESS 0x60014ABF /end MEASUREMENT
/begin MEASUREMENT IKCtl_IntglCh1_au32 "Integration value channel 1" ULONG spg_q7p629Em7_V_ms 1 100 0.00 3276.79999924 FORMAT "%13.8" ARRAY_SIZE 4 ECU_ADDRESS 0x500005CC /end MEASUREMENT
/begin MEASUREMENT IKCtl_IntglCh2_au32 "Integration value channel 2" ULONG spg_q7p629Em7_V_ms 1 100 0.00 3276.79999924 FORMAT "%13.8" ARRAY_SIZE 4 ECU_ADDRESS 0x500005DC /end MEASUREMENT
/begin MEASUREMENT IKCtl_IntglCh3_au32 "Integration value channel 3" ULONG spg_q7p629Em7_V_ms 1 100 0.00 3276.79999924 FORMAT "%13.8" ARRAY_SIZE 4 ECU_ADDRESS 0x500005EC /end MEASUREMENT
/begin MEASUREMENT IKCtl_nUsdKnKSnsr "Number of actual used knock sensors" UBYTE dez 1 100 1.000 4.000 FORMAT "%5.3" ECU_ADDRESS 0x6000F7AB /end MEASUREMENT
/begin MEASUREMENT IKCtl_PreIgnIntglCh1_au32 "integrator value cannal 1 for pre-ignition detection" ULONG spg_q7p629Em7_V_ms 1 100 0.00 3276.79999924 FORMAT "%13.8" ARRAY_SIZE 4 ECU_ADDRESS 0x70003E30 /end MEASUREMENT
/begin MEASUREMENT IKCtl_PreIgnIntglCh2_au32 "integrator value cannal 2 for pre-ignition detection" ULONG spg_q7p629Em7_V_ms 1 100 0.00 3276.79999924 FORMAT "%13.8" ARRAY_SIZE 4 ECU_ADDRESS 0x70003E20 /end MEASUREMENT
/begin MEASUREMENT IKCtl_PreIgnIntglCh3_au32 "integrator value cannal 3 for pre-ignition detection" ULONG spg_q7p629Em7_V_ms 1 100 0.00 3276.79999924 FORMAT "%13.8" ARRAY_SIZE 4 ECU_ADDRESS 0x70003E10 /end MEASUREMENT
/begin MEASUREMENT IKCtl_stDgnsSnsrReq "knock control: knock sensor diagnosis request" UBYTE dez 1 100 0.00 255.0 FORMAT "%5.1" ECU_ADDRESS 0x600008DB /end MEASUREMENT
/begin MEASUREMENT IKCtl_stPreIgnMeasWin "current status of enabling (additional measurement window)" UBYTE dez 1 100 0.00 255.0 FORMAT "%5.1" ECU_ADDRESS 0x700036FE /end MEASUREMENT
/begin MEASUREMENT IKCtl_stVldnSnsrSig "activation of knock control functions" UBYTE dez 1 100 0.00 255.0 FORMAT "%5.1" ECU_ADDRESS 0x50000992 /end MEASUREMENT
/begin MEASUREMENT krinterg_l "integration value channel 1-3" ULONG spg_q7p629Em7_V_ms 1 100 0.00 3276.79999924 FORMAT "%13.8" ARRAY_SIZE 3 ECU_ADDRESS 0x50000574 /end MEASUREMENT
/begin MEASUREMENT makrmnzmf "Current value from KFMAKRMNZF" SBYTE zw_sb_q0p75 1 100 -96.00 95.25 FORMAT "%5.2" ECU_ADDRESS 0x6000B828 /end MEASUREMENT
/begin MEASUREMENT makrmxzmf "Current value from KFMAKRMXZF" SBYTE zw_sb_q0p75 1 100 -96.00 95.25 FORMAT "%5.2" ECU_ADDRESS 0x6000B827 /end MEASUREMENT
/begin MEASUREMENT npwethsr_w_msg "negative duty-cycle time duration from ethanol sensor" UWORD t_q0p0001_ms 1 100 0.00 6.553500 FORMAT "%8.6" ECU_ADDRESS 0x60008D36 /end MEASUREMENT
/begin MEASUREMENT prdiff_w_msg "High pressure regulation: System deviation" SWORD p_q0p0005 1 100 -16.38400 16.38350 FORMAT "%8.5" ECU_ADDRESS 0x60001636 /end MEASUREMENT
/begin MEASUREMENT prdr_w_msg "output high pressure controller" SWORD p_q0p0005 1 100 -16.38400 16.38350 FORMAT "%8.5" ECU_ADDRESS 0x60001630 /end MEASUREMENT
/begin MEASUREMENT pristlc_w "Filtered rail pressure real value local (absolut pressure)" UWORD RBPtCel_p_0p002_1 1 100 0.00 131.0700 FORMAT "%8.4" ECU_ADDRESS 0x600092F6 /end MEASUREMENT
/begin MEASUREMENT prsollu_w_msg "rail pressure setpoint before filtering" UWORD p_q0p0005 1 100 0.00 32.76750 FORMAT "%8.5" ECU_ADDRESS 0x600092F2 /end MEASUREMENT
/begin MEASUREMENT prsoll_w_msg "rail pressure setpoint" UWORD p_q0p0005 1 100 0.00 32.76750 FORMAT "%8.5" ECU_ADDRESS 0x600092F4 /end MEASUREMENT
/begin MEASUREMENT rfstt2sv_msg "relative fuel level for connection to OBD Service" UBYTE rel_q0p39 1 100 0.00 99.61 FORMAT "%5.2" ECU_ADDRESS 0x60001411 /end MEASUREMENT
/begin MEASUREMENT rmiprsol_w "relative engine load for rail pressure setpoint calculation" UWORD rel_uw_b3072 1 100 0.00 3071.953 FORMAT "%8.3" ECU_ADDRESS 0x600074A4 /end MEASUREMENT
/begin MEASUREMENT s1fl2p2f_msg "Interface for mode 01+02 Tank level for PID 2F" UBYTE dez 1 100 0.00 255.0 FORMAT "%5.1" ARRAY_SIZE 2 ECU_ADDRESS 0x6000140E /end MEASUREMENT
/begin MEASUREMENT sggteths_msg "status byte for GGTETHS" UBYTE dez 1 100 0.00 255.0 FORMAT "%5.1" ECU_ADDRESS 0x6000F71E /end MEASUREMENT
/begin MEASUREMENT stkrfmf_tmp "index of nmot-specific filter mean frequency" UBYTE dez 1 100 0.00 255.0 FORMAT "%5.1" ECU_ADDRESS 0x60014A56 /end MEASUREMENT
/begin MEASUREMENT teths_msg "temperature ethanolsensor" UBYTE temp_ub_q0p75_o48 1 100 -48.0 143.3 FORMAT "%5.1" ECU_ADDRESS 0x6000F71B /end MEASUREMENT
/begin MEASUREMENT tfstf_w "time constant fuel level filter (16 bit)" UWORD t_q0p1 1 100 0.00 6553.500 FORMAT "%8.3" ECU_ADDRESS 0x60000F08 /end MEASUREMENT
/begin MEASUREMENT veinterg "integrator value channel 1-3 for pre-ignition detection" ULONG spg_q7p629Em7_V_ms 1 100 0.00 3276.79999924 FORMAT "%13.8" ARRAY_SIZE 3 ECU_ADDRESS 0x70002E80 /end MEASUREMENT
/begin MEASUREMENT wmfa_tmp "beginning of measurement window in degree crank angle" SBYTE zw_sb_q0p75 1 100 -96.00 95.25 FORMAT "%5.2" ECU_ADDRESS 0x60014A57 /end MEASUREMENT
/begin MEASUREMENT wmfl_tmp "duration of measurement window in degree crank angle" SBYTE zw_sb_q0p75 1 100 -96.00 95.25 FORMAT "%5.2" ECU_ADDRESS 0x60014A58 /end MEASUREMENT
/begin MEASUREMENT zkrksdf "counter knock control: enable knock sensors short circuit detection" UBYTE dez 1 100 0.00 255.0 FORMAT "%5.1" ECU_ADDRESS 0x5000097D /end MEASUREMENT
/begin MEASUREMENT zzylkr_dia "cylinder counter of knock control for diagnosis" UBYTE dez 1 100 0.00 255.0 FORMAT "%5.1" ECU_ADDRESS 0x50000980 /end MEASUREMENT
/begin FUNCTION GGFSTT "11.19.0   Sensor variable fluid level sensor tank"
 /begin DEF_CHARACTERISTIC AFSTB CWGGFST DFSTBTKFSA FlLvl_fuSnsrPhyErrTiDeb_C FlLvl_stBreakCdnSwt_C Fllvl_tiDlyFuLvlDiagcFct_C FlLvl_tiDlyKl15FuLvlCdn_C FlLvl_tiRefuDeb_C FlLvl_tiTnFilMdnFuLvl_C FlLvl_tiTnRefFuLvl_C FlLvl_uBattUMaxFuLvl_C FlLvl_uBattUMinFuLvl_C FlLvl_uFuSnsrPhyRngMax_C FlLvl_uFuSnsrPhyRngMin_C FlLvl_volFuTankLvlMax_C FlLvl_volFuTankLvlThd_C FlLvl_volHysFuLvlDiagcFct_C FlLvl_volMaxFuLvlDiagcFct_C FlLvl_volMinFuLvlDiagcFct_C FlLvl_volThdRefuDetn_C FSTDMN FSTDMX FSTDTOL FSTHYS FSTTAL FSTTAV FSTTEW GVTMX KLTFSTFV TDFSTBTKF TDFSTU TFSTFBTK TVFSTD TVFSTTRG TVHALT UBSQDFSTMN UBSQDFSTMX UFSTMN UFSTMX /end DEF_CHARACTERISTIC
 /begin IN_MEASUREMENT BattU_u B_cdfst_msg B_clrfste_msg B_fstcanok B_fstelerr_msg B_fsttldv_msg B_kl15_msg B_tankab_msg B_tankdy_msg B_tankg_msg B_tankzu_msg B_tank_msg Eep_EnvRamHist Eep_EnvRamInvld EngStrt_bFrstStrtEnd Epm_stSpd FlLvl_flgRefuPsbl GlbDa_lTotDst SyC_stSub tfst_w_msg unfst_w_msg VehV_v /end IN_MEASUREMENT
 /begin OUT_MEASUREMENT B_efstmn_msg B_efstmx_msg B_fstdmn_msg B_fstdmx_msg B_fstsok1_msg B_fstsok_msg B_fsttg_msg B_fsttrg_msg B_fsttsh_msg B_fsttval_msg B_talval_msg B_tal_msg B_tav_msg FlLvl_flgFuSnsrPhyRngMaxErr FlLvl_flgFuSnsrPhyRngMinErr FlLvl_flgMaxFuLvlDiagcFct FlLvl_flgMinFuLvlDiagcFct FlLvl_flgRefuInProgs FlLvl_volAvrgFuLvl_msg FlLvl_volMdnFuLvlFild FlLvl_volRefuFuLvlFild FlLvl_volTnkTot fstof_w_msg fstt_msg fstt_w_msg fstu_w_msg gvtaf_w_msg /end OUT_MEASUREMENT
 /begin LOC_MEASUREMENT B_fstdy B_fstfbtk B_fststa FlLvl_flgCdnMdnFuLvl FlLvl_idxFuLvlAvrg200 FlLvl_idxFuLvlAvrg5 FlLvl_idxMdnFuLvl FlLvl_lTotDstFuLvlAvrg FlLvl_volDiffFuLvl FlLvl_volFuForDynDetn FlLvl_volFuLvlAvrg200 FlLvl_volFuLvlAvrg5 FlLvl_volFuLvlAvrgAry FlLvl_volMdnValFuLvl FlLvl_volRawFuLvlAry fstadf_w fstof1_w fsttval_w tfstf_w /end LOC_MEASUREMENT
 FUNCTION_VERSION "11.19.0" /end FUNCTION
/begin FUNCTION GGFSTT2SV "11.7.0    Connection %GGFSTT to OBD Service"
 /begin DEF_CHARACTERISTIC FlLvl_stFlSnsrErrEnad_C FlLvl_stFlSnsrPlausyChkEnad_C FSTTMX /end DEF_CHARACTERISTIC
 /begin IN_MEASUREMENT B_cdfst_msg B_fstelerr_msg B_fsttldv_msg fstu_w_msg SyC_stSub /end IN_MEASUREMENT
 /begin OUT_MEASUREMENT FlLvl_rOBDSig rfstt2sv_msg s1fl2p2f_msg /end OUT_MEASUREMENT
 FUNCTION_VERSION "11.7.0" /end FUNCTION
/begin FUNCTION GGKR "13.7.0    Sensor signal knock control"
 /begin DEF_CHARACTERISTIC FMFKRZN IKCtl_agOffsNInltAirTempKnkMeasWin_M IKCtl_facDgnsSnsr IKCtl_facFilSwt1 IKCtl_facFilSwt2 IKCtl_facFilSwt3 IKCtl_facFilSwt4 IKCtl_facMeasWinBgnHiRtdtIgn_GM IKCtl_facMeasWinBgnLoRtdtIgn_GM IKCtl_facMeasWinBgnMax_T IKCtl_facMeasWinBgnShftFFV_M IKCtl_facMeasWinLngth_GT IKCtl_idxAsgnSnsr_CA IKCtl_MeasWinCorr_C IKCtl_SpdHys_C ZWRETKRMN /end DEF_CHARACTERISTIC
 /begin REF_CHARACTERISTIC IKCtl_Load08_X_AX IKCtl_nEngVar13_X_AX /end REF_CHARACTERISTIC
 /begin IN_MEASUREMENT AirMod_ratChrgAirCyl B_ethg_msg dzwwl_msg Epm_nEng Epm_stOpMode fethmnmx_msg Ign_diaKperm_s8 Ign_diaKP_s8 IKCtl_agKnkAvrgGen_s8 IKCtl_flgLoadDynDetn IKCtl_flgSftyRtdt IKCtl_flgSpdDynDetn SyC_ctPostDrvLeave SyC_stSub tans_msg /end IN_MEASUREMENT
 /begin OUT_MEASUREMENT IKCtl_cntrCyl IKCtl_flgFilSwt IKCtl_iaMeasWinBgn_s8 IKCtl_iaMeasWinLngth_s8 IKCtl_iaMeasWin_s8 IKCtl_idxFilSwt IKCtl_IntglCh1_au32 IKCtl_IntglCh2_au32 IKCtl_IntglCh3_au32 IKCtl_nUsdKnKSnsr IKCtl_stDgnsSnsrReq IKCtl_stVldnSnsrSig stkrfmf_tmp wmfa_tmp wmfl_tmp /end OUT_MEASUREMENT
 /begin LOC_MEASUREMENT IKCtl_ctReIniGGKR krinterg_l zkrksdf zzylkr_dia /end LOC_MEASUREMENT
 FUNCTION_VERSION "13.7.0" /end FUNCTION
/begin FUNCTION GGKRZMF "3.9.0     Sensor signal knock control additional measurement window"
 /begin DEF_CHARACTERISTIC CWDKRZMF IKCtl_agOffsPreIgnMeasWin_M IKCtl_facPreIgnMeasWinBgnLrg_GM IKCtl_facPreIgnMeasWinBgnShftFFV_M IKCtl_facPreIgnMeasWinBgnSml_GM IKCtl_facPreIgnMeasWinLngth_GT ZWRETKRMNZ ZWRETKRMXZ /end DEF_CHARACTERISTIC
 /begin REF_CHARACTERISTIC IKCtl_Load08_X_AX IKCtl_nEngVar13_X_AX /end REF_CHARACTERISTIC
 /begin IN_MEASUREMENT AirMod_ratChrgAirCyl B_ethg_msg Epm_nEng fethmnmx_msg IKCtl_agMaxRtdtCurr_s8 IKCtl_cntrCyl IKCtl_flgSftyRtdtPreIgn IKCtl_iaMeasWin_s8 IKCtl_stVldnSnsrSig SyC_stSub tans_msg /end IN_MEASUREMENT
 /begin OUT_MEASUREMENT IKCtl_iaPreIgnMeasWinBgn_s8 IKCtl_iaPreIgnMeasWinLngth_s8 IKCtl_PreIgnIntglCh1_au32 IKCtl_PreIgnIntglCh2_au32 IKCtl_PreIgnIntglCh3_au32 IKCtl_stPreIgnMeasWin /end OUT_MEASUREMENT
 /begin LOC_MEASUREMENT akrcderz_w IKCtl_iaPreIgnWinBgnIni_s8 IKCtl_iaPreIgnWinLngthIni_s8 IKCtl_iaPreIgnWinLngthLoc_s8 makrmnzmf makrmxzmf veinterg /end LOC_MEASUREMENT
 FUNCTION_VERSION "3.9.0" /end FUNCTION
/begin FUNCTION GGTETHS "12.1.0    Sensor signal temperature fuel at ethanol sensor"
 /begin DEF_CHARACTERISTIC CWGGTFETH KLTFETHQES NPTETHMFMN_C NPTETHMFMX_C NPTETHSPMN_C NPTETHSPMX_C /end DEF_CHARACTERISTIC
 /begin REF_CHARACTERISTIC FfPrm_stEna_C TETHSKL15 UBSQFETHMN UBSQFETHMX /end REF_CHARACTERISTIC
 /begin IN_MEASUREMENT BattU_uFild B_ethsemn_msg B_ethsemx_msg B_kl15_msg fqethsr_w_msg pnpweths_w_msg SyC_stSub /end IN_MEASUREMENT
 /begin OUT_MEASUREMENT B_ethspwmn_msg B_ethspwmx_msg B_ethspwsi_msg B_tethsrg_msg ETHSCP_tFuHiRes npwethsr_w_msg sggteths_msg teths_msg /end OUT_MEASUREMENT
 FUNCTION_VERSION "12.1.0" /end FUNCTION
/begin FUNCTION GlbDa_DrvgCycCntr "1.0.0     Global driving cycle counter" /begin DEF_CHARACTERISTIC GlbDa_dlyTiDrvgCycCntr_C /end DEF_CHARACTERISTIC /begin IN_MEASUREMENT CoEng_st SyC_stSub T15_st /end IN_MEASUREMENT /begin OUT_MEASUREMENT GlbDa_cntrDrvgCyc /end OUT_MEASUREMENT /begin LOC_MEASUREMENT GlbDa_flgDrvgCycCntr /end LOC_MEASUREMENT FUNCTION_VERSION "1.0.0" /end FUNCTION
/begin FUNCTION GlbDa_LSum "64.0.0    Global Data Total Distance" /begin DEF_CHARACTERISTIC GlbDa_lDstLim_C /end DEF_CHARACTERISTIC /begin IN_MEASUREMENT CoEng_st VehV_v /end IN_MEASUREMENT
 /begin OUT_MEASUREMENT GlbDa_lDst GlbDa_lenTotDstDcyc GlbDa_lenTotDstDcycHiResl GlbDa_lTotDst /end OUT_MEASUREMENT
 /begin LOC_MEASUREMENT GlbDa_lDstLstStored GlbDa_lDstLstStoredProtd GlbDa_lenTotDstPrevDcyc GlbDa_lTotDstProtd GlbDa_stEepOrder GlbDa_stEepWrite /end LOC_MEASUREMENT
 FUNCTION_VERSION "64.0.0" /end FUNCTION
/begin FUNCTION GlbDa_SetData "38.1.0    Global Data Set Data"
 /begin DEF_CHARACTERISTIC GlbDa_aX_C GlbDa_lWhlCirc_C GlbDa_pEnv_C GlbDa_rTrqDfl_C GlbDa_tEnv_C GlbDa_tiFltAX_C GlbDa_tiFltVX_C GlbDa_tIndAir_C GlbDa_tiWhlSpdFlt_C GlbDa_vWhlSpdMin_C GlbDa_vX_C /end DEF_CHARACTERISTIC
 /begin IN_MEASUREMENT Air_tCACDs EnvP_p EnvT_t PT_rTrq PT_rTrqWoConvRat StbIntv_vWhlSpd SyC_ctPostDrvLeave VehMot_rTrqDfftl VehV_a VehV_v /end IN_MEASUREMENT
 /begin OUT_MEASUREMENT GlbDa_aX GlbDa_aXFlt GlbDa_lWhlCirc GlbDa_pEnv GlbDa_rTrqTot GlbDa_rTrqTotWoConvRat GlbDa_tEnv GlbDa_tIndAir GlbDa_vAvrgWhlSpd GlbDa_vWhlSpdFlt GlbDa_vX GlbDa_vXFlt /end OUT_MEASUREMENT
 /begin LOC_MEASUREMENT GlbDa_cntrReIni GlbDa_nrWhlSpdAryIdx1 GlbDa_nrWhlSpdAryIdx2 GlbDa_vWhlSpdFltAryVal /end LOC_MEASUREMENT
 FUNCTION_VERSION "38.1.0" /end FUNCTION
/begin FUNCTION GlbDa_TrqDem "24.0.0    Global Data Torque Demand" /begin IN_MEASUREMENT PT_stTqDem /end IN_MEASUREMENT /begin OUT_MEASUREMENT GlbDa_stTrqDem /end OUT_MEASUREMENT FUNCTION_VERSION "24.0.0" /end FUNCTION
/begin FUNCTION GwECU_CGW1 "15.5.0    Receive frame CGW1" /begin DEF_CHARACTERISTIC Com_dCGW1MaxDiff_C Com_dCGW1MaxPer_C Com_dGwCGW1SigSel_C /end DEF_CHARACTERISTIC
 /begin IN_MEASUREMENT Com_ctCRingCGW1 Com_numCsumCGW1 Com_stFrmRxEna Com_stIMGMILReq Com_stMon SyC_ctPostDrvLeave T15_st /end IN_MEASUREMENT
 /begin LOC_MEASUREMENT Com_ctReIni10msCGW1 GwECU_ctCGW1RngCnt_MP /end LOC_MEASUREMENT
 FUNCTION_VERSION "15.5.0" /end FUNCTION
/begin FUNCTION GwECU_GwIMG1 "2.3.0     Reception process for the CAN frame GwIMG1"
 /begin DEF_CHARACTERISTIC Com_dGwIMG1MaxDiff_C Com_dGwIMG1MaxPer_C Com_dGwIMG1SigSel_C /end DEF_CHARACTERISTIC
 /begin IN_MEASUREMENT Com_ctCRingGwIMG1 Com_numCsumGwIMG1 Com_stFrmRxEna Com_stIMGIDSA12DrvMod Com_stIMGIDSDrvMod Com_stMon /end IN_MEASUREMENT
 /begin LOC_MEASUREMENT GwECU_ctGwIMG1RngCnt_MP /end LOC_MEASUREMENT
 FUNCTION_VERSION "2.3.0" /end FUNCTION
/begin FUNCTION GwECU_GwIMG3 "5.3.0_6SAAReception process for the CAN frame GwIMG3"
 /begin DEF_CHARACTERISTIC Com_dGwIMG3MaxDiff_C Com_dGwIMG3MaxPer_C Com_tqIMGSuppReq_C /end DEF_CHARACTERISTIC
 /begin IN_MEASUREMENT Com_ctCRingGwIMG3 Com_numCsumGwIMG3 Com_stFrmRxEna Com_stIMGACCBrkReq Com_stIMGDrvTq Com_stIMGISBrkCntrADAS Com_stIMGISRlsReq Com_stIMGLimTq Com_stIMGShiftReq Com_stMon Com_tqIMGReqDrv Com_tqIMGSuppReq /end IN_MEASUREMENT
 /begin OUT_MEASUREMENT Com_flgGwIMG3Norm /end OUT_MEASUREMENT
 FUNCTION_VERSION "5.3.0_6SAA" /end FUNCTION
/begin FUNCTION GwECU_GwIMG4 "4.2.0_6SAAReception process for the CAN frame GwIMG4" /begin DEF_CHARACTERISTIC Com_dGwIMG4MaxDiff_C Com_dGwIMG4MaxPer_C /end DEF_CHARACTERISTIC
 /begin IN_MEASUREMENT Com_ctCRingGwIMG4 Com_numCsumGwIMG4 Com_stEngCanRxErr Com_stFrmRxEna Com_stIMGISBrkHldActv Com_stIMGISBrkHldStb Com_stIMGISInhbBrk Com_stIMGISRstrtInhbBrk Com_stIMGISShiftInhbBrk Com_stIMGISSysOffBrk Com_stMon /end IN_MEASUREMENT
 /begin LOC_MEASUREMENT GwECU_ctGwIMG4RngCnt_MP /end LOC_MEASUREMENT
 FUNCTION_VERSION "4.2.0_6SAA" /end FUNCTION
/begin FUNCTION GwECU_GwIMG5 "3.2.0_6SAAReception process for the CAN frame GwIMG5" /begin DEF_CHARACTERISTIC Com_dGwIMG5MaxDiff_C Com_dGwIMG5MaxPer_C /end DEF_CHARACTERISTIC
 /begin IN_MEASUREMENT Com_ctCRingGwIMG5 Com_numCsumGwIMG5 Com_stClrCmplInfoVINRegst Com_stFrmRxEna Com_stMon /end IN_MEASUREMENT
 /begin LOC_MEASUREMENT GwECU_ctGwIMG5RngCnt_MP /end LOC_MEASUREMENT
 FUNCTION_VERSION "3.2.0_6SAA" /end FUNCTION
/begin FUNCTION GwECU_GwIMG6 "714.1.0   Reception process for the CAN frame GwIMG6" /begin DEF_CHARACTERISTIC Com_dGwIMG6MaxDiff_C Com_dGwIMG6MaxPer_C /end DEF_CHARACTERISTIC
 /begin IN_MEASUREMENT Com_ctCRingGwIMG6 Com_numCsumGwIMG6 Com_stFrmRxEna Com_stIMGECUIG1 Com_stMon Com_uBattDetnIMGECU Com_uIG1DetnIMGECU SyC_ctPostDrvLeave T15_st /end IN_MEASUREMENT
 /begin LOC_MEASUREMENT Com_ctReIni10msGwIMG6 GwECU_ctGwIMG6RngCnt /end LOC_MEASUREMENT
 FUNCTION_VERSION "714.1.0" /end FUNCTION
/begin FUNCTION HDR "51.2.0    High pressure control"
 /begin DEF_CHARACTERISTIC FPHDRTF FuPHi_pHpDeMaxLimInteg_C FuPHi_pHpDeMinLimInteg_C FWIHDR FWPHDR KLIHDR KLPHDR KLPHDRTF SPD06HDSW /end DEF_CHARACTERISTIC
 /begin IN_MEASUREMENT B_hdrba_msg B_hdrres_msg B_hdr_msg B_tfuelg_msg Epm_nEngLRes FuPHi_pRail FuPHi_pRailSp SyC_stSub tfuelsq_msg /end IN_MEASUREMENT
 /begin OUT_MEASUREMENT FuPHi_pHpCtrlrOut FuPHi_pHpRglnDe prdiff_w_msg prdr_w_msg /end OUT_MEASUREMENT
 /begin LOC_MEASUREMENT FuPHi_pHpRglnDeLoc FuPHi_pria FuPHi_prpa /end LOC_MEASUREMENT
 FUNCTION_VERSION "51.2.0" /end FUNCTION
/begin FUNCTION HDRPIST "51.10.0_1.4.0Rail pressure actual value"
 /begin DEF_CHARACTERISTIC CWHDRPIST FuPHi_cntrCrksftRevAftStrtRailPPrdn_C FuPHi_facRailPPrdnNeg_T FuPHi_facRailPPrdnOldMax_C FuPHi_facRailPPrdnOldMin_C FuPHi_facRailPPrdnPos_T FuPHi_pDifStrtActThdHys_C FuPHi_pDifStrtActThd_C FuPHi_pDpnHiPPmp_C FuPHi_pRailPrdnActMax_C FuPHi_pRailPrdnActMin_C FuPHi_pRailPrdnSpActMin_C FuPHi_pSubStrtLoP_C FuPHi_tiFilPPrdnDelta_C FuPHi_tiRailPPrdnAct_C KLTFPRIST KLTFPRISTDYN /end DEF_CHARACTERISTIC
 /begin IN_MEASUREMENT B_hdrres_msg B_prnl_msg EngStrt_bStrtEnd EpmCrS_ctRevStrt Epm_nEngLRes FuPHi_pRailLimpHome FuPHi_pRailSp FuPHi_pRailSpGrdt FuPHi_pRawAbslt FuPHi_pRawAbsltInj SyC_ctPostDrvLeave /end IN_MEASUREMENT
 /begin OUT_MEASUREMENT FuPHi_pRail FuPHi_pRailInj FuPHi_pRailStrt /end OUT_MEASUREMENT
 /begin LOC_MEASUREMENT dprstt_w FuPHi_fGrdtChgPRailSp FuPHi_flgPPrdnEna FuPHi_pPrdnDelta FuPHi_pPrdnDeltaOld FuPHi_pPrdnOff FuPHi_pPrdnOld FuPHi_tnPRailPT1 hdrpist_ctReIni10ms pristlc_w /end LOC_MEASUREMENT
 FUNCTION_VERSION "51.10.0_1.4.0" /end FUNCTION
/begin FUNCTION HDRPSOL "51.12.0_1.2.0Fuel High Pressure Setpoint"
 /begin DEF_CHARACTERISTIC ACTR_TST_HDP_ATS_ATS.LimitTypeMsk_C ACTR_TST_HDP_ATS_ATS.CnvNorm_C ACTR_TST_HDP_ATS_ATS.LowLim_C ACTR_TST_HDP_ATS_ATS.UpLim_C ACTR_TST_HDP_ATS_ATS.CnvFac_C ACTR_TST_HDP_ATS_ATS.CnvOfs_C ACTR_TST_HDP_ATS_ATS.DfltVal_C CWHDRPSOL CWPRSOLAP FGPRSOLP FuPHi_EomMpg_I.OperMod2Idx_M FuPHi_facRailSpEngTempEthCntnt_M FuPHi_facRailSpNVCoornEth_M FuPHi_maxSpValRailP_GC FuPHi_pRailDesHiCstrLoad_MEXTD FuPHi_pRailEthnlFacSp2_GC FuPHi_pRailEthnlFacSp3_GC FuPHi_pRailEthnlFacSp4_GC FuPHi_pRailEthnlFacSp_GC FuPHi_pRailEthnlSp2_GM FuPHi_pRailEthnlSp3_GM FuPHi_pRailEthnlSp4_GM FuPHi_pRailEthnlSp_GM FuPHi_pRailSp2_GM FuPHi_pRailSp3_GM FuPHi_pRailSp4_GM FuPHi_pRailSpAppl_C FuPHi_pRailSpEngTSpd_GM FuPHi_pRailSpEth_M FuPHi_pRailSpMap4Act_C FuPHi_pRailSpMaxSmlInj_C FuPHi_pRailSpMax_C FuPHi_pRailSpMin_C FuPHi_pRailSpNVCorrn_M FuPHi_pRailSpTstrDmd_C FuPHi_pRailSp_GM FuPHi_pRalIdleDrv_M FuPHi_pRlSpNgvGrad_GM FuPHi_pRlSpPosGrad_GM HiPSys_pSpMaxDe_C HiPSys_pSpSTSP_C HiPSys_tiSpRea_C KLGPRSOLDP MODPRSOL2 MODPRSOL3 SNM05HDUW SRK05HDUW TDPRMXNMX TVHDRPSLST /end DEF_CHARACTERISTIC
 /begin IN_MEASUREMENT B_fteadh_msg B_hdrres_msg B_khakt_msg B_khan_msg B_ll_msg B_nmax_msg B_prmaxti_msg B_prmxnl_msg B_stoanf_msg CEngDsT_t CoEOM_stEomDest CoEOM_stEOMDesWoCatHtg CoEOM_stEomTarInj Epm_nEng Epm_nEngLRes fethmnmx_msg fethr_w_msg FfPrm_facEth FfPrm_facEthCurr FuPHi_pMaxRailSpLimp FuPHi_pRail gangsist_msg InjSys_flgReqSpRailCvo InjSys_pSpRailCvoExtdRng InjSys_ratFuM InjSys_ratPrdcFuMLamDesAvrg MfVD_bSpPrHld milsol_w_msg rkvmeeff_w_msg rlp_w_msg SyC_ctPostDrvLeave SyC_stSub teths_msg tnse_w_msg /end IN_MEASUREMENT
 /begin OUT_MEASUREMENT FuPHi_flgTstrReqActvRailP FuPHi_pRailSp FuPHi_pRailSpGrdt FuPHi_pRailSpNoCatHeatg FuPHi_pRailSpUnlim HPSys_bPresSetPntRea prsollu_w_msg prsoll_w_msg /end OUT_MEASUREMENT
 /begin LOC_MEASUREMENT B_prsolgrb B_prsolst FuPHi_flgTstrReqActvRailPLoc FuPHi_pRailLoc FuPHi_pRailSpBefLimn FuPHi_pRailSpGradLimd FuPHi_pRailSpGrdtloc FuPHi_pRailSpLoc FuPHi_pRlSpMaxLoc FuPHi_pRlSpNgvGradLoc FuPHi_pRlSpPosGradLoc HDRPSOL_ctInit rmiprsol_w /end LOC_MEASUREMENT
 FUNCTION_VERSION "51.12.0_1.2.0" /end FUNCTION
/begin FUNCTION HEGOD_DynSimn "1.8.0     Dynamics simulation for binary oxygen sensors"
 /begin DEF_CHARACTERISTIC HEGOD_stDynSimn_CW HEGOD_tiFltSimn_C HEGOD_tiFolwLRSimn_C HEGOD_tiFolwRLSimn_C HEGOD_tiFolwSimn_C HEGOD_tiHldLRSimn_C HEGOD_tiHldRLSimn_C HEGOD_tiHldSimn_C HEGOD_tiVltFltSimn_C HEGOD_uLimdMaxSimn_C HEGOD_uLimdMinSimn_C HEGOD_stPosnSimn_CW /end DEF_CHARACTERISTIC
 /begin REF_CHARACTERISTIC HEGO_flgS2B1Prsnt_C /end REF_CHARACTERISTIC
 /begin IN_MEASUREMENT HEGO_uS2B1WoDynSimHiRes /end IN_MEASUREMENT
 /begin OUT_MEASUREMENT HEGO_uS2B1WiDynSimHiRes /end OUT_MEASUREMENT
 /begin LOC_MEASUREMENT HEGOD_S2B1Simn_I.bFolwLR HEGOD_S2B1Simn_I.bFolwRL HEGOD_S2B1Simn_I.bHldLR HEGOD_S2B1Simn_I.bHldRL HEGOD_S2B1Simn_I.bVltgFall HEGOD_S2B1Simn_I.bVltgRise HEGOD_S2B1Simn_I.tiHld HEGOD_S2B1Simn_I.uWiSimnHiRes HEGOD_S2B1Simn_I.uWoSimnFltHiRes HEGOD_S2B1Simn_I.DlyTtOpt_I.buffer HEGOD_S2B1Simn_I.DlyTtOpt_I.counter HEGOD_S2B1Simn_I.DlyTtOpt_I.ds HEGOD_S2B1Simn_I.DlyTtOpt_I.pointer HEGOD_S2B1Simn_I.FolwSimnHiResLT_I.memory HEGOD_S2B1Simn_I.VltFltHiResLT_I.memory HEGOD_S2B1Simn_I.VltgFallER_I.buffer HEGOD_S2B1Simn_I.VltgFallER_I.oldSignal HEGOD_S2B1Simn_I.VltgRiseER_I.buffer HEGOD_S2B1Simn_I.VltgRiseER_I.oldSignal HEGOD_S2B1Simn_I.bFolwLRER_I.buffer HEGOD_S2B1Simn_I.bFolwLRER_I.oldSignal HEGOD_S2B1Simn_I.bFolwRLER_I.buffer HEGOD_S2B1Simn_I.bFolwRLER_I.oldSignal HEGOD_S2B1Simn_I.bHldLRER_I.buffer HEGOD_S2B1Simn_I.bHldLRER_I.oldSignal HEGOD_S2B1Simn_I.bHldRLER_I.buffer HEGOD_S2B1Simn_I.bHldRLER_I.oldSignal /end LOC_MEASUREMENT
 FUNCTION_VERSION "1.8.0" /end FUNCTION
/begin FUNCTION HEGO_Htg "3.53.0_1.1.0Heating binary oxygen sensors"
 /begin DEF_CHARACTERISTIC HEGO_duHtgMapMax_C HEGO_duNomHtgIMax_C HEGO_duNomHtgIMin_C HEGO_duNomHtgPMax_C HEGO_duNomHtgPMin_C HEGO_duNomHtgRedErrElecMin_C HEGO_facHtgIGn_C HEGO_facHtgPGn_CUR HEGO_flgDewPntEndFreeSnsr_C HEGO_HtgS2B1_I.duHtgRmpDwn_C HEGO_HtgS2B1_I.duHtgRmpUp_C HEGO_HtgS2B1_I.pwrHtgSuffMin_C HEGO_HtgS2B1_I.resRiDBndMax_C HEGO_HtgS2B1_I.resRiDBndMin_C HEGO_HtgS2B1_I.resRiNom_C HEGO_HtgS2B1_I.stHtg_CW HEGO_HtgS2B1_I.tEGHtgSuffMin_C HEGO_HtgS2B1_I.tiDebHtgMax_C HEGO_HtgS2B1_I.tiDebHtgStrtUs_C HEGO_HtgS2B1_I.tiHtgSuffDeb_C HEGO_HtgS2B1_I.tiMaxHtgRedEngOff_CUR HEGO_HtgS2B1_I.tiMaxHtgRedPrt_CUR HEGO_HtgS2B1_I.tiMaxHtgRed_C HEGO_HtgS2B1_I.tiTExhSnsrFil_M HEGO_HtgS2B1_I.uDrpHtg_C HEGO_HtgS2B1_I.uHtgAftPrt_CUR HEGO_HtgS2B1_I.uHtgMapCtl_MAP HEGO_HtgS2B1_I.uHtgMaxDeb_C HEGO_HtgS2B1_I.uHtgMaxHtUp_C HEGO_HtgS2B1_I.uHtgMax_C HEGO_HtgS2B1_I.uHtgNom_C HEGO_HtgS2B1_I.uHtgPrt_C HEGO_resRiCorrdHtgRed_C HEGO_resRiHtgOffLo_C HEGO_resRiHtgOff_C HEGO_resRiImpsThdHtgStrt_C HEGO_resRiOffsHysHtgRed_C HEGO_resRiSwtHeatgMapThd_C HEGO_rHtgMaxAntiWindUp_C HEGO_rHtgMinAntiWindUp_C HEGO_stHtgEna_CW HEGO_stHtg_CW HEGO_tEGHtgOffStop_C HEGO_tEGHtgRed_C HEGO_tEGMaxHtgEna_C HEGO_tEGMinHtg_C HEGO_tEngHotHtg_C HEGO_tEngMinHeatgProtn_C HEGO_tExhStrtMinMapHtg_C HEGO_tExhStrt_C HEGO_tiDebBattHtgOff_C HEGO_tiDebHeatgStrt_C HEGO_tiDebHtgMapClsdLop_C HEGO_tiDebHtgMaxHys_C HEGO_tiDebHtgPreDrive_C HEGO_tiDebNewRiAvlHtg_C HEGO_tiDebNewRiHtg_C HEGO_tiDebRiActAvlHtg_C HEGO_tiEngStop_C HEGO_tiFltRiHtg_C HEGO_tiPerdHtg_C HEGO_tiTExhSnsrDyn_C HEGO_uBattHtgOff_C /end DEF_CHARACTERISTIC
 /begin REF_CHARACTERISTIC HEGO_flgS2B1Prsnt_C HEGO_tiS2FrzSigRiAcqn_C /end REF_CHARACTERISTIC
 /begin IN_MEASUREMENT BattU_u CEngDsT_t Eep_EnvRamInvld EngStrt_bStrtEnd ExhMod_flgDewPntEndS2B1 ExhMod_flgHeatgTspS2B1 ExhMod_flgTSnsrStrtCalcdB1 ExhMod_mfExhCat1B1 ExhMod_tExhS2B1 ExhMod_tExhStrtS2B1 ExhMod_tWallS2B1 HEGO_bS2B1ErrElecMinWoDeb HEGO_bS2B1NewRi HEGO_bS2B1Vld HEGO_numVoltMeasmtElecMaxS2B1 HEGO_resS2B1RiCorrd SyC_ctPostDrvLeave SyC_stSub TiEngOff_stTi TiOff_tiStrtEndOff UEGO_flgSnsrMdlHotS1B1 /end IN_MEASUREMENT
 /begin OUT_MEASUREMENT HEGO_bS2B1HtgEna HEGO_bS2B1HtgOn HEGO_bS2B1HtgPrtFin HEGO_bS2B1HtgRiReq HEGO_bS2B1HtgStrt HEGO_bS2B1HtgSuff HEGO_flgHtgClsdLopEnaS2B1 HEGO_flgS2B1InhbRiMeasmtElDiag HEGO_pwrS2B1Htg HEGO_pwrS2B1HtgOnRls HEGO_resS2B1RiNom HEGO_rS2B1HtgLim HEGO_tiS2B1HtgOn HEGO_uS2B1NomHtgLim /end OUT_MEASUREMENT
 /begin LOC_MEASUREMENT HEGO_bS2B1HtgOffTiImpsMem HEGO_flgS2B1HtgOnDes HEGO_HtgEnaS2B1_I.bEngStrtFinFF HEGO_HtgEnaS2B1_I.bHtgEna HEGO_HtgEnaS2B1_I.flgPhysEna HEGO_HtgEnaS2B1_I.BattHtgOffTONV_I.outbit HEGO_HtgEnaS2B1_I.BattHtgOffTONV_I.time HEGO_HtgEnaS2B1_I.DebHtgPreDriveTOFFV_I.outbit HEGO_HtgEnaS2B1_I.DebHtgPreDriveTOFFV_I.time HEGO_HtgS2B1_I.bDebHtgStrt HEGO_HtgS2B1_I.bHtgClsdLopAntiWndUp HEGO_HtgS2B1_I.bHtgClsdLopEna HEGO_HtgS2B1_I.bHtgClsdLopRiReq HEGO_HtgS2B1_I.bHtgEna HEGO_HtgS2B1_I.bHtgMap HEGO_HtgS2B1_I.bHtgOffHiTemp HEGO_HtgS2B1_I.bHtgPrtFin HEGO_HtgS2B1_I.bHtgPrtInhb HEGO_HtgS2B1_I.bHtgStrt HEGO_HtgS2B1_I.bHtgStrtInhb HEGO_HtgS2B1_I.bHtgStrtPwrRed HEGO_HtgS2B1_I.bHtgSuff HEGO_HtgS2B1_I.bRiActAvl HEGO_HtgS2B1_I.cycHtgCntr HEGO_HtgS2B1_I.dresRi HEGO_HtgS2B1_I.duNomHtgClsdLop HEGO_HtgS2B1_I.duNomHtgI HEGO_HtgS2B1_I.duNomHtgP HEGO_HtgS2B1_I.flgHtgOnReq HEGO_HtgS2B1_I.flgInhbRiElecMax HEGO_HtgS2B1_I.flgRiHtgStrtPwrRed HEGO_HtgS2B1_I.mEGHtg HEGO_HtgS2B1_I.numHtgCycDif HEGO_HtgS2B1_I.numHtgCycOffReq HEGO_HtgS2B1_I.numHtgCycOnReq HEGO_HtgS2B1_I.numVoltMeasmtElecMaxPrev HEGO_HtgS2B1_I.pwrHtg HEGO_HtgS2B1_I.pwrHtgOnRls HEGO_HtgS2B1_I.rHtg HEGO_HtgS2B1_I.rHtgLim HEGO_HtgS2B1_I.resRiAct HEGO_HtgS2B1_I.resRiNom HEGO_HtgS2B1_I.tEGFltHtg HEGO_HtgS2B1_I.tEg HEGO_HtgS2B1_I.tExhSnsrDyn HEGO_HtgS2B1_I.tiFilTExhSn HEGO_HtgS2B1_I.tiHtgOn HEGO_HtgS2B1_I.tiHtgPrt HEGO_HtgS2B1_I.uBattHtg HEGO_HtgS2B1_I.uNomHtg HEGO_HtgS2B1_I.uNomHtgAftPrt HEGO_HtgS2B1_I.uNomHtgLim HEGO_HtgS2B1_I.uNomHtgMap HEGO_HtgS2B1_I.uNomHtgNoLim HEGO_HtgS2B1_I.uNomHtgStrt HEGO_HtgS2B1_I.DebAtmstTONV_I.outbit HEGO_HtgS2B1_I.DebAtmstTONV_I.time HEGO_HtgS2B1_I.DebHeatgStrtTONV_I.outbit HEGO_HtgS2B1_I.DebHeatgStrtTONV_I.time HEGO_HtgS2B1_I.DebHtgMapClsdLopTONV_I.outbit HEGO_HtgS2B1_I.DebHtgMapClsdLopTONV_I.time HEGO_HtgS2B1_I.DebHtgMaxTOFFV_I.outbit HEGO_HtgS2B1_I.DebHtgMaxTOFFV_I.time HEGO_HtgS2B1_I.DebHtgStrtUsTONV_I.outbit HEGO_HtgS2B1_I.DebHtgStrtUsTONV_I.time HEGO_HtgS2B1_I.DebNewRiAvlTOFFV_I.outbit HEGO_HtgS2B1_I.DebNewRiAvlTOFFV_I.time HEGO_HtgS2B1_I.DebNewRiTOFFV_I.outbit HEGO_HtgS2B1_I.DebNewRiTOFFV_I.time HEGO_HtgS2B1_I.DebRiActAvlTOFFV_I.outbit HEGO_HtgS2B1_I.DebRiActAvlTOFFV_I.time HEGO_HtgS2B1_I.HtgRedTONV_I.outbit HEGO_HtgS2B1_I.HtgRedTONV_I.time HEGO_HtgS2B1_I.RiHtgLT_I.memory HEGO_HtgS2B1_I.bHtgStrtEF_I.buffer HEGO_HtgS2B1_I.bHtgStrtEF_I.oldSignal HEGO_HtgS2B1_I.bHtgStrtPwrRedEF_I.buffer HEGO_HtgS2B1_I.bHtgStrtPwrRedEF_I.oldSignal HEGO_HtgS2B1_I.bRiActAvlER_I.buffer HEGO_HtgS2B1_I.bRiActAvlER_I.oldSignal HEGO_HtgS2B1_I.duNomHtgITL_I.memory HEGO_HtgS2B1_I.flgIntrptHeatgElDiagSW_I.timeCounter HEGO_HtgS2B1_I.tEGHtgLT_I.memory HEGO_HtgS2B1_I.tExhSnsrLT_I.memory HEGO_HtgS2B1_I.tiHtgPrtSW_I.timeCounter HEGO_HtgS2B1_I.uNomHtgStrtAL_I.memory HEGO_Htg_ctReIni /end LOC_MEASUREMENT
 FUNCTION_VERSION "3.53.0_1.1.0" /end FUNCTION
/begin COMPU_METHOD Acc "" RAT_FUNC "%6.5" "m/s^2" COEFFS 0 1000 0 0 0 1 /end COMPU_METHOD
/begin COMPU_METHOD B_TRUE "" TAB_VERB "%6.3" "" COMPU_TAB_REF B_TRUE /end COMPU_METHOD
/begin COMPU_VTAB B_TRUE "" TAB_VERB 2 0 "FALSE" 1 "TRUE" /end COMPU_VTAB
/begin COMPU_METHOD CoEOM_idxOperModCfgd_VERB "" TAB_VERB "%6.3" "-" COMPU_TAB_REF CoEOM_idxOperModCfgd_VERB /end COMPU_METHOD
/begin COMPU_VTAB CoEOM_idxOperModCfgd_VERB "" TAB_VERB 4 0 "Base" 1 "WarmUp" 2 "CatHtg" 3 "Start" /end COMPU_VTAB
/begin COMPU_METHOD CoEOM_idxOperModStgTot_VERB "" TAB_VERB "%6.3" "-" COMPU_TAB_REF CoEOM_idxOperModStgTot_VERB /end COMPU_METHOD
/begin COMPU_VTAB CoEOM_idxOperModStgTot_VERB "" TAB_VERB 16 0 "HOM-SNGL_FullLft" 1 "HOM_FullLft" 2 "HSP_FullLft" 3 "HSPIC_FullLft" 4 "HOM-SNGL_EIVC" 5 "HOM_EIVC" 6 "HSP_EIVC" 7 "HSPIC_EIVC" 8 "Stage 8" 9 "Stage 9" 10 "Stage 10" 11 "Stage 11" 12 "Stage 12" 13 "Stage 13" 14 "Stage 14" 15 "Stage 15" /end COMPU_VTAB
/begin COMPU_METHOD dez "" RAT_FUNC "%6.2" "" COEFFS 0 1 0 0 0 1 /end COMPU_METHOD
/begin COMPU_METHOD dezsub1 "" RAT_FUNC "%6.2" "-" COEFFS 0 1 -1 0 0 1 /end COMPU_METHOD
/begin COMPU_METHOD EngN "" RAT_FUNC "%6.3" "rpm" COEFFS 0 2 0 0 0 1 /end COMPU_METHOD
/begin COMPU_METHOD EngN_LRes "" RAT_FUNC "%6.1" "rpm" COEFFS 0 0.025 0 0 0 1 /end COMPU_METHOD
/begin COMPU_METHOD fak_q0p01 "" RAT_FUNC "%6.4" "" COEFFS 0 100 0 0 0 1 /end COMPU_METHOD
/begin COMPU_METHOD fak_q0p03125 "" RAT_FUNC "%6.4" "" COEFFS 0 32 0 0 0 1 /end COMPU_METHOD
/begin COMPU_METHOD fak_q3p0518Em5 "" RAT_FUNC "%7.6" "" COEFFS 0 32768 0 0 0 1 /end COMPU_METHOD
/begin COMPU_METHOD fak_q3p906Em5 "" RAT_FUNC "%7.6" "-" COEFFS 0 25600 0 0 0 1 /end COMPU_METHOD
/begin COMPU_METHOD fak_ub_b1 "" RAT_FUNC "%6.4" "-" COEFFS 0 256 0 0 0 1 /end COMPU_METHOD
/begin COMPU_METHOD fak_ub_b16 "" RAT_FUNC "%6.4" "-" COEFFS 0 256 0 0 0 16 /end COMPU_METHOD
/begin COMPU_METHOD fak_ub_b2 "" RAT_FUNC "%8.5" "-" COEFFS 0 256 0 0 0 2 /end COMPU_METHOD
/begin COMPU_METHOD fak_uw_b2 "" RAT_FUNC "%7.6" "-" COEFFS 0 65536 0 0 0 2 /end COMPU_METHOD
/begin COMPU_METHOD fak_uw_b8 "" RAT_FUNC "%6.5" "-" COEFFS 0 65536 0 0 0 8 /end COMPU_METHOD
/begin COMPU_METHOD kw_q0p75 "" RAT_FUNC "%6.3" "Grad KW" COEFFS 0 4 0 0 0 3 /end COMPU_METHOD
/begin COMPU_METHOD Length "" RAT_FUNC "%6.2" "m" COEFFS 0 1 0 0 0 1 /end COMPU_METHOD
/begin COMPU_METHOD LengthKm1 "" RAT_FUNC "%6.2" "Km" COEFFS 0 1 0 0 0 1 /end COMPU_METHOD
/begin COMPU_METHOD Length_10m "" RAT_FUNC "%6.1" "m" COEFFS 0 0.1 0 0 0 1 /end COMPU_METHOD
/begin COMPU_METHOD Length_fine "" RAT_FUNC "%6.5" "m" COEFFS 0 1000 0 0 0 1 /end COMPU_METHOD
/begin COMPU_METHOD m_uw_b6553p5 "" RAT_FUNC "%6.3" "kg/h" COEFFS 0 1 0 0 0 0.1 /end COMPU_METHOD
/begin COMPU_METHOD nmot_ub_q40 "" RAT_FUNC "%6.1" "1/min" COEFFS 0 1 0 0 0 40 /end COMPU_METHOD
/begin COMPU_METHOD OneToOne "" RAT_FUNC "%6.2" "-" COEFFS 0 1 0 0 0 1 /end COMPU_METHOD
/begin COMPU_METHOD PBALTUBEINTKMNFLD_SC_Compu "" TAB_VERB "%6.3" "" COMPU_TAB_REF PBALTUBEINTKMNFLD_SC_Compu /end COMPU_METHOD
/begin COMPU_VTAB PBALTUBEINTKMNFLD_SC_Compu "" TAB_VERB 2 0 "False" 1 "True" /end COMPU_VTAB
/begin COMPU_METHOD PCMPR2US_SNSR1PRSNT_SC_Compu "" TAB_VERB "%6.3" "" COMPU_TAB_REF PCMPR2US_SNSR1PRSNT_SC_Compu /end COMPU_METHOD
/begin COMPU_VTAB PCMPR2US_SNSR1PRSNT_SC_Compu "" TAB_VERB 2 0 "False" 1 "True" /end COMPU_VTAB
/begin COMPU_METHOD PCRCSPRS_SC_Compu "" TAB_VERB "%6.3" "" COMPU_TAB_REF PCRCSPRS_SC_Compu /end COMPU_METHOD
/begin COMPU_VTAB PCRCSPRS_SC_Compu "" TAB_VERB 2 0 "False" 1 "True" /end COMPU_VTAB
/begin COMPU_METHOD PCSI_SY_Compu "" TAB_VERB "%6.3" "" COMPU_TAB_REF PCSI_SY_Compu /end COMPU_METHOD
/begin COMPU_VTAB PCSI_SY_Compu "" TAB_VERB 2 0 "no PCSI" 1 "PCSI used" /end COMPU_VTAB
/begin COMPU_METHOD PEGRLPDIFF_TYPAVL_SY_Compu "" TAB_VERB "%6.3" "" COMPU_TAB_REF PEGRLPDIFF_TYPAVL_SY_Compu /end COMPU_METHOD
/begin COMPU_VTAB PEGRLPDIFF_TYPAVL_SY_Compu "" TAB_VERB 2 0 "False" 1 "True" /end COMPU_VTAB
/begin COMPU_METHOD PEGRPIPUSSENS_SC_Compu "" TAB_VERB "%6.3" "" COMPU_TAB_REF PEGRPIPUSSENS_SC_Compu /end COMPU_METHOD
/begin COMPU_VTAB PEGRPIPUSSENS_SC_Compu "" TAB_VERB 3 0 "0" 1 "1" 2 "2" /end COMPU_VTAB
/begin COMPU_METHOD PEGRVLVDSEXT_SC_Compu "" TAB_VERB "%6.3" "" COMPU_TAB_REF PEGRVLVDSEXT_SC_Compu /end COMPU_METHOD
/begin COMPU_VTAB PEGRVLVDSEXT_SC_Compu "" TAB_VERB 2 0 "False" 1 "True" /end COMPU_VTAB
/begin COMPU_METHOD PEGRVLVUSSENS_SC_Compu "" TAB_VERB "%6.3" "" COMPU_TAB_REF PEGRVLVUSSENS_SC_Compu /end COMPU_METHOD
/begin COMPU_VTAB PEGRVLVUSSENS_SC_Compu "" TAB_VERB 3 0 "0" 1 "1" 2 "2" /end COMPU_VTAB
/begin COMPU_METHOD PENVPRSNT_SC_Compu "" TAB_VERB "%6.3" "" COMPU_TAB_REF PENVPRSNT_SC_Compu /end COMPU_METHOD
/begin COMPU_VTAB PENVPRSNT_SC_Compu "" TAB_VERB 2 0 "False" 1 "True" /end COMPU_VTAB
/begin COMPU_METHOD PENVREJHIVALERR_SC_Compu "" TAB_VERB "%6.3" "" COMPU_TAB_REF PENVREJHIVALERR_SC_Compu /end COMPU_METHOD
/begin COMPU_VTAB PENVREJHIVALERR_SC_Compu "" TAB_VERB 2 0 "Disable" 1 "Enable" /end COMPU_VTAB
/begin COMPU_METHOD PENVSNSRTYP_SC_Compu "" TAB_VERB "%6.3" "" COMPU_TAB_REF PENVSNSRTYP_SC_Compu /end COMPU_METHOD
/begin COMPU_VTAB PENVSNSRTYP_SC_Compu "" TAB_VERB 3 0 "ANA" 1 "SPI" 2 "CAN" /end COMPU_VTAB
/begin COMPU_METHOD PERMSPLYSYS_SY_Compu "" TAB_VERB "%6.3" "" COMPU_TAB_REF PERMSPLYSYS_SY_Compu /end COMPU_METHOD
/begin COMPU_VTAB PERMSPLYSYS_SY_Compu "" TAB_VERB 2 0 "non-permanently supplied system" 1 "permanently supplied system" /end COMPU_VTAB
/begin COMPU_METHOD PEXHMNFPRS_SY_Compu "" TAB_VERB "%6.3" "" COMPU_TAB_REF PEXHMNFPRS_SY_Compu /end COMPU_METHOD
/begin COMPU_VTAB PEXHMNFPRS_SY_Compu "" TAB_VERB 2 0 "False" 1 "True" /end COMPU_VTAB
/begin COMPU_METHOD PFltPOpPrcPerSec_COMPU "" RAT_FUNC "%6.3" "%/s" COEFFS 0 10 0 0 0 1 /end COMPU_METHOD
/begin COMPU_METHOD PFLT_ACTV_SC_Compu "" TAB_VERB "%6.3" "" COMPU_TAB_REF PFLT_ACTV_SC_Compu /end COMPU_METHOD
/begin COMPU_VTAB PFLT_ACTV_SC_Compu "" TAB_VERB 2 0 "False" 1 "True" /end COMPU_VTAB
/begin COMPU_METHOD PFLT_BANKCFG_SC_Compu "" TAB_VERB "%6.3" "" COMPU_TAB_REF PFLT_BANKCFG_SC_Compu /end COMPU_METHOD
/begin COMPU_VTAB PFLT_BANKCFG_SC_Compu "" TAB_VERB 3 0 "ONE_BANK" 1 "Y_CONFIGURATION" 2 "TWO_BANKS" /end COMPU_VTAB
/begin COMPU_METHOD PFLT_INHOUSE_SC_Compu "" TAB_VERB "%6.3" "" COMPU_TAB_REF PFLT_INHOUSE_SC_Compu /end COMPU_METHOD
/begin COMPU_VTAB PFLT_INHOUSE_SC_Compu "" TAB_VERB 2 0 "False" 1 "True" /end COMPU_VTAB
/begin COMPU_METHOD PFUTANKLI_SC_Compu "" TAB_VERB "%6.3" "" COMPU_TAB_REF PFUTANKLI_SC_Compu /end COMPU_METHOD
/begin COMPU_VTAB PFUTANKLI_SC_Compu "" TAB_VERB 2 0 "False" 1 "True" /end COMPU_VTAB
/begin COMPU_METHOD PHYCYLCNTR_SC_Compu "" TAB_VERB "%6.3" "" COMPU_TAB_REF PHYCYLCNTR_SC_Compu /end COMPU_METHOD
/begin COMPU_VTAB PHYCYLCNTR_SC_Compu "" TAB_VERB 2 0 "False" 1 "True" /end COMPU_VTAB
/begin COMPU_METHOD PHYMOD_CLNTENTRY_SY_Compu "" TAB_VERB "%6.3" "" COMPU_TAB_REF PHYMOD_CLNTENTRY_SY_Compu /end COMPU_METHOD
/begin COMPU_VTAB PHYMOD_CLNTENTRY_SY_Compu "" TAB_VERB 3 0 "0" 1 "1" 2 "2" /end COMPU_VTAB
/begin COMPU_METHOD PIDA6_SRCODOVAL_SC_Compu "" TAB_VERB "%6.3" "" COMPU_TAB_REF PIDA6_SRCODOVAL_SC_Compu /end COMPU_METHOD
/begin COMPU_VTAB PIDA6_SRCODOVAL_SC_Compu "" TAB_VERB 4 0 "NONE" 1 "Host_ECU" 2 "Head_unit_ECU" 3 "CAN_Sync_Host_ECU" /end COMPU_VTAB
/begin COMPU_METHOD PiIClb_InjMassS32 "" RAT_FUNC "%9.8" "mg/hub" COEFFS 0 6553600 0 0 0 1 /end COMPU_METHOD
/begin COMPU_METHOD PINTKVUSPRS_SC_Compu "" TAB_VERB "%6.3" "" COMPU_TAB_REF PINTKVUSPRS_SC_Compu /end COMPU_METHOD
/begin COMPU_VTAB PINTKVUSPRS_SC_Compu "" TAB_VERB 2 0 "False" 1 "True" /end COMPU_VTAB
/begin COMPU_METHOD PINTKVUS_COMERRSNVTY_SC_Compu "" TAB_VERB "%6.3" "" COMPU_TAB_REF PINTKVUS_COMERRSNVTY_SC_Compu /end COMPU_METHOD
/begin COMPU_VTAB PINTKVUS_COMERRSNVTY_SC_Compu "" TAB_VERB 2 0 "standard" 1 "reducedSensitivity" /end COMPU_VTAB
/begin COMPU_METHOD PINTKVUS_PHYSRNGCHK_SY_Compu "" TAB_VERB "%6.3" "" COMPU_TAB_REF PINTKVUS_PHYSRNGCHK_SY_Compu /end COMPU_METHOD
/begin COMPU_VTAB PINTKVUS_PHYSRNGCHK_SY_Compu "" TAB_VERB 2 0 "PHYSRNGCHK_DISBL" 1 "PHYSRNGCHK_ENA" /end COMPU_VTAB
/begin COMPU_METHOD PINTKVUS_SNSR1PRSNT_SC_Compu "" TAB_VERB "%6.3" "" COMPU_TAB_REF PINTKVUS_SNSR1PRSNT_SC_Compu /end COMPU_METHOD
/begin COMPU_VTAB PINTKVUS_SNSR1PRSNT_SC_Compu "" TAB_VERB 2 0 "False" 1 "True" /end COMPU_VTAB
/begin COMPU_METHOD PINTKVUS_SNSR1VCC_SC_Compu "" TAB_VERB "%6.3" "" COMPU_TAB_REF PINTKVUS_SNSR1VCC_SC_Compu /end COMPU_METHOD
/begin COMPU_VTAB PINTKVUS_SNSR1VCC_SC_Compu "" TAB_VERB 4 0 "none" 1 "SSpMon1" 2 "SSpMon2" 3 "SSpMon3" /end COMPU_VTAB
/begin COMPU_METHOD PINTKVUS_SNSR2PRSNT_SC_Compu "" TAB_VERB "%6.3" "" COMPU_TAB_REF PINTKVUS_SNSR2PRSNT_SC_Compu /end COMPU_METHOD
/begin COMPU_VTAB PINTKVUS_SNSR2PRSNT_SC_Compu "" TAB_VERB 2 0 "False" 1 "True" /end COMPU_VTAB
/begin COMPU_METHOD PINTKVUS_SNSR2VCC_SC_Compu "" TAB_VERB "%6.3" "" COMPU_TAB_REF PINTKVUS_SNSR2VCC_SC_Compu /end COMPU_METHOD
/begin COMPU_VTAB PINTKVUS_SNSR2VCC_SC_Compu "" TAB_VERB 4 0 "none" 1 "SSpMon1" 2 "SSpMon2" 3 "SSpMon3" /end COMPU_VTAB
/begin COMPU_METHOD PINTKVUS_SNSRHWIF_SC_Compu "" TAB_VERB "%6.3" "" COMPU_TAB_REF PINTKVUS_SNSRHWIF_SC_Compu /end COMPU_METHOD
/begin COMPU_VTAB PINTKVUS_SNSRHWIF_SC_Compu "" TAB_VERB 4 0 "NO_Sensor" 1 "Analogous_Sensor" 2 "Digital_Sensor" 3 "Both_Sensor" /end COMPU_VTAB
/begin COMPU_METHOD PINTKVUS_SNSRWOULIMN_SC_Compu "" TAB_VERB "%6.3" "" COMPU_TAB_REF PINTKVUS_SNSRWOULIMN_SC_Compu /end COMPU_METHOD
/begin COMPU_VTAB PINTKVUS_SNSRWOULIMN_SC_Compu "" TAB_VERB 2 0 "False" 1 "True" /end COMPU_VTAB
/begin COMPU_METHOD PINTKVUS_UPDRATE_SC_Compu "" TAB_VERB "%6.3" "" COMPU_TAB_REF PINTKVUS_UPDRATE_SC_Compu /end COMPU_METHOD
/begin COMPU_VTAB PINTKVUS_UPDRATE_SC_Compu "" TAB_VERB 3 0 "Fullsegment" 1 "Halfsegment" 2 "Quartersegment" /end COMPU_VTAB
/begin COMPU_METHOD PINTVUS_SY_Compu "" TAB_VERB "%6.3" "" COMPU_TAB_REF PINTVUS_SY_Compu /end COMPU_METHOD
/begin COMPU_VTAB PINTVUS_SY_Compu "" TAB_VERB 2 0 "AirMod provides neutral value for PIntkVUs" 1 "AirDvP provides neutral value for PIntkVUs" /end COMPU_VTAB
/begin COMPU_METHOD PISTCOOLGVLVPRSNT_SC_Compu "" TAB_VERB "%6.3" "" COMPU_TAB_REF PISTCOOLGVLVPRSNT_SC_Compu /end COMPU_METHOD
/begin COMPU_VTAB PISTCOOLGVLVPRSNT_SC_Compu "" TAB_VERB 2 0 "not_present" 1 "present" /end COMPU_VTAB
/begin COMPU_METHOD PMaxCtlKi "" RAT_FUNC "%6.4" "deg CrS/(bar*s)" COEFFS 0 763.549741510925 0 0 0 1 /end COMPU_METHOD
/begin COMPU_METHOD PMaxCtlKp "" RAT_FUNC "%7.6" "deg CrS/bar" COEFFS 0 11650.8444444416 0 0 0 1 /end COMPU_METHOD
/begin COMPU_METHOD PMaxCtlKp_8 "" RAT_FUNC "%6.5" "deg CrS/bar" COEFFS 0 1456.3555555552 0 0 0 1 /end COMPU_METHOD
/begin COMPU_METHOD PMM_SWTCOORNPERPH_SC_Compu "" TAB_VERB "%6.3" "" COMPU_TAB_REF PMM_SWTCOORNPERPH_SC_Compu /end COMPU_METHOD
/begin COMPU_VTAB PMM_SWTCOORNPERPH_SC_Compu "" TAB_VERB 2 0 "False" 1 "True" /end COMPU_VTAB
/begin COMPU_METHOD PmpQnt "" RAT_FUNC "%6.3" "mm^3/rev" COEFFS 0 10 0 0 0 1 /end COMPU_METHOD
/begin COMPU_METHOD POFFSADPN_SC_Compu "" TAB_VERB "%6.3" "" COMPU_TAB_REF POFFSADPN_SC_Compu /end COMPU_METHOD
/begin COMPU_VTAB POFFSADPN_SC_Compu "" TAB_VERB 2 0 "False" 1 "True" /end COMPU_VTAB
/begin COMPU_METHOD POILVT_TYPAVL_SC_Compu "" TAB_VERB "%6.3" "" COMPU_TAB_REF POILVT_TYPAVL_SC_Compu /end COMPU_METHOD
/begin COMPU_VTAB POILVT_TYPAVL_SC_Compu "" TAB_VERB 2 0 "False" 1 "True" /end COMPU_VTAB
/begin COMPU_METHOD PosMCAirKi "" RAT_FUNC "%6.4" "(mg/str)/(%*s)" COEFFS 0 214.7483648 0 0 0 1 /end COMPU_METHOD
/begin COMPU_METHOD PosMCAirKp "" RAT_FUNC "%6.5" "(mg/str)/%" COEFFS 0 3276.8 0 0 0 1 /end COMPU_METHOD
/begin COMPU_METHOD PosMCAir_AMPC2Rat "" RAT_FUNC "%6.4" "1/mg/str" COEFFS 0 128 0 0 0 1 /end COMPU_METHOD
/begin COMPU_METHOD PosMCKd "" RAT_FUNC "%8.7" "%/AgCA" COEFFS 0 144000.000000035 0 0 0 1 /end COMPU_METHOD
/begin COMPU_METHOD PosMCKd_4 "" RAT_FUNC "%7.6" "%/AgCA" COEFFS 0 36000.0000000088 0 0 0 1 /end COMPU_METHOD
/begin COMPU_METHOD PosMCKi "" RAT_FUNC "%6.5" "%/(AgCA*s)" COEFFS 0 4718.59200000115 0 0 0 1 /end COMPU_METHOD
/begin COMPU_METHOD PosMCKi_2 "" RAT_FUNC "%6.5" "%/(AgCA*s)" COEFFS 0 2359.29600000058 0 0 0 1 /end COMPU_METHOD
/begin COMPU_METHOD PosMCKp "" RAT_FUNC "%7.6" "%/AgCA" COEFFS 0 72000.0000000176 0 0 0 1 /end COMPU_METHOD
/begin COMPU_METHOD PosMCKp_32 "" RAT_FUNC "%6.5" "%/AgCA" COEFFS 0 2250.00000000055 0 0 0 1 /end COMPU_METHOD
/begin COMPU_METHOD Prc_q0p392157_COMPU "" RAT_FUNC "%6.3" "%" COEFFS 0 255 0 0 0 100 /end COMPU_METHOD
/begin COMPU_METHOD Pres_hPa "" RAT_FUNC "%6.2" "hPa" COEFFS 0 1 0 0 0 1 /end COMPU_METHOD
/begin COMPU_METHOD p_q0p0005 "" RAT_FUNC "%6.5" "MPa" COEFFS 0 10000 0 0 0 5 /end COMPU_METHOD
/begin COMPU_METHOD q1p953125Em4_V_DIV_Ohm "" RAT_FUNC "%6.5" "V/Ohm" COEFFS 0 5120 0 0 0 1 /end COMPU_METHOD
/begin COMPU_METHOD q1p953125Em4_V_DIV_s_Ohm "" RAT_FUNC "%6.5" "V/(s*Ohm)" COEFFS 0 5120 0 0 0 1 /end COMPU_METHOD
/begin COMPU_METHOD RBPtCel_p_0p002_1 "" RAT_FUNC "%6.4" "MPa" COEFFS 0 1000 0 0 0 2 /end COMPU_METHOD
/begin COMPU_METHOD rel_q0p39 "" RAT_FUNC "%6.3" "%" COEFFS 0 256 0 0 0 100 /end COMPU_METHOD
/begin COMPU_METHOD rel_uw_b100 "" RAT_FUNC "%6.4" "%" COEFFS 0 65536 0 0 0 100 /end COMPU_METHOD
/begin COMPU_METHOD rel_uw_b3072 "" RAT_FUNC "%6.4" "%" COEFFS 0 65536 0 0 0 3072 /end COMPU_METHOD
/begin COMPU_METHOD rel_uw_q0p0234 "" RAT_FUNC "%6.4" "%" COEFFS 0 32 0 0 0 0.75 /end COMPU_METHOD
/begin COMPU_METHOD r_q3p0518Em5 "" RAT_FUNC "%7.6" "Ohm" COEFFS 0 32768 0 0 0 1 /end COMPU_METHOD
/begin COMPU_METHOD r_uw_q2 "" RAT_FUNC "%6.2" "Ohm" COEFFS 0 1 0 0 0 2 /end COMPU_METHOD
/begin COMPU_METHOD spgg_q0p0039 "" RAT_FUNC "%6.4" "V/s" COEFFS 0 65536 0 0 0 256 /end COMPU_METHOD
/begin COMPU_METHOD spg_q0p00039 "" RAT_FUNC "%6.5" "V" COEFFS 0 1 0 0 0 0.000390625 /end COMPU_METHOD
/begin COMPU_METHOD spg_q0p1 "" RAT_FUNC "%6.3" "V" COEFFS 0 1 0 0 0 0.1 /end COMPU_METHOD
/begin COMPU_METHOD spg_q1p221Em3_V "" RAT_FUNC "%6.4" "V" COEFFS 0 65536 0 0 0 80 /end COMPU_METHOD
/begin COMPU_METHOD spg_q1p8626Em8_V "" RAT_FUNC "%10.9" "V" COEFFS 0 268435456 0 0 0 5 /end COMPU_METHOD
/begin COMPU_METHOD spg_q7p629Em7_V_ms "" RAT_FUNC "%9.8" "V*ms" COEFFS 0 65536 0 0 0 0.05 /end COMPU_METHOD
/begin COMPU_METHOD spg_uw_q0p004888 "" RAT_FUNC "%6.4" "V" COEFFS 0 1 0 0 0 0.004888 /end COMPU_METHOD
/begin COMPU_METHOD Temp_Cels "" RAT_FUNC "%6.1" "deg C" COEFFS 0 10 2731.4 0 0 1 /end COMPU_METHOD
/begin COMPU_METHOD temp_q0p0234_o273 "" RAT_FUNC "%6.1" "Grad C" COEFFS 0 1 273.15 0 0 0.0234375 /end COMPU_METHOD
/begin COMPU_METHOD temp_q0p1_om40 "" RAT_FUNC "%6.2" "Grad C" COEFFS 0 1 40 0 0 0.1 /end COMPU_METHOD
/begin COMPU_METHOD temp_q3p57Em7_om273 "" RAT_FUNC "%6.1" "Grad C" COEFFS 0 8388608 2291348275.2 0 0 3 /end COMPU_METHOD
/begin COMPU_METHOD temp_ub_q0p75_o48 "" RAT_FUNC "%6.2" "Grad C" COEFFS 0 1 48 0 0 0.75 /end COMPU_METHOD
/begin COMPU_METHOD TimeDelay_ms "" RAT_FUNC "%13.2" "ms" COEFFS 0 0 1 0 2.3283064365387e-007 0 /end COMPU_METHOD
/begin COMPU_METHOD TimeDelay_s "" RAT_FUNC "%6.1" "s" COEFFS 0 0 1 0 0.00023283064365387 0 /end COMPU_METHOD
/begin COMPU_METHOD Time_Dt "" RAT_FUNC "%9.8" "s" COEFFS 0 1000000 0 0 0 1 /end COMPU_METHOD
/begin COMPU_METHOD TransR "" RAT_FUNC "%6.4" "-" COEFFS 0 100 0 0 0 1 /end COMPU_METHOD
/begin COMPU_METHOD Trq_float "" RAT_FUNC "%6.2" "Nm" COEFFS 0 1 0 0 0 1 /end COMPU_METHOD
/begin COMPU_METHOD t_q0p0001_ms "" RAT_FUNC "%7.6" "ms" COEFFS 0 10000 0 0 0 1 /end COMPU_METHOD
/begin COMPU_METHOD t_q0p001 "" RAT_FUNC "%6.5" "s" COEFFS 0 1000 0 0 0 1 /end COMPU_METHOD
/begin COMPU_METHOD t_q0p01 "" RAT_FUNC "%6.4" "s" COEFFS 0 100 0 0 0 1 /end COMPU_METHOD
/begin COMPU_METHOD t_q0p02 "" RAT_FUNC "%6.4" "s" COEFFS 0 100 0 0 0 2 /end COMPU_METHOD
/begin COMPU_METHOD t_q0p1 "" RAT_FUNC "%6.3" "s" COEFFS 0 10 0 0 0 1 /end COMPU_METHOD
/begin COMPU_METHOD t_q1 "" RAT_FUNC "%6.2" "s" COEFFS 0 1 0 0 0 1 /end COMPU_METHOD
/begin COMPU_METHOD t_q1_ms "" RAT_FUNC "%6.2" "ms" COEFFS 0 1 0 0 0 1 /end COMPU_METHOD
/begin COMPU_METHOD Vel "" RAT_FUNC "%6.4" "km/h" COEFFS 0 100 0 0 0 1 /end COMPU_METHOD
/begin COMPU_METHOD Volt_Batt "" RAT_FUNC "%6.1" "mV" COEFFS 0 0.05 0 0 0 1 /end COMPU_METHOD
/begin COMPU_METHOD Vol_q0p1_l "" RAT_FUNC "%6.3" "l" COEFFS 0 10 0 0 0 1 /end COMPU_METHOD
/begin COMPU_METHOD vol_q0p1_l "" RAT_FUNC "%6.3" "l" COEFFS 0 1 0 0 0 0.1 /end COMPU_METHOD
/begin COMPU_METHOD vol_q1 "" RAT_FUNC "%6.2" "L" COEFFS 0 1 0 0 0 1 /end COMPU_METHOD
/begin COMPU_METHOD zk100msxs_uw_b6553p6 "" RAT_FUNC "%6.1" "s" COEFFS 0 0 65536 0 10 0 /end COMPU_METHOD
/begin COMPU_METHOD zk10msxs_uw_b655p36 "" RAT_FUNC "%6.2" "s" COEFFS 0 0 65536 0 100 0 /end COMPU_METHOD
/begin COMPU_METHOD zw_sb_q0p75 "" RAT_FUNC "%6.3" "Grad KW" COEFFS 0 255 0 0 0 191.25 /end COMPU_METHOD
/begin RECORD_LAYOUT RB_Axis_S16 NO_AXIS_PTS_X 1 SWORD AXIS_PTS_X 2 SWORD INDEX_INCR DIRECT /end RECORD_LAYOUT
/begin RECORD_LAYOUT RB_Axis_U16 NO_AXIS_PTS_X 1 UWORD AXIS_PTS_X 2 UWORD INDEX_INCR DIRECT /end RECORD_LAYOUT
/begin RECORD_LAYOUT RB_CurveGroup_S8 FNC_VALUES 1 SBYTE COLUMN_DIR DIRECT /end RECORD_LAYOUT
/begin RECORD_LAYOUT RB_CurveGroup_U16 FNC_VALUES 1 UWORD COLUMN_DIR DIRECT /end RECORD_LAYOUT
/begin RECORD_LAYOUT RB_CurveGroup_U8 FNC_VALUES 1 UBYTE COLUMN_DIR DIRECT /end RECORD_LAYOUT
/begin RECORD_LAYOUT RB_Curve_S16_S8_Static NO_AXIS_PTS_X 1 SWORD AXIS_PTS_X 2 SWORD INDEX_INCR DIRECT FNC_VALUES 3 SBYTE COLUMN_DIR DIRECT STATIC_RECORD_LAYOUT /end RECORD_LAYOUT
/begin RECORD_LAYOUT RB_Curve_S16_U16_Static NO_AXIS_PTS_X 1 SWORD AXIS_PTS_X 2 SWORD INDEX_INCR DIRECT FNC_VALUES 3 UWORD COLUMN_DIR DIRECT STATIC_RECORD_LAYOUT /end RECORD_LAYOUT
/begin RECORD_LAYOUT RB_Curve_S8_U16_Static NO_AXIS_PTS_X 1 SBYTE AXIS_PTS_X 2 SBYTE INDEX_INCR DIRECT FNC_VALUES 3 UWORD COLUMN_DIR DIRECT STATIC_RECORD_LAYOUT /end RECORD_LAYOUT
/begin RECORD_LAYOUT RB_Curve_U16_U16 NO_AXIS_PTS_X 1 UWORD AXIS_PTS_X 2 UWORD INDEX_INCR DIRECT FNC_VALUES 3 UWORD COLUMN_DIR DIRECT /end RECORD_LAYOUT
/begin RECORD_LAYOUT RB_Curve_U16_U8_Static NO_AXIS_PTS_X 1 UWORD AXIS_PTS_X 2 UWORD INDEX_INCR DIRECT FNC_VALUES 3 UBYTE COLUMN_DIR DIRECT STATIC_RECORD_LAYOUT /end RECORD_LAYOUT
/begin RECORD_LAYOUT RB_Curve_U8_U8 NO_AXIS_PTS_X 1 UBYTE AXIS_PTS_X 2 UBYTE INDEX_INCR DIRECT FNC_VALUES 3 UBYTE COLUMN_DIR DIRECT /end RECORD_LAYOUT
/begin RECORD_LAYOUT RB_MapGroup_S8 FNC_VALUES 1 SBYTE COLUMN_DIR DIRECT /end RECORD_LAYOUT
/begin RECORD_LAYOUT RB_MapGroup_U16 FNC_VALUES 1 UWORD COLUMN_DIR DIRECT /end RECORD_LAYOUT
/begin RECORD_LAYOUT RB_Map_S16S16_S16 NO_AXIS_PTS_X 1 SWORD NO_AXIS_PTS_Y 2 SWORD AXIS_PTS_X 3 SWORD INDEX_INCR DIRECT AXIS_PTS_Y 4 SWORD INDEX_INCR DIRECT FNC_VALUES 5 SWORD COLUMN_DIR DIRECT /end RECORD_LAYOUT
/begin RECORD_LAYOUT RB_Map_S16U16_U16 NO_AXIS_PTS_X 1 SWORD NO_AXIS_PTS_Y 2 SWORD AXIS_PTS_X 3 SWORD INDEX_INCR DIRECT AXIS_PTS_Y 4 UWORD INDEX_INCR DIRECT FNC_VALUES 5 UWORD ROW_DIR DIRECT /end RECORD_LAYOUT
/begin RECORD_LAYOUT RB_Map_S16U8_S8 NO_AXIS_PTS_X 1 SWORD NO_AXIS_PTS_Y 2 SWORD AXIS_PTS_X 3 SWORD INDEX_INCR DIRECT AXIS_PTS_Y 4 UBYTE INDEX_INCR DIRECT FNC_VALUES 5 SBYTE COLUMN_DIR DIRECT /end RECORD_LAYOUT
/begin RECORD_LAYOUT RB_Map_U16S16_U16 NO_AXIS_PTS_X 1 UWORD NO_AXIS_PTS_Y 2 UWORD AXIS_PTS_X 3 UWORD INDEX_INCR DIRECT AXIS_PTS_Y 4 SWORD INDEX_INCR DIRECT FNC_VALUES 5 UWORD COLUMN_DIR DIRECT /end RECORD_LAYOUT
/begin RECORD_LAYOUT RB_Map_U16U16_U16 NO_AXIS_PTS_X 1 UWORD NO_AXIS_PTS_Y 2 UWORD AXIS_PTS_X 3 UWORD INDEX_INCR DIRECT AXIS_PTS_Y 4 UWORD INDEX_INCR DIRECT FNC_VALUES 5 UWORD COLUMN_DIR DIRECT /end RECORD_LAYOUT
/begin RECORD_LAYOUT RB_Map_U16U8_U16 NO_AXIS_PTS_X 1 UWORD NO_AXIS_PTS_Y 2 UWORD AXIS_PTS_X 3 UWORD INDEX_INCR DIRECT AXIS_PTS_Y 4 UBYTE INDEX_INCR DIRECT FNC_VALUES 5 UWORD COLUMN_DIR DIRECT /end RECORD_LAYOUT
/begin RECORD_LAYOUT RB_Map_U8U16_U8 NO_AXIS_PTS_X 1 UBYTE NO_AXIS_PTS_Y 2 UBYTE AXIS_PTS_X 3 UBYTE INDEX_INCR DIRECT AXIS_PTS_Y 4 UWORD INDEX_INCR DIRECT FNC_VALUES 5 UBYTE ROW_DIR DIRECT /end RECORD_LAYOUT
/begin RECORD_LAYOUT RB_Map_U8U8_S16 NO_AXIS_PTS_X 1 UBYTE NO_AXIS_PTS_Y 2 UBYTE AXIS_PTS_X 3 UBYTE INDEX_INCR DIRECT AXIS_PTS_Y 4 UBYTE INDEX_INCR DIRECT FNC_VALUES 5 SWORD COLUMN_DIR DIRECT /end RECORD_LAYOUT
/begin RECORD_LAYOUT RB_Map_U8U8_U16 NO_AXIS_PTS_X 1 UBYTE NO_AXIS_PTS_Y 2 UBYTE AXIS_PTS_X 3 UBYTE INDEX_INCR DIRECT AXIS_PTS_Y 4 UBYTE INDEX_INCR DIRECT FNC_VALUES 5 UWORD COLUMN_DIR DIRECT /end RECORD_LAYOUT
/begin RECORD_LAYOUT RB_Map_U8U8_U8 NO_AXIS_PTS_X 1 UBYTE NO_AXIS_PTS_Y 2 UBYTE AXIS_PTS_X 3 UBYTE INDEX_INCR DIRECT AXIS_PTS_Y 4 UBYTE INDEX_INCR DIRECT FNC_VALUES 5 UBYTE COLUMN_DIR DIRECT /end RECORD_LAYOUT
/begin RECORD_LAYOUT RB_ValA_Wu8 FNC_VALUES 1 UBYTE COLUMN_DIR DIRECT /end RECORD_LAYOUT
/begin RECORD_LAYOUT RB_Val_Wboolean FNC_VALUES 1 UBYTE COLUMN_DIR DIRECT /end RECORD_LAYOUT
/begin RECORD_LAYOUT RB_Val_Ws16 FNC_VALUES 1 SWORD COLUMN_DIR DIRECT /end RECORD_LAYOUT
/begin RECORD_LAYOUT RB_Val_Ws32 FNC_VALUES 1 SLONG COLUMN_DIR DIRECT /end RECORD_LAYOUT
/begin RECORD_LAYOUT RB_Val_Ws8 FNC_VALUES 1 SBYTE COLUMN_DIR DIRECT /end RECORD_LAYOUT
/begin RECORD_LAYOUT RB_Val_Wu16 FNC_VALUES 1 UWORD COLUMN_DIR DIRECT /end RECORD_LAYOUT
/begin RECORD_LAYOUT RB_Val_Wu8 FNC_VALUES 1 UBYTE COLUMN_DIR DIRECT /end RECORD_LAYOUT
/begin RECORD_LAYOUT Val_Ws16 FNC_VALUES 1 SWORD COLUMN_DIR DIRECT /end RECORD_LAYOUT
/begin RECORD_LAYOUT Val_Ws32 FNC_VALUES 1 SLONG COLUMN_DIR DIRECT /end RECORD_LAYOUT
/begin RECORD_LAYOUT Val_Wu8 FNC_VALUES 1 UBYTE COLUMN_DIR DIRECT /end RECORD_LAYOUT
/end MODULE
/end PROJECT
