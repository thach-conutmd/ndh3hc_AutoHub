ASAP2_VERSION 1 60
/begin PROJECT MG1CS022 "MG1CS022"
/begin HEADER "" VERSION "MG1CS022_62XSC_V037" PROJECT_NO MG1CS022 /end HEADER
/begin MODULE DIM ""
/begin MOD_COMMON "" BYTE_ORDER MSB_LAST ALIGNMENT_BYTE 1 ALIGNMENT_WORD 2 ALIGNMENT_LONG 4 ALIGNMENT_INT64 4 ALIGNMENT_FLOAT32_IEEE 4 ALIGNMENT_FLOAT64_IEEE 4 DATA_SIZE 32 /end MOD_COMMON
/begin CHARACTERISTIC MisfDet_axleSeln_C "Axle selection for rough road detection" VALUE 0x8057B7F8 RB_Val_Wu8 3.000 dez 0.00 3.000 FORMAT "%5.3" EXTENDED_LIMITS 0.00 255.0 /end CHARACTERISTIC
/begin CHARACTERISTIC MisfDet_dnThdContRdcFac_C "factor on negative dn Values for reduction of dnThdCont" VALUE 0x8057BABE RB_Val_Wu16 0.9999847 fak_uw_b1 0.00 0.9999847 FORMAT "%9.7" /end CHARACTERISTIC
/begin CHARACTERISTIC MisfDet_dnThdContRdcIdx_C "selection of dn value in ascending order for reduction of dnThdCont" VALUE 0x8057BAC0 RB_Val_Wu8 255.0 OneToOne 0.00 255.0 FORMAT "%5.1" /end CHARACTERISTIC
/begin CHARACTERISTIC MisfDet_dnThdDecFilFac_C "filter factore for limitation of negative gradient of detection threshold" VALUE 0x8057BAC2 RB_Val_Wu16 0.9999847 fak_uw_b1 0.00 0.9999847 FORMAT "%9.7" /end CHARACTERISTIC
/begin CHARACTERISTIC MisfDet_dnThdDecMaxCont_T "maximum negative gradient of detection threshold for continuous misfires" CURVE 0x8057BAC4 RB_Curve_S16_S16 4095.938 dn_Compu -2048.000 2047.938 FORMAT "%8.3"
 /begin AXIS_DESCR STD_AXIS MisfDet_nEngSync EngN 4 -16384.00 16383.50 FORMAT "%8.2" DEPOSIT ABSOLUTE /end AXIS_DESCR
/end CHARACTERISTIC
/begin CHARACTERISTIC MisfDet_dnThdDecMaxDif_T "maximum negative gradient of detection threshold for differential method" CURVE 0x8057BAD6 RB_Curve_S16_S16 4095.938 dn_Compu -2048.000 2047.938 FORMAT "%8.3"
 /begin AXIS_DESCR STD_AXIS MisfDet_nEngSync EngN 4 -16384.00 16383.50 FORMAT "%8.2" DEPOSIT ABSOLUTE /end AXIS_DESCR
/end CHARACTERISTIC
/begin CHARACTERISTIC MisfDet_dnThdDecMax_T "maximum negative gradient of detection threshold" CURVE 0x8057BAE8 RB_Curve_S16_S16 4095.938 dn_Compu -2048.000 2047.938 FORMAT "%8.3"
 /begin AXIS_DESCR STD_AXIS MisfDet_nEngSync EngN 4 -16384.00 16383.50 FORMAT "%8.2" DEPOSIT ABSOLUTE /end AXIS_DESCR
/end CHARACTERISTIC
/begin CHARACTERISTIC MisfDet_dnThdFacLteCmbDrv.Cmn_GT "Factor to detection threshold at late combustion barycenter / all transmission types" CURVE 0x8057BC2C RB_CurveGroup_U16 1.999969 fak_uw_b2 0.00 1.999969 FORMAT "%8.6"
 /begin AXIS_DESCR COM_AXIS MisfDet_iaMdnAvrg kw_q0p75 4 -96.00 95.25 FORMAT "%5.2" AXIS_PTS_REF MisfDet_dnThdFacLteCmbDrv_AX /end AXIS_DESCR
/end CHARACTERISTIC
/begin AXIS_PTS MisfDet_dnThdFacLteCmbDrv_AX "ignition angle axes of factor to detection threshold at late combustion barycenter" 0x8057BB80 MisfDet_iaMdnAvrg RB_Axis_S8 191.3 kw_q0p75 4 -96.00 95.25 FORMAT "%5.2" DEPOSIT ABSOLUTE /end AXIS_PTS
/begin CHARACTERISTIC MisfDet_dnThdFacLteCmbIdle.Cmn_GT "Factor to detection threshold at late combustion barycenter at low idle / all transmission types" CURVE 0x8057BC34 RB_CurveGroup_U16 1.999969 fak_uw_b2 0.00 1.999969 FORMAT "%8.6"
 /begin AXIS_DESCR COM_AXIS MisfDet_iaMdnAvrg kw_q0p75 4 -96.00 95.25 FORMAT "%5.2" AXIS_PTS_REF MisfDet_dnThdFacLteCmbIdle_AX /end AXIS_DESCR
/end CHARACTERISTIC
/begin AXIS_PTS MisfDet_dnThdFacLteCmbIdle_AX "ignition angle axes of factor to detection threshold at late combustion barycenter at idle" 0x8057BB85 MisfDet_iaMdnAvrg RB_Axis_S8 191.3 kw_q0p75 4 -96.00 95.25 FORMAT "%5.2" DEPOSIT ABSOLUTE /end AXIS_PTS
/begin CHARACTERISTIC MisfDet_dnThdFacStrt_T "Factor to detection threshold at engine start" CURVE 0x8057BAFA RB_Curve_U16_U16 1.999969 fak_uw_b2 0.00 1.999969 FORMAT "%8.6"
 /begin AXIS_DESCR STD_AXIS MisfDet_tiEngRunSum t_q0p1 4 0.00 6553.500 FORMAT "%8.3" DEPOSIT ABSOLUTE /end AXIS_DESCR
/end CHARACTERISTIC
/begin AXIS_PTS MisfDet_dnThdIdleLteCmbTq_AX "torque axes for threshold map idle late combustion" 0x8057BB8A MisfDet_tqBascSync RB_Axis_U16 99.99847 rel_uw_b100 6 0.00 99.99847 FORMAT "%8.5" DEPOSIT ABSOLUTE /end AXIS_PTS
/begin AXIS_PTS MisfDet_dnThdIdleTq_AX "torque axis for base maps at idle" 0x8057BB98 MisfDet_tqBascSync RB_Axis_U16 99.99847 rel_uw_b100 6 0.00 99.99847 FORMAT "%8.5" DEPOSIT ABSOLUTE /end AXIS_PTS
/begin CHARACTERISTIC MisfDet_dnThdMapDrvCatHeatGrip.Std.Cmn_GM "Thresholds for catalyst heating at driving operation closed clutch / standard engine roughness / all transmission types" MAP 0x8057BC3C RB_MapGroup_S16 4095.938 dn_Compu -2048.000 2047.938 FORMAT "%8.3"
 /begin AXIS_DESCR COM_AXIS MisfDet_tqBascSync rel_uw_b100 8 0.00 99.99847 FORMAT "%8.5" AXIS_PTS_REF MisfDet_dnThdTq_AX /end AXIS_DESCR
 /begin AXIS_DESCR COM_AXIS MisfDet_nEngSync EngN 8 -16384.00 16383.50 FORMAT "%8.2" AXIS_PTS_REF MisfDet_dnThdN_AX /end AXIS_DESCR
/end CHARACTERISTIC
/begin CHARACTERISTIC MisfDet_dnThdMapDrvCatHeatGrip.Cont.Cmn_GM "Thresholds for catalyst heating at driving operation closed clutch / continuous misfire (filtered engine roughness) / all transmission types" MAP 0x8057BCBC RB_MapGroup_S16 4095.938 dn_Compu -2048.000 2047.938 FORMAT "%8.3"
 /begin AXIS_DESCR COM_AXIS MisfDet_tqBascSync rel_uw_b100 8 0.00 99.99847 FORMAT "%8.5" AXIS_PTS_REF MisfDet_dnThdTq_AX /end AXIS_DESCR
 /begin AXIS_DESCR COM_AXIS MisfDet_nEngSync EngN 8 -16384.00 16383.50 FORMAT "%8.2" AXIS_PTS_REF MisfDet_dnThdN_AX /end AXIS_DESCR
/end CHARACTERISTIC
/begin CHARACTERISTIC MisfDet_dnThdMapDrvCatHeatGrip.Dif.Cmn_GM "Thresholds for catalyst heating at driving operation closed clutch / differetial engine roughness / all transmission types" MAP 0x8057BD3C RB_MapGroup_S16 4095.938 dn_Compu -2048.000 2047.938 FORMAT "%8.3"
 /begin AXIS_DESCR COM_AXIS MisfDet_tqBascSync rel_uw_b100 8 0.00 99.99847 FORMAT "%8.5" AXIS_PTS_REF MisfDet_dnThdTq_AX /end AXIS_DESCR
 /begin AXIS_DESCR COM_AXIS MisfDet_nEngSync EngN 8 -16384.00 16383.50 FORMAT "%8.2" AXIS_PTS_REF MisfDet_dnThdN_AX /end AXIS_DESCR
/end CHARACTERISTIC
/begin CHARACTERISTIC MisfDet_dnThdMapDrvCatHeatOpen.Std.Cmn_GM "Thresholds for catalyst heating at driving operation slipping clutch / standard engine roughness / all transmission types" MAP 0x8057BDBC RB_MapGroup_S16 4095.938 dn_Compu -2048.000 2047.938 FORMAT "%8.3"
 /begin AXIS_DESCR COM_AXIS MisfDet_tqBascSync rel_uw_b100 8 0.00 99.99847 FORMAT "%8.5" AXIS_PTS_REF MisfDet_dnThdTq_AX /end AXIS_DESCR
 /begin AXIS_DESCR COM_AXIS MisfDet_nEngSync EngN 8 -16384.00 16383.50 FORMAT "%8.2" AXIS_PTS_REF MisfDet_dnThdN_AX /end AXIS_DESCR
/end CHARACTERISTIC
/begin CHARACTERISTIC MisfDet_dnThdMapDrvCatHeatOpen.Cont.Cmn_GM "Thresholds for catalyst heating at driving operation slipping clutch / continuous misfire (filtered engine roughness) / all transmission types" MAP 0x8057BE3C RB_MapGroup_S16 4095.938 dn_Compu -2048.000 2047.938 FORMAT "%8.3"
 /begin AXIS_DESCR COM_AXIS MisfDet_tqBascSync rel_uw_b100 8 0.00 99.99847 FORMAT "%8.5" AXIS_PTS_REF MisfDet_dnThdTq_AX /end AXIS_DESCR
 /begin AXIS_DESCR COM_AXIS MisfDet_nEngSync EngN 8 -16384.00 16383.50 FORMAT "%8.2" AXIS_PTS_REF MisfDet_dnThdN_AX /end AXIS_DESCR
/end CHARACTERISTIC
/begin CHARACTERISTIC MisfDet_dnThdMapDrvCatHeatOpen.Dif.Cmn_GM "Thresholds for catalyst heating at driving operation slipping clutch / differetial engine roughness / all transmission types" MAP 0x8057BEBC RB_MapGroup_S16 4095.938 dn_Compu -2048.000 2047.938 FORMAT "%8.3"
 /begin AXIS_DESCR COM_AXIS MisfDet_tqBascSync rel_uw_b100 8 0.00 99.99847 FORMAT "%8.5" AXIS_PTS_REF MisfDet_dnThdTq_AX /end AXIS_DESCR
 /begin AXIS_DESCR COM_AXIS MisfDet_nEngSync EngN 8 -16384.00 16383.50 FORMAT "%8.2" AXIS_PTS_REF MisfDet_dnThdN_AX /end AXIS_DESCR
/end CHARACTERISTIC
/begin CHARACTERISTIC MisfDet_dnThdMapDrvCatHeatSlip.Std.Cmn_GM "Thresholds for catalyst heating at driving operation opened clutch / standard engine roughness / all transmission types" MAP 0x8057BF3C RB_MapGroup_S16 4095.938 dn_Compu -2048.000 2047.938 FORMAT "%8.3"
 /begin AXIS_DESCR COM_AXIS MisfDet_tqBascSync rel_uw_b100 8 0.00 99.99847 FORMAT "%8.5" AXIS_PTS_REF MisfDet_dnThdTq_AX /end AXIS_DESCR
 /begin AXIS_DESCR COM_AXIS MisfDet_nEngSync EngN 8 -16384.00 16383.50 FORMAT "%8.2" AXIS_PTS_REF MisfDet_dnThdN_AX /end AXIS_DESCR
/end CHARACTERISTIC
/begin CHARACTERISTIC MisfDet_dnThdMapDrvCatHeatSlip.Cont.Cmn_GM "Thresholds for catalyst heating at driving operation opened clutch / continuous misfire (filtered engine roughness) / all transmission types" MAP 0x8057BFBC RB_MapGroup_S16 4095.938 dn_Compu -2048.000 2047.938 FORMAT "%8.3"
 /begin AXIS_DESCR COM_AXIS MisfDet_tqBascSync rel_uw_b100 8 0.00 99.99847 FORMAT "%8.5" AXIS_PTS_REF MisfDet_dnThdTq_AX /end AXIS_DESCR
 /begin AXIS_DESCR COM_AXIS MisfDet_nEngSync EngN 8 -16384.00 16383.50 FORMAT "%8.2" AXIS_PTS_REF MisfDet_dnThdN_AX /end AXIS_DESCR
/end CHARACTERISTIC
/begin CHARACTERISTIC MisfDet_dnThdMapDrvCatHeatSlip.Dif.Cmn_GM "Thresholds for catalyst heating at driving operation opened clutch / differetial engine roughness / all transmission types" MAP 0x8057C03C RB_MapGroup_S16 4095.938 dn_Compu -2048.000 2047.938 FORMAT "%8.3"
 /begin AXIS_DESCR COM_AXIS MisfDet_tqBascSync rel_uw_b100 8 0.00 99.99847 FORMAT "%8.5" AXIS_PTS_REF MisfDet_dnThdTq_AX /end AXIS_DESCR
 /begin AXIS_DESCR COM_AXIS MisfDet_nEngSync EngN 8 -16384.00 16383.50 FORMAT "%8.2" AXIS_PTS_REF MisfDet_dnThdN_AX /end AXIS_DESCR
/end CHARACTERISTIC
/begin CHARACTERISTIC MisfDet_dnThdMapIdle.Std.Cmn_GT "Thresholds for idle / standard engine roughness / all transmission types" CURVE 0x8057C0BC RB_CurveGroup_S16 4095.938 dn_Compu -2048.000 2047.938 FORMAT "%8.3"
 /begin AXIS_DESCR COM_AXIS MisfDet_tqBascSync rel_uw_b100 6 0.00 99.99847 FORMAT "%8.5" AXIS_PTS_REF MisfDet_dnThdIdleTq_AX /end AXIS_DESCR
/end CHARACTERISTIC
/begin CHARACTERISTIC MisfDet_dnThdMapIdle.Cont.Cmn_GT "Thresholds for idle / continuous misfire (filtered engine roughness) / all transmission types" CURVE 0x8057C0C8 RB_CurveGroup_S16 4095.938 dn_Compu -2048.000 2047.938 FORMAT "%8.3"
 /begin AXIS_DESCR COM_AXIS MisfDet_tqBascSync rel_uw_b100 6 0.00 99.99847 FORMAT "%8.5" AXIS_PTS_REF MisfDet_dnThdIdleTq_AX /end AXIS_DESCR
/end CHARACTERISTIC
/begin CHARACTERISTIC MisfDet_dnThdMapIdle.Dif.Cmn_GT "Thresholds for idle / differetial engine roughness / all transmission types" CURVE 0x8057C0D4 RB_CurveGroup_S16 4095.938 dn_Compu -2048.000 2047.938 FORMAT "%8.3"
 /begin AXIS_DESCR COM_AXIS MisfDet_tqBascSync rel_uw_b100 6 0.00 99.99847 FORMAT "%8.5" AXIS_PTS_REF MisfDet_dnThdIdleTq_AX /end AXIS_DESCR
/end CHARACTERISTIC
/begin CHARACTERISTIC MisfDet_dnThdMapIdleAltvPosn.Std.Cmn_GT "Thresholds for idle alternative segment position / standard engine roughness / all transmission types" CURVE 0x8057C0E0 RB_CurveGroup_S16 4095.938 dn_Compu -2048.000 2047.938 FORMAT "%8.3"
 /begin AXIS_DESCR COM_AXIS MisfDet_tqBascSync rel_uw_b100 6 0.00 99.99847 FORMAT "%8.5" AXIS_PTS_REF MisfDet_dnThdIdleTq_AX /end AXIS_DESCR
/end CHARACTERISTIC
/begin CHARACTERISTIC MisfDet_dnThdMapIdleAltvPosn.Cont.Cmn_GT "Thresholds for idle alternative segment position / continuous misfire (filtered engine roughness) / all transmission types" CURVE 0x8057C0EC RB_CurveGroup_S16 4095.938 dn_Compu -2048.000 2047.938 FORMAT "%8.3"
 /begin AXIS_DESCR COM_AXIS MisfDet_tqBascSync rel_uw_b100 6 0.00 99.99847 FORMAT "%8.5" AXIS_PTS_REF MisfDet_dnThdIdleTq_AX /end AXIS_DESCR
/end CHARACTERISTIC
/begin CHARACTERISTIC MisfDet_dnThdMapIdleAltvPosn.Dif.Cmn_GT "Thresholds for idle alternative segment position / differetial engine roughness / all transmission types" CURVE 0x8057C0F8 RB_CurveGroup_S16 4095.938 dn_Compu -2048.000 2047.938 FORMAT "%8.3"
 /begin AXIS_DESCR COM_AXIS MisfDet_tqBascSync rel_uw_b100 6 0.00 99.99847 FORMAT "%8.5" AXIS_PTS_REF MisfDet_dnThdIdleTq_AX /end AXIS_DESCR
/end CHARACTERISTIC
/begin CHARACTERISTIC MisfDet_dnThdMapIdleCatHeat.Std.Cmn_GT "Thresholds for idle catalyst heating / standard engine roughness / all transmission types" CURVE 0x8057C104 RB_CurveGroup_S16 4095.938 dn_Compu -2048.000 2047.938 FORMAT "%8.3"
 /begin AXIS_DESCR COM_AXIS MisfDet_tqBascSync rel_uw_b100 6 0.00 99.99847 FORMAT "%8.5" AXIS_PTS_REF MisfDet_dnThdIdleLteCmbTq_AX /end AXIS_DESCR
/end CHARACTERISTIC
/begin CHARACTERISTIC MisfDet_dnThdMapIdleCatHeat.Cont.Cmn_GT "Thresholds for idle catalyst heating / continuous misfire (filtered engine roughness) / all transmission types" CURVE 0x8057C110 RB_CurveGroup_S16 4095.938 dn_Compu -2048.000 2047.938 FORMAT "%8.3"
 /begin AXIS_DESCR COM_AXIS MisfDet_tqBascSync rel_uw_b100 6 0.00 99.99847 FORMAT "%8.5" AXIS_PTS_REF MisfDet_dnThdIdleLteCmbTq_AX /end AXIS_DESCR
/end CHARACTERISTIC
/begin CHARACTERISTIC MisfDet_dnThdMapIdleCatHeat.Dif.Cmn_GT "Thresholds for idle catalyst heating / differetial engine roughness / all transmission types" CURVE 0x8057C11C RB_CurveGroup_S16 4095.938 dn_Compu -2048.000 2047.938 FORMAT "%8.3"
 /begin AXIS_DESCR COM_AXIS MisfDet_tqBascSync rel_uw_b100 6 0.00 99.99847 FORMAT "%8.5" AXIS_PTS_REF MisfDet_dnThdIdleLteCmbTq_AX /end AXIS_DESCR
/end CHARACTERISTIC
/begin CHARACTERISTIC MisfDet_dnThdMapIdleCatWrm.Std.Cmn_GT "Thresholds for idle catalyst warming / standard engine roughness / all transmission types" CURVE 0x8057C128 RB_CurveGroup_S16 4095.938 dn_Compu -2048.000 2047.938 FORMAT "%8.3"
 /begin AXIS_DESCR COM_AXIS MisfDet_tqBascSync rel_uw_b100 6 0.00 99.99847 FORMAT "%8.5" AXIS_PTS_REF MisfDet_dnThdIdleTq_AX /end AXIS_DESCR
/end CHARACTERISTIC
/begin CHARACTERISTIC MisfDet_dnThdMapIdleCatWrm.Cont.Cmn_GT "Thresholds for idle catalyst warming / continuous misfire (filtered engine roughness) / all transmission types" CURVE 0x8057C134 RB_CurveGroup_S16 4095.938 dn_Compu -2048.000 2047.938 FORMAT "%8.3"
 /begin AXIS_DESCR COM_AXIS MisfDet_tqBascSync rel_uw_b100 6 0.00 99.99847 FORMAT "%8.5" AXIS_PTS_REF MisfDet_dnThdIdleTq_AX /end AXIS_DESCR
/end CHARACTERISTIC
/begin CHARACTERISTIC MisfDet_dnThdMapIdleCatWrm.Dif.Cmn_GT "Thresholds for idle catalyst warming / differetial engine roughness / all transmission types" CURVE 0x8057C140 RB_CurveGroup_S16 4095.938 dn_Compu -2048.000 2047.938 FORMAT "%8.3"
 /begin AXIS_DESCR COM_AXIS MisfDet_tqBascSync rel_uw_b100 6 0.00 99.99847 FORMAT "%8.5" AXIS_PTS_REF MisfDet_dnThdIdleTq_AX /end AXIS_DESCR
/end CHARACTERISTIC
/begin CHARACTERISTIC MisfDet_dnThdMapPtGrip.Std.Cmn_GM "Thresholds for closed clutch / standard engine roughness / all transmission types" MAP 0x8057C14C RB_MapGroup_S16 4095.938 dn_Compu -2048.000 2047.938 FORMAT "%8.3"
 /begin AXIS_DESCR COM_AXIS MisfDet_tqBascSync rel_uw_b100 8 0.00 99.99847 FORMAT "%8.5" AXIS_PTS_REF MisfDet_dnThdTq_AX /end AXIS_DESCR
 /begin AXIS_DESCR COM_AXIS MisfDet_nEngSync EngN 8 -16384.00 16383.50 FORMAT "%8.2" AXIS_PTS_REF MisfDet_dnThdN_AX /end AXIS_DESCR
/end CHARACTERISTIC
/begin CHARACTERISTIC MisfDet_dnThdMapPtGrip.Cont.Cmn_GM "Thresholds for closed clutch / continuous misfire (filtered engine roughness) / all transmission types" MAP 0x8057C1CC RB_MapGroup_S16 4095.938 dn_Compu -2048.000 2047.938 FORMAT "%8.3"
 /begin AXIS_DESCR COM_AXIS MisfDet_tqBascSync rel_uw_b100 8 0.00 99.99847 FORMAT "%8.5" AXIS_PTS_REF MisfDet_dnThdTq_AX /end AXIS_DESCR
 /begin AXIS_DESCR COM_AXIS MisfDet_nEngSync EngN 8 -16384.00 16383.50 FORMAT "%8.2" AXIS_PTS_REF MisfDet_dnThdN_AX /end AXIS_DESCR
/end CHARACTERISTIC
/begin CHARACTERISTIC MisfDet_dnThdMapPtGrip.Dif.Cmn_GM "Thresholds for closed clutch / differetial engine roughness / all transmission types" MAP 0x8057C24C RB_MapGroup_S16 4095.938 dn_Compu -2048.000 2047.938 FORMAT "%8.3"
 /begin AXIS_DESCR COM_AXIS MisfDet_tqBascSync rel_uw_b100 8 0.00 99.99847 FORMAT "%8.5" AXIS_PTS_REF MisfDet_dnThdTq_AX /end AXIS_DESCR
 /begin AXIS_DESCR COM_AXIS MisfDet_nEngSync EngN 8 -16384.00 16383.50 FORMAT "%8.2" AXIS_PTS_REF MisfDet_dnThdN_AX /end AXIS_DESCR
/end CHARACTERISTIC
/begin CHARACTERISTIC MisfDet_dnThdMapPtOpen.Std.Cmn_GM "Thresholds for slipping clutch / standard engine roughness / all transmission types" MAP 0x8057C2CC RB_MapGroup_S16 4095.938 dn_Compu -2048.000 2047.938 FORMAT "%8.3"
 /begin AXIS_DESCR COM_AXIS MisfDet_tqBascSync rel_uw_b100 8 0.00 99.99847 FORMAT "%8.5" AXIS_PTS_REF MisfDet_dnThdTq_AX /end AXIS_DESCR
 /begin AXIS_DESCR COM_AXIS MisfDet_nEngSync EngN 8 -16384.00 16383.50 FORMAT "%8.2" AXIS_PTS_REF MisfDet_dnThdN_AX /end AXIS_DESCR
/end CHARACTERISTIC
/begin CHARACTERISTIC MisfDet_dnThdMapPtOpen.Cont.Cmn_GM "Thresholds for slipping clutch / continuous misfire (filtered engine roughness) / all transmission types" MAP 0x8057C34C RB_MapGroup_S16 4095.938 dn_Compu -2048.000 2047.938 FORMAT "%8.3"
 /begin AXIS_DESCR COM_AXIS MisfDet_tqBascSync rel_uw_b100 8 0.00 99.99847 FORMAT "%8.5" AXIS_PTS_REF MisfDet_dnThdTq_AX /end AXIS_DESCR
 /begin AXIS_DESCR COM_AXIS MisfDet_nEngSync EngN 8 -16384.00 16383.50 FORMAT "%8.2" AXIS_PTS_REF MisfDet_dnThdN_AX /end AXIS_DESCR
/end CHARACTERISTIC
/begin CHARACTERISTIC MisfDet_dnThdMapPtOpen.Dif.Cmn_GM "Thresholds for slipping clutch / differetial engine roughness / all transmission types" MAP 0x8057C3CC RB_MapGroup_S16 4095.938 dn_Compu -2048.000 2047.938 FORMAT "%8.3"
 /begin AXIS_DESCR COM_AXIS MisfDet_tqBascSync rel_uw_b100 8 0.00 99.99847 FORMAT "%8.5" AXIS_PTS_REF MisfDet_dnThdTq_AX /end AXIS_DESCR
 /begin AXIS_DESCR COM_AXIS MisfDet_nEngSync EngN 8 -16384.00 16383.50 FORMAT "%8.2" AXIS_PTS_REF MisfDet_dnThdN_AX /end AXIS_DESCR
/end CHARACTERISTIC
/begin CHARACTERISTIC MisfDet_dnThdMapPtSlip.Std.Cmn_GM "Thresholds for opened clutch / standard engine roughness / all transmission types" MAP 0x8057C44C RB_MapGroup_S16 4095.938 dn_Compu -2048.000 2047.938 FORMAT "%8.3"
 /begin AXIS_DESCR COM_AXIS MisfDet_tqBascSync rel_uw_b100 8 0.00 99.99847 FORMAT "%8.5" AXIS_PTS_REF MisfDet_dnThdTq_AX /end AXIS_DESCR
 /begin AXIS_DESCR COM_AXIS MisfDet_nEngSync EngN 8 -16384.00 16383.50 FORMAT "%8.2" AXIS_PTS_REF MisfDet_dnThdN_AX /end AXIS_DESCR
/end CHARACTERISTIC
/begin CHARACTERISTIC MisfDet_dnThdMapPtSlip.Cont.Cmn_GM "Thresholds for opened clutch / continuous misfire (filtered engine roughness) / all transmission types" MAP 0x8057C4CC RB_MapGroup_S16 4095.938 dn_Compu -2048.000 2047.938 FORMAT "%8.3"
 /begin AXIS_DESCR COM_AXIS MisfDet_tqBascSync rel_uw_b100 8 0.00 99.99847 FORMAT "%8.5" AXIS_PTS_REF MisfDet_dnThdTq_AX /end AXIS_DESCR
 /begin AXIS_DESCR COM_AXIS MisfDet_nEngSync EngN 8 -16384.00 16383.50 FORMAT "%8.2" AXIS_PTS_REF MisfDet_dnThdN_AX /end AXIS_DESCR
/end CHARACTERISTIC
/begin CHARACTERISTIC MisfDet_dnThdMapPtSlip.Dif.Cmn_GM "Thresholds for opened clutch / differetial engine roughness / all transmission types" MAP 0x8057C54C RB_MapGroup_S16 4095.938 dn_Compu -2048.000 2047.938 FORMAT "%8.3"
 /begin AXIS_DESCR COM_AXIS MisfDet_tqBascSync rel_uw_b100 8 0.00 99.99847 FORMAT "%8.5" AXIS_PTS_REF MisfDet_dnThdTq_AX /end AXIS_DESCR
 /begin AXIS_DESCR COM_AXIS MisfDet_nEngSync EngN 8 -16384.00 16383.50 FORMAT "%8.2" AXIS_PTS_REF MisfDet_dnThdN_AX /end AXIS_DESCR
/end CHARACTERISTIC
/begin CHARACTERISTIC MisfDet_dnThdMinBlkDnAdpnNvCorrn.Cmn_GM "minimum limitation for inhibiting the usage of long time adaptation values / all transmission types" MAP 0x8057C5CC RB_MapGroup_S16 2047.938 dn_Compu 0.00 2047.938 FORMAT "%8.3" EXTENDED_LIMITS -2048.000 2047.938
 /begin AXIS_DESCR COM_AXIS MisfDet_tqBascSync rel_uw_b100 4 0.00 99.99847 FORMAT "%8.5" AXIS_PTS_REF MisfDet_dnThdMinDnAdpnTq_AX /end AXIS_DESCR
 /begin AXIS_DESCR COM_AXIS MisfDet_nEngSync EngN 8 -16384.00 16383.50 FORMAT "%8.2" AXIS_PTS_REF MisfDet_dnThdMinDnAdpnN_AX /end AXIS_DESCR
/end CHARACTERISTIC
/begin CHARACTERISTIC MisfDet_dnThdMinBlkDnAdpnNvCorrn1.Cmn_GM "minimum limitation for inhibiting the usage of long time adaptation values / all transmission types" MAP 0x8057C60C RB_MapGroup_S16 2047.938 dn_Compu 0.00 2047.938 FORMAT "%8.3" EXTENDED_LIMITS -2048.000 2047.938
 /begin AXIS_DESCR COM_AXIS MisfDet_tqBascSync rel_uw_b100 4 0.00 99.99847 FORMAT "%8.5" AXIS_PTS_REF MisfDet_dnThdMinDnAdpnTq_AX /end AXIS_DESCR
 /begin AXIS_DESCR COM_AXIS MisfDet_nEngSync EngN 8 -16384.00 16383.50 FORMAT "%8.2" AXIS_PTS_REF MisfDet_dnThdMinDnAdpnN_AX /end AXIS_DESCR
/end CHARACTERISTIC
/begin CHARACTERISTIC MisfDet_dnThdMinCont.Cmn_GM "Threshold limitation for continuous misfires / all transmission types" MAP 0x8057C64C RB_MapGroup_S16 2047.938 dn_Compu 0.00 2047.938 FORMAT "%8.3" EXTENDED_LIMITS -2048.000 2047.938
 /begin AXIS_DESCR COM_AXIS MisfDet_tqBascSync rel_uw_b100 8 0.00 99.99847 FORMAT "%8.5" AXIS_PTS_REF MisfDet_dnThdTq_AX /end AXIS_DESCR
 /begin AXIS_DESCR COM_AXIS MisfDet_nEngSync EngN 8 -16384.00 16383.50 FORMAT "%8.2" AXIS_PTS_REF MisfDet_dnThdN_AX /end AXIS_DESCR
/end CHARACTERISTIC
/begin CHARACTERISTIC MisfDet_dnThdMinContIdle_M "Threshold limitation for continuous misfires in half engine mode" MAP 0x8057BBA6 RB_Map_U16S16_S16 4095.938 dn_Compu -2048.000 2047.938 FORMAT "%8.3"
 /begin AXIS_DESCR STD_AXIS MisfDet_tqBascSync rel_uw_b100 4 0.00 99.99847 FORMAT "%8.5" DEPOSIT ABSOLUTE /end AXIS_DESCR
 /begin AXIS_DESCR STD_AXIS MisfDet_nEngSync EngN 3 -16384.00 16383.50 FORMAT "%8.2" DEPOSIT ABSOLUTE /end AXIS_DESCR
/end CHARACTERISTIC
/begin CHARACTERISTIC MisfDet_dnThdMinDnAdpn.Cmn_GM "minimum limitation in case of incomplete dn adaptation / all transmission types" MAP 0x8057C6CC RB_MapGroup_S16 2047.938 dn_Compu 0.00 2047.938 FORMAT "%8.3" EXTENDED_LIMITS -2048.000 2047.938
 /begin AXIS_DESCR COM_AXIS MisfDet_tqBascSync rel_uw_b100 4 0.00 99.99847 FORMAT "%8.5" AXIS_PTS_REF MisfDet_dnThdMinDnAdpnTq_AX /end AXIS_DESCR
 /begin AXIS_DESCR COM_AXIS MisfDet_nEngSync EngN 8 -16384.00 16383.50 FORMAT "%8.2" AXIS_PTS_REF MisfDet_dnThdMinDnAdpnN_AX /end AXIS_DESCR
/end CHARACTERISTIC
/begin AXIS_PTS MisfDet_dnThdMinDnAdpnN_AX "engine speed axes for minimum limitation in cae of incomplete dn adaptation" 0x8057BBD0 MisfDet_nEngSync RB_Axis_S16 32767.50 EngN 8 -16384.00 16383.50 FORMAT "%8.2" DEPOSIT ABSOLUTE /end AXIS_PTS
/begin AXIS_PTS MisfDet_dnThdMinDnAdpnTq_AX "torque axes for minimum limitation in cae of incomplete dn adaptation" 0x8057BBE2 MisfDet_tqBascSync RB_Axis_U16 99.99847 rel_uw_b100 4 0.00 99.99847 FORMAT "%8.5" DEPOSIT ABSOLUTE /end AXIS_PTS
/begin CHARACTERISTIC MisfDet_dnThdMinFacLteCmb.Cmn_C "Minimum limitation of threshold while using the correction factor for late combustion / all transmission types" VALUE 0x8057BB7C RB_Val_Ws16 2047.938 dn_Compu 0.00 2047.938 FORMAT "%8.3" EXTENDED_LIMITS -2048.000 2047.938 /end CHARACTERISTIC
/begin AXIS_PTS MisfDet_dnThdN_AX "engine speed axis for base maps" 0x8057BBEC MisfDet_nEngSync RB_Axis_S16 32767.50 EngN 8 -16384.00 16383.50 FORMAT "%8.2" DEPOSIT ABSOLUTE /end AXIS_PTS
/begin CHARACTERISTIC MisfDet_dnThdOffsCvoCont_T "offset to detection threshold in case of CVO mode active" CURVE 0x8057BB0C RB_Curve_U16_S16_Static 2047.938 dn_Compu 0.00 2047.938 FORMAT "%8.3" EXTENDED_LIMITS -2048.000 2047.938
 /begin AXIS_DESCR STD_AXIS MisfDet_tqBascSync rel_uw_b100 4 0.00 99.99847 FORMAT "%8.5" DEPOSIT ABSOLUTE /end AXIS_DESCR
/end CHARACTERISTIC
/begin CHARACTERISTIC MisfDet_dnThdOffsCvo_T "offset to detection threshold in case of CVO mode active" CURVE 0x8057BB1E RB_Curve_U16_S16_Static 2047.938 dn_Compu 0.00 2047.938 FORMAT "%8.3" EXTENDED_LIMITS -2048.000 2047.938
 /begin AXIS_DESCR STD_AXIS MisfDet_tqBascSync rel_uw_b100 4 0.00 99.99847 FORMAT "%8.5" DEPOSIT ABSOLUTE /end AXIS_DESCR
/end CHARACTERISTIC
/begin CHARACTERISTIC MisfDet_dnThdOffsTCatHeat_T "temperature dependent offset to detection threshold during catalyst heating" CURVE 0x8057BB30 RB_Curve_S16_S16 4095.938 dn_Compu -2048.000 2047.938 FORMAT "%8.3"
 /begin AXIS_DESCR STD_AXIS MisfDet_tEng Temp_Cels 8 -3549.940 3003.560 FORMAT "%8.3" DEPOSIT ABSOLUTE /end AXIS_DESCR
/end CHARACTERISTIC
/begin CHARACTERISTIC MisfDet_dnThdOffsT_T "temperature dependent offset to detection threshold" CURVE 0x8057BB52 RB_Curve_S16_S16 4095.938 dn_Compu -2048.000 2047.938 FORMAT "%8.3"
 /begin AXIS_DESCR STD_AXIS MisfDet_tEng Temp_Cels 8 -3549.940 3003.560 FORMAT "%8.3" DEPOSIT ABSOLUTE /end AXIS_DESCR
/end CHARACTERISTIC
/begin CHARACTERISTIC MisfDet_dnThdTiMinDynLim_C "Time after start without dynamic limitation" VALUE 0x8057BB74 RB_Val_Wu8 25.50 t_q0p1 0.00 25.50 FORMAT "%5.2" /end CHARACTERISTIC
/begin AXIS_PTS MisfDet_dnThdTq_AX "torque axis for base maps" 0x8057BBFE MisfDet_tqBascSync RB_Axis_U16 99.99847 rel_uw_b100 8 0.00 99.99847 FORMAT "%8.5" DEPOSIT ABSOLUTE /end AXIS_PTS
/begin CHARACTERISTIC MisfDet_dVWhlDecMax_C "limitation of negative gradient oh wheel acceleration" VALUE 0x8057B7FA RB_Val_Wu16 2777.735 accgrd_uw_b2777p6 0.00 2777.735 FORMAT "%8.3" /end CHARACTERISTIC
/begin CHARACTERISTIC MisfDet_dVWhlFil_C "Filter factor for differentiated wheel speeds" VALUE 0x8057B7FC RB_Val_Wu16 0.9999847 fak_uw_b1 0.00 0.9999847 FORMAT "%9.7" /end CHARACTERISTIC
/begin CHARACTERISTIC MisfDet_dVWhlFrntThd_M "Threshold map to detect rough road front axle" MAP 0x8057B7FE RB_Map_U16S16_U16 55.55471 acc_uw_b55p55 0.00 55.55471 FORMAT "%8.5"
 /begin AXIS_DESCR STD_AXIS MisfDet_tqBasc rel_uw_b100 4 0.00 99.99847 FORMAT "%8.5" DEPOSIT ABSOLUTE /end AXIS_DESCR
 /begin AXIS_DESCR STD_AXIS VehV_v Vel 4 -327.6800 327.6700 FORMAT "%8.4" DEPOSIT ABSOLUTE /end AXIS_DESCR
/end CHARACTERISTIC
/begin CHARACTERISTIC MisfDet_dVWhlPlausVMax_C "Maximum speed for enabling the diagnosis of wheel acceleration" VALUE 0x8057B832 RB_Val_Ws16 655.3500 Vel -327.6800 327.6700 FORMAT "%8.4" /end CHARACTERISTIC
/begin CHARACTERISTIC MisfDet_dVWhlPlausVMin_C "Minimum speed for enabling the diagnosis of wheel acceleration" VALUE 0x8057B834 RB_Val_Ws16 655.3500 Vel -327.6800 327.6700 FORMAT "%8.4" /end CHARACTERISTIC
/begin CHARACTERISTIC MisfDet_dVWhlRatMax_C "Maximum ratio of largest and second largest wheel acceleration" VALUE 0x8057B836 RB_Val_Wu16 655.3500 fak_q0p01 0.00 655.3500 FORMAT "%8.4" /end CHARACTERISTIC
/begin CHARACTERISTIC MisfDet_dVWhlReThd_M "Threshold map to detect rough road rear axle" MAP 0x8057B838 RB_Map_U16S16_U16 55.55471 acc_uw_b55p55 0.00 55.55471 FORMAT "%8.5"
 /begin AXIS_DESCR STD_AXIS MisfDet_tqBasc rel_uw_b100 4 0.00 99.99847 FORMAT "%8.5" DEPOSIT ABSOLUTE /end AXIS_DESCR
 /begin AXIS_DESCR STD_AXIS VehV_v Vel 4 -327.6800 327.6700 FORMAT "%8.4" DEPOSIT ABSOLUTE /end AXIS_DESCR
/end CHARACTERISTIC
/begin CHARACTERISTIC MisfDet_dVWhlThdFac_T "Factor for rough road detection threshold dependent on transmission ratio" CURVE 0x8057B86C RB_Curve_S16_U8_Static 1.992188 fak_ub_b2 0.00 1.992188 FORMAT "%8.6"
 /begin AXIS_DESCR STD_AXIS PT_rTrq TransR 6 -327.6800 327.6700 FORMAT "%8.4" DEPOSIT ABSOLUTE /end AXIS_DESCR
/end CHARACTERISTIC
/begin CHARACTERISTIC MisfDet_facCritScav_C "Scavenging rate to enable special cat monitoring" VALUE 0x8057B936 Val_Wu16 15.99976 fak_uw_b16 0.00 15.99976 FORMAT "%8.5" /end CHARACTERISTIC
/begin CHARACTERISTIC MisfDet_iaCatWrmThd_C "Ignition angle threshold for detecting catalyst warming." VALUE 0x8057BC10 RB_Val_Ws8 191.3 kw_q0p75 -96.00 95.25 FORMAT "%5.2" /end CHARACTERISTIC
/begin CHARACTERISTIC MisfDet_kdRoughRoadDT1_C "Gain of DT1 engine speed gradient for wheel speed diagnosis" VALUE 0x8057B880 RB_Val_Ws32 65535.9999847 Kd -32768.0000000 32767.9999847 FORMAT "%13.7" /end CHARACTERISTIC
/begin CHARACTERISTIC MisfDet_maskDnThdMinBlkDnAdpnNvCorrnCmbTyp_CA "Selection mask for inhibiting condition for minimum limitation for inhibiting the usage of long time adaptation values depending on diesel or gasoline motor" VAL_BLK 0x8057BC14 RB_ValA_Wu32 4294967295.00 OneToOne 0.00 4294967295.00 FORMAT "%13.2" NUMBER 3 /end CHARACTERISTIC
/begin CHARACTERISTIC MisfDet_maskDnThdMinBlkDnAdpnNvCorrn_CA "Selection mask for inhibiting condition for minimum limitation for inhibiting the usage of long time adaptation values" VAL_BLK 0x8057BC20 RB_ValA_Wu16 65535.00 OneToOne 0.00 65535.00 FORMAT "%8.2" NUMBER 3 /end CHARACTERISTIC
/begin CHARACTERISTIC MisfDet_maxToothDeEolNLim_C "engine speed threshold for usage of remaining tooth tolerance after EOL adaptation" VALUE 0x8057BB76 RB_Val_Ws16 32767.50 EngN -16384.00 16383.50 FORMAT "%8.2" /end CHARACTERISTIC
/begin CHARACTERISTIC MisfDet_maxToothDeEol_C "maximum tooth tolerance of crank wheel after EOL adaptation for offset calculation" VALUE 0x8057BB78 RB_Val_Wu8 0.9961 kw_q0p0039 0.00 0.9961 /end CHARACTERISTIC
/begin CHARACTERISTIC MisfDet_maxToothDe_C "maximum tooth tolerance of crank wheel for offset calculation" VALUE 0x8057BB79 RB_Val_Wu8 0.9961 kw_q0p0039 0.00 0.9961 /end CHARACTERISTIC
/begin CHARACTERISTIC MisfDet_nrCycMisfCont_C "Number of consecutive misfires for condition continuous misfire" VALUE 0x8057B932 RB_Val_Wu8 255.0 OneToOne 0.00 255.0 FORMAT "%5.1" /end CHARACTERISTIC
/begin CHARACTERISTIC MisfDet_nrDcycDrvRcdrRst_C "Number of driving cycles to reset endurance test counters" VALUE 0x8057BABC RB_Val_Wu8 255.0 OneToOne 0.00 255.0 FORMAT "%5.1" /end CHARACTERISTIC
/begin CHARACTERISTIC MisfDet_rGripMaxOpen_C "Maximum grip for status open drive train" VALUE 0x8057BC26 RB_Val_Ws16 655.3500 Fact100 -327.6800 327.6700 FORMAT "%8.4" /end CHARACTERISTIC
/begin CHARACTERISTIC MisfDet_rGripMinClsd_C "Minimum grip for status engaged drive train" VALUE 0x8057BC28 RB_Val_Ws16 655.3500 Fact100 -327.6800 327.6700 FORMAT "%8.4" /end CHARACTERISTIC
/begin CHARACTERISTIC MisfDet_RoughRoadDiagStuckDNEngMin_C "Minimum engine speed gradient for stuck diagnosis of wheel speeds" VALUE 0x8057B884 RB_Val_Ws16 32767.50 EngNGrad -16384.00 16383.50 FORMAT "%8.2" /end CHARACTERISTIC
/begin CHARACTERISTIC MisfDet_segPosnAltvNMax_C "Maximum engine speed for usage of the alternative segment position" VALUE 0x8057B8F0 RB_Val_Ws16 32767.50 EngN -16384.00 16383.50 FORMAT "%8.2" /end CHARACTERISTIC
/begin CHARACTERISTIC MisfDet_segPosnCalcNMaxOffs_C "Engine speed offset for calculation of segment time of additional segment positions" VALUE 0x8057B8F2 RB_Val_Ws16 32767.50 EngN -16384.00 16383.50 FORMAT "%8.2" /end CHARACTERISTIC
/begin CHARACTERISTIC MisfDet_segPosnIaLteHld_C "turn off delay of identifying the late ignition angle" VALUE 0x8057B8F4 RB_Val_Wu8 255.0 dez 0.00 255.0 FORMAT "%5.1" /end CHARACTERISTIC
/begin CHARACTERISTIC MisfDet_segPosnIaLte_T "Threshold value for identifying the late ignition angle" CURVE 0x8057B8F6 RB_Curve_S16_S8_Static 191.3 zw_sb_q0p75 -96.00 95.25 FORMAT "%5.2"
 /begin AXIS_DESCR STD_AXIS MisfDet_tEngStrt Temp_Cels 6 -3549.940 3003.560 FORMAT "%8.3" DEPOSIT ABSOLUTE /end AXIS_DESCR
/end CHARACTERISTIC
/begin CHARACTERISTIC MisfDet_segPosnLenAltv_C "Alternative segment length" VALUE 0x8057B90A RB_Val_Wu8 174.0 kw_tooth_sy 6.0 180.0 FORMAT "%5.1" EXTENDED_LIMITS 0.00 1530. /end CHARACTERISTIC
/begin CHARACTERISTIC MisfDet_segPosnLen_C "segment length value" VALUE 0x8057B90B RB_Val_Wu8 174.0 kw_tooth_sy 6.0 180.0 FORMAT "%5.1" EXTENDED_LIMITS 0.00 1530. /end CHARACTERISTIC
/begin CHARACTERISTIC MisfDet_segPosnOffsIaFilFac_C "filter factor for ignition angle to shift segment position" VALUE 0x8057B90C RB_Val_Wu16 0.9999847 fak_uw_b1 0.00 0.9999847 FORMAT "%9.7" /end CHARACTERISTIC
/begin CHARACTERISTIC MisfDet_segPosnOffsIdleDlyTi_C "Debounce time for switch to alternative segment position at low idle" VALUE 0x8057B90E KwUb 12.75 t_q0p05 0.00 12.75 FORMAT "%5.2" /end CHARACTERISTIC
/begin CHARACTERISTIC MisfDet_segPosnOffsIdleTMin_C "min temperature to switch to alternative segment at idle" VALUE 0x8057B910 RB_Val_Ws16 6553.500 Temp_Cels -3549.940 3003.560 FORMAT "%8.3" /end CHARACTERISTIC
/begin CHARACTERISTIC MisfDet_segPosnOffsNHys_C "Maximum engine speed offset" VALUE 0x8057B912 RB_Val_Ws16 32767.50 EngN -16384.00 16383.50 FORMAT "%8.2" /end CHARACTERISTIC
/begin CHARACTERISTIC MisfDet_segPosnOffsTqMaxOff_C "maximum torque for segment shift at low idle, hysteresis upper limit" VALUE 0x8057B914 RB_Val_Wu16 99.99847 rel_uw_b100 0.00 99.99847 FORMAT "%8.5" /end CHARACTERISTIC
/begin CHARACTERISTIC MisfDet_segPosnOffsTqMaxOn_C "maximum torque for segment shift at low idle, hysteresis lower limit" VALUE 0x8057B916 RB_Val_Wu16 99.99847 rel_uw_b100 0.00 99.99847 FORMAT "%8.5" /end CHARACTERISTIC
/begin CHARACTERISTIC MisfDet_segPosnStrtAltv_C "starting position of the alternative segment" VALUE 0x8057B918 RB_Val_Ws8 1530. kw_tooth_sy -768.0 762.0 FORMAT "%5.1" /end CHARACTERISTIC
/begin CHARACTERISTIC MisfDet_segPosnStrt_C "starting position of the standard segment" VALUE 0x8057B919 RB_Val_Ws8 1530. kw_tooth_sy -768.0 762.0 FORMAT "%5.1" /end CHARACTERISTIC
/begin CHARACTERISTIC MisfDet_segShiftRedStgHld_C "Turn-off delay for usage of alternative segment in case of reduction stage" VALUE 0x8057B91A RB_Val_Wu8 255.0 OneToOne 0.00 255.0 FORMAT "%5.1" /end CHARACTERISTIC
/begin CHARACTERISTIC MisfDet_segTiAdpnCntrEnaDlyEol_C "enable delay segment time adaptation at end of line" VALUE 0x8057B89C RB_Val_Wu8 255.0 CaS_32rev_compu 0.00 255.0 FORMAT "%5.1" /end CHARACTERISTIC
/begin CHARACTERISTIC MisfDet_segTiAdpnCntrEnaDly_C "enable delay segment time adaptation" VALUE 0x8057B89D RB_Val_Wu8 255.0 CaS_32rev_compu 0.00 255.0 FORMAT "%5.1" /end CHARACTERISTIC
/begin CHARACTERISTIC MisfDet_segTiAdpnDifMaxFco_C "maximale Differenz der Korrekturfaktoren bei erneutem Lernen at fuel cut off" VALUE 0x8057B89E RB_Val_Wu16 11.99982 kw_q1p8310eEm4 0.00 11.99982 FORMAT "%8.5" /end CHARACTERISTIC
/begin CHARACTERISTIC MisfDet_segTiAdpnDifMaxPrio_C "maximum difference of correction factors at new learning with prioritization" VALUE 0x8057B8A0 RB_Val_Wu16 11.99982 kw_q1p8310eEm4 0.00 11.99982 FORMAT "%8.5" /end CHARACTERISTIC
/begin CHARACTERISTIC MisfDet_segTiAdpnDifMax_C "maximum difference of correction factors at new learning" VALUE 0x8057B8A2 RB_Val_Wu16 11.99982 kw_q1p8310eEm4 0.00 11.99982 FORMAT "%8.5" /end CHARACTERISTIC
/begin CHARACTERISTIC MisfDet_segTiAdpnFilFacDecEol_C "decrease of filter factor during learning progress at end of line" VALUE 0x8057B8A4 RB_Val_Wu16 0.9999847 fak_uw_b1 0.00 0.9999847 FORMAT "%9.7" /end CHARACTERISTIC
/begin CHARACTERISTIC MisfDet_segTiAdpnFilFacDec_C "decrease of filter factor during learning progress" VALUE 0x8057B8A6 RB_Val_Wu16 0.9999847 fak_uw_b1 0.00 0.9999847 FORMAT "%9.7" /end CHARACTERISTIC
/begin CHARACTERISTIC MisfDet_segTiAdpnFilFacEndEol_C "ending value of filterfactor at end of line" VALUE 0x8057B8A8 RB_Val_Wu16 0.9999847 fak_uw_b1 0.00 0.9999847 FORMAT "%9.7" /end CHARACTERISTIC
/begin CHARACTERISTIC MisfDet_segTiAdpnFilFacEnd_C "ending value of filter factor" VALUE 0x8057B8AA RB_Val_Wu16 0.9999847 fak_uw_b1 0.00 0.9999847 FORMAT "%9.7" /end CHARACTERISTIC
/begin CHARACTERISTIC MisfDet_segTiAdpnFilFacStrtEol_C "starting value of filter factor at end of line" VALUE 0x8057B8AC RB_Val_Wu16 0.9999847 fak_uw_b1 0.00 0.9999847 FORMAT "%9.7" /end CHARACTERISTIC
/begin CHARACTERISTIC MisfDet_segTiAdpnFilFacStrt_C "starting value of filter factor" VALUE 0x8057B8AE RB_Val_Wu16 0.9999847 fak_uw_b1 0.00 0.9999847 FORMAT "%9.7" /end CHARACTERISTIC
/begin CHARACTERISTIC MisfDet_segTiAdpnN.Max.Eol_C "Engine speed limits SegTiAdpn / upper limit / End of line mode" VALUE 0x8057B8D4 RB_Val_Ws16 32767.50 EngN -16384.00 16383.50 FORMAT "%8.2" /end CHARACTERISTIC
/begin CHARACTERISTIC MisfDet_segTiAdpnN.Max.PosTq.Cmn_C "Engine speed limits SegTiAdpn / upper limit / positive torque / all transmission types" VALUE 0x8057B8D6 RB_Val_Ws16 32767.50 EngN -16384.00 16383.50 FORMAT "%8.2" /end CHARACTERISTIC
/begin CHARACTERISTIC MisfDet_segTiAdpnN.Max.Fco.Cmn_C "Engine speed limits SegTiAdpn / upper limit / fuel cut off / all transmission types" VALUE 0x8057B8D8 RB_Val_Ws16 32767.50 EngN -16384.00 16383.50 FORMAT "%8.2" /end CHARACTERISTIC
/begin CHARACTERISTIC MisfDet_segTiAdpnN.Min.Eol_C "Engine speed limits SegTiAdpn / lower limit / End of line mode" VALUE 0x8057B8DA RB_Val_Ws16 32767.50 EngN -16384.00 16383.50 FORMAT "%8.2" /end CHARACTERISTIC
/begin CHARACTERISTIC MisfDet_segTiAdpnN.Min.PosTq.Cmn_C "Engine speed limits SegTiAdpn / lower limit / positive torque / all transmission types" VALUE 0x8057B8DC RB_Val_Ws16 32767.50 EngN -16384.00 16383.50 FORMAT "%8.2" /end CHARACTERISTIC
/begin CHARACTERISTIC MisfDet_segTiAdpnN.Min.Fco.Cmn_C "Engine speed limits SegTiAdpn / lower limit / fuel cut off / all transmission types" VALUE 0x8057B8DE RB_Val_Ws16 32767.50 EngN -16384.00 16383.50 FORMAT "%8.2" /end CHARACTERISTIC
/begin CHARACTERISTIC MisfDet_segTiAdpnNMaxNoDmd_C "Maximum engine speed no segment time adaptation necessary" VALUE 0x8057B8B0 RB_Val_Ws16 32767.50 EngN -16384.00 16383.50 FORMAT "%8.2" /end CHARACTERISTIC
/begin CHARACTERISTIC MisfDet_segTiAdpnNrTryEolMax_C "Maximum number of attempts for learning at end of line mode" VALUE 0x8057B8B2 RB_Val_Wu8 255.0 OneToOne 0.00 255.0 FORMAT "%5.1" /end CHARACTERISTIC
/begin CHARACTERISTIC MisfDet_segTiAdpnSampleSprdMax_C "maximal deviation of segment deviation samples" VALUE 0x8057B8B4 RB_Val_Wu16 11.99982 kw_q1p8310eEm4 0.00 11.99982 FORMAT "%8.5" /end CHARACTERISTIC
/begin CHARACTERISTIC MisfDet_segTiAdpnTq.Max.Cmn_GT "torque limits to enable MisfDet_SegTiAdpn adaptation / upper limit / all transmission types" CURVE 0x8057B8E0 RB_CurveGroup_S16 6553.500 Trq -3276.800 3276.700 FORMAT "%8.3"
 /begin AXIS_DESCR COM_AXIS Epm_nEng EngN 4 -16384.00 16383.50 FORMAT "%8.2" AXIS_PTS_REF MisfDet_segTiAdpnTqMax_AX /end AXIS_DESCR
/end CHARACTERISTIC
/begin CHARACTERISTIC MisfDet_segTiAdpnTq.Max.Eol_C "torque limits to enable MisfDet_SegTiAdpn adaptation / upper limit / End of line mode" VALUE 0x8057B8E8 RB_Val_Ws16 6553.500 Trq -3276.800 3276.700 FORMAT "%8.3" /end CHARACTERISTIC
/begin CHARACTERISTIC MisfDet_segTiAdpnTq.Min.Cmn_C "torque limits to enable MisfDet_SegTiAdpn adaptation / lower limit / all transmission types" VALUE 0x8057B8EA RB_Val_Ws16 6553.500 Trq -3276.800 3276.700 FORMAT "%8.3" /end CHARACTERISTIC
/begin CHARACTERISTIC MisfDet_segTiAdpnTq.Min.Eol_C "torque limits to enable MisfDet_SegTiAdpn adaptation / lower limit / End of line mode" VALUE 0x8057B8EC RB_Val_Ws16 6553.500 Trq -3276.800 3276.700 FORMAT "%8.3" /end CHARACTERISTIC
/begin AXIS_PTS MisfDet_segTiAdpnTqMax_AX "engine speed axes for upper torque limit of segment time adaptation" 0x8057B8B6 Epm_nEng RB_Axis_S16 32767.50 EngN 4 -16384.00 16383.50 FORMAT "%8.2" DEPOSIT ABSOLUTE /end AXIS_PTS
/begin CHARACTERISTIC MisfDet_segTiAdpnValMaxDebCntrThd_C "debounce threshold for maximum values diagnosis" VALUE 0x8057B8C0 RB_Val_Wu8 255.0 OneToOne 0.00 255.0 FORMAT "%5.1" /end CHARACTERISTIC
/begin CHARACTERISTIC MisfDet_segTiAdpnValMaxEol_C "Maximum allowed absolute adaption value at end of line mode" VALUE 0x8057B8C2 RB_Val_Ws16 11.99982 kw_q1p8310eEm4 -6.000000 5.999817 FORMAT "%8.6" /end CHARACTERISTIC
/begin CHARACTERISTIC MisfDet_segTiAdpnValMax_C "Maximum allowed absolute adaption value" VALUE 0x8057B8C4 RB_Val_Ws16 11.99982 kw_q1p8310eEm4 -6.000000 5.999817 FORMAT "%8.6" /end CHARACTERISTIC
/begin CHARACTERISTIC MisfDet_segTiAdpnValSampleDiagDebCntrThd_C "debounce counter threshold for Sample-plausibility check diagnosis" VALUE 0x8057B8C6 RB_Val_Wu8 254.0 OneToOne 1.0 255.0 FORMAT "%5.1" EXTENDED_LIMITS 0.00 255.0 /end CHARACTERISTIC
/begin CHARACTERISTIC MisfDet_segTiAdpnValSampleDiagMaxSampleNrThd_C "Number of samples needed for Sample-plausibility check diagnosis" VALUE 0x8057B8C7 RB_Val_Wu8 254.0 OneToOne 1.0 255.0 FORMAT "%5.1" EXTENDED_LIMITS 0.00 255.0 /end CHARACTERISTIC
/begin CHARACTERISTIC MisfDet_segTiDifDebCntrThd_C "Threshold for debounce counter plausibility check delta of learning values" VALUE 0x8057B8C8 RB_Val_Wu8 255.0 OneToOne 0.00 255.0 FORMAT "%5.1" /end CHARACTERISTIC
/begin CHARACTERISTIC MisfDet_segTiDly_C "initial value for delay of igntition to segment time" VALUE 0x8057B91B RB_Val_Wu8 3.000 dez 0.00 3.000 FORMAT "%5.3" EXTENDED_LIMITS 0.00 255.0 /end CHARACTERISTIC
/begin CHARACTERISTIC MisfDet_segTiInin_C "initialisation value for segment duration related to 360 derees crankshaft" VALUE 0x8057B91C RB_Val_Wu16 65.53500 t1msxs_b65p535 0.00 65.53500 FORMAT "%8.5" /end CHARACTERISTIC
/begin CHARACTERISTIC MisfDet_segTiMnpl_FM "Map for manipulation of segment times" MAP 0x8057B91E RB_FixMap_S16S16_S16 11.99982 kw_q1p8310eEm4 -6.000000 5.999817 FORMAT "%8.6"
 /begin AXIS_DESCR FIX_AXIS MisfDet_cylCntrSegTi dez 4 0.00 3.000 FORMAT "%5.3" FIX_AXIS_PAR 0 0 4 /end AXIS_DESCR
 /begin AXIS_DESCR FIX_AXIS MisfDet_segPosnSegTi Compu_SegPosnInt_VERB 2 0.00 1.00000000000 FORMAT "%13.11" FIX_AXIS_PAR 0 0 2 /end AXIS_DESCR
/end CHARACTERISTIC
/begin CHARACTERISTIC MisfDet_segTiRatSprdDebCntrThd_C "Threshold for debounce counter plausibility check ratio of sampled values" VALUE 0x8057B8C9 RB_Val_Wu8 255.0 OneToOne 0.00 255.0 FORMAT "%5.1" /end CHARACTERISTIC
/begin CHARACTERISTIC MisfDet_segTiRatSprdMax_C "maximum spread of segment time ratios" VALUE 0x8057B8CA RB_Val_Wu16 11.99982 kw_q1p8310eEm4 0.00 11.99982 FORMAT "%8.5" /end CHARACTERISTIC
/begin CHARACTERISTIC MisfDet_segTiRatSpreadFilFacMax_C "maximum filter factor for segTiRatSpread check" VALUE 0x8057B8CC RB_Val_Wu16 0.9999847 fak_uw_b1 0.00 0.9999847 FORMAT "%9.7" /end CHARACTERISTIC
/begin CHARACTERISTIC MisfDet_segTiSampleSprdDebCntrThd_C "Threshold for debounce counter plausibility check spreading of sampled values" VALUE 0x8057B8CE RB_Val_Wu8 255.0 OneToOne 0.00 255.0 FORMAT "%5.1" /end CHARACTERISTIC
/begin CHARACTERISTIC MisfDet_stcCatDmgCritScavIntlCntrMax_C "Maximum number of catalyst damaginging intervals at high scavenging rate to change the weighting factor" VALUE 0x8057B938 RB_Val_Wu8 255.0 OneToOne 0.00 255.0 FORMAT "%5.1" /end CHARACTERISTIC
/begin CHARACTERISTIC MisfDet_stcCatDmgDebIntlNr_C "number of encounters from catalyst damaging till FSP entry" VALUE 0x8057B939 RB_Val_Wu8 2.000 OneToOne 1.000 3.000 FORMAT "%5.3" EXTENDED_LIMITS 0.00 255.0 /end CHARACTERISTIC
/begin CHARACTERISTIC MisfDet_stcCatDmgDebNMax_C "maximum engine speed for debouncing" VALUE 0x8057B93A RB_Val_Ws16 32767.50 EngN -16384.00 16383.50 FORMAT "%8.2" /end CHARACTERISTIC
/begin CHARACTERISTIC MisfDet_stcCatDmgDebTqMax_T "maximum torque for debouncing" CURVE 0x8057B93C RB_Curve_S16_U16_Static 99.99847 rel_uw_b100 0.00 99.99847 FORMAT "%8.5"
 /begin AXIS_DESCR STD_AXIS Epm_nEng EngN 10 -16384.00 16383.50 FORMAT "%8.2" DEPOSIT ABSOLUTE /end AXIS_DESCR
/end CHARACTERISTIC
/begin CHARACTERISTIC MisfDet_stcCatDmgFcoNrCylBnkMax_CA "maximum number of deactivateable cylinders on exhaust bank" VAL_BLK 0x8057BA96 RB_ValA_Wu8 255.0 OneToOne 0.00 255.0 FORMAT "%5.1" NUMBER 1 /end CHARACTERISTIC
/begin CHARACTERISTIC MisfDet_stcCatDmgFcoNrIntlMin_T "Necessary number of intervals criterias for cylinder deactivation met" CURVE 0x8057BA98 RB_Curve_S16_U8_Static 255.0 OneToOne 0.00 255.0 FORMAT "%5.1"
 /begin AXIS_DESCR STD_AXIS Epm_nEng EngN 8 -16384.00 16383.50 FORMAT "%8.2" DEPOSIT ABSOLUTE /end AXIS_DESCR
/end CHARACTERISTIC
/begin CHARACTERISTIC MisfDet_stcCatDmgFcoNrIntlStrt_C "Minimum number of intervals since start for cylinder deactivation" VALUE 0x8057BAB2 RB_Val_Wu8 255.0 OneToOne 0.00 255.0 FORMAT "%5.1" /end CHARACTERISTIC
/begin CHARACTERISTIC MisfDet_stcCatDmgFcoRatMin_C "Minimum contribution ratio of a cylinder to catalyst damaging for cylinder deactivation" VALUE 0x8057BAB4 Val_Wu16 99.99847 rel_uw_b100 0.00 99.99847 FORMAT "%8.5" /end CHARACTERISTIC
/begin CHARACTERISTIC MisfDet_stcCatDmgFcoThd_CA "Threshold for weighted misfire counter for cylinder deactivation" VAL_BLK 0x8057BAB6 RB_ValA_Wu16 65535.00 OneToOne 0.00 65535.00 FORMAT "%8.2" NUMBER 1 /end CHARACTERISTIC
/begin CHARACTERISTIC MisfDet_stcCatExtFirstIntlFac_C "Extension factor for first cat interval in case of cold engine" VALUE 0x8057B966 RB_Val_Wu8 255.0 OneToOne 0.00 255.0 FORMAT "%5.1" /end CHARACTERISTIC
/begin CHARACTERISTIC MisfDet_stcCatExtFirstIntlT_C "Maximum temperature for extension of first cat interval" VALUE 0x8057B968 RB_Val_Ws16 6553.500 Temp_Cels -3549.940 3003.560 FORMAT "%8.3" /end CHARACTERISTIC
/begin CHARACTERISTIC MisfDet_stcCatRatMinCylIdn_C "Minimum contribution ratio of misfire sum for cylinder individual misfire fault" VALUE 0x8057B96A Val_Wu16 99.99847 rel_uw_b100 0.00 99.99847 FORMAT "%8.5" /end CHARACTERISTIC
/begin CHARACTERISTIC MisfDet_stcCatRatMinMpl_C "Minimum contribution ratio of misfire sum for multiple misfire fault" VALUE 0x8057B96C Val_Wu16 99.99847 rel_uw_b100 0.00 99.99847 FORMAT "%8.5" /end CHARACTERISTIC
/begin CHARACTERISTIC MisfDet_stcCatThdStrt_CA "Threshold for catalyst damaging at first interval" VAL_BLK 0x8057B96E RB_ValA_Wu16 65535.00 OneToOne 0.00 65535.00 FORMAT "%8.2" NUMBER 1 /end CHARACTERISTIC
/begin CHARACTERISTIC MisfDet_stcCatThd_CA "Threshold for catalyst damaging" VAL_BLK 0x8057B970 RB_ValA_Wu16 65535.00 OneToOne 0.00 65535.00 FORMAT "%8.2" NUMBER 1 /end CHARACTERISTIC
/begin CHARACTERISTIC MisfDet_stcCatWghtFacCritScav_M "Map for catalyst protection, weighting factors considering high scavenging rates" MAP 0x8057B972 RB_Map_S16U16_U8 255.0 OneToOne 0.00 255.0 FORMAT "%5.1"
 /begin AXIS_DESCR STD_AXIS Epm_nEng EngN 6 -16384.00 16383.50 FORMAT "%8.2" DEPOSIT ABSOLUTE /end AXIS_DESCR
 /begin AXIS_DESCR STD_AXIS MisfDet_tqBasc rel_uw_b100 6 0.00 99.99847 FORMAT "%8.5" DEPOSIT ABSOLUTE /end AXIS_DESCR
/end CHARACTERISTIC
/begin CHARACTERISTIC MisfDet_stcCatWghtFacEth_M "weighting factor for misfire counter for ethanol" MAP 0x8057B9B2 RB_Map_S16U16_U8 255.0 OneToOne 0.00 255.0 FORMAT "%5.1"
 /begin AXIS_DESCR STD_AXIS Epm_nEng EngN 8 -16384.00 16383.50 FORMAT "%8.2" DEPOSIT ABSOLUTE /end AXIS_DESCR
 /begin AXIS_DESCR STD_AXIS MisfDet_tqBasc rel_uw_b100 8 0.00 99.99847 FORMAT "%8.5" DEPOSIT ABSOLUTE /end AXIS_DESCR
/end CHARACTERISTIC
/begin CHARACTERISTIC MisfDet_stcCatWghtFac_M "weighting factor for misfire counter" MAP 0x8057BA16 RB_Map_S16U16_U8 255.0 OneToOne 0.00 255.0 FORMAT "%5.1"
 /begin AXIS_DESCR STD_AXIS Epm_nEng EngN 8 -16384.00 16383.50 FORMAT "%8.2" DEPOSIT ABSOLUTE /end AXIS_DESCR
 /begin AXIS_DESCR STD_AXIS MisfDet_tqBasc rel_uw_b100 8 0.00 99.99847 FORMAT "%8.5" DEPOSIT ABSOLUTE /end AXIS_DESCR
/end CHARACTERISTIC
/begin CHARACTERISTIC MisfDet_stcEmiNrIntl_C "Number of damaged emission intervals which will cause a fault memory entry" VALUE 0x8057BA7E Val_Wu8 3.000 OneToOne 1.000 4.000 FORMAT "%5.3" EXTENDED_LIMITS 0.00 255.0 /end CHARACTERISTIC
/begin CHARACTERISTIC MisfDet_stcEmiRatMinCylIdn_C "minimum ratio of misfire sum for cylinder individual fault code" VALUE 0x8057BA80 Val_Wu16 99.99847 rel_uw_b100 0.00 99.99847 FORMAT "%8.5" /end CHARACTERISTIC
/begin CHARACTERISTIC MisfDet_stcEmiRatMinMpl_C "minimum ratio of misfire sum for multiple fault code" VALUE 0x8057BA82 Val_Wu16 99.99847 rel_uw_b100 0.00 99.99847 FORMAT "%8.5" /end CHARACTERISTIC
/begin CHARACTERISTIC MisfDet_stcEmiThdStrtCatHeat_C "threshold for emission exceedance first interval cat heating" VALUE 0x8057BA84 RB_Val_Wu16 65535.00 OneToOne 0.00 65535.00 FORMAT "%8.2" /end CHARACTERISTIC
/begin CHARACTERISTIC MisfDet_stcEmiThdStrt_C "threshold for emission exceedance first interval" VALUE 0x8057BA86 RB_Val_Wu16 65535.00 OneToOne 0.00 65535.00 FORMAT "%8.2" /end CHARACTERISTIC
/begin CHARACTERISTIC MisfDet_stcEmiThd_T "threshold for emission exceedance" CURVE 0x8057BA88 RB_Curve_U16_U16 65535.00 OneToOne 0.00 65535.00 FORMAT "%8.2"
 /begin AXIS_DESCR STD_AXIS FfPrm_facEth fak_uw_b2 3 0.00 1.999969 FORMAT "%8.6" DEPOSIT ABSOLUTE /end AXIS_DESCR
/end CHARACTERISTIC
/begin CHARACTERISTIC MisfDet_stCfgOBD_C "configuration switch Obd requirement" VALUE 0x8057BABA RB_Val_Wu8 255.0 OneToOne 0.00 255.0 FORMAT "%5.1" /end CHARACTERISTIC
/begin CHARACTERISTIC MisfDet_stRoughRoadDiagCfg_C "Selection of the wheel speed diagnostics" VALUE 0x8057B886 RB_Val_Wu8 255.0 OneToOne 0.00 255.0 FORMAT "%5.1" /end CHARACTERISTIC
/begin CHARACTERISTIC MisfDet_stSegTiAdpnCfgCal_C "code to deactivate and reset the adaptation" VALUE 0x8057B8CF RB_Val_Wu8 255.0 OneToOne 0.00 255.0 FORMAT "%5.1" /end CHARACTERISTIC
/begin CHARACTERISTIC MisfDet_stSegTiAdpnCfgDiag_C "code word to enable the plaus checks for DFC" VALUE 0x8057B8D0 RB_Val_Wu8 255.0 OneToOne 0.00 255.0 FORMAT "%5.1" /end CHARACTERISTIC
/begin CHARACTERISTIC MisfDet_stSegTiAdpnCfgEnaPosn_C "code word to enable the segment time adaptation of the segment positions" VALUE 0x8057B8D1 RB_Val_Wu8 255.0 OneToOne 0.00 255.0 FORMAT "%5.1" /end CHARACTERISTIC
/begin CHARACTERISTIC MisfDet_stSegTiAdpnCfgEnaTyp.Cmn_C "code word to enable the segment time adaptation at fuel cut off or at positive torque / all transmission types" VALUE 0x8057B8EE RB_Val_Wu8 255.0 OneToOne 0.00 255.0 FORMAT "%5.1" /end CHARACTERISTIC
/begin CHARACTERISTIC MisfDet_stSegTiAdpnCfgFastLrn_C "code word for fast learning of segment time adaptation" VALUE 0x8057B8D2 RB_Val_Wu8 255.0 OneToOne 0.00 255.0 FORMAT "%5.1" /end CHARACTERISTIC
/begin CHARACTERISTIC MisfDet_stSegTiAdpnCfgPrio_C "Codeword to prioritize the procedures of segment time adaptation" VALUE 0x8057B8D3 RB_Val_Wu8 255.0 OneToOne 0.00 255.0 FORMAT "%5.1" /end CHARACTERISTIC
/begin CHARACTERISTIC MisfDet_stSegTiCalcnCfgCal_C "Configuration switch segment time calculation for calibration features" VALUE 0x8057B92E RB_Val_Wu8 255.0 dez 0.00 255.0 FORMAT "%5.1" /end CHARACTERISTIC
/begin CHARACTERISTIC MisfDet_stSegTiCalcnCfg_C "Configuration switch segment time calculation" VALUE 0x8057B930 RB_Val_Wu16 65535.00 dez 0.00 65535.00 FORMAT "%8.2" /end CHARACTERISTIC
/begin CHARACTERISTIC MisfDet_stSigSelnCfg_C "Configuration code word for FC:MisfDet_SigSeln" VALUE 0x8057B934 RB_Val_Wu16 65535.00 OneToOne 0.00 65535.00 FORMAT "%8.2" /end CHARACTERISTIC
/begin CHARACTERISTIC MisfDet_stStcCatCfg_C "configuration code word MisfDet_stcCat" VALUE 0x8057BA7A RB_Val_Wu8 255.0 OneToOne 0.00 255.0 FORMAT "%5.1" /end CHARACTERISTIC
/begin CHARACTERISTIC MisfDet_stStcCatDmgFcoCfg_C "Configuration code word MisfDet_StcCat" VALUE 0x8057BAB8 RB_Val_Wu8 255.0 OneToOne 0.00 255.0 FORMAT "%5.1" /end CHARACTERISTIC
/begin CHARACTERISTIC MisfDet_stStcMiscCfg_C "configuration switch StcMisc" VALUE 0x8057BABD RB_Val_Wu8 255.0 OneToOne 0.00 255.0 FORMAT "%5.1" /end CHARACTERISTIC
/begin CHARACTERISTIC MisfDet_stThdCalcnCfg_C "configuration mask threshold calculation" VALUE 0x8057BB7A RB_Val_Wu8 255.0 OneToOne 0.00 255.0 FORMAT "%5.1" /end CHARACTERISTIC
/begin CHARACTERISTIC MisfDet_stThdMapSelnCfg_C "configuration code word ThdMapSeln" VALUE 0x8057BC2A RB_Val_Wu8 255.0 OneToOne 0.00 255.0 FORMAT "%5.1" /end CHARACTERISTIC
/begin CHARACTERISTIC MisfDet_tiDebCatHealCritScav_C "Debounce time to reset DFC_MDCatCrit" VALUE 0x8057BA7C Val_Wu16 6553.500 t_q0p1 0.00 6553.500 FORMAT "%8.3" /end CHARACTERISTIC
/begin CHARACTERISTIC MisfDet_tiRoughRoadDT1_C "time constant of DT1 engine speed gradient for wheel speed diagnosis" VALUE 0x8057B888 RB_Val_Ws32 4294.9672940000000 TimeDelay_s 0.0000020000000 4294.9672959999998 FORMAT "%19.14" EXTENDED_LIMITS 0.000002000000001 4294.9672959999998 /end CHARACTERISTIC
/begin CHARACTERISTIC MisfDet_trckWidth_C "Track width" VALUE 0x8057B88C RB_Val_Wu16 65.53500 len_q0p001_m 0.00 65.53500 FORMAT "%8.5" /end CHARACTERISTIC
/begin CHARACTERISTIC MisfDet_trqMaxDiagVWhlDe_C "Maximum wheel torque for plausible check of wheel speed" VALUE 0x8057B88E RB_Val_Ws16 6553.500 TrqPrpHigh -3276.800 3276.700 FORMAT "%8.3" /end CHARACTERISTIC
/begin CHARACTERISTIC MisfDet_vWhlDeMax_C "Maximum relative deviation of wheel speeds" VALUE 0x8057B890 RB_Val_Wu16 199.9969 r_prc_q0p003052_COMPU 0.00 199.9969 FORMAT "%8.4" /end CHARACTERISTIC
/begin CHARACTERISTIC MisfDet_vWhlFil_C "Filter factor for wheel speed" VALUE 0x8057B892 RB_Val_Wu16 0.9999847 fak_uw_b1 0.00 0.9999847 FORMAT "%9.7" /end CHARACTERISTIC
/begin CHARACTERISTIC MisfDet_vWhlMax_C "Maximum wheel speed" VALUE 0x8057B894 RB_Val_Wu16 324.9950 vfzg_uw_b325 0.00 324.9950 FORMAT "%8.4" /end CHARACTERISTIC
/begin CHARACTERISTIC MisfDet_whlBas_C "Wheel basis" VALUE 0x8057B896 RB_Val_Wu16 65.53500 len_q0p001_m 0.00 65.53500 FORMAT "%8.5" /end CHARACTERISTIC
/begin CHARACTERISTIC MisfDet_yawRateDeMax_C "Maximum relative deviation of yaw rates" VALUE 0x8057B898 RB_Val_Wu16 199.9969 r_prc_q0p003052_COMPU 0.00 199.9969 FORMAT "%8.4" /end CHARACTERISTIC
/begin CHARACTERISTIC MoCADC_ctDebNTP_C "Final value of Error counter for verifying of Null-Load-Test-Pulse" VALUE 0x80591AF0 Val_Wu8 5100.00 t20ms_ub_b5100 0.00 5100.00 /end CHARACTERISTIC
/begin CHARACTERISTIC MoCADC_ctDebTst_C "Error counter end value of test voltage verification" VALUE 0x80591AF1 Val_Wu8 255.0 dez 0.00 255.0 FORMAT "%5.1" /end CHARACTERISTIC
/begin CHARACTERISTIC MoCADC_ctRstNTP_C "Number of permitted resets for verifying of Null-Load-Test-Pulse" VALUE 0x80591AF2 Val_Wu8 255.0 dez 0.00 255.0 FORMAT "%5.1" /end CHARACTERISTIC
/begin CHARACTERISTIC MoCADC_ctRstTst_C "Number of permissible resets in case of an error in test voltage verification" VALUE 0x80591AF3 Val_Wu8 255.0 dez 0.00 255.0 FORMAT "%5.1" /end CHARACTERISTIC
/begin CHARACTERISTIC MoCADC_uNTPMax_C "Maximum ADC value in case of ADC channel moved to low during the ADC verification" VALUE 0x80591AF4 Val_Wu8 2.490 spg_q0p00977 0.00 2.490 FORMAT "%5.3" /end CHARACTERISTIC
/begin CHARACTERISTIC MoCADC_uTstMax_C "Maximum test voltage in ADC test" VALUE 0x80592108 Val_Ws16 319995.1 spg_q4p88_mV -160000.0 159995.1 FORMAT "%8.1" /end CHARACTERISTIC
/begin CHARACTERISTIC MoCADC_uTstMin_C "Minimum test voltage in ADC test" VALUE 0x8059210A Val_Ws16 319995.1 spg_q4p88_mV -160000.0 159995.1 FORMAT "%8.1" /end CHARACTERISTIC
/begin CHARACTERISTIC MoCCPU_stLockStepTstActv_CW "Codeword to create lockstep core error for test purpose" VALUE 0x805962B0 Val_Wu8 1.000 dez 0.00 1.000 FORMAT "%5.3" EXTENDED_LIMITS 0.00 255.0 /end CHARACTERISTIC
/begin CHARACTERISTIC MoCGTM_cntrCMPErrbitHealMax_C "Number of times CMP patter match should occur to initiate healing of MoCGTM_cntrCMPErrbit" VALUE 0x80591AF6 Val_Wu8 255.0 dez 0.00 255.0 FORMAT "%5.1" /end CHARACTERISTIC
/begin CHARACTERISTIC MoCGTM_cntrDebErrMax_C "Max. allowed deviation between badcase created and detected occured" VALUE 0x80591AF7 Val_Wu8 255.0 dez 0.00 255.0 FORMAT "%5.1" /end CHARACTERISTIC
/begin CHARACTERISTIC MoCGTM_stChksTstActv_CW "Calibration for ECU-MST test of MCS ROM check" VALUE 0x805962B2 Val_Wu8 1.000 dez 0.00 1.000 FORMAT "%5.3" EXTENDED_LIMITS 0.00 255.0 /end CHARACTERISTIC
/begin CHARACTERISTIC MoCGTM_stSWResetDem_CW "Codeword for enabling reset and Error pin as error reaction in case of failure of MoCGTM tests" VALUE 0x80591AFC Val_Wu8 255.0 dez 0.00 255.0 FORMAT "%5.1" /end CHARACTERISTIC
/begin CHARACTERISTIC MoCGTM_stTestActv_CW "Codeword to activate MFT (Monitoring Function Test) and check the error reaction from MoCGTM_Co" VALUE 0x805962B3 Val_Wu8 1.000 dez 0.00 1.000 FORMAT "%5.3" EXTENDED_LIMITS 0.00 255.0 /end CHARACTERISTIC
/begin CHARACTERISTIC MoCHwLogicTest_stTestActv_CW "Codeword to activate MFT (Monitoring Function Test) and check the error reaction from MoCHwLogicTest_Co" VALUE 0x805962B4 Val_Wu8 255.0 dez 0.00 255.0 FORMAT "%5.1" /end CHARACTERISTIC
/begin CHARACTERISTIC MoCHwLogicTest_swtDisblErrReactn_CW "Calibration to disable error reaction from checks in hardware logic test module" VALUE 0x80591AFE Val_Wu8 255.0 dez 0.00 255.0 FORMAT "%5.1" /end CHARACTERISTIC
/begin CHARACTERISTIC MoCHwLogicTest_swtDisblFwChk_CA "Calibration to disable error reaction from Firmware checks" VAL_BLK 0x805920BC ValA_Wu32 4294967295.00 OneToOne 0.00 4294967295.00 FORMAT "%13.2" NUMBER 5 /end CHARACTERISTIC
/begin CHARACTERISTIC MoCIWDH_stPtlRespTstActv_CW "Codeword to destroy the partial response from MoCIWDH if enabled" VALUE 0x805962B5 Val_Wu8 1.000 dez 0.00 1.000 FORMAT "%5.3" EXTENDED_LIMITS 0.00 255.0 /end CHARACTERISTIC
/begin CHARACTERISTIC MoCMemStrtUp_chkRamTest_C "Parameter to request corruption of RAM test during complete memory test" VALUE 0x805962B6 Val_Wu8 255.0 dez 0.00 255.0 FORMAT "%5.1" /end CHARACTERISTIC
/begin CHARACTERISTIC MoCMemStrtUp_chkRomTest_C "Parameter to request corruption of ROM test during complete memory test" VALUE 0x805962B7 Val_Wu8 255.0 dez 0.00 255.0 FORMAT "%5.1" /end CHARACTERISTIC
/begin MEASUREMENT MisfDet_chkVWhlDe "Index of the wheel being checked by a plaus check" SBYTE OneToOne 1 100 -128.0 127.0 FORMAT "%5.1" ECU_ADDRESS 0x6000B719 /end MEASUREMENT
/begin MEASUREMENT MisfDet_cntrMisfDiag "counter of misfire events for diagnosis service-tester" UWORD OneToOne 1 100 0.00 65535.00 FORMAT "%8.2" ARRAY_SIZE 4 ECU_ADDRESS 0x5000032C /end MEASUREMENT
/begin MEASUREMENT MisfDet_cntrMisfDiagFild "exponential weighted moving average of misfire events for diagnosis service-tester" FLOAT32_IEEE OneToOne 1 100 -1.00000000E+037 1.00000000E+037 FORMAT "%13.3" ARRAY_SIZE 4 ECU_ADDRESS 0x60038EAC /end MEASUREMENT
/begin MEASUREMENT MisfDet_cylCntrSegTi "Cylinder counter for Misfire Detection according to Segment time" UBYTE dez 1 100 0.00 255.0 FORMAT "%5.1" ECU_ADDRESS 0x5000099D /end MEASUREMENT
/begin MEASUREMENT MisfDet_cylFrzFrmData "Cylinder number relevant for similar conditions" SBYTE OneToOne 1 100 -128.0 127.0 FORMAT "%5.1" ECU_ADDRESS 0x60038EAA /end MEASUREMENT
/begin MEASUREMENT MisfDet_dnThd "Threshold for circular acceleration" SWORD dn_Compu 1 100 -2048.000 2047.938 FORMAT "%8.3" ECU_ADDRESS 0x50000812 /end MEASUREMENT
/begin MEASUREMENT MisfDet_dnThdCont "Threshold for continuous misfires" SWORD dn_Compu 1 100 -2048.000 2047.938 FORMAT "%8.3" ECU_ADDRESS 0x50000814 /end MEASUREMENT
/begin MEASUREMENT MisfDet_dnThdContRdcVal "value for reduction of dnThdCont" SWORD dn_Compu 1 100 -2048.000 2047.938 FORMAT "%8.3" ECU_ADDRESS 0x700020F6 /end MEASUREMENT
/begin MEASUREMENT MisfDet_dnThdCor "preliminary detection threshold including correction offsets and factors" SWORD dn_Compu 1 100 -2048.000 2047.938 FORMAT "%8.3" ECU_ADDRESS 0x50000816 /end MEASUREMENT
/begin MEASUREMENT MisfDet_dnThdCorCont "preliminary detection threshold for continuous misfires including correction offsets and factors" SWORD dn_Compu 1 100 -2048.000 2047.938 FORMAT "%8.3" ECU_ADDRESS 0x50000718 /end MEASUREMENT
/begin MEASUREMENT MisfDet_dnThdCorDif "preliminary detection threshold for differential method including correction offsets and factors" SWORD dn_Compu 1 100 -2048.000 2047.938 FORMAT "%8.3" ECU_ADDRESS 0x5000071A /end MEASUREMENT
/begin MEASUREMENT MisfDet_dnThdDecLim "limitation of negative gradients of detection threshold" SWORD dn_Compu 1 100 -2048.000 2047.938 FORMAT "%8.3" ECU_ADDRESS 0x5000071C /end MEASUREMENT
/begin MEASUREMENT MisfDet_dnThdDecLimCont "limitation of negative gradients of detection threshold for continuous misfire" SWORD dn_Compu 1 100 -2048.000 2047.938 FORMAT "%8.3" ECU_ADDRESS 0x5000071E /end MEASUREMENT
/begin MEASUREMENT MisfDet_dnThdDecLimDif "limitation of negative gradients of detection threshold for differential method" SWORD dn_Compu 1 100 -2048.000 2047.938 FORMAT "%8.3" ECU_ADDRESS 0x50000720 /end MEASUREMENT
/begin MEASUREMENT MisfDet_dnThdDif "detection threshold for differential method" SWORD dn_Compu 1 100 -2048.000 2047.938 FORMAT "%8.3" ECU_ADDRESS 0x50000818 /end MEASUREMENT
/begin MEASUREMENT MisfDet_dnThdDynLim "Threshold for sporadic misfires with limited dynamic" SWORD dn_Compu 1 100 -2048.000 2047.938 FORMAT "%8.3" ECU_ADDRESS 0x50000722 /end MEASUREMENT
/begin MEASUREMENT MisfDet_dnThdDynLimCont "Threshold for continuous misfires with limited dynamic" SWORD dn_Compu 1 100 -2048.000 2047.938 FORMAT "%8.3" ECU_ADDRESS 0x50000724 /end MEASUREMENT
/begin MEASUREMENT MisfDet_dnThdFacLteCmb "Factor to detection threshold at late combustion barycenter" UWORD fak_uw_b2 1 100 0.00 1.999969 FORMAT "%8.6" ECU_ADDRESS 0x7000381E /end MEASUREMENT
/begin MEASUREMENT MisfDet_dnThdFacLteCmbMapOut "Factor to detection threshold at late combustion barycenter curve output" UWORD fak_uw_b2 1 100 0.00 1.999969 FORMAT "%8.6" ECU_ADDRESS 0x7000381C /end MEASUREMENT
/begin MEASUREMENT MisfDet_dnThdFacStrt "Factor to detection threshold at engine start" UWORD fak_uw_b2 1 100 0.00 1.999969 FORMAT "%8.6" ECU_ADDRESS 0x5000081A /end MEASUREMENT
/begin MEASUREMENT MisfDet_dnThdMapOut "Threshold output from map" SWORD dn_Compu 1 100 -2048.000 2047.938 FORMAT "%8.3" ECU_ADDRESS 0x5000081E /end MEASUREMENT
/begin MEASUREMENT MisfDet_dnThdMapOutCont "threshold for continuous misfires, output from map" SWORD dn_Compu 1 100 -2048.000 2047.938 FORMAT "%8.3" ECU_ADDRESS 0x50000820 /end MEASUREMENT
/begin MEASUREMENT MisfDet_dnThdMapOutDif "map output of base map for differential method" SWORD dn_Compu 1 100 -2048.000 2047.938 FORMAT "%8.3" ECU_ADDRESS 0x50000822 /end MEASUREMENT
/begin MEASUREMENT MisfDet_dnThdMinAdpn "Minimum limitation of threshold due to incomplete adaptations" SWORD dn_Compu 1 100 -2048.000 2047.938 FORMAT "%8.3" ECU_ADDRESS 0x50000824 /end MEASUREMENT
/begin MEASUREMENT MisfDet_dnThdMinContOut "Threshold limitation for continuous misfires map output" SWORD dn_Compu 1 100 -2048.000 2047.938 FORMAT "%8.3" ECU_ADDRESS 0x50000826 /end MEASUREMENT
/begin MEASUREMENT MisfDet_dnThdMinDnAdpnMapIdx "map index for minimum limitation in case of incomplete dn adaptation" SBYTE MisfDet_dnThdMinDnAdpnMapIdx_VERB 1 100 -1.00000000000 2.00000000000 FORMAT "%13.11" ECU_ADDRESS 0x700020F5 /end MEASUREMENT
/begin MEASUREMENT MisfDet_dnThdMinDnAdpnMapOut "minimum limitation in case of incomplete dn adaptation map output" SWORD dn_Compu 1 100 -2048.000 2047.938 FORMAT "%8.3" ECU_ADDRESS 0x50000828 /end MEASUREMENT
/begin MEASUREMENT MisfDet_dnThdMinDnAdpnVal "Minimum limitation of threshold due to incomplete dn adaptation, curve output" SWORD dn_Compu 1 100 -2048.000 2047.938 FORMAT "%8.3" ECU_ADDRESS 0x70003A6C /end MEASUREMENT
/begin MEASUREMENT MisfDet_dnThdMinSegTiAdpn "minimum limitation in case of incomplete dnsegment time adaptation" SWORD dn_Compu 1 100 -2048.000 2047.938 FORMAT "%8.3" ECU_ADDRESS 0x70003A6A /end MEASUREMENT
/begin MEASUREMENT MisfDet_dnThdOffsCvo "offset to detection threshold in case of CVO mode active" SWORD dn_Compu 1 100 -2048.000 2047.938 FORMAT "%8.3" ECU_ADDRESS 0x70003A68 /end MEASUREMENT
/begin MEASUREMENT MisfDet_dnThdOffsCvoCont "offset to detection threshold in case of CVO mode active" SWORD dn_Compu 1 100 -2048.000 2047.938 FORMAT "%8.3" ECU_ADDRESS 0x70003A66 /end MEASUREMENT
/begin MEASUREMENT MisfDet_dnThdOffsT "temperature dependent offset to detection threshold" SWORD dn_Compu 1 100 -2048.000 2047.938 FORMAT "%8.3" ECU_ADDRESS 0x5000082A /end MEASUREMENT
/begin MEASUREMENT MisfDet_dnThdSyncContFiltd "filtered detection threshold for continuous misfires" SWORD dn_Compu 1 100 -2048.000 2047.938 FORMAT "%8.3" ECU_ADDRESS 0x50000726 /end MEASUREMENT
/begin MEASUREMENT MisfDet_dVWhl "Differentiated wheel speed" UWORD acc_uw_b55p55 1 100 0.00 55.55471 FORMAT "%8.5" ARRAY_SIZE 4 ECU_ADDRESS 0x50005E06 /end MEASUREMENT
/begin MEASUREMENT MisfDet_dVWhlAvrgFrnt "averaged wheel acceleration front axle" UWORD acc_uw_b55p55 1 100 0.00 55.55471 FORMAT "%8.5" ECU_ADDRESS 0x60007276 /end MEASUREMENT
/begin MEASUREMENT MisfDet_dVWhlAvrgRe "averaged wheel acceleration rear axle" UWORD acc_uw_b55p55 1 100 0.00 55.55471 FORMAT "%8.5" ECU_ADDRESS 0x60007274 /end MEASUREMENT
/begin MEASUREMENT MisfDet_dVWhlFild "Filtered differentiated wheel speed" UWORD acc_uw_b55p55 1 100 0.00 55.55471 FORMAT "%8.5" ARRAY_SIZE 4 ECU_ADDRESS 0x50005E0E /end MEASUREMENT
/begin MEASUREMENT MisfDet_dVWhlFrntThd "Threshold to detect rough road front axle" UWORD acc_uw_b55p55 1 100 0.00 55.55471 FORMAT "%8.5" ECU_ADDRESS 0x60007272 /end MEASUREMENT
/begin MEASUREMENT MisfDet_dVWhlFrntThdMapOut "Threshold to detect rough road front axle, output of map" UWORD acc_uw_b55p55 1 100 0.00 55.55471 FORMAT "%8.5" ECU_ADDRESS 0x60007270 /end MEASUREMENT
/begin MEASUREMENT MisfDet_dVWhlRat "Ratio of largest and second largest wheel acceleration" UWORD fak_q0p01 1 100 0.00 655.3500 FORMAT "%8.4" ECU_ADDRESS 0x6000726E /end MEASUREMENT
/begin MEASUREMENT MisfDet_dVWhlReThd "Threshold to detect rough road rear axle" UWORD acc_uw_b55p55 1 100 0.00 55.55471 FORMAT "%8.5" ECU_ADDRESS 0x6000726C /end MEASUREMENT
/begin MEASUREMENT MisfDet_dVWhlReThdMapOut "Threshold to detect rough road rear axle, output of map" UWORD acc_uw_b55p55 1 100 0.00 55.55471 FORMAT "%8.5" ECU_ADDRESS 0x6000726A /end MEASUREMENT
/begin MEASUREMENT MisfDet_dVWhlThdFac "factor dependent on transmission ratio for threshold oh rough road detection" UBYTE fak_ub_b2 1 100 0.00 1.992188 FORMAT "%8.6" ECU_ADDRESS 0x6000B71A /end MEASUREMENT
/begin MEASUREMENT MisfDet_flgRoughRoad "Rough road detected" UBYTE B_TRUE 1 100 0.00 1.00000000000 BIT_MASK 0x1 FORMAT "%13.11" ECU_ADDRESS 0x7000081D /end MEASUREMENT
/begin MEASUREMENT MisfDet_flgRoughRoadFrnt "Rough road detected at front axle" UBYTE B_TRUE 1 100 0.00 1.00000000000 BIT_MASK 0x1 FORMAT "%13.11" ECU_ADDRESS 0x7000016D /end MEASUREMENT
/begin MEASUREMENT MisfDet_flgRoughRoadPrel "rough road detection without checking grip state" UBYTE B_TRUE 1 100 0.00 1.00000000000 BIT_MASK 0x1 FORMAT "%13.11" ECU_ADDRESS 0x7000016C /end MEASUREMENT
/begin MEASUREMENT MisfDet_flgRoughRoadRe "Rough road detected at rear axle" UBYTE B_TRUE 1 100 0.00 1.00000000000 BIT_MASK 0x1 FORMAT "%13.11" ECU_ADDRESS 0x7000016B /end MEASUREMENT
/begin MEASUREMENT MisfDet_flgSyncnRstSegTi "demand for reset of Segment time adaptation" UBYTE B_TRUE 1 100 0.00 1.00000000000 BIT_MASK 0x1 FORMAT "%13.11" ECU_ADDRESS 0x70000168 /end MEASUREMENT
/begin MEASUREMENT MisfDet_iaAvg "average ignition angle for segment position" SBYTE kw_q0p75 1 100 -96.00 95.25 FORMAT "%5.2" ECU_ADDRESS 0x700020FB /end MEASUREMENT
/begin MEASUREMENT MisfDet_iaLteCntr "Counter of turn off delay for the identifying the late ignition angle" UBYTE dez 1 100 0.00 255.0 FORMAT "%5.1" ECU_ADDRESS 0x700020FA /end MEASUREMENT
/begin MEASUREMENT MisfDet_iaMdn "Median of ignition angle for segment position" SBYTE kw_q0p75 1 100 -96.00 95.25 FORMAT "%5.2" ECU_ADDRESS 0x700020F9 /end MEASUREMENT
/begin MEASUREMENT MisfDet_iaMdnAvrg "Lowpass filtered average of the ignition angle output" SBYTE kw_q0p75 1 100 -96.00 95.25 FORMAT "%5.2" ECU_ADDRESS 0x7000373E /end MEASUREMENT
/begin MEASUREMENT MisfDet_idxThdMap "index of threshold map" UBYTE MisfDet_idxThdMap_VERB 1 100 0.00 22.0000000000 FORMAT "%13.10" ECU_ADDRESS 0x5000096D /end MEASUREMENT
/begin MEASUREMENT MisfDet_idxThdMapSync "index for map selection synchronised" UBYTE MisfDet_idxThdMap_VERB 1 100 0.00 22.0000000000 FORMAT "%13.10" ECU_ADDRESS 0x700020F4 /end MEASUREMENT
/begin MEASUREMENT MisfDet_ignCntr "Ignition counter endurance test" ULONG OneToOne 1 100 0.00 4294967295.00 FORMAT "%13.2" ECU_ADDRESS 0x60038EA4 /end MEASUREMENT
/begin MEASUREMENT MisfDet_ignCntrHsp "ignition counter endurance test HSP" ULONG OneToOne 1 100 0.00 4294967295.00 FORMAT "%13.2" ECU_ADDRESS 0x60038EA0 /end MEASUREMENT
/begin MEASUREMENT MisfDet_maskCntMisf "bit mask counted misfires during past working cycle" UWORD OneToOne 1 100 0.00 65535.00 FORMAT "%8.2" ECU_ADDRESS 0x50000728 /end MEASUREMENT
/begin MEASUREMENT MisfDet_maskDet "Bit mask detected misfires during past working cycle" UWORD OneToOne 1 100 0.00 65535.00 FORMAT "%8.2" ECU_ADDRESS 0x5000072A /end MEASUREMENT
/begin MEASUREMENT MisfDet_maskDFCsegTiAdpn "Indicating mask which plausibility check triggered DFC report" UBYTE OneToOne 1 100 0.00 255.0 FORMAT "%5.1" ECU_ADDRESS 0x6000B716 /end MEASUREMENT
/begin MEASUREMENT MisfDet_maskDFCsegTiAdpnAltvPosn "Indicating mask of the alternative segment time position which plausibility check triggered DFC report" UBYTE OneToOne 1 100 0.00 255.0 FORMAT "%5.1" ECU_ADDRESS 0x60038EFC /end MEASUREMENT
/begin MEASUREMENT MisfDet_maskDFCsegTiAdpnStdPosn "Indicating mask of the standard segment time position which plausibility check triggered DFC report" UBYTE OneToOne 1 100 0.00 255.0 FORMAT "%5.1" ECU_ADDRESS 0x60038EFB /end MEASUREMENT
/begin MEASUREMENT MisfDet_maskMisfCont "bit mask continuous misfiring cylinder" UWORD OneToOne 1 100 0.00 65535.00 FORMAT "%8.2" ECU_ADDRESS 0x5000072C /end MEASUREMENT
/begin MEASUREMENT MisfDet_maskSegPosnDnCalc "Calculation request for engine roughness of the respective segment position" UBYTE OneToOne 1 100 0.00 255.0 FORMAT "%5.1" ECU_ADDRESS 0x500009A0 /end MEASUREMENT
/begin MEASUREMENT MisfDet_maskSegTiReqAdpn "request of calculation of segment time for adaptation" UBYTE OneToOne 1 100 0.00 255.0 FORMAT "%5.1" ECU_ADDRESS 0x60000979 /end MEASUREMENT
/begin MEASUREMENT MisfDet_maskSegTiVld "Validity of segment time of the respective segment position" UBYTE OneToOne 1 100 0.00 255.0 FORMAT "%5.1" ECU_ADDRESS 0x500009A1 /end MEASUREMENT
/begin MEASUREMENT MisfDet_maskSegTiVldSegBasd "Validity of segment time of the respective segment position" UBYTE OneToOne 1 100 0.00 255.0 FORMAT "%5.1" ECU_ADDRESS 0x700020F8 /end MEASUREMENT
/begin MEASUREMENT MisfDet_maskStcCatFltCylIdn "cylinder individual fault state single cylinder fault" UWORD OneToOne 1 100 0.00 65535.00 FORMAT "%8.2" ECU_ADDRESS 0x50000836 /end MEASUREMENT
/begin MEASUREMENT MisfDet_maskStcCatFltMpl "cylinder individual fault state multiple fault" UWORD OneToOne 1 100 0.00 65535.00 FORMAT "%8.2" ECU_ADDRESS 0x600006F8 /end MEASUREMENT
/begin MEASUREMENT MisfDet_maskStcEmiFltCylIdn "cylinder individual fault state single cylinder fault" UWORD OneToOne 1 100 0.00 65535.00 FORMAT "%8.2" ECU_ADDRESS 0x7000381A /end MEASUREMENT
/begin MEASUREMENT MisfDet_maskStcEmiFltMpl "cylinder individual fault state multiple fault" UWORD OneToOne 1 100 0.00 65535.00 FORMAT "%8.2" ECU_ADDRESS 0x70003818 /end MEASUREMENT
/begin MEASUREMENT MisfDet_misfCntrCyl "misfire counter endurance test" UWORD OneToOne 1 100 0.00 65535.00 FORMAT "%8.2" ARRAY_SIZE 4 ECU_ADDRESS 0x60038E98 /end MEASUREMENT
/begin MEASUREMENT MisfDet_misfCntrCylHsp "misfire counter endurance test HSP" UWORD OneToOne 1 100 0.00 65535.00 FORMAT "%8.2" ARRAY_SIZE 4 ECU_ADDRESS 0x60038E90 /end MEASUREMENT
/begin MEASUREMENT MisfDet_misfCntrSum "sum of cylinder individual misfire counter endurance test" UWORD OneToOne 1 100 0.00 65535.00 FORMAT "%8.2" ECU_ADDRESS 0x600005D8 /end MEASUREMENT
/begin MEASUREMENT MisfDet_nrCylMisfNoId "number of misfiring cylinders without cylinder identification" UBYTE OneToOne 1 100 0.00 255.0 FORMAT "%5.1" ARRAY_SIZE 1 ECU_ADDRESS 0x6000097B /end MEASUREMENT
/begin MEASUREMENT MisfDet_nrDcycDrvRcdr "Number driving cycles to reset endurance test counters" UBYTE OneToOne 1 100 0.00 255.0 FORMAT "%5.1" ECU_ADDRESS 0x60038EA8 /end MEASUREMENT
/begin MEASUREMENT MisfDet_nrMisfConsc "NUmber of consecutive misfires" UBYTE OneToOne 1 100 0.00 255.0 FORMAT "%5.1" ARRAY_SIZE 4 ECU_ADDRESS 0x60000504 /end MEASUREMENT
/begin MEASUREMENT MisfDet_RoughRoadDNEng "Engine speed gradient for diagnosis of wheel speeds" SWORD EngNGrad 1 100 -16384.00 16383.50 FORMAT "%8.2" ECU_ADDRESS 0x60007268 /end MEASUREMENT
/begin MEASUREMENT MisfDet_RoughRoadDstLog "Driven distance during detected rough road" UWORD len_q50_m 1 100 0.00 3276750. FORMAT "%8.0" ECU_ADDRESS 0x60008DFA /end MEASUREMENT
/begin MEASUREMENT MisfDet_segPosnLen "segment length" UBYTE kw_tooth_sy 1 100 0.00 1530. FORMAT "%5.0" ECU_ADDRESS 0x70003675 /end MEASUREMENT
/begin MEASUREMENT MisfDet_segPosnLenAry "segment length array(per segment position)" UBYTE kw_tooth_sy 1 100 0.00 1530. FORMAT "%5.0" ARRAY_SIZE 2 ECU_ADDRESS 0x600008FD /end MEASUREMENT
/begin MEASUREMENT MisfDet_segPosnLenSync "Segment length, synchronised" UBYTE kw_tooth_sy 1 100 0.00 1530. FORMAT "%5.0" ECU_ADDRESS 0x500009A4 /end MEASUREMENT
/begin MEASUREMENT MisfDet_segPosnSegTi "Current segment position of the segment time" UBYTE Compu_SegPosnInt_VERB 1 100 0.00 259.000000000 FORMAT "%13.9" ECU_ADDRESS 0x500009A5 /end MEASUREMENT
/begin MEASUREMENT MisfDet_segPosnStrt "starting position of the segment" SBYTE kw_tooth_sy 1 100 -768.0 762.0 FORMAT "%5.1" ECU_ADDRESS 0x7000373D /end MEASUREMENT
/begin MEASUREMENT MisfDet_segTi "segment time value" ULONG tsquant_l 1 100 0.00 214748364.750 FORMAT "%13.3" ECU_ADDRESS 0x70003C78 /end MEASUREMENT
/begin MEASUREMENT MisfDet_segTiAdpnCntrEnaDly "enable delay segment time adaptation" UBYTE CaS_32rev_compu 1 100 0.00 255.0 FORMAT "%5.1" ECU_ADDRESS 0x600008FF /end MEASUREMENT
/begin MEASUREMENT MisfDet_segTiAdpnDifRelMax "maximum reached ratio of threshold for Dif fault in segment time adaptation" UBYTE rel_ub_b200 1 100 0.00 199.2 FORMAT "%5.1" ECU_ADDRESS 0x60038F06 /end MEASUREMENT
/begin MEASUREMENT MisfDet_segTiAdpnFilFac "current filter factor segment time adaptation" UWORD fak_uw_b1 1 100 0.00 0.9999847 FORMAT "%9.7" ECU_ADDRESS 0x600005DC /end MEASUREMENT
/begin MEASUREMENT MisfDet_segTiAdpnNMax "Maximum engine speed for segment time adaptation" SWORD EngN 1 100 -16384.00 16383.50 FORMAT "%8.2" ECU_ADDRESS 0x5000083E /end MEASUREMENT
/begin MEASUREMENT MisfDet_segTiAdpnNMin "Minimum engine speed for segment time adaptation" SWORD EngN 1 100 -16384.00 16383.50 FORMAT "%8.2" ECU_ADDRESS 0x50000842 /end MEASUREMENT
/begin MEASUREMENT MisfDet_segTiAdpnRstCntr "reset counter learning filter not plausible segment time adaptation" UBYTE OneToOne 1 100 0.00 255.0 FORMAT "%5.1" ECU_ADDRESS 0x6000F797 /end MEASUREMENT
/begin MEASUREMENT MisfDet_segTiAdpnRstCntrAltvPosn "Reset counter of adaptation of alternative segment position" UBYTE OneToOne 1 100 0.00 255.0 FORMAT "%5.1" ECU_ADDRESS 0x60038EFA /end MEASUREMENT
/begin MEASUREMENT MisfDet_segTiAdpnRstCntrFco "reset counter of adaptation after learning cycle at fuel cut off" UBYTE OneToOne 1 100 0.00 255.0 FORMAT "%5.1" ECU_ADDRESS 0x60038EF9 /end MEASUREMENT
/begin MEASUREMENT MisfDet_segTiAdpnSample0.ary "Structure for samples of fuel off adaptation / array of segment deviation samples" SWORD kw_q1p8310eEm4 1 100 -6.000000 5.999817 FORMAT "%8.6" ARRAY_SIZE 11 ECU_ADDRESS 0x60038ED4 /end MEASUREMENT
/begin MEASUREMENT MisfDet_segTiAdpnSample0.cntr "Structure for samples of fuel off adaptation / segment deviation sample counter" UBYTE OneToOne 1 100 0.00 255.0 FORMAT "%5.1" ECU_ADDRESS 0x60038EEA /end MEASUREMENT
/begin MEASUREMENT MisfDet_segTiAdpnSample0.segPosn "Structure for samples of fuel off adaptation / currently learnt segment position" UBYTE Compu_SegPosn_VERB 1 100 0.00 261.000000000 FORMAT "%13.9" ECU_ADDRESS 0x60038EEB /end MEASUREMENT
/begin MEASUREMENT MisfDet_segTiAdpnSample1.ary "Structure for samples of fuel off adaptation / array of segment deviation samples" SWORD kw_q1p8310eEm4 1 100 -6.000000 5.999817 FORMAT "%8.6" ARRAY_SIZE 11 ECU_ADDRESS 0x60038EBC /end MEASUREMENT
/begin MEASUREMENT MisfDet_segTiAdpnSample1.cntr "Structure for samples of fuel off adaptation / segment deviation sample counter" UBYTE OneToOne 1 100 0.00 255.0 FORMAT "%5.1" ECU_ADDRESS 0x60038ED2 /end MEASUREMENT
/begin MEASUREMENT MisfDet_segTiAdpnSample1.segPosn "Structure for samples of fuel off adaptation / currently learnt segment position" UBYTE Compu_SegPosn_VERB 1 100 0.00 261.000000000 FORMAT "%13.9" ECU_ADDRESS 0x60038ED3 /end MEASUREMENT
/begin MEASUREMENT MisfDet_segTiAdpnSampleCntr "segment deviation sample counter" UBYTE OneToOne 1 100 0.00 255.0 FORMAT "%5.1" ECU_ADDRESS 0x6000097C /end MEASUREMENT
/begin MEASUREMENT MisfDet_segTiAdpnSampleMdn "median of segment deviation samples" SWORD kw_q1p8310eEm4 1 100 -6.000000 5.999817 FORMAT "%8.6" ARRAY_SIZE 1 ECU_ADDRESS 0x60009042 /end MEASUREMENT
/begin MEASUREMENT MisfDet_segTiAdpnSampleSprdCntr "counter for failed sample spread checks in segment time adaptation" UBYTE OneToOne 1 100 0.00 255.0 FORMAT "%5.1" ECU_ADDRESS 0x60038F05 /end MEASUREMENT
/begin MEASUREMENT MisfDet_segTiAdpnSampleSprdRelMax "maximum reached ratio of threshold for sample spread fault in segment time adaptation" UBYTE rel_ub_b200 1 100 0.00 199.2 FORMAT "%5.1" ECU_ADDRESS 0x60038F04 /end MEASUREMENT
/begin MEASUREMENT MisfDet_segTiAdpnStruct0.rat "structure for calculation of segment time adaptation / Ratio modelled segment time to actual segment time" SWORD kw_q1p8310eEm4 1 100 -6.000000 5.999817 FORMAT "%8.6" ARRAY_SIZE 4 ECU_ADDRESS 0x50000498 /end MEASUREMENT
/begin MEASUREMENT MisfDet_segTiAdpnStruct0.ratFltd "structure for calculation of segment time adaptation / Ratio modelled segment time to actual segment time filtered" SLONG kw_q2p794eEm9 1 100 -6.00000000000 5.99999999721 FORMAT "%13.11" ARRAY_SIZE 4 ECU_ADDRESS 0x500004A0 /end MEASUREMENT
/begin MEASUREMENT MisfDet_segTiAdpnStruct0.ratMin "structure for calculation of segment time adaptation / cylinder individual minimum of segment duration ratio values, used for MisfDet_segTiRatSprd calculation" SWORD kw_q1p8310eEm4 1 100 -6.000000 5.999817 FORMAT "%8.6" ARRAY_SIZE 2 ECU_ADDRESS 0x500004B0 /end MEASUREMENT
/begin MEASUREMENT MisfDet_segTiAdpnStruct0.ratMax "structure for calculation of segment time adaptation / cylinder individual maximum of segment time ratio values, used for MisfDet_segTiRatSprd calculation" SWORD kw_q1p8310eEm4 1 100 -6.000000 5.999817 FORMAT "%8.6" ARRAY_SIZE 2 ECU_ADDRESS 0x500004B4 /end MEASUREMENT
/begin MEASUREMENT MisfDet_segTiAdpnStruct0.ratMinDiv "structure for calculation of segment time adaptation / divisor for ratMin calculation" UBYTE OneToOne 1 100 0.00 255.0 FORMAT "%5.1" ARRAY_SIZE 2 ECU_ADDRESS 0x500004B8 /end MEASUREMENT
/begin MEASUREMENT MisfDet_segTiAdpnStruct0.ratMaxDiv "structure for calculation of segment time adaptation / divisor for ratMax calculation" UBYTE OneToOne 1 100 0.00 255.0 FORMAT "%5.1" ARRAY_SIZE 2 ECU_ADDRESS 0x500004BA /end MEASUREMENT
/begin MEASUREMENT MisfDet_segTiAdpnStruct0.ratSprd "structure for calculation of segment time adaptation / Spread of segment time ratios" UWORD kw_q1p8310eEm4 1 100 0.00 11.99982 FORMAT "%8.5" ECU_ADDRESS 0x500004BC /end MEASUREMENT
/begin MEASUREMENT MisfDet_segTiAdpnStruct0.stFilRdy "structure for calculation of segment time adaptation / Status filter settled" UBYTE B_TRUE 1 100 0.00 1.00000000000 BIT_MASK 0x1 FORMAT "%13.11" ECU_ADDRESS 0x500004BE /end MEASUREMENT
/begin MEASUREMENT MisfDet_segTiAdpnStruct0.stSampleSprdMax "structure for calculation of segment time adaptation / condition variation of segment deviation samples too big" UBYTE B_TRUE 1 100 0.00 1.00000000000 BIT_MASK 0x1 FORMAT "%13.11" ECU_ADDRESS 0x500004BF /end MEASUREMENT
/begin MEASUREMENT MisfDet_segTiAdpnStruct0.stMdnMax "structure for calculation of segment time adaptation / current Median greater than maximum allowed adaptation value" UBYTE B_TRUE 1 100 0.00 1.00000000000 BIT_MASK 0x1 FORMAT "%13.11" ECU_ADDRESS 0x500004C0 /end MEASUREMENT
/begin MEASUREMENT MisfDet_segTiAdpnStruct0.sampleMdn "structure for calculation of segment time adaptation / median of segment deviation samples" SWORD kw_q1p8310eEm4 1 100 -6.000000 5.999817 FORMAT "%8.6" ARRAY_SIZE 1 ECU_ADDRESS 0x500004C2 /end MEASUREMENT
/begin MEASUREMENT MisfDet_segTiAdpnStruct0.sampleSprd "structure for calculation of segment time adaptation / deviation of the five middle segment deviation samples" UWORD kw_q1p8310eEm4 1 100 0.00 11.99982 FORMAT "%8.5" ARRAY_SIZE 1 ECU_ADDRESS 0x500004C4 /end MEASUREMENT
/begin MEASUREMENT MisfDet_segTiAdpnStruct0.sampleCurr "structure for calculation of segment time adaptation / filter value segment deviation" SWORD kw_q1p8310eEm4 1 100 -6.000000 5.999817 FORMAT "%8.6" ARRAY_SIZE 1 ECU_ADDRESS 0x500004C6 /end MEASUREMENT
/begin MEASUREMENT MisfDet_segTiAdpnStruct0.segNr "structure for calculation of segment time adaptation / segment number" SBYTE OneToOne 1 100 -128.0 127.0 FORMAT "%5.1" ECU_ADDRESS 0x500004C8 /end MEASUREMENT
/begin MEASUREMENT MisfDet_segTiAdpnStruct1.rat "structure for calculation of segment time adaptation / Ratio modelled segment time to actual segment time" SWORD kw_q1p8310eEm4 1 100 -6.000000 5.999817 FORMAT "%8.6" ARRAY_SIZE 4 ECU_ADDRESS 0x500004CC /end MEASUREMENT
/begin MEASUREMENT MisfDet_segTiAdpnStruct1.ratFltd "structure for calculation of segment time adaptation / Ratio modelled segment time to actual segment time filtered" SLONG kw_q2p794eEm9 1 100 -6.00000000000 5.99999999721 FORMAT "%13.11" ARRAY_SIZE 4 ECU_ADDRESS 0x500004D4 /end MEASUREMENT
/begin MEASUREMENT MisfDet_segTiAdpnStruct1.ratMin "structure for calculation of segment time adaptation / cylinder individual minimum of segment duration ratio values, used for MisfDet_segTiRatSprd calculation" SWORD kw_q1p8310eEm4 1 100 -6.000000 5.999817 FORMAT "%8.6" ARRAY_SIZE 2 ECU_ADDRESS 0x500004E4 /end MEASUREMENT
/begin MEASUREMENT MisfDet_segTiAdpnStruct1.ratMax "structure for calculation of segment time adaptation / cylinder individual maximum of segment time ratio values, used for MisfDet_segTiRatSprd calculation" SWORD kw_q1p8310eEm4 1 100 -6.000000 5.999817 FORMAT "%8.6" ARRAY_SIZE 2 ECU_ADDRESS 0x500004E8 /end MEASUREMENT
/begin MEASUREMENT MisfDet_segTiAdpnStruct1.ratMinDiv "structure for calculation of segment time adaptation / divisor for ratMin calculation" UBYTE OneToOne 1 100 0.00 255.0 FORMAT "%5.1" ARRAY_SIZE 2 ECU_ADDRESS 0x500004EC /end MEASUREMENT
/begin MEASUREMENT MisfDet_segTiAdpnStruct1.ratMaxDiv "structure for calculation of segment time adaptation / divisor for ratMax calculation" UBYTE OneToOne 1 100 0.00 255.0 FORMAT "%5.1" ARRAY_SIZE 2 ECU_ADDRESS 0x500004EE /end MEASUREMENT
/begin MEASUREMENT MisfDet_segTiAdpnStruct1.ratSprd "structure for calculation of segment time adaptation / Spread of segment time ratios" UWORD kw_q1p8310eEm4 1 100 0.00 11.99982 FORMAT "%8.5" ECU_ADDRESS 0x500004F0 /end MEASUREMENT
/begin MEASUREMENT MisfDet_segTiAdpnStruct1.stFilRdy "structure for calculation of segment time adaptation / Status filter settled" UBYTE B_TRUE 1 100 0.00 1.00000000000 BIT_MASK 0x1 FORMAT "%13.11" ECU_ADDRESS 0x500004F2 /end MEASUREMENT
/begin MEASUREMENT MisfDet_segTiAdpnStruct1.stSampleSprdMax "structure for calculation of segment time adaptation / condition variation of segment deviation samples too big" UBYTE B_TRUE 1 100 0.00 1.00000000000 BIT_MASK 0x1 FORMAT "%13.11" ECU_ADDRESS 0x500004F3 /end MEASUREMENT
/begin MEASUREMENT MisfDet_segTiAdpnStruct1.stMdnMax "structure for calculation of segment time adaptation / current Median greater than maximum allowed adaptation value" UBYTE B_TRUE 1 100 0.00 1.00000000000 BIT_MASK 0x1 FORMAT "%13.11" ECU_ADDRESS 0x500004F4 /end MEASUREMENT
/begin MEASUREMENT MisfDet_segTiAdpnStruct1.sampleMdn "structure for calculation of segment time adaptation / median of segment deviation samples" SWORD kw_q1p8310eEm4 1 100 -6.000000 5.999817 FORMAT "%8.6" ARRAY_SIZE 1 ECU_ADDRESS 0x500004F6 /end MEASUREMENT
/begin MEASUREMENT MisfDet_segTiAdpnStruct1.sampleSprd "structure for calculation of segment time adaptation / deviation of the five middle segment deviation samples" UWORD kw_q1p8310eEm4 1 100 0.00 11.99982 FORMAT "%8.5" ARRAY_SIZE 1 ECU_ADDRESS 0x500004F8 /end MEASUREMENT
/begin MEASUREMENT MisfDet_segTiAdpnStruct1.sampleCurr "structure for calculation of segment time adaptation / filter value segment deviation" SWORD kw_q1p8310eEm4 1 100 -6.000000 5.999817 FORMAT "%8.6" ARRAY_SIZE 1 ECU_ADDRESS 0x500004FA /end MEASUREMENT
/begin MEASUREMENT MisfDet_segTiAdpnStruct1.segNr "structure for calculation of segment time adaptation / segment number" SBYTE OneToOne 1 100 -128.0 127.0 FORMAT "%5.1" ECU_ADDRESS 0x500004FC /end MEASUREMENT
/begin MEASUREMENT MisfDet_segTiAdpnTqMax "upper torque limit to enable MisfDet_SegTiAdpn adaptation" SWORD Trq 1 100 -3276.800 3276.700 FORMAT "%8.3" ECU_ADDRESS 0x50000846 /end MEASUREMENT
/begin MEASUREMENT MisfDet_segTiAdpnTqMin "lower torque limit to enable MisfDet_SegTiAdpn adaptation" SWORD Trq 1 100 -3276.800 3276.700 FORMAT "%8.3" ECU_ADDRESS 0x5000084A /end MEASUREMENT
/begin MEASUREMENT MisfDet_segTiAdpnVal "adaptation values of segTiAdpn" SWORD kw_q1p8310eEm4 1 100 -6.000000 5.999817 FORMAT "%8.6" ARRAY_SIZE 1 ECU_ADDRESS 0x50005E16 /end MEASUREMENT
/begin MEASUREMENT MisfDet_segTiAdpnValAltvPosn "adaptation values of segTiAdpn, alternative position" SWORD kw_q1p8310eEm4 1 100 -6.000000 5.999817 FORMAT "%8.6" ARRAY_SIZE 1 ECU_ADDRESS 0x60009E1E /end MEASUREMENT
/begin MEASUREMENT MisfDet_segTiAdpnValMaxCntr "counter for failed max checks in segment time adaptation" UBYTE OneToOne 1 100 0.00 255.0 FORMAT "%5.1" ECU_ADDRESS 0x60038F03 /end MEASUREMENT
/begin MEASUREMENT MisfDet_segTiAdpnValMaxCntrEol "counter for failed max checks in segment time adaptation at end of line mode" UBYTE OneToOne 1 100 0.00 255.0 FORMAT "%5.1" ECU_ADDRESS 0x60038F02 /end MEASUREMENT
/begin MEASUREMENT MisfDet_segTiAdpnValMaxDebCntrAltvPosn "debounce counter of the alternative segment time position for maximum values diagnosis" UBYTE OneToOne 1 100 0.00 255.0 FORMAT "%5.1" ECU_ADDRESS 0x60038EF8 /end MEASUREMENT
/begin MEASUREMENT MisfDet_segTiAdpnValMaxDebCntrStdPosn "debounce counter of the standard segment time position for maximum values diagnosis" UBYTE OneToOne 1 100 0.00 255.0 FORMAT "%5.1" ECU_ADDRESS 0x60038EF7 /end MEASUREMENT
/begin MEASUREMENT MisfDet_segTiAdpnValRelMax "maximum reached ratio of threshold for max fault in segment time adaptation" UBYTE rel_ub_b200 1 100 0.00 199.2 FORMAT "%5.1" ECU_ADDRESS 0x60038F01 /end MEASUREMENT
/begin MEASUREMENT MisfDet_segTiAdpnValSampleDiagCntrAltvPosn "Sample counter of Sample-plausibility check diagnosis for the alternative segment position" UBYTE OneToOne 1 100 0.00 255.0 FORMAT "%5.1" ECU_ADDRESS 0x60038EF6 /end MEASUREMENT
/begin MEASUREMENT MisfDet_segTiAdpnValSampleDiagCntrStdPosn "Sample counter of Sample-plausibility check diagnosis for the standard segment position" UBYTE OneToOne 1 100 0.00 255.0 FORMAT "%5.1" ECU_ADDRESS 0x60038EF5 /end MEASUREMENT
/begin MEASUREMENT MisfDet_segTiAdpnValSampleDiagDebCntrAltvPosn "Debounce counter of Sample-plausibility check diagnosis for the alternative segment position" UBYTE OneToOne 1 100 0.00 255.0 FORMAT "%5.1" ECU_ADDRESS 0x60038EF4 /end MEASUREMENT
/begin MEASUREMENT MisfDet_segTiAdpnValSampleDiagDebCntrStdPosn "Debounce counter of Sample-plausibility check diagnosis for the standard segment position" UBYTE OneToOne 1 100 0.00 255.0 FORMAT "%5.1" ECU_ADDRESS 0x60038EF3 /end MEASUREMENT
/begin MEASUREMENT MisfDet_segTiAry "Array of segment times (per segment position)" ULONG tsquant_l 1 100 0.00 214748364.750 FORMAT "%13.3" ARRAY_SIZE 2 ECU_ADDRESS 0x50000684 /end MEASUREMENT
/begin MEASUREMENT MisfDet_segTiDifDebCntr "debounce counter for plausibility check for delta of new learning values to stored values" UBYTE OneToOne 1 100 0.00 255.0 FORMAT "%5.1" ECU_ADDRESS 0x60038EF2 /end MEASUREMENT
/begin MEASUREMENT MisfDet_segTiDly "delay of igntition to segment time" UBYTE dez 1 100 0.00 255.0 FORMAT "%5.1" ECU_ADDRESS 0x500009A6 /end MEASUREMENT
/begin MEASUREMENT MisfDet_segTiDlyCorr "correction value for segment time delay to ignition" SBYTE OneToOne 1 100 -128.0 127.0 FORMAT "%5.1" ECU_ADDRESS 0x5000096E /end MEASUREMENT
/begin MEASUREMENT MisfDet_segTiRatSprdCntrAltvPosn "counter for failed ratio spread checks for alternative segment position" UBYTE OneToOne 1 100 0.00 255.0 FORMAT "%5.1" ECU_ADDRESS 0x60038F00 /end MEASUREMENT
/begin MEASUREMENT MisfDet_segTiRatSprdCntrStdPosn "counter for failed ratio spread checks for standard segment position" UBYTE OneToOne 1 100 0.00 255.0 FORMAT "%5.1" ECU_ADDRESS 0x60038EFF /end MEASUREMENT
/begin MEASUREMENT MisfDet_segTiRatSprdDebCntrAltvPosn "debounce counter for plausibility check for ratio of sampled values for alternative segment position" UBYTE OneToOne 1 100 0.00 255.0 FORMAT "%5.1" ECU_ADDRESS 0x60038EF1 /end MEASUREMENT
/begin MEASUREMENT MisfDet_segTiRatSprdDebCntrStdPosn "debounce counter for plausibility check for ratio of sampled values for standard segment position" UBYTE OneToOne 1 100 0.00 255.0 FORMAT "%5.1" ECU_ADDRESS 0x60038EF0 /end MEASUREMENT
/begin MEASUREMENT MisfDet_segTiRatSprdRelMax "maximum reached ratio of threshold for ratio spread fault in segment time adaptation" UBYTE rel_ub_b200 1 100 0.00 199.2 FORMAT "%5.1" ECU_ADDRESS 0x60038EFE /end MEASUREMENT
/begin MEASUREMENT MisfDet_segTiRawAry "Array of raw segment times (per segment position)" ULONG tsquant_l 1 100 0.00 214748364.750 FORMAT "%13.3" ARRAY_SIZE 2 ECU_ADDRESS 0x5000068C /end MEASUREMENT
/begin MEASUREMENT MisfDet_segTiSampleSprdDebCntrAltvPosn "debounce counter for plausibility check for spreading of sampled values for alternative segment position" UBYTE OneToOne 1 100 0.00 255.0 FORMAT "%5.1" ECU_ADDRESS 0x60038EEF /end MEASUREMENT
/begin MEASUREMENT MisfDet_segTiSampleSprdDebCntrStdPosn "debounce counter for plausibility check for spreading of sampled values for standard segment position" UBYTE OneToOne 1 100 0.00 255.0 FORMAT "%5.1" ECU_ADDRESS 0x60038EEE /end MEASUREMENT
/begin MEASUREMENT MisfDet_segTiSegBasd "segment time based on raw time stamps" ULONG tsquant_l 1 100 0.00 214748364.750 FORMAT "%13.3" ARRAY_SIZE 2 ECU_ADDRESS 0x50000500 /end MEASUREMENT
/begin MEASUREMENT MisfDet_segTiValMdl "modelled segment time" ULONG tsquant_l 1 100 0.00 214748364.750 FORMAT "%13.3" ARRAY_SIZE 2 ECU_ADDRESS 0x50000508 /end MEASUREMENT
/begin MEASUREMENT MisfDet_segTiValSync "synchronized segment time" ULONG tsquant_l 1 100 0.00 214748364.750 FORMAT "%13.3" ARRAY_SIZE 2 ECU_ADDRESS 0x50000510 /end MEASUREMENT
/begin MEASUREMENT MisfDet_simrCdn.n "Freeze frame data for similar conditions misfire fault / engine speed for similar conditions" UWORD nmot_uw_q0p25 1 100 0.00 16383.75 FORMAT "%8.2" ECU_ADDRESS 0x50000518 /end MEASUREMENT
/begin MEASUREMENT MisfDet_simrCdn.load "Freeze frame data for similar conditions misfire fault / load for similar conditions" UBYTE rel_ub_b99p6 1 100 0.00 99.61 FORMAT "%5.2" ECU_ADDRESS 0x5000051A /end MEASUREMENT
/begin MEASUREMENT MisfDet_simrCdn.T "Freeze frame data for similar conditions misfire fault / Warm-Up state for similar coditions" UBYTE B_TRUE 1 100 0.00 1.00000000000 BIT_MASK 0x1 FORMAT "%13.11" ECU_ADDRESS 0x5000051B /end MEASUREMENT
/begin MEASUREMENT MisfDet_stCatDmg "cat damage during past intervall" UBYTE B_TRUE 1 100 0.00 1.00000000000 BIT_MASK 0x1 FORMAT "%13.11" ECU_ADDRESS 0x5000608D /end MEASUREMENT
/begin MEASUREMENT MisfDet_stCatDmgBnk "exhaust bank individual statusbyte for catalyst damaging misfire rate exceeded" UBYTE OneToOne 1 100 0.00 255.0 FORMAT "%5.1" ECU_ADDRESS 0x500009A7 /end MEASUREMENT
/begin MEASUREMENT MisfDet_stCatDmgBnkCurrIntl "Catalyst damage bank index" UBYTE OneToOne 1 100 0.00 255.0 FORMAT "%5.1" ECU_ADDRESS 0x6000097D /end MEASUREMENT
/begin MEASUREMENT MisfDet_stCatDmgCritScav "Catalyst damaginging at high scavenging rate detected" UBYTE B_TRUE 1 100 0.00 1.00000000000 BIT_MASK 0x1 FORMAT "%13.11" ECU_ADDRESS 0x60010129 /end MEASUREMENT
/begin MEASUREMENT MisfDet_stCatDmgCritScavCurr "Catalyst damaginging at high scavenging rate detected at current interval" UBYTE B_TRUE 1 100 0.00 1.00000000000 BIT_MASK 0x1 FORMAT "%13.11" ECU_ADDRESS 0x60010128 /end MEASUREMENT
/begin MEASUREMENT MisfDet_stCatDmgCurrIntl "Condition for catalyst damaging misfire detected for this kat- intervall" UBYTE B_TRUE 1 100 0.00 1.00000000000 BIT_MASK 0x1 FORMAT "%13.11" ECU_ADDRESS 0x60010127 /end MEASUREMENT
/begin MEASUREMENT MisfDet_stCatDmgDebd "status debouncing for catalyst damaging expired" UBYTE B_TRUE 1 100 0.00 1.00000000000 BIT_MASK 0x1 FORMAT "%13.11" ECU_ADDRESS 0x70000161 /end MEASUREMENT
/begin MEASUREMENT MisfDet_stCatDmgDebMisfOutdRng "status misfire detected out of range for debouncing" UBYTE B_TRUE 1 100 0.00 1.00000000000 BIT_MASK 0x1 FORMAT "%13.11" ECU_ADDRESS 0x70000160 /end MEASUREMENT
/begin MEASUREMENT MisfDet_stCatDmgDebOutOfRng "status out of range for debouncing" UBYTE B_TRUE 1 100 0.00 1.00000000000 BIT_MASK 0x1 FORMAT "%13.11" ECU_ADDRESS 0x7000015F /end MEASUREMENT
/begin MEASUREMENT MisfDet_stCatDmgFcoCyl "state flag fuel cutoff by catalyst damaging misfiring rates" UBYTE OneToOne 1 100 0.00 255.0 FORMAT "%5.1" ECU_ADDRESS 0x500009A8 /end MEASUREMENT
/begin MEASUREMENT MisfDet_stCatDmgFcoCylCurrIntl "Cylinder has fulfilled criterias for cylinder deactivatino at current interval" UWORD OneToOne 1 100 0.00 65535.00 FORMAT "%8.2" ECU_ADDRESS 0x600005DE /end MEASUREMENT
/begin MEASUREMENT MisfDet_stCatDmgFcoEng "state flag fuel cutoff by catalyst damaging misfiring rates" UWORD OneToOne 1 100 0.00 65535.00 FORMAT "%8.2" ECU_ADDRESS 0x5000084E /end MEASUREMENT
/begin MEASUREMENT MisfDet_stCatDmgLstIntl "catalyst damaging at past interval" UBYTE B_TRUE 1 100 0.00 1.00000000000 BIT_MASK 0x1 FORMAT "%13.11" ECU_ADDRESS 0x60010126 /end MEASUREMENT
/begin MEASUREMENT MisfDet_stCatFltMpl "multiple misfire fault detected" UBYTE B_TRUE 1 100 0.00 1.00000000000 BIT_MASK 0x1 FORMAT "%13.11" ECU_ADDRESS 0x7000015E /end MEASUREMENT
/begin MEASUREMENT MisfDet_stCatIntlCritScav "High scavenging rate at current cat interval" UBYTE B_TRUE 1 100 0.00 1.00000000000 BIT_MASK 0x1 FORMAT "%13.11" ECU_ADDRESS 0x60010125 /end MEASUREMENT
/begin MEASUREMENT MisfDet_StcCatCntrSimrCdn.misfBnk "counter of catalyst damage in similar conditions / misfire counter sum of exhaust bank under similar conditions" UWORD OneToOne 1 100 0.00 65535.00 FORMAT "%8.2" ARRAY_SIZE 1 ECU_ADDRESS 0x50000328 /end MEASUREMENT
/begin MEASUREMENT MisfDet_StcCatCntrSimrCdn.ign "counter of catalyst damage in similar conditions / ignition counter in cat interval" UWORD OneToOne 1 100 0.00 65535.00 FORMAT "%8.2" ECU_ADDRESS 0x5000032A /end MEASUREMENT
/begin MEASUREMENT MisfDet_stcCatDmgCritScavIntlCntr "Catalyst damaginging intervals at high scavenging rate" UBYTE OneToOne 1 100 0.00 255.0 FORMAT "%5.1" ECU_ADDRESS 0x70003674 /end MEASUREMENT
/begin MEASUREMENT MisfDet_stcCatDmgDebIntlCntr "counter encountered from catalyst damaging till FSP entry" UBYTE OneToOne 1 100 0.00 255.0 FORMAT "%5.1" ECU_ADDRESS 0x60000907 /end MEASUREMENT
/begin MEASUREMENT MisfDet_stcCatDmgFcoNrCylBnk "number of deactivated cylinders on exhaust bank" UBYTE OneToOne 1 100 0.00 255.0 FORMAT "%5.1" ARRAY_SIZE 1 ECU_ADDRESS 0x500009AF /end MEASUREMENT
/begin MEASUREMENT MisfDet_stcCatDmgFcoNrIntlCyl "Number of intervals criterias for cylinder deactivation met" UBYTE OneToOne 1 100 0.00 255.0 FORMAT "%5.1" ARRAY_SIZE 4 ECU_ADDRESS 0x5000051C /end MEASUREMENT
/begin MEASUREMENT MisfDet_stcCatDmgFcoNrIntlMin "Necessary number of intervals criterias for cylinder deactivation met" UBYTE OneToOne 1 100 0.00 255.0 FORMAT "%5.1" ECU_ADDRESS 0x50006020 /end MEASUREMENT
/begin MEASUREMENT MisfDet_stcCatDmgFcoNrIntlStrt "Number of intervals since start" UBYTE OneToOne 1 100 0.00 255.0 FORMAT "%5.1" ECU_ADDRESS 0x60000908 /end MEASUREMENT
/begin MEASUREMENT MisfDet_stcCatDmgNrCyl "Number of catalyst damaging cylinders" UBYTE OneToOne 1 100 0.00 255.0 FORMAT "%5.1" ECU_ADDRESS 0x60000983 /end MEASUREMENT
/begin MEASUREMENT MisfDet_stcCatIgnCntr "Ignition counter for cat interval" UWORD OneToOne 1 100 0.00 65535.00 FORMAT "%8.2" ECU_ADDRESS 0x50000852 /end MEASUREMENT
/begin MEASUREMENT MisfDet_stcCatIntlLen "Number of ignitions of cat interval" UWORD OneToOne 1 100 0.00 65535.00 FORMAT "%8.2" ECU_ADDRESS 0x50000854 /end MEASUREMENT
/begin MEASUREMENT MisfDet_stcCatIntlLenMaxSimrCdn "Length of cat interval for similar conditions" UWORD OneToOne 1 100 0.00 65535.00 FORMAT "%8.2" ECU_ADDRESS 0x600005E0 /end MEASUREMENT
/begin MEASUREMENT MisfDet_stcCatMisfCntrBnk "Weighted misfire counter for exhaust bank" UWORD OneToOne 1 100 0.00 65535.00 FORMAT "%8.2" ARRAY_SIZE 1 ECU_ADDRESS 0x50000856 /end MEASUREMENT
/begin MEASUREMENT MisfDet_stcCatMisfCntrBnkCritScav "Counter for catalyst damaging misfire per cylinder bank considering high scavenging rate" UWORD OneToOne 1 100 0.00 65535.00 FORMAT "%8.2" ARRAY_SIZE 1 ECU_ADDRESS 0x70003816 /end MEASUREMENT
/begin MEASUREMENT MisfDet_stcCatMisfCntrCyl "weighted misfire counter cylinder individual" UWORD OneToOne 1 100 0.00 65535.00 FORMAT "%8.2" ARRAY_SIZE 4 ECU_ADDRESS 0x50000694 /end MEASUREMENT
/begin MEASUREMENT MisfDet_stcCatMisfCntrSumNotWght "unweighted misfire counter for cat interval" UWORD dez 1 100 0.00 65535.00 FORMAT "%8.2" ECU_ADDRESS 0x6000070C /end MEASUREMENT
/begin MEASUREMENT MisfDet_stcCatThd "Threshold for catalyst damaging" UWORD OneToOne 1 100 0.00 65535.00 FORMAT "%8.2" ECU_ADDRESS 0x50000858 /end MEASUREMENT
/begin MEASUREMENT MisfDet_stcCatThdMaxSimrCdn "Threshold for catalyst damaging for similar conditions" UWORD OneToOne 1 100 0.00 65535.00 FORMAT "%8.2" ECU_ADDRESS 0x600005E2 /end MEASUREMENT
/begin MEASUREMENT MisfDet_stcCatWghtFac "weighting factor for misfire counter" UBYTE OneToOne 1 100 0.00 255.0 FORMAT "%5.1" ECU_ADDRESS 0x500009B1 /end MEASUREMENT
/begin MEASUREMENT MisfDet_stcCatWghtFacCritScav "Catalyst protection, weighting factors considering high scavenging rates" UBYTE OneToOne 1 100 0.00 255.0 FORMAT "%5.1" ECU_ADDRESS 0x70003673 /end MEASUREMENT
/begin MEASUREMENT MisfDet_stcEmiIgnCntr "ignition counter for emission interval" UWORD OneToOne 1 100 0.00 65535.00 FORMAT "%8.2" ECU_ADDRESS 0x5000085A /end MEASUREMENT
/begin MEASUREMENT MisfDet_stcEmiIntlCntr "interval counter for emission statistic" UBYTE OneToOne 1 100 0.00 255.0 FORMAT "%5.1" ECU_ADDRESS 0x70003672 /end MEASUREMENT
/begin MEASUREMENT MisfDet_stcEmiIntlDmgCntr "counter iof damaged emission intervals" UBYTE OneToOne 1 100 0.00 255.0 FORMAT "%5.1" ECU_ADDRESS 0x70003671 /end MEASUREMENT
/begin MEASUREMENT MisfDet_stcEmiMisfCntrCyl "cylinder individual misfire counter for emission statistic" UWORD OneToOne 1 100 0.00 65535.00 FORMAT "%8.2" ARRAY_SIZE 4 ECU_ADDRESS 0x5000069C /end MEASUREMENT
/begin MEASUREMENT MisfDet_stcEmiMisfCntrSum "misfire sum counter emission statistic" UWORD OneToOne 1 100 0.00 65535.00 FORMAT "%8.2" ECU_ADDRESS 0x5000085C /end MEASUREMENT
/begin MEASUREMENT MisfDet_stcEmiStructCntr.misfSum "structure for counters of emission statistic / misfire sum counter" UWORD OneToOne 1 100 0.00 65535.00 FORMAT "%8.2" ECU_ADDRESS 0x5000072E /end MEASUREMENT
/begin MEASUREMENT MisfDet_stcEmiStructCntr.misfCyl "structure for counters of emission statistic / cylinder individual misfire counter" UWORD OneToOne 1 100 0.00 65535.00 FORMAT "%8.2" ARRAY_SIZE 4 ECU_ADDRESS 0x50000730 /end MEASUREMENT
/begin MEASUREMENT MisfDet_stcEmiStructCntr.ign "structure for counters of emission statistic / ignition counter in emission interval" UWORD OneToOne 1 100 0.00 65535.00 FORMAT "%8.2" ECU_ADDRESS 0x50000738 /end MEASUREMENT
/begin MEASUREMENT MisfDet_stcEmiStructCntr.intl "structure for counters of emission statistic / counter emission intervals" UBYTE OneToOne 1 100 0.00 255.0 FORMAT "%5.1" ECU_ADDRESS 0x5000073A /end MEASUREMENT
/begin MEASUREMENT MisfDet_stcEmiStructCntr.dmgIntl "structure for counters of emission statistic / number of damaged intervals" UBYTE OneToOne 1 100 0.00 255.0 FORMAT "%5.1" ECU_ADDRESS 0x5000073B /end MEASUREMENT
/begin MEASUREMENT MisfDet_stcEmiStructCntr.stCylDmgCylIdn "structure for counters of emission statistic / status erroneous cylinders for cylinder individual fault" UWORD OneToOne 1 100 0.00 65535.00 FORMAT "%8.2" ECU_ADDRESS 0x5000073C /end MEASUREMENT
/begin MEASUREMENT MisfDet_stcEmiStructCntr.stCylDmgMtpl "structure for counters of emission statistic / status erroneous cylinders for multiple ault" UWORD OneToOne 1 100 0.00 65535.00 FORMAT "%8.2" ECU_ADDRESS 0x5000073E /end MEASUREMENT
/begin MEASUREMENT MisfDet_stcEmiStructSimrCdn.misfSum "structure for counters of emission statistic if similar conditions are encountered / misfire sum counter" UWORD OneToOne 1 100 0.00 65535.00 FORMAT "%8.2" ECU_ADDRESS 0x50000520 /end MEASUREMENT
/begin MEASUREMENT MisfDet_stcEmiStructSimrCdn.ign "structure for counters of emission statistic if similar conditions are encountered / ignition counter in emission interval" UWORD OneToOne 1 100 0.00 65535.00 FORMAT "%8.2" ECU_ADDRESS 0x50000522 /end MEASUREMENT
/begin MEASUREMENT MisfDet_stcEmiStructSimrCdn.intl "structure for counters of emission statistic if similar conditions are encountered / counter emission intervals" UWORD OneToOne 1 100 0.00 65535.00 FORMAT "%8.2" ECU_ADDRESS 0x50000524 /end MEASUREMENT
/begin MEASUREMENT MisfDet_stcEmiStructSimrCdn.dmgIntl "structure for counters of emission statistic if similar conditions are encountered / number of damaged intervals" UBYTE OneToOne 1 100 0.00 255.0 FORMAT "%5.1" ECU_ADDRESS 0x50000526 /end MEASUREMENT
/begin MEASUREMENT MisfDet_stcEmiStructSimrCdnStrt.misfSum "structure for counters of emission statistic if similar conditions are encountered first interval / misfire sum counter" UWORD OneToOne 1 100 0.00 65535.00 FORMAT "%8.2" ECU_ADDRESS 0x50000528 /end MEASUREMENT
/begin MEASUREMENT MisfDet_stcEmiStructSimrCdnStrt.ign "structure for counters of emission statistic if similar conditions are encountered first interval / ignition counter in emission interval" UWORD OneToOne 1 100 0.00 65535.00 FORMAT "%8.2" ECU_ADDRESS 0x5000052A /end MEASUREMENT
/begin MEASUREMENT MisfDet_stcEmiStructSimrCdnStrt.intl "structure for counters of emission statistic if similar conditions are encountered first interval / counter emission intervals" UWORD OneToOne 1 100 0.00 65535.00 FORMAT "%8.2" ECU_ADDRESS 0x5000052C /end MEASUREMENT
/begin MEASUREMENT MisfDet_stcEmiStructSimrCdnStrt.dmgIntl "structure for counters of emission statistic if similar conditions are encountered first interval / number of damaged intervals" UBYTE OneToOne 1 100 0.00 255.0 FORMAT "%5.1" ECU_ADDRESS 0x5000052E /end MEASUREMENT
/begin MEASUREMENT MisfDet_stcEmiThd "threshold for emission exceedance" UWORD OneToOne 1 100 0.00 65535.00 FORMAT "%8.2" ECU_ADDRESS 0x70003814 /end MEASUREMENT
/begin MEASUREMENT MisfDet_stCntMisf "count misfire event" UBYTE B_TRUE 1 100 0.00 1.00000000000 BIT_MASK 0x1 FORMAT "%13.11" ECU_ADDRESS 0x70000810 /end MEASUREMENT
/begin MEASUREMENT MisfDet_stDiagVWhlDeEnbl "State plausible check of wheel speed active" UBYTE B_TRUE 1 100 0.00 1.00000000000 BIT_MASK 0x1 FORMAT "%13.11" ECU_ADDRESS 0x7000016A /end MEASUREMENT
/begin MEASUREMENT MisfDet_stDiagVWhlStuck "Enable status of stuck diagnosis of wheel speeds" UBYTE B_TRUE 1 100 0.00 1.00000000000 BIT_MASK 0x1 FORMAT "%13.11" ECU_ADDRESS 0x70000169 /end MEASUREMENT
/begin MEASUREMENT MisfDet_stDnAdpnRstReq "Reset request Dn-adaptation" UBYTE B_TRUE 1 100 0.00 1.00000000000 BIT_MASK 0x1 FORMAT "%13.11" ECU_ADDRESS 0x6001011F /end MEASUREMENT
/begin MEASUREMENT MisfDet_stDnThdDynLim "dynamic limitation enabled" UBYTE B_TRUE 1 100 0.00 1.00000000000 BIT_MASK 0x1 FORMAT "%13.11" ECU_ADDRESS 0x7000080A /end MEASUREMENT
/begin MEASUREMENT MisfDet_stEmiDmgCurrIntl "State of emission damgage current interval" UBYTE B_TRUE 1 100 0.00 1.00000000000 BIT_MASK 0x1 FORMAT "%13.11" ECU_ADDRESS 0x6001011C /end MEASUREMENT
/begin MEASUREMENT MisfDet_stEmiFltMpl "Status multiple fault by emission exceedance" UBYTE B_TRUE 1 100 0.00 1.00000000000 BIT_MASK 0x1 FORMAT "%13.11" ECU_ADDRESS 0x7000015D /end MEASUREMENT
/begin MEASUREMENT MisfDet_stExhDmgSuspc "suspicion for emission relevant misfire rate" UBYTE B_TRUE 1 100 0.00 1.00000000000 BIT_MASK 0x1 FORMAT "%13.11" ECU_ADDRESS 0x50006093 /end MEASUREMENT
/begin MEASUREMENT MisfDet_stExtClrReq "external request to reset the segment time adaption values" UBYTE B_TRUE 1 100 0.00 1.00000000000 BIT_MASK 0x1 FORMAT "%13.11" ECU_ADDRESS 0x70000167 /end MEASUREMENT
/begin MEASUREMENT MisfDet_stFlt "status of fault types in DFES" UBYTE OneToOne 1 100 0.00 255.0 FORMAT "%5.1" ECU_ADDRESS 0x60038EA9 /end MEASUREMENT
/begin MEASUREMENT MisfDet_stFltCurrDcyc "status of fault types at current driving cycle" UBYTE OneToOne 1 100 0.00 255.0 FORMAT "%5.1" ECU_ADDRESS 0x6000097E /end MEASUREMENT
/begin MEASUREMENT MisfDet_stFltCyl "bit mask cylinders with fault code entry" UWORD OneToOne 1 100 0.00 65535.00 FORMAT "%8.2" ECU_ADDRESS 0x6000070A /end MEASUREMENT
/begin MEASUREMENT MisfDet_stFltPrevDcyc "status of fault types of past driving cycles" UBYTE OneToOne 1 100 0.00 255.0 FORMAT "%5.1" ECU_ADDRESS 0x500009AA /end MEASUREMENT
/begin MEASUREMENT MisfDet_stMisfCont "Status continuous misfires" UBYTE B_TRUE 1 100 0.00 1.00000000000 BIT_MASK 0x1 FORMAT "%13.11" ECU_ADDRESS 0x70000805 /end MEASUREMENT
/begin MEASUREMENT MisfDet_stOk "Status of ok report specific for the fault types" UBYTE OneToOne 1 100 0.00 255.0 FORMAT "%5.1" ECU_ADDRESS 0x60000906 /end MEASUREMENT
/begin MEASUREMENT MisfDet_stSegPosnIaLte "state of identifying the late ignition angle" UBYTE B_TRUE 1 100 0.00 1.00000000000 BIT_MASK 0x1 FORMAT "%13.11" ECU_ADDRESS 0x6001010F /end MEASUREMENT
/begin MEASUREMENT MisfDet_stSegPosnOffsIdle "Status segment shift at low idle" UBYTE B_TRUE 1 100 0.00 1.00000000000 BIT_MASK 0x1 FORMAT "%13.11" ECU_ADDRESS 0x6001010E /end MEASUREMENT
/begin MEASUREMENT MisfDet_stSegPosnOffsTqLo "Status torque condition met for segment shift at low idle" UBYTE B_TRUE 1 100 0.00 1.00000000000 BIT_MASK 0x1 FORMAT "%13.11" ECU_ADDRESS 0x6001010D /end MEASUREMENT
/begin MEASUREMENT MisfDet_stSegShift "status alternative segment used" UBYTE B_TRUE 1 100 0.00 1.00000000000 BIT_MASK 0x1 FORMAT "%13.11" ECU_ADDRESS 0x6001010C /end MEASUREMENT
/begin MEASUREMENT MisfDet_stSegShiftCatHeat "condition segment position shifted in case of cat heating measures" UBYTE B_TRUE 1 100 0.00 1.00000000000 BIT_MASK 0x1 FORMAT "%13.11" ECU_ADDRESS 0x70000163 /end MEASUREMENT
/begin MEASUREMENT MisfDet_stSegShiftRedStg "condition segment position shifted in case of reduction stage" UBYTE B_TRUE 1 100 0.00 1.00000000000 BIT_MASK 0x1 FORMAT "%13.11" ECU_ADDRESS 0x70000162 /end MEASUREMENT
/begin MEASUREMENT MisfDet_stSegTiAdpn "Status segment time adaptation" UBYTE B_TRUE 1 100 0.00 1.00000000000 BIT_MASK 0x1 FORMAT "%13.11" ECU_ADDRESS 0x6001010B /end MEASUREMENT
/begin MEASUREMENT MisfDet_stSegTiAdpnActv "segment time adaptation active" UBYTE B_TRUE 1 100 0.00 1.00000000000 BIT_MASK 0x1 FORMAT "%13.11" ECU_ADDRESS 0x5000609C /end MEASUREMENT
/begin MEASUREMENT MisfDet_stSegTiAdpnCfgEnaTypVal "code word to enable the segment time adaptation at fuel cut off or at positive torque" UBYTE OneToOne 1 100 0.00 255.0 FORMAT "%5.1" ECU_ADDRESS 0x500009AB /end MEASUREMENT
/begin MEASUREMENT MisfDet_stSegTiAdpnEna "condition segment time adaptation is enabled" UBYTE B_TRUE 1 100 0.00 1.00000000000 BIT_MASK 0x1 FORMAT "%13.11" ECU_ADDRESS 0x5000609E /end MEASUREMENT
/begin MEASUREMENT MisfDet_stSegTiAdpnEnaEol "condition quick adaptation mode for MisfDet_SegTiAdpn at end of line enabled" UBYTE B_TRUE 1 100 0.00 1.00000000000 BIT_MASK 0x1 FORMAT "%13.11" ECU_ADDRESS 0x5000609F /end MEASUREMENT
/begin MEASUREMENT MisfDet_stSegTiAdpnEolReq "adaptation in end of line mode requested" UBYTE B_TRUE 1 100 0.00 1.00000000000 BIT_MASK 0x1 FORMAT "%13.11" ECU_ADDRESS 0x6001010A /end MEASUREMENT
/begin MEASUREMENT MisfDet_stSegTiAdpnFcoOnly "Inhibiting adaptation at positive torque after completed learning at fuel cut offf" UBYTE B_TRUE 1 100 0.00 1.00000000000 BIT_MASK 0x1 FORMAT "%13.11" ECU_ADDRESS 0x70000166 /end MEASUREMENT
/begin MEASUREMENT MisfDet_stSegTiAdpnLrntSegPosnCyc "Segment individual bit mask for learnt segment time adaptation" UBYTE OneToOne 1 100 0.00 255.0 FORMAT "%5.1" ECU_ADDRESS 0x60038EFD /end MEASUREMENT
/begin MEASUREMENT MisfDet_stSegTiAdpnRdy "cond. Segment time adaptation in actual speed range ready" UBYTE B_TRUE 1 100 0.00 1.00000000000 BIT_MASK 0x1 FORMAT "%13.11" ECU_ADDRESS 0x500060A1 /end MEASUREMENT
/begin MEASUREMENT MisfDet_stSegTiAdpnRdyPosn "Bit mask adaptation of the segment positions completed" UBYTE OneToOne 1 100 0.00 255.0 FORMAT "%5.1" ECU_ADDRESS 0x500009AD /end MEASUREMENT
/begin MEASUREMENT MisfDet_stSegTiAdpnRng "condition operating range in 1st speed range" UBYTE B_TRUE 1 100 0.00 1.00000000000 BIT_MASK 0x1 FORMAT "%13.11" ECU_ADDRESS 0x60010109 /end MEASUREMENT
/begin MEASUREMENT MisfDet_stSegTiAdpnRst "reset of segment time adaptation" UBYTE OneToOne 1 100 0.00 255.0 FORMAT "%5.1" ECU_ADDRESS 0x60000981 /end MEASUREMENT
/begin MEASUREMENT MisfDet_stSegTiAdpnRstCfm "Reset confirmation of segment time adaptation" UBYTE B_TRUE 1 100 0.00 1.00000000000 BIT_MASK 0x1 FORMAT "%13.11" ECU_ADDRESS 0x60010108 /end MEASUREMENT
/begin MEASUREMENT MisfDet_stSegTiAdpnSampleCalc "condition segment time adaptation is running" UBYTE B_TRUE 1 100 0.00 1.00000000000 BIT_MASK 0x1 FORMAT "%13.11" ECU_ADDRESS 0x70000165 /end MEASUREMENT
/begin MEASUREMENT MisfDet_stSegTiAdpnSampleRdy "condition new segment deviation sample actually taken" UBYTE B_TRUE 1 100 0.00 1.00000000000 BIT_MASK 0x1 FORMAT "%13.11" ECU_ADDRESS 0x60010106 /end MEASUREMENT
/begin MEASUREMENT MisfDet_stSegTiAdpnSimuLrn "simultaneous learning of both segments" UBYTE B_TRUE 1 100 0.00 1.00000000000 BIT_MASK 0x1 FORMAT "%13.11" ECU_ADDRESS 0x500060A3 /end MEASUREMENT
/begin MEASUREMENT MisfDet_stSegTiAdpnSync "status of segment time adaptation synchronised" UBYTE B_TRUE 1 100 0.00 1.00000000000 BIT_MASK 0x1 FORMAT "%13.11" ECU_ADDRESS 0x500060A4 /end MEASUREMENT
/begin MEASUREMENT MisfDet_stSegTiAdpnTypeRdy "status of different learning strategies" UBYTE OneToOne 1 100 0.00 255.0 FORMAT "%5.1" ECU_ADDRESS 0x500060A5 /end MEASUREMENT
/begin MEASUREMENT MisfDet_stSegTiAdpnValMax "threshold for segment time correction factor is exceeded" UBYTE B_TRUE 1 100 0.00 1.00000000000 BIT_MASK 0x1 FORMAT "%13.11" ECU_ADDRESS 0x70000164 /end MEASUREMENT
/begin MEASUREMENT MisfDet_stSegTiAdpnValSampleDiagAltvPosn "Fault Status of Sample-plausibility check diagnosis for the alternative segment position" UBYTE B_TRUE 1 100 0.00 1.00000000000 BIT_MASK 0x1 FORMAT "%13.11" ECU_ADDRESS 0x60038EED /end MEASUREMENT
/begin MEASUREMENT MisfDet_stSegTiAdpnValSampleDiagStdPosn "Fault Status of Sample-plausibility check diagnosis for the standard segment position" UBYTE B_TRUE 1 100 0.00 1.00000000000 BIT_MASK 0x1 FORMAT "%13.11" ECU_ADDRESS 0x60038EEC /end MEASUREMENT
/begin MEASUREMENT MisfDet_stSegTiVld "condition segment time plausible" UBYTE B_TRUE 1 100 0.00 1.00000000000 BIT_MASK 0x1 FORMAT "%13.11" ECU_ADDRESS 0x500060A7 /end MEASUREMENT
/begin MEASUREMENT MisfDet_stSimrCdn "similar conditions encaountered for misfire faults" UBYTE B_TRUE 1 100 0.00 1.00000000000 BIT_MASK 0x1 FORMAT "%13.11" ECU_ADDRESS 0x500060A8 /end MEASUREMENT
/begin MEASUREMENT MisfDet_stStcCatIntlHealSimrCdn "status healing with similar conditions encountered" UBYTE B_TRUE 1 100 0.00 1.00000000000 BIT_MASK 0x1 FORMAT "%13.11" ECU_ADDRESS 0x500060A9 /end MEASUREMENT
/begin MEASUREMENT MisfDet_stStcCatRstCompl200ms "State reset of catalyst statistics completed (200ms)" UBYTE B_TRUE 1 100 0.00 1.00000000000 BIT_MASK 0x1 FORMAT "%13.11" ECU_ADDRESS 0x60010105 /end MEASUREMENT
/begin MEASUREMENT MisfDet_stStcCatStrt "Status first interval (200 CrS rev)" UBYTE B_TRUE 1 100 0.00 1.00000000000 BIT_MASK 0x1 FORMAT "%13.11" ECU_ADDRESS 0x500060AB /end MEASUREMENT
/begin MEASUREMENT MisfDet_stStcEmiDmgLstIntl "Exhaust damage during last interval" UBYTE B_TRUE 1 100 0.00 1.00000000000 BIT_MASK 0x1 FORMAT "%13.11" ECU_ADDRESS 0x60010104 /end MEASUREMENT
/begin MEASUREMENT MisfDet_stStcEmiFrzFrm "Status Freeze Frame reservation" UBYTE B_TRUE 1 100 0.00 1.00000000000 BIT_MASK 0x1 FORMAT "%13.11" ECU_ADDRESS 0x500060AC /end MEASUREMENT
/begin MEASUREMENT MisfDet_stStcEmiIntlHealSimrCdn "Status healing encountering similar conditions" UBYTE B_TRUE 1 100 0.00 1.00000000000 BIT_MASK 0x1 FORMAT "%13.11" ECU_ADDRESS 0x500060AD /end MEASUREMENT
/begin MEASUREMENT MisfDet_stStcEmiIntlHealSimrCdnStrt "Status healing first interval encountering similar conditions" UBYTE B_TRUE 1 100 0.00 1.00000000000 BIT_MASK 0x1 FORMAT "%13.11" ECU_ADDRESS 0x500060AE /end MEASUREMENT
/begin MEASUREMENT MisfDet_stStcEmiStrt "status first emission interval" UBYTE B_TRUE 1 100 0.00 1.00000000000 BIT_MASK 0x1 FORMAT "%13.11" ECU_ADDRESS 0x500060B1 /end MEASUREMENT
/begin MEASUREMENT MisfDet_stStcEmiStrtCatHeat "status cat heat t first emission interval" UBYTE B_TRUE 1 100 0.00 1.00000000000 BIT_MASK 0x1 FORMAT "%13.11" ECU_ADDRESS 0x500060B2 /end MEASUREMENT
/begin MEASUREMENT MisfDet_stStcEmiStrtSrv "Status first interval (independent from configuration)" UBYTE B_TRUE 1 100 0.00 1.00000000000 BIT_MASK 0x1 FORMAT "%13.11" ECU_ADDRESS 0x60010103 /end MEASUREMENT
/begin MEASUREMENT MisfDet_tiDebCatHealCritScav "Debounce counter to reset DFC_MDCatCrit" UWORD t_q0p1 1 100 0.00 6553.500 FORMAT "%8.3" ECU_ADDRESS 0x70003812 /end MEASUREMENT
/begin MEASUREMENT MisfDet_vWhl "Wheel speed for rough road detection" UWORD vfzg_uw_b90_m_DIV_s 1 100 0.00 90.27662 FORMAT "%8.5" ARRAY_SIZE 4 ECU_ADDRESS 0x50005782 /end MEASUREMENT
/begin MEASUREMENT MisfDet_vWhlCor "wheel speed corrected to reference point" UWORD vfzg_uw_b90_m_DIV_s 1 100 0.00 90.27662 FORMAT "%8.5" ARRAY_SIZE 4 ECU_ADDRESS 0x5000578A /end MEASUREMENT
/begin MEASUREMENT MisfDet_vWhlDe "Relative deviation of the wheel speed" SWORD r_prc_q0p003052_COMPU 1 100 -100.0000 99.9969 FORMAT "%8.4" ECU_ADDRESS 0x60007266 /end MEASUREMENT
/begin MEASUREMENT MisfDet_vWhlFild "Filtered wheel speed" UWORD vfzg_uw_b90_m_DIV_s 1 100 0.00 90.27662 FORMAT "%8.5" ARRAY_SIZE 4 ECU_ADDRESS 0x50005792 /end MEASUREMENT
/begin MEASUREMENT MisfDet_vWhlUsd "Wheel speeds used for rough road detection" UBYTE OneToOne 1 100 0.00 255.0 FORMAT "%5.1" ECU_ADDRESS 0x6000B718 /end MEASUREMENT
/begin MEASUREMENT MisfDet_vWhlVld "Gültige Radgeschwindigkeiten" UBYTE OneToOne 1 100 0.00 255.0 FORMAT "%5.1" ECU_ADDRESS 0x6000B717 /end MEASUREMENT
/begin MEASUREMENT MisfDet_yawRate "Yaw rate" FLOAT32_IEEE yaw_rate_real 1 100 -1.00000000E+037 1.00000000E+037 FORMAT "%13.3" ARRAY_SIZE 4 ECU_ADDRESS 0x50001B68 /end MEASUREMENT
/begin MEASUREMENT MisfDet_yawRateAvrg "Average yaw rate" FLOAT32_IEEE yaw_rate_real 1 100 -1.00000000E+037 1.00000000E+037 FORMAT "%13.3" ECU_ADDRESS 0x50001B78 /end MEASUREMENT
/begin MEASUREMENT MisfDet_yawRateDe "Relative deviation of yaw rates" UWORD r_prc_q0p003052_COMPU 1 100 0.00 199.9969 FORMAT "%8.4" ECU_ADDRESS 0x60007264 /end MEASUREMENT
/begin MEASUREMENT MoCADC_bChkActv "Bit info ADC check by Null Load Testimpuls is active" UBYTE B_TRUE 1 100 0.00 1.00000000000 BIT_MASK 0x8 FORMAT "%13.11" ECU_ADDRESS 0x60018CB3 /end MEASUREMENT
/begin MEASUREMENT MoCADC_bDef "Bit info ADC check detected an error" UBYTE B_TRUE 1 100 0.00 1.00000000000 BIT_MASK 0x80 FORMAT "%13.11" ECU_ADDRESS 0x60018CB3 /end MEASUREMENT
/begin MEASUREMENT MoCADC_bNTPActv "Null load test impulse check active in ADC monitoring" UBYTE B_TRUE 1 100 0.00 1.00000000000 BIT_MASK 0x1 FORMAT "%13.11" ECU_ADDRESS 0x60018CB3 /end MEASUREMENT
/begin MEASUREMENT MoCADC_bNTPErr "Bitinfo in MoCADC_st for irreversible error in ADC check by NuLL Load Testimpuls" UBYTE B_TRUE 1 100 0.00 1.00000000000 BIT_MASK 0x40 FORMAT "%13.11" ECU_ADDRESS 0x60018CB3 /end MEASUREMENT
/begin MEASUREMENT MoCADC_bNTPRel "Null load test impulse was released" UBYTE B_TRUE 1 100 0.00 1.00000000000 BIT_MASK 0x2 FORMAT "%13.11" ECU_ADDRESS 0x60018CB3 /end MEASUREMENT
/begin MEASUREMENT MoCADC_bTstErr "Bitinfo in MoCADC_st for testvoltage out of permissible range" UBYTE B_TRUE 1 100 0.00 1.00000000000 BIT_MASK 0x4 FORMAT "%13.11" ECU_ADDRESS 0x60018CB3 /end MEASUREMENT
/begin MEASUREMENT MoCADC_ctDebNTP "Error counter for verifying of Null-load-Test-pulse" UBYTE OneToOne 1 100 0.00 255.0 FORMAT "%5.1" ECU_ADDRESS 0x60018CB5 /end MEASUREMENT
/begin MEASUREMENT MoCADC_ctDebNTPCpl "Double storage for error counter for testing with null load test pulse procedure" UBYTE OneToOne 1 100 0.00 255.0 FORMAT "%5.1" ECU_ADDRESS 0x600185E2 /end MEASUREMENT
/begin MEASUREMENT MoCADC_ctDebTst "Error counter for testing the test voltage" UBYTE OneToOne 1 100 0.00 255.0 FORMAT "%5.1" ECU_ADDRESS 0x60018CB4 /end MEASUREMENT
/begin MEASUREMENT MoCADC_ctDebTstCpl "Double storage for error counter for testing with test voltage" UBYTE OneToOne 1 100 0.00 255.0 FORMAT "%5.1" ECU_ADDRESS 0x600185E1 /end MEASUREMENT
/begin MEASUREMENT MoCADC_ctTstNTP "counter of testflag in diagnosis for ADC - Null Load TestPulse check" UBYTE OneToOne 1 100 0.00 255.0 FORMAT "%5.1" ECU_ADDRESS 0x600185E0 /end MEASUREMENT
/begin MEASUREMENT MoCADC_ctTstTst "counter of testflag in diagnosis for ADC - testvoltage check" UBYTE OneToOne 1 100 0.00 255.0 FORMAT "%5.1" ECU_ADDRESS 0x600185DF /end MEASUREMENT
/begin MEASUREMENT MoCADC_flgClrNTP "Flag bit to indicate request to clear fault memory" UBYTE B_TRUE 1 100 0.00 1.00000000000 BIT_MASK 0x1 FORMAT "%13.11" ECU_ADDRESS 0x7000015C /end MEASUREMENT
/begin MEASUREMENT MoCADC_flgClrTst "Flag bit to indicate request to clear fault memory" UBYTE B_TRUE 1 100 0.00 1.00000000000 BIT_MASK 0x1 FORMAT "%13.11" ECU_ADDRESS 0x7000015B /end MEASUREMENT
/begin MEASUREMENT MoCADC_flgNTPTest "Indicates that the NTP test on APP2 is executed atleast once" UBYTE OneToOne 1 100 0.00 255.0 FORMAT "%5.1" ECU_ADDRESS 0x600185DE /end MEASUREMENT
/begin MEASUREMENT MoCADC_st "Status Info of ADC monitoring" UBYTE dez 1 100 0.00 255.0 FORMAT "%5.1" ECU_ADDRESS 0x60018CB3 /end MEASUREMENT
/begin MEASUREMENT MoCADC_stCpl "Double storage of status Info of ADC monitoring" UBYTE dez 1 100 0.00 255.0 FORMAT "%5.1" ECU_ADDRESS 0x600185DD /end MEASUREMENT
/begin MEASUREMENT MoCADC_stMsg "Status info from ADC Monitoring, message forLevel1" UBYTE dez 1 100 0.00 255.0 FORMAT "%5.1" ECU_ADDRESS 0x600008A7 /end MEASUREMENT
/begin MEASUREMENT MoCADC_uNTP_mp "Voltage at ADC for acceleration pedal signal 2" UWORD spg_q0p00977 1 100 0.00 639.9902 FORMAT "%8.4" ECU_ADDRESS 0x70009C78 /end MEASUREMENT
/begin MEASUREMENT MoCADC_uTst_mp "Voltage at ADC test voltage input" SWORD spg_q4p88_mV 1 100 -160000.0 159995.1 FORMAT "%8.1" ECU_ADDRESS 0x70009C76 /end MEASUREMENT
/begin MEASUREMENT MoCCom_bPFCNew "condition new question received for program flow check" UBYTE B_TRUE 1 100 0.00 1.00000000000 BIT_MASK 0x2 FORMAT "%13.11" ECU_ADDRESS 0x60017FC0 /end MEASUREMENT
/begin MEASUREMENT MoCCom_bSwShrNew "new question received for software sharing module" UBYTE B_TRUE 1 100 0.00 1.00000000000 BIT_MASK 0x10 FORMAT "%13.11" ECU_ADDRESS 0x60017FC0 /end MEASUREMENT
/begin MEASUREMENT MoCCom_cntrInCorrRespTime "Incorrect response time counter" UBYTE OneToOne 1 100 0.00 255.0 FORMAT "%5.1" ECU_ADDRESS 0x600185DC /end MEASUREMENT
/begin MEASUREMENT MoCCom_cntrSyncMonModl "Counter to increment when incomplete response is received" UBYTE OneToOne 1 100 0.00 255.0 FORMAT "%5.1" ECU_ADDRESS 0x600185DB /end MEASUREMENT
/begin MEASUREMENT MoCCom_cntrWDAErrThd "Error counter threshold of the external monitoring module" UBYTE OneToOne 1 100 3.000 4.000 FORMAT "%5.3" ECU_ADDRESS 0x600185CA /end MEASUREMENT
/begin MEASUREMENT MoCCom_cntrWDAErrThdCpl "Complement of Error counter threshold of the external monitoring module" UBYTE OneToOne 1 100 0.00 255.0 FORMAT "%5.1" ECU_ADDRESS 0x600185DA /end MEASUREMENT
/begin MEASUREMENT MoCCom_cntrWDAErrThdMsg "Error counter threshold of the external monitoring module (a message for Level 1)" UBYTE dez 1 100 3.000 4.000 FORMAT "%5.3" ECU_ADDRESS 0x60000985 /end MEASUREMENT
/begin MEASUREMENT MoCCom_ctBusErr "error counter for communication bus error between FC and other ASICS like power stage ASIC, Monitoring module etc" UBYTE OneToOne 1 100 0.00 255.0 FORMAT "%5.1" ECU_ADDRESS 0x600185D9 /end MEASUREMENT
/begin MEASUREMENT MoCCom_ctBusErrCpl "Complement variable for bus errors" UBYTE OneToOne 1 100 0.00 255.0 FORMAT "%5.1" ECU_ADDRESS 0x600185D8 /end MEASUREMENT
/begin MEASUREMENT MoCCom_ctErrFC "error counter for failure in function controller" UBYTE OneToOne 1 100 0.00 255.0 FORMAT "%5.1" ECU_ADDRESS 0x600185C9 /end MEASUREMENT
/begin MEASUREMENT MoCCom_ctErrFCCpl "RAM data redundancy for MoCCom_ctErrFC" UBYTE OneToOne 1 100 0.00 255.0 FORMAT "%5.1" ECU_ADDRESS 0x600185D7 /end MEASUREMENT
/begin MEASUREMENT MoCCom_ctErrMM "error counter of monitoring module" UBYTE OneToOne 1 100 0.00 255.0 FORMAT "%5.1" ECU_ADDRESS 0x600185C8 /end MEASUREMENT
/begin MEASUREMENT MoCCom_ctErrMMMsg "info for level 1: error counter of monitoring module" UBYTE dez 1 100 0.00 255.0 FORMAT "%5.1" ECU_ADDRESS 0x60000986 /end MEASUREMENT
/begin MEASUREMENT MoCCom_ctErrMMOld "old value of the error count got from the monitoring module" UBYTE OneToOne 1 100 0.00 255.0 FORMAT "%5.1" ECU_ADDRESS 0x600185D6 /end MEASUREMENT
/begin MEASUREMENT MoCCom_ctErrOSTimeout "error counter for timeout of operating system" UBYTE OneToOne 1 100 0.00 255.0 FORMAT "%5.1" ECU_ADDRESS 0x600185D5 /end MEASUREMENT
/begin MEASUREMENT MoCCom_Query "Enlarged query from monitoring module" ULONG dez 1 100 0.00 4294967295.00 FORMAT "%13.2" ECU_ADDRESS 0x600185C0 /end MEASUREMENT
/begin MEASUREMENT MoCCom_Response "Response to the query from monitoring module" ULONG dez 1 100 0.00 4294967295.00 FORMAT "%13.2" ECU_ADDRESS 0x600185C4 /end MEASUREMENT
/begin MEASUREMENT MoCCom_Response_mp "copy of the response to the monitoring module" ULONG dez 1 100 0.00 4294967295.00 FORMAT "%13.2" ECU_ADDRESS 0x70009A38 /end MEASUREMENT
/begin MEASUREMENT MoCCom_stBusErr "Status variable for bus error" UBYTE OneToOne 1 100 0.00 255.0 FORMAT "%5.1" ECU_ADDRESS 0x600185D4 /end MEASUREMENT
/begin MEASUREMENT MoCCom_stCheckState "Actual step of MoCCOM inner state machine" UBYTE MoCCom_stCheckState_Compu 1 100 0.00 7.00000000000 FORMAT "%13.11" ECU_ADDRESS 0x600185D3 /end MEASUREMENT
/begin MEASUREMENT MoCCom_stCheckStateCpl "complement variable for actual step of moccom inner state machine" UBYTE OneToOne 1 100 0.00 255.0 FORMAT "%5.1" ECU_ADDRESS 0x600185D2 /end MEASUREMENT
/begin MEASUREMENT MoCCom_stComActvOld "Variable to update the SOP test active status" UBYTE OneToOne 1 100 0.00 255.0 FORMAT "%5.1" ECU_ADDRESS 0x600185D1 /end MEASUREMENT
/begin MEASUREMENT MoCCom_stComActvOldCpl "Complement of MoCCom_stComActvOld" UBYTE OneToOne 1 100 0.00 255.0 FORMAT "%5.1" ECU_ADDRESS 0x600185D0 /end MEASUREMENT
/begin MEASUREMENT MoCCom_stComState "Actual step of MoCCOM WD communication state machine" UBYTE MoCCom_stComState_Compu 1 100 0.00 2.00000000000 FORMAT "%13.11" ECU_ADDRESS 0x600185CF /end MEASUREMENT
/begin MEASUREMENT MoCCom_stErrEna "status variable, if reinitialisation of power stages CJ945 and CY372 is necessary" UBYTE OneToOne 1 100 0.00 255.0 FORMAT "%5.1" ECU_ADDRESS 0x600185CE /end MEASUREMENT
/begin MEASUREMENT MoCCom_stErrEnaCpl "double storaged status variable, if reinitialisation of power stages CJ945 and CY372 is necessary" UBYTE OneToOne 1 100 0.00 255.0 FORMAT "%5.1" ECU_ADDRESS 0x600185CD /end MEASUREMENT
/begin MEASUREMENT MoCCom_stQueryNew "Bitbase for info 'new query from monitoring module'" UBYTE OneToOne 1 100 0.00 255.0 FORMAT "%5.1" ECU_ADDRESS 0x60017FC0 /end MEASUREMENT
/begin MEASUREMENT MoCCom_stWdgThdErr "Status variable for watchdog threshold error" UBYTE OneToOne 1 100 0.00 255.0 FORMAT "%5.1" ECU_ADDRESS 0x600185CC /end MEASUREMENT
/begin MEASUREMENT MoCCom_stWdgTiWinErr "Status variable for watchdog time window error" UBYTE OneToOne 1 100 0.00 255.0 FORMAT "%5.1" ECU_ADDRESS 0x600185CB /end MEASUREMENT
/begin MEASUREMENT MoCCom_SwShrPtlResp "Partial response contribution from software sharing modules" ULONG OneToOne 1 100 0.00 4294967295.00 FORMAT "%13.2" ECU_ADDRESS 0x600185BC /end MEASUREMENT
/begin MEASUREMENT MoCCPU_PartResp "Partial response from instruction test to monitoring module" ULONG OneToOne 1 100 0.00 4294967295.00 FORMAT "%13.2" ECU_ADDRESS 0x600185B8 /end MEASUREMENT
/begin MEASUREMENT MoCEMM_idxNumCurrErr "Variable to store the number of current error requests" UWORD OneToOne 1 100 0.00 65535.00 FORMAT "%8.2" ECU_ADDRESS 0x60017FBE /end MEASUREMENT
/begin MEASUREMENT MoCEMM_stEmmAlrms "State of EMM alarm groups" ULONG dez 1 100 0.00 4294967295.00 FORMAT "%13.2" ARRAY_SIZE 22 ECU_ADDRESS 0x60018C58 /end MEASUREMENT
/begin MEASUREMENT MoCEMM_stEmmAlrmsCpl "Complement of MoCEMM_stEmmAlrms" ULONG dez 1 100 0.00 4294967295.00 FORMAT "%13.2" ARRAY_SIZE 22 ECU_ADDRESS 0x6001855C /end MEASUREMENT
/begin MEASUREMENT MoCEMM_stEmmAlrmsMsg "State of EMM alarm groups" ULONG dez 1 100 0.00 4294967295.00 FORMAT "%13.2" ARRAY_SIZE 22 ECU_ADDRESS 0x60000508 /end MEASUREMENT
/begin MEASUREMENT MoCEMM_stEmmAlrmsNv "State of EMM alarm groups in NV-Ram" ULONG dez 1 100 0.00 4294967295.00 FORMAT "%13.2" ARRAY_SIZE 22 ECU_ADDRESS 0x60038E38 /end MEASUREMENT
/begin MEASUREMENT MoCEMM_stEmmErrorPin "Physical state of error pin" UBYTE dez 1 100 0.00 255.0 FORMAT "%5.1" ECU_ADDRESS 0x60018CB0 /end MEASUREMENT
/begin MEASUREMENT MoCEMM_stEmmErrorPinCpl "Complement of physical state of error pin" UBYTE dez 1 100 0.00 255.0 FORMAT "%5.1" ECU_ADDRESS 0x600185B7 /end MEASUREMENT
/begin MEASUREMENT MoCEMM_stEmmGPIO "State of Master controllers output GPIO line" UBYTE dez 1 100 0.00 255.0 FORMAT "%5.1" ECU_ADDRESS 0x600185B6 /end MEASUREMENT
/begin MEASUREMENT MoCEMM_stPwrOnRstHdl "Variable to store the status of execution of power-on reset handler" UBYTE OneToOne 1 100 0.00 255.0 FORMAT "%5.1" ECU_ADDRESS 0x60018CB2 /end MEASUREMENT
/begin MEASUREMENT MoCEMM_stPwrOnRstHdlCpl "Complement variable to store the status of execution of power-on reset handler" UBYTE OneToOne 1 100 0.00 255.0 FORMAT "%5.1" ECU_ADDRESS 0x600185B5 /end MEASUREMENT
/begin MEASUREMENT MoCEMM_stPwrOnRstReq "Variable to store the status of power-on reset request" UBYTE OneToOne 1 100 0.00 255.0 FORMAT "%5.1" ECU_ADDRESS 0x60018CB1 /end MEASUREMENT
/begin MEASUREMENT MoCEMM_stPwrOnRstReqCpl "Complement variable to store the status of power-on reset request" UBYTE OneToOne 1 100 0.00 255.0 FORMAT "%5.1" ECU_ADDRESS 0x600185B4 /end MEASUREMENT
/begin MEASUREMENT MoCEMM_structCurrReq.MoCEMM_cntrInfo "Structure to store the current PORST request / Structure member to store number of power on resets" ULONG OneToOne 1 100 0.00 4294967295.00 FORMAT "%13.2" ECU_ADDRESS 0x700042E8 /end MEASUREMENT
/begin MEASUREMENT MoCEMM_structCurrReq.MoCEMM_blkInfo "Structure to store the current PORST request / Structure member to store error ID, error statues and Diagnosis data" ULONG OneToOne 1 100 0.00 4294967295.00 FORMAT "%13.2" ARRAY_SIZE 17 ECU_ADDRESS 0x700042EC /end MEASUREMENT
/begin MEASUREMENT MoCEMM_structCurrReq.MoCEMM_cntrInfoCpl "Structure to store the current PORST request / Complement of MoCEMM_cntrInfo" ULONG OneToOne 1 100 0.00 4294967295.00 FORMAT "%13.2" ECU_ADDRESS 0x70004390 /end MEASUREMENT
/begin MEASUREMENT MoCEMM_structFlash.MoCEMM_cntrInfo "Structure to store the error information from NvM memory. / Structure member to store number of power on resets" ULONG OneToOne 1 100 0.00 4294967295.00 FORMAT "%13.2" ECU_ADDRESS 0x7000423C /end MEASUREMENT
/begin MEASUREMENT MoCEMM_structFlash.MoCEMM_blkInfo "Structure to store the error information from NvM memory. / Structure member to store error ID, error statues and Diagnosis data" ULONG OneToOne 1 100 0.00 4294967295.00 FORMAT "%13.2" ARRAY_SIZE 41 ECU_ADDRESS 0x70004240 /end MEASUREMENT
/begin MEASUREMENT MoCEMM_structFlash.MoCEMM_cntrInfoCpl "Structure to store the error information from NvM memory. / Complement of MoCEMM_cntrInfo" ULONG OneToOne 1 100 0.00 4294967295.00 FORMAT "%13.2" ECU_ADDRESS 0x700042E4 /end MEASUREMENT
/begin MEASUREMENT MoCEMM_stSWErrorPinReqAry "Status array for errorpin handler which software modules are in fault state" ULONG MoExe_Co_PFC_ID_Compu 1 100 0.00 16777471.0000 FORMAT "%13.4" ARRAY_SIZE 10 ECU_ADDRESS 0x70039BCC /end MEASUREMENT
/begin MEASUREMENT MoCEMM_stSWErrorPinReqAryCpl "Complement of MoCEMM_stSWErrorPinReqAry" ULONG OneToOne 1 100 0.00 4294967295.00 FORMAT "%13.2" ARRAY_SIZE 10 ECU_ADDRESS 0x70039BA4 /end MEASUREMENT
/begin MEASUREMENT MoCEMM_wdgTout "Variable to store timeout of internal watchdog" ULONG OneToOne 1 100 0.00 4294967295.00 FORMAT "%13.2" ECU_ADDRESS 0x70039BA0 /end MEASUREMENT
/begin MEASUREMENT MoCGTM_aryCMPErrBit "Output array obtained from CMP_IRQ_NOTIFY" UBYTE OneToOne 1 100 0.00 255.0 FORMAT "%5.1" ARRAY_SIZE 4 ECU_ADDRESS 0x60018C51 /end MEASUREMENT
/begin MEASUREMENT MoCGTM_aryCMPErrBitCpl "Complement variable for Output array obtained from CMP_IRQ_NOTIFY" UBYTE OneToOne 1 100 0.00 255.0 FORMAT "%5.1" ARRAY_SIZE 4 ECU_ADDRESS 0x60018557 /end MEASUREMENT
/begin MEASUREMENT MoCGTM_bbOut1 "Bit bases for storing status of compare bit" UBYTE OneToOne 1 100 0.00 255.0 FORMAT "%5.1" ECU_ADDRESS 0x60018C44 /end MEASUREMENT
/begin MEASUREMENT MoCGTM_bbOut1Cpl "complement variable for MoCGTMCo_bbOut1" UBYTE OneToOne 1 100 0.00 255.0 FORMAT "%5.1" ECU_ADDRESS 0x60018556 /end MEASUREMENT
/begin MEASUREMENT MoCGTM_cmpErrAryIdx "Array index for CMP unit check" UBYTE OneToOne 1 100 0.00 255.0 FORMAT "%5.1" ECU_ADDRESS 0x60018C50 /end MEASUREMENT
/begin MEASUREMENT MoCGTM_cmpErrAryIdxCpl "Complement variable for MoCGTM_cmpErrAryIdx" UBYTE OneToOne 1 100 0.00 255.0 FORMAT "%5.1" ECU_ADDRESS 0x60018555 /end MEASUREMENT
/begin MEASUREMENT MoCGTM_cntrBadcase "Number of bad cases triggered by MCS" ULONG OneToOne 1 100 0.00 4294967295.00 FORMAT "%13.2" ECU_ADDRESS 0x60018C40 /end MEASUREMENT
/begin MEASUREMENT MoCGTM_cntrCMPErrbit "Number of times badcase detected by CMP unit" ULONG OneToOne 1 100 0.00 4294967295.00 FORMAT "%13.2" ECU_ADDRESS 0x60018C3C /end MEASUREMENT
/begin MEASUREMENT MoCGTM_cntrCMPErrbitCpl "Complement variable for MoCGTM_CMPErrbitCnt" ULONG OneToOne 1 100 0.00 4294967295.00 FORMAT "%13.2" ECU_ADDRESS 0x6001854C /end MEASUREMENT
/begin MEASUREMENT MoCGTM_cntrCMPErrbitHeal "Healing counter for MoCGTM_cntrCMPErrbit" UBYTE OneToOne 1 100 0.00 255.0 FORMAT "%5.1" ECU_ADDRESS 0x60018C4F /end MEASUREMENT
/begin MEASUREMENT MoCGTM_cntrCMPErrbitHealCpl "Complement variable for MoCGTM_cntrCMPErrbitHeal" UBYTE OneToOne 1 100 0.00 255.0 FORMAT "%5.1" ECU_ADDRESS 0x60018554 /end MEASUREMENT
/begin MEASUREMENT MoCGTM_cntrDebErr "Error Debounce Counter for Pattern Mismatch error" UBYTE OneToOne 1 100 0.00 255.0 FORMAT "%5.1" ECU_ADDRESS 0x60018C4E /end MEASUREMENT
/begin MEASUREMENT MoCGTM_cntrDebErrCpl "Complement of the Error Debounce Counter for Pattern Mismatch error" UBYTE OneToOne 1 100 0.00 255.0 FORMAT "%5.1" ECU_ADDRESS 0x60018553 /end MEASUREMENT
/begin MEASUREMENT MoCGTM_cntrDebErrMax "Max. deviation between badcase created and detected occurred" UBYTE OneToOne 1 100 0.00 255.0 FORMAT "%5.1" ECU_ADDRESS 0x60018552 /end MEASUREMENT
/begin MEASUREMENT MoCGTM_cntrMCS1 "Number of times MCS1 triggered from core" ULONG OneToOne 1 100 0.00 4294967295.00 FORMAT "%13.2" ECU_ADDRESS 0x60018C38 /end MEASUREMENT
/begin MEASUREMENT MoCGTM_cntrMCS1Old "previous raster value of Number of times MCS1 triggered from core" ULONG OneToOne 1 100 0.00 4294967295.00 FORMAT "%13.2" ECU_ADDRESS 0x60018C34 /end MEASUREMENT
/begin MEASUREMENT MoCGTM_cntrMCS1OldCpl "complement variable for MoCGTM_cntrMCS1Old" ULONG OneToOne 1 100 0.00 4294967295.00 FORMAT "%13.2" ECU_ADDRESS 0x60018548 /end MEASUREMENT
/begin MEASUREMENT MoCGTM_cntrMCS2 "Number of times MCS2 triggered from core" ULONG OneToOne 1 100 0.00 4294967295.00 FORMAT "%13.2" ECU_ADDRESS 0x60018C30 /end MEASUREMENT
/begin MEASUREMENT MoCGTM_cntrMCS2Old "previous raster value of Number of times MCS2 triggered from core" ULONG OneToOne 1 100 0.00 4294967295.00 FORMAT "%13.2" ECU_ADDRESS 0x60018C2C /end MEASUREMENT
/begin MEASUREMENT MoCGTM_cntrMCS2OldCpl "complement variable for MoCGTM_cntrMCS2Old" ULONG OneToOne 1 100 0.00 4294967295.00 FORMAT "%13.2" ECU_ADDRESS 0x60018544 /end MEASUREMENT
/begin MEASUREMENT MoCGTM_cntrMsmCMPErrBit "Number of mismatch between MoCGTM_aryCMPErrBit and MoCGTM_exptCMPErrBit_CA" UBYTE OneToOne 1 100 0.00 255.0 FORMAT "%5.1" ECU_ADDRESS 0x60018C4D /end MEASUREMENT
/begin MEASUREMENT MoCGTM_cntrRouteSigErr "Number of time signal routing error occured in GTM" UBYTE OneToOne 1 100 0.00 255.0 FORMAT "%5.1" ECU_ADDRESS 0x60018C4C /end MEASUREMENT
/begin MEASUREMENT MoCGTM_cntrRouteSigErrCpl "Complement variable for MoCGTM_cntrRouteSigErr" UBYTE OneToOne 1 100 0.00 255.0 FORMAT "%5.1" ECU_ADDRESS 0x60018551 /end MEASUREMENT
/begin MEASUREMENT MoCGTM_currChksVal "Value of calculated checksum of current MCS module" ULONG OneToOne 1 100 0.00 4294967295.00 FORMAT "%13.2" ECU_ADDRESS 0x60018C28 /end MEASUREMENT
/begin MEASUREMENT MoCGTM_currChksValCpl "Complement of value of calculated checksum of current MCS module" ULONG OneToOne 1 100 0.00 4294967295.00 FORMAT "%13.2" ECU_ADDRESS 0x60018540 /end MEASUREMENT
/begin MEASUREMENT MoCGTM_currMCSModlAryIdx "Array index for MCS modules used during MCS ROM memory check" UBYTE OneToOne 1 100 0.00 255.0 FORMAT "%5.1" ECU_ADDRESS 0x60018C4B /end MEASUREMENT
/begin MEASUREMENT MoCGTM_flgCmpErr "compare error bit status" UBYTE B_TRUE 1 100 0.00 1.00000000000 BIT_MASK 0x1 FORMAT "%13.11" ECU_ADDRESS 0x60018C44 /end MEASUREMENT
/begin MEASUREMENT MoCGTM_McsData_ptr1Cpl "Complement for MCS data pointer1" ULONG OneToOne 1 100 0.00 4294967295.00 FORMAT "%13.2" ECU_ADDRESS 0x6001853C /end MEASUREMENT
/begin MEASUREMENT MoCGTM_McsData_ptr2Cpl "Complement for MCS data pointer2" ULONG OneToOne 1 100 0.00 4294967295.00 FORMAT "%13.2" ECU_ADDRESS 0x60018538 /end MEASUREMENT
/begin MEASUREMENT MoCGTM_numMCS1Ch "MCS channel number selected for MCS1" UBYTE OneToOne 1 100 0.00 255.0 FORMAT "%5.1" ECU_ADDRESS 0x60018C4A /end MEASUREMENT
/begin MEASUREMENT MoCGTM_numMCS1Modl "MCS module number selected for MCS1" UBYTE OneToOne 1 100 0.00 255.0 FORMAT "%5.1" ECU_ADDRESS 0x60018C49 /end MEASUREMENT
/begin MEASUREMENT MoCGTM_numMCS2Ch "MCS channel number selected for MCS2" UBYTE OneToOne 1 100 0.00 255.0 FORMAT "%5.1" ECU_ADDRESS 0x60018C48 /end MEASUREMENT
/begin MEASUREMENT MoCGTM_numMCS2Modl "MCS module number selected for MCS2" UBYTE OneToOne 1 100 0.00 255.0 FORMAT "%5.1" ECU_ADDRESS 0x60018C47 /end MEASUREMENT
/begin MEASUREMENT MoCGTM_PtlResp "Partial respose of MoCGTM_Co" ULONG OneToOne 1 100 0.00 4294967295.00 FORMAT "%13.2" ECU_ADDRESS 0x60018528 /end MEASUREMENT
/begin MEASUREMENT MoCGTM_PtlRespCpl "Complement variable for MoCGTM_PtlResp" ULONG OneToOne 1 100 0.00 4294967295.00 FORMAT "%13.2" ECU_ADDRESS 0x60018534 /end MEASUREMENT
/begin MEASUREMENT MoCGTM_stBadcaseTrig "Indicates creation of badcase in MCS2" ULONG OneToOne 1 100 0.00 4294967295.00 FORMAT "%13.2" ECU_ADDRESS 0x60018C24 /end MEASUREMENT
/begin MEASUREMENT MoCGTM_stErr "Indicates failure in BSW function call" UBYTE OneToOne 1 100 0.00 255.0 FORMAT "%5.1" ECU_ADDRESS 0x60018C46 /end MEASUREMENT
/begin MEASUREMENT MoCGTM_stErrChks "Status of checksum error in MCS ROM check" UBYTE OneToOne 1 100 0.00 255.0 FORMAT "%5.1" ECU_ADDRESS 0x60018C45 /end MEASUREMENT
/begin MEASUREMENT MoCGTM_stErrCpl "Complement variable for MoCGTM_stErr" UBYTE OneToOne 1 100 0.00 255.0 FORMAT "%5.1" ECU_ADDRESS 0x60018550 /end MEASUREMENT
/begin MEASUREMENT MoCGTM_tiCurrMCSVal "Timestamp at which TIM read to be performed after MCS trigger from safety core" ULONG OneToOne 1 100 0.00 4294967295.00 FORMAT "%13.2" ECU_ADDRESS 0x60018C20 /end MEASUREMENT
/begin MEASUREMENT MoCGTM_tiCurrTskcall "Time stamp current task call" ULONG OneToOne 1 100 0.00 4294967295.00 FORMAT "%13.2" ECU_ADDRESS 0x60018530 /end MEASUREMENT
/begin MEASUREMENT MoCGTM_tiExeMCS1_MP "Measurement of time taken for complete execution of MCS1 in ticks" ULONG RBPtCel_ti_0p4_1 1 100 0.00 1717986918.00 FORMAT "%13.2" ECU_ADDRESS 0x70009A34 /end MEASUREMENT
/begin MEASUREMENT MoCGTM_tiExeMCS2_MP "Measurement of time taken for complete execution of MCS2 in ticks" ULONG RBPtCel_ti_0p4_1 1 100 0.00 1717986918.00 FORMAT "%13.2" ECU_ADDRESS 0x70009A30 /end MEASUREMENT
/begin MEASUREMENT MoCGTM_tiFallEdgeBadcase_MP "Measurement point for Falling edge time stamp in MCS2 during badcase" ULONG OneToOne 1 100 0.00 4294967295.00 FORMAT "%13.2" ECU_ADDRESS 0x70009A2C /end MEASUREMENT
/begin MEASUREMENT MoCGTM_tiFallEdgeMCS1_MP "Measurement point for Falling edge time stamp in MCS1" ULONG OneToOne 1 100 0.00 4294967295.00 FORMAT "%13.2" ECU_ADDRESS 0x70009A28 /end MEASUREMENT
/begin MEASUREMENT MoCGTM_tiFallEdgeMCS2_MP "Measurement point for Falling edge time stamp in MCS2" ULONG OneToOne 1 100 0.00 4294967295.00 FORMAT "%13.2" ECU_ADDRESS 0x70009A24 /end MEASUREMENT
/begin MEASUREMENT MoCGTM_tiMCSTIMRead "Current rising edge time stamp received from TIM before the control trigger from safety core is passed" ULONG OneToOne 1 100 0.00 4294967295.00 FORMAT "%13.2" ECU_ADDRESS 0x60018C1C /end MEASUREMENT
/begin MEASUREMENT MoCGTM_tiPrevMCS1Trig_MP "Measurement point for Timestamp of previous trigger for MCS1 execution from safety core" ULONG OneToOne 1 100 0.00 4294967295.00 FORMAT "%13.2" ECU_ADDRESS 0x70009A20 /end MEASUREMENT
/begin MEASUREMENT MoCGTM_tiPrevMCS2Trig_MP "Measurement point for Timestamp of previous trigger for MCS2 execution from safety core" ULONG OneToOne 1 100 0.00 4294967295.00 FORMAT "%13.2" ECU_ADDRESS 0x70009A1C /end MEASUREMENT
/begin MEASUREMENT MoCGTM_tiPrevTskcall "Time stamp previous task call" ULONG OneToOne 1 100 0.00 4294967295.00 FORMAT "%13.2" ECU_ADDRESS 0x6001852C /end MEASUREMENT
/begin MEASUREMENT MoCGTM_tiRisngEdgeMCS1_MP "Measurement point for Rising edge time stamp in MCS1" ULONG OneToOne 1 100 0.00 4294967295.00 FORMAT "%13.2" ECU_ADDRESS 0x70009A18 /end MEASUREMENT
/begin MEASUREMENT MoCGTM_tiRisngEdgeMCS2_MP "Measurement point for Rising edge time stamp in MCS2" ULONG OneToOne 1 100 0.00 4294967295.00 FORMAT "%13.2" ECU_ADDRESS 0x70009A14 /end MEASUREMENT
/begin MEASUREMENT MoCGTM_tiTskCalldst_MP "Measurepoint time between two task calls" ULONG OneToOne 1 100 0.00 4294967295.00 FORMAT "%13.2" ECU_ADDRESS 0x70009A10 /end MEASUREMENT
/begin MEASUREMENT MoCHwLogicTest_flgAlvTestChk "Standby SMU alivetest check error" UBYTE B_TRUE 1 100 0.00 1.00000000000 BIT_MASK 0x8 FORMAT "%13.11" ECU_ADDRESS 0x60017FBC /end MEASUREMENT
/begin MEASUREMENT MoCHwLogicTest_flgFwChk "Firmware check error" UBYTE B_TRUE 1 100 0.00 1.00000000000 BIT_MASK 0x1 FORMAT "%13.11" ECU_ADDRESS 0x60017FBC /end MEASUREMENT
/begin MEASUREMENT MoCHwLogicTest_flgMONBISTChk "MONBIST error" UBYTE B_TRUE 1 100 0.00 1.00000000000 BIT_MASK 0x2 FORMAT "%13.11" ECU_ADDRESS 0x60017FBC /end MEASUREMENT
/begin MEASUREMENT MoCHwLogicTest_flgSFFDChk "Safety flip-flop test error" UBYTE B_TRUE 1 100 0.00 1.00000000000 BIT_MASK 0x4 FORMAT "%13.11" ECU_ADDRESS 0x60017FBC /end MEASUREMENT
/begin MEASUREMENT MoCHwLogicTest_flgTempChk "Temperature latent fault check error" UBYTE B_TRUE 1 100 0.00 1.00000000000 BIT_MASK 0x10 FORMAT "%13.11" ECU_ADDRESS 0x60017FBC /end MEASUREMENT
/begin MEASUREMENT MoCHwLogicTest_flgUCBErrChk "Safety critical register evaluation check error" UBYTE B_TRUE 1 100 0.00 1.00000000000 BIT_MASK 0x20 FORMAT "%13.11" ECU_ADDRESS 0x60017FBC /end MEASUREMENT
/begin MEASUREMENT MoCHwLogicTest_PtlResp "Partial response from HW Logic Test module" ULONG OneToOne 1 100 0.00 4294967295.00 FORMAT "%13.2" ECU_ADDRESS 0x60017FB8 /end MEASUREMENT
/begin MEASUREMENT MoCHwLogicTest_stErr "Status word to report hardware logic test error" UBYTE OneToOne 1 100 0.00 255.0 FORMAT "%5.1" ECU_ADDRESS 0x60017FBC /end MEASUREMENT
/begin MEASUREMENT MoCIWDH_bbLoc1 "Bit bases for storing status of concatenated value read from ring buffer" UBYTE OneToOne 1 100 0.00 255.0 FORMAT "%5.1" ECU_ADDRESS 0x60018C1A /end MEASUREMENT
/begin MEASUREMENT MoCIWDH_bbLoc1Cpl "complement variable for MoCIWDH_bbLoc1" UBYTE OneToOne 1 100 0.00 255.0 FORMAT "%5.1" ECU_ADDRESS 0x60018524 /end MEASUREMENT
/begin MEASUREMENT MoCIWDH_cntChksAry "Array to hold the Number of entries made into each ring buffer by each task-core combination" UBYTE OneToOne 1 100 0.00 255.0 FORMAT "%5.1" ARRAY_SIZE 1 ECU_ADDRESS 0x60018C19 /end MEASUREMENT
/begin MEASUREMENT MoCIWDH_cntrRollgAry "Array to hold the internal watchdog handler rolling counter value" ULONG OneToOne 1 100 0.00 4294967295.00 FORMAT "%13.2" ARRAY_SIZE 1 ECU_ADDRESS 0x60018C14 /end MEASUREMENT
/begin MEASUREMENT MoCIWDH_cntrRollgAryCpl "Double storage for Array to hold the internal watchdog handler rolling counter value" ULONG OneToOne 1 100 0.00 4294967295.00 FORMAT "%13.2" ARRAY_SIZE 1 ECU_ADDRESS 0x60018520 /end MEASUREMENT
/begin MEASUREMENT MoCIWDH_flgConcatValErr "status of concatenated value read from ring buffer" UBYTE B_TRUE 1 100 0.00 1.00000000000 BIT_MASK 0x1 FORMAT "%13.11" ECU_ADDRESS 0x60018C1A /end MEASUREMENT
/begin MEASUREMENT MoCIWDH_numChksAry "Extracted checksum from the concatenated value read from each task-core combination ring buffer" ULONG OneToOne 1 100 0.00 4294967295.00 FORMAT "%13.2" ARRAY_SIZE 1 ECU_ADDRESS 0x60018C10 /end MEASUREMENT
/begin MEASUREMENT MoCIWDH_numConcatValAry "Concatenated value of PFC checksum and rolling counter of each task-core combination" ULONG OneToOne 1 100 0.00 4294967295.00 FORMAT "%13.2" ARRAY_SIZE 1 ECU_ADDRESS 0x60018C0C /end MEASUREMENT
/begin MEASUREMENT MoCIWDH_PtlResp "Partial response of MoCIWDH_Co" ULONG OneToOne 1 100 0.00 4294967295.00 FORMAT "%13.2" ECU_ADDRESS 0x60018518 /end MEASUREMENT
/begin MEASUREMENT MoCIWDH_PtlRespCpl "Double storage for Partial response of MoCIWDH_Co" ULONG OneToOne 1 100 0.00 4294967295.00 FORMAT "%13.2" ECU_ADDRESS 0x6001851C /end MEASUREMENT
/begin MEASUREMENT MoCIWDH_stErrAry "Status word to report internal watchdog handler errors for each task-core combination" UBYTE OneToOne 1 100 0.00 255.0 FORMAT "%5.1" ARRAY_SIZE 1 ECU_ADDRESS 0x60018C18 /end MEASUREMENT
/begin MEASUREMENT MoCMemStrtUp_adrEccErr "Backup of the memory address of the last occured uncorrectable ECC errors" ULONG OneToOne 1 100 0.00 4294967295.00 FORMAT "%13.2" ECU_ADDRESS 0x70039B8C /end MEASUREMENT
/begin MEASUREMENT MoCMemStrtUp_chkRamTest "Variable to corrupt Ram check in the next startup" UBYTE OneToOne 1 100 0.00 255.0 FORMAT "%5.1" ECU_ADDRESS 0x70039B9D /end MEASUREMENT
/begin MEASUREMENT MoCMemStrtUp_chkRomTest "Variable to corrupt Rom check in the next startup" UBYTE OneToOne 1 100 0.00 255.0 FORMAT "%5.1" ECU_ADDRESS 0x70039B9C /end MEASUREMENT
/begin MEASUREMENT MoCMemStrtUp_tiRamChk "Variable to store runtime of RAM test during startup" ULONG OneToOne 1 100 0.00 4294967295.00 FORMAT "%13.2" ECU_ADDRESS 0x70039B98 /end MEASUREMENT
/begin MEASUREMENT MoCMemStrtUp_tiRomChk "Variable to store runtime of ROM test during startup" ULONG OneToOne 1 100 0.00 4294967295.00 FORMAT "%13.2" ECU_ADDRESS 0x70039B94 /end MEASUREMENT
/begin MEASUREMENT MoCMemStrtUp_toutWdg "Variable to store timeout of internal watchdog" ULONG OneToOne 1 100 0.00 4294967295.00 FORMAT "%13.2" ECU_ADDRESS 0x70039B90 /end MEASUREMENT
/begin MEASUREMENT Mo_flgIrrvErrNTPMsg "Irreversible error bit of ADC implemented as message - Null Load TestPulse check" UBYTE B_TRUE 1 100 0.00 1.00000000000 BIT_MASK 0x1 FORMAT "%13.11" ECU_ADDRESS 0x60010102 /end MEASUREMENT
/begin MEASUREMENT Mo_flgIrrvErrTstMsg "Irreversible error bit of ADC implemented as message - Testvoltage check" UBYTE B_TRUE 1 100 0.00 1.00000000000 BIT_MASK 0x1 FORMAT "%13.11" ECU_ADDRESS 0x60010100 /end MEASUREMENT
/begin FUNCTION MisfDet_RoughRoadByWhlSpd "1.18.0    Rough road detection by wheel speeds"
 /begin DEF_CHARACTERISTIC MisfDet_axleSeln_C MisfDet_dVWhlDecMax_C MisfDet_dVWhlFil_C MisfDet_dVWhlFrntThd_M MisfDet_dVWhlPlausVMax_C MisfDet_dVWhlPlausVMin_C MisfDet_dVWhlRatMax_C MisfDet_dVWhlReThd_M MisfDet_dVWhlThdFac_T MisfDet_kdRoughRoadDT1_C MisfDet_RoughRoadDiagStuckDNEngMin_C MisfDet_stRoughRoadDiagCfg_C MisfDet_tiRoughRoadDT1_C MisfDet_trckWidth_C MisfDet_trqMaxDiagVWhlDe_C MisfDet_vWhlDeMax_C MisfDet_vWhlFil_C MisfDet_vWhlMax_C MisfDet_whlBas_C MisfDet_yawRateDeMax_C /end DEF_CHARACTERISTIC
 /begin IN_MEASUREMENT Brk_st Com_vWhlFrntLe Com_vWhlFrntRi Com_vWhlReLe Com_vWhlReRi Epm_nEng MisfDet_stFcmClr20ms MisfDet_tqBasc PT_bGrip PT_bNoGrip PT_rTrq PT_stTraShftOp PT_trqWhl VehV_v /end IN_MEASUREMENT
 /begin OUT_MEASUREMENT MisfDet_flgRoughRoad MisfDet_RoughRoadDstLog /end OUT_MEASUREMENT
 /begin LOC_MEASUREMENT MisfDet_chkVWhlDe MisfDet_dVWhl MisfDet_dVWhlAvrgFrnt MisfDet_dVWhlAvrgRe MisfDet_dVWhlFild MisfDet_dVWhlFrntThd MisfDet_dVWhlFrntThdMapOut MisfDet_dVWhlRat MisfDet_dVWhlReThd MisfDet_dVWhlReThdMapOut MisfDet_dVWhlThdFac MisfDet_flgRoughRoadFrnt MisfDet_flgRoughRoadPrel MisfDet_flgRoughRoadRe MisfDet_RoughRoadDNEng MisfDet_stDiagVWhlDeEnbl MisfDet_stDiagVWhlStuck MisfDet_vWhl MisfDet_vWhlCor MisfDet_vWhlDe MisfDet_vWhlFild MisfDet_vWhlUsd MisfDet_vWhlVld MisfDet_yawRate MisfDet_yawRateAvrg MisfDet_yawRateDe /end LOC_MEASUREMENT
 FUNCTION_VERSION "1.18.0" /end FUNCTION
/begin FUNCTION MisfDet_SegTiAdpn "1.25.0    Trigger wheel adaptation of misfire detection"
 /begin DEF_CHARACTERISTIC MisfDet_segTiAdpnCntrEnaDlyEol_C MisfDet_segTiAdpnCntrEnaDly_C MisfDet_segTiAdpnDifMaxFco_C MisfDet_segTiAdpnDifMaxPrio_C MisfDet_segTiAdpnDifMax_C MisfDet_segTiAdpnFilFacDecEol_C MisfDet_segTiAdpnFilFacDec_C MisfDet_segTiAdpnFilFacEndEol_C MisfDet_segTiAdpnFilFacEnd_C MisfDet_segTiAdpnFilFacStrtEol_C MisfDet_segTiAdpnFilFacStrt_C MisfDet_segTiAdpnN.Max.Eol_C MisfDet_segTiAdpnN.Max.PosTq.Cmn_C MisfDet_segTiAdpnN.Max.Fco.Cmn_C MisfDet_segTiAdpnN.Min.Eol_C MisfDet_segTiAdpnN.Min.PosTq.Cmn_C MisfDet_segTiAdpnN.Min.Fco.Cmn_C MisfDet_segTiAdpnNMaxNoDmd_C MisfDet_segTiAdpnNrTryEolMax_C MisfDet_segTiAdpnSampleSprdMax_C MisfDet_segTiAdpnTq.Max.Cmn_GT MisfDet_segTiAdpnTq.Max.Eol_C MisfDet_segTiAdpnTq.Min.Cmn_C MisfDet_segTiAdpnTq.Min.Eol_C MisfDet_segTiAdpnTqMax_AX MisfDet_segTiAdpnValMaxDebCntrThd_C MisfDet_segTiAdpnValMaxEol_C MisfDet_segTiAdpnValMax_C MisfDet_segTiAdpnValSampleDiagDebCntrThd_C MisfDet_segTiAdpnValSampleDiagMaxSampleNrThd_C MisfDet_segTiDifDebCntrThd_C MisfDet_segTiRatSprdDebCntrThd_C MisfDet_segTiRatSprdMax_C MisfDet_segTiRatSpreadFilFacMax_C MisfDet_segTiSampleSprdDebCntrThd_C MisfDet_stSegTiAdpnCfgCal_C MisfDet_stSegTiAdpnCfgDiag_C MisfDet_stSegTiAdpnCfgEnaPosn_C MisfDet_stSegTiAdpnCfgEnaTyp.Cmn_C MisfDet_stSegTiAdpnCfgFastLrn_C MisfDet_stSegTiAdpnCfgPrio_C /end DEF_CHARACTERISTIC
 /begin IN_MEASUREMENT ActMod_trqClth Eep_EnvRamInvld Epm_nEng MisfDet_cylCntrSegTi MisfDet_dnDly MisfDet_segPosnLenAry MisfDet_segPosnSegTi MisfDet_segTiDly MisfDet_segTiRawAry MisfDet_stBlkSegTiAdpn MisfDet_stBlkSegTiAdpnFco MisfDet_stDnAdpnRstCfm MisfDet_stFcmClr MisfDet_stFcmClr1000ms MisfDet_stReIni MisfDet_stSegTiAdpnRstReq SyC_stSub Tra_numGear VehV_v /end IN_MEASUREMENT
 /begin OUT_MEASUREMENT MisfDet_maskDFCsegTiAdpn MisfDet_maskDFCsegTiAdpnAltvPosn MisfDet_maskDFCsegTiAdpnStdPosn MisfDet_maskSegTiReqAdpn MisfDet_segTiAdpnNMax MisfDet_segTiAdpnNMin MisfDet_segTiAdpnRstCntr MisfDet_segTiAdpnRstCntrAltvPosn MisfDet_segTiAdpnRstCntrFco MisfDet_segTiAdpnSample0.ary MisfDet_segTiAdpnSample0.cntr MisfDet_segTiAdpnSample0.segPosn MisfDet_segTiAdpnSample1.ary MisfDet_segTiAdpnSample1.cntr MisfDet_segTiAdpnSample1.segPosn MisfDet_segTiAdpnSampleCntr MisfDet_segTiAdpnSampleMdn MisfDet_segTiAdpnStruct0.rat MisfDet_segTiAdpnStruct0.ratFltd MisfDet_segTiAdpnStruct0.ratMin MisfDet_segTiAdpnStruct0.ratMax MisfDet_segTiAdpnStruct0.ratMinDiv MisfDet_segTiAdpnStruct0.ratMaxDiv MisfDet_segTiAdpnStruct0.ratSprd MisfDet_segTiAdpnStruct0.stFilRdy MisfDet_segTiAdpnStruct0.stSampleSprdMax MisfDet_segTiAdpnStruct0.stMdnMax MisfDet_segTiAdpnStruct0.sampleMdn MisfDet_segTiAdpnStruct0.sampleSprd MisfDet_segTiAdpnStruct0.sampleCurr MisfDet_segTiAdpnStruct0.segNr MisfDet_segTiAdpnStruct1.rat MisfDet_segTiAdpnStruct1.ratFltd MisfDet_segTiAdpnStruct1.ratMin MisfDet_segTiAdpnStruct1.ratMax MisfDet_segTiAdpnStruct1.ratMinDiv MisfDet_segTiAdpnStruct1.ratMaxDiv MisfDet_segTiAdpnStruct1.ratSprd MisfDet_segTiAdpnStruct1.stFilRdy MisfDet_segTiAdpnStruct1.stSampleSprdMax MisfDet_segTiAdpnStruct1.stMdnMax MisfDet_segTiAdpnStruct1.sampleMdn MisfDet_segTiAdpnStruct1.sampleSprd MisfDet_segTiAdpnStruct1.sampleCurr MisfDet_segTiAdpnStruct1.segNr MisfDet_segTiAdpnTqMax MisfDet_segTiAdpnTqMin MisfDet_segTiAdpnVal MisfDet_segTiAdpnValAltvPosn MisfDet_segTiAdpnValMaxDebCntrAltvPosn MisfDet_segTiAdpnValMaxDebCntrStdPosn MisfDet_segTiAdpnValSampleDiagCntrAltvPosn MisfDet_segTiAdpnValSampleDiagCntrStdPosn MisfDet_segTiAdpnValSampleDiagDebCntrAltvPosn MisfDet_segTiAdpnValSampleDiagDebCntrStdPosn MisfDet_segTiDifDebCntr MisfDet_segTiRatSprdDebCntrAltvPosn MisfDet_segTiRatSprdDebCntrStdPosn MisfDet_segTiSampleSprdDebCntrAltvPosn MisfDet_segTiSampleSprdDebCntrStdPosn MisfDet_stDnAdpnRstReq MisfDet_stSegTiAdpn MisfDet_stSegTiAdpnActv MisfDet_stSegTiAdpnCfgEnaTypVal MisfDet_stSegTiAdpnEna MisfDet_stSegTiAdpnRdy MisfDet_stSegTiAdpnRdyPosn MisfDet_stSegTiAdpnRng MisfDet_stSegTiAdpnRst MisfDet_stSegTiAdpnRstCfm MisfDet_stSegTiAdpnSampleRdy MisfDet_stSegTiAdpnSimuLrn MisfDet_stSegTiAdpnSync MisfDet_stSegTiAdpnTypeRdy MisfDet_stSegTiAdpnValSampleDiagAltvPosn MisfDet_stSegTiAdpnValSampleDiagStdPosn /end OUT_MEASUREMENT
 /begin LOC_MEASUREMENT MisfDet_flgSyncnRstSegTi MisfDet_segTiAdpnCntrEnaDly MisfDet_segTiAdpnDifRelMax MisfDet_segTiAdpnFilFac MisfDet_segTiAdpnSampleSprdCntr MisfDet_segTiAdpnSampleSprdRelMax MisfDet_segTiAdpnValMaxCntr MisfDet_segTiAdpnValMaxCntrEol MisfDet_segTiAdpnValRelMax MisfDet_segTiRatSprdCntrAltvPosn MisfDet_segTiRatSprdCntrStdPosn MisfDet_segTiRatSprdRelMax MisfDet_segTiValMdl MisfDet_segTiValSync MisfDet_stExtClrReq MisfDet_stSegTiAdpnEnaEol MisfDet_stSegTiAdpnEolReq MisfDet_stSegTiAdpnFcoOnly MisfDet_stSegTiAdpnLrntSegPosnCyc MisfDet_stSegTiAdpnSampleCalc MisfDet_stSegTiAdpnValMax /end LOC_MEASUREMENT
 FUNCTION_VERSION "1.25.0" /end FUNCTION
/begin FUNCTION MisfDet_SegTiCalcn "1.29.1    Segment time calculation of misfire detection"
 /begin DEF_CHARACTERISTIC MisfDet_segPosnAltvNMax_C MisfDet_segPosnCalcNMaxOffs_C MisfDet_segPosnIaLteHld_C MisfDet_segPosnIaLte_T MisfDet_segPosnLenAltv_C MisfDet_segPosnLen_C MisfDet_segPosnOffsIaFilFac_C MisfDet_segPosnOffsIdleDlyTi_C MisfDet_segPosnOffsIdleTMin_C MisfDet_segPosnOffsNHys_C MisfDet_segPosnOffsTqMaxOff_C MisfDet_segPosnOffsTqMaxOn_C MisfDet_segPosnStrtAltv_C MisfDet_segPosnStrt_C MisfDet_segShiftRedStgHld_C MisfDet_segTiDly_C MisfDet_segTiInin_C MisfDet_segTiMnpl_FM MisfDet_stSegTiCalcnCfgCal_C MisfDet_stSegTiCalcnCfg_C /end DEF_CHARACTERISTIC
 /begin REF_CHARACTERISTIC EpmSeq_phiInt_CA MisfDet_dnQnts_C /end REF_CHARACTERISTIC
 /begin IN_MEASUREMENT Clth_st EngStrt_bStrtEnd EpmSyn_phiInt Epm_ctCyl Epm_nEng Ign_iaBas_s8 Ign_iacalc_s8 MisfDet_dnThd MisfDet_maskSegTiReqAdpn MisfDet_segPosnDn MisfDet_stCatHeat MisfDet_stIdle MisfDet_stMisfSti MisfDet_stOpenPt MisfDet_stRedStgTrqSyncSegTi MisfDet_stReIni MisfDet_stTqZero MisfDet_tEng MisfDet_tEngStrt MisfDet_tqBasc VehV_v /end IN_MEASUREMENT
 /begin OUT_MEASUREMENT MisfDet_cylCntrSegTi MisfDet_iaMdnAvrg MisfDet_maskSegPosnDnCalc MisfDet_maskSegTiVld MisfDet_segPosnLen MisfDet_segPosnLenAry MisfDet_segPosnLenSync MisfDet_segPosnSegTi MisfDet_segPosnStrt MisfDet_segTi MisfDet_segTiAry MisfDet_segTiDly MisfDet_segTiRawAry MisfDet_stSegPosnOffsTqLo MisfDet_stSegShift MisfDet_stSegTiVld /end OUT_MEASUREMENT
 /begin LOC_MEASUREMENT MisfDet_iaAvg MisfDet_iaLteCntr MisfDet_iaMdn MisfDet_maskSegTiVldSegBasd MisfDet_segTiDlyCorr MisfDet_segTiSegBasd MisfDet_stSegPosnIaLte MisfDet_stSegPosnOffsIdle MisfDet_stSegShiftCatHeat MisfDet_stSegShiftRedStg /end LOC_MEASUREMENT
 FUNCTION_VERSION "1.29.1" /end FUNCTION
/begin FUNCTION MisfDet_SigSeln "1.15.0    Selection of the misfire signal for the statistical evaluation" /begin DEF_CHARACTERISTIC MisfDet_nrCycMisfCont_C MisfDet_stSigSelnCfg_C /end DEF_CHARACTERISTIC
 /begin IN_MEASUREMENT Epm_stSync MisfDet_cylCntr MisfDet_stBlkStc MisfDet_stDet MisfDet_stDnDet MisfDet_stNoInjSync MisfDet_stReIni /end IN_MEASUREMENT
 /begin OUT_MEASUREMENT MisfDet_nrCylMisfNoId MisfDet_nrMisfConsc MisfDet_stCntMisf MisfDet_stMisfCont /end OUT_MEASUREMENT
 /begin LOC_MEASUREMENT MisfDet_maskCntMisf MisfDet_maskDet MisfDet_maskMisfCont /end LOC_MEASUREMENT
 FUNCTION_VERSION "1.15.0" /end FUNCTION
/begin FUNCTION MisfDet_Srv06 "1.12.0    Service 06 of misfire detection"
 /begin IN_MEASUREMENT Epm_nEng MisfDet_cylCntr MisfDet_stCntMisf MisfDet_stFcmClr MisfDet_stFcmClr100ms MisfDet_stReIni SyC_stSub /end IN_MEASUREMENT
 /begin OUT_MEASUREMENT MisfDet_cntrMisfDiag MisfDet_cntrMisfDiagFild /end OUT_MEASUREMENT
 FUNCTION_VERSION "1.12.0" /end FUNCTION
/begin FUNCTION MisfDet_StcCat "1.28.0    Misfire statistic for detection of catalyst damaging misfire and cylinder deactivation"
 /begin DEF_CHARACTERISTIC MisfDet_facCritScav_C MisfDet_stcCatDmgCritScavIntlCntrMax_C MisfDet_stcCatDmgDebIntlNr_C MisfDet_stcCatDmgDebNMax_C MisfDet_stcCatDmgDebTqMax_T MisfDet_stcCatExtFirstIntlFac_C MisfDet_stcCatExtFirstIntlT_C MisfDet_stcCatRatMinCylIdn_C MisfDet_stcCatRatMinMpl_C MisfDet_stcCatThdStrt_CA MisfDet_stcCatThd_CA MisfDet_stcCatWghtFacCritScav_M MisfDet_stcCatWghtFacEth_M MisfDet_stcCatWghtFac_M MisfDet_stStcCatCfg_C MisfDet_tiDebCatHealCritScav_C /end DEF_CHARACTERISTIC
 /begin REF_CHARACTERISTIC MisfDet_stCfgOBD_C /end REF_CHARACTERISTIC
 /begin IN_MEASUREMENT Epm_nEng FfPrm_facEth flamlu_w_msg MisfDet_cylCntr MisfDet_nEngSync MisfDet_nrCylMisfNoId MisfDet_stBlkStc MisfDet_stCntMisf MisfDet_stFcmClr MisfDet_stFcmClr100ms MisfDet_stFcmClr200ms MisfDet_stFltPrevDcyc MisfDet_stNoInjSync MisfDet_stReIni MisfDet_stReIni100ms MisfDet_stReIni200ms MisfDet_stSimrCdn MisfDet_tEngStrt MisfDet_tqBasc MisfDet_tqBascSync SyC_stSub /end IN_MEASUREMENT
 /begin OUT_MEASUREMENT MisfDet_maskStcCatFltCylIdn MisfDet_maskStcCatFltMpl MisfDet_stCatDmg MisfDet_stCatDmgBnk MisfDet_stCatDmgCurrIntl MisfDet_stCatDmgLstIntl MisfDet_stcCatIgnCntr MisfDet_stcCatIntlLen MisfDet_stcCatMisfCntrBnk MisfDet_stcCatMisfCntrCyl MisfDet_stcCatMisfCntrSumNotWght MisfDet_stcCatThd MisfDet_stcCatWghtFac MisfDet_stStcCatIntlHealSimrCdn MisfDet_stStcCatStrt /end OUT_MEASUREMENT
 /begin LOC_MEASUREMENT MisfDet_stCatDmgBnkCurrIntl MisfDet_stCatDmgCritScav MisfDet_stCatDmgCritScavCurr MisfDet_stCatDmgDebd MisfDet_stCatDmgDebMisfOutdRng MisfDet_stCatDmgDebOutOfRng MisfDet_stCatFltMpl MisfDet_stCatIntlCritScav MisfDet_StcCatCntrSimrCdn.misfBnk MisfDet_StcCatCntrSimrCdn.ign MisfDet_stcCatDmgCritScavIntlCntr MisfDet_stcCatDmgDebIntlCntr MisfDet_stcCatDmgNrCyl MisfDet_stcCatIntlLenMaxSimrCdn MisfDet_stcCatMisfCntrBnkCritScav MisfDet_stcCatThdMaxSimrCdn MisfDet_stcCatWghtFacCritScav MisfDet_stStcCatRstCompl200ms MisfDet_tiDebCatHealCritScav /end LOC_MEASUREMENT
 FUNCTION_VERSION "1.28.0" /end FUNCTION
/begin FUNCTION MisfDet_StcExh "1.25.0    Misfire statistic for detection of exhaust limit exceedance"
 /begin DEF_CHARACTERISTIC MisfDet_stcEmiNrIntl_C MisfDet_stcEmiRatMinCylIdn_C MisfDet_stcEmiRatMinMpl_C MisfDet_stcEmiThdStrtCatHeat_C MisfDet_stcEmiThdStrt_C MisfDet_stcEmiThd_T /end DEF_CHARACTERISTIC
 /begin REF_CHARACTERISTIC MisfDet_stCfgOBD_C /end REF_CHARACTERISTIC
 /begin IN_MEASUREMENT FfPrm_facEth MisfDet_cylCntr MisfDet_nrCylMisfNoId MisfDet_stBlkStc MisfDet_stCatHeat MisfDet_stCntMisf MisfDet_stFcmClr MisfDet_stFltPrevDcyc MisfDet_stNoInjSync MisfDet_stReIni MisfDet_stSimrCdn /end IN_MEASUREMENT
 /begin OUT_MEASUREMENT MisfDet_maskStcEmiFltCylIdn MisfDet_maskStcEmiFltMpl MisfDet_stcEmiIgnCntr MisfDet_stcEmiIntlCntr MisfDet_stcEmiIntlDmgCntr MisfDet_stcEmiMisfCntrCyl MisfDet_stcEmiMisfCntrSum MisfDet_stcEmiThd MisfDet_stEmiDmgCurrIntl MisfDet_stStcEmiDmgLstIntl MisfDet_stStcEmiIntlHealSimrCdn MisfDet_stStcEmiIntlHealSimrCdnStrt MisfDet_stStcEmiStrt MisfDet_stStcEmiStrtSrv /end OUT_MEASUREMENT
 /begin LOC_MEASUREMENT MisfDet_stcEmiStructCntr.misfSum MisfDet_stcEmiStructCntr.misfCyl MisfDet_stcEmiStructCntr.ign MisfDet_stcEmiStructCntr.intl MisfDet_stcEmiStructCntr.dmgIntl MisfDet_stcEmiStructCntr.stCylDmgCylIdn MisfDet_stcEmiStructCntr.stCylDmgMtpl MisfDet_stcEmiStructSimrCdn.misfSum MisfDet_stcEmiStructSimrCdn.ign MisfDet_stcEmiStructSimrCdn.intl MisfDet_stcEmiStructSimrCdn.dmgIntl MisfDet_stcEmiStructSimrCdnStrt.misfSum MisfDet_stcEmiStructSimrCdnStrt.ign MisfDet_stcEmiStructSimrCdnStrt.intl MisfDet_stcEmiStructSimrCdnStrt.dmgIntl MisfDet_stEmiFltMpl MisfDet_stStcEmiFrzFrm MisfDet_stStcEmiStrtCatHeat /end LOC_MEASUREMENT
 FUNCTION_VERSION "1.25.0" /end FUNCTION
/begin FUNCTION MisfDet_StcFco "1.17.0    Misfire statistic for cylinder individual fuel cut off in case of catalyst damaging misfire rate"
 /begin DEF_CHARACTERISTIC MisfDet_stcCatDmgFcoNrCylBnkMax_CA MisfDet_stcCatDmgFcoNrIntlMin_T MisfDet_stcCatDmgFcoNrIntlStrt_C MisfDet_stcCatDmgFcoRatMin_C MisfDet_stcCatDmgFcoThd_CA MisfDet_stStcCatDmgFcoCfg_C /end DEF_CHARACTERISTIC
 /begin IN_MEASUREMENT Epm_nEng MisfDet_cylCntr MisfDet_stBlkStc MisfDet_stCatDmgCurrIntl MisfDet_stcCatIgnCntr MisfDet_stcCatIntlLen MisfDet_stcCatMisfCntrBnk MisfDet_stcCatMisfCntrCyl MisfDet_stcCatThd MisfDet_stFcmClr MisfDet_stReIni SyC_stSub /end IN_MEASUREMENT
 /begin OUT_MEASUREMENT MisfDet_stCatDmgFcoCyl MisfDet_stCatDmgFcoEng /end OUT_MEASUREMENT
 /begin LOC_MEASUREMENT MisfDet_stCatDmgFcoCylCurrIntl MisfDet_stcCatDmgFcoNrCylBnk MisfDet_stcCatDmgFcoNrIntlCyl MisfDet_stcCatDmgFcoNrIntlMin MisfDet_stcCatDmgFcoNrIntlStrt /end LOC_MEASUREMENT
 FUNCTION_VERSION "1.17.0" /end FUNCTION
/begin FUNCTION MisfDet_StcIfDSM "1.23.0    Misfire interface to diagnostic system manager (DSM)" /begin DEF_CHARACTERISTIC MisfDet_stCfgOBD_C /end DEF_CHARACTERISTIC
 /begin IN_MEASUREMENT DSM_TripChgFinshd MisfDet_stcEmiMisfCntrCyl MisfDet_stFcmClr100ms MisfDet_stStcCatIntlHealSimrCdn MisfDet_stStcEmiIntlHealSimrCdn MisfDet_stStcEmiIntlHealSimrCdnStrt SyC_stSub /end IN_MEASUREMENT
 /begin OUT_MEASUREMENT MisfDet_stFlt MisfDet_stFltCurrDcyc MisfDet_stFltCyl MisfDet_stFltPrevDcyc MisfDet_stSimrCdn /end OUT_MEASUREMENT
 /begin LOC_MEASUREMENT MisfDet_cylFrzFrmData MisfDet_simrCdn.n MisfDet_simrCdn.load MisfDet_simrCdn.T MisfDet_stOk /end LOC_MEASUREMENT
 FUNCTION_VERSION "1.23.0" /end FUNCTION
/begin FUNCTION MisfDet_StcMisc "1.11.2    Miscellaneous misfire statistics (similar conditions, longterm calibration support, arv,)" /begin DEF_CHARACTERISTIC MisfDet_nrDcycDrvRcdrRst_C MisfDet_stStcMiscCfg_C /end DEF_CHARACTERISTIC
 /begin IN_MEASUREMENT CoEOM_flgHsp Epm_nEng MisfDet_cylCntr MisfDet_stBlkStc MisfDet_stCntMisf SyC_stSub /end IN_MEASUREMENT
 /begin OUT_MEASUREMENT MisfDet_ignCntr MisfDet_ignCntrHsp MisfDet_misfCntrCyl MisfDet_misfCntrCylHsp MisfDet_misfCntrSum MisfDet_stExhDmgSuspc /end OUT_MEASUREMENT
 /begin LOC_MEASUREMENT MisfDet_nrDcycDrvRcdr /end LOC_MEASUREMENT
 FUNCTION_VERSION "1.11.2" /end FUNCTION
/begin FUNCTION MisfDet_ThdCalcn "1.24.0    Misfire detection, Threshold calculation"
 /begin DEF_CHARACTERISTIC MisfDet_dnThdContRdcFac_C MisfDet_dnThdContRdcIdx_C MisfDet_dnThdDecFilFac_C MisfDet_dnThdDecMaxCont_T MisfDet_dnThdDecMaxDif_T MisfDet_dnThdDecMax_T MisfDet_dnThdFacStrt_T MisfDet_dnThdMinFacLteCmb.Cmn_C MisfDet_dnThdOffsCvoCont_T MisfDet_dnThdOffsCvo_T MisfDet_dnThdOffsTCatHeat_T MisfDet_dnThdOffsT_T MisfDet_dnThdTiMinDynLim_C MisfDet_maxToothDeEolNLim_C MisfDet_maxToothDeEol_C MisfDet_maxToothDe_C MisfDet_stThdCalcnCfg_C /end DEF_CHARACTERISTIC
 /begin REF_CHARACTERISTIC MisfDet_dnFilFacMax_C MisfDet_dnQnts_C /end REF_CHARACTERISTIC
 /begin IN_MEASUREMENT CoEOM_flgHsp Epm_numCyl InjSys_flgCvoBascEna MisfDet_dnAdpnQlyFac MisfDet_dnFltdCyl MisfDet_dnThdFacLteCmbMapOut MisfDet_dnThdMapOut MisfDet_dnThdMapOutCont MisfDet_dnThdMapOutDif MisfDet_dnThdMinContOut MisfDet_dnThdMinDnAdpnMapOut MisfDet_nEngSync MisfDet_segPosnLenSync MisfDet_stCatHeat MisfDet_stDnDifSelActv MisfDet_stSegShift MisfDet_stSegTiAdpnRdy MisfDet_stSegTiAdpnSync MisfDet_stSegTiAdpnTypeRdy MisfDet_stStcEmiStrt MisfDet_tEng MisfDet_tiEngRun MisfDet_tiEngRunSum MisfDet_tqBascSync /end IN_MEASUREMENT
 /begin OUT_MEASUREMENT MisfDet_dnThd MisfDet_dnThdCont MisfDet_dnThdCor MisfDet_dnThdDif MisfDet_dnThdMinAdpn MisfDet_dnThdOffsT /end OUT_MEASUREMENT
 /begin LOC_MEASUREMENT MisfDet_dnThdContRdcVal MisfDet_dnThdCorCont MisfDet_dnThdCorDif MisfDet_dnThdDecLim MisfDet_dnThdDecLimCont MisfDet_dnThdDecLimDif MisfDet_dnThdDynLim MisfDet_dnThdDynLimCont MisfDet_dnThdFacLteCmb MisfDet_dnThdFacStrt MisfDet_dnThdMinDnAdpnVal MisfDet_dnThdMinSegTiAdpn MisfDet_dnThdOffsCvo MisfDet_dnThdOffsCvoCont MisfDet_dnThdSyncContFiltd MisfDet_stDnThdDynLim /end LOC_MEASUREMENT
 FUNCTION_VERSION "1.24.0" /end FUNCTION
/begin FUNCTION MisfDet_ThdMapSeln "1.11.0    Base map selection for threshold calculation"
 /begin DEF_CHARACTERISTIC MisfDet_dnThdFacLteCmbDrv.Cmn_GT MisfDet_dnThdFacLteCmbDrv_AX MisfDet_dnThdFacLteCmbIdle.Cmn_GT MisfDet_dnThdFacLteCmbIdle_AX MisfDet_dnThdIdleLteCmbTq_AX MisfDet_dnThdIdleTq_AX MisfDet_dnThdMapDrvCatHeatGrip.Std.Cmn_GM MisfDet_dnThdMapDrvCatHeatGrip.Cont.Cmn_GM MisfDet_dnThdMapDrvCatHeatGrip.Dif.Cmn_GM MisfDet_dnThdMapDrvCatHeatOpen.Std.Cmn_GM MisfDet_dnThdMapDrvCatHeatOpen.Cont.Cmn_GM MisfDet_dnThdMapDrvCatHeatOpen.Dif.Cmn_GM MisfDet_dnThdMapDrvCatHeatSlip.Std.Cmn_GM MisfDet_dnThdMapDrvCatHeatSlip.Cont.Cmn_GM MisfDet_dnThdMapDrvCatHeatSlip.Dif.Cmn_GM MisfDet_dnThdMapIdle.Std.Cmn_GT MisfDet_dnThdMapIdle.Cont.Cmn_GT MisfDet_dnThdMapIdle.Dif.Cmn_GT MisfDet_dnThdMapIdleAltvPosn.Std.Cmn_GT MisfDet_dnThdMapIdleAltvPosn.Cont.Cmn_GT MisfDet_dnThdMapIdleAltvPosn.Dif.Cmn_GT MisfDet_dnThdMapIdleCatHeat.Std.Cmn_GT MisfDet_dnThdMapIdleCatHeat.Cont.Cmn_GT MisfDet_dnThdMapIdleCatHeat.Dif.Cmn_GT MisfDet_dnThdMapIdleCatWrm.Std.Cmn_GT MisfDet_dnThdMapIdleCatWrm.Cont.Cmn_GT MisfDet_dnThdMapIdleCatWrm.Dif.Cmn_GT MisfDet_dnThdMapPtGrip.Std.Cmn_GM MisfDet_dnThdMapPtGrip.Cont.Cmn_GM MisfDet_dnThdMapPtGrip.Dif.Cmn_GM MisfDet_dnThdMapPtOpen.Std.Cmn_GM MisfDet_dnThdMapPtOpen.Cont.Cmn_GM MisfDet_dnThdMapPtOpen.Dif.Cmn_GM MisfDet_dnThdMapPtSlip.Std.Cmn_GM MisfDet_dnThdMapPtSlip.Cont.Cmn_GM MisfDet_dnThdMapPtSlip.Dif.Cmn_GM MisfDet_dnThdMinBlkDnAdpnNvCorrn.Cmn_GM MisfDet_dnThdMinBlkDnAdpnNvCorrn1.Cmn_GM MisfDet_dnThdMinCont.Cmn_GM MisfDet_dnThdMinContIdle_M MisfDet_dnThdMinDnAdpn.Cmn_GM MisfDet_dnThdMinDnAdpnN_AX MisfDet_dnThdMinDnAdpnTq_AX MisfDet_dnThdN_AX MisfDet_dnThdTq_AX MisfDet_iaCatWrmThd_C MisfDet_maskDnThdMinBlkDnAdpnNvCorrnCmbTyp_CA MisfDet_maskDnThdMinBlkDnAdpnNvCorrn_CA MisfDet_rGripMaxOpen_C MisfDet_rGripMinClsd_C MisfDet_stThdMapSelnCfg_C /end DEF_CHARACTERISTIC
 /begin IN_MEASUREMENT B_kw_msg MisfDet_dnDly MisfDet_iaMdnAvrg MisfDet_maskDnAdpnNvCorrnCmbd MisfDet_maskDnAdpnNvCorrnCmbdCmbTyp MisfDet_nEngSync MisfDet_stBlkDnAdpnNvCorrn MisfDet_stCatHeat MisfDet_stIdle MisfDet_stOpenPt MisfDet_stSegShift MisfDet_tqBascSync PT_rGrip /end IN_MEASUREMENT
 /begin OUT_MEASUREMENT MisfDet_dnThdFacLteCmbMapOut MisfDet_dnThdMapOut MisfDet_dnThdMapOutCont MisfDet_dnThdMapOutDif MisfDet_dnThdMinContOut MisfDet_dnThdMinDnAdpnMapOut /end OUT_MEASUREMENT
 /begin LOC_MEASUREMENT MisfDet_dnThdMinDnAdpnMapIdx MisfDet_idxThdMap MisfDet_idxThdMapSync /end LOC_MEASUREMENT
 FUNCTION_VERSION "1.11.0" /end FUNCTION
/begin FUNCTION MoCADC_Co "80.8.0    Microcontroller Monitoring: AD-converter"
 /begin DEF_CHARACTERISTIC MoCADC_ctDebNTP_C MoCADC_ctDebTst_C MoCADC_ctRstNTP_C MoCADC_ctRstTst_C MoCADC_uNTPMax_C MoCADC_uTstMax_C MoCADC_uTstMin_C /end DEF_CHARACTERISTIC
 /begin IN_MEASUREMENT MoGlbl_vblStructCpl.Mo_stCplChk MoGlbl_vblStructCpl.Mo_stMoCCpl Mo_ctRst Mo_ctRstCpl Mo_stMoF Mo_stMoFCpl /end IN_MEASUREMENT
 /begin OUT_MEASUREMENT MoCADC_bChkActv MoCADC_bDef MoCADC_bNTPActv MoCADC_bNTPErr MoCADC_bNTPRel MoCADC_bTstErr MoCADC_st MoCADC_stMsg Mo_flgIrrvErrNTPMsg Mo_flgIrrvErrTstMsg /end OUT_MEASUREMENT
 /begin LOC_MEASUREMENT MoCADC_ctDebNTP MoCADC_ctDebNTPCpl MoCADC_ctDebTst MoCADC_ctDebTstCpl MoCADC_ctTstNTP MoCADC_ctTstTst MoCADC_flgClrNTP MoCADC_flgClrTst MoCADC_flgNTPTest MoCADC_stCpl MoCADC_uNTP_mp MoCADC_uTst_mp /end LOC_MEASUREMENT
 FUNCTION_VERSION "80.8.0" /end FUNCTION
/begin FUNCTION MoCCom_Co "81.26.0   Microcontroller Monitoring: Query-response-communication between MM and FC"
 /begin IN_MEASUREMENT MoCCPU_PartResp MoCGTM_PtlResp MoCHwLogicTest_PtlResp MoCIWDH_PtlResp MoCPFC_PtlResp MoCSOP_stActvMsg MoCSOP_stComActv MoCSOP_stComActvCpl /end IN_MEASUREMENT
 /begin OUT_MEASUREMENT MoCCom_bPFCNew MoCCom_bSwShrNew MoCCom_cntrWDAErrThd MoCCom_cntrWDAErrThdMsg MoCCom_ctErrFC MoCCom_ctErrMM MoCCom_ctErrMMMsg MoCCom_Query MoCCom_stQueryNew MoCCom_SwShrPtlResp /end OUT_MEASUREMENT
 /begin LOC_MEASUREMENT MoCCom_cntrInCorrRespTime MoCCom_cntrSyncMonModl MoCCom_cntrWDAErrThdCpl MoCCom_ctBusErr MoCCom_ctBusErrCpl MoCCom_ctErrFCCpl MoCCom_ctErrMMOld MoCCom_ctErrOSTimeout MoCCom_Response MoCCom_Response_mp MoCCom_stBusErr MoCCom_stCheckState MoCCom_stCheckStateCpl MoCCom_stComActvOld MoCCom_stComActvOldCpl MoCCom_stComState MoCCom_stErrEna MoCCom_stErrEnaCpl MoCCom_stWdgThdErr MoCCom_stWdgTiWinErr /end LOC_MEASUREMENT
 FUNCTION_VERSION "81.26.0" /end FUNCTION
/begin FUNCTION MoCCPU_Co "80.6.0    Microcontroller Monitoring: Instruction test" /begin DEF_CHARACTERISTIC MoCCPU_stLockStepTstActv_CW /end DEF_CHARACTERISTIC /begin OUT_MEASUREMENT MoCCPU_PartResp /end OUT_MEASUREMENT FUNCTION_VERSION "80.6.0" /end FUNCTION
/begin FUNCTION MoCEMM_Co "1.24.0    Microcontroller Monitoring: Error Management Module(EMM)" /begin IN_MEASUREMENT MoCSOP_stComActv /end IN_MEASUREMENT
 /begin OUT_MEASUREMENT MoCEMM_stEmmAlrms MoCEMM_stEmmAlrmsMsg MoCEMM_stEmmAlrmsNv MoCEMM_stEmmErrorPin /end OUT_MEASUREMENT
 /begin LOC_MEASUREMENT MoCEMM_idxNumCurrErr MoCEMM_stEmmAlrmsCpl MoCEMM_stEmmErrorPinCpl MoCEMM_stEmmGPIO MoCEMM_stPwrOnRstHdl MoCEMM_stPwrOnRstHdlCpl MoCEMM_stPwrOnRstReq MoCEMM_stPwrOnRstReqCpl MoCEMM_structCurrReq.MoCEMM_cntrInfo MoCEMM_structCurrReq.MoCEMM_blkInfo MoCEMM_structCurrReq.MoCEMM_cntrInfoCpl MoCEMM_structFlash.MoCEMM_cntrInfo MoCEMM_structFlash.MoCEMM_blkInfo MoCEMM_structFlash.MoCEMM_cntrInfoCpl MoCEMM_stSWErrorPinReqAry MoCEMM_stSWErrorPinReqAryCpl MoCEMM_wdgTout /end LOC_MEASUREMENT
 FUNCTION_VERSION "1.24.0" /end FUNCTION
/begin FUNCTION MoCGTM_Co "1.16.0    Microcontroller Monitoring: Generic Timer Module (GTM)"
 /begin DEF_CHARACTERISTIC MoCGTM_cntrCMPErrbitHealMax_C MoCGTM_cntrDebErrMax_C MoCGTM_stChksTstActv_CW MoCGTM_stSWResetDem_CW MoCGTM_stTestActv_CW /end DEF_CHARACTERISTIC
 /begin OUT_MEASUREMENT MoCGTM_bbOut1 MoCGTM_flgCmpErr MoCGTM_PtlResp /end OUT_MEASUREMENT
 /begin LOC_MEASUREMENT MoCGTM_aryCMPErrBit MoCGTM_aryCMPErrBitCpl MoCGTM_bbOut1Cpl MoCGTM_cmpErrAryIdx MoCGTM_cmpErrAryIdxCpl MoCGTM_cntrBadcase MoCGTM_cntrCMPErrbit MoCGTM_cntrCMPErrbitCpl MoCGTM_cntrCMPErrbitHeal MoCGTM_cntrCMPErrbitHealCpl MoCGTM_cntrDebErr MoCGTM_cntrDebErrCpl MoCGTM_cntrDebErrMax MoCGTM_cntrMCS1 MoCGTM_cntrMCS1Old MoCGTM_cntrMCS1OldCpl MoCGTM_cntrMCS2 MoCGTM_cntrMCS2Old MoCGTM_cntrMCS2OldCpl MoCGTM_cntrMsmCMPErrBit MoCGTM_cntrRouteSigErr MoCGTM_cntrRouteSigErrCpl MoCGTM_currChksVal MoCGTM_currChksValCpl MoCGTM_currMCSModlAryIdx MoCGTM_McsData_ptr1Cpl MoCGTM_McsData_ptr2Cpl MoCGTM_numMCS1Ch MoCGTM_numMCS1Modl MoCGTM_numMCS2Ch MoCGTM_numMCS2Modl MoCGTM_PtlRespCpl MoCGTM_stBadcaseTrig MoCGTM_stErr MoCGTM_stErrChks MoCGTM_stErrCpl MoCGTM_tiCurrMCSVal MoCGTM_tiCurrTskcall MoCGTM_tiExeMCS1_MP MoCGTM_tiExeMCS2_MP MoCGTM_tiFallEdgeBadcase_MP MoCGTM_tiFallEdgeMCS1_MP MoCGTM_tiFallEdgeMCS2_MP MoCGTM_tiMCSTIMRead MoCGTM_tiPrevMCS1Trig_MP MoCGTM_tiPrevMCS2Trig_MP MoCGTM_tiPrevTskcall MoCGTM_tiRisngEdgeMCS1_MP MoCGTM_tiRisngEdgeMCS2_MP MoCGTM_tiTskCalldst_MP /end LOC_MEASUREMENT
 FUNCTION_VERSION "1.16.0" /end FUNCTION
/begin FUNCTION MoCHwLogicTest_Co "1.4.0     Microcontroller Monitoring: Hardware Logic Test"
 /begin DEF_CHARACTERISTIC MoCHwLogicTest_stTestActv_CW MoCHwLogicTest_swtDisblErrReactn_CW MoCHwLogicTest_swtDisblFwChk_CA /end DEF_CHARACTERISTIC
 /begin OUT_MEASUREMENT MoCHwLogicTest_PtlResp /end OUT_MEASUREMENT
 /begin LOC_MEASUREMENT MoCHwLogicTest_flgAlvTestChk MoCHwLogicTest_flgFwChk MoCHwLogicTest_flgMONBISTChk MoCHwLogicTest_flgSFFDChk MoCHwLogicTest_flgTempChk MoCHwLogicTest_flgUCBErrChk MoCHwLogicTest_stErr /end LOC_MEASUREMENT
 FUNCTION_VERSION "1.4.0" /end FUNCTION
/begin FUNCTION MoCIWDH_Co "2.1.0     Microcontroller Monitoring: Internal watchdog handler" /begin DEF_CHARACTERISTIC MoCIWDH_stPtlRespTstActv_CW /end DEF_CHARACTERISTIC /begin OUT_MEASUREMENT MoCIWDH_PtlResp /end OUT_MEASUREMENT
 /begin LOC_MEASUREMENT MoCIWDH_bbLoc1 MoCIWDH_bbLoc1Cpl MoCIWDH_cntChksAry MoCIWDH_cntrRollgAry MoCIWDH_cntrRollgAryCpl MoCIWDH_flgConcatValErr MoCIWDH_numChksAry MoCIWDH_numConcatValAry MoCIWDH_PtlRespCpl MoCIWDH_stErrAry /end LOC_MEASUREMENT
 FUNCTION_VERSION "2.1.0" /end FUNCTION
/begin FUNCTION MoCMemStrtUp_Co "1.0.0     Microcontroller Monitoring: Startup memory test" /begin DEF_CHARACTERISTIC MoCMemStrtUp_chkRamTest_C MoCMemStrtUp_chkRomTest_C /end DEF_CHARACTERISTIC /begin OUT_MEASUREMENT MoCMemStrtUp_adrEccErr /end OUT_MEASUREMENT
 /begin LOC_MEASUREMENT MoCMemStrtUp_chkRamTest MoCMemStrtUp_chkRomTest MoCMemStrtUp_tiRamChk MoCMemStrtUp_tiRomChk MoCMemStrtUp_toutWdg /end LOC_MEASUREMENT
 FUNCTION_VERSION "1.0.0" /end FUNCTION
/begin COMPU_METHOD accgrd_uw_b2777p6 "" RAT_FUNC "%6.4" "m/(s^3)" COEFFS 0 147456 0 0 0 6250 /end COMPU_METHOD
/begin COMPU_METHOD acc_uw_b55p55 "" RAT_FUNC "%6.5" "m/(s^2)" COEFFS 0 147456 0 0 0 125 /end COMPU_METHOD
/begin COMPU_METHOD B_TRUE "" TAB_VERB "%6.3" "" COMPU_TAB_REF B_TRUE /end COMPU_METHOD
/begin COMPU_VTAB B_TRUE "" TAB_VERB 2 0 "FALSE" 1 "TRUE" /end COMPU_VTAB
/begin COMPU_METHOD CaS_32rev_compu "" RAT_FUNC "%6.2" "CaS rev" COEFFS 0 1 0 0 0 1 /end COMPU_METHOD
/begin COMPU_METHOD Compu_SegPosnInt_VERB "" TAB_VERB "%6.3" "" COMPU_TAB_REF Compu_SegPosnInt_VERB /end COMPU_METHOD
/begin COMPU_VTAB Compu_SegPosnInt_VERB "" TAB_VERB 4 0 "Std" 1 "Altv" 258 "Idle" 259 "PfltRgn" /end COMPU_VTAB
/begin COMPU_METHOD Compu_SegPosn_VERB "" TAB_VERB "%6.3" "" COMPU_TAB_REF Compu_SegPosn_VERB /end COMPU_METHOD
/begin COMPU_VTAB Compu_SegPosn_VERB "" TAB_VERB 9 0 "Std" 1 "Altv" 258 "Idle" 259 "PfltRgn" 260 "Cilcn" 261 "TqBal" 2 "undef1" 16 "Std2" 17 "undef2" /end COMPU_VTAB
/begin COMPU_METHOD dez "" RAT_FUNC "%6.2" "" COEFFS 0 1 0 0 0 1 /end COMPU_METHOD
/begin COMPU_METHOD dn_Compu "" RAT_FUNC "%6.4" "rad/s^2" COEFFS 0 16 0 0 0 1 /end COMPU_METHOD
/begin COMPU_METHOD EngN "" RAT_FUNC "%6.3" "rpm" COEFFS 0 2 0 0 0 1 /end COMPU_METHOD
/begin COMPU_METHOD EngNGrad "" RAT_FUNC "%6.3" "rpm/s" COEFFS 0 2 0 0 0 1 /end COMPU_METHOD
/begin COMPU_METHOD Fact100 "" RAT_FUNC "%6.4" "-" COEFFS 0 100 0 0 0 1 /end COMPU_METHOD
/begin COMPU_METHOD fak_q0p01 "" RAT_FUNC "%6.4" "" COEFFS 0 100 0 0 0 1 /end COMPU_METHOD
/begin COMPU_METHOD fak_ub_b2 "" RAT_FUNC "%8.5" "-" COEFFS 0 256 0 0 0 2 /end COMPU_METHOD
/begin COMPU_METHOD fak_uw_b1 "" RAT_FUNC "%7.6" "-" COEFFS 0 65536 0 0 0 1 /end COMPU_METHOD
/begin COMPU_METHOD fak_uw_b16 "" RAT_FUNC "%6.5" "-" COEFFS 0 65536 0 0 0 16 /end COMPU_METHOD
/begin COMPU_METHOD fak_uw_b2 "" RAT_FUNC "%7.6" "-" COEFFS 0 65536 0 0 0 2 /end COMPU_METHOD
/begin COMPU_METHOD Kd "" RAT_FUNC "%7.6" "1/1" COEFFS 0 65536 0 0 0 1 /end COMPU_METHOD
/begin COMPU_METHOD kw_q0p0039 "" RAT_FUNC "%6.4" "Grad KW" COEFFS 0 256 0 0 0 1 /end COMPU_METHOD
/begin COMPU_METHOD kw_q0p75 "" RAT_FUNC "%6.3" "Grad KW" COEFFS 0 4 0 0 0 3 /end COMPU_METHOD
/begin COMPU_METHOD kw_q1p8310eEm4 "" RAT_FUNC "%6.5" "deg CrS" COEFFS 0 32768 0 0 0 6 /end COMPU_METHOD
/begin COMPU_METHOD kw_q2p794eEm9 "" RAT_FUNC "%11.10" "deg CrS" COEFFS 0 2147483648 0 0 0 6 /end COMPU_METHOD
/begin COMPU_METHOD kw_tooth_sy "" RAT_FUNC "%6.2" "deg KW" COEFFS 0 0.166666666666667 0 0 0 1 /end COMPU_METHOD
/begin COMPU_METHOD len_q0p001_m "" RAT_FUNC "%6.5" "m" COEFFS 0 1000 0 0 0 1 /end COMPU_METHOD
/begin COMPU_METHOD len_q50_m "" RAT_FUNC "%6.1" "m" COEFFS 0 0.02 0 0 0 1 /end COMPU_METHOD
/begin COMPU_METHOD MisfDet_dnThdMinDnAdpnMapIdx_VERB "" TAB_VERB "%6.3" "" COMPU_TAB_REF MisfDet_dnThdMinDnAdpnMapIdx_VERB /end COMPU_METHOD
/begin COMPU_VTAB MisfDet_dnThdMinDnAdpnMapIdx_VERB "" TAB_VERB 4 -1 "None" 0 "MinDnAdpn" 1 "MinBlkDnAdpnNvCorrn" 2 "MinBlkDnAdpnNvCorrn1" /end COMPU_VTAB
/begin COMPU_METHOD MisfDet_idxThdMap_VERB "" TAB_VERB "%6.3" "" COMPU_TAB_REF MisfDet_idxThdMap_VERB /end COMPU_METHOD
/begin COMPU_VTAB MisfDet_idxThdMap_VERB "" TAB_VERB 23 0 "PtOpen" 1 "PtSlip" 12 "IdleStrat" 13 "IdleLamSplit" 14 "IdleStdPfltRgn" 15 "IdleAltvPosn" 16 "IdleThermCoorn" 17 "IdleCatWrm" 18 "IdleCatHeat" 19 "IdleAltvPfltRgn" 20 "IdleAltvPosnLamSplit" 21 "EclOpen" 2 "PtGrip" 3 "Hem" 4 "DrvStrat" 5 "DrvCatHeatOpen" 6 "DrvCatHeatSlip" 7 "DrvCatHeatGrip" 8 "PfltRgnPtOpen" 9 "PfltRgnPtSlip" 10 "PfltRgnPtGrip" 11 "Idle" 22 "EclSlip" /end COMPU_VTAB
/begin COMPU_METHOD MoCCom_stCheckState_Compu "" TAB_VERB "%6.3" "" COMPU_TAB_REF MoCCom_stCheckState_Compu /end COMPU_METHOD
/begin COMPU_VTAB MoCCom_stCheckState_Compu "" TAB_VERB 8 0 "MOCCOM_CO_COR_IN_TIME_AND_VALUE_1" 1 "MOCCOM_CO_COR_IN_TIME_AND_VALUE_2" 2 "MOCCOM_CO_TOO_EARLY" 3 "MOCCOM_CO_COR_IN_TIME_AND_VALUE_3" 4 "MOCCOM_CO_TOO_LATE" 5 "MOCCOM_CO_COR_IN_TIME_AND_VALUE_4A" 6 "MOCCOM_CO_COR_IN_TIME_AND_VALUE_4B" 7 "MOCCOM_CO_COR_IN_TIME_INC_IN_VALUE" /end COMPU_VTAB
/begin COMPU_METHOD MoCCom_stComState_Compu "" TAB_VERB "%6.3" "" COMPU_TAB_REF MoCCom_stComState_Compu /end COMPU_METHOD
/begin COMPU_VTAB MoCCom_stComState_Compu "" TAB_VERB 3 0 "MOCCOM_CO_SYNCHRONIZING" 1 "MOCCOM_CO_RECEIVING_QUERY" 2 "MOCCOM_CO_SENDING_RESP" /end COMPU_VTAB
/begin COMPU_METHOD MoExe_Co_PFC_ID_Compu "" TAB_VERB "%6.3" "" COMPU_TAB_REF MoExe_Co_PFC_ID_Compu /end COMPU_METHOD
/begin COMPU_VTAB MoExe_Co_PFC_ID_Compu "" TAB_VERB 88 0 "-" 16777471 "MOCEMM_CO_REQERRPIN_ID_HW" 16777217 "MOCEMM_CO_REQERRPIN_ID_MOCMEM" 16777216 "MOCEMM_CO_REQERRPIN_ID_MOCCOM" 16777218 "MOCEMM_CO_REQERRPIN_ID_MOCSOP" 16777225 "MOCEMM_CO_REQERRPIN_ID_MOCADC" 16777220 "MOCEMM_CO_REQERRPIN_ID_MOFWDA" 16777219 "MOCEMM_CO_REQERRPIN_ID_MOCEMM" 16777221 "MOCEMM_CO_REQERRPIN_ID_OCWDATEST" 16777222 "MOCEMM_CO_REQERRPIN_ID_SWSHRL2" 16777223 "MOCEMM_CO_REQERRPIN_ID_MOCGTM" 16777224 "MOCEMM_CO_REQERRPIN_ID_MOCSCC" 16777226 "MOCEMM_CO_REQERRPIN_ID_MOCIWDH" 11 "MO_ADAP_PROC_CORE1_10MS_NR1_PFC_ID" 10 "MO_GLBL_PROC_CORE1_10MS_NR1_PFC_ID" 73 "MO_GLBL_PROC_MANYCORE_CORE1_10MS_NR1_PFC_ID" 2 "MOCADC_CO_PROC_CORE1_10MS_NR1_PFC_ID" 74 "MOCCOM_CO_PROC_CORE1_10MS_NR1_PFC_ID" 70 "MOCCPU_CO_PROC_CORE1_10MS_NR1_PFC_ID" 7 "MOCEMM_CO_PROC_CORE1_10MS_NR1_PFC_ID" 9 "MOCGTM_CO_PROC_CORE1_10MS_NR1_PFC_ID" 71 "MOCIWDH_CO_PROC_CORE1_10MS_NR1_PFC_ID" 5 "MOCMEM_CO_CHKCSA_PROC_CORE1_10MS_NR1_PFC_ID" 65 "MOCMEM_CO_CHKRAM_PROC_CORE1_10MS_NR1_PFC_ID" 8 "MOCMEM_CO_CHKROM_PROC_CORE1_10MS_NR1_PFC_ID" 4 "MOCMEM_CO_CHKSTCK_PROC_CORE1_10MS_NR1_PFC_ID" 67 "MOCMEM_CO_ERRHDL_PROC_CORE1_10MS_NR1_PFC_ID" 72 "MOCPFC_CO_IWDH_PROC_CORE1_10MS_NR1_PFC_ID" 69 "MOCPFC_CO_MANYCORE_PROC_CORE1_10MS_NR1_PFC_ID" 66 "MOCSCC_CO_PROC_CORE1_10MS_NR1_PFC_ID" 75 "MOCSOP_CO_PROC_CORE1_10MS_NR1_PFC_ID" 6 "MOCSOP_CO_PROC_10MS_CORE1_10MS_NR1_PFC_ID" 1 "MOEXE_CO_TASK_CTCYC_CORE1_TASK10MS_NR1_PFC_ID" 28 "MOFACC_CO_PROC_CORE1_10MS_NR1_PFC_ID" 50 "MOFAIR_FILGPRDC_PROC_CORE1_10MS_NR1_PFC_ID" 53 "MOFAIRFL_CTOFFGDI_PROC_CORE1_10MS_NR1_PFC_ID" 52 "MOFAIRFL_CYLGDI_PROC_CORE1_10MS_NR1_PFC_ID" 54 "MOFAIRFL_ETA_PROC_CORE1_10MS_NR1_PFC_ID" 48 "MOFAIRFL_FF_PROC_CORE1_10MS_NR1_PFC_ID" 47 "MOFAIRFL_IN_PROC_CORE1_10MS_NR1_PFC_ID" 51 "MOFAIRFL_MIXCTLGDI_PROC_CORE1_10MS_NR1_PFC_ID" 49 "MOFAIRFL_MODE_PROC_CORE1_10MS_NR1_PFC_ID" 20 "MOFAPP_CO_PROC_CORE1_10MS_NR1_PFC_ID" 21 "MOFAPP_REL_PROC_CORE1_10MS_NR1_PFC_ID" 19 "MOFBRK_CO_PROC_CORE1_10MS_NR1_PFC_ID" 27 "MOFCCTL_CO_PROC_CORE1_10MS_NR1_PFC_ID" 22 "MOFCLTH_CO_PROC_CORE1_10MS_NR1_PFC_ID" 42 "MOFCOVEH_CO_PROC_CORE1_10MS_NR1_PFC_ID" 29 "MOFDCS_CO_PROC_CORE1_10MS_NR1_PFC_ID" 31 "MOFDRAS_CO_PROC_CORE1_10MS_NR1_PFC_ID" 40 "MOFDRDEM_CO_PROC_CORE1_10MS_NR1_PFC_ID" 41 "MOFDRDEM_MIN_PROC_CORE1_10MS_NR1_PFC_ID" 39 "MOFDRVPRGSWT_CO_PROC_CORE1_10MS_NR1_PFC_ID" 17 "MOFESPD_CO_PROC_CORE1_10MS_NR1_PFC_ID" 32 "MOFETC_CO_PROC_CORE1_10MS_NR1_PFC_ID" 33 "MOFEXTINT_CO_PROC_CORE1_10MS_NR1_PFC_ID" 12 "MOFFRM_RX_PROC_CORE1_10MS_NR1_PFC_ID" 64 "MOFFRM_TX_PROC_CORE1_10MS_NR1_PFC_ID" 13 "MOFFRMCOORRCUST_RX_PROC_CORE1_10MS_NR1_PFC_ID" 63 "MOFFRMCOORRCUST_TX_PROC_CORE1_10MS_NR1_PFC_ID" 16 "MOFHYBRX_CO_PROC_CORE1_10MS_NR1_PFC_ID" 55 "MOFIA_CO_PROC_CORE1_10MS_NR1_PFC_ID" 61 "MOFICO_CO_PROC_CORE1_10MS_NR1_PFC_ID" 15 "MOFIN_CO_PROC_CORE1_10MS_NR1_PFC_ID" 38 "MOFSPDG_CO_PROC_CORE1_10MS_NR1_PFC_ID" 35 "MOFSTRT_CO_PROC_CORE1_10MS_NR1_PFC_ID" 34 "MOFSTRT_IN_PROC_CORE1_10MS_NR1_PFC_ID" 36 "MOFSTRT_RLS_PROC_CORE1_10MS_NR1_PFC_ID" 25 "MOFTENG_CO_PROC_CORE1_10MS_NR1_PFC_ID" 30 "MOFTRA_CO_PROC_CORE1_10MS_NR1_PFC_ID" 56 "MOFTRQACT_ENG_PROC_CORE1_10MS_NR1_PFC_ID" 57 "MOFTRQACT_SUM_PROC_CORE1_10MS_NR1_PFC_ID" 58 "MOFTRQCMP_ENG_PROC_CORE1_10MS_NR1_PFC_ID" 59 "MOFTRQCMP_MAX_PROC_CORE1_10MS_NR1_PFC_ID" 60 "MOFTRQCMP_MIN_PROC_CORE1_10MS_NR1_PFC_ID" 37 "MOFTRQLIM_ENG_PROC_CORE1_10MS_NR1_PFC_ID" 26 "MOFTRQLOS_CO_PROC_CORE1_10MS_NR1_PFC_ID" 44 "MOFTRQPTD_EMAC_PROC_CORE1_10MS_NR1_PFC_ID" 45 "MOFTRQPTD_ENG_PROC_CORE1_10MS_NR1_PFC_ID" 43 "MOFTRQPTD_MAX_PROC_CORE1_10MS_NR1_PFC_ID" 46 "MOFTRQPTD_MIN_PROC_CORE1_10MS_NR1_PFC_ID" 24 "MOFTRQRAT_CO_PROC_CORE1_10MS_NR1_PFC_ID" 18 "MOFVAR_CO_PROC_CORE1_10MS_NR1_PFC_ID" 68 "MOFVAR_POSTBLDSEL_PROC_CORE1_10MS_NR1_PFC_ID" 14 "MOFVEHIFC_IFADP1_PROC_CORE1_10MS_NR1_PFC_ID" 23 "MOFVSS_CO_PROC_CORE1_10MS_NR1_PFC_ID" 62 "MOFWDA_CO_PROC_CORE1_10MS_NR1_PFC_ID" 3 "MOSYSCTRL_CO_PROC_CORE1_10MS_NR1_PFC_ID" /end COMPU_VTAB
/begin COMPU_METHOD nmot_uw_q0p25 "" RAT_FUNC "%6.3" "1/min" COEFFS 0 1 0 0 0 0.25 /end COMPU_METHOD
/begin COMPU_METHOD OneToOne "" RAT_FUNC "%6.2" "-" COEFFS 0 1 0 0 0 1 /end COMPU_METHOD
/begin COMPU_METHOD RBPtCel_ti_0p4_1 "" RAT_FUNC "%6.3" "us" COEFFS 0 5 0 0 0 2 /end COMPU_METHOD
/begin COMPU_METHOD rel_ub_b200 "" RAT_FUNC "%6.3" "%" COEFFS 0 256 0 0 0 200 /end COMPU_METHOD
/begin COMPU_METHOD rel_ub_b99p6 "" RAT_FUNC "%6.3" "%" COEFFS 0 256 0 0 0 100 /end COMPU_METHOD
/begin COMPU_METHOD rel_uw_b100 "" RAT_FUNC "%6.4" "%" COEFFS 0 65536 0 0 0 100 /end COMPU_METHOD
/begin COMPU_METHOD r_prc_q0p003052_COMPU "" RAT_FUNC "%6.4" "%" COEFFS 0 65536 0 0 0 200 /end COMPU_METHOD
/begin COMPU_METHOD spg_q0p00977 "" RAT_FUNC "%6.4" "V" COEFFS 0 256 0 0 0 2.5 /end COMPU_METHOD
/begin COMPU_METHOD spg_q4p88_mV "" RAT_FUNC "%6.2" "mV" COEFFS 0 1024 0 0 0 5000 /end COMPU_METHOD
/begin COMPU_METHOD SY_FEPB_Compu "" TAB_VERB "%6.3" "" COMPU_TAB_REF SY_FEPB_Compu /end COMPU_METHOD
/begin COMPU_VTAB SY_FEPB_Compu "" TAB_VERB 3 0 "NOPCHDET" 1 "PINLETCAM" 2 "PINLETEGR" /end COMPU_VTAB
/begin COMPU_METHOD SY_FFV_Compu "" TAB_VERB "%6.3" "" COMPU_TAB_REF SY_FFV_Compu /end COMPU_METHOD
/begin COMPU_VTAB SY_FFV_Compu "" TAB_VERB 2 0 "kein flexible fuel Fahrzeug" 1 "flexible fuel Fahrzeug" /end COMPU_VTAB
/begin COMPU_METHOD SY_FFZ_Compu "" TAB_VERB "%6.3" "" COMPU_TAB_REF SY_FFZ_Compu /end COMPU_METHOD
/begin COMPU_VTAB SY_FFZ_Compu "" TAB_VERB 2 0 "keine Funkenbandzündung" 1 "Funkenbandzündung vorhanden" /end COMPU_VTAB
/begin COMPU_METHOD SY_FKAT_Compu "" TAB_VERB "%6.3" "" COMPU_TAB_REF SY_FKAT_Compu /end COMPU_METHOD
/begin COMPU_VTAB SY_FKAT_Compu "" TAB_VERB 2 0 "kein Frontkat Bank 1" 1 "Frontkat Bank 1 vorhanden" /end COMPU_VTAB
/begin COMPU_METHOD SY_FLASHON_Compu "" TAB_VERB "%6.3" "" COMPU_TAB_REF SY_FLASHON_Compu /end COMPU_METHOD
/begin COMPU_VTAB SY_FLASHON_Compu "" TAB_VERB 2 0 "FALSE" 1 "TRUE" /end COMPU_VTAB
/begin COMPU_METHOD SY_FLOAKT_Compu "" TAB_VERB "%6.3" "" COMPU_TAB_REF SY_FLOAKT_Compu /end COMPU_METHOD
/begin COMPU_VTAB SY_FLOAKT_Compu "" TAB_VERB 2 0 "False" 1 "True" /end COMPU_VTAB
/begin COMPU_METHOD SY_FLUQ_Compu "" RAT_FUNC "%6.2" "" COEFFS 0 1 0 0 0 1 /end COMPU_METHOD
/begin COMPU_METHOD SY_FNSK_Compu "" TAB_VERB "%6.3" "" COMPU_TAB_REF SY_FNSK_Compu /end COMPU_METHOD
/begin COMPU_VTAB SY_FNSK_Compu "" TAB_VERB 5 0 "Aus" 1 "Ein1" 2 "Ein2" 3 "Ein3" 4 "Ein4" /end COMPU_VTAB
/begin COMPU_METHOD SY_FNSWLK_Compu "" TAB_VERB "%6.3" "" COMPU_TAB_REF SY_FNSWLK_Compu /end COMPU_METHOD
/begin COMPU_VTAB SY_FNSWLK_Compu "" TAB_VERB 2 0 "Aus" 1 "Ein" /end COMPU_VTAB
/begin COMPU_METHOD SY_FOFHEV_Compu "" TAB_VERB "%6.3" "" COMPU_TAB_REF SY_FOFHEV_Compu /end COMPU_METHOD
/begin COMPU_VTAB SY_FOFHEV_Compu "" TAB_VERB 2 0 "not used" 1 "used" /end COMPU_VTAB
/begin COMPU_METHOD SY_FOFSMPN_Compu "" RAT_FUNC "%6.2" "" COEFFS 0 1 0 0 0 1 /end COMPU_METHOD
/begin COMPU_METHOD SY_FPCCPV_Compu "" TAB_VERB "%6.3" "" COMPU_TAB_REF SY_FPCCPV_Compu /end COMPU_METHOD
/begin COMPU_VTAB SY_FPCCPV_Compu "" TAB_VERB 4 0 "00_NO_CPV" 1 "01_PWM_CPV" 2 "02_Linear_CPV" 3 "03_Selectable_Lineal_or_PWM" /end COMPU_VTAB
/begin COMPU_METHOD SY_FPCELPV_Compu "" TAB_VERB "%6.3" "" COMPU_TAB_REF SY_FPCELPV_Compu /end COMPU_METHOD
/begin COMPU_VTAB SY_FPCELPV_Compu "" TAB_VERB 2 0 "False" 1 "True" /end COMPU_VTAB
/begin COMPU_METHOD SY_FPCES_Compu "" TAB_VERB "%6.3" "" COMPU_TAB_REF SY_FPCES_Compu /end COMPU_METHOD
/begin COMPU_VTAB SY_FPCES_Compu "" TAB_VERB 3 0 "Keine Gemisch-Fehlerverdachtserkennung" 1 "Gemisch-Fehlerverdachtserkennung möglich" 2 "Erw. Gemisch-Fehlerverdachtserkennung möglich" /end COMPU_VTAB
/begin COMPU_METHOD SY_FPCGWRK_Compu "" TAB_VERB "%6.3" "" COMPU_TAB_REF SY_FPCGWRK_Compu /end COMPU_METHOD
/begin COMPU_VTAB SY_FPCGWRK_Compu "" TAB_VERB 2 0 "FALSE" 1 "TRUE" /end COMPU_VTAB
/begin COMPU_METHOD SY_FPCIMV_Compu "" TAB_VERB "%6.3" "" COMPU_TAB_REF SY_FPCIMV_Compu /end COMPU_METHOD
/begin COMPU_VTAB SY_FPCIMV_Compu "" TAB_VERB 2 0 "False" 1 "True" /end COMPU_VTAB
/begin COMPU_METHOD SY_FPCLRBN_Compu "" TAB_VERB "%6.3" "" COMPU_TAB_REF SY_FPCLRBN_Compu /end COMPU_METHOD
/begin COMPU_VTAB SY_FPCLRBN_Compu "" TAB_VERB 2 0 "kein langsamer Reset der Beladung bei Notlauf" 1 "Langsamer Reset der Beladung bei Notlauf" /end COMPU_VTAB
/begin COMPU_METHOD SY_FPCMW_Compu "" TAB_VERB "%6.3" "" COMPU_TAB_REF SY_FPCMW_Compu /end COMPU_METHOD
/begin COMPU_VTAB SY_FPCMW_Compu "" TAB_VERB 2 0 "keine Berücksichtigung der Absteuerung" 1 "Berücksichtigung der Absteuerung" /end COMPU_VTAB
/begin COMPU_METHOD SY_FPCPIN_Compu "" TAB_VERB "%6.3" "" COMPU_TAB_REF SY_FPCPIN_Compu /end COMPU_METHOD
/begin COMPU_VTAB SY_FPCPIN_Compu "" TAB_VERB 3 0 "Keine zusätzliche Einleitstelle" 1 "Zusätzliche Einleitstelle vor Verdichter" 2 "Zusätzliche Einleitstelle vor zweitem Verdichter" /end COMPU_VTAB
/begin COMPU_METHOD SY_FPCPR_Compu "" TAB_VERB "%6.3" "" COMPU_TAB_REF SY_FPCPR_Compu /end COMPU_METHOD
/begin COMPU_VTAB SY_FPCPR_Compu "" TAB_VERB 2 0 "Keine Anforderung Saugrohrdruck von Tankentlüftung" 1 "Anforderung des Saugrohrdrucks von Tankentlüftung" /end COMPU_VTAB
/begin COMPU_METHOD SY_FPCSSP_Compu "" TAB_VERB "%6.3" "" COMPU_TAB_REF SY_FPCSSP_Compu /end COMPU_METHOD
/begin COMPU_VTAB SY_FPCSSP_Compu "" TAB_VERB 2 0 "False" 1 "True" /end COMPU_VTAB
/begin COMPU_METHOD SY_FPCSTRQ_Compu "" TAB_VERB "%6.3" "" COMPU_TAB_REF SY_FPCSTRQ_Compu /end COMPU_METHOD
/begin COMPU_VTAB SY_FPCSTRQ_Compu "" TAB_VERB 2 0 "False" 1 "True" /end COMPU_VTAB
/begin COMPU_METHOD SY_FPCTKTM_Compu "" TAB_VERB "%6.3" "" COMPU_TAB_REF SY_FPCTKTM_Compu /end COMPU_METHOD
/begin COMPU_VTAB SY_FPCTKTM_Compu "" TAB_VERB 2 0 "FALSE" 1 "TRUE" /end COMPU_VTAB
/begin COMPU_METHOD SY_FSGFS_Compu "" TAB_VERB "%6.3" "" COMPU_TAB_REF SY_FSGFS_Compu /end COMPU_METHOD
/begin COMPU_VTAB SY_FSGFS_Compu "" TAB_VERB 2 0 "False" 1 "True" /end COMPU_VTAB
/begin COMPU_METHOD SY_FSGM_Compu "" TAB_VERB "%6.3" "" COMPU_TAB_REF SY_FSGM_Compu /end COMPU_METHOD
/begin COMPU_VTAB SY_FSGM_Compu "" TAB_VERB 3 0 "Kennfelder" 1 "Modelle" 2 "Modelle_HFM_über_DSS" /end COMPU_VTAB
/begin COMPU_METHOD SY_FSSKMA_Compu "" TAB_VERB "%6.3" "" COMPU_TAB_REF SY_FSSKMA_Compu /end COMPU_METHOD
/begin COMPU_VTAB SY_FSSKMA_Compu "" TAB_VERB 2 0 "msvkma_off" 1 "msvkma_on" /end COMPU_VTAB
/begin COMPU_METHOD SY_FSSPRCT_Compu "" TAB_VERB "%6.3" "" COMPU_TAB_REF SY_FSSPRCT_Compu /end COMPU_METHOD
/begin COMPU_VTAB SY_FSSPRCT_Compu "" TAB_VERB 2 0 "(0) drehzahlabhängig" 1 "(1) drehzahl- und regeldifferenzabhängig" /end COMPU_VTAB
/begin COMPU_METHOD SY_FSSTPRS_Compu "" TAB_VERB "%6.3" "" COMPU_TAB_REF SY_FSSTPRS_Compu /end COMPU_METHOD
/begin COMPU_VTAB SY_FSSTPRS_Compu "" TAB_VERB 2 0 "False" 1 "True" /end COMPU_VTAB
/begin COMPU_METHOD SY_FSSZPA_Compu "" TAB_VERB "%6.3" "" COMPU_TAB_REF SY_FSSZPA_Compu /end COMPU_METHOD
/begin COMPU_VTAB SY_FSSZPA_Compu "" TAB_VERB 2 0 "msvzpa_off" 1 "msvzpa_on" /end COMPU_VTAB
/begin COMPU_METHOD SY_FSTCAN_Compu "" TAB_VERB "%6.3" "" COMPU_TAB_REF SY_FSTCAN_Compu /end COMPU_METHOD
/begin COMPU_VTAB SY_FSTCAN_Compu "" TAB_VERB 5 0 "Füllstandssignal nicht über CAN" 1 "Füllstandssignal über CAN" 2 "fertig aufbereitetes Füllstandssignal über CAN" 11 "Voltage" 12 "Height" /end COMPU_VTAB
/begin COMPU_METHOD SY_FSTCEI_Compu "" TAB_VERB "%6.3" "" COMPU_TAB_REF SY_FSTCEI_Compu /end COMPU_METHOD
/begin COMPU_VTAB SY_FSTCEI_Compu "" TAB_VERB 5 0 "SY_FSTCEI =0" 1 "SY_FSTCEI =1" 2 "SY_FSTCEI =2" 11 "SY_FSTCEI =11" 12 "SY_FSTCEI =12" /end COMPU_VTAB
/begin COMPU_METHOD SY_FSTK_Compu "" TAB_VERB "%6.3" "" COMPU_TAB_REF SY_FSTK_Compu /end COMPU_METHOD
/begin COMPU_VTAB SY_FSTK_Compu "" TAB_VERB 3 0 "no-correction-interface" 1 "uint8-Interface" 2 "unit16-Interface" /end COMPU_VTAB
/begin COMPU_METHOD SY_FTIVDM_Compu "" TAB_VERB "%6.3" "" COMPU_TAB_REF SY_FTIVDM_Compu /end COMPU_METHOD
/begin COMPU_VTAB SY_FTIVDM_Compu "" TAB_VERB 3 0 "00_NO_FTIV_Available" 1 "01_Closed_when_PoweredOff" 2 "02_Open_when_PoweredOff" /end COMPU_VTAB
/begin COMPU_METHOD SY_FTOFSLS_Compu "" TAB_VERB "%6.3" "" COMPU_TAB_REF SY_FTOFSLS_Compu /end COMPU_METHOD
/begin COMPU_VTAB SY_FTOFSLS_Compu "" TAB_VERB 3 0 "SY_FTOFSLS_0" 1 "SY_FTOFSLS_1" 2 "SY_FTOFSLS_2" /end COMPU_VTAB
/begin COMPU_METHOD SY_FUELVAP_Compu "" TAB_VERB "%6.3" "" COMPU_TAB_REF SY_FUELVAP_Compu /end COMPU_METHOD
/begin COMPU_VTAB SY_FUELVAP_Compu "" TAB_VERB 3 0 "no central bad fuel detection value" 1 "central bad fuel detection value" 2 "central bad fuel value with reset at fuel fill" /end COMPU_VTAB
/begin COMPU_METHOD SY_FWLK_Compu "" TAB_VERB "%6.3" "" COMPU_TAB_REF SY_FWLK_Compu /end COMPU_METHOD
/begin COMPU_VTAB SY_FWLK_Compu "" TAB_VERB 4 0 "Aus0" 1 "Ein1" 2 "Ein2" 3 "Ein3" /end COMPU_VTAB
/begin COMPU_METHOD SY_GAUSD_Compu "" TAB_VERB "%6.3" "" COMPU_TAB_REF SY_GAUSD_Compu /end COMPU_METHOD
/begin COMPU_VTAB SY_GAUSD_Compu "" TAB_VERB 2 0 "Umschaltung Diagnoseschwellen nicht möglich" 1 "Umschaltung Diagnoseschwellen möglich" /end COMPU_VTAB
/begin COMPU_METHOD SY_GDIPFI_Compu "" TAB_VERB "%6.3" "" COMPU_TAB_REF SY_GDIPFI_Compu /end COMPU_METHOD
/begin COMPU_VTAB SY_GDIPFI_Compu "" TAB_VERB 2 0 "False" 1 "True" /end COMPU_VTAB
/begin COMPU_METHOD SY_GP_Compu "" TAB_VERB "%6.3" "" COMPU_TAB_REF SY_GP_Compu /end COMPU_METHOD
/begin COMPU_VTAB SY_GP_Compu "" TAB_VERB 2 0 "Solldrehzahl bei Klima Ein über KL mit tumg" 1 "Solldrehzahl bei Klima Ein über globalen Parameter" /end COMPU_VTAB
/begin COMPU_METHOD SY_GRDWOF_Compu "" RAT_FUNC "%6.2" "" COEFFS 0 1 0 0 0 1 /end COMPU_METHOD
/begin COMPU_METHOD SY_GRDWRT_Compu "" RAT_FUNC "%6.2" "" COEFFS 0 1 0 0 0 1 /end COMPU_METHOD
/begin COMPU_METHOD SY_HDP_Compu "" TAB_VERB "%6.3" "" COMPU_TAB_REF SY_HDP_Compu /end COMPU_METHOD
/begin COMPU_VTAB SY_HDP_Compu "" TAB_VERB 4 0 "keine HDP" 1 "HDP1" 2 "HDP2" 3 "HDP3" /end COMPU_VTAB
/begin COMPU_METHOD SY_HDRFREQ_Compu "" TAB_VERB "%6.3" "" COMPU_TAB_REF SY_HDRFREQ_Compu /end COMPU_METHOD
/begin COMPU_VTAB SY_HDRFREQ_Compu "" TAB_VERB 3 0 "HPCTL20MS" 1 "HPCTL10MS" 2 "Camshaft_synchronous_task" /end COMPU_VTAB
/begin COMPU_METHOD SY_HDST_Compu "" TAB_VERB "%6.3" "" COMPU_TAB_REF SY_HDST_Compu /end COMPU_METHOD
/begin COMPU_VTAB SY_HDST_Compu "" TAB_VERB 2 0 "kein HDST" 1 "HDST" /end COMPU_VTAB
/begin COMPU_METHOD SY_HEV_Compu "" TAB_VERB "%6.3" "" COMPU_TAB_REF SY_HEV_Compu /end COMPU_METHOD
/begin COMPU_VTAB SY_HEV_Compu "" TAB_VERB 8 0 "0" 1 "HEVTYP_SER" 2 "HEVTYP_SERPARL" 3 "HEVTYP_PWRSPLT" 4 "HEVTYP_PARL" 5 "HEVTYP_EAD" 6 "HEVTYP_EDCT" 7 "HEVTYP_PARLSER" /end COMPU_VTAB
/begin COMPU_METHOD SY_HFM2_Compu "" TAB_VERB "%6.3" "" COMPU_TAB_REF SY_HFM2_Compu /end COMPU_METHOD
/begin COMPU_VTAB SY_HFM2_Compu "" TAB_VERB 2 0 "kein zweiter HFM vorhanden" 1 "zweiter HFM vorhanden" /end COMPU_VTAB
/begin COMPU_METHOD SY_HFMFIL_Compu "" TAB_VERB "%6.3" "" COMPU_TAB_REF SY_HFMFIL_Compu /end COMPU_METHOD
/begin COMPU_VTAB SY_HFMFIL_Compu "" TAB_VERB 2 0 "no HFM filter activ" 1 "HFM filter activ" /end COMPU_VTAB
/begin COMPU_METHOD SY_HFMKOMP_Compu "" TAB_VERB "%6.3" "" COMPU_TAB_REF SY_HFMKOMP_Compu /end COMPU_METHOD
/begin COMPU_VTAB SY_HFMKOMP_Compu "" TAB_VERB 9 0 "No_Afs" 1 "Afs_AnIf" 2 "Afs_PwmIf_Corrn" 3 "Afs_PwmIf_WoCorrn" 4 "Afs_PwmIf_DblRng" 5 "Afs_AnIf_SelfDiag" 6 "Afs_SentIf" 7 "Afs_PwmIfWoCorrn_SentIf" 8 "Afs_PwmIfCorrn_SentIf" /end COMPU_VTAB
/begin COMPU_METHOD SY_HFMPANZ_Compu "" TAB_VERB "%6.3" "" COMPU_TAB_REF SY_HFMPANZ_Compu /end COMPU_METHOD
/begin COMPU_VTAB SY_HFMPANZ_Compu "" TAB_VERB 4 0 "No device" 1 "1 device" 2 "2 device" 3 "3 device" /end COMPU_VTAB
/begin COMPU_METHOD SY_HFM_ANZKL_Compu "" TAB_VERB "%6.3" "" COMPU_TAB_REF SY_HFM_ANZKL_Compu /end COMPU_METHOD
/begin COMPU_VTAB SY_HFM_ANZKL_Compu "" TAB_VERB 3 0 "no HFM" 1 "one HFM transfer curve" 2 "two HFM transfer curves" /end COMPU_VTAB
/begin COMPU_METHOD t1msxs_b65p535 "" RAT_FUNC "%6.5" "s" COEFFS 0 65535 0 0 0 65.535 /end COMPU_METHOD
/begin COMPU_METHOD t20ms_ub_b5100 "" RAT_FUNC "%7.2" "ms" COEFFS 0 1 0 0 0 20 /end COMPU_METHOD
/begin COMPU_METHOD Temp_Cels "" RAT_FUNC "%6.1" "deg C" COEFFS 0 10 2731.4 0 0 1 /end COMPU_METHOD
/begin COMPU_METHOD TimeDelay_s "" RAT_FUNC "%6.1" "s" COEFFS 0 0 1 0 0.00023283064365387 0 /end COMPU_METHOD
/begin COMPU_METHOD TransR "" RAT_FUNC "%6.4" "-" COEFFS 0 100 0 0 0 1 /end COMPU_METHOD
/begin COMPU_METHOD Trq "" RAT_FUNC "%6.3" "Nm" COEFFS 0 10 0 0 0 1 /end COMPU_METHOD
/begin COMPU_METHOD TrqPrpHigh "" RAT_FUNC "%6.3" "Nm" COEFFS 0 10 0 0 0 1 /end COMPU_METHOD
/begin COMPU_METHOD tsquant_l "" RAT_FUNC "%6.4" "us" COEFFS 0 20 0 0 0 1 /end COMPU_METHOD
/begin COMPU_METHOD t_q0p05 "" RAT_FUNC "%6.4" "s" COEFFS 0 100 0 0 0 5 /end COMPU_METHOD
/begin COMPU_METHOD t_q0p1 "" RAT_FUNC "%6.3" "s" COEFFS 0 10 0 0 0 1 /end COMPU_METHOD
/begin COMPU_METHOD Vel "" RAT_FUNC "%6.4" "km/h" COEFFS 0 100 0 0 0 1 /end COMPU_METHOD
/begin COMPU_METHOD vfzg_uw_b325 "" RAT_FUNC "%6.4" "km/h" COEFFS 0 65536 0 0 0 325 /end COMPU_METHOD
/begin COMPU_METHOD vfzg_uw_b90_m_DIV_s "" RAT_FUNC "%6.4" "m/s" COEFFS 0 65536 0 0 0 90.278 /end COMPU_METHOD
/begin COMPU_METHOD yaw_rate_real "" RAT_FUNC "%6.2" "rad/s" COEFFS 0 1 0 0 0 1 /end COMPU_METHOD
/begin COMPU_METHOD zw_sb_q0p75 "" RAT_FUNC "%6.3" "Grad KW" COEFFS 0 255 0 0 0 191.25 /end COMPU_METHOD
/begin RECORD_LAYOUT KwUb FNC_VALUES 1 UBYTE COLUMN_DIR DIRECT /end RECORD_LAYOUT
/begin RECORD_LAYOUT RB_Axis_S16 NO_AXIS_PTS_X 1 SWORD AXIS_PTS_X 2 SWORD INDEX_INCR DIRECT /end RECORD_LAYOUT
/begin RECORD_LAYOUT RB_Axis_S8 NO_AXIS_PTS_X 1 SBYTE AXIS_PTS_X 2 SBYTE INDEX_INCR DIRECT /end RECORD_LAYOUT
/begin RECORD_LAYOUT RB_Axis_U16 NO_AXIS_PTS_X 1 UWORD AXIS_PTS_X 2 UWORD INDEX_INCR DIRECT /end RECORD_LAYOUT
/begin RECORD_LAYOUT RB_CurveGroup_S16 FNC_VALUES 1 SWORD COLUMN_DIR DIRECT /end RECORD_LAYOUT
/begin RECORD_LAYOUT RB_CurveGroup_U16 FNC_VALUES 1 UWORD COLUMN_DIR DIRECT /end RECORD_LAYOUT
/begin RECORD_LAYOUT RB_Curve_S16_S16 NO_AXIS_PTS_X 1 SWORD AXIS_PTS_X 2 SWORD INDEX_INCR DIRECT FNC_VALUES 3 SWORD COLUMN_DIR DIRECT /end RECORD_LAYOUT
/begin RECORD_LAYOUT RB_Curve_S16_S8_Static NO_AXIS_PTS_X 1 SWORD AXIS_PTS_X 2 SWORD INDEX_INCR DIRECT FNC_VALUES 3 SBYTE COLUMN_DIR DIRECT STATIC_RECORD_LAYOUT /end RECORD_LAYOUT
/begin RECORD_LAYOUT RB_Curve_S16_U16_Static NO_AXIS_PTS_X 1 SWORD AXIS_PTS_X 2 SWORD INDEX_INCR DIRECT FNC_VALUES 3 UWORD COLUMN_DIR DIRECT STATIC_RECORD_LAYOUT /end RECORD_LAYOUT
/begin RECORD_LAYOUT RB_Curve_S16_U8_Static NO_AXIS_PTS_X 1 SWORD AXIS_PTS_X 2 SWORD INDEX_INCR DIRECT FNC_VALUES 3 UBYTE COLUMN_DIR DIRECT STATIC_RECORD_LAYOUT /end RECORD_LAYOUT
/begin RECORD_LAYOUT RB_Curve_U16_S16_Static NO_AXIS_PTS_X 1 UWORD AXIS_PTS_X 2 UWORD INDEX_INCR DIRECT FNC_VALUES 3 SWORD COLUMN_DIR DIRECT STATIC_RECORD_LAYOUT /end RECORD_LAYOUT
/begin RECORD_LAYOUT RB_Curve_U16_U16 NO_AXIS_PTS_X 1 UWORD AXIS_PTS_X 2 UWORD INDEX_INCR DIRECT FNC_VALUES 3 UWORD COLUMN_DIR DIRECT /end RECORD_LAYOUT
/begin RECORD_LAYOUT RB_FixMap_S16S16_S16 FNC_VALUES 1 SWORD COLUMN_DIR DIRECT /end RECORD_LAYOUT
/begin RECORD_LAYOUT RB_MapGroup_S16 FNC_VALUES 1 SWORD COLUMN_DIR DIRECT /end RECORD_LAYOUT
/begin RECORD_LAYOUT RB_Map_S16U16_U8 NO_AXIS_PTS_X 1 SWORD NO_AXIS_PTS_Y 2 SWORD AXIS_PTS_X 3 SWORD INDEX_INCR DIRECT AXIS_PTS_Y 4 UWORD INDEX_INCR DIRECT FNC_VALUES 5 UBYTE ROW_DIR DIRECT /end RECORD_LAYOUT
/begin RECORD_LAYOUT RB_Map_U16S16_S16 NO_AXIS_PTS_X 1 UWORD NO_AXIS_PTS_Y 2 UWORD AXIS_PTS_X 3 UWORD INDEX_INCR DIRECT AXIS_PTS_Y 4 SWORD INDEX_INCR DIRECT FNC_VALUES 5 SWORD COLUMN_DIR DIRECT /end RECORD_LAYOUT
/begin RECORD_LAYOUT RB_Map_U16S16_U16 NO_AXIS_PTS_X 1 UWORD NO_AXIS_PTS_Y 2 UWORD AXIS_PTS_X 3 UWORD INDEX_INCR DIRECT AXIS_PTS_Y 4 SWORD INDEX_INCR DIRECT FNC_VALUES 5 UWORD COLUMN_DIR DIRECT /end RECORD_LAYOUT
/begin RECORD_LAYOUT RB_ValA_Wu16 FNC_VALUES 1 UWORD COLUMN_DIR DIRECT /end RECORD_LAYOUT
/begin RECORD_LAYOUT RB_ValA_Wu32 FNC_VALUES 1 ULONG COLUMN_DIR DIRECT /end RECORD_LAYOUT
/begin RECORD_LAYOUT RB_ValA_Wu8 FNC_VALUES 1 UBYTE COLUMN_DIR DIRECT /end RECORD_LAYOUT
/begin RECORD_LAYOUT RB_Val_Ws16 FNC_VALUES 1 SWORD COLUMN_DIR DIRECT /end RECORD_LAYOUT
/begin RECORD_LAYOUT RB_Val_Ws32 FNC_VALUES 1 SLONG COLUMN_DIR DIRECT /end RECORD_LAYOUT
/begin RECORD_LAYOUT RB_Val_Ws8 FNC_VALUES 1 SBYTE COLUMN_DIR DIRECT /end RECORD_LAYOUT
/begin RECORD_LAYOUT RB_Val_Wu16 FNC_VALUES 1 UWORD COLUMN_DIR DIRECT /end RECORD_LAYOUT
/begin RECORD_LAYOUT RB_Val_Wu8 FNC_VALUES 1 UBYTE COLUMN_DIR DIRECT /end RECORD_LAYOUT
/begin RECORD_LAYOUT ValA_Wu32 FNC_VALUES 1 ULONG COLUMN_DIR DIRECT /end RECORD_LAYOUT
/begin RECORD_LAYOUT Val_Ws16 FNC_VALUES 1 SWORD COLUMN_DIR DIRECT /end RECORD_LAYOUT
/begin RECORD_LAYOUT Val_Wu16 FNC_VALUES 1 UWORD COLUMN_DIR DIRECT /end RECORD_LAYOUT
/begin RECORD_LAYOUT Val_Wu8 FNC_VALUES 1 UBYTE COLUMN_DIR DIRECT /end RECORD_LAYOUT
/end MODULE
/end PROJECT
