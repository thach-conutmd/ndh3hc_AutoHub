ASAP2_VERSION 1 60
/begin PROJECT MG1CS022 "MG1CS022"
/begin HEADER "" VERSION "MG1CS022_62XSC_V037" PROJECT_NO MG1CS022 /end HEADER
/begin MODULE DIM ""
/begin MOD_COMMON "" BYTE_ORDER MSB_LAST ALIGNMENT_BYTE 1 ALIGNMENT_WORD 2 ALIGNMENT_LONG 4 ALIGNMENT_INT64 4 ALIGNMENT_FLOAT32_IEEE 4 ALIGNMENT_FLOAT64_IEEE 4 DATA_SIZE 32 /end MOD_COMMON
/begin CHARACTERISTIC Com_ctCRingEAT7_C "Calibration Ini value for the EAT7 frame ring counter" VALUE 0x80555B30 RB_Val_Wu8 3.000 OneToOne 0.00 3.000 FORMAT "%5.3" EXTENDED_LIMITS 0.00 255.0 /end CHARACTERISTIC
/begin CHARACTERISTIC Com_dEAT7MaxDiff_C "Maximum difference between 2 message counters of EAT7 for error detection" VALUE 0x80555B31 RB_Val_Wu8 255.0 OneToOne 0.00 255.0 FORMAT "%5.1" /end CHARACTERISTIC
/begin CHARACTERISTIC Com_dEAT7MaxPer_C "Maximum period count for the detection of EAT7 stopped message counter" VALUE 0x80555B32 RB_Val_Wu8 255.0 OneToOne 0.00 255.0 FORMAT "%5.1" /end CHARACTERISTIC
/begin CHARACTERISTIC Com_dEAT8MaxDiff_C "Maximum difference between 2 message counters of EAT8 for error detection" VALUE 0x80555B50 RB_Val_Wu8 255.0 OneToOne 0.00 255.0 FORMAT "%5.1" /end CHARACTERISTIC
/begin CHARACTERISTIC Com_dEAT8MaxPer_C "Maximum period count for the detection of EAT8 stopped message counter" VALUE 0x80555B51 RB_Val_Wu8 255.0 OneToOne 0.00 255.0 FORMAT "%5.1" /end CHARACTERISTIC
/begin CHARACTERISTIC Com_dEATAMaxDiff_C "Application constant for Maximum difference for EATA frame" VALUE 0x80555BB4 RB_Val_Wu8 255.0 OneToOne 0.00 255.0 FORMAT "%5.1" /end CHARACTERISTIC
/begin CHARACTERISTIC Com_dEATAMaxPer_C "Period for EATA frame." VALUE 0x80555BB5 RB_Val_Wu8 255.0 OneToOne 0.00 255.0 FORMAT "%5.1" /end CHARACTERISTIC
/begin CHARACTERISTIC Com_dEATASigSel_C "Signal selection data for EATA frame" VALUE 0x80555BB6 RB_Val_Wu8 255.0 OneToOne 0.00 255.0 FORMAT "%5.1" /end CHARACTERISTIC
/begin CHARACTERISTIC Com_dEATBMaxDiff_C "calibration for Max difference between reception for EATB frame" VALUE 0x80555BB8 RB_Val_Wu8 255.0 OneToOne 0.00 255.0 FORMAT "%5.1" /end CHARACTERISTIC
/begin CHARACTERISTIC Com_dEATBMaxPer_C "calibration for error for EATB frame" VALUE 0x80555BB9 RB_Val_Wu8 255.0 OneToOne 0.00 255.0 FORMAT "%5.1" /end CHARACTERISTIC
/begin CHARACTERISTIC Com_dEATCMaxDiff_C "Ring Counter Diff for EATC" VALUE 0x80555BD8 RB_Val_Wu8 255.0 OneToOne 0.00 255.0 FORMAT "%5.1" /end CHARACTERISTIC
/begin CHARACTERISTIC Com_dEATCMaxPer_C "Ring Counter period for EATC" VALUE 0x80555BD9 RB_Val_Wu8 255.0 OneToOne 0.00 255.0 FORMAT "%5.1" /end CHARACTERISTIC
/begin CHARACTERISTIC Com_ErrDeb_FailSafeA_TmrEAT7_C "Timer Calibration after which Fail Safe A values would be assigned to messages when error is in DEBOUNCING state" VALUE 0x80555B34 RB_Val_Ws32 21474836470.0 Time_ms 0.00 21474836470.0 FORMAT "%13.1" EXTENDED_LIMITS -21474836480.0 21474836470.0 /end CHARACTERISTIC
/begin CHARACTERISTIC Com_nTrbn_C "calibration for Gbx_nTrbn" VALUE 0x80555B38 RB_Val_Wu16 16383.75 DFES_nPID0C 0.00 16383.75 FORMAT "%8.2" /end CHARACTERISTIC
/begin CHARACTERISTIC Com_numCsumEAT7_C "Calibration Ini value for the EAT7 frame ring counterChecksum" VALUE 0x80555B3A RB_Val_Wu8 15.00 OneToOne 0.00 15.00 FORMAT "%5.2" EXTENDED_LIMITS 0.00 255.0 /end CHARACTERISTIC
/begin CHARACTERISTIC Com_rConvSlipHiLimHysHi_C "High limit hysteresis high of Torque convertor slip ratio" VALUE 0x80555B52 RB_Val_Wu16 327.6750 CrCtlSlipRat 0.00 327.6750 FORMAT "%8.4" /end CHARACTERISTIC
/begin CHARACTERISTIC Com_rConvSlipHiLimHysLo_C "High limit hysteresis low of Torque convertor slip ratio" VALUE 0x80555B54 RB_Val_Wu16 327.6750 CrCtlSlipRat 0.00 327.6750 FORMAT "%8.4" /end CHARACTERISTIC
/begin CHARACTERISTIC Com_rConvSlipLoLimHysHi_C "Low limit hysteresis high of Torque convertor slip ratio" VALUE 0x80555B56 RB_Val_Wu16 327.6750 CrCtlSlipRat 0.00 327.6750 FORMAT "%8.4" /end CHARACTERISTIC
/begin CHARACTERISTIC Com_rConvSlipLoLimHysLo_C "Low limit hysteresis low of Torque convertor slip ratio" VALUE 0x80555B58 RB_Val_Wu16 327.6750 CrCtlSlipRat 0.00 327.6750 FORMAT "%8.4" /end CHARACTERISTIC
/begin CHARACTERISTIC Com_rTarPllyEAT7_C "Calibration for Target pulley ratio" VALUE 0x80555B3B RB_Val_Wu8 3.984 TransR_COMPU 0.00 3.984 FORMAT "%5.3" /end CHARACTERISTIC
/begin CHARACTERISTIC Com_rTrqCnvBoostDef_C "default value of VSA Torque Accuracy Improvement" VALUE 0x80555B5A RB_Val_Wu16 655.3500 TransR 0.00 655.3500 FORMAT "%8.4" /end CHARACTERISTIC
/begin CHARACTERISTIC Com_stAntiJerkCtrl_CW1 "Calibration select the application of each status 1" VALUE 0x80555B5C RB_Val_Wu32 4294967295.00 OneToOne 0.00 4294967295.00 FORMAT "%13.2" /end CHARACTERISTIC
/begin CHARACTERISTIC Com_stAntiJerkCtrl_CW2 "Calibration select the application of each status 2" VALUE 0x80555B60 RB_Val_Wu32 4294967295.00 OneToOne 0.00 4294967295.00 FORMAT "%13.2" /end CHARACTERISTIC
/begin CHARACTERISTIC Com_stCVTFailrInfo_C "default calibration value for CVT failur information" VALUE 0x80555BBA RB_Val_Wu8 255.0 OneToOne 0.00 255.0 FORMAT "%5.1" /end CHARACTERISTIC
/begin CHARACTERISTIC Com_stCVTShiftActv_C "default calibration value forCVT Shift Active status" VALUE 0x80555BBB RB_Val_Wu8 255.0 OneToOne 0.00 255.0 FORMAT "%5.1" /end CHARACTERISTIC
/begin CHARACTERISTIC Com_stEATBCrkMask_C "Cranking Mask information of EATB information" VALUE 0x80555BBC RB_Val_Wu8 255.0 OneToOne 0.00 255.0 FORMAT "%5.1" /end CHARACTERISTIC
/begin CHARACTERISTIC Com_stMilLtgReq_C "default calibration value for MIL lighting request from transmission" VALUE 0x80555BBD RB_Val_Wu8 255.0 OneToOne 0.00 255.0 FORMAT "%5.1" /end CHARACTERISTIC
/begin CHARACTERISTIC Com_stMissSnsrFlg_C "default calibration value for Missing Sensor Flag" VALUE 0x80555BBE RB_Val_Wu8 255.0 OneToOne 0.00 255.0 FORMAT "%5.1" /end CHARACTERISTIC
/begin CHARACTERISTIC Com_stNoShftSel_C "Calibration for NO SHIFT selection" VALUE 0x80555BBF RB_Val_Wu8 1.000 OneToOne 0.00 1.000 FORMAT "%5.3" EXTENDED_LIMITS 0.00 255.0 /end CHARACTERISTIC
/begin CHARACTERISTIC Com_stShftInNeutr_C "Actual transmission position for N-range in case of system errors for TCU02 frame" VALUE 0x80555BC0 RB_Val_Wu8 1.000 OneToOne 0.00 1.000 FORMAT "%5.3" EXTENDED_LIMITS 0.00 255.0 /end CHARACTERISTIC
/begin CHARACTERISTIC Com_stShftInPark_C "Actual transmission position for P-range in case of system errors for TCU02 frame" VALUE 0x80555BC1 RB_Val_Wu8 1.000 OneToOne 0.00 1.000 FORMAT "%5.3" EXTENDED_LIMITS 0.00 255.0 /end CHARACTERISTIC
/begin CHARACTERISTIC Com_stShftSel0_C "Calibration for shift detection priority to check if bit0 of Com_stEATBByte0Info is set" VALUE 0x80555BC2 RB_Val_Wu8 255.0 OneToOne 0.00 255.0 FORMAT "%5.1" /end CHARACTERISTIC
/begin CHARACTERISTIC Com_stShftSel1_C "Calibration for shift detection priority to check bit1 of Com_stEATBByte0Info is set" VALUE 0x80555BC3 RB_Val_Wu8 255.0 OneToOne 0.00 255.0 FORMAT "%5.1" /end CHARACTERISTIC
/begin CHARACTERISTIC Com_stShftSel2_C "Calibration for shift detection priority to check bit2 of Com_stEATBByte0Info is set" VALUE 0x80555BC4 RB_Val_Wu8 255.0 OneToOne 0.00 255.0 FORMAT "%5.1" /end CHARACTERISTIC
/begin CHARACTERISTIC Com_stShftSel3_C "Calibration for shift detection priority to check bit3 of Com_stEATBByte0Info is set" VALUE 0x80555BC5 RB_Val_Wu8 255.0 OneToOne 0.00 255.0 FORMAT "%5.1" /end CHARACTERISTIC
/begin CHARACTERISTIC Com_stShftSel4_C "Calibration for shift detection priority to check bit4 of Com_stEATBByte0Info is set" VALUE 0x80555BC6 RB_Val_Wu8 255.0 OneToOne 0.00 255.0 FORMAT "%5.1" /end CHARACTERISTIC
/begin CHARACTERISTIC Com_stShftSel5_C "Calibration for shift detection priority to check bit5 of Com_stEATBByte0Info is set" VALUE 0x80555BC7 RB_Val_Wu8 255.0 OneToOne 0.00 255.0 FORMAT "%5.1" /end CHARACTERISTIC
/begin CHARACTERISTIC Com_stSpdSnsrFailr_C "default calibration value for Speed Sensor Failure" VALUE 0x80555BC8 RB_Val_Wu8 255.0 OneToOne 0.00 255.0 FORMAT "%5.1" /end CHARACTERISTIC
/begin CHARACTERISTIC Com_stVehSpdSnsr_C "default calibration value for CVT vehicle speed sensor" VALUE 0x80555BC9 RB_Val_Wu8 255.0 OneToOne 0.00 255.0 FORMAT "%5.1" /end CHARACTERISTIC
/begin CHARACTERISTIC Com_swtCrkCdn_C "calibration switch Auto Manual cranking" VALUE 0x80555BCA RB_Val_Wu8 255.0 OneToOne 0.00 255.0 FORMAT "%5.1" /end CHARACTERISTIC
/begin CHARACTERISTIC Com_swtEAT7MonEna_C "EAT7 error monitoring enable switch" VALUE 0x80555B3C RB_Val_Wu8 1.000 OneToOne 0.00 1.000 FORMAT "%5.3" EXTENDED_LIMITS 0.00 255.0 /end CHARACTERISTIC
/begin CHARACTERISTIC Com_swtEAT8MonEna_C "EAT8 error monitoring enable switch" VALUE 0x80555B64 RB_Val_Wu8 1.000 OneToOne 0.00 1.000 FORMAT "%5.3" EXTENDED_LIMITS 0.00 255.0 /end CHARACTERISTIC
/begin CHARACTERISTIC Com_swtEATAMonEna_C "EATA error monitoring enable switch" VALUE 0x80555BB7 RB_Val_Wu8 1.000 OneToOne 0.00 1.000 FORMAT "%5.3" EXTENDED_LIMITS 0.00 255.0 /end CHARACTERISTIC
/begin CHARACTERISTIC Com_swtEATBMonEna_C "EATB error monitoring enable switch" VALUE 0x80555BCB RB_Val_Wu8 1.000 OneToOne 0.00 1.000 FORMAT "%5.3" EXTENDED_LIMITS 0.00 255.0 /end CHARACTERISTIC
/begin CHARACTERISTIC Com_swtPTRatTrqCnv_C "switch value of Com_swtPTRatTrqCnv_C" VALUE 0x80555B65 RB_Val_Wu8 255.0 OneToOne 0.00 255.0 FORMAT "%5.1" /end CHARACTERISTIC
/begin CHARACTERISTIC Com_swtShiftPosn_C "calibration used for status of gear position" VALUE 0x80555BCC RB_Val_Wu8 255.0 OneToOne 0.00 255.0 FORMAT "%5.1" /end CHARACTERISTIC
/begin CHARACTERISTIC Com_tiCanDebTmr_C "Calibration to recognize CAN disconnection error" VALUE 0x80555BCE RB_Val_Ws16 32770.00 Time_ms 0.00 32770.00 FORMAT "%8.2" EXTENDED_LIMITS -327680.0 327670.0 /end CHARACTERISTIC
/begin CHARACTERISTIC Com_tiEngTrq_CUR "Time delay after enable anti-jerk torque convertor slip flag" CURVE 0x80555B66 RB_Curve_S16_U16_Static 655.3500 t_q0p01 0.00 655.3500 FORMAT "%8.4"
 /begin AXIS_DESCR STD_AXIS Com_trqEngTrq md_q0p1 8 -3276.800 3276.700 FORMAT "%8.3" DEPOSIT ABSOLUTE /end AXIS_DESCR
/end CHARACTERISTIC
/begin CHARACTERISTIC Com_trqBoost_CUR "curve for VSA Torque Accuracy Improvement" CURVE 0x80555B88 RB_Curve_U16_U16 327.6800 TransR 0.00 327.6800 FORMAT "%8.4" EXTENDED_LIMITS 0.00 655.3500
 /begin AXIS_DESCR STD_AXIS Com_rConvSlip CrCtlSlipRat 10 0.00 327.6750 FORMAT "%8.4" DEPOSIT ABSOLUTE /end AXIS_DESCR
/end CHARACTERISTIC
/begin CHARACTERISTIC CVT_SHFT_IN_D_C "Calibration for status of position D for shifting operation." VALUE 0x80555BD0 RB_Val_Wu8 255.0 OneToOne 0.00 255.0 FORMAT "%5.1" /end CHARACTERISTIC
/begin CHARACTERISTIC CVT_SHFT_IN_L_C "Calibration for status of position L for shifting operation." VALUE 0x80555BD1 RB_Val_Wu8 255.0 OneToOne 0.00 255.0 FORMAT "%5.1" /end CHARACTERISTIC
/begin CHARACTERISTIC CVT_SHFT_IN_NEUTRAL_C "Calibration for Shift in Neutral Parking" VALUE 0x80555BD2 RB_Val_Wu8 255.0 OneToOne 0.00 255.0 FORMAT "%5.1" /end CHARACTERISTIC
/begin CHARACTERISTIC CVT_SHFT_IN_NO_C "calibration for NO shift in parking" VALUE 0x80555BD3 RB_Val_Wu8 255.0 OneToOne 0.00 255.0 FORMAT "%5.1" /end CHARACTERISTIC
/begin CHARACTERISTIC CVT_SHFT_IN_PARKING_C "Calibration for Shift in Parking" VALUE 0x80555BD4 RB_Val_Wu8 255.0 OneToOne 0.00 255.0 FORMAT "%5.1" /end CHARACTERISTIC
/begin CHARACTERISTIC CVT_SHFT_IN_REVERSE_C "Calibration for Shift in Reverse Parking" VALUE 0x80555BD5 RB_Val_Wu8 255.0 OneToOne 0.00 255.0 FORMAT "%5.1" /end CHARACTERISTIC
/begin CHARACTERISTIC CVT_SHFT_IN_S_C "Calibration for status of position S for shifting operation." VALUE 0x80555BD6 RB_Val_Wu8 255.0 OneToOne 0.00 255.0 FORMAT "%5.1" /end CHARACTERISTIC
/begin CHARACTERISTIC DWGVOKE "Offset: gas exch. valve intake opens 1mm -> 0.5mm for low cam stroke" VALUE 0x8055079A RB_Val_Ws16 1023.984 kw_q0p0156 -512.0000 511.9844 FORMAT "%8.4" /end CHARACTERISTIC
/begin CHARACTERISTIC DWOGVKE "Open angle: gas exch. vlv. intake closes to intake opens low cam stroke" VALUE 0x8055079C RB_Val_Ws16 1023.984 kw_q0p0156 -512.0000 511.9844 FORMAT "%8.4" /end CHARACTERISTIC
/begin CHARACTERISTIC GbxPNPos_stPNSwtInv_C "Invert Calibration to chose between the debounced ST pin status." VALUE 0x80555C2C RB_Val_Wboolean 1.00000000000 B_TRUE 0.00 1.00000000000 FORMAT "%13.11" /end CHARACTERISTIC
/begin CHARACTERISTIC GbxPNPos_tiDebHiLo_C "High to Low debouncing time for PN Position raw signal" VALUE 0x80555C2E RB_Val_Ws16 655.3500 Time_s -327.6800 327.6700 FORMAT "%8.4" /end CHARACTERISTIC
/begin CHARACTERISTIC GbxPNPos_tiDebLoHi_C "Low to High debouncing time for PN Position raw signal" VALUE 0x80555C30 RB_Val_Ws16 655.3500 Time_s -327.6800 327.6700 FORMAT "%8.4" /end CHARACTERISTIC
/begin CHARACTERISTIC Gbx_cntrNeutPosnCANPlausErr_C "Maximum threshold Counter for the no.of times the plausibility error happened" VALUE 0x80555BDA RB_Val_Wu16 65535.00 OneToOne 0.00 65535.00 FORMAT "%8.2" /end CHARACTERISTIC
/begin CHARACTERISTIC Gbx_facCorrlnAnaNPos_C "Factor for the correlation of neutral position analog sensor 1" VALUE 0x80555BDC RB_Val_Ws16 7.999878 Fact -4.000000 3.999878 FORMAT "%8.6" /end CHARACTERISTIC
/begin CHARACTERISTIC Gbx_lDiffDst_C "Threshold of distance after detection of reverse switch ON stuck error" VALUE 0x80555C40 RB_Val_Ws16 3276.700 LengthKm_q0p1 0.00 3276.700 FORMAT "%8.3" EXTENDED_LIMITS -3276.800 3276.700 /end CHARACTERISTIC
/begin CHARACTERISTIC Gbx_nIdlDesTrsmFail_C "Calibration for transmission fail safe value of synchronized desired engine speed" VALUE 0x80555B3E RB_Val_Ws16 32767.50 EngN -16384.00 16383.50 FORMAT "%8.2" /end CHARACTERISTIC
/begin CHARACTERISTIC Gbx_nIdlDes_FailSafeA_C "Fail Safe A calibration value assigned to Gbx_nIdlDes when error is in DEBOUNCING state" VALUE 0x80555B40 RB_Val_Ws16 32767.50 EngN -16384.00 16383.50 FORMAT "%8.2" /end CHARACTERISTIC
/begin CHARACTERISTIC Gbx_nIdlDes_FailSafeB_C "Fail Safe B calibration value assigned to Gbx_nIdlDes when error is in DEBOUNCING state" VALUE 0x80555B42 RB_Val_Ws16 32767.50 EngN -16384.00 16383.50 FORMAT "%8.2" /end CHARACTERISTIC
/begin CHARACTERISTIC Gbx_nMaxEngFcoTrsmFail_C "Calibration for transmission fail safe value of maximum engine speed limitation request (FuelCut Control)" VALUE 0x80555B44 RB_Val_Ws16 32767.50 EngN -16384.00 16383.50 FORMAT "%8.2" /end CHARACTERISTIC
/begin CHARACTERISTIC Gbx_nMaxEngFco_FailSafeA_C "Fail Safe A calibration value assigned to Gbx_nMaxEngFco when error is in DEBOUNCING state" VALUE 0x80555B46 RB_Val_Ws16 32767.50 EngN -16384.00 16383.50 FORMAT "%8.2" /end CHARACTERISTIC
/begin CHARACTERISTIC Gbx_nMaxEngFco_FailSafeB_C "Fail Safe B calibration value assigned to Gbx_nMaxEngFco when error is in DEBOUNCING state" VALUE 0x80555B48 RB_Val_Ws16 32767.50 EngN -16384.00 16383.50 FORMAT "%8.2" /end CHARACTERISTIC
/begin CHARACTERISTIC Gbx_nMaxEngTrqLimTrsmFail_C "Calibration for transmission fail safe value of maximum engine speed limitation request (Torque Control)" VALUE 0x80555B4A RB_Val_Ws16 32767.50 EngN -16384.00 16383.50 FORMAT "%8.2" /end CHARACTERISTIC
/begin CHARACTERISTIC Gbx_nMaxEngTrqLim_FailSafeA_C "Fail Safe A calibration value assigned to Gbx_nMaxEngTrqLim when error is in DEBOUNCING state" VALUE 0x80555B4C RB_Val_Ws16 32767.50 EngN -16384.00 16383.50 FORMAT "%8.2" /end CHARACTERISTIC
/begin CHARACTERISTIC Gbx_nMaxEngTrqLim_FailSafeB_C "Fail Safe B calibration value assigned to Gbx_nMaxEngTrqLim when error is in DEBOUNCING state" VALUE 0x80555B4E RB_Val_Ws16 32767.50 EngN -16384.00 16383.50 FORMAT "%8.2" /end CHARACTERISTIC
/begin CHARACTERISTIC Gbx_nPNPosnDiagDrvCdnThd_C "Engine speed threshold for Park Neutral Switch diagnosis in vehicle drive condition" VALUE 0x80555C32 RB_Val_Ws16 32767.50 EngN -16384.00 16383.50 FORMAT "%8.2" /end CHARACTERISTIC
/begin CHARACTERISTIC Gbx_nPNPosnDiagPlausyThd_C "Engine speed threshold for Park Neutral Switch plausibility diagnosis" VALUE 0x80555C34 RB_Val_Ws16 32767.50 EngN -16384.00 16383.50 FORMAT "%8.2" /end CHARACTERISTIC
/begin CHARACTERISTIC Gbx_numMaxNPosAlv_C "Counter threshold for alive check" VALUE 0x80555BDE RB_Val_Wu8 255.0 OneToOne 0.00 255.0 FORMAT "%5.1" /end CHARACTERISTIC
/begin CHARACTERISTIC Gbx_rPNPosnDiagAccPedlThd_C "Accelerator Pedal Position threshold for Park Neutral Switch diagnosis in vehicle drive condition" VALUE 0x80555C36 RB_Val_Ws16 799.9878 Prc -400.0000 399.9878 FORMAT "%8.4" /end CHARACTERISTIC
/begin CHARACTERISTIC Gbx_RvsPosDeb.tiHiLo_C "Debouncing Parameters structure for Gearbox reverse position switch / Time for a High to Low transition" VALUE 0x80591530 Kw_Ws16 655350.0 TimeDeb -327680.0 327670.0 FORMAT "%8.1" /end CHARACTERISTIC
/begin CHARACTERISTIC Gbx_RvsPosDeb.tiLoHi_C "Debouncing Parameters structure for Gearbox reverse position switch / Time for a Low to High transition" VALUE 0x80591532 Kw_Ws16 655350.0 TimeDeb -327680.0 327670.0 FORMAT "%8.1" /end CHARACTERISTIC
/begin CHARACTERISTIC Gbx_stNeut_C "Calibratable parameter- Neutral inserted" VALUE 0x80555BDF RB_Val_Wu8 255.0 OneToOne 0.00 255.0 FORMAT "%5.1" /end CHARACTERISTIC
/begin CHARACTERISTIC Gbx_stNotNeut_C "Calibratable parameter- Neutral not inserted" VALUE 0x80555BE0 RB_Val_Wu8 255.0 OneToOne 0.00 255.0 FORMAT "%5.1" /end CHARACTERISTIC
/begin CHARACTERISTIC Gbx_stSwtCfgNeutPosn_C "Neutral position configuration switch status" VALUE 0x80555BE1 RB_Val_Wu8 255.0 OneToOne 0.00 255.0 FORMAT "%5.1" /end CHARACTERISTIC
/begin CHARACTERISTIC Gbx_swtRvsPosPrs_C "Gearbox Reverse Position selection switch" VALUE 0x80555C42 RB_Val_Wu8 1.000 OneToOne 0.00 1.000 FORMAT "%5.3" EXTENDED_LIMITS 0.00 255.0 /end CHARACTERISTIC
/begin CHARACTERISTIC Gbx_swtRvsSwtStkEna_C "Selection switch for reverse switch ON stuck error" VALUE 0x80555C43 RB_Val_Wu8 1.000 OneToOne 0.00 1.000 FORMAT "%5.3" EXTENDED_LIMITS 0.00 255.0 /end CHARACTERISTIC
/begin CHARACTERISTIC Gbx_swtSigInpLogic_C "Calibration to select the inversion logic for digital input" VALUE 0x80555BE2 RB_Val_Wu8 255.0 OneToOne 0.00 255.0 FORMAT "%5.1" /end CHARACTERISTIC
/begin CHARACTERISTIC Gbx_swtSigNeutPosn_C "Switch to select either from CAN input, Digital and CAN input OR Analog inputs." VALUE 0x80555BE3 RB_Val_Wu8 255.0 OneToOne 0.00 255.0 FORMAT "%5.1" /end CHARACTERISTIC
/begin CHARACTERISTIC Gbx_tiDigNeutPosnOffDeb_C "High to Low debounce parameter for digital input signal" VALUE 0x80555BE4 RB_Val_Wu16 655350.0 TimeDeb 0.00 655350.0 FORMAT "%8.1" /end CHARACTERISTIC
/begin CHARACTERISTIC Gbx_tiDigNeutPosnOnDeb_C "Low to High debounce parameter for digital input signal" VALUE 0x80555BE6 RB_Val_Wu16 655350.0 TimeDeb 0.00 655350.0 FORMAT "%8.1" /end CHARACTERISTIC
/begin CHARACTERISTIC Gbx_tiNeutInsertedDly_C "Time after which CAN signal is checked if it matches with digital signal which already shows neutral inserted" VALUE 0x80555BE8 RB_Val_Wu16 655.3500 Time_s 0.00 655.3500 FORMAT "%8.4" /end CHARACTERISTIC
/begin CHARACTERISTIC Gbx_tiNeutNotInsertedDly_C "Time after which CAN signal is checked if it matches with digital signal which already shows neutral not inserted" VALUE 0x80555BEA RB_Val_Wu16 655.3500 Time_s 0.00 655.3500 FORMAT "%8.4" /end CHARACTERISTIC
/begin CHARACTERISTIC Gbx_tiNeutPosnDebHiLo_C "High to Low debounce for analog sensor if it is within upper and lower thresholds" VALUE 0x80555BEC RB_Val_Wu16 655350.0 TimeDeb 0.00 655350.0 FORMAT "%8.1" /end CHARACTERISTIC
/begin CHARACTERISTIC Gbx_tiNeutPosnDebLoHi_C "Low to High debounce for analog sensor if it is within upper and lower thresholds" VALUE 0x80555BEE RB_Val_Wu16 655350.0 TimeDeb 0.00 655350.0 FORMAT "%8.1" /end CHARACTERISTIC
/begin CHARACTERISTIC Gbx_tiRvsSwtStk_C "Delay time for detection of normal behaviour of reverse switch" VALUE 0x80555C44 RB_Val_Ws16 327670.0 Time_ms 0.00 327670.0 FORMAT "%8.1" EXTENDED_LIMITS -327680.0 327670.0 /end CHARACTERISTIC
/begin CHARACTERISTIC Gbx_trqPNPosnDiagTqThd_C "Engine torque threshold for Park Neutral Switch diagnosis in vehicle drive condition" VALUE 0x80555C38 RB_Val_Ws16 6553.500 Trq -3276.800 3276.700 FORMAT "%8.3" /end CHARACTERISTIC
/begin CHARACTERISTIC Gbx_uAn1NeutPosnRawTmp_C "Init value for Analog voltage raw value from sensor1" VALUE 0x80555BF0 RB_Val_Ws16 13107.00 Volt -6553.600 6553.400 FORMAT "%8.3" /end CHARACTERISTIC
/begin CHARACTERISTIC Gbx_uAn1SRCMax_C "Analog sensor1 max SRC threshold" VALUE 0x80555BF2 RB_Val_Ws16 13107.00 Volt -6553.600 6553.400 FORMAT "%8.3" /end CHARACTERISTIC
/begin CHARACTERISTIC Gbx_uAn1SRCMin_C "Analog sensor1 min SRC threshold" VALUE 0x80555BF4 RB_Val_Ws16 13107.00 Volt -6553.600 6553.400 FORMAT "%8.3" /end CHARACTERISTIC
/begin CHARACTERISTIC Gbx_uAn2SRCMax_C "Analog sensor2 max SRC threshold" VALUE 0x80555BF6 RB_Val_Ws16 13107.00 Volt -6553.600 6553.400 FORMAT "%8.3" /end CHARACTERISTIC
/begin CHARACTERISTIC Gbx_uAn2SRCMin_C "Analog sensor2 max SRC threshold" VALUE 0x80555BF8 RB_Val_Ws16 13107.00 Volt -6553.600 6553.400 FORMAT "%8.3" /end CHARACTERISTIC
/begin CHARACTERISTIC Gbx_uCorrlnMaxDiffAnSnsr_CUR "Maximum allowed difference of analog sensors 1 and 2" CURVE 0x80555BFA RB_Curve_S16_S16 13107.00 Volt -6553.600 6553.400 FORMAT "%8.3"
 /begin AXIS_DESCR STD_AXIS Gbx_uAna1NPosRaw Volt 11 -6553.600 6553.400 FORMAT "%8.3" DEPOSIT ABSOLUTE /end AXIS_DESCR
/end CHARACTERISTIC
/begin CHARACTERISTIC Gbx_uNeutPosnRngHi_C "Analog sensor higher threshold range" VALUE 0x80555C28 RB_Val_Ws16 13107.00 Volt -6553.600 6553.400 FORMAT "%8.3" /end CHARACTERISTIC
/begin CHARACTERISTIC Gbx_uNeutPosnRngLo_C "Analog sensor lower threshold range" VALUE 0x80555C2A RB_Val_Ws16 13107.00 Volt -6553.600 6553.400 FORMAT "%8.3" /end CHARACTERISTIC
/begin CHARACTERISTIC Gbx_uPNPosnDiagThdHi_C "Battery upper threshold for all Park Neutral Switch diagnosis" VALUE 0x80555C3A RB_Val_Ws16 1310700. Volt_Batt -655360.0 655340.0 FORMAT "%8.1" /end CHARACTERISTIC
/begin CHARACTERISTIC Gbx_uPNPosnDiagThdLo_C "Battery lower threshold for all Park Neutral Switch diagnosis" VALUE 0x80555C3C RB_Val_Ws16 1310700. Volt_Batt -655360.0 655340.0 FORMAT "%8.1" /end CHARACTERISTIC
/begin CHARACTERISTIC Gbx_uRvsSwtStk_C "Battery voltage threshold for reverse switch ON stuck error" VALUE 0x80555C46 RB_Val_Ws16 655340.0 Volt_Batt 0.00 655340.0 FORMAT "%8.1" EXTENDED_LIMITS -655360.0 655340.0 /end CHARACTERISTIC
/begin CHARACTERISTIC Gbx_vPNPosnDiagVThd_C "Vehicle speed threshold for Park Neutral Switch diagnosis in vehicle drive condition" VALUE 0x80555C3E RB_Val_Ws16 655.3500 Vel -327.6800 327.6700 FORMAT "%8.4" /end CHARACTERISTIC
/begin CHARACTERISTIC GEVCtl_agGrdtErrSimMaxIntk_C "Maximum setpoint ramp angle in slow ramping error simulation for intake" VALUE 0x805507B8 RB_Val_Ws16 1023.984 kw_q0p0156 -512.0000 511.9844 FORMAT "%8.4" /end CHARACTERISTIC
/begin CHARACTERISTIC GEVCtl_agGrdtErrSimMinIntk_C "Minimum setpoint ramp angle in slow ramping error simulation for intake" VALUE 0x805507BA RB_Val_Ws16 1023.984 kw_q0p0156 -512.0000 511.9844 FORMAT "%8.4" /end CHARACTERISTIC
/begin CHARACTERISTIC GEVCtl_agOffsSpcltoStdLftIntk_C "Angle offset low to high cam profile (inlet)" VALUE 0x80550D1C RB_Val_Ws16 1023.984 kw_q0p0156 -512.0000 511.9844 FORMAT "%8.4" /end CHARACTERISTIC
/begin CHARACTERISTIC GEVCtl_agPhaLockPosnRngIntk_C "Angle range: long hole of lock position (intake camshaft)" VALUE 0x80554718 RB_Val_Ws16 1023.984 kw_q0p0156 -512.0000 511.9844 FORMAT "%8.4" /end CHARACTERISTIC
/begin CHARACTERISTIC GEVCtl_agPhaMinDstToUnLckIntk_C "Min. dist. f. des. angle intk. CmS to leave lock position" VALUE 0x8055471A RB_Val_Ws16 1023.984 kw_q0p0156 -512.0000 511.9844 FORMAT "%8.4" /end CHARACTERISTIC
/begin CHARACTERISTIC GEVCtl_agPtdDePhaLockgPosnIntk_C "Permitted deviation of the intake camshaft from the locking position" VALUE 0x80550A18 RB_Val_Wu8 127.5 kw_q0p5 0.00 127.5 FORMAT "%5.1" /end CHARACTERISTIC
/begin CHARACTERISTIC GEVCtl_agSpAdvClngIntk_C "Advanced position of the intake camshaft for setpoint jumps during cleaning" VALUE 0x805546FC RB_Val_Ws16 1023.984 kw_q0p0156 -512.0000 511.9844 FORMAT "%8.4" /end CHARACTERISTIC
/begin CHARACTERISTIC GEVCtl_agSpCalSuprtAdvIntk_C "Early position for calibrated setpoint jumps intake" VALUE 0x805507BC RB_Val_Ws16 1023.984 kw_q0p0156 -512.0000 511.9844 FORMAT "%8.4" /end CHARACTERISTIC
/begin CHARACTERISTIC GEVCtl_agSpCalSuprtIntk_C "Fixed calibrated setpoint value intake" VALUE 0x805507BE RB_Val_Ws16 1023.984 kw_q0p0156 -512.0000 511.9844 FORMAT "%8.4" /end CHARACTERISTIC
/begin CHARACTERISTIC GEVCtl_agSpCalSuprtIntk_GM "Calibrated setpoint angle map intake" MAP 0x805507C0 RB_MapGroup_S16 1023.984 kw_q0p0156 -512.0000 511.9844 FORMAT "%8.4"
 /begin AXIS_DESCR COM_AXIS Epm_nEng EngN 16 -16384.00 16383.50 FORMAT "%8.2" AXIS_PTS_REF GEVCtl_nEng_Ax /end AXIS_DESCR
 /begin AXIS_DESCR COM_AXIS GEVCtl_ratLoad rel_uw_q0p0234 16 0.00 1535.977 FORMAT "%8.3" AXIS_PTS_REF GEVCtl_ratLoad_Ax /end AXIS_DESCR
/end CHARACTERISTIC
/begin CHARACTERISTIC GEVCtl_agSpCalSuprtRtdIntk_C "Late position for calibrated setpoint jumps intake" VALUE 0x805509C0 RB_Val_Ws16 1023.984 kw_q0p0156 -512.0000 511.9844 FORMAT "%8.4" /end CHARACTERISTIC
/begin CHARACTERISTIC GEVCtl_agSpCatHeatgEth85FacHiIdleIntk_GM "Desired value map E85 intake camshaft for catalyst heating at idling (Factor high)" MAP 0x80550D1E RB_MapGroup_S16 1023.984 kw_q0p0156 -512.0000 511.9844 FORMAT "%8.4"
 /begin AXIS_DESCR COM_AXIS Epm_nEng EngN 4 -16384.00 16383.50 FORMAT "%8.2" AXIS_PTS_REF GEVCtl_nEngIdle_Ax /end AXIS_DESCR
 /begin AXIS_DESCR COM_AXIS GEVCtl_ratLoad rel_uw_q0p0234 4 0.00 1535.977 FORMAT "%8.3" AXIS_PTS_REF GEVCtl_ratLoadIdle_Ax /end AXIS_DESCR
/end CHARACTERISTIC
/begin CHARACTERISTIC GEVCtl_agSpCatHeatgEth85FacHiLoLftIdleIntk_GM "Setpoint map E85 of the inlet camshaft for catalyst heating at low idle for low lift (high factor)" MAP 0x80550D3E RB_MapGroup_S16 1023.984 kw_q0p0156 -512.0000 511.9844 FORMAT "%8.4"
 /begin AXIS_DESCR COM_AXIS Epm_nEng EngN 4 -16384.00 16383.50 FORMAT "%8.2" AXIS_PTS_REF GEVCtl_nEngIdle_Ax /end AXIS_DESCR
 /begin AXIS_DESCR COM_AXIS GEVCtl_ratLoad rel_uw_q0p0234 4 0.00 1535.977 FORMAT "%8.3" AXIS_PTS_REF GEVCtl_ratLoadIdle_Ax /end AXIS_DESCR
/end CHARACTERISTIC
/begin CHARACTERISTIC GEVCtl_agSpCatHeatgEth85FacLoIdleIntk_GM "Desired value map E85 intake camshaft for catalyst heating at idling (Factor low)" MAP 0x80550D5E RB_MapGroup_S16 1023.984 kw_q0p0156 -512.0000 511.9844 FORMAT "%8.4"
 /begin AXIS_DESCR COM_AXIS Epm_nEng EngN 4 -16384.00 16383.50 FORMAT "%8.2" AXIS_PTS_REF GEVCtl_nEngIdle_Ax /end AXIS_DESCR
 /begin AXIS_DESCR COM_AXIS GEVCtl_ratLoad rel_uw_q0p0234 4 0.00 1535.977 FORMAT "%8.3" AXIS_PTS_REF GEVCtl_ratLoadIdle_Ax /end AXIS_DESCR
/end CHARACTERISTIC
/begin CHARACTERISTIC GEVCtl_agSpCatHeatgEth85FacLoLoLftIdleIntk_GM "Setpoint map E85 of the inlet camshaft for catalyst heating at low idle for low lift (low factor)" MAP 0x80550D7E RB_MapGroup_S16 1023.984 kw_q0p0156 -512.0000 511.9844 FORMAT "%8.4"
 /begin AXIS_DESCR COM_AXIS Epm_nEng EngN 4 -16384.00 16383.50 FORMAT "%8.2" AXIS_PTS_REF GEVCtl_nEngIdle_Ax /end AXIS_DESCR
 /begin AXIS_DESCR COM_AXIS GEVCtl_ratLoad rel_uw_q0p0234 4 0.00 1535.977 FORMAT "%8.3" AXIS_PTS_REF GEVCtl_ratLoadIdle_Ax /end AXIS_DESCR
/end CHARACTERISTIC
/begin CHARACTERISTIC GEVCtl_agSpCatHeatgEthFacHiIntk_GM "Setpoint map of the intake camshaft for catalyst heating (high factor) and high ethanol content in the fuel." MAP 0x80550D9E RB_MapGroup_S16 1023.984 kw_q0p0156 -512.0000 511.9844 FORMAT "%8.4"
 /begin AXIS_DESCR COM_AXIS Epm_nEng EngN 16 -16384.00 16383.50 FORMAT "%8.2" AXIS_PTS_REF GEVCtl_nEng_Ax /end AXIS_DESCR
 /begin AXIS_DESCR COM_AXIS GEVCtl_ratLoad rel_uw_q0p0234 16 0.00 1535.977 FORMAT "%8.3" AXIS_PTS_REF GEVCtl_ratLoad_Ax /end AXIS_DESCR
/end CHARACTERISTIC
/begin CHARACTERISTIC GEVCtl_agSpCatHeatgEthFacHiLoLftIntk_GM "Setpoint map for ethanol of the intake camshaft for catalyst heating for low lift high factor" MAP 0x80550F9E RB_MapGroup_S16 1023.984 kw_q0p0156 -512.0000 511.9844 FORMAT "%8.4"
 /begin AXIS_DESCR COM_AXIS Epm_nEng EngN 16 -16384.00 16383.50 FORMAT "%8.2" AXIS_PTS_REF GEVCtl_nEngLoLft_Ax /end AXIS_DESCR
 /begin AXIS_DESCR COM_AXIS GEVCtl_ratLoad rel_uw_q0p0234 16 0.00 1535.977 FORMAT "%8.3" AXIS_PTS_REF GEVCtl_ratLoadLoLft_Ax /end AXIS_DESCR
/end CHARACTERISTIC
/begin CHARACTERISTIC GEVCtl_agSpCatHeatgEthFacLoIntk_GM "Setpoint map of the intake camshaft for catalyst heating (low factor) and high ethanol content in the fuel." MAP 0x8055119E RB_MapGroup_S16 1023.984 kw_q0p0156 -512.0000 511.9844 FORMAT "%8.4"
 /begin AXIS_DESCR COM_AXIS Epm_nEng EngN 16 -16384.00 16383.50 FORMAT "%8.2" AXIS_PTS_REF GEVCtl_nEng_Ax /end AXIS_DESCR
 /begin AXIS_DESCR COM_AXIS GEVCtl_ratLoad rel_uw_q0p0234 16 0.00 1535.977 FORMAT "%8.3" AXIS_PTS_REF GEVCtl_ratLoad_Ax /end AXIS_DESCR
/end CHARACTERISTIC
/begin CHARACTERISTIC GEVCtl_agSpCatHeatgEthFacLoLoLftIntk_GM "Setpoint map for ethanol of the intake camshaft for catalyst heating for low lift low factor" MAP 0x8055139E RB_MapGroup_S16 1023.984 kw_q0p0156 -512.0000 511.9844 FORMAT "%8.4"
 /begin AXIS_DESCR COM_AXIS Epm_nEng EngN 16 -16384.00 16383.50 FORMAT "%8.2" AXIS_PTS_REF GEVCtl_nEngLoLft_Ax /end AXIS_DESCR
 /begin AXIS_DESCR COM_AXIS GEVCtl_ratLoad rel_uw_q0p0234 16 0.00 1535.977 FORMAT "%8.3" AXIS_PTS_REF GEVCtl_ratLoadLoLft_Ax /end AXIS_DESCR
/end CHARACTERISTIC
/begin CHARACTERISTIC GEVCtl_agSpCatHeatgFacHiIdleIntk_GM "Desired value map intake camshaft for catalyst heating at idling (Factor high)" MAP 0x8055159E RB_MapGroup_S16 1023.984 kw_q0p0156 -512.0000 511.9844 FORMAT "%8.4"
 /begin AXIS_DESCR COM_AXIS Epm_nEng EngN 4 -16384.00 16383.50 FORMAT "%8.2" AXIS_PTS_REF GEVCtl_nEngIdle_Ax /end AXIS_DESCR
 /begin AXIS_DESCR COM_AXIS GEVCtl_ratLoad rel_uw_q0p0234 4 0.00 1535.977 FORMAT "%8.3" AXIS_PTS_REF GEVCtl_ratLoadIdle_Ax /end AXIS_DESCR
/end CHARACTERISTIC
/begin CHARACTERISTIC GEVCtl_agSpCatHeatgFacHiIntk_GM "Desired value map intake camshaft catalyst heating (Factor high)" MAP 0x805515BE RB_MapGroup_S16 1023.984 kw_q0p0156 -512.0000 511.9844 FORMAT "%8.4"
 /begin AXIS_DESCR COM_AXIS Epm_nEng EngN 16 -16384.00 16383.50 FORMAT "%8.2" AXIS_PTS_REF GEVCtl_nEng_Ax /end AXIS_DESCR
 /begin AXIS_DESCR COM_AXIS GEVCtl_ratLoad rel_uw_q0p0234 16 0.00 1535.977 FORMAT "%8.3" AXIS_PTS_REF GEVCtl_ratLoad_Ax /end AXIS_DESCR
/end CHARACTERISTIC
/begin CHARACTERISTIC GEVCtl_agSpCatHeatgFacHiLoLftIdleIntk_GM "Setpoint map of the inlet camshaft for catalyst heating at low idle for low lift (high factor)" MAP 0x805517BE RB_MapGroup_S16 1023.984 kw_q0p0156 -512.0000 511.9844 FORMAT "%8.4"
 /begin AXIS_DESCR COM_AXIS Epm_nEng EngN 4 -16384.00 16383.50 FORMAT "%8.2" AXIS_PTS_REF GEVCtl_nEngIdle_Ax /end AXIS_DESCR
 /begin AXIS_DESCR COM_AXIS GEVCtl_ratLoad rel_uw_q0p0234 4 0.00 1535.977 FORMAT "%8.3" AXIS_PTS_REF GEVCtl_ratLoadIdle_Ax /end AXIS_DESCR
/end CHARACTERISTIC
/begin CHARACTERISTIC GEVCtl_agSpCatHeatgFacHiLoLftIntk_GM "Setpoint map of the inlet camshaft for catalyst heating for low lift (high factor)" MAP 0x805517DE RB_MapGroup_S16 1023.984 kw_q0p0156 -512.0000 511.9844 FORMAT "%8.4"
 /begin AXIS_DESCR COM_AXIS Epm_nEng EngN 16 -16384.00 16383.50 FORMAT "%8.2" AXIS_PTS_REF GEVCtl_nEngLoLft_Ax /end AXIS_DESCR
 /begin AXIS_DESCR COM_AXIS GEVCtl_ratLoad rel_uw_q0p0234 16 0.00 1535.977 FORMAT "%8.3" AXIS_PTS_REF GEVCtl_ratLoadLoLft_Ax /end AXIS_DESCR
/end CHARACTERISTIC
/begin CHARACTERISTIC GEVCtl_agSpCatHeatgFacLoIdleIntk_GM "Desired value map intake camshaft for catalyst heating at idling (Factor low)" MAP 0x805519DE RB_MapGroup_S16 1023.984 kw_q0p0156 -512.0000 511.9844 FORMAT "%8.4"
 /begin AXIS_DESCR COM_AXIS Epm_nEng EngN 4 -16384.00 16383.50 FORMAT "%8.2" AXIS_PTS_REF GEVCtl_nEngIdle_Ax /end AXIS_DESCR
 /begin AXIS_DESCR COM_AXIS GEVCtl_ratLoad rel_uw_q0p0234 4 0.00 1535.977 FORMAT "%8.3" AXIS_PTS_REF GEVCtl_ratLoadIdle_Ax /end AXIS_DESCR
/end CHARACTERISTIC
/begin CHARACTERISTIC GEVCtl_agSpCatHeatgFacLoIntk_GM "Desired value map intake camshaft catalyst heating (Factor low)" MAP 0x805519FE RB_MapGroup_S16 1023.984 kw_q0p0156 -512.0000 511.9844 FORMAT "%8.4"
 /begin AXIS_DESCR COM_AXIS Epm_nEng EngN 16 -16384.00 16383.50 FORMAT "%8.2" AXIS_PTS_REF GEVCtl_nEng_Ax /end AXIS_DESCR
 /begin AXIS_DESCR COM_AXIS GEVCtl_ratLoad rel_uw_q0p0234 16 0.00 1535.977 FORMAT "%8.3" AXIS_PTS_REF GEVCtl_ratLoad_Ax /end AXIS_DESCR
/end CHARACTERISTIC
/begin CHARACTERISTIC GEVCtl_agSpCatHeatgFacLoLoLftIdleIntk_GM "Setpoint map of the inlet camshaft for catalyst heating at low idle for low lift (low factor)" MAP 0x80551BFE RB_MapGroup_S16 1023.984 kw_q0p0156 -512.0000 511.9844 FORMAT "%8.4"
 /begin AXIS_DESCR COM_AXIS Epm_nEng EngN 4 -16384.00 16383.50 FORMAT "%8.2" AXIS_PTS_REF GEVCtl_nEngIdle_Ax /end AXIS_DESCR
 /begin AXIS_DESCR COM_AXIS GEVCtl_ratLoad rel_uw_q0p0234 4 0.00 1535.977 FORMAT "%8.3" AXIS_PTS_REF GEVCtl_ratLoadIdle_Ax /end AXIS_DESCR
/end CHARACTERISTIC
/begin CHARACTERISTIC GEVCtl_agSpCatHeatgFacLoLoLftIntk_GM "Setpoint map of the inlet camshaft for catalyst heating for low lift (low factor)" MAP 0x80551C1E RB_MapGroup_S16 1023.984 kw_q0p0156 -512.0000 511.9844 FORMAT "%8.4"
 /begin AXIS_DESCR COM_AXIS Epm_nEng EngN 16 -16384.00 16383.50 FORMAT "%8.2" AXIS_PTS_REF GEVCtl_nEngLoLft_Ax /end AXIS_DESCR
 /begin AXIS_DESCR COM_AXIS GEVCtl_ratLoad rel_uw_q0p0234 16 0.00 1535.977 FORMAT "%8.3" AXIS_PTS_REF GEVCtl_ratLoadLoLft_Ax /end AXIS_DESCR
/end CHARACTERISTIC
/begin CHARACTERISTIC GEVCtl_agSpDeltaFilOffIntk_C "Setpoint delta (filter_input - filter_output), to reset setpoint filtering for intake camshaft" VALUE 0x80551E1E RB_Val_Ws16 1023.984 kw_q0p0156 -512.0000 511.9844 FORMAT "%8.4" /end CHARACTERISTIC
/begin CHARACTERISTIC GEVCtl_agSpDeltaFilOnIntk_C "Setpoint delta (filter_input - filter_output), to activate setpoint filtering for intake camshaft" VALUE 0x80551E20 RB_Val_Ws16 1023.984 kw_q0p0156 -512.0000 511.9844 FORMAT "%8.4" /end CHARACTERISTIC
/begin CHARACTERISTIC GEVCtl_agSpDeltaSimCsersDiagIntk_C "Offset angle for non csers setpoint for csers diagnosis simulation intake camshaft" VALUE 0x805509C2 RB_Val_Ws16 1023.984 kw_q0p0156 -512.0000 511.9844 FORMAT "%8.4" /end CHARACTERISTIC
/begin CHARACTERISTIC GEVCtl_agSpDeltaTrigChrgInc_C "Delta anlge before adapted, mechanical endpoint in retarded position for start of charge increase" VALUE 0x80551E22 RB_Val_Ws16 1023.984 kw_q0p0156 -512.0000 511.9844 FORMAT "%8.4" /end CHARACTERISTIC
/begin CHARACTERISTIC GEVCtl_agSpDeltaUnstyTarPosnIntk_C "Angle delta for confirmation: camshaft has reached setpoint angle after Unsteady Mode (intake)" VALUE 0x80551E24 RB_Val_Ws16 1023.984 kw_q0p0156 -512.0000 511.9844 FORMAT "%8.4" /end CHARACTERISTIC
/begin CHARACTERISTIC GEVCtl_agSpDeltaVlvLftSwtPosnIntk_C "Angle delta for confirmation: camshaft has reached setpoint angle for lift switch (intake)" VALUE 0x80551E26 RB_Val_Ws16 1023.984 kw_q0p0156 -512.0000 511.9844 FORMAT "%8.4" /end CHARACTERISTIC
/begin CHARACTERISTIC GEVCtl_agSpDeltaVlvLftTarPosnIntk_C "Angle delta for confirmation: camshaft has reached setpoint angle after lift switch (intake)" VALUE 0x80551E28 RB_Val_Ws16 1023.984 kw_q0p0156 -512.0000 511.9844 FORMAT "%8.4" /end CHARACTERISTIC
/begin CHARACTERISTIC GEVCtl_agSpDifIoFilLimNegIntk_M "Angle difference intake camshaft between filtered and unfiltered setpoint for transition from linear filtering to lowpass based filtering in advanced direction" MAP 0x80551E2A RB_Map_U16S16_S16 1023.984 kw_q0p0156 -512.0000 511.9844 FORMAT "%8.4"
 /begin AXIS_DESCR STD_AXIS Epm_nEng EngN 6 0.00 16383.50 FORMAT "%8.2" EXTENDED_LIMITS 0.00 32767.50 DEPOSIT ABSOLUTE /end AXIS_DESCR
 /begin AXIS_DESCR STD_AXIS GEVCtl_tOilCylHd Temp_Cels 6 -3549.940 3003.560 FORMAT "%8.3" DEPOSIT ABSOLUTE /end AXIS_DESCR
/end CHARACTERISTIC
/begin CHARACTERISTIC GEVCtl_agSpDifIoFilLimPosIntk_M "Angle difference intake camshaft between filtered and unfiltered setpoint for transition from linear filtering to lowpass based filtering in retarded direction" MAP 0x80551E8E RB_Map_S16S16_S16 511.9844 kw_q0p0156 0.00 511.9844 FORMAT "%8.4" EXTENDED_LIMITS -512.0000 511.9844
 /begin AXIS_DESCR STD_AXIS Epm_nEng EngN 6 -16384.00 16383.50 FORMAT "%8.2" DEPOSIT ABSOLUTE /end AXIS_DESCR
 /begin AXIS_DESCR STD_AXIS GEVCtl_tOilCylHd Temp_Cels 6 -3549.940 3003.560 FORMAT "%8.3" DEPOSIT ABSOLUTE /end AXIS_DESCR
/end CHARACTERISTIC
/begin CHARACTERISTIC GEVCtl_agSpErrSimIntk_T "Setpoint curve for target error simulation intake" CURVE 0x805509C4 RB_Curve_S16_S16 1023.984 kw_q0p0156 -512.0000 511.9844 FORMAT "%8.4"
 /begin AXIS_DESCR STD_AXIS NO_INPUT_QUANTITY kw_q0p0156 6 -512.0000 511.9844 FORMAT "%8.4" DEPOSIT ABSOLUTE /end AXIS_DESCR
/end CHARACTERISTIC
/begin CHARACTERISTIC GEVCtl_agSpFrznMod2Intk_M "Calibratable angle for extreme cold temperatures (Frozen Mode) (intake) selected based on EnvP and Oil temperature" MAP 0x80551EF2 RB_Map_U16S16_S16 1023.984 kw_q0p0156 -512.0000 511.9844 FORMAT "%8.4"
 /begin AXIS_DESCR STD_AXIS GEVCtl_tiNormalIntk Time_ms 6 0.00 655350.0 FORMAT "%8.1" DEPOSIT ABSOLUTE /end AXIS_DESCR
 /begin AXIS_DESCR STD_AXIS CEngDsT_tStrt Temp_Cels 6 -3549.940 3003.560 FORMAT "%8.3" DEPOSIT ABSOLUTE /end AXIS_DESCR
/end CHARACTERISTIC
/begin CHARACTERISTIC GEVCtl_agSpFrznModIntk_C "Calibratable fixed angle for extreme cold temperatures (Frozen Mode) (intake)" VALUE 0x80551F56 RB_Val_Ws16 1023.984 kw_q0p0156 -512.0000 511.9844 FORMAT "%8.4" /end CHARACTERISTIC
/begin CHARACTERISTIC GEVCtl_agSpHomColdIntk_GM "Desired value map intake camshaft homogeneous mode (HOM) engine not at operating temperature" MAP 0x80551F58 RB_MapGroup_S16 1023.984 kw_q0p0156 -512.0000 511.9844 FORMAT "%8.4"
 /begin AXIS_DESCR COM_AXIS Epm_nEng EngN 16 -16384.00 16383.50 FORMAT "%8.2" AXIS_PTS_REF GEVCtl_nEng_Ax /end AXIS_DESCR
 /begin AXIS_DESCR COM_AXIS GEVCtl_ratLoad rel_uw_q0p0234 16 0.00 1535.977 FORMAT "%8.3" AXIS_PTS_REF GEVCtl_ratLoad_Ax /end AXIS_DESCR
/end CHARACTERISTIC
/begin CHARACTERISTIC GEVCtl_agSpHomCorrnRhoEthFacIntk_GM "Map for a warm engine with Ethanol content(consider of environmental influence on density via height and heat)" MAP 0x80552158 RB_MapGroup_S16 1023.984 kw_q0p0156 -512.0000 511.9844 FORMAT "%8.4"
 /begin AXIS_DESCR COM_AXIS Epm_nEng EngN 16 -16384.00 16383.50 FORMAT "%8.2" AXIS_PTS_REF GEVCtl_nEng_Ax /end AXIS_DESCR
 /begin AXIS_DESCR COM_AXIS GEVCtl_ratLoad rel_uw_q0p0234 16 0.00 1535.977 FORMAT "%8.3" AXIS_PTS_REF GEVCtl_ratLoad_Ax /end AXIS_DESCR
/end CHARACTERISTIC
/begin CHARACTERISTIC GEVCtl_agSpHomCorrnRhoIntk_GM "Map for homogeneous warm camshaft set points consider of environmental influence on density via height and heat" MAP 0x80552358 RB_MapGroup_S16 1023.984 kw_q0p0156 -512.0000 511.9844 FORMAT "%8.4"
 /begin AXIS_DESCR COM_AXIS Epm_nEng EngN 16 -16384.00 16383.50 FORMAT "%8.2" AXIS_PTS_REF GEVCtl_nEng_Ax /end AXIS_DESCR
 /begin AXIS_DESCR COM_AXIS GEVCtl_ratLoad rel_uw_q0p0234 16 0.00 1535.977 FORMAT "%8.3" AXIS_PTS_REF GEVCtl_ratLoad_Ax /end AXIS_DESCR
/end CHARACTERISTIC
/begin CHARACTERISTIC GEVCtl_agSpHomEthColdIntk_GM "Map for a cold engine with high ethanol content in the fuel." MAP 0x80552558 RB_MapGroup_S16 1023.984 kw_q0p0156 -512.0000 511.9844 FORMAT "%8.4"
 /begin AXIS_DESCR COM_AXIS Epm_nEng EngN 16 -16384.00 16383.50 FORMAT "%8.2" AXIS_PTS_REF GEVCtl_nEng_Ax /end AXIS_DESCR
 /begin AXIS_DESCR COM_AXIS GEVCtl_ratLoad rel_uw_q0p0234 16 0.00 1535.977 FORMAT "%8.3" AXIS_PTS_REF GEVCtl_ratLoad_Ax /end AXIS_DESCR
/end CHARACTERISTIC
/begin CHARACTERISTIC GEVCtl_agSpHomEthFacWrmIntk_GM "Map for a warm engine with Ethanol content." MAP 0x80552758 RB_MapGroup_S16 1023.984 kw_q0p0156 -512.0000 511.9844 FORMAT "%8.4"
 /begin AXIS_DESCR COM_AXIS Epm_nEng EngN 16 -16384.00 16383.50 FORMAT "%8.2" AXIS_PTS_REF GEVCtl_nEng_Ax /end AXIS_DESCR
 /begin AXIS_DESCR COM_AXIS GEVCtl_ratLoad rel_uw_q0p0234 16 0.00 1535.977 FORMAT "%8.3" AXIS_PTS_REF GEVCtl_ratLoad_Ax /end AXIS_DESCR
/end CHARACTERISTIC
/begin CHARACTERISTIC GEVCtl_agSpHomNoEgrEthFacHiWrmIntk_GM "Camshaft setpoint map for a warm engine and high ethanol content in the fuel with External EGR not activated." MAP 0x80552958 RB_MapGroup_S16 1023.984 kw_q0p0156 -512.0000 511.9844 FORMAT "%8.4"
 /begin AXIS_DESCR COM_AXIS Epm_nEng EngN 16 -16384.00 16383.50 FORMAT "%8.2" AXIS_PTS_REF GEVCtl_nEng_Ax /end AXIS_DESCR
 /begin AXIS_DESCR COM_AXIS GEVCtl_ratLoad rel_uw_q0p0234 16 0.00 1535.977 FORMAT "%8.3" AXIS_PTS_REF GEVCtl_ratLoad_Ax /end AXIS_DESCR
/end CHARACTERISTIC
/begin CHARACTERISTIC GEVCtl_agSpHomNoEgrEthFacLoWrmIntk_GM "Camshaft setpoint map for a warm engine and low ethanol content in the fuel with External EGR not activated." MAP 0x80552B58 RB_MapGroup_S16 1023.984 kw_q0p0156 -512.0000 511.9844 FORMAT "%8.4"
 /begin AXIS_DESCR COM_AXIS Epm_nEng EngN 16 -16384.00 16383.50 FORMAT "%8.2" AXIS_PTS_REF GEVCtl_nEng_Ax /end AXIS_DESCR
 /begin AXIS_DESCR COM_AXIS GEVCtl_ratLoad rel_uw_q0p0234 16 0.00 1535.977 FORMAT "%8.3" AXIS_PTS_REF GEVCtl_ratLoad_Ax /end AXIS_DESCR
/end CHARACTERISTIC
/begin CHARACTERISTIC GEVCtl_agSpHomWrmIntk_GM "Desired value map intake camshaft homogeneous mode (HOM) engine at operating temperature" MAP 0x80552D58 RB_MapGroup_S16 1023.984 kw_q0p0156 -512.0000 511.9844 FORMAT "%8.4"
 /begin AXIS_DESCR COM_AXIS Epm_nEng EngN 16 -16384.00 16383.50 FORMAT "%8.2" AXIS_PTS_REF GEVCtl_nEng_Ax /end AXIS_DESCR
 /begin AXIS_DESCR COM_AXIS GEVCtl_ratLoad rel_uw_q0p0234 16 0.00 1535.977 FORMAT "%8.3" AXIS_PTS_REF GEVCtl_ratLoad_Ax /end AXIS_DESCR
/end CHARACTERISTIC
/begin CHARACTERISTIC GEVCtl_agSpIdleColdIntk_GM "Desired value map intake camshaft while idling engine not at operating temperature" MAP 0x80552F58 RB_MapGroup_S16 1023.984 kw_q0p0156 -512.0000 511.9844 FORMAT "%8.4"
 /begin AXIS_DESCR COM_AXIS Epm_nEng EngN 4 -16384.00 16383.50 FORMAT "%8.2" AXIS_PTS_REF GEVCtl_nEngStdIdle_Ax /end AXIS_DESCR
 /begin AXIS_DESCR COM_AXIS GEVCtl_ratLoad rel_uw_q0p0234 4 0.00 1535.977 FORMAT "%8.3" AXIS_PTS_REF GEVCtl_ratLoadStdIdle_Ax /end AXIS_DESCR
/end CHARACTERISTIC
/begin CHARACTERISTIC GEVCtl_agSpIdleEthColdIntk_GM "Map for high ethanol content low idle mode when engine is not at an operating temperature." MAP 0x80552F78 RB_MapGroup_S16 1023.984 kw_q0p0156 -512.0000 511.9844 FORMAT "%8.4"
 /begin AXIS_DESCR COM_AXIS Epm_nEng EngN 4 -16384.00 16383.50 FORMAT "%8.2" AXIS_PTS_REF GEVCtl_nEngStdIdle_Ax /end AXIS_DESCR
 /begin AXIS_DESCR COM_AXIS GEVCtl_ratLoad rel_uw_q0p0234 4 0.00 1535.977 FORMAT "%8.3" AXIS_PTS_REF GEVCtl_ratLoadStdIdle_Ax /end AXIS_DESCR
/end CHARACTERISTIC
/begin CHARACTERISTIC GEVCtl_agSpIdleWrmIntk_GM "Desired value map intake camshaft while idling engine at operating temperature" MAP 0x80552F98 RB_MapGroup_S16 1023.984 kw_q0p0156 -512.0000 511.9844 FORMAT "%8.4"
 /begin AXIS_DESCR COM_AXIS Epm_nEng EngN 4 -16384.00 16383.50 FORMAT "%8.2" AXIS_PTS_REF GEVCtl_nEngStdIdle_Ax /end AXIS_DESCR
 /begin AXIS_DESCR COM_AXIS GEVCtl_ratLoad rel_uw_q0p0234 4 0.00 1535.977 FORMAT "%8.3" AXIS_PTS_REF GEVCtl_ratLoadStdIdle_Ax /end AXIS_DESCR
/end CHARACTERISTIC
/begin CHARACTERISTIC GEVCtl_agSpLoLftColdIntk_GM "Desired value map intake camshaft low lift engine not at operating temperature" MAP 0x80552FB8 RB_MapGroup_S16 1023.984 kw_q0p0156 -512.0000 511.9844 FORMAT "%8.4"
 /begin AXIS_DESCR COM_AXIS Epm_nEng EngN 16 -16384.00 16383.50 FORMAT "%8.2" AXIS_PTS_REF GEVCtl_nEngLoLft_Ax /end AXIS_DESCR
 /begin AXIS_DESCR COM_AXIS GEVCtl_ratLoad rel_uw_q0p0234 16 0.00 1535.977 FORMAT "%8.3" AXIS_PTS_REF GEVCtl_ratLoadLoLft_Ax /end AXIS_DESCR
/end CHARACTERISTIC
/begin CHARACTERISTIC GEVCtl_agSpLoLftEthColdIntk_GM "Map for a small cam for a cold engine with Ethanol content." MAP 0x805531B8 RB_MapGroup_S16 1023.984 kw_q0p0156 -512.0000 511.9844 FORMAT "%8.4"
 /begin AXIS_DESCR COM_AXIS Epm_nEng EngN 16 -16384.00 16383.50 FORMAT "%8.2" AXIS_PTS_REF GEVCtl_nEngLoLft_Ax /end AXIS_DESCR
 /begin AXIS_DESCR COM_AXIS GEVCtl_ratLoad rel_uw_q0p0234 16 0.00 1535.977 FORMAT "%8.3" AXIS_PTS_REF GEVCtl_ratLoadLoLft_Ax /end AXIS_DESCR
/end CHARACTERISTIC
/begin CHARACTERISTIC GEVCtl_agSpLoLftEthNoEgrWrmIntk_GM "Setpoint map for ethanol influence in small cam for a warm engine with External EGR not activated." MAP 0x805533B8 RB_MapGroup_S16 1023.984 kw_q0p0156 -512.0000 511.9844 FORMAT "%8.4"
 /begin AXIS_DESCR COM_AXIS Epm_nEng EngN 16 -16384.00 16383.50 FORMAT "%8.2" AXIS_PTS_REF GEVCtl_nEngLoLft_Ax /end AXIS_DESCR
 /begin AXIS_DESCR COM_AXIS GEVCtl_ratLoad rel_uw_q0p0234 16 0.00 1535.977 FORMAT "%8.3" AXIS_PTS_REF GEVCtl_ratLoadLoLft_Ax /end AXIS_DESCR
/end CHARACTERISTIC
/begin CHARACTERISTIC GEVCtl_agSpLoLftEthWrmIntk_GM "Map for a small cam for a warm engine with Ethanol content." MAP 0x805535B8 RB_MapGroup_S16 1023.984 kw_q0p0156 -512.0000 511.9844 FORMAT "%8.4"
 /begin AXIS_DESCR COM_AXIS Epm_nEng EngN 16 -16384.00 16383.50 FORMAT "%8.2" AXIS_PTS_REF GEVCtl_nEngLoLft_Ax /end AXIS_DESCR
 /begin AXIS_DESCR COM_AXIS GEVCtl_ratLoad rel_uw_q0p0234 16 0.00 1535.977 FORMAT "%8.3" AXIS_PTS_REF GEVCtl_ratLoadLoLft_Ax /end AXIS_DESCR
/end CHARACTERISTIC
/begin CHARACTERISTIC GEVCtl_agSpLoLftIdleColdIntk_GM "Desired value map intake camshaft low lift while idling engine not at operating temperature" MAP 0x805537B8 RB_MapGroup_S16 1023.984 kw_q0p0156 -512.0000 511.9844 FORMAT "%8.4"
 /begin AXIS_DESCR COM_AXIS Epm_nEng EngN 4 -16384.00 16383.50 FORMAT "%8.2" AXIS_PTS_REF GEVCtl_nEngIdle_Ax /end AXIS_DESCR
 /begin AXIS_DESCR COM_AXIS GEVCtl_ratLoad rel_uw_q0p0234 4 0.00 1535.977 FORMAT "%8.3" AXIS_PTS_REF GEVCtl_ratLoadIdle_Ax /end AXIS_DESCR
/end CHARACTERISTIC
/begin CHARACTERISTIC GEVCtl_agSpLoLftIdleWrmIntk_GM "Desired value map intake camshaft low lift while idling engine at operating temperature" MAP 0x805537D8 RB_MapGroup_S16 1023.984 kw_q0p0156 -512.0000 511.9844 FORMAT "%8.4"
 /begin AXIS_DESCR COM_AXIS Epm_nEng EngN 4 -16384.00 16383.50 FORMAT "%8.2" AXIS_PTS_REF GEVCtl_nEngIdle_Ax /end AXIS_DESCR
 /begin AXIS_DESCR COM_AXIS GEVCtl_ratLoad rel_uw_q0p0234 4 0.00 1535.977 FORMAT "%8.3" AXIS_PTS_REF GEVCtl_ratLoadIdle_Ax /end AXIS_DESCR
/end CHARACTERISTIC
/begin CHARACTERISTIC GEVCtl_agSpLoLftNoEgrWrmIntk_GM "Setpoint map for a small cam for a warm engine with External EGR not activated." MAP 0x805537F8 RB_MapGroup_S16 1023.984 kw_q0p0156 -512.0000 511.9844 FORMAT "%8.4"
 /begin AXIS_DESCR COM_AXIS Epm_nEng EngN 16 -16384.00 16383.50 FORMAT "%8.2" AXIS_PTS_REF GEVCtl_nEngLoLft_Ax /end AXIS_DESCR
 /begin AXIS_DESCR COM_AXIS GEVCtl_ratLoad rel_uw_q0p0234 16 0.00 1535.977 FORMAT "%8.3" AXIS_PTS_REF GEVCtl_ratLoadLoLft_Ax /end AXIS_DESCR
/end CHARACTERISTIC
/begin CHARACTERISTIC GEVCtl_agSpLoLftWrmIntk_GM "Desired value map intake camshaft low lift engine at operating temperature" MAP 0x805539F8 RB_MapGroup_S16 1023.984 kw_q0p0156 -512.0000 511.9844 FORMAT "%8.4"
 /begin AXIS_DESCR COM_AXIS Epm_nEng EngN 16 -16384.00 16383.50 FORMAT "%8.2" AXIS_PTS_REF GEVCtl_nEngLoLft_Ax /end AXIS_DESCR
 /begin AXIS_DESCR COM_AXIS GEVCtl_ratLoad rel_uw_q0p0234 16 0.00 1535.977 FORMAT "%8.3" AXIS_PTS_REF GEVCtl_ratLoadLoLft_Ax /end AXIS_DESCR
/end CHARACTERISTIC
/begin CHARACTERISTIC GEVCtl_agSpMinOvlIntk_C "Desired angle intake camshaft for the minimum overlap" VALUE 0x80553BF8 RB_Val_Ws16 1023.984 kw_q0p0156 -512.0000 511.9844 FORMAT "%8.4" /end CHARACTERISTIC
/begin CHARACTERISTIC GEVCtl_agSpPrpnVlvLftSwtIntk_GM "Desired phase value map intake camshaft for outlet valve lift switching" MAP 0x80553BFA RB_MapGroup_S16 1023.984 kw_q0p0156 -512.0000 511.9844 FORMAT "%8.4"
 /begin AXIS_DESCR COM_AXIS Epm_nEng EngN 16 -16384.00 16383.50 FORMAT "%8.2" AXIS_PTS_REF GEVCtl_nEng_Ax /end AXIS_DESCR
 /begin AXIS_DESCR COM_AXIS GEVCtl_ratLoad rel_uw_q0p0234 16 0.00 1535.977 FORMAT "%8.3" AXIS_PTS_REF GEVCtl_ratLoad_Ax /end AXIS_DESCR
/end CHARACTERISTIC
/begin CHARACTERISTIC GEVCtl_agSpRampMaxIntk_C "Maximum angle of calibrated setpoint ramp intake" VALUE 0x805509DE RB_Val_Ws16 1023.984 kw_q0p0156 -512.0000 511.9844 FORMAT "%8.4" /end CHARACTERISTIC
/begin CHARACTERISTIC GEVCtl_agSpRampMinIntk_C "Minimum angle of calibrated setpoint ramp intake" VALUE 0x805509E0 RB_Val_Ws16 1023.984 kw_q0p0156 -512.0000 511.9844 FORMAT "%8.4" /end CHARACTERISTIC
/begin CHARACTERISTIC GEVCtl_agSpRedOvlPreIgnIntk_T "Desired value table intake camshaft reduced valve overlap in case of knock detection" CURVE 0x80553DFA RB_Curve_S16_S16 1023.984 kw_q0p0156 -512.0000 511.9844 FORMAT "%8.4"
 /begin AXIS_DESCR STD_AXIS Epm_nEng EngN 6 -16384.00 16383.50 FORMAT "%8.2" DEPOSIT ABSOLUTE /end AXIS_DESCR
/end CHARACTERISTIC
/begin CHARACTERISTIC GEVCtl_agSpRefPosnGrdtLimIntk_T "Maximum limits for approaching the reference position with limited gradient (intake camshaft)" CURVE 0x80553E14 RB_Curve_S16_U16_Static 4095.938 q0p0625_degCrS_DIV_s 0.00 4095.938 FORMAT "%8.3"
 /begin AXIS_DESCR STD_AXIS GEVCtl_tOilCylHd Temp_Cels 6 -3549.940 3003.560 FORMAT "%8.3" DEPOSIT ABSOLUTE /end AXIS_DESCR
/end CHARACTERISTIC
/begin CHARACTERISTIC GEVCtl_agSpRefPosnReaDeltaIntk_C "Distance to reference position defining if the setpoint is close enough to the reference position for directly setting the reference position as setpoint (intake)" VALUE 0x80553E2E RB_Val_Wu16 1023.984 kw_q0p0156 0.00 1023.984 FORMAT "%8.3" /end CHARACTERISTIC
/begin CHARACTERISTIC GEVCtl_agSpRtdtClngIntk_C "Retarded position of the intake camshaft for setpoint jumps during cleaning" VALUE 0x805546FE RB_Val_Ws16 1023.984 kw_q0p0156 -512.0000 511.9844 FORMAT "%8.4" /end CHARACTERISTIC
/begin CHARACTERISTIC GEVCtl_agThdFilSlowTiIntk_C "Threshold: switch over to time constant for desired value change limitation intake" VALUE 0x80553E30 RB_Val_Ws16 1023.984 kw_q0p0156 -512.0000 511.9844 FORMAT "%8.4" /end CHARACTERISTIC
/begin CHARACTERISTIC GEVCtl_cntrGrdtTstFctRepnIntk_C "Repetitions of calibrated setpoint ramps intake" VALUE 0x805509E2 RB_Val_Wu8 255.0 OneToOne 0.00 255.0 FORMAT "%5.1" /end CHARACTERISTIC
/begin CHARACTERISTIC GEVCtl_cntrMdnCalcnPha_C "Start counter median-calculation camshaft" VALUE 0x80550A19 RB_Val_Wu8 255.0 dez 0.00 255.0 FORMAT "%5.1" /end CHARACTERISTIC
/begin CHARACTERISTIC GEVCtl_facCorrnRho_T "Interpolation curve for environmental influence on setpoints (density)" CURVE 0x80553E32 RB_Curve_U8_U8 0.9961 fak_ub_b1 0.00 0.9961
 /begin AXIS_DESCR STD_AXIS GEVCtl_rhoEnv dichte_ub_b2 6 0.00 1.992 FORMAT "%5.3" DEPOSIT ABSOLUTE /end AXIS_DESCR
/end CHARACTERISTIC
/begin CHARACTERISTIC GEVCtl_facEthColdWrmIntk_T "Interpolation curve for ethanol influence in camshaft functions in cold and warm engine HOM mode with Ethanol content." CURVE 0x80553E40 RB_Curve_U16_U8_Static 0.9961 fak_ub_b1 0.00 0.9961
 /begin AXIS_DESCR STD_AXIS FfPrm_facEth fak_uw_b2 6 0.00 1.999969 FORMAT "%8.6" DEPOSIT ABSOLUTE /end AXIS_DESCR
/end CHARACTERISTIC
/begin CHARACTERISTIC GEVCtl_facEthFrctCatHeatgIntk_T "Interpolation curve for ethanol influence in camshaft functions in catalyst heating mode" CURVE 0x80553E54 RB_Curve_U16_U8_Static 0.9961 fak_ub_b1 0.00 0.9961
 /begin AXIS_DESCR STD_AXIS FfPrm_facEth fak_uw_b2 6 0.00 1.999969 FORMAT "%8.6" DEPOSIT ABSOLUTE /end AXIS_DESCR
/end CHARACTERISTIC
/begin CHARACTERISTIC GEVCtl_facEthFrctCatHeatgLoLftIntk_T "Interpolation curve for ethanol influence in camshaft functions in catalyst low lift heating mode" CURVE 0x80553E68 RB_Curve_U16_U8_Static 0.9961 fak_ub_b1 0.00 0.9961
 /begin AXIS_DESCR STD_AXIS FfPrm_facEth fak_uw_b2 6 0.00 1.999969 FORMAT "%8.6" DEPOSIT ABSOLUTE /end AXIS_DESCR
/end CHARACTERISTIC
/begin CHARACTERISTIC GEVCtl_facEthFrctHomColdIntk_T "Interpolation curve for ethanol influence in camshaft functions in cold engine HOM mode." CURVE 0x80553E7C RB_Curve_U16_U8_Static 0.9961 fak_ub_b1 0.00 0.9961
 /begin AXIS_DESCR STD_AXIS FfPrm_facEth fak_uw_b2 6 0.00 1.999969 FORMAT "%8.6" DEPOSIT ABSOLUTE /end AXIS_DESCR
/end CHARACTERISTIC
/begin CHARACTERISTIC GEVCtl_facEthFrctHomWarmIntk_T "Interpolation curve for ethanol influence in camshaft functions in warm engine HOM mode." CURVE 0x80553E90 RB_Curve_U16_U8_Static 0.9961 fak_ub_b1 0.00 0.9961
 /begin AXIS_DESCR STD_AXIS FfPrm_facEth fak_uw_b2 6 0.00 1.999969 FORMAT "%8.6" DEPOSIT ABSOLUTE /end AXIS_DESCR
/end CHARACTERISTIC
/begin CHARACTERISTIC GEVCtl_facEthFrctIdleModIntk_T "Interpolation curve for ethanol influence in camshaft functions in cold engine mode idling condition." CURVE 0x80553EA4 RB_Curve_U16_U8_Static 0.9961 fak_ub_b1 0.00 0.9961
 /begin AXIS_DESCR STD_AXIS FfPrm_facEth fak_uw_b2 6 0.00 1.999969 FORMAT "%8.6" DEPOSIT ABSOLUTE /end AXIS_DESCR
/end CHARACTERISTIC
/begin CHARACTERISTIC GEVCtl_facEthFrctIntk_T "Table influence of ethanol content for desired value intake calculation" CURVE 0x80553EB8 RB_Curve_U16_U8_Static 0.9961 fak_ub_b1 0.00 0.9961
 /begin AXIS_DESCR STD_AXIS FfPrm_facEth fak_uw_b2 6 0.00 1.999969 FORMAT "%8.6" DEPOSIT ABSOLUTE /end AXIS_DESCR
/end CHARACTERISTIC
/begin CHARACTERISTIC GEVCtl_facEthFrctLoLftColdIntk_T "Interpolation curve for ethanol influence in camshaft functions in small cam cold engine with Ethanol content." CURVE 0x80553ECC RB_Curve_U16_U8_Static 0.9961 fak_ub_b1 0.00 0.9961
 /begin AXIS_DESCR STD_AXIS FfPrm_facEth fak_uw_b2 6 0.00 1.999969 FORMAT "%8.6" DEPOSIT ABSOLUTE /end AXIS_DESCR
/end CHARACTERISTIC
/begin CHARACTERISTIC GEVCtl_facEthFrctLoLftNoEgrWrmIntk_T "Interpolation curve for ethanol influence in camshaft functions in small cam warm engine with External EGR not activated." CURVE 0x80553EE0 RB_Curve_U16_U8_Static 0.9961 fak_ub_b1 0.00 0.9961
 /begin AXIS_DESCR STD_AXIS FfPrm_facEth fak_uw_b2 6 0.00 1.999969 FORMAT "%8.6" DEPOSIT ABSOLUTE /end AXIS_DESCR
/end CHARACTERISTIC
/begin CHARACTERISTIC GEVCtl_facEthFrctLoLftWrmIntk_T "Interpolation curve for ethanol influence in camshaft functions in small cam warm engine with Ethanol content." CURVE 0x80553EF4 RB_Curve_U16_U8_Static 0.9961 fak_ub_b1 0.00 0.9961
 /begin AXIS_DESCR STD_AXIS FfPrm_facEth fak_uw_b2 6 0.00 1.999969 FORMAT "%8.6" DEPOSIT ABSOLUTE /end AXIS_DESCR
/end CHARACTERISTIC
/begin CHARACTERISTIC GEVCtl_facEthFrctNoEgrHomWarmIntk_T "Interpolation curve for ethanol influence in camshaft functions in warm engine HOM mode." CURVE 0x80553F08 RB_Curve_U16_U8_Static 0.9961 fak_ub_b1 0.00 0.9961
 /begin AXIS_DESCR STD_AXIS FfPrm_facEth fak_uw_b2 6 0.00 1.999969 FORMAT "%8.6" DEPOSIT ABSOLUTE /end AXIS_DESCR
/end CHARACTERISTIC
/begin CHARACTERISTIC GEVCtl_facFrznModSpSwtIntk_M "Map for factor based on the environment pressure and oil temperature for setpoint selection during Frozen Mode for intake camshaft." MAP 0x80553F1C RB_Map_U16S16_U16 0.9999847 fak_uw_b1 0.00 0.9999847 FORMAT "%9.7"
 /begin AXIS_DESCR STD_AXIS PEnv_p p_uw_q0p039 6 0.00 2559.961 FORMAT "%8.3" DEPOSIT ABSOLUTE /end AXIS_DESCR
 /begin AXIS_DESCR STD_AXIS GEVCtl_tOilCylHd Temp_Cels 6 -3549.940 3003.560 FORMAT "%8.3" DEPOSIT ABSOLUTE /end AXIS_DESCR
/end CHARACTERISTIC
/begin CHARACTERISTIC GEVCtl_facHighFrznModSpSwtIntk_C "High factor for hysterisys for SetPoint switching during the Intake camshaft Frozen Mode" VALUE 0x80553F80 RB_Val_Wu16 0.9999847 fak_uw_b1 0.00 0.9999847 FORMAT "%9.7" /end CHARACTERISTIC
/begin CHARACTERISTIC GEVCtl_facLoFrznModSpSwtIntk_C "Low Faktor für Hysterese für Sollwertumschaltung während des Einlass nockenwelle Frozen Mode" VALUE 0x80553F82 RB_Val_Wu16 0.9999847 fak_uw_b1 0.00 0.9999847 FORMAT "%9.7" /end CHARACTERISTIC
/begin CHARACTERISTIC GEVCtl_facRatLoadDeltaIntk_T "Factor depending on the rat load change for angle difference outlet camshaft setpoint filter for filtering in advanced direction" CURVE 0x80553F84 RB_Curve_S16_U16_Static 1.000000 fak_uw_b2 0.00 1.000000 FORMAT "%8.6" EXTENDED_LIMITS 0.00 1.999969
 /begin AXIS_DESCR STD_AXIS GEVCtl_ratLoadDeltaIntk rel_q0p0234 4 -768.0000 767.9766 FORMAT "%8.4" DEPOSIT ABSOLUTE /end AXIS_DESCR
/end CHARACTERISTIC
/begin CHARACTERISTIC GEVCtl_facTiAgSpFilIntk_T "Multiplicative correction factor of the filter time constant" CURVE 0x80553F96 RB_Curve_U16_U16 511.9922 fak_q0p0078 0.00 511.9922 FORMAT "%8.4"
 /begin AXIS_DESCR STD_AXIS Epm_nEng EngN 5 0.00 16383.50 FORMAT "%8.2" EXTENDED_LIMITS 0.00 32767.50 DEPOSIT ABSOLUTE /end AXIS_DESCR
/end CHARACTERISTIC
/begin CHARACTERISTIC GEVCtl_facTiAgSpFilTOilIntk_T "Multiplicative oil dependent correction factor of the filter time constant" CURVE 0x80553FAC RB_Curve_S16_U16_Static 511.9922 fak_q0p0078 0.00 511.9922 FORMAT "%8.4"
 /begin AXIS_DESCR STD_AXIS GEVCtl_tTiAgSpFilCorrnIntk Temp_Cels 6 -3549.940 3003.560 FORMAT "%8.3" DEPOSIT ABSOLUTE /end AXIS_DESCR
/end CHARACTERISTIC
/begin CHARACTERISTIC GEVCtl_facTranColdWrmEthIntk_M "Factor for the transition from maps for a cold engine (0.0) to maps for a warm engine (1.0) with Ethanol content." MAP 0x80553FC6 RB_Map_S16S16_U8 0.9961 fak_ub_b1 0.00 0.9961
 /begin AXIS_DESCR STD_AXIS CEngDsT_t Temp_Cels 6 -3549.940 3003.560 FORMAT "%8.3" DEPOSIT ABSOLUTE /end AXIS_DESCR
 /begin AXIS_DESCR STD_AXIS CEngDsT_tStrt Temp_Cels 4 -3549.940 3003.560 FORMAT "%8.3" DEPOSIT ABSOLUTE /end AXIS_DESCR
/end CHARACTERISTIC
/begin CHARACTERISTIC GEVCtl_facTranColdWrmIntk_M "Factor map transition operating point coldwarm desired value intake camshaft" MAP 0x80553FF6 RB_Map_S16S16_U8 0.9961 fak_ub_b1 0.00 0.9961
 /begin AXIS_DESCR STD_AXIS CEngDsT_t Temp_Cels 6 -3549.940 3003.560 FORMAT "%8.3" DEPOSIT ABSOLUTE /end AXIS_DESCR
 /begin AXIS_DESCR STD_AXIS CEngDsT_tStrt Temp_Cels 4 -3549.940 3003.560 FORMAT "%8.3" DEPOSIT ABSOLUTE /end AXIS_DESCR
/end CHARACTERISTIC
/begin CHARACTERISTIC GEVCtl_facTranColdWrmLoLftEthIntk_M "Factor for the transition from maps for a cold engine (0.0) to maps for a warm engine (1.0) for low lift with Ethanol content." MAP 0x80554026 RB_Map_S16S16_U8 0.9961 fak_ub_b1 0.00 0.9961
 /begin AXIS_DESCR STD_AXIS CEngDsT_t Temp_Cels 6 -3549.940 3003.560 FORMAT "%8.3" DEPOSIT ABSOLUTE /end AXIS_DESCR
 /begin AXIS_DESCR STD_AXIS CEngDsT_tStrt Temp_Cels 4 -3549.940 3003.560 FORMAT "%8.3" DEPOSIT ABSOLUTE /end AXIS_DESCR
/end CHARACTERISTIC
/begin CHARACTERISTIC GEVCtl_facTranColdWrmLoLftIntk_M "Factor map transition operating point coldwarm desired value intake camshaft with low lift for intake" MAP 0x80554056 RB_Map_S16S16_U8 0.9961 fak_ub_b1 0.00 0.9961
 /begin AXIS_DESCR STD_AXIS CEngDsT_t Temp_Cels 6 -3549.940 3003.560 FORMAT "%8.3" DEPOSIT ABSOLUTE /end AXIS_DESCR
 /begin AXIS_DESCR STD_AXIS CEngDsT_tStrt Temp_Cels 4 -3549.940 3003.560 FORMAT "%8.3" DEPOSIT ABSOLUTE /end AXIS_DESCR
/end CHARACTERISTIC
/begin CHARACTERISTIC GEVCtl_idxGrdtTstFctRepnStopIntk_C "Stopping index of gradient for calibrated setpoint ramp intake" VALUE 0x805509E3 RB_Val_Wu8 255.0 OneToOne 0.00 255.0 FORMAT "%5.1" /end CHARACTERISTIC
/begin CHARACTERISTIC GEVCtl_idxGrdtTstFctRepnStrtIntk_C "Starting index of gradient for calibrated setpoint ramp intake" VALUE 0x805509E4 RB_Val_Wu8 255.0 OneToOne 0.00 255.0 FORMAT "%5.1" /end CHARACTERISTIC
/begin CHARACTERISTIC GEVCtl_idxTiAgSpFilIntk_CA "Index selection depending on camshaft mode for switching filter time constant intake camshaft" VAL_BLK 0x80554086 RB_ValA_Wu16 65535.00 dez 0.00 65535.00 FORMAT "%8.2" NUMBER 30 /end CHARACTERISTIC
/begin AXIS_PTS GEVCtl_nEngIdle_Ax "Group axis for engine speed while ideling" 0x80550B4E Epm_nEng RB_Axis_S16 32767.50 EngN 4 -16384.00 16383.50 FORMAT "%8.2" DEPOSIT ABSOLUTE /end AXIS_PTS
/begin AXIS_PTS GEVCtl_nEngLoLft_Ax "Group axis for engine speed at low valve lift" 0x80550B58 Epm_nEng RB_Axis_S16 32767.50 EngN 16 -16384.00 16383.50 FORMAT "%8.2" DEPOSIT ABSOLUTE /end AXIS_PTS
/begin CHARACTERISTIC GEVCtl_nEngMaxClng_C "Maximum engine speed for the activation of the camshaft cleaning" VALUE 0x80554700 RB_Val_Ws16 16383.50 EngN 0.00 16383.50 FORMAT "%8.2" EXTENDED_LIMITS -16384.00 16383.50 /end CHARACTERISTIC
/begin CHARACTERISTIC GEVCtl_nEngMinClng_C "Minimum engine speed for the activation of the camshaft cleaning" VALUE 0x80554702 RB_Val_Ws16 16383.50 EngN 0.00 16383.50 FORMAT "%8.2" EXTENDED_LIMITS -16384.00 16383.50 /end CHARACTERISTIC
/begin CHARACTERISTIC GEVCtl_nEngMinPhaDeactvIntk_T "Engine speed at which intake camshaft adjustment release is withdrawn instantly due to lack of sufficient oil pressure" CURVE 0x80550C00 RB_Curve_S16_S16 32767.50 EngN -16384.00 16383.50 FORMAT "%8.2"
 /begin AXIS_DESCR STD_AXIS GEVCtl_tOilPhaEna Temp_Cels 4 -3549.940 3003.560 FORMAT "%8.3" DEPOSIT ABSOLUTE /end AXIS_DESCR
/end CHARACTERISTIC
/begin CHARACTERISTIC GEVCtl_nEngMinPhaDebDeactvIntk_T "Engine speed at which intake camshaft adjustment release is withdrawn after delay time" CURVE 0x80550C12 RB_Curve_S16_S16 32767.50 EngN -16384.00 16383.50 FORMAT "%8.2"
 /begin AXIS_DESCR STD_AXIS GEVCtl_tOilPhaEna Temp_Cels 4 -3549.940 3003.560 FORMAT "%8.3" DEPOSIT ABSOLUTE /end AXIS_DESCR
/end CHARACTERISTIC
/begin CHARACTERISTIC GEVCtl_nEngMinPhaEnaHys_T "Camshaft Speed hysteresis for the avoidance of engine speed fluctuations" CURVE 0x80550C24 RB_Curve_S16_S16 32767.50 EngN -16384.00 16383.50 FORMAT "%8.2"
 /begin AXIS_DESCR STD_AXIS GEVCtl_tOilPhaEna Temp_Cels 4 -3549.940 3003.560 FORMAT "%8.3" DEPOSIT ABSOLUTE /end AXIS_DESCR
/end CHARACTERISTIC
/begin CHARACTERISTIC GEVCtl_nEngMinPhaEnaIntk_T "min threshold of engine speed to enable inlet camshaft control" CURVE 0x80550C36 RB_Curve_S16_S16 32767.50 EngN -16384.00 16383.50 FORMAT "%8.2"
 /begin AXIS_DESCR STD_AXIS GEVCtl_tOilPhaEna Temp_Cels 4 -3549.940 3003.560 FORMAT "%8.3" DEPOSIT ABSOLUTE /end AXIS_DESCR
/end CHARACTERISTIC
/begin AXIS_PTS GEVCtl_nEngStdIdle_Ax "Group axis for engine speed while ideling (not catheating)" 0x80550B7A Epm_nEng RB_Axis_S16 32767.50 EngN 4 -16384.00 16383.50 FORMAT "%8.2" DEPOSIT ABSOLUTE /end AXIS_PTS
/begin AXIS_PTS GEVCtl_nEng_Ax "Group axis for engine speed" 0x80550B84 Epm_nEng RB_Axis_S16 32767.50 EngN 16 -16384.00 16383.50 FORMAT "%8.2" DEPOSIT ABSOLUTE /end AXIS_PTS
/begin CHARACTERISTIC GEVCtl_nHysPhaFctReqDiag_C "Hysteresis engine speed for diagnoses function request of phaseshifting camshaft" VALUE 0x805546EE RB_Val_Wu8 10200. EngN_LRes 0.00 10200. FORMAT "%5.0" /end CHARACTERISTIC
/begin CHARACTERISTIC GEVCtl_nHysSpIdleIntk_C "Hysteresis threshold engine speed activation idling maps desired value map intake camshaft" VALUE 0x805540C2 RB_Val_Wu16 16383.50 EngN 0.00 16383.50 FORMAT "%8.2" EXTENDED_LIMITS 0.00 32767.50 /end CHARACTERISTIC
/begin CHARACTERISTIC GEVCtl_nMinPhaFctReqDiag_C "Minimum engine speed for diagnoses function request of phaseshifting camshaft" VALUE 0x805546EF RB_Val_Wu8 10200. EngN_LRes 0.00 10200. FORMAT "%5.0" /end CHARACTERISTIC
/begin CHARACTERISTIC GEVCtl_nrMaxClngCycErrIntk_C "Maximum number of cleaning cycles (intake) during camshaft error" VALUE 0x80554704 RB_Val_Wu8 255.0 OneToOne 0.00 255.0 FORMAT "%5.1" /end CHARACTERISTIC
/begin CHARACTERISTIC GEVCtl_nrMaxClngCycIntk_C "Maximum number of cleaning cycles (intake) per driving cycle" VALUE 0x80554705 RB_Val_Wu8 255.0 OneToOne 0.00 255.0 FORMAT "%5.1" /end CHARACTERISTIC
/begin CHARACTERISTIC GEVCtl_nrMaxPhaRelsAtmptIntk_C "Max. no. of release attempts at locked intake camshaft" VALUE 0x8055471C RB_Val_Wu8 255.0 OneToOne 0.00 255.0 FORMAT "%5.1" /end CHARACTERISTIC
/begin CHARACTERISTIC GEVCtl_nrShkEveIntk_C "Number of setpoint jumps per cleaning cycle of the intake camshaft" VALUE 0x80554706 RB_Val_Wu8 255.0 OneToOne 0.00 255.0 FORMAT "%5.1" /end CHARACTERISTIC
/begin CHARACTERISTIC GEVCtl_nrShkEvePostDrv_C "Number of setpoint jumps for the cleaning cycle during PostDrive" VALUE 0x80554707 RB_Val_Wu8 127.0 OneToOne 0.00 127.0 FORMAT "%5.1" EXTENDED_LIMITS 0.00 255.0 /end CHARACTERISTIC
/begin CHARACTERISTIC GEVCtl_nSpIdleIntk_C "Threshold engine speed activation idling maps desired value map intake camshaft" VALUE 0x805540C4 RB_Val_Wu16 16383.50 EngN 0.00 16383.50 FORMAT "%8.2" EXTENDED_LIMITS 0.00 32767.50 /end CHARACTERISTIC
/begin CHARACTERISTIC GEVCtl_pOilThdDeltaPhaEna_C "Oil pressure delta threshold for activation of camshaft phase adjustment release" VALUE 0x80550A1A RB_Val_Ws16 65535.00 Pres_hPa -32768.00 32767.00 FORMAT "%8.2" /end CHARACTERISTIC
/begin CHARACTERISTIC GEVCtl_pOilThdPhaEna_C "Oil pressure threshold for activation of camshaft phase adjustment release" VALUE 0x80550A1C RB_Val_Ws16 65535.00 Pres_hPa -32768.00 32767.00 FORMAT "%8.2" /end CHARACTERISTIC
/begin CHARACTERISTIC GEVCtl_RampSigIntk_I.vGrdtTstFct_T "Class instance calibrated setpoint ramp signal intake / Gradients of calibrated setpoint ramp" CURVE 0x805509F8 RB_Curve_U8_U16_Static 2047.938 q0p0625_degCrS_DIV_s 0.00 2047.938 FORMAT "%8.3" EXTENDED_LIMITS 0.00 4095.938
 /begin AXIS_DESCR STD_AXIS GEVCtl_RampSigIntk_I.idxGrdtTstFctRepn OneToOne 10 0.00 255.0 FORMAT "%5.1" DEPOSIT ABSOLUTE /end AXIS_DESCR
/end CHARACTERISTIC
/begin AXIS_PTS GEVCtl_ratLoadIdle_Ax "Group axis for engine load while ideling" 0x80550BA6 GEVCtl_ratLoad RB_Axis_U16 1535.977 rel_uw_q0p0234 4 0.00 1535.977 FORMAT "%8.3" DEPOSIT ABSOLUTE /end AXIS_PTS
/begin AXIS_PTS GEVCtl_ratLoadLoLft_Ax "Group axis for engine load at low valve lift" 0x80550BB0 GEVCtl_ratLoad RB_Axis_U16 1535.977 rel_uw_q0p0234 16 0.00 1535.977 FORMAT "%8.3" DEPOSIT ABSOLUTE /end AXIS_PTS
/begin CHARACTERISTIC GEVCtl_ratLoadLo_C "Threshold for air charge until some special filter features are active" VALUE 0x805540C6 RB_Val_Wu16 1535.977 rel_q0p0234 0.00 1535.977 FORMAT "%8.3" /end CHARACTERISTIC
/begin AXIS_PTS GEVCtl_ratLoadStdIdle_Ax "Group axis for engine load while idling (not catheating)" 0x80550BD2 GEVCtl_ratLoad RB_Axis_U16 1535.977 rel_uw_q0p0234 4 0.00 1535.977 FORMAT "%8.3" DEPOSIT ABSOLUTE /end AXIS_PTS
/begin AXIS_PTS GEVCtl_ratLoad_Ax "Group axis for engine load" 0x80550BDC GEVCtl_ratLoad RB_Axis_U16 1535.977 rel_uw_q0p0234 16 0.00 1535.977 FORMAT "%8.3" DEPOSIT ABSOLUTE /end AXIS_PTS
/begin CHARACTERISTIC GEVCtl_stAdapErrSim_C "Codeword to avoid prohibition of fine adaption while camshaft controller is in error simulation" VALUE 0x805509E5 RB_Val_Wu8 255.0 OneToOne 0.00 255.0 FORMAT "%5.1" /end CHARACTERISTIC
/begin CHARACTERISTIC GEVCtl_stCfgCalSuprt_C "Codeword for setpoint calibration" VALUE 0x805509E6 RB_Val_Wu8 255.0 OneToOne 0.00 255.0 FORMAT "%5.1" /end CHARACTERISTIC
/begin CHARACTERISTIC GEVCtl_stCsersExhDiaCfg_C "Codeword for definition of exhaust diagnoses that are part of catalyst heating strategy" VALUE 0x805540C8 RB_Val_Wu16 65535.00 OneToOne 0.00 65535.00 FORMAT "%8.2" /end CHARACTERISTIC
/begin CHARACTERISTIC GEVCtl_stErrIntkB1_C "Codeword for error simulation activation intake B1" VALUE 0x805509E7 RB_Val_Wu8 255.0 OneToOne 0.00 255.0 FORMAT "%5.1" /end CHARACTERISTIC
/begin CHARACTERISTIC GEVCtl_stNonCsersIntkCfg_C "Codeword for definition of exhaust diagnoses that are part of CSERS strategy" VALUE 0x805540CA RB_Val_Wu8 255.0 OneToOne 0.00 255.0 FORMAT "%5.1" /end CHARACTERISTIC
/begin CHARACTERISTIC GEVCtl_stOperModSim_C "Codeword for simulation of operating mode" VALUE 0x805509E8 RB_Val_Wu8 255.0 OneToOne 0.00 255.0 FORMAT "%5.1" /end CHARACTERISTIC
/begin CHARACTERISTIC GEVCtl_stPhaActrTestEnaFct_C "Status ETC-tester activation of the actuator camshaft diagnosis short trip for the calibration phase" VALUE 0x805546F0 RB_Val_Wu8 255.0 OneToOne 0.00 255.0 FORMAT "%5.1" /end CHARACTERISTIC
/begin CHARACTERISTIC GEVCtl_stPhaAdpr_C "Codeword interface test" VALUE 0x80550BFE RB_Val_Wu8 255.0 OneToOne 0.00 255.0 FORMAT "%5.1" /end CHARACTERISTIC
/begin CHARACTERISTIC GEVCtl_stPhaCtrlGlb_C "code word: camshaft control global" VALUE 0x80550C48 RB_Val_Wu8 255.0 dez 0.00 255.0 FORMAT "%5.1" /end CHARACTERISTIC
/begin CHARACTERISTIC GEVCtl_stPhaEna_C "Codeword for configuration of GEVCtl_PhaEna" VALUE 0x80550C49 RB_Val_Wu8 255.0 OneToOne 0.00 255.0 FORMAT "%5.1" /end CHARACTERISTIC
/begin CHARACTERISTIC GEVCtl_stPhaErrSim_C "Codeword for activation of phase error simulation in calibration mode" VALUE 0x805509E9 RB_Val_Wu8 255.0 OneToOne 0.00 255.0 FORMAT "%5.1" /end CHARACTERISTIC
/begin CHARACTERISTIC GEVCtl_stPhaSpclSpOper_C "Codeword for the function GEVCtl_PhaSpclSpOper" VALUE 0x80554708 RB_Val_Wu8 255.0 OneToOne 0.00 255.0 FORMAT "%5.1" /end CHARACTERISTIC
/begin CHARACTERISTIC GEVCtl_stPhaSpExtdIntk_C "Status: Bit coded feature selection in function GEVCtl_PhaSpIntk" VALUE 0x805540CC RB_Val_Wu16 65535.00 dez 0.00 65535.00 FORMAT "%8.2" /end CHARACTERISTIC
/begin CHARACTERISTIC GEVCtl_stPhaSpIntkVlvLft_C "Status: Bit coded selection what intake valve lift will be used in which camshaft setpoint mode in function GEVCtl_PhaSpIntk" VALUE 0x805540CE RB_Val_Wu16 65535.00 OneToOne 0.00 65535.00 FORMAT "%8.2" /end CHARACTERISTIC
/begin CHARACTERISTIC GEVCtl_stPhaSpIntk_C "Status: Bit coded feature selection in function GEVCtl_PhaSpIntk" VALUE 0x805540D0 RB_Val_Wu16 65535.00 OneToOne 0.00 65535.00 FORMAT "%8.2" /end CHARACTERISTIC
/begin CHARACTERISTIC GEVCtl_stPhaSpSupExtdIntk_C "Status: Bit coded feature selection in function GEVCtl_PhaSpIntk (extended extended)" VALUE 0x805540D2 RB_Val_Wu16 65535.00 OneToOne 0.00 65535.00 FORMAT "%8.2" /end CHARACTERISTIC
/begin CHARACTERISTIC GEVCtl_stPOilMdl_C "Codeword for configuration of GEVCtl_POilMdl" VALUE 0x80550A1E RB_Val_Wu8 255.0 OneToOne 0.00 255.0 FORMAT "%5.1" /end CHARACTERISTIC
/begin CHARACTERISTIC GEVCtl_stRatLoadSeln_C "Status word selection interface engine load" VALUE 0x80550BFF RB_Val_Wu8 255.0 dez 0.00 255.0 FORMAT "%5.1" /end CHARACTERISTIC
/begin CHARACTERISTIC GEVCtl_stSpCalSuprtIntk_C "Codeword calibrated setpoint activation intake" VALUE 0x805509EA RB_Val_Wu8 255.0 OneToOne 0.00 255.0 FORMAT "%5.1" /end CHARACTERISTIC
/begin CHARACTERISTIC GEVCtl_stUnlckCtrlIntk_C "Codeword for the unlock function of the intake camshaft" VALUE 0x8055471D RB_Val_Wu8 255.0 OneToOne 0.00 255.0 FORMAT "%5.1" /end CHARACTERISTIC
/begin CHARACTERISTIC GEVCtl_tEngStrtMaxOilPresEna_C "Maximal motor start temperature under which the oil pressure information is required for camshaft release" VALUE 0x80550C4A RB_Val_Ws16 6553.500 Temp_Cels -3549.940 3003.560 FORMAT "%8.3" /end CHARACTERISTIC
/begin CHARACTERISTIC GEVCtl_tiActrReactnToutIntk_T "Curve delay time until actual value = desired value (intake)" CURVE 0x805540D4 RB_Curve_S16_U16_Static 655.3500 t_q0p01 0.00 655.3500 FORMAT "%8.4"
 /begin AXIS_DESCR STD_AXIS GEVCtl_tOilCylHd Temp_Cels 4 -3549.940 3003.560 FORMAT "%8.3" DEPOSIT ABSOLUTE /end AXIS_DESCR
/end CHARACTERISTIC
/begin CHARACTERISTIC GEVCtl_tiAgSpCalSuprtTogPerdIntk_C "Duration of calibrated setpoint jump period intake" VALUE 0x805509EC RB_Val_Wu16 655.3500 t_q0p01 0.00 655.3500 FORMAT "%8.4" /end CHARACTERISTIC
/begin CHARACTERISTIC GEVCtl_tiAgSpFilNegDe1Intk_M "Time constant setpoint filter intake camshaft in case of negative setpoint difference at filter input and index 1" MAP 0x805540E6 RB_Map_U16U16_U16 2.550000 t_q0p01 0.010000 2.560000 FORMAT "%8.6" EXTENDED_LIMITS 0.00 655.3500
 /begin AXIS_DESCR STD_AXIS Epm_nEng EngN 8 0.00 16383.50 FORMAT "%8.2" EXTENDED_LIMITS 0.00 32767.50 DEPOSIT ABSOLUTE /end AXIS_DESCR
 /begin AXIS_DESCR STD_AXIS GEVCtl_ratLoad rel_q0p0234 8 0.00 1535.977 FORMAT "%8.3" DEPOSIT ABSOLUTE /end AXIS_DESCR
/end CHARACTERISTIC
/begin CHARACTERISTIC GEVCtl_tiAgSpFilNegDe2Intk_M "Time constant setpoint filter intake camshaft in case of negative setpoint difference at filter input and index 2" MAP 0x8055418A RB_Map_U16U16_U16 2.550000 t_q0p01 0.010000 2.560000 FORMAT "%8.6" EXTENDED_LIMITS 0.00 655.3500
 /begin AXIS_DESCR STD_AXIS Epm_nEng EngN 8 0.00 16383.50 FORMAT "%8.2" EXTENDED_LIMITS 0.00 32767.50 DEPOSIT ABSOLUTE /end AXIS_DESCR
 /begin AXIS_DESCR STD_AXIS GEVCtl_ratLoad rel_q0p0234 8 0.00 1535.977 FORMAT "%8.3" DEPOSIT ABSOLUTE /end AXIS_DESCR
/end CHARACTERISTIC
/begin CHARACTERISTIC GEVCtl_tiAgSpFilNegDe3Intk_M "Time constant setpoint filter intake camshaft in case of negative setpoint difference at filter input and index 3" MAP 0x8055422E RB_Map_U16U16_U16 2.550000 t_q0p01 0.010000 2.560000 FORMAT "%8.6" EXTENDED_LIMITS 0.00 655.3500
 /begin AXIS_DESCR STD_AXIS Epm_nEng EngN 8 0.00 16383.50 FORMAT "%8.2" EXTENDED_LIMITS 0.00 32767.50 DEPOSIT ABSOLUTE /end AXIS_DESCR
 /begin AXIS_DESCR STD_AXIS GEVCtl_ratLoad rel_q0p0234 8 0.00 1535.977 FORMAT "%8.3" DEPOSIT ABSOLUTE /end AXIS_DESCR
/end CHARACTERISTIC
/begin CHARACTERISTIC GEVCtl_tiAgSpFilPosDe1Intk_M "Time constant setpoint filter inlet camshaft in case of positive setpoint difference at filter input and index 1" MAP 0x805542D2 RB_Map_U16U16_U16 2.550000 t_q0p01 0.010000 2.560000 FORMAT "%8.6" EXTENDED_LIMITS 0.00 655.3500
 /begin AXIS_DESCR STD_AXIS Epm_nEng EngN 8 0.00 16383.50 FORMAT "%8.2" EXTENDED_LIMITS 0.00 32767.50 DEPOSIT ABSOLUTE /end AXIS_DESCR
 /begin AXIS_DESCR STD_AXIS GEVCtl_ratLoad rel_q0p0234 8 0.00 1535.977 FORMAT "%8.3" DEPOSIT ABSOLUTE /end AXIS_DESCR
/end CHARACTERISTIC
/begin CHARACTERISTIC GEVCtl_tiAgSpFilPosDe2Intk_M "Time constant setpoint filter inlet camshaft in case of positive setpoint difference at filter input and index 2" MAP 0x80554376 RB_Map_U16U16_U16 2.550000 t_q0p01 0.010000 2.560000 FORMAT "%8.6" EXTENDED_LIMITS 0.00 655.3500
 /begin AXIS_DESCR STD_AXIS Epm_nEng EngN 8 0.00 16383.50 FORMAT "%8.2" EXTENDED_LIMITS 0.00 32767.50 DEPOSIT ABSOLUTE /end AXIS_DESCR
 /begin AXIS_DESCR STD_AXIS GEVCtl_ratLoad rel_q0p0234 8 0.00 1535.977 FORMAT "%8.3" DEPOSIT ABSOLUTE /end AXIS_DESCR
/end CHARACTERISTIC
/begin CHARACTERISTIC GEVCtl_tiAgSpFilPosDe3Intk_M "Time constant setpoint filter inlet camshaft in case of positive setpoint difference at filter input and index 3" MAP 0x8055441A RB_Map_U16U16_U16 2.550000 t_q0p01 0.010000 2.560000 FORMAT "%8.6" EXTENDED_LIMITS 0.00 655.3500
 /begin AXIS_DESCR STD_AXIS Epm_nEng EngN 8 0.00 16383.50 FORMAT "%8.2" EXTENDED_LIMITS 0.00 32767.50 DEPOSIT ABSOLUTE /end AXIS_DESCR
 /begin AXIS_DESCR STD_AXIS GEVCtl_ratLoad rel_q0p0234 8 0.00 1535.977 FORMAT "%8.3" DEPOSIT ABSOLUTE /end AXIS_DESCR
/end CHARACTERISTIC
/begin CHARACTERISTIC GEVCtl_tiAgSpFilSlowTiTranIntk_T "Slow time constant for desired value change limitation intake camshaft" CURVE 0x805544BE RB_Curve_S16_U16_Static 2.550000 t_q0p01 0.010000 2.560000 FORMAT "%8.6" EXTENDED_LIMITS 0.00 655.3500
 /begin AXIS_DESCR STD_AXIS GEVCtl_tOilCylHd Temp_Cels 6 -3549.940 3003.560 FORMAT "%8.3" DEPOSIT ABSOLUTE /end AXIS_DESCR
/end CHARACTERISTIC
/begin CHARACTERISTIC GEVCtl_tiAgSpFilUnstyMod1Intk_M "Time constant setpoint filter inlet camshaft in unsteady state and index 1" MAP 0x805544D8 RB_Map_U16U16_U16 2.550000 t_q0p01 0.010000 2.560000 FORMAT "%8.6" EXTENDED_LIMITS 0.00 655.3500
 /begin AXIS_DESCR STD_AXIS Epm_nEng EngN 8 0.00 16383.50 FORMAT "%8.2" EXTENDED_LIMITS 0.00 32767.50 DEPOSIT ABSOLUTE /end AXIS_DESCR
 /begin AXIS_DESCR STD_AXIS GEVCtl_ratLoad rel_q0p0234 8 0.00 1535.977 FORMAT "%8.3" DEPOSIT ABSOLUTE /end AXIS_DESCR
/end CHARACTERISTIC
/begin CHARACTERISTIC GEVCtl_tiAgSpFilUnstyMod2Intk_M "Time constant setpoint filter inlet camshaft in unsteady state and index 2" MAP 0x8055457C RB_Map_U16U16_U16 2.550000 t_q0p01 0.010000 2.560000 FORMAT "%8.6" EXTENDED_LIMITS 0.00 655.3500
 /begin AXIS_DESCR STD_AXIS Epm_nEng EngN 8 0.00 16383.50 FORMAT "%8.2" EXTENDED_LIMITS 0.00 32767.50 DEPOSIT ABSOLUTE /end AXIS_DESCR
 /begin AXIS_DESCR STD_AXIS GEVCtl_ratLoad rel_q0p0234 8 0.00 1535.977 FORMAT "%8.3" DEPOSIT ABSOLUTE /end AXIS_DESCR
/end CHARACTERISTIC
/begin CHARACTERISTIC GEVCtl_tiAgSpFilUnstyMod3Intk_M "Time constant setpoint filter inlet camshaft in unsteady state and index 3" MAP 0x80554620 RB_Map_U16U16_U16 2.550000 t_q0p01 0.010000 2.560000 FORMAT "%8.6" EXTENDED_LIMITS 0.00 655.3500
 /begin AXIS_DESCR STD_AXIS Epm_nEng EngN 8 0.00 16383.50 FORMAT "%8.2" EXTENDED_LIMITS 0.00 32767.50 DEPOSIT ABSOLUTE /end AXIS_DESCR
 /begin AXIS_DESCR STD_AXIS GEVCtl_ratLoad rel_q0p0234 8 0.00 1535.977 FORMAT "%8.3" DEPOSIT ABSOLUTE /end AXIS_DESCR
/end CHARACTERISTIC
/begin CHARACTERISTIC GEVCtl_tiAgSpFilVlvLftSwtIntk_T "Time constant setpoint filter intake camshaft in case of valve lift switching" CURVE 0x805546C4 RB_Curve_U16_U16 2.550000 t_q0p01 0.010000 2.560000 FORMAT "%8.6" EXTENDED_LIMITS 0.00 655.3500
 /begin AXIS_DESCR STD_AXIS Epm_nEng EngN 8 0.00 16383.50 FORMAT "%8.2" EXTENDED_LIMITS 0.00 32767.50 DEPOSIT ABSOLUTE /end AXIS_DESCR
/end CHARACTERISTIC
/begin CHARACTERISTIC GEVCtl_tiBtwShkEvePostDrvHi_C "Dwell time between the setpoint jumps during cleaning in PostDrive higher threshold" VALUE 0x80554709 RB_Val_Wu8 2.550 t_q0p01 0.00 2.550 FORMAT "%5.3" /end CHARACTERISTIC
/begin CHARACTERISTIC GEVCtl_tiBtwShkEvePostDrvLo_C "Time between shake events post drive for low duty cycle" VALUE 0x8055470A RB_Val_Wu8 2.550 t_q0p01 0.00 2.550 FORMAT "%5.3" /end CHARACTERISTIC
/begin CHARACTERISTIC GEVCtl_tiDebJitObsPha_M "Debounce time jitter-observation camshaft" MAP 0x80550A20 RB_Map_S16U16_U8 127.5 t_q0p5 0.00 127.5 FORMAT "%5.1"
 /begin AXIS_DESCR STD_AXIS CEngDsT_t Temp_Cels 6 -3549.940 3003.560 FORMAT "%8.3" DEPOSIT ABSOLUTE /end AXIS_DESCR
 /begin AXIS_DESCR STD_AXIS GEVCtl_tiTiEngOff t_q1 4 0.00 32767.00 FORMAT "%8.2" EXTENDED_LIMITS 0.00 65535.00 DEPOSIT ABSOLUTE /end AXIS_DESCR
/end CHARACTERISTIC
/begin CHARACTERISTIC GEVCtl_tiDebOilPEna_M "Debounce time for camshaft release based on oil pressure in oil swamp for Start-stop start." MAP 0x80550A50 RB_Map_S16U16_U16 655.3500 t_q0p01 0.00 655.3500 FORMAT "%8.4"
 /begin AXIS_DESCR STD_AXIS GEVCtl_tOilCylHd Temp_Cels 8 -3549.940 3003.560 FORMAT "%8.3" DEPOSIT ABSOLUTE /end AXIS_DESCR
 /begin AXIS_DESCR STD_AXIS GEVCtl_tiTiEngOff t_q1 6 0.00 32767.00 FORMAT "%8.2" EXTENDED_LIMITS 0.00 65535.00 DEPOSIT ABSOLUTE /end AXIS_DESCR
/end CHARACTERISTIC
/begin CHARACTERISTIC GEVCtl_tiDebOilPEna_T "Debounce time for camshaft release based on oil pressure in oil swamp" CURVE 0x80550AD0 RB_Curve_S16_U16_Static 655.3500 t_q0p01 0.00 655.3500 FORMAT "%8.4"
 /begin AXIS_DESCR STD_AXIS GEVCtl_tOilCylHd Temp_Cels 8 -3549.940 3003.560 FORMAT "%8.3" DEPOSIT ABSOLUTE /end AXIS_DESCR
/end CHARACTERISTIC
/begin CHARACTERISTIC GEVCtl_tiDlyClngPostDrvIntk_C "Delay time before the cleaning of the intake camshaft is activated in PostDrive" VALUE 0x8055470C RB_Val_Wu16 655.3500 t_q0p01 0.00 655.3500 FORMAT "%8.4" /end CHARACTERISTIC
/begin CHARACTERISTIC GEVCtl_tiDlyEngMinPhaDeactvIntk_C "Delay time to deactivate the intake camshaft adjustment when the engine speed is within certain threshold" VALUE 0x80550C4C RB_Val_Wu16 655.3500 t_q0p01 0.00 655.3500 FORMAT "%8.4" /end CHARACTERISTIC
/begin CHARACTERISTIC GEVCtl_tiDlyFastFildgIntk_C "Waiting time in case of start stop starts, during which the large time constant for the intake camshaft setpoint filtering is used" VALUE 0x805546E6 RB_Val_Wu16 655.3500 t_q0p01 0.00 655.3500 FORMAT "%8.4" /end CHARACTERISTIC
/begin CHARACTERISTIC GEVCtl_tiDlyPhaEnaEngOff_M "Time delay after start for camshaft release depending on engine-off time" MAP 0x80550C4E RB_Map_U16S16_U16 655.3500 t_q0p01 0.00 655.3500 FORMAT "%8.4"
 /begin AXIS_DESCR STD_AXIS NO_INPUT_QUANTITY t_q1 6 0.00 65535.00 FORMAT "%8.2" DEPOSIT ABSOLUTE /end AXIS_DESCR
 /begin AXIS_DESCR STD_AXIS GEVCtl_tEngStrt Temp_Cels 8 -3549.940 3003.560 FORMAT "%8.3" DEPOSIT ABSOLUTE /end AXIS_DESCR
/end CHARACTERISTIC
/begin CHARACTERISTIC GEVCtl_tiDlyPhaEnaPOil_T "Time delay of camshaft release due to oil pressure" CURVE 0x80550CCE RB_Curve_S16_U16_Static 655.3500 t_q0p01 0.00 655.3500 FORMAT "%8.4"
 /begin AXIS_DESCR STD_AXIS CEngDsT_tStrt Temp_Cels 8 -3549.940 3003.560 FORMAT "%8.3" DEPOSIT ABSOLUTE /end AXIS_DESCR
/end CHARACTERISTIC
/begin CHARACTERISTIC GEVCtl_tiEnaOilPOk_M "map time delay enabling oil presure is okey" MAP 0x80550AF2 RB_Map_S16S16_U16 655.3500 t_q0p01 0.00 655.3500 FORMAT "%8.4"
 /begin AXIS_DESCR STD_AXIS GEVCtl_nEngLRes EngN_LRes 4 0.00 10200.00 FORMAT "%8.2" EXTENDED_LIMITS -1310720. 1310680. DEPOSIT ABSOLUTE /end AXIS_DESCR
 /begin AXIS_DESCR STD_AXIS GEVCtl_tOilCylHd Temp_Cels 8 -3549.940 3003.560 FORMAT "%8.3" DEPOSIT ABSOLUTE /end AXIS_DESCR
/end CHARACTERISTIC
/begin CHARACTERISTIC GEVCtl_tiGrdtTstFctDebIntk_C "Time of flat signal between calibrated setpoint ramps intake" VALUE 0x805509EE RB_Val_Wu16 655.3500 t_q0p01 0.00 655.3500 FORMAT "%8.4" /end CHARACTERISTIC
/begin CHARACTERISTIC GEVCtl_tiLveLockPosnRngIntk_M "Time, which the intake camshaft has to leave the locking position after an adjustment request, before the unlock mechanism starts" MAP 0x8055471E RB_Map_U8S16_U8 2.550 t_q0p01 0.00 2.550 FORMAT "%5.3"
 /begin AXIS_DESCR STD_AXIS Epm_nEngLRes EngN_LRes 5 0.00 10200. FORMAT "%5.0" DEPOSIT ABSOLUTE /end AXIS_DESCR
 /begin AXIS_DESCR STD_AXIS GEVCtl_tOilCylHd Temp_Cels 5 -3549.940 3003.560 FORMAT "%8.3" DEPOSIT ABSOLUTE /end AXIS_DESCR
/end CHARACTERISTIC
/begin CHARACTERISTIC GEVCtl_tiPerdClngIntk_C "Dwell time between the setpoint jumps of the intake camshaft during cleaning" VALUE 0x8055470E RB_Val_Wu8 2.550 t_q0p01 0.00 2.550 FORMAT "%5.3" /end CHARACTERISTIC
/begin CHARACTERISTIC GEVCtl_tiPhaActvPosnTstrIntk_C "Dwell time in the active position during actuator test of intake camshaft (short trip)" VALUE 0x805546F2 RB_Val_Wu16 655.3500 Time_s 0.00 655.3500 FORMAT "%8.4" /end CHARACTERISTIC
/begin CHARACTERISTIC GEVCtl_tiPhaEnaEngOffThd_C "Maximum engine-off time to allow a shorter delay time after start for the camshaft release" VALUE 0x80550CF0 RB_Val_Ws32 4294967295.00 Time_sec_q1_COMPU -2147483648.00 2147483647.00 FORMAT "%13.2" /end CHARACTERISTIC
/begin CHARACTERISTIC GEVCtl_tiPhaEnaIntk_T "delay time : enable of inlet camshaft control after start, depending on engine temp" CURVE 0x80550CF4 RB_Curve_S16_U16_Static 655.3500 t_q0p01 0.00 655.3500 FORMAT "%8.4"
 /begin AXIS_DESCR STD_AXIS GEVCtl_tEngStrt Temp_Cels 6 -3549.940 3003.560 FORMAT "%8.3" DEPOSIT ABSOLUTE /end AXIS_DESCR
/end CHARACTERISTIC
/begin CHARACTERISTIC GEVCtl_tiPhaErrSimAdvIntk_C "Time constant for setpoint value filtering for error simulation intake into advanced direction" VALUE 0x805509F0 RB_Val_Wu16 655.34999985 zk10msxs_uw_b655p36 0.01000015 655.36000000 FORMAT "%12.8" EXTENDED_LIMITS 0.010000152590 655.36000000 /end CHARACTERISTIC
/begin CHARACTERISTIC GEVCtl_tiPhaErrSimRtdIntk_C "Time constant intake setpoint value filtering for error simulation into retarded direction" VALUE 0x805509F2 RB_Val_Wu16 655.34999985 zk10msxs_uw_b655p36 0.01000015 655.36000000 FORMAT "%12.8" EXTENDED_LIMITS 0.010000152590 655.36000000 /end CHARACTERISTIC
/begin CHARACTERISTIC GEVCtl_tiPhaPasPosnTstrIntk_C "Dwell time in the passive position during actuator test of intake camshaft (short trip)" VALUE 0x805546F4 RB_Val_Wu16 655.3500 Time_s 0.00 655.3500 FORMAT "%8.4" /end CHARACTERISTIC
/begin CHARACTERISTIC GEVCtl_tiPhaSpRampTstrIntk_C "Time constant for setpoint ramp during intake camshaft actuator test (short trip)" VALUE 0x805546F6 RB_Val_Wu16 3276.7499992 zk50msxs_uw_b3276p8 0.0500008 3276.8000000 FORMAT "%12.7" EXTENDED_LIMITS 0.050000762951 3276.8000000 /end CHARACTERISTIC
/begin CHARACTERISTIC GEVCtl_tiPhaStrtTstrIntk_C "waiting time before intake camshaft adjustment by tester starts" VALUE 0x805546F8 RB_Val_Wu16 655.3500 Time_s 0.00 655.3500 FORMAT "%8.4" /end CHARACTERISTIC
/begin CHARACTERISTIC GEVCtl_tiTogErrSuspcIntk_C "Duration of the alternating duty cycle jumps after error suspicion of the intake camshaft" VALUE 0x8055474A RB_Val_Wu8 2.550 t_q0p01 0.00 2.550 FORMAT "%5.3" /end CHARACTERISTIC
/begin CHARACTERISTIC GEVCtl_tiTogOutLockPosnIntk_C "Duration of the duty cycle jumps away from the locking position for unlocking the intake camshaft" VALUE 0x8055474B RB_Val_Wu8 2.550 t_q0p01 0.00 2.550 FORMAT "%5.3" /end CHARACTERISTIC
/begin CHARACTERISTIC GEVCtl_tiTogToLockPosnIntk_C "Duration of the duty cycle jumps towards the locking position for unlocking the intake camshaft" VALUE 0x8055474C RB_Val_Wu8 2.550 t_q0p01 0.00 2.550 FORMAT "%5.3" /end CHARACTERISTIC
/begin CHARACTERISTIC GEVCtl_tiUnlckForAdpnIntk_C "Duration of the duty cycle jump for unlocking the intake camshaft before adaptation" VALUE 0x8055474D RB_Val_Wu8 2.550 t_q0p01 0.00 2.550 FORMAT "%5.3" /end CHARACTERISTIC
/begin CHARACTERISTIC GEVCtl_tiWaitForNxtUnlckIntk_C "Maximum waiting time, before a new unlock cycle for the intake camshaft is started" VALUE 0x8055474E RB_Val_Wu16 655.3500 t_q0p01 0.00 655.3500 FORMAT "%8.4" /end CHARACTERISTIC
/begin CHARACTERISTIC GEVCtl_tOilCylHdMinIntk_C "Oil temperature threshold, which enables functionality to jump to late position while small relative air charge" VALUE 0x805546E8 RB_Val_Ws16 6553.500 Temp_Cels -3549.940 3003.560 FORMAT "%8.3" /end CHARACTERISTIC
/begin CHARACTERISTIC GEVCtl_tOilFrznModMaxIntk_C "Temperature threshold, below setpoint angles are being overwritten by calibratable Frozen Mode angle (intake)" VALUE 0x805546EA RB_Val_Ws16 6553.500 Temp_Cels -3549.940 3003.560 FORMAT "%8.3" /end CHARACTERISTIC
/begin CHARACTERISTIC GEVCtl_tOilMaxClngPostDrv_C "Maximum oil temperature for the cleaning in PostDrive" VALUE 0x80554710 RB_Val_Ws16 6553.500 Temp_Cels -3549.940 3003.560 FORMAT "%8.3" /end CHARACTERISTIC
/begin CHARACTERISTIC GEVCtl_tOilMaxClng_C "Maximum oil temperature for the cleaning in fuel cutoff" VALUE 0x80554712 RB_Val_Ws16 6553.500 Temp_Cels -3549.940 3003.560 FORMAT "%8.3" /end CHARACTERISTIC
/begin CHARACTERISTIC GEVCtl_tOilMaxPhaEna_C "Max. threshold of oil temperature to enable camshaft control" VALUE 0x80550D0E RB_Val_Ws16 6553.500 Temp_Cels -3549.940 3003.560 FORMAT "%8.3" /end CHARACTERISTIC
/begin CHARACTERISTIC GEVCtl_tOilMinClngPostDrv_C "Minimum oil temperature for the cleaning in PostDrive" VALUE 0x80554714 RB_Val_Ws16 6553.500 Temp_Cels -3549.940 3003.560 FORMAT "%8.3" /end CHARACTERISTIC
/begin CHARACTERISTIC GEVCtl_tOilMinClng_C "Minimum oil temperature for the cleaning in fuel cutoff" VALUE 0x80554716 RB_Val_Ws16 6553.500 Temp_Cels -3549.940 3003.560 FORMAT "%8.3" /end CHARACTERISTIC
/begin CHARACTERISTIC GEVCtl_tOilMinPhaEna_C "Min. threshold of oil temperature to enable camshaft control" VALUE 0x80550D10 RB_Val_Ws16 6553.500 Temp_Cels -3549.940 3003.560 FORMAT "%8.3" /end CHARACTERISTIC
/begin CHARACTERISTIC GEVCtl_tOilPhaEnaHys_C "Temperature hysteresis for the avoidance of engine temperature and oil temperature fluctuations" VALUE 0x80550D12 RB_Val_Ws16 6553.500 TempDiff_Cels -3276.800 3276.700 FORMAT "%8.3" /end CHARACTERISTIC
/begin CHARACTERISTIC GEVCtl_tqResvPhaDiagTstr_C "Torque reserve for diagnosis phaseshifting camshaft by tester" VALUE 0x805546FA RB_Val_Wu16 99.99847 rel_uw_b100 0.00 99.99847 FORMAT "%8.5" /end CHARACTERISTIC
/begin CHARACTERISTIC GEVCtl_uBattMaxPhaEna_C "Maximum battery voltage to enable of camshaft control" VALUE 0x80550D14 RB_Val_Ws16 1310700. Volt_Batt -655360.0 655340.0 FORMAT "%8.1" /end CHARACTERISTIC
/begin CHARACTERISTIC GEVCtl_uBattMinPhaEnaHys_C "Hysteresis for minimal battery voltage for activation of camshaft control" VALUE 0x80550D16 RB_Val_Ws16 1310700. Volt_Batt -655360.0 655340.0 FORMAT "%8.1" /end CHARACTERISTIC
/begin CHARACTERISTIC GEVCtl_uBattMinPhaEna_C "Minimum battery voltage to enable of camshaft control" VALUE 0x80550D18 RB_Val_Ws16 1310700. Volt_Batt -655360.0 655340.0 FORMAT "%8.1" /end CHARACTERISTIC
/begin CHARACTERISTIC GEVCtl_vVehLo_C "threshold of vehicle speed until a multiplicative factor is correcting the filter time constant" VALUE 0x805546EC RB_Val_Ws16 327.6700 Vel 0.00 327.6700 FORMAT "%8.4" EXTENDED_LIMITS -327.6800 327.6700 /end CHARACTERISTIC
/begin CHARACTERISTIC SF_NWS "Summary error Camshaft shifting" VAL_BLK 0x8055079E RB_ValA_Wu16 82.0000000000 dfp_verbal 0.00 82.0000000000 FORMAT "%13.10" READ_ONLY NUMBER 3 /end CHARACTERISTIC
/begin CHARACTERISTIC SF_NWSE "Summary error Camshaft shifting inlet" VAL_BLK 0x805507A4 RB_ValA_Wu16 82.0000000000 dfp_verbal 0.00 82.0000000000 FORMAT "%13.10" READ_ONLY NUMBER 4 /end CHARACTERISTIC
/begin CHARACTERISTIC TDDENWS "Distortion time for outlet cam control diagnosis enable in end positions" VALUE 0x805507AC RB_Val_Wu8 12.75 t_q0p05 0.00 12.75 FORMAT "%5.2" /end CHARACTERISTIC
/begin CHARACTERISTIC WNWRAS "angle outlet valve closed in reference position relative to TDC" VALUE 0x805507AE RB_Val_Ws16 511.9922 kw_q0p0078 -256.0000 255.9922 FORMAT "%8.4" /end CHARACTERISTIC
/begin CHARACTERISTIC WNWREO "angle inlet valve opened in reference position relative to TDC" VALUE 0x805507B0 RB_Val_Ws16 511.9922 kw_q0p0078 -256.0000 255.9922 FORMAT "%8.4" /end CHARACTERISTIC
/begin CHARACTERISTIC WNWSMNE "min value of desired angle of inlet camshaft opens (TDC)" VALUE 0x805507B2 RB_Val_Ws16 511.9922 kw_q0p0078 -256.0000 255.9922 FORMAT "%8.4" /end CHARACTERISTIC
/begin CHARACTERISTIC WNWSMXE "max value of desired angle of inlet camshaft opens (TDC)" VALUE 0x805507B4 RB_Val_Ws16 511.9922 kw_q0p0078 -256.0000 255.9922 FORMAT "%8.4" /end CHARACTERISTIC
/begin MEASUREMENT AirSys_bCaSEdgAdapIntk "Request of condition: flank adaption camshaft intake" UBYTE B_TRUE 1 100 0.00 1.00000000000 BIT_MASK 0x1 FORMAT "%13.11" ECU_ADDRESS 0x6000FAD9 /end MEASUREMENT
/begin MEASUREMENT AirSys_bCaSRefAdap "Air System condition camshaft reference adaption" UBYTE B_TRUE 1 100 0.00 1.00000000000 BIT_MASK 0x1 FORMAT "%13.11" ECU_ADDRESS 0x6000F70E /end MEASUREMENT
/begin MEASUREMENT B_anfnwrad "Condition request camshaft reference adaptation" UBYTE B_TRUE 1 100 0.00 1.00000000000 BIT_MASK 0x1 FORMAT "%13.11" ECU_ADDRESS 0x6000B84F /end MEASUREMENT
/begin MEASUREMENT B_dnwcse "Active diagnosis: camshaft control inlet during CSERS" UBYTE B_TRUE 1 100 0.00 1.00000000000 BIT_MASK 0x1 FORMAT "%13.11" ECU_ADDRESS 0x6000B84E /end MEASUREMENT
/begin MEASUREMENT B_dnwse "active diagnosis: camshaft control inlet" UBYTE B_TRUE 1 100 0.00 1.00000000000 BIT_MASK 0x1 FORMAT "%13.11" ECU_ADDRESS 0x6000B84D /end MEASUREMENT
/begin MEASUREMENT B_enws "condition error camshaft control" UBYTE B_TRUE 1 100 0.00 1.00000000000 BIT_MASK 0x1 FORMAT "%13.11" ECU_ADDRESS 0x6000B84C /end MEASUREMENT
/begin MEASUREMENT B_enwse "condition Error camshaft (inlet)" UBYTE B_TRUE 1 100 0.00 1.00000000000 BIT_MASK 0x1 FORMAT "%13.11" ECU_ADDRESS 0x6000F6FA /end MEASUREMENT
/begin MEASUREMENT B_enwsve "condition suspect of error camshaft actuator inlet" UBYTE B_TRUE 1 100 0.00 1.00000000000 BIT_MASK 0x1 FORMAT "%13.11" ECU_ADDRESS 0x6000B84B /end MEASUREMENT
/begin MEASUREMENT B_fanwftve "Condition test advancement diagnosis NWS active (inlet)" UBYTE B_TRUE 1 100 0.00 1.00000000000 BIT_MASK 0x1 FORMAT "%13.11" ECU_ADDRESS 0x6000B84A /end MEASUREMENT
/begin MEASUREMENT B_fanwkwze "Condition tester demand fine adaptationat inlet camshaft done" UBYTE B_TRUE 1 100 0.00 1.00000000000 BIT_MASK 0x1 FORMAT "%13.11" ECU_ADDRESS 0x6000B855 /end MEASUREMENT
/begin MEASUREMENT B_fanwstae_msg "Switchover to desired angle by tester at inlet camshaft" UBYTE B_TRUE 1 100 0.00 1.00000000000 BIT_MASK 0x1 FORMAT "%13.11" ECU_ADDRESS 0x6000F6EE /end MEASUREMENT
/begin MEASUREMENT B_fanwte "Functional demand diagnosis camshaft activation by tester (inlet)" UBYTE B_TRUE 1 100 0.00 1.00000000000 BIT_MASK 0x1 FORMAT "%13.11" ECU_ADDRESS 0x6000B849 /end MEASUREMENT
/begin MEASUREMENT B_fanwtze "End of tester shifting cycle for diagnosis inlet camshaft" UBYTE B_TRUE 1 100 0.00 1.00000000000 BIT_MASK 0x1 FORMAT "%13.11" ECU_ADDRESS 0x6000B848 /end MEASUREMENT
/begin MEASUREMENT B_fnwaktve_msg "Fault at camshaft adjustment (intake) present (not debounced)" UBYTE B_TRUE 1 100 0.00 1.00000000000 BIT_MASK 0x1 FORMAT "%13.11" ECU_ADDRESS 0x6000F6EB /end MEASUREMENT
/begin MEASUREMENT B_nwflade "Request of condition: flank adaption camshaft intake" UBYTE B_TRUE 1 100 0.00 1.00000000000 BIT_MASK 0x1 FORMAT "%13.11" ECU_ADDRESS 0x6000B854 /end MEASUREMENT
/begin MEASUREMENT B_nwrpose "condition: control of camshaft-reference position by actuator (inlet)" UBYTE B_TRUE 1 100 0.00 1.00000000000 BIT_MASK 0x1 FORMAT "%13.11" ECU_ADDRESS 0x6000B853 /end MEASUREMENT
/begin MEASUREMENT B_nws "Condition camshaft control" UBYTE B_TRUE 1 100 0.00 1.00000000000 BIT_MASK 0x1 FORMAT "%13.11" ECU_ADDRESS 0x6000B852 /end MEASUREMENT
/begin MEASUREMENT B_nwswg_msg "condition: desired angle of camshaft(s) valid" UBYTE B_TRUE 1 100 0.00 1.00000000000 BIT_MASK 0x1 FORMAT "%13.11" ECU_ADDRESS 0x6000FA7D /end MEASUREMENT
/begin MEASUREMENT B_nwvfe "Condition release of inlet camshaft control" UBYTE B_TRUE 1 100 0.00 1.00000000000 BIT_MASK 0x1 FORMAT "%13.11" ECU_ADDRESS 0x6000B851 /end MEASUREMENT
/begin MEASUREMENT B_spfnwe "Condition locking errors at inlet camshaft active" UBYTE B_TRUE 1 100 0.00 1.00000000000 BIT_MASK 0x1 FORMAT "%13.11" ECU_ADDRESS 0x6000F6D9 /end MEASUREMENT
/begin MEASUREMENT B_vhegnwzpe_msg "Acknowledge: Request desired positions for phase shift intake camshaft for big or small cam profile" UBYTE B_TRUE 1 100 0.00 1.00000000000 BIT_MASK 0x1 FORMAT "%13.11" ECU_ADDRESS 0x6000FA58 /end MEASUREMENT
/begin MEASUREMENT B_vhenwspe_msg "Acknowledge: Request shifting to retarded mechanical stop position intake camshaft at cam profile switching" UBYTE B_TRUE 1 100 0.00 1.00000000000 BIT_MASK 0x1 FORMAT "%13.11" ECU_ADDRESS 0x6000FA52 /end MEASUREMENT
/begin MEASUREMENT B_vhenwvspe_msg "Confirmation: camshaft has reached position, where charge build-up can start" UBYTE B_TRUE 1 100 0.00 1.00000000000 BIT_MASK 0x1 FORMAT "%13.11" ECU_ADDRESS 0x6000FA50 /end MEASUREMENT
/begin MEASUREMENT B_wgvsvheg_msg "desired angles of inlet camshaft is computed for big lobe" UBYTE B_TRUE 1 100 0.00 1.00000000000 BIT_MASK 0x1 FORMAT "%13.11" ECU_ADDRESS 0x6000FA4E /end MEASUREMENT
/begin MEASUREMENT B_wnwsmnue "condition: desired angle inlet camshaft for the minimum overlap" UBYTE B_TRUE 1 100 0.00 1.00000000000 BIT_MASK 0x1 FORMAT "%13.11" ECU_ADDRESS 0x6000B850 /end MEASUREMENT
/begin MEASUREMENT Com_ctReIni10msEATB "ReInit Counter for EATB frame" UBYTE OneToOne 1 100 0.00 255.0 FORMAT "%5.1" ECU_ADDRESS 0x6000B85D /end MEASUREMENT
/begin MEASUREMENT Com_ctReIni10msEATC "ReInit Counter for EATC frame" UBYTE OneToOne 1 100 0.00 255.0 FORMAT "%5.1" ECU_ADDRESS 0x6000B85B /end MEASUREMENT
/begin MEASUREMENT Com_flgAntiJerkCnvrSlipEna "anti jerk compensation for CVT activ" UBYTE B_TRUE 1 100 0.00 1.00000000000 BIT_MASK 0x1 FORMAT "%13.11" ECU_ADDRESS 0x6000F9C8 /end MEASUREMENT
/begin MEASUREMENT Com_flgAntiJerkCnvrSlipEnaNoDly "Enable Anti-jerk Torque convertor slip flag without delay" UBYTE B_TRUE 1 100 0.00 1.00000000000 BIT_MASK 0x1 FORMAT "%13.11" ECU_ADDRESS 0x6000F9C7 /end MEASUREMENT
/begin MEASUREMENT Com_flgAutCrkActv "Auto crancking status" UBYTE OneToOne 1 100 0.00 255.0 FORMAT "%5.1" ECU_ADDRESS 0x6000FEE2 /end MEASUREMENT
/begin MEASUREMENT Com_flgCVTPNPos "Neutral of Parking position status" UBYTE OneToOne 1 100 0.00 255.0 FORMAT "%5.1" ECU_ADDRESS 0x6000FEE1 /end MEASUREMENT
/begin MEASUREMENT Com_flgDFCSrv7VisClrInProgs "DFC Service7 Visibility Clear in-Progress Flag" UBYTE B_TRUE 1 100 0.00 1.00000000000 BIT_MASK 0x1 FORMAT "%13.11" ECU_ADDRESS 0x6000B85C /end MEASUREMENT
/begin MEASUREMENT Com_flgEATANorm "EATA Frame communication normal flag. (FId_ComEATA is not inhibited)" UBYTE B_TRUE 1 100 0.00 1.00000000000 BIT_MASK 0x1 FORMAT "%13.11" ECU_ADDRESS 0x6000F9C5 /end MEASUREMENT
/begin MEASUREMENT Com_flgManCrkFCANEna "Manual cranking based on F-CAN" UBYTE OneToOne 1 100 0.00 255.0 FORMAT "%5.1" ECU_ADDRESS 0x6000FEDA /end MEASUREMENT
/begin MEASUREMENT Com_rTrqCnvBoost "Trorque Conversion value" UWORD TransR 1 100 0.00 655.3500 FORMAT "%8.4" ECU_ADDRESS 0x60009552 /end MEASUREMENT
/begin MEASUREMENT Com_stAntiJerkCtrlInhb "Anti jerk control inhibit status" UBYTE OneToOne 1 100 0.00 255.0 FORMAT "%5.1" ECU_ADDRESS 0x6000FE69 /end MEASUREMENT
/begin MEASUREMENT Com_stCanChkFlg_MP "status of CAN check completion flag" UBYTE OneToOne 1 100 0.00 255.0 FORMAT "%5.1" ECU_ADDRESS 0x7000A26F /end MEASUREMENT
/begin MEASUREMENT Com_stCanErr "Status variable for CAN Error" UBYTE OneToOne 1 100 0.00 255.0 FORMAT "%5.1" ECU_ADDRESS 0x6000FE55 /end MEASUREMENT
/begin MEASUREMENT Com_stCrkCdn "Status cranking condition" UBYTE OneToOne 1 100 0.00 255.0 FORMAT "%5.1" ECU_ADDRESS 0x6000FE46 /end MEASUREMENT
/begin MEASUREMENT Com_stCrkCdn_MP "Status message for internal cranking condition" UBYTE OneToOne 1 100 0.00 255.0 FORMAT "%5.1" ECU_ADDRESS 0x7000A26E /end MEASUREMENT
/begin MEASUREMENT Com_stCvtShiftNeut "Neutral shift info from CAN" UBYTE OneToOne 1 100 0.00 255.0 FORMAT "%5.1" ECU_ADDRESS 0x6000FE44 /end MEASUREMENT
/begin MEASUREMENT Com_stCvtShiftRvs "Reverse shift info from CAN" UBYTE OneToOne 1 100 0.00 255.0 FORMAT "%5.1" ECU_ADDRESS 0x6000FE43 /end MEASUREMENT
/begin MEASUREMENT Com_stEAT7Mon "Status for EAT7 error monitoring" UBYTE OneToOne 1 100 0.00 255.0 FORMAT "%5.1" ECU_ADDRESS 0x6000FE37 /end MEASUREMENT
/begin MEASUREMENT Com_stEAT8Mon "Status for EAT8 error monitoring" UBYTE OneToOne 1 100 0.00 255.0 FORMAT "%5.1" ECU_ADDRESS 0x6000FE36 /end MEASUREMENT
/begin MEASUREMENT Com_stEATAMon "Status for EATA error monitoring" UBYTE OneToOne 1 100 0.00 255.0 FORMAT "%5.1" ECU_ADDRESS 0x6000FE35 /end MEASUREMENT
/begin MEASUREMENT Com_stEATBByte0Info "Message for Byte0 of EATB frame" UBYTE OneToOne 1 100 0.00 255.0 FORMAT "%5.1" ECU_ADDRESS 0x6000FE34 /end MEASUREMENT
/begin MEASUREMENT Com_stEATBMon "Status for EATB error monitoring" UBYTE OneToOne 1 100 0.00 255.0 FORMAT "%5.1" ECU_ADDRESS 0x6000FE33 /end MEASUREMENT
/begin MEASUREMENT Com_stLowVoltFCan "FCAN status For Low Voltage" UBYTE OneToOne 1 100 0.00 255.0 FORMAT "%5.1" ECU_ADDRESS 0x6000FDCE /end MEASUREMENT
/begin MEASUREMENT Com_stLowVoltPCan "PCAN Status for low voltage" UBYTE OneToOne 1 100 0.00 255.0 FORMAT "%5.1" ECU_ADDRESS 0x6000FDCD /end MEASUREMENT
/begin MEASUREMENT Com_stNeutInfo "Neutral information" UBYTE OneToOne 1 100 0.00 255.0 FORMAT "%5.1" ECU_ADDRESS 0x6000FDB9 /end MEASUREMENT
/begin MEASUREMENT Com_stRxEATBChkSumOk "CheckSum Status message" UBYTE OneToOne 1 100 0.00 255.0 FORMAT "%5.1" ECU_ADDRESS 0x6000FDA3 /end MEASUREMENT
/begin MEASUREMENT Com_stRxEATBDeb "EATB frame reception status after debouncing" UBYTE OneToOne 1 100 0.00 255.0 FORMAT "%5.1" ECU_ADDRESS 0x6000FDA2 /end MEASUREMENT
/begin MEASUREMENT Com_stRxEATBRingCntOk "Ring Counter Status Message" UBYTE OneToOne 1 100 0.00 255.0 FORMAT "%5.1" ECU_ADDRESS 0x6000FDA1 /end MEASUREMENT
/begin MEASUREMENT Com_stShftNP "Status message to indicate the position of NEUTRAL or PARKING is enabled" UBYTE OneToOne 1 100 0.00 255.0 FORMAT "%5.1" ECU_ADDRESS 0x6000FD8B /end MEASUREMENT
/begin MEASUREMENT Com_stShftRev "Status message to indicate the position of REVERSE is enabled" UBYTE OneToOne 1 100 0.00 255.0 FORMAT "%5.1" ECU_ADDRESS 0x6000FD8A /end MEASUREMENT
/begin MEASUREMENT Com_tiCanChkTmr_MP "measurement point" SWORD Time_ms 1 100 -327680.0 327670.0 FORMAT "%8.1" ECU_ADDRESS 0x7000A26C /end MEASUREMENT
/begin MEASUREMENT Com_trqEngTrq "Antijerk clutch torque" SWORD md_q0p1 1 100 -3276.800 3276.700 FORMAT "%8.3" ECU_ADDRESS 0x60009A9A /end MEASUREMENT
/begin MEASUREMENT dmrdnw_w "Torque reserve for diagnosis via tester" UWORD rel_uw_b100 1 100 0.00 99.99847 FORMAT "%8.5" ECU_ADDRESS 0x60007530 /end MEASUREMENT
/begin MEASUREMENT dwgvsge_w_msg "difference gas exch. valve inlet closes on switched valve lift between high cam and low cam profile" SWORD kw_q0p0078 1 100 -256.0000 255.9922 FORMAT "%8.4" ECU_ADDRESS 0x50005EF4 /end MEASUREMENT
/begin MEASUREMENT dwnwfde_w "Difference: actual / desired camshaft angle filtered for diagnosis (intake)" SWORD kw_q0p0078 1 100 -256.0000 255.9922 FORMAT "%8.4" ECU_ADDRESS 0x6000752E /end MEASUREMENT
/begin MEASUREMENT fnwue_msg "Weighting factor camshaft overlap" UBYTE fak_ub_b1 1 100 0.00 0.9961 ECU_ADDRESS 0x6000FB43 /end MEASUREMENT
/begin MEASUREMENT GbxECU_ctEAT7RngCnt_MP "Alive counter measurement point" UBYTE OneToOne 1 100 0.00 255.0 FORMAT "%5.1" ECU_ADDRESS 0x7000A272 /end MEASUREMENT
/begin MEASUREMENT GbxECU_ctEAT8RngCnt_MP "Measurement point for EAT8 frame ring counter" UBYTE OneToOne 1 100 0.00 255.0 FORMAT "%5.1" ECU_ADDRESS 0x7000A271 /end MEASUREMENT
/begin MEASUREMENT GbxECU_ctEATARngCnt_MP "Alive counter measurement point" UBYTE OneToOne 1 100 0.00 255.0 FORMAT "%5.1" ECU_ADDRESS 0x7000A270 /end MEASUREMENT
/begin MEASUREMENT GbxECU_ctEATBRngCnt_MP "Alive counter measurement point" UBYTE OneToOne 1 100 0.00 255.0 FORMAT "%5.1" ECU_ADDRESS 0x7000A26A /end MEASUREMENT
/begin MEASUREMENT GbxECU_ctEATCRngCnt "Indicated for Measurement point for EATC frame ring counter" UBYTE OneToOne 1 100 0.00 255.0 FORMAT "%5.1" ECU_ADDRESS 0x6000B85A /end MEASUREMENT
/begin MEASUREMENT GbxPNPos_cntrReIni "control ReIni" UBYTE OneToOne 1 100 0.00 255.0 FORMAT "%5.1" ECU_ADDRESS 0x6000B859 /end MEASUREMENT
/begin MEASUREMENT GbxPNPos_stPNPosnDiagEna "Park Neutral Switch diagnosis enable conditions" UBYTE OneToOne 1 100 0.00 255.0 FORMAT "%5.1" ECU_ADDRESS 0x6000FC72 /end MEASUREMENT
/begin MEASUREMENT Gbx_cntrNeutPosnCANPlausErr "Counter for the no.of times the plausibility error happened" UWORD OneToOne 1 100 0.00 65535.00 FORMAT "%8.2" ECU_ADDRESS 0x600005A0 /end MEASUREMENT
/begin MEASUREMENT Gbx_ctRvsSwtReIni "Post drive state counter" UBYTE OneToOne 1 100 0.00 255.0 FORMAT "%5.1" ECU_ADDRESS 0x6000B858 /end MEASUREMENT
/begin MEASUREMENT Gbx_flgAn1NeutPosnSRCMax "Flag indicating SRC max error for analog sensor1" UBYTE B_TRUE 1 100 0.00 1.00000000000 BIT_MASK 0x1 FORMAT "%13.11" ECU_ADDRESS 0x600008CA /end MEASUREMENT
/begin MEASUREMENT Gbx_flgAn1NeutPosnSRCMin "Flag indicating SRC min error for analog sensor1" UBYTE B_TRUE 1 100 0.00 1.00000000000 BIT_MASK 0x1 FORMAT "%13.11" ECU_ADDRESS 0x600008CB /end MEASUREMENT
/begin MEASUREMENT Gbx_flgAn2NeutPosnSRCMax "Flag indicating SRC max error for analog sensor2" UBYTE B_TRUE 1 100 0.00 1.00000000000 BIT_MASK 0x1 FORMAT "%13.11" ECU_ADDRESS 0x600008CC /end MEASUREMENT
/begin MEASUREMENT Gbx_flgAn2NeutPosnSRCMin "Flag indicating SRC min error for analog sensor2" UBYTE B_TRUE 1 100 0.00 1.00000000000 BIT_MASK 0x1 FORMAT "%13.11" ECU_ADDRESS 0x600008CD /end MEASUREMENT
/begin MEASUREMENT Gbx_flgAnaNPosSyncErr "Flag indicating analog neutral position syncronicity error" UBYTE B_TRUE 1 100 0.00 1.00000000000 BIT_MASK 0x1 FORMAT "%13.11" ECU_ADDRESS 0x600008CE /end MEASUREMENT
/begin MEASUREMENT Gbx_flgNeutChk "Flag to indicate if it was in neutral position" UBYTE B_TRUE 1 100 0.00 1.00000000000 BIT_MASK 0x1 FORMAT "%13.11" ECU_ADDRESS 0x600008CF /end MEASUREMENT
/begin MEASUREMENT Gbx_flgNeutErr1 "Error flag- Digital signal shows ON, which doesnt match with CAN signal" UBYTE B_TRUE 1 100 0.00 1.00000000000 BIT_MASK 0x1 FORMAT "%13.11" ECU_ADDRESS 0x600008D0 /end MEASUREMENT
/begin MEASUREMENT Gbx_flgNeutErr2 "Error flag- Digital signal shows OFF, which doesnt match with CAN signal" UBYTE B_TRUE 1 100 0.00 1.00000000000 BIT_MASK 0x1 FORMAT "%13.11" ECU_ADDRESS 0x600008D1 /end MEASUREMENT
/begin MEASUREMENT Gbx_flgNeutPosnCANPlausErr "Mismatch between digital signal and CAN signal" UBYTE B_TRUE 1 100 0.00 1.00000000000 BIT_MASK 0x1 FORMAT "%13.11" ECU_ADDRESS 0x600008D2 /end MEASUREMENT
/begin MEASUREMENT Gbx_flgNeutSig "Neutral signal from digital input after inversion logic" UBYTE B_TRUE 1 100 0.00 1.00000000000 BIT_MASK 0x1 FORMAT "%13.11" ECU_ADDRESS 0x600008D3 /end MEASUREMENT
/begin MEASUREMENT Gbx_flgNonNeutChk "Flag to indicate if it was in non neutral position" UBYTE B_TRUE 1 100 0.00 1.00000000000 BIT_MASK 0x1 FORMAT "%13.11" ECU_ADDRESS 0x600008D4 /end MEASUREMENT
/begin MEASUREMENT Gbx_lDiffDst "Distance[Km] after detection of reverse switch ON stuck error" SWORD LengthKm_q0p1 1 100 -3276.800 3276.700 FORMAT "%8.3" ECU_ADDRESS 0x60007548 /end MEASUREMENT
/begin MEASUREMENT Gbx_lDiffDstM "Distance[m] after detection of reverse switch ON stuck error" SLONG Length 1 100 -2147483648.00 2147483647.00 FORMAT "%13.2" ECU_ADDRESS 0x600027BC /end MEASUREMENT
/begin MEASUREMENT Gbx_lTotDstOld "Total distance travelled with the current ECU when reverse switch ON stuck error is detected" SLONG Length 1 100 -2147483648.00 2147483647.00 FORMAT "%13.2" ECU_ADDRESS 0x600027B8 /end MEASUREMENT
/begin MEASUREMENT Gbx_nIdlDes "Synchronized desired engine speed" SWORD EngN 1 100 -16384.00 16383.50 FORMAT "%8.2" ECU_ADDRESS 0x60009926 /end MEASUREMENT
/begin MEASUREMENT Gbx_nTrbn "Turbine speed" SWORD EngN 1 100 -16384.00 16383.50 FORMAT "%8.2" ECU_ADDRESS 0x60009920 /end MEASUREMENT
/begin MEASUREMENT Gbx_numNeutPosnAlv "Counter for alive check" UBYTE OneToOne 1 100 0.00 255.0 FORMAT "%5.1" ECU_ADDRESS 0x600008D5 /end MEASUREMENT
/begin MEASUREMENT Gbx_stActvNPos "Active live check status for neutral position sensor for 1 driving cycle" UBYTE OneToOne 1 100 0.00 255.0 FORMAT "%5.1" ECU_ADDRESS 0x6000095E /end MEASUREMENT
/begin MEASUREMENT Gbx_stAlvChk "State variable for alive check." UBYTE OneToOne 1 100 0.00 255.0 FORMAT "%5.1" ECU_ADDRESS 0x600008D6 /end MEASUREMENT
/begin MEASUREMENT Gbx_stAnaNPos "Status message of neutral position for analog neutral sensor" UBYTE OneToOne 1 100 0.00 255.0 FORMAT "%5.1" ECU_ADDRESS 0x7000370A /end MEASUREMENT
/begin MEASUREMENT Gbx_stAnaNPosBrkHld "Neutral flag for brake hold control" UBYTE OneToOne 1 100 0.00 255.0 FORMAT "%5.1" ECU_ADDRESS 0x70003709 /end MEASUREMENT
/begin MEASUREMENT Gbx_stAnaNPosnWoAlvChk "Neutral position without alive-check from Analog signal" UBYTE OneToOne 1 100 0.00 255.0 FORMAT "%5.1" ECU_ADDRESS 0x60000961 /end MEASUREMENT
/begin MEASUREMENT Gbx_stAnNeutPosnFlt "Status showing if the analog sensor voltage is within Low and High thresholds, after debouncing" UBYTE B_TRUE 1 100 0.00 1.00000000000 BIT_MASK 0x1 FORMAT "%13.11" ECU_ADDRESS 0x6000095F /end MEASUREMENT
/begin MEASUREMENT Gbx_stAnNeutPosnRaw "Status showing if the analog sensor voltage is within Low and High thresholds, before debouncing" UBYTE B_TRUE 1 100 0.00 1.00000000000 BIT_MASK 0x1 FORMAT "%13.11" ECU_ADDRESS 0x60000960 /end MEASUREMENT
/begin MEASUREMENT Gbx_stGearLvr "Selected gear position in case of automatic transmission system" UBYTE OneToOne 1 100 0.00 255.0 FORMAT "%5.1" ECU_ADDRESS 0x6000FC70 /end MEASUREMENT
/begin MEASUREMENT Gbx_stNPos "gearbox neutral position status signal" UBYTE OneToOne 1 100 0.00 255.0 FORMAT "%5.1" ECU_ADDRESS 0x60000963 /end MEASUREMENT
/begin MEASUREMENT Gbx_stNPosErr "Start-Stop System Error of the Neutral Gear Sensor" UBYTE B_TRUE 1 100 0.00 1.00000000000 BIT_MASK 0x1 FORMAT "%13.11" ECU_ADDRESS 0x60000964 /end MEASUREMENT
/begin MEASUREMENT Gbx_stNPosRaw "Raw signal from the digital gearbox neutral position sensor." UBYTE OneToOne 1 100 0.00 255.0 FORMAT "%5.1" ECU_ADDRESS 0x60000965 /end MEASUREMENT
/begin MEASUREMENT Gbx_stPNPos "Park Neutral Switch status" UBYTE B_TRUE 1 100 0.00 1.00000000000 BIT_MASK 0x1 FORMAT "%13.11" ECU_ADDRESS 0x6000F949 /end MEASUREMENT
/begin MEASUREMENT Gbx_stPNPosnDeb "Debounced Park Neutral Switch status" UBYTE B_TRUE 1 100 0.00 1.00000000000 BIT_MASK 0x1 FORMAT "%13.11" ECU_ADDRESS 0x6000F948 /end MEASUREMENT
/begin MEASUREMENT Gbx_stPNPosnRaw "Park Neutral Switch raw signal" UBYTE B_TRUE 1 100 0.00 1.00000000000 BIT_MASK 0x1 FORMAT "%13.11" ECU_ADDRESS 0x6000F947 /end MEASUREMENT
/begin MEASUREMENT Gbx_stPPos "Gearbox parking position status signal." UBYTE OneToOne 1 100 0.00 255.0 FORMAT "%5.1" ECU_ADDRESS 0x6001008C /end MEASUREMENT
/begin MEASUREMENT Gbx_stRvsPos "Debounced Gearbox Reverse Position Switch Raw Value" UBYTE OneToOne 1 100 0.00 255.0 FORMAT "%5.1" ECU_ADDRESS 0x6000FC6E /end MEASUREMENT
/begin MEASUREMENT Gbx_stRvsPosRaw "Gearbox Reverse Position Switch Raw Value" UBYTE OneToOne 1 100 0.00 255.0 FORMAT "%5.1" ECU_ADDRESS 0x6000FC6D /end MEASUREMENT
/begin MEASUREMENT Gbx_stRvsSwtCnd "Condition of reverse switch ON stuck error" UBYTE OneToOne 1 100 0.00 255.0 FORMAT "%5.1" ECU_ADDRESS 0x6000B857 /end MEASUREMENT
/begin MEASUREMENT Gbx_stRvsSwtErr "Status of reverse switch ON stuck error" UBYTE OneToOne 1 100 0.00 255.0 FORMAT "%5.1" ECU_ADDRESS 0x6000B856 /end MEASUREMENT
/begin MEASUREMENT Gbx_uAn1NeutPosnRawTmp "Analog voltage raw value from sensor1" SWORD Volt 1 100 -6553.600 6553.400 FORMAT "%8.3" ECU_ADDRESS 0x600005A2 /end MEASUREMENT
/begin MEASUREMENT Gbx_uAna1NPosRaw "Raw voltage value from analog neutral sensor-A" SWORD Volt 1 100 -6553.600 6553.400 FORMAT "%8.3" ECU_ADDRESS 0x600006CE /end MEASUREMENT
/begin MEASUREMENT Gbx_uAna2NPosRaw "Raw voltage value from analog neutral sensor-B" SWORD Volt 1 100 -6553.600 6553.400 FORMAT "%8.3" ECU_ADDRESS 0x600006D0 /end MEASUREMENT
/begin MEASUREMENT GEVCtl_agRefPosnIntkBX "Reference position phase actuator intake camshaft bankx (currentless actuator)" SWORD kw_q0p0156 1 100 -512.0000 511.9844 FORMAT "%8.4" ECU_ADDRESS 0x6000752C /end MEASUREMENT
/begin MEASUREMENT GEVCtl_agSpCalSuprtIntk "Calibrated setpoint angle intake" SWORD kw_q0p0156 1 100 -512.0000 511.9844 FORMAT "%8.4" ECU_ADDRESS 0x60009976 /end MEASUREMENT
/begin MEASUREMENT GEVCtl_agSpCatHeatgIdleFacHiCurrLftIntk "Desired value intake camshaft for catalyst heating at idling (Factor high) for low intake lift" SWORD kw_q0p0156 1 100 -512.0000 511.9844 FORMAT "%8.4" ECU_ADDRESS 0x6000751E /end MEASUREMENT
/begin MEASUREMENT GEVCtl_agSpCatHeatgIdleFacHiIntk "Desired value intake camshaft for catalyst heating at idling (Factor high)" SWORD kw_q0p0156 1 100 -512.0000 511.9844 FORMAT "%8.4" ECU_ADDRESS 0x6000751C /end MEASUREMENT
/begin MEASUREMENT GEVCtl_agSpCatHeatgIdleFacHiLoLftIntk "Desired value intake camshaft for catalyst heating at idling (Factor high) for low intake lift" SWORD kw_q0p0156 1 100 -512.0000 511.9844 FORMAT "%8.4" ECU_ADDRESS 0x6000751A /end MEASUREMENT
/begin MEASUREMENT GEVCtl_agSpCatHeatgIdleFacLoCurrLftIntk "Desired value intake camshaft for catalyst heating at idling (Factor Low) for low intake lift" SWORD kw_q0p0156 1 100 -512.0000 511.9844 FORMAT "%8.4" ECU_ADDRESS 0x60007518 /end MEASUREMENT
/begin MEASUREMENT GEVCtl_agSpCatHeatgIdleFacLoIntk "Desired value intake camshaft for catalyst heating at idling (Factor low)" SWORD kw_q0p0156 1 100 -512.0000 511.9844 FORMAT "%8.4" ECU_ADDRESS 0x60007516 /end MEASUREMENT
/begin MEASUREMENT GEVCtl_agSpCatHeatgIdleFacLoLoLftIntk "Desired value intake camshaft for catalyst heating at idling (Factor low) for low intake lift" SWORD kw_q0p0156 1 100 -512.0000 511.9844 FORMAT "%8.4" ECU_ADDRESS 0x60007514 /end MEASUREMENT
/begin MEASUREMENT GEVCtl_agSpCatHeatgIntk "Desired value intake camshaft catalyst heating" SWORD kw_q0p0156 1 100 -512.0000 511.9844 FORMAT "%8.4" ECU_ADDRESS 0x60007512 /end MEASUREMENT
/begin MEASUREMENT GEVCtl_agSpClngIntk "Setpoint angle for the cleaning of the intake camshaft" SWORD kw_q0p0156 1 100 -512.0000 511.9844 FORMAT "%8.4" ECU_ADDRESS 0x60007520 /end MEASUREMENT
/begin MEASUREMENT GEVCtl_agSpCsersDiagIntk "Desired position phase actuator intake camshaft for CSERS (Cold Start Emission Reduction Strategy)" SWORD kw_q0p0156 1 100 -512.0000 511.9844 FORMAT "%8.4" ECU_ADDRESS 0x60009974 /end MEASUREMENT
/begin MEASUREMENT GEVCtl_agSpCurrLftIntkB1 "Desired value phase angle for actual lift 1 mm inlet bank 1" SWORD kw_q0p0156 1 100 -512.0000 511.9844 FORMAT "%8.4" ECU_ADDRESS 0x60009972 /end MEASUREMENT
/begin MEASUREMENT GEVCtl_agSpDeltaSimCsersDiagIntk "Offset angle for nonCSERS intake angle for simulated CSERS diagnosis" SWORD kw_q0p0156 1 100 -512.0000 511.9844 FORMAT "%8.4" ECU_ADDRESS 0x60009970 /end MEASUREMENT
/begin MEASUREMENT GEVCtl_agSpDifIoFilIntk "Difference setpoint filter (input-output) inlet camshaft" SWORD kw_q0p0156 1 100 -512.0000 511.9844 FORMAT "%8.4" ECU_ADDRESS 0x6000996E /end MEASUREMENT
/begin MEASUREMENT GEVCtl_agSpDifIoFilLimNegIntk "Delta angle intake camshaft between filtered and unfiltered setpoint for transition from linear filtering to lowpass based filtering in advanced direction" SWORD kw_q0p0156 1 100 -512.0000 511.9844 FORMAT "%8.4" ECU_ADDRESS 0x60007510 /end MEASUREMENT
/begin MEASUREMENT GEVCtl_agSpDifIoFilLimPosIntk "Delta angle intake camshaft between filtered and unfiltered setpoint for transition from linear filtering to lowpass based filtering in retarded direction" SWORD kw_q0p0156 1 100 -512.0000 511.9844 FORMAT "%8.4" ECU_ADDRESS 0x6000750E /end MEASUREMENT
/begin MEASUREMENT GEVCtl_agSpDrvDmdIntk "Setpoint intake camshaft according to driver demand in current operating mode" SWORD kw_q0p0156 1 100 -512.0000 511.9844 FORMAT "%8.4" ECU_ADDRESS 0x6000996C /end MEASUREMENT
/begin MEASUREMENT GEVCtl_agSpDrvDmdIntk_a "Setpoint array for intake camshaft according to driver demand" SWORD kw_q0p0156 1 100 -512.0000 511.9844 FORMAT "%8.4" ARRAY_SIZE 30 ECU_ADDRESS 0x50005700 /end MEASUREMENT
/begin MEASUREMENT GEVCtl_agSpErrSimInpIntkB1 "Setpoint angle due to target error error simulation mode for intake camshaft B1" SWORD kw_q0p0156 1 100 -512.0000 511.9844 FORMAT "%8.4" ECU_ADDRESS 0x6000752A /end MEASUREMENT
/begin MEASUREMENT GEVCtl_agSpErrSimIntkB1 "Setpoint angle in error simulation mode for intake camshaft B1" SWORD kw_q0p0156 1 100 -512.0000 511.9844 FORMAT "%8.4" ECU_ADDRESS 0x6000996A /end MEASUREMENT
/begin MEASUREMENT GEVCtl_agSpErrSimLimIntkB1 "Desired position phase actuator affected by setpoint ramping error simulation for intake camshaft bank1 (calibration support mode)" SWORD kw_q0p0156 1 100 -512.0000 511.9844 FORMAT "%8.4" ECU_ADDRESS 0x60007528 /end MEASUREMENT
/begin MEASUREMENT GEVCtl_agSpErrSimLpIntkB1 "Setpoint angle due to Slow Response error simulation mode for intake camshaft B1" SWORD kw_q0p0156 1 100 -512.0000 511.9844 FORMAT "%8.4" ECU_ADDRESS 0x60007526 /end MEASUREMENT
/begin MEASUREMENT GEVCtl_agSpFildIntk "Desired value intake camshaft behind filter" SWORD kw_q0p0156 1 100 -512.0000 511.9844 FORMAT "%8.4" ECU_ADDRESS 0x60009968 /end MEASUREMENT
/begin MEASUREMENT GEVCtl_agSpFrznModIntk "Setpoint angle in Frozen Mode (very low temperatures) (intake)" SWORD kw_q0p0156 1 100 -512.0000 511.9844 FORMAT "%8.4" ECU_ADDRESS 0x6000750C /end MEASUREMENT
/begin MEASUREMENT GEVCtl_agSpHomHiLftIntk "Desired value intake camshaft HOM mode high lift" SWORD kw_q0p0156 1 100 -512.0000 511.9844 FORMAT "%8.4" ECU_ADDRESS 0x60009966 /end MEASUREMENT
/begin MEASUREMENT GEVCtl_agSpHomIntk "Desired value intake camshaft homogeneous mode (HOM)" SWORD kw_q0p0156 1 100 -512.0000 511.9844 FORMAT "%8.4" ECU_ADDRESS 0x60009964 /end MEASUREMENT
/begin MEASUREMENT GEVCtl_agSpHomLoLftIntk "Desired value intake camshaft HOM mode low lift" SWORD kw_q0p0156 1 100 -512.0000 511.9844 FORMAT "%8.4" ECU_ADDRESS 0x60009962 /end MEASUREMENT
/begin MEASUREMENT GEVCtl_agSpHomWrmIntk "Desired value intake camshaft homogeneous mode (HOM) engine at operating temperature" SWORD kw_q0p0156 1 100 -512.0000 511.9844 FORMAT "%8.4" ECU_ADDRESS 0x50005DDE /end MEASUREMENT
/begin MEASUREMENT GEVCtl_agSpIntkB1 "Desired position phase actuator intake camshaft bank1" SWORD kw_q0p0156 1 100 -512.0000 511.9844 FORMAT "%8.4" ECU_ADDRESS 0x600148D2 /end MEASUREMENT
/begin MEASUREMENT GEVCtl_agSpJmpIntk "Rectangular pattern setpoint intake camshaft" SWORD kw_q0p0156 1 100 -512.0000 511.9844 FORMAT "%8.4" ECU_ADDRESS 0x60007524 /end MEASUREMENT
/begin MEASUREMENT GEVCtl_agSpLoLftWrmIntk "Desired value intake camshaft low lift engine at operating temperature" SWORD kw_q0p0156 1 100 -512.0000 511.9844 FORMAT "%8.4" ECU_ADDRESS 0x50005DE0 /end MEASUREMENT
/begin MEASUREMENT GEVCtl_agSpNonCsersIntkB1 "Desired value intake camshaft nonCSERS" SWORD kw_q0p0156 1 100 -512.0000 511.9844 FORMAT "%8.4" ECU_ADDRESS 0x6000994E /end MEASUREMENT
/begin MEASUREMENT GEVCtl_agSpPhaActrTstrIntk "Angle setpoint phaseshifting intake camshaft actuator by tester" SWORD kw_q0p0156 1 100 -512.0000 511.9844 FORMAT "%8.4" ECU_ADDRESS 0x60009092 /end MEASUREMENT
/begin MEASUREMENT GEVCtl_agSpPhaATSIntk "Camshaft SetPoint angle from ATS for the intake bank" SWORD kw_q0p0156 1 100 -512.0000 511.9844 FORMAT "%8.4" ECU_ADDRESS 0x600074F8 /end MEASUREMENT
/begin MEASUREMENT GEVCtl_agSpPhaUnLckIntkB1 "Desired angle during unlocking of the camshaft actuator intake bank 1" SWORD kw_q0p0156 1 100 -512.0000 511.9844 FORMAT "%8.4" ECU_ADDRESS 0x600148E0 /end MEASUREMENT
/begin MEASUREMENT GEVCtl_agSpPrpnVlvLftSwtIntk "Desired phase value intake camshaft for outlet valve lift switching" SWORD kw_q0p0156 1 100 -512.0000 511.9844 FORMAT "%8.4" ECU_ADDRESS 0x6000750A /end MEASUREMENT
/begin MEASUREMENT GEVCtl_agSpRampIntk "Ramp pattern setpoint intake camshaft" SWORD kw_q0p0156 1 100 -512.0000 511.9844 FORMAT "%8.4" ECU_ADDRESS 0x60007522 /end MEASUREMENT
/begin MEASUREMENT GEVCtl_agSpRefPosnGrdtLimIntk "Intake setpoint with limited gradient for reference adaptation" SWORD kw_q0p0156 1 100 -512.0000 511.9844 FORMAT "%8.4" ECU_ADDRESS 0x60007508 /end MEASUREMENT
/begin MEASUREMENT GEVCtl_agSpSpclIntkB1 "Setpoint in special operation mode (intake bank 1)" SWORD kw_q0p0156 1 100 -512.0000 511.9844 FORMAT "%8.4" ECU_ADDRESS 0x60007506 /end MEASUREMENT
/begin MEASUREMENT GEVCtl_agSpSpclOperIntkB1 "Setpoint angle for special interventions at the intake camshaft bank 1" SWORD kw_q0p0156 1 100 -512.0000 511.9844 FORMAT "%8.4" ECU_ADDRESS 0x6000994A /end MEASUREMENT
/begin MEASUREMENT GEVCtl_agSpUnFildIntkB1 "unfiltered target angle intake camshaft" SWORD kw_q0p0156 1 100 -512.0000 511.9844 FORMAT "%8.4" ECU_ADDRESS 0x60009948 /end MEASUREMENT
/begin MEASUREMENT GEVCtl_agSpUnlimIntkB1 "Desired unlimted position phase actuator intake camshaft bank1" SWORD kw_q0p0156 1 100 -512.0000 511.9844 FORMAT "%8.4" ECU_ADDRESS 0x60009946 /end MEASUREMENT
/begin MEASUREMENT GEVCtl_cntrClngCycIntk "Number of cleaning cycles of the intake camshaft in the current driving cycle" UBYTE OneToOne 1 100 0.00 255.0 FORMAT "%5.1" ECU_ADDRESS 0x6000B844 /end MEASUREMENT
/begin MEASUREMENT GEVCtl_facCorrnRho "Interpolation factor for environmental influence on setpoints (density)" UBYTE fak_ub_b1 1 100 0.00 0.9961 ECU_ADDRESS 0x6000FC83 /end MEASUREMENT
/begin MEASUREMENT GEVCtl_facTranColdWrmIntk "Factor transition operating point coldwarm desired value intake camshaft" UBYTE fak_ub_b1 1 100 0.00 0.9961 ECU_ADDRESS 0x6000FC82 /end MEASUREMENT
/begin MEASUREMENT GEVCtl_flgAdapErrSimIntk "Condition no inhibition of fine adaption while camshaft controller is in error simulation (Intake camshaft)" UBYTE B_TRUE 1 100 0.00 1.00000000000 BIT_MASK 0x1 FORMAT "%13.11" ECU_ADDRESS 0x7000092E /end MEASUREMENT
/begin MEASUREMENT GEVCtl_flgAdapErrSimIntkB1 "Condition for activation of adaptation error simulation intake B1 (request of adaptation without requiring camshaft to be in reference position)" UBYTE B_TRUE 1 100 0.00 1.00000000000 BIT_MASK 0x1 FORMAT "%13.11" ECU_ADDRESS 0x7000092D /end MEASUREMENT
/begin MEASUREMENT GEVCtl_flgAgSpFilOnIntk "Condition desired value filtering intake camshaft active" UBYTE B_TRUE 1 100 0.00 1.00000000000 BIT_MASK 0x1 FORMAT "%13.11" ECU_ADDRESS 0x6000B83F /end MEASUREMENT
/begin MEASUREMENT GEVCtl_flgCamsftUnstyModIntk "Transient phase of the intake camshaft, when the operation mode changes" UBYTE B_TRUE 1 100 0.00 1.00000000000 BIT_MASK 0x1 FORMAT "%13.11" ECU_ADDRESS 0x6000F96B /end MEASUREMENT
/begin MEASUREMENT GEVCtl_flgClngActvIntk "Cleaning of intake camshaft active" UBYTE B_TRUE 1 100 0.00 1.00000000000 BIT_MASK 0x1 FORMAT "%13.11" ECU_ADDRESS 0x6000F96A /end MEASUREMENT
/begin MEASUREMENT GEVCtl_flgClngActvPostDrvIntk "Cleaning of intake camshaft in PostDrive active" UBYTE B_TRUE 1 100 0.00 1.00000000000 BIT_MASK 0x1 FORMAT "%13.11" ECU_ADDRESS 0x6000F969 /end MEASUREMENT
/begin MEASUREMENT GEVCtl_flgClngCycCmplIntk "Cleaning cycle of intake camshaft completed" UBYTE B_TRUE 1 100 0.00 1.00000000000 BIT_MASK 0x1 FORMAT "%13.11" ECU_ADDRESS 0x6000B843 /end MEASUREMENT
/begin MEASUREMENT GEVCtl_flgClngOnIntk "Condition cleaning ON during engine drive, postdrive or engine stall inlet camshaft" UBYTE B_TRUE 1 100 0.00 1.00000000000 BIT_MASK 0x1 FORMAT "%13.11" ECU_ADDRESS 0x6000F67D /end MEASUREMENT
/begin MEASUREMENT GEVCtl_flgClngRels "Release of the cleaning functionality" UBYTE B_TRUE 1 100 0.00 1.00000000000 BIT_MASK 0x1 FORMAT "%13.11" ECU_ADDRESS 0x6000F968 /end MEASUREMENT
/begin MEASUREMENT GEVCtl_flgClngReqIntk "Request of the cleaning functionality for the intake camshaft" UBYTE B_TRUE 1 100 0.00 1.00000000000 BIT_MASK 0x1 FORMAT "%13.11" ECU_ADDRESS 0x6000B842 /end MEASUREMENT
/begin MEASUREMENT GEVCtl_flgDiMaskPhaDiagIntk "Condition: none of the camshaft actuator diagnosis DFCs is deactivated via DisableMask (intake)" UBYTE B_TRUE 1 100 0.00 1.00000000000 BIT_MASK 0x1 FORMAT "%13.11" ECU_ADDRESS 0x7000024C /end MEASUREMENT
/begin MEASUREMENT GEVCtl_flgEnaUnlckIntk "Enable condition for the unlock functionality of the intake camshaft" UBYTE B_TRUE 1 100 0.00 1.00000000000 BIT_MASK 0x1 FORMAT "%13.11" ECU_ADDRESS 0x7000024B /end MEASUREMENT
/begin MEASUREMENT GEVCtl_flgEngOffClnActv "Condition cleaning after engine off active" UBYTE B_TRUE 1 100 0.00 1.00000000000 BIT_MASK 0x1 FORMAT "%13.11" ECU_ADDRESS 0x6000F967 /end MEASUREMENT
/begin MEASUREMENT GEVCtl_flgEngStActrClng "Condition Engine ECU state for Actuator Cleaning" UBYTE B_TRUE 1 100 0.00 1.00000000000 BIT_MASK 0x1 FORMAT "%13.11" ECU_ADDRESS 0x6000B841 /end MEASUREMENT
/begin MEASUREMENT GEVCtl_flgEngStalEna "Condition cleaning during engine stall enabled" UBYTE B_TRUE 1 100 0.00 1.00000000000 BIT_MASK 0x1 FORMAT "%13.11" ECU_ADDRESS 0x6000B840 /end MEASUREMENT
/begin MEASUREMENT GEVCtl_flgExhDiagNonCsersIntk "Condition Exhaust gas diagnosis to be a part of CSERS strategyfor intake camshaft" UBYTE B_TRUE 1 100 0.00 1.00000000000 BIT_MASK 0x1 FORMAT "%13.11" ECU_ADDRESS 0x6000B83E /end MEASUREMENT
/begin MEASUREMENT GEVCtl_flgLftLimpNLim "Engine speed limitation based valve lift system request" UBYTE B_TRUE 1 100 0.00 1.00000000000 BIT_MASK 0x1 FORMAT "%13.11" ECU_ADDRESS 0x70000926 /end MEASUREMENT
/begin MEASUREMENT GEVCtl_flgMinOvlIntk "Condition desired angle intake camshaft for minimum overlap" UBYTE B_TRUE 1 100 0.00 1.00000000000 BIT_MASK 0x1 FORMAT "%13.11" ECU_ADDRESS 0x6000F966 /end MEASUREMENT
/begin MEASUREMENT GEVCtl_flgNonCsersEOMActvIntk "Condition EOM different from Csers active" UBYTE B_TRUE 1 100 0.00 1.00000000000 BIT_MASK 0x1 FORMAT "%13.11" ECU_ADDRESS 0x6000B83D /end MEASUREMENT
/begin MEASUREMENT GEVCtl_flgNonCsersSpIntk "Condition for intake camshaft angle different from csers angle" UBYTE B_TRUE 1 100 0.00 1.00000000000 BIT_MASK 0x1 FORMAT "%13.11" ECU_ADDRESS 0x6000B83C /end MEASUREMENT
/begin MEASUREMENT GEVCtl_flgPhaActrTestEnaFctIntk "Actuator test for intake camshaft (short trip) requested by tester" UBYTE B_TRUE 1 100 0.00 1.00000000000 BIT_MASK 0x1 FORMAT "%13.11" ECU_ADDRESS 0x70000925 /end MEASUREMENT
/begin MEASUREMENT GEVCtl_flgPhaActrTestEnaIntk "Actuator test of intake camshaft (short trip) active" UBYTE B_TRUE 1 100 0.00 1.00000000000 BIT_MASK 0x1 FORMAT "%13.11" ECU_ADDRESS 0x70000923 /end MEASUREMENT
/begin MEASUREMENT GEVCtl_flgPhaActvnSpActrTstrIntk "Flag activation setpoint phaseshifting intake camshaft actuator by tester" UBYTE B_TRUE 1 100 0.00 1.00000000000 BIT_MASK 0x1 FORMAT "%13.11" ECU_ADDRESS 0x70000922 /end MEASUREMENT
/begin MEASUREMENT GEVCtl_flgPhaEna "Condition: camshaft control" UBYTE B_TRUE 1 100 0.00 1.00000000000 BIT_MASK 0x1 FORMAT "%13.11" ECU_ADDRESS 0x70000921 /end MEASUREMENT
/begin MEASUREMENT GEVCtl_flgPhaEnaAftStrt "condition: end of disable time for camshaft control after end of start" UBYTE B_TRUE 1 100 0.00 1.00000000000 BIT_MASK 0x1 FORMAT "%13.11" ECU_ADDRESS 0x70000253 /end MEASUREMENT
/begin MEASUREMENT GEVCtl_flgPhaEnaAftStrtIntk "Time after start for intake camshaft release elapsed" UBYTE B_TRUE 1 100 0.00 1.00000000000 BIT_MASK 0x1 FORMAT "%13.11" ECU_ADDRESS 0x70000252 /end MEASUREMENT
/begin MEASUREMENT GEVCtl_flgPhaEnaAmb "Global enable of camshaft control depending on oil pressure, temperature and battery voltage" UBYTE B_TRUE 1 100 0.00 1.00000000000 BIT_MASK 0x1 FORMAT "%13.11" ECU_ADDRESS 0x70000251 /end MEASUREMENT
/begin MEASUREMENT GEVCtl_flgPhaEnaEngRestrt "Flag: request for engine restart mode triggered." UBYTE B_TRUE 1 100 0.00 1.00000000000 BIT_MASK 0x1 FORMAT "%13.11" ECU_ADDRESS 0x70000250 /end MEASUREMENT
/begin MEASUREMENT GEVCtl_flgPhaEnaIntk "Condition release of intake camshaft control" UBYTE B_TRUE 1 100 0.00 1.00000000000 BIT_MASK 0x1 FORMAT "%13.11" ECU_ADDRESS 0x70000920 /end MEASUREMENT
/begin MEASUREMENT GEVCtl_flgPhaEnaIntkErr "Condition intake camshaft adjustment inhibited by error" UBYTE B_TRUE 1 100 0.00 1.00000000000 BIT_MASK 0x1 FORMAT "%13.11" ECU_ADDRESS 0x7000091F /end MEASUREMENT
/begin MEASUREMENT GEVCtl_flgPhaEnaNEngIntk "engine speed thresh. depend. of Oil temperature to enable inletcamshaft control" UBYTE B_TRUE 1 100 0.00 1.00000000000 BIT_MASK 0x1 FORMAT "%13.11" ECU_ADDRESS 0x7000024F /end MEASUREMENT
/begin MEASUREMENT GEVCtl_flgPhaEnaPOil "Condition: oil pressure for camshaft control ok" UBYTE B_TRUE 1 100 0.00 1.00000000000 BIT_MASK 0x1 FORMAT "%13.11" ECU_ADDRESS 0x7000091E /end MEASUREMENT
/begin MEASUREMENT GEVCtl_flgPhaEnaTOil "Condition oiltemperature for camshaft enable ok" UBYTE B_TRUE 1 100 0.00 1.00000000000 BIT_MASK 0x1 FORMAT "%13.11" ECU_ADDRESS 0x7000024E /end MEASUREMENT
/begin MEASUREMENT GEVCtl_flgPhaErrSimIntk "Condition for activation of phase error simulation intake" UBYTE B_TRUE 1 100 0.00 1.00000000000 BIT_MASK 0x1 FORMAT "%13.11" ECU_ADDRESS 0x7000091D /end MEASUREMENT
/begin MEASUREMENT GEVCtl_flgPhaErrSimIntkB1 "Condition for activation of phase error simulation intake B1" UBYTE B_TRUE 1 100 0.00 1.00000000000 BIT_MASK 0x1 FORMAT "%13.11" ECU_ADDRESS 0x7000091C /end MEASUREMENT
/begin MEASUREMENT GEVCtl_flgPhaJitObsIntk "Condition: Jitter-Observation intake camshaft, bank-independent" UBYTE B_TRUE 1 100 0.00 1.00000000000 BIT_MASK 0x1 FORMAT "%13.11" ECU_ADDRESS 0x70000249 /end MEASUREMENT
/begin MEASUREMENT GEVCtl_flgPhaJitObsIntkB1 "Condition jitter-observation intake camshaft bank1" UBYTE B_TRUE 1 100 0.00 1.00000000000 BIT_MASK 0x1 FORMAT "%13.11" ECU_ADDRESS 0x70000248 /end MEASUREMENT
/begin MEASUREMENT GEVCtl_flgPhaJitObsOk "Condition: Jitter-Observation intake andor outlet camshaft okay" UBYTE B_TRUE 1 100 0.00 1.00000000000 BIT_MASK 0x1 FORMAT "%13.11" ECU_ADDRESS 0x70000247 /end MEASUREMENT
/begin MEASUREMENT GEVCtl_flgPhaOutLockPosnIntkB1 "Actuation out of lock position phase actuator intake camshaft bank1" UBYTE B_TRUE 1 100 0.00 1.00000000000 BIT_MASK 0x1 FORMAT "%13.11" ECU_ADDRESS 0x7000091B /end MEASUREMENT
/begin MEASUREMENT GEVCtl_flgPhaToLockPosnIntkB1 "Actuation into lock position phase actuator intake camshaft bank1" UBYTE B_TRUE 1 100 0.00 1.00000000000 BIT_MASK 0x1 FORMAT "%13.11" ECU_ADDRESS 0x70000918 /end MEASUREMENT
/begin MEASUREMENT GEVCtl_flgPhaToRefPosnSpReaIntk "Flag indicating that the setpoint is sufficiently near to the reference position (for reference adaptation)" UBYTE B_TRUE 1 100 0.00 1.00000000000 BIT_MASK 0x1 FORMAT "%13.11" ECU_ADDRESS 0x6000F965 /end MEASUREMENT
/begin MEASUREMENT GEVCtl_flgPhaTstrActvIntk "Setpoint assignment via tester active for intake camshaft" UBYTE B_TRUE 1 100 0.00 1.00000000000 BIT_MASK 0x1 FORMAT "%13.11" ECU_ADDRESS 0x70000916 /end MEASUREMENT
/begin MEASUREMENT GEVCtl_flgPhaUnLckActvIntkB1 "Unlocking of intake camshaft bank 1 active" UBYTE B_TRUE 1 100 0.00 1.00000000000 BIT_MASK 0x1 FORMAT "%13.11" ECU_ADDRESS 0x70000915 /end MEASUREMENT
/begin MEASUREMENT GEVCtl_flgRatLoadLo "Condition: maximal value for air charge until some special filter features are active" UBYTE B_TRUE 1 100 0.00 1.00000000000 BIT_MASK 0x1 FORMAT "%13.11" ECU_ADDRESS 0x6000F963 /end MEASUREMENT
/begin MEASUREMENT GEVCtl_flgRmnClngCycIntk "Further cleaning cycles of the intake camshaft in current driving cycle remaining" UBYTE B_TRUE 1 100 0.00 1.00000000000 BIT_MASK 0x1 FORMAT "%13.11" ECU_ADDRESS 0x6000F961 /end MEASUREMENT
/begin MEASUREMENT GEVCtl_flgSimCsersDiag "Condition simulation of CSERS diagnosis" UBYTE B_TRUE 1 100 0.00 1.00000000000 BIT_MASK 0x1 FORMAT "%13.11" ECU_ADDRESS 0x70000910 /end MEASUREMENT
/begin MEASUREMENT GEVCtl_flgSpCalSuprtIntk "Condition for using calibrated intake setpoints" UBYTE B_TRUE 1 100 0.00 1.00000000000 BIT_MASK 0x1 FORMAT "%13.11" ECU_ADDRESS 0x7000090F /end MEASUREMENT
/begin MEASUREMENT GEVCtl_flgSpCatHeatgIntk "Condition setpoint intake camshaft for catalyst heating active" UBYTE B_TRUE 1 100 0.00 1.00000000000 BIT_MASK 0x1 FORMAT "%13.11" ECU_ADDRESS 0x6000F960 /end MEASUREMENT
/begin MEASUREMENT GEVCtl_flgSpIdleIntk "Condition setpoint intake camshaft for idling active" UBYTE B_TRUE 1 100 0.00 1.00000000000 BIT_MASK 0x1 FORMAT "%13.11" ECU_ADDRESS 0x6000F95F /end MEASUREMENT
/begin MEASUREMENT GEVCtl_flgSpRefPosnIntk "flag to switch the setpoint to reference position in special cases." UBYTE B_TRUE 1 100 0.00 1.00000000000 BIT_MASK 0x1 FORMAT "%13.11" ECU_ADDRESS 0x6000F95D /end MEASUREMENT
/begin MEASUREMENT GEVCtl_flgSpSpclIntk "Condition setpoint intake camshaft for special operation active" UBYTE B_TRUE 1 100 0.00 1.00000000000 BIT_MASK 0x1 FORMAT "%13.11" ECU_ADDRESS 0x6000F95C /end MEASUREMENT
/begin MEASUREMENT GEVCtl_flgSpSpclIntkVlvLft "Special cam lobe for intake camshaft desired" UBYTE B_TRUE 1 100 0.00 1.00000000000 BIT_MASK 0x1 FORMAT "%13.11" ECU_ADDRESS 0x7000090E /end MEASUREMENT
/begin MEASUREMENT GEVCtl_flgSpSpclOperActvIntkB1 "Special setpoint intervention active for intake camshaft bank 1" UBYTE B_TRUE 1 100 0.00 1.00000000000 BIT_MASK 0x1 FORMAT "%13.11" ECU_ADDRESS 0x6000F95B /end MEASUREMENT
/begin MEASUREMENT GEVCtl_flgSpStgyChgIntk "Condition desired value intake camshaft for strategy change (with additional continuous desired value change) active" UBYTE B_TRUE 1 100 0.00 1.00000000000 BIT_MASK 0x1 FORMAT "%13.11" ECU_ADDRESS 0x6000F95A /end MEASUREMENT
/begin MEASUREMENT GEVCtl_flgStrtStopEvtIntk "Condition start-stop event intake camshaft" UBYTE B_TRUE 1 100 0.00 1.00000000000 BIT_MASK 0x1 FORMAT "%13.11" ECU_ADDRESS 0x6000B83B /end MEASUREMENT
/begin MEASUREMENT GEVCtl_flgTiAftStrtIntk "Time delayed release of intake camshaft after engine start f(GEVCtl_tEngStrt)" UBYTE B_TRUE 1 100 0.00 1.00000000000 BIT_MASK 0x1 FORMAT "%13.11" ECU_ADDRESS 0x7000024D /end MEASUREMENT
/begin MEASUREMENT GEVCtl_flgTiAftStrtPrevDrvgCyc "Condition from last driving cycle for faster release of inlet camshaft control" UBYTE B_TRUE 1 100 0.00 1.00000000000 BIT_MASK 0x1 FORMAT "%13.11" ECU_ADDRESS 0x60036DCB /end MEASUREMENT
/begin MEASUREMENT GEVCtl_flgUnlckForAdpnIntk "Request for unlocking the intake camshaft for the first adaptation" UBYTE B_TRUE 1 100 0.00 1.00000000000 BIT_MASK 0x1 FORMAT "%13.11" ECU_ADDRESS 0x7000024A /end MEASUREMENT
/begin MEASUREMENT GEVCtl_flgVVehLo "maximal vehicle speed until a multiplicative factor is correcting the filter time constant" UBYTE B_TRUE 1 100 0.00 1.00000000000 BIT_MASK 0x1 FORMAT "%13.11" ECU_ADDRESS 0x6000F959 /end MEASUREMENT
/begin MEASUREMENT GEVCtl_idxTiAgSpFilIntk "Index for selection of filter time constant intake camshaft" UWORD dez 1 100 0.00 65535.00 FORMAT "%8.2" ECU_ADDRESS 0x60007504 /end MEASUREMENT
/begin MEASUREMENT GEVCtl_JmpSigIntk_I.agSpJmp "Class instance: Rectangular pattern setpoint intake camshaft / Calibrated setpoint angle, jump signal" SWORD kw_q0p0156 1 100 -512.0000 511.9844 FORMAT "%8.4" ECU_ADDRESS 0x500056E8 /end MEASUREMENT
/begin MEASUREMENT GEVCtl_nEngLRes "Engine speed with low resolution" SWORD EngN_LRes 1 100 0.00 10200.00 FORMAT "%8.2" ECU_ADDRESS 0x600074F6 /end MEASUREMENT
/begin MEASUREMENT GEVCtl_RampSigIntk_I.agSpRamp "Class instance calibrated setpoint ramp signal intake / Limited setpoint of ramp generator" SWORD kw_q0p0156 1 100 -512.0000 511.9844 FORMAT "%8.4" ECU_ADDRESS 0x500056EE /end MEASUREMENT
/begin MEASUREMENT GEVCtl_RampSigIntk_I.agSpRampPre "Class instance calibrated setpoint ramp signal intake / Calibrated setpoint angle, ramp signal umlimited" SWORD kw_q0p0156 1 100 -512.0000 511.9844 FORMAT "%8.4" ECU_ADDRESS 0x500056F0 /end MEASUREMENT
/begin MEASUREMENT GEVCtl_RampSigIntk_I.cntrIdx "Class instance calibrated setpoint ramp signal intake / Number of ramp cycles" UBYTE OneToOne 1 100 0.00 255.0 FORMAT "%5.1" ECU_ADDRESS 0x500056F2 /end MEASUREMENT
/begin MEASUREMENT GEVCtl_RampSigIntk_I.flgDir "Class instance calibrated setpoint ramp signal intake / Direction of calibrated ramp signal" UBYTE B_TRUE 1 100 0.00 1.00000000000 BIT_MASK 0x1 FORMAT "%13.11" ECU_ADDRESS 0x500056F3 /end MEASUREMENT
/begin MEASUREMENT GEVCtl_RampSigIntk_I.flgLimRea "Class instance calibrated setpoint ramp signal intake / Ramp limitation reached of ramp functionality" UBYTE B_TRUE 1 100 0.00 1.00000000000 BIT_MASK 0x1 FORMAT "%13.11" ECU_ADDRESS 0x500056F4 /end MEASUREMENT
/begin MEASUREMENT GEVCtl_RampSigIntk_I.flgMaxRepn "Class instance calibrated setpoint ramp signal intake / Maximum number of cycles reached" UBYTE B_TRUE 1 100 0.00 1.00000000000 BIT_MASK 0x1 FORMAT "%13.11" ECU_ADDRESS 0x500056F5 /end MEASUREMENT
/begin MEASUREMENT GEVCtl_RampSigIntk_I.flgSwtDir "Class instance calibrated setpoint ramp signal intake / Direction change of ramp functionality" UBYTE B_TRUE 1 100 0.00 1.00000000000 BIT_MASK 0x1 FORMAT "%13.11" ECU_ADDRESS 0x500056F6 /end MEASUREMENT
/begin MEASUREMENT GEVCtl_RampSigIntk_I.idxGrdtTstFctRepn "Class instance calibrated setpoint ramp signal intake / Used index of gradient curve" UBYTE OneToOne 1 100 0.00 255.0 FORMAT "%5.1" ECU_ADDRESS 0x500056F7 /end MEASUREMENT
/begin MEASUREMENT GEVCtl_RampSigIntk_I.vGrdtTstFct "Class instance calibrated setpoint ramp signal intake / Gradient for calibrated ramp signal" UWORD q0p0625_degCrS_DIV_s 1 100 0.00 2047.938 FORMAT "%8.3" ECU_ADDRESS 0x500056F8 /end MEASUREMENT
/begin MEASUREMENT GEVCtl_ratLoad "Relative load for setpoints determination of camshaft phase shifting" UWORD rel_uw_q0p0234 1 100 0.00 1535.977 FORMAT "%8.3" ECU_ADDRESS 0x6000945C /end MEASUREMENT
/begin MEASUREMENT GEVCtl_ratLoadDeltaIntk "Change of relative load for setpoint determination of camshaft phase shifting intake" SWORD rel_q0p0234 1 100 -768.0000 767.9766 FORMAT "%8.4" ECU_ADDRESS 0x60007502 /end MEASUREMENT
/begin MEASUREMENT GEVCtl_rhoEnv "environmental density (consider of environmental temperature and pressure)" UBYTE dichte_ub_b2 1 100 0.00 1.992 FORMAT "%5.3" ECU_ADDRESS 0x6000B83A /end MEASUREMENT
/begin MEASUREMENT GEVCtl_stErrIntkB1 "Error simulation status intake B1 for calibrated setpoint calculation" UBYTE OneToOne 1 100 0.00 255.0 FORMAT "%5.1" ECU_ADDRESS 0x6000B846 /end MEASUREMENT
/begin MEASUREMENT GEVCtl_stGslSpIntk "Operation mode intake camshaft (gasoline projects)" UBYTE dez 1 100 0.00 255.0 FORMAT "%5.1" ECU_ADDRESS 0x6000FC81 /end MEASUREMENT
/begin MEASUREMENT GEVCtl_stGslSpNonCsersIntk "Non-CSERS operation mode intake camshaft (gasoline projects)" UBYTE OneToOne 1 100 0.00 255.0 FORMAT "%5.1" ECU_ADDRESS 0x6000B839 /end MEASUREMENT
/begin MEASUREMENT GEVCtl_stPhaDiagTstrIntk "Current state phaseshifting intake camshaft by tester" UBYTE OneToOne 1 100 0.00 255.0 FORMAT "%5.1" ECU_ADDRESS 0x6000F7B7 /end MEASUREMENT
/begin MEASUREMENT GEVCtl_stPhaUnLckIntkB1 "State: control CmS unlocking intake" UBYTE OneToOne 1 100 0.00 255.0 FORMAT "%5.1" ECU_ADDRESS 0x60014A44 /end MEASUREMENT
/begin MEASUREMENT GEVCtl_stSpCalSuprtIntk "Status calibrated setpoint intake" UBYTE OneToOne 1 100 0.00 255.0 FORMAT "%5.1" ECU_ADDRESS 0x6000B845 /end MEASUREMENT
/begin MEASUREMENT GEVCtl_tEngStrt "Engine temperature or start engine temperature" SWORD Temp_Cels 1 100 -3549.940 3003.560 FORMAT "%8.3" ECU_ADDRESS 0x60013D36 /end MEASUREMENT
/begin MEASUREMENT GEVCtl_tiAgSpFilIntk "Time constant change limitation of desired angle inlet camshaft" UWORD t_q0p01 1 100 0.0100 655.3500 FORMAT "%8.4" ECU_ADDRESS 0x60007500 /end MEASUREMENT
/begin MEASUREMENT GEVCtl_tiAgSpFilIntkBas "Time constant change limitation of desired angle inlet camshaft (base value)" UWORD t_q0p01 1 100 0.010000 2.560000 FORMAT "%8.6" ECU_ADDRESS 0x600074FE /end MEASUREMENT
/begin MEASUREMENT GEVCtl_tiNormalIntk "time since state COENG_RUNNING was reached for Intake (local copy)" UWORD Time_ms 1 100 0.00 655350.0 FORMAT "%8.1" ECU_ADDRESS 0x600074FC /end MEASUREMENT
/begin MEASUREMENT GEVCtl_tiTiEngOff "Engine off time" UWORD t_q1 1 100 0.00 32767.00 FORMAT "%8.2" ECU_ADDRESS 0x600074F4 /end MEASUREMENT
/begin MEASUREMENT GEVCtl_tOilCylHd "Oil temperature cylinder head" SWORD Temp_Cels 1 100 -3549.940 3003.560 FORMAT "%8.3" ECU_ADDRESS 0x600148E2 /end MEASUREMENT
/begin MEASUREMENT GEVCtl_tOilPhaEna "Oil temperature for camshaft adjustment release" SWORD Temp_Cels 1 100 -3549.940 3003.560 FORMAT "%8.3" ECU_ADDRESS 0x60013D38 /end MEASUREMENT
/begin MEASUREMENT GEVCtl_tqResvPhaDiagTstr "Torque reserve for diagnosis phaseshifting camshaft by tester" UWORD rel_uw_b100 1 100 0.00 99.99847 FORMAT "%8.5" ECU_ADDRESS 0x60008E48 /end MEASUREMENT
/begin MEASUREMENT GEVCtl_tTiAgSpFilCorrnIntk "Coolant or oil temperature based on the calibration for the setpoint filtering time constant correction for intake" SWORD Temp_Cels 1 100 -3549.940 3003.560 FORMAT "%8.3" ECU_ADDRESS 0x600074FA /end MEASUREMENT
/begin MEASUREMENT JitDetrmIntkB1_I.agAcm "Jitter Determination class for Intake Camshaft B1 / accumulated angle" SLONG kw_q0p0156 1 100 -33554432.0000 33554431.9844 FORMAT "%13.4" ECU_ADDRESS 0x50001B08 /end MEASUREMENT
/begin MEASUREMENT JitDetrmIntkB1_I.agMed "Jitter Determination class for Intake Camshaft B1 / average angle" SWORD kw_q0p0156 1 100 -512.0000 511.9844 FORMAT "%8.4" ECU_ADDRESS 0x50001B0C /end MEASUREMENT
/begin MEASUREMENT JitDetrmIntkB1_I.agOld "Jitter Determination class for Intake Camshaft B1 / old angle" SWORD kw_q0p0156 1 100 -512.0000 511.9844 FORMAT "%8.4" ECU_ADDRESS 0x50001B0E /end MEASUREMENT
/begin MEASUREMENT JitDetrmIntkB1_I.cntrDevPha "Jitter Determination class for Intake Camshaft B1 / Number of evaluated angles" UWORD dez 1 100 0.00 65535.00 FORMAT "%8.2" ECU_ADDRESS 0x50001B10 /end MEASUREMENT
/begin MEASUREMENT JitDetrmIntkB1_I.cntrMedCalcPhaMax "Jitter Determination class for Intake Camshaft B1 / Number of discarded angle values aftger start" UBYTE dez 1 100 0.00 255.0 FORMAT "%5.1" ECU_ADDRESS 0x50001B12 /end MEASUREMENT
/begin MEASUREMENT JitDetrmIntkB1_I.flgPhaJitObs "Jitter Determination class for Intake Camshaft B1 / Condition jittering detected" UBYTE B_TRUE 1 100 0.00 1.00000000000 BIT_MASK 0x1 FORMAT "%13.11" ECU_ADDRESS 0x50001B13 /end MEASUREMENT
/begin MEASUREMENT rlsnw_w "selection between rlsol_w and rlshk for map KFNW" UWORD rel_uw_q0p0234 1 100 0.00 1535.977 FORMAT "%8.3" ECU_ADDRESS 0x60007546 /end MEASUREMENT
/begin MEASUREMENT statetnwe "statenumber of Statemachine ANGLE_BY_TESTER_E at inlet camshaft" UBYTE dez 1 100 0.00 255.0 FORMAT "%5.1" ECU_ADDRESS 0x6000B847 /end MEASUREMENT
/begin MEASUREMENT stnwe "operation mode of the inlet camshaft" UWORD OneToOne 1 100 0.00 65535.00 FORMAT "%8.2" ECU_ADDRESS 0x600092C4 /end MEASUREMENT
/begin MEASUREMENT tanwree_w "duty cycle to control power stage inlet camshaft(word)" UWORD rel_uw_b100 1 100 0.00 99.99847 FORMAT "%8.5" ECU_ADDRESS 0x60007544 /end MEASUREMENT
/begin MEASUREMENT tmp_misra "Temp variable to get the return value of the DSM check." UWORD OneToOne 1 100 0.00 65535.00 FORMAT "%8.2" ECU_ADDRESS 0x70002EB4 /end MEASUREMENT
/begin MEASUREMENT wgvohsme_w_msg "Average value: des. angle gas exch. valve opens intake hom.mode" SWORD kw_q0p0156 1 100 -512.0000 511.9844 FORMAT "%8.4" ECU_ADDRESS 0x600095CA /end MEASUREMENT
/begin MEASUREMENT wgvoma_w "Average value: gas exch. valve opens exhaust" SWORD kw_q0p0156 1 100 -512.0000 511.9844 FORMAT "%8.4" ECU_ADDRESS 0x600095C8 /end MEASUREMENT
/begin MEASUREMENT wgvome_w "Center value angle gas change valve opens intake" SWORD kw_q0p0156 1 100 -512.0000 511.9844 FORMAT "%8.4" ECU_ADDRESS 0x600095C6 /end MEASUREMENT
/begin MEASUREMENT wgvose_w "Des. angle: gas exch. valve opens intake" SWORD kw_q0p0156 1 100 -512.0000 511.9844 FORMAT "%8.4" ECU_ADDRESS 0x600095C4 /end MEASUREMENT
/begin MEASUREMENT wgvovgesme_w_msg "Average value desired angle intake gas exchange valve opens for VHE big cam profile" SWORD kw_q0p0156 1 100 -512.0000 511.9844 FORMAT "%8.4" ECU_ADDRESS 0x600095C2 /end MEASUREMENT
/begin MEASUREMENT wgvovkesme_w_msg "Average value desired angle intake gas exchange valve opens for VHE small cam profile" SWORD kw_q0p0156 1 100 -512.0000 511.9844 FORMAT "%8.4" ECU_ADDRESS 0x600095C0 /end MEASUREMENT
/begin MEASUREMENT wgvshsma_w_msg "Av.value: des. angle gas exch. valve closes exhaust hom.mode" SWORD kw_q0p0156 1 100 -512.0000 511.9844 FORMAT "%8.4" ECU_ADDRESS 0x600095BE /end MEASUREMENT
/begin MEASUREMENT wgvshsme_w_msg "Av.value: des. angle gas exch. valve closes intake hom.mode" SWORD kw_q0p0156 1 100 -512.0000 511.9844 FORMAT "%8.4" ECU_ADDRESS 0x600095BC /end MEASUREMENT
/begin MEASUREMENT wgvsma_w "Center value angle gas change value closes outlet" SWORD kw_q0p0156 1 100 -512.0000 511.9844 FORMAT "%8.4" ECU_ADDRESS 0x600095BA /end MEASUREMENT
/begin MEASUREMENT wgvsme_w "Center value angle gas change valve closes intake" SWORD kw_q0p0156 1 100 -512.0000 511.9844 FORMAT "%8.4" ECU_ADDRESS 0x600095B8 /end MEASUREMENT
/begin MEASUREMENT wgvssa_w "Des. angle: gas exch. valve closes exhaust" SWORD kw_q0p0156 1 100 -512.0000 511.9844 FORMAT "%8.4" ECU_ADDRESS 0x600095B6 /end MEASUREMENT
/begin MEASUREMENT wgvsse_w "Des. angle: gas exch. valve closes intake" SWORD kw_q0p0156 1 100 -512.0000 511.9844 FORMAT "%8.4" ECU_ADDRESS 0x600095B4 /end MEASUREMENT
/begin MEASUREMENT wgvsvgesma_w_msg "Average value desired angle outlet gas exchange valve closes for VHE big cam profile" SWORD kw_q0p0156 1 100 -512.0000 511.9844 FORMAT "%8.4" ECU_ADDRESS 0x600095B2 /end MEASUREMENT
/begin MEASUREMENT wgvsvgesme_w_msg "Average value desired angle inlet gas exchange valve closes for VHE big cam profile" SWORD kw_q0p0156 1 100 -512.0000 511.9844 FORMAT "%8.4" ECU_ADDRESS 0x600095B0 /end MEASUREMENT
/begin MEASUREMENT wgvsvkesma_w_msg "Average value desired angle outlet gas exchange valve closes for VHE small cam profile" SWORD kw_q0p0156 1 100 -512.0000 511.9844 FORMAT "%8.4" ECU_ADDRESS 0x600095AE /end MEASUREMENT
/begin MEASUREMENT wgvsvkesme_w_msg "Average value desired angle inlet gas exchange valve closes for VHE small cam profile" SWORD kw_q0p0156 1 100 -512.0000 511.9844 FORMAT "%8.4" ECU_ADDRESS 0x600095AC /end MEASUREMENT
/begin MEASUREMENT wnvuhoms_w_msg "Desired NW-overlap angle only by homogen. mode adj." SWORD kw_q0p0078 1 100 -256.0000 255.9922 FORMAT "%8.4" ECU_ADDRESS 0x600095AA /end MEASUREMENT
/begin MEASUREMENT wnvus_w_msg "Desired NW-overlap angle for active mode" SWORD kw_q0p0078 1 100 -256.0000 255.9922 FORMAT "%8.4" ECU_ADDRESS 0x600095A8 /end MEASUREMENT
/begin MEASUREMENT wnwehom_w "Advance control value for camshaft angle (Homogen-Mode) inlet" SWORD kw_q0p0078 1 100 -256.0000 255.9922 FORMAT "%8.4" ECU_ADDRESS 0x60007542 /end MEASUREMENT
/begin MEASUREMENT wnwreo_w "angle inlet valve opened in reference position relative to TDC bank1" SWORD kw_q0p0078 1 100 -256.0000 255.9922 FORMAT "%8.4" ECU_ADDRESS 0x60007540 /end MEASUREMENT
/begin MEASUREMENT wnwsae_w "activated desired camshaft angle, by selection of the different maps inlet" SWORD kw_q0p0078 1 100 -256.0000 255.9922 FORMAT "%8.4" ECU_ADDRESS 0x6000753E /end MEASUREMENT
/begin MEASUREMENT wnwse_w "desired camshaft angle inlet valve opened" SWORD kw_q0p0078 1 100 -256.0000 255.9922 FORMAT "%8.4" ECU_ADDRESS 0x6000753C /end MEASUREMENT
/begin MEASUREMENT wnwshwe_w "desired camshaft angle inlet valve opened homogenuous mode, warm engine" SWORD kw_q0p0078 1 100 -256.0000 255.9922 FORMAT "%8.4" ECU_ADDRESS 0x6000753A /end MEASUREMENT
/begin MEASUREMENT wnwshwke_w "desired camshaft angle inlet valve openes for homogenuous mode, warm engine, small cam profile" SWORD kw_q0p0078 1 100 -256.0000 255.9922 FORMAT "%8.4" ECU_ADDRESS 0x60007538 /end MEASUREMENT
/begin MEASUREMENT wnwsmne_w "min. desired camshaft angle inlet valve opened" SWORD kw_q0p0078 1 100 -256.0000 255.9922 FORMAT "%8.4" ECU_ADDRESS 0x60007536 /end MEASUREMENT
/begin MEASUREMENT wnwsmxe_w "max. desired camshaft angle inlet valve opened" SWORD kw_q0p0078 1 100 -256.0000 255.9922 FORMAT "%8.4" ECU_ADDRESS 0x60007534 /end MEASUREMENT
/begin MEASUREMENT wnwsswe_w_msg "Saved nominal camshaft angle inlet" SWORD kw_q0p0078 1 100 -256.0000 255.9922 FORMAT "%8.4" ECU_ADDRESS 0x600095A6 /end MEASUREMENT
/begin MEASUREMENT wnwue_w_msg "camshaft overlap angle of inlet and outlet valve opening" UWORD kw_q0p0019 1 100 0.00 127.9980 FORMAT "%8.4" ECU_ADDRESS 0x60009294 /end MEASUREMENT
/begin MEASUREMENT wnwve_w_msg "NW-adjustment angle (intake)" SWORD kw_q0p0078 1 100 -256.0000 255.9922 FORMAT "%8.4" ECU_ADDRESS 0x600095A4 /end MEASUREMENT
/begin MEASUREMENT wnwvfe_w "fine triggered camshaft angle inlet camshaft 1" SWORD kw_q0p0078 1 100 -256.0000 255.9922 FORMAT "%8.4" ECU_ADDRESS 0x60007532 /end MEASUREMENT
/begin MEASUREMENT wnwvumxe_w_msg "Max. perm. overlap angle by intake camshaft adj." UWORD kw_q0p0078 1 100 0.00 511.9922 FORMAT "%8.4" ECU_ADDRESS 0x60009290 /end MEASUREMENT
/begin MEASUREMENT wnwvu_w_msg "Overlap angle intake and exhaust camshaft only by adj." UWORD kw_q0p0078 1 100 0.00 511.9922 FORMAT "%8.4" ECU_ADDRESS 0x60009292 /end MEASUREMENT
/begin MEASUREMENT _uNeutTmp "Analog sensor1 voltage" SWORD Volt 1 100 -6553.600 6553.400 FORMAT "%8.3" ECU_ADDRESS 0x70002EB2 /end MEASUREMENT
/begin FUNCTION GbxECU_EAT7 "10.6.0    Reception process for the CAN frame EAT7"
 /begin DEF_CHARACTERISTIC Com_ctCRingEAT7_C Com_dEAT7MaxDiff_C Com_dEAT7MaxPer_C Com_ErrDeb_FailSafeA_TmrEAT7_C Com_nTrbn_C Com_numCsumEAT7_C Com_rTarPllyEAT7_C Com_swtEAT7MonEna_C Gbx_nIdlDesTrsmFail_C Gbx_nIdlDes_FailSafeA_C Gbx_nIdlDes_FailSafeB_C Gbx_nMaxEngFcoTrsmFail_C Gbx_nMaxEngFco_FailSafeA_C Gbx_nMaxEngFco_FailSafeB_C Gbx_nMaxEngTrqLimTrsmFail_C Gbx_nMaxEngTrqLim_FailSafeA_C Gbx_nMaxEngTrqLim_FailSafeB_C /end DEF_CHARACTERISTIC
 /begin IN_MEASUREMENT Com_ctCRingEAT7 Com_flgACCutDurgAtCvt Com_nIdlDes Com_nTrbn Com_numCsumEAT7 Com_rTarPllyEAT7 Com_stAmbLmpPrms Com_stFrmRxEna Com_stHvyDecelFlg Com_stMon Com_stShiftDwnReco Com_stShiftUpReco Com_stTrsmFailMod Com_stVINWrClrDone Gbx_nMaxEngFco Gbx_nMaxEngTrqLim /end IN_MEASUREMENT
 /begin OUT_MEASUREMENT Com_stEAT7Mon Gbx_nIdlDes Gbx_nTrbn /end OUT_MEASUREMENT
 /begin LOC_MEASUREMENT GbxECU_ctEAT7RngCnt_MP /end LOC_MEASUREMENT
 FUNCTION_VERSION "10.6.0" /end FUNCTION
/begin FUNCTION GbxECU_EAT8 "6.6.0     Reception process for the CAN frame EAT8"
 /begin DEF_CHARACTERISTIC Com_dEAT8MaxDiff_C Com_dEAT8MaxPer_C Com_rConvSlipHiLimHysHi_C Com_rConvSlipHiLimHysLo_C Com_rConvSlipLoLimHysHi_C Com_rConvSlipLoLimHysLo_C Com_rTrqCnvBoostDef_C Com_stAntiJerkCtrl_CW1 Com_stAntiJerkCtrl_CW2 Com_swtEAT8MonEna_C Com_swtPTRatTrqCnv_C Com_tiEngTrq_CUR Com_trqBoost_CUR /end DEF_CHARACTERISTIC
 /begin IN_MEASUREMENT ActMod_trqCrSWoDstC Com_ctCRingEAT8 Com_flgCvtFcoPrms Com_numCsumEAT8 Com_numCvtGearShiftMap Com_rConvBoost Com_rConvSlip Com_stATMILReqEAT8 Com_stCvtPosnPrms Com_stFrmRxEna Com_stFwdRvsCluInfo Com_stGearChgCtrlMod Com_stLCInfo Com_stMon Com_stVehSpdSensErr CoVeh_trqAcs Gbx_stGearLvr /end IN_MEASUREMENT
 /begin OUT_MEASUREMENT Com_flgAntiJerkCnvrSlipEna Com_flgAntiJerkCnvrSlipEnaNoDly Com_rTrqCnvBoost Com_stAntiJerkCtrlInhb Com_stEAT8Mon Com_trqEngTrq /end OUT_MEASUREMENT
 /begin LOC_MEASUREMENT GbxECU_ctEAT8RngCnt_MP /end LOC_MEASUREMENT
 FUNCTION_VERSION "6.6.0" /end FUNCTION
/begin FUNCTION GbxECU_EATA "8.5.0_6SAAReception process for the CAN frame EATA"
 /begin DEF_CHARACTERISTIC Com_dEATAMaxDiff_C Com_dEATAMaxPer_C Com_dEATASigSel_C Com_swtEATAMonEna_C /end DEF_CHARACTERISTIC
 /begin IN_MEASUREMENT Com_ctCRingEATA Com_lTotRingEATA Com_nTrsmMaiShaft Com_numCsumEATA Com_stFrmRxEna Com_stMon Com_vVehCtl Com_vVehInstPnl /end IN_MEASUREMENT
 /begin OUT_MEASUREMENT Com_flgEATANorm Com_stEATAMon /end OUT_MEASUREMENT
 /begin LOC_MEASUREMENT GbxECU_ctEATARngCnt_MP /end LOC_MEASUREMENT
 FUNCTION_VERSION "8.5.0_6SAA" /end FUNCTION
/begin FUNCTION GbxECU_EATB "15.4.0_1.0.0Reception process for the CAN frame EATB"
 /begin DEF_CHARACTERISTIC Com_dEATBMaxDiff_C Com_dEATBMaxPer_C Com_stCVTFailrInfo_C Com_stCVTShiftActv_C Com_stEATBCrkMask_C Com_stMilLtgReq_C Com_stMissSnsrFlg_C Com_stNoShftSel_C Com_stShftInNeutr_C Com_stShftInPark_C Com_stShftSel0_C Com_stShftSel1_C Com_stShftSel2_C Com_stShftSel3_C Com_stShftSel4_C Com_stShftSel5_C Com_stSpdSnsrFailr_C Com_stVehSpdSnsr_C Com_swtCrkCdn_C Com_swtEATBMonEna_C Com_swtShiftPosn_C Com_tiCanDebTmr_C CVT_SHFT_IN_D_C CVT_SHFT_IN_L_C CVT_SHFT_IN_NEUTRAL_C CVT_SHFT_IN_NO_C CVT_SHFT_IN_PARKING_C CVT_SHFT_IN_REVERSE_C CVT_SHFT_IN_S_C /end DEF_CHARACTERISTIC
 /begin IN_MEASUREMENT Com_ctCRingEATB Com_numCsumEATB Com_rCVTAct Com_stCANANoBusOff Com_stCVTFailrInfo Com_stCVTShiftActv Com_stFrmRxEna Com_stFwdRvsCluInfo Com_stMilLtgReq Com_stMissSnsrFlg Com_stMon Com_stShftInD Com_stShftInL Com_stShftInNeutr Com_stShftInPark Com_stShftInRev Com_stShftInS Com_stSpdSnsrFailr Com_stVehSpdSnsr Gbx_stPNPos SyC_ctPostDrvLeave SyC_stSub T15_st /end IN_MEASUREMENT
 /begin OUT_MEASUREMENT Com_flgAutCrkActv Com_flgCVTPNPos Com_flgManCrkFCANEna Com_stCanErr Com_stCrkCdn Com_stCvtShiftNeut Com_stCvtShiftRvs Com_stEATBByte0Info Com_stEATBMon Com_stLowVoltFCan Com_stLowVoltPCan Com_stNeutInfo Com_stRxEATBChkSumOk Com_stRxEATBDeb Com_stRxEATBRingCntOk Com_stShftNP Com_stShftRev Gbx_stGearLvr /end OUT_MEASUREMENT
 /begin LOC_MEASUREMENT Com_ctReIni10msEATB Com_flgDFCSrv7VisClrInProgs Com_stCanChkFlg_MP Com_stCrkCdn_MP Com_tiCanChkTmr_MP GbxECU_ctEATBRngCnt_MP /end LOC_MEASUREMENT
 FUNCTION_VERSION "15.4.0_1.0.0" /end FUNCTION
/begin FUNCTION GbxECU_EATC "714.1.0   Reception process for the CAN frame EATC" /begin DEF_CHARACTERISTIC Com_dEATCMaxDiff_C Com_dEATCMaxPer_C /end DEF_CHARACTERISTIC
 /begin IN_MEASUREMENT Com_ctCRingEATC Com_numCsumEATC Com_stFrmRxEna Com_stMon Com_stTCUECUIG1 Com_uBattDetnTCUECU Com_uIG1DetnTCUECU SyC_ctPostDrvLeave T15_st /end IN_MEASUREMENT
 /begin LOC_MEASUREMENT Com_ctReIni10msEATC GbxECU_ctEATCRngCnt /end LOC_MEASUREMENT
 FUNCTION_VERSION "714.1.0" /end FUNCTION
/begin FUNCTION GbxNPos_DD "44.0.0    Neutral position sensor for gearbox device driver"
 /begin DEF_CHARACTERISTIC Gbx_cntrNeutPosnCANPlausErr_C Gbx_facCorrlnAnaNPos_C Gbx_numMaxNPosAlv_C Gbx_stNeut_C Gbx_stNotNeut_C Gbx_stSwtCfgNeutPosn_C Gbx_swtSigInpLogic_C Gbx_swtSigNeutPosn_C Gbx_tiDigNeutPosnOffDeb_C Gbx_tiDigNeutPosnOnDeb_C Gbx_tiNeutInsertedDly_C Gbx_tiNeutNotInsertedDly_C Gbx_tiNeutPosnDebHiLo_C Gbx_tiNeutPosnDebLoHi_C Gbx_uAn1NeutPosnRawTmp_C Gbx_uAn1SRCMax_C Gbx_uAn1SRCMin_C Gbx_uAn2SRCMax_C Gbx_uAn2SRCMin_C Gbx_uCorrlnMaxDiffAnSnsr_CUR Gbx_uNeutPosnRngHi_C Gbx_uNeutPosnRngLo_C /end DEF_CHARACTERISTIC
 /begin IN_MEASUREMENT Com_stGbxNPos Com_stShftNP T15_st /end IN_MEASUREMENT
 /begin OUT_MEASUREMENT Gbx_stActvNPos Gbx_stAnaNPos Gbx_stAnaNPosnWoAlvChk Gbx_stAnNeutPosnFlt Gbx_stAnNeutPosnRaw Gbx_stNPos Gbx_stNPosErr Gbx_stNPosRaw Gbx_uAna1NPosRaw Gbx_uAna2NPosRaw /end OUT_MEASUREMENT
 /begin LOC_MEASUREMENT Gbx_cntrNeutPosnCANPlausErr Gbx_flgAn1NeutPosnSRCMax Gbx_flgAn1NeutPosnSRCMin Gbx_flgAn2NeutPosnSRCMax Gbx_flgAn2NeutPosnSRCMin Gbx_flgAnaNPosSyncErr Gbx_flgNeutChk Gbx_flgNeutErr1 Gbx_flgNeutErr2 Gbx_flgNeutPosnCANPlausErr Gbx_flgNeutSig Gbx_flgNonNeutChk Gbx_numNeutPosnAlv Gbx_stAlvChk Gbx_stAnaNPosBrkHld Gbx_uAn1NeutPosnRawTmp tmp_misra _uNeutTmp /end LOC_MEASUREMENT
 FUNCTION_VERSION "44.0.0" /end FUNCTION
/begin FUNCTION GbxPNPos_DD "8.0.0     Gearbox Park Neutral position sensor device driver"
 /begin DEF_CHARACTERISTIC GbxPNPos_stPNSwtInv_C GbxPNPos_tiDebHiLo_C GbxPNPos_tiDebLoHi_C Gbx_nPNPosnDiagDrvCdnThd_C Gbx_nPNPosnDiagPlausyThd_C Gbx_rPNPosnDiagAccPedlThd_C Gbx_trqPNPosnDiagTqThd_C Gbx_uPNPosnDiagThdHi_C Gbx_uPNPosnDiagThdLo_C Gbx_vPNPosnDiagVThd_C /end DEF_CHARACTERISTIC
 /begin IN_MEASUREMENT ActMod_trqCrS APP_r BattU_u Epm_nEng Gbx_stGearLvr PT_stTraType SyC_ctPostDrvLeave VehV_v /end IN_MEASUREMENT
 /begin OUT_MEASUREMENT Gbx_stPNPos Gbx_stPNPosnDeb Gbx_stPNPosnRaw /end OUT_MEASUREMENT
 /begin LOC_MEASUREMENT GbxPNPos_cntrReIni GbxPNPos_stPNPosnDiagEna /end LOC_MEASUREMENT
 FUNCTION_VERSION "8.0.0" /end FUNCTION
/begin FUNCTION GbxPPos_Vd "1.2.0     Gearbox park position (P) Virtual driver" /begin IN_MEASUREMENT Com_stPPos /end IN_MEASUREMENT /begin OUT_MEASUREMENT Gbx_stPPos /end OUT_MEASUREMENT FUNCTION_VERSION "1.2.0" /end FUNCTION
/begin FUNCTION GbxRvsSwt_DD "17.1.0    Device Driver for Reverse Position Switch"
 /begin DEF_CHARACTERISTIC Gbx_lDiffDst_C Gbx_RvsPosDeb.tiHiLo_C Gbx_RvsPosDeb.tiLoHi_C Gbx_swtRvsPosPrs_C Gbx_swtRvsSwtStkEna_C Gbx_tiRvsSwtStk_C Gbx_uRvsSwtStk_C /end DEF_CHARACTERISTIC
 /begin IN_MEASUREMENT BattU_u GlbDa_lTotDst SyC_ctPostDrvLeave T15_st /end IN_MEASUREMENT
 /begin OUT_MEASUREMENT Gbx_stRvsPos Gbx_stRvsPosRaw /end OUT_MEASUREMENT
 /begin LOC_MEASUREMENT Gbx_ctRvsSwtReIni Gbx_lDiffDst Gbx_lDiffDstM Gbx_lTotDstOld Gbx_stRvsSwtCnd Gbx_stRvsSwtErr /end LOC_MEASUREMENT
 FUNCTION_VERSION "17.1.0" /end FUNCTION
/begin FUNCTION GConf_Sy "PCFG_MG1CS022_62XSC_34" FUNCTION_VERSION "PCFG_MG1CS022_62XSC_34" /end FUNCTION
/begin FUNCTION GEVCtl_AVCAdpr "10.2.1    Adaptor for AVC-Functions"
 /begin DEF_CHARACTERISTIC DWGVOKE DWOGVKE SF_NWS SF_NWSE TDDENWS WNWRAS WNWREO WNWSMNE WNWSMXE /end DEF_CHARACTERISTIC
 /begin REF_CHARACTERISTIC GEVCtl_stPhaAdpr_C /end REF_CHARACTERISTIC
 /begin IN_MEASUREMENT GEVCtl_agDifStdSpclLftClsdIntk GEVCtl_agIntkClsd GEVCtl_agIntkOpen GEVCtl_agOutlClsd GEVCtl_agOutlOpen GEVCtl_agRefPosnIntkB1 GEVCtl_agSpDrvDmdIntk GEVCtl_agSpHomIntk GEVCtl_agSpHomIntkClsd GEVCtl_agSpHomIntkOpen GEVCtl_agSpHomOutlClsd GEVCtl_agSpHomVlvOvl GEVCtl_agSpHomWrmIntk GEVCtl_agSpIntkB1 GEVCtl_agSpIntkClsd GEVCtl_agSpIntkHiLftIntkClsd GEVCtl_agSpIntkHiLftIntkOpen GEVCtl_agSpIntkHiLftOutlClsd GEVCtl_agSpIntkLoLftIntkClsd GEVCtl_agSpIntkLoLftIntkOpen GEVCtl_agSpIntkLoLftOutlClsd GEVCtl_agSpIntkOpen GEVCtl_agSpLoLftWrmIntk GEVCtl_agSpMaxIntk GEVCtl_agSpMinIntk GEVCtl_agSpOutlClsd GEVCtl_agSpUnFildIntkB1 GEVCtl_agSpVlvOvl GEVCtl_flgAdpnTstrFinshdIntk GEVCtl_flgCalcSpIntkHiLft GEVCtl_flgMinOvlIntk GEVCtl_flgPhaActrTestEnaFctIntk GEVCtl_flgPhaActrTestEnaIntk GEVCtl_flgPhaActvnSpActrTstrIntk GEVCtl_flgPhaEna GEVCtl_flgPhaEnaIntk GEVCtl_flgPhaToRefPosnIntk GEVCtl_flgReqRefAdpn GEVCtl_flgReqRefAdpnIntk GEVCtl_flgSpSpclIntk GEVCtl_ratLoad GEVCtl_stGslSpIntk GEVCtl_stPhaDiagTstrIntk GEVCtl_tqResvPhaDiagTstr GEVlv_agDePhaDiagIntkB1 GEVlv_agExtrpnIntkB1 GEVlv_agMaxShiftIntk GEVlv_agOvlShiftB1 GEVlv_agShiftIntkB1 GEVlv_flgPhaActrErrSuspcIntkB1 GEVlv_flgPhaDiagEnaCsersIntkB1 GEVlv_flgPhaDiagEnaIntkB1 GEVlv_flgPhaDiagRdyIntkB1 GEVlv_ratAgShiftMaxShiftIntkB1 GEVlv_ratPhaIntkB1 SyC_stSub /end IN_MEASUREMENT
 /begin OUT_MEASUREMENT AirSys_bCaSEdgAdapIntk AirSys_bCaSRefAdap B_anfnwrad B_dnwcse B_dnwse B_enws B_enwse B_enwsve B_fanwftve B_fanwkwze B_fanwstae_msg B_fanwte B_fanwtze B_fnwaktve_msg B_nwflade B_nwrpose B_nws B_nwswg_msg B_nwvfe B_spfnwe B_wgvsvheg_msg B_wnwsmnue dmrdnw_w dwgvsge_w_msg dwnwfde_w fnwue_msg rlsnw_w statetnwe stnwe tanwree_w wgvohsme_w_msg wgvoma_w wgvome_w wgvose_w wgvovgesme_w_msg wgvovkesme_w_msg wgvshsma_w_msg wgvshsme_w_msg wgvsma_w wgvsme_w wgvssa_w wgvsse_w wgvsvgesma_w_msg wgvsvgesme_w_msg wgvsvkesma_w_msg wgvsvkesme_w_msg wnvuhoms_w_msg wnvus_w_msg wnwehom_w wnwreo_w wnwsae_w wnwse_w wnwshwe_w wnwshwke_w wnwsmne_w wnwsmxe_w wnwsswe_w_msg wnwue_w_msg wnwve_w_msg wnwvfe_w wnwvumxe_w_msg wnwvu_w_msg /end OUT_MEASUREMENT
 FUNCTION_VERSION "10.2.1" /end FUNCTION
/begin FUNCTION GEVCtl_CalSuprt "1.0.0     Camshaft calibration support"
 /begin DEF_CHARACTERISTIC GEVCtl_agGrdtErrSimMaxIntk_C GEVCtl_agGrdtErrSimMinIntk_C GEVCtl_agSpCalSuprtAdvIntk_C GEVCtl_agSpCalSuprtIntk_C GEVCtl_agSpCalSuprtIntk_GM GEVCtl_agSpCalSuprtRtdIntk_C GEVCtl_agSpDeltaSimCsersDiagIntk_C GEVCtl_agSpErrSimIntk_T GEVCtl_agSpRampMaxIntk_C GEVCtl_agSpRampMinIntk_C GEVCtl_cntrGrdtTstFctRepnIntk_C GEVCtl_idxGrdtTstFctRepnStopIntk_C GEVCtl_idxGrdtTstFctRepnStrtIntk_C GEVCtl_RampSigIntk_I.vGrdtTstFct_T GEVCtl_stAdapErrSim_C GEVCtl_stCfgCalSuprt_C GEVCtl_stErrIntkB1_C GEVCtl_stOperModSim_C GEVCtl_stPhaErrSim_C GEVCtl_stSpCalSuprtIntk_C GEVCtl_tiAgSpCalSuprtTogPerdIntk_C GEVCtl_tiGrdtTstFctDebIntk_C GEVCtl_tiPhaErrSimAdvIntk_C GEVCtl_tiPhaErrSimRtdIntk_C /end DEF_CHARACTERISTIC
 /begin REF_CHARACTERISTIC GEVCtl_nEng_Ax GEVCtl_ratLoad_Ax /end REF_CHARACTERISTIC
 /begin IN_MEASUREMENT B_khakt_msg B_kh_msg Epm_nEng GEVCtl_agRefPosnIntkB1 GEVCtl_agSpIntkB1 GEVCtl_agSpNonCsersIntkB1 GEVCtl_ratLoad SyC_stSub /end IN_MEASUREMENT
 /begin OUT_MEASUREMENT GEVCtl_agSpCalSuprtIntk GEVCtl_agSpDeltaSimCsersDiagIntk GEVCtl_agSpErrSimIntkB1 GEVCtl_flgAdapErrSimIntk GEVCtl_flgAdapErrSimIntkB1 GEVCtl_flgPhaErrSimIntk GEVCtl_flgPhaErrSimIntkB1 GEVCtl_flgSimCsersDiag GEVCtl_flgSpCalSuprtIntk /end OUT_MEASUREMENT
 /begin LOC_MEASUREMENT GEVCtl_agRefPosnIntkBX GEVCtl_agSpErrSimInpIntkB1 GEVCtl_agSpErrSimLimIntkB1 GEVCtl_agSpErrSimLpIntkB1 GEVCtl_agSpJmpIntk GEVCtl_agSpRampIntk GEVCtl_JmpSigIntk_I.agSpJmp GEVCtl_RampSigIntk_I.agSpRamp GEVCtl_RampSigIntk_I.agSpRampPre GEVCtl_RampSigIntk_I.cntrIdx GEVCtl_RampSigIntk_I.flgDir GEVCtl_RampSigIntk_I.flgLimRea GEVCtl_RampSigIntk_I.flgMaxRepn GEVCtl_RampSigIntk_I.flgSwtDir GEVCtl_RampSigIntk_I.idxGrdtTstFctRepn GEVCtl_RampSigIntk_I.vGrdtTstFct GEVCtl_stErrIntkB1 GEVCtl_stSpCalSuprtIntk /end LOC_MEASUREMENT
 FUNCTION_VERSION "1.0.0" /end FUNCTION
/begin FUNCTION GEVCtl_LftLimp "5.1.0     Limp home coordinator for valve lift system" /begin IN_MEASUREMENT VlvLft_flgFbVlvStIntk /end IN_MEASUREMENT /begin OUT_MEASUREMENT GEVCtl_flgLftLimpNLim /end OUT_MEASUREMENT FUNCTION_VERSION "5.1.0" /end FUNCTION
/begin FUNCTION GEVCtl_PhaAdpr "3.13.0    Interface adapter phase shifting camshaft"
 /begin DEF_CHARACTERISTIC GEVCtl_nEngIdle_Ax GEVCtl_nEngLoLft_Ax GEVCtl_nEngStdIdle_Ax GEVCtl_nEng_Ax GEVCtl_ratLoadIdle_Ax GEVCtl_ratLoadLoLft_Ax GEVCtl_ratLoadStdIdle_Ax GEVCtl_ratLoad_Ax GEVCtl_stPhaAdpr_C GEVCtl_stRatLoadSeln_C /end DEF_CHARACTERISTIC
 /begin IN_MEASUREMENT B_tochg_msg B_vhegs_msg Epm_nEng KONCW_flgRatLoadCalMod rlshhkid_w_msg rlshhk_w_msg rlsol_w_msg rl_w_msg SyC_stSub toch_w_msg /end IN_MEASUREMENT
 /begin OUT_MEASUREMENT GEVCtl_flgSpSpclIntkVlvLft GEVCtl_ratLoad GEVCtl_tOilCylHd /end OUT_MEASUREMENT
 FUNCTION_VERSION "3.13.0" /end FUNCTION
/begin FUNCTION GEVCtl_PhaEna "2.21.0    Enable conditions phase shifting camshaft"
 /begin DEF_CHARACTERISTIC GEVCtl_nEngMinPhaDeactvIntk_T GEVCtl_nEngMinPhaDebDeactvIntk_T GEVCtl_nEngMinPhaEnaHys_T GEVCtl_nEngMinPhaEnaIntk_T GEVCtl_stPhaCtrlGlb_C GEVCtl_stPhaEna_C GEVCtl_tEngStrtMaxOilPresEna_C GEVCtl_tiDlyEngMinPhaDeactvIntk_C GEVCtl_tiDlyPhaEnaEngOff_M GEVCtl_tiDlyPhaEnaPOil_T GEVCtl_tiPhaEnaEngOffThd_C GEVCtl_tiPhaEnaIntk_T GEVCtl_tOilMaxPhaEna_C GEVCtl_tOilMinPhaEna_C GEVCtl_tOilPhaEnaHys_C GEVCtl_uBattMaxPhaEna_C GEVCtl_uBattMinPhaEnaHys_C GEVCtl_uBattMinPhaEna_C /end DEF_CHARACTERISTIC
 /begin IN_MEASUREMENT BattU_u CEngDsT_t CEngDsT_tStrt CoEng_stMai CoVOM_flgTrigCamsftRefPosn Epm_nEng Epm_stSpd GEVCtl_flgPhaActrTestEnaFctIntk GEVCtl_flgPhaEnaPOil GEVCtl_tOilCylHd OilSwmpT_t SyC_stSub T15_st TiEngOff_ti /end IN_MEASUREMENT
 /begin OUT_MEASUREMENT GEVCtl_flgPhaEna GEVCtl_flgPhaEnaIntk GEVCtl_flgPhaEnaIntkErr /end OUT_MEASUREMENT
 /begin LOC_MEASUREMENT GEVCtl_flgPhaEnaAftStrt GEVCtl_flgPhaEnaAftStrtIntk GEVCtl_flgPhaEnaAmb GEVCtl_flgPhaEnaEngRestrt GEVCtl_flgPhaEnaNEngIntk GEVCtl_flgPhaEnaTOil GEVCtl_flgTiAftStrtIntk GEVCtl_flgTiAftStrtPrevDrvgCyc GEVCtl_tEngStrt GEVCtl_tOilPhaEna /end LOC_MEASUREMENT
 FUNCTION_VERSION "2.21.0" /end FUNCTION
/begin FUNCTION GEVCtl_PhaSpclSpOper "9.3.0     Special set point operation phase actuator"
 /begin DEF_CHARACTERISTIC GEVCtl_agSpAdvClngIntk_C GEVCtl_agSpRtdtClngIntk_C GEVCtl_nEngMaxClng_C GEVCtl_nEngMinClng_C GEVCtl_nrMaxClngCycErrIntk_C GEVCtl_nrMaxClngCycIntk_C GEVCtl_nrShkEveIntk_C GEVCtl_nrShkEvePostDrv_C GEVCtl_stPhaSpclSpOper_C GEVCtl_tiBtwShkEvePostDrvHi_C GEVCtl_tiBtwShkEvePostDrvLo_C GEVCtl_tiDlyClngPostDrvIntk_C GEVCtl_tiPerdClngIntk_C GEVCtl_tOilMaxClngPostDrv_C GEVCtl_tOilMaxClng_C GEVCtl_tOilMinClngPostDrv_C GEVCtl_tOilMinClng_C /end DEF_CHARACTERISTIC
 /begin IN_MEASUREMENT Brk_st B_dagrssf_msg B_vheinst_msg Clth_st CoEng_stMai Epm_nEng Epm_stSpd GEVCtl_agSpDrvDmdIntk GEVCtl_agSpMaxIntk GEVCtl_agSpMinIntk GEVCtl_agSpPhaUnLckIntkB1 GEVCtl_flgPhaEnaIntk GEVCtl_flgPhaUnLckActvIntkB1 GEVCtl_tOilCylHd GEVlv_flgCsersEomActvIntk PthSet_bOvrRun SyC_stSub /end IN_MEASUREMENT
 /begin OUT_MEASUREMENT GEVCtl_agSpSpclOperIntkB1 GEVCtl_flgClngActvIntk GEVCtl_flgClngActvPostDrvIntk GEVCtl_flgClngOnIntk GEVCtl_flgClngRels GEVCtl_flgEngOffClnActv GEVCtl_flgRmnClngCycIntk GEVCtl_flgSpSpclOperActvIntkB1 /end OUT_MEASUREMENT
 /begin LOC_MEASUREMENT GEVCtl_agSpClngIntk GEVCtl_cntrClngCycIntk GEVCtl_flgClngCycCmplIntk GEVCtl_flgClngReqIntk GEVCtl_flgEngStActrClng GEVCtl_flgEngStalEna /end LOC_MEASUREMENT
 FUNCTION_VERSION "9.3.0" /end FUNCTION
/begin FUNCTION GEVCtl_PhaSpIntk "30.1.0    Set points phase shifting intake camshaft"
 /begin DEF_CHARACTERISTIC GEVCtl_agOffsSpcltoStdLftIntk_C GEVCtl_agSpCatHeatgEth85FacHiIdleIntk_GM GEVCtl_agSpCatHeatgEth85FacHiLoLftIdleIntk_GM GEVCtl_agSpCatHeatgEth85FacLoIdleIntk_GM GEVCtl_agSpCatHeatgEth85FacLoLoLftIdleIntk_GM GEVCtl_agSpCatHeatgEthFacHiIntk_GM GEVCtl_agSpCatHeatgEthFacHiLoLftIntk_GM GEVCtl_agSpCatHeatgEthFacLoIntk_GM GEVCtl_agSpCatHeatgEthFacLoLoLftIntk_GM GEVCtl_agSpCatHeatgFacHiIdleIntk_GM GEVCtl_agSpCatHeatgFacHiIntk_GM GEVCtl_agSpCatHeatgFacHiLoLftIdleIntk_GM GEVCtl_agSpCatHeatgFacHiLoLftIntk_GM GEVCtl_agSpCatHeatgFacLoIdleIntk_GM GEVCtl_agSpCatHeatgFacLoIntk_GM GEVCtl_agSpCatHeatgFacLoLoLftIdleIntk_GM GEVCtl_agSpCatHeatgFacLoLoLftIntk_GM GEVCtl_agSpDeltaFilOffIntk_C GEVCtl_agSpDeltaFilOnIntk_C GEVCtl_agSpDeltaTrigChrgInc_C GEVCtl_agSpDeltaUnstyTarPosnIntk_C GEVCtl_agSpDeltaVlvLftSwtPosnIntk_C GEVCtl_agSpDeltaVlvLftTarPosnIntk_C GEVCtl_agSpDifIoFilLimNegIntk_M GEVCtl_agSpDifIoFilLimPosIntk_M GEVCtl_agSpFrznMod2Intk_M GEVCtl_agSpFrznModIntk_C GEVCtl_agSpHomColdIntk_GM GEVCtl_agSpHomCorrnRhoEthFacIntk_GM GEVCtl_agSpHomCorrnRhoIntk_GM GEVCtl_agSpHomEthColdIntk_GM GEVCtl_agSpHomEthFacWrmIntk_GM GEVCtl_agSpHomNoEgrEthFacHiWrmIntk_GM GEVCtl_agSpHomNoEgrEthFacLoWrmIntk_GM GEVCtl_agSpHomWrmIntk_GM GEVCtl_agSpIdleColdIntk_GM GEVCtl_agSpIdleEthColdIntk_GM GEVCtl_agSpIdleWrmIntk_GM GEVCtl_agSpLoLftColdIntk_GM GEVCtl_agSpLoLftEthColdIntk_GM GEVCtl_agSpLoLftEthNoEgrWrmIntk_GM GEVCtl_agSpLoLftEthWrmIntk_GM GEVCtl_agSpLoLftIdleColdIntk_GM GEVCtl_agSpLoLftIdleWrmIntk_GM GEVCtl_agSpLoLftNoEgrWrmIntk_GM GEVCtl_agSpLoLftWrmIntk_GM GEVCtl_agSpMinOvlIntk_C GEVCtl_agSpPrpnVlvLftSwtIntk_GM GEVCtl_agSpRedOvlPreIgnIntk_T GEVCtl_agSpRefPosnGrdtLimIntk_T GEVCtl_agSpRefPosnReaDeltaIntk_C GEVCtl_agThdFilSlowTiIntk_C GEVCtl_facCorrnRho_T GEVCtl_facEthColdWrmIntk_T GEVCtl_facEthFrctCatHeatgIntk_T GEVCtl_facEthFrctCatHeatgLoLftIntk_T GEVCtl_facEthFrctHomColdIntk_T GEVCtl_facEthFrctHomWarmIntk_T GEVCtl_facEthFrctIdleModIntk_T GEVCtl_facEthFrctIntk_T GEVCtl_facEthFrctLoLftColdIntk_T GEVCtl_facEthFrctLoLftNoEgrWrmIntk_T GEVCtl_facEthFrctLoLftWrmIntk_T GEVCtl_facEthFrctNoEgrHomWarmIntk_T GEVCtl_facFrznModSpSwtIntk_M GEVCtl_facHighFrznModSpSwtIntk_C GEVCtl_facLoFrznModSpSwtIntk_C GEVCtl_facRatLoadDeltaIntk_T GEVCtl_facTiAgSpFilIntk_T GEVCtl_facTiAgSpFilTOilIntk_T GEVCtl_facTranColdWrmEthIntk_M GEVCtl_facTranColdWrmIntk_M GEVCtl_facTranColdWrmLoLftEthIntk_M GEVCtl_facTranColdWrmLoLftIntk_M GEVCtl_idxTiAgSpFilIntk_CA GEVCtl_nHysSpIdleIntk_C GEVCtl_nSpIdleIntk_C GEVCtl_ratLoadLo_C GEVCtl_stCsersExhDiaCfg_C GEVCtl_stNonCsersIntkCfg_C GEVCtl_stPhaSpExtdIntk_C GEVCtl_stPhaSpIntkVlvLft_C GEVCtl_stPhaSpIntk_C GEVCtl_stPhaSpSupExtdIntk_C GEVCtl_tiActrReactnToutIntk_T GEVCtl_tiAgSpFilNegDe1Intk_M GEVCtl_tiAgSpFilNegDe2Intk_M GEVCtl_tiAgSpFilNegDe3Intk_M GEVCtl_tiAgSpFilPosDe1Intk_M GEVCtl_tiAgSpFilPosDe2Intk_M GEVCtl_tiAgSpFilPosDe3Intk_M GEVCtl_tiAgSpFilSlowTiTranIntk_T GEVCtl_tiAgSpFilUnstyMod1Intk_M GEVCtl_tiAgSpFilUnstyMod2Intk_M GEVCtl_tiAgSpFilUnstyMod3Intk_M GEVCtl_tiAgSpFilVlvLftSwtIntk_T GEVCtl_tiDlyFastFildgIntk_C GEVCtl_tOilCylHdMinIntk_C GEVCtl_tOilFrznModMaxIntk_C GEVCtl_vVehLo_C /end DEF_CHARACTERISTIC
 /begin REF_CHARACTERISTIC GEVCtl_nEngIdle_Ax GEVCtl_nEngLoLft_Ax GEVCtl_nEngStdIdle_Ax GEVCtl_nEng_Ax GEVCtl_ratLoadIdle_Ax GEVCtl_ratLoadLoLft_Ax GEVCtl_ratLoadStdIdle_Ax GEVCtl_ratLoad_Ax /end REF_CHARACTERISTIC
 /begin IN_MEASUREMENT B_agrbb_msg B_bkvnwab_msg B_vhegs_msg B_vhegvse_msg B_vhegvss_msg B_vhenwsspe_msg CEngDsT_t CEngDsT_tStrt CoEng_tiNormal CoEOM_flgEomSwtActv CoVMD_flgIdleDrv EGSDCmn_flgOperPntActvParl EnvT_t Epm_nEng Epm_stSpd FfPrm_facEth fnwkhe_msg GEVCtl_agMaxAdpdIntk GEVCtl_agMinAdpdIntk GEVCtl_agRefPosnIntkB1 GEVCtl_agSpCalSuprtIntk GEVCtl_agSpDeltaSimCsersDiagIntk GEVCtl_agSpMaxIntk GEVCtl_agSpMinIntk GEVCtl_agSpPhaActrTstrIntk GEVCtl_agSpSpclOperIntkB1 GEVCtl_flgPhaActvnSpActrTstrIntk GEVCtl_flgPhaEnaIntk GEVCtl_flgPhaSpToRefPosnIntk GEVCtl_flgSimCsersDiag GEVCtl_flgSpCalSuprtIntk GEVCtl_flgSpSpclOperActvIntkB1 GEVCtl_ratLoad GEVCtl_tOilCylHd GEVlv_agIntkB1 IKCtl_flgReqCvlci PEnv_p SyC_stSub ThrVlv_flgLimpModeB1 ThrVlv_flgReqFuCutOffB1 VehV_v /end IN_MEASUREMENT
 /begin OUT_MEASUREMENT B_vhegnwzpe_msg B_vhenwspe_msg B_vhenwvspe_msg GEVCtl_agSpCsersDiagIntk GEVCtl_agSpCurrLftIntkB1 GEVCtl_agSpDifIoFilIntk GEVCtl_agSpDrvDmdIntk GEVCtl_agSpFildIntk GEVCtl_agSpHomHiLftIntk GEVCtl_agSpHomIntk GEVCtl_agSpHomLoLftIntk GEVCtl_agSpHomWrmIntk GEVCtl_agSpIntkB1 GEVCtl_agSpLoLftWrmIntk GEVCtl_agSpNonCsersIntkB1 GEVCtl_agSpUnFildIntkB1 GEVCtl_agSpUnlimIntkB1 GEVCtl_facCorrnRho GEVCtl_facTranColdWrmIntk GEVCtl_flgCamsftUnstyModIntk GEVCtl_flgMinOvlIntk GEVCtl_flgPhaToRefPosnSpReaIntk GEVCtl_flgRatLoadLo GEVCtl_flgSpCatHeatgIntk GEVCtl_flgSpIdleIntk GEVCtl_flgSpSpclIntk GEVCtl_flgSpStgyChgIntk GEVCtl_flgVVehLo GEVCtl_stGslSpIntk /end OUT_MEASUREMENT
 /begin LOC_MEASUREMENT GEVCtl_agSpCatHeatgIdleFacHiCurrLftIntk GEVCtl_agSpCatHeatgIdleFacHiIntk GEVCtl_agSpCatHeatgIdleFacHiLoLftIntk GEVCtl_agSpCatHeatgIdleFacLoCurrLftIntk GEVCtl_agSpCatHeatgIdleFacLoIntk GEVCtl_agSpCatHeatgIdleFacLoLoLftIntk GEVCtl_agSpCatHeatgIntk GEVCtl_agSpDifIoFilLimNegIntk GEVCtl_agSpDifIoFilLimPosIntk GEVCtl_agSpDrvDmdIntk_a GEVCtl_agSpFrznModIntk GEVCtl_agSpPrpnVlvLftSwtIntk GEVCtl_agSpRefPosnGrdtLimIntk GEVCtl_agSpSpclIntkB1 GEVCtl_flgAgSpFilOnIntk GEVCtl_flgExhDiagNonCsersIntk GEVCtl_flgNonCsersEOMActvIntk GEVCtl_flgNonCsersSpIntk GEVCtl_flgSpRefPosnIntk GEVCtl_flgStrtStopEvtIntk GEVCtl_idxTiAgSpFilIntk GEVCtl_ratLoadDeltaIntk GEVCtl_rhoEnv GEVCtl_stGslSpNonCsersIntk GEVCtl_tiAgSpFilIntk GEVCtl_tiAgSpFilIntkBas GEVCtl_tiNormalIntk GEVCtl_tTiAgSpFilCorrnIntk /end LOC_MEASUREMENT
 FUNCTION_VERSION "30.1.0" /end FUNCTION
/begin FUNCTION GEVCtl_PhaSpTstr "1.6.0_1.1.0Set points phase shifting by tester demand"
 /begin DEF_CHARACTERISTIC GEVCtl_nHysPhaFctReqDiag_C GEVCtl_nMinPhaFctReqDiag_C GEVCtl_stPhaActrTestEnaFct_C GEVCtl_tiPhaActvPosnTstrIntk_C GEVCtl_tiPhaPasPosnTstrIntk_C GEVCtl_tiPhaSpRampTstrIntk_C GEVCtl_tiPhaStrtTstrIntk_C GEVCtl_tqResvPhaDiagTstr_C /end DEF_CHARACTERISTIC
 /begin IN_MEASUREMENT Epm_nEngLRes GEVCtl_agSpMaxIntk GEVCtl_agSpMinIntk GEVCtl_stCamPhaActrIntk_AbrtReasonMsg GEVCtl_stCamPhaActrIntk_StMsg GEVCtl_stCamPhaActrIntk_StrtPermMsg GEVlv_flgPhaDiagEnaIntkB1 GEVlv_flgPhaDiagRdyIntkB1 SyC_stSub /end IN_MEASUREMENT
 /begin OUT_MEASUREMENT GEVCtl_agSpPhaActrTstrIntk GEVCtl_flgPhaActrTestEnaFctIntk GEVCtl_flgPhaActrTestEnaIntk GEVCtl_flgPhaActvnSpActrTstrIntk GEVCtl_flgPhaTstrActvIntk GEVCtl_stPhaDiagTstrIntk GEVCtl_tqResvPhaDiagTstr /end OUT_MEASUREMENT
 /begin LOC_MEASUREMENT GEVCtl_agSpPhaATSIntk GEVCtl_flgDiMaskPhaDiagIntk /end LOC_MEASUREMENT
 FUNCTION_VERSION "1.6.0_1.1.0" /end FUNCTION
/begin FUNCTION GEVCtl_PhaUnLckCtrl "2.0.1     Unlock Control phase shifting camshaft actuator"
 /begin DEF_CHARACTERISTIC GEVCtl_agPhaLockPosnRngIntk_C GEVCtl_agPhaMinDstToUnLckIntk_C GEVCtl_nrMaxPhaRelsAtmptIntk_C GEVCtl_stUnlckCtrlIntk_C GEVCtl_tiLveLockPosnRngIntk_M GEVCtl_tiTogErrSuspcIntk_C GEVCtl_tiTogOutLockPosnIntk_C GEVCtl_tiTogToLockPosnIntk_C GEVCtl_tiUnlckForAdpnIntk_C GEVCtl_tiWaitForNxtUnlckIntk_C /end DEF_CHARACTERISTIC
 /begin IN_MEASUREMENT Epm_nEngLRes GEVCtl_agLockPosnIntkB1 GEVCtl_agSpDrvDmdIntk GEVCtl_agSpIntkB1 GEVCtl_flgPhaActrTestEnaFctIntk GEVCtl_flgPhaEnaIntk GEVCtl_flgPhaToRefPosnIntk GEVCtl_tOilCylHd GEVlv_agIntkB1 GEVlv_flgPhaActrErrSuspcIntkB1 GEVlv_flgPhaAdpnVldIntk GEVlv_flgPhaErrSimIntk SyC_stSub /end IN_MEASUREMENT
 /begin OUT_MEASUREMENT GEVCtl_agSpPhaUnLckIntkB1 GEVCtl_flgPhaOutLockPosnIntkB1 GEVCtl_flgPhaToLockPosnIntkB1 GEVCtl_flgPhaUnLckActvIntkB1 /end OUT_MEASUREMENT
 /begin LOC_MEASUREMENT GEVCtl_flgEnaUnlckIntk GEVCtl_flgUnlckForAdpnIntk GEVCtl_stPhaUnLckIntkB1 /end LOC_MEASUREMENT
 FUNCTION_VERSION "2.0.1" /end FUNCTION
/begin FUNCTION GEVCtl_POilMdl "1.10.0    Oil Pressure Model"
 /begin DEF_CHARACTERISTIC GEVCtl_agPtdDePhaLockgPosnIntk_C GEVCtl_cntrMdnCalcnPha_C GEVCtl_pOilThdDeltaPhaEna_C GEVCtl_pOilThdPhaEna_C GEVCtl_stPOilMdl_C GEVCtl_tiDebJitObsPha_M GEVCtl_tiDebOilPEna_M GEVCtl_tiDebOilPEna_T GEVCtl_tiEnaOilPOk_M /end DEF_CHARACTERISTIC
 /begin IN_MEASUREMENT CEngDsT_t CoEng_stMai EngStrt_bFrstStrtEnd Epm_nEngLRes Epm_stSpd GEVCtl_agLockPosnIntkB1 GEVCtl_tOilCylHd GEVlv_agIntkB1 GEVlv_flgPhaAdpnVldIntk OilP_p SyC_stSub T15_st TiEngOff_stTi TiEngOff_ti /end IN_MEASUREMENT
 /begin OUT_MEASUREMENT GEVCtl_flgPhaEnaPOil /end OUT_MEASUREMENT
 /begin LOC_MEASUREMENT GEVCtl_flgPhaJitObsIntk GEVCtl_flgPhaJitObsIntkB1 GEVCtl_flgPhaJitObsOk GEVCtl_nEngLRes GEVCtl_tiTiEngOff JitDetrmIntkB1_I.agAcm JitDetrmIntkB1_I.agMed JitDetrmIntkB1_I.agOld JitDetrmIntkB1_I.cntrDevPha JitDetrmIntkB1_I.cntrMedCalcPhaMax JitDetrmIntkB1_I.flgPhaJitObs /end LOC_MEASUREMENT
 FUNCTION_VERSION "1.10.0" /end FUNCTION
/begin COMPU_METHOD B_TRUE "" TAB_VERB "%6.3" "" COMPU_TAB_REF B_TRUE /end COMPU_METHOD
/begin COMPU_VTAB B_TRUE "" TAB_VERB 2 0 "FALSE" 1 "TRUE" /end COMPU_VTAB
/begin COMPU_METHOD CrCtlSlipRat "" RAT_FUNC "%6.4" "%" COEFFS 0 200 0 0 0 1 /end COMPU_METHOD
/begin COMPU_METHOD dez "" RAT_FUNC "%6.2" "" COEFFS 0 1 0 0 0 1 /end COMPU_METHOD
/begin COMPU_METHOD DFES_nPID0C "" RAT_FUNC "%6.3" "rpm" COEFFS 0 4 0 0 0 1 /end COMPU_METHOD
/begin COMPU_METHOD dfp_verbal "" TAB_VERB "%6.3" "-" COMPU_TAB_REF dfp_verbal /end COMPU_METHOD
/begin COMPU_VTAB dfp_verbal "" TAB_VERB 83 0 "DFP_AAA" 1 "DFP_AAV" 2 "DFP_AAVE" 3 "DFP_AGRE" 4 "DFP_AGRS" 5 "DFP_DHFHD" 6 "DFP_DK" 7 "DFP_DK1P" 8 "DFP_DK2P" 9 "DFP_DKVS" 10 "DFP_DSKV" 11 "DFP_DSKVR" 12 "DFP_DSKVS" 13 "DFP_DSS" 14 "DFP_DSU" 15 "DFP_DVEE" 16 "DFP_DVEF" 17 "DFP_DVEFO" 18 "DFP_DVEL" 19 "DFP_DVEN" 20 "DFP_DVER" 21 "DFP_DVEU" 22 "DFP_DVEUB" 23 "DFP_DVEUW" 24 "DFP_DYLSU" 25 "DFP_ENWCS" 26 "DFP_ENWS" 27 "DFP_ENWSE" 28 "DFP_EONV" 29 "DFP_FP1P" 30 "DFP_FP2P" 31 "DFP_FRA" 32 "DFP_FST" 33 "DFP_FSTE" 34 "DFP_FSTR" 35 "DFP_FTDLA" 36 "DFP_HDR" 37 "DFP_HDRKH" 38 "DFP_HDRPL" 39 "DFP_HFM" 40 "DFP_HSH" 41 "DFP_HSHE" 42 "DFP_KAT" 43 "DFP_KPE" 44 "DFP_KS1" 45 "DFP_LLRH" 46 "DFP_LLRKH" 47 "DFP_LM" 48 "DFP_LSH" 49 "DFP_LZSR" 50 "DFP_MD" 51 "DFP_NWS" 52 "DFP_NWSE" 53 "DFP_ORA" 54 "DFP_PLLSU" 55 "DFP_PSR" 56 "DFP_PSR1" 57 "DFP_PSRB" 58 "DFP_PSRE" 59 "DFP_PSRP" 60 "DFP_PU" 61 "DFP_PUE" 62 "DFP_PUPL" 63 "DFP_PUR" 64 "DFP_STHDR" 65 "DFP_TA" 66 "DFP_TANKL" 67 "DFP_TANLCS" 68 "DFP_TANLPRC" 69 "DFP_TANLR" 70 "DFP_TASRCS" 71 "DFP_TASRE" 72 "DFP_TASRPRC" 73 "DFP_TASRR" 74 "DFP_TESF" 75 "DFP_TESG" 76 "DFP_TM" 77 "DFP_TMCS" 78 "DFP_TME" 79 "DFP_TMP" 80 "DFP_UB" 81 "DFP_VFZ" 82 "DFP_ZZZ" DEFAULT_VALUE "---" /end COMPU_VTAB
/begin COMPU_METHOD dichte_ub_b2 "" RAT_FUNC "%6.4" "kg/m^3" COEFFS 0 256 0 0 0 2 /end COMPU_METHOD
/begin COMPU_METHOD EngN "" RAT_FUNC "%6.3" "rpm" COEFFS 0 2 0 0 0 1 /end COMPU_METHOD
/begin COMPU_METHOD EngN_LRes "" RAT_FUNC "%6.1" "rpm" COEFFS 0 0.025 0 0 0 1 /end COMPU_METHOD
/begin COMPU_METHOD Fact "" RAT_FUNC "%6.5" "-" COEFFS 0 8192 0 0 0 1 /end COMPU_METHOD
/begin COMPU_METHOD fak_q0p0078 "" RAT_FUNC "%6.4" "-" COEFFS 0 128 0 0 0 1 /end COMPU_METHOD
/begin COMPU_METHOD fak_ub_b1 "" RAT_FUNC "%6.4" "-" COEFFS 0 256 0 0 0 1 /end COMPU_METHOD
/begin COMPU_METHOD fak_uw_b1 "" RAT_FUNC "%7.6" "-" COEFFS 0 65536 0 0 0 1 /end COMPU_METHOD
/begin COMPU_METHOD fak_uw_b2 "" RAT_FUNC "%7.6" "-" COEFFS 0 65536 0 0 0 2 /end COMPU_METHOD
/begin COMPU_METHOD kw_q0p0019 "" RAT_FUNC "%6.4" "Grad KW" COEFFS 0 512 0 0 0 1 /end COMPU_METHOD
/begin COMPU_METHOD kw_q0p0078 "" RAT_FUNC "%6.4" "Grad KW" COEFFS 0 128 0 0 0 1 /end COMPU_METHOD
/begin COMPU_METHOD kw_q0p0156 "" RAT_FUNC "%6.4" "Grad KW" COEFFS 0 64 0 0 0 1 /end COMPU_METHOD
/begin COMPU_METHOD kw_q0p5 "" RAT_FUNC "%6.3" "Grad KW" COEFFS 0 2 0 0 0 1 /end COMPU_METHOD
/begin COMPU_METHOD Length "" RAT_FUNC "%6.2" "m" COEFFS 0 1 0 0 0 1 /end COMPU_METHOD
/begin COMPU_METHOD LengthKm_q0p1 "" RAT_FUNC "%6.3" "km" COEFFS 0 10 0 0 0 1 /end COMPU_METHOD
/begin COMPU_METHOD md_q0p1 "" RAT_FUNC "%6.3" "Nm" COEFFS 0 10 0 0 0 1 /end COMPU_METHOD
/begin COMPU_METHOD NOxLdPerFl "" RAT_FUNC "%6.5" "1/l" COEFFS 0 8192 0 0 0 1 /end COMPU_METHOD
/begin COMPU_METHOD NOxMassFlw "" RAT_FUNC "%6.5" "mg/s" COEFFS 0 1000 0 0 0 1 /end COMPU_METHOD
/begin COMPU_METHOD NOxMassPerTime "" RAT_FUNC "%6.3" "mg/s" COEFFS 0 10 0 0 0 1 /end COMPU_METHOD
/begin COMPU_METHOD NRADCKNKSIG_SC_Compu "" TAB_VERB "%6.3" "" COMPU_TAB_REF NRADCKNKSIG_SC_Compu /end COMPU_METHOD
/begin COMPU_VTAB NRADCKNKSIG_SC_Compu "" TAB_VERB 4 1 "1ADC" 2 "2ADC" 3 "3ADC" 4 "4ADC" /end COMPU_VTAB
/begin COMPU_METHOD NRGEARTRSM_SC_Compu "" TAB_VERB "%6.3" "" COMPU_TAB_REF NRGEARTRSM_SC_Compu /end COMPU_METHOD
/begin COMPU_VTAB NRGEARTRSM_SC_Compu "" TAB_VERB 2 0 "PT_rTrq" 1 "Tra_numGear" /end COMPU_VTAB
/begin COMPU_METHOD NRKNKSNSRMAX_SC_Compu "" TAB_VERB "%6.3" "" COMPU_TAB_REF NRKNKSNSRMAX_SC_Compu /end COMPU_METHOD
/begin COMPU_VTAB NRKNKSNSRMAX_SC_Compu "" TAB_VERB 5 0 "0" 1 "1" 2 "2" 3 "3" 4 "4" /end COMPU_VTAB
/begin COMPU_METHOD NRRAILPPNTCVO_SC_Compu "" RAT_FUNC "%6.2" "" COEFFS 0 1 0 0 0 1 /end COMPU_METHOD
/begin COMPU_METHOD NRTELLTLLAMP_SC_Compu "" TAB_VERB "%6.3" "" COMPU_TAB_REF NRTELLTLLAMP_SC_Compu /end COMPU_METHOD
/begin COMPU_VTAB NRTELLTLLAMP_SC_Compu "" TAB_VERB 3 0 "None" 1 "Single" 2 "Two" /end COMPU_VTAB
/begin COMPU_METHOD NRVCOSPNTCVO_SC_Compu "" RAT_FUNC "%6.2" "" COEFFS 0 1 0 0 0 1 /end COMPU_METHOD
/begin COMPU_METHOD NSC1B1_SC_Compu "" TAB_VERB "%6.3" "" COMPU_TAB_REF NSC1B1_SC_Compu /end COMPU_METHOD
/begin COMPU_VTAB NSC1B1_SC_Compu "" TAB_VERB 2 0 "False" 1 "True" /end COMPU_VTAB
/begin COMPU_METHOD NSC1B2_SC_Compu "" TAB_VERB "%6.3" "" COMPU_TAB_REF NSC1B2_SC_Compu /end COMPU_METHOD
/begin COMPU_VTAB NSC1B2_SC_Compu "" TAB_VERB 2 0 "False" 1 "True" /end COMPU_VTAB
/begin COMPU_METHOD NSC2B1_SC_Compu "" TAB_VERB "%6.3" "" COMPU_TAB_REF NSC2B1_SC_Compu /end COMPU_METHOD
/begin COMPU_VTAB NSC2B1_SC_Compu "" TAB_VERB 2 0 "False" 1 "True" /end COMPU_VTAB
/begin COMPU_METHOD NSC2B2_SC_Compu "" TAB_VERB "%6.3" "" COMPU_TAB_REF NSC2B2_SC_Compu /end COMPU_METHOD
/begin COMPU_VTAB NSC2B2_SC_Compu "" TAB_VERB 2 0 "False" 1 "True" /end COMPU_VTAB
/begin COMPU_METHOD NSCRgn_Time_S "" RAT_FUNC "%6.4" "s" COEFFS 0 100 0 0 0 1 /end COMPU_METHOD
/begin COMPU_METHOD NSC_ACTV_SY_Compu "" TAB_VERB "%6.3" "" COMPU_TAB_REF NSC_ACTV_SY_Compu /end COMPU_METHOD
/begin COMPU_VTAB NSC_ACTV_SY_Compu "" TAB_VERB 2 0 "False" 1 "True" /end COMPU_VTAB
/begin COMPU_METHOD NSC_CT_SENSORS_SY_Compu "" TAB_VERB "%6.3" "" COMPU_TAB_REF NSC_CT_SENSORS_SY_Compu /end COMPU_METHOD
/begin COMPU_VTAB NSC_CT_SENSORS_SY_Compu "" TAB_VERB 5 0 "ZERO" 1 "ONE" 2 "TWO" 3 "THREE" 4 "FOUR" /end COMPU_VTAB
/begin COMPU_METHOD NSEKP_SC_Compu "" RAT_FUNC "%6.2" "" COEFFS 0 1 0 0 0 1 /end COMPU_METHOD
/begin COMPU_METHOD NSODA_SC_Compu "" TAB_VERB "%6.3" "" COMPU_TAB_REF NSODA_SC_Compu /end COMPU_METHOD
/begin COMPU_VTAB NSODA_SC_Compu "" TAB_VERB 3 0 "NONE" 1 "STANDARD" 2 "EXTENDED" /end COMPU_VTAB
/begin COMPU_METHOD NSTEV_SC_Compu "" TAB_VERB "%6.3" "" COMPU_TAB_REF NSTEV_SC_Compu /end COMPU_METHOD
/begin COMPU_VTAB NSTEV_SC_Compu "" TAB_VERB 3 0 "0" 1 "1" 2 "2" /end COMPU_VTAB
/begin COMPU_METHOD NUMCYLACT_SY_Compu "" TAB_VERB "%6.3" "" COMPU_TAB_REF NUMCYLACT_SY_Compu /end COMPU_METHOD
/begin COMPU_VTAB NUMCYLACT_SY_Compu "" TAB_VERB 12 1 "ONE_CLYL" 2 "TWO_CYL" 3 "THREE_CYL" 4 "FOUR_CYL" 5 "FIVE_CYL" 6 "SIX_CYL" 7 "SEVEN_CYL" 8 "EIGHT_CYL" 10 "TEN_CYL" 12 "TWELVE_CYL" 16 "SIXTEEN_CYL" 24 "Twentyfour_CYL" /end COMPU_VTAB
/begin COMPU_METHOD NUMCYLCAL_SY_Compu "" TAB_VERB "%6.3" "" COMPU_TAB_REF NUMCYLCAL_SY_Compu /end COMPU_METHOD
/begin COMPU_VTAB NUMCYLCAL_SY_Compu "" TAB_VERB 2 0 "FIX" 1 "CAL" /end COMPU_VTAB
/begin COMPU_METHOD NUMCYLMAX_SY_Compu "" TAB_VERB "%6.3" "" COMPU_TAB_REF NUMCYLMAX_SY_Compu /end COMPU_METHOD
/begin COMPU_VTAB NUMCYLMAX_SY_Compu "" TAB_VERB 12 1 "ONE_CLYL" 2 "TWO_CYL" 3 "THREE_CYL" 4 "FOUR_CYL" 5 "FIVE_CYL" 6 "SIX_CYL" 7 "SEVEN_CYL" 8 "EIGHT_CYL" 10 "TEN_CYL" 12 "TWELVE_CYL" 16 "SIXTEEN_CYL" 24 "Twentyfour_CYL" /end COMPU_VTAB
/begin COMPU_METHOD NUMFANS_SY_Compu "" TAB_VERB "%6.3" "" COMPU_TAB_REF NUMFANS_SY_Compu /end COMPU_METHOD
/begin COMPU_VTAB NUMFANS_SY_Compu "" TAB_VERB 6 0 "0" 1 "1" 2 "2" 3 "3" 4 "4" 12 "12" /end COMPU_VTAB
/begin COMPU_METHOD NUMNTEAR_SY_Compu "" RAT_FUNC "%6.2" "" COEFFS 0 1 0 0 0 1 /end COMPU_METHOD
/begin COMPU_METHOD NUMPSICCHP_SY_Compu "" TAB_VERB "%6.3" "" COMPU_TAB_REF NUMPSICCHP_SY_Compu /end COMPU_METHOD
/begin COMPU_VTAB NUMPSICCHP_SY_Compu "" TAB_VERB 5 1 "1" 2 "2" 3 "3" 4 "4" 5 "5" /end COMPU_VTAB
/begin COMPU_METHOD NUMVEHVSENS_SY_Compu "" RAT_FUNC "%6.2" "" COEFFS 0 1 0 0 0 1 /end COMPU_METHOD
/begin COMPU_METHOD NUM_WAHT_SY_Compu "" RAT_FUNC "%6.2" "" COEFFS 0 1 0 0 0 1 /end COMPU_METHOD
/begin COMPU_METHOD NVLDTELL_SC_Compu "" TAB_VERB "%6.3" "" COMPU_TAB_REF NVLDTELL_SC_Compu /end COMPU_METHOD
/begin COMPU_VTAB NVLDTELL_SC_Compu "" TAB_VERB 2 0 "False" 1 "True" /end COMPU_VTAB
/begin COMPU_METHOD O2MassPerTimeLo "" RAT_FUNC "%6.4" "Kg/h" COEFFS 0 50 0 0 0 1 /end COMPU_METHOD
/begin COMPU_METHOD OBDCARBCSERS26_SC_Compu "" TAB_VERB "%6.3" "" COMPU_TAB_REF OBDCARBCSERS26_SC_Compu /end COMPU_METHOD
/begin COMPU_VTAB OBDCARBCSERS26_SC_Compu "" TAB_VERB 3 0 "CARB_BFR_MY26" 1 "CARB_BTW_MY26" 2 "CARB_MY26" /end COMPU_VTAB
/begin COMPU_METHOD OBDUDSACTVN_SC_Compu "" TAB_VERB "%6.3" "" COMPU_TAB_REF OBDUDSACTVN_SC_Compu /end COMPU_METHOD
/begin COMPU_VTAB OBDUDSACTVN_SC_Compu "" TAB_VERB 2 0 "False" 1 "True" /end COMPU_VTAB
/begin COMPU_METHOD OBD_PHYSMEDM_SY_Compu "" TAB_VERB "%6.3" "" COMPU_TAB_REF OBD_PHYSMEDM_SY_Compu /end COMPU_METHOD
/begin COMPU_VTAB OBD_PHYSMEDM_SY_Compu "" TAB_VERB 2 0 "OBD_PHYSMEDM_CAN" 1 "OBD_PHYSMEDM_KLINE" /end COMPU_VTAB
/begin COMPU_METHOD OBS_SY_Compu "" TAB_VERB "%6.3" "" COMPU_TAB_REF OBS_SY_Compu /end COMPU_METHOD
/begin COMPU_VTAB OBS_SY_Compu "" TAB_VERB 2 0 "NOOBS" 1 "SMP480" /end COMPU_VTAB
/begin COMPU_METHOD OFFSCRKPIST_SC_Compu "" TAB_VERB "%6.3" "" COMPU_TAB_REF OFFSCRKPIST_SC_Compu /end COMPU_METHOD
/begin COMPU_VTAB OFFSCRKPIST_SC_Compu "" TAB_VERB 2 0 "False" 1 "True" /end COMPU_VTAB
/begin COMPU_METHOD OILCMBDSEN_SWTCONN_SC_Compu "" TAB_VERB "%6.3" "" COMPU_TAB_REF OILCMBDSEN_SWTCONN_SC_Compu /end COMPU_METHOD
/begin COMPU_VTAB OILCMBDSEN_SWTCONN_SC_Compu "" TAB_VERB 5 0 "0" 1 "1" 2 "2" 3 "3" 255 "255" /end COMPU_VTAB
/begin COMPU_METHOD OILCOOLRDST_TYPAVL_SC_Compu "" TAB_VERB "%6.3" "" COMPU_TAB_REF OILCOOLRDST_TYPAVL_SC_Compu /end COMPU_METHOD
/begin COMPU_VTAB OILCOOLRDST_TYPAVL_SC_Compu "" TAB_VERB 2 0 "False" 1 "True" /end COMPU_VTAB
/begin COMPU_METHOD OILCYLHDT_SENSCFG_SC_Compu "" TAB_VERB "%6.3" "" COMPU_TAB_REF OILCYLHDT_SENSCFG_SC_Compu /end COMPU_METHOD
/begin COMPU_VTAB OILCYLHDT_SENSCFG_SC_Compu "" TAB_VERB 5 0 "No_Sens" 1 "ECU_ADC" 2 "CAN" 3 "SENT" 255 "Switch" /end COMPU_VTAB
/begin COMPU_METHOD OILFILT_COLDSTRTDIAG_SC_Compu "" TAB_VERB "%6.3" "" COMPU_TAB_REF OILFILT_COLDSTRTDIAG_SC_Compu /end COMPU_METHOD
/begin COMPU_VTAB OILFILT_COLDSTRTDIAG_SC_Compu "" TAB_VERB 2 0 "False" 1 "True" /end COMPU_VTAB
/begin COMPU_METHOD OILFILT_SNSRTYP_SC_Compu "" TAB_VERB "%6.3" "" COMPU_TAB_REF OILFILT_SNSRTYP_SC_Compu /end COMPU_METHOD
/begin COMPU_VTAB OILFILT_SNSRTYP_SC_Compu "" TAB_VERB 4 0 "no OilFilT_Sensor" 1 "OilFilT_ADC" 2 "OilFilT_CmbdSenECU" 255 "Via_application_parameter" /end COMPU_VTAB
/begin COMPU_METHOD OILGLRYT_COLDSTRTDIAG_SC_Compu "" TAB_VERB "%6.3" "" COMPU_TAB_REF OILGLRYT_COLDSTRTDIAG_SC_Compu /end COMPU_METHOD
/begin COMPU_VTAB OILGLRYT_COLDSTRTDIAG_SC_Compu "" TAB_VERB 2 0 "False" 1 "True" /end COMPU_VTAB
/begin COMPU_METHOD OILGLRYT_SNSRCFG_SC_Compu "" TAB_VERB "%6.3" "" COMPU_TAB_REF OILGLRYT_SNSRCFG_SC_Compu /end COMPU_METHOD
/begin COMPU_VTAB OILGLRYT_SNSRCFG_SC_Compu "" TAB_VERB 5 0 "No_Sensor" 1 "Analog" 2 "CAN" 3 "SENT_Slow_Channel" 4 "SENT_Fast_Channel" /end COMPU_VTAB
/begin COMPU_METHOD OilMassPerTime "" RAT_FUNC "%7.6" "mg/s" COEFFS 0 10000 0 0 0 1 /end COMPU_METHOD
/begin COMPU_METHOD OilMassPerTimeLo "" RAT_FUNC "%6.4" "mg/s" COEFFS 0 500 0 0 0 1 /end COMPU_METHOD
/begin COMPU_METHOD OilMFl_mgps_q0p1 "" RAT_FUNC "%6.3" "mg/s" COEFFS 0 10 0 0 0 1 /end COMPU_METHOD
/begin COMPU_METHOD OILMOK_SY_Compu "" TAB_VERB "%6.3" "" COMPU_TAB_REF OILMOK_SY_Compu /end COMPU_METHOD
/begin COMPU_VTAB OILMOK_SY_Compu "" TAB_VERB 2 0 "False" 1 "True" /end COMPU_VTAB
/begin COMPU_METHOD OilMsPrc_q0p01 "" RAT_FUNC "%6.4" "%" COEFFS 0 100 0 0 0 1 /end COMPU_METHOD
/begin COMPU_METHOD OilMs_mg "" RAT_FUNC "%6.2" "mg" COEFFS 0 1 0 0 0 1 /end COMPU_METHOD
/begin COMPU_METHOD OilMs_q0p1 "" RAT_FUNC "%6.3" "g" COEFFS 0 10 0 0 0 1 /end COMPU_METHOD
/begin COMPU_METHOD OilMs_q10 "" RAT_FUNC "%6.1" "g" COEFFS 0 0.1 0 0 0 1 /end COMPU_METHOD
/begin COMPU_METHOD OILPCTL_SY_Compu "" TAB_VERB "%6.3" "" COMPU_TAB_REF OILPCTL_SY_Compu /end COMPU_METHOD
/begin COMPU_VTAB OILPCTL_SY_Compu "" TAB_VERB 2 0 "False" 1 "True" /end COMPU_VTAB
/begin COMPU_METHOD OneToOne "" RAT_FUNC "%6.2" "-" COEFFS 0 1 0 0 0 1 /end COMPU_METHOD
/begin COMPU_METHOD Prc "" RAT_FUNC "%6.4" "%" COEFFS 0 81.92 0 0 0 1 /end COMPU_METHOD
/begin COMPU_METHOD Pres_hPa "" RAT_FUNC "%6.2" "hPa" COEFFS 0 1 0 0 0 1 /end COMPU_METHOD
/begin COMPU_METHOD p_uw_q0p039 "" RAT_FUNC "%6.4" "hPa" COEFFS 0 256 0 0 0 10 /end COMPU_METHOD
/begin COMPU_METHOD q0p0625_degCrS_DIV_s "" RAT_FUNC "%6.4" "degCrS/s" COEFFS 0 10000 0 0 0 625 /end COMPU_METHOD
/begin COMPU_METHOD rel_q0p0234 "" RAT_FUNC "%6.4" "%" COEFFS 0 128 0 0 0 3 /end COMPU_METHOD
/begin COMPU_METHOD rel_uw_b100 "" RAT_FUNC "%6.4" "%" COEFFS 0 65536 0 0 0 100 /end COMPU_METHOD
/begin COMPU_METHOD rel_uw_q0p0234 "" RAT_FUNC "%6.4" "%" COEFFS 0 32 0 0 0 0.75 /end COMPU_METHOD
/begin COMPU_METHOD TempDiff_Cels "" RAT_FUNC "%6.3" "deg C" COEFFS 0 10 0 0 0 1 /end COMPU_METHOD
/begin COMPU_METHOD Temp_Cels "" RAT_FUNC "%6.1" "deg C" COEFFS 0 10 2731.4 0 0 1 /end COMPU_METHOD
/begin COMPU_METHOD TimeDeb "" RAT_FUNC "%6.1" "ms" COEFFS 0 0.1 0 0 0 1 /end COMPU_METHOD
/begin COMPU_METHOD Time_ms "" RAT_FUNC "%6.1" "ms" COEFFS 0 0.1 0 0 0 1 /end COMPU_METHOD
/begin COMPU_METHOD Time_s "" RAT_FUNC "%6.4" "s" COEFFS 0 100 0 0 0 1 /end COMPU_METHOD
/begin COMPU_METHOD Time_sec_q1_COMPU "" RAT_FUNC "%6.2" "s" COEFFS 0 1 0 0 0 1 /end COMPU_METHOD
/begin COMPU_METHOD TransR "" RAT_FUNC "%6.4" "-" COEFFS 0 100 0 0 0 1 /end COMPU_METHOD
/begin COMPU_METHOD TransR_COMPU "" RAT_FUNC "%6.4" "" COEFFS 0 64 0 0 0 1 /end COMPU_METHOD
/begin COMPU_METHOD Trq "" RAT_FUNC "%6.3" "Nm" COEFFS 0 10 0 0 0 1 /end COMPU_METHOD
/begin COMPU_METHOD t_q0p01 "" RAT_FUNC "%6.4" "s" COEFFS 0 100 0 0 0 1 /end COMPU_METHOD
/begin COMPU_METHOD t_q0p05 "" RAT_FUNC "%6.4" "s" COEFFS 0 100 0 0 0 5 /end COMPU_METHOD
/begin COMPU_METHOD t_q0p5 "" RAT_FUNC "%6.3" "s" COEFFS 0 1 0 0 0 0.5 /end COMPU_METHOD
/begin COMPU_METHOD t_q1 "" RAT_FUNC "%6.2" "s" COEFFS 0 1 0 0 0 1 /end COMPU_METHOD
/begin COMPU_METHOD Vel "" RAT_FUNC "%6.4" "km/h" COEFFS 0 100 0 0 0 1 /end COMPU_METHOD
/begin COMPU_METHOD Volt "" RAT_FUNC "%6.3" "mV" COEFFS 0 5 0 0 0 1 /end COMPU_METHOD
/begin COMPU_METHOD Volt_Batt "" RAT_FUNC "%6.1" "mV" COEFFS 0 0.05 0 0 0 1 /end COMPU_METHOD
/begin COMPU_METHOD zk10msxs_uw_b655p36 "" RAT_FUNC "%6.2" "s" COEFFS 0 0 65536 0 100 0 /end COMPU_METHOD
/begin COMPU_METHOD zk50msxs_uw_b3276p8 "" RAT_FUNC "%6.1" "s" COEFFS 0 0 65536 0 20 0 /end COMPU_METHOD
/begin RECORD_LAYOUT Kw_Ws16 FNC_VALUES 1 SWORD COLUMN_DIR DIRECT /end RECORD_LAYOUT
/begin RECORD_LAYOUT RB_Axis_S16 NO_AXIS_PTS_X 1 SWORD AXIS_PTS_X 2 SWORD INDEX_INCR DIRECT /end RECORD_LAYOUT
/begin RECORD_LAYOUT RB_Axis_U16 NO_AXIS_PTS_X 1 UWORD AXIS_PTS_X 2 UWORD INDEX_INCR DIRECT /end RECORD_LAYOUT
/begin RECORD_LAYOUT RB_Curve_S16_S16 NO_AXIS_PTS_X 1 SWORD AXIS_PTS_X 2 SWORD INDEX_INCR DIRECT FNC_VALUES 3 SWORD COLUMN_DIR DIRECT /end RECORD_LAYOUT
/begin RECORD_LAYOUT RB_Curve_S16_U16_Static NO_AXIS_PTS_X 1 SWORD AXIS_PTS_X 2 SWORD INDEX_INCR DIRECT FNC_VALUES 3 UWORD COLUMN_DIR DIRECT STATIC_RECORD_LAYOUT /end RECORD_LAYOUT
/begin RECORD_LAYOUT RB_Curve_U16_U16 NO_AXIS_PTS_X 1 UWORD AXIS_PTS_X 2 UWORD INDEX_INCR DIRECT FNC_VALUES 3 UWORD COLUMN_DIR DIRECT /end RECORD_LAYOUT
/begin RECORD_LAYOUT RB_Curve_U16_U8_Static NO_AXIS_PTS_X 1 UWORD AXIS_PTS_X 2 UWORD INDEX_INCR DIRECT FNC_VALUES 3 UBYTE COLUMN_DIR DIRECT STATIC_RECORD_LAYOUT /end RECORD_LAYOUT
/begin RECORD_LAYOUT RB_Curve_U8_U16_Static NO_AXIS_PTS_X 1 UBYTE AXIS_PTS_X 2 UBYTE INDEX_INCR DIRECT FNC_VALUES 3 UWORD COLUMN_DIR DIRECT STATIC_RECORD_LAYOUT /end RECORD_LAYOUT
/begin RECORD_LAYOUT RB_Curve_U8_U8 NO_AXIS_PTS_X 1 UBYTE AXIS_PTS_X 2 UBYTE INDEX_INCR DIRECT FNC_VALUES 3 UBYTE COLUMN_DIR DIRECT /end RECORD_LAYOUT
/begin RECORD_LAYOUT RB_MapGroup_S16 FNC_VALUES 1 SWORD COLUMN_DIR DIRECT /end RECORD_LAYOUT
/begin RECORD_LAYOUT RB_Map_S16S16_S16 NO_AXIS_PTS_X 1 SWORD NO_AXIS_PTS_Y 2 SWORD AXIS_PTS_X 3 SWORD INDEX_INCR DIRECT AXIS_PTS_Y 4 SWORD INDEX_INCR DIRECT FNC_VALUES 5 SWORD COLUMN_DIR DIRECT /end RECORD_LAYOUT
/begin RECORD_LAYOUT RB_Map_S16S16_U16 NO_AXIS_PTS_X 1 SWORD NO_AXIS_PTS_Y 2 SWORD AXIS_PTS_X 3 SWORD INDEX_INCR DIRECT AXIS_PTS_Y 4 SWORD INDEX_INCR DIRECT FNC_VALUES 5 UWORD COLUMN_DIR DIRECT /end RECORD_LAYOUT
/begin RECORD_LAYOUT RB_Map_S16S16_U8 NO_AXIS_PTS_X 1 SWORD NO_AXIS_PTS_Y 2 SWORD AXIS_PTS_X 3 SWORD INDEX_INCR DIRECT AXIS_PTS_Y 4 SWORD INDEX_INCR DIRECT FNC_VALUES 5 UBYTE COLUMN_DIR DIRECT /end RECORD_LAYOUT
/begin RECORD_LAYOUT RB_Map_S16U16_U16 NO_AXIS_PTS_X 1 SWORD NO_AXIS_PTS_Y 2 SWORD AXIS_PTS_X 3 SWORD INDEX_INCR DIRECT AXIS_PTS_Y 4 UWORD INDEX_INCR DIRECT FNC_VALUES 5 UWORD ROW_DIR DIRECT /end RECORD_LAYOUT
/begin RECORD_LAYOUT RB_Map_S16U16_U8 NO_AXIS_PTS_X 1 SWORD NO_AXIS_PTS_Y 2 SWORD AXIS_PTS_X 3 SWORD INDEX_INCR DIRECT AXIS_PTS_Y 4 UWORD INDEX_INCR DIRECT FNC_VALUES 5 UBYTE ROW_DIR DIRECT /end RECORD_LAYOUT
/begin RECORD_LAYOUT RB_Map_U16S16_S16 NO_AXIS_PTS_X 1 UWORD NO_AXIS_PTS_Y 2 UWORD AXIS_PTS_X 3 UWORD INDEX_INCR DIRECT AXIS_PTS_Y 4 SWORD INDEX_INCR DIRECT FNC_VALUES 5 SWORD COLUMN_DIR DIRECT /end RECORD_LAYOUT
/begin RECORD_LAYOUT RB_Map_U16S16_U16 NO_AXIS_PTS_X 1 UWORD NO_AXIS_PTS_Y 2 UWORD AXIS_PTS_X 3 UWORD INDEX_INCR DIRECT AXIS_PTS_Y 4 SWORD INDEX_INCR DIRECT FNC_VALUES 5 UWORD COLUMN_DIR DIRECT /end RECORD_LAYOUT
/begin RECORD_LAYOUT RB_Map_U16U16_U16 NO_AXIS_PTS_X 1 UWORD NO_AXIS_PTS_Y 2 UWORD AXIS_PTS_X 3 UWORD INDEX_INCR DIRECT AXIS_PTS_Y 4 UWORD INDEX_INCR DIRECT FNC_VALUES 5 UWORD COLUMN_DIR DIRECT /end RECORD_LAYOUT
/begin RECORD_LAYOUT RB_Map_U8S16_U8 NO_AXIS_PTS_X 1 UBYTE NO_AXIS_PTS_Y 2 UBYTE AXIS_PTS_X 3 UBYTE INDEX_INCR DIRECT AXIS_PTS_Y 4 SWORD INDEX_INCR DIRECT FNC_VALUES 5 UBYTE ROW_DIR DIRECT /end RECORD_LAYOUT
/begin RECORD_LAYOUT RB_ValA_Wu16 FNC_VALUES 1 UWORD COLUMN_DIR DIRECT /end RECORD_LAYOUT
/begin RECORD_LAYOUT RB_Val_Wboolean FNC_VALUES 1 UBYTE COLUMN_DIR DIRECT /end RECORD_LAYOUT
/begin RECORD_LAYOUT RB_Val_Ws16 FNC_VALUES 1 SWORD COLUMN_DIR DIRECT /end RECORD_LAYOUT
/begin RECORD_LAYOUT RB_Val_Ws32 FNC_VALUES 1 SLONG COLUMN_DIR DIRECT /end RECORD_LAYOUT
/begin RECORD_LAYOUT RB_Val_Wu16 FNC_VALUES 1 UWORD COLUMN_DIR DIRECT /end RECORD_LAYOUT
/begin RECORD_LAYOUT RB_Val_Wu32 FNC_VALUES 1 ULONG COLUMN_DIR DIRECT /end RECORD_LAYOUT
/begin RECORD_LAYOUT RB_Val_Wu8 FNC_VALUES 1 UBYTE COLUMN_DIR DIRECT /end RECORD_LAYOUT
/end MODULE
/end PROJECT
