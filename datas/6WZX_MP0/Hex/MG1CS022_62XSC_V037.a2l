ASAP2_VERSION 1 60
/begin PROJECT MG1CS022 "MG1CS022"
/begin HEADER "" VERSION "MG1CS022_62XSC_V037" PROJECT_NO MG1CS022 /end HEADER
/begin MODULE DIM ""
/begin MOD_COMMON "" BYTE_ORDER MSB_LAST ALIGNMENT_BYTE 1 ALIGNMENT_WORD 2 ALIGNMENT_LONG 4 ALIGNMENT_INT64 4 ALIGNMENT_FLOAT32_IEEE 4 ALIGNMENT_FLOAT64_IEEE 4 DATA_SIZE 32 /end MOD_COMMON
/begin CHARACTERISTIC ADCVERL "Number of driving cycles for pre-ignition" VALUE 0x805700B8 RB_Val_Wu8 255.0 dez 0.00 255.0 FORMAT "%5.1" /end CHARACTERISTIC
/begin CHARACTERISTIC ADCVERL2 "Number of driving cycles for pre-ignition as substitution of cut off" VALUE 0x805700B9 RB_Val_Wu8 255.0 dez 0.00 255.0 FORMAT "%5.1" /end CHARACTERISTIC
/begin CHARACTERISTIC ANWPEDMX "Maximal number of acceleraror pedal position = 0, detection for irreversible fuel cut off due to pre-ignition" VALUE 0x805700BA RB_Val_Wu8 255.0 dez 0.00 255.0 FORMAT "%5.1" /end CHARACTERISTIC
/begin CHARACTERISTIC ATISLATX "threshold number of injection to switch from lambda afterstart to lambda warm-up" CURVE 0x80570C0E RB_Curve_U8_U16_Static 65535.00 dez 0.00 65535.00 FORMAT "%8.2"
 /begin AXIS_DESCR STD_AXIS tmstlanswl temp_ub_q0p75_o48 12 -48.0 143.3 FORMAT "%5.1" DEPOSIT ABSOLUTE /end AXIS_DESCR
/end CHARACTERISTIC
/begin CHARACTERISTIC ATIWKSTX "threshold number of injection to switch from lambda afterstart to lambda warm-up at cold restart" CURVE 0x80570C34 RB_Curve_U8_U16_Static 65535.00 dez 0.00 65535.00 FORMAT "%8.2"
 /begin AXIS_DESCR STD_AXIS tmstlanswl temp_ub_q0p75_o48 12 -48.0 143.3 FORMAT "%5.1" DEPOSIT ABSOLUTE /end AXIS_DESCR
/end CHARACTERISTIC
/begin CHARACTERISTIC AVEESCYL "Threshold for request of measurement due to injection time cylinder individual" VALUE 0x805700BB RB_Val_Wu8 255.0 dez 0.00 255.0 FORMAT "%5.1" /end CHARACTERISTIC
/begin CHARACTERISTIC AVERLMXL "Threshold for permanent air charge reduction at pre-ignition" VALUE 0x805700BC RB_Val_Wu8 255.0 dez 0.00 255.0 FORMAT "%5.1" /end CHARACTERISTIC
/begin CHARACTERISTIC CDDST "code word CARB: EURO byte for deactivation of tank press. sensor diagn." VALUE 0x8056F156 RB_Val_Wu8 255.0 dez 0.00 255.0 FORMAT "%5.1" /end CHARACTERISTIC
/begin CHARACTERISTIC CDDTESK "codeword to enable tank leak diagnosis (Euro coding)" VALUE 0x8056F157 RB_Val_Wu8 255.0 dez 0.00 255.0 FORMAT "%5.1" /end CHARACTERISTIC
/begin CHARACTERISTIC CDEFST "code word DFSTT inactive (EURO-coding), CD..=0 -> no diagnosis" VALUE 0x8056F158 RB_Val_Wu8 255.0 dez 0.00 255.0 FORMAT "%5.1" /end CHARACTERISTIC
/begin CHARACTERISTIC CDEONV "Codeword for preventing the activation of EONV diagnosis" VALUE 0x8056F159 RB_Val_Wu8 255.0 dez 0.00 255.0 FORMAT "%5.1" /end CHARACTERISTIC
/begin CHARACTERISTIC CDFSTR "Codeword for fuel level sensor rationality check activation" VALUE 0x8056F15A RB_Val_Wu8 255.0 dez 0.00 255.0 FORMAT "%5.1" /end CHARACTERISTIC
/begin CHARACTERISTIC CDTANKL "code word DTANKL inactive (EURO-coding), CD..=0 -> no diagnosis" VALUE 0x8056F15B RB_Val_Wu8 255.0 dez 0.00 255.0 FORMAT "%5.1" /end CHARACTERISTIC
/begin CHARACTERISTIC CDTESPL "code word disable canister-purge monitoring second purge line (Euro coding), CD..=0 -> no dia." VALUE 0x8056F15C RB_Val_Wu8 255.0 dez 0.00 255.0 FORMAT "%5.1" /end CHARACTERISTIC
/begin CHARACTERISTIC CNTNRWCY "Number of working cycles to decrement the pre-ignition counter ctrveescyl (path: fuel enrichment)" VALUE 0x805700BD RB_Val_Wu8 255.0 dez 0.00 255.0 FORMAT "%5.1" /end CHARACTERISTIC
/begin CHARACTERISTIC Com_tiLINShtDwnDlyReq_C "calibration for LIN node0 and node 1 shut down delay" VALUE 0x80579500 RB_Val_Ws16 655350.0 Time_ms -327680.0 327670.0 FORMAT "%8.1" /end CHARACTERISTIC
/begin CHARACTERISTIC CVESEREV "number of pre-ignitions for event storage" VALUE 0x8056F460 RB_Val_Wu8 255.0 dez 0.00 255.0 FORMAT "%5.1" /end CHARACTERISTIC
/begin CHARACTERISTIC CWANZTIB "code word for injection counter" VALUE 0x80570C5A RB_Val_Wu16 65535.00 dez 0.00 65535.00 FORMAT "%8.2" /end CHARACTERISTIC
/begin CHARACTERISTIC CWEVMZVE "codeword to enable the cylinder individual measure of injection time" VALUE 0x805700BE RB_Val_Wu8 255.0 dez 0.00 255.0 FORMAT "%5.1" /end CHARACTERISTIC
/begin CHARACTERISTIC CWKR2INT "codeword pre-ignition detection: calculation of knock detection charateristic" VALUE 0x8056F461 RB_Val_Wu8 255.0 dez 0.00 255.0 FORMAT "%5.1" /end CHARACTERISTIC
/begin CHARACTERISTIC CWKRDWS "Code word to lock bad fuel detection in case of an error" VALUE 0x8056F7FA RB_Val_Wu8 255.0 dez 0.00 255.0 FORMAT "%5.1" /end CHARACTERISTIC
/begin CHARACTERISTIC CWKRDYE "code word for function KRDY (knock control dynamic)" VALUE 0x8056F170 RB_Val_Wu8 255.0 dez 0.00 255.0 FORMAT "%5.1" /end CHARACTERISTIC
/begin CHARACTERISTIC CWKRINT "codeword knock control: calculation of knock detection charateristic" VALUE 0x8056F1F0 RB_Val_Wu8 255.0 dez 0.00 255.0 FORMAT "%5.1" /end CHARACTERISTIC
/begin CHARACTERISTIC CWKRLZFK "code word: knock detection is not disabled for guided cylinders" VALUE 0x8056F7FB RB_Val_Wu8 1.000 dez 0.00 1.000 FORMAT "%5.3" EXTENDED_LIMITS 0.00 255.0 /end CHARACTERISTIC
/begin CHARACTERISTIC CWKRLZOFV "Code word :activate ignition angle and offset of guiding cylinder in steeps" VALUE 0x8056F7FC RB_Val_Wu8 255.0 dez 0.00 255.0 FORMAT "%5.1" /end CHARACTERISTIC
/begin CHARACTERISTIC CWKROFFGZ "Code word for offset of guided cylinders" VALUE 0x8056F7FD RB_Val_Wu8 255.0 dez 0.00 255.0 FORMAT "%5.1" /end CHARACTERISTIC
/begin CHARACTERISTIC CWKRREF "code word: characteristic of rkr follow-up at speed dynamics" VALUE 0x8056F1F1 RB_Val_Wu8 255.0 dez 0.00 255.0 FORMAT "%5.1" /end CHARACTERISTIC
/begin CHARACTERISTIC CWKRVECTR "Code word for reset the counter for pre-ignition events" VALUE 0x805700BF RB_Val_Wu8 255.0 dez 0.00 255.0 FORMAT "%5.1" /end CHARACTERISTIC
/begin CHARACTERISTIC CWKRVEKO "Code word for function Coordination of measures against pre-ignition (short name KRVEKO, measures in case of pre ignition)" VALUE 0x805700C0 RB_Val_Wu8 255.0 dez 0.00 255.0 FORMAT "%5.1" /end CHARACTERISTIC
/begin CHARACTERISTIC CWLAMKO "Codeword Lambda Co-ordination" VALUE 0x805709DA RB_Val_Wu8 255.0 dez 0.00 255.0 FORMAT "%5.1" /end CHARACTERISTIC
/begin CHARACTERISTIC CWLAMKOAP "Codeword for options for calibration purposes in the function LAMKO (LAMKO: lambda setpoint coordination)" VALUE 0x805709DB RB_Val_Wu8 255.0 dez 0.00 255.0 FORMAT "%5.1" /end CHARACTERISTIC
/begin CHARACTERISTIC CWMDAPP "code word for calibration without torque structure" VALUE 0x8056F15D RB_Val_Wu8 255.0 dez 0.00 255.0 FORMAT "%5.1" /end CHARACTERISTIC
/begin CHARACTERISTIC CWMDAPP1 "code word for calibration without torque structure" VALUE 0x8056F15E RB_Val_Wu8 255.0 dez 0.00 255.0 FORMAT "%5.1" /end CHARACTERISTIC
/begin CHARACTERISTIC CWREFI "code word: reinitialize of rkr with REFINI at dynamics conditions" VALUE 0x8056F1F2 RB_Val_Wu8 255.0 dez 0.00 255.0 FORMAT "%5.1" /end CHARACTERISTIC
/begin CHARACTERISTIC CWRLXDZW "Codeword for calculation of the delta ignition angles" VALUE 0x8056F7FE RB_Val_Wu8 255.0 dez 0.00 255.0 FORMAT "%5.1" /end CHARACTERISTIC
/begin CHARACTERISTIC CWRSKRTP "Code word for freezing of reference level in case of overlapped measurement windows" VALUE 0x8056F462 RB_Val_Wu8 255.0 dez 0.00 255.0 FORMAT "%5.1" /end CHARACTERISTIC
/begin CHARACTERISTIC CWSKRREF "code word: characteristic of reference level calculation at speed dynamics" VALUE 0x8056F463 RB_Val_Wu8 255.0 dez 0.00 255.0 FORMAT "%5.1" /end CHARACTERISTIC
/begin CHARACTERISTIC CWVEREFI "code word: reinitialize of pre ignition reference level at dynamics conditions" VALUE 0x8056F464 RB_Val_Wu8 255.0 dez 0.00 255.0 FORMAT "%5.1" /end CHARACTERISTIC
/begin CHARACTERISTIC CWVEVKR "Code word for blocking knock control due to pre-ignition" VALUE 0x8056F7FF RB_Val_Wu8 255.0 dez 0.00 255.0 FORMAT "%5.1" /end CHARACTERISTIC
/begin CHARACTERISTIC CWVEVKRA "Codeword for restoring the variables of KRADAP before calculation" VALUE 0x8056F160 RB_Val_Wu8 255.0 dez 0.00 255.0 FORMAT "%5.1" /end CHARACTERISTIC
/begin CHARACTERISTIC CWVFN "Codeword for the variable step width of advancing of the ignition angle" VALUE 0x8056F800 RB_Val_Wu8 1.000 dez 0.00 1.000 FORMAT "%5.3" EXTENDED_LIMITS 0.00 255.0 /end CHARACTERISTIC
/begin CHARACTERISTIC CWWL "code word for warm-up control" VALUE 0x80570C5C RB_Val_Wu8 255.0 dez 0.00 255.0 FORMAT "%5.1" /end CHARACTERISTIC
/begin CHARACTERISTIC DLAMNSWL "max. deviation for lambda afterstart-warmup to switch on Lambda warmup" VALUE 0x80570C5D RB_Val_Wu8 0.9961 fak_ub_b1 0.00 0.9961 /end CHARACTERISTIC
/begin CHARACTERISTIC DWKRZMN "Threshold for the delta ignition angle in knock control to request limitation of the air charge" VALUE 0x8056F801 RB_Val_Ws8 191.3 kw_q0p75 -96.00 95.25 FORMAT "%5.2" /end CHARACTERISTIC
/begin CHARACTERISTIC DWKRZRLX "delta ignition angle to interpolate the factor for air charge limitation" VALUE 0x8056F802 RB_Val_Wu8 95.25 kw_q0p75 0.00 95.25 FORMAT "%5.2" EXTENDED_LIMITS 0.00 191.3 /end CHARACTERISTIC
/begin CHARACTERISTIC DYADMAX "Knock control: max. retard of dynamic response" VAL_BLK 0x8056F171 RB_ValA_Ws8 191.3 kw_q0p75 -96.00 95.25 FORMAT "%5.2" NUMBER 5 /end CHARACTERISTIC
/begin CHARACTERISTIC DYADS "additional retarding per cycle through adaptationat dynamics" VALUE 0x8056F176 RB_Val_Ws8 24.00 kw_q0p75 -24.00 0.00 FORMAT "%5.2" EXTENDED_LIMITS -96.00 95.25 /end CHARACTERISTIC
/begin CHARACTERISTIC DYAFVS "advance step for deactivation of dynamic response" VALUE 0x8056F177 RB_Val_Ws8 24.00 kw_q0p75 0.00 24.00 FORMAT "%5.2" EXTENDED_LIMITS -96.00 95.25 /end CHARACTERISTIC
/begin CHARACTERISTIC DYAMNV "min. value of dynamic response derivation" VALUE 0x8056F178 RB_Val_Ws8 24.00 kw_q0p75 -24.00 0.00 FORMAT "%5.2" EXTENDED_LIMITS -96.00 95.25 /end CHARACTERISTIC
/begin CHARACTERISTIC EngStrt_facAlti_T "Altitude factor" CURVE 0x80570C5E RB_Curve_U16_U8_Static 0.9961 fak_ub_b1 0.00 0.9961
 /begin AXIS_DESCR STD_AXIS PEnv_facCorrAlti fak_uw_b4 6 0.00 3.999939 FORMAT "%8.6" DEPOSIT ABSOLUTE /end AXIS_DESCR
/end CHARACTERISTIC
/begin CHARACTERISTIC EngStrt_facEngNomWrmLam_M "factor engine nominal warmup lambda" MAP 0x80570C72 RB_Map_U8U8_U8 1.992188 fak_ub_b2 0.00 1.992188 FORMAT "%8.6"
 /begin AXIS_DESCR STD_AXIS tmotlanswl temp_ub_q0p75_o48 12 -48.0 143.3 FORMAT "%5.1" DEPOSIT ABSOLUTE /end AXIS_DESCR
 /begin AXIS_DESCR STD_AXIS tmstlanswl temp_ub_q0p75_o48 12 -48.0 143.3 FORMAT "%5.1" DEPOSIT ABSOLUTE /end AXIS_DESCR
/end CHARACTERISTIC
/begin CHARACTERISTIC EngStrt_facEngNomWrm_M "factor engine nominal warmup" MAP 0x80570D1C RB_Map_U8U8_U8 1.992188 fak_ub_b2 0.00 1.992188 FORMAT "%8.6"
 /begin AXIS_DESCR STD_AXIS tmotlanswl temp_ub_q0p75_o48 12 -48.0 143.3 FORMAT "%5.1" DEPOSIT ABSOLUTE /end AXIS_DESCR
 /begin AXIS_DESCR STD_AXIS tmstlanswl temp_ub_q0p75_o48 12 -48.0 143.3 FORMAT "%5.1" DEPOSIT ABSOLUTE /end AXIS_DESCR
/end CHARACTERISTIC
/begin CHARACTERISTIC EngStrt_facHiAlti_T "factor high altitude" CURVE 0x80570DC6 RB_Curve_U16_U8_Static 0.9961 fak_ub_b1 0.00 0.9961
 /begin AXIS_DESCR STD_AXIS PEnv_facCorrAlti fak_uw_b4 6 0.00 3.999939 FORMAT "%8.6" DEPOSIT ABSOLUTE /end AXIS_DESCR
/end CHARACTERISTIC
/begin CHARACTERISTIC EngStrt_facLamDurgAftStrt_M "factor lambda during after start" MAP 0x80570DDA RB_Map_U8U16_U16 15.99976 fak_uw_b16 0.00 15.99976 FORMAT "%8.5"
 /begin AXIS_DESCR STD_AXIS tmstlanswl temp_ub_q0p75_o48 12 -48.0 143.3 FORMAT "%5.1" DEPOSIT ABSOLUTE /end AXIS_DESCR
 /begin AXIS_DESCR STD_AXIS anztib1_w_Loc dez 12 0.00 65535.00 FORMAT "%8.2" DEPOSIT ABSOLUTE /end AXIS_DESCR
/end CHARACTERISTIC
/begin CHARACTERISTIC EngStrt_facLamEngAftStrt_M "factor lambda engine after start" MAP 0x80570F20 RB_Map_U8U16_U16 15.99976 fak_uw_b16 0.00 15.99976 FORMAT "%8.5"
 /begin AXIS_DESCR STD_AXIS tmstlanswl temp_ub_q0p75_o48 12 -48.0 143.3 FORMAT "%5.1" DEPOSIT ABSOLUTE /end AXIS_DESCR
 /begin AXIS_DESCR STD_AXIS anztib1_w_Loc dez 12 0.00 65535.00 FORMAT "%8.2" DEPOSIT ABSOLUTE /end AXIS_DESCR
/end CHARACTERISTIC
/begin CHARACTERISTIC EngStrt_facLamWrmUpIntkP_CUR "factor for enrichment of lambda during warm-up based on intake manifold pressure (ps_w)" CURVE 0x80571066 RB_Curve_U16_U8_Static 1.992188 fak_ub_b2 0.00 1.992188 FORMAT "%8.6"
 /begin AXIS_DESCR STD_AXIS ps_w_msg p_uw_q0p039 5 0.00 2559.961 FORMAT "%8.3" DEPOSIT ABSOLUTE /end AXIS_DESCR
/end CHARACTERISTIC
/begin CHARACTERISTIC ExhMgT_ratLamCatHeatgIdleModSecFu_M "Performance characteristics lambda engine nominal at catalyst heating when vehicle is idling (second fuel, for instande FFV or CNG)" MAP 0x8057050C RB_Map_S16U16_U16 8.000000 fak_q0p000244 0.00 8.000000 FORMAT "%8.6" EXTENDED_LIMITS 0.00 15.99976
 /begin AXIS_DESCR STD_AXIS Epm_nEng EngN 8 -16384.00 16383.50 FORMAT "%8.2" DEPOSIT ABSOLUTE /end AXIS_DESCR
 /begin AXIS_DESCR STD_AXIS AirMod_ratChrgAirCyl rel_uw_q0p0234 8 0.00 1535.977 FORMAT "%8.3" DEPOSIT ABSOLUTE /end AXIS_DESCR
/end CHARACTERISTIC
/begin CHARACTERISTIC ExhMgT_ratLamCatHeatgIdleMod_M "Performance characteristics lambda engine nominal at catalyst heating when vehicle is idling" MAP 0x805705B0 RB_Map_S16U16_U16 8.000000 fak_q0p000244 0.00 8.000000 FORMAT "%8.6" EXTENDED_LIMITS 0.00 15.99976
 /begin AXIS_DESCR STD_AXIS Epm_nEng EngN 8 -16384.00 16383.50 FORMAT "%8.2" DEPOSIT ABSOLUTE /end AXIS_DESCR
 /begin AXIS_DESCR STD_AXIS AirMod_ratChrgAirCyl rel_uw_q0p0234 8 0.00 1535.977 FORMAT "%8.3" DEPOSIT ABSOLUTE /end AXIS_DESCR
/end CHARACTERISTIC
/begin CHARACTERISTIC ExhMgT_ratLamCatHeatgStrtSecFu_M "map lambda engine request at catalyst heating during afterstart (second fuel)" MAP 0x80570654 RB_Map_S16U16_U16 8.000000 fak_q0p000244 0.00 8.000000 FORMAT "%8.6" EXTENDED_LIMITS 0.00 15.99976
 /begin AXIS_DESCR STD_AXIS tmstcyla_w Temp_Cels 6 -3549.940 3003.560 FORMAT "%8.3" DEPOSIT ABSOLUTE /end AXIS_DESCR
 /begin AXIS_DESCR STD_AXIS anztib_w_msg dez 12 0.00 65535.00 FORMAT "%8.2" DEPOSIT ABSOLUTE /end AXIS_DESCR
/end CHARACTERISTIC
/begin CHARACTERISTIC ExhMgT_ratLamCatHeatgStrt_M "map lambda engine request at catalyst heating during afterstart (gasoline)" MAP 0x8057070C RB_Map_S16U16_U16 8.000000 fak_q0p000244 0.00 8.000000 FORMAT "%8.6" EXTENDED_LIMITS 0.00 15.99976
 /begin AXIS_DESCR STD_AXIS tmstcyla_w Temp_Cels 12 -3549.940 3003.560 FORMAT "%8.3" DEPOSIT ABSOLUTE /end AXIS_DESCR
 /begin AXIS_DESCR STD_AXIS anztib_w_msg dez 12 0.00 65535.00 FORMAT "%8.2" DEPOSIT ABSOLUTE /end AXIS_DESCR
/end CHARACTERISTIC
/begin CHARACTERISTIC ExhMgT_stCatHeatgLam2_C "second Codeword for the lambda for catalyst heating function" VALUE 0x80570860 RB_Val_Wu16 65535.00 dez 0.00 65535.00 FORMAT "%8.2" /end CHARACTERISTIC
/begin CHARACTERISTIC ExhMgT_stCatHeatgLam3_C "third Codeword for the lambda for catalyst heating function" VALUE 0x80570862 RB_Val_Wu16 65535.00 dez 0.00 65535.00 FORMAT "%8.2" /end CHARACTERISTIC
/begin CHARACTERISTIC ExhMgT_stCatHeatgLam_C "Codeword for the lambda for catalyst heating function" VALUE 0x80570864 RB_Val_Wu8 255.0 dez 0.00 255.0 FORMAT "%5.1" /end CHARACTERISTIC
/begin CHARACTERISTIC ExhMgT_stLamCoornExhMngt_C "Code word for the function lambda co-ordinator for exhaust temperature management" VALUE 0x805709D8 RB_Val_Wu8 255.0 dez 0.00 255.0 FORMAT "%5.1" /end CHARACTERISTIC
/begin CHARACTERISTIC ExhMgt_tiCatHeatgLamIdle_C "time constant for the calculation of Idle lambda during catalyst heating" VALUE 0x80570865 RB_Val_Wu8 25.4996 zk100msxs_ub_b25p5 0.1004 25.6000 FORMAT "%7.4" EXTENDED_LIMITS 0.100392 25.6000 /end CHARACTERISTIC
/begin CHARACTERISTIC ExhMgt_tiCatHeatgLamPartLoad_C "time constant for the transition factor of idle part load of the nominal engine lambda" VALUE 0x80570866 RB_Val_Wu8 25.4996 zk100msxs_ub_b25p5 0.1004 25.6000 FORMAT "%7.4" EXTENDED_LIMITS 0.100392 25.6000 /end CHARACTERISTIC
/begin CHARACTERISTIC ExhMgT_tiLamCatHeatgStrt_C "filter time constant for engine lambda request at catalyst heating during afterstart" VALUE 0x80570868 RB_Val_Wu16 655.3400 t_q0p01 0.0100 655.3500 FORMAT "%8.4" EXTENDED_LIMITS 0.00 655.3500 /end CHARACTERISTIC
/begin CHARACTERISTIC FETHKRREFI "Ethanol threshold for reinitialisation of rkr" VALUE 0x8056F1F3 RB_Val_Wu8 1.992188 fak_ub_b2 0.00 1.992188 FORMAT "%8.6" /end CHARACTERISTIC
/begin CHARACTERISTIC FKEFMC "correction factor for knock detection thresh. in case of change of filter frequ." VALUE 0x8056F1F4 RB_Val_Wu8 1.938 fak_ub_b16 0.063 2.000 FORMAT "%5.3" EXTENDED_LIMITS 0.00 15.94 /end CHARACTERISTIC
/begin CHARACTERISTIC FKELDYA "Corrective factor for knock detection threshold for adaptation of load dynamic" VALUE 0x8056F179 RB_Val_Wu8 15.94 fak_ub_b16 0.00 15.94 FORMAT "%5.2" /end CHARACTERISTIC
/begin CHARACTERISTIC FRKR2KOR "correction factor for reference pegel during initialization" VALUE 0x8056F465 RB_Val_Wu8 15.94 fak_ub_b16 0.00 15.94 FORMAT "%5.2" /end CHARACTERISTIC
/begin CHARACTERISTIC FRLVE2 "Factor for the 2nd stage of air charge reduction" VALUE 0x805700C2 RB_Val_Wu16 0.9999695 fak_uw_b2 1.000000 1.999969 FORMAT "%8.6" EXTENDED_LIMITS 0.00 1.999969 /end CHARACTERISTIC
/begin CHARACTERISTIC FSKEFMC "correction factor for knock detection thresh. in case of change of filter frequency in superknock window" VALUE 0x8056F466 RB_Val_Wu8 1.938 fak_ub_b16 0.063 2.000 FORMAT "%5.3" EXTENDED_LIMITS 0.00 15.94 /end CHARACTERISTIC
/begin CHARACTERISTIC FSKELDY "correction factor for knock detection threshold with engine-speed dynamics in superknock window" VALUE 0x8056F467 RB_Val_Wu8 1.938 fak_ub_b16 0.063 2.000 FORMAT "%5.3" EXTENDED_LIMITS 0.00 15.94 /end CHARACTERISTIC
/begin CHARACTERISTIC FSKENDY "correction factor for knock detection threshold with engine-speed dynamics in superknock window" VALUE 0x8056F468 RB_Val_Wu8 1.938 fak_ub_b16 0.063 2.000 FORMAT "%5.3" EXTENDED_LIMITS 0.00 15.94 /end CHARACTERISTIC
/begin CHARACTERISTIC FVERL "Threshold of the factor for the 2nd stage air charge reduction" VALUE 0x805700C4 RB_Val_Wu16 0.9999695 fak_uw_b2 0.00 0.9999695 FORMAT "%9.7" EXTENDED_LIMITS 0.00 1.999969 /end CHARACTERISTIC
/begin CHARACTERISTIC IKCtl_agAdpnRedn_C "Adaption reduction value (fine resolution)" VALUE 0x8056F162 RB_Val_Ws16 10.00000 zw_q0p1 -10.00000 0.00 FORMAT "%8.5" EXTENDED_LIMITS -3276.800 3276.700 /end CHARACTERISTIC
/begin CHARACTERISTIC IKCtl_agAdvLrng_C "ignition advancing learning value for knock adaption" VALUE 0x8056F164 RB_Val_Ws16 6.000000 zw_q0p1 0.00 6.000000 FORMAT "%8.6" EXTENDED_LIMITS -3276.800 3276.700 /end CHARACTERISTIC
/begin CHARACTERISTIC IKCtl_agKnkRtdt_M "retard step knock occurrence(fine resolution)" MAP 0x8056F804 RB_Map_S16U8_S16 6.000000 zw_q0p1 -6.000000 0.00 FORMAT "%8.6" EXTENDED_LIMITS -3276.800 3276.700
 /begin AXIS_DESCR STD_AXIS Epm_nEng EngN 8 -16384.00 16383.50 FORMAT "%8.2" DEPOSIT ABSOLUTE /end AXIS_DESCR
 /begin AXIS_DESCR STD_AXIS IKCtl_facKnkInten_u8 fak_ub_b16 4 0.00 15.94 FORMAT "%5.2" DEPOSIT ABSOLUTE /end AXIS_DESCR
/end CHARACTERISTIC
/begin CHARACTERISTIC IKCtl_agLimnAdpnLoadDyn_M "map for limitation by adaption read dependent on load dynamics" MAP 0x8056F85C RB_Map_U16S8_S16 3276.800 zw_q0p1 -3276.800 0.00 FORMAT "%8.3" EXTENDED_LIMITS -3276.800 3276.700
 /begin AXIS_DESCR STD_AXIS AirMod_ratChrgAirCyl rel_uw_q0p0234 4 0.00 1535.977 FORMAT "%8.3" DEPOSIT ABSOLUTE /end AXIS_DESCR
 /begin AXIS_DESCR STD_AXIS IKCtl_pPfiSp p_q10 4 -1280. 1270. FORMAT "%5.0" DEPOSIT ABSOLUTE /end AXIS_DESCR
/end CHARACTERISTIC
/begin CHARACTERISTIC IKCtl_agLimnAdpnPosDeLoadDyn_M "Map for the limitation of adaption values in case of positive change and load dynamic" MAP 0x8056F88C RB_Map_U16S8_S16 3276.700 zw_q0p1 0.00 3276.700 FORMAT "%8.3" EXTENDED_LIMITS -3276.800 3276.700
 /begin AXIS_DESCR STD_AXIS AirMod_ratChrgAirCyl rel_uw_q0p0234 4 0.00 1535.977 FORMAT "%8.3" DEPOSIT ABSOLUTE /end AXIS_DESCR
 /begin AXIS_DESCR STD_AXIS IKCtl_pPfiSp p_q10 4 -1280. 1270. FORMAT "%5.0" DEPOSIT ABSOLUTE /end AXIS_DESCR
/end CHARACTERISTIC
/begin CHARACTERISTIC IKCtl_agLimnAdpnPosDeSpdDyn_M "map for limitation of adaption values in case of positive change and speed dynamic" MAP 0x8056F8BC RB_Map_S16S8_S16 3276.700 zw_q0p1 0.00 3276.700 FORMAT "%8.3" EXTENDED_LIMITS -3276.800 3276.700
 /begin AXIS_DESCR STD_AXIS Epm_nEng EngN 4 -16384.00 16383.50 FORMAT "%8.2" DEPOSIT ABSOLUTE /end AXIS_DESCR
 /begin AXIS_DESCR STD_AXIS IKCtl_nFildGrad_s8 nmotg_sb_q100 6 -12800. 12700. FORMAT "%5.0" DEPOSIT ABSOLUTE /end AXIS_DESCR
/end CHARACTERISTIC
/begin CHARACTERISTIC IKCtl_agLimnAdpnSpdDyn_M "Map for limitation reading of adaption depending on engine speed dynamics" MAP 0x8056F8FE RB_Map_S16S8_S16 3276.800 zw_q0p1 -3276.800 0.00 FORMAT "%8.3" EXTENDED_LIMITS -3276.800 3276.700
 /begin AXIS_DESCR STD_AXIS Epm_nEng EngN 4 -16384.00 16383.50 FORMAT "%8.2" DEPOSIT ABSOLUTE /end AXIS_DESCR
 /begin AXIS_DESCR STD_AXIS IKCtl_nFildGrad_s8 nmotg_sb_q100 6 -12800. 12700. FORMAT "%5.0" DEPOSIT ABSOLUTE /end AXIS_DESCR
/end CHARACTERISTIC
/begin CHARACTERISTIC IKCtl_agLowrDistRtdt_GT "knock control: low delta ignition angle distance from mean retarding(fine resolution)" CURVE 0x8056F940 RB_CurveGroup_S16 20.50000 zw_q0p1 -20.50000 0.00 FORMAT "%8.5" EXTENDED_LIMITS -3276.800 3276.700
 /begin AXIS_DESCR COM_AXIS Epm_nEng EngN 8 -16384.00 16383.50 FORMAT "%8.2" AXIS_PTS_REF IKCtl_nEng08_X_AX /end AXIS_DESCR
/end CHARACTERISTIC
/begin CHARACTERISTIC IKCtl_agMaxRtdAdjmt_C "maximum retard adjustment (for fine resolution)" VALUE 0x8056F166 RB_Val_Ws16 30.00000 zw_q0p1 -30.00000 0.00 FORMAT "%8.5" EXTENDED_LIMITS -3276.800 3276.700 /end CHARACTERISTIC
/begin CHARACTERISTIC IKCtl_agMaxRtdtCurr_M "Maximum retardation(fine resolution)" MAP 0x8056F950 RB_Map_S16S16_S16 20.50000 zw_q0p1 -20.50000 0.00 FORMAT "%8.5" EXTENDED_LIMITS -3276.800 3276.700
 /begin AXIS_DESCR STD_AXIS Epm_nEng EngN 8 -16384.00 16383.50 FORMAT "%8.2" DEPOSIT ABSOLUTE /end AXIS_DESCR
 /begin AXIS_DESCR STD_AXIS IKCtl_tEngLoc_s16 Temp_Cels 8 -3549.940 3003.560 FORMAT "%8.3" DEPOSIT ABSOLUTE /end AXIS_DESCR
/end CHARACTERISTIC
/begin CHARACTERISTIC IKCtl_agMaxRtdtFlexfu_M "Maximal retardation of ignition angle for FlexFuel" MAP 0x8056F9F4 RB_Map_S16S16_S16 20.50000 zw_q0p1 -20.50000 0.00 FORMAT "%8.5" EXTENDED_LIMITS -3276.800 3276.700
 /begin AXIS_DESCR STD_AXIS Epm_nEng EngN 8 -16384.00 16383.50 FORMAT "%8.2" DEPOSIT ABSOLUTE /end AXIS_DESCR
 /begin AXIS_DESCR STD_AXIS IKCtl_tEngLoc_s16 Temp_Cels 8 -3549.940 3003.560 FORMAT "%8.3" DEPOSIT ABSOLUTE /end AXIS_DESCR
/end CHARACTERISTIC
/begin CHARACTERISTIC IKCtl_agMinDstAdpnLrng_C "minimum distance of current ignition angle to adaption value for advancing" VALUE 0x8056F168 RB_Val_Ws16 3285.800 zw_q0p1 -3276.800 9.000 FORMAT "%8.3" EXTENDED_LIMITS -3276.800 3276.700 /end CHARACTERISTIC
/begin CHARACTERISTIC IKCtl_agRtdtLrng_C "ignition retardation learning value for knock adaption after knocking detected" VALUE 0x8056F16A RB_Val_Ws16 18.00000 zw_q0p1 -9.000000 9.000000 FORMAT "%8.6" EXTENDED_LIMITS -3276.800 3276.700 /end CHARACTERISTIC
/begin CHARACTERISTIC IKCtl_agUpprDistRtdt_GT "high delta ignition angle distance from mean retarding(fine resolution)" CURVE 0x8056FA98 RB_CurveGroup_S16 20.50000 zw_q0p1 0.00 20.50000 FORMAT "%8.5" EXTENDED_LIMITS -3276.800 3276.700
 /begin AXIS_DESCR COM_AXIS Epm_nEng EngN 8 -16384.00 16383.50 FORMAT "%8.2" AXIS_PTS_REF IKCtl_nEng08_X_AX /end AXIS_DESCR
/end CHARACTERISTIC
/begin CHARACTERISTIC IKCtl_EnaPreIgnWoKnkEna_C "Activation pre ignition detection with out active knock detection" VALUE 0x8056F469 RB_Val_Wu8 255.0 OneToOne 0.00 255.0 FORMAT "%5.1" /end CHARACTERISTIC
/begin AXIS_PTS IKCtl_fac04_X_AX "distribution for ethanol-ratio" 0x805578CA fethmnmx_msg RB_Axis_U8 1.992188 fak_ub_b2 4 0.00 1.992188 FORMAT "%8.6" DEPOSIT ABSOLUTE /end AXIS_PTS
/begin CHARACTERISTIC IKCtl_facAirChRednFu_T "the latest delta ignition angle for air charge reduction at low octane fuel" CURVE 0x8056FAA8 RB_Curve_S16_S8_Static 191.3 kw_q0p75 -96.00 95.25 FORMAT "%5.2"
 /begin AXIS_DESCR STD_AXIS Epm_nEng EngN 4 -16384.00 16383.50 FORMAT "%8.2" DEPOSIT ABSOLUTE /end AXIS_DESCR
/end CHARACTERISTIC
/begin CHARACTERISTIC IKCtl_facCorrnInj_C "correction factor for knock detection threshold due to injector noise" VALUE 0x8056F1F5 RB_Val_Wu8 1.938 fak_ub_b16 0.063 2.000 FORMAT "%5.3" EXTENDED_LIMITS 0.00 15.94 /end CHARACTERISTIC
/begin CHARACTERISTIC IKCtl_facCorrnLoadDyn_GT "correction factor for knock detection threshold during load dynamics" CURVE 0x8056F1F6 RB_CurveGroup_U8 1.938 fak_ub_b16 0.063 2.000 FORMAT "%5.3" EXTENDED_LIMITS 0.00 15.94
 /begin AXIS_DESCR COM_AXIS Epm_nEng EngN 13 -16384.00 16383.50 FORMAT "%8.2" AXIS_PTS_REF IKCtl_nEngVar13_X_AX /end AXIS_DESCR
/end CHARACTERISTIC
/begin CHARACTERISTIC IKCtl_facCorrnNDyn_GT "correction factor for knock detection threshold with engine-speed dynamics" CURVE 0x8056F203 RB_CurveGroup_U8 1.938 fak_ub_b16 0.063 2.000 FORMAT "%5.3" EXTENDED_LIMITS 0.00 15.94
 /begin AXIS_DESCR COM_AXIS Epm_nEng EngN 13 -16384.00 16383.50 FORMAT "%8.2" AXIS_PTS_REF IKCtl_nEngVar13_X_AX /end AXIS_DESCR
/end CHARACTERISTIC
/begin CHARACTERISTIC IKCtl_facDetnThdPreIgn0_GM "Threshold for super knock detection, cylinder 0" MAP 0x8056F46A RB_MapGroup_U8 13.94 fak_ub_b16 2.00 15.94 FORMAT "%5.2" EXTENDED_LIMITS 0.00 15.94
 /begin AXIS_DESCR COM_AXIS Epm_nEng EngN 13 -16384.00 16383.50 FORMAT "%8.2" AXIS_PTS_REF IKCtl_nEngVar13_X_AX /end AXIS_DESCR
 /begin AXIS_DESCR COM_AXIS AirMod_ratChrgAirCyl rel_uw_q0p0234 4 0.00 1535.977 FORMAT "%8.3" AXIS_PTS_REF IKCtl_ratLoad04_X_AX /end AXIS_DESCR
/end CHARACTERISTIC
/begin CHARACTERISTIC IKCtl_facDetnThdPreIgn1_GM "Threshold for super knock detection, cylinder 1" MAP 0x8056F49E RB_MapGroup_U8 13.94 fak_ub_b16 2.00 15.94 FORMAT "%5.2" EXTENDED_LIMITS 0.00 15.94
 /begin AXIS_DESCR COM_AXIS Epm_nEng EngN 13 -16384.00 16383.50 FORMAT "%8.2" AXIS_PTS_REF IKCtl_nEngVar13_X_AX /end AXIS_DESCR
 /begin AXIS_DESCR COM_AXIS AirMod_ratChrgAirCyl rel_uw_q0p0234 4 0.00 1535.977 FORMAT "%8.3" AXIS_PTS_REF IKCtl_ratLoad04_X_AX /end AXIS_DESCR
/end CHARACTERISTIC
/begin CHARACTERISTIC IKCtl_facDetnThdPreIgn2_GM "Threshold for super knock detection, cylinder 2" MAP 0x8056F4D2 RB_MapGroup_U8 13.94 fak_ub_b16 2.00 15.94 FORMAT "%5.2" EXTENDED_LIMITS 0.00 15.94
 /begin AXIS_DESCR COM_AXIS Epm_nEng EngN 13 -16384.00 16383.50 FORMAT "%8.2" AXIS_PTS_REF IKCtl_nEngVar13_X_AX /end AXIS_DESCR
 /begin AXIS_DESCR COM_AXIS AirMod_ratChrgAirCyl rel_uw_q0p0234 4 0.00 1535.977 FORMAT "%8.3" AXIS_PTS_REF IKCtl_ratLoad04_X_AX /end AXIS_DESCR
/end CHARACTERISTIC
/begin CHARACTERISTIC IKCtl_facDetnThdPreIgn3_GM "Threshold for super knock detection, cylinder 3" MAP 0x8056F506 RB_MapGroup_U8 13.94 fak_ub_b16 2.00 15.94 FORMAT "%5.2" EXTENDED_LIMITS 0.00 15.94
 /begin AXIS_DESCR COM_AXIS Epm_nEng EngN 13 -16384.00 16383.50 FORMAT "%8.2" AXIS_PTS_REF IKCtl_nEngVar13_X_AX /end AXIS_DESCR
 /begin AXIS_DESCR COM_AXIS AirMod_ratChrgAirCyl rel_uw_q0p0234 4 0.00 1535.977 FORMAT "%8.3" AXIS_PTS_REF IKCtl_ratLoad04_X_AX /end AXIS_DESCR
/end CHARACTERISTIC
/begin CHARACTERISTIC IKCtl_facDurnReqCvlci_T "Duration for camshaft adjustment at per-ignition" CURVE 0x805700C6 RB_Curve_S16_U16_Static 3276.750 t_q0p05 0.00 3276.750 FORMAT "%8.3"
 /begin AXIS_DESCR STD_AXIS Epm_nEng EngN 6 -16384.00 16383.50 FORMAT "%8.2" DEPOSIT ABSOLUTE /end AXIS_DESCR
/end CHARACTERISTIC
/begin CHARACTERISTIC IKCtl_facDurnReqEnchmt_T "Duration for fuel enrichment at pre-ignition" CURVE 0x805700E0 RB_Curve_S16_U16_Static 30.00000 t_q0p05 0.00 30.00000 FORMAT "%8.5" EXTENDED_LIMITS 0.00 3276.750
 /begin AXIS_DESCR STD_AXIS Epm_nEng EngN 6 -16384.00 16383.50 FORMAT "%8.2" DEPOSIT ABSOLUTE /end AXIS_DESCR
/end CHARACTERISTIC
/begin CHARACTERISTIC IKCtl_facDurnReqInjD_T "Curve for number of demanded fuel cut off at pre-ignition" CURVE 0x805700FA RB_Curve_S16_U8_Static 20.00 dez 0.00 20.00 FORMAT "%5.2" EXTENDED_LIMITS 0.00 255.0
 /begin AXIS_DESCR STD_AXIS Epm_nEng EngN 6 -16384.00 16383.50 FORMAT "%8.2" DEPOSIT ABSOLUTE /end AXIS_DESCR
/end CHARACTERISTIC
/begin CHARACTERISTIC IKCtl_facDurnReqRedFillg_T "Duration for air charge reduction at pre-ignition" CURVE 0x8057010E RB_Curve_S16_U16_Static 3276.750 t_q0p05 0.00 3276.750 FORMAT "%8.3"
 /begin AXIS_DESCR STD_AXIS Epm_nEng EngN 6 -16384.00 16383.50 FORMAT "%8.2" DEPOSIT ABSOLUTE /end AXIS_DESCR
/end CHARACTERISTIC
/begin CHARACTERISTIC IKCtl_facDynAdpnFFV_GT "Weighting factor for dynamic response pre-control" CURVE 0x8056F17A RB_CurveGroup_U8 0.9961 fak_ub_b1 0.00 0.9961
 /begin AXIS_DESCR COM_AXIS fethmnmx_msg fak_ub_b2 4 0.00 1.992188 FORMAT "%8.6" AXIS_PTS_REF IKCtl_fac04_X_AX /end AXIS_DESCR
/end CHARACTERISTIC
/begin CHARACTERISTIC IKCtl_facDynAdpn_M "dynamic response pre-control" MAP 0x8056F17E RB_Map_S16U8_S8 191.3 kw_q0p75 -96.00 95.25 FORMAT "%5.2"
 /begin AXIS_DESCR STD_AXIS Epm_nEng EngN 6 -16384.00 16383.50 FORMAT "%8.2" DEPOSIT ABSOLUTE /end AXIS_DESCR
 /begin AXIS_DESCR STD_AXIS taevkr temp_ub_q0p75_o48 5 -48.0 143.3 FORMAT "%5.1" DEPOSIT ABSOLUTE /end AXIS_DESCR
/end CHARACTERISTIC
/begin CHARACTERISTIC IKCtl_facEndAirChRednFu_T "the delta ignition angle for withdrawl of air charge reduction at low octane fuel" CURVE 0x8056FAB6 RB_Curve_S16_S8_Static 191.3 kw_q0p75 -96.00 95.25 FORMAT "%5.2"
 /begin AXIS_DESCR STD_AXIS Epm_nEng EngN 4 -16384.00 16383.50 FORMAT "%8.2" DEPOSIT ABSOLUTE /end AXIS_DESCR
/end CHARACTERISTIC
/begin CHARACTERISTIC IKCtl_facEthMax "max. ethanol content to activate pre-ignition detection" VALUE 0x8056F53A RB_Val_Wu16 1.999969 fak_uw_b2 0.00 1.999969 FORMAT "%8.6" /end CHARACTERISTIC
/begin CHARACTERISTIC IKCtl_FacKnockDetCorrnThd0_GM "correction of knock-detection factor characteristic map for flexfuel, cylinder counter 0" MAP 0x8056F210 RB_MapGroup_U8 3.438 fak_ub_b16 0.063 3.500 FORMAT "%5.3" EXTENDED_LIMITS 0.00 15.94
 /begin AXIS_DESCR COM_AXIS Epm_nEng EngN 6 -16384.00 16383.50 FORMAT "%8.2" AXIS_PTS_REF IKCtl_nEng06_X_AX /end AXIS_DESCR
 /begin AXIS_DESCR COM_AXIS fethmnmx_msg fak_ub_b2 4 0.00 1.992188 FORMAT "%8.6" AXIS_PTS_REF IKCtl_fac04_X_AX /end AXIS_DESCR
/end CHARACTERISTIC
/begin CHARACTERISTIC IKCtl_FacKnockDetCorrnThd1_GM "correction of knock-detection factor characteristic map for flexfuel, cylinder counter 1" MAP 0x8056F228 RB_MapGroup_U8 3.438 fak_ub_b16 0.063 3.500 FORMAT "%5.3" EXTENDED_LIMITS 0.00 15.94
 /begin AXIS_DESCR COM_AXIS Epm_nEng EngN 6 -16384.00 16383.50 FORMAT "%8.2" AXIS_PTS_REF IKCtl_nEng06_X_AX /end AXIS_DESCR
 /begin AXIS_DESCR COM_AXIS fethmnmx_msg fak_ub_b2 4 0.00 1.992188 FORMAT "%8.6" AXIS_PTS_REF IKCtl_fac04_X_AX /end AXIS_DESCR
/end CHARACTERISTIC
/begin CHARACTERISTIC IKCtl_FacKnockDetCorrnThd2_GM "correction of knock-detection factor characteristic map for flexfuel, cylinder counter 2" MAP 0x8056F240 RB_MapGroup_U8 3.438 fak_ub_b16 0.063 3.500 FORMAT "%5.3" EXTENDED_LIMITS 0.00 15.94
 /begin AXIS_DESCR COM_AXIS Epm_nEng EngN 6 -16384.00 16383.50 FORMAT "%8.2" AXIS_PTS_REF IKCtl_nEng06_X_AX /end AXIS_DESCR
 /begin AXIS_DESCR COM_AXIS fethmnmx_msg fak_ub_b2 4 0.00 1.992188 FORMAT "%8.6" AXIS_PTS_REF IKCtl_fac04_X_AX /end AXIS_DESCR
/end CHARACTERISTIC
/begin CHARACTERISTIC IKCtl_FacKnockDetCorrnThd3_GM "correction of knock-detection factor characteristic map for flexfuel, cylinder counter 3" MAP 0x8056F258 RB_MapGroup_U8 3.438 fak_ub_b16 0.063 3.500 FORMAT "%5.3" EXTENDED_LIMITS 0.00 15.94
 /begin AXIS_DESCR COM_AXIS Epm_nEng EngN 6 -16384.00 16383.50 FORMAT "%8.2" AXIS_PTS_REF IKCtl_nEng06_X_AX /end AXIS_DESCR
 /begin AXIS_DESCR COM_AXIS fethmnmx_msg fak_ub_b2 4 0.00 1.992188 FORMAT "%8.6" AXIS_PTS_REF IKCtl_fac04_X_AX /end AXIS_DESCR
/end CHARACTERISTIC
/begin CHARACTERISTIC IKCtl_FacKnockDetThd0_GM "Knock-detection factor characteristic map cylinder counter 0" MAP 0x8056F270 RB_MapGroup_U8 3.438 fak_ub_b16 0.063 3.500 FORMAT "%5.3" EXTENDED_LIMITS 0.00 15.94
 /begin AXIS_DESCR COM_AXIS Epm_nEng EngN 13 -16384.00 16383.50 FORMAT "%8.2" AXIS_PTS_REF IKCtl_nEngVar13_X_AX /end AXIS_DESCR
 /begin AXIS_DESCR COM_AXIS AirMod_ratChrgAirCyl rel_uw_q0p0234 4 0.00 1535.977 FORMAT "%8.3" AXIS_PTS_REF IKCtl_ratLoad04_X_AX /end AXIS_DESCR
/end CHARACTERISTIC
/begin CHARACTERISTIC IKCtl_FacKnockDetThd1_GM "Knock-detection factor characteristic map cylinder counter 1" MAP 0x8056F2A4 RB_MapGroup_U8 3.438 fak_ub_b16 0.063 3.500 FORMAT "%5.3" EXTENDED_LIMITS 0.00 15.94
 /begin AXIS_DESCR COM_AXIS Epm_nEng EngN 13 -16384.00 16383.50 FORMAT "%8.2" AXIS_PTS_REF IKCtl_nEngVar13_X_AX /end AXIS_DESCR
 /begin AXIS_DESCR COM_AXIS AirMod_ratChrgAirCyl rel_uw_q0p0234 4 0.00 1535.977 FORMAT "%8.3" AXIS_PTS_REF IKCtl_ratLoad04_X_AX /end AXIS_DESCR
/end CHARACTERISTIC
/begin CHARACTERISTIC IKCtl_FacKnockDetThd2_GM "Knock-detection factor characteristic map cylinder counter 2" MAP 0x8056F2D8 RB_MapGroup_U8 3.438 fak_ub_b16 0.063 3.500 FORMAT "%5.3" EXTENDED_LIMITS 0.00 15.94
 /begin AXIS_DESCR COM_AXIS Epm_nEng EngN 13 -16384.00 16383.50 FORMAT "%8.2" AXIS_PTS_REF IKCtl_nEngVar13_X_AX /end AXIS_DESCR
 /begin AXIS_DESCR COM_AXIS AirMod_ratChrgAirCyl rel_uw_q0p0234 4 0.00 1535.977 FORMAT "%8.3" AXIS_PTS_REF IKCtl_ratLoad04_X_AX /end AXIS_DESCR
/end CHARACTERISTIC
/begin CHARACTERISTIC IKCtl_FacKnockDetThd3_GM "Knock-detection factor characteristic map cylinder counter 3" MAP 0x8056F30C RB_MapGroup_U8 3.438 fak_ub_b16 0.063 3.500 FORMAT "%5.3" EXTENDED_LIMITS 0.00 15.94
 /begin AXIS_DESCR COM_AXIS Epm_nEng EngN 13 -16384.00 16383.50 FORMAT "%8.2" AXIS_PTS_REF IKCtl_nEngVar13_X_AX /end AXIS_DESCR
 /begin AXIS_DESCR COM_AXIS AirMod_ratChrgAirCyl rel_uw_q0p0234 4 0.00 1535.977 FORMAT "%8.3" AXIS_PTS_REF IKCtl_ratLoad04_X_AX /end AXIS_DESCR
/end CHARACTERISTIC
/begin CHARACTERISTIC IKCtl_FacKnockTrck_AX "Lowpass follow-up factor for stationary operation" MAP 0x8056F340 RB_Map_S8U8_U8 28.00 dez 4.00 32.00 FORMAT "%5.2" EXTENDED_LIMITS 0.00 255.0
 /begin AXIS_DESCR STD_AXIS IKCtl_nFildGrad_s8 nmotg_sb_q100 6 -12800. 12700. FORMAT "%5.0" DEPOSIT ABSOLUTE /end AXIS_DESCR
 /begin AXIS_DESCR STD_AXIS Epm_nEngLRes nmot_ub_q40 4 0.00 10200. FORMAT "%5.0" DEPOSIT ABSOLUTE /end AXIS_DESCR
/end CHARACTERISTIC
/begin CHARACTERISTIC IKCtl_facMaxAirCh_T "factor for the engine speed dependent measure of knock control to maximum air charge" MAP 0x8056FAC4 RB_Map_S16U16_U16 1.000000 fak_uw_b2 0.00 1.000000 FORMAT "%8.6" EXTENDED_LIMITS 0.00 1.999969
 /begin AXIS_DESCR STD_AXIS Epm_nEng EngN 12 -16384.00 16383.50 FORMAT "%8.2" DEPOSIT ABSOLUTE /end AXIS_DESCR
 /begin AXIS_DESCR STD_AXIS dzwflt_w_msg zw_q0p1875 8 0.00 12287.81 FORMAT "%8.2" DEPOSIT ABSOLUTE /end AXIS_DESCR
/end CHARACTERISTIC
/begin CHARACTERISTIC IKCtl_facMaxLpFilKnkDetn_T "curve for limitation of pressure value for reference calculation in case of knocking" CURVE 0x8056F364 RB_Curve_S16_U8_Static 14.94 fak_ub_b16 1.00 15.94 FORMAT "%5.2" EXTENDED_LIMITS 0.00 15.94
 /begin AXIS_DESCR STD_AXIS Epm_nEng EngN 13 -16384.00 16383.50 FORMAT "%8.2" DEPOSIT ABSOLUTE /end AXIS_DESCR
/end CHARACTERISTIC
/begin CHARACTERISTIC IKCtl_facMaxLpFilPreIgnDetn_T "curve for limitation of reference value, in case of pre-ignition" CURVE 0x8056F53C RB_Curve_S16_U8_Static 14.94 fak_ub_b16 1.00 15.94 FORMAT "%5.2" EXTENDED_LIMITS 0.00 15.94
 /begin AXIS_DESCR STD_AXIS Epm_nEng EngN 13 -16384.00 16383.50 FORMAT "%8.2" DEPOSIT ABSOLUTE /end AXIS_DESCR
/end CHARACTERISTIC
/begin CHARACTERISTIC IKCtl_facMaxRtdtHiVlvLftFlexfu_M "Correction factor for maximum retardation during high valve timing in flex fuel vehicles" MAP 0x8056FBB0 RB_Map_S16U16_U8 1.000 fak_ub_b16 0.00 1.000 FORMAT "%5.3" EXTENDED_LIMITS 0.00 15.94
 /begin AXIS_DESCR STD_AXIS Epm_nEng EngN 8 -16384.00 16383.50 FORMAT "%8.2" DEPOSIT ABSOLUTE /end AXIS_DESCR
 /begin AXIS_DESCR STD_AXIS AirMod_ratChrgAirCyl rel_uw_q0p0234 8 0.00 1535.977 FORMAT "%8.3" DEPOSIT ABSOLUTE /end AXIS_DESCR
/end CHARACTERISTIC
/begin CHARACTERISTIC IKCtl_facMaxRtdtHiVlvLft_M "Correction factor for maximum retardation during high valve timing" MAP 0x8056FC14 RB_Map_S16U16_U8 1.000 fak_ub_b16 0.00 1.000 FORMAT "%5.3" EXTENDED_LIMITS 0.00 15.94
 /begin AXIS_DESCR STD_AXIS Epm_nEng EngN 8 -16384.00 16383.50 FORMAT "%8.2" DEPOSIT ABSOLUTE /end AXIS_DESCR
 /begin AXIS_DESCR STD_AXIS AirMod_ratChrgAirCyl rel_uw_q0p0234 8 0.00 1535.977 FORMAT "%8.3" DEPOSIT ABSOLUTE /end AXIS_DESCR
/end CHARACTERISTIC
/begin CHARACTERISTIC IKCtl_facMaxRtdtLoVlvLftFlexfu_M "Correction factor for maximum retardation during low valve timing in flex fuel vehicles" MAP 0x8056FC78 RB_Map_S16U16_U8 1.000 fak_ub_b16 0.00 1.000 FORMAT "%5.3" EXTENDED_LIMITS 0.00 15.94
 /begin AXIS_DESCR STD_AXIS Epm_nEng EngN 8 -16384.00 16383.50 FORMAT "%8.2" DEPOSIT ABSOLUTE /end AXIS_DESCR
 /begin AXIS_DESCR STD_AXIS AirMod_ratChrgAirCyl rel_uw_q0p0234 8 0.00 1535.977 FORMAT "%8.3" DEPOSIT ABSOLUTE /end AXIS_DESCR
/end CHARACTERISTIC
/begin CHARACTERISTIC IKCtl_facMaxRtdtLoVlvLft_M "Correction factor for maximum retardation during low valve timing" MAP 0x8056FCDC RB_Map_S16U16_U8 1.000 fak_ub_b16 0.00 1.000 FORMAT "%5.3" EXTENDED_LIMITS 0.00 15.94
 /begin AXIS_DESCR STD_AXIS Epm_nEng EngN 8 -16384.00 16383.50 FORMAT "%8.2" DEPOSIT ABSOLUTE /end AXIS_DESCR
 /begin AXIS_DESCR STD_AXIS AirMod_ratChrgAirCyl rel_uw_q0p0234 8 0.00 1535.977 FORMAT "%8.3" DEPOSIT ABSOLUTE /end AXIS_DESCR
/end CHARACTERISTIC
/begin CHARACTERISTIC IKCtl_facNMaxAirCh_T "factor for the engine speed depending measure in knock control to maximize air charge" CURVE 0x8056FD40 RB_Curve_S16_U16_Static 1.000000 fak_uw_b2 0.00 1.000000 FORMAT "%8.6" EXTENDED_LIMITS 0.00 1.999969
 /begin AXIS_DESCR STD_AXIS Epm_nEng EngN 8 -16384.00 16383.50 FORMAT "%8.2" DEPOSIT ABSOLUTE /end AXIS_DESCR
/end CHARACTERISTIC
/begin CHARACTERISTIC IKCtl_facOffsGdCyl_M "Correction factor for offset map" MAP 0x8056F630 RB_Map_S16U16_U8 1.992 fak_ub_q7p8125Em3 0.00 1.992 FORMAT "%5.3"
 /begin AXIS_DESCR STD_AXIS Epm_nEng EngN 12 -16384.00 16383.50 FORMAT "%8.2" DEPOSIT ABSOLUTE /end AXIS_DESCR
 /begin AXIS_DESCR STD_AXIS AirMod_ratChrgAirCyl rel_uw_q0p0234 12 0.00 1535.977 FORMAT "%8.3" DEPOSIT ABSOLUTE /end AXIS_DESCR
/end CHARACTERISTIC
/begin CHARACTERISTIC IKCtl_FacPreIgnTrck_AX "Lowpass follow-up factor for stationary operation, 2. knock-window" MAP 0x8056F566 RB_Map_S8S16_U8 28.00 dez 4.00 32.00 FORMAT "%5.2" EXTENDED_LIMITS 0.00 255.0
 /begin AXIS_DESCR STD_AXIS IKCtl_nFildGrad_s8 nmotg_sb_q100 6 -12800. 12700. FORMAT "%5.0" DEPOSIT ABSOLUTE /end AXIS_DESCR
 /begin AXIS_DESCR STD_AXIS Epm_nEng EngN 4 -16384.00 16383.50 FORMAT "%8.2" DEPOSIT ABSOLUTE /end AXIS_DESCR
/end CHARACTERISTIC
/begin CHARACTERISTIC IKCtl_facReqRedFillgPrmnt_T "Curve for factor to permanently reduce air charge" CURVE 0x80570128 RB_Curve_S16_U16_Static 1.000000 fak_uw_b2 0.00 1.000000 FORMAT "%8.6" EXTENDED_LIMITS 0.00 1.999969
 /begin AXIS_DESCR STD_AXIS Epm_nEng EngN 8 -16384.00 16383.50 FORMAT "%8.2" DEPOSIT ABSOLUTE /end AXIS_DESCR
/end CHARACTERISTIC
/begin CHARACTERISTIC IKCtl_facReqRedFillg_T "Map for factor to reduce air charge" MAP 0x8057014A RB_Map_S16U16_U16 1.000000 fak_uw_b2 0.00 1.000000 FORMAT "%8.6" EXTENDED_LIMITS 0.00 1.999969
 /begin AXIS_DESCR STD_AXIS Epm_nEng EngN 5 -16384.00 16383.50 FORMAT "%8.2" DEPOSIT ABSOLUTE /end AXIS_DESCR
 /begin AXIS_DESCR STD_AXIS tans_msg temp_ub_q0p75_o48 5 -48.0000 143.2500 FORMAT "%8.4" EXTENDED_LIMITS -48.00000 49103.25 DEPOSIT ABSOLUTE /end AXIS_DESCR
/end CHARACTERISTIC
/begin CHARACTERISTIC IKCtl_facSftyRtdtHiVlvLftFlexfu_M "Correction factor for safety retardation during high valve timing in flex fuel vehicles" MAP 0x8056FD62 RB_Map_S16U16_U8 1.000 fak_ub_b16 0.00 1.000 FORMAT "%5.3" EXTENDED_LIMITS 0.00 15.94
 /begin AXIS_DESCR STD_AXIS Epm_nEng EngN 8 -16384.00 16383.50 FORMAT "%8.2" DEPOSIT ABSOLUTE /end AXIS_DESCR
 /begin AXIS_DESCR STD_AXIS AirMod_ratChrgAirCyl rel_uw_q0p0234 8 0.00 1535.977 FORMAT "%8.3" DEPOSIT ABSOLUTE /end AXIS_DESCR
/end CHARACTERISTIC
/begin CHARACTERISTIC IKCtl_facSftyRtdtHiVlvLft_M "Correction factor for safety retardation during high valve timing" MAP 0x8056FDC6 RB_Map_S16U16_U8 1.000 fak_ub_b16 0.00 1.000 FORMAT "%5.3" EXTENDED_LIMITS 0.00 15.94
 /begin AXIS_DESCR STD_AXIS Epm_nEng EngN 8 -16384.00 16383.50 FORMAT "%8.2" DEPOSIT ABSOLUTE /end AXIS_DESCR
 /begin AXIS_DESCR STD_AXIS AirMod_ratChrgAirCyl rel_uw_q0p0234 8 0.00 1535.977 FORMAT "%8.3" DEPOSIT ABSOLUTE /end AXIS_DESCR
/end CHARACTERISTIC
/begin CHARACTERISTIC IKCtl_facSftyRtdtLoVlvLftFlexfu_M "Correction factor for safety retardation during low valve timing in flex fuel vehicles" MAP 0x8056FE2A RB_Map_S16U16_U8 1.000 fak_ub_b16 0.00 1.000 FORMAT "%5.3" EXTENDED_LIMITS 0.00 15.94
 /begin AXIS_DESCR STD_AXIS Epm_nEng EngN 8 -16384.00 16383.50 FORMAT "%8.2" DEPOSIT ABSOLUTE /end AXIS_DESCR
 /begin AXIS_DESCR STD_AXIS AirMod_ratChrgAirCyl rel_uw_q0p0234 8 0.00 1535.977 FORMAT "%8.3" DEPOSIT ABSOLUTE /end AXIS_DESCR
/end CHARACTERISTIC
/begin CHARACTERISTIC IKCtl_facSftyRtdtLoVlvLft_M "Correction factor for safety retardation during low valve timing" MAP 0x8056FE8E RB_Map_S16U16_U8 1.000 fak_ub_b16 0.00 1.000 FORMAT "%5.3" EXTENDED_LIMITS 0.00 15.94
 /begin AXIS_DESCR STD_AXIS Epm_nEng EngN 8 -16384.00 16383.50 FORMAT "%8.2" DEPOSIT ABSOLUTE /end AXIS_DESCR
 /begin AXIS_DESCR STD_AXIS AirMod_ratChrgAirCyl rel_uw_q0p0234 8 0.00 1535.977 FORMAT "%8.3" DEPOSIT ABSOLUTE /end AXIS_DESCR
/end CHARACTERISTIC
/begin CHARACTERISTIC IKCtl_facSftyRtdtPreIgn_T "curve for factor to reduce air charge at knock sensor error" CURVE 0x80570194 RB_Curve_S16_U16_Static 1.000000 fak_uw_b2 0.00 1.000000 FORMAT "%8.6" EXTENDED_LIMITS 0.00 1.999969
 /begin AXIS_DESCR STD_AXIS Epm_nEng EngN 5 -16384.00 16383.50 FORMAT "%8.2" DEPOSIT ABSOLUTE /end AXIS_DESCR
/end CHARACTERISTIC
/begin CHARACTERISTIC IKCtl_facThdMaxGdCly "cylinder individual rpm limit, below which leading cylinder functionality is active" VAL_BLK 0x8056F6F4 RB_ValA_Ws16 32767.50 EngN -16384.00 16383.50 FORMAT "%8.2" NUMBER 4 /end CHARACTERISTIC
/begin CHARACTERISTIC IKCtl_facThdMinGdCly "cylinder individual rpm limit for lead by leading cylinder" VAL_BLK 0x8056F6FC RB_ValA_Ws16 32767.50 EngN -16384.00 16383.50 FORMAT "%8.2" NUMBER 4 /end CHARACTERISTIC
/begin CHARACTERISTIC IKCtl_facThdReqCvlci_T "Curve for Threshold to camshaft adjustment demand at pre-ignition" CURVE 0x805701AA RB_Curve_S16_U8_Static 255.0 dez 0.00 255.0 FORMAT "%5.1"
 /begin AXIS_DESCR STD_AXIS Epm_nEng EngN 6 -16384.00 16383.50 FORMAT "%8.2" DEPOSIT ABSOLUTE /end AXIS_DESCR
/end CHARACTERISTIC
/begin CHARACTERISTIC IKCtl_facThdReqEnchmt_T "Curve for Threshold to fuel enrichment demand at pre-ignition" CURVE 0x805701BE RB_Curve_S16_U8_Static 255.0 dez 0.00 255.0 FORMAT "%5.1"
 /begin AXIS_DESCR STD_AXIS Epm_nEng EngN 6 -16384.00 16383.50 FORMAT "%8.2" DEPOSIT ABSOLUTE /end AXIS_DESCR
/end CHARACTERISTIC
/begin CHARACTERISTIC IKCtl_facThdReqInjD_T "Threshold for cut off demand at pre-ignition" CURVE 0x805701D2 RB_Curve_S16_U8_Static 255.0 dez 0.00 255.0 FORMAT "%5.1"
 /begin AXIS_DESCR STD_AXIS Epm_nEng EngN 13 -16384.00 16383.50 FORMAT "%8.2" DEPOSIT ABSOLUTE /end AXIS_DESCR
/end CHARACTERISTIC
/begin CHARACTERISTIC IKCtl_facThdReqRedFillg_T "Curve for threshold of the air charge reduction at pre-ignition" CURVE 0x805701FC RB_Curve_S16_U8_Static 255.0 dez 0.00 255.0 FORMAT "%5.1"
 /begin AXIS_DESCR STD_AXIS Epm_nEng EngN 6 -16384.00 16383.50 FORMAT "%8.2" DEPOSIT ABSOLUTE /end AXIS_DESCR
/end CHARACTERISTIC
/begin CHARACTERISTIC IKCtl_facTiFastKnkPrem_GT "Delay time during fast ignition advancing" CURVE 0x8056FEF2 RB_CurveGroup_U8 25.50 t_q0p1 0.00 25.50 FORMAT "%5.2"
 /begin AXIS_DESCR COM_AXIS Epm_nEng EngN 8 -16384.00 16383.50 FORMAT "%8.2" AXIS_PTS_REF IKCtl_nEng08_X_AX /end AXIS_DESCR
/end CHARACTERISTIC
/begin CHARACTERISTIC IKCtl_facTiFilgRednRamp_T "Time constant for low pass filtering of the delta ignition angles at rising ramp to reduce air charge" CURVE 0x8056FEFA RB_Curve_S16_U16_Static 3276.750 t_q0p05 0.00 3276.750 FORMAT "%8.3"
 /begin AXIS_DESCR STD_AXIS Epm_nEng EngN 8 -16384.00 16383.50 FORMAT "%8.2" DEPOSIT ABSOLUTE /end AXIS_DESCR
/end CHARACTERISTIC
/begin CHARACTERISTIC IKCtl_facTiFilgRedn_T "Time constant for low pass filtering of the delta ignition angles at the falling ramp to restore air charge" CURVE 0x8056FF1C RB_Curve_S16_U16_Static 3276.750 t_q0p05 0.00 3276.750 FORMAT "%8.3"
 /begin AXIS_DESCR STD_AXIS Epm_nEng EngN 8 -16384.00 16383.50 FORMAT "%8.2" DEPOSIT ABSOLUTE /end AXIS_DESCR
/end CHARACTERISTIC
/begin CHARACTERISTIC IKCtl_facTipinFFV_GM "delta ignition angle at tip-in" MAP 0x8056F1B2 RB_MapGroup_S8 191.3 kw_q0p75 -96.00 95.25 FORMAT "%5.2"
 /begin AXIS_DESCR COM_AXIS Epm_nEng EngN 8 -16384.00 16383.50 FORMAT "%8.2" AXIS_PTS_REF IKCtl_nEng08_X_AX /end AXIS_DESCR
 /begin AXIS_DESCR COM_AXIS fethmnmx_msg fak_ub_b2 4 0.00 1.992188 FORMAT "%8.6" AXIS_PTS_REF IKCtl_fac04_X_AX /end AXIS_DESCR
/end CHARACTERISTIC
/begin CHARACTERISTIC IKCtl_facTThdLoadPreIgn "Temperature threshold for knock detection at pre-ignition" VALUE 0x8056F58E RB_Val_Ws16 6553.500 Temp_Cels -3549.940 3003.560 FORMAT "%8.3" /end CHARACTERISTIC
/begin CHARACTERISTIC IKCtl_iaOffsGdCyl_M "ignition retard offset for guided cylinder(nmot, cylinder)" MAP 0x8056F704 RB_Map_S16U8_S16 3276.800 zw_q0p1 -3276.800 0.00 FORMAT "%8.3" EXTENDED_LIMITS -3276.800 3276.700
 /begin AXIS_DESCR STD_AXIS Epm_nEng EngN 12 -16384.00 16383.50 FORMAT "%8.2" DEPOSIT ABSOLUTE /end AXIS_DESCR
 /begin AXIS_DESCR STD_AXIS IKCtl_nrCylFineResl_u8 OneToOne 8 0.00 255.0 FORMAT "%5.1" DEPOSIT ABSOLUTE /end AXIS_DESCR
/end CHARACTERISTIC
/begin CHARACTERISTIC IKCtl_iaOffsKnkSnsrErr_C "ignition retard offset for guided cylinders in case of knock sensor error" VALUE 0x8056F7E8 RB_Val_Ws16 12.00000 zw_q0p1 -12.00000 0.00 FORMAT "%8.5" EXTENDED_LIMITS -3276.800 3276.700 /end CHARACTERISTIC
/begin CHARACTERISTIC IKCtl_iaSftyRtdtFlexFu_M "Safety retardation for flex-fuel vehicles" MAP 0x8056FF3E RB_Map_S16S16_S8 20.25 kw_q0p75 -20.25 0.00 FORMAT "%5.2" EXTENDED_LIMITS -96.00 95.25
 /begin AXIS_DESCR STD_AXIS Epm_nEng EngN 8 -16384.00 16383.50 FORMAT "%8.2" DEPOSIT ABSOLUTE /end AXIS_DESCR
 /begin AXIS_DESCR STD_AXIS IKCtl_tEngLoc_s16 Temp_Cels 8 -3549.940 3003.560 FORMAT "%8.3" DEPOSIT ABSOLUTE /end AXIS_DESCR
/end CHARACTERISTIC
/begin CHARACTERISTIC IKCtl_iaSftyRtdt_M "Safety retardation" MAP 0x8056FFA2 RB_Map_S16S16_S8 20.25 kw_q0p75 -20.25 0.00 FORMAT "%5.2" EXTENDED_LIMITS -96.00 95.25
 /begin AXIS_DESCR STD_AXIS Epm_nEng EngN 8 -16384.00 16383.50 FORMAT "%8.2" DEPOSIT ABSOLUTE /end AXIS_DESCR
 /begin AXIS_DESCR STD_AXIS IKCtl_tEngLoc_s16 Temp_Cels 8 -3549.940 3003.560 FORMAT "%8.3" DEPOSIT ABSOLUTE /end AXIS_DESCR
/end CHARACTERISTIC
/begin AXIS_PTS IKCtl_nEng06_X_AX "Drehzahlstützstellen" 0x805578F4 Epm_nEng RB_Axis_S16 32767.50 EngN 6 -16384.00 16383.50 FORMAT "%8.2" DEPOSIT ABSOLUTE /end AXIS_PTS
/begin AXIS_PTS IKCtl_nEng08_X_AX "KC: Datapoint distribution engine speed of group B" 0x80557902 Epm_nEng RB_Axis_S16 32767.50 EngN 8 -16384.00 16383.50 FORMAT "%8.2" DEPOSIT ABSOLUTE /end AXIS_PTS
/begin AXIS_PTS IKCtl_nEngVar13_X_AX "KC: Datapoint distribution engine speed of group A" 0x80557930 Epm_nEng RB_Axis_S16 32767.50 EngN 13 -16384.00 16383.50 FORMAT "%8.2" DEPOSIT ABSOLUTE /end AXIS_PTS
/begin CHARACTERISTIC IKCtl_nrCmbPremDynOffs_M "number of combustions for reduction of retardation offset" CURVE 0x8056F1D2 RB_Curve_S16_U8_Static 255.0 dez 0.00 255.0 FORMAT "%5.1"
 /begin AXIS_DESCR STD_AXIS Epm_nEng EngN 8 -16384.00 16383.50 FORMAT "%8.2" DEPOSIT ABSOLUTE /end AXIS_DESCR
/end CHARACTERISTIC
/begin CHARACTERISTIC IKCtl_ratHysDelta_C "load hysteresis for activation areas" VALUE 0x80570210 RB_Val_Wu16 1535.977 rel_q0p0234 0.00 1535.977 FORMAT "%8.3" /end CHARACTERISTIC
/begin CHARACTERISTIC IKCtl_ratHysLoadPreIgn_C "Load hysteresis for knock detection at pre-ignition" VALUE 0x8056F590 RB_Val_Wu16 1535.977 rel_uw_q0p0234 0.00 1535.977 FORMAT "%8.3" /end CHARACTERISTIC
/begin AXIS_PTS IKCtl_ratLoad04_X_AX "basepoint distribution of air charge , 4 basepoints" 0x80557968 AirMod_ratChrgAirCyl RB_Axis_U16 1535.977 rel_uw_q0p0234 4 0.00 1535.977 FORMAT "%8.3" DEPOSIT ABSOLUTE /end AXIS_PTS
/begin CHARACTERISTIC IKCtl_ratLoadThdCvlci_T "load threshold for activation of camshaft adjustment" CURVE 0x80570212 RB_Curve_S16_U16_Static 1535.977 rel_q0p0234 0.00 1535.977 FORMAT "%8.3"
 /begin AXIS_DESCR STD_AXIS Epm_nEng EngN 6 -16384.00 16383.50 FORMAT "%8.2" DEPOSIT ABSOLUTE /end AXIS_DESCR
/end CHARACTERISTIC
/begin CHARACTERISTIC IKCtl_ratLoadThdEnchmt_T "load threshold for activation of enrichment" CURVE 0x8057022C RB_Curve_S16_U16_Static 1535.977 rel_q0p0234 0.00 1535.977 FORMAT "%8.3"
 /begin AXIS_DESCR STD_AXIS Epm_nEng EngN 6 -16384.00 16383.50 FORMAT "%8.2" DEPOSIT ABSOLUTE /end AXIS_DESCR
/end CHARACTERISTIC
/begin CHARACTERISTIC IKCtl_ratLoadThdGdCyl_CA "cylinder individual load limit, above which leading cylinder functionality is active" VAL_BLK 0x8056F7EA RB_ValA_Wu16 1535.977 rel_uw_q0p0234 0.00 1535.977 FORMAT "%8.3" NUMBER 4 /end CHARACTERISTIC
/begin CHARACTERISTIC IKCtl_ratLoadThdIaEta_T "threshold of load for limitation of the air charge through ignition angle retardation" CURVE 0x80570006 RB_Curve_S16_U16_Static 1535.977 rel_uw_q0p0234 0.00 1535.977 FORMAT "%8.3"
 /begin AXIS_DESCR STD_AXIS Epm_nEng EngN 8 -16384.00 16383.50 FORMAT "%8.2" DEPOSIT ABSOLUTE /end AXIS_DESCR
/end CHARACTERISTIC
/begin CHARACTERISTIC IKCtl_ratLoadThdInjD_T "load threshold for activation of fuel cut-off" CURVE 0x80570246 RB_Curve_S16_U16_Static 1535.977 rel_q0p0234 0.00 1535.977 FORMAT "%8.3"
 /begin AXIS_DESCR STD_AXIS Epm_nEng EngN 6 -16384.00 16383.50 FORMAT "%8.2" DEPOSIT ABSOLUTE /end AXIS_DESCR
/end CHARACTERISTIC
/begin CHARACTERISTIC IKCtl_ratLoadThdLlKnk_T "threshold of load for limitation of the air charge through ignition angle retardation" CURVE 0x80570028 RB_Curve_S16_U16_Static 1535.977 rel_uw_q0p0234 0.00 1535.977 FORMAT "%8.3"
 /begin AXIS_DESCR STD_AXIS Epm_nEng EngN 8 -16384.00 16383.50 FORMAT "%8.2" DEPOSIT ABSOLUTE /end AXIS_DESCR
/end CHARACTERISTIC
/begin CHARACTERISTIC IKCtl_ratLoadThdPreIgn_T "Load threshold for knock detection" CURVE 0x8056F592 RB_Curve_S16_U16_Static 1535.977 rel_uw_q0p0234 0.00 1535.977 FORMAT "%8.3"
 /begin AXIS_DESCR STD_AXIS Epm_nEng EngN 13 -16384.00 16383.50 FORMAT "%8.2" DEPOSIT ABSOLUTE /end AXIS_DESCR
/end CHARACTERISTIC
/begin CHARACTERISTIC IKCtl_stActvAreas_C "codeword for application of activation areas for measures" VALUE 0x80570260 RB_Val_Wu8 255.0 dez 0.00 255.0 FORMAT "%5.1" /end CHARACTERISTIC
/begin CHARACTERISTIC IKCtl_stCorrFil_C "knock control: correction of low pass characteristic at switch of filter mean frequency (50%)" VALUE 0x8056F38E RB_Val_Wu8 255.0 dez 0.00 255.0 FORMAT "%5.1" /end CHARACTERISTIC
/begin CHARACTERISTIC IKCtl_stKnkSeln_C "code word for k factor and reference level calculation" VALUE 0x8056F38F RB_Val_Wu8 255.0 dez 0.00 255.0 FORMAT "%5.1" /end CHARACTERISTIC
/begin CHARACTERISTIC IKCtl_stLimp_C "code word for limp home in case of one knock sensors fails" VALUE 0x8056F7F2 RB_Val_Wu8 255.0 dez 0.00 255.0 FORMAT "%5.1" /end CHARACTERISTIC
/begin CHARACTERISTIC IKCtl_stRefLvlReIni_C "codeword for reinitialization of reference level" VALUE 0x8056F390 RB_Val_Wu8 255.0 dez 0.00 255.0 FORMAT "%5.1" /end CHARACTERISTIC
/begin CHARACTERISTIC IKCtl_tiTmrAdv_M "time for ignition-advancing knock ingnition (fine resolution)" MAP 0x8057004A RB_Map_S16S16_S16 25.50000 t_q0p1 0.00 25.50000 FORMAT "%8.5" EXTENDED_LIMITS -3276.800 3276.700
 /begin AXIS_DESCR STD_AXIS Epm_nEng EngN 8 -16384.00 16383.50 FORMAT "%8.2" DEPOSIT ABSOLUTE /end AXIS_DESCR
 /begin AXIS_DESCR STD_AXIS IKCtl_agRtdtCurrOutp_s16 zw_q0p1 4 -3276.800 3276.700 FORMAT "%8.3" DEPOSIT ABSOLUTE /end AXIS_DESCR
/end CHARACTERISTIC
/begin CHARACTERISTIC IKCtl_wStrtEndRef_C "initialization value for pre ignition reference level at start end" VALUE 0x8056F5C8 RB_Val_Wu32 3276.79999924 spg_q7p629Em7_V_ms 0.00 3276.79999924 FORMAT "%13.8" /end CHARACTERISTIC
/begin CHARACTERISTIC IKCtl_wStrtRef_C "initialization value for reference level" VALUE 0x8056F394 RB_Val_Wu32 3276.79999924 spg_q7p629Em7_V_ms 0.00 3276.79999924 FORMAT "%13.8" /end CHARACTERISTIC
/begin CHARACTERISTIC KFKR2INT1G "knock control: weighting integration value channel 1" MAP 0x8056F5CC RB_Map_U8U8_S8 3.000 fak_q0p03125 -1.000 2.000 FORMAT "%5.3" EXTENDED_LIMITS -4.000 3.969
 /begin AXIS_DESCR STD_AXIS IKCtl_cntrCyl dez 4 0.00 255.0 FORMAT "%5.1" DEPOSIT ABSOLUTE /end AXIS_DESCR
 /begin AXIS_DESCR STD_AXIS IKCtl_idxFilSwt dez 5 0.00 255.0 FORMAT "%5.1" DEPOSIT ABSOLUTE /end AXIS_DESCR
/end CHARACTERISTIC
/begin CHARACTERISTIC KFKR2INT2G "knock control: weighting integration value channel 2" MAP 0x8056F5EC RB_Map_U8U8_S8 3.000 fak_q0p03125 -1.000 2.000 FORMAT "%5.3" EXTENDED_LIMITS -4.000 3.969
 /begin AXIS_DESCR STD_AXIS IKCtl_cntrCyl dez 4 0.00 255.0 FORMAT "%5.1" DEPOSIT ABSOLUTE /end AXIS_DESCR
 /begin AXIS_DESCR STD_AXIS IKCtl_idxFilSwt dez 5 0.00 255.0 FORMAT "%5.1" DEPOSIT ABSOLUTE /end AXIS_DESCR
/end CHARACTERISTIC
/begin CHARACTERISTIC KFKR2INT3G "knock control: weighting integration value channel 3" MAP 0x8056F60C RB_Map_U8U8_S8 3.000 fak_q0p03125 -1.000 2.000 FORMAT "%5.3" EXTENDED_LIMITS -4.000 3.969
 /begin AXIS_DESCR STD_AXIS IKCtl_cntrCyl dez 4 0.00 255.0 FORMAT "%5.1" DEPOSIT ABSOLUTE /end AXIS_DESCR
 /begin AXIS_DESCR STD_AXIS IKCtl_idxFilSwt dez 5 0.00 255.0 FORMAT "%5.1" DEPOSIT ABSOLUTE /end AXIS_DESCR
/end CHARACTERISTIC
/begin CHARACTERISTIC KFKRINT1G "knock control: weighting integration value channel 1" MAP 0x8056F398 RB_Map_U8U8_S8 3.000 fak_q0p03125 -1.000 2.000 FORMAT "%5.3" EXTENDED_LIMITS -4.000 3.969
 /begin AXIS_DESCR STD_AXIS IKCtl_cntrCyl dez 4 0.00 255.0 FORMAT "%5.1" DEPOSIT ABSOLUTE /end AXIS_DESCR
 /begin AXIS_DESCR STD_AXIS IKCtl_idxFilSwt dez 5 0.00 255.0 FORMAT "%5.1" DEPOSIT ABSOLUTE /end AXIS_DESCR
/end CHARACTERISTIC
/begin CHARACTERISTIC KFKRINT2G "knock control: weighting integration value channel 2" MAP 0x8056F3B8 RB_Map_U8U8_S8 3.000 fak_q0p03125 -1.000 2.000 FORMAT "%5.3" EXTENDED_LIMITS -4.000 3.969
 /begin AXIS_DESCR STD_AXIS IKCtl_cntrCyl dez 4 0.00 255.0 FORMAT "%5.1" DEPOSIT ABSOLUTE /end AXIS_DESCR
 /begin AXIS_DESCR STD_AXIS IKCtl_idxFilSwt dez 5 0.00 255.0 FORMAT "%5.1" DEPOSIT ABSOLUTE /end AXIS_DESCR
/end CHARACTERISTIC
/begin CHARACTERISTIC KFKRINT3G "knock control: weighting integration value channel 3" MAP 0x8056F3D8 RB_Map_U8U8_S8 3.000 fak_q0p03125 -1.000 2.000 FORMAT "%5.3" EXTENDED_LIMITS -4.000 3.969
 /begin AXIS_DESCR STD_AXIS IKCtl_cntrCyl dez 4 0.00 255.0 FORMAT "%5.1" DEPOSIT ABSOLUTE /end AXIS_DESCR
 /begin AXIS_DESCR STD_AXIS IKCtl_idxFilSwt dez 5 0.00 255.0 FORMAT "%5.1" DEPOSIT ABSOLUTE /end AXIS_DESCR
/end CHARACTERISTIC
/begin CHARACTERISTIC KFLAMHAP "desired lambda for application homogeneous mode" MAP 0x805709DC RB_Map_U16U16_U16 15.99976 fak_uw_b16 0.00 15.99976 FORMAT "%8.5"
 /begin AXIS_DESCR STD_AXIS NO_INPUT_QUANTITY nmot_uw_q0p25 16 0.00 16383.75 FORMAT "%8.2" DEPOSIT ABSOLUTE /end AXIS_DESCR
 /begin AXIS_DESCR STD_AXIS NO_INPUT_QUANTITY rel_uw_q0p0234 12 0.00 1535.977 FORMAT "%8.3" DEPOSIT ABSOLUTE /end AXIS_DESCR
/end CHARACTERISTIC
/begin CHARACTERISTIC KFLANS "map lambda engine during afterstart" MAP 0x80571078 RB_Map_U8U16_U16 15.99976 fak_uw_b16 0.00 15.99976 FORMAT "%8.5"
 /begin AXIS_DESCR STD_AXIS tmstlanswl temp_ub_q0p75_o48 12 -48.0 143.3 FORMAT "%5.1" DEPOSIT ABSOLUTE /end AXIS_DESCR
 /begin AXIS_DESCR STD_AXIS anztib1_w_Loc dez 12 0.00 65535.00 FORMAT "%8.2" DEPOSIT ABSOLUTE /end AXIS_DESCR
/end CHARACTERISTIC
/begin CHARACTERISTIC KFLANSETH "map lambda engine during afterstart wih E85" MAP 0x805711BE RB_Map_U8U16_U16 15.99976 fak_uw_b16 0.00 15.99976 FORMAT "%8.5"
 /begin AXIS_DESCR STD_AXIS tmstlanswl temp_ub_q0p75_o48 12 -48.0 143.3 FORMAT "%5.1" DEPOSIT ABSOLUTE /end AXIS_DESCR
 /begin AXIS_DESCR STD_AXIS anztib1_w_Loc dez 12 0.00 65535.00 FORMAT "%8.2" DEPOSIT ABSOLUTE /end AXIS_DESCR
/end CHARACTERISTIC
/begin CHARACTERISTIC KFLASWLRTE "map lambda engine nominal at warming up with active AF control for E85" MAP 0x80571304 RB_Map_U8U8_U8 1.992188 fak_ub_b2 0.00 1.992188 FORMAT "%8.6"
 /begin AXIS_DESCR STD_AXIS tmotlanswl temp_ub_q0p75_o48 12 -48.0 143.3 FORMAT "%5.1" DEPOSIT ABSOLUTE /end AXIS_DESCR
 /begin AXIS_DESCR STD_AXIS tmstlanswl temp_ub_q0p75_o48 12 -48.0 143.3 FORMAT "%5.1" DEPOSIT ABSOLUTE /end AXIS_DESCR
/end CHARACTERISTIC
/begin CHARACTERISTIC KFLASWLRTX "map lambda engine nominal at warming up with active lambda control" MAP 0x805713AE RB_Map_U8U8_U8 1.992188 fak_ub_b2 0.00 1.992188 FORMAT "%8.6"
 /begin AXIS_DESCR STD_AXIS tmotlanswl temp_ub_q0p75_o48 12 -48.0 143.3 FORMAT "%5.1" DEPOSIT ABSOLUTE /end AXIS_DESCR
 /begin AXIS_DESCR STD_AXIS tmstlanswl temp_ub_q0p75_o48 12 -48.0 143.3 FORMAT "%5.1" DEPOSIT ABSOLUTE /end AXIS_DESCR
/end CHARACTERISTIC
/begin CHARACTERISTIC KFLMSKH "Performance characteristics lambda engine nominal at catalyst heating" MAP 0x8057086A RB_Map_S16U16_U16 8.000000 fak_q0p000244 0.00 8.000000 FORMAT "%8.6" EXTENDED_LIMITS 0.00 15.99976
 /begin AXIS_DESCR STD_AXIS Epm_nEng EngN 8 -16384.00 16383.50 FORMAT "%8.2" DEPOSIT ABSOLUTE /end AXIS_DESCR
 /begin AXIS_DESCR STD_AXIS AirMod_ratChrgAirCyl rel_uw_q0p0234 8 0.00 1535.977 FORMAT "%8.3" DEPOSIT ABSOLUTE /end AXIS_DESCR
/end CHARACTERISTIC
/begin CHARACTERISTIC KFLMSKHSF "Performance characteristics lambda engine nominal at catalyst heating (second fuel, for instande FFV or CNG)" MAP 0x8057090E RB_Map_S16U16_U16 8.000000 fak_q0p000244 0.00 8.000000 FORMAT "%8.6" EXTENDED_LIMITS 0.00 15.99976
 /begin AXIS_DESCR STD_AXIS Epm_nEng EngN 8 -16384.00 16383.50 FORMAT "%8.2" DEPOSIT ABSOLUTE /end AXIS_DESCR
 /begin AXIS_DESCR STD_AXIS AirMod_ratChrgAirCyl rel_uw_q0p0234 8 0.00 1535.977 FORMAT "%8.3" DEPOSIT ABSOLUTE /end AXIS_DESCR
/end CHARACTERISTIC
/begin CHARACTERISTIC KLFRKRINI "curve of multiplcativ factor to reinitialize the reference level" CURVE 0x8056F3F8 RB_CurveGroup_U8 15.88 fak_ub_b16 0.06 15.94 FORMAT "%5.2" EXTENDED_LIMITS 0.00 15.94
 /begin AXIS_DESCR COM_AXIS Epm_nEng EngN 13 -16384.00 16383.50 FORMAT "%8.2" AXIS_PTS_REF IKCtl_nEngVar13_X_AX /end AXIS_DESCR
/end CHARACTERISTIC
/begin CHARACTERISTIC KLLAKHFH "ambient pressure correction lambda catalyst heating" CURVE 0x805709B2 RB_Curve_U16_U16 1.999969 fak_uw_b2 0.00 1.999969 FORMAT "%8.6"
 /begin AXIS_DESCR STD_AXIS PEnv_facCorrAlti fak_uw_b4 4 0.00 3.999939 FORMAT "%8.6" DEPOSIT ABSOLUTE /end AXIS_DESCR
/end CHARACTERISTIC
/begin CHARACTERISTIC KLNRWCY "curve for the demanded number of working cycles for cylinder individual fuel enrichment" CURVE 0x80570262 RB_Curve_S16_U8_Static 255.0 dez 0.00 255.0 FORMAT "%5.1"
 /begin AXIS_DESCR STD_AXIS Epm_nEng EngN 6 -16384.00 16383.50 FORMAT "%8.2" DEPOSIT ABSOLUTE /end AXIS_DESCR
/end CHARACTERISTIC
/begin CHARACTERISTIC KLRKRMN "minimal reference level during idle or quiet operation mode" CURVE 0x8056F406 RB_CurveGroup_U16 25.59922 spg_q3p906Em4_V_ms 0.00039 25.59961 FORMAT "%8.5" EXTENDED_LIMITS 0.00 25.59961
 /begin AXIS_DESCR COM_AXIS Epm_nEng EngN 13 -16384.00 16383.50 FORMAT "%8.2" AXIS_PTS_REF IKCtl_nEngVar13_X_AX /end AXIS_DESCR
/end CHARACTERISTIC
/begin CHARACTERISTIC KLRLVEN2 "Curve for factor to permanently reduce air charge as substitution measurement of cut off" CURVE 0x80570276 RB_Curve_S16_U16_Static 1.000000 fak_uw_b2 0.00 1.000000 FORMAT "%8.6" EXTENDED_LIMITS 0.00 1.999969
 /begin AXIS_DESCR STD_AXIS Epm_nEng EngN 8 -16384.00 16383.50 FORMAT "%8.2" DEPOSIT ABSOLUTE /end AXIS_DESCR
/end CHARACTERISTIC
/begin CHARACTERISTIC KR2FTP2 "low pass characteristic at engine speed dynamics; reference level knocking2" VALUE 0x8056F62C RB_Val_Wu8 14.00 dez 2.00 16.00 FORMAT "%5.2" EXTENDED_LIMITS 0.00 255.0 /end CHARACTERISTIC
/begin CHARACTERISTIC KR2FTP3 "low pass characteristic at load dynamic; reference level knocking2" VALUE 0x8056F62D RB_Val_Wu8 14.00 dez 2.00 16.00 FORMAT "%5.2" EXTENDED_LIMITS 0.00 255.0 /end CHARACTERISTIC
/begin CHARACTERISTIC KR2KFKS "selected knock detection2 threshold, if missing cylinder one detection" VALUE 0x8056F62E RB_Val_Wu8 7.000 dez 0.00 7.000 FORMAT "%5.3" EXTENDED_LIMITS 0.00 255.0 /end CHARACTERISTIC
/begin CHARACTERISTIC KRFTP2 "low pass characteristic at engine speed dynamics" VALUE 0x8056F420 RB_Val_Wu8 14.00 dez 2.00 16.00 FORMAT "%5.2" EXTENDED_LIMITS 0.00 255.0 /end CHARACTERISTIC
/begin CHARACTERISTIC KRFTP3 "low pass characteristic at load dynamic" VALUE 0x8056F421 RB_Val_Wu8 14.00 dez 2.00 16.00 FORMAT "%5.2" EXTENDED_LIMITS 0.00 255.0 /end CHARACTERISTIC
/begin CHARACTERISTIC KRKFKS "selected knock detection threshold, if missing cylinder one detection" VALUE 0x8056F422 RB_Val_Wu8 7.000 dez 0.00 7.000 FORMAT "%5.3" EXTENDED_LIMITS 0.00 255.0 /end CHARACTERISTIC
/begin CHARACTERISTIC KRNGFILO "No foozen values upper KRNGFILO" VALUE 0x8056F423 RB_Val_Ws8 25500. nmotg_sb_q100 -12800. 12700. FORMAT "%5.0" /end CHARACTERISTIC
/begin CHARACTERISTIC KRNGFILU "No foozen values lower KRNGFILO" VALUE 0x8056F424 RB_Val_Ws8 25500. nmotg_sb_q100 -12800. 12700. FORMAT "%5.0" /end CHARACTERISTIC
/begin CHARACTERISTIC KROFFV "Threshold: knock control near to its limite with flexfuel" VALUE 0x805700A6 RB_Val_Ws8 191.3 kw_q0p75 -96.00 95.25 FORMAT "%5.2" /end CHARACTERISTIC
/begin CHARACTERISTIC KRTNSEO "Knock control: switch off time threshold" VALUE 0x8056F16C RB_Val_Wu16 6553.500 t100msxs_uw_b6553p5 0.00 6553.500 FORMAT "%8.3" /end CHARACTERISTIC
/begin CHARACTERISTIC KRVEZ "Number of working cycles to decrement the pre ignition counter ctrveev (path fuel cut off)" VALUE 0x80570298 RB_Val_Wu8 255.0 dez 0.00 255.0 FORMAT "%5.1" /end CHARACTERISTIC
/begin CHARACTERISTIC KRVFZGO "Knock control: vehicle speed threshold" VALUE 0x8056F16E RB_Val_Ws16 655.3500 Vel -327.6800 327.6700 FORMAT "%8.4" /end CHARACTERISTIC
/begin CHARACTERISTIC LamCtrl_ratLamSpCdaGbx_Crv "Target lambda for fuel cut off during gear box intervention" CURVE 0x80570B98 RB_Curve_U16_U8_Static 1.992188 fak_ub_b2 0.00 1.992188 FORMAT "%8.6"
 /begin AXIS_DESCR STD_AXIS NO_INPUT_QUANTITY fak_uw_b16 4 0.00 15.99976 FORMAT "%8.5" DEPOSIT ABSOLUTE /end AXIS_DESCR
/end CHARACTERISTIC
/begin CHARACTERISTIC LamCtrl_ratLamSpFcoB1_M "Lambda setpoint during fuel cut-off or cylinder deactivation, bank 1" MAP 0x80570BA6 RB_Map_U16U16_U8 1.992188 fak_ub_b2 0.00 1.992188 FORMAT "%8.6"
 /begin AXIS_DESCR STD_AXIS NO_INPUT_QUANTITY temp_q0p0234_o273 8 -273.150 1262.827 FORMAT "%8.3" DEPOSIT ABSOLUTE /end AXIS_DESCR
 /begin AXIS_DESCR STD_AXIS LamCtrl_mfExhCat1B1 m_uw_b6553p5 8 0.00 6553.500 FORMAT "%8.3" DEPOSIT ABSOLUTE /end AXIS_DESCR
/end CHARACTERISTIC
/begin CHARACTERISTIC LAMHAP "desired lambda for application homogeneous mode" VALUE 0x80570C0A RB_Val_Wu16 15.99976 fak_uw_b16 0.00 15.99976 FORMAT "%8.5" /end CHARACTERISTIC
/begin CHARACTERISTIC LAMXHOMKH "Maximum lambda request for catalyst heating while homogenous operation" VALUE 0x805709C4 RB_Val_Wu16 15.99976 fak_q0p000244 0.00 15.99976 FORMAT "%8.5" /end CHARACTERISTIC
/begin CHARACTERISTIC LASOABDMD "lambda setpoint in combustion chamber during catalyst damaging misfire" VALUE 0x80570C0C RB_Val_Wu8 1.992188 fak_ub_b2 0.00 1.992188 FORMAT "%8.6" /end CHARACTERISTIC
/begin CHARACTERISTIC LASWLTX "offset lambda engine nominal with inactive lambda control" CURVE 0x80571458 RB_Curve_U8_S8_Static 1.992 fak_sb_b1 -1.000 0.992 FORMAT "%5.3" EXTENDED_LIMITS -1.000 0.9922
 /begin AXIS_DESCR STD_AXIS tmotlanswl temp_ub_q0p75_o48 12 -48.0 143.3 FORMAT "%5.1" DEPOSIT ABSOLUTE /end AXIS_DESCR
/end CHARACTERISTIC
/begin CHARACTERISTIC LIGov_ExtTrqDemMskSeln_CW "selection alternative bit mask for external torque demands" VALUE 0x80571788 RB_Val_Wu16 65535.00 OneToOne 0.00 65535.00 FORMAT "%8.2" /end CHARACTERISTIC
/begin CHARACTERISTIC LIGov_facCatHeatgAlti_C "Factor parameter selection cat heating in altitude" VALUE 0x8057178A RB_Val_Wu8 3.984 fak_ub_b4 0.00 3.984 FORMAT "%5.3" /end CHARACTERISTIC
/begin CHARACTERISTIC LIGov_facDeadZoneEngLoad_T "Factor dead zone on engine load level for modification of pre-control-torque dependend on set- and actual-speed" CURVE 0x80571494 RB_Curve_U16_U16 4.999924 fak_uw_b5 0.00 4.999924 FORMAT "%8.6"
 /begin AXIS_DESCR STD_AXIS LIGov_nDiffNSetNEng fak_uw_b2 6 0.00 1.999969 FORMAT "%8.6" DEPOSIT ABSOLUTE /end AXIS_DESCR
/end CHARACTERISTIC
/begin CHARACTERISTIC LIGov_facEngLoadLvl_M "Engine load level factor for modification of pre-control-torque during engine start" MAP 0x805714AE RB_Map_U8U16_U16 0.9960938 fak_ub_b1 0.00 0.9960938 FORMAT "%9.7" EXTENDED_LIMITS 0.00 255.9961
 /begin AXIS_DESCR STD_AXIS LIGov_tStrtloc temp_ub_q0p75_o48 6 -48.0 143.3 FORMAT "%5.1" DEPOSIT ABSOLUTE /end AXIS_DESCR
 /begin AXIS_DESCR STD_AXIS tnst_w_msg t_q0p01 6 0.00 655.3500 FORMAT "%8.4" DEPOSIT ABSOLUTE /end AXIS_DESCR
/end CHARACTERISTIC
/begin CHARACTERISTIC LIGov_facPreCtlRmpDwn_C "Step width of the ramp for precontrol of the drag torque of the engine when ramping downwards" VALUE 0x8057150A RB_Val_Wu16 0.9999695 fak_q3p0518Em5 0.000031 1.000000 FORMAT "%8.6" EXTENDED_LIMITS 0.00 1.999969 /end CHARACTERISTIC
/begin CHARACTERISTIC LIGov_facPreCtlRmpGrip_C "Step width of the ramp for precontrol of the drag torque of the engine with closed powertrain" VALUE 0x8057150C RB_Val_Wu16 0.9999695 fak_uw_b2 0.000031 1.000000 FORMAT "%8.6" EXTENDED_LIMITS 0.00 1.999969 /end CHARACTERISTIC
/begin CHARACTERISTIC LIGov_facPreCtlRmpNoGrip_C "Step width of the ramp for precontrol of the drag torque of the engine with open powertrain" VALUE 0x8057150E RB_Val_Wu16 0.9999695 fak_uw_b2 0.000031 1.000000 FORMAT "%8.6" EXTENDED_LIMITS 0.00 1.999969 /end CHARACTERISTIC
/begin CHARACTERISTIC LIGov_facTrqMax_CUR "engine speed dependent factor for limitation of maximum idle speed governor torque" CURVE 0x80571510 RB_Curve_S16_U16_Static 1.000000 fak_uw_b2 0.00 1.000000 FORMAT "%8.6" EXTENDED_LIMITS 0.00 1.999969
 /begin AXIS_DESCR STD_AXIS Epm_nEng EngN 6 -16384.00 16383.50 FORMAT "%8.2" DEPOSIT ABSOLUTE /end AXIS_DESCR
/end CHARACTERISTIC
/begin CHARACTERISTIC LIGov_flgMskLLimIfFcoReqd_C "Flag to mask active bit position of LLim in GlbDa_stTrqDem when fuel cut-off is requested." VALUE 0x8057178B RB_Val_Wu8 1.00000000000 B_TRUE 0.00 1.00000000000 FORMAT "%13.11" /end CHARACTERISTIC
/begin CHARACTERISTIC LIGov_flgSrvCouplrSwtCdnDi_C "Service coupler disable calibration" VALUE 0x8057152A RB_Val_Wboolean 1.00000000000 B_TRUE 0.00 1.00000000000 FORMAT "%13.11" /end CHARACTERISTIC
/begin CHARACTERISTIC LIGov_Gov_CW "Codeword Governor Module" VALUE 0x8057152B RB_Val_Wu8 255.0 dez 0.00 255.0 FORMAT "%5.1" /end CHARACTERISTIC
/begin CHARACTERISTIC LIGov_nExtTrqDemSelnSpOffs_C "offset speed difference alternative bit mask for external torque demands" VALUE 0x8057178C RB_Val_Ws16 32767.50 nmot_sw_q0p5 -16384.00 16383.50 FORMAT "%8.2" /end CHARACTERISTIC
/begin CHARACTERISTIC LIGov_nExtTrqDemSelnThd_C "threshold engine speed alternative bit mask for external torque demands" VALUE 0x8057178E RB_Val_Ws16 32767.50 nmot_sw_q0p5 -16384.00 16383.50 FORMAT "%8.2" /end CHARACTERISTIC
/begin CHARACTERISTIC LIGov_nLimHi_C "Upper speed limit for controller activity" VALUE 0x80571790 RB_Val_Ws16 32767.50 nmot_q0p5 -16384.00 16383.50 FORMAT "%8.2" /end CHARACTERISTIC
/begin CHARACTERISTIC LIGov_nOffs_C "Engine speed setpoint Offset" VALUE 0x80571792 RB_Val_Ws16 32767.50 nmot_sw_q0p5 -16384.00 16383.50 FORMAT "%8.2" /end CHARACTERISTIC
/begin CHARACTERISTIC LIGov_nOfsPreCtlRstrt_C "speed offset for re-ignition" VALUE 0x80571794 RB_Val_Ws16 32767.50 nmot_q0p5 -16384.00 16383.50 FORMAT "%8.2" /end CHARACTERISTIC
/begin CHARACTERISTIC LIGov_nOfsPreCtlTrqDem_C "speed offset for external torque demand" VALUE 0x80571796 RB_Val_Ws16 32767.50 nmot_q0p5 -16384.00 16383.50 FORMAT "%8.2" /end CHARACTERISTIC
/begin CHARACTERISTIC LIGov_nOfsPreCtl_C "speed offset for precontrol" VALUE 0x80571798 RB_Val_Ws16 32767.50 nmot_q0p5 -16384.00 16383.50 FORMAT "%8.2" /end CHARACTERISTIC
/begin CHARACTERISTIC LIGov_nOfsPredef_C "speed offset for predefined torque" VALUE 0x8057179A RB_Val_Ws16 32767.50 nmot_q0p5 -16384.00 16383.50 FORMAT "%8.2" /end CHARACTERISTIC
/begin CHARACTERISTIC LIGov_nOfsUbr_C "speed offset for underbraking" VALUE 0x8057179C RB_Val_Ws16 32767.50 nmot_q0p5 -16384.00 16383.50 FORMAT "%8.2" /end CHARACTERISTIC
/begin CHARACTERISTIC LIGov_nThresPreCtlLo_T "Speed deviation threshold for activation D-part due to underspeed" CURVE 0x8057179E RB_Curve_S16_S16 32767.50 nmot_sw_q0p5 -16384.00 16383.50 FORMAT "%8.2"
 /begin AXIS_DESCR STD_AXIS HLSDem_nSetPLo nmot_sw_q0p5 4 -16384.00 16383.50 FORMAT "%8.2" DEPOSIT ABSOLUTE /end AXIS_DESCR
/end CHARACTERISTIC
/begin CHARACTERISTIC LIGov_numParCnv_CUR "Curve for the conversion of LIGov_numPar in a P- and an I-part" CURVE 0x80571474 RB_Curve_U8_U8 255.0 dez 0.00 255.0 FORMAT "%5.1"
 /begin AXIS_DESCR STD_AXIS LIGov_numPar dez 14 0.00 255.0 FORMAT "%5.1" DEPOSIT ABSOLUTE /end AXIS_DESCR
/end CHARACTERISTIC
/begin CHARACTERISTIC LIGov_pwrMax_C "maximum engine power for limitation of the torque of the idle speed controller depending on engine speed" VALUE 0x8057152C RB_Val_Ws32 214748364.750 mdgrad_q0p05 -107374182.400 107374182.350 FORMAT "%13.3" /end CHARACTERISTIC
/begin CHARACTERISTIC LIGov_rExtTrqDemMskSelnAppThd_C "threshold accelerator pedal angle alternative bit mask for external torque demands" VALUE 0x805717B0 RB_Val_Ws16 799.9878 Prc -400.0000 399.9878 FORMAT "%8.4" /end CHARACTERISTIC
/begin CHARACTERISTIC LIGov_rGripThres_C "Threshold for grip detection within low idle speed controller" VALUE 0x805717B2 RB_Val_Ws16 655.3500 Fact100 -327.6800 327.6700 FORMAT "%8.4" /end CHARACTERISTIC
/begin CHARACTERISTIC LIGov_SelPar2_CW "Codeword 2 for LIGov parameter selection" VALUE 0x805717B4 RB_Val_Wu8 255.0 dez 0.00 255.0 FORMAT "%5.1" /end CHARACTERISTIC
/begin CHARACTERISTIC LIGov_SelPar_CW "Codeword for LIGov parameter selection" VALUE 0x805717B6 RB_Val_Wu16 65535.00 dez 0.00 65535.00 FORMAT "%8.2" /end CHARACTERISTIC
/begin CHARACTERISTIC LIGov_stBrkThres_C "status threshold for underbraking detection" VALUE 0x805717B8 RB_Val_Wu8 255.0 dez 0.00 255.0 FORMAT "%5.1" /end CHARACTERISTIC
/begin CHARACTERISTIC LIGov_stExtTrqDemMskAltv_C "alternative bitmask for external torque demands to be considered in idle speed governor" VALUE 0x805717BA RB_Val_Wu16 65535.00 OneToOne 0.00 65535.00 FORMAT "%8.2" /end CHARACTERISTIC
/begin CHARACTERISTIC LIGov_stExtTrqDemMskSelnBrk_C "break switch state alternative bit mask for external torque demands" VALUE 0x805717BC RB_Val_Wu8 255.0 OneToOne 0.00 255.0 FORMAT "%5.1" /end CHARACTERISTIC
/begin CHARACTERISTIC LIGov_stExtTrqDemMsk_C "bitmask for external torque demands to be considered in idle speed governor" VALUE 0x805717BE RB_Val_Wu16 65535.00 OneToOne 0.00 65535.00 FORMAT "%8.2" /end CHARACTERISTIC
/begin CHARACTERISTIC LIGov_swtBll_C "Idle speed dependency selection switch" VALUE 0x805717C0 RB_Val_Wu8 1.00000000000 B_TRUE 0.00 1.00000000000 FORMAT "%13.11" /end CHARACTERISTIC
/begin CHARACTERISTIC LIGov_swtNoGrip_C "Open Powertrain selection switch" VALUE 0x805717C1 RB_Val_Wu8 1.00000000000 B_TRUE 0.00 1.00000000000 FORMAT "%13.11" /end CHARACTERISTIC
/begin CHARACTERISTIC LIGov_tEngXHi_C "upper engine temperature threshold" VALUE 0x805717C2 RB_Val_Ws16 6553.500 temp_q0p1_o273 -3549.940 3003.560 FORMAT "%8.3" /end CHARACTERISTIC
/begin CHARACTERISTIC LIGov_tEngXLo_C "lower engine temperature threshold" VALUE 0x805717C4 RB_Val_Ws16 6553.500 temp_q0p1_o273 -3549.940 3003.560 FORMAT "%8.3" /end CHARACTERISTIC
/begin CHARACTERISTIC LIGov_tiDlyPreCtl_C "time delay D-part calculation" VALUE 0x805717C6 RB_Val_Wu16 31.99951 t_tev0p0005 0.00 31.99951 FORMAT "%8.5" /end CHARACTERISTIC
/begin CHARACTERISTIC LIGov_tiEnblI_CUR "time delay for I-part release after start" CURVE 0x805717C8 RB_Curve_S16_U16_Static 31.99951 t_tev0p0005 0.00 31.99951 FORMAT "%8.5"
 /begin AXIS_DESCR STD_AXIS EngDa_tEng temp_q0p1_o273 6 -3549.940 3003.560 FORMAT "%8.3" DEPOSIT ABSOLUTE /end AXIS_DESCR
/end CHARACTERISTIC
/begin CHARACTERISTIC LIGov_tiFrzIDly_C "time delay I-part calculation" VALUE 0x805717E2 RB_Val_Wu16 31.99951 t_tev0p0005 0.00 31.99951 FORMAT "%8.5" /end CHARACTERISTIC
/begin CHARACTERISTIC LIGov_tiGrip_C "time delay clutch opens" VALUE 0x805717E4 RB_Val_Wu16 31.99951 t_tev0p0005 0.00 31.99951 FORMAT "%8.5" /end CHARACTERISTIC
/begin CHARACTERISTIC LIGov_tiPLeadOfs_C "time constant for P-part air path offset filter" VALUE 0x80571530 RB_Val_Wu16 2047.969 t_q3p125em2 0.00 2047.969 FORMAT "%8.3" /end CHARACTERISTIC
/begin CHARACTERISTIC LIGov_tiStrtPar_C "time delay for shutting down the parameter set for start with underspeed" VALUE 0x805717E6 RB_Val_Ws16 10485.60 TimeRed -5242.880 5242.720 FORMAT "%8.3" /end CHARACTERISTIC
/begin CHARACTERISTIC LIGov_tqIntglSrvCouplrSwtActv_M "Integral torque when SCS is active" MAP 0x80571532 RB_Map_S16U8_S16 6553.500 md_q0p1 -3276.800 3276.700 FORMAT "%8.3"
 /begin AXIS_DESCR STD_AXIS LIGov_nDiff nmot_q0p5 8 -16384.00 16383.50 FORMAT "%8.2" DEPOSIT ABSOLUTE /end AXIS_DESCR
 /begin AXIS_DESCR STD_AXIS LIGov_numParTrqI dez 6 0.00 255.0 FORMAT "%5.1" DEPOSIT ABSOLUTE /end AXIS_DESCR
/end CHARACTERISTIC
/begin CHARACTERISTIC LIGov_tqMin_C "Minimum torque LIGov_trqMin of the idle-speed governor." VALUE 0x805715AC RB_Val_Ws16 6553.500 md_q0p1 -3276.800 3276.700 FORMAT "%8.3" /end CHARACTERISTIC
/begin CHARACTERISTIC LIGov_trqDeltaWndUpMax_C "delta torque for freeze of integrator at maximal torque" VALUE 0x805717E8 RB_Val_Ws16 6553.500 md_q0p1 -3276.800 3276.700 FORMAT "%8.3" /end CHARACTERISTIC
/begin CHARACTERISTIC LIGov_trqDeltaWndUpMin_C "delta torque for freeze of integrator at minimal torque" VALUE 0x805717EA RB_Val_Ws16 6553.500 md_q0p1 -3276.800 3276.700 FORMAT "%8.3" /end CHARACTERISTIC
/begin CHARACTERISTIC LIGov_trqDiffMaxParChng_C "Maximal difference between Set and Lead torque for I-Part offset during parameter change" VALUE 0x805715AE RB_Val_Ws16 6553.500 md_q0p1 -3276.800 3276.700 FORMAT "%8.3" /end CHARACTERISTIC
/begin CHARACTERISTIC LIGov_trqI_MAP "Map for I-part of low idle governor (number of parameter sets = LIGOV_NUMIPAR_SY )" MAP 0x805715B0 RB_Map_S16U8_S16 6553.500 md_q0p1 -3276.800 3276.700 FORMAT "%8.3"
 /begin AXIS_DESCR STD_AXIS LIGov_nDiff nmot_q0p5 8 -16384.00 16383.50 FORMAT "%8.2" DEPOSIT ABSOLUTE /end AXIS_DESCR
 /begin AXIS_DESCR STD_AXIS LIGov_numParTrqI dez 6 0.00 255.0 FORMAT "%5.1" DEPOSIT ABSOLUTE /end AXIS_DESCR
/end CHARACTERISTIC
/begin CHARACTERISTIC LIGov_trqMaxI_CUR "curve for maximum torque limitation for I-part" CURVE 0x8057162A RB_Curve_S16_S16 6553.500 md_q0p1 -3276.800 3276.700 FORMAT "%8.3"
 /begin AXIS_DESCR STD_AXIS HLSDem_nSetPLoDiff nmot_sw_q0p5 8 -16384.00 16383.50 FORMAT "%8.2" DEPOSIT ABSOLUTE /end AXIS_DESCR
/end CHARACTERISTIC
/begin CHARACTERISTIC LIGov_trqMax_C "maximal idle speed torque" VALUE 0x8057164C RB_Val_Ws16 6553.500 md_q0p1 -3276.800 3276.700 FORMAT "%8.3" /end CHARACTERISTIC
/begin CHARACTERISTIC LIGov_trqOfsHi_C "offset for speed dependent limitation" VALUE 0x8057164E RB_Val_Ws16 6553.500 md_q0p1 -3276.800 3276.700 FORMAT "%8.3" /end CHARACTERISTIC
/begin CHARACTERISTIC LIGov_trqOfsPtd_CUR "torque offset for permitted torque" CURVE 0x80571650 RB_Curve_S16_S16 6553.500 md_q0p1 -3276.800 3276.700 FORMAT "%8.3"
 /begin AXIS_DESCR STD_AXIS LIGov_nDiff nmot_q0p5 6 -16384.00 16383.50 FORMAT "%8.2" DEPOSIT ABSOLUTE /end AXIS_DESCR
/end CHARACTERISTIC
/begin CHARACTERISTIC LIGov_trqPLead_MAP "Map for P-part of low idle governor air path (number of parameter sets = LIGOV_NUMPPAR_SY)" MAP 0x8057166A RB_Map_S16U8_S16 6553.500 md_q0p1 -3276.800 3276.700 FORMAT "%8.3"
 /begin AXIS_DESCR STD_AXIS LIGov_nDiff nmot_q0p5 8 -16384.00 16383.50 FORMAT "%8.2" DEPOSIT ABSOLUTE /end AXIS_DESCR
 /begin AXIS_DESCR STD_AXIS LIGov_numParTrqP dez 7 0.00 255.0 FORMAT "%5.1" DEPOSIT ABSOLUTE /end AXIS_DESCR
/end CHARACTERISTIC
/begin CHARACTERISTIC LIGov_trqPRmp_C "ramp slope for filtering of P-part at parameter set change" VALUE 0x805716F6 RB_Val_Ws16 3276.600 md_q0p1 0.100 3276.700 FORMAT "%8.3" EXTENDED_LIMITS -3276.800 3276.700 /end CHARACTERISTIC
/begin CHARACTERISTIC LIGov_trqP_MAP "Map for P-part of low idle governor ignition path (number of parameter sets = LIGOV_NUMPPAR_SY)" MAP 0x805716F8 RB_Map_S16U8_S16 6553.500 md_q0p1 -3276.800 3276.700 FORMAT "%8.3"
 /begin AXIS_DESCR STD_AXIS LIGov_nDiff nmot_q0p5 8 -16384.00 16383.50 FORMAT "%8.2" DEPOSIT ABSOLUTE /end AXIS_DESCR
 /begin AXIS_DESCR STD_AXIS LIGov_numParTrqP dez 7 0.00 255.0 FORMAT "%5.1" DEPOSIT ABSOLUTE /end AXIS_DESCR
/end CHARACTERISTIC
/begin CHARACTERISTIC LIGov_trqRstIntrv_C "permitted interval for reset torque" VALUE 0x80571784 RB_Val_Ws16 3276.700 md_q0p1 0.00 3276.700 FORMAT "%8.3" EXTENDED_LIMITS -3276.800 3276.700 /end CHARACTERISTIC
/begin CHARACTERISTIC LIGov_trqThresDfrstI_C "torque threshold for I-part release during pre-control" VALUE 0x805717EC RB_Val_Ws16 6553.500 md_q0p1 -3276.800 3276.700 FORMAT "%8.3" /end CHARACTERISTIC
/begin CHARACTERISTIC LIGov_vGrip_C "velocity threshold for rolling vehicle" VALUE 0x805717EE RB_Val_Ws16 327.6700 vfzg_uw_q0p01 0.00 327.6700 FORMAT "%8.4" EXTENDED_LIMITS -327.6800 327.6700 /end CHARACTERISTIC
/begin CHARACTERISTIC LIGov_vMinRstI_C "minimum vehicle speed for release of I-part-reset" VALUE 0x805717F0 RB_Val_Ws16 327.6700 vfzg_uw_q0p01 0.00 327.6700 FORMAT "%8.4" EXTENDED_LIMITS -327.6800 327.6700 /end CHARACTERISTIC
/begin CHARACTERISTIC LiGov_vThresFrzI_C "Vehicle speed threshold for detection of rolling vehicle" VALUE 0x805717F2 RB_Val_Ws16 655.3500 vel_q0p01 -327.6800 327.6700 FORMAT "%8.4" /end CHARACTERISTIC
/begin CHARACTERISTIC LIGov_vThresUbr_C "vehicle speed threshold for underbraking" VALUE 0x805717F4 RB_Val_Ws16 327.6700 vfzg_uw_q0p01 0.00 327.6700 FORMAT "%8.4" EXTENDED_LIMITS -327.6800 327.6700 /end CHARACTERISTIC
/begin CHARACTERISTIC Linappl_stUseLstErr_C "Use last value of LIN error flag if transmission or reception is not occurred in this period" VALUE 0x80579502 RB_Val_Wu8 1.000 OneToOne 0.00 1.000 FORMAT "%5.3" EXTENDED_LIMITS 0.00 255.0 /end CHARACTERISTIC
/begin CHARACTERISTIC Linappl_tiAEVActv_C "AEV threshold value for timer" VALUE 0x80579504 RB_Val_Ws16 655.3500 Time_s -327.6800 327.6700 FORMAT "%8.4" /end CHARACTERISTIC
/begin CHARACTERISTIC LinDiag_C "Switch for enabling LIN diagnosis" VALUE 0x80579506 RB_Val_Wu8 1.000 OneToOne 0.00 1.000 FORMAT "%5.3" EXTENDED_LIMITS 0.00 255.0 /end CHARACTERISTIC
/begin CHARACTERISTIC LMSTMOT "correction based on engine temperature for the calculation of nominal engine lambda" CURVE 0x805709C6 RB_Curve_S16_U16_Static 1.992188 fak_ub_b2 0.00 1.992188 FORMAT "%8.6" EXTENDED_LIMITS 0.00 511.9922
 /begin AXIS_DESCR STD_AXIS tmcyla_w Temp_Cels 4 -3549.940 3003.560 FORMAT "%8.3" DEPOSIT ABSOLUTE /end AXIS_DESCR
/end CHARACTERISTIC
/begin CHARACTERISTIC LZFUERV "guide cylinder assignment" VAL_BLK 0x8056F7F3 RB_ValA_Wu8 255.0 dez 0.00 255.0 FORMAT "%5.1" NUMBER 4 /end CHARACTERISTIC
/begin CHARACTERISTIC MINAKRLZ "minimum number of possible KC guide cylinders" VALUE 0x8056F7F7 RB_Val_Wu8 7.000 dez 1.000 8.000 FORMAT "%5.3" EXTENDED_LIMITS 0.00 255.0 /end CHARACTERISTIC
/begin CHARACTERISTIC NEVABRLMXL "maximal number of fuel cut off requested by knock control to activate air charge reduction" VALUE 0x80570299 RB_Val_Wu8 255.0 dez 0.00 255.0 FORMAT "%5.1" /end CHARACTERISTIC
/begin CHARACTERISTIC NKRREFIE "Engine speed threshold for reinitialisation of rkr" VALUE 0x8056F425 RB_Val_Wu8 10200. nmot_ub_q40 0.00 10200. FORMAT "%5.0" /end CHARACTERISTIC
/begin CHARACTERISTIC OFSKEKLZYL "Offset of knock detection threshold" VALUE 0x8056F62F RB_Val_Wu8 15.94 fak_ub_b16 0.00 15.94 FORMAT "%5.2" /end CHARACTERISTIC
/begin CHARACTERISTIC PZWKRA "percentage frequency of ignition angle output by knock control during dynamic adaption" VALUE 0x8056F1EC RB_Val_Wu8 99.61 rel_q0p39 0.00 99.61 FORMAT "%5.2" /end CHARACTERISTIC
/begin CHARACTERISTIC RKRMX1N "Maximum of reference level for knock detection threshold cylinder group 1" CURVE 0x8056F426 RB_CurveGroup_U16 25.59961 spg_q3p906Em4_V_ms 0.00 25.59961 FORMAT "%8.5"
 /begin AXIS_DESCR COM_AXIS Epm_nEng EngN 13 -16384.00 16383.50 FORMAT "%8.2" AXIS_PTS_REF IKCtl_nEngVar13_X_AX /end AXIS_DESCR
/end CHARACTERISTIC
/begin CHARACTERISTIC RKRMX2N "maximum of reference level for knock detection threshold cylinder group 2" CURVE 0x8056F440 RB_CurveGroup_U16 25.59961 spg_q3p906Em4_V_ms 0.00 25.59961 FORMAT "%8.5"
 /begin AXIS_DESCR COM_AXIS Epm_nEng EngN 13 -16384.00 16383.50 FORMAT "%8.2" AXIS_PTS_REF IKCtl_nEngVar13_X_AX /end AXIS_DESCR
/end CHARACTERISTIC
/begin CHARACTERISTIC SpdCtl_flgSynIninReqDrv_C "Calibration flag to request for initialization during transition to Drive state for Synchro-task in Spdctl package." VALUE 0x805717F6 RB_Val_Wu8 1.00000000000 B_TRUE 0.00 1.00000000000 FORMAT "%13.11" /end CHARACTERISTIC
/begin CHARACTERISTIC SpdCtl_flgSynPstDrvBreak_C "Calibration flag to prevent execution of Synchro-processes of Spdctl during Post-Drive state" VALUE 0x805717F7 RB_Val_Wu8 1.00000000000 B_TRUE 0.00 1.00000000000 FORMAT "%13.11" /end CHARACTERISTIC
/begin CHARACTERISTIC TCTRLBT "Timer for the decrement of the pre-ignition counter ctrvelbt (path: fuel enrichment)" VALUE 0x8057029A RB_Val_Wu16 3276.750 t_q0p05 0.00 3276.750 FORMAT "%8.3" /end CHARACTERISTIC
/begin CHARACTERISTIC TCTRNW "Timer for decrement the counter for camshaft adjustment demand" VALUE 0x8057029C RB_Val_Wu16 3276.750 t_q0p05 0.00 3276.750 FORMAT "%8.3" /end CHARACTERISTIC
/begin CHARACTERISTIC TCTRRL "Timer for decrement the pre ignition counter ctrverl (path: load limitation)" VALUE 0x8057029E RB_Val_Wu16 3276.750 t_q0p05 0.00 3276.750 FORMAT "%8.3" /end CHARACTERISTIC
/begin CHARACTERISTIC TCTRRLL "Timer for decrement the pre-ignition counter ctrverll (path: load limitation, limp home)" VALUE 0x805702A0 RB_Val_Wu16 3276.750 t_q0p05 0.00 3276.750 FORMAT "%8.3" /end CHARACTERISTIC
/begin CHARACTERISTIC TDKRFFV "Threshold: Timer for knock control near to its limite with flexfuel" VALUE 0x805700A8 RB_Val_Wu16 6553.500 t_q0p1 0.00 6553.500 FORMAT "%8.3" /end CHARACTERISTIC
/begin CHARACTERISTIC TDVERL "number of combustions until the next pre-ignition detection during the air charge reduction" VALUE 0x805702A2 RB_Val_Wu16 65535.00 dez 0.00 65535.00 FORMAT "%8.2" /end CHARACTERISTIC
/begin CHARACTERISTIC TDZW "Time constant for low octane fuel detection using delta ignition angles" VALUE 0x805700AA RB_Val_Wu8 12.75 t_q0p05 0.00 12.75 FORMAT "%5.2" /end CHARACTERISTIC
/begin CHARACTERISTIC TFDZWAB "Timer for ramping back the factor to reduce air charge in case of bad fuel" VALUE 0x805700AC RB_Val_Wu16 3276.7499992 zk50msxs_uw_b3276p8 0.0500008 3276.8000000 FORMAT "%12.7" EXTENDED_LIMITS 0.050000762951 3276.8000000 /end CHARACTERISTIC
/begin CHARACTERISTIC TFDZWAUF "Timer for ramping up the factor to restore air charge reduction in case of bad fuel" VALUE 0x805700AE RB_Val_Wu16 3276.7499992 zk50msxs_uw_b3276p8 0.0500008 3276.8000000 FORMAT "%12.7" EXTENDED_LIMITS 0.050000762951 3276.8000000 /end CHARACTERISTIC
/begin CHARACTERISTIC TFRLAB "Timer for ramp back the factor to reduce air charge in case of pre-ignition" VALUE 0x805702A4 RB_Val_Wu16 3276.7499992 zk50msxs_uw_b3276p8 0.0500008 3276.8000000 FORMAT "%12.7" EXTENDED_LIMITS 0.050000762951 3276.8000000 /end CHARACTERISTIC
/begin CHARACTERISTIC TFRLAUF "Timer for ramp the factor to restore air charge reduction in case of pre-ignition" VALUE 0x805702A6 RB_Val_Wu16 3276.7499992 zk50msxs_uw_b3276p8 0.0500008 3276.8000000 FORMAT "%12.7" EXTENDED_LIMITS 0.050000762951 3276.8000000 /end CHARACTERISTIC
/begin CHARACTERISTIC TFRLAUFL "Timer for ramp, the factor to restore air charge at permanent air charge reduction in case of pre-ignition" VALUE 0x805702A8 RB_Val_Wu16 3276.7499992 zk50msxs_uw_b3276p8 0.0500008 3276.8000000 FORMAT "%12.7" EXTENDED_LIMITS 0.050000762951 3276.8000000 /end CHARACTERISTIC
/begin CHARACTERISTIC TKRLZAMN "Knock control: delay for condition ""min nr. of guiding cylinders underschootten""" VALUE 0x8056F7F8 RB_Val_Wu8 25.50 t_q0p1 0.00 25.50 FORMAT "%5.2" /end CHARACTERISTIC
/begin CHARACTERISTIC TKRREFIE "Time until reinitialisation of rkr" VALUE 0x8056F45A RB_Val_Wu16 655.3500 t_q0p01 0.00 655.3500 FORMAT "%8.4" /end CHARACTERISTIC
/begin CHARACTERISTIC TKRVHEU "time for detected valve strock switch" VALUE 0x8056F45C RB_Val_Wu8 2.550 t_q0p01 0.00 2.550 FORMAT "%5.3" /end CHARACTERISTIC
/begin CHARACTERISTIC TLANSWL "time constant filter lamda afterstart-warmup" VALUE 0x80571472 RB_Val_Wu16 655.3500 t10msxs_uw_b655p35 0.00 655.3500 FORMAT "%8.4" /end CHARACTERISTIC
/begin CHARACTERISTIC TLASOABDQ "Activation time for lambda request in case of gearbox intervention" VALUE 0x80570C0D RB_Val_Wu8 2.550 t_q0p01 0.00 2.550 FORMAT "%5.3" /end CHARACTERISTIC
/begin CHARACTERISTIC TWKRLZOFV "Steps per 0.75 degree for angle and offset guided cylinder" VALUE 0x805700B0 RB_Val_Wu8 255.0 dez 0.00 255.0 FORMAT "%5.1" /end CHARACTERISTIC
/begin CHARACTERISTIC VTRIPMN "fuel consumption of the trip in L for low octane fuel detection" VALUE 0x805700B2 RB_Val_Wu16 255.9961 vol_q3p90625Em3_l 0.00 255.9961 FORMAT "%8.4" /end CHARACTERISTIC
/begin CHARACTERISTIC VZWKR "Ignition angle adjustment by calibration tool, e.g. VS100, INCA" VAL_BLK 0x805700B4 RB_ValA_Ws8 40.50 kw_q0p75 -20.25 20.25 FORMAT "%5.2" EXTENDED_LIMITS -96.00 95.25 NUMBER 4 /end CHARACTERISTIC
/begin CHARACTERISTIC ZKRNGFIL "Knock control: time constant for the filtered engine-speed gradient" VALUE 0x8056F45D RB_Val_Wu8 0.9922 fak_ub_b1 0.0039 0.9961 EXTENDED_LIMITS 0.00 0.9961 /end CHARACTERISTIC
/begin CHARACTERISTIC ZYRKR "cylinder selective reference level limitation" VALUE 0x8056F45E RB_Val_Wu8 255.0 dez 0.00 255.0 FORMAT "%5.1" /end CHARACTERISTIC
/begin MEASUREMENT akrgz "number of guided cylinders" UBYTE dez 1 100 0.00 254.0 FORMAT "%5.1" ECU_ADDRESS 0x6000B782 /end MEASUREMENT
/begin MEASUREMENT akrlz "number of possible guide cylinders" UBYTE dez 1 100 0.00 254.0 FORMAT "%5.1" ECU_ADDRESS 0x6000B781 /end MEASUREMENT
/begin MEASUREMENT anztib0_w "Counter for number of injection before start end of injection is reached" UWORD dez 1 100 0.00 65535.00 FORMAT "%8.2" ECU_ADDRESS 0x6000732A /end MEASUREMENT
/begin MEASUREMENT anztib1_w_Loc "injection counter from end of start injection" UWORD dez 1 100 0.00 65535.00 FORMAT "%8.2" ECU_ADDRESS 0x60007328 /end MEASUREMENT
/begin MEASUREMENT anztib1_w_msg "injection counter from end of start injection" UWORD dez 1 100 0.00 65535.00 FORMAT "%8.2" ECU_ADDRESS 0x60014972 /end MEASUREMENT
/begin MEASUREMENT B_cddst_msg "function active per codeword CDDST" UBYTE B_TRUE 1 100 0.00 1.00000000000 BIT_MASK 0x1 FORMAT "%13.11" ECU_ADDRESS 0x6000FAC2 /end MEASUREMENT
/begin MEASUREMENT B_cddtesk_msg "Function release via code word CDDTESK" UBYTE B_TRUE 1 100 0.00 1.00000000000 BIT_MASK 0x1 FORMAT "%13.11" ECU_ADDRESS 0x6000FAC1 /end MEASUREMENT
/begin MEASUREMENT B_cdeonv_msg "Diagnosis of DEONV is released via code word CDEONV" UBYTE B_TRUE 1 100 0.00 1.00000000000 BIT_MASK 0x1 FORMAT "%13.11" ECU_ADDRESS 0x6000FAC0 /end MEASUREMENT
/begin MEASUREMENT B_cdfstr_msg "fuel level sensor rationality check enable" UBYTE B_TRUE 1 100 0.00 1.00000000000 BIT_MASK 0x1 FORMAT "%13.11" ECU_ADDRESS 0x70000C28 /end MEASUREMENT
/begin MEASUREMENT B_cdfst_msg "fuel level sensor diagnostic enable" UBYTE B_TRUE 1 100 0.00 1.00000000000 BIT_MASK 0x1 FORMAT "%13.11" ECU_ADDRESS 0x70000C29 /end MEASUREMENT
/begin MEASUREMENT B_cdtankl_msg "function active per codeword CDTANKL" UBYTE B_TRUE 1 100 0.00 1.00000000000 BIT_MASK 0x1 FORMAT "%13.11" ECU_ADDRESS 0x70000C23 /end MEASUREMENT
/begin MEASUREMENT B_cdtespl_msg "Diagnosis canister purge valve released with codeword" UBYTE B_TRUE 1 100 0.00 1.00000000000 BIT_MASK 0x1 FORMAT "%13.11" ECU_ADDRESS 0x70000C21 /end MEASUREMENT
/begin MEASUREMENT B_dwkrzrlx "Bit for air charge limitation due to delta ignition angle of knock control" UBYTE B_TRUE 1 100 0.00 1.00000000000 BIT_MASK 0x1 FORMAT "%13.11" ECU_ADDRESS 0x700001A8 /end MEASUREMENT
/begin MEASUREMENT B_elzmn "number of possible KC guide cylinders below minimum" UBYTE B_TRUE 1 100 0.00 1.00000000000 BIT_MASK 0x1 FORMAT "%13.11" ECU_ADDRESS 0x700001AC /end MEASUREMENT
/begin MEASUREMENT B_fgkfhst_msg "Enabling bit application map lift boost pressure actuator" UBYTE B_TRUE 1 100 0.00 1.00000000000 BIT_MASK 0x1 FORMAT "%13.11" ECU_ADDRESS 0x70000BC3 /end MEASUREMENT
/begin MEASUREMENT B_fpwdkap_msg "throttle-valve control by accelerator pedal" UBYTE B_TRUE 1 100 0.00 1.00000000000 BIT_MASK 0x1 FORMAT "%13.11" ECU_ADDRESS 0x70000BC1 /end MEASUREMENT
/begin MEASUREMENT B_hldstfw_msg "Condition constant lift for boost pressure actuator activated (application mode)" UBYTE B_TRUE 1 100 0.00 1.00000000000 BIT_MASK 0x1 FORMAT "%13.11" ECU_ADDRESS 0x70000BA8 /end MEASUREMENT
/begin MEASUREMENT B_kldynrm "Condition normal knocking with adapted load dynamic" UBYTE B_TRUE 1 100 0.00 1.00000000000 BIT_MASK 0x1 FORMAT "%13.11" ECU_ADDRESS 0x700001B2 /end MEASUREMENT
/begin MEASUREMENT B_kldystk "Condition heavy knocking with adapted load dynamic" UBYTE B_TRUE 1 100 0.00 1.00000000000 BIT_MASK 0x1 FORMAT "%13.11" ECU_ADDRESS 0x700001B1 /end MEASUREMENT
/begin MEASUREMENT B_klzyl2 "Condition: Cylinder 2 knocked at last evaluation" UBYTE B_TRUE 1 100 0.00 1.00000000000 BIT_MASK 0x1 FORMAT "%13.11" ECU_ADDRESS 0x700001AD /end MEASUREMENT
/begin MEASUREMENT B_krlz "condition for knock control guide-cylinder function active" UBYTE B_TRUE 1 100 0.00 1.00000000000 BIT_MASK 0x1 FORMAT "%13.11" ECU_ADDRESS 0x700001AB /end MEASUREMENT
/begin MEASUREMENT B_krnlzdws "Condition: knock control safety retard adjustment due to KR-limp-home" UBYTE B_TRUE 1 100 0.00 1.00000000000 BIT_MASK 0x1 FORMAT "%13.11" ECU_ADDRESS 0x700001AA /end MEASUREMENT
/begin MEASUREMENT B_lalgf_msg "Condition: lambda limit rich active" UBYTE B_TRUE 1 100 0.00 1.00000000000 BIT_MASK 0x1 FORMAT "%13.11" ECU_ADDRESS 0x70000B92 /end MEASUREMENT
/begin MEASUREMENT B_lamdiag_msg "Lambda nominal value called by diagnosis function" UBYTE B_TRUE 1 100 0.00 1.00000000000 BIT_MASK 0x1 FORMAT "%13.11" ECU_ADDRESS 0x70000B90 /end MEASUREMENT
/begin MEASUREMENT B_lamkhe_msg "no air-fuel-ratio request by the function Lambda calculation for catalyst heating" UBYTE B_TRUE 1 100 0.00 1.00000000000 BIT_MASK 0x1 FORMAT "%13.11" ECU_ADDRESS 0x70000B8E /end MEASUREMENT
/begin MEASUREMENT B_lamkh_msg "condition desired lambda for catalyst heating activated" UBYTE B_TRUE 1 100 0.00 1.00000000000 BIT_MASK 0x1 FORMAT "%13.11" ECU_ADDRESS 0x70000B8F /end MEASUREMENT
/begin MEASUREMENT B_lamnswl_msg "lambda engine nominal at post start and warming up active" UBYTE B_TRUE 1 100 0.00 1.00000000000 BIT_MASK 0x1 FORMAT "%13.11" ECU_ADDRESS 0x6000FA8B /end MEASUREMENT
/begin MEASUREMENT B_lamsdef_msg "Condition: defined desired airfuel ratio value" UBYTE B_TRUE 1 100 0.00 1.00000000000 BIT_MASK 0x1 FORMAT "%13.11" ECU_ADDRESS 0x70000B8D /end MEASUREMENT
/begin MEASUREMENT B_lawlon "lambda engine nominal at warming up is active" UBYTE B_TRUE 1 100 0.00 1.00000000000 BIT_MASK 0x1 FORMAT "%13.11" ECU_ADDRESS 0x6000B771 /end MEASUREMENT
/begin MEASUREMENT B_ldef "Condition: defined desired value of the lambda (bank1)" UBYTE B_TRUE 1 100 0.00 1.00000000000 BIT_MASK 0x1 FORMAT "%13.11" ECU_ADDRESS 0x600000D6 /end MEASUREMENT
/begin MEASUREMENT B_lzup "update of lzist" UBYTE B_TRUE 1 100 0.00 1.00000000000 BIT_MASK 0x1 FORMAT "%13.11" ECU_ADDRESS 0x700001A9 /end MEASUREMENT
/begin MEASUREMENT B_rlmxkr "Bit for detection of low octane fuel" UBYTE B_TRUE 1 100 0.00 1.00000000000 BIT_MASK 0x1 FORMAT "%13.11" ECU_ADDRESS 0x60036DCA /end MEASUREMENT
/begin MEASUREMENT B_rlmxve2 "Condition for the 2nd stage air charge reduction at recognized pre-ignition" UBYTE B_TRUE 1 100 0.00 1.00000000000 BIT_MASK 0x1 FORMAT "%13.11" ECU_ADDRESS 0x700001A7 /end MEASUREMENT
/begin MEASUREMENT B_rlmxve2r "Condition for the reset of the 2nd stage air charge reduction" UBYTE B_TRUE 1 100 0.00 1.00000000000 BIT_MASK 0x1 FORMAT "%13.11" ECU_ADDRESS 0x700001A6 /end MEASUREMENT
/begin MEASUREMENT B_rlmxvel2 "Condition for permanent air charge reduction as substitution of cut off" UBYTE B_TRUE 1 100 0.00 1.00000000000 BIT_MASK 0x1 FORMAT "%13.11" ECU_ADDRESS 0x60036DC8 /end MEASUREMENT
/begin MEASUREMENT B_rlmxveold "state bit air charge reduction stage 1 was active due to preignition" UBYTE B_TRUE 1 100 0.00 1.00000000000 BIT_MASK 0x1 FORMAT "%13.11" ECU_ADDRESS 0x700001A5 /end MEASUREMENT
/begin MEASUREMENT B_tankgkr "Condition: refuelling bit valid for knock control" UBYTE B_TRUE 1 100 0.00 1.00000000000 BIT_MASK 0x1 FORMAT "%13.11" ECU_ADDRESS 0x60036DC9 /end MEASUREMENT
/begin MEASUREMENT B_tvfwldst_msg "Condition constant duty cycle for boost pressure actuator activated (application mode)" UBYTE B_TRUE 1 100 0.00 1.00000000000 BIT_MASK 0x1 FORMAT "%13.11" ECU_ADDRESS 0x70000AFD /end MEASUREMENT
/begin MEASUREMENT B_tvkfldst_msg "Condition duty cycle from map for boost pressure actuator activated (application mode)" UBYTE B_TRUE 1 100 0.00 1.00000000000 BIT_MASK 0x1 FORMAT "%13.11" ECU_ADDRESS 0x70000AFC /end MEASUREMENT
/begin MEASUREMENT B_wdksap_msg "throttle blade control by fixed value, bit 1 has priority" UBYTE B_TRUE 1 100 0.00 1.00000000000 BIT_MASK 0x1 FORMAT "%13.11" ECU_ADDRESS 0x70000AEC /end MEASUREMENT
/begin MEASUREMENT B_zwappl_msg "Condition ignition-timing application without torque intervention" UBYTE B_TRUE 1 100 0.00 1.00000000000 BIT_MASK 0x1 FORMAT "%13.11" ECU_ADDRESS 0x70000AE3 /end MEASUREMENT
/begin MEASUREMENT clrzzylkr "cylinder of fuel cut off" UBYTE dez 1 100 0.00 255.0 FORMAT "%5.1" ECU_ADDRESS 0x700021D0 /end MEASUREMENT
/begin MEASUREMENT Com_ctReIni100msLinappl "The counter of ReInit Proc for Linappl_std" UBYTE OneToOne 1 100 0.00 255.0 FORMAT "%5.1" ECU_ADDRESS 0x6000B769 /end MEASUREMENT
/begin MEASUREMENT Com_flgLINShtDwnTiDlyExp "LIN Node Shut down delay indicate Flag" UBYTE B_TRUE 1 100 0.00 1.00000000000 BIT_MASK 0x1 FORMAT "%13.11" ECU_ADDRESS 0x6000B768 /end MEASUREMENT
/begin MEASUREMENT ctrnrwcy "Timer to decrement the counter ctrveescyl (counter of pre-ignitions for injection timing cylinder individual)" UBYTE dez 1 100 0.00 255.0 FORMAT "%5.1" ARRAY_SIZE 4 ECU_ADDRESS 0x700021CC /end MEASUREMENT
/begin MEASUREMENT ctrveescyl "counter of pre-ignitions for injection timing cylinder individual" UBYTE dez 1 100 0.00 255.0 FORMAT "%5.1" ARRAY_SIZE 4 ECU_ADDRESS 0x700021C8 /end MEASUREMENT
/begin MEASUREMENT ctrveev "Counter of pre-ignition events for fuel cut off" UBYTE dez 1 100 0.00 255.0 FORMAT "%5.1" ARRAY_SIZE 4 ECU_ADDRESS 0x700021C4 /end MEASUREMENT
/begin MEASUREMENT ctrveevmx "maximum number of pre-ignition for fuel cut off" UBYTE dez 1 100 0.00 255.0 FORMAT "%5.1" ECU_ADDRESS 0x700021C3 /end MEASUREMENT
/begin MEASUREMENT ctrvelbt "Counter of pre-ignition events for fuel enrichment" UBYTE dez 1 100 0.00 255.0 FORMAT "%5.1" ECU_ADDRESS 0x700021C2 /end MEASUREMENT
/begin MEASUREMENT ctrvenw "Counter of pre-ignition events for camshaft adjustment" UBYTE dez 1 100 0.00 255.0 FORMAT "%5.1" ECU_ADDRESS 0x700021C1 /end MEASUREMENT
/begin MEASUREMENT ctrverl "Counter of pre-ignition events for air charge reduction" UBYTE dez 1 100 0.00 255.0 FORMAT "%5.1" ECU_ADDRESS 0x700021C0 /end MEASUREMENT
/begin MEASUREMENT ctrverll "Counter of pre-ignition events for permanent air charge reduction" UBYTE dez 1 100 0.00 255.0 FORMAT "%5.1" ECU_ADDRESS 0x6003908D /end MEASUREMENT
/begin MEASUREMENT ctrwped "number of acceleration pedal position=0 detection during active fuel cut off due to pre-ignition" UBYTE dez 1 100 0.00 255.0 FORMAT "%5.1" ARRAY_SIZE 4 ECU_ADDRESS 0x700021BC /end MEASUREMENT
/begin MEASUREMENT dcycntkr "driving cycle - counter knock control for pre-ignition" UBYTE dez 1 100 0.00 255.0 FORMAT "%5.1" ECU_ADDRESS 0x6003908C /end MEASUREMENT
/begin MEASUREMENT dcycntkr2 "driving cycle - counter knock control for pre-ignition as substitution measurement of cut off" UBYTE dez 1 100 0.00 255.0 FORMAT "%5.1" ECU_ADDRESS 0x6003908B /end MEASUREMENT
/begin MEASUREMENT dymntvs "Knock control: current min. additional dynamic reponse" SBYTE kw_q0p75 1 100 -96.00 95.25 FORMAT "%5.2" ECU_ADDRESS 0x7000222A /end MEASUREMENT
/begin MEASUREMENT dzwbf "delta ignition angle due to bad fuel" SBYTE kw_q0p75 1 100 -96.00 95.25 FORMAT "%5.2" ECU_ADDRESS 0x60039094 /end MEASUREMENT
/begin MEASUREMENT dzwflt_w_msg "Delta ignition angles for knock control (Low pass filtered)" UWORD zw_q0p1875 1 100 0.00 12287.81 FORMAT "%8.2" ECU_ADDRESS 0x6003908E /end MEASUREMENT
/begin MEASUREMENT dzwrlx_w "Delta ignition angles for the measure of knock control to the maximum air charge" UWORD zw_q0p1875 1 100 0.00 12287.81 FORMAT "%8.2" ECU_ADDRESS 0x6000734A /end MEASUREMENT
/begin MEASUREMENT EngStrt_ctReIniLANSWL10ms "Local variable to store the global post-drive leave counter(SyC_ctPostDrvLeave)" UBYTE OneToOne 1 100 0.00 255.0 FORMAT "%5.1" ECU_ADDRESS 0x6000B770 /end MEASUREMENT
/begin MEASUREMENT EngStrt_ctReIniLANSWL200ms "Local variable to store the global post-drive leave counter(SyC_ctPostDrvLeave)" UBYTE OneToOne 1 100 0.00 255.0 FORMAT "%5.1" ECU_ADDRESS 0x6000B76F /end MEASUREMENT
/begin MEASUREMENT EngStrt_facLamWrmUpAftStrt "lambda engine nominal at afterstart and warming up" UWORD fak_uw_b16 1 100 0.00 15.99976 FORMAT "%8.5" ECU_ADDRESS 0x60007326 /end MEASUREMENT
/begin MEASUREMENT evmzveold "bit mask evmzve (bit mask for injection time measurements cylinder individual against pre-ignition) from the last combustion" UBYTE dez 1 100 0.00 255.0 FORMAT "%5.1" ECU_ADDRESS 0x700021BB /end MEASUREMENT
/begin MEASUREMENT ExhMgT_cntrReIniCoornLamCatHeatg100ms "Counter for Re-Initialization request for LAKH, 100ms" UBYTE OneToOne 1 100 0.00 255.0 FORMAT "%5.1" ECU_ADDRESS 0x6000B772 /end MEASUREMENT
/begin MEASUREMENT ExhMgT_cntrReIniCoornLamCatHeatg10ms "Counter for Re-Initialization request for LAKH, 10ms" UBYTE OneToOne 1 100 0.00 255.0 FORMAT "%5.1" ECU_ADDRESS 0x6000B773 /end MEASUREMENT
/begin MEASUREMENT ExhMgt_facIntrpnCatHeatg "weighting factor for the calculation of the engine efficiency degradation during Idle and part load" UBYTE fak_ub_b1 1 100 0.00 0.9961 ECU_ADDRESS 0x6000FC86 /end MEASUREMENT
/begin MEASUREMENT ExhMgT_flgCdnCatHeat "Condition of the request catalyst heating." UBYTE B_TRUE 1 100 0.00 1.00000000000 BIT_MASK 0x1 FORMAT "%13.11" ECU_ADDRESS 0x7000096F /end MEASUREMENT
/begin MEASUREMENT ExhMgT_ratLamCatHeatg "Ratio of lambda of catlysit heating" UWORD fak_q0p000244 1 100 0.00 8.000000 FORMAT "%8.6" ECU_ADDRESS 0x6000732C /end MEASUREMENT
/begin MEASUREMENT ExhMgT_ratLamEngNomB1 "Ratio of desired lambda engine at catalyst heating, Bank1" UWORD fak_q0p000244 1 100 0.00 15.99976 FORMAT "%8.5" ECU_ADDRESS 0x60007336 /end MEASUREMENT
/begin MEASUREMENT ExhMgT_ratLamExhB1 "desired lambda for engine combustion of package ExhMgT (bench1)" UWORD fak_q0p000244 1 100 0.00 15.99976 FORMAT "%8.5" ECU_ADDRESS 0x6000948E /end MEASUREMENT
/begin MEASUREMENT ExhMgT_stLamExhB1 "status engine lambda request of package ExhMgT (bank1)" UBYTE OneToOne 1 100 0.00 255.0 FORMAT "%5.1" ECU_ADDRESS 0x6000FC87 /end MEASUREMENT
/begin MEASUREMENT flamsl_w_msg "Factor lambda change by secondary air" UWORD fak_uw_b16 1 100 0.00 15.99976 FORMAT "%8.5" ECU_ADDRESS 0x60009362 /end MEASUREMENT
/begin MEASUREMENT flglrs2_msg "CARB FREEZE FRAME byte, bank 2, for lambda control" UBYTE dez 1 100 0.00 255.0 FORMAT "%5.1" ECU_ADDRESS 0x6000F735 /end MEASUREMENT
/begin MEASUREMENT flglrs_msg "CARB FREEZE FRAME byte, bank 1, for lambda control" UBYTE dez 1 100 0.00 255.0 FORMAT "%5.1" ECU_ADDRESS 0x60014AE9 /end MEASUREMENT
/begin MEASUREMENT frkrini "factor to reinitialize the reference level" UBYTE fak_ub_b16 1 100 0.00 15.94 FORMAT "%5.2" ECU_ADDRESS 0x60014A54 /end MEASUREMENT
/begin MEASUREMENT frlmxkr_w "factor for air charge reduction at recognized low octane fuel" UWORD fak_uw_b2 1 100 0.00 1.000000 FORMAT "%8.6" ECU_ADDRESS 0x60007348 /end MEASUREMENT
/begin MEASUREMENT frlmxtmp_w "factor for air charge reduction at recognized pre-ignition from map" UWORD fak_uw_b2 1 100 0.500000 1.000000 FORMAT "%8.6" ECU_ADDRESS 0x6000733A /end MEASUREMENT
/begin MEASUREMENT HdLi_flgActv "Headlight active" UBYTE B_TRUE 1 100 0.00 1.00000000000 BIT_MASK 0x1 FORMAT "%13.11" ECU_ADDRESS 0x6000F93C /end MEASUREMENT
/begin MEASUREMENT IKCtl_agAdpnCurr_s16 "Current Adaption value for fine resolution" SWORD zw_q0p1 1 100 -3276.800 3276.700 FORMAT "%8.3" ECU_ADDRESS 0x600006D2 /end MEASUREMENT
/begin MEASUREMENT IKCtl_agAdpnVlvLft_as16 "stationary adaption map for valve lift switch depending on speed and load(fine resolution)" SWORD zw_q0p1 1 100 -3276.800 3276.700 FORMAT "%8.3" ARRAY_SIZE 80 ECU_ADDRESS 0x60039196 /end MEASUREMENT
/begin MEASUREMENT IKCtl_agAdpn_as16 "Stationary adaptation map depending on engine speed and load (fine resolution)" SWORD zw_q0p1 1 100 -3276.800 3276.700 FORMAT "%8.3" ARRAY_SIZE 80 ECU_ADDRESS 0x600390F6 /end MEASUREMENT
/begin MEASUREMENT IKCtl_agDynAdpnOffs_s8 "ignition retard during dynamic function of knock control" SBYTE kw_q0p75 1 100 -96.00 95.25 FORMAT "%5.2" ECU_ADDRESS 0x60000969 /end MEASUREMENT
/begin MEASUREMENT IKCtl_agDynAdpn_as8 "Adapted ignition timing for knock control dynamic" SBYTE kw_q0p75 1 100 -96.00 95.25 FORMAT "%5.2" ARRAY_SIZE 5 ECU_ADDRESS 0x600390F0 /end MEASUREMENT
/begin MEASUREMENT IKCtl_agKnkAvrgGen_s16 "Average value of ignition retardation by knock control, generally (limp-home with safety, fine resolution)" SWORD zw_q0p1 1 100 -3276.800 3276.700 FORMAT "%8.3" ECU_ADDRESS 0x70003BC0 /end MEASUREMENT
/begin MEASUREMENT IKCtl_agKnkAvrgGen_s8 "Average value of ignition retardation by knock control, generally (limp-home with safety)" SBYTE kw_q0p75 1 100 -96.00 95.25 FORMAT "%5.2" ECU_ADDRESS 0x70003749 /end MEASUREMENT
/begin MEASUREMENT IKCtl_agKnkAvrg_s16 "average value of individual ignition retarting by knock control (fine resolution)" SWORD zw_q0p1 1 100 -3276.800 3276.700 FORMAT "%8.3" ECU_ADDRESS 0x600006D4 /end MEASUREMENT
/begin MEASUREMENT IKCtl_agKnkAvrg_s8 "average value of cylinder individual ignition retardation by knock control" SBYTE kw_q0p75 1 100 -96.00 95.25 FORMAT "%5.2" ECU_ADDRESS 0x6000096C /end MEASUREMENT
/begin MEASUREMENT IKCtl_agKnkIntCurr_s16 "cylinder-individual ignition angle retarding, druming(fine resolution)" SWORD zw_q0p1 1 100 -3276.800 3276.700 FORMAT "%8.3" ECU_ADDRESS 0x700021E6 /end MEASUREMENT
/begin MEASUREMENT IKCtl_agKnkInt_as16 "cylinder individual ignition retarding value of knock control (fine resolution)" SWORD zw_q0p1 1 100 -3276.800 3276.700 FORMAT "%8.3" ARRAY_SIZE 4 ECU_ADDRESS 0x500005FC /end MEASUREMENT
/begin MEASUREMENT IKCtl_agKnkInt_as8 "cylinder individual ignition retarding value of knock control" SBYTE kw_q0p75 1 100 -96.00 95.25 FORMAT "%5.2" ARRAY_SIZE 4 ECU_ADDRESS 0x50000604 /end MEASUREMENT
/begin MEASUREMENT IKCtl_agKnkLimrCurr_s16 "Ignition retard during knocking event(fine resolution)" SWORD zw_q0p1 1 100 -3276.800 3276.700 FORMAT "%8.3" ECU_ADDRESS 0x600006D6 /end MEASUREMENT
/begin MEASUREMENT IKCtl_agKnkMaxLim "upper limit for retardation range around average" SWORD zw_q0p1 1 100 -3276.800 3276.700 FORMAT "%8.3" ECU_ADDRESS 0x700021E4 /end MEASUREMENT
/begin MEASUREMENT IKCtl_agKnkRtdtAry_s16 "cylinder individual ignition retardation including dynamics" SWORD zw_q0p1 1 100 -3276.800 3276.700 FORMAT "%8.3" ARRAY_SIZE 4 ECU_ADDRESS 0x50000608 /end MEASUREMENT
/begin MEASUREMENT IKCtl_agKnkRtdt_as8 "cylinder specific ignition-timing retardation with retardation for dynamics" SBYTE kw_q0p75 1 100 -96.00 95.25 FORMAT "%5.2" ARRAY_SIZE 4 ECU_ADDRESS 0x600004D8 /end MEASUREMENT
/begin MEASUREMENT IKCtl_agKnkRtdt_s16 "cylinder-specific ignition-timing retardation(fine resolution)" SWORD zw_q0p1 1 100 -3276.800 3276.700 FORMAT "%8.3" ECU_ADDRESS 0x70003BBE /end MEASUREMENT
/begin MEASUREMENT IKCtl_agKnkRtdt_s8 "cylinder-specific ignition-timing retardation" SBYTE kw_q0p75 1 100 -96.00 95.25 FORMAT "%5.2" ECU_ADDRESS 0x70003748 /end MEASUREMENT
/begin MEASUREMENT IKCtl_agMaxRtdtCurrLoc_s16 "Local variable to select between CEngDsT_t and CHdT_t" SWORD zw_q0p1 1 100 -3276.800 3276.700 FORMAT "%8.3" ECU_ADDRESS 0x60007346 /end MEASUREMENT
/begin MEASUREMENT IKCtl_agMaxRtdtCurr_s16 "current value for retard limitation of the retarding(fine resolution)" SWORD zw_q0p1 1 100 -3276.800 3276.700 FORMAT "%8.3" ECU_ADDRESS 0x50005DEE /end MEASUREMENT
/begin MEASUREMENT IKCtl_agMaxRtdtCurr_s8 "current value for retard limitation of the retarding" SBYTE kw_q0p75 1 100 -96.00 95.25 FORMAT "%5.2" ECU_ADDRESS 0x6000F8A7 /end MEASUREMENT
/begin MEASUREMENT IKCtl_agRtdtCurrOutp_s16 "current ignition retardation after knock event" SWORD zw_q0p1 1 100 -3276.800 3276.700 FORMAT "%8.3" ECU_ADDRESS 0x60007344 /end MEASUREMENT
/begin MEASUREMENT IKCtl_agRtdtCurr_as16 "current ignition retardation after knock event, cylinder individual" SWORD zw_q0p1 1 100 -3276.800 3276.700 FORMAT "%8.3" ARRAY_SIZE 4 ECU_ADDRESS 0x600003F0 /end MEASUREMENT
/begin MEASUREMENT IKCtl_agRtdtLowrCurr_s16 "current min value of range around average" SWORD zw_q0p1 1 100 -3276.800 3276.700 FORMAT "%8.3" ECU_ADDRESS 0x700021E2 /end MEASUREMENT
/begin MEASUREMENT IKCtl_agRtdtLowr_s16 "current value for under mean value limitation of the retarding(fine resolution)" SWORD zw_q0p1 1 100 -3276.800 3276.700 FORMAT "%8.3" ECU_ADDRESS 0x60007342 /end MEASUREMENT
/begin MEASUREMENT IKCtl_agRtdtUpprCurr_s16 "current Max-value for band" SWORD zw_q0p1 1 100 -3276.800 3276.700 FORMAT "%8.3" ECU_ADDRESS 0x700021E0 /end MEASUREMENT
/begin MEASUREMENT IKCtl_agRtdtUppr_s16 "current value for upper mean value limitation of the retarding(fine resolution)" SWORD zw_q0p1 1 100 -3276.800 3276.700 FORMAT "%8.3" ECU_ADDRESS 0x60007340 /end MEASUREMENT
/begin MEASUREMENT IKCtl_cntCylCurr "cylinder on which pre-ignition is detected" UBYTE dez 1 100 0.00 255.0 FORMAT "%5.1" ECU_ADDRESS 0x6003908A /end MEASUREMENT
/begin MEASUREMENT IKCtl_cntCylPreIgn_au8 "array of cylinder on which preignition is detected" UBYTE dez 1 100 0.00 255.0 FORMAT "%5.1" ARRAY_SIZE 10 ECU_ADDRESS 0x60039080 /end MEASUREMENT
/begin MEASUREMENT IKCtl_cntrCvlciActv "activation counter for camshaft adjustment" UWORD dez 1 100 0.00 65535.00 FORMAT "%8.2" ECU_ADDRESS 0x6003907E /end MEASUREMENT
/begin MEASUREMENT IKCtl_cntrCvlciRdy "readiness counter for camshaft adjustment" UWORD dez 1 100 0.00 65535.00 FORMAT "%8.2" ECU_ADDRESS 0x6003907C /end MEASUREMENT
/begin MEASUREMENT IKCtl_cntrCylPreIgn_au16 "Cylinder specific pre-ignition counter" UWORD dez 1 100 0.00 65535.00 FORMAT "%8.2" ARRAY_SIZE 4 ECU_ADDRESS 0x60039912 /end MEASUREMENT
/begin MEASUREMENT IKCtl_cntrEnchmtActv "activation counter for enrichment" UWORD dez 1 100 0.00 65535.00 FORMAT "%8.2" ECU_ADDRESS 0x6003907A /end MEASUREMENT
/begin MEASUREMENT IKCtl_cntrEnchmtCylActv "activation counter for cylinder individual enrichment" UWORD dez 1 100 0.00 65535.00 FORMAT "%8.2" ARRAY_SIZE 4 ECU_ADDRESS 0x60039072 /end MEASUREMENT
/begin MEASUREMENT IKCtl_cntrEnchmtCylRdy "readiness counter for cylinder individual enrichment" UWORD dez 1 100 0.00 65535.00 FORMAT "%8.2" ARRAY_SIZE 4 ECU_ADDRESS 0x6003906A /end MEASUREMENT
/begin MEASUREMENT IKCtl_cntrEnchmtRdy "readiness counter for enrichment" UWORD dez 1 100 0.00 65535.00 FORMAT "%8.2" ECU_ADDRESS 0x60039068 /end MEASUREMENT
/begin MEASUREMENT IKCtl_cntrFcoActv "activation counter for fuel cut-off" UWORD dez 1 100 0.00 65535.00 FORMAT "%8.2" ARRAY_SIZE 4 ECU_ADDRESS 0x60039060 /end MEASUREMENT
/begin MEASUREMENT IKCtl_cntrFcoRdy "readiness counter for fuel cut-off" UWORD dez 1 100 0.00 65535.00 FORMAT "%8.2" ARRAY_SIZE 4 ECU_ADDRESS 0x60039058 /end MEASUREMENT
/begin MEASUREMENT IKCtl_cntrFrzFrm_au8 "counter of the value blocks for freeze frame" UBYTE dez 1 100 0.00 255.0 FORMAT "%5.1" ECU_ADDRESS 0x60039056 /end MEASUREMENT
/begin MEASUREMENT IKCtl_cntrGdCyl_au8 "Cylinder assignment for guided cylinders" UBYTE dez 1 100 0.00 255.0 FORMAT "%5.1" ARRAY_SIZE 4 ECU_ADDRESS 0x6000F7AC /end MEASUREMENT
/begin MEASUREMENT IKCtl_cntrPreIgnDetn "Pre-ignition counter(driving cycle)" UWORD dez 1 100 0.00 65535.00 FORMAT "%8.2" ECU_ADDRESS 0x7000396E /end MEASUREMENT
/begin MEASUREMENT IKCtl_cntrRedFillgActv "activation counter for air charge reduction" UWORD dez 1 100 0.00 65535.00 FORMAT "%8.2" ECU_ADDRESS 0x60039054 /end MEASUREMENT
/begin MEASUREMENT IKCtl_cntrRedFillgPrmntActv "activation counter for permanent air charge reduction" UWORD dez 1 100 0.00 65535.00 FORMAT "%8.2" ECU_ADDRESS 0x60039052 /end MEASUREMENT
/begin MEASUREMENT IKCtl_cntrReIni100msKRREG "counter reinitializations in 100 ms Task" UBYTE dez 1 100 0.00 255.0 FORMAT "%5.1" ECU_ADDRESS 0x50000956 /end MEASUREMENT
/begin MEASUREMENT IKCtl_cntrReIniSyncKRKEVE "Counter for ReIni in Syncro task" UBYTE OneToOne 1 100 0.00 255.0 FORMAT "%5.1" ECU_ADDRESS 0x7000221D /end MEASUREMENT
/begin MEASUREMENT IKCtl_cntrReIniSyncKRREG "counter number of reinitialzations in synchronous task" UBYTE dez 1 100 0.00 255.0 FORMAT "%5.1" ECU_ADDRESS 0x50000957 /end MEASUREMENT
/begin MEASUREMENT IKCtl_ctReIni100msKRADAP "Local counter in KRADAP for counting number of driving cycles (leave postdrive and enter drive) to enable reinitialization" UBYTE dez 1 100 0.00 255.0 FORMAT "%5.1" ECU_ADDRESS 0x6000B78E /end MEASUREMENT
/begin MEASUREMENT IKCtl_ctReIni10msKRDY "Local counter in function KRDY for counting number of driving cycles (leave postdrive and enter drive) to enable reinitialization" UBYTE dez 1 100 0.00 255.0 FORMAT "%5.1" ECU_ADDRESS 0x60014A46 /end MEASUREMENT
/begin MEASUREMENT IKCtl_ctReIni10msKRVEKO "Local counter in KRVEKO (Pre-Ignition detection through knocking combustion) to hold number of post-drive exits to track state post-drive leave" UBYTE dez 1 100 0.00 255.0 FORMAT "%5.1" ECU_ADDRESS 0x700021BA /end MEASUREMENT
/begin MEASUREMENT IKCtl_ctReIni50msKRREG "Local counter in KRREG (Knock control: stationary control) for number of driving cycles (leave post-drive) to enable reinitialization" UBYTE dez 1 100 0.00 255.0 FORMAT "%5.1" ECU_ADDRESS 0x600008D8 /end MEASUREMENT
/begin MEASUREMENT IKCtl_ctReIniKRKE "Local counter in KRKE for number of driving cycles (leave postdrive) to enable reinitialization" UBYTE OneToOne 1 100 0.00 255.0 FORMAT "%5.1" ECU_ADDRESS 0x600008D9 /end MEASUREMENT
/begin MEASUREMENT IKCtl_ctReIniKRKEVE "Local counter in KRKEVE for number of driving cycles (leave postdrive) to enable reinitialization" UBYTE OneToOne 1 100 0.00 255.0 FORMAT "%5.1" ECU_ADDRESS 0x7000221C /end MEASUREMENT
/begin MEASUREMENT IKCtl_facCorrnLoadDyn "correction factor for knock detection threshold during load dynamics" UBYTE fak_ub_b16 1 100 0.063 2.000 FORMAT "%5.3" ECU_ADDRESS 0x6000B78C /end MEASUREMENT
/begin MEASUREMENT IKCtl_facCorrnSpdDyn "correction factor for knock detection threshold with engine-speed dynamics" UBYTE fak_ub_b16 1 100 0.063 2.000 FORMAT "%5.3" ECU_ADDRESS 0x6000B78B /end MEASUREMENT
/begin MEASUREMENT IKCtl_facDetnThdPreIgn_au8 "superknock detection threshold corrected" UBYTE fak_ub_b16 1 100 0.06 15.94 FORMAT "%5.2" ARRAY_SIZE 4 ECU_ADDRESS 0x70003704 /end MEASUREMENT
/begin MEASUREMENT IKCtl_facFillgRedPreIgn_u16 "factor for permanent air charge reduction at recognized pre-ignition from curve" UWORD fak_uw_b2 1 100 0.00 1.000000 FORMAT "%8.6" ECU_ADDRESS 0x60008E30 /end MEASUREMENT
/begin MEASUREMENT IKCtl_facFillgRed_u16 "Factor to limit the max. air charge dependent on ignition retardation" UWORD fak_uw_b2 1 100 0.00 1.000000 FORMAT "%8.6" ECU_ADDRESS 0x60008E2E /end MEASUREMENT
/begin MEASUREMENT IKCtl_facKnkInten_au8 "Interface: Ratio integrator, reference level knock control, cylinder selective" UBYTE fak_ub_b16 1 100 0.00 15.94 FORMAT "%5.2" ARRAY_SIZE 4 ECU_ADDRESS 0x500002AC /end MEASUREMENT
/begin MEASUREMENT IKCtl_facKnkInten_u8 "Ratio: integrator / reference level knock control" UBYTE fak_ub_b16 1 100 0.00 15.94 FORMAT "%5.2" ECU_ADDRESS 0x5000098E /end MEASUREMENT
/begin MEASUREMENT IKCtl_facMaxAirChAg "factor air charge limitation based on ignition angle" UWORD fak_uw_b2 1 100 0.00 1.000000 FORMAT "%8.6" ECU_ADDRESS 0x6000733E /end MEASUREMENT
/begin MEASUREMENT IKCtl_facPreIgnInten_au8 "Ratio result current combustion to reference level preignition detection, cylinder individual" UBYTE fak_ub_b16 1 100 0.00 15.94 FORMAT "%5.2" ARRAY_SIZE 4 ECU_ADDRESS 0x700021E9 /end MEASUREMENT
/begin MEASUREMENT IKCtl_facPreIgnInten_u8 "Ratio: integrator / reference level knock control, 2. knock-window" UBYTE fak_ub_b16 1 100 0.00 15.94 FORMAT "%5.2" ECU_ADDRESS 0x70003703 /end MEASUREMENT
/begin MEASUREMENT IKCtl_flgAdpnWrEnaCopy "knock control: Copy of IKCtl_flgAdpnWrEna (flag read adaption map)" UBYTE B_TRUE 1 100 0.00 1.00000000000 BIT_MASK 0x1 FORMAT "%13.11" ECU_ADDRESS 0x700008B6 /end MEASUREMENT
/begin MEASUREMENT IKCtl_flgAdvIa "condition for adjustment of knock control ignition timing to a less retarded value" UBYTE B_TRUE 1 100 0.00 1.00000000000 BIT_MASK 0x1 FORMAT "%13.11" ECU_ADDRESS 0x700008B5 /end MEASUREMENT
/begin MEASUREMENT IKCtl_flgCvlciArea "condition activation area for camshaft adjustment" UBYTE B_TRUE 1 100 0.00 1.00000000000 BIT_MASK 0x1 FORMAT "%13.11" ECU_ADDRESS 0x700001A4 /end MEASUREMENT
/begin MEASUREMENT IKCtl_flgEnchmtArea "condition activation area for enrichment" UBYTE B_TRUE 1 100 0.00 1.00000000000 BIT_MASK 0x1 FORMAT "%13.11" ECU_ADDRESS 0x700001A3 /end MEASUREMENT
/begin MEASUREMENT IKCtl_flgInjDArea "condition activation area for fuel cut-off" UBYTE B_TRUE 1 100 0.00 1.00000000000 BIT_MASK 0x1 FORMAT "%13.11" ECU_ADDRESS 0x700001A2 /end MEASUREMENT
/begin MEASUREMENT IKCtl_flgKnkDetn "condition for knocking" UBYTE B_TRUE 1 100 0.00 1.00000000000 BIT_MASK 0x1 FORMAT "%13.11" ECU_ADDRESS 0x700008AC /end MEASUREMENT
/begin MEASUREMENT IKCtl_flgPreIgnDetn "Condition for recognized pre-ignition" UBYTE B_TRUE 1 100 0.00 1.00000000000 BIT_MASK 0x1 FORMAT "%13.11" ECU_ADDRESS 0x700008A5 /end MEASUREMENT
/begin MEASUREMENT IKCtl_flgPreIgnEna "Condition for pre-ignition detection active" UBYTE B_TRUE 1 100 0.00 1.00000000000 BIT_MASK 0x1 FORMAT "%13.11" ECU_ADDRESS 0x700008A4 /end MEASUREMENT
/begin MEASUREMENT IKCtl_flgReqCvlci "Request of min. overlapping by knock coordinator" UBYTE B_TRUE 1 100 0.00 1.00000000000 BIT_MASK 0x1 FORMAT "%13.11" ECU_ADDRESS 0x700008A3 /end MEASUREMENT
/begin MEASUREMENT IKCtl_flgReqCvlciTmp "temporary variable for IKCtl_flgReqCvlci and IKCtl_flgReqCvlciSnd" UBYTE B_TRUE 1 100 0.00 1.00000000000 BIT_MASK 0x1 FORMAT "%13.11" ECU_ADDRESS 0x700001A1 /end MEASUREMENT
/begin MEASUREMENT IKCtl_flgReqEnchmt "Condition for fuel enrichment demand at recognized pre-ignition" UBYTE B_TRUE 1 100 0.00 1.00000000000 BIT_MASK 0x1 FORMAT "%13.11" ECU_ADDRESS 0x700008A2 /end MEASUREMENT
/begin MEASUREMENT IKCtl_flgReqEnchmtTmp "readiness flag for enrichment" UBYTE B_TRUE 1 100 0.00 1.00000000000 BIT_MASK 0x1 FORMAT "%13.11" ECU_ADDRESS 0x700001A0 /end MEASUREMENT
/begin MEASUREMENT IKCtl_flgReqInjTiCyl "request cylinder individual fuel enrichment" UBYTE B_TRUE 1 100 0.00 1.00000000000 BIT_MASK 0x1 FORMAT "%13.11" ECU_ADDRESS 0x700008A1 /end MEASUREMENT
/begin MEASUREMENT IKCtl_flgReqRedFillg "Condition for air charge reduction at recognized pre-ignition" UBYTE B_TRUE 1 100 0.00 1.00000000000 BIT_MASK 0x1 FORMAT "%13.11" ECU_ADDRESS 0x700008A0 /end MEASUREMENT
/begin MEASUREMENT IKCtl_flgReqRedFillgPrmnt "Condition for permanent air charge reduction at recognized pre-ignition" UBYTE B_TRUE 1 100 0.00 1.00000000000 BIT_MASK 0x1 FORMAT "%13.11" ECU_ADDRESS 0x60036DC7 /end MEASUREMENT
/begin MEASUREMENT IKCtl_flgRtdtMax "knock controll is near to its limite" UBYTE B_TRUE 1 100 0.00 1.00000000000 BIT_MASK 0x1 FORMAT "%13.11" ECU_ADDRESS 0x7000089F /end MEASUREMENT
/begin MEASUREMENT IKCtl_flgSftyRtdtGdCyl "Condition: knock control safety retard adjustment of LZF requested" UBYTE B_TRUE 1 100 0.00 1.00000000000 BIT_MASK 0x1 FORMAT "%13.11" ECU_ADDRESS 0x7000089C /end MEASUREMENT
/begin MEASUREMENT IKCtl_flgSftyRtdtPreIgn "Knock control safety mode for pre-ignition" UBYTE B_TRUE 1 100 0.00 1.00000000000 BIT_MASK 0x1 FORMAT "%13.11" ECU_ADDRESS 0x7000089B /end MEASUREMENT
/begin MEASUREMENT IKCtl_flgTranActv "Transition of injection mode activ" UBYTE B_TRUE 1 100 0.00 1.00000000000 BIT_MASK 0x1 FORMAT "%13.11" ECU_ADDRESS 0x700001AF /end MEASUREMENT
/begin MEASUREMENT IKCtl_flgTranRefIniTmp "reinitialization in case of switch of injection mode requested" UBYTE B_TRUE 1 100 0.00 1.00000000000 BIT_MASK 0x1 FORMAT "%13.11" ECU_ADDRESS 0x700001AE /end MEASUREMENT
/begin MEASUREMENT IKCtl_iaOffsfildGdCyl_as16 "filtered Ignition angle offset for guided cylinder(fine resolution)" SWORD zw_q0p1 1 100 -3276.800 3276.700 FORMAT "%8.3" ARRAY_SIZE 4 ECU_ADDRESS 0x700021D8 /end MEASUREMENT
/begin MEASUREMENT IKCtl_iaOffsGdCyl_as16 "Ignition angle offset for guided cylinder" SWORD zw_q0p1 1 100 -3276.800 3276.700 FORMAT "%8.3" ARRAY_SIZE 4 ECU_ADDRESS 0x6000907C /end MEASUREMENT
/begin MEASUREMENT IKCtl_nEngCurr "engine speed while pre-ignition is detected" SWORD EngN 1 100 -16384.00 16383.50 FORMAT "%8.2" ECU_ADDRESS 0x60039050 /end MEASUREMENT
/begin MEASUREMENT IKCtl_nEngPreIgn_as16 "array of engine speed while pre-ignition is detected" SWORD EngN 1 100 -16384.00 16383.50 FORMAT "%8.2" ARRAY_SIZE 10 ECU_ADDRESS 0x6003903C /end MEASUREMENT
/begin MEASUREMENT IKCtl_nFildGrad_s8 "knock control: engine speed gradient during one working cycle (filtered value)" SBYTE nmotg_sb_q100 1 100 -12800. 12700. FORMAT "%5.0" ECU_ADDRESS 0x5000098F /end MEASUREMENT
/begin MEASUREMENT IKCtl_nrCylFineResl_u8 "Current cylinder number(0.1 res)" UBYTE OneToOne 1 100 0.00 255.0 FORMAT "%5.1" ECU_ADDRESS 0x6000B780 /end MEASUREMENT
/begin MEASUREMENT IKCtl_numReqInjTi "number of the cylinder to be enriched at detected pre-ignition" UBYTE dez 1 100 0.00 8.000 FORMAT "%5.3" ECU_ADDRESS 0x70003700 /end MEASUREMENT
/begin MEASUREMENT IKCtl_ratChrgAirCurr "load while pre-ignition is detected" UWORD rel_q0p0234 1 100 0.00 1535.977 FORMAT "%8.3" ECU_ADDRESS 0x6003903A /end MEASUREMENT
/begin MEASUREMENT IKCtl_ratChrgAirPreIgn_au16 "array of load while pre-ignition is detected" UWORD rel_q0p0234 1 100 0.00 1535.977 FORMAT "%8.3" ARRAY_SIZE 10 ECU_ADDRESS 0x60039026 /end MEASUREMENT
/begin MEASUREMENT IKCtl_ratLoadRefLvl "relative air charge in cylinder while pre-ignition detected" UWORD rel_uw_q0p0234 1 100 0.00 1535.977 FORMAT "%8.3" ARRAY_SIZE 5 ECU_ADDRESS 0x600390E6 /end MEASUREMENT
/begin MEASUREMENT IKCtl_stCylRefIniEna "Status of the actual transition for refini release" UBYTE dez 1 100 0.00 255.0 FORMAT "%5.1" ECU_ADDRESS 0x600008DA /end MEASUREMENT
/begin MEASUREMENT IKCtl_stFilSwt "filter center frequency changed" UBYTE dez 1 100 0.00 255.0 FORMAT "%5.1" ECU_ADDRESS 0x50000991 /end MEASUREMENT
/begin MEASUREMENT IKCtl_stMaskGdCly_b8 "mask: guided cylinders" UBYTE dez 1 100 0.00 255.0 FORMAT "%5.1" ECU_ADDRESS 0x6000F7A9 /end MEASUREMENT
/begin MEASUREMENT IKCtl_stReIniKRLZ "Status ReIni Task for KRLZ" UBYTE dez 1 100 0.00 255.0 FORMAT "%5.1" ECU_ADDRESS 0x700021E8 /end MEASUREMENT
/begin MEASUREMENT IKCtl_stReqInjDTmp "internal status request fuel cut-off" UBYTE dez 1 100 0.00 255.0 FORMAT "%5.1" ECU_ADDRESS 0x700021B9 /end MEASUREMENT
/begin MEASUREMENT IKCtl_stReqInjD_b8 "fuel cut off pattern at recognized pre-ignition" UBYTE dez 1 100 0.00 255.0 FORMAT "%5.1" ECU_ADDRESS 0x700036FD /end MEASUREMENT
/begin MEASUREMENT IKCtl_stReqInjTiCylTmp "internal status request cylinder individual fuel enrichment" UBYTE dez 1 100 0.00 255.0 FORMAT "%5.1" ECU_ADDRESS 0x700021B8 /end MEASUREMENT
/begin MEASUREMENT IKCtl_stReqInjTiCyl_b8 "bit master request cylinder individual fuel enrichment" UBYTE dez 1 100 0.00 255.0 FORMAT "%5.1" ECU_ADDRESS 0x700036FC /end MEASUREMENT
/begin MEASUREMENT IKCtl_tEngLoc_s16 "selected temperature input" SWORD Temp_Cels 1 100 -3549.940 3003.560 FORMAT "%8.3" ECU_ADDRESS 0x6000733C /end MEASUREMENT
/begin MEASUREMENT IKCtl_tiReqCvlci "counter for the duration of the camshaft adjustment" ULONG t_q0p01 1 100 0.00 42949672.9500 FORMAT "%13.4" ECU_ADDRESS 0x700021B4 /end MEASUREMENT
/begin MEASUREMENT IKCtl_tiReqEnchmt "counter for the duration of fuel enrichment" ULONG t_q0p01 1 100 0.00 42949672.9500 FORMAT "%13.4" ECU_ADDRESS 0x700021B0 /end MEASUREMENT
/begin MEASUREMENT IKCtl_tmpReIniKRDY "Local variable in function KRDY to re-initialise the ASCET classes with no memory when entering drive from postdrive" UBYTE B_TRUE 1 100 0.00 1.00000000000 BIT_MASK 0x1 FORMAT "%13.11" ECU_ADDRESS 0x700001B0 /end MEASUREMENT
/begin MEASUREMENT IKCtl_tmpReIniKRVEKO "Local variable in KRVEKO(Pre-Ignition detection through knocking combustion) to re-initialize the ASCET classes with no memory when entering drive from post-drive" UBYTE B_TRUE 1 100 0.00 1.00000000000 BIT_MASK 0x1 FORMAT "%13.11" ECU_ADDRESS 0x7000019F /end MEASUREMENT
/begin MEASUREMENT IKCtl_wDetnThdCorr_au8 "knock detection threshold corrected" UBYTE fak_ub_b16 1 100 0.06 15.94 FORMAT "%5.2" ARRAY_SIZE 4 ECU_ADDRESS 0x600004DC /end MEASUREMENT
/begin MEASUREMENT IKCtl_wIntglResLoc_u32 "integral result knock control updated by cylinder counter" ULONG spg_q7p629Em7_V_ms 1 100 0.00 3276.79999924 FORMAT "%13.8" ECU_ADDRESS 0x50000630 /end MEASUREMENT
/begin MEASUREMENT IKCtl_wIntglResPreIgn_u32 "integrator2 value with offset correction updated with cyl.counter" ULONG spg_q7p629Em7_V_ms 1 100 0.00 3276.79999924 FORMAT "%13.8" ECU_ADDRESS 0x70003E0C /end MEASUREMENT
/begin MEASUREMENT IKCtl_wIntglRes_au32 "integral result kncok control 32Bit" ULONG spg_q7p629Em7_V_ms 1 100 0.00 3276.79999924 FORMAT "%13.8" ARRAY_SIZE 4 ECU_ADDRESS 0x70003DFC /end MEASUREMENT
/begin MEASUREMENT IKCtl_wIntgRef_au32 "reference level knock control 32bit" ULONG spg_q7p629Em7_V_ms 1 100 0.00 3276.79999924 FORMAT "%13.8" ARRAY_SIZE 4 ECU_ADDRESS 0x600004E0 /end MEASUREMENT
/begin MEASUREMENT IKCtl_wMaxLpFilKnk_u32 "maximum allowed value for reference level calculation in case of knocking" ULONG spg_q7p629Em7_V_ms 1 100 0.00000076 3276.79999924 FORMAT "%13.8" ECU_ADDRESS 0x70002224 /end MEASUREMENT
/begin MEASUREMENT IKCtl_wMaxLpFilPreIgn "maximum allowed value for reference level calculation in case of pre-ignition" ULONG spg_q7p629Em7_V_ms 1 100 0.00000076 3276.79999924 FORMAT "%13.8" ECU_ADDRESS 0x70002218 /end MEASUREMENT
/begin MEASUREMENT IKCtl_wRefMaxPreIgn_u32 "reference level limited upwards for preignition control, 32bit" ULONG spg_q7p629Em7_V_ms 1 100 0.00000076 3276.79999924 FORMAT "%13.8" ECU_ADDRESS 0x70003DF8 /end MEASUREMENT
/begin MEASUREMENT IKCtl_wRefMax_u32 "reference level limited upwards, 32bit" ULONG spg_q7p629Em7_V_ms 1 100 0.00000076 3276.79999924 FORMAT "%13.8" ECU_ADDRESS 0x50000634 /end MEASUREMENT
/begin MEASUREMENT ikr2_l "integrator value for preignition detection with offset correction" ULONG spg_q7p629Em7_V_ms 1 100 0.00 3276.79999924 FORMAT "%13.8" ARRAY_SIZE 4 ECU_ADDRESS 0x70002208 /end MEASUREMENT
/begin MEASUREMENT ke "knock detection threshold from characteristic map" UBYTE fak_ub_b16 1 100 0.00 15.94 FORMAT "%5.2" ARRAY_SIZE 4 ECU_ADDRESS 0x6000B787 /end MEASUREMENT
/begin MEASUREMENT ke02 "knock detection threshold from characteristic map, 2. Knock-window" UBYTE fak_ub_b16 1 100 0.00 15.94 FORMAT "%5.2" ARRAY_SIZE 4 ECU_ADDRESS 0x6000B783 /end MEASUREMENT
/begin MEASUREMENT kek2_tst "knock detection threshold corrected, updated with cylinder counter, 2. measurement window" UBYTE fak_ub_b16 1 100 0.06 15.94 FORMAT "%5.2" ECU_ADDRESS 0x70002206 /end MEASUREMENT
/begin MEASUREMENT kek_tst "knock detection threshold corrected, updated with cyl.counter" UBYTE fak_ub_b16 1 100 0.06 15.94 FORMAT "%5.2" ECU_ADDRESS 0x6000091B /end MEASUREMENT
/begin MEASUREMENT klopfakt "bit mask for cylinder individual knock events" UBYTE dez 1 100 0.00 255.0 FORMAT "%5.1" ECU_ADDRESS 0x6000091C /end MEASUREMENT
/begin MEASUREMENT KONCW_flgRatLoadCalMod "Release condition for rl_w usage on GEVCtl_ratLoad calculation for calibration purposes" UBYTE B_TRUE 1 100 0.00 1.00000000000 BIT_MASK 0x1 FORMAT "%13.11" ECU_ADDRESS 0x70000835 /end MEASUREMENT
/begin MEASUREMENT kr2ftpakt "actual low pass characteristic; reference level knocking" UBYTE dez 1 100 1.00 32.00 FORMAT "%5.2" ECU_ADDRESS 0x70002205 /end MEASUREMENT
/begin MEASUREMENT kr2ftpst "Lowpass follow-up factor in stationary operation from characteristic map" UBYTE dez 1 100 4.00 32.00 FORMAT "%5.2" ECU_ADDRESS 0x70002204 /end MEASUREMENT
/begin MEASUREMENT kradapred "Knock control: condition to reduce the adaption values" UBYTE dez 1 100 0.00 255.0 FORMAT "%5.1" ECU_ADDRESS 0x6000B78D /end MEASUREMENT
/begin MEASUREMENT krdwsw "current value based on calibration parameter for safety retard" SBYTE kw_q0p75 1 100 -96.00 95.25 FORMAT "%5.2" ECU_ADDRESS 0x60014A55 /end MEASUREMENT
/begin MEASUREMENT krftpakt "actual low pass characteristic" UBYTE dez 1 100 1.00 32.00 FORMAT "%5.2" ECU_ADDRESS 0x5000097A /end MEASUREMENT
/begin MEASUREMENT krftpst "Lowpass follow-up factor in stationary operation from characteristic map" UBYTE dez 1 100 4.00 32.00 FORMAT "%5.2" ECU_ADDRESS 0x50006021 /end MEASUREMENT
/begin MEASUREMENT krlzn "cylinder individuel rpm threshold of guide cylinder function exceeded" UBYTE dez 1 100 0.00 255.0 FORMAT "%5.1" ECU_ADDRESS 0x6000B77F /end MEASUREMENT
/begin MEASUREMENT krlzsfytm "Knock control: delay-counter for safety retard ignition by guide cylinder funct." UBYTE t_q0p1 1 100 0.00 25.50 FORMAT "%5.2" ECU_ADDRESS 0x6000B77E /end MEASUREMENT
/begin MEASUREMENT krvfswz "initialization value for quick advancing, cylinder individual" UBYTE t_q0p1 1 100 0.00 25.50 FORMAT "%5.2" ARRAY_SIZE 4 ECU_ADDRESS 0x6000B778 /end MEASUREMENT
/begin MEASUREMENT krvfwz "initialization value for normal advancing, cylinder individual" UBYTE t_q0p1 1 100 0.00 25.50 FORMAT "%5.2" ARRAY_SIZE 4 ECU_ADDRESS 0x6000B774 /end MEASUREMENT
/begin MEASUREMENT lambas_msg "basic Lambda" UBYTE fak_ub_b2 1 100 0.00 1.992188 FORMAT "%8.6" ECU_ADDRESS 0x600009A0 /end MEASUREMENT
/begin MEASUREMENT lambas_w_msg "lambda base value" UWORD fak_uw_b16 1 100 0.00 15.99976 FORMAT "%8.5" ECU_ADDRESS 0x600007BC /end MEASUREMENT
/begin MEASUREMENT LamCtrl_bHLN "Condition GDI mode homogeneous lean, LamCL copy in S1 task" UBYTE B_TRUE 1 100 0.00 1.00000000000 BIT_MASK 0x1 FORMAT "%13.11" ECU_ADDRESS 0x600000D5 /end MEASUREMENT
/begin MEASUREMENT LamCtrl_bHOM "Condition GDI mode homogeneous, LamCL copy in S1 task" UBYTE B_TRUE 1 100 0.00 1.00000000000 BIT_MASK 0x1 FORMAT "%13.11" ECU_ADDRESS 0x600000D4 /end MEASUREMENT
/begin MEASUREMENT LamCtrl_bHOS "Condition GDI mode homogeneous stratified, LamCL copy in S1 task" UBYTE B_TRUE 1 100 0.00 1.00000000000 BIT_MASK 0x1 FORMAT "%13.11" ECU_ADDRESS 0x600000D3 /end MEASUREMENT
/begin MEASUREMENT LamCtrl_flgClsdLoopB1 "Lambda control in closed loop (bank 1)" UBYTE B_TRUE 1 100 0.00 1.00000000000 BIT_MASK 0x1 FORMAT "%13.11" ECU_ADDRESS 0x600000DD /end MEASUREMENT
/begin MEASUREMENT LamCtrl_flgClsdLoopFltB1 "Lambda control in closed loop but fault with a least one lambda sensor (bank 1)" UBYTE B_TRUE 1 100 0.00 1.00000000000 BIT_MASK 0x1 FORMAT "%13.11" ECU_ADDRESS 0x600000DC /end MEASUREMENT
/begin MEASUREMENT LamCtrl_flgEngWrmUpB1 "Engine warm-up active (bank 1)" UBYTE B_TRUE 1 100 0.00 1.00000000000 BIT_MASK 0x1 FORMAT "%13.11" ECU_ADDRESS 0x600000DB /end MEASUREMENT
/begin MEASUREMENT LamCtrl_flgFltRdnS1B1 "Lambda sensor fault resetting operational readiness (sensor 1, bank 1)" UBYTE B_TRUE 1 100 0.00 1.00000000000 BIT_MASK 0x1 FORMAT "%13.11" ECU_ADDRESS 0x600000DA /end MEASUREMENT
/begin MEASUREMENT LamCtrl_flgFltS1B1 "Lambda sensor fault (sensor 1, bank 1)" UBYTE B_TRUE 1 100 0.00 1.00000000000 BIT_MASK 0x1 FORMAT "%13.11" ECU_ADDRESS 0x600000D9 /end MEASUREMENT
/begin MEASUREMENT LamCtrl_flgOpenLoopB1 "Lambda control in open loop (bank 1)" UBYTE B_TRUE 1 100 0.00 1.00000000000 BIT_MASK 0x1 FORMAT "%13.11" ECU_ADDRESS 0x600000D8 /end MEASUREMENT
/begin MEASUREMENT LamCtrl_flgOpenLoopFltB1 "Lambda control in open loop due to fault (bank 1)" UBYTE B_TRUE 1 100 0.00 1.00000000000 BIT_MASK 0x1 FORMAT "%13.11" ECU_ADDRESS 0x600000D7 /end MEASUREMENT
/begin MEASUREMENT LamCtrl_mfExhCat1B1 "Mass flow exhaust gas catalyst 1" UWORD m_uw_b6553p5 1 100 0.00 6553.500 FORMAT "%8.3" ECU_ADDRESS 0x60000EFE /end MEASUREMENT
/begin MEASUREMENT LamCtrl_ratLamSpCdaGbxB1 "Target lambda for fuel cut off during gear box intervention" UBYTE fak_ub_b2 1 100 0.00 1.992188 FORMAT "%8.6" ECU_ADDRESS 0x60000EFC /end MEASUREMENT
/begin MEASUREMENT LamCtrl_stBytA "Status of lambda control (PID 03hex, byte A)" UBYTE OneToOne 1 100 0.00 255.0 FORMAT "%5.1" ECU_ADDRESS 0x60014AC2 /end MEASUREMENT
/begin MEASUREMENT LamCtrl_stBytAInter "Status of lambda control (PID 03hex, byte A) (intermediate variable)" UBYTE OneToOne 1 100 0.00 255.0 FORMAT "%5.1" ECU_ADDRESS 0x60014AC3 /end MEASUREMENT
/begin MEASUREMENT LamCtrl_stBytAInterDeb "Status of lambda control (PID 03hex, byte A) (debounced intermediate variable)" UBYTE OneToOne 1 100 0.00 255.0 FORMAT "%5.1" ECU_ADDRESS 0x6000F79B /end MEASUREMENT
/begin MEASUREMENT LamCtrl_stBytAOld "Status of lambda control (PID 03hex, byte A) (old value)" UBYTE OneToOne 1 100 0.00 255.0 FORMAT "%5.1" ECU_ADDRESS 0x6000F79A /end MEASUREMENT
/begin MEASUREMENT LamCtrl_stBytB "Status of lambda control (PID 03hex, byte B)" UBYTE OneToOne 1 100 0.00 255.0 FORMAT "%5.1" ECU_ADDRESS 0x6000F799 /end MEASUREMENT
/begin MEASUREMENT LamCtrl_tCat1B1 "Temperature in catalyst 1" UWORD temp_q0p0234_o273 1 100 -273.150 1262.827 FORMAT "%8.3" ECU_ADDRESS 0x60000EFA /end MEASUREMENT
/begin MEASUREMENT lamdiag_w_msg "Lambda nominal value from diagnosis functions" UWORD fak_uw_b16 1 100 0.00 15.99976 FORMAT "%8.5" ECU_ADDRESS 0x600149A0 /end MEASUREMENT
/begin MEASUREMENT lamexht_w_msg "desired lambda for engine combustion of package Exhaust temperature management bank 1" UWORD fak_q0p000244 1 100 0.00 15.99976 FORMAT "%8.5" ECU_ADDRESS 0x700053F0 /end MEASUREMENT
/begin MEASUREMENT lamhsbg_w "Lambda nominal limiting homogeneous mode" UWORD fak_uw_b16 1 100 0.00 15.99976 FORMAT "%8.5" ECU_ADDRESS 0x700041F2 /end MEASUREMENT
/begin MEASUREMENT lamkhg_w "Lambda engine nominal at catalyst heating (word) weighted by flakh" UWORD fak_q0p000244 1 100 0.00 15.99976 FORMAT "%8.5" ECU_ADDRESS 0x60007334 /end MEASUREMENT
/begin MEASUREMENT lamkhr_w "Lambda engine result at catalyst heating (word)" UWORD fak_q0p000244 1 100 0.00 15.99976 FORMAT "%8.5" ECU_ADDRESS 0x60007332 /end MEASUREMENT
/begin MEASUREMENT lamkh_w_msg "Lambda engine nominal at catalyst heating (word)" UWORD fak_q0p000244 1 100 0.00 15.99976 FORMAT "%8.5" ECU_ADDRESS 0x700053F2 /end MEASUREMENT
/begin MEASUREMENT lamlgm_w_msg "lambda limit lean" UWORD fak_uw_b16 1 100 0.00 15.99976 FORMAT "%8.5" ECU_ADDRESS 0x600007C0 /end MEASUREMENT
/begin MEASUREMENT lamnswl_w_msg "lambda engine nominal at afterstart and warming up" UWORD fak_uw_b16 1 100 0.00 15.99976 FORMAT "%8.5" ECU_ADDRESS 0x6000934C /end MEASUREMENT
/begin MEASUREMENT lamns_w_msg "lambda engine nominal during afterstart" UWORD fak_uw_b16 1 100 0.00 15.99976 FORMAT "%8.5" ECU_ADDRESS 0x6000934E /end MEASUREMENT
/begin MEASUREMENT lamsbg_w_msg "Lambda setpoint in combustion chamber, limited" UWORD fak_uw_b16 1 100 0.00 15.99976 FORMAT "%8.5" ECU_ADDRESS 0x600007C2 /end MEASUREMENT
/begin MEASUREMENT lamsubg_w "Lambda nominal unlimited (word)" UWORD fak_uw_b16 1 100 0.00 15.99976 FORMAT "%8.5" ECU_ADDRESS 0x60000EF8 /end MEASUREMENT
/begin MEASUREMENT lams_w_msg "nominal Lambda value" UWORD fak_uw_b16 1 100 0.00 15.99976 FORMAT "%8.5" ECU_ADDRESS 0x600149A2 /end MEASUREMENT
/begin MEASUREMENT lamwbr_w "Desired in-cylinder lambda selected from the lambda requests sent to LAMKO" UWORD fak_uw_b16 1 100 0.00 15.99976 FORMAT "%8.5" ECU_ADDRESS 0x60000EF6 /end MEASUREMENT
/begin MEASUREMENT lamwl_w "lambda engine nominal at warming up" UWORD fak_uw_b16 1 100 0.00 15.99976 FORMAT "%8.5" ECU_ADDRESS 0x60008D5E /end MEASUREMENT
/begin MEASUREMENT lanskh_w "lambda engine nominal during afterstart at catalyst heating" UWORD fak_q0p000244 1 100 0.00 15.99976 FORMAT "%8.5" ECU_ADDRESS 0x60007330 /end MEASUREMENT
/begin MEASUREMENT LIGov_bCalcPreCtl "Condition calculate pre control" UBYTE B_TRUE 1 100 0.00 1.00000000000 BIT_MASK 0x1 FORMAT "%13.11" ECU_ADDRESS 0x70000834 /end MEASUREMENT
/begin MEASUREMENT LIGov_bEnblI "Condition activated integrator" UBYTE B_TRUE 1 100 0.00 1.00000000000 BIT_MASK 0x1 FORMAT "%13.11" ECU_ADDRESS 0x70000833 /end MEASUREMENT
/begin MEASUREMENT LIGov_bExtTrqDem "Condition external torque demand" UBYTE B_TRUE 1 100 0.00 1.00000000000 BIT_MASK 0x1 FORMAT "%13.11" ECU_ADDRESS 0x70000832 /end MEASUREMENT
/begin MEASUREMENT LIGov_bFrzI "Condition freeze integrator" UBYTE B_TRUE 1 100 0.00 1.00000000000 BIT_MASK 0x1 FORMAT "%13.11" ECU_ADDRESS 0x70000831 /end MEASUREMENT
/begin MEASUREMENT LIGov_bFrzIDiag "Condition freeze integrator because of reaching the lower physical operation limit" UBYTE B_TRUE 1 100 0.00 1.00000000000 BIT_MASK 0x1 FORMAT "%13.11" ECU_ADDRESS 0x70000830 /end MEASUREMENT
/begin MEASUREMENT LIGov_bGear1 "Condition parameter set for first gear" UBYTE B_TRUE 1 100 0.00 1.00000000000 BIT_MASK 0x1 FORMAT "%13.11" ECU_ADDRESS 0x7000082F /end MEASUREMENT
/begin MEASUREMENT LIGov_bInactv "Condition idle speed controller inactive" UBYTE B_TRUE 1 100 0.00 1.00000000000 BIT_MASK 0x1 FORMAT "%13.11" ECU_ADDRESS 0x7000082E /end MEASUREMENT
/begin MEASUREMENT LIGov_bIniPredefTrq "Condition initialize with predefined torque" UBYTE B_TRUE 1 100 0.00 1.00000000000 BIT_MASK 0x1 FORMAT "%13.11" ECU_ADDRESS 0x7000082D /end MEASUREMENT
/begin MEASUREMENT LIGov_bLoSpdExs "Condition overspeed after start" UBYTE B_TRUE 1 100 0.00 1.00000000000 BIT_MASK 0x1 FORMAT "%13.11" ECU_ADDRESS 0x7000019E /end MEASUREMENT
/begin MEASUREMENT LIGov_bNoGrip "Condition no grip, open powertrain" UBYTE B_TRUE 1 100 0.00 1.00000000000 BIT_MASK 0x1 FORMAT "%13.11" ECU_ADDRESS 0x7000082C /end MEASUREMENT
/begin MEASUREMENT LIGov_bNPreCtl "Condition dependent on engine speed for usage of pre control (D-part)" UBYTE B_TRUE 1 100 0.00 1.00000000000 BIT_MASK 0x1 FORMAT "%13.11" ECU_ADDRESS 0x7000019D /end MEASUREMENT
/begin MEASUREMENT LIGov_bOvrRunEF_I.buffer "Turn Off Delay fuel cut off / memory to detect falling edge" UBYTE B_TRUE 1 100 0.00 1.00000000000 BIT_MASK 0x1 FORMAT "%13.11" ECU_ADDRESS 0x7000218E /end MEASUREMENT
/begin MEASUREMENT LIGov_bOvrRunEF_I.oldSignal "Turn Off Delay fuel cut off / memory to detect falling edge" UBYTE B_TRUE 1 100 0.00 1.00000000000 BIT_MASK 0x1 FORMAT "%13.11" ECU_ADDRESS 0x7000218F /end MEASUREMENT
/begin MEASUREMENT LIGov_bParChng "Condition change of parameter set" UBYTE B_TRUE 1 100 0.00 1.00000000000 BIT_MASK 0x1 FORMAT "%13.11" ECU_ADDRESS 0x7000082B /end MEASUREMENT
/begin MEASUREMENT LIGov_bParChngTrqP "Condition change of P-parameter set" UBYTE B_TRUE 1 100 0.00 1.00000000000 BIT_MASK 0x1 FORMAT "%13.11" ECU_ADDRESS 0x7000082A /end MEASUREMENT
/begin MEASUREMENT LIGov_bPreCtlUndrSpd "Activation and calculation D-part because of underspeed" UBYTE B_TRUE 1 100 0.00 1.00000000000 BIT_MASK 0x1 FORMAT "%13.11" ECU_ADDRESS 0x70000829 /end MEASUREMENT
/begin MEASUREMENT LIGov_bRlsPreCtl "Release of pre-control" UBYTE B_TRUE 1 100 0.00 1.00000000000 BIT_MASK 0x1 FORMAT "%13.11" ECU_ADDRESS 0x70000828 /end MEASUREMENT
/begin MEASUREMENT LIGov_bRlsPredef "Release of predefined torque" UBYTE B_TRUE 1 100 0.00 1.00000000000 BIT_MASK 0x1 FORMAT "%13.11" ECU_ADDRESS 0x70000827 /end MEASUREMENT
/begin MEASUREMENT LIGov_bRmpDwn "Condition 'ramping down the output torques of the idle speed controller' for preparing fuel cutoff" UBYTE B_TRUE 1 100 0.00 1.00000000000 BIT_MASK 0x1 FORMAT "%13.11" ECU_ADDRESS 0x70003608 /end MEASUREMENT
/begin MEASUREMENT LIGov_bRstI "Condition reset integrator" UBYTE B_TRUE 1 100 0.00 1.00000000000 BIT_MASK 0x1 FORMAT "%13.11" ECU_ADDRESS 0x70000826 /end MEASUREMENT
/begin MEASUREMENT LIGov_bStrtPar "Condition use start parameters" UBYTE B_TRUE 1 100 0.00 1.00000000000 BIT_MASK 0x1 FORMAT "%13.11" ECU_ADDRESS 0x7000019C /end MEASUREMENT
/begin MEASUREMENT LIGov_bUbr "Condition Underbraking" UBYTE B_TRUE 1 100 0.00 1.00000000000 BIT_MASK 0x1 FORMAT "%13.11" ECU_ADDRESS 0x70000825 /end MEASUREMENT
/begin MEASUREMENT LIGov_bWrm "Condition warm engine" UBYTE B_TRUE 1 100 0.00 1.00000000000 BIT_MASK 0x1 FORMAT "%13.11" ECU_ADDRESS 0x70000824 /end MEASUREMENT
/begin MEASUREMENT LIGov_facPreCtlRmp "Ramp factor for precontrol of the drag torque of the engine" UWORD fak_uw_b2 1 100 0.00 1.000000 FORMAT "%8.6" ECU_ADDRESS 0x700021A0 /end MEASUREMENT
/begin MEASUREMENT LIGov_facPreCtlRmpMax "maximum ramp factor for precontrol of the drag torque of the engine" UWORD fak_q3p0518Em5 1 100 0.00 1.000000 FORMAT "%8.6" ECU_ADDRESS 0x70003828 /end MEASUREMENT
/begin MEASUREMENT LIGov_facThrStabAc "unlimited stabilization factor" UWORD fak_uw_b2 1 100 0.00 1.999969 FORMAT "%8.6" ECU_ADDRESS 0x70003826 /end MEASUREMENT
/begin MEASUREMENT LIGov_flgExtTrqDemMskSeln "alternative bit mask for external torque demands" UBYTE B_TRUE 1 100 0.00 1.00000000000 BIT_MASK 0x1 FORMAT "%13.11" ECU_ADDRESS 0x70000823 /end MEASUREMENT
/begin MEASUREMENT LIGov_flgSrvCouplrSwtSt "Service coupler disable switch" UBYTE B_TRUE 1 100 0.00 1.00000000000 BIT_MASK 0x1 FORMAT "%13.11" ECU_ADDRESS 0x7000219E /end MEASUREMENT
/begin MEASUREMENT LIGov_nDiff "current setpoint deviation" SWORD nmot_q0p5 1 100 -16384.00 16383.50 FORMAT "%8.2" ECU_ADDRESS 0x500007FA /end MEASUREMENT
/begin MEASUREMENT LIGov_nDiffNSetNEng "Ratio of set- and actual-speed" UWORD fak_uw_b2 1 100 0.00 1.999969 FORMAT "%8.6" ECU_ADDRESS 0x7000219C /end MEASUREMENT
/begin MEASUREMENT LIGov_nDiffOld "previous setpoint deviation" SWORD nmot_q0p5 1 100 -16384.00 16383.50 FORMAT "%8.2" ECU_ADDRESS 0x70003A8A /end MEASUREMENT
/begin MEASUREMENT LIGov_nPreCtl "speed limit for precontrol" SWORD nmot_sw_q0p5 1 100 -16384.00 16383.50 FORMAT "%8.2" ECU_ADDRESS 0x70002192 /end MEASUREMENT
/begin MEASUREMENT LIGov_numPar "current parameter set" UBYTE dez 1 100 0.00 255.0 FORMAT "%5.1" ECU_ADDRESS 0x70003678 /end MEASUREMENT
/begin MEASUREMENT LIGov_numParTrqI "current parameter set I-part" UBYTE dez 1 100 0.00 255.0 FORMAT "%5.1" ECU_ADDRESS 0x70003677 /end MEASUREMENT
/begin MEASUREMENT LIGov_numParTrqP "current parameter set P-part" UBYTE dez 1 100 0.00 255.0 FORMAT "%5.1" ECU_ADDRESS 0x70003676 /end MEASUREMENT
/begin MEASUREMENT LIGov_stExtTrqDemMskSeln "state alternative bit mask for external torque demands" UWORD OneToOne 1 100 0.00 65535.00 FORMAT "%8.2" ECU_ADDRESS 0x70003824 /end MEASUREMENT
/begin MEASUREMENT LIGov_stIdleSpdDrvr "Idle speed status from drivers sight" UBYTE B_TRUE 1 100 0.00 1.00000000000 BIT_MASK 0x1 FORMAT "%13.11" ECU_ADDRESS 0x70002190 /end MEASUREMENT
/begin MEASUREMENT LIGov_stOvrRun "Condition overrun fuel cut-off for idle speed controller" UBYTE B_TRUE 1 100 0.00 1.00000000000 BIT_MASK 0x1 FORMAT "%13.11" ECU_ADDRESS 0x70003607 /end MEASUREMENT
/begin MEASUREMENT LIGov_tiSync "segment time of idle speed control" UWORD t_q1p5259Em5_s 1 100 0.00 0.9999847 FORMAT "%9.7" ECU_ADDRESS 0x70003822 /end MEASUREMENT
/begin MEASUREMENT LIGov_tqThrStabAc "Torque for Pre-Control dependend on engine speed-stabilization factor" SWORD md_q0p1 1 100 -3276.800 3276.700 FORMAT "%8.3" ECU_ADDRESS 0x7000219A /end MEASUREMENT
/begin MEASUREMENT LIGov_trq "demanded torque of LIGov" SWORD md_q0p1 1 100 -3276.800 3276.700 FORMAT "%8.3" ECU_ADDRESS 0x70003A88 /end MEASUREMENT
/begin MEASUREMENT LIGov_trqI "value for I-part of torque" SWORD md_q0p1 1 100 -3276.800 3276.700 FORMAT "%8.3" ECU_ADDRESS 0x70003A86 /end MEASUREMENT
/begin MEASUREMENT LIGov_trqIDiff_MP "Amplification factor I-part Low-Idle-Governor (measurement point)" SWORD md_q0p1 1 100 -3276.800 3276.700 FORMAT "%8.3" ECU_ADDRESS 0x7000A244 /end MEASUREMENT
/begin MEASUREMENT LIGov_trqIgnFixPreCtl "Precontrol torque of ISC while ignition angle is fixed by tester" SWORD md_q0p1 1 100 -3276.800 3276.700 FORMAT "%8.3" ECU_ADDRESS 0x70002198 /end MEASUREMENT
/begin MEASUREMENT LIGov_trqIntegIPrmChg_MP "Offset-correction of I-part Idle-Speed-Governor by Parameter_Change (measurement point)" SLONG md_q1p526Em6 1 100 -3276.80000000 3276.79999847 FORMAT "%13.8" ECU_ADDRESS 0x7000A240 /end MEASUREMENT
/begin MEASUREMENT LIGov_trqIntegIRst_MP "Resetting of I-part Idle-Speed-Governor (measurement point)" SLONG md_q1p526Em6 1 100 -3276.80000000 3276.79999847 FORMAT "%13.8" ECU_ADDRESS 0x7000A23C /end MEASUREMENT
/begin MEASUREMENT LIGov_trqIntegI_MP "Value of I-part Low-Idle-Governor (measurement point)" SLONG md_q1p526Em6 1 100 -3276.80000000 3276.79999847 FORMAT "%13.8" ECU_ADDRESS 0x7000A238 /end MEASUREMENT
/begin MEASUREMENT LIGov_trqI_mp "temporary torque offset for I-par" SWORD md_q0p1 1 100 -3276.800 3276.700 FORMAT "%8.3" ECU_ADDRESS 0x7000A234 /end MEASUREMENT
/begin MEASUREMENT LIGov_trqLead "idle speed controller torque air path" SWORD md_q0p1 1 100 -3276.800 3276.700 FORMAT "%8.3" ECU_ADDRESS 0x70003A84 /end MEASUREMENT
/begin MEASUREMENT LIGov_trqMax "maximal idle speed torque" SWORD md_q0p1 1 100 -3276.800 3276.700 FORMAT "%8.3" ECU_ADDRESS 0x70003A82 /end MEASUREMENT
/begin MEASUREMENT LIGov_trqMin "minimum inner torque idle speed control" SWORD md_q0p1 1 100 -3276.800 3276.700 FORMAT "%8.3" ECU_ADDRESS 0x70003A80 /end MEASUREMENT
/begin MEASUREMENT LIGov_trqP "value for P-part of torque" SWORD md_q0p1 1 100 -3276.800 3276.700 FORMAT "%8.3" ECU_ADDRESS 0x70003A7E /end MEASUREMENT
/begin MEASUREMENT LIGov_trqPLead "P-part idle speed torque for air path" SWORD md_q0p1 1 100 -3276.800 3276.700 FORMAT "%8.3" ECU_ADDRESS 0x70003A7C /end MEASUREMENT
/begin MEASUREMENT LIGov_trqPreCtl "Precontrol of the drag torque" SWORD md_q0p1 1 100 -3276.800 3276.700 FORMAT "%8.3" ECU_ADDRESS 0x70003A7A /end MEASUREMENT
/begin MEASUREMENT LIGov_trqPRmp "torque ramp for the p-part of the idle speed controller" SWORD md_q0p1 1 100 0.00 3276.700 FORMAT "%8.3" ECU_ADDRESS 0x70002196 /end MEASUREMENT
/begin MEASUREMENT LIGov_tStrtloc "engine temperature at start" UBYTE temp_ub_q0p75_o48 1 100 -48.0 143.3 FORMAT "%5.1" ECU_ADDRESS 0x70002194 /end MEASUREMENT
/begin MEASUREMENT Linappl_flgFrstFrmAEV "Status of AEV communication of that frame is transmitted or received" UBYTE B_TRUE 1 100 0.00 1.00000000000 BIT_MASK 0x1 FORMAT "%13.11" ECU_ADDRESS 0x6000F92E /end MEASUREMENT
/begin MEASUREMENT Linappl_stFrmErr "Status of LIN error for every frame" UBYTE OneToOne 1 100 0.00 255.0 FORMAT "%5.1" ARRAY_SIZE 21 ECU_ADDRESS 0x6000FBE9 /end MEASUREMENT
/begin MEASUREMENT Linappl_stFrmErrOld "Old value for status of LIN error for every frame" UBYTE OneToOne 1 100 0.00 255.0 FORMAT "%5.1" ARRAY_SIZE 21 ECU_ADDRESS 0x6000FBFE /end MEASUREMENT
/begin MEASUREMENT Linappl_stFrmTxdRxd "Status of that frame is transmitted or received" ULONG OneToOne 1 100 0.00 4294967295.00 FORMAT "%13.2" ECU_ADDRESS 0x600038F8 /end MEASUREMENT
/begin MEASUREMENT Linappl_stFrstFrmRxd "Flag for first reception is done after IG-On for each frame" ULONG OneToOne 1 100 0.00 4294967295.00 FORMAT "%13.2" ECU_ADDRESS 0x600038F4 /end MEASUREMENT
/begin MEASUREMENT Linappl_stNodErr "LIN Node Error Status" UBYTE OneToOne 1 100 0.00 255.0 FORMAT "%5.1" ARRAY_SIZE 5 ECU_ADDRESS 0x6000B76A /end MEASUREMENT
/begin MEASUREMENT lmskh_w "Lambda engine nominal at catalyst heating (word)" UWORD fak_q0p000244 1 100 0.00 15.99976 FORMAT "%8.5" ECU_ADDRESS 0x6000732E /end MEASUREMENT
/begin MEASUREMENT lmsubng_w_msg "Lambda nominal unlimited (word)" UWORD fak_uw_b16 1 100 0.00 15.99976 FORMAT "%8.5" ECU_ADDRESS 0x60009340 /end MEASUREMENT
/begin MEASUREMENT maskeks "mask: knock sensor defect" UBYTE dez 1 100 0.00 255.0 FORMAT "%5.1" ECU_ADDRESS 0x6000B77D /end MEASUREMENT
/begin MEASUREMENT maskgz_old "mask: last guided cylinders" UBYTE dez 1 100 0.00 255.0 FORMAT "%5.1" ECU_ADDRESS 0x700021D7 /end MEASUREMENT
/begin MEASUREMENT masklz "mask: guiding cylinders" UBYTE dez 1 100 0.00 255.0 FORMAT "%5.1" ECU_ADDRESS 0x6000B77C /end MEASUREMENT
/begin MEASUREMENT mkrzwsp "Knock control: bit mask ignition retard of guiding cylinder >0" UBYTE dez 1 100 0.00 255.0 FORMAT "%5.1" ECU_ADDRESS 0x700021D6 /end MEASUREMENT
/begin MEASUREMENT nevabve "Number of fuel cut off requested by knock detection" UBYTE dez 1 100 0.00 255.0 FORMAT "%5.1" ARRAY_SIZE 4 ECU_ADDRESS 0x700021AB /end MEASUREMENT
/begin MEASUREMENT nevabvecum "Number of fuel cut off requested by knock detection cumulated for all cylinders" UBYTE dez 1 100 0.00 255.0 FORMAT "%5.1" ECU_ADDRESS 0x700021AA /end MEASUREMENT
/begin MEASUREMENT nrwcy "Number of the cylinder individual fuel enrichment" UBYTE dez 1 100 0.00 255.0 FORMAT "%5.1" ARRAY_SIZE 4 ECU_ADDRESS 0x700021A6 /end MEASUREMENT
/begin MEASUREMENT rkr2tp_l "reference level behind low pass for preignition" ULONG spg_q7p629Em7_V_ms 1 100 0.00 3276.79999924 FORMAT "%13.8" ECU_ADDRESS 0x70002200 /end MEASUREMENT
/begin MEASUREMENT rkrmn_w "current value of curve KLRKRMN" UWORD spg_q3p906Em4_V_ms 1 100 0.00 25.59961 FORMAT "%8.5" ECU_ADDRESS 0x60013DFC /end MEASUREMENT
/begin MEASUREMENT rkrmx1n_w "instantaneous value of the characteristic line RKRMX1N" UWORD spg_q3p906Em4_V_ms 1 100 0.00 25.59961 FORMAT "%8.5" ECU_ADDRESS 0x60013DFE /end MEASUREMENT
/begin MEASUREMENT rkrmx2n_w "instantaneous value of the characteristic line RKRMX2N" UWORD spg_q3p906Em4_V_ms 1 100 0.00 25.59961 FORMAT "%8.5" ECU_ADDRESS 0x60013E00 /end MEASUREMENT
/begin MEASUREMENT rkr_2_l "reference level knock control, 2. knock-window" ULONG spg_q7p629Em7_V_ms 1 100 0.00000076 3276.79999924 FORMAT "%13.8" ARRAY_SIZE 4 ECU_ADDRESS 0x700021F0 /end MEASUREMENT
/begin MEASUREMENT rkr_tst_l "reference level knock control updated with cyl.counter, 32bit" ULONG spg_q7p629Em7_V_ms 1 100 0.00 3276.79999924 FORMAT "%13.8" ECU_ADDRESS 0x70002220 /end MEASUREMENT
/begin MEASUREMENT SpdCtl_flgSynIninReqDrv "Initialization request during transition to Drive state for Synchro-task in Spdctl package." UBYTE B_TRUE 1 100 0.00 1.00000000000 BIT_MASK 0x1 FORMAT "%13.11" ECU_ADDRESS 0x7000079D /end MEASUREMENT
/begin MEASUREMENT SpdCtl_flgSynPstDrvBreak "Flag to prevent execution of Synchro-processes of Spdctl during Post-Drive state." UBYTE B_TRUE 1 100 0.00 1.00000000000 BIT_MASK 0x1 FORMAT "%13.11" ECU_ADDRESS 0x7000079C /end MEASUREMENT
/begin MEASUREMENT SpdCtl_flgSynStrtInitReq "Flag to indicate the start of Init of all the Synchro-tasks in Spdctl package." UBYTE B_TRUE 1 100 0.00 1.00000000000 BIT_MASK 0x1 FORMAT "%13.11" ECU_ADDRESS 0x7000079B /end MEASUREMENT
/begin MEASUREMENT stlamexhtm_msg "status of the lambda co-ordination of the exhaust temperature management" UBYTE dez 1 100 0.00 255.0 FORMAT "%5.1" ECU_ADDRESS 0x6000FB27 /end MEASUREMENT
/begin MEASUREMENT stuetz "engine speed adaptation range at load dynamics detection" UBYTE dez 1 100 0.00 255.0 FORMAT "%5.1" ECU_ADDRESS 0x60000923 /end MEASUREMENT
/begin MEASUREMENT taevkr "air temperature at inlet valve KR internal" UBYTE temp_ub_q0p75_o48 1 100 -48.0 143.3 FORMAT "%5.1" ECU_ADDRESS 0x70002229 /end MEASUREMENT
/begin MEASUREMENT tfrauf_w "Time constant for ramp back the air charge reduction factor" UWORD zk50msxs_uw_b3276p8 1 100 0.0500008 3276.8000000 FORMAT "%12.7" ECU_ADDRESS 0x60007338 /end MEASUREMENT
/begin MEASUREMENT tmcyla_w "engine temperature (eng. coolant or cyl. head), local copy" SWORD Temp_Cels 1 100 -3549.940 3003.560 FORMAT "%8.3" ECU_ADDRESS 0x600095CE /end MEASUREMENT
/begin MEASUREMENT tmotlanswl "local copy engine temperature (engine coolant or cylinder head)" UBYTE temp_ub_q0p75_o48 1 100 -48.0 143.3 FORMAT "%5.1" ECU_ADDRESS 0x6000FB1C /end MEASUREMENT
/begin MEASUREMENT tmstcyla_w "engine temperature at start (eng. coolant or cyl. head), local copy" SWORD Temp_Cels 1 100 -3549.940 3003.560 FORMAT "%8.3" ECU_ADDRESS 0x600095CC /end MEASUREMENT
/begin MEASUREMENT tmstlanswl "local copy engine start temperature (engine coolant or cylinder head)" UBYTE temp_ub_q0p75_o48 1 100 -48.0 143.3 FORMAT "%5.1" ECU_ADDRESS 0x6000FB1A /end MEASUREMENT
/begin MEASUREMENT veevCEngDsT_t "information tmot (temperature) at detected pre-ignition" SWORD Temp_Cels 1 100 -3549.940 3003.560 FORMAT "%8.3" ARRAY_SIZE 5 ECU_ADDRESS 0x600390DC /end MEASUREMENT
/begin MEASUREMENT veevDspl_lMlg "information kilometer stand at detected pre-ignition" SLONG Length_km 1 100 -2147483648.00 2147483647.00 FORMAT "%13.2" ARRAY_SIZE 5 ECU_ADDRESS 0x600390C8 /end MEASUREMENT
/begin MEASUREMENT veevEpm_nEng "information Engine speed at detected pre-ignition" SWORD EngN 1 100 -16384.00 16383.50 FORMAT "%8.2" ARRAY_SIZE 5 ECU_ADDRESS 0x600390BE /end MEASUREMENT
/begin MEASUREMENT veevIKCtl_cntrCyl "information cylinder counter at detected pre-ignition" UBYTE dez 1 100 0.00 255.0 FORMAT "%5.1" ARRAY_SIZE 5 ECU_ADDRESS 0x600390B8 /end MEASUREMENT
/begin MEASUREMENT veevIKCtl_facKnkInten_u8 "information knock intensity at detected pre-ignition" UBYTE fak_ub_b16 1 100 0.00 15.94 FORMAT "%5.2" ARRAY_SIZE 5 ECU_ADDRESS 0x600390B3 /end MEASUREMENT
/begin MEASUREMENT veevIKCtl_facPreIgnInten_u8 "information knock intensity at detected pre-ignition" UBYTE fak_ub_b16 1 100 0.00 15.94 FORMAT "%5.2" ARRAY_SIZE 5 ECU_ADDRESS 0x600390AE /end MEASUREMENT
/begin MEASUREMENT veevtans_msg "intake air temperature" UBYTE temp_q0p75_om48 1 100 -48.0 143.3 FORMAT "%5.1" ARRAY_SIZE 5 ECU_ADDRESS 0x600390A9 /end MEASUREMENT
/begin MEASUREMENT veevzwca0 "ignition angle output while pre-ignition detected" SBYTE zw_sb_q0p75 1 100 -96.00 95.25 FORMAT "%5.2" ARRAY_SIZE 5 ECU_ADDRESS 0x600390A4 /end MEASUREMENT
/begin MEASUREMENT veevzwca1 "ignition angle output while pre-ignition detected" SBYTE zw_sb_q0p75 1 100 -96.00 95.25 FORMAT "%5.2" ARRAY_SIZE 5 ECU_ADDRESS 0x6003909F /end MEASUREMENT
/begin MEASUREMENT veevzwca2 "ignition angle output while pre-ignition detected" SBYTE zw_sb_q0p75 1 100 -96.00 95.25 FORMAT "%5.2" ARRAY_SIZE 5 ECU_ADDRESS 0x6003909A /end MEASUREMENT
/begin MEASUREMENT veevzwca3 "ignition angle output while pre-ignition detected" SBYTE zw_sb_q0p75 1 100 -96.00 95.25 FORMAT "%5.2" ARRAY_SIZE 5 ECU_ADDRESS 0x60039095 /end MEASUREMENT
/begin MEASUREMENT vszwm "mean value of adjustment ignition angle with calibration tool (e.g. VS2x)" SBYTE kw_q0p75 1 100 -96.00 95.25 FORMAT "%5.2" ECU_ADDRESS 0x60000924 /end MEASUREMENT
/begin MEASUREMENT vtripkr_w "fuel consumption for low octane detection" UWORD vol_q3p90625Em3_l 1 100 0.00 255.9961 FORMAT "%8.4" ECU_ADDRESS 0x60039092 /end MEASUREMENT
/begin MEASUREMENT vtripold_w "fuel consumption of the last trip in L" UWORD vol_q3p90625Em3_l 1 100 0.00 255.9961 FORMAT "%8.4" ECU_ADDRESS 0x60039090 /end MEASUREMENT
/begin MEASUREMENT wkrdyaa "adaptation part of dynamic ignition retard" SBYTE kw_q0p75 1 100 -96.00 95.25 FORMAT "%5.2" ECU_ADDRESS 0x60000925 /end MEASUREMENT
/begin MEASUREMENT wkrdyti "tip in part of dynamic ignition retard" SBYTE kw_q0p75 1 100 -96.00 95.25 FORMAT "%5.2" ECU_ADDRESS 0x70002228 /end MEASUREMENT
/begin MEASUREMENT wkrlzofv_bits "Filtering from Offset of guided cylinder is running" UBYTE dez 1 100 0.00 255.0 FORMAT "%5.1" ECU_ADDRESS 0x700021D5 /end MEASUREMENT
/begin MEASUREMENT zaldy "Ignition counter for deactivation of load dynamics" UBYTE dez 1 100 0.00 255.0 FORMAT "%5.1" ECU_ADDRESS 0x60000929 /end MEASUREMENT
/begin MEASUREMENT zkrfmu "Counter of filter frequency changes, KC" UBYTE dez 1 100 0.00 255.0 FORMAT "%5.1" ARRAY_SIZE 4 ECU_ADDRESS 0x50000580 /end MEASUREMENT
/begin MEASUREMENT zkrvecyl "Timer for decrement the counter ctrveev (fuel cut)" UBYTE dez 1 100 0.00 255.0 FORMAT "%5.1" ARRAY_SIZE 4 ECU_ADDRESS 0x700021A2 /end MEASUREMENT
/begin MEASUREMENT zkrvf "counter, determines the frequency of the cylinder-individual ignition angle advancing" UBYTE t_q0p1 1 100 0.00 25.50 FORMAT "%5.2" ARRAY_SIZE 4 ECU_ADDRESS 0x600004B0 /end MEASUREMENT
/begin MEASUREMENT zlamkod "Number of the highest-prioritized lambda request from diagnosis functions" UBYTE dez 1 100 0.00 255.0 FORMAT "%5.1" ECU_ADDRESS 0x60000D43 /end MEASUREMENT
/begin MEASUREMENT zlamkoz "Number of the lambda request determining the lambda setpoint (intermediate value)" UBYTE dez 1 100 0.00 255.0 FORMAT "%5.1" ECU_ADDRESS 0x60000EF5 /end MEASUREMENT
/begin MEASUREMENT zlamkozc "Number of the lambda request determining the lambda setpoint (copy of intermediate value)" UBYTE dez 1 100 0.00 255.0 FORMAT "%5.1" ECU_ADDRESS 0x6000FB12 /end MEASUREMENT
/begin MEASUREMENT zlamko_msg "Number of the lambda request determining the lambda setpoint" UBYTE dez 1 100 0.00 255.0 FORMAT "%5.1" ECU_ADDRESS 0x600009A5 /end MEASUREMENT
/begin MEASUREMENT zoffset "counter for ignition angle offset of guiding cylinder" UBYTE dez 1 100 0.00 255.0 FORMAT "%5.1" ARRAY_SIZE 4 ECU_ADDRESS 0x700021D1 /end MEASUREMENT
/begin MEASUREMENT zzprz "percentage of ignitions with kc determined ign. angle during dynamics" UBYTE rel_q0p39 1 100 0.00 99.61 FORMAT "%5.2" ECU_ADDRESS 0x6000092A /end MEASUREMENT
/begin MEASUREMENT zzwdykr_w "ignition counter for knock control with used knock ignition retardation during knock control dynamic" UWORD dez 1 100 0.00 65535.00 FORMAT "%8.2" ECU_ADDRESS 0x60000622 /end MEASUREMENT
/begin MEASUREMENT zzwdymd_w "ignition counter for knock control without used knock ignition retardation during knock control dynamic" UWORD dez 1 100 0.00 65535.00 FORMAT "%8.2" ECU_ADDRESS 0x60000624 /end MEASUREMENT
/begin FUNCTION KONCW "9000.13.0_3.1.0Configuration via code words"
 /begin DEF_CHARACTERISTIC CDDST CDDTESK CDEFST CDEONV CDFSTR CDTANKL CDTESPL CWMDAPP CWMDAPP1 /end DEF_CHARACTERISTIC
 /begin OUT_MEASUREMENT B_cddst_msg B_cddtesk_msg B_cdeonv_msg B_cdfstr_msg B_cdfst_msg B_cdtankl_msg B_cdtespl_msg B_fgkfhst_msg B_fpwdkap_msg B_hldstfw_msg B_tvfwldst_msg B_tvkfldst_msg B_wdksap_msg B_zwappl_msg KONCW_flgRatLoadCalMod /end OUT_MEASUREMENT
 FUNCTION_VERSION "9000.13.0_3.1.0" /end FUNCTION
/begin FUNCTION KRADAP "16.2.0    Knock control: stationary adaptation"
 /begin DEF_CHARACTERISTIC CWVEVKRA IKCtl_agAdpnRedn_C IKCtl_agAdvLrng_C IKCtl_agMaxRtdAdjmt_C IKCtl_agMinDstAdpnLrng_C IKCtl_agRtdtLrng_C KRTNSEO KRVFZGO /end DEF_CHARACTERISTIC
 /begin IN_MEASUREMENT Eep_EnvRamHist Eep_EnvRamInvld Ign_bVlvLInNxtCmbs IKCtl_agKnkInt_as16 IKCtl_agKnkLimrCurr_s16 IKCtl_agMaxRtdtCurr_s16 IKCtl_cntrCyl IKCtl_flgAdpnEna IKCtl_flgAdpnLrnEna IKCtl_flgAdvIa IKCtl_flgKnkDetn IKCtl_flgKnkEna IKCtl_flgSftyRtdt IKCtl_idxAdpn_u16 IKCtl_stVldnSnsrSig SyC_ctPostDrvLeave SyC_stSub tnsez_w_msg VehV_v /end IN_MEASUREMENT
 /begin OUT_MEASUREMENT IKCtl_agAdpnCurr_s16 IKCtl_agAdpnVlvLft_as16 IKCtl_agAdpn_as16 /end OUT_MEASUREMENT
 /begin LOC_MEASUREMENT IKCtl_ctReIni100msKRADAP kradapred /end LOC_MEASUREMENT
 FUNCTION_VERSION "16.2.0" /end FUNCTION
/begin FUNCTION KRDY "7.5.0     Knock control for load dynamics"
 /begin DEF_CHARACTERISTIC CWKRDYE DYADMAX DYADS DYAFVS DYAMNV FKELDYA IKCtl_facDynAdpnFFV_GT IKCtl_facDynAdpn_M IKCtl_facTipinFFV_GM IKCtl_nrCmbPremDynOffs_M PZWKRA /end DEF_CHARACTERISTIC
 /begin REF_CHARACTERISTIC IKCtl_fac04_X_AX IKCtl_nEng08_X_AX /end REF_CHARACTERISTIC
 /begin IN_MEASUREMENT B_eepwf_msg Epm_nEng fethmnmx_msg IKCtl_cntrCyl IKCtl_facKnkInten_u8 IKCtl_flgDynAdpnEna IKCtl_flgDynAdpnRead IKCtl_flgKnkDetn IKCtl_flgLoadDynAdpn IKCtl_flgLoadDynAdpnAdv IKCtl_flgLoadDynCtrlEna IKCtl_flgRtdtUse IKCtl_flgTEna IKCtl_flgTipinDetn IKCtl_idxSpdAdpn_u8 IKCtl_wDetnThdCorr_au8 SyC_ctPostDrvLeave SyC_stSub taev_w_msg tans_msg /end IN_MEASUREMENT
 /begin OUT_MEASUREMENT IKCtl_agDynAdpnOffs_s8 IKCtl_agDynAdpn_as8 /end OUT_MEASUREMENT
 /begin LOC_MEASUREMENT B_kldynrm B_kldystk dymntvs IKCtl_ctReIni10msKRDY IKCtl_tmpReIniKRDY stuetz taevkr wkrdyaa wkrdyti zaldy zzprz zzwdykr_w zzwdymd_w /end LOC_MEASUREMENT
 FUNCTION_VERSION "7.5.0" /end FUNCTION
/begin FUNCTION KRKE "42.4.0    Knocking detection"
 /begin DEF_CHARACTERISTIC CWKRINT CWKRREF CWREFI FETHKRREFI FKEFMC IKCtl_facCorrnInj_C IKCtl_facCorrnLoadDyn_GT IKCtl_facCorrnNDyn_GT IKCtl_FacKnockDetCorrnThd0_GM IKCtl_FacKnockDetCorrnThd1_GM IKCtl_FacKnockDetCorrnThd2_GM IKCtl_FacKnockDetCorrnThd3_GM IKCtl_FacKnockDetThd0_GM IKCtl_FacKnockDetThd1_GM IKCtl_FacKnockDetThd2_GM IKCtl_FacKnockDetThd3_GM IKCtl_FacKnockTrck_AX IKCtl_facMaxLpFilKnkDetn_T IKCtl_stCorrFil_C IKCtl_stKnkSeln_C IKCtl_stRefLvlReIni_C IKCtl_wStrtRef_C KFKRINT1G KFKRINT2G KFKRINT3G KLFRKRINI KLRKRMN KRFTP2 KRFTP3 KRKFKS KRNGFILO KRNGFILU NKRREFIE RKRMX1N RKRMX2N TKRREFIE TKRVHEU ZKRNGFIL ZYRKR /end DEF_CHARACTERISTIC
 /begin REF_CHARACTERISTIC IKCtl_fac04_X_AX IKCtl_nEng06_X_AX IKCtl_nEngVar13_X_AX IKCtl_ratLoad04_X_AX /end REF_CHARACTERISTIC
 /begin IN_MEASUREMENT AirMod_ratChrgAirCyl EngStrt_bStrtEnd Epm_dnEngAvg Epm_nEng Epm_nEngLRes Epm_numCyl fethmnmx_msg Ign_bVlvLInNxtCmbs IKCtl_cntrCyl IKCtl_flgFilSwt IKCtl_flgKnkEna IKCtl_flgKnkLimp IKCtl_flgLoadDynDetn IKCtl_flgSpdDynDetn IKCtl_idxFilSwt IKCtl_IntglCh1_au32 IKCtl_IntglCh2_au32 IKCtl_IntglCh3_au32 IKCtl_stInjRefCorr IKCtl_stVldnSnsrSig SyC_ctPostDrvLeave SyC_stSub /end IN_MEASUREMENT
 /begin OUT_MEASUREMENT IKCtl_facKnkInten_au8 IKCtl_facKnkInten_u8 IKCtl_flgKnkDetn IKCtl_nFildGrad_s8 IKCtl_stFilSwt IKCtl_wDetnThdCorr_au8 IKCtl_wIntglResLoc_u32 IKCtl_wIntglRes_au32 IKCtl_wIntgRef_au32 IKCtl_wRefMax_u32 /end OUT_MEASUREMENT
 /begin LOC_MEASUREMENT frkrini IKCtl_ctReIniKRKE IKCtl_facCorrnLoadDyn IKCtl_facCorrnSpdDyn IKCtl_flgTranActv IKCtl_flgTranRefIniTmp IKCtl_stCylRefIniEna IKCtl_wMaxLpFilKnk_u32 ke kek_tst krftpakt krftpst rkrmn_w rkrmx1n_w rkrmx2n_w rkr_tst_l zkrfmu /end LOC_MEASUREMENT
 FUNCTION_VERSION "42.4.0" /end FUNCTION
/begin FUNCTION KRKEVE "3.14.0    Pre-Ignition detection through knocking combustion"
 /begin DEF_CHARACTERISTIC CVESEREV CWKR2INT CWRSKRTP CWSKRREF CWVEREFI FRKR2KOR FSKEFMC FSKELDY FSKENDY IKCtl_EnaPreIgnWoKnkEna_C IKCtl_facDetnThdPreIgn0_GM IKCtl_facDetnThdPreIgn1_GM IKCtl_facDetnThdPreIgn2_GM IKCtl_facDetnThdPreIgn3_GM IKCtl_facEthMax IKCtl_facMaxLpFilPreIgnDetn_T IKCtl_FacPreIgnTrck_AX IKCtl_facTThdLoadPreIgn IKCtl_ratHysLoadPreIgn_C IKCtl_ratLoadThdPreIgn_T IKCtl_wStrtEndRef_C KFKR2INT1G KFKR2INT2G KFKR2INT3G KR2FTP2 KR2FTP3 KR2KFKS OFSKEKLZYL /end DEF_CHARACTERISTIC
 /begin REF_CHARACTERISTIC IKCtl_nEngVar13_X_AX IKCtl_ratLoad04_X_AX IKCtl_stCorrFil_C /end REF_CHARACTERISTIC
 /begin IN_MEASUREMENT AirMod_ratChrgAirCyl CEngDsT_t Eep_EnvRamHist Eep_EnvRamInvld EngStrt_bStrtEnd Epm_nEng Epm_numCyl fethmnmx_w_msg GlbDa_lTotDst Ign_iacalc_as8 IKCtl_cntrCyl IKCtl_facKnkInten_u8 IKCtl_flgKnkDetn IKCtl_flgKnkEna IKCtl_flgKnkLimp IKCtl_flgLoadDynCtrlEna IKCtl_flgLoadDynDetn IKCtl_flgSftyRtdt IKCtl_flgSpdDynDetn IKCtl_idxFilSwt IKCtl_nFildGrad_s8 IKCtl_PreIgnIntglCh1_au32 IKCtl_PreIgnIntglCh2_au32 IKCtl_PreIgnIntglCh3_au32 IKCtl_stFilSwt IKCtl_stPreIgnMeasWin IKCtl_stSnsrErr_u8 SyC_ctPostDrvLeave SyC_stSub tans_msg /end IN_MEASUREMENT
 /begin OUT_MEASUREMENT IKCtl_cntrPreIgnDetn IKCtl_facDetnThdPreIgn_au8 IKCtl_facPreIgnInten_au8 IKCtl_facPreIgnInten_u8 IKCtl_flgPreIgnDetn IKCtl_flgPreIgnEna IKCtl_flgSftyRtdtPreIgn IKCtl_ratLoadRefLvl IKCtl_wIntglResPreIgn_u32 IKCtl_wRefMaxPreIgn_u32 veevCEngDsT_t veevDspl_lMlg veevEpm_nEng veevIKCtl_cntrCyl veevIKCtl_facKnkInten_u8 veevIKCtl_facPreIgnInten_u8 veevtans_msg veevzwca0 veevzwca1 veevzwca2 veevzwca3 /end OUT_MEASUREMENT
 /begin LOC_MEASUREMENT B_klzyl2 IKCtl_cntrReIniSyncKRKEVE IKCtl_ctReIniKRKEVE IKCtl_wMaxLpFilPreIgn ikr2_l ke02 kek2_tst kr2ftpakt kr2ftpst rkr2tp_l rkr_2_l /end LOC_MEASUREMENT
 FUNCTION_VERSION "3.14.0" /end FUNCTION
/begin FUNCTION KRLZ "3.5.0     Knock control: guide cylinder function"
 /begin DEF_CHARACTERISTIC IKCtl_facOffsGdCyl_M IKCtl_facThdMaxGdCly IKCtl_facThdMinGdCly IKCtl_iaOffsGdCyl_M IKCtl_iaOffsKnkSnsrErr_C IKCtl_ratLoadThdGdCyl_CA IKCtl_stLimp_C LZFUERV MINAKRLZ TKRLZAMN /end DEF_CHARACTERISTIC
 /begin REF_CHARACTERISTIC IKCtl_idxAsgnSnsr_CA /end REF_CHARACTERISTIC
 /begin IN_MEASUREMENT AirMod_ratChrgAirCyl Epm_nEng Epm_numCyl IKCtl_agKnkInt_as16 IKCtl_flgKnkEna IKCtl_flgKnkLimp IKCtl_stInjDTot_b8 IKCtl_stSnsrErr_u8 SyC_stSub /end IN_MEASUREMENT
 /begin OUT_MEASUREMENT IKCtl_cntrGdCyl_au8 IKCtl_flgSftyRtdtGdCyl IKCtl_iaOffsGdCyl_as16 IKCtl_stMaskGdCly_b8 /end OUT_MEASUREMENT
 /begin LOC_MEASUREMENT akrgz akrlz B_elzmn B_krlz B_krnlzdws B_lzup IKCtl_nrCylFineResl_u8 IKCtl_stReIniKRLZ krlzn krlzsfytm maskeks masklz /end LOC_MEASUREMENT
 FUNCTION_VERSION "3.5.0" /end FUNCTION
/begin FUNCTION KRREG "32.8.0    Knock control: stationary control"
 /begin DEF_CHARACTERISTIC CWKRDWS CWKRLZFK CWKRLZOFV CWKROFFGZ CWRLXDZW CWVEVKR CWVFN DWKRZMN DWKRZRLX IKCtl_agKnkRtdt_M IKCtl_agLimnAdpnLoadDyn_M IKCtl_agLimnAdpnPosDeLoadDyn_M IKCtl_agLimnAdpnPosDeSpdDyn_M IKCtl_agLimnAdpnSpdDyn_M IKCtl_agLowrDistRtdt_GT IKCtl_agMaxRtdtCurr_M IKCtl_agMaxRtdtFlexfu_M IKCtl_agUpprDistRtdt_GT IKCtl_facAirChRednFu_T IKCtl_facEndAirChRednFu_T IKCtl_facMaxAirCh_T IKCtl_facMaxRtdtHiVlvLftFlexfu_M IKCtl_facMaxRtdtHiVlvLft_M IKCtl_facMaxRtdtLoVlvLftFlexfu_M IKCtl_facMaxRtdtLoVlvLft_M IKCtl_facNMaxAirCh_T IKCtl_facSftyRtdtHiVlvLftFlexfu_M IKCtl_facSftyRtdtHiVlvLft_M IKCtl_facSftyRtdtLoVlvLftFlexfu_M IKCtl_facSftyRtdtLoVlvLft_M IKCtl_facTiFastKnkPrem_GT IKCtl_facTiFilgRednRamp_T IKCtl_facTiFilgRedn_T IKCtl_iaSftyRtdtFlexFu_M IKCtl_iaSftyRtdt_M IKCtl_ratLoadThdIaEta_T IKCtl_ratLoadThdLlKnk_T IKCtl_tiTmrAdv_M KROFFV TDKRFFV TDZW TFDZWAB TFDZWAUF TWKRLZOFV VTRIPMN VZWKR /end DEF_CHARACTERISTIC
 /begin REF_CHARACTERISTIC Ign_diaAPP_C IKCtl_nEng08_X_AX /end REF_CHARACTERISTIC
 /begin IN_MEASUREMENT AirMod_ratChrgAirCyl B_llri_msg B_tankg_msg B_tank_msg CEngDsT_t DSM_TripChgFinshd dzwwl_msg Eep_EnvRamHist Eep_EnvRamInvld Epm_nEng Epm_numCyl evz_austot_msg Ign_bVlvLInNxtIAs Ign_diaKperm_s8 Ign_fac2F_iaPr Ign_flgIAmapsyn Ign_stiaBasKnk IKCtl_agAdpn_as16 IKCtl_cntrCyl IKCtl_cntrGdCyl_au8 IKCtl_facFillgRedPreIgn_u16 IKCtl_facKnkInten_u8 IKCtl_flgAdpnWrEna IKCtl_flgFastAdvIa IKCtl_flgGdCyl IKCtl_flgInjD IKCtl_flgKnkDetn IKCtl_flgKnkEna IKCtl_flgPreIgnDetn IKCtl_flgSftyRtdt IKCtl_iaOffsGdCyl_as16 IKCtl_idxAdpn_u16 IKCtl_nFildGrad_s8 IKCtl_pPfiSp IKCtl_stInjDTot_b8 IKCtl_stMaskGdCly_b8 IKCtl_stVldnSnsrSig InjSys_volFuConsDrvCyc SyC_ctPostDrvLeave SyC_stSub /end IN_MEASUREMENT
 /begin OUT_MEASUREMENT dzwflt_w_msg IKCtl_agKnkAvrgGen_s16 IKCtl_agKnkAvrgGen_s8 IKCtl_agKnkAvrg_s16 IKCtl_agKnkAvrg_s8 IKCtl_agKnkInt_as16 IKCtl_agKnkInt_as8 IKCtl_agKnkLimrCurr_s16 IKCtl_agKnkRtdtAry_s16 IKCtl_agKnkRtdt_as8 IKCtl_agKnkRtdt_s16 IKCtl_agKnkRtdt_s8 IKCtl_agMaxRtdtCurr_s16 IKCtl_agMaxRtdtCurr_s8 IKCtl_facFillgRed_u16 IKCtl_flgAdpnWrEnaCopy IKCtl_flgAdvIa IKCtl_flgRtdtMax /end OUT_MEASUREMENT
 /begin LOC_MEASUREMENT B_dwkrzrlx B_rlmxkr B_tankgkr dzwbf dzwrlx_w frlmxkr_w IKCtl_agKnkIntCurr_s16 IKCtl_agKnkMaxLim IKCtl_agMaxRtdtCurrLoc_s16 IKCtl_agRtdtCurrOutp_s16 IKCtl_agRtdtCurr_as16 IKCtl_agRtdtLowrCurr_s16 IKCtl_agRtdtLowr_s16 IKCtl_agRtdtUpprCurr_s16 IKCtl_agRtdtUppr_s16 IKCtl_cntrReIni100msKRREG IKCtl_cntrReIniSyncKRREG IKCtl_ctReIni50msKRREG IKCtl_facMaxAirChAg IKCtl_iaOffsfildGdCyl_as16 IKCtl_tEngLoc_s16 klopfakt krdwsw krvfswz krvfwz maskgz_old mkrzwsp vszwm vtripkr_w vtripold_w wkrlzofv_bits zkrvf zoffset /end LOC_MEASUREMENT
 FUNCTION_VERSION "32.8.0" /end FUNCTION
/begin FUNCTION KRVEKO "4.10.0    Coordination of measures against pre-ignition"
 /begin DEF_CHARACTERISTIC ADCVERL ADCVERL2 ANWPEDMX AVEESCYL AVERLMXL CNTNRWCY CWEVMZVE CWKRVECTR CWKRVEKO FRLVE2 FVERL IKCtl_facDurnReqCvlci_T IKCtl_facDurnReqEnchmt_T IKCtl_facDurnReqInjD_T IKCtl_facDurnReqRedFillg_T IKCtl_facReqRedFillgPrmnt_T IKCtl_facReqRedFillg_T IKCtl_facSftyRtdtPreIgn_T IKCtl_facThdReqCvlci_T IKCtl_facThdReqEnchmt_T IKCtl_facThdReqInjD_T IKCtl_facThdReqRedFillg_T IKCtl_ratHysDelta_C IKCtl_ratLoadThdCvlci_T IKCtl_ratLoadThdEnchmt_T IKCtl_ratLoadThdInjD_T IKCtl_stActvAreas_C KLNRWCY KLRLVEN2 KRVEZ NEVABRLMXL TCTRLBT TCTRNW TCTRRL TCTRRLL TDVERL TFRLAB TFRLAUF TFRLAUFL /end DEF_CHARACTERISTIC
 /begin IN_MEASUREMENT AirMod_ratChrgAirCyl APP_r DSM_TripChgFinshd Eep_EnvRamInvld EngStrt_bFrstStrtEnd Epm_nEng IKCtl_cntrCyl IKCtl_flgPreIgnDetn IKCtl_flgPreIgnEna IKCtl_flgSftyRtdtPreIgn SyC_ctPostDrvLeave SyC_stSub tans_msg /end IN_MEASUREMENT
 /begin OUT_MEASUREMENT IKCtl_cntCylCurr IKCtl_cntCylPreIgn_au8 IKCtl_cntrCvlciActv IKCtl_cntrCvlciRdy IKCtl_cntrCylPreIgn_au16 IKCtl_cntrEnchmtActv IKCtl_cntrEnchmtCylActv IKCtl_cntrEnchmtCylRdy IKCtl_cntrEnchmtRdy IKCtl_cntrFcoActv IKCtl_cntrFcoRdy IKCtl_cntrFrzFrm_au8 IKCtl_cntrRedFillgActv IKCtl_cntrRedFillgPrmntActv IKCtl_facFillgRedPreIgn_u16 IKCtl_flgReqCvlci IKCtl_flgReqEnchmt IKCtl_flgReqInjTiCyl IKCtl_flgReqRedFillg IKCtl_flgReqRedFillgPrmnt IKCtl_nEngCurr IKCtl_nEngPreIgn_as16 IKCtl_numReqInjTi IKCtl_ratChrgAirCurr IKCtl_ratChrgAirPreIgn_au16 IKCtl_stReqInjD_b8 IKCtl_stReqInjTiCyl_b8 /end OUT_MEASUREMENT
 /begin LOC_MEASUREMENT B_rlmxve2 B_rlmxve2r B_rlmxvel2 B_rlmxveold clrzzylkr ctrnrwcy ctrveescyl ctrveev ctrveevmx ctrvelbt ctrvenw ctrverl ctrverll ctrwped dcycntkr dcycntkr2 evmzveold frlmxtmp_w IKCtl_ctReIni10msKRVEKO IKCtl_flgCvlciArea IKCtl_flgEnchmtArea IKCtl_flgInjDArea IKCtl_flgReqCvlciTmp IKCtl_flgReqEnchmtTmp IKCtl_stReqInjDTmp IKCtl_stReqInjTiCylTmp IKCtl_tiReqCvlci IKCtl_tiReqEnchmt IKCtl_tmpReIniKRVEKO nevabve nevabvecum nrwcy tfrauf_w zkrvecyl /end LOC_MEASUREMENT
 FUNCTION_VERSION "4.10.0" /end FUNCTION
/begin FUNCTION LAKH "10.36.0   Lambda coordination for catalyst heating"
 /begin DEF_CHARACTERISTIC ExhMgT_ratLamCatHeatgIdleModSecFu_M ExhMgT_ratLamCatHeatgIdleMod_M ExhMgT_ratLamCatHeatgStrtSecFu_M ExhMgT_ratLamCatHeatgStrt_M ExhMgT_stCatHeatgLam2_C ExhMgT_stCatHeatgLam3_C ExhMgT_stCatHeatgLam_C ExhMgt_tiCatHeatgLamIdle_C ExhMgt_tiCatHeatgLamPartLoad_C ExhMgT_tiLamCatHeatgStrt_C KFLMSKH KFLMSKHSF KLLAKHFH LAMXHOMKH LMSTMOT /end DEF_CHARACTERISTIC
 /begin IN_MEASUREMENT AirMod_ratChrgAirCyl anztib_w_msg B_ethadap_msg B_ethhte_msg B_hsps_msg B_kha_msg B_kh_msg B_ll_msg CEngDsT_t CEngDsT_tStrt Epm_nEng fethmnmx_w_msg flakh_msg Ign_flgHspNxtCmb PEnv_facCorrAlti SyC_ctPostDrvLeave SyC_stSub /end IN_MEASUREMENT
 /begin OUT_MEASUREMENT B_lamkhe_msg B_lamkh_msg ExhMgt_facIntrpnCatHeatg flamsl_w_msg lamkh_w_msg /end OUT_MEASUREMENT
 /begin LOC_MEASUREMENT ExhMgT_cntrReIniCoornLamCatHeatg100ms ExhMgT_cntrReIniCoornLamCatHeatg10ms ExhMgT_flgCdnCatHeat ExhMgT_ratLamCatHeatg ExhMgT_ratLamEngNomB1 lamkhg_w lamkhr_w lanskh_w lmskh_w tmcyla_w tmstcyla_w /end LOC_MEASUREMENT
 FUNCTION_VERSION "10.36.0" /end FUNCTION
/begin FUNCTION LAMCOREXMT "3.6.0     lambda coordination for exhaust temperature management" /begin DEF_CHARACTERISTIC ExhMgT_stLamCoornExhMngt_C /end DEF_CHARACTERISTIC
 /begin IN_MEASUREMENT B_khakt_msg B_kh_msg B_lambts_msg B_lamkh_msg ExhMgT_flgLamFuFco ExhMgT_ratLamFuFco lambts_w_msg lamkh_w_msg SyC_stSub /end IN_MEASUREMENT
 /begin OUT_MEASUREMENT ExhMgT_ratLamExhB1 ExhMgT_stLamExhB1 lamexht_w_msg stlamexhtm_msg /end OUT_MEASUREMENT
 FUNCTION_VERSION "3.6.0" /end FUNCTION
/begin FUNCTION LamCtrl_PrmId03 "3.0.0_1.0.1Tester output of lambda control status (PID 03hex)"
 /begin IN_MEASUREMENT B_elsxbb_msg B_eobdlr_msg B_lrmstr_msg B_lrs_msg B_pspwl_msg B_sbblsu_msg Epm_nEng LamCtrl_flgEnlnmtProtActvB1 LamCtrl_flgLamBlwMinB1 SyC_stSub /end IN_MEASUREMENT
 /begin OUT_MEASUREMENT flglrs2_msg flglrs_msg LamCtrl_stBytA LamCtrl_stBytAInter LamCtrl_stBytAInterDeb LamCtrl_stBytAOld LamCtrl_stBytB /end OUT_MEASUREMENT
 /begin LOC_MEASUREMENT LamCtrl_flgClsdLoopB1 LamCtrl_flgClsdLoopFltB1 LamCtrl_flgEngWrmUpB1 LamCtrl_flgFltRdnS1B1 LamCtrl_flgFltS1B1 LamCtrl_flgOpenLoopB1 LamCtrl_flgOpenLoopFltB1 /end LOC_MEASUREMENT
 FUNCTION_VERSION "3.0.0_1.0.1" /end FUNCTION
/begin FUNCTION LAMKO "5.36.1_1.4.0Lambda coordination"
 /begin DEF_CHARACTERISTIC CWLAMKO CWLAMKOAP KFLAMHAP LamCtrl_ratLamSpCdaGbx_Crv LamCtrl_ratLamSpFcoB1_M LAMHAP LASOABDMD TLASOABDQ /end DEF_CHARACTERISTIC
 /begin IN_MEASUREMENT B_bevab_msg B_hos_msg B_lamnswl_msg B_zwget_msg CoEOM_bHLN CoEOM_bHOM EGSDCmn_flgLamReqParlB1 EGSDCmn_ratLamReqParlB1 Epm_nEng ExhMod_mfExhCat1B1 ExhMod_tCat1B1 IKCtl_flgReqEnchmtWithInteg IKCtl_ratLamPreIgn lamax_w_msg lamexht_w_msg lamin_w_msg lamnswl_w_msg MisfDet_stCatDmgFcoCyl rl_w_msg stlamexhtm_msg SyC_stSub TWCC_bEnaRichPurgB1 TWCC_rLamSetPPurgB1 /end IN_MEASUREMENT
 /begin OUT_MEASUREMENT B_lalgf_msg B_lamdiag_msg B_lamsdef_msg lambas_msg lambas_w_msg lamdiag_w_msg lamlgm_w_msg lamsbg_w_msg lams_w_msg lmsubng_w_msg zlamko_msg /end OUT_MEASUREMENT
 /begin LOC_MEASUREMENT B_ldef LamCtrl_bHLN LamCtrl_bHOM LamCtrl_bHOS LamCtrl_mfExhCat1B1 LamCtrl_ratLamSpCdaGbxB1 LamCtrl_tCat1B1 lamhsbg_w lamsubg_w lamwbr_w zlamkod zlamkoz zlamkozc /end LOC_MEASUREMENT
 FUNCTION_VERSION "5.36.1_1.4.0" /end FUNCTION
/begin FUNCTION LANSWL "10.14.0_1.2.0Lambda during afterstart and warm-up"
 /begin DEF_CHARACTERISTIC ATISLATX ATIWKSTX CWANZTIB CWWL DLAMNSWL EngStrt_facAlti_T EngStrt_facEngNomWrmLam_M EngStrt_facEngNomWrm_M EngStrt_facHiAlti_T EngStrt_facLamDurgAftStrt_M EngStrt_facLamEngAftStrt_M EngStrt_facLamWrmUpIntkP_CUR KFLANS KFLANSETH KFLASWLRTE KFLASWLRTX LASWLTX TLANSWL /end DEF_CHARACTERISTIC
 /begin IN_MEASUREMENT anztib_w_msg B_lrnda_msg B_stendes_msg B_wks_msg CEngDsT_t CEngDsT_tStrt EngStrt_bStrtEnd EngStrt_flgDrctStrt fipoleth_msg PEnv_facCorrAlti ps_w_msg SyC_ctPostDrvLeave /end IN_MEASUREMENT
 /begin OUT_MEASUREMENT anztib1_w_msg B_lamnswl_msg lamnswl_w_msg lamns_w_msg /end OUT_MEASUREMENT
 /begin LOC_MEASUREMENT anztib0_w anztib1_w_Loc B_lawlon EngStrt_ctReIniLANSWL10ms EngStrt_ctReIniLANSWL200ms EngStrt_facLamWrmUpAftStrt lamwl_w tmotlanswl tmstlanswl /end LOC_MEASUREMENT
 FUNCTION_VERSION "10.14.0_1.2.0" /end FUNCTION
/begin FUNCTION LCSwt_DD "4.0.0     Device driver for light control switch" /begin IN_MEASUREMENT Com_stLiSwtInfo T15_st /end IN_MEASUREMENT /begin OUT_MEASUREMENT HdLi_flgActv /end OUT_MEASUREMENT FUNCTION_VERSION "4.0.0" /end FUNCTION
/begin FUNCTION LIGov_Adap "2.12.0    Adapter for Function Group LIGov" /begin DEF_CHARACTERISTIC LIGov_numParCnv_CUR /end DEF_CHARACTERISTIC /begin IN_MEASUREMENT LIGov_numPar /end IN_MEASUREMENT /begin OUT_MEASUREMENT LIGov_bParChngTrqP LIGov_numParTrqI LIGov_numParTrqP /end OUT_MEASUREMENT FUNCTION_VERSION "2.12.0" /end FUNCTION
/begin FUNCTION LIGov_Governor "2.32.0    idle speed controller"
 /begin DEF_CHARACTERISTIC LIGov_facDeadZoneEngLoad_T LIGov_facEngLoadLvl_M LIGov_facPreCtlRmpDwn_C LIGov_facPreCtlRmpGrip_C LIGov_facPreCtlRmpNoGrip_C LIGov_facTrqMax_CUR LIGov_flgSrvCouplrSwtCdnDi_C LIGov_Gov_CW LIGov_pwrMax_C LIGov_tiPLeadOfs_C LIGov_tqIntglSrvCouplrSwtActv_M LIGov_tqMin_C LIGov_trqDiffMaxParChng_C LIGov_trqI_MAP LIGov_trqMaxI_CUR LIGov_trqMax_C LIGov_trqOfsHi_C LIGov_trqOfsPtd_CUR LIGov_trqPLead_MAP LIGov_trqPRmp_C LIGov_trqP_MAP LIGov_trqRstIntrv_C /end DEF_CHARACTERISTIC
 /begin IN_MEASUREMENT ActMod_trqInrWoDstC CEngDsT_tStrt CoEng_bStrtEndTrqStruct CoEng_flgRelsFco CoVeh_trqDesComp EpmCrS_tiSeg Epm_nEng HLSDem_nSetPLo HLSDem_nSetPLoDiff LIGov_bExtTrqDem LIGov_bFrzI LIGov_bInactv LIGov_bNoGrip LIGov_bParChngTrqP LIGov_bRstI LIGov_nDiff LIGov_nDiffOld LIGov_numParTrqI LIGov_numParTrqP PthSet_bOvrRun PthSet_stOvrRunPhActv RngMod_trqComp RngMod_trqDiffAdap RngMod_trqInrMinWoCtOff RngMod_trqLosEng RngMod_trqLosTot SpdCtl_flgSynPstDrvBreak SpdCtl_flgSynStrtInitReq SrvCSwt_st tnst_w_msg /end IN_MEASUREMENT
 /begin OUT_MEASUREMENT LIGov_bRmpDwn LIGov_facPreCtlRmpMax LIGov_facThrStabAc LIGov_stOvrRun LIGov_tiSync LIGov_trq LIGov_trqI LIGov_trqLead LIGov_trqMax LIGov_trqMin LIGov_trqP LIGov_trqPLead LIGov_trqPreCtl /end OUT_MEASUREMENT
 /begin LOC_MEASUREMENT LIGov_facPreCtlRmp LIGov_flgSrvCouplrSwtSt LIGov_nDiffNSetNEng LIGov_tqThrStabAc LIGov_trqIDiff_MP LIGov_trqIgnFixPreCtl LIGov_trqIntegIPrmChg_MP LIGov_trqIntegIRst_MP LIGov_trqIntegI_MP LIGov_trqI_mp LIGov_trqPRmp LIGov_tStrtloc /end LOC_MEASUREMENT
 FUNCTION_VERSION "2.32.0" /end FUNCTION
/begin FUNCTION LIGov_SelPar "2.45.0    Operating conditions / parameter selection low idle governor"
 /begin DEF_CHARACTERISTIC LIGov_ExtTrqDemMskSeln_CW LIGov_facCatHeatgAlti_C LIGov_flgMskLLimIfFcoReqd_C LIGov_nExtTrqDemSelnSpOffs_C LIGov_nExtTrqDemSelnThd_C LIGov_nLimHi_C LIGov_nOffs_C LIGov_nOfsPreCtlRstrt_C LIGov_nOfsPreCtlTrqDem_C LIGov_nOfsPreCtl_C LIGov_nOfsPredef_C LIGov_nOfsUbr_C LIGov_nThresPreCtlLo_T LIGov_rExtTrqDemMskSelnAppThd_C LIGov_rGripThres_C LIGov_SelPar2_CW LIGov_SelPar_CW LIGov_stBrkThres_C LIGov_stExtTrqDemMskAltv_C LIGov_stExtTrqDemMskSelnBrk_C LIGov_stExtTrqDemMsk_C LIGov_swtBll_C LIGov_swtNoGrip_C LIGov_tEngXHi_C LIGov_tEngXLo_C LIGov_tiDlyPreCtl_C LIGov_tiEnblI_CUR LIGov_tiFrzIDly_C LIGov_tiGrip_C LIGov_tiStrtPar_C LIGov_trqDeltaWndUpMax_C LIGov_trqDeltaWndUpMin_C LIGov_trqThresDfrstI_C LIGov_vGrip_C LIGov_vMinRstI_C LiGov_vThresFrzI_C LIGov_vThresUbr_C SpdCtl_flgSynIninReqDrv_C SpdCtl_flgSynPstDrvBreak_C /end DEF_CHARACTERISTIC
 /begin IN_MEASUREMENT ACC_bBrkReq ACC_bExsMinDstBrkReq AirSys_bMinPsblIdcTrqRea APP_r Brk_st B_ll_msg CoEng_bStrtEndSpdGov CoEng_nRstrt CoEng_st CoEng_tiNormalRed CoETS_trqInrLimLead CrCtl_numACCType DOGov_bActv EGSys_bCH EngDa_tEng Epm_nEng GlbDa_stTrqDem HLSDem_nSetPLo HLSDem_nSetPTrck InjSys_bMinPtdInjDurActv InjSys_stActRedStg LIGov_tiSync LIGov_trq LIGov_trqI LIGov_trqLead LIGov_trqMax LIGov_trqMin LIGov_trqP LLim_bFcoDes PEnv_facCorrAlti PthSet_bOvrRun PthSet_trqInrIA PT_rGrip PT_stTraType RngMod_trqInrBsMin SyC_stSub Tra_numGear VehV_v /end IN_MEASUREMENT
 /begin OUT_MEASUREMENT LIGov_bCalcPreCtl LIGov_bEnblI LIGov_bExtTrqDem LIGov_bFrzI LIGov_bFrzIDiag LIGov_bGear1 LIGov_bInactv LIGov_bIniPredefTrq LIGov_bNoGrip LIGov_bParChng LIGov_bPreCtlUndrSpd LIGov_bRlsPreCtl LIGov_bRlsPredef LIGov_bRstI LIGov_bUbr LIGov_bWrm LIGov_flgExtTrqDemMskSeln LIGov_nDiff LIGov_nDiffOld LIGov_numPar LIGov_stExtTrqDemMskSeln SpdCtl_flgSynIninReqDrv SpdCtl_flgSynPstDrvBreak SpdCtl_flgSynStrtInitReq /end OUT_MEASUREMENT
 /begin LOC_MEASUREMENT LIGov_bLoSpdExs LIGov_bNPreCtl LIGov_bOvrRunEF_I.buffer LIGov_bOvrRunEF_I.oldSignal LIGov_bStrtPar LIGov_nPreCtl LIGov_stIdleSpdDrvr /end LOC_MEASUREMENT
 FUNCTION_VERSION "2.45.0" /end FUNCTION
/begin FUNCTION LinAppl_Std "74.4.0    Lin Application Standard"
 /begin DEF_CHARACTERISTIC Com_tiLINShtDwnDlyReq_C Linappl_stUseLstErr_C Linappl_tiAEVActv_C LinDiag_C /end DEF_CHARACTERISTIC
 /begin IN_MEASUREMENT Com_rEEV1PosFb Com_stMon SyC_ctPostDrvLeave T15_st /end IN_MEASUREMENT
 /begin OUT_MEASUREMENT Com_ctReIni100msLinappl Com_flgLINShtDwnTiDlyExp Linappl_flgFrstFrmAEV Linappl_stFrmErr Linappl_stFrmErrOld Linappl_stFrmTxdRxd Linappl_stFrstFrmRxd /end OUT_MEASUREMENT
 /begin LOC_MEASUREMENT Linappl_stNodErr /end LOC_MEASUREMENT
 FUNCTION_VERSION "74.4.0" /end FUNCTION
/begin COMPU_METHOD B_TRUE "" TAB_VERB "%6.3" "" COMPU_TAB_REF B_TRUE /end COMPU_METHOD
/begin COMPU_VTAB B_TRUE "" TAB_VERB 2 0 "FALSE" 1 "TRUE" /end COMPU_VTAB
/begin COMPU_METHOD dez "" RAT_FUNC "%6.2" "" COEFFS 0 1 0 0 0 1 /end COMPU_METHOD
/begin COMPU_METHOD EngN "" RAT_FUNC "%6.3" "rpm" COEFFS 0 2 0 0 0 1 /end COMPU_METHOD
/begin COMPU_METHOD Fact100 "" RAT_FUNC "%6.4" "-" COEFFS 0 100 0 0 0 1 /end COMPU_METHOD
/begin COMPU_METHOD fak_q0p000244 "" RAT_FUNC "%6.5" "-" COEFFS 0 65536 0 0 0 16 /end COMPU_METHOD
/begin COMPU_METHOD fak_q0p03125 "" RAT_FUNC "%6.4" "" COEFFS 0 32 0 0 0 1 /end COMPU_METHOD
/begin COMPU_METHOD fak_q3p0518Em5 "" RAT_FUNC "%7.6" "" COEFFS 0 32768 0 0 0 1 /end COMPU_METHOD
/begin COMPU_METHOD fak_sb_b1 "" RAT_FUNC "%6.4" "-" COEFFS 0 256 0 0 0 2 /end COMPU_METHOD
/begin COMPU_METHOD fak_ub_b1 "" RAT_FUNC "%6.4" "-" COEFFS 0 256 0 0 0 1 /end COMPU_METHOD
/begin COMPU_METHOD fak_ub_b16 "" RAT_FUNC "%6.4" "-" COEFFS 0 256 0 0 0 16 /end COMPU_METHOD
/begin COMPU_METHOD fak_ub_b2 "" RAT_FUNC "%8.5" "-" COEFFS 0 256 0 0 0 2 /end COMPU_METHOD
/begin COMPU_METHOD fak_ub_b4 "" RAT_FUNC "%6.4" "-" COEFFS 0 256 0 0 0 4 /end COMPU_METHOD
/begin COMPU_METHOD fak_ub_q7p8125Em3 "" RAT_FUNC "%6.4" "" COEFFS 0 128 0 0 0 1 /end COMPU_METHOD
/begin COMPU_METHOD fak_uw_b16 "" RAT_FUNC "%6.5" "-" COEFFS 0 65536 0 0 0 16 /end COMPU_METHOD
/begin COMPU_METHOD fak_uw_b2 "" RAT_FUNC "%7.6" "-" COEFFS 0 65536 0 0 0 2 /end COMPU_METHOD
/begin COMPU_METHOD fak_uw_b4 "" RAT_FUNC "%7.6" "-" COEFFS 0 65536 0 0 0 4 /end COMPU_METHOD
/begin COMPU_METHOD fak_uw_b5 "" RAT_FUNC "%7.6" "-" COEFFS 0 65536 0 0 0 5 /end COMPU_METHOD
/begin COMPU_METHOD kw_q0p75 "" RAT_FUNC "%6.3" "Grad KW" COEFFS 0 4 0 0 0 3 /end COMPU_METHOD
/begin COMPU_METHOD Length_km "" RAT_FUNC "%6.2" "km" COEFFS 0 1 0 0 0 1 /end COMPU_METHOD
/begin COMPU_METHOD mdgrad_q0p05 "" RAT_FUNC "%6.4" "Nm/s" COEFFS 0 20 0 0 0 1 /end COMPU_METHOD
/begin COMPU_METHOD md_q0p1 "" RAT_FUNC "%6.3" "Nm" COEFFS 0 10 0 0 0 1 /end COMPU_METHOD
/begin COMPU_METHOD md_q1p526Em6 "" RAT_FUNC "%8.7" "Nm" COEFFS 0 65536 0 0 0 0.1 /end COMPU_METHOD
/begin COMPU_METHOD m_uw_b6553p5 "" RAT_FUNC "%6.3" "kg/h" COEFFS 0 1 0 0 0 0.1 /end COMPU_METHOD
/begin COMPU_METHOD nmotg_sb_q100 "" RAT_FUNC "%6.0" "1/min/s" COEFFS 0 1 0 0 0 100 /end COMPU_METHOD
/begin COMPU_METHOD nmot_q0p5 "" RAT_FUNC "%6.3" "1/min" COEFFS 0 2 0 0 0 1 /end COMPU_METHOD
/begin COMPU_METHOD nmot_sw_q0p5 "" RAT_FUNC "%6.3" "1/min" COEFFS 0 2 0 0 0 1 /end COMPU_METHOD
/begin COMPU_METHOD nmot_ub_q40 "" RAT_FUNC "%6.1" "1/min" COEFFS 0 1 0 0 0 40 /end COMPU_METHOD
/begin COMPU_METHOD nmot_uw_q0p25 "" RAT_FUNC "%6.3" "1/min" COEFFS 0 1 0 0 0 0.25 /end COMPU_METHOD
/begin COMPU_METHOD OneToOne "" RAT_FUNC "%6.2" "-" COEFFS 0 1 0 0 0 1 /end COMPU_METHOD
/begin COMPU_METHOD Prc "" RAT_FUNC "%6.4" "%" COEFFS 0 81.92 0 0 0 1 /end COMPU_METHOD
/begin COMPU_METHOD p_q10 "" RAT_FUNC "%6.1" "hPa" COEFFS 0 1 0 0 0 10 /end COMPU_METHOD
/begin COMPU_METHOD p_uw_q0p039 "" RAT_FUNC "%6.4" "hPa" COEFFS 0 256 0 0 0 10 /end COMPU_METHOD
/begin COMPU_METHOD rel_q0p0234 "" RAT_FUNC "%6.4" "%" COEFFS 0 128 0 0 0 3 /end COMPU_METHOD
/begin COMPU_METHOD rel_q0p39 "" RAT_FUNC "%6.3" "%" COEFFS 0 256 0 0 0 100 /end COMPU_METHOD
/begin COMPU_METHOD rel_uw_q0p0234 "" RAT_FUNC "%6.4" "%" COEFFS 0 32 0 0 0 0.75 /end COMPU_METHOD
/begin COMPU_METHOD spg_q3p906Em4_V_ms "" RAT_FUNC "%6.5" "V*ms" COEFFS 0 65536 0 0 0 25.6 /end COMPU_METHOD
/begin COMPU_METHOD spg_q7p629Em7_V_ms "" RAT_FUNC "%9.8" "V*ms" COEFFS 0 65536 0 0 0 0.05 /end COMPU_METHOD
/begin COMPU_METHOD SY_2LBK_Compu "" TAB_VERB "%6.3" "" COMPU_TAB_REF SY_2LBK_Compu /end COMPU_METHOD
/begin COMPU_VTAB SY_2LBK_Compu "" TAB_VERB 2 0 "no LBK for Bank 2" 1 "LBK for Bank 2 is present" /end COMPU_VTAB
/begin COMPU_METHOD SY_2SGHST_Compu "" TAB_VERB "%6.3" "" COMPU_TAB_REF SY_2SGHST_Compu /end COMPU_METHOD
/begin COMPU_VTAB SY_2SGHST_Compu "" TAB_VERB 2 0 "Heißstartbed. auch im SLAVE berechnet" 1 "Heißstartbed. nur im MASTER berechnet" /end COMPU_VTAB
/begin COMPU_METHOD SY_2SG_Compu "" TAB_VERB "%6.3" "" COMPU_TAB_REF SY_2SG_Compu /end COMPU_METHOD
/begin COMPU_VTAB SY_2SG_Compu "" TAB_VERB 2 0 "1 Steuergerät" 1 "2 Steuergeräte" /end COMPU_VTAB
/begin COMPU_METHOD SY_2TANK_Compu "" TAB_VERB "%6.3" "" COMPU_TAB_REF SY_2TANK_Compu /end COMPU_METHOD
/begin COMPU_VTAB SY_2TANK_Compu "" TAB_VERB 2 0 "SY_2TANK =0" 1 "SY_2TANK >0" /end COMPU_VTAB
/begin COMPU_METHOD SY_2TEV_Compu "" TAB_VERB "%6.3" "" COMPU_TAB_REF SY_2TEV_Compu /end COMPU_METHOD
/begin COMPU_VTAB SY_2TEV_Compu "" TAB_VERB 2 0 "kein TEV-Fehlerpfad fuer Bank 2 vorhanden" 1 "TEV-Fehlerpfad fuer Bank 2 vorhanden" /end COMPU_VTAB
/begin COMPU_METHOD SY_2VD_Compu "" TAB_VERB "%6.3" "" COMPU_TAB_REF SY_2VD_Compu /end COMPU_METHOD
/begin COMPU_VTAB SY_2VD_Compu "" TAB_VERB 4 0 "kein zweit. Verdichter" 1 "ATL" 2 "Kompressor" 3 "EZV" /end COMPU_VTAB
/begin COMPU_METHOD SY_AAV_Compu "" TAB_VERB "%6.3" "" COMPU_TAB_REF SY_AAV_Compu /end COMPU_METHOD
/begin COMPU_VTAB SY_AAV_Compu "" TAB_VERB 2 0 "AKFShutOffValve_NotAvailable" 1 "AKFShutOffValve_Available" /end COMPU_VTAB
/begin COMPU_METHOD SY_ABGKL_Compu "" TAB_VERB "%6.3" "" COMPU_TAB_REF SY_ABGKL_Compu /end COMPU_METHOD
/begin COMPU_VTAB SY_ABGKL_Compu "" TAB_VERB 2 0 "keine Abgasklappe vorhanden" 1 "Abgasklappe vorhanden" /end COMPU_VTAB
/begin COMPU_METHOD SY_ABGYVBP_Compu "" TAB_VERB "%6.3" "" COMPU_TAB_REF SY_ABGYVBP_Compu /end COMPU_METHOD
/begin COMPU_VTAB SY_ABGYVBP_Compu "" TAB_VERB 5 0 "keine Y-Zusammenführung" 5 "Y-Zusammenführung vor Bauteileposition 5" 9 "Y-Zusammenführung vor Bauteileposition 9" 12 "Y-Zusammenführung vor Bauteileposition 12" 13 "Y-Zusammenführung vor Bauteileposition 13" /end COMPU_VTAB
/begin COMPU_METHOD SY_ABGY_Compu "" TAB_VERB "%6.3" "" COMPU_TAB_REF SY_ABGY_Compu /end COMPU_METHOD
/begin COMPU_VTAB SY_ABGY_Compu "" TAB_VERB 2 0 "kein Y-Abgassystem" 1 "Y-Abgassystem" /end COMPU_VTAB
/begin COMPU_METHOD SY_ABMZND_Compu "" TAB_VERB "%6.3" "" COMPU_TAB_REF SY_ABMZND_Compu /end COMPU_METHOD
/begin COMPU_VTAB SY_ABMZND_Compu "" TAB_VERB 2 0 "keine Einspritzausblendung bei Zuendfehler" 1 "Einspritzausblendung bei Zuendfehler" /end COMPU_VTAB
/begin COMPU_METHOD SY_ADTESK_Compu "" TAB_VERB "%6.3" "" COMPU_TAB_REF SY_ADTESK_Compu /end COMPU_METHOD
/begin COMPU_VTAB SY_ADTESK_Compu "" TAB_VERB 2 0 "False" 1 "True" /end COMPU_VTAB
/begin COMPU_METHOD SY_AFIMVAR_Compu "" TAB_VERB "%6.3" "" COMPU_TAB_REF SY_AFIMVAR_Compu /end COMPU_METHOD
/begin COMPU_VTAB SY_AFIMVAR_Compu "" TAB_VERB 6 0 "NOAFIM" 1 "AFIMDIS" 2 "AFIMEZLA" 3 "AFIMMFK" 4 "AFIMEZFRQ" 5 "AFIMCILCN" /end COMPU_VTAB
/begin COMPU_METHOD SY_AGR2_Compu "" TAB_VERB "%6.3" "" COMPU_TAB_REF SY_AGR2_Compu /end COMPU_METHOD
/begin COMPU_VTAB SY_AGR2_Compu "" TAB_VERB 2 0 "FALSE" 1 "TRUE" /end COMPU_VTAB
/begin COMPU_METHOD SY_AGRBZSV_Compu "" TAB_VERB "%6.3" "" COMPU_TAB_REF SY_AGRBZSV_Compu /end COMPU_METHOD
/begin COMPU_VTAB SY_AGRBZSV_Compu "" TAB_VERB 2 0 "Feste Blende zw.  AGR und SR nicht vorhanden" 1 "Feste Blende zw.  AGR und SR vorhanden" /end COMPU_VTAB
/begin COMPU_METHOD SY_AGRCLV_Compu "" TAB_VERB "%6.3" "" COMPU_TAB_REF SY_AGRCLV_Compu /end COMPU_METHOD
/begin COMPU_VTAB SY_AGRCLV_Compu "" TAB_VERB 2 0 "Feature disabled" 1 "Feature enabled" /end COMPU_VTAB
/begin COMPU_METHOD SY_AGREDK_Compu "" TAB_VERB "%6.3" "" COMPU_TAB_REF SY_AGREDK_Compu /end COMPU_METHOD
/begin COMPU_VTAB SY_AGREDK_Compu "" TAB_VERB 2 0 "keine Erwärmung der Drosselklappe durch ext. AGR" 1 "Erwärmung der Drosselklappe durch ext. AGR" /end COMPU_VTAB
/begin COMPU_METHOD SY_AGREOA_Compu "" TAB_VERB "%6.3" "" COMPU_TAB_REF SY_AGREOA_Compu /end COMPU_METHOD
/begin COMPU_VTAB SY_AGREOA_Compu "" TAB_VERB 3 0 "aus Bank1" 1 "aus Bank2" 2 "aus Bank 1 und 2" /end COMPU_VTAB
/begin COMPU_METHOD SY_AGREOB_Compu "" TAB_VERB "%6.3" "" COMPU_TAB_REF SY_AGREOB_Compu /end COMPU_METHOD
/begin COMPU_VTAB SY_AGREOB_Compu "" TAB_VERB 5 0 "im Krümmer" 1 "vor Vorkat" 2 "hinter Vorkat" 3 "vor Speicherkat" 4 "im Krümmer mit Aufladung" /end COMPU_VTAB
/begin COMPU_METHOD SY_AGRKOMP_Compu "" TAB_VERB "%6.3" "" COMPU_TAB_REF SY_AGRKOMP_Compu /end COMPU_METHOD
/begin COMPU_VTAB SY_AGRKOMP_Compu "" TAB_VERB 6 0 "kein AGR" 1 "Proportionalmagnet" 2 "Steppermotor" 3 "DC-Motor" 4 "MELCO Tellerstössel" 5 "Delphi Torquer-Ventil" /end COMPU_VTAB
/begin COMPU_METHOD SY_AGRTS_Compu "" TAB_VERB "%6.3" "" COMPU_TAB_REF SY_AGRTS_Compu /end COMPU_METHOD
/begin COMPU_VTAB SY_AGRTS_Compu "" TAB_VERB 2 0 "keine Abschaltung AGR wird bei zu hoher Temp." 1 "Abschaltung AGR wird bei zu hoher Temp." /end COMPU_VTAB
/begin COMPU_METHOD SY_AGRVR_Compu "" TAB_VERB "%6.3" "" COMPU_TAB_REF SY_AGRVR_Compu /end COMPU_METHOD
/begin COMPU_VTAB SY_AGRVR_Compu "" TAB_VERB 2 0 "False" 1 "True" /end COMPU_VTAB
/begin COMPU_METHOD SY_AGR_Compu "" TAB_VERB "%6.3" "" COMPU_TAB_REF SY_AGR_Compu /end COMPU_METHOD
/begin COMPU_VTAB SY_AGR_Compu "" TAB_VERB 2 0 "FALSE" 1 "TRUE" /end COMPU_VTAB
/begin COMPU_METHOD SY_AIRBAG_Compu "" TAB_VERB "%6.3" "" COMPU_TAB_REF SY_AIRBAG_Compu /end COMPU_METHOD
/begin COMPU_VTAB SY_AIRBAG_Compu "" TAB_VERB 2 0 "kein Airbagsignal verfügbar" 1 "Airbagsignal verfügbar" /end COMPU_VTAB
/begin COMPU_METHOD SY_AMSHFMP_Compu "" TAB_VERB "%6.3" "" COMPU_TAB_REF SY_AMSHFMP_Compu /end COMPU_METHOD
/begin COMPU_VTAB SY_AMSHFMP_Compu "" TAB_VERB 2 0 "inactiv" 1 "based on MAP" /end COMPU_VTAB
/begin COMPU_METHOD SY_ANST_Compu "" TAB_VERB "%6.3" "" COMPU_TAB_REF SY_ANST_Compu /end COMPU_METHOD
/begin COMPU_VTAB SY_ANST_Compu "" TAB_VERB 2 0 "False" 1 "True" /end COMPU_VTAB
/begin COMPU_METHOD SY_ANZEKP_Compu "" RAT_FUNC "%6.2" "" COEFFS 0 1 0 0 0 1 /end COMPU_METHOD
/begin COMPU_METHOD SY_ANZLUE_Compu "" TAB_VERB "%6.3" "" COMPU_TAB_REF SY_ANZLUE_Compu /end COMPU_METHOD
/begin COMPU_VTAB SY_ANZLUE_Compu "" TAB_VERB 5 0 "kein Lüfter" 1 "1 Lüfter" 2 "2 Lüfter" 3 "3 Lüfter" 12 "Doppellüfter" /end COMPU_VTAB
/begin COMPU_METHOD SY_ANZPSLS_Compu "" TAB_VERB "%6.3" "" COMPU_TAB_REF SY_ANZPSLS_Compu /end COMPU_METHOD
/begin COMPU_VTAB SY_ANZPSLS_Compu "" TAB_VERB 3 0 "PSLS_NO" 1 "PSLS_ONE" 2 "PSLS_TWO" /end COMPU_VTAB
/begin COMPU_METHOD SY_ANZSFST_Compu "" RAT_FUNC "%6.2" "" COEFFS 0 1 0 0 0 1 /end COMPU_METHOD
/begin COMPU_METHOD SY_ARC_Compu "" TAB_VERB "%6.3" "" COMPU_TAB_REF SY_ARC_Compu /end COMPU_METHOD
/begin COMPU_VTAB SY_ARC_Compu "" TAB_VERB 2 0 "kein Active Roll Control vorhanden" 1 "Active Roll Control vorhanden" /end COMPU_VTAB
/begin COMPU_METHOD SY_ASGLC_Compu "" RAT_FUNC "%6.2" "" COEFFS 0 1 0 0 0 1 /end COMPU_METHOD
/begin COMPU_METHOD SY_ASG_Compu "" TAB_VERB "%6.3" "" COMPU_TAB_REF SY_ASG_Compu /end COMPU_METHOD
/begin COMPU_VTAB SY_ASG_Compu "" TAB_VERB 2 0 "kein automatisiertes Schaltgetriebe vorhanden" 1 "Automatisiertes Schaltgetriebe vorhanden" /end COMPU_VTAB
/begin COMPU_METHOD SY_ASM_Compu "" TAB_VERB "%6.3" "" COMPU_TAB_REF SY_ASM_Compu /end COMPU_METHOD
/begin COMPU_VTAB SY_ASM_Compu "" TAB_VERB 2 0 "kein ASM-Getriebe vorhanden" 1 "ASM-Getriebe vorhanden" /end COMPU_VTAB
/begin COMPU_METHOD SY_ASR_Compu "" TAB_VERB "%6.3" "" COMPU_TAB_REF SY_ASR_Compu /end COMPU_METHOD
/begin COMPU_VTAB SY_ASR_Compu "" TAB_VERB 2 0 "keine ASR vorhanden" 1 "ASR vorhanden" /end COMPU_VTAB
/begin COMPU_METHOD SY_ASTIKR_Compu "" TAB_VERB "%6.3" "" COMPU_TAB_REF SY_ASTIKR_Compu /end COMPU_METHOD
/begin COMPU_VTAB SY_ASTIKR_Compu "" TAB_VERB 2 0 "kein Temperatursensor im Krümmer" 1 "Temperatursensor im Krümmer verbaut" /end COMPU_VTAB
/begin COMPU_METHOD SY_ASTNVK_Compu "" TAB_VERB "%6.3" "" COMPU_TAB_REF SY_ASTNVK_Compu /end COMPU_METHOD
/begin COMPU_VTAB SY_ASTNVK_Compu "" TAB_VERB 2 0 "kein Temperatursensor nach Vorkat" 1 "Temperatursensor nach Vorkat" /end COMPU_VTAB
/begin COMPU_METHOD SY_ASTVHK2_Compu "" TAB_VERB "%6.3" "" COMPU_TAB_REF SY_ASTVHK2_Compu /end COMPU_METHOD
/begin COMPU_VTAB SY_ASTVHK2_Compu "" TAB_VERB 2 0 "kein Temperatursensor vor Hauptkat Bank 2" 1 "Temperatursensor vor Hauptkat Bank 2" /end COMPU_VTAB
/begin COMPU_METHOD SY_ASTVHK_Compu "" TAB_VERB "%6.3" "" COMPU_TAB_REF SY_ASTVHK_Compu /end COMPU_METHOD
/begin COMPU_VTAB SY_ASTVHK_Compu "" TAB_VERB 2 0 "kein Temperatursensor vor Hauptkat" 1 "Temperatursensor vor Hauptkat" /end COMPU_VTAB
/begin COMPU_METHOD SY_ASTVVK_Compu "" TAB_VERB "%6.3" "" COMPU_TAB_REF SY_ASTVVK_Compu /end COMPU_METHOD
/begin COMPU_VTAB SY_ASTVVK_Compu "" TAB_VERB 2 0 "Kein Temperatursensor vor Vorkat" 1 "Temperatursensor vor Vorkat" /end COMPU_VTAB
/begin COMPU_METHOD SY_ASV_Compu "" TAB_VERB "%6.3" "" COMPU_TAB_REF SY_ASV_Compu /end COMPU_METHOD
/begin COMPU_VTAB SY_ASV_Compu "" TAB_VERB 4 0 "kein ASV vorhanden" 1 "stromlos geöffnetes ASV" 2 "stromlos geschlossenes ASV" 3 "stromlos geschlossenes ASV in Leckageleitung HDP" /end COMPU_VTAB
/begin COMPU_METHOD SY_ATLB_Compu "" TAB_VERB "%6.3" "" COMPU_TAB_REF SY_ATLB_Compu /end COMPU_METHOD
/begin COMPU_VTAB SY_ATLB_Compu "" TAB_VERB 2 0 "keine Turbo-Bypassklappe" 1 "Turbo-Bypassklappe" /end COMPU_VTAB
/begin COMPU_METHOD SY_ATMTURB_Compu "" TAB_VERB "%6.3" "" COMPU_TAB_REF SY_ATMTURB_Compu /end COMPU_METHOD
/begin COMPU_VTAB SY_ATMTURB_Compu "" TAB_VERB 2 0 "ATMTURB_NOPRES" 1 "ATMTURB_PRES" /end COMPU_VTAB
/begin COMPU_METHOD SY_ATMZA_Compu "" TAB_VERB "%6.3" "" COMPU_TAB_REF SY_ATMZA_Compu /end COMPU_METHOD
/begin COMPU_VTAB SY_ATMZA_Compu "" TAB_VERB 2 0 "%ATMZA nicht vorhanden" 1 "%ATMZA vorhanden" /end COMPU_VTAB
/begin COMPU_METHOD SY_ATR_Compu "" TAB_VERB "%6.3" "" COMPU_TAB_REF SY_ATR_Compu /end COMPU_METHOD
/begin COMPU_VTAB SY_ATR_Compu "" TAB_VERB 2 0 "keine Abgastemperatursensoren vorhanden" 1 "Abgastemperatursensoren vorhanden" /end COMPU_VTAB
/begin COMPU_METHOD t100msxs_uw_b6553p5 "" RAT_FUNC "%6.3" "s" COEFFS 0 1 0 0 0 0.1 /end COMPU_METHOD
/begin COMPU_METHOD t10msxs_uw_b655p35 "" RAT_FUNC "%6.4" "s" COEFFS 0 1 0 0 0 0.01 /end COMPU_METHOD
/begin COMPU_METHOD Temp_Cels "" RAT_FUNC "%6.1" "deg C" COEFFS 0 10 2731.4 0 0 1 /end COMPU_METHOD
/begin COMPU_METHOD temp_q0p0234_o273 "" RAT_FUNC "%6.1" "Grad C" COEFFS 0 1 273.15 0 0 0.0234375 /end COMPU_METHOD
/begin COMPU_METHOD temp_q0p1_o273 "" RAT_FUNC "%6.1" "Grad C" COEFFS 0 10 2731.4 0 0 1 /end COMPU_METHOD
/begin COMPU_METHOD temp_q0p75_om48 "" RAT_FUNC "%6.2" "Grad C" COEFFS 0 4 192 0 0 3 /end COMPU_METHOD
/begin COMPU_METHOD temp_ub_q0p75_o48 "" RAT_FUNC "%6.2" "Grad C" COEFFS 0 1 48 0 0 0.75 /end COMPU_METHOD
/begin COMPU_METHOD TimeRed "" RAT_FUNC "%6.3" "s" COEFFS 0 6.25 0 0 0 1 /end COMPU_METHOD
/begin COMPU_METHOD Time_ms "" RAT_FUNC "%6.1" "ms" COEFFS 0 0.1 0 0 0 1 /end COMPU_METHOD
/begin COMPU_METHOD Time_s "" RAT_FUNC "%6.4" "s" COEFFS 0 100 0 0 0 1 /end COMPU_METHOD
/begin COMPU_METHOD t_q0p01 "" RAT_FUNC "%6.4" "s" COEFFS 0 100 0 0 0 1 /end COMPU_METHOD
/begin COMPU_METHOD t_q0p05 "" RAT_FUNC "%6.4" "s" COEFFS 0 100 0 0 0 5 /end COMPU_METHOD
/begin COMPU_METHOD t_q0p1 "" RAT_FUNC "%6.3" "s" COEFFS 0 10 0 0 0 1 /end COMPU_METHOD
/begin COMPU_METHOD t_q1p5259Em5_s "" RAT_FUNC "%7.6" "s" COEFFS 0 65536 0 0 0 1 /end COMPU_METHOD
/begin COMPU_METHOD t_q3p125em2 "" RAT_FUNC "%6.4" "s" COEFFS 0 32 0 0 0 1 /end COMPU_METHOD
/begin COMPU_METHOD t_tev0p0005 "" RAT_FUNC "%6.5" "s" COEFFS 0 2048 0 0 0 1 /end COMPU_METHOD
/begin COMPU_METHOD Vel "" RAT_FUNC "%6.4" "km/h" COEFFS 0 100 0 0 0 1 /end COMPU_METHOD
/begin COMPU_METHOD vel_q0p01 "" RAT_FUNC "%6.4" "km/h" COEFFS 0 100 0 0 0 1 /end COMPU_METHOD
/begin COMPU_METHOD vfzg_uw_q0p01 "" RAT_FUNC "%6.4" "km/h" COEFFS 0 100 0 0 0 1 /end COMPU_METHOD
/begin COMPU_METHOD vol_q3p90625Em3_l "" RAT_FUNC "%6.4" "l" COEFFS 0 65536 0 0 0 256 /end COMPU_METHOD
/begin COMPU_METHOD zk100msxs_ub_b25p5 "" RAT_FUNC "%6.3" "s" COEFFS 0 0 256 0 10 0 /end COMPU_METHOD
/begin COMPU_METHOD zk50msxs_uw_b3276p8 "" RAT_FUNC "%6.1" "s" COEFFS 0 0 65536 0 20 0 /end COMPU_METHOD
/begin COMPU_METHOD zw_q0p1 "" RAT_FUNC "%6.3" "Grad KW" COEFFS 0 10 0 0 0 1 /end COMPU_METHOD
/begin COMPU_METHOD zw_q0p1875 "" RAT_FUNC "%6.3" "Grad KW" COEFFS 0 1 0 0 0 0.1875 /end COMPU_METHOD
/begin COMPU_METHOD zw_sb_q0p75 "" RAT_FUNC "%6.3" "Grad KW" COEFFS 0 255 0 0 0 191.25 /end COMPU_METHOD
/begin RECORD_LAYOUT RB_Axis_S16 NO_AXIS_PTS_X 1 SWORD AXIS_PTS_X 2 SWORD INDEX_INCR DIRECT /end RECORD_LAYOUT
/begin RECORD_LAYOUT RB_Axis_U16 NO_AXIS_PTS_X 1 UWORD AXIS_PTS_X 2 UWORD INDEX_INCR DIRECT /end RECORD_LAYOUT
/begin RECORD_LAYOUT RB_Axis_U8 NO_AXIS_PTS_X 1 UBYTE AXIS_PTS_X 2 UBYTE INDEX_INCR DIRECT /end RECORD_LAYOUT
/begin RECORD_LAYOUT RB_CurveGroup_S16 FNC_VALUES 1 SWORD COLUMN_DIR DIRECT /end RECORD_LAYOUT
/begin RECORD_LAYOUT RB_CurveGroup_U16 FNC_VALUES 1 UWORD COLUMN_DIR DIRECT /end RECORD_LAYOUT
/begin RECORD_LAYOUT RB_CurveGroup_U8 FNC_VALUES 1 UBYTE COLUMN_DIR DIRECT /end RECORD_LAYOUT
/begin RECORD_LAYOUT RB_Curve_S16_S16 NO_AXIS_PTS_X 1 SWORD AXIS_PTS_X 2 SWORD INDEX_INCR DIRECT FNC_VALUES 3 SWORD COLUMN_DIR DIRECT /end RECORD_LAYOUT
/begin RECORD_LAYOUT RB_Curve_S16_S8_Static NO_AXIS_PTS_X 1 SWORD AXIS_PTS_X 2 SWORD INDEX_INCR DIRECT FNC_VALUES 3 SBYTE COLUMN_DIR DIRECT STATIC_RECORD_LAYOUT /end RECORD_LAYOUT
/begin RECORD_LAYOUT RB_Curve_S16_U16_Static NO_AXIS_PTS_X 1 SWORD AXIS_PTS_X 2 SWORD INDEX_INCR DIRECT FNC_VALUES 3 UWORD COLUMN_DIR DIRECT STATIC_RECORD_LAYOUT /end RECORD_LAYOUT
/begin RECORD_LAYOUT RB_Curve_S16_U8_Static NO_AXIS_PTS_X 1 SWORD AXIS_PTS_X 2 SWORD INDEX_INCR DIRECT FNC_VALUES 3 UBYTE COLUMN_DIR DIRECT STATIC_RECORD_LAYOUT /end RECORD_LAYOUT
/begin RECORD_LAYOUT RB_Curve_U16_U16 NO_AXIS_PTS_X 1 UWORD AXIS_PTS_X 2 UWORD INDEX_INCR DIRECT FNC_VALUES 3 UWORD COLUMN_DIR DIRECT /end RECORD_LAYOUT
/begin RECORD_LAYOUT RB_Curve_U16_U8_Static NO_AXIS_PTS_X 1 UWORD AXIS_PTS_X 2 UWORD INDEX_INCR DIRECT FNC_VALUES 3 UBYTE COLUMN_DIR DIRECT STATIC_RECORD_LAYOUT /end RECORD_LAYOUT
/begin RECORD_LAYOUT RB_Curve_U8_S8_Static NO_AXIS_PTS_X 1 UBYTE AXIS_PTS_X 2 UBYTE INDEX_INCR DIRECT FNC_VALUES 3 SBYTE COLUMN_DIR DIRECT STATIC_RECORD_LAYOUT /end RECORD_LAYOUT
/begin RECORD_LAYOUT RB_Curve_U8_U16_Static NO_AXIS_PTS_X 1 UBYTE AXIS_PTS_X 2 UBYTE INDEX_INCR DIRECT FNC_VALUES 3 UWORD COLUMN_DIR DIRECT STATIC_RECORD_LAYOUT /end RECORD_LAYOUT
/begin RECORD_LAYOUT RB_Curve_U8_U8 NO_AXIS_PTS_X 1 UBYTE AXIS_PTS_X 2 UBYTE INDEX_INCR DIRECT FNC_VALUES 3 UBYTE COLUMN_DIR DIRECT /end RECORD_LAYOUT
/begin RECORD_LAYOUT RB_MapGroup_S8 FNC_VALUES 1 SBYTE COLUMN_DIR DIRECT /end RECORD_LAYOUT
/begin RECORD_LAYOUT RB_MapGroup_U8 FNC_VALUES 1 UBYTE COLUMN_DIR DIRECT /end RECORD_LAYOUT
/begin RECORD_LAYOUT RB_Map_S16S16_S16 NO_AXIS_PTS_X 1 SWORD NO_AXIS_PTS_Y 2 SWORD AXIS_PTS_X 3 SWORD INDEX_INCR DIRECT AXIS_PTS_Y 4 SWORD INDEX_INCR DIRECT FNC_VALUES 5 SWORD COLUMN_DIR DIRECT /end RECORD_LAYOUT
/begin RECORD_LAYOUT RB_Map_S16S16_S8 NO_AXIS_PTS_X 1 SWORD NO_AXIS_PTS_Y 2 SWORD AXIS_PTS_X 3 SWORD INDEX_INCR DIRECT AXIS_PTS_Y 4 SWORD INDEX_INCR DIRECT FNC_VALUES 5 SBYTE COLUMN_DIR DIRECT /end RECORD_LAYOUT
/begin RECORD_LAYOUT RB_Map_S16S8_S16 NO_AXIS_PTS_X 1 SWORD NO_AXIS_PTS_Y 2 SWORD AXIS_PTS_X 3 SWORD INDEX_INCR DIRECT AXIS_PTS_Y 4 SBYTE INDEX_INCR DIRECT FNC_VALUES 5 SWORD COLUMN_DIR DIRECT /end RECORD_LAYOUT
/begin RECORD_LAYOUT RB_Map_S16U16_U16 NO_AXIS_PTS_X 1 SWORD NO_AXIS_PTS_Y 2 SWORD AXIS_PTS_X 3 SWORD INDEX_INCR DIRECT AXIS_PTS_Y 4 UWORD INDEX_INCR DIRECT FNC_VALUES 5 UWORD ROW_DIR DIRECT /end RECORD_LAYOUT
/begin RECORD_LAYOUT RB_Map_S16U16_U8 NO_AXIS_PTS_X 1 SWORD NO_AXIS_PTS_Y 2 SWORD AXIS_PTS_X 3 SWORD INDEX_INCR DIRECT AXIS_PTS_Y 4 UWORD INDEX_INCR DIRECT FNC_VALUES 5 UBYTE ROW_DIR DIRECT /end RECORD_LAYOUT
/begin RECORD_LAYOUT RB_Map_S16U8_S16 NO_AXIS_PTS_X 1 SWORD NO_AXIS_PTS_Y 2 SWORD AXIS_PTS_X 3 SWORD INDEX_INCR DIRECT AXIS_PTS_Y 4 UBYTE INDEX_INCR DIRECT FNC_VALUES 5 SWORD COLUMN_DIR DIRECT /end RECORD_LAYOUT
/begin RECORD_LAYOUT RB_Map_S16U8_S8 NO_AXIS_PTS_X 1 SWORD NO_AXIS_PTS_Y 2 SWORD AXIS_PTS_X 3 SWORD INDEX_INCR DIRECT AXIS_PTS_Y 4 UBYTE INDEX_INCR DIRECT FNC_VALUES 5 SBYTE COLUMN_DIR DIRECT /end RECORD_LAYOUT
/begin RECORD_LAYOUT RB_Map_S8S16_U8 NO_AXIS_PTS_X 1 SBYTE NO_AXIS_PTS_Y 2 SBYTE AXIS_PTS_X 3 SBYTE INDEX_INCR DIRECT AXIS_PTS_Y 4 SWORD INDEX_INCR DIRECT FNC_VALUES 5 UBYTE ROW_DIR DIRECT /end RECORD_LAYOUT
/begin RECORD_LAYOUT RB_Map_S8U8_U8 NO_AXIS_PTS_X 1 SBYTE NO_AXIS_PTS_Y 2 SBYTE AXIS_PTS_X 3 SBYTE INDEX_INCR DIRECT AXIS_PTS_Y 4 UBYTE INDEX_INCR DIRECT FNC_VALUES 5 UBYTE ROW_DIR DIRECT /end RECORD_LAYOUT
/begin RECORD_LAYOUT RB_Map_U16S8_S16 NO_AXIS_PTS_X 1 UWORD NO_AXIS_PTS_Y 2 UWORD AXIS_PTS_X 3 UWORD INDEX_INCR DIRECT AXIS_PTS_Y 4 SBYTE INDEX_INCR DIRECT FNC_VALUES 5 SWORD COLUMN_DIR DIRECT /end RECORD_LAYOUT
/begin RECORD_LAYOUT RB_Map_U16U16_U16 NO_AXIS_PTS_X 1 UWORD NO_AXIS_PTS_Y 2 UWORD AXIS_PTS_X 3 UWORD INDEX_INCR DIRECT AXIS_PTS_Y 4 UWORD INDEX_INCR DIRECT FNC_VALUES 5 UWORD COLUMN_DIR DIRECT /end RECORD_LAYOUT
/begin RECORD_LAYOUT RB_Map_U16U16_U8 NO_AXIS_PTS_X 1 UWORD NO_AXIS_PTS_Y 2 UWORD AXIS_PTS_X 3 UWORD INDEX_INCR DIRECT AXIS_PTS_Y 4 UWORD INDEX_INCR DIRECT FNC_VALUES 5 UBYTE COLUMN_DIR DIRECT /end RECORD_LAYOUT
/begin RECORD_LAYOUT RB_Map_U8U16_U16 NO_AXIS_PTS_X 1 UBYTE NO_AXIS_PTS_Y 2 UBYTE AXIS_PTS_X 3 UBYTE INDEX_INCR DIRECT AXIS_PTS_Y 4 UWORD INDEX_INCR DIRECT FNC_VALUES 5 UWORD ROW_DIR DIRECT /end RECORD_LAYOUT
/begin RECORD_LAYOUT RB_Map_U8U8_S8 NO_AXIS_PTS_X 1 UBYTE NO_AXIS_PTS_Y 2 UBYTE AXIS_PTS_X 3 UBYTE INDEX_INCR DIRECT AXIS_PTS_Y 4 UBYTE INDEX_INCR DIRECT FNC_VALUES 5 SBYTE COLUMN_DIR DIRECT /end RECORD_LAYOUT
/begin RECORD_LAYOUT RB_Map_U8U8_U8 NO_AXIS_PTS_X 1 UBYTE NO_AXIS_PTS_Y 2 UBYTE AXIS_PTS_X 3 UBYTE INDEX_INCR DIRECT AXIS_PTS_Y 4 UBYTE INDEX_INCR DIRECT FNC_VALUES 5 UBYTE COLUMN_DIR DIRECT /end RECORD_LAYOUT
/begin RECORD_LAYOUT RB_ValA_Ws16 FNC_VALUES 1 SWORD COLUMN_DIR DIRECT /end RECORD_LAYOUT
/begin RECORD_LAYOUT RB_ValA_Ws8 FNC_VALUES 1 SBYTE COLUMN_DIR DIRECT /end RECORD_LAYOUT
/begin RECORD_LAYOUT RB_ValA_Wu16 FNC_VALUES 1 UWORD COLUMN_DIR DIRECT /end RECORD_LAYOUT
/begin RECORD_LAYOUT RB_ValA_Wu8 FNC_VALUES 1 UBYTE COLUMN_DIR DIRECT /end RECORD_LAYOUT
/begin RECORD_LAYOUT RB_Val_Wboolean FNC_VALUES 1 UBYTE COLUMN_DIR DIRECT /end RECORD_LAYOUT
/begin RECORD_LAYOUT RB_Val_Ws16 FNC_VALUES 1 SWORD COLUMN_DIR DIRECT /end RECORD_LAYOUT
/begin RECORD_LAYOUT RB_Val_Ws32 FNC_VALUES 1 SLONG COLUMN_DIR DIRECT /end RECORD_LAYOUT
/begin RECORD_LAYOUT RB_Val_Ws8 FNC_VALUES 1 SBYTE COLUMN_DIR DIRECT /end RECORD_LAYOUT
/begin RECORD_LAYOUT RB_Val_Wu16 FNC_VALUES 1 UWORD COLUMN_DIR DIRECT /end RECORD_LAYOUT
/begin RECORD_LAYOUT RB_Val_Wu32 FNC_VALUES 1 ULONG COLUMN_DIR DIRECT /end RECORD_LAYOUT
/begin RECORD_LAYOUT RB_Val_Wu8 FNC_VALUES 1 UBYTE COLUMN_DIR DIRECT /end RECORD_LAYOUT
/end MODULE
/end PROJECT
