ASAP2_VERSION 1 60
/begin PROJECT MG1CS022 "MG1CS022"
/begin HEADER "" VERSION "MG1CS022_62XSC_V037" PROJECT_NO MG1CS022 /end HEADER
/begin MODULE DIM ""
/begin MOD_COMMON "" BYTE_ORDER MSB_LAST ALIGNMENT_BYTE 1 ALIGNMENT_WORD 2 ALIGNMENT_LONG 4 ALIGNMENT_INT64 4 ALIGNMENT_FLOAT32_IEEE 4 ALIGNMENT_FLOAT64_IEEE 4 DATA_SIZE 32 /end MOD_COMMON
/begin AXIS_PTS InjSys_nEng10_AX "base point distribution for engine speed with 10 base points" 0x80558610 Epm_nEng RB_Axis_S16 16383.50 EngN 10 0.00 16383.50 FORMAT "%8.2" EXTENDED_LIMITS -16384.00 16383.50 DEPOSIT ABSOLUTE /end AXIS_PTS
/begin AXIS_PTS InjSys_nEng12Hpx_AX "Base point distribution for engine speed HPx with 12 base points" 0x80558626 Epm_nEng RB_Axis_S16 16383.50 EngN 12 0.00 16383.50 FORMAT "%8.2" EXTENDED_LIMITS -16384.00 16383.50 DEPOSIT ABSOLUTE /end AXIS_PTS
/begin AXIS_PTS InjSys_nEng12HspVers2_AX "base point distribution for engine speed with 12 base points (Version 2 HSP Mode)" 0x80558640 Epm_nEng RB_Axis_S16 16383.50 EngN 12 0.00 16383.50 FORMAT "%8.2" EXTENDED_LIMITS -16384.00 16383.50 DEPOSIT ABSOLUTE /end AXIS_PTS
/begin AXIS_PTS InjSys_nEng12Hsp_AX "base point distribution for engine speed with 12 base points (HSP Mode)" 0x8055865A Epm_nEng RB_Axis_S16 16383.50 EngN 12 0.00 16383.50 FORMAT "%8.2" EXTENDED_LIMITS -16384.00 16383.50 DEPOSIT ABSOLUTE /end AXIS_PTS
/begin AXIS_PTS InjSys_nEng12Vers2_AX "base point distribution for engine speed with 10 base points (version 2)" 0x80558674 Epm_nEng RB_Axis_S16 16383.50 EngN 12 0.00 16383.50 FORMAT "%8.2" EXTENDED_LIMITS -16384.00 16383.50 DEPOSIT ABSOLUTE /end AXIS_PTS
/begin AXIS_PTS InjSys_nEng12_AX "base point distribution for engine speed with 12 base points" 0x8055868E Epm_nEng RB_Axis_S16 16383.50 EngN 12 0.00 16383.50 FORMAT "%8.2" EXTENDED_LIMITS -16384.00 16383.50 DEPOSIT ABSOLUTE /end AXIS_PTS
/begin AXIS_PTS InjSys_nrInj04_AX "Base point distribution number of injections with 4 base points" 0x805586A8 InjSys_nrInjLimdLoc RB_Axis_U16 65535.00 dez 4 0.00 65535.00 FORMAT "%8.2" DEPOSIT ABSOLUTE /end AXIS_PTS
/begin CHARACTERISTIC InjSys_P1APPL.agBas_C "class instance packet 1 for calibration / base angle" VALUE 0x8056321C RB_Val_Ws16 1535.977 kw_q0p0234 -768.0000 767.9766 FORMAT "%8.4" /end CHARACTERISTIC
/begin CHARACTERISTIC InjSys_P1APPL.facSpltAux1_C "class instance packet 1 for calibration / split factor auxiliary injection 1" VALUE 0x8056321E RB_Val_Wu8 0.9961 fak_ub_b1 0.00 0.9961 /end CHARACTERISTIC
/begin CHARACTERISTIC InjSys_P1APPL.facSpltAux2_C "class instance packet 1 for calibration / split factor auxiliary injection 2" VALUE 0x8056321F RB_Val_Wu8 0.9961 fak_ub_b1 0.00 0.9961 /end CHARACTERISTIC
/begin CHARACTERISTIC InjSys_P1APPL.facSpltAux_C "class instance packet 1 for calibration / split factor auxiliary injections" VALUE 0x80563220 RB_Val_Wu8 0.9961 fak_ub_b1 0.00 0.9961 /end CHARACTERISTIC
/begin CHARACTERISTIC InjSys_P1APPL.flgAbsltSplt_C "class instance packet 1 for calibration / condition split with absolute fuel mass" VALUE 0x80563221 RB_Val_Wu8 1.00000000000 B_TRUE 0.00 1.00000000000 FORMAT "%13.11" /end CHARACTERISTIC
/begin CHARACTERISTIC InjSys_P1APPL.flgAgAux_C "class instance packet 1 for calibration / condition angle addressing for auxiliary injections" VALUE 0x80563222 RB_Val_Wu8 1.00000000000 B_TRUE 0.00 1.00000000000 FORMAT "%13.11" /end CHARACTERISTIC
/begin CHARACTERISTIC InjSys_P1APPL.flgSpltAux_C "class instance packet 1 for calibration / condition split auxiliary injections with facSpltAux_C" VALUE 0x80563223 RB_Val_Wu8 1.00000000000 B_TRUE 0.00 1.00000000000 FORMAT "%13.11" /end CHARACTERISTIC
/begin CHARACTERISTIC InjSys_P1APPL.ratFuMAux1_C "class instance packet 1 for calibration / relative fuel mass auxiliary injection 1" VALUE 0x80563224 RB_Val_Wu16 3071.953 rel_uw_b3072 0.00 3071.953 FORMAT "%8.3" /end CHARACTERISTIC
/begin CHARACTERISTIC InjSys_P1APPL.ratFuMAux2_C "class instance packet 1 for calibration / relative fuel mass auxiliary injection 2" VALUE 0x80563226 RB_Val_Wu16 3071.953 rel_uw_b3072 0.00 3071.953 FORMAT "%8.3" /end CHARACTERISTIC
/begin CHARACTERISTIC InjSys_P1APPL.ratFuMBas_C "class instance packet 1 for calibration / relative fuel mass base injection" VALUE 0x80563228 RB_Val_Wu16 3071.953 rel_uw_b3072 0.00 3071.953 FORMAT "%8.3" /end CHARACTERISTIC
/begin CHARACTERISTIC InjSys_P1APPL.stAgEnd_C "class instance packet 1 for calibration / state end angle coupled" VALUE 0x8056322A RB_Val_Wu8 255.0 dez 0.00 255.0 FORMAT "%5.1" /end CHARACTERISTIC
/begin CHARACTERISTIC InjSys_P1APPL.tiBreakAux1_C "class instance packet 1 for calibration / break time auxiliary injection 1" VALUE 0x8056322C RB_Val_Ws16 1310.680 t_q0p04_ms 0.00 1310.680 FORMAT "%8.3" EXTENDED_LIMITS -1310.720 1310.680 /end CHARACTERISTIC
/begin CHARACTERISTIC InjSys_P1APPL.tiBreakAux2_C "class instance packet 1 for calibration / break time auxiliary injection 2" VALUE 0x8056322E RB_Val_Ws16 1310.680 t_q0p04_ms 0.00 1310.680 FORMAT "%8.3" EXTENDED_LIMITS -1310.720 1310.680 /end CHARACTERISTIC
/begin CHARACTERISTIC InjSys_P1V1I1_HO.agBasTPistColdVers2_GM "class instance packet 1 variant 1 / base angle at cold piston temperature (version 2)" MAP 0x80563234 RB_MapGroup_U8 382.5 kw_q1p5 0.00 382.5 FORMAT "%5.1"
 /begin AXIS_DESCR COM_AXIS Epm_nEng EngN 12 0.00 16383.50 FORMAT "%8.2" EXTENDED_LIMITS -16384.00 16383.50 AXIS_PTS_REF InjSys_nEng12Vers2_AX /end AXIS_DESCR
 /begin AXIS_DESCR COM_AXIS InjSys_ratAirMAgSpVers2AxisInp rel_uw_q0p0234 12 0.00 1535.977 FORMAT "%8.3" AXIS_PTS_REF InjSys_ratAirM12AgSpVers2_AX /end AXIS_DESCR
/end CHARACTERISTIC
/begin CHARACTERISTIC InjSys_P1V1I1_HO.agBasTPistCold_GM "class instance packet 1 variant 1 / base angle at cold piston temperature" MAP 0x805632C4 RB_MapGroup_U8 382.5 kw_q1p5 0.00 382.5 FORMAT "%5.1"
 /begin AXIS_DESCR COM_AXIS Epm_nEng EngN 12 0.00 16383.50 FORMAT "%8.2" EXTENDED_LIMITS -16384.00 16383.50 AXIS_PTS_REF InjSys_nEng12_AX /end AXIS_DESCR
 /begin AXIS_DESCR COM_AXIS InjSys_ratAirMAgSpAxisInp rel_uw_q0p0234 12 0.00 1535.977 FORMAT "%8.3" AXIS_PTS_REF InjSys_ratAirM12AgSp_AX /end AXIS_DESCR
/end CHARACTERISTIC
/begin CHARACTERISTIC InjSys_P1V1I1_HO.agBasTPistWrmVers2_GM "class instance packet 1 variant 1 / base angle for interpolation Warm TSA mode (Version 2)" MAP 0x80563354 RB_MapGroup_U8 382.5 kw_q1p5 0.00 382.5 FORMAT "%5.1"
 /begin AXIS_DESCR COM_AXIS Epm_nEng EngN 12 0.00 16383.50 FORMAT "%8.2" EXTENDED_LIMITS -16384.00 16383.50 AXIS_PTS_REF InjSys_nEng12Vers2_AX /end AXIS_DESCR
 /begin AXIS_DESCR COM_AXIS InjSys_ratAirMAgSpVers2AxisInp rel_uw_q0p0234 12 0.00 1535.977 FORMAT "%8.3" AXIS_PTS_REF InjSys_ratAirM12AgSpVers2_AX /end AXIS_DESCR
/end CHARACTERISTIC
/begin CHARACTERISTIC InjSys_P1V1I1_HO.agBasTPistWrm_GM "class instance packet 1 variant 1 / base angle for interpolation Warm TSA mode" MAP 0x805633E4 RB_MapGroup_U8 382.5 kw_q1p5 0.00 382.5 FORMAT "%5.1"
 /begin AXIS_DESCR COM_AXIS Epm_nEng EngN 12 0.00 16383.50 FORMAT "%8.2" EXTENDED_LIMITS -16384.00 16383.50 AXIS_PTS_REF InjSys_nEng12_AX /end AXIS_DESCR
 /begin AXIS_DESCR COM_AXIS InjSys_ratAirMAgSpAxisInp rel_uw_q0p0234 12 0.00 1535.977 FORMAT "%8.3" AXIS_PTS_REF InjSys_ratAirM12AgSp_AX /end AXIS_DESCR
/end CHARACTERISTIC
/begin CHARACTERISTIC InjSys_P1V1I1_HO.agBgnColdExtdEthnl_GM "class instance packet 1 variant 1 / base angle cold extended ethanol dependent" MAP 0x80563474 RB_MapGroup_U8 191.3 kw_q0p75_o240 240.0 431.3 FORMAT "%5.1"
 /begin AXIS_DESCR COM_AXIS Epm_nEng EngN 12 0.00 16383.50 FORMAT "%8.2" EXTENDED_LIMITS -16384.00 16383.50 AXIS_PTS_REF InjSys_nEng12_AX /end AXIS_DESCR
 /begin AXIS_DESCR COM_AXIS InjSys_ratAirMAxisInp rel_uw_q0p0234 12 0.00 1535.977 FORMAT "%8.3" AXIS_PTS_REF InjSys_ratAirM12_AX /end AXIS_DESCR
/end CHARACTERISTIC
/begin CHARACTERISTIC InjSys_P1V1I1_HO.agBgnColdExtd_GM "class instance packet 1 variant 1 / base angld cold extended" MAP 0x80563504 RB_MapGroup_U8 191.3 kw_q0p75_o240 240.0 431.3 FORMAT "%5.1"
 /begin AXIS_DESCR COM_AXIS Epm_nEng EngN 12 0.00 16383.50 FORMAT "%8.2" EXTENDED_LIMITS -16384.00 16383.50 AXIS_PTS_REF InjSys_nEng12_AX /end AXIS_DESCR
 /begin AXIS_DESCR COM_AXIS InjSys_ratAirMAxisInp rel_uw_q0p0234 12 0.00 1535.977 FORMAT "%8.3" AXIS_PTS_REF InjSys_ratAirM12_AX /end AXIS_DESCR
/end CHARACTERISTIC
/begin CHARACTERISTIC InjSys_P1V1I1_HO.agBgnColdSmlVlvEthnl_GM "class instance packet 1 variant 1 / base angle cold small valve ethanol dependent" MAP 0x80563594 RB_MapGroup_U8 191.3 kw_q0p75_o240 240.0 431.3 FORMAT "%5.1"
 /begin AXIS_DESCR COM_AXIS Epm_nEng EngN 12 0.00 16383.50 FORMAT "%8.2" EXTENDED_LIMITS -16384.00 16383.50 AXIS_PTS_REF InjSys_nEng12_AX /end AXIS_DESCR
 /begin AXIS_DESCR COM_AXIS InjSys_ratAirMAxisInp rel_uw_q0p0234 12 0.00 1535.977 FORMAT "%8.3" AXIS_PTS_REF InjSys_ratAirM12_AX /end AXIS_DESCR
/end CHARACTERISTIC
/begin CHARACTERISTIC InjSys_P1V1I1_HO.agBgnColdSmlVlv_GM "class instance packet 1 variant 1 / base angle cold small valve" MAP 0x80563624 RB_MapGroup_U8 191.3 kw_q0p75_o240 240.0 431.3 FORMAT "%5.1"
 /begin AXIS_DESCR COM_AXIS Epm_nEng EngN 12 0.00 16383.50 FORMAT "%8.2" EXTENDED_LIMITS -16384.00 16383.50 AXIS_PTS_REF InjSys_nEng12_AX /end AXIS_DESCR
 /begin AXIS_DESCR COM_AXIS InjSys_ratAirMAxisInp rel_uw_q0p0234 12 0.00 1535.977 FORMAT "%8.3" AXIS_PTS_REF InjSys_ratAirM12_AX /end AXIS_DESCR
/end CHARACTERISTIC
/begin CHARACTERISTIC InjSys_P1V1I1_HO.agBgnWrmExtdEthnl_GM "class instance packet 1 variant 1 / base angle warm extended ethanol dependent" MAP 0x805636B4 RB_MapGroup_U8 191.3 kw_q0p75_o240 240.0 431.3 FORMAT "%5.1"
 /begin AXIS_DESCR COM_AXIS Epm_nEng EngN 12 0.00 16383.50 FORMAT "%8.2" EXTENDED_LIMITS -16384.00 16383.50 AXIS_PTS_REF InjSys_nEng12_AX /end AXIS_DESCR
 /begin AXIS_DESCR COM_AXIS InjSys_ratAirMAxisInp rel_uw_q0p0234 12 0.00 1535.977 FORMAT "%8.3" AXIS_PTS_REF InjSys_ratAirM12_AX /end AXIS_DESCR
/end CHARACTERISTIC
/begin CHARACTERISTIC InjSys_P1V1I1_HO.agBgnWrmExtd_GM "class instance packet 1 variant 1 / base angle warm extended" MAP 0x80563744 RB_MapGroup_U8 191.3 kw_q0p75_o240 240.0 431.3 FORMAT "%5.1"
 /begin AXIS_DESCR COM_AXIS Epm_nEng EngN 12 0.00 16383.50 FORMAT "%8.2" EXTENDED_LIMITS -16384.00 16383.50 AXIS_PTS_REF InjSys_nEng12_AX /end AXIS_DESCR
 /begin AXIS_DESCR COM_AXIS InjSys_ratAirMAxisInp rel_uw_q0p0234 12 0.00 1535.977 FORMAT "%8.3" AXIS_PTS_REF InjSys_ratAirM12_AX /end AXIS_DESCR
/end CHARACTERISTIC
/begin CHARACTERISTIC InjSys_P1V1I1_HO.agBgnWrmSmlVlvEthnl_GM "class instance packet 1 variant 1 / base angle warm small valve ethanol dependent" MAP 0x805637D4 RB_MapGroup_U8 191.3 kw_q0p75_o240 240.0 431.3 FORMAT "%5.1"
 /begin AXIS_DESCR COM_AXIS Epm_nEng EngN 12 0.00 16383.50 FORMAT "%8.2" EXTENDED_LIMITS -16384.00 16383.50 AXIS_PTS_REF InjSys_nEng12_AX /end AXIS_DESCR
 /begin AXIS_DESCR COM_AXIS InjSys_ratAirMAxisInp rel_uw_q0p0234 12 0.00 1535.977 FORMAT "%8.3" AXIS_PTS_REF InjSys_ratAirM12_AX /end AXIS_DESCR
/end CHARACTERISTIC
/begin CHARACTERISTIC InjSys_P1V1I1_HO.agBgnWrmSmlVlv_GM "class instance packet 1 variant 1 / base angle warm small valve" MAP 0x80563864 RB_MapGroup_U8 191.3 kw_q0p75_o240 240.0 431.3 FORMAT "%5.1"
 /begin AXIS_DESCR COM_AXIS Epm_nEng EngN 12 0.00 16383.50 FORMAT "%8.2" EXTENDED_LIMITS -16384.00 16383.50 AXIS_PTS_REF InjSys_nEng12_AX /end AXIS_DESCR
 /begin AXIS_DESCR COM_AXIS InjSys_ratAirMAxisInp rel_uw_q0p0234 12 0.00 1535.977 FORMAT "%8.3" AXIS_PTS_REF InjSys_ratAirM12_AX /end AXIS_DESCR
/end CHARACTERISTIC
/begin CHARACTERISTIC InjSys_P1V1I1_HO.agDeltaEth_M "class instance packet 1 variant 1 / delta angle ethanol dependent" MAP 0x805638F4 RB_Map_S16S16_S16 191.2500 kw_q0p75 -96.00000 95.25000 FORMAT "%8.5" EXTENDED_LIMITS -24576.00 24575.25
 /begin AXIS_DESCR STD_AXIS InjSys_facEthLnrLocSp fak_ub_b2 4 0.00 1.992188 FORMAT "%8.6" EXTENDED_LIMITS -256.0000 255.9922 DEPOSIT ABSOLUTE /end AXIS_DESCR
 /begin AXIS_DESCR STD_AXIS InjSys_tEng Temp_Cels 4 -3549.940 3003.560 FORMAT "%8.3" DEPOSIT ABSOLUTE /end AXIS_DESCR
/end CHARACTERISTIC
/begin CHARACTERISTIC InjSys_P1V1I1_HO.agDeltaLamBasCold_M "class instance packet 1 variant 1 / cold angle base lambda dependent and engine temperature dependent" MAP 0x80563928 RB_Map_S16U16_S16 191.2500 kw_q0p75 -96.00000 95.25000 FORMAT "%8.5" EXTENDED_LIMITS -24576.00 24575.25
 /begin AXIS_DESCR STD_AXIS Epm_nEng EngN 8 -16384.00 16383.50 FORMAT "%8.2" DEPOSIT ABSOLUTE /end AXIS_DESCR
 /begin AXIS_DESCR STD_AXIS InjSys_ratAirMPredLocSp rel_uw_q0p0234 6 0.00 1535.977 FORMAT "%8.3" DEPOSIT ABSOLUTE /end AXIS_DESCR
/end CHARACTERISTIC
/begin CHARACTERISTIC InjSys_P1V1I1_HO.agDeltaLamBasWrm_M "class instance packet 1 variant 1 / warm angle base lambda dependent and engine temperature dependent" MAP 0x805639A8 RB_Map_S16U16_S16 191.2500 kw_q0p75 -96.00000 95.25000 FORMAT "%8.5" EXTENDED_LIMITS -24576.00 24575.25
 /begin AXIS_DESCR STD_AXIS Epm_nEng EngN 8 -16384.00 16383.50 FORMAT "%8.2" DEPOSIT ABSOLUTE /end AXIS_DESCR
 /begin AXIS_DESCR STD_AXIS InjSys_ratAirMPredLocSp rel_uw_q0p0234 6 0.00 1535.977 FORMAT "%8.3" DEPOSIT ABSOLUTE /end AXIS_DESCR
/end CHARACTERISTIC
/begin CHARACTERISTIC InjSys_P1V1I1_HO.agDeltaLam_M "class instance packet 1 variant 1 / base angle lamda dependent" MAP 0x80563A28 RB_Map_S16U16_S16 191.2500 kw_q0p75 -96.00000 95.25000 FORMAT "%8.5" EXTENDED_LIMITS -24576.00 24575.25
 /begin AXIS_DESCR STD_AXIS Epm_nEng EngN 10 -16384.00 16383.50 FORMAT "%8.2" DEPOSIT ABSOLUTE /end AXIS_DESCR
 /begin AXIS_DESCR STD_AXIS InjSys_ratAirMPredLocSp kw_q0p0234 8 0.00 1535.977 FORMAT "%8.3" DEPOSIT ABSOLUTE /end AXIS_DESCR
/end CHARACTERISTIC
/begin CHARACTERISTIC InjSys_P1V1I1_HO.agDeltaTEngOilVers2_GM "class instance packet 1 variant 1 / delta angle engine- and oil- temperature dependent" MAP 0x80563AF0 RB_MapGroup_S8 191.3 kw_q0p75 -96.00 95.25 FORMAT "%5.2"
 /begin AXIS_DESCR COM_AXIS Epm_nEng EngN 12 0.00 16383.50 FORMAT "%8.2" EXTENDED_LIMITS -16384.00 16383.50 AXIS_PTS_REF InjSys_nEng12Vers2_AX /end AXIS_DESCR
 /begin AXIS_DESCR COM_AXIS InjSys_ratAirMAgSpVers2AxisInp rel_uw_q0p0234 12 0.00 1535.977 FORMAT "%8.3" AXIS_PTS_REF InjSys_ratAirM12AgSpVers2_AX /end AXIS_DESCR
/end CHARACTERISTIC
/begin CHARACTERISTIC InjSys_P1V1I1_HO.agDeltaTEngOil_GM "class instance packet 1 variant 1 / delta angle engine- and oil- temperature dependent" MAP 0x80563B80 RB_MapGroup_S8 191.3 kw_q0p75 -96.00 95.25 FORMAT "%5.2"
 /begin AXIS_DESCR COM_AXIS Epm_nEng EngN 12 0.00 16383.50 FORMAT "%8.2" EXTENDED_LIMITS -16384.00 16383.50 AXIS_PTS_REF InjSys_nEng12_AX /end AXIS_DESCR
 /begin AXIS_DESCR COM_AXIS InjSys_ratAirMAgSpAxisInp rel_uw_q0p0234 12 0.00 1535.977 FORMAT "%8.3" AXIS_PTS_REF InjSys_ratAirM12AgSp_AX /end AXIS_DESCR
/end CHARACTERISTIC
/begin CHARACTERISTIC InjSys_P1V1I1_HO.facAgBgnLam_T "class instance packet 1 variant 1 / base angle lamda dependent curve" CURVE 0x80563C10 RB_Curve_U8_U8 0.9961 fak_ub_b1 0.00 0.9961
 /begin AXIS_DESCR STD_AXIS InjSys_facLamBasLocSp fak_ub_b2 8 0.00 1.992188 FORMAT "%8.6" DEPOSIT ABSOLUTE /end AXIS_DESCR
/end CHARACTERISTIC
/begin CHARACTERISTIC InjSys_P1V1I1_HO.facEthnlAgBgn_T "class instance packet 1 variant 1 / base angle lamda dependent ethanol curve" CURVE 0x80563C21 RB_Curve_U8_U8 0.9961 fak_ub_b1 0.00 0.9961
 /begin AXIS_DESCR STD_AXIS fethstoeLocSp fak_ub_b2 4 0.00 1.992188 FORMAT "%8.6" DEPOSIT ABSOLUTE /end AXIS_DESCR
/end CHARACTERISTIC
/begin CHARACTERISTIC InjSys_P1V1I1_HO.facTPistCold_M "class instance packet 1 variant 1 / delta angle ethanol dependent" MAP 0x80563C2A RB_Map_S16S16_U8 0.9961 fak_ub_b1 0.00 0.9961
 /begin AXIS_DESCR STD_AXIS InjSys_tEng Temp_Cels 8 -3549.940 3003.560 FORMAT "%8.3" DEPOSIT ABSOLUTE /end AXIS_DESCR
 /begin AXIS_DESCR STD_AXIS InjSys_tOilLocSp Temp_Cels 8 -3549.940 3003.560 FORMAT "%8.3" DEPOSIT ABSOLUTE /end AXIS_DESCR
/end CHARACTERISTIC
/begin CHARACTERISTIC InjSys_P1V1I1_HO.facTPist_M "class instance packet 1 variant 1 / factor piston temperature" MAP 0x80563C8E RB_Map_S16S16_U8 0.9961 fak_ub_b1 0.00 0.9961
 /begin AXIS_DESCR STD_AXIS InjSys_tPistBas Temp_Cels 6 -3549.940 3003.560 FORMAT "%8.3" DEPOSIT ABSOLUTE /end AXIS_DESCR
 /begin AXIS_DESCR STD_AXIS InjSys_tPistDelta temp_q0p1 6 -3276.800 3276.700 FORMAT "%8.3" DEPOSIT ABSOLUTE /end AXIS_DESCR
/end CHARACTERISTIC
/begin CHARACTERISTIC InjSys_P1V1I1_HO.facWghtAgDeltaLamBasCold_T "class instance packet 1 variant 1 / weighting factor cold delta angle engine and oil temperature dependent" CURVE 0x80563CCE RB_Curve_U8_U8 0.9961 fak_ub_b1 0.00 0.9961
 /begin AXIS_DESCR STD_AXIS InjSys_facLamBasLocSp fak_ub_b2 3 0.00 1.992188 FORMAT "%8.6" DEPOSIT ABSOLUTE /end AXIS_DESCR
/end CHARACTERISTIC
/begin CHARACTERISTIC InjSys_P1V1I1_HO.facWghtAgDeltaLamBasWrm_T "class instance packet 1 variant 1 / weighting factor warm delta angle engine and oil temperature dependent" CURVE 0x80563CD5 RB_Curve_U8_U8 0.9961 fak_ub_b1 0.00 0.9961
 /begin AXIS_DESCR STD_AXIS InjSys_facLamBasLocSp fak_ub_b2 3 0.00 1.992188 FORMAT "%8.6" DEPOSIT ABSOLUTE /end AXIS_DESCR
/end CHARACTERISTIC
/begin CHARACTERISTIC InjSys_P1V1I1_HO.facWghtColdWrmEthnl_M "class instance packet 1 variant 1 / weighting factor cold-warm ethnaol dependent" MAP 0x80563CDC RB_Map_S16S16_U8 0.9961 fak_ub_b1 0.00 0.9961
 /begin AXIS_DESCR STD_AXIS InjSys_tEng Temp_Cels 6 -3549.940 3003.560 FORMAT "%8.3" DEPOSIT ABSOLUTE /end AXIS_DESCR
 /begin AXIS_DESCR STD_AXIS InjSys_tOilLocSp Temp_Cels 4 -3549.940 3003.560 FORMAT "%8.3" DEPOSIT ABSOLUTE /end AXIS_DESCR
/end CHARACTERISTIC
/begin CHARACTERISTIC InjSys_P1V1I1_HO.facWghtColdWrm_M "class instance packet 1 variant 1 / weighting factor cold-warm" MAP 0x80563D0C RB_Map_S16S16_U8 0.9961 fak_ub_b1 0.00 0.9961
 /begin AXIS_DESCR STD_AXIS InjSys_tEng Temp_Cels 6 -3549.940 3003.560 FORMAT "%8.3" DEPOSIT ABSOLUTE /end AXIS_DESCR
 /begin AXIS_DESCR STD_AXIS InjSys_tOilLocSp Temp_Cels 4 -3549.940 3003.560 FORMAT "%8.3" DEPOSIT ABSOLUTE /end AXIS_DESCR
/end CHARACTERISTIC
/begin CHARACTERISTIC InjSys_P1V1I1_HO.facWghtWrmCold_M "class instance packet 1 variant 1 / weighting factor warmcold delta angle engine- and oil- temperature dependent" MAP 0x80563D3C RB_Map_S16S16_U8 0.9961 fak_ub_b1 0.00 0.9961
 /begin AXIS_DESCR STD_AXIS InjSys_tEng Temp_Cels 6 -3549.940 3003.560 FORMAT "%8.3" DEPOSIT ABSOLUTE /end AXIS_DESCR
 /begin AXIS_DESCR STD_AXIS InjSys_tOilLocSp Temp_Cels 4 -3549.940 3003.560 FORMAT "%8.3" DEPOSIT ABSOLUTE /end AXIS_DESCR
/end CHARACTERISTIC
/begin CHARACTERISTIC InjSys_P1V1I1_HO.flgAxVers_C "class instance packet 1 variant 1 / condition map selection with group axis in version 2" VALUE 0x80563D6C RB_Val_Wu8 1.00000000000 B_TRUE 0.00 1.00000000000 FORMAT "%13.11" /end CHARACTERISTIC
/begin CHARACTERISTIC InjSys_P1V1I2_HO.agBasTPistColdVers2_GM "injection packet 1 in variant 1 / base angle at cold piston temperature (version 2)" MAP 0x805599F8 RB_MapGroup_U8 382.5 kw_q1p5 0.00 382.5 FORMAT "%5.1"
 /begin AXIS_DESCR COM_AXIS Epm_nEng EngN 12 0.00 16383.50 FORMAT "%8.2" EXTENDED_LIMITS -16384.00 16383.50 AXIS_PTS_REF InjSys_nEng12Vers2_AX /end AXIS_DESCR
 /begin AXIS_DESCR COM_AXIS InjSys_ratAirMAgSpVers2AxisInp rel_uw_q0p0234 12 0.00 1535.977 FORMAT "%8.3" AXIS_PTS_REF InjSys_ratAirM12AgSpVers2_AX /end AXIS_DESCR
/end CHARACTERISTIC
/begin CHARACTERISTIC InjSys_P1V1I2_HO.agBasTPistCold_GM "injection packet 1 in variant 1 / base angle at cold piston temperature" MAP 0x80559A88 RB_MapGroup_U8 382.5 kw_q1p5 0.00 382.5 FORMAT "%5.1"
 /begin AXIS_DESCR COM_AXIS Epm_nEng EngN 12 0.00 16383.50 FORMAT "%8.2" EXTENDED_LIMITS -16384.00 16383.50 AXIS_PTS_REF InjSys_nEng12_AX /end AXIS_DESCR
 /begin AXIS_DESCR COM_AXIS InjSys_ratAirMAgSpAxisInp rel_uw_q0p0234 12 0.00 1535.977 FORMAT "%8.3" AXIS_PTS_REF InjSys_ratAirM12AgSp_AX /end AXIS_DESCR
/end CHARACTERISTIC
/begin CHARACTERISTIC InjSys_P1V1I2_HO.agBasTPistWrmVers2_GM "injection packet 1 in variant 1 / base angle for interpolation Warm TSA mode (Version 2)" MAP 0x80559B18 RB_MapGroup_U8 382.5 kw_q1p5 0.00 382.5 FORMAT "%5.1"
 /begin AXIS_DESCR COM_AXIS Epm_nEng EngN 12 0.00 16383.50 FORMAT "%8.2" EXTENDED_LIMITS -16384.00 16383.50 AXIS_PTS_REF InjSys_nEng12Vers2_AX /end AXIS_DESCR
 /begin AXIS_DESCR COM_AXIS InjSys_ratAirMAgSpVers2AxisInp rel_uw_q0p0234 12 0.00 1535.977 FORMAT "%8.3" AXIS_PTS_REF InjSys_ratAirM12AgSpVers2_AX /end AXIS_DESCR
/end CHARACTERISTIC
/begin CHARACTERISTIC InjSys_P1V1I2_HO.agBasTPistWrm_GM "injection packet 1 in variant 1 / base angle for interpolation Warm TSA mode" MAP 0x80559BA8 RB_MapGroup_U8 382.5 kw_q1p5 0.00 382.5 FORMAT "%5.1"
 /begin AXIS_DESCR COM_AXIS Epm_nEng EngN 12 0.00 16383.50 FORMAT "%8.2" EXTENDED_LIMITS -16384.00 16383.50 AXIS_PTS_REF InjSys_nEng12_AX /end AXIS_DESCR
 /begin AXIS_DESCR COM_AXIS InjSys_ratAirMAgSpAxisInp rel_uw_q0p0234 12 0.00 1535.977 FORMAT "%8.3" AXIS_PTS_REF InjSys_ratAirM12AgSp_AX /end AXIS_DESCR
/end CHARACTERISTIC
/begin CHARACTERISTIC InjSys_P1V1I2_HO.agBgnColdExtdEthnl_GM "injection packet 1 in variant 1 / base angle cold extended ethanol dependent" MAP 0x80559C38 RB_MapGroup_U8 191.3 kw_q0p75_o240 240.0 431.3 FORMAT "%5.1"
 /begin AXIS_DESCR COM_AXIS Epm_nEng EngN 12 0.00 16383.50 FORMAT "%8.2" EXTENDED_LIMITS -16384.00 16383.50 AXIS_PTS_REF InjSys_nEng12_AX /end AXIS_DESCR
 /begin AXIS_DESCR COM_AXIS InjSys_ratAirMAxisInp rel_uw_q0p0234 12 0.00 1535.977 FORMAT "%8.3" AXIS_PTS_REF InjSys_ratAirM12_AX /end AXIS_DESCR
/end CHARACTERISTIC
/begin CHARACTERISTIC InjSys_P1V1I2_HO.agBgnColdExtd_GM "injection packet 1 in variant 1 / base angld cold extended" MAP 0x80559CC8 RB_MapGroup_U8 191.3 kw_q0p75_o240 240.0 431.3 FORMAT "%5.1"
 /begin AXIS_DESCR COM_AXIS Epm_nEng EngN 12 0.00 16383.50 FORMAT "%8.2" EXTENDED_LIMITS -16384.00 16383.50 AXIS_PTS_REF InjSys_nEng12_AX /end AXIS_DESCR
 /begin AXIS_DESCR COM_AXIS InjSys_ratAirMAxisInp rel_uw_q0p0234 12 0.00 1535.977 FORMAT "%8.3" AXIS_PTS_REF InjSys_ratAirM12_AX /end AXIS_DESCR
/end CHARACTERISTIC
/begin CHARACTERISTIC InjSys_P1V1I2_HO.agBgnColdSmlVlvEthnl_GM "injection packet 1 in variant 1 / base angle cold small valve ethanol dependent" MAP 0x80559D58 RB_MapGroup_U8 191.3 kw_q0p75_o240 240.0 431.3 FORMAT "%5.1"
 /begin AXIS_DESCR COM_AXIS Epm_nEng EngN 12 0.00 16383.50 FORMAT "%8.2" EXTENDED_LIMITS -16384.00 16383.50 AXIS_PTS_REF InjSys_nEng12_AX /end AXIS_DESCR
 /begin AXIS_DESCR COM_AXIS InjSys_ratAirMAxisInp rel_uw_q0p0234 12 0.00 1535.977 FORMAT "%8.3" AXIS_PTS_REF InjSys_ratAirM12_AX /end AXIS_DESCR
/end CHARACTERISTIC
/begin CHARACTERISTIC InjSys_P1V1I2_HO.agBgnColdSmlVlv_GM "injection packet 1 in variant 1 / base angle cold small valve" MAP 0x80559DE8 RB_MapGroup_U8 191.3 kw_q0p75_o240 240.0 431.3 FORMAT "%5.1"
 /begin AXIS_DESCR COM_AXIS Epm_nEng EngN 12 0.00 16383.50 FORMAT "%8.2" EXTENDED_LIMITS -16384.00 16383.50 AXIS_PTS_REF InjSys_nEng12_AX /end AXIS_DESCR
 /begin AXIS_DESCR COM_AXIS InjSys_ratAirMAxisInp rel_uw_q0p0234 12 0.00 1535.977 FORMAT "%8.3" AXIS_PTS_REF InjSys_ratAirM12_AX /end AXIS_DESCR
/end CHARACTERISTIC
/begin CHARACTERISTIC InjSys_P1V1I2_HO.agBgnWrmExtdEthnl_GM "injection packet 1 in variant 1 / base angle warm extended ethanol dependent" MAP 0x80559E78 RB_MapGroup_U8 191.3 kw_q0p75_o240 240.0 431.3 FORMAT "%5.1"
 /begin AXIS_DESCR COM_AXIS Epm_nEng EngN 12 0.00 16383.50 FORMAT "%8.2" EXTENDED_LIMITS -16384.00 16383.50 AXIS_PTS_REF InjSys_nEng12_AX /end AXIS_DESCR
 /begin AXIS_DESCR COM_AXIS InjSys_ratAirMAxisInp rel_uw_q0p0234 12 0.00 1535.977 FORMAT "%8.3" AXIS_PTS_REF InjSys_ratAirM12_AX /end AXIS_DESCR
/end CHARACTERISTIC
/begin CHARACTERISTIC InjSys_P1V1I2_HO.agBgnWrmExtd_GM "injection packet 1 in variant 1 / base angle warm extended" MAP 0x80559F08 RB_MapGroup_U8 191.3 kw_q0p75_o240 240.0 431.3 FORMAT "%5.1"
 /begin AXIS_DESCR COM_AXIS Epm_nEng EngN 12 0.00 16383.50 FORMAT "%8.2" EXTENDED_LIMITS -16384.00 16383.50 AXIS_PTS_REF InjSys_nEng12_AX /end AXIS_DESCR
 /begin AXIS_DESCR COM_AXIS InjSys_ratAirMAxisInp rel_uw_q0p0234 12 0.00 1535.977 FORMAT "%8.3" AXIS_PTS_REF InjSys_ratAirM12_AX /end AXIS_DESCR
/end CHARACTERISTIC
/begin CHARACTERISTIC InjSys_P1V1I2_HO.agBgnWrmSmlVlvEthnl_GM "injection packet 1 in variant 1 / base angle warm small valve ethanol dependent" MAP 0x80559F98 RB_MapGroup_U8 191.3 kw_q0p75_o240 240.0 431.3 FORMAT "%5.1"
 /begin AXIS_DESCR COM_AXIS Epm_nEng EngN 12 0.00 16383.50 FORMAT "%8.2" EXTENDED_LIMITS -16384.00 16383.50 AXIS_PTS_REF InjSys_nEng12_AX /end AXIS_DESCR
 /begin AXIS_DESCR COM_AXIS InjSys_ratAirMAxisInp rel_uw_q0p0234 12 0.00 1535.977 FORMAT "%8.3" AXIS_PTS_REF InjSys_ratAirM12_AX /end AXIS_DESCR
/end CHARACTERISTIC
/begin CHARACTERISTIC InjSys_P1V1I2_HO.agBgnWrmSmlVlv_GM "injection packet 1 in variant 1 / base angle warm small valve" MAP 0x8055A028 RB_MapGroup_U8 191.3 kw_q0p75_o240 240.0 431.3 FORMAT "%5.1"
 /begin AXIS_DESCR COM_AXIS Epm_nEng EngN 12 0.00 16383.50 FORMAT "%8.2" EXTENDED_LIMITS -16384.00 16383.50 AXIS_PTS_REF InjSys_nEng12_AX /end AXIS_DESCR
 /begin AXIS_DESCR COM_AXIS InjSys_ratAirMAxisInp rel_uw_q0p0234 12 0.00 1535.977 FORMAT "%8.3" AXIS_PTS_REF InjSys_ratAirM12_AX /end AXIS_DESCR
/end CHARACTERISTIC
/begin CHARACTERISTIC InjSys_P1V1I2_HO.agDeltaEth_M "injection packet 1 in variant 1 / delta angle ethanol dependent" MAP 0x8055A0B8 RB_Map_S16S16_S16 191.2500 kw_q0p75 -96.00000 95.25000 FORMAT "%8.5" EXTENDED_LIMITS -24576.00 24575.25
 /begin AXIS_DESCR STD_AXIS InjSys_facEthLnrLocSp fak_ub_b2 4 0.00 1.992188 FORMAT "%8.6" EXTENDED_LIMITS -256.0000 255.9922 DEPOSIT ABSOLUTE /end AXIS_DESCR
 /begin AXIS_DESCR STD_AXIS InjSys_tEng Temp_Cels 4 -3549.940 3003.560 FORMAT "%8.3" DEPOSIT ABSOLUTE /end AXIS_DESCR
/end CHARACTERISTIC
/begin CHARACTERISTIC InjSys_P1V1I2_HO.agDeltaLamBasCold_M "injection packet 1 in variant 1 / cold angle base lambda dependent and engine temperature dependent" MAP 0x8055A0EC RB_Map_S16U16_S16 191.2500 kw_q0p75 -96.00000 95.25000 FORMAT "%8.5" EXTENDED_LIMITS -24576.00 24575.25
 /begin AXIS_DESCR STD_AXIS Epm_nEng EngN 8 -16384.00 16383.50 FORMAT "%8.2" DEPOSIT ABSOLUTE /end AXIS_DESCR
 /begin AXIS_DESCR STD_AXIS InjSys_ratAirMPredLocSp rel_uw_q0p0234 6 0.00 1535.977 FORMAT "%8.3" DEPOSIT ABSOLUTE /end AXIS_DESCR
/end CHARACTERISTIC
/begin CHARACTERISTIC InjSys_P1V1I2_HO.agDeltaLamBasWrm_M "injection packet 1 in variant 1 / warm angle base lambda dependent and engine temperature dependent" MAP 0x8055A16C RB_Map_S16U16_S16 191.2500 kw_q0p75 -96.00000 95.25000 FORMAT "%8.5" EXTENDED_LIMITS -24576.00 24575.25
 /begin AXIS_DESCR STD_AXIS Epm_nEng EngN 8 -16384.00 16383.50 FORMAT "%8.2" DEPOSIT ABSOLUTE /end AXIS_DESCR
 /begin AXIS_DESCR STD_AXIS InjSys_ratAirMPredLocSp rel_uw_q0p0234 6 0.00 1535.977 FORMAT "%8.3" DEPOSIT ABSOLUTE /end AXIS_DESCR
/end CHARACTERISTIC
/begin CHARACTERISTIC InjSys_P1V1I2_HO.agDeltaLam_M "injection packet 1 in variant 1 / base angle lamda dependent" MAP 0x8055A1EC RB_Map_S16U16_S16 191.2500 kw_q0p75 -96.00000 95.25000 FORMAT "%8.5" EXTENDED_LIMITS -24576.00 24575.25
 /begin AXIS_DESCR STD_AXIS Epm_nEng EngN 10 -16384.00 16383.50 FORMAT "%8.2" DEPOSIT ABSOLUTE /end AXIS_DESCR
 /begin AXIS_DESCR STD_AXIS InjSys_ratAirMPredLocSp kw_q0p0234 8 0.00 1535.977 FORMAT "%8.3" DEPOSIT ABSOLUTE /end AXIS_DESCR
/end CHARACTERISTIC
/begin CHARACTERISTIC InjSys_P1V1I2_HO.agDeltaTEngOilVers2_GM "injection packet 1 in variant 1 / delta angle engine- and oil- temperature dependent" MAP 0x8055A2B4 RB_MapGroup_S8 191.3 kw_q0p75 -96.00 95.25 FORMAT "%5.2"
 /begin AXIS_DESCR COM_AXIS Epm_nEng EngN 12 0.00 16383.50 FORMAT "%8.2" EXTENDED_LIMITS -16384.00 16383.50 AXIS_PTS_REF InjSys_nEng12Vers2_AX /end AXIS_DESCR
 /begin AXIS_DESCR COM_AXIS InjSys_ratAirMAgSpVers2AxisInp rel_uw_q0p0234 12 0.00 1535.977 FORMAT "%8.3" AXIS_PTS_REF InjSys_ratAirM12AgSpVers2_AX /end AXIS_DESCR
/end CHARACTERISTIC
/begin CHARACTERISTIC InjSys_P1V1I2_HO.agDeltaTEngOil_GM "injection packet 1 in variant 1 / delta angle engine- and oil- temperature dependent" MAP 0x8055A344 RB_MapGroup_S8 191.3 kw_q0p75 -96.00 95.25 FORMAT "%5.2"
 /begin AXIS_DESCR COM_AXIS Epm_nEng EngN 12 0.00 16383.50 FORMAT "%8.2" EXTENDED_LIMITS -16384.00 16383.50 AXIS_PTS_REF InjSys_nEng12_AX /end AXIS_DESCR
 /begin AXIS_DESCR COM_AXIS InjSys_ratAirMAgSpAxisInp rel_uw_q0p0234 12 0.00 1535.977 FORMAT "%8.3" AXIS_PTS_REF InjSys_ratAirM12AgSp_AX /end AXIS_DESCR
/end CHARACTERISTIC
/begin CHARACTERISTIC InjSys_P1V1I2_HO.facAgBgnLam_T "injection packet 1 in variant 1 / base angle lamda dependent curve" CURVE 0x8055A3D4 RB_Curve_U8_U8 0.9961 fak_ub_b1 0.00 0.9961
 /begin AXIS_DESCR STD_AXIS InjSys_facLamBasLocSp fak_ub_b2 8 0.00 1.992188 FORMAT "%8.6" DEPOSIT ABSOLUTE /end AXIS_DESCR
/end CHARACTERISTIC
/begin CHARACTERISTIC InjSys_P1V1I2_HO.facEthnlAgBgn_T "injection packet 1 in variant 1 / base angle lamda dependent ethanol curve" CURVE 0x8055A3E5 RB_Curve_U8_U8 0.9961 fak_ub_b1 0.00 0.9961
 /begin AXIS_DESCR STD_AXIS fethstoeLocSp fak_ub_b2 4 0.00 1.992188 FORMAT "%8.6" DEPOSIT ABSOLUTE /end AXIS_DESCR
/end CHARACTERISTIC
/begin CHARACTERISTIC InjSys_P1V1I2_HO.facTPistCold_M "injection packet 1 in variant 1 / delta angle ethanol dependent" MAP 0x8055A3EE RB_Map_S16S16_U8 0.9961 fak_ub_b1 0.00 0.9961
 /begin AXIS_DESCR STD_AXIS InjSys_tEng Temp_Cels 8 -3549.940 3003.560 FORMAT "%8.3" DEPOSIT ABSOLUTE /end AXIS_DESCR
 /begin AXIS_DESCR STD_AXIS InjSys_tOilLocSp Temp_Cels 8 -3549.940 3003.560 FORMAT "%8.3" DEPOSIT ABSOLUTE /end AXIS_DESCR
/end CHARACTERISTIC
/begin CHARACTERISTIC InjSys_P1V1I2_HO.facTPist_M "injection packet 1 in variant 1 / factor piston temperature" MAP 0x8055A452 RB_Map_S16S16_U8 0.9961 fak_ub_b1 0.00 0.9961
 /begin AXIS_DESCR STD_AXIS InjSys_tPistBas Temp_Cels 6 -3549.940 3003.560 FORMAT "%8.3" DEPOSIT ABSOLUTE /end AXIS_DESCR
 /begin AXIS_DESCR STD_AXIS InjSys_tPistDelta temp_q0p1 6 -3276.800 3276.700 FORMAT "%8.3" DEPOSIT ABSOLUTE /end AXIS_DESCR
/end CHARACTERISTIC
/begin CHARACTERISTIC InjSys_P1V1I2_HO.facWghtAgDeltaLamBasCold_T "injection packet 1 in variant 1 / weighting factor cold delta angle engine and oil temperature dependent" CURVE 0x8055A492 RB_Curve_U8_U8 0.9961 fak_ub_b1 0.00 0.9961
 /begin AXIS_DESCR STD_AXIS InjSys_facLamBasLocSp fak_ub_b2 3 0.00 1.992188 FORMAT "%8.6" DEPOSIT ABSOLUTE /end AXIS_DESCR
/end CHARACTERISTIC
/begin CHARACTERISTIC InjSys_P1V1I2_HO.facWghtAgDeltaLamBasWrm_T "injection packet 1 in variant 1 / weighting factor warm delta angle engine and oil temperature dependent" CURVE 0x8055A499 RB_Curve_U8_U8 0.9961 fak_ub_b1 0.00 0.9961
 /begin AXIS_DESCR STD_AXIS InjSys_facLamBasLocSp fak_ub_b2 3 0.00 1.992188 FORMAT "%8.6" DEPOSIT ABSOLUTE /end AXIS_DESCR
/end CHARACTERISTIC
/begin CHARACTERISTIC InjSys_P1V1I2_HO.facWghtColdWrmEthnl_M "injection packet 1 in variant 1 / weighting factor cold-warm ethnaol dependent" MAP 0x8055A4A0 RB_Map_S16S16_U8 0.9961 fak_ub_b1 0.00 0.9961
 /begin AXIS_DESCR STD_AXIS InjSys_tEng Temp_Cels 6 -3549.940 3003.560 FORMAT "%8.3" DEPOSIT ABSOLUTE /end AXIS_DESCR
 /begin AXIS_DESCR STD_AXIS InjSys_tOilLocSp Temp_Cels 4 -3549.940 3003.560 FORMAT "%8.3" DEPOSIT ABSOLUTE /end AXIS_DESCR
/end CHARACTERISTIC
/begin CHARACTERISTIC InjSys_P1V1I2_HO.facWghtColdWrm_M "injection packet 1 in variant 1 / weighting factor cold-warm" MAP 0x8055A4D0 RB_Map_S16S16_U8 0.9961 fak_ub_b1 0.00 0.9961
 /begin AXIS_DESCR STD_AXIS InjSys_tEng Temp_Cels 6 -3549.940 3003.560 FORMAT "%8.3" DEPOSIT ABSOLUTE /end AXIS_DESCR
 /begin AXIS_DESCR STD_AXIS InjSys_tOilLocSp Temp_Cels 4 -3549.940 3003.560 FORMAT "%8.3" DEPOSIT ABSOLUTE /end AXIS_DESCR
/end CHARACTERISTIC
/begin CHARACTERISTIC InjSys_P1V1I2_HO.facWghtWrmCold_M "injection packet 1 in variant 1 / weighting factor warmcold delta angle engine- and oil- temperature dependent" MAP 0x8055A500 RB_Map_S16S16_U8 0.9961 fak_ub_b1 0.00 0.9961
 /begin AXIS_DESCR STD_AXIS InjSys_tEng Temp_Cels 6 -3549.940 3003.560 FORMAT "%8.3" DEPOSIT ABSOLUTE /end AXIS_DESCR
 /begin AXIS_DESCR STD_AXIS InjSys_tOilLocSp Temp_Cels 4 -3549.940 3003.560 FORMAT "%8.3" DEPOSIT ABSOLUTE /end AXIS_DESCR
/end CHARACTERISTIC
/begin CHARACTERISTIC InjSys_P1V1I2_HO.flgAxVers_C "injection packet 1 in variant 1 / condition map selection with group axis in version 2" VALUE 0x8055A530 RB_Val_Wu8 1.00000000000 B_TRUE 0.00 1.00000000000 FORMAT "%13.11" /end CHARACTERISTIC
/begin CHARACTERISTIC InjSys_P1V2I1_HO.agBasTPistColdVers2_GM "class instance packet 1 variant 2 / base angle at cold piston temperature (version 2)" MAP 0x80563D74 RB_MapGroup_U8 382.5 kw_q1p5 0.00 382.5 FORMAT "%5.1"
 /begin AXIS_DESCR COM_AXIS Epm_nEng EngN 12 0.00 16383.50 FORMAT "%8.2" EXTENDED_LIMITS -16384.00 16383.50 AXIS_PTS_REF InjSys_nEng12Vers2_AX /end AXIS_DESCR
 /begin AXIS_DESCR COM_AXIS InjSys_ratAirMAgSpVers2AxisInp rel_uw_q0p0234 12 0.00 1535.977 FORMAT "%8.3" AXIS_PTS_REF InjSys_ratAirM12AgSpVers2_AX /end AXIS_DESCR
/end CHARACTERISTIC
/begin CHARACTERISTIC InjSys_P1V2I1_HO.agBasTPistCold_GM "class instance packet 1 variant 2 / base angle at cold piston temperature" MAP 0x80563E04 RB_MapGroup_U8 382.5 kw_q1p5 0.00 382.5 FORMAT "%5.1"
 /begin AXIS_DESCR COM_AXIS Epm_nEng EngN 12 0.00 16383.50 FORMAT "%8.2" EXTENDED_LIMITS -16384.00 16383.50 AXIS_PTS_REF InjSys_nEng12_AX /end AXIS_DESCR
 /begin AXIS_DESCR COM_AXIS InjSys_ratAirMAgSpAxisInp rel_uw_q0p0234 12 0.00 1535.977 FORMAT "%8.3" AXIS_PTS_REF InjSys_ratAirM12AgSp_AX /end AXIS_DESCR
/end CHARACTERISTIC
/begin CHARACTERISTIC InjSys_P1V2I1_HO.agBasTPistWrmVers2_GM "class instance packet 1 variant 2 / base angle for interpolation Warm TSA mode (Version 2)" MAP 0x80563E94 RB_MapGroup_U8 382.5 kw_q1p5 0.00 382.5 FORMAT "%5.1"
 /begin AXIS_DESCR COM_AXIS Epm_nEng EngN 12 0.00 16383.50 FORMAT "%8.2" EXTENDED_LIMITS -16384.00 16383.50 AXIS_PTS_REF InjSys_nEng12Vers2_AX /end AXIS_DESCR
 /begin AXIS_DESCR COM_AXIS InjSys_ratAirMAgSpVers2AxisInp rel_uw_q0p0234 12 0.00 1535.977 FORMAT "%8.3" AXIS_PTS_REF InjSys_ratAirM12AgSpVers2_AX /end AXIS_DESCR
/end CHARACTERISTIC
/begin CHARACTERISTIC InjSys_P1V2I1_HO.agBasTPistWrm_GM "class instance packet 1 variant 2 / base angle for interpolation Warm TSA mode" MAP 0x80563F24 RB_MapGroup_U8 382.5 kw_q1p5 0.00 382.5 FORMAT "%5.1"
 /begin AXIS_DESCR COM_AXIS Epm_nEng EngN 12 0.00 16383.50 FORMAT "%8.2" EXTENDED_LIMITS -16384.00 16383.50 AXIS_PTS_REF InjSys_nEng12_AX /end AXIS_DESCR
 /begin AXIS_DESCR COM_AXIS InjSys_ratAirMAgSpAxisInp rel_uw_q0p0234 12 0.00 1535.977 FORMAT "%8.3" AXIS_PTS_REF InjSys_ratAirM12AgSp_AX /end AXIS_DESCR
/end CHARACTERISTIC
/begin CHARACTERISTIC InjSys_P1V2I1_HO.agBgnColdExtdEthnl_GM "class instance packet 1 variant 2 / base angle when charge motion greater threshold" MAP 0x80563FB4 RB_MapGroup_U8 191.3 kw_q0p75_o240 240.0 431.3 FORMAT "%5.1"
 /begin AXIS_DESCR COM_AXIS Epm_nEng EngN 12 0.00 16383.50 FORMAT "%8.2" EXTENDED_LIMITS -16384.00 16383.50 AXIS_PTS_REF InjSys_nEng12_AX /end AXIS_DESCR
 /begin AXIS_DESCR COM_AXIS InjSys_ratAirMAxisInp rel_uw_q0p0234 12 0.00 1535.977 FORMAT "%8.3" AXIS_PTS_REF InjSys_ratAirM12_AX /end AXIS_DESCR
/end CHARACTERISTIC
/begin CHARACTERISTIC InjSys_P1V2I1_HO.agBgnColdExtd_GM "class instance packet 1 variant 2 / base angle cold extended" MAP 0x80564044 RB_MapGroup_U8 191.3 kw_q0p75_o240 240.0 431.3 FORMAT "%5.1"
 /begin AXIS_DESCR COM_AXIS Epm_nEng EngN 12 0.00 16383.50 FORMAT "%8.2" EXTENDED_LIMITS -16384.00 16383.50 AXIS_PTS_REF InjSys_nEng12_AX /end AXIS_DESCR
 /begin AXIS_DESCR COM_AXIS InjSys_ratAirMAxisInp rel_uw_q0p0234 12 0.00 1535.977 FORMAT "%8.3" AXIS_PTS_REF InjSys_ratAirM12_AX /end AXIS_DESCR
/end CHARACTERISTIC
/begin CHARACTERISTIC InjSys_P1V2I1_HO.agBgnColdSmlVlvEthnl_GM "class instance packet 1 variant 2 / base angle cold small valve ethanol dependent" MAP 0x805640D4 RB_MapGroup_U8 191.3 kw_q0p75_o240 240.0 431.3 FORMAT "%5.1"
 /begin AXIS_DESCR COM_AXIS Epm_nEng EngN 12 0.00 16383.50 FORMAT "%8.2" EXTENDED_LIMITS -16384.00 16383.50 AXIS_PTS_REF InjSys_nEng12_AX /end AXIS_DESCR
 /begin AXIS_DESCR COM_AXIS InjSys_ratAirMAxisInp rel_uw_q0p0234 12 0.00 1535.977 FORMAT "%8.3" AXIS_PTS_REF InjSys_ratAirM12_AX /end AXIS_DESCR
/end CHARACTERISTIC
/begin CHARACTERISTIC InjSys_P1V2I1_HO.agBgnColdSmlVlv_GM "class instance packet 1 variant 2 / base angle cold small valve" MAP 0x80564164 RB_MapGroup_U8 191.3 kw_q0p75_o240 240.0 431.3 FORMAT "%5.1"
 /begin AXIS_DESCR COM_AXIS Epm_nEng EngN 12 0.00 16383.50 FORMAT "%8.2" EXTENDED_LIMITS -16384.00 16383.50 AXIS_PTS_REF InjSys_nEng12_AX /end AXIS_DESCR
 /begin AXIS_DESCR COM_AXIS InjSys_ratAirMAxisInp rel_uw_q0p0234 12 0.00 1535.977 FORMAT "%8.3" AXIS_PTS_REF InjSys_ratAirM12_AX /end AXIS_DESCR
/end CHARACTERISTIC
/begin CHARACTERISTIC InjSys_P1V2I1_HO.agBgnWrmExtdEthnl_GM "class instance packet 1 variant 2 / base angle warm extended ethanol dependent" MAP 0x805641F4 RB_MapGroup_U8 191.3 kw_q0p75_o240 240.0 431.3 FORMAT "%5.1"
 /begin AXIS_DESCR COM_AXIS Epm_nEng EngN 12 0.00 16383.50 FORMAT "%8.2" EXTENDED_LIMITS -16384.00 16383.50 AXIS_PTS_REF InjSys_nEng12_AX /end AXIS_DESCR
 /begin AXIS_DESCR COM_AXIS InjSys_ratAirMAxisInp rel_uw_q0p0234 12 0.00 1535.977 FORMAT "%8.3" AXIS_PTS_REF InjSys_ratAirM12_AX /end AXIS_DESCR
/end CHARACTERISTIC
/begin CHARACTERISTIC InjSys_P1V2I1_HO.agBgnWrmExtd_GM "class instance packet 1 variant 2 / base angle warm extended" MAP 0x80564284 RB_MapGroup_U8 191.3 kw_q0p75_o240 240.0 431.3 FORMAT "%5.1"
 /begin AXIS_DESCR COM_AXIS Epm_nEng EngN 12 0.00 16383.50 FORMAT "%8.2" EXTENDED_LIMITS -16384.00 16383.50 AXIS_PTS_REF InjSys_nEng12_AX /end AXIS_DESCR
 /begin AXIS_DESCR COM_AXIS InjSys_ratAirMAxisInp rel_uw_q0p0234 12 0.00 1535.977 FORMAT "%8.3" AXIS_PTS_REF InjSys_ratAirM12_AX /end AXIS_DESCR
/end CHARACTERISTIC
/begin CHARACTERISTIC InjSys_P1V2I1_HO.agBgnWrmSmlVlvEthnl_GM "class instance packet 1 variant 2 / ." MAP 0x80564314 RB_MapGroup_U8 191.3 kw_q0p75_o240 240.0 431.3 FORMAT "%5.1"
 /begin AXIS_DESCR COM_AXIS Epm_nEng EngN 12 0.00 16383.50 FORMAT "%8.2" EXTENDED_LIMITS -16384.00 16383.50 AXIS_PTS_REF InjSys_nEng12_AX /end AXIS_DESCR
 /begin AXIS_DESCR COM_AXIS InjSys_ratAirMAxisInp rel_uw_q0p0234 12 0.00 1535.977 FORMAT "%8.3" AXIS_PTS_REF InjSys_ratAirM12_AX /end AXIS_DESCR
/end CHARACTERISTIC
/begin CHARACTERISTIC InjSys_P1V2I1_HO.agBgnWrmSmlVlv_GM "class instance packet 1 variant 2 / ." MAP 0x805643A4 RB_MapGroup_U8 191.3 kw_q0p75_o240 240.0 431.3 FORMAT "%5.1"
 /begin AXIS_DESCR COM_AXIS Epm_nEng EngN 12 0.00 16383.50 FORMAT "%8.2" EXTENDED_LIMITS -16384.00 16383.50 AXIS_PTS_REF InjSys_nEng12_AX /end AXIS_DESCR
 /begin AXIS_DESCR COM_AXIS InjSys_ratAirMAxisInp rel_uw_q0p0234 12 0.00 1535.977 FORMAT "%8.3" AXIS_PTS_REF InjSys_ratAirM12_AX /end AXIS_DESCR
/end CHARACTERISTIC
/begin CHARACTERISTIC InjSys_P1V2I1_HO.agDeltaEth_M "class instance packet 1 variant 2 / delta angle ethanol dependent" MAP 0x80564434 RB_Map_S16S16_S16 191.2500 kw_q0p75 -96.00000 95.25000 FORMAT "%8.5" EXTENDED_LIMITS -24576.00 24575.25
 /begin AXIS_DESCR STD_AXIS InjSys_facEthLnrLocSp fak_ub_b2 4 0.00 1.992188 FORMAT "%8.6" EXTENDED_LIMITS -256.0000 255.9922 DEPOSIT ABSOLUTE /end AXIS_DESCR
 /begin AXIS_DESCR STD_AXIS InjSys_tEng Temp_Cels 4 -3549.940 3003.560 FORMAT "%8.3" DEPOSIT ABSOLUTE /end AXIS_DESCR
/end CHARACTERISTIC
/begin CHARACTERISTIC InjSys_P1V2I1_HO.agDeltaLamBasCold_M "class instance packet 1 variant 2 / cold angle base lambda dependent and engine temperature dependent" MAP 0x80564468 RB_Map_S16U16_S16 191.2500 kw_q0p75 -96.00000 95.25000 FORMAT "%8.5" EXTENDED_LIMITS -24576.00 24575.25
 /begin AXIS_DESCR STD_AXIS Epm_nEng EngN 8 -16384.00 16383.50 FORMAT "%8.2" DEPOSIT ABSOLUTE /end AXIS_DESCR
 /begin AXIS_DESCR STD_AXIS InjSys_ratAirMPredLocSp rel_uw_q0p0234 6 0.00 1535.977 FORMAT "%8.3" DEPOSIT ABSOLUTE /end AXIS_DESCR
/end CHARACTERISTIC
/begin CHARACTERISTIC InjSys_P1V2I1_HO.agDeltaLamBasWrm_M "class instance packet 1 variant 2 / warm angle base lambda dependent and engine temperature dependent" MAP 0x805644E8 RB_Map_S16U16_S16 191.2500 kw_q0p75 -96.00000 95.25000 FORMAT "%8.5" EXTENDED_LIMITS -24576.00 24575.25
 /begin AXIS_DESCR STD_AXIS Epm_nEng EngN 8 -16384.00 16383.50 FORMAT "%8.2" DEPOSIT ABSOLUTE /end AXIS_DESCR
 /begin AXIS_DESCR STD_AXIS InjSys_ratAirMPredLocSp rel_uw_q0p0234 6 0.00 1535.977 FORMAT "%8.3" DEPOSIT ABSOLUTE /end AXIS_DESCR
/end CHARACTERISTIC
/begin CHARACTERISTIC InjSys_P1V2I1_HO.agDeltaLam_M "class instance packet 1 variant 2 / ." MAP 0x80564568 RB_Map_S16U16_S16 191.2500 kw_q0p75 -96.00000 95.25000 FORMAT "%8.5" EXTENDED_LIMITS -24576.00 24575.25
 /begin AXIS_DESCR STD_AXIS Epm_nEng EngN 10 -16384.00 16383.50 FORMAT "%8.2" DEPOSIT ABSOLUTE /end AXIS_DESCR
 /begin AXIS_DESCR STD_AXIS InjSys_ratAirMPredLocSp rel_uw_q0p0234 8 0.00 1535.977 FORMAT "%8.3" DEPOSIT ABSOLUTE /end AXIS_DESCR
/end CHARACTERISTIC
/begin CHARACTERISTIC InjSys_P1V2I1_HO.agDeltaTEngOilVers2_GM "class instance packet 1 variant 2 / delta angle engine- and oil- temperature dependent" MAP 0x80564630 RB_MapGroup_S8 191.3 kw_q0p75 -96.00 95.25 FORMAT "%5.2"
 /begin AXIS_DESCR COM_AXIS Epm_nEng EngN 12 0.00 16383.50 FORMAT "%8.2" EXTENDED_LIMITS -16384.00 16383.50 AXIS_PTS_REF InjSys_nEng12Vers2_AX /end AXIS_DESCR
 /begin AXIS_DESCR COM_AXIS InjSys_ratAirMAgSpVers2AxisInp rel_uw_q0p0234 12 0.00 1535.977 FORMAT "%8.3" AXIS_PTS_REF InjSys_ratAirM12AgSpVers2_AX /end AXIS_DESCR
/end CHARACTERISTIC
/begin CHARACTERISTIC InjSys_P1V2I1_HO.agDeltaTEngOil_GM "class instance packet 1 variant 2 / delta angle engine- and oil- temperature dependent" MAP 0x805646C0 RB_MapGroup_S8 191.3 kw_q0p75 -96.00 95.25 FORMAT "%5.2"
 /begin AXIS_DESCR COM_AXIS Epm_nEng EngN 12 0.00 16383.50 FORMAT "%8.2" EXTENDED_LIMITS -16384.00 16383.50 AXIS_PTS_REF InjSys_nEng12_AX /end AXIS_DESCR
 /begin AXIS_DESCR COM_AXIS InjSys_ratAirMAgSpAxisInp rel_uw_q0p0234 12 0.00 1535.977 FORMAT "%8.3" AXIS_PTS_REF InjSys_ratAirM12AgSp_AX /end AXIS_DESCR
/end CHARACTERISTIC
/begin CHARACTERISTIC InjSys_P1V2I1_HO.facAgBgnLam_T "class instance packet 1 variant 2 / ." CURVE 0x80564750 RB_Curve_U8_U8 0.9961 fak_ub_b1 0.00 0.9961
 /begin AXIS_DESCR STD_AXIS InjSys_facLamBasLocSp fak_ub_b2 8 0.00 1.992188 FORMAT "%8.6" DEPOSIT ABSOLUTE /end AXIS_DESCR
/end CHARACTERISTIC
/begin CHARACTERISTIC InjSys_P1V2I1_HO.facEthnlAgBgn_T "class instance packet 1 variant 2 / ." CURVE 0x80564761 RB_Curve_U8_U8 0.9961 fak_ub_b1 0.00 0.9961
 /begin AXIS_DESCR STD_AXIS fethstoeLocSp fak_ub_b2 4 0.00 1.992188 FORMAT "%8.6" DEPOSIT ABSOLUTE /end AXIS_DESCR
/end CHARACTERISTIC
/begin CHARACTERISTIC InjSys_P1V2I1_HO.facSpltAux1Extd_GM "class instance packet 1 variant 2 / split factor auxiliary injection 1" MAP 0x8056476A RB_MapGroup_U8 0.9961 fak_ub_b1 0.00 0.9961
 /begin AXIS_DESCR COM_AXIS Epm_nEng EngN 12 0.00 16383.50 FORMAT "%8.2" EXTENDED_LIMITS -16384.00 16383.50 AXIS_PTS_REF InjSys_nEng12Vers2_AX /end AXIS_DESCR
 /begin AXIS_DESCR COM_AXIS InjSys_ratAirMVers2AxisInp rel_uw_q0p0234 12 0.00 1535.977 FORMAT "%8.3" AXIS_PTS_REF InjSys_ratAirM12Vers2_AX /end AXIS_DESCR
/end CHARACTERISTIC
/begin CHARACTERISTIC InjSys_P1V2I1_HO.facSpltAux1_GM "class instance packet 1 variant 2 / split factor auxiliary injection 1" MAP 0x805647FA RB_MapGroup_U8 0.9961 fak_ub_b1 0.00 0.9961
 /begin AXIS_DESCR COM_AXIS Epm_nEng EngN 10 0.00 16383.50 FORMAT "%8.2" EXTENDED_LIMITS -16384.00 16383.50 AXIS_PTS_REF InjSys_nEng10_AX /end AXIS_DESCR
 /begin AXIS_DESCR COM_AXIS InjSys_ratAirMAxisInp rel_uw_q0p0234 8 0.00 1535.977 FORMAT "%8.3" AXIS_PTS_REF InjSys_ratAirM08_AX /end AXIS_DESCR
/end CHARACTERISTIC
/begin CHARACTERISTIC InjSys_P1V2I1_HO.facTPistCold_M "class instance packet 1 variant 2 / delta angle ethanol dependent" MAP 0x8056484A RB_Map_S16S16_U8 0.9961 fak_ub_b1 0.00 0.9961
 /begin AXIS_DESCR STD_AXIS InjSys_tEng Temp_Cels 8 -3549.940 3003.560 FORMAT "%8.3" DEPOSIT ABSOLUTE /end AXIS_DESCR
 /begin AXIS_DESCR STD_AXIS InjSys_tOilLocSp Temp_Cels 8 -3549.940 3003.560 FORMAT "%8.3" DEPOSIT ABSOLUTE /end AXIS_DESCR
/end CHARACTERISTIC
/begin CHARACTERISTIC InjSys_P1V2I1_HO.facTPist_M "class instance packet 1 variant 2 / factor piston temperature" MAP 0x805648AE RB_Map_S16S16_U8 0.9961 fak_ub_b1 0.00 0.9961
 /begin AXIS_DESCR STD_AXIS InjSys_tPistBas Temp_Cels 6 -3549.940 3003.560 FORMAT "%8.3" DEPOSIT ABSOLUTE /end AXIS_DESCR
 /begin AXIS_DESCR STD_AXIS InjSys_tPistDelta temp_q0p1 6 -3276.800 3276.700 FORMAT "%8.3" DEPOSIT ABSOLUTE /end AXIS_DESCR
/end CHARACTERISTIC
/begin CHARACTERISTIC InjSys_P1V2I1_HO.facWghtAgDeltaLamBasCold_T "class instance packet 1 variant 2 / weighting factor cold delta angle engine and oil temperature dependent" CURVE 0x805648EE RB_Curve_U8_U8 0.9961 fak_ub_b1 0.00 0.9961
 /begin AXIS_DESCR STD_AXIS InjSys_facLamBasLocSp fak_ub_b2 3 0.00 1.992188 FORMAT "%8.6" DEPOSIT ABSOLUTE /end AXIS_DESCR
/end CHARACTERISTIC
/begin CHARACTERISTIC InjSys_P1V2I1_HO.facWghtAgDeltaLamBasWrm_T "class instance packet 1 variant 2 / weighting factor warm delta angle engine and oil temperature dependent" CURVE 0x805648F5 RB_Curve_U8_U8 0.9961 fak_ub_b1 0.00 0.9961
 /begin AXIS_DESCR STD_AXIS InjSys_facLamBasLocSp fak_ub_b2 3 0.00 1.992188 FORMAT "%8.6" DEPOSIT ABSOLUTE /end AXIS_DESCR
/end CHARACTERISTIC
/begin CHARACTERISTIC InjSys_P1V2I1_HO.facWghtColdWrmEthnl_M "class instance packet 1 variant 2 / ." MAP 0x805648FC RB_Map_S16S16_U8 0.9961 fak_ub_b1 0.00 0.9961
 /begin AXIS_DESCR STD_AXIS InjSys_tEng Temp_Cels 6 -3549.940 3003.560 FORMAT "%8.3" DEPOSIT ABSOLUTE /end AXIS_DESCR
 /begin AXIS_DESCR STD_AXIS InjSys_tOilLocSp Temp_Cels 4 -3549.940 3003.560 FORMAT "%8.3" DEPOSIT ABSOLUTE /end AXIS_DESCR
/end CHARACTERISTIC
/begin CHARACTERISTIC InjSys_P1V2I1_HO.facWghtColdWrm_M "class instance packet 1 variant 2 / ." MAP 0x8056492C RB_Map_S16S16_U8 0.9961 fak_ub_b1 0.00 0.9961
 /begin AXIS_DESCR STD_AXIS InjSys_tEng Temp_Cels 6 -3549.940 3003.560 FORMAT "%8.3" DEPOSIT ABSOLUTE /end AXIS_DESCR
 /begin AXIS_DESCR STD_AXIS InjSys_tOilLocSp Temp_Cels 4 -3549.940 3003.560 FORMAT "%8.3" DEPOSIT ABSOLUTE /end AXIS_DESCR
/end CHARACTERISTIC
/begin CHARACTERISTIC InjSys_P1V2I1_HO.facWghtWrmCold_M "class instance packet 1 variant 2 / weighting factor warm-cold delta angle engine- and oil- temperature dependent" MAP 0x8056495C RB_Map_S16S16_U8 0.9961 fak_ub_b1 0.00 0.9961
 /begin AXIS_DESCR STD_AXIS InjSys_tEng Temp_Cels 6 -3549.940 3003.560 FORMAT "%8.3" DEPOSIT ABSOLUTE /end AXIS_DESCR
 /begin AXIS_DESCR STD_AXIS InjSys_tOilLocSp Temp_Cels 4 -3549.940 3003.560 FORMAT "%8.3" DEPOSIT ABSOLUTE /end AXIS_DESCR
/end CHARACTERISTIC
/begin CHARACTERISTIC InjSys_P1V2I1_HO.flgAbsltSplt_C "class instance packet 1 variant 2 / condition split with absolute fuel mass" VALUE 0x8056498C RB_Val_Wu8 1.00000000000 B_TRUE 0.00 1.00000000000 FORMAT "%13.11" /end CHARACTERISTIC
/begin CHARACTERISTIC InjSys_P1V2I1_HO.flgAxVers_C "class instance packet 1 variant 2 / condition map selection with group axis in version 2" VALUE 0x8056498D RB_Val_Wu8 1.00000000000 B_TRUE 0.00 1.00000000000 FORMAT "%13.11" /end CHARACTERISTIC
/begin CHARACTERISTIC InjSys_P1V2I1_HO.flgPltInj_C "class instance packet 1 variant 2 / condition pilot injection" VALUE 0x8056498E RB_Val_Wu8 1.00000000000 B_TRUE 0.00 1.00000000000 FORMAT "%13.11" /end CHARACTERISTIC
/begin CHARACTERISTIC InjSys_P1V2I1_HO.ratFuMAux1_GM "class instance packet 1 variant 2 / relative fuel mass auxiliary injection 1" MAP 0x80564990 RB_MapGroup_U16 3071.953 rel_uw_b3072 0.00 3071.953 FORMAT "%8.3"
 /begin AXIS_DESCR COM_AXIS Epm_nEng EngN 10 0.00 16383.50 FORMAT "%8.2" EXTENDED_LIMITS -16384.00 16383.50 AXIS_PTS_REF InjSys_nEng10_AX /end AXIS_DESCR
 /begin AXIS_DESCR COM_AXIS InjSys_ratAirMAxisInp rel_uw_q0p0234 8 0.00 1535.977 FORMAT "%8.3" AXIS_PTS_REF InjSys_ratAirM08_AX /end AXIS_DESCR
/end CHARACTERISTIC
/begin CHARACTERISTIC InjSys_P1V2I1_HO.ratFuMBasExtd_GM "class instance packet 1 variant 2 / relative fuel mass base injection" MAP 0x80564A30 RB_MapGroup_U16 3071.953 rel_uw_b3072 0.00 3071.953 FORMAT "%8.3"
 /begin AXIS_DESCR COM_AXIS Epm_nEng EngN 12 0.00 16383.50 FORMAT "%8.2" EXTENDED_LIMITS -16384.00 16383.50 AXIS_PTS_REF InjSys_nEng12Vers2_AX /end AXIS_DESCR
 /begin AXIS_DESCR COM_AXIS InjSys_ratAirMVers2AxisInp rel_uw_q0p0234 12 0.00 1535.977 FORMAT "%8.3" AXIS_PTS_REF InjSys_ratAirM12Vers2_AX /end AXIS_DESCR
/end CHARACTERISTIC
/begin CHARACTERISTIC InjSys_P1V2I1_HO.ratFuMBas_GM "class instance packet 1 variant 2 / relative fuel mass base injection" MAP 0x80564B50 RB_MapGroup_U16 3071.953 rel_uw_b3072 0.00 3071.953 FORMAT "%8.3"
 /begin AXIS_DESCR COM_AXIS Epm_nEng EngN 10 0.00 16383.50 FORMAT "%8.2" EXTENDED_LIMITS -16384.00 16383.50 AXIS_PTS_REF InjSys_nEng10_AX /end AXIS_DESCR
 /begin AXIS_DESCR COM_AXIS InjSys_ratAirMAxisInp rel_uw_q0p0234 8 0.00 1535.977 FORMAT "%8.3" AXIS_PTS_REF InjSys_ratAirM08_AX /end AXIS_DESCR
/end CHARACTERISTIC
/begin CHARACTERISTIC InjSys_P1V2I1_HO.stDiTiBreakAux_C "class instance packet 1 variant 2 / state disabling break time for auxiliary injection" VALUE 0x80564BF0 RB_Val_Wu8 255.0 dez 0.00 255.0 FORMAT "%5.1" /end CHARACTERISTIC
/begin CHARACTERISTIC InjSys_P1V2I1_HO.tiBreakAux1_M "class instance packet 1 variant 2 / pause time auxiliary injection 1" MAP 0x80564BF2 RB_Map_S16U16_S16 1310.680 t_q0p04_ms 0.00 1310.680 FORMAT "%8.3" EXTENDED_LIMITS -1310.720 1310.680
 /begin AXIS_DESCR STD_AXIS Epm_nEng EngN 8 -16384.00 16383.50 FORMAT "%8.2" DEPOSIT ABSOLUTE /end AXIS_DESCR
 /begin AXIS_DESCR STD_AXIS InjSys_ratAirMPredLocSp rel_uw_q0p0234 8 0.00 1535.977 FORMAT "%8.3" DEPOSIT ABSOLUTE /end AXIS_DESCR
/end CHARACTERISTIC
/begin CHARACTERISTIC InjSys_P1V2I2_HO.agBasTPistColdVers2_GM "injection packet 1 in variant 2 / base angle at cold piston temperature (version 2)" MAP 0x8055A538 RB_MapGroup_U8 382.5 kw_q1p5 0.00 382.5 FORMAT "%5.1"
 /begin AXIS_DESCR COM_AXIS Epm_nEng EngN 12 0.00 16383.50 FORMAT "%8.2" EXTENDED_LIMITS -16384.00 16383.50 AXIS_PTS_REF InjSys_nEng12Vers2_AX /end AXIS_DESCR
 /begin AXIS_DESCR COM_AXIS InjSys_ratAirMAgSpVers2AxisInp rel_uw_q0p0234 12 0.00 1535.977 FORMAT "%8.3" AXIS_PTS_REF InjSys_ratAirM12AgSpVers2_AX /end AXIS_DESCR
/end CHARACTERISTIC
/begin CHARACTERISTIC InjSys_P1V2I2_HO.agBasTPistCold_GM "injection packet 1 in variant 2 / base angle at cold piston temperature" MAP 0x8055A5C8 RB_MapGroup_U8 382.5 kw_q1p5 0.00 382.5 FORMAT "%5.1"
 /begin AXIS_DESCR COM_AXIS Epm_nEng EngN 12 0.00 16383.50 FORMAT "%8.2" EXTENDED_LIMITS -16384.00 16383.50 AXIS_PTS_REF InjSys_nEng12_AX /end AXIS_DESCR
 /begin AXIS_DESCR COM_AXIS InjSys_ratAirMAgSpAxisInp rel_uw_q0p0234 12 0.00 1535.977 FORMAT "%8.3" AXIS_PTS_REF InjSys_ratAirM12AgSp_AX /end AXIS_DESCR
/end CHARACTERISTIC
/begin CHARACTERISTIC InjSys_P1V2I2_HO.agBasTPistWrmVers2_GM "injection packet 1 in variant 2 / base angle for interpolation Warm TSA mode (Version 2)" MAP 0x8055A658 RB_MapGroup_U8 382.5 kw_q1p5 0.00 382.5 FORMAT "%5.1"
 /begin AXIS_DESCR COM_AXIS Epm_nEng EngN 12 0.00 16383.50 FORMAT "%8.2" EXTENDED_LIMITS -16384.00 16383.50 AXIS_PTS_REF InjSys_nEng12Vers2_AX /end AXIS_DESCR
 /begin AXIS_DESCR COM_AXIS InjSys_ratAirMAgSpVers2AxisInp rel_uw_q0p0234 12 0.00 1535.977 FORMAT "%8.3" AXIS_PTS_REF InjSys_ratAirM12AgSpVers2_AX /end AXIS_DESCR
/end CHARACTERISTIC
/begin CHARACTERISTIC InjSys_P1V2I2_HO.agBasTPistWrm_GM "injection packet 1 in variant 2 / base angle for interpolation Warm TSA mode" MAP 0x8055A6E8 RB_MapGroup_U8 382.5 kw_q1p5 0.00 382.5 FORMAT "%5.1"
 /begin AXIS_DESCR COM_AXIS Epm_nEng EngN 12 0.00 16383.50 FORMAT "%8.2" EXTENDED_LIMITS -16384.00 16383.50 AXIS_PTS_REF InjSys_nEng12_AX /end AXIS_DESCR
 /begin AXIS_DESCR COM_AXIS InjSys_ratAirMAgSpAxisInp rel_uw_q0p0234 12 0.00 1535.977 FORMAT "%8.3" AXIS_PTS_REF InjSys_ratAirM12AgSp_AX /end AXIS_DESCR
/end CHARACTERISTIC
/begin CHARACTERISTIC InjSys_P1V2I2_HO.agBgnColdExtdEthnl_GM "injection packet 1 in variant 2 / base angle when charge motion greater threshold" MAP 0x8055A778 RB_MapGroup_U8 191.3 kw_q0p75_o240 240.0 431.3 FORMAT "%5.1"
 /begin AXIS_DESCR COM_AXIS Epm_nEng EngN 12 0.00 16383.50 FORMAT "%8.2" EXTENDED_LIMITS -16384.00 16383.50 AXIS_PTS_REF InjSys_nEng12_AX /end AXIS_DESCR
 /begin AXIS_DESCR COM_AXIS InjSys_ratAirMAxisInp rel_uw_q0p0234 12 0.00 1535.977 FORMAT "%8.3" AXIS_PTS_REF InjSys_ratAirM12_AX /end AXIS_DESCR
/end CHARACTERISTIC
/begin CHARACTERISTIC InjSys_P1V2I2_HO.agBgnColdExtd_GM "injection packet 1 in variant 2 / base angle cold extended" MAP 0x8055A808 RB_MapGroup_U8 191.3 kw_q0p75_o240 240.0 431.3 FORMAT "%5.1"
 /begin AXIS_DESCR COM_AXIS Epm_nEng EngN 12 0.00 16383.50 FORMAT "%8.2" EXTENDED_LIMITS -16384.00 16383.50 AXIS_PTS_REF InjSys_nEng12_AX /end AXIS_DESCR
 /begin AXIS_DESCR COM_AXIS InjSys_ratAirMAxisInp rel_uw_q0p0234 12 0.00 1535.977 FORMAT "%8.3" AXIS_PTS_REF InjSys_ratAirM12_AX /end AXIS_DESCR
/end CHARACTERISTIC
/begin CHARACTERISTIC InjSys_P1V2I2_HO.agBgnColdSmlVlvEthnl_GM "injection packet 1 in variant 2 / base angle cold small valve ethanol dependent" MAP 0x8055A898 RB_MapGroup_U8 191.3 kw_q0p75_o240 240.0 431.3 FORMAT "%5.1"
 /begin AXIS_DESCR COM_AXIS Epm_nEng EngN 12 0.00 16383.50 FORMAT "%8.2" EXTENDED_LIMITS -16384.00 16383.50 AXIS_PTS_REF InjSys_nEng12_AX /end AXIS_DESCR
 /begin AXIS_DESCR COM_AXIS InjSys_ratAirMAxisInp rel_uw_q0p0234 12 0.00 1535.977 FORMAT "%8.3" AXIS_PTS_REF InjSys_ratAirM12_AX /end AXIS_DESCR
/end CHARACTERISTIC
/begin CHARACTERISTIC InjSys_P1V2I2_HO.agBgnColdSmlVlv_GM "injection packet 1 in variant 2 / base angle cold small valve" MAP 0x8055A928 RB_MapGroup_U8 191.3 kw_q0p75_o240 240.0 431.3 FORMAT "%5.1"
 /begin AXIS_DESCR COM_AXIS Epm_nEng EngN 12 0.00 16383.50 FORMAT "%8.2" EXTENDED_LIMITS -16384.00 16383.50 AXIS_PTS_REF InjSys_nEng12_AX /end AXIS_DESCR
 /begin AXIS_DESCR COM_AXIS InjSys_ratAirMAxisInp rel_uw_q0p0234 12 0.00 1535.977 FORMAT "%8.3" AXIS_PTS_REF InjSys_ratAirM12_AX /end AXIS_DESCR
/end CHARACTERISTIC
/begin CHARACTERISTIC InjSys_P1V2I2_HO.agBgnWrmExtdEthnl_GM "injection packet 1 in variant 2 / base angle warm extended ethanol dependent" MAP 0x8055A9B8 RB_MapGroup_U8 191.3 kw_q0p75_o240 240.0 431.3 FORMAT "%5.1"
 /begin AXIS_DESCR COM_AXIS Epm_nEng EngN 12 0.00 16383.50 FORMAT "%8.2" EXTENDED_LIMITS -16384.00 16383.50 AXIS_PTS_REF InjSys_nEng12_AX /end AXIS_DESCR
 /begin AXIS_DESCR COM_AXIS InjSys_ratAirMAxisInp rel_uw_q0p0234 12 0.00 1535.977 FORMAT "%8.3" AXIS_PTS_REF InjSys_ratAirM12_AX /end AXIS_DESCR
/end CHARACTERISTIC
/begin CHARACTERISTIC InjSys_P1V2I2_HO.agBgnWrmExtd_GM "injection packet 1 in variant 2 / base angle warm extended" MAP 0x8055AA48 RB_MapGroup_U8 191.3 kw_q0p75_o240 240.0 431.3 FORMAT "%5.1"
 /begin AXIS_DESCR COM_AXIS Epm_nEng EngN 12 0.00 16383.50 FORMAT "%8.2" EXTENDED_LIMITS -16384.00 16383.50 AXIS_PTS_REF InjSys_nEng12_AX /end AXIS_DESCR
 /begin AXIS_DESCR COM_AXIS InjSys_ratAirMAxisInp rel_uw_q0p0234 12 0.00 1535.977 FORMAT "%8.3" AXIS_PTS_REF InjSys_ratAirM12_AX /end AXIS_DESCR
/end CHARACTERISTIC
/begin CHARACTERISTIC InjSys_P1V2I2_HO.agBgnWrmSmlVlvEthnl_GM "injection packet 1 in variant 2 / ." MAP 0x8055AAD8 RB_MapGroup_U8 191.3 kw_q0p75_o240 240.0 431.3 FORMAT "%5.1"
 /begin AXIS_DESCR COM_AXIS Epm_nEng EngN 12 0.00 16383.50 FORMAT "%8.2" EXTENDED_LIMITS -16384.00 16383.50 AXIS_PTS_REF InjSys_nEng12_AX /end AXIS_DESCR
 /begin AXIS_DESCR COM_AXIS InjSys_ratAirMAxisInp rel_uw_q0p0234 12 0.00 1535.977 FORMAT "%8.3" AXIS_PTS_REF InjSys_ratAirM12_AX /end AXIS_DESCR
/end CHARACTERISTIC
/begin CHARACTERISTIC InjSys_P1V2I2_HO.agBgnWrmSmlVlv_GM "injection packet 1 in variant 2 / ." MAP 0x8055AB68 RB_MapGroup_U8 191.3 kw_q0p75_o240 240.0 431.3 FORMAT "%5.1"
 /begin AXIS_DESCR COM_AXIS Epm_nEng EngN 12 0.00 16383.50 FORMAT "%8.2" EXTENDED_LIMITS -16384.00 16383.50 AXIS_PTS_REF InjSys_nEng12_AX /end AXIS_DESCR
 /begin AXIS_DESCR COM_AXIS InjSys_ratAirMAxisInp rel_uw_q0p0234 12 0.00 1535.977 FORMAT "%8.3" AXIS_PTS_REF InjSys_ratAirM12_AX /end AXIS_DESCR
/end CHARACTERISTIC
/begin CHARACTERISTIC InjSys_P1V2I2_HO.agDeltaEth_M "injection packet 1 in variant 2 / delta angle ethanol dependent" MAP 0x8055ABF8 RB_Map_S16S16_S16 191.2500 kw_q0p75 -96.00000 95.25000 FORMAT "%8.5" EXTENDED_LIMITS -24576.00 24575.25
 /begin AXIS_DESCR STD_AXIS InjSys_facEthLnrLocSp fak_ub_b2 4 0.00 1.992188 FORMAT "%8.6" EXTENDED_LIMITS -256.0000 255.9922 DEPOSIT ABSOLUTE /end AXIS_DESCR
 /begin AXIS_DESCR STD_AXIS InjSys_tEng Temp_Cels 4 -3549.940 3003.560 FORMAT "%8.3" DEPOSIT ABSOLUTE /end AXIS_DESCR
/end CHARACTERISTIC
/begin CHARACTERISTIC InjSys_P1V2I2_HO.agDeltaLamBasCold_M "injection packet 1 in variant 2 / cold angle base lambda dependent and engine temperature dependent" MAP 0x8055AC2C RB_Map_S16U16_S16 191.2500 kw_q0p75 -96.00000 95.25000 FORMAT "%8.5" EXTENDED_LIMITS -24576.00 24575.25
 /begin AXIS_DESCR STD_AXIS Epm_nEng EngN 8 -16384.00 16383.50 FORMAT "%8.2" DEPOSIT ABSOLUTE /end AXIS_DESCR
 /begin AXIS_DESCR STD_AXIS InjSys_ratAirMPredLocSp rel_uw_q0p0234 6 0.00 1535.977 FORMAT "%8.3" DEPOSIT ABSOLUTE /end AXIS_DESCR
/end CHARACTERISTIC
/begin CHARACTERISTIC InjSys_P1V2I2_HO.agDeltaLamBasWrm_M "injection packet 1 in variant 2 / warm angle base lambda dependent and engine temperature dependent" MAP 0x8055ACAC RB_Map_S16U16_S16 191.2500 kw_q0p75 -96.00000 95.25000 FORMAT "%8.5" EXTENDED_LIMITS -24576.00 24575.25
 /begin AXIS_DESCR STD_AXIS Epm_nEng EngN 8 -16384.00 16383.50 FORMAT "%8.2" DEPOSIT ABSOLUTE /end AXIS_DESCR
 /begin AXIS_DESCR STD_AXIS InjSys_ratAirMPredLocSp rel_uw_q0p0234 6 0.00 1535.977 FORMAT "%8.3" DEPOSIT ABSOLUTE /end AXIS_DESCR
/end CHARACTERISTIC
/begin CHARACTERISTIC InjSys_P1V2I2_HO.agDeltaLam_M "injection packet 1 in variant 2 / ." MAP 0x8055AD2C RB_Map_S16U16_S16 191.2500 kw_q0p75 -96.00000 95.25000 FORMAT "%8.5" EXTENDED_LIMITS -24576.00 24575.25
 /begin AXIS_DESCR STD_AXIS Epm_nEng EngN 10 -16384.00 16383.50 FORMAT "%8.2" DEPOSIT ABSOLUTE /end AXIS_DESCR
 /begin AXIS_DESCR STD_AXIS InjSys_ratAirMPredLocSp rel_uw_q0p0234 8 0.00 1535.977 FORMAT "%8.3" DEPOSIT ABSOLUTE /end AXIS_DESCR
/end CHARACTERISTIC
/begin CHARACTERISTIC InjSys_P1V2I2_HO.agDeltaTEngOilVers2_GM "injection packet 1 in variant 2 / delta angle engine- and oil- temperature dependent" MAP 0x8055ADF4 RB_MapGroup_S8 191.3 kw_q0p75 -96.00 95.25 FORMAT "%5.2"
 /begin AXIS_DESCR COM_AXIS Epm_nEng EngN 12 0.00 16383.50 FORMAT "%8.2" EXTENDED_LIMITS -16384.00 16383.50 AXIS_PTS_REF InjSys_nEng12Vers2_AX /end AXIS_DESCR
 /begin AXIS_DESCR COM_AXIS InjSys_ratAirMAgSpVers2AxisInp rel_uw_q0p0234 12 0.00 1535.977 FORMAT "%8.3" AXIS_PTS_REF InjSys_ratAirM12AgSpVers2_AX /end AXIS_DESCR
/end CHARACTERISTIC
/begin CHARACTERISTIC InjSys_P1V2I2_HO.agDeltaTEngOil_GM "injection packet 1 in variant 2 / delta angle engine- and oil- temperature dependent" MAP 0x8055AE84 RB_MapGroup_S8 191.3 kw_q0p75 -96.00 95.25 FORMAT "%5.2"
 /begin AXIS_DESCR COM_AXIS Epm_nEng EngN 12 0.00 16383.50 FORMAT "%8.2" EXTENDED_LIMITS -16384.00 16383.50 AXIS_PTS_REF InjSys_nEng12_AX /end AXIS_DESCR
 /begin AXIS_DESCR COM_AXIS InjSys_ratAirMAgSpAxisInp rel_uw_q0p0234 12 0.00 1535.977 FORMAT "%8.3" AXIS_PTS_REF InjSys_ratAirM12AgSp_AX /end AXIS_DESCR
/end CHARACTERISTIC
/begin CHARACTERISTIC InjSys_P1V2I2_HO.facAgBgnLam_T "injection packet 1 in variant 2 / ." CURVE 0x8055AF14 RB_Curve_U8_U8 0.9961 fak_ub_b1 0.00 0.9961
 /begin AXIS_DESCR STD_AXIS InjSys_facLamBasLocSp fak_ub_b2 8 0.00 1.992188 FORMAT "%8.6" DEPOSIT ABSOLUTE /end AXIS_DESCR
/end CHARACTERISTIC
/begin CHARACTERISTIC InjSys_P1V2I2_HO.facEthnlAgBgn_T "injection packet 1 in variant 2 / ." CURVE 0x8055AF25 RB_Curve_U8_U8 0.9961 fak_ub_b1 0.00 0.9961
 /begin AXIS_DESCR STD_AXIS fethstoeLocSp fak_ub_b2 4 0.00 1.992188 FORMAT "%8.6" DEPOSIT ABSOLUTE /end AXIS_DESCR
/end CHARACTERISTIC
/begin CHARACTERISTIC InjSys_P1V2I2_HO.facSpltAux1Extd_GM "injection packet 1 in variant 2 / split factor auxiliary injection 1" MAP 0x8055AF2E RB_MapGroup_U8 0.9961 fak_ub_b1 0.00 0.9961
 /begin AXIS_DESCR COM_AXIS Epm_nEng EngN 12 0.00 16383.50 FORMAT "%8.2" EXTENDED_LIMITS -16384.00 16383.50 AXIS_PTS_REF InjSys_nEng12Vers2_AX /end AXIS_DESCR
 /begin AXIS_DESCR COM_AXIS InjSys_ratAirMVers2AxisInp rel_uw_q0p0234 12 0.00 1535.977 FORMAT "%8.3" AXIS_PTS_REF InjSys_ratAirM12Vers2_AX /end AXIS_DESCR
/end CHARACTERISTIC
/begin CHARACTERISTIC InjSys_P1V2I2_HO.facSpltAux1_GM "injection packet 1 in variant 2 / split factor auxiliary injection 1" MAP 0x8055AFBE RB_MapGroup_U8 0.9961 fak_ub_b1 0.00 0.9961
 /begin AXIS_DESCR COM_AXIS Epm_nEng EngN 10 0.00 16383.50 FORMAT "%8.2" EXTENDED_LIMITS -16384.00 16383.50 AXIS_PTS_REF InjSys_nEng10_AX /end AXIS_DESCR
 /begin AXIS_DESCR COM_AXIS InjSys_ratAirMAxisInp rel_uw_q0p0234 8 0.00 1535.977 FORMAT "%8.3" AXIS_PTS_REF InjSys_ratAirM08_AX /end AXIS_DESCR
/end CHARACTERISTIC
/begin CHARACTERISTIC InjSys_P1V2I2_HO.facTPistCold_M "injection packet 1 in variant 2 / delta angle ethanol dependent" MAP 0x8055B00E RB_Map_S16S16_U8 0.9961 fak_ub_b1 0.00 0.9961
 /begin AXIS_DESCR STD_AXIS InjSys_tEng Temp_Cels 8 -3549.940 3003.560 FORMAT "%8.3" DEPOSIT ABSOLUTE /end AXIS_DESCR
 /begin AXIS_DESCR STD_AXIS InjSys_tOilLocSp Temp_Cels 8 -3549.940 3003.560 FORMAT "%8.3" DEPOSIT ABSOLUTE /end AXIS_DESCR
/end CHARACTERISTIC
/begin CHARACTERISTIC InjSys_P1V2I2_HO.facTPist_M "injection packet 1 in variant 2 / factor piston temperature" MAP 0x8055B072 RB_Map_S16S16_U8 0.9961 fak_ub_b1 0.00 0.9961
 /begin AXIS_DESCR STD_AXIS InjSys_tPistBas Temp_Cels 6 -3549.940 3003.560 FORMAT "%8.3" DEPOSIT ABSOLUTE /end AXIS_DESCR
 /begin AXIS_DESCR STD_AXIS InjSys_tPistDelta temp_q0p1 6 -3276.800 3276.700 FORMAT "%8.3" DEPOSIT ABSOLUTE /end AXIS_DESCR
/end CHARACTERISTIC
/begin CHARACTERISTIC InjSys_P1V2I2_HO.facWghtAgDeltaLamBasCold_T "injection packet 1 in variant 2 / weighting factor cold delta angle engine and oil temperature dependent" CURVE 0x8055B0B2 RB_Curve_U8_U8 0.9961 fak_ub_b1 0.00 0.9961
 /begin AXIS_DESCR STD_AXIS InjSys_facLamBasLocSp fak_ub_b2 3 0.00 1.992188 FORMAT "%8.6" DEPOSIT ABSOLUTE /end AXIS_DESCR
/end CHARACTERISTIC
/begin CHARACTERISTIC InjSys_P1V2I2_HO.facWghtAgDeltaLamBasWrm_T "injection packet 1 in variant 2 / weighting factor warm delta angle engine and oil temperature dependent" CURVE 0x8055B0B9 RB_Curve_U8_U8 0.9961 fak_ub_b1 0.00 0.9961
 /begin AXIS_DESCR STD_AXIS InjSys_facLamBasLocSp fak_ub_b2 3 0.00 1.992188 FORMAT "%8.6" DEPOSIT ABSOLUTE /end AXIS_DESCR
/end CHARACTERISTIC
/begin CHARACTERISTIC InjSys_P1V2I2_HO.facWghtColdWrmEthnl_M "injection packet 1 in variant 2 / ." MAP 0x8055B0C0 RB_Map_S16S16_U8 0.9961 fak_ub_b1 0.00 0.9961
 /begin AXIS_DESCR STD_AXIS InjSys_tEng Temp_Cels 6 -3549.940 3003.560 FORMAT "%8.3" DEPOSIT ABSOLUTE /end AXIS_DESCR
 /begin AXIS_DESCR STD_AXIS InjSys_tOilLocSp Temp_Cels 4 -3549.940 3003.560 FORMAT "%8.3" DEPOSIT ABSOLUTE /end AXIS_DESCR
/end CHARACTERISTIC
/begin CHARACTERISTIC InjSys_P1V2I2_HO.facWghtColdWrm_M "injection packet 1 in variant 2 / ." MAP 0x8055B0F0 RB_Map_S16S16_U8 0.9961 fak_ub_b1 0.00 0.9961
 /begin AXIS_DESCR STD_AXIS InjSys_tEng Temp_Cels 6 -3549.940 3003.560 FORMAT "%8.3" DEPOSIT ABSOLUTE /end AXIS_DESCR
 /begin AXIS_DESCR STD_AXIS InjSys_tOilLocSp Temp_Cels 4 -3549.940 3003.560 FORMAT "%8.3" DEPOSIT ABSOLUTE /end AXIS_DESCR
/end CHARACTERISTIC
/begin CHARACTERISTIC InjSys_P1V2I2_HO.facWghtWrmCold_M "injection packet 1 in variant 2 / weighting factor warm-cold delta angle engine- and oil- temperature dependent" MAP 0x8055B120 RB_Map_S16S16_U8 0.9961 fak_ub_b1 0.00 0.9961
 /begin AXIS_DESCR STD_AXIS InjSys_tEng Temp_Cels 6 -3549.940 3003.560 FORMAT "%8.3" DEPOSIT ABSOLUTE /end AXIS_DESCR
 /begin AXIS_DESCR STD_AXIS InjSys_tOilLocSp Temp_Cels 4 -3549.940 3003.560 FORMAT "%8.3" DEPOSIT ABSOLUTE /end AXIS_DESCR
/end CHARACTERISTIC
/begin CHARACTERISTIC InjSys_P1V2I2_HO.flgAbsltSplt_C "injection packet 1 in variant 2 / condition split with absolute fuel mass" VALUE 0x8055B150 RB_Val_Wu8 1.00000000000 B_TRUE 0.00 1.00000000000 FORMAT "%13.11" /end CHARACTERISTIC
/begin CHARACTERISTIC InjSys_P1V2I2_HO.flgAxVers_C "injection packet 1 in variant 2 / condition map selection with group axis in version 2" VALUE 0x8055B151 RB_Val_Wu8 1.00000000000 B_TRUE 0.00 1.00000000000 FORMAT "%13.11" /end CHARACTERISTIC
/begin CHARACTERISTIC InjSys_P1V2I2_HO.flgPltInj_C "injection packet 1 in variant 2 / condition pilot injection" VALUE 0x8055B152 RB_Val_Wu8 1.00000000000 B_TRUE 0.00 1.00000000000 FORMAT "%13.11" /end CHARACTERISTIC
/begin CHARACTERISTIC InjSys_P1V2I2_HO.ratFuMAux1_GM "injection packet 1 in variant 2 / relative fuel mass auxiliary injection 1" MAP 0x8055B154 RB_MapGroup_U16 3071.953 rel_uw_b3072 0.00 3071.953 FORMAT "%8.3"
 /begin AXIS_DESCR COM_AXIS Epm_nEng EngN 10 0.00 16383.50 FORMAT "%8.2" EXTENDED_LIMITS -16384.00 16383.50 AXIS_PTS_REF InjSys_nEng10_AX /end AXIS_DESCR
 /begin AXIS_DESCR COM_AXIS InjSys_ratAirMAxisInp rel_uw_q0p0234 8 0.00 1535.977 FORMAT "%8.3" AXIS_PTS_REF InjSys_ratAirM08_AX /end AXIS_DESCR
/end CHARACTERISTIC
/begin CHARACTERISTIC InjSys_P1V2I2_HO.ratFuMBasExtd_GM "injection packet 1 in variant 2 / relative fuel mass base injection" MAP 0x8055B1F4 RB_MapGroup_U16 3071.953 rel_uw_b3072 0.00 3071.953 FORMAT "%8.3"
 /begin AXIS_DESCR COM_AXIS Epm_nEng EngN 12 0.00 16383.50 FORMAT "%8.2" EXTENDED_LIMITS -16384.00 16383.50 AXIS_PTS_REF InjSys_nEng12Vers2_AX /end AXIS_DESCR
 /begin AXIS_DESCR COM_AXIS InjSys_ratAirMVers2AxisInp rel_uw_q0p0234 12 0.00 1535.977 FORMAT "%8.3" AXIS_PTS_REF InjSys_ratAirM12Vers2_AX /end AXIS_DESCR
/end CHARACTERISTIC
/begin CHARACTERISTIC InjSys_P1V2I2_HO.ratFuMBas_GM "injection packet 1 in variant 2 / relative fuel mass base injection" MAP 0x8055B314 RB_MapGroup_U16 3071.953 rel_uw_b3072 0.00 3071.953 FORMAT "%8.3"
 /begin AXIS_DESCR COM_AXIS Epm_nEng EngN 10 0.00 16383.50 FORMAT "%8.2" EXTENDED_LIMITS -16384.00 16383.50 AXIS_PTS_REF InjSys_nEng10_AX /end AXIS_DESCR
 /begin AXIS_DESCR COM_AXIS InjSys_ratAirMAxisInp rel_uw_q0p0234 8 0.00 1535.977 FORMAT "%8.3" AXIS_PTS_REF InjSys_ratAirM08_AX /end AXIS_DESCR
/end CHARACTERISTIC
/begin CHARACTERISTIC InjSys_P1V2I2_HO.stDiTiBreakAux_C "injection packet 1 in variant 2 / state disabling break time for auxiliary injection" VALUE 0x8055B3B4 RB_Val_Wu8 255.0 dez 0.00 255.0 FORMAT "%5.1" /end CHARACTERISTIC
/begin CHARACTERISTIC InjSys_P1V2I2_HO.tiBreakAux1_M "injection packet 1 in variant 2 / pause time auxiliary injection 1" MAP 0x8055B3B6 RB_Map_S16U16_S16 1310.680 t_q0p04_ms 0.00 1310.680 FORMAT "%8.3" EXTENDED_LIMITS -1310.720 1310.680
 /begin AXIS_DESCR STD_AXIS Epm_nEng EngN 8 -16384.00 16383.50 FORMAT "%8.2" DEPOSIT ABSOLUTE /end AXIS_DESCR
 /begin AXIS_DESCR STD_AXIS InjSys_ratAirMPredLocSp rel_uw_q0p0234 8 0.00 1535.977 FORMAT "%8.3" DEPOSIT ABSOLUTE /end AXIS_DESCR
/end CHARACTERISTIC
/begin CHARACTERISTIC InjSys_P1V3I1_HO.agBasTPistColdVers2_GM "class instance packet 1 variant 3 / base angle at cold piston temperature (version 2)" MAP 0x80564C9C RB_MapGroup_U8 382.5 kw_q1p5 0.00 382.5 FORMAT "%5.1"
 /begin AXIS_DESCR COM_AXIS Epm_nEng EngN 12 0.00 16383.50 FORMAT "%8.2" EXTENDED_LIMITS -16384.00 16383.50 AXIS_PTS_REF InjSys_nEng12Vers2_AX /end AXIS_DESCR
 /begin AXIS_DESCR COM_AXIS InjSys_ratAirMAgSpVers2AxisInp rel_uw_q0p0234 12 0.00 1535.977 FORMAT "%8.3" AXIS_PTS_REF InjSys_ratAirM12AgSpVers2_AX /end AXIS_DESCR
/end CHARACTERISTIC
/begin CHARACTERISTIC InjSys_P1V3I1_HO.agBasTPistCold_GM "class instance packet 1 variant 3 / base angle at cold piston temperature" MAP 0x80564D2C RB_MapGroup_U8 382.5 kw_q1p5 0.00 382.5 FORMAT "%5.1"
 /begin AXIS_DESCR COM_AXIS Epm_nEng EngN 12 0.00 16383.50 FORMAT "%8.2" EXTENDED_LIMITS -16384.00 16383.50 AXIS_PTS_REF InjSys_nEng12_AX /end AXIS_DESCR
 /begin AXIS_DESCR COM_AXIS InjSys_ratAirMAgSpAxisInp rel_uw_q0p0234 12 0.00 1535.977 FORMAT "%8.3" AXIS_PTS_REF InjSys_ratAirM12AgSp_AX /end AXIS_DESCR
/end CHARACTERISTIC
/begin CHARACTERISTIC InjSys_P1V3I1_HO.agBasTPistWrmVers2_GM "class instance packet 1 variant 3 / base angle for interpolation Warm TSA mode (Version 2)" MAP 0x80564DBC RB_MapGroup_U8 382.5 kw_q1p5 0.00 382.5 FORMAT "%5.1"
 /begin AXIS_DESCR COM_AXIS Epm_nEng EngN 12 0.00 16383.50 FORMAT "%8.2" EXTENDED_LIMITS -16384.00 16383.50 AXIS_PTS_REF InjSys_nEng12Vers2_AX /end AXIS_DESCR
 /begin AXIS_DESCR COM_AXIS InjSys_ratAirMAgSpVers2AxisInp rel_uw_q0p0234 12 0.00 1535.977 FORMAT "%8.3" AXIS_PTS_REF InjSys_ratAirM12AgSpVers2_AX /end AXIS_DESCR
/end CHARACTERISTIC
/begin CHARACTERISTIC InjSys_P1V3I1_HO.agBasTPistWrm_GM "class instance packet 1 variant 3 / base angle for interpolation Warm TSA mode" MAP 0x80564E4C RB_MapGroup_U8 382.5 kw_q1p5 0.00 382.5 FORMAT "%5.1"
 /begin AXIS_DESCR COM_AXIS Epm_nEng EngN 12 0.00 16383.50 FORMAT "%8.2" EXTENDED_LIMITS -16384.00 16383.50 AXIS_PTS_REF InjSys_nEng12_AX /end AXIS_DESCR
 /begin AXIS_DESCR COM_AXIS InjSys_ratAirMAgSpAxisInp rel_uw_q0p0234 12 0.00 1535.977 FORMAT "%8.3" AXIS_PTS_REF InjSys_ratAirM12AgSp_AX /end AXIS_DESCR
/end CHARACTERISTIC
/begin CHARACTERISTIC InjSys_P1V3I1_HO.agBgnColdExtdEthnl_GM "class instance packet 1 variant 3 / ." MAP 0x80564EDC RB_MapGroup_U8 191.3 kw_q0p75_o240 240.0 431.3 FORMAT "%5.1"
 /begin AXIS_DESCR COM_AXIS Epm_nEng EngN 12 0.00 16383.50 FORMAT "%8.2" EXTENDED_LIMITS -16384.00 16383.50 AXIS_PTS_REF InjSys_nEng12_AX /end AXIS_DESCR
 /begin AXIS_DESCR COM_AXIS InjSys_ratAirMAxisInp rel_uw_q0p0234 12 0.00 1535.977 FORMAT "%8.3" AXIS_PTS_REF InjSys_ratAirM12_AX /end AXIS_DESCR
/end CHARACTERISTIC
/begin CHARACTERISTIC InjSys_P1V3I1_HO.agBgnColdExtd_GM "class instance packet 1 variant 3 / ." MAP 0x80564F6C RB_MapGroup_U8 191.3 kw_q0p75_o240 240.0 431.3 FORMAT "%5.1"
 /begin AXIS_DESCR COM_AXIS Epm_nEng EngN 12 0.00 16383.50 FORMAT "%8.2" EXTENDED_LIMITS -16384.00 16383.50 AXIS_PTS_REF InjSys_nEng12_AX /end AXIS_DESCR
 /begin AXIS_DESCR COM_AXIS InjSys_ratAirMAxisInp rel_uw_q0p0234 12 0.00 1535.977 FORMAT "%8.3" AXIS_PTS_REF InjSys_ratAirM12_AX /end AXIS_DESCR
/end CHARACTERISTIC
/begin CHARACTERISTIC InjSys_P1V3I1_HO.agBgnColdSmlVlvEthnl_GM "class instance packet 1 variant 3 / ." MAP 0x80564FFC RB_MapGroup_U8 191.3 kw_q0p75_o240 240.0 431.3 FORMAT "%5.1"
 /begin AXIS_DESCR COM_AXIS Epm_nEng EngN 12 0.00 16383.50 FORMAT "%8.2" EXTENDED_LIMITS -16384.00 16383.50 AXIS_PTS_REF InjSys_nEng12_AX /end AXIS_DESCR
 /begin AXIS_DESCR COM_AXIS InjSys_ratAirMAxisInp rel_uw_q0p0234 12 0.00 1535.977 FORMAT "%8.3" AXIS_PTS_REF InjSys_ratAirM12_AX /end AXIS_DESCR
/end CHARACTERISTIC
/begin CHARACTERISTIC InjSys_P1V3I1_HO.agBgnColdSmlVlv_GM "class instance packet 1 variant 3 / ." MAP 0x8056508C RB_MapGroup_U8 191.3 kw_q0p75_o240 240.0 431.3 FORMAT "%5.1"
 /begin AXIS_DESCR COM_AXIS Epm_nEng EngN 12 0.00 16383.50 FORMAT "%8.2" EXTENDED_LIMITS -16384.00 16383.50 AXIS_PTS_REF InjSys_nEng12_AX /end AXIS_DESCR
 /begin AXIS_DESCR COM_AXIS InjSys_ratAirMAxisInp rel_uw_q0p0234 12 0.00 1535.977 FORMAT "%8.3" AXIS_PTS_REF InjSys_ratAirM12_AX /end AXIS_DESCR
/end CHARACTERISTIC
/begin CHARACTERISTIC InjSys_P1V3I1_HO.agBgnWrmExtdEthnl_GM "class instance packet 1 variant 3 / ." MAP 0x8056511C RB_MapGroup_U8 191.3 kw_q0p75_o240 240.0 431.3 FORMAT "%5.1"
 /begin AXIS_DESCR COM_AXIS Epm_nEng EngN 12 0.00 16383.50 FORMAT "%8.2" EXTENDED_LIMITS -16384.00 16383.50 AXIS_PTS_REF InjSys_nEng12_AX /end AXIS_DESCR
 /begin AXIS_DESCR COM_AXIS InjSys_ratAirMAxisInp rel_uw_q0p0234 12 0.00 1535.977 FORMAT "%8.3" AXIS_PTS_REF InjSys_ratAirM12_AX /end AXIS_DESCR
/end CHARACTERISTIC
/begin CHARACTERISTIC InjSys_P1V3I1_HO.agBgnWrmExtd_GM "class instance packet 1 variant 3 / ." MAP 0x805651AC RB_MapGroup_U8 191.3 kw_q0p75_o240 240.0 431.3 FORMAT "%5.1"
 /begin AXIS_DESCR COM_AXIS Epm_nEng EngN 12 0.00 16383.50 FORMAT "%8.2" EXTENDED_LIMITS -16384.00 16383.50 AXIS_PTS_REF InjSys_nEng12_AX /end AXIS_DESCR
 /begin AXIS_DESCR COM_AXIS InjSys_ratAirMAxisInp rel_uw_q0p0234 12 0.00 1535.977 FORMAT "%8.3" AXIS_PTS_REF InjSys_ratAirM12_AX /end AXIS_DESCR
/end CHARACTERISTIC
/begin CHARACTERISTIC InjSys_P1V3I1_HO.agBgnWrmSmlVlvWEthnl_GM "class instance packet 1 variant 3 / ." MAP 0x8056523C RB_MapGroup_U8 191.3 kw_q0p75_o240 240.0 431.3 FORMAT "%5.1"
 /begin AXIS_DESCR COM_AXIS Epm_nEng EngN 12 0.00 16383.50 FORMAT "%8.2" EXTENDED_LIMITS -16384.00 16383.50 AXIS_PTS_REF InjSys_nEng12_AX /end AXIS_DESCR
 /begin AXIS_DESCR COM_AXIS InjSys_ratAirMAxisInp rel_uw_q0p0234 12 0.00 1535.977 FORMAT "%8.3" AXIS_PTS_REF InjSys_ratAirM12_AX /end AXIS_DESCR
/end CHARACTERISTIC
/begin CHARACTERISTIC InjSys_P1V3I1_HO.agBgnWrmSmlVlv_GM "class instance packet 1 variant 3 / ." MAP 0x805652CC RB_MapGroup_U8 191.3 kw_q0p75_o240 240.0 431.3 FORMAT "%5.1"
 /begin AXIS_DESCR COM_AXIS Epm_nEng EngN 12 0.00 16383.50 FORMAT "%8.2" EXTENDED_LIMITS -16384.00 16383.50 AXIS_PTS_REF InjSys_nEng12_AX /end AXIS_DESCR
 /begin AXIS_DESCR COM_AXIS InjSys_ratAirMAxisInp rel_uw_q0p0234 12 0.00 1535.977 FORMAT "%8.3" AXIS_PTS_REF InjSys_ratAirM12_AX /end AXIS_DESCR
/end CHARACTERISTIC
/begin CHARACTERISTIC InjSys_P1V3I1_HO.agDeltaEth_M "class instance packet 1 variant 3 / delta angle ethanol dependent" MAP 0x8056535C RB_Map_S16S16_S16 191.2500 kw_q0p75 -96.00000 95.25000 FORMAT "%8.5" EXTENDED_LIMITS -24576.00 24575.25
 /begin AXIS_DESCR STD_AXIS InjSys_facEthLnrLocSp fak_ub_b2 4 0.00 1.992188 FORMAT "%8.6" EXTENDED_LIMITS -256.0000 255.9922 DEPOSIT ABSOLUTE /end AXIS_DESCR
 /begin AXIS_DESCR STD_AXIS InjSys_tEng Temp_Cels 4 -3549.940 3003.560 FORMAT "%8.3" DEPOSIT ABSOLUTE /end AXIS_DESCR
/end CHARACTERISTIC
/begin CHARACTERISTIC InjSys_P1V3I1_HO.agDeltaLamBasCold_M "class instance packet 1 variant 3 / cold angle base lambda dependent and engine temperature dependent" MAP 0x80565390 RB_Map_S16U16_S16 191.2500 kw_q0p75 -96.00000 95.25000 FORMAT "%8.5" EXTENDED_LIMITS -24576.00 24575.25
 /begin AXIS_DESCR STD_AXIS Epm_nEng EngN 8 -16384.00 16383.50 FORMAT "%8.2" DEPOSIT ABSOLUTE /end AXIS_DESCR
 /begin AXIS_DESCR STD_AXIS InjSys_ratAirMPredLocSp rel_uw_q0p0234 6 0.00 1535.977 FORMAT "%8.3" DEPOSIT ABSOLUTE /end AXIS_DESCR
/end CHARACTERISTIC
/begin CHARACTERISTIC InjSys_P1V3I1_HO.agDeltaLamBasWrm_M "class instance packet 1 variant 3 / warm angle base lambda dependent and engine temperature dependent" MAP 0x80565410 RB_Map_S16U16_S16 191.2500 kw_q0p75 -96.00000 95.25000 FORMAT "%8.5" EXTENDED_LIMITS -24576.00 24575.25
 /begin AXIS_DESCR STD_AXIS Epm_nEng EngN 8 -16384.00 16383.50 FORMAT "%8.2" DEPOSIT ABSOLUTE /end AXIS_DESCR
 /begin AXIS_DESCR STD_AXIS InjSys_ratAirMPredLocSp rel_uw_q0p0234 6 0.00 1535.977 FORMAT "%8.3" DEPOSIT ABSOLUTE /end AXIS_DESCR
/end CHARACTERISTIC
/begin CHARACTERISTIC InjSys_P1V3I1_HO.agDeltaLam_M "class instance packet 1 variant 3 / ." MAP 0x80565490 RB_Map_S16U16_S16 191.2500 kw_q0p75 -96.00000 95.25000 FORMAT "%8.5" EXTENDED_LIMITS -24576.00 24575.25
 /begin AXIS_DESCR STD_AXIS Epm_nEng EngN 10 -16384.00 16383.50 FORMAT "%8.2" DEPOSIT ABSOLUTE /end AXIS_DESCR
 /begin AXIS_DESCR STD_AXIS InjSys_ratAirMPredLocSp kw_q0p0234 8 0.00 1535.977 FORMAT "%8.3" DEPOSIT ABSOLUTE /end AXIS_DESCR
/end CHARACTERISTIC
/begin CHARACTERISTIC InjSys_P1V3I1_HO.agDeltaTEngOilVers2_GM "class instance packet 1 variant 3 / delta angle engine- and oil- temperature dependent" MAP 0x80565558 RB_MapGroup_S8 191.3 kw_q0p75 -96.00 95.25 FORMAT "%5.2"
 /begin AXIS_DESCR COM_AXIS Epm_nEng EngN 12 0.00 16383.50 FORMAT "%8.2" EXTENDED_LIMITS -16384.00 16383.50 AXIS_PTS_REF InjSys_nEng12Vers2_AX /end AXIS_DESCR
 /begin AXIS_DESCR COM_AXIS InjSys_ratAirMAgSpVers2AxisInp rel_uw_q0p0234 12 0.00 1535.977 FORMAT "%8.3" AXIS_PTS_REF InjSys_ratAirM12AgSpVers2_AX /end AXIS_DESCR
/end CHARACTERISTIC
/begin CHARACTERISTIC InjSys_P1V3I1_HO.agDeltaTEngOil_GM "class instance packet 1 variant 3 / delta angle engine- and oil- temperature dependent" MAP 0x805655E8 RB_MapGroup_S8 191.3 kw_q0p75 -96.00 95.25 FORMAT "%5.2"
 /begin AXIS_DESCR COM_AXIS Epm_nEng EngN 12 0.00 16383.50 FORMAT "%8.2" EXTENDED_LIMITS -16384.00 16383.50 AXIS_PTS_REF InjSys_nEng12_AX /end AXIS_DESCR
 /begin AXIS_DESCR COM_AXIS InjSys_ratAirMAgSpAxisInp rel_uw_q0p0234 12 0.00 1535.977 FORMAT "%8.3" AXIS_PTS_REF InjSys_ratAirM12AgSp_AX /end AXIS_DESCR
/end CHARACTERISTIC
/begin CHARACTERISTIC InjSys_P1V3I1_HO.facAgBgnLam_T "class instance packet 1 variant 3 / ." CURVE 0x80565678 RB_Curve_U8_U8 0.9961 fak_ub_b1 0.00 0.9961
 /begin AXIS_DESCR STD_AXIS InjSys_facLamBasLocSp fak_ub_b2 8 0.00 1.992188 FORMAT "%8.6" DEPOSIT ABSOLUTE /end AXIS_DESCR
/end CHARACTERISTIC
/begin CHARACTERISTIC InjSys_P1V3I1_HO.facEthnlAgBgn_T "class instance packet 1 variant 3 / ." CURVE 0x80565689 RB_Curve_U8_U8 0.9961 fak_ub_b1 0.00 0.9961
 /begin AXIS_DESCR STD_AXIS fethstoeLocSp fak_ub_b2 4 0.00 1.992188 FORMAT "%8.6" DEPOSIT ABSOLUTE /end AXIS_DESCR
/end CHARACTERISTIC
/begin CHARACTERISTIC InjSys_P1V3I1_HO.facSpltAux1Extd_GM "class instance packet 1 variant 3 / split factor auxiliary injection 1" MAP 0x80565692 RB_MapGroup_U8 0.9961 fak_ub_b1 0.00 0.9961
 /begin AXIS_DESCR COM_AXIS Epm_nEng EngN 12 0.00 16383.50 FORMAT "%8.2" EXTENDED_LIMITS -16384.00 16383.50 AXIS_PTS_REF InjSys_nEng12Vers2_AX /end AXIS_DESCR
 /begin AXIS_DESCR COM_AXIS InjSys_ratAirMVers2AxisInp rel_uw_q0p0234 12 0.00 1535.977 FORMAT "%8.3" AXIS_PTS_REF InjSys_ratAirM12Vers2_AX /end AXIS_DESCR
/end CHARACTERISTIC
/begin CHARACTERISTIC InjSys_P1V3I1_HO.facSpltAux1_GM "class instance packet 1 variant 3 / split factor auxiliary injection 1" MAP 0x80565722 RB_MapGroup_U8 0.9961 fak_ub_b1 0.00 0.9961
 /begin AXIS_DESCR COM_AXIS Epm_nEng EngN 10 0.00 16383.50 FORMAT "%8.2" EXTENDED_LIMITS -16384.00 16383.50 AXIS_PTS_REF InjSys_nEng10_AX /end AXIS_DESCR
 /begin AXIS_DESCR COM_AXIS InjSys_ratAirMAxisInp rel_uw_q0p0234 8 0.00 1535.977 FORMAT "%8.3" AXIS_PTS_REF InjSys_ratAirM08_AX /end AXIS_DESCR
/end CHARACTERISTIC
/begin CHARACTERISTIC InjSys_P1V3I1_HO.facSpltAux2Extd_GM "class instance packet 1 variant 3 / split factor auxiliary injection 2" MAP 0x80565772 RB_MapGroup_U8 0.9961 fak_ub_b1 0.00 0.9961
 /begin AXIS_DESCR COM_AXIS Epm_nEng EngN 12 0.00 16383.50 FORMAT "%8.2" EXTENDED_LIMITS -16384.00 16383.50 AXIS_PTS_REF InjSys_nEng12Vers2_AX /end AXIS_DESCR
 /begin AXIS_DESCR COM_AXIS InjSys_ratAirMVers2AxisInp rel_uw_q0p0234 12 0.00 1535.977 FORMAT "%8.3" AXIS_PTS_REF InjSys_ratAirM12Vers2_AX /end AXIS_DESCR
/end CHARACTERISTIC
/begin CHARACTERISTIC InjSys_P1V3I1_HO.facSpltAux2_GM "class instance packet 1 variant 3 / split factor auxiliary injection 2" MAP 0x80565802 RB_MapGroup_U8 0.9961 fak_ub_b1 0.00 0.9961
 /begin AXIS_DESCR COM_AXIS Epm_nEng EngN 10 0.00 16383.50 FORMAT "%8.2" EXTENDED_LIMITS -16384.00 16383.50 AXIS_PTS_REF InjSys_nEng10_AX /end AXIS_DESCR
 /begin AXIS_DESCR COM_AXIS InjSys_ratAirMAxisInp rel_uw_q0p0234 8 0.00 1535.977 FORMAT "%8.3" AXIS_PTS_REF InjSys_ratAirM08_AX /end AXIS_DESCR
/end CHARACTERISTIC
/begin CHARACTERISTIC InjSys_P1V3I1_HO.facTPistCold_M "class instance packet 1 variant 3 / delta angle ethanol dependent" MAP 0x80565852 RB_Map_S16S16_U8 0.9961 fak_ub_b1 0.00 0.9961
 /begin AXIS_DESCR STD_AXIS InjSys_tEng Temp_Cels 8 -3549.940 3003.560 FORMAT "%8.3" DEPOSIT ABSOLUTE /end AXIS_DESCR
 /begin AXIS_DESCR STD_AXIS InjSys_tOilLocSp Temp_Cels 8 -3549.940 3003.560 FORMAT "%8.3" DEPOSIT ABSOLUTE /end AXIS_DESCR
/end CHARACTERISTIC
/begin CHARACTERISTIC InjSys_P1V3I1_HO.facTPist_M "class instance packet 1 variant 3 / factor piston temperature" MAP 0x805658B6 RB_Map_S16S16_U8 0.9961 fak_ub_b1 0.00 0.9961
 /begin AXIS_DESCR STD_AXIS InjSys_tPistBas Temp_Cels 6 -3549.940 3003.560 FORMAT "%8.3" DEPOSIT ABSOLUTE /end AXIS_DESCR
 /begin AXIS_DESCR STD_AXIS InjSys_tPistDelta temp_q0p1 6 -3276.800 3276.700 FORMAT "%8.3" DEPOSIT ABSOLUTE /end AXIS_DESCR
/end CHARACTERISTIC
/begin CHARACTERISTIC InjSys_P1V3I1_HO.facWghtAgDeltaLamBasCold_T "class instance packet 1 variant 3 / weighting factor cold delta angle engine and oil temperature dependent" CURVE 0x805658F6 RB_Curve_U8_U8 0.9961 fak_ub_b1 0.00 0.9961
 /begin AXIS_DESCR STD_AXIS InjSys_facLamBasLocSp fak_ub_b2 3 0.00 1.992188 FORMAT "%8.6" DEPOSIT ABSOLUTE /end AXIS_DESCR
/end CHARACTERISTIC
/begin CHARACTERISTIC InjSys_P1V3I1_HO.facWghtAgDeltaLamBasWrm_T "class instance packet 1 variant 3 / weighting factor warm delta angle engine and oil temperature dependent" CURVE 0x805658FD RB_Curve_U8_U8 0.9961 fak_ub_b1 0.00 0.9961
 /begin AXIS_DESCR STD_AXIS InjSys_facLamBasLocSp fak_ub_b2 3 0.00 1.992188 FORMAT "%8.6" DEPOSIT ABSOLUTE /end AXIS_DESCR
/end CHARACTERISTIC
/begin CHARACTERISTIC InjSys_P1V3I1_HO.facWghtColdWrmEthnl_M "class instance packet 1 variant 3 / ." MAP 0x80565904 RB_Map_S16S16_U8 0.9961 fak_ub_b1 0.00 0.9961
 /begin AXIS_DESCR STD_AXIS InjSys_tEng Temp_Cels 6 -3549.940 3003.560 FORMAT "%8.3" DEPOSIT ABSOLUTE /end AXIS_DESCR
 /begin AXIS_DESCR STD_AXIS InjSys_tOilLocSp Temp_Cels 4 -3549.940 3003.560 FORMAT "%8.3" DEPOSIT ABSOLUTE /end AXIS_DESCR
/end CHARACTERISTIC
/begin CHARACTERISTIC InjSys_P1V3I1_HO.facWghtColdWrm_M "class instance packet 1 variant 3 / ." MAP 0x80565934 RB_Map_S16S16_U8 0.9961 fak_ub_b1 0.00 0.9961
 /begin AXIS_DESCR STD_AXIS InjSys_tEng Temp_Cels 6 -3549.940 3003.560 FORMAT "%8.3" DEPOSIT ABSOLUTE /end AXIS_DESCR
 /begin AXIS_DESCR STD_AXIS InjSys_tOilLocSp Temp_Cels 4 -3549.940 3003.560 FORMAT "%8.3" DEPOSIT ABSOLUTE /end AXIS_DESCR
/end CHARACTERISTIC
/begin CHARACTERISTIC InjSys_P1V3I1_HO.facWghtWrmCold_M "class instance packet 1 variant 3 / weighting factor warm-cold delta angle engine- and oil- temperature dependent" MAP 0x80565964 RB_Map_S16S16_U8 0.9961 fak_ub_b1 0.00 0.9961
 /begin AXIS_DESCR STD_AXIS InjSys_tEng Temp_Cels 6 -3549.940 3003.560 FORMAT "%8.3" DEPOSIT ABSOLUTE /end AXIS_DESCR
 /begin AXIS_DESCR STD_AXIS InjSys_tOilLocSp Temp_Cels 4 -3549.940 3003.560 FORMAT "%8.3" DEPOSIT ABSOLUTE /end AXIS_DESCR
/end CHARACTERISTIC
/begin CHARACTERISTIC InjSys_P1V3I1_HO.flgAbsltSplt_C "class instance packet 1 variant 3 / condition split with absolute fuel mass" VALUE 0x80565994 RB_Val_Wu8 1.00000000000 B_TRUE 0.00 1.00000000000 FORMAT "%13.11" /end CHARACTERISTIC
/begin CHARACTERISTIC InjSys_P1V3I1_HO.flgAxVers_C "class instance packet 1 variant 3 / condition map selection with group axis in version 2" VALUE 0x80565995 RB_Val_Wu8 1.00000000000 B_TRUE 0.00 1.00000000000 FORMAT "%13.11" /end CHARACTERISTIC
/begin CHARACTERISTIC InjSys_P1V3I1_HO.flgPltInj_C "class instance packet 1 variant 3 / condition pilot injection" VALUE 0x80565996 RB_Val_Wu8 1.00000000000 B_TRUE 0.00 1.00000000000 FORMAT "%13.11" /end CHARACTERISTIC
/begin CHARACTERISTIC InjSys_P1V3I1_HO.ratFuMAux1_GM "class instance packet 1 variant 3 / relative fuel mass auxiliary injection 1" MAP 0x80565998 RB_MapGroup_U16 3071.953 rel_uw_b3072 0.00 3071.953 FORMAT "%8.3"
 /begin AXIS_DESCR COM_AXIS Epm_nEng EngN 10 0.00 16383.50 FORMAT "%8.2" EXTENDED_LIMITS -16384.00 16383.50 AXIS_PTS_REF InjSys_nEng10_AX /end AXIS_DESCR
 /begin AXIS_DESCR COM_AXIS InjSys_ratAirMAxisInp rel_uw_q0p0234 8 0.00 1535.977 FORMAT "%8.3" AXIS_PTS_REF InjSys_ratAirM08_AX /end AXIS_DESCR
/end CHARACTERISTIC
/begin CHARACTERISTIC InjSys_P1V3I1_HO.ratFuMAux2_GM "class instance packet 1 variant 3 / relative fuel mass auxiliary injection 2" MAP 0x80565A38 RB_MapGroup_U16 3071.953 rel_uw_b3072 0.00 3071.953 FORMAT "%8.3"
 /begin AXIS_DESCR COM_AXIS Epm_nEng EngN 10 0.00 16383.50 FORMAT "%8.2" EXTENDED_LIMITS -16384.00 16383.50 AXIS_PTS_REF InjSys_nEng10_AX /end AXIS_DESCR
 /begin AXIS_DESCR COM_AXIS InjSys_ratAirMAxisInp rel_uw_q0p0234 8 0.00 1535.977 FORMAT "%8.3" AXIS_PTS_REF InjSys_ratAirM08_AX /end AXIS_DESCR
/end CHARACTERISTIC
/begin CHARACTERISTIC InjSys_P1V3I1_HO.ratFuMBasExtd_GM "class instance packet 1 variant 3 / relative fuel mass base injection" MAP 0x80565AD8 RB_MapGroup_U16 3071.953 rel_uw_b3072 0.00 3071.953 FORMAT "%8.3"
 /begin AXIS_DESCR COM_AXIS Epm_nEng EngN 12 0.00 16383.50 FORMAT "%8.2" EXTENDED_LIMITS -16384.00 16383.50 AXIS_PTS_REF InjSys_nEng12Vers2_AX /end AXIS_DESCR
 /begin AXIS_DESCR COM_AXIS InjSys_ratAirMVers2AxisInp rel_uw_q0p0234 12 0.00 1535.977 FORMAT "%8.3" AXIS_PTS_REF InjSys_ratAirM12Vers2_AX /end AXIS_DESCR
/end CHARACTERISTIC
/begin CHARACTERISTIC InjSys_P1V3I1_HO.ratFuMBas_GM "class instance packet 1 variant 3 / relative fuel mass base injection" MAP 0x80565BF8 RB_MapGroup_U16 3071.953 rel_uw_b3072 0.00 3071.953 FORMAT "%8.3"
 /begin AXIS_DESCR COM_AXIS Epm_nEng EngN 10 0.00 16383.50 FORMAT "%8.2" EXTENDED_LIMITS -16384.00 16383.50 AXIS_PTS_REF InjSys_nEng10_AX /end AXIS_DESCR
 /begin AXIS_DESCR COM_AXIS InjSys_ratAirMAxisInp rel_uw_q0p0234 8 0.00 1535.977 FORMAT "%8.3" AXIS_PTS_REF InjSys_ratAirM08_AX /end AXIS_DESCR
/end CHARACTERISTIC
/begin CHARACTERISTIC InjSys_P1V3I1_HO.stDiTiBreakAux_C "class instance packet 1 variant 3 / state disabling break time for auxiliary injection" VALUE 0x80565C98 RB_Val_Wu8 255.0 dez 0.00 255.0 FORMAT "%5.1" /end CHARACTERISTIC
/begin CHARACTERISTIC InjSys_P1V3I1_HO.tiBreakAux1_M "class instance packet 1 variant 3 / pause time auxiliary injection 1" MAP 0x80565C9A RB_Map_S16U16_S16 1310.680 t_q0p04_ms 0.00 1310.680 FORMAT "%8.3" EXTENDED_LIMITS -1310.720 1310.680
 /begin AXIS_DESCR STD_AXIS Epm_nEng EngN 8 -16384.00 16383.50 FORMAT "%8.2" DEPOSIT ABSOLUTE /end AXIS_DESCR
 /begin AXIS_DESCR STD_AXIS InjSys_ratAirMPredLocSp rel_uw_q0p0234 8 0.00 1535.977 FORMAT "%8.3" DEPOSIT ABSOLUTE /end AXIS_DESCR
/end CHARACTERISTIC
/begin CHARACTERISTIC InjSys_P1V3I1_HO.tiBreakAux2_M "class instance packet 1 variant 3 / pause time auxiliary injection 2" MAP 0x80565D3E RB_Map_S16U16_S16 1310.680 t_q0p04_ms 0.00 1310.680 FORMAT "%8.3" EXTENDED_LIMITS -1310.720 1310.680
 /begin AXIS_DESCR STD_AXIS Epm_nEng EngN 8 -16384.00 16383.50 FORMAT "%8.2" DEPOSIT ABSOLUTE /end AXIS_DESCR
 /begin AXIS_DESCR STD_AXIS InjSys_ratAirMPredLocSp rel_uw_q0p0234 8 0.00 1535.977 FORMAT "%8.3" DEPOSIT ABSOLUTE /end AXIS_DESCR
/end CHARACTERISTIC
/begin CHARACTERISTIC InjSys_P1V3I2_HO.agBasTPistColdVers2_GM "injection packet 1 in variant 3 / base angle at cold piston temperature (version 2)" MAP 0x8055B460 RB_MapGroup_U8 382.5 kw_q1p5 0.00 382.5 FORMAT "%5.1"
 /begin AXIS_DESCR COM_AXIS Epm_nEng EngN 12 0.00 16383.50 FORMAT "%8.2" EXTENDED_LIMITS -16384.00 16383.50 AXIS_PTS_REF InjSys_nEng12Vers2_AX /end AXIS_DESCR
 /begin AXIS_DESCR COM_AXIS InjSys_ratAirMAgSpVers2AxisInp rel_uw_q0p0234 12 0.00 1535.977 FORMAT "%8.3" AXIS_PTS_REF InjSys_ratAirM12AgSpVers2_AX /end AXIS_DESCR
/end CHARACTERISTIC
/begin CHARACTERISTIC InjSys_P1V3I2_HO.agBasTPistCold_GM "injection packet 1 in variant 3 / base angle at cold piston temperature" MAP 0x8055B4F0 RB_MapGroup_U8 382.5 kw_q1p5 0.00 382.5 FORMAT "%5.1"
 /begin AXIS_DESCR COM_AXIS Epm_nEng EngN 12 0.00 16383.50 FORMAT "%8.2" EXTENDED_LIMITS -16384.00 16383.50 AXIS_PTS_REF InjSys_nEng12_AX /end AXIS_DESCR
 /begin AXIS_DESCR COM_AXIS InjSys_ratAirMAgSpAxisInp rel_uw_q0p0234 12 0.00 1535.977 FORMAT "%8.3" AXIS_PTS_REF InjSys_ratAirM12AgSp_AX /end AXIS_DESCR
/end CHARACTERISTIC
/begin CHARACTERISTIC InjSys_P1V3I2_HO.agBasTPistWrmVers2_GM "injection packet 1 in variant 3 / base angle for interpolation Warm TSA mode (Version 2)" MAP 0x8055B580 RB_MapGroup_U8 382.5 kw_q1p5 0.00 382.5 FORMAT "%5.1"
 /begin AXIS_DESCR COM_AXIS Epm_nEng EngN 12 0.00 16383.50 FORMAT "%8.2" EXTENDED_LIMITS -16384.00 16383.50 AXIS_PTS_REF InjSys_nEng12Vers2_AX /end AXIS_DESCR
 /begin AXIS_DESCR COM_AXIS InjSys_ratAirMAgSpVers2AxisInp rel_uw_q0p0234 12 0.00 1535.977 FORMAT "%8.3" AXIS_PTS_REF InjSys_ratAirM12AgSpVers2_AX /end AXIS_DESCR
/end CHARACTERISTIC
/begin CHARACTERISTIC InjSys_P1V3I2_HO.agBasTPistWrm_GM "injection packet 1 in variant 3 / base angle for interpolation Warm TSA mode" MAP 0x8055B610 RB_MapGroup_U8 382.5 kw_q1p5 0.00 382.5 FORMAT "%5.1"
 /begin AXIS_DESCR COM_AXIS Epm_nEng EngN 12 0.00 16383.50 FORMAT "%8.2" EXTENDED_LIMITS -16384.00 16383.50 AXIS_PTS_REF InjSys_nEng12_AX /end AXIS_DESCR
 /begin AXIS_DESCR COM_AXIS InjSys_ratAirMAgSpAxisInp rel_uw_q0p0234 12 0.00 1535.977 FORMAT "%8.3" AXIS_PTS_REF InjSys_ratAirM12AgSp_AX /end AXIS_DESCR
/end CHARACTERISTIC
/begin CHARACTERISTIC InjSys_P1V3I2_HO.agBgnColdExtdEthnl_GM "injection packet 1 in variant 3 / ." MAP 0x8055B6A0 RB_MapGroup_U8 191.3 kw_q0p75_o240 240.0 431.3 FORMAT "%5.1"
 /begin AXIS_DESCR COM_AXIS Epm_nEng EngN 12 0.00 16383.50 FORMAT "%8.2" EXTENDED_LIMITS -16384.00 16383.50 AXIS_PTS_REF InjSys_nEng12_AX /end AXIS_DESCR
 /begin AXIS_DESCR COM_AXIS InjSys_ratAirMAxisInp rel_uw_q0p0234 12 0.00 1535.977 FORMAT "%8.3" AXIS_PTS_REF InjSys_ratAirM12_AX /end AXIS_DESCR
/end CHARACTERISTIC
/begin CHARACTERISTIC InjSys_P1V3I2_HO.agBgnColdExtd_GM "injection packet 1 in variant 3 / ." MAP 0x8055B730 RB_MapGroup_U8 191.3 kw_q0p75_o240 240.0 431.3 FORMAT "%5.1"
 /begin AXIS_DESCR COM_AXIS Epm_nEng EngN 12 0.00 16383.50 FORMAT "%8.2" EXTENDED_LIMITS -16384.00 16383.50 AXIS_PTS_REF InjSys_nEng12_AX /end AXIS_DESCR
 /begin AXIS_DESCR COM_AXIS InjSys_ratAirMAxisInp rel_uw_q0p0234 12 0.00 1535.977 FORMAT "%8.3" AXIS_PTS_REF InjSys_ratAirM12_AX /end AXIS_DESCR
/end CHARACTERISTIC
/begin CHARACTERISTIC InjSys_P1V3I2_HO.agBgnColdSmlVlvEthnl_GM "injection packet 1 in variant 3 / ." MAP 0x8055B7C0 RB_MapGroup_U8 191.3 kw_q0p75_o240 240.0 431.3 FORMAT "%5.1"
 /begin AXIS_DESCR COM_AXIS Epm_nEng EngN 12 0.00 16383.50 FORMAT "%8.2" EXTENDED_LIMITS -16384.00 16383.50 AXIS_PTS_REF InjSys_nEng12_AX /end AXIS_DESCR
 /begin AXIS_DESCR COM_AXIS InjSys_ratAirMAxisInp rel_uw_q0p0234 12 0.00 1535.977 FORMAT "%8.3" AXIS_PTS_REF InjSys_ratAirM12_AX /end AXIS_DESCR
/end CHARACTERISTIC
/begin CHARACTERISTIC InjSys_P1V3I2_HO.agBgnColdSmlVlv_GM "injection packet 1 in variant 3 / ." MAP 0x8055B850 RB_MapGroup_U8 191.3 kw_q0p75_o240 240.0 431.3 FORMAT "%5.1"
 /begin AXIS_DESCR COM_AXIS Epm_nEng EngN 12 0.00 16383.50 FORMAT "%8.2" EXTENDED_LIMITS -16384.00 16383.50 AXIS_PTS_REF InjSys_nEng12_AX /end AXIS_DESCR
 /begin AXIS_DESCR COM_AXIS InjSys_ratAirMAxisInp rel_uw_q0p0234 12 0.00 1535.977 FORMAT "%8.3" AXIS_PTS_REF InjSys_ratAirM12_AX /end AXIS_DESCR
/end CHARACTERISTIC
/begin CHARACTERISTIC InjSys_P1V3I2_HO.agBgnWrmExtdEthnl_GM "injection packet 1 in variant 3 / ." MAP 0x8055B8E0 RB_MapGroup_U8 191.3 kw_q0p75_o240 240.0 431.3 FORMAT "%5.1"
 /begin AXIS_DESCR COM_AXIS Epm_nEng EngN 12 0.00 16383.50 FORMAT "%8.2" EXTENDED_LIMITS -16384.00 16383.50 AXIS_PTS_REF InjSys_nEng12_AX /end AXIS_DESCR
 /begin AXIS_DESCR COM_AXIS InjSys_ratAirMAxisInp rel_uw_q0p0234 12 0.00 1535.977 FORMAT "%8.3" AXIS_PTS_REF InjSys_ratAirM12_AX /end AXIS_DESCR
/end CHARACTERISTIC
/begin CHARACTERISTIC InjSys_P1V3I2_HO.agBgnWrmExtd_GM "injection packet 1 in variant 3 / ." MAP 0x8055B970 RB_MapGroup_U8 191.3 kw_q0p75_o240 240.0 431.3 FORMAT "%5.1"
 /begin AXIS_DESCR COM_AXIS Epm_nEng EngN 12 0.00 16383.50 FORMAT "%8.2" EXTENDED_LIMITS -16384.00 16383.50 AXIS_PTS_REF InjSys_nEng12_AX /end AXIS_DESCR
 /begin AXIS_DESCR COM_AXIS InjSys_ratAirMAxisInp rel_uw_q0p0234 12 0.00 1535.977 FORMAT "%8.3" AXIS_PTS_REF InjSys_ratAirM12_AX /end AXIS_DESCR
/end CHARACTERISTIC
/begin CHARACTERISTIC InjSys_P1V3I2_HO.agBgnWrmSmlVlvWEthnl_GM "injection packet 1 in variant 3 / ." MAP 0x8055BA00 RB_MapGroup_U8 191.3 kw_q0p75_o240 240.0 431.3 FORMAT "%5.1"
 /begin AXIS_DESCR COM_AXIS Epm_nEng EngN 12 0.00 16383.50 FORMAT "%8.2" EXTENDED_LIMITS -16384.00 16383.50 AXIS_PTS_REF InjSys_nEng12_AX /end AXIS_DESCR
 /begin AXIS_DESCR COM_AXIS InjSys_ratAirMAxisInp rel_uw_q0p0234 12 0.00 1535.977 FORMAT "%8.3" AXIS_PTS_REF InjSys_ratAirM12_AX /end AXIS_DESCR
/end CHARACTERISTIC
/begin CHARACTERISTIC InjSys_P1V3I2_HO.agBgnWrmSmlVlv_GM "injection packet 1 in variant 3 / ." MAP 0x8055BA90 RB_MapGroup_U8 191.3 kw_q0p75_o240 240.0 431.3 FORMAT "%5.1"
 /begin AXIS_DESCR COM_AXIS Epm_nEng EngN 12 0.00 16383.50 FORMAT "%8.2" EXTENDED_LIMITS -16384.00 16383.50 AXIS_PTS_REF InjSys_nEng12_AX /end AXIS_DESCR
 /begin AXIS_DESCR COM_AXIS InjSys_ratAirMAxisInp rel_uw_q0p0234 12 0.00 1535.977 FORMAT "%8.3" AXIS_PTS_REF InjSys_ratAirM12_AX /end AXIS_DESCR
/end CHARACTERISTIC
/begin CHARACTERISTIC InjSys_P1V3I2_HO.agDeltaEth_M "injection packet 1 in variant 3 / delta angle ethanol dependent" MAP 0x8055BB20 RB_Map_S16S16_S16 191.2500 kw_q0p75 -96.00000 95.25000 FORMAT "%8.5" EXTENDED_LIMITS -24576.00 24575.25
 /begin AXIS_DESCR STD_AXIS InjSys_facEthLnrLocSp fak_ub_b2 4 0.00 1.992188 FORMAT "%8.6" EXTENDED_LIMITS -256.0000 255.9922 DEPOSIT ABSOLUTE /end AXIS_DESCR
 /begin AXIS_DESCR STD_AXIS InjSys_tEng Temp_Cels 4 -3549.940 3003.560 FORMAT "%8.3" DEPOSIT ABSOLUTE /end AXIS_DESCR
/end CHARACTERISTIC
/begin CHARACTERISTIC InjSys_P1V3I2_HO.agDeltaLamBasCold_M "injection packet 1 in variant 3 / cold angle base lambda dependent and engine temperature dependent" MAP 0x8055BB54 RB_Map_S16U16_S16 191.2500 kw_q0p75 -96.00000 95.25000 FORMAT "%8.5" EXTENDED_LIMITS -24576.00 24575.25
 /begin AXIS_DESCR STD_AXIS Epm_nEng EngN 8 -16384.00 16383.50 FORMAT "%8.2" DEPOSIT ABSOLUTE /end AXIS_DESCR
 /begin AXIS_DESCR STD_AXIS InjSys_ratAirMPredLocSp rel_uw_q0p0234 6 0.00 1535.977 FORMAT "%8.3" DEPOSIT ABSOLUTE /end AXIS_DESCR
/end CHARACTERISTIC
/begin CHARACTERISTIC InjSys_P1V3I2_HO.agDeltaLamBasWrm_M "injection packet 1 in variant 3 / warm angle base lambda dependent and engine temperature dependent" MAP 0x8055BBD4 RB_Map_S16U16_S16 191.2500 kw_q0p75 -96.00000 95.25000 FORMAT "%8.5" EXTENDED_LIMITS -24576.00 24575.25
 /begin AXIS_DESCR STD_AXIS Epm_nEng EngN 8 -16384.00 16383.50 FORMAT "%8.2" DEPOSIT ABSOLUTE /end AXIS_DESCR
 /begin AXIS_DESCR STD_AXIS InjSys_ratAirMPredLocSp rel_uw_q0p0234 6 0.00 1535.977 FORMAT "%8.3" DEPOSIT ABSOLUTE /end AXIS_DESCR
/end CHARACTERISTIC
/begin CHARACTERISTIC InjSys_P1V3I2_HO.agDeltaLam_M "injection packet 1 in variant 3 / ." MAP 0x8055BC54 RB_Map_S16U16_S16 191.2500 kw_q0p75 -96.00000 95.25000 FORMAT "%8.5" EXTENDED_LIMITS -24576.00 24575.25
 /begin AXIS_DESCR STD_AXIS Epm_nEng EngN 10 -16384.00 16383.50 FORMAT "%8.2" DEPOSIT ABSOLUTE /end AXIS_DESCR
 /begin AXIS_DESCR STD_AXIS InjSys_ratAirMPredLocSp kw_q0p0234 8 0.00 1535.977 FORMAT "%8.3" DEPOSIT ABSOLUTE /end AXIS_DESCR
/end CHARACTERISTIC
/begin CHARACTERISTIC InjSys_P1V3I2_HO.agDeltaTEngOilVers2_GM "injection packet 1 in variant 3 / delta angle engine- and oil- temperature dependent" MAP 0x8055BD1C RB_MapGroup_S8 191.3 kw_q0p75 -96.00 95.25 FORMAT "%5.2"
 /begin AXIS_DESCR COM_AXIS Epm_nEng EngN 12 0.00 16383.50 FORMAT "%8.2" EXTENDED_LIMITS -16384.00 16383.50 AXIS_PTS_REF InjSys_nEng12Vers2_AX /end AXIS_DESCR
 /begin AXIS_DESCR COM_AXIS InjSys_ratAirMAgSpVers2AxisInp rel_uw_q0p0234 12 0.00 1535.977 FORMAT "%8.3" AXIS_PTS_REF InjSys_ratAirM12AgSpVers2_AX /end AXIS_DESCR
/end CHARACTERISTIC
/begin CHARACTERISTIC InjSys_P1V3I2_HO.agDeltaTEngOil_GM "injection packet 1 in variant 3 / delta angle engine- and oil- temperature dependent" MAP 0x8055BDAC RB_MapGroup_S8 191.3 kw_q0p75 -96.00 95.25 FORMAT "%5.2"
 /begin AXIS_DESCR COM_AXIS Epm_nEng EngN 12 0.00 16383.50 FORMAT "%8.2" EXTENDED_LIMITS -16384.00 16383.50 AXIS_PTS_REF InjSys_nEng12_AX /end AXIS_DESCR
 /begin AXIS_DESCR COM_AXIS InjSys_ratAirMAgSpAxisInp rel_uw_q0p0234 12 0.00 1535.977 FORMAT "%8.3" AXIS_PTS_REF InjSys_ratAirM12AgSp_AX /end AXIS_DESCR
/end CHARACTERISTIC
/begin CHARACTERISTIC InjSys_P1V3I2_HO.facAgBgnLam_T "injection packet 1 in variant 3 / ." CURVE 0x8055BE3C RB_Curve_U8_U8 0.9961 fak_ub_b1 0.00 0.9961
 /begin AXIS_DESCR STD_AXIS InjSys_facLamBasLocSp fak_ub_b2 8 0.00 1.992188 FORMAT "%8.6" DEPOSIT ABSOLUTE /end AXIS_DESCR
/end CHARACTERISTIC
/begin CHARACTERISTIC InjSys_P1V3I2_HO.facEthnlAgBgn_T "injection packet 1 in variant 3 / ." CURVE 0x8055BE4D RB_Curve_U8_U8 0.9961 fak_ub_b1 0.00 0.9961
 /begin AXIS_DESCR STD_AXIS fethstoeLocSp fak_ub_b2 4 0.00 1.992188 FORMAT "%8.6" DEPOSIT ABSOLUTE /end AXIS_DESCR
/end CHARACTERISTIC
/begin CHARACTERISTIC InjSys_P1V3I2_HO.facSpltAux1Extd_GM "injection packet 1 in variant 3 / split factor auxiliary injection 1" MAP 0x8055BE56 RB_MapGroup_U8 0.9961 fak_ub_b1 0.00 0.9961
 /begin AXIS_DESCR COM_AXIS Epm_nEng EngN 12 0.00 16383.50 FORMAT "%8.2" EXTENDED_LIMITS -16384.00 16383.50 AXIS_PTS_REF InjSys_nEng12Vers2_AX /end AXIS_DESCR
 /begin AXIS_DESCR COM_AXIS InjSys_ratAirMVers2AxisInp rel_uw_q0p0234 12 0.00 1535.977 FORMAT "%8.3" AXIS_PTS_REF InjSys_ratAirM12Vers2_AX /end AXIS_DESCR
/end CHARACTERISTIC
/begin CHARACTERISTIC InjSys_P1V3I2_HO.facSpltAux1_GM "injection packet 1 in variant 3 / split factor auxiliary injection 1" MAP 0x8055BEE6 RB_MapGroup_U8 0.9961 fak_ub_b1 0.00 0.9961
 /begin AXIS_DESCR COM_AXIS Epm_nEng EngN 10 0.00 16383.50 FORMAT "%8.2" EXTENDED_LIMITS -16384.00 16383.50 AXIS_PTS_REF InjSys_nEng10_AX /end AXIS_DESCR
 /begin AXIS_DESCR COM_AXIS InjSys_ratAirMAxisInp rel_uw_q0p0234 8 0.00 1535.977 FORMAT "%8.3" AXIS_PTS_REF InjSys_ratAirM08_AX /end AXIS_DESCR
/end CHARACTERISTIC
/begin CHARACTERISTIC InjSys_P1V3I2_HO.facSpltAux2Extd_GM "injection packet 1 in variant 3 / split factor auxiliary injection 2" MAP 0x8055BF36 RB_MapGroup_U8 0.9961 fak_ub_b1 0.00 0.9961
 /begin AXIS_DESCR COM_AXIS Epm_nEng EngN 12 0.00 16383.50 FORMAT "%8.2" EXTENDED_LIMITS -16384.00 16383.50 AXIS_PTS_REF InjSys_nEng12Vers2_AX /end AXIS_DESCR
 /begin AXIS_DESCR COM_AXIS InjSys_ratAirMVers2AxisInp rel_uw_q0p0234 12 0.00 1535.977 FORMAT "%8.3" AXIS_PTS_REF InjSys_ratAirM12Vers2_AX /end AXIS_DESCR
/end CHARACTERISTIC
/begin CHARACTERISTIC InjSys_P1V3I2_HO.facSpltAux2_GM "injection packet 1 in variant 3 / split factor auxiliary injection 2" MAP 0x8055BFC6 RB_MapGroup_U8 0.9961 fak_ub_b1 0.00 0.9961
 /begin AXIS_DESCR COM_AXIS Epm_nEng EngN 10 0.00 16383.50 FORMAT "%8.2" EXTENDED_LIMITS -16384.00 16383.50 AXIS_PTS_REF InjSys_nEng10_AX /end AXIS_DESCR
 /begin AXIS_DESCR COM_AXIS InjSys_ratAirMAxisInp rel_uw_q0p0234 8 0.00 1535.977 FORMAT "%8.3" AXIS_PTS_REF InjSys_ratAirM08_AX /end AXIS_DESCR
/end CHARACTERISTIC
/begin CHARACTERISTIC InjSys_P1V3I2_HO.facTPistCold_M "injection packet 1 in variant 3 / delta angle ethanol dependent" MAP 0x8055C016 RB_Map_S16S16_U8 0.9961 fak_ub_b1 0.00 0.9961
 /begin AXIS_DESCR STD_AXIS InjSys_tEng Temp_Cels 8 -3549.940 3003.560 FORMAT "%8.3" DEPOSIT ABSOLUTE /end AXIS_DESCR
 /begin AXIS_DESCR STD_AXIS InjSys_tOilLocSp Temp_Cels 8 -3549.940 3003.560 FORMAT "%8.3" DEPOSIT ABSOLUTE /end AXIS_DESCR
/end CHARACTERISTIC
/begin CHARACTERISTIC InjSys_P1V3I2_HO.facTPist_M "injection packet 1 in variant 3 / factor piston temperature" MAP 0x8055C07A RB_Map_S16S16_U8 0.9961 fak_ub_b1 0.00 0.9961
 /begin AXIS_DESCR STD_AXIS InjSys_tPistBas Temp_Cels 6 -3549.940 3003.560 FORMAT "%8.3" DEPOSIT ABSOLUTE /end AXIS_DESCR
 /begin AXIS_DESCR STD_AXIS InjSys_tPistDelta temp_q0p1 6 -3276.800 3276.700 FORMAT "%8.3" DEPOSIT ABSOLUTE /end AXIS_DESCR
/end CHARACTERISTIC
/begin CHARACTERISTIC InjSys_P1V3I2_HO.facWghtAgDeltaLamBasCold_T "injection packet 1 in variant 3 / weighting factor cold delta angle engine and oil temperature dependent" CURVE 0x8055C0BA RB_Curve_U8_U8 0.9961 fak_ub_b1 0.00 0.9961
 /begin AXIS_DESCR STD_AXIS InjSys_facLamBasLocSp fak_ub_b2 3 0.00 1.992188 FORMAT "%8.6" DEPOSIT ABSOLUTE /end AXIS_DESCR
/end CHARACTERISTIC
/begin CHARACTERISTIC InjSys_P1V3I2_HO.facWghtAgDeltaLamBasWrm_T "injection packet 1 in variant 3 / weighting factor warm delta angle engine and oil temperature dependent" CURVE 0x8055C0C1 RB_Curve_U8_U8 0.9961 fak_ub_b1 0.00 0.9961
 /begin AXIS_DESCR STD_AXIS InjSys_facLamBasLocSp fak_ub_b2 3 0.00 1.992188 FORMAT "%8.6" DEPOSIT ABSOLUTE /end AXIS_DESCR
/end CHARACTERISTIC
/begin CHARACTERISTIC InjSys_P1V3I2_HO.facWghtColdWrmEthnl_M "injection packet 1 in variant 3 / ." MAP 0x8055C0C8 RB_Map_S16S16_U8 0.9961 fak_ub_b1 0.00 0.9961
 /begin AXIS_DESCR STD_AXIS InjSys_tEng Temp_Cels 6 -3549.940 3003.560 FORMAT "%8.3" DEPOSIT ABSOLUTE /end AXIS_DESCR
 /begin AXIS_DESCR STD_AXIS InjSys_tOilLocSp Temp_Cels 4 -3549.940 3003.560 FORMAT "%8.3" DEPOSIT ABSOLUTE /end AXIS_DESCR
/end CHARACTERISTIC
/begin CHARACTERISTIC InjSys_P1V3I2_HO.facWghtColdWrm_M "injection packet 1 in variant 3 / ." MAP 0x8055C0F8 RB_Map_S16S16_U8 0.9961 fak_ub_b1 0.00 0.9961
 /begin AXIS_DESCR STD_AXIS InjSys_tEng Temp_Cels 6 -3549.940 3003.560 FORMAT "%8.3" DEPOSIT ABSOLUTE /end AXIS_DESCR
 /begin AXIS_DESCR STD_AXIS InjSys_tOilLocSp Temp_Cels 4 -3549.940 3003.560 FORMAT "%8.3" DEPOSIT ABSOLUTE /end AXIS_DESCR
/end CHARACTERISTIC
/begin CHARACTERISTIC InjSys_P1V3I2_HO.facWghtWrmCold_M "injection packet 1 in variant 3 / weighting factor warm-cold delta angle engine- and oil- temperature dependent" MAP 0x8055C128 RB_Map_S16S16_U8 0.9961 fak_ub_b1 0.00 0.9961
 /begin AXIS_DESCR STD_AXIS InjSys_tEng Temp_Cels 6 -3549.940 3003.560 FORMAT "%8.3" DEPOSIT ABSOLUTE /end AXIS_DESCR
 /begin AXIS_DESCR STD_AXIS InjSys_tOilLocSp Temp_Cels 4 -3549.940 3003.560 FORMAT "%8.3" DEPOSIT ABSOLUTE /end AXIS_DESCR
/end CHARACTERISTIC
/begin CHARACTERISTIC InjSys_P1V3I2_HO.flgAbsltSplt_C "injection packet 1 in variant 3 / condition split with absolute fuel mass" VALUE 0x8055C158 RB_Val_Wu8 1.00000000000 B_TRUE 0.00 1.00000000000 FORMAT "%13.11" /end CHARACTERISTIC
/begin CHARACTERISTIC InjSys_P1V3I2_HO.flgAxVers_C "injection packet 1 in variant 3 / condition map selection with group axis in version 2" VALUE 0x8055C159 RB_Val_Wu8 1.00000000000 B_TRUE 0.00 1.00000000000 FORMAT "%13.11" /end CHARACTERISTIC
/begin CHARACTERISTIC InjSys_P1V3I2_HO.flgPltInj_C "injection packet 1 in variant 3 / condition pilot injection" VALUE 0x8055C15A RB_Val_Wu8 1.00000000000 B_TRUE 0.00 1.00000000000 FORMAT "%13.11" /end CHARACTERISTIC
/begin CHARACTERISTIC InjSys_P1V3I2_HO.ratFuMAux1_GM "injection packet 1 in variant 3 / relative fuel mass auxiliary injection 1" MAP 0x8055C15C RB_MapGroup_U16 3071.953 rel_uw_b3072 0.00 3071.953 FORMAT "%8.3"
 /begin AXIS_DESCR COM_AXIS Epm_nEng EngN 10 0.00 16383.50 FORMAT "%8.2" EXTENDED_LIMITS -16384.00 16383.50 AXIS_PTS_REF InjSys_nEng10_AX /end AXIS_DESCR
 /begin AXIS_DESCR COM_AXIS InjSys_ratAirMAxisInp rel_uw_q0p0234 8 0.00 1535.977 FORMAT "%8.3" AXIS_PTS_REF InjSys_ratAirM08_AX /end AXIS_DESCR
/end CHARACTERISTIC
/begin CHARACTERISTIC InjSys_P1V3I2_HO.ratFuMAux2_GM "injection packet 1 in variant 3 / relative fuel mass auxiliary injection 2" MAP 0x8055C1FC RB_MapGroup_U16 3071.953 rel_uw_b3072 0.00 3071.953 FORMAT "%8.3"
 /begin AXIS_DESCR COM_AXIS Epm_nEng EngN 10 0.00 16383.50 FORMAT "%8.2" EXTENDED_LIMITS -16384.00 16383.50 AXIS_PTS_REF InjSys_nEng10_AX /end AXIS_DESCR
 /begin AXIS_DESCR COM_AXIS InjSys_ratAirMAxisInp rel_uw_q0p0234 8 0.00 1535.977 FORMAT "%8.3" AXIS_PTS_REF InjSys_ratAirM08_AX /end AXIS_DESCR
/end CHARACTERISTIC
/begin CHARACTERISTIC InjSys_P1V3I2_HO.ratFuMBasExtd_GM "injection packet 1 in variant 3 / relative fuel mass base injection" MAP 0x8055C29C RB_MapGroup_U16 3071.953 rel_uw_b3072 0.00 3071.953 FORMAT "%8.3"
 /begin AXIS_DESCR COM_AXIS Epm_nEng EngN 12 0.00 16383.50 FORMAT "%8.2" EXTENDED_LIMITS -16384.00 16383.50 AXIS_PTS_REF InjSys_nEng12Vers2_AX /end AXIS_DESCR
 /begin AXIS_DESCR COM_AXIS InjSys_ratAirMVers2AxisInp rel_uw_q0p0234 12 0.00 1535.977 FORMAT "%8.3" AXIS_PTS_REF InjSys_ratAirM12Vers2_AX /end AXIS_DESCR
/end CHARACTERISTIC
/begin CHARACTERISTIC InjSys_P1V3I2_HO.ratFuMBas_GM "injection packet 1 in variant 3 / relative fuel mass base injection" MAP 0x8055C3BC RB_MapGroup_U16 3071.953 rel_uw_b3072 0.00 3071.953 FORMAT "%8.3"
 /begin AXIS_DESCR COM_AXIS Epm_nEng EngN 10 0.00 16383.50 FORMAT "%8.2" EXTENDED_LIMITS -16384.00 16383.50 AXIS_PTS_REF InjSys_nEng10_AX /end AXIS_DESCR
 /begin AXIS_DESCR COM_AXIS InjSys_ratAirMAxisInp rel_uw_q0p0234 8 0.00 1535.977 FORMAT "%8.3" AXIS_PTS_REF InjSys_ratAirM08_AX /end AXIS_DESCR
/end CHARACTERISTIC
/begin CHARACTERISTIC InjSys_P1V3I2_HO.stDiTiBreakAux_C "injection packet 1 in variant 3 / state disabling break time for auxiliary injection" VALUE 0x8055C45C RB_Val_Wu8 255.0 dez 0.00 255.0 FORMAT "%5.1" /end CHARACTERISTIC
/begin CHARACTERISTIC InjSys_P1V3I2_HO.tiBreakAux1_M "injection packet 1 in variant 3 / pause time auxiliary injection 1" MAP 0x8055C45E RB_Map_S16U16_S16 1310.680 t_q0p04_ms 0.00 1310.680 FORMAT "%8.3" EXTENDED_LIMITS -1310.720 1310.680
 /begin AXIS_DESCR STD_AXIS Epm_nEng EngN 8 -16384.00 16383.50 FORMAT "%8.2" DEPOSIT ABSOLUTE /end AXIS_DESCR
 /begin AXIS_DESCR STD_AXIS InjSys_ratAirMPredLocSp rel_uw_q0p0234 8 0.00 1535.977 FORMAT "%8.3" DEPOSIT ABSOLUTE /end AXIS_DESCR
/end CHARACTERISTIC
/begin CHARACTERISTIC InjSys_P1V3I2_HO.tiBreakAux2_M "injection packet 1 in variant 3 / pause time auxiliary injection 2" MAP 0x8055C502 RB_Map_S16U16_S16 1310.680 t_q0p04_ms 0.00 1310.680 FORMAT "%8.3" EXTENDED_LIMITS -1310.720 1310.680
 /begin AXIS_DESCR STD_AXIS Epm_nEng EngN 8 -16384.00 16383.50 FORMAT "%8.2" DEPOSIT ABSOLUTE /end AXIS_DESCR
 /begin AXIS_DESCR STD_AXIS InjSys_ratAirMPredLocSp rel_uw_q0p0234 8 0.00 1535.977 FORMAT "%8.3" DEPOSIT ABSOLUTE /end AXIS_DESCR
/end CHARACTERISTIC
/begin CHARACTERISTIC InjSys_P1V4I1_HP.agBasHspHiVers2_GM "class instance packet 1 variant 4 / base angle in homogenous-split mode for interpolation (version 2)" MAP 0x80565DE8 RB_MapGroup_U8 382.5 kw_q1p5 0.00 382.5 FORMAT "%5.1"
 /begin AXIS_DESCR COM_AXIS Epm_nEng EngN 12 0.00 16383.50 FORMAT "%8.2" EXTENDED_LIMITS -16384.00 16383.50 AXIS_PTS_REF InjSys_nEng12HspVers2_AX /end AXIS_DESCR
 /begin AXIS_DESCR COM_AXIS InjSys_ratAirMAgSpVers2AxisInp rel_uw_q0p0234 12 0.00 1535.977 FORMAT "%8.3" AXIS_PTS_REF InjSys_ratAirM12AgSpHspVers2_AX /end AXIS_DESCR
/end CHARACTERISTIC
/begin CHARACTERISTIC InjSys_P1V4I1_HP.agBasHspHi_GM "class instance packet 1 variant 4 / base angle in homogenous-split mode for interpolation" MAP 0x80565E78 RB_MapGroup_U8 382.5 kw_q1p5 0.00 382.5 FORMAT "%5.1"
 /begin AXIS_DESCR COM_AXIS Epm_nEng EngN 12 0.00 16383.50 FORMAT "%8.2" EXTENDED_LIMITS -16384.00 16383.50 AXIS_PTS_REF InjSys_nEng12Hsp_AX /end AXIS_DESCR
 /begin AXIS_DESCR COM_AXIS InjSys_ratAirMAgSpAxisInp rel_uw_q0p0234 12 0.00 1535.977 FORMAT "%8.3" AXIS_PTS_REF InjSys_ratAirM12AgSpHsp_AX /end AXIS_DESCR
/end CHARACTERISTIC
/begin CHARACTERISTIC InjSys_P1V4I1_HP.agBasHspLoVers2_GM "class instance packet 1 variant 4 / base angle in homogenous-split mode for interpolation (version 2)" MAP 0x80565F08 RB_MapGroup_U8 382.5 kw_q1p5 0.00 382.5 FORMAT "%5.1"
 /begin AXIS_DESCR COM_AXIS Epm_nEng EngN 12 0.00 16383.50 FORMAT "%8.2" EXTENDED_LIMITS -16384.00 16383.50 AXIS_PTS_REF InjSys_nEng12HspVers2_AX /end AXIS_DESCR
 /begin AXIS_DESCR COM_AXIS InjSys_ratAirMAgSpVers2AxisInp rel_uw_q0p0234 12 0.00 1535.977 FORMAT "%8.3" AXIS_PTS_REF InjSys_ratAirM12AgSpHspVers2_AX /end AXIS_DESCR
/end CHARACTERISTIC
/begin CHARACTERISTIC InjSys_P1V4I1_HP.agBasHspLo_GM "class instance packet 1 variant 4 / base angle in homogenous-split mode for interpolation" MAP 0x80565F98 RB_MapGroup_U8 382.5 kw_q1p5 0.00 382.5 FORMAT "%5.1"
 /begin AXIS_DESCR COM_AXIS Epm_nEng EngN 12 0.00 16383.50 FORMAT "%8.2" EXTENDED_LIMITS -16384.00 16383.50 AXIS_PTS_REF InjSys_nEng12Hsp_AX /end AXIS_DESCR
 /begin AXIS_DESCR COM_AXIS InjSys_ratAirMAgSpAxisInp rel_uw_q0p0234 12 0.00 1535.977 FORMAT "%8.3" AXIS_PTS_REF InjSys_ratAirM12AgSpHsp_AX /end AXIS_DESCR
/end CHARACTERISTIC
/begin CHARACTERISTIC InjSys_P1V4I1_HP.agBasTPistColdVers2_GM "class instance packet 1 variant 4 / base angle at cold piston temperature (version 2)" MAP 0x80566028 RB_MapGroup_U8 382.5 kw_q1p5 0.00 382.5 FORMAT "%5.1"
 /begin AXIS_DESCR COM_AXIS Epm_nEng EngN 12 0.00 16383.50 FORMAT "%8.2" EXTENDED_LIMITS -16384.00 16383.50 AXIS_PTS_REF InjSys_nEng12Vers2_AX /end AXIS_DESCR
 /begin AXIS_DESCR COM_AXIS InjSys_ratAirMAgSpVers2AxisInp rel_uw_q0p0234 12 0.00 1535.977 FORMAT "%8.3" AXIS_PTS_REF InjSys_ratAirM12AgSpVers2_AX /end AXIS_DESCR
/end CHARACTERISTIC
/begin CHARACTERISTIC InjSys_P1V4I1_HP.agBasTPistCold_GM "class instance packet 1 variant 4 / base angle at cold piston temperature" MAP 0x805660B8 RB_MapGroup_U8 382.5 kw_q1p5 0.00 382.5 FORMAT "%5.1"
 /begin AXIS_DESCR COM_AXIS Epm_nEng EngN 12 0.00 16383.50 FORMAT "%8.2" EXTENDED_LIMITS -16384.00 16383.50 AXIS_PTS_REF InjSys_nEng12_AX /end AXIS_DESCR
 /begin AXIS_DESCR COM_AXIS InjSys_ratAirMAgSpAxisInp rel_uw_q0p0234 12 0.00 1535.977 FORMAT "%8.3" AXIS_PTS_REF InjSys_ratAirM12AgSp_AX /end AXIS_DESCR
/end CHARACTERISTIC
/begin CHARACTERISTIC InjSys_P1V4I1_HP.agBasTPistWrmVers2_GM "class instance packet 1 variant 4 / base angle for interpolation Warm TSA mode (Version 2)" MAP 0x80566148 RB_MapGroup_U8 382.5 kw_q1p5 0.00 382.5 FORMAT "%5.1"
 /begin AXIS_DESCR COM_AXIS Epm_nEng EngN 12 0.00 16383.50 FORMAT "%8.2" EXTENDED_LIMITS -16384.00 16383.50 AXIS_PTS_REF InjSys_nEng12Vers2_AX /end AXIS_DESCR
 /begin AXIS_DESCR COM_AXIS InjSys_ratAirMAgSpVers2AxisInp rel_uw_q0p0234 12 0.00 1535.977 FORMAT "%8.3" AXIS_PTS_REF InjSys_ratAirM12AgSpVers2_AX /end AXIS_DESCR
/end CHARACTERISTIC
/begin CHARACTERISTIC InjSys_P1V4I1_HP.agBasTPistWrm_GM "class instance packet 1 variant 4 / base angle for interpolation Warm TSA mode" MAP 0x805661D8 RB_MapGroup_U8 382.5 kw_q1p5 0.00 382.5 FORMAT "%5.1"
 /begin AXIS_DESCR COM_AXIS Epm_nEng EngN 12 0.00 16383.50 FORMAT "%8.2" EXTENDED_LIMITS -16384.00 16383.50 AXIS_PTS_REF InjSys_nEng12_AX /end AXIS_DESCR
 /begin AXIS_DESCR COM_AXIS InjSys_ratAirMAgSpAxisInp rel_uw_q0p0234 12 0.00 1535.977 FORMAT "%8.3" AXIS_PTS_REF InjSys_ratAirM12AgSp_AX /end AXIS_DESCR
/end CHARACTERISTIC
/begin CHARACTERISTIC InjSys_P1V4I1_HP.agBgnColdExtdEthnl_GM "class instance packet 1 variant 4 / ." MAP 0x80566268 RB_MapGroup_U8 382.5 kw_q1p5 0.00 382.5 FORMAT "%5.1"
 /begin AXIS_DESCR COM_AXIS Epm_nEng EngN 12 0.00 16383.50 FORMAT "%8.2" EXTENDED_LIMITS -16384.00 16383.50 AXIS_PTS_REF InjSys_nEng12Hpx_AX /end AXIS_DESCR
 /begin AXIS_DESCR COM_AXIS InjSys_ratAirMAxisInp rel_uw_q0p0234 12 0.00 1535.977 FORMAT "%8.3" AXIS_PTS_REF InjSys_ratAirM12Hpx_AX /end AXIS_DESCR
/end CHARACTERISTIC
/begin CHARACTERISTIC InjSys_P1V4I1_HP.agBgnColdExtd_GM "class instance packet 1 variant 4 / ." MAP 0x805662F8 RB_MapGroup_U8 382.5 kw_q1p5 0.00 382.5 FORMAT "%5.1"
 /begin AXIS_DESCR COM_AXIS Epm_nEng EngN 12 0.00 16383.50 FORMAT "%8.2" EXTENDED_LIMITS -16384.00 16383.50 AXIS_PTS_REF InjSys_nEng12Hpx_AX /end AXIS_DESCR
 /begin AXIS_DESCR COM_AXIS InjSys_ratAirMAxisInp rel_uw_q0p0234 12 0.00 1535.977 FORMAT "%8.3" AXIS_PTS_REF InjSys_ratAirM12Hpx_AX /end AXIS_DESCR
/end CHARACTERISTIC
/begin CHARACTERISTIC InjSys_P1V4I1_HP.agBgnColdSmlVlvEthnl_GM "class instance packet 1 variant 4 / ." MAP 0x80566388 RB_MapGroup_U8 382.5 kw_q1p5 0.00 382.5 FORMAT "%5.1"
 /begin AXIS_DESCR COM_AXIS Epm_nEng EngN 12 0.00 16383.50 FORMAT "%8.2" EXTENDED_LIMITS -16384.00 16383.50 AXIS_PTS_REF InjSys_nEng12Hpx_AX /end AXIS_DESCR
 /begin AXIS_DESCR COM_AXIS InjSys_ratAirMAxisInp rel_uw_q0p0234 12 0.00 1535.977 FORMAT "%8.3" AXIS_PTS_REF InjSys_ratAirM12Hpx_AX /end AXIS_DESCR
/end CHARACTERISTIC
/begin CHARACTERISTIC InjSys_P1V4I1_HP.agBgnColdSmlVlv_GM "class instance packet 1 variant 4 / ." MAP 0x80566418 RB_MapGroup_U8 382.5 kw_q1p5 0.00 382.5 FORMAT "%5.1"
 /begin AXIS_DESCR COM_AXIS Epm_nEng EngN 12 0.00 16383.50 FORMAT "%8.2" EXTENDED_LIMITS -16384.00 16383.50 AXIS_PTS_REF InjSys_nEng12Hpx_AX /end AXIS_DESCR
 /begin AXIS_DESCR COM_AXIS InjSys_ratAirMAxisInp rel_uw_q0p0234 12 0.00 1535.977 FORMAT "%8.3" AXIS_PTS_REF InjSys_ratAirM12Hpx_AX /end AXIS_DESCR
/end CHARACTERISTIC
/begin CHARACTERISTIC InjSys_P1V4I1_HP.agBgnWrmExtdEthnl_GM "class instance packet 1 variant 4 / ." MAP 0x805664A8 RB_MapGroup_U8 382.5 kw_q1p5 0.00 382.5 FORMAT "%5.1"
 /begin AXIS_DESCR COM_AXIS Epm_nEng EngN 12 0.00 16383.50 FORMAT "%8.2" EXTENDED_LIMITS -16384.00 16383.50 AXIS_PTS_REF InjSys_nEng12Hpx_AX /end AXIS_DESCR
 /begin AXIS_DESCR COM_AXIS InjSys_ratAirMAxisInp rel_uw_q0p0234 12 0.00 1535.977 FORMAT "%8.3" AXIS_PTS_REF InjSys_ratAirM12Hpx_AX /end AXIS_DESCR
/end CHARACTERISTIC
/begin CHARACTERISTIC InjSys_P1V4I1_HP.agBgnWrmExtd_GM "class instance packet 1 variant 4 / ." MAP 0x80566538 RB_MapGroup_U8 382.5 kw_q1p5 0.00 382.5 FORMAT "%5.1"
 /begin AXIS_DESCR COM_AXIS Epm_nEng EngN 12 0.00 16383.50 FORMAT "%8.2" EXTENDED_LIMITS -16384.00 16383.50 AXIS_PTS_REF InjSys_nEng12Hpx_AX /end AXIS_DESCR
 /begin AXIS_DESCR COM_AXIS InjSys_ratAirMAxisInp rel_uw_q0p0234 12 0.00 1535.977 FORMAT "%8.3" AXIS_PTS_REF InjSys_ratAirM12Hpx_AX /end AXIS_DESCR
/end CHARACTERISTIC
/begin CHARACTERISTIC InjSys_P1V4I1_HP.agBgnWrmSmlVlvEthnl_GM "class instance packet 1 variant 4 / ." MAP 0x805665C8 RB_MapGroup_U8 382.5 kw_q1p5 0.00 382.5 FORMAT "%5.1"
 /begin AXIS_DESCR COM_AXIS Epm_nEng EngN 12 0.00 16383.50 FORMAT "%8.2" EXTENDED_LIMITS -16384.00 16383.50 AXIS_PTS_REF InjSys_nEng12Hpx_AX /end AXIS_DESCR
 /begin AXIS_DESCR COM_AXIS InjSys_ratAirMAxisInp rel_uw_q0p0234 12 0.00 1535.977 FORMAT "%8.3" AXIS_PTS_REF InjSys_ratAirM12Hpx_AX /end AXIS_DESCR
/end CHARACTERISTIC
/begin CHARACTERISTIC InjSys_P1V4I1_HP.agBgnWrmSmlVlv_GM "class instance packet 1 variant 4 / ." MAP 0x80566658 RB_MapGroup_U8 382.5 kw_q1p5 0.00 382.5 FORMAT "%5.1"
 /begin AXIS_DESCR COM_AXIS Epm_nEng EngN 12 0.00 16383.50 FORMAT "%8.2" EXTENDED_LIMITS -16384.00 16383.50 AXIS_PTS_REF InjSys_nEng12Hpx_AX /end AXIS_DESCR
 /begin AXIS_DESCR COM_AXIS InjSys_ratAirMAxisInp rel_uw_q0p0234 12 0.00 1535.977 FORMAT "%8.3" AXIS_PTS_REF InjSys_ratAirM12Hpx_AX /end AXIS_DESCR
/end CHARACTERISTIC
/begin CHARACTERISTIC InjSys_P1V4I1_HP.agDeltaEth_M "class instance packet 1 variant 4 / delta angle ethanol dependent" MAP 0x805666E8 RB_Map_S16S16_S16 191.2500 kw_q0p75 -96.00000 95.25000 FORMAT "%8.5" EXTENDED_LIMITS -24576.00 24575.25
 /begin AXIS_DESCR STD_AXIS InjSys_facEthLnrLocSp fak_ub_b2 4 0.00 1.992188 FORMAT "%8.6" EXTENDED_LIMITS -256.0000 255.9922 DEPOSIT ABSOLUTE /end AXIS_DESCR
 /begin AXIS_DESCR STD_AXIS InjSys_tEng Temp_Cels 4 -3549.940 3003.560 FORMAT "%8.3" DEPOSIT ABSOLUTE /end AXIS_DESCR
/end CHARACTERISTIC
/begin CHARACTERISTIC InjSys_P1V4I1_HP.agDeltaLam_M "class instance packet 1 variant 4 / ." MAP 0x8056671C RB_Map_S16U16_S16 191.2500 kw_q0p75 -96.00000 95.25000 FORMAT "%8.5" EXTENDED_LIMITS -24576.00 24575.25
 /begin AXIS_DESCR STD_AXIS Epm_nEng EngN 10 -16384.00 16383.50 FORMAT "%8.2" DEPOSIT ABSOLUTE /end AXIS_DESCR
 /begin AXIS_DESCR STD_AXIS InjSys_ratAirMPredLocSp kw_q0p0234 8 0.00 1535.977 FORMAT "%8.3" DEPOSIT ABSOLUTE /end AXIS_DESCR
/end CHARACTERISTIC
/begin CHARACTERISTIC InjSys_P1V4I1_HP.facAgBgnLam_T "class instance packet 1 variant 4 / ." CURVE 0x805667E4 RB_Curve_U8_U8 0.9961 fak_ub_b1 0.00 0.9961
 /begin AXIS_DESCR STD_AXIS InjSys_facLamBasLocSp fak_ub_b2 8 0.00 1.992188 FORMAT "%8.6" DEPOSIT ABSOLUTE /end AXIS_DESCR
/end CHARACTERISTIC
/begin CHARACTERISTIC InjSys_P1V4I1_HP.facEthnlAgBgn_T "class instance packet 1 variant 4 / ." CURVE 0x805667F5 RB_Curve_U8_U8 0.9961 fak_ub_b1 0.00 0.9961
 /begin AXIS_DESCR STD_AXIS fethstoeLocSp fak_ub_b2 4 0.00 1.992188 FORMAT "%8.6" DEPOSIT ABSOLUTE /end AXIS_DESCR
/end CHARACTERISTIC
/begin CHARACTERISTIC InjSys_P1V4I1_HP.facTPistCold_M "class instance packet 1 variant 4 / delta angle ethanol dependent" MAP 0x805667FE RB_Map_S16S16_U8 0.9961 fak_ub_b1 0.00 0.9961
 /begin AXIS_DESCR STD_AXIS InjSys_tEng Temp_Cels 8 -3549.940 3003.560 FORMAT "%8.3" DEPOSIT ABSOLUTE /end AXIS_DESCR
 /begin AXIS_DESCR STD_AXIS InjSys_tOilLocSp Temp_Cels 8 -3549.940 3003.560 FORMAT "%8.3" DEPOSIT ABSOLUTE /end AXIS_DESCR
/end CHARACTERISTIC
/begin CHARACTERISTIC InjSys_P1V4I1_HP.facTPist_M "class instance packet 1 variant 4 / weighting factor base angle in homogenous-split mode temperature dependent" MAP 0x80566862 RB_Map_S16S16_U8 0.9961 fak_ub_b1 0.00 0.9961
 /begin AXIS_DESCR STD_AXIS InjSys_tPistBas Temp_Cels 6 -3549.940 3003.560 FORMAT "%8.3" DEPOSIT ABSOLUTE /end AXIS_DESCR
 /begin AXIS_DESCR STD_AXIS InjSys_tPistDelta temp_q0p1 6 -3276.800 3276.700 FORMAT "%8.3" DEPOSIT ABSOLUTE /end AXIS_DESCR
/end CHARACTERISTIC
/begin CHARACTERISTIC InjSys_P1V4I1_HP.facWghtColdWrmEthnl_M "class instance packet 1 variant 4 / ." MAP 0x805668A2 RB_Map_S16S16_U8 0.9961 fak_ub_b1 0.00 0.9961
 /begin AXIS_DESCR STD_AXIS InjSys_tEng Temp_Cels 6 -3549.940 3003.560 FORMAT "%8.3" DEPOSIT ABSOLUTE /end AXIS_DESCR
 /begin AXIS_DESCR STD_AXIS InjSys_tOilLocSp Temp_Cels 4 -3549.940 3003.560 FORMAT "%8.3" DEPOSIT ABSOLUTE /end AXIS_DESCR
/end CHARACTERISTIC
/begin CHARACTERISTIC InjSys_P1V4I1_HP.facWghtColdWrm_M "class instance packet 1 variant 4 / ." MAP 0x805668D2 RB_Map_S16S16_U8 0.9961 fak_ub_b1 0.00 0.9961
 /begin AXIS_DESCR STD_AXIS InjSys_tEng Temp_Cels 6 -3549.940 3003.560 FORMAT "%8.3" DEPOSIT ABSOLUTE /end AXIS_DESCR
 /begin AXIS_DESCR STD_AXIS InjSys_tOilLocSp Temp_Cels 4 -3549.940 3003.560 FORMAT "%8.3" DEPOSIT ABSOLUTE /end AXIS_DESCR
/end CHARACTERISTIC
/begin CHARACTERISTIC InjSys_P1V4I1_HP.facWghtTHsp_M "class instance packet 1 variant 4 / weighting factor base angle in homogenous-split mode temperature dependent" MAP 0x80566902 RB_Map_S16S16_U8 0.9961 fak_ub_b1 0.00 0.9961
 /begin AXIS_DESCR STD_AXIS InjSys_tEng Temp_Cels 6 -3549.940 3003.560 FORMAT "%8.3" DEPOSIT ABSOLUTE /end AXIS_DESCR
 /begin AXIS_DESCR STD_AXIS InjSys_tEngStrt Temp_Cels 4 -3549.940 3003.560 FORMAT "%8.3" DEPOSIT ABSOLUTE /end AXIS_DESCR
/end CHARACTERISTIC
/begin CHARACTERISTIC InjSys_P1V4I1_HP.facWhgtWrmColdHsp_GM "class instance packet 1 variant 4 / weighting factor warm-cold base angle in homogenous-split mode" MAP 0x80566932 RB_MapGroup_U16 1.000000 fak_uw_b2 0.00 1.000000 FORMAT "%8.6" EXTENDED_LIMITS 0.00 1.999969
 /begin AXIS_DESCR COM_AXIS InjSys_tEngStrt Temp_Cels 8 -3549.940 3003.560 FORMAT "%8.3" AXIS_PTS_REF InjSys_tEngStrt08_AX /end AXIS_DESCR
 /begin AXIS_DESCR COM_AXIS InjSys_nrInjLimdLoc dez 4 0.00 65535.00 FORMAT "%8.2" AXIS_PTS_REF InjSys_nrInj04_AX /end AXIS_DESCR
/end CHARACTERISTIC
/begin CHARACTERISTIC InjSys_P1V4I1_HP.flgAxVers_C "class instance packet 1 variant 4 / condition map selection with group axis in version 2" VALUE 0x80566972 RB_Val_Wu8 1.00000000000 B_TRUE 0.00 1.00000000000 FORMAT "%13.11" /end CHARACTERISTIC
/begin CHARACTERISTIC InjSys_P1V4I2_HP.agBasHspHiVers2_GM "injection packet 1 in variant 4 / base angle in homogenous-split mode for interpolation (version 2)" MAP 0x8055C5AC RB_MapGroup_U8 382.5 kw_q1p5 0.00 382.5 FORMAT "%5.1"
 /begin AXIS_DESCR COM_AXIS Epm_nEng EngN 12 0.00 16383.50 FORMAT "%8.2" EXTENDED_LIMITS -16384.00 16383.50 AXIS_PTS_REF InjSys_nEng12HspVers2_AX /end AXIS_DESCR
 /begin AXIS_DESCR COM_AXIS InjSys_ratAirMAgSpVers2AxisInp rel_uw_q0p0234 12 0.00 1535.977 FORMAT "%8.3" AXIS_PTS_REF InjSys_ratAirM12AgSpHspVers2_AX /end AXIS_DESCR
/end CHARACTERISTIC
/begin CHARACTERISTIC InjSys_P1V4I2_HP.agBasHspHi_GM "injection packet 1 in variant 4 / base angle in homogenous-split mode for interpolation" MAP 0x8055C63C RB_MapGroup_U8 382.5 kw_q1p5 0.00 382.5 FORMAT "%5.1"
 /begin AXIS_DESCR COM_AXIS Epm_nEng EngN 12 0.00 16383.50 FORMAT "%8.2" EXTENDED_LIMITS -16384.00 16383.50 AXIS_PTS_REF InjSys_nEng12Hsp_AX /end AXIS_DESCR
 /begin AXIS_DESCR COM_AXIS InjSys_ratAirMAgSpAxisInp rel_uw_q0p0234 12 0.00 1535.977 FORMAT "%8.3" AXIS_PTS_REF InjSys_ratAirM12AgSpHsp_AX /end AXIS_DESCR
/end CHARACTERISTIC
/begin CHARACTERISTIC InjSys_P1V4I2_HP.agBasHspLoVers2_GM "injection packet 1 in variant 4 / base angle in homogenous-split mode for interpolation (version 2)" MAP 0x8055C6CC RB_MapGroup_U8 382.5 kw_q1p5 0.00 382.5 FORMAT "%5.1"
 /begin AXIS_DESCR COM_AXIS Epm_nEng EngN 12 0.00 16383.50 FORMAT "%8.2" EXTENDED_LIMITS -16384.00 16383.50 AXIS_PTS_REF InjSys_nEng12HspVers2_AX /end AXIS_DESCR
 /begin AXIS_DESCR COM_AXIS InjSys_ratAirMAgSpVers2AxisInp rel_uw_q0p0234 12 0.00 1535.977 FORMAT "%8.3" AXIS_PTS_REF InjSys_ratAirM12AgSpHspVers2_AX /end AXIS_DESCR
/end CHARACTERISTIC
/begin CHARACTERISTIC InjSys_P1V4I2_HP.agBasHspLo_GM "injection packet 1 in variant 4 / base angle in homogenous-split mode for interpolation" MAP 0x8055C75C RB_MapGroup_U8 382.5 kw_q1p5 0.00 382.5 FORMAT "%5.1"
 /begin AXIS_DESCR COM_AXIS Epm_nEng EngN 12 0.00 16383.50 FORMAT "%8.2" EXTENDED_LIMITS -16384.00 16383.50 AXIS_PTS_REF InjSys_nEng12Hsp_AX /end AXIS_DESCR
 /begin AXIS_DESCR COM_AXIS InjSys_ratAirMAgSpAxisInp rel_uw_q0p0234 12 0.00 1535.977 FORMAT "%8.3" AXIS_PTS_REF InjSys_ratAirM12AgSpHsp_AX /end AXIS_DESCR
/end CHARACTERISTIC
/begin CHARACTERISTIC InjSys_P1V4I2_HP.agBasTPistColdVers2_GM "injection packet 1 in variant 4 / base angle at cold piston temperature (version 2)" MAP 0x8055C7EC RB_MapGroup_U8 382.5 kw_q1p5 0.00 382.5 FORMAT "%5.1"
 /begin AXIS_DESCR COM_AXIS Epm_nEng EngN 12 0.00 16383.50 FORMAT "%8.2" EXTENDED_LIMITS -16384.00 16383.50 AXIS_PTS_REF InjSys_nEng12Vers2_AX /end AXIS_DESCR
 /begin AXIS_DESCR COM_AXIS InjSys_ratAirMAgSpVers2AxisInp rel_uw_q0p0234 12 0.00 1535.977 FORMAT "%8.3" AXIS_PTS_REF InjSys_ratAirM12AgSpVers2_AX /end AXIS_DESCR
/end CHARACTERISTIC
/begin CHARACTERISTIC InjSys_P1V4I2_HP.agBasTPistCold_GM "injection packet 1 in variant 4 / base angle at cold piston temperature" MAP 0x8055C87C RB_MapGroup_U8 382.5 kw_q1p5 0.00 382.5 FORMAT "%5.1"
 /begin AXIS_DESCR COM_AXIS Epm_nEng EngN 12 0.00 16383.50 FORMAT "%8.2" EXTENDED_LIMITS -16384.00 16383.50 AXIS_PTS_REF InjSys_nEng12_AX /end AXIS_DESCR
 /begin AXIS_DESCR COM_AXIS InjSys_ratAirMAgSpAxisInp rel_uw_q0p0234 12 0.00 1535.977 FORMAT "%8.3" AXIS_PTS_REF InjSys_ratAirM12AgSp_AX /end AXIS_DESCR
/end CHARACTERISTIC
/begin CHARACTERISTIC InjSys_P1V4I2_HP.agBasTPistWrmVers2_GM "injection packet 1 in variant 4 / base angle for interpolation Warm TSA mode (Version 2)" MAP 0x8055C90C RB_MapGroup_U8 382.5 kw_q1p5 0.00 382.5 FORMAT "%5.1"
 /begin AXIS_DESCR COM_AXIS Epm_nEng EngN 12 0.00 16383.50 FORMAT "%8.2" EXTENDED_LIMITS -16384.00 16383.50 AXIS_PTS_REF InjSys_nEng12Vers2_AX /end AXIS_DESCR
 /begin AXIS_DESCR COM_AXIS InjSys_ratAirMAgSpVers2AxisInp rel_uw_q0p0234 12 0.00 1535.977 FORMAT "%8.3" AXIS_PTS_REF InjSys_ratAirM12AgSpVers2_AX /end AXIS_DESCR
/end CHARACTERISTIC
/begin CHARACTERISTIC InjSys_P1V4I2_HP.agBasTPistWrm_GM "injection packet 1 in variant 4 / base angle for interpolation Warm TSA mode" MAP 0x8055C99C RB_MapGroup_U8 382.5 kw_q1p5 0.00 382.5 FORMAT "%5.1"
 /begin AXIS_DESCR COM_AXIS Epm_nEng EngN 12 0.00 16383.50 FORMAT "%8.2" EXTENDED_LIMITS -16384.00 16383.50 AXIS_PTS_REF InjSys_nEng12_AX /end AXIS_DESCR
 /begin AXIS_DESCR COM_AXIS InjSys_ratAirMAgSpAxisInp rel_uw_q0p0234 12 0.00 1535.977 FORMAT "%8.3" AXIS_PTS_REF InjSys_ratAirM12AgSp_AX /end AXIS_DESCR
/end CHARACTERISTIC
/begin CHARACTERISTIC InjSys_P1V4I2_HP.agBgnColdExtdEthnl_GM "injection packet 1 in variant 4 / ." MAP 0x8055CA2C RB_MapGroup_U8 382.5 kw_q1p5 0.00 382.5 FORMAT "%5.1"
 /begin AXIS_DESCR COM_AXIS Epm_nEng EngN 12 0.00 16383.50 FORMAT "%8.2" EXTENDED_LIMITS -16384.00 16383.50 AXIS_PTS_REF InjSys_nEng12Hpx_AX /end AXIS_DESCR
 /begin AXIS_DESCR COM_AXIS InjSys_ratAirMAxisInp rel_uw_q0p0234 12 0.00 1535.977 FORMAT "%8.3" AXIS_PTS_REF InjSys_ratAirM12Hpx_AX /end AXIS_DESCR
/end CHARACTERISTIC
/begin CHARACTERISTIC InjSys_P1V4I2_HP.agBgnColdExtd_GM "injection packet 1 in variant 4 / ." MAP 0x8055CABC RB_MapGroup_U8 382.5 kw_q1p5 0.00 382.5 FORMAT "%5.1"
 /begin AXIS_DESCR COM_AXIS Epm_nEng EngN 12 0.00 16383.50 FORMAT "%8.2" EXTENDED_LIMITS -16384.00 16383.50 AXIS_PTS_REF InjSys_nEng12Hpx_AX /end AXIS_DESCR
 /begin AXIS_DESCR COM_AXIS InjSys_ratAirMAxisInp rel_uw_q0p0234 12 0.00 1535.977 FORMAT "%8.3" AXIS_PTS_REF InjSys_ratAirM12Hpx_AX /end AXIS_DESCR
/end CHARACTERISTIC
/begin CHARACTERISTIC InjSys_P1V4I2_HP.agBgnColdSmlVlvEthnl_GM "injection packet 1 in variant 4 / ." MAP 0x8055CB4C RB_MapGroup_U8 382.5 kw_q1p5 0.00 382.5 FORMAT "%5.1"
 /begin AXIS_DESCR COM_AXIS Epm_nEng EngN 12 0.00 16383.50 FORMAT "%8.2" EXTENDED_LIMITS -16384.00 16383.50 AXIS_PTS_REF InjSys_nEng12Hpx_AX /end AXIS_DESCR
 /begin AXIS_DESCR COM_AXIS InjSys_ratAirMAxisInp rel_uw_q0p0234 12 0.00 1535.977 FORMAT "%8.3" AXIS_PTS_REF InjSys_ratAirM12Hpx_AX /end AXIS_DESCR
/end CHARACTERISTIC
/begin CHARACTERISTIC InjSys_P1V4I2_HP.agBgnColdSmlVlv_GM "injection packet 1 in variant 4 / ." MAP 0x8055CBDC RB_MapGroup_U8 382.5 kw_q1p5 0.00 382.5 FORMAT "%5.1"
 /begin AXIS_DESCR COM_AXIS Epm_nEng EngN 12 0.00 16383.50 FORMAT "%8.2" EXTENDED_LIMITS -16384.00 16383.50 AXIS_PTS_REF InjSys_nEng12Hpx_AX /end AXIS_DESCR
 /begin AXIS_DESCR COM_AXIS InjSys_ratAirMAxisInp rel_uw_q0p0234 12 0.00 1535.977 FORMAT "%8.3" AXIS_PTS_REF InjSys_ratAirM12Hpx_AX /end AXIS_DESCR
/end CHARACTERISTIC
/begin CHARACTERISTIC InjSys_P1V4I2_HP.agBgnWrmExtdEthnl_GM "injection packet 1 in variant 4 / ." MAP 0x8055CC6C RB_MapGroup_U8 382.5 kw_q1p5 0.00 382.5 FORMAT "%5.1"
 /begin AXIS_DESCR COM_AXIS Epm_nEng EngN 12 0.00 16383.50 FORMAT "%8.2" EXTENDED_LIMITS -16384.00 16383.50 AXIS_PTS_REF InjSys_nEng12Hpx_AX /end AXIS_DESCR
 /begin AXIS_DESCR COM_AXIS InjSys_ratAirMAxisInp rel_uw_q0p0234 12 0.00 1535.977 FORMAT "%8.3" AXIS_PTS_REF InjSys_ratAirM12Hpx_AX /end AXIS_DESCR
/end CHARACTERISTIC
/begin CHARACTERISTIC InjSys_P1V4I2_HP.agBgnWrmExtd_GM "injection packet 1 in variant 4 / ." MAP 0x8055CCFC RB_MapGroup_U8 382.5 kw_q1p5 0.00 382.5 FORMAT "%5.1"
 /begin AXIS_DESCR COM_AXIS Epm_nEng EngN 12 0.00 16383.50 FORMAT "%8.2" EXTENDED_LIMITS -16384.00 16383.50 AXIS_PTS_REF InjSys_nEng12Hpx_AX /end AXIS_DESCR
 /begin AXIS_DESCR COM_AXIS InjSys_ratAirMAxisInp rel_uw_q0p0234 12 0.00 1535.977 FORMAT "%8.3" AXIS_PTS_REF InjSys_ratAirM12Hpx_AX /end AXIS_DESCR
/end CHARACTERISTIC
/begin CHARACTERISTIC InjSys_P1V4I2_HP.agBgnWrmSmlVlvEthnl_GM "injection packet 1 in variant 4 / ." MAP 0x8055CD8C RB_MapGroup_U8 382.5 kw_q1p5 0.00 382.5 FORMAT "%5.1"
 /begin AXIS_DESCR COM_AXIS Epm_nEng EngN 12 0.00 16383.50 FORMAT "%8.2" EXTENDED_LIMITS -16384.00 16383.50 AXIS_PTS_REF InjSys_nEng12Hpx_AX /end AXIS_DESCR
 /begin AXIS_DESCR COM_AXIS InjSys_ratAirMAxisInp rel_uw_q0p0234 12 0.00 1535.977 FORMAT "%8.3" AXIS_PTS_REF InjSys_ratAirM12Hpx_AX /end AXIS_DESCR
/end CHARACTERISTIC
/begin CHARACTERISTIC InjSys_P1V4I2_HP.agBgnWrmSmlVlv_GM "injection packet 1 in variant 4 / ." MAP 0x8055CE1C RB_MapGroup_U8 382.5 kw_q1p5 0.00 382.5 FORMAT "%5.1"
 /begin AXIS_DESCR COM_AXIS Epm_nEng EngN 12 0.00 16383.50 FORMAT "%8.2" EXTENDED_LIMITS -16384.00 16383.50 AXIS_PTS_REF InjSys_nEng12Hpx_AX /end AXIS_DESCR
 /begin AXIS_DESCR COM_AXIS InjSys_ratAirMAxisInp rel_uw_q0p0234 12 0.00 1535.977 FORMAT "%8.3" AXIS_PTS_REF InjSys_ratAirM12Hpx_AX /end AXIS_DESCR
/end CHARACTERISTIC
/begin CHARACTERISTIC InjSys_P1V4I2_HP.agDeltaEth_M "injection packet 1 in variant 4 / delta angle ethanol dependent" MAP 0x8055CEAC RB_Map_S16S16_S16 191.2500 kw_q0p75 -96.00000 95.25000 FORMAT "%8.5" EXTENDED_LIMITS -24576.00 24575.25
 /begin AXIS_DESCR STD_AXIS InjSys_facEthLnrLocSp fak_ub_b2 4 0.00 1.992188 FORMAT "%8.6" EXTENDED_LIMITS -256.0000 255.9922 DEPOSIT ABSOLUTE /end AXIS_DESCR
 /begin AXIS_DESCR STD_AXIS InjSys_tEng Temp_Cels 4 -3549.940 3003.560 FORMAT "%8.3" DEPOSIT ABSOLUTE /end AXIS_DESCR
/end CHARACTERISTIC
/begin CHARACTERISTIC InjSys_P1V4I2_HP.agDeltaLam_M "injection packet 1 in variant 4 / ." MAP 0x8055CEE0 RB_Map_S16U16_S16 191.2500 kw_q0p75 -96.00000 95.25000 FORMAT "%8.5" EXTENDED_LIMITS -24576.00 24575.25
 /begin AXIS_DESCR STD_AXIS Epm_nEng EngN 10 -16384.00 16383.50 FORMAT "%8.2" DEPOSIT ABSOLUTE /end AXIS_DESCR
 /begin AXIS_DESCR STD_AXIS InjSys_ratAirMPredLocSp kw_q0p0234 8 0.00 1535.977 FORMAT "%8.3" DEPOSIT ABSOLUTE /end AXIS_DESCR
/end CHARACTERISTIC
/begin CHARACTERISTIC InjSys_P1V4I2_HP.facAgBgnLam_T "injection packet 1 in variant 4 / ." CURVE 0x8055CFA8 RB_Curve_U8_U8 0.9961 fak_ub_b1 0.00 0.9961
 /begin AXIS_DESCR STD_AXIS InjSys_facLamBasLocSp fak_ub_b2 8 0.00 1.992188 FORMAT "%8.6" DEPOSIT ABSOLUTE /end AXIS_DESCR
/end CHARACTERISTIC
/begin CHARACTERISTIC InjSys_P1V4I2_HP.facEthnlAgBgn_T "injection packet 1 in variant 4 / ." CURVE 0x8055CFB9 RB_Curve_U8_U8 0.9961 fak_ub_b1 0.00 0.9961
 /begin AXIS_DESCR STD_AXIS fethstoeLocSp fak_ub_b2 4 0.00 1.992188 FORMAT "%8.6" DEPOSIT ABSOLUTE /end AXIS_DESCR
/end CHARACTERISTIC
/begin CHARACTERISTIC InjSys_P1V4I2_HP.facTPistCold_M "injection packet 1 in variant 4 / delta angle ethanol dependent" MAP 0x8055CFC2 RB_Map_S16S16_U8 0.9961 fak_ub_b1 0.00 0.9961
 /begin AXIS_DESCR STD_AXIS InjSys_tEng Temp_Cels 8 -3549.940 3003.560 FORMAT "%8.3" DEPOSIT ABSOLUTE /end AXIS_DESCR
 /begin AXIS_DESCR STD_AXIS InjSys_tOilLocSp Temp_Cels 8 -3549.940 3003.560 FORMAT "%8.3" DEPOSIT ABSOLUTE /end AXIS_DESCR
/end CHARACTERISTIC
/begin CHARACTERISTIC InjSys_P1V4I2_HP.facTPist_M "injection packet 1 in variant 4 / weighting factor base angle in homogenous-split mode temperature dependent" MAP 0x8055D026 RB_Map_S16S16_U8 0.9961 fak_ub_b1 0.00 0.9961
 /begin AXIS_DESCR STD_AXIS InjSys_tPistBas Temp_Cels 6 -3549.940 3003.560 FORMAT "%8.3" DEPOSIT ABSOLUTE /end AXIS_DESCR
 /begin AXIS_DESCR STD_AXIS InjSys_tPistDelta temp_q0p1 6 -3276.800 3276.700 FORMAT "%8.3" DEPOSIT ABSOLUTE /end AXIS_DESCR
/end CHARACTERISTIC
/begin CHARACTERISTIC InjSys_P1V4I2_HP.facWghtColdWrmEthnl_M "injection packet 1 in variant 4 / ." MAP 0x8055D066 RB_Map_S16S16_U8 0.9961 fak_ub_b1 0.00 0.9961
 /begin AXIS_DESCR STD_AXIS InjSys_tEng Temp_Cels 6 -3549.940 3003.560 FORMAT "%8.3" DEPOSIT ABSOLUTE /end AXIS_DESCR
 /begin AXIS_DESCR STD_AXIS InjSys_tOilLocSp Temp_Cels 4 -3549.940 3003.560 FORMAT "%8.3" DEPOSIT ABSOLUTE /end AXIS_DESCR
/end CHARACTERISTIC
/begin CHARACTERISTIC InjSys_P1V4I2_HP.facWghtColdWrm_M "injection packet 1 in variant 4 / ." MAP 0x8055D096 RB_Map_S16S16_U8 0.9961 fak_ub_b1 0.00 0.9961
 /begin AXIS_DESCR STD_AXIS InjSys_tEng Temp_Cels 6 -3549.940 3003.560 FORMAT "%8.3" DEPOSIT ABSOLUTE /end AXIS_DESCR
 /begin AXIS_DESCR STD_AXIS InjSys_tOilLocSp Temp_Cels 4 -3549.940 3003.560 FORMAT "%8.3" DEPOSIT ABSOLUTE /end AXIS_DESCR
/end CHARACTERISTIC
/begin CHARACTERISTIC InjSys_P1V4I2_HP.facWghtTHsp_M "injection packet 1 in variant 4 / weighting factor base angle in homogenous-split mode temperature dependent" MAP 0x8055D0C6 RB_Map_S16S16_U8 0.9961 fak_ub_b1 0.00 0.9961
 /begin AXIS_DESCR STD_AXIS InjSys_tEng Temp_Cels 6 -3549.940 3003.560 FORMAT "%8.3" DEPOSIT ABSOLUTE /end AXIS_DESCR
 /begin AXIS_DESCR STD_AXIS InjSys_tEngStrt Temp_Cels 4 -3549.940 3003.560 FORMAT "%8.3" DEPOSIT ABSOLUTE /end AXIS_DESCR
/end CHARACTERISTIC
/begin CHARACTERISTIC InjSys_P1V4I2_HP.facWhgtWrmColdHsp_GM "injection packet 1 in variant 4 / weighting factor warm-cold base angle in homogenous-split mode" MAP 0x8055D0F6 RB_MapGroup_U16 1.000000 fak_uw_b2 0.00 1.000000 FORMAT "%8.6" EXTENDED_LIMITS 0.00 1.999969
 /begin AXIS_DESCR COM_AXIS InjSys_tEngStrt Temp_Cels 8 -3549.940 3003.560 FORMAT "%8.3" AXIS_PTS_REF InjSys_tEngStrt08_AX /end AXIS_DESCR
 /begin AXIS_DESCR COM_AXIS InjSys_nrInjLimdLoc dez 4 0.00 65535.00 FORMAT "%8.2" AXIS_PTS_REF InjSys_nrInj04_AX /end AXIS_DESCR
/end CHARACTERISTIC
/begin CHARACTERISTIC InjSys_P1V4I2_HP.flgAxVers_C "injection packet 1 in variant 4 / condition map selection with group axis in version 2" VALUE 0x8055D136 RB_Val_Wu8 1.00000000000 B_TRUE 0.00 1.00000000000 FORMAT "%13.11" /end CHARACTERISTIC
/begin CHARACTERISTIC InjSys_P1V4I3_HP.agBasHspHiVers2_GM "injection packet 1 in variant 4 / base angle in homogenous-split mode for interpolation (version 2)" MAP 0x8055D13C RB_MapGroup_U8 382.5 kw_q1p5 0.00 382.5 FORMAT "%5.1"
 /begin AXIS_DESCR COM_AXIS Epm_nEng EngN 12 0.00 16383.50 FORMAT "%8.2" EXTENDED_LIMITS -16384.00 16383.50 AXIS_PTS_REF InjSys_nEng12HspVers2_AX /end AXIS_DESCR
 /begin AXIS_DESCR COM_AXIS InjSys_ratAirMAgSpVers2AxisInp rel_uw_q0p0234 12 0.00 1535.977 FORMAT "%8.3" AXIS_PTS_REF InjSys_ratAirM12AgSpHspVers2_AX /end AXIS_DESCR
/end CHARACTERISTIC
/begin CHARACTERISTIC InjSys_P1V4I3_HP.agBasHspHi_GM "injection packet 1 in variant 4 / base angle in homogenous-split mode for interpolation" MAP 0x8055D1CC RB_MapGroup_U8 382.5 kw_q1p5 0.00 382.5 FORMAT "%5.1"
 /begin AXIS_DESCR COM_AXIS Epm_nEng EngN 12 0.00 16383.50 FORMAT "%8.2" EXTENDED_LIMITS -16384.00 16383.50 AXIS_PTS_REF InjSys_nEng12Hsp_AX /end AXIS_DESCR
 /begin AXIS_DESCR COM_AXIS InjSys_ratAirMAgSpAxisInp rel_uw_q0p0234 12 0.00 1535.977 FORMAT "%8.3" AXIS_PTS_REF InjSys_ratAirM12AgSpHsp_AX /end AXIS_DESCR
/end CHARACTERISTIC
/begin CHARACTERISTIC InjSys_P1V4I3_HP.agBasHspLoVers2_GM "injection packet 1 in variant 4 / base angle in homogenous-split mode for interpolation (version 2)" MAP 0x8055D25C RB_MapGroup_U8 382.5 kw_q1p5 0.00 382.5 FORMAT "%5.1"
 /begin AXIS_DESCR COM_AXIS Epm_nEng EngN 12 0.00 16383.50 FORMAT "%8.2" EXTENDED_LIMITS -16384.00 16383.50 AXIS_PTS_REF InjSys_nEng12HspVers2_AX /end AXIS_DESCR
 /begin AXIS_DESCR COM_AXIS InjSys_ratAirMAgSpVers2AxisInp rel_uw_q0p0234 12 0.00 1535.977 FORMAT "%8.3" AXIS_PTS_REF InjSys_ratAirM12AgSpHspVers2_AX /end AXIS_DESCR
/end CHARACTERISTIC
/begin CHARACTERISTIC InjSys_P1V4I3_HP.agBasHspLo_GM "injection packet 1 in variant 4 / base angle in homogenous-split mode for interpolation" MAP 0x8055D2EC RB_MapGroup_U8 382.5 kw_q1p5 0.00 382.5 FORMAT "%5.1"
 /begin AXIS_DESCR COM_AXIS Epm_nEng EngN 12 0.00 16383.50 FORMAT "%8.2" EXTENDED_LIMITS -16384.00 16383.50 AXIS_PTS_REF InjSys_nEng12Hsp_AX /end AXIS_DESCR
 /begin AXIS_DESCR COM_AXIS InjSys_ratAirMAgSpAxisInp rel_uw_q0p0234 12 0.00 1535.977 FORMAT "%8.3" AXIS_PTS_REF InjSys_ratAirM12AgSpHsp_AX /end AXIS_DESCR
/end CHARACTERISTIC
/begin CHARACTERISTIC InjSys_P1V4I3_HP.agBasTPistColdVers2_GM "injection packet 1 in variant 4 / base angle at cold piston temperature (version 2)" MAP 0x8055D37C RB_MapGroup_U8 382.5 kw_q1p5 0.00 382.5 FORMAT "%5.1"
 /begin AXIS_DESCR COM_AXIS Epm_nEng EngN 12 0.00 16383.50 FORMAT "%8.2" EXTENDED_LIMITS -16384.00 16383.50 AXIS_PTS_REF InjSys_nEng12Vers2_AX /end AXIS_DESCR
 /begin AXIS_DESCR COM_AXIS InjSys_ratAirMAgSpVers2AxisInp rel_uw_q0p0234 12 0.00 1535.977 FORMAT "%8.3" AXIS_PTS_REF InjSys_ratAirM12AgSpVers2_AX /end AXIS_DESCR
/end CHARACTERISTIC
/begin CHARACTERISTIC InjSys_P1V4I3_HP.agBasTPistCold_GM "injection packet 1 in variant 4 / base angle at cold piston temperature" MAP 0x8055D40C RB_MapGroup_U8 382.5 kw_q1p5 0.00 382.5 FORMAT "%5.1"
 /begin AXIS_DESCR COM_AXIS Epm_nEng EngN 12 0.00 16383.50 FORMAT "%8.2" EXTENDED_LIMITS -16384.00 16383.50 AXIS_PTS_REF InjSys_nEng12_AX /end AXIS_DESCR
 /begin AXIS_DESCR COM_AXIS InjSys_ratAirMAgSpAxisInp rel_uw_q0p0234 12 0.00 1535.977 FORMAT "%8.3" AXIS_PTS_REF InjSys_ratAirM12AgSp_AX /end AXIS_DESCR
/end CHARACTERISTIC
/begin CHARACTERISTIC InjSys_P1V4I3_HP.agBasTPistWrmVers2_GM "injection packet 1 in variant 4 / base angle for interpolation Warm TSA mode (Version 2)" MAP 0x8055D49C RB_MapGroup_U8 382.5 kw_q1p5 0.00 382.5 FORMAT "%5.1"
 /begin AXIS_DESCR COM_AXIS Epm_nEng EngN 12 0.00 16383.50 FORMAT "%8.2" EXTENDED_LIMITS -16384.00 16383.50 AXIS_PTS_REF InjSys_nEng12Vers2_AX /end AXIS_DESCR
 /begin AXIS_DESCR COM_AXIS InjSys_ratAirMAgSpVers2AxisInp rel_uw_q0p0234 12 0.00 1535.977 FORMAT "%8.3" AXIS_PTS_REF InjSys_ratAirM12AgSpVers2_AX /end AXIS_DESCR
/end CHARACTERISTIC
/begin CHARACTERISTIC InjSys_P1V4I3_HP.agBasTPistWrm_GM "injection packet 1 in variant 4 / base angle for interpolation Warm TSA mode" MAP 0x8055D52C RB_MapGroup_U8 382.5 kw_q1p5 0.00 382.5 FORMAT "%5.1"
 /begin AXIS_DESCR COM_AXIS Epm_nEng EngN 12 0.00 16383.50 FORMAT "%8.2" EXTENDED_LIMITS -16384.00 16383.50 AXIS_PTS_REF InjSys_nEng12_AX /end AXIS_DESCR
 /begin AXIS_DESCR COM_AXIS InjSys_ratAirMAgSpAxisInp rel_uw_q0p0234 12 0.00 1535.977 FORMAT "%8.3" AXIS_PTS_REF InjSys_ratAirM12AgSp_AX /end AXIS_DESCR
/end CHARACTERISTIC
/begin CHARACTERISTIC InjSys_P1V4I3_HP.agBgnColdExtdEthnl_GM "injection packet 1 in variant 4 / ." MAP 0x8055D5BC RB_MapGroup_U8 382.5 kw_q1p5 0.00 382.5 FORMAT "%5.1"
 /begin AXIS_DESCR COM_AXIS Epm_nEng EngN 12 0.00 16383.50 FORMAT "%8.2" EXTENDED_LIMITS -16384.00 16383.50 AXIS_PTS_REF InjSys_nEng12Hpx_AX /end AXIS_DESCR
 /begin AXIS_DESCR COM_AXIS InjSys_ratAirMAxisInp rel_uw_q0p0234 12 0.00 1535.977 FORMAT "%8.3" AXIS_PTS_REF InjSys_ratAirM12Hpx_AX /end AXIS_DESCR
/end CHARACTERISTIC
/begin CHARACTERISTIC InjSys_P1V4I3_HP.agBgnColdExtd_GM "injection packet 1 in variant 4 / ." MAP 0x8055D64C RB_MapGroup_U8 382.5 kw_q1p5 0.00 382.5 FORMAT "%5.1"
 /begin AXIS_DESCR COM_AXIS Epm_nEng EngN 12 0.00 16383.50 FORMAT "%8.2" EXTENDED_LIMITS -16384.00 16383.50 AXIS_PTS_REF InjSys_nEng12Hpx_AX /end AXIS_DESCR
 /begin AXIS_DESCR COM_AXIS InjSys_ratAirMAxisInp rel_uw_q0p0234 12 0.00 1535.977 FORMAT "%8.3" AXIS_PTS_REF InjSys_ratAirM12Hpx_AX /end AXIS_DESCR
/end CHARACTERISTIC
/begin CHARACTERISTIC InjSys_P1V4I3_HP.agBgnColdSmlVlvEthnl_GM "injection packet 1 in variant 4 / ." MAP 0x8055D6DC RB_MapGroup_U8 382.5 kw_q1p5 0.00 382.5 FORMAT "%5.1"
 /begin AXIS_DESCR COM_AXIS Epm_nEng EngN 12 0.00 16383.50 FORMAT "%8.2" EXTENDED_LIMITS -16384.00 16383.50 AXIS_PTS_REF InjSys_nEng12Hpx_AX /end AXIS_DESCR
 /begin AXIS_DESCR COM_AXIS InjSys_ratAirMAxisInp rel_uw_q0p0234 12 0.00 1535.977 FORMAT "%8.3" AXIS_PTS_REF InjSys_ratAirM12Hpx_AX /end AXIS_DESCR
/end CHARACTERISTIC
/begin CHARACTERISTIC InjSys_P1V4I3_HP.agBgnColdSmlVlv_GM "injection packet 1 in variant 4 / ." MAP 0x8055D76C RB_MapGroup_U8 382.5 kw_q1p5 0.00 382.5 FORMAT "%5.1"
 /begin AXIS_DESCR COM_AXIS Epm_nEng EngN 12 0.00 16383.50 FORMAT "%8.2" EXTENDED_LIMITS -16384.00 16383.50 AXIS_PTS_REF InjSys_nEng12Hpx_AX /end AXIS_DESCR
 /begin AXIS_DESCR COM_AXIS InjSys_ratAirMAxisInp rel_uw_q0p0234 12 0.00 1535.977 FORMAT "%8.3" AXIS_PTS_REF InjSys_ratAirM12Hpx_AX /end AXIS_DESCR
/end CHARACTERISTIC
/begin CHARACTERISTIC InjSys_P1V4I3_HP.agBgnWrmExtdEthnl_GM "injection packet 1 in variant 4 / ." MAP 0x8055D7FC RB_MapGroup_U8 382.5 kw_q1p5 0.00 382.5 FORMAT "%5.1"
 /begin AXIS_DESCR COM_AXIS Epm_nEng EngN 12 0.00 16383.50 FORMAT "%8.2" EXTENDED_LIMITS -16384.00 16383.50 AXIS_PTS_REF InjSys_nEng12Hpx_AX /end AXIS_DESCR
 /begin AXIS_DESCR COM_AXIS InjSys_ratAirMAxisInp rel_uw_q0p0234 12 0.00 1535.977 FORMAT "%8.3" AXIS_PTS_REF InjSys_ratAirM12Hpx_AX /end AXIS_DESCR
/end CHARACTERISTIC
/begin CHARACTERISTIC InjSys_P1V4I3_HP.agBgnWrmExtd_GM "injection packet 1 in variant 4 / ." MAP 0x8055D88C RB_MapGroup_U8 382.5 kw_q1p5 0.00 382.5 FORMAT "%5.1"
 /begin AXIS_DESCR COM_AXIS Epm_nEng EngN 12 0.00 16383.50 FORMAT "%8.2" EXTENDED_LIMITS -16384.00 16383.50 AXIS_PTS_REF InjSys_nEng12Hpx_AX /end AXIS_DESCR
 /begin AXIS_DESCR COM_AXIS InjSys_ratAirMAxisInp rel_uw_q0p0234 12 0.00 1535.977 FORMAT "%8.3" AXIS_PTS_REF InjSys_ratAirM12Hpx_AX /end AXIS_DESCR
/end CHARACTERISTIC
/begin CHARACTERISTIC InjSys_P1V4I3_HP.agBgnWrmSmlVlvEthnl_GM "injection packet 1 in variant 4 / ." MAP 0x8055D91C RB_MapGroup_U8 382.5 kw_q1p5 0.00 382.5 FORMAT "%5.1"
 /begin AXIS_DESCR COM_AXIS Epm_nEng EngN 12 0.00 16383.50 FORMAT "%8.2" EXTENDED_LIMITS -16384.00 16383.50 AXIS_PTS_REF InjSys_nEng12Hpx_AX /end AXIS_DESCR
 /begin AXIS_DESCR COM_AXIS InjSys_ratAirMAxisInp rel_uw_q0p0234 12 0.00 1535.977 FORMAT "%8.3" AXIS_PTS_REF InjSys_ratAirM12Hpx_AX /end AXIS_DESCR
/end CHARACTERISTIC
/begin CHARACTERISTIC InjSys_P1V4I3_HP.agBgnWrmSmlVlv_GM "injection packet 1 in variant 4 / ." MAP 0x8055D9AC RB_MapGroup_U8 382.5 kw_q1p5 0.00 382.5 FORMAT "%5.1"
 /begin AXIS_DESCR COM_AXIS Epm_nEng EngN 12 0.00 16383.50 FORMAT "%8.2" EXTENDED_LIMITS -16384.00 16383.50 AXIS_PTS_REF InjSys_nEng12Hpx_AX /end AXIS_DESCR
 /begin AXIS_DESCR COM_AXIS InjSys_ratAirMAxisInp rel_uw_q0p0234 12 0.00 1535.977 FORMAT "%8.3" AXIS_PTS_REF InjSys_ratAirM12Hpx_AX /end AXIS_DESCR
/end CHARACTERISTIC
/begin CHARACTERISTIC InjSys_P1V4I3_HP.agDeltaEth_M "injection packet 1 in variant 4 / delta angle ethanol dependent" MAP 0x8055DA3C RB_Map_S16S16_S16 191.2500 kw_q0p75 -96.00000 95.25000 FORMAT "%8.5" EXTENDED_LIMITS -24576.00 24575.25
 /begin AXIS_DESCR STD_AXIS InjSys_facEthLnrLocSp fak_ub_b2 4 0.00 1.992188 FORMAT "%8.6" EXTENDED_LIMITS -256.0000 255.9922 DEPOSIT ABSOLUTE /end AXIS_DESCR
 /begin AXIS_DESCR STD_AXIS InjSys_tEng Temp_Cels 4 -3549.940 3003.560 FORMAT "%8.3" DEPOSIT ABSOLUTE /end AXIS_DESCR
/end CHARACTERISTIC
/begin CHARACTERISTIC InjSys_P1V4I3_HP.agDeltaLam_M "injection packet 1 in variant 4 / ." MAP 0x8055DA70 RB_Map_S16U16_S16 191.2500 kw_q0p75 -96.00000 95.25000 FORMAT "%8.5" EXTENDED_LIMITS -24576.00 24575.25
 /begin AXIS_DESCR STD_AXIS Epm_nEng EngN 10 -16384.00 16383.50 FORMAT "%8.2" DEPOSIT ABSOLUTE /end AXIS_DESCR
 /begin AXIS_DESCR STD_AXIS InjSys_ratAirMPredLocSp kw_q0p0234 8 0.00 1535.977 FORMAT "%8.3" DEPOSIT ABSOLUTE /end AXIS_DESCR
/end CHARACTERISTIC
/begin CHARACTERISTIC InjSys_P1V4I3_HP.facAgBgnLam_T "injection packet 1 in variant 4 / ." CURVE 0x8055DB38 RB_Curve_U8_U8 0.9961 fak_ub_b1 0.00 0.9961
 /begin AXIS_DESCR STD_AXIS InjSys_facLamBasLocSp fak_ub_b2 8 0.00 1.992188 FORMAT "%8.6" DEPOSIT ABSOLUTE /end AXIS_DESCR
/end CHARACTERISTIC
/begin CHARACTERISTIC InjSys_P1V4I3_HP.facEthnlAgBgn_T "injection packet 1 in variant 4 / ." CURVE 0x8055DB49 RB_Curve_U8_U8 0.9961 fak_ub_b1 0.00 0.9961
 /begin AXIS_DESCR STD_AXIS fethstoeLocSp fak_ub_b2 4 0.00 1.992188 FORMAT "%8.6" DEPOSIT ABSOLUTE /end AXIS_DESCR
/end CHARACTERISTIC
/begin CHARACTERISTIC InjSys_P1V4I3_HP.facTPistCold_M "injection packet 1 in variant 4 / delta angle ethanol dependent" MAP 0x8055DB52 RB_Map_S16S16_U8 0.9961 fak_ub_b1 0.00 0.9961
 /begin AXIS_DESCR STD_AXIS InjSys_tEng Temp_Cels 8 -3549.940 3003.560 FORMAT "%8.3" DEPOSIT ABSOLUTE /end AXIS_DESCR
 /begin AXIS_DESCR STD_AXIS InjSys_tOilLocSp Temp_Cels 8 -3549.940 3003.560 FORMAT "%8.3" DEPOSIT ABSOLUTE /end AXIS_DESCR
/end CHARACTERISTIC
/begin CHARACTERISTIC InjSys_P1V4I3_HP.facTPist_M "injection packet 1 in variant 4 / weighting factor base angle in homogenous-split mode temperature dependent" MAP 0x8055DBB6 RB_Map_S16S16_U8 0.9961 fak_ub_b1 0.00 0.9961
 /begin AXIS_DESCR STD_AXIS InjSys_tPistBas Temp_Cels 6 -3549.940 3003.560 FORMAT "%8.3" DEPOSIT ABSOLUTE /end AXIS_DESCR
 /begin AXIS_DESCR STD_AXIS InjSys_tPistDelta temp_q0p1 6 -3276.800 3276.700 FORMAT "%8.3" DEPOSIT ABSOLUTE /end AXIS_DESCR
/end CHARACTERISTIC
/begin CHARACTERISTIC InjSys_P1V4I3_HP.facWghtColdWrmEthnl_M "injection packet 1 in variant 4 / ." MAP 0x8055DBF6 RB_Map_S16S16_U8 0.9961 fak_ub_b1 0.00 0.9961
 /begin AXIS_DESCR STD_AXIS InjSys_tEng Temp_Cels 6 -3549.940 3003.560 FORMAT "%8.3" DEPOSIT ABSOLUTE /end AXIS_DESCR
 /begin AXIS_DESCR STD_AXIS InjSys_tOilLocSp Temp_Cels 4 -3549.940 3003.560 FORMAT "%8.3" DEPOSIT ABSOLUTE /end AXIS_DESCR
/end CHARACTERISTIC
/begin CHARACTERISTIC InjSys_P1V4I3_HP.facWghtColdWrm_M "injection packet 1 in variant 4 / ." MAP 0x8055DC26 RB_Map_S16S16_U8 0.9961 fak_ub_b1 0.00 0.9961
 /begin AXIS_DESCR STD_AXIS InjSys_tEng Temp_Cels 6 -3549.940 3003.560 FORMAT "%8.3" DEPOSIT ABSOLUTE /end AXIS_DESCR
 /begin AXIS_DESCR STD_AXIS InjSys_tOilLocSp Temp_Cels 4 -3549.940 3003.560 FORMAT "%8.3" DEPOSIT ABSOLUTE /end AXIS_DESCR
/end CHARACTERISTIC
/begin CHARACTERISTIC InjSys_P1V4I3_HP.facWghtTHsp_M "injection packet 1 in variant 4 / weighting factor base angle in homogenous-split mode temperature dependent" MAP 0x8055DC56 RB_Map_S16S16_U8 0.9961 fak_ub_b1 0.00 0.9961
 /begin AXIS_DESCR STD_AXIS InjSys_tEng Temp_Cels 6 -3549.940 3003.560 FORMAT "%8.3" DEPOSIT ABSOLUTE /end AXIS_DESCR
 /begin AXIS_DESCR STD_AXIS InjSys_tEngStrt Temp_Cels 4 -3549.940 3003.560 FORMAT "%8.3" DEPOSIT ABSOLUTE /end AXIS_DESCR
/end CHARACTERISTIC
/begin CHARACTERISTIC InjSys_P1V4I3_HP.facWhgtWrmColdHsp_GM "injection packet 1 in variant 4 / weighting factor warm-cold base angle in homogenous-split mode" MAP 0x8055DC86 RB_MapGroup_U16 1.000000 fak_uw_b2 0.00 1.000000 FORMAT "%8.6" EXTENDED_LIMITS 0.00 1.999969
 /begin AXIS_DESCR COM_AXIS InjSys_tEngStrt Temp_Cels 8 -3549.940 3003.560 FORMAT "%8.3" AXIS_PTS_REF InjSys_tEngStrt08_AX /end AXIS_DESCR
 /begin AXIS_DESCR COM_AXIS InjSys_nrInjLimdLoc dez 4 0.00 65535.00 FORMAT "%8.2" AXIS_PTS_REF InjSys_nrInj04_AX /end AXIS_DESCR
/end CHARACTERISTIC
/begin CHARACTERISTIC InjSys_P1V4I3_HP.flgAxVers_C "injection packet 1 in variant 4 / condition map selection with group axis in version 2" VALUE 0x8055DCC6 RB_Val_Wu8 1.00000000000 B_TRUE 0.00 1.00000000000 FORMAT "%13.11" /end CHARACTERISTIC
/begin CHARACTERISTIC InjSys_P1V4I4_HP.agBasHspHiVers2_GM "injection packet 1 in variant 4 / base angle in homogenous-split mode for interpolation (version 2)" MAP 0x8055DCCC RB_MapGroup_U8 382.5 kw_q1p5 0.00 382.5 FORMAT "%5.1"
 /begin AXIS_DESCR COM_AXIS Epm_nEng EngN 12 0.00 16383.50 FORMAT "%8.2" EXTENDED_LIMITS -16384.00 16383.50 AXIS_PTS_REF InjSys_nEng12HspVers2_AX /end AXIS_DESCR
 /begin AXIS_DESCR COM_AXIS InjSys_ratAirMAgSpVers2AxisInp rel_uw_q0p0234 12 0.00 1535.977 FORMAT "%8.3" AXIS_PTS_REF InjSys_ratAirM12AgSpHspVers2_AX /end AXIS_DESCR
/end CHARACTERISTIC
/begin CHARACTERISTIC InjSys_P1V4I4_HP.agBasHspHi_GM "injection packet 1 in variant 4 / base angle in homogenous-split mode for interpolation" MAP 0x8055DD5C RB_MapGroup_U8 382.5 kw_q1p5 0.00 382.5 FORMAT "%5.1"
 /begin AXIS_DESCR COM_AXIS Epm_nEng EngN 12 0.00 16383.50 FORMAT "%8.2" EXTENDED_LIMITS -16384.00 16383.50 AXIS_PTS_REF InjSys_nEng12Hsp_AX /end AXIS_DESCR
 /begin AXIS_DESCR COM_AXIS InjSys_ratAirMAgSpAxisInp rel_uw_q0p0234 12 0.00 1535.977 FORMAT "%8.3" AXIS_PTS_REF InjSys_ratAirM12AgSpHsp_AX /end AXIS_DESCR
/end CHARACTERISTIC
/begin CHARACTERISTIC InjSys_P1V4I4_HP.agBasHspLoVers2_GM "injection packet 1 in variant 4 / base angle in homogenous-split mode for interpolation (version 2)" MAP 0x8055DDEC RB_MapGroup_U8 382.5 kw_q1p5 0.00 382.5 FORMAT "%5.1"
 /begin AXIS_DESCR COM_AXIS Epm_nEng EngN 12 0.00 16383.50 FORMAT "%8.2" EXTENDED_LIMITS -16384.00 16383.50 AXIS_PTS_REF InjSys_nEng12HspVers2_AX /end AXIS_DESCR
 /begin AXIS_DESCR COM_AXIS InjSys_ratAirMAgSpVers2AxisInp rel_uw_q0p0234 12 0.00 1535.977 FORMAT "%8.3" AXIS_PTS_REF InjSys_ratAirM12AgSpHspVers2_AX /end AXIS_DESCR
/end CHARACTERISTIC
/begin CHARACTERISTIC InjSys_P1V4I4_HP.agBasHspLo_GM "injection packet 1 in variant 4 / base angle in homogenous-split mode for interpolation" MAP 0x8055DE7C RB_MapGroup_U8 382.5 kw_q1p5 0.00 382.5 FORMAT "%5.1"
 /begin AXIS_DESCR COM_AXIS Epm_nEng EngN 12 0.00 16383.50 FORMAT "%8.2" EXTENDED_LIMITS -16384.00 16383.50 AXIS_PTS_REF InjSys_nEng12Hsp_AX /end AXIS_DESCR
 /begin AXIS_DESCR COM_AXIS InjSys_ratAirMAgSpAxisInp rel_uw_q0p0234 12 0.00 1535.977 FORMAT "%8.3" AXIS_PTS_REF InjSys_ratAirM12AgSpHsp_AX /end AXIS_DESCR
/end CHARACTERISTIC
/begin CHARACTERISTIC InjSys_P1V4I4_HP.agBasTPistColdVers2_GM "injection packet 1 in variant 4 / base angle at cold piston temperature (version 2)" MAP 0x8055DF0C RB_MapGroup_U8 382.5 kw_q1p5 0.00 382.5 FORMAT "%5.1"
 /begin AXIS_DESCR COM_AXIS Epm_nEng EngN 12 0.00 16383.50 FORMAT "%8.2" EXTENDED_LIMITS -16384.00 16383.50 AXIS_PTS_REF InjSys_nEng12Vers2_AX /end AXIS_DESCR
 /begin AXIS_DESCR COM_AXIS InjSys_ratAirMAgSpVers2AxisInp rel_uw_q0p0234 12 0.00 1535.977 FORMAT "%8.3" AXIS_PTS_REF InjSys_ratAirM12AgSpVers2_AX /end AXIS_DESCR
/end CHARACTERISTIC
/begin CHARACTERISTIC InjSys_P1V4I4_HP.agBasTPistCold_GM "injection packet 1 in variant 4 / base angle at cold piston temperature" MAP 0x8055DF9C RB_MapGroup_U8 382.5 kw_q1p5 0.00 382.5 FORMAT "%5.1"
 /begin AXIS_DESCR COM_AXIS Epm_nEng EngN 12 0.00 16383.50 FORMAT "%8.2" EXTENDED_LIMITS -16384.00 16383.50 AXIS_PTS_REF InjSys_nEng12_AX /end AXIS_DESCR
 /begin AXIS_DESCR COM_AXIS InjSys_ratAirMAgSpAxisInp rel_uw_q0p0234 12 0.00 1535.977 FORMAT "%8.3" AXIS_PTS_REF InjSys_ratAirM12AgSp_AX /end AXIS_DESCR
/end CHARACTERISTIC
/begin CHARACTERISTIC InjSys_P1V4I4_HP.agBasTPistWrmVers2_GM "injection packet 1 in variant 4 / base angle for interpolation Warm TSA mode (Version 2)" MAP 0x8055E02C RB_MapGroup_U8 382.5 kw_q1p5 0.00 382.5 FORMAT "%5.1"
 /begin AXIS_DESCR COM_AXIS Epm_nEng EngN 12 0.00 16383.50 FORMAT "%8.2" EXTENDED_LIMITS -16384.00 16383.50 AXIS_PTS_REF InjSys_nEng12Vers2_AX /end AXIS_DESCR
 /begin AXIS_DESCR COM_AXIS InjSys_ratAirMAgSpVers2AxisInp rel_uw_q0p0234 12 0.00 1535.977 FORMAT "%8.3" AXIS_PTS_REF InjSys_ratAirM12AgSpVers2_AX /end AXIS_DESCR
/end CHARACTERISTIC
/begin CHARACTERISTIC InjSys_P1V4I4_HP.agBasTPistWrm_GM "injection packet 1 in variant 4 / base angle for interpolation Warm TSA mode" MAP 0x8055E0BC RB_MapGroup_U8 382.5 kw_q1p5 0.00 382.5 FORMAT "%5.1"
 /begin AXIS_DESCR COM_AXIS Epm_nEng EngN 12 0.00 16383.50 FORMAT "%8.2" EXTENDED_LIMITS -16384.00 16383.50 AXIS_PTS_REF InjSys_nEng12_AX /end AXIS_DESCR
 /begin AXIS_DESCR COM_AXIS InjSys_ratAirMAgSpAxisInp rel_uw_q0p0234 12 0.00 1535.977 FORMAT "%8.3" AXIS_PTS_REF InjSys_ratAirM12AgSp_AX /end AXIS_DESCR
/end CHARACTERISTIC
/begin CHARACTERISTIC InjSys_P1V4I4_HP.agBgnColdExtdEthnl_GM "injection packet 1 in variant 4 / ." MAP 0x8055E14C RB_MapGroup_U8 382.5 kw_q1p5 0.00 382.5 FORMAT "%5.1"
 /begin AXIS_DESCR COM_AXIS Epm_nEng EngN 12 0.00 16383.50 FORMAT "%8.2" EXTENDED_LIMITS -16384.00 16383.50 AXIS_PTS_REF InjSys_nEng12Hpx_AX /end AXIS_DESCR
 /begin AXIS_DESCR COM_AXIS InjSys_ratAirMAxisInp rel_uw_q0p0234 12 0.00 1535.977 FORMAT "%8.3" AXIS_PTS_REF InjSys_ratAirM12Hpx_AX /end AXIS_DESCR
/end CHARACTERISTIC
/begin CHARACTERISTIC InjSys_P1V4I4_HP.agBgnColdExtd_GM "injection packet 1 in variant 4 / ." MAP 0x8055E1DC RB_MapGroup_U8 382.5 kw_q1p5 0.00 382.5 FORMAT "%5.1"
 /begin AXIS_DESCR COM_AXIS Epm_nEng EngN 12 0.00 16383.50 FORMAT "%8.2" EXTENDED_LIMITS -16384.00 16383.50 AXIS_PTS_REF InjSys_nEng12Hpx_AX /end AXIS_DESCR
 /begin AXIS_DESCR COM_AXIS InjSys_ratAirMAxisInp rel_uw_q0p0234 12 0.00 1535.977 FORMAT "%8.3" AXIS_PTS_REF InjSys_ratAirM12Hpx_AX /end AXIS_DESCR
/end CHARACTERISTIC
/begin CHARACTERISTIC InjSys_P1V4I4_HP.agBgnColdSmlVlvEthnl_GM "injection packet 1 in variant 4 / ." MAP 0x8055E26C RB_MapGroup_U8 382.5 kw_q1p5 0.00 382.5 FORMAT "%5.1"
 /begin AXIS_DESCR COM_AXIS Epm_nEng EngN 12 0.00 16383.50 FORMAT "%8.2" EXTENDED_LIMITS -16384.00 16383.50 AXIS_PTS_REF InjSys_nEng12Hpx_AX /end AXIS_DESCR
 /begin AXIS_DESCR COM_AXIS InjSys_ratAirMAxisInp rel_uw_q0p0234 12 0.00 1535.977 FORMAT "%8.3" AXIS_PTS_REF InjSys_ratAirM12Hpx_AX /end AXIS_DESCR
/end CHARACTERISTIC
/begin CHARACTERISTIC InjSys_P1V4I4_HP.agBgnColdSmlVlv_GM "injection packet 1 in variant 4 / ." MAP 0x8055E2FC RB_MapGroup_U8 382.5 kw_q1p5 0.00 382.5 FORMAT "%5.1"
 /begin AXIS_DESCR COM_AXIS Epm_nEng EngN 12 0.00 16383.50 FORMAT "%8.2" EXTENDED_LIMITS -16384.00 16383.50 AXIS_PTS_REF InjSys_nEng12Hpx_AX /end AXIS_DESCR
 /begin AXIS_DESCR COM_AXIS InjSys_ratAirMAxisInp rel_uw_q0p0234 12 0.00 1535.977 FORMAT "%8.3" AXIS_PTS_REF InjSys_ratAirM12Hpx_AX /end AXIS_DESCR
/end CHARACTERISTIC
/begin CHARACTERISTIC InjSys_P1V4I4_HP.agBgnWrmExtdEthnl_GM "injection packet 1 in variant 4 / ." MAP 0x8055E38C RB_MapGroup_U8 382.5 kw_q1p5 0.00 382.5 FORMAT "%5.1"
 /begin AXIS_DESCR COM_AXIS Epm_nEng EngN 12 0.00 16383.50 FORMAT "%8.2" EXTENDED_LIMITS -16384.00 16383.50 AXIS_PTS_REF InjSys_nEng12Hpx_AX /end AXIS_DESCR
 /begin AXIS_DESCR COM_AXIS InjSys_ratAirMAxisInp rel_uw_q0p0234 12 0.00 1535.977 FORMAT "%8.3" AXIS_PTS_REF InjSys_ratAirM12Hpx_AX /end AXIS_DESCR
/end CHARACTERISTIC
/begin CHARACTERISTIC InjSys_P1V4I4_HP.agBgnWrmExtd_GM "injection packet 1 in variant 4 / ." MAP 0x8055E41C RB_MapGroup_U8 382.5 kw_q1p5 0.00 382.5 FORMAT "%5.1"
 /begin AXIS_DESCR COM_AXIS Epm_nEng EngN 12 0.00 16383.50 FORMAT "%8.2" EXTENDED_LIMITS -16384.00 16383.50 AXIS_PTS_REF InjSys_nEng12Hpx_AX /end AXIS_DESCR
 /begin AXIS_DESCR COM_AXIS InjSys_ratAirMAxisInp rel_uw_q0p0234 12 0.00 1535.977 FORMAT "%8.3" AXIS_PTS_REF InjSys_ratAirM12Hpx_AX /end AXIS_DESCR
/end CHARACTERISTIC
/begin CHARACTERISTIC InjSys_P1V4I4_HP.agBgnWrmSmlVlvEthnl_GM "injection packet 1 in variant 4 / ." MAP 0x8055E4AC RB_MapGroup_U8 382.5 kw_q1p5 0.00 382.5 FORMAT "%5.1"
 /begin AXIS_DESCR COM_AXIS Epm_nEng EngN 12 0.00 16383.50 FORMAT "%8.2" EXTENDED_LIMITS -16384.00 16383.50 AXIS_PTS_REF InjSys_nEng12Hpx_AX /end AXIS_DESCR
 /begin AXIS_DESCR COM_AXIS InjSys_ratAirMAxisInp rel_uw_q0p0234 12 0.00 1535.977 FORMAT "%8.3" AXIS_PTS_REF InjSys_ratAirM12Hpx_AX /end AXIS_DESCR
/end CHARACTERISTIC
/begin CHARACTERISTIC InjSys_P1V4I4_HP.agBgnWrmSmlVlv_GM "injection packet 1 in variant 4 / ." MAP 0x8055E53C RB_MapGroup_U8 382.5 kw_q1p5 0.00 382.5 FORMAT "%5.1"
 /begin AXIS_DESCR COM_AXIS Epm_nEng EngN 12 0.00 16383.50 FORMAT "%8.2" EXTENDED_LIMITS -16384.00 16383.50 AXIS_PTS_REF InjSys_nEng12Hpx_AX /end AXIS_DESCR
 /begin AXIS_DESCR COM_AXIS InjSys_ratAirMAxisInp rel_uw_q0p0234 12 0.00 1535.977 FORMAT "%8.3" AXIS_PTS_REF InjSys_ratAirM12Hpx_AX /end AXIS_DESCR
/end CHARACTERISTIC
/begin CHARACTERISTIC InjSys_P1V4I4_HP.agDeltaEth_M "injection packet 1 in variant 4 / delta angle ethanol dependent" MAP 0x8055E5CC RB_Map_S16S16_S16 191.2500 kw_q0p75 -96.00000 95.25000 FORMAT "%8.5" EXTENDED_LIMITS -24576.00 24575.25
 /begin AXIS_DESCR STD_AXIS InjSys_facEthLnrLocSp fak_ub_b2 4 0.00 1.992188 FORMAT "%8.6" EXTENDED_LIMITS -256.0000 255.9922 DEPOSIT ABSOLUTE /end AXIS_DESCR
 /begin AXIS_DESCR STD_AXIS InjSys_tEng Temp_Cels 4 -3549.940 3003.560 FORMAT "%8.3" DEPOSIT ABSOLUTE /end AXIS_DESCR
/end CHARACTERISTIC
/begin CHARACTERISTIC InjSys_P1V4I4_HP.agDeltaLam_M "injection packet 1 in variant 4 / ." MAP 0x8055E600 RB_Map_S16U16_S16 191.2500 kw_q0p75 -96.00000 95.25000 FORMAT "%8.5" EXTENDED_LIMITS -24576.00 24575.25
 /begin AXIS_DESCR STD_AXIS Epm_nEng EngN 10 -16384.00 16383.50 FORMAT "%8.2" DEPOSIT ABSOLUTE /end AXIS_DESCR
 /begin AXIS_DESCR STD_AXIS InjSys_ratAirMPredLocSp kw_q0p0234 8 0.00 1535.977 FORMAT "%8.3" DEPOSIT ABSOLUTE /end AXIS_DESCR
/end CHARACTERISTIC
/begin CHARACTERISTIC InjSys_P1V4I4_HP.facAgBgnLam_T "injection packet 1 in variant 4 / ." CURVE 0x8055E6C8 RB_Curve_U8_U8 0.9961 fak_ub_b1 0.00 0.9961
 /begin AXIS_DESCR STD_AXIS InjSys_facLamBasLocSp fak_ub_b2 8 0.00 1.992188 FORMAT "%8.6" DEPOSIT ABSOLUTE /end AXIS_DESCR
/end CHARACTERISTIC
/begin CHARACTERISTIC InjSys_P1V4I4_HP.facEthnlAgBgn_T "injection packet 1 in variant 4 / ." CURVE 0x8055E6D9 RB_Curve_U8_U8 0.9961 fak_ub_b1 0.00 0.9961
 /begin AXIS_DESCR STD_AXIS fethstoeLocSp fak_ub_b2 4 0.00 1.992188 FORMAT "%8.6" DEPOSIT ABSOLUTE /end AXIS_DESCR
/end CHARACTERISTIC
/begin CHARACTERISTIC InjSys_P1V4I4_HP.facTPistCold_M "injection packet 1 in variant 4 / delta angle ethanol dependent" MAP 0x8055E6E2 RB_Map_S16S16_U8 0.9961 fak_ub_b1 0.00 0.9961
 /begin AXIS_DESCR STD_AXIS InjSys_tEng Temp_Cels 8 -3549.940 3003.560 FORMAT "%8.3" DEPOSIT ABSOLUTE /end AXIS_DESCR
 /begin AXIS_DESCR STD_AXIS InjSys_tOilLocSp Temp_Cels 8 -3549.940 3003.560 FORMAT "%8.3" DEPOSIT ABSOLUTE /end AXIS_DESCR
/end CHARACTERISTIC
/begin CHARACTERISTIC InjSys_P1V4I4_HP.facTPist_M "injection packet 1 in variant 4 / weighting factor base angle in homogenous-split mode temperature dependent" MAP 0x8055E746 RB_Map_S16S16_U8 0.9961 fak_ub_b1 0.00 0.9961
 /begin AXIS_DESCR STD_AXIS InjSys_tPistBas Temp_Cels 6 -3549.940 3003.560 FORMAT "%8.3" DEPOSIT ABSOLUTE /end AXIS_DESCR
 /begin AXIS_DESCR STD_AXIS InjSys_tPistDelta temp_q0p1 6 -3276.800 3276.700 FORMAT "%8.3" DEPOSIT ABSOLUTE /end AXIS_DESCR
/end CHARACTERISTIC
/begin CHARACTERISTIC InjSys_P1V4I4_HP.facWghtColdWrmEthnl_M "injection packet 1 in variant 4 / ." MAP 0x8055E786 RB_Map_S16S16_U8 0.9961 fak_ub_b1 0.00 0.9961
 /begin AXIS_DESCR STD_AXIS InjSys_tEng Temp_Cels 6 -3549.940 3003.560 FORMAT "%8.3" DEPOSIT ABSOLUTE /end AXIS_DESCR
 /begin AXIS_DESCR STD_AXIS InjSys_tOilLocSp Temp_Cels 4 -3549.940 3003.560 FORMAT "%8.3" DEPOSIT ABSOLUTE /end AXIS_DESCR
/end CHARACTERISTIC
/begin CHARACTERISTIC InjSys_P1V4I4_HP.facWghtColdWrm_M "injection packet 1 in variant 4 / ." MAP 0x8055E7B6 RB_Map_S16S16_U8 0.9961 fak_ub_b1 0.00 0.9961
 /begin AXIS_DESCR STD_AXIS InjSys_tEng Temp_Cels 6 -3549.940 3003.560 FORMAT "%8.3" DEPOSIT ABSOLUTE /end AXIS_DESCR
 /begin AXIS_DESCR STD_AXIS InjSys_tOilLocSp Temp_Cels 4 -3549.940 3003.560 FORMAT "%8.3" DEPOSIT ABSOLUTE /end AXIS_DESCR
/end CHARACTERISTIC
/begin CHARACTERISTIC InjSys_P1V4I4_HP.facWghtTHsp_M "injection packet 1 in variant 4 / weighting factor base angle in homogenous-split mode temperature dependent" MAP 0x8055E7E6 RB_Map_S16S16_U8 0.9961 fak_ub_b1 0.00 0.9961
 /begin AXIS_DESCR STD_AXIS InjSys_tEng Temp_Cels 6 -3549.940 3003.560 FORMAT "%8.3" DEPOSIT ABSOLUTE /end AXIS_DESCR
 /begin AXIS_DESCR STD_AXIS InjSys_tEngStrt Temp_Cels 4 -3549.940 3003.560 FORMAT "%8.3" DEPOSIT ABSOLUTE /end AXIS_DESCR
/end CHARACTERISTIC
/begin CHARACTERISTIC InjSys_P1V4I4_HP.facWhgtWrmColdHsp_GM "injection packet 1 in variant 4 / weighting factor warm-cold base angle in homogenous-split mode" MAP 0x8055E816 RB_MapGroup_U16 1.000000 fak_uw_b2 0.00 1.000000 FORMAT "%8.6" EXTENDED_LIMITS 0.00 1.999969
 /begin AXIS_DESCR COM_AXIS InjSys_tEngStrt Temp_Cels 8 -3549.940 3003.560 FORMAT "%8.3" AXIS_PTS_REF InjSys_tEngStrt08_AX /end AXIS_DESCR
 /begin AXIS_DESCR COM_AXIS InjSys_nrInjLimdLoc dez 4 0.00 65535.00 FORMAT "%8.2" AXIS_PTS_REF InjSys_nrInj04_AX /end AXIS_DESCR
/end CHARACTERISTIC
/begin CHARACTERISTIC InjSys_P1V4I4_HP.flgAxVers_C "injection packet 1 in variant 4 / condition map selection with group axis in version 2" VALUE 0x8055E856 RB_Val_Wu8 1.00000000000 B_TRUE 0.00 1.00000000000 FORMAT "%13.11" /end CHARACTERISTIC
/begin CHARACTERISTIC InjSys_P1V4I5_HP.agBasHspHiVers2_GM "injection packet 1 in variant 4 / base angle in homogenous-split mode for interpolation (version 2)" MAP 0x8055E85C RB_MapGroup_U8 382.5 kw_q1p5 0.00 382.5 FORMAT "%5.1"
 /begin AXIS_DESCR COM_AXIS Epm_nEng EngN 12 0.00 16383.50 FORMAT "%8.2" EXTENDED_LIMITS -16384.00 16383.50 AXIS_PTS_REF InjSys_nEng12HspVers2_AX /end AXIS_DESCR
 /begin AXIS_DESCR COM_AXIS InjSys_ratAirMAgSpVers2AxisInp rel_uw_q0p0234 12 0.00 1535.977 FORMAT "%8.3" AXIS_PTS_REF InjSys_ratAirM12AgSpHspVers2_AX /end AXIS_DESCR
/end CHARACTERISTIC
/begin CHARACTERISTIC InjSys_P1V4I5_HP.agBasHspHi_GM "injection packet 1 in variant 4 / base angle in homogenous-split mode for interpolation" MAP 0x8055E8EC RB_MapGroup_U8 382.5 kw_q1p5 0.00 382.5 FORMAT "%5.1"
 /begin AXIS_DESCR COM_AXIS Epm_nEng EngN 12 0.00 16383.50 FORMAT "%8.2" EXTENDED_LIMITS -16384.00 16383.50 AXIS_PTS_REF InjSys_nEng12Hsp_AX /end AXIS_DESCR
 /begin AXIS_DESCR COM_AXIS InjSys_ratAirMAgSpAxisInp rel_uw_q0p0234 12 0.00 1535.977 FORMAT "%8.3" AXIS_PTS_REF InjSys_ratAirM12AgSpHsp_AX /end AXIS_DESCR
/end CHARACTERISTIC
/begin CHARACTERISTIC InjSys_P1V4I5_HP.agBasHspLoVers2_GM "injection packet 1 in variant 4 / base angle in homogenous-split mode for interpolation (version 2)" MAP 0x8055E97C RB_MapGroup_U8 382.5 kw_q1p5 0.00 382.5 FORMAT "%5.1"
 /begin AXIS_DESCR COM_AXIS Epm_nEng EngN 12 0.00 16383.50 FORMAT "%8.2" EXTENDED_LIMITS -16384.00 16383.50 AXIS_PTS_REF InjSys_nEng12HspVers2_AX /end AXIS_DESCR
 /begin AXIS_DESCR COM_AXIS InjSys_ratAirMAgSpVers2AxisInp rel_uw_q0p0234 12 0.00 1535.977 FORMAT "%8.3" AXIS_PTS_REF InjSys_ratAirM12AgSpHspVers2_AX /end AXIS_DESCR
/end CHARACTERISTIC
/begin CHARACTERISTIC InjSys_P1V4I5_HP.agBasHspLo_GM "injection packet 1 in variant 4 / base angle in homogenous-split mode for interpolation" MAP 0x8055EA0C RB_MapGroup_U8 382.5 kw_q1p5 0.00 382.5 FORMAT "%5.1"
 /begin AXIS_DESCR COM_AXIS Epm_nEng EngN 12 0.00 16383.50 FORMAT "%8.2" EXTENDED_LIMITS -16384.00 16383.50 AXIS_PTS_REF InjSys_nEng12Hsp_AX /end AXIS_DESCR
 /begin AXIS_DESCR COM_AXIS InjSys_ratAirMAgSpAxisInp rel_uw_q0p0234 12 0.00 1535.977 FORMAT "%8.3" AXIS_PTS_REF InjSys_ratAirM12AgSpHsp_AX /end AXIS_DESCR
/end CHARACTERISTIC
/begin CHARACTERISTIC InjSys_P1V4I5_HP.agBasTPistColdVers2_GM "injection packet 1 in variant 4 / base angle at cold piston temperature (version 2)" MAP 0x8055EA9C RB_MapGroup_U8 382.5 kw_q1p5 0.00 382.5 FORMAT "%5.1"
 /begin AXIS_DESCR COM_AXIS Epm_nEng EngN 12 0.00 16383.50 FORMAT "%8.2" EXTENDED_LIMITS -16384.00 16383.50 AXIS_PTS_REF InjSys_nEng12Vers2_AX /end AXIS_DESCR
 /begin AXIS_DESCR COM_AXIS InjSys_ratAirMAgSpVers2AxisInp rel_uw_q0p0234 12 0.00 1535.977 FORMAT "%8.3" AXIS_PTS_REF InjSys_ratAirM12AgSpVers2_AX /end AXIS_DESCR
/end CHARACTERISTIC
/begin CHARACTERISTIC InjSys_P1V4I5_HP.agBasTPistCold_GM "injection packet 1 in variant 4 / base angle at cold piston temperature" MAP 0x8055EB2C RB_MapGroup_U8 382.5 kw_q1p5 0.00 382.5 FORMAT "%5.1"
 /begin AXIS_DESCR COM_AXIS Epm_nEng EngN 12 0.00 16383.50 FORMAT "%8.2" EXTENDED_LIMITS -16384.00 16383.50 AXIS_PTS_REF InjSys_nEng12_AX /end AXIS_DESCR
 /begin AXIS_DESCR COM_AXIS InjSys_ratAirMAgSpAxisInp rel_uw_q0p0234 12 0.00 1535.977 FORMAT "%8.3" AXIS_PTS_REF InjSys_ratAirM12AgSp_AX /end AXIS_DESCR
/end CHARACTERISTIC
/begin CHARACTERISTIC InjSys_P1V4I5_HP.agBasTPistWrmVers2_GM "injection packet 1 in variant 4 / base angle for interpolation Warm TSA mode (Version 2)" MAP 0x8055EBBC RB_MapGroup_U8 382.5 kw_q1p5 0.00 382.5 FORMAT "%5.1"
 /begin AXIS_DESCR COM_AXIS Epm_nEng EngN 12 0.00 16383.50 FORMAT "%8.2" EXTENDED_LIMITS -16384.00 16383.50 AXIS_PTS_REF InjSys_nEng12Vers2_AX /end AXIS_DESCR
 /begin AXIS_DESCR COM_AXIS InjSys_ratAirMAgSpVers2AxisInp rel_uw_q0p0234 12 0.00 1535.977 FORMAT "%8.3" AXIS_PTS_REF InjSys_ratAirM12AgSpVers2_AX /end AXIS_DESCR
/end CHARACTERISTIC
/begin CHARACTERISTIC InjSys_P1V4I5_HP.agBasTPistWrm_GM "injection packet 1 in variant 4 / base angle for interpolation Warm TSA mode" MAP 0x8055EC4C RB_MapGroup_U8 382.5 kw_q1p5 0.00 382.5 FORMAT "%5.1"
 /begin AXIS_DESCR COM_AXIS Epm_nEng EngN 12 0.00 16383.50 FORMAT "%8.2" EXTENDED_LIMITS -16384.00 16383.50 AXIS_PTS_REF InjSys_nEng12_AX /end AXIS_DESCR
 /begin AXIS_DESCR COM_AXIS InjSys_ratAirMAgSpAxisInp rel_uw_q0p0234 12 0.00 1535.977 FORMAT "%8.3" AXIS_PTS_REF InjSys_ratAirM12AgSp_AX /end AXIS_DESCR
/end CHARACTERISTIC
/begin CHARACTERISTIC InjSys_P1V4I5_HP.agBgnColdExtdEthnl_GM "injection packet 1 in variant 4 / ." MAP 0x8055ECDC RB_MapGroup_U8 382.5 kw_q1p5 0.00 382.5 FORMAT "%5.1"
 /begin AXIS_DESCR COM_AXIS Epm_nEng EngN 12 0.00 16383.50 FORMAT "%8.2" EXTENDED_LIMITS -16384.00 16383.50 AXIS_PTS_REF InjSys_nEng12Hpx_AX /end AXIS_DESCR
 /begin AXIS_DESCR COM_AXIS InjSys_ratAirMAxisInp rel_uw_q0p0234 12 0.00 1535.977 FORMAT "%8.3" AXIS_PTS_REF InjSys_ratAirM12Hpx_AX /end AXIS_DESCR
/end CHARACTERISTIC
/begin CHARACTERISTIC InjSys_P1V4I5_HP.agBgnColdExtd_GM "injection packet 1 in variant 4 / ." MAP 0x8055ED6C RB_MapGroup_U8 382.5 kw_q1p5 0.00 382.5 FORMAT "%5.1"
 /begin AXIS_DESCR COM_AXIS Epm_nEng EngN 12 0.00 16383.50 FORMAT "%8.2" EXTENDED_LIMITS -16384.00 16383.50 AXIS_PTS_REF InjSys_nEng12Hpx_AX /end AXIS_DESCR
 /begin AXIS_DESCR COM_AXIS InjSys_ratAirMAxisInp rel_uw_q0p0234 12 0.00 1535.977 FORMAT "%8.3" AXIS_PTS_REF InjSys_ratAirM12Hpx_AX /end AXIS_DESCR
/end CHARACTERISTIC
/begin CHARACTERISTIC InjSys_P1V4I5_HP.agBgnColdSmlVlvEthnl_GM "injection packet 1 in variant 4 / ." MAP 0x8055EDFC RB_MapGroup_U8 382.5 kw_q1p5 0.00 382.5 FORMAT "%5.1"
 /begin AXIS_DESCR COM_AXIS Epm_nEng EngN 12 0.00 16383.50 FORMAT "%8.2" EXTENDED_LIMITS -16384.00 16383.50 AXIS_PTS_REF InjSys_nEng12Hpx_AX /end AXIS_DESCR
 /begin AXIS_DESCR COM_AXIS InjSys_ratAirMAxisInp rel_uw_q0p0234 12 0.00 1535.977 FORMAT "%8.3" AXIS_PTS_REF InjSys_ratAirM12Hpx_AX /end AXIS_DESCR
/end CHARACTERISTIC
/begin CHARACTERISTIC InjSys_P1V4I5_HP.agBgnColdSmlVlv_GM "injection packet 1 in variant 4 / ." MAP 0x8055EE8C RB_MapGroup_U8 382.5 kw_q1p5 0.00 382.5 FORMAT "%5.1"
 /begin AXIS_DESCR COM_AXIS Epm_nEng EngN 12 0.00 16383.50 FORMAT "%8.2" EXTENDED_LIMITS -16384.00 16383.50 AXIS_PTS_REF InjSys_nEng12Hpx_AX /end AXIS_DESCR
 /begin AXIS_DESCR COM_AXIS InjSys_ratAirMAxisInp rel_uw_q0p0234 12 0.00 1535.977 FORMAT "%8.3" AXIS_PTS_REF InjSys_ratAirM12Hpx_AX /end AXIS_DESCR
/end CHARACTERISTIC
/begin CHARACTERISTIC InjSys_P1V4I5_HP.agBgnWrmExtdEthnl_GM "injection packet 1 in variant 4 / ." MAP 0x8055EF1C RB_MapGroup_U8 382.5 kw_q1p5 0.00 382.5 FORMAT "%5.1"
 /begin AXIS_DESCR COM_AXIS Epm_nEng EngN 12 0.00 16383.50 FORMAT "%8.2" EXTENDED_LIMITS -16384.00 16383.50 AXIS_PTS_REF InjSys_nEng12Hpx_AX /end AXIS_DESCR
 /begin AXIS_DESCR COM_AXIS InjSys_ratAirMAxisInp rel_uw_q0p0234 12 0.00 1535.977 FORMAT "%8.3" AXIS_PTS_REF InjSys_ratAirM12Hpx_AX /end AXIS_DESCR
/end CHARACTERISTIC
/begin CHARACTERISTIC InjSys_P1V4I5_HP.agBgnWrmExtd_GM "injection packet 1 in variant 4 / ." MAP 0x8055EFAC RB_MapGroup_U8 382.5 kw_q1p5 0.00 382.5 FORMAT "%5.1"
 /begin AXIS_DESCR COM_AXIS Epm_nEng EngN 12 0.00 16383.50 FORMAT "%8.2" EXTENDED_LIMITS -16384.00 16383.50 AXIS_PTS_REF InjSys_nEng12Hpx_AX /end AXIS_DESCR
 /begin AXIS_DESCR COM_AXIS InjSys_ratAirMAxisInp rel_uw_q0p0234 12 0.00 1535.977 FORMAT "%8.3" AXIS_PTS_REF InjSys_ratAirM12Hpx_AX /end AXIS_DESCR
/end CHARACTERISTIC
/begin CHARACTERISTIC InjSys_P1V4I5_HP.agBgnWrmSmlVlvEthnl_GM "injection packet 1 in variant 4 / ." MAP 0x8055F03C RB_MapGroup_U8 382.5 kw_q1p5 0.00 382.5 FORMAT "%5.1"
 /begin AXIS_DESCR COM_AXIS Epm_nEng EngN 12 0.00 16383.50 FORMAT "%8.2" EXTENDED_LIMITS -16384.00 16383.50 AXIS_PTS_REF InjSys_nEng12Hpx_AX /end AXIS_DESCR
 /begin AXIS_DESCR COM_AXIS InjSys_ratAirMAxisInp rel_uw_q0p0234 12 0.00 1535.977 FORMAT "%8.3" AXIS_PTS_REF InjSys_ratAirM12Hpx_AX /end AXIS_DESCR
/end CHARACTERISTIC
/begin CHARACTERISTIC InjSys_P1V4I5_HP.agBgnWrmSmlVlv_GM "injection packet 1 in variant 4 / ." MAP 0x8055F0CC RB_MapGroup_U8 382.5 kw_q1p5 0.00 382.5 FORMAT "%5.1"
 /begin AXIS_DESCR COM_AXIS Epm_nEng EngN 12 0.00 16383.50 FORMAT "%8.2" EXTENDED_LIMITS -16384.00 16383.50 AXIS_PTS_REF InjSys_nEng12Hpx_AX /end AXIS_DESCR
 /begin AXIS_DESCR COM_AXIS InjSys_ratAirMAxisInp rel_uw_q0p0234 12 0.00 1535.977 FORMAT "%8.3" AXIS_PTS_REF InjSys_ratAirM12Hpx_AX /end AXIS_DESCR
/end CHARACTERISTIC
/begin CHARACTERISTIC InjSys_P1V4I5_HP.agDeltaEth_M "injection packet 1 in variant 4 / delta angle ethanol dependent" MAP 0x8055F15C RB_Map_S16S16_S16 191.2500 kw_q0p75 -96.00000 95.25000 FORMAT "%8.5" EXTENDED_LIMITS -24576.00 24575.25
 /begin AXIS_DESCR STD_AXIS InjSys_facEthLnrLocSp fak_ub_b2 4 0.00 1.992188 FORMAT "%8.6" EXTENDED_LIMITS -256.0000 255.9922 DEPOSIT ABSOLUTE /end AXIS_DESCR
 /begin AXIS_DESCR STD_AXIS InjSys_tEng Temp_Cels 4 -3549.940 3003.560 FORMAT "%8.3" DEPOSIT ABSOLUTE /end AXIS_DESCR
/end CHARACTERISTIC
/begin CHARACTERISTIC InjSys_P1V4I5_HP.agDeltaLam_M "injection packet 1 in variant 4 / ." MAP 0x8055F190 RB_Map_S16U16_S16 191.2500 kw_q0p75 -96.00000 95.25000 FORMAT "%8.5" EXTENDED_LIMITS -24576.00 24575.25
 /begin AXIS_DESCR STD_AXIS Epm_nEng EngN 10 -16384.00 16383.50 FORMAT "%8.2" DEPOSIT ABSOLUTE /end AXIS_DESCR
 /begin AXIS_DESCR STD_AXIS InjSys_ratAirMPredLocSp kw_q0p0234 8 0.00 1535.977 FORMAT "%8.3" DEPOSIT ABSOLUTE /end AXIS_DESCR
/end CHARACTERISTIC
/begin CHARACTERISTIC InjSys_P1V4I5_HP.facAgBgnLam_T "injection packet 1 in variant 4 / ." CURVE 0x8055F258 RB_Curve_U8_U8 0.9961 fak_ub_b1 0.00 0.9961
 /begin AXIS_DESCR STD_AXIS InjSys_facLamBasLocSp fak_ub_b2 8 0.00 1.992188 FORMAT "%8.6" DEPOSIT ABSOLUTE /end AXIS_DESCR
/end CHARACTERISTIC
/begin CHARACTERISTIC InjSys_P1V4I5_HP.facEthnlAgBgn_T "injection packet 1 in variant 4 / ." CURVE 0x8055F269 RB_Curve_U8_U8 0.9961 fak_ub_b1 0.00 0.9961
 /begin AXIS_DESCR STD_AXIS fethstoeLocSp fak_ub_b2 4 0.00 1.992188 FORMAT "%8.6" DEPOSIT ABSOLUTE /end AXIS_DESCR
/end CHARACTERISTIC
/begin CHARACTERISTIC InjSys_P1V4I5_HP.facTPistCold_M "injection packet 1 in variant 4 / delta angle ethanol dependent" MAP 0x8055F272 RB_Map_S16S16_U8 0.9961 fak_ub_b1 0.00 0.9961
 /begin AXIS_DESCR STD_AXIS InjSys_tEng Temp_Cels 8 -3549.940 3003.560 FORMAT "%8.3" DEPOSIT ABSOLUTE /end AXIS_DESCR
 /begin AXIS_DESCR STD_AXIS InjSys_tOilLocSp Temp_Cels 8 -3549.940 3003.560 FORMAT "%8.3" DEPOSIT ABSOLUTE /end AXIS_DESCR
/end CHARACTERISTIC
/begin CHARACTERISTIC InjSys_P1V4I5_HP.facTPist_M "injection packet 1 in variant 4 / weighting factor base angle in homogenous-split mode temperature dependent" MAP 0x8055F2D6 RB_Map_S16S16_U8 0.9961 fak_ub_b1 0.00 0.9961
 /begin AXIS_DESCR STD_AXIS InjSys_tPistBas Temp_Cels 6 -3549.940 3003.560 FORMAT "%8.3" DEPOSIT ABSOLUTE /end AXIS_DESCR
 /begin AXIS_DESCR STD_AXIS InjSys_tPistDelta temp_q0p1 6 -3276.800 3276.700 FORMAT "%8.3" DEPOSIT ABSOLUTE /end AXIS_DESCR
/end CHARACTERISTIC
/begin CHARACTERISTIC InjSys_P1V4I5_HP.facWghtColdWrmEthnl_M "injection packet 1 in variant 4 / ." MAP 0x8055F316 RB_Map_S16S16_U8 0.9961 fak_ub_b1 0.00 0.9961
 /begin AXIS_DESCR STD_AXIS InjSys_tEng Temp_Cels 6 -3549.940 3003.560 FORMAT "%8.3" DEPOSIT ABSOLUTE /end AXIS_DESCR
 /begin AXIS_DESCR STD_AXIS InjSys_tOilLocSp Temp_Cels 4 -3549.940 3003.560 FORMAT "%8.3" DEPOSIT ABSOLUTE /end AXIS_DESCR
/end CHARACTERISTIC
/begin CHARACTERISTIC InjSys_P1V4I5_HP.facWghtColdWrm_M "injection packet 1 in variant 4 / ." MAP 0x8055F346 RB_Map_S16S16_U8 0.9961 fak_ub_b1 0.00 0.9961
 /begin AXIS_DESCR STD_AXIS InjSys_tEng Temp_Cels 6 -3549.940 3003.560 FORMAT "%8.3" DEPOSIT ABSOLUTE /end AXIS_DESCR
 /begin AXIS_DESCR STD_AXIS InjSys_tOilLocSp Temp_Cels 4 -3549.940 3003.560 FORMAT "%8.3" DEPOSIT ABSOLUTE /end AXIS_DESCR
/end CHARACTERISTIC
/begin CHARACTERISTIC InjSys_P1V4I5_HP.facWghtTHsp_M "injection packet 1 in variant 4 / weighting factor base angle in homogenous-split mode temperature dependent" MAP 0x8055F376 RB_Map_S16S16_U8 0.9961 fak_ub_b1 0.00 0.9961
 /begin AXIS_DESCR STD_AXIS InjSys_tEng Temp_Cels 6 -3549.940 3003.560 FORMAT "%8.3" DEPOSIT ABSOLUTE /end AXIS_DESCR
 /begin AXIS_DESCR STD_AXIS InjSys_tEngStrt Temp_Cels 4 -3549.940 3003.560 FORMAT "%8.3" DEPOSIT ABSOLUTE /end AXIS_DESCR
/end CHARACTERISTIC
/begin CHARACTERISTIC InjSys_P1V4I5_HP.facWhgtWrmColdHsp_GM "injection packet 1 in variant 4 / weighting factor warm-cold base angle in homogenous-split mode" MAP 0x8055F3A6 RB_MapGroup_U16 1.000000 fak_uw_b2 0.00 1.000000 FORMAT "%8.6" EXTENDED_LIMITS 0.00 1.999969
 /begin AXIS_DESCR COM_AXIS InjSys_tEngStrt Temp_Cels 8 -3549.940 3003.560 FORMAT "%8.3" AXIS_PTS_REF InjSys_tEngStrt08_AX /end AXIS_DESCR
 /begin AXIS_DESCR COM_AXIS InjSys_nrInjLimdLoc dez 4 0.00 65535.00 FORMAT "%8.2" AXIS_PTS_REF InjSys_nrInj04_AX /end AXIS_DESCR
/end CHARACTERISTIC
/begin CHARACTERISTIC InjSys_P1V4I5_HP.flgAxVers_C "injection packet 1 in variant 4 / condition map selection with group axis in version 2" VALUE 0x8055F3E6 RB_Val_Wu8 1.00000000000 B_TRUE 0.00 1.00000000000 FORMAT "%13.11" /end CHARACTERISTIC
/begin CHARACTERISTIC InjSys_P1V4I6_HP.agBasHspHiVers2_GM "injection packet 1 in variant 4 / base angle in homogenous-split mode for interpolation (version 2)" MAP 0x8055F3EC RB_MapGroup_U8 382.5 kw_q1p5 0.00 382.5 FORMAT "%5.1"
 /begin AXIS_DESCR COM_AXIS Epm_nEng EngN 12 0.00 16383.50 FORMAT "%8.2" EXTENDED_LIMITS -16384.00 16383.50 AXIS_PTS_REF InjSys_nEng12HspVers2_AX /end AXIS_DESCR
 /begin AXIS_DESCR COM_AXIS InjSys_ratAirMAgSpVers2AxisInp rel_uw_q0p0234 12 0.00 1535.977 FORMAT "%8.3" AXIS_PTS_REF InjSys_ratAirM12AgSpHspVers2_AX /end AXIS_DESCR
/end CHARACTERISTIC
/begin CHARACTERISTIC InjSys_P1V4I6_HP.agBasHspHi_GM "injection packet 1 in variant 4 / base angle in homogenous-split mode for interpolation" MAP 0x8055F47C RB_MapGroup_U8 382.5 kw_q1p5 0.00 382.5 FORMAT "%5.1"
 /begin AXIS_DESCR COM_AXIS Epm_nEng EngN 12 0.00 16383.50 FORMAT "%8.2" EXTENDED_LIMITS -16384.00 16383.50 AXIS_PTS_REF InjSys_nEng12Hsp_AX /end AXIS_DESCR
 /begin AXIS_DESCR COM_AXIS InjSys_ratAirMAgSpAxisInp rel_uw_q0p0234 12 0.00 1535.977 FORMAT "%8.3" AXIS_PTS_REF InjSys_ratAirM12AgSpHsp_AX /end AXIS_DESCR
/end CHARACTERISTIC
/begin CHARACTERISTIC InjSys_P1V4I6_HP.agBasHspLoVers2_GM "injection packet 1 in variant 4 / base angle in homogenous-split mode for interpolation (version 2)" MAP 0x8055F50C RB_MapGroup_U8 382.5 kw_q1p5 0.00 382.5 FORMAT "%5.1"
 /begin AXIS_DESCR COM_AXIS Epm_nEng EngN 12 0.00 16383.50 FORMAT "%8.2" EXTENDED_LIMITS -16384.00 16383.50 AXIS_PTS_REF InjSys_nEng12HspVers2_AX /end AXIS_DESCR
 /begin AXIS_DESCR COM_AXIS InjSys_ratAirMAgSpVers2AxisInp rel_uw_q0p0234 12 0.00 1535.977 FORMAT "%8.3" AXIS_PTS_REF InjSys_ratAirM12AgSpHspVers2_AX /end AXIS_DESCR
/end CHARACTERISTIC
/begin CHARACTERISTIC InjSys_P1V4I6_HP.agBasHspLo_GM "injection packet 1 in variant 4 / base angle in homogenous-split mode for interpolation" MAP 0x8055F59C RB_MapGroup_U8 382.5 kw_q1p5 0.00 382.5 FORMAT "%5.1"
 /begin AXIS_DESCR COM_AXIS Epm_nEng EngN 12 0.00 16383.50 FORMAT "%8.2" EXTENDED_LIMITS -16384.00 16383.50 AXIS_PTS_REF InjSys_nEng12Hsp_AX /end AXIS_DESCR
 /begin AXIS_DESCR COM_AXIS InjSys_ratAirMAgSpAxisInp rel_uw_q0p0234 12 0.00 1535.977 FORMAT "%8.3" AXIS_PTS_REF InjSys_ratAirM12AgSpHsp_AX /end AXIS_DESCR
/end CHARACTERISTIC
/begin CHARACTERISTIC InjSys_P1V4I6_HP.agBasTPistColdVers2_GM "injection packet 1 in variant 4 / base angle at cold piston temperature (version 2)" MAP 0x8055F62C RB_MapGroup_U8 382.5 kw_q1p5 0.00 382.5 FORMAT "%5.1"
 /begin AXIS_DESCR COM_AXIS Epm_nEng EngN 12 0.00 16383.50 FORMAT "%8.2" EXTENDED_LIMITS -16384.00 16383.50 AXIS_PTS_REF InjSys_nEng12Vers2_AX /end AXIS_DESCR
 /begin AXIS_DESCR COM_AXIS InjSys_ratAirMAgSpVers2AxisInp rel_uw_q0p0234 12 0.00 1535.977 FORMAT "%8.3" AXIS_PTS_REF InjSys_ratAirM12AgSpVers2_AX /end AXIS_DESCR
/end CHARACTERISTIC
/begin CHARACTERISTIC InjSys_P1V4I6_HP.agBasTPistCold_GM "injection packet 1 in variant 4 / base angle at cold piston temperature" MAP 0x8055F6BC RB_MapGroup_U8 382.5 kw_q1p5 0.00 382.5 FORMAT "%5.1"
 /begin AXIS_DESCR COM_AXIS Epm_nEng EngN 12 0.00 16383.50 FORMAT "%8.2" EXTENDED_LIMITS -16384.00 16383.50 AXIS_PTS_REF InjSys_nEng12_AX /end AXIS_DESCR
 /begin AXIS_DESCR COM_AXIS InjSys_ratAirMAgSpAxisInp rel_uw_q0p0234 12 0.00 1535.977 FORMAT "%8.3" AXIS_PTS_REF InjSys_ratAirM12AgSp_AX /end AXIS_DESCR
/end CHARACTERISTIC
/begin CHARACTERISTIC InjSys_P1V4I6_HP.agBasTPistWrmVers2_GM "injection packet 1 in variant 4 / base angle for interpolation Warm TSA mode (Version 2)" MAP 0x8055F74C RB_MapGroup_U8 382.5 kw_q1p5 0.00 382.5 FORMAT "%5.1"
 /begin AXIS_DESCR COM_AXIS Epm_nEng EngN 12 0.00 16383.50 FORMAT "%8.2" EXTENDED_LIMITS -16384.00 16383.50 AXIS_PTS_REF InjSys_nEng12Vers2_AX /end AXIS_DESCR
 /begin AXIS_DESCR COM_AXIS InjSys_ratAirMAgSpVers2AxisInp rel_uw_q0p0234 12 0.00 1535.977 FORMAT "%8.3" AXIS_PTS_REF InjSys_ratAirM12AgSpVers2_AX /end AXIS_DESCR
/end CHARACTERISTIC
/begin CHARACTERISTIC InjSys_P1V4I6_HP.agBasTPistWrm_GM "injection packet 1 in variant 4 / base angle for interpolation Warm TSA mode" MAP 0x8055F7DC RB_MapGroup_U8 382.5 kw_q1p5 0.00 382.5 FORMAT "%5.1"
 /begin AXIS_DESCR COM_AXIS Epm_nEng EngN 12 0.00 16383.50 FORMAT "%8.2" EXTENDED_LIMITS -16384.00 16383.50 AXIS_PTS_REF InjSys_nEng12_AX /end AXIS_DESCR
 /begin AXIS_DESCR COM_AXIS InjSys_ratAirMAgSpAxisInp rel_uw_q0p0234 12 0.00 1535.977 FORMAT "%8.3" AXIS_PTS_REF InjSys_ratAirM12AgSp_AX /end AXIS_DESCR
/end CHARACTERISTIC
/begin CHARACTERISTIC InjSys_P1V4I6_HP.agBgnColdExtdEthnl_GM "injection packet 1 in variant 4 / ." MAP 0x8055F86C RB_MapGroup_U8 382.5 kw_q1p5 0.00 382.5 FORMAT "%5.1"
 /begin AXIS_DESCR COM_AXIS Epm_nEng EngN 12 0.00 16383.50 FORMAT "%8.2" EXTENDED_LIMITS -16384.00 16383.50 AXIS_PTS_REF InjSys_nEng12Hpx_AX /end AXIS_DESCR
 /begin AXIS_DESCR COM_AXIS InjSys_ratAirMAxisInp rel_uw_q0p0234 12 0.00 1535.977 FORMAT "%8.3" AXIS_PTS_REF InjSys_ratAirM12Hpx_AX /end AXIS_DESCR
/end CHARACTERISTIC
/begin CHARACTERISTIC InjSys_P1V4I6_HP.agBgnColdExtd_GM "injection packet 1 in variant 4 / ." MAP 0x8055F8FC RB_MapGroup_U8 382.5 kw_q1p5 0.00 382.5 FORMAT "%5.1"
 /begin AXIS_DESCR COM_AXIS Epm_nEng EngN 12 0.00 16383.50 FORMAT "%8.2" EXTENDED_LIMITS -16384.00 16383.50 AXIS_PTS_REF InjSys_nEng12Hpx_AX /end AXIS_DESCR
 /begin AXIS_DESCR COM_AXIS InjSys_ratAirMAxisInp rel_uw_q0p0234 12 0.00 1535.977 FORMAT "%8.3" AXIS_PTS_REF InjSys_ratAirM12Hpx_AX /end AXIS_DESCR
/end CHARACTERISTIC
/begin CHARACTERISTIC InjSys_P1V4I6_HP.agBgnColdSmlVlvEthnl_GM "injection packet 1 in variant 4 / ." MAP 0x8055F98C RB_MapGroup_U8 382.5 kw_q1p5 0.00 382.5 FORMAT "%5.1"
 /begin AXIS_DESCR COM_AXIS Epm_nEng EngN 12 0.00 16383.50 FORMAT "%8.2" EXTENDED_LIMITS -16384.00 16383.50 AXIS_PTS_REF InjSys_nEng12Hpx_AX /end AXIS_DESCR
 /begin AXIS_DESCR COM_AXIS InjSys_ratAirMAxisInp rel_uw_q0p0234 12 0.00 1535.977 FORMAT "%8.3" AXIS_PTS_REF InjSys_ratAirM12Hpx_AX /end AXIS_DESCR
/end CHARACTERISTIC
/begin CHARACTERISTIC InjSys_P1V4I6_HP.agBgnColdSmlVlv_GM "injection packet 1 in variant 4 / ." MAP 0x8055FA1C RB_MapGroup_U8 382.5 kw_q1p5 0.00 382.5 FORMAT "%5.1"
 /begin AXIS_DESCR COM_AXIS Epm_nEng EngN 12 0.00 16383.50 FORMAT "%8.2" EXTENDED_LIMITS -16384.00 16383.50 AXIS_PTS_REF InjSys_nEng12Hpx_AX /end AXIS_DESCR
 /begin AXIS_DESCR COM_AXIS InjSys_ratAirMAxisInp rel_uw_q0p0234 12 0.00 1535.977 FORMAT "%8.3" AXIS_PTS_REF InjSys_ratAirM12Hpx_AX /end AXIS_DESCR
/end CHARACTERISTIC
/begin CHARACTERISTIC InjSys_P1V4I6_HP.agBgnWrmExtdEthnl_GM "injection packet 1 in variant 4 / ." MAP 0x8055FAAC RB_MapGroup_U8 382.5 kw_q1p5 0.00 382.5 FORMAT "%5.1"
 /begin AXIS_DESCR COM_AXIS Epm_nEng EngN 12 0.00 16383.50 FORMAT "%8.2" EXTENDED_LIMITS -16384.00 16383.50 AXIS_PTS_REF InjSys_nEng12Hpx_AX /end AXIS_DESCR
 /begin AXIS_DESCR COM_AXIS InjSys_ratAirMAxisInp rel_uw_q0p0234 12 0.00 1535.977 FORMAT "%8.3" AXIS_PTS_REF InjSys_ratAirM12Hpx_AX /end AXIS_DESCR
/end CHARACTERISTIC
/begin CHARACTERISTIC InjSys_P1V4I6_HP.agBgnWrmExtd_GM "injection packet 1 in variant 4 / ." MAP 0x8055FB3C RB_MapGroup_U8 382.5 kw_q1p5 0.00 382.5 FORMAT "%5.1"
 /begin AXIS_DESCR COM_AXIS Epm_nEng EngN 12 0.00 16383.50 FORMAT "%8.2" EXTENDED_LIMITS -16384.00 16383.50 AXIS_PTS_REF InjSys_nEng12Hpx_AX /end AXIS_DESCR
 /begin AXIS_DESCR COM_AXIS InjSys_ratAirMAxisInp rel_uw_q0p0234 12 0.00 1535.977 FORMAT "%8.3" AXIS_PTS_REF InjSys_ratAirM12Hpx_AX /end AXIS_DESCR
/end CHARACTERISTIC
/begin CHARACTERISTIC InjSys_P1V4I6_HP.agBgnWrmSmlVlvEthnl_GM "injection packet 1 in variant 4 / ." MAP 0x8055FBCC RB_MapGroup_U8 382.5 kw_q1p5 0.00 382.5 FORMAT "%5.1"
 /begin AXIS_DESCR COM_AXIS Epm_nEng EngN 12 0.00 16383.50 FORMAT "%8.2" EXTENDED_LIMITS -16384.00 16383.50 AXIS_PTS_REF InjSys_nEng12Hpx_AX /end AXIS_DESCR
 /begin AXIS_DESCR COM_AXIS InjSys_ratAirMAxisInp rel_uw_q0p0234 12 0.00 1535.977 FORMAT "%8.3" AXIS_PTS_REF InjSys_ratAirM12Hpx_AX /end AXIS_DESCR
/end CHARACTERISTIC
/begin CHARACTERISTIC InjSys_P1V4I6_HP.agBgnWrmSmlVlv_GM "injection packet 1 in variant 4 / ." MAP 0x8055FC5C RB_MapGroup_U8 382.5 kw_q1p5 0.00 382.5 FORMAT "%5.1"
 /begin AXIS_DESCR COM_AXIS Epm_nEng EngN 12 0.00 16383.50 FORMAT "%8.2" EXTENDED_LIMITS -16384.00 16383.50 AXIS_PTS_REF InjSys_nEng12Hpx_AX /end AXIS_DESCR
 /begin AXIS_DESCR COM_AXIS InjSys_ratAirMAxisInp rel_uw_q0p0234 12 0.00 1535.977 FORMAT "%8.3" AXIS_PTS_REF InjSys_ratAirM12Hpx_AX /end AXIS_DESCR
/end CHARACTERISTIC
/begin CHARACTERISTIC InjSys_P1V4I6_HP.agDeltaEth_M "injection packet 1 in variant 4 / delta angle ethanol dependent" MAP 0x8055FCEC RB_Map_S16S16_S16 191.2500 kw_q0p75 -96.00000 95.25000 FORMAT "%8.5" EXTENDED_LIMITS -24576.00 24575.25
 /begin AXIS_DESCR STD_AXIS InjSys_facEthLnrLocSp fak_ub_b2 4 0.00 1.992188 FORMAT "%8.6" EXTENDED_LIMITS -256.0000 255.9922 DEPOSIT ABSOLUTE /end AXIS_DESCR
 /begin AXIS_DESCR STD_AXIS InjSys_tEng Temp_Cels 4 -3549.940 3003.560 FORMAT "%8.3" DEPOSIT ABSOLUTE /end AXIS_DESCR
/end CHARACTERISTIC
/begin CHARACTERISTIC InjSys_P1V4I6_HP.agDeltaLam_M "injection packet 1 in variant 4 / ." MAP 0x8055FD20 RB_Map_S16U16_S16 191.2500 kw_q0p75 -96.00000 95.25000 FORMAT "%8.5" EXTENDED_LIMITS -24576.00 24575.25
 /begin AXIS_DESCR STD_AXIS Epm_nEng EngN 10 -16384.00 16383.50 FORMAT "%8.2" DEPOSIT ABSOLUTE /end AXIS_DESCR
 /begin AXIS_DESCR STD_AXIS InjSys_ratAirMPredLocSp kw_q0p0234 8 0.00 1535.977 FORMAT "%8.3" DEPOSIT ABSOLUTE /end AXIS_DESCR
/end CHARACTERISTIC
/begin CHARACTERISTIC InjSys_P1V4I6_HP.facAgBgnLam_T "injection packet 1 in variant 4 / ." CURVE 0x8055FDE8 RB_Curve_U8_U8 0.9961 fak_ub_b1 0.00 0.9961
 /begin AXIS_DESCR STD_AXIS InjSys_facLamBasLocSp fak_ub_b2 8 0.00 1.992188 FORMAT "%8.6" DEPOSIT ABSOLUTE /end AXIS_DESCR
/end CHARACTERISTIC
/begin CHARACTERISTIC InjSys_P1V4I6_HP.facEthnlAgBgn_T "injection packet 1 in variant 4 / ." CURVE 0x8055FDF9 RB_Curve_U8_U8 0.9961 fak_ub_b1 0.00 0.9961
 /begin AXIS_DESCR STD_AXIS fethstoeLocSp fak_ub_b2 4 0.00 1.992188 FORMAT "%8.6" DEPOSIT ABSOLUTE /end AXIS_DESCR
/end CHARACTERISTIC
/begin CHARACTERISTIC InjSys_P1V4I6_HP.facTPistCold_M "injection packet 1 in variant 4 / delta angle ethanol dependent" MAP 0x8055FE02 RB_Map_S16S16_U8 0.9961 fak_ub_b1 0.00 0.9961
 /begin AXIS_DESCR STD_AXIS InjSys_tEng Temp_Cels 8 -3549.940 3003.560 FORMAT "%8.3" DEPOSIT ABSOLUTE /end AXIS_DESCR
 /begin AXIS_DESCR STD_AXIS InjSys_tOilLocSp Temp_Cels 8 -3549.940 3003.560 FORMAT "%8.3" DEPOSIT ABSOLUTE /end AXIS_DESCR
/end CHARACTERISTIC
/begin CHARACTERISTIC InjSys_P1V4I6_HP.facTPist_M "injection packet 1 in variant 4 / weighting factor base angle in homogenous-split mode temperature dependent" MAP 0x8055FE66 RB_Map_S16S16_U8 0.9961 fak_ub_b1 0.00 0.9961
 /begin AXIS_DESCR STD_AXIS InjSys_tPistBas Temp_Cels 6 -3549.940 3003.560 FORMAT "%8.3" DEPOSIT ABSOLUTE /end AXIS_DESCR
 /begin AXIS_DESCR STD_AXIS InjSys_tPistDelta temp_q0p1 6 -3276.800 3276.700 FORMAT "%8.3" DEPOSIT ABSOLUTE /end AXIS_DESCR
/end CHARACTERISTIC
/begin AXIS_PTS InjSys_ratAirM08_AX "base point distribution relative air mass with 8 base points" 0x805586E8 InjSys_ratAirMAxisInp RB_Axis_U16 1535.977 rel_uw_q0p0234 8 0.00 1535.977 FORMAT "%8.3" DEPOSIT ABSOLUTE /end AXIS_PTS
/begin AXIS_PTS InjSys_ratAirM12AgSpHspVers2_AX "base point distribution relative air mass with 12 base points (Version 2 HSP Mode)" 0x805586FA InjSys_ratAirMAgSpVers2AxisInp RB_Axis_U16 1535.977 rel_uw_q0p0234 12 0.00 1535.977 FORMAT "%8.3" DEPOSIT ABSOLUTE /end AXIS_PTS
/begin AXIS_PTS InjSys_ratAirM12AgSpHsp_AX "base point distribution relative air mass with 12 base points (HSP Mode)" 0x80558714 InjSys_ratAirMAgSpAxisInp RB_Axis_U16 1535.977 rel_uw_q0p0234 12 0.00 1535.977 FORMAT "%8.3" DEPOSIT ABSOLUTE /end AXIS_PTS
/begin AXIS_PTS InjSys_ratAirM12AgSpVers2_AX "base point distribution relative air mass with 12 base points" 0x8055872E InjSys_ratAirMAgSpVers2AxisInp RB_Axis_U16 1535.977 rel_uw_q0p0234 12 0.00 1535.977 FORMAT "%8.3" DEPOSIT ABSOLUTE /end AXIS_PTS
/begin AXIS_PTS InjSys_ratAirM12AgSp_AX "base point distribution relative air mass with 12 base points" 0x80558748 InjSys_ratAirMAgSpAxisInp RB_Axis_U16 1535.977 rel_uw_q0p0234 12 0.00 1535.977 FORMAT "%8.3" DEPOSIT ABSOLUTE /end AXIS_PTS
/begin AXIS_PTS InjSys_ratAirM12Hpx_AX "base point distribution relative air mass HPx with 12 base points" 0x80558762 InjSys_ratAirMAxisInp RB_Axis_U16 1535.977 rel_uw_q0p0234 12 0.00 1535.977 FORMAT "%8.3" DEPOSIT ABSOLUTE /end AXIS_PTS
/begin AXIS_PTS InjSys_ratAirM12Vers2_AX "base point distribution relative air mass with 12 base points" 0x8055877C InjSys_ratAirMVers2AxisInp RB_Axis_U16 1535.977 rel_uw_q0p0234 12 0.00 1535.977 FORMAT "%8.3" DEPOSIT ABSOLUTE /end AXIS_PTS
/begin AXIS_PTS InjSys_ratAirM12_AX "base point distribution relative air mass with 12 base points" 0x80558796 InjSys_ratAirMAxisInp RB_Axis_U16 1535.977 rel_uw_q0p0234 12 0.00 1535.977 FORMAT "%8.3" DEPOSIT ABSOLUTE /end AXIS_PTS
/begin AXIS_PTS InjSys_tEngStrt08_AX "Base point distribution for engine temperature at start with 8 base points" 0x805587DC InjSys_tEngStrt RB_Axis_S16 6553.500 Temp_Cels 8 -3549.940 3003.560 FORMAT "%8.3" DEPOSIT ABSOLUTE /end AXIS_PTS
/begin FUNCTION InjSyG_InjSp "159.0.0   Injection Setpoints"
 /begin DEF_CHARACTERISTIC InjSys_P1APPL.agBas_C InjSys_P1APPL.facSpltAux1_C InjSys_P1APPL.facSpltAux2_C InjSys_P1APPL.facSpltAux_C InjSys_P1APPL.flgAbsltSplt_C InjSys_P1APPL.flgAgAux_C InjSys_P1APPL.flgSpltAux_C InjSys_P1APPL.ratFuMAux1_C InjSys_P1APPL.ratFuMAux2_C InjSys_P1APPL.ratFuMBas_C InjSys_P1APPL.stAgEnd_C InjSys_P1APPL.tiBreakAux1_C InjSys_P1APPL.tiBreakAux2_C InjSys_P1V1I1_HO.agBasTPistColdVers2_GM InjSys_P1V1I1_HO.agBasTPistCold_GM InjSys_P1V1I1_HO.agBasTPistWrmVers2_GM InjSys_P1V1I1_HO.agBasTPistWrm_GM InjSys_P1V1I1_HO.agBgnColdExtdEthnl_GM InjSys_P1V1I1_HO.agBgnColdExtd_GM InjSys_P1V1I1_HO.agBgnColdSmlVlvEthnl_GM InjSys_P1V1I1_HO.agBgnColdSmlVlv_GM InjSys_P1V1I1_HO.agBgnWrmExtdEthnl_GM InjSys_P1V1I1_HO.agBgnWrmExtd_GM InjSys_P1V1I1_HO.agBgnWrmSmlVlvEthnl_GM InjSys_P1V1I1_HO.agBgnWrmSmlVlv_GM InjSys_P1V1I1_HO.agDeltaEth_M InjSys_P1V1I1_HO.agDeltaLamBasCold_M InjSys_P1V1I1_HO.agDeltaLamBasWrm_M InjSys_P1V1I1_HO.agDeltaLam_M InjSys_P1V1I1_HO.agDeltaTEngOilVers2_GM InjSys_P1V1I1_HO.agDeltaTEngOil_GM InjSys_P1V1I1_HO.facAgBgnLam_T InjSys_P1V1I1_HO.facEthnlAgBgn_T InjSys_P1V1I1_HO.facTPistCold_M InjSys_P1V1I1_HO.facTPist_M InjSys_P1V1I1_HO.facWghtAgDeltaLamBasCold_T InjSys_P1V1I1_HO.facWghtAgDeltaLamBasWrm_T InjSys_P1V1I1_HO.facWghtColdWrmEthnl_M InjSys_P1V1I1_HO.facWghtColdWrm_M InjSys_P1V1I1_HO.facWghtWrmCold_M InjSys_P1V1I1_HO.flgAxVers_C InjSys_P1V1I2_HO.agBasTPistColdVers2_GM InjSys_P1V1I2_HO.agBasTPistCold_GM InjSys_P1V1I2_HO.agBasTPistWrmVers2_GM InjSys_P1V1I2_HO.agBasTPistWrm_GM InjSys_P1V1I2_HO.agBgnColdExtdEthnl_GM InjSys_P1V1I2_HO.agBgnColdExtd_GM InjSys_P1V1I2_HO.agBgnColdSmlVlvEthnl_GM InjSys_P1V1I2_HO.agBgnColdSmlVlv_GM InjSys_P1V1I2_HO.agBgnWrmExtdEthnl_GM InjSys_P1V1I2_HO.agBgnWrmExtd_GM InjSys_P1V1I2_HO.agBgnWrmSmlVlvEthnl_GM InjSys_P1V1I2_HO.agBgnWrmSmlVlv_GM InjSys_P1V1I2_HO.agDeltaEth_M InjSys_P1V1I2_HO.agDeltaLamBasCold_M InjSys_P1V1I2_HO.agDeltaLamBasWrm_M InjSys_P1V1I2_HO.agDeltaLam_M InjSys_P1V1I2_HO.agDeltaTEngOilVers2_GM InjSys_P1V1I2_HO.agDeltaTEngOil_GM InjSys_P1V1I2_HO.facAgBgnLam_T InjSys_P1V1I2_HO.facEthnlAgBgn_T InjSys_P1V1I2_HO.facTPistCold_M InjSys_P1V1I2_HO.facTPist_M InjSys_P1V1I2_HO.facWghtAgDeltaLamBasCold_T InjSys_P1V1I2_HO.facWghtAgDeltaLamBasWrm_T InjSys_P1V1I2_HO.facWghtColdWrmEthnl_M InjSys_P1V1I2_HO.facWghtColdWrm_M InjSys_P1V1I2_HO.facWghtWrmCold_M InjSys_P1V1I2_HO.flgAxVers_C InjSys_P1V2I1_HO.agBasTPistColdVers2_GM InjSys_P1V2I1_HO.agBasTPistCold_GM InjSys_P1V2I1_HO.agBasTPistWrmVers2_GM InjSys_P1V2I1_HO.agBasTPistWrm_GM InjSys_P1V2I1_HO.agBgnColdExtdEthnl_GM InjSys_P1V2I1_HO.agBgnColdExtd_GM InjSys_P1V2I1_HO.agBgnColdSmlVlvEthnl_GM InjSys_P1V2I1_HO.agBgnColdSmlVlv_GM InjSys_P1V2I1_HO.agBgnWrmExtdEthnl_GM InjSys_P1V2I1_HO.agBgnWrmExtd_GM InjSys_P1V2I1_HO.agBgnWrmSmlVlvEthnl_GM InjSys_P1V2I1_HO.agBgnWrmSmlVlv_GM InjSys_P1V2I1_HO.agDeltaEth_M InjSys_P1V2I1_HO.agDeltaLamBasCold_M InjSys_P1V2I1_HO.agDeltaLamBasWrm_M InjSys_P1V2I1_HO.agDeltaLam_M InjSys_P1V2I1_HO.agDeltaTEngOilVers2_GM InjSys_P1V2I1_HO.agDeltaTEngOil_GM InjSys_P1V2I1_HO.facAgBgnLam_T InjSys_P1V2I1_HO.facEthnlAgBgn_T InjSys_P1V2I1_HO.facSpltAux1Extd_GM InjSys_P1V2I1_HO.facSpltAux1_GM InjSys_P1V2I1_HO.facTPistCold_M InjSys_P1V2I1_HO.facTPist_M InjSys_P1V2I1_HO.facWghtAgDeltaLamBasCold_T InjSys_P1V2I1_HO.facWghtAgDeltaLamBasWrm_T InjSys_P1V2I1_HO.facWghtColdWrmEthnl_M InjSys_P1V2I1_HO.facWghtColdWrm_M InjSys_P1V2I1_HO.facWghtWrmCold_M InjSys_P1V2I1_HO.flgAbsltSplt_C InjSys_P1V2I1_HO.flgAxVers_C InjSys_P1V2I1_HO.flgPltInj_C InjSys_P1V2I1_HO.ratFuMAux1_GM InjSys_P1V2I1_HO.ratFuMBasExtd_GM InjSys_P1V2I1_HO.ratFuMBas_GM InjSys_P1V2I1_HO.stDiTiBreakAux_C InjSys_P1V2I1_HO.tiBreakAux1_M InjSys_P1V2I2_HO.agBasTPistColdVers2_GM InjSys_P1V2I2_HO.agBasTPistCold_GM InjSys_P1V2I2_HO.agBasTPistWrmVers2_GM InjSys_P1V2I2_HO.agBasTPistWrm_GM InjSys_P1V2I2_HO.agBgnColdExtdEthnl_GM InjSys_P1V2I2_HO.agBgnColdExtd_GM InjSys_P1V2I2_HO.agBgnColdSmlVlvEthnl_GM InjSys_P1V2I2_HO.agBgnColdSmlVlv_GM InjSys_P1V2I2_HO.agBgnWrmExtdEthnl_GM InjSys_P1V2I2_HO.agBgnWrmExtd_GM InjSys_P1V2I2_HO.agBgnWrmSmlVlvEthnl_GM InjSys_P1V2I2_HO.agBgnWrmSmlVlv_GM InjSys_P1V2I2_HO.agDeltaEth_M InjSys_P1V2I2_HO.agDeltaLamBasCold_M InjSys_P1V2I2_HO.agDeltaLamBasWrm_M InjSys_P1V2I2_HO.agDeltaLam_M InjSys_P1V2I2_HO.agDeltaTEngOilVers2_GM InjSys_P1V2I2_HO.agDeltaTEngOil_GM InjSys_P1V2I2_HO.facAgBgnLam_T InjSys_P1V2I2_HO.facEthnlAgBgn_T InjSys_P1V2I2_HO.facSpltAux1Extd_GM InjSys_P1V2I2_HO.facSpltAux1_GM InjSys_P1V2I2_HO.facTPistCold_M InjSys_P1V2I2_HO.facTPist_M InjSys_P1V2I2_HO.facWghtAgDeltaLamBasCold_T InjSys_P1V2I2_HO.facWghtAgDeltaLamBasWrm_T InjSys_P1V2I2_HO.facWghtColdWrmEthnl_M InjSys_P1V2I2_HO.facWghtColdWrm_M InjSys_P1V2I2_HO.facWghtWrmCold_M InjSys_P1V2I2_HO.flgAbsltSplt_C InjSys_P1V2I2_HO.flgAxVers_C InjSys_P1V2I2_HO.flgPltInj_C InjSys_P1V2I2_HO.ratFuMAux1_GM InjSys_P1V2I2_HO.ratFuMBasExtd_GM InjSys_P1V2I2_HO.ratFuMBas_GM InjSys_P1V2I2_HO.stDiTiBreakAux_C InjSys_P1V2I2_HO.tiBreakAux1_M InjSys_P1V3I1_HO.agBasTPistColdVers2_GM InjSys_P1V3I1_HO.agBasTPistCold_GM InjSys_P1V3I1_HO.agBasTPistWrmVers2_GM InjSys_P1V3I1_HO.agBasTPistWrm_GM InjSys_P1V3I1_HO.agBgnColdExtdEthnl_GM InjSys_P1V3I1_HO.agBgnColdExtd_GM InjSys_P1V3I1_HO.agBgnColdSmlVlvEthnl_GM InjSys_P1V3I1_HO.agBgnColdSmlVlv_GM InjSys_P1V3I1_HO.agBgnWrmExtdEthnl_GM InjSys_P1V3I1_HO.agBgnWrmExtd_GM InjSys_P1V3I1_HO.agBgnWrmSmlVlvWEthnl_GM InjSys_P1V3I1_HO.agBgnWrmSmlVlv_GM InjSys_P1V3I1_HO.agDeltaEth_M InjSys_P1V3I1_HO.agDeltaLamBasCold_M InjSys_P1V3I1_HO.agDeltaLamBasWrm_M InjSys_P1V3I1_HO.agDeltaLam_M InjSys_P1V3I1_HO.agDeltaTEngOilVers2_GM InjSys_P1V3I1_HO.agDeltaTEngOil_GM InjSys_P1V3I1_HO.facAgBgnLam_T InjSys_P1V3I1_HO.facEthnlAgBgn_T InjSys_P1V3I1_HO.facSpltAux1Extd_GM InjSys_P1V3I1_HO.facSpltAux1_GM InjSys_P1V3I1_HO.facSpltAux2Extd_GM InjSys_P1V3I1_HO.facSpltAux2_GM InjSys_P1V3I1_HO.facTPistCold_M InjSys_P1V3I1_HO.facTPist_M InjSys_P1V3I1_HO.facWghtAgDeltaLamBasCold_T InjSys_P1V3I1_HO.facWghtAgDeltaLamBasWrm_T InjSys_P1V3I1_HO.facWghtColdWrmEthnl_M InjSys_P1V3I1_HO.facWghtColdWrm_M InjSys_P1V3I1_HO.facWghtWrmCold_M InjSys_P1V3I1_HO.flgAbsltSplt_C InjSys_P1V3I1_HO.flgAxVers_C InjSys_P1V3I1_HO.flgPltInj_C InjSys_P1V3I1_HO.ratFuMAux1_GM InjSys_P1V3I1_HO.ratFuMAux2_GM InjSys_P1V3I1_HO.ratFuMBasExtd_GM InjSys_P1V3I1_HO.ratFuMBas_GM InjSys_P1V3I1_HO.stDiTiBreakAux_C InjSys_P1V3I1_HO.tiBreakAux1_M InjSys_P1V3I1_HO.tiBreakAux2_M InjSys_P1V3I2_HO.agBasTPistColdVers2_GM InjSys_P1V3I2_HO.agBasTPistCold_GM InjSys_P1V3I2_HO.agBasTPistWrmVers2_GM InjSys_P1V3I2_HO.agBasTPistWrm_GM InjSys_P1V3I2_HO.agBgnColdExtdEthnl_GM InjSys_P1V3I2_HO.agBgnColdExtd_GM InjSys_P1V3I2_HO.agBgnColdSmlVlvEthnl_GM InjSys_P1V3I2_HO.agBgnColdSmlVlv_GM InjSys_P1V3I2_HO.agBgnWrmExtdEthnl_GM InjSys_P1V3I2_HO.agBgnWrmExtd_GM InjSys_P1V3I2_HO.agBgnWrmSmlVlvWEthnl_GM InjSys_P1V3I2_HO.agBgnWrmSmlVlv_GM InjSys_P1V3I2_HO.agDeltaEth_M InjSys_P1V3I2_HO.agDeltaLamBasCold_M InjSys_P1V3I2_HO.agDeltaLamBasWrm_M InjSys_P1V3I2_HO.agDeltaLam_M InjSys_P1V3I2_HO.agDeltaTEngOilVers2_GM InjSys_P1V3I2_HO.agDeltaTEngOil_GM InjSys_P1V3I2_HO.facAgBgnLam_T InjSys_P1V3I2_HO.facEthnlAgBgn_T InjSys_P1V3I2_HO.facSpltAux1Extd_GM InjSys_P1V3I2_HO.facSpltAux1_GM InjSys_P1V3I2_HO.facSpltAux2Extd_GM InjSys_P1V3I2_HO.facSpltAux2_GM InjSys_P1V3I2_HO.facTPistCold_M InjSys_P1V3I2_HO.facTPist_M InjSys_P1V3I2_HO.facWghtAgDeltaLamBasCold_T InjSys_P1V3I2_HO.facWghtAgDeltaLamBasWrm_T InjSys_P1V3I2_HO.facWghtColdWrmEthnl_M InjSys_P1V3I2_HO.facWghtColdWrm_M InjSys_P1V3I2_HO.facWghtWrmCold_M InjSys_P1V3I2_HO.flgAbsltSplt_C InjSys_P1V3I2_HO.flgAxVers_C InjSys_P1V3I2_HO.flgPltInj_C InjSys_P1V3I2_HO.ratFuMAux1_GM InjSys_P1V3I2_HO.ratFuMAux2_GM InjSys_P1V3I2_HO.ratFuMBasExtd_GM InjSys_P1V3I2_HO.ratFuMBas_GM InjSys_P1V3I2_HO.stDiTiBreakAux_C InjSys_P1V3I2_HO.tiBreakAux1_M InjSys_P1V3I2_HO.tiBreakAux2_M InjSys_P1V4I1_HP.agBasHspHiVers2_GM InjSys_P1V4I1_HP.agBasHspHi_GM InjSys_P1V4I1_HP.agBasHspLoVers2_GM InjSys_P1V4I1_HP.agBasHspLo_GM InjSys_P1V4I1_HP.agBasTPistColdVers2_GM InjSys_P1V4I1_HP.agBasTPistCold_GM InjSys_P1V4I1_HP.agBasTPistWrmVers2_GM InjSys_P1V4I1_HP.agBasTPistWrm_GM InjSys_P1V4I1_HP.agBgnColdExtdEthnl_GM InjSys_P1V4I1_HP.agBgnColdExtd_GM InjSys_P1V4I1_HP.agBgnColdSmlVlvEthnl_GM InjSys_P1V4I1_HP.agBgnColdSmlVlv_GM InjSys_P1V4I1_HP.agBgnWrmExtdEthnl_GM InjSys_P1V4I1_HP.agBgnWrmExtd_GM InjSys_P1V4I1_HP.agBgnWrmSmlVlvEthnl_GM InjSys_P1V4I1_HP.agBgnWrmSmlVlv_GM InjSys_P1V4I1_HP.agDeltaEth_M InjSys_P1V4I1_HP.agDeltaLam_M InjSys_P1V4I1_HP.facAgBgnLam_T InjSys_P1V4I1_HP.facEthnlAgBgn_T InjSys_P1V4I1_HP.facTPistCold_M InjSys_P1V4I1_HP.facTPist_M InjSys_P1V4I1_HP.facWghtColdWrmEthnl_M InjSys_P1V4I1_HP.facWghtColdWrm_M InjSys_P1V4I1_HP.facWghtTHsp_M InjSys_P1V4I1_HP.facWhgtWrmColdHsp_GM InjSys_P1V4I1_HP.flgAxVers_C InjSys_P1V4I2_HP.agBasHspHiVers2_GM InjSys_P1V4I2_HP.agBasHspHi_GM InjSys_P1V4I2_HP.agBasHspLoVers2_GM InjSys_P1V4I2_HP.agBasHspLo_GM InjSys_P1V4I2_HP.agBasTPistColdVers2_GM InjSys_P1V4I2_HP.agBasTPistCold_GM InjSys_P1V4I2_HP.agBasTPistWrmVers2_GM InjSys_P1V4I2_HP.agBasTPistWrm_GM InjSys_P1V4I2_HP.agBgnColdExtdEthnl_GM InjSys_P1V4I2_HP.agBgnColdExtd_GM InjSys_P1V4I2_HP.agBgnColdSmlVlvEthnl_GM InjSys_P1V4I2_HP.agBgnColdSmlVlv_GM InjSys_P1V4I2_HP.agBgnWrmExtdEthnl_GM InjSys_P1V4I2_HP.agBgnWrmExtd_GM InjSys_P1V4I2_HP.agBgnWrmSmlVlvEthnl_GM InjSys_P1V4I2_HP.agBgnWrmSmlVlv_GM InjSys_P1V4I2_HP.agDeltaEth_M InjSys_P1V4I2_HP.agDeltaLam_M InjSys_P1V4I2_HP.facAgBgnLam_T InjSys_P1V4I2_HP.facEthnlAgBgn_T InjSys_P1V4I2_HP.facTPistCold_M InjSys_P1V4I2_HP.facTPist_M InjSys_P1V4I2_HP.facWghtColdWrmEthnl_M InjSys_P1V4I2_HP.facWghtColdWrm_M InjSys_P1V4I2_HP.facWghtTHsp_M InjSys_P1V4I2_HP.facWhgtWrmColdHsp_GM InjSys_P1V4I2_HP.flgAxVers_C InjSys_P1V4I3_HP.agBasHspHiVers2_GM InjSys_P1V4I3_HP.agBasHspHi_GM InjSys_P1V4I3_HP.agBasHspLoVers2_GM InjSys_P1V4I3_HP.agBasHspLo_GM InjSys_P1V4I3_HP.agBasTPistColdVers2_GM InjSys_P1V4I3_HP.agBasTPistCold_GM InjSys_P1V4I3_HP.agBasTPistWrmVers2_GM InjSys_P1V4I3_HP.agBasTPistWrm_GM InjSys_P1V4I3_HP.agBgnColdExtdEthnl_GM InjSys_P1V4I3_HP.agBgnColdExtd_GM InjSys_P1V4I3_HP.agBgnColdSmlVlvEthnl_GM InjSys_P1V4I3_HP.agBgnColdSmlVlv_GM InjSys_P1V4I3_HP.agBgnWrmExtdEthnl_GM InjSys_P1V4I3_HP.agBgnWrmExtd_GM InjSys_P1V4I3_HP.agBgnWrmSmlVlvEthnl_GM InjSys_P1V4I3_HP.agBgnWrmSmlVlv_GM InjSys_P1V4I3_HP.agDeltaEth_M InjSys_P1V4I3_HP.agDeltaLam_M InjSys_P1V4I3_HP.facAgBgnLam_T InjSys_P1V4I3_HP.facEthnlAgBgn_T InjSys_P1V4I3_HP.facTPistCold_M InjSys_P1V4I3_HP.facTPist_M InjSys_P1V4I3_HP.facWghtColdWrmEthnl_M InjSys_P1V4I3_HP.facWghtColdWrm_M InjSys_P1V4I3_HP.facWghtTHsp_M InjSys_P1V4I3_HP.facWhgtWrmColdHsp_GM InjSys_P1V4I3_HP.flgAxVers_C InjSys_P1V4I4_HP.agBasHspHiVers2_GM InjSys_P1V4I4_HP.agBasHspHi_GM InjSys_P1V4I4_HP.agBasHspLoVers2_GM InjSys_P1V4I4_HP.agBasHspLo_GM InjSys_P1V4I4_HP.agBasTPistColdVers2_GM InjSys_P1V4I4_HP.agBasTPistCold_GM InjSys_P1V4I4_HP.agBasTPistWrmVers2_GM InjSys_P1V4I4_HP.agBasTPistWrm_GM InjSys_P1V4I4_HP.agBgnColdExtdEthnl_GM InjSys_P1V4I4_HP.agBgnColdExtd_GM InjSys_P1V4I4_HP.agBgnColdSmlVlvEthnl_GM InjSys_P1V4I4_HP.agBgnColdSmlVlv_GM InjSys_P1V4I4_HP.agBgnWrmExtdEthnl_GM InjSys_P1V4I4_HP.agBgnWrmExtd_GM InjSys_P1V4I4_HP.agBgnWrmSmlVlvEthnl_GM InjSys_P1V4I4_HP.agBgnWrmSmlVlv_GM InjSys_P1V4I4_HP.agDeltaEth_M InjSys_P1V4I4_HP.agDeltaLam_M InjSys_P1V4I4_HP.facAgBgnLam_T InjSys_P1V4I4_HP.facEthnlAgBgn_T InjSys_P1V4I4_HP.facTPistCold_M InjSys_P1V4I4_HP.facTPist_M InjSys_P1V4I4_HP.facWghtColdWrmEthnl_M InjSys_P1V4I4_HP.facWghtColdWrm_M InjSys_P1V4I4_HP.facWghtTHsp_M InjSys_P1V4I4_HP.facWhgtWrmColdHsp_GM InjSys_P1V4I4_HP.flgAxVers_C InjSys_P1V4I5_HP.agBasHspHiVers2_GM InjSys_P1V4I5_HP.agBasHspHi_GM InjSys_P1V4I5_HP.agBasHspLoVers2_GM InjSys_P1V4I5_HP.agBasHspLo_GM InjSys_P1V4I5_HP.agBasTPistColdVers2_GM InjSys_P1V4I5_HP.agBasTPistCold_GM InjSys_P1V4I5_HP.agBasTPistWrmVers2_GM InjSys_P1V4I5_HP.agBasTPistWrm_GM InjSys_P1V4I5_HP.agBgnColdExtdEthnl_GM InjSys_P1V4I5_HP.agBgnColdExtd_GM InjSys_P1V4I5_HP.agBgnColdSmlVlvEthnl_GM InjSys_P1V4I5_HP.agBgnColdSmlVlv_GM InjSys_P1V4I5_HP.agBgnWrmExtdEthnl_GM InjSys_P1V4I5_HP.agBgnWrmExtd_GM InjSys_P1V4I5_HP.agBgnWrmSmlVlvEthnl_GM InjSys_P1V4I5_HP.agBgnWrmSmlVlv_GM InjSys_P1V4I5_HP.agDeltaEth_M InjSys_P1V4I5_HP.agDeltaLam_M InjSys_P1V4I5_HP.facAgBgnLam_T InjSys_P1V4I5_HP.facEthnlAgBgn_T InjSys_P1V4I5_HP.facTPistCold_M InjSys_P1V4I5_HP.facTPist_M InjSys_P1V4I5_HP.facWghtColdWrmEthnl_M InjSys_P1V4I5_HP.facWghtColdWrm_M InjSys_P1V4I5_HP.facWghtTHsp_M InjSys_P1V4I5_HP.facWhgtWrmColdHsp_GM InjSys_P1V4I5_HP.flgAxVers_C InjSys_P1V4I6_HP.agBasHspHiVers2_GM InjSys_P1V4I6_HP.agBasHspHi_GM InjSys_P1V4I6_HP.agBasHspLoVers2_GM InjSys_P1V4I6_HP.agBasHspLo_GM InjSys_P1V4I6_HP.agBasTPistColdVers2_GM InjSys_P1V4I6_HP.agBasTPistCold_GM InjSys_P1V4I6_HP.agBasTPistWrmVers2_GM InjSys_P1V4I6_HP.agBasTPistWrm_GM InjSys_P1V4I6_HP.agBgnColdExtdEthnl_GM InjSys_P1V4I6_HP.agBgnColdExtd_GM InjSys_P1V4I6_HP.agBgnColdSmlVlvEthnl_GM InjSys_P1V4I6_HP.agBgnColdSmlVlv_GM InjSys_P1V4I6_HP.agBgnWrmExtdEthnl_GM InjSys_P1V4I6_HP.agBgnWrmExtd_GM InjSys_P1V4I6_HP.agBgnWrmSmlVlvEthnl_GM InjSys_P1V4I6_HP.agBgnWrmSmlVlv_GM InjSys_P1V4I6_HP.agDeltaEth_M InjSys_P1V4I6_HP.agDeltaLam_M InjSys_P1V4I6_HP.facAgBgnLam_T InjSys_P1V4I6_HP.facEthnlAgBgn_T InjSys_P1V4I6_HP.facTPistCold_M InjSys_P1V4I6_HP.facTPist_M /end DEF_CHARACTERISTIC
 FUNCTION_VERSION "159.0.0" /end FUNCTION
/begin COMPU_METHOD B_TRUE "" TAB_VERB "%6.3" "" COMPU_TAB_REF B_TRUE /end COMPU_METHOD
/begin COMPU_VTAB B_TRUE "" TAB_VERB 2 0 "FALSE" 1 "TRUE" /end COMPU_VTAB
/begin COMPU_METHOD dez "" RAT_FUNC "%6.2" "" COEFFS 0 1 0 0 0 1 /end COMPU_METHOD
/begin COMPU_METHOD EngN "" RAT_FUNC "%6.3" "rpm" COEFFS 0 2 0 0 0 1 /end COMPU_METHOD
/begin COMPU_METHOD fak_ub_b1 "" RAT_FUNC "%6.4" "-" COEFFS 0 256 0 0 0 1 /end COMPU_METHOD
/begin COMPU_METHOD fak_ub_b2 "" RAT_FUNC "%8.5" "-" COEFFS 0 256 0 0 0 2 /end COMPU_METHOD
/begin COMPU_METHOD fak_uw_b2 "" RAT_FUNC "%7.6" "-" COEFFS 0 65536 0 0 0 2 /end COMPU_METHOD
/begin COMPU_METHOD kw_q0p0234 "" RAT_FUNC "%6.4" "Grad KW" COEFFS 0 32768 0 0 0 768 /end COMPU_METHOD
/begin COMPU_METHOD kw_q0p75 "" RAT_FUNC "%6.3" "Grad KW" COEFFS 0 4 0 0 0 3 /end COMPU_METHOD
/begin COMPU_METHOD kw_q0p75_o240 "" RAT_FUNC "%6.1" "Grad KW" COEFFS 0 4 -960 0 0 3 /end COMPU_METHOD
/begin COMPU_METHOD kw_q1p5 "" RAT_FUNC "%6.2" "deg KW" COEFFS 0 256 0 0 0 384 /end COMPU_METHOD
/begin COMPU_METHOD rel_uw_b3072 "" RAT_FUNC "%6.4" "%" COEFFS 0 65536 0 0 0 3072 /end COMPU_METHOD
/begin COMPU_METHOD rel_uw_q0p0234 "" RAT_FUNC "%6.4" "%" COEFFS 0 32 0 0 0 0.75 /end COMPU_METHOD
/begin COMPU_METHOD Temp_Cels "" RAT_FUNC "%6.1" "deg C" COEFFS 0 10 2731.4 0 0 1 /end COMPU_METHOD
/begin COMPU_METHOD temp_q0p1 "" RAT_FUNC "%6.3" "Grad C" COEFFS 0 10 0 0 0 1 /end COMPU_METHOD
/begin COMPU_METHOD t_q0p04_ms "" RAT_FUNC "%6.4" "ms" COEFFS 0 1 0 0 0 0.04 /end COMPU_METHOD
/begin RECORD_LAYOUT RB_Axis_S16 NO_AXIS_PTS_X 1 SWORD AXIS_PTS_X 2 SWORD INDEX_INCR DIRECT /end RECORD_LAYOUT
/begin RECORD_LAYOUT RB_Axis_U16 NO_AXIS_PTS_X 1 UWORD AXIS_PTS_X 2 UWORD INDEX_INCR DIRECT /end RECORD_LAYOUT
/begin RECORD_LAYOUT RB_Curve_U8_U8 NO_AXIS_PTS_X 1 UBYTE AXIS_PTS_X 2 UBYTE INDEX_INCR DIRECT FNC_VALUES 3 UBYTE COLUMN_DIR DIRECT /end RECORD_LAYOUT
/begin RECORD_LAYOUT RB_MapGroup_S8 FNC_VALUES 1 SBYTE COLUMN_DIR DIRECT /end RECORD_LAYOUT
/begin RECORD_LAYOUT RB_MapGroup_U16 FNC_VALUES 1 UWORD COLUMN_DIR DIRECT /end RECORD_LAYOUT
/begin RECORD_LAYOUT RB_MapGroup_U8 FNC_VALUES 1 UBYTE COLUMN_DIR DIRECT /end RECORD_LAYOUT
/begin RECORD_LAYOUT RB_Map_S16S16_S16 NO_AXIS_PTS_X 1 SWORD NO_AXIS_PTS_Y 2 SWORD AXIS_PTS_X 3 SWORD INDEX_INCR DIRECT AXIS_PTS_Y 4 SWORD INDEX_INCR DIRECT FNC_VALUES 5 SWORD COLUMN_DIR DIRECT /end RECORD_LAYOUT
/begin RECORD_LAYOUT RB_Map_S16S16_U8 NO_AXIS_PTS_X 1 SWORD NO_AXIS_PTS_Y 2 SWORD AXIS_PTS_X 3 SWORD INDEX_INCR DIRECT AXIS_PTS_Y 4 SWORD INDEX_INCR DIRECT FNC_VALUES 5 UBYTE COLUMN_DIR DIRECT /end RECORD_LAYOUT
/begin RECORD_LAYOUT RB_Map_S16U16_S16 NO_AXIS_PTS_X 1 SWORD NO_AXIS_PTS_Y 2 SWORD AXIS_PTS_X 3 SWORD INDEX_INCR DIRECT AXIS_PTS_Y 4 UWORD INDEX_INCR DIRECT FNC_VALUES 5 SWORD ROW_DIR DIRECT /end RECORD_LAYOUT
/begin RECORD_LAYOUT RB_Val_Ws16 FNC_VALUES 1 SWORD COLUMN_DIR DIRECT /end RECORD_LAYOUT
/begin RECORD_LAYOUT RB_Val_Wu16 FNC_VALUES 1 UWORD COLUMN_DIR DIRECT /end RECORD_LAYOUT
/begin RECORD_LAYOUT RB_Val_Wu8 FNC_VALUES 1 UBYTE COLUMN_DIR DIRECT /end RECORD_LAYOUT
/end MODULE
/end PROJECT
