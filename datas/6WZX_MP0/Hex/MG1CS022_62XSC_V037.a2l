ASAP2_VERSION 1 60
/begin PROJECT MG1CS022 "MG1CS022"
/begin HEADER "" VERSION "MG1CS022_62XSC_V037" PROJECT_NO MG1CS022 /end HEADER
/begin MODULE DIM ""
/begin MOD_COMMON "" BYTE_ORDER MSB_LAST ALIGNMENT_BYTE 1 ALIGNMENT_WORD 2 ALIGNMENT_LONG 4 ALIGNMENT_INT64 4 ALIGNMENT_FLOAT32_IEEE 4 ALIGNMENT_FLOAT64_IEEE 4 DATA_SIZE 32 /end MOD_COMMON
/begin CHARACTERISTIC ComEBS_BattID2_C "Battery ID2" VALUE 0x80543008 RB_Val_Wu8 63.00 dez 0.00 63.00 FORMAT "%5.2" EXTENDED_LIMITS 0.00 255.0 /end CHARACTERISTIC
/begin CHARACTERISTIC ComEBS_BattID_C "Battery ID" VALUE 0x80543009 RB_Val_Wu8 63.00 dez 0.00 63.00 FORMAT "%5.2" EXTENDED_LIMITS 0.00 255.0 /end CHARACTERISTIC
/begin CHARACTERISTIC Com_ctCRingENGL_C "CAN RingCounter for ENGL Frame" VALUE 0x80542F78 RB_Val_Wu8 255.0 OneToOne 0.00 255.0 FORMAT "%5.1" /end CHARACTERISTIC
/begin CHARACTERISTIC Com_ctCRingENGQ_C "Intial value for Alive counter of ENGQ frame" VALUE 0x80542F80 RB_Val_Wu8 3.000 OneToOne 0.00 3.000 FORMAT "%5.3" EXTENDED_LIMITS 0.00 255.0 /end CHARACTERISTIC
/begin CHARACTERISTIC Com_dENG18SigSel_C "Signal selection data for ENG18 frame" VALUE 0x80542DD2 RB_Val_Wu8 255.0 OneToOne 0.00 255.0 FORMAT "%5.1" /end CHARACTERISTIC
/begin CHARACTERISTIC Com_dENG19SigSel_C "Signal selection data for ENG19 frame" VALUE 0x80542DD3 RB_Val_Wu8 255.0 OneToOne 0.00 255.0 FORMAT "%5.1" /end CHARACTERISTIC
/begin CHARACTERISTIC Com_dENG21SigSel_C "Signal selection data for ENG21 frame" VALUE 0x80542DD6 Val_Wu8 255.0 OneToOne 0.00 255.0 FORMAT "%5.1" /end CHARACTERISTIC
/begin CHARACTERISTIC Com_dENG25SigSel_C "Signal selection data for ENG25 frame" VALUE 0x80542F30 RB_Val_Wu8 255.0 OneToOne 0.00 255.0 FORMAT "%5.1" /end CHARACTERISTIC
/begin CHARACTERISTIC Com_dENG2SigSel_C "Signal selection data for ENG2 frame" VALUE 0x80542DD4 RB_Val_Wu8 255.0 OneToOne 0.00 255.0 FORMAT "%5.1" /end CHARACTERISTIC
/begin CHARACTERISTIC Com_dENGASigSel_C "Signal selection data for ENGA frame" VALUE 0x80542F32 RB_Val_Wu8 255.0 OneToOne 0.00 255.0 FORMAT "%5.1" /end CHARACTERISTIC
/begin CHARACTERISTIC Com_dENGBSigSel_C "Signal selection data for ENGB frame" VALUE 0x80542F38 RB_Val_Wu8 255.0 OneToOne 0.00 255.0 FORMAT "%5.1" /end CHARACTERISTIC
/begin CHARACTERISTIC Com_dENGJ3SigSel_C "Signal selection data for ENGJ3 frame" VALUE 0x80542F4A Val_Wu8 255.0 OneToOne 0.00 255.0 FORMAT "%5.1" /end CHARACTERISTIC
/begin CHARACTERISTIC Com_dENGK3SigSel_C "Signal selection data for ENGK3 frame" VALUE 0x80542F50 RB_Val_Wu8 255.0 OneToOne 0.00 255.0 FORMAT "%5.1" /end CHARACTERISTIC
/begin CHARACTERISTIC Com_dENGLSigSel_C "Signal selection data for ENGL frame" VALUE 0x80542F79 RB_Val_Wu8 255.0 OneToOne 0.00 255.0 FORMAT "%5.1" /end CHARACTERISTIC
/begin CHARACTERISTIC Com_dENGOSigSel_C "Signal selection data for ENGO frame" VALUE 0x80542F7E RB_Val_Wu8 255.0 OneToOne 0.00 255.0 FORMAT "%5.1" /end CHARACTERISTIC
/begin CHARACTERISTIC Com_dENGQSigSel_C "Signal selection data for ENGQ frame" VALUE 0x80542F81 RB_Val_Wu8 255.0 OneToOne 0.00 255.0 FORMAT "%5.1" /end CHARACTERISTIC
/begin CHARACTERISTIC Com_dENGRSigSel_C "Signal selection data for ENGR frame" VALUE 0x80542FA4 RB_Val_Wu8 255.0 OneToOne 0.00 255.0 FORMAT "%5.1" /end CHARACTERISTIC
/begin CHARACTERISTIC Com_dENGT2SigSel_C "Signal selection data for ENGT2 frame" VALUE 0x80542FA8 RB_Val_Wu8 255.0 OneToOne 0.00 255.0 FORMAT "%5.1" /end CHARACTERISTIC
/begin CHARACTERISTIC Com_dENGUSigSel_C "Signal selection data for ENGU frame" VALUE 0x80542FB0 RB_Val_Wu8 255.0 OneToOne 0.00 255.0 FORMAT "%5.1" /end CHARACTERISTIC
/begin CHARACTERISTIC Com_dENGV2SigSel_C "Signal selection data for ENGV2 frame" VALUE 0x80542FB2 RB_Val_Wu8 255.0 OneToOne 0.00 255.0 FORMAT "%5.1" /end CHARACTERISTIC
/begin CHARACTERISTIC Com_dENGWSigSel_C "Signal selection data for EngW frame" VALUE 0x80543004 Val_Wu8 255.0 OneToOne 0.00 255.0 FORMAT "%5.1" /end CHARACTERISTIC
/begin CHARACTERISTIC Com_dENGYSigSel_C "Signal selection data for ENGY frame" VALUE 0x80543005 RB_Val_Wu8 255.0 OneToOne 0.00 255.0 FORMAT "%5.1" /end CHARACTERISTIC
/begin CHARACTERISTIC Com_dENGZSigSel_C "Signal selection data for ENGZ frame" VALUE 0x80543006 RB_Val_Wu8 255.0 OneToOne 0.00 255.0 FORMAT "%5.1" /end CHARACTERISTIC
/begin CHARACTERISTIC Com_dPhysAdr_C "Physical address sent to Meter unit from Engine ECU" VALUE 0x80542F7C Val_Wu8 255.0 OneToOne 0.00 255.0 FORMAT "%5.1" /end CHARACTERISTIC
/begin CHARACTERISTIC Com_ErrDeb_Tmr1ACh_C "Timer Calibration value for which error in 1AC Frame should be present to set ENG_RECEIVE_ERROR information to 1" VALUE 0x80542FAC RB_Val_Ws32 42949672950.0 Time_ms -21474836480.0 21474836470.0 FORMAT "%13.1" /end CHARACTERISTIC
/begin CHARACTERISTIC Com_facAltCutOffConv_CUR "Curve for Gradual Excitation Cancel Speed" CURVE 0x8054300A RB_Curve_S16_S16 15.00000 Fact1 0.00 15.00000 FORMAT "%8.5" EXTENDED_LIMITS -256.0000 255.9922
 /begin AXIS_DESCR STD_AXIS Alt_nCutOff EngN 15 20.00 10000.00 FORMAT "%8.2" EXTENDED_LIMITS -16384.00 16383.50 DEPOSIT ABSOLUTE /end AXIS_DESCR
/end CHARACTERISTIC
/begin CHARACTERISTIC Com_facFlConsAdd_C "Calibration parameter" VALUE 0x80542F3C RB_Val_Ws32 4294967295.00 OneToOne -2147483648.00 2147483647.00 FORMAT "%13.2" /end CHARACTERISTIC
/begin CHARACTERISTIC Com_iAltExctLimOfs_C "Calibration offset value for Lin conversion of adjusting voltage" VALUE 0x80543048 RB_Val_Ws16 65535.00 Curr -32768.00 32767.00 FORMAT "%8.2" /end CHARACTERISTIC
/begin CHARACTERISTIC Com_iAltExctLimSlp_C "Calibration slope value for Lin conversion of adjusting voltage" VALUE 0x8054304C RB_Val_Ws32 250.000000000 Fact 0.00 250.000000000 FORMAT "%13.9" EXTENDED_LIMITS -262144.000000 262143.999878 /end CHARACTERISTIC
/begin CHARACTERISTIC Com_nEngHi_C "Hysteris upper limit of engine speed for Engine stall information." VALUE 0x80542DCC RB_Val_Ws16 32767.50 EngN -16384.00 16383.50 FORMAT "%8.2" /end CHARACTERISTIC
/begin CHARACTERISTIC Com_nEngLo_C "Hysteris lower limit of engine speed for Engine stall information." VALUE 0x80542DCE RB_Val_Ws16 32767.50 EngN -16384.00 16383.50 FORMAT "%8.2" /end CHARACTERISTIC
/begin CHARACTERISTIC Com_nEngSpdRampNeg_C "Negative slope of Ramp switch in smoothing of Tachometer" VALUE 0x80542F54 RB_Val_Ws32 32767999.9924 RmpEngN -16384000.0000 16383999.9924 FORMAT "%13.4" /end CHARACTERISTIC
/begin CHARACTERISTIC Com_nEngSpdRampPos_C "Positive slope of Ramp switch in smoothing of Tachometer" VALUE 0x80542F58 RB_Val_Ws32 32767999.9924 RmpEngN -16384000.0000 16383999.9924 FORMAT "%13.4" /end CHARACTERISTIC
/begin CHARACTERISTIC Com_nMinEngStillRun_C "minimum threshold for engine run" VALUE 0x80542F5C RB_Val_Ws16 32767.50 EngN -16384.00 16383.50 FORMAT "%8.2" /end CHARACTERISTIC
/begin CHARACTERISTIC Com_nrACGDbgInfoTx_C "ACG Debug information for transmission" VALUE 0x80543050 RB_Val_Wu8 7.000 OneToOne 0.00 7.000 FORMAT "%5.3" EXTENDED_LIMITS 0.00 255.0 /end CHARACTERISTIC
/begin CHARACTERISTIC Com_nstatThdXHysHi_C "High Hysteresis Threshold X value of Engine Speed" VALUE 0x80542F5E RB_Val_Ws8 2550. nmot_ub_q10 -1280. 1270. FORMAT "%5.0" /end CHARACTERISTIC
/begin CHARACTERISTIC Com_nstatThdXHysLo_C "Low Hysteresis Threshold X value of Engine Speed" VALUE 0x80542F5F RB_Val_Ws8 2550. nmot_ub_q10 -1280. 1270. FORMAT "%5.0" /end CHARACTERISTIC
/begin CHARACTERISTIC Com_nstatThdYHysHi_C "High Hysteresis Threshold Y value of Engine Speed" VALUE 0x80542F60 RB_Val_Ws8 1280. nmot_ub_q10 -1280. 0.00 FORMAT "%5.0" EXTENDED_LIMITS -1280. 1270. /end CHARACTERISTIC
/begin CHARACTERISTIC Com_nstatThdYHysLo_C "Low Hysteresis Threshold Y value of Engine Speed" VALUE 0x80542F61 RB_Val_Ws8 1280. nmot_ub_q10 -1280. 0.00 FORMAT "%5.0" EXTENDED_LIMITS -1280. 1270. /end CHARACTERISTIC
/begin CHARACTERISTIC Com_numCsumENGL_C "CAN CheckSum for ENGL Frame" VALUE 0x80542F7A RB_Val_Wu8 255.0 OneToOne 0.00 255.0 FORMAT "%5.1" /end CHARACTERISTIC
/begin CHARACTERISTIC Com_numCsumENGQ_C "Intial value for Checksum of ENGQ frame" VALUE 0x80542F82 RB_Val_Wu8 15.00 OneToOne 0.00 15.00 FORMAT "%5.2" EXTENDED_LIMITS 0.00 255.0 /end CHARACTERISTIC
/begin CHARACTERISTIC Com_numTCUMilReqDFC_CA "Calibration Array of DFCs that triggers MIL on Request" VAL_BLK 0x804F5A7A RB_ValA_Wu16 906.000000000 DFC_Verb 0.00 906.000000000 FORMAT "%13.9" NUMBER 12 /end CHARACTERISTIC
/begin CHARACTERISTIC Com_rAppHysHi_C "High hysteresis value of Accelerator pedal" VALUE 0x80542F62 RB_Val_Ws16 799.9878 Prc -400.0000 399.9878 FORMAT "%8.4" /end CHARACTERISTIC
/begin CHARACTERISTIC Com_rAppHysLo_C "Low hysteresis value of Accelerator pedal" VALUE 0x80542F64 RB_Val_Ws16 799.9878 Prc -400.0000 399.9878 FORMAT "%8.4" /end CHARACTERISTIC
/begin CHARACTERISTIC Com_rThrVlvActAdj_C "Calibration adjust for Actual throttle Aperture" VALUE 0x80542DC0 RB_Val_Wu16 159.9976 reldeg_q0p002441 0.00 159.9976 FORMAT "%8.4" /end CHARACTERISTIC
/begin CHARACTERISTIC Com_stBlkSensWaEna_C "Calibration for Block Sensor warning" VALUE 0x80542F40 RB_Val_Wu8 1.000 OneToOne 0.00 1.000 FORMAT "%5.3" EXTENDED_LIMITS 0.00 255.0 /end CHARACTERISTIC
/begin CHARACTERISTIC Com_stClntTempWaEna_C "Calibration for Coolant Temperature Failure warning" VALUE 0x80542F41 RB_Val_Wu8 1.000 OneToOne 0.00 1.000 FORMAT "%5.3" EXTENDED_LIMITS 0.00 255.0 /end CHARACTERISTIC
/begin CHARACTERISTIC Com_stConvalch_CUR "Curve to convert Ethanol concentration to factor" CURVE 0x80542F83 RB_Curve_U8_U8 255.0 OneToOne 0.00 255.0 FORMAT "%5.1" READ_ONLY
 /begin AXIS_DESCR STD_AXIS alchpct_msg rel_ub_b100 16 0.00 99.61 FORMAT "%5.2" DEPOSIT ABSOLUTE /end AXIS_DESCR
/end CHARACTERISTIC
/begin CHARACTERISTIC Com_stDrvModDisp_C "Driver Mode Display Calibration" VALUE 0x80542F66 RB_Val_Wu8 255.0 OneToOne 0.00 255.0 FORMAT "%5.1" /end CHARACTERISTIC
/begin CHARACTERISTIC Com_stEngRemSt_C "calibration for remote engine starter status" VALUE 0x80542F7F RB_Val_Wu8 1.000 OneToOne 0.00 1.000 FORMAT "%5.3" EXTENDED_LIMITS 0.00 255.0 /end CHARACTERISTIC
/begin CHARACTERISTIC Com_stIdleNeutMsk_C "Calibration for Engine Idle Neutral Judgment" VALUE 0x80542DC4 RB_Val_Wu32 4294967295.00 OneToOne 0.00 4294967295.00 FORMAT "%13.2" /end CHARACTERISTIC
/begin CHARACTERISTIC Com_stRemEngStrtMilSeln_C "caliration for remote engine starter MIL selection" VALUE 0x80542F33 RB_Val_Wu8 255.0 OneToOne 0.00 255.0 FORMAT "%5.1" /end CHARACTERISTIC
/begin CHARACTERISTIC Com_stSwtEstmTqNormJdg_C "Switch to change the estimated torque accuracy flag info" VALUE 0x80542F31 RB_Val_Wu8 1.00000000000 B_TRUE 0.00 1.00000000000 FORMAT "%13.11" /end CHARACTERISTIC
/begin CHARACTERISTIC Com_stSwtMinTqAllwd_C "Calibration to enable message switching for ENG_IDAS_MIN_TORQUE" VALUE 0x80542DD7 RB_Val_Wu8 2.000 OneToOne 0.00 2.000 FORMAT "%5.3" EXTENDED_LIMITS 0.00 255.0 /end CHARACTERISTIC
/begin CHARACTERISTIC Com_swFIdEngIDASFail_C "Calibration parameter for switching FId_ComIDASEngFail" VALUE 0x80542DD8 RB_Val_Wboolean 1.00000000000 B_TRUE 0.00 1.00000000000 FORMAT "%13.11" /end CHARACTERISTIC
/begin CHARACTERISTIC Com_swtENGYFrmTypSel_C "Frame type selection switch for ENGY and ENGY2" VALUE 0x805912E8 Val_Wu8 1.000 OneToOne 0.00 1.000 FORMAT "%5.3" EXTENDED_LIMITS 0.00 255.0 /end CHARACTERISTIC
/begin CHARACTERISTIC Com_swtFlLvlMonEna_C "Calibration switch to enable or disable to monitor Fuel level signal on IG - OFF" VALUE 0x80542F67 Val_Wu8 1.00000000000 B_TRUE 0.00 1.00000000000 FORMAT "%13.11" /end CHARACTERISTIC
/begin CHARACTERISTIC Com_swtImsLmpDisbl_C "Immobilizer key lamp Enable/Disable switch" VALUE 0x80542F42 RB_Val_Wu8 1.000 OneToOne 0.00 1.000 FORMAT "%5.3" EXTENDED_LIMITS 0.00 255.0 /end CHARACTERISTIC
/begin CHARACTERISTIC Com_SwtMaxTqAllwd_C "Calibration to enable message switching for ENG_IDAS_MAX_TORQUE" VALUE 0x80542DD9 Val_Wu8 1.000 OneToOne 0.00 1.000 FORMAT "%5.3" EXTENDED_LIMITS 0.00 255.0 /end CHARACTERISTIC
/begin CHARACTERISTIC Com_swtMILMulDisbl_C "CAN switch for Multi information switch" VALUE 0x80542F34 RB_Val_Wu8 1.000 OneToOne 0.00 1.000 FORMAT "%5.3" EXTENDED_LIMITS 0.00 255.0 /end CHARACTERISTIC
/begin CHARACTERISTIC Com_SwtMilMultiBDi_C "Switch to disable the Multi information display Type B for MIL status" VALUE 0x80542F35 RB_Val_Wu8 1.000 OneToOne 0.00 1.000 FORMAT "%5.3" EXTENDED_LIMITS 0.00 255.0 /end CHARACTERISTIC
/begin CHARACTERISTIC Com_swtNEng_C "switch for selection of engine speed" VALUE 0x80542DD0 RB_Val_Wu8 255.0 OneToOne 0.00 255.0 FORMAT "%5.1" /end CHARACTERISTIC
/begin CHARACTERISTIC Com_swtSmotngCtrl_C "Smoothing Control switch" VALUE 0x80542F68 RB_Val_Wu8 255.0 OneToOne 0.00 255.0 FORMAT "%5.1" /end CHARACTERISTIC
/begin CHARACTERISTIC Com_swtTqRvsnEnaFlg_C "Switch for Torque adjustment permission flag" VALUE 0x80542DC8 RB_Val_Wu8 1.000 OneToOne 0.00 1.000 FORMAT "%5.3" EXTENDED_LIMITS 0.00 255.0 /end CHARACTERISTIC
/begin CHARACTERISTIC Com_tiAltLoadRespOfs_C "Calibration offset value for Lin conversion of gradual excitation time" VALUE 0x80543052 RB_Val_Ws16 400.0000 Period 0.00 400.0000 FORMAT "%8.4" EXTENDED_LIMITS -3276.800 3276.700 /end CHARACTERISTIC
/begin CHARACTERISTIC Com_tiAltLoadRespSlp_C "Calibration slope value for Lin conversion of gradual excitation time" VALUE 0x80543054 RB_Val_Ws16 65535.00 OneToOne -32768.00 32767.00 FORMAT "%8.2" /end CHARACTERISTIC
/begin CHARACTERISTIC Com_tiEngAwk_C "Calibration for exceeding post drive time" VALUE 0x80542F69 RB_Val_Wu8 255.0 t_q1p0 0.00 255.0 FORMAT "%5.1" /end CHARACTERISTIC
/begin CHARACTERISTIC Com_tiEngSpdPT1_C "PT1 filter timer for Engine Speed" VALUE 0x80542F6C RB_Val_Ws32 4294.9672940000000 TimeDelay_s 0.0000020000000 4294.9672959999998 FORMAT "%19.14" EXTENDED_LIMITS 0.000002000000001 4294.9672959999998 /end CHARACTERISTIC
/begin CHARACTERISTIC Com_tiFlFWLvlLmp_C "Delay time for Com_stFlFWLvl to get updated by FlFWLvl_stLmp" VALUE 0x80542F4C RB_Val_Ws16 65540.00 Time_ms -32770.00 32770.00 FORMAT "%8.2" EXTENDED_LIMITS -327680.0 327670.0 /end CHARACTERISTIC
/begin CHARACTERISTIC Com_tiHACCut_C "calibration infomration for Timet AC Cut Infomation" VALUE 0x80542DCA RB_Val_Ws16 65535.00 t_q1_ms -32768.00 32767.00 FORMAT "%8.2" /end CHARACTERISTIC
/begin CHARACTERISTIC Com_tiIDASInhbDly_C "Calibration parameter for debounce time of inhibit information about IDAS" VALUE 0x80542DDA Val_Ws16 327670.0 Time_ms 0.00 327670.0 FORMAT "%8.1" EXTENDED_LIMITS -327680.0 327670.0 /end CHARACTERISTIC
/begin CHARACTERISTIC Com_tiOilLmpOff_C "Delay time for oil pressure warning lamp" VALUE 0x80542F44 RB_Val_Ws16 655350.0 Time_ms -327680.0 327670.0 FORMAT "%8.1" /end CHARACTERISTIC
/begin CHARACTERISTIC Com_tiOilLowOn_C "Delay time for oil low warning lamp" VALUE 0x80542F4E RB_Val_Ws16 65540.00 Time_ms -32770.00 32770.00 FORMAT "%8.2" EXTENDED_LIMITS -327680.0 327670.0 /end CHARACTERISTIC
/begin CHARACTERISTIC Com_tiShrtIgnOn_C "Short IG ON Time calibration" VALUE 0x80542F70 RB_Val_Wu16 655.3500 Time_s 0.00 655.3500 FORMAT "%8.4" /end CHARACTERISTIC
/begin CHARACTERISTIC Com_tiSmotngFlag_C "Time calibration for Smoothing function condition flag" VALUE 0x80542F72 RB_Val_Wu8 2550. Time_ms 0.00 2550. FORMAT "%5.0" /end CHARACTERISTIC
/begin CHARACTERISTIC Com_tTFixSensFail_C "Fix temperature value in case of sensor fail" VALUE 0x80542F46 RB_Val_Ws16 6553.500 Temp_Cels -3549.940 3003.560 FORMAT "%8.3" /end CHARACTERISTIC
/begin CHARACTERISTIC Com_uAltFinalDesOfs_C "Calibration of Offset for Adjusting voltage of the alternator" VALUE 0x80543056 RB_Val_Ws16 10600.00 Volt1 0.00 10600.00 FORMAT "%8.2" EXTENDED_LIMITS -32768.00 32767.00 /end CHARACTERISTIC
/begin CHARACTERISTIC Com_uAltFinalDesSlp_C "Calibration of Slop for Adjusting voltage of the alternator" VALUE 0x80543058 RB_Val_Ws16 65535.00 OneToOne -32768.00 32767.00 FORMAT "%8.2" /end CHARACTERISTIC
/begin CHARACTERISTIC Com_VehVFltMin_C "Minimum vehicle speed at transimission" VALUE 0x80542F48 RB_Val_Ws16 20.00000 Vel 0.00 20.00000 FORMAT "%8.5" EXTENDED_LIMITS -327.6800 327.6700 /end CHARACTERISTIC
/begin CHARACTERISTIC Com_vVehSpdHysHi_C "High hysteresis value of Vehicle Speed" VALUE 0x80542F74 RB_Val_Ws16 655.3500 Vel -327.6800 327.6700 FORMAT "%8.4" /end CHARACTERISTIC
/begin CHARACTERISTIC Com_vVehSpdHysLo_C "low hysteresis value of Vehicle Speed" VALUE 0x80542F76 RB_Val_Ws16 655.3500 Vel -327.6800 327.6700 FORMAT "%8.4" /end CHARACTERISTIC
/begin CHARACTERISTIC Com_xAsgnFrzSig_CA "Calibration for Freeze signals" VAL_BLK 0x80542FB4 RB_ValA_Wu16 1168.00000000 Signals_IntSigNumVerb 0.00 1168.00000000 FORMAT "%13.8" NUMBER 40 /end CHARACTERISTIC
/begin CHARACTERISTIC CWAEVABU "code word for function AEVABU" VALUE 0x8054305C RB_Val_Wu8 255.0 dez 0.00 255.0 FORMAT "%5.1" /end CHARACTERISTIC
/begin CHARACTERISTIC DNMAXH "Exceeding of the engine speed limit leading to fuel cut-off in all cylinders" VALUE 0x8054305E RB_Val_Wu16 16383.75 nmot_sw_q0p25 0.00 16383.75 FORMAT "%8.2" /end CHARACTERISTIC
/begin CHARACTERISTIC EngICO_nMaxAppDfct_C "Max engine Speed in case of defect App signal" VALUE 0x80543060 RB_Val_Wu8 8160. nmot_q32 0.00 8160. FORMAT "%5.0" /end CHARACTERISTIC
/begin CHARACTERISTIC EngICO_nMaxAppDpd_Cur "Engine speed dependent on App" CURVE 0x80543061 RB_Curve_U8_U8 8160. nmot_q32 0.00 8160. FORMAT "%5.0"
 /begin AXIS_DESCR STD_AXIS EngICO_nMaxApp relPED_ub_b100 6 0.00 100.0 FORMAT "%5.1" DEPOSIT ABSOLUTE /end AXIS_DESCR
/end CHARACTERISTIC
/begin CHARACTERISTIC EngICO_nMaxVDpd_Cur "Engine speed dependent on Veocity" CURVE 0x8054306E RB_Curve_S16_U8_Static 8160. nmot_q32 0.00 8160. FORMAT "%5.0"
 /begin AXIS_DESCR STD_AXIS EngICO_nMaxV vel_q0p01 6 -327.6800 327.6700 FORMAT "%8.4" DEPOSIT ABSOLUTE /end AXIS_DESCR
/end CHARACTERISTIC
/begin CHARACTERISTIC EngICO_nMax_C "Engine speed over all limiting" VALUE 0x80543082 RB_Val_Wu8 8160. nmot_q32 0.00 8160. FORMAT "%5.0" /end CHARACTERISTIC
/begin CHARACTERISTIC EngPrt_numEngTBltDampr_C "Parameter to select the suitable temperature from the temperature array" VALUE 0x80543084 RB_Val_Wu8 255.0 OneToOne 0.00 255.0 FORMAT "%5.1" /end CHARACTERISTIC
/begin CHARACTERISTIC EngPrt_swtInpTSeln_C "Temperature selector switch" VALUE 0x80543085 RB_Val_Wu8 1.00000000000 B_TRUE 0.00 1.00000000000 FORMAT "%13.11" /end CHARACTERISTIC
/begin CHARACTERISTIC EngPrt_tAirThd_C "Temperature Threshold" VALUE 0x80543086 RB_Val_Ws16 6553.500 Temp_Cels -3549.940 3003.560 FORMAT "%8.3" /end CHARACTERISTIC
/begin CHARACTERISTIC EngPrt_tiDlyBltDrvVbrDampr_C "Time Delay parameter" VALUE 0x80543088 RB_Val_Wu16 655.3500 Time_s 0.00 655.3500 FORMAT "%8.4" /end CHARACTERISTIC
/begin CHARACTERISTIC EngPrt_tmrAftStrtThd_C "Timer threshold" VALUE 0x8054308A RB_Val_Wu16 655.3500 t_q0p01 0.00 655.3500 FORMAT "%8.4" /end CHARACTERISTIC
/begin CHARACTERISTIC EngPrt_tqBltDrvVbrDampr_C "Torque threshold" VALUE 0x8054308C RB_Val_Ws16 6553.500 Trq -3276.800 3276.700 FORMAT "%8.3" /end CHARACTERISTIC
/begin CHARACTERISTIC EngPrt_tqDeltaBltDrvVbrDampr_C "Delta torque for the hysteresis" VALUE 0x8054308E RB_Val_Ws16 6553.500 Trq -3276.800 3276.700 FORMAT "%8.3" /end CHARACTERISTIC
/begin CHARACTERISTIC EngPrt_trqInrNLim_CUR "HEV: curve for limitation of engine speed on ENG (inner engine torque)" CURVE 0x80543090 RB_Curve_S16_S16 3276.700 Trq 0.00 3276.700 FORMAT "%8.3" EXTENDED_LIMITS -3276.800 3276.700
 /begin AXIS_DESCR STD_AXIS Epm_nEng EngN 4 -16384.00 16383.50 FORMAT "%8.2" DEPOSIT ABSOLUTE /end AXIS_DESCR
/end CHARACTERISTIC
/begin CHARACTERISTIC EngPrt_trqLimOvrSpdFCODem_C "Torque threshold for release of fuel cut-off" VALUE 0x805430A2 RB_Val_Ws16 3276.700 Trq 0.00 3276.700 FORMAT "%8.3" EXTENDED_LIMITS -3276.800 3276.700 /end CHARACTERISTIC
/begin CHARACTERISTIC Eng_tqAdjusMinIDAS_MAP "A map to adjust the value of ENG_IDAS_MINMUM_TORQUE" MAP 0x80542DDC RB_Map_S16S16_S16 65535.00 Trq_float -32768.00 32767.00 FORMAT "%8.2"
 /begin AXIS_DESCR STD_AXIS VehV_v Vel 12 -327.6800 327.6700 FORMAT "%8.4" DEPOSIT ABSOLUTE /end AXIS_DESCR
 /begin AXIS_DESCR STD_AXIS AccPed_rTrq TransR 12 -327.6800 327.6700 FORMAT "%8.4" DEPOSIT ABSOLUTE /end AXIS_DESCR
/end CHARACTERISTIC
/begin MEASUREMENT B_evabu_msg "Condition: Ev- disconnection by monitoring functions" UBYTE B_TRUE 1 100 0.00 1.00000000000 BIT_MASK 0x1 FORMAT "%13.11" ECU_ADDRESS 0x70000BD6 /end MEASUREMENT
/begin MEASUREMENT ComEBS_BattID "Battery ID" UBYTE dez 1 100 0.00 255.0 FORMAT "%5.1" ECU_ADDRESS 0x6000FF4E /end MEASUREMENT
/begin MEASUREMENT Com_bCVTIdleStop "Status of idle stop request" UBYTE B_TRUE 1 100 0.00 1.00000000000 BIT_MASK 0x1 FORMAT "%13.11" ECU_ADDRESS 0x6000F9D0 /end MEASUREMENT
/begin MEASUREMENT Com_bCVTStopEna "Status of Preparation for Idle Stop" UBYTE B_TRUE 1 100 0.00 1.00000000000 BIT_MASK 0x1 FORMAT "%13.11" ECU_ADDRESS 0x6000F9CF /end MEASUREMENT
/begin MEASUREMENT Com_cntBankFrozenNew "Count of Bank frozen in Current DCY" UBYTE OneToOne 1 100 0.00 255.0 FORMAT "%5.1" ECU_ADDRESS 0x6000BA33 /end MEASUREMENT
/begin MEASUREMENT Com_cntBankFrozenNewOld "Count of Bank frozen in Current DCY old" UBYTE OneToOne 1 100 0.00 255.0 FORMAT "%5.1" ECU_ADDRESS 0x6000BA32 /end MEASUREMENT
/begin MEASUREMENT Com_cntDTCCfmdOld "Holds the previously confirmed DTC count" UBYTE OneToOne 1 100 0.00 255.0 FORMAT "%5.1" ECU_ADDRESS 0x600393CC /end MEASUREMENT
/begin MEASUREMENT Com_cntDTCPendingOld "Holds the previously pending DTC count" UBYTE OneToOne 1 100 0.00 255.0 FORMAT "%5.1" ECU_ADDRESS 0x600393CB /end MEASUREMENT
/begin MEASUREMENT Com_cntOBSOld "Holds the previous OBS freeze count" UBYTE OneToOne 1 100 0.00 255.0 FORMAT "%5.1" ECU_ADDRESS 0x600393CA /end MEASUREMENT
/begin MEASUREMENT Com_ctCRingENG10 "Ring counter for ENG10 frame" UBYTE OneToOne 1 100 0.00 255.0 FORMAT "%5.1" ECU_ADDRESS 0x6000F865 /end MEASUREMENT
/begin MEASUREMENT Com_ctCRingENG11 "Ring counter for ENG11 frame" UBYTE OneToOne 1 100 0.00 255.0 FORMAT "%5.1" ECU_ADDRESS 0x6000F864 /end MEASUREMENT
/begin MEASUREMENT Com_ctCRingENG15 "CAN RingCounter for ENG15 Frame" UBYTE OneToOne 1 100 0.00 255.0 FORMAT "%5.1" ECU_ADDRESS 0x6000FF1D /end MEASUREMENT
/begin MEASUREMENT Com_ctCRingENG16 "Message counter for Eng16 frame" UBYTE OneToOne 1 100 0.00 255.0 FORMAT "%5.1" ECU_ADDRESS 0x6000FF1C /end MEASUREMENT
/begin MEASUREMENT Com_ctCRingENG17 "the message Counter for ENG17 frame" UBYTE OneToOne 1 100 0.00 255.0 FORMAT "%5.1" ECU_ADDRESS 0x6000FF1B /end MEASUREMENT
/begin MEASUREMENT Com_ctCRingENG18 "Message counter for Eng18 frame" UBYTE OneToOne 1 100 0.00 3.000 FORMAT "%5.3" ECU_ADDRESS 0x6000FF1A /end MEASUREMENT
/begin MEASUREMENT Com_ctCRingENG19 "Ring Counter For ENG19 Frame" UBYTE OneToOne 1 100 0.00 255.0 FORMAT "%5.1" ECU_ADDRESS 0x6000F863 /end MEASUREMENT
/begin MEASUREMENT Com_ctCRingENG2 "Message counter info ENG2" UBYTE OneToOne 1 100 0.00 3.000 FORMAT "%5.3" ECU_ADDRESS 0x6000FF16 /end MEASUREMENT
/begin MEASUREMENT Com_ctCRingENG20 "Message counter for Eng20 frame." UBYTE OneToOne 1 100 0.00 255.0 FORMAT "%5.1" ECU_ADDRESS 0x6000F862 /end MEASUREMENT
/begin MEASUREMENT Com_ctCRingENG21 "Ring counter message for Eng21 frame" UBYTE OneToOne 1 100 0.00 255.0 FORMAT "%5.1" ECU_ADDRESS 0x6000FF18 /end MEASUREMENT
/begin MEASUREMENT Com_ctCRingENG22 "Ring counter of ENG22 frame" UBYTE OneToOne 1 100 0.00 3.000 FORMAT "%5.3" ECU_ADDRESS 0x6000FF17 /end MEASUREMENT
/begin MEASUREMENT Com_ctCRingENG23 "Ring counter for Engine 23 Frame" UBYTE OneToOne 1 100 0.00 3.000 FORMAT "%5.3" ECU_ADDRESS 0x6000F861 /end MEASUREMENT
/begin MEASUREMENT Com_ctCRingENG24 "Ring counter for ENG24 frame" UBYTE OneToOne 1 100 0.00 3.000 FORMAT "%5.3" ECU_ADDRESS 0x6000F860 /end MEASUREMENT
/begin MEASUREMENT Com_ctCRingENG25 "Ring counter for ENG25 frame" UBYTE OneToOne 1 100 0.00 3.000 FORMAT "%5.3" ECU_ADDRESS 0x6000F85F /end MEASUREMENT
/begin MEASUREMENT Com_ctCRingENG3 "Message counter for ENG3 frame" UBYTE OneToOne 1 100 0.00 3.000 FORMAT "%5.3" ECU_ADDRESS 0x6000FF15 /end MEASUREMENT
/begin MEASUREMENT Com_ctCRingENG4 "Message Counter info for ENG4 frame" UBYTE OneToOne 1 100 0.00 3.000 FORMAT "%5.3" ECU_ADDRESS 0x6000FF14 /end MEASUREMENT
/begin MEASUREMENT Com_ctCRingENG5 "Frame counter info ENG5" UBYTE OneToOne 1 100 0.00 3.000 FORMAT "%5.3" ECU_ADDRESS 0x6000FF13 /end MEASUREMENT
/begin MEASUREMENT Com_ctCRingENG6 "message counter info ENG6" UBYTE OneToOne 1 100 0.00 3.000 FORMAT "%5.3" ECU_ADDRESS 0x6000FF12 /end MEASUREMENT
/begin MEASUREMENT Com_ctCRingENGA "Message counter info ENGA" UBYTE OneToOne 1 100 0.00 255.0 FORMAT "%5.1" ECU_ADDRESS 0x60010198 /end MEASUREMENT
/begin MEASUREMENT Com_ctCRingENGAE "Message for ring counter oF ENGAE frame" UBYTE OneToOne 1 100 0.00 3.000 FORMAT "%5.3" ECU_ADDRESS 0x6000F85E /end MEASUREMENT
/begin MEASUREMENT Com_ctCRingENGB "message counter info of ENGB" UBYTE OneToOne 1 100 0.00 255.0 FORMAT "%5.1" ECU_ADDRESS 0x6000FF11 /end MEASUREMENT
/begin MEASUREMENT Com_ctCRingENGC "Frame counter info for ENGC" UBYTE OneToOne 1 100 0.00 255.0 FORMAT "%5.1" ECU_ADDRESS 0x6000FF10 /end MEASUREMENT
/begin MEASUREMENT Com_ctCRingENGF "Message counter info ENGF" UBYTE OneToOne 1 100 0.00 255.0 FORMAT "%5.1" ECU_ADDRESS 0x6000FF0F /end MEASUREMENT
/begin MEASUREMENT Com_ctCRingENGIMG1 "Ring Counter for ENGIMG1 frame" UBYTE OneToOne 1 100 0.00 3.000 FORMAT "%5.3" ECU_ADDRESS 0x6000F85D /end MEASUREMENT
/begin MEASUREMENT Com_ctCRingENGJ "Message counter info ENGJ" UBYTE OneToOne 1 100 0.00 255.0 FORMAT "%5.1" ECU_ADDRESS 0x6000FF0E /end MEASUREMENT
/begin MEASUREMENT Com_ctCRingENGK "Frame counter info ENGK" UBYTE OneToOne 1 100 0.00 255.0 FORMAT "%5.1" ECU_ADDRESS 0x6000FF0D /end MEASUREMENT
/begin MEASUREMENT Com_ctCRingENGL "CAN RingCounter for ENGL Frame" UBYTE OneToOne 1 100 0.00 255.0 FORMAT "%5.1" ECU_ADDRESS 0x6000FF0C /end MEASUREMENT
/begin MEASUREMENT Com_ctCRingENGN "Ring counter for frame ENGN" UBYTE OneToOne 1 100 0.00 255.0 FORMAT "%5.1" ECU_ADDRESS 0x6000F85C /end MEASUREMENT
/begin MEASUREMENT Com_ctCRingENGO "message counter info ENGO" UBYTE OneToOne 1 100 0.00 255.0 FORMAT "%5.1" ECU_ADDRESS 0x6000F85B /end MEASUREMENT
/begin MEASUREMENT Com_ctCRingENGQ "Ring counter for ENGQ frame" UBYTE OneToOne 1 100 0.00 3.000 FORMAT "%5.3" ECU_ADDRESS 0x6000F85A /end MEASUREMENT
/begin MEASUREMENT Com_ctCRingENGR "Message counter info ENGR" UBYTE OneToOne 1 100 0.00 255.0 FORMAT "%5.1" ECU_ADDRESS 0x6000FF0B /end MEASUREMENT
/begin MEASUREMENT Com_ctCRingENGT "Can ring counter for ENGT frame" UBYTE OneToOne 1 100 0.00 255.0 FORMAT "%5.1" ECU_ADDRESS 0x6000FF08 /end MEASUREMENT
/begin MEASUREMENT Com_ctCRingENGT1 "Engine T1 alive counter" UBYTE OneToOne 1 100 0.00 255.0 FORMAT "%5.1" ECU_ADDRESS 0x6000FF0A /end MEASUREMENT
/begin MEASUREMENT Com_ctCRingENGT2 "Ring Counter message for ENGT2 Frame" UBYTE OneToOne 1 100 0.00 255.0 FORMAT "%5.1" ECU_ADDRESS 0x6000FF09 /end MEASUREMENT
/begin MEASUREMENT Com_ctCRingENGU "Ring Counter Message for Transmission frame ENGU" UBYTE OneToOne 1 100 0.00 255.0 FORMAT "%5.1" ECU_ADDRESS 0x6000FF07 /end MEASUREMENT
/begin MEASUREMENT Com_ctCRingENGV2 "Ring Counter message for ENGV2 Frame" UBYTE OneToOne 1 100 0.00 255.0 FORMAT "%5.1" ECU_ADDRESS 0x6000FF06 /end MEASUREMENT
/begin MEASUREMENT Com_ctCRingENGW "Message counter info ENGW" UBYTE OneToOne 1 100 0.00 255.0 FORMAT "%5.1" ECU_ADDRESS 0x6000FF05 /end MEASUREMENT
/begin MEASUREMENT Com_ctCRingENGX "Message counter for EngX frame" UBYTE OneToOne 1 100 0.00 255.0 FORMAT "%5.1" ECU_ADDRESS 0x6000F859 /end MEASUREMENT
/begin MEASUREMENT Com_ctCRingENGY "Message counter for EngY frame" UBYTE OneToOne 1 100 0.00 255.0 FORMAT "%5.1" ECU_ADDRESS 0x6001015F /end MEASUREMENT
/begin MEASUREMENT Com_ctCRingENGZ "Message counter for ENGZ frame." UBYTE OneToOne 1 100 0.00 255.0 FORMAT "%5.1" ECU_ADDRESS 0x60010197 /end MEASUREMENT
/begin MEASUREMENT Com_ctEngData "Data frame counter for ENGV2" UBYTE OneToOne 1 100 0.00 255.0 FORMAT "%5.1" ECU_ADDRESS 0x6000FEEF /end MEASUREMENT
/begin MEASUREMENT Com_ctFrmENGN "Frame number for frame ENGN" UBYTE OneToOne 1 100 0.00 255.0 FORMAT "%5.1" ECU_ADDRESS 0x6000FEEE /end MEASUREMENT
/begin MEASUREMENT Com_ctFrzSyn "Freeze data synchronization counter" UBYTE OneToOne 1 100 0.00 255.0 FORMAT "%5.1" ECU_ADDRESS 0x6000FEED /end MEASUREMENT
/begin MEASUREMENT Com_ctIdxCptr "Count of captured entires for DFC_ComATMILReq in DFES_numDFC" UBYTE OneToOne 1 100 0.00 255.0 FORMAT "%5.1" ECU_ADDRESS 0x6000FEEC /end MEASUREMENT
/begin MEASUREMENT Com_ctReIni10msENG19 "ReInit Counter for ENG19 frame" UBYTE OneToOne 1 100 0.00 255.0 FORMAT "%5.1" ECU_ADDRESS 0x6000BA36 /end MEASUREMENT
/begin MEASUREMENT Com_ctReIni10msENG24 "ReInit Counter for ENG24 frame" UBYTE OneToOne 1 100 0.00 255.0 FORMAT "%5.1" ECU_ADDRESS 0x6000BA35 /end MEASUREMENT
/begin MEASUREMENT Com_ctReIni10msENGA "ReInit Counter for ENGA frame" UBYTE OneToOne 1 100 0.00 255.0 FORMAT "%5.1" ECU_ADDRESS 0x6000BA34 /end MEASUREMENT
/begin MEASUREMENT Com_ctReIni10msENGB "ReInit Counter for ENGB frame" UBYTE OneToOne 1 100 0.00 255.0 FORMAT "%5.1" ECU_ADDRESS 0x6000BA2E /end MEASUREMENT
/begin MEASUREMENT Com_ctReIni10msENGK "ReInit Counter for ENGK frame" UBYTE OneToOne 1 100 0.00 255.0 FORMAT "%5.1" ECU_ADDRESS 0x6000BA2D /end MEASUREMENT
/begin MEASUREMENT Com_ctReIni10msENGV2 "ReInit Counter for ENGV2 frame" UBYTE OneToOne 1 100 0.00 255.0 FORMAT "%5.1" ECU_ADDRESS 0x6000BA25 /end MEASUREMENT
/begin MEASUREMENT Com_ctReIni10msENGW "ReInit Counter for ENGW frame" UBYTE OneToOne 1 100 0.00 255.0 FORMAT "%5.1" ECU_ADDRESS 0x6000BA24 /end MEASUREMENT
/begin MEASUREMENT Com_dDTCInfo "Array to hold the values of DTCs in confirmed state that is to be sent to Meter unit" UWORD OneToOne 1 100 0.00 65535.00 FORMAT "%8.2" ARRAY_SIZE 6 ECU_ADDRESS 0x6000956A /end MEASUREMENT
/begin MEASUREMENT Com_dDTCRaw1 "Raw value of DTC output to Meter" UWORD OneToOne 1 100 0.00 65535.00 FORMAT "%8.2" ECU_ADDRESS 0x60009568 /end MEASUREMENT
/begin MEASUREMENT Com_dDTCRaw2 "Raw value of DTC output to Meter" UWORD OneToOne 1 100 0.00 65535.00 FORMAT "%8.2" ECU_ADDRESS 0x60009566 /end MEASUREMENT
/begin MEASUREMENT Com_dDTCRaw3 "Raw value of DTC output to Meter" UWORD OneToOne 1 100 0.00 65535.00 FORMAT "%8.2" ECU_ADDRESS 0x60009564 /end MEASUREMENT
/begin MEASUREMENT Com_dIdxDFESEntry "Index data of DFES_numENtries for DFC_ComATMILReq" UBYTE OneToOne 1 100 0.00 255.0 FORMAT "%5.1" ARRAY_SIZE 20 ECU_ADDRESS 0x6000F843 /end MEASUREMENT
/begin MEASUREMENT Com_dPhysAdr "Physical address sent to Meter unit by Engine ECU" UBYTE OneToOne 1 100 0.00 255.0 FORMAT "%5.1" ECU_ADDRESS 0x6000FEE5 /end MEASUREMENT
/begin MEASUREMENT Com_dstOilLfTiRedMilg "Data on remaining distance" UWORD dist_uw_q1 1 100 0.00 65535.00 FORMAT "%8.2" ECU_ADDRESS 0x60009E1C /end MEASUREMENT
/begin MEASUREMENT Com_flgACReq "A/C Clutch Connection Status" UBYTE OneToOne 1 100 0.00 255.0 FORMAT "%5.1" ECU_ADDRESS 0x6000FEE3 /end MEASUREMENT
/begin MEASUREMENT Com_flgCylIndFcoStrtd "Condition: overrun fuel cut-off" UBYTE OneToOne 1 100 0.00 255.0 FORMAT "%5.1" ECU_ADDRESS 0x6000FEDF /end MEASUREMENT
/begin MEASUREMENT Com_flgEngAwkReq "Engine stay awake request status" UBYTE B_TRUE 1 100 0.00 1.00000000000 BIT_MASK 0x1 FORMAT "%13.11" ECU_ADDRESS 0x6000F9C4 /end MEASUREMENT
/begin MEASUREMENT Com_flgEngAwkReqPostDrv "Engine stay awake request flag in PostDrive" UBYTE B_TRUE 1 100 0.00 1.00000000000 FORMAT "%13.11" ECU_ADDRESS 0x6000BA2C /end MEASUREMENT
/begin MEASUREMENT Com_flgEngAwkReqTiElpd "Engine stay awake request status eslaped" UBYTE B_TRUE 1 100 0.00 1.00000000000 BIT_MASK 0x1 FORMAT "%13.11" ECU_ADDRESS 0x6000BA2B /end MEASUREMENT
/begin MEASUREMENT Com_flgEngSleepPrep "Engine sleep preparation" UBYTE B_TRUE 1 100 0.00 1.00000000000 BIT_MASK 0x1 FORMAT "%13.11" ECU_ADDRESS 0x6000BA2A /end MEASUREMENT
/begin MEASUREMENT Com_flgEngStLimr "Engine state for speed limiter Com message" UBYTE B_TRUE 1 100 0.00 1.00000000000 BIT_MASK 0x1 FORMAT "%13.11" ECU_ADDRESS 0x6000F9C3 /end MEASUREMENT
/begin MEASUREMENT Com_flgFcoRdy "Fuel Cut ready state" UBYTE OneToOne 1 100 0.00 255.0 FORMAT "%5.1" ECU_ADDRESS 0x6000FEDC /end MEASUREMENT
/begin MEASUREMENT Com_flgISABReq "status of ISAB Request" UBYTE OneToOne 1 100 0.00 255.0 FORMAT "%5.1" ECU_ADDRESS 0x6000FEDB /end MEASUREMENT
/begin MEASUREMENT Com_flgISSRSFF "Com flag for storing the output of ISS RS Flip Flop" UBYTE B_TRUE 1 100 0.00 1.00000000000 BIT_MASK 0x1 FORMAT "%13.11" ECU_ADDRESS 0x6000BA29 /end MEASUREMENT
/begin MEASUREMENT Com_flgLstIgnOnShrt "Last IG ON Short Time Flag" UBYTE B_TRUE 1 100 0.00 1.00000000000 FORMAT "%13.11" ECU_ADDRESS 0x6000BA28 /end MEASUREMENT
/begin MEASUREMENT Com_flgTCUMilReqDFCErase "FCM Erase status flag for DFC_ComATMILReq" UBYTE B_TRUE 1 100 0.00 1.00000000000 BIT_MASK 0x1 FORMAT "%13.11" ECU_ADDRESS 0x6000F9B9 /end MEASUREMENT
/begin MEASUREMENT Com_flgValFailJdg "Failure information for engine coolant temperature" UBYTE B_TRUE 1 100 0.00 1.00000000000 BIT_MASK 0x1 FORMAT "%13.11" ECU_ADDRESS 0x6000F9B8 /end MEASUREMENT
/begin MEASUREMENT Com_flgValNormJdg "Normal information for 2nd engine coolant temperature" UBYTE B_TRUE 1 100 0.00 1.00000000000 BIT_MASK 0x1 FORMAT "%13.11" ECU_ADDRESS 0x6000F9B7 /end MEASUREMENT
/begin MEASUREMENT Com_flgVehSpdLimr "Status of Speed Limiter Upward Request" UBYTE B_TRUE 1 100 0.00 1.00000000000 BIT_MASK 0x1 FORMAT "%13.11" ECU_ADDRESS 0x6000F9B6 /end MEASUREMENT
/begin MEASUREMENT Com_flgVirtApp "ENG_APOPEN virtual gas pedal status" UBYTE OneToOne 1 100 0.00 255.0 FORMAT "%5.1" ECU_ADDRESS 0x6000FED8 /end MEASUREMENT
/begin MEASUREMENT Com_lTotRing "Value of distance travelled by vehicle transmitted over CAN" SWORD Length_Km_q0p001 1 100 -32.76800 32.76700 FORMAT "%8.5" ECU_ADDRESS 0x60009AFA /end MEASUREMENT
/begin MEASUREMENT Com_nEngSpd "current engine speed" SWORD EngN 1 100 -16384.00 16383.50 FORMAT "%8.2" ECU_ADDRESS 0x60009AF8 /end MEASUREMENT
/begin MEASUREMENT Com_nEngSpdSmotng "Smoothing control of tachometer Value" SWORD EngN 1 100 -16384.00 16383.50 FORMAT "%8.2" ECU_ADDRESS 0x60009AF6 /end MEASUREMENT
/begin MEASUREMENT Com_nEngSpdSmotng_MP "Switch ramp output of Engine Speed" SWORD EngN 1 100 -16384.00 16383.50 FORMAT "%8.2" ECU_ADDRESS 0x7000A2C8 /end MEASUREMENT
/begin MEASUREMENT Com_nEngSpd_MP "Filtered Engine Speed measuring point" SWORD EngN 1 100 -16384.00 16383.50 FORMAT "%8.2" ECU_ADDRESS 0x7000A2C6 /end MEASUREMENT
/begin MEASUREMENT Com_nISSEng "Engine speed after ISS starts" SWORD EngN 1 100 -16384.00 16383.50 FORMAT "%8.2" ECU_ADDRESS 0x60009AF4 /end MEASUREMENT
/begin MEASUREMENT Com_nrCsumENG15 "Checksum for ENG15 frame." UBYTE OneToOne 1 100 0.00 255.0 FORMAT "%5.1" ECU_ADDRESS 0x6000FED4 /end MEASUREMENT
/begin MEASUREMENT Com_nrEngByte1 "Engine data byte1" UBYTE OneToOne 1 100 0.00 255.0 FORMAT "%5.1" ECU_ADDRESS 0x6000FED3 /end MEASUREMENT
/begin MEASUREMENT Com_nrEngByte2 "Engine data byte2" UBYTE OneToOne 1 100 0.00 255.0 FORMAT "%5.1" ECU_ADDRESS 0x6000FED2 /end MEASUREMENT
/begin MEASUREMENT Com_nrEngByte3 "Engine data byte3" UBYTE OneToOne 1 100 0.00 255.0 FORMAT "%5.1" ECU_ADDRESS 0x6000FED1 /end MEASUREMENT
/begin MEASUREMENT Com_nrEngByte4 "Engine data byte4" UBYTE OneToOne 1 100 0.00 255.0 FORMAT "%5.1" ECU_ADDRESS 0x6000FED0 /end MEASUREMENT
/begin MEASUREMENT Com_nrEngByte5 "Engine data byte5" UBYTE OneToOne 1 100 0.00 255.0 FORMAT "%5.1" ECU_ADDRESS 0x6000FECF /end MEASUREMENT
/begin MEASUREMENT Com_nrEngByte6 "Engine data byte6" UBYTE OneToOne 1 100 0.00 255.0 FORMAT "%5.1" ECU_ADDRESS 0x6000FECE /end MEASUREMENT
/begin MEASUREMENT Com_nSetPLo "Low Idle SetPoint Speed" SWORD EngN 1 100 -16384.00 16383.50 FORMAT "%8.2" ECU_ADDRESS 0x60009AF0 /end MEASUREMENT
/begin MEASUREMENT Com_numCsumENG10 "Checksum for ENG10 frame" UBYTE OneToOne 1 100 0.00 255.0 FORMAT "%5.1" ECU_ADDRESS 0x6000F83B /end MEASUREMENT
/begin MEASUREMENT Com_numCsumENG11 "Checksum for ENG11 frame" UBYTE OneToOne 1 100 0.00 255.0 FORMAT "%5.1" ECU_ADDRESS 0x6000F83A /end MEASUREMENT
/begin MEASUREMENT Com_numCsumENG16 "Checksum message for Eng16 frame" UBYTE OneToOne 1 100 0.00 255.0 FORMAT "%5.1" ECU_ADDRESS 0x6000FEC0 /end MEASUREMENT
/begin MEASUREMENT Com_numCsumENG17 "The Checksum for ENG17 frame" UBYTE OneToOne 1 100 0.00 255.0 FORMAT "%5.1" ECU_ADDRESS 0x6000FEBF /end MEASUREMENT
/begin MEASUREMENT Com_numCsumENG18 "Checksum message for Eng18 frame" UBYTE OneToOne 1 100 0.00 15.00 FORMAT "%5.2" ECU_ADDRESS 0x6000FEBE /end MEASUREMENT
/begin MEASUREMENT Com_numCsumENG19 "Checksum of ENG19 Frame" UBYTE OneToOne 1 100 0.00 255.0 FORMAT "%5.1" ECU_ADDRESS 0x6000F839 /end MEASUREMENT
/begin MEASUREMENT Com_numCsumENG2 "Checksum message for frame ENG2" UBYTE OneToOne 1 100 0.00 15.00 FORMAT "%5.2" ECU_ADDRESS 0x6000FEBA /end MEASUREMENT
/begin MEASUREMENT Com_numCsumENG20 "Checksum message for Eng20 frame." UBYTE OneToOne 1 100 0.00 255.0 FORMAT "%5.1" ECU_ADDRESS 0x6000F838 /end MEASUREMENT
/begin MEASUREMENT Com_numCsumENG21 "Checksum message for Eng21 frame" UBYTE OneToOne 1 100 0.00 255.0 FORMAT "%5.1" ECU_ADDRESS 0x6000FEBC /end MEASUREMENT
/begin MEASUREMENT Com_numCsumENG22 "Checksum of ENG22 frame" UBYTE OneToOne 1 100 0.00 15.00 FORMAT "%5.2" ECU_ADDRESS 0x6000FEBB /end MEASUREMENT
/begin MEASUREMENT Com_numCsumENG23 "Checksum message for Engine 23 Frame" UBYTE OneToOne 1 100 0.00 15.00 FORMAT "%5.2" ECU_ADDRESS 0x6000F837 /end MEASUREMENT
/begin MEASUREMENT Com_numCsumENG24 "Checksum for ENG24 frmae" UBYTE OneToOne 1 100 0.00 15.00 FORMAT "%5.2" ECU_ADDRESS 0x6000F836 /end MEASUREMENT
/begin MEASUREMENT Com_numCsumENG25 "Checksum for ENG25 frame" UBYTE OneToOne 1 100 0.00 15.00 FORMAT "%5.2" ECU_ADDRESS 0x6000F835 /end MEASUREMENT
/begin MEASUREMENT Com_numCsumENG3 "Checksum message for ENG3 frame" UBYTE OneToOne 1 100 0.00 15.00 FORMAT "%5.2" ECU_ADDRESS 0x6000FEB9 /end MEASUREMENT
/begin MEASUREMENT Com_numCsumENG4 "Checksum message for frame ENG4" UBYTE OneToOne 1 100 0.00 15.00 FORMAT "%5.2" ECU_ADDRESS 0x6000FEB8 /end MEASUREMENT
/begin MEASUREMENT Com_numCsumENG5 "Checksum message for frame ENG5" UBYTE OneToOne 1 100 0.00 15.00 FORMAT "%5.2" ECU_ADDRESS 0x6000FEB7 /end MEASUREMENT
/begin MEASUREMENT Com_numCsumENG6 "Checksum message for ENG6 frame" UBYTE OneToOne 1 100 0.00 15.00 FORMAT "%5.2" ECU_ADDRESS 0x6000FEB6 /end MEASUREMENT
/begin MEASUREMENT Com_numCsumENGA "Checksum message for frame ENGA" UBYTE OneToOne 1 100 0.00 255.0 FORMAT "%5.1" ECU_ADDRESS 0x60010196 /end MEASUREMENT
/begin MEASUREMENT Com_numCsumENGAE "Message fr checksum of frame ENGAE" UBYTE OneToOne 1 100 0.00 15.00 FORMAT "%5.2" ECU_ADDRESS 0x6000F834 /end MEASUREMENT
/begin MEASUREMENT Com_numCsumENGB "Checksum message for ENGB frame" UBYTE OneToOne 1 100 0.00 255.0 FORMAT "%5.1" ECU_ADDRESS 0x6000FEB5 /end MEASUREMENT
/begin MEASUREMENT Com_numCsumENGC "Checksum message for frame ENGC" UBYTE OneToOne 1 100 0.00 255.0 FORMAT "%5.1" ECU_ADDRESS 0x6000FEB4 /end MEASUREMENT
/begin MEASUREMENT Com_numCsumENGF "Checksum message for frame ENGF" UBYTE OneToOne 1 100 0.00 255.0 FORMAT "%5.1" ECU_ADDRESS 0x6000FEB3 /end MEASUREMENT
/begin MEASUREMENT Com_numCsumENGIMG1 "Checksum message for Engine IMG1 Frame" UBYTE OneToOne 1 100 0.00 15.00 FORMAT "%5.2" ECU_ADDRESS 0x6000F833 /end MEASUREMENT
/begin MEASUREMENT Com_numCsumENGJ "Checksum message for frame ENGJ" UBYTE OneToOne 1 100 0.00 255.0 FORMAT "%5.1" ECU_ADDRESS 0x6000FEB2 /end MEASUREMENT
/begin MEASUREMENT Com_numCsumENGK "Checksum message for frame ENGK" UBYTE OneToOne 1 100 0.00 255.0 FORMAT "%5.1" ECU_ADDRESS 0x6000FEB1 /end MEASUREMENT
/begin MEASUREMENT Com_numCsumENGL "Check sum for ENGL frame" UBYTE OneToOne 1 100 0.00 255.0 FORMAT "%5.1" ECU_ADDRESS 0x6000FEB0 /end MEASUREMENT
/begin MEASUREMENT Com_numCsumENGN "Checksum for the CAN frame ENGN" UBYTE OneToOne 1 100 0.00 255.0 FORMAT "%5.1" ECU_ADDRESS 0x6000F832 /end MEASUREMENT
/begin MEASUREMENT Com_numCsumENGO "Checksum message for ENGO frame" UBYTE OneToOne 1 100 0.00 255.0 FORMAT "%5.1" ECU_ADDRESS 0x6000F831 /end MEASUREMENT
/begin MEASUREMENT Com_numCsumENGQ "Checksum for ENGQ frame" UBYTE OneToOne 1 100 0.00 15.00 FORMAT "%5.2" ECU_ADDRESS 0x6000F830 /end MEASUREMENT
/begin MEASUREMENT Com_numCsumENGR "Checksum message for frame ENGR" UBYTE OneToOne 1 100 0.00 255.0 FORMAT "%5.1" ECU_ADDRESS 0x6000FEAF /end MEASUREMENT
/begin MEASUREMENT Com_numCsumENGT "Checksum message for ENGT frame" UBYTE OneToOne 1 100 0.00 255.0 FORMAT "%5.1" ECU_ADDRESS 0x6000FEAC /end MEASUREMENT
/begin MEASUREMENT Com_numCsumENGT1 "Checksum counter for ENGT1" UBYTE OneToOne 1 100 0.00 255.0 FORMAT "%5.1" ECU_ADDRESS 0x6000FEAE /end MEASUREMENT
/begin MEASUREMENT Com_numCsumENGT2 "Check sum Message for ENGT2" UBYTE OneToOne 1 100 0.00 255.0 FORMAT "%5.1" ECU_ADDRESS 0x6000FEAD /end MEASUREMENT
/begin MEASUREMENT Com_numCsumENGU "Checksum message for ENGU Trasnmission frame" UBYTE OneToOne 1 100 0.00 255.0 FORMAT "%5.1" ECU_ADDRESS 0x6000FEAB /end MEASUREMENT
/begin MEASUREMENT Com_numCsumENGV2 "Checksum of ENGV2 Frame" UBYTE OneToOne 1 100 0.00 255.0 FORMAT "%5.1" ECU_ADDRESS 0x6000FEAA /end MEASUREMENT
/begin MEASUREMENT Com_numCsumENGW "Checksum for ENGW frame" UBYTE OneToOne 1 100 0.00 255.0 FORMAT "%5.1" ECU_ADDRESS 0x6000FEA9 /end MEASUREMENT
/begin MEASUREMENT Com_numCsumENGX "Checksum message for EngX frame" UBYTE OneToOne 1 100 0.00 255.0 FORMAT "%5.1" ECU_ADDRESS 0x6000F82F /end MEASUREMENT
/begin MEASUREMENT Com_numCsumENGY "Checksum message for EngY frame" UBYTE OneToOne 1 100 0.00 255.0 FORMAT "%5.1" ECU_ADDRESS 0x6001015E /end MEASUREMENT
/begin MEASUREMENT Com_numCsumENGZ "Checksum message for ENGZ frame" UBYTE OneToOne 1 100 0.00 255.0 FORMAT "%5.1" ECU_ADDRESS 0x60010195 /end MEASUREMENT
/begin MEASUREMENT Com_numCurrfrzDFC "Current Freeze frame DFC available on tester" UWORD DFC_Verb 1 100 0.00 906.000000000 FORMAT "%13.9" ECU_ADDRESS 0x60007A48 /end MEASUREMENT
/begin MEASUREMENT Com_numCurrfrzDFCOld "Old Freeze frame DFC available on tester" UWORD DFC_Verb 1 100 0.00 906.000000000 FORMAT "%13.9" ECU_ADDRESS 0x600393C8 /end MEASUREMENT
/begin MEASUREMENT Com_numIdxDFC "Index of current Freeze frame DFC available on tester" UBYTE OneToOne 1 100 0.00 255.0 FORMAT "%5.1" ECU_ADDRESS 0x6000F82C /end MEASUREMENT
/begin MEASUREMENT Com_numIdxDFCOld "Index of old Freeze frame DFC available on tester" UBYTE OneToOne 1 100 0.00 255.0 FORMAT "%5.1" ECU_ADDRESS 0x600393C6 /end MEASUREMENT
/begin MEASUREMENT Com_numTCUMilReqDFC "DFC Id info of DFC_ComATMILReq" UWORD OneToOne 1 100 0.00 65535.00 FORMAT "%8.2" ARRAY_SIZE 12 ECU_ADDRESS 0x50005CAC /end MEASUREMENT
/begin MEASUREMENT Com_numTraGearDisp "Actual Gear Number Display" SBYTE OneToOne 1 100 -128.0 127.0 FORMAT "%5.1" ECU_ADDRESS 0x60010009 /end MEASUREMENT
/begin MEASUREMENT Com_pClnt "Temporary value of A/C head pressure in bar" UWORD Pres_kPa_ENGY 1 100 0.00 65535.00 FORMAT "%8.2" ECU_ADDRESS 0x60009E1A /end MEASUREMENT
/begin MEASUREMENT Com_pEngOil "Engine Oil pressure" SWORD Pres 1 100 -3276.800 3276.700 FORMAT "%8.3" ECU_ADDRESS 0x60009AEC /end MEASUREMENT
/begin MEASUREMENT Com_pEngOil_temp "Temporary variable for Engine Oil pressure" UBYTE q4_kPa 1 100 0.00 1020. FORMAT "%5.0" ECU_ADDRESS 0x6000FE91 /end MEASUREMENT
/begin MEASUREMENT Com_pEnvPRaw "Raw value for Ambient pressure value transmitted on the CAN" UWORD Pres_1_kPa 1 100 0.00 65535.00 FORMAT "%8.2" ECU_ADDRESS 0x6000955C /end MEASUREMENT
/begin MEASUREMENT Com_pEnvPRawENGL "Raw value for Ambient pressure value transmitted on the CAN" UWORD Pres_1_kPa 1 100 0.00 65535.00 FORMAT "%8.2" ECU_ADDRESS 0x6000955A /end MEASUREMENT
/begin MEASUREMENT Com_pforISABIdleStop "Brake Fluid Pressure For Idling Stop" SWORD Pres 1 100 -3276.800 3276.700 FORMAT "%8.3" ECU_ADDRESS 0x60009AE4 /end MEASUREMENT
/begin MEASUREMENT Com_pIntkMnfAir "Intake Manifold Air Pressure" SWORD Pres 1 100 -3276.800 3276.700 FORMAT "%8.3" ECU_ADDRESS 0x60009AEA /end MEASUREMENT
/begin MEASUREMENT Com_rAccrPedlPosn "Accelerator pedal position" UBYTE rel_q0p392 1 100 0.00 100.0 FORMAT "%5.1" ECU_ADDRESS 0x6000FE90 /end MEASUREMENT
/begin MEASUREMENT Com_rACCTxEstSlp "Estimated slope of the road transmitted over CAN" SBYTE Prc_CrCtl3 1 100 -16.00 15.88 FORMAT "%5.2" ECU_ADDRESS 0x60010008 /end MEASUREMENT
/begin MEASUREMENT Com_rDrvAccrPedlPosn "Com message of Accelerator Pedal opening for IUPR message" UWORD q0p005_Perc 1 100 0.00 327.6750 FORMAT "%8.4" ECU_ADDRESS 0x60009554 /end MEASUREMENT
/begin MEASUREMENT Com_rOilLif "Remaining Engine oil life (OIL deterioration index)" UBYTE RBPtCel_Perc_1p0_1 1 100 0.00 255.0 FORMAT "%5.1" ECU_ADDRESS 0x6000F82B /end MEASUREMENT
/begin MEASUREMENT Com_rThrVlvAct "Throttle valve angle" SWORD Com_deg_q0p02441 1 100 -800.0000 799.9756 FORMAT "%8.4" ECU_ADDRESS 0x60009ACA /end MEASUREMENT
/begin MEASUREMENT Com_stalchpct "Ethanol concentration factor" UBYTE OneToOne 1 100 0.00 255.0 FORMAT "%5.1" ECU_ADDRESS 0x6000F80E /end MEASUREMENT
/begin MEASUREMENT Com_stAltFail "Fail information for Alternator" UBYTE OneToOne 1 100 0.00 255.0 FORMAT "%5.1" ECU_ADDRESS 0x6000FE6B /end MEASUREMENT
/begin MEASUREMENT Com_stAutoSta1DCY "Output of SR FlipFlop of Each 1DCY DFCs" UWORD OneToOne 1 100 0.00 65535.00 FORMAT "%8.2" ECU_ADDRESS 0x60038902 /end MEASUREMENT
/begin MEASUREMENT Com_stAutoSta1DCYOld "Previous Driving Cycle value of Output of SR FlipFlop of Each 1DCY DFCs" UWORD OneToOne 1 100 0.00 65535.00 FORMAT "%8.2" ECU_ADDRESS 0x6000954E /end MEASUREMENT
/begin MEASUREMENT Com_stAutoSta2DCY "Output of SR FlipFlop of Each 2DCY DFCs" UBYTE OneToOne 1 100 0.00 255.0 FORMAT "%5.1" ECU_ADDRESS 0x60038901 /end MEASUREMENT
/begin MEASUREMENT Com_stAutoSta2DCYInterStrt "Confirmed Error status for 2DCY DFC_Clth2ONStuckLdc" UBYTE OneToOne 1 100 0.00 255.0 FORMAT "%5.1" ECU_ADDRESS 0x60038900 /end MEASUREMENT
/begin MEASUREMENT Com_stAutoSta2DCYOld "Previous Driving Cycle value of Output of SR FlipFlop of Each 2DCY DFCs" UBYTE OneToOne 1 100 0.00 255.0 FORMAT "%5.1" ECU_ADDRESS 0x6000FE68 /end MEASUREMENT
/begin MEASUREMENT Com_stAutoStaInfo "The status of automatic starter system warning lamp for MID" UBYTE OneToOne 1 100 0.00 255.0 FORMAT "%5.1" ECU_ADDRESS 0x6000FE67 /end MEASUREMENT
/begin MEASUREMENT Com_stAutoStaInfoMtr "Status of Starter system warning lamp for meter display" UBYTE OneToOne 1 100 0.00 255.0 FORMAT "%5.1" ECU_ADDRESS 0x6000FE66 /end MEASUREMENT
/begin MEASUREMENT Com_stAYCFErr "CAN Recieve Error Information" UBYTE OneToOne 1 100 0.00 255.0 FORMAT "%5.1" ECU_ADDRESS 0x6000FE75 /end MEASUREMENT
/begin MEASUREMENT Com_stBankFrozen "status of OBS banks frozen from over DCYs" UBYTE OneToOne 1 100 0.00 255.0 FORMAT "%5.1" ECU_ADDRESS 0x6000BA31 /end MEASUREMENT
/begin MEASUREMENT Com_stBankFrozenNew "status of OBS banks frozen current DCY" UBYTE OneToOne 1 100 0.00 255.0 FORMAT "%5.1" ECU_ADDRESS 0x6000BA30 /end MEASUREMENT
/begin MEASUREMENT Com_stBankFrozenNewOld "status of OBS banks frozen current DCY old" UBYTE OneToOne 1 100 0.00 255.0 FORMAT "%5.1" ECU_ADDRESS 0x6000BA2F /end MEASUREMENT
/begin MEASUREMENT Com_stCCClthSwt "Clutch switch signal for Cruise control" UBYTE OneToOne 1 100 0.00 255.0 FORMAT "%5.1" ECU_ADDRESS 0x6000FE5B /end MEASUREMENT
/begin MEASUREMENT Com_stChkChgnSysInfo "Checking charging system information" UBYTE OneToOne 1 100 0.00 255.0 FORMAT "%5.1" ECU_ADDRESS 0x6000F824 /end MEASUREMENT
/begin MEASUREMENT Com_stChrgnSys "Status of Request Check Charging System" UBYTE OneToOne 1 100 0.00 255.0 FORMAT "%5.1" ECU_ADDRESS 0x6000F823 /end MEASUREMENT
/begin MEASUREMENT Com_stCmnCntCdnStart "In-Use Performance Tracking numerator condition" UBYTE B_TRUE 1 100 0.00 1.00000000000 BIT_MASK 0x1 FORMAT "%13.11" ECU_ADDRESS 0x6000F9B3 /end MEASUREMENT
/begin MEASUREMENT Com_stDcyc "Driving cycle formation flag" UBYTE OneToOne 1 100 0.00 1.000 FORMAT "%5.3" ECU_ADDRESS 0x6000F820 /end MEASUREMENT
/begin MEASUREMENT Com_stDrvModDisp "Driver Mode Display" UBYTE OneToOne 1 100 0.00 255.0 FORMAT "%5.1" ECU_ADDRESS 0x6000FE40 /end MEASUREMENT
/begin MEASUREMENT Com_stDtcInhbClr "Status of DTC Clear Inhibit" UBYTE OneToOne 1 100 0.00 255.0 FORMAT "%5.1" ECU_ADDRESS 0x6000F81D /end MEASUREMENT
/begin MEASUREMENT Com_stDTCUpd "Holds the DTC update notofication status" UBYTE OneToOne 1 100 0.00 3.000 FORMAT "%5.3" ECU_ADDRESS 0x600393C5 /end MEASUREMENT
/begin MEASUREMENT Com_stEMTestModEna "Test Mode Enable Status" UBYTE OneToOne 1 100 0.00 255.0 FORMAT "%5.1" ECU_ADDRESS 0x6000FE2F /end MEASUREMENT
/begin MEASUREMENT Com_stEngBrkApp "Brake for the accelerator pedal on information" UBYTE OneToOne 1 100 0.00 255.0 FORMAT "%5.1" ECU_ADDRESS 0x6000FE18 /end MEASUREMENT
/begin MEASUREMENT Com_stEngBrkOvrdInfo "Engine-ECU Messages (EngECU)" UBYTE OneToOne 1 100 0.00 255.0 FORMAT "%5.1" ECU_ADDRESS 0x6000FE17 /end MEASUREMENT
/begin MEASUREMENT Com_stEngBrkOvrdMtr "Engine-ECU Messages (EngECU)" UBYTE OneToOne 1 100 0.00 255.0 FORMAT "%5.1" ECU_ADDRESS 0x6000FE16 /end MEASUREMENT
/begin MEASUREMENT Com_stEngCooltTFail "Fail information for Engine coolant temperature" UBYTE OneToOne 1 100 0.00 255.0 FORMAT "%5.1" ECU_ADDRESS 0x6000FE15 /end MEASUREMENT
/begin MEASUREMENT Com_stENGECUIG1 "ENG-ECU IG1 status" UBYTE OneToOne 1 100 0.00 255.0 FORMAT "%5.1" ECU_ADDRESS 0x6000FE2E /end MEASUREMENT
/begin MEASUREMENT Com_stEngIntkAirFail "Fail information for Engine intake air temperature" UBYTE OneToOne 1 100 0.00 255.0 FORMAT "%5.1" ECU_ADDRESS 0x6000FE13 /end MEASUREMENT
/begin MEASUREMENT Com_stENGKXPostDrv "ENG K for post drive" UBYTE B_TRUE 1 100 0.00 1.00000000000 BIT_MASK 0x1 FORMAT "%13.11" ECU_ADDRESS 0x6000BA26 /end MEASUREMENT
/begin MEASUREMENT Com_stEngRemSt "remote engine starter status" UBYTE OneToOne 1 100 0.00 255.0 FORMAT "%5.1" ECU_ADDRESS 0x6000F818 /end MEASUREMENT
/begin MEASUREMENT Com_stEngRstrt "The status of engine restart" UBYTE OneToOne 1 100 0.00 255.0 FORMAT "%5.1" ECU_ADDRESS 0x6000FE10 /end MEASUREMENT
/begin MEASUREMENT Com_stEngRtMilUpd "Status of engine runtime MIL update" UBYTE OneToOne 1 100 0.00 255.0 FORMAT "%5.1" ECU_ADDRESS 0x6000FE0F /end MEASUREMENT
/begin MEASUREMENT Com_stEngSpd30DegFail "Fail information of engine speed 30deg" UBYTE OneToOne 1 100 0.00 255.0 FORMAT "%5.1" ECU_ADDRESS 0x6000FE0D /end MEASUREMENT
/begin MEASUREMENT Com_stEngSpdThdX "Threshold X calculation of Engine Speed" UBYTE OneToOne 1 100 0.00 255.0 BIT_MASK 0x1 FORMAT "%5.1" ECU_ADDRESS 0x6000F9B2 /end MEASUREMENT
/begin MEASUREMENT Com_stEngSpdThdY "Threshold Y calculation of Engine Speed" UBYTE OneToOne 1 100 0.00 255.0 BIT_MASK 0x1 FORMAT "%5.1" ECU_ADDRESS 0x6000F9B1 /end MEASUREMENT
/begin MEASUREMENT Com_stEngStop "Engine Stop status" UBYTE OneToOne 1 100 0.00 255.0 FORMAT "%5.1" ECU_ADDRESS 0x6000FE0C /end MEASUREMENT
/begin MEASUREMENT Com_stENGT2AYCAck "Message for ENGT2 AYC acknowledgement" UBYTE OneToOne 1 100 0.00 255.0 FORMAT "%5.1" ECU_ADDRESS 0x6000FE2D /end MEASUREMENT
/begin MEASUREMENT Com_stENGT2NPos "Status of com Gear box neutral position based on transmission type" UBYTE OneToOne 1 100 0.00 255.0 FORMAT "%5.1" ECU_ADDRESS 0x6000FE2C /end MEASUREMENT
/begin MEASUREMENT Com_stENGT2RvsPos "Status of com Gear box reverse position based on transmission type" UBYTE OneToOne 1 100 0.00 255.0 FORMAT "%5.1" ECU_ADDRESS 0x6000FE2B /end MEASUREMENT
/begin MEASUREMENT Com_stENGT2TraType_mp "Status of transmission type" UBYTE OneToOne 1 100 0.00 255.0 FORMAT "%5.1" ECU_ADDRESS 0x7000A2C4 /end MEASUREMENT
/begin MEASUREMENT Com_stEngWrmUp40CycWoFail "40 Warm-up cycle condition positive" UBYTE OneToOne 1 100 0.00 1.000 FORMAT "%5.3" ECU_ADDRESS 0x6000FE0B /end MEASUREMENT
/begin MEASUREMENT Com_stErrLmp "Current status of MIL error lamp" UBYTE OneToOne 1 100 0.00 255.0 FORMAT "%5.1" ECU_ADDRESS 0x6000FE09 /end MEASUREMENT
/begin MEASUREMENT Com_stEstmTqNormJdg "Estimated torque accuracy guarantee flag" UBYTE B_TRUE 1 100 0.00 1.00000000000 BIT_MASK 0x1 FORMAT "%13.11" ECU_ADDRESS 0x6000F9AF /end MEASUREMENT
/begin MEASUREMENT Com_stFailrDetn "Failure Detection status" UBYTE OneToOne 1 100 0.00 3.000 FORMAT "%5.3" ECU_ADDRESS 0x6000FE06 /end MEASUREMENT
/begin MEASUREMENT Com_stFIDInhbn "Inhibition status of current driving cycle" UBYTE OneToOne 1 100 0.00 255.0 FORMAT "%5.1" ECU_ADDRESS 0x60038904 /end MEASUREMENT
/begin MEASUREMENT Com_stFIDInhbnOld "old Status of Inhibition" UBYTE OneToOne 1 100 0.00 255.0 FORMAT "%5.1" ECU_ADDRESS 0x6000F817 /end MEASUREMENT
/begin MEASUREMENT Com_stFrstStrtEnd "ENG start judgment for Tester communication tool" UBYTE B_TRUE 1 100 0.00 1.00000000000 BIT_MASK 0x1 FORMAT "%13.11" ECU_ADDRESS 0x6000F9AE /end MEASUREMENT
/begin MEASUREMENT Com_stFrzLvl "Freeze level" UBYTE OneToOne 1 100 0.00 255.0 FORMAT "%5.1" ECU_ADDRESS 0x6000FDF4 /end MEASUREMENT
/begin MEASUREMENT Com_stFrzUpd "Holds the Freeze data update notification" UBYTE OneToOne 1 100 0.00 3.000 FORMAT "%5.3" ECU_ADDRESS 0x600393C4 /end MEASUREMENT
/begin MEASUREMENT Com_stGbxNPosSFailEngT2 "Message for gear box Neutral Position failure for ENGT2 frame" UBYTE OneToOne 1 100 0.00 255.0 FORMAT "%5.1" ECU_ADDRESS 0x6000FDF1 /end MEASUREMENT
/begin MEASUREMENT Com_stIDASEngFail "Engine failure information for IDAS" UBYTE OneToOne 1 100 0.00 255.0 FORMAT "%5.1" ECU_ADDRESS 0x6000FDE9 /end MEASUREMENT
/begin MEASUREMENT Com_stIDASEngFailOld "Value of Engine failure information about IDAS in previous driving cycle" UBYTE OneToOne 1 100 0.00 255.0 FORMAT "%5.1" ECU_ADDRESS 0x600393CD /end MEASUREMENT
/begin MEASUREMENT Com_stIDASInhb "Inhibit information about IDAS" UBYTE OneToOne 1 100 0.00 255.0 FORMAT "%5.1" ECU_ADDRESS 0x6000FDE8 /end MEASUREMENT
/begin MEASUREMENT Com_stIdxDelCntr_MP "measurement point" UBYTE OneToOne 1 100 0.00 255.0 FORMAT "%5.1" ECU_ADDRESS 0x7000A2CA /end MEASUREMENT
/begin MEASUREMENT Com_stImsLmp "Immobilizer key lamp status" UBYTE OneToOne 1 100 0.00 255.0 FORMAT "%5.1" ECU_ADDRESS 0x6000FDD6 /end MEASUREMENT
/begin MEASUREMENT Com_stISSRelsPreNotif "Pre-notification of release engine stop by ISS" UBYTE OneToOne 1 100 0.00 255.0 FORMAT "%5.1" ECU_ADDRESS 0x6000FDD7 /end MEASUREMENT
/begin MEASUREMENT Com_stISSStrt_mp "Idle Start stop status" UBYTE OneToOne 1 100 0.00 255.0 FORMAT "%5.1" ECU_ADDRESS 0x6000BA27 /end MEASUREMENT
/begin MEASUREMENT Com_stLmp5AltIO "Lamp5 signal or Signal for Alternator is generating voltage" UBYTE OneToOne 1 100 0.00 255.0 FORMAT "%5.1" ECU_ADDRESS 0x6000FDCF /end MEASUREMENT
/begin MEASUREMENT Com_stLmp5AltIOENGO "Message for Charge Lamp Request" UBYTE OneToOne 1 100 0.00 255.0 FORMAT "%5.1" ECU_ADDRESS 0x6000F814 /end MEASUREMENT
/begin MEASUREMENT Com_stMILMul "Status Information of the MultiInformation MIL" UBYTE OneToOne 1 100 0.00 255.0 FORMAT "%5.1" ECU_ADDRESS 0x6000FDC7 /end MEASUREMENT
/begin MEASUREMENT Com_stMilMultiSerios "Multi information of MIL status incase of serious engine failure" UBYTE OneToOne 1 100 0.00 255.0 FORMAT "%5.1" ECU_ADDRESS 0x6000FDC5 /end MEASUREMENT
/begin MEASUREMENT Com_stOBSUpd "Holds the OBS update notification" UBYTE OneToOne 1 100 0.00 3.000 FORMAT "%5.3" ECU_ADDRESS 0x600393C3 /end MEASUREMENT
/begin MEASUREMENT Com_stOilLmp "Oil pressure warning lamp" UBYTE OneToOne 1 100 0.00 255.0 FORMAT "%5.1" ECU_ADDRESS 0x6000FDB5 /end MEASUREMENT
/begin MEASUREMENT Com_stOilLmpInfo "Oil pressure warning lamp status for multi information" UBYTE OneToOne 1 100 0.00 255.0 FORMAT "%5.1" ECU_ADDRESS 0x6000FDB4 /end MEASUREMENT
/begin MEASUREMENT Com_stOilLow "Low oil level status" UBYTE OneToOne 1 100 0.00 255.0 FORMAT "%5.1" ECU_ADDRESS 0x6000FDB3 /end MEASUREMENT
/begin MEASUREMENT Com_stPASensFail "PA Sensor Fail Status" UBYTE OneToOne 1 100 0.00 255.0 FORMAT "%5.1" ECU_ADDRESS 0x6000FDB2 /end MEASUREMENT
/begin MEASUREMENT Com_stPBSensFail "Fail information for manifold pressure by TDC" UBYTE OneToOne 1 100 0.00 255.0 FORMAT "%5.1" ECU_ADDRESS 0x6000FDB1 /end MEASUREMENT
/begin MEASUREMENT Com_stPrmntDenomCdnJdgStop "Judging PFC clear conditions" UBYTE B_TRUE 1 100 0.00 1.00000000000 BIT_MASK 0x1 FORMAT "%13.11" ECU_ADDRESS 0x6000F9AD /end MEASUREMENT
/begin MEASUREMENT Com_stSmotngFlag "Smoothing condition Flag" UBYTE OneToOne 1 100 0.00 255.0 BIT_MASK 0x1 FORMAT "%5.1" ECU_ADDRESS 0x6000F9A9 /end MEASUREMENT
/begin MEASUREMENT Com_stStSpEngStop "engine stop status in case of idle start stop" UBYTE OneToOne 1 100 0.00 255.0 FORMAT "%5.1" ECU_ADDRESS 0x6000FD80 /end MEASUREMENT
/begin MEASUREMENT Com_stT15Eng21 "T15 status for Eng21 frame" UBYTE OneToOne 1 100 0.00 255.0 FORMAT "%5.1" ECU_ADDRESS 0x6000FD7C /end MEASUREMENT
/begin MEASUREMENT Com_stThrPosnFail "Fail information relating to DBW" UBYTE OneToOne 1 100 0.00 255.0 FORMAT "%5.1" ECU_ADDRESS 0x6000FD72 /end MEASUREMENT
/begin MEASUREMENT Com_stTqRvsnEnaFlg "Status of Torque slippage breakdown existence flag" UBYTE OneToOne 1 100 0.00 1.000 FORMAT "%5.3" ECU_ADDRESS 0x6000FD70 /end MEASUREMENT
/begin MEASUREMENT Com_stTrqAccuracySlow "Slow torque required accuracy deterioration" UBYTE OneToOne 1 100 0.00 255.0 FORMAT "%5.1" ECU_ADDRESS 0x6000FD6F /end MEASUREMENT
/begin MEASUREMENT Com_stTrqReqFast "Prohibition of fast torque requests" UBYTE OneToOne 1 100 0.00 255.0 FORMAT "%5.1" ECU_ADDRESS 0x6000FD6E /end MEASUREMENT
/begin MEASUREMENT Com_stTrqReqSlow "Prohibition of slow torque requests" UBYTE OneToOne 1 100 0.00 255.0 FORMAT "%5.1" ECU_ADDRESS 0x6000FD6D /end MEASUREMENT
/begin MEASUREMENT Com_stVINErrENGV2 "EEPROM Fail status" UBYTE OneToOne 1 100 0.00 255.0 FORMAT "%5.1" ECU_ADDRESS 0x6000FD6A /end MEASUREMENT
/begin MEASUREMENT Com_stVINUnRegENGV2 "VIN resistance status" UBYTE OneToOne 1 100 0.00 255.0 FORMAT "%5.1" ECU_ADDRESS 0x6000FD69 /end MEASUREMENT
/begin MEASUREMENT Com_stWarnOilLvl "Oil level sensor failure warning lamp" UBYTE OneToOne 1 100 0.00 255.0 FORMAT "%5.1" ECU_ADDRESS 0x6000FD4C /end MEASUREMENT
/begin MEASUREMENT Com_stWrmUp40Cyc "40 wuc completed in dcy" UBYTE OneToOne 1 100 0.00 1.000 FORMAT "%5.3" ECU_ADDRESS 0x6003991C /end MEASUREMENT
/begin MEASUREMENT Com_swtDrvMod "Control state of ECON transmitted on CAN" UBYTE OneToOne 1 100 0.00 255.0 FORMAT "%5.1" ECU_ADDRESS 0x6000FD49 /end MEASUREMENT
/begin MEASUREMENT Com_tAirCACDs "Message for FId" SWORD Temp_Cels 1 100 -3549.940 3003.560 FORMAT "%8.3" ECU_ADDRESS 0x60009AC2 /end MEASUREMENT
/begin MEASUREMENT Com_tCEngDsT "Received Coolant Temperature" SWORD Temp_Cels 1 100 -3549.940 3003.560 FORMAT "%8.3" ECU_ADDRESS 0x60009ABA /end MEASUREMENT
/begin MEASUREMENT Com_tEngOil "Oil temperature signal quality" SWORD Temp_Cels 1 100 -3549.940 3003.560 FORMAT "%8.3" ECU_ADDRESS 0x60009AB6 /end MEASUREMENT
/begin MEASUREMENT Com_tEngOil_temp "Oil temperature signal quality temp" UBYTE RBPtCel_t_1p0_3 1 100 0.00 255.0 FORMAT "%5.1" ECU_ADDRESS 0x6000FD46 /end MEASUREMENT
/begin MEASUREMENT Com_ThrVlvActSens1AbsltB1 "absolute throttle position" UBYTE relDK_q0p3922 1 100 0.00 100.0 FORMAT "%5.1" ECU_ADDRESS 0x6000FF34 /end MEASUREMENT
/begin MEASUREMENT Com_ThrVlvActSens1RelB1 "relative throttle position" UBYTE relDK_q0p3922 1 100 0.00 100.0 FORMAT "%5.1" ECU_ADDRESS 0x6000FF33 /end MEASUREMENT
/begin MEASUREMENT Com_tiExptFcoStrt "Timer till FC starts Down Counter" ULONG Time_ms_to_us 1 100 0.00 4294967.29500 FORMAT "%13.5" ECU_ADDRESS 0x50004E04 /end MEASUREMENT
/begin MEASUREMENT Com_tiHACCut "Timer information for AC cut" UWORD t_q1_ms 1 100 0.00 65535.00 FORMAT "%8.2" ECU_ADDRESS 0x60009548 /end MEASUREMENT
/begin MEASUREMENT Com_tiLstIgnOn "Last IG ON Time" UWORD Time_s 1 100 0.00 655.3500 FORMAT "%8.4" ECU_ADDRESS 0x60007A46 /end MEASUREMENT
/begin MEASUREMENT Com_tiMiCumContGlb "Counter of external MIL occurence time" UWORD DSMDUR_MICntr_COMPU 1 100 0.00 65535.00 FORMAT "%8.2" ECU_ADDRESS 0x60039924 /end MEASUREMENT
/begin MEASUREMENT Com_tiOilShlfLif "Usable years" UBYTE OneToOne 1 100 0.00 255.0 FORMAT "%5.1" ECU_ADDRESS 0x6000F80C /end MEASUREMENT
/begin MEASUREMENT Com_tqEstimdEngCrkLvl "Estimated torque at engine Crank Terminal" SWORD TrqCom_q0p02 1 100 -655.3600 655.3400 FORMAT "%8.4" ECU_ADDRESS 0x60009AAE /end MEASUREMENT
/begin MEASUREMENT Com_tqMaxIDAS "Maximum IDAS torque" SWORD Trq_float 1 100 -32768.00 32767.00 FORMAT "%8.2" ECU_ADDRESS 0x60009AA6 /end MEASUREMENT
/begin MEASUREMENT Com_tqMinIDAS "Minimum Adjustable torque for IDAS" SWORD Trq_float 1 100 -32768.00 32767.00 FORMAT "%8.2" ECU_ADDRESS 0x60009AA4 /end MEASUREMENT
/begin MEASUREMENT Com_trqEngENGT2 "Engine torque for ENGT2 frame" SLONG RBPtCel_tq_1p0_1 1 100 -2147483648.00 2147483647.00 FORMAT "%13.2" ECU_ADDRESS 0x50004E08 /end MEASUREMENT
/begin MEASUREMENT Com_trqEngENGT2Temp "Tempory Engine torque for ENGT2 frame" SLONG trq_q0p1 1 100 -214748364.800 214748364.700 FORMAT "%13.3" ECU_ADDRESS 0x60003AF4 /end MEASUREMENT
/begin MEASUREMENT Com_uBattDetnENGECU "Battery detection voltage value of ENG-ECU" UWORD q0p01_V 1 100 0.00 40.95000 FORMAT "%8.5" ECU_ADDRESS 0x60009544 /end MEASUREMENT
/begin MEASUREMENT Com_uIG1DetnENGECU "IG1 detection voltage value of ENG-ECU" UWORD q0p01_V 1 100 0.00 40.95000 FORMAT "%8.5" ECU_ADDRESS 0x6000953A /end MEASUREMENT
/begin MEASUREMENT Com_vACCMemSpd "Memory speed for ACC transmitted over CAN" SWORD Vel_CrCtl1 1 100 -32768.00 32767.00 FORMAT "%8.2" ECU_ADDRESS 0x60009A92 /end MEASUREMENT
/begin MEASUREMENT Com_vhegfe "VTEC switching status" UBYTE OneToOne 1 100 0.00 255.0 FORMAT "%5.1" ECU_ADDRESS 0x6000FD3E /end MEASUREMENT
/begin MEASUREMENT Com_volFlConsAdd "Consumed fuel volume for ENGB frame" SLONG OneToOne 1 100 -2147483648.00 2147483647.00 FORMAT "%13.2" ECU_ADDRESS 0x50004E0C /end MEASUREMENT
/begin MEASUREMENT Com_vVeh "Vehicle speed from CAN-bus" SWORD Vel 1 100 -327.6800 327.6700 FORMAT "%8.4" ECU_ADDRESS 0x60009A8E /end MEASUREMENT
/begin MEASUREMENT Com_vVeh2 "Vehicle speed from Kombi 1 Message" SWORD Vel 1 100 -327.6800 327.6700 FORMAT "%8.4" ECU_ADDRESS 0x60009A90 /end MEASUREMENT
/begin MEASUREMENT EngECU_numDTCFrzHi "HIGH Byte of DTC of Freeze signal" UBYTE OneToOne 1 100 0.00 255.0 FORMAT "%5.1" ECU_ADDRESS 0x6000FC9C /end MEASUREMENT
/begin MEASUREMENT EngECU_numDTCFrzLo "Low Byte of DTC of Freeze signal" UBYTE OneToOne 1 100 0.00 255.0 FORMAT "%5.1" ECU_ADDRESS 0x6000FC9B /end MEASUREMENT
/begin MEASUREMENT EngICO_nCtOff "Maximum setpoint speed for masking the injections via the engine-speed controller (Comfort ICO)" SWORD nmot_q0p5 1 100 -16384.00 16383.50 FORMAT "%8.2" ECU_ADDRESS 0x600099CA /end MEASUREMENT
/begin MEASUREMENT EngICO_nMaxApp "Engine sped value dependent on App" UBYTE relPED_ub_b100 1 100 0.00 100.0 FORMAT "%5.1" ECU_ADDRESS 0x6000BA23 /end MEASUREMENT
/begin MEASUREMENT EngICO_nMaxV "Engine sped value dependent on Velocity" SWORD vel_q0p01 1 100 -327.6800 327.6700 FORMAT "%8.4" ECU_ADDRESS 0x60007A44 /end MEASUREMENT
/begin MEASUREMENT EngICO_stICO "Demand for masking the injections via the shut-off coordinator (standard ICO)" UBYTE OneToOne 1 100 0.00 255.0 FORMAT "%5.1" ECU_ADDRESS 0x6000FC9A /end MEASUREMENT
/begin MEASUREMENT EngPrt_bLimOvrSpd "Condition: Engine speed limitation active" UBYTE B_TRUE 1 100 0.00 1.00000000000 BIT_MASK 0x1 FORMAT "%13.11" ECU_ADDRESS 0x700009AB /end MEASUREMENT
/begin MEASUREMENT EngPrt_flgActv "function activation flag" UBYTE B_TRUE 1 100 0.00 1.00000000000 BIT_MASK 0x1 FORMAT "%13.11" ECU_ADDRESS 0x6000BA22 /end MEASUREMENT
/begin MEASUREMENT EngPrt_flgBltDrvVbrDampr "Belt drive vibration damper set condition for torque limitation" UBYTE B_TRUE 1 100 0.00 1.00000000000 BIT_MASK 0x1 FORMAT "%13.11" ECU_ADDRESS 0x6000BA21 /end MEASUREMENT
/begin MEASUREMENT EngPrt_flgBltDrvVbrDamprFF_I.status "FlipFlop to setor reset the limitation / current value of RS-FF" UBYTE B_TRUE 1 100 0.00 1.00000000000 BIT_MASK 0x1 FORMAT "%13.11" ECU_ADDRESS 0x6000BA20 /end MEASUREMENT
/begin MEASUREMENT EngPrt_flgFallEdgeFF_I.status "FlipFlop to select the reset path / current value of RS-FF" UBYTE B_TRUE 1 100 0.00 1.00000000000 BIT_MASK 0x1 FORMAT "%13.11" ECU_ADDRESS 0x6000BA1F /end MEASUREMENT
/begin MEASUREMENT EngPrt_flgTqThdTONVNM_I.time "Turn on delay to avoid toggling / Delay Time" UWORD t_q0p01 1 100 0.00 655.3500 FORMAT "%8.4" ECU_ADDRESS 0x60007A42 /end MEASUREMENT
/begin MEASUREMENT EngPrt_tqBltDrvVbrDampr "Belt drive vibration damper torque limitation" SWORD Trq 1 100 0.00 3276.700 FORMAT "%8.3" ECU_ADDRESS 0x600099C8 /end MEASUREMENT
/begin MEASUREMENT EngPrt_trqLimMech "Torque limitation due to NMAX-limitation" SWORD Trq 1 100 -3276.800 3276.700 FORMAT "%8.3" ECU_ADDRESS 0x600099C2 /end MEASUREMENT
/begin MEASUREMENT EngPrt_trqLimMechLead "Torque limitation (Leadpath) due to NMAX-limitation" SWORD Trq 1 100 -3276.800 3276.700 FORMAT "%8.3" ECU_ADDRESS 0x600099C0 /end MEASUREMENT
/begin MEASUREMENT Lin_Alt_Signal_AdjVltgDem_6_w_msg "Adjusting voltage LIN raw value" UBYTE OneToOne 1 100 0.00 255.0 FORMAT "%5.1" ECU_ADDRESS 0x6000FC19 /end MEASUREMENT
/begin MEASUREMENT Lin_Alt_Signal_DbgInfoTx_3_w_msg "Debug information for transmission LIN raw value" UBYTE OneToOne 1 100 0.00 255.0 FORMAT "%5.1" ECU_ADDRESS 0x6000FC18 /end MEASUREMENT
/begin MEASUREMENT Lin_Alt_Signal_DeMagCnclSpd_4_w_msg "Gradual Excitation Cancel Speed LIN raw value" UBYTE OneToOne 1 100 0.00 255.0 FORMAT "%5.1" ECU_ADDRESS 0x6000FC17 /end MEASUREMENT
/begin MEASUREMENT Lin_Alt_Signal_DeMagTime_4_w_msg "Gradual Excitation time LIN raw value" UBYTE OneToOne 1 100 0.00 255.0 FORMAT "%5.1" ECU_ADDRESS 0x6000FC16 /end MEASUREMENT
/begin MEASUREMENT Lin_Alt_Signal_MagCrntLim_8_w_msg "Excitation Current Limitation LIN raw value" UBYTE OneToOne 1 100 0.00 255.0 FORMAT "%5.1" ECU_ADDRESS 0x6000FC15 /end MEASUREMENT
/begin MEASUREMENT Lin_BS_B_Signal_BattID_8_w_msg "Battery ID LIN raw value" UBYTE OneToOne 1 100 0.00 255.0 FORMAT "%5.1" ECU_ADDRESS 0x6000FC14 /end MEASUREMENT
/begin MEASUREMENT Lin_BS_B_Signal_BoostEnfDmd_1_w_msg "Boost check enforcement demand LIN raw value" UBYTE OneToOne 1 100 0.00 255.0 FORMAT "%5.1" ECU_ADDRESS 0x6000FC13 /end MEASUREMENT
/begin MEASUREMENT Lin_BS_B_Signal_T15_st_1_w_msg "IG1 ONOFF LIN raw value" UBYTE B_TRUE 1 100 0.00 1.00000000000 BIT_MASK 0x1 FORMAT "%13.11" ECU_ADDRESS 0x6000F92F /end MEASUREMENT
/begin MEASUREMENT MoX_nMaxICOMsg "Engine speed threshold at disabled throttle control by monitoring function" SWORD EngN 1 100 -16384.00 16383.50 FORMAT "%8.2" ECU_ADDRESS 0x6001491C /end MEASUREMENT
/begin MEASUREMENT ndcdis_w_msg "engine speed threshold at disabled throttle control by monitoring function" UWORD nmot_uw_q0p25 1 100 0.00 16383.75 FORMAT "%8.2" ECU_ADDRESS 0x600092FC /end MEASUREMENT
/begin FUNCTION EngECU_Eng10 "9.2.0_6SAATransmission process for the CAN frame Engine 10" /begin IN_MEASUREMENT PEnv_pRaw /end IN_MEASUREMENT /begin OUT_MEASUREMENT Com_ctCRingENG10 Com_numCsumENG10 Com_pEnvPRaw /end OUT_MEASUREMENT FUNCTION_VERSION "9.2.0_6SAA" /end FUNCTION
/begin FUNCTION EngECU_Eng11 "15.3.0    Transmission process for the CAN frame Engine 11"
 /begin IN_MEASUREMENT APP_uRaw1unLim CoEng_tiNormalOBD ects2svc_msg I14229_stVINWriteClrReq I15031_PID1C tmottstr_w /end IN_MEASUREMENT
 /begin OUT_MEASUREMENT Com_ctCRingENG11 Com_numCsumENG11 /end OUT_MEASUREMENT
 FUNCTION_VERSION "15.3.0" /end FUNCTION
/begin FUNCTION EngECU_Eng15 "12.3.0    Transmission process for the CAN frame Engine 15"
 /begin DEF_CHARACTERISTIC Com_rThrVlvActAdj_C Com_stIdleNeutMsk_C Com_swtTqRvsnEnaFlg_C Com_tiHACCut_C /end DEF_CHARACTERISTIC
 /begin IN_MEASUREMENT AccPed_swtDrvMod ACCtl_flgACCutPrms ACCtl_flgACOnCdnTCU ACCtl_nrACCutPrms AirC_stPsCmpr AirSys_rPhiThrVlv HLSDem_nSetPLo TCE_flgCylIndFcoStrtd TCE_flgFcoRdy TCE_tiExptFcoStrt ThrVlv_dRatPrVB1 VMD_rVirtAPP /end IN_MEASUREMENT
 /begin OUT_MEASUREMENT Com_ctCRingENG15 Com_flgACReq Com_flgCylIndFcoStrtd Com_flgFcoRdy Com_flgVirtApp Com_nrCsumENG15 Com_nSetPLo Com_rThrVlvAct Com_stTqRvsnEnaFlg Com_swtDrvMod Com_tiExptFcoStrt Com_tiHACCut /end OUT_MEASUREMENT
 FUNCTION_VERSION "12.3.0" /end FUNCTION
/begin FUNCTION EngECU_Eng16 "8.1.0_6SAATransmission process for the CAN frame Engine 16" /begin DEF_CHARACTERISTIC Com_nEngHi_C Com_nEngLo_C Com_swtNEng_C /end DEF_CHARACTERISTIC /begin IN_MEASUREMENT Epm_nEng Epm_nEng10ms /end IN_MEASUREMENT
 /begin OUT_MEASUREMENT Com_ctCRingENG16 Com_nEngSpd Com_numCsumENG16 Com_stEngStop Com_stTrqAccuracySlow Com_stTrqReqFast Com_stTrqReqSlow /end OUT_MEASUREMENT
 FUNCTION_VERSION "8.1.0_6SAA" /end FUNCTION
/begin FUNCTION EngECU_Eng17 "9.1.0_6SAATransmission process for the CAN frame Engine 17" /begin IN_MEASUREMENT PIntkVUs_p /end IN_MEASUREMENT
 /begin OUT_MEASUREMENT Com_ctCRingENG17 Com_numCsumENG17 Com_stAltFail Com_stEngCooltTFail Com_stEngIntkAirFail Com_stEngSpd30DegFail Com_stPBSensFail Com_stThrPosnFail /end OUT_MEASUREMENT
 FUNCTION_VERSION "9.1.0_6SAA" /end FUNCTION
/begin FUNCTION EngECU_Eng18 "7.2.0     Transmission process for the CAN frame Engine 18" /begin DEF_CHARACTERISTIC Com_dENG18SigSel_C /end DEF_CHARACTERISTIC /begin IN_MEASUREMENT CoVOM_bCVTIdleStop CoVOM_bCVTStopEna /end IN_MEASUREMENT
 /begin OUT_MEASUREMENT Com_bCVTIdleStop Com_bCVTStopEna Com_ctCRingENG18 Com_numCsumENG18 Com_rDrvAccrPedlPosn /end OUT_MEASUREMENT
 FUNCTION_VERSION "7.2.0" /end FUNCTION
/begin FUNCTION EngECU_Eng19 "5.4.0     Transmission process for the CAN frame Engine 19" /begin DEF_CHARACTERISTIC Com_dENG19SigSel_C /end DEF_CHARACTERISTIC
 /begin IN_MEASUREMENT Com_stEngCustRevMatchFct Com_stEngRevMatchFct Com_stSrvModDispReq GSHDem_flgInhbnGSH I14229_stABSFailCnclActv Oil_p PIntkVUs_p SyC_ctPostDrvLeave SysDiag_flgCModJdg T15_st Tra_numGearDisp /end IN_MEASUREMENT
 /begin OUT_MEASUREMENT Com_ctCRingENG19 Com_numCsumENG19 Com_numTraGearDisp Com_pEngOil Com_pEngOil_temp Com_pIntkMnfAir /end OUT_MEASUREMENT
 /begin LOC_MEASUREMENT Com_ctReIni10msENG19 /end LOC_MEASUREMENT
 FUNCTION_VERSION "5.4.0" /end FUNCTION
/begin FUNCTION EngECU_Eng2 "30.3.0    The function prepares and sends the CAN messages Motor_2 (ENG2)" /begin DEF_CHARACTERISTIC Com_dENG2SigSel_C /end DEF_CHARACTERISTIC /begin IN_MEASUREMENT AccPed_flgVehSpedSigFailr /end IN_MEASUREMENT /begin OUT_MEASUREMENT Com_ctCRingENG2 Com_numCsumENG2 /end OUT_MEASUREMENT FUNCTION_VERSION "30.3.0" /end FUNCTION
/begin FUNCTION EngECU_Eng20 "6.1.0_6SAATransmission process for the CAN frame Engine 20" /begin IN_MEASUREMENT ACEvpT_tAvg /end IN_MEASUREMENT /begin OUT_MEASUREMENT Com_ctCRingENG20 Com_numCsumENG20 /end OUT_MEASUREMENT FUNCTION_VERSION "6.1.0_6SAA" /end FUNCTION
/begin FUNCTION EngECU_Eng21 "8.7.0     Transmission process for the CAN frame Engine 21"
 /begin DEF_CHARACTERISTIC Com_dENG21SigSel_C Com_stSwtMinTqAllwd_C Com_swFIdEngIDASFail_C Com_SwtMaxTqAllwd_C Com_tiIDASInhbDly_C Eng_tqAdjusMinIDAS_MAP /end DEF_CHARACTERISTIC
 /begin IN_MEASUREMENT AccPed_rTrq Alt_flgACGExctCmpl Alt_flgACGFailr CoEng_st Com_rTrqCnvBoost Com_stADSSpdLim Com_stFrmTxEna CoVeh_trqAcs CoVeh_trqDesComp CoVMD_flgIDASFailDetn CoVMD_tqMaxAllwdIDAS CoVMD_tqMinAllwdIDAS CrCtl_stIDASExsJdg CrCtl_stIDASTqModFailr CrCUI_numGearPosnADAS DFES_stErrLamp PT_rTrq PT_stTraType PT_trqLos PT_trqWhlMaxEng PT_trqWhlMinWoCtOff RngMod_trqCrSMinWoCtOff SpdGov_trqLead T15_st VehMot_rTrqDfftl VehV_v /end IN_MEASUREMENT
 /begin OUT_MEASUREMENT Com_ctCRingENG21 Com_numCsumENG21 Com_stIDASEngFail Com_stIDASInhb Com_tqMaxIDAS Com_tqMinIDAS /end OUT_MEASUREMENT
 /begin LOC_MEASUREMENT Com_stIDASEngFailOld Com_stT15Eng21 /end LOC_MEASUREMENT
 FUNCTION_VERSION "8.7.0" /end FUNCTION
/begin FUNCTION EngECU_Eng22 "6.1.0_6SAATransmission process for the CAN frame Engine 22" /begin OUT_MEASUREMENT Com_ctCRingENG22 Com_numCsumENG22 /end OUT_MEASUREMENT FUNCTION_VERSION "6.1.0_6SAA" /end FUNCTION
/begin FUNCTION EngECU_Eng23 "3.1.0_6SAATransmission process for the CAN frame Engine 23" /begin OUT_MEASUREMENT Com_ctCRingENG23 Com_numCsumENG23 /end OUT_MEASUREMENT FUNCTION_VERSION "3.1.0_6SAA" /end FUNCTION
/begin FUNCTION EngECU_Eng24 "3.5.0     Transmission process for the message Engine 24"
 /begin IN_MEASUREMENT AirMod_ratRelAirM B_dcy CoEng_stStopEng Com_stCmnCntCdnStart EngStrt_bFrstStrtEnd Epm_nEng I14229_stVINWriteClrReq SyC_ctPostDrvLeave T15_st ThrVlv_ratActSens1AbsltB1_u8 VehV_v /end IN_MEASUREMENT
 /begin OUT_MEASUREMENT Com_ctCRingENG24 Com_numCsumENG24 Com_stDcyc Com_stDtcInhbClr Com_stFrstStrtEnd /end OUT_MEASUREMENT
 /begin LOC_MEASUREMENT Com_ctReIni10msENG24 /end LOC_MEASUREMENT
 FUNCTION_VERSION "3.5.0" /end FUNCTION
/begin FUNCTION EngECU_Eng25 "2.3.0     Transmission process for the message Engine 25" /begin DEF_CHARACTERISTIC Com_dENG25SigSel_C /end DEF_CHARACTERISTIC
 /begin IN_MEASUREMENT APP_uRaw1unLim CoEng_tiNormalOBD ects2svc_msg I14229_stVINWriteClrReq I15031_PID1C tmottstr_w /end IN_MEASUREMENT
 /begin OUT_MEASUREMENT Com_ctCRingENG25 Com_numCsumENG25 Com_rAccrPedlPosn /end OUT_MEASUREMENT
 FUNCTION_VERSION "2.3.0" /end FUNCTION
/begin FUNCTION EngECU_Eng3 "26.1.0_6SAAThe function prepares and sends CAN message engine 3 (ENG3)" /begin DEF_CHARACTERISTIC Com_stSwtEstmTqNormJdg_C /end DEF_CHARACTERISTIC
 /begin OUT_MEASUREMENT Com_ctCRingENG3 Com_flgValFailJdg Com_flgValNormJdg Com_numCsumENG3 Com_stEstmTqNormJdg Com_stPrmntDenomCdnJdgStop /end OUT_MEASUREMENT
 FUNCTION_VERSION "26.1.0_6SAA" /end FUNCTION
/begin FUNCTION EngECU_Eng4 "22.1.0_6SAATransmission process for the CAN frame Engine 4" /begin IN_MEASUREMENT CEngDsT_tSnsrFild CEngUsT_t /end IN_MEASUREMENT /begin OUT_MEASUREMENT Com_ctCRingENG4 Com_numCsumENG4 /end OUT_MEASUREMENT FUNCTION_VERSION "22.1.0_6SAA" /end FUNCTION
/begin FUNCTION EngECU_Eng5 "32.1.0_6SAAThe function prepares and sends CAN message engine5 (ENG5)" /begin IN_MEASUREMENT ActMod_trqInr RngMod_trqCrSMin /end IN_MEASUREMENT
 /begin OUT_MEASUREMENT Com_ctCRingENG5 Com_numCsumENG5 Com_stCmnCntCdnStart Com_tqEstimdEngCrkLvl /end OUT_MEASUREMENT
 FUNCTION_VERSION "32.1.0_6SAA" /end FUNCTION
/begin FUNCTION EngECU_Eng6 "14.1.0_6SAAThe function prepares and sends CAN message engine6 (ENG6)" /begin OUT_MEASUREMENT Com_ctCRingENG6 Com_numCsumENG6 /end OUT_MEASUREMENT FUNCTION_VERSION "14.1.0_6SAA" /end FUNCTION
/begin FUNCTION EngECU_EngA "17.7.0    Transmission process for the CAN frame Engine A"
 /begin DEF_CHARACTERISTIC Com_dENGASigSel_C Com_stRemEngStrtMilSeln_C Com_swtMILMulDisbl_C Com_SwtMilMultiBDi_C /end DEF_CHARACTERISTIC
 /begin IN_MEASUREMENT Brk_stMnRaw Brk_stRedRaw CoEng_st Com_rAPPENGA Com_stAPPSensFail Com_stATMILReq Com_stIMGMILReq CoVOM_bEngPreStrtOrd CoVOM_bSSEEngStopPassed CoVOM_bSysOff CoVOM_stSSE CrCtl_stACCAPPOn CrCtl_stActive CrCtl_stDR1Req CrCtl_stDR2Req CrCtl_stFailCond CrCtl_stLmpOn CrCtl_stManCncl DFES_stErrLamp Epm_nEng ErrLmp_stMIL SyC_ctPostDrvLeave T15_st wdks_w_msg /end IN_MEASUREMENT
 /begin OUT_MEASUREMENT Com_ctCRingENGA Com_numCsumENGA Com_stEngRstrt Com_stErrLmp Com_stISSRelsPreNotif Com_stMILMul Com_stMilMultiSerios Com_stStSpEngStop /end OUT_MEASUREMENT
 /begin LOC_MEASUREMENT Com_ctReIni10msENGA /end LOC_MEASUREMENT
 FUNCTION_VERSION "17.7.0" /end FUNCTION
/begin FUNCTION EngECU_ENGAE "3.4.0_6SAASignal processing of message ENGAE"
 /begin OUT_MEASUREMENT Com_cntBankFrozenNew Com_cntBankFrozenNewOld Com_ctCRingENGAE Com_numCsumENGAE Com_numIdxDFC Com_stBankFrozen Com_stBankFrozenNew Com_stBankFrozenNewOld Com_stDTCUpd Com_stFrzUpd Com_stOBSUpd /end OUT_MEASUREMENT
 /begin LOC_MEASUREMENT Com_cntDTCCfmdOld Com_cntDTCPendingOld Com_cntOBSOld Com_numCurrfrzDFC Com_numCurrfrzDFCOld Com_numIdxDFCOld /end LOC_MEASUREMENT
 FUNCTION_VERSION "3.4.0_6SAA" /end FUNCTION
/begin FUNCTION EngECU_EngB "18.12.0   Transmission process for the CAN frame Engine B"
 /begin DEF_CHARACTERISTIC Com_dENGBSigSel_C Com_facFlConsAdd_C Com_numTCUMilReqDFC_CA Com_stBlkSensWaEna_C Com_stClntTempWaEna_C Com_swtImsLmpDisbl_C Com_tiOilLmpOff_C Com_tTFixSensFail_C /end DEF_CHARACTERISTIC
 /begin IN_MEASUREMENT Air_tCACDs AltIO_stCon CEngDsT_t CoDsplCtl_stLmp5Out CoDsplCtl_stOilLmp CoDsplCtl_stOilLmpInfo CrCtl_rACCTxEstSlp CrCtl_vACCMemSpd I14229_stABSFailCnclActv InjSys_volFuConsDrvCycCAN Sia_stOK SrvCSwt_st SyC_ctPostDrvLeave SysDiag_flgCModJdg T15_st Tra_stEcoLmpIdc /end IN_MEASUREMENT
 /begin OUT_MEASUREMENT Com_ctCRingENGB Com_ctIdxCptr Com_dIdxDFESEntry Com_flgTCUMilReqDFCErase Com_numCsumENGB Com_numTCUMilReqDFC Com_rACCTxEstSlp Com_stEMTestModEna Com_stEngWrmUp40CycWoFail Com_stImsLmp Com_stLmp5AltIO Com_stOilLmp Com_stOilLmpInfo Com_stWrmUp40Cyc Com_tAirCACDs Com_tCEngDsT Com_vACCMemSpd Com_volFlConsAdd /end OUT_MEASUREMENT
 /begin LOC_MEASUREMENT Com_ctReIni10msENGB Com_stIdxDelCntr_MP /end LOC_MEASUREMENT
 FUNCTION_VERSION "18.12.0" /end FUNCTION
/begin FUNCTION EngECU_EngC "12.1.0_6SAATransmission process for the CAN frame Engine C" /begin DEF_CHARACTERISTIC Com_VehVFltMin_C /end DEF_CHARACTERISTIC /begin IN_MEASUREMENT Com_vVehCtl GlbDa_lTotDst PT_stTraType VehV_v /end IN_MEASUREMENT
 /begin OUT_MEASUREMENT Com_ctCRingENGC Com_lTotRing Com_numCsumENGC Com_vVeh Com_vVeh2 /end OUT_MEASUREMENT
 FUNCTION_VERSION "12.1.0_6SAA" /end FUNCTION
/begin FUNCTION EngECU_EngF "8.2.0_6SAATransmission process for the CAN frame Engine F"
 /begin IN_MEASUREMENT BrkPed_flgISABReq BrkPed_flgSwtISABAvl BrkPed_pForISABIdleStop /end IN_MEASUREMENT
 /begin OUT_MEASUREMENT Com_ctCRingENGF Com_flgISABReq Com_numCsumENGF Com_pforISABIdleStop /end OUT_MEASUREMENT
 FUNCTION_VERSION "8.2.0_6SAA" /end FUNCTION
/begin FUNCTION EngECU_EngIMG1 "714.0.0   Transmission process for the CAN frame Engine IMG1 (Integrated Management Gateway 1)" /begin IN_MEASUREMENT BattU_stEngCmbCmpl BattU_uSnsrFild T15_st /end IN_MEASUREMENT
 /begin OUT_MEASUREMENT Com_ctCRingENGIMG1 Com_numCsumENGIMG1 Com_stENGECUIG1 Com_stFailrDetn Com_uBattDetnENGECU Com_uIG1DetnENGECU /end OUT_MEASUREMENT
 FUNCTION_VERSION "714.0.0" /end FUNCTION
/begin FUNCTION EngECU_EngJ "16.4.0    Transmission process for the CAN frame Engine J" /begin DEF_CHARACTERISTIC Com_dENGJ3SigSel_C Com_tiFlFWLvlLmp_C Com_tiOilLowOn_C /end DEF_CHARACTERISTIC
 /begin IN_MEASUREMENT B_vhegfe CoDsplCtl_stLmp4Out OilSwmpT_tMtrDisp Oil_stOilLow SSEUI_stISSInhbReas SSEUI_stISSLampReq SSEUI_stISSLampReqInfo SSEUI_stISSWarnReq SSEUI_stStrtClthReq T15_st Tra_numStInd /end IN_MEASUREMENT
 /begin OUT_MEASUREMENT Com_ctCRingENGJ Com_numCsumENGJ Com_stEngBrkOvrdInfo Com_stEngBrkOvrdMtr Com_stOilLow Com_stWarnOilLvl Com_tEngOil Com_tEngOil_temp Com_vhegfe /end OUT_MEASUREMENT
 FUNCTION_VERSION "16.4.0" /end FUNCTION
/begin FUNCTION EngECU_EngK "18.6.0    Transmission process for the CAN frame Engine K"
 /begin DEF_CHARACTERISTIC Com_dENGK3SigSel_C Com_nEngSpdRampNeg_C Com_nEngSpdRampPos_C Com_nMinEngStillRun_C Com_nstatThdXHysHi_C Com_nstatThdXHysLo_C Com_nstatThdYHysHi_C Com_nstatThdYHysLo_C Com_rAppHysHi_C Com_rAppHysLo_C Com_stDrvModDisp_C Com_swtFlLvlMonEna_C Com_swtSmotngCtrl_C Com_tiEngAwk_C Com_tiEngSpdPT1_C Com_tiShrtIgnOn_C Com_tiSmotngFlag_C Com_vVehSpdHysHi_C Com_vVehSpdHysLo_C /end DEF_CHARACTERISTIC
 /begin IN_MEASUREMENT APP_r CoEng_st CoEng_stMai CoEng_stMaiOld CoVOM_bSSEEngStopPassed DsplCtl_nEngSpdDisp DsplCtl_stPredEngSpd Eep_EnvRamInvld Epm_nEng FlLvl_flgVehStandStill MFDspl_flgFuCapWarn nstat StrtCtl_flgPShiftLockReq SyC_ctPostDrvLeave SyC_stSub T15_st VehV_v /end IN_MEASUREMENT
 /begin OUT_MEASUREMENT Com_ctCRingENGK Com_flgEngAwkReq Com_nEngSpdSmotng Com_nISSEng Com_numCsumENGK Com_stAutoSta1DCY Com_stAutoSta1DCYOld Com_stAutoSta2DCY Com_stAutoSta2DCYInterStrt Com_stAutoSta2DCYOld Com_stAutoStaInfo Com_stAutoStaInfoMtr Com_stDrvModDisp Com_stENGKXPostDrv Com_stEngSpdThdX Com_stEngSpdThdY Com_stSmotngFlag /end OUT_MEASUREMENT
 /begin LOC_MEASUREMENT Com_ctReIni10msENGK Com_flgEngAwkReqPostDrv Com_flgEngAwkReqTiElpd Com_flgEngSleepPrep Com_flgISSRSFF Com_flgLstIgnOnShrt Com_nEngSpdSmotng_MP Com_nEngSpd_MP Com_stISSStrt_mp Com_tiLstIgnOn /end LOC_MEASUREMENT
 FUNCTION_VERSION "18.6.0" /end FUNCTION
/begin FUNCTION EngECU_EngL "6.3.0     Transmission process for the CAN frame Engine L" /begin DEF_CHARACTERISTIC Com_ctCRingENGL_C Com_dENGLSigSel_C Com_numCsumENGL_C /end DEF_CHARACTERISTIC
 /begin IN_MEASUREMENT AirMod_ratRelAirM DSMDur_tiMICumContGlb Eep_EnvRamInvld Epm_nEngRaw ErrLmp_stMIL PEnv_pRaw T15_st ThrVlv_ratActSens1AbsltB1_u8 ThrVlv_ratActSens1RelB1_u8 /end IN_MEASUREMENT
 /begin OUT_MEASUREMENT Com_ctCRingENGL Com_numCsumENGL Com_pEnvPRawENGL Com_stEngRtMilUpd Com_ThrVlvActSens1AbsltB1 Com_ThrVlvActSens1RelB1 /end OUT_MEASUREMENT
 /begin LOC_MEASUREMENT Com_tiMiCumContGlb /end LOC_MEASUREMENT
 FUNCTION_VERSION "6.3.0" /end FUNCTION
/begin FUNCTION EngECU_EngN "11.3.0_6SAATransmission process for the CAN frame Engine N (ENGN)" /begin DEF_CHARACTERISTIC Com_dPhysAdr_C /end DEF_CHARACTERISTIC /begin IN_MEASUREMENT Com_stFrmTxEna T15_st /end IN_MEASUREMENT
 /begin OUT_MEASUREMENT Com_ctCRingENGN Com_ctFrmENGN Com_dDTCInfo Com_dDTCRaw1 Com_dDTCRaw2 Com_dDTCRaw3 Com_dPhysAdr Com_numCsumENGN /end OUT_MEASUREMENT
 FUNCTION_VERSION "11.3.0_6SAA" /end FUNCTION
/begin FUNCTION EngECU_EngO "15.4.0    Transmission process for the CAN frame Engine O(ENGO)" /begin DEF_CHARACTERISTIC Com_dENGOSigSel_C Com_stEngRemSt_C /end DEF_CHARACTERISTIC
 /begin IN_MEASUREMENT AltIO_stCon Batt_flgDarkIAllwCondA CoDsplCtl_stLmp5Out Com_stEngRun Com_stFrmTxEna CoVeh_flgPtcShtOff CoVOM_bSSEEna Eep_EnvRamInvld EnvP_p OilLfT_degOilDetern OilLfT_dstOilLfTiRedMilg OilLfT_stFailOilTSnsr OilLfT_stRstCmpl OilLfT_tiOilLfTi SyC_ctPostDrvLeave T15_st /end IN_MEASUREMENT
 /begin OUT_MEASUREMENT Com_ctCRingENGO Com_dstOilLfTiRedMilg Com_numCsumENGO Com_rOilLif Com_stChkChgnSysInfo Com_stChrgnSys Com_stEngRemSt Com_stFIDInhbn Com_stFIDInhbnOld Com_stLmp5AltIOENGO Com_stPASensFail Com_tiOilShlfLif /end OUT_MEASUREMENT
 FUNCTION_VERSION "15.4.0" /end FUNCTION
/begin FUNCTION EngECU_EngQ "5.5.0     Transmission process for the CAN frame EngineQ(ENGQ)"
 /begin DEF_CHARACTERISTIC Com_ctCRingENGQ_C Com_dENGQSigSel_C Com_numCsumENGQ_C Com_stConvalch_CUR /end DEF_CHARACTERISTIC
 /begin IN_MEASUREMENT alchpct_msg Batt_flgDarkIAllwCondB StrtCtl_flgEBBShiftToPReq /end IN_MEASUREMENT
 /begin OUT_MEASUREMENT Com_ctCRingENGQ Com_numCsumENGQ Com_stalchpct /end OUT_MEASUREMENT
 FUNCTION_VERSION "5.5.0" /end FUNCTION
/begin FUNCTION EngECU_EngR "9.6.0     Transmission process for the CAN frame Engine R" /begin DEF_CHARACTERISTIC Com_dENGRSigSel_C /end DEF_CHARACTERISTIC
 /begin IN_MEASUREMENT CrCtl_stActive CrCUI_stVehUn LLim_flgASLCtrlTmpHalt LLim_flgASLOverSpd LLim_numMETAlrm LLim_numMETMemSpd LLim_stActvLmp LLim_stMetCCMode1 LLim_stMetCCMode2 LLim_stMETVehUn /end IN_MEASUREMENT
 /begin OUT_MEASUREMENT Com_ctCRingENGR Com_numCsumENGR /end OUT_MEASUREMENT
 FUNCTION_VERSION "9.6.0" /end FUNCTION
/begin FUNCTION EngECU_EngT "12.2.0    CAN messages of the Engine ECU (ENGT)" /begin IN_MEASUREMENT Clth3_st /end IN_MEASUREMENT /begin OUT_MEASUREMENT Com_ctCRingENGT Com_numCsumENGT /end OUT_MEASUREMENT FUNCTION_VERSION "12.2.0" /end FUNCTION
/begin FUNCTION EngECU_EngT1 "5.1.0_6SAACAN messages of the Engine ECU 1 (ENGT)" /begin OUT_MEASUREMENT Com_ctCRingENGT1 Com_numCsumENGT1 /end OUT_MEASUREMENT FUNCTION_VERSION "5.1.0_6SAA" /end FUNCTION
/begin FUNCTION EngECU_EngT2 "9.9.0     CAN messages of the Engine ECU (ENGT2)" /begin DEF_CHARACTERISTIC Com_dENGT2SigSel_C Com_ErrDeb_Tmr1ACh_C /end DEF_CHARACTERISTIC
 /begin IN_MEASUREMENT ActMod_trqClth APP_bTempErr APP_r APP_stSigSrc Clth2_st Clth_stRaw Com_rVirtAPP Com_stVSAInh Com_stVSAInhbInfo Com_trqDesENGT2 Conv_trqOilPmpLoss Gbx_stAnaNPosnWoAlvChk Gbx_stRvsPos PT_stTraType StrtCtl_flgEngStrtCmpl StrtCtl_flgVehDrvInhb StrtCtl_flgVehDrvRdy T15_st VMSI_stDCSPlusOK /end IN_MEASUREMENT
 /begin OUT_MEASUREMENT Com_ctCRingENGT2 Com_numCsumENGT2 Com_stAYCFErr Com_stCCClthSwt Com_stEngBrkApp Com_stENGT2AYCAck Com_stENGT2NPos Com_stENGT2RvsPos Com_stGbxNPosSFailEngT2 Com_trqEngENGT2 Com_trqEngENGT2Temp /end OUT_MEASUREMENT
 /begin LOC_MEASUREMENT Com_stENGT2TraType_mp /end LOC_MEASUREMENT
 FUNCTION_VERSION "9.9.0" /end FUNCTION
/begin FUNCTION EngECU_EngU "12.3.0    CAN messages of the Engine ECU (ENGU)" /begin DEF_CHARACTERISTIC Com_dENGUSigSel_C /end DEF_CHARACTERISTIC
 /begin IN_MEASUREMENT Com_stAPPFailrDetInfo Com_stAPPNormDetInfo Com_stEngRun Com_stStaActvReq CrCtl_stGuidDispNo SSEUI_stDrvrGuidInhb /end IN_MEASUREMENT
 /begin OUT_MEASUREMENT Com_ctCRingENGU Com_numCsumENGU /end OUT_MEASUREMENT
 FUNCTION_VERSION "12.3.0" /end FUNCTION
/begin FUNCTION EngECU_EngV2 "5.7.0     Transmission process of the CAN frame ENGV2" /begin DEF_CHARACTERISTIC Com_dENGV2SigSel_C Com_xAsgnFrzSig_CA /end DEF_CHARACTERISTIC /begin REF_CHARACTERISTIC I14229_numReWrECUID_CA /end REF_CHARACTERISTIC /begin IN_MEASUREMENT SyC_ctPostDrvLeave T15_st /end IN_MEASUREMENT
 /begin OUT_MEASUREMENT Com_ctCRingENGV2 Com_ctEngData Com_ctFrzSyn Com_nrEngByte1 Com_nrEngByte2 Com_nrEngByte3 Com_nrEngByte4 Com_nrEngByte5 Com_nrEngByte6 Com_numCsumENGV2 Com_stFrzLvl Com_stVINErrENGV2 Com_stVINUnRegENGV2 EngECU_numDTCFrzHi EngECU_numDTCFrzLo /end OUT_MEASUREMENT
 /begin LOC_MEASUREMENT Com_ctReIni10msENGV2 /end LOC_MEASUREMENT
 FUNCTION_VERSION "5.7.0" /end FUNCTION
/begin FUNCTION EngECU_EngW "10.3.0    CAN messages of the Engine ECU (ENGW)" /begin DEF_CHARACTERISTIC Com_dENGWSigSel_C /end DEF_CHARACTERISTIC
 /begin IN_MEASUREMENT LLim_flgEngSt LLim_flgVehSpdHi SyC_ctPostDrvLeave T15_st Tra_stAmbLmp /end IN_MEASUREMENT
 /begin OUT_MEASUREMENT Com_ctCRingENGW Com_flgEngStLimr Com_flgVehSpdLimr Com_numCsumENGW /end OUT_MEASUREMENT
 /begin LOC_MEASUREMENT Com_ctReIni10msENGW /end LOC_MEASUREMENT
 FUNCTION_VERSION "10.3.0" /end FUNCTION
/begin FUNCTION EngECU_EngX "11.1.0_6SAATransmission process for the CAN frame Engine X" /begin OUT_MEASUREMENT Com_ctCRingENGX Com_numCsumENGX /end OUT_MEASUREMENT FUNCTION_VERSION "11.1.0_6SAA" /end FUNCTION
/begin FUNCTION EngECU_EngY "6.6.0     Transmission process for the CAN frame Engine Y" /begin DEF_CHARACTERISTIC Com_dENGYSigSel_C Com_swtENGYFrmTypSel_C /end DEF_CHARACTERISTIC /begin IN_MEASUREMENT ACCtl_iCmprDwnIReq AirC_pClnt AirC_stPsCmpr Com_stFrmTxEna /end IN_MEASUREMENT /begin OUT_MEASUREMENT Com_ctCRingENGY Com_numCsumENGY Com_pClnt /end OUT_MEASUREMENT FUNCTION_VERSION "6.6.0" /end FUNCTION
/begin FUNCTION EngECU_EngZ "9.2.0_6SAATransmission process for the CAN frame Engine Z(ENGZ)" /begin DEF_CHARACTERISTIC Com_dENGZSigSel_C /end DEF_CHARACTERISTIC /begin IN_MEASUREMENT Gbx_stAnaNPosBrkHld /end IN_MEASUREMENT /begin OUT_MEASUREMENT Com_ctCRingENGZ Com_numCsumENGZ /end OUT_MEASUREMENT FUNCTION_VERSION "9.2.0_6SAA" /end FUNCTION
/begin FUNCTION EngECU_LinTx "34.6.0    EngECU LIN frames"
 /begin DEF_CHARACTERISTIC ComEBS_BattID2_C ComEBS_BattID_C Com_facAltCutOffConv_CUR Com_iAltExctLimOfs_C Com_iAltExctLimSlp_C Com_nrACGDbgInfoTx_C Com_tiAltLoadRespOfs_C Com_tiAltLoadRespSlp_C Com_uAltFinalDesOfs_C Com_uAltFinalDesSlp_C /end DEF_CHARACTERISTIC
 /begin IN_MEASUREMENT Alt_iExctLim Alt_nCutOff Alt_tiLoadResp Alt_uFinalDes Batt_stEbsBattCod T15_st /end IN_MEASUREMENT
 /begin OUT_MEASUREMENT ComEBS_BattID Lin_Alt_Signal_AdjVltgDem_6_w_msg Lin_Alt_Signal_DbgInfoTx_3_w_msg Lin_Alt_Signal_DeMagCnclSpd_4_w_msg Lin_Alt_Signal_DeMagTime_4_w_msg Lin_Alt_Signal_MagCrntLim_8_w_msg Lin_BS_B_Signal_BattID_8_w_msg Lin_BS_B_Signal_BoostEnfDmd_1_w_msg Lin_BS_B_Signal_T15_st_1_w_msg /end OUT_MEASUREMENT
 FUNCTION_VERSION "34.6.0" /end FUNCTION
/begin FUNCTION EngICO_Co "44.2.0_1.0.0Extended Monitoring: Injection Cut Off"
 /begin DEF_CHARACTERISTIC CWAEVABU DNMAXH EngICO_nMaxAppDfct_C EngICO_nMaxAppDpd_Cur EngICO_nMaxVDpd_Cur EngICO_nMax_C /end DEF_CHARACTERISTIC
 /begin IN_MEASUREMENT APP_r APP_stSigSrc Epm_nEng SyC_stSub ThrVlv_flgLimpModeB1 ThrVlv_flgReqFuCutOffB1 ThrVlv_flgUBattSuffB1 VehV_vSens /end IN_MEASUREMENT
 /begin OUT_MEASUREMENT B_evabu_msg EngICO_nCtOff EngICO_stICO MoX_nMaxICOMsg ndcdis_w_msg /end OUT_MEASUREMENT
 /begin LOC_MEASUREMENT EngICO_nMaxApp EngICO_nMaxV /end LOC_MEASUREMENT
 FUNCTION_VERSION "44.2.0_1.0.0" /end FUNCTION
/begin FUNCTION EngPrt_BltDrvVbrDampr "2.0.0     Engine Protection Belt Drive Vibration Damper"
 /begin DEF_CHARACTERISTIC EngPrt_numEngTBltDampr_C EngPrt_swtInpTSeln_C EngPrt_tAirThd_C EngPrt_tiDlyBltDrvVbrDampr_C EngPrt_tmrAftStrtThd_C EngPrt_tqBltDrvVbrDampr_C EngPrt_tqDeltaBltDrvVbrDampr_C /end DEF_CHARACTERISTIC
 /begin IN_MEASUREMENT AirSys_tFld CoPT_trqClthWoIntv EngDa_tFld RngMod_trqClthMin tnst_w_msg /end IN_MEASUREMENT
 /begin OUT_MEASUREMENT EngPrt_tqBltDrvVbrDampr /end OUT_MEASUREMENT
 /begin LOC_MEASUREMENT EngPrt_flgActv EngPrt_flgBltDrvVbrDampr EngPrt_flgBltDrvVbrDamprFF_I.status EngPrt_flgFallEdgeFF_I.status EngPrt_flgTqThdTONVNM_I.time /end LOC_MEASUREMENT
 FUNCTION_VERSION "2.0.0" /end FUNCTION
/begin FUNCTION EngPrt_NLim "1.7.0     Limitation of maximum engine speed in case of open clutch for hybrid systems" /begin DEF_CHARACTERISTIC EngPrt_trqInrNLim_CUR EngPrt_trqLimOvrSpdFCODem_C /end DEF_CHARACTERISTIC /begin IN_MEASUREMENT Epm_nEng /end IN_MEASUREMENT /begin OUT_MEASUREMENT EngPrt_bLimOvrSpd EngPrt_trqLimMech EngPrt_trqLimMechLead /end OUT_MEASUREMENT FUNCTION_VERSION "1.7.0" /end FUNCTION
/begin COMPU_METHOD B_TRUE "" TAB_VERB "%6.3" "" COMPU_TAB_REF B_TRUE /end COMPU_METHOD
/begin COMPU_VTAB B_TRUE "" TAB_VERB 2 0 "FALSE" 1 "TRUE" /end COMPU_VTAB
/begin COMPU_METHOD Com_deg_q0p02441 "" RAT_FUNC "%6.4" "deg" COEFFS 0 65536 0 0 0 1600 /end COMPU_METHOD
/begin COMPU_METHOD Curr "" RAT_FUNC "%6.2" "mA" COEFFS 0 1 0 0 0 1 /end COMPU_METHOD
/begin COMPU_METHOD dez "" RAT_FUNC "%6.2" "" COEFFS 0 1 0 0 0 1 /end COMPU_METHOD
/begin COMPU_METHOD DFC_Verb "" TAB_VERB "%6.3" "-" COMPU_TAB_REF DFC_Verb /end COMPU_METHOD
/begin COMPU_VTAB DFC_Verb "" TAB_VERB 907 0 "DFC_Unused" 1 "DFC_AAVEmax" 2 "DFC_AAVEmin" 3 "DFC_AAVEsig" 508 "DFC_AAVmin" 379 "DFC_ACEvpTPhysRngHi" 380 "DFC_ACEvpTPhysRngLo" 381 "DFC_ACEvpTSRCMax" 382 "DFC_ACEvpTSRCMin" 288 "DFC_AfsPhyRngHiB1" 289 "DFC_AfsPhyRngLoB1" 510 "DFC_AfsPlausDiagHi" 511 "DFC_AfsPlausDiagLo" 383 "DFC_AfsRawSigRngHiB1" 384 "DFC_AfsRawSigRngLoB1" 415 "DFC_AfsSigErrLineHiB1" 416 "DFC_AfsSigErrLineLoB1" 385 "DFC_AfsSnsrErrB1" 512 "DFC_AfsVrntDiagErrB1" 509 "DFC_AGRSUS" 386 "DFC_AirCClntPAnaSRCMax" 387 "DFC_AirCClntPAnaSRCMin" 290 "DFC_AirCCmprOL" 291 "DFC_AirCCmprOvrTemp" 292 "DFC_AirCCmprSCB" 293 "DFC_AirCCmprSCG" 388 "DFC_AirCSwtNpl" 389 "DFC_AirCSwtSig" 294 "DFC_AltErr" 4 "DFC_AltIOACGFailr" 5 "DFC_AltIOACGHiVltg" 6 "DFC_AltIOACGLoVltg" 7 "DFC_AltIOACGTHi" 8 "DFC_AltIODConnACG" 513 "DFC_AppAllSnsrDfct" 10 "DFC_BattUHiFailr" 11 "DFC_BattULoFailr" 295 "DFC_BattUSRCMax" 296 "DFC_BattUSRCMin" 516 "DFC_BattUStdbyDiaOL" 514 "DFC_BBKRnldg" 515 "DFC_BBKRsyne" 9 "DFC_BGOELWAF" 517 "DFC_BigLeakIntkMnfldEmiInfl" 518 "DFC_BlkdLineTank" 390 "DFC_Brk" 12 "DFC_BrkBstPDriftHiErr" 13 "DFC_BrkBstPDriftLoErr" 14 "DFC_BrkBstPSnsrStuck" 391 "DFC_BrkBstSensSCB" 392 "DFC_BrkBstSensSCG" 15 "DFC_BrkMnSwtContOn" 519 "DFC_BrkMnSwtContOnWarnLmp" 16 "DFC_BrkMnSwtNotStp" 520 "DFC_BrkMnSwtNotStpWarnLmp" 17 "DFC_BrkNpl" 18 "DFC_BrkRdntSwtContOn" 521 "DFC_BrkRdntSwtContOnWarnLmp" 19 "DFC_BrkRdntSwtNotStp" 522 "DFC_BrkRdntSwtNotStpWarnLmp" 393 "DFC_BrkSig" 496 "DFC_BSWM_E_ACTION_FAILED" 497 "DFC_BSWM_E_INTRPTQUEUE_FULL" 472 "DFC_BusDiagCANAPPLBusOff" 473 "DFC_BusDiagCANCANCBusOff" 474 "DFC_BusDiagCANVEHICLEBusOff" 490 "DFC_CAN_E_TIMEOUT" 523 "DFC_CEngDsTColdStrtMax" 524 "DFC_CEngDsTColdStrtMin" 525 "DFC_CEngDsTImps" 526 "DFC_CEngDsTPlausHSC" 527 "DFC_CEngDsTPlausLSC" 528 "DFC_CEngDsTPlausSTC" 531 "DFC_CEngDsTSig" 529 "DFC_CEngDsTSRCMax" 530 "DFC_CEngDsTSRCMin" 532 "DFC_CEngUsTColdStrtMax" 533 "DFC_CEngUsTColdStrtMin" 534 "DFC_CEngUsTLooseCnctn" 535 "DFC_CEngUsTSRCMax" 536 "DFC_CEngUsTSRCMin" 432 "DFC_Clth2ONStuck" 433 "DFC_Clth2ONStuckLdc" 20 "DFC_Clth3ONStuck" 434 "DFC_Clth3ONStuckLdc" 435 "DFC_Clth3ONStuckPostDrv" 21 "DFC_Clth4OFFStuck" 436 "DFC_Clth4ONStuck" 437 "DFC_Clth4ONStuckLdc" 260 "DFC_ClthMax" 412 "DFC_ClthNpl" 22 "DFC_ClthOFFStuck" 23 "DFC_ClthONStuck" 394 "DFC_ClthSig" 24 "DFC_ClthStkFailInfo" 25 "DFC_ComACFailInfo" 26 "DFC_ComATFTValErr" 27 "DFC_ComATMILReq" 28 "DFC_ComAYCAChksum" 29 "DFC_ComAYCARingCnt" 30 "DFC_ComAYCATOut" 31 "DFC_ComAYCDChkSum" 32 "DFC_ComAYCDTOut" 33 "DFC_ComAYCFChksum" 34 "DFC_ComAYCFRingCnt" 35 "DFC_ComAYCFTOut" 36 "DFC_ComAYCGChksum" 37 "DFC_ComAYCGRingCnt" 38 "DFC_ComAYCGTOut" 39 "DFC_ComAYCIChkSum" 40 "DFC_ComAYCIRingCnt" 41 "DFC_ComAYCITOut" 42 "DFC_ComBCM1ChkSum" 43 "DFC_ComBCM1RingCnt" 44 "DFC_ComBCM1TOut" 438 "DFC_ComBCMUnit" 45 "DFC_ComCANABusOffErr" 46 "DFC_ComCANBBusOffErr" 47 "DFC_ComCANCBusOffErr" 48 "DFC_ComCGW1ChkSum" 49 "DFC_ComCGW1RingCnt" 50 "DFC_ComCGW1TOut" 297 "DFC_ComChksTCU1" 298 "DFC_ComChksTCU11" 299 "DFC_ComChksTCU12" 300 "DFC_ComChksTCU13" 301 "DFC_ComChksTCU2" 302 "DFC_ComChksTCU3" 303 "DFC_ComChksTCU4" 304 "DFC_ComCntTCU1" 305 "DFC_ComCntTCU11" 306 "DFC_ComCntTCU12" 307 "DFC_ComCntTCU13" 308 "DFC_ComCntTCU2" 309 "DFC_ComCntTCU3" 310 "DFC_ComCntTCU4" 51 "DFC_ComConvBoostErr" 52 "DFC_ComConvSlipErr" 537 "DFC_ComDCDCACCFailr" 53 "DFC_ComDCDCPrfmncErr" 54 "DFC_ComDCDCTempWarn" 439 "DFC_ComDLCTCU01" 440 "DFC_ComDLCTCU02" 441 "DFC_ComDLCTCU1" 442 "DFC_ComDLCTCU11" 443 "DFC_ComDLCTCU12" 444 "DFC_ComDLCTCU13" 445 "DFC_ComDLCTCU14" 446 "DFC_ComDLCTCU2" 447 "DFC_ComDLCTCU3" 448 "DFC_ComDLCTCU4" 55 "DFC_ComEAT10Chksum" 56 "DFC_ComEAT10RingCnt" 57 "DFC_ComEAT10TOut" 58 "DFC_ComEAT11ChkSum" 59 "DFC_ComEAT11RingCnt" 60 "DFC_ComEAT11TOut" 61 "DFC_ComEAT12ChkSum" 62 "DFC_ComEAT12RingCnt" 63 "DFC_ComEAT12TOut" 64 "DFC_ComEAT13ChkSum" 65 "DFC_ComEAT13RingCnt" 66 "DFC_ComEAT13TOut" 67 "DFC_ComEAT1Chksum" 68 "DFC_ComEAT1RingCnt" 69 "DFC_ComEAT1TOut" 70 "DFC_ComEAT2ChkSum" 71 "DFC_ComEAT2RingCnt" 72 "DFC_ComEAT2TOut" 73 "DFC_ComEAT4ChkSum" 74 "DFC_ComEAT4RingCnt" 75 "DFC_ComEAT4TOut" 76 "DFC_ComEAT6Chksum" 77 "DFC_ComEAT6RingCnt" 78 "DFC_ComEAT6TOut" 79 "DFC_ComEAT7Chksum" 80 "DFC_ComEAT7RingCnt" 81 "DFC_ComEAT7TOut" 82 "DFC_ComEAT8Chksum" 83 "DFC_ComEAT8RingCnt" 84 "DFC_ComEAT8TOut" 85 "DFC_ComEATAChksum" 86 "DFC_ComEATARingCnt" 87 "DFC_ComEATATOut" 88 "DFC_ComEATBChkSum" 89 "DFC_ComEATBRingCnt" 90 "DFC_ComEATBTOut" 91 "DFC_ComEATCChksum" 92 "DFC_ComEATCRingCnt" 93 "DFC_ComEATCTOut" 103 "DFC_ComEngCanRxErr" 94 "DFC_ComEPBBChkSum" 95 "DFC_ComEPBBRingCnt" 96 "DFC_ComEPBBTOut" 97 "DFC_ComEPBChksum" 99 "DFC_ComEPBctRing" 98 "DFC_ComEPBTOut" 100 "DFC_ComEPS1Chksum" 101 "DFC_ComEPS1RingCnt" 102 "DFC_ComEPS1TOut" 449 "DFC_ComEPSUnit" 104 "DFC_ComGrvySnsrErr" 105 "DFC_ComGwIMG1ChkSum" 106 "DFC_ComGwIMG1RingCnt" 107 "DFC_ComGwIMG1TOut" 108 "DFC_ComGwIMG3ChkSum" 109 "DFC_ComGwIMG3RingCnt" 110 "DFC_ComGwIMG3TOut" 111 "DFC_ComGwIMG4ChkSum" 112 "DFC_ComGwIMG4RingCnt" 113 "DFC_ComGwIMG4TOut" 114 "DFC_ComGwIMG5ChkSum" 115 "DFC_ComGwIMG5RingCnt" 116 "DFC_ComGwIMG5TOut" 117 "DFC_ComGwIMG6ChkSum" 118 "DFC_ComGwIMG6RingCnt" 119 "DFC_ComGwIMG6TOut" 120 "DFC_ComIDASBChksum" 121 "DFC_ComIDASBRingCnt" 122 "DFC_ComIDASBTOut" 450 "DFC_ComIDASBUnit" 123 "DFC_ComIMGMILReq" 451 "DFC_ComIMGUnit" 124 "DFC_ComISSPrms" 125 "DFC_ComMETAChksum" 126 "DFC_ComMETAChksumPstDrv" 127 "DFC_ComMETARingCnt" 128 "DFC_ComMETARingCntPstDrv" 129 "DFC_ComMETATOut" 130 "DFC_ComMETATOutPstDrv" 131 "DFC_ComMETCChksum" 132 "DFC_ComMETCRingCnt" 133 "DFC_ComMETCTOut" 134 "DFC_ComMETDChksum" 135 "DFC_ComMETDRingCnt" 136 "DFC_ComMETDTOut" 137 "DFC_ComMETE2Chksum" 138 "DFC_ComMETE2RingCnt" 139 "DFC_ComMETE2TOut" 140 "DFC_ComMETFChksum" 141 "DFC_ComMETFRingCnt" 142 "DFC_ComMETFTOut" 143 "DFC_ComMETGChksum" 144 "DFC_ComMETGRingCnt" 145 "DFC_ComMETGTOut" 146 "DFC_ComMETH2Chksum" 147 "DFC_ComMETH2RingCnt" 148 "DFC_ComMETH2TOut" 149 "DFC_ComMETHChksum" 150 "DFC_ComMETHRingCnt" 151 "DFC_ComMETHTOut" 152 "DFC_ComMETIChksum" 153 "DFC_ComMETIRingCnt" 154 "DFC_ComMETITOut" 155 "DFC_ComMETKChksum" 156 "DFC_ComMETKRingCnt" 157 "DFC_ComMETKTOut" 158 "DFC_ComMETLChksum" 159 "DFC_ComMETLRingCnt" 160 "DFC_ComMETLTOut" 161 "DFC_ComMETMChksum" 162 "DFC_ComMETMRingCnt" 163 "DFC_ComMETMTOut" 164 "DFC_ComMETNChksum" 165 "DFC_ComMETNRingCnt" 166 "DFC_ComMETNTOut" 452 "DFC_ComMETUnit" 167 "DFC_ComMtrCom" 168 "DFC_ComPCUChkSum" 169 "DFC_ComPCURingCnt" 170 "DFC_ComPCUTOut" 171 "DFC_ComSRSAChksum" 172 "DFC_ComSRSARingCnt" 173 "DFC_ComSRSATOut" 174 "DFC_ComSRSBChksum" 175 "DFC_ComSRSBRingCnt" 176 "DFC_ComSRSBTOut" 177 "DFC_ComSRSChksum" 178 "DFC_ComSRSErr" 179 "DFC_ComSRSRingCnt" 180 "DFC_ComSRSTOut" 453 "DFC_ComSRSUnit" 311 "DFC_ComTOutTCU01" 312 "DFC_ComTOutTCU02" 313 "DFC_ComTOutTCU1" 314 "DFC_ComTOutTCU11" 315 "DFC_ComTOutTCU12" 316 "DFC_ComTOutTCU13" 317 "DFC_ComTOutTCU14" 318 "DFC_ComTOutTCU2" 319 "DFC_ComTOutTCU3" 320 "DFC_ComTOutTCU4" 181 "DFC_ComVehSpdPndFltTCU" 454 "DFC_ComVSAUnit" 538 "DFC_DCDCFltDet" 321 "DFC_DevLibBattUHi" 322 "DFC_DevLibBattULo" 357 "DFC_DHFHD" 558 "DFC_DiagCpv1DteskLoLoadStuckClsd" 559 "DFC_DiagCpv1DteskLoLoadStuckOpen" 541 "DFC_DKnpl" 539 "DFC_DKRSA" 540 "DFC_DKVSmax" 542 "DFC_DSKVRmax" 543 "DFC_DSKVRmin" 544 "DFC_DSKVRnpl" 545 "DFC_DSKVRsig" 546 "DFC_DSKVSsig" 547 "DFC_DSSmax" 548 "DFC_DSTDmax" 549 "DFC_DSTEmax" 550 "DFC_DSTEmin" 551 "DFC_DSTOFmax" 552 "DFC_DSTRmax" 553 "DFC_DSTRmin" 554 "DFC_DSTRnpl" 555 "DFC_DSTRsig" 556 "DFC_DSTTI" 557 "DFC_DSUmax" 182 "DFC_EbsChartcCurrErr" 183 "DFC_EbsSelfDiagErr" 455 "DFC_EbsSocFlt" 395 "DFC_EGRVlvCurrLim" 560 "DFC_EGRVlvDrftClsd" 561 "DFC_EGRVlvDrftOpn" 323 "DFC_EGRVlvFailSafeActv" 324 "DFC_EGRVlvGovDvtCld" 562 "DFC_EGRVlvJamVlvClsd" 563 "DFC_EGRVlvJamVlvOpn" 396 "DFC_EGRVlvOL" 397 "DFC_EGRVlvOvrTemp" 325 "DFC_EGRVlvPhysSRCMax" 326 "DFC_EGRVlvPhysSRCMin" 398 "DFC_EGRVlvSCB" 399 "DFC_EGRVlvSCG" 564 "DFC_EGRVlvSprgBrk" 400 "DFC_EGRVlvSRCMax" 401 "DFC_EGRVlvSRCMin" 565 "DFC_EGRVlvTempMdlEEPErr" 566 "DFC_EGRVlvTmpErr" 567 "DFC_EGSDUS2B1LtrDly" 568 "DFC_EGSDUS2B1LtrPT1" 569 "DFC_EGSDUS2B1RtlDly" 570 "DFC_EGSDUS2B1RtlPT1" 571 "DFC_EGSDUS2B1TarLean" 572 "DFC_EGSDUS2B1TarRich" 586 "DFC_EngICO" 587 "DFC_EngPrtOvrSpdMon" 573 "DFC_EONVmax" 588 "DFC_EpmCaSI1ErrSig" 589 "DFC_EpmCaSI1MntErr" 590 "DFC_EpmCaSI1NoSigMax" 591 "DFC_EpmCaSI1NoSigMin" 592 "DFC_EpmCaSI1OfsErr" 593 "DFC_EpmCrSDGI" 594 "DFC_EpmCrSErrSig" 595 "DFC_EpmCrSNoSig" 596 "DFC_EtaEngIdleNonCsers" 597 "DFC_EtaEngPtlNonCsers" 574 "DFC_ETAKHLmax" 575 "DFC_ETAKHTmax" 576 "DFC_ETHSEmax" 577 "DFC_ETHSEmin" 578 "DFC_ETHSFmax" 579 "DFC_ETHSFmin" 580 "DFC_ETHSFsig" 581 "DFC_ETHSNPWmax" 582 "DFC_ETHSNPWmin" 583 "DFC_ETHSNPWsig" 584 "DFC_ETHSPLnpl" 585 "DFC_ETHSTPLnpl" 327 "DFC_FanDIOOL_0" 328 "DFC_FanDIOOL_1" 329 "DFC_FanDIOOvrTemp_0" 330 "DFC_FanDIOOvrTemp_1" 331 "DFC_FanDIOSCB_0" 332 "DFC_FanDIOSCB_1" 333 "DFC_FanDIOSCG_0" 334 "DFC_FanDIOSCG_1" 598 "DFC_FRAmax" 599 "DFC_FRAmin" 600 "DFC_FSTEmax" 601 "DFC_FSTEmin" 605 "DFC_FSTmax" 602 "DFC_FSTRmax" 603 "DFC_FSTRmin" 604 "DFC_FSTRnpl" 606 "DFC_FTDLAmax" 607 "DFC_FTDLAmin" 608 "DFC_FuPHiSnsrEleclmax" 609 "DFC_FuPHiSnsrEleclmin" 610 "DFC_FuPHiSnsrEleclnpl" 611 "DFC_FuPHiSnsrURngMax" 612 "DFC_FuPHiSnsrURngMin" 613 "DFC_FuSnsrPhyRngMaxErr" 614 "DFC_FuSnsrPhyRngMinErr" 188 "DFC_GbxCANDigPlausErr" 189 "DFC_GbxNPos1SRCMax" 190 "DFC_GbxNPos1SRCMin" 191 "DFC_GbxNPos2SRCMax" 192 "DFC_GbxNPos2SRCMin" 193 "DFC_GbxNPosAlvChk" 194 "DFC_GbxNPosSyncErr" 413 "DFC_GbxPNPosnDrvCdn" 414 "DFC_GbxPNPosnPlausy" 618 "DFC_GbxRvsSwtStk" 615 "DFC_GEVlvLockPinDiagIntkB1" 184 "DFC_GEVlvPhaCsersIntkB1" 185 "DFC_GEVlvPhaPsOpenLoadIntkB1" 186 "DFC_GEVlvPhaPsShoToBattIntkB1" 187 "DFC_GEVlvPhaPsShoToGndIntkB1" 616 "DFC_GEVlvPhaSlowIntkB1" 617 "DFC_GEVlvPhaTargIntkB1" 619 "DFC_HDRKHmax" 620 "DFC_HDRKHmin" 623 "DFC_HDRmax" 624 "DFC_HDRmin" 621 "DFC_HDRPLmax" 622 "DFC_HDRPLmin" 625 "DFC_HEGOS2B1ElecMax" 626 "DFC_HEGOS2B1ElecMin" 627 "DFC_HEGOS2B1ElecSig" 628 "DFC_HEGOS2B1HtgNpl" 195 "DFC_HEGOS2B1HtrPsMax" 196 "DFC_HEGOS2B1HtrPsMin" 197 "DFC_HEGOS2B1HtrPsSig" 629 "DFC_HEV00max" 630 "DFC_HEV01max" 631 "DFC_HEV02max" 632 "DFC_HEV03max" 633 "DFC_HEVE0max" 634 "DFC_HEVE1max" 635 "DFC_HFMmax" 636 "DFC_HiPSysHiPMaxLimExcdd" 402 "DFC_HLSDemOvhtEngLim" 456 "DFC_I14229VINErr" 261 "DFC_IgnClPs_DevComErr" 262 "DFC_IgnClPs_LineOl_0" 263 "DFC_IgnClPs_LineOl_1" 264 "DFC_IgnClPs_LineOl_2" 265 "DFC_IgnClPs_LineOl_3" 266 "DFC_IgnClPs_LineScb_0" 267 "DFC_IgnClPs_LineScb_1" 268 "DFC_IgnClPs_LineScb_2" 269 "DFC_IgnClPs_LineScb_3" 270 "DFC_IgnClPs_LineScg_0" 271 "DFC_IgnClPs_LineScg_1" 272 "DFC_IgnClPs_LineScg_2" 273 "DFC_IgnClPs_LineScg_3" 457 "DFC_InjCatHeatgErr" 458 "DFC_InjSysMulInjDiagErr" 358 "DFC_InjVlv_DI_DcDc" 359 "DFC_InjVlv_DI_NoLd_0" 360 "DFC_InjVlv_DI_NoLd_1" 361 "DFC_InjVlv_DI_NoLd_2" 362 "DFC_InjVlv_DI_NoLd_3" 363 "DFC_InjVlv_DI_ScBnk_0" 364 "DFC_InjVlv_DI_ScBnk_1" 365 "DFC_InjVlv_DI_ScBnk_2" 366 "DFC_InjVlv_DI_ScBnk_3" 367 "DFC_InjVlv_DI_ScCyl_0" 368 "DFC_InjVlv_DI_ScCyl_1" 369 "DFC_InjVlv_DI_ScCyl_2" 370 "DFC_InjVlv_DI_ScCyl_3" 371 "DFC_InjVlv_DI_ScHsLs_0" 372 "DFC_InjVlv_DI_ScHsLs_1" 373 "DFC_InjVlv_DI_ScHsLs_2" 374 "DFC_InjVlv_DI_ScHsLs_3" 652 "DFC_IntkAirTAirFltDsCrssMax" 653 "DFC_IntkAirTAirFltDsCrssMin" 654 "DFC_IntkAirTAirFltDsHSCMax" 655 "DFC_IntkAirTAirFltDsImps" 656 "DFC_IntkAirTAirFltDsPRCMax" 657 "DFC_IntkAirTAirFltDsPRCMin" 658 "DFC_IntkAirTAirFltDsSRCMax" 659 "DFC_IntkAirTAirFltDsSRCMin" 660 "DFC_IntkAirTAirFltDsSTC" 661 "DFC_IntkAirTIntkMnfldCrssMax" 662 "DFC_IntkAirTIntkMnfldCrssMin" 663 "DFC_IntkAirTIntkMnfldHSCMax" 664 "DFC_IntkAirTIntkMnfldImps" 665 "DFC_IntkAirTIntkMnfldPRCMax" 666 "DFC_IntkAirTIntkMnfldPRCMin" 667 "DFC_IntkAirTIntkMnfldSRCMax" 668 "DFC_IntkAirTIntkMnfldSRCMin" 669 "DFC_IntkAirTIntkMnfldSTC" 647 "DFC_IVGdiCtl_CvoErr" 648 "DFC_IVGdiCtl_CvoSigPlaus_0" 649 "DFC_IVGdiCtl_CvoSigPlaus_1" 650 "DFC_IVGdiCtl_CvoSigPlaus_2" 651 "DFC_IVGdiCtl_CvoSigPlaus_3" 637 "DFC_IVGdiCtlCvoErrMax_0" 638 "DFC_IVGdiCtlCvoErrMax_1" 639 "DFC_IVGdiCtlCvoErrMax_2" 640 "DFC_IVGdiCtlCvoErrMax_3" 641 "DFC_IVGdiCtlCvoErrMin_0" 642 "DFC_IVGdiCtlCvoErrMin_1" 643 "DFC_IVGdiCtlCvoErrMin_2" 644 "DFC_IVGdiCtlCvoErrMin_3" 645 "DFC_IVGdiCtlCvoErrMinMax" 646 "DFC_IVGdiCtlCvoSigPlausErrSmrCdn" 428 "DFC_KnDetSens1PortAMax" 429 "DFC_KnDetSens1PortAMin" 430 "DFC_KnDetSens1PortBMax" 431 "DFC_KnDetSens1PortBMin" 670 "DFC_KRREGRLMX" 671 "DFC_KRVEKOCVLCI" 672 "DFC_KRVEKOENCHMT" 673 "DFC_KRVEKOENCHMT0" 674 "DFC_KRVEKOENCHMT1" 675 "DFC_KRVEKOENCHMT2" 676 "DFC_KRVEKOENCHMT3" 677 "DFC_KRVEKOENCHMT4" 678 "DFC_KRVEKOENCHMT5" 679 "DFC_KRVEKOENCHMT6" 680 "DFC_KRVEKOENCHMT7" 274 "DFC_KRVEKOEVAB" 275 "DFC_KRVEKOEVAB0" 276 "DFC_KRVEKOEVAB1" 277 "DFC_KRVEKOEVAB2" 278 "DFC_KRVEKOEVAB3" 681 "DFC_KRVEKORLMX" 682 "DFC_KRVEKORLMXL" 683 "DFC_KS1max" 684 "DFC_KS1min" 687 "DFC_LamDynDiagS1B1" 688 "DFC_LeakIntkMnfldEmiInfl" 491 "DFC_LIN_E_TIMEOUT" 465 "DFC_LinACGUnit" 466 "DFC_LinAEVUnit" 198 "DFC_LinCSErrACG" 199 "DFC_LinCSErrAEV" 200 "DFC_LinCSErrDCDC" 201 "DFC_LinCSErrEBS" 467 "DFC_LinEBSUnit" 689 "DFC_LinFrameErrDCDC" 202 "DFC_LinHdrTimeoutErrACG" 203 "DFC_LinHdrTimeoutErrAEV" 204 "DFC_LinHdrTimeoutErrDCDC" 205 "DFC_LinHdrTimeoutErrEBS" 206 "DFC_LinMsgTimeoutErrACG" 207 "DFC_LinMsgTimeoutErrAEV" 208 "DFC_LinMsgTimeoutErrDCDC" 209 "DFC_LinMsgTimeoutErrEBS" 210 "DFC_LinNoStrtComErr" 690 "DFC_LinOverrunErrDCDC" 459 "DFC_LLRHmax" 460 "DFC_LLRHmin" 461 "DFC_LLRHnpl" 462 "DFC_LLRKHmax" 463 "DFC_LLRKHmin" 464 "DFC_LLRKHnpl" 685 "DFC_LMmax" 211 "DFC_LowPresOilP" 686 "DFC_LZSRnpl" 691 "DFC_MD00max" 692 "DFC_MDBmax" 693 "DFC_MDCat" 694 "DFC_MDCatCrit" 695 "DFC_MDCatCurr" 696 "DFC_MDCyl_0" 697 "DFC_MDCyl_1" 698 "DFC_MDCyl_2" 699 "DFC_MDCyl_3" 700 "DFC_MDEmi" 701 "DFC_MDEmiStrt" 702 "DFC_MDFco" 705 "DFC_MDmax" 703 "DFC_MDMpl" 704 "DFC_MDSegTiAdpn" 375 "DFC_MfPsDiaOpenLoad1" 376 "DFC_MfPsDiaScHiS1" 377 "DFC_MfPsDiaScHiSLowS1" 378 "DFC_MfPsDiaScLowS1" 706 "DFC_MFuOilMax" 228 "DFC_MisfDetdVWhlFrntLePlaus" 229 "DFC_MisfDetdVWhlFrntRiPlaus" 230 "DFC_MisfDetdVWhlReLePlaus" 231 "DFC_MisfDetdVWhlReRiPlaus" 212 "DFC_MisfDetVWhlFrntLeOORHi" 213 "DFC_MisfDetVWhlFrntLeRatyHi" 214 "DFC_MisfDetVWhlFrntLeRatyLo" 215 "DFC_MisfDetVWhlFrntLeStuck" 216 "DFC_MisfDetVWhlFrntRiOORHi" 217 "DFC_MisfDetVWhlFrntRiRatyHi" 218 "DFC_MisfDetVWhlFrntRiRatyLo" 219 "DFC_MisfDetVWhlFrntRiStuck" 220 "DFC_MisfDetVWhlReLeOORHi" 221 "DFC_MisfDetVWhlReLeRatyHi" 222 "DFC_MisfDetVWhlReLeRatyLo" 223 "DFC_MisfDetVWhlReLeStuck" 224 "DFC_MisfDetVWhlReRiOORHi" 225 "DFC_MisfDetVWhlReRiRatyHi" 226 "DFC_MisfDetVWhlReRiRatyLo" 227 "DFC_MisfDetVWhlReRiStuck" 801 "DFC_MoCADCNTP" 802 "DFC_MoCADCTst" 803 "DFC_MoCSOPICO" 805 "DFC_MoFAirFilgPrdc" 806 "DFC_MoFAirFlCtOffGdi" 807 "DFC_MoFAirFlCylGdi" 808 "DFC_MoFAirFlFF" 809 "DFC_MoFAirFlIn" 810 "DFC_MoFAirFlMixCtlGdiChkAirFl" 811 "DFC_MoFAirFlMixCtlGdiChkCtrl" 812 "DFC_MoFAirFlMode" 804 "DFC_MoFAPP" 813 "DFC_MoFESpd" 814 "DFC_MoFIACo" 815 "DFC_MoFICOL1" 816 "DFC_MoFICOL2" 817 "DFC_MoFStrt" 818 "DFC_MoFTrqCmp" 819 "DFC_MoFTrqCmpMax" 820 "DFC_MoFTrqCmpMin" 821 "DFC_MoFVarPostBldSel" 707 "DFC_MOXEMM_SMU_ALM0_0" 708 "DFC_MOXEMM_SMU_ALM0_1" 709 "DFC_MOXEMM_SMU_ALM0_10" 710 "DFC_MOXEMM_SMU_ALM0_11" 711 "DFC_MOXEMM_SMU_ALM0_13" 712 "DFC_MOXEMM_SMU_ALM0_14" 713 "DFC_MOXEMM_SMU_ALM0_2" 714 "DFC_MOXEMM_SMU_ALM0_22" 715 "DFC_MOXEMM_SMU_ALM0_23" 716 "DFC_MOXEMM_SMU_ALM0_4" 717 "DFC_MOXEMM_SMU_ALM0_5" 718 "DFC_MOXEMM_SMU_ALM0_7" 719 "DFC_MOXEMM_SMU_ALM0_8" 720 "DFC_MOXEMM_SMU_ALM10_16" 721 "DFC_MOXEMM_SMU_ALM10_17" 722 "DFC_MOXEMM_SMU_ALM10_21" 723 "DFC_MOXEMM_SMU_ALM11_0" 724 "DFC_MOXEMM_SMU_ALM11_1" 725 "DFC_MOXEMM_SMU_ALM11_2" 726 "DFC_MOXEMM_SMU_ALM11_3" 727 "DFC_MOXEMM_SMU_ALM11_4" 728 "DFC_MOXEMM_SMU_ALM11_5" 729 "DFC_MOXEMM_SMU_ALM11_8" 730 "DFC_MOXEMM_SMU_ALM11_9" 731 "DFC_MOXEMM_SMU_ALM1_0" 732 "DFC_MOXEMM_SMU_ALM1_1" 733 "DFC_MOXEMM_SMU_ALM1_10" 734 "DFC_MOXEMM_SMU_ALM1_11" 735 "DFC_MOXEMM_SMU_ALM1_13" 736 "DFC_MOXEMM_SMU_ALM1_14" 737 "DFC_MOXEMM_SMU_ALM1_2" 738 "DFC_MOXEMM_SMU_ALM1_22" 739 "DFC_MOXEMM_SMU_ALM1_23" 740 "DFC_MOXEMM_SMU_ALM1_4" 741 "DFC_MOXEMM_SMU_ALM1_5" 742 "DFC_MOXEMM_SMU_ALM1_7" 743 "DFC_MOXEMM_SMU_ALM1_8" 744 "DFC_MOXEMM_SMU_ALM21_0" 745 "DFC_MOXEMM_SMU_ALM21_16" 746 "DFC_MOXEMM_SMU_ALM21_3" 747 "DFC_MOXEMM_SMU_ALM2_1" 748 "DFC_MOXEMM_SMU_ALM2_10" 749 "DFC_MOXEMM_SMU_ALM2_11" 750 "DFC_MOXEMM_SMU_ALM2_13" 751 "DFC_MOXEMM_SMU_ALM2_14" 752 "DFC_MOXEMM_SMU_ALM2_22" 753 "DFC_MOXEMM_SMU_ALM2_23" 754 "DFC_MOXEMM_SMU_ALM2_4" 755 "DFC_MOXEMM_SMU_ALM2_5" 756 "DFC_MOXEMM_SMU_ALM2_7" 757 "DFC_MOXEMM_SMU_ALM2_8" 758 "DFC_MOXEMM_SMU_ALM6_0" 759 "DFC_MOXEMM_SMU_ALM6_11" 760 "DFC_MOXEMM_SMU_ALM6_12" 761 "DFC_MOXEMM_SMU_ALM6_14" 762 "DFC_MOXEMM_SMU_ALM6_15" 763 "DFC_MOXEMM_SMU_ALM6_17" 764 "DFC_MOXEMM_SMU_ALM6_18" 765 "DFC_MOXEMM_SMU_ALM6_20" 766 "DFC_MOXEMM_SMU_ALM6_21" 767 "DFC_MOXEMM_SMU_ALM6_25" 768 "DFC_MOXEMM_SMU_ALM6_4" 769 "DFC_MOXEMM_SMU_ALM6_5" 770 "DFC_MOXEMM_SMU_ALM6_7" 771 "DFC_MOXEMM_SMU_ALM6_8" 772 "DFC_MOXEMM_SMU_ALM7_1" 773 "DFC_MOXEMM_SMU_ALM7_12" 774 "DFC_MOXEMM_SMU_ALM7_13" 775 "DFC_MOXEMM_SMU_ALM7_14" 776 "DFC_MOXEMM_SMU_ALM7_15" 777 "DFC_MOXEMM_SMU_ALM7_16" 778 "DFC_MOXEMM_SMU_ALM7_17" 779 "DFC_MOXEMM_SMU_ALM7_2" 780 "DFC_MOXEMM_SMU_ALM7_20" 781 "DFC_MOXEMM_SMU_ALM7_25" 782 "DFC_MOXEMM_SMU_ALM7_26" 783 "DFC_MOXEMM_SMU_ALM7_28" 784 "DFC_MOXEMM_SMU_ALM7_29" 785 "DFC_MOXEMM_SMU_ALM7_30" 786 "DFC_MOXEMM_SMU_ALM7_31" 787 "DFC_MOXEMM_SMU_ALM8_0" 788 "DFC_MOXEMM_SMU_ALM8_1" 789 "DFC_MOXEMM_SMU_ALM8_10" 790 "DFC_MOXEMM_SMU_ALM8_11" 791 "DFC_MOXEMM_SMU_ALM8_12" 792 "DFC_MOXEMM_SMU_ALM8_16" 793 "DFC_MOXEMM_SMU_ALM8_18" 794 "DFC_MOXEMM_SMU_ALM8_2" 795 "DFC_MOXEMM_SMU_ALM8_3" 796 "DFC_MOXEMM_SMU_ALM8_31" 797 "DFC_MOXEMM_SMU_ALM8_4" 798 "DFC_MOXEMM_SMU_ALM9_0" 799 "DFC_MOXEMM_SMU_ALM9_15" 800 "DFC_MOXEMM_SMU_ALM9_3" 822 "DFC_MoXEMMHwLTMCUFW" 823 "DFC_MoXEMMHwLTMonBIST" 824 "DFC_MoXEMMHwLTRegMonTest" 825 "DFC_MoXEMMHwLTStbySMUAlvTest" 826 "DFC_MoXEMMHwLTTempSens" 827 "DFC_MoXEMMHwLTUCBCfg" 335 "DFC_MRlyDcOL" 336 "DFC_MRlyDcSCB" 337 "DFC_MRlyDcSCG" 492 "DFC_MRlyOL" 493 "DFC_MRlySCB" 494 "DFC_MRlySCG" 828 "DFC_NWSEmax" 829 "DFC_NWSmax" 830 "DFC_OCWDAABEActv" 831 "DFC_OCWDACom" 832 "DFC_OCWDAErrPin" 833 "DFC_OCWDAOvrVltg" 836 "DFC_OilPPlaus" 403 "DFC_OilPSwmpSRCMax" 404 "DFC_OilPSwmpSRCMin" 834 "DFC_ORAmax" 835 "DFC_ORAmin" 847 "DFC_P_VSE11_OL" 848 "DFC_P_VSE11_SCB" 849 "DFC_P_VSE11_SCG" 417 "DFC_PEnvCcMax" 418 "DFC_PEnvCcMin" 419 "DFC_PEnvRngChkMax" 420 "DFC_PEnvRngChkMin" 232 "DFC_PEnvSigRngMax" 233 "DFC_PEnvSigRngMin" 421 "DFC_PEnvSnsrPlaus" 850 "DFC_PhyHighAPP1" 851 "DFC_PhyHighAPP2" 852 "DFC_PhyLowAPP1" 853 "DFC_PhyLowAPP2" 405 "DFC_PIntkVUsLineHiB1" 406 "DFC_PIntkVUsLineLoB1" 837 "DFC_PLLSUmax" 838 "DFC_PLLSUmin" 338 "DFC_PSPOL" 339 "DFC_PSPOvrTemp" 340 "DFC_PSPSCB" 341 "DFC_PSPSCG" 839 "DFC_PSR1max" 840 "DFC_PSRBmax" 841 "DFC_PSRBmin" 845 "DFC_PSRmax" 842 "DFC_PSRPmax" 843 "DFC_PSRPmin" 844 "DFC_PSRPsig" 846 "DFC_PUmax" 475 "DFC_RBA_IODIAGPWR_rba_IoExtCy329_SignalVltSply_0" 476 "DFC_RBA_IODIAGPWR_rba_IoExtCy329_SignalVltSply_0OT" 477 "DFC_RBA_IODIAGPWR_rba_IoExtCy329_SignalVltSply_0OV" 478 "DFC_RBA_IODIAGPWR_rba_IoExtCy329_SignalVltSply_0SCG" 479 "DFC_RBA_IODIAGPWR_rba_IoExtCy329_SignalVltSply_0UV" 480 "DFC_RBA_IODIAGPWR_rba_IoExtCy329_SignalVltSply_1" 481 "DFC_RBA_IODIAGPWR_rba_IoExtCy329_SignalVltSply_1OT" 482 "DFC_RBA_IODIAGPWR_rba_IoExtCy329_SignalVltSply_1OV" 483 "DFC_RBA_IODIAGPWR_rba_IoExtCy329_SignalVltSply_1SCG" 484 "DFC_RBA_IODIAGPWR_rba_IoExtCy329_SignalVltSply_1UV" 485 "DFC_RBA_IODIAGPWR_rba_IoExtCy329_SignalVltSply_2" 486 "DFC_RBA_IODIAGPWR_rba_IoExtCy329_SignalVltSply_2OT" 487 "DFC_RBA_IODIAGPWR_rba_IoExtCy329_SignalVltSply_2OV" 488 "DFC_RBA_IODIAGPWR_rba_IoExtCy329_SignalVltSply_2SCG" 489 "DFC_RBA_IODIAGPWR_rba_IoExtCy329_SignalVltSply_2UV" 498 "DFC_RBA_IOEXTLIB_KEEPALIVE_DRV" 499 "DFC_RBA_IOEXTLIB_KEEPALIVE_INI" 500 "DFC_rba_IoSigRtc_StopCounter" 502 "DFC_rba_MemDiag_MemReadErr" 503 "DFC_rba_MemDiag_MemWrErr" 501 "DFC_rba_MRly_Diag_Stk_Event" 495 "DFC_rba_MultiStackTrace_Threshold" 504 "DFC_rba_SyC_IrrSwOffTrigEngRun_Event" 505 "DFC_rba_T15_Diag_ComInVld_Event" 506 "DFC_rba_T15_Diag_ComOff_HwOn_Event" 507 "DFC_rba_T15_Diag_ComOn_HwOff_Event" 468 "DFC_RoughRoad" 469 "DFC_SiaEEPRdErr" 470 "DFC_SiaEEPWrngCod" 854 "DFC_SRCHighAPP1" 855 "DFC_SRCHighAPP2" 856 "DFC_SRCLowAPP1" 857 "DFC_SRCLowAPP2" 858 "DFC_SSpMon2" 859 "DFC_STHDRmax" 234 "DFC_StmFault" 236 "DFC_StrtCtlErr" 235 "DFC_StrtCtOffPth" 237 "DFC_StrtFault" 238 "DFC_StrtLckJudg1" 239 "DFC_StrtLckJudg2" 240 "DFC_StrtOL" 241 "DFC_StrtOL2" 242 "DFC_StrtSCB" 243 "DFC_StrtSCB2" 244 "DFC_StrtSCG" 245 "DFC_StrtSCG2" 246 "DFC_StrtStkRly1" 247 "DFC_StrtStkRly2" 860 "DFC_SWReset_0" 861 "DFC_SWReset_1" 862 "DFC_SWReset_2" 863 "DFC_SyncAPP" 342 "DFC_T50Err" 865 "DFC_TAmax_Dummy" 864 "DFC_TANKLnpl" 866 "DFC_TESFmax" 867 "DFC_TESGmax" 248 "DFC_TEVEmax" 249 "DFC_TEVEmin" 250 "DFC_TEVEsig" 875 "DFC_ThrVlvClsdPosnFirstOffsLrnImpoB1" 876 "DFC_ThrVlvClsdPosnOffsLrnImpoB1" 877 "DFC_ThrVlvClsdPosnOffsLrnMaxB1" 878 "DFC_ThrVlvClsdPosnOffsLrnMinB1" 879 "DFC_ThrVlvCtrlDeB1" 880 "DFC_ThrVlvDycB1" 881 "DFC_ThrVlvLimpAirPosnMaxAbsltDriftB1" 882 "DFC_ThrVlvLimpAirPosnMaxB1" 883 "DFC_ThrVlvLimpAirPosnMaxRelDriftB1" 884 "DFC_ThrVlvLimpAirPosnMinB1" 343 "DFC_ThrVlvLoBattB1" 885 "DFC_ThrVlvOpenLoadB1" 886 "DFC_ThrVlvOpenSprgB1" 887 "DFC_ThrVlvOpenSprgSprdB1" 888 "DFC_ThrVlvOpenSprgTwnB1" 889 "DFC_ThrVlvOverTB1" 890 "DFC_ThrVlvRetSprgB1" 891 "DFC_ThrVlvRetSprgSprdB1" 892 "DFC_ThrVlvRetSprgTwnB1" 893 "DFC_ThrVlvSens1MaxB1" 900 "DFC_ThrvlvSens1MinB1" 894 "DFC_ThrVlvSens1NplB1" 895 "DFC_ThrVlvSens2MaxB1" 896 "DFC_ThrVlvSens2MinB1" 897 "DFC_ThrVlvSens2NplB1" 898 "DFC_ThrVlvShoCircB1" 899 "DFC_ThrVlvSpiErrB1" 901 "DFC_TiOffTBasdChkFast" 902 "DFC_TiOffTBasdChkSlow" 868 "DFC_TKAEmax" 869 "DFC_TKAEmin" 870 "DFC_TKARmax" 871 "DFC_TKARnpl" 872 "DFC_TMmax_Dummy" 873 "DFC_TUMmax_Dummy" 874 "DFC_TWCDPriCatB1" 251 "DFC_UegoHeatrPrfmncLoS1B1" 422 "DFC_UEGOHeatrRlyPsOLS1B1" 423 "DFC_UEGOHeatrRlyPsSCBS1B1" 424 "DFC_UEGOHeatrRlyPsSCGS1B1" 471 "DFC_UegoHeatrStrtS1B1" 425 "DFC_UegoHeatrWireOlS1B1" 426 "DFC_UegoHeatrWireScbS1B1" 427 "DFC_UegoHeatrWireScgS1B1" 279 "DFC_UegoSigEcuAsicS1B1" 280 "DFC_UegoSigEcuComS1B1" 344 "DFC_UegoSigOperPlausS1B1" 281 "DFC_UegoSigSnsrS1B1" 282 "DFC_UegoSigWireOlApesS1B1" 283 "DFC_UegoSigWireOlIpeS1B1" 284 "DFC_UegoSigWireOlReS1B1" 285 "DFC_UegoSigWireRCmpS1B1" 286 "DFC_UegoSigWireScbS1B1" 287 "DFC_UegoSigWireScgS1B1" 903 "DFC_UEGOSnsrMntdS1B1" 252 "DFC_VehVAllPlaus" 253 "DFC_VehVNCSnsrElecFailr" 345 "DFC_VehVPhysRngHi" 407 "DFC_VehVPhysRngLo" 254 "DFC_VehVPlausCan" 255 "DFC_VehVPlausFco" 256 "DFC_VehVPlausPwr" 257 "DFC_VehVPlausV2N" 346 "DFC_VehVSclOutOL" 347 "DFC_VehVSclOutOT" 348 "DFC_VehVSclOutSCB" 349 "DFC_VehVSclOutSCG" 904 "DFC_VehVSig" 408 "DFC_VehVSigCan" 409 "DFC_VehVSigCanSafe" 350 "DFC_VehVSigFL" 351 "DFC_VehVSigFR" 352 "DFC_VehVSigRL" 353 "DFC_VehVSigRR" 354 "DFC_VehVSnsrARngHi" 355 "DFC_VehVSnsrBRngHi" 356 "DFC_VehVSpdRtyDiag" 258 "DFC_VehVSpdSnsrAElecFailr" 259 "DFC_VehVSpdSnsrBElecFailr" 410 "DFC_VlvLftFbOilPSnsrIntk11SRCMax" 411 "DFC_VlvLftFbOilPSnsrIntk11SRCMin" 905 "DFC_VlvLftFbSwtIntk11SpclFail" 906 "DFC_VlvLftFbSwtIntk11StdFail" DEFAULT_VALUE "---" /end COMPU_VTAB
/begin COMPU_METHOD dist_uw_q1 "" RAT_FUNC "%6.2" "Km" COEFFS 0 1 0 0 0 1 /end COMPU_METHOD
/begin COMPU_METHOD DSMDUR_MICntr_COMPU "" RAT_FUNC "%6.2" "h" COEFFS 0 1 0 0 0 1 /end COMPU_METHOD
/begin COMPU_METHOD EngN "" RAT_FUNC "%6.3" "rpm" COEFFS 0 2 0 0 0 1 /end COMPU_METHOD
/begin COMPU_METHOD Fact "" RAT_FUNC "%6.5" "-" COEFFS 0 8192 0 0 0 1 /end COMPU_METHOD
/begin COMPU_METHOD Fact1 "" RAT_FUNC "%6.4" "-" COEFFS 0 128 0 0 0 1 /end COMPU_METHOD
/begin COMPU_METHOD FUELP_TYPAVL_SY_Compu "" TAB_VERB "%6.3" "" COMPU_TAB_REF FUELP_TYPAVL_SY_Compu /end COMPU_METHOD
/begin COMPU_VTAB FUELP_TYPAVL_SY_Compu "" TAB_VERB 2 0 "False" 1 "True" /end COMPU_VTAB
/begin COMPU_METHOD FUELT2_TYPAVL_SC_Compu "" TAB_VERB "%6.3" "" COMPU_TAB_REF FUELT2_TYPAVL_SC_Compu /end COMPU_METHOD
/begin COMPU_VTAB FUELT2_TYPAVL_SC_Compu "" TAB_VERB 2 0 "False" 1 "True" /end COMPU_VTAB
/begin COMPU_METHOD FUELT_SNSRBNK2_SC_Compu "" TAB_VERB "%6.3" "" COMPU_TAB_REF FUELT_SNSRBNK2_SC_Compu /end COMPU_METHOD
/begin COMPU_VTAB FUELT_SNSRBNK2_SC_Compu "" TAB_VERB 3 0 "NOTAVL" 1 "TFUELLP" 2 "TFUELLPHP" /end COMPU_VTAB
/begin COMPU_METHOD FUELT_TYPAVL_SY_Compu "" TAB_VERB "%6.3" "" COMPU_TAB_REF FUELT_TYPAVL_SY_Compu /end COMPU_METHOD
/begin COMPU_VTAB FUELT_TYPAVL_SY_Compu "" TAB_VERB 2 0 "False" 1 "True" /end COMPU_VTAB
/begin COMPU_METHOD FUEVAPDIAG_CALDIAGTYP_SC_Compu "" TAB_VERB "%6.3" "" COMPU_TAB_REF FUEVAPDIAG_CALDIAGTYP_SC_Compu /end COMPU_METHOD
/begin COMPU_VTAB FUEVAPDIAG_CALDIAGTYP_SC_Compu "" TAB_VERB 2 0 "False" 1 "True" /end COMPU_VTAB
/begin COMPU_METHOD FUEVAPDIAG_ENADTESKDRV_SC_Compu "" TAB_VERB "%6.3" "" COMPU_TAB_REF FUEVAPDIAG_ENADTESKDRV_SC_Compu /end COMPU_METHOD
/begin COMPU_VTAB FUEVAPDIAG_ENADTESKDRV_SC_Compu "" TAB_VERB 2 0 "False" 1 "True" /end COMPU_VTAB
/begin COMPU_METHOD FUEVAPOILBNKIND_SC_Compu "" TAB_VERB "%6.3" "" COMPU_TAB_REF FUEVAPOILBNKIND_SC_Compu /end COMPU_METHOD
/begin COMPU_VTAB FUEVAPOILBNKIND_SC_Compu "" TAB_VERB 2 0 "False" 1 "True" /end COMPU_VTAB
/begin COMPU_METHOD FUEVAPOIL_SC_Compu "" TAB_VERB "%6.3" "" COMPU_TAB_REF FUEVAPOIL_SC_Compu /end COMPU_METHOD
/begin COMPU_VTAB FUEVAPOIL_SC_Compu "" TAB_VERB 4 0 "no modelling" 1 "only model" 2 "lambda adaptation" 3 "LAMKORRLL adaptation" /end COMPU_VTAB
/begin COMPU_METHOD FUEVAPPURGP_TYPAVL_SC_Compu "" TAB_VERB "%6.3" "" COMPU_TAB_REF FUEVAPPURGP_TYPAVL_SC_Compu /end COMPU_METHOD
/begin COMPU_VTAB FUEVAPPURGP_TYPAVL_SC_Compu "" TAB_VERB 2 0 "False" 1 "True" /end COMPU_VTAB
/begin COMPU_METHOD FUEVAPPURGT_TYPAVL_SC_Compu "" TAB_VERB "%6.3" "" COMPU_TAB_REF FUEVAPPURGT_TYPAVL_SC_Compu /end COMPU_METHOD
/begin COMPU_VTAB FUEVAPPURGT_TYPAVL_SC_Compu "" TAB_VERB 2 0 "False" 1 "True" /end COMPU_VTAB
/begin COMPU_METHOD FUEVAPPURGT_TYPTWINFLW_SC_Compu "" TAB_VERB "%6.3" "" COMPU_TAB_REF FUEVAPPURGT_TYPTWINFLW_SC_Compu /end COMPU_METHOD
/begin COMPU_VTAB FUEVAPPURGT_TYPTWINFLW_SC_Compu "" TAB_VERB 2 0 "False" 1 "True" /end COMPU_VTAB
/begin COMPU_METHOD FUFLAPCTRL_SC_Compu "" TAB_VERB "%6.3" "" COMPU_TAB_REF FUFLAPCTRL_SC_Compu /end COMPU_METHOD
/begin COMPU_VTAB FUFLAPCTRL_SC_Compu "" TAB_VERB 2 0 "False" 1 "True" /end COMPU_VTAB
/begin COMPU_METHOD FUFLAPSNSR_SC_Compu "" TAB_VERB "%6.3" "" COMPU_TAB_REF FUFLAPSNSR_SC_Compu /end COMPU_METHOD
/begin COMPU_VTAB FUFLAPSNSR_SC_Compu "" TAB_VERB 2 0 "False" 1 "True" /end COMPU_VTAB
/begin COMPU_METHOD FUHIPGP_JUMPSIGCHK_SC_Compu "" TAB_VERB "%6.3" "" COMPU_TAB_REF FUHIPGP_JUMPSIGCHK_SC_Compu /end COMPU_METHOD
/begin COMPU_VTAB FUHIPGP_JUMPSIGCHK_SC_Compu "" TAB_VERB 2 0 "False" 1 "True" /end COMPU_VTAB
/begin COMPU_METHOD FULCOMP_SY_Compu "" TAB_VERB "%6.3" "" COMPU_TAB_REF FULCOMP_SY_Compu /end COMPU_METHOD
/begin COMPU_VTAB FULCOMP_SY_Compu "" TAB_VERB 2 0 "False" 1 "True" /end COMPU_VTAB
/begin COMPU_METHOD FULVLSNSRARCHSWT_SC_Compu "" TAB_VERB "%6.3" "" COMPU_TAB_REF FULVLSNSRARCHSWT_SC_Compu /end COMPU_METHOD
/begin COMPU_VTAB FULVLSNSRARCHSWT_SC_Compu "" TAB_VERB 2 0 "0" 1 "1" /end COMPU_VTAB
/begin COMPU_METHOD FUMIXPCALCN_SC_Compu "" TAB_VERB "%6.3" "" COMPU_TAB_REF FUMIXPCALCN_SC_Compu /end COMPU_METHOD
/begin COMPU_VTAB FUMIXPCALCN_SC_Compu "" TAB_VERB 2 0 "False" 1 "True" /end COMPU_VTAB
/begin COMPU_METHOD FUPHI_DIPATLOBE_SC_Compu "" TAB_VERB "%6.3" "" COMPU_TAB_REF FUPHI_DIPATLOBE_SC_Compu /end COMPU_METHOD
/begin COMPU_VTAB FUPHI_DIPATLOBE_SC_Compu "" TAB_VERB 2 0 "DiPat_inactive" 1 "DiPat_active" /end COMPU_VTAB
/begin COMPU_METHOD FUPHI_OFFSCHKDIUMPR_SC_Compu "" TAB_VERB "%6.3" "" COMPU_TAB_REF FUPHI_OFFSCHKDIUMPR_SC_Compu /end COMPU_METHOD
/begin COMPU_VTAB FUPHI_OFFSCHKDIUMPR_SC_Compu "" TAB_VERB 2 0 "False" 1 "True" /end COMPU_VTAB
/begin COMPU_METHOD FUPHI_PIDSELN_SC_Compu "" TAB_VERB "%6.3" "" COMPU_TAB_REF FUPHI_PIDSELN_SC_Compu /end COMPU_METHOD
/begin COMPU_VTAB FUPHI_PIDSELN_SC_Compu "" TAB_VERB 4 0 "PID23_used" 1 "PID6D_used" 2 "PID23_and_PID6D_used" 3 "No_PID_used" /end COMPU_VTAB
/begin COMPU_METHOD FUPURGEMGYFCO_SC_Compu "" TAB_VERB "%6.3" "" COMPU_TAB_REF FUPURGEMGYFCO_SC_Compu /end COMPU_METHOD
/begin COMPU_VTAB FUPURGEMGYFCO_SC_Compu "" TAB_VERB 2 0 "False" 1 "True" /end COMPU_VTAB
/begin COMPU_METHOD GBXCSC_SY_Compu "" TAB_VERB "%6.3" "" COMPU_TAB_REF GBXCSC_SY_Compu /end COMPU_METHOD
/begin COMPU_VTAB GBXCSC_SY_Compu "" TAB_VERB 2 0 "False" 1 "True" /end COMPU_VTAB
/begin COMPU_METHOD GBXIDLECRP_SC_Compu "" TAB_VERB "%6.3" "" COMPU_TAB_REF GBXIDLECRP_SC_Compu /end COMPU_METHOD
/begin COMPU_VTAB GBXIDLECRP_SC_Compu "" TAB_VERB 2 0 "False" 1 "True" /end COMPU_VTAB
/begin COMPU_METHOD GBXNPOS_SY_Compu "" TAB_VERB "%6.3" "" COMPU_TAB_REF GBXNPOS_SY_Compu /end COMPU_METHOD
/begin COMPU_VTAB GBXNPOS_SY_Compu "" TAB_VERB 7 0 "GBXNPOS_OFF" 1 "GBXNPOS_ADC" 2 "GBXNPOS_PWM" 3 "GBXNPOS_INTSENS" 4 "GBXNPOS_CAL" 5 "GBXNPOS_DIO" 6 "GBXNPOS_CAN" /end COMPU_VTAB
/begin COMPU_METHOD GBXOILT_TYPAVL_SY_Compu "" TAB_VERB "%6.3" "" COMPU_TAB_REF GBXOILT_TYPAVL_SY_Compu /end COMPU_METHOD
/begin COMPU_VTAB GBXOILT_TYPAVL_SY_Compu "" TAB_VERB 2 0 "False" 1 "True" /end COMPU_VTAB
/begin COMPU_METHOD GBXPNPOS_SC_Compu "" TAB_VERB "%6.3" "" COMPU_TAB_REF GBXPNPOS_SC_Compu /end COMPU_METHOD
/begin COMPU_VTAB GBXPNPOS_SC_Compu "" TAB_VERB 2 0 "False" 1 "True" /end COMPU_VTAB
/begin COMPU_METHOD GBXSPD_SC_Compu "" TAB_VERB "%6.3" "" COMPU_TAB_REF GBXSPD_SC_Compu /end COMPU_METHOD
/begin COMPU_VTAB GBXSPD_SC_Compu "" TAB_VERB 2 0 "False" 1 "True" /end COMPU_VTAB
/begin COMPU_METHOD GBX_ATNEUTCTRLSYS_SC_Compu "" TAB_VERB "%6.3" "" COMPU_TAB_REF GBX_ATNEUTCTRLSYS_SC_Compu /end COMPU_METHOD
/begin COMPU_VTAB GBX_ATNEUTCTRLSYS_SC_Compu "" TAB_VERB 2 0 "False" 1 "True" /end COMPU_VTAB
/begin COMPU_METHOD GC_Volt "" RAT_FUNC "%6.2" "mV" COEFFS 0 0.2046 0 0 0 1 /end COMPU_METHOD
/begin COMPU_METHOD GDI_SY_Compu "" TAB_VERB "%6.3" "" COMPU_TAB_REF GDI_SY_Compu /end COMPU_METHOD
/begin COMPU_VTAB GDI_SY_Compu "" TAB_VERB 2 0 "GDI_NO" 1 "GDI" /end COMPU_VTAB
/begin COMPU_METHOD GEARBX_NUMGEAR_MAX_Compu "" RAT_FUNC "%6.2" "" COEFFS 0 1 0 0 0 1 /end COMPU_METHOD
/begin COMPU_METHOD GEARSHIFTSUPRTMT_SC_Compu "" TAB_VERB "%6.3" "" COMPU_TAB_REF GEARSHIFTSUPRTMT_SC_Compu /end COMPU_METHOD
/begin COMPU_VTAB GEARSHIFTSUPRTMT_SC_Compu "" TAB_VERB 2 0 "not_available" 1 "active_MT" /end COMPU_VTAB
/begin COMPU_METHOD GENERICLIMNOVRDSTSCINC_SC_Compu "" TAB_VERB "%6.3" "" COMPU_TAB_REF GENERICLIMNOVRDSTSCINC_SC_Compu /end COMPU_METHOD
/begin COMPU_VTAB GENERICLIMNOVRDSTSCINC_SC_Compu "" TAB_VERB 2 0 "False" 1 "True" /end COMPU_VTAB
/begin COMPU_METHOD GENINHIB_SY_Compu "" TAB_VERB "%6.3" "" COMPU_TAB_REF GENINHIB_SY_Compu /end COMPU_METHOD
/begin COMPU_VTAB GENINHIB_SY_Compu "" TAB_VERB 2 0 "False" 1 "True" /end COMPU_VTAB
/begin COMPU_METHOD GEVCtl_AgSpByTstr_sm_VERB "" TAB_VERB "%6.3" "" COMPU_TAB_REF GEVCtl_AgSpByTstr_sm_VERB /end COMPU_METHOD
/begin COMPU_VTAB GEVCtl_AgSpByTstr_sm_VERB "" TAB_VERB 7 0 "WAIT_FOR_TESTER" 1 "AP_TO_RP" 2 "RP_TO_AP" 3 "SET_RP_AND_WAIT" 4 "WAIT_FOR_REQ_END" 5 "WAIT_IN_AP" 6 "WAIT_IN_RP" /end COMPU_VTAB
/begin COMPU_METHOD GEVCTL_BASCONLY_SC_Compu "" TAB_VERB "%6.3" "" COMPU_TAB_REF GEVCTL_BASCONLY_SC_Compu /end COMPU_METHOD
/begin COMPU_VTAB GEVCTL_BASCONLY_SC_Compu "" TAB_VERB 2 0 "False" 1 "True" /end COMPU_VTAB
/begin COMPU_METHOD GEVCtl_PhaUnLckStMac_sm_VERB "" TAB_VERB "%6.3" "" COMPU_TAB_REF GEVCtl_PhaUnLckStMac_sm_VERB /end COMPU_METHOD
/begin COMPU_VTAB GEVCtl_PhaUnLckStMac_sm_VERB "" TAB_VERB 6 0 "A_Start" 1 "A_0_Idle" 2 "A_1_UnlockMonitoring" 3 "A_2_UnlockControl" 4 "A_3_Wait" 5 "A_4_UnlockForAdaptation" /end COMPU_VTAB
/begin COMPU_METHOD GEVCTL_REQADPNEXT_SC_Compu "" TAB_VERB "%6.3" "" COMPU_TAB_REF GEVCTL_REQADPNEXT_SC_Compu /end COMPU_METHOD
/begin COMPU_VTAB GEVCTL_REQADPNEXT_SC_Compu "" TAB_VERB 2 0 "NoReq" 1 "Req" /end COMPU_VTAB
/begin COMPU_METHOD GEVCTL_VAR_SY_Compu "" TAB_VERB "%6.3" "" COMPU_TAB_REF GEVCTL_VAR_SY_Compu /end COMPU_METHOD
/begin COMPU_VTAB GEVCTL_VAR_SY_Compu "" TAB_VERB 44 1 "DAI" 3 "VWW" 4 "POR" 5 "AUD" 6 "OPE" 9 "FIA" 11 "BMW" 14 "PSA" 15 "REN" 17 "ALF" 18 "SAB" 19 "VOL" 20 "NIS" 21 "GMU" 22 "FOR" 26 "IMJ" 51 "SEA" 53 "CHR" 54 "JAG" 55 "ROL" 69 "FER" 72 "TOY" 123 "MIT" 147 "HYU" 159 "HON" 160 "MAZ" 183 "CU" 190 "LRG" 204 "VVW" 214 "AVT" 242 "Iveco" 243 "DMC" 248 "SUZ" 267 "SSANGYONG" 270 "KEF" 289 "AMG" 308 "TAT" 319 "MVM" 385 "UAES" 590 "Scania" 828 "RBCD" 999 "ALL" 2887 "Nonox" 9454 "Fuso" /end COMPU_VTAB
/begin COMPU_METHOD GEVCTL_VLVOPENCLSDARY_SC_Compu "" TAB_VERB "%6.3" "" COMPU_TAB_REF GEVCTL_VLVOPENCLSDARY_SC_Compu /end COMPU_METHOD
/begin COMPU_VTAB GEVCTL_VLVOPENCLSDARY_SC_Compu "" TAB_VERB 2 0 "NoArray" 1 "Array" /end COMPU_VTAB
/begin COMPU_METHOD GLBDALSUMAVS_SY_Compu "" TAB_VERB "%6.3" "" COMPU_TAB_REF GLBDALSUMAVS_SY_Compu /end COMPU_METHOD
/begin COMPU_VTAB GLBDALSUMAVS_SY_Compu "" TAB_VERB 2 0 "False" 1 "True" /end COMPU_VTAB
/begin COMPU_METHOD GLBDA_ACTRACTVN_SC_Compu "" TAB_VERB "%6.3" "" COMPU_TAB_REF GLBDA_ACTRACTVN_SC_Compu /end COMPU_METHOD
/begin COMPU_VTAB GLBDA_ACTRACTVN_SC_Compu "" TAB_VERB 2 0 "Disable_Actuator_Activation" 1 "Enable_Actuator_Activation" /end COMPU_VTAB
/begin COMPU_METHOD GLBDA_ENAVEHDRVGDIRDETN_SC_Compu "" TAB_VERB "%6.3" "" COMPU_TAB_REF GLBDA_ENAVEHDRVGDIRDETN_SC_Compu /end COMPU_METHOD
/begin COMPU_VTAB GLBDA_ENAVEHDRVGDIRDETN_SC_Compu "" TAB_VERB 2 0 "False" 1 "True" /end COMPU_VTAB
/begin COMPU_METHOD GLBDA_LSUMMODE_SC_Compu "" TAB_VERB "%6.3" "" COMPU_TAB_REF GLBDA_LSUMMODE_SC_Compu /end COMPU_METHOD
/begin COMPU_VTAB GLBDA_LSUMMODE_SC_Compu "" TAB_VERB 3 0 "0" 1 "1" 2 "2" /end COMPU_VTAB
/begin COMPU_METHOD GPFRGNAIRVLV_SC_Compu "" TAB_VERB "%6.3" "" COMPU_TAB_REF GPFRGNAIRVLV_SC_Compu /end COMPU_METHOD
/begin COMPU_VTAB GPFRGNAIRVLV_SC_Compu "" TAB_VERB 2 0 "Does_not_exist" 1 "Exists" /end COMPU_VTAB
/begin COMPU_METHOD GPFRGNFANENA_INHOUSE_SC_Compu "" TAB_VERB "%6.3" "" COMPU_TAB_REF GPFRGNFANENA_INHOUSE_SC_Compu /end COMPU_METHOD
/begin COMPU_VTAB GPFRGNFANENA_INHOUSE_SC_Compu "" TAB_VERB 2 0 "RB" 1 "SWSH" /end COMPU_VTAB
/begin COMPU_METHOD GrpDlyTime "" RAT_FUNC "%6.3" "usec" COEFFS 0 10 0 0 0 1 /end COMPU_METHOD
/begin COMPU_METHOD GSHDEM_AVL_SC_Compu "" TAB_VERB "%6.3" "" COMPU_TAB_REF GSHDEM_AVL_SC_Compu /end COMPU_METHOD
/begin COMPU_VTAB GSHDEM_AVL_SC_Compu "" TAB_VERB 3 0 "0" 1 "1" 2 "2" /end COMPU_VTAB
/begin COMPU_METHOD GSHDEM_PRELOAD_SC_Compu "" TAB_VERB "%6.3" "" COMPU_TAB_REF GSHDEM_PRELOAD_SC_Compu /end COMPU_METHOD
/begin COMPU_VTAB GSHDEM_PRELOAD_SC_Compu "" TAB_VERB 2 0 "False" 1 "True" /end COMPU_VTAB
/begin COMPU_METHOD GSSYS_TYPEEXHFLW_SY_Compu "" TAB_VERB "%6.3" "" COMPU_TAB_REF GSSYS_TYPEEXHFLW_SY_Compu /end COMPU_METHOD
/begin COMPU_VTAB GSSYS_TYPEEXHFLW_SY_Compu "" TAB_VERB 2 1 "HESRV_SNGLFLW" 2 "HESRV_TWFLW" /end COMPU_VTAB
/begin COMPU_METHOD GSSYS_TYPINDVOL_SY_Compu "" TAB_VERB "%6.3" "" COMPU_TAB_REF GSSYS_TYPINDVOL_SY_Compu /end COMPU_METHOD
/begin COMPU_VTAB GSSYS_TYPINDVOL_SY_Compu "" TAB_VERB 3 0 "HESRV_NOTUSED" 1 "HESRV_SNGLFLW" 2 "HESRV_TWFLW" /end COMPU_VTAB
/begin COMPU_METHOD GSSYS_TYPPCR_SY_Compu "" TAB_VERB "%6.3" "" COMPU_TAB_REF GSSYS_TYPPCR_SY_Compu /end COMPU_METHOD
/begin COMPU_VTAB GSSYS_TYPPCR_SY_Compu "" TAB_VERB 2 1 "HESRV_SNGLFLW" 2 "HESRV_TWFLW" /end COMPU_VTAB
/begin COMPU_METHOD H2CORS2_SY_Compu "" TAB_VERB "%6.3" "" COMPU_TAB_REF H2CORS2_SY_Compu /end COMPU_METHOD
/begin COMPU_VTAB H2CORS2_SY_Compu "" TAB_VERB 2 0 "False" 1 "True" /end COMPU_VTAB
/begin COMPU_METHOD H2CORS3_SY_Compu "" TAB_VERB "%6.3" "" COMPU_TAB_REF H2CORS3_SY_Compu /end COMPU_METHOD
/begin COMPU_VTAB H2CORS3_SY_Compu "" TAB_VERB 2 0 "False" 1 "True" /end COMPU_VTAB
/begin COMPU_METHOD H2ICE_SC_Compu "" TAB_VERB "%6.3" "" COMPU_TAB_REF H2ICE_SC_Compu /end COMPU_METHOD
/begin COMPU_VTAB H2ICE_SC_Compu "" TAB_VERB 3 0 "NO_H2ICE" 1 "H2ICE_PI" 2 "H2ICE_DI" /end COMPU_VTAB
/begin COMPU_METHOD HBR_SC_Compu "" TAB_VERB "%6.3" "" COMPU_TAB_REF HBR_SC_Compu /end COMPU_METHOD
/begin COMPU_VTAB HBR_SC_Compu "" TAB_VERB 2 0 "False" 1 "True" /end COMPU_VTAB
/begin COMPU_METHOD HCI_HCDOSSYS_SC_Compu "" TAB_VERB "%6.3" "" COMPU_TAB_REF HCI_HCDOSSYS_SC_Compu /end COMPU_METHOD
/begin COMPU_VTAB HCI_HCDOSSYS_SC_Compu "" TAB_VERB 4 0 "no_HCI" 1 "HCDos_with_DCU" 2 "HCDos_with_PowerSwitch" 3 "HCDos_integrated" /end COMPU_VTAB
/begin COMPU_METHOD HCMassPerTime "" RAT_FUNC "%6.3" "mg/s" COEFFS 0 10 0 0 0 1 /end COMPU_METHOD
/begin COMPU_METHOD HCMassPerTime_q0p0000004 "" RAT_FUNC "%9.8" "kg/s" COEFFS 0 2500000 0 0 0 1 /end COMPU_METHOD
/begin COMPU_METHOD HCMassPerTime_q0p4 "" RAT_FUNC "%6.3" "mg/s" COEFFS 0 2.5 0 0 0 1 /end COMPU_METHOD
/begin COMPU_METHOD HCMassPerTime_q0p8 "" RAT_FUNC "%6.2" "mg/s" COEFFS 0 1.25 0 0 0 1 /end COMPU_METHOD
/begin COMPU_METHOD HCMass_q0p005 "" RAT_FUNC "%6.4" "g" COEFFS 0 200 0 0 0 1 /end COMPU_METHOD
/begin COMPU_METHOD HDC_SY_Compu "" TAB_VERB "%6.3" "" COMPU_TAB_REF HDC_SY_Compu /end COMPU_METHOD
/begin COMPU_VTAB HDC_SY_Compu "" TAB_VERB 2 0 "False" 1 "True" /end COMPU_VTAB
/begin COMPU_METHOD HDLI_HWACTV_SY_Compu "" TAB_VERB "%6.3" "" COMPU_TAB_REF HDLI_HWACTV_SY_Compu /end COMPU_METHOD
/begin COMPU_VTAB HDLI_HWACTV_SY_Compu "" TAB_VERB 2 0 "False" 1 "True" /end COMPU_VTAB
/begin COMPU_METHOD HeatCapacity "" RAT_FUNC "%6.3" "J/K" COEFFS 0 10 0 0 0 1 /end COMPU_METHOD
/begin COMPU_METHOD HEATRCORET_TYPAVL_SC_Compu "" TAB_VERB "%6.3" "" COMPU_TAB_REF HEATRCORET_TYPAVL_SC_Compu /end COMPU_METHOD
/begin COMPU_VTAB HEATRCORET_TYPAVL_SC_Compu "" TAB_VERB 2 0 "False" 1 "True" /end COMPU_VTAB
/begin COMPU_METHOD HEGNDIAGU_SC_Compu "" TAB_VERB "%6.3" "" COMPU_TAB_REF HEGNDIAGU_SC_Compu /end COMPU_METHOD
/begin COMPU_VTAB HEGNDIAGU_SC_Compu "" TAB_VERB 2 0 "WoDiagSnsrU" 1 "WithDiagSnsrU" /end COMPU_VTAB
/begin COMPU_METHOD HEGNNMNGCNVTN_SC_Compu "" TAB_VERB "%6.3" "" COMPU_TAB_REF HEGNNMNGCNVTN_SC_Compu /end COMPU_METHOD
/begin COMPU_VTAB HEGNNMNGCNVTN_SC_Compu "" TAB_VERB 6 0 "GS-classic" 1 "AUTOSAR R2.0" 2 "AUTOSAR R4.0" 3 "mixed AUTOSAR R2.0/GS-classic" 4 "mixed AUTOSAR R4.0/GS-classic" 5 "mixed AUTOSAR R2.0/AUTOSAR R4.0" /end COMPU_VTAB
/begin COMPU_METHOD HEGNS3B1_SC_Compu "" TAB_VERB "%6.3" "" COMPU_TAB_REF HEGNS3B1_SC_Compu /end COMPU_METHOD
/begin COMPU_VTAB HEGNS3B1_SC_Compu "" TAB_VERB 2 0 "False" 1 "True" /end COMPU_VTAB
/begin COMPU_METHOD HEGNS3B2_SC_Compu "" TAB_VERB "%6.3" "" COMPU_TAB_REF HEGNS3B2_SC_Compu /end COMPU_METHOD
/begin COMPU_VTAB HEGNS3B2_SC_Compu "" TAB_VERB 2 0 "False" 1 "True" /end COMPU_VTAB
/begin COMPU_METHOD HEGNS4B1_SC_Compu "" TAB_VERB "%6.3" "" COMPU_TAB_REF HEGNS4B1_SC_Compu /end COMPU_METHOD
/begin COMPU_VTAB HEGNS4B1_SC_Compu "" TAB_VERB 2 0 "False" 1 "True" /end COMPU_VTAB
/begin COMPU_METHOD HEGNS4B2_SC_Compu "" TAB_VERB "%6.3" "" COMPU_TAB_REF HEGNS4B2_SC_Compu /end COMPU_METHOD
/begin COMPU_VTAB HEGNS4B2_SC_Compu "" TAB_VERB 2 0 "False" 1 "True" /end COMPU_VTAB
/begin COMPU_METHOD HEGODDLYDS_SY_Compu "" TAB_VERB "%6.3" "" COMPU_TAB_REF HEGODDLYDS_SY_Compu /end COMPU_METHOD
/begin COMPU_VTAB HEGODDLYDS_SY_Compu "" TAB_VERB 2 0 "False" 1 "True" /end COMPU_VTAB
/begin COMPU_METHOD HEGODDYNSIMN_SY_Compu "" TAB_VERB "%6.3" "" COMPU_TAB_REF HEGODDYNSIMN_SY_Compu /end COMPU_METHOD
/begin COMPU_VTAB HEGODDYNSIMN_SY_Compu "" TAB_VERB 2 0 "False" 1 "True" /end COMPU_VTAB
/begin COMPU_METHOD HEGODDYNUS_SY_Compu "" TAB_VERB "%6.3" "" COMPU_TAB_REF HEGODDYNUS_SY_Compu /end COMPU_METHOD
/begin COMPU_VTAB HEGODDYNUS_SY_Compu "" TAB_VERB 2 0 "False" 1 "True" /end COMPU_VTAB
/begin COMPU_METHOD HEGODLIMDS_SY_Compu "" TAB_VERB "%6.3" "" COMPU_TAB_REF HEGODLIMDS_SY_Compu /end COMPU_METHOD
/begin COMPU_VTAB HEGODLIMDS_SY_Compu "" TAB_VERB 2 0 "False" 1 "True" /end COMPU_VTAB
/begin COMPU_METHOD HEGODSYMCTLUS_SY_Compu "" TAB_VERB "%6.3" "" COMPU_TAB_REF HEGODSYMCTLUS_SY_Compu /end COMPU_METHOD
/begin COMPU_VTAB HEGODSYMCTLUS_SY_Compu "" TAB_VERB 2 0 "False" 1 "True" /end COMPU_VTAB
/begin COMPU_METHOD HEGODTRANDS_SY_Compu "" TAB_VERB "%6.3" "" COMPU_TAB_REF HEGODTRANDS_SY_Compu /end COMPU_METHOD
/begin COMPU_VTAB HEGODTRANDS_SY_Compu "" TAB_VERB 3 0 "0" 1 "1" 2 "2" /end COMPU_VTAB
/begin COMPU_METHOD HEGOFUELCOR_SY_Compu "" TAB_VERB "%6.3" "" COMPU_TAB_REF HEGOFUELCOR_SY_Compu /end COMPU_METHOD
/begin COMPU_VTAB HEGOFUELCOR_SY_Compu "" TAB_VERB 2 0 "False" 1 "True" /end COMPU_VTAB
/begin COMPU_METHOD HEGONMNGCNVTN_SC_Compu "" TAB_VERB "%6.3" "" COMPU_TAB_REF HEGONMNGCNVTN_SC_Compu /end COMPU_METHOD
/begin COMPU_VTAB HEGONMNGCNVTN_SC_Compu "" TAB_VERB 6 0 "GS-classic" 1 "AUTOSAR R2.0" 2 "AUTOSAR R4.0" 3 "mixed AUTOSAR R2.0/GS-classic" 4 "mixed AUTOSAR R4.0/GS-classic" 5 "mixed AUTOSAR R2.0/AUTOSAR R4.0" /end COMPU_VTAB
/begin COMPU_METHOD HEGONTK_SY_Compu "" TAB_VERB "%6.3" "" COMPU_TAB_REF HEGONTK_SY_Compu /end COMPU_METHOD
/begin COMPU_VTAB HEGONTK_SY_Compu "" TAB_VERB 2 0 "False" 1 "True" /end COMPU_VTAB
/begin COMPU_METHOD HEGOPREHEATG_SC_Compu "" TAB_VERB "%6.3" "" COMPU_TAB_REF HEGOPREHEATG_SC_Compu /end COMPU_METHOD
/begin COMPU_VTAB HEGOPREHEATG_SC_Compu "" TAB_VERB 2 0 "False" 1 "True" /end COMPU_VTAB
/begin COMPU_METHOD HEGOS1B1_SY_Compu "" TAB_VERB "%6.3" "" COMPU_TAB_REF HEGOS1B1_SY_Compu /end COMPU_METHOD
/begin COMPU_VTAB HEGOS1B1_SY_Compu "" TAB_VERB 2 0 "False" 1 "True" /end COMPU_VTAB
/begin COMPU_METHOD HEGOS1B2_SY_Compu "" TAB_VERB "%6.3" "" COMPU_TAB_REF HEGOS1B2_SY_Compu /end COMPU_METHOD
/begin COMPU_VTAB HEGOS1B2_SY_Compu "" TAB_VERB 2 0 "False" 1 "True" /end COMPU_VTAB
/begin COMPU_METHOD HEGOS1COLDOPER_SC_Compu "" TAB_VERB "%6.3" "" COMPU_TAB_REF HEGOS1COLDOPER_SC_Compu /end COMPU_METHOD
/begin COMPU_VTAB HEGOS1COLDOPER_SC_Compu "" TAB_VERB 2 0 "False" 1 "True" /end COMPU_VTAB
/begin COMPU_METHOD HEGOS1FET_SY_Compu "" TAB_VERB "%6.3" "" COMPU_TAB_REF HEGOS1FET_SY_Compu /end COMPU_METHOD
/begin COMPU_VTAB HEGOS1FET_SY_Compu "" TAB_VERB 2 0 "False" 1 "True" /end COMPU_VTAB
/begin COMPU_METHOD HEGOS1HTGENAEXT_SC_Compu "" TAB_VERB "%6.3" "" COMPU_TAB_REF HEGOS1HTGENAEXT_SC_Compu /end COMPU_METHOD
/begin COMPU_VTAB HEGOS1HTGENAEXT_SC_Compu "" TAB_VERB 2 0 "False" 1 "True" /end COMPU_VTAB
/begin COMPU_METHOD HEGOS1HTGEXT_SC_Compu "" TAB_VERB "%6.3" "" COMPU_TAB_REF HEGOS1HTGEXT_SC_Compu /end COMPU_METHOD
/begin COMPU_VTAB HEGOS1HTGEXT_SC_Compu "" TAB_VERB 2 0 "False" 1 "True" /end COMPU_VTAB
/begin COMPU_METHOD HEGOS1MNTGTST_SC_Compu "" TAB_VERB "%6.3" "" COMPU_TAB_REF HEGOS1MNTGTST_SC_Compu /end COMPU_METHOD
/begin COMPU_VTAB HEGOS1MNTGTST_SC_Compu "" TAB_VERB 2 0 "False" 1 "True" /end COMPU_VTAB
/begin COMPU_METHOD HEGOS2B1_SY_Compu "" TAB_VERB "%6.3" "" COMPU_TAB_REF HEGOS2B1_SY_Compu /end COMPU_METHOD
/begin COMPU_VTAB HEGOS2B1_SY_Compu "" TAB_VERB 2 0 "False" 1 "True" /end COMPU_VTAB
/begin COMPU_METHOD HEGOS2B2_SY_Compu "" TAB_VERB "%6.3" "" COMPU_TAB_REF HEGOS2B2_SY_Compu /end COMPU_METHOD
/begin COMPU_VTAB HEGOS2B2_SY_Compu "" TAB_VERB 2 0 "False" 1 "True" /end COMPU_VTAB
/begin COMPU_METHOD HEGOS2COLDOPER_SC_Compu "" TAB_VERB "%6.3" "" COMPU_TAB_REF HEGOS2COLDOPER_SC_Compu /end COMPU_METHOD
/begin COMPU_VTAB HEGOS2COLDOPER_SC_Compu "" TAB_VERB 2 0 "False" 1 "True" /end COMPU_VTAB
/begin COMPU_METHOD HEGOS2FET_SY_Compu "" TAB_VERB "%6.3" "" COMPU_TAB_REF HEGOS2FET_SY_Compu /end COMPU_METHOD
/begin COMPU_VTAB HEGOS2FET_SY_Compu "" TAB_VERB 2 0 "False" 1 "True" /end COMPU_VTAB
/begin COMPU_METHOD HEGOS2HTGENAEXT_SC_Compu "" TAB_VERB "%6.3" "" COMPU_TAB_REF HEGOS2HTGENAEXT_SC_Compu /end COMPU_METHOD
/begin COMPU_VTAB HEGOS2HTGENAEXT_SC_Compu "" TAB_VERB 2 0 "False" 1 "True" /end COMPU_VTAB
/begin COMPU_METHOD HEGOS2HTGEXT_SC_Compu "" TAB_VERB "%6.3" "" COMPU_TAB_REF HEGOS2HTGEXT_SC_Compu /end COMPU_METHOD
/begin COMPU_VTAB HEGOS2HTGEXT_SC_Compu "" TAB_VERB 2 0 "False" 1 "True" /end COMPU_VTAB
/begin COMPU_METHOD HEGOS2MNTGTST_SC_Compu "" TAB_VERB "%6.3" "" COMPU_TAB_REF HEGOS2MNTGTST_SC_Compu /end COMPU_METHOD
/begin COMPU_VTAB HEGOS2MNTGTST_SC_Compu "" TAB_VERB 2 0 "False" 1 "True" /end COMPU_VTAB
/begin COMPU_METHOD HEGOS2OFFSDETN_SC_Compu "" TAB_VERB "%6.3" "" COMPU_TAB_REF HEGOS2OFFSDETN_SC_Compu /end COMPU_METHOD
/begin COMPU_VTAB HEGOS2OFFSDETN_SC_Compu "" TAB_VERB 2 0 "False" 1 "True" /end COMPU_VTAB
/begin COMPU_METHOD HEGOS3B1_SY_Compu "" TAB_VERB "%6.3" "" COMPU_TAB_REF HEGOS3B1_SY_Compu /end COMPU_METHOD
/begin COMPU_VTAB HEGOS3B1_SY_Compu "" TAB_VERB 2 0 "False" 1 "True" /end COMPU_VTAB
/begin COMPU_METHOD HEGOS3B2_SY_Compu "" TAB_VERB "%6.3" "" COMPU_TAB_REF HEGOS3B2_SY_Compu /end COMPU_METHOD
/begin COMPU_VTAB HEGOS3B2_SY_Compu "" TAB_VERB 2 0 "False" 1 "True" /end COMPU_VTAB
/begin COMPU_METHOD HEGOS3COLDOPER_SC_Compu "" TAB_VERB "%6.3" "" COMPU_TAB_REF HEGOS3COLDOPER_SC_Compu /end COMPU_METHOD
/begin COMPU_VTAB HEGOS3COLDOPER_SC_Compu "" TAB_VERB 2 0 "False" 1 "True" /end COMPU_VTAB
/begin COMPU_METHOD HEGOS3FET_SY_Compu "" TAB_VERB "%6.3" "" COMPU_TAB_REF HEGOS3FET_SY_Compu /end COMPU_METHOD
/begin COMPU_VTAB HEGOS3FET_SY_Compu "" TAB_VERB 2 0 "False" 1 "True" /end COMPU_VTAB
/begin COMPU_METHOD HEGOS3HTGENAEXT_SC_Compu "" TAB_VERB "%6.3" "" COMPU_TAB_REF HEGOS3HTGENAEXT_SC_Compu /end COMPU_METHOD
/begin COMPU_VTAB HEGOS3HTGENAEXT_SC_Compu "" TAB_VERB 2 0 "False" 1 "True" /end COMPU_VTAB
/begin COMPU_METHOD HEGOS3HTGEXT_SC_Compu "" TAB_VERB "%6.3" "" COMPU_TAB_REF HEGOS3HTGEXT_SC_Compu /end COMPU_METHOD
/begin COMPU_VTAB HEGOS3HTGEXT_SC_Compu "" TAB_VERB 2 0 "False" 1 "True" /end COMPU_VTAB
/begin COMPU_METHOD HEGOS3MNTGTST_SC_Compu "" TAB_VERB "%6.3" "" COMPU_TAB_REF HEGOS3MNTGTST_SC_Compu /end COMPU_METHOD
/begin COMPU_VTAB HEGOS3MNTGTST_SC_Compu "" TAB_VERB 2 0 "False" 1 "True" /end COMPU_VTAB
/begin COMPU_METHOD HEGO_BINSNSRSWIL_SC_Compu "" TAB_VERB "%6.3" "" COMPU_TAB_REF HEGO_BINSNSRSWIL_SC_Compu /end COMPU_METHOD
/begin COMPU_VTAB HEGO_BINSNSRSWIL_SC_Compu "" TAB_VERB 2 0 "False" 1 "True" /end COMPU_VTAB
/begin COMPU_METHOD HEGO_VAR_SY_Compu "" TAB_VERB "%6.3" "" COMPU_TAB_REF HEGO_VAR_SY_Compu /end COMPU_METHOD
/begin COMPU_VTAB HEGO_VAR_SY_Compu "" TAB_VERB 45 1 "DAI" 3 "VWW" 4 "POR" 5 "AUD" 6 "OPE" 9 "FIA" 11 "BMW" 14 "PSA" 15 "REN" 17 "ALF" 18 "SAB" 19 "VOL" 20 "NIS" 21 "GMU" 22 "FOR" 26 "IMJ" 51 "SEA" 53 "CHR" 54 "JAG" 55 "ROL" 69 "FER" 72 "TOY" 112 "BMW-Motorrad AG" 123 "MIT" 147 "HYU" 159 "HON" 160 "MAZ" 183 "CU" 190 "LRG" 204 "VVW" 214 "AVT" 242 "Iveco" 243 "DMC" 248 "SUZ" 267 "SSANGYONG" 270 "KEF" 289 "AMG" 308 "TAT" 319 "MVM" 385 "UAES" 590 "Scania" 828 "RBCD" 999 "ALL" 2887 "Nonox" 9454 "Fuso" /end COMPU_VTAB
/begin COMPU_METHOD HEMAIRCHMB_SC_Compu "" TAB_VERB "%6.3" "" COMPU_TAB_REF HEMAIRCHMB_SC_Compu /end COMPU_METHOD
/begin COMPU_VTAB HEMAIRCHMB_SC_Compu "" TAB_VERB 2 0 "False" 1 "True" /end COMPU_VTAB
/begin COMPU_METHOD HEM_SY_Compu "" TAB_VERB "%6.3" "" COMPU_TAB_REF HEM_SY_Compu /end COMPU_METHOD
/begin COMPU_VTAB HEM_SY_Compu "" TAB_VERB 3 0 "NO_HEM" 1 "HEM_CYL" 2 "HEM_BNK" /end COMPU_VTAB
/begin COMPU_METHOD HESRV_DEFNGETECUTYPE_SC_Compu "" TAB_VERB "%6.3" "" COMPU_TAB_REF HESRV_DEFNGETECUTYPE_SC_Compu /end COMPU_METHOD
/begin COMPU_VTAB HESRV_DEFNGETECUTYPE_SC_Compu "" TAB_VERB 2 0 "False" 1 "True" /end COMPU_VTAB
/begin COMPU_METHOD HESRV_HETYP_SY_Compu "" TAB_VERB "%6.3" "" COMPU_TAB_REF HESRV_HETYP_SY_Compu /end COMPU_METHOD
/begin COMPU_VTAB HESRV_HETYP_SY_Compu "" TAB_VERB 4 1 "HESRV_MASTERSLAVE" 2 "HESRV_VCU" 3 "HESRV_HCU" 255 "HESRV_ONEBOX" /end COMPU_VTAB
/begin COMPU_METHOD HESRV_MSIDADP_SC_Compu "" TAB_VERB "%6.3" "" COMPU_TAB_REF HESRV_MSIDADP_SC_Compu /end COMPU_METHOD
/begin COMPU_VTAB HESRV_MSIDADP_SC_Compu "" TAB_VERB 2 0 "False" 1 "True" /end COMPU_VTAB
/begin COMPU_METHOD HESRV_MSIDEXCLSN_SC_Compu "" TAB_VERB "%6.3" "" COMPU_TAB_REF HESRV_MSIDEXCLSN_SC_Compu /end COMPU_METHOD
/begin COMPU_VTAB HESRV_MSIDEXCLSN_SC_Compu "" TAB_VERB 2 0 "False" 1 "True" /end COMPU_VTAB
/begin COMPU_METHOD HESRV_MSIDOPENLOAD_SC_Compu "" TAB_VERB "%6.3" "" COMPU_TAB_REF HESRV_MSIDOPENLOAD_SC_Compu /end COMPU_METHOD
/begin COMPU_VTAB HESRV_MSIDOPENLOAD_SC_Compu "" TAB_VERB 2 0 "False" 1 "True" /end COMPU_VTAB
/begin COMPU_METHOD Length_Km_q0p001 "" RAT_FUNC "%6.5" "km" COEFFS 0 1000 0 0 0 1 /end COMPU_METHOD
/begin COMPU_METHOD nmot_q0p5 "" RAT_FUNC "%6.3" "1/min" COEFFS 0 2 0 0 0 1 /end COMPU_METHOD
/begin COMPU_METHOD nmot_q32 "" RAT_FUNC "%6.1" "1/min" COEFFS 0 1 0 0 0 32 /end COMPU_METHOD
/begin COMPU_METHOD nmot_sw_q0p25 "" RAT_FUNC "%6.3" "1/min" COEFFS 0 1 0 0 0 0.25 /end COMPU_METHOD
/begin COMPU_METHOD nmot_ub_q10 "" RAT_FUNC "%6.1" "1/min" COEFFS 0 1 0 0 0 10 /end COMPU_METHOD
/begin COMPU_METHOD nmot_uw_q0p25 "" RAT_FUNC "%6.3" "1/min" COEFFS 0 1 0 0 0 0.25 /end COMPU_METHOD
/begin COMPU_METHOD OneToOne "" RAT_FUNC "%6.2" "-" COEFFS 0 1 0 0 0 1 /end COMPU_METHOD
/begin COMPU_METHOD Period "" RAT_FUNC "%6.3" "ms" COEFFS 0 10 0 0 0 1 /end COMPU_METHOD
/begin COMPU_METHOD Prc "" RAT_FUNC "%6.4" "%" COEFFS 0 81.92 0 0 0 1 /end COMPU_METHOD
/begin COMPU_METHOD Prc_CrCtl3 "" RAT_FUNC "%6.3" "%" COEFFS 0 8 0 0 0 1 /end COMPU_METHOD
/begin COMPU_METHOD Pres "" RAT_FUNC "%6.3" "kPa" COEFFS 0 10 0 0 0 1 /end COMPU_METHOD
/begin COMPU_METHOD Pres_1_kPa "" RAT_FUNC "%6.2" "kPa" COEFFS 0 1 0 0 0 1 /end COMPU_METHOD
/begin COMPU_METHOD Pres_kPa_ENGY "" RAT_FUNC "%6.2" "kPa" COEFFS 0 1 0 0 0 1 /end COMPU_METHOD
/begin COMPU_METHOD q0p005_Perc "" RAT_FUNC "%6.4" "%" COEFFS 0 200 0 0 0 1 /end COMPU_METHOD
/begin COMPU_METHOD q0p01_V "" RAT_FUNC "%6.4" "V" COEFFS 0 100 0 0 0 1 /end COMPU_METHOD
/begin COMPU_METHOD q4_kPa "" RAT_FUNC "%6.2" "kPa" COEFFS 0 1 0 0 0 4 /end COMPU_METHOD
/begin COMPU_METHOD RBPtCel_Perc_1p0_1 "" RAT_FUNC "%6.2" "%" COEFFS 0 1 0 0 0 1 /end COMPU_METHOD
/begin COMPU_METHOD RBPtCel_tq_1p0_1 "" RAT_FUNC "%6.2" "Nm" COEFFS 0 1 0 0 0 1 /end COMPU_METHOD
/begin COMPU_METHOD RBPtCel_t_1p0_3 "" RAT_FUNC "%6.2" "Deg C" COEFFS 0 1 0 0 0 1 /end COMPU_METHOD
/begin COMPU_METHOD reldeg_q0p002441 "" RAT_FUNC "%6.4" "deg/V" COEFFS 0 65536 0 0 0 160 /end COMPU_METHOD
/begin COMPU_METHOD relDK_q0p3922 "" RAT_FUNC "%6.3" "%DK" COEFFS 0 255 0 0 0 100 /end COMPU_METHOD
/begin COMPU_METHOD relPED_ub_b100 "" RAT_FUNC "%6.3" "%PED" COEFFS 0 255 0 0 0 100 /end COMPU_METHOD
/begin COMPU_METHOD rel_q0p392 "" RAT_FUNC "%6.3" "%" COEFFS 0 255 0 0 0 100 /end COMPU_METHOD
/begin COMPU_METHOD rel_ub_b100 "" RAT_FUNC "%6.3" "%" COEFFS 0 256 0 0 0 100 /end COMPU_METHOD
/begin COMPU_METHOD RmpEngN "" RAT_FUNC "%6.4" "rpm/s" COEFFS 0 131.072 0 0 0 1 /end COMPU_METHOD
/begin COMPU_METHOD Signals_IntSigNumVerb "" TAB_VERB "%6.3" "" COMPU_TAB_REF Signals_IntSigNumVerb /end COMPU_METHOD
/begin COMPU_VTAB Signals_IntSigNumVerb "" TAB_VERB 1169 0 "SIGNALS_Signals_Default" 1 "SIGNALS_APP_rUnFlt" 2 "SIGNALS_APP_r_sig" 3 "SIGNALS_APP_r_signal" 4 "SIGNALS_APP_uRaw1_signal" 5 "SIGNALS_APP_uRaw2_signal" 6 "SIGNALS_AbsLdCom8Bit_PID43h" 7 "SIGNALS_AccPed_tqMapBasd_BENG_signal" 8 "SIGNALS_AccPed_tqMapBasd_TRQB_signal" 9 "SIGNALS_ActMod_trqInr_signal" 10 "SIGNALS_AirC_uAnaRawClnt_signal" 11 "SIGNALS_Alt_iExctLim_signal" 12 "SIGNALS_Alt_rAltExct_signal" 13 "SIGNALS_Alt_uFinalDes_signal" 14 "SIGNALS_BattU_u" 15 "SIGNALS_BattU_uSens1_signal" 16 "SIGNALS_BattU_uSens2_s" 17 "SIGNALS_BattU_uSens_signal" 18 "SIGNALS_Batt_lMaxCnsChk_signal" 19 "SIGNALS_Batt_lMinCnsChk_signal" 20 "SIGNALS_Batt_qCnsChkAH_signal" 21 "SIGNALS_Brk_st" 22 "SIGNALS_Brk_stRed" 23 "SIGNALS_CEngDsT_uRaw_s" 24 "SIGNALS_CEngDsT_uRaw_signal" 25 "SIGNALS_CEngUsT_t_signal" 26 "SIGNALS_CEngUsT_uSnsr_s" 27 "SIGNALS_CoEng_tiCranking_signal" 28 "SIGNALS_CoVeh_trqAcs_s" 29 "SIGNALS_ComEBS_BattID_signal" 30 "SIGNALS_ComEBS_rBattSensCh_signal" 31 "SIGNALS_ComEBS_rBattStrat_signal" 32 "SIGNALS_ComEBS_uBattSens_signal" 33 "SIGNALS_ComEBS_uBattUCO_signal" 34 "SIGNALS_Com_iBattEBS_signal" 35 "SIGNALS_Com_lDst_signal" 36 "SIGNALS_Com_rMeasdBattREbs_signal" 37 "SIGNALS_Com_stI_signal" 38 "SIGNALS_Com_stT_signal" 39 "SIGNALS_Com_stU_signal" 40 "SIGNALS_Com_tBattEBS_signal" 41 "SIGNALS_Com_trqAYCFDes_signal" 42 "SIGNALS_Com_uPeak_signal" 43 "SIGNALS_CrCtl_stShutOffCode0_signal" 44 "SIGNALS_CrCtl_stShutOffCode1_signal" 45 "SIGNALS_CrCtl_stShutOffCode2_signal" 46 "SIGNALS_CrCtl_stShutOffCode3_signal" 47 "SIGNALS_CrCtl_stShutOffCode4_signal" 48 "SIGNALS_CrCtl_stShutOffCode5_signal" 49 "SIGNALS_CrCtl_stShutOffCode6_signal" 50 "SIGNALS_CrCtl_stShutOffCode7_signal" 51 "SIGNALS_CrCtl_stShutOffCode8_signal" 52 "SIGNALS_CrCtl_stShutOffCode9_signal" 53 "SIGNALS_DIUMPR_ctGenDenom_signal" 54 "SIGNALS_DIUMPR_ctIgn_signal" 55 "SIGNALS_DRIVE_numDTCFrz_s" 56 "SIGNALS_DRIVE_stCurTrgMode_signal" 57 "SIGNALS_DRIVE_stHardToStrt_s" 58 "SIGNALS_DSM_tiMICumCont" 59 "SIGNALS_DcmDspUDS_rdbi_2612Byte10_signal" 60 "SIGNALS_DcmDspUDS_rdbi_2612Byte11_signal" 61 "SIGNALS_DcmDspUDS_rdbi_fixed_signal" 62 "SIGNALS_DcmDspUDS_rdbi_reserved0_signal_s" 63 "SIGNALS_DcmDspUDS_rdbi_reserved0_signal_w_s" 64 "SIGNALS_DcmDspUDS_rdbi_reserved1_signal" 65 "SIGNALS_Dspl_stCrsSwtInfo_signal" 66 "SIGNALS_Ebs_qBliChrg_signal" 67 "SIGNALS_Ebs_qBliDchaTotDcyc_0_signal" 68 "SIGNALS_Ebs_qBliDchaTotDcyc_1_signal" 69 "SIGNALS_Ebs_qBliDchaTotDcyc_2_signal" 70 "SIGNALS_Ebs_qBliDchaTotDcyc_3_signal" 71 "SIGNALS_Ebs_qBliDchaTotDcyc_4_signal" 72 "SIGNALS_Ebs_qBliDcha_signal" 73 "SIGNALS_Ebs_stStbIEBSByt0_0_signal" 74 "SIGNALS_Ebs_stStbIEBSByt0_1_signal" 75 "SIGNALS_Ebs_stStbIEBSByt0_2_signal" 76 "SIGNALS_Ebs_stStbIEBSByt0_3_signal" 77 "SIGNALS_Ebs_stStbIEBSByt0_4_signal" 78 "SIGNALS_Ebs_stStbIEBSByt1_0_signal" 79 "SIGNALS_Ebs_stStbIEBSByt1_1_signal" 80 "SIGNALS_Ebs_stStbIEBSByt1_2_signal" 81 "SIGNALS_Ebs_stStbIEBSByt1_3_signal" 82 "SIGNALS_Ebs_stStbIEBSByt1_4_signal" 83 "SIGNALS_Ebs_stStbIEBSByt2_0_signal" 84 "SIGNALS_Ebs_stStbIEBSByt2_1_signal" 85 "SIGNALS_Ebs_stStbIEBSByt2_2_signal" 86 "SIGNALS_Ebs_stStbIEBSByt2_3_signal" 87 "SIGNALS_Ebs_stStbIEBSByt2_4_signal" 88 "SIGNALS_Ebs_stStbIEBSByt3_0_signal" 89 "SIGNALS_Ebs_stStbIEBSByt3_1_signal" 90 "SIGNALS_Ebs_stStbIEBSByt3_2_signal" 91 "SIGNALS_Ebs_stStbIEBSByt3_3_signal" 92 "SIGNALS_Ebs_stStbIEBSByt3_4_signal" 93 "SIGNALS_Ebs_stStbIEBSByt4_0_signal" 94 "SIGNALS_Ebs_stStbIEBSByt4_1_signal" 95 "SIGNALS_Ebs_stStbIEBSByt4_2_signal" 96 "SIGNALS_Ebs_stStbIEBSByt4_3_signal" 97 "SIGNALS_Ebs_stStbIEBSByt4_4_signal" 98 "SIGNALS_EngTrqPtd_trqLead_s" 99 "SIGNALS_EngTrqPtd_trqLead_signal" 100 "SIGNALS_EngTrqPtd_trqSet_s" 101 "SIGNALS_EngTrqPtd_trqSet_signal" 102 "SIGNALS_EpmCaS_ctErrSig_signal" 103 "SIGNALS_EpmCaS_ctNoSig_signal" 104 "SIGNALS_EpmCaS_phiDiffCal2AdapEqAvg_0" 105 "SIGNALS_EpmCaS_phiOfsCorr" 106 "SIGNALS_Epm_nEngAct" 107 "SIGNALS_Epm_nEngRaw_s" 108 "SIGNALS_Epm_nEngRaw_signal" 109 "SIGNALS_Epm_stOpMode" 110 "SIGNALS_Epm_stSync" 111 "SIGNALS_FuPHi_uHiResl_signal" 112 "SIGNALS_GEVlv_ratPhaIntkB1_signal" 113 "SIGNALS_GlbDa_lenTotDstDcycHiResl_signal" 114 "SIGNALS_HEGO_uS2B1Extd_s" 115 "SIGNALS_HEGO_uS2B1HiRes_signal" 116 "SIGNALS_I14229CoEng_tiNormalOBDPrevDcyc_s" 117 "SIGNALS_I14229EpmCaS_ctErrSig1_signal" 118 "SIGNALS_I14229EpmCaS_ctNoSig1_signal" 119 "SIGNALS_I14229GlbDa_lTotDstDCHiReslPrevDcyc_s" 120 "SIGNALS_I14229IntkAirT_tSnsrTstrMax_s" 121 "SIGNALS_I14229IntkAirT_tSnsrTstrMin_s" 122 "SIGNALS_I14229RDBI_nOvrSpd_signal" 123 "SIGNALS_I14229RDBI_tiOvrSpd_signal" 124 "SIGNALS_I14229_AirC_pAnaClnt_signal" 125 "SIGNALS_I14229_ElecLd_iEPSLoadOnly_signal" 126 "SIGNALS_I14229_EpmCaS_ctErrSig2_signal" 127 "SIGNALS_I14229_EpmCaS_ctNoSig2_signal" 128 "SIGNALS_I14229_EpmCrS_ctCaSRev_signal" 129 "SIGNALS_I14229_EpmCrS_ctErrSig_signal" 130 "SIGNALS_I14229_GEVCtl_agMaxAdpdIntk_signal" 131 "SIGNALS_I14229_Gbx_uAna1NPosRaw_signal" 132 "SIGNALS_I14229_Gbx_uAna2NPosRaw_signal" 133 "SIGNALS_I14229_ivzabg_w_signal" 134 "SIGNALS_I14229_lDst_signal" 135 "SIGNALS_I14229_nstat_signal" 136 "SIGNALS_I14229_numDTCFrzFrmHi_signal" 137 "SIGNALS_I14229_numDTCFrzFrmLo_signal" 138 "SIGNALS_I14229_numDTCFrzFrmMid_signal" 139 "SIGNALS_I14229_ps_w_signal" 140 "SIGNALS_I14229_rTrqPT_signal" 141 "SIGNALS_I14229_stTURBODV_signal" 142 "SIGNALS_I14229_tSnsrFild1_signal" 143 "SIGNALS_I14229_tiInj1On_signal" 144 "SIGNALS_I14229_tiOilFlowCompl_signal" 145 "SIGNALS_I14229_tiSia_signal" 146 "SIGNALS_I14229_tkaMax_s" 147 "SIGNALS_I14229_tkaMin_s" 148 "SIGNALS_I14229_tka_signal" 149 "SIGNALS_I14229_tmotMaxCurrDcyc_s" 150 "SIGNALS_I14229_tmotMaxPrevDcyc_s" 151 "SIGNALS_I14229_tmotMinCurrDcyc_s" 152 "SIGNALS_I14229_tmotMinPrevDcyc_s" 153 "SIGNALS_I14229_ubsq_signal" 154 "SIGNALS_I14229_umsrln_w_signal" 155 "SIGNALS_I14229_wdks_w_signal" 156 "SIGNALS_I14229_wped1_signal" 157 "SIGNALS_I14229_wped2_signal" 158 "SIGNALS_I14229_zwist_signal" 159 "SIGNALS_I14229iocpMDA_numABV_signal" 160 "SIGNALS_I14229iocpMDA_numACGC_signal" 161 "SIGNALS_I14229iocpMDA_numAPS_signal" 162 "SIGNALS_I14229iocpMDA_numPSC_signal" 163 "SIGNALS_I14229iocpMDA_numRFAN_signal" 164 "SIGNALS_I14229iocpMDA_numRvsLck_signal" 165 "SIGNALS_I14229iocpMDA_numVTEC_signal" 166 "SIGNALS_I14229iocp_numCtlSt_s" 167 "SIGNALS_I14229iocp_numEXE_signal" 168 "SIGNALS_I14229iocp_numREQ_s" 169 "SIGNALS_I14229iocp_stSFTRJC_s" 170 "SIGNALS_I15031_PID1Dh" 171 "SIGNALS_I15031_PID65Ah" 172 "SIGNALS_I15031_PID66Ah" 173 "SIGNALS_I15031_PID69Ah" 174 "SIGNALS_I15031_PID6AAh" 175 "SIGNALS_I15031_PID6BAh" 176 "SIGNALS_I15031_PID6CAh" 177 "SIGNALS_I15031_PID6DAh" 178 "SIGNALS_I15031_PID6EAh" 179 "SIGNALS_I15031_PID6FAh" 180 "SIGNALS_I15031_PID70Ah" 181 "SIGNALS_I15031_PID71Ah" 182 "SIGNALS_I15031_PID72Ah" 183 "SIGNALS_I15031_PID73Ah" 184 "SIGNALS_I15031_PID74Ah" 185 "SIGNALS_I15031_PID75Ah" 186 "SIGNALS_I15031_PID76Ah" 187 "SIGNALS_I15031_PID77Ah" 188 "SIGNALS_I15031_PID78Ah" 189 "SIGNALS_I15031_PID79Ah" 190 "SIGNALS_I15031_PID7AAh" 191 "SIGNALS_I15031_PID7BAh" 192 "SIGNALS_I15031_PID7CAh" 193 "SIGNALS_I15031_PID7FAh" 194 "SIGNALS_I15031_PID81Ah" 195 "SIGNALS_I15031_PID82Ah" 196 "SIGNALS_I15031_PID85Ah" 197 "SIGNALS_I15031_PID86Ah" 198 "SIGNALS_I15031_PID87Ah" 199 "SIGNALS_I15031_PID89Ah" 200 "SIGNALS_I15031_PID8AAh" 201 "SIGNALS_I15031_PID8FAh" 202 "SIGNALS_I15031_PID92Ah" 203 "SIGNALS_I15031_PID93Ah" 204 "SIGNALS_I15031_PID94Ah" 205 "SIGNALS_I15031_PID98Ah" 206 "SIGNALS_I15031_PID99Ah" 207 "SIGNALS_I15031_PID9CAh" 208 "SIGNALS_I15031_PIDA3Ah" 209 "SIGNALS_I15031_PIDA4Ah" 210 "SIGNALS_I15031_PIDA5Ah" 211 "SIGNALS_I15031_PIDA9Ah" 212 "SIGNALS_I15031_PIDACAh" 213 "SIGNALS_IKCtl_agKnkAvrg_s8_signal" 214 "SIGNALS_InjSys_volFuConsDrvCycCAN_s" 215 "SIGNALS_IntkAirT_tSnsr2_signal" 216 "SIGNALS_IntkAirT_uSnsr1Exprt_signal" 217 "SIGNALS_IntkAirT_uSnsr3CrssSwtLoc_s" 218 "SIGNALS_MoF_rTrqInrAct_s" 219 "SIGNALS_MoF_rTrqPtdFlt_s" 220 "SIGNALS_OBD_ITID_InjSys_volFuConsDrvgCycTstrSrv" 221 "SIGNALS_OilSwmpT_uSnsrRaw_s" 222 "SIGNALS_Oil_pSensPSwmp_signal" 223 "SIGNALS_Oil_uRawPSwmp_signal" 224 "SIGNALS_PID01h" 225 "SIGNALS_PID03h_0" 226 "SIGNALS_PID03h_1" 227 "SIGNALS_PID04h" 228 "SIGNALS_PID05h" 229 "SIGNALS_PID06h_0" 230 "SIGNALS_PID07h_0" 231 "SIGNALS_PID0Ch_Epm_nEng" 232 "SIGNALS_PID0D_VehV_vSens" 233 "SIGNALS_PID0Eh" 234 "SIGNALS_PID0Fh" 235 "SIGNALS_PID0bh_PIntkVUs_pRawObd" 236 "SIGNALS_PID10h" 237 "SIGNALS_PID11h_ThrVlv_ratActSens1AbsltB1_u8" 238 "SIGNALS_PID13h" 239 "SIGNALS_PID15h_0" 240 "SIGNALS_PID15h_1" 241 "SIGNALS_PID1Ch" 242 "SIGNALS_PID1Fh_TiScneEngStrt" 243 "SIGNALS_PID21h" 244 "SIGNALS_PID23h" 245 "SIGNALS_PID2Ch_EGRVlv_rCmdNrm" 246 "SIGNALS_PID2Dh_EGRVlv_rGovDvtNrm" 247 "SIGNALS_PID2Eh" 248 "SIGNALS_PID2Fh" 249 "SIGNALS_PID30h" 250 "SIGNALS_PID31h" 251 "SIGNALS_PID33h_PEnv_pRaw" 252 "SIGNALS_PID34h_0" 253 "SIGNALS_PID34h_1" 254 "SIGNALS_PID3Ch" 255 "SIGNALS_PID41h" 256 "SIGNALS_PID42_BattU_uSens" 257 "SIGNALS_PID43h" 258 "SIGNALS_PID44h" 259 "SIGNALS_PID45h_ThrVlv_ratActSens1RelB1_u8" 260 "SIGNALS_PID46h" 261 "SIGNALS_PID47h_ThrVlv_ratActSens2AbsltB1_u8" 262 "SIGNALS_PID49_APP_uRaw1unLim" 263 "SIGNALS_PID4A_APP_uRaw2unLim" 264 "SIGNALS_PID4Ch_wdks_msg" 265 "SIGNALS_PID4FAh" 266 "SIGNALS_PID4FBh" 267 "SIGNALS_PID4FCh" 268 "SIGNALS_PID4FDh" 269 "SIGNALS_PID50Ah" 270 "SIGNALS_PID50Bh" 271 "SIGNALS_PID50Ch" 272 "SIGNALS_PID50Dh" 273 "SIGNALS_PID51h_PID51_stFuTyp" 274 "SIGNALS_PID52h" 275 "SIGNALS_PID56h_0" 276 "SIGNALS_PID5A_APP_rOBDPID5A" 277 "SIGNALS_PID5Eh_InjSys_volEngFuCnsPerHr" 278 "SIGNALS_PID5Fh" 279 "SIGNALS_PID62h_TME_ratActEngPercTqPrmIdH62" 280 "SIGNALS_IntFloat_PID63h_TqEngRef" 281 "SIGNALS_PID67h_ects2sva_msg" 282 "SIGNALS_PID67h_ects2svb_msg" 283 "SIGNALS_PID67h_ects2svc_msg" 284 "SIGNALS_PID68h_iats2sva" 285 "SIGNALS_PID68h_iats2svb" 286 "SIGNALS_PID68h_iats2svc" 287 "SIGNALS_PID68h_iats2svd" 288 "SIGNALS_PID68h_iats2sve" 289 "SIGNALS_PID68h_iats2svf" 290 "SIGNALS_PID68h_iats2svg" 291 "SIGNALS_PID69h_EGRVlv_rActNrm" 292 "SIGNALS_PID69h_EGRVlv_rCmdNrm" 293 "SIGNALS_PID69h_EGRVlv_rGovDvtNrm" 294 "SIGNALS_PID7Fh_RTId_TotRt" 295 "SIGNALS_PID7Fh_RtId_TotIdleRt" 296 "SIGNALS_PID7Fh_RtId_TotPtoRt" 297 "SIGNALS_PID87h_PIntkVUs_pRawObd" 298 "SIGNALS_PID8BAh" 299 "SIGNALS_PID8CAh" 300 "SIGNALS_PID8Eh_TME_ratEngFricPercTqPrmIdH8E" 301 "SIGNALS_PID93BCh" 302 "SIGNALS_PID9AAh" 303 "SIGNALS_PID9Dh_InjSys_mfEngFuRate" 304 "SIGNALS_PID9Dh_InjSys_mfVehFuRate" 305 "SIGNALS_PID9FAh" 306 "SIGNALS_PIDA6h_lTotDst" 307 "SIGNALS_PID_FILLSIG_1BIT" 308 "SIGNALS_PID_FILLSIG_1BITNZ" 309 "SIGNALS_PID_FILLSIG_1BYTE" 310 "SIGNALS_PID_FILLSIG_1BYTENZ" 311 "SIGNALS_PID_FILLSIG_2BIT" 312 "SIGNALS_PID_FILLSIG_2BITNZ" 313 "SIGNALS_PID_FILLSIG_2BYTE" 314 "SIGNALS_PID_FILLSIG_2BYTENZ" 315 "SIGNALS_PID_FILLSIG_3BIT" 316 "SIGNALS_PID_FILLSIG_3BITNZ" 317 "SIGNALS_PID_FILLSIG_4BIT" 318 "SIGNALS_PID_FILLSIG_4BITNZ" 319 "SIGNALS_PID_FILLSIG_4BYTE" 320 "SIGNALS_PID_FILLSIG_4BYTENZ" 321 "SIGNALS_PID_FILLSIG_5BIT" 322 "SIGNALS_PID_FILLSIG_5BITNZ" 323 "SIGNALS_PID_FILLSIG_6BIT" 324 "SIGNALS_PID_FILLSIG_6BITNZ" 325 "SIGNALS_PID_FILLSIG_7BIT" 326 "SIGNALS_PID_FILLSIG_7BITNZ" 327 "SIGNALS_PIntkVUs_uRawUnFlt_signal" 328 "SIGNALS_PT_rGrip_signal" 329 "SIGNALS_PT_trqLos_signal" 330 "SIGNALS_PThrVlvUs_uRawB1_signal" 331 "SIGNALS_PthLead_trqInrNoMon_s" 332 "SIGNALS_PthLead_trqInrNoMon_signal" 333 "SIGNALS_PthSet_trqInrIABef_s" 334 "SIGNALS_PthSet_trqInrLtd_s" 335 "SIGNALS_RngMod_trqDiffAdap_signal" 336 "SIGNALS_RngMod_trqDiffAdap_signal_s" 337 "SIGNALS_RngMod_trqInrBs_s" 338 "SIGNALS_SIGNAL_GEVlv_agSumSpCsersDeIntkB1" 339 "SIGNALS_Strt_uStrtMonDia_signal" 340 "SIGNALS_TWCD_numMeasB1_s" 341 "SIGNALS_TWCD_rOSCAvrgPriB1_s" 342 "SIGNALS_TWCD_rOSCAvrgPriB1_signal" 343 "SIGNALS_ThrVlv_uRawSens1B1_signal" 344 "SIGNALS_ThrVlv_uRawSens2B1_signal" 345 "SIGNALS_TiEngOff_ti_s" 346 "SIGNALS_VehStc_lDstCityEco_signal" 347 "SIGNALS_VehStc_lDstCity_signal" 348 "SIGNALS_VehStc_lDstHighWayEco_signal" 349 "SIGNALS_VehStc_lDstHighWay_signal" 350 "SIGNALS_VehStc_numFuDiagRecA_0_s" 351 "SIGNALS_VehStc_numFuDiagRecA_10_s" 352 "SIGNALS_VehStc_numFuDiagRecA_11_s" 353 "SIGNALS_VehStc_numFuDiagRecA_12_s" 354 "SIGNALS_VehStc_numFuDiagRecA_13_s" 355 "SIGNALS_VehStc_numFuDiagRecA_14_s" 356 "SIGNALS_VehStc_numFuDiagRecA_15_s" 357 "SIGNALS_VehStc_numFuDiagRecA_16_s" 358 "SIGNALS_VehStc_numFuDiagRecA_17_s" 359 "SIGNALS_VehStc_numFuDiagRecA_18_s" 360 "SIGNALS_VehStc_numFuDiagRecA_19_s" 361 "SIGNALS_VehStc_numFuDiagRecA_1_s" 362 "SIGNALS_VehStc_numFuDiagRecA_20_s" 363 "SIGNALS_VehStc_numFuDiagRecA_2_s" 364 "SIGNALS_VehStc_numFuDiagRecA_3_s" 365 "SIGNALS_VehStc_numFuDiagRecA_4_s" 366 "SIGNALS_VehStc_numFuDiagRecA_5_s" 367 "SIGNALS_VehStc_numFuDiagRecA_6_s" 368 "SIGNALS_VehStc_numFuDiagRecA_7_s" 369 "SIGNALS_VehStc_numFuDiagRecA_8_s" 370 "SIGNALS_VehStc_numFuDiagRecA_9_s" 371 "SIGNALS_VehStc_numMisfDetnHiEctA_0_s" 372 "SIGNALS_VehStc_numMisfDetnHiEctA_10_s" 373 "SIGNALS_VehStc_numMisfDetnHiEctA_11_s" 374 "SIGNALS_VehStc_numMisfDetnHiEctA_12_s" 375 "SIGNALS_VehStc_numMisfDetnHiEctA_13_s" 376 "SIGNALS_VehStc_numMisfDetnHiEctA_14_s" 377 "SIGNALS_VehStc_numMisfDetnHiEctA_15_s" 378 "SIGNALS_VehStc_numMisfDetnHiEctA_16_s" 379 "SIGNALS_VehStc_numMisfDetnHiEctA_17_s" 380 "SIGNALS_VehStc_numMisfDetnHiEctA_18_s" 381 "SIGNALS_VehStc_numMisfDetnHiEctA_19_s" 382 "SIGNALS_VehStc_numMisfDetnHiEctA_1_s" 383 "SIGNALS_VehStc_numMisfDetnHiEctA_20_s" 384 "SIGNALS_VehStc_numMisfDetnHiEctA_2_s" 385 "SIGNALS_VehStc_numMisfDetnHiEctA_3_s" 386 "SIGNALS_VehStc_numMisfDetnHiEctA_4_s" 387 "SIGNALS_VehStc_numMisfDetnHiEctA_5_s" 388 "SIGNALS_VehStc_numMisfDetnHiEctA_6_s" 389 "SIGNALS_VehStc_numMisfDetnHiEctA_7_s" 390 "SIGNALS_VehStc_numMisfDetnHiEctA_8_s" 391 "SIGNALS_VehStc_numMisfDetnHiEctA_9_s" 392 "SIGNALS_VehStc_numMisfDetnLoEctA_0_s" 393 "SIGNALS_VehStc_numMisfDetnLoEctA_10_s" 394 "SIGNALS_VehStc_numMisfDetnLoEctA_11_s" 395 "SIGNALS_VehStc_numMisfDetnLoEctA_12_s" 396 "SIGNALS_VehStc_numMisfDetnLoEctA_13_s" 397 "SIGNALS_VehStc_numMisfDetnLoEctA_14_s" 398 "SIGNALS_VehStc_numMisfDetnLoEctA_15_s" 399 "SIGNALS_VehStc_numMisfDetnLoEctA_16_s" 400 "SIGNALS_VehStc_numMisfDetnLoEctA_17_s" 401 "SIGNALS_VehStc_numMisfDetnLoEctA_18_s" 402 "SIGNALS_VehStc_numMisfDetnLoEctA_19_s" 403 "SIGNALS_VehStc_numMisfDetnLoEctA_1_s" 404 "SIGNALS_VehStc_numMisfDetnLoEctA_20_s" 405 "SIGNALS_VehStc_numMisfDetnLoEctA_2_s" 406 "SIGNALS_VehStc_numMisfDetnLoEctA_3_s" 407 "SIGNALS_VehStc_numMisfDetnLoEctA_4_s" 408 "SIGNALS_VehStc_numMisfDetnLoEctA_5_s" 409 "SIGNALS_VehStc_numMisfDetnLoEctA_6_s" 410 "SIGNALS_VehStc_numMisfDetnLoEctA_7_s" 411 "SIGNALS_VehStc_numMisfDetnLoEctA_8_s" 412 "SIGNALS_VehStc_numMisfDetnLoEctA_9_s" 413 "SIGNALS_VehStc_numMisfDetnNormA_0_s" 414 "SIGNALS_VehStc_numMisfDetnNormA_10_s" 415 "SIGNALS_VehStc_numMisfDetnNormA_11_s" 416 "SIGNALS_VehStc_numMisfDetnNormA_12_s" 417 "SIGNALS_VehStc_numMisfDetnNormA_13_s" 418 "SIGNALS_VehStc_numMisfDetnNormA_14_s" 419 "SIGNALS_VehStc_numMisfDetnNormA_15_s" 420 "SIGNALS_VehStc_numMisfDetnNormA_16_s" 421 "SIGNALS_VehStc_numMisfDetnNormA_17_s" 422 "SIGNALS_VehStc_numMisfDetnNormA_18_s" 423 "SIGNALS_VehStc_numMisfDetnNormA_19_s" 424 "SIGNALS_VehStc_numMisfDetnNormA_1_s" 425 "SIGNALS_VehStc_numMisfDetnNormA_20_s" 426 "SIGNALS_VehStc_numMisfDetnNormA_2_s" 427 "SIGNALS_VehStc_numMisfDetnNormA_3_s" 428 "SIGNALS_VehStc_numMisfDetnNormA_4_s" 429 "SIGNALS_VehStc_numMisfDetnNormA_5_s" 430 "SIGNALS_VehStc_numMisfDetnNormA_6_s" 431 "SIGNALS_VehStc_numMisfDetnNormA_7_s" 432 "SIGNALS_VehStc_numMisfDetnNormA_8_s" 433 "SIGNALS_VehStc_numMisfDetnNormA_9_s" 434 "SIGNALS_VehStc_rDiagRsltB1A_0_s" 435 "SIGNALS_VehStc_rDiagRsltB1A_1_s" 436 "SIGNALS_VehStc_rDiagRsltB1A_2_s" 437 "SIGNALS_VehStc_rDiagRsltB1A_3_s" 438 "SIGNALS_VehStc_rDiagRsltB1A_4_s" 439 "SIGNALS_VehStc_tiRtCityEco_signal" 440 "SIGNALS_VehStc_tiRtCity_signal" 441 "SIGNALS_VehStc_tiRtHighWayEco_signal" 442 "SIGNALS_VehStc_tiRtHighWay_signal" 443 "SIGNALS_VehStc_tiRtStop_signal" 444 "SIGNALS_VehStc_volCnsCityDcyc_signal" 445 "SIGNALS_VehStc_volCnsCityEcoDcyc_signal" 446 "SIGNALS_VehStc_volCnsHighWayDcyc_signal" 447 "SIGNALS_VehStc_volCnsHighWayEcoDcyc_signal" 448 "SIGNALS_VehStc_volCnsStopDcyc_signal" 449 "SIGNALS_VehV_a" 450 "SIGNALS_VehV_v" 451 "SIGNALS_VehV_vSens_signal" 452 "SIGNALS_fra_w_msg_signal" 453 "SIGNALS_fra_w_s" 454 "SIGNALS_ftead_w_msg_s" 455 "SIGNALS_ftead_w_si" 456 "SIGNALS_ftead_w_signal" 457 "SIGNALS_i14229_agIntkB1GEVlv_2Byte_signal" 458 "SIGNALS_i14229_agIntkB1GEVlv_signal" 459 "SIGNALS_i14229_agSpIntkB1GevCtl_2Byte_signal" 460 "SIGNALS_i14229_agSpIntkB1GevCtl_signal" 461 "SIGNALS_lutskzyl_w_0_signal" 462 "SIGNALS_lutskzyl_w_1_signal" 463 "SIGNALS_lutskzyl_w_2_signal" 464 "SIGNALS_lutskzyl_w_3_signal" 465 "SIGNALS_lutskzyl_w_msg_0_signal" 466 "SIGNALS_mshfmst_w_signal" 467 "SIGNALS_ofmsndkh1_w_msg_signal" 468 "SIGNALS_ofmsndkh2_w_msg_signal" 469 "SIGNALS_prsoll_w_msg_s" 470 "SIGNALS_tateout_w_signal" 471 "SIGNALS_tatesoll_w_msg_signal" 472 "SIGNALS_thdev_msg_signal" 473 "SIGNALS_tmst_signal" 474 "SIGNALS_wkratst_signal" 475 "SIGNALS_PID83h_A_BitCombineSignal" 476 "SIGNALS_PID9Bh_A_BitCombineSignal" 477 "SIGNALS_PIDA1h_A_BitCombineSignal" 478 "SIGNALS_PIDA7h_A_BitCombineSignal" 479 "SIGNALS_PIDA8h_A_BitCombineSignal" 480 "SIGNALS_Virtual_DcmDspUDS_2600Byte06_signal" 481 "SIGNALS_Virtual_DcmDspUDS_2610Byte00_signal" 482 "SIGNALS_Virtual_DcmDspUDS_2610Byte01_signal" 483 "SIGNALS_Virtual_DcmDspUDS_2610Byte02_signal" 484 "SIGNALS_Virtual_DcmDspUDS_2610Byte03_signal" 485 "SIGNALS_Virtual_DcmDspUDS_2610Byte04_signal" 486 "SIGNALS_Virtual_DcmDspUDS_2610Byte05_signal" 487 "SIGNALS_Virtual_DcmDspUDS_2610Byte0D_signal" 488 "SIGNALS_Virtual_DcmDspUDS_2610Byte0F_signal" 489 "SIGNALS_Virtual_DcmDspUDS_2610Byte10_signal" 490 "SIGNALS_Virtual_DcmDspUDS_2610Byte1A_signal" 491 "SIGNALS_Virtual_DcmDspUDS_2610Byte1B_signal" 492 "SIGNALS_Virtual_DcmDspUDS_2610Byte1C_signal" 493 "SIGNALS_Virtual_DcmDspUDS_2610Byte1D_signal" 494 "SIGNALS_Virtual_DcmDspUDS_2610Byte1F_signal" 495 "SIGNALS_Virtual_DcmDspUDS_2610Byte20_signal" 496 "SIGNALS_Virtual_DcmDspUDS_2610Byte21_signal" 497 "SIGNALS_Virtual_DcmDspUDS_2610Byte22to23_signal" 498 "SIGNALS_Virtual_DcmDspUDS_2610Byte29_signal" 499 "SIGNALS_Virtual_DcmDspUDS_2610Byte2A_signal" 500 "SIGNALS_Virtual_DcmDspUDS_2611Byte00_signal" 501 "SIGNALS_Virtual_DcmDspUDS_2611Byte01_signal" 502 "SIGNALS_Virtual_DcmDspUDS_2611Byte02_signal" 503 "SIGNALS_Virtual_DcmDspUDS_2611Byte03_signal" 504 "SIGNALS_Virtual_DcmDspUDS_2611Byte04_signal" 505 "SIGNALS_Virtual_DcmDspUDS_2611Byte05_signal" 506 "SIGNALS_Virtual_DcmDspUDS_2611Byte06_07_signal" 507 "SIGNALS_Virtual_DcmDspUDS_2611Byte08to09_signal" 508 "SIGNALS_Virtual_DcmDspUDS_2611Byte0A_signal" 509 "SIGNALS_Virtual_DcmDspUDS_2611Byte0B_signal" 510 "SIGNALS_Virtual_DcmDspUDS_2611Byte0Cto0D_signal" 511 "SIGNALS_Virtual_DcmDspUDS_2611Byte0E_signal" 512 "SIGNALS_Virtual_DcmDspUDS_2611Byte2A_signal" 513 "SIGNALS_Virtual_DcmDspUDS_2611Byte2B_signal" 514 "SIGNALS_Virtual_DcmDspUDS_2611Byte30_signal" 515 "SIGNALS_Virtual_DcmDspUDS_2611Byte31_signal" 516 "SIGNALS_Virtual_DcmDspUDS_2611Byte32_signal" 517 "SIGNALS_Virtual_DcmDspUDS_2611Byte33_signal" 518 "SIGNALS_Virtual_DcmDspUDS_2612Byte00_signal" 519 "SIGNALS_Virtual_DcmDspUDS_2612Byte01_signal" 520 "SIGNALS_Virtual_DcmDspUDS_2612Byte02_signal" 521 "SIGNALS_Virtual_DcmDspUDS_2612Byte03_signal" 522 "SIGNALS_Virtual_DcmDspUDS_2612Byte04_signal" 523 "SIGNALS_Virtual_DcmDspUDS_2612Byte05_signal" 524 "SIGNALS_Virtual_DcmDspUDS_2612Byte0B_0C_signal" 525 "SIGNALS_Virtual_DcmDspUDS_2612Byte14_signal" 526 "SIGNALS_Virtual_DcmDspUDS_2612Byte15_signal" 527 "SIGNALS_Virtual_DcmDspUDS_2612Byte16_signal" 528 "SIGNALS_Virtual_DcmDspUDS_2612Byte17_signal" 529 "SIGNALS_Virtual_DcmDspUDS_2612Byte1F_signal" 530 "SIGNALS_Virtual_DcmDspUDS_2612Byte20_signal" 531 "SIGNALS_Virtual_DcmDspUDS_2612Byte2A_signal" 532 "SIGNALS_Virtual_DcmDspUDS_2612Byte2B_signal" 533 "SIGNALS_Virtual_DcmDspUDS_2613Byte00_signal" 534 "SIGNALS_Virtual_DcmDspUDS_2613Byte01_signal" 535 "SIGNALS_Virtual_DcmDspUDS_2613Byte02_signal" 536 "SIGNALS_Virtual_DcmDspUDS_2613Byte03_signal" 537 "SIGNALS_Virtual_DcmDspUDS_2613Byte04_signal" 538 "SIGNALS_Virtual_DcmDspUDS_2613Byte05_signal" 539 "SIGNALS_Virtual_DcmDspUDS_2613Byte08_signal" 540 "SIGNALS_Virtual_DcmDspUDS_2613Byte09_signal" 541 "SIGNALS_Virtual_DcmDspUDS_2615Byte00_signal" 542 "SIGNALS_Virtual_DcmDspUDS_2615Byte01_signal" 543 "SIGNALS_Virtual_DcmDspUDS_2615Byte02_signal" 544 "SIGNALS_Virtual_DcmDspUDS_2615Byte03_signal" 545 "SIGNALS_Virtual_DcmDspUDS_2615Byte04_signal" 546 "SIGNALS_Virtual_DcmDspUDS_2615Byte05_signal" 547 "SIGNALS_Virtual_DcmDspUDS_2615Byte10_signal" 548 "SIGNALS_Virtual_DcmDspUDS_2615Byte26_signal" 549 "SIGNALS_Virtual_DcmDspUDS_2615Byte27_signal" 550 "SIGNALS_Virtual_DcmDspUDS_2617Byte00_signal" 551 "SIGNALS_Virtual_DcmDspUDS_2617Byte01_signal" 552 "SIGNALS_Virtual_DcmDspUDS_2617Byte02_signal" 553 "SIGNALS_Virtual_DcmDspUDS_2617Byte03_signal" 554 "SIGNALS_Virtual_DcmDspUDS_2617Byte04_signal" 555 "SIGNALS_Virtual_DcmDspUDS_2617Byte05_signal" 556 "SIGNALS_Virtual_DcmDspUDS_261AByte00_signal" 557 "SIGNALS_Virtual_DcmDspUDS_261AByte01_signal" 558 "SIGNALS_Virtual_DcmDspUDS_261AByte02_signal" 559 "SIGNALS_Virtual_DcmDspUDS_261AByte03_signal" 560 "SIGNALS_Virtual_DcmDspUDS_261AByte04_signal" 561 "SIGNALS_Virtual_DcmDspUDS_261AByte05_signal" 562 "SIGNALS_Virtual_DcmDspUDS_261AByte07_signal" 563 "SIGNALS_Virtual_DcmDspUDS_261AByte0A_signal" 564 "SIGNALS_Virtual_DcmDspUDS_261AByte0B_signal" 565 "SIGNALS_Virtual_DcmDspUDS_261AByte0C_signal" 566 "SIGNALS_Virtual_DcmDspUDS_261AByte0D_signal" 567 "SIGNALS_Virtual_DcmDspUDS_261AByte0E_signal" 568 "SIGNALS_Virtual_DcmDspUDS_2620Byte00_signal" 569 "SIGNALS_Virtual_DcmDspUDS_2620Byte01_signal" 570 "SIGNALS_Virtual_DcmDspUDS_2620Byte02_signal" 571 "SIGNALS_Virtual_DcmDspUDS_2620Byte03_signal" 572 "SIGNALS_Virtual_DcmDspUDS_2620Byte04_signal" 573 "SIGNALS_Virtual_DcmDspUDS_2620Byte05_signal" 574 "SIGNALS_Virtual_DcmDspUDS_2621Byte00_signal" 575 "SIGNALS_Virtual_DcmDspUDS_2621Byte01_signal" 576 "SIGNALS_Virtual_DcmDspUDS_2621Byte02_signal" 577 "SIGNALS_Virtual_DcmDspUDS_2621Byte03_signal" 578 "SIGNALS_Virtual_DcmDspUDS_2621Byte04_signal" 579 "SIGNALS_Virtual_DcmDspUDS_2621Byte05_signal" 580 "SIGNALS_Virtual_DcmDspUDS_2622Byte00_signal" 581 "SIGNALS_Virtual_DcmDspUDS_2622Byte01_signal" 582 "SIGNALS_Virtual_DcmDspUDS_2622Byte02_signal" 583 "SIGNALS_Virtual_DcmDspUDS_2622Byte03_signal" 584 "SIGNALS_Virtual_DcmDspUDS_2622Byte04_signal" 585 "SIGNALS_Virtual_DcmDspUDS_2622Byte05_signal" 586 "SIGNALS_Virtual_DcmDspUDS_2623Byte00_signal" 587 "SIGNALS_Virtual_DcmDspUDS_2623Byte01_signal" 588 "SIGNALS_Virtual_DcmDspUDS_2623Byte02_signal" 589 "SIGNALS_Virtual_DcmDspUDS_2623Byte03_signal" 590 "SIGNALS_Virtual_DcmDspUDS_2623Byte04_signal" 591 "SIGNALS_Virtual_DcmDspUDS_2623Byte05_signal" 592 "SIGNALS_Virtual_DcmDspUDS_2625Byte00_signal" 593 "SIGNALS_Virtual_DcmDspUDS_2625Byte01_signal" 594 "SIGNALS_Virtual_DcmDspUDS_2625Byte02_signal" 595 "SIGNALS_Virtual_DcmDspUDS_2625Byte03_signal" 596 "SIGNALS_Virtual_DcmDspUDS_2625Byte04_signal" 597 "SIGNALS_Virtual_DcmDspUDS_2625Byte05_signal" 598 "SIGNALS_Virtual_DcmDspUDS_2627Byte00_signal" 599 "SIGNALS_Virtual_DcmDspUDS_2627Byte01_signal" 600 "SIGNALS_Virtual_DcmDspUDS_2627Byte02_signal" 601 "SIGNALS_Virtual_DcmDspUDS_2627Byte03_signal" 602 "SIGNALS_Virtual_DcmDspUDS_2627Byte04_signal" 603 "SIGNALS_Virtual_DcmDspUDS_2627Byte05_signal" 604 "SIGNALS_Virtual_DcmDspUDS_262AByte00_signal" 605 "SIGNALS_Virtual_DcmDspUDS_262AByte01_signal" 606 "SIGNALS_Virtual_DcmDspUDS_262AByte02_signal" 607 "SIGNALS_Virtual_DcmDspUDS_262AByte03_signal" 608 "SIGNALS_Virtual_DcmDspUDS_262AByte04_signal" 609 "SIGNALS_Virtual_DcmDspUDS_262AByte05_signal" 610 "SIGNALS_Virtual_DcmDspUDS_2660Byte0_signal" 611 "SIGNALS_Virtual_DcmDspUDS_2660Byte11to12_signal" 612 "SIGNALS_Virtual_DcmDspUDS_2660Byte13to14_signal" 613 "SIGNALS_Virtual_DcmDspUDS_2660Byte15_signal" 614 "SIGNALS_Virtual_DcmDspUDS_2660Byte16_signal" 615 "SIGNALS_Virtual_DcmDspUDS_2660Byte17_signal" 616 "SIGNALS_Virtual_DcmDspUDS_2660Byte18_signal" 617 "SIGNALS_Virtual_DcmDspUDS_2660Byte19_signal" 618 "SIGNALS_Virtual_DcmDspUDS_2660Byte1A_signal" 619 "SIGNALS_Virtual_DcmDspUDS_2660Byte1B_signal" 620 "SIGNALS_Virtual_DcmDspUDS_2660Byte1C_signal" 621 "SIGNALS_Virtual_DcmDspUDS_2660Byte1D_signal" 622 "SIGNALS_Virtual_DcmDspUDS_2660Byte1E_signal" 623 "SIGNALS_Virtual_DcmDspUDS_2660Byte1_signal" 624 "SIGNALS_Virtual_DcmDspUDS_2660Byte26to27_signal" 625 "SIGNALS_Virtual_DcmDspUDS_2660Byte2A_signal" 626 "SIGNALS_Virtual_DcmDspUDS_2660Byte2Eto2F_signal" 627 "SIGNALS_Virtual_DcmDspUDS_2660Byte2_signal" 628 "SIGNALS_Virtual_DcmDspUDS_2660Byte3_signal" 629 "SIGNALS_Virtual_DcmDspUDS_2660Byte4_signal" 630 "SIGNALS_Virtual_DcmDspUDS_2660Byte5_signal" 631 "SIGNALS_Virtual_DcmDspUDS_2660Byte6_signal" 632 "SIGNALS_Virtual_DcmDspUDS_2661Byte0A_signal" 633 "SIGNALS_Virtual_DcmDspUDS_2661Byte0B_signal" 634 "SIGNALS_Virtual_DcmDspUDS_2661Byte0C_signal" 635 "SIGNALS_Virtual_DcmDspUDS_2661Byte0D_signal" 636 "SIGNALS_Virtual_DcmDspUDS_2661Byte0E_signal" 637 "SIGNALS_Virtual_DcmDspUDS_2661Byte0F_signal" 638 "SIGNALS_Virtual_DcmDspUDS_2661Byte0_signal" 639 "SIGNALS_Virtual_DcmDspUDS_2661Byte1_signal" 640 "SIGNALS_Virtual_DcmDspUDS_2661Byte2D_signal" 641 "SIGNALS_Virtual_DcmDspUDS_2661Byte2E_signal" 642 "SIGNALS_Virtual_DcmDspUDS_2661Byte2F_signal" 643 "SIGNALS_Virtual_DcmDspUDS_2661Byte2_signal" 644 "SIGNALS_Virtual_DcmDspUDS_2661Byte30_signal" 645 "SIGNALS_Virtual_DcmDspUDS_2661Byte31_signal" 646 "SIGNALS_Virtual_DcmDspUDS_2661Byte32_signal" 647 "SIGNALS_Virtual_DcmDspUDS_2661Byte3_signal" 648 "SIGNALS_Virtual_DcmDspUDS_2661Byte4_signal" 649 "SIGNALS_Virtual_DcmDspUDS_2661Byte5_signal" 650 "SIGNALS_Virtual_DcmDspUDS_2661Byte6_signal" 651 "SIGNALS_Virtual_DcmDspUDS_2661Byte7_signal" 652 "SIGNALS_Virtual_DcmDspUDS_2661Byte8_signal" 653 "SIGNALS_Virtual_DcmDspUDS_2661Byte9_signal" 654 "SIGNALS_Virtual_DcmDspUDS_2662Byte0Cto0D_signal" 655 "SIGNALS_Virtual_DcmDspUDS_2662Byte0_signal" 656 "SIGNALS_Virtual_DcmDspUDS_2662Byte18_signal" 657 "SIGNALS_Virtual_DcmDspUDS_2662Byte19_signal" 658 "SIGNALS_Virtual_DcmDspUDS_2662Byte1_signal" 659 "SIGNALS_Virtual_DcmDspUDS_2662Byte2_signal" 660 "SIGNALS_Virtual_DcmDspUDS_2662Byte3_signal" 661 "SIGNALS_Virtual_DcmDspUDS_2662Byte4_signal" 662 "SIGNALS_Virtual_DcmDspUDS_2662Byte5_signal" 663 "SIGNALS_Virtual_DcmDspUDS_2663Byte0_signal" 664 "SIGNALS_Virtual_DcmDspUDS_2663Byte14Byte15_signal" 665 "SIGNALS_Virtual_DcmDspUDS_2663Byte16Byte17_signal" 666 "SIGNALS_Virtual_DcmDspUDS_2663Byte18Byte19_signal" 667 "SIGNALS_Virtual_DcmDspUDS_2663Byte1AByte1B_signal" 668 "SIGNALS_Virtual_DcmDspUDS_2663Byte1_signal" 669 "SIGNALS_Virtual_DcmDspUDS_2663Byte2_signal" 670 "SIGNALS_Virtual_DcmDspUDS_2663Byte3_signal" 671 "SIGNALS_Virtual_DcmDspUDS_2663Byte4_signal" 672 "SIGNALS_Virtual_DcmDspUDS_2663Byte5_signal" 673 "SIGNALS_Virtual_DcmDspUDS_2664Byte0_signal" 674 "SIGNALS_Virtual_DcmDspUDS_2664Byte1_signal" 675 "SIGNALS_Virtual_DcmDspUDS_2664Byte25_signal" 676 "SIGNALS_Virtual_DcmDspUDS_2664Byte26_signal" 677 "SIGNALS_Virtual_DcmDspUDS_2664Byte2_signal" 678 "SIGNALS_Virtual_DcmDspUDS_2664Byte3_signal" 679 "SIGNALS_Virtual_DcmDspUDS_2664Byte4_signal" 680 "SIGNALS_Virtual_DcmDspUDS_2664Byte5_signal" 681 "SIGNALS_Virtual_DcmDspUDS_2664Byte6_signal" 682 "SIGNALS_Virtual_DcmDspUDS_2664Byte7_signal" 683 "SIGNALS_Virtual_DcmDspUDS_2665Byte0_signal" 684 "SIGNALS_Virtual_DcmDspUDS_2665Byte1_signal" 685 "SIGNALS_Virtual_DcmDspUDS_2665Byte2_signal" 686 "SIGNALS_Virtual_DcmDspUDS_2665Byte3_signal" 687 "SIGNALS_Virtual_DcmDspUDS_2665Byte4_signal" 688 "SIGNALS_Virtual_DcmDspUDS_2665Byte5_signal" 689 "SIGNALS_Virtual_DcmDspUDS_2666Byte0_signal" 690 "SIGNALS_Virtual_DcmDspUDS_2666Byte1_signal" 691 "SIGNALS_Virtual_DcmDspUDS_2666Byte2_signal" 692 "SIGNALS_Virtual_DcmDspUDS_2666Byte3_signal" 693 "SIGNALS_Virtual_DcmDspUDS_2666Byte4_signal" 694 "SIGNALS_Virtual_DcmDspUDS_2666Byte5_signal" 695 "SIGNALS_Virtual_DcmDspUDS_2668Byte0_signal" 696 "SIGNALS_Virtual_DcmDspUDS_2668Byte1_signal" 697 "SIGNALS_Virtual_DcmDspUDS_2668Byte2_signal" 698 "SIGNALS_Virtual_DcmDspUDS_2668Byte3_signal" 699 "SIGNALS_Virtual_DcmDspUDS_2668Byte4_signal" 700 "SIGNALS_Virtual_DcmDspUDS_2668Byte5_signal" 701 "SIGNALS_Virtual_DcmDspUDS_266CByte0_signal" 702 "SIGNALS_Virtual_DcmDspUDS_266CByte1_signal" 703 "SIGNALS_Virtual_DcmDspUDS_266CByte26_signal" 704 "SIGNALS_Virtual_DcmDspUDS_266CByte27_signal" 705 "SIGNALS_Virtual_DcmDspUDS_266CByte2_signal" 706 "SIGNALS_Virtual_DcmDspUDS_266CByte3_signal" 707 "SIGNALS_Virtual_DcmDspUDS_266CByte4_signal" 708 "SIGNALS_Virtual_DcmDspUDS_266CByte5_signal" 709 "SIGNALS_Virtual_DcmDspUDS_266CByte6_signal" 710 "SIGNALS_Virtual_DcmDspUDS_266CByte7_signal" 711 "SIGNALS_Virtual_DcmDspUDS_266CByte8_signal" 712 "SIGNALS_Virtual_DcmDspUDS_266CByte9_signal" 713 "SIGNALS_Virtual_DcmDspUDS_266DByte0_signal" 714 "SIGNALS_Virtual_DcmDspUDS_266DByte1_signal" 715 "SIGNALS_Virtual_DcmDspUDS_266DByte2_signal" 716 "SIGNALS_Virtual_DcmDspUDS_266DByte3_signal" 717 "SIGNALS_Virtual_DcmDspUDS_266DByte4_signal" 718 "SIGNALS_Virtual_DcmDspUDS_266DByte5_signal" 719 "SIGNALS_Virtual_DcmDspUDS_266FByte0_signal" 720 "SIGNALS_Virtual_DcmDspUDS_266FByte1_signal" 721 "SIGNALS_Virtual_DcmDspUDS_266FByte2_signal" 722 "SIGNALS_Virtual_DcmDspUDS_266FByte3_signal" 723 "SIGNALS_Virtual_DcmDspUDS_2673Byte0A_signal" 724 "SIGNALS_Virtual_DcmDspUDS_2673Byte0B_signal" 725 "SIGNALS_Virtual_DcmDspUDS_2673Byte0_signal" 726 "SIGNALS_Virtual_DcmDspUDS_2673Byte12_signal" 727 "SIGNALS_Virtual_DcmDspUDS_2673Byte13_signal" 728 "SIGNALS_Virtual_DcmDspUDS_2673Byte16_signal" 729 "SIGNALS_Virtual_DcmDspUDS_2673Byte17_signal" 730 "SIGNALS_Virtual_DcmDspUDS_2673Byte1E_signal" 731 "SIGNALS_Virtual_DcmDspUDS_2673Byte1F_signal" 732 "SIGNALS_Virtual_DcmDspUDS_2673Byte1_signal" 733 "SIGNALS_Virtual_DcmDspUDS_2673Byte2_signal" 734 "SIGNALS_Virtual_DcmDspUDS_2673Byte3_signal" 735 "SIGNALS_Virtual_DcmDspUDS_2673Byte4_signal" 736 "SIGNALS_Virtual_DcmDspUDS_2673Byte5_signal" 737 "SIGNALS_Virtual_DcmDspUDS_2673Byte6_signal" 738 "SIGNALS_Virtual_DcmDspUDS_2673Byte7_signal" 739 "SIGNALS_Virtual_DcmDspUDS_2676Byte0_signal" 740 "SIGNALS_Virtual_DcmDspUDS_2676Byte1_signal" 741 "SIGNALS_Virtual_DcmDspUDS_2676Byte2E_signal" 742 "SIGNALS_Virtual_DcmDspUDS_2676Byte2F_signal" 743 "SIGNALS_Virtual_DcmDspUDS_2676Byte2_signal" 744 "SIGNALS_Virtual_DcmDspUDS_2676Byte3_signal" 745 "SIGNALS_Virtual_DcmDspUDS_2676Byte4_signal" 746 "SIGNALS_Virtual_DcmDspUDS_2676Byte5_signal" 747 "SIGNALS_Virtual_DcmDspUDS_2676Byte6_signal" 748 "SIGNALS_Virtual_DcmDspUDS_2676Byte7_signal" 749 "SIGNALS_Virtual_DcmDspUDS_267BByte0_signal" 750 "SIGNALS_Virtual_DcmDspUDS_267BByte1_signal" 751 "SIGNALS_Virtual_DcmDspUDS_267BByte2_signal" 752 "SIGNALS_Virtual_DcmDspUDS_267BByte3_signal" 753 "SIGNALS_Virtual_DcmDspUDS_267BByte4_signal" 754 "SIGNALS_Virtual_DcmDspUDS_267BByte5_signal" 755 "SIGNALS_Virtual_DcmDspUDS_267EByte0_signal" 756 "SIGNALS_Virtual_DcmDspUDS_267EByte1_signal" 757 "SIGNALS_Virtual_DcmDspUDS_267EByte22_signal" 758 "SIGNALS_Virtual_DcmDspUDS_267EByte2_signal" 759 "SIGNALS_Virtual_DcmDspUDS_2680Byte00_signal" 760 "SIGNALS_Virtual_DcmDspUDS_2680Byte01_signal" 761 "SIGNALS_Virtual_DcmDspUDS_2680Byte02_signal" 762 "SIGNALS_Virtual_DcmDspUDS_2680Byte03_signal" 763 "SIGNALS_Virtual_DcmDspUDS_2680Byte04_signal" 764 "SIGNALS_Virtual_DcmDspUDS_2680Byte05_signal" 765 "SIGNALS_Virtual_DcmDspUDS_2680Byte08_signal" 766 "SIGNALS_Virtual_DcmDspUDS_2680Byte09_signal" 767 "SIGNALS_Virtual_DcmDspUDS_2680Byte0E_signal" 768 "SIGNALS_Virtual_DcmDspUDS_2680Byte0F_signal" 769 "SIGNALS_Virtual_DcmDspUDS_2681Byte00_signal" 770 "SIGNALS_Virtual_DcmDspUDS_2681Byte01_signal" 771 "SIGNALS_Virtual_DcmDspUDS_2681Byte02_signal" 772 "SIGNALS_Virtual_DcmDspUDS_2681Byte03_signal" 773 "SIGNALS_Virtual_DcmDspUDS_2681Byte04_signal" 774 "SIGNALS_Virtual_DcmDspUDS_2681Byte05_signal" 775 "SIGNALS_Virtual_DcmDspUDS_2681Byte0F_signal" 776 "SIGNALS_Virtual_DcmDspUDS_2681Byte10_signal" 777 "SIGNALS_Virtual_DcmDspUDS_2681Byte13_signal" 778 "SIGNALS_Virtual_DcmDspUDS_2681Byte14_signal" 779 "SIGNALS_Virtual_DcmDspUDS_2681Byte1D_signal" 780 "SIGNALS_Virtual_DcmDspUDS_2681Byte1E_signal" 781 "SIGNALS_Virtual_DcmDspUDS_2682Byte00_signal" 782 "SIGNALS_Virtual_DcmDspUDS_2682Byte01_signal" 783 "SIGNALS_Virtual_DcmDspUDS_2682Byte02_signal" 784 "SIGNALS_Virtual_DcmDspUDS_2682Byte03_signal" 785 "SIGNALS_Virtual_DcmDspUDS_2682Byte04_signal" 786 "SIGNALS_Virtual_DcmDspUDS_2682Byte05_signal" 787 "SIGNALS_Virtual_DcmDspUDS_2682Byte06_07_signal" 788 "SIGNALS_Virtual_DcmDspUDS_2682Byte08_09_signal" 789 "SIGNALS_Virtual_DcmDspUDS_2682Byte0E_signal" 790 "SIGNALS_Virtual_DcmDspUDS_2682Byte11_12_signal" 791 "SIGNALS_Virtual_DcmDspUDS_2682Byte13_14_signal" 792 "SIGNALS_Virtual_DcmDspUDS_2682Byte15_16_signal" 793 "SIGNALS_Virtual_DcmDspUDS_2682Byte18_19_signal" 794 "SIGNALS_Virtual_DcmDspUDS_2682Byte1B_signal" 795 "SIGNALS_Virtual_DcmDspUDS_2682Byte1C_signal" 796 "SIGNALS_Virtual_DcmDspUDS_2683Byte00_signal" 797 "SIGNALS_Virtual_DcmDspUDS_2683Byte01_signal" 798 "SIGNALS_Virtual_DcmDspUDS_2683Byte02_signal" 799 "SIGNALS_Virtual_DcmDspUDS_2683Byte03_signal" 800 "SIGNALS_Virtual_DcmDspUDS_2683Byte04_signal" 801 "SIGNALS_Virtual_DcmDspUDS_2683Byte05_signal" 802 "SIGNALS_Virtual_DcmDspUDS_2684Byte00_signal" 803 "SIGNALS_Virtual_DcmDspUDS_2684Byte01_signal" 804 "SIGNALS_Virtual_DcmDspUDS_2684Byte02_signal" 805 "SIGNALS_Virtual_DcmDspUDS_2684Byte03_signal" 806 "SIGNALS_Virtual_DcmDspUDS_2684Byte04_signal" 807 "SIGNALS_Virtual_DcmDspUDS_2684Byte05_signal" 808 "SIGNALS_Virtual_DcmDspUDS_2688Byte00_signal" 809 "SIGNALS_Virtual_DcmDspUDS_2688Byte01_signal" 810 "SIGNALS_Virtual_DcmDspUDS_2688Byte02_signal" 811 "SIGNALS_Virtual_DcmDspUDS_2688Byte03_signal" 812 "SIGNALS_Virtual_DcmDspUDS_2688Byte04_signal" 813 "SIGNALS_Virtual_DcmDspUDS_2688Byte05_signal" 814 "SIGNALS_Virtual_DcmDspUDS_2689Byte00_signal" 815 "SIGNALS_Virtual_DcmDspUDS_2689Byte01_signal" 816 "SIGNALS_Virtual_DcmDspUDS_2689Byte02_signal" 817 "SIGNALS_Virtual_DcmDspUDS_2689Byte03_signal" 818 "SIGNALS_Virtual_DcmDspUDS_2689Byte04_signal" 819 "SIGNALS_Virtual_DcmDspUDS_2689Byte05_signal" 820 "SIGNALS_Virtual_DcmDspUDS_2689Byte06to09_signal" 821 "SIGNALS_Virtual_DcmDspUDS_2689Byte0Eto11_signal" 822 "SIGNALS_Virtual_DcmDspUDS_2689Byte12to15_signal" 823 "SIGNALS_Virtual_DcmDspUDS_2689Byte16to19_signal" 824 "SIGNALS_Virtual_DcmDspUDS_2689Byte1Ato1D_signal" 825 "SIGNALS_Virtual_DcmDspUDS_2689Byte1Eto21_signal" 826 "SIGNALS_Virtual_DcmDspUDS_2689Byte22to25_signal" 827 "SIGNALS_Virtual_DcmDspUDS_2689Byte26to29_signal" 828 "SIGNALS_Virtual_DcmDspUDS_2689Byte2Ato2D_signal" 829 "SIGNALS_Virtual_DcmDspUDS_2689Byte2Eto31_signal" 830 "SIGNALS_Virtual_DcmDspUDS_268BByte00_signal" 831 "SIGNALS_Virtual_DcmDspUDS_268BByte01_signal" 832 "SIGNALS_Virtual_DcmDspUDS_268BByte02_signal" 833 "SIGNALS_Virtual_DcmDspUDS_268BByte03_signal" 834 "SIGNALS_Virtual_DcmDspUDS_268BByte04_signal" 835 "SIGNALS_Virtual_DcmDspUDS_268BByte05_signal" 836 "SIGNALS_Virtual_DcmDspUDS_268BByte06_signal" 837 "SIGNALS_Virtual_DcmDspUDS_268BByte07_signal" 838 "SIGNALS_Virtual_DcmDspUDS_268BByte08_signal" 839 "SIGNALS_Virtual_DcmDspUDS_268BByte09_signal" 840 "SIGNALS_Virtual_DcmDspUDS_268BByte0A_signal" 841 "SIGNALS_Virtual_DcmDspUDS_268BByte0B_signal" 842 "SIGNALS_Virtual_DcmDspUDS_268BByte0C_signal" 843 "SIGNALS_Virtual_DcmDspUDS_268BByte0D_signal" 844 "SIGNALS_Virtual_DcmDspUDS_268CByte00_signal" 845 "SIGNALS_Virtual_DcmDspUDS_268CByte01_signal" 846 "SIGNALS_Virtual_DcmDspUDS_268CByte02_signal" 847 "SIGNALS_Virtual_DcmDspUDS_268CByte03_signal" 848 "SIGNALS_Virtual_DcmDspUDS_268CByte04_signal" 849 "SIGNALS_Virtual_DcmDspUDS_268CByte05_signal" 850 "SIGNALS_Virtual_DcmDspUDS_268CByte06_signal" 851 "SIGNALS_Virtual_DcmDspUDS_268CByte07_signal" 852 "SIGNALS_Virtual_DcmDspUDS_268CByte08_signal" 853 "SIGNALS_Virtual_DcmDspUDS_268CByte09_signal" 854 "SIGNALS_Virtual_DcmDspUDS_268CByte0A_signal" 855 "SIGNALS_Virtual_DcmDspUDS_268CByte2E_signal" 856 "SIGNALS_Virtual_DcmDspUDS_268CByte2F_signal" 857 "SIGNALS_Virtual_DcmDspUDS_268CByte30_signal" 858 "SIGNALS_Virtual_DcmDspUDS_268CByte31_signal" 859 "SIGNALS_Virtual_DcmDspUDS_268CByte32_signal" 860 "SIGNALS_Virtual_DcmDspUDS_268CByte33_signal" 861 "SIGNALS_Virtual_DcmDspUDS_268EByte00_signal" 862 "SIGNALS_Virtual_DcmDspUDS_268EByte01_signal" 863 "SIGNALS_Virtual_DcmDspUDS_268EByte02_signal" 864 "SIGNALS_Virtual_DcmDspUDS_268EByte03_signal" 865 "SIGNALS_Virtual_DcmDspUDS_268EByte04_signal" 866 "SIGNALS_Virtual_DcmDspUDS_268EByte05_signal" 867 "SIGNALS_Virtual_DcmDspUDS_268EByte08to09_signal" 868 "SIGNALS_Virtual_DcmDspUDS_268EByte0A_signal" 869 "SIGNALS_Virtual_DcmDspUDS_268EByte0B_signal" 870 "SIGNALS_Virtual_DcmDspUDS_268FByte00_signal" 871 "SIGNALS_Virtual_DcmDspUDS_268FByte01_signal" 872 "SIGNALS_Virtual_DcmDspUDS_268FByte02_signal" 873 "SIGNALS_Virtual_DcmDspUDS_268FByte03_signal" 874 "SIGNALS_Virtual_DcmDspUDS_268FByte04_signal" 875 "SIGNALS_Virtual_DcmDspUDS_268FByte05_signal" 876 "SIGNALS_Virtual_DcmDspUDS_268FByte0A_signal" 877 "SIGNALS_Virtual_DcmDspUDS_268FByte0B_signal" 878 "SIGNALS_Virtual_DcmDspUDS_268FByte16_17_signal" 879 "SIGNALS_Virtual_DcmDspUDS_268FByte18_19_signal" 880 "SIGNALS_Virtual_DcmDspUDS_268FByte1A_1B_signal" 881 "SIGNALS_Virtual_DcmDspUDS_2699Byte00_signal" 882 "SIGNALS_Virtual_DcmDspUDS_2699Byte01_signal" 883 "SIGNALS_Virtual_DcmDspUDS_2699Byte02_signal" 884 "SIGNALS_Virtual_DcmDspUDS_2699Byte03_signal" 885 "SIGNALS_Virtual_DcmDspUDS_2699Byte04_signal" 886 "SIGNALS_Virtual_DcmDspUDS_2699Byte05_signal" 887 "SIGNALS_Virtual_DcmDspUDS_2699Byte06_signal" 888 "SIGNALS_Virtual_DcmDspUDS_2699Byte07_signal" 889 "SIGNALS_Virtual_DcmDspUDS_2699Byte0B_0C_signal" 890 "SIGNALS_Virtual_DcmDspUDS_2699Byte16_signal" 891 "SIGNALS_Virtual_DcmDspUDS_2699Byte17_signal" 892 "SIGNALS_Virtual_DcmDspUDS_2699Byte26_27_signal" 893 "SIGNALS_Virtual_DcmDspUDS_2699Byte28_29_signal" 894 "SIGNALS_Virtual_DcmDspUDS_2699Byte2A_2B_signal" 895 "SIGNALS_Virtual_DcmDspUDS_2699Byte2E_signal" 896 "SIGNALS_Virtual_DcmDspUDS_2699Byte2F_30_signal" 897 "SIGNALS_Virtual_DcmDspUDS_269AByte00_signal" 898 "SIGNALS_Virtual_DcmDspUDS_269AByte01_signal" 899 "SIGNALS_Virtual_DcmDspUDS_269AByte02_signal" 900 "SIGNALS_Virtual_DcmDspUDS_269AByte03_signal" 901 "SIGNALS_Virtual_DcmDspUDS_269AByte04_signal" 902 "SIGNALS_Virtual_DcmDspUDS_269AByte05_signal" 903 "SIGNALS_Virtual_DcmDspUDS_269BByte00_signal" 904 "SIGNALS_Virtual_DcmDspUDS_269BByte01_signal" 905 "SIGNALS_Virtual_DcmDspUDS_269BByte02_signal" 906 "SIGNALS_Virtual_DcmDspUDS_269BByte03_signal" 907 "SIGNALS_Virtual_DcmDspUDS_269BByte04_signal" 908 "SIGNALS_Virtual_DcmDspUDS_269BByte05_signal" 909 "SIGNALS_Virtual_DcmDspUDS_269EByte00_signal" 910 "SIGNALS_Virtual_DcmDspUDS_269EByte01_signal" 911 "SIGNALS_Virtual_DcmDspUDS_269EByte02_signal" 912 "SIGNALS_Virtual_DcmDspUDS_269EByte03_signal" 913 "SIGNALS_Virtual_DcmDspUDS_269EByte04_signal" 914 "SIGNALS_Virtual_DcmDspUDS_269EByte05_signal" 915 "SIGNALS_Virtual_DcmDspUDS_26A0Byte00_signal" 916 "SIGNALS_Virtual_DcmDspUDS_26A0Byte01_signal" 917 "SIGNALS_Virtual_DcmDspUDS_26A0Byte02_signal" 918 "SIGNALS_Virtual_DcmDspUDS_26A0Byte03_signal" 919 "SIGNALS_Virtual_DcmDspUDS_26A0Byte04_signal" 920 "SIGNALS_Virtual_DcmDspUDS_26A0Byte05_signal" 921 "SIGNALS_Virtual_DcmDspUDS_26A0Byte06_signal" 922 "SIGNALS_Virtual_DcmDspUDS_26A0Byte07_signal" 923 "SIGNALS_Virtual_DcmDspUDS_26A0Byte08_signal" 924 "SIGNALS_Virtual_DcmDspUDS_26A0Byte09_signal" 925 "SIGNALS_Virtual_DcmDspUDS_26A0Byte0A_signal" 926 "SIGNALS_Virtual_DcmDspUDS_26A0Byte0B_signal" 927 "SIGNALS_Virtual_DcmDspUDS_26A0Byte0C_signal" 928 "SIGNALS_Virtual_DcmDspUDS_26A0Byte0D_signal" 929 "SIGNALS_Virtual_DcmDspUDS_26A0Byte0E_signal" 930 "SIGNALS_Virtual_DcmDspUDS_26A0Byte0F_signal" 931 "SIGNALS_Virtual_DcmDspUDS_26A0Byte10_signal" 932 "SIGNALS_Virtual_DcmDspUDS_26A0Byte11_signal" 933 "SIGNALS_Virtual_DcmDspUDS_26A0Byte12_signal" 934 "SIGNALS_Virtual_DcmDspUDS_26A0Byte13_signal" 935 "SIGNALS_Virtual_DcmDspUDS_26A0Byte14_signal" 936 "SIGNALS_Virtual_DcmDspUDS_26A0Byte15_signal" 937 "SIGNALS_Virtual_DcmDspUDS_26A0Byte16_signal" 938 "SIGNALS_Virtual_DcmDspUDS_26A0Byte17_signal" 939 "SIGNALS_Virtual_DcmDspUDS_26A0Byte18_signal" 940 "SIGNALS_Virtual_DcmDspUDS_26A0Byte19_signal" 941 "SIGNALS_Virtual_DcmDspUDS_26A0Byte1A_signal" 942 "SIGNALS_Virtual_DcmDspUDS_26A0Byte4E_signal" 943 "SIGNALS_Virtual_DcmDspUDS_26A0Byte52_53_signal" 944 "SIGNALS_Virtual_DcmDspUDS_26A0Byte54_55_signal" 945 "SIGNALS_Virtual_DcmDspUDS_26A0Byte56_57_signal" 946 "SIGNALS_Virtual_DcmDspUDS_26A0Byte66_signal" 947 "SIGNALS_Virtual_DcmDspUDS_26A0Byte67_signal" 948 "SIGNALS_Virtual_DcmDspUDS_26A0Byte68_signal" 949 "SIGNALS_Virtual_DcmDspUDS_26A0Byte69_signal" 950 "SIGNALS_Virtual_DcmDspUDS_26A0Byte6A_signal" 951 "SIGNALS_Virtual_DcmDspUDS_26A0Byte6B_signal" 952 "SIGNALS_Virtual_DcmDspUDS_26A0Byte6C_signal" 953 "SIGNALS_Virtual_DcmDspUDS_26A0Byte6D_signal" 954 "SIGNALS_Virtual_DcmDspUDS_26A0Byte7F_80_signal" 955 "SIGNALS_Virtual_DcmDspUDS_26A0Byte81_82_signal" 956 "SIGNALS_Virtual_DcmDspUDS_26A0Byte83_84_signal" 957 "SIGNALS_Virtual_DcmDspUDS_26A0Byte85_86_signal" 958 "SIGNALS_Virtual_DcmDspUDS_26A0Byte87_88_signal" 959 "SIGNALS_Virtual_DcmDspUDS_26A0Byte89_8A_signal" 960 "SIGNALS_Virtual_DcmDspUDS_26A0Byte8B_8C_signal" 961 "SIGNALS_Virtual_DcmDspUDS_26A0Byte8D_8E_signal" 962 "SIGNALS_Virtual_DcmDspUDS_26A0Byte8F_90_signal" 963 "SIGNALS_Virtual_DcmDspUDS_26A0Byte91_92_signal" 964 "SIGNALS_Virtual_DcmDspUDS_26A0Byte93_94_signal" 965 "SIGNALS_Virtual_DcmDspUDS_26A0Byte95_96_signal" 966 "SIGNALS_Virtual_DcmDspUDS_26A0Byte97_98_signal" 967 "SIGNALS_Virtual_DcmDspUDS_26A0Byte99_9A_signal" 968 "SIGNALS_Virtual_DcmDspUDS_26A0Byte9B_9C_signal" 969 "SIGNALS_Virtual_DcmDspUDS_26A0Byte9D_9E_signal" 970 "SIGNALS_Virtual_DcmDspUDS_26A0Byte9F_A0_signal" 971 "SIGNALS_Virtual_DcmDspUDS_26A0ByteA1_A2_signal" 972 "SIGNALS_Virtual_DcmDspUDS_26A0ByteA3_A4_signal" 973 "SIGNALS_Virtual_DcmDspUDS_26A0ByteA5_A6_signal" 974 "SIGNALS_Virtual_DcmDspUDS_26A0ByteA7_A8_signal" 975 "SIGNALS_Virtual_DcmDspUDS_26A0ByteA9_AA_signal" 976 "SIGNALS_Virtual_DcmDspUDS_26A0ByteAB_AC_signal" 977 "SIGNALS_Virtual_DcmDspUDS_26A0ByteAD_AE_signal" 978 "SIGNALS_Virtual_DcmDspUDS_26A0ByteAF_B0_signal" 979 "SIGNALS_Virtual_DcmDspUDS_26A0ByteB1_B2_signal" 980 "SIGNALS_Virtual_DcmDspUDS_26A0ByteB3_B4_signal" 981 "SIGNALS_Virtual_DcmDspUDS_26A0ByteB5_B6_signal" 982 "SIGNALS_Virtual_DcmDspUDS_26A0ByteB7_B8_signal" 983 "SIGNALS_Virtual_DcmDspUDS_26A0ByteB9_BA_signal" 984 "SIGNALS_Virtual_DcmDspUDS_26A0ByteBB_BC_signal" 985 "SIGNALS_Virtual_DcmDspUDS_26A0ByteBD_BE_signal" 986 "SIGNALS_Virtual_DcmDspUDS_26A0ByteBF_C0_signal" 987 "SIGNALS_Virtual_DcmDspUDS_26A0ByteC1_C2_signal" 988 "SIGNALS_Virtual_DcmDspUDS_26A0ByteC3_C4_signal" 989 "SIGNALS_Virtual_DcmDspUDS_26A0ByteC5_C6_signal" 990 "SIGNALS_Virtual_DcmDspUDS_26A0ByteC7_C8_signal" 991 "SIGNALS_Virtual_DcmDspUDS_26A0ByteC9_CA_signal" 992 "SIGNALS_Virtual_DcmDspUDS_26A0ByteCB_CC_signal" 993 "SIGNALS_Virtual_DcmDspUDS_26A0ByteCD_CE_signal" 994 "SIGNALS_Virtual_DcmDspUDS_26A0ByteCF_D0_signal" 995 "SIGNALS_Virtual_DcmDspUDS_26A0ByteD1_D2_signal" 996 "SIGNALS_Virtual_DcmDspUDS_26A0ByteD3_D4_signal" 997 "SIGNALS_Virtual_DcmDspUDS_26A0ByteD5_D6_signal" 998 "SIGNALS_Virtual_DcmDspUDS_26A0ByteD7_D8_signal" 999 "SIGNALS_Virtual_DcmDspUDS_26A0ByteD9_DA_signal" 1000 "SIGNALS_Virtual_DcmDspUDS_26A0ByteDB_DC_signal" 1001 "SIGNALS_Virtual_DcmDspUDS_26A0ByteDD_DE_signal" 1002 "SIGNALS_Virtual_DcmDspUDS_26A0ByteDF_E0_signal" 1003 "SIGNALS_Virtual_DcmDspUDS_26A0ByteE1_E2_signal" 1004 "SIGNALS_Virtual_DcmDspUDS_26A0ByteE3_E4_signal" 1005 "SIGNALS_Virtual_DcmDspUDS_26A0ByteE5_E6_signal" 1006 "SIGNALS_Virtual_DcmDspUDS_26A0ByteE7_E8_signal" 1007 "SIGNALS_Virtual_DcmDspUDS_26A0ByteE9_EA_signal" 1008 "SIGNALS_Virtual_DcmDspUDS_26A0ByteEB_EC_signal" 1009 "SIGNALS_Virtual_DcmDspUDS_26A0ByteED_EE_signal" 1010 "SIGNALS_Virtual_DcmDspUDS_26A0ByteEF_F0_signal" 1011 "SIGNALS_Virtual_DcmDspUDS_26A0ByteF1_F2_signal" 1012 "SIGNALS_Virtual_DcmDspUDS_26A1Byte00_signal" 1013 "SIGNALS_Virtual_DcmDspUDS_26A1Byte01_signal" 1014 "SIGNALS_Virtual_DcmDspUDS_26A1Byte02_signal" 1015 "SIGNALS_Virtual_DcmDspUDS_26A1Byte03_signal" 1016 "SIGNALS_Virtual_DcmDspUDS_26A1Byte04_signal" 1017 "SIGNALS_Virtual_DcmDspUDS_26A1Byte05_signal" 1018 "SIGNALS_Virtual_DcmDspUDS_26A1Byte06_signal" 1019 "SIGNALS_Virtual_DcmDspUDS_26A1Byte07_signal" 1020 "SIGNALS_Virtual_DcmDspUDS_26A1Byte08_signal" 1021 "SIGNALS_Virtual_DcmDspUDS_26A1Byte09_signal" 1022 "SIGNALS_Virtual_DcmDspUDS_26A1Byte0A_signal" 1023 "SIGNALS_Virtual_DcmDspUDS_26A1Byte0B_signal" 1024 "SIGNALS_Virtual_DcmDspUDS_26A1Byte0C_signal" 1025 "SIGNALS_Virtual_DcmDspUDS_26A1Byte0D_signal" 1026 "SIGNALS_Virtual_DcmDspUDS_26A1Byte0E_signal" 1027 "SIGNALS_Virtual_DcmDspUDS_26A1Byte0F_signal" 1028 "SIGNALS_Virtual_DcmDspUDS_26A1Byte10_signal" 1029 "SIGNALS_Virtual_DcmDspUDS_26A1Byte11_signal" 1030 "SIGNALS_Virtual_DcmDspUDS_26A1Byte12_signal" 1031 "SIGNALS_Virtual_DcmDspUDS_26A1Byte13_signal" 1032 "SIGNALS_Virtual_DcmDspUDS_26A1Byte14_signal" 1033 "SIGNALS_Virtual_DcmDspUDS_26A1Byte15_signal" 1034 "SIGNALS_Virtual_DcmDspUDS_26A1Byte16_signal" 1035 "SIGNALS_Virtual_DcmDspUDS_26A1Byte17_signal" 1036 "SIGNALS_Virtual_DcmDspUDS_26A1Byte18_signal" 1037 "SIGNALS_Virtual_DcmDspUDS_26A1Byte19_signal" 1038 "SIGNALS_Virtual_DcmDspUDS_26A1Byte1A_signal" 1039 "SIGNALS_Virtual_DcmDspUDS_26A1Byte1B_1C_signal" 1040 "SIGNALS_Virtual_DcmDspUDS_26A1Byte1D_1E_signal" 1041 "SIGNALS_Virtual_DcmDspUDS_26A1Byte1F_20_signal" 1042 "SIGNALS_Virtual_DcmDspUDS_26A1Byte21_22_signal" 1043 "SIGNALS_Virtual_DcmDspUDS_26A1Byte23_24_signal" 1044 "SIGNALS_Virtual_DcmDspUDS_26A1Byte25_signal" 1045 "SIGNALS_Virtual_DcmDspUDS_26A1Byte26_signal" 1046 "SIGNALS_Virtual_DcmDspUDS_26A1Byte27_signal" 1047 "SIGNALS_Virtual_DcmDspUDS_26A1Byte28_signal" 1048 "SIGNALS_Virtual_DcmDspUDS_26A1Byte29_signal" 1049 "SIGNALS_Virtual_DcmDspUDS_26A1Byte2A_signal" 1050 "SIGNALS_Virtual_DcmDspUDS_26A1Byte2B_signal" 1051 "SIGNALS_Virtual_DcmDspUDS_26A1Byte2C_signal" 1052 "SIGNALS_Virtual_DcmDspUDS_26A1Byte2D_signal" 1053 "SIGNALS_Virtual_DcmDspUDS_26A1Byte2E_signal" 1054 "SIGNALS_Virtual_DcmDspUDS_26A1Byte2F_signal" 1055 "SIGNALS_Virtual_DcmDspUDS_26A1Byte30_signal" 1056 "SIGNALS_Virtual_DcmDspUDS_26A1Byte31_signal" 1057 "SIGNALS_Virtual_DcmDspUDS_26A1Byte32_signal" 1058 "SIGNALS_Virtual_DcmDspUDS_26A1Byte33_signal" 1059 "SIGNALS_Virtual_DcmDspUDS_26A1Byte34_signal" 1060 "SIGNALS_Virtual_DcmDspUDS_26A1Byte35_signal" 1061 "SIGNALS_Virtual_DcmDspUDS_26A1Byte36_signal" 1062 "SIGNALS_Virtual_DcmDspUDS_26A1Byte37_signal" 1063 "SIGNALS_Virtual_DcmDspUDS_26A1Byte38_signal" 1064 "SIGNALS_Virtual_DcmDspUDS_26A1Byte39_signal" 1065 "SIGNALS_Virtual_DcmDspUDS_26A1Byte6F_70_signal" 1066 "SIGNALS_Virtual_DcmDspUDS_26A1Byte71_72_signal" 1067 "SIGNALS_Virtual_DcmDspUDS_26A1Byte73_74_signal" 1068 "SIGNALS_Virtual_DcmDspUDS_26A1Byte75_76_signal" 1069 "SIGNALS_Virtual_DcmDspUDS_26A1Byte77_78_signal" 1070 "SIGNALS_Virtual_DcmDspUDS_26A1Byte79_signal" 1071 "SIGNALS_Virtual_DcmDspUDS_26A1Byte7B_signal" 1072 "SIGNALS_Virtual_DcmDspUDS_26A2Byte00_signal" 1073 "SIGNALS_Virtual_DcmDspUDS_26A2Byte01_signal" 1074 "SIGNALS_Virtual_DcmDspUDS_26A2Byte02_signal" 1075 "SIGNALS_Virtual_DcmDspUDS_26A2Byte03_signal" 1076 "SIGNALS_Virtual_DcmDspUDS_26A2Byte04_signal" 1077 "SIGNALS_Virtual_DcmDspUDS_26A2Byte05_signal" 1078 "SIGNALS_Virtual_DcmDspUDS_26A2Byte12_13_signal" 1079 "SIGNALS_Virtual_DcmDspUDS_26A2Byte1C_signal" 1080 "SIGNALS_Virtual_DcmDspUDS_26A2Byte1D_signal" 1081 "SIGNALS_Virtual_DcmDspUDS_26A2Byte21_signal" 1082 "SIGNALS_Virtual_DcmDspUDS_26A2Byte22_signal" 1083 "SIGNALS_Virtual_DcmDspUDS_Acm_fzabgs_w_signal" 1084 "SIGNALS_Virtual_DcmDspUDS_DID_2613Byte2Eto2F_signal_VirtFunc_s" 1085 "SIGNALS_Virtual_DcmDspUDS_DID_261AByte08_signal" 1086 "SIGNALS_Virtual_DcmDspUDS_DID_261AByte09_signal" 1087 "SIGNALS_Virtual_DcmDspUDS_DID_E402Byte00_signal" 1088 "SIGNALS_Virtual_DcmDspUDS_DID_E402Byte01_signal" 1089 "SIGNALS_Virtual_DcmDspUDS_DID_E402Byte07to08_signal" 1090 "SIGNALS_Virtual_DcmDspUDS_DID_E402Byte10to11_signal" 1091 "SIGNALS_Virtual_DcmDspUDS_DID_E402Byte19to1A_signal" 1092 "SIGNALS_Virtual_DcmDspUDS_DID_E402Byte22to23_signal" 1093 "SIGNALS_Virtual_DcmDspUDS_DID_E402Byte2Bto2C_signal" 1094 "SIGNALS_Virtual_DcmDspUDS_DID_F110Byte0_3_signal" 1095 "SIGNALS_Virtual_DcmDspUDS_DID_F110Byte12_15_signal" 1096 "SIGNALS_Virtual_DcmDspUDS_DID_F110Byte16_signal" 1097 "SIGNALS_Virtual_DcmDspUDS_DID_F110Byte4_7_signal" 1098 "SIGNALS_Virtual_DcmDspUDS_DID_F110Byte8_11_signal" 1099 "SIGNALS_Virtual_DcmDspUDS_DID_F112Byte0_3_signal" 1100 "SIGNALS_Virtual_DcmDspUDS_DID_F112Byte12_15_signal" 1101 "SIGNALS_Virtual_DcmDspUDS_DID_F112Byte16_19_signal" 1102 "SIGNALS_Virtual_DcmDspUDS_DID_F112Byte20_23_signal" 1103 "SIGNALS_Virtual_DcmDspUDS_DID_F112Byte24_27_signal" 1104 "SIGNALS_Virtual_DcmDspUDS_DID_F112Byte28_29_signal" 1105 "SIGNALS_Virtual_DcmDspUDS_DID_F112Byte30_signal" 1106 "SIGNALS_Virtual_DcmDspUDS_DID_F112Byte4_7_signal" 1107 "SIGNALS_Virtual_DcmDspUDS_DID_F112Byte8_11_signal" 1108 "SIGNALS_Virtual_DcmDspUDS_E602Byte2_signal" 1109 "SIGNALS_Virtual_DcmDspUDS_F181Byte0_3_signal" 1110 "SIGNALS_Virtual_DcmDspUDS_F181Byte12_15_signal" 1111 "SIGNALS_Virtual_DcmDspUDS_F181Byte4_7_signal" 1112 "SIGNALS_Virtual_DcmDspUDS_F181Byte8_11_signal" 1113 "SIGNALS_Virtual_DcmDspUDS_fzabgs_w_signal" 1114 "SIGNALS_Virtual_DcmDspUDS_numReWrECUID1_signal" 1115 "SIGNALS_Virtual_DcmDspUDS_numReWrECUID2_signal" 1116 "SIGNALS_Virtual_I14229B9_0490_FrNo09_signal" 1117 "SIGNALS_Virtual_I14229B9_0490_FrNo10_signal" 1118 "SIGNALS_Virtual_I14229B9_04B1_FrNo16_signal" 1119 "SIGNALS_Virtual_I14229B9_04B1_FrNo17_signal" 1120 "SIGNALS_Virtual_I14229B9_04B1_FrNo20_signal" 1121 "SIGNALS_Virtual_I14229B9_04B1_FrNo21_signal" 1122 "SIGNALS_Virtual_I14229B9_04B1_FrNo22_signal" 1123 "SIGNALS_Virtual_I14229B9_04B1_FrNo23_signal" 1124 "SIGNALS_Virtual_I14229B9_04C2_FrNo2021_signal" 1125 "SIGNALS_Virtual_I14229B9_04D2_FrNo24_signal" 1126 "SIGNALS_Virtual_I14229B9_04D2_FrNo25_signal" 1127 "SIGNALS_Virtual_I14229B9_0520_FrNo15_signal" 1128 "SIGNALS_Virtual_I14229B9_0520_FrNo16_signal" 1129 "SIGNALS_Virtual_I14229B9_0523_FrNo42_signal" 1130 "SIGNALS_Virtual_I14229B9_0523_FrNo43_signal" 1131 "SIGNALS_Virtual_I14229B9_0524_FrNo09_signal" 1132 "SIGNALS_Virtual_I14229B9_0524_FrNo10_signal" 1133 "SIGNALS_Virtual_I14229B9_0550_FrNo09_signal" 1134 "SIGNALS_Virtual_I14229B9_0550_FrNo10_signal" 1135 "SIGNALS_Virtual_I14229B9_0553_FrNo13_signal" 1136 "SIGNALS_Virtual_I14229B9_0553_FrNo14_signal" 1137 "SIGNALS_Virtual_I14229B9_056A_FrNo8_signal" 1138 "SIGNALS_Virtual_I14229B9_056A_FrNo9_signal" 1139 "SIGNALS_Virtual_I14229B9_0588_FrNo15_signal" 1140 "SIGNALS_Virtual_I14229B9_0588_FrNo16_signal" 1141 "SIGNALS_Virtual_I14229B9_05A0_FrNo40_signal" 1142 "SIGNALS_Virtual_I14229B9_05A0_FrNo41_signal" 1143 "SIGNALS_Virtual_I14229B9_05B0_FrNo13_signal" 1144 "SIGNALS_Virtual_I14229B9_05B0_FrNo14_signal" 1145 "SIGNALS_Virtual_I14229B9_05C0_FrNo12_signal" 1146 "SIGNALS_Virtual_I14229B9_05C0_FrNo13_signal" 1147 "SIGNALS_Virtual_I14229B9_05E0_FrNo19_signal" 1148 "SIGNALS_Virtual_I14229B9_05E0_FrNo20_signal" 1149 "SIGNALS_Virtual_I14229B9_05E0_FrNo21_signal" 1150 "SIGNALS_Virtual_I14229B9_05E0_FrNo22_signal" 1151 "SIGNALS_Virtual_I14229B9_05E0_FrNo23_signal" 1152 "SIGNALS_Virtual_I14229B9_05E0_FrNo24_signal" 1153 "SIGNALS_Virtual_I14229B9_1208_FrNo34_signal" 1154 "SIGNALS_Virtual_I14229B9_1208_FrNo35_signal" 1155 "SIGNALS_Virtual_I14229B9_1208_FrNo36_signal" 1156 "SIGNALS_Virtual_I14229B9_1208_FrNo37_signal" 1157 "SIGNALS_Virtual_I14229B9_120A_FrNo09_signal" 1158 "SIGNALS_Virtual_I14229B9_120A_FrNo10_signal" 1159 "SIGNALS_Virtual_I14229B9_120B_FrNo09_signal" 1160 "SIGNALS_Virtual_I14229B9_120B_FrNo10_signal" 1161 "SIGNALS_Virtual_I14229_Com_aLgtG_signal" 1162 "SIGNALS_Virtual_I14229_pEngSrtMin_signal" 1163 "SIGNALS_Virtual_IKCtl_agAdpnCurr_s16_signal" 1164 "SIGNALS_Virtual_IKCtl_wIntgRef_au32_0__s" 1165 "SIGNALS_Virtual_PtCoornDyn_tqCluDes_signal" 1166 "SIGNALS_Virtual_PtCoornDyn_tqCluLeadTrsmIntv_signal" 1167 "SIGNALS_Virtual_Tra_numGear_signal" 1168 "SIGNALS_Virtual_i14229_agIntkB1GEVlvSig_signal" /end COMPU_VTAB
/begin COMPU_METHOD Temp_Cels "" RAT_FUNC "%6.1" "deg C" COEFFS 0 10 2731.4 0 0 1 /end COMPU_METHOD
/begin COMPU_METHOD TimeDelay_s "" RAT_FUNC "%6.1" "s" COEFFS 0 0 1 0 0.00023283064365387 0 /end COMPU_METHOD
/begin COMPU_METHOD Time_ms "" RAT_FUNC "%6.1" "ms" COEFFS 0 0.1 0 0 0 1 /end COMPU_METHOD
/begin COMPU_METHOD Time_ms_to_us "" RAT_FUNC "%6.5" "ms" COEFFS 0 1000 0 0 0 1 /end COMPU_METHOD
/begin COMPU_METHOD Time_s "" RAT_FUNC "%6.4" "s" COEFFS 0 100 0 0 0 1 /end COMPU_METHOD
/begin COMPU_METHOD TransR "" RAT_FUNC "%6.4" "-" COEFFS 0 100 0 0 0 1 /end COMPU_METHOD
/begin COMPU_METHOD Trq "" RAT_FUNC "%6.3" "Nm" COEFFS 0 10 0 0 0 1 /end COMPU_METHOD
/begin COMPU_METHOD TrqCom_q0p02 "" RAT_FUNC "%6.4" "Nm" COEFFS 0 50 0 0 0 1 /end COMPU_METHOD
/begin COMPU_METHOD Trq_float "" RAT_FUNC "%6.2" "Nm" COEFFS 0 1 0 0 0 1 /end COMPU_METHOD
/begin COMPU_METHOD trq_q0p1 "" RAT_FUNC "%6.3" "Nm" COEFFS 0 10 0 0 0 1 /end COMPU_METHOD
/begin COMPU_METHOD t_q0p01 "" RAT_FUNC "%6.4" "s" COEFFS 0 100 0 0 0 1 /end COMPU_METHOD
/begin COMPU_METHOD t_q1p0 "" RAT_FUNC "%6.2" "s" COEFFS 0 1 0 0 0 1 /end COMPU_METHOD
/begin COMPU_METHOD t_q1_ms "" RAT_FUNC "%6.2" "ms" COEFFS 0 1 0 0 0 1 /end COMPU_METHOD
/begin COMPU_METHOD Vel "" RAT_FUNC "%6.4" "km/h" COEFFS 0 100 0 0 0 1 /end COMPU_METHOD
/begin COMPU_METHOD Vel_CrCtl1 "" RAT_FUNC "%6.2" "km/h" COEFFS 0 1 0 0 0 1 /end COMPU_METHOD
/begin COMPU_METHOD vel_q0p01 "" RAT_FUNC "%6.4" "km/h" COEFFS 0 100 0 0 0 1 /end COMPU_METHOD
/begin COMPU_METHOD Volt1 "" RAT_FUNC "%6.2" "" COEFFS 0 1 0 0 0 1 /end COMPU_METHOD
/begin RECORD_LAYOUT RB_Curve_S16_S16 NO_AXIS_PTS_X 1 SWORD AXIS_PTS_X 2 SWORD INDEX_INCR DIRECT FNC_VALUES 3 SWORD COLUMN_DIR DIRECT /end RECORD_LAYOUT
/begin RECORD_LAYOUT RB_Curve_S16_U8_Static NO_AXIS_PTS_X 1 SWORD AXIS_PTS_X 2 SWORD INDEX_INCR DIRECT FNC_VALUES 3 UBYTE COLUMN_DIR DIRECT STATIC_RECORD_LAYOUT /end RECORD_LAYOUT
/begin RECORD_LAYOUT RB_Curve_U8_U8 NO_AXIS_PTS_X 1 UBYTE AXIS_PTS_X 2 UBYTE INDEX_INCR DIRECT FNC_VALUES 3 UBYTE COLUMN_DIR DIRECT /end RECORD_LAYOUT
/begin RECORD_LAYOUT RB_Map_S16S16_S16 NO_AXIS_PTS_X 1 SWORD NO_AXIS_PTS_Y 2 SWORD AXIS_PTS_X 3 SWORD INDEX_INCR DIRECT AXIS_PTS_Y 4 SWORD INDEX_INCR DIRECT FNC_VALUES 5 SWORD COLUMN_DIR DIRECT /end RECORD_LAYOUT
/begin RECORD_LAYOUT RB_ValA_Wu16 FNC_VALUES 1 UWORD COLUMN_DIR DIRECT /end RECORD_LAYOUT
/begin RECORD_LAYOUT RB_Val_Wboolean FNC_VALUES 1 UBYTE COLUMN_DIR DIRECT /end RECORD_LAYOUT
/begin RECORD_LAYOUT RB_Val_Ws16 FNC_VALUES 1 SWORD COLUMN_DIR DIRECT /end RECORD_LAYOUT
/begin RECORD_LAYOUT RB_Val_Ws32 FNC_VALUES 1 SLONG COLUMN_DIR DIRECT /end RECORD_LAYOUT
/begin RECORD_LAYOUT RB_Val_Ws8 FNC_VALUES 1 SBYTE COLUMN_DIR DIRECT /end RECORD_LAYOUT
/begin RECORD_LAYOUT RB_Val_Wu16 FNC_VALUES 1 UWORD COLUMN_DIR DIRECT /end RECORD_LAYOUT
/begin RECORD_LAYOUT RB_Val_Wu32 FNC_VALUES 1 ULONG COLUMN_DIR DIRECT /end RECORD_LAYOUT
/begin RECORD_LAYOUT RB_Val_Wu8 FNC_VALUES 1 UBYTE COLUMN_DIR DIRECT /end RECORD_LAYOUT
/begin RECORD_LAYOUT Val_Ws16 FNC_VALUES 1 SWORD COLUMN_DIR DIRECT /end RECORD_LAYOUT
/begin RECORD_LAYOUT Val_Wu8 FNC_VALUES 1 UBYTE COLUMN_DIR DIRECT /end RECORD_LAYOUT
/end MODULE
/end PROJECT
