ASAP2_VERSION 1 60
/begin PROJECT MG1CS022 "MG1CS022"
/begin HEADER "" VERSION "MG1CS022_62XSC_V037" PROJECT_NO MG1CS022 /end HEADER
/begin MODULE DIM ""
/begin MOD_COMMON "" BYTE_ORDER MSB_LAST ALIGNMENT_BYTE 1 ALIGNMENT_WORD 2 ALIGNMENT_LONG 4 ALIGNMENT_INT64 4 ALIGNMENT_FLOAT32_IEEE 4 ALIGNMENT_FLOAT64_IEEE 4 DATA_SIZE 32 /end MOD_COMMON
/begin CHARACTERISTIC Com_tiAYCA_RxRxTout_C "Calibration parameter to control Rx Ipdu Timeout for AYCA_Rx" VALUE 0x804D856C DefaultValueRecordLayout_AUTOSAR_Platform_BaseTypes_uint16 65535.0 RB_RBA_Common_CentralElements_CompuMethods_Identical 0.0 65535. FORMAT "%5.0" /end CHARACTERISTIC
/begin CHARACTERISTIC Com_tiAYCD_RxRxTout_C "Calibration parameter to control Rx Ipdu Timeout for AYCD_Rx" VALUE 0x804D856A DefaultValueRecordLayout_AUTOSAR_Platform_BaseTypes_uint16 65535.0 RB_RBA_Common_CentralElements_CompuMethods_Identical 0.0 65535. FORMAT "%5.0" /end CHARACTERISTIC
/begin CHARACTERISTIC Com_tiAYCF_RxRxTout_C "Calibration parameter to control Rx Ipdu Timeout for AYCF_Rx" VALUE 0x804D8568 DefaultValueRecordLayout_AUTOSAR_Platform_BaseTypes_uint16 65535.0 RB_RBA_Common_CentralElements_CompuMethods_Identical 0.0 65535. FORMAT "%5.0" /end CHARACTERISTIC
/begin CHARACTERISTIC Com_tiAYCG_RxRxTout_C "Calibration parameter to control Rx Ipdu Timeout for AYCG_Rx" VALUE 0x804D8566 DefaultValueRecordLayout_AUTOSAR_Platform_BaseTypes_uint16 65535.0 RB_RBA_Common_CentralElements_CompuMethods_Identical 0.0 65535. FORMAT "%5.0" /end CHARACTERISTIC
/begin CHARACTERISTIC Com_tiAYCI_RxRxTout_C "Calibration parameter to control Rx Ipdu Timeout for AYCI_Rx" VALUE 0x804D8564 DefaultValueRecordLayout_AUTOSAR_Platform_BaseTypes_uint16 65535.0 RB_RBA_Common_CentralElements_CompuMethods_Identical 0.0 65535. FORMAT "%5.0" /end CHARACTERISTIC
/begin CHARACTERISTIC Com_tiBCM1_RxRxTout_C "Calibration parameter to control Rx Ipdu Timeout for BCM1_Rx" VALUE 0x804D8562 DefaultValueRecordLayout_AUTOSAR_Platform_BaseTypes_uint16 65535.0 RB_RBA_Common_CentralElements_CompuMethods_Identical 0.0 65535. FORMAT "%5.0" /end CHARACTERISTIC
/begin CHARACTERISTIC Com_tiCGW1_RxRxTout_C "Calibration parameter to control Rx Ipdu Timeout for CGW1_Rx" VALUE 0x804D8560 DefaultValueRecordLayout_AUTOSAR_Platform_BaseTypes_uint16 65535.0 RB_RBA_Common_CentralElements_CompuMethods_Identical 0.0 65535. FORMAT "%5.0" /end CHARACTERISTIC
/begin CHARACTERISTIC Com_tiEAT10_RxRxTout_C "Calibration parameter to control Rx Ipdu Timeout for EAT10_Rx" VALUE 0x804D855E DefaultValueRecordLayout_AUTOSAR_Platform_BaseTypes_uint16 65535.0 RB_RBA_Common_CentralElements_CompuMethods_Identical 0.0 65535. FORMAT "%5.0" /end CHARACTERISTIC
/begin CHARACTERISTIC Com_tiEAT11_RxRxTout_C "Calibration parameter to control Rx Ipdu Timeout for EAT11_Rx" VALUE 0x804D855C DefaultValueRecordLayout_AUTOSAR_Platform_BaseTypes_uint16 65535.0 RB_RBA_Common_CentralElements_CompuMethods_Identical 0.0 65535. FORMAT "%5.0" /end CHARACTERISTIC
/begin CHARACTERISTIC Com_tiEAT12_RxRxTout_C "Calibration parameter to control Rx Ipdu Timeout for EAT12_Rx" VALUE 0x804D855A DefaultValueRecordLayout_AUTOSAR_Platform_BaseTypes_uint16 65535.0 RB_RBA_Common_CentralElements_CompuMethods_Identical 0.0 65535. FORMAT "%5.0" /end CHARACTERISTIC
/begin CHARACTERISTIC Com_tiEAT13_RxRxTout_C "Calibration parameter to control Rx Ipdu Timeout for EAT13_Rx" VALUE 0x804D8558 DefaultValueRecordLayout_AUTOSAR_Platform_BaseTypes_uint16 65535.0 RB_RBA_Common_CentralElements_CompuMethods_Identical 0.0 65535. FORMAT "%5.0" /end CHARACTERISTIC
/begin CHARACTERISTIC Com_tiEAT1_RxRxTout_C "Calibration parameter to control Rx Ipdu Timeout for EAT1_Rx" VALUE 0x804D8556 DefaultValueRecordLayout_AUTOSAR_Platform_BaseTypes_uint16 65535.0 RB_RBA_Common_CentralElements_CompuMethods_Identical 0.0 65535. FORMAT "%5.0" /end CHARACTERISTIC
/begin CHARACTERISTIC Com_tiEAT2_RxRxTout_C "Calibration parameter to control Rx Ipdu Timeout for EAT2_Rx" VALUE 0x804D8554 DefaultValueRecordLayout_AUTOSAR_Platform_BaseTypes_uint16 65535.0 RB_RBA_Common_CentralElements_CompuMethods_Identical 0.0 65535. FORMAT "%5.0" /end CHARACTERISTIC
/begin CHARACTERISTIC Com_tiEAT4_RxRxTout_C "Calibration parameter to control Rx Ipdu Timeout for EAT4_Rx" VALUE 0x804D8552 DefaultValueRecordLayout_AUTOSAR_Platform_BaseTypes_uint16 65535.0 RB_RBA_Common_CentralElements_CompuMethods_Identical 0.0 65535. FORMAT "%5.0" /end CHARACTERISTIC
/begin CHARACTERISTIC Com_tiEAT6_RxRxTout_C "Calibration parameter to control Rx Ipdu Timeout for EAT6_Rx" VALUE 0x804D8550 DefaultValueRecordLayout_AUTOSAR_Platform_BaseTypes_uint16 65535.0 RB_RBA_Common_CentralElements_CompuMethods_Identical 0.0 65535. FORMAT "%5.0" /end CHARACTERISTIC
/begin CHARACTERISTIC Com_tiEAT7_RxRxTout_C "Calibration parameter to control Rx Ipdu Timeout for EAT7_Rx" VALUE 0x804D854E DefaultValueRecordLayout_AUTOSAR_Platform_BaseTypes_uint16 65535.0 RB_RBA_Common_CentralElements_CompuMethods_Identical 0.0 65535. FORMAT "%5.0" /end CHARACTERISTIC
/begin CHARACTERISTIC Com_tiEAT8_RxRxTout_C "Calibration parameter to control Rx Ipdu Timeout for EAT8_Rx" VALUE 0x804D854C DefaultValueRecordLayout_AUTOSAR_Platform_BaseTypes_uint16 65535.0 RB_RBA_Common_CentralElements_CompuMethods_Identical 0.0 65535. FORMAT "%5.0" /end CHARACTERISTIC
/begin CHARACTERISTIC Com_tiEATA_RxRxTout_C "Calibration parameter to control Rx Ipdu Timeout for EATA_Rx" VALUE 0x804D854A DefaultValueRecordLayout_AUTOSAR_Platform_BaseTypes_uint16 65535.0 RB_RBA_Common_CentralElements_CompuMethods_Identical 0.0 65535. FORMAT "%5.0" /end CHARACTERISTIC
/begin CHARACTERISTIC Com_tiEATB_RxRxTout_C "Calibration parameter to control Rx Ipdu Timeout for EATB_Rx" VALUE 0x804D8548 DefaultValueRecordLayout_AUTOSAR_Platform_BaseTypes_uint16 65535.0 RB_RBA_Common_CentralElements_CompuMethods_Identical 0.0 65535. FORMAT "%5.0" /end CHARACTERISTIC
/begin CHARACTERISTIC Com_tiEATC_RxRxTout_C "Calibration parameter to control Rx Ipdu Timeout for EATC_Rx" VALUE 0x804D8546 DefaultValueRecordLayout_AUTOSAR_Platform_BaseTypes_uint16 65535.0 RB_RBA_Common_CentralElements_CompuMethods_Identical 0.0 65535. FORMAT "%5.0" /end CHARACTERISTIC
/begin CHARACTERISTIC Com_tiENG10_TxTxPerd_C "Calibration parameter to control Tx Ipdu periodic factor for ENG10_Tx" VALUE 0x804D8544 DefaultValueRecordLayout_AUTOSAR_Platform_BaseTypes_uint16 65535.0 RB_RBA_Common_CentralElements_CompuMethods_Identical 0.0 65535. FORMAT "%5.0" /end CHARACTERISTIC
/begin CHARACTERISTIC Com_tiENG11_TxTxPerd_C "Calibration parameter to control Tx Ipdu periodic factor for ENG11_Tx" VALUE 0x804D8542 DefaultValueRecordLayout_AUTOSAR_Platform_BaseTypes_uint16 65535.0 RB_RBA_Common_CentralElements_CompuMethods_Identical 0.0 65535. FORMAT "%5.0" /end CHARACTERISTIC
/begin CHARACTERISTIC Com_tiENG15_TxTxPerd_C "Calibration parameter to control Tx Ipdu periodic factor for ENG15_Tx" VALUE 0x804D8540 DefaultValueRecordLayout_AUTOSAR_Platform_BaseTypes_uint16 65535.0 RB_RBA_Common_CentralElements_CompuMethods_Identical 0.0 65535. FORMAT "%5.0" /end CHARACTERISTIC
/begin CHARACTERISTIC Com_tiENG16_TxTxPerd_C "Calibration parameter to control Tx Ipdu periodic factor for ENG16_Tx" VALUE 0x804D853E DefaultValueRecordLayout_AUTOSAR_Platform_BaseTypes_uint16 65535.0 RB_RBA_Common_CentralElements_CompuMethods_Identical 0.0 65535. FORMAT "%5.0" /end CHARACTERISTIC
/begin CHARACTERISTIC Com_tiENG17_TxTxPerd_C "Calibration parameter to control Tx Ipdu periodic factor for ENG17_Tx" VALUE 0x804D853C DefaultValueRecordLayout_AUTOSAR_Platform_BaseTypes_uint16 65535.0 RB_RBA_Common_CentralElements_CompuMethods_Identical 0.0 65535. FORMAT "%5.0" /end CHARACTERISTIC
/begin CHARACTERISTIC Com_tiENG18_TxTxPerd_C "Calibration parameter to control Tx Ipdu periodic factor for ENG18_Tx" VALUE 0x804D853A DefaultValueRecordLayout_AUTOSAR_Platform_BaseTypes_uint16 65535.0 RB_RBA_Common_CentralElements_CompuMethods_Identical 0.0 65535. FORMAT "%5.0" /end CHARACTERISTIC
/begin CHARACTERISTIC Com_tiENG19_TxTxPerd_C "Calibration parameter to control Tx Ipdu periodic factor for ENG19_Tx" VALUE 0x804D8538 DefaultValueRecordLayout_AUTOSAR_Platform_BaseTypes_uint16 65535.0 RB_RBA_Common_CentralElements_CompuMethods_Identical 0.0 65535. FORMAT "%5.0" /end CHARACTERISTIC
/begin CHARACTERISTIC Com_tiENG20_TxTxPerd_C "Calibration parameter to control Tx Ipdu periodic factor for ENG20_Tx" VALUE 0x804D8536 DefaultValueRecordLayout_AUTOSAR_Platform_BaseTypes_uint16 65535.0 RB_RBA_Common_CentralElements_CompuMethods_Identical 0.0 65535. FORMAT "%5.0" /end CHARACTERISTIC
/begin CHARACTERISTIC Com_tiENG21_TxTxPerd_C "Calibration parameter to control Tx Ipdu periodic factor for ENG21_Tx" VALUE 0x804D8534 DefaultValueRecordLayout_AUTOSAR_Platform_BaseTypes_uint16 65535.0 RB_RBA_Common_CentralElements_CompuMethods_Identical 0.0 65535. FORMAT "%5.0" /end CHARACTERISTIC
/begin CHARACTERISTIC Com_tiENG22_TxTxPerd_C "Calibration parameter to control Tx Ipdu periodic factor for ENG22_Tx" VALUE 0x804D8532 DefaultValueRecordLayout_AUTOSAR_Platform_BaseTypes_uint16 65535.0 RB_RBA_Common_CentralElements_CompuMethods_Identical 0.0 65535. FORMAT "%5.0" /end CHARACTERISTIC
/begin CHARACTERISTIC Com_tiENG23_TxTxPerd_C "Calibration parameter to control Tx Ipdu periodic factor for ENG23_Tx" VALUE 0x804D8530 DefaultValueRecordLayout_AUTOSAR_Platform_BaseTypes_uint16 65535.0 RB_RBA_Common_CentralElements_CompuMethods_Identical 0.0 65535. FORMAT "%5.0" /end CHARACTERISTIC
/begin CHARACTERISTIC Com_tiENG24_TxTxPerd_C "Calibration parameter to control Tx Ipdu periodic factor for ENG24_Tx" VALUE 0x804D852E DefaultValueRecordLayout_AUTOSAR_Platform_BaseTypes_uint16 65535.0 RB_RBA_Common_CentralElements_CompuMethods_Identical 0.0 65535. FORMAT "%5.0" /end CHARACTERISTIC
/begin CHARACTERISTIC Com_tiENG25_TxTxPerd_C "Calibration parameter to control Tx Ipdu periodic factor for ENG25_Tx" VALUE 0x804D852C DefaultValueRecordLayout_AUTOSAR_Platform_BaseTypes_uint16 65535.0 RB_RBA_Common_CentralElements_CompuMethods_Identical 0.0 65535. FORMAT "%5.0" /end CHARACTERISTIC
/begin CHARACTERISTIC Com_tiENG2_TxTxPerd_C "Calibration parameter to control Tx Ipdu periodic factor for ENG2_Tx" VALUE 0x804D852A DefaultValueRecordLayout_AUTOSAR_Platform_BaseTypes_uint16 65535.0 RB_RBA_Common_CentralElements_CompuMethods_Identical 0.0 65535. FORMAT "%5.0" /end CHARACTERISTIC
/begin CHARACTERISTIC Com_tiENG3_TxTxPerd_C "Calibration parameter to control Tx Ipdu periodic factor for ENG3_Tx" VALUE 0x804D8528 DefaultValueRecordLayout_AUTOSAR_Platform_BaseTypes_uint16 65535.0 RB_RBA_Common_CentralElements_CompuMethods_Identical 0.0 65535. FORMAT "%5.0" /end CHARACTERISTIC
/begin CHARACTERISTIC Com_tiENG4_TxTxPerd_C "Calibration parameter to control Tx Ipdu periodic factor for ENG4_Tx" VALUE 0x804D8526 DefaultValueRecordLayout_AUTOSAR_Platform_BaseTypes_uint16 65535.0 RB_RBA_Common_CentralElements_CompuMethods_Identical 0.0 65535. FORMAT "%5.0" /end CHARACTERISTIC
/begin CHARACTERISTIC Com_tiENG5_TxTxPerd_C "Calibration parameter to control Tx Ipdu periodic factor for ENG5_Tx" VALUE 0x804D8524 DefaultValueRecordLayout_AUTOSAR_Platform_BaseTypes_uint16 65535.0 RB_RBA_Common_CentralElements_CompuMethods_Identical 0.0 65535. FORMAT "%5.0" /end CHARACTERISTIC
/begin CHARACTERISTIC Com_tiENG6_TxTxPerd_C "Calibration parameter to control Tx Ipdu periodic factor for ENG6_Tx" VALUE 0x804D8522 DefaultValueRecordLayout_AUTOSAR_Platform_BaseTypes_uint16 65535.0 RB_RBA_Common_CentralElements_CompuMethods_Identical 0.0 65535. FORMAT "%5.0" /end CHARACTERISTIC
/begin CHARACTERISTIC Com_tiENGAE_TxTxPerd_C "Calibration parameter to control Tx Ipdu periodic factor for ENGAE_Tx" VALUE 0x804D8520 DefaultValueRecordLayout_AUTOSAR_Platform_BaseTypes_uint16 65535.0 RB_RBA_Common_CentralElements_CompuMethods_Identical 0.0 65535. FORMAT "%5.0" /end CHARACTERISTIC
/begin CHARACTERISTIC Com_tiENGA_TxTxPerd_C "Calibration parameter to control Tx Ipdu periodic factor for ENGA_Tx" VALUE 0x804D851E DefaultValueRecordLayout_AUTOSAR_Platform_BaseTypes_uint16 65535.0 RB_RBA_Common_CentralElements_CompuMethods_Identical 0.0 65535. FORMAT "%5.0" /end CHARACTERISTIC
/begin CHARACTERISTIC Com_tiENGB_TxTxPerd_C "Calibration parameter to control Tx Ipdu periodic factor for ENGB_Tx" VALUE 0x804D851C DefaultValueRecordLayout_AUTOSAR_Platform_BaseTypes_uint16 65535.0 RB_RBA_Common_CentralElements_CompuMethods_Identical 0.0 65535. FORMAT "%5.0" /end CHARACTERISTIC
/begin CHARACTERISTIC Com_tiENGC_TxTxPerd_C "Calibration parameter to control Tx Ipdu periodic factor for ENGC_Tx" VALUE 0x804D851A DefaultValueRecordLayout_AUTOSAR_Platform_BaseTypes_uint16 65535.0 RB_RBA_Common_CentralElements_CompuMethods_Identical 0.0 65535. FORMAT "%5.0" /end CHARACTERISTIC
/begin CHARACTERISTIC Com_tiENGF_TxTxPerd_C "Calibration parameter to control Tx Ipdu periodic factor for ENGF_Tx" VALUE 0x804D8518 DefaultValueRecordLayout_AUTOSAR_Platform_BaseTypes_uint16 65535.0 RB_RBA_Common_CentralElements_CompuMethods_Identical 0.0 65535. FORMAT "%5.0" /end CHARACTERISTIC
/begin CHARACTERISTIC Com_tiENGIMG1_TxTxPerd_C "Calibration parameter to control Tx Ipdu periodic factor for ENGIMG1_Tx" VALUE 0x804D8516 DefaultValueRecordLayout_AUTOSAR_Platform_BaseTypes_uint16 65535.0 RB_RBA_Common_CentralElements_CompuMethods_Identical 0.0 65535. FORMAT "%5.0" /end CHARACTERISTIC
/begin CHARACTERISTIC Com_tiENGJ3_TxTxPerd_C "Calibration parameter to control Tx Ipdu periodic factor for ENGJ3_Tx" VALUE 0x804D8514 DefaultValueRecordLayout_AUTOSAR_Platform_BaseTypes_uint16 65535.0 RB_RBA_Common_CentralElements_CompuMethods_Identical 0.0 65535. FORMAT "%5.0" /end CHARACTERISTIC
/begin CHARACTERISTIC Com_tiENGK3_TxTxPerd_C "Calibration parameter to control Tx Ipdu periodic factor for ENGK3_Tx" VALUE 0x804D8512 DefaultValueRecordLayout_AUTOSAR_Platform_BaseTypes_uint16 65535.0 RB_RBA_Common_CentralElements_CompuMethods_Identical 0.0 65535. FORMAT "%5.0" /end CHARACTERISTIC
/begin CHARACTERISTIC Com_tiENGL_TxTxPerd_C "Calibration parameter to control Tx Ipdu periodic factor for ENGL_Tx" VALUE 0x804D8510 DefaultValueRecordLayout_AUTOSAR_Platform_BaseTypes_uint16 65535.0 RB_RBA_Common_CentralElements_CompuMethods_Identical 0.0 65535. FORMAT "%5.0" /end CHARACTERISTIC
/begin CHARACTERISTIC Com_tiENGN_TxTxPerd_C "Calibration parameter to control Tx Ipdu periodic factor for ENGN_Tx" VALUE 0x804D850E DefaultValueRecordLayout_AUTOSAR_Platform_BaseTypes_uint16 65535.0 RB_RBA_Common_CentralElements_CompuMethods_Identical 0.0 65535. FORMAT "%5.0" /end CHARACTERISTIC
/begin CHARACTERISTIC Com_tiENGQ_TxTxPerd_C "Calibration parameter to control Tx Ipdu periodic factor for ENGQ_Tx" VALUE 0x804D850C DefaultValueRecordLayout_AUTOSAR_Platform_BaseTypes_uint16 65535.0 RB_RBA_Common_CentralElements_CompuMethods_Identical 0.0 65535. FORMAT "%5.0" /end CHARACTERISTIC
/begin CHARACTERISTIC Com_tiENGR_TxTxPerd_C "Calibration parameter to control Tx Ipdu periodic factor for ENGR_Tx" VALUE 0x804D850A DefaultValueRecordLayout_AUTOSAR_Platform_BaseTypes_uint16 65535.0 RB_RBA_Common_CentralElements_CompuMethods_Identical 0.0 65535. FORMAT "%5.0" /end CHARACTERISTIC
/begin CHARACTERISTIC Com_tiENGT1_TxTxPerd_C "Calibration parameter to control Tx Ipdu periodic factor for ENGT1_Tx" VALUE 0x804D8508 DefaultValueRecordLayout_AUTOSAR_Platform_BaseTypes_uint16 65535.0 RB_RBA_Common_CentralElements_CompuMethods_Identical 0.0 65535. FORMAT "%5.0" /end CHARACTERISTIC
/begin CHARACTERISTIC Com_tiENGT2_TxTxPerd_C "Calibration parameter to control Tx Ipdu periodic factor for ENGT2_Tx" VALUE 0x804D8506 DefaultValueRecordLayout_AUTOSAR_Platform_BaseTypes_uint16 65535.0 RB_RBA_Common_CentralElements_CompuMethods_Identical 0.0 65535. FORMAT "%5.0" /end CHARACTERISTIC
/begin CHARACTERISTIC Com_tiENGT_TxTxPerd_C "Calibration parameter to control Tx Ipdu periodic factor for ENGT_Tx" VALUE 0x804D8504 DefaultValueRecordLayout_AUTOSAR_Platform_BaseTypes_uint16 65535.0 RB_RBA_Common_CentralElements_CompuMethods_Identical 0.0 65535. FORMAT "%5.0" /end CHARACTERISTIC
/begin CHARACTERISTIC Com_tiENGU_TxTxPerd_C "Calibration parameter to control Tx Ipdu periodic factor for ENGU_Tx" VALUE 0x804D8502 DefaultValueRecordLayout_AUTOSAR_Platform_BaseTypes_uint16 65535.0 RB_RBA_Common_CentralElements_CompuMethods_Identical 0.0 65535. FORMAT "%5.0" /end CHARACTERISTIC
/begin CHARACTERISTIC Com_tiENGV_TxTxPerd_C "Calibration parameter to control Tx Ipdu periodic factor for ENGV_Tx" VALUE 0x804D8500 DefaultValueRecordLayout_AUTOSAR_Platform_BaseTypes_uint16 65535.0 RB_RBA_Common_CentralElements_CompuMethods_Identical 0.0 65535. FORMAT "%5.0" /end CHARACTERISTIC
/begin CHARACTERISTIC Com_tiENGW_TxTxPerd_C "Calibration parameter to control Tx Ipdu periodic factor for ENGW_Tx" VALUE 0x804D84FE DefaultValueRecordLayout_AUTOSAR_Platform_BaseTypes_uint16 65535.0 RB_RBA_Common_CentralElements_CompuMethods_Identical 0.0 65535. FORMAT "%5.0" /end CHARACTERISTIC
/begin CHARACTERISTIC Com_tiENGX2_TxTxPerd_C "Calibration parameter to control Tx Ipdu periodic factor for ENGX2_Tx" VALUE 0x804D84FC DefaultValueRecordLayout_AUTOSAR_Platform_BaseTypes_uint16 65535.0 RB_RBA_Common_CentralElements_CompuMethods_Identical 0.0 65535. FORMAT "%5.0" /end CHARACTERISTIC
/begin CHARACTERISTIC Com_tiENGY2_TxTxPerd_C "Calibration parameter to control Tx Ipdu periodic factor for ENGY2_Tx" VALUE 0x804D84FA DefaultValueRecordLayout_AUTOSAR_Platform_BaseTypes_uint16 65535.0 RB_RBA_Common_CentralElements_CompuMethods_Identical 0.0 65535. FORMAT "%5.0" /end CHARACTERISTIC
/begin CHARACTERISTIC Com_tiENGY_TxTxPerd_C "Calibration parameter to control Tx Ipdu periodic factor for ENGY_Tx" VALUE 0x804D84F8 DefaultValueRecordLayout_AUTOSAR_Platform_BaseTypes_uint16 65535.0 RB_RBA_Common_CentralElements_CompuMethods_Identical 0.0 65535. FORMAT "%5.0" /end CHARACTERISTIC
/begin CHARACTERISTIC Com_tiENGZ_TxTxPerd_C "Calibration parameter to control Tx Ipdu periodic factor for ENGZ_Tx" VALUE 0x804D84F6 DefaultValueRecordLayout_AUTOSAR_Platform_BaseTypes_uint16 65535.0 RB_RBA_Common_CentralElements_CompuMethods_Identical 0.0 65535. FORMAT "%5.0" /end CHARACTERISTIC
/begin CHARACTERISTIC Com_tiEPB2_RxRxTout_C "Calibration parameter to control Rx Ipdu Timeout for EPB2_Rx" VALUE 0x804D84F4 DefaultValueRecordLayout_AUTOSAR_Platform_BaseTypes_uint16 65535.0 RB_RBA_Common_CentralElements_CompuMethods_Identical 0.0 65535. FORMAT "%5.0" /end CHARACTERISTIC
/begin CHARACTERISTIC Com_tiEPBB_RxRxTout_C "Calibration parameter to control Rx Ipdu Timeout for EPBB_Rx" VALUE 0x804D84F2 DefaultValueRecordLayout_AUTOSAR_Platform_BaseTypes_uint16 65535.0 RB_RBA_Common_CentralElements_CompuMethods_Identical 0.0 65535. FORMAT "%5.0" /end CHARACTERISTIC
/begin CHARACTERISTIC Com_tiEPS1_RxRxTout_C "Calibration parameter to control Rx Ipdu Timeout for EPS1_Rx" VALUE 0x804D84F0 DefaultValueRecordLayout_AUTOSAR_Platform_BaseTypes_uint16 65535.0 RB_RBA_Common_CentralElements_CompuMethods_Identical 0.0 65535. FORMAT "%5.0" /end CHARACTERISTIC
/begin CHARACTERISTIC Com_tiGWIMG1_RxRxTout_C "Calibration parameter to control Rx Ipdu Timeout for GWIMG1_Rx" VALUE 0x804D84EE DefaultValueRecordLayout_AUTOSAR_Platform_BaseTypes_uint16 65535.0 RB_RBA_Common_CentralElements_CompuMethods_Identical 0.0 65535. FORMAT "%5.0" /end CHARACTERISTIC
/begin CHARACTERISTIC Com_tiGWIMG3_RxRxTout_C "Calibration parameter to control Rx Ipdu Timeout for GWIMG3_Rx" VALUE 0x804D84EC DefaultValueRecordLayout_AUTOSAR_Platform_BaseTypes_uint16 65535.0 RB_RBA_Common_CentralElements_CompuMethods_Identical 0.0 65535. FORMAT "%5.0" /end CHARACTERISTIC
/begin CHARACTERISTIC Com_tiGWIMG4_RxRxTout_C "Calibration parameter to control Rx Ipdu Timeout for GWIMG4_Rx" VALUE 0x804D84EA DefaultValueRecordLayout_AUTOSAR_Platform_BaseTypes_uint16 65535.0 RB_RBA_Common_CentralElements_CompuMethods_Identical 0.0 65535. FORMAT "%5.0" /end CHARACTERISTIC
/begin CHARACTERISTIC Com_tiGWIMG5_RxRxTout_C "Calibration parameter to control Rx Ipdu Timeout for GWIMG5_Rx" VALUE 0x804D84E8 DefaultValueRecordLayout_AUTOSAR_Platform_BaseTypes_uint16 65535.0 RB_RBA_Common_CentralElements_CompuMethods_Identical 0.0 65535. FORMAT "%5.0" /end CHARACTERISTIC
/begin CHARACTERISTIC Com_tiGWIMG6_RxRxTout_C "Calibration parameter to control Rx Ipdu Timeout for GWIMG6_Rx" VALUE 0x804D84E6 DefaultValueRecordLayout_AUTOSAR_Platform_BaseTypes_uint16 65535.0 RB_RBA_Common_CentralElements_CompuMethods_Identical 0.0 65535. FORMAT "%5.0" /end CHARACTERISTIC
/begin CHARACTERISTIC Com_tiIDASB_RxRxTout_C "Calibration parameter to control Rx Ipdu Timeout for IDASB_Rx" VALUE 0x804D84E4 DefaultValueRecordLayout_AUTOSAR_Platform_BaseTypes_uint16 65535.0 RB_RBA_Common_CentralElements_CompuMethods_Identical 0.0 65535. FORMAT "%5.0" /end CHARACTERISTIC
/begin CHARACTERISTIC Com_tiLin_Alt_Rx_ACG_INFO_B_RxRxTout_C "Calibration parameter to control Rx Ipdu Timeout for Lin_Alt_Rx_ACG_INFO_B_Rx" VALUE 0x804D84E2 DefaultValueRecordLayout_AUTOSAR_Platform_BaseTypes_uint16 65535.0 RB_RBA_Common_CentralElements_CompuMethods_Identical 0.0 65535. FORMAT "%5.0" /end CHARACTERISTIC
/begin CHARACTERISTIC Com_tiLin_BS_Rx_EBSA_RxRxTout_C "Calibration parameter to control Rx Ipdu Timeout for Lin_BS_Rx_EBSA_Rx" VALUE 0x804D84E0 DefaultValueRecordLayout_AUTOSAR_Platform_BaseTypes_uint16 65535.0 RB_RBA_Common_CentralElements_CompuMethods_Identical 0.0 65535. FORMAT "%5.0" /end CHARACTERISTIC
/begin CHARACTERISTIC Com_tiLin_BS_Rx_EBSB_RxRxTout_C "Calibration parameter to control Rx Ipdu Timeout for Lin_BS_Rx_EBSB_Rx" VALUE 0x804D84DE DefaultValueRecordLayout_AUTOSAR_Platform_BaseTypes_uint16 65535.0 RB_RBA_Common_CentralElements_CompuMethods_Identical 0.0 65535. FORMAT "%5.0" /end CHARACTERISTIC
/begin CHARACTERISTIC Com_tiLin_BS_Rx_EBSC_RxRxTout_C "Calibration parameter to control Rx Ipdu Timeout for Lin_BS_Rx_EBSC_Rx" VALUE 0x804D84DC DefaultValueRecordLayout_AUTOSAR_Platform_BaseTypes_uint16 65535.0 RB_RBA_Common_CentralElements_CompuMethods_Identical 0.0 65535. FORMAT "%5.0" /end CHARACTERISTIC
/begin CHARACTERISTIC Com_tiLin_BS_Rx_EBSD_RxRxTout_C "Calibration parameter to control Rx Ipdu Timeout for Lin_BS_Rx_EBSD_Rx" VALUE 0x804D84DA DefaultValueRecordLayout_AUTOSAR_Platform_BaseTypes_uint16 65535.0 RB_RBA_Common_CentralElements_CompuMethods_Identical 0.0 65535. FORMAT "%5.0" /end CHARACTERISTIC
/begin CHARACTERISTIC Com_tiLin_BS_Rx_EBSE_RxRxTout_C "Calibration parameter to control Rx Ipdu Timeout for Lin_BS_Rx_EBSE_Rx" VALUE 0x804D84D8 DefaultValueRecordLayout_AUTOSAR_Platform_BaseTypes_uint16 65535.0 RB_RBA_Common_CentralElements_CompuMethods_Identical 0.0 65535. FORMAT "%5.0" /end CHARACTERISTIC
/begin CHARACTERISTIC Com_tiLin_BS_Rx_EBSF_RxRxTout_C "Calibration parameter to control Rx Ipdu Timeout for Lin_BS_Rx_EBSF_Rx" VALUE 0x804D84D6 DefaultValueRecordLayout_AUTOSAR_Platform_BaseTypes_uint16 65535.0 RB_RBA_Common_CentralElements_CompuMethods_Identical 0.0 65535. FORMAT "%5.0" /end CHARACTERISTIC
/begin CHARACTERISTIC Com_tiMETA_RxRxTout_C "Calibration parameter to control Rx Ipdu Timeout for META_Rx" VALUE 0x804D84D4 DefaultValueRecordLayout_AUTOSAR_Platform_BaseTypes_uint16 65535.0 RB_RBA_Common_CentralElements_CompuMethods_Identical 0.0 65535. FORMAT "%5.0" /end CHARACTERISTIC
/begin CHARACTERISTIC Com_tiMETC_RxRxTout_C "Calibration parameter to control Rx Ipdu Timeout for METC_Rx" VALUE 0x804D84D2 DefaultValueRecordLayout_AUTOSAR_Platform_BaseTypes_uint16 65535.0 RB_RBA_Common_CentralElements_CompuMethods_Identical 0.0 65535. FORMAT "%5.0" /end CHARACTERISTIC
/begin CHARACTERISTIC Com_tiMETD2_RxRxTout_C "Calibration parameter to control Rx Ipdu Timeout for METD2_Rx" VALUE 0x804D84D0 DefaultValueRecordLayout_AUTOSAR_Platform_BaseTypes_uint16 65535.0 RB_RBA_Common_CentralElements_CompuMethods_Identical 0.0 65535. FORMAT "%5.0" /end CHARACTERISTIC
/begin CHARACTERISTIC Com_tiMETD_RxRxTout_C "Calibration parameter to control Rx Ipdu Timeout for METD_Rx" VALUE 0x804D84CE DefaultValueRecordLayout_AUTOSAR_Platform_BaseTypes_uint16 65535.0 RB_RBA_Common_CentralElements_CompuMethods_Identical 0.0 65535. FORMAT "%5.0" /end CHARACTERISTIC
/begin CHARACTERISTIC Com_tiMETE2_RxRxTout_C "Calibration parameter to control Rx Ipdu Timeout for METE2_Rx" VALUE 0x804D84CC DefaultValueRecordLayout_AUTOSAR_Platform_BaseTypes_uint16 65535.0 RB_RBA_Common_CentralElements_CompuMethods_Identical 0.0 65535. FORMAT "%5.0" /end CHARACTERISTIC
/begin CHARACTERISTIC Com_tiMETF_RxRxTout_C "Calibration parameter to control Rx Ipdu Timeout for METF_Rx" VALUE 0x804D84CA DefaultValueRecordLayout_AUTOSAR_Platform_BaseTypes_uint16 65535.0 RB_RBA_Common_CentralElements_CompuMethods_Identical 0.0 65535. FORMAT "%5.0" /end CHARACTERISTIC
/begin CHARACTERISTIC Com_tiMETG2_RxRxTout_C "Calibration parameter to control Rx Ipdu Timeout for METG2_Rx" VALUE 0x804D84C8 DefaultValueRecordLayout_AUTOSAR_Platform_BaseTypes_uint16 65535.0 RB_RBA_Common_CentralElements_CompuMethods_Identical 0.0 65535. FORMAT "%5.0" /end CHARACTERISTIC
/begin CHARACTERISTIC Com_tiMETG_RxRxTout_C "Calibration parameter to control Rx Ipdu Timeout for METG_Rx" VALUE 0x804D84C6 DefaultValueRecordLayout_AUTOSAR_Platform_BaseTypes_uint16 65535.0 RB_RBA_Common_CentralElements_CompuMethods_Identical 0.0 65535. FORMAT "%5.0" /end CHARACTERISTIC
/begin CHARACTERISTIC Com_tiMETH2_RxRxTout_C "Calibration parameter to control Rx Ipdu Timeout for METH2_Rx" VALUE 0x804D84C4 DefaultValueRecordLayout_AUTOSAR_Platform_BaseTypes_uint16 65535.0 RB_RBA_Common_CentralElements_CompuMethods_Identical 0.0 65535. FORMAT "%5.0" /end CHARACTERISTIC
/begin CHARACTERISTIC Com_tiMETH_RxRxTout_C "Calibration parameter to control Rx Ipdu Timeout for METH_Rx" VALUE 0x804D84C2 DefaultValueRecordLayout_AUTOSAR_Platform_BaseTypes_uint16 65535.0 RB_RBA_Common_CentralElements_CompuMethods_Identical 0.0 65535. FORMAT "%5.0" /end CHARACTERISTIC
/begin CHARACTERISTIC Com_tiMETI_RxRxTout_C "Calibration parameter to control Rx Ipdu Timeout for METI_Rx" VALUE 0x804D84C0 DefaultValueRecordLayout_AUTOSAR_Platform_BaseTypes_uint16 65535.0 RB_RBA_Common_CentralElements_CompuMethods_Identical 0.0 65535. FORMAT "%5.0" /end CHARACTERISTIC
/begin CHARACTERISTIC Com_tiMETK_RxRxTout_C "Calibration parameter to control Rx Ipdu Timeout for METK_Rx" VALUE 0x804D84BE DefaultValueRecordLayout_AUTOSAR_Platform_BaseTypes_uint16 65535.0 RB_RBA_Common_CentralElements_CompuMethods_Identical 0.0 65535. FORMAT "%5.0" /end CHARACTERISTIC
/begin CHARACTERISTIC Com_tiMETL_RxRxTout_C "Calibration parameter to control Rx Ipdu Timeout for METL_Rx" VALUE 0x804D84BC DefaultValueRecordLayout_AUTOSAR_Platform_BaseTypes_uint16 65535.0 RB_RBA_Common_CentralElements_CompuMethods_Identical 0.0 65535. FORMAT "%5.0" /end CHARACTERISTIC
/begin CHARACTERISTIC Com_tiMETM_RxRxTout_C "Calibration parameter to control Rx Ipdu Timeout for METM_Rx" VALUE 0x804D84BA DefaultValueRecordLayout_AUTOSAR_Platform_BaseTypes_uint16 65535.0 RB_RBA_Common_CentralElements_CompuMethods_Identical 0.0 65535. FORMAT "%5.0" /end CHARACTERISTIC
/begin CHARACTERISTIC Com_tiMETN_RxRxTout_C "Calibration parameter to control Rx Ipdu Timeout for METN_Rx" VALUE 0x804D84B8 DefaultValueRecordLayout_AUTOSAR_Platform_BaseTypes_uint16 65535.0 RB_RBA_Common_CentralElements_CompuMethods_Identical 0.0 65535. FORMAT "%5.0" /end CHARACTERISTIC
/begin CHARACTERISTIC Com_tiPCU_RxRxTout_C "Calibration parameter to control Rx Ipdu Timeout for PCU_Rx" VALUE 0x804D84B6 DefaultValueRecordLayout_AUTOSAR_Platform_BaseTypes_uint16 65535.0 RB_RBA_Common_CentralElements_CompuMethods_Identical 0.0 65535. FORMAT "%5.0" /end CHARACTERISTIC
/begin CHARACTERISTIC Com_tiSRSA_RxRxTout_C "Calibration parameter to control Rx Ipdu Timeout for SRSA_Rx" VALUE 0x804D84B4 DefaultValueRecordLayout_AUTOSAR_Platform_BaseTypes_uint16 65535.0 RB_RBA_Common_CentralElements_CompuMethods_Identical 0.0 65535. FORMAT "%5.0" /end CHARACTERISTIC
/begin CHARACTERISTIC Com_tiSRSB_RxRxTout_C "Calibration parameter to control Rx Ipdu Timeout for SRSB_Rx" VALUE 0x804D84B2 DefaultValueRecordLayout_AUTOSAR_Platform_BaseTypes_uint16 65535.0 RB_RBA_Common_CentralElements_CompuMethods_Identical 0.0 65535. FORMAT "%5.0" /end CHARACTERISTIC
/begin CHARACTERISTIC Com_tiSRS_RxRxTout_C "Calibration parameter to control Rx Ipdu Timeout for SRS_Rx" VALUE 0x804D84B0 DefaultValueRecordLayout_AUTOSAR_Platform_BaseTypes_uint16 65535.0 RB_RBA_Common_CentralElements_CompuMethods_Identical 0.0 65535. FORMAT "%5.0" /end CHARACTERISTIC
/begin CHARACTERISTIC Com_tieng1_TxTxPerd_C "Calibration parameter to control Tx Ipdu periodic factor for eng1_Tx" VALUE 0x804D84AE DefaultValueRecordLayout_AUTOSAR_Platform_BaseTypes_uint16 65535.0 RB_RBA_Common_CentralElements_CompuMethods_Identical 0.0 65535. FORMAT "%5.0" /end CHARACTERISTIC
/begin CHARACTERISTIC Com_tiengo_TxTxPerd_C "Calibration parameter to control Tx Ipdu periodic factor for engo_Tx" VALUE 0x804D84AC DefaultValueRecordLayout_AUTOSAR_Platform_BaseTypes_uint16 65535.0 RB_RBA_Common_CentralElements_CompuMethods_Identical 0.0 65535. FORMAT "%5.0" /end CHARACTERISTIC
/begin CHARACTERISTIC Can_CanHwObject_AYCA_RXCanId_C "Calibration parameter for Can-Id of Message CanHwObject_AYCA_RX" VALUE 0x804D83DC DefaultValueRecordLayout_AUTOSAR_Platform_BaseTypes_uint32 2047.0 RB_RBA_Common_CentralElements_CompuMethods_Identical 0.0 2047. FORMAT "%5.0" /end CHARACTERISTIC
/begin CHARACTERISTIC Can_CanHwObject_AYCA_RXCanNod_C "Calibration parameter to calibrate Message CanHwObject_AYCA_RX on different Can Node." VALUE 0x804D85F2 DefaultValueRecordLayout_AUTOSAR_Platform_BaseTypes_uint8 2.0 Mcan_Can_CompuMethods_Can_CompuMethod_CtrlId 0.0 2. FORMAT "%5.0" /end CHARACTERISTIC
/begin CHARACTERISTIC Can_CanHwObject_AYCD_RXCanId_C "Calibration parameter for Can-Id of Message CanHwObject_AYCD_RX" VALUE 0x804D83D8 DefaultValueRecordLayout_AUTOSAR_Platform_BaseTypes_uint32 2047.0 RB_RBA_Common_CentralElements_CompuMethods_Identical 0.0 2047. FORMAT "%5.0" /end CHARACTERISTIC
/begin CHARACTERISTIC Can_CanHwObject_AYCD_RXCanNod_C "Calibration parameter to calibrate Message CanHwObject_AYCD_RX on different Can Node." VALUE 0x804D85F1 DefaultValueRecordLayout_AUTOSAR_Platform_BaseTypes_uint8 2.0 Mcan_Can_CompuMethods_Can_CompuMethod_CtrlId 0.0 2. FORMAT "%5.0" /end CHARACTERISTIC
/begin CHARACTERISTIC Can_CanHwObject_AYCF_RXCanId_C "Calibration parameter for Can-Id of Message CanHwObject_AYCF_RX" VALUE 0x804D83D4 DefaultValueRecordLayout_AUTOSAR_Platform_BaseTypes_uint32 2047.0 RB_RBA_Common_CentralElements_CompuMethods_Identical 0.0 2047. FORMAT "%5.0" /end CHARACTERISTIC
/begin CHARACTERISTIC Can_CanHwObject_AYCF_RXCanNod_C "Calibration parameter to calibrate Message CanHwObject_AYCF_RX on different Can Node." VALUE 0x804D85F0 DefaultValueRecordLayout_AUTOSAR_Platform_BaseTypes_uint8 2.0 Mcan_Can_CompuMethods_Can_CompuMethod_CtrlId 0.0 2. FORMAT "%5.0" /end CHARACTERISTIC
/begin CHARACTERISTIC Can_CanHwObject_AYCG_RXCanId_C "Calibration parameter for Can-Id of Message CanHwObject_AYCG_RX" VALUE 0x804D83D0 DefaultValueRecordLayout_AUTOSAR_Platform_BaseTypes_uint32 2047.0 RB_RBA_Common_CentralElements_CompuMethods_Identical 0.0 2047. FORMAT "%5.0" /end CHARACTERISTIC
/begin CHARACTERISTIC Can_CanHwObject_AYCG_RXCanNod_C "Calibration parameter to calibrate Message CanHwObject_AYCG_RX on different Can Node." VALUE 0x804D85EF DefaultValueRecordLayout_AUTOSAR_Platform_BaseTypes_uint8 2.0 Mcan_Can_CompuMethods_Can_CompuMethod_CtrlId 0.0 2. FORMAT "%5.0" /end CHARACTERISTIC
/begin CHARACTERISTIC Can_CanHwObject_AYCI_RXCanId_C "Calibration parameter for Can-Id of Message CanHwObject_AYCI_RX" VALUE 0x804D83CC DefaultValueRecordLayout_AUTOSAR_Platform_BaseTypes_uint32 2047.0 RB_RBA_Common_CentralElements_CompuMethods_Identical 0.0 2047. FORMAT "%5.0" /end CHARACTERISTIC
/begin CHARACTERISTIC Can_CanHwObject_AYCI_RXCanNod_C "Calibration parameter to calibrate Message CanHwObject_AYCI_RX on different Can Node." VALUE 0x804D85EE DefaultValueRecordLayout_AUTOSAR_Platform_BaseTypes_uint8 2.0 Mcan_Can_CompuMethods_Can_CompuMethod_CtrlId 0.0 2. FORMAT "%5.0" /end CHARACTERISTIC
/begin CHARACTERISTIC Can_CanHwObject_BCM1_RXCanId_C "Calibration parameter for Can-Id of Message CanHwObject_BCM1_RX" VALUE 0x804D83C8 DefaultValueRecordLayout_AUTOSAR_Platform_BaseTypes_uint32 2047.0 RB_RBA_Common_CentralElements_CompuMethods_Identical 0.0 2047. FORMAT "%5.0" /end CHARACTERISTIC
/begin CHARACTERISTIC Can_CanHwObject_BCM1_RXCanNod_C "Calibration parameter to calibrate Message CanHwObject_BCM1_RX on different Can Node." VALUE 0x804D85ED DefaultValueRecordLayout_AUTOSAR_Platform_BaseTypes_uint8 2.0 Mcan_Can_CompuMethods_Can_CompuMethod_CtrlId 0.0 2. FORMAT "%5.0" /end CHARACTERISTIC
/begin CHARACTERISTIC Can_CanHwObject_CGW1_RXCanId_C "Calibration parameter for Can-Id of Message CanHwObject_CGW1_RX" VALUE 0x804D83C4 DefaultValueRecordLayout_AUTOSAR_Platform_BaseTypes_uint32 2047.0 RB_RBA_Common_CentralElements_CompuMethods_Identical 0.0 2047. FORMAT "%5.0" /end CHARACTERISTIC
/begin CHARACTERISTIC Can_CanHwObject_CGW1_RXCanNod_C "Calibration parameter to calibrate Message CanHwObject_CGW1_RX on different Can Node." VALUE 0x804D85EC DefaultValueRecordLayout_AUTOSAR_Platform_BaseTypes_uint8 2.0 Mcan_Can_CompuMethods_Can_CompuMethod_CtrlId 0.0 2. FORMAT "%5.0" /end CHARACTERISTIC
/begin CHARACTERISTIC Can_CanHwObject_EAT10_RXCanId_C "Calibration parameter for Can-Id of Message CanHwObject_EAT10_RX" VALUE 0x804D83C0 DefaultValueRecordLayout_AUTOSAR_Platform_BaseTypes_uint32 2047.0 RB_RBA_Common_CentralElements_CompuMethods_Identical 0.0 2047. FORMAT "%5.0" /end CHARACTERISTIC
/begin CHARACTERISTIC Can_CanHwObject_EAT10_RXCanNod_C "Calibration parameter to calibrate Message CanHwObject_EAT10_RX on different Can Node." VALUE 0x804D85EB DefaultValueRecordLayout_AUTOSAR_Platform_BaseTypes_uint8 2.0 Mcan_Can_CompuMethods_Can_CompuMethod_CtrlId 0.0 2. FORMAT "%5.0" /end CHARACTERISTIC
/begin CHARACTERISTIC Can_CanHwObject_EAT11_RXCanId_C "Calibration parameter for Can-Id of Message CanHwObject_EAT11_RX" VALUE 0x804D83BC DefaultValueRecordLayout_AUTOSAR_Platform_BaseTypes_uint32 2047.0 RB_RBA_Common_CentralElements_CompuMethods_Identical 0.0 2047. FORMAT "%5.0" /end CHARACTERISTIC
/begin CHARACTERISTIC Can_CanHwObject_EAT11_RXCanNod_C "Calibration parameter to calibrate Message CanHwObject_EAT11_RX on different Can Node." VALUE 0x804D85EA DefaultValueRecordLayout_AUTOSAR_Platform_BaseTypes_uint8 2.0 Mcan_Can_CompuMethods_Can_CompuMethod_CtrlId 0.0 2. FORMAT "%5.0" /end CHARACTERISTIC
/begin CHARACTERISTIC Can_CanHwObject_EAT12_RXCanId_C "Calibration parameter for Can-Id of Message CanHwObject_EAT12_RX" VALUE 0x804D83B8 DefaultValueRecordLayout_AUTOSAR_Platform_BaseTypes_uint32 2047.0 RB_RBA_Common_CentralElements_CompuMethods_Identical 0.0 2047. FORMAT "%5.0" /end CHARACTERISTIC
/begin CHARACTERISTIC Can_CanHwObject_EAT12_RXCanNod_C "Calibration parameter to calibrate Message CanHwObject_EAT12_RX on different Can Node." VALUE 0x804D85E9 DefaultValueRecordLayout_AUTOSAR_Platform_BaseTypes_uint8 2.0 Mcan_Can_CompuMethods_Can_CompuMethod_CtrlId 0.0 2. FORMAT "%5.0" /end CHARACTERISTIC
/begin CHARACTERISTIC Can_CanHwObject_EAT13_RXCanId_C "Calibration parameter for Can-Id of Message CanHwObject_EAT13_RX" VALUE 0x804D83B4 DefaultValueRecordLayout_AUTOSAR_Platform_BaseTypes_uint32 2047.0 RB_RBA_Common_CentralElements_CompuMethods_Identical 0.0 2047. FORMAT "%5.0" /end CHARACTERISTIC
/begin CHARACTERISTIC Can_CanHwObject_EAT13_RXCanNod_C "Calibration parameter to calibrate Message CanHwObject_EAT13_RX on different Can Node." VALUE 0x804D85E8 DefaultValueRecordLayout_AUTOSAR_Platform_BaseTypes_uint8 2.0 Mcan_Can_CompuMethods_Can_CompuMethod_CtrlId 0.0 2. FORMAT "%5.0" /end CHARACTERISTIC
/begin CHARACTERISTIC Can_CanHwObject_EAT1_RXCanId_C "Calibration parameter for Can-Id of Message CanHwObject_EAT1_RX" VALUE 0x804D83B0 DefaultValueRecordLayout_AUTOSAR_Platform_BaseTypes_uint32 2047.0 RB_RBA_Common_CentralElements_CompuMethods_Identical 0.0 2047. FORMAT "%5.0" /end CHARACTERISTIC
/begin CHARACTERISTIC Can_CanHwObject_EAT1_RXCanNod_C "Calibration parameter to calibrate Message CanHwObject_EAT1_RX on different Can Node." VALUE 0x804D85E7 DefaultValueRecordLayout_AUTOSAR_Platform_BaseTypes_uint8 2.0 Mcan_Can_CompuMethods_Can_CompuMethod_CtrlId 0.0 2. FORMAT "%5.0" /end CHARACTERISTIC
/begin CHARACTERISTIC Can_CanHwObject_EAT2_RXCanId_C "Calibration parameter for Can-Id of Message CanHwObject_EAT2_RX" VALUE 0x804D83AC DefaultValueRecordLayout_AUTOSAR_Platform_BaseTypes_uint32 2047.0 RB_RBA_Common_CentralElements_CompuMethods_Identical 0.0 2047. FORMAT "%5.0" /end CHARACTERISTIC
/begin CHARACTERISTIC Can_CanHwObject_EAT2_RXCanNod_C "Calibration parameter to calibrate Message CanHwObject_EAT2_RX on different Can Node." VALUE 0x804D85E6 DefaultValueRecordLayout_AUTOSAR_Platform_BaseTypes_uint8 2.0 Mcan_Can_CompuMethods_Can_CompuMethod_CtrlId 0.0 2. FORMAT "%5.0" /end CHARACTERISTIC
/begin CHARACTERISTIC Can_CanHwObject_EAT4_RXCanId_C "Calibration parameter for Can-Id of Message CanHwObject_EAT4_RX" VALUE 0x804D83A8 DefaultValueRecordLayout_AUTOSAR_Platform_BaseTypes_uint32 2047.0 RB_RBA_Common_CentralElements_CompuMethods_Identical 0.0 2047. FORMAT "%5.0" /end CHARACTERISTIC
/begin CHARACTERISTIC Can_CanHwObject_EAT4_RXCanNod_C "Calibration parameter to calibrate Message CanHwObject_EAT4_RX on different Can Node." VALUE 0x804D85E5 DefaultValueRecordLayout_AUTOSAR_Platform_BaseTypes_uint8 2.0 Mcan_Can_CompuMethods_Can_CompuMethod_CtrlId 0.0 2. FORMAT "%5.0" /end CHARACTERISTIC
/begin CHARACTERISTIC Can_CanHwObject_EAT6_RXCanId_C "Calibration parameter for Can-Id of Message CanHwObject_EAT6_RX" VALUE 0x804D83A4 DefaultValueRecordLayout_AUTOSAR_Platform_BaseTypes_uint32 2047.0 RB_RBA_Common_CentralElements_CompuMethods_Identical 0.0 2047. FORMAT "%5.0" /end CHARACTERISTIC
/begin CHARACTERISTIC Can_CanHwObject_EAT6_RXCanNod_C "Calibration parameter to calibrate Message CanHwObject_EAT6_RX on different Can Node." VALUE 0x804D85E4 DefaultValueRecordLayout_AUTOSAR_Platform_BaseTypes_uint8 2.0 Mcan_Can_CompuMethods_Can_CompuMethod_CtrlId 0.0 2. FORMAT "%5.0" /end CHARACTERISTIC
/begin CHARACTERISTIC Can_CanHwObject_EAT7_RXCanId_C "Calibration parameter for Can-Id of Message CanHwObject_EAT7_RX" VALUE 0x804D83A0 DefaultValueRecordLayout_AUTOSAR_Platform_BaseTypes_uint32 2047.0 RB_RBA_Common_CentralElements_CompuMethods_Identical 0.0 2047. FORMAT "%5.0" /end CHARACTERISTIC
/begin CHARACTERISTIC Can_CanHwObject_EAT7_RXCanNod_C "Calibration parameter to calibrate Message CanHwObject_EAT7_RX on different Can Node." VALUE 0x804D85E3 DefaultValueRecordLayout_AUTOSAR_Platform_BaseTypes_uint8 2.0 Mcan_Can_CompuMethods_Can_CompuMethod_CtrlId 0.0 2. FORMAT "%5.0" /end CHARACTERISTIC
/begin CHARACTERISTIC Can_CanHwObject_EAT8_RXCanId_C "Calibration parameter for Can-Id of Message CanHwObject_EAT8_RX" VALUE 0x804D839C DefaultValueRecordLayout_AUTOSAR_Platform_BaseTypes_uint32 2047.0 RB_RBA_Common_CentralElements_CompuMethods_Identical 0.0 2047. FORMAT "%5.0" /end CHARACTERISTIC
/begin CHARACTERISTIC Can_CanHwObject_EAT8_RXCanNod_C "Calibration parameter to calibrate Message CanHwObject_EAT8_RX on different Can Node." VALUE 0x804D85E2 DefaultValueRecordLayout_AUTOSAR_Platform_BaseTypes_uint8 2.0 Mcan_Can_CompuMethods_Can_CompuMethod_CtrlId 0.0 2. FORMAT "%5.0" /end CHARACTERISTIC
/begin CHARACTERISTIC Can_CanHwObject_EATA_RXCanId_C "Calibration parameter for Can-Id of Message CanHwObject_EATA_RX" VALUE 0x804D8398 DefaultValueRecordLayout_AUTOSAR_Platform_BaseTypes_uint32 2047.0 RB_RBA_Common_CentralElements_CompuMethods_Identical 0.0 2047. FORMAT "%5.0" /end CHARACTERISTIC
/begin CHARACTERISTIC Can_CanHwObject_EATA_RXCanNod_C "Calibration parameter to calibrate Message CanHwObject_EATA_RX on different Can Node." VALUE 0x804D85E1 DefaultValueRecordLayout_AUTOSAR_Platform_BaseTypes_uint8 2.0 Mcan_Can_CompuMethods_Can_CompuMethod_CtrlId 0.0 2. FORMAT "%5.0" /end CHARACTERISTIC
/begin CHARACTERISTIC Can_CanHwObject_EATB_RXCanId_C "Calibration parameter for Can-Id of Message CanHwObject_EATB_RX" VALUE 0x804D8394 DefaultValueRecordLayout_AUTOSAR_Platform_BaseTypes_uint32 2047.0 RB_RBA_Common_CentralElements_CompuMethods_Identical 0.0 2047. FORMAT "%5.0" /end CHARACTERISTIC
/begin CHARACTERISTIC Can_CanHwObject_EATB_RXCanNod_C "Calibration parameter to calibrate Message CanHwObject_EATB_RX on different Can Node." VALUE 0x804D85E0 DefaultValueRecordLayout_AUTOSAR_Platform_BaseTypes_uint8 2.0 Mcan_Can_CompuMethods_Can_CompuMethod_CtrlId 0.0 2. FORMAT "%5.0" /end CHARACTERISTIC
/begin CHARACTERISTIC Can_CanHwObject_EATC_RXCanId_C "Calibration parameter for Can-Id of Message CanHwObject_EATC_RX" VALUE 0x804D8390 DefaultValueRecordLayout_AUTOSAR_Platform_BaseTypes_uint32 2047.0 RB_RBA_Common_CentralElements_CompuMethods_Identical 0.0 2047. FORMAT "%5.0" /end CHARACTERISTIC
/begin CHARACTERISTIC Can_CanHwObject_EATC_RXCanNod_C "Calibration parameter to calibrate Message CanHwObject_EATC_RX on different Can Node." VALUE 0x804D85DF DefaultValueRecordLayout_AUTOSAR_Platform_BaseTypes_uint8 2.0 Mcan_Can_CompuMethods_Can_CompuMethod_CtrlId 0.0 2. FORMAT "%5.0" /end CHARACTERISTIC
/begin CHARACTERISTIC Can_CanHwObject_ENG10_TXCanNod_C "Calibration parameter to calibrate Message CanHwObject_ENG10_TX on different Can Node." VALUE 0x804D85DE DefaultValueRecordLayout_AUTOSAR_Platform_BaseTypes_uint8 2.0 Mcan_Can_CompuMethods_Can_CompuMethod_CtrlId 0.0 2. FORMAT "%5.0" /end CHARACTERISTIC
/begin CHARACTERISTIC Can_CanHwObject_ENG11_TXCanNod_C "Calibration parameter to calibrate Message CanHwObject_ENG11_TX on different Can Node." VALUE 0x804D85DD DefaultValueRecordLayout_AUTOSAR_Platform_BaseTypes_uint8 2.0 Mcan_Can_CompuMethods_Can_CompuMethod_CtrlId 0.0 2. FORMAT "%5.0" /end CHARACTERISTIC
/begin CHARACTERISTIC Can_CanHwObject_ENG15_TXCanNod_C "Calibration parameter to calibrate Message CanHwObject_ENG15_TX on different Can Node." VALUE 0x804D85DC DefaultValueRecordLayout_AUTOSAR_Platform_BaseTypes_uint8 2.0 Mcan_Can_CompuMethods_Can_CompuMethod_CtrlId 0.0 2. FORMAT "%5.0" /end CHARACTERISTIC
/begin CHARACTERISTIC Can_CanHwObject_ENG16_TXCanNod_C "Calibration parameter to calibrate Message CanHwObject_ENG16_TX on different Can Node." VALUE 0x804D85DB DefaultValueRecordLayout_AUTOSAR_Platform_BaseTypes_uint8 2.0 Mcan_Can_CompuMethods_Can_CompuMethod_CtrlId 0.0 2. FORMAT "%5.0" /end CHARACTERISTIC
/begin CHARACTERISTIC Can_CanHwObject_ENG17_TXCanNod_C "Calibration parameter to calibrate Message CanHwObject_ENG17_TX on different Can Node." VALUE 0x804D85DA DefaultValueRecordLayout_AUTOSAR_Platform_BaseTypes_uint8 2.0 Mcan_Can_CompuMethods_Can_CompuMethod_CtrlId 0.0 2. FORMAT "%5.0" /end CHARACTERISTIC
/begin CHARACTERISTIC Can_CanHwObject_ENG18_TXCanNod_C "Calibration parameter to calibrate Message CanHwObject_ENG18_TX on different Can Node." VALUE 0x804D85D9 DefaultValueRecordLayout_AUTOSAR_Platform_BaseTypes_uint8 2.0 Mcan_Can_CompuMethods_Can_CompuMethod_CtrlId 0.0 2. FORMAT "%5.0" /end CHARACTERISTIC
/begin CHARACTERISTIC Can_CanHwObject_ENG19_TXCanNod_C "Calibration parameter to calibrate Message CanHwObject_ENG19_TX on different Can Node." VALUE 0x804D85D8 DefaultValueRecordLayout_AUTOSAR_Platform_BaseTypes_uint8 2.0 Mcan_Can_CompuMethods_Can_CompuMethod_CtrlId 0.0 2. FORMAT "%5.0" /end CHARACTERISTIC
/begin CHARACTERISTIC Can_CanHwObject_ENG20_TXCanNod_C "Calibration parameter to calibrate Message CanHwObject_ENG20_TX on different Can Node." VALUE 0x804D85D7 DefaultValueRecordLayout_AUTOSAR_Platform_BaseTypes_uint8 2.0 Mcan_Can_CompuMethods_Can_CompuMethod_CtrlId 0.0 2. FORMAT "%5.0" /end CHARACTERISTIC
/begin CHARACTERISTIC Can_CanHwObject_ENG21_TXCanNod_C "Calibration parameter to calibrate Message CanHwObject_ENG21_TX on different Can Node." VALUE 0x804D85D6 DefaultValueRecordLayout_AUTOSAR_Platform_BaseTypes_uint8 2.0 Mcan_Can_CompuMethods_Can_CompuMethod_CtrlId 0.0 2. FORMAT "%5.0" /end CHARACTERISTIC
/begin CHARACTERISTIC Can_CanHwObject_ENG22_TXCanNod_C "Calibration parameter to calibrate Message CanHwObject_ENG22_TX on different Can Node." VALUE 0x804D85D5 DefaultValueRecordLayout_AUTOSAR_Platform_BaseTypes_uint8 2.0 Mcan_Can_CompuMethods_Can_CompuMethod_CtrlId 0.0 2. FORMAT "%5.0" /end CHARACTERISTIC
/begin CHARACTERISTIC Can_CanHwObject_ENG23_TXCanNod_C "Calibration parameter to calibrate Message CanHwObject_ENG23_TX on different Can Node." VALUE 0x804D85D4 DefaultValueRecordLayout_AUTOSAR_Platform_BaseTypes_uint8 2.0 Mcan_Can_CompuMethods_Can_CompuMethod_CtrlId 0.0 2. FORMAT "%5.0" /end CHARACTERISTIC
/begin CHARACTERISTIC Can_CanHwObject_ENG24_TXCanNod_C "Calibration parameter to calibrate Message CanHwObject_ENG24_TX on different Can Node." VALUE 0x804D85D3 DefaultValueRecordLayout_AUTOSAR_Platform_BaseTypes_uint8 2.0 Mcan_Can_CompuMethods_Can_CompuMethod_CtrlId 0.0 2. FORMAT "%5.0" /end CHARACTERISTIC
/begin CHARACTERISTIC Can_CanHwObject_ENG25_TXCanNod_C "Calibration parameter to calibrate Message CanHwObject_ENG25_TX on different Can Node." VALUE 0x804D85D2 DefaultValueRecordLayout_AUTOSAR_Platform_BaseTypes_uint8 2.0 Mcan_Can_CompuMethods_Can_CompuMethod_CtrlId 0.0 2. FORMAT "%5.0" /end CHARACTERISTIC
/begin CHARACTERISTIC Can_CanHwObject_ENG2_TXCanNod_C "Calibration parameter to calibrate Message CanHwObject_ENG2_TX on different Can Node." VALUE 0x804D85D1 DefaultValueRecordLayout_AUTOSAR_Platform_BaseTypes_uint8 2.0 Mcan_Can_CompuMethods_Can_CompuMethod_CtrlId 0.0 2. FORMAT "%5.0" /end CHARACTERISTIC
/begin CHARACTERISTIC Can_CanHwObject_ENG3_TXCanNod_C "Calibration parameter to calibrate Message CanHwObject_ENG3_TX on different Can Node." VALUE 0x804D85D0 DefaultValueRecordLayout_AUTOSAR_Platform_BaseTypes_uint8 2.0 Mcan_Can_CompuMethods_Can_CompuMethod_CtrlId 0.0 2. FORMAT "%5.0" /end CHARACTERISTIC
/begin CHARACTERISTIC Can_CanHwObject_ENG4_TXCanNod_C "Calibration parameter to calibrate Message CanHwObject_ENG4_TX on different Can Node." VALUE 0x804D85CF DefaultValueRecordLayout_AUTOSAR_Platform_BaseTypes_uint8 2.0 Mcan_Can_CompuMethods_Can_CompuMethod_CtrlId 0.0 2. FORMAT "%5.0" /end CHARACTERISTIC
/begin CHARACTERISTIC Can_CanHwObject_ENG5_TXCanNod_C "Calibration parameter to calibrate Message CanHwObject_ENG5_TX on different Can Node." VALUE 0x804D85CE DefaultValueRecordLayout_AUTOSAR_Platform_BaseTypes_uint8 2.0 Mcan_Can_CompuMethods_Can_CompuMethod_CtrlId 0.0 2. FORMAT "%5.0" /end CHARACTERISTIC
/begin CHARACTERISTIC Can_CanHwObject_ENG6_TXCanNod_C "Calibration parameter to calibrate Message CanHwObject_ENG6_TX on different Can Node." VALUE 0x804D85CD DefaultValueRecordLayout_AUTOSAR_Platform_BaseTypes_uint8 2.0 Mcan_Can_CompuMethods_Can_CompuMethod_CtrlId 0.0 2. FORMAT "%5.0" /end CHARACTERISTIC
/begin CHARACTERISTIC Can_CanHwObject_ENGAE_TXCanNod_C "Calibration parameter to calibrate Message CanHwObject_ENGAE_TX on different Can Node." VALUE 0x804D85CC DefaultValueRecordLayout_AUTOSAR_Platform_BaseTypes_uint8 2.0 Mcan_Can_CompuMethods_Can_CompuMethod_CtrlId 0.0 2. FORMAT "%5.0" /end CHARACTERISTIC
/begin CHARACTERISTIC Can_CanHwObject_ENGA_TXCanNod_C "Calibration parameter to calibrate Message CanHwObject_ENGA_TX on different Can Node." VALUE 0x804D85CB DefaultValueRecordLayout_AUTOSAR_Platform_BaseTypes_uint8 2.0 Mcan_Can_CompuMethods_Can_CompuMethod_CtrlId 0.0 2. FORMAT "%5.0" /end CHARACTERISTIC
/begin CHARACTERISTIC Can_CanHwObject_ENGB_TXCanNod_C "Calibration parameter to calibrate Message CanHwObject_ENGB_TX on different Can Node." VALUE 0x804D85CA DefaultValueRecordLayout_AUTOSAR_Platform_BaseTypes_uint8 2.0 Mcan_Can_CompuMethods_Can_CompuMethod_CtrlId 0.0 2. FORMAT "%5.0" /end CHARACTERISTIC
/begin CHARACTERISTIC Can_CanHwObject_ENGC_TXCanNod_C "Calibration parameter to calibrate Message CanHwObject_ENGC_TX on different Can Node." VALUE 0x804D85C9 DefaultValueRecordLayout_AUTOSAR_Platform_BaseTypes_uint8 2.0 Mcan_Can_CompuMethods_Can_CompuMethod_CtrlId 0.0 2. FORMAT "%5.0" /end CHARACTERISTIC
/begin CHARACTERISTIC Can_CanHwObject_ENGF_TXCanNod_C "Calibration parameter to calibrate Message CanHwObject_ENGF_TX on different Can Node." VALUE 0x804D85C8 DefaultValueRecordLayout_AUTOSAR_Platform_BaseTypes_uint8 2.0 Mcan_Can_CompuMethods_Can_CompuMethod_CtrlId 0.0 2. FORMAT "%5.0" /end CHARACTERISTIC
/begin CHARACTERISTIC Can_CanHwObject_ENGIMG1_TXCanNod_C "Calibration parameter to calibrate Message CanHwObject_ENGIMG1_TX on different Can Node." VALUE 0x804D85C7 DefaultValueRecordLayout_AUTOSAR_Platform_BaseTypes_uint8 2.0 Mcan_Can_CompuMethods_Can_CompuMethod_CtrlId 0.0 2. FORMAT "%5.0" /end CHARACTERISTIC
/begin CHARACTERISTIC Can_CanHwObject_ENGJ3_TXCanNod_C "Calibration parameter to calibrate Message CanHwObject_ENGJ3_TX on different Can Node." VALUE 0x804D85C6 DefaultValueRecordLayout_AUTOSAR_Platform_BaseTypes_uint8 2.0 Mcan_Can_CompuMethods_Can_CompuMethod_CtrlId 0.0 2. FORMAT "%5.0" /end CHARACTERISTIC
/begin CHARACTERISTIC Can_CanHwObject_ENGK3_TXCanNod_C "Calibration parameter to calibrate Message CanHwObject_ENGK3_TX on different Can Node." VALUE 0x804D85C5 DefaultValueRecordLayout_AUTOSAR_Platform_BaseTypes_uint8 2.0 Mcan_Can_CompuMethods_Can_CompuMethod_CtrlId 0.0 2. FORMAT "%5.0" /end CHARACTERISTIC
/begin CHARACTERISTIC Can_CanHwObject_ENGL_TXCanNod_C "Calibration parameter to calibrate Message CanHwObject_ENGL_TX on different Can Node." VALUE 0x804D85C4 DefaultValueRecordLayout_AUTOSAR_Platform_BaseTypes_uint8 2.0 Mcan_Can_CompuMethods_Can_CompuMethod_CtrlId 0.0 2. FORMAT "%5.0" /end CHARACTERISTIC
/begin CHARACTERISTIC Can_CanHwObject_ENGN_TXCanNod_C "Calibration parameter to calibrate Message CanHwObject_ENGN_TX on different Can Node." VALUE 0x804D85C3 DefaultValueRecordLayout_AUTOSAR_Platform_BaseTypes_uint8 2.0 Mcan_Can_CompuMethods_Can_CompuMethod_CtrlId 0.0 2. FORMAT "%5.0" /end CHARACTERISTIC
/begin CHARACTERISTIC Can_CanHwObject_ENGQ_TXCanNod_C "Calibration parameter to calibrate Message CanHwObject_ENGQ_TX on different Can Node." VALUE 0x804D85C2 DefaultValueRecordLayout_AUTOSAR_Platform_BaseTypes_uint8 2.0 Mcan_Can_CompuMethods_Can_CompuMethod_CtrlId 0.0 2. FORMAT "%5.0" /end CHARACTERISTIC
/begin CHARACTERISTIC Can_CanHwObject_ENGR_TXCanNod_C "Calibration parameter to calibrate Message CanHwObject_ENGR_TX on different Can Node." VALUE 0x804D85C1 DefaultValueRecordLayout_AUTOSAR_Platform_BaseTypes_uint8 2.0 Mcan_Can_CompuMethods_Can_CompuMethod_CtrlId 0.0 2. FORMAT "%5.0" /end CHARACTERISTIC
/begin CHARACTERISTIC Can_CanHwObject_ENGT1_TXCanNod_C "Calibration parameter to calibrate Message CanHwObject_ENGT1_TX on different Can Node." VALUE 0x804D85C0 DefaultValueRecordLayout_AUTOSAR_Platform_BaseTypes_uint8 2.0 Mcan_Can_CompuMethods_Can_CompuMethod_CtrlId 0.0 2. FORMAT "%5.0" /end CHARACTERISTIC
/begin CHARACTERISTIC Can_CanHwObject_ENGT2_TXCanNod_C "Calibration parameter to calibrate Message CanHwObject_ENGT2_TX on different Can Node." VALUE 0x804D85BF DefaultValueRecordLayout_AUTOSAR_Platform_BaseTypes_uint8 2.0 Mcan_Can_CompuMethods_Can_CompuMethod_CtrlId 0.0 2. FORMAT "%5.0" /end CHARACTERISTIC
/begin CHARACTERISTIC Can_CanHwObject_ENGT_TXCanNod_C "Calibration parameter to calibrate Message CanHwObject_ENGT_TX on different Can Node." VALUE 0x804D85BE DefaultValueRecordLayout_AUTOSAR_Platform_BaseTypes_uint8 2.0 Mcan_Can_CompuMethods_Can_CompuMethod_CtrlId 0.0 2. FORMAT "%5.0" /end CHARACTERISTIC
/begin CHARACTERISTIC Can_CanHwObject_ENGU_TXCanNod_C "Calibration parameter to calibrate Message CanHwObject_ENGU_TX on different Can Node." VALUE 0x804D85BD DefaultValueRecordLayout_AUTOSAR_Platform_BaseTypes_uint8 2.0 Mcan_Can_CompuMethods_Can_CompuMethod_CtrlId 0.0 2. FORMAT "%5.0" /end CHARACTERISTIC
/begin CHARACTERISTIC Can_CanHwObject_ENGV_TXCanNod_C "Calibration parameter to calibrate Message CanHwObject_ENGV_TX on different Can Node." VALUE 0x804D85BC DefaultValueRecordLayout_AUTOSAR_Platform_BaseTypes_uint8 2.0 Mcan_Can_CompuMethods_Can_CompuMethod_CtrlId 0.0 2. FORMAT "%5.0" /end CHARACTERISTIC
/begin CHARACTERISTIC Can_CanHwObject_ENGW_TXCanNod_C "Calibration parameter to calibrate Message CanHwObject_ENGW_TX on different Can Node." VALUE 0x804D85BB DefaultValueRecordLayout_AUTOSAR_Platform_BaseTypes_uint8 2.0 Mcan_Can_CompuMethods_Can_CompuMethod_CtrlId 0.0 2. FORMAT "%5.0" /end CHARACTERISTIC
/begin CHARACTERISTIC Can_CanHwObject_ENGX2_TXCanNod_C "Calibration parameter to calibrate Message CanHwObject_ENGX2_TX on different Can Node." VALUE 0x804D85BA DefaultValueRecordLayout_AUTOSAR_Platform_BaseTypes_uint8 2.0 Mcan_Can_CompuMethods_Can_CompuMethod_CtrlId 0.0 2. FORMAT "%5.0" /end CHARACTERISTIC
/begin CHARACTERISTIC Can_CanHwObject_ENGY2_TXCanNod_C "Calibration parameter to calibrate Message CanHwObject_ENGY2_TX on different Can Node." VALUE 0x804D85B9 DefaultValueRecordLayout_AUTOSAR_Platform_BaseTypes_uint8 2.0 Mcan_Can_CompuMethods_Can_CompuMethod_CtrlId 0.0 2. FORMAT "%5.0" /end CHARACTERISTIC
/begin CHARACTERISTIC Can_CanHwObject_ENGY_TXCanNod_C "Calibration parameter to calibrate Message CanHwObject_ENGY_TX on different Can Node." VALUE 0x804D85B8 DefaultValueRecordLayout_AUTOSAR_Platform_BaseTypes_uint8 2.0 Mcan_Can_CompuMethods_Can_CompuMethod_CtrlId 0.0 2. FORMAT "%5.0" /end CHARACTERISTIC
/begin CHARACTERISTIC Can_CanHwObject_ENGZ_TXCanNod_C "Calibration parameter to calibrate Message CanHwObject_ENGZ_TX on different Can Node." VALUE 0x804D85B7 DefaultValueRecordLayout_AUTOSAR_Platform_BaseTypes_uint8 2.0 Mcan_Can_CompuMethods_Can_CompuMethod_CtrlId 0.0 2. FORMAT "%5.0" /end CHARACTERISTIC
/begin CHARACTERISTIC Can_CanHwObject_EPB2_RXCanId_C "Calibration parameter for Can-Id of Message CanHwObject_EPB2_RX" VALUE 0x804D838C DefaultValueRecordLayout_AUTOSAR_Platform_BaseTypes_uint32 2047.0 RB_RBA_Common_CentralElements_CompuMethods_Identical 0.0 2047. FORMAT "%5.0" /end CHARACTERISTIC
/begin CHARACTERISTIC Can_CanHwObject_EPB2_RXCanNod_C "Calibration parameter to calibrate Message CanHwObject_EPB2_RX on different Can Node." VALUE 0x804D85B6 DefaultValueRecordLayout_AUTOSAR_Platform_BaseTypes_uint8 2.0 Mcan_Can_CompuMethods_Can_CompuMethod_CtrlId 0.0 2. FORMAT "%5.0" /end CHARACTERISTIC
/begin CHARACTERISTIC Can_CanHwObject_EPBB_RXCanId_C "Calibration parameter for Can-Id of Message CanHwObject_EPBB_RX" VALUE 0x804D8388 DefaultValueRecordLayout_AUTOSAR_Platform_BaseTypes_uint32 2047.0 RB_RBA_Common_CentralElements_CompuMethods_Identical 0.0 2047. FORMAT "%5.0" /end CHARACTERISTIC
/begin CHARACTERISTIC Can_CanHwObject_EPBB_RXCanNod_C "Calibration parameter to calibrate Message CanHwObject_EPBB_RX on different Can Node." VALUE 0x804D85B5 DefaultValueRecordLayout_AUTOSAR_Platform_BaseTypes_uint8 2.0 Mcan_Can_CompuMethods_Can_CompuMethod_CtrlId 0.0 2. FORMAT "%5.0" /end CHARACTERISTIC
/begin CHARACTERISTIC Can_CanHwObject_EPS1_RXCanId_C "Calibration parameter for Can-Id of Message CanHwObject_EPS1_RX" VALUE 0x804D8384 DefaultValueRecordLayout_AUTOSAR_Platform_BaseTypes_uint32 2047.0 RB_RBA_Common_CentralElements_CompuMethods_Identical 0.0 2047. FORMAT "%5.0" /end CHARACTERISTIC
/begin CHARACTERISTIC Can_CanHwObject_EPS1_RXCanNod_C "Calibration parameter to calibrate Message CanHwObject_EPS1_RX on different Can Node." VALUE 0x804D85B4 DefaultValueRecordLayout_AUTOSAR_Platform_BaseTypes_uint8 2.0 Mcan_Can_CompuMethods_Can_CompuMethod_CtrlId 0.0 2. FORMAT "%5.0" /end CHARACTERISTIC
/begin CHARACTERISTIC Can_CanHwObject_GWIMG1_RXCanId_C "Calibration parameter for Can-Id of Message CanHwObject_GWIMG1_RX" VALUE 0x804D8380 DefaultValueRecordLayout_AUTOSAR_Platform_BaseTypes_uint32 2047.0 RB_RBA_Common_CentralElements_CompuMethods_Identical 0.0 2047. FORMAT "%5.0" /end CHARACTERISTIC
/begin CHARACTERISTIC Can_CanHwObject_GWIMG1_RXCanNod_C "Calibration parameter to calibrate Message CanHwObject_GWIMG1_RX on different Can Node." VALUE 0x804D85B3 DefaultValueRecordLayout_AUTOSAR_Platform_BaseTypes_uint8 2.0 Mcan_Can_CompuMethods_Can_CompuMethod_CtrlId 0.0 2. FORMAT "%5.0" /end CHARACTERISTIC
/begin CHARACTERISTIC Can_CanHwObject_GWIMG3_RXCanId_C "Calibration parameter for Can-Id of Message CanHwObject_GWIMG3_RX" VALUE 0x804D837C DefaultValueRecordLayout_AUTOSAR_Platform_BaseTypes_uint32 2047.0 RB_RBA_Common_CentralElements_CompuMethods_Identical 0.0 2047. FORMAT "%5.0" /end CHARACTERISTIC
/begin CHARACTERISTIC Can_CanHwObject_GWIMG3_RXCanNod_C "Calibration parameter to calibrate Message CanHwObject_GWIMG3_RX on different Can Node." VALUE 0x804D85B2 DefaultValueRecordLayout_AUTOSAR_Platform_BaseTypes_uint8 2.0 Mcan_Can_CompuMethods_Can_CompuMethod_CtrlId 0.0 2. FORMAT "%5.0" /end CHARACTERISTIC
/begin CHARACTERISTIC Can_CanHwObject_GWIMG4_RXCanId_C "Calibration parameter for Can-Id of Message CanHwObject_GWIMG4_RX" VALUE 0x804D8378 DefaultValueRecordLayout_AUTOSAR_Platform_BaseTypes_uint32 2047.0 RB_RBA_Common_CentralElements_CompuMethods_Identical 0.0 2047. FORMAT "%5.0" /end CHARACTERISTIC
/begin CHARACTERISTIC Can_CanHwObject_GWIMG4_RXCanNod_C "Calibration parameter to calibrate Message CanHwObject_GWIMG4_RX on different Can Node." VALUE 0x804D85B1 DefaultValueRecordLayout_AUTOSAR_Platform_BaseTypes_uint8 2.0 Mcan_Can_CompuMethods_Can_CompuMethod_CtrlId 0.0 2. FORMAT "%5.0" /end CHARACTERISTIC
/begin CHARACTERISTIC Can_CanHwObject_GWIMG5_RXCanId_C "Calibration parameter for Can-Id of Message CanHwObject_GWIMG5_RX" VALUE 0x804D8374 DefaultValueRecordLayout_AUTOSAR_Platform_BaseTypes_uint32 2047.0 RB_RBA_Common_CentralElements_CompuMethods_Identical 0.0 2047. FORMAT "%5.0" /end CHARACTERISTIC
/begin CHARACTERISTIC Can_CanHwObject_GWIMG5_RXCanNod_C "Calibration parameter to calibrate Message CanHwObject_GWIMG5_RX on different Can Node." VALUE 0x804D85B0 DefaultValueRecordLayout_AUTOSAR_Platform_BaseTypes_uint8 2.0 Mcan_Can_CompuMethods_Can_CompuMethod_CtrlId 0.0 2. FORMAT "%5.0" /end CHARACTERISTIC
/begin CHARACTERISTIC Can_CanHwObject_GWIMG6_RXCanId_C "Calibration parameter for Can-Id of Message CanHwObject_GWIMG6_RX" VALUE 0x804D8370 DefaultValueRecordLayout_AUTOSAR_Platform_BaseTypes_uint32 2047.0 RB_RBA_Common_CentralElements_CompuMethods_Identical 0.0 2047. FORMAT "%5.0" /end CHARACTERISTIC
/begin CHARACTERISTIC Can_CanHwObject_GWIMG6_RXCanNod_C "Calibration parameter to calibrate Message CanHwObject_GWIMG6_RX on different Can Node." VALUE 0x804D85AF DefaultValueRecordLayout_AUTOSAR_Platform_BaseTypes_uint8 2.0 Mcan_Can_CompuMethods_Can_CompuMethod_CtrlId 0.0 2. FORMAT "%5.0" /end CHARACTERISTIC
/begin CHARACTERISTIC Can_CanHwObject_IDASB_RXCanId_C "Calibration parameter for Can-Id of Message CanHwObject_IDASB_RX" VALUE 0x804D836C DefaultValueRecordLayout_AUTOSAR_Platform_BaseTypes_uint32 2047.0 RB_RBA_Common_CentralElements_CompuMethods_Identical 0.0 2047. FORMAT "%5.0" /end CHARACTERISTIC
/begin CHARACTERISTIC Can_CanHwObject_IDASB_RXCanNod_C "Calibration parameter to calibrate Message CanHwObject_IDASB_RX on different Can Node." VALUE 0x804D85AE DefaultValueRecordLayout_AUTOSAR_Platform_BaseTypes_uint8 2.0 Mcan_Can_CompuMethods_Can_CompuMethod_CtrlId 0.0 2. FORMAT "%5.0" /end CHARACTERISTIC
/begin CHARACTERISTIC Can_CanHwObject_META_RXCanId_C "Calibration parameter for Can-Id of Message CanHwObject_META_RX" VALUE 0x804D8368 DefaultValueRecordLayout_AUTOSAR_Platform_BaseTypes_uint32 2047.0 RB_RBA_Common_CentralElements_CompuMethods_Identical 0.0 2047. FORMAT "%5.0" /end CHARACTERISTIC
/begin CHARACTERISTIC Can_CanHwObject_META_RXCanNod_C "Calibration parameter to calibrate Message CanHwObject_META_RX on different Can Node." VALUE 0x804D85AD DefaultValueRecordLayout_AUTOSAR_Platform_BaseTypes_uint8 2.0 Mcan_Can_CompuMethods_Can_CompuMethod_CtrlId 0.0 2. FORMAT "%5.0" /end CHARACTERISTIC
/begin CHARACTERISTIC Can_CanHwObject_METC_RXCanId_C "Calibration parameter for Can-Id of Message CanHwObject_METC_RX" VALUE 0x804D8364 DefaultValueRecordLayout_AUTOSAR_Platform_BaseTypes_uint32 2047.0 RB_RBA_Common_CentralElements_CompuMethods_Identical 0.0 2047. FORMAT "%5.0" /end CHARACTERISTIC
/begin CHARACTERISTIC Can_CanHwObject_METC_RXCanNod_C "Calibration parameter to calibrate Message CanHwObject_METC_RX on different Can Node." VALUE 0x804D85AC DefaultValueRecordLayout_AUTOSAR_Platform_BaseTypes_uint8 2.0 Mcan_Can_CompuMethods_Can_CompuMethod_CtrlId 0.0 2. FORMAT "%5.0" /end CHARACTERISTIC
/begin CHARACTERISTIC Can_CanHwObject_METD2_RXCanId_C "Calibration parameter for Can-Id of Message CanHwObject_METD2_RX" VALUE 0x804D8360 DefaultValueRecordLayout_AUTOSAR_Platform_BaseTypes_uint32 2047.0 RB_RBA_Common_CentralElements_CompuMethods_Identical 0.0 2047. FORMAT "%5.0" /end CHARACTERISTIC
/begin CHARACTERISTIC Can_CanHwObject_METD2_RXCanNod_C "Calibration parameter to calibrate Message CanHwObject_METD2_RX on different Can Node." VALUE 0x804D85AB DefaultValueRecordLayout_AUTOSAR_Platform_BaseTypes_uint8 2.0 Mcan_Can_CompuMethods_Can_CompuMethod_CtrlId 0.0 2. FORMAT "%5.0" /end CHARACTERISTIC
/begin CHARACTERISTIC Can_CanHwObject_METD_RXCanId_C "Calibration parameter for Can-Id of Message CanHwObject_METD_RX" VALUE 0x804D835C DefaultValueRecordLayout_AUTOSAR_Platform_BaseTypes_uint32 2047.0 RB_RBA_Common_CentralElements_CompuMethods_Identical 0.0 2047. FORMAT "%5.0" /end CHARACTERISTIC
/begin CHARACTERISTIC Can_CanHwObject_METD_RXCanNod_C "Calibration parameter to calibrate Message CanHwObject_METD_RX on different Can Node." VALUE 0x804D85AA DefaultValueRecordLayout_AUTOSAR_Platform_BaseTypes_uint8 2.0 Mcan_Can_CompuMethods_Can_CompuMethod_CtrlId 0.0 2. FORMAT "%5.0" /end CHARACTERISTIC
/begin CHARACTERISTIC Can_CanHwObject_METE2_RXCanId_C "Calibration parameter for Can-Id of Message CanHwObject_METE2_RX" VALUE 0x804D8358 DefaultValueRecordLayout_AUTOSAR_Platform_BaseTypes_uint32 2047.0 RB_RBA_Common_CentralElements_CompuMethods_Identical 0.0 2047. FORMAT "%5.0" /end CHARACTERISTIC
/begin CHARACTERISTIC Can_CanHwObject_METE2_RXCanNod_C "Calibration parameter to calibrate Message CanHwObject_METE2_RX on different Can Node." VALUE 0x804D85A9 DefaultValueRecordLayout_AUTOSAR_Platform_BaseTypes_uint8 2.0 Mcan_Can_CompuMethods_Can_CompuMethod_CtrlId 0.0 2. FORMAT "%5.0" /end CHARACTERISTIC
/begin CHARACTERISTIC Can_CanHwObject_METF_RXCanId_C "Calibration parameter for Can-Id of Message CanHwObject_METF_RX" VALUE 0x804D8354 DefaultValueRecordLayout_AUTOSAR_Platform_BaseTypes_uint32 2047.0 RB_RBA_Common_CentralElements_CompuMethods_Identical 0.0 2047. FORMAT "%5.0" /end CHARACTERISTIC
/begin CHARACTERISTIC Can_CanHwObject_METF_RXCanNod_C "Calibration parameter to calibrate Message CanHwObject_METF_RX on different Can Node." VALUE 0x804D85A8 DefaultValueRecordLayout_AUTOSAR_Platform_BaseTypes_uint8 2.0 Mcan_Can_CompuMethods_Can_CompuMethod_CtrlId 0.0 2. FORMAT "%5.0" /end CHARACTERISTIC
/begin CHARACTERISTIC Can_CanHwObject_METG2_RXCanId_C "Calibration parameter for Can-Id of Message CanHwObject_METG2_RX" VALUE 0x804D8350 DefaultValueRecordLayout_AUTOSAR_Platform_BaseTypes_uint32 2047.0 RB_RBA_Common_CentralElements_CompuMethods_Identical 0.0 2047. FORMAT "%5.0" /end CHARACTERISTIC
/begin CHARACTERISTIC Can_CanHwObject_METG2_RXCanNod_C "Calibration parameter to calibrate Message CanHwObject_METG2_RX on different Can Node." VALUE 0x804D85A7 DefaultValueRecordLayout_AUTOSAR_Platform_BaseTypes_uint8 2.0 Mcan_Can_CompuMethods_Can_CompuMethod_CtrlId 0.0 2. FORMAT "%5.0" /end CHARACTERISTIC
/begin CHARACTERISTIC Can_CanHwObject_METG_RXCanId_C "Calibration parameter for Can-Id of Message CanHwObject_METG_RX" VALUE 0x804D834C DefaultValueRecordLayout_AUTOSAR_Platform_BaseTypes_uint32 2047.0 RB_RBA_Common_CentralElements_CompuMethods_Identical 0.0 2047. FORMAT "%5.0" /end CHARACTERISTIC
/begin CHARACTERISTIC Can_CanHwObject_METG_RXCanNod_C "Calibration parameter to calibrate Message CanHwObject_METG_RX on different Can Node." VALUE 0x804D85A6 DefaultValueRecordLayout_AUTOSAR_Platform_BaseTypes_uint8 2.0 Mcan_Can_CompuMethods_Can_CompuMethod_CtrlId 0.0 2. FORMAT "%5.0" /end CHARACTERISTIC
/begin CHARACTERISTIC Can_CanHwObject_METH2_RXCanId_C "Calibration parameter for Can-Id of Message CanHwObject_METH2_RX" VALUE 0x804D8348 DefaultValueRecordLayout_AUTOSAR_Platform_BaseTypes_uint32 2047.0 RB_RBA_Common_CentralElements_CompuMethods_Identical 0.0 2047. FORMAT "%5.0" /end CHARACTERISTIC
/begin CHARACTERISTIC Can_CanHwObject_METH2_RXCanNod_C "Calibration parameter to calibrate Message CanHwObject_METH2_RX on different Can Node." VALUE 0x804D85A5 DefaultValueRecordLayout_AUTOSAR_Platform_BaseTypes_uint8 2.0 Mcan_Can_CompuMethods_Can_CompuMethod_CtrlId 0.0 2. FORMAT "%5.0" /end CHARACTERISTIC
/begin CHARACTERISTIC Can_CanHwObject_METH_RXCanId_C "Calibration parameter for Can-Id of Message CanHwObject_METH_RX" VALUE 0x804D8344 DefaultValueRecordLayout_AUTOSAR_Platform_BaseTypes_uint32 2047.0 RB_RBA_Common_CentralElements_CompuMethods_Identical 0.0 2047. FORMAT "%5.0" /end CHARACTERISTIC
/begin CHARACTERISTIC Can_CanHwObject_METH_RXCanNod_C "Calibration parameter to calibrate Message CanHwObject_METH_RX on different Can Node." VALUE 0x804D85A4 DefaultValueRecordLayout_AUTOSAR_Platform_BaseTypes_uint8 2.0 Mcan_Can_CompuMethods_Can_CompuMethod_CtrlId 0.0 2. FORMAT "%5.0" /end CHARACTERISTIC
/begin CHARACTERISTIC Can_CanHwObject_METI_RXCanId_C "Calibration parameter for Can-Id of Message CanHwObject_METI_RX" VALUE 0x804D8340 DefaultValueRecordLayout_AUTOSAR_Platform_BaseTypes_uint32 2047.0 RB_RBA_Common_CentralElements_CompuMethods_Identical 0.0 2047. FORMAT "%5.0" /end CHARACTERISTIC
/begin CHARACTERISTIC Can_CanHwObject_METI_RXCanNod_C "Calibration parameter to calibrate Message CanHwObject_METI_RX on different Can Node." VALUE 0x804D85A3 DefaultValueRecordLayout_AUTOSAR_Platform_BaseTypes_uint8 2.0 Mcan_Can_CompuMethods_Can_CompuMethod_CtrlId 0.0 2. FORMAT "%5.0" /end CHARACTERISTIC
/begin CHARACTERISTIC Can_CanHwObject_METK_RXCanId_C "Calibration parameter for Can-Id of Message CanHwObject_METK_RX" VALUE 0x804D833C DefaultValueRecordLayout_AUTOSAR_Platform_BaseTypes_uint32 2047.0 RB_RBA_Common_CentralElements_CompuMethods_Identical 0.0 2047. FORMAT "%5.0" /end CHARACTERISTIC
/begin CHARACTERISTIC Can_CanHwObject_METK_RXCanNod_C "Calibration parameter to calibrate Message CanHwObject_METK_RX on different Can Node." VALUE 0x804D85A2 DefaultValueRecordLayout_AUTOSAR_Platform_BaseTypes_uint8 2.0 Mcan_Can_CompuMethods_Can_CompuMethod_CtrlId 0.0 2. FORMAT "%5.0" /end CHARACTERISTIC
/begin CHARACTERISTIC Can_CanHwObject_METL_RXCanId_C "Calibration parameter for Can-Id of Message CanHwObject_METL_RX" VALUE 0x804D8338 DefaultValueRecordLayout_AUTOSAR_Platform_BaseTypes_uint32 2047.0 RB_RBA_Common_CentralElements_CompuMethods_Identical 0.0 2047. FORMAT "%5.0" /end CHARACTERISTIC
/begin CHARACTERISTIC Can_CanHwObject_METL_RXCanNod_C "Calibration parameter to calibrate Message CanHwObject_METL_RX on different Can Node." VALUE 0x804D85A1 DefaultValueRecordLayout_AUTOSAR_Platform_BaseTypes_uint8 2.0 Mcan_Can_CompuMethods_Can_CompuMethod_CtrlId 0.0 2. FORMAT "%5.0" /end CHARACTERISTIC
/begin CHARACTERISTIC Can_CanHwObject_METM_RXCanId_C "Calibration parameter for Can-Id of Message CanHwObject_METM_RX" VALUE 0x804D8334 DefaultValueRecordLayout_AUTOSAR_Platform_BaseTypes_uint32 2047.0 RB_RBA_Common_CentralElements_CompuMethods_Identical 0.0 2047. FORMAT "%5.0" /end CHARACTERISTIC
/begin CHARACTERISTIC Can_CanHwObject_METM_RXCanNod_C "Calibration parameter to calibrate Message CanHwObject_METM_RX on different Can Node." VALUE 0x804D85A0 DefaultValueRecordLayout_AUTOSAR_Platform_BaseTypes_uint8 2.0 Mcan_Can_CompuMethods_Can_CompuMethod_CtrlId 0.0 2. FORMAT "%5.0" /end CHARACTERISTIC
/begin CHARACTERISTIC Can_CanHwObject_METN_RXCanId_C "Calibration parameter for Can-Id of Message CanHwObject_METN_RX" VALUE 0x804D8330 DefaultValueRecordLayout_AUTOSAR_Platform_BaseTypes_uint32 2047.0 RB_RBA_Common_CentralElements_CompuMethods_Identical 0.0 2047. FORMAT "%5.0" /end CHARACTERISTIC
/begin CHARACTERISTIC Can_CanHwObject_METN_RXCanNod_C "Calibration parameter to calibrate Message CanHwObject_METN_RX on different Can Node." VALUE 0x804D859F DefaultValueRecordLayout_AUTOSAR_Platform_BaseTypes_uint8 2.0 Mcan_Can_CompuMethods_Can_CompuMethod_CtrlId 0.0 2. FORMAT "%5.0" /end CHARACTERISTIC
/begin CHARACTERISTIC Can_CanHwObject_PCU_RXCanId_C "Calibration parameter for Can-Id of Message CanHwObject_PCU_RX" VALUE 0x804D832C DefaultValueRecordLayout_AUTOSAR_Platform_BaseTypes_uint32 2047.0 RB_RBA_Common_CentralElements_CompuMethods_Identical 0.0 2047. FORMAT "%5.0" /end CHARACTERISTIC
/begin CHARACTERISTIC Can_CanHwObject_PCU_RXCanNod_C "Calibration parameter to calibrate Message CanHwObject_PCU_RX on different Can Node." VALUE 0x804D859E DefaultValueRecordLayout_AUTOSAR_Platform_BaseTypes_uint8 2.0 Mcan_Can_CompuMethods_Can_CompuMethod_CtrlId 0.0 2. FORMAT "%5.0" /end CHARACTERISTIC
/begin CHARACTERISTIC Can_CanHwObject_SRSA_RXCanId_C "Calibration parameter for Can-Id of Message CanHwObject_SRSA_RX" VALUE 0x804D8328 DefaultValueRecordLayout_AUTOSAR_Platform_BaseTypes_uint32 2047.0 RB_RBA_Common_CentralElements_CompuMethods_Identical 0.0 2047. FORMAT "%5.0" /end CHARACTERISTIC
/begin CHARACTERISTIC Can_CanHwObject_SRSA_RXCanNod_C "Calibration parameter to calibrate Message CanHwObject_SRSA_RX on different Can Node." VALUE 0x804D859D DefaultValueRecordLayout_AUTOSAR_Platform_BaseTypes_uint8 2.0 Mcan_Can_CompuMethods_Can_CompuMethod_CtrlId 0.0 2. FORMAT "%5.0" /end CHARACTERISTIC
/begin CHARACTERISTIC Can_CanHwObject_SRSB_RXCanId_C "Calibration parameter for Can-Id of Message CanHwObject_SRSB_RX" VALUE 0x804D8324 DefaultValueRecordLayout_AUTOSAR_Platform_BaseTypes_uint32 2047.0 RB_RBA_Common_CentralElements_CompuMethods_Identical 0.0 2047. FORMAT "%5.0" /end CHARACTERISTIC
/begin CHARACTERISTIC Can_CanHwObject_SRSB_RXCanNod_C "Calibration parameter to calibrate Message CanHwObject_SRSB_RX on different Can Node." VALUE 0x804D859C DefaultValueRecordLayout_AUTOSAR_Platform_BaseTypes_uint8 2.0 Mcan_Can_CompuMethods_Can_CompuMethod_CtrlId 0.0 2. FORMAT "%5.0" /end CHARACTERISTIC
/begin CHARACTERISTIC Can_CanHwObject_SRS_RXCanId_C "Calibration parameter for Can-Id of Message CanHwObject_SRS_RX" VALUE 0x804D8320 DefaultValueRecordLayout_AUTOSAR_Platform_BaseTypes_uint32 2047.0 RB_RBA_Common_CentralElements_CompuMethods_Identical 0.0 2047. FORMAT "%5.0" /end CHARACTERISTIC
/begin CHARACTERISTIC Can_CanHwObject_SRS_RXCanNod_C "Calibration parameter to calibrate Message CanHwObject_SRS_RX on different Can Node." VALUE 0x804D859B DefaultValueRecordLayout_AUTOSAR_Platform_BaseTypes_uint8 2.0 Mcan_Can_CompuMethods_Can_CompuMethod_CtrlId 0.0 2. FORMAT "%5.0" /end CHARACTERISTIC
/begin CHARACTERISTIC Can_CanHwObject_eng1_TXCanNod_C "Calibration parameter to calibrate Message CanHwObject_eng1_TX on different Can Node." VALUE 0x804D859A DefaultValueRecordLayout_AUTOSAR_Platform_BaseTypes_uint8 2.0 Mcan_Can_CompuMethods_Can_CompuMethod_CtrlId 0.0 2. FORMAT "%5.0" /end CHARACTERISTIC
/begin CHARACTERISTIC Can_CanHwObject_engo_TXCanNod_C "Calibration parameter to calibrate Message CanHwObject_engo_TX on different Can Node." VALUE 0x804D8599 DefaultValueRecordLayout_AUTOSAR_Platform_BaseTypes_uint8 2.0 Mcan_Can_CompuMethods_Can_CompuMethod_CtrlId 0.0 2. FORMAT "%5.0" /end CHARACTERISTIC
/begin CHARACTERISTIC Can_Can_APPLBaudrateCfgId_C "Calibration parameter for the Baudrate of Can Node Can_APPL" VALUE 0x804D8572 DefaultValueRecordLayout_AUTOSAR_Platform_BaseTypes_uint16 0.0 Mcan_Can_CompuMethods_Can_CompuMethod_CtrlBdRateId_Can_APPL 0.0 0.0 FORMAT "%5.0" /end CHARACTERISTIC
/begin CHARACTERISTIC Can_Can_CBaudrateCfgId_C "Calibration parameter for the Baudrate of Can Node Can_C" VALUE 0x804D8570 DefaultValueRecordLayout_AUTOSAR_Platform_BaseTypes_uint16 0.0 Mcan_Can_CompuMethods_Can_CompuMethod_CtrlBdRateId_Can_C 0.0 0.0 FORMAT "%5.0" /end CHARACTERISTIC
/begin CHARACTERISTIC Can_Can_VEHICLEBaudrateCfgId_C "Calibration parameter for the Baudrate of Can Node Can_VEHICLE" VALUE 0x804D856E DefaultValueRecordLayout_AUTOSAR_Platform_BaseTypes_uint16 0.0 Mcan_Can_CompuMethods_Can_CompuMethod_CtrlBdRateId_Can_VEHICLE 0.0 0.0 FORMAT "%5.0" /end CHARACTERISTIC
/begin CHARACTERISTIC Can_OBD_ON_CAN_Rx_0x7DF_VEHICLECanId_C "Calibration parameter for Can-Id of Message OBD_ON_CAN_Rx_0x7DF_VEHICLE" VALUE 0x804D831C DefaultValueRecordLayout_AUTOSAR_Platform_BaseTypes_uint32 2047.0 RB_RBA_Common_CentralElements_CompuMethods_Identical 0.0 2047. FORMAT "%5.0" /end CHARACTERISTIC
/begin CHARACTERISTIC Can_OBD_ON_CAN_Rx_0x7DF_VEHICLECanNod_C "Calibration parameter to calibrate Message OBD_ON_CAN_Rx_0x7DF_VEHICLE on different Can Node." VALUE 0x804D8598 DefaultValueRecordLayout_AUTOSAR_Platform_BaseTypes_uint8 2.0 Mcan_Can_CompuMethods_Can_CompuMethod_CtrlId 0.0 2. FORMAT "%5.0" /end CHARACTERISTIC
/begin CHARACTERISTIC Can_OBD_ON_CAN_Rx_0x7E0_VEHICLECanId_C "Calibration parameter for Can-Id of Message OBD_ON_CAN_Rx_0x7E0_VEHICLE" VALUE 0x804D8318 DefaultValueRecordLayout_AUTOSAR_Platform_BaseTypes_uint32 2047.0 RB_RBA_Common_CentralElements_CompuMethods_Identical 0.0 2047. FORMAT "%5.0" /end CHARACTERISTIC
/begin CHARACTERISTIC Can_OBD_ON_CAN_Rx_0x7E0_VEHICLECanNod_C "Calibration parameter to calibrate Message OBD_ON_CAN_Rx_0x7E0_VEHICLE on different Can Node." VALUE 0x804D8597 DefaultValueRecordLayout_AUTOSAR_Platform_BaseTypes_uint8 2.0 Mcan_Can_CompuMethods_Can_CompuMethod_CtrlId 0.0 2. FORMAT "%5.0" /end CHARACTERISTIC
/begin CHARACTERISTIC Can_OBD_ON_CAN_Tx_0x7E8_VEHICLECanNod_C "Calibration parameter to calibrate Message OBD_ON_CAN_Tx_0x7E8_VEHICLE on different Can Node." VALUE 0x804D8596 DefaultValueRecordLayout_AUTOSAR_Platform_BaseTypes_uint8 2.0 Mcan_Can_CompuMethods_Can_CompuMethod_CtrlId 0.0 2. FORMAT "%5.0" /end CHARACTERISTIC
/begin CHARACTERISTIC Can_T1_RXCanId_C "Calibration parameter for Can-Id of Message T1_RX" VALUE 0x804D8314 DefaultValueRecordLayout_AUTOSAR_Platform_BaseTypes_uint32 2047.0 RB_RBA_Common_CentralElements_CompuMethods_Identical 0.0 2047. FORMAT "%5.0" /end CHARACTERISTIC
/begin CHARACTERISTIC Can_T1_RXCanNod_C "Calibration parameter to calibrate Message T1_RX on different Can Node." VALUE 0x804D8595 DefaultValueRecordLayout_AUTOSAR_Platform_BaseTypes_uint8 2.0 Mcan_Can_CompuMethods_Can_CompuMethod_CtrlId 0.0 2. FORMAT "%5.0" /end CHARACTERISTIC
/begin CHARACTERISTIC Can_T1_TXCanNod_C "Calibration parameter to calibrate Message T1_TX on different Can Node." VALUE 0x804D8594 DefaultValueRecordLayout_AUTOSAR_Platform_BaseTypes_uint8 2.0 Mcan_Can_CompuMethods_Can_CompuMethod_CtrlId 0.0 2. FORMAT "%5.0" /end CHARACTERISTIC
/begin CHARACTERISTIC Can_UDS_ON_CAN_Rx_0x18da10f1_VEHICLECanId_C "Calibration parameter for Can-Id of Message UDS_ON_CAN_Rx_0x18da10f1_VEHICLE" VALUE 0x804D8310 DefaultValueRecordLayout_AUTOSAR_Platform_BaseTypes_uint32 5.0E8 RB_RBA_Common_CentralElements_CompuMethods_Identical 0.0 5.E8 FORMAT "%5.0" /end CHARACTERISTIC
/begin CHARACTERISTIC Can_UDS_ON_CAN_Rx_0x18da10f1_VEHICLECanNod_C "Calibration parameter to calibrate Message UDS_ON_CAN_Rx_0x18da10f1_VEHICLE on different Can Node." VALUE 0x804D8593 DefaultValueRecordLayout_AUTOSAR_Platform_BaseTypes_uint8 2.0 Mcan_Can_CompuMethods_Can_CompuMethod_CtrlId 0.0 2. FORMAT "%5.0" /end CHARACTERISTIC
/begin CHARACTERISTIC Can_UDS_ON_CAN_Rx_0x18da10f2_VEHICLECanId_C "Calibration parameter for Can-Id of Message UDS_ON_CAN_Rx_0x18da10f2_VEHICLE" VALUE 0x804D830C DefaultValueRecordLayout_AUTOSAR_Platform_BaseTypes_uint32 5.0E8 RB_RBA_Common_CentralElements_CompuMethods_Identical 0.0 5.E8 FORMAT "%5.0" /end CHARACTERISTIC
/begin CHARACTERISTIC Can_UDS_ON_CAN_Rx_0x18da10f2_VEHICLECanNod_C "Calibration parameter to calibrate Message UDS_ON_CAN_Rx_0x18da10f2_VEHICLE on different Can Node." VALUE 0x804D8592 DefaultValueRecordLayout_AUTOSAR_Platform_BaseTypes_uint8 2.0 Mcan_Can_CompuMethods_Can_CompuMethod_CtrlId 0.0 2. FORMAT "%5.0" /end CHARACTERISTIC
/begin CHARACTERISTIC Can_UDS_ON_CAN_Rx_0x18db2ff1_VEHICLECanId_C "Calibration parameter for Can-Id of Message UDS_ON_CAN_Rx_0x18db2ff1_VEHICLE" VALUE 0x804D8308 DefaultValueRecordLayout_AUTOSAR_Platform_BaseTypes_uint32 5.0E8 RB_RBA_Common_CentralElements_CompuMethods_Identical 0.0 5.E8 FORMAT "%5.0" /end CHARACTERISTIC
/begin CHARACTERISTIC Can_UDS_ON_CAN_Rx_0x18db2ff1_VEHICLECanNod_C "Calibration parameter to calibrate Message UDS_ON_CAN_Rx_0x18db2ff1_VEHICLE on different Can Node." VALUE 0x804D8591 DefaultValueRecordLayout_AUTOSAR_Platform_BaseTypes_uint8 2.0 Mcan_Can_CompuMethods_Can_CompuMethod_CtrlId 0.0 2. FORMAT "%5.0" /end CHARACTERISTIC
/begin CHARACTERISTIC Can_UDS_ON_CAN_Rx_0x18db33f1_VEHICLECanId_C "Calibration parameter for Can-Id of Message UDS_ON_CAN_Rx_0x18db33f1_VEHICLE" VALUE 0x804D8304 DefaultValueRecordLayout_AUTOSAR_Platform_BaseTypes_uint32 5.0E8 RB_RBA_Common_CentralElements_CompuMethods_Identical 0.0 5.E8 FORMAT "%5.0" /end CHARACTERISTIC
/begin CHARACTERISTIC Can_UDS_ON_CAN_Rx_0x18db33f1_VEHICLECanNod_C "Calibration parameter to calibrate Message UDS_ON_CAN_Rx_0x18db33f1_VEHICLE on different Can Node." VALUE 0x804D8590 DefaultValueRecordLayout_AUTOSAR_Platform_BaseTypes_uint8 2.0 Mcan_Can_CompuMethods_Can_CompuMethod_CtrlId 0.0 2. FORMAT "%5.0" /end CHARACTERISTIC
/begin CHARACTERISTIC Can_UDS_ON_CAN_Rx_0x18dbeff1_VEHICLECanId_C "Calibration parameter for Can-Id of Message UDS_ON_CAN_Rx_0x18dbeff1_VEHICLE" VALUE 0x804D8300 DefaultValueRecordLayout_AUTOSAR_Platform_BaseTypes_uint32 5.0E8 RB_RBA_Common_CentralElements_CompuMethods_Identical 0.0 5.E8 FORMAT "%5.0" /end CHARACTERISTIC
/begin CHARACTERISTIC Can_UDS_ON_CAN_Rx_0x18dbeff1_VEHICLECanNod_C "Calibration parameter to calibrate Message UDS_ON_CAN_Rx_0x18dbeff1_VEHICLE on different Can Node." VALUE 0x804D858F DefaultValueRecordLayout_AUTOSAR_Platform_BaseTypes_uint8 2.0 Mcan_Can_CompuMethods_Can_CompuMethod_CtrlId 0.0 2. FORMAT "%5.0" /end CHARACTERISTIC
/begin CHARACTERISTIC Can_UDS_ON_CAN_Tx_0x18daf110_VEHICLECanNod_C "Calibration parameter to calibrate Message UDS_ON_CAN_Tx_0x18daf110_VEHICLE on different Can Node." VALUE 0x804D858E DefaultValueRecordLayout_AUTOSAR_Platform_BaseTypes_uint8 2.0 Mcan_Can_CompuMethods_Can_CompuMethod_CtrlId 0.0 2. FORMAT "%5.0" /end CHARACTERISTIC
/begin CHARACTERISTIC Can_UDS_ON_CAN_Tx_0x18daf210_VEHICLECanNod_C "Calibration parameter to calibrate Message UDS_ON_CAN_Tx_0x18daf210_VEHICLE on different Can Node." VALUE 0x804D858D DefaultValueRecordLayout_AUTOSAR_Platform_BaseTypes_uint8 2.0 Mcan_Can_CompuMethods_Can_CompuMethod_CtrlId 0.0 2. FORMAT "%5.0" /end CHARACTERISTIC
/begin CHARACTERISTIC Can_XcpRx_Cmd_APPLCanId_C "Calibration parameter for Can-Id of Message XcpRx_Cmd_APPL" VALUE 0x804D82FC DefaultValueRecordLayout_AUTOSAR_Platform_BaseTypes_uint32 2047.0 RB_RBA_Common_CentralElements_CompuMethods_Identical 0.0 2047. FORMAT "%5.0" /end CHARACTERISTIC
/begin CHARACTERISTIC Can_XcpRx_Cmd_APPLCanNod_C "Calibration parameter to calibrate Message XcpRx_Cmd_APPL on different Can Node." VALUE 0x804D858C DefaultValueRecordLayout_AUTOSAR_Platform_BaseTypes_uint8 2.0 Mcan_Can_CompuMethods_Can_CompuMethod_CtrlId 0.0 2. FORMAT "%5.0" /end CHARACTERISTIC
/begin CHARACTERISTIC Can_XcpRx_Cmd_CANCCanId_C "Calibration parameter for Can-Id of Message XcpRx_Cmd_CANC" VALUE 0x804D82F8 DefaultValueRecordLayout_AUTOSAR_Platform_BaseTypes_uint32 2047.0 RB_RBA_Common_CentralElements_CompuMethods_Identical 0.0 2047. FORMAT "%5.0" /end CHARACTERISTIC
/begin CHARACTERISTIC Can_XcpRx_Cmd_CANCCanNod_C "Calibration parameter to calibrate Message XcpRx_Cmd_CANC on different Can Node." VALUE 0x804D858B DefaultValueRecordLayout_AUTOSAR_Platform_BaseTypes_uint8 2.0 Mcan_Can_CompuMethods_Can_CompuMethod_CtrlId 0.0 2. FORMAT "%5.0" /end CHARACTERISTIC
/begin CHARACTERISTIC Can_XcpRx_Cmd_VEHICLECanId_C "Calibration parameter for Can-Id of Message XcpRx_Cmd_VEHICLE" VALUE 0x804D82F4 DefaultValueRecordLayout_AUTOSAR_Platform_BaseTypes_uint32 2047.0 RB_RBA_Common_CentralElements_CompuMethods_Identical 0.0 2047. FORMAT "%5.0" /end CHARACTERISTIC
/begin CHARACTERISTIC Can_XcpRx_Cmd_VEHICLECanNod_C "Calibration parameter to calibrate Message XcpRx_Cmd_VEHICLE on different Can Node." VALUE 0x804D858A DefaultValueRecordLayout_AUTOSAR_Platform_BaseTypes_uint8 2.0 Mcan_Can_CompuMethods_Can_CompuMethod_CtrlId 0.0 2. FORMAT "%5.0" /end CHARACTERISTIC
/begin CHARACTERISTIC Can_XcpTx_Var_APPLCanNod_C "Calibration parameter to calibrate Message XcpTx_Var_APPL on different Can Node." VALUE 0x804D8589 DefaultValueRecordLayout_AUTOSAR_Platform_BaseTypes_uint8 2.0 Mcan_Can_CompuMethods_Can_CompuMethod_CtrlId 0.0 2. FORMAT "%5.0" /end CHARACTERISTIC
/begin CHARACTERISTIC Can_XcpTx_Var_CANCCanNod_C "Calibration parameter to calibrate Message XcpTx_Var_CANC on different Can Node." VALUE 0x804D8588 DefaultValueRecordLayout_AUTOSAR_Platform_BaseTypes_uint8 2.0 Mcan_Can_CompuMethods_Can_CompuMethod_CtrlId 0.0 2. FORMAT "%5.0" /end CHARACTERISTIC
/begin CHARACTERISTIC Can_XcpTx_Var_VEHICLECanNod_C "Calibration parameter to calibrate Message XcpTx_Var_VEHICLE on different Can Node." VALUE 0x804D8587 DefaultValueRecordLayout_AUTOSAR_Platform_BaseTypes_uint8 2.0 Mcan_Can_CompuMethods_Can_CompuMethod_CtrlId 0.0 2. FORMAT "%5.0" /end CHARACTERISTIC
/begin CHARACTERISTIC rba_BypEtk_AccPed_trqDes_bypass_CST.Vector_u16 "Value must not be changed manually. This is done automatically by Ascet/Intecrio/" VALUE 0xB92E0068 DefaultValueRecordLayout_AUTOSAR_Platform_BaseTypes_uint16 65535.0 RB_RBA_Common_CentralElements_CompuMethods_Identical 0.0 65535.0 FORMAT "%5.1" MAX_REFRESH 3 200 /end CHARACTERISTIC
/begin CHARACTERISTIC rba_BypEtk_AccPed_trqDes_bypass_CST.Channel_u16 "Value must not be changed manually. This is done automatically by Ascet/Intecrio/" VALUE 0xB92E006A DefaultValueRecordLayout_AUTOSAR_Platform_BaseTypes_uint16 65535.0 RB_RBA_Common_CentralElements_CompuMethods_Identical 0.0 65535.0 FORMAT "%5.1" MAX_REFRESH 3 200 /end CHARACTERISTIC
/begin CHARACTERISTIC rba_BypEtk_CoETS_trqInrCurrLim_bypass_CST.Vector_u16 "Value must not be changed manually. This is done automatically by Ascet/Intecrio/" VALUE 0xB92E0064 DefaultValueRecordLayout_AUTOSAR_Platform_BaseTypes_uint16 65535.0 RB_RBA_Common_CentralElements_CompuMethods_Identical 0.0 65535.0 FORMAT "%5.1" MAX_REFRESH 3 200 /end CHARACTERISTIC
/begin CHARACTERISTIC rba_BypEtk_CoETS_trqInrCurrLim_bypass_CST.Channel_u16 "Value must not be changed manually. This is done automatically by Ascet/Intecrio/" VALUE 0xB92E0066 DefaultValueRecordLayout_AUTOSAR_Platform_BaseTypes_uint16 65535.0 RB_RBA_Common_CentralElements_CompuMethods_Identical 0.0 65535.0 FORMAT "%5.1" MAX_REFRESH 3 200 /end CHARACTERISTIC
/begin CHARACTERISTIC rba_BypEtk_CoME_nMax_bypass_CST.Vector_u16 "Value must not be changed manually. This is done automatically by Ascet/Intecrio/" VALUE 0xB92E0060 DefaultValueRecordLayout_AUTOSAR_Platform_BaseTypes_uint16 65535.0 RB_RBA_Common_CentralElements_CompuMethods_Identical 0.0 65535.0 FORMAT "%5.1" MAX_REFRESH 3 200 /end CHARACTERISTIC
/begin CHARACTERISTIC rba_BypEtk_CoME_nMax_bypass_CST.Channel_u16 "Value must not be changed manually. This is done automatically by Ascet/Intecrio/" VALUE 0xB92E0062 DefaultValueRecordLayout_AUTOSAR_Platform_BaseTypes_uint16 65535.0 RB_RBA_Common_CentralElements_CompuMethods_Identical 0.0 65535.0 FORMAT "%5.1" MAX_REFRESH 3 200 /end CHARACTERISTIC
/begin CHARACTERISTIC rba_BypEtk_CoME_nMin_bypass_CST.Vector_u16 "Value must not be changed manually. This is done automatically by Ascet/Intecrio/" VALUE 0xB92E005C DefaultValueRecordLayout_AUTOSAR_Platform_BaseTypes_uint16 65535.0 RB_RBA_Common_CentralElements_CompuMethods_Identical 0.0 65535.0 FORMAT "%5.1" MAX_REFRESH 3 200 /end CHARACTERISTIC
/begin CHARACTERISTIC rba_BypEtk_CoME_nMin_bypass_CST.Channel_u16 "Value must not be changed manually. This is done automatically by Ascet/Intecrio/" VALUE 0xB92E005E DefaultValueRecordLayout_AUTOSAR_Platform_BaseTypes_uint16 65535.0 RB_RBA_Common_CentralElements_CompuMethods_Identical 0.0 65535.0 FORMAT "%5.1" MAX_REFRESH 3 200 /end CHARACTERISTIC
/begin CHARACTERISTIC rba_BypEtk_CoME_stNSetP_bypass_CST.Vector_u16 "Value must not be changed manually. This is done automatically by Ascet/Intecrio/" VALUE 0xB92E0058 DefaultValueRecordLayout_AUTOSAR_Platform_BaseTypes_uint16 65535.0 RB_RBA_Common_CentralElements_CompuMethods_Identical 0.0 65535.0 FORMAT "%5.1" MAX_REFRESH 3 200 /end CHARACTERISTIC
/begin CHARACTERISTIC rba_BypEtk_CoME_stNSetP_bypass_CST.Channel_u16 "Value must not be changed manually. This is done automatically by Ascet/Intecrio/" VALUE 0xB92E005A DefaultValueRecordLayout_AUTOSAR_Platform_BaseTypes_uint16 65535.0 RB_RBA_Common_CentralElements_CompuMethods_Identical 0.0 65535.0 FORMAT "%5.1" MAX_REFRESH 3 200 /end CHARACTERISTIC
/begin CHARACTERISTIC rba_BypEtk_CoME_trqDesComp_bypass_CST.Vector_u16 "Value must not be changed manually. This is done automatically by Ascet/Intecrio/" VALUE 0xB92E0054 DefaultValueRecordLayout_AUTOSAR_Platform_BaseTypes_uint16 65535.0 RB_RBA_Common_CentralElements_CompuMethods_Identical 0.0 65535.0 FORMAT "%5.1" MAX_REFRESH 3 200 /end CHARACTERISTIC
/begin CHARACTERISTIC rba_BypEtk_CoME_trqDesComp_bypass_CST.Channel_u16 "Value must not be changed manually. This is done automatically by Ascet/Intecrio/" VALUE 0xB92E0056 DefaultValueRecordLayout_AUTOSAR_Platform_BaseTypes_uint16 65535.0 RB_RBA_Common_CentralElements_CompuMethods_Identical 0.0 65535.0 FORMAT "%5.1" MAX_REFRESH 3 200 /end CHARACTERISTIC
/begin CHARACTERISTIC rba_BypEtk_CoME_trqResv_bypass_CST.Vector_u16 "Value must not be changed manually. This is done automatically by Ascet/Intecrio/" VALUE 0xB92E0050 DefaultValueRecordLayout_AUTOSAR_Platform_BaseTypes_uint16 65535.0 RB_RBA_Common_CentralElements_CompuMethods_Identical 0.0 65535.0 FORMAT "%5.1" MAX_REFRESH 3 200 /end CHARACTERISTIC
/begin CHARACTERISTIC rba_BypEtk_CoME_trqResv_bypass_CST.Channel_u16 "Value must not be changed manually. This is done automatically by Ascet/Intecrio/" VALUE 0xB92E0052 DefaultValueRecordLayout_AUTOSAR_Platform_BaseTypes_uint16 65535.0 RB_RBA_Common_CentralElements_CompuMethods_Identical 0.0 65535.0 FORMAT "%5.1" MAX_REFRESH 3 200 /end CHARACTERISTIC
/begin CHARACTERISTIC rba_BypEtk_CoPT_trqClthWoIntv_bypass_CST.Vector_u16 "Value must not be changed manually. This is done automatically by Ascet/Intecrio/" VALUE 0xB92E004C DefaultValueRecordLayout_AUTOSAR_Platform_BaseTypes_uint16 65535.0 RB_RBA_Common_CentralElements_CompuMethods_Identical 0.0 65535.0 FORMAT "%5.1" MAX_REFRESH 3 200 /end CHARACTERISTIC
/begin CHARACTERISTIC rba_BypEtk_CoPT_trqClthWoIntv_bypass_CST.Channel_u16 "Value must not be changed manually. This is done automatically by Ascet/Intecrio/" VALUE 0xB92E004E DefaultValueRecordLayout_AUTOSAR_Platform_BaseTypes_uint16 65535.0 RB_RBA_Common_CentralElements_CompuMethods_Identical 0.0 65535.0 FORMAT "%5.1" MAX_REFRESH 3 200 /end CHARACTERISTIC
/begin CHARACTERISTIC rba_BypEtk_CoPT_trqClthWoTraIntv_bypass_CST.Vector_u16 "Value must not be changed manually. This is done automatically by Ascet/Intecrio/" VALUE 0xB92E0048 DefaultValueRecordLayout_AUTOSAR_Platform_BaseTypes_uint16 65535.0 RB_RBA_Common_CentralElements_CompuMethods_Identical 0.0 65535.0 FORMAT "%5.1" MAX_REFRESH 3 200 /end CHARACTERISTIC
/begin CHARACTERISTIC rba_BypEtk_CoPT_trqClthWoTraIntv_bypass_CST.Channel_u16 "Value must not be changed manually. This is done automatically by Ascet/Intecrio/" VALUE 0xB92E004A DefaultValueRecordLayout_AUTOSAR_Platform_BaseTypes_uint16 65535.0 RB_RBA_Common_CentralElements_CompuMethods_Identical 0.0 65535.0 FORMAT "%5.1" MAX_REFRESH 3 200 /end CHARACTERISTIC
/begin CHARACTERISTIC rba_BypEtk_CoPT_trqDesCompEng_bypass_CST.Vector_u16 "Value must not be changed manually. This is done automatically by Ascet/Intecrio/" VALUE 0xB92E0044 DefaultValueRecordLayout_AUTOSAR_Platform_BaseTypes_uint16 65535.0 RB_RBA_Common_CentralElements_CompuMethods_Identical 0.0 65535.0 FORMAT "%5.1" MAX_REFRESH 3 200 /end CHARACTERISTIC
/begin CHARACTERISTIC rba_BypEtk_CoPT_trqDesCompEng_bypass_CST.Channel_u16 "Value must not be changed manually. This is done automatically by Ascet/Intecrio/" VALUE 0xB92E0046 DefaultValueRecordLayout_AUTOSAR_Platform_BaseTypes_uint16 65535.0 RB_RBA_Common_CentralElements_CompuMethods_Identical 0.0 65535.0 FORMAT "%5.1" MAX_REFRESH 3 200 /end CHARACTERISTIC
/begin CHARACTERISTIC rba_BypEtk_CoVMD_trqCrCtl_bypass_CST.Vector_u16 "Value must not be changed manually. This is done automatically by Ascet/Intecrio/" VALUE 0xB92E0040 DefaultValueRecordLayout_AUTOSAR_Platform_BaseTypes_uint16 65535.0 RB_RBA_Common_CentralElements_CompuMethods_Identical 0.0 65535.0 FORMAT "%5.1" MAX_REFRESH 3 200 /end CHARACTERISTIC
/begin CHARACTERISTIC rba_BypEtk_CoVMD_trqCrCtl_bypass_CST.Channel_u16 "Value must not be changed manually. This is done automatically by Ascet/Intecrio/" VALUE 0xB92E0042 DefaultValueRecordLayout_AUTOSAR_Platform_BaseTypes_uint16 65535.0 RB_RBA_Common_CentralElements_CompuMethods_Identical 0.0 65535.0 FORMAT "%5.1" MAX_REFRESH 3 200 /end CHARACTERISTIC
/begin CHARACTERISTIC rba_BypEtk_CoVeh_trqDesComp_bypass_CST.Vector_u16 "Value must not be changed manually. This is done automatically by Ascet/Intecrio/" VALUE 0xB92E003C DefaultValueRecordLayout_AUTOSAR_Platform_BaseTypes_uint16 65535.0 RB_RBA_Common_CentralElements_CompuMethods_Identical 0.0 65535.0 FORMAT "%5.1" MAX_REFRESH 3 200 /end CHARACTERISTIC
/begin CHARACTERISTIC rba_BypEtk_CoVeh_trqDesComp_bypass_CST.Channel_u16 "Value must not be changed manually. This is done automatically by Ascet/Intecrio/" VALUE 0xB92E003E DefaultValueRecordLayout_AUTOSAR_Platform_BaseTypes_uint16 65535.0 RB_RBA_Common_CentralElements_CompuMethods_Identical 0.0 65535.0 FORMAT "%5.1" MAX_REFRESH 3 200 /end CHARACTERISTIC
/begin CHARACTERISTIC rba_BypEtk_EGRVlv_rDesVal_bypass_CST.Vector_u16 "Value must not be changed manually. This is done automatically by Ascet/Intecrio/" VALUE 0xB92E0038 DefaultValueRecordLayout_AUTOSAR_Platform_BaseTypes_uint16 65535.0 RB_RBA_Common_CentralElements_CompuMethods_Identical 0.0 65535.0 FORMAT "%5.1" MAX_REFRESH 3 200 /end CHARACTERISTIC
/begin CHARACTERISTIC rba_BypEtk_EGRVlv_rDesVal_bypass_CST.Channel_u16 "Value must not be changed manually. This is done automatically by Ascet/Intecrio/" VALUE 0xB92E003A DefaultValueRecordLayout_AUTOSAR_Platform_BaseTypes_uint16 65535.0 RB_RBA_Common_CentralElements_CompuMethods_Identical 0.0 65535.0 FORMAT "%5.1" MAX_REFRESH 3 200 /end CHARACTERISTIC
/begin CHARACTERISTIC rba_BypEtk_EGRVlv_rGovActr_bypass_CST.Vector_u16 "Value must not be changed manually. This is done automatically by Ascet/Intecrio/" VALUE 0xB92E0034 DefaultValueRecordLayout_AUTOSAR_Platform_BaseTypes_uint16 65535.0 RB_RBA_Common_CentralElements_CompuMethods_Identical 0.0 65535.0 FORMAT "%5.1" MAX_REFRESH 3 200 /end CHARACTERISTIC
/begin CHARACTERISTIC rba_BypEtk_EGRVlv_rGovActr_bypass_CST.Channel_u16 "Value must not be changed manually. This is done automatically by Ascet/Intecrio/" VALUE 0xB92E0036 DefaultValueRecordLayout_AUTOSAR_Platform_BaseTypes_uint16 65535.0 RB_RBA_Common_CentralElements_CompuMethods_Identical 0.0 65535.0 FORMAT "%5.1" MAX_REFRESH 3 200 /end CHARACTERISTIC
/begin CHARACTERISTIC rba_BypEtk_EGRVlv_rPs_bypass_CST.Vector_u16 "Value must not be changed manually. This is done automatically by Ascet/Intecrio/" VALUE 0xB92E0030 DefaultValueRecordLayout_AUTOSAR_Platform_BaseTypes_uint16 65535.0 RB_RBA_Common_CentralElements_CompuMethods_Identical 0.0 65535.0 FORMAT "%5.1" MAX_REFRESH 3 200 /end CHARACTERISTIC
/begin CHARACTERISTIC rba_BypEtk_EGRVlv_rPs_bypass_CST.Channel_u16 "Value must not be changed manually. This is done automatically by Ascet/Intecrio/" VALUE 0xB92E0032 DefaultValueRecordLayout_AUTOSAR_Platform_BaseTypes_uint16 65535.0 RB_RBA_Common_CentralElements_CompuMethods_Identical 0.0 65535.0 FORMAT "%5.1" MAX_REFRESH 3 200 /end CHARACTERISTIC
/begin CHARACTERISTIC rba_BypEtk_EGRVlv_uRelPosClsd_bypass_CST.Vector_u16 "Value must not be changed manually. This is done automatically by Ascet/Intecrio/" VALUE 0xB92E002C DefaultValueRecordLayout_AUTOSAR_Platform_BaseTypes_uint16 65535.0 RB_RBA_Common_CentralElements_CompuMethods_Identical 0.0 65535.0 FORMAT "%5.1" MAX_REFRESH 3 200 /end CHARACTERISTIC
/begin CHARACTERISTIC rba_BypEtk_EGRVlv_uRelPosClsd_bypass_CST.Channel_u16 "Value must not be changed manually. This is done automatically by Ascet/Intecrio/" VALUE 0xB92E002E DefaultValueRecordLayout_AUTOSAR_Platform_BaseTypes_uint16 65535.0 RB_RBA_Common_CentralElements_CompuMethods_Identical 0.0 65535.0 FORMAT "%5.1" MAX_REFRESH 3 200 /end CHARACTERISTIC
/begin CHARACTERISTIC rba_BypEtk_EGRVlv_uRelPosOpn_bypass_CST.Vector_u16 "Value must not be changed manually. This is done automatically by Ascet/Intecrio/" VALUE 0xB92E0028 DefaultValueRecordLayout_AUTOSAR_Platform_BaseTypes_uint16 65535.0 RB_RBA_Common_CentralElements_CompuMethods_Identical 0.0 65535.0 FORMAT "%5.1" MAX_REFRESH 3 200 /end CHARACTERISTIC
/begin CHARACTERISTIC rba_BypEtk_EGRVlv_uRelPosOpn_bypass_CST.Channel_u16 "Value must not be changed manually. This is done automatically by Ascet/Intecrio/" VALUE 0xB92E002A DefaultValueRecordLayout_AUTOSAR_Platform_BaseTypes_uint16 65535.0 RB_RBA_Common_CentralElements_CompuMethods_Identical 0.0 65535.0 FORMAT "%5.1" MAX_REFRESH 3 200 /end CHARACTERISTIC
/begin CHARACTERISTIC rba_BypEtk_PT_trqCrSDCS_bypass_CST.Vector_u16 "Value must not be changed manually. This is done automatically by Ascet/Intecrio/" VALUE 0xB92E0024 DefaultValueRecordLayout_AUTOSAR_Platform_BaseTypes_uint16 65535.0 RB_RBA_Common_CentralElements_CompuMethods_Identical 0.0 65535.0 FORMAT "%5.1" MAX_REFRESH 3 200 /end CHARACTERISTIC
/begin CHARACTERISTIC rba_BypEtk_PT_trqCrSDCS_bypass_CST.Channel_u16 "Value must not be changed manually. This is done automatically by Ascet/Intecrio/" VALUE 0xB92E0026 DefaultValueRecordLayout_AUTOSAR_Platform_BaseTypes_uint16 65535.0 RB_RBA_Common_CentralElements_CompuMethods_Identical 0.0 65535.0 FORMAT "%5.1" MAX_REFRESH 3 200 /end CHARACTERISTIC
/begin CHARACTERISTIC rba_BypEtk_PT_trqCrSDes_bypass_CST.Vector_u16 "Value must not be changed manually. This is done automatically by Ascet/Intecrio/" VALUE 0xB92E0020 DefaultValueRecordLayout_AUTOSAR_Platform_BaseTypes_uint16 65535.0 RB_RBA_Common_CentralElements_CompuMethods_Identical 0.0 65535.0 FORMAT "%5.1" MAX_REFRESH 3 200 /end CHARACTERISTIC
/begin CHARACTERISTIC rba_BypEtk_PT_trqCrSDes_bypass_CST.Channel_u16 "Value must not be changed manually. This is done automatically by Ascet/Intecrio/" VALUE 0xB92E0022 DefaultValueRecordLayout_AUTOSAR_Platform_BaseTypes_uint16 65535.0 RB_RBA_Common_CentralElements_CompuMethods_Identical 0.0 65535.0 FORMAT "%5.1" MAX_REFRESH 3 200 /end CHARACTERISTIC
/begin CHARACTERISTIC rba_BypEtk_PT_trqCrSPTPrt_bypass_CST.Vector_u16 "Value must not be changed manually. This is done automatically by Ascet/Intecrio/" VALUE 0xB92E001C DefaultValueRecordLayout_AUTOSAR_Platform_BaseTypes_uint16 65535.0 RB_RBA_Common_CentralElements_CompuMethods_Identical 0.0 65535.0 FORMAT "%5.1" MAX_REFRESH 3 200 /end CHARACTERISTIC
/begin CHARACTERISTIC rba_BypEtk_PT_trqCrSPTPrt_bypass_CST.Channel_u16 "Value must not be changed manually. This is done automatically by Ascet/Intecrio/" VALUE 0xB92E001E DefaultValueRecordLayout_AUTOSAR_Platform_BaseTypes_uint16 65535.0 RB_RBA_Common_CentralElements_CompuMethods_Identical 0.0 65535.0 FORMAT "%5.1" MAX_REFRESH 3 200 /end CHARACTERISTIC
/begin CHARACTERISTIC rba_BypEtk_PT_trqCrSWoTraIntv_bypass_CST.Vector_u16 "Value must not be changed manually. This is done automatically by Ascet/Intecrio/" VALUE 0xB92E0018 DefaultValueRecordLayout_AUTOSAR_Platform_BaseTypes_uint16 65535.0 RB_RBA_Common_CentralElements_CompuMethods_Identical 0.0 65535.0 FORMAT "%5.1" MAX_REFRESH 3 200 /end CHARACTERISTIC
/begin CHARACTERISTIC rba_BypEtk_PT_trqCrSWoTraIntv_bypass_CST.Channel_u16 "Value must not be changed manually. This is done automatically by Ascet/Intecrio/" VALUE 0xB92E001A DefaultValueRecordLayout_AUTOSAR_Platform_BaseTypes_uint16 65535.0 RB_RBA_Common_CentralElements_CompuMethods_Identical 0.0 65535.0 FORMAT "%5.1" MAX_REFRESH 3 200 /end CHARACTERISTIC
/begin CHARACTERISTIC rba_BypEtk_PT_trqCrsPTPrt_bypass_CST.Vector_u16 "Value must not be changed manually. This is done automatically by Ascet/Intecrio/" VALUE 0xB92E0014 DefaultValueRecordLayout_AUTOSAR_Platform_BaseTypes_uint16 65535.0 RB_RBA_Common_CentralElements_CompuMethods_Identical 0.0 65535.0 FORMAT "%5.1" MAX_REFRESH 3 200 /end CHARACTERISTIC
/begin CHARACTERISTIC rba_BypEtk_PT_trqCrsPTPrt_bypass_CST.Channel_u16 "Value must not be changed manually. This is done automatically by Ascet/Intecrio/" VALUE 0xB92E0016 DefaultValueRecordLayout_AUTOSAR_Platform_BaseTypes_uint16 65535.0 RB_RBA_Common_CentralElements_CompuMethods_Identical 0.0 65535.0 FORMAT "%5.1" MAX_REFRESH 3 200 /end CHARACTERISTIC
/begin CHARACTERISTIC rba_BypEtk_PT_trqCrsWoIntv_bypass_CST.Vector_u16 "Value must not be changed manually. This is done automatically by Ascet/Intecrio/" VALUE 0xB92E0010 DefaultValueRecordLayout_AUTOSAR_Platform_BaseTypes_uint16 65535.0 RB_RBA_Common_CentralElements_CompuMethods_Identical 0.0 65535.0 FORMAT "%5.1" MAX_REFRESH 3 200 /end CHARACTERISTIC
/begin CHARACTERISTIC rba_BypEtk_PT_trqCrsWoIntv_bypass_CST.Channel_u16 "Value must not be changed manually. This is done automatically by Ascet/Intecrio/" VALUE 0xB92E0012 DefaultValueRecordLayout_AUTOSAR_Platform_BaseTypes_uint16 65535.0 RB_RBA_Common_CentralElements_CompuMethods_Identical 0.0 65535.0 FORMAT "%5.1" MAX_REFRESH 3 200 /end CHARACTERISTIC
/begin CHARACTERISTIC rba_BypEtk_VMD_rVirtAPP_bypass_CST.Vector_u16 "Value must not be changed manually. This is done automatically by Ascet/Intecrio/" VALUE 0xB92E000C DefaultValueRecordLayout_AUTOSAR_Platform_BaseTypes_uint16 65535.0 RB_RBA_Common_CentralElements_CompuMethods_Identical 0.0 65535.0 FORMAT "%5.1" MAX_REFRESH 3 200 /end CHARACTERISTIC
/begin CHARACTERISTIC rba_BypEtk_VMD_rVirtAPP_bypass_CST.Channel_u16 "Value must not be changed manually. This is done automatically by Ascet/Intecrio/" VALUE 0xB92E000E DefaultValueRecordLayout_AUTOSAR_Platform_BaseTypes_uint16 65535.0 RB_RBA_Common_CentralElements_CompuMethods_Identical 0.0 65535.0 FORMAT "%5.1" MAX_REFRESH 3 200 /end CHARACTERISTIC
/begin CHARACTERISTIC rba_BypEtk_VMD_trqDes_bypass_CST.Vector_u16 "Value must not be changed manually. This is done automatically by Ascet/Intecrio/" VALUE 0xB92E0008 DefaultValueRecordLayout_AUTOSAR_Platform_BaseTypes_uint16 65535.0 RB_RBA_Common_CentralElements_CompuMethods_Identical 0.0 65535.0 FORMAT "%5.1" MAX_REFRESH 3 200 /end CHARACTERISTIC
/begin CHARACTERISTIC rba_BypEtk_VMD_trqDes_bypass_CST.Channel_u16 "Value must not be changed manually. This is done automatically by Ascet/Intecrio/" VALUE 0xB92E000A DefaultValueRecordLayout_AUTOSAR_Platform_BaseTypes_uint16 65535.0 RB_RBA_Common_CentralElements_CompuMethods_Identical 0.0 65535.0 FORMAT "%5.1" MAX_REFRESH 3 200 /end CHARACTERISTIC
/begin CHARACTERISTIC rba_BypEtk_VehMot_stPrpCrCtl_bypass_CST.Vector_u16 "Value must not be changed manually. This is done automatically by Ascet/Intecrio/" VALUE 0xB92E0004 DefaultValueRecordLayout_AUTOSAR_Platform_BaseTypes_uint16 65535.0 RB_RBA_Common_CentralElements_CompuMethods_Identical 0.0 65535.0 FORMAT "%5.1" MAX_REFRESH 3 200 /end CHARACTERISTIC
/begin CHARACTERISTIC rba_BypEtk_VehMot_stPrpCrCtl_bypass_CST.Channel_u16 "Value must not be changed manually. This is done automatically by Ascet/Intecrio/" VALUE 0xB92E0006 DefaultValueRecordLayout_AUTOSAR_Platform_BaseTypes_uint16 65535.0 RB_RBA_Common_CentralElements_CompuMethods_Identical 0.0 65535.0 FORMAT "%5.1" MAX_REFRESH 3 200 /end CHARACTERISTIC
/begin CHARACTERISTIC rba_Etks_swt3rdPartySupp_C "Enable 3rd party tool support for Etks" VALUE 0x804D8586 DefaultValueRecordLayout_AUTOSAR_Platform_BaseTypes_uint8 255.0 RB_RBA_Common_CentralElements_CompuMethods_Identical 0.0 255. FORMAT "%5.0" /end CHARACTERISTIC
/begin CHARACTERISTIC rba_IoDiagPwr_Config_rba_IoExtCy329_SignalMrly_0_BattVltgThres_C "Calibration for Battey Voltage Threshold rba_IoExtCy329_SignalMrly_0 in the post build config set rba_IoDiagPwr_Config" VALUE 0x804D82F0 DefaultValueRecordLayout_AUTOSAR_Platform_BaseTypes_uint32 4.0E9 RB_RBA_rba_IoDiagPwr_CompuMethod_rba_DiagPwr_BatteryThreshold_millivolts_CompuMethod 0.0 4.E9 FORMAT "%9.0" /end CHARACTERISTIC
/begin CHARACTERISTIC rba_IoDiagPwr_Config_rba_IoExtCy329_SignalMrly_0_TimeBtwTst_C "Calibration for Time Between Test Pulse rba_IoExtCy329_SignalMrly_0 in the post build config setrba_IoDiagPwr_Config" VALUE 0x804D8585 DefaultValueRecordLayout_AUTOSAR_Platform_BaseTypes_uint8 255.0 RB_RBA_rba_IoDiagPwr_CompuMethod_rba_DiagPwr_DelayTest_100ms_CompuMethod 0.0 255. FORMAT "%9.0" /end CHARACTERISTIC
/begin CHARACTERISTIC rba_IoSigDio_BrkMn_I_D_C "HW signal path for signal BrkMn_I_D in the post build config set __DEFAULT_VARIANT__" VALUE 0x804D84AA DefaultValueRecordLayout_AUTOSAR_Platform_BaseTypes_uint16 31.0 RB_RBA_rba_IoSigDio_CompuMethods_rba_IoSigDio_HWSigPathCompuMethod 0.0 31. FORMAT "%9.0" /end CHARACTERISTIC
/begin CHARACTERISTIC rba_IoSigDio_swtMrlyDCInv_C "Signal state inversion for signal MrlyDC in the post build config set __DEFAULT_VARIANT__" VALUE 0x804D8584 DefaultValueRecordLayout_AUTOSAR_Platform_BaseTypes_boolean 1.0 RB_RBA_rba_IoSigDio_CompuMethods_rba_IoSigDio_InvertCompuMethod 0.0 1. FORMAT "%9.0" /end CHARACTERISTIC
/begin CHARACTERISTIC rba_IoSigDio_swtP_FDBKSWE11Inv_C "Signal state inversion for signal P_FDBKSWE11 in the post build config set __DEFAULT_VARIANT__" VALUE 0x804D8583 DefaultValueRecordLayout_AUTOSAR_Platform_BaseTypes_boolean 1.0 RB_RBA_rba_IoSigDio_CompuMethods_rba_IoSigDio_InvertCompuMethod 0.0 1. FORMAT "%9.0" /end CHARACTERISTIC
/begin CHARACTERISTIC rba_IoSigRtc_stDiagErrInject_StopCounter_C "error inject param for signal StopCounter" VALUE 0x804D84A8 DefaultValueRecordLayout_AUTOSAR_Platform_BaseTypes_uint16 8.0 RB_RBA_rba_IoSigRtc_CompuMethods_rba_IoSigRtc_DiagErrInjectCompuMethod 0.0 8. FORMAT "%9.0" /end CHARACTERISTIC
/begin CHARACTERISTIC rba_MRly_Diag_Stk_tiOkError_C "Debounce time of main relay sticky diagnosis for detecting an error" VALUE 0x804D82EC DefaultValueRecordLayout_AUTOSAR_Platform_BaseTypes_uint32 3000.0 RB_RBA_rba_MRly_BswModuleDescriptions_rba_MRly_Calibration_Common_milliseconds_CompuMethod 0.0 3000. FORMAT "%5.0" /end CHARACTERISTIC
/begin CHARACTERISTIC rba_MRly_Sens_Measd_tiHiLo_C "Debounce time of main relay actual state measured. Time to open the main relay in ms" VALUE 0x804D82E8 DefaultValueRecordLayout_AUTOSAR_Platform_BaseTypes_uint32 200.0 RB_RBA_rba_MRly_BswModuleDescriptions_rba_MRly_Calibration_Common_milliseconds_CompuMethod 0.0 200. FORMAT "%5.0" /end CHARACTERISTIC
/begin CHARACTERISTIC rba_MRly_Sens_Measd_tiLoHi_C "Debounce time of main relay actual state measured. Time to close the main relay in ms" VALUE 0x804D82E4 DefaultValueRecordLayout_AUTOSAR_Platform_BaseTypes_uint32 200.0 RB_RBA_rba_MRly_BswModuleDescriptions_rba_MRly_Calibration_Common_milliseconds_CompuMethod 0.0 200. FORMAT "%5.0" /end CHARACTERISTIC
/begin CHARACTERISTIC rba_MRly_Sens_Measd_uBattClosedThr_C "Battery voltage threshold to detect the main relay as closed" VALUE 0x804D82E0 DefaultValueRecordLayout_AUTOSAR_Platform_BaseTypes_uint32 30000.0 RB_RBA_rba_MRly_BswModuleDescriptions_rba_MRly_Sens_Measd_uBattClosedThr_millivolts_CompuMethod 0.0 30000. FORMAT "%5.0" /end CHARACTERISTIC
/begin CHARACTERISTIC rba_MultiStackTrace_ResetMaxValues "Reset max stack values saved in NvM" VALUE 0x804D8582 DefaultValueRecordLayout_AUTOSAR_Platform_BaseTypes_uint8 1.0 RB_RBA_Common_CentralElements_CompuMethods_Identical 0.0 1. FORMAT "%5.0" /end CHARACTERISTIC
/begin CHARACTERISTIC rba_MultiStackTrace_ThresholdSwitch "Select the Stack Limit Threshold Range from 0-5" VALUE 0x804D8581 DefaultValueRecordLayout_AUTOSAR_Platform_BaseTypes_uint8 5.0 RB_RBA_Common_CentralElements_CompuMethods_Identical 0.0 5. FORMAT "%5.0" /end CHARACTERISTIC
/begin CHARACTERISTIC rba_OsMeasmt_CoreLoadThresholdValue_C "Set a Threshold CoreLoad value for the dem event generation" VALUE 0x804D84A6 DefaultValueRecordLayout_AUTOSAR_Platform_BaseTypes_uint16 655.0 RB_RBA_rba_OsMeasmt_CompuMethods_rba_OsMeasmt_PercConversion 0.0 655.00 FORMAT "%5.2" /end CHARACTERISTIC
/begin CHARACTERISTIC rba_OsMeasmt_ResetMaxCoreLoadValues_C "Reset max core load values saved in NvM" VALUE 0x804D8580 DefaultValueRecordLayout_AUTOSAR_Platform_BaseTypes_uint8 1.0 RB_RBA_Common_CentralElements_CompuMethods_Identical 0.0 1. FORMAT "%5.0" /end CHARACTERISTIC
/begin CHARACTERISTIC rba_OsMeasmt_ResetResponseTimeValues_C "Reset max response time values saved in NvM" VALUE 0x804D857F DefaultValueRecordLayout_AUTOSAR_Platform_BaseTypes_uint8 1.0 RB_RBA_Common_CentralElements_CompuMethods_Identical 0.0 1. FORMAT "%5.0" /end CHARACTERISTIC
/begin CHARACTERISTIC rba_OsMeasmt_SwTrace_InitMode_C "Init mode which shall be used for the rba_SwTrace / Gliwa T1 initialization" VALUE 0x804D857E DefaultValueRecordLayout_AUTOSAR_Platform_BaseTypes_uint8 2.0 RB_RBA_rba_OsMeasmt_CompuMethods_rba_OsMeasmt_SwTrace_InitMode_CompuMethod 0.0 2. FORMAT "%5.0" /end CHARACTERISTIC
/begin MEASUREMENT Com_IpduBuf_ENG10_Tx "Tx Ipdu buffer of IPdu -ENG10_Tx- as a Measurement parameter" UBYTE RB_RBA_Common_CentralElements_CompuMethods_Identical 1 100 0.0 255. FORMAT "%5.0" ARRAY_SIZE 8 ECU_ADDRESS 0x60010726 /end MEASUREMENT
/begin MEASUREMENT Com_IpduBuf_ENG11_Tx "Tx Ipdu buffer of IPdu -ENG11_Tx- as a Measurement parameter" UBYTE RB_RBA_Common_CentralElements_CompuMethods_Identical 1 100 0.0 255. FORMAT "%5.0" ARRAY_SIZE 8 ECU_ADDRESS 0x6001071E /end MEASUREMENT
/begin MEASUREMENT Com_IpduBuf_ENG15_Tx "Tx Ipdu buffer of IPdu -ENG15_Tx- as a Measurement parameter" UBYTE RB_RBA_Common_CentralElements_CompuMethods_Identical 1 100 0.0 255. FORMAT "%5.0" ARRAY_SIZE 8 ECU_ADDRESS 0x60010716 /end MEASUREMENT
/begin MEASUREMENT Com_IpduBuf_ENG16_Tx "Tx Ipdu buffer of IPdu -ENG16_Tx- as a Measurement parameter" UBYTE RB_RBA_Common_CentralElements_CompuMethods_Identical 1 100 0.0 255. FORMAT "%5.0" ARRAY_SIZE 8 ECU_ADDRESS 0x6001070E /end MEASUREMENT
/begin MEASUREMENT Com_IpduBuf_ENG17_Tx "Tx Ipdu buffer of IPdu -ENG17_Tx- as a Measurement parameter" UBYTE RB_RBA_Common_CentralElements_CompuMethods_Identical 1 100 0.0 255. FORMAT "%5.0" ARRAY_SIZE 8 ECU_ADDRESS 0x60010706 /end MEASUREMENT
/begin MEASUREMENT Com_IpduBuf_ENG18_Tx "Tx Ipdu buffer of IPdu -ENG18_Tx- as a Measurement parameter" UBYTE RB_RBA_Common_CentralElements_CompuMethods_Identical 1 100 0.0 255. FORMAT "%5.0" ARRAY_SIZE 8 ECU_ADDRESS 0x600106FE /end MEASUREMENT
/begin MEASUREMENT Com_IpduBuf_ENG19_Tx "Tx Ipdu buffer of IPdu -ENG19_Tx- as a Measurement parameter" UBYTE RB_RBA_Common_CentralElements_CompuMethods_Identical 1 100 0.0 255. FORMAT "%5.0" ARRAY_SIZE 8 ECU_ADDRESS 0x600106F6 /end MEASUREMENT
/begin MEASUREMENT Com_IpduBuf_ENG20_Tx "Tx Ipdu buffer of IPdu -ENG20_Tx- as a Measurement parameter" UBYTE RB_RBA_Common_CentralElements_CompuMethods_Identical 1 100 0.0 255. FORMAT "%5.0" ARRAY_SIZE 8 ECU_ADDRESS 0x600106EE /end MEASUREMENT
/begin MEASUREMENT Com_IpduBuf_ENG21_Tx "Tx Ipdu buffer of IPdu -ENG21_Tx- as a Measurement parameter" UBYTE RB_RBA_Common_CentralElements_CompuMethods_Identical 1 100 0.0 255. FORMAT "%5.0" ARRAY_SIZE 8 ECU_ADDRESS 0x600106E6 /end MEASUREMENT
/begin MEASUREMENT Com_IpduBuf_ENG22_Tx "Tx Ipdu buffer of IPdu -ENG22_Tx- as a Measurement parameter" UBYTE RB_RBA_Common_CentralElements_CompuMethods_Identical 1 100 0.0 255. FORMAT "%5.0" ARRAY_SIZE 8 ECU_ADDRESS 0x600106DE /end MEASUREMENT
/begin MEASUREMENT Com_IpduBuf_ENG23_Tx "Tx Ipdu buffer of IPdu -ENG23_Tx- as a Measurement parameter" UBYTE RB_RBA_Common_CentralElements_CompuMethods_Identical 1 100 0.0 255. FORMAT "%5.0" ARRAY_SIZE 8 ECU_ADDRESS 0x600106D6 /end MEASUREMENT
/begin MEASUREMENT Com_IpduBuf_ENG24_Tx "Tx Ipdu buffer of IPdu -ENG24_Tx- as a Measurement parameter" UBYTE RB_RBA_Common_CentralElements_CompuMethods_Identical 1 100 0.0 255. FORMAT "%5.0" ARRAY_SIZE 8 ECU_ADDRESS 0x600106CE /end MEASUREMENT
/begin MEASUREMENT Com_IpduBuf_ENG25_Tx "Tx Ipdu buffer of IPdu -ENG25_Tx- as a Measurement parameter" UBYTE RB_RBA_Common_CentralElements_CompuMethods_Identical 1 100 0.0 255. FORMAT "%5.0" ARRAY_SIZE 8 ECU_ADDRESS 0x600106C6 /end MEASUREMENT
/begin MEASUREMENT Com_IpduBuf_ENG2_Tx "Tx Ipdu buffer of IPdu -ENG2_Tx- as a Measurement parameter" UBYTE RB_RBA_Common_CentralElements_CompuMethods_Identical 1 100 0.0 255. FORMAT "%5.0" ARRAY_SIZE 5 ECU_ADDRESS 0x600106C1 /end MEASUREMENT
/begin MEASUREMENT Com_IpduBuf_ENG3_Tx "Tx Ipdu buffer of IPdu -ENG3_Tx- as a Measurement parameter" UBYTE RB_RBA_Common_CentralElements_CompuMethods_Identical 1 100 0.0 255. FORMAT "%5.0" ARRAY_SIZE 8 ECU_ADDRESS 0x600106B9 /end MEASUREMENT
/begin MEASUREMENT Com_IpduBuf_ENG4_Tx "Tx Ipdu buffer of IPdu -ENG4_Tx- as a Measurement parameter" UBYTE RB_RBA_Common_CentralElements_CompuMethods_Identical 1 100 0.0 255. FORMAT "%5.0" ARRAY_SIZE 8 ECU_ADDRESS 0x600106B1 /end MEASUREMENT
/begin MEASUREMENT Com_IpduBuf_ENG5_Tx "Tx Ipdu buffer of IPdu -ENG5_Tx- as a Measurement parameter" UBYTE RB_RBA_Common_CentralElements_CompuMethods_Identical 1 100 0.0 255. FORMAT "%5.0" ARRAY_SIZE 8 ECU_ADDRESS 0x600106A9 /end MEASUREMENT
/begin MEASUREMENT Com_IpduBuf_ENG6_Tx "Tx Ipdu buffer of IPdu -ENG6_Tx- as a Measurement parameter" UBYTE RB_RBA_Common_CentralElements_CompuMethods_Identical 1 100 0.0 255. FORMAT "%5.0" ARRAY_SIZE 8 ECU_ADDRESS 0x600106A1 /end MEASUREMENT
/begin MEASUREMENT Com_IpduBuf_ENGAE_Tx "Tx Ipdu buffer of IPdu -ENGAE_Tx- as a Measurement parameter" UBYTE RB_RBA_Common_CentralElements_CompuMethods_Identical 1 100 0.0 255. FORMAT "%5.0" ARRAY_SIZE 8 ECU_ADDRESS 0x60010699 /end MEASUREMENT
/begin MEASUREMENT Com_IpduBuf_ENGA_Tx "Tx Ipdu buffer of IPdu -ENGA_Tx- as a Measurement parameter" UBYTE RB_RBA_Common_CentralElements_CompuMethods_Identical 1 100 0.0 255. FORMAT "%5.0" ARRAY_SIZE 8 ECU_ADDRESS 0x60010691 /end MEASUREMENT
/begin MEASUREMENT Com_IpduBuf_ENGB_Tx "Tx Ipdu buffer of IPdu -ENGB_Tx- as a Measurement parameter" UBYTE RB_RBA_Common_CentralElements_CompuMethods_Identical 1 100 0.0 255. FORMAT "%5.0" ARRAY_SIZE 8 ECU_ADDRESS 0x60010689 /end MEASUREMENT
/begin MEASUREMENT Com_IpduBuf_ENGC_Tx "Tx Ipdu buffer of IPdu -ENGC_Tx- as a Measurement parameter" UBYTE RB_RBA_Common_CentralElements_CompuMethods_Identical 1 100 0.0 255. FORMAT "%5.0" ARRAY_SIZE 8 ECU_ADDRESS 0x60010681 /end MEASUREMENT
/begin MEASUREMENT Com_IpduBuf_ENGF_Tx "Tx Ipdu buffer of IPdu -ENGF_Tx- as a Measurement parameter" UBYTE RB_RBA_Common_CentralElements_CompuMethods_Identical 1 100 0.0 255. FORMAT "%5.0" ARRAY_SIZE 2 ECU_ADDRESS 0x6001067F /end MEASUREMENT
/begin MEASUREMENT Com_IpduBuf_ENGIMG1_Tx "Tx Ipdu buffer of IPdu -ENGIMG1_Tx- as a Measurement parameter" UBYTE RB_RBA_Common_CentralElements_CompuMethods_Identical 1 100 0.0 255. FORMAT "%5.0" ARRAY_SIZE 8 ECU_ADDRESS 0x60010677 /end MEASUREMENT
/begin MEASUREMENT Com_IpduBuf_ENGJ3_Tx "Tx Ipdu buffer of IPdu -ENGJ3_Tx- as a Measurement parameter" UBYTE RB_RBA_Common_CentralElements_CompuMethods_Identical 1 100 0.0 255. FORMAT "%5.0" ARRAY_SIZE 8 ECU_ADDRESS 0x6001066F /end MEASUREMENT
/begin MEASUREMENT Com_IpduBuf_ENGK3_Tx "Tx Ipdu buffer of IPdu -ENGK3_Tx- as a Measurement parameter" UBYTE RB_RBA_Common_CentralElements_CompuMethods_Identical 1 100 0.0 255. FORMAT "%5.0" ARRAY_SIZE 8 ECU_ADDRESS 0x60010667 /end MEASUREMENT
/begin MEASUREMENT Com_IpduBuf_ENGL_Tx "Tx Ipdu buffer of IPdu -ENGL_Tx- as a Measurement parameter" UBYTE RB_RBA_Common_CentralElements_CompuMethods_Identical 1 100 0.0 255. FORMAT "%5.0" ARRAY_SIZE 8 ECU_ADDRESS 0x6001065F /end MEASUREMENT
/begin MEASUREMENT Com_IpduBuf_ENGN_Tx "Tx Ipdu buffer of IPdu -ENGN_Tx- as a Measurement parameter" UBYTE RB_RBA_Common_CentralElements_CompuMethods_Identical 1 100 0.0 255. FORMAT "%5.0" ARRAY_SIZE 8 ECU_ADDRESS 0x60010657 /end MEASUREMENT
/begin MEASUREMENT Com_IpduBuf_ENGQ_Tx "Tx Ipdu buffer of IPdu -ENGQ_Tx- as a Measurement parameter" UBYTE RB_RBA_Common_CentralElements_CompuMethods_Identical 1 100 0.0 255. FORMAT "%5.0" ARRAY_SIZE 2 ECU_ADDRESS 0x60010655 /end MEASUREMENT
/begin MEASUREMENT Com_IpduBuf_ENGR_Tx "Tx Ipdu buffer of IPdu -ENGR_Tx- as a Measurement parameter" UBYTE RB_RBA_Common_CentralElements_CompuMethods_Identical 1 100 0.0 255. FORMAT "%5.0" ARRAY_SIZE 5 ECU_ADDRESS 0x60010650 /end MEASUREMENT
/begin MEASUREMENT Com_IpduBuf_ENGT1_Tx "Tx Ipdu buffer of IPdu -ENGT1_Tx- as a Measurement parameter" UBYTE RB_RBA_Common_CentralElements_CompuMethods_Identical 1 100 0.0 255. FORMAT "%5.0" ARRAY_SIZE 8 ECU_ADDRESS 0x60010648 /end MEASUREMENT
/begin MEASUREMENT Com_IpduBuf_ENGT2_Tx "Tx Ipdu buffer of IPdu -ENGT2_Tx- as a Measurement parameter" UBYTE RB_RBA_Common_CentralElements_CompuMethods_Identical 1 100 0.0 255. FORMAT "%5.0" ARRAY_SIZE 8 ECU_ADDRESS 0x60010640 /end MEASUREMENT
/begin MEASUREMENT Com_IpduBuf_ENGT_Tx "Tx Ipdu buffer of IPdu -ENGT_Tx- as a Measurement parameter" UBYTE RB_RBA_Common_CentralElements_CompuMethods_Identical 1 100 0.0 255. FORMAT "%5.0" ARRAY_SIZE 8 ECU_ADDRESS 0x60010638 /end MEASUREMENT
/begin MEASUREMENT Com_IpduBuf_ENGU_Tx "Tx Ipdu buffer of IPdu -ENGU_Tx- as a Measurement parameter" UBYTE RB_RBA_Common_CentralElements_CompuMethods_Identical 1 100 0.0 255. FORMAT "%5.0" ARRAY_SIZE 8 ECU_ADDRESS 0x60010630 /end MEASUREMENT
/begin MEASUREMENT Com_IpduBuf_ENGV_Tx "Tx Ipdu buffer of IPdu -ENGV_Tx- as a Measurement parameter" UBYTE RB_RBA_Common_CentralElements_CompuMethods_Identical 1 100 0.0 255. FORMAT "%5.0" ARRAY_SIZE 8 ECU_ADDRESS 0x60010628 /end MEASUREMENT
/begin MEASUREMENT Com_IpduBuf_ENGW_Tx "Tx Ipdu buffer of IPdu -ENGW_Tx- as a Measurement parameter" UBYTE RB_RBA_Common_CentralElements_CompuMethods_Identical 1 100 0.0 255. FORMAT "%5.0" ARRAY_SIZE 8 ECU_ADDRESS 0x60010620 /end MEASUREMENT
/begin MEASUREMENT Com_IpduBuf_ENGX2_Tx "Tx Ipdu buffer of IPdu -ENGX2_Tx- as a Measurement parameter" UBYTE RB_RBA_Common_CentralElements_CompuMethods_Identical 1 100 0.0 255. FORMAT "%5.0" ARRAY_SIZE 8 ECU_ADDRESS 0x60010618 /end MEASUREMENT
/begin MEASUREMENT Com_IpduBuf_ENGY2_Tx "Tx Ipdu buffer of IPdu -ENGY2_Tx- as a Measurement parameter" UBYTE RB_RBA_Common_CentralElements_CompuMethods_Identical 1 100 0.0 255. FORMAT "%5.0" ARRAY_SIZE 4 ECU_ADDRESS 0x60010614 /end MEASUREMENT
/begin MEASUREMENT Com_IpduBuf_ENGY_Tx "Tx Ipdu buffer of IPdu -ENGY_Tx- as a Measurement parameter" UBYTE RB_RBA_Common_CentralElements_CompuMethods_Identical 1 100 0.0 255. FORMAT "%5.0" ARRAY_SIZE 5 ECU_ADDRESS 0x6001060F /end MEASUREMENT
/begin MEASUREMENT Com_IpduBuf_ENGZ_Tx "Tx Ipdu buffer of IPdu -ENGZ_Tx- as a Measurement parameter" UBYTE RB_RBA_Common_CentralElements_CompuMethods_Identical 1 100 0.0 255. FORMAT "%5.0" ARRAY_SIZE 8 ECU_ADDRESS 0x60010607 /end MEASUREMENT
/begin MEASUREMENT Com_IpduBuf_Lin_Alt_Tx_ACG_CTL_Tx "Tx Ipdu buffer of IPdu -Lin_Alt_Tx_ACG_CTL_Tx- as a Measurement parameter" UBYTE RB_RBA_Common_CentralElements_CompuMethods_Identical 1 100 0.0 255. FORMAT "%5.0" ARRAY_SIZE 4 ECU_ADDRESS 0x60010603 /end MEASUREMENT
/begin MEASUREMENT Com_IpduBuf_Lin_BS_Tx_EBSA_Tx "Tx Ipdu buffer of IPdu -Lin_BS_Tx_EBSA_Tx- as a Measurement parameter" UBYTE RB_RBA_Common_CentralElements_CompuMethods_Identical 1 100 0.0 255. FORMAT "%5.0" ARRAY_SIZE 8 ECU_ADDRESS 0x600105FB /end MEASUREMENT
/begin MEASUREMENT Com_IpduBuf_Lin_DCDC_Tx_DCDC_Tx "Tx Ipdu buffer of IPdu -Lin_DCDC_Tx_DCDC_Tx- as a Measurement parameter" UBYTE RB_RBA_Common_CentralElements_CompuMethods_Identical 1 100 0.0 255. FORMAT "%5.0" ARRAY_SIZE 2 ECU_ADDRESS 0x600105F9 /end MEASUREMENT
/begin MEASUREMENT Com_IpduBuf_eng1_Tx "Tx Ipdu buffer of IPdu -eng1_Tx- as a Measurement parameter" UBYTE RB_RBA_Common_CentralElements_CompuMethods_Identical 1 100 0.0 255. FORMAT "%5.0" ARRAY_SIZE 8 ECU_ADDRESS 0x600105F1 /end MEASUREMENT
/begin MEASUREMENT Com_IpduBuf_engo_Tx "Tx Ipdu buffer of IPdu -engo_Tx- as a Measurement parameter" UBYTE RB_RBA_Common_CentralElements_CompuMethods_Identical 1 100 0.0 255. FORMAT "%5.0" ARRAY_SIZE 8 ECU_ADDRESS 0x600105E9 /end MEASUREMENT
/begin MEASUREMENT Com_LocalBuf_AYCA_Rx "Rx Local Ipdu buffer of IPdu -AYCA_Rx- as a Measurement parameter" UBYTE RB_RBA_Common_CentralElements_CompuMethods_Identical 1 100 0.0 255. FORMAT "%5.0" ARRAY_SIZE 8 ECU_ADDRESS 0x600105E1 /end MEASUREMENT
/begin MEASUREMENT Com_LocalBuf_AYCD_Rx "Rx Local Ipdu buffer of IPdu -AYCD_Rx- as a Measurement parameter" UBYTE RB_RBA_Common_CentralElements_CompuMethods_Identical 1 100 0.0 255. FORMAT "%5.0" ARRAY_SIZE 8 ECU_ADDRESS 0x600105D9 /end MEASUREMENT
/begin MEASUREMENT Com_LocalBuf_AYCF_Rx "Rx Local Ipdu buffer of IPdu -AYCF_Rx- as a Measurement parameter" UBYTE RB_RBA_Common_CentralElements_CompuMethods_Identical 1 100 0.0 255. FORMAT "%5.0" ARRAY_SIZE 8 ECU_ADDRESS 0x600105D1 /end MEASUREMENT
/begin MEASUREMENT Com_LocalBuf_AYCG_Rx "Rx Local Ipdu buffer of IPdu -AYCG_Rx- as a Measurement parameter" UBYTE RB_RBA_Common_CentralElements_CompuMethods_Identical 1 100 0.0 255. FORMAT "%5.0" ARRAY_SIZE 7 ECU_ADDRESS 0x600105CA /end MEASUREMENT
/begin MEASUREMENT Com_LocalBuf_AYCI_Rx "Rx Local Ipdu buffer of IPdu -AYCI_Rx- as a Measurement parameter" UBYTE RB_RBA_Common_CentralElements_CompuMethods_Identical 1 100 0.0 255. FORMAT "%5.0" ARRAY_SIZE 8 ECU_ADDRESS 0x600105C2 /end MEASUREMENT
/begin MEASUREMENT Com_LocalBuf_BCM1_Rx "Rx Local Ipdu buffer of IPdu -BCM1_Rx- as a Measurement parameter" UBYTE RB_RBA_Common_CentralElements_CompuMethods_Identical 1 100 0.0 255. FORMAT "%5.0" ARRAY_SIZE 2 ECU_ADDRESS 0x600105C0 /end MEASUREMENT
/begin MEASUREMENT Com_LocalBuf_CGW1_Rx "Rx Local Ipdu buffer of IPdu -CGW1_Rx- as a Measurement parameter" UBYTE RB_RBA_Common_CentralElements_CompuMethods_Identical 1 100 0.0 255. FORMAT "%5.0" ARRAY_SIZE 1 ECU_ADDRESS 0x600105BF /end MEASUREMENT
/begin MEASUREMENT Com_LocalBuf_EAT10_Rx "Rx Local Ipdu buffer of IPdu -EAT10_Rx- as a Measurement parameter" UBYTE RB_RBA_Common_CentralElements_CompuMethods_Identical 1 100 0.0 255. FORMAT "%5.0" ARRAY_SIZE 8 ECU_ADDRESS 0x600105B7 /end MEASUREMENT
/begin MEASUREMENT Com_LocalBuf_EAT11_Rx "Rx Local Ipdu buffer of IPdu -EAT11_Rx- as a Measurement parameter" UBYTE RB_RBA_Common_CentralElements_CompuMethods_Identical 1 100 0.0 255. FORMAT "%5.0" ARRAY_SIZE 8 ECU_ADDRESS 0x600105AF /end MEASUREMENT
/begin MEASUREMENT Com_LocalBuf_EAT12_Rx "Rx Local Ipdu buffer of IPdu -EAT12_Rx- as a Measurement parameter" UBYTE RB_RBA_Common_CentralElements_CompuMethods_Identical 1 100 0.0 255. FORMAT "%5.0" ARRAY_SIZE 2 ECU_ADDRESS 0x600105AD /end MEASUREMENT
/begin MEASUREMENT Com_LocalBuf_EAT13_Rx "Rx Local Ipdu buffer of IPdu -EAT13_Rx- as a Measurement parameter" UBYTE RB_RBA_Common_CentralElements_CompuMethods_Identical 1 100 0.0 255. FORMAT "%5.0" ARRAY_SIZE 3 ECU_ADDRESS 0x600105AA /end MEASUREMENT
/begin MEASUREMENT Com_LocalBuf_EAT1_Rx "Rx Local Ipdu buffer of IPdu -EAT1_Rx- as a Measurement parameter" UBYTE RB_RBA_Common_CentralElements_CompuMethods_Identical 1 100 0.0 255. FORMAT "%5.0" ARRAY_SIZE 8 ECU_ADDRESS 0x600105A2 /end MEASUREMENT
/begin MEASUREMENT Com_LocalBuf_EAT2_Rx "Rx Local Ipdu buffer of IPdu -EAT2_Rx- as a Measurement parameter" UBYTE RB_RBA_Common_CentralElements_CompuMethods_Identical 1 100 0.0 255. FORMAT "%5.0" ARRAY_SIZE 8 ECU_ADDRESS 0x6001059A /end MEASUREMENT
/begin MEASUREMENT Com_LocalBuf_EAT4_Rx "Rx Local Ipdu buffer of IPdu -EAT4_Rx- as a Measurement parameter" UBYTE RB_RBA_Common_CentralElements_CompuMethods_Identical 1 100 0.0 255. FORMAT "%5.0" ARRAY_SIZE 8 ECU_ADDRESS 0x60010592 /end MEASUREMENT
/begin MEASUREMENT Com_LocalBuf_EAT6_Rx "Rx Local Ipdu buffer of IPdu -EAT6_Rx- as a Measurement parameter" UBYTE RB_RBA_Common_CentralElements_CompuMethods_Identical 1 100 0.0 255. FORMAT "%5.0" ARRAY_SIZE 3 ECU_ADDRESS 0x6001058F /end MEASUREMENT
/begin MEASUREMENT Com_LocalBuf_EAT7_Rx "Rx Local Ipdu buffer of IPdu -EAT7_Rx- as a Measurement parameter" UBYTE RB_RBA_Common_CentralElements_CompuMethods_Identical 1 100 0.0 255. FORMAT "%5.0" ARRAY_SIZE 8 ECU_ADDRESS 0x60010587 /end MEASUREMENT
/begin MEASUREMENT Com_LocalBuf_EAT8_Rx "Rx Local Ipdu buffer of IPdu -EAT8_Rx- as a Measurement parameter" UBYTE RB_RBA_Common_CentralElements_CompuMethods_Identical 1 100 0.0 255. FORMAT "%5.0" ARRAY_SIZE 8 ECU_ADDRESS 0x6001057F /end MEASUREMENT
/begin MEASUREMENT Com_LocalBuf_EATA_Rx "Rx Local Ipdu buffer of IPdu -EATA_Rx- as a Measurement parameter" UBYTE RB_RBA_Common_CentralElements_CompuMethods_Identical 1 100 0.0 255. FORMAT "%5.0" ARRAY_SIZE 8 ECU_ADDRESS 0x60010577 /end MEASUREMENT
/begin MEASUREMENT Com_LocalBuf_EATB_Rx "Rx Local Ipdu buffer of IPdu -EATB_Rx- as a Measurement parameter" UBYTE RB_RBA_Common_CentralElements_CompuMethods_Identical 1 100 0.0 255. FORMAT "%5.0" ARRAY_SIZE 8 ECU_ADDRESS 0x6001056F /end MEASUREMENT
/begin MEASUREMENT Com_LocalBuf_EATC_Rx "Rx Local Ipdu buffer of IPdu -EATC_Rx- as a Measurement parameter" UBYTE RB_RBA_Common_CentralElements_CompuMethods_Identical 1 100 0.0 255. FORMAT "%5.0" ARRAY_SIZE 8 ECU_ADDRESS 0x60010567 /end MEASUREMENT
/begin MEASUREMENT Com_LocalBuf_EPB2_Rx "Rx Local Ipdu buffer of IPdu -EPB2_Rx- as a Measurement parameter" UBYTE RB_RBA_Common_CentralElements_CompuMethods_Identical 1 100 0.0 255. FORMAT "%5.0" ARRAY_SIZE 8 ECU_ADDRESS 0x6001055F /end MEASUREMENT
/begin MEASUREMENT Com_LocalBuf_EPBB_Rx "Rx Local Ipdu buffer of IPdu -EPBB_Rx- as a Measurement parameter" UBYTE RB_RBA_Common_CentralElements_CompuMethods_Identical 1 100 0.0 255. FORMAT "%5.0" ARRAY_SIZE 8 ECU_ADDRESS 0x60010557 /end MEASUREMENT
/begin MEASUREMENT Com_LocalBuf_EPS1_Rx "Rx Local Ipdu buffer of IPdu -EPS1_Rx- as a Measurement parameter" UBYTE RB_RBA_Common_CentralElements_CompuMethods_Identical 1 100 0.0 255. FORMAT "%5.0" ARRAY_SIZE 3 ECU_ADDRESS 0x60010554 /end MEASUREMENT
/begin MEASUREMENT Com_LocalBuf_GWIMG1_Rx "Rx Local Ipdu buffer of IPdu -GWIMG1_Rx- as a Measurement parameter" UBYTE RB_RBA_Common_CentralElements_CompuMethods_Identical 1 100 0.0 255. FORMAT "%5.0" ARRAY_SIZE 8 ECU_ADDRESS 0x6001054C /end MEASUREMENT
/begin MEASUREMENT Com_LocalBuf_GWIMG3_Rx "Rx Local Ipdu buffer of IPdu -GWIMG3_Rx- as a Measurement parameter" UBYTE RB_RBA_Common_CentralElements_CompuMethods_Identical 1 100 0.0 255. FORMAT "%5.0" ARRAY_SIZE 8 ECU_ADDRESS 0x60010544 /end MEASUREMENT
/begin MEASUREMENT Com_LocalBuf_GWIMG4_Rx "Rx Local Ipdu buffer of IPdu -GWIMG4_Rx- as a Measurement parameter" UBYTE RB_RBA_Common_CentralElements_CompuMethods_Identical 1 100 0.0 255. FORMAT "%5.0" ARRAY_SIZE 8 ECU_ADDRESS 0x6001053C /end MEASUREMENT
/begin MEASUREMENT Com_LocalBuf_GWIMG5_Rx "Rx Local Ipdu buffer of IPdu -GWIMG5_Rx- as a Measurement parameter" UBYTE RB_RBA_Common_CentralElements_CompuMethods_Identical 1 100 0.0 255. FORMAT "%5.0" ARRAY_SIZE 8 ECU_ADDRESS 0x60010534 /end MEASUREMENT
/begin MEASUREMENT Com_LocalBuf_GWIMG6_Rx "Rx Local Ipdu buffer of IPdu -GWIMG6_Rx- as a Measurement parameter" UBYTE RB_RBA_Common_CentralElements_CompuMethods_Identical 1 100 0.0 255. FORMAT "%5.0" ARRAY_SIZE 8 ECU_ADDRESS 0x6001052C /end MEASUREMENT
/begin MEASUREMENT Com_LocalBuf_IDASB_Rx "Rx Local Ipdu buffer of IPdu -IDASB_Rx- as a Measurement parameter" UBYTE RB_RBA_Common_CentralElements_CompuMethods_Identical 1 100 0.0 255. FORMAT "%5.0" ARRAY_SIZE 8 ECU_ADDRESS 0x60010524 /end MEASUREMENT
/begin MEASUREMENT Com_LocalBuf_Lin_Alt_Rx_ACG_INFO_B_Rx "Rx Local Ipdu buffer of IPdu -Lin_Alt_Rx_ACG_INFO_B_Rx- as a Measurement parameter" UBYTE RB_RBA_Common_CentralElements_CompuMethods_Identical 1 100 0.0 255. FORMAT "%5.0" ARRAY_SIZE 4 ECU_ADDRESS 0x60010520 /end MEASUREMENT
/begin MEASUREMENT Com_LocalBuf_Lin_BS_Rx_EBSA_Rx "Rx Local Ipdu buffer of IPdu -Lin_BS_Rx_EBSA_Rx- as a Measurement parameter" UBYTE RB_RBA_Common_CentralElements_CompuMethods_Identical 1 100 0.0 255. FORMAT "%5.0" ARRAY_SIZE 8 ECU_ADDRESS 0x60010518 /end MEASUREMENT
/begin MEASUREMENT Com_LocalBuf_Lin_BS_Rx_EBSB_Rx "Rx Local Ipdu buffer of IPdu -Lin_BS_Rx_EBSB_Rx- as a Measurement parameter" UBYTE RB_RBA_Common_CentralElements_CompuMethods_Identical 1 100 0.0 255. FORMAT "%5.0" ARRAY_SIZE 8 ECU_ADDRESS 0x60010510 /end MEASUREMENT
/begin MEASUREMENT Com_LocalBuf_Lin_BS_Rx_EBSC_Rx "Rx Local Ipdu buffer of IPdu -Lin_BS_Rx_EBSC_Rx- as a Measurement parameter" UBYTE RB_RBA_Common_CentralElements_CompuMethods_Identical 1 100 0.0 255. FORMAT "%5.0" ARRAY_SIZE 8 ECU_ADDRESS 0x60010508 /end MEASUREMENT
/begin MEASUREMENT Com_LocalBuf_Lin_BS_Rx_EBSD_Rx "Rx Local Ipdu buffer of IPdu -Lin_BS_Rx_EBSD_Rx- as a Measurement parameter" UBYTE RB_RBA_Common_CentralElements_CompuMethods_Identical 1 100 0.0 255. FORMAT "%5.0" ARRAY_SIZE 8 ECU_ADDRESS 0x60010500 /end MEASUREMENT
/begin MEASUREMENT Com_LocalBuf_Lin_BS_Rx_EBSE_Rx "Rx Local Ipdu buffer of IPdu -Lin_BS_Rx_EBSE_Rx- as a Measurement parameter" UBYTE RB_RBA_Common_CentralElements_CompuMethods_Identical 1 100 0.0 255. FORMAT "%5.0" ARRAY_SIZE 8 ECU_ADDRESS 0x600104F8 /end MEASUREMENT
/begin MEASUREMENT Com_LocalBuf_Lin_BS_Rx_EBSF_Rx "Rx Local Ipdu buffer of IPdu -Lin_BS_Rx_EBSF_Rx- as a Measurement parameter" UBYTE RB_RBA_Common_CentralElements_CompuMethods_Identical 1 100 0.0 255. FORMAT "%5.0" ARRAY_SIZE 8 ECU_ADDRESS 0x600104F0 /end MEASUREMENT
/begin MEASUREMENT Com_LocalBuf_Lin_DCDC_Rx_DCDC0_Rx "Rx Local Ipdu buffer of IPdu -Lin_DCDC_Rx_DCDC0_Rx- as a Measurement parameter" UBYTE RB_RBA_Common_CentralElements_CompuMethods_Identical 1 100 0.0 255. FORMAT "%5.0" ARRAY_SIZE 2 ECU_ADDRESS 0x600104EE /end MEASUREMENT
/begin MEASUREMENT Com_LocalBuf_META_Rx "Rx Local Ipdu buffer of IPdu -META_Rx- as a Measurement parameter" UBYTE RB_RBA_Common_CentralElements_CompuMethods_Identical 1 100 0.0 255. FORMAT "%5.0" ARRAY_SIZE 8 ECU_ADDRESS 0x600104E6 /end MEASUREMENT
/begin MEASUREMENT Com_LocalBuf_METC_Rx "Rx Local Ipdu buffer of IPdu -METC_Rx- as a Measurement parameter" UBYTE RB_RBA_Common_CentralElements_CompuMethods_Identical 1 100 0.0 255. FORMAT "%5.0" ARRAY_SIZE 8 ECU_ADDRESS 0x600104DE /end MEASUREMENT
/begin MEASUREMENT Com_LocalBuf_METD2_Rx "Rx Local Ipdu buffer of IPdu -METD2_Rx- as a Measurement parameter" UBYTE RB_RBA_Common_CentralElements_CompuMethods_Identical 1 100 0.0 255. FORMAT "%5.0" ARRAY_SIZE 6 ECU_ADDRESS 0x600104D8 /end MEASUREMENT
/begin MEASUREMENT Com_LocalBuf_METD_Rx "Rx Local Ipdu buffer of IPdu -METD_Rx- as a Measurement parameter" UBYTE RB_RBA_Common_CentralElements_CompuMethods_Identical 1 100 0.0 255. FORMAT "%5.0" ARRAY_SIZE 7 ECU_ADDRESS 0x600104D1 /end MEASUREMENT
/begin MEASUREMENT Com_LocalBuf_METE2_Rx "Rx Local Ipdu buffer of IPdu -METE2_Rx- as a Measurement parameter" UBYTE RB_RBA_Common_CentralElements_CompuMethods_Identical 1 100 0.0 255. FORMAT "%5.0" ARRAY_SIZE 7 ECU_ADDRESS 0x600104CA /end MEASUREMENT
/begin MEASUREMENT Com_LocalBuf_METF_Rx "Rx Local Ipdu buffer of IPdu -METF_Rx- as a Measurement parameter" UBYTE RB_RBA_Common_CentralElements_CompuMethods_Identical 1 100 0.0 255. FORMAT "%5.0" ARRAY_SIZE 8 ECU_ADDRESS 0x600104C2 /end MEASUREMENT
/begin MEASUREMENT Com_LocalBuf_METG2_Rx "Rx Local Ipdu buffer of IPdu -METG2_Rx- as a Measurement parameter" UBYTE RB_RBA_Common_CentralElements_CompuMethods_Identical 1 100 0.0 255. FORMAT "%5.0" ARRAY_SIZE 8 ECU_ADDRESS 0x600104BA /end MEASUREMENT
/begin MEASUREMENT Com_LocalBuf_METG_Rx "Rx Local Ipdu buffer of IPdu -METG_Rx- as a Measurement parameter" UBYTE RB_RBA_Common_CentralElements_CompuMethods_Identical 1 100 0.0 255. FORMAT "%5.0" ARRAY_SIZE 4 ECU_ADDRESS 0x600104B6 /end MEASUREMENT
/begin MEASUREMENT Com_LocalBuf_METH2_Rx "Rx Local Ipdu buffer of IPdu -METH2_Rx- as a Measurement parameter" UBYTE RB_RBA_Common_CentralElements_CompuMethods_Identical 1 100 0.0 255. FORMAT "%5.0" ARRAY_SIZE 8 ECU_ADDRESS 0x600104AE /end MEASUREMENT
/begin MEASUREMENT Com_LocalBuf_METH_Rx "Rx Local Ipdu buffer of IPdu -METH_Rx- as a Measurement parameter" UBYTE RB_RBA_Common_CentralElements_CompuMethods_Identical 1 100 0.0 255. FORMAT "%5.0" ARRAY_SIZE 8 ECU_ADDRESS 0x600104A6 /end MEASUREMENT
/begin MEASUREMENT Com_LocalBuf_METI_Rx "Rx Local Ipdu buffer of IPdu -METI_Rx- as a Measurement parameter" UBYTE RB_RBA_Common_CentralElements_CompuMethods_Identical 1 100 0.0 255. FORMAT "%5.0" ARRAY_SIZE 8 ECU_ADDRESS 0x6001049E /end MEASUREMENT
/begin MEASUREMENT Com_LocalBuf_METK_Rx "Rx Local Ipdu buffer of IPdu -METK_Rx- as a Measurement parameter" UBYTE RB_RBA_Common_CentralElements_CompuMethods_Identical 1 100 0.0 255. FORMAT "%5.0" ARRAY_SIZE 8 ECU_ADDRESS 0x60010496 /end MEASUREMENT
/begin MEASUREMENT Com_LocalBuf_METL_Rx "Rx Local Ipdu buffer of IPdu -METL_Rx- as a Measurement parameter" UBYTE RB_RBA_Common_CentralElements_CompuMethods_Identical 1 100 0.0 255. FORMAT "%5.0" ARRAY_SIZE 4 ECU_ADDRESS 0x60010492 /end MEASUREMENT
/begin MEASUREMENT Com_LocalBuf_METM_Rx "Rx Local Ipdu buffer of IPdu -METM_Rx- as a Measurement parameter" UBYTE RB_RBA_Common_CentralElements_CompuMethods_Identical 1 100 0.0 255. FORMAT "%5.0" ARRAY_SIZE 8 ECU_ADDRESS 0x6001048A /end MEASUREMENT
/begin MEASUREMENT Com_LocalBuf_METN_Rx "Rx Local Ipdu buffer of IPdu -METN_Rx- as a Measurement parameter" UBYTE RB_RBA_Common_CentralElements_CompuMethods_Identical 1 100 0.0 255. FORMAT "%5.0" ARRAY_SIZE 4 ECU_ADDRESS 0x60010486 /end MEASUREMENT
/begin MEASUREMENT Com_LocalBuf_PCU_Rx "Rx Local Ipdu buffer of IPdu -PCU_Rx- as a Measurement parameter" UBYTE RB_RBA_Common_CentralElements_CompuMethods_Identical 1 100 0.0 255. FORMAT "%5.0" ARRAY_SIZE 1 ECU_ADDRESS 0x60010485 /end MEASUREMENT
/begin MEASUREMENT Com_LocalBuf_SRSA_Rx "Rx Local Ipdu buffer of IPdu -SRSA_Rx- as a Measurement parameter" UBYTE RB_RBA_Common_CentralElements_CompuMethods_Identical 1 100 0.0 255. FORMAT "%5.0" ARRAY_SIZE 8 ECU_ADDRESS 0x6001047D /end MEASUREMENT
/begin MEASUREMENT Com_LocalBuf_SRSB_Rx "Rx Local Ipdu buffer of IPdu -SRSB_Rx- as a Measurement parameter" UBYTE RB_RBA_Common_CentralElements_CompuMethods_Identical 1 100 0.0 255. FORMAT "%5.0" ARRAY_SIZE 3 ECU_ADDRESS 0x6001047A /end MEASUREMENT
/begin MEASUREMENT Com_LocalBuf_SRS_Rx "Rx Local Ipdu buffer of IPdu -SRS_Rx- as a Measurement parameter" UBYTE RB_RBA_Common_CentralElements_CompuMethods_Identical 1 100 0.0 255. FORMAT "%5.0" ARRAY_SIZE 7 ECU_ADDRESS 0x60010473 /end MEASUREMENT
/begin MEASUREMENT Com_SigType_au16 "Measurement variable for Signals of type - uint16,sint16. To refer Individual element in the Buffer array, Fetch Buffer Index from Com_PBcfg.c for each signal." UWORD RB_RBA_Common_CentralElements_CompuMethods_Identical 1 100 0.0 65535. FORMAT "%5.0" ARRAY_SIZE 45 ECU_ADDRESS 0x60009EF8 /end MEASUREMENT
/begin MEASUREMENT Com_SigType_au32 "Measurement variable for Signals of type - uint32,sint32. To refer Individual element in the Buffer array, Fetch Buffer Index from Com_PBcfg.c for each signal." ULONG RB_RBA_Common_CentralElements_CompuMethods_Identical 1 100 0.0 4.E9 FORMAT "%5.0" ARRAY_SIZE 1 ECU_ADDRESS 0x60003B78 /end MEASUREMENT
/begin MEASUREMENT Com_SigType_au8 "Measurement variable for Signals of type - uint8,sint8,boolean,uint8_n. To refer Individual element in the Buffer array, Fetch Buffer Index from Com_PBcfg.c for each signal." UBYTE RB_RBA_Common_CentralElements_CompuMethods_Identical 1 100 0.0 255. FORMAT "%5.0" ARRAY_SIZE 341 ECU_ADDRESS 0x60010281 /end MEASUREMENT
/begin MEASUREMENT rba_CanMcan_DriverState_MP "Flag to check if CAN driver is Initialized(CAN_READY(TRUE)) or Not Initialized (CAN_UNINIT(FALSE))" UBYTE RB_RBA_Common_CentralElements_CompuMethods_Identical 1 100 0.0 1. FORMAT "%5.0" ECU_ADDRESS 0x70004AC7 /end MEASUREMENT
/begin MEASUREMENT rba_CanMcan_MsgStatus_MP "This variable value describes the CAN message buffer status. The value is 1 if the message transmission is initiated and is reset(value 0) after the confirmation is given for the same." UBYTE RB_RBA_Common_CentralElements_CompuMethods_Identical 1 100 0.0 255. FORMAT "%5.0" ARRAY_SIZE 49 ECU_ADDRESS 0x60010DA0 /end MEASUREMENT
/begin MEASUREMENT rba_MRly_Ctrl_State_MP "Current control state of Main Relay" UBYTE RB_RBA_rba_MRly_BswModuleDescriptions_rba_MRly_Ctrl_States_CompuMethod 1 100 0.0 1.000 FORMAT "%8.3" ECU_ADDRESS 0x7000A960
 /begin ANNOTATION ANNOTATION_LABEL "Description (coming from AUTOSAR DESC field)" /begin ANNOTATION_TEXT "Current control state of Main Relay\r\n" /end ANNOTATION_TEXT /end ANNOTATION
/end MEASUREMENT
/begin MEASUREMENT rba_MultiStackTrace_CurrentCycleMaxUsage_CSA0 "Current Cycle Max Usage stack Csa0" UWORD RB_RBA_rba_OsMeasmt_CompuMethods_rba_OsMeasmt_PercConversion 1 100 0.0 655. FORMAT "%5.0" ECU_ADDRESS 0x6000A700 /end MEASUREMENT
/begin MEASUREMENT rba_MultiStackTrace_CurrentCycleMaxUsage_CSA1 "Current Cycle Max Usage stack Csa1" UWORD RB_RBA_rba_OsMeasmt_CompuMethods_rba_OsMeasmt_PercConversion 1 100 0.0 655. FORMAT "%5.0" ECU_ADDRESS 0x6000A6FE /end MEASUREMENT
/begin MEASUREMENT rba_MultiStackTrace_CurrentCycleMaxUsage_CSA2 "Current Cycle Max Usage stack Csa2" UWORD RB_RBA_rba_OsMeasmt_CompuMethods_rba_OsMeasmt_PercConversion 1 100 0.0 655. FORMAT "%5.0" ECU_ADDRESS 0x6000A6FC /end MEASUREMENT
/begin MEASUREMENT rba_MultiStackTrace_CurrentCycleMaxUsage_User0 "Current Cycle Max Usage stack User0" UWORD RB_RBA_rba_OsMeasmt_CompuMethods_rba_OsMeasmt_PercConversion 1 100 0.0 655. FORMAT "%5.0" ECU_ADDRESS 0x6000A706 /end MEASUREMENT
/begin MEASUREMENT rba_MultiStackTrace_CurrentCycleMaxUsage_User1 "Current Cycle Max Usage stack User1" UWORD RB_RBA_rba_OsMeasmt_CompuMethods_rba_OsMeasmt_PercConversion 1 100 0.0 655. FORMAT "%5.0" ECU_ADDRESS 0x6000A704 /end MEASUREMENT
/begin MEASUREMENT rba_MultiStackTrace_CurrentCycleMaxUsage_User2 "Current Cycle Max Usage stack User2" UWORD RB_RBA_rba_OsMeasmt_CompuMethods_rba_OsMeasmt_PercConversion 1 100 0.0 655. FORMAT "%5.0" ECU_ADDRESS 0x6000A702 /end MEASUREMENT
/begin MEASUREMENT rba_MultiStackTrace_LifeTimeMaxUsage_CSA0 "Life Time Max Usage stack CSA0" UWORD RB_RBA_rba_OsMeasmt_CompuMethods_rba_OsMeasmt_PercConversion 1 100 0.0 655. FORMAT "%5.0" ECU_ADDRESS 0x6003567A /end MEASUREMENT
/begin MEASUREMENT rba_MultiStackTrace_LifeTimeMaxUsage_CSA1 "Life Time Max Usage stack CSA1" UWORD RB_RBA_rba_OsMeasmt_CompuMethods_rba_OsMeasmt_PercConversion 1 100 0.0 655. FORMAT "%5.0" ECU_ADDRESS 0x60035678 /end MEASUREMENT
/begin MEASUREMENT rba_MultiStackTrace_LifeTimeMaxUsage_CSA2 "Life Time Max Usage stack CSA2" UWORD RB_RBA_rba_OsMeasmt_CompuMethods_rba_OsMeasmt_PercConversion 1 100 0.0 655. FORMAT "%5.0" ECU_ADDRESS 0x60035676 /end MEASUREMENT
/begin MEASUREMENT rba_MultiStackTrace_LifeTimeMaxUsage_User0 "Life Time Max Usage stack User0" UWORD RB_RBA_rba_OsMeasmt_CompuMethods_rba_OsMeasmt_PercConversion 1 100 0.0 655. FORMAT "%5.0" ECU_ADDRESS 0x60035680 /end MEASUREMENT
/begin MEASUREMENT rba_MultiStackTrace_LifeTimeMaxUsage_User1 "Life Time Max Usage stack User1" UWORD RB_RBA_rba_OsMeasmt_CompuMethods_rba_OsMeasmt_PercConversion 1 100 0.0 655. FORMAT "%5.0" ECU_ADDRESS 0x6003567E /end MEASUREMENT
/begin MEASUREMENT rba_MultiStackTrace_LifeTimeMaxUsage_User2 "Life Time Max Usage stack User2" UWORD RB_RBA_rba_OsMeasmt_CompuMethods_rba_OsMeasmt_PercConversion 1 100 0.0 655. FORMAT "%5.0" ECU_ADDRESS 0x6003567C /end MEASUREMENT
/begin MEASUREMENT rba_MultiStackTrace_ThresholdTable "Threshold table for Configured Limits" UWORD RB_RBA_Common_CentralElements_CompuMethods_Identical 1 100 0.0 65535. FORMAT "%5.0" ARRAY_SIZE 6 ECU_ADDRESS 0x70004A56 /end MEASUREMENT
/begin MEASUREMENT rba_OsMeasmt_CoreLoad[0].current "Core load Os measurement for each core[0]/" UWORD RB_RBA_rba_OsMeasmt_CompuMethods_rba_OsMeasmt_PercConversion 1 100 0.0 655.00 FORMAT "%5.2" ECU_ADDRESS 0x500009D2 /end MEASUREMENT
/begin MEASUREMENT rba_OsMeasmt_CoreLoad[1].current "Core load Os measurement for each core[1]/" UWORD RB_RBA_rba_OsMeasmt_CompuMethods_rba_OsMeasmt_PercConversion 1 100 0.0 655.00 FORMAT "%5.2" ECU_ADDRESS 0x500009D8 /end MEASUREMENT
/begin MEASUREMENT rba_OsMeasmt_CoreLoad[2].current "Core load Os measurement for each core[2]/" UWORD RB_RBA_rba_OsMeasmt_CompuMethods_rba_OsMeasmt_PercConversion 1 100 0.0 655.00 FORMAT "%5.2" ECU_ADDRESS 0x500009DE /end MEASUREMENT
/begin MEASUREMENT rba_OsMeasmt_CoreLoad[0].curCycleMax "Core load Os measurement for each core[0]/" UWORD RB_RBA_rba_OsMeasmt_CompuMethods_rba_OsMeasmt_PercConversion 1 100 0.0 655.00 FORMAT "%5.2" ECU_ADDRESS 0x500009D4 /end MEASUREMENT
/begin MEASUREMENT rba_OsMeasmt_CoreLoad[1].curCycleMax "Core load Os measurement for each core[1]/" UWORD RB_RBA_rba_OsMeasmt_CompuMethods_rba_OsMeasmt_PercConversion 1 100 0.0 655.00 FORMAT "%5.2" ECU_ADDRESS 0x500009DA /end MEASUREMENT
/begin MEASUREMENT rba_OsMeasmt_CoreLoad[2].curCycleMax "Core load Os measurement for each core[2]/" UWORD RB_RBA_rba_OsMeasmt_CompuMethods_rba_OsMeasmt_PercConversion 1 100 0.0 655.00 FORMAT "%5.2" ECU_ADDRESS 0x500009E0 /end MEASUREMENT
/begin MEASUREMENT rba_OsMeasmt_CoreLoad[0].lifeTimeMax "Core load Os measurement for each core[0]/" UWORD RB_RBA_rba_OsMeasmt_CompuMethods_rba_OsMeasmt_PercConversion 1 100 0.0 655.00 FORMAT "%5.2" ECU_ADDRESS 0x500009D6 /end MEASUREMENT
/begin MEASUREMENT rba_OsMeasmt_CoreLoad[1].lifeTimeMax "Core load Os measurement for each core[1]/" UWORD RB_RBA_rba_OsMeasmt_CompuMethods_rba_OsMeasmt_PercConversion 1 100 0.0 655.00 FORMAT "%5.2" ECU_ADDRESS 0x500009DC /end MEASUREMENT
/begin MEASUREMENT rba_OsMeasmt_CoreLoad[2].lifeTimeMax "Core load Os measurement for each core[2]/" UWORD RB_RBA_rba_OsMeasmt_CompuMethods_rba_OsMeasmt_PercConversion 1 100 0.0 655.00 FORMAT "%5.2" ECU_ADDRESS 0x500009E2 /end MEASUREMENT
/begin MEASUREMENT rba_OsMeasmt_OS_1000ms_Task.RespTimeCurrent "Task response time monitoring for OS_1000ms_Task/" ULONG RB_RBA_rba_OsMeasmt_CompuMethods_rba_OsMeasmt_TaskRespTime_CompuMethod 1 100 0.0 4.294967200E7 FORMAT "%13.9" ECU_ADDRESS 0x60015BA0 /end MEASUREMENT
/begin MEASUREMENT rba_OsMeasmt_OS_1000ms_Task.RespTimeCycleMax "Task response time monitoring for OS_1000ms_Task/" ULONG RB_RBA_rba_OsMeasmt_CompuMethods_rba_OsMeasmt_TaskRespTime_CompuMethod 1 100 0.0 4.294967200E7 FORMAT "%13.9" ECU_ADDRESS 0x60015BA4 /end MEASUREMENT
/begin MEASUREMENT rba_OsMeasmt_OS_1000ms_Task.RespTimeLifetimeMax "Task response time monitoring for OS_1000ms_Task/" ULONG RB_RBA_rba_OsMeasmt_CompuMethods_rba_OsMeasmt_TaskRespTime_CompuMethod 1 100 0.0 4.294967200E7 FORMAT "%13.9" ECU_ADDRESS 0x60015BA8 /end MEASUREMENT
/begin MEASUREMENT rba_OsMeasmt_OS_1000ms_Task.CETCurrent "Task response time monitoring for OS_1000ms_Task/" ULONG RB_RBA_rba_OsMeasmt_CompuMethods_rba_OsMeasmt_CET_T1_CompuMethod 1 100 0.0 4.294967200E7 FORMAT "%13.9" ECU_ADDRESS 0x60015BAC /end MEASUREMENT
/begin MEASUREMENT rba_OsMeasmt_OS_1000ms_Task.CETCycleMax "Task response time monitoring for OS_1000ms_Task/" ULONG RB_RBA_rba_OsMeasmt_CompuMethods_rba_OsMeasmt_CET_T1_CompuMethod 1 100 0.0 4.294967200E7 FORMAT "%13.9" ECU_ADDRESS 0x60015BB0 /end MEASUREMENT
/begin MEASUREMENT rba_OsMeasmt_OS_1000ms_Task.CETCurrentLoad "Task response time monitoring for OS_1000ms_Task/" UWORD RB_RBA_rba_OsMeasmt_CompuMethods_rba_OsMeasmt_T1_PercConversion 1 100 0.0 655.00 FORMAT "%5.2" ECU_ADDRESS 0x60015BB4 /end MEASUREMENT
/begin MEASUREMENT rba_OsMeasmt_OS_1000ms_Task.CETCurrentLoadMax "Task response time monitoring for OS_1000ms_Task/" UWORD RB_RBA_rba_OsMeasmt_CompuMethods_rba_OsMeasmt_T1_PercConversion 1 100 0.0 655.00 FORMAT "%5.2" ECU_ADDRESS 0x60015BB6 /end MEASUREMENT
/begin MEASUREMENT rba_OsMeasmt_OS_100ms_Task.RespTimeCurrent "Task response time monitoring for OS_100ms_Task/" ULONG RB_RBA_rba_OsMeasmt_CompuMethods_rba_OsMeasmt_TaskRespTime_CompuMethod 1 100 0.0 4.294967200E7 FORMAT "%13.9" ECU_ADDRESS 0x60015B88 /end MEASUREMENT
/begin MEASUREMENT rba_OsMeasmt_OS_100ms_Task.RespTimeCycleMax "Task response time monitoring for OS_100ms_Task/" ULONG RB_RBA_rba_OsMeasmt_CompuMethods_rba_OsMeasmt_TaskRespTime_CompuMethod 1 100 0.0 4.294967200E7 FORMAT "%13.9" ECU_ADDRESS 0x60015B8C /end MEASUREMENT
/begin MEASUREMENT rba_OsMeasmt_OS_100ms_Task.RespTimeLifetimeMax "Task response time monitoring for OS_100ms_Task/" ULONG RB_RBA_rba_OsMeasmt_CompuMethods_rba_OsMeasmt_TaskRespTime_CompuMethod 1 100 0.0 4.294967200E7 FORMAT "%13.9" ECU_ADDRESS 0x60015B90 /end MEASUREMENT
/begin MEASUREMENT rba_OsMeasmt_OS_100ms_Task.CETCurrent "Task response time monitoring for OS_100ms_Task/" ULONG RB_RBA_rba_OsMeasmt_CompuMethods_rba_OsMeasmt_CET_T1_CompuMethod 1 100 0.0 4.294967200E7 FORMAT "%13.9" ECU_ADDRESS 0x60015B94 /end MEASUREMENT
/begin MEASUREMENT rba_OsMeasmt_OS_100ms_Task.CETCycleMax "Task response time monitoring for OS_100ms_Task/" ULONG RB_RBA_rba_OsMeasmt_CompuMethods_rba_OsMeasmt_CET_T1_CompuMethod 1 100 0.0 4.294967200E7 FORMAT "%13.9" ECU_ADDRESS 0x60015B98 /end MEASUREMENT
/begin MEASUREMENT rba_OsMeasmt_OS_100ms_Task.CETCurrentLoad "Task response time monitoring for OS_100ms_Task/" UWORD RB_RBA_rba_OsMeasmt_CompuMethods_rba_OsMeasmt_T1_PercConversion 1 100 0.0 655.00 FORMAT "%5.2" ECU_ADDRESS 0x60015B9C /end MEASUREMENT
/begin MEASUREMENT rba_OsMeasmt_OS_100ms_Task.CETCurrentLoadMax "Task response time monitoring for OS_100ms_Task/" UWORD RB_RBA_rba_OsMeasmt_CompuMethods_rba_OsMeasmt_T1_PercConversion 1 100 0.0 655.00 FORMAT "%5.2" ECU_ADDRESS 0x60015B9E /end MEASUREMENT
/begin MEASUREMENT rba_OsMeasmt_OS_10ms_Task.RespTimeCurrent "Task response time monitoring for OS_10ms_Task/" ULONG RB_RBA_rba_OsMeasmt_CompuMethods_rba_OsMeasmt_TaskRespTime_CompuMethod 1 100 0.0 4.294967200E7 FORMAT "%13.9" ECU_ADDRESS 0x60015B70 /end MEASUREMENT
/begin MEASUREMENT rba_OsMeasmt_OS_10ms_Task.RespTimeCycleMax "Task response time monitoring for OS_10ms_Task/" ULONG RB_RBA_rba_OsMeasmt_CompuMethods_rba_OsMeasmt_TaskRespTime_CompuMethod 1 100 0.0 4.294967200E7 FORMAT "%13.9" ECU_ADDRESS 0x60015B74 /end MEASUREMENT
/begin MEASUREMENT rba_OsMeasmt_OS_10ms_Task.RespTimeLifetimeMax "Task response time monitoring for OS_10ms_Task/" ULONG RB_RBA_rba_OsMeasmt_CompuMethods_rba_OsMeasmt_TaskRespTime_CompuMethod 1 100 0.0 4.294967200E7 FORMAT "%13.9" ECU_ADDRESS 0x60015B78 /end MEASUREMENT
/begin MEASUREMENT rba_OsMeasmt_OS_10ms_Task.CETCurrent "Task response time monitoring for OS_10ms_Task/" ULONG RB_RBA_rba_OsMeasmt_CompuMethods_rba_OsMeasmt_CET_T1_CompuMethod 1 100 0.0 4.294967200E7 FORMAT "%13.9" ECU_ADDRESS 0x60015B7C /end MEASUREMENT
/begin MEASUREMENT rba_OsMeasmt_OS_10ms_Task.CETCycleMax "Task response time monitoring for OS_10ms_Task/" ULONG RB_RBA_rba_OsMeasmt_CompuMethods_rba_OsMeasmt_CET_T1_CompuMethod 1 100 0.0 4.294967200E7 FORMAT "%13.9" ECU_ADDRESS 0x60015B80 /end MEASUREMENT
/begin MEASUREMENT rba_OsMeasmt_OS_10ms_Task.CETCurrentLoad "Task response time monitoring for OS_10ms_Task/" UWORD RB_RBA_rba_OsMeasmt_CompuMethods_rba_OsMeasmt_T1_PercConversion 1 100 0.0 655.00 FORMAT "%5.2" ECU_ADDRESS 0x60015B84 /end MEASUREMENT
/begin MEASUREMENT rba_OsMeasmt_OS_10ms_Task.CETCurrentLoadMax "Task response time monitoring for OS_10ms_Task/" UWORD RB_RBA_rba_OsMeasmt_CompuMethods_rba_OsMeasmt_T1_PercConversion 1 100 0.0 655.00 FORMAT "%5.2" ECU_ADDRESS 0x60015B86 /end MEASUREMENT
/begin MEASUREMENT rba_OsMeasmt_OS_1ms_Task.RespTimeCurrent "Task response time monitoring for OS_1ms_Task/" ULONG RB_RBA_rba_OsMeasmt_CompuMethods_rba_OsMeasmt_TaskRespTime_CompuMethod 1 100 0.0 4.294967200E7 FORMAT "%13.9" ECU_ADDRESS 0x60015B58 /end MEASUREMENT
/begin MEASUREMENT rba_OsMeasmt_OS_1ms_Task.RespTimeCycleMax "Task response time monitoring for OS_1ms_Task/" ULONG RB_RBA_rba_OsMeasmt_CompuMethods_rba_OsMeasmt_TaskRespTime_CompuMethod 1 100 0.0 4.294967200E7 FORMAT "%13.9" ECU_ADDRESS 0x60015B5C /end MEASUREMENT
/begin MEASUREMENT rba_OsMeasmt_OS_1ms_Task.RespTimeLifetimeMax "Task response time monitoring for OS_1ms_Task/" ULONG RB_RBA_rba_OsMeasmt_CompuMethods_rba_OsMeasmt_TaskRespTime_CompuMethod 1 100 0.0 4.294967200E7 FORMAT "%13.9" ECU_ADDRESS 0x60015B60 /end MEASUREMENT
/begin MEASUREMENT rba_OsMeasmt_OS_1ms_Task.CETCurrent "Task response time monitoring for OS_1ms_Task/" ULONG RB_RBA_rba_OsMeasmt_CompuMethods_rba_OsMeasmt_CET_T1_CompuMethod 1 100 0.0 4.294967200E7 FORMAT "%13.9" ECU_ADDRESS 0x60015B64 /end MEASUREMENT
/begin MEASUREMENT rba_OsMeasmt_OS_1ms_Task.CETCycleMax "Task response time monitoring for OS_1ms_Task/" ULONG RB_RBA_rba_OsMeasmt_CompuMethods_rba_OsMeasmt_CET_T1_CompuMethod 1 100 0.0 4.294967200E7 FORMAT "%13.9" ECU_ADDRESS 0x60015B68 /end MEASUREMENT
/begin MEASUREMENT rba_OsMeasmt_OS_1ms_Task.CETCurrentLoad "Task response time monitoring for OS_1ms_Task/" UWORD RB_RBA_rba_OsMeasmt_CompuMethods_rba_OsMeasmt_T1_PercConversion 1 100 0.0 655.00 FORMAT "%5.2" ECU_ADDRESS 0x60015B6C /end MEASUREMENT
/begin MEASUREMENT rba_OsMeasmt_OS_1ms_Task.CETCurrentLoadMax "Task response time monitoring for OS_1ms_Task/" UWORD RB_RBA_rba_OsMeasmt_CompuMethods_rba_OsMeasmt_T1_PercConversion 1 100 0.0 655.00 FORMAT "%5.2" ECU_ADDRESS 0x60015B6E /end MEASUREMENT
/begin MEASUREMENT rba_OsMeasmt_OS_200ms_Task.RespTimeCurrent "Task response time monitoring for OS_200ms_Task/" ULONG RB_RBA_rba_OsMeasmt_CompuMethods_rba_OsMeasmt_TaskRespTime_CompuMethod 1 100 0.0 4.294967200E7 FORMAT "%13.9" ECU_ADDRESS 0x60015B40 /end MEASUREMENT
/begin MEASUREMENT rba_OsMeasmt_OS_200ms_Task.RespTimeCycleMax "Task response time monitoring for OS_200ms_Task/" ULONG RB_RBA_rba_OsMeasmt_CompuMethods_rba_OsMeasmt_TaskRespTime_CompuMethod 1 100 0.0 4.294967200E7 FORMAT "%13.9" ECU_ADDRESS 0x60015B44 /end MEASUREMENT
/begin MEASUREMENT rba_OsMeasmt_OS_200ms_Task.RespTimeLifetimeMax "Task response time monitoring for OS_200ms_Task/" ULONG RB_RBA_rba_OsMeasmt_CompuMethods_rba_OsMeasmt_TaskRespTime_CompuMethod 1 100 0.0 4.294967200E7 FORMAT "%13.9" ECU_ADDRESS 0x60015B48 /end MEASUREMENT
/begin MEASUREMENT rba_OsMeasmt_OS_200ms_Task.CETCurrent "Task response time monitoring for OS_200ms_Task/" ULONG RB_RBA_rba_OsMeasmt_CompuMethods_rba_OsMeasmt_CET_T1_CompuMethod 1 100 0.0 4.294967200E7 FORMAT "%13.9" ECU_ADDRESS 0x60015B4C /end MEASUREMENT
/begin MEASUREMENT rba_OsMeasmt_OS_200ms_Task.CETCycleMax "Task response time monitoring for OS_200ms_Task/" ULONG RB_RBA_rba_OsMeasmt_CompuMethods_rba_OsMeasmt_CET_T1_CompuMethod 1 100 0.0 4.294967200E7 FORMAT "%13.9" ECU_ADDRESS 0x60015B50 /end MEASUREMENT
/begin MEASUREMENT rba_OsMeasmt_OS_200ms_Task.CETCurrentLoad "Task response time monitoring for OS_200ms_Task/" UWORD RB_RBA_rba_OsMeasmt_CompuMethods_rba_OsMeasmt_T1_PercConversion 1 100 0.0 655.00 FORMAT "%5.2" ECU_ADDRESS 0x60015B54 /end MEASUREMENT
/begin MEASUREMENT rba_OsMeasmt_OS_200ms_Task.CETCurrentLoadMax "Task response time monitoring for OS_200ms_Task/" UWORD RB_RBA_rba_OsMeasmt_CompuMethods_rba_OsMeasmt_T1_PercConversion 1 100 0.0 655.00 FORMAT "%5.2" ECU_ADDRESS 0x60015B56 /end MEASUREMENT
/begin MEASUREMENT rba_OsMeasmt_OS_20ms_Task.RespTimeCurrent "Task response time monitoring for OS_20ms_Task/" ULONG RB_RBA_rba_OsMeasmt_CompuMethods_rba_OsMeasmt_TaskRespTime_CompuMethod 1 100 0.0 4.294967200E7 FORMAT "%13.9" ECU_ADDRESS 0x60015B28 /end MEASUREMENT
/begin MEASUREMENT rba_OsMeasmt_OS_20ms_Task.RespTimeCycleMax "Task response time monitoring for OS_20ms_Task/" ULONG RB_RBA_rba_OsMeasmt_CompuMethods_rba_OsMeasmt_TaskRespTime_CompuMethod 1 100 0.0 4.294967200E7 FORMAT "%13.9" ECU_ADDRESS 0x60015B2C /end MEASUREMENT
/begin MEASUREMENT rba_OsMeasmt_OS_20ms_Task.RespTimeLifetimeMax "Task response time monitoring for OS_20ms_Task/" ULONG RB_RBA_rba_OsMeasmt_CompuMethods_rba_OsMeasmt_TaskRespTime_CompuMethod 1 100 0.0 4.294967200E7 FORMAT "%13.9" ECU_ADDRESS 0x60015B30 /end MEASUREMENT
/begin MEASUREMENT rba_OsMeasmt_OS_20ms_Task.CETCurrent "Task response time monitoring for OS_20ms_Task/" ULONG RB_RBA_rba_OsMeasmt_CompuMethods_rba_OsMeasmt_CET_T1_CompuMethod 1 100 0.0 4.294967200E7 FORMAT "%13.9" ECU_ADDRESS 0x60015B34 /end MEASUREMENT
/begin MEASUREMENT rba_OsMeasmt_OS_20ms_Task.CETCycleMax "Task response time monitoring for OS_20ms_Task/" ULONG RB_RBA_rba_OsMeasmt_CompuMethods_rba_OsMeasmt_CET_T1_CompuMethod 1 100 0.0 4.294967200E7 FORMAT "%13.9" ECU_ADDRESS 0x60015B38 /end MEASUREMENT
/begin MEASUREMENT rba_OsMeasmt_OS_20ms_Task.CETCurrentLoad "Task response time monitoring for OS_20ms_Task/" UWORD RB_RBA_rba_OsMeasmt_CompuMethods_rba_OsMeasmt_T1_PercConversion 1 100 0.0 655.00 FORMAT "%5.2" ECU_ADDRESS 0x60015B3C /end MEASUREMENT
/begin MEASUREMENT rba_OsMeasmt_OS_20ms_Task.CETCurrentLoadMax "Task response time monitoring for OS_20ms_Task/" UWORD RB_RBA_rba_OsMeasmt_CompuMethods_rba_OsMeasmt_T1_PercConversion 1 100 0.0 655.00 FORMAT "%5.2" ECU_ADDRESS 0x60015B3E /end MEASUREMENT
/begin MEASUREMENT rba_OsMeasmt_OS_2ms_Task.RespTimeCurrent "Task response time monitoring for OS_2ms_Task/" ULONG RB_RBA_rba_OsMeasmt_CompuMethods_rba_OsMeasmt_TaskRespTime_CompuMethod 1 100 0.0 4.294967200E7 FORMAT "%13.9" ECU_ADDRESS 0x60015B10 /end MEASUREMENT
/begin MEASUREMENT rba_OsMeasmt_OS_2ms_Task.RespTimeCycleMax "Task response time monitoring for OS_2ms_Task/" ULONG RB_RBA_rba_OsMeasmt_CompuMethods_rba_OsMeasmt_TaskRespTime_CompuMethod 1 100 0.0 4.294967200E7 FORMAT "%13.9" ECU_ADDRESS 0x60015B14 /end MEASUREMENT
/begin MEASUREMENT rba_OsMeasmt_OS_2ms_Task.RespTimeLifetimeMax "Task response time monitoring for OS_2ms_Task/" ULONG RB_RBA_rba_OsMeasmt_CompuMethods_rba_OsMeasmt_TaskRespTime_CompuMethod 1 100 0.0 4.294967200E7 FORMAT "%13.9" ECU_ADDRESS 0x60015B18 /end MEASUREMENT
/begin MEASUREMENT rba_OsMeasmt_OS_2ms_Task.CETCurrent "Task response time monitoring for OS_2ms_Task/" ULONG RB_RBA_rba_OsMeasmt_CompuMethods_rba_OsMeasmt_CET_T1_CompuMethod 1 100 0.0 4.294967200E7 FORMAT "%13.9" ECU_ADDRESS 0x60015B1C /end MEASUREMENT
/begin MEASUREMENT rba_OsMeasmt_OS_2ms_Task.CETCycleMax "Task response time monitoring for OS_2ms_Task/" ULONG RB_RBA_rba_OsMeasmt_CompuMethods_rba_OsMeasmt_CET_T1_CompuMethod 1 100 0.0 4.294967200E7 FORMAT "%13.9" ECU_ADDRESS 0x60015B20 /end MEASUREMENT
/begin MEASUREMENT rba_OsMeasmt_OS_2ms_Task.CETCurrentLoad "Task response time monitoring for OS_2ms_Task/" UWORD RB_RBA_rba_OsMeasmt_CompuMethods_rba_OsMeasmt_T1_PercConversion 1 100 0.0 655.00 FORMAT "%5.2" ECU_ADDRESS 0x60015B24 /end MEASUREMENT
/begin MEASUREMENT rba_OsMeasmt_OS_2ms_Task.CETCurrentLoadMax "Task response time monitoring for OS_2ms_Task/" UWORD RB_RBA_rba_OsMeasmt_CompuMethods_rba_OsMeasmt_T1_PercConversion 1 100 0.0 655.00 FORMAT "%5.2" ECU_ADDRESS 0x60015B26 /end MEASUREMENT
/begin MEASUREMENT rba_OsMeasmt_OS_50ms_Task.RespTimeCurrent "Task response time monitoring for OS_50ms_Task/" ULONG RB_RBA_rba_OsMeasmt_CompuMethods_rba_OsMeasmt_TaskRespTime_CompuMethod 1 100 0.0 4.294967200E7 FORMAT "%13.9" ECU_ADDRESS 0x60015AF8 /end MEASUREMENT
/begin MEASUREMENT rba_OsMeasmt_OS_50ms_Task.RespTimeCycleMax "Task response time monitoring for OS_50ms_Task/" ULONG RB_RBA_rba_OsMeasmt_CompuMethods_rba_OsMeasmt_TaskRespTime_CompuMethod 1 100 0.0 4.294967200E7 FORMAT "%13.9" ECU_ADDRESS 0x60015AFC /end MEASUREMENT
/begin MEASUREMENT rba_OsMeasmt_OS_50ms_Task.RespTimeLifetimeMax "Task response time monitoring for OS_50ms_Task/" ULONG RB_RBA_rba_OsMeasmt_CompuMethods_rba_OsMeasmt_TaskRespTime_CompuMethod 1 100 0.0 4.294967200E7 FORMAT "%13.9" ECU_ADDRESS 0x60015B00 /end MEASUREMENT
/begin MEASUREMENT rba_OsMeasmt_OS_50ms_Task.CETCurrent "Task response time monitoring for OS_50ms_Task/" ULONG RB_RBA_rba_OsMeasmt_CompuMethods_rba_OsMeasmt_CET_T1_CompuMethod 1 100 0.0 4.294967200E7 FORMAT "%13.9" ECU_ADDRESS 0x60015B04 /end MEASUREMENT
/begin MEASUREMENT rba_OsMeasmt_OS_50ms_Task.CETCycleMax "Task response time monitoring for OS_50ms_Task/" ULONG RB_RBA_rba_OsMeasmt_CompuMethods_rba_OsMeasmt_CET_T1_CompuMethod 1 100 0.0 4.294967200E7 FORMAT "%13.9" ECU_ADDRESS 0x60015B08 /end MEASUREMENT
/begin MEASUREMENT rba_OsMeasmt_OS_50ms_Task.CETCurrentLoad "Task response time monitoring for OS_50ms_Task/" UWORD RB_RBA_rba_OsMeasmt_CompuMethods_rba_OsMeasmt_T1_PercConversion 1 100 0.0 655.00 FORMAT "%5.2" ECU_ADDRESS 0x60015B0C /end MEASUREMENT
/begin MEASUREMENT rba_OsMeasmt_OS_50ms_Task.CETCurrentLoadMax "Task response time monitoring for OS_50ms_Task/" UWORD RB_RBA_rba_OsMeasmt_CompuMethods_rba_OsMeasmt_T1_PercConversion 1 100 0.0 655.00 FORMAT "%5.2" ECU_ADDRESS 0x60015B0E /end MEASUREMENT
/begin MEASUREMENT rba_OsMeasmt_OS_5ms_Task.RespTimeCurrent "Task response time monitoring for OS_5ms_Task/" ULONG RB_RBA_rba_OsMeasmt_CompuMethods_rba_OsMeasmt_TaskRespTime_CompuMethod 1 100 0.0 4.294967200E7 FORMAT "%13.9" ECU_ADDRESS 0x70006EBC /end MEASUREMENT
/begin MEASUREMENT rba_OsMeasmt_OS_5ms_Task.RespTimeCycleMax "Task response time monitoring for OS_5ms_Task/" ULONG RB_RBA_rba_OsMeasmt_CompuMethods_rba_OsMeasmt_TaskRespTime_CompuMethod 1 100 0.0 4.294967200E7 FORMAT "%13.9" ECU_ADDRESS 0x70006EC0 /end MEASUREMENT
/begin MEASUREMENT rba_OsMeasmt_OS_5ms_Task.RespTimeLifetimeMax "Task response time monitoring for OS_5ms_Task/" ULONG RB_RBA_rba_OsMeasmt_CompuMethods_rba_OsMeasmt_TaskRespTime_CompuMethod 1 100 0.0 4.294967200E7 FORMAT "%13.9" ECU_ADDRESS 0x70006EC4 /end MEASUREMENT
/begin MEASUREMENT rba_OsMeasmt_OS_5ms_Task.CETCurrent "Task response time monitoring for OS_5ms_Task/" ULONG RB_RBA_rba_OsMeasmt_CompuMethods_rba_OsMeasmt_CET_T1_CompuMethod 1 100 0.0 4.294967200E7 FORMAT "%13.9" ECU_ADDRESS 0x70006EC8 /end MEASUREMENT
/begin MEASUREMENT rba_OsMeasmt_OS_5ms_Task.CETCycleMax "Task response time monitoring for OS_5ms_Task/" ULONG RB_RBA_rba_OsMeasmt_CompuMethods_rba_OsMeasmt_CET_T1_CompuMethod 1 100 0.0 4.294967200E7 FORMAT "%13.9" ECU_ADDRESS 0x70006ECC /end MEASUREMENT
/begin MEASUREMENT rba_OsMeasmt_OS_5ms_Task.CETCurrentLoad "Task response time monitoring for OS_5ms_Task/" UWORD RB_RBA_rba_OsMeasmt_CompuMethods_rba_OsMeasmt_T1_PercConversion 1 100 0.0 655.00 FORMAT "%5.2" ECU_ADDRESS 0x70006ED0 /end MEASUREMENT
/begin MEASUREMENT rba_OsMeasmt_OS_5ms_Task.CETCurrentLoadMax "Task response time monitoring for OS_5ms_Task/" UWORD RB_RBA_rba_OsMeasmt_CompuMethods_rba_OsMeasmt_T1_PercConversion 1 100 0.0 655.00 FORMAT "%5.2" ECU_ADDRESS 0x70006ED2 /end MEASUREMENT
/begin MEASUREMENT rba_OsMeasmt_T1_CoreLoad[0].current "Core load T1 measurement for each core[0]/" UWORD RB_RBA_rba_OsMeasmt_CompuMethods_rba_OsMeasmt_T1_PercConversion 1 100 0.0 655.00 FORMAT "%5.2" ECU_ADDRESS 0x500009C6 /end MEASUREMENT
/begin MEASUREMENT rba_OsMeasmt_T1_CoreLoad[1].current "Core load T1 measurement for each core[1]/" UWORD RB_RBA_rba_OsMeasmt_CompuMethods_rba_OsMeasmt_T1_PercConversion 1 100 0.0 655.00 FORMAT "%5.2" ECU_ADDRESS 0x500009CA /end MEASUREMENT
/begin MEASUREMENT rba_OsMeasmt_T1_CoreLoad[2].current "Core load T1 measurement for each core[2]/" UWORD RB_RBA_rba_OsMeasmt_CompuMethods_rba_OsMeasmt_T1_PercConversion 1 100 0.0 655.00 FORMAT "%5.2" ECU_ADDRESS 0x500009CE /end MEASUREMENT
/begin MEASUREMENT rba_OsMeasmt_T1_CoreLoad[0].curCycleMax "Core load T1 measurement for each core[0]/" UWORD RB_RBA_rba_OsMeasmt_CompuMethods_rba_OsMeasmt_T1_PercConversion 1 100 0.0 655.00 FORMAT "%5.2" ECU_ADDRESS 0x500009C8 /end MEASUREMENT
/begin MEASUREMENT rba_OsMeasmt_T1_CoreLoad[1].curCycleMax "Core load T1 measurement for each core[1]/" UWORD RB_RBA_rba_OsMeasmt_CompuMethods_rba_OsMeasmt_T1_PercConversion 1 100 0.0 655.00 FORMAT "%5.2" ECU_ADDRESS 0x500009CC /end MEASUREMENT
/begin MEASUREMENT rba_OsMeasmt_T1_CoreLoad[2].curCycleMax "Core load T1 measurement for each core[2]/" UWORD RB_RBA_rba_OsMeasmt_CompuMethods_rba_OsMeasmt_T1_PercConversion 1 100 0.0 655.00 FORMAT "%5.2" ECU_ADDRESS 0x500009D0 /end MEASUREMENT
/begin FUNCTION Com "13.16.4_6.0.0  McFunction Com Created by MCFunctionUpdater"
 /begin DEF_CHARACTERISTIC Com_tiAYCA_RxRxTout_C Com_tiAYCD_RxRxTout_C Com_tiAYCF_RxRxTout_C Com_tiAYCG_RxRxTout_C Com_tiAYCI_RxRxTout_C Com_tiBCM1_RxRxTout_C Com_tiCGW1_RxRxTout_C Com_tiEAT10_RxRxTout_C Com_tiEAT11_RxRxTout_C Com_tiEAT12_RxRxTout_C Com_tiEAT13_RxRxTout_C Com_tiEAT1_RxRxTout_C Com_tiEAT2_RxRxTout_C Com_tiEAT4_RxRxTout_C Com_tiEAT6_RxRxTout_C Com_tiEAT7_RxRxTout_C Com_tiEAT8_RxRxTout_C Com_tiEATA_RxRxTout_C Com_tiEATB_RxRxTout_C Com_tiEATC_RxRxTout_C Com_tiENG10_TxTxPerd_C Com_tiENG11_TxTxPerd_C Com_tiENG15_TxTxPerd_C Com_tiENG16_TxTxPerd_C Com_tiENG17_TxTxPerd_C Com_tiENG18_TxTxPerd_C Com_tiENG19_TxTxPerd_C Com_tiENG20_TxTxPerd_C Com_tiENG21_TxTxPerd_C Com_tiENG22_TxTxPerd_C Com_tiENG23_TxTxPerd_C Com_tiENG24_TxTxPerd_C Com_tiENG25_TxTxPerd_C Com_tiENG2_TxTxPerd_C Com_tiENG3_TxTxPerd_C Com_tiENG4_TxTxPerd_C Com_tiENG5_TxTxPerd_C Com_tiENG6_TxTxPerd_C Com_tiENGAE_TxTxPerd_C Com_tiENGA_TxTxPerd_C Com_tiENGB_TxTxPerd_C Com_tiENGC_TxTxPerd_C Com_tiENGF_TxTxPerd_C Com_tiENGIMG1_TxTxPerd_C Com_tiENGJ3_TxTxPerd_C Com_tiENGK3_TxTxPerd_C Com_tiENGL_TxTxPerd_C Com_tiENGN_TxTxPerd_C Com_tiENGQ_TxTxPerd_C Com_tiENGR_TxTxPerd_C Com_tiENGT1_TxTxPerd_C Com_tiENGT2_TxTxPerd_C Com_tiENGT_TxTxPerd_C Com_tiENGU_TxTxPerd_C Com_tiENGV_TxTxPerd_C Com_tiENGW_TxTxPerd_C Com_tiENGX2_TxTxPerd_C Com_tiENGY2_TxTxPerd_C Com_tiENGY_TxTxPerd_C Com_tiENGZ_TxTxPerd_C Com_tiEPB2_RxRxTout_C Com_tiEPBB_RxRxTout_C Com_tiEPS1_RxRxTout_C Com_tiGWIMG1_RxRxTout_C Com_tiGWIMG3_RxRxTout_C Com_tiGWIMG4_RxRxTout_C Com_tiGWIMG5_RxRxTout_C Com_tiGWIMG6_RxRxTout_C Com_tiIDASB_RxRxTout_C Com_tiLin_Alt_Rx_ACG_INFO_B_RxRxTout_C Com_tiLin_BS_Rx_EBSA_RxRxTout_C Com_tiLin_BS_Rx_EBSB_RxRxTout_C Com_tiLin_BS_Rx_EBSC_RxRxTout_C Com_tiLin_BS_Rx_EBSD_RxRxTout_C Com_tiLin_BS_Rx_EBSE_RxRxTout_C Com_tiLin_BS_Rx_EBSF_RxRxTout_C Com_tiMETA_RxRxTout_C Com_tiMETC_RxRxTout_C Com_tiMETD2_RxRxTout_C Com_tiMETD_RxRxTout_C Com_tiMETE2_RxRxTout_C Com_tiMETF_RxRxTout_C Com_tiMETG2_RxRxTout_C Com_tiMETG_RxRxTout_C Com_tiMETH2_RxRxTout_C Com_tiMETH_RxRxTout_C Com_tiMETI_RxRxTout_C Com_tiMETK_RxRxTout_C Com_tiMETL_RxRxTout_C Com_tiMETM_RxRxTout_C Com_tiMETN_RxRxTout_C Com_tiPCU_RxRxTout_C Com_tiSRSA_RxRxTout_C Com_tiSRSB_RxRxTout_C Com_tiSRS_RxRxTout_C Com_tieng1_TxTxPerd_C Com_tiengo_TxTxPerd_C /end DEF_CHARACTERISTIC
 /begin LOC_MEASUREMENT Com_IpduBuf_ENG10_Tx Com_IpduBuf_ENG11_Tx Com_IpduBuf_ENG15_Tx Com_IpduBuf_ENG16_Tx Com_IpduBuf_ENG17_Tx Com_IpduBuf_ENG18_Tx Com_IpduBuf_ENG19_Tx Com_IpduBuf_ENG20_Tx Com_IpduBuf_ENG21_Tx Com_IpduBuf_ENG22_Tx Com_IpduBuf_ENG23_Tx Com_IpduBuf_ENG24_Tx Com_IpduBuf_ENG25_Tx Com_IpduBuf_ENG2_Tx Com_IpduBuf_ENG3_Tx Com_IpduBuf_ENG4_Tx Com_IpduBuf_ENG5_Tx Com_IpduBuf_ENG6_Tx Com_IpduBuf_ENGAE_Tx Com_IpduBuf_ENGA_Tx Com_IpduBuf_ENGB_Tx Com_IpduBuf_ENGC_Tx Com_IpduBuf_ENGF_Tx Com_IpduBuf_ENGIMG1_Tx Com_IpduBuf_ENGJ3_Tx Com_IpduBuf_ENGK3_Tx Com_IpduBuf_ENGL_Tx Com_IpduBuf_ENGN_Tx Com_IpduBuf_ENGQ_Tx Com_IpduBuf_ENGR_Tx Com_IpduBuf_ENGT1_Tx Com_IpduBuf_ENGT2_Tx Com_IpduBuf_ENGT_Tx Com_IpduBuf_ENGU_Tx Com_IpduBuf_ENGV_Tx Com_IpduBuf_ENGW_Tx Com_IpduBuf_ENGX2_Tx Com_IpduBuf_ENGY2_Tx Com_IpduBuf_ENGY_Tx Com_IpduBuf_ENGZ_Tx Com_IpduBuf_Lin_Alt_Tx_ACG_CTL_Tx Com_IpduBuf_Lin_BS_Tx_EBSA_Tx Com_IpduBuf_Lin_DCDC_Tx_DCDC_Tx Com_IpduBuf_eng1_Tx Com_IpduBuf_engo_Tx Com_LocalBuf_AYCA_Rx Com_LocalBuf_AYCD_Rx Com_LocalBuf_AYCF_Rx Com_LocalBuf_AYCG_Rx Com_LocalBuf_AYCI_Rx Com_LocalBuf_BCM1_Rx Com_LocalBuf_CGW1_Rx Com_LocalBuf_EAT10_Rx Com_LocalBuf_EAT11_Rx Com_LocalBuf_EAT12_Rx Com_LocalBuf_EAT13_Rx Com_LocalBuf_EAT1_Rx Com_LocalBuf_EAT2_Rx Com_LocalBuf_EAT4_Rx Com_LocalBuf_EAT6_Rx Com_LocalBuf_EAT7_Rx Com_LocalBuf_EAT8_Rx Com_LocalBuf_EATA_Rx Com_LocalBuf_EATB_Rx Com_LocalBuf_EATC_Rx Com_LocalBuf_EPB2_Rx Com_LocalBuf_EPBB_Rx Com_LocalBuf_EPS1_Rx Com_LocalBuf_GWIMG1_Rx Com_LocalBuf_GWIMG3_Rx Com_LocalBuf_GWIMG4_Rx Com_LocalBuf_GWIMG5_Rx Com_LocalBuf_GWIMG6_Rx Com_LocalBuf_IDASB_Rx Com_LocalBuf_Lin_Alt_Rx_ACG_INFO_B_Rx Com_LocalBuf_Lin_BS_Rx_EBSA_Rx Com_LocalBuf_Lin_BS_Rx_EBSB_Rx Com_LocalBuf_Lin_BS_Rx_EBSC_Rx Com_LocalBuf_Lin_BS_Rx_EBSD_Rx Com_LocalBuf_Lin_BS_Rx_EBSE_Rx Com_LocalBuf_Lin_BS_Rx_EBSF_Rx Com_LocalBuf_Lin_DCDC_Rx_DCDC0_Rx Com_LocalBuf_META_Rx Com_LocalBuf_METC_Rx Com_LocalBuf_METD2_Rx Com_LocalBuf_METD_Rx Com_LocalBuf_METE2_Rx Com_LocalBuf_METF_Rx Com_LocalBuf_METG2_Rx Com_LocalBuf_METG_Rx Com_LocalBuf_METH2_Rx Com_LocalBuf_METH_Rx Com_LocalBuf_METI_Rx Com_LocalBuf_METK_Rx Com_LocalBuf_METL_Rx Com_LocalBuf_METM_Rx Com_LocalBuf_METN_Rx Com_LocalBuf_PCU_Rx Com_LocalBuf_SRSA_Rx Com_LocalBuf_SRSB_Rx Com_LocalBuf_SRS_Rx Com_SigType_au16 Com_SigType_au32 Com_SigType_au8 /end LOC_MEASUREMENT
 FUNCTION_VERSION "13.16.4_6.0.0" /end FUNCTION
/begin FUNCTION Can "McFunction Can Created by MCFunctionUpdater"
 /begin DEF_CHARACTERISTIC Can_CanHwObject_AYCA_RXCanId_C Can_CanHwObject_AYCA_RXCanNod_C Can_CanHwObject_AYCD_RXCanId_C Can_CanHwObject_AYCD_RXCanNod_C Can_CanHwObject_AYCF_RXCanId_C Can_CanHwObject_AYCF_RXCanNod_C Can_CanHwObject_AYCG_RXCanId_C Can_CanHwObject_AYCG_RXCanNod_C Can_CanHwObject_AYCI_RXCanId_C Can_CanHwObject_AYCI_RXCanNod_C Can_CanHwObject_BCM1_RXCanId_C Can_CanHwObject_BCM1_RXCanNod_C Can_CanHwObject_CGW1_RXCanId_C Can_CanHwObject_CGW1_RXCanNod_C Can_CanHwObject_EAT10_RXCanId_C Can_CanHwObject_EAT10_RXCanNod_C Can_CanHwObject_EAT11_RXCanId_C Can_CanHwObject_EAT11_RXCanNod_C Can_CanHwObject_EAT12_RXCanId_C Can_CanHwObject_EAT12_RXCanNod_C Can_CanHwObject_EAT13_RXCanId_C Can_CanHwObject_EAT13_RXCanNod_C Can_CanHwObject_EAT1_RXCanId_C Can_CanHwObject_EAT1_RXCanNod_C Can_CanHwObject_EAT2_RXCanId_C Can_CanHwObject_EAT2_RXCanNod_C Can_CanHwObject_EAT4_RXCanId_C Can_CanHwObject_EAT4_RXCanNod_C Can_CanHwObject_EAT6_RXCanId_C Can_CanHwObject_EAT6_RXCanNod_C Can_CanHwObject_EAT7_RXCanId_C Can_CanHwObject_EAT7_RXCanNod_C Can_CanHwObject_EAT8_RXCanId_C Can_CanHwObject_EAT8_RXCanNod_C Can_CanHwObject_EATA_RXCanId_C Can_CanHwObject_EATA_RXCanNod_C Can_CanHwObject_EATB_RXCanId_C Can_CanHwObject_EATB_RXCanNod_C Can_CanHwObject_EATC_RXCanId_C Can_CanHwObject_EATC_RXCanNod_C Can_CanHwObject_ENG10_TXCanNod_C Can_CanHwObject_ENG11_TXCanNod_C Can_CanHwObject_ENG15_TXCanNod_C Can_CanHwObject_ENG16_TXCanNod_C Can_CanHwObject_ENG17_TXCanNod_C Can_CanHwObject_ENG18_TXCanNod_C Can_CanHwObject_ENG19_TXCanNod_C Can_CanHwObject_ENG20_TXCanNod_C Can_CanHwObject_ENG21_TXCanNod_C Can_CanHwObject_ENG22_TXCanNod_C Can_CanHwObject_ENG23_TXCanNod_C Can_CanHwObject_ENG24_TXCanNod_C Can_CanHwObject_ENG25_TXCanNod_C Can_CanHwObject_ENG2_TXCanNod_C Can_CanHwObject_ENG3_TXCanNod_C Can_CanHwObject_ENG4_TXCanNod_C Can_CanHwObject_ENG5_TXCanNod_C Can_CanHwObject_ENG6_TXCanNod_C Can_CanHwObject_ENGAE_TXCanNod_C Can_CanHwObject_ENGA_TXCanNod_C Can_CanHwObject_ENGB_TXCanNod_C Can_CanHwObject_ENGC_TXCanNod_C Can_CanHwObject_ENGF_TXCanNod_C Can_CanHwObject_ENGIMG1_TXCanNod_C Can_CanHwObject_ENGJ3_TXCanNod_C Can_CanHwObject_ENGK3_TXCanNod_C Can_CanHwObject_ENGL_TXCanNod_C Can_CanHwObject_ENGN_TXCanNod_C Can_CanHwObject_ENGQ_TXCanNod_C Can_CanHwObject_ENGR_TXCanNod_C Can_CanHwObject_ENGT1_TXCanNod_C Can_CanHwObject_ENGT2_TXCanNod_C Can_CanHwObject_ENGT_TXCanNod_C Can_CanHwObject_ENGU_TXCanNod_C Can_CanHwObject_ENGV_TXCanNod_C Can_CanHwObject_ENGW_TXCanNod_C Can_CanHwObject_ENGX2_TXCanNod_C Can_CanHwObject_ENGY2_TXCanNod_C Can_CanHwObject_ENGY_TXCanNod_C Can_CanHwObject_ENGZ_TXCanNod_C Can_CanHwObject_EPB2_RXCanId_C Can_CanHwObject_EPB2_RXCanNod_C Can_CanHwObject_EPBB_RXCanId_C Can_CanHwObject_EPBB_RXCanNod_C Can_CanHwObject_EPS1_RXCanId_C Can_CanHwObject_EPS1_RXCanNod_C Can_CanHwObject_GWIMG1_RXCanId_C Can_CanHwObject_GWIMG1_RXCanNod_C Can_CanHwObject_GWIMG3_RXCanId_C Can_CanHwObject_GWIMG3_RXCanNod_C Can_CanHwObject_GWIMG4_RXCanId_C Can_CanHwObject_GWIMG4_RXCanNod_C Can_CanHwObject_GWIMG5_RXCanId_C Can_CanHwObject_GWIMG5_RXCanNod_C Can_CanHwObject_GWIMG6_RXCanId_C Can_CanHwObject_GWIMG6_RXCanNod_C Can_CanHwObject_IDASB_RXCanId_C Can_CanHwObject_IDASB_RXCanNod_C Can_CanHwObject_META_RXCanId_C Can_CanHwObject_META_RXCanNod_C Can_CanHwObject_METC_RXCanId_C Can_CanHwObject_METC_RXCanNod_C Can_CanHwObject_METD2_RXCanId_C Can_CanHwObject_METD2_RXCanNod_C Can_CanHwObject_METD_RXCanId_C Can_CanHwObject_METD_RXCanNod_C Can_CanHwObject_METE2_RXCanId_C Can_CanHwObject_METE2_RXCanNod_C Can_CanHwObject_METF_RXCanId_C Can_CanHwObject_METF_RXCanNod_C Can_CanHwObject_METG2_RXCanId_C Can_CanHwObject_METG2_RXCanNod_C Can_CanHwObject_METG_RXCanId_C Can_CanHwObject_METG_RXCanNod_C Can_CanHwObject_METH2_RXCanId_C Can_CanHwObject_METH2_RXCanNod_C Can_CanHwObject_METH_RXCanId_C Can_CanHwObject_METH_RXCanNod_C Can_CanHwObject_METI_RXCanId_C Can_CanHwObject_METI_RXCanNod_C Can_CanHwObject_METK_RXCanId_C Can_CanHwObject_METK_RXCanNod_C Can_CanHwObject_METL_RXCanId_C Can_CanHwObject_METL_RXCanNod_C Can_CanHwObject_METM_RXCanId_C Can_CanHwObject_METM_RXCanNod_C Can_CanHwObject_METN_RXCanId_C Can_CanHwObject_METN_RXCanNod_C Can_CanHwObject_PCU_RXCanId_C Can_CanHwObject_PCU_RXCanNod_C Can_CanHwObject_SRSA_RXCanId_C Can_CanHwObject_SRSA_RXCanNod_C Can_CanHwObject_SRSB_RXCanId_C Can_CanHwObject_SRSB_RXCanNod_C Can_CanHwObject_SRS_RXCanId_C Can_CanHwObject_SRS_RXCanNod_C Can_CanHwObject_eng1_TXCanNod_C Can_CanHwObject_engo_TXCanNod_C Can_Can_APPLBaudrateCfgId_C Can_Can_CBaudrateCfgId_C Can_Can_VEHICLEBaudrateCfgId_C Can_OBD_ON_CAN_Rx_0x7DF_VEHICLECanId_C Can_OBD_ON_CAN_Rx_0x7DF_VEHICLECanNod_C Can_OBD_ON_CAN_Rx_0x7E0_VEHICLECanId_C Can_OBD_ON_CAN_Rx_0x7E0_VEHICLECanNod_C Can_OBD_ON_CAN_Tx_0x7E8_VEHICLECanNod_C Can_T1_RXCanId_C Can_T1_RXCanNod_C Can_T1_TXCanNod_C Can_UDS_ON_CAN_Rx_0x18da10f1_VEHICLECanId_C Can_UDS_ON_CAN_Rx_0x18da10f1_VEHICLECanNod_C Can_UDS_ON_CAN_Rx_0x18da10f2_VEHICLECanId_C Can_UDS_ON_CAN_Rx_0x18da10f2_VEHICLECanNod_C Can_UDS_ON_CAN_Rx_0x18db2ff1_VEHICLECanId_C Can_UDS_ON_CAN_Rx_0x18db2ff1_VEHICLECanNod_C Can_UDS_ON_CAN_Rx_0x18db33f1_VEHICLECanId_C Can_UDS_ON_CAN_Rx_0x18db33f1_VEHICLECanNod_C Can_UDS_ON_CAN_Rx_0x18dbeff1_VEHICLECanId_C Can_UDS_ON_CAN_Rx_0x18dbeff1_VEHICLECanNod_C Can_UDS_ON_CAN_Tx_0x18daf110_VEHICLECanNod_C Can_UDS_ON_CAN_Tx_0x18daf210_VEHICLECanNod_C Can_XcpRx_Cmd_APPLCanId_C Can_XcpRx_Cmd_APPLCanNod_C Can_XcpRx_Cmd_CANCCanId_C Can_XcpRx_Cmd_CANCCanNod_C Can_XcpRx_Cmd_VEHICLECanId_C Can_XcpRx_Cmd_VEHICLECanNod_C Can_XcpTx_Var_APPLCanNod_C Can_XcpTx_Var_CANCCanNod_C Can_XcpTx_Var_VEHICLECanNod_C /end DEF_CHARACTERISTIC
 /begin LOC_MEASUREMENT rba_CanMcan_DriverState_MP rba_CanMcan_MsgStatus_MP /end LOC_MEASUREMENT
/end FUNCTION
/begin FUNCTION rba_BypEtk "McFunction rba_BypEtk Created by MCFunctionUpdater"
 /begin DEF_CHARACTERISTIC rba_BypEtk_AccPed_trqDes_bypass_CST.Channel_u16 rba_BypEtk_AccPed_trqDes_bypass_CST.Vector_u16 rba_BypEtk_CoETS_trqInrCurrLim_bypass_CST.Channel_u16 rba_BypEtk_CoETS_trqInrCurrLim_bypass_CST.Vector_u16 rba_BypEtk_CoME_nMax_bypass_CST.Channel_u16 rba_BypEtk_CoME_nMax_bypass_CST.Vector_u16 rba_BypEtk_CoME_nMin_bypass_CST.Channel_u16 rba_BypEtk_CoME_nMin_bypass_CST.Vector_u16 rba_BypEtk_CoME_stNSetP_bypass_CST.Channel_u16 rba_BypEtk_CoME_stNSetP_bypass_CST.Vector_u16 rba_BypEtk_CoME_trqDesComp_bypass_CST.Channel_u16 rba_BypEtk_CoME_trqDesComp_bypass_CST.Vector_u16 rba_BypEtk_CoME_trqResv_bypass_CST.Channel_u16 rba_BypEtk_CoME_trqResv_bypass_CST.Vector_u16 rba_BypEtk_CoPT_trqClthWoIntv_bypass_CST.Channel_u16 rba_BypEtk_CoPT_trqClthWoIntv_bypass_CST.Vector_u16 rba_BypEtk_CoPT_trqClthWoTraIntv_bypass_CST.Channel_u16 rba_BypEtk_CoPT_trqClthWoTraIntv_bypass_CST.Vector_u16 rba_BypEtk_CoPT_trqDesCompEng_bypass_CST.Channel_u16 rba_BypEtk_CoPT_trqDesCompEng_bypass_CST.Vector_u16 rba_BypEtk_CoVMD_trqCrCtl_bypass_CST.Channel_u16 rba_BypEtk_CoVMD_trqCrCtl_bypass_CST.Vector_u16 rba_BypEtk_CoVeh_trqDesComp_bypass_CST.Channel_u16 rba_BypEtk_CoVeh_trqDesComp_bypass_CST.Vector_u16 rba_BypEtk_EGRVlv_rDesVal_bypass_CST.Channel_u16 rba_BypEtk_EGRVlv_rDesVal_bypass_CST.Vector_u16 rba_BypEtk_EGRVlv_rGovActr_bypass_CST.Channel_u16 rba_BypEtk_EGRVlv_rGovActr_bypass_CST.Vector_u16 rba_BypEtk_EGRVlv_rPs_bypass_CST.Channel_u16 rba_BypEtk_EGRVlv_rPs_bypass_CST.Vector_u16 rba_BypEtk_EGRVlv_uRelPosClsd_bypass_CST.Channel_u16 rba_BypEtk_EGRVlv_uRelPosClsd_bypass_CST.Vector_u16 rba_BypEtk_EGRVlv_uRelPosOpn_bypass_CST.Channel_u16 rba_BypEtk_EGRVlv_uRelPosOpn_bypass_CST.Vector_u16 rba_BypEtk_PT_trqCrSDCS_bypass_CST.Channel_u16 rba_BypEtk_PT_trqCrSDCS_bypass_CST.Vector_u16 rba_BypEtk_PT_trqCrSDes_bypass_CST.Channel_u16 rba_BypEtk_PT_trqCrSDes_bypass_CST.Vector_u16 rba_BypEtk_PT_trqCrSPTPrt_bypass_CST.Channel_u16 rba_BypEtk_PT_trqCrSPTPrt_bypass_CST.Vector_u16 rba_BypEtk_PT_trqCrSWoTraIntv_bypass_CST.Channel_u16 rba_BypEtk_PT_trqCrSWoTraIntv_bypass_CST.Vector_u16 rba_BypEtk_PT_trqCrsPTPrt_bypass_CST.Channel_u16 rba_BypEtk_PT_trqCrsPTPrt_bypass_CST.Vector_u16 rba_BypEtk_PT_trqCrsWoIntv_bypass_CST.Channel_u16 rba_BypEtk_PT_trqCrsWoIntv_bypass_CST.Vector_u16 rba_BypEtk_VMD_rVirtAPP_bypass_CST.Channel_u16 rba_BypEtk_VMD_rVirtAPP_bypass_CST.Vector_u16 rba_BypEtk_VMD_trqDes_bypass_CST.Channel_u16 rba_BypEtk_VMD_trqDes_bypass_CST.Vector_u16 rba_BypEtk_VehMot_stPrpCrCtl_bypass_CST.Channel_u16 rba_BypEtk_VehMot_stPrpCrCtl_bypass_CST.Vector_u16 /end DEF_CHARACTERISTIC
/end FUNCTION
/begin FUNCTION rba_Etks "1.45.0  McFunction rba_Etks Created by MCFunctionUpdater" /begin DEF_CHARACTERISTIC rba_Etks_swt3rdPartySupp_C /end DEF_CHARACTERISTIC FUNCTION_VERSION "1.45.0" /end FUNCTION
/begin FUNCTION rba_IoDiagPwr "1.21.0    IO Diagnose Power"
 /begin DEF_CHARACTERISTIC rba_IoDiagPwr_Config_rba_IoExtCy329_SignalMrly_0_BattVltgThres_C rba_IoDiagPwr_Config_rba_IoExtCy329_SignalMrly_0_TimeBtwTst_C /end DEF_CHARACTERISTIC
 FUNCTION_VERSION "1.21.0" /end FUNCTION
/begin FUNCTION rba_IoSigDio "2.32.0  McFunction rba_IoSigDio Created by MCFunctionUpdater"
 /begin DEF_CHARACTERISTIC rba_IoSigDio_BrkMn_I_D_C rba_IoSigDio_swtMrlyDCInv_C rba_IoSigDio_swtP_FDBKSWE11Inv_C /end DEF_CHARACTERISTIC
 FUNCTION_VERSION "2.32.0" /end FUNCTION
/begin FUNCTION rba_IoSigRtc "1.32.1    IO Signals: Real Time Clocks" /begin DEF_CHARACTERISTIC rba_IoSigRtc_stDiagErrInject_StopCounter_C /end DEF_CHARACTERISTIC FUNCTION_VERSION "1.32.1" /end FUNCTION
/begin FUNCTION rba_MRly "1.34.0    Main Relay"
 /begin DEF_CHARACTERISTIC rba_MRly_Diag_Stk_tiOkError_C rba_MRly_Sens_Measd_tiHiLo_C rba_MRly_Sens_Measd_tiLoHi_C rba_MRly_Sens_Measd_uBattClosedThr_C /end DEF_CHARACTERISTIC
 /begin LOC_MEASUREMENT rba_MRly_Ctrl_State_MP /end LOC_MEASUREMENT
 FUNCTION_VERSION "1.34.0" /end FUNCTION
/begin FUNCTION rba_OsMeasmt "1.15.0    Os Runtime Measurement"
 /begin DEF_CHARACTERISTIC rba_MultiStackTrace_ResetMaxValues rba_MultiStackTrace_ThresholdSwitch rba_OsMeasmt_CoreLoadThresholdValue_C rba_OsMeasmt_ResetMaxCoreLoadValues_C rba_OsMeasmt_ResetResponseTimeValues_C rba_OsMeasmt_SwTrace_InitMode_C /end DEF_CHARACTERISTIC
 /begin LOC_MEASUREMENT rba_MultiStackTrace_CurrentCycleMaxUsage_CSA0 rba_MultiStackTrace_CurrentCycleMaxUsage_CSA1 rba_MultiStackTrace_CurrentCycleMaxUsage_CSA2 rba_MultiStackTrace_CurrentCycleMaxUsage_User0 rba_MultiStackTrace_CurrentCycleMaxUsage_User1 rba_MultiStackTrace_CurrentCycleMaxUsage_User2 rba_MultiStackTrace_LifeTimeMaxUsage_CSA0 rba_MultiStackTrace_LifeTimeMaxUsage_CSA1 rba_MultiStackTrace_LifeTimeMaxUsage_CSA2 rba_MultiStackTrace_LifeTimeMaxUsage_User0 rba_MultiStackTrace_LifeTimeMaxUsage_User1 rba_MultiStackTrace_LifeTimeMaxUsage_User2 rba_MultiStackTrace_ThresholdTable rba_OsMeasmt_CoreLoad[0].curCycleMax rba_OsMeasmt_CoreLoad[0].current rba_OsMeasmt_CoreLoad[0].lifeTimeMax rba_OsMeasmt_CoreLoad[1].curCycleMax rba_OsMeasmt_CoreLoad[1].current rba_OsMeasmt_CoreLoad[1].lifeTimeMax rba_OsMeasmt_CoreLoad[2].curCycleMax rba_OsMeasmt_CoreLoad[2].current rba_OsMeasmt_CoreLoad[2].lifeTimeMax rba_OsMeasmt_OS_1000ms_Task.CETCurrent rba_OsMeasmt_OS_1000ms_Task.CETCurrentLoad rba_OsMeasmt_OS_1000ms_Task.CETCurrentLoadMax rba_OsMeasmt_OS_1000ms_Task.CETCycleMax rba_OsMeasmt_OS_1000ms_Task.RespTimeCurrent rba_OsMeasmt_OS_1000ms_Task.RespTimeCycleMax rba_OsMeasmt_OS_1000ms_Task.RespTimeLifetimeMax rba_OsMeasmt_OS_100ms_Task.CETCurrent rba_OsMeasmt_OS_100ms_Task.CETCurrentLoad rba_OsMeasmt_OS_100ms_Task.CETCurrentLoadMax rba_OsMeasmt_OS_100ms_Task.CETCycleMax rba_OsMeasmt_OS_100ms_Task.RespTimeCurrent rba_OsMeasmt_OS_100ms_Task.RespTimeCycleMax rba_OsMeasmt_OS_100ms_Task.RespTimeLifetimeMax rba_OsMeasmt_OS_10ms_Task.CETCurrent rba_OsMeasmt_OS_10ms_Task.CETCurrentLoad rba_OsMeasmt_OS_10ms_Task.CETCurrentLoadMax rba_OsMeasmt_OS_10ms_Task.CETCycleMax rba_OsMeasmt_OS_10ms_Task.RespTimeCurrent rba_OsMeasmt_OS_10ms_Task.RespTimeCycleMax rba_OsMeasmt_OS_10ms_Task.RespTimeLifetimeMax rba_OsMeasmt_OS_1ms_Task.CETCurrent rba_OsMeasmt_OS_1ms_Task.CETCurrentLoad rba_OsMeasmt_OS_1ms_Task.CETCurrentLoadMax rba_OsMeasmt_OS_1ms_Task.CETCycleMax rba_OsMeasmt_OS_1ms_Task.RespTimeCurrent rba_OsMeasmt_OS_1ms_Task.RespTimeCycleMax rba_OsMeasmt_OS_1ms_Task.RespTimeLifetimeMax rba_OsMeasmt_OS_200ms_Task.CETCurrent rba_OsMeasmt_OS_200ms_Task.CETCurrentLoad rba_OsMeasmt_OS_200ms_Task.CETCurrentLoadMax rba_OsMeasmt_OS_200ms_Task.CETCycleMax rba_OsMeasmt_OS_200ms_Task.RespTimeCurrent rba_OsMeasmt_OS_200ms_Task.RespTimeCycleMax rba_OsMeasmt_OS_200ms_Task.RespTimeLifetimeMax rba_OsMeasmt_OS_20ms_Task.CETCurrent rba_OsMeasmt_OS_20ms_Task.CETCurrentLoad rba_OsMeasmt_OS_20ms_Task.CETCurrentLoadMax rba_OsMeasmt_OS_20ms_Task.CETCycleMax rba_OsMeasmt_OS_20ms_Task.RespTimeCurrent rba_OsMeasmt_OS_20ms_Task.RespTimeCycleMax rba_OsMeasmt_OS_20ms_Task.RespTimeLifetimeMax rba_OsMeasmt_OS_2ms_Task.CETCurrent rba_OsMeasmt_OS_2ms_Task.CETCurrentLoad rba_OsMeasmt_OS_2ms_Task.CETCurrentLoadMax rba_OsMeasmt_OS_2ms_Task.CETCycleMax rba_OsMeasmt_OS_2ms_Task.RespTimeCurrent rba_OsMeasmt_OS_2ms_Task.RespTimeCycleMax rba_OsMeasmt_OS_2ms_Task.RespTimeLifetimeMax rba_OsMeasmt_OS_50ms_Task.CETCurrent rba_OsMeasmt_OS_50ms_Task.CETCurrentLoad rba_OsMeasmt_OS_50ms_Task.CETCurrentLoadMax rba_OsMeasmt_OS_50ms_Task.CETCycleMax rba_OsMeasmt_OS_50ms_Task.RespTimeCurrent rba_OsMeasmt_OS_50ms_Task.RespTimeCycleMax rba_OsMeasmt_OS_50ms_Task.RespTimeLifetimeMax rba_OsMeasmt_OS_5ms_Task.CETCurrent rba_OsMeasmt_OS_5ms_Task.CETCurrentLoad rba_OsMeasmt_OS_5ms_Task.CETCurrentLoadMax rba_OsMeasmt_OS_5ms_Task.CETCycleMax rba_OsMeasmt_OS_5ms_Task.RespTimeCurrent rba_OsMeasmt_OS_5ms_Task.RespTimeCycleMax rba_OsMeasmt_OS_5ms_Task.RespTimeLifetimeMax rba_OsMeasmt_T1_CoreLoad[0].curCycleMax rba_OsMeasmt_T1_CoreLoad[0].current rba_OsMeasmt_T1_CoreLoad[1].curCycleMax rba_OsMeasmt_T1_CoreLoad[1].current rba_OsMeasmt_T1_CoreLoad[2].curCycleMax rba_OsMeasmt_T1_CoreLoad[2].current /end LOC_MEASUREMENT
 FUNCTION_VERSION "1.15.0" /end FUNCTION
/*********** Start of merged COMPU_METHOD blocks ***********/
/begin COMPU_METHOD RB_RBA_Common_CentralElements_CompuMethods_Identical "The internal value and the physical one are identical. No physical unit available" RAT_FUNC "%10.5" "noUnit" COEFFS 0.0 1.0 0.0 0.0 0.0 1.0 REF_UNIT RB_RBA_Common_CentralElements_Units_NoUnit /end COMPU_METHOD
/begin COMPU_METHOD Mcan_Can_CompuMethods_Can_CompuMethod_CtrlId "Compu Method for Can controllers" TAB_VERB "%10.5" "noUnit" COMPU_TAB_REF Mcan_Can_CompuMethods_Can_CompuMethod_CtrlId REF_UNIT Mcan_Can_Units_NoUnit /end COMPU_METHOD
/begin COMPU_METHOD Mcan_Can_CompuMethods_Can_CompuMethod_CtrlBdRateId_Can_APPL "Compu Method for Can controller Baudrate Id" TAB_VERB "%10.5" "noUnit" COMPU_TAB_REF Mcan_Can_CompuMethods_Can_CompuMethod_CtrlBdRateId_Can_APPL REF_UNIT Mcan_Can_Units_NoUnit /end COMPU_METHOD
/begin COMPU_METHOD Mcan_Can_CompuMethods_Can_CompuMethod_CtrlBdRateId_Can_C "Compu Method for Can controller Baudrate Id" TAB_VERB "%10.5" "noUnit" COMPU_TAB_REF Mcan_Can_CompuMethods_Can_CompuMethod_CtrlBdRateId_Can_C REF_UNIT Mcan_Can_Units_NoUnit /end COMPU_METHOD
/begin COMPU_METHOD Mcan_Can_CompuMethods_Can_CompuMethod_CtrlBdRateId_Can_VEHICLE "Compu Method for Can controller Baudrate Id" TAB_VERB "%10.5" "noUnit" COMPU_TAB_REF Mcan_Can_CompuMethods_Can_CompuMethod_CtrlBdRateId_Can_VEHICLE REF_UNIT Mcan_Can_Units_NoUnit /end COMPU_METHOD
/begin COMPU_METHOD RB_RBA_rba_IoDiagPwr_CompuMethod_rba_DiagPwr_BatteryThreshold_millivolts_CompuMethod "CompuMethod for battery voltage threshold" RAT_FUNC "%10.5" "mV" COEFFS 0.0 -1.0 0.0 0.0 0.0 -20.0 REF_UNIT RB_RBA_rba_IoDiagPwr_Units_rba_IoDiagPwr_mV /end COMPU_METHOD
/begin COMPU_METHOD RB_RBA_rba_IoDiagPwr_CompuMethod_rba_DiagPwr_DelayTest_100ms_CompuMethod "CompuMethod for delay time between test in 100ms" RAT_FUNC "%10.5" "100ms" COEFFS 0.0 -1.0 0.0 0.0 0.0 -1.0 REF_UNIT RB_RBA_rba_IoDiagPwr_Units_rba_IoDiagPwr_100ms /end COMPU_METHOD
/begin COMPU_METHOD RB_RBA_rba_IoSigDio_CompuMethods_rba_IoSigDio_HWSigPathCompuMethod "CompuMethod used for calibration parameters for signals in the post build data set __DEFAULT_VARIANT__" TAB_VERB "%10.5" "noUnit" COMPU_TAB_REF RB_RBA_rba_IoSigDio_CompuMethods_rba_IoSigDio_HWSigPathCompuMethod REF_UNIT RB_RBA_rba_IoSigDio_Units_NoUnit /end COMPU_METHOD
/begin COMPU_METHOD RB_RBA_rba_IoSigDio_CompuMethods_rba_IoSigDio_InvertCompuMethod "CompuMethod used for signal state calibration parameters" TAB_VERB "%10.5" "noUnit" COMPU_TAB_REF RB_RBA_rba_IoSigDio_CompuMethods_rba_IoSigDio_InvertCompuMethod REF_UNIT RB_RBA_rba_IoSigDio_Units_NoUnit /end COMPU_METHOD
/begin COMPU_METHOD RB_RBA_rba_IoSigRtc_CompuMethods_rba_IoSigRtc_DiagErrInjectCompuMethod "CompuMethod used for error injection parametersof rba_IoSigRtc" TAB_VERB "%10.5" "noUnit" COMPU_TAB_REF RB_RBA_rba_IoSigRtc_CompuMethods_rba_IoSigRtc_DiagErrInjectCompuMethod REF_UNIT RB_RBA_rba_IoSigRtc_Units_NoUnit /end COMPU_METHOD
/begin COMPU_METHOD RB_RBA_rba_MRly_BswModuleDescriptions_rba_MRly_Ctrl_States_CompuMethod "CompuMethod for control states of Main Relay" TAB_VERB "%10.5" "nounit" COMPU_TAB_REF RB_RBA_rba_MRly_BswModuleDescriptions_rba_MRly_Ctrl_States_CompuMethod REF_UNIT RB_RBA_rba_MRly_Units_NoUnit /end COMPU_METHOD
/begin COMPU_METHOD RB_RBA_rba_MRly_BswModuleDescriptions_rba_MRly_Calibration_Common_milliseconds_CompuMethod "CompuMethod for calibration in milliseconds of Main Relay" RAT_FUNC "%10.5" "ms" COEFFS 0.0 -1.0 0.0 0.0 0.0 -1.0 REF_UNIT RB_RBA_rba_MRly_Units_ms /end COMPU_METHOD
/begin COMPU_METHOD RB_RBA_rba_MRly_BswModuleDescriptions_rba_MRly_Sens_Measd_uBattClosedThr_millivolts_CompuMethod "CompuMethod for measured threshold voltage of the battery to set the status of Main Relay" RAT_FUNC "%10.5" "mV" COEFFS 0.0 -1.0 0.0 0.0 0.0 -20.0 REF_UNIT RB_RBA_rba_MRly_Units_mV /end COMPU_METHOD
/begin COMPU_METHOD RB_RBA_rba_OsMeasmt_CompuMethods_rba_OsMeasmt_PercConversion "Os measurement conversion factor for percent" RAT_FUNC "%10.5" "%" COEFFS 0.0 -1.0 0.0 0.0 0.0 -0.01 REF_UNIT RB_RBA_rba_OsMeasmt_Units_Perc /end COMPU_METHOD
/begin COMPU_METHOD RB_RBA_rba_OsMeasmt_CompuMethods_rba_OsMeasmt_TaskRespTime_CompuMethod "Task response time computation method" RAT_FUNC "%10.5" "us" COEFFS 0.0 -1.0 0.0 0.0 0.0 -0.01 REF_UNIT RB_RBA_rba_OsMeasmt_Units_MicroSec /end COMPU_METHOD
/begin COMPU_METHOD RB_RBA_rba_OsMeasmt_CompuMethods_rba_OsMeasmt_CET_T1_CompuMethod "Task CET computation method for T1" RAT_FUNC "%10.5" "us" COEFFS 0.0 -1.0 0.0 0.0 0.0 -0.16 REF_UNIT RB_RBA_rba_OsShell_Units_MicroSec /end COMPU_METHOD
/begin COMPU_METHOD RB_RBA_rba_OsMeasmt_CompuMethods_rba_OsMeasmt_T1_PercConversion "Os measurement conversion factor for T1 percent" RAT_FUNC "%10.5" "%" COEFFS 0.0 -1.0 0.0 0.0 0.0 -1.0 REF_UNIT RB_RBA_rba_OsMeasmt_Units_Perc /end COMPU_METHOD
/begin COMPU_METHOD RB_RBA_rba_OsMeasmt_CompuMethods_rba_OsMeasmt_SwTrace_InitMode_CompuMethod "Enum for different Gliwa Init Modes" TAB_VERB "%10.5" "noUnit" COMPU_TAB_REF RB_RBA_rba_OsMeasmt_CompuMethods_rba_OsMeasmt_SwTrace_InitMode_CompuMethod REF_UNIT RB_RBA_rba_OsMeasmt_Units_NoUnit /end COMPU_METHOD
/begin COMPU_VTAB Mcan_Can_CompuMethods_Can_CompuMethod_CtrlId "Compu Method for Can controllers" TAB_VERB 3 0 "Can_APPL" 1 "Can_C" 2 "Can_VEHICLE" /end COMPU_VTAB
/begin COMPU_VTAB Mcan_Can_CompuMethods_Can_CompuMethod_CtrlBdRateId_Can_APPL "Compu Method for Can controller Baudrate Id" TAB_VERB 1 0 "CanControllerBaudrateConfig" /end COMPU_VTAB
/begin COMPU_VTAB Mcan_Can_CompuMethods_Can_CompuMethod_CtrlBdRateId_Can_C "Compu Method for Can controller Baudrate Id" TAB_VERB 1 0 "CanControllerBaudrateConfig" /end COMPU_VTAB
/begin COMPU_VTAB Mcan_Can_CompuMethods_Can_CompuMethod_CtrlBdRateId_Can_VEHICLE "Compu Method for Can controller Baudrate Id" TAB_VERB 1 0 "CanControllerBaudrateConfig" /end COMPU_VTAB
/begin COMPU_VTAB RB_RBA_rba_IoSigDio_CompuMethods_rba_IoSigDio_HWSigPathCompuMethod "CompuMethod used for calibration parameters for signals in the post build data set __DEFAULT_VARIANT__" TAB_VERB 1 2 "HWSigPath_DIO_33_00" /end COMPU_VTAB
/begin COMPU_VTAB RB_RBA_rba_IoSigDio_CompuMethods_rba_IoSigDio_InvertCompuMethod "CompuMethod used for signal state calibration parameters" TAB_VERB 2 0 "NonInvert" 1 "Invert" /end COMPU_VTAB
/begin COMPU_VTAB RB_RBA_rba_IoSigRtc_CompuMethods_rba_IoSigRtc_DiagErrInjectCompuMethod "CompuMethod used for error injection parametersof rba_IoSigRtc" TAB_VERB 9 0 "Idle State: No error is injected in diagnosis" 1 "Error State: Simulates counter is running way too fast (single step error)" 2 "Error State: Simulates counter is running way too slow (single step error)" 3 "Error State: Simulates counter is running too fast (overall accuracy)" 4 "Error State: Simulates counter is running too slow (overall accuracy)" 5 "Error State: Simulates not all counter bits are able to change their value" 6 "Error State: Simulates communication error with device driver" 7 "Error State: Simulates error while reading from NvM (during Initialization)" 8 "Error State: Simulates counter is stuck during accuracy diagnosis" /end COMPU_VTAB
/begin COMPU_VTAB RB_RBA_rba_MRly_BswModuleDescriptions_rba_MRly_Ctrl_States_CompuMethod "CompuMethod for control states of Main Relay" TAB_VERB 2 0 "rba_MRly_Ctrl_Open_e" 1 "rba_MRly_Ctrl_Close_e" /end COMPU_VTAB
/begin COMPU_VTAB RB_RBA_rba_OsMeasmt_CompuMethods_rba_OsMeasmt_SwTrace_InitMode_CompuMethod "Enum for different Gliwa Init Modes" TAB_VERB 3 0 "GLIWA_T1_PRODUCTIVE" 1 "GLIWA_T1_DEVELOPMENT" 2 "GLIWA_T1_OFF" /end COMPU_VTAB
/begin COMPU_METHOD ACCHRGRINTKT_TYPAVL_SC_Compu "" TAB_VERB "%6.3" "" COMPU_TAB_REF ACCHRGRINTKT_TYPAVL_SC_Compu /end COMPU_METHOD
/begin COMPU_VTAB ACCHRGRINTKT_TYPAVL_SC_Compu "" TAB_VERB 2 0 "False" 1 "True" /end COMPU_VTAB
/begin COMPU_METHOD ACCI_INHOUSE_SY_Compu "" TAB_VERB "%6.3" "" COMPU_TAB_REF ACCI_INHOUSE_SY_Compu /end COMPU_METHOD
/begin COMPU_VTAB ACCI_INHOUSE_SY_Compu "" TAB_VERB 2 0 "False" 1 "True" /end COMPU_VTAB
/begin COMPU_METHOD ACCLMON_SY_Compu "" TAB_VERB "%6.3" "" COMPU_TAB_REF ACCLMON_SY_Compu /end COMPU_METHOD
/begin COMPU_VTAB ACCLMON_SY_Compu "" TAB_VERB 3 0 "NOAMO" 1 "AMO_OVR" 2 "AMO_NO_OVR" /end COMPU_VTAB
/begin COMPU_METHOD ACCLNTP_ATS_SY_Compu "" TAB_VERB "%6.3" "" COMPU_TAB_REF ACCLNTP_ATS_SY_Compu /end COMPU_METHOD
/begin COMPU_VTAB ACCLNTP_ATS_SY_Compu "" TAB_VERB 2 0 "False" 1 "True" /end COMPU_VTAB
/begin COMPU_METHOD ACCLNTP_CODAVL_SC_Compu "" TAB_VERB "%6.3" "" COMPU_TAB_REF ACCLNTP_CODAVL_SC_Compu /end COMPU_METHOD
/begin COMPU_VTAB ACCLNTP_CODAVL_SC_Compu "" TAB_VERB 2 0 "False" 1 "True" /end COMPU_VTAB
/begin COMPU_METHOD ACCLNTP_SENSTYP_SY_Compu "" TAB_VERB "%6.3" "" COMPU_TAB_REF ACCLNTP_SENSTYP_SY_Compu /end COMPU_METHOD
/begin COMPU_VTAB ACCLNTP_SENSTYP_SY_Compu "" TAB_VERB 4 0 "ADCIN" 1 "PWMOUT" 2 "ADCIN_PWMOUT" 3 "CONNECT_NONE" /end COMPU_VTAB
/begin COMPU_METHOD ACCMPR_CODAVL_SC_Compu "" TAB_VERB "%6.3" "" COMPU_TAB_REF ACCMPR_CODAVL_SC_Compu /end COMPU_METHOD
/begin COMPU_VTAB ACCMPR_CODAVL_SC_Compu "" TAB_VERB 2 0 "False" 1 "True" /end COMPU_VTAB
/begin COMPU_METHOD ACCPED_EXTDGEAR_SC_Compu "" TAB_VERB "%6.3" "" COMPU_TAB_REF ACCPED_EXTDGEAR_SC_Compu /end COMPU_METHOD
/begin COMPU_VTAB ACCPED_EXTDGEAR_SC_Compu "" TAB_VERB 3 0 "SNGMAPSELN" 1 "LOMEDHIGEARMAPSELN" 2 "GEARBASEDMAPSELN" /end COMPU_VTAB
/begin COMPU_METHOD ACCTL_DEMANDTQDWNENA_SC_Compu "" TAB_VERB "%6.3" "" COMPU_TAB_REF ACCTL_DEMANDTQDWNENA_SC_Compu /end COMPU_METHOD
/begin COMPU_VTAB ACCTL_DEMANDTQDWNENA_SC_Compu "" TAB_VERB 2 0 "False" 1 "True" /end COMPU_VTAB
/begin COMPU_METHOD ACC_SY_Compu "" TAB_VERB "%6.3" "" COMPU_TAB_REF ACC_SY_Compu /end COMPU_METHOD
/begin COMPU_VTAB ACC_SY_Compu "" TAB_VERB 2 0 "FALSE" 1 "TRUE" /end COMPU_VTAB
/begin COMPU_METHOD ACEVPT_PHYSRNGCHK_SC_Compu "" TAB_VERB "%6.3" "" COMPU_TAB_REF ACEVPT_PHYSRNGCHK_SC_Compu /end COMPU_METHOD
/begin COMPU_VTAB ACEVPT_PHYSRNGCHK_SC_Compu "" TAB_VERB 2 0 "False" 1 "True" /end COMPU_VTAB
/begin COMPU_METHOD ACSWT_ATS_SY_Compu "" TAB_VERB "%6.3" "" COMPU_TAB_REF ACSWT_ATS_SY_Compu /end COMPU_METHOD
/begin COMPU_VTAB ACSWT_ATS_SY_Compu "" TAB_VERB 2 0 "False" 1 "True" /end COMPU_VTAB
/begin COMPU_METHOD ACSYEMAC_SC_Compu "" TAB_VERB "%6.3" "" COMPU_TAB_REF ACSYEMAC_SC_Compu /end COMPU_METHOD
/begin COMPU_VTAB ACSYEMAC_SC_Compu "" TAB_VERB 2 0 "False" 1 "True" /end COMPU_VTAB
/begin COMPU_METHOD ActAngle "" RAT_FUNC "%6.4" "deg" COEFFS 0 20 0 0 0 1 /end COMPU_METHOD
/begin COMPU_METHOD ACTRLIB_IINITSPEZIAL_SY_Compu "" TAB_VERB "%6.3" "" COMPU_TAB_REF ACTRLIB_IINITSPEZIAL_SY_Compu /end COMPU_METHOD
/begin COMPU_VTAB ACTRLIB_IINITSPEZIAL_SY_Compu "" TAB_VERB 2 0 "FALSE" 1 "TRUE" /end COMPU_VTAB
/begin COMPU_METHOD ACTTRQCO_SY_Compu "" TAB_VERB "%6.3" "" COMPU_TAB_REF ACTTRQCO_SY_Compu /end COMPU_METHOD
/begin COMPU_VTAB ACTTRQCO_SY_Compu "" TAB_VERB 2 0 "FALSE" 1 "TRUE" /end COMPU_VTAB
/begin COMPU_METHOD ACTYP_SY_Compu "" TAB_VERB "%6.3" "" COMPU_TAB_REF ACTYP_SY_Compu /end COMPU_METHOD
/begin COMPU_VTAB ACTYP_SY_Compu "" TAB_VERB 5 0 "NO_AC" 1 "ACTYP_MECH_FIX" 2 "ACTYP_MECH_VAR" 3 "ACTYP_ELEC" 4 "ACTYP_MECHELEC" /end COMPU_VTAB
/begin COMPU_METHOD AC_DEMAND_SY_Compu "" TAB_VERB "%6.3" "" COMPU_TAB_REF AC_DEMAND_SY_Compu /end COMPU_METHOD
/begin COMPU_VTAB AC_DEMAND_SY_Compu "" TAB_VERB 2 0 "False" 1 "True" /end COMPU_VTAB
/begin COMPU_METHOD ADDLEONV_SC_Compu "" TAB_VERB "%6.3" "" COMPU_TAB_REF ADDLEONV_SC_Compu /end COMPU_METHOD
/begin COMPU_VTAB ADDLEONV_SC_Compu "" TAB_VERB 2 0 "False" 1 "True" /end COMPU_VTAB
/begin COMPU_METHOD ADDLNMAXLVL_SC_Compu "" TAB_VERB "%6.3" "" COMPU_TAB_REF ADDLNMAXLVL_SC_Compu /end COMPU_METHOD
/begin COMPU_VTAB ADDLNMAXLVL_SC_Compu "" TAB_VERB 2 0 "False" 1 "True" /end COMPU_VTAB
/begin COMPU_METHOD ADVREQIDLENGCATHEATG_SC_Compu "" TAB_VERB "%6.3" "" COMPU_TAB_REF ADVREQIDLENGCATHEATG_SC_Compu /end COMPU_METHOD
/begin COMPU_VTAB ADVREQIDLENGCATHEATG_SC_Compu "" TAB_VERB 2 0 "False" 1 "True" /end COMPU_VTAB
/begin COMPU_METHOD AFSP_MNTPOSN_SC_Compu "" TAB_VERB "%6.3" "" COMPU_TAB_REF AFSP_MNTPOSN_SC_Compu /end COMPU_METHOD
/begin COMPU_VTAB AFSP_MNTPOSN_SC_Compu "" TAB_VERB 5 0 "Disabled" 1 "AfsPSnsrMntPosIcoDs" 2 "AfsPSnsrMntPosIcoUs" 3 "AfsPSnsrMntPosEgrCoolrDs" 4 "AfsPSnsrMntPosAirFilDs" /end COMPU_VTAB
/begin COMPU_METHOD AFSP_TYPAVL_SC_Compu "" TAB_VERB "%6.3" "" COMPU_TAB_REF AFSP_TYPAVL_SC_Compu /end COMPU_METHOD
/begin COMPU_VTAB AFSP_TYPAVL_SC_Compu "" TAB_VERB 2 0 "False" 1 "True" /end COMPU_VTAB
/*********** Start of merged RECORD_LAYOUT blocks ***********/
/begin RECORD_LAYOUT DefaultValueRecordLayout_AUTOSAR_Platform_BaseTypes_uint8 FNC_VALUES 1 UBYTE COLUMN_DIR DIRECT STATIC_RECORD_LAYOUT /end RECORD_LAYOUT
/begin RECORD_LAYOUT DefaultValueRecordLayout_AUTOSAR_Platform_BaseTypes_uint32 FNC_VALUES 1 ULONG COLUMN_DIR DIRECT STATIC_RECORD_LAYOUT /end RECORD_LAYOUT
/begin RECORD_LAYOUT DefaultValueRecordLayout_AUTOSAR_Platform_BaseTypes_uint16 FNC_VALUES 1 UWORD COLUMN_DIR DIRECT STATIC_RECORD_LAYOUT /end RECORD_LAYOUT
/begin RECORD_LAYOUT DefaultValueRecordLayout_AUTOSAR_Platform_BaseTypes_boolean FNC_VALUES 1 UBYTE COLUMN_DIR DIRECT STATIC_RECORD_LAYOUT /end RECORD_LAYOUT
/*********** Start of merged UNIT blocks ***********/
/begin UNIT RB_RBA_Common_CentralElements_Units_NoUnit "No Unit" "noUnit" EXTENDED_SI SI_EXPONENTS 0 0 0 0 0 0 0 /end UNIT
/begin UNIT Mcan_Can_Units_NoUnit "No Unit" "noUnit" EXTENDED_SI SI_EXPONENTS 0 0 0 0 0 0 0 /end UNIT
/begin UNIT RB_RBA_rba_IoDiagPwr_Units_rba_IoDiagPwr_mV "Millivolt" "mV" EXTENDED_SI SI_EXPONENTS 0 0 0 0 0 0 0 /end UNIT
/begin UNIT RB_RBA_rba_IoDiagPwr_Units_rba_IoDiagPwr_100ms "Millisecond" "100ms" EXTENDED_SI SI_EXPONENTS 0 0 0 0 0 0 0 /end UNIT
/begin UNIT RB_RBA_rba_IoSigDio_Units_NoUnit "No Unit" "noUnit" EXTENDED_SI SI_EXPONENTS 0 0 0 0 0 0 0 /end UNIT
/begin UNIT RB_RBA_rba_IoSigRtc_Units_NoUnit "No Unit" "noUnit" EXTENDED_SI SI_EXPONENTS 0 0 0 0 0 0 0 /end UNIT
/begin UNIT RB_RBA_rba_MRly_Units_NoUnit "No Unit" "nounit" EXTENDED_SI SI_EXPONENTS 0 0 0 0 0 0 0 /end UNIT
/begin UNIT RB_RBA_rba_MRly_Units_ms "Millisecond" "ms" EXTENDED_SI SI_EXPONENTS 0 0 1 0 0 0 0 /end UNIT
/begin UNIT RB_RBA_rba_MRly_Units_mV "Millivolt" "mV" EXTENDED_SI SI_EXPONENTS 0 0 0 0 0 0 0 /end UNIT
/begin UNIT RB_RBA_rba_OsMeasmt_Units_Perc "Percent" "%" EXTENDED_SI /end UNIT
/begin UNIT RB_RBA_rba_OsMeasmt_Units_MicroSec "Micro Second" "us" EXTENDED_SI /end UNIT
/begin UNIT RB_RBA_rba_OsShell_Units_MicroSec "Micro Second" "us" EXTENDED_SI /end UNIT
/begin UNIT RB_RBA_rba_OsMeasmt_Units_NoUnit "No Unit" "noUnit" EXTENDED_SI SI_EXPONENTS 0 0 0 0 0 0 0 /end UNIT
/end MODULE
/end PROJECT
