ASAP2_VERSION 1 60
/begin PROJECT MG1CS022 "MG1CS022"
/begin HEADER "" VERSION "MG1CS022_62XSC_V037" PROJECT_NO MG1CS022 /end HEADER
/begin MODULE DIM ""
/begin MOD_COMMON "" BYTE_ORDER MSB_LAST ALIGNMENT_BYTE 1 ALIGNMENT_WORD 2 ALIGNMENT_LONG 4 ALIGNMENT_INT64 4 ALIGNMENT_FLOAT32_IEEE 4 ALIGNMENT_FLOAT64_IEEE 4 DATA_SIZE 32 /end MOD_COMMON
/begin CHARACTERISTIC ANZTILRA "min. number of injections for enabling fuel mixture adaptation" VALUE 0x805790CE RB_Val_Wu16 65535.00 dez 0.00 65535.00 FORMAT "%8.2" /end CHARACTERISTIC
/begin CHARACTERISTIC ANZTIWSLRA "min. number of injections after automatic start for enabling fuel mixture adaptation" VALUE 0x805790D0 RB_Val_Wu16 65535.00 dez 0.00 65535.00 FORMAT "%8.2" /end CHARACTERISTIC
/begin CHARACTERISTIC CNFLLRNS "Configuration byte for determination of target engine speed at idle" VALUE 0x805720F2 RB_Val_Wu8 255.0 dez 0.00 255.0 FORMAT "%5.1" /end CHARACTERISTIC
/begin CHARACTERISTIC CNFMDVER "Codeword to configure the function MDVER" VALUE 0x80579A90 RB_Val_Wu16 65535.00 dez 0.00 65535.00 FORMAT "%8.2" /end CHARACTERISTIC
/begin CHARACTERISTIC CWFRAINIT "Code word to select different initialization values for multiplicative correction of mixture adaptation" VALUE 0x80578F82 RB_Val_Wu8 255.0 dez 0.00 255.0 FORMAT "%5.1" /end CHARACTERISTIC
/begin CHARACTERISTIC CWLLRNS "codeword for idle increase." VALUE 0x805720F3 RB_Val_Wu8 255.0 dez 0.00 255.0 FORMAT "%5.1" /end CHARACTERISTIC
/begin CHARACTERISTIC CWLOCONOHK "Codeword for configuration NOx-sensor" VALUE 0x80578F80 RB_Val_Wu8 255.0 dez 0.00 255.0 FORMAT "%5.1" /end CHARACTERISTIC
/begin CHARACTERISTIC CWLRADLSUCHK "Code word for activating the writing of the adaptation values from the last driving cycle" VALUE 0x80578F83 RB_Val_Wu8 255.0 dez 0.00 255.0 FORMAT "%5.1" /end CHARACTERISTIC
/begin CHARACTERISTIC CWLRADYN "Codeword to select between Engine speed(nmot) gradient and Co-ordinated torque request for charge(milsol_w) gradient" VALUE 0x80578F84 RB_Val_Wu8 255.0 dez 0.00 255.0 FORMAT "%5.1" /end CHARACTERISTIC
/begin CHARACTERISTIC CWLRAEB "code word for mixture adaptation" VALUE 0x805790D2 RB_Val_Wu8 255.0 dez 0.00 255.0 FORMAT "%5.1" /end CHARACTERISTIC
/begin CHARACTERISTIC CWLRAEBORA "codeword to configure additive correction of the mixture adaptation (ORA) enable conditions" VALUE 0x805790D3 RB_Val_Wu8 255.0 dez 0.00 255.0 FORMAT "%5.1" /end CHARACTERISTIC
/begin CHARACTERISTIC CWLRAFCLR "Codeword to clear certain interfaces on fault memory clear trigger in LRA(Lambda closed loop control; Adaptive pilot control) module." VALUE 0x80578F85 RB_Val_Wu8 255.0 dez 0.00 255.0 FORMAT "%5.1" /end CHARACTERISTIC
/begin CHARACTERISTIC CWLRMS "Code word enleanment protection" VALUE 0x805791B2 RB_Val_Wu8 255.0 dez 0.00 255.0 FORMAT "%5.1" /end CHARACTERISTIC
/begin CHARACTERISTIC CWLRS "Code word for function LRS (LRS: continuous lambda control)" VALUE 0x805791B3 RB_Val_Wu8 255.0 dez 0.00 255.0 FORMAT "%5.1" /end CHARACTERISTIC
/begin CHARACTERISTIC CWLRSEB "Code word to enable LRS" VALUE 0x805793FC RB_Val_Wu8 255.0 dez 0.00 255.0 FORMAT "%5.1" /end CHARACTERISTIC
/begin CHARACTERISTIC CWLRSEB2 "Code word to enable LRS, no. 2" VALUE 0x805793FD RB_Val_Wu8 255.0 dez 0.00 255.0 FORMAT "%5.1" /end CHARACTERISTIC
/begin CHARACTERISTIC CWLRSMOD "Code word lambda control enabling for operating modes" VALUE 0x805793FE RB_Val_Wu8 255.0 dez 0.00 255.0 FORMAT "%5.1" /end CHARACTERISTIC
/begin CHARACTERISTIC CWMADWMG "Code Word for adaptation-value-manager magnetic injection valve" VALUE 0x80579510 RB_Val_Wu8 255.0 dez 0.00 255.0 FORMAT "%5.1" /end CHARACTERISTIC
/begin CHARACTERISTIC CWMDIST "codeword MDIST - engine torque computation" VALUE 0x80579914 RB_Val_Wu8 255.0 dez 0.00 255.0 FORMAT "%5.1" /end CHARACTERISTIC
/begin CHARACTERISTIC CWMDMAX "codeword in MDMAX" VALUE 0x80579920 RB_Val_Wu8 255.0 dez 0.00 255.0 FORMAT "%5.1" /end CHARACTERISTIC
/begin CHARACTERISTIC CWMDRLMN "configuration (codeword) of MDRLMN" VALUE 0x805799CA RB_Val_Wu8 255.0 dez 0.00 255.0 FORMAT "%5.1" /end CHARACTERISTIC
/begin CHARACTERISTIC CWNSTAT "Codeword for the Filtration of nstat" VALUE 0x805720F4 RB_Val_Wu8 255.0 dez 0.00 255.0 FORMAT "%5.1" /end CHARACTERISTIC
/begin CHARACTERISTIC CWORAP "code word for calculation or consideration additive correction of the mixture adaptation orap_w(Manifold Air Pressure sensor systems)" VALUE 0x80578F86 RB_Val_Wu8 255.0 dez 0.00 255.0 FORMAT "%5.1" /end CHARACTERISTIC
/begin CHARACTERISTIC CWRKANMIL "Codeword to enable additive adaptive correction of the relative fuel amount (rka_w) calculation based on moment and engine speed" VALUE 0x80578F87 RB_Val_Wu8 255.0 dez 0.00 255.0 FORMAT "%5.1" /end CHARACTERISTIC
/begin CHARACTERISTIC CWRKANMOT "Codeword to enable additive adaptive correction of the relative fuel amount (rka_w) calculation based on engine speed(nmot)" VALUE 0x80578F88 RB_Val_Wu8 255.0 dez 0.00 255.0 FORMAT "%5.1" /end CHARACTERISTIC
/begin CHARACTERISTIC CWUBORAERW "Code word to configure engine mode independent enable conditions of ORA(additive correction of the mixture adaptation)" VALUE 0x805790D4 RB_Val_Wu8 255.0 dez 0.00 255.0 FORMAT "%5.1" /end CHARACTERISTIC
/begin CHARACTERISTIC DFRMSTKH "maximum threshold of lowpass filtered dfrm(2)[deviation of fast lambda controller mean value from 1.0 (Word)] for stable criterion of adaptation" VALUE 0x80578F8A RB_Val_Wu16 1.999969 fak_uw_b2 0.00 1.999969 FORMAT "%8.6" /end CHARACTERISTIC
/begin CHARACTERISTIC DLAHPLRAMN "lower limitation of taking into account the P-component of the lambda controller downstream in fuel mixture adaptation" VALUE 0x80578F8C RB_Val_Ws16 1.999969 fak_sw_b1 -1.000000 0.999969 FORMAT "%8.6" EXTENDED_LIMITS -1.000000 0.9999695 /end CHARACTERISTIC
/begin CHARACTERISTIC DLAHPLRAMX "upper limitation of taking into account the P-component of the lambda controller downstream in fuel mixture adaptation" VALUE 0x80578F8E RB_Val_Ws16 1.999969 fak_sw_b1 -1.000000 0.999969 FORMAT "%8.6" EXTENDED_LIMITS -1.000000 0.9999695 /end CHARACTERISTIC
/begin CHARACTERISTIC DLAMXSA "maximum control error for enabling closed-loop lambda control after fuel cut-off" VALUE 0x80579400 RB_Val_Wu16 15.99976 fak_uw_b16 0.00 15.99976 FORMAT "%8.5" /end CHARACTERISTIC
/begin CHARACTERISTIC DMLMVORAMX "maximum delta torque above loss torque for ORA adaptation (at higher load)" VALUE 0x805790D6 RB_Val_Wu16 99.99847 rel_uw_b100 0.00 99.99847 FORMAT "%8.5" /end CHARACTERISTIC
/begin CHARACTERISTIC DMRAA "general torque margin quick trip" VALUE 0x80579A82 RB_Val_Wu16 99.99847 rel_uw_b100 0.00 99.99847 FORMAT "%8.5" /end CHARACTERISTIC
/begin CHARACTERISTIC DVFBESOERW "Vehicle speed threshold to detect the acceleration within a certain time duration" VALUE 0x805790D8 RB_Val_Wu16 511.9922 vfzg_uw_b512 0.00 511.9922 FORMAT "%8.4" /end CHARACTERISTIC
/begin CHARACTERISTIC DVFUBOERW "Vehicle speed threshold for expected engine mode independant enable conditions of ORA" VALUE 0x805790DA RB_Val_Wu16 511.9922 vfzg_uw_b512 0.00 511.9922 FORMAT "%8.4" /end CHARACTERISTIC
/begin CHARACTERISTIC EngReq_tqDecExlResv_C "decrement of the real torque reserve" VALUE 0x805799C8 RB_Val_Ws16 3276.700 Trq 0.00 3276.700 FORMAT "%8.3" EXTENDED_LIMITS -3276.800 3276.700 /end CHARACTERISTIC
/begin CHARACTERISTIC EnvP_pDfl_C "Default value for environment pressure" VALUE 0x80579DA0 RB_Val_Ws16 3500.000 Pres_hPa 0.00 3500.000 FORMAT "%8.3" EXTENDED_LIMITS -32768.00 32767.00 /end CHARACTERISTIC
/begin CHARACTERISTIC EnvT_tDfl_C "Default value for temperature of environment air" VALUE 0x80579DA2 RB_Val_Ws16 6553.500 Temp_Cels -3549.940 3003.560 FORMAT "%8.3" /end CHARACTERISTIC
/begin CHARACTERISTIC ExhCo_flgLsfNoxSnsrOptn_CW "Codebit to choose LSF or Nox sensor into consideration." VALUE 0x80578F81 RB_Val_Wu8 1.00000000000 B_TRUE 0.00 1.00000000000 FORMAT "%13.11" /end CHARACTERISTIC
/begin CHARACTERISTIC FFRAKBO "factor for decreasing the integration speed of FRA_IK(Integrator for multiplicative correction of mixture adaptation) in case of high fuel in oil" VALUE 0x80578F90 RB_Val_Wu8 1.992188 fak_ub_b2 0.00 1.992188 FORMAT "%8.6" /end CHARACTERISTIC
/begin CHARACTERISTIC FFRAKFV "factor for increasing integration speed integrator FRA_IK(Integrator for multiplicative correction of mixture adaptation) in case of error suspicion" VALUE 0x80578F92 RB_Val_Wu16 31.87500 fak_ub_b32 0.00 31.87500 FORMAT "%8.5" EXTENDED_LIMITS 0.00 8191.875 /end CHARACTERISTIC
/begin CHARACTERISTIC FGAUSGGAMX "deactivation threshold of fuel mixture adaptation if the proportion of evaporating fuel from the engine oil to the fuel demand is too big" VALUE 0x805790DC RB_Val_Wu8 1.992188 fak_ub_b2 0.00 1.992188 FORMAT "%8.6" /end CHARACTERISTIC
/begin CHARACTERISTIC FKTMOD "Interpolation factor temperature for drag torque calculation" VALUE 0x80579A92 RB_Val_Wu8 0.9961 fak_ub_b1 0.00 0.9961 /end CHARACTERISTIC
/begin CHARACTERISTIC FlMA_facAftStrtWrmUp_C "Threshold of factor after start and warm up for mixture adaptation" VALUE 0x805790DE RB_Val_Wu16 15.99976 fak_uw_b16 0.00 15.99976 FORMAT "%8.5" /end CHARACTERISTIC
/begin CHARACTERISTIC FlMA_facDynAddAdpnSpdRed_T "Characteristic curve to reduce the additive adaptation speed due to dynamic effects" CURVE 0x80578F94 RB_Curve_S16_U8_Static 1.984375 fak_ub_b2 0.007813 1.992188 FORMAT "%8.6" EXTENDED_LIMITS 0.00 1.992188
 /begin AXIS_DESCR STD_AXIS FlMA_ratLoadGrdt rel_sw_b100 6 -100.0000 99.9969 FORMAT "%8.4" EXTENDED_LIMITS -100.0000 99.99695 DEPOSIT ABSOLUTE /end AXIS_DESCR
/end CHARACTERISTIC
/begin CHARACTERISTIC FlMA_facDynMulAdpnSpdRed_T "Characteristic curve to reduce the multiplicative adaptation speed due to dynamic effects" CURVE 0x80578FA8 RB_Curve_S16_U8_Static 0.9921875 fak_ub_b2 0.007813 1.000000 FORMAT "%8.6" EXTENDED_LIMITS 0.00 1.992188
 /begin AXIS_DESCR STD_AXIS FlMA_ratLoadGrdt rel_sw_b100 6 -100.0000 99.9969 FORMAT "%8.4" EXTENDED_LIMITS -100.0000 99.99695 DEPOSIT ABSOLUTE /end AXIS_DESCR
/end CHARACTERISTIC
/begin CHARACTERISTIC FlMA_facFuEvapAddAdpnSpdRed_T "Characteristic curve to reduce the additive adaptation speed due to fuel evaporation from engine oil" CURVE 0x80578FBC RB_Curve_U8_U8 0.9921875 fak_ub_b2 0.007813 1.000000 FORMAT "%8.6" EXTENDED_LIMITS 0.00 1.992188
 /begin AXIS_DESCR STD_AXIS fgausmx_msg fak_ub_b2 4 0.00 1.992188 FORMAT "%8.6" DEPOSIT ABSOLUTE /end AXIS_DESCR
/end CHARACTERISTIC
/begin CHARACTERISTIC FlMA_facFuEvapMulAdpnSpdRed_T "Characteristic curve to reduce the multiplicative adaptation speed due to fuel evaporation from engine oil" CURVE 0x80578FC5 RB_Curve_U8_U8 0.9921875 fak_ub_b2 0.007813 1.000000 FORMAT "%8.6" EXTENDED_LIMITS 0.00 1.992188
 /begin AXIS_DESCR STD_AXIS fgausmx_msg fak_ub_b2 4 0.00 1.992188 FORMAT "%8.6" DEPOSIT ABSOLUTE /end AXIS_DESCR
/end CHARACTERISTIC
/begin CHARACTERISTIC FlMA_stCfgEnaCnd "Codeword to configure the enabling condition of mixture adaptation" VALUE 0x805790E0 RB_Val_Wu8 255.0 dez 0.00 255.0 FORMAT "%5.1" /end CHARACTERISTIC
/begin CHARACTERISTIC FlMA_stCfgEnhdEnaCdn_C "Configuration of the enhanced enable conditions" VALUE 0x805790E1 RB_Val_Wu8 255.0 dez 0.00 255.0 FORMAT "%5.1" /end CHARACTERISTIC
/begin CHARACTERISTIC FlMA_tiEnhdEnagFacAdpnStab_C "duration of the fra(multiplicative mixture adaptation) adaptation, until the release of the ora(additive correction of the mixture adaptation)adaptation." VALUE 0x805790E2 RB_Val_Wu16 13107.00 t_q0p2 0.00 13107.00 FORMAT "%8.2" /end CHARACTERISTIC
/begin CHARACTERISTIC FlMA_tiLoadGrdtFil_C "Time constant for low pass filtering of load dynamic" VALUE 0x80578FCE RB_Val_Wu16 13106.999997 zk200msxs_uw_b13107 0.200003 13107.200000 FORMAT "%12.6" EXTENDED_LIMITS 0.20000305180 13107.200000 /end CHARACTERISTIC
/begin CHARACTERISTIC FMIISTSTN "Ramp-up factor for actual engine torque during start over engine speed" CURVE 0x80579915 RB_Curve_U8_U8 1.992188 fak_ub_b2 0.00 1.992188 FORMAT "%8.6"
 /begin AXIS_DESCR STD_AXIS NO_INPUT_QUANTITY nmot_q10 5 0.00 2550. FORMAT "%5.0" DEPOSIT ABSOLUTE /end AXIS_DESCR
/end CHARACTERISTIC
/begin CHARACTERISTIC FORAKBO "factor for decreasing the integration speed of ORA_IK(Integrator for additive correction of mixture adaptation) in case of high fuel in oil" VALUE 0x80578FD0 RB_Val_Wu8 1.992188 fak_ub_b2 0.00 1.992188 FORMAT "%8.6" /end CHARACTERISTIC
/begin CHARACTERISTIC FORAKFV "factor for increasing integration speed integrator ORA_IK(Integrator for additive correction of mixture adaptation) in case of error suspicion" VALUE 0x80578FD1 RB_Val_Wu8 31.88 fak_ub_b32 0.00 31.88 FORMAT "%5.2" /end CHARACTERISTIC
/begin CHARACTERISTIC FRADIFF "Threshold of changes in frai_w(multiplicative correction of the mixture adaptation) from last driving cycle when the lamda sensor is not yet OK tested" VALUE 0x80578FD2 RB_Val_Wu16 1.999969 fak_uw_b2 0.00 1.999969 FORMAT "%8.6" /end CHARACTERISTIC
/begin CHARACTERISTIC FRAMN "Lower limit for multiplicative correction of the mixture adaptation(fra)" VALUE 0x80578FD4 RB_Val_Wu16 1.999969 fak_uw_b2 0.00 1.999969 FORMAT "%8.6" /end CHARACTERISTIC
/begin CHARACTERISTIC FRAMX "Upper limit for multiplicative correction of the mixture adaptation(fra)" VALUE 0x80578FD6 RB_Val_Wu16 1.999969 fak_uw_b2 0.00 1.999969 FORMAT "%8.6" /end CHARACTERISTIC
/begin CHARACTERISTIC FREDMN "Interpolation factor - minimum reduction stage" VALUE 0x80579966 RB_Val_Wu8 0.9961 fak_ub_b1 0.00 0.9961 /end CHARACTERISTIC
/begin CHARACTERISTIC FREDMX "Interpolation factor - maximum reduction stage" VALUE 0x80579967 RB_Val_Wu8 0.9961 fak_ub_b1 0.00 0.9961 /end CHARACTERISTIC
/begin CHARACTERISTIC FREDTYP "strategy for computation of desired reduction stage (based on specific request)" VALUE 0x80579968 RB_Val_Wu8 255.0 dez 0.00 255.0 FORMAT "%5.1" /end CHARACTERISTIC
/begin CHARACTERISTIC FRMAX "Maximum limit for absolute control factor of lambda control" VALUE 0x805791B4 RB_Val_Wu16 1.999969 fak_uw_b2 0.00 1.999969 FORMAT "%8.6" /end CHARACTERISTIC
/begin CHARACTERISTIC FRMIN "Minimum limit for absolute control factor of lambda control" VALUE 0x805791B6 RB_Val_Wu16 1.999969 fak_uw_b2 0.00 1.999969 FORMAT "%8.6" /end CHARACTERISTIC
/begin CHARACTERISTIC FRMINKH "Lean limit of lambda controller in case of catalyst heating with secondary air" VALUE 0x805791B8 RB_Val_Wu16 1.999969 fak_uw_b2 0.00 1.999969 FORMAT "%8.6" /end CHARACTERISTIC
/begin CHARACTERISTIC FVLRARESS "threshold for indication of an error suspicion in LRA( Lambda closed loop control; Adaptive pilot control), after reset of adaptation values" VALUE 0x80578FD8 RB_Val_Wu16 1.999969 fak_uw_b2 0.00 1.999969 FORMAT "%8.6" /end CHARACTERISTIC
/begin CHARACTERISTIC FVLRAS "threshold for indication of an error suspicion in LRA(Lambda closed loop control; Adaptive pilot control)" VALUE 0x80578FDA RB_Val_Wu16 1.999969 fak_uw_b2 0.00 1.999969 FORMAT "%8.6" /end CHARACTERISTIC
/begin CHARACTERISTIC IMLEVABS "Threshold air mass integral before lambda control enable after cylinder cut-off" VALUE 0x80579402 RB_Val_Wu16 4660.267 m_uw_b4660 0.00 4660.267 FORMAT "%8.3" /end CHARACTERISTIC
/begin CHARACTERISTIC IMLRAAEIN "air mass threshold for forced activation of fuel mixture adaptation" VALUE 0x805790E4 RB_Val_Wu16 116.5067 m_q1p7778Em3_kg 0.00 116.5067 FORMAT "%8.4" /end CHARACTERISTIC
/begin CHARACTERISTIC IMLSALR "Threshold for air mass integral before lambda control is enabled after fuel cut-off" VALUE 0x80579404 RB_Val_Wu16 4660.267 m_uw_b4660 0.00 4660.267 FORMAT "%8.3" /end CHARACTERISTIC
/begin CHARACTERISTIC IMTEFVDFRM "minimum canister purge mass for error suspicion via dfrm_w(deviation of fast lambda controller mean value from 1.0)" VALUE 0x80578FDC RB_Val_Wu8 11.32 m_ub_q0p0444 0.00 11.32 FORMAT "%5.2" /end CHARACTERISTIC
/begin CHARACTERISTIC INITFRA "Initialization value of FRA(multiplicative mixture adaptation factor)" VALUE 0x80578FDE RB_Val_Wu16 1.999969 fak_uw_b2 0.00 1.999969 FORMAT "%8.6" /end CHARACTERISTIC
/begin CHARACTERISTIC INITORA "Initialization value of ORA(additive correction of mixture adaptation)" VALUE 0x80578FE0 RB_Val_Ws16 3071.953 rel_sw_b1536 -1536.000 1535.953 FORMAT "%8.3" /end CHARACTERISTIC
/begin CHARACTERISTIC KFETAVFZG "Interpolation factor lower base point depending on vehicle speed/accelerator pedal angle" MAP 0x805799CC RB_Map_S16S16_U8 0.9961 fak_ub_b1 0.00 0.9961
 /begin AXIS_DESCR STD_AXIS VehV_v Vel 4 -327.6800 327.6700 FORMAT "%8.4" DEPOSIT ABSOLUTE /end AXIS_DESCR
 /begin AXIS_DESCR STD_AXIS APP_r Prc 4 -400.0000 399.9878 FORMAT "%8.4" DEPOSIT ABSOLUTE /end AXIS_DESCR
/end CHARACTERISTIC
/begin CHARACTERISTIC KFLRSSIG "Map of controller gain sigma for continuous lambda control" MAP 0x805791BA RB_MapGroup_U8 2.550 fak_q0p01 0.00 2.550 FORMAT "%5.3"
 /begin AXIS_DESCR COM_AXIS LamCtrl_nEngESPLANT nmot_uw_q0p25 7 0.00 16383.75 FORMAT "%8.2" AXIS_PTS_REF SNM07LSUW /end AXIS_DESCR
 /begin AXIS_DESCR COM_AXIS LamCtrl_ratFillgPlaPrm rel_uw_q0p0234 8 0.00 1535.977 FORMAT "%8.3" AXIS_PTS_REF SRL08LSUW /end AXIS_DESCR
/end CHARACTERISTIC
/begin CHARACTERISTIC KFMIOP "map optimum engine torque" MAP 0x80579514 RB_Map_U16U16_U16 99.99847 rel_uw_b100 0.00 99.99847 FORMAT "%8.5"
 /begin AXIS_DESCR STD_AXIS NO_INPUT_QUANTITY nmot_uw_q0p25 16 0.00 16383.75 FORMAT "%8.2" DEPOSIT ABSOLUTE /end AXIS_DESCR
 /begin AXIS_DESCR STD_AXIS NO_INPUT_QUANTITY rel_uw_q0p0234 14 0.00 1535.977 FORMAT "%8.3" DEPOSIT ABSOLUTE /end AXIS_DESCR
/end CHARACTERISTIC
/begin CHARACTERISTIC KFMIRL "map for calculation of nominal charge" MAP 0x80579714 RB_Map_U16U16_U16 1535.977 rel_uw_q0p0234 0.00 1535.977 FORMAT "%8.3"
 /begin AXIS_DESCR STD_AXIS NO_INPUT_QUANTITY nmot_uw_q0p25 16 0.00 16383.75 FORMAT "%8.2" DEPOSIT ABSOLUTE /end AXIS_DESCR
 /begin AXIS_DESCR STD_AXIS NO_INPUT_QUANTITY rel_uw_b100 14 0.00 99.99847 FORMAT "%8.5" DEPOSIT ABSOLUTE /end AXIS_DESCR
/end CHARACTERISTIC
/begin CHARACTERISTIC KFRKANMIL "Characteristic map to calculate the moment - engine speed dependent weighting factor of ora_w(Additive correction of mixture adaptation)" MAP 0x80578FE2 RB_Map_U8U16_U16 1.999969 fak_uw_b2 0.00 1.999969 FORMAT "%8.6"
 /begin AXIS_DESCR STD_AXIS FlMA_nEng nmot_ub_q40 6 0.00 10200. FORMAT "%5.0" DEPOSIT ABSOLUTE /end AXIS_DESCR
 /begin AXIS_DESCR STD_AXIS milsol_w_msg rel_uw_b100 6 0.00 99.99847 FORMAT "%8.5" DEPOSIT ABSOLUTE /end AXIS_DESCR
/end CHARACTERISTIC
/begin CHARACTERISTIC KFTETAMIMN "filter time constant for computation of min. indicated torque (lower base)" MAP 0x805799F0 RB_Map_U16U16_U16 655.3400 t_q0p01 0.0100 655.3500 FORMAT "%8.4" EXTENDED_LIMITS 0.00 655.3500
 /begin AXIS_DESCR STD_AXIS TME_nAvrgEngSpdLoc EngN 5 0.00 16383.50 FORMAT "%8.2" EXTENDED_LIMITS 0.00 32767.50 DEPOSIT ABSOLUTE /end AXIS_DESCR
 /begin AXIS_DESCR STD_AXIS drlmn_w rel_uw_q0p0234 5 0.00 1535.977 FORMAT "%8.3" DEPOSIT ABSOLUTE /end AXIS_DESCR
/end CHARACTERISTIC
/begin CHARACTERISTIC KLDFRKFRAK "Integration speed of integrator FRA_IK(Multiplicative correction of mixture adaptation integrator) depending on absolute value of corrected deviation of the fast lambda controller mean value (dfrmk_w)" CURVE 0x8057903E RB_Curve_U16_U16 4.999924 q7p63Em5_DIV_s 0.00 4.999924 FORMAT "%8.6"
 /begin AXIS_DESCR STD_AXIS dfrmkb_w fak_uw_b2 6 0.00 1.999969 FORMAT "%8.6" DEPOSIT ABSOLUTE /end AXIS_DESCR
/end CHARACTERISTIC
/begin CHARACTERISTIC KLDFRKORAK "Integration speed of integrator ORA_IK(Additive correction of mixture adaptation integrator) depending on absolute value of corrected deviation of the fast lambda controller mean value (dfrmk_w)" CURVE 0x80579058 RB_Curve_U16_U16 3839.941 q0p0586_pc_DIV_s 0.00 3839.941 FORMAT "%8.3"
 /begin AXIS_DESCR STD_AXIS dfrmkb_w fak_uw_b2 6 0.00 1.999969 FORMAT "%8.6" DEPOSIT ABSOLUTE /end AXIS_DESCR
/end CHARACTERISTIC
/begin CHARACTERISTIC KLDLAHSP "Characteristic curve of lambda setpoint shift depending on twin injection in homogeneous split operation" CURVE 0x805791F2 RB_Curve_U8_S8_Static 0.06226 fak_sb_b0p03125 -0.03125 0.03101 FORMAT "%7.5"
 /begin AXIS_DESCR STD_AXIS LamCtrl_facSpltCmprn fak_ub_b1 4 0.00 0.9961 DEPOSIT ABSOLUTE /end AXIS_DESCR
/end CHARACTERISTIC
/begin CHARACTERISTIC KLETADRLMN "Interpolation factor for minimum ignition angle eta" CURVE 0x80579A3A RB_Curve_U16_U8_Static 0.9961 fak_ub_b1 0.00 0.9961
 /begin AXIS_DESCR STD_AXIS drlmn_w rel_uw_q0p0234 6 0.00 1535.977 FORMAT "%8.3" DEPOSIT ABSOLUTE /end AXIS_DESCR
/end CHARACTERISTIC
/begin CHARACTERISTIC KLETAMN "minimum ignition angle effectiveness at minimun air charge" CURVE 0x80579A4E RB_Curve_S16_U16_Static 1.000000 fak_uw_b2 0.00 1.000000 FORMAT "%8.6" EXTENDED_LIMITS 0.00 1.999969
 /begin AXIS_DESCR STD_AXIS Epm_nEng EngN 6 -16384.00 16383.50 FORMAT "%8.2" DEPOSIT ABSOLUTE /end AXIS_DESCR
/end CHARACTERISTIC
/begin CHARACTERISTIC KLETAMNLL "minimum ignition angle effectiveness at minimun air charge" CURVE 0x80579A68 RB_Curve_S16_U16_Static 1.000000 fak_uw_b2 0.00 1.000000 FORMAT "%8.6" EXTENDED_LIMITS 0.00 1.999969
 /begin AXIS_DESCR STD_AXIS Epm_nEng EngN 6 -16384.00 16383.50 FORMAT "%8.2" DEPOSIT ABSOLUTE /end AXIS_DESCR
/end CHARACTERISTIC
/begin CHARACTERISTIC KLETAVGMN "Lookup table minimum defined efficiency" CURVE 0x80579922 RB_Curve_U16_U16 1.000000 fak_uw_b2 0.00 1.000000 FORMAT "%8.6" EXTENDED_LIMITS 0.00 1.999969
 /begin AXIS_DESCR STD_AXIS NO_INPUT_QUANTITY nmot_uw_q0p25 16 0.00 16383.75 FORMAT "%8.2" DEPOSIT ABSOLUTE /end AXIS_DESCR
/end CHARACTERISTIC
/begin CHARACTERISTIC KLFRAMILH "Upper limit area for fra(multiplicative mixture adaptation factor)" CURVE 0x805790E6 RB_Curve_U8_U16_Static 99.99847 rel_uw_b100 0.00 99.99847 FORMAT "%8.5"
 /begin AXIS_DESCR STD_AXIS FlMA_nEngLRes nmot_ub_q40 4 0.00 10200. FORMAT "%5.0" DEPOSIT ABSOLUTE /end AXIS_DESCR
/end CHARACTERISTIC
/begin CHARACTERISTIC KLFRAMILHY "Lower limit of the hysteresis range for fra(multiplicative mixture adaptation factor)" CURVE 0x805790F4 RB_Curve_U8_U16_Static 99.99847 rel_uw_b100 0.00 99.99847 FORMAT "%8.5"
 /begin AXIS_DESCR STD_AXIS FlMA_nEngLRes nmot_ub_q40 4 0.00 10200. FORMAT "%5.0" DEPOSIT ABSOLUTE /end AXIS_DESCR
/end CHARACTERISTIC
/begin CHARACTERISTIC KLFRAMILL "Lower limit area for fra(multiplicative mixture adaptation factor)" CURVE 0x80579102 RB_Curve_U8_U16_Static 99.99847 rel_uw_b100 0.00 99.99847 FORMAT "%8.5"
 /begin AXIS_DESCR STD_AXIS FlMA_nEngLRes nmot_ub_q40 4 0.00 10200. FORMAT "%5.0" DEPOSIT ABSOLUTE /end AXIS_DESCR
/end CHARACTERISTIC
/begin CHARACTERISTIC KLFRKANMOT "Characteristic curve to determine the weighing factor based on engine speed for rka_w(additive adaptive correction of the relative fuel amount) calculation." CURVE 0x80579072 RB_Curve_U8_U16_Static 1.999969 fak_uw_b2 0.00 1.999969 FORMAT "%8.6"
 /begin AXIS_DESCR STD_AXIS FlMA_nEng nmot_ub_q40 8 0.00 10200. FORMAT "%5.0" DEPOSIT ABSOLUTE /end AXIS_DESCR
/end CHARACTERISTIC
/begin CHARACTERISTIC KLLRUW "debouncing anti windup" CURVE 0x805791FC RB_Curve_U16_U16 655.3500 t_q0p01 0.00 655.3500 FORMAT "%8.4"
 /begin AXIS_DESCR STD_AXIS LamCtrl_mfExhB1 m_uw_b6553p5 2 0.00 6553.500 FORMAT "%8.3" DEPOSIT ABSOLUTE /end AXIS_DESCR
/end CHARACTERISTIC
/begin CHARACTERISTIC KLMILFFRAK "factor for reducing speed of learning of multiplicative mixture adaptation factor (fra), depending on gradient of coordinated torque request for charge (milsol_w)" CURVE 0x8057908C RB_Curve_U16_U8_Static 0.9921875 fak_ub_b2 0.007813 1.000000 FORMAT "%8.6" EXTENDED_LIMITS 0.00 1.992188
 /begin AXIS_DESCR STD_AXIS milsolg_w rel_uw_b100 4 0.00 99.99847 FORMAT "%8.5" DEPOSIT ABSOLUTE /end AXIS_DESCR
/end CHARACTERISTIC
/begin CHARACTERISTIC KLMILFORAK "factor for reducing speed of learning of additive correction of the mixture adaptation(ora), depending on gradient of coordinated torque request for charge (milsol_w)" CURVE 0x8057909A RB_Curve_U16_U8_Static 0.9921875 fak_ub_b2 0.007813 1.000000 FORMAT "%8.6" EXTENDED_LIMITS 0.00 1.992188
 /begin AXIS_DESCR STD_AXIS milsolg_w rel_uw_b100 4 0.00 99.99847 FORMAT "%8.5" DEPOSIT ABSOLUTE /end AXIS_DESCR
/end CHARACTERISTIC
/begin CHARACTERISTIC KLMRKFHO "Correctionb factor altitude depending torque reserve" CURVE 0x80579A84 RB_Curve_U16_U8_Static 15.94 fak_ub_b16 0.00 15.94 FORMAT "%5.2"
 /begin AXIS_DESCR STD_AXIS PEnv_facCorrAlti fak_uw_b4 3 0.00 3.999939 FORMAT "%8.6" DEPOSIT ABSOLUTE /end AXIS_DESCR
/end CHARACTERISTIC
/begin CHARACTERISTIC KLNMOFFRAK "Factor to reduce the Integration speed of integrator for multiplicative mixture adaptation factor (FRA), depending on the gradient of engine speed (nmot)" CURVE 0x805790A8 RB_Curve_U8_U8 0.9921875 fak_ub_b2 0.007813 1.000000 FORMAT "%8.6" EXTENDED_LIMITS 0.00 1.992188
 /begin AXIS_DESCR STD_AXIS nmotg nmot_ub_q40 4 0.00 10200. FORMAT "%5.0" DEPOSIT ABSOLUTE /end AXIS_DESCR
/end CHARACTERISTIC
/begin CHARACTERISTIC KLNMOFORAK "Factor to reduce the Integration speed of integrator for additive correction of the mixture adaptation(ORA), depending on the gradient of the engine speed (nmot)" CURVE 0x805790B1 RB_Curve_U8_U8 0.9921875 fak_ub_b2 0.007813 1.000000 FORMAT "%8.6" EXTENDED_LIMITS 0.00 1.992188
 /begin AXIS_DESCR STD_AXIS nmotg nmot_ub_q40 4 0.00 10200. FORMAT "%5.0" DEPOSIT ABSOLUTE /end AXIS_DESCR
/end CHARACTERISTIC
/begin CHARACTERISTIC KLORAMILH "Upper limit area for ora(additive correction of mixture adaptation)" CURVE 0x80579110 RB_Curve_U8_U16_Static 99.99847 rel_uw_b100 0.00 99.99847 FORMAT "%8.5"
 /begin AXIS_DESCR STD_AXIS FlMA_nEngLRes nmot_ub_q40 4 0.00 10200. FORMAT "%5.0" DEPOSIT ABSOLUTE /end AXIS_DESCR
/end CHARACTERISTIC
/begin CHARACTERISTIC KLORAMILHF "Upper limit area for ora(additive correction of mixture adaptation) in case of error suspicion for Pressure sensor offset." CURVE 0x8057911E RB_Curve_U8_U16_Static 99.99847 rel_uw_b100 0.00 99.99847 FORMAT "%8.5"
 /begin AXIS_DESCR STD_AXIS FlMA_nEngLRes nmot_ub_q40 4 0.00 10200. FORMAT "%5.0" DEPOSIT ABSOLUTE /end AXIS_DESCR
/end CHARACTERISTIC
/begin CHARACTERISTIC KLORAMILL "Lower limit area for ora(additive correction of mixture adaptation)" CURVE 0x8057912C RB_Curve_U8_U16_Static 99.99847 rel_uw_b100 0.00 99.99847 FORMAT "%8.5"
 /begin AXIS_DESCR STD_AXIS FlMA_nEngLRes nmot_ub_q40 4 0.00 10200. FORMAT "%5.0" DEPOSIT ABSOLUTE /end AXIS_DESCR
/end CHARACTERISTIC
/begin CHARACTERISTIC KLREDNMX "maximum reduction step for sequential fuel cutoff (depending on gear), engine speed limitation" CURVE 0x80579969 RB_FixCurve_S8_S8 24.00 dez 0.00 24.00 FORMAT "%5.2" EXTENDED_LIMITS -128.0 127.0
 /begin AXIS_DESCR FIX_AXIS Tra_numGear OneToOne 11 -1.000 9.000 FORMAT "%5.3" FIX_AXIS_PAR -1 0 11 /end AXIS_DESCR
/end CHARACTERISTIC
/begin CHARACTERISTIC KLTMRAA "cut-in temperature adaptive precontrol for lambda closed-loop control" CURVE 0x8057913A RB_Curve_U8_U8 191.3 temp_ub_q0p75_o48 -48.0 143.3 FORMAT "%5.1"
 /begin AXIS_DESCR STD_AXIS FlMA_tCEngDsStrt temp_ub_q0p75_o48 8 -48.0 143.3 FORMAT "%5.1" DEPOSIT ABSOLUTE /end AXIS_DESCR
/end CHARACTERISTIC
/begin CHARACTERISTIC KLTONLRALAF "Characteristic line for delay time of fuel mixture adaptation after lambda out of range (rich)" CURVE 0x8057914C RB_Curve_U16_U16 13107.00 t_q0p2 0.00 13107.00 FORMAT "%8.2"
 /begin AXIS_DESCR STD_AXIS lamtmef_w t_q0p2 3 0.00 13107.00 FORMAT "%8.2" DEPOSIT ABSOLUTE /end AXIS_DESCR
/end CHARACTERISTIC
/begin CHARACTERISTIC KLTONLRALAM "Characteristic line for delay time of fuel mixture adaptation after lambda out of range (lean)" CURVE 0x8057915A RB_Curve_U16_U16 13107.00 t_q0p2 0.00 13107.00 FORMAT "%8.2"
 /begin AXIS_DESCR STD_AXIS lamtmem_w t_q0p2 3 0.00 13107.00 FORMAT "%8.2" DEPOSIT ABSOLUTE /end AXIS_DESCR
/end CHARACTERISTIC
/begin CHARACTERISTIC KLTURAA "cut-in temperature depending on ambient air temperature" CURVE 0x80579168 RB_Curve_U8_U8 191.3 temp_ub_q0p75_o48 -48.0 143.3 FORMAT "%5.1"
 /begin AXIS_DESCR STD_AXIS FlMA_tEnv temp_ub_q0p75_o48 4 -48.0 143.3 FORMAT "%5.1" DEPOSIT ABSOLUTE /end AXIS_DESCR
/end CHARACTERISTIC
/begin CHARACTERISTIC KWTFRAMX "Start value: active Phase FRA" VALUE 0x80579192 RB_Val_Wu16 13107.00 t_q0p2 0.00 13107.00 FORMAT "%8.2" /end CHARACTERISTIC
/begin CHARACTERISTIC KWTORAMX "Start value: active Phase ORA" VALUE 0x80579194 RB_Val_Wu16 13107.00 t_q0p2 0.00 13107.00 FORMAT "%8.2" /end CHARACTERISTIC
/begin CHARACTERISTIC KWTPFRAMX "Start value: pause phase FRA" VALUE 0x80579196 RB_Val_Wu16 13107.00 t_q0p2 0.00 13107.00 FORMAT "%8.2" /end CHARACTERISTIC
/begin CHARACTERISTIC KWTPORAMX "Start value: pause phase ORA" VALUE 0x80579198 RB_Val_Wu16 13107.00 t_q0p2 0.00 13107.00 FORMAT "%8.2" /end CHARACTERISTIC
/begin CHARACTERISTIC LADIFFTHR "Threshold of absolute lambda difference for reset of lambda control due to enleanment protection" VALUE 0x80579206 RB_Val_Wu16 1.999969 fak_uw_b2 0.00 1.999969 FORMAT "%8.6" /end CHARACTERISTIC
/begin CHARACTERISTIC LALIUSMN "minimum measurable lambda" VALUE 0x80579208 RB_Val_Wu16 15.99976 fak_uw_b16 0.00 15.99976 FORMAT "%8.5" /end CHARACTERISTIC
/begin CHARACTERISTIC LamCL_tiDlyEnagFuOffFfv_C "Delay for forced enabling of lambda control after fuel cut-off and increased evaporation in flex-fuel vehicle" VALUE 0x80579406 RB_Val_Wu16 6553.500 t_q0p1 0.00 6553.500 FORMAT "%8.3" /end CHARACTERISTIC
/begin CHARACTERISTIC LamCtrl_dfacCtrlDeltaLimCtrl_C "Slope to ramp down control factor of lambda control during limit control (i.e. physical lambda value and lambda setpoint are smaller than the minimal measurable lambda value)" VALUE 0x8057920A RB_Val_Ws16 0.9999695 freq_q3p0518Em5 0.00 0.9999695 FORMAT "%9.7" EXTENDED_LIMITS -1.000000 0.9999695 /end CHARACTERISTIC
/begin CHARACTERISTIC LamCtrl_facAirEnaWrmUpEthnl_T "correction factor for air mass threshold to enable controller during warm-up depending on ethanol content in fuel" CURVE 0x80579408 RB_Curve_U16_U16 15.99976 fak_uw_b16 0.00 15.99976 FORMAT "%8.5"
 /begin AXIS_DESCR STD_AXIS FfPrm_facEth fak_uw_b2 4 0.00 1.999969 FORMAT "%8.6" DEPOSIT ABSOLUTE /end AXIS_DESCR
/end CHARACTERISTIC
/begin CHARACTERISTIC LamCtrl_facCtrlDeltaMaxEnlnmtProtB1_T "Maximum limit for delta control factor of lambda control during enleanment protection depending on current delta control factor, bank 1" CURVE 0x8057920C RB_Curve_S16_S16 1.999969 fak_sw_b1 -1.000000 0.999969 FORMAT "%8.6" EXTENDED_LIMITS -1.000000 0.9999695
 /begin AXIS_DESCR STD_AXIS LamCtrl_facCtrlDeltaEnlnmtProtB1 fak_sw_b1 7 -1.000000 0.999969 FORMAT "%8.6" EXTENDED_LIMITS -1.000000 0.9999695 DEPOSIT ABSOLUTE /end AXIS_DESCR
/end CHARACTERISTIC
/begin CHARACTERISTIC LamCtrl_facCtrlDeltaMinEnlnmtProtB1_T "Minimum limit for delta control factor of lambda control during enleanment protection depending on current delta control factor, bank 1" CURVE 0x8057922A RB_Curve_S16_S16 1.999969 fak_sw_b1 -1.000000 0.999969 FORMAT "%8.6" EXTENDED_LIMITS -1.000000 0.9999695
 /begin AXIS_DESCR STD_AXIS LamCtrl_facCtrlDeltaEnlnmtProtB1 fak_sw_b1 7 -1.000000 0.999969 FORMAT "%8.6" EXTENDED_LIMITS -1.000000 0.9999695 DEPOSIT ABSOLUTE /end AXIS_DESCR
/end CHARACTERISTIC
/begin CHARACTERISTIC LamCtrl_facMaxLimFfv_T "upper bound for control action(flex fuel)" CURVE 0x80579248 RB_Curve_U8_S16_Static 1.999969 fak_sw_b1 -1.000000 0.999969 FORMAT "%8.6" EXTENDED_LIMITS -1.000000 0.9999695
 /begin AXIS_DESCR STD_AXIS LamCtrl_tCEngDs temp_ub_q0p75_o48 6 -48.0 143.3 FORMAT "%5.1" DEPOSIT ABSOLUTE /end AXIS_DESCR
/end CHARACTERISTIC
/begin CHARACTERISTIC LamCtrl_facMinLim_M "Minimum limit for absolute control factor of lambda control" MAP 0x8057925C RB_Map_U8U16_U16 1.999969 fak_uw_b2 0.00 1.999969 FORMAT "%8.6"
 /begin AXIS_DESCR STD_AXIS LamCtrl_tCEngDs temp_ub_q0p75_o48 5 -48.0 143.3 FORMAT "%5.1" DEPOSIT ABSOLUTE /end AXIS_DESCR
 /begin AXIS_DESCR STD_AXIS LamCtrl_tiAftStrtEnd t_q0p01 4 0.00 655.3500 FORMAT "%8.4" DEPOSIT ABSOLUTE /end AXIS_DESCR
/end CHARACTERISTIC
/begin CHARACTERISTIC LamCtrl_facSigmaIdleCtrlB1_M "Robustness factor sigma during active idle speed governor, bank 1" MAP 0x80579294 RB_Map_U8U16_U8 2.550 fak_q0p01 0.00 2.550 FORMAT "%5.3"
 /begin AXIS_DESCR STD_AXIS LamCtrl_nEngLResLRS nmot_ub_q40 4 0.00 10200. FORMAT "%5.0" DEPOSIT ABSOLUTE /end AXIS_DESCR
 /begin AXIS_DESCR STD_AXIS LamCtrl_ratFillgLRS rel_uw_q0p0234 4 0.00 1535.977 FORMAT "%8.3" DEPOSIT ABSOLUTE /end AXIS_DESCR
/end CHARACTERISTIC
/begin CHARACTERISTIC LamCtrl_facVCtrlDif_T "Factor for controller velocity dependent on control difference" CURVE 0x805792B2 RB_Curve_S16_U8_Static 1.992188 fak_ub_b2 0.00 1.992188 FORMAT "%8.6"
 /begin AXIS_DESCR STD_AXIS LamCtrl_ratLamDifPrelB1 fak_sw_b1 5 -1.000000 0.999969 FORMAT "%8.6" EXTENDED_LIMITS -1.000000 0.9999695 DEPOSIT ABSOLUTE /end AXIS_DESCR
/end CHARACTERISTIC
/begin CHARACTERISTIC LamCtrl_facVDlyAdpn_T "Factor for lambda controller velocity at adapted delay time dependent on delay time ratio" CURVE 0x805792C4 RB_Curve_U16_U8_Static 1.992188 fak_ub_b2 0.00 1.992188 FORMAT "%8.6"
 /begin AXIS_DESCR STD_AXIS LamCtrl_ratDlyTiB1 t_q0p01 4 0.00 655.3500 FORMAT "%8.4" DEPOSIT ABSOLUTE /end AXIS_DESCR
/end CHARACTERISTIC
/begin CHARACTERISTIC LamCtrl_facVTranAdpn_C "Factor for lambda controller velocity at adapted transition time" VALUE 0x805792D2 RB_Val_Wu8 1.992188 fak_ub_b2 0.00 1.992188 FORMAT "%8.6" /end CHARACTERISTIC
/begin CHARACTERISTIC LamCtrl_facVTranAdpn_T "Factor for lambda controller velocity at adapted transition time dependent on transition time ratio" CURVE 0x805792D4 RB_Curve_U16_U8_Static 1.992188 fak_ub_b2 0.00 1.992188 FORMAT "%8.6"
 /begin AXIS_DESCR STD_AXIS LamCtrl_ratTranTiB1 t_q0p01 4 0.00 655.3500 FORMAT "%8.4" DEPOSIT ABSOLUTE /end AXIS_DESCR
/end CHARACTERISTIC
/begin CHARACTERISTIC LamCtrl_flgEnaWrmUpAirM_CW "Code bit to activate air mass based controller enabling during warm-up" VALUE 0x8057941A RB_Val_Wu8 1.00000000000 B_TRUE 0.00 1.00000000000 FORMAT "%13.11" /end CHARACTERISTIC
/begin CHARACTERISTIC LamCtrl_mAirEnaWrmUpHotStrt_C "Air mass threshold to enable controller during warm-up at hot start" VALUE 0x8057941C RB_Val_Wu16 1820.417 m_q0p0277_g 0.00 1820.417 FORMAT "%8.3" /end CHARACTERISTIC
/begin CHARACTERISTIC LamCtrl_mAirEnaWrmUpSpst_T "Air mass threshold to enable controller during warm-up after start-stop" CURVE 0x8057941E RB_Curve_U8_U16_Static 1820.417 m_q0p0277_g 0.00 1820.417 FORMAT "%8.3"
 /begin AXIS_DESCR STD_AXIS LamCtrl_tEngStrtWrmUp temp_ub_q0p75_o48 5 -48.0 143.3 FORMAT "%5.1" DEPOSIT ABSOLUTE /end AXIS_DESCR
/end CHARACTERISTIC
/begin CHARACTERISTIC LamCtrl_mAirEnaWrmUp_T "Air mass threshold to enable controller during warm-up" CURVE 0x8057942E RB_Curve_U8_U16_Static 1820.417 m_q0p0277_g 0.00 1820.417 FORMAT "%8.3"
 /begin AXIS_DESCR STD_AXIS LamCtrl_tEngStrtWrmUp temp_ub_q0p75_o48 5 -48.0 143.3 FORMAT "%5.1" DEPOSIT ABSOLUTE /end AXIS_DESCR
/end CHARACTERISTIC
/begin CHARACTERISTIC LamCtrl_ratLamSpCorrnB1_M "Correction of the lambda setpoint for the continuous lambda controller" MAP 0x805792E2 RB_Map_U8U16_S8 0.06226 fak_sb_b0p03125 -0.03125 0.03101 FORMAT "%7.5"
 /begin AXIS_DESCR STD_AXIS LamCtrl_nEngLResLRS nmot_ub_q40 10 0.00 10200. FORMAT "%5.0" DEPOSIT ABSOLUTE /end AXIS_DESCR
 /begin AXIS_DESCR STD_AXIS LamCtrl_ratFillgLRS rel_uw_q0p0234 10 0.00 1535.977 FORMAT "%8.3" DEPOSIT ABSOLUTE /end AXIS_DESCR
/end CHARACTERISTIC
/begin CHARACTERISTIC LamCtrl_ratLamSpCorrnFfvB1_M "Correction of the lambda setpoint for the continuous lambda controller(flex fuel)" MAP 0x80579366 RB_Map_U8U16_S8 0.06226 fak_sb_b0p03125 -0.03125 0.03101 FORMAT "%7.5"
 /begin AXIS_DESCR STD_AXIS LamCtrl_nEngLResLRS nmot_ub_q40 10 0.00 10200. FORMAT "%5.0" DEPOSIT ABSOLUTE /end AXIS_DESCR
 /begin AXIS_DESCR STD_AXIS LamCtrl_ratFillgLRS rel_uw_q0p0234 10 0.00 1535.977 FORMAT "%8.3" DEPOSIT ABSOLUTE /end AXIS_DESCR
/end CHARACTERISTIC
/begin CHARACTERISTIC LamCtrl_tiAEnchmtFfv_M "blocking time for activation LC after acceleration enrichment(for FFV)" MAP 0x8057943E RB_Map_U8U16_U16 655.3500 t_q0p01 0.00 655.3500 FORMAT "%8.4"
 /begin AXIS_DESCR STD_AXIS LamCtrl_tEngEnlnmt temp_ub_q0p75_o48 8 -48.0 143.3 FORMAT "%5.1" DEPOSIT ABSOLUTE /end AXIS_DESCR
 /begin AXIS_DESCR STD_AXIS FfPrm_facEth fak_uw_b2 4 0.00 1.999969 FORMAT "%8.6" DEPOSIT ABSOLUTE /end AXIS_DESCR
/end CHARACTERISTIC
/begin CHARACTERISTIC LamCtrl_tiDecelEnlnmtFfv_M "blocking time for activation LC after deceleration enleanment(for FFV)" MAP 0x80579490 RB_Map_U8U16_U16 655.3500 t_q0p01 0.00 655.3500 FORMAT "%8.4"
 /begin AXIS_DESCR STD_AXIS LamCtrl_tEngEnlnmt temp_ub_q0p75_o48 8 -48.0 143.3 FORMAT "%5.1" DEPOSIT ABSOLUTE /end AXIS_DESCR
 /begin AXIS_DESCR STD_AXIS FfPrm_facEth fak_uw_b2 4 0.00 1.999969 FORMAT "%8.6" DEPOSIT ABSOLUTE /end AXIS_DESCR
/end CHARACTERISTIC
/begin CHARACTERISTIC LamCtrl_tiDlyEnagPlaFco_C "Additional delay time (additive) to plant parameters to enable closed-loop control after fuel cut-off" VALUE 0x805794E2 RB_Val_Wu16 6553.500 t_q0p1 0.00 6553.500 FORMAT "%8.3" /end CHARACTERISTIC
/begin CHARACTERISTIC LamCtrl_tiEnlnmtProtLrgVlvLft_C "Switch-on time of enleament protection after switching to large valve lift" VALUE 0x805794E4 RB_Val_Wu16 655.3500 t_q0p01 0.00 655.3500 FORMAT "%8.4" /end CHARACTERISTIC
/begin CHARACTERISTIC LamCtrl_tiEnlnmtProtSmlVlvLft_C "Switch-on time of enleanment protection after switching to small valve lift" VALUE 0x805794E6 RB_Val_Wu16 655.3500 t_q0p01 0.00 655.3500 FORMAT "%8.4" /end CHARACTERISTIC
/begin CHARACTERISTIC LamCtrl_tiRampDe_T "curve for ramp up time for control deviation after turn on" CURVE 0x805793EA RB_Curve_U16_U16 655.3400 t_q0p01 0.0100 655.3500 FORMAT "%8.4" EXTENDED_LIMITS 0.00 655.3500
 /begin AXIS_DESCR STD_AXIS LamCtrl_tiAdpnMaxS1B1 t_q0p01 4 0.00 655.3500 FORMAT "%8.4" DEPOSIT ABSOLUTE /end AXIS_DESCR
/end CHARACTERISTIC
/begin CHARACTERISTIC LamCtrl_tiTurnOnStratHom_C "Turn-on delay for enabling lambda control at transition from stratified to homogeneous mode" VALUE 0x805794E8 RB_Val_Wu16 655.3500 t_q0p01 0.00 655.3500 FORMAT "%8.4" /end CHARACTERISTIC
/begin CHARACTERISTIC LAMGAFVMN "minimum of lambda threshold (error suspicion) for mixture adaptation active" VALUE 0x80579172 RB_Val_Wu16 15.99976 fak_uw_b16 0.00 15.99976 FORMAT "%8.5" /end CHARACTERISTIC
/begin CHARACTERISTIC LAMGAMN "minimum of lambda threshold for mixture adaptation active" VALUE 0x80579174 RB_Val_Wu16 15.99976 fak_uw_b16 0.00 15.99976 FORMAT "%8.5" /end CHARACTERISTIC
/begin CHARACTERISTIC LAMGAMX "maximum of lambda threshold for mixture adaptation active" VALUE 0x80579176 RB_Val_Wu16 15.99976 fak_uw_b16 0.00 15.99976 FORMAT "%8.5" /end CHARACTERISTIC
/begin CHARACTERISTIC LLRNSTAT_nOffsIgnAgnlFix_C "Offset for ignition angle cutoff" VALUE 0x805720F6 RB_Val_Ws16 32767.50 nmot_sw_q0p5 -16384.00 16383.50 FORMAT "%8.2" /end CHARACTERISTIC
/begin CHARACTERISTIC LLRNSTAT_nThrIceAdh_M "Idle speed set-point when ice adhesion at throttle valve" MAP 0x805720F8 RB_MapGroup_S16 32767.50 nmot_sw_q0p5 -16384.00 16383.50 FORMAT "%8.2"
 /begin AXIS_DESCR COM_AXIS tmot_llrnstat_loc temp_ub_q0p75_o48 6 -48.0 143.3 FORMAT "%5.1" AXIS_PTS_REF STM06LLUB_LLRNSTAT /end AXIS_DESCR
 /begin AXIS_DESCR COM_AXIS gangsist_llrnstat_loc dez 9 -128.0 127.0 FORMAT "%5.1" AXIS_PTS_REF SGA09LLSB /end AXIS_DESCR
/end CHARACTERISTIC
/begin CHARACTERISTIC LLRNSTAT_tiPT1HvyDecel1_C "Time constant 1 for deceleration" VALUE 0x80572164 RB_Val_Wu16 1310.6999997 zk20msxs_uw_b1310 0.0200003 1310.7200000 FORMAT "%12.7" EXTENDED_LIMITS 0.020000305180 1310.7200000 /end CHARACTERISTIC
/begin CHARACTERISTIC LLRNSTAT_tiPT1HvyDecel2_C "Time constant 2 during decelaration" VALUE 0x80572166 RB_Val_Wu16 1310.6999997 zk20msxs_uw_b1310 0.0200003 1310.7200000 FORMAT "%12.7" EXTENDED_LIMITS 0.020000305180 1310.7200000 /end CHARACTERISTIC
/begin CHARACTERISTIC LsComp_bLossCmpActvd_C "State of compensation of the switchable losses (False=OFF, True=ON)" VALUE 0x80579508 RB_Val_Wu8 1.00000000000 B_TRUE 0.00 1.00000000000 FORMAT "%13.11" /end CHARACTERISTIC
/begin CHARACTERISTIC LsComp_tiFlt_C "filter time constant of the DT1-filters" VALUE 0x8057950C RB_Val_Ws32 4294.9672940000000 TimeDelay_s 0.0000020000000 4294.9672959999998 FORMAT "%19.14" EXTENDED_LIMITS 0.000002000000001 4294.9672959999998 /end CHARACTERISTIC
/begin CHARACTERISTIC MADWRKMN "lower limit rk-correction piezo HDEV" VALUE 0x80579511 RB_Val_Wu8 1.000000 fak_ub_b2 0.00 1.000000 FORMAT "%8.6" EXTENDED_LIMITS 0.00 1.992188 /end CHARACTERISTIC
/begin CHARACTERISTIC MADWRKMX "upper limit rk-correction piezo HDEV" VALUE 0x80579512 RB_Val_Wu8 0.9921875 fak_ub_b2 1.000000 1.992188 FORMAT "%8.6" EXTENDED_LIMITS 0.00 1.992188 /end CHARACTERISTIC
/begin CHARACTERISTIC MDSH "Part of the resistant torque depending on altitude" CURVE 0x80579A94 RB_Curve_U8_S16_Static 99.99847 rel_sw_b50 -50.00000 49.99847 FORMAT "%8.5"
 /begin AXIS_DESCR STD_AXIS NO_INPUT_QUANTITY fak_ub_b4 6 0.00 3.984 FORMAT "%5.3" DEPOSIT ABSOLUTE /end AXIS_DESCR
/end CHARACTERISTIC
/begin CHARACTERISTIC MDVERMOT_dtTqCrkEth_M "time constant for decay of torque offset after cranking for ethanol" MAP 0x80579AA8 RB_Map_U8U8_U16 1310.6999997 zk20msxs_uw_b1310p72 0.0200003 1310.7200000 FORMAT "%12.7" EXTENDED_LIMITS 0.020000305180 1310.7200000
 /begin AXIS_DESCR STD_AXIS tomdvermot temp_ub_q0p75_o48 8 -48.0 143.3 FORMAT "%5.1" DEPOSIT ABSOLUTE /end AXIS_DESCR
 /begin AXIS_DESCR STD_AXIS fethmnmx_msg fak_ub_b2 4 0.00 1.992188 FORMAT "%8.6" DEPOSIT ABSOLUTE /end AXIS_DESCR
/end CHARACTERISTIC
/begin CHARACTERISTIC MDVERMOT_TqCrkOffsEth_M "Torque offset for after cranking compensation" MAP 0x80579AF6 RB_Map_U8U8_U16 99.99847 rel_uw_b100 0.00 99.99847 FORMAT "%8.5"
 /begin AXIS_DESCR STD_AXIS tomdvermot temp_ub_q0p75_o48 8 -48.0 143.3 FORMAT "%5.1" DEPOSIT ABSOLUTE /end AXIS_DESCR
 /begin AXIS_DESCR STD_AXIS fethmnmx_msg fak_ub_b2 4 0.00 1.992188 FORMAT "%8.6" DEPOSIT ABSOLUTE /end AXIS_DESCR
/end CHARACTERISTIC
/begin CHARACTERISTIC MfDD_numFadeOutNip_T "non interpolating map of faded out actuations at Hot Temperature Low Speed Actuation" MAP 0x8057AB9C RB_Map_U16U16_U16 65535.00 dez 0.00 65535.00 FORMAT "%8.2"
 /begin AXIS_DESCR STD_AXIS MfDD_nEng EngN 4 0.00 32767.50 FORMAT "%8.2" DEPOSIT ABSOLUTE /end AXIS_DESCR
 /begin AXIS_DESCR STD_AXIS FuPHi_pRailSp RBPtCel_p_0p002_1 3 0.00 131.0700 FORMAT "%8.4" DEPOSIT ABSOLUTE /end AXIS_DESCR
/end CHARACTERISTIC
/begin CHARACTERISTIC MFDD_phiOTZ1OTP_CA "differential angle between OT-cylinder1 and OT-pump (master ecu)" VAL_BLK 0x8057ABC6 ValA_Ws16 360.0000 kw_q1 -180.0000 180.0000 FORMAT "%8.4" EXTENDED_LIMITS -32768.00 32767.00 NUMBER 1 /end CHARACTERISTIC
/begin CHARACTERISTIC MFDD_tTstPulse_C "pulse length for test pulses - PS diagnosis & Light Load Delivery Mode" VALUE 0x8057ABC8 Val_Wu8 12.75 txms_ub_q0p05 0.00 12.75 FORMAT "%5.2" /end CHARACTERISTIC
/begin CHARACTERISTIC N0 "conversion constant for calculation of the mixture correction rka_w(additive adaptive correction of the relative fuel amount)" VALUE 0x805790BA RB_Val_Wu8 10200. nmot_ub_q40 0.00 10200. FORMAT "%5.0" /end CHARACTERISTIC
/begin CHARACTERISTIC NFSMIN "Minimal allowed engine speed at idle with AT in drive" VALUE 0x80572168 RB_Val_Wu8 2550. nmot_ub_q10 0.00 2550. FORMAT "%5.0" /end CHARACTERISTIC
/begin CHARACTERISTIC NLLMG "desired engine speed" MAP 0x80572169 RB_MapGroup_U8 2550. nmot_ub_q10 0.00 2550. FORMAT "%5.0"
 /begin AXIS_DESCR COM_AXIS tmot_llrnstat_loc temp_ub_q0p75_o48 6 -48.0 143.3 FORMAT "%5.1" AXIS_PTS_REF STM06LLUB_LLRNSTAT /end AXIS_DESCR
 /begin AXIS_DESCR COM_AXIS gangsist_llrnstat_loc dez 9 -128.0 127.0 FORMAT "%5.1" AXIS_PTS_REF SGA09LLSB /end AXIS_DESCR
/end CHARACTERISTIC
/begin CHARACTERISTIC NLLMGFS "desired idle speed in Drive-mode" MAP 0x8057219F RB_MapGroup_U8 2550. nmot_ub_q10 0.00 2550. FORMAT "%5.0"
 /begin AXIS_DESCR COM_AXIS tmot_llrnstat_loc temp_ub_q0p75_o48 6 -48.0 143.3 FORMAT "%5.1" AXIS_PTS_REF STM06LLUB_LLRNSTAT /end AXIS_DESCR
 /begin AXIS_DESCR COM_AXIS gangsist_llrnstat_loc dez 9 -128.0 127.0 FORMAT "%5.1" AXIS_PTS_REF SGA09LLSB /end AXIS_DESCR
/end CHARACTERISTIC
/begin CHARACTERISTIC NLLMIN "Minimal allowed engine speed at idle" VALUE 0x805721D5 RB_Val_Wu8 2550. nmot_ub_q10 0.00 2550. FORMAT "%5.0" /end CHARACTERISTIC
/begin CHARACTERISTIC NOLRA "codeword for release of adaptation" VALUE 0x80579178 RB_Val_Wu8 255.0 dez 0.00 255.0 FORMAT "%5.1" /end CHARACTERISTIC
/begin CHARACTERISTIC NORAMX "upper engine speed threshold for ORA adaptation (at higher load)" VALUE 0x80579179 RB_Val_Wu8 10200. nmot_ub_q40 0.00 10200. FORMAT "%5.0" /end CHARACTERISTIC
/begin CHARACTERISTIC NRKAB "minimum engine speed limitation for rka_w(additive adaptive correction of the relative fuel amount) correction." VALUE 0x805790BB RB_Val_Wu8 10200. nmot_ub_q40 0.00 10200. FORMAT "%5.0" /end CHARACTERISTIC
/begin CHARACTERISTIC NTIPLL "speed limit for TIP-IN" VALUE 0x805721D6 RB_Val_Wu8 10200. nmot_ub_q40 0.00 10200. FORMAT "%5.0" /end CHARACTERISTIC
/begin CHARACTERISTIC ORAMN "Lower threshold for additive correction of the mixture adaptation" VALUE 0x805790BC RB_Val_Ws16 3071.953 rel_sw_b1536 -1536.000 1535.953 FORMAT "%8.3" /end CHARACTERISTIC
/begin CHARACTERISTIC ORAMX "Upper threshold for additive correction of the mixture adaptation" VALUE 0x805790BE RB_Val_Ws16 3071.953 rel_sw_b1536 -1536.000 1535.953 FORMAT "%8.3" /end CHARACTERISTIC
/begin CHARACTERISTIC ORASPV "Vehicle speed threshold to disable additive fuel mixture adaptation learning" VALUE 0x8057917A RB_Val_Wu16 511.9922 vfzg_uw_b512 0.00 511.9922 FORMAT "%8.4" /end CHARACTERISTIC
/begin CHARACTERISTIC PHUFRAHP "physical urgentcy fra high priority" VALUE 0x8057919A RB_Val_Wu8 255.0 dez 0.00 255.0 FORMAT "%5.1" /end CHARACTERISTIC
/begin CHARACTERISTIC PHUFRALP "Physical urgency fra low priority" VALUE 0x8057919B RB_Val_Wu8 255.0 dez 0.00 255.0 FORMAT "%5.1" /end CHARACTERISTIC
/begin CHARACTERISTIC PHUFRAMP "Physical urgentcy fra middle priority" VALUE 0x8057919C RB_Val_Wu8 255.0 dez 0.00 255.0 FORMAT "%5.1" /end CHARACTERISTIC
/begin CHARACTERISTIC PHUORAHP "Physical urgentcy high priority" VALUE 0x8057919D RB_Val_Wu8 255.0 dez 0.00 255.0 FORMAT "%5.1" /end CHARACTERISTIC
/begin CHARACTERISTIC PHUORALP "Physical urgentcy low priority" VALUE 0x8057919E RB_Val_Wu8 255.0 dez 0.00 255.0 FORMAT "%5.1" /end CHARACTERISTIC
/begin CHARACTERISTIC PHUORAMP "Physical urgentcy middle priority" VALUE 0x8057919F RB_Val_Wu8 255.0 dez 0.00 255.0 FORMAT "%5.1" /end CHARACTERISTIC
/begin CHARACTERISTIC REDHYOC "hysteresis of reduction step at bigger desired red. step than actual value" VALUE 0x80579974 RB_Val_Ws8 1.992 fak_sb_b1 -1.000 0.992 FORMAT "%5.3" EXTENDED_LIMITS -1.000 0.9922 /end CHARACTERISTIC
/begin CHARACTERISTIC REDHYOCESP "hysteresis of reduction step at bigger desired red. step than actual value during ESP-intervention" VALUE 0x80579975 RB_Val_Ws8 1.992 fak_sb_b1 -1.000 0.992 FORMAT "%5.3" EXTENDED_LIMITS -1.000 0.9922 /end CHARACTERISTIC
/begin CHARACTERISTIC REDHYOCGSN "hysteresis of reduction step at bigger desired red. step than actual value during gear shift" VALUE 0x80579976 RB_Val_Ws8 1.992 fak_sb_b1 -1.000 0.992 FORMAT "%5.3" EXTENDED_LIMITS -1.000 0.9922 /end CHARACTERISTIC
/begin CHARACTERISTIC REDHYUC "hysteresis of reduction step at smaller desired red. step than actual value" VALUE 0x80579977 RB_Val_Ws8 1.992 fak_sb_b1 -1.000 0.992 FORMAT "%5.3" EXTENDED_LIMITS -1.000 0.9922 /end CHARACTERISTIC
/begin CHARACTERISTIC REDHYUCESP "hysteresis of reduction step at smaller desired red. step than actual value during ESP-intervention" VALUE 0x80579978 RB_Val_Ws8 1.992 fak_sb_b1 -1.000 0.992 FORMAT "%5.3" EXTENDED_LIMITS -1.000 0.9922 /end CHARACTERISTIC
/begin CHARACTERISTIC REDHYUCGSN "hysteresis of reduction step at smaller desired red. step than actual value during gear shift" VALUE 0x80579979 RB_Val_Ws8 1.992 fak_sb_b1 -1.000 0.992 FORMAT "%5.3" EXTENDED_LIMITS -1.000 0.9922 /end CHARACTERISTIC
/begin CHARACTERISTIC REDMXGS "maximum reduction step for gear shift" VALUE 0x8057997A RB_Val_Wu8 24.00 OneToOne 0.00 24.00 FORMAT "%5.2" EXTENDED_LIMITS 0.00 255.0 /end CHARACTERISTIC
/begin CHARACTERISTIC REDZEM "threshold between ignition intervention and injector disabling" CURVE 0x8057997C RB_Curve_S16_U8_Static 24.00 dez 0.00 24.00 FORMAT "%5.2" EXTENDED_LIMITS 0.00 255.0
 /begin AXIS_DESCR STD_AXIS CEngDsT_t Temp_Cels 5 -3549.940 3003.560 FORMAT "%8.3" DEPOSIT ABSOLUTE /end AXIS_DESCR
/end CHARACTERISTIC
/begin CHARACTERISTIC REDZEMESP "threshold between ignition intervention and injector disabling, ESP-intervention" CURVE 0x8057998E RB_Curve_S16_U8_Static 24.00 dez 0.00 24.00 FORMAT "%5.2" EXTENDED_LIMITS 0.00 255.0
 /begin AXIS_DESCR STD_AXIS CEngDsT_t Temp_Cels 5 -3549.940 3003.560 FORMAT "%8.3" DEPOSIT ABSOLUTE /end AXIS_DESCR
/end CHARACTERISTIC
/begin CHARACTERISTIC REDZEMGS "threshold between ignition intervention and injector disabling, gear shift-intervention" CURVE 0x805799A0 RB_Curve_S16_U8_Static 24.00 dez 0.00 24.00 FORMAT "%5.2" EXTENDED_LIMITS 0.00 255.0
 /begin AXIS_DESCR STD_AXIS CEngDsT_t Temp_Cels 5 -3549.940 3003.560 FORMAT "%8.3" DEPOSIT ABSOLUTE /end AXIS_DESCR
/end CHARACTERISTIC
/begin CHARACTERISTIC REDZEMNL "threshold between ignition intervention and injector disabling, emergency mode" CURVE 0x805799B2 RB_Curve_S16_U8_Static 24.00 dez 0.00 24.00 FORMAT "%5.2" EXTENDED_LIMITS 0.00 255.0
 /begin AXIS_DESCR STD_AXIS CEngDsT_t Temp_Cels 5 -3549.940 3003.560 FORMAT "%8.3" DEPOSIT ABSOLUTE /end AXIS_DESCR
/end CHARACTERISTIC
/begin CHARACTERISTIC RngMod_nrStrtMod_CUR "Map to activate after start treatment depending on start mode" CURVE 0x80579B44 RB_Curve_U8_U8 1.000 OneToOne 0.00 1.000 FORMAT "%5.3" EXTENDED_LIMITS 0.00 255.0
 /begin AXIS_DESCR STD_AXIS CoPOM_numStrt OneToOne 10 0.00 255.0 FORMAT "%5.1" DEPOSIT ABSOLUTE /end AXIS_DESCR
/end CHARACTERISTIC
/begin AXIS_PTS SGA09LLSB "distribution for gear information in idle speed controller" 0x805721D7 gangsist_llrnstat_loc RB_Axis_S8 255.0 dez 9 -128.0 127.0 FORMAT "%5.1" DEPOSIT ABSOLUTE /end AXIS_PTS
/begin AXIS_PTS SNM07LSUW "Base point distribution for LRS controller parameters" 0x8054126C LamCtrl_nEngESPLANT RB_Axis_U16 16383.75 nmot_uw_q0p25 7 0.00 16383.75 FORMAT "%8.2" DEPOSIT ABSOLUTE /end AXIS_PTS
/begin AXIS_PTS SRL08LSUW "air charge set points for the controller parameters" 0x8054127C LamCtrl_ratFillgPlaPrm RB_Axis_U16 1535.977 rel_uw_q0p0234 8 0.00 1535.977 FORMAT "%8.3" DEPOSIT ABSOLUTE /end AXIS_PTS
/begin AXIS_PTS STM06LLUB_LLRNSTAT "Datapoint distribution, engine temperature, 6 datapoints" 0x805721E1 tmot_llrnstat_loc RB_Axis_U8 191.3 temp_ub_q0p75_o48 6 -48.0 143.3 FORMAT "%5.1" DEPOSIT ABSOLUTE /end AXIS_PTS
/begin CHARACTERISTIC TAKH "intake air temperature (tans) threshold for drifting of additive adaption value" VALUE 0x805790C0 RB_Val_Wu8 191.3 temp_ub_q0p75_o48 -48.0 143.3 FORMAT "%5.1" /end CHARACTERISTIC
/begin CHARACTERISTIC TARA "temperature threshold intake air" VALUE 0x8057917C RB_Val_Wu8 191.3 temp_ub_q0p75_o48 -48.0 143.3 FORMAT "%5.1" /end CHARACTERISTIC
/begin CHARACTERISTIC TASHS "threshold for intake air temperature for hot start detection" VALUE 0x805794EA RB_Val_Wu8 191.3 temp_ub_q0p75_o48 -48.0 143.3 FORMAT "%5.1" /end CHARACTERISTIC
/begin CHARACTERISTIC TDFEDSSB "Minimum debounce time needed, once the pressure sensor based filling detection is active for ORA(additive correction of mixture adaptation) switchover." VALUE 0x805790C1 RB_Val_Wu8 51.00 t_q0p2 0.00 51.00 FORMAT "%5.2" /end CHARACTERISTIC
/begin CHARACTERISTIC TDFRMKHZ "time constant for deviation of dfrm2_w(fast lambda controller mean value from 1.0 for bank 2) low pass filter" VALUE 0x805790C2 RB_Val_Wu16 13106.999997 zk200msxs_uw_b13107 0.200003 13107.200000 FORMAT "%12.6" EXTENDED_LIMITS 0.20000305180 13107.200000 /end CHARACTERISTIC
/begin CHARACTERISTIC TDFRMSTKH "Minimum debounce time needed, for dfrm2_w(deviation of fast lambda controller mean value from 1.0 for bank2) low pass filter to be less than a threshold, as a stable criteria for adaptation" VALUE 0x805790C4 RB_Val_Wu8 51.00 t_q0p2 0.00 51.00 FORMAT "%5.2" /end CHARACTERISTIC
/begin CHARACTERISTIC TDMILFRALT "LP timeconstant for filtering the FRA adaptation point" VALUE 0x8057917E RB_Val_Wu16 13106.80 t_q0p2 0.20 13107.00 FORMAT "%8.2" EXTENDED_LIMITS 0.00 13107.00 /end CHARACTERISTIC
/begin CHARACTERISTIC TDMILORALT "LP timeconstant for filtering the ORA adaptation point" VALUE 0x80579180 RB_Val_Wu16 13106.80 t_q0p2 0.20 13107.00 FORMAT "%8.2" EXTENDED_LIMITS 0.00 13107.00 /end CHARACTERISTIC
/begin CHARACTERISTIC TDVFORAERW "Time interval which is used, to take into account the change of vehicle speed for the condition ORA(additive correction of the mixture adaptation)expected" VALUE 0x80579182 RB_Val_Wu8 51.00 t_q0p2 0.00 51.00 FORMAT "%5.2" /end CHARACTERISTIC
/begin CHARACTERISTIC TETAMIMX "filter time constant for computation of max. indicated torque" VALUE 0x80579964 RB_Val_Wu16 655.34999985 zk10msxs_uw_b655 0.01000015 655.36000000 FORMAT "%12.8" EXTENDED_LIMITS 0.010000152590 655.36000000 /end CHARACTERISTIC
/begin CHARACTERISTIC TFRAFV "start value for count down timer case of fault suspicion fra" VALUE 0x805791A0 RB_Val_Wu16 13107.00 t_q0p2 0.00 13107.00 FORMAT "%8.2" /end CHARACTERISTIC
/begin CHARACTERISTIC TFRAINI "Initialisation value of count down timer fra" VALUE 0x805791A2 RB_Val_Wu16 13107.00 t_q0p2 0.00 13107.00 FORMAT "%8.2" /end CHARACTERISTIC
/begin CHARACTERISTIC TFRAPH "threshold for priority step 2 fra" VALUE 0x805791A4 RB_Val_Wu16 13107.00 t_q0p2 0.00 13107.00 FORMAT "%8.2" /end CHARACTERISTIC
/begin CHARACTERISTIC TFRASTABZ "start value for count down timer case of GA stabilized and Z_fra" VALUE 0x805791A6 RB_Val_Wu16 13107.00 t_q0p2 0.00 13107.00 FORMAT "%8.2" /end CHARACTERISTIC
/begin CHARACTERISTIC TLRHS "Turn-on delay time for activation of closed-loop lambda control in case of hot start" VALUE 0x805794EB RB_Val_Wu8 25.50 t_q0p1 0.00 25.50 FORMAT "%5.2" /end CHARACTERISTIC
/begin CHARACTERISTIC TLRSZWSA "Time for hard switch-on of closed loop lambda control after fuel cut-off" VALUE 0x805794EC RB_Val_Wu16 6553.500 t_q0p1 0.00 6553.500 FORMAT "%8.3" /end CHARACTERISTIC
/begin CHARACTERISTIC TLRTMS "Turn-on delay time for activation of closed-loop lambda control depending on engine start temperature" CURVE 0x805794EE RB_Curve_U8_U16_Static 6553.500 t_q0p1 0.00 6553.500 FORMAT "%8.3"
 /begin AXIS_DESCR STD_AXIS LamCtrl_tEngStrtWrmUp temp_ub_q0p75_o48 5 -48.0 143.3 FORMAT "%5.1" DEPOSIT ABSOLUTE /end AXIS_DESCR
/end CHARACTERISTIC
/begin CHARACTERISTIC TMECnv_flgRedStgMaxThdGbx_C "Calibration to activate gear box by protection by changing the reduction stage maximum threshold" VALUE 0x805799C4 RB_Val_Wboolean 1.00000000000 B_TRUE 0.00 1.00000000000 FORMAT "%13.11" /end CHARACTERISTIC
/begin CHARACTERISTIC TMECnv_RedStgMaxThdGbx_C "Maximum reduction stage threshold for gear box protection" VALUE 0x805799C5 RB_Val_Wu8 255.0 dez 0.00 255.0 FORMAT "%5.1" /end CHARACTERISTIC
/begin CHARACTERISTIC TMECnv_stTqRedCfg_C "codeword for configuration of reduction stage from torque demand" VALUE 0x805799C6 RB_Val_Wu8 255.0 dez 0.00 255.0 FORMAT "%5.1" /end CHARACTERISTIC
/begin CHARACTERISTIC TMELoss_ratTqDrgT_M "temperature share of drag torque" MAP 0x80579B5C RB_Map_S16S16_S32 199.998474121 rel_uw_b100 -100.000000000 99.998474121 FORMAT "%13.9" EXTENDED_LIMITS -3276800.00000 3276799.99847
 /begin AXIS_DESCR STD_AXIS tsmdvermot temp_ub_q0p75_o48 3 -48.0000 143.2500 FORMAT "%8.4" EXTENDED_LIMITS -24624.00 24527.25 DEPOSIT ABSOLUTE /end AXIS_DESCR
 /begin AXIS_DESCR STD_AXIS tmotlok temp_ub_q0p75_o48 10 -48.0000 143.2500 FORMAT "%8.4" EXTENDED_LIMITS -24624.00 24527.25 DEPOSIT ABSOLUTE /end AXIS_DESCR
/end CHARACTERISTIC
/begin CHARACTERISTIC TMELoss_ratTqFrc_M "map for friction torque (rel to MDNORM)" MAP 0x80579BF4 RB_Map_S16S16_U16 99.99847 rel_uw_b100 0.00 99.99847 FORMAT "%8.5"
 /begin AXIS_DESCR STD_AXIS Epm_nEng EngN 12 -16384.00 16383.50 FORMAT "%8.2" DEPOSIT ABSOLUTE /end AXIS_DESCR
 /begin AXIS_DESCR STD_AXIS EngDa_tEng Temp_Cels 6 -3549.940 3003.560 FORMAT "%8.3" DEPOSIT ABSOLUTE /end AXIS_DESCR
/end CHARACTERISTIC
/begin CHARACTERISTIC TMELoss_ratTqFricT_M "Map for temperature depending drag torque, depended on oil and coolant temperature" MAP 0x80579CAC RB_Map_S16S16_U16 99.99847 rel_uw_b100 0.00 99.99847 FORMAT "%8.5"
 /begin AXIS_DESCR STD_AXIS NO_INPUT_QUANTITY Temp_Cels 10 -273.140 3003.560 FORMAT "%8.3" EXTENDED_LIMITS -3549.940 3003.560 DEPOSIT ABSOLUTE /end AXIS_DESCR
 /begin AXIS_DESCR STD_AXIS NO_INPUT_QUANTITY Temp_Cels 10 -273.140 3003.560 FORMAT "%8.3" EXTENDED_LIMITS -3549.940 3003.560 DEPOSIT ABSOLUTE /end AXIS_DESCR
/end CHARACTERISTIC
/begin CHARACTERISTIC TMFVDFRM "Enable temperature threshold to determine the error suspicion via dfrm_w(deviation of fast lambda controller mean value from 1.0)" VALUE 0x805790C5 RB_Val_Wu8 191.3 temp_ub_q0p75_o48 -48.0 143.3 FORMAT "%5.1" /end CHARACTERISTIC
/begin CHARACTERISTIC TMRAA "cut-in temperature adaptive precontrol for lambda closed-loop control" VALUE 0x80579183 RB_Val_Wu8 191.3 temp_ub_q0p75_o48 -48.0 143.3 FORMAT "%5.1" /end CHARACTERISTIC
/begin CHARACTERISTIC TMRAAFV "cut-in temperature fuel mixture adaptation in case of error suspicion" VALUE 0x80579184 RB_Val_Wu8 191.3 temp_ub_q0p75_o48 -48.0 143.3 FORMAT "%5.1" /end CHARACTERISTIC
/begin CHARACTERISTIC TMSHS "threshold for engine temperature for hot start detection" VALUE 0x805794FE RB_Val_Wu8 191.3 temp_ub_q0p75_o48 -48.0 143.3 FORMAT "%5.1" /end CHARACTERISTIC
/begin CHARACTERISTIC TNSEORAP "Threshold time to ignore B_fedssb(Charge determination based on intake manifold pressure sensor), after engine start." VALUE 0x805790C6 RB_Val_Wu16 6553.500 t100msxs_uw_b6553p5 0.00 6553.500 FORMAT "%8.3" /end CHARACTERISTIC
/begin CHARACTERISTIC TORAFDGS "Reset value for count down timer in case of B_fdgser" VALUE 0x805791A8 RB_Val_Wu16 13107.00 t_q0p2 0.00 13107.00 FORMAT "%8.2" /end CHARACTERISTIC
/begin CHARACTERISTIC TORAFV "Reset value for count down timer in case of fault suspition B_fvlra" VALUE 0x805791AA RB_Val_Wu16 13107.00 t_q0p2 0.00 13107.00 FORMAT "%8.2" /end CHARACTERISTIC
/begin CHARACTERISTIC TORAINI "Initialisation value of count down timer ora" VALUE 0x805791AC RB_Val_Wu16 13107.00 t_q0p2 0.00 13107.00 FORMAT "%8.2" /end CHARACTERISTIC
/begin CHARACTERISTIC TORAPH "Threshold of phase 2 (Ga possible)" VALUE 0x805791AE RB_Val_Wu16 13107.00 t_q0p2 0.00 13107.00 FORMAT "%8.2" /end CHARACTERISTIC
/begin CHARACTERISTIC TORASTA "start value for count down timer case of GA stabilized" VALUE 0x805791B0 RB_Val_Wu16 13107.00 t_q0p2 0.00 13107.00 FORMAT "%8.2" /end CHARACTERISTIC
/begin CHARACTERISTIC TTPDFRM "time constant for deviation of fast lambda controller mean value from 1.0 lowpass filter" VALUE 0x805790C8 RB_Val_Wu16 13106.999997 zk200msxs_uw_b13107 0.200003 13107.200000 FORMAT "%12.6" EXTENDED_LIMITS 0.20000305180 13107.200000 /end CHARACTERISTIC
/begin CHARACTERISTIC TTPMILSOL "time constant for the low pass filtering of the load dynamics" VALUE 0x805790CA RB_Val_Wu16 13106.999997 zk200msxs_uw_b13107 0.200003 13107.200000 FORMAT "%12.6" EXTENDED_LIMITS 0.20000305180 13107.200000 /end CHARACTERISTIC
/begin CHARACTERISTIC TTPNMOT "time constant for the low pass filtering of the engine speed dynamics" VALUE 0x805790CC RB_Val_Wu8 50.9992 zk200msxs_ub_b51p2 0.2008 51.2000 FORMAT "%7.4" EXTENDED_LIMITS 0.200784 51.2000 /end CHARACTERISTIC
/begin CHARACTERISTIC TUBOERWMX "Maximum time for the ORA(additive correction of the mixture adaptation) expected condition" VALUE 0x80579186 RB_Val_Wu16 13107.00 t_q0p2 0.00 13107.00 FORMAT "%8.2" /end CHARACTERISTIC
/begin CHARACTERISTIC TVLRA "delay time for activation of the lambda adaption after lambda control active" VALUE 0x80579188 RB_Val_Wu8 51.00 t_q0p2 0.00 51.00 FORMAT "%5.2" /end CHARACTERISTIC
/begin CHARACTERISTIC TVNLGA "Switch-off time for operating readiness for adaption factor" VALUE 0x80579189 RB_Val_Wu8 51.00 t_q0p2 0.00 51.00 FORMAT "%5.2" /end CHARACTERISTIC
/begin CHARACTERISTIC TVUBLRA "switch off time for avoidance of operating mode switching in range limit" VALUE 0x8057918A RB_Val_Wu8 51.00 t_q0p2 0.00 51.00 FORMAT "%5.2" /end CHARACTERISTIC
/begin CHARACTERISTIC TVUBLRAFRA "delay time operating mode independent enable conditions of multiplicative mixture adaptation factor (FRA)" VALUE 0x8057918B RB_Val_Wu8 51.00 t_q0p2 0.00 51.00 FORMAT "%5.2" /end CHARACTERISTIC
/begin CHARACTERISTIC TVUBLRAORA "delay time operating mode independent enable conditions of additive correction of the mixture adaptation (ORA)" VALUE 0x8057918C RB_Val_Wu8 51.00 t_q0p2 0.00 51.00 FORMAT "%5.2" /end CHARACTERISTIC
/begin CHARACTERISTIC VFOERWRES "Vehicle speed threshold for reset of expected engine mode independent enable conditions of ORA(additive correction of the mixture adaptation)" VALUE 0x8057918E RB_Val_Wu16 511.9922 vfzg_uw_b512 0.00 511.9922 FORMAT "%8.4" /end CHARACTERISTIC
/begin CHARACTERISTIC VFUBOERW "Vehicle speed threshold for expected engine mode independent enable conditions of ORA(additive correction of the mixture adaptation)" VALUE 0x80579190 RB_Val_Wu16 511.9922 vfzg_uw_b512 0.00 511.9922 FORMAT "%8.4" /end CHARACTERISTIC
/begin CHARACTERISTIC ZKNSU_W "Time constant for target engine speed when changing target (rising)" VALUE 0x805721E8 RB_Val_Wu16 1310.6999997 zk20msxs_uw_b1310 0.0200003 1310.7200000 FORMAT "%12.7" EXTENDED_LIMITS 0.020000305180 1310.7200000 /end CHARACTERISTIC
/begin CHARACTERISTIC ZKNS_W "Time constant for target engine speed when changing target" VALUE 0x805721EA RB_Val_Wu16 1310.6999997 zk20msxs_uw_b1310 0.0200003 1310.7200000 FORMAT "%12.7" EXTENDED_LIMITS 0.020000305180 1310.7200000 /end CHARACTERISTIC
/begin MEASUREMENT AirMod_mfGasIntkVlv "gas mass flow over intake valve" SWORD m_q0p1 1 100 -3276.800 3276.700 FORMAT "%8.3" ECU_ADDRESS 0x70003C10 /end MEASUREMENT
/begin MEASUREMENT AirSys_bMinPsblIdcTrqRea "Condition minimal possible indicated torque reached" UBYTE B_TRUE 1 100 0.00 1.00000000000 BIT_MASK 0x1 FORMAT "%13.11" ECU_ADDRESS 0x60001511 /end MEASUREMENT
/begin MEASUREMENT AirSys_bThrVlvUnthr "Condition: throttle angle greater or equal wdkugd" UBYTE B_TRUE 1 100 0.00 1.00000000000 BIT_MASK 0x1 FORMAT "%13.11" ECU_ADDRESS 0x60001510 /end MEASUREMENT
/begin MEASUREMENT AirSys_bTrqInflCmft "Request (dynamic) intervention by air system considering comfort" UBYTE B_TRUE 1 100 0.00 1.00000000000 BIT_MASK 0x1 FORMAT "%13.11" ECU_ADDRESS 0x6000150F /end MEASUREMENT
/begin MEASUREMENT AirSys_bTrqInflLimp "Request (dynamic) intervention by air system - limp home" UBYTE B_TRUE 1 100 0.00 1.00000000000 BIT_MASK 0x1 FORMAT "%13.11" ECU_ADDRESS 0x6000150E /end MEASUREMENT
/begin MEASUREMENT AirSys_mAirThrVlv "air mass flow through throttle valve" UWORD m_q0p1 1 100 0.00 6553.500 FORMAT "%8.3" ECU_ADDRESS 0x70003988 /end MEASUREMENT
/begin MEASUREMENT AirSys_rChCyl "Relative air charge in the cylinder" SWORD rel_q0p02344 1 100 0.00 767.9766 FORMAT "%8.4" ECU_ADDRESS 0x70003C0E /end MEASUREMENT
/begin MEASUREMENT AirSys_rChCylLRes "Relative air charge in the cylinder lower resolution" UBYTE rel_q0p75 1 100 0.00 191.3 FORMAT "%5.1" ECU_ADDRESS 0x7000372D /end MEASUREMENT
/begin MEASUREMENT AirSys_rChrgCyl "Relative air charge in the cylinder" SWORD rel_q0p02344 1 100 0.00 767.9766 FORMAT "%8.4" ECU_ADDRESS 0x6000065C /end MEASUREMENT
/begin MEASUREMENT AirSys_rMsCyl "relative air mass (calc. load value) acc. to SAE J1979" UBYTE rel_ub_b99p6 1 100 0.00 99.61 FORMAT "%5.2" ECU_ADDRESS 0x6000F89E /end MEASUREMENT
/begin MEASUREMENT AirSys_rPhiThrVlv "Throttle angle with respect to lower mechanical stop" SWORD relDK_q0p02441 1 100 -800.0000 799.9756 FORMAT "%8.4" ECU_ADDRESS 0x60000A7A /end MEASUREMENT
/begin MEASUREMENT blrs_IT.memory "Enabling ramp, integrator, bank 1 / current integrator value" SLONG fak_q9p3132Em10 1 100 -2.00000000000 1.99999999907 FORMAT "%13.11" ECU_ADDRESS 0x60000EC8 /end MEASUREMENT
/begin MEASUREMENT BMLEVAB.imlevab_l "Class instance to disable lambda control during and after fuel cut-off (bank 1) / Air mass after cylinder cut-off" ULONG m_q2p777Em4_g 1 100 0.00 1193046.47083 FORMAT "%13.5" ECU_ADDRESS 0x60000EB8 /end MEASUREMENT
/begin MEASUREMENT B_avfra_msg "condition multiplicative mixture adaptation active" UBYTE B_TRUE 1 100 0.00 1.00000000000 BIT_MASK 0x1 FORMAT "%13.11" ECU_ADDRESS 0x70000C39 /end MEASUREMENT
/begin MEASUREMENT B_avora_msg "condition additive mixture adaptation active" UBYTE B_TRUE 1 100 0.00 1.00000000000 BIT_MASK 0x1 FORMAT "%13.11" ECU_ADDRESS 0x70000C38 /end MEASUREMENT
/begin MEASUREMENT B_baffuel_msg "operating mode dependent readiness stoichiometric fuel adaptation" UBYTE B_TRUE 1 100 0.00 1.00000000000 BIT_MASK 0x1 FORMAT "%13.11" ECU_ADDRESS 0x70000C37 /end MEASUREMENT
/begin MEASUREMENT B_balra_msg "Operating mode dependent Readiness for function LRA(Lambda closed loop control; Adaptive pilot control)" UBYTE B_TRUE 1 100 0.00 1.00000000000 BIT_MASK 0x1 FORMAT "%13.11" ECU_ADDRESS 0x70000C35 /end MEASUREMENT
/begin MEASUREMENT B_besoe_msg "acceleration in calculation of additive correction of the mixture adaptation (ORA) -expected" UBYTE B_TRUE 1 100 0.00 1.00000000000 BIT_MASK 0x1 FORMAT "%13.11" ECU_ADDRESS 0x70000199 /end MEASUREMENT
/begin MEASUREMENT B_brufs_msg "Condition drive and brake activated, combined" UBYTE B_TRUE 1 100 0.00 1.00000000000 BIT_MASK 0x1 FORMAT "%13.11" ECU_ADDRESS 0x70000C2D /end MEASUREMENT
/begin MEASUREMENT B_dtefrr_ER.buffer "B_dtefrr, edge rising / rising edge detected" UBYTE B_TRUE 1 100 0.00 1.00000000000 BIT_MASK 0x1 FORMAT "%13.11" ECU_ADDRESS 0x60000ED0 /end MEASUREMENT
/begin MEASUREMENT B_dtefrr_ER.oldSignal "B_dtefrr, edge rising / flag rising edge" UBYTE B_TRUE 1 100 0.00 1.00000000000 BIT_MASK 0x1 FORMAT "%13.11" ECU_ADDRESS 0x60000ED1 /end MEASUREMENT
/begin MEASUREMENT B_elsvga_msg "condition: lambda sensor error for mixture adaptation" UBYTE B_TRUE 1 100 0.00 1.00000000000 BIT_MASK 0x1 FORMAT "%13.11" ECU_ADDRESS 0x70000BF2 /end MEASUREMENT
/begin MEASUREMENT B_eobdlr_msg "error flag: OBD II summary fault, disables lambda control (OBD: on-board-diagnosis)" UBYTE B_TRUE 1 100 0.00 1.00000000000 BIT_MASK 0x1 FORMAT "%13.11" ECU_ADDRESS 0x70000BEA /end MEASUREMENT
/begin MEASUREMENT B_fraprdy "Condition physical readiness of fra(multiplicative mixture adaptation factor) adaptation" UBYTE B_TRUE 1 100 0.00 1.00000000000 BIT_MASK 0x1 FORMAT "%13.11" ECU_ADDRESS 0x70000198 /end MEASUREMENT
/begin MEASUREMENT B_frfvlra_FF.status "variable existing only due to software reason / current value of RS-FF" UBYTE B_TRUE 1 100 0.00 1.00000000000 BIT_MASK 0x1 FORMAT "%13.11" ECU_ADDRESS 0x6000B753 /end MEASUREMENT
/begin MEASUREMENT B_frmax_msg "lambda control at upper limit without special conditions (e.g. enleanment protection)" UBYTE B_TRUE 1 100 0.00 1.00000000000 BIT_MASK 0x1 FORMAT "%13.11" ECU_ADDRESS 0x70000BBC /end MEASUREMENT
/begin MEASUREMENT B_frmin_msg "lambda control at lower limit without special conditions (e.g. enleanment protection)" UBYTE B_TRUE 1 100 0.00 1.00000000000 BIT_MASK 0x1 FORMAT "%13.11" ECU_ADDRESS 0x70000BBB /end MEASUREMENT
/begin MEASUREMENT B_frmn_msg "lambda control at lower limit with special conditions (e.g. enleanment protection), bank 1" UBYTE B_TRUE 1 100 0.00 1.00000000000 BIT_MASK 0x1 FORMAT "%13.11" ECU_ADDRESS 0x70000BBA /end MEASUREMENT
/begin MEASUREMENT B_fvdfrm "Condition error suspicion from the fast mean value of lambda control factor (frm) deviation" UBYTE B_TRUE 1 100 0.00 1.00000000000 BIT_MASK 0x1 FORMAT "%13.11" ECU_ADDRESS 0x7000019B /end MEASUREMENT
/begin MEASUREMENT B_fvdfrmeb_msg "basic willingness for identification of error suspicion" UBYTE B_TRUE 1 100 0.00 1.00000000000 BIT_MASK 0x1 FORMAT "%13.11" ECU_ADDRESS 0x70000BB5 /end MEASUREMENT
/begin MEASUREMENT B_fvlrae "Enabling condition to calculate the error suspicion of the mixture adaptation" UBYTE B_TRUE 1 100 0.00 1.00000000000 BIT_MASK 0x1 FORMAT "%13.11" ECU_ADDRESS 0x7000019A /end MEASUREMENT
/begin MEASUREMENT B_fvlra_msg "condition error suspicion in mixture adaptation" UBYTE B_TRUE 1 100 0.00 1.00000000000 BIT_MASK 0x1 FORMAT "%13.11" ECU_ADDRESS 0x70000BB4 /end MEASUREMENT
/begin MEASUREMENT B_gaenresff "fuel mixture adaptation stabilized since last reset (NV-NonVolatile) for Gasoline Direct Injection (gdi) path" UBYTE B_TRUE 1 100 0.00 1.00000000000 BIT_MASK 0x1 FORMAT "%13.11" ECU_ADDRESS 0x60036E25 /end MEASUREMENT
/begin MEASUREMENT B_gaenres_msg "fuel mixture adaptation stabilized since last reset (NV-Nonvolatile Memory)" UBYTE B_TRUE 1 100 0.00 1.00000000000 BIT_MASK 0x1 FORMAT "%13.11" ECU_ADDRESS 0x70000BB2 /end MEASUREMENT
/begin MEASUREMENT B_lrabstv_msg "fundamental operating mode independent operation readiness of mixture adaptation fpr stop inhibitions" UBYTE B_TRUE 1 100 0.00 1.00000000000 BIT_MASK 0x1 FORMAT "%13.11" ECU_ADDRESS 0x70000B7C /end MEASUREMENT
/begin MEASUREMENT B_lrab_msg "fundamental operating mode independent operation readiness of mixture adaptation" UBYTE B_TRUE 1 100 0.00 1.00000000000 BIT_MASK 0x1 FORMAT "%13.11" ECU_ADDRESS 0x70000B7D /end MEASUREMENT
/begin MEASUREMENT B_lradlsuchk "Condition that lambda sensor diagnosis was tested ok" UBYTE B_TRUE 1 100 0.00 1.00000000000 BIT_MASK 0x1 FORMAT "%13.11" ECU_ADDRESS 0x60036DC6 /end MEASUREMENT
/begin MEASUREMENT B_lrafra_msg "multiplicative range of mixture adaptation is active" UBYTE B_TRUE 1 100 0.00 1.00000000000 BIT_MASK 0x1 FORMAT "%13.11" ECU_ADDRESS 0x70000B7B /end MEASUREMENT
/begin MEASUREMENT B_lraora_msg "additive range of the mixture adaptation is active" UBYTE B_TRUE 1 100 0.00 1.00000000000 BIT_MASK 0x1 FORMAT "%13.11" ECU_ADDRESS 0x70000B7A /end MEASUREMENT
/begin MEASUREMENT B_lrareb_msg "condition reset readiness of mixture adaptation" UBYTE B_TRUE 1 100 0.00 1.00000000000 BIT_MASK 0x1 FORMAT "%13.11" ECU_ADDRESS 0x70000B78 /end MEASUREMENT
/begin MEASUREMENT B_lrare_msg "condition reset of mixture adaptation" UBYTE B_TRUE 1 100 0.00 1.00000000000 BIT_MASK 0x1 FORMAT "%13.11" ECU_ADDRESS 0x70000B79 /end MEASUREMENT
/begin MEASUREMENT B_lrmein "condition lambda control active due to GDI (gasoline direct injection) mode change" UBYTE B_TRUE 1 100 0.00 1.00000000000 BIT_MASK 0x1 FORMAT "%13.11" ECU_ADDRESS 0x600000CE /end MEASUREMENT
/begin MEASUREMENT B_lrmein_FF.status "FlipFlop for operating mode dependent enabling / current value of RS-FF" UBYTE B_TRUE 1 100 0.00 1.00000000000 BIT_MASK 0x1 FORMAT "%13.11" ECU_ADDRESS 0x60000EB5 /end MEASUREMENT
/begin MEASUREMENT B_lrmsbs_ER.buffer "Condition lean mixture forbidden for lambda control, edge rising / rising edge detected" UBYTE B_TRUE 1 100 0.00 1.00000000000 BIT_MASK 0x1 FORMAT "%13.11" ECU_ADDRESS 0x60000ECE /end MEASUREMENT
/begin MEASUREMENT B_lrmsbs_ER.oldSignal "Condition lean mixture forbidden for lambda control, edge rising / flag rising edge" UBYTE B_TRUE 1 100 0.00 1.00000000000 BIT_MASK 0x1 FORMAT "%13.11" ECU_ADDRESS 0x60000ECF /end MEASUREMENT
/begin MEASUREMENT B_lrmsbs_msg "Condition lean mixture forbidden for lambda control, bank 1" UBYTE B_TRUE 1 100 0.00 1.00000000000 BIT_MASK 0x1 FORMAT "%13.11" ECU_ADDRESS 0x70000B77 /end MEASUREMENT
/begin MEASUREMENT B_lrmstr_msg "Condition lean mixture forbidden at load change" UBYTE B_TRUE 1 100 0.00 1.00000000000 BIT_MASK 0x1 FORMAT "%13.11" ECU_ADDRESS 0x70000B76 /end MEASUREMENT
/begin MEASUREMENT B_lrnbsnc "bank independent neccessary conditions for lambda control" UBYTE B_TRUE 1 100 0.00 1.00000000000 BIT_MASK 0x1 FORMAT "%13.11" ECU_ADDRESS 0x600000CD /end MEASUREMENT
/begin MEASUREMENT B_lrnda_msg "lambda control bank 1 active, possibly limited" UBYTE B_TRUE 1 100 0.00 1.00000000000 BIT_MASK 0x1 FORMAT "%13.11" ECU_ADDRESS 0x70000B75 /end MEASUREMENT
/begin MEASUREMENT B_lrsb_msg "Flag readiness continuous lambda control except possibly for operating mode" UBYTE B_TRUE 1 100 0.00 1.00000000000 BIT_MASK 0x1 FORMAT "%13.11" ECU_ADDRESS 0x70000B73 /end MEASUREMENT
/begin MEASUREMENT B_lrseta_msg "Continuous lambda control: setpoint active" UBYTE B_TRUE 1 100 0.00 1.00000000000 BIT_MASK 0x1 FORMAT "%13.11" ECU_ADDRESS 0x70000B72 /end MEASUREMENT
/begin MEASUREMENT B_lrsrems "Condition fr-Reset if lean mixture forbidden, bank 1" UBYTE B_TRUE 1 100 0.00 1.00000000000 BIT_MASK 0x1 FORMAT "%13.11" ECU_ADDRESS 0x600000D2 /end MEASUREMENT
/begin MEASUREMENT B_lrssa_msg "switch on continuous lambda control after fuel cut off with slow sensor" UBYTE B_TRUE 1 100 0.00 1.00000000000 BIT_MASK 0x1 FORMAT "%13.11" ECU_ADDRESS 0x70000B71 /end MEASUREMENT
/begin MEASUREMENT B_lrs_msg "Enabling condition for lambda closed loop control upstream catalyst, bank 1" UBYTE B_TRUE 1 100 0.00 1.00000000000 BIT_MASK 0x1 FORMAT "%13.11" ECU_ADDRESS 0x70000B74 /end MEASUREMENT
/begin MEASUREMENT B_lr_msg "Closed loop lambda upstream catalyst enabled without restrictions" UBYTE B_TRUE 1 100 0.00 1.00000000000 BIT_MASK 0x1 FORMAT "%13.11" ECU_ADDRESS 0x70000B7E /end MEASUREMENT
/begin MEASUREMENT B_mdeevb_msg "condition: torque reduction by injection fade out, excluding function monitoring" UBYTE B_TRUE 1 100 0.00 1.00000000000 BIT_MASK 0x1 FORMAT "%13.11" ECU_ADDRESS 0x70003641 /end MEASUREMENT
/begin MEASUREMENT B_mdee_msg "Condition: torque reduction by injection fade out is permitted" UBYTE B_TRUE 1 100 0.00 1.00000000000 BIT_MASK 0x1 FORMAT "%13.11" ECU_ADDRESS 0x70003642 /end MEASUREMENT
/begin MEASUREMENT B_mdist "Condition Actual Torque Computation active" UBYTE B_TRUE 1 100 0.00 1.00000000000 BIT_MASK 0x1 FORMAT "%13.11" ECU_ADDRESS 0x70000193 /end MEASUREMENT
/begin MEASUREMENT B_mdistact "like ActMod_bEngActv." UBYTE B_TRUE 1 100 0.00 1.00000000000 BIT_MASK 0x1 FORMAT "%13.11" ECU_ADDRESS 0x70000192 /end MEASUREMENT
/begin MEASUREMENT B_mlevab_msg "Bit lambda control disabled during or after cylinder cut-off" UBYTE B_TRUE 1 100 0.00 1.00000000000 BIT_MASK 0x1 FORMAT "%13.11" ECU_ADDRESS 0x70000B69 /end MEASUREMENT
/begin MEASUREMENT B_mlrsa_FF.status "FlipFlop for air-mass based disabling condition / current value of RS-FF" UBYTE B_TRUE 1 100 0.00 1.00000000000 BIT_MASK 0x1 FORMAT "%13.11" ECU_ADDRESS 0x60000EB4 /end MEASUREMENT
/begin MEASUREMENT B_mlrsa_msg "Air mass based switch off of lambda control during and after fuel cut off" UBYTE B_TRUE 1 100 0.00 1.00000000000 BIT_MASK 0x1 FORMAT "%13.11" ECU_ADDRESS 0x70000B68 /end MEASUREMENT
/begin MEASUREMENT B_nofra_msg "condition no fra(multiplicative correction of mixture adaptation) adaptation active" UBYTE B_TRUE 1 100 0.00 1.00000000000 BIT_MASK 0x1 FORMAT "%13.11" ECU_ADDRESS 0x70000B59 /end MEASUREMENT
/begin MEASUREMENT B_noora_msg "condition additive correction of the mixture adaptation switched off" UBYTE B_TRUE 1 100 0.00 1.00000000000 BIT_MASK 0x1 FORMAT "%13.11" ECU_ADDRESS 0x70000B58 /end MEASUREMENT
/begin MEASUREMENT B_nozwe_msg "condition no intervention of torque-model via ignition angle" UBYTE B_TRUE 1 100 0.00 1.00000000000 BIT_MASK 0x1 FORMAT "%13.11" ECU_ADDRESS 0x70000B55 /end MEASUREMENT
/begin MEASUREMENT B_nphyora_msg "ORA adaptation not within physical range" UBYTE B_TRUE 1 100 0.00 1.00000000000 BIT_MASK 0x1 FORMAT "%13.11" ECU_ADDRESS 0x60036E15 /end MEASUREMENT
/begin MEASUREMENT B_oramilh "enabling range for ORA adaptation at higher load" UBYTE B_TRUE 1 100 0.00 1.00000000000 BIT_MASK 0x1 FORMAT "%13.11" ECU_ADDRESS 0x70000197 /end MEASUREMENT
/begin MEASUREMENT B_oraprdy "Condition physical readiness of ora adaptation" UBYTE B_TRUE 1 100 0.00 1.00000000000 BIT_MASK 0x1 FORMAT "%13.11" ECU_ADDRESS 0x70000196 /end MEASUREMENT
/begin MEASUREMENT B_orap_msg "Condition for switching from HFM(Hot film meter) System to P-System(Pressure Sensor)" UBYTE B_TRUE 1 100 0.00 1.00000000000 BIT_MASK 0x1 FORMAT "%13.11" ECU_ADDRESS 0x70000B4C /end MEASUREMENT
/begin MEASUREMENT B_phyframh "FRA adaptation within raised physical range" UBYTE B_TRUE 1 100 0.00 1.00000000000 BIT_MASK 0x1 FORMAT "%13.11" ECU_ADDRESS 0x70000195 /end MEASUREMENT
/begin MEASUREMENT B_pspaus "condition lambda control inactive by project specific disabling condition" UBYTE B_TRUE 1 100 0.00 1.00000000000 BIT_MASK 0x1 FORMAT "%13.11" ECU_ADDRESS 0x600000CC /end MEASUREMENT
/begin MEASUREMENT B_pspwl_msg "condition lambda control possible since warmup finished" UBYTE B_TRUE 1 100 0.00 1.00000000000 BIT_MASK 0x1 FORMAT "%13.11" ECU_ADDRESS 0x70000B44 /end MEASUREMENT
/begin MEASUREMENT B_redmxgs_msg "condition: limitation of reduction stage for cylinder individual fuel cut-off at gear shift" UBYTE B_TRUE 1 100 0.00 1.00000000000 BIT_MASK 0x1 FORMAT "%13.11" ECU_ADDRESS 0x7000363D /end MEASUREMENT
/begin MEASUREMENT B_refrast_msg "condition: reset of stabilisation bit of adaption fra" UBYTE B_TRUE 1 100 0.00 1.00000000000 BIT_MASK 0x1 FORMAT "%13.11" ECU_ADDRESS 0x70000B35 /end MEASUREMENT
/begin MEASUREMENT B_reorast_msg "condition: reset of stabilisation bit of adaption ora" UBYTE B_TRUE 1 100 0.00 1.00000000000 BIT_MASK 0x1 FORMAT "%13.11" ECU_ADDRESS 0x70000B34 /end MEASUREMENT
/begin MEASUREMENT B_reqlra_msg "fuel mixture adaptation requirement detected" UBYTE B_TRUE 1 100 0.00 1.00000000000 BIT_MASK 0x1 FORMAT "%13.11" ECU_ADDRESS 0x60036E0D /end MEASUREMENT
/begin MEASUREMENT B_teminlrs_ER.buffer "Minimum injection time reached, edge rising / rising edge detected" UBYTE B_TRUE 1 100 0.00 1.00000000000 BIT_MASK 0x1 FORMAT "%13.11" ECU_ADDRESS 0x60000ECC /end MEASUREMENT
/begin MEASUREMENT B_teminlrs_ER.oldSignal "Minimum injection time reached, edge rising / flag rising edge" UBYTE B_TRUE 1 100 0.00 1.00000000000 BIT_MASK 0x1 FORMAT "%13.11" ECU_ADDRESS 0x60000ECD /end MEASUREMENT
/begin MEASUREMENT B_temin_TOFFV.outbit "Minimum injection time reached, turn off delay / Output Bit" UBYTE B_TRUE 1 100 0.00 1.00000000000 BIT_MASK 0x1 FORMAT "%13.11" ECU_ADDRESS 0x50000F44 /end MEASUREMENT
/begin MEASUREMENT B_temin_TOFFV.time "Minimum injection time reached, turn off delay / Occured Time" UWORD t_q0p01 1 100 0.00 655.3500 FORMAT "%8.4" ECU_ADDRESS 0x50000F46 /end MEASUREMENT
/begin MEASUREMENT B_tpn_msg "Condition Tip_In" UBYTE B_TRUE 1 100 0.00 1.00000000000 BIT_MASK 0x1 FORMAT "%13.11" ECU_ADDRESS 0x70000B05 /end MEASUREMENT
/begin MEASUREMENT B_ubfra_msg "fra (multiplicative mixture adaptation factor)operational readiness independent of the operating mode" UBYTE B_TRUE 1 100 0.00 1.00000000000 BIT_MASK 0x1 FORMAT "%13.11" ECU_ADDRESS 0x70000AFB /end MEASUREMENT
/begin MEASUREMENT B_uboraerw_msg "engine mode independant enable conditions of ORA( additive correction of the mixture adaptation) expected" UBYTE B_TRUE 1 100 0.00 1.00000000000 BIT_MASK 0x1 FORMAT "%13.11" ECU_ADDRESS 0x70000AF9 /end MEASUREMENT
/begin MEASUREMENT B_ubora_msg "ora(additive correction of the mixture adaptation) operational readiness independent of the operating mode" UBYTE B_TRUE 1 100 0.00 1.00000000000 BIT_MASK 0x1 FORMAT "%13.11" ECU_ADDRESS 0x70000AFA /end MEASUREMENT
/begin MEASUREMENT B_ubphyfra_msg "Operating mode-independent physical readiness for FRA(Multiplicative correction of the mixture adaptation) adaptation" UBYTE B_TRUE 1 100 0.00 1.00000000000 BIT_MASK 0x1 FORMAT "%13.11" ECU_ADDRESS 0x70000AF8 /end MEASUREMENT
/begin MEASUREMENT B_ubphyora_msg "Operating mode-independent physical readiness for ORA(Additive correction of the mixture adaptation) adaptation" UBYTE B_TRUE 1 100 0.00 1.00000000000 BIT_MASK 0x1 FORMAT "%13.11" ECU_ADDRESS 0x70000AF7 /end MEASUREMENT
/begin MEASUREMENT B_ubpoerw_msg "engine mode independent enable conditions of ORA(additive correction of the mixture adaptation) expected (physical)" UBYTE B_TRUE 1 100 0.00 1.00000000000 BIT_MASK 0x1 FORMAT "%13.11" ECU_ADDRESS 0x70000AF6 /end MEASUREMENT
/begin MEASUREMENT dfrmax_w_msg "maximum limit for delta control factor of lambda control" SWORD fak_sw_b1 1 100 -1.000000 0.999969 FORMAT "%8.6" ECU_ADDRESS 0x6001497A /end MEASUREMENT
/begin MEASUREMENT dfrmin_w_msg "minimum limit for delta control factor of lambda control" SWORD fak_sw_b1 1 100 -1.000000 0.999969 FORMAT "%8.6" ECU_ADDRESS 0x6001497C /end MEASUREMENT
/begin MEASUREMENT dfrmkb_w "absolute value of dfrm(2)_w(deviation of fast lambda controller mean value from 1) corrected with the P-part(Proportional) of HK(Catalytic converter in downstream) controllerof the HK controller" UWORD fak_uw_b2 1 100 0.00 1.999969 FORMAT "%8.6" ECU_ADDRESS 0x600072F2 /end MEASUREMENT
/begin MEASUREMENT dfrmk_w_msg "dfrm_w(deviation of fast lambda controller mean value from 1) corrected with the P-part(Proportional) of the HK(Catalytic converter in downstream) controller" SWORD fak_sw_b1 1 100 -1.000000 0.999969 FORMAT "%8.6" ECU_ADDRESS 0x60008FC2 /end MEASUREMENT
/begin MEASUREMENT dfrmnms_w "minimum limit for delta control factor of lambda control due to enleanment protection" SWORD fak_sw_b1 1 100 -1.000000 0.999969 FORMAT "%8.6" ECU_ADDRESS 0x60000EEE /end MEASUREMENT
/begin MEASUREMENT dfrmn_w_msg "minimum limit for delta control factor of lambda control without special conditions (e.g. enleanment protection)" SWORD fak_sw_b1 1 100 -1.000000 0.999969 FORMAT "%8.6" ECU_ADDRESS 0x50005EF2 /end MEASUREMENT
/begin MEASUREMENT dfrmtp_w_msg "low pass filtered, deviation of fast lambda controller mean value from 1.0 (dfrm_w)" UWORD fak_uw_b2 1 100 0.00 1.999969 FORMAT "%8.6" ECU_ADDRESS 0x60008D90 /end MEASUREMENT
/begin MEASUREMENT dfrmx_w_msg "maximum limit for delta control factor of lambda control without special conditions (e.g. enleanment protection)" SWORD fak_sw_b1 1 100 -1.000000 0.999969 FORMAT "%8.6" ECU_ADDRESS 0x6001497E /end MEASUREMENT
/begin MEASUREMENT dfrm_w_msg "deviation of fast lambda controller mean value from 1.0" SWORD fak_sw_b1 1 100 -1.000000 0.999969 FORMAT "%8.6" ECU_ADDRESS 0x60008FC4 /end MEASUREMENT
/begin MEASUREMENT dfr_w_msg "Delta lambda controller (factor), bank1" SWORD fak_sw_b1 1 100 -1.000000 0.999969 FORMAT "%8.6" ECU_ADDRESS 0x600095F6 /end MEASUREMENT
/begin MEASUREMENT dlaso_msg "Correction of lambda setpoint for continuous lambda control, 8 Bit" SBYTE fak_sb_b0p03125 1 100 -0.03125 0.03101 FORMAT "%7.5" ECU_ADDRESS 0x6000FFFA /end MEASUREMENT
/begin MEASUREMENT dmilflp_w "delta milsol of FRA adaptation above lower limit of the physical range" SWORD rel_sw_b100 1 100 -100.0000 99.9969 FORMAT "%8.4" ECU_ADDRESS 0x600072E2 /end MEASUREMENT
/begin MEASUREMENT dmilfra_w "delta milsol of FRA adaptation above lower limit of the physical range at stabilizing" UWORD rel_uw_b100 1 100 0.00 99.99847 FORMAT "%8.5" ECU_ADDRESS 0x600072E0 /end MEASUREMENT
/begin MEASUREMENT dmilolp_w "delta milsol of ORA adaptation outside the physical range" SWORD rel_sw_b100 1 100 -100.0000 99.9969 FORMAT "%8.4" ECU_ADDRESS 0x600072DE /end MEASUREMENT
/begin MEASUREMENT dmilora_w "delta milsol of ORA adaptation outside the physical range at stabilizing" UWORD rel_uw_b100 1 100 0.00 99.99847 FORMAT "%8.5" ECU_ADDRESS 0x6003901C /end MEASUREMENT
/begin MEASUREMENT drldvmds_w_msg "dynamic reserve for compensating the change in air charge caused by switching of air charge actuators" SWORD rel_q0p02344 1 100 -768.0000 767.9766 FORMAT "%8.4" ECU_ADDRESS 0x600095EC /end MEASUREMENT
/begin MEASUREMENT drlmn_w "difference of actual to minimum air charge" UWORD rel_uw_q0p0234 1 100 0.00 1535.977 FORMAT "%8.3" ECU_ADDRESS 0x600072BA /end MEASUREMENT
/begin MEASUREMENT dvfoerw_w "delta vehicle speed for condition ORA(additive correction of the mixture adaptation) expected" SWORD vfzg_q0p0078125 1 100 -256.0000 255.9922 FORMAT "%8.4" ECU_ADDRESS 0x600072DC /end MEASUREMENT
/begin MEASUREMENT dzwi_w "Difference between optimized model reference ignition angle and actual ignition angle" SWORD zw_q2p9297Em3_deg_KW 1 100 0.00 95.99707 FORMAT "%8.5" ECU_ADDRESS 0x7000216C /end MEASUREMENT
/begin MEASUREMENT EGSys_bCH "condition catalyst heating activated" UBYTE B_TRUE 1 100 0.00 1.00000000000 BIT_MASK 0x1 FORMAT "%13.11" ECU_ADDRESS 0x6000F98C /end MEASUREMENT
/begin MEASUREMENT EGSys_bFCORdnCoPr "condition fuel cutoff request by component protection" UBYTE B_TRUE 1 100 0.00 1.00000000000 BIT_MASK 0x1 FORMAT "%13.11" ECU_ADDRESS 0x6000F6AF /end MEASUREMENT
/begin MEASUREMENT EGSys_etaCH "Efficiency requirement of the exhaust gas system for catalyst heating" UWORD fak_uw_b2 1 100 0.00 1.999969 FORMAT "%8.6" ECU_ADDRESS 0x6000949E /end MEASUREMENT
/begin MEASUREMENT EGSys_trqResvCH "Torque reserve for catalyst heating" SWORD md_q0p1 1 100 -3276.800 3276.700 FORMAT "%8.3" ECU_ADDRESS 0x70005370 /end MEASUREMENT
/begin MEASUREMENT EngReq_trqResvQckTst "Torque reserve during quicktest (previously: dmrkt_w)" SWORD Trq 1 100 -3276.800 3276.700 FORMAT "%8.3" ECU_ADDRESS 0x6001482A /end MEASUREMENT
/begin MEASUREMENT EngReq_trqRngExlAct "Exclusive torque range (previously: dmriexkl_w)" SWORD Trq 1 100 0.00 3276.700 FORMAT "%8.3" ECU_ADDRESS 0x600006BA /end MEASUREMENT
/begin MEASUREMENT EnvP_p "Ambient pressure" SWORD Pres_hPa 1 100 0.00 3500.000 FORMAT "%8.3" ECU_ADDRESS 0x600091E0 /end MEASUREMENT
/begin MEASUREMENT EnvT_tMod "Modeled environment air temperature" SWORD Temp_Cels 1 100 -3549.940 3003.560 FORMAT "%8.3" ECU_ADDRESS 0x600091DA /end MEASUREMENT
/begin MEASUREMENT etafue_w_msg "efficiency for torque calculation air charge path" UWORD fak_uw_b2 1 100 0.00 1.999969 FORMAT "%8.6" ECU_ADDRESS 0x6000078A /end MEASUREMENT
/begin MEASUREMENT etalfue_w "Efficiency of the air charge control" UWORD fak_uw_b2 1 100 0.00 1.999969 FORMAT "%8.6" ECU_ADDRESS 0x700052C2 /end MEASUREMENT
/begin MEASUREMENT etamimx_w_msg "smoothed efficieny for computation of maximal indicated optimal torque" UWORD fak_uw_b2 1 100 0.00 1.999969 FORMAT "%8.6" ECU_ADDRESS 0x6000936A /end MEASUREMENT
/begin MEASUREMENT etazaist_w_msg "actual cylinder masking efficiency" UWORD fak_uw_b2 1 100 0.00 1.000000 FORMAT "%8.6" ECU_ADDRESS 0x500008BC /end MEASUREMENT
/begin MEASUREMENT etazwbm_w_msg "mean ignition angle effectiveness of basic ignition angle" UWORD fak_uw_b2 1 100 0.00 1.999969 FORMAT "%8.6" ECU_ADDRESS 0x60000792 /end MEASUREMENT
/begin MEASUREMENT etazwb_w_msg "ignition angle effectiveness of basic ignition angle" UWORD fak_uw_b2 1 100 0.00 1.000000 FORMAT "%8.6" ECU_ADDRESS 0x6000078E /end MEASUREMENT
/begin MEASUREMENT etazwist_w_msg "actual spark efficiency" UWORD fak_uw_b2 1 100 0.00 1.999969 FORMAT "%8.6" ECU_ADDRESS 0x60000796 /end MEASUREMENT
/begin MEASUREMENT etazwmni_w "minimum ignition angle effectiveness" UWORD fak_uw_b2 1 100 0.00 1.999969 FORMAT "%8.6" ECU_ADDRESS 0x600072B8 /end MEASUREMENT
/begin MEASUREMENT etazwmnm_w_msg "average minimum ignition angle effectiveness" UWORD fak_uw_b2 1 100 0.00 1.000000 FORMAT "%8.6" ECU_ADDRESS 0x700037A4 /end MEASUREMENT
/begin MEASUREMENT etazwmns_w "Efficiency of ignition for desired operating mode" UWORD fak_uw_b2 1 100 0.00 1.000000 FORMAT "%8.6" ECU_ADDRESS 0x7000216E /end MEASUREMENT
/begin MEASUREMENT etazwmn_w_msg "minimum ignition angle effectiveness" UWORD fak_uw_b2 1 100 0.00 1.000000 FORMAT "%8.6" ECU_ADDRESS 0x6000079A /end MEASUREMENT
/begin MEASUREMENT etazwsol_w_msg "nominal spark efficiency" UWORD fak_uw_b2 1 100 0.00 1.999969 FORMAT "%8.6" ECU_ADDRESS 0x500008C6 /end MEASUREMENT
/begin MEASUREMENT ExhCo_Idx1d "location of oxygen sensors (4 banks and 2 sensors) - Parameter Identification 1D according with ISO15031-5. 2 banks and 4 sensors are identified by the index 13" UBYTE dez 1 100 0.00 255.0 FORMAT "%5.1" ECU_ADDRESS 0x6000F7ED /end MEASUREMENT
/begin MEASUREMENT facetazwmn_w "Interpolation factor for minimum ignition angle eta" UWORD fak_ub_b1 1 100 0.00 0.9960938 FORMAT "%9.7" ECU_ADDRESS 0x700052C4 /end MEASUREMENT
/begin MEASUREMENT ffrakl_msg "factor for reducing speed of learning fra(multiplicative correction of mixture adaptation)" UBYTE fak_ub_b2 1 100 0.007813 1.000000 FORMAT "%8.6" ECU_ADDRESS 0x6000F741 /end MEASUREMENT
/begin MEASUREMENT fkrkloc_w_msg "Correction Factor tolerance-compensation HDEV (rk), local array over all cylinders" UWORD fak_uw_b2 1 100 0.00 1.999969 FORMAT "%8.6" ARRAY_SIZE 4 ECU_ADDRESS 0x7000217E /end MEASUREMENT
/begin MEASUREMENT fkrk_w_msg "Correction Factor tolerance-compensation HDEV (rk), array over all cylinders" UWORD fak_uw_b2 1 100 0.00 1.999969 FORMAT "%8.6" ARRAY_SIZE 4 ECU_ADDRESS 0x500006B0 /end MEASUREMENT
/begin MEASUREMENT FlMA_ctPostDrvLeave "Local variable to store the global drive cycle counter (Global drive cycle counter which is incremented when system state SyC_PostDrive is left (SyC_ctPostDrvLeave))" UBYTE OneToOne 1 100 0.00 255.0 FORMAT "%5.1" ECU_ADDRESS 0x6000B752 /end MEASUREMENT
/begin MEASUREMENT FlMA_facFuEvapAddAdpnSpdRed "Factor to reduce the additive adaptation speed due to fuel evaporation from engine oil" UBYTE fak_ub_b2 1 100 0.007813 1.000000 FORMAT "%8.6" ECU_ADDRESS 0x6000F7C2 /end MEASUREMENT
/begin MEASUREMENT FlMA_facFuEvapMulAdpnSpdRed "Factor to reduce the multiplicative adaptation speed due to fuel evaporation from engine oil" UBYTE fak_ub_b2 1 100 0.007813 1.000000 FORMAT "%8.6" ECU_ADDRESS 0x6000F7C1 /end MEASUREMENT
/begin MEASUREMENT FlMA_facMulMixAdpnPCrrd "Corrected background calculation of multiplicative mixture correction in P-system(Pressure Sensor)" UWORD fak_uw_b2 1 100 0.00 1.999969 FORMAT "%8.6" ECU_ADDRESS 0x60039024 /end MEASUREMENT
/begin MEASUREMENT FlMA_facSubMulLamSnsrErr "Substitute multiplicative adaptation value when the lambda sensor error for mixture adaptation" UWORD fak_uw_b2 1 100 0.00 1.999969 FORMAT "%8.6" ECU_ADDRESS 0x600072F0 /end MEASUREMENT
/begin MEASUREMENT FlMA_flgAddlEnaCdn "Additional enable conditions of the fuel mixture adaptation fulfilled" UBYTE B_TRUE 1 100 0.00 1.00000000000 BIT_MASK 0x1 FORMAT "%13.11" ECU_ADDRESS 0x7000093E /end MEASUREMENT
/begin MEASUREMENT FlMA_flgBascEnaCdn "Basic enable conditions of the fuel mixture adaptation fulfilled" UBYTE B_TRUE 1 100 0.00 1.00000000000 BIT_MASK 0x1 FORMAT "%13.11" ECU_ADDRESS 0x7000093D /end MEASUREMENT
/begin MEASUREMENT FlMA_flgDsmClrFinshdAckd "DSM(Diagnostic System Management) Clear has been finished" UBYTE B_TRUE 1 100 0.00 1.00000000000 BIT_MASK 0x1 FORMAT "%13.11" ECU_ADDRESS 0x60036E06 /end MEASUREMENT
/begin MEASUREMENT FlMA_flgDSMClrFra "Condition clear request exists for multiplicative mixture adaptation faults on fault memory clear request." UBYTE B_TRUE 1 100 0.00 1.00000000000 BIT_MASK 0x1 FORMAT "%13.11" ECU_ADDRESS 0x7000093B /end MEASUREMENT
/begin MEASUREMENT FlMA_flgDSMClrLRA "Condition clearing fault memory for function LRA is active" UBYTE B_TRUE 1 100 0.00 1.00000000000 BIT_MASK 0x1 FORMAT "%13.11" ECU_ADDRESS 0x7000093A /end MEASUREMENT
/begin MEASUREMENT FlMA_flgDSMClrLRAEB "Condition clearing fault memory for function LRAEB(Conditions adaptive pilot control) is active" UBYTE B_TRUE 1 100 0.00 1.00000000000 BIT_MASK 0x1 FORMAT "%13.11" ECU_ADDRESS 0x70000939 /end MEASUREMENT
/begin MEASUREMENT FlMA_flgDSMClrLRAPHU "Condition clearing fault memory for function LRAPHU is active" UBYTE B_TRUE 1 100 0.00 1.00000000000 BIT_MASK 0x1 FORMAT "%13.11" ECU_ADDRESS 0x70000194 /end MEASUREMENT
/begin MEASUREMENT FlMA_flgDSMClrLRAProc1 "Flag to signify fault memory clear trigger request for current process" UBYTE B_TRUE 1 100 0.00 1.00000000000 BIT_MASK 0x1 FORMAT "%13.11" ECU_ADDRESS 0x70000938 /end MEASUREMENT
/begin MEASUREMENT FlMA_flgDSMClrOra "Condition clear request exists for additive mixture adaptation faults on fault memory clear request." UBYTE B_TRUE 1 100 0.00 1.00000000000 BIT_MASK 0x1 FORMAT "%13.11" ECU_ADDRESS 0x70000937 /end MEASUREMENT
/begin MEASUREMENT FlMA_flgDsmClrTrig "DSM(Diagnostic System Management) Clear has been triggered" UBYTE B_TRUE 1 100 0.00 1.00000000000 BIT_MASK 0x1 FORMAT "%13.11" ECU_ADDRESS 0x60036E05 /end MEASUREMENT
/begin MEASUREMENT FlMA_flgFncRqstMixAdpn "condition: requirement adaption close loop" UBYTE B_TRUE 1 100 0.00 1.00000000000 BIT_MASK 0x1 FORMAT "%13.11" ECU_ADDRESS 0x70000936 /end MEASUREMENT
/begin MEASUREMENT FlMA_flgIninFinshdAckd "Finish of the initialization acknowledged" UBYTE B_TRUE 1 100 0.00 1.00000000000 BIT_MASK 0x1 FORMAT "%13.11" ECU_ADDRESS 0x6000F684 /end MEASUREMENT
/begin MEASUREMENT FlMA_flgIninTrig "Initialization triggered" UBYTE B_TRUE 1 100 0.00 1.00000000000 BIT_MASK 0x1 FORMAT "%13.11" ECU_ADDRESS 0x70000932 /end MEASUREMENT
/begin MEASUREMENT FlMA_flgTEngEnaCdn "Enable temperature of the fuel mixture adaptation fulfilled" UBYTE B_TRUE 1 100 0.00 1.00000000000 BIT_MASK 0x1 FORMAT "%13.11" ECU_ADDRESS 0x70000931 /end MEASUREMENT
/begin MEASUREMENT FlMA_LraEbEnhdRdnOraActvFF_I.status "Enhanced readiness for additive correction of the mixture adaptation (ORA) current value of RS-FF(FlipFlop) / current value of RS-FF" UBYTE B_TRUE 1 100 0.00 1.00000000000 BIT_MASK 0x1 FORMAT "%13.11" ECU_ADDRESS 0x6000B74E /end MEASUREMENT
/begin MEASUREMENT FlMA_LraEbEnhdRdnOraDeltaVT_I.timeCounter "timer to obtain the delta velocity / Remaining time of the timer" UBYTE t_q0p2 1 100 0.00 51.00 FORMAT "%5.2" ECU_ADDRESS 0x6000B74D /end MEASUREMENT
/begin MEASUREMENT FlMA_LraEbEnhdRdnOraDisadFF_I.status "Enhanced readiness additive correction of the mixture adaptation (ORA) disabled current value of RS-FF(FlipFlop) / current value of RS-FF" UBYTE B_TRUE 1 100 0.00 1.00000000000 BIT_MASK 0x1 FORMAT "%13.11" ECU_ADDRESS 0x6000B74C /end MEASUREMENT
/begin MEASUREMENT FlMA_LraEbEnhdRdnOraMaxTONV_I.outbit "Delay to determine the timespan of enhanced readiness / return value" UBYTE B_TRUE 1 100 0.00 1.00000000000 BIT_MASK 0x1 FORMAT "%13.11" ECU_ADDRESS 0x600072D0 /end MEASUREMENT
/begin MEASUREMENT FlMA_LraEbEnhdRdnOraMaxTONV_I.time "Delay to determine the timespan of enhanced readiness / expired delay time" UWORD t_q0p2 1 100 0.00 13107.00 FORMAT "%8.2" ECU_ADDRESS 0x600072D2 /end MEASUREMENT
/begin MEASUREMENT FlMA_LraMulMixAdpnPCrrdLT_I.memory "Low pass filter pressure sensor based corrected multiplicative mixture adaptation / current lowpass value" ULONG fak_q4p6566Em10 1 100 0.00 1.999999999534339 FORMAT "%17.15" ECU_ADDRESS 0x5000185C /end MEASUREMENT
/begin MEASUREMENT FlMA_nEng "engine speed with low resolution" UBYTE nmot_ub_q40 1 100 0.00 10200. FORMAT "%5.0" ECU_ADDRESS 0x6000F7C0 /end MEASUREMENT
/begin MEASUREMENT FlMA_nEngLRes "Engine speed with low resolution" UBYTE nmot_ub_q40 1 100 0.00 10200. FORMAT "%5.0" ECU_ADDRESS 0x6000B751 /end MEASUREMENT
/begin MEASUREMENT FlMA_ratAddMixAdpnPCrrd "Corrected background calculation, additive mixture correction in the P system(Pressure Sensor)" SWORD rel_sw_b1536 1 100 -1536.000 1535.953 FORMAT "%8.3" ECU_ADDRESS 0x60039022 /end MEASUREMENT
/begin MEASUREMENT FlMA_ratDeltaAddAdpnPHFM "delta additive mixture correction between HFM(hot-film air-mass meter) and pressure sensor based system" SWORD rel_sw_b1536 1 100 -1536.000 1535.953 FORMAT "%8.3" ECU_ADDRESS 0x60039020 /end MEASUREMENT
/begin MEASUREMENT FlMA_ratLoadGrdt "Gradient of coordinated torque request for charge" SWORD rel_sw_b100 1 100 -100.0000 99.9969 FORMAT "%8.4" ECU_ADDRESS 0x600072EE /end MEASUREMENT
/begin MEASUREMENT FlMA_ratSubAddlLamSnsrErr "Substitute additive adaptation value when the lambda sensor error for mixture adaptation" SWORD rel_sw_b1536 1 100 -1536.000 1535.953 FORMAT "%8.3" ECU_ADDRESS 0x600072EC /end MEASUREMENT
/begin MEASUREMENT FlMA_tCEngDsStrt "Coolant temperature at engine output" UBYTE temp_ub_q0p75_o48 1 100 -48.0 143.3 FORMAT "%5.1" ECU_ADDRESS 0x6000B750 /end MEASUREMENT
/begin MEASUREMENT FlMA_tEngEna "Enable temperature of the fuel mixture adaptation" UBYTE temp_ub_q0p75_o48 1 100 -48.0 143.3 FORMAT "%5.1" ECU_ADDRESS 0x6000F7BF /end MEASUREMENT
/begin MEASUREMENT FlMA_tEnv "enviroment temperature Actual physical value" UBYTE temp_ub_q0p75_o48 1 100 -48.0 143.3 FORMAT "%5.1" ECU_ADDRESS 0x6000B74F /end MEASUREMENT
/begin MEASUREMENT FlSys_tFlHPSys "fuel temperature in the high pressure system" SWORD Temp_Cels 1 100 -273.140 3003.560 FORMAT "%8.3" ECU_ADDRESS 0x600014D4 /end MEASUREMENT
/begin MEASUREMENT FlSys_tFlLPSys "fuel temperature in the low pressure system" SWORD Temp_Cels 1 100 -273.140 3003.560 FORMAT "%8.3" ECU_ADDRESS 0x60000CBA /end MEASUREMENT
/begin MEASUREMENT forakl_msg "factor for reducing speed of learning ora(additive correction of mixture adaptation)" UBYTE fak_ub_b2 1 100 0.007813 1.000000 FORMAT "%8.6" ECU_ADDRESS 0x6000F734 /end MEASUREMENT
/begin MEASUREMENT fraildcy_w "multiplicative correction of the mixture adaptation (frai_w) from the last driving cycle" UWORD fak_uw_b2 1 100 0.00 1.999969 FORMAT "%8.6" ECU_ADDRESS 0x6003901E /end MEASUREMENT
/begin MEASUREMENT fraini_w_msg "multiplicative correction of the mixture adaptation at initialization" UWORD fak_uw_b2 1 100 0.00 1.999969 FORMAT "%8.6" ECU_ADDRESS 0x60039870 /end MEASUREMENT
/begin MEASUREMENT frai_w_msg "multiplicative correction of the mixture adaptation" UWORD fak_uw_b2 1 100 0.00 1.999969 FORMAT "%8.6" ECU_ADDRESS 0x60039872 /end MEASUREMENT
/begin MEASUREMENT frak_w_msg "integration speed integrator FRA_IK" UWORD q7p63Em5_DIV_s 1 100 0.00 4.999924 FORMAT "%8.6" ECU_ADDRESS 0x60008D6C /end MEASUREMENT
/begin MEASUREMENT framn_w "lower limit of multiplicative correction factor(fra_w)" UWORD fak_uw_b2 1 100 0.00 1.999969 FORMAT "%8.6" ECU_ADDRESS 0x60008D6A /end MEASUREMENT
/begin MEASUREMENT framx_w "upper limit of multiplicative correction factor(fra_w)" UWORD fak_uw_b2 1 100 0.00 1.999969 FORMAT "%8.6" ECU_ADDRESS 0x60008D68 /end MEASUREMENT
/begin MEASUREMENT fraw_w "multiplicative mixture adaptation factor in warm engine operation mode" UWORD fak_uw_b2 1 100 0.00 1.999969 FORMAT "%8.6" ECU_ADDRESS 0x600072EA /end MEASUREMENT
/begin MEASUREMENT fra_w_msg "multiplicative correction of the mixture adaptation (word)" UWORD fak_uw_b2 1 100 0.00 1.999969 FORMAT "%8.6" ECU_ADDRESS 0x50005F02 /end MEASUREMENT
/begin MEASUREMENT frmn_w_msg "lambda regulator output min." UWORD fak_uw_b2 1 100 0.00 1.999969 FORMAT "%8.6" ECU_ADDRESS 0x60014998 /end MEASUREMENT
/begin MEASUREMENT frmx_w_msg "Maximum limit for absolute control factor of lambda control without special conditions (e.g. enleanment protection)" UWORD fak_uw_b2 1 100 0.00 1.999969 FORMAT "%8.6" ECU_ADDRESS 0x60008D64 /end MEASUREMENT
/begin MEASUREMENT frm_w_msg "fast mean value of lambda control factor (word)" UWORD fak_uw_b2 1 100 0.00 1.999969 FORMAT "%8.6" ECU_ADDRESS 0x6000935C /end MEASUREMENT
/begin MEASUREMENT fr_w_msg "Lambda controller output (word)" UWORD fak_uw_b2 1 100 0.00 1.999969 FORMAT "%8.6" ECU_ADDRESS 0x50005EFE /end MEASUREMENT
/begin MEASUREMENT FuelT_t "Temperature of fuel" SWORD Temp_Cels 1 100 -273.140 3003.560 FORMAT "%8.3" ECU_ADDRESS 0x600014D2 /end MEASUREMENT
/begin MEASUREMENT FuelT_tHiP "fuel temperature in the high pressure system" SWORD Temp_Cels 1 100 -273.140 3003.560 FORMAT "%8.3" ECU_ADDRESS 0x60000CBE /end MEASUREMENT
/begin MEASUREMENT gangllrs_msg "gear information for idle speed determination" SBYTE dez 1 100 -128.0 127.0 FORMAT "%5.1" ECU_ADDRESS 0x6000F8A3 /end MEASUREMENT
/begin MEASUREMENT gangsist_llrnstat_loc "Current gear" SBYTE dez 1 100 -128.0 127.0 FORMAT "%5.1" ECU_ADDRESS 0x6000B756 /end MEASUREMENT
/begin MEASUREMENT HLSDem_nMinWoCat "idle speed setpoint without catalyst heating" SWORD nmot_sw_q0p5 1 100 -16384.00 16383.50 FORMAT "%8.2" ECU_ADDRESS 0x600098E6 /end MEASUREMENT
/begin MEASUREMENT HLSDem_nMinWoTraIntv "CAN - Adapter" SWORD nmot_sw_q0p5 1 100 -16384.00 16383.50 FORMAT "%8.2" ECU_ADDRESS 0x600098E4 /end MEASUREMENT
/begin MEASUREMENT HLSDem_nSetPLo "Effective steady-state idle speed" SWORD nmot_sw_q0p5 1 100 -16384.00 16383.50 FORMAT "%8.2" ECU_ADDRESS 0x50005DE8 /end MEASUREMENT
/begin MEASUREMENT HLSDem_nStatyEng "Stationary reference speed for V-engine" UBYTE nmot_ub_q10 1 100 0.00 2550. FORMAT "%5.0" ECU_ADDRESS 0x6000FC68 /end MEASUREMENT
/begin MEASUREMENT HLSDem_nStyFildIdle "Stationary reference speed filtered" SWORD nmot_sw_q0p5 1 100 -16384.00 16383.50 FORMAT "%8.2" ECU_ADDRESS 0x600098DE /end MEASUREMENT
/begin MEASUREMENT IMC_B1.a0lrs_w "IMC controller for continuous lambda control bank 1 / a0 parameter of discretized IMC lambda controller" UWORD t_q2p5Em4 1 100 0.00 16.38375 FORMAT "%8.5" ECU_ADDRESS 0x60000BE0 /end MEASUREMENT
/begin MEASUREMENT IMC_B1.b0lrs_w "IMC controller for continuous lambda control bank 1 / b0 parameter of discretized IMC lambda controller" UWORD t_q2p5Em4 1 100 0.00 16.38375 FORMAT "%8.5" ECU_ADDRESS 0x60000BE2 /end MEASUREMENT
/begin MEASUREMENT IMC_B1.dfr_w "IMC controller for continuous lambda control bank 1 / Delta lambda controller (factor)" SWORD fak_sw_b1 1 100 -1.000000 0.999969 FORMAT "%8.6" ECU_ADDRESS 0x60000BE6 /end MEASUREMENT
/begin MEASUREMENT IMC_B1.dfrpr_w "IMC controller for continuous lambda control bank 1 / Delta lambda controller; temporary value before test for enleanment protection" SWORD fak_sw_b1 1 100 -1.000000 0.999969 FORMAT "%8.6" ECU_ADDRESS 0x60000BEC /end MEASUREMENT
/begin MEASUREMENT IMC_B1.dlrs_w "IMC controller for continuous lambda control bank 1 / Delay time parameter of discretized IMC lambda controller" UWORD fak_uw_b2 1 100 0.00 1.999969 FORMAT "%8.6" ECU_ADDRESS 0x60000BEE /end MEASUREMENT
/begin MEASUREMENT IMC_B1.m1lrs_w "IMC controller for continuous lambda control bank 1 / m1 parameter of discretized IMC lambda controller" UWORD t_q2p5Em4 1 100 0.00 16.38375 FORMAT "%8.5" ECU_ADDRESS 0x60000BF0 /end MEASUREMENT
/begin MEASUREMENT IMC_B1.n0lrs_w "IMC controller for continuous lambda control bank 1 / n0 parameter of discretized IMC lambda controller" UWORD t_q2p5Em4 1 100 0.00 16.38375 FORMAT "%8.5" ECU_ADDRESS 0x60000BF2 /end MEASUREMENT
/begin MEASUREMENT IMC_B1.planto_w "IMC controller for continuous lambda control bank 1 / Output of plant model" SWORD fak_sw_b1 1 100 -1.000000 0.999969 FORMAT "%8.6" ECU_ADDRESS 0x60000BF4 /end MEASUREMENT
/begin MEASUREMENT IMC_B1.r1lrs_w "IMC controller for continuous lambda control bank 1 / r1 parameter of discretized IMC lambda controller" UWORD t_q2p5Em4 1 100 0.00 16.38375 FORMAT "%8.5" ECU_ADDRESS 0x60000BF8 /end MEASUREMENT
/begin MEASUREMENT IMC_B1.s0lrs_w "IMC controller for continuous lambda control bank 1 / s0 parameter of discretized IMC lambda controller" UWORD t_q2p5Em4 1 100 0.00 16.38375 FORMAT "%8.5" ECU_ADDRESS 0x60000BFA /end MEASUREMENT
/begin MEASUREMENT IMC_B1.s1lrs_w "IMC controller for continuous lambda control bank 1 / s1 parameter of discretized IMC lambda controller" SWORD t_q2p5Em4 1 100 -8.192000 0.00 FORMAT "%8.6" ECU_ADDRESS 0x60000BFC /end MEASUREMENT
/begin MEASUREMENT IMC_B1.LRScl_DelayTime_ds_opt.buffer "IMC controller for continuous lambda control bank 1 / Delay time element of IMC lambda controller / buffer" SWORD fak_sw_b1 1 100 -1.000000 0.999969 FORMAT "%8.6" ARRAY_SIZE 50 ECU_ADDRESS 0x60000BFE /end MEASUREMENT
/begin MEASUREMENT IMC_B1.LRScl_DelayTime_ds_opt.counter "IMC controller for continuous lambda control bank 1 / Delay time element of IMC lambda controller / counter" UWORD fak_uw_b2 1 100 0.00 1.999969 FORMAT "%8.6" ECU_ADDRESS 0x60000C62 /end MEASUREMENT
/begin MEASUREMENT IMC_B1.LRScl_DelayTime_ds_opt.out_val "IMC controller for continuous lambda control bank 1 / Delay time element of IMC lambda controller / out_val" SWORD fak_sw_b1 1 100 -1.000000 0.999969 FORMAT "%8.6" ECU_ADDRESS 0x60000C64 /end MEASUREMENT
/begin MEASUREMENT IMC_B1.LRScl_DelayTime_ds_opt.pointer "IMC controller for continuous lambda control bank 1 / Delay time element of IMC lambda controller / pointer" UBYTE dez 1 100 0.00 255.0 FORMAT "%5.1" ECU_ADDRESS 0x60000C66 /end MEASUREMENT
/begin MEASUREMENT IMC_B1.LRScl_DelayTime_ds_opt.pointerIni "IMC controller for continuous lambda control bank 1 / Delay time element of IMC lambda controller / pointerIni" UBYTE dez 1 100 0.00 255.0 FORMAT "%5.1" ECU_ADDRESS 0x60000C67 /end MEASUREMENT
/begin MEASUREMENT imlraa_w "air mass since engine start for forced activation of fuel mixture adaptation" UWORD m_q1p7778Em3_kg 1 100 0.00 116.5067 FORMAT "%8.4" ECU_ADDRESS 0x600072DA /end MEASUREMENT
/begin MEASUREMENT InjSys_bStrtFlHP "Condition start with high fuel pressure" UBYTE B_TRUE 1 100 0.00 1.00000000000 BIT_MASK 0x1 FORMAT "%13.11" ECU_ADDRESS 0x600001B0 /end MEASUREMENT
/begin MEASUREMENT InjSys_cylBnk0 "InjSyG Local variable for cylinder allocation to exhaust bank 0" UBYTE dez 1 100 0.00 255.0 FORMAT "%5.1" ECU_ADDRESS 0x7000217C /end MEASUREMENT
/begin MEASUREMENT InjSys_sumBnk0 "InjSyG Local variable for Sum formation injection factor for Bank 0" ULONG fak_uw_b2 1 100 0.00 131071.999969 FORMAT "%13.6" ECU_ADDRESS 0x70002178 /end MEASUREMENT
/begin MEASUREMENT InjSys_sumBnk1 "InjSyG Local variable for Sum formation injection factor for Bank 1" ULONG fak_uw_b2 1 100 0.00 131071.999969 FORMAT "%13.6" ECU_ADDRESS 0x70002174 /end MEASUREMENT
/begin MEASUREMENT ladiff_w_msg "control error continuous lambda control" SWORD fak_sw_b1 1 100 -1.000000 0.999969 FORMAT "%8.6" ECU_ADDRESS 0x600095DC /end MEASUREMENT
/begin MEASUREMENT LamCtrl_facCtrlDeltaEnlnmtProtB1 "Lambda control factor (delta) for enleanment protection (bank 1)" SWORD fak_sw_b1 1 100 -1.000000 0.999969 FORMAT "%8.6" ECU_ADDRESS 0x60000EEC /end MEASUREMENT
/begin MEASUREMENT LamCtrl_facCtrlDeltaLimCtrlB1 "Upper and lower limit (delta) of manipulated variable of lambda control during limit control (bank 1)" SWORD fak_sw_b1 1 100 -1.000000 0.999969 FORMAT "%8.6" ECU_ADDRESS 0x60000EEA /end MEASUREMENT
/begin MEASUREMENT LamCtrl_facCtrlDeltaMaxEnlnmtProtB1 "Maximum limit for delta control factor of lambda control during enleanment protection depending on current delta control factor, bank 1" SWORD fak_sw_b1 1 100 -1.000000 0.999969 FORMAT "%8.6" ECU_ADDRESS 0x60000EE8 /end MEASUREMENT
/begin MEASUREMENT LamCtrl_facSpltCmprn "split factor compression stroke injections" UBYTE fak_ub_b1 1 100 0.00 0.9961 ECU_ADDRESS 0x60000EE7 /end MEASUREMENT
/begin MEASUREMENT LamCtrl_facVBasB1 "Base value for controller velocity (bank 1)" UBYTE fak_q0p01 1 100 0.00 2.550 FORMAT "%5.3" ECU_ADDRESS 0x60000EE6 /end MEASUREMENT
/begin MEASUREMENT LamCtrl_facVDlyAdpnB1 "Factor for lambda controller velocity at adapted delay time (bank 1)" UBYTE fak_ub_b2 1 100 0.00 1.992188 FORMAT "%8.6" ECU_ADDRESS 0x60000EE5 /end MEASUREMENT
/begin MEASUREMENT LamCtrl_facVTranAdpnB1 "Factor for lambda controller velocity at adapted transition time (bank 1)" UBYTE fak_ub_b2 1 100 0.00 1.992188 FORMAT "%8.6" ECU_ADDRESS 0x60000EE4 /end MEASUREMENT
/begin MEASUREMENT LamCtrl_flgEnlnmtProtActvB1 "Enleanment protection for continuous lambda control active, bank 1" UBYTE B_TRUE 1 100 0.00 1.00000000000 BIT_MASK 0x1 FORMAT "%13.11" ECU_ADDRESS 0x70000820 /end MEASUREMENT
/begin MEASUREMENT LamCtrl_flgHotStrt "Hot start detected" UBYTE B_TRUE 1 100 0.00 1.00000000000 BIT_MASK 0x1 FORMAT "%13.11" ECU_ADDRESS 0x60000EC4 /end MEASUREMENT
/begin MEASUREMENT LamCtrl_flgLamBlwMinB1 "Lambda (measured and setpoint) below minimal measurable lambda, bank 1" UBYTE B_TRUE 1 100 0.00 1.00000000000 BIT_MASK 0x1 FORMAT "%13.11" ECU_ADDRESS 0x6000F930 /end MEASUREMENT
/begin MEASUREMENT LamCtrl_flgLamMeasBlwMinB1 "Lambda (measured) below minimal measurable lambda (bank 1)" UBYTE B_TRUE 1 100 0.00 1.00000000000 BIT_MASK 0x1 FORMAT "%13.11" ECU_ADDRESS 0x600000D1 /end MEASUREMENT
/begin MEASUREMENT LamCtrl_flgLamSpBlwMinB1 "Lambda (setpoint) below minimal measurable lambda (bank 1)" UBYTE B_TRUE 1 100 0.00 1.00000000000 BIT_MASK 0x1 FORMAT "%13.11" ECU_ADDRESS 0x600000D0 /end MEASUREMENT
/begin MEASUREMENT LamCtrl_flgRdnRstEnlnmtProtnB1 "Readiness for reset at enleanment protection (bank 1)" UBYTE B_TRUE 1 100 0.00 1.00000000000 BIT_MASK 0x1 FORMAT "%13.11" ECU_ADDRESS 0x600000CF /end MEASUREMENT
/begin MEASUREMENT LamCtrl_LimCtrlB1RMP_I.Memory "instance lambda ramp, bank 1 / memory element" SLONG fak_sw_b1 1 100 -65536.0000000 65535.9999695 FORMAT "%13.7" ECU_ADDRESS 0x50000F50 /end MEASUREMENT
/begin MEASUREMENT LamCtrl_LrgVlvLftER_I.buffer "Rising edge on switching intake valve lift (large lift) / rising edge detected" UBYTE B_TRUE 1 100 0.00 1.00000000000 BIT_MASK 0x1 FORMAT "%13.11" ECU_ADDRESS 0x60000EB2 /end MEASUREMENT
/begin MEASUREMENT LamCtrl_LrgVlvLftER_I.oldSignal "Rising edge on switching intake valve lift (large lift) / flag rising edge" UBYTE B_TRUE 1 100 0.00 1.00000000000 BIT_MASK 0x1 FORMAT "%13.11" ECU_ADDRESS 0x60000EB3 /end MEASUREMENT
/begin MEASUREMENT LamCtrl_LrgVlvLftTOFV_I.outbit "Turn-off delay after switching to large intake valve lift / Output Bit" UBYTE B_TRUE 1 100 0.00 1.00000000000 BIT_MASK 0x1 FORMAT "%13.11" ECU_ADDRESS 0x50000F54 /end MEASUREMENT
/begin MEASUREMENT LamCtrl_LrgVlvLftTOFV_I.time "Turn-off delay after switching to large intake valve lift / Occured Time" UWORD t_q0p01 1 100 0.00 655.3500 FORMAT "%8.4" ECU_ADDRESS 0x50000F56 /end MEASUREMENT
/begin MEASUREMENT LamCtrl_mAirEnaStrtEndIK_I.memory "Air mass after start end to enable controller / current integrator value" ULONG m_q4p239Em7_g 1 100 0.00 1820.44907366 FORMAT "%13.8" ECU_ADDRESS 0x50000F58 /end MEASUREMENT
/begin MEASUREMENT LamCtrl_mAirEnaWrmUpThd "Current air mass threshold to enable controller during warm-up after" UWORD m_q0p0277_g 1 100 0.00 1820.417 FORMAT "%8.3" ECU_ADDRESS 0x60000EC2 /end MEASUREMENT
/begin MEASUREMENT LamCtrl_mfExhB1 "mass flow exhaust gas (bank 1)" UWORD m_uw_b6553p5 1 100 0.00 6553.500 FORMAT "%8.3" ECU_ADDRESS 0x60000EE2 /end MEASUREMENT
/begin MEASUREMENT LamCtrl_nEngLResLRS "Engine speed with low resolution (in FC LRS)" UBYTE nmot_ub_q40 1 100 0.00 10200. FORMAT "%5.0" ECU_ADDRESS 0x60000EE0 /end MEASUREMENT
/begin MEASUREMENT LamCtrl_nEngLRS "Engine speed" SWORD EngN 1 100 -16384.00 16383.50 FORMAT "%8.2" ECU_ADDRESS 0x60000EDE /end MEASUREMENT
/begin MEASUREMENT LamCtrl_ratDlyTiB1 "Ratio of base delay time and delay time with dynamics adaptation for lambda control plant model, bank 1" UWORD t_q0p01 1 100 0.00 655.3500 FORMAT "%8.4" ECU_ADDRESS 0x60000EDC /end MEASUREMENT
/begin MEASUREMENT LamCtrl_ratFillgLRS "Relative air charge (in FC LRS)" UWORD rel_uw_q0p0234 1 100 0.00 1535.977 FORMAT "%8.3" ECU_ADDRESS 0x60000EDA /end MEASUREMENT
/begin MEASUREMENT LamCtrl_ratFillgLRSEB "Relative air charge (in FC LRSEB)" UWORD rel_uw_q0p0234 1 100 0.00 1535.977 FORMAT "%8.3" ECU_ADDRESS 0x60000CA0 /end MEASUREMENT
/begin MEASUREMENT LamCtrl_ratLamDifPrelB1 "Control difference in lambda or reciprocal lambda (always calculated preliminary value), bank 1" SWORD fak_sw_b1 1 100 -1.000000 0.999969 FORMAT "%8.6" ECU_ADDRESS 0x6000989E /end MEASUREMENT
/begin MEASUREMENT LamCtrl_ratTranTiB1 "Ratio of transition times (bank 1)" UWORD t_q0p01 1 100 0.00 655.3500 FORMAT "%8.4" ECU_ADDRESS 0x60000ED8 /end MEASUREMENT
/begin MEASUREMENT LamCtrl_SmlVlvLftEF_I.buffer "Falling edge on switching intake valve lift (small lift) / memory to detect falling edge" UBYTE B_TRUE 1 100 0.00 1.00000000000 BIT_MASK 0x1 FORMAT "%13.11" ECU_ADDRESS 0x60000EB0 /end MEASUREMENT
/begin MEASUREMENT LamCtrl_SmlVlvLftEF_I.oldSignal "Falling edge on switching intake valve lift (small lift) / memory to detect falling edge" UBYTE B_TRUE 1 100 0.00 1.00000000000 BIT_MASK 0x1 FORMAT "%13.11" ECU_ADDRESS 0x60000EB1 /end MEASUREMENT
/begin MEASUREMENT LamCtrl_SmlVlvLftTOFV_I.outbit "Turn-off delay after switching to small intake valve lift / Output Bit" UBYTE B_TRUE 1 100 0.00 1.00000000000 BIT_MASK 0x1 FORMAT "%13.11" ECU_ADDRESS 0x60000EAC /end MEASUREMENT
/begin MEASUREMENT LamCtrl_SmlVlvLftTOFV_I.time "Turn-off delay after switching to small intake valve lift / Occured Time" UWORD t_q0p01 1 100 0.00 655.3500 FORMAT "%8.4" ECU_ADDRESS 0x60000EAE /end MEASUREMENT
/begin MEASUREMENT LamCtrl_tCEngDs "Coolant temperature at engine output" UBYTE temp_ub_q0p75_o48 1 100 -48.0 143.3 FORMAT "%5.1" ECU_ADDRESS 0x60000ED6 /end MEASUREMENT
/begin MEASUREMENT LamCtrl_tEngEnlnmt "Engine temperature (for enleanment protection in FC LRSEB)" UBYTE temp_ub_q0p75_o48 1 100 -48.0 143.3 FORMAT "%5.1" ECU_ADDRESS 0x60000D42 /end MEASUREMENT
/begin MEASUREMENT LamCtrl_tEngStrtWrmUp "Engine temperature at start (for warm-up phase in FC LRSEB)" UBYTE temp_ub_q0p75_o48 1 100 -48.0 143.3 FORMAT "%5.1" ECU_ADDRESS 0x60000EC0 /end MEASUREMENT
/begin MEASUREMENT LamCtrl_tiAdpnMaxS1B1 "Maximal adapted delay or tranisition time (sensor 1, bank 1)" UWORD t_q0p01 1 100 0.00 655.3500 FORMAT "%8.4" ECU_ADDRESS 0x60000ED4 /end MEASUREMENT
/begin MEASUREMENT LamCtrl_tiAftStrtEnd "time after end of start" UWORD t_q0p01 1 100 0.00 655.3500 FORMAT "%8.4" ECU_ADDRESS 0x60000ED2 /end MEASUREMENT
/begin MEASUREMENT LamCtrl_tiTurnOffDlyA "Actual turn-off delay for enleanment protection after acceleration enrichment" UWORD t_q0p01 1 100 0.00 655.3500 FORMAT "%8.4" ECU_ADDRESS 0x60008DFE /end MEASUREMENT
/begin MEASUREMENT LamCtrl_tiTurnOffDlyDecel "Actual turn-off delay for enleanment protection after deceleration enleanment" UWORD t_q0p01 1 100 0.00 655.3500 FORMAT "%8.4" ECU_ADDRESS 0x60008DFC /end MEASUREMENT
/begin MEASUREMENT LAMSONS_TONV.outbit "variable existing only due to software reason / return value" UBYTE B_TRUE 1 100 0.00 1.00000000000 BIT_MASK 0x1 FORMAT "%13.11" ECU_ADDRESS 0x600072CC /end MEASUREMENT
/begin MEASUREMENT LAMSONS_TONV.time "variable existing only due to software reason / expired delay time" UWORD t_q0p2 1 100 0.00 13107.00 FORMAT "%8.2" ECU_ADDRESS 0x600072CE /end MEASUREMENT
/begin MEASUREMENT lamssok_w_msg "Lambda setpoint for sensor after addition of trim control action" UWORD fak_uw_b16 1 100 0.00 15.99976 FORMAT "%8.5" ECU_ADDRESS 0x600149A6 /end MEASUREMENT
/begin MEASUREMENT lamtmef_w "measured time of operation below the lambda interval (LAMGAMN resp. LAMGAFVMN) for mixture adaptation" UWORD t_q0p2 1 100 0.00 13107.00 FORMAT "%8.2" ECU_ADDRESS 0x600072D8 /end MEASUREMENT
/begin MEASUREMENT lamtmem_w "measured time of operation above the lambda interval (LAMGAMX) for mixture adaptation" UWORD t_q0p2 1 100 0.00 13107.00 FORMAT "%8.2" ECU_ADDRESS 0x600072D6 /end MEASUREMENT
/begin MEASUREMENT lamzak_w_msg "measured lambda value corrected by external signal" UWORD fak_uw_b16 1 100 0.00 15.99976 FORMAT "%8.5" ECU_ADDRESS 0x60009346 /end MEASUREMENT
/begin MEASUREMENT lft1_w "long term fuel trim bank1" UWORD fak_uw_b2 1 100 0.00 1.999969 FORMAT "%8.6" ECU_ADDRESS 0x600072E4 /end MEASUREMENT
/begin MEASUREMENT LLRNSTAT_nBascIdlSpdSp "Basic idle speed setpoint after limitation by the minimum setpoint" SWORD nmot_sw_q0p5 1 100 -16384.00 16383.50 FORMAT "%8.2" ECU_ADDRESS 0x600072FA /end MEASUREMENT
/begin MEASUREMENT LLRNSTAT_nMinBascSpLo "Basic setpoint exported for reference in NSREQ" SWORD nmot_sw_q0p5 1 100 -16384.00 16383.50 FORMAT "%8.2" ECU_ADDRESS 0x600098AC /end MEASUREMENT
/begin MEASUREMENT longft1_w_msg "long term fuel trim bank1" UWORD fak_uw_b2 1 100 0.00 1.999969 FORMAT "%8.6" ECU_ADDRESS 0x60008D56 /end MEASUREMENT
/begin MEASUREMENT lrdtwl_w "Turn-on delay of lambda control at warm-up" UWORD t_q0p1 1 100 0.00 6553.500 FORMAT "%8.3" ECU_ADDRESS 0x60000EBE /end MEASUREMENT
/begin MEASUREMENT lrssig_msg "Controller bandwidth of closed loop lambda control upstream catalyst" UBYTE fak_q0p01 1 100 0.010 2.550 FORMAT "%5.3" ECU_ADDRESS 0x60014AEF /end MEASUREMENT
/begin MEASUREMENT LsComp_bLossCmpActvd "State of compensation of the switchable losses (False=OFF, True=ON)" UBYTE B_TRUE 1 100 0.00 1.00000000000 BIT_MASK 0x1 FORMAT "%13.11" ECU_ADDRESS 0x6000F92D /end MEASUREMENT
/begin MEASUREMENT LsComp_facCmpNoFlt "Compensation factor for loss compensation minus factor one" SWORD Fact 1 100 -1.000000 1.000000 FORMAT "%8.6" ECU_ADDRESS 0x600072C4 /end MEASUREMENT
/begin MEASUREMENT LsComp_tqCmpActvSpdGovr "Part of compensated torque during active speed governor" SWORD Trq 1 100 -3276.800 3276.700 FORMAT "%8.3" ECU_ADDRESS 0x6000989C /end MEASUREMENT
/begin MEASUREMENT LsComp_tqConvLd "Gradient of torque load from the converter" SWORD Trq 1 100 -3276.800 3276.700 FORMAT "%8.3" ECU_ADDRESS 0x600072C2 /end MEASUREMENT
/begin MEASUREMENT LsComp_tqDesCmpDt1 "Filtered value of desired compensation which will not be send throu ASD filter" SWORD Trq 1 100 -3276.800 3276.700 FORMAT "%8.3" ECU_ADDRESS 0x600072C0 /end MEASUREMENT
/begin MEASUREMENT LsComp_tqResv "Torque reserve for accessories" SWORD Trq 1 100 -3276.800 3276.700 FORMAT "%8.3" ECU_ADDRESS 0x6000989A /end MEASUREMENT
/begin MEASUREMENT LsComp_tqSwilLossNotFild "Torque part of Switchable losses that has to bypass the ASD filter." SWORD Trq 1 100 -3276.800 3276.700 FORMAT "%8.3" ECU_ADDRESS 0x60009898 /end MEASUREMENT
/begin MEASUREMENT mdeemodfg "requests for reduction stages - release conditions" UBYTE dez 1 100 0.00 255.0 FORMAT "%5.1" ECU_ADDRESS 0x6000091E /end MEASUREMENT
/begin MEASUREMENT mdistratzz "Ramp-up factor for actual engine torque during start" UBYTE fak_ub_b2 1 100 0.00 1.992188 FORMAT "%8.6" ECU_ADDRESS 0x6000B74B /end MEASUREMENT
/begin MEASUREMENT mdns_w_msg "torque after start" UWORD rel_uw_b100 1 100 0.00 99.99847 FORMAT "%8.5" ECU_ADDRESS 0x6000933E /end MEASUREMENT
/begin MEASUREMENT mdsh_w_msg "altitude compensation of drag torque" SWORD rel_sw_b50 1 100 -50.00000 49.99847 FORMAT "%8.5" ECU_ADDRESS 0x600095DA /end MEASUREMENT
/begin MEASUREMENT mdslw_w_msg "torque loss: charge exchange" UWORD rel_uw_b100 1 100 0.00 99.99847 FORMAT "%8.5" ECU_ADDRESS 0x700053F8 /end MEASUREMENT
/begin MEASUREMENT mdsmn_w "engine loss without pumping work" UWORD rel_uw_b100 1 100 0.00 99.99847 FORMAT "%8.5" ECU_ADDRESS 0x700052CA /end MEASUREMENT
/begin MEASUREMENT mdssta_w_msg "Engine-temperature-dependent component after start-up for drag torque" UWORD rel_uw_b100 1 100 0.00 99.99847 FORMAT "%8.5" ECU_ADDRESS 0x6000933C /end MEASUREMENT
/begin MEASUREMENT mds_w_msg "engine drag torque" UWORD rel_uw_b100 1 100 0.00 99.99847 FORMAT "%8.5" ECU_ADDRESS 0x700053F6 /end MEASUREMENT
/begin MEASUREMENT MED2FSS_bdummy "Dummy variable in MED2FSS to avoid compiler warning" UBYTE B_TRUE 1 100 0.00 1.00000000000 BIT_MASK 0x1 FORMAT "%13.11" ECU_ADDRESS 0x600000CB /end MEASUREMENT
/begin MEASUREMENT mfdd_bsetdata "Condition : Pulse train data updated in NORMAL mode." UBYTE dez 1 100 0.00 255.0 FORMAT "%5.1" ECU_ADDRESS 0x6000B746 /end MEASUREMENT
/begin MEASUREMENT mfdd_durpwm "duration of PWM phase" UWORD t_q0p001_ms 1 100 0.00 65.53500 FORMAT "%8.5" ECU_ADDRESS 0x600072AE /end MEASUREMENT
/begin MEASUREMENT MfDD_nEng "Engine Speed in FC MfDD" UWORD EngN 1 100 0.00 32767.50 FORMAT "%8.2" ECU_ADDRESS 0x600072B0 /end MEASUREMENT
/begin MEASUREMENT MfDD_numFadeOut "number of faded out actuations at Hot Temperature Low Speed Actuation" UBYTE dez 1 100 0.00 255.0 FORMAT "%5.1" ECU_ADDRESS 0x6000B745 /end MEASUREMENT
/begin MEASUREMENT MfDD_phiDur "Duration of the Activation" UWORD kw_q0p1 1 100 0.00 6553.500 FORMAT "%8.3" ARRAY_SIZE 1 ECU_ADDRESS 0x600072A6 /end MEASUREMENT
/begin MEASUREMENT MfDD_tiTV1Length "Duration of duty cycle 1 phase" UWORD t_q0p001_ms 1 100 0.00 65.53500 FORMAT "%8.5" ARRAY_SIZE 1 ECU_ADDRESS 0x600072A4 /end MEASUREMENT
/begin MEASUREMENT MFVlv_agTdcPmp1 "Angle TDC of the first pump" UWORD kw_q0p1 1 100 0.00 6553.500 FORMAT "%8.3" ARRAY_SIZE 4 ECU_ADDRESS 0x60009408 /end MEASUREMENT
/begin MEASUREMENT MfVlv_NrCamsftReal "Number of cams that is used to control the high pressure pump (HDP)" UBYTE dez 1 100 0.00 255.0 FORMAT "%5.1" ECU_ADDRESS 0x6000FBE5 /end MEASUREMENT
/begin MEASUREMENT mibas_w_msg "indicated basic torque" UWORD rel_uw_b100 1 100 0.00 99.99847 FORMAT "%8.5" ECU_ADDRESS 0x600007D0 /end MEASUREMENT
/begin MEASUREMENT mibminm_w_msg "average internal base torque, lower limit for given mode" UWORD rel_uw_b100 1 100 0.00 99.99847 FORMAT "%8.5" ECU_ADDRESS 0x500008E2 /end MEASUREMENT
/begin MEASUREMENT mibmn_w_msg "internal base torque, lower limit for given mode" UWORD rel_uw_b100 1 100 0.00 99.99847 FORMAT "%8.5" ECU_ADDRESS 0x600007D4 /end MEASUREMENT
/begin MEASUREMENT mibmx_w_msg "internal base torque, upper limit for given mode" UWORD rel_uw_b100 1 100 0.00 99.99847 FORMAT "%8.5" ECU_ADDRESS 0x600007D8 /end MEASUREMENT
/begin MEASUREMENT miistz_w "Indicated engine torque high pressure phase, cylinder individual (actual value)" UWORD rel_uw_b100 1 100 0.00 99.99847 FORMAT "%8.5" ECU_ADDRESS 0x600007DC /end MEASUREMENT
/begin MEASUREMENT miist_w_msg "indicated real engine torque" UWORD rel_uw_b100 1 100 0.00 99.99847 FORMAT "%8.5" ECU_ADDRESS 0x60009338 /end MEASUREMENT
/begin MEASUREMENT milshfra_w_msg "upper milsol(coordinated torque request for charge)threshold for learning range multiplicative mixture adaptation factor (FRA)" UWORD rel_uw_b100 1 100 0.00 99.99847 FORMAT "%8.5" ECU_ADDRESS 0x60008D54 /end MEASUREMENT
/begin MEASUREMENT milshora_w_msg "upper milsol(coordinated torque request for charge)threshold for learning range additive correction of the mixture adaptation (ORA)" UWORD rel_uw_b100 1 100 0.00 99.99847 FORMAT "%8.5" ECU_ADDRESS 0x60008D52 /end MEASUREMENT
/begin MEASUREMENT milslfra_w_msg "lower milsol(coordinated torque request for charge)threshold for learning range multiplicative mixture adaptation factor (FRA)" UWORD rel_uw_b100 1 100 0.00 99.99847 FORMAT "%8.5" ECU_ADDRESS 0x60008D50 /end MEASUREMENT
/begin MEASUREMENT milslora_w_msg "lower milsol(coordinated torque request for charge)threshold for learning range additive correction of the mixture adaptation (ORA)" UWORD rel_uw_b100 1 100 0.00 99.99847 FORMAT "%8.5" ECU_ADDRESS 0x60008D4E /end MEASUREMENT
/begin MEASUREMENT milsolg_w "gradient of coordinated torque request for charge" UWORD rel_uw_b100 1 100 0.00 99.99847 FORMAT "%8.5" ECU_ADDRESS 0x600072E8 /end MEASUREMENT
/begin MEASUREMENT mimaxa_w_msg "maximum, currently attainable indicated torque" UWORD rel_uw_b100 1 100 0.00 99.99847 FORMAT "%8.5" ECU_ADDRESS 0x60009332 /end MEASUREMENT
/begin MEASUREMENT mimaxud_w_msg "maximum attainable relative inner torque for increase of inlet manifold pressure to current pressure upstream throttle" UWORD rel_uw_b100 1 100 0.00 99.99847 FORMAT "%8.5" ECU_ADDRESS 0x6000932E /end MEASUREMENT
/begin MEASUREMENT mimax_w_msg "maximum attainable indicated torque" UWORD rel_uw_b100 1 100 0.00 99.99847 FORMAT "%8.5" ECU_ADDRESS 0x60009334 /end MEASUREMENT
/begin MEASUREMENT mioptl1h_w_msg "optimal torque at lambda = 1 homogeneous mode" UWORD rel_uw_b100 1 100 0.00 99.99847 FORMAT "%8.5" ECU_ADDRESS 0x500008EC /end MEASUREMENT
/begin MEASUREMENT miopt_w_msg "optimum indicated torque" UWORD rel_uw_b100 1 100 0.00 99.99847 FORMAT "%8.5" ECU_ADDRESS 0x500008EA /end MEASUREMENT
/begin MEASUREMENT nllmgfsglb_msg "desired idle speed in Drive-mode" UBYTE nmot_ub_q10 1 100 0.00 2550. FORMAT "%5.0" ECU_ADDRESS 0x6000F729 /end MEASUREMENT
/begin MEASUREMENT nllmgglb_msg "desired idle speed" UBYTE nmot_ub_q10 1 100 0.00 2550. FORMAT "%5.0" ECU_ADDRESS 0x6000F728 /end MEASUREMENT
/begin MEASUREMENT nmotg "engine speed gradient" UBYTE nmot_ub_q40 1 100 0.00 10200. FORMAT "%5.0" ECU_ADDRESS 0x6000B754 /end MEASUREMENT
/begin MEASUREMENT nsolbas_msg "desired idle speed, basic value" UBYTE nmot_ub_q10 1 100 0.00 2550. FORMAT "%5.0" ECU_ADDRESS 0x6000FB37 /end MEASUREMENT
/begin MEASUREMENT nstat2_w "stationary desired idle-speed after limitation" SWORD nmot_sw_q0p5 1 100 -16384.00 16383.50 FORMAT "%8.2" ECU_ADDRESS 0x600072F8 /end MEASUREMENT
/begin MEASUREMENT nstat3 "Stationary desired idle-speed pre filter" UBYTE nmot_ub_q10 1 100 0.00 2550. FORMAT "%5.0" ECU_ADDRESS 0x6000B758 /end MEASUREMENT
/begin MEASUREMENT nstateng "Stationary reference speed for V-engine" UBYTE nmot_ub_q10 1 100 0.00 2550. FORMAT "%5.0" ECU_ADDRESS 0x6000B757 /end MEASUREMENT
/begin MEASUREMENT nstateng_w "Stationary reference speed for V-engine" SWORD nmot_sw_q0p5 1 100 -16384.00 16383.50 FORMAT "%8.2" ECU_ADDRESS 0x600072F6 /end MEASUREMENT
/begin MEASUREMENT nstatfil_msg "Stationary reference speed filtered" UBYTE nmot_ub_q10 1 100 0.00 2550. FORMAT "%5.0" ECU_ADDRESS 0x6000FB30 /end MEASUREMENT
/begin MEASUREMENT nstatLoc "local variable for nstat" SWORD nmot_sw_q0p5 1 100 -16384.00 16383.50 FORMAT "%8.2" ECU_ADDRESS 0x600072F4 /end MEASUREMENT
/begin MEASUREMENT orahini_w_msg "additive correction of the mixture adaptation for HFM(Hot Film Meter) system at initialization" SWORD rel_sw_b1536 1 100 -1536.000 1535.953 FORMAT "%8.3" ECU_ADDRESS 0x600398A4 /end MEASUREMENT
/begin MEASUREMENT orah_w_msg "additive correction of the mixture adaptation for HFM(Hot Film Meter) system" SWORD rel_sw_b1536 1 100 -1536.000 1535.953 FORMAT "%8.3" ECU_ADDRESS 0x600398A6 /end MEASUREMENT
/begin MEASUREMENT orai_w_msg "additive correction of the mixture adaptation" SWORD rel_sw_b1536 1 100 -1536.000 1535.953 FORMAT "%8.3" ECU_ADDRESS 0x60008FB0 /end MEASUREMENT
/begin MEASUREMENT orak_w_msg "integration speed integrator ORA_IK" UWORD q0p0586_pc_DIV_s 1 100 0.00 3839.941 FORMAT "%8.3" ECU_ADDRESS 0x60008D34 /end MEASUREMENT
/begin MEASUREMENT oramn_w "lower limit of additive correction factor(ora_w)" SWORD rel_sw_b1536 1 100 -1536.000 1535.953 FORMAT "%8.3" ECU_ADDRESS 0x60008FAE /end MEASUREMENT
/begin MEASUREMENT oramx_w "upper limit of additive correction factor(ora_w) ." SWORD rel_sw_b1536 1 100 -1536.000 1535.953 FORMAT "%8.3" ECU_ADDRESS 0x60008FAC /end MEASUREMENT
/begin MEASUREMENT orapini_w_msg "additive correction of the mixture adaptation (Pressure sensor based system) at initialization" SWORD rel_sw_b1536 1 100 -1536.000 1535.953 FORMAT "%8.3" ECU_ADDRESS 0x600398A0 /end MEASUREMENT
/begin MEASUREMENT orapkh_w_msg "copy of additive correction of the mixture adaptation (pressure sensor based system) (orap_w) at low and medium Engine temperature (tans)" SWORD rel_sw_b1536 1 100 -1536.000 1535.953 FORMAT "%8.3" ECU_ADDRESS 0x6003989E /end MEASUREMENT
/begin MEASUREMENT orap_w_msg "additive correction of the mixture adaptation (pressure sensor based system)" SWORD rel_sw_b1536 1 100 -1536.000 1535.953 FORMAT "%8.3" ECU_ADDRESS 0x600398A2 /end MEASUREMENT
/begin MEASUREMENT oraw_w "additive correction of the mixture adaptation in warm engine operation mode" SWORD rel_sw_b1536 1 100 -1536.000 1535.953 FORMAT "%8.3" ECU_ADDRESS 0x600072E6 /end MEASUREMENT
/begin MEASUREMENT ora_w_msg "additive correction of the mixture adaptation" SWORD rel_sw_b1536 1 100 -1536.000 1535.953 FORMAT "%8.3" ECU_ADDRESS 0x60008FB2 /end MEASUREMENT
/begin MEASUREMENT phufraloc_msg "local physical urgency fra" UBYTE dez 1 100 0.00 255.0 FORMAT "%5.1" ECU_ADDRESS 0x6000F726 /end MEASUREMENT
/begin MEASUREMENT phuoraloc_msg "local physical urgentcy ora" UBYTE dez 1 100 0.00 255.0 FORMAT "%5.1" ECU_ADDRESS 0x6000F725 /end MEASUREMENT
/begin MEASUREMENT redeta_w "Reduction stage for cylinder individual fuel cutoff" UWORD fak_uw_b32 1 100 0.00 24.00000 FORMAT "%8.5" ECU_ADDRESS 0x6000060E /end MEASUREMENT
/begin MEASUREMENT redneu "new calculated cylinder cut-off step" UBYTE dez 1 100 0.00 24.00 FORMAT "%5.2" ECU_ADDRESS 0x6000091F /end MEASUREMENT
/begin MEASUREMENT redze "threshold between ignition intervention and injector disabling" UBYTE dez 1 100 0.00 24.00 FORMAT "%5.2" ECU_ADDRESS 0x60000920 /end MEASUREMENT
/begin MEASUREMENT redzenl "threshold between ignition intervention and injector disabling, limp home mode" UBYTE dez 1 100 0.00 24.00 FORMAT "%5.2" ECU_ADDRESS 0x60000921 /end MEASUREMENT
/begin MEASUREMENT redzenmx "threshold between ignition intervention and injector disabling, engine speed limitation" UBYTE dez 1 100 0.00 24.00 FORMAT "%5.2" ECU_ADDRESS 0x7000216B /end MEASUREMENT
/begin MEASUREMENT rka_w_msg "additive adaptive correction of the relative fuel amount" SWORD rel_sw_b1536 1 100 -1536.000 1535.953 FORMAT "%8.3" ECU_ADDRESS 0x50005F10 /end MEASUREMENT
/begin MEASUREMENT rlmdhoms_w_msg "desired relative air charge for homogeneous mode" UWORD rel_uw_q0p0234 1 100 0.00 1535.977 FORMAT "%8.3" ECU_ADDRESS 0x600092D8 /end MEASUREMENT
/begin MEASUREMENT rlmdmax_w "maximum air-charge limited by maximum calibrated nominal torque and maximum calibrated air-charge" UWORD rel_uw_q0p0234 1 100 0.00 1535.977 FORMAT "%8.3" ECU_ADDRESS 0x600072BE /end MEASUREMENT
/begin MEASUREMENT rlmds_w_msg "desired relative air charge" UWORD rel_uw_q0p0234 1 100 0.00 1535.977 FORMAT "%8.3" ECU_ADDRESS 0x600092D6 /end MEASUREMENT
/begin MEASUREMENT RngMod_trqComp "Torque to be compensated" SWORD md_sw_q0p1 1 100 -3276.800 3276.700 FORMAT "%8.3" ECU_ADDRESS 0x60014946 /end MEASUREMENT
/begin MEASUREMENT RngMod_trqCrSLeadMin "minimum stationary engine torque - Lead path" SWORD md_q0p1 1 100 -3276.800 3276.700 FORMAT "%8.3" ECU_ADDRESS 0x600097E6 /end MEASUREMENT
/begin MEASUREMENT RngMod_trqCrSLeadMinAvl "minimum stationary engine torque - Lead path (soft limit)" SWORD md_q0p1 1 100 -3276.800 3276.700 FORMAT "%8.3" ECU_ADDRESS 0x600097E4 /end MEASUREMENT
/begin MEASUREMENT RngMod_trqInrLeadMin "minimum stationary engine torque - Lead path" SWORD md_q0p1 1 100 -3276.800 3276.700 FORMAT "%8.3" ECU_ADDRESS 0x700053C8 /end MEASUREMENT
/begin MEASUREMENT RngMod_trqInrLeadMinAvl "minimum stationary engine torque - Lead path (soft limit)" SWORD md_q0p1 1 100 0.00 3276.700 FORMAT "%8.3" ECU_ADDRESS 0x6001494A /end MEASUREMENT
/begin MEASUREMENT RngMod_trqInrMinAirChrg "torque at min. cylinder charge" SWORD md_q0p1 1 100 0.00 3276.700 FORMAT "%8.3" ECU_ADDRESS 0x700053CA /end MEASUREMENT
/begin MEASUREMENT RngMod_trqLosEng "engine losses" SWORD md_sw_q0p1 1 100 0.00 3276.700 FORMAT "%8.3" ECU_ADDRESS 0x6001494E /end MEASUREMENT
/begin MEASUREMENT tfraffv_w "Last initial value of tfraf_w" UWORD t_q0p2 1 100 0.00 13107.00 FORMAT "%8.2" ECU_ADDRESS 0x600072CA /end MEASUREMENT
/begin MEASUREMENT tfraf_w "count down timer, switches between phy. urgencies fra" UWORD t_q0p2 1 100 0.00 13107.00 FORMAT "%8.2" ECU_ADDRESS 0x600072C8 /end MEASUREMENT
/begin MEASUREMENT TLRBAM_TOFV.outbit "Turn-off delay after acceleration enrichment / Output Bit" UBYTE B_TRUE 1 100 0.00 1.00000000000 BIT_MASK 0x1 FORMAT "%13.11" ECU_ADDRESS 0x60000EA8 /end MEASUREMENT
/begin MEASUREMENT TLRBAM_TOFV.time "Turn-off delay after acceleration enrichment / Occured Time" UWORD t_q0p01 1 100 0.00 655.3500 FORMAT "%8.4" ECU_ADDRESS 0x60000EAA /end MEASUREMENT
/begin MEASUREMENT TLRHS_TONV.outbit "Turn-on delay after end of start / return value" UBYTE B_TRUE 1 100 0.00 1.00000000000 BIT_MASK 0x1 FORMAT "%13.11" ECU_ADDRESS 0x50000F60 /end MEASUREMENT
/begin MEASUREMENT TLRHS_TONV.time "Turn-on delay after end of start / expired delay time" UWORD t_q0p1 1 100 0.00 6553.500 FORMAT "%8.3" ECU_ADDRESS 0x50000F62 /end MEASUREMENT
/begin MEASUREMENT TLRVAM_TOFV.outbit "Turn-off delay after deceleration enleanment / Output Bit" UBYTE B_TRUE 1 100 0.00 1.00000000000 BIT_MASK 0x1 FORMAT "%13.11" ECU_ADDRESS 0x50000F64 /end MEASUREMENT
/begin MEASUREMENT TLRVAM_TOFV.time "Turn-off delay after deceleration enleanment / Occured Time" UWORD t_q0p01 1 100 0.00 655.3500 FORMAT "%8.4" ECU_ADDRESS 0x50000F66 /end MEASUREMENT
/begin MEASUREMENT tlrzwsa_w "Time running down after fuel cut-off for enabling lambda control" UWORD t_q0p1 1 100 0.00 6553.500 FORMAT "%8.3" ECU_ADDRESS 0x60000EBC /end MEASUREMENT
/begin MEASUREMENT TMEAct_facIaAdv_a "extended ring buffer for cylinder individual ignition factor" UWORD fak_uw_b2 1 100 0.00 1.999969 FORMAT "%8.6" ARRAY_SIZE 4 ECU_ADDRESS 0x700037F0 /end MEASUREMENT
/begin MEASUREMENT TMECmb_facChrgAdv_a "stretching factor for torque calculation air charge path" UWORD fak_uw_b2 1 100 0.00 1.999969 FORMAT "%8.6" ARRAY_SIZE 4 ECU_ADDRESS 0x700037E8 /end MEASUREMENT
/begin MEASUREMENT TMECmb_facIaBasAdv_a "stretching factor for base torque calculation" UWORD fak_uw_b2 1 100 0.00 1.000000 FORMAT "%8.6" ARRAY_SIZE 4 ECU_ADDRESS 0x700037D0 /end MEASUREMENT
/begin MEASUREMENT TMECmb_facIaBasMinAdv_a "stretching factor for calculation of minimum base torque" UWORD fak_uw_b2 1 100 0.00 1.000000 FORMAT "%8.6" ARRAY_SIZE 4 ECU_ADDRESS 0x700037C8 /end MEASUREMENT
/begin MEASUREMENT TMECmb_ratTqRefAdv_a "optimum indicated torque" UWORD rel_uw_b100 1 100 0.00 99.99847 FORMAT "%8.5" ARRAY_SIZE 4 ECU_ADDRESS 0x700037B0 /end MEASUREMENT
/begin MEASUREMENT TMECnv_etaIgnBasc "base ignition angle efficiency" UWORD fak_uw_b2 1 100 0.00 1.999969 FORMAT "%8.6" ECU_ADDRESS 0x700053D0 /end MEASUREMENT
/begin MEASUREMENT TMECnv_flgFacRedStgMax "activation of Interpolation factor for maximum reduction stage" UBYTE B_TRUE 1 100 0.00 1.00000000000 BIT_MASK 0x1 FORMAT "%13.11" ECU_ADDRESS 0x7000216A /end MEASUREMENT
/begin MEASUREMENT TMECnv_flgInjSplitActv "Calculation of relative air charge for engine operation modes with split injections activ" UBYTE B_TRUE 1 100 0.00 1.00000000000 BIT_MASK 0x1 FORMAT "%13.11" ECU_ADDRESS 0x7000076C /end MEASUREMENT
/begin MEASUREMENT TMECnv_iaDesAdv_a "desired ign.angle from BC TME" SWORD zw_q2p9297Em3_deg_KW 1 100 -96.00000 95.99707 FORMAT "%8.5" ARRAY_SIZE 4 ECU_ADDRESS 0x70003A2A /end MEASUREMENT
/begin MEASUREMENT TMECnv_nrRedStg "calculated cylinder cut-off stage (before limitation)" UBYTE dez 1 100 0.00 24.00 FORMAT "%5.2" ECU_ADDRESS 0x60000909 /end MEASUREMENT
/begin MEASUREMENT TMECnv_nrRedStgContns "preliminary calculated cylinder cut-off stage (continuous)" UWORD fak_uw_b32 1 100 0.00 24.00000 FORMAT "%8.5" ECU_ADDRESS 0x600005E6 /end MEASUREMENT
/begin MEASUREMENT TMECnv_nrRedStgHysAbv "hysteresis of reduction step at bigger desired red. step than actual value" SWORD fak_sw_b256 1 100 -2.000000 2.000000 FORMAT "%8.6" ECU_ADDRESS 0x600005E8 /end MEASUREMENT
/begin MEASUREMENT TMECnv_nrRedStgHysBlw "hysteresis of reduction step at smaller desired red. step than actual value" SWORD fak_sw_b256 1 100 -2.000000 2.000000 FORMAT "%8.6" ECU_ADDRESS 0x600005EA /end MEASUREMENT
/begin MEASUREMENT TMECnv_ratChrgAirInjSplit "desired relative air charge for engine operation modes with split injections" UWORD rel_uw_q0p0234 1 100 0.00 1535.977 FORMAT "%8.3" ECU_ADDRESS 0x600093D4 /end MEASUREMENT
/begin MEASUREMENT TMECnv_ratTqInnrRefRed "optimum indicated torque considering reduction stage" UWORD rel_uw_b100 1 100 0.00 99.99847 FORMAT "%8.5" ECU_ADDRESS 0x70002168 /end MEASUREMENT
/begin MEASUREMENT TMECnv_ratTqRefCco "indicated reference torque for calculation of desired indivudual cutoff-stage" UWORD rel_uw_b100 1 100 0.00 99.99847 FORMAT "%8.5" ECU_ADDRESS 0x600005EC /end MEASUREMENT
/begin MEASUREMENT TMELoss_ratTqChrgExchLoss "Charge Exchange Loss Torque of the Engine" SWORD rel_sw_b50 1 100 -50.00000 49.99847 FORMAT "%8.5" ECU_ADDRESS 0x600072B2 /end MEASUREMENT
/begin MEASUREMENT TMELoss_ratTqDrg "temperature share of drag torque" SLONG rel_uw_b100 1 100 -100.000000000 99.998474121 FORMAT "%13.9" ECU_ADDRESS 0x60002714 /end MEASUREMENT
/begin MEASUREMENT TMERng_ctBascDrvEnter "Local driving cycle counter for transition to drive state" UBYTE OneToOne 1 100 0.00 255.0 FORMAT "%5.1" ECU_ADDRESS 0x70002170 /end MEASUREMENT
/begin MEASUREMENT TMERng_ctDrvEntrMDMAX "Drive enter counter MDMAX" UBYTE OneToOne 1 100 0.00 255.0 FORMAT "%5.1" ECU_ADDRESS 0x6000B74A /end MEASUREMENT
/begin MEASUREMENT TMERng_ctDrvEntrMDRLMN "Drive enter counter MDRLMN" UBYTE OneToOne 1 100 0.00 255.0 FORMAT "%5.1" ECU_ADDRESS 0x6000B749 /end MEASUREMENT
/begin MEASUREMENT TMERng_etaAirChrgFild "Filtered air charge efficiency for torque calculation in MDRLMN" UWORD fak_uw_b2 1 100 0.00 1.999969 FORMAT "%8.6" ECU_ADDRESS 0x600072B6 /end MEASUREMENT
/begin MEASUREMENT TMERng_etaChrg "efficiency for torque calculation air charge path" UWORD fak_uw_b2 1 100 0.00 1.999969 FORMAT "%8.6" ECU_ADDRESS 0x60000768 /end MEASUREMENT
/begin MEASUREMENT TMERng_etaChrgWoCda "efficiency for torque calculation air charge path without cylinder deactivation" UWORD fak_uw_b2 1 100 0.00 1.999969 FORMAT "%8.6" ECU_ADDRESS 0x700037AE /end MEASUREMENT
/begin MEASUREMENT TMERng_etaMinIaFild "Filtered ignition angle efficiency for torque calculation in MDRLMN" UWORD fak_uw_b2 1 100 0.00 1.999969 FORMAT "%8.6" ECU_ADDRESS 0x600072B4 /end MEASUREMENT
/begin MEASUREMENT TMERng_facTqMaxFild "Maximum torque scaling factor, filtered" UWORD fak_uw_b2 1 100 0.00 1.999969 FORMAT "%8.6" ECU_ADDRESS 0x600072BC /end MEASUREMENT
/begin MEASUREMENT TMERng_ratTqBascMinCylPred "indicated minimum torque including predicted air charge step" UWORD rel_uw_b100 1 100 0.00 99.99847 FORMAT "%8.5" ECU_ADDRESS 0x600093D2 /end MEASUREMENT
/begin MEASUREMENT TMERng_ratTqBascPred "predicted basic torque (from rlp_w)" UWORD rel_uw_b100 1 100 0.00 99.99847 FORMAT "%8.5" ECU_ADDRESS 0x600093D0 /end MEASUREMENT
/begin MEASUREMENT TME_etafueLT_I.memory "internal memory filter etafue / current lowpass value" ULONG dez 1 100 0.00 4294967295.00 FORMAT "%13.2" ECU_ADDRESS 0x6000271C /end MEASUREMENT
/begin MEASUREMENT TME_etazwmnLT_I.memory "internal memory filter etazwmn / current lowpass value" ULONG dez 1 100 0.00 4294967295.00 FORMAT "%13.2" ECU_ADDRESS 0x60002718 /end MEASUREMENT
/begin MEASUREMENT TME_nAvrgEngSpdLoc "Local varaible for engine speed" UWORD EngN 1 100 0.00 16383.50 FORMAT "%8.2" ECU_ADDRESS 0x700052B4 /end MEASUREMENT
/begin MEASUREMENT tmotlok "Engine- oiltemperature for drag torque calculation" UBYTE temp_ub_q0p75_o48 1 100 -48.0 143.3 FORMAT "%5.1" ECU_ADDRESS 0x6000B748 /end MEASUREMENT
/begin MEASUREMENT tmot_llrnstat_loc "Engine temperature" UBYTE temp_ub_q0p75_o48 1 100 -48.0 143.3 FORMAT "%5.1" ECU_ADDRESS 0x6000B755 /end MEASUREMENT
/begin MEASUREMENT tmraaein_msg "ambient tmperature for forced activation of fuel mixture adaptation" UBYTE temp_ub_q0p75_o48 1 100 -48.0 143.3 FORMAT "%5.1" ECU_ADDRESS 0x6000F717 /end MEASUREMENT
/begin MEASUREMENT tomdvermot "engine temperature (eng. coolant or cyl. head), local copy" UBYTE temp_ub_q0p75_o48 1 100 -48.0 143.3 FORMAT "%5.1" ECU_ADDRESS 0x6000B747 /end MEASUREMENT
/begin MEASUREMENT toraffv_w "Last initial value of toraf_w" UWORD t_q0p2 1 100 0.00 13107.00 FORMAT "%8.2" ECU_ADDRESS 0x600072C6 /end MEASUREMENT
/begin MEASUREMENT toraf_w_msg "count down timer, switched between three different phy. urgentses ora" UWORD t_q0p2 1 100 0.00 13107.00 FORMAT "%8.2" ECU_ADDRESS 0x60008D02 /end MEASUREMENT
/begin MEASUREMENT TrqCnv_numRedStgDem "calculated desired cylinder cut-off step" UBYTE dez 1 100 0.00 24.00 FORMAT "%5.2" ECU_ADDRESS 0x60000992 /end MEASUREMENT
/begin MEASUREMENT tsmdvermot "engine temperature at start (eng. coolant or cyl. head), local copy" UBYTE temp_ub_q0p75_o48 1 100 -48.0 143.3 FORMAT "%5.1" ECU_ADDRESS 0x70005478 /end MEASUREMENT
/begin MEASUREMENT TVSLRS_TONV.outbit "Turn-on delay (homogenuous operation or stratified operation) / return value" UBYTE B_TRUE 1 100 0.00 1.00000000000 BIT_MASK 0x1 FORMAT "%13.11" ECU_ADDRESS 0x60000EA4 /end MEASUREMENT
/begin MEASUREMENT TVSLRS_TONV.time "Turn-on delay (homogenuous operation or stratified operation) / expired delay time" UWORD t_q0p01 1 100 0.00 655.3500 FORMAT "%8.4" ECU_ADDRESS 0x60000EA6 /end MEASUREMENT
/begin MEASUREMENT vfooerw_w "Vehicle speed (old) in consideration of the change for ORA(Additive correction of mixture adaptation) expected." UWORD vfzg_uw_b512 1 100 0.00 511.9922 FORMAT "%8.4" ECU_ADDRESS 0x600072D4 /end MEASUREMENT
/begin MEASUREMENT zwsol_w_msg "desired ignition angle from torque intervention" SWORD zw_q2p9297Em3_deg_KW 1 100 -96.00000 95.99707 FORMAT "%8.5" ECU_ADDRESS 0x50000944 /end MEASUREMENT
/begin FUNCTION LLRNSTAT "30.0.0    Stationary idle speed, coordination and filtering"
 /begin DEF_CHARACTERISTIC CNFLLRNS CWLLRNS CWNSTAT LLRNSTAT_nOffsIgnAgnlFix_C LLRNSTAT_nThrIceAdh_M LLRNSTAT_tiPT1HvyDecel1_C LLRNSTAT_tiPT1HvyDecel2_C NFSMIN NLLMG NLLMGFS NLLMIN NTIPLL SGA09LLSB STM06LLUB_LLRNSTAT ZKNSU_W ZKNS_W /end DEF_CHARACTERISTIC
 /begin IN_MEASUREMENT Brk_st B_fa_msg B_fs_msg B_khnshp_msg B_kh_msg B_llrein_msg B_ll_msg B_nswo1_msg B_vllr_msg CEngDsT_t CoPT_nMinAcs CoPT_nMinSysErr CoPT_nMinTra CoPT_stNSetPAcs CoPT_stNSetPSysErr CoPT_stNSetPTra EngStrt_bStrtEnd Epm_nEngLRes gangsist_msg Gbx_nIdlDes HLSDem_nDrvOffSuprtSp HLSDem_stDrvOffSuprtSpFilTyp nsmodac_msg nsmodlph_msg nsolac_msg nsolcat_msg nsolflx_msg nsolhtd_msg nsolhti_msg nsollph_msg nsolpts_msg Pt_flgFcoInhb SrvCSwt_st ThrVlv_flgColdCdnOffsActvB1 /end IN_MEASUREMENT
 /begin OUT_MEASUREMENT B_brufs_msg B_tpn_msg gangllrs_msg HLSDem_nMinWoCat HLSDem_nMinWoTraIntv HLSDem_nSetPLo HLSDem_nStatyEng HLSDem_nStyFildIdle LLRNSTAT_nMinBascSpLo nllmgfsglb_msg nllmgglb_msg nsolbas_msg nstatfil_msg /end OUT_MEASUREMENT
 /begin LOC_MEASUREMENT gangsist_llrnstat_loc LLRNSTAT_nBascIdlSpdSp nstat2_w nstat3 nstateng nstateng_w nstatLoc tmot_llrnstat_loc /end LOC_MEASUREMENT
 FUNCTION_VERSION "30.0.0" /end FUNCTION
/begin FUNCTION LOCOS2SV "4.1.0     Interface Oxygen Sensors Location for OBD2 Service $01/$02" /begin DEF_CHARACTERISTIC CWLOCONOHK ExhCo_flgLsfNoxSnsrOptn_CW /end DEF_CHARACTERISTIC /begin OUT_MEASUREMENT ExhCo_Idx1d /end OUT_MEASUREMENT FUNCTION_VERSION "4.1.0" /end FUNCTION
/begin FUNCTION LRA "30001.28.1Lambda closed loop control; Adaptive pilot control"
 /begin DEF_CHARACTERISTIC CWFRAINIT CWLRADLSUCHK CWLRADYN CWLRAFCLR CWORAP CWRKANMIL CWRKANMOT DFRMSTKH DLAHPLRAMN DLAHPLRAMX FFRAKBO FFRAKFV FlMA_facDynAddAdpnSpdRed_T FlMA_facDynMulAdpnSpdRed_T FlMA_facFuEvapAddAdpnSpdRed_T FlMA_facFuEvapMulAdpnSpdRed_T FlMA_tiLoadGrdtFil_C FORAKBO FORAKFV FRADIFF FRAMN FRAMX FVLRARESS FVLRAS IMTEFVDFRM INITFRA INITORA KFRKANMIL KLDFRKFRAK KLDFRKORAK KLFRKANMOT KLMILFFRAK KLMILFORAK KLNMOFFRAK KLNMOFORAK N0 NRKAB ORAMN ORAMX TAKH TDFEDSSB TDFRMKHZ TDFRMSTKH TMFVDFRM TNSEORAP TTPDFRM TTPMILSOL TTPNMOT /end DEF_CHARACTERISTIC
 /begin REF_CHARACTERISTIC ANZTILRA /end REF_CHARACTERISTIC
 /begin IN_MEASUREMENT anztib_w_msg B_abor_msg B_fedkapb_msg B_fedssb_msg B_ffuelrp_msg B_fvgte_msg B_gae_msg B_lrafra_msg B_lraora_msg B_lrareb_msg B_lrare_msg B_lr_msg B_nofra_msg B_noora_msg B_reqddskv_msg B_te_msg B_zora_msg CEngDsT_t Epm_nEngLRes fgausmx_msg FlMA_flgDSMClrLRAEB FlMA_flgIninFinshdAckd FlMA_flgIninTrig fraffck_w_msg frm_w_msg imsteini_msg milsol_w_msg SyC_stSub tans_msg tnse_w_msg TWCC_rPCtlPriB1 /end IN_MEASUREMENT
 /begin OUT_MEASUREMENT B_elsvga_msg B_fvdfrmeb_msg B_fvlra_msg B_gaenres_msg B_orap_msg B_reqlra_msg dfrmk_w_msg dfrmtp_w_msg dfrm_w_msg ffrakl_msg FlMA_facFuEvapAddAdpnSpdRed FlMA_facFuEvapMulAdpnSpdRed FlMA_flgFncRqstMixAdpn forakl_msg fraini_w_msg frai_w_msg frak_w_msg fra_w_msg orahini_w_msg orah_w_msg orai_w_msg orak_w_msg orapini_w_msg orapkh_w_msg orap_w_msg ora_w_msg rka_w_msg /end OUT_MEASUREMENT
 /begin LOC_MEASUREMENT B_frfvlra_FF.status B_fvdfrm B_fvlrae B_gaenresff B_lradlsuchk dfrmkb_w FlMA_facMulMixAdpnPCrrd FlMA_facSubMulLamSnsrErr FlMA_flgDSMClrFra FlMA_flgDSMClrLRA FlMA_flgDSMClrLRAProc1 FlMA_flgDSMClrOra FlMA_LraMulMixAdpnPCrrdLT_I.memory FlMA_nEng FlMA_ratAddMixAdpnPCrrd FlMA_ratDeltaAddAdpnPHFM FlMA_ratLoadGrdt FlMA_ratSubAddlLamSnsrErr fraildcy_w framn_w framx_w fraw_w milsolg_w nmotg oramn_w oramx_w oraw_w /end LOC_MEASUREMENT
 FUNCTION_VERSION "30001.28.1" /end FUNCTION
/begin FUNCTION LRA2SV "3.6.0     Connection %LRA to OBD Service"
 /begin IN_MEASUREMENT anztib_w_msg FlMA_flgIninFinshdAckd FlMA_flgIninTrig frai_w_msg fra_w_msg InjSys_ratPrdcAirLamDes rka_w_msg rlp_w_msg /end IN_MEASUREMENT
 /begin OUT_MEASUREMENT longft1_w_msg /end OUT_MEASUREMENT
 /begin LOC_MEASUREMENT lft1_w /end LOC_MEASUREMENT
 FUNCTION_VERSION "3.6.0" /end FUNCTION
/begin FUNCTION LRAEB "30001.27.0_2.2.0Conditions adaptive pilot control"
 /begin DEF_CHARACTERISTIC ANZTILRA ANZTIWSLRA CWLRAEB CWLRAEBORA CWUBORAERW DMLMVORAMX DVFBESOERW DVFUBOERW FGAUSGGAMX FlMA_facAftStrtWrmUp_C FlMA_stCfgEnaCnd FlMA_stCfgEnhdEnaCdn_C FlMA_tiEnhdEnagFacAdpnStab_C IMLRAAEIN KLFRAMILH KLFRAMILHY KLFRAMILL KLORAMILH KLORAMILHF KLORAMILL KLTMRAA KLTONLRALAF KLTONLRALAM KLTURAA LAMGAFVMN LAMGAMN LAMGAMX NOLRA NORAMX ORASPV TARA TDMILFRALT TDMILORALT TDVFORAERW TMRAA TMRAAFV TUBOERWMX TVLRA TVNLGA TVUBLRA TVUBLRAFRA TVUBLRAORA VFOERWRES VFUBOERW /end DEF_CHARACTERISTIC
 /begin REF_CHARACTERISTIC FRAMN FRAMX /end REF_CHARACTERISTIC
 /begin IN_MEASUREMENT anztib_w_msg B_bkvmsisr_msg B_efra_msg B_ethadap_msg B_fedssb_msg B_feete_msg B_frastab_msg B_fvlra_msg B_gaenres_msg B_lamkh_msg B_ll_msg B_lr_msg B_orastab_msg B_reqlra_msg B_vl_msg B_zfra_msg CEngDsT_t CEngDsT_tStrt Com_flgLETNoInjCntrCdn DSM_TripChgFinshd Eep_EnvRamInvld EnvT_t Epm_nEngLRes Epm_stSpd FfPrm_flgModCalc_msg fgausmx_msg FlMA_flgFncRqstMixAdpn FlMA_flgIninFinshdBGAUSG FlMA_flgIninFinshdLAMKORRLL fnswl_w_msg frai_w_msg lamsons_w_msg mdverl_w_msg mdwan_w_msg milsol_w_msg ml_w_msg SyC_ctPostDrvLeave tans_msg UEGO_flgAirScav VehV_v /end IN_MEASUREMENT
 /begin OUT_MEASUREMENT B_avfra_msg B_avora_msg B_baffuel_msg B_balra_msg B_lrabstv_msg B_lrab_msg B_lrafra_msg B_lraora_msg B_lrareb_msg B_lrare_msg B_nofra_msg B_noora_msg B_nphyora_msg B_ubfra_msg B_uboraerw_msg B_ubora_msg B_ubphyfra_msg B_ubphyora_msg B_ubpoerw_msg FlMA_flgAddlEnaCdn FlMA_flgBascEnaCdn FlMA_flgDsmClrFinshdAckd FlMA_flgDSMClrLRAEB FlMA_flgDsmClrTrig FlMA_flgIninFinshdAckd FlMA_flgIninTrig FlMA_flgTEngEnaCdn FlMA_tEngEna milshfra_w_msg milshora_w_msg milslfra_w_msg milslora_w_msg tmraaein_msg /end OUT_MEASUREMENT
 /begin LOC_MEASUREMENT B_besoe_msg B_fraprdy B_oramilh B_oraprdy B_phyframh dmilflp_w dmilfra_w dmilolp_w dmilora_w dvfoerw_w FlMA_ctPostDrvLeave FlMA_LraEbEnhdRdnOraActvFF_I.status FlMA_LraEbEnhdRdnOraDeltaVT_I.timeCounter FlMA_LraEbEnhdRdnOraDisadFF_I.status FlMA_LraEbEnhdRdnOraMaxTONV_I.outbit FlMA_LraEbEnhdRdnOraMaxTONV_I.time FlMA_nEngLRes FlMA_tCEngDsStrt FlMA_tEnv imlraa_w LAMSONS_TONV.outbit LAMSONS_TONV.time lamtmef_w lamtmem_w vfooerw_w /end LOC_MEASUREMENT
 FUNCTION_VERSION "30001.27.0_2.2.0" /end FUNCTION
/begin FUNCTION LRAPHU "30001.11.0Formation of physical urgency of mixture adaptation"
 /begin DEF_CHARACTERISTIC KWTFRAMX KWTORAMX KWTPFRAMX KWTPORAMX PHUFRAHP PHUFRALP PHUFRAMP PHUORAHP PHUORALP PHUORAMP TFRAFV TFRAINI TFRAPH TFRASTABZ TORAFDGS TORAFV TORAINI TORAPH TORASTA /end DEF_CHARACTERISTIC
 /begin IN_MEASUREMENT B_avfra_msg B_avora_msg B_dkvsscr_msg B_edkvs_msg B_fdgser_msg B_frastab_msg B_fvlra_msg B_gaenres_msg B_nphyora_msg B_odgser_msg B_orastab_msg EngStrt_bFrstStrtEnd FlMA_flgDSMClrLRAEB FlMA_flgIninFinshdAckd FlMA_flgIninTrig /end IN_MEASUREMENT
 /begin OUT_MEASUREMENT B_refrast_msg B_reorast_msg phufraloc_msg phuoraloc_msg toraf_w_msg /end OUT_MEASUREMENT
 /begin LOC_MEASUREMENT FlMA_flgDSMClrLRAPHU tfraffv_w tfraf_w toraffv_w /end LOC_MEASUREMENT
 FUNCTION_VERSION "30001.11.0" /end FUNCTION
/begin FUNCTION LRS "1.58.1_1.0.1Continuous lambda control"
 /begin DEF_CHARACTERISTIC CWLRMS CWLRS FRMAX FRMIN FRMINKH KFLRSSIG KLDLAHSP KLLRUW LADIFFTHR LALIUSMN LamCtrl_dfacCtrlDeltaLimCtrl_C LamCtrl_facCtrlDeltaMaxEnlnmtProtB1_T LamCtrl_facCtrlDeltaMinEnlnmtProtB1_T LamCtrl_facMaxLimFfv_T LamCtrl_facMinLim_M LamCtrl_facSigmaIdleCtrlB1_M LamCtrl_facVCtrlDif_T LamCtrl_facVDlyAdpn_T LamCtrl_facVTranAdpn_C LamCtrl_facVTranAdpn_T LamCtrl_ratLamSpCorrnB1_M LamCtrl_ratLamSpCorrnFfvB1_M LamCtrl_tiRampDe_T /end DEF_CHARACTERISTIC
 /begin REF_CHARACTERISTIC SNM07LSUW SRL08LSUW /end REF_CHARACTERISTIC
 /begin IN_MEASUREMENT B_dtefrr_msg B_gaeing_msg B_kh_msg B_lasostc_msg B_llr_msg B_lrmsbs_msg B_lrs_msg CEngDsT_t CoEOM_flgHsp EGSDCmn_facLamCtrlVParlB1 EGSDO2_tiDlyAdpnS1B1 EGSDO2_tiTranAdpnS1B1 Epm_nEng Epm_nEngLRes ExhMod_mfExhB1 fethmnmx_w_msg frdter_w_msg InjSys_bMinPtdInjDurActv InjSys_facSpltCmprn LamCtrl_nEngESPLANT LamCtrl_ratFillgPlaPrm LamCtrl_ratLamSpS1B1 rl_w_msg SyC_stSub tlrslb_w_msg tlrsl_w_msg tlrs_w_msg tnst_w_msg TWCC_facFlModlnB1 TWCC_rCtlPriB1 TWCC_rLamFltModlnB1 TWCC_rSetPUsGlbB1 UEGO_ratLamSymS1B1 zlamko_msg zlrslb_w_msg zlrsl_w_msg zlrs_w_msg /end IN_MEASUREMENT
 /begin OUT_MEASUREMENT B_frmax_msg B_frmin_msg B_frmn_msg B_lrnda_msg dfrmax_w_msg dfrmin_w_msg dfrmn_w_msg dfrmx_w_msg dfr_w_msg dlaso_msg frmn_w_msg frmx_w_msg frm_w_msg fr_w_msg ladiff_w_msg LamCtrl_flgEnlnmtProtActvB1 LamCtrl_flgLamBlwMinB1 LamCtrl_ratLamDifPrelB1 lamssok_w_msg lamzak_w_msg lrssig_msg /end OUT_MEASUREMENT
 /begin LOC_MEASUREMENT blrs_IT.memory B_dtefrr_ER.buffer B_dtefrr_ER.oldSignal B_lrmsbs_ER.buffer B_lrmsbs_ER.oldSignal B_lrsrems B_teminlrs_ER.buffer B_teminlrs_ER.oldSignal B_temin_TOFFV.outbit B_temin_TOFFV.time dfrmnms_w IMC_B1.a0lrs_w IMC_B1.b0lrs_w IMC_B1.dfr_w IMC_B1.dfrpr_w IMC_B1.dlrs_w IMC_B1.m1lrs_w IMC_B1.n0lrs_w IMC_B1.planto_w IMC_B1.r1lrs_w IMC_B1.s0lrs_w IMC_B1.s1lrs_w IMC_B1.LRScl_DelayTime_ds_opt.buffer IMC_B1.LRScl_DelayTime_ds_opt.counter IMC_B1.LRScl_DelayTime_ds_opt.out_val IMC_B1.LRScl_DelayTime_ds_opt.pointer IMC_B1.LRScl_DelayTime_ds_opt.pointerIni LamCtrl_facCtrlDeltaEnlnmtProtB1 LamCtrl_facCtrlDeltaLimCtrlB1 LamCtrl_facCtrlDeltaMaxEnlnmtProtB1 LamCtrl_facSpltCmprn LamCtrl_facVBasB1 LamCtrl_facVDlyAdpnB1 LamCtrl_facVTranAdpnB1 LamCtrl_flgLamMeasBlwMinB1 LamCtrl_flgLamSpBlwMinB1 LamCtrl_flgRdnRstEnlnmtProtnB1 LamCtrl_LimCtrlB1RMP_I.Memory LamCtrl_mfExhB1 LamCtrl_nEngLResLRS LamCtrl_nEngLRS LamCtrl_ratDlyTiB1 LamCtrl_ratFillgLRS LamCtrl_ratTranTiB1 LamCtrl_tCEngDs LamCtrl_tiAdpnMaxS1B1 LamCtrl_tiAftStrtEnd /end LOC_MEASUREMENT
 FUNCTION_VERSION "1.58.1_1.0.1" /end FUNCTION
/begin FUNCTION LRSEB "1.42.0_2.0.0Activation conditions for continuous Lambda control"
 /begin DEF_CHARACTERISTIC CWLRSEB CWLRSEB2 CWLRSMOD DLAMXSA IMLEVABS IMLSALR LamCL_tiDlyEnagFuOffFfv_C LamCtrl_facAirEnaWrmUpEthnl_T LamCtrl_flgEnaWrmUpAirM_CW LamCtrl_mAirEnaWrmUpHotStrt_C LamCtrl_mAirEnaWrmUpSpst_T LamCtrl_mAirEnaWrmUp_T LamCtrl_tiAEnchmtFfv_M LamCtrl_tiDecelEnlnmtFfv_M LamCtrl_tiDlyEnagPlaFco_C LamCtrl_tiEnlnmtProtLrgVlvLft_C LamCtrl_tiEnlnmtProtSmlVlvLft_C LamCtrl_tiTurnOnStratHom_C TASHS TLRHS TLRSZWSA TLRTMS TMSHS /end DEF_CHARACTERISTIC
 /begin REF_CHARACTERISTIC LALIUSMN /end REF_CHARACTERISTIC
 /begin IN_MEASUREMENT B_abor_msg B_bag_msg B_bevab_msg B_eev_msg B_frmax_msg B_frmn_msg B_sa_msg B_sbblsu_msg B_stopz_msg B_vag_msg B_vhegfe_msg CEngDsT_t CEngDsT_tStrt CoEOM_bHOM CoEOM_flgHsp EngStrt_bStrtEnd FfPrm_facEth InjSys_bMinPtdInjDurActv LamCtrl_flgLamBlwMinB1 LamCtrl_ratLamDifPrelB1 lamssok_w_msg ml_w_msg rl_w_msg SyC_stSub tansst_msg tlrsl_w_msg zlrsl_w_msg /end IN_MEASUREMENT
 /begin OUT_MEASUREMENT B_eobdlr_msg B_lrmsbs_msg B_lrmstr_msg B_lrsb_msg B_lrseta_msg B_lrssa_msg B_lrs_msg B_lr_msg B_mlevab_msg B_mlrsa_msg B_pspwl_msg LamCtrl_tiTurnOffDlyA LamCtrl_tiTurnOffDlyDecel /end OUT_MEASUREMENT
 /begin LOC_MEASUREMENT BMLEVAB.imlevab_l B_lrmein B_lrmein_FF.status B_lrnbsnc B_mlrsa_FF.status B_pspaus LamCtrl_flgHotStrt LamCtrl_LrgVlvLftER_I.buffer LamCtrl_LrgVlvLftER_I.oldSignal LamCtrl_LrgVlvLftTOFV_I.outbit LamCtrl_LrgVlvLftTOFV_I.time LamCtrl_mAirEnaStrtEndIK_I.memory LamCtrl_mAirEnaWrmUpThd LamCtrl_ratFillgLRSEB LamCtrl_SmlVlvLftEF_I.buffer LamCtrl_SmlVlvLftEF_I.oldSignal LamCtrl_SmlVlvLftTOFV_I.outbit LamCtrl_SmlVlvLftTOFV_I.time LamCtrl_tEngEnlnmt LamCtrl_tEngStrtWrmUp lrdtwl_w TLRBAM_TOFV.outbit TLRBAM_TOFV.time TLRHS_TONV.outbit TLRHS_TONV.time TLRVAM_TOFV.outbit TLRVAM_TOFV.time tlrzwsa_w TVSLRS_TONV.outbit TVSLRS_TONV.time /end LOC_MEASUREMENT
 FUNCTION_VERSION "1.42.0_2.0.0" /end FUNCTION
/begin FUNCTION LsComp_TrqCalc "27.1.0    Calculation of compensation of accessory torque loss" /begin DEF_CHARACTERISTIC LsComp_bLossCmpActvd_C LsComp_tiFlt_C /end DEF_CHARACTERISTIC
 /begin IN_MEASUREMENT CoME_trqDesComp CoME_trqResv Conv_trqLd SpdGov_facComp VehMot_facCompAcs /end IN_MEASUREMENT
 /begin OUT_MEASUREMENT LsComp_bLossCmpActvd LsComp_tqCmpActvSpdGovr LsComp_tqResv LsComp_tqSwilLossNotFild /end OUT_MEASUREMENT
 /begin LOC_MEASUREMENT LsComp_facCmpNoFlt LsComp_tqConvLd LsComp_tqDesCmpDt1 /end LOC_MEASUREMENT
 FUNCTION_VERSION "27.1.0" /end FUNCTION
/begin FUNCTION MADW "6.3.0     manager adaption values" /begin DEF_CHARACTERISTIC CWMADWMG MADWRKMN MADWRKMX /end DEF_CHARACTERISTIC /begin IN_MEASUREMENT fkaez_w_msg InjSys_facPreIgnMix_a /end IN_MEASUREMENT /begin OUT_MEASUREMENT fkrk_w_msg /end OUT_MEASUREMENT /begin LOC_MEASUREMENT fkrkloc_w_msg InjSys_cylBnk0 InjSys_sumBnk0 InjSys_sumBnk1 /end LOC_MEASUREMENT FUNCTION_VERSION "6.3.0" /end FUNCTION
/begin FUNCTION MDBAS "11.12.1   Basic calculation for torque interface" /begin DEF_CHARACTERISTIC KFMIOP /end DEF_CHARACTERISTIC
 /begin IN_MEASUREMENT AirMod_ratChrgAirCylAdv_a AirMod_ratChrgAirCylAftSwtPred CoEOM_flgEomSwtActv Epm_ctCyl Epm_nEng eta2ka_w_msg etaaufte_w_msg etalab_w_msg etalb_w_msg etarri_w_msg Gen_ctCylAdv Ign_iaBas_s16 Ign_ia_LT SyC_ctDrvEnter zwopt_w_msg /end IN_MEASUREMENT
 /begin OUT_MEASUREMENT etafue_w_msg etazwbm_w_msg etazwb_w_msg etazwmnm_w_msg etazwmns_w etazwmn_w_msg mibas_w_msg mibminm_w_msg mibmn_w_msg mibmx_w_msg mioptl1h_w_msg miopt_w_msg TMECmb_facChrgAdv_a TMECmb_facIaBasAdv_a TMECmb_facIaBasMinAdv_a TMECmb_ratTqRefAdv_a TMERng_etaChrg TMERng_etaChrgWoCda TMERng_ratTqBascMinCylPred TMERng_ratTqBascPred /end OUT_MEASUREMENT
 /begin LOC_MEASUREMENT TMERng_ctBascDrvEnter /end LOC_MEASUREMENT
 FUNCTION_VERSION "11.12.1" /end FUNCTION
/begin FUNCTION MDFUE "10.5.0    Nominal-value input from nominal torque for airmass" /begin DEF_CHARACTERISTIC KFMIRL /end DEF_CHARACTERISTIC
 /begin IN_MEASUREMENT B_rlvheg_msg B_vhegfes_msg B_vhegs_msg drlvhepsrs_w_msg Epm_nEng etaaufte_w_msg etazwbm_w_msg milsol_w_msg TMERng_etaChrg /end IN_MEASUREMENT
 /begin OUT_MEASUREMENT drldvmds_w_msg rlmdhoms_w_msg rlmds_w_msg TMECnv_flgInjSplitActv TMECnv_ratChrgAirInjSplit /end OUT_MEASUREMENT
 /begin LOC_MEASUREMENT etalfue_w TMECnv_etaIgnBasc /end LOC_MEASUREMENT
 FUNCTION_VERSION "10.5.0" /end FUNCTION
/begin FUNCTION MDIST "1.23.1    Engine torque calculation" /begin DEF_CHARACTERISTIC CWMDIST FMIISTSTN /end DEF_CHARACTERISTIC
 /begin IN_MEASUREMENT anztib_msg B_stendmd_msg Epm_ctCyl Epm_nEngTooth10ms Gen_ctCylAdv miopt_w_msg redistar_msg zwopt_w_msg zwoutzyl_w_msg zzaehl_msg /end IN_MEASUREMENT
 /begin OUT_MEASUREMENT etazaist_w_msg etazwist_w_msg miistz_w miist_w_msg TMEAct_facIaAdv_a /end OUT_MEASUREMENT
 /begin LOC_MEASUREMENT B_mdist B_mdistact dzwi_w mdistratzz /end LOC_MEASUREMENT
 FUNCTION_VERSION "1.23.1" /end FUNCTION
/begin FUNCTION MDMAX "1.23.0    Calculation maximum indicated torque" /begin DEF_CHARACTERISTIC CWMDMAX KLETAVGMN TETAMIMX /end DEF_CHARACTERISTIC /begin REF_CHARACTERISTIC KFMIOP /end REF_CHARACTERISTIC
 /begin IN_MEASUREMENT Epm_nEng etaaufte_w_msg etafue_w_msg etazwbm_w_msg Ign_flgHspNxtIA rldkmx_w_msg rlmxs_w_msg SyC_ctDrvEnter /end IN_MEASUREMENT
 /begin OUT_MEASUREMENT etamimx_w_msg mimaxa_w_msg mimaxud_w_msg mimax_w_msg /end OUT_MEASUREMENT
 /begin LOC_MEASUREMENT rlmdmax_w TMERng_ctDrvEntrMDMAX TMERng_facTqMaxFild /end LOC_MEASUREMENT
 FUNCTION_VERSION "1.23.0" /end FUNCTION
/begin FUNCTION MDRED "159.0.0   Calculation reduction stage from torque demand"
 /begin DEF_CHARACTERISTIC FREDMN FREDMX FREDTYP KLREDNMX REDHYOC REDHYOCESP REDHYOCGSN REDHYUC REDHYUCESP REDHYUCGSN REDMXGS REDZEM REDZEMESP REDZEMGS REDZEMNL TMECnv_flgRedStgMaxThdGbx_C TMECnv_RedStgMaxThdGbx_C TMECnv_stTqRedCfg_C /end DEF_CHARACTERISTIC
 /begin IN_MEASUREMENT CEngDsT_t ECT_bFCOEnaCmpnPrt ftrq2mi_w_msg Gbx_bLimp mibas_w_msg mibminm_w_msg PthSet_bOvrRun PthSet_stCylIndivCtOff PthSet_stTrgFCO PthSet_trqInrCtOff Tra_numGear /end IN_MEASUREMENT
 /begin OUT_MEASUREMENT B_mdeevb_msg B_mdee_msg B_redmxgs_msg TrqCnv_numRedStgDem /end OUT_MEASUREMENT
 /begin LOC_MEASUREMENT mdeemodfg redeta_w redneu redze redzenl redzenmx TMECnv_flgFacRedStgMax TMECnv_nrRedStg TMECnv_nrRedStgContns TMECnv_nrRedStgHysAbv TMECnv_nrRedStgHysBlw TMECnv_ratTqRefCco /end LOC_MEASUREMENT
 FUNCTION_VERSION "159.0.0" /end FUNCTION
/begin FUNCTION MDRIST "4.0.0     Real torque reserve" /begin DEF_CHARACTERISTIC EngReq_tqDecExlResv_C /end DEF_CHARACTERISTIC /begin IN_MEASUREMENT CoEng_bStrtEndTrqStruct RngMod_trqInrBs RngMod_trqInrBsMin /end IN_MEASUREMENT /begin OUT_MEASUREMENT EngReq_trqRngExlAct /end OUT_MEASUREMENT FUNCTION_VERSION "4.0.0" /end FUNCTION
/begin FUNCTION MDRLMN "1.14.0    Calculation torque for minimum charge" /begin DEF_CHARACTERISTIC CWMDRLMN KFETAVFZG KFTETAMIMN KLETADRLMN KLETAMN KLETAMNLL /end DEF_CHARACTERISTIC /begin REF_CHARACTERISTIC KFMIOP /end REF_CHARACTERISTIC
 /begin IN_MEASUREMENT APP_r Epm_nEng etafue_w_msg etazwbm_w_msg etazwmn_w_msg fmi2trq_w_msg rlfgmnho_w_msg rl_w_msg RngMod_trqCrSMin SyC_ctDrvEnter VehV_v /end IN_MEASUREMENT
 /begin OUT_MEASUREMENT RngMod_trqCrSLeadMin RngMod_trqCrSLeadMinAvl RngMod_trqInrLeadMin RngMod_trqInrLeadMinAvl RngMod_trqInrMinAirChrg /end OUT_MEASUREMENT
 /begin LOC_MEASUREMENT drlmn_w etazwmni_w facetazwmn_w TMERng_ctDrvEntrMDRLMN TMERng_etaAirChrgFild TMERng_etaMinIaFild TME_etafueLT_I.memory TME_etazwmnLT_I.memory TME_nAvrgEngSpdLoc /end LOC_MEASUREMENT
 FUNCTION_VERSION "1.14.0" /end FUNCTION
/begin FUNCTION MDTRIP "4.3.0     Calculation of torque reserve for short trip" /begin DEF_CHARACTERISTIC DMRAA KLMRKFHO /end DEF_CHARACTERISTIC
 /begin IN_MEASUREMENT B_faam_msg dmrdagr_w_msg fmi2trq_w_msg GEVCtl_tqResvPhaDiagTstr PEnv_facCorrAlti Shtrp_rTrqSetPointDia /end IN_MEASUREMENT
 /begin OUT_MEASUREMENT EngReq_trqResvQckTst /end OUT_MEASUREMENT
 FUNCTION_VERSION "4.3.0" /end FUNCTION
/begin FUNCTION MDVERMOT "11.25.0   calculation engine losses"
 /begin DEF_CHARACTERISTIC CNFMDVER FKTMOD MDSH MDVERMOT_dtTqCrkEth_M MDVERMOT_TqCrkOffsEth_M RngMod_nrStrtMod_CUR TMELoss_ratTqDrgT_M TMELoss_ratTqFrc_M TMELoss_ratTqFricT_M /end DEF_CHARACTERISTIC
 /begin IN_MEASUREMENT CEngDsT_t CEngDsT_tStrt CoPOM_numStrt EngDa_tEng EngStrt_bStrtEnd Epm_nEng fethmnmx_msg fmi2trq_w_msg ftrq2mi_w_msg OilSwmpT_t OilSwmpT_tMdl PEnv_facCorrAlti RngMod_trqChrgExchLoss /end IN_MEASUREMENT
 /begin OUT_MEASUREMENT mdns_w_msg mdsh_w_msg mdslw_w_msg mdssta_w_msg mds_w_msg RngMod_trqComp RngMod_trqLosEng /end OUT_MEASUREMENT
 /begin LOC_MEASUREMENT mdsmn_w TMELoss_ratTqChrgExchLoss TMELoss_ratTqDrg tmotlok tomdvermot tsmdvermot /end LOC_MEASUREMENT
 FUNCTION_VERSION "11.25.0" /end FUNCTION
/begin FUNCTION MDZW "1.19.2    Calculation of torque in nominal ignition timing"
 /begin IN_MEASUREMENT B_lamkora_msg Epm_ctCyl etalab_w_msg etalrplk_w_msg ftrq2mi_w_msg Gen_ctCylAdv Ign_iaBas_s16 Ign_ia_LT miopt_w_msg PthSet_bIAIntv PthSet_trqInrIA redistar_msg zwopt_w_msg /end IN_MEASUREMENT
 /begin OUT_MEASUREMENT B_nozwe_msg etazwsol_w_msg TMECnv_iaDesAdv_a zwsol_w_msg /end OUT_MEASUREMENT
 /begin LOC_MEASUREMENT TMECnv_ratTqInnrRefRed /end LOC_MEASUREMENT
 FUNCTION_VERSION "1.19.2" /end FUNCTION
/begin FUNCTION MED2ADC "3.2.0     Interface adapter MED to ADC"
 /begin IN_MEASUREMENT ChrCtl_flgChrgCalcnTiBasd rl_msg rl_w_msg rml_msg umsrln_w_msg /end IN_MEASUREMENT
 /begin OUT_MEASUREMENT AirMod_mfGasIntkVlv AirSys_rChCyl AirSys_rChCylLRes AirSys_rChrgCyl AirSys_rMsCyl /end OUT_MEASUREMENT
 FUNCTION_VERSION "3.2.0" /end FUNCTION
/begin FUNCTION MED2ATC "13.1.0    Interface adapter MED to ATC"
 /begin IN_MEASUREMENT B_mdfasfk_msg B_mdfasnl_msg B_mdmin_msg B_ugd_msg ChrCtl_flgChrgCalcnTiBasd msdk_w_msg SyC_stSub ThrVlv_ratActPosnB1 ThrVlv_ratLimpAirPosnB1 /end IN_MEASUREMENT
 /begin OUT_MEASUREMENT AirSys_bMinPsblIdcTrqRea AirSys_bThrVlvUnthr AirSys_bTrqInflCmft AirSys_bTrqInflLimp AirSys_mAirThrVlv AirSys_rPhiThrVlv /end OUT_MEASUREMENT
 FUNCTION_VERSION "13.1.0" /end FUNCTION
/begin FUNCTION MED2ECT "3.3.0     Interface adapter MED to ECT" /begin REF_CHARACTERISTIC MDNORM /end REF_CHARACTERISTIC /begin IN_MEASUREMENT B_kh_msg B_sabbts_msg etakh_w_msg SyC_stSub /end IN_MEASUREMENT /begin OUT_MEASUREMENT EGSys_bCH EGSys_bFCORdnCoPr EGSys_etaCH EGSys_trqResvCH /end OUT_MEASUREMENT FUNCTION_VERSION "3.3.0" /end FUNCTION
/begin FUNCTION MED2EnvP "3.3.0     Interface Adapter MED to EnvP" /begin DEF_CHARACTERISTIC EnvP_pDfl_C /end DEF_CHARACTERISTIC /begin IN_MEASUREMENT PEnv_p /end IN_MEASUREMENT /begin OUT_MEASUREMENT EnvP_p /end OUT_MEASUREMENT FUNCTION_VERSION "3.3.0" /end FUNCTION
/begin FUNCTION MED2EnvT "4.5.0     Interface Adapter MED to EnvT" /begin DEF_CHARACTERISTIC EnvT_tDfl_C /end DEF_CHARACTERISTIC /begin IN_MEASUREMENT tumg_msg /end IN_MEASUREMENT /begin OUT_MEASUREMENT EnvT_tMod /end OUT_MEASUREMENT FUNCTION_VERSION "4.5.0" /end FUNCTION
/begin FUNCTION MED2FSS "51.6.0    Interface adapter MED to FSS" /begin IN_MEASUREMENT B_sthdr_msg B_tfuelg_msg tfuelhpsq_msg tfuelsq_msg /end IN_MEASUREMENT
 /begin OUT_MEASUREMENT FlSys_tFlHPSys FlSys_tFlLPSys FuelT_t FuelT_tHiP InjSys_bStrtFlHP /end OUT_MEASUREMENT
 /begin LOC_MEASUREMENT MED2FSS_bdummy /end LOC_MEASUREMENT
 FUNCTION_VERSION "51.6.0" /end FUNCTION
/begin FUNCTION MEDC_Axispoints_Custom "14700.0.0_3.1.0customer specific axispoints" FUNCTION_VERSION "14700.0.0_3.1.0" /end FUNCTION
/begin FUNCTION MEDC_Compu_Core_CELPrj "30059.0.0 Computation Methods for core, which are migrated from DS classis" FUNCTION_VERSION "30059.0.0" /end FUNCTION
/begin FUNCTION MEDC_Compu_Custom "30059.0.0_3.3.0deprectared: have to be migrated to CEL_Compu" FUNCTION_VERSION "30059.0.0_3.3.0" /end FUNCTION
/begin FUNCTION MEDC_Compu_Custom_CELPrj "30059.0.0 Customer specific computation formulas from Clearcase" FUNCTION_VERSION "30059.0.0" /end FUNCTION
/begin FUNCTION MEDC_Compu_DS_CELPrj "30059.0.0 computation methods of DS from Clearcase" FUNCTION_VERSION "30059.0.0" /end FUNCTION
/begin FUNCTION MEDC_Compu_DS_GS_CELPrj "30059.0.0 computation methods, common used by DS and GS from Clearcase" FUNCTION_VERSION "30059.0.0" /end FUNCTION
/begin FUNCTION MEDC_FixConst_Core_CELPrj "30059.0.0 central system constants of the core from Clearcase" FUNCTION_VERSION "30059.0.0" /end FUNCTION
/begin FUNCTION MEDC_FixConst_Custom "30059.0.0_3.1.0deprectared: have to be migrated to CEL_Const" FUNCTION_VERSION "30059.0.0_3.1.0" /end FUNCTION
/begin FUNCTION MEDC_FixConst_Custom_CELPrj "30059.0.0 Customer specific central system constants from Clearcase" FUNCTION_VERSION "30059.0.0" /end FUNCTION
/begin FUNCTION MEDC_FixConst_DS_CELPrj "30059.0.0 DS central system constants from Clearcase" FUNCTION_VERSION "30059.0.0" /end FUNCTION
/begin FUNCTION MEDC_FixConst_DS_GS_CELPrj "30059.0.0 central systemkonstants, common used by DS and GS from Clearcase" FUNCTION_VERSION "30059.0.0" /end FUNCTION
/begin FUNCTION MEDC_Models_DS_CELPrj "30059.0.0 models DS from Clearcase" FUNCTION_VERSION "30059.0.0" /end FUNCTION
/begin FUNCTION MEDC_Models_DS_GS_CELPrj "30059.0.0 common models GS and DS from Clearcase" FUNCTION_VERSION "30059.0.0" /end FUNCTION
/begin FUNCTION MEDC_SimpleModels "30001.0.0 Simple models for diesel gasoline systems" FUNCTION_VERSION "30001.0.0" /end FUNCTION
/begin FUNCTION MfDD "1001.30.0_6.0.0Device Driver for Mass Flow Valve Component." /begin DEF_CHARACTERISTIC MfDD_numFadeOutNip_T MFDD_phiOTZ1OTP_CA MFDD_tTstPulse_C /end DEF_CHARACTERISTIC /begin REF_CHARACTERISTIC Epm_phiTdc1_C /end REF_CHARACTERISTIC
 /begin IN_MEASUREMENT B_cononmsv_msg B_msvact_msg B_msvrecur_msg B_msvzpa_msg dwmsvd_w_msg dwmsvo_w_msg Epm_nEng Epm_stOpMode Epm_stSync FuPHi_flgOnOffCtrlFadeOut FuPHi_pRailSp mfpsdia_efMsv_u8_msg MfVlv_tDelayOffset_msg MfVlv_tiDlyMfvOpn_msg MfVlv_tvzmsv_msg SyC_stSub /end IN_MEASUREMENT
 /begin OUT_MEASUREMENT MFVlv_agTdcPmp1 MfVlv_NrCamsftReal /end OUT_MEASUREMENT
 /begin LOC_MEASUREMENT mfdd_bsetdata mfdd_durpwm MfDD_nEng MfDD_numFadeOut MfDD_phiDur MfDD_tiTV1Length /end LOC_MEASUREMENT
 FUNCTION_VERSION "1001.30.0_6.0.0" /end FUNCTION
/begin COMPU_METHOD B_TRUE "" TAB_VERB "%6.3" "" COMPU_TAB_REF B_TRUE /end COMPU_METHOD
/begin COMPU_VTAB B_TRUE "" TAB_VERB 2 0 "FALSE" 1 "TRUE" /end COMPU_VTAB
/begin COMPU_METHOD dez "" RAT_FUNC "%6.2" "" COEFFS 0 1 0 0 0 1 /end COMPU_METHOD
/begin COMPU_METHOD EngN "" RAT_FUNC "%6.3" "rpm" COEFFS 0 2 0 0 0 1 /end COMPU_METHOD
/begin COMPU_METHOD Fact "" RAT_FUNC "%6.5" "-" COEFFS 0 8192 0 0 0 1 /end COMPU_METHOD
/begin COMPU_METHOD fak_q0p01 "" RAT_FUNC "%6.4" "" COEFFS 0 100 0 0 0 1 /end COMPU_METHOD
/begin COMPU_METHOD fak_q4p6566Em10 "" RAT_FUNC "%18.17" "" COEFFS 0 2147483648 0 0 0 1 /end COMPU_METHOD
/begin COMPU_METHOD fak_q9p3132Em10 "" RAT_FUNC "%12.11" "-" COEFFS 0 1073741824 0 0 0 1 /end COMPU_METHOD
/begin COMPU_METHOD fak_sb_b0p03125 "" RAT_FUNC "%6.5" "-" COEFFS 0 256 0 0 0 0.0625 /end COMPU_METHOD
/begin COMPU_METHOD fak_sb_b1 "" RAT_FUNC "%6.4" "-" COEFFS 0 256 0 0 0 2 /end COMPU_METHOD
/begin COMPU_METHOD fak_sw_b1 "" RAT_FUNC "%7.6" "-" COEFFS 0 65536 0 0 0 2 /end COMPU_METHOD
/begin COMPU_METHOD fak_sw_b256 "" RAT_FUNC "%6.4" "-" COEFFS 0 65536 0 0 0 512 /end COMPU_METHOD
/begin COMPU_METHOD fak_ub_b1 "" RAT_FUNC "%6.4" "-" COEFFS 0 256 0 0 0 1 /end COMPU_METHOD
/begin COMPU_METHOD fak_ub_b16 "" RAT_FUNC "%6.4" "-" COEFFS 0 256 0 0 0 16 /end COMPU_METHOD
/begin COMPU_METHOD fak_ub_b2 "" RAT_FUNC "%8.5" "-" COEFFS 0 256 0 0 0 2 /end COMPU_METHOD
/begin COMPU_METHOD fak_ub_b32 "" RAT_FUNC "%6.3" "-" COEFFS 0 256 0 0 0 32 /end COMPU_METHOD
/begin COMPU_METHOD fak_ub_b4 "" RAT_FUNC "%6.4" "-" COEFFS 0 256 0 0 0 4 /end COMPU_METHOD
/begin COMPU_METHOD fak_uw_b16 "" RAT_FUNC "%6.5" "-" COEFFS 0 65536 0 0 0 16 /end COMPU_METHOD
/begin COMPU_METHOD fak_uw_b2 "" RAT_FUNC "%7.6" "-" COEFFS 0 65536 0 0 0 2 /end COMPU_METHOD
/begin COMPU_METHOD fak_uw_b32 "" RAT_FUNC "%6.5" "-" COEFFS 0 65536 0 0 0 32 /end COMPU_METHOD
/begin COMPU_METHOD fak_uw_b4 "" RAT_FUNC "%7.6" "-" COEFFS 0 65536 0 0 0 4 /end COMPU_METHOD
/begin COMPU_METHOD freq_q3p0518Em5 "" RAT_FUNC "%7.6" "1/s" COEFFS 0 65536 0 0 0 2 /end COMPU_METHOD
/begin COMPU_METHOD kw_q0p1 "" RAT_FUNC "%6.3" "Grad KW" COEFFS 0 10 0 0 0 1 /end COMPU_METHOD
/begin COMPU_METHOD kw_q1 "" RAT_FUNC "%6.2" "Grad KW" COEFFS 0 1 0 0 0 1 /end COMPU_METHOD
/begin COMPU_METHOD md_q0p1 "" RAT_FUNC "%6.3" "Nm" COEFFS 0 10 0 0 0 1 /end COMPU_METHOD
/begin COMPU_METHOD md_sw_q0p1 "" RAT_FUNC "%6.3" "Nm" COEFFS 0 10 0 0 0 1 /end COMPU_METHOD
/begin COMPU_METHOD m_q0p0277_g "" RAT_FUNC "%6.4" "g" COEFFS 0 36 0 0 0 1 /end COMPU_METHOD
/begin COMPU_METHOD m_q0p1 "" RAT_FUNC "%6.3" "kg/h" COEFFS 0 10 0 0 0 1 /end COMPU_METHOD
/begin COMPU_METHOD m_q1p7778Em3_kg "" RAT_FUNC "%6.4" "kg" COEFFS 0 36000 0 0 0 64 /end COMPU_METHOD
/begin COMPU_METHOD m_q2p777Em4_g "" RAT_FUNC "%6.5" "g" COEFFS 0 3600 0 0 0 1 /end COMPU_METHOD
/begin COMPU_METHOD m_q4p239Em7_g "" RAT_FUNC "%9.8" "g" COEFFS 0 2359290 0 0 0 1 /end COMPU_METHOD
/begin COMPU_METHOD m_ub_q0p0444 "" RAT_FUNC "%6.4" "g" COEFFS 0 1 0 0 0 0.0444 /end COMPU_METHOD
/begin COMPU_METHOD m_uw_b4660 "" RAT_FUNC "%6.4" "g" COEFFS 0 3600 0 0 0 256 /end COMPU_METHOD
/begin COMPU_METHOD m_uw_b6553p5 "" RAT_FUNC "%6.3" "kg/h" COEFFS 0 1 0 0 0 0.1 /end COMPU_METHOD
/begin COMPU_METHOD nmot_q10 "" RAT_FUNC "%6.1" "1/min" COEFFS 0 1 0 0 0 10 /end COMPU_METHOD
/begin COMPU_METHOD nmot_sw_q0p5 "" RAT_FUNC "%6.3" "1/min" COEFFS 0 2 0 0 0 1 /end COMPU_METHOD
/begin COMPU_METHOD nmot_ub_q10 "" RAT_FUNC "%6.1" "1/min" COEFFS 0 1 0 0 0 10 /end COMPU_METHOD
/begin COMPU_METHOD nmot_ub_q40 "" RAT_FUNC "%6.1" "1/min" COEFFS 0 1 0 0 0 40 /end COMPU_METHOD
/begin COMPU_METHOD nmot_uw_q0p25 "" RAT_FUNC "%6.3" "1/min" COEFFS 0 1 0 0 0 0.25 /end COMPU_METHOD
/begin COMPU_METHOD OneToOne "" RAT_FUNC "%6.2" "-" COEFFS 0 1 0 0 0 1 /end COMPU_METHOD
/begin COMPU_METHOD Prc "" RAT_FUNC "%6.4" "%" COEFFS 0 81.92 0 0 0 1 /end COMPU_METHOD
/begin COMPU_METHOD Pres_hPa "" RAT_FUNC "%6.2" "hPa" COEFFS 0 1 0 0 0 1 /end COMPU_METHOD
/begin COMPU_METHOD q0p0586_pc_DIV_s "" RAT_FUNC "%6.4" "%/s" COEFFS 0 256 0 0 0 15 /end COMPU_METHOD
/begin COMPU_METHOD q7p63Em5_DIV_s "" RAT_FUNC "%7.6" "1/s" COEFFS 0 65536 0 0 0 5 /end COMPU_METHOD
/begin COMPU_METHOD RBPtCel_p_0p002_1 "" RAT_FUNC "%6.4" "MPa" COEFFS 0 1000 0 0 0 2 /end COMPU_METHOD
/begin COMPU_METHOD relDK_q0p02441 "" RAT_FUNC "%6.4" "%DK" COEFFS 0 65536 0 0 0 1600 /end COMPU_METHOD
/begin COMPU_METHOD rel_q0p02344 "" RAT_FUNC "%6.4" "%" COEFFS 0 32 0 0 0 0.75 /end COMPU_METHOD
/begin COMPU_METHOD rel_q0p75 "" RAT_FUNC "%6.3" "%" COEFFS 0 4 0 0 0 3 /end COMPU_METHOD
/begin COMPU_METHOD rel_sw_b100 "" RAT_FUNC "%6.4" "%" COEFFS 0 32768 0 0 0 100 /end COMPU_METHOD
/begin COMPU_METHOD rel_sw_b1536 "" RAT_FUNC "%6.4" "%" COEFFS 0 65536 0 0 0 3072 /end COMPU_METHOD
/begin COMPU_METHOD rel_sw_b50 "" RAT_FUNC "%6.4" "%" COEFFS 0 65536 0 0 0 100 /end COMPU_METHOD
/begin COMPU_METHOD rel_ub_b99p6 "" RAT_FUNC "%6.3" "%" COEFFS 0 256 0 0 0 100 /end COMPU_METHOD
/begin COMPU_METHOD rel_uw_b100 "" RAT_FUNC "%6.4" "%" COEFFS 0 65536 0 0 0 100 /end COMPU_METHOD
/begin COMPU_METHOD rel_uw_q0p0234 "" RAT_FUNC "%6.4" "%" COEFFS 0 32 0 0 0 0.75 /end COMPU_METHOD
/begin COMPU_METHOD SY_BKVP_Compu "" TAB_VERB "%6.3" "" COMPU_TAB_REF SY_BKVP_Compu /end COMPU_METHOD
/begin COMPU_VTAB SY_BKVP_Compu "" TAB_VERB 4 0 "0" 1 "1" 2 "2" 3 "3" /end COMPU_VTAB
/begin COMPU_METHOD SY_BKVSRV_Compu "" TAB_VERB "%6.3" "" COMPU_TAB_REF SY_BKVSRV_Compu /end COMPU_METHOD
/begin COMPU_VTAB SY_BKVSRV_Compu "" TAB_VERB 2 0 "ohne Verbindung" 1 "mit Verbindung" /end COMPU_VTAB
/begin COMPU_METHOD SY_BKV_Compu "" TAB_VERB "%6.3" "" COMPU_TAB_REF SY_BKV_Compu /end COMPU_METHOD
/begin COMPU_VTAB SY_BKV_Compu "" TAB_VERB 3 0 "ohne Drucksensor oder -schalter" 1 "Druckschalter" 2 "Drucksensor" /end COMPU_VTAB
/begin COMPU_METHOD SY_BOADAP_Compu "" TAB_VERB "%6.3" "" COMPU_TAB_REF SY_BOADAP_Compu /end COMPU_METHOD
/begin COMPU_VTAB SY_BOADAP_Compu "" TAB_VERB 2 0 "SY_BOADAP ==0" 1 "SY_BOADAP ==1" /end COMPU_VTAB
/begin COMPU_METHOD SY_BOGALIM_Compu "" TAB_VERB "%6.3" "" COMPU_TAB_REF SY_BOGALIM_Compu /end COMPU_METHOD
/begin COMPU_VTAB SY_BOGALIM_Compu "" TAB_VERB 2 0 "SY_BOGALIM ==0" 1 "SY_BOGALIM ==1" /end COMPU_VTAB
/begin COMPU_METHOD SY_BPEZEK_Compu "" TAB_VERB "%6.3" "" COMPU_TAB_REF SY_BPEZEK_Compu /end COMPU_METHOD
/begin COMPU_VTAB SY_BPEZEK_Compu "" TAB_VERB 2 0 "False" 1 "True" /end COMPU_VTAB
/begin COMPU_METHOD SY_CAMNMSV_Compu "" TAB_VERB "%6.3" "" COMPU_TAB_REF SY_CAMNMSV_Compu /end COMPU_METHOD
/begin COMPU_VTAB SY_CAMNMSV_Compu "" TAB_VERB 10 0 "Zero_CamLobe_HDP" 1 "One_CamLobe_HDP" 2 "Two_CamLobe_HDP" 3 "Three_CamLobe_HDP" 4 "Four_CamLobe_HDP" 5 "Five_CamLobe_HDP" 6 "Six_CamLobe_HDP" 7 "Seven_CamLobe_HDP" 8 "Eight_CamLobe_HDP" 9 "Nine_CamLobe_HDP" /end COMPU_VTAB
/begin COMPU_METHOD SY_CATACT_Compu "" TAB_VERB "%6.3" "" COMPU_TAB_REF SY_CATACT_Compu /end COMPU_METHOD
/begin COMPU_VTAB SY_CATACT_Compu "" TAB_VERB 2 0 "False" 1 "True" /end COMPU_VTAB
/begin COMPU_METHOD SY_CFCEO_Compu "" TAB_VERB "%6.3" "" COMPU_TAB_REF SY_CFCEO_Compu /end COMPU_METHOD
/begin COMPU_VTAB SY_CFCEO_Compu "" TAB_VERB 2 0 "GasCapCheck_NotAvailable" 1 "GasCapCheck_Available" /end COMPU_VTAB
/begin COMPU_METHOD SY_CFMST_Compu "" TAB_VERB "%6.3" "" COMPU_TAB_REF SY_CFMST_Compu /end COMPU_METHOD
/begin COMPU_VTAB SY_CFMST_Compu "" TAB_VERB 2 0 "kein Throttle Stomp Clear Flood in Start" 1 "Throttle Stomp Clear Flood in Start vorhanden" /end COMPU_VTAB
/begin COMPU_METHOD SY_CHSPLMI_Compu "" TAB_VERB "%6.3" "" COMPU_TAB_REF SY_CHSPLMI_Compu /end COMPU_METHOD
/begin COMPU_VTAB SY_CHSPLMI_Compu "" TAB_VERB 2 0 "Direct definition of setpoint lambda" 1 "Definition by mixture lambda of exhaust gas" /end COMPU_VTAB
/begin COMPU_METHOD SY_CJ230_Compu "" TAB_VERB "%6.3" "" COMPU_TAB_REF SY_CJ230_Compu /end COMPU_METHOD
/begin COMPU_VTAB SY_CJ230_Compu "" TAB_VERB 4 0 "0 CJ230 Bauteine im Gerät verbaut" 1 "1 CJ230 Baustein im Gerät verbaut" 2 "2 CJ230 Bausteine im Gerät verbaut" 3 "3 CJ230 Bausteine im Gerät verbaut" /end COMPU_VTAB
/begin COMPU_METHOD SY_CJ840_Compu "" RAT_FUNC "%6.2" "" COEFFS 0 1 0 0 0 1 /end COMPU_METHOD
/begin COMPU_METHOD SY_CJ841_Compu "" TAB_VERB "%6.3" "" COMPU_TAB_REF SY_CJ841_Compu /end COMPU_METHOD
/begin COMPU_VTAB SY_CJ841_Compu "" TAB_VERB 3 0 "no CJ841" 1 "one CJ841" 2 "two CJ841" /end COMPU_VTAB
/begin COMPU_METHOD SY_CJ870_Compu "" TAB_VERB "%6.3" "" COMPU_TAB_REF SY_CJ870_Compu /end COMPU_METHOD
/begin COMPU_VTAB SY_CJ870_Compu "" TAB_VERB 3 0 "no CJ870" 1 "one CJ870" 2 "two CJ870" /end COMPU_VTAB
/begin COMPU_METHOD SY_CK200_Compu "" RAT_FUNC "%6.2" "" COEFFS 0 1 0 0 0 1 /end COMPU_METHOD
/begin COMPU_METHOD SY_CK240_Compu "" RAT_FUNC "%6.2" "" COEFFS 0 1 0 0 0 1 /end COMPU_METHOD
/begin COMPU_METHOD SY_CK260_Compu "" RAT_FUNC "%6.2" "" COEFFS 0 1 0 0 0 1 /end COMPU_METHOD
/begin COMPU_METHOD SY_CKA_Compu "" TAB_VERB "%6.3" "" COMPU_TAB_REF SY_CKA_Compu /end COMPU_METHOD
/begin COMPU_VTAB SY_CKA_Compu "" TAB_VERB 2 0 "chemisches Katalysatoraufheizen nicht möglich" 1 "chemisches Katalysatoraufheizen möglich" /end COMPU_VTAB
/begin COMPU_METHOD SY_CNG_Compu "" TAB_VERB "%6.3" "" COMPU_TAB_REF SY_CNG_Compu /end COMPU_METHOD
/begin COMPU_VTAB SY_CNG_Compu "" TAB_VERB 6 0 "Kein System mit CNG" 1 "System mit CNG" 2 "System mit CNG und EOBD" 3 "System mit CNG Fehlerpfade ASV1...5" 4 "System mit CNG Plattform" 5 "System with customer options on CNG platform" /end COMPU_VTAB
/begin COMPU_METHOD SY_CPRDYL_Compu "" TAB_VERB "%6.3" "" COMPU_TAB_REF SY_CPRDYL_Compu /end COMPU_METHOD
/begin COMPU_VTAB SY_CPRDYL_Compu "" TAB_VERB 2 0 "No specific enrichment at high load dynamic avail." 1 "Specific enrichment at high load dynamic available" /end COMPU_VTAB
/begin COMPU_METHOD SY_CPRLAOX_Compu "" TAB_VERB "%6.3" "" COMPU_TAB_REF SY_CPRLAOX_Compu /end COMPU_METHOD
/begin COMPU_VTAB SY_CPRLAOX_Compu "" TAB_VERB 2 0 "No lower limit of enrichment by comp. protection" 1 "Lower limit of enrichment by comp. prot. possible" /end COMPU_VTAB
/begin COMPU_METHOD SY_CPRSCV_Compu "" TAB_VERB "%6.3" "" COMPU_TAB_REF SY_CPRSCV_Compu /end COMPU_METHOD
/begin COMPU_VTAB SY_CPRSCV_Compu "" TAB_VERB 2 0 "Enrichment independent of swirl control valve" 1 "Specific enrichment for high/low swirl" /end COMPU_VTAB
/begin COMPU_METHOD SY_CVT_Compu "" TAB_VERB "%6.3" "" COMPU_TAB_REF SY_CVT_Compu /end COMPU_METHOD
/begin COMPU_VTAB SY_CVT_Compu "" TAB_VERB 2 0 "no CVT Gear installed" 1 "CVT Gear installed" /end COMPU_VTAB
/begin COMPU_METHOD SY_DAPRID_Compu "" TAB_VERB "%6.3" "" COMPU_TAB_REF SY_DAPRID_Compu /end COMPU_METHOD
/begin COMPU_VTAB SY_DAPRID_Compu "" TAB_VERB 11 0 "keine Zuordnung" 1 "ME 9.7 NGV" 2 "ME 17.7 UHP" 3 "MED 17.7.1 MoVE" 4 "MED 17.7.2 M270/M274" 5 "M276Desla" 6 "MED 17.7.4 M177/M178" 7 "ME17.7.20 M281 Smart" 8 "ME17.7.20 M281 REX" 9 "kein MED17 Projekt" 10 "MED17.7.7 M260/M264" /end COMPU_VTAB
/begin COMPU_METHOD SY_DCPVLRR_Compu "" TAB_VERB "%6.3" "" COMPU_TAB_REF SY_DCPVLRR_Compu /end COMPU_METHOD
/begin COMPU_VTAB SY_DCPVLRR_Compu "" TAB_VERB 2 0 "kein Lambdareglerreset nach DTEV" 1 "Lambdareglerreset aktiviert nach DTEV" /end COMPU_VTAB
/begin COMPU_METHOD SY_DCPVPAS_Compu "" TAB_VERB "%6.3" "" COMPU_TAB_REF SY_DCPVPAS_Compu /end COMPU_METHOD
/begin COMPU_VTAB SY_DCPVPAS_Compu "" TAB_VERB 2 0 "False" 1 "True" /end COMPU_VTAB
/begin COMPU_METHOD SY_DCPVSPL_Compu "" TAB_VERB "%6.3" "" COMPU_TAB_REF SY_DCPVSPL_Compu /end COMPU_METHOD
/begin COMPU_VTAB SY_DCPVSPL_Compu "" TAB_VERB 2 0 "False" 1 "True" /end COMPU_VTAB
/begin COMPU_METHOD SY_DCPV_Compu "" TAB_VERB "%6.3" "" COMPU_TAB_REF SY_DCPV_Compu /end COMPU_METHOD
/begin COMPU_VTAB SY_DCPV_Compu "" TAB_VERB 9 0 "00_No_CPV_Diag" 1 "01_DTEV_based" 2 "02_DTEV_wothout_PassiveCheck" 11 "11_Using_TankPSensor" 12 "12_TankPSensor_based+DTEV_Workshop_AddOn" 16 "16_CPV-check_with_DTESP" 21 "21_using_DMTL_pump" 22 "22_CPV_Diag_Selectable_DMTL_or_DTEV" 30 "30_CPV-check_with_cross_correlation" /end COMPU_VTAB
/begin COMPU_METHOD SY_DCV_Compu "" TAB_VERB "%6.3" "" COMPU_TAB_REF SY_DCV_Compu /end COMPU_METHOD
/begin COMPU_VTAB SY_DCV_Compu "" TAB_VERB 2 0 "Keine Diagnose Kurbelgehäuseentlüftung vorhanden" 1 "Diagnose Kurbelgehäuseentlüftung vorhanden" /end COMPU_VTAB
/begin COMPU_METHOD SY_DCYLIMB_Compu "" TAB_VERB "%6.3" "" COMPU_TAB_REF SY_DCYLIMB_Compu /end COMPU_METHOD
/begin COMPU_VTAB SY_DCYLIMB_Compu "" TAB_VERB 2 0 "SY_DCYLIMB_NO" 1 "SY_DCYLIMB_YES" /end COMPU_VTAB
/begin COMPU_METHOD SY_DDS2A3_Compu "" TAB_VERB "%6.3" "" COMPU_TAB_REF SY_DDS2A3_Compu /end COMPU_METHOD
/begin COMPU_VTAB SY_DDS2A3_Compu "" TAB_VERB 2 0 "PRES_SENS_INACTV" 1 "PRES_SENS_ACTV" /end COMPU_VTAB
/begin COMPU_METHOD SY_DDTLSFK_Compu "" TAB_VERB "%6.3" "" COMPU_TAB_REF SY_DDTLSFK_Compu /end COMPU_METHOD
/begin COMPU_VTAB SY_DDTLSFK_Compu "" TAB_VERB 2 0 "False" 1 "True" /end COMPU_VTAB
/begin COMPU_METHOD SY_DDTLSHK_Compu "" TAB_VERB "%6.3" "" COMPU_TAB_REF SY_DDTLSHK_Compu /end COMPU_METHOD
/begin COMPU_VTAB SY_DDTLSHK_Compu "" TAB_VERB 2 0 "False" 1 "True" /end COMPU_VTAB
/begin COMPU_METHOD SY_DECOS_Compu "" TAB_VERB "%6.3" "" COMPU_TAB_REF SY_DECOS_Compu /end COMPU_METHOD
/begin COMPU_VTAB SY_DECOS_Compu "" TAB_VERB 2 0 "kein bedarfsgesteuertes Niederdrucksystem" 1 "bedarfsgesteuertes Niederdrucksystem" /end COMPU_VTAB
/begin COMPU_METHOD SY_DEGFE_Compu "" TAB_VERB "%6.3" "" COMPU_TAB_REF SY_DEGFE_Compu /end COMPU_METHOD
/begin COMPU_VTAB SY_DEGFE_Compu "" TAB_VERB 5 0 "DiagWithoutMassFlowAdaption" 1 "DiagWithMassFlowAdaption" 2 "DiagWithMassFlowAdaptionPinPointing MAF" 3 "DiagWithMassFlowAdaptionPinPointing MAP" 4 "DiagWithMassFlowAdaptionPinPointingServiceDia MAP" /end COMPU_VTAB
/begin COMPU_METHOD SY_DESOK_Compu "" TAB_VERB "%6.3" "" COMPU_TAB_REF SY_DESOK_Compu /end COMPU_METHOD
/begin COMPU_VTAB SY_DESOK_Compu "" TAB_VERB 2 0 "shortened EOL-test unavailable" 1 "shortened EOL-test available" /end COMPU_VTAB
/begin COMPU_METHOD SY_DEVAL_Compu "" TAB_VERB "%6.3" "" COMPU_TAB_REF SY_DEVAL_Compu /end COMPU_METHOD
/begin COMPU_VTAB SY_DEVAL_Compu "" TAB_VERB 2 0 "disabled" 1 "enabled" /end COMPU_VTAB
/begin COMPU_METHOD SY_DFKTAV2_Compu "" TAB_VERB "%6.3" "" COMPU_TAB_REF SY_DFKTAV2_Compu /end COMPU_METHOD
/begin COMPU_VTAB SY_DFKTAV2_Compu "" TAB_VERB 2 0 "False" 1 "True" /end COMPU_VTAB
/begin COMPU_METHOD SY_DFKTAV_Compu "" TAB_VERB "%6.3" "" COMPU_TAB_REF SY_DFKTAV_Compu /end COMPU_METHOD
/begin COMPU_VTAB SY_DFKTAV_Compu "" TAB_VERB 2 0 "False" 1 "True" /end COMPU_VTAB
/begin COMPU_METHOD SY_DFKTSP2_Compu "" TAB_VERB "%6.3" "" COMPU_TAB_REF SY_DFKTSP2_Compu /end COMPU_METHOD
/begin COMPU_VTAB SY_DFKTSP2_Compu "" TAB_VERB 2 0 "False" 1 "True" /end COMPU_VTAB
/begin COMPU_METHOD SY_DFKTSP_Compu "" TAB_VERB "%6.3" "" COMPU_TAB_REF SY_DFKTSP_Compu /end COMPU_METHOD
/begin COMPU_VTAB SY_DFKTSP_Compu "" TAB_VERB 2 0 "False" 1 "True" /end COMPU_VTAB
/begin COMPU_METHOD SY_DFPMFFR_Compu "" TAB_VERB "%6.3" "" COMPU_TAB_REF SY_DFPMFFR_Compu /end COMPU_METHOD
/begin COMPU_VTAB SY_DFPMFFR_Compu "" TAB_VERB 2 0 "keine Unterstützung FFR Anforderung" 1 "Unterstützung FFR Anforderung" /end COMPU_VTAB
/begin COMPU_METHOD SY_DFRAVUE_Compu "" TAB_VERB "%6.3" "" COMPU_TAB_REF SY_DFRAVUE_Compu /end COMPU_METHOD
/begin COMPU_VTAB SY_DFRAVUE_Compu "" TAB_VERB 2 0 "False" 1 "True" /end COMPU_VTAB
/begin COMPU_METHOD SY_DFRST_Compu "" TAB_VERB "%6.3" "" COMPU_TAB_REF SY_DFRST_Compu /end COMPU_METHOD
/begin COMPU_VTAB SY_DFRST_Compu "" TAB_VERB 2 0 "False" 1 "True" /end COMPU_VTAB
/begin COMPU_METHOD SY_DFSTTNL_Compu "" TAB_VERB "%6.3" "" COMPU_TAB_REF SY_DFSTTNL_Compu /end COMPU_METHOD
/begin COMPU_VTAB SY_DFSTTNL_Compu "" TAB_VERB 2 0 "False" 1 "True" /end COMPU_VTAB
/begin COMPU_METHOD SY_DHDEVOE_Compu "" TAB_VERB "%6.3" "" COMPU_TAB_REF SY_DHDEVOE_Compu /end COMPU_METHOD
/begin COMPU_VTAB SY_DHDEVOE_Compu "" TAB_VERB 2 0 "no_error_reaction" 1 "error_reaction" /end COMPU_VTAB
/begin COMPU_METHOD SY_DHKTAV2_Compu "" TAB_VERB "%6.3" "" COMPU_TAB_REF SY_DHKTAV2_Compu /end COMPU_METHOD
/begin COMPU_VTAB SY_DHKTAV2_Compu "" TAB_VERB 2 0 "False" 1 "True" /end COMPU_VTAB
/begin COMPU_METHOD SY_DHKTAV_Compu "" TAB_VERB "%6.3" "" COMPU_TAB_REF SY_DHKTAV_Compu /end COMPU_METHOD
/begin COMPU_VTAB SY_DHKTAV_Compu "" TAB_VERB 2 0 "False" 1 "True" /end COMPU_VTAB
/begin COMPU_METHOD SY_DHKTSP2_Compu "" TAB_VERB "%6.3" "" COMPU_TAB_REF SY_DHKTSP2_Compu /end COMPU_METHOD
/begin COMPU_VTAB SY_DHKTSP2_Compu "" TAB_VERB 2 0 "False" 1 "True" /end COMPU_VTAB
/begin COMPU_METHOD SY_DHKTSP_Compu "" TAB_VERB "%6.3" "" COMPU_TAB_REF SY_DHKTSP_Compu /end COMPU_METHOD
/begin COMPU_VTAB SY_DHKTSP_Compu "" TAB_VERB 2 0 "False" 1 "True" /end COMPU_VTAB
/begin COMPU_METHOD SY_DIGBT_Compu "" TAB_VERB "%6.3" "" COMPU_TAB_REF SY_DIGBT_Compu /end COMPU_METHOD
/begin COMPU_VTAB SY_DIGBT_Compu "" TAB_VERB 8 0 "0" 1 "1" 2 "2" 3 "3" 4 "4" 5 "5" 6 "6" 7 "7" /end COMPU_VTAB
/begin COMPU_METHOD SY_DIONDE_Compu "" TAB_VERB "%6.3" "" COMPU_TAB_REF SY_DIONDE_Compu /end COMPU_METHOD
/begin COMPU_VTAB SY_DIONDE_Compu "" TAB_VERB 2 0 "False" 1 "True" /end COMPU_VTAB
/begin COMPU_METHOD SY_DIRST_Compu "" TAB_VERB "%6.3" "" COMPU_TAB_REF SY_DIRST_Compu /end COMPU_METHOD
/begin COMPU_VTAB SY_DIRST_Compu "" TAB_VERB 4 0 "NO_DIRST" 1 "STARTER_SUP" 2 "NO_STARTER_SUP" 3 "STARTER_SRE" /end COMPU_VTAB
/begin COMPU_METHOD SY_DISDPLT_Compu "" TAB_VERB "%6.3" "" COMPU_TAB_REF SY_DISDPLT_Compu /end COMPU_METHOD
/begin COMPU_VTAB SY_DISDPLT_Compu "" TAB_VERB 2 0 "No diagnosis deactivation during very first start." 1 "Diagnosis deactivation during very first start." /end COMPU_VTAB
/begin COMPU_METHOD SY_DKATTE_Compu "" TAB_VERB "%6.3" "" COMPU_TAB_REF SY_DKATTE_Compu /end COMPU_METHOD
/begin COMPU_VTAB SY_DKATTE_Compu "" TAB_VERB 2 0 "False" 1 "True" /end COMPU_VTAB
/begin COMPU_METHOD SY_DKNOTVVT_Compu "" TAB_VERB "%6.3" "" COMPU_TAB_REF SY_DKNOTVVT_Compu /end COMPU_METHOD
/begin COMPU_VTAB SY_DKNOTVVT_Compu "" TAB_VERB 2 0 "False" 1 "True" /end COMPU_VTAB
/begin COMPU_METHOD SY_DKVFTAL_Compu "" TAB_VERB "%6.3" "" COMPU_TAB_REF SY_DKVFTAL_Compu /end COMPU_METHOD
/begin COMPU_VTAB SY_DKVFTAL_Compu "" TAB_VERB 2 0 "fuel mixture fault entries enabled" 1 "calculation of enabling fuel mixture fault entries" /end COMPU_VTAB
/begin COMPU_METHOD SY_DKVSCMB_Compu "" TAB_VERB "%6.3" "" COMPU_TAB_REF SY_DKVSCMB_Compu /end COMPU_METHOD
/begin COMPU_VTAB SY_DKVSCMB_Compu "" TAB_VERB 2 0 "False" 1 "True" /end COMPU_VTAB
/begin COMPU_METHOD SY_DKVSDFRM_Compu "" TAB_VERB "%6.3" "" COMPU_TAB_REF SY_DKVSDFRM_Compu /end COMPU_METHOD
/begin COMPU_VTAB SY_DKVSDFRM_Compu "" TAB_VERB 2 0 "False" 1 "True" /end COMPU_VTAB
/begin COMPU_METHOD SY_DKVSFFC_Compu "" TAB_VERB "%6.3" "" COMPU_TAB_REF SY_DKVSFFC_Compu /end COMPU_METHOD
/begin COMPU_VTAB SY_DKVSFFC_Compu "" TAB_VERB 2 0 "False" 1 "True" /end COMPU_VTAB
/begin COMPU_METHOD SY_DKVSSC_Compu "" TAB_VERB "%6.3" "" COMPU_TAB_REF SY_DKVSSC_Compu /end COMPU_METHOD
/begin COMPU_VTAB SY_DKVSSC_Compu "" TAB_VERB 2 0 "no similar conditions in DKVS" 1 "similar conditions in DKVS" /end COMPU_VTAB
/begin COMPU_METHOD SY_DLBTSZW_Compu "" TAB_VERB "%6.3" "" COMPU_TAB_REF SY_DLBTSZW_Compu /end COMPU_METHOD
/begin COMPU_VTAB SY_DLBTSZW_Compu "" TAB_VERB 2 0 "False" 1 "True" /end COMPU_VTAB
/begin COMPU_METHOD SY_DLDPATC_Compu "" TAB_VERB "%6.3" "" COMPU_TAB_REF SY_DLDPATC_Compu /end COMPU_METHOD
/begin COMPU_VTAB SY_DLDPATC_Compu "" TAB_VERB 2 0 "False" 1 "True" /end COMPU_VTAB
/begin COMPU_METHOD SY_DLDP_Compu "" TAB_VERB "%6.3" "" COMPU_TAB_REF SY_DLDP_Compu /end COMPU_METHOD
/begin COMPU_VTAB SY_DLDP_Compu "" TAB_VERB 2 0 "kein DLDP System" 1 "DLDP System" /end COMPU_VTAB
/begin COMPU_METHOD SY_DLLRNPL_Compu "" TAB_VERB "%6.3" "" COMPU_TAB_REF SY_DLLRNPL_Compu /end COMPU_METHOD
/begin COMPU_VTAB SY_DLLRNPL_Compu "" TAB_VERB 2 0 "False" 1 "True" /end COMPU_VTAB
/begin COMPU_METHOD SY_DLSHVTO_Compu "" TAB_VERB "%6.3" "" COMPU_TAB_REF SY_DLSHVTO_Compu /end COMPU_METHOD
/begin COMPU_VTAB SY_DLSHVTO_Compu "" TAB_VERB 2 0 "False" 1 "True" /end COMPU_VTAB
/begin COMPU_METHOD SY_DLSHV_Compu "" TAB_VERB "%6.3" "" COMPU_TAB_REF SY_DLSHV_Compu /end COMPU_METHOD
/begin COMPU_VTAB SY_DLSHV_Compu "" TAB_VERB 2 0 "keine Sonde-Vertauschung hinter Kat erkennbar" 1 "Sonde-Vertauschung hinter Kat erkennbar" /end COMPU_VTAB
/begin COMPU_METHOD SY_DLSUV_Compu "" TAB_VERB "%6.3" "" COMPU_TAB_REF SY_DLSUV_Compu /end COMPU_METHOD
/begin COMPU_VTAB SY_DLSUV_Compu "" TAB_VERB 2 0 "keine Lambdasondenvertauscherkennung vor KAT aktiv" 1 "Lambdasondenvertauscherkennung vor KAT aktiv" /end COMPU_VTAB
/begin COMPU_METHOD SY_DMDADAP_Compu "" TAB_VERB "%6.3" "" COMPU_TAB_REF SY_DMDADAP_Compu /end COMPU_METHOD
/begin COMPU_VTAB SY_DMDADAP_Compu "" TAB_VERB 3 0 "standard adaptation" 1 "adaptation with %DMDADAP" 2 "adaptation with %DMDSIC" /end COMPU_VTAB
/begin COMPU_METHOD SY_DMDATEH_Compu "" TAB_VERB "%6.3" "" COMPU_TAB_REF SY_DMDATEH_Compu /end COMPU_METHOD
/begin COMPU_VTAB SY_DMDATEH_Compu "" TAB_VERB 2 0 "disabled" 1 "enabled" /end COMPU_VTAB
/begin COMPU_METHOD SY_DMDBTGT_Compu "" TAB_VERB "%6.3" "" COMPU_TAB_REF SY_DMDBTGT_Compu /end COMPU_METHOD
/begin COMPU_VTAB SY_DMDBTGT_Compu "" TAB_VERB 2 0 "NO_DMD_GearTypeSpecificBaseThreshold" 1 "DMD_GearTypeSpecificBaseThreshold" /end COMPU_VTAB
/begin COMPU_METHOD SY_DMDCYLID_Compu "" TAB_VERB "%6.3" "" COMPU_TAB_REF SY_DMDCYLID_Compu /end COMPU_METHOD
/begin COMPU_VTAB SY_DMDCYLID_Compu "" TAB_VERB 2 0 "False" 1 "True" /end COMPU_VTAB
/begin COMPU_METHOD SY_DMDFCER_Compu "" TAB_VERB "%6.3" "" COMPU_TAB_REF SY_DMDFCER_Compu /end COMPU_METHOD
/begin COMPU_VTAB SY_DMDFCER_Compu "" TAB_VERB 2 0 "False" 1 "True" /end COMPU_VTAB
/begin COMPU_METHOD SY_DMDPAT_Compu "" TAB_VERB "%6.3" "" COMPU_TAB_REF SY_DMDPAT_Compu /end COMPU_METHOD
/begin COMPU_VTAB SY_DMDPAT_Compu "" TAB_VERB 5 0 "No algorithm is activated" 1 "Activates additional algorithm" 2 "Activates additional algorithm(plausability check)" 3 "pat_algo_wo_id" 4 "PatDetnByFrqEvln" /end COMPU_VTAB
/begin COMPU_METHOD SY_DMDSEGV_Compu "" TAB_VERB "%6.3" "" COMPU_TAB_REF SY_DMDSEGV_Compu /end COMPU_METHOD
/begin COMPU_VTAB SY_DMDSEGV_Compu "" TAB_VERB 2 0 "no switch over of misfire segment" 1 "switch over of misfire segment" /end COMPU_VTAB
/begin COMPU_METHOD SY_DMDSTQ_Compu "" RAT_FUNC "%6.2" "" COEFFS 0 1 0 0 0 1 /end COMPU_METHOD
/begin COMPU_METHOD SY_DMDTAL_Compu "" TAB_VERB "%6.3" "" COMPU_TAB_REF SY_DMDTAL_Compu /end COMPU_METHOD
/begin COMPU_VTAB SY_DMDTAL_Compu "" TAB_VERB 2 0 "keine Unterdrückung MIL an bei leerem Tank" 1 "Unterdrückung MIL an bei leerem Tank" /end COMPU_VTAB
/begin COMPU_METHOD SY_DMDZAG_Compu "" TAB_VERB "%6.3" "" COMPU_TAB_REF SY_DMDZAG_Compu /end COMPU_METHOD
/begin COMPU_VTAB SY_DMDZAG_Compu "" TAB_VERB 3 0 "Misfire generation with DMDZAG not available" 1 "Misfire generation with DMDZAG available, case 1" 2 "Misfire generation with DMDZAG available, case 2" /end COMPU_VTAB
/begin COMPU_METHOD SY_DMTL_Compu "" TAB_VERB "%6.3" "" COMPU_TAB_REF SY_DMTL_Compu /end COMPU_METHOD
/begin COMPU_VTAB SY_DMTL_Compu "" TAB_VERB 2 0 "DMTL_NotAvailable" 1 "DMTL_Available" /end COMPU_VTAB
/begin COMPU_METHOD SY_DNSTAT_Compu "" RAT_FUNC "%6.2" "" COEFFS 0 1 0 0 0 1 /end COMPU_METHOD
/begin COMPU_METHOD SY_DOPZW_Compu "" TAB_VERB "%6.3" "" COMPU_TAB_REF SY_DOPZW_Compu /end COMPU_METHOD
/begin COMPU_VTAB SY_DOPZW_Compu "" TAB_VERB 2 0 "keine doppelte Zündausgabe aktiv" 1 "doppelte Zündausgabe aktiv" /end COMPU_VTAB
/begin COMPU_METHOD SY_DPCS_Compu "" TAB_VERB "%6.3" "" COMPU_TAB_REF SY_DPCS_Compu /end COMPU_METHOD
/begin COMPU_VTAB SY_DPCS_Compu "" TAB_VERB 12 0 "no leak test" 11 "EONV stand alone" 21 "DMTL" 30 "NVLD" 36 "DLDP" 41 "DMTL with TEV-Check, DTEVP" 42 "DMTL with DMTL as pressure sensor" 43 "DMTL as pressure sensor" 46 "DTESK" 51 "DTESK, EONV (open gas cap, 1mm, 0.5mm)" 52 "DTESK, EONV (open gas cap, 0.5mm)" 53 "DTESK, EONV (both for 1mm)" /end COMPU_VTAB
/begin COMPU_METHOD SY_DPLTCWL_Compu "" TAB_VERB "%6.3" "" COMPU_TAB_REF SY_DPLTCWL_Compu /end COMPU_METHOD
/begin COMPU_VTAB SY_DPLTCWL_Compu "" TAB_VERB 3 0 "SY_DPLTCWL_0" 1 "SY_DPLTCWL_1" 2 "SY_DPLTCWL_2" /end COMPU_VTAB
/begin COMPU_METHOD SY_DSKVND_Compu "" TAB_VERB "%6.3" "" COMPU_TAB_REF SY_DSKVND_Compu /end COMPU_METHOD
/begin COMPU_VTAB SY_DSKVND_Compu "" TAB_VERB 2 0 "kein Kraftstoffniederdrucksensor vorhanden" 1 "Kraftstoffniederdrucksensor vorhanden" /end COMPU_VTAB
/begin COMPU_METHOD SY_DSKVRIN_Compu "" TAB_VERB "%6.3" "" COMPU_TAB_REF SY_DSKVRIN_Compu /end COMPU_METHOD
/begin COMPU_VTAB SY_DSKVRIN_Compu "" TAB_VERB 2 0 "False" 1 "True" /end COMPU_VTAB
/begin COMPU_METHOD SY_DSKVSIN_Compu "" TAB_VERB "%6.3" "" COMPU_TAB_REF SY_DSKVSIN_Compu /end COMPU_METHOD
/begin COMPU_VTAB SY_DSKVSIN_Compu "" TAB_VERB 2 0 "False" 1 "True" /end COMPU_VTAB
/begin COMPU_METHOD SY_DSLSPS_Compu "" TAB_VERB "%6.3" "" COMPU_TAB_REF SY_DSLSPS_Compu /end COMPU_METHOD
/begin COMPU_VTAB SY_DSLSPS_Compu "" TAB_VERB 2 0 "DSLSPS_NO" 1 "DSLSPS_POSSIBLE" /end COMPU_VTAB
/begin COMPU_METHOD SY_DSLS_Compu "" TAB_VERB "%6.3" "" COMPU_TAB_REF SY_DSLS_Compu /end COMPU_METHOD
/begin COMPU_VTAB SY_DSLS_Compu "" TAB_VERB 5 0 "keine Sekundärluftdiagnose" 1 "Sekundärluftdiagnose basierend auf Lambdasonde" 2 "Sekundärluftdiagose mittels eines separaten SL_HFM" 3 "Sekundärluftdiagnose basierend auf Sensorik zur FE" 4 "Sekundärluftdiagnose mit Drucksensor" /end COMPU_VTAB
/begin COMPU_METHOD SY_DSMSUS_Compu "" TAB_VERB "%6.3" "" COMPU_TAB_REF SY_DSMSUS_Compu /end COMPU_METHOD
/begin COMPU_VTAB SY_DSMSUS_Compu "" TAB_VERB 2 0 "False" 1 "True" /end COMPU_VTAB
/begin COMPU_METHOD SY_DSMSWOF_Compu "" TAB_VERB "%6.3" "" COMPU_TAB_REF SY_DSMSWOF_Compu /end COMPU_METHOD
/begin COMPU_VTAB SY_DSMSWOF_Compu "" TAB_VERB 2 0 "Ablaufsteuerung von DSM im Nachlauf-Task inaktiv" 1 "Ablaufsteuerung von DSM im Nachlauf-Task aktiv" /end COMPU_VTAB
/begin COMPU_METHOD SY_DSM_Compu "" TAB_VERB "%6.3" "" COMPU_TAB_REF SY_DSM_Compu /end COMPU_METHOD
/begin COMPU_VTAB SY_DSM_Compu "" TAB_VERB 2 0 "kein DSM vorhanden" 1 "DSM vorhanden" /end COMPU_VTAB
/begin COMPU_METHOD SY_DSNDK_Compu "" TAB_VERB "%6.3" "" COMPU_TAB_REF SY_DSNDK_Compu /end COMPU_METHOD
/begin COMPU_VTAB SY_DSNDK_Compu "" TAB_VERB 2 0 "no pressure sensor downstream throttle valve insta" 1 "pressure sensor downstream throttle valve installe" /end COMPU_VTAB
/begin COMPU_METHOD SY_DSS2_Compu "" TAB_VERB "%6.3" "" COMPU_TAB_REF SY_DSS2_Compu /end COMPU_METHOD
/begin COMPU_VTAB SY_DSS2_Compu "" TAB_VERB 2 0 "kein zweiter Drucksensor im Saugrohr verbaut" 1 "zweiter Drucksensor im Saugrohr verbaut" /end COMPU_VTAB
/begin COMPU_METHOD SY_DSS_Compu "" TAB_VERB "%6.3" "" COMPU_TAB_REF SY_DSS_Compu /end COMPU_METHOD
/begin COMPU_VTAB SY_DSS_Compu "" TAB_VERB 2 0 "kein Drucksensor im Saugrohr verbaut" 1 "Drucksensor im Saugrohr verbaut" /end COMPU_VTAB
/begin COMPU_METHOD SY_DSTD_Compu "" TAB_VERB "%6.3" "" COMPU_TAB_REF SY_DSTD_Compu /end COMPU_METHOD
/begin COMPU_VTAB SY_DSTD_Compu "" TAB_VERB 2 0 "False" 1 "True" /end COMPU_VTAB
/begin COMPU_METHOD SY_DSU_Compu "" TAB_VERB "%6.3" "" COMPU_TAB_REF SY_DSU_Compu /end COMPU_METHOD
/begin COMPU_VTAB SY_DSU_Compu "" TAB_VERB 2 0 "kein Umgebungsdrucksensor verbaut" 1 "Umgebungsdrucksensor verbaut" /end COMPU_VTAB
/begin COMPU_METHOD SY_DSV2V_Compu "" TAB_VERB "%6.3" "" COMPU_TAB_REF SY_DSV2V_Compu /end COMPU_METHOD
/begin COMPU_VTAB SY_DSV2V_Compu "" TAB_VERB 2 0 "kein Drucksensor vor zweitem Verdichter vorhanden" 1 "Drucksensor vor zweitem Verdichter vorhanden" /end COMPU_VTAB
/begin COMPU_METHOD SY_DSVDK2_Compu "" TAB_VERB "%6.3" "" COMPU_TAB_REF SY_DSVDK2_Compu /end COMPU_METHOD
/begin COMPU_VTAB SY_DSVDK2_Compu "" TAB_VERB 2 0 "kein zweiter Drucksensor vor Drosselklappe verbaut" 1 "zweiter Drucksensor vor Drosselklappe verbaut" /end COMPU_VTAB
/begin COMPU_METHOD SY_DSVDK_Compu "" TAB_VERB "%6.3" "" COMPU_TAB_REF SY_DSVDK_Compu /end COMPU_METHOD
/begin COMPU_VTAB SY_DSVDK_Compu "" TAB_VERB 2 0 "FALSE" 1 "TRUE" /end COMPU_VTAB
/begin COMPU_METHOD SY_DSVV_Compu "" TAB_VERB "%6.3" "" COMPU_TAB_REF SY_DSVV_Compu /end COMPU_METHOD
/begin COMPU_VTAB SY_DSVV_Compu "" TAB_VERB 2 0 "kein Drucksensor vor Verdichter vorhanden" 1 "Drucksensor vor Verdichter vorhanden" /end COMPU_VTAB
/begin COMPU_METHOD SY_DTANKL_Compu "" TAB_VERB "%6.3" "" COMPU_TAB_REF SY_DTANKL_Compu /end COMPU_METHOD
/begin COMPU_VTAB SY_DTANKL_Compu "" TAB_VERB 2 0 "FALSE" 1 "TRUE" /end COMPU_VTAB
/begin COMPU_METHOD t100msxs_uw_b6553p5 "" RAT_FUNC "%6.3" "s" COEFFS 0 1 0 0 0 0.1 /end COMPU_METHOD
/begin COMPU_METHOD Temp_Cels "" RAT_FUNC "%6.1" "deg C" COEFFS 0 10 2731.4 0 0 1 /end COMPU_METHOD
/begin COMPU_METHOD temp_ub_q0p75_o48 "" RAT_FUNC "%6.2" "Grad C" COEFFS 0 1 48 0 0 0.75 /end COMPU_METHOD
/begin COMPU_METHOD TimeDelay_s "" RAT_FUNC "%6.1" "s" COEFFS 0 0 1 0 0.00023283064365387 0 /end COMPU_METHOD
/begin COMPU_METHOD Trq "" RAT_FUNC "%6.3" "Nm" COEFFS 0 10 0 0 0 1 /end COMPU_METHOD
/begin COMPU_METHOD txms_ub_q0p05 "" RAT_FUNC "%6.4" "ms" COEFFS 0 20 0 0 0 1 /end COMPU_METHOD
/begin COMPU_METHOD t_q0p001_ms "" RAT_FUNC "%6.5" "ms" COEFFS 0 1 0 0 0 0.001 /end COMPU_METHOD
/begin COMPU_METHOD t_q0p01 "" RAT_FUNC "%6.4" "s" COEFFS 0 100 0 0 0 1 /end COMPU_METHOD
/begin COMPU_METHOD t_q0p1 "" RAT_FUNC "%6.3" "s" COEFFS 0 10 0 0 0 1 /end COMPU_METHOD
/begin COMPU_METHOD t_q0p2 "" RAT_FUNC "%6.3" "s" COEFFS 0 10 0 0 0 2 /end COMPU_METHOD
/begin COMPU_METHOD t_q2p5Em4 "" RAT_FUNC "%6.5" "s" COEFFS 0 4000 0 0 0 1 /end COMPU_METHOD
/begin COMPU_METHOD Vel "" RAT_FUNC "%6.4" "km/h" COEFFS 0 100 0 0 0 1 /end COMPU_METHOD
/begin COMPU_METHOD vfzg_q0p0078125 "" RAT_FUNC "%6.4" "km/h" COEFFS 0 128 0 0 0 1 /end COMPU_METHOD
/begin COMPU_METHOD vfzg_uw_b512 "" RAT_FUNC "%6.4" "km/h" COEFFS 0 65536 0 0 0 512 /end COMPU_METHOD
/begin COMPU_METHOD zk10msxs_uw_b655 "" RAT_FUNC "%6.2" "s" COEFFS 0 0 65536 0 100 0 /end COMPU_METHOD
/begin COMPU_METHOD zk200msxs_ub_b51p2 "" RAT_FUNC "%6.3" "s" COEFFS 0 0 256 0 5 0 /end COMPU_METHOD
/begin COMPU_METHOD zk200msxs_uw_b13107 "" RAT_FUNC "%6.0" "s" COEFFS 0 0 13107.2 0 1 0 /end COMPU_METHOD
/begin COMPU_METHOD zk20msxs_uw_b1310 "" RAT_FUNC "%6.1" "s" COEFFS 0 0 65536 0 50 0 /end COMPU_METHOD
/begin COMPU_METHOD zk20msxs_uw_b1310p72 "" RAT_FUNC "%6.1" "s" COEFFS 0 0 65536 0 50 0 /end COMPU_METHOD
/begin COMPU_METHOD zw_q2p9297Em3_deg_KW "" RAT_FUNC "%6.4" "deg KW" COEFFS 0 1024 0 0 0 3 /end COMPU_METHOD
/begin RECORD_LAYOUT RB_Axis_S8 NO_AXIS_PTS_X 1 SBYTE AXIS_PTS_X 2 SBYTE INDEX_INCR DIRECT /end RECORD_LAYOUT
/begin RECORD_LAYOUT RB_Axis_U16 NO_AXIS_PTS_X 1 UWORD AXIS_PTS_X 2 UWORD INDEX_INCR DIRECT /end RECORD_LAYOUT
/begin RECORD_LAYOUT RB_Axis_U8 NO_AXIS_PTS_X 1 UBYTE AXIS_PTS_X 2 UBYTE INDEX_INCR DIRECT /end RECORD_LAYOUT
/begin RECORD_LAYOUT RB_Curve_S16_S16 NO_AXIS_PTS_X 1 SWORD AXIS_PTS_X 2 SWORD INDEX_INCR DIRECT FNC_VALUES 3 SWORD COLUMN_DIR DIRECT /end RECORD_LAYOUT
/begin RECORD_LAYOUT RB_Curve_S16_U16_Static NO_AXIS_PTS_X 1 SWORD AXIS_PTS_X 2 SWORD INDEX_INCR DIRECT FNC_VALUES 3 UWORD COLUMN_DIR DIRECT STATIC_RECORD_LAYOUT /end RECORD_LAYOUT
/begin RECORD_LAYOUT RB_Curve_S16_U8_Static NO_AXIS_PTS_X 1 SWORD AXIS_PTS_X 2 SWORD INDEX_INCR DIRECT FNC_VALUES 3 UBYTE COLUMN_DIR DIRECT STATIC_RECORD_LAYOUT /end RECORD_LAYOUT
/begin RECORD_LAYOUT RB_Curve_U16_U16 NO_AXIS_PTS_X 1 UWORD AXIS_PTS_X 2 UWORD INDEX_INCR DIRECT FNC_VALUES 3 UWORD COLUMN_DIR DIRECT /end RECORD_LAYOUT
/begin RECORD_LAYOUT RB_Curve_U16_U8_Static NO_AXIS_PTS_X 1 UWORD AXIS_PTS_X 2 UWORD INDEX_INCR DIRECT FNC_VALUES 3 UBYTE COLUMN_DIR DIRECT STATIC_RECORD_LAYOUT /end RECORD_LAYOUT
/begin RECORD_LAYOUT RB_Curve_U8_S16_Static NO_AXIS_PTS_X 1 UBYTE AXIS_PTS_X 2 UBYTE INDEX_INCR DIRECT FNC_VALUES 3 SWORD COLUMN_DIR DIRECT STATIC_RECORD_LAYOUT /end RECORD_LAYOUT
/begin RECORD_LAYOUT RB_Curve_U8_S8_Static NO_AXIS_PTS_X 1 UBYTE AXIS_PTS_X 2 UBYTE INDEX_INCR DIRECT FNC_VALUES 3 SBYTE COLUMN_DIR DIRECT STATIC_RECORD_LAYOUT /end RECORD_LAYOUT
/begin RECORD_LAYOUT RB_Curve_U8_U16_Static NO_AXIS_PTS_X 1 UBYTE AXIS_PTS_X 2 UBYTE INDEX_INCR DIRECT FNC_VALUES 3 UWORD COLUMN_DIR DIRECT STATIC_RECORD_LAYOUT /end RECORD_LAYOUT
/begin RECORD_LAYOUT RB_Curve_U8_U8 NO_AXIS_PTS_X 1 UBYTE AXIS_PTS_X 2 UBYTE INDEX_INCR DIRECT FNC_VALUES 3 UBYTE COLUMN_DIR DIRECT /end RECORD_LAYOUT
/begin RECORD_LAYOUT RB_FixCurve_S8_S8 FNC_VALUES 1 SBYTE COLUMN_DIR DIRECT /end RECORD_LAYOUT
/begin RECORD_LAYOUT RB_MapGroup_S16 FNC_VALUES 1 SWORD COLUMN_DIR DIRECT /end RECORD_LAYOUT
/begin RECORD_LAYOUT RB_MapGroup_U8 FNC_VALUES 1 UBYTE COLUMN_DIR DIRECT /end RECORD_LAYOUT
/begin RECORD_LAYOUT RB_Map_S16S16_S32 NO_AXIS_PTS_X 1 SWORD NO_AXIS_PTS_Y 2 SWORD AXIS_PTS_X 3 SWORD INDEX_INCR DIRECT AXIS_PTS_Y 4 SWORD INDEX_INCR DIRECT FNC_VALUES 5 SLONG COLUMN_DIR DIRECT /end RECORD_LAYOUT
/begin RECORD_LAYOUT RB_Map_S16S16_U16 NO_AXIS_PTS_X 1 SWORD NO_AXIS_PTS_Y 2 SWORD AXIS_PTS_X 3 SWORD INDEX_INCR DIRECT AXIS_PTS_Y 4 SWORD INDEX_INCR DIRECT FNC_VALUES 5 UWORD COLUMN_DIR DIRECT /end RECORD_LAYOUT
/begin RECORD_LAYOUT RB_Map_S16S16_U8 NO_AXIS_PTS_X 1 SWORD NO_AXIS_PTS_Y 2 SWORD AXIS_PTS_X 3 SWORD INDEX_INCR DIRECT AXIS_PTS_Y 4 SWORD INDEX_INCR DIRECT FNC_VALUES 5 UBYTE COLUMN_DIR DIRECT /end RECORD_LAYOUT
/begin RECORD_LAYOUT RB_Map_U16U16_U16 NO_AXIS_PTS_X 1 UWORD NO_AXIS_PTS_Y 2 UWORD AXIS_PTS_X 3 UWORD INDEX_INCR DIRECT AXIS_PTS_Y 4 UWORD INDEX_INCR DIRECT FNC_VALUES 5 UWORD COLUMN_DIR DIRECT /end RECORD_LAYOUT
/begin RECORD_LAYOUT RB_Map_U8U16_S8 NO_AXIS_PTS_X 1 UBYTE NO_AXIS_PTS_Y 2 UBYTE AXIS_PTS_X 3 UBYTE INDEX_INCR DIRECT AXIS_PTS_Y 4 UWORD INDEX_INCR DIRECT FNC_VALUES 5 SBYTE ROW_DIR DIRECT /end RECORD_LAYOUT
/begin RECORD_LAYOUT RB_Map_U8U16_U16 NO_AXIS_PTS_X 1 UBYTE NO_AXIS_PTS_Y 2 UBYTE AXIS_PTS_X 3 UBYTE INDEX_INCR DIRECT AXIS_PTS_Y 4 UWORD INDEX_INCR DIRECT FNC_VALUES 5 UWORD ROW_DIR DIRECT /end RECORD_LAYOUT
/begin RECORD_LAYOUT RB_Map_U8U16_U8 NO_AXIS_PTS_X 1 UBYTE NO_AXIS_PTS_Y 2 UBYTE AXIS_PTS_X 3 UBYTE INDEX_INCR DIRECT AXIS_PTS_Y 4 UWORD INDEX_INCR DIRECT FNC_VALUES 5 UBYTE ROW_DIR DIRECT /end RECORD_LAYOUT
/begin RECORD_LAYOUT RB_Map_U8U8_U16 NO_AXIS_PTS_X 1 UBYTE NO_AXIS_PTS_Y 2 UBYTE AXIS_PTS_X 3 UBYTE INDEX_INCR DIRECT AXIS_PTS_Y 4 UBYTE INDEX_INCR DIRECT FNC_VALUES 5 UWORD COLUMN_DIR DIRECT /end RECORD_LAYOUT
/begin RECORD_LAYOUT RB_Val_Wboolean FNC_VALUES 1 UBYTE COLUMN_DIR DIRECT /end RECORD_LAYOUT
/begin RECORD_LAYOUT RB_Val_Ws16 FNC_VALUES 1 SWORD COLUMN_DIR DIRECT /end RECORD_LAYOUT
/begin RECORD_LAYOUT RB_Val_Ws32 FNC_VALUES 1 SLONG COLUMN_DIR DIRECT /end RECORD_LAYOUT
/begin RECORD_LAYOUT RB_Val_Ws8 FNC_VALUES 1 SBYTE COLUMN_DIR DIRECT /end RECORD_LAYOUT
/begin RECORD_LAYOUT RB_Val_Wu16 FNC_VALUES 1 UWORD COLUMN_DIR DIRECT /end RECORD_LAYOUT
/begin RECORD_LAYOUT RB_Val_Wu8 FNC_VALUES 1 UBYTE COLUMN_DIR DIRECT /end RECORD_LAYOUT
/begin RECORD_LAYOUT ValA_Ws16 FNC_VALUES 1 SWORD COLUMN_DIR DIRECT /end RECORD_LAYOUT
/begin RECORD_LAYOUT Val_Wu8 FNC_VALUES 1 UBYTE COLUMN_DIR DIRECT /end RECORD_LAYOUT
/end MODULE
/end PROJECT
