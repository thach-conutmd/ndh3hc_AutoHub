ASAP2_VERSION 1 60
/begin PROJECT MG1CS022 "MG1CS022"
/begin HEADER "" VERSION "MG1CS022_62XSC_V037" PROJECT_NO MG1CS022 /end HEADER
/begin MODULE DIM ""
/begin MOD_COMMON "" BYTE_ORDER MSB_LAST ALIGNMENT_BYTE 1 ALIGNMENT_WORD 2 ALIGNMENT_LONG 4 ALIGNMENT_INT64 4 ALIGNMENT_FLOAT32_IEEE 4 ALIGNMENT_FLOAT64_IEEE 4 DATA_SIZE 32 /end MOD_COMMON
/begin AXIS_PTS MoFESpd_nEng_Ax "Data point distribution for engine speed in engine speed monitoring" 0x80591BF8 MoFESpd_nEng Axis_Xu8 10200. nmot_q40 8 0.00 10200. FORMAT "%5.0" DEPOSIT ABSOLUTE /end AXIS_PTS
/begin CHARACTERISTIC MoFFrm_Rx_DataPdu_AYCF.bufLen_C "Structure instance of PDU AYCF / parameter to indicate the buffer length of the receiving PDU" VALUE 0x8059611C Val_Wu8 255.0 OneToOne 0.00 255.0 FORMAT "%5.1" READ_ONLY /end CHARACTERISTIC
/begin CHARACTERISTIC MoFFrm_Rx_DataPdu_AYCF.bytOrderAlvCntr_C "Structure instance of PDU AYCF / Alive counter calibration of RX Data Pdu" VALUE 0x8059611D Val_Wu8 1.000 OneToOne 0.00 1.000 FORMAT "%5.3" EXTENDED_LIMITS 0.00 255.0 READ_ONLY /end CHARACTERISTIC
/begin CHARACTERISTIC MoFFrm_Rx_DataPdu_AYCF.bytOrderCrc_C "Structure instance of PDU AYCF / CRC calibration of RX Data Pdu" VALUE 0x8059611E Val_Wu8 1.000 OneToOne 0.00 1.000 FORMAT "%5.3" EXTENDED_LIMITS 0.00 255.0 READ_ONLY /end CHARACTERISTIC
/begin CHARACTERISTIC MoFFrm_Rx_DataPdu_AYCF.cntrAlvErrDeb_C "Structure instance of PDU AYCF / Alive counter debounce error calibration of RX Data Pdu" VALUE 0x80596120 Val_Wu16 65535.00 OneToOne 0.00 65535.00 FORMAT "%8.2" /end CHARACTERISTIC
/begin CHARACTERISTIC MoFFrm_Rx_DataPdu_AYCF.cntrCrcErrDeb_C "Structure instance of PDU AYCF / Alive counter debounce error calibration of RX Data Pdu" VALUE 0x80596122 Val_Wu16 65535.00 OneToOne 0.00 65535.00 FORMAT "%8.2" /end CHARACTERISTIC
/begin CHARACTERISTIC MoFFrm_Rx_DataPdu_AYCF.cntrMaxAlvDif_C "Structure instance of PDU AYCF / Complement of Counter cyclic calibration of RX Data Pdu" VALUE 0x80596124 Val_Wu8 255.0 OneToOne 0.00 255.0 FORMAT "%5.1" /end CHARACTERISTIC
/begin CHARACTERISTIC MoFFrm_Rx_DataPdu_AYCF.cntrTiOutDeb_C "Structure instance of PDU AYCF / Counter time out debounce calibration of Rx data PDU" VALUE 0x80596126 Val_Wu16 65535.00 OneToOne 0.00 65535.00 FORMAT "%8.2" /end CHARACTERISTIC
/begin CHARACTERISTIC MoFFrm_Rx_DataPdu_AYCF.crcId_C "Structure instance of PDU AYCF / CRC ID of Rx data PDU" VALUE 0x80596128 Val_Wu32 4294967295.00 OneToOne 0.00 4294967295.00 FORMAT "%13.2" /end CHARACTERISTIC
/begin CHARACTERISTIC MoFFrm_Rx_DataPdu_AYCF.cycTi_C "Structure instance of PDU AYCF / cycle time from bus matrix" VALUE 0x8059612C Val_Wu16 65535.00 OneToOne 0.00 65535.00 FORMAT "%8.2" READ_ONLY /end CHARACTERISTIC
/begin CHARACTERISTIC MoFFrm_Rx_DataPdu_AYCF.diChks_C "Structure instance of PDU AYCF / parameter to enable or disable manipulation of various checks" VALUE 0x8059612E Val_Wu8 255.0 OneToOne 0.00 255.0 FORMAT "%5.1" /end CHARACTERISTIC
/begin CHARACTERISTIC MoFFrm_Rx_DataPdu_AYCF.evalType_C "Structure instance of PDU AYCF / evaluation type" VALUE 0x8059612F Val_Wu8 255.0 OneToOne 0.00 255.0 FORMAT "%5.1" READ_ONLY /end CHARACTERISTIC
/begin CHARACTERISTIC MoFFrm_Rx_DataPdu_AYCF.maskAlvCntr_C "Structure instance of PDU AYCF / Alive counter start bit position of Rx data PDU" VALUE 0x80596130 Val_Wu8 255.0 OneToOne 0.00 255.0 FORMAT "%5.1" /end CHARACTERISTIC
/begin CHARACTERISTIC MoFFrm_Rx_DataPdu_AYCF.posnAlvCntrStrtBit_C "Structure instance of PDU AYCF / Alive counter start bit calibration of of Data PDU Rx" VALUE 0x80596132 Val_Wu16 65535.00 OneToOne 0.00 65535.00 FORMAT "%8.2" READ_ONLY /end CHARACTERISTIC
/begin CHARACTERISTIC MoFFrm_Rx_DataPdu_AYCF.posnCrcCalcEndByte_C "Structure instance of PDU AYCF / End byte of CRC calculation position of Data PDU Rx" VALUE 0x80596134 Val_Wu8 255.0 OneToOne 0.00 255.0 FORMAT "%5.1" /end CHARACTERISTIC
/begin CHARACTERISTIC MoFFrm_Rx_DataPdu_AYCF.posnCrcCalcStrtByte_C "Structure instance of PDU AYCF / Start byte of CRC calculation position of Data PDU Rx" VALUE 0x80596135 Val_Wu8 255.0 OneToOne 0.00 255.0 FORMAT "%5.1" /end CHARACTERISTIC
/begin CHARACTERISTIC MoFFrm_Rx_DataPdu_AYCF.posnCrcStrtBit_C "Structure instance of PDU AYCF / CRC start bit position of Rx data PDU" VALUE 0x80596136 Val_Wu16 65535.00 OneToOne 0.00 65535.00 FORMAT "%8.2" READ_ONLY /end CHARACTERISTIC
/begin CHARACTERISTIC MoFFrm_Rx_DataPdu_AYCF.sigLenAlvCntr_C "Structure instance of PDU AYCF / Alive counter signal length of Rx data PDU" VALUE 0x80596138 Val_Wu8 31.00 OneToOne 1.00 32.00 FORMAT "%5.2" EXTENDED_LIMITS 0.00 255.0 READ_ONLY /end CHARACTERISTIC
/begin CHARACTERISTIC MoFFrm_Rx_DataPdu_AYCF.sigLenCrc_C "Structure instance of PDU AYCF / CRC calibration signal length of Rx data PDU" VALUE 0x80596139 Val_Wu8 31.00 OneToOne 1.00 32.00 FORMAT "%5.2" EXTENDED_LIMITS 0.00 255.0 READ_ONLY /end CHARACTERISTIC
/begin CHARACTERISTIC MoFFrm_Rx_DataPdu_EAT1.bufLen_C "Structure instance of PDU EAT1 / parameter to indicate the buffer length of the receiving PDU" VALUE 0x80596144 Val_Wu8 255.0 OneToOne 0.00 255.0 FORMAT "%5.1" READ_ONLY /end CHARACTERISTIC
/begin CHARACTERISTIC MoFFrm_Rx_DataPdu_EAT1.bytOrderAlvCntr_C "Structure instance of PDU EAT1 / Alive counter calibration of RX Data Pdu" VALUE 0x80596145 Val_Wu8 1.000 OneToOne 0.00 1.000 FORMAT "%5.3" EXTENDED_LIMITS 0.00 255.0 READ_ONLY /end CHARACTERISTIC
/begin CHARACTERISTIC MoFFrm_Rx_DataPdu_EAT1.bytOrderCrc_C "Structure instance of PDU EAT1 / CRC calibration of RX Data Pdu" VALUE 0x80596146 Val_Wu8 1.000 OneToOne 0.00 1.000 FORMAT "%5.3" EXTENDED_LIMITS 0.00 255.0 READ_ONLY /end CHARACTERISTIC
/begin CHARACTERISTIC MoFFrm_Rx_DataPdu_EAT1.cntrAlvErrDeb_C "Structure instance of PDU EAT1 / Alive counter debounce error calibration of RX Data Pdu" VALUE 0x80596148 Val_Wu16 65535.00 OneToOne 0.00 65535.00 FORMAT "%8.2" /end CHARACTERISTIC
/begin CHARACTERISTIC MoFFrm_Rx_DataPdu_EAT1.cntrCrcErrDeb_C "Structure instance of PDU EAT1 / Alive counter debounce error calibration of RX Data Pdu" VALUE 0x8059614A Val_Wu16 65535.00 OneToOne 0.00 65535.00 FORMAT "%8.2" /end CHARACTERISTIC
/begin CHARACTERISTIC MoFFrm_Rx_DataPdu_EAT1.cntrMaxAlvDif_C "Structure instance of PDU EAT1 / Complement of Counter cyclic calibration of RX Data Pdu" VALUE 0x8059614C Val_Wu8 255.0 OneToOne 0.00 255.0 FORMAT "%5.1" /end CHARACTERISTIC
/begin CHARACTERISTIC MoFFrm_Rx_DataPdu_EAT1.cntrTiOutDeb_C "Structure instance of PDU EAT1 / Counter time out debounce calibration of Rx data PDU" VALUE 0x8059614E Val_Wu16 65535.00 OneToOne 0.00 65535.00 FORMAT "%8.2" /end CHARACTERISTIC
/begin CHARACTERISTIC MoFFrm_Rx_DataPdu_EAT1.crcId_C "Structure instance of PDU EAT1 / CRC ID of Rx data PDU" VALUE 0x80596150 Val_Wu32 4294967295.00 OneToOne 0.00 4294967295.00 FORMAT "%13.2" /end CHARACTERISTIC
/begin CHARACTERISTIC MoFFrm_Rx_DataPdu_EAT1.cycTi_C "Structure instance of PDU EAT1 / cycle time from bus matrix" VALUE 0x80596154 Val_Wu16 65535.00 OneToOne 0.00 65535.00 FORMAT "%8.2" READ_ONLY /end CHARACTERISTIC
/begin CHARACTERISTIC MoFFrm_Rx_DataPdu_EAT1.diChks_C "Structure instance of PDU EAT1 / parameter to enable or disable manipulation of various checks" VALUE 0x80596156 Val_Wu8 255.0 OneToOne 0.00 255.0 FORMAT "%5.1" /end CHARACTERISTIC
/begin CHARACTERISTIC MoFFrm_Rx_DataPdu_EAT1.evalType_C "Structure instance of PDU EAT1 / evaluation type" VALUE 0x80596157 Val_Wu8 255.0 OneToOne 0.00 255.0 FORMAT "%5.1" READ_ONLY /end CHARACTERISTIC
/begin CHARACTERISTIC MoFFrm_Rx_DataPdu_EAT1.maskAlvCntr_C "Structure instance of PDU EAT1 / Alive counter start bit position of Rx data PDU" VALUE 0x80596158 Val_Wu8 255.0 OneToOne 0.00 255.0 FORMAT "%5.1" /end CHARACTERISTIC
/begin CHARACTERISTIC MoFFrm_Rx_DataPdu_EAT1.posnAlvCntrStrtBit_C "Structure instance of PDU EAT1 / Alive counter start bit calibration of of Data PDU Rx" VALUE 0x8059615A Val_Wu16 65535.00 OneToOne 0.00 65535.00 FORMAT "%8.2" READ_ONLY /end CHARACTERISTIC
/begin CHARACTERISTIC MoFFrm_Rx_DataPdu_EAT1.posnCrcCalcEndByte_C "Structure instance of PDU EAT1 / End byte of CRC calculation position of Data PDU Rx" VALUE 0x8059615C Val_Wu8 255.0 OneToOne 0.00 255.0 FORMAT "%5.1" /end CHARACTERISTIC
/begin CHARACTERISTIC MoFFrm_Rx_DataPdu_EAT1.posnCrcCalcStrtByte_C "Structure instance of PDU EAT1 / Start byte of CRC calculation position of Data PDU Rx" VALUE 0x8059615D Val_Wu8 255.0 OneToOne 0.00 255.0 FORMAT "%5.1" /end CHARACTERISTIC
/begin CHARACTERISTIC MoFFrm_Rx_DataPdu_EAT1.posnCrcStrtBit_C "Structure instance of PDU EAT1 / CRC start bit position of Rx data PDU" VALUE 0x8059615E Val_Wu16 65535.00 OneToOne 0.00 65535.00 FORMAT "%8.2" READ_ONLY /end CHARACTERISTIC
/begin CHARACTERISTIC MoFFrm_Rx_DataPdu_EAT1.sigLenAlvCntr_C "Structure instance of PDU EAT1 / Alive counter signal length of Rx data PDU" VALUE 0x80596160 Val_Wu8 31.00 OneToOne 1.00 32.00 FORMAT "%5.2" EXTENDED_LIMITS 0.00 255.0 READ_ONLY /end CHARACTERISTIC
/begin CHARACTERISTIC MoFFrm_Rx_DataPdu_EAT1.sigLenCrc_C "Structure instance of PDU EAT1 / CRC calibration signal length of Rx data PDU" VALUE 0x80596161 Val_Wu8 31.00 OneToOne 1.00 32.00 FORMAT "%5.2" EXTENDED_LIMITS 0.00 255.0 READ_ONLY /end CHARACTERISTIC
/begin CHARACTERISTIC MoFFrm_Rx_DataPdu_EAT12.bufLen_C "Data PDU of EAT12 / parameter to indicate the buffer length of the receiving PDU" VALUE 0x8059616C Val_Wu8 255.0 OneToOne 0.00 255.0 FORMAT "%5.1" READ_ONLY /end CHARACTERISTIC
/begin CHARACTERISTIC MoFFrm_Rx_DataPdu_EAT12.bytOrderAlvCntr_C "Data PDU of EAT12 / Alive counter calibration of RX Data Pdu" VALUE 0x8059616D Val_Wu8 1.000 OneToOne 0.00 1.000 FORMAT "%5.3" EXTENDED_LIMITS 0.00 255.0 READ_ONLY /end CHARACTERISTIC
/begin CHARACTERISTIC MoFFrm_Rx_DataPdu_EAT12.bytOrderCrc_C "Data PDU of EAT12 / CRC calibration of RX Data Pdu" VALUE 0x8059616E Val_Wu8 1.000 OneToOne 0.00 1.000 FORMAT "%5.3" EXTENDED_LIMITS 0.00 255.0 READ_ONLY /end CHARACTERISTIC
/begin CHARACTERISTIC MoFFrm_Rx_DataPdu_EAT12.cntrAlvErrDeb_C "Data PDU of EAT12 / Alive counter debounce error calibration of RX Data Pdu" VALUE 0x80596170 Val_Wu16 65535.00 OneToOne 0.00 65535.00 FORMAT "%8.2" /end CHARACTERISTIC
/begin CHARACTERISTIC MoFFrm_Rx_DataPdu_EAT12.cntrCrcErrDeb_C "Data PDU of EAT12 / Alive counter debounce error calibration of RX Data Pdu" VALUE 0x80596172 Val_Wu16 65535.00 OneToOne 0.00 65535.00 FORMAT "%8.2" /end CHARACTERISTIC
/begin CHARACTERISTIC MoFFrm_Rx_DataPdu_EAT12.cntrMaxAlvDif_C "Data PDU of EAT12 / Complement of Counter cyclic calibration of RX Data Pdu" VALUE 0x80596174 Val_Wu8 255.0 OneToOne 0.00 255.0 FORMAT "%5.1" /end CHARACTERISTIC
/begin CHARACTERISTIC MoFFrm_Rx_DataPdu_EAT12.cntrTiOutDeb_C "Data PDU of EAT12 / Counter time out debounce calibration of Rx data PDU" VALUE 0x80596176 Val_Wu16 65535.00 OneToOne 0.00 65535.00 FORMAT "%8.2" /end CHARACTERISTIC
/begin CHARACTERISTIC MoFFrm_Rx_DataPdu_EAT12.crcId_C "Data PDU of EAT12 / CRC ID of Rx data PDU" VALUE 0x80596178 Val_Wu32 4294967295.00 OneToOne 0.00 4294967295.00 FORMAT "%13.2" /end CHARACTERISTIC
/begin CHARACTERISTIC MoFFrm_Rx_DataPdu_EAT12.cycTi_C "Data PDU of EAT12 / cycle time from bus matrix" VALUE 0x8059617C Val_Wu16 65535.00 OneToOne 0.00 65535.00 FORMAT "%8.2" READ_ONLY /end CHARACTERISTIC
/begin CHARACTERISTIC MoFFrm_Rx_DataPdu_EAT12.diChks_C "Data PDU of EAT12 / parameter to enable or disable manipulation of various checks" VALUE 0x8059617E Val_Wu8 255.0 OneToOne 0.00 255.0 FORMAT "%5.1" /end CHARACTERISTIC
/begin CHARACTERISTIC MoFFrm_Rx_DataPdu_EAT12.evalType_C "Data PDU of EAT12 / evaluation type" VALUE 0x8059617F Val_Wu8 255.0 OneToOne 0.00 255.0 FORMAT "%5.1" READ_ONLY /end CHARACTERISTIC
/begin CHARACTERISTIC MoFFrm_Rx_DataPdu_EAT12.maskAlvCntr_C "Data PDU of EAT12 / Alive counter start bit position of Rx data PDU" VALUE 0x80596180 Val_Wu8 255.0 OneToOne 0.00 255.0 FORMAT "%5.1" /end CHARACTERISTIC
/begin CHARACTERISTIC MoFFrm_Rx_DataPdu_EAT12.posnAlvCntrStrtBit_C "Data PDU of EAT12 / Alive counter start bit calibration of of Data PDU Rx" VALUE 0x80596182 Val_Wu16 65535.00 OneToOne 0.00 65535.00 FORMAT "%8.2" READ_ONLY /end CHARACTERISTIC
/begin CHARACTERISTIC MoFFrm_Rx_DataPdu_EAT12.posnCrcCalcEndByte_C "Data PDU of EAT12 / End byte of CRC calculation position of Data PDU Rx" VALUE 0x80596184 Val_Wu8 255.0 OneToOne 0.00 255.0 FORMAT "%5.1" /end CHARACTERISTIC
/begin CHARACTERISTIC MoFFrm_Rx_DataPdu_EAT12.posnCrcCalcStrtByte_C "Data PDU of EAT12 / Start byte of CRC calculation position of Data PDU Rx" VALUE 0x80596185 Val_Wu8 255.0 OneToOne 0.00 255.0 FORMAT "%5.1" /end CHARACTERISTIC
/begin CHARACTERISTIC MoFFrm_Rx_DataPdu_EAT12.posnCrcStrtBit_C "Data PDU of EAT12 / CRC start bit position of Rx data PDU" VALUE 0x80596186 Val_Wu16 65535.00 OneToOne 0.00 65535.00 FORMAT "%8.2" READ_ONLY /end CHARACTERISTIC
/begin CHARACTERISTIC MoFFrm_Rx_DataPdu_EAT12.sigLenAlvCntr_C "Data PDU of EAT12 / Alive counter signal length of Rx data PDU" VALUE 0x80596188 Val_Wu8 31.00 OneToOne 1.00 32.00 FORMAT "%5.2" EXTENDED_LIMITS 0.00 255.0 READ_ONLY /end CHARACTERISTIC
/begin CHARACTERISTIC MoFFrm_Rx_DataPdu_EAT12.sigLenCrc_C "Data PDU of EAT12 / CRC calibration signal length of Rx data PDU" VALUE 0x80596189 Val_Wu8 31.00 OneToOne 1.00 32.00 FORMAT "%5.2" EXTENDED_LIMITS 0.00 255.0 READ_ONLY /end CHARACTERISTIC
/begin CHARACTERISTIC MoFFrm_Rx_DataPdu_EAT13.bufLen_C "Data PDU of EAT13 / parameter to indicate the buffer length of the receiving PDU" VALUE 0x80596194 Val_Wu8 255.0 OneToOne 0.00 255.0 FORMAT "%5.1" READ_ONLY /end CHARACTERISTIC
/begin CHARACTERISTIC MoFFrm_Rx_DataPdu_EAT13.bytOrderAlvCntr_C "Data PDU of EAT13 / Alive counter calibration of RX Data Pdu" VALUE 0x80596195 Val_Wu8 1.000 OneToOne 0.00 1.000 FORMAT "%5.3" EXTENDED_LIMITS 0.00 255.0 READ_ONLY /end CHARACTERISTIC
/begin CHARACTERISTIC MoFFrm_Rx_DataPdu_EAT13.bytOrderCrc_C "Data PDU of EAT13 / CRC calibration of RX Data Pdu" VALUE 0x80596196 Val_Wu8 1.000 OneToOne 0.00 1.000 FORMAT "%5.3" EXTENDED_LIMITS 0.00 255.0 READ_ONLY /end CHARACTERISTIC
/begin CHARACTERISTIC MoFFrm_Rx_DataPdu_EAT13.cntrAlvErrDeb_C "Data PDU of EAT13 / Alive counter debounce error calibration of RX Data Pdu" VALUE 0x80596198 Val_Wu16 65535.00 OneToOne 0.00 65535.00 FORMAT "%8.2" /end CHARACTERISTIC
/begin CHARACTERISTIC MoFFrm_Rx_DataPdu_EAT13.cntrCrcErrDeb_C "Data PDU of EAT13 / Alive counter debounce error calibration of RX Data Pdu" VALUE 0x8059619A Val_Wu16 65535.00 OneToOne 0.00 65535.00 FORMAT "%8.2" /end CHARACTERISTIC
/begin CHARACTERISTIC MoFFrm_Rx_DataPdu_EAT13.cntrMaxAlvDif_C "Data PDU of EAT13 / Complement of Counter cyclic calibration of RX Data Pdu" VALUE 0x8059619C Val_Wu8 255.0 OneToOne 0.00 255.0 FORMAT "%5.1" /end CHARACTERISTIC
/begin CHARACTERISTIC MoFFrm_Rx_DataPdu_EAT13.cntrTiOutDeb_C "Data PDU of EAT13 / Counter time out debounce calibration of Rx data PDU" VALUE 0x8059619E Val_Wu16 65535.00 OneToOne 0.00 65535.00 FORMAT "%8.2" /end CHARACTERISTIC
/begin CHARACTERISTIC MoFFrm_Rx_DataPdu_EAT13.crcId_C "Data PDU of EAT13 / CRC ID of Rx data PDU" VALUE 0x805961A0 Val_Wu32 4294967295.00 OneToOne 0.00 4294967295.00 FORMAT "%13.2" /end CHARACTERISTIC
/begin CHARACTERISTIC MoFFrm_Rx_DataPdu_EAT13.cycTi_C "Data PDU of EAT13 / cycle time from bus matrix" VALUE 0x805961A4 Val_Wu16 65535.00 OneToOne 0.00 65535.00 FORMAT "%8.2" READ_ONLY /end CHARACTERISTIC
/begin CHARACTERISTIC MoFFrm_Rx_DataPdu_EAT13.diChks_C "Data PDU of EAT13 / parameter to enable or disable manipulation of various checks" VALUE 0x805961A6 Val_Wu8 255.0 OneToOne 0.00 255.0 FORMAT "%5.1" /end CHARACTERISTIC
/begin CHARACTERISTIC MoFFrm_Rx_DataPdu_EAT13.evalType_C "Data PDU of EAT13 / evaluation type" VALUE 0x805961A7 Val_Wu8 255.0 OneToOne 0.00 255.0 FORMAT "%5.1" READ_ONLY /end CHARACTERISTIC
/begin CHARACTERISTIC MoFFrm_Rx_DataPdu_EAT13.maskAlvCntr_C "Data PDU of EAT13 / Alive counter start bit position of Rx data PDU" VALUE 0x805961A8 Val_Wu8 255.0 OneToOne 0.00 255.0 FORMAT "%5.1" /end CHARACTERISTIC
/begin CHARACTERISTIC MoFFrm_Rx_DataPdu_EAT13.posnAlvCntrStrtBit_C "Data PDU of EAT13 / Alive counter start bit calibration of of Data PDU Rx" VALUE 0x805961AA Val_Wu16 65535.00 OneToOne 0.00 65535.00 FORMAT "%8.2" READ_ONLY /end CHARACTERISTIC
/begin CHARACTERISTIC MoFFrm_Rx_DataPdu_EAT13.posnCrcCalcEndByte_C "Data PDU of EAT13 / End byte of CRC calculation position of Data PDU Rx" VALUE 0x805961AC Val_Wu8 255.0 OneToOne 0.00 255.0 FORMAT "%5.1" /end CHARACTERISTIC
/begin CHARACTERISTIC MoFFrm_Rx_DataPdu_EAT13.posnCrcCalcStrtByte_C "Data PDU of EAT13 / Start byte of CRC calculation position of Data PDU Rx" VALUE 0x805961AD Val_Wu8 255.0 OneToOne 0.00 255.0 FORMAT "%5.1" /end CHARACTERISTIC
/begin CHARACTERISTIC MoFFrm_Rx_DataPdu_EAT13.posnCrcStrtBit_C "Data PDU of EAT13 / CRC start bit position of Rx data PDU" VALUE 0x805961AE Val_Wu16 65535.00 OneToOne 0.00 65535.00 FORMAT "%8.2" READ_ONLY /end CHARACTERISTIC
/begin CHARACTERISTIC MoFFrm_Rx_DataPdu_EAT13.sigLenAlvCntr_C "Data PDU of EAT13 / Alive counter signal length of Rx data PDU" VALUE 0x805961B0 Val_Wu8 31.00 OneToOne 1.00 32.00 FORMAT "%5.2" EXTENDED_LIMITS 0.00 255.0 READ_ONLY /end CHARACTERISTIC
/begin CHARACTERISTIC MoFFrm_Rx_DataPdu_EAT13.sigLenCrc_C "Data PDU of EAT13 / CRC calibration signal length of Rx data PDU" VALUE 0x805961B1 Val_Wu8 31.00 OneToOne 1.00 32.00 FORMAT "%5.2" EXTENDED_LIMITS 0.00 255.0 READ_ONLY /end CHARACTERISTIC
/begin CHARACTERISTIC MoFFrm_Rx_DataPdu_EAT4.bufLen_C "Structure instance of PDU EAT4 / parameter to indicate the buffer length of the receiving PDU" VALUE 0x805961BC Val_Wu8 255.0 OneToOne 0.00 255.0 FORMAT "%5.1" READ_ONLY /end CHARACTERISTIC
/begin CHARACTERISTIC MoFFrm_Rx_DataPdu_EAT4.bytOrderAlvCntr_C "Structure instance of PDU EAT4 / Alive counter calibration of RX Data Pdu" VALUE 0x805961BD Val_Wu8 1.000 OneToOne 0.00 1.000 FORMAT "%5.3" EXTENDED_LIMITS 0.00 255.0 READ_ONLY /end CHARACTERISTIC
/begin CHARACTERISTIC MoFFrm_Rx_DataPdu_EAT4.bytOrderCrc_C "Structure instance of PDU EAT4 / CRC calibration of RX Data Pdu" VALUE 0x805961BE Val_Wu8 1.000 OneToOne 0.00 1.000 FORMAT "%5.3" EXTENDED_LIMITS 0.00 255.0 READ_ONLY /end CHARACTERISTIC
/begin CHARACTERISTIC MoFFrm_Rx_DataPdu_EAT4.cntrAlvErrDeb_C "Structure instance of PDU EAT4 / Alive counter debounce error calibration of RX Data Pdu" VALUE 0x805961C0 Val_Wu16 65535.00 OneToOne 0.00 65535.00 FORMAT "%8.2" /end CHARACTERISTIC
/begin CHARACTERISTIC MoFFrm_Rx_DataPdu_EAT4.cntrCrcErrDeb_C "Structure instance of PDU EAT4 / Alive counter debounce error calibration of RX Data Pdu" VALUE 0x805961C2 Val_Wu16 65535.00 OneToOne 0.00 65535.00 FORMAT "%8.2" /end CHARACTERISTIC
/begin CHARACTERISTIC MoFFrm_Rx_DataPdu_EAT4.cntrMaxAlvDif_C "Structure instance of PDU EAT4 / Complement of Counter cyclic calibration of RX Data Pdu" VALUE 0x805961C4 Val_Wu8 255.0 OneToOne 0.00 255.0 FORMAT "%5.1" /end CHARACTERISTIC
/begin CHARACTERISTIC MoFFrm_Rx_DataPdu_EAT4.cntrTiOutDeb_C "Structure instance of PDU EAT4 / Counter time out debounce calibration of Rx data PDU" VALUE 0x805961C6 Val_Wu16 65535.00 OneToOne 0.00 65535.00 FORMAT "%8.2" /end CHARACTERISTIC
/begin CHARACTERISTIC MoFFrm_Rx_DataPdu_EAT4.crcId_C "Structure instance of PDU EAT4 / CRC ID of Rx data PDU" VALUE 0x805961C8 Val_Wu32 4294967295.00 OneToOne 0.00 4294967295.00 FORMAT "%13.2" /end CHARACTERISTIC
/begin CHARACTERISTIC MoFFrm_Rx_DataPdu_EAT4.cycTi_C "Structure instance of PDU EAT4 / cycle time from bus matrix" VALUE 0x805961CC Val_Wu16 65535.00 OneToOne 0.00 65535.00 FORMAT "%8.2" READ_ONLY /end CHARACTERISTIC
/begin CHARACTERISTIC MoFFrm_Rx_DataPdu_EAT4.diChks_C "Structure instance of PDU EAT4 / parameter to enable or disable manipulation of various checks" VALUE 0x805961CE Val_Wu8 255.0 OneToOne 0.00 255.0 FORMAT "%5.1" /end CHARACTERISTIC
/begin CHARACTERISTIC MoFFrm_Rx_DataPdu_EAT4.evalType_C "Structure instance of PDU EAT4 / evaluation type" VALUE 0x805961CF Val_Wu8 255.0 OneToOne 0.00 255.0 FORMAT "%5.1" READ_ONLY /end CHARACTERISTIC
/begin CHARACTERISTIC MoFFrm_Rx_DataPdu_EAT4.maskAlvCntr_C "Structure instance of PDU EAT4 / Alive counter start bit position of Rx data PDU" VALUE 0x805961D0 Val_Wu8 255.0 OneToOne 0.00 255.0 FORMAT "%5.1" /end CHARACTERISTIC
/begin CHARACTERISTIC MoFFrm_Rx_DataPdu_EAT4.posnAlvCntrStrtBit_C "Structure instance of PDU EAT4 / Alive counter start bit calibration of of Data PDU Rx" VALUE 0x805961D2 Val_Wu16 65535.00 OneToOne 0.00 65535.00 FORMAT "%8.2" READ_ONLY /end CHARACTERISTIC
/begin CHARACTERISTIC MoFFrm_Rx_DataPdu_EAT4.posnCrcCalcEndByte_C "Structure instance of PDU EAT4 / End byte of CRC calculation position of Data PDU Rx" VALUE 0x805961D4 Val_Wu8 255.0 OneToOne 0.00 255.0 FORMAT "%5.1" /end CHARACTERISTIC
/begin CHARACTERISTIC MoFFrm_Rx_DataPdu_EAT4.posnCrcCalcStrtByte_C "Structure instance of PDU EAT4 / Start byte of CRC calculation position of Data PDU Rx" VALUE 0x805961D5 Val_Wu8 255.0 OneToOne 0.00 255.0 FORMAT "%5.1" /end CHARACTERISTIC
/begin CHARACTERISTIC MoFFrm_Rx_DataPdu_EAT4.posnCrcStrtBit_C "Structure instance of PDU EAT4 / CRC start bit position of Rx data PDU" VALUE 0x805961D6 Val_Wu16 65535.00 OneToOne 0.00 65535.00 FORMAT "%8.2" READ_ONLY /end CHARACTERISTIC
/begin CHARACTERISTIC MoFFrm_Rx_DataPdu_EAT4.sigLenAlvCntr_C "Structure instance of PDU EAT4 / Alive counter signal length of Rx data PDU" VALUE 0x805961D8 Val_Wu8 31.00 OneToOne 1.00 32.00 FORMAT "%5.2" EXTENDED_LIMITS 0.00 255.0 READ_ONLY /end CHARACTERISTIC
/begin CHARACTERISTIC MoFFrm_Rx_DataPdu_EAT4.sigLenCrc_C "Structure instance of PDU EAT4 / CRC calibration signal length of Rx data PDU" VALUE 0x805961D9 Val_Wu8 31.00 OneToOne 1.00 32.00 FORMAT "%5.2" EXTENDED_LIMITS 0.00 255.0 READ_ONLY /end CHARACTERISTIC
/begin CHARACTERISTIC MoFFrm_Rx_DataPdu_EATB.bufLen_C "Data PDU of EATB / parameter to indicate the buffer length of the receiving PDU" VALUE 0x805961E4 Val_Wu8 255.0 OneToOne 0.00 255.0 FORMAT "%5.1" READ_ONLY /end CHARACTERISTIC
/begin CHARACTERISTIC MoFFrm_Rx_DataPdu_EATB.bytOrderAlvCntr_C "Data PDU of EATB / Alive counter calibration of RX Data Pdu" VALUE 0x805961E5 Val_Wu8 1.000 OneToOne 0.00 1.000 FORMAT "%5.3" EXTENDED_LIMITS 0.00 255.0 READ_ONLY /end CHARACTERISTIC
/begin CHARACTERISTIC MoFFrm_Rx_DataPdu_EATB.bytOrderCrc_C "Data PDU of EATB / CRC calibration of RX Data Pdu" VALUE 0x805961E6 Val_Wu8 1.000 OneToOne 0.00 1.000 FORMAT "%5.3" EXTENDED_LIMITS 0.00 255.0 READ_ONLY /end CHARACTERISTIC
/begin CHARACTERISTIC MoFFrm_Rx_DataPdu_EATB.cntrAlvErrDeb_C "Data PDU of EATB / Alive counter debounce error calibration of RX Data Pdu" VALUE 0x805961E8 Val_Wu16 65535.00 OneToOne 0.00 65535.00 FORMAT "%8.2" /end CHARACTERISTIC
/begin CHARACTERISTIC MoFFrm_Rx_DataPdu_EATB.cntrCrcErrDeb_C "Data PDU of EATB / Alive counter debounce error calibration of RX Data Pdu" VALUE 0x805961EA Val_Wu16 65535.00 OneToOne 0.00 65535.00 FORMAT "%8.2" /end CHARACTERISTIC
/begin CHARACTERISTIC MoFFrm_Rx_DataPdu_EATB.cntrMaxAlvDif_C "Data PDU of EATB / Complement of Counter cyclic calibration of RX Data Pdu" VALUE 0x805961EC Val_Wu8 255.0 OneToOne 0.00 255.0 FORMAT "%5.1" /end CHARACTERISTIC
/begin CHARACTERISTIC MoFFrm_Rx_DataPdu_EATB.cntrTiOutDeb_C "Data PDU of EATB / Counter time out debounce calibration of Rx data PDU" VALUE 0x805961EE Val_Wu16 65535.00 OneToOne 0.00 65535.00 FORMAT "%8.2" /end CHARACTERISTIC
/begin CHARACTERISTIC MoFFrm_Rx_DataPdu_EATB.crcId_C "Data PDU of EATB / CRC ID of Rx data PDU" VALUE 0x805961F0 Val_Wu32 4294967295.00 OneToOne 0.00 4294967295.00 FORMAT "%13.2" /end CHARACTERISTIC
/begin CHARACTERISTIC MoFFrm_Rx_DataPdu_EATB.cycTi_C "Data PDU of EATB / cycle time from bus matrix" VALUE 0x805961F4 Val_Wu16 65535.00 OneToOne 0.00 65535.00 FORMAT "%8.2" READ_ONLY /end CHARACTERISTIC
/begin CHARACTERISTIC MoFFrm_Rx_DataPdu_EATB.diChks_C "Data PDU of EATB / parameter to enable or disable manipulation of various checks" VALUE 0x805961F6 Val_Wu8 255.0 OneToOne 0.00 255.0 FORMAT "%5.1" /end CHARACTERISTIC
/begin CHARACTERISTIC MoFFrm_Rx_DataPdu_EATB.evalType_C "Data PDU of EATB / evaluation type" VALUE 0x805961F7 Val_Wu8 255.0 OneToOne 0.00 255.0 FORMAT "%5.1" READ_ONLY /end CHARACTERISTIC
/begin CHARACTERISTIC MoFFrm_Rx_DataPdu_EATB.maskAlvCntr_C "Data PDU of EATB / Alive counter start bit position of Rx data PDU" VALUE 0x805961F8 Val_Wu8 255.0 OneToOne 0.00 255.0 FORMAT "%5.1" /end CHARACTERISTIC
/begin CHARACTERISTIC MoFFrm_Rx_DataPdu_EATB.posnAlvCntrStrtBit_C "Data PDU of EATB / Alive counter start bit calibration of of Data PDU Rx" VALUE 0x805961FA Val_Wu16 65535.00 OneToOne 0.00 65535.00 FORMAT "%8.2" READ_ONLY /end CHARACTERISTIC
/begin CHARACTERISTIC MoFFrm_Rx_DataPdu_EATB.posnCrcCalcEndByte_C "Data PDU of EATB / End byte of CRC calculation position of Data PDU Rx" VALUE 0x805961FC Val_Wu8 255.0 OneToOne 0.00 255.0 FORMAT "%5.1" /end CHARACTERISTIC
/begin CHARACTERISTIC MoFFrm_Rx_DataPdu_EATB.posnCrcCalcStrtByte_C "Data PDU of EATB / Start byte of CRC calculation position of Data PDU Rx" VALUE 0x805961FD Val_Wu8 255.0 OneToOne 0.00 255.0 FORMAT "%5.1" /end CHARACTERISTIC
/begin CHARACTERISTIC MoFFrm_Rx_DataPdu_EATB.posnCrcStrtBit_C "Data PDU of EATB / CRC start bit position of Rx data PDU" VALUE 0x805961FE Val_Wu16 65535.00 OneToOne 0.00 65535.00 FORMAT "%8.2" READ_ONLY /end CHARACTERISTIC
/begin CHARACTERISTIC MoFFrm_Rx_DataPdu_EATB.sigLenAlvCntr_C "Data PDU of EATB / Alive counter signal length of Rx data PDU" VALUE 0x80596200 Val_Wu8 31.00 OneToOne 1.00 32.00 FORMAT "%5.2" EXTENDED_LIMITS 0.00 255.0 READ_ONLY /end CHARACTERISTIC
/begin CHARACTERISTIC MoFFrm_Rx_DataPdu_EATB.sigLenCrc_C "Data PDU of EATB / CRC calibration signal length of Rx data PDU" VALUE 0x80596201 Val_Wu8 31.00 OneToOne 1.00 32.00 FORMAT "%5.2" EXTENDED_LIMITS 0.00 255.0 READ_ONLY /end CHARACTERISTIC
/begin CHARACTERISTIC MoFFrm_Rx_DataPdu_GWIMG3.bufLen_C "Data PDU of GWIMG3 / parameter to indicate the buffer length of the receiving PDU" VALUE 0x8059620C Val_Wu8 255.0 OneToOne 0.00 255.0 FORMAT "%5.1" READ_ONLY /end CHARACTERISTIC
/begin CHARACTERISTIC MoFFrm_Rx_DataPdu_GWIMG3.bytOrderAlvCntr_C "Data PDU of GWIMG3 / Alive counter calibration of RX Data Pdu" VALUE 0x8059620D Val_Wu8 1.000 OneToOne 0.00 1.000 FORMAT "%5.3" EXTENDED_LIMITS 0.00 255.0 READ_ONLY /end CHARACTERISTIC
/begin CHARACTERISTIC MoFFrm_Rx_DataPdu_GWIMG3.bytOrderCrc_C "Data PDU of GWIMG3 / CRC calibration of RX Data Pdu" VALUE 0x8059620E Val_Wu8 1.000 OneToOne 0.00 1.000 FORMAT "%5.3" EXTENDED_LIMITS 0.00 255.0 READ_ONLY /end CHARACTERISTIC
/begin CHARACTERISTIC MoFFrm_Rx_DataPdu_GWIMG3.cntrAlvErrDeb_C "Data PDU of GWIMG3 / Alive counter debounce error calibration of RX Data Pdu" VALUE 0x80596210 Val_Wu16 65535.00 OneToOne 0.00 65535.00 FORMAT "%8.2" /end CHARACTERISTIC
/begin CHARACTERISTIC MoFFrm_Rx_DataPdu_GWIMG3.cntrCrcErrDeb_C "Data PDU of GWIMG3 / Alive counter debounce error calibration of RX Data Pdu" VALUE 0x80596212 Val_Wu16 65535.00 OneToOne 0.00 65535.00 FORMAT "%8.2" /end CHARACTERISTIC
/begin CHARACTERISTIC MoFFrm_Rx_DataPdu_GWIMG3.cntrMaxAlvDif_C "Data PDU of GWIMG3 / Complement of Counter cyclic calibration of RX Data Pdu" VALUE 0x80596214 Val_Wu8 255.0 OneToOne 0.00 255.0 FORMAT "%5.1" /end CHARACTERISTIC
/begin CHARACTERISTIC MoFFrm_Rx_DataPdu_GWIMG3.cntrTiOutDeb_C "Data PDU of GWIMG3 / Counter time out debounce calibration of Rx data PDU" VALUE 0x80596216 Val_Wu16 65535.00 OneToOne 0.00 65535.00 FORMAT "%8.2" /end CHARACTERISTIC
/begin CHARACTERISTIC MoFFrm_Rx_DataPdu_GWIMG3.crcId_C "Data PDU of GWIMG3 / CRC ID of Rx data PDU" VALUE 0x80596218 Val_Wu32 4294967295.00 OneToOne 0.00 4294967295.00 FORMAT "%13.2" /end CHARACTERISTIC
/begin CHARACTERISTIC MoFFrm_Rx_DataPdu_GWIMG3.cycTi_C "Data PDU of GWIMG3 / cycle time from bus matrix" VALUE 0x8059621C Val_Wu16 65535.00 OneToOne 0.00 65535.00 FORMAT "%8.2" READ_ONLY /end CHARACTERISTIC
/begin CHARACTERISTIC MoFFrm_Rx_DataPdu_GWIMG3.diChks_C "Data PDU of GWIMG3 / parameter to enable or disable manipulation of various checks" VALUE 0x8059621E Val_Wu8 255.0 OneToOne 0.00 255.0 FORMAT "%5.1" /end CHARACTERISTIC
/begin CHARACTERISTIC MoFFrm_Rx_DataPdu_GWIMG3.evalType_C "Data PDU of GWIMG3 / evaluation type" VALUE 0x8059621F Val_Wu8 255.0 OneToOne 0.00 255.0 FORMAT "%5.1" READ_ONLY /end CHARACTERISTIC
/begin CHARACTERISTIC MoFFrm_Rx_DataPdu_GWIMG3.maskAlvCntr_C "Data PDU of GWIMG3 / Alive counter start bit position of Rx data PDU" VALUE 0x80596220 Val_Wu8 255.0 OneToOne 0.00 255.0 FORMAT "%5.1" /end CHARACTERISTIC
/begin CHARACTERISTIC MoFFrm_Rx_DataPdu_GWIMG3.posnAlvCntrStrtBit_C "Data PDU of GWIMG3 / Alive counter start bit calibration of of Data PDU Rx" VALUE 0x80596222 Val_Wu16 65535.00 OneToOne 0.00 65535.00 FORMAT "%8.2" READ_ONLY /end CHARACTERISTIC
/begin CHARACTERISTIC MoFFrm_Rx_DataPdu_GWIMG3.posnCrcCalcEndByte_C "Data PDU of GWIMG3 / End byte of CRC calculation position of Data PDU Rx" VALUE 0x80596224 Val_Wu8 255.0 OneToOne 0.00 255.0 FORMAT "%5.1" /end CHARACTERISTIC
/begin CHARACTERISTIC MoFFrm_Rx_DataPdu_GWIMG3.posnCrcCalcStrtByte_C "Data PDU of GWIMG3 / Start byte of CRC calculation position of Data PDU Rx" VALUE 0x80596225 Val_Wu8 255.0 OneToOne 0.00 255.0 FORMAT "%5.1" /end CHARACTERISTIC
/begin CHARACTERISTIC MoFFrm_Rx_DataPdu_GWIMG3.posnCrcStrtBit_C "Data PDU of GWIMG3 / CRC start bit position of Rx data PDU" VALUE 0x80596226 Val_Wu16 65535.00 OneToOne 0.00 65535.00 FORMAT "%8.2" READ_ONLY /end CHARACTERISTIC
/begin CHARACTERISTIC MoFFrm_Rx_DataPdu_GWIMG3.sigLenAlvCntr_C "Data PDU of GWIMG3 / Alive counter signal length of Rx data PDU" VALUE 0x80596228 Val_Wu8 31.00 OneToOne 1.00 32.00 FORMAT "%5.2" EXTENDED_LIMITS 0.00 255.0 READ_ONLY /end CHARACTERISTIC
/begin CHARACTERISTIC MoFFrm_Rx_DataPdu_GWIMG3.sigLenCrc_C "Data PDU of GWIMG3 / CRC calibration signal length of Rx data PDU" VALUE 0x80596229 Val_Wu8 31.00 OneToOne 1.00 32.00 FORMAT "%5.2" EXTENDED_LIMITS 0.00 255.0 READ_ONLY /end CHARACTERISTIC
/begin CHARACTERISTIC MoFFrm_Rx_DataPdu_META.bufLen_C "Structure instance of PDU META / parameter to indicate the buffer length of the receiving PDU" VALUE 0x80596234 Val_Wu8 255.0 OneToOne 0.00 255.0 FORMAT "%5.1" READ_ONLY /end CHARACTERISTIC
/begin CHARACTERISTIC MoFFrm_Rx_DataPdu_META.bytOrderAlvCntr_C "Structure instance of PDU META / Alive counter calibration of RX Data Pdu" VALUE 0x80596235 Val_Wu8 1.000 OneToOne 0.00 1.000 FORMAT "%5.3" EXTENDED_LIMITS 0.00 255.0 READ_ONLY /end CHARACTERISTIC
/begin CHARACTERISTIC MoFFrm_Rx_DataPdu_META.bytOrderCrc_C "Structure instance of PDU META / CRC calibration of RX Data Pdu" VALUE 0x80596236 Val_Wu8 1.000 OneToOne 0.00 1.000 FORMAT "%5.3" EXTENDED_LIMITS 0.00 255.0 READ_ONLY /end CHARACTERISTIC
/begin CHARACTERISTIC MoFFrm_Rx_DataPdu_META.cntrAlvErrDeb_C "Structure instance of PDU META / Alive counter debounce error calibration of RX Data Pdu" VALUE 0x80596238 Val_Wu16 65535.00 OneToOne 0.00 65535.00 FORMAT "%8.2" /end CHARACTERISTIC
/begin CHARACTERISTIC MoFFrm_Rx_DataPdu_META.cntrCrcErrDeb_C "Structure instance of PDU META / Alive counter debounce error calibration of RX Data Pdu" VALUE 0x8059623A Val_Wu16 65535.00 OneToOne 0.00 65535.00 FORMAT "%8.2" /end CHARACTERISTIC
/begin CHARACTERISTIC MoFFrm_Rx_DataPdu_META.cntrMaxAlvDif_C "Structure instance of PDU META / Complement of Counter cyclic calibration of RX Data Pdu" VALUE 0x8059623C Val_Wu8 255.0 OneToOne 0.00 255.0 FORMAT "%5.1" /end CHARACTERISTIC
/begin CHARACTERISTIC MoFFrm_Rx_DataPdu_META.cntrTiOutDeb_C "Structure instance of PDU META / Counter time out debounce calibration of Rx data PDU" VALUE 0x8059623E Val_Wu16 65535.00 OneToOne 0.00 65535.00 FORMAT "%8.2" /end CHARACTERISTIC
/begin CHARACTERISTIC MoFFrm_Rx_DataPdu_META.crcId_C "Structure instance of PDU META / CRC ID of Rx data PDU" VALUE 0x80596240 Val_Wu32 4294967295.00 OneToOne 0.00 4294967295.00 FORMAT "%13.2" /end CHARACTERISTIC
/begin CHARACTERISTIC MoFFrm_Rx_DataPdu_META.cycTi_C "Structure instance of PDU META / cycle time from bus matrix" VALUE 0x80596244 Val_Wu16 65535.00 OneToOne 0.00 65535.00 FORMAT "%8.2" READ_ONLY /end CHARACTERISTIC
/begin CHARACTERISTIC MoFFrm_Rx_DataPdu_META.diChks_C "Structure instance of PDU META / parameter to enable or disable manipulation of various checks" VALUE 0x80596246 Val_Wu8 255.0 OneToOne 0.00 255.0 FORMAT "%5.1" /end CHARACTERISTIC
/begin CHARACTERISTIC MoFFrm_Rx_DataPdu_META.evalType_C "Structure instance of PDU META / evaluation type" VALUE 0x80596247 Val_Wu8 255.0 OneToOne 0.00 255.0 FORMAT "%5.1" READ_ONLY /end CHARACTERISTIC
/begin CHARACTERISTIC MoFFrm_Rx_DataPdu_META.maskAlvCntr_C "Structure instance of PDU META / Alive counter start bit position of Rx data PDU" VALUE 0x80596248 Val_Wu8 255.0 OneToOne 0.00 255.0 FORMAT "%5.1" /end CHARACTERISTIC
/begin CHARACTERISTIC MoFFrm_Rx_DataPdu_META.posnAlvCntrStrtBit_C "Structure instance of PDU META / Alive counter start bit calibration of of Data PDU Rx" VALUE 0x8059624A Val_Wu16 65535.00 OneToOne 0.00 65535.00 FORMAT "%8.2" READ_ONLY /end CHARACTERISTIC
/begin CHARACTERISTIC MoFFrm_Rx_DataPdu_META.posnCrcCalcEndByte_C "Structure instance of PDU META / End byte of CRC calculation position of Data PDU Rx" VALUE 0x8059624C Val_Wu8 255.0 OneToOne 0.00 255.0 FORMAT "%5.1" /end CHARACTERISTIC
/begin CHARACTERISTIC MoFFrm_Rx_DataPdu_META.posnCrcCalcStrtByte_C "Structure instance of PDU META / Start byte of CRC calculation position of Data PDU Rx" VALUE 0x8059624D Val_Wu8 255.0 OneToOne 0.00 255.0 FORMAT "%5.1" /end CHARACTERISTIC
/begin CHARACTERISTIC MoFFrm_Rx_DataPdu_META.posnCrcStrtBit_C "Structure instance of PDU META / CRC start bit position of Rx data PDU" VALUE 0x8059624E Val_Wu16 65535.00 OneToOne 0.00 65535.00 FORMAT "%8.2" READ_ONLY /end CHARACTERISTIC
/begin CHARACTERISTIC MoFFrm_Rx_DataPdu_META.sigLenAlvCntr_C "Structure instance of PDU META / Alive counter signal length of Rx data PDU" VALUE 0x80596250 Val_Wu8 31.00 OneToOne 1.00 32.00 FORMAT "%5.2" EXTENDED_LIMITS 0.00 255.0 READ_ONLY /end CHARACTERISTIC
/begin CHARACTERISTIC MoFFrm_Rx_DataPdu_META.sigLenCrc_C "Structure instance of PDU META / CRC calibration signal length of Rx data PDU" VALUE 0x80596251 Val_Wu8 31.00 OneToOne 1.00 32.00 FORMAT "%5.2" EXTENDED_LIMITS 0.00 255.0 READ_ONLY /end CHARACTERISTIC
/begin CHARACTERISTIC MoFFrm_Rx_DataPdu_METL.bufLen_C "Structure instance of PDU METL / parameter to indicate the buffer length of the receiving PDU" VALUE 0x8059625C Val_Wu8 255.0 OneToOne 0.00 255.0 FORMAT "%5.1" READ_ONLY /end CHARACTERISTIC
/begin CHARACTERISTIC MoFFrm_Rx_DataPdu_METL.bytOrderAlvCntr_C "Structure instance of PDU METL / Alive counter calibration of RX Data Pdu" VALUE 0x8059625D Val_Wu8 1.000 OneToOne 0.00 1.000 FORMAT "%5.3" EXTENDED_LIMITS 0.00 255.0 READ_ONLY /end CHARACTERISTIC
/begin CHARACTERISTIC MoFFrm_Rx_DataPdu_METL.bytOrderCrc_C "Structure instance of PDU METL / CRC calibration of RX Data Pdu" VALUE 0x8059625E Val_Wu8 1.000 OneToOne 0.00 1.000 FORMAT "%5.3" EXTENDED_LIMITS 0.00 255.0 READ_ONLY /end CHARACTERISTIC
/begin CHARACTERISTIC MoFFrm_Rx_DataPdu_METL.cntrAlvErrDeb_C "Structure instance of PDU METL / Alive counter debounce error calibration of RX Data Pdu" VALUE 0x80596260 Val_Wu16 65535.00 OneToOne 0.00 65535.00 FORMAT "%8.2" /end CHARACTERISTIC
/begin CHARACTERISTIC MoFFrm_Rx_DataPdu_METL.cntrCrcErrDeb_C "Structure instance of PDU METL / Alive counter debounce error calibration of RX Data Pdu" VALUE 0x80596262 Val_Wu16 65535.00 OneToOne 0.00 65535.00 FORMAT "%8.2" /end CHARACTERISTIC
/begin CHARACTERISTIC MoFFrm_Rx_DataPdu_METL.cntrMaxAlvDif_C "Structure instance of PDU METL / Complement of Counter cyclic calibration of RX Data Pdu" VALUE 0x80596264 Val_Wu8 255.0 OneToOne 0.00 255.0 FORMAT "%5.1" /end CHARACTERISTIC
/begin CHARACTERISTIC MoFFrm_Rx_DataPdu_METL.cntrTiOutDeb_C "Structure instance of PDU METL / Counter time out debounce calibration of Rx data PDU" VALUE 0x80596266 Val_Wu16 65535.00 OneToOne 0.00 65535.00 FORMAT "%8.2" /end CHARACTERISTIC
/begin CHARACTERISTIC MoFFrm_Rx_DataPdu_METL.crcId_C "Structure instance of PDU METL / CRC ID of Rx data PDU" VALUE 0x80596268 Val_Wu32 4294967295.00 OneToOne 0.00 4294967295.00 FORMAT "%13.2" /end CHARACTERISTIC
/begin CHARACTERISTIC MoFFrm_Rx_DataPdu_METL.cycTi_C "Structure instance of PDU METL / cycle time from bus matrix" VALUE 0x8059626C Val_Wu16 65535.00 OneToOne 0.00 65535.00 FORMAT "%8.2" READ_ONLY /end CHARACTERISTIC
/begin CHARACTERISTIC MoFFrm_Rx_DataPdu_METL.diChks_C "Structure instance of PDU METL / parameter to enable or disable manipulation of various checks" VALUE 0x8059626E Val_Wu8 255.0 OneToOne 0.00 255.0 FORMAT "%5.1" /end CHARACTERISTIC
/begin CHARACTERISTIC MoFFrm_Rx_DataPdu_METL.evalType_C "Structure instance of PDU METL / evaluation type" VALUE 0x8059626F Val_Wu8 255.0 OneToOne 0.00 255.0 FORMAT "%5.1" READ_ONLY /end CHARACTERISTIC
/begin CHARACTERISTIC MoFFrm_Rx_DataPdu_METL.maskAlvCntr_C "Structure instance of PDU METL / Alive counter start bit position of Rx data PDU" VALUE 0x80596270 Val_Wu8 255.0 OneToOne 0.00 255.0 FORMAT "%5.1" /end CHARACTERISTIC
/begin CHARACTERISTIC MoFFrm_Rx_DataPdu_METL.posnAlvCntrStrtBit_C "Structure instance of PDU METL / Alive counter start bit calibration of of Data PDU Rx" VALUE 0x80596272 Val_Wu16 65535.00 OneToOne 0.00 65535.00 FORMAT "%8.2" READ_ONLY /end CHARACTERISTIC
/begin CHARACTERISTIC MoFFrm_Rx_DataPdu_METL.posnCrcCalcEndByte_C "Structure instance of PDU METL / End byte of CRC calculation position of Data PDU Rx" VALUE 0x80596274 Val_Wu8 255.0 OneToOne 0.00 255.0 FORMAT "%5.1" /end CHARACTERISTIC
/begin CHARACTERISTIC MoFFrm_Rx_DataPdu_METL.posnCrcCalcStrtByte_C "Structure instance of PDU METL / Start byte of CRC calculation position of Data PDU Rx" VALUE 0x80596275 Val_Wu8 255.0 OneToOne 0.00 255.0 FORMAT "%5.1" /end CHARACTERISTIC
/begin CHARACTERISTIC MoFFrm_Rx_DataPdu_METL.posnCrcStrtBit_C "Structure instance of PDU METL / CRC start bit position of Rx data PDU" VALUE 0x80596276 Val_Wu16 65535.00 OneToOne 0.00 65535.00 FORMAT "%8.2" READ_ONLY /end CHARACTERISTIC
/begin CHARACTERISTIC MoFFrm_Rx_DataPdu_METL.sigLenAlvCntr_C "Structure instance of PDU METL / Alive counter signal length of Rx data PDU" VALUE 0x80596278 Val_Wu8 31.00 OneToOne 1.00 32.00 FORMAT "%5.2" EXTENDED_LIMITS 0.00 255.0 READ_ONLY /end CHARACTERISTIC
/begin CHARACTERISTIC MoFFrm_Rx_DataPdu_METL.sigLenCrc_C "Structure instance of PDU METL / CRC calibration signal length of Rx data PDU" VALUE 0x80596279 Val_Wu8 31.00 OneToOne 1.00 32.00 FORMAT "%5.2" EXTENDED_LIMITS 0.00 255.0 READ_ONLY /end CHARACTERISTIC
/begin CHARACTERISTIC MoFFrm_Tx_DataPdu_ENGA.bufLen_C "DATA PDU ENGA / Buffer length of the transmission PDU" VALUE 0x80596290 Val_Wu8 255.0 OneToOne 0.00 255.0 FORMAT "%5.1" READ_ONLY /end CHARACTERISTIC
/begin CHARACTERISTIC MoFFrm_Tx_DataPdu_ENGA.bytOrderAlvCntr_C "DATA PDU ENGA / Alive counter byte order" VALUE 0x80596291 Val_Wu8 1.000 OneToOne 0.00 1.000 FORMAT "%5.3" EXTENDED_LIMITS 0.00 255.0 READ_ONLY /end CHARACTERISTIC
/begin CHARACTERISTIC MoFFrm_Tx_DataPdu_ENGA.bytOrderCrc_C "DATA PDU ENGA / CRC byte order" VALUE 0x80596292 Val_Wu8 1.000 OneToOne 0.00 1.000 FORMAT "%5.3" EXTENDED_LIMITS 0.00 255.0 READ_ONLY /end CHARACTERISTIC
/begin CHARACTERISTIC MoFFrm_Tx_DataPdu_ENGA.crcId_C "DATA PDU ENGA / CRC iD calibration of Tx data PDU" VALUE 0x80596294 Val_Wu32 4294967295.00 OneToOne 0.00 4294967295.00 FORMAT "%13.2" /end CHARACTERISTIC
/begin CHARACTERISTIC MoFFrm_Tx_DataPdu_ENGA.evalType_C "DATA PDU ENGA / evaluation type of the Tx message" VALUE 0x80596298 Val_Wu8 255.0 OneToOne 0.00 255.0 FORMAT "%5.1" READ_ONLY /end CHARACTERISTIC
/begin CHARACTERISTIC MoFFrm_Tx_DataPdu_ENGA.posnAlvCntrStrtBit_C "DATA PDU ENGA / alive counter start bit position" VALUE 0x8059629A Val_Wu16 65535.00 OneToOne 0.00 65535.00 FORMAT "%8.2" READ_ONLY /end CHARACTERISTIC
/begin CHARACTERISTIC MoFFrm_Tx_DataPdu_ENGA.posnCrcCalcEndByte_C "DATA PDU ENGA / Start byte of CRC calculation position of Data PDU Tx" VALUE 0x8059629C Val_Wu8 255.0 OneToOne 0.00 255.0 FORMAT "%5.1" /end CHARACTERISTIC
/begin CHARACTERISTIC MoFFrm_Tx_DataPdu_ENGA.posnCrcCalcStrtByte_C "DATA PDU ENGA / Start byte of CRC calculation position of Data PDU Tx" VALUE 0x8059629D Val_Wu8 255.0 OneToOne 0.00 255.0 FORMAT "%5.1" /end CHARACTERISTIC
/begin CHARACTERISTIC MoFFrm_Tx_DataPdu_ENGA.posnCrcStrtBit_C "DATA PDU ENGA / CRC start bit position" VALUE 0x8059629E Val_Wu16 65535.00 OneToOne 0.00 65535.00 FORMAT "%8.2" READ_ONLY /end CHARACTERISTIC
/begin CHARACTERISTIC MoFFrm_Tx_DataPdu_ENGA.sigLenAlvCntr_C "DATA PDU ENGA / alive counter signal length" VALUE 0x805962A0 Val_Wu8 31.00 OneToOne 1.00 32.00 FORMAT "%5.2" EXTENDED_LIMITS 0.00 255.0 READ_ONLY /end CHARACTERISTIC
/begin CHARACTERISTIC MoFFrm_Tx_DataPdu_ENGA.sigLenCrc_C "DATA PDU ENGA / CRC signal length" VALUE 0x805962A1 Val_Wu8 31.00 OneToOne 1.00 32.00 FORMAT "%5.2" EXTENDED_LIMITS 0.00 255.0 READ_ONLY /end CHARACTERISTIC
/begin CHARACTERISTIC MoFHybRx_flgComErrElDrv_C "Calibration for dummy interfaces of MoFHybRx_flgComErrElDrv" VALUE 0x80591E18 Val_Wu8 1.00000000000 B_TRUE 0.00 1.00000000000 FORMAT "%13.11" /end CHARACTERISTIC
/begin CHARACTERISTIC MoFHybRx_flgIrvErrDelDrv_C "Calibration for dummy interfaces of MoFHybRx_flgIrvErrDelDrv" VALUE 0x80591E19 Val_Wu8 1.00000000000 B_TRUE 0.00 1.00000000000 FORMAT "%13.11" /end CHARACTERISTIC
/begin CHARACTERISTIC MoFIA_cntrErrDebMaxIACo_C "Maximum tolerated error debounce counter value in function MoFIA_Co" VALUE 0x80591E1A Val_Wu8 255.0 OneToOne 0.00 255.0 FORMAT "%5.1" /end CHARACTERISTIC
/begin CHARACTERISTIC MoFIA_cntrRstMaxIACo_C "Maximum number of Pre-ICO resets in function MoFIA_Co" VALUE 0x80591E1B Val_Wu8 255.0 OneToOne 0.00 255.0 FORMAT "%5.1" /end CHARACTERISTIC
/begin CHARACTERISTIC MoFIA_nErrHndlgActvnIACo_C "Engine speed threshold for activation of error handling in function MoFIA_Co" VALUE 0x80591E1C Val_Wu8 10200. nmot_q40 0.00 10200. FORMAT "%5.0" /end CHARACTERISTIC
/begin CHARACTERISTIC MoFICO_nEngThdESM_T "acceleration pedal depandant engine speed curve for the speed threshold during ESM with open throttle valve" CURVE 0x80595CBA Mo_DataCurveSstS16WS16 2621400. nmot_q40 -1310720. 1310680. FORMAT "%8.0"
 /begin AXIS_DESCR STD_AXIS MoFAPP_ratHiResl relPED_q0p02441 6 -800.0000 799.9756 FORMAT "%8.4" DEPOSIT ABSOLUTE /end AXIS_DESCR
/end CHARACTERISTIC
/begin CHARACTERISTIC MoFICO_nMaxVDpd_Cur "Velocity dependend engine speed curve for enghine speed trheshold" CURVE 0x80595CD4 Mo_DataCurveSstS16WS16 2621400. nmot_q40 -1310720. 1310680. FORMAT "%8.0"
 /begin AXIS_DESCR STD_AXIS MoFVSS_v vel_q0p01 6 -327.6800 327.6700 FORMAT "%8.4" DEPOSIT ABSOLUTE /end AXIS_DESCR
/end CHARACTERISTIC
/begin CHARACTERISTIC MoFIn_ctInjPCPTst_CW "codeword for manipulation of injection counter feedback in function monitoring" VALUE 0x805962C6 Val_Wu8 255.0 dez 0.00 255.0 FORMAT "%5.1" /end CHARACTERISTIC
/begin CHARACTERISTIC MoFIn_ignCtOffTst_CW "codeword for manipulation of ignition cut off mask in function monitoring" VALUE 0x805962C7 Val_Wu8 255.0 dez 0.00 255.0 FORMAT "%5.1" /end CHARACTERISTIC
/begin CHARACTERISTIC MoFIn_stPPDrvTst_CW "codeword for manipulation of state Pre/PostDrv in function monitoring" VALUE 0x805962C8 Val_Wu8 255.0 dez 0.00 255.0 FORMAT "%5.1" /end CHARACTERISTIC
/begin CHARACTERISTIC MoFSpdG_facTqLtd_CUR "factor-curve Speedgov-torque" CURVE 0x80591E24 Mo_DataCurveSstU8WU8 2.550 fak_q0p01 0.00 2.550 FORMAT "%5.3"
 /begin AXIS_DESCR STD_AXIS MoFESpd_nEng nmot_q40 8 0.00 10200. FORMAT "%5.0" DEPOSIT ABSOLUTE /end AXIS_DESCR
/end CHARACTERISTIC
/begin CHARACTERISTIC MoFStrt_cntrStrtRls_C "Threshold value for Starter release plausible error" VALUE 0x80591E4A Val_Wu8 255.0 OneToOne 0.00 255.0 FORMAT "%5.1" /end CHARACTERISTIC
/begin CHARACTERISTIC MoFStrt_cntrUnderVltg_C "Threshold for delay of start release deactivation in case of undervoltage situation" VALUE 0x80591E3A Val_Wu8 255.0 OneToOne 0.00 255.0 FORMAT "%5.1" /end CHARACTERISTIC
/begin CHARACTERISTIC MoFStrt_ctDebClthImpsOff_C "Threshold for clutch implausibility check healing" VALUE 0x80591E3B Val_Wu8 255.0 OneToOne 0.00 255.0 FORMAT "%5.1" /end CHARACTERISTIC
/begin CHARACTERISTIC MoFStrt_ctDebClthImpsOn_C "Threshold for clutch implausibility check" VALUE 0x80591E3C Val_Wu8 255.0 OneToOne 0.00 255.0 FORMAT "%5.1" /end CHARACTERISTIC
/begin CHARACTERISTIC MoFStrt_ctDebPushBtnDfl_C "Initialisation value for MoFStrt_ctDebPushBtn" VALUE 0x80591E3D Val_Wu8 255.0 OneToOne 0.00 255.0 FORMAT "%5.1" /end CHARACTERISTIC
/begin CHARACTERISTIC MoFStrt_ctDebPushBtn_C "Debounce threshold for low to high transition of push button signal debouncing" VALUE 0x80591E3E Val_Wu8 255.0 OneToOne 0.00 255.0 FORMAT "%5.1" /end CHARACTERISTIC
/begin CHARACTERISTIC MoFStrt_ctDebT50HiLo_C "Debounce threshold for High to low transition in T50 signal debouncing" VALUE 0x80591E3F Val_Wu8 255.0 OneToOne 0.00 255.0 FORMAT "%5.1" /end CHARACTERISTIC
/begin CHARACTERISTIC MoFStrt_ctDebT50LoHi_C "Debounce threshold for low to high transition in T50 signal debouncing" VALUE 0x80591E40 Val_Wu8 255.0 OneToOne 0.00 255.0 FORMAT "%5.1" /end CHARACTERISTIC
/begin CHARACTERISTIC MoFStrt_ctHWBrkDeactvnDly_C "Debounce counter threshold for brake deactivation for T50 Start" VALUE 0x80591E41 Val_Wu8 255.0 OneToOne 0.00 255.0 FORMAT "%5.1" /end CHARACTERISTIC
/begin CHARACTERISTIC MoFStrt_flgTraMT_C "Calibration to choose the type of transmission present in the vehicle" VALUE 0x80591E42 Val_Wu8 1.00000000000 B_TRUE 0.00 1.00000000000 FORMAT "%13.11" /end CHARACTERISTIC
/begin CHARACTERISTIC MoFStrt_stSTSwitchMnl_C "ST_Switch replacement in manual mode" VALUE 0x80591E43 Val_Wu8 1.00000000000 B_TRUE 0.00 1.00000000000 FORMAT "%13.11" /end CHARACTERISTIC
/begin CHARACTERISTIC MoFStrt_swtBrkCnd_C "Switch for (de)activating brake condition" VALUE 0x80591E44 Val_Wu8 1.00000000000 B_TRUE 0.00 1.00000000000 FORMAT "%13.11" /end CHARACTERISTIC
/begin CHARACTERISTIC MoFStrt_swtClthPlausChk_C "Switch to consider clutch plausibility check in start release" VALUE 0x80591E45 Val_Wu8 1.00000000000 B_TRUE 0.00 1.00000000000 FORMAT "%13.11" /end CHARACTERISTIC
/begin CHARACTERISTIC MoFStrt_swtInvSTSwitch_C "Switch to invert ST_Switch signal" VALUE 0x80591E46 Val_Wu8 1.00000000000 B_TRUE 0.00 1.00000000000 FORMAT "%13.11" /end CHARACTERISTIC
/begin CHARACTERISTIC MoFStrt_swtISSDisbl_C "Disable Calibration for ISS Monitoring" VALUE 0x80591E38 Val_Wu8 255.0 OneToOne 0.00 255.0 FORMAT "%5.1" /end CHARACTERISTIC
/begin CHARACTERISTIC MoFStrt_swtSigNPos_C "Switch to select source of gear nuetral signal via CAN or ADC" VALUE 0x80591E47 Val_Wu8 255.0 OneToOne 0.00 255.0 FORMAT "%5.1" /end CHARACTERISTIC
/begin CHARACTERISTIC MoFStrt_swtSTSwitchMnl_C "Switch to select manual mode for ST_Switch" VALUE 0x80591E48 Val_Wu8 1.00000000000 B_TRUE 0.00 1.00000000000 FORMAT "%13.11" /end CHARACTERISTIC
/begin CHARACTERISTIC MoFTra_cntrDebTSCDeactv_C "Threshold for MoFTra_cntrDebTSCDeactv" VALUE 0x80591E7E Val_Wu8 255.0 OneToOne 0.00 255.0 FORMAT "%5.1" /end CHARACTERISTIC
/begin CHARACTERISTIC MoFTra_rTqBoostMinLim_C "Limiting torque converter boost value" VALUE 0x80595D5C Val_Wu16 655.3500 TransR 0.00 655.3500 FORMAT "%8.4" /end CHARACTERISTIC
/begin CHARACTERISTIC MoFTra_rTqCnvrBoostDft_C "Default torque converter boost value" VALUE 0x80595D5E Val_Wu16 655.3500 TransR 0.00 655.3500 FORMAT "%8.4" /end CHARACTERISTIC
/begin CHARACTERISTIC MoFTrqAct_facTolrTqActChkMax_C "Maximum relative tolerance factor for the evaluation of Lv. 1 actual torque." VALUE 0x80591E80 Val_Wu8 1.992188 fak_ub_b2 0.00 1.992188 FORMAT "%8.6" /end CHARACTERISTIC
/begin CHARACTERISTIC MoFTrqAct_facTolrTqActChkMin_C "Minimum relative tolerance factor for the evaluation of Lv. 1 actual torque." VALUE 0x80591E81 Val_Wu8 1.992188 fak_ub_b2 0.00 1.992188 FORMAT "%8.6" /end CHARACTERISTIC
/begin AXIS_PTS MoFTrqAct_nEng_Ax "Data point distribution for engine speed" 0x80591E82 MoFESpd_nEng Axis_Xu8 10200. nmot_q40 12 0.00 10200. FORMAT "%5.0" DEPOSIT ABSOLUTE /end AXIS_PTS
/begin CHARACTERISTIC MoFTrqAct_offsTolrTqActChk_C "Absolute tolerance factor for the accuracy check of Lv. 1 actual torque" VALUE 0x80595D60 Val_Wu16 99.99847 rel_uw_b100 0.00 99.99847 FORMAT "%8.5" /end CHARACTERISTIC
/begin AXIS_PTS MoFTrqAct_ratFillg_Ax "Axis grid distribution for air charge" 0x80595D62 MoFAirFl_ratFillg Axis_Xu16 1535.977 rel_uw_q0p0234 12 0.00 1535.977 FORMAT "%8.3" DEPOSIT ABSOLUTE /end AXIS_PTS
/begin CHARACTERISTIC MoFTrqAct_stSwtTqActEng_C "Code word for the configuration of the actual torque calculation in functional monitoring." VALUE 0x80591E8F Val_Wu8 255.0 OneToOne 0.00 255.0 FORMAT "%5.1" /end CHARACTERISTIC
/begin CHARACTERISTIC MoFTrqAct_tqOptm_M "Optimal torque in function monitoring" MAP 0x80595D7C MapG_Wu16 99.99847 rel_uw_b100 0.00 99.99847 FORMAT "%8.5"
 /begin AXIS_DESCR COM_AXIS MoFAirFl_ratFillg rel_uw_q0p0234 12 0.00 1535.977 FORMAT "%8.3" AXIS_PTS_REF MoFTrqAct_ratFillg_Ax /end AXIS_DESCR
 /begin AXIS_DESCR COM_AXIS MoFESpd_nEng nmot_q40 12 0.00 10200. FORMAT "%5.0" AXIS_PTS_REF MoFTrqAct_nEng_Ax /end AXIS_DESCR
/end CHARACTERISTIC
/begin CHARACTERISTIC MoFTrqCmp_cntrRstTqCompMax_C "Number of resets to be executed in the error case" VALUE 0x80591EA4 Val_Wu8 255.0 OneToOne 0.00 255.0 FORMAT "%5.1" /end CHARACTERISTIC
/begin CHARACTERISTIC MoFTrqCmp_cntrTestTqCompMax_C "Counter threshold for setting of test flag in diagnosis of total torque comparision" VALUE 0x805962CC Val_Wu8 255.0 OneToOne 0.00 255.0 FORMAT "%5.1" /end CHARACTERISTIC
/begin CHARACTERISTIC MoFTrqCmp_cntrTestTqCompMin_C "Counter threshold for setting of test flag in diagnosis of min total torque comparision" VALUE 0x805962CE Val_Wu8 255.0 OneToOne 0.00 255.0 FORMAT "%5.1" /end CHARACTERISTIC
/begin CHARACTERISTIC MoFTrqCmp_cntrTqCompMax_C "Error tolerance threshold for total torque comparision in function monitoring" VALUE 0x80591EA5 Val_Wu8 255.0 OneToOne 0.00 255.0 FORMAT "%5.1" /end CHARACTERISTIC
/begin CHARACTERISTIC MoFTrqCmp_cntrTqCompMin_C "Error tolerance threshold for min torque comparision in function monitoring" VALUE 0x80591EA6 Val_Wu8 255.0 OneToOne 0.00 255.0 FORMAT "%5.1" /end CHARACTERISTIC
/begin CHARACTERISTIC MoFTrqCmp_facTqErrMax_C "maximal increment of MoF_facTrqErrSum per time" VALUE 0x80595E9C Val_Ws16 127.9980 rel_q0p00195_pc_s -64.00000 63.99805 FORMAT "%8.5" /end CHARACTERISTIC
/begin CHARACTERISTIC MoFTrqCmp_facTqErrMin_C "maximal decrement of MoF_facTrqErrSum per time" VALUE 0x80595E9E Val_Ws16 127.9980 rel_q0p00195_pc_s -64.00000 63.99805 FORMAT "%8.5" /end CHARACTERISTIC
/begin CHARACTERISTIC MoFTrqCmp_nEngTestTqCompMax_C "Engine speed threshold for the entry of the cycle flags in MoFTrqCmp_Max" VALUE 0x805962CD Val_Wu8 10200. nmot_q40 0.00 10200. FORMAT "%5.0" /end CHARACTERISTIC
/begin CHARACTERISTIC MoFTrqCmp_nEngTestTqCompMin_C "Engine speed threshold for the entry of cycle flags in MoFTrqCmp_Min" VALUE 0x805962CF Val_Wu8 10200. nmot_q40 0.00 10200. FORMAT "%5.0" /end CHARACTERISTIC
/begin CHARACTERISTIC MoFTrqPtd_nSpdGovMax_C "Maximun Speed governer speed allowed." VALUE 0x80591E35 Val_Wu8 10200. nmot_q40 0.00 10200. FORMAT "%5.0" /end CHARACTERISTIC
/begin CHARACTERISTIC MoFTrqPtd_nSpdGovTrckMax_C "threshold for maximum speedgovernor tracking speed offset" VALUE 0x80591E36 Val_Wu8 10200. nmot_q40 0.00 10200. FORMAT "%5.0" /end CHARACTERISTIC
/begin CHARACTERISTIC MoFTrqPtd_tiTrqMaxStrt_C "time during maximal start torque is allowed in function monitoring" VALUE 0x80595EA2 Val_Wu16 2621.400 t_q0p04 0.00 2621.400 FORMAT "%8.3" /end CHARACTERISTIC
/begin CHARACTERISTIC MoFTrqPtd_tqInrMaxStrt_C "maximal inner torque during start in function monitoring" VALUE 0x80595EA4 Val_Ws16 6553.500 md_q0p1 -3276.800 3276.700 FORMAT "%8.3" /end CHARACTERISTIC
/begin CHARACTERISTIC MoFTrqPtd_tqSpdGovPtdOfs_T "offset characteristic curve for start up controler" CURVE 0x80595CEE Mo_DataCurveSstS16WS16 408.0000 md_q1p6 0.00 408.0000 FORMAT "%8.4" EXTENDED_LIMITS -52428.80 52427.20
 /begin AXIS_DESCR STD_AXIS NO_INPUT_QUANTITY nmot_q0p5 8 -16384.00 16383.50 FORMAT "%8.2" DEPOSIT ABSOLUTE /end AXIS_DESCR
/end CHARACTERISTIC
/begin CHARACTERISTIC MoF_ctICOIgn_C "error counter for checking ignition cut off in the fault reaction monitoring" VALUE 0x80591E1E Val_Wu8 255.0 OneToOne 0.00 255.0 FORMAT "%5.1" /end CHARACTERISTIC
/begin CHARACTERISTIC MoF_ctICOInj_C "error counter for checking injection cut off in the fault reaction monitoring" VALUE 0x80591E1F Val_Wu8 255.0 OneToOne 0.00 255.0 FORMAT "%5.1" /end CHARACTERISTIC
/begin CHARACTERISTIC MoF_ctIgnDel_C "Final Value for Delay Counter for Ignition Cut Off in Function Monitoring" VALUE 0x80591E20 Val_Wu8 255.0 OneToOne 0.00 255.0 FORMAT "%5.1" /end CHARACTERISTIC
/begin CHARACTERISTIC MoF_ctPCPDel_C "Final Value for Delay Counter for PCP-feedback in Function Monitoring" VALUE 0x80591E21 Val_Wu8 255.0 OneToOne 0.00 255.0 FORMAT "%5.1" /end CHARACTERISTIC
/begin CHARACTERISTIC MoF_ctRstTrqCmp_C "number of Resets to be executed in the error case" VALUE 0x80591E90 Val_Wu8 255.0 dez 0.00 255.0 FORMAT "%5.1" /end CHARACTERISTIC
/begin CHARACTERISTIC MoF_ctTrqCmp_C "error tolerance time for torque comparison in the function monitoring" VALUE 0x80591E91 Val_Wu8 255.0 dez 0.00 255.0 FORMAT "%5.1" /end CHARACTERISTIC
/begin CHARACTERISTIC MoF_ctTstTrqCmp_C "counter for putting of the test flag in diagnosis of torque comparison" VALUE 0x805962CA Val_Wu8 255.0 dez 0.00 255.0 FORMAT "%5.1" /end CHARACTERISTIC
/begin CHARACTERISTIC MoF_facMinRTrqInrMax_C "Factor for protection of maximally torque downwards" VALUE 0x80591EA8 Val_Wu8 0.9961 fak_ub_b1 0.00 0.9961 /end CHARACTERISTIC
/begin CHARACTERISTIC MoF_facTrqErrSumDet_C "Detection threshold for the error sum MoF_facTrqErrSum in function monitoring" VALUE 0x80595EA0 Val_Wu16 127.9980 rel_q0p00195_pc_s 0.00 127.9980 FORMAT "%8.4" /end CHARACTERISTIC
/begin CHARACTERISTIC MoF_facTrqMinOvrRun_CUR "Factor characteristic curve for over run cutoff air charge in the functional monitoring" CURVE 0x80591EA9 ValA_Wu8 1.992188 fak_ub_b2 0.00 1.992188 FORMAT "%8.6"
 /begin AXIS_DESCR COM_AXIS MoFESpd_nEng nmot_q40 8 0.00 10200. FORMAT "%5.0" AXIS_PTS_REF MoFESpd_nEng_Ax /end AXIS_DESCR
/end CHARACTERISTIC
/begin CHARACTERISTIC MoF_nEngShOff_C "engine speed threshold to throw down the model temperature in the functional monitoring" VALUE 0x80591E4C Val_Wu8 10200. nmot_q40 0.00 10200. FORMAT "%5.0" /end CHARACTERISTIC
/begin CHARACTERISTIC MoF_nEngStrt_C "engine speed threshold for starting the model temperature in the functional monitoring" VALUE 0x80591E4D Val_Wu8 10200. nmot_q40 0.00 10200. FORMAT "%5.0" /end CHARACTERISTIC
/begin CHARACTERISTIC MoF_nEngTstTrqCmp_C "engine speed threshold for the entry of the cycle flags MoFTrqCmp" VALUE 0x805962CB Val_Wu8 10200. nmot_q40 0.00 10200. FORMAT "%5.0" /end CHARACTERISTIC
/begin CHARACTERISTIC MoF_nMaxAppDfct_C "Max engine speed in case of defect App" VALUE 0x80591E22 Val_Wu8 10200. nmot_q40 0.00 10200. FORMAT "%5.0" /end CHARACTERISTIC
/begin CHARACTERISTIC MoF_nMax_C "Engine Speed limitation in MoFICO" VALUE 0x80591E23 Val_Wu8 10200. nmot_q40 0.00 10200. FORMAT "%5.0" /end CHARACTERISTIC
/begin AXIS_PTS MoF_rAPP_DST "accelerator pedal position distribution in function monitoring" 0x80591B39 MoF_rAPP Axis_Xu8 99.61 rel_q0p39 8 0.00 99.61 FORMAT "%5.2" DEPOSIT ABSOLUTE /end AXIS_PTS
/begin CHARACTERISTIC MoF_rTrqInrMax_CUR "curve maximal inner torque in function monitoring" CURVE 0x80591EB1 ValA_Wu8 99.61 rel_q0p39 0.00 99.61 FORMAT "%5.2"
 /begin AXIS_DESCR COM_AXIS MoFESpd_nEng nmot_q40 8 0.00 10200. FORMAT "%5.0" AXIS_PTS_REF MoFESpd_nEng_Ax /end AXIS_DESCR
/end CHARACTERISTIC
/begin CHARACTERISTIC MoF_rTrqPtdFltWgh_CUR "weighting of the filtered permissible torque in function monitoring" CURVE 0x80591E92 Mo_DataCurveSstU8WU8 99.61 rel_q0p39 0.00 99.61 FORMAT "%5.2"
 /begin AXIS_DESCR STD_AXIS MoF_rTrqPtdFlt rel_q0p39 8 0.00 99.61 FORMAT "%5.2" DEPOSIT ABSOLUTE /end AXIS_DESCR
/end CHARACTERISTIC
/begin CHARACTERISTIC MoF_tEngGradNrmOp16_MAP "temperature gradient for model temperature in the normal opreation in the function monitoring" MAP 0x80595D10 Map_Xs16Ys16Ws16 47.99927 temp_q7p324Em4_DegC -24.00000 23.99927 FORMAT "%8.5"
 /begin AXIS_DESCR STD_AXIS MoFTEng_mfVal m_ub_b1020 5 0.00 1020.000 FORMAT "%8.3" EXTENDED_LIMITS -131072.0 131068.0 DEPOSIT ABSOLUTE /end AXIS_DESCR
 /begin AXIS_DESCR STD_AXIS MoF_tEngMod temp_ub_q0p75_o48 5 -48.0000 143.2500 FORMAT "%8.4" EXTENDED_LIMITS -24624.00 24527.25 DEPOSIT ABSOLUTE /end AXIS_DESCR
/end CHARACTERISTIC
/begin CHARACTERISTIC MoF_tEngGradOvrRun_MAP "temperature gradient for model temperature in the fuel cut-off opreation in the function monitoring" MAP 0x80591E4E Map_Xu8Yu8Wu8 0.1868 temp_qn7p324Em4_DegC -0.1868 0.00 FORMAT "%6.4"
 /begin AXIS_DESCR STD_AXIS MoFTEng_mfVal m_ub_b1020 5 0.00 1020. FORMAT "%5.0" DEPOSIT ABSOLUTE /end AXIS_DESCR
 /begin AXIS_DESCR STD_AXIS MoF_tEngMod temp_ub_q0p75_o48 5 -48.0 143.3 FORMAT "%5.1" DEPOSIT ABSOLUTE /end AXIS_DESCR
/end CHARACTERISTIC
/begin CHARACTERISTIC MoF_tEngModMax_C "maximum initialization value of the model temperature in the function monitoring" VALUE 0x80591E73 Val_Wu8 191.3 temp_ub_q0p75_o48 -48.0 143.3 FORMAT "%5.1" /end CHARACTERISTIC
/begin CHARACTERISTIC MoF_tEngModOfs_C "offset for model temperature in the function monitoring" VALUE 0x80591E74 Val_Wu8 191.3 temp_ub_q0p75_o48 -48.0 143.3 FORMAT "%5.1" /end CHARACTERISTIC
/begin AXIS_PTS MoF_tEng_DST "interpolation node distribution for engine temperature in the function monitoring" 0x80591E75 MoF_tEng Axis_Xu8 191.3 temp_ub_q0p75_o48 8 -48.0 143.3 FORMAT "%5.1" DEPOSIT ABSOLUTE /end AXIS_PTS
/begin CHARACTERISTIC MoF_tiTEngEna_C "time thershold after it the temperature plasibility check is enable in function monitoring" VALUE 0x80595D5A Val_Wu16 2621.400 t_q0p04 0.00 2621.400 FORMAT "%8.3" /end CHARACTERISTIC
/begin CHARACTERISTIC MoF_trqAdap_C "permissible adaptation torque in the function monitoring" VALUE 0x80591F02 Val_Wu8 408.0 md_q1p6 0.00 408.0 FORMAT "%5.1" /end CHARACTERISTIC
/begin CHARACTERISTIC MoF_trqChrChg_CUR "charge change losses in the function monitoring" CURVE 0x80591F03 ValA_Wu8 408.0 md_q1p6 0.00 408.0 FORMAT "%5.1"
 /begin AXIS_DESCR COM_AXIS MoFESpd_nEng nmot_q40 8 0.00 10200. FORMAT "%5.0" AXIS_PTS_REF MoFESpd_nEng_Ax /end AXIS_DESCR
/end CHARACTERISTIC
/begin CHARACTERISTIC MoF_trqConvNAP1_MAP "power train loss torque as f (engine speed, accelerator pedal) in the function monitoring" MAP 0x80591F0B MapG_Wu8 408.0 md_q1p6 0.00 408.0 FORMAT "%5.1"
 /begin AXIS_DESCR COM_AXIS MoFESpd_nEng nmot_q40 8 0.00 10200. FORMAT "%5.0" AXIS_PTS_REF MoFESpd_nEng_Ax /end AXIS_DESCR
 /begin AXIS_DESCR COM_AXIS MoF_rAPP rel_q0p39 8 0.00 99.61 FORMAT "%5.2" AXIS_PTS_REF MoF_rAPP_DST /end AXIS_DESCR
/end CHARACTERISTIC
/begin CHARACTERISTIC MoF_trqConvNT1_MAP "power train loss torque as f (engine speed, temperature) in the function monitoring" MAP 0x80591F4B MapG_Wu8 408.0 md_q1p6 0.00 408.0 FORMAT "%5.1"
 /begin AXIS_DESCR COM_AXIS MoFESpd_nEng nmot_q40 8 0.00 10200. FORMAT "%5.0" AXIS_PTS_REF MoFESpd_nEng_Ax /end AXIS_DESCR
 /begin AXIS_DESCR COM_AXIS MoF_tEng temp_ub_q0p75_o48 8 -48.0 143.3 FORMAT "%5.1" AXIS_PTS_REF MoF_tEng_DST /end AXIS_DESCR
/end CHARACTERISTIC
/begin CHARACTERISTIC MoF_trqDesAlt_MAP "electric consumer in the function monitoring" MAP 0x80591F8B MapG_Wu8 408.0 md_q1p6 0.00 408.0 FORMAT "%5.1"
 /begin AXIS_DESCR COM_AXIS MoFESpd_nEng nmot_q40 8 0.00 10200. FORMAT "%5.0" AXIS_PTS_REF MoFESpd_nEng_Ax /end AXIS_DESCR
 /begin AXIS_DESCR COM_AXIS MoF_tEng temp_ub_q0p75_o48 8 -48.0 143.3 FORMAT "%5.1" AXIS_PTS_REF MoF_tEng_DST /end AXIS_DESCR
/end CHARACTERISTIC
/begin CHARACTERISTIC MoF_trqDrag_MAP "friction losses in the function monitoring" MAP 0x80591FCB MapG_Wu8 408.0 md_q1p6 0.00 408.0 FORMAT "%5.1"
 /begin AXIS_DESCR COM_AXIS MoFESpd_nEng nmot_q40 8 0.00 10200. FORMAT "%5.0" AXIS_PTS_REF MoFESpd_nEng_Ax /end AXIS_DESCR
 /begin AXIS_DESCR COM_AXIS MoF_tEng temp_ub_q0p75_o48 8 -48.0 143.3 FORMAT "%5.1" AXIS_PTS_REF MoF_tEng_DST /end AXIS_DESCR
/end CHARACTERISTIC
/begin CHARACTERISTIC MoF_trqInrMinIncr_CUR "minimal torque with anti clack in function monitoring" CURVE 0x80591EB9 ValA_Wu8 408.0 md_q1p6 0.00 408.0 FORMAT "%5.1"
 /begin AXIS_DESCR COM_AXIS MoFESpd_nEng nmot_q40 8 0.00 10200. FORMAT "%5.0" AXIS_PTS_REF MoFESpd_nEng_Ax /end AXIS_DESCR
/end CHARACTERISTIC
/begin CHARACTERISTIC MoF_trqLosTra_CUR "power train loss in function monitoring" CURVE 0x8059200B ValA_Wu8 408.0 md_q1p6 0.00 408.0 FORMAT "%5.1"
 /begin AXIS_DESCR COM_AXIS MoF_tEng temp_ub_q0p75_o48 8 -48.0 143.3 FORMAT "%5.1" AXIS_PTS_REF MoF_tEng_DST /end AXIS_DESCR
/end CHARACTERISTIC
/begin CHARACTERISTIC MoF_trqLtdAC_CUR "AC torque in the function monitoring" CURVE 0x80592013 ValA_Wu8 408.0 md_q1p6 0.00 408.0 FORMAT "%5.1"
 /begin AXIS_DESCR COM_AXIS MoFESpd_nEng nmot_q40 8 0.00 10200. FORMAT "%5.0" AXIS_PTS_REF MoFESpd_nEng_Ax /end AXIS_DESCR
/end CHARACTERISTIC
/begin CHARACTERISTIC MoF_trqLtdFan_CUR "loss torque of the fan in the function monitoring" CURVE 0x8059201B ValA_Wu8 408.0 md_q1p6 0.00 408.0 FORMAT "%5.1"
 /begin AXIS_DESCR COM_AXIS MoF_tEng temp_ub_q0p75_o48 8 -48.0 143.3 FORMAT "%5.1" AXIS_PTS_REF MoF_tEng_DST /end AXIS_DESCR
/end CHARACTERISTIC
/begin CHARACTERISTIC MoF_trqMinAirChrg_MAP "minimal torque dependent on minimal load in the function monitoring" MAP 0x80591EC1 MapG_Wu8 408.0 md_q1p6 0.00 408.0 FORMAT "%5.1"
 /begin AXIS_DESCR COM_AXIS MoFESpd_nEng nmot_q40 8 0.00 10200. FORMAT "%5.0" AXIS_PTS_REF MoFESpd_nEng_Ax /end AXIS_DESCR
 /begin AXIS_DESCR COM_AXIS MoF_tEng temp_ub_q0p75_o48 8 -48.0 143.3 FORMAT "%5.1" AXIS_PTS_REF MoF_tEng_DST /end AXIS_DESCR
/end CHARACTERISTIC
/begin CHARACTERISTIC MoF_trqStrgLtd_C "loss torque of the power steering in the function monitoring" VALUE 0x80592023 Val_Wu8 408.0 md_q1p6 0.00 408.0 FORMAT "%5.1" /end CHARACTERISTIC
/begin MEASUREMENT MoFFrmRx_bbMoFFrm_Rx_flgATCVTShiftN_EATBCpl "Bit Base for MoFFrm_Rx_flgATCVTShiftN_EATBCpl" UBYTE OneToOne 1 100 0.00 255.0 FORMAT "%5.1" ECU_ADDRESS 0x600181D9 /end MEASUREMENT
/begin MEASUREMENT MoFFrmRx_bbMoFFrm_Rx_flgATCVTShiftP_EATBCpl "Bit Base for MoFFrm_Rx_flgATCVTShiftP_EATBCpl" UBYTE OneToOne 1 100 0.00 255.0 FORMAT "%5.1" ECU_ADDRESS 0x600181D8 /end MEASUREMENT
/begin MEASUREMENT MoFFrmRx_bbMoFFrm_Rx_flgBrkHldActv_GWIMG4Cpl "Bit Base for MoFFrm_Rx_flgBrkHldActv_GWIMG4Cpl" UBYTE OneToOne 1 100 0.00 255.0 FORMAT "%5.1" ECU_ADDRESS 0x600181D7 /end MEASUREMENT
/begin MEASUREMENT MoFFrmRx_bbMoFFrm_Rx_flgCVTShiftSure_EATBCpl "Bit Base for MoFFrm_Rx_flgCVTShiftSure_EATBCpl" UBYTE OneToOne 1 100 0.00 255.0 FORMAT "%5.1" ECU_ADDRESS 0x600181D6 /end MEASUREMENT
/begin MEASUREMENT MoFFrmRx_bbMoFFrm_Rx_flgDCSPlus_AYCFCpl "Bit Base for MoFFrm_Rx_flgDCSPlus_AYCFCpl" UBYTE OneToOne 1 100 0.00 255.0 FORMAT "%5.1" ECU_ADDRESS 0x600181D5 /end MEASUREMENT
/begin MEASUREMENT MoFFrmRx_bbMoFFrm_Rx_flgEBBBrkPedlOn_EBBACpl "Bit Base for MoFFrm_Rx_flgEBBBrkPedlOn_EBBACpl" UBYTE OneToOne 1 100 0.00 255.0 FORMAT "%5.1" ECU_ADDRESS 0x600181D4 /end MEASUREMENT
/begin MEASUREMENT MoFFrmRx_bbMoFFrm_Rx_flgMaiSwt_METACpl "Bit Base for MoFFrm_Rx_flgMaiSwt_METACpl" UBYTE OneToOne 1 100 0.00 255.0 FORMAT "%5.1" ECU_ADDRESS 0x600181D3 /end MEASUREMENT
/begin MEASUREMENT MoFFrmRx_bbMoFFrm_Rx_flgTMStrtEna_EAT12Cpl "Bit Base for MoFFrm_Rx_flgTMStrtEna_EAT12Cpl" UBYTE OneToOne 1 100 0.00 255.0 FORMAT "%5.1" ECU_ADDRESS 0x600181D2 /end MEASUREMENT
/begin MEASUREMENT MoFFrmRx_bbMoFFrm_Rx_flgTMStrtEna_EAT13Cpl "Bit Base for MoFFrm_Rx_flgTMStrtEna_EAT13Cpl" UBYTE OneToOne 1 100 0.00 255.0 FORMAT "%5.1" ECU_ADDRESS 0x600181D1 /end MEASUREMENT
/begin MEASUREMENT MoFFrm_flgComErrACC "CAN communication error from ACC control" UBYTE B_TRUE 1 100 0.00 1.00000000000 BIT_MASK 0x1 FORMAT "%13.11" ECU_ADDRESS 0x60018911 /end MEASUREMENT
/begin MEASUREMENT MoFFrm_flgDecIntvActvDCS "on CAN received info of decreasing torque intervention" UBYTE B_TRUE 1 100 0.00 1.00000000000 BIT_MASK 0x2 FORMAT "%13.11" ECU_ADDRESS 0x60018911 /end MEASUREMENT
/begin MEASUREMENT MoFFrm_flgDecIntvActvTra "Decreasing transmission intervention request flag" UBYTE B_TRUE 1 100 0.00 1.00000000000 BIT_MASK 0x4 FORMAT "%13.11" ECU_ADDRESS 0x60018911 /end MEASUREMENT
/begin MEASUREMENT MoFFrm_flgTqUpReqACC "torque up request from ACC control" UBYTE B_TRUE 1 100 0.00 1.00000000000 BIT_MASK 0x8 FORMAT "%13.11" ECU_ADDRESS 0x60018911 /end MEASUREMENT
/begin MEASUREMENT MoFFrm_Rx_bbOut1Cpl "Double storage variable of MoFFrm_Rx_bbOut1" UBYTE OneToOne 1 100 0.00 255.0 FORMAT "%5.1" ECU_ADDRESS 0x600181D0 /end MEASUREMENT
/begin MEASUREMENT MoFFrm_Rx_DataPdu_AYCF.cntrAlvErrDeb "Structure instance of PDU AYCF / Alive counter debounce error calibration of RX Data Pdu" UWORD OneToOne 1 100 0.00 65535.00 FORMAT "%8.2" ECU_ADDRESS 0x600188CA /end MEASUREMENT
/begin MEASUREMENT MoFFrm_Rx_DataPdu_AYCF.cntrAlvErrDebCpl "Structure instance of PDU AYCF / complement of alive counter debounce error calibration of RX Data Pdu" UWORD OneToOne 1 100 0.00 65535.00 FORMAT "%8.2" ECU_ADDRESS 0x600181AA /end MEASUREMENT
/begin MEASUREMENT MoFFrm_Rx_DataPdu_AYCF.cntrAlvOld "Structure instance of PDU AYCF / old alive counter calibration of RX Data Pdu" UBYTE OneToOne 1 100 0.00 255.0 FORMAT "%5.1" ECU_ADDRESS 0x600188CC /end MEASUREMENT
/begin MEASUREMENT MoFFrm_Rx_DataPdu_AYCF.cntrAlvOldCpl "Structure instance of PDU AYCF / Complement of old Alive counter calibration of RX Data Pdu" UBYTE OneToOne 1 100 0.00 255.0 FORMAT "%5.1" ECU_ADDRESS 0x600181AC /end MEASUREMENT
/begin MEASUREMENT MoFFrm_Rx_DataPdu_AYCF.cntrCrcErrDeb "Structure instance of PDU AYCF / Alive counter error debounce calibration of RX Data Pdu" UWORD OneToOne 1 100 0.00 65535.00 FORMAT "%8.2" ECU_ADDRESS 0x600188CE /end MEASUREMENT
/begin MEASUREMENT MoFFrm_Rx_DataPdu_AYCF.cntrCrcErrDebCpl "Structure instance of PDU AYCF / Complement of old Alive counter calibration of RX Data Pdu" UWORD OneToOne 1 100 0.00 65535.00 FORMAT "%8.2" ECU_ADDRESS 0x600181AE /end MEASUREMENT
/begin MEASUREMENT MoFFrm_Rx_DataPdu_AYCF.cntrCycTi "Structure instance of PDU AYCF / Alive counter debounce error calibration of RX Data Pdu" UWORD OneToOne 1 100 0.00 65535.00 FORMAT "%8.2" ECU_ADDRESS 0x600188D0 /end MEASUREMENT
/begin MEASUREMENT MoFFrm_Rx_DataPdu_AYCF.cntrCycTiCpl "Structure instance of PDU AYCF / Counter cyclic calibration of RX Data Pdu" UWORD OneToOne 1 100 0.00 65535.00 FORMAT "%8.2" ECU_ADDRESS 0x600181B0 /end MEASUREMENT
/begin MEASUREMENT MoFFrm_Rx_DataPdu_AYCF.cntrTiOutDeb "Structure instance of PDU AYCF / Counter time out debounce of Rx data PDU" UWORD OneToOne 1 100 0.00 65535.00 FORMAT "%8.2" ECU_ADDRESS 0x600188D2 /end MEASUREMENT
/begin MEASUREMENT MoFFrm_Rx_DataPdu_AYCF.cntrTiOutDebCpl "Structure instance of PDU AYCF / Complement of Counter time out debounce of Rx data PDU" UWORD OneToOne 1 100 0.00 65535.00 FORMAT "%8.2" ECU_ADDRESS 0x600181B2 /end MEASUREMENT
/begin MEASUREMENT MoFFrm_Rx_DataPdu_AYCF.crcData "Structure instance of PDU AYCF / CRC data of Rx data PDU" UWORD OneToOne 1 100 0.00 65535.00 FORMAT "%8.2" ECU_ADDRESS 0x600188D4 /end MEASUREMENT
/begin MEASUREMENT MoFFrm_Rx_DataPdu_AYCF.crcDataCpl "Structure instance of PDU AYCF / Comlement of CRC data of Rx data PDU" UWORD OneToOne 1 100 0.00 65535.00 FORMAT "%8.2" ECU_ADDRESS 0x600181B4 /end MEASUREMENT
/begin MEASUREMENT MoFFrm_Rx_DataPdu_AYCF.flgPduUpd "Structure instance of PDU AYCF / PDU update flag" UBYTE B_TRUE 1 100 0.00 1.00000000000 BIT_MASK 0x1 FORMAT "%13.11" ECU_ADDRESS 0x600188D6 /end MEASUREMENT
/begin MEASUREMENT MoFFrm_Rx_DataPdu_AYCF.flgPduUpdCpl "Structure instance of PDU AYCF / complement of PDU update flag" UBYTE B_TRUE 1 100 0.00 1.00000000000 BIT_MASK 0x1 FORMAT "%13.11" ECU_ADDRESS 0x600181B6 /end MEASUREMENT
/begin MEASUREMENT MoFFrm_Rx_DataPdu_EAT1.cntrAlvErrDeb "Structure instance of PDU EAT1 / Alive counter debounce error calibration of RX Data Pdu" UWORD OneToOne 1 100 0.00 65535.00 FORMAT "%8.2" ECU_ADDRESS 0x600188BC /end MEASUREMENT
/begin MEASUREMENT MoFFrm_Rx_DataPdu_EAT1.cntrAlvErrDebCpl "Structure instance of PDU EAT1 / complement of alive counter debounce error calibration of RX Data Pdu" UWORD OneToOne 1 100 0.00 65535.00 FORMAT "%8.2" ECU_ADDRESS 0x6001819C /end MEASUREMENT
/begin MEASUREMENT MoFFrm_Rx_DataPdu_EAT1.cntrAlvOld "Structure instance of PDU EAT1 / old alive counter calibration of RX Data Pdu" UBYTE OneToOne 1 100 0.00 255.0 FORMAT "%5.1" ECU_ADDRESS 0x600188BE /end MEASUREMENT
/begin MEASUREMENT MoFFrm_Rx_DataPdu_EAT1.cntrAlvOldCpl "Structure instance of PDU EAT1 / Complement of old Alive counter calibration of RX Data Pdu" UBYTE OneToOne 1 100 0.00 255.0 FORMAT "%5.1" ECU_ADDRESS 0x6001819E /end MEASUREMENT
/begin MEASUREMENT MoFFrm_Rx_DataPdu_EAT1.cntrCrcErrDeb "Structure instance of PDU EAT1 / Alive counter error debounce calibration of RX Data Pdu" UWORD OneToOne 1 100 0.00 65535.00 FORMAT "%8.2" ECU_ADDRESS 0x600188C0 /end MEASUREMENT
/begin MEASUREMENT MoFFrm_Rx_DataPdu_EAT1.cntrCrcErrDebCpl "Structure instance of PDU EAT1 / Complement of old Alive counter calibration of RX Data Pdu" UWORD OneToOne 1 100 0.00 65535.00 FORMAT "%8.2" ECU_ADDRESS 0x600181A0 /end MEASUREMENT
/begin MEASUREMENT MoFFrm_Rx_DataPdu_EAT1.cntrCycTi "Structure instance of PDU EAT1 / Alive counter debounce error calibration of RX Data Pdu" UWORD OneToOne 1 100 0.00 65535.00 FORMAT "%8.2" ECU_ADDRESS 0x600188C2 /end MEASUREMENT
/begin MEASUREMENT MoFFrm_Rx_DataPdu_EAT1.cntrCycTiCpl "Structure instance of PDU EAT1 / Counter cyclic calibration of RX Data Pdu" UWORD OneToOne 1 100 0.00 65535.00 FORMAT "%8.2" ECU_ADDRESS 0x600181A2 /end MEASUREMENT
/begin MEASUREMENT MoFFrm_Rx_DataPdu_EAT1.cntrTiOutDeb "Structure instance of PDU EAT1 / Counter time out debounce of Rx data PDU" UWORD OneToOne 1 100 0.00 65535.00 FORMAT "%8.2" ECU_ADDRESS 0x600188C4 /end MEASUREMENT
/begin MEASUREMENT MoFFrm_Rx_DataPdu_EAT1.cntrTiOutDebCpl "Structure instance of PDU EAT1 / Complement of Counter time out debounce of Rx data PDU" UWORD OneToOne 1 100 0.00 65535.00 FORMAT "%8.2" ECU_ADDRESS 0x600181A4 /end MEASUREMENT
/begin MEASUREMENT MoFFrm_Rx_DataPdu_EAT1.crcData "Structure instance of PDU EAT1 / CRC data of Rx data PDU" UWORD OneToOne 1 100 0.00 65535.00 FORMAT "%8.2" ECU_ADDRESS 0x600188C6 /end MEASUREMENT
/begin MEASUREMENT MoFFrm_Rx_DataPdu_EAT1.crcDataCpl "Structure instance of PDU EAT1 / Comlement of CRC data of Rx data PDU" UWORD OneToOne 1 100 0.00 65535.00 FORMAT "%8.2" ECU_ADDRESS 0x600181A6 /end MEASUREMENT
/begin MEASUREMENT MoFFrm_Rx_DataPdu_EAT1.flgPduUpd "Structure instance of PDU EAT1 / PDU update flag" UBYTE B_TRUE 1 100 0.00 1.00000000000 BIT_MASK 0x1 FORMAT "%13.11" ECU_ADDRESS 0x600188C8 /end MEASUREMENT
/begin MEASUREMENT MoFFrm_Rx_DataPdu_EAT1.flgPduUpdCpl "Structure instance of PDU EAT1 / complement of PDU update flag" UBYTE B_TRUE 1 100 0.00 1.00000000000 BIT_MASK 0x1 FORMAT "%13.11" ECU_ADDRESS 0x600181A8 /end MEASUREMENT
/begin MEASUREMENT MoFFrm_Rx_DataPdu_EAT12.cntrAlvErrDeb "Data PDU of EAT12 / Alive counter debounce error calibration of RX Data Pdu" UWORD OneToOne 1 100 0.00 65535.00 FORMAT "%8.2" ECU_ADDRESS 0x600188AE /end MEASUREMENT
/begin MEASUREMENT MoFFrm_Rx_DataPdu_EAT12.cntrAlvErrDebCpl "Data PDU of EAT12 / complement of alive counter debounce error calibration of RX Data Pdu" UWORD OneToOne 1 100 0.00 65535.00 FORMAT "%8.2" ECU_ADDRESS 0x6001818E /end MEASUREMENT
/begin MEASUREMENT MoFFrm_Rx_DataPdu_EAT12.cntrAlvOld "Data PDU of EAT12 / old alive counter calibration of RX Data Pdu" UBYTE OneToOne 1 100 0.00 255.0 FORMAT "%5.1" ECU_ADDRESS 0x600188B0 /end MEASUREMENT
/begin MEASUREMENT MoFFrm_Rx_DataPdu_EAT12.cntrAlvOldCpl "Data PDU of EAT12 / Complement of old Alive counter calibration of RX Data Pdu" UBYTE OneToOne 1 100 0.00 255.0 FORMAT "%5.1" ECU_ADDRESS 0x60018190 /end MEASUREMENT
/begin MEASUREMENT MoFFrm_Rx_DataPdu_EAT12.cntrCrcErrDeb "Data PDU of EAT12 / Alive counter error debounce calibration of RX Data Pdu" UWORD OneToOne 1 100 0.00 65535.00 FORMAT "%8.2" ECU_ADDRESS 0x600188B2 /end MEASUREMENT
/begin MEASUREMENT MoFFrm_Rx_DataPdu_EAT12.cntrCrcErrDebCpl "Data PDU of EAT12 / Complement of old Alive counter calibration of RX Data Pdu" UWORD OneToOne 1 100 0.00 65535.00 FORMAT "%8.2" ECU_ADDRESS 0x60018192 /end MEASUREMENT
/begin MEASUREMENT MoFFrm_Rx_DataPdu_EAT12.cntrCycTi "Data PDU of EAT12 / Alive counter debounce error calibration of RX Data Pdu" UWORD OneToOne 1 100 0.00 65535.00 FORMAT "%8.2" ECU_ADDRESS 0x600188B4 /end MEASUREMENT
/begin MEASUREMENT MoFFrm_Rx_DataPdu_EAT12.cntrCycTiCpl "Data PDU of EAT12 / Counter cyclic calibration of RX Data Pdu" UWORD OneToOne 1 100 0.00 65535.00 FORMAT "%8.2" ECU_ADDRESS 0x60018194 /end MEASUREMENT
/begin MEASUREMENT MoFFrm_Rx_DataPdu_EAT12.cntrTiOutDeb "Data PDU of EAT12 / Counter time out debounce of Rx data PDU" UWORD OneToOne 1 100 0.00 65535.00 FORMAT "%8.2" ECU_ADDRESS 0x600188B6 /end MEASUREMENT
/begin MEASUREMENT MoFFrm_Rx_DataPdu_EAT12.cntrTiOutDebCpl "Data PDU of EAT12 / Complement of Counter time out debounce of Rx data PDU" UWORD OneToOne 1 100 0.00 65535.00 FORMAT "%8.2" ECU_ADDRESS 0x60018196 /end MEASUREMENT
/begin MEASUREMENT MoFFrm_Rx_DataPdu_EAT12.crcData "Data PDU of EAT12 / CRC data of Rx data PDU" UWORD OneToOne 1 100 0.00 65535.00 FORMAT "%8.2" ECU_ADDRESS 0x600188B8 /end MEASUREMENT
/begin MEASUREMENT MoFFrm_Rx_DataPdu_EAT12.crcDataCpl "Data PDU of EAT12 / Comlement of CRC data of Rx data PDU" UWORD OneToOne 1 100 0.00 65535.00 FORMAT "%8.2" ECU_ADDRESS 0x60018198 /end MEASUREMENT
/begin MEASUREMENT MoFFrm_Rx_DataPdu_EAT12.flgPduUpd "Data PDU of EAT12 / PDU update flag" UBYTE B_TRUE 1 100 0.00 1.00000000000 BIT_MASK 0x1 FORMAT "%13.11" ECU_ADDRESS 0x600188BA /end MEASUREMENT
/begin MEASUREMENT MoFFrm_Rx_DataPdu_EAT12.flgPduUpdCpl "Data PDU of EAT12 / complement of PDU update flag" UBYTE B_TRUE 1 100 0.00 1.00000000000 BIT_MASK 0x1 FORMAT "%13.11" ECU_ADDRESS 0x6001819A /end MEASUREMENT
/begin MEASUREMENT MoFFrm_Rx_DataPdu_EAT13.cntrAlvErrDeb "Data PDU of EAT13 / Alive counter debounce error calibration of RX Data Pdu" UWORD OneToOne 1 100 0.00 65535.00 FORMAT "%8.2" ECU_ADDRESS 0x600188A0 /end MEASUREMENT
/begin MEASUREMENT MoFFrm_Rx_DataPdu_EAT13.cntrAlvErrDebCpl "Data PDU of EAT13 / complement of alive counter debounce error calibration of RX Data Pdu" UWORD OneToOne 1 100 0.00 65535.00 FORMAT "%8.2" ECU_ADDRESS 0x60018180 /end MEASUREMENT
/begin MEASUREMENT MoFFrm_Rx_DataPdu_EAT13.cntrAlvOld "Data PDU of EAT13 / old alive counter calibration of RX Data Pdu" UBYTE OneToOne 1 100 0.00 255.0 FORMAT "%5.1" ECU_ADDRESS 0x600188A2 /end MEASUREMENT
/begin MEASUREMENT MoFFrm_Rx_DataPdu_EAT13.cntrAlvOldCpl "Data PDU of EAT13 / Complement of old Alive counter calibration of RX Data Pdu" UBYTE OneToOne 1 100 0.00 255.0 FORMAT "%5.1" ECU_ADDRESS 0x60018182 /end MEASUREMENT
/begin MEASUREMENT MoFFrm_Rx_DataPdu_EAT13.cntrCrcErrDeb "Data PDU of EAT13 / Alive counter error debounce calibration of RX Data Pdu" UWORD OneToOne 1 100 0.00 65535.00 FORMAT "%8.2" ECU_ADDRESS 0x600188A4 /end MEASUREMENT
/begin MEASUREMENT MoFFrm_Rx_DataPdu_EAT13.cntrCrcErrDebCpl "Data PDU of EAT13 / Complement of old Alive counter calibration of RX Data Pdu" UWORD OneToOne 1 100 0.00 65535.00 FORMAT "%8.2" ECU_ADDRESS 0x60018184 /end MEASUREMENT
/begin MEASUREMENT MoFFrm_Rx_DataPdu_EAT13.cntrCycTi "Data PDU of EAT13 / Alive counter debounce error calibration of RX Data Pdu" UWORD OneToOne 1 100 0.00 65535.00 FORMAT "%8.2" ECU_ADDRESS 0x600188A6 /end MEASUREMENT
/begin MEASUREMENT MoFFrm_Rx_DataPdu_EAT13.cntrCycTiCpl "Data PDU of EAT13 / Counter cyclic calibration of RX Data Pdu" UWORD OneToOne 1 100 0.00 65535.00 FORMAT "%8.2" ECU_ADDRESS 0x60018186 /end MEASUREMENT
/begin MEASUREMENT MoFFrm_Rx_DataPdu_EAT13.cntrTiOutDeb "Data PDU of EAT13 / Counter time out debounce of Rx data PDU" UWORD OneToOne 1 100 0.00 65535.00 FORMAT "%8.2" ECU_ADDRESS 0x600188A8 /end MEASUREMENT
/begin MEASUREMENT MoFFrm_Rx_DataPdu_EAT13.cntrTiOutDebCpl "Data PDU of EAT13 / Complement of Counter time out debounce of Rx data PDU" UWORD OneToOne 1 100 0.00 65535.00 FORMAT "%8.2" ECU_ADDRESS 0x60018188 /end MEASUREMENT
/begin MEASUREMENT MoFFrm_Rx_DataPdu_EAT13.crcData "Data PDU of EAT13 / CRC data of Rx data PDU" UWORD OneToOne 1 100 0.00 65535.00 FORMAT "%8.2" ECU_ADDRESS 0x600188AA /end MEASUREMENT
/begin MEASUREMENT MoFFrm_Rx_DataPdu_EAT13.crcDataCpl "Data PDU of EAT13 / Comlement of CRC data of Rx data PDU" UWORD OneToOne 1 100 0.00 65535.00 FORMAT "%8.2" ECU_ADDRESS 0x6001818A /end MEASUREMENT
/begin MEASUREMENT MoFFrm_Rx_DataPdu_EAT13.flgPduUpd "Data PDU of EAT13 / PDU update flag" UBYTE B_TRUE 1 100 0.00 1.00000000000 BIT_MASK 0x1 FORMAT "%13.11" ECU_ADDRESS 0x600188AC /end MEASUREMENT
/begin MEASUREMENT MoFFrm_Rx_DataPdu_EAT13.flgPduUpdCpl "Data PDU of EAT13 / complement of PDU update flag" UBYTE B_TRUE 1 100 0.00 1.00000000000 BIT_MASK 0x1 FORMAT "%13.11" ECU_ADDRESS 0x6001818C /end MEASUREMENT
/begin MEASUREMENT MoFFrm_Rx_DataPdu_EAT4.cntrAlvErrDeb "Structure instance of PDU EAT4 / Alive counter debounce error calibration of RX Data Pdu" UWORD OneToOne 1 100 0.00 65535.00 FORMAT "%8.2" ECU_ADDRESS 0x60018892 /end MEASUREMENT
/begin MEASUREMENT MoFFrm_Rx_DataPdu_EAT4.cntrAlvErrDebCpl "Structure instance of PDU EAT4 / complement of alive counter debounce error calibration of RX Data Pdu" UWORD OneToOne 1 100 0.00 65535.00 FORMAT "%8.2" ECU_ADDRESS 0x60018172 /end MEASUREMENT
/begin MEASUREMENT MoFFrm_Rx_DataPdu_EAT4.cntrAlvOld "Structure instance of PDU EAT4 / old alive counter calibration of RX Data Pdu" UBYTE OneToOne 1 100 0.00 255.0 FORMAT "%5.1" ECU_ADDRESS 0x60018894 /end MEASUREMENT
/begin MEASUREMENT MoFFrm_Rx_DataPdu_EAT4.cntrAlvOldCpl "Structure instance of PDU EAT4 / Complement of old Alive counter calibration of RX Data Pdu" UBYTE OneToOne 1 100 0.00 255.0 FORMAT "%5.1" ECU_ADDRESS 0x60018174 /end MEASUREMENT
/begin MEASUREMENT MoFFrm_Rx_DataPdu_EAT4.cntrCrcErrDeb "Structure instance of PDU EAT4 / Alive counter error debounce calibration of RX Data Pdu" UWORD OneToOne 1 100 0.00 65535.00 FORMAT "%8.2" ECU_ADDRESS 0x60018896 /end MEASUREMENT
/begin MEASUREMENT MoFFrm_Rx_DataPdu_EAT4.cntrCrcErrDebCpl "Structure instance of PDU EAT4 / Complement of old Alive counter calibration of RX Data Pdu" UWORD OneToOne 1 100 0.00 65535.00 FORMAT "%8.2" ECU_ADDRESS 0x60018176 /end MEASUREMENT
/begin MEASUREMENT MoFFrm_Rx_DataPdu_EAT4.cntrCycTi "Structure instance of PDU EAT4 / Alive counter debounce error calibration of RX Data Pdu" UWORD OneToOne 1 100 0.00 65535.00 FORMAT "%8.2" ECU_ADDRESS 0x60018898 /end MEASUREMENT
/begin MEASUREMENT MoFFrm_Rx_DataPdu_EAT4.cntrCycTiCpl "Structure instance of PDU EAT4 / Counter cyclic calibration of RX Data Pdu" UWORD OneToOne 1 100 0.00 65535.00 FORMAT "%8.2" ECU_ADDRESS 0x60018178 /end MEASUREMENT
/begin MEASUREMENT MoFFrm_Rx_DataPdu_EAT4.cntrTiOutDeb "Structure instance of PDU EAT4 / Counter time out debounce of Rx data PDU" UWORD OneToOne 1 100 0.00 65535.00 FORMAT "%8.2" ECU_ADDRESS 0x6001889A /end MEASUREMENT
/begin MEASUREMENT MoFFrm_Rx_DataPdu_EAT4.cntrTiOutDebCpl "Structure instance of PDU EAT4 / Complement of Counter time out debounce of Rx data PDU" UWORD OneToOne 1 100 0.00 65535.00 FORMAT "%8.2" ECU_ADDRESS 0x6001817A /end MEASUREMENT
/begin MEASUREMENT MoFFrm_Rx_DataPdu_EAT4.crcData "Structure instance of PDU EAT4 / CRC data of Rx data PDU" UWORD OneToOne 1 100 0.00 65535.00 FORMAT "%8.2" ECU_ADDRESS 0x6001889C /end MEASUREMENT
/begin MEASUREMENT MoFFrm_Rx_DataPdu_EAT4.crcDataCpl "Structure instance of PDU EAT4 / Comlement of CRC data of Rx data PDU" UWORD OneToOne 1 100 0.00 65535.00 FORMAT "%8.2" ECU_ADDRESS 0x6001817C /end MEASUREMENT
/begin MEASUREMENT MoFFrm_Rx_DataPdu_EAT4.flgPduUpd "Structure instance of PDU EAT4 / PDU update flag" UBYTE B_TRUE 1 100 0.00 1.00000000000 BIT_MASK 0x1 FORMAT "%13.11" ECU_ADDRESS 0x6001889E /end MEASUREMENT
/begin MEASUREMENT MoFFrm_Rx_DataPdu_EAT4.flgPduUpdCpl "Structure instance of PDU EAT4 / complement of PDU update flag" UBYTE B_TRUE 1 100 0.00 1.00000000000 BIT_MASK 0x1 FORMAT "%13.11" ECU_ADDRESS 0x6001817E /end MEASUREMENT
/begin MEASUREMENT MoFFrm_Rx_DataPdu_EATB.cntrAlvErrDeb "Data PDU of EATB / Alive counter debounce error calibration of RX Data Pdu" UWORD OneToOne 1 100 0.00 65535.00 FORMAT "%8.2" ECU_ADDRESS 0x60018884 /end MEASUREMENT
/begin MEASUREMENT MoFFrm_Rx_DataPdu_EATB.cntrAlvErrDebCpl "Data PDU of EATB / complement of alive counter debounce error calibration of RX Data Pdu" UWORD OneToOne 1 100 0.00 65535.00 FORMAT "%8.2" ECU_ADDRESS 0x60018164 /end MEASUREMENT
/begin MEASUREMENT MoFFrm_Rx_DataPdu_EATB.cntrAlvOld "Data PDU of EATB / old alive counter calibration of RX Data Pdu" UBYTE OneToOne 1 100 0.00 255.0 FORMAT "%5.1" ECU_ADDRESS 0x60018886 /end MEASUREMENT
/begin MEASUREMENT MoFFrm_Rx_DataPdu_EATB.cntrAlvOldCpl "Data PDU of EATB / Complement of old Alive counter calibration of RX Data Pdu" UBYTE OneToOne 1 100 0.00 255.0 FORMAT "%5.1" ECU_ADDRESS 0x60018166 /end MEASUREMENT
/begin MEASUREMENT MoFFrm_Rx_DataPdu_EATB.cntrCrcErrDeb "Data PDU of EATB / Alive counter error debounce calibration of RX Data Pdu" UWORD OneToOne 1 100 0.00 65535.00 FORMAT "%8.2" ECU_ADDRESS 0x60018888 /end MEASUREMENT
/begin MEASUREMENT MoFFrm_Rx_DataPdu_EATB.cntrCrcErrDebCpl "Data PDU of EATB / Complement of old Alive counter calibration of RX Data Pdu" UWORD OneToOne 1 100 0.00 65535.00 FORMAT "%8.2" ECU_ADDRESS 0x60018168 /end MEASUREMENT
/begin MEASUREMENT MoFFrm_Rx_DataPdu_EATB.cntrCycTi "Data PDU of EATB / Alive counter debounce error calibration of RX Data Pdu" UWORD OneToOne 1 100 0.00 65535.00 FORMAT "%8.2" ECU_ADDRESS 0x6001888A /end MEASUREMENT
/begin MEASUREMENT MoFFrm_Rx_DataPdu_EATB.cntrCycTiCpl "Data PDU of EATB / Counter cyclic calibration of RX Data Pdu" UWORD OneToOne 1 100 0.00 65535.00 FORMAT "%8.2" ECU_ADDRESS 0x6001816A /end MEASUREMENT
/begin MEASUREMENT MoFFrm_Rx_DataPdu_EATB.cntrTiOutDeb "Data PDU of EATB / Counter time out debounce of Rx data PDU" UWORD OneToOne 1 100 0.00 65535.00 FORMAT "%8.2" ECU_ADDRESS 0x6001888C /end MEASUREMENT
/begin MEASUREMENT MoFFrm_Rx_DataPdu_EATB.cntrTiOutDebCpl "Data PDU of EATB / Complement of Counter time out debounce of Rx data PDU" UWORD OneToOne 1 100 0.00 65535.00 FORMAT "%8.2" ECU_ADDRESS 0x6001816C /end MEASUREMENT
/begin MEASUREMENT MoFFrm_Rx_DataPdu_EATB.crcData "Data PDU of EATB / CRC data of Rx data PDU" UWORD OneToOne 1 100 0.00 65535.00 FORMAT "%8.2" ECU_ADDRESS 0x6001888E /end MEASUREMENT
/begin MEASUREMENT MoFFrm_Rx_DataPdu_EATB.crcDataCpl "Data PDU of EATB / Comlement of CRC data of Rx data PDU" UWORD OneToOne 1 100 0.00 65535.00 FORMAT "%8.2" ECU_ADDRESS 0x6001816E /end MEASUREMENT
/begin MEASUREMENT MoFFrm_Rx_DataPdu_EATB.flgPduUpd "Data PDU of EATB / PDU update flag" UBYTE B_TRUE 1 100 0.00 1.00000000000 BIT_MASK 0x1 FORMAT "%13.11" ECU_ADDRESS 0x60018890 /end MEASUREMENT
/begin MEASUREMENT MoFFrm_Rx_DataPdu_EATB.flgPduUpdCpl "Data PDU of EATB / complement of PDU update flag" UBYTE B_TRUE 1 100 0.00 1.00000000000 BIT_MASK 0x1 FORMAT "%13.11" ECU_ADDRESS 0x60018170 /end MEASUREMENT
/begin MEASUREMENT MoFFrm_Rx_DataPdu_GWIMG3.cntrAlvErrDeb "Data PDU of GWIMG3 / Alive counter debounce error calibration of RX Data Pdu" UWORD OneToOne 1 100 0.00 65535.00 FORMAT "%8.2" ECU_ADDRESS 0x60018876 /end MEASUREMENT
/begin MEASUREMENT MoFFrm_Rx_DataPdu_GWIMG3.cntrAlvErrDebCpl "Data PDU of GWIMG3 / complement of alive counter debounce error calibration of RX Data Pdu" UWORD OneToOne 1 100 0.00 65535.00 FORMAT "%8.2" ECU_ADDRESS 0x60018156 /end MEASUREMENT
/begin MEASUREMENT MoFFrm_Rx_DataPdu_GWIMG3.cntrAlvOld "Data PDU of GWIMG3 / old alive counter calibration of RX Data Pdu" UBYTE OneToOne 1 100 0.00 255.0 FORMAT "%5.1" ECU_ADDRESS 0x60018878 /end MEASUREMENT
/begin MEASUREMENT MoFFrm_Rx_DataPdu_GWIMG3.cntrAlvOldCpl "Data PDU of GWIMG3 / Complement of old Alive counter calibration of RX Data Pdu" UBYTE OneToOne 1 100 0.00 255.0 FORMAT "%5.1" ECU_ADDRESS 0x60018158 /end MEASUREMENT
/begin MEASUREMENT MoFFrm_Rx_DataPdu_GWIMG3.cntrCrcErrDeb "Data PDU of GWIMG3 / Alive counter error debounce calibration of RX Data Pdu" UWORD OneToOne 1 100 0.00 65535.00 FORMAT "%8.2" ECU_ADDRESS 0x6001887A /end MEASUREMENT
/begin MEASUREMENT MoFFrm_Rx_DataPdu_GWIMG3.cntrCrcErrDebCpl "Data PDU of GWIMG3 / Complement of old Alive counter calibration of RX Data Pdu" UWORD OneToOne 1 100 0.00 65535.00 FORMAT "%8.2" ECU_ADDRESS 0x6001815A /end MEASUREMENT
/begin MEASUREMENT MoFFrm_Rx_DataPdu_GWIMG3.cntrCycTi "Data PDU of GWIMG3 / Alive counter debounce error calibration of RX Data Pdu" UWORD OneToOne 1 100 0.00 65535.00 FORMAT "%8.2" ECU_ADDRESS 0x6001887C /end MEASUREMENT
/begin MEASUREMENT MoFFrm_Rx_DataPdu_GWIMG3.cntrCycTiCpl "Data PDU of GWIMG3 / Counter cyclic calibration of RX Data Pdu" UWORD OneToOne 1 100 0.00 65535.00 FORMAT "%8.2" ECU_ADDRESS 0x6001815C /end MEASUREMENT
/begin MEASUREMENT MoFFrm_Rx_DataPdu_GWIMG3.cntrTiOutDeb "Data PDU of GWIMG3 / Counter time out debounce of Rx data PDU" UWORD OneToOne 1 100 0.00 65535.00 FORMAT "%8.2" ECU_ADDRESS 0x6001887E /end MEASUREMENT
/begin MEASUREMENT MoFFrm_Rx_DataPdu_GWIMG3.cntrTiOutDebCpl "Data PDU of GWIMG3 / Complement of Counter time out debounce of Rx data PDU" UWORD OneToOne 1 100 0.00 65535.00 FORMAT "%8.2" ECU_ADDRESS 0x6001815E /end MEASUREMENT
/begin MEASUREMENT MoFFrm_Rx_DataPdu_GWIMG3.crcData "Data PDU of GWIMG3 / CRC data of Rx data PDU" UWORD OneToOne 1 100 0.00 65535.00 FORMAT "%8.2" ECU_ADDRESS 0x60018880 /end MEASUREMENT
/begin MEASUREMENT MoFFrm_Rx_DataPdu_GWIMG3.crcDataCpl "Data PDU of GWIMG3 / Comlement of CRC data of Rx data PDU" UWORD OneToOne 1 100 0.00 65535.00 FORMAT "%8.2" ECU_ADDRESS 0x60018160 /end MEASUREMENT
/begin MEASUREMENT MoFFrm_Rx_DataPdu_GWIMG3.flgPduUpd "Data PDU of GWIMG3 / PDU update flag" UBYTE B_TRUE 1 100 0.00 1.00000000000 BIT_MASK 0x1 FORMAT "%13.11" ECU_ADDRESS 0x60018882 /end MEASUREMENT
/begin MEASUREMENT MoFFrm_Rx_DataPdu_GWIMG3.flgPduUpdCpl "Data PDU of GWIMG3 / complement of PDU update flag" UBYTE B_TRUE 1 100 0.00 1.00000000000 BIT_MASK 0x1 FORMAT "%13.11" ECU_ADDRESS 0x60018162 /end MEASUREMENT
/begin MEASUREMENT MoFFrm_Rx_DataPdu_META.cntrAlvErrDeb "Structure instance of PDU META / Alive counter debounce error calibration of RX Data Pdu" UWORD OneToOne 1 100 0.00 65535.00 FORMAT "%8.2" ECU_ADDRESS 0x60018868 /end MEASUREMENT
/begin MEASUREMENT MoFFrm_Rx_DataPdu_META.cntrAlvErrDebCpl "Structure instance of PDU META / complement of alive counter debounce error calibration of RX Data Pdu" UWORD OneToOne 1 100 0.00 65535.00 FORMAT "%8.2" ECU_ADDRESS 0x60018148 /end MEASUREMENT
/begin MEASUREMENT MoFFrm_Rx_DataPdu_META.cntrAlvOld "Structure instance of PDU META / old alive counter calibration of RX Data Pdu" UBYTE OneToOne 1 100 0.00 255.0 FORMAT "%5.1" ECU_ADDRESS 0x6001886A /end MEASUREMENT
/begin MEASUREMENT MoFFrm_Rx_DataPdu_META.cntrAlvOldCpl "Structure instance of PDU META / Complement of old Alive counter calibration of RX Data Pdu" UBYTE OneToOne 1 100 0.00 255.0 FORMAT "%5.1" ECU_ADDRESS 0x6001814A /end MEASUREMENT
/begin MEASUREMENT MoFFrm_Rx_DataPdu_META.cntrCrcErrDeb "Structure instance of PDU META / Alive counter error debounce calibration of RX Data Pdu" UWORD OneToOne 1 100 0.00 65535.00 FORMAT "%8.2" ECU_ADDRESS 0x6001886C /end MEASUREMENT
/begin MEASUREMENT MoFFrm_Rx_DataPdu_META.cntrCrcErrDebCpl "Structure instance of PDU META / Complement of old Alive counter calibration of RX Data Pdu" UWORD OneToOne 1 100 0.00 65535.00 FORMAT "%8.2" ECU_ADDRESS 0x6001814C /end MEASUREMENT
/begin MEASUREMENT MoFFrm_Rx_DataPdu_META.cntrCycTi "Structure instance of PDU META / Alive counter debounce error calibration of RX Data Pdu" UWORD OneToOne 1 100 0.00 65535.00 FORMAT "%8.2" ECU_ADDRESS 0x6001886E /end MEASUREMENT
/begin MEASUREMENT MoFFrm_Rx_DataPdu_META.cntrCycTiCpl "Structure instance of PDU META / Counter cyclic calibration of RX Data Pdu" UWORD OneToOne 1 100 0.00 65535.00 FORMAT "%8.2" ECU_ADDRESS 0x6001814E /end MEASUREMENT
/begin MEASUREMENT MoFFrm_Rx_DataPdu_META.cntrTiOutDeb "Structure instance of PDU META / Counter time out debounce of Rx data PDU" UWORD OneToOne 1 100 0.00 65535.00 FORMAT "%8.2" ECU_ADDRESS 0x60018870 /end MEASUREMENT
/begin MEASUREMENT MoFFrm_Rx_DataPdu_META.cntrTiOutDebCpl "Structure instance of PDU META / Complement of Counter time out debounce of Rx data PDU" UWORD OneToOne 1 100 0.00 65535.00 FORMAT "%8.2" ECU_ADDRESS 0x60018150 /end MEASUREMENT
/begin MEASUREMENT MoFFrm_Rx_DataPdu_META.crcData "Structure instance of PDU META / CRC data of Rx data PDU" UWORD OneToOne 1 100 0.00 65535.00 FORMAT "%8.2" ECU_ADDRESS 0x60018872 /end MEASUREMENT
/begin MEASUREMENT MoFFrm_Rx_DataPdu_META.crcDataCpl "Structure instance of PDU META / Comlement of CRC data of Rx data PDU" UWORD OneToOne 1 100 0.00 65535.00 FORMAT "%8.2" ECU_ADDRESS 0x60018152 /end MEASUREMENT
/begin MEASUREMENT MoFFrm_Rx_DataPdu_META.flgPduUpd "Structure instance of PDU META / PDU update flag" UBYTE B_TRUE 1 100 0.00 1.00000000000 BIT_MASK 0x1 FORMAT "%13.11" ECU_ADDRESS 0x60018874 /end MEASUREMENT
/begin MEASUREMENT MoFFrm_Rx_DataPdu_META.flgPduUpdCpl "Structure instance of PDU META / complement of PDU update flag" UBYTE B_TRUE 1 100 0.00 1.00000000000 BIT_MASK 0x1 FORMAT "%13.11" ECU_ADDRESS 0x60018154 /end MEASUREMENT
/begin MEASUREMENT MoFFrm_Rx_DataPdu_METL.cntrAlvErrDeb "Structure instance of PDU METL / Alive counter debounce error calibration of RX Data Pdu" UWORD OneToOne 1 100 0.00 65535.00 FORMAT "%8.2" ECU_ADDRESS 0x6001885A /end MEASUREMENT
/begin MEASUREMENT MoFFrm_Rx_DataPdu_METL.cntrAlvErrDebCpl "Structure instance of PDU METL / complement of alive counter debounce error calibration of RX Data Pdu" UWORD OneToOne 1 100 0.00 65535.00 FORMAT "%8.2" ECU_ADDRESS 0x6001813A /end MEASUREMENT
/begin MEASUREMENT MoFFrm_Rx_DataPdu_METL.cntrAlvOld "Structure instance of PDU METL / old alive counter calibration of RX Data Pdu" UBYTE OneToOne 1 100 0.00 255.0 FORMAT "%5.1" ECU_ADDRESS 0x6001885C /end MEASUREMENT
/begin MEASUREMENT MoFFrm_Rx_DataPdu_METL.cntrAlvOldCpl "Structure instance of PDU METL / Complement of old Alive counter calibration of RX Data Pdu" UBYTE OneToOne 1 100 0.00 255.0 FORMAT "%5.1" ECU_ADDRESS 0x6001813C /end MEASUREMENT
/begin MEASUREMENT MoFFrm_Rx_DataPdu_METL.cntrCrcErrDeb "Structure instance of PDU METL / Alive counter error debounce calibration of RX Data Pdu" UWORD OneToOne 1 100 0.00 65535.00 FORMAT "%8.2" ECU_ADDRESS 0x6001885E /end MEASUREMENT
/begin MEASUREMENT MoFFrm_Rx_DataPdu_METL.cntrCrcErrDebCpl "Structure instance of PDU METL / Complement of old Alive counter calibration of RX Data Pdu" UWORD OneToOne 1 100 0.00 65535.00 FORMAT "%8.2" ECU_ADDRESS 0x6001813E /end MEASUREMENT
/begin MEASUREMENT MoFFrm_Rx_DataPdu_METL.cntrCycTi "Structure instance of PDU METL / Alive counter debounce error calibration of RX Data Pdu" UWORD OneToOne 1 100 0.00 65535.00 FORMAT "%8.2" ECU_ADDRESS 0x60018860 /end MEASUREMENT
/begin MEASUREMENT MoFFrm_Rx_DataPdu_METL.cntrCycTiCpl "Structure instance of PDU METL / Counter cyclic calibration of RX Data Pdu" UWORD OneToOne 1 100 0.00 65535.00 FORMAT "%8.2" ECU_ADDRESS 0x60018140 /end MEASUREMENT
/begin MEASUREMENT MoFFrm_Rx_DataPdu_METL.cntrTiOutDeb "Structure instance of PDU METL / Counter time out debounce of Rx data PDU" UWORD OneToOne 1 100 0.00 65535.00 FORMAT "%8.2" ECU_ADDRESS 0x60018862 /end MEASUREMENT
/begin MEASUREMENT MoFFrm_Rx_DataPdu_METL.cntrTiOutDebCpl "Structure instance of PDU METL / Complement of Counter time out debounce of Rx data PDU" UWORD OneToOne 1 100 0.00 65535.00 FORMAT "%8.2" ECU_ADDRESS 0x60018142 /end MEASUREMENT
/begin MEASUREMENT MoFFrm_Rx_DataPdu_METL.crcData "Structure instance of PDU METL / CRC data of Rx data PDU" UWORD OneToOne 1 100 0.00 65535.00 FORMAT "%8.2" ECU_ADDRESS 0x60018864 /end MEASUREMENT
/begin MEASUREMENT MoFFrm_Rx_DataPdu_METL.crcDataCpl "Structure instance of PDU METL / Comlement of CRC data of Rx data PDU" UWORD OneToOne 1 100 0.00 65535.00 FORMAT "%8.2" ECU_ADDRESS 0x60018144 /end MEASUREMENT
/begin MEASUREMENT MoFFrm_Rx_DataPdu_METL.flgPduUpd "Structure instance of PDU METL / PDU update flag" UBYTE B_TRUE 1 100 0.00 1.00000000000 BIT_MASK 0x1 FORMAT "%13.11" ECU_ADDRESS 0x60018866 /end MEASUREMENT
/begin MEASUREMENT MoFFrm_Rx_DataPdu_METL.flgPduUpdCpl "Structure instance of PDU METL / complement of PDU update flag" UBYTE B_TRUE 1 100 0.00 1.00000000000 BIT_MASK 0x1 FORMAT "%13.11" ECU_ADDRESS 0x60018146 /end MEASUREMENT
/begin MEASUREMENT MoFFrm_Rx_flgATCVTShiftN_EATB "Flag for Neutral gear position" UBYTE B_TRUE 1 100 0.00 1.00000000000 BIT_MASK 0x1 FORMAT "%13.11" ECU_ADDRESS 0x600188FE /end MEASUREMENT
/begin MEASUREMENT MoFFrm_Rx_flgATCVTShiftP_EATB "Flag for Parking gear position" UBYTE B_TRUE 1 100 0.00 1.00000000000 BIT_MASK 0x1 FORMAT "%13.11" ECU_ADDRESS 0x600188FD /end MEASUREMENT
/begin MEASUREMENT MoFFrm_Rx_flgBrkHldActv_GWIMG4 "Flag for Brake hold Active" UBYTE B_TRUE 1 100 0.00 1.00000000000 BIT_MASK 0x1 FORMAT "%13.11" ECU_ADDRESS 0x600188FC /end MEASUREMENT
/begin MEASUREMENT MoFFrm_Rx_flgCVTShiftSure_EATB "indicates that shift position signal is confirmed" UBYTE B_TRUE 1 100 0.00 1.00000000000 BIT_MASK 0x1 FORMAT "%13.11" ECU_ADDRESS 0x600188FB /end MEASUREMENT
/begin MEASUREMENT MoFFrm_Rx_flgDCSPlus_AYCF "DCS Plus activ" UBYTE B_TRUE 1 100 0.00 1.00000000000 BIT_MASK 0x1 FORMAT "%13.11" ECU_ADDRESS 0x600188FA /end MEASUREMENT
/begin MEASUREMENT MoFFrm_Rx_flgEBBBrkPedlOn_EBBA "Brake pressed signal from EBBA" UBYTE B_TRUE 1 100 0.00 1.00000000000 BIT_MASK 0x1 FORMAT "%13.11" ECU_ADDRESS 0x600188F9 /end MEASUREMENT
/begin MEASUREMENT MoFFrm_Rx_flgMaiSwt_META "Main Brake switch signal" UBYTE B_TRUE 1 100 0.00 1.00000000000 BIT_MASK 0x1 FORMAT "%13.11" ECU_ADDRESS 0x600188F8 /end MEASUREMENT
/begin MEASUREMENT MoFFrm_Rx_flgTMStrtEna_EAT12 "Flag indicating that disen- gaged gear information is transmitted" UBYTE B_TRUE 1 100 0.00 1.00000000000 BIT_MASK 0x1 FORMAT "%13.11" ECU_ADDRESS 0x600188F7 /end MEASUREMENT
/begin MEASUREMENT MoFFrm_Rx_flgTMStrtEna_EAT13 "Flag indicating that disen- gaged gear information is transmitted" UBYTE B_TRUE 1 100 0.00 1.00000000000 BIT_MASK 0x1 FORMAT "%13.11" ECU_ADDRESS 0x600188F6 /end MEASUREMENT
/begin MEASUREMENT MoFFrm_Rx_mirrBuf "Mirror buffer for CAN for RX internal caculation" UBYTE OneToOne 1 100 0.00 255.0 FORMAT "%5.1" ARRAY_SIZE 8 ECU_ADDRESS 0x60018909 /end MEASUREMENT
/begin MEASUREMENT MoFFrm_Rx_rawCVT_SHFT_IN_NEUTRAL "Neutral gear info" UBYTE OneToOne 1 100 0.00 255.0 FORMAT "%5.1" ECU_ADDRESS 0x60018908 /end MEASUREMENT
/begin MEASUREMENT MoFFrm_Rx_rawCVT_SHFT_IN_PARKING "Parking gear info" UBYTE OneToOne 1 100 0.00 255.0 FORMAT "%5.1" ECU_ADDRESS 0x60018907 /end MEASUREMENT
/begin MEASUREMENT MoFFrm_Rx_rawCVT_SHIFT_SURE "indicates that shift position signal is confirmed" UBYTE OneToOne 1 100 0.00 255.0 FORMAT "%5.1" ECU_ADDRESS 0x60018906 /end MEASUREMENT
/begin MEASUREMENT MoFFrm_Rx_rawIMG_DRVTRQ_STATUS "Raw value of signal IMG_DRVTRQ_STATUS" UBYTE OneToOne 1 100 0.00 255.0 FORMAT "%5.1" ECU_ADDRESS 0x60018905 /end MEASUREMENT
/begin MEASUREMENT MoFFrm_Rx_rawMETER_CC_MAIN_STATUS "Raw value of signal MoFFrm_Rx_rawMETER_CC_MAIN_STATUS" UBYTE OneToOne 1 100 0.00 255.0 FORMAT "%5.1" ECU_ADDRESS 0x60018904 /end MEASUREMENT
/begin MEASUREMENT MoFFrm_Rx_rawMETER_SW_STATUS_CC_STANDARD "Raw value of signal METER_SW_STATUS_CC_STANDAR" UBYTE OneToOne 1 100 0.00 255.0 FORMAT "%5.1" ECU_ADDRESS 0x60018903 /end MEASUREMENT
/begin MEASUREMENT MoFFrm_Rx_rawTM_REQ_ENG_TORQUE_FAST "Raw value of signal TM_REQ_ENG_TORQUE_FAST" SWORD OneToOne 1 100 -32768.00 32767.00 FORMAT "%8.2" ECU_ADDRESS 0x600188E4 /end MEASUREMENT
/begin MEASUREMENT MoFFrm_Rx_rawTM_START_ENABLE "Raw value of signal TM_START_ENABLE" UBYTE OneToOne 1 100 0.00 255.0 FORMAT "%5.1" ECU_ADDRESS 0x60018902 /end MEASUREMENT
/begin MEASUREMENT MoFFrm_Rx_rawTM_START_ENABLESUB "Raw value of signal TM_START_ENABLESUB" UBYTE OneToOne 1 100 0.00 255.0 FORMAT "%5.1" ECU_ADDRESS 0x60018901 /end MEASUREMENT
/begin MEASUREMENT MoFFrm_Rx_rawTM_TORQUE_CONV_TORQUE_RATIO "Raw value of signal TM_TORQUE_CONV_TORQUE_RATIO" UWORD OneToOne 1 100 0.00 65535.00 FORMAT "%8.2" ECU_ADDRESS 0x600188E2 /end MEASUREMENT
/begin MEASUREMENT MoFFrm_Rx_rawVSA_REQ_MSR_PLUS_TRQ "Raw value of signal VSA_REQ_MSR_PLUS_TRQ" UBYTE OneToOne 1 100 0.00 255.0 FORMAT "%5.1" ECU_ADDRESS 0x60018900 /end MEASUREMENT
/begin MEASUREMENT MoFFrm_Rx_rawVSA_REQ_TRQ_1AC "Raw value of signal VSA_REQ_TRQ_1AC" SWORD OneToOne 1 100 -32768.00 32767.00 FORMAT "%8.2" ECU_ADDRESS 0x600188E0 /end MEASUREMENT
/begin MEASUREMENT MoFFrm_Rx_rawVSA_TRQ_CONTROL_MODE "Raw value of signal VSA_TRQ_CONTROL_MODE" UBYTE OneToOne 1 100 0.00 255.0 FORMAT "%5.1" ECU_ADDRESS 0x600188FF /end MEASUREMENT
/begin MEASUREMENT MoFFrm_Rx_rTrqCnvBoost_EAT1 "Booster Torque Converter ratio" UWORD fak_q6p1035Em5_AFm16 1 100 0.00 3.999938964843750 FORMAT "%17.15" ECU_ADDRESS 0x600188DE /end MEASUREMENT
/begin MEASUREMENT MoFFrm_Rx_rTrqCnvBoost_EAT1Cpl "Complement of Booster Torque Converter ratio" UWORD OneToOne 1 100 0.00 65535.00 FORMAT "%8.2" ECU_ADDRESS 0x600181BE /end MEASUREMENT
/begin MEASUREMENT MoFFrm_Rx_stACCActv_GWIMG3 "ACC active status" UBYTE OneToOne 1 100 0.00 3.000 FORMAT "%5.3" ECU_ADDRESS 0x600188F5 /end MEASUREMENT
/begin MEASUREMENT MoFFrm_Rx_stACCActv_GWIMG3Cpl "Complement of ACC active status" UBYTE OneToOne 1 100 0.00 255.0 FORMAT "%5.1" ECU_ADDRESS 0x600181CF /end MEASUREMENT
/begin MEASUREMENT MoFFrm_Rx_stButtonRaw_METL "Status of button" UBYTE OneToOne 1 100 0.00 7.000 FORMAT "%5.3" ECU_ADDRESS 0x600188F4 /end MEASUREMENT
/begin MEASUREMENT MoFFrm_Rx_stButtonRaw_METLCpl "Complement of Status of button" UBYTE OneToOne 1 100 0.00 255.0 FORMAT "%5.1" ECU_ADDRESS 0x600181CE /end MEASUREMENT
/begin MEASUREMENT MoFFrm_Rx_stEcoModOn_METD "ECO mode status" UBYTE OneToOne 1 100 0.00 255.0 FORMAT "%5.1" ECU_ADDRESS 0x600188F3 /end MEASUREMENT
/begin MEASUREMENT MoFFrm_Rx_stEcoModOn_METDCpl "Complement of MoFFrm_Rx_stEcoModOn_METD" UBYTE OneToOne 1 100 0.00 255.0 FORMAT "%5.1" ECU_ADDRESS 0x600181CD /end MEASUREMENT
/begin MEASUREMENT MoFFrm_Rx_stPdu_AYCF "AYCF CAN frame Pdu Qualifier" UBYTE OneToOne 1 100 0.00 255.0 FORMAT "%5.1" ECU_ADDRESS 0x600188F2 /end MEASUREMENT
/begin MEASUREMENT MoFFrm_Rx_stPdu_AYCFCpl "RAM redundancy of MoFFrm_Rx_stPdu_AYCF" UBYTE OneToOne 1 100 0.00 255.0 FORMAT "%5.1" ECU_ADDRESS 0x600181CC /end MEASUREMENT
/begin MEASUREMENT MoFFrm_Rx_stPdu_EAT1 "EAT1 CAN frame Pdu Qualifier" UBYTE OneToOne 1 100 0.00 255.0 FORMAT "%5.1" ECU_ADDRESS 0x600188F1 /end MEASUREMENT
/begin MEASUREMENT MoFFrm_Rx_stPdu_EAT12 "Status of PDU EAT12" UBYTE OneToOne 1 100 0.00 255.0 FORMAT "%5.1" ECU_ADDRESS 0x600188F0 /end MEASUREMENT
/begin MEASUREMENT MoFFrm_Rx_stPdu_EAT12Cpl "Status of PDU EAT12 - Complement" UBYTE OneToOne 1 100 0.00 255.0 FORMAT "%5.1" ECU_ADDRESS 0x600181CB /end MEASUREMENT
/begin MEASUREMENT MoFFrm_Rx_stPdu_EAT13 "Status of PDU EAT13" UBYTE OneToOne 1 100 0.00 255.0 FORMAT "%5.1" ECU_ADDRESS 0x600188EF /end MEASUREMENT
/begin MEASUREMENT MoFFrm_Rx_stPdu_EAT13Cpl "Status of PDU EAT13 - Complement" UBYTE OneToOne 1 100 0.00 255.0 FORMAT "%5.1" ECU_ADDRESS 0x600181CA /end MEASUREMENT
/begin MEASUREMENT MoFFrm_Rx_stPdu_EAT1Cpl "RAM redundancy of MoFFrm_Rx_stPdu_EAT1" UBYTE OneToOne 1 100 0.00 255.0 FORMAT "%5.1" ECU_ADDRESS 0x600181C9 /end MEASUREMENT
/begin MEASUREMENT MoFFrm_Rx_stPdu_EAT4 "EAT4 CAN frame Pdu Qualifier" UBYTE OneToOne 1 100 0.00 255.0 FORMAT "%5.1" ECU_ADDRESS 0x600188EE /end MEASUREMENT
/begin MEASUREMENT MoFFrm_Rx_stPdu_EAT4Cpl "RAM redundancy of MoFFrm_Rx_stPdu_EAT4" UBYTE OneToOne 1 100 0.00 255.0 FORMAT "%5.1" ECU_ADDRESS 0x600181C8 /end MEASUREMENT
/begin MEASUREMENT MoFFrm_Rx_stPdu_EATB "Status of PDU EATB" UBYTE OneToOne 1 100 0.00 255.0 FORMAT "%5.1" ECU_ADDRESS 0x600188ED /end MEASUREMENT
/begin MEASUREMENT MoFFrm_Rx_stPdu_EATBCpl "Status of PDU EATB - Complement" UBYTE OneToOne 1 100 0.00 255.0 FORMAT "%5.1" ECU_ADDRESS 0x600181C7 /end MEASUREMENT
/begin MEASUREMENT MoFFrm_Rx_stPdu_EBBA "Status of PDU EBBA" UBYTE OneToOne 1 100 0.00 255.0 FORMAT "%5.1" ECU_ADDRESS 0x600188EC /end MEASUREMENT
/begin MEASUREMENT MoFFrm_Rx_stPdu_EBBACpl "Status of PDU EBBA - Complement" UBYTE OneToOne 1 100 0.00 255.0 FORMAT "%5.1" ECU_ADDRESS 0x600181C6 /end MEASUREMENT
/begin MEASUREMENT MoFFrm_Rx_stPdu_GWIMG3 "Status of PDU GWIMG3" UBYTE OneToOne 1 100 0.00 255.0 FORMAT "%5.1" ECU_ADDRESS 0x600188EB /end MEASUREMENT
/begin MEASUREMENT MoFFrm_Rx_stPdu_GWIMG3Cpl "Status of PDU GWIMG3 - Complement" UBYTE OneToOne 1 100 0.00 255.0 FORMAT "%5.1" ECU_ADDRESS 0x600181C5 /end MEASUREMENT
/begin MEASUREMENT MoFFrm_Rx_stPdu_GWIMG4 "Status of PDU GWIMG4" UBYTE OneToOne 1 100 0.00 255.0 FORMAT "%5.1" ECU_ADDRESS 0x600188EA /end MEASUREMENT
/begin MEASUREMENT MoFFrm_Rx_stPdu_GWIMG4Cpl "Status of PDU GWIMG4 - Complement" UBYTE OneToOne 1 100 0.00 255.0 FORMAT "%5.1" ECU_ADDRESS 0x600181C4 /end MEASUREMENT
/begin MEASUREMENT MoFFrm_Rx_stPdu_META "META CAN frame Pdu Qualifier" UBYTE OneToOne 1 100 0.00 255.0 FORMAT "%5.1" ECU_ADDRESS 0x600188E9 /end MEASUREMENT
/begin MEASUREMENT MoFFrm_Rx_stPdu_METACpl "RAM data redundancy of META" UBYTE OneToOne 1 100 0.00 255.0 FORMAT "%5.1" ECU_ADDRESS 0x600181C3 /end MEASUREMENT
/begin MEASUREMENT MoFFrm_Rx_stPdu_METD "Status of PDU METD" UBYTE OneToOne 1 100 0.00 255.0 FORMAT "%5.1" ECU_ADDRESS 0x600188E8 /end MEASUREMENT
/begin MEASUREMENT MoFFrm_Rx_stPdu_METDCpl "Complement of MoFFrm_Rx_stPdu_METD" UBYTE OneToOne 1 100 0.00 255.0 FORMAT "%5.1" ECU_ADDRESS 0x600181C2 /end MEASUREMENT
/begin MEASUREMENT MoFFrm_Rx_stPdu_METL "METL CAN frame Pdu Qualifier" UBYTE OneToOne 1 100 0.00 255.0 FORMAT "%5.1" ECU_ADDRESS 0x600188E7 /end MEASUREMENT
/begin MEASUREMENT MoFFrm_Rx_stPdu_METLCpl "RAM data redundancy of MoFFrm_Rx_stPdu_METL" UBYTE OneToOne 1 100 0.00 255.0 FORMAT "%5.1" ECU_ADDRESS 0x600181C1 /end MEASUREMENT
/begin MEASUREMENT MoFFrm_Rx_stTqUpReqDCS_AYCF "Torque Up request status" UBYTE OneToOne 1 100 0.00 3.000 FORMAT "%5.3" ECU_ADDRESS 0x600188E6 /end MEASUREMENT
/begin MEASUREMENT MoFFrm_Rx_stTqUpReqDCS_AYCFCpl "Complement of Torque Up request status" UBYTE OneToOne 1 100 0.00 255.0 FORMAT "%5.1" ECU_ADDRESS 0x600181C0 /end MEASUREMENT
/begin MEASUREMENT MoFFrm_Rx_tqCluTra_EAT4 "Clutch Torque" SWORD md_q0p1 1 100 -3276.800 3276.700 FORMAT "%8.3" ECU_ADDRESS 0x600188DC /end MEASUREMENT
/begin MEASUREMENT MoFFrm_Rx_tqCluTra_EAT4Cpl "Complement of Clutch Torque" UWORD OneToOne 1 100 0.00 65535.00 FORMAT "%8.2" ECU_ADDRESS 0x600181BC /end MEASUREMENT
/begin MEASUREMENT MoFFrm_Rx_tqWhlDCS_AYCF "DCS wheel Torque" SWORD md_q0p1 1 100 -3276.800 3276.700 FORMAT "%8.3" ECU_ADDRESS 0x600188DA /end MEASUREMENT
/begin MEASUREMENT MoFFrm_Rx_tqWhlDCS_AYCFCpl "Complement of DCS wheel Torque" UWORD OneToOne 1 100 0.00 65535.00 FORMAT "%8.2" ECU_ADDRESS 0x600181BA /end MEASUREMENT
/begin MEASUREMENT MoFFrm_tqWhlACC "requested ACC torque from ACC-control" SWORD md_q0p1 1 100 -3276.800 3276.700 FORMAT "%8.3" ECU_ADDRESS 0x600188D8 /end MEASUREMENT
/begin MEASUREMENT MoFFrm_tqWhlACCCpl "RAM data redundancy of MoFFrm_tqWhlACC" UWORD OneToOne 1 100 0.00 65535.00 FORMAT "%8.2" ECU_ADDRESS 0x600181B8 /end MEASUREMENT
/begin MEASUREMENT MoFFrm_Tx_bbOutENGACpl "CPL of ENGA PDU bbout" UBYTE OneToOne 1 100 0.00 255.0 FORMAT "%5.1" ECU_ADDRESS 0x60018138 /end MEASUREMENT
/begin MEASUREMENT MoFFrm_Tx_Buf_ENGA "ENGA PDU buffer" UBYTE OneToOne 1 100 0.00 255.0 FORMAT "%5.1" ARRAY_SIZE 8 ECU_ADDRESS 0x6000B703 /end MEASUREMENT
/begin MEASUREMENT MoFFrm_Tx_dataENG_ACCELE_FAIL_INFORMATION "dataENG of Acc pedal status" UBYTE OneToOne 1 100 0.00 255.0 FORMAT "%5.1" ECU_ADDRESS 0x60018857 /end MEASUREMENT
/begin MEASUREMENT MoFFrm_Tx_dataENG_ACCELE_FAIL_INFORMATIONCpl "dataeng of ACC pedal status cpl" UBYTE OneToOne 1 100 0.00 255.0 FORMAT "%5.1" ECU_ADDRESS 0x60018137 /end MEASUREMENT
/begin MEASUREMENT MoFFrm_Tx_dataENG_DRIVER_ACPEDAL_POSITION "DataEng of acc pedal position" UBYTE OneToOne 1 100 0.00 255.0 FORMAT "%5.1" ECU_ADDRESS 0x60018856 /end MEASUREMENT
/begin MEASUREMENT MoFFrm_Tx_dataENG_DRIVER_ACPEDAL_POSITIONCpl "DataEng of Acc pedal position CPL" UBYTE OneToOne 1 100 0.00 255.0 FORMAT "%5.1" ECU_ADDRESS 0x60018136 /end MEASUREMENT
/begin MEASUREMENT MoFFrm_Tx_DataPdu_ENGA.cntrAlvOld "DATA PDU ENGA / old alive counter" UBYTE OneToOne 1 100 0.00 255.0 FORMAT "%5.1" ECU_ADDRESS 0x60018848 /end MEASUREMENT
/begin MEASUREMENT MoFFrm_Tx_DataPdu_ENGA.cntrAlvOldCpl "DATA PDU ENGA / complement of oold alive counter" UBYTE OneToOne 1 100 0.00 255.0 FORMAT "%5.1" ECU_ADDRESS 0x60018130 /end MEASUREMENT
/begin MEASUREMENT MoFFrm_Tx_DataPdu_ENGA.crcData "DATA PDU ENGA / crc data" UWORD OneToOne 1 100 0.00 65535.00 FORMAT "%8.2" ECU_ADDRESS 0x6001884A /end MEASUREMENT
/begin MEASUREMENT MoFFrm_Tx_DataPdu_ENGA.crcDataCpl "DATA PDU ENGA / complement of crc data" UWORD OneToOne 1 100 0.00 65535.00 FORMAT "%8.2" ECU_ADDRESS 0x60018132 /end MEASUREMENT
/begin MEASUREMENT MoFFrm_Tx_DataPdu_ENGA.flgAswTrigTx "DATA PDU ENGA / ASW Tx trigger flag" UBYTE B_TRUE 1 100 0.00 1.00000000000 BIT_MASK 0x1 FORMAT "%13.11" ECU_ADDRESS 0x6001884C /end MEASUREMENT
/begin MEASUREMENT MoFFrm_Tx_DataPdu_ENGA.flgAswTrigTxCpl "DATA PDU ENGA / complement of ASW Tx trigger flag" UBYTE B_TRUE 1 100 0.00 1.00000000000 BIT_MASK 0x1 FORMAT "%13.11" ECU_ADDRESS 0x60018134 /end MEASUREMENT
/begin MEASUREMENT MoFFrm_Tx_flgPduStENGA "PDU status of ENGA" UBYTE B_TRUE 1 100 0.00 1.00000000000 BIT_MASK 0x1 FORMAT "%13.11" ECU_ADDRESS 0x60018858 /end MEASUREMENT
/begin MEASUREMENT MoFFrm_Tx_mirrBuf "Transmit mirror buffer" UBYTE OneToOne 1 100 0.00 255.0 FORMAT "%5.1" ARRAY_SIZE 8 ECU_ADDRESS 0x6001884E /end MEASUREMENT
/begin MEASUREMENT MoFHybRxCo_bbOut1Cpl "duplicate storage of MoFHybRxCo_bbOut1" UBYTE OneToOne 1 100 0.00 255.0 FORMAT "%5.1" ECU_ADDRESS 0x6001812E /end MEASUREMENT
/begin MEASUREMENT MoFHybRx_flgComErrElDrv "flag communication with the electrical drive error detected" UBYTE B_TRUE 1 100 0.00 1.00000000000 BIT_MASK 0x4 FORMAT "%13.11" ECU_ADDRESS 0x60018846 /end MEASUREMENT
/begin MEASUREMENT MoFHybRx_flgIrvErrElDrv "E-Drive in error mode" UBYTE B_TRUE 1 100 0.00 1.00000000000 BIT_MASK 0x8 FORMAT "%13.11" ECU_ADDRESS 0x60018846 /end MEASUREMENT
/begin MEASUREMENT MoFHybRx_tqActEm "Actual generated torque from the E-machine" SWORD md_q0p1 1 100 -3276.800 3276.700 FORMAT "%8.3" ECU_ADDRESS 0x60018844 /end MEASUREMENT
/begin MEASUREMENT MoFHybRx_tqActEmCpl "Ram data redundancy of MoFHybRx_tqActEm" UWORD OneToOne 1 100 0.00 65535.00 FORMAT "%8.2" ECU_ADDRESS 0x6001812C /end MEASUREMENT
/begin MEASUREMENT MoFIA_cntrDiagDebIACo "Diagnosis counter in function MoFIA_Co" UBYTE OneToOne 1 100 0.00 255.0 FORMAT "%5.1" ECU_ADDRESS 0x6000B702 /end MEASUREMENT
/begin MEASUREMENT MoFIA_cntrErrDebIACo "Error debounce counter in function MoFIA_Co" UBYTE OneToOne 1 100 0.00 255.0 FORMAT "%5.1" ECU_ADDRESS 0x60018843 /end MEASUREMENT
/begin MEASUREMENT MoFIA_cntrErrDebIACoCpl "Ram data redundancy for MoFIA_cntrErrDebIACo" UBYTE OneToOne 1 100 0.00 255.0 FORMAT "%5.1" ECU_ADDRESS 0x6001812B /end MEASUREMENT
/begin MEASUREMENT MoFIA_flgClr "Condition clear FCM in function MoFIA_Co" UBYTE B_TRUE 1 100 0.00 1.00000000000 BIT_MASK 0x1 FORMAT "%13.11" ECU_ADDRESS 0x70000151 /end MEASUREMENT
/begin MEASUREMENT MoFIA_flgIrrvErrMsg "Condition error reaction active in function MoFIA_Co" UBYTE B_TRUE 1 100 0.00 1.00000000000 BIT_MASK 0x1 FORMAT "%13.11" ECU_ADDRESS 0x700007E5 /end MEASUREMENT
/begin MEASUREMENT MoFIA_flgTestIACoMsg "Condition error checking active in function MoFIA_Co" UBYTE B_TRUE 1 100 0.00 1.00000000000 BIT_MASK 0x1 FORMAT "%13.11" ECU_ADDRESS 0x700007E4 /end MEASUREMENT
/begin MEASUREMENT MoFIA_iaOutp "Ignition output angle in function monitoring" SBYTE zw_sb_q0p75 1 100 -96.00 95.25 FORMAT "%5.2" ECU_ADDRESS 0x60018842 /end MEASUREMENT
/begin MEASUREMENT MoFIA_iaOutpCpl "Ram data redundancy for MoFIA_iaOutp" UBYTE OneToOne 1 100 0.00 255.0 FORMAT "%5.1" ECU_ADDRESS 0x6001812A /end MEASUREMENT
/begin MEASUREMENT MoFIA_iaOutpHiResl "Ignition output angle (high resolution) in function monitoring" SWORD zw_q0p1 1 100 -3276.800 3276.700 FORMAT "%8.3" ECU_ADDRESS 0x60018840 /end MEASUREMENT
/begin MEASUREMENT MoFIA_iaOutpHiReslCpl "Ram data redundancy for MoFIA_iaOutpHiResl" UWORD OneToOne 1 100 0.00 65535.00 FORMAT "%8.2" ECU_ADDRESS 0x60018128 /end MEASUREMENT
/begin MEASUREMENT MoFICO_cntrTestICOL1 "Counter for test ICO L1" UBYTE OneToOne 1 100 0.00 255.0 FORMAT "%5.1" ECU_ADDRESS 0x6000B701 /end MEASUREMENT
/begin MEASUREMENT MoFICO_cntrTestICOL2 "counter for setting the testflag in diagnosis for the injection cut-off check in function monitoring" UBYTE OneToOne 1 100 0.00 255.0 FORMAT "%5.1" ECU_ADDRESS 0x6000B700 /end MEASUREMENT
/begin MEASUREMENT MoFICO_flgClrICOL1 "FCM clrear flag for ICOL1" UBYTE B_TRUE 1 100 0.00 1.00000000000 BIT_MASK 0x1 FORMAT "%13.11" ECU_ADDRESS 0x70000150 /end MEASUREMENT
/begin MEASUREMENT MoFICO_flgClrICOL2 "condition DSM clearing for ICOL2 in function monitoring" UBYTE B_TRUE 1 100 0.00 1.00000000000 BIT_MASK 0x1 FORMAT "%13.11" ECU_ADDRESS 0x7000014F /end MEASUREMENT
/begin MEASUREMENT MoFICO_flgIrrvErrICOL1Msg "Flag message for irreversible error ICO L1" UBYTE B_TRUE 1 100 0.00 1.00000000000 BIT_MASK 0x1 FORMAT "%13.11" ECU_ADDRESS 0x700007E3 /end MEASUREMENT
/begin MEASUREMENT MoFICO_flgIrrvErrICOL2Msg "Flag message for irreversible error ICO L2" UBYTE B_TRUE 1 100 0.00 1.00000000000 BIT_MASK 0x1 FORMAT "%13.11" ECU_ADDRESS 0x700007E2 /end MEASUREMENT
/begin MEASUREMENT MoFICO_flgTestICOL1Msg "Test flag message ICO L1" UBYTE B_TRUE 1 100 0.00 1.00000000000 BIT_MASK 0x1 FORMAT "%13.11" ECU_ADDRESS 0x700007E1 /end MEASUREMENT
/begin MEASUREMENT MoFICO_flgTestICOL2Msg "bit check condition for diagnosis of error path DFC_MoFICOL2" UBYTE B_TRUE 1 100 0.00 1.00000000000 BIT_MASK 0x1 FORMAT "%13.11" ECU_ADDRESS 0x700007E0 /end MEASUREMENT
/begin MEASUREMENT MoFSpdGCo_bbOutCpl "double storage of MoFSpdGCo_bbOut" UBYTE OneToOne 1 100 0.00 255.0 FORMAT "%5.1" ECU_ADDRESS 0x60018113 /end MEASUREMENT
/begin MEASUREMENT MoFSpdG_flgWesDem "overrun monitoring release" UBYTE B_TRUE 1 100 0.00 1.00000000000 BIT_MASK 0x1 FORMAT "%13.11" ECU_ADDRESS 0x6001882B /end MEASUREMENT
/begin MEASUREMENT MoFSpdG_tqPtd "Permitted inner torque of Speed-Governor" SWORD md_q0p1 1 100 -3276.800 3276.700 FORMAT "%8.3" ECU_ADDRESS 0x60018826 /end MEASUREMENT
/begin MEASUREMENT MoFSpdG_tqPtdCpl "double storage of MoFSpdG_tqPtd" UWORD OneToOne 1 100 0.00 65535.00 FORMAT "%8.2" ECU_ADDRESS 0x60018110 /end MEASUREMENT
/begin MEASUREMENT MoFSpdG_tqSpdGovPtd_MP "Measurement point: permitted speedgovernor torque" SWORD md_q0p1 1 100 -3276.800 3276.700 FORMAT "%8.3" ECU_ADDRESS 0x7000A122 /end MEASUREMENT
/begin MEASUREMENT MoFStrtCo_bbOutCpl "RAM data redundancy for MoFStrtCo_bbOut" UBYTE OneToOne 1 100 0.00 255.0 FORMAT "%5.1" ECU_ADDRESS 0x6001810D /end MEASUREMENT
/begin MEASUREMENT MoFStrtIn_bbLoc1Cpl "Complement of MoFStrtIn_bbLoc1" UBYTE OneToOne 1 100 0.00 255.0 FORMAT "%5.1" ECU_ADDRESS 0x6001810B /end MEASUREMENT
/begin MEASUREMENT MoFStrtIn_bbOut1Cpl "duplicate storage of MoFStrtIn_bbOut1" UBYTE OneToOne 1 100 0.00 255.0 FORMAT "%5.1" ECU_ADDRESS 0x6001810A /end MEASUREMENT
/begin MEASUREMENT MoFStrt_cntrStrtRels "Error counter for debouncing Starter release" UBYTE OneToOne 1 100 0.00 255.0 FORMAT "%5.1" ECU_ADDRESS 0x60018815 /end MEASUREMENT
/begin MEASUREMENT MoFStrt_cntrStrtRelsCpl "RAM data redundancy for MoFStrt_cntrStrtRls" UBYTE OneToOne 1 100 0.00 255.0 FORMAT "%5.1" ECU_ADDRESS 0x600180FD /end MEASUREMENT
/begin MEASUREMENT MoFStrt_cntrUnderVltg "Counter for delay of start release deactivation in case of undervoltage situation" UBYTE OneToOne 1 100 0.00 255.0 FORMAT "%5.1" ECU_ADDRESS 0x60018822 /end MEASUREMENT
/begin MEASUREMENT MoFStrt_cntrUnderVltgCpl "Complement of MoFStrt_cntrUnderVltg" UBYTE OneToOne 1 100 0.00 255.0 FORMAT "%5.1" ECU_ADDRESS 0x60018109 /end MEASUREMENT
/begin MEASUREMENT MoFStrt_ctDebClthImpsOff "Debounce counter for clutch implausibility check healing" UBYTE OneToOne 1 100 0.00 255.0 FORMAT "%5.1" ECU_ADDRESS 0x60018821 /end MEASUREMENT
/begin MEASUREMENT MoFStrt_ctDebClthImpsOffCpl "Complement of MoFStrt_ctDebClthImpsOff" UBYTE OneToOne 1 100 0.00 255.0 FORMAT "%5.1" ECU_ADDRESS 0x60018108 /end MEASUREMENT
/begin MEASUREMENT MoFStrt_ctDebClthImpsOn "Debounce counter for clutch implausibility check" UBYTE OneToOne 1 100 0.00 255.0 FORMAT "%5.1" ECU_ADDRESS 0x60018820 /end MEASUREMENT
/begin MEASUREMENT MoFStrt_ctDebClthImpsOnCpl "Complement of MoFStrt_ctDebClthImpsOn" UBYTE OneToOne 1 100 0.00 255.0 FORMAT "%5.1" ECU_ADDRESS 0x60018107 /end MEASUREMENT
/begin MEASUREMENT MoFStrt_ctDebPushBtn "Debounce counter for pusch button signal debouncin" UBYTE OneToOne 1 100 0.00 255.0 FORMAT "%5.1" ECU_ADDRESS 0x6001881F /end MEASUREMENT
/begin MEASUREMENT MoFStrt_ctDebPushBtnCpl "Double storage for debounce counter for pusch button signal debouncing" UBYTE OneToOne 1 100 0.00 255.0 FORMAT "%5.1" ECU_ADDRESS 0x60018106 /end MEASUREMENT
/begin MEASUREMENT MoFStrt_ctDebT50 "Debounce counter for T50 signal debouncing" UBYTE OneToOne 1 100 0.00 255.0 FORMAT "%5.1" ECU_ADDRESS 0x6001881E /end MEASUREMENT
/begin MEASUREMENT MoFStrt_ctDebT50Cpl "Complement variable for MoFStrt_ctDebT50" UBYTE OneToOne 1 100 0.00 255.0 FORMAT "%5.1" ECU_ADDRESS 0x60018105 /end MEASUREMENT
/begin MEASUREMENT MoFStrt_ctHWBrkDeactvnDly "Debounce counter for brake deactivation for T50 Start" UBYTE OneToOne 1 100 0.00 255.0 FORMAT "%5.1" ECU_ADDRESS 0x6001881D /end MEASUREMENT
/begin MEASUREMENT MoFStrt_ctHWBrkDeactvnDlyCpl "Complement of MoFStrt_ctHWBrkDeactvnDly" UBYTE OneToOne 1 100 0.00 255.0 FORMAT "%5.1" ECU_ADDRESS 0x60018104 /end MEASUREMENT
/begin MEASUREMENT MoFStrt_flgBrkHldActv "Flag Brake Hold active" UBYTE B_TRUE 1 100 0.00 1.00000000000 BIT_MASK 0x1 FORMAT "%13.11" ECU_ADDRESS 0x60018818 /end MEASUREMENT
/begin MEASUREMENT MoFStrt_flgClthSwtImps "Clutch implausibility flag" UBYTE B_TRUE 1 100 0.00 1.00000000000 BIT_MASK 0x4 FORMAT "%13.11" ECU_ADDRESS 0x60018818 /end MEASUREMENT
/begin MEASUREMENT MoFStrt_flgDioStrtNeutrGearErr "Flag for error indication of neutral gear digital pin input" UBYTE B_TRUE 1 100 0.00 1.00000000000 BIT_MASK 0x2 FORMAT "%13.11" ECU_ADDRESS 0x60018823 /end MEASUREMENT
/begin MEASUREMENT MoFStrt_flgDioT50Err "Flag for error indication of T50 digital pin input" UBYTE B_TRUE 1 100 0.00 1.00000000000 BIT_MASK 0x4 FORMAT "%13.11" ECU_ADDRESS 0x60018823 /end MEASUREMENT
/begin MEASUREMENT MoFStrt_flgIrrvErrStrtRlsMsg "Irreversible error bit of the powertrain active" UBYTE B_TRUE 1 100 0.00 1.00000000000 BIT_MASK 0x1 FORMAT "%13.11" ECU_ADDRESS 0x700007DF /end MEASUREMENT
/begin MEASUREMENT MoFStrt_flgMonDisbl "Flag to Disable Monitoring" UBYTE B_TRUE 1 100 0.00 1.00000000000 BIT_MASK 0x2 FORMAT "%13.11" ECU_ADDRESS 0x60018818 /end MEASUREMENT
/begin MEASUREMENT MoFStrt_flgPs1Actv "status which tells the Starter powerstage is active" UBYTE B_TRUE 1 100 0.00 1.00000000000 BIT_MASK 0x4 FORMAT "%13.11" ECU_ADDRESS 0x60018825 /end MEASUREMENT
/begin MEASUREMENT MoFStrt_flgPs2Actv "status which tells the Starter powerstage is active" UBYTE B_TRUE 1 100 0.00 1.00000000000 BIT_MASK 0x8 FORMAT "%13.11" ECU_ADDRESS 0x60018825 /end MEASUREMENT
/begin MEASUREMENT MoFStrt_flgStrtPtd "condition starter activation permitted from function monitoring" UBYTE B_TRUE 1 100 0.00 1.00000000000 BIT_MASK 0x1 FORMAT "%13.11" ECU_ADDRESS 0x60018825 /end MEASUREMENT
/begin MEASUREMENT MoFStrt_flgStrtRly "status of powertrain active in the function monitoring" UBYTE B_TRUE 1 100 0.00 1.00000000000 BIT_MASK 0x2 FORMAT "%13.11" ECU_ADDRESS 0x60018825 /end MEASUREMENT
/begin MEASUREMENT MoFStrt_flgSTSwitch "Flag ST Switch active" UBYTE B_TRUE 1 100 0.00 1.00000000000 BIT_MASK 0x20 FORMAT "%13.11" ECU_ADDRESS 0x60018823 /end MEASUREMENT
/begin MEASUREMENT MoFStrt_flgSTSwitchRaw "Raw signal of ST Switch PIN (ST PIN indicates that gear lever is in P or N position)" UBYTE B_TRUE 1 100 0.00 1.00000000000 BIT_MASK 0x8 FORMAT "%13.11" ECU_ADDRESS 0x60018818 /end MEASUREMENT
/begin MEASUREMENT MoFStrt_flgT50 "T50 condition" UBYTE B_TRUE 1 100 0.00 1.00000000000 BIT_MASK 0x40 FORMAT "%13.11" ECU_ADDRESS 0x60018823 /end MEASUREMENT
/begin MEASUREMENT MoFStrt_flgTmpErrStrtRels_MP "Status of Debouncing Plausible error in Starter release" UBYTE B_TRUE 1 100 0.00 1.00000000000 BIT_MASK 0x1 FORMAT "%13.11" ECU_ADDRESS 0x7000A120 /end MEASUREMENT
/begin MEASUREMENT MoFStrt_flgTMStrtEna "Start enable information related to transmission" UBYTE B_TRUE 1 100 0.00 1.00000000000 BIT_MASK 0x1 FORMAT "%13.11" ECU_ADDRESS 0x60018823 /end MEASUREMENT
/begin MEASUREMENT MoFStrt_flgTstStrtRlsMsg "Irreversible error bit of the powertrain active" UBYTE B_TRUE 1 100 0.00 1.00000000000 BIT_MASK 0x1 FORMAT "%13.11" ECU_ADDRESS 0x700007DE /end MEASUREMENT
/begin MEASUREMENT MoFStrt_stDioStrtNeutrGear "Status for indication of neutral gear digital pin input" UBYTE OneToOne 1 100 0.00 255.0 FORMAT "%5.1" ECU_ADDRESS 0x6001881C /end MEASUREMENT
/begin MEASUREMENT MoFStrt_stDioStrtNeutrGearCpl "Double storage for debounce counter for MoFStrt_stDioStrtNeutrGear" UBYTE OneToOne 1 100 0.00 255.0 FORMAT "%5.1" ECU_ADDRESS 0x60018103 /end MEASUREMENT
/begin MEASUREMENT MoFStrt_stFFPushBtn "Status of push button release" UBYTE OneToOne 1 100 0.00 255.0 FORMAT "%5.1" ECU_ADDRESS 0x60018817 /end MEASUREMENT
/begin MEASUREMENT MoFStrt_stFFPushBtnCpl "Double storage for status of push button release" UBYTE OneToOne 1 100 0.00 255.0 FORMAT "%5.1" ECU_ADDRESS 0x60018102 /end MEASUREMENT
/begin MEASUREMENT MoFStrt_stHWBrkDeactvnDlyMem "Debounce state for brake release delay" UBYTE OneToOne 1 100 0.00 255.0 FORMAT "%5.1" ECU_ADDRESS 0x6001881B /end MEASUREMENT
/begin MEASUREMENT MoFStrt_stHWBrkDeactvnDlyMemCpl "RAM data redundancy for MoFStrt_stHWBrkDeactvnDlyMem" UBYTE OneToOne 1 100 0.00 255.0 FORMAT "%5.1" ECU_ADDRESS 0x60018101 /end MEASUREMENT
/begin MEASUREMENT MoFStrt_stStrtActv "Status of starter power stage" UBYTE OneToOne 1 100 0.00 255.0 FORMAT "%5.1" ECU_ADDRESS 0x60018824 /end MEASUREMENT
/begin MEASUREMENT MoFStrt_stStrtActvCpl "RAM data redundancy for MoFStrt_stStrtActv" UBYTE OneToOne 1 100 0.00 255.0 FORMAT "%5.1" ECU_ADDRESS 0x6001810C /end MEASUREMENT
/begin MEASUREMENT MoFStrt_stStrtMsg "state:powertrain active in function monitoring" UBYTE OneToOne 1 100 0.00 255.0 FORMAT "%5.1" ECU_ADDRESS 0x6000FBD2 /end MEASUREMENT
/begin MEASUREMENT MoFStrt_stT50 "Status of debounce T50 signal" UBYTE OneToOne 1 100 0.00 255.0 FORMAT "%5.1" ECU_ADDRESS 0x60018816 /end MEASUREMENT
/begin MEASUREMENT MoFStrt_stT50Cpl "Complement variable for MoFStrt_stT50" UBYTE OneToOne 1 100 0.00 255.0 FORMAT "%5.1" ECU_ADDRESS 0x60018100 /end MEASUREMENT
/begin MEASUREMENT MoFStrt_stT50DebMem "Memory for debounce" UBYTE OneToOne 1 100 0.00 255.0 FORMAT "%5.1" ECU_ADDRESS 0x6001881A /end MEASUREMENT
/begin MEASUREMENT MoFStrt_stT50DebMemCpl "RAM data redundancy for MoFStrt_stT50DebMem" UBYTE OneToOne 1 100 0.00 255.0 FORMAT "%5.1" ECU_ADDRESS 0x600180FF /end MEASUREMENT
/begin MEASUREMENT MoFStrt_stT50Raw "raw signal T50" UBYTE OneToOne 1 100 0.00 255.0 FORMAT "%5.1" ECU_ADDRESS 0x60018819 /end MEASUREMENT
/begin MEASUREMENT MoFStrt_stT50RawCpl "RAM data redundancy for MoFStrt_stT50Raw" UBYTE OneToOne 1 100 0.00 255.0 FORMAT "%5.1" ECU_ADDRESS 0x600180FE /end MEASUREMENT
/begin MEASUREMENT MoFTEngCo_bbLoc1Cpl "bit compl" UBYTE OneToOne 1 100 0.00 255.0 FORMAT "%5.1" ECU_ADDRESS 0x600180FC /end MEASUREMENT
/begin MEASUREMENT MoFTEng_mfVal "Mass Flow value in MoFTEng" UBYTE m_ub_b1020 1 100 0.00 1020. FORMAT "%5.0" ECU_ADDRESS 0x60018813 /end MEASUREMENT
/begin MEASUREMENT MoFTEng_mfValCpl "Cpl of Mass Flow value in MoFTEng" UBYTE OneToOne 1 100 0.00 255.0 FORMAT "%5.1" ECU_ADDRESS 0x600180FB /end MEASUREMENT
/begin MEASUREMENT MoFTEng_tEng "Engine temperature in level 2" UBYTE Mo_t_DegC_q0p8o48 1 100 -48.0 156.0 FORMAT "%5.1" ECU_ADDRESS 0x60018811 /end MEASUREMENT
/begin MEASUREMENT MoFTEng_tEngCpl "Dobbel storage of Engine temperature in level 2" UBYTE OneToOne 1 100 0.00 255.0 FORMAT "%5.1" ECU_ADDRESS 0x600180FA /end MEASUREMENT
/begin MEASUREMENT MoFTraCo_bbOut1Cpl "RAM data redundancy for MoFTraCo_bbOut1" UBYTE OneToOne 1 100 0.00 255.0 FORMAT "%5.1" ECU_ADDRESS 0x600180EB /end MEASUREMENT
/begin MEASUREMENT MoFTra_cntrDebTSCDeactv "Counter deactivation TSC" UBYTE OneToOne 1 100 0.00 255.0 FORMAT "%5.1" ECU_ADDRESS 0x60018805 /end MEASUREMENT
/begin MEASUREMENT MoFTra_cntrDebTSCDeactvCpl "Dual Storage of MoFTra_cntrDebTSCDeactv" UBYTE OneToOne 1 100 0.00 255.0 FORMAT "%5.1" ECU_ADDRESS 0x600180EA /end MEASUREMENT
/begin MEASUREMENT MoFTra_flgDecIntvActv "decreasing intervention requested by transmission control" UBYTE B_TRUE 1 100 0.00 1.00000000000 BIT_MASK 0x1 FORMAT "%13.11" ECU_ADDRESS 0x60018804 /end MEASUREMENT
/begin MEASUREMENT MoFTra_flgTSCPtd "permission of gearbox intervention" UBYTE B_TRUE 1 100 0.00 1.00000000000 BIT_MASK 0x2 FORMAT "%13.11" ECU_ADDRESS 0x60018804 /end MEASUREMENT
/begin MEASUREMENT MoFTra_rTqCnvrBoost "Torque Converter Boost Ratio" UWORD TransR 1 100 0.00 655.3500 FORMAT "%8.4" ECU_ADDRESS 0x60018802 /end MEASUREMENT
/begin MEASUREMENT MoFTra_rTqCnvrBoostCpl "RAM data redundancy for MoFTra_rTqCnvrBoost" UWORD OneToOne 1 100 0.00 65535.00 FORMAT "%8.2" ECU_ADDRESS 0x600180E8 /end MEASUREMENT
/begin MEASUREMENT MoFTra_tqClthPtd "Permitted clutch torque of transmission intervention" SWORD md_q0p1 1 100 -3276.800 3276.700 FORMAT "%8.3" ECU_ADDRESS 0x60018800 /end MEASUREMENT
/begin MEASUREMENT MoFTra_tqClthPtdCpl "Dual storage of MoFTra_tqClthPtd" UWORD OneToOne 1 100 0.00 65535.00 FORMAT "%8.2" ECU_ADDRESS 0x600180E6 /end MEASUREMENT
/begin MEASUREMENT MoFTrqAct_nEng_Ax_result "Supporting coordinate for engine speed during function monitoring" SLONG dez 1 100 -2147483648.00 2147483647.00 FORMAT "%13.2" ECU_ADDRESS 0x600187F8 /end MEASUREMENT
/begin MEASUREMENT MoFTrqAct_ratFillg_Ax_result "Result of grid search for air charge in function monitoring" SLONG dez 1 100 -2147483648.00 2147483647.00 FORMAT "%13.2" ECU_ADDRESS 0x600187F4 /end MEASUREMENT
/begin MEASUREMENT MoFTrqAct_ratTqInr "current inner torque in the function monitoring" UBYTE rel_q0p39 1 100 0.00 99.61 FORMAT "%5.2" ECU_ADDRESS 0x600187FE /end MEASUREMENT
/begin MEASUREMENT MoFTrqAct_ratTqInrCpl "RAM Data redundancy for MoFTrqAct_ratTqInr" UBYTE OneToOne 1 100 0.00 255.0 FORMAT "%5.1" ECU_ADDRESS 0x600180E4 /end MEASUREMENT
/begin MEASUREMENT MoFTrqAct_tqActCmbEng_MP "Inner combustion engine torque in function monitoring" SWORD md_q0p1 1 100 -3276.800 3276.700 FORMAT "%8.3" ECU_ADDRESS 0x7000A11E /end MEASUREMENT
/begin MEASUREMENT MoFTrqAct_tqCrksftEm "Actual E-machine torque at Crankshaft level" SWORD md_q0p1 1 100 -3276.800 3276.700 FORMAT "%8.3" ECU_ADDRESS 0x600187F0 /end MEASUREMENT
/begin MEASUREMENT MoFTrqAct_tqCrksftEmCpl "RAM data redundancy of MoFTrqAct_tqCrksftEmCpl" UWORD OneToOne 1 100 0.00 65535.00 FORMAT "%8.2" ECU_ADDRESS 0x600180E0 /end MEASUREMENT
/begin MEASUREMENT MoFTrqAct_tqCrksftEmMsg "Actual E-machine torque at Crankshaft level sent as a message from Function monitoring to Level 1" SWORD md_q0p1 1 100 -3276.800 3276.700 FORMAT "%8.3" ECU_ADDRESS 0x60009894 /end MEASUREMENT
/begin MEASUREMENT MoFTrqAct_tqSumClu "Sum of Actual Combustion Engine torque and Actual E machine torque at clutch level" SWORD md_q0p1 1 100 -3276.800 3276.700 FORMAT "%8.3" ECU_ADDRESS 0x600187EE /end MEASUREMENT
/begin MEASUREMENT MoFTrqAct_tqSumCluCpl "RAM data redundancy of MoFTrqAct_tqSumClu" UWORD OneToOne 1 100 0.00 65535.00 FORMAT "%8.2" ECU_ADDRESS 0x600180DE /end MEASUREMENT
/begin MEASUREMENT MoFTrqCmpMax_bbOut1Cpl "RAM data redundancy of MoFTrqCmpMax_bbOut1" UBYTE OneToOne 1 100 0.00 255.0 FORMAT "%5.1" ECU_ADDRESS 0x600180D8 /end MEASUREMENT
/begin MEASUREMENT MoFTrqCmpMin_bbOut1Cpl "RAM data redundancy of MoFTrqCmpMin_bbOut1" UBYTE OneToOne 1 100 0.00 255.0 FORMAT "%5.1" ECU_ADDRESS 0x600180D6 /end MEASUREMENT
/begin MEASUREMENT MoFTrqCmp_cntrTestTqCompMax "Counter for setting of test flag in diagnosis of total torque comparision" UBYTE OneToOne 1 100 0.00 255.0 FORMAT "%5.1" ECU_ADDRESS 0x6000B6FE /end MEASUREMENT
/begin MEASUREMENT MoFTrqCmp_cntrTestTqCompMin "Counter for setting of test flag in diagnosis of min total torque comparision" UBYTE OneToOne 1 100 0.00 255.0 FORMAT "%5.1" ECU_ADDRESS 0x6000B6FD /end MEASUREMENT
/begin MEASUREMENT MoFTrqCmp_cntrTqCompMax "Error tolerance time for total torque comparision in function monitoring" UBYTE OneToOne 1 100 0.00 255.0 FORMAT "%5.1" ECU_ADDRESS 0x600187E8 /end MEASUREMENT
/begin MEASUREMENT MoFTrqCmp_cntrTqCompMaxCpl "RAM data redundancy of MoFTrqCmp_cntrTqCompMax" UBYTE OneToOne 1 100 0.00 255.0 FORMAT "%5.1" ECU_ADDRESS 0x600180D7 /end MEASUREMENT
/begin MEASUREMENT MoFTrqCmp_cntrTqCompMin "Error tolerance time for min torque comparision in function monitoring" UBYTE OneToOne 1 100 0.00 255.0 FORMAT "%5.1" ECU_ADDRESS 0x600187E6 /end MEASUREMENT
/begin MEASUREMENT MoFTrqCmp_cntrTqCompMinCpl "RAM data redundancy of MoFTrqCmp_cntrTqCompMin" UBYTE OneToOne 1 100 0.00 255.0 FORMAT "%5.1" ECU_ADDRESS 0x600180D5 /end MEASUREMENT
/begin MEASUREMENT MoFTrqCmp_flgClrEng "Bit in order to delete the Diagnose Information" UBYTE B_TRUE 1 100 0.00 1.00000000000 BIT_MASK 0x1 FORMAT "%13.11" ECU_ADDRESS 0x7000014E /end MEASUREMENT
/begin MEASUREMENT MoFTrqCmp_flgClrMax "Flag to clear the fault memory of the max-torque comparison" UBYTE B_TRUE 1 100 0.00 1.00000000000 BIT_MASK 0x1 FORMAT "%13.11" ECU_ADDRESS 0x7000014D /end MEASUREMENT
/begin MEASUREMENT MoFTrqCmp_flgClrMin "Flag to clear the fault memory of the min-torque comparison" UBYTE B_TRUE 1 100 0.00 1.00000000000 BIT_MASK 0x1 FORMAT "%13.11" ECU_ADDRESS 0x7000014C /end MEASUREMENT
/begin MEASUREMENT MoFTrqCmp_flgErrMaxPndMsg "Error pending flag message in total torque comparision" UBYTE B_TRUE 1 100 0.00 1.00000000000 BIT_MASK 0x1 FORMAT "%13.11" ECU_ADDRESS 0x700007DD /end MEASUREMENT
/begin MEASUREMENT MoFTrqCmp_flgErrMinPndMsg "Error flag in case of pending error in min torque comparision" UBYTE B_TRUE 1 100 0.00 1.00000000000 BIT_MASK 0x1 FORMAT "%13.11" ECU_ADDRESS 0x700007DC /end MEASUREMENT
/begin MEASUREMENT MoFTrqCmp_flgIrrvErrEngMsg "irreversible error bit of the torque comparison" UBYTE B_TRUE 1 100 0.00 1.00000000000 BIT_MASK 0x1 FORMAT "%13.11" ECU_ADDRESS 0x700007DB /end MEASUREMENT
/begin MEASUREMENT MoFTrqCmp_flgIrrvErrMax "Irreversible error bit of the torque comparison" UBYTE B_TRUE 1 100 0.00 1.00000000000 BIT_MASK 0x1 FORMAT "%13.11" ECU_ADDRESS 0x600187E7 /end MEASUREMENT
/begin MEASUREMENT MoFTrqCmp_flgIrrvErrMaxMsg "Irreversible error flag message in total torque comparison" UBYTE B_TRUE 1 100 0.00 1.00000000000 BIT_MASK 0x1 FORMAT "%13.11" ECU_ADDRESS 0x700007DA /end MEASUREMENT
/begin MEASUREMENT MoFTrqCmp_flgIrrvErrMin "Irreversible error flag of minimal torque comparison" UBYTE B_TRUE 1 100 0.00 1.00000000000 BIT_MASK 0x1 FORMAT "%13.11" ECU_ADDRESS 0x600187E5 /end MEASUREMENT
/begin MEASUREMENT MoFTrqCmp_flgIrrvErrMinMsg "Irreversible error flag in case of min torque comparison" UBYTE B_TRUE 1 100 0.00 1.00000000000 BIT_MASK 0x1 FORMAT "%13.11" ECU_ADDRESS 0x700007D9 /end MEASUREMENT
/begin MEASUREMENT MoFTrqCmp_flgTestEngMsg "Bit of test condition on diagnosis error path DFC_MoFTrqCmp" UBYTE B_TRUE 1 100 0.00 1.00000000000 BIT_MASK 0x1 FORMAT "%13.11" ECU_ADDRESS 0x700007D8 /end MEASUREMENT
/begin MEASUREMENT MoFTrqCmp_flgTestTqCompMinMsg "Test condition on diagnosis error path DFC_MoFTrqCmpMin" UBYTE B_TRUE 1 100 0.00 1.00000000000 BIT_MASK 0x1 FORMAT "%13.11" ECU_ADDRESS 0x700007D7 /end MEASUREMENT
/begin MEASUREMENT MoFTrqCmp_flgTestTrqCmpMaxMsg "Bit of test condition on diagnosis error path" UBYTE B_TRUE 1 100 0.00 1.00000000000 BIT_MASK 0x1 FORMAT "%13.11" ECU_ADDRESS 0x700007D6 /end MEASUREMENT
/begin MEASUREMENT MoFTrqLim_tqInrMinWoCtOffMsg "minimal inner torque in the combusted operation in the function monitoring" UBYTE md_q1p6 1 100 0.00 408.0 FORMAT "%5.1" ECU_ADDRESS 0x6000FBD0 /end MEASUREMENT
/begin MEASUREMENT MoFTrqLos_tqChrgChg_mp "Limited L2 charge change losses" UBYTE md_q1p6 1 100 0.00 408.0 FORMAT "%5.1" ECU_ADDRESS 0x7000A11B /end MEASUREMENT
/begin MEASUREMENT MoFTrqLos_tqConvLd_mp "L2 power train losses after limitimation" UBYTE md_q1p6 1 100 0.00 408.0 FORMAT "%5.1" ECU_ADDRESS 0x7000A11A /end MEASUREMENT
/begin MEASUREMENT MoFTrqLos_tqLosTotMsg "overall losses (drive train, converter, engine and accessories losses)in function monitoring" UBYTE md_q1p6 1 100 0.00 408.0 FORMAT "%5.1" ECU_ADDRESS 0x6000FBCF /end MEASUREMENT
/begin MEASUREMENT MoFTrqLos_tqTraLoss_mp "limited value of Tra_trqLos" UBYTE md_q1p6 1 100 0.00 408.0 FORMAT "%5.1" ECU_ADDRESS 0x7000A119 /end MEASUREMENT
/begin MEASUREMENT MoFTrqPtd_facCmpSpdGovr "Weighting factor for torque loss compensation in level 2 function monitoring" UBYTE fak_q0p01 1 100 0.00 2.550 FORMAT "%5.3" ECU_ADDRESS 0x6001882A /end MEASUREMENT
/begin MEASUREMENT MoFTrqPtd_facCmpSpdGovrCpl "double storage of MoFTrqPtd_facCmpSpdGovr" UBYTE OneToOne 1 100 0.00 255.0 FORMAT "%5.1" ECU_ADDRESS 0x60018112 /end MEASUREMENT
/begin MEASUREMENT MoFTrqPtd_nDifSpdGovr "Difference of engine speed demanded by speedgovernor" SWORD nmot_q0p5 1 100 -16384.00 16383.50 FORMAT "%8.2" ECU_ADDRESS 0x60018828 /end MEASUREMENT
/begin MEASUREMENT MoFTrqPtd_nDifSpdGovrCpl "double storage of MoFTrqPtd_nDifSpdGovr" UWORD OneToOne 1 100 0.00 65535.00 FORMAT "%8.2" ECU_ADDRESS 0x6001810E /end MEASUREMENT
/begin MEASUREMENT MoFTrqPtd_tqCmpNotSwilLoss "permitted loss compensation torque of not switchable losses" UBYTE md_q1p6 1 100 0.00 408.0 FORMAT "%5.1" ECU_ADDRESS 0x600187E2 /end MEASUREMENT
/begin MEASUREMENT MoFTrqPtd_tqCmpNotSwilLossCpl "RAM data redundancy for MoFTrqPtd_tqCmpNotSwilLoss" UBYTE OneToOne 1 100 0.00 255.0 FORMAT "%5.1" ECU_ADDRESS 0x600180D2 /end MEASUREMENT
/begin MEASUREMENT MoFTrqPtd_tqCmpSwilLoss "Compensatable torque of the switchable losses in function monitoring" UBYTE md_q1p6 1 100 0.00 408.0 FORMAT "%5.1" ECU_ADDRESS 0x600187E1 /end MEASUREMENT
/begin MEASUREMENT MoFTrqPtd_tqCmpSwilLossCpl "RAM data redundancy for MoFTrqPtd_tqCmpSwilLoss" UBYTE OneToOne 1 100 0.00 255.0 FORMAT "%5.1" ECU_ADDRESS 0x600180D1 /end MEASUREMENT
/begin MEASUREMENT MoF_ctICOIgn "error counter (ignition) for fault reaction monitoring in function monitoring" UBYTE OneToOne 1 100 0.00 255.0 FORMAT "%5.1" ECU_ADDRESS 0x6001883F /end MEASUREMENT
/begin MEASUREMENT MoF_ctICOIgnCpl "RAM data redundancy for MoF_ctICOIgn" UBYTE OneToOne 1 100 0.00 255.0 FORMAT "%5.1" ECU_ADDRESS 0x60018127 /end MEASUREMENT
/begin MEASUREMENT MoF_ctICOInj "error counter (injection) for fault reaction monitoring in function monitoring" UBYTE OneToOne 1 100 0.00 255.0 FORMAT "%5.1" ECU_ADDRESS 0x6001883E /end MEASUREMENT
/begin MEASUREMENT MoF_ctICOInjCpl "RAM data redundancy for MoF_ctICOInj" UBYTE OneToOne 1 100 0.00 255.0 FORMAT "%5.1" ECU_ADDRESS 0x60018126 /end MEASUREMENT
/begin MEASUREMENT MoF_ctIgnDel "Delay Counter for Ignition Cut Off in Function Monitoring" UBYTE OneToOne 1 100 0.00 255.0 FORMAT "%5.1" ECU_ADDRESS 0x6001883D /end MEASUREMENT
/begin MEASUREMENT MoF_ctIgnDelCpl "RAM data redundancy for MoF_ctIgnDel" UBYTE OneToOne 1 100 0.00 255.0 FORMAT "%5.1" ECU_ADDRESS 0x60018125 /end MEASUREMENT
/begin MEASUREMENT MoF_ctInjPCPCurr "current injection counter in function monitoring" ULONG OneToOne 1 100 0.00 4294967295.00 FORMAT "%13.2" ECU_ADDRESS 0x60018830 /end MEASUREMENT
/begin MEASUREMENT MoF_ctInjPCPCurrCpl "RAM data redundancy for MoF_ctInjPcpCurr" ULONG OneToOne 1 100 0.00 4294967295.00 FORMAT "%13.2" ECU_ADDRESS 0x60018118 /end MEASUREMENT
/begin MEASUREMENT MoF_ctInjPCPOld "injection counter (one time slot delayed) in function monitoring" ULONG OneToOne 1 100 0.00 4294967295.00 FORMAT "%13.2" ECU_ADDRESS 0x60018838 /end MEASUREMENT
/begin MEASUREMENT MoF_ctInjPCPOldCpl "RAM data redundancy for MoF_ctInjPcpOld" ULONG OneToOne 1 100 0.00 4294967295.00 FORMAT "%13.2" ECU_ADDRESS 0x60018120 /end MEASUREMENT
/begin MEASUREMENT MoF_ctPCPDel "Delay Counter for PCP-feedback in Function Monitoring" UBYTE OneToOne 1 100 0.00 255.0 FORMAT "%5.1" ECU_ADDRESS 0x6001883C /end MEASUREMENT
/begin MEASUREMENT MoF_ctPCPDelCpl "RAM data redundancy for MoF_ctPCPDel" UBYTE OneToOne 1 100 0.00 255.0 FORMAT "%5.1" ECU_ADDRESS 0x60018124 /end MEASUREMENT
/begin MEASUREMENT MoF_ctTrqCmp "error tolerance time for torque comparison in the function monitoring" UBYTE dez 1 100 0.00 255.0 FORMAT "%5.1" ECU_ADDRESS 0x600187EC /end MEASUREMENT
/begin MEASUREMENT MoF_ctTrqCmpCpl "RAM data redundancy for MoF_ctTrqCmp" UBYTE dez 1 100 0.00 255.0 FORMAT "%5.1" ECU_ADDRESS 0x600180DC /end MEASUREMENT
/begin MEASUREMENT MoF_ctTstTrqCmp "counter for putting of the test flag in diagnosis of torque comparison" UBYTE dez 1 100 0.00 255.0 FORMAT "%5.1" ECU_ADDRESS 0x6000B6FF /end MEASUREMENT
/begin MEASUREMENT MoF_facTrqErrSum "error sum of the relative deviation from the permissible torque in function monitoring" UWORD rel_q0p00195_pc_s 1 100 0.00 127.9980 FORMAT "%8.4" ECU_ADDRESS 0x600187EA /end MEASUREMENT
/begin MEASUREMENT MoF_facTrqErrSumCpl "RAM data redundancy for MoF_facTrqErrSum" UWORD dez 1 100 0.00 65535.00 FORMAT "%8.2" ECU_ADDRESS 0x600180DA /end MEASUREMENT
/begin MEASUREMENT MoF_ignCtOffMsk "fade out mask ignition output in function monitoring" UWORD OneToOne 1 100 0.00 65535.00 FORMAT "%8.2" ECU_ADDRESS 0x6001882C /end MEASUREMENT
/begin MEASUREMENT MoF_ignCtOffMskCpl "RAM data redundancy for MoF_IgnCtOffMsk" UWORD OneToOne 1 100 0.00 65535.00 FORMAT "%8.2" ECU_ADDRESS 0x60018114 /end MEASUREMENT
/begin MEASUREMENT MoF_nMax_MP "Engine Speed Treshold" ULONG nmot_q0p5 1 100 0.00 2147483647.50 FORMAT "%13.2" ECU_ADDRESS 0x7000A124 /end MEASUREMENT
/begin MEASUREMENT MoF_rTrqInrAct "current torque in the function monitoring" UBYTE rel_q0p39 1 100 0.00 99.61 FORMAT "%5.2" ECU_ADDRESS 0x600187FD /end MEASUREMENT
/begin MEASUREMENT MoF_rTrqInrActCpl "RAM data redundancy for MoF_rTrqInrAct" UBYTE OneToOne 1 100 0.00 255.0 FORMAT "%5.1" ECU_ADDRESS 0x600180E3 /end MEASUREMENT
/begin MEASUREMENT MoF_rTrqInrMax "max. inner engine torque in function monitoring" UBYTE rel_q0p39 1 100 0.00 99.61 FORMAT "%5.2" ECU_ADDRESS 0x600187E4 /end MEASUREMENT
/begin MEASUREMENT MoF_rTrqInrMaxCpl "RAM data redundancy for MoF_rTrqInrMax" UBYTE OneToOne 1 100 0.00 255.0 FORMAT "%5.1" ECU_ADDRESS 0x600180D4 /end MEASUREMENT
/begin MEASUREMENT MoF_rTrqInrOpt "Optimum indicated torque in function monitoring" UBYTE rel_q0p39 1 100 0.00 99.61 FORMAT "%5.2" ECU_ADDRESS 0x600187FC /end MEASUREMENT
/begin MEASUREMENT MoF_rTrqInrOptCpl "RAM data redundancy for MoF_rTrqInrOpt" UBYTE OneToOne 1 100 0.00 255.0 FORMAT "%5.1" ECU_ADDRESS 0x600180E2 /end MEASUREMENT
/begin MEASUREMENT MoF_rTrqPtdFltWgh_mp "measurement value: permitted filtered weight reference torque in function monitoring" UBYTE rel_q0p39 1 100 0.00 99.61 FORMAT "%5.2" ECU_ADDRESS 0x7000A11C /end MEASUREMENT
/begin MEASUREMENT MoF_tEng "engine temperature in the function monitoring" UBYTE temp_ub_q0p75_o48 1 100 -48.0 143.3 FORMAT "%5.1" ECU_ADDRESS 0x60018810 /end MEASUREMENT
/begin MEASUREMENT MoF_tEngCpl "RAM data redundancy for MoF_tEng" UBYTE OneToOne 1 100 0.00 255.0 FORMAT "%5.1" ECU_ADDRESS 0x600180F9 /end MEASUREMENT
/begin MEASUREMENT MoF_tEngLonWrd "modelled engine temperature in the function monitoring 32 bits" ULONG temp_q4p4703Em8_om48_DegC 1 100 -48.000000000 143.999999955 FORMAT "%13.9" ECU_ADDRESS 0x6001880C /end MEASUREMENT
/begin MEASUREMENT MoF_tEngLonWrdCpl "RAM data redundancy for MoF_tEngLonWrd" ULONG OneToOne 1 100 0.00 4294967295.00 FORMAT "%13.2" ECU_ADDRESS 0x600180F4 /end MEASUREMENT
/begin MEASUREMENT MoF_tEngMod "modelled engine temperature in the function monitoring" UBYTE temp_ub_q0p75_o48 1 100 -48.0 143.3 FORMAT "%5.1" ECU_ADDRESS 0x60018812 /end MEASUREMENT
/begin MEASUREMENT MoF_tEngModCpl "RAM data redundancy for MoF_tEngMod" UBYTE OneToOne 1 100 0.00 255.0 FORMAT "%5.1" ECU_ADDRESS 0x600180F8 /end MEASUREMENT
/begin MEASUREMENT MoF_tEng_DST_result "result of distribution search in MoF_tEng_DST" SLONG dez 1 100 -2147483648.00 2147483647.00 FORMAT "%13.2" ECU_ADDRESS 0x60018808 /end MEASUREMENT
/begin MEASUREMENT MoF_tEng_DST_resultCpl "RAM data redundancy for MoF_tEng_DST_result" ULONG OneToOne 1 100 0.00 4294967295.00 FORMAT "%13.2" ECU_ADDRESS 0x600180F0 /end MEASUREMENT
/begin MEASUREMENT MoF_tiAftStrt "time after start in function monitoring" UWORD t_q0p04 1 100 0.00 2621.400 FORMAT "%8.3" ECU_ADDRESS 0x60018806 /end MEASUREMENT
/begin MEASUREMENT MoF_tiAftStrtCpl "RAM data redundancy for MoF_tiAftStrt" UWORD OneToOne 1 100 0.00 65535.00 FORMAT "%8.2" ECU_ADDRESS 0x600180EC /end MEASUREMENT
/begin MEASUREMENT MoF_tqAdap "Adapted difference of loss torque in function monitoring" SWORD md_q1p6 1 100 -52428.80 52427.20 FORMAT "%8.2" ECU_ADDRESS 0x600187D8 /end MEASUREMENT
/begin MEASUREMENT MoF_tqAdapCpl "Complement of Adapted difference of loss torque in function monitoring" UWORD OneToOne 1 100 0.00 65535.00 FORMAT "%8.2" ECU_ADDRESS 0x600180C8 /end MEASUREMENT
/begin MEASUREMENT MoF_trqAcs "torque of the accessories in the function monitoring" UBYTE md_q1p6 1 100 0.00 408.0 FORMAT "%5.1" ECU_ADDRESS 0x600187E0 /end MEASUREMENT
/begin MEASUREMENT MoF_trqAcsCpl "RAM data redundancy for MoF_trqAcs" UBYTE OneToOne 1 100 0.00 255.0 FORMAT "%5.1" ECU_ADDRESS 0x600180D0 /end MEASUREMENT
/begin MEASUREMENT MoF_trqCalCompDes "the desired adjustable compensation torquein in function monitoring" UBYTE md_q1p6 1 100 0.00 408.0 FORMAT "%5.1" ECU_ADDRESS 0x600187DF /end MEASUREMENT
/begin MEASUREMENT MoF_trqCalCompDesCpl "RAM data redundancy for MoF_trqCalCompDes" UBYTE OneToOne 1 100 0.00 255.0 FORMAT "%5.1" ECU_ADDRESS 0x600180CF /end MEASUREMENT
/begin MEASUREMENT MoF_trqFulCompDes "the desired full compensation torque in function monitoring" UBYTE md_q1p6 1 100 0.00 408.0 FORMAT "%5.1" ECU_ADDRESS 0x600187DE /end MEASUREMENT
/begin MEASUREMENT MoF_trqFulCompDesCpl "RAM data redundancy for MoF_trqFulCompDes" UBYTE OneToOne 1 100 0.00 255.0 FORMAT "%5.1" ECU_ADDRESS 0x600180CE /end MEASUREMENT
/begin MEASUREMENT MoF_trqInrMinWoCtOff "minimal inner torque in the combusted operation in the function monitoring" UBYTE md_q1p6 1 100 0.00 408.0 FORMAT "%5.1" ECU_ADDRESS 0x600187E3 /end MEASUREMENT
/begin MEASUREMENT MoF_trqInrMinWoCtOffCpl "RAM-data redundancy for MoF_trqInrMinWoCtOff" UBYTE OneToOne 1 100 0.00 255.0 FORMAT "%5.1" ECU_ADDRESS 0x600180D3 /end MEASUREMENT
/begin MEASUREMENT MoF_trqLos "torque losses in function monitoring" UBYTE md_q1p6 1 100 0.00 408.0 FORMAT "%5.1" ECU_ADDRESS 0x600187DD /end MEASUREMENT
/begin MEASUREMENT MoF_trqLosComp "torque losses to be compensated in function monitoring" UBYTE md_q1p6 1 100 0.00 408.0 FORMAT "%5.1" ECU_ADDRESS 0x600187DC /end MEASUREMENT
/begin MEASUREMENT MoF_trqLosCompCpl "RAM-data redundancy for MoF_trqLosComp" UBYTE OneToOne 1 100 0.00 255.0 FORMAT "%5.1" ECU_ADDRESS 0x600180CD /end MEASUREMENT
/begin MEASUREMENT MoF_trqLosCpl "RAM-data redundancy for MoF_trqLos" UBYTE OneToOne 1 100 0.00 255.0 FORMAT "%5.1" ECU_ADDRESS 0x600180CC /end MEASUREMENT
/begin MEASUREMENT MoF_trqLosMsg "torque losses in function monitoring" UBYTE md_q1p6 1 100 0.00 408.0 FORMAT "%5.1" ECU_ADDRESS 0x6000FBCB /end MEASUREMENT
/begin MEASUREMENT MoF_trqLosPT "power train losses (gear box, converter) in function monitoring" UBYTE md_q1p6 1 100 0.00 408.0 FORMAT "%5.1" ECU_ADDRESS 0x600187DB /end MEASUREMENT
/begin MEASUREMENT MoF_trqLosPTCpl "RAM-data redundancy for MoF_trqLosPT" UBYTE OneToOne 1 100 0.00 255.0 FORMAT "%5.1" ECU_ADDRESS 0x600180CB /end MEASUREMENT
/begin MEASUREMENT MoF_trqLosTot "overall losses (drive train, converter, engine and accessories losses)in function monitoring" UBYTE md_q1p6 1 100 0.00 408.0 FORMAT "%5.1" ECU_ADDRESS 0x600187DA /end MEASUREMENT
/begin MEASUREMENT MoF_trqLosTotCpl "RAM-data redundancy for MoF_trqLosTot" UBYTE OneToOne 1 100 0.00 255.0 FORMAT "%5.1" ECU_ADDRESS 0x600180CA /end MEASUREMENT
/begin MEASUREMENT Mo_bAftStrt "Condition engine speed above the start threshold in the function monitoring" UBYTE B_TRUE 1 100 0.00 1.00000000000 BIT_MASK 0x1 FORMAT "%13.11" ECU_ADDRESS 0x60018814 /end MEASUREMENT
/begin MEASUREMENT Mo_bIrvICOL1 "State irreversible SKA from Level1 in function monitoring" UBYTE B_TRUE 1 100 0.00 1.00000000000 BIT_MASK 0x1 FORMAT "%13.11" ECU_ADDRESS 0x60018834 /end MEASUREMENT
/begin MEASUREMENT Mo_bPostDrv "State PostDrive in function monitoring" UBYTE B_TRUE 1 100 0.00 1.00000000000 BIT_MASK 0x2 FORMAT "%13.11" ECU_ADDRESS 0x60018834 /end MEASUREMENT
/begin MEASUREMENT Mo_bPreDrv "State PreDrive in function monitoring" UBYTE B_TRUE 1 100 0.00 1.00000000000 BIT_MASK 0x4 FORMAT "%13.11" ECU_ADDRESS 0x60018834 /end MEASUREMENT
/begin MEASUREMENT Mo_bRvICOL1 "State reversible SKA from Level1 in function monitoring" UBYTE B_TRUE 1 100 0.00 1.00000000000 BIT_MASK 0x8 FORMAT "%13.11" ECU_ADDRESS 0x60018834 /end MEASUREMENT
/begin MEASUREMENT Mo_stSysCpl "RAM data redundancy of Mo_stSys" UBYTE OneToOne 1 100 0.00 255.0 FORMAT "%5.1" ECU_ADDRESS 0x6001811C /end MEASUREMENT
/begin FUNCTION MoFFrm_Rx "230.0.0   Function Monitoring: Frame Manager - Received Messages"
 /begin DEF_CHARACTERISTIC MoFFrm_Rx_DataPdu_AYCF.bufLen_C MoFFrm_Rx_DataPdu_AYCF.bytOrderAlvCntr_C MoFFrm_Rx_DataPdu_AYCF.bytOrderCrc_C MoFFrm_Rx_DataPdu_AYCF.cntrAlvErrDeb_C MoFFrm_Rx_DataPdu_AYCF.cntrCrcErrDeb_C MoFFrm_Rx_DataPdu_AYCF.cntrMaxAlvDif_C MoFFrm_Rx_DataPdu_AYCF.cntrTiOutDeb_C MoFFrm_Rx_DataPdu_AYCF.crcId_C MoFFrm_Rx_DataPdu_AYCF.cycTi_C MoFFrm_Rx_DataPdu_AYCF.diChks_C MoFFrm_Rx_DataPdu_AYCF.evalType_C MoFFrm_Rx_DataPdu_AYCF.maskAlvCntr_C MoFFrm_Rx_DataPdu_AYCF.posnAlvCntrStrtBit_C MoFFrm_Rx_DataPdu_AYCF.posnCrcCalcEndByte_C MoFFrm_Rx_DataPdu_AYCF.posnCrcCalcStrtByte_C MoFFrm_Rx_DataPdu_AYCF.posnCrcStrtBit_C MoFFrm_Rx_DataPdu_AYCF.sigLenAlvCntr_C MoFFrm_Rx_DataPdu_AYCF.sigLenCrc_C MoFFrm_Rx_DataPdu_EAT1.bufLen_C MoFFrm_Rx_DataPdu_EAT1.bytOrderAlvCntr_C MoFFrm_Rx_DataPdu_EAT1.bytOrderCrc_C MoFFrm_Rx_DataPdu_EAT1.cntrAlvErrDeb_C MoFFrm_Rx_DataPdu_EAT1.cntrCrcErrDeb_C MoFFrm_Rx_DataPdu_EAT1.cntrMaxAlvDif_C MoFFrm_Rx_DataPdu_EAT1.cntrTiOutDeb_C MoFFrm_Rx_DataPdu_EAT1.crcId_C MoFFrm_Rx_DataPdu_EAT1.cycTi_C MoFFrm_Rx_DataPdu_EAT1.diChks_C MoFFrm_Rx_DataPdu_EAT1.evalType_C MoFFrm_Rx_DataPdu_EAT1.maskAlvCntr_C MoFFrm_Rx_DataPdu_EAT1.posnAlvCntrStrtBit_C MoFFrm_Rx_DataPdu_EAT1.posnCrcCalcEndByte_C MoFFrm_Rx_DataPdu_EAT1.posnCrcCalcStrtByte_C MoFFrm_Rx_DataPdu_EAT1.posnCrcStrtBit_C MoFFrm_Rx_DataPdu_EAT1.sigLenAlvCntr_C MoFFrm_Rx_DataPdu_EAT1.sigLenCrc_C MoFFrm_Rx_DataPdu_EAT12.bufLen_C MoFFrm_Rx_DataPdu_EAT12.bytOrderAlvCntr_C MoFFrm_Rx_DataPdu_EAT12.bytOrderCrc_C MoFFrm_Rx_DataPdu_EAT12.cntrAlvErrDeb_C MoFFrm_Rx_DataPdu_EAT12.cntrCrcErrDeb_C MoFFrm_Rx_DataPdu_EAT12.cntrMaxAlvDif_C MoFFrm_Rx_DataPdu_EAT12.cntrTiOutDeb_C MoFFrm_Rx_DataPdu_EAT12.crcId_C MoFFrm_Rx_DataPdu_EAT12.cycTi_C MoFFrm_Rx_DataPdu_EAT12.diChks_C MoFFrm_Rx_DataPdu_EAT12.evalType_C MoFFrm_Rx_DataPdu_EAT12.maskAlvCntr_C MoFFrm_Rx_DataPdu_EAT12.posnAlvCntrStrtBit_C MoFFrm_Rx_DataPdu_EAT12.posnCrcCalcEndByte_C MoFFrm_Rx_DataPdu_EAT12.posnCrcCalcStrtByte_C MoFFrm_Rx_DataPdu_EAT12.posnCrcStrtBit_C MoFFrm_Rx_DataPdu_EAT12.sigLenAlvCntr_C MoFFrm_Rx_DataPdu_EAT12.sigLenCrc_C MoFFrm_Rx_DataPdu_EAT13.bufLen_C MoFFrm_Rx_DataPdu_EAT13.bytOrderAlvCntr_C MoFFrm_Rx_DataPdu_EAT13.bytOrderCrc_C MoFFrm_Rx_DataPdu_EAT13.cntrAlvErrDeb_C MoFFrm_Rx_DataPdu_EAT13.cntrCrcErrDeb_C MoFFrm_Rx_DataPdu_EAT13.cntrMaxAlvDif_C MoFFrm_Rx_DataPdu_EAT13.cntrTiOutDeb_C MoFFrm_Rx_DataPdu_EAT13.crcId_C MoFFrm_Rx_DataPdu_EAT13.cycTi_C MoFFrm_Rx_DataPdu_EAT13.diChks_C MoFFrm_Rx_DataPdu_EAT13.evalType_C MoFFrm_Rx_DataPdu_EAT13.maskAlvCntr_C MoFFrm_Rx_DataPdu_EAT13.posnAlvCntrStrtBit_C MoFFrm_Rx_DataPdu_EAT13.posnCrcCalcEndByte_C MoFFrm_Rx_DataPdu_EAT13.posnCrcCalcStrtByte_C MoFFrm_Rx_DataPdu_EAT13.posnCrcStrtBit_C MoFFrm_Rx_DataPdu_EAT13.sigLenAlvCntr_C MoFFrm_Rx_DataPdu_EAT13.sigLenCrc_C MoFFrm_Rx_DataPdu_EAT4.bufLen_C MoFFrm_Rx_DataPdu_EAT4.bytOrderAlvCntr_C MoFFrm_Rx_DataPdu_EAT4.bytOrderCrc_C MoFFrm_Rx_DataPdu_EAT4.cntrAlvErrDeb_C MoFFrm_Rx_DataPdu_EAT4.cntrCrcErrDeb_C MoFFrm_Rx_DataPdu_EAT4.cntrMaxAlvDif_C MoFFrm_Rx_DataPdu_EAT4.cntrTiOutDeb_C MoFFrm_Rx_DataPdu_EAT4.crcId_C MoFFrm_Rx_DataPdu_EAT4.cycTi_C MoFFrm_Rx_DataPdu_EAT4.diChks_C MoFFrm_Rx_DataPdu_EAT4.evalType_C MoFFrm_Rx_DataPdu_EAT4.maskAlvCntr_C MoFFrm_Rx_DataPdu_EAT4.posnAlvCntrStrtBit_C MoFFrm_Rx_DataPdu_EAT4.posnCrcCalcEndByte_C MoFFrm_Rx_DataPdu_EAT4.posnCrcCalcStrtByte_C MoFFrm_Rx_DataPdu_EAT4.posnCrcStrtBit_C MoFFrm_Rx_DataPdu_EAT4.sigLenAlvCntr_C MoFFrm_Rx_DataPdu_EAT4.sigLenCrc_C MoFFrm_Rx_DataPdu_EATB.bufLen_C MoFFrm_Rx_DataPdu_EATB.bytOrderAlvCntr_C MoFFrm_Rx_DataPdu_EATB.bytOrderCrc_C MoFFrm_Rx_DataPdu_EATB.cntrAlvErrDeb_C MoFFrm_Rx_DataPdu_EATB.cntrCrcErrDeb_C MoFFrm_Rx_DataPdu_EATB.cntrMaxAlvDif_C MoFFrm_Rx_DataPdu_EATB.cntrTiOutDeb_C MoFFrm_Rx_DataPdu_EATB.crcId_C MoFFrm_Rx_DataPdu_EATB.cycTi_C MoFFrm_Rx_DataPdu_EATB.diChks_C MoFFrm_Rx_DataPdu_EATB.evalType_C MoFFrm_Rx_DataPdu_EATB.maskAlvCntr_C MoFFrm_Rx_DataPdu_EATB.posnAlvCntrStrtBit_C MoFFrm_Rx_DataPdu_EATB.posnCrcCalcEndByte_C MoFFrm_Rx_DataPdu_EATB.posnCrcCalcStrtByte_C MoFFrm_Rx_DataPdu_EATB.posnCrcStrtBit_C MoFFrm_Rx_DataPdu_EATB.sigLenAlvCntr_C MoFFrm_Rx_DataPdu_EATB.sigLenCrc_C MoFFrm_Rx_DataPdu_GWIMG3.bufLen_C MoFFrm_Rx_DataPdu_GWIMG3.bytOrderAlvCntr_C MoFFrm_Rx_DataPdu_GWIMG3.bytOrderCrc_C MoFFrm_Rx_DataPdu_GWIMG3.cntrAlvErrDeb_C MoFFrm_Rx_DataPdu_GWIMG3.cntrCrcErrDeb_C MoFFrm_Rx_DataPdu_GWIMG3.cntrMaxAlvDif_C MoFFrm_Rx_DataPdu_GWIMG3.cntrTiOutDeb_C MoFFrm_Rx_DataPdu_GWIMG3.crcId_C MoFFrm_Rx_DataPdu_GWIMG3.cycTi_C MoFFrm_Rx_DataPdu_GWIMG3.diChks_C MoFFrm_Rx_DataPdu_GWIMG3.evalType_C MoFFrm_Rx_DataPdu_GWIMG3.maskAlvCntr_C MoFFrm_Rx_DataPdu_GWIMG3.posnAlvCntrStrtBit_C MoFFrm_Rx_DataPdu_GWIMG3.posnCrcCalcEndByte_C MoFFrm_Rx_DataPdu_GWIMG3.posnCrcCalcStrtByte_C MoFFrm_Rx_DataPdu_GWIMG3.posnCrcStrtBit_C MoFFrm_Rx_DataPdu_GWIMG3.sigLenAlvCntr_C MoFFrm_Rx_DataPdu_GWIMG3.sigLenCrc_C MoFFrm_Rx_DataPdu_META.bufLen_C MoFFrm_Rx_DataPdu_META.bytOrderAlvCntr_C MoFFrm_Rx_DataPdu_META.bytOrderCrc_C MoFFrm_Rx_DataPdu_META.cntrAlvErrDeb_C MoFFrm_Rx_DataPdu_META.cntrCrcErrDeb_C MoFFrm_Rx_DataPdu_META.cntrMaxAlvDif_C MoFFrm_Rx_DataPdu_META.cntrTiOutDeb_C MoFFrm_Rx_DataPdu_META.crcId_C MoFFrm_Rx_DataPdu_META.cycTi_C MoFFrm_Rx_DataPdu_META.diChks_C MoFFrm_Rx_DataPdu_META.evalType_C MoFFrm_Rx_DataPdu_META.maskAlvCntr_C MoFFrm_Rx_DataPdu_META.posnAlvCntrStrtBit_C MoFFrm_Rx_DataPdu_META.posnCrcCalcEndByte_C MoFFrm_Rx_DataPdu_META.posnCrcCalcStrtByte_C MoFFrm_Rx_DataPdu_META.posnCrcStrtBit_C MoFFrm_Rx_DataPdu_META.sigLenAlvCntr_C MoFFrm_Rx_DataPdu_META.sigLenCrc_C MoFFrm_Rx_DataPdu_METL.bufLen_C MoFFrm_Rx_DataPdu_METL.bytOrderAlvCntr_C MoFFrm_Rx_DataPdu_METL.bytOrderCrc_C MoFFrm_Rx_DataPdu_METL.cntrAlvErrDeb_C MoFFrm_Rx_DataPdu_METL.cntrCrcErrDeb_C MoFFrm_Rx_DataPdu_METL.cntrMaxAlvDif_C MoFFrm_Rx_DataPdu_METL.cntrTiOutDeb_C MoFFrm_Rx_DataPdu_METL.crcId_C MoFFrm_Rx_DataPdu_METL.cycTi_C MoFFrm_Rx_DataPdu_METL.diChks_C MoFFrm_Rx_DataPdu_METL.evalType_C MoFFrm_Rx_DataPdu_METL.maskAlvCntr_C MoFFrm_Rx_DataPdu_METL.posnAlvCntrStrtBit_C MoFFrm_Rx_DataPdu_METL.posnCrcCalcEndByte_C MoFFrm_Rx_DataPdu_METL.posnCrcCalcStrtByte_C MoFFrm_Rx_DataPdu_METL.posnCrcStrtBit_C MoFFrm_Rx_DataPdu_METL.sigLenAlvCntr_C MoFFrm_Rx_DataPdu_METL.sigLenCrc_C /end DEF_CHARACTERISTIC
 /begin IN_MEASUREMENT MoXFrm_Buf_AYCF MoXFrm_Buf_EAT1 MoXFrm_Buf_EAT12 MoXFrm_Buf_EAT13 MoXFrm_Buf_EAT4 MoXFrm_Buf_EATB MoXFrm_Buf_GWIMG3 MoXFrm_Buf_META MoXFrm_Buf_METL MoXFrm_flgUpdAYCF MoXFrm_flgUpdEAT1 MoXFrm_flgUpdEAT12 MoXFrm_flgUpdEAT13 MoXFrm_flgUpdEAT4 MoXFrm_flgUpdEATB MoXFrm_flgUpdGWIMG3 MoXFrm_flgUpdMETA MoXFrm_flgUpdMETL Mo_stCplChk Mo_stMoC Mo_stMoCCpl /end IN_MEASUREMENT
 /begin OUT_MEASUREMENT MoFFrm_flgComErrACC MoFFrm_flgDecIntvActvDCS MoFFrm_flgDecIntvActvTra MoFFrm_flgTqUpReqACC MoFFrm_Rx_flgATCVTShiftN_EATB MoFFrm_Rx_flgATCVTShiftP_EATB MoFFrm_Rx_flgBrkHldActv_GWIMG4 MoFFrm_Rx_flgCVTShiftSure_EATB MoFFrm_Rx_flgDCSPlus_AYCF MoFFrm_Rx_flgEBBBrkPedlOn_EBBA MoFFrm_Rx_flgMaiSwt_META MoFFrm_Rx_flgTMStrtEna_EAT12 MoFFrm_Rx_flgTMStrtEna_EAT13 MoFFrm_Rx_rTrqCnvBoost_EAT1 MoFFrm_Rx_stACCActv_GWIMG3 MoFFrm_Rx_stButtonRaw_METL MoFFrm_Rx_stEcoModOn_METD MoFFrm_Rx_stPdu_AYCF MoFFrm_Rx_stPdu_EAT1 MoFFrm_Rx_stPdu_EAT12 MoFFrm_Rx_stPdu_EAT13 MoFFrm_Rx_stPdu_EAT4 MoFFrm_Rx_stPdu_EATB MoFFrm_Rx_stPdu_EBBA MoFFrm_Rx_stPdu_GWIMG3 MoFFrm_Rx_stPdu_GWIMG4 MoFFrm_Rx_stPdu_META MoFFrm_Rx_stPdu_METD MoFFrm_Rx_stPdu_METL MoFFrm_Rx_stTqUpReqDCS_AYCF MoFFrm_Rx_tqCluTra_EAT4 MoFFrm_Rx_tqWhlDCS_AYCF MoFFrm_tqWhlACC /end OUT_MEASUREMENT
 /begin LOC_MEASUREMENT MoFFrmRx_bbMoFFrm_Rx_flgATCVTShiftN_EATBCpl MoFFrmRx_bbMoFFrm_Rx_flgATCVTShiftP_EATBCpl MoFFrmRx_bbMoFFrm_Rx_flgBrkHldActv_GWIMG4Cpl MoFFrmRx_bbMoFFrm_Rx_flgCVTShiftSure_EATBCpl MoFFrmRx_bbMoFFrm_Rx_flgDCSPlus_AYCFCpl MoFFrmRx_bbMoFFrm_Rx_flgEBBBrkPedlOn_EBBACpl MoFFrmRx_bbMoFFrm_Rx_flgMaiSwt_METACpl MoFFrmRx_bbMoFFrm_Rx_flgTMStrtEna_EAT12Cpl MoFFrmRx_bbMoFFrm_Rx_flgTMStrtEna_EAT13Cpl MoFFrm_Rx_bbOut1Cpl MoFFrm_Rx_DataPdu_AYCF.cntrAlvErrDeb MoFFrm_Rx_DataPdu_AYCF.cntrAlvErrDebCpl MoFFrm_Rx_DataPdu_AYCF.cntrAlvOld MoFFrm_Rx_DataPdu_AYCF.cntrAlvOldCpl MoFFrm_Rx_DataPdu_AYCF.cntrCrcErrDeb MoFFrm_Rx_DataPdu_AYCF.cntrCrcErrDebCpl MoFFrm_Rx_DataPdu_AYCF.cntrCycTi MoFFrm_Rx_DataPdu_AYCF.cntrCycTiCpl MoFFrm_Rx_DataPdu_AYCF.cntrTiOutDeb MoFFrm_Rx_DataPdu_AYCF.cntrTiOutDebCpl MoFFrm_Rx_DataPdu_AYCF.crcData MoFFrm_Rx_DataPdu_AYCF.crcDataCpl MoFFrm_Rx_DataPdu_AYCF.flgPduUpd MoFFrm_Rx_DataPdu_AYCF.flgPduUpdCpl MoFFrm_Rx_DataPdu_EAT1.cntrAlvErrDeb MoFFrm_Rx_DataPdu_EAT1.cntrAlvErrDebCpl MoFFrm_Rx_DataPdu_EAT1.cntrAlvOld MoFFrm_Rx_DataPdu_EAT1.cntrAlvOldCpl MoFFrm_Rx_DataPdu_EAT1.cntrCrcErrDeb MoFFrm_Rx_DataPdu_EAT1.cntrCrcErrDebCpl MoFFrm_Rx_DataPdu_EAT1.cntrCycTi MoFFrm_Rx_DataPdu_EAT1.cntrCycTiCpl MoFFrm_Rx_DataPdu_EAT1.cntrTiOutDeb MoFFrm_Rx_DataPdu_EAT1.cntrTiOutDebCpl MoFFrm_Rx_DataPdu_EAT1.crcData MoFFrm_Rx_DataPdu_EAT1.crcDataCpl MoFFrm_Rx_DataPdu_EAT1.flgPduUpd MoFFrm_Rx_DataPdu_EAT1.flgPduUpdCpl MoFFrm_Rx_DataPdu_EAT12.cntrAlvErrDeb MoFFrm_Rx_DataPdu_EAT12.cntrAlvErrDebCpl MoFFrm_Rx_DataPdu_EAT12.cntrAlvOld MoFFrm_Rx_DataPdu_EAT12.cntrAlvOldCpl MoFFrm_Rx_DataPdu_EAT12.cntrCrcErrDeb MoFFrm_Rx_DataPdu_EAT12.cntrCrcErrDebCpl MoFFrm_Rx_DataPdu_EAT12.cntrCycTi MoFFrm_Rx_DataPdu_EAT12.cntrCycTiCpl MoFFrm_Rx_DataPdu_EAT12.cntrTiOutDeb MoFFrm_Rx_DataPdu_EAT12.cntrTiOutDebCpl MoFFrm_Rx_DataPdu_EAT12.crcData MoFFrm_Rx_DataPdu_EAT12.crcDataCpl MoFFrm_Rx_DataPdu_EAT12.flgPduUpd MoFFrm_Rx_DataPdu_EAT12.flgPduUpdCpl MoFFrm_Rx_DataPdu_EAT13.cntrAlvErrDeb MoFFrm_Rx_DataPdu_EAT13.cntrAlvErrDebCpl MoFFrm_Rx_DataPdu_EAT13.cntrAlvOld MoFFrm_Rx_DataPdu_EAT13.cntrAlvOldCpl MoFFrm_Rx_DataPdu_EAT13.cntrCrcErrDeb MoFFrm_Rx_DataPdu_EAT13.cntrCrcErrDebCpl MoFFrm_Rx_DataPdu_EAT13.cntrCycTi MoFFrm_Rx_DataPdu_EAT13.cntrCycTiCpl MoFFrm_Rx_DataPdu_EAT13.cntrTiOutDeb MoFFrm_Rx_DataPdu_EAT13.cntrTiOutDebCpl MoFFrm_Rx_DataPdu_EAT13.crcData MoFFrm_Rx_DataPdu_EAT13.crcDataCpl MoFFrm_Rx_DataPdu_EAT13.flgPduUpd MoFFrm_Rx_DataPdu_EAT13.flgPduUpdCpl MoFFrm_Rx_DataPdu_EAT4.cntrAlvErrDeb MoFFrm_Rx_DataPdu_EAT4.cntrAlvErrDebCpl MoFFrm_Rx_DataPdu_EAT4.cntrAlvOld MoFFrm_Rx_DataPdu_EAT4.cntrAlvOldCpl MoFFrm_Rx_DataPdu_EAT4.cntrCrcErrDeb MoFFrm_Rx_DataPdu_EAT4.cntrCrcErrDebCpl MoFFrm_Rx_DataPdu_EAT4.cntrCycTi MoFFrm_Rx_DataPdu_EAT4.cntrCycTiCpl MoFFrm_Rx_DataPdu_EAT4.cntrTiOutDeb MoFFrm_Rx_DataPdu_EAT4.cntrTiOutDebCpl MoFFrm_Rx_DataPdu_EAT4.crcData MoFFrm_Rx_DataPdu_EAT4.crcDataCpl MoFFrm_Rx_DataPdu_EAT4.flgPduUpd MoFFrm_Rx_DataPdu_EAT4.flgPduUpdCpl MoFFrm_Rx_DataPdu_EATB.cntrAlvErrDeb MoFFrm_Rx_DataPdu_EATB.cntrAlvErrDebCpl MoFFrm_Rx_DataPdu_EATB.cntrAlvOld MoFFrm_Rx_DataPdu_EATB.cntrAlvOldCpl MoFFrm_Rx_DataPdu_EATB.cntrCrcErrDeb MoFFrm_Rx_DataPdu_EATB.cntrCrcErrDebCpl MoFFrm_Rx_DataPdu_EATB.cntrCycTi MoFFrm_Rx_DataPdu_EATB.cntrCycTiCpl MoFFrm_Rx_DataPdu_EATB.cntrTiOutDeb MoFFrm_Rx_DataPdu_EATB.cntrTiOutDebCpl MoFFrm_Rx_DataPdu_EATB.crcData MoFFrm_Rx_DataPdu_EATB.crcDataCpl MoFFrm_Rx_DataPdu_EATB.flgPduUpd MoFFrm_Rx_DataPdu_EATB.flgPduUpdCpl MoFFrm_Rx_DataPdu_GWIMG3.cntrAlvErrDeb MoFFrm_Rx_DataPdu_GWIMG3.cntrAlvErrDebCpl MoFFrm_Rx_DataPdu_GWIMG3.cntrAlvOld MoFFrm_Rx_DataPdu_GWIMG3.cntrAlvOldCpl MoFFrm_Rx_DataPdu_GWIMG3.cntrCrcErrDeb MoFFrm_Rx_DataPdu_GWIMG3.cntrCrcErrDebCpl MoFFrm_Rx_DataPdu_GWIMG3.cntrCycTi MoFFrm_Rx_DataPdu_GWIMG3.cntrCycTiCpl MoFFrm_Rx_DataPdu_GWIMG3.cntrTiOutDeb MoFFrm_Rx_DataPdu_GWIMG3.cntrTiOutDebCpl MoFFrm_Rx_DataPdu_GWIMG3.crcData MoFFrm_Rx_DataPdu_GWIMG3.crcDataCpl MoFFrm_Rx_DataPdu_GWIMG3.flgPduUpd MoFFrm_Rx_DataPdu_GWIMG3.flgPduUpdCpl MoFFrm_Rx_DataPdu_META.cntrAlvErrDeb MoFFrm_Rx_DataPdu_META.cntrAlvErrDebCpl MoFFrm_Rx_DataPdu_META.cntrAlvOld MoFFrm_Rx_DataPdu_META.cntrAlvOldCpl MoFFrm_Rx_DataPdu_META.cntrCrcErrDeb MoFFrm_Rx_DataPdu_META.cntrCrcErrDebCpl MoFFrm_Rx_DataPdu_META.cntrCycTi MoFFrm_Rx_DataPdu_META.cntrCycTiCpl MoFFrm_Rx_DataPdu_META.cntrTiOutDeb MoFFrm_Rx_DataPdu_META.cntrTiOutDebCpl MoFFrm_Rx_DataPdu_META.crcData MoFFrm_Rx_DataPdu_META.crcDataCpl MoFFrm_Rx_DataPdu_META.flgPduUpd MoFFrm_Rx_DataPdu_META.flgPduUpdCpl MoFFrm_Rx_DataPdu_METL.cntrAlvErrDeb MoFFrm_Rx_DataPdu_METL.cntrAlvErrDebCpl MoFFrm_Rx_DataPdu_METL.cntrAlvOld MoFFrm_Rx_DataPdu_METL.cntrAlvOldCpl MoFFrm_Rx_DataPdu_METL.cntrCrcErrDeb MoFFrm_Rx_DataPdu_METL.cntrCrcErrDebCpl MoFFrm_Rx_DataPdu_METL.cntrCycTi MoFFrm_Rx_DataPdu_METL.cntrCycTiCpl MoFFrm_Rx_DataPdu_METL.cntrTiOutDeb MoFFrm_Rx_DataPdu_METL.cntrTiOutDebCpl MoFFrm_Rx_DataPdu_METL.crcData MoFFrm_Rx_DataPdu_METL.crcDataCpl MoFFrm_Rx_DataPdu_METL.flgPduUpd MoFFrm_Rx_DataPdu_METL.flgPduUpdCpl MoFFrm_Rx_mirrBuf MoFFrm_Rx_rawCVT_SHFT_IN_NEUTRAL MoFFrm_Rx_rawCVT_SHFT_IN_PARKING MoFFrm_Rx_rawCVT_SHIFT_SURE MoFFrm_Rx_rawIMG_DRVTRQ_STATUS MoFFrm_Rx_rawMETER_CC_MAIN_STATUS MoFFrm_Rx_rawMETER_SW_STATUS_CC_STANDARD MoFFrm_Rx_rawTM_REQ_ENG_TORQUE_FAST MoFFrm_Rx_rawTM_START_ENABLE MoFFrm_Rx_rawTM_START_ENABLESUB MoFFrm_Rx_rawTM_TORQUE_CONV_TORQUE_RATIO MoFFrm_Rx_rawVSA_REQ_MSR_PLUS_TRQ MoFFrm_Rx_rawVSA_REQ_TRQ_1AC MoFFrm_Rx_rawVSA_TRQ_CONTROL_MODE MoFFrm_Rx_rTrqCnvBoost_EAT1Cpl MoFFrm_Rx_stACCActv_GWIMG3Cpl MoFFrm_Rx_stButtonRaw_METLCpl MoFFrm_Rx_stEcoModOn_METDCpl MoFFrm_Rx_stPdu_AYCFCpl MoFFrm_Rx_stPdu_EAT12Cpl MoFFrm_Rx_stPdu_EAT13Cpl MoFFrm_Rx_stPdu_EAT1Cpl MoFFrm_Rx_stPdu_EAT4Cpl MoFFrm_Rx_stPdu_EATBCpl MoFFrm_Rx_stPdu_EBBACpl MoFFrm_Rx_stPdu_GWIMG3Cpl MoFFrm_Rx_stPdu_GWIMG4Cpl MoFFrm_Rx_stPdu_METACpl MoFFrm_Rx_stPdu_METDCpl MoFFrm_Rx_stPdu_METLCpl MoFFrm_Rx_stTqUpReqDCS_AYCFCpl MoFFrm_Rx_tqCluTra_EAT4Cpl MoFFrm_Rx_tqWhlDCS_AYCFCpl MoFFrm_tqWhlACCCpl /end LOC_MEASUREMENT
 FUNCTION_VERSION "230.0.0" /end FUNCTION
/begin FUNCTION MoFFrm_Tx "118.0.0   Function Monitoring: Frame Manager - Sent Messages"
 /begin DEF_CHARACTERISTIC MoFFrm_Tx_DataPdu_ENGA.bufLen_C MoFFrm_Tx_DataPdu_ENGA.bytOrderAlvCntr_C MoFFrm_Tx_DataPdu_ENGA.bytOrderCrc_C MoFFrm_Tx_DataPdu_ENGA.crcId_C MoFFrm_Tx_DataPdu_ENGA.evalType_C MoFFrm_Tx_DataPdu_ENGA.posnAlvCntrStrtBit_C MoFFrm_Tx_DataPdu_ENGA.posnCrcCalcEndByte_C MoFFrm_Tx_DataPdu_ENGA.posnCrcCalcStrtByte_C MoFFrm_Tx_DataPdu_ENGA.posnCrcStrtBit_C MoFFrm_Tx_DataPdu_ENGA.sigLenAlvCntr_C MoFFrm_Tx_DataPdu_ENGA.sigLenCrc_C /end DEF_CHARACTERISTIC
 /begin IN_MEASUREMENT MoFFrmCoorrCust_Tx_flgAppErr MoFFrmCoorrCust_Tx_rAPP MoXFrm_Buf_ENGA MoXFrm_flgUpdENGA Mo_stCplChk Mo_stMoC Mo_stMoCCpl /end IN_MEASUREMENT
 /begin LOC_MEASUREMENT MoFFrm_Tx_bbOutENGACpl MoFFrm_Tx_Buf_ENGA MoFFrm_Tx_dataENG_ACCELE_FAIL_INFORMATION MoFFrm_Tx_dataENG_ACCELE_FAIL_INFORMATIONCpl MoFFrm_Tx_dataENG_DRIVER_ACPEDAL_POSITION MoFFrm_Tx_dataENG_DRIVER_ACPEDAL_POSITIONCpl MoFFrm_Tx_DataPdu_ENGA.cntrAlvOld MoFFrm_Tx_DataPdu_ENGA.cntrAlvOldCpl MoFFrm_Tx_DataPdu_ENGA.crcData MoFFrm_Tx_DataPdu_ENGA.crcDataCpl MoFFrm_Tx_DataPdu_ENGA.flgAswTrigTx MoFFrm_Tx_DataPdu_ENGA.flgAswTrigTxCpl MoFFrm_Tx_flgPduStENGA MoFFrm_Tx_mirrBuf /end LOC_MEASUREMENT
 FUNCTION_VERSION "118.0.0" /end FUNCTION
/begin FUNCTION MoFHybRx_Co "30.1.0    Function Monitoring: Input signals from hybrid system" /begin DEF_CHARACTERISTIC MoFHybRx_flgComErrElDrv_C MoFHybRx_flgIrvErrDelDrv_C /end DEF_CHARACTERISTIC /begin IN_MEASUREMENT Mo_stCplChk Mo_stMoC Mo_stMoCCpl /end IN_MEASUREMENT
 /begin OUT_MEASUREMENT MoFHybRx_flgComErrElDrv MoFHybRx_flgIrvErrElDrv MoFHybRx_tqActEm /end OUT_MEASUREMENT
 /begin LOC_MEASUREMENT MoFHybRxCo_bbOut1Cpl MoFHybRx_tqActEmCpl /end LOC_MEASUREMENT
 FUNCTION_VERSION "30.1.0" /end FUNCTION
/begin FUNCTION MoFIA_Co "40.0.0    Function Monitoring: Ignition angle"
 /begin DEF_CHARACTERISTIC MoFIA_cntrErrDebMaxIACo_C MoFIA_cntrRstMaxIACo_C MoFIA_nErrHndlgActvnIACo_C /end DEF_CHARACTERISTIC
 /begin REF_CHARACTERISTIC MoFAirFl_nrCylTot_C /end REF_CHARACTERISTIC
 /begin IN_MEASUREMENT MoFAirFl_TrqActIfClass_V4_I.agIntkClsd MoFAirFl_TrqActIfClass_V4_I.agIntkClsdRdt MoFAirFl_TrqActIfClass_V4_I.etaaufte MoFAirFl_TrqActIfClass_V4_I.etazwist MoFAirFl_TrqActIfClass_V4_I.etazwistm MoFAirFl_TrqActIfClass_V4_I.miist MoFAirFl_TrqActIfClass_V4_I.zwcalcar MoFAirFl_TrqActIfClass_V4_I.zwcalcar_zzylzue MoFAirFl_TrqActIfClass_V4_I.zwcalcarcp MoFAirFl_TrqActIfClass_V4_I.zwopt MoFAirFl_TrqActIfClass_V4_I.zwout MoFAirFl_TrqActIfClass_V4_I.zwoutcpl MoFAirFl_TrqActIfClass_V4_I.zwouthiresl MoFAirFl_TrqActIfClass_V4_I.zwouthireslAry_zzylzue MoFAirFl_TrqActIfClass_V4_I.zwouthireslRdnt MoFESpd_nEng MoF_bAirFlChkDisbl Mo_bPostDrv Mo_bPreDrv Mo_ctRst Mo_ctRstCpl Mo_stCplChk Mo_stMoC Mo_stMoCCpl Mo_stMoF Mo_stMoFCpl /end IN_MEASUREMENT
 /begin OUT_MEASUREMENT MoFIA_flgIrrvErrMsg MoFIA_flgTestIACoMsg MoFIA_iaOutp MoFIA_iaOutpHiResl /end OUT_MEASUREMENT
 /begin LOC_MEASUREMENT MoFIA_cntrDiagDebIACo MoFIA_cntrErrDebIACo MoFIA_cntrErrDebIACoCpl MoFIA_flgClr MoFIA_iaOutpCpl MoFIA_iaOutpHiReslCpl /end LOC_MEASUREMENT
 FUNCTION_VERSION "40.0.0" /end FUNCTION
/begin FUNCTION MoFICO_Co "57.2.0    Function Monitoring: Injection Cut Off"
 /begin DEF_CHARACTERISTIC MoFICO_nEngThdESM_T MoFICO_nMaxVDpd_Cur MoF_ctICOIgn_C MoF_ctICOInj_C MoF_ctIgnDel_C MoF_ctPCPDel_C MoF_nMaxAppDfct_C MoF_nMax_C /end DEF_CHARACTERISTIC
 /begin IN_MEASUREMENT MoFAirFl_stCtOffMask MoFAPP_flgPlausErrDeb MoFAPP_ratHiResl MoFESpd_nEngHiRes MoFVSS_v MoF_ctInjPCPCurr MoF_ignCtOffMsk Mo_bPostDrv Mo_bPreDrv Mo_stCplChk Mo_stMoC Mo_stMoCCpl Mo_stMoF Mo_stMoFCpl /end IN_MEASUREMENT
 /begin LOC_MEASUREMENT MoFICO_cntrTestICOL1 MoFICO_cntrTestICOL2 MoFICO_flgClrICOL1 MoFICO_flgClrICOL2 MoFICO_flgIrrvErrICOL1Msg MoFICO_flgIrrvErrICOL2Msg MoFICO_flgTestICOL1Msg MoFICO_flgTestICOL2Msg MoF_ctICOIgn MoF_ctICOIgnCpl MoF_ctICOInj MoF_ctICOInjCpl MoF_ctIgnDel MoF_ctIgnDelCpl MoF_ctInjPCPOld MoF_ctInjPCPOldCpl MoF_ctPCPDel MoF_ctPCPDelCpl MoF_nMax_MP /end LOC_MEASUREMENT
 FUNCTION_VERSION "57.2.0" /end FUNCTION
/begin FUNCTION MoFIn_Co "90.0.0    Function Monitoring: Input signals"
 /begin DEF_CHARACTERISTIC MoFIn_ctInjPCPTst_CW MoFIn_ignCtOffTst_CW MoFIn_stPPDrvTst_CW /end DEF_CHARACTERISTIC
 /begin IN_MEASUREMENT azoffmsk_w_msg Mo_stCplChk Mo_stMoC Mo_stMoCCpl Mo_stMoF Mo_stMoFCpl SyC_stSub ThrVlv_flgIrrvFuCutOffB1 ThrVlv_flgLimpModeB1 ThrVlv_flgRvsbFuCutOffB1 ThrVlv_flgUBattSuffB1 /end IN_MEASUREMENT
 /begin OUT_MEASUREMENT MoF_ctInjPCPCurr MoF_ignCtOffMsk Mo_bIrvICOL1 Mo_bPostDrv Mo_bPreDrv Mo_bRvICOL1 /end OUT_MEASUREMENT
 /begin LOC_MEASUREMENT MoF_ctInjPCPCurrCpl MoF_ignCtOffMskCpl Mo_stSysCpl /end LOC_MEASUREMENT
 FUNCTION_VERSION "90.0.0" /end FUNCTION
/begin FUNCTION MoFSpdG_Co "64.4.0    Function Monitoring: Speed governor torque"
 /begin DEF_CHARACTERISTIC MoFSpdG_facTqLtd_CUR MoFTrqPtd_nSpdGovMax_C MoFTrqPtd_nSpdGovTrckMax_C MoFTrqPtd_tqSpdGovPtdOfs_T /end DEF_CHARACTERISTIC
 /begin IN_MEASUREMENT HLSDem_nSetPLo HLSDem_nSetPTrck LIGov_nDiff MoFESpd_nEng MoFTrqPtd_tqCmpSwilLoss MoF_trqLosTot Mo_stCplChk Mo_stMoC Mo_stMoCCpl SpdGov_facComp SpdGov_trqClth /end IN_MEASUREMENT
 /begin OUT_MEASUREMENT MoFSpdG_flgWesDem MoFSpdG_tqPtd MoFTrqPtd_facCmpSpdGovr /end OUT_MEASUREMENT
 /begin LOC_MEASUREMENT MoFSpdGCo_bbOutCpl MoFSpdG_tqPtdCpl MoFSpdG_tqSpdGovPtd_MP MoFTrqPtd_facCmpSpdGovrCpl MoFTrqPtd_nDifSpdGovr MoFTrqPtd_nDifSpdGovrCpl /end LOC_MEASUREMENT
 FUNCTION_VERSION "64.4.0" /end FUNCTION
/begin FUNCTION MoFSrv_Lib "24.9.0    Function Monitoring: Service library" /begin IN_MEASUREMENT Mo_stCplChk Mo_stMoC Mo_stMoCCpl /end IN_MEASUREMENT FUNCTION_VERSION "24.9.0" /end FUNCTION
/begin FUNCTION MoFStrt_Co "126.0.0   Function Monitoring: Start" /begin DEF_CHARACTERISTIC MoFStrt_swtISSDisbl_C /end DEF_CHARACTERISTIC /begin IN_MEASUREMENT MoFStrt_stT50 Mo_stCplChk Mo_stMoC Mo_stMoCCpl /end IN_MEASUREMENT /begin OUT_MEASUREMENT MoFStrt_flgStrtPtd MoFStrt_flgStrtRly MoFStrt_stStrtActv /end OUT_MEASUREMENT
 /begin LOC_MEASUREMENT MoFStrtCo_bbOutCpl MoFStrt_flgPs1Actv MoFStrt_flgPs2Actv MoFStrt_stStrtActvCpl /end LOC_MEASUREMENT
 FUNCTION_VERSION "126.0.0" /end FUNCTION
/begin FUNCTION MoFStrt_In "92.0.0    Function Monitoring: Input signals start"
 /begin DEF_CHARACTERISTIC MoFStrt_cntrUnderVltg_C MoFStrt_ctDebClthImpsOff_C MoFStrt_ctDebClthImpsOn_C MoFStrt_ctDebPushBtnDfl_C MoFStrt_ctDebPushBtn_C MoFStrt_ctDebT50HiLo_C MoFStrt_ctDebT50LoHi_C MoFStrt_ctHWBrkDeactvnDly_C MoFStrt_flgTraMT_C MoFStrt_stSTSwitchMnl_C MoFStrt_swtBrkCnd_C MoFStrt_swtClthPlausChk_C MoFStrt_swtInvSTSwitch_C MoFStrt_swtSigNPos_C MoFStrt_swtSTSwitchMnl_C /end DEF_CHARACTERISTIC
 /begin IN_MEASUREMENT MoFBrk_flgMaiBrk MoFBrk_flgRdntBrk MoFClth_flgClthBot MoFClth_flgClthTop MoFFrm_flgBrkHldActv MoFFrm_Rx_flgTMStrtEna_EAT12 MoFFrm_Rx_flgTMStrtEna_EAT13 MoFFrm_Rx_stPdu_EAT12 MoFFrm_Rx_stPdu_EAT13 MoFStrt_stStrtActv Mo_stCplChk Mo_stMoC Mo_stMoCCpl /end IN_MEASUREMENT
 /begin OUT_MEASUREMENT MoFStrt_flgBrkHldActv MoFStrt_flgClthSwtImps MoFStrt_flgMonDisbl MoFStrt_flgSTSwitchRaw MoFStrt_stFFPushBtn MoFStrt_stT50 /end OUT_MEASUREMENT
 /begin LOC_MEASUREMENT MoFStrtIn_bbLoc1Cpl MoFStrtIn_bbOut1Cpl MoFStrt_cntrUnderVltg MoFStrt_cntrUnderVltgCpl MoFStrt_ctDebClthImpsOff MoFStrt_ctDebClthImpsOffCpl MoFStrt_ctDebClthImpsOn MoFStrt_ctDebClthImpsOnCpl MoFStrt_ctDebPushBtn MoFStrt_ctDebPushBtnCpl MoFStrt_ctDebT50 MoFStrt_ctDebT50Cpl MoFStrt_ctHWBrkDeactvnDly MoFStrt_ctHWBrkDeactvnDlyCpl MoFStrt_flgDioStrtNeutrGearErr MoFStrt_flgDioT50Err MoFStrt_flgSTSwitch MoFStrt_flgT50 MoFStrt_flgTMStrtEna MoFStrt_stDioStrtNeutrGear MoFStrt_stDioStrtNeutrGearCpl MoFStrt_stFFPushBtnCpl MoFStrt_stHWBrkDeactvnDlyMem MoFStrt_stHWBrkDeactvnDlyMemCpl MoFStrt_stT50Cpl MoFStrt_stT50DebMem MoFStrt_stT50DebMemCpl MoFStrt_stT50Raw MoFStrt_stT50RawCpl /end LOC_MEASUREMENT
 FUNCTION_VERSION "92.0.0" /end FUNCTION
/begin FUNCTION MoFStrt_Rls "32.0.0    Function Monitoring: Release start" /begin DEF_CHARACTERISTIC MoFStrt_cntrStrtRls_C /end DEF_CHARACTERISTIC
 /begin IN_MEASUREMENT MoFStrt_flgMonDisbl MoFStrt_flgStrtPtd MoFStrt_flgStrtRly Mo_stCplChk Mo_stMoC Mo_stMoCCpl Mo_stMoF Mo_stMoFCpl /end IN_MEASUREMENT
 /begin OUT_MEASUREMENT MoFStrt_flgIrrvErrStrtRlsMsg MoFStrt_flgTstStrtRlsMsg MoFStrt_stStrtMsg /end OUT_MEASUREMENT
 /begin LOC_MEASUREMENT MoFStrt_cntrStrtRels MoFStrt_cntrStrtRelsCpl MoFStrt_flgTmpErrStrtRels_MP /end LOC_MEASUREMENT
 FUNCTION_VERSION "32.0.0" /end FUNCTION
/begin FUNCTION MoFTEng_Co "35.2.0    Function Monitoring: Engine temperature"
 /begin DEF_CHARACTERISTIC MoF_nEngShOff_C MoF_nEngStrt_C MoF_tEngGradNrmOp16_MAP MoF_tEngGradOvrRun_MAP MoF_tEngModMax_C MoF_tEngModOfs_C MoF_tEng_DST MoF_tiTEngEna_C /end DEF_CHARACTERISTIC
 /begin IN_MEASUREMENT CEngDsT_t etaaus_um MoFESpd_nEng MoF_rAMPTLam Mo_stCplChk Mo_stMoC Mo_stMoCCpl /end IN_MEASUREMENT
 /begin OUT_MEASUREMENT MoFTEng_tEng MoF_tEng MoF_tEng_DST_result MoF_tiAftStrt /end OUT_MEASUREMENT
 /begin LOC_MEASUREMENT MoFTEngCo_bbLoc1Cpl MoFTEng_mfVal MoFTEng_mfValCpl MoFTEng_tEngCpl MoF_tEngCpl MoF_tEngLonWrd MoF_tEngLonWrdCpl MoF_tEngMod MoF_tEngModCpl MoF_tEng_DST_resultCpl MoF_tiAftStrtCpl Mo_bAftStrt /end LOC_MEASUREMENT
 FUNCTION_VERSION "35.2.0" /end FUNCTION
/begin FUNCTION MoFTra_Co "171.0.0   Function Monitoring: Transmission intervention"
 /begin DEF_CHARACTERISTIC MoFTra_cntrDebTSCDeactv_C MoFTra_rTqBoostMinLim_C MoFTra_rTqCnvrBoostDft_C /end DEF_CHARACTERISTIC
 /begin IN_MEASUREMENT MoFFrm_flgDecIntvActvTra MoFFrm_flgTqUpReqTra MoFFrm_rTqCnvrBoost MoFFrm_tqCluTra Mo_stCplChk Mo_stMoC Mo_stMoCCpl Tra_trqDesMin /end IN_MEASUREMENT
 /begin OUT_MEASUREMENT MoFTra_flgDecIntvActv MoFTra_flgTSCPtd MoFTra_rTqCnvrBoost MoFTra_tqClthPtd /end OUT_MEASUREMENT
 /begin LOC_MEASUREMENT MoFTraCo_bbOut1Cpl MoFTra_cntrDebTSCDeactv MoFTra_cntrDebTSCDeactvCpl MoFTra_rTqCnvrBoostCpl MoFTra_tqClthPtdCpl /end LOC_MEASUREMENT
 FUNCTION_VERSION "171.0.0" /end FUNCTION
/begin FUNCTION MoFTrqAct_Eng "119.1.0   Function monitoring: Actual engine torque"
 /begin DEF_CHARACTERISTIC MoFTrqAct_facTolrTqActChkMax_C MoFTrqAct_facTolrTqActChkMin_C MoFTrqAct_nEng_Ax MoFTrqAct_offsTolrTqActChk_C MoFTrqAct_ratFillg_Ax MoFTrqAct_stSwtTqActEng_C MoFTrqAct_tqOptm_M /end DEF_CHARACTERISTIC
 /begin IN_MEASUREMENT MoFAirFl_etaIA MoFAirFl_etaIAAvrg MoFAirFl_etaInjCtOff MoFAirFl_etaInjSplt MoFAirFl_etaLam MoFAirFl_ratFillg MoFAirFl_TrqActIfClass_V4_I.agIntkClsd MoFAirFl_TrqActIfClass_V4_I.agIntkClsdRdt MoFAirFl_TrqActIfClass_V4_I.etaaufte MoFAirFl_TrqActIfClass_V4_I.etazwist MoFAirFl_TrqActIfClass_V4_I.etazwistm MoFAirFl_TrqActIfClass_V4_I.miist MoFAirFl_TrqActIfClass_V4_I.zwcalcar MoFAirFl_TrqActIfClass_V4_I.zwcalcar_zzylzue MoFAirFl_TrqActIfClass_V4_I.zwcalcarcp MoFAirFl_TrqActIfClass_V4_I.zwopt MoFAirFl_TrqActIfClass_V4_I.zwout MoFAirFl_TrqActIfClass_V4_I.zwoutcpl MoFAirFl_TrqActIfClass_V4_I.zwouthiresl MoFAirFl_TrqActIfClass_V4_I.zwouthireslAry_zzylzue MoFAirFl_TrqActIfClass_V4_I.zwouthireslRdnt MoFESpd_nEng MoF_ignCtOffMsk Mo_stCplChk Mo_stMoC Mo_stMoCCpl /end IN_MEASUREMENT
 /begin OUT_MEASUREMENT MoFTrqAct_ratTqInr MoF_rTrqInrAct MoF_rTrqInrOpt /end OUT_MEASUREMENT
 /begin LOC_MEASUREMENT MoFTrqAct_nEng_Ax_result MoFTrqAct_ratFillg_Ax_result MoFTrqAct_ratTqInrCpl MoF_rTrqInrActCpl MoF_rTrqInrOptCpl /end LOC_MEASUREMENT
 FUNCTION_VERSION "119.1.0" /end FUNCTION
/begin FUNCTION MoFTrqAct_Sum "13.0.0    Function monitoring: Actual sum torque" /begin REF_CHARACTERISTIC MoFTrqPtd_rBltDrv_C Mo_trqIdcMax_C /end REF_CHARACTERISTIC
 /begin IN_MEASUREMENT MoFHybRx_tqActEm MoFTrqAct_ratTqInr MoF_trqLos Mo_stCplChk Mo_stMoC Mo_stMoCCpl /end IN_MEASUREMENT
 /begin OUT_MEASUREMENT MoFTrqAct_tqCrksftEm MoFTrqAct_tqCrksftEmMsg MoFTrqAct_tqSumClu /end OUT_MEASUREMENT
 /begin LOC_MEASUREMENT MoFTrqAct_tqActCmbEng_MP MoFTrqAct_tqCrksftEmCpl MoFTrqAct_tqSumCluCpl /end LOC_MEASUREMENT
 FUNCTION_VERSION "13.0.0" /end FUNCTION
/begin FUNCTION MoFTrqCmp_Eng "38.0.0    Function Monitoring: Torque comparison engine"
 /begin DEF_CHARACTERISTIC MoFTrqCmp_facTqErrMax_C MoFTrqCmp_facTqErrMin_C MoF_ctRstTrqCmp_C MoF_ctTrqCmp_C MoF_ctTstTrqCmp_C MoF_facTrqErrSumDet_C MoF_nEngTstTrqCmp_C MoF_rTrqPtdFltWgh_CUR /end DEF_CHARACTERISTIC
 /begin IN_MEASUREMENT MoFESpd_nEng MoF_rTrqInrAct MoF_rTrqPtdFlt Mo_bPostDrv Mo_bPreDrv Mo_ctRst Mo_ctRstCpl Mo_stCplChk Mo_stMoC Mo_stMoCCpl Mo_stMoF Mo_stMoFCpl /end IN_MEASUREMENT
 /begin OUT_MEASUREMENT MoFTrqCmp_flgIrrvErrEngMsg MoFTrqCmp_flgTestEngMsg MoF_ctTrqCmp MoF_facTrqErrSum /end OUT_MEASUREMENT
 /begin LOC_MEASUREMENT MoFTrqCmp_flgClrEng MoF_ctTrqCmpCpl MoF_ctTstTrqCmp MoF_facTrqErrSumCpl MoF_rTrqPtdFltWgh_mp /end LOC_MEASUREMENT
 FUNCTION_VERSION "38.0.0" /end FUNCTION
/begin FUNCTION MoFTrqCmp_Max "8.0.0     Function Monitoring: Torque comparison maximum sum torque"
 /begin DEF_CHARACTERISTIC MoFTrqCmp_cntrRstTqCompMax_C MoFTrqCmp_cntrTestTqCompMax_C MoFTrqCmp_cntrTqCompMax_C MoFTrqCmp_nEngTestTqCompMax_C /end DEF_CHARACTERISTIC
 /begin IN_MEASUREMENT MoFESpd_nEng MoFTrqAct_tqSumClu MoFTrqPtd_tqCluSumPtdFildOffs Mo_bPostDrv Mo_bPreDrv Mo_ctRst Mo_ctRstCpl Mo_stCplChk Mo_stMoC Mo_stMoCCpl Mo_stMoF Mo_stMoFCpl /end IN_MEASUREMENT
 /begin OUT_MEASUREMENT MoFTrqCmp_flgErrMaxPndMsg MoFTrqCmp_flgIrrvErrMax MoFTrqCmp_flgIrrvErrMaxMsg MoFTrqCmp_flgTestTrqCmpMaxMsg /end OUT_MEASUREMENT
 /begin LOC_MEASUREMENT MoFTrqCmpMax_bbOut1Cpl MoFTrqCmp_cntrTestTqCompMax MoFTrqCmp_cntrTqCompMax MoFTrqCmp_cntrTqCompMaxCpl MoFTrqCmp_flgClrMax /end LOC_MEASUREMENT
 FUNCTION_VERSION "8.0.0" /end FUNCTION
/begin FUNCTION MoFTrqCmp_Min "8.0.0     Function Monitoring: Torque comparison minimal sum torque"
 /begin DEF_CHARACTERISTIC MoFTrqCmp_cntrTestTqCompMin_C MoFTrqCmp_cntrTqCompMin_C MoFTrqCmp_nEngTestTqCompMin_C /end DEF_CHARACTERISTIC
 /begin IN_MEASUREMENT MoFESpd_nEng MoFTrqAct_tqCrksftEm MoFTrqPtd_tqCrksftEmMinFildOffs Mo_stCplChk Mo_stMoC Mo_stMoCCpl Mo_stMoF /end IN_MEASUREMENT
 /begin OUT_MEASUREMENT MoFTrqCmp_flgErrMinPndMsg MoFTrqCmp_flgIrrvErrMin MoFTrqCmp_flgIrrvErrMinMsg MoFTrqCmp_flgTestTqCompMinMsg /end OUT_MEASUREMENT
 /begin LOC_MEASUREMENT MoFTrqCmpMin_bbOut1Cpl MoFTrqCmp_cntrTestTqCompMin MoFTrqCmp_cntrTqCompMin MoFTrqCmp_cntrTqCompMinCpl MoFTrqCmp_flgClrMin /end LOC_MEASUREMENT
 FUNCTION_VERSION "8.0.0" /end FUNCTION
/begin FUNCTION MoFTrqLim_Eng "14.2.0    Function Monitoring: Torque limits engine"
 /begin DEF_CHARACTERISTIC MoFTrqPtd_tiTrqMaxStrt_C MoFTrqPtd_tqInrMaxStrt_C MoF_facMinRTrqInrMax_C MoF_facTrqMinOvrRun_CUR MoF_rTrqInrMax_CUR MoF_trqInrMinIncr_CUR MoF_trqMinAirChrg_MAP /end DEF_CHARACTERISTIC
 /begin REF_CHARACTERISTIC MoFESpd_nEng_Ax MoF_tEng_DST Mo_trqIdcMax_C /end REF_CHARACTERISTIC
 /begin IN_MEASUREMENT MoFAirFl_etaInjCtOff MoFESpd_nEng MoFESpd_nEng_Ax_result MoFTEng_tEng MoF_tEng MoF_tEng_DST_result MoF_tiAftStrt MoF_trqLos MoX_trqInrMinWoCtOff Mo_stCplChk Mo_stMoC Mo_stMoCCpl RngMod_trqInrMax /end IN_MEASUREMENT
 /begin OUT_MEASUREMENT MoFTrqLim_tqInrMinWoCtOffMsg MoF_rTrqInrMax MoF_trqInrMinWoCtOff /end OUT_MEASUREMENT
 /begin LOC_MEASUREMENT MoF_rTrqInrMaxCpl MoF_trqInrMinWoCtOffCpl /end LOC_MEASUREMENT
 FUNCTION_VERSION "14.2.0" /end FUNCTION
/begin FUNCTION MoFTrqLos_Co "45.2.1    Function Monitoring: Torque losses"
 /begin DEF_CHARACTERISTIC MoF_trqAdap_C MoF_trqChrChg_CUR MoF_trqConvNAP1_MAP MoF_trqConvNT1_MAP MoF_trqDesAlt_MAP MoF_trqDrag_MAP MoF_trqLosTra_CUR MoF_trqLtdAC_CUR MoF_trqLtdFan_CUR MoF_trqStrgLtd_C /end DEF_CHARACTERISTIC
 /begin REF_CHARACTERISTIC MoFESpd_nEng_Ax MoF_rAPP_DST MoF_tEng_DST /end REF_CHARACTERISTIC
 /begin IN_MEASUREMENT Conv_trqLd ESS_trqDesAcs MoFESpd_nEng MoFESpd_nEng_Ax_result MoF_rAPP MoF_rAPP_DST_result MoF_tEng MoF_tEng_DST_result Mo_stCplChk Mo_stMoC Mo_stMoCCpl RngMod_trqComp RngMod_trqDiffAdap RngMod_trqLosEng Tra_trqLos TS_trqDesAcs VehMot_trqDesAcs /end IN_MEASUREMENT
 /begin OUT_MEASUREMENT MoFTrqLos_tqLosTotMsg MoFTrqPtd_tqCmpNotSwilLoss MoFTrqPtd_tqCmpSwilLoss MoF_trqAcs MoF_trqCalCompDes MoF_trqFulCompDes MoF_trqLos MoF_trqLosComp MoF_trqLosMsg MoF_trqLosPT MoF_trqLosTot /end OUT_MEASUREMENT
 /begin LOC_MEASUREMENT MoFTrqLos_tqChrgChg_mp MoFTrqLos_tqConvLd_mp MoFTrqLos_tqTraLoss_mp MoFTrqPtd_tqCmpNotSwilLossCpl MoFTrqPtd_tqCmpSwilLossCpl MoF_tqAdap MoF_tqAdapCpl MoF_trqAcsCpl MoF_trqCalCompDesCpl MoF_trqFulCompDesCpl MoF_trqLosCompCpl MoF_trqLosCpl MoF_trqLosPTCpl MoF_trqLosTotCpl /end LOC_MEASUREMENT
 FUNCTION_VERSION "45.2.1" /end FUNCTION
/begin COMPU_METHOD B_TRUE "" TAB_VERB "%6.3" "" COMPU_TAB_REF B_TRUE /end COMPU_METHOD
/begin COMPU_VTAB B_TRUE "" TAB_VERB 2 0 "FALSE" 1 "TRUE" /end COMPU_VTAB
/begin COMPU_METHOD dez "" RAT_FUNC "%6.2" "" COEFFS 0 1 0 0 0 1 /end COMPU_METHOD
/begin COMPU_METHOD fak_q0p01 "" RAT_FUNC "%6.4" "" COEFFS 0 100 0 0 0 1 /end COMPU_METHOD
/begin COMPU_METHOD fak_q6p1035Em5_AFm16 "" RAT_FUNC "%17.12" "-" COEFFS 0 16384 0 0 0 1 /end COMPU_METHOD
/begin COMPU_METHOD fak_ub_b1 "" RAT_FUNC "%6.4" "-" COEFFS 0 256 0 0 0 1 /end COMPU_METHOD
/begin COMPU_METHOD fak_ub_b2 "" RAT_FUNC "%8.5" "-" COEFFS 0 256 0 0 0 2 /end COMPU_METHOD
/begin COMPU_METHOD md_q0p1 "" RAT_FUNC "%6.3" "Nm" COEFFS 0 10 0 0 0 1 /end COMPU_METHOD
/begin COMPU_METHOD md_q1p6 "" RAT_FUNC "%6.2" "Nm" COEFFS 0 10 0 0 0 16 /end COMPU_METHOD
/begin COMPU_METHOD Mo_t_DegC_q0p8o48 "" RAT_FUNC "%6.2" "Deg C" COEFFS 0 5 240 0 0 4 /end COMPU_METHOD
/begin COMPU_METHOD m_ub_b1020 "" RAT_FUNC "%6.2" "kg/h" COEFFS 0 1 0 0 0 4 /end COMPU_METHOD
/begin COMPU_METHOD nmot_q0p5 "" RAT_FUNC "%6.3" "1/min" COEFFS 0 2 0 0 0 1 /end COMPU_METHOD
/begin COMPU_METHOD nmot_q40 "" RAT_FUNC "%6.1" "1/min" COEFFS 0 1 0 0 0 40 /end COMPU_METHOD
/begin COMPU_METHOD OneToOne "" RAT_FUNC "%6.2" "-" COEFFS 0 1 0 0 0 1 /end COMPU_METHOD
/begin COMPU_METHOD relPED_q0p02441 "" RAT_FUNC "%6.4" "% PED" COEFFS 0 4096 0 0 0 100 /end COMPU_METHOD
/begin COMPU_METHOD rel_q0p00195_pc_s "" RAT_FUNC "%6.4" "%*s" COEFFS 0 65536 0 0 0 128 /end COMPU_METHOD
/begin COMPU_METHOD rel_q0p39 "" RAT_FUNC "%6.3" "%" COEFFS 0 256 0 0 0 100 /end COMPU_METHOD
/begin COMPU_METHOD rel_uw_b100 "" RAT_FUNC "%6.4" "%" COEFFS 0 65536 0 0 0 100 /end COMPU_METHOD
/begin COMPU_METHOD rel_uw_q0p0234 "" RAT_FUNC "%6.4" "%" COEFFS 0 32 0 0 0 0.75 /end COMPU_METHOD
/begin COMPU_METHOD SY_LSFVVK_Compu "" TAB_VERB "%6.3" "" COMPU_TAB_REF SY_LSFVVK_Compu /end COMPU_METHOD
/begin COMPU_VTAB SY_LSFVVK_Compu "" TAB_VERB 2 0 "keine LSF vor Vorkatalysator vorhanden" 1 "LSF vor Vorkatalysator vorhanden" /end COMPU_VTAB
/begin COMPU_METHOD SY_LSFV_Compu "" TAB_VERB "%6.3" "" COMPU_TAB_REF SY_LSFV_Compu /end COMPU_METHOD
/begin COMPU_VTAB SY_LSFV_Compu "" TAB_VERB 2 0 "keine Diag.vertauschte Sonden hinter FrontKat" 1 "Diagnose vertauschte Sonden hinter FrontKat" /end COMPU_VTAB
/begin COMPU_METHOD SY_LSHV_Compu "" TAB_VERB "%6.3" "" COMPU_TAB_REF SY_LSHV_Compu /end COMPU_METHOD
/begin COMPU_VTAB SY_LSHV_Compu "" TAB_VERB 2 0 "keine vertauschte Sonde hinter Kat im System" 1 "vertauschte Sonde hinter Kat im System vorhanden" /end COMPU_VTAB
/begin COMPU_METHOD SY_LSUIKR2_Compu "" TAB_VERB "%6.3" "" COMPU_TAB_REF SY_LSUIKR2_Compu /end COMPU_METHOD
/begin COMPU_VTAB SY_LSUIKR2_Compu "" TAB_VERB 2 0 "keine LSU im Abgaskrümmer Bank2 vorhanden" 1 "LSU im Abgaskrümmer Bank2 vorhanden" /end COMPU_VTAB
/begin COMPU_METHOD SY_LSUIKR_Compu "" TAB_VERB "%6.3" "" COMPU_TAB_REF SY_LSUIKR_Compu /end COMPU_METHOD
/begin COMPU_VTAB SY_LSUIKR_Compu "" TAB_VERB 2 0 "keine LSU im Abgaskrümmer vorhanden" 1 "LSU im Abgaskrümmer vorhanden" /end COMPU_VTAB
/begin COMPU_METHOD SY_LSUNHK2_Compu "" TAB_VERB "%6.3" "" COMPU_TAB_REF SY_LSUNHK2_Compu /end COMPU_METHOD
/begin COMPU_VTAB SY_LSUNHK2_Compu "" TAB_VERB 2 0 "LSU nicht nach Hauptkat, Bank2 verbaut" 1 "LSU nach Hauptkat, Bank2 verbaut" /end COMPU_VTAB
/begin COMPU_METHOD SY_LSUNHK_Compu "" TAB_VERB "%6.3" "" COMPU_TAB_REF SY_LSUNHK_Compu /end COMPU_METHOD
/begin COMPU_VTAB SY_LSUNHK_Compu "" TAB_VERB 2 0 "keine LSU nach Hauptkatalysator" 1 "LSU nach Hauptkatalysator" /end COMPU_VTAB
/begin COMPU_METHOD SY_LSUNTL2_Compu "" TAB_VERB "%6.3" "" COMPU_TAB_REF SY_LSUNTL2_Compu /end COMPU_METHOD
/begin COMPU_VTAB SY_LSUNTL2_Compu "" TAB_VERB 2 0 "keine LSU nach Abgasturbolader, Bank2" 1 "LSU nach Abgasturbolader, Bank2" /end COMPU_VTAB
/begin COMPU_METHOD SY_LSUNTL_Compu "" TAB_VERB "%6.3" "" COMPU_TAB_REF SY_LSUNTL_Compu /end COMPU_METHOD
/begin COMPU_VTAB SY_LSUNTL_Compu "" TAB_VERB 2 0 "keine LSU nach Abgasturbolader" 1 "LSU nach Abgasturbolader" /end COMPU_VTAB
/begin COMPU_METHOD SY_LSUNVK2_Compu "" TAB_VERB "%6.3" "" COMPU_TAB_REF SY_LSUNVK2_Compu /end COMPU_METHOD
/begin COMPU_VTAB SY_LSUNVK2_Compu "" TAB_VERB 2 0 "keine LSU nach Vorkat, Bank 2" 1 "LSU nach Vorkatalysator, Bank 2 verbaut" /end COMPU_VTAB
/begin COMPU_METHOD SY_LSUNVK_Compu "" TAB_VERB "%6.3" "" COMPU_TAB_REF SY_LSUNVK_Compu /end COMPU_METHOD
/begin COMPU_VTAB SY_LSUNVK_Compu "" TAB_VERB 2 0 "keine LSU nach Vorkatalysator" 1 "LSU nach Vorkatalysator" /end COMPU_VTAB
/begin COMPU_METHOD SY_LSUVHK2_Compu "" TAB_VERB "%6.3" "" COMPU_TAB_REF SY_LSUVHK2_Compu /end COMPU_METHOD
/begin COMPU_VTAB SY_LSUVHK2_Compu "" TAB_VERB 2 0 "keine LSU vor Hauptkatalysator, Bank 2 verbaut" 1 "LSU vor Hauptkatalysator, Bank 2 verbaut" /end COMPU_VTAB
/begin COMPU_METHOD SY_LSUVHK_Compu "" TAB_VERB "%6.3" "" COMPU_TAB_REF SY_LSUVHK_Compu /end COMPU_METHOD
/begin COMPU_VTAB SY_LSUVHK_Compu "" TAB_VERB 2 0 "keine LSU vor Hauptkatalysator" 1 "LSU vor Hauptkatalysator" /end COMPU_VTAB
/begin COMPU_METHOD SY_LSUVVK2_Compu "" TAB_VERB "%6.3" "" COMPU_TAB_REF SY_LSUVVK2_Compu /end COMPU_METHOD
/begin COMPU_VTAB SY_LSUVVK2_Compu "" TAB_VERB 2 0 "keine LSU vor Vorkatalysator, Bank2" 1 "LSU vor Vorkatalysator, Bank2" /end COMPU_VTAB
/begin COMPU_METHOD SY_LSUVVK_Compu "" TAB_VERB "%6.3" "" COMPU_TAB_REF SY_LSUVVK_Compu /end COMPU_METHOD
/begin COMPU_VTAB SY_LSUVVK_Compu "" TAB_VERB 2 0 "keine LSU vor Vorkatalysator" 1 "LSU vor Vorkatalysator" /end COMPU_VTAB
/begin COMPU_METHOD SY_LSVV_Compu "" TAB_VERB "%6.3" "" COMPU_TAB_REF SY_LSVV_Compu /end COMPU_METHOD
/begin COMPU_VTAB SY_LSVV_Compu "" TAB_VERB 2 0 "keine Diag.vertauschte Sonden vor Vorkat" 1 "Diagnose vertauschte Sonden vor Vorkat vorhanden" /end COMPU_VTAB
/begin COMPU_METHOD SY_LSZYVER_Compu "" TAB_VERB "%6.3" "" COMPU_TAB_REF SY_LSZYVER_Compu /end COMPU_METHOD
/begin COMPU_VTAB SY_LSZYVER_Compu "" TAB_VERB 2 0 "False" 1 "True" /end COMPU_VTAB
/begin COMPU_METHOD SY_LS_Compu "" TAB_VERB "%6.3" "" COMPU_TAB_REF SY_LS_Compu /end COMPU_METHOD
/begin COMPU_VTAB SY_LS_Compu "" TAB_VERB 2 0 "Lambda-Split nicht vorhanden" 1 "Lambda-Split vorhanden" /end COMPU_VTAB
/begin COMPU_METHOD SY_LUFAK_Compu "" RAT_FUNC "%6.2" "" COEFFS 0 1 0 0 0 1 /end COMPU_METHOD
/begin COMPU_METHOD SY_LUSRKR_Compu "" TAB_VERB "%6.3" "" COMPU_TAB_REF SY_LUSRKR_Compu /end COMPU_METHOD
/begin COMPU_VTAB SY_LUSRKR_Compu "" TAB_VERB 3 0 "no Scavenging" 1 "Scavenging with Inlet Cam Phasing" 2 "Scavenging with Inlet and Exhaust Cam Phasing" /end COMPU_VTAB
/begin COMPU_METHOD SY_LWMEXT_Compu "" TAB_VERB "%6.3" "" COMPU_TAB_REF SY_LWMEXT_Compu /end COMPU_METHOD
/begin COMPU_VTAB SY_LWMEXT_Compu "" TAB_VERB 4 0 "ValuesOfBGLWMFromBGLWM" 1 "ValuesOfBGLWMFromBGLWMwithBGLWMintegrated" 2 "ValuesOfBGLWMFromBGLWMwithBGLWMNotintegrated" 3 "Values of BGLWM from external function" /end COMPU_VTAB
/begin COMPU_METHOD SY_M8TE_Compu "" TAB_VERB "%6.3" "" COMPU_TAB_REF SY_M8TE_Compu /end COMPU_METHOD
/begin COMPU_VTAB SY_M8TE_Compu "" TAB_VERB 2 0 "False" 1 "True" /end COMPU_VTAB
/begin COMPU_METHOD SY_MAGER_Compu "" TAB_VERB "%6.3" "" COMPU_TAB_REF SY_MAGER_Compu /end COMPU_METHOD
/begin COMPU_VTAB SY_MAGER_Compu "" TAB_VERB 2 0 "kein Magerbetrieb erlaubt" 1 "Magerbetrieb erlaubt" /end COMPU_VTAB
/begin COMPU_METHOD SY_MDBGHS_Compu "" TAB_VERB "%6.3" "" COMPU_TAB_REF SY_MDBGHS_Compu /end COMPU_METHOD
/begin COMPU_VTAB SY_MDBGHS_Compu "" TAB_VERB 2 0 "False" 1 "True" /end COMPU_VTAB
/begin COMPU_METHOD SY_MDBGTI_Compu "" TAB_VERB "%6.3" "" COMPU_TAB_REF SY_MDBGTI_Compu /end COMPU_METHOD
/begin COMPU_VTAB SY_MDBGTI_Compu "" TAB_VERB 2 0 "0" 1 "1" /end COMPU_VTAB
/begin COMPU_METHOD SY_MDISTM_Compu "" TAB_VERB "%6.3" "" COMPU_TAB_REF SY_MDISTM_Compu /end COMPU_METHOD
/begin COMPU_VTAB SY_MDISTM_Compu "" TAB_VERB 2 0 "keine Modellierung eines mittleren Ist-Drehmomente" 1 "Bereitstellung eines mittleren Ist-Drehmomentes" /end COMPU_VTAB
/begin COMPU_METHOD SY_MDI_Compu "" TAB_VERB "%6.3" "" COMPU_TAB_REF SY_MDI_Compu /end COMPU_METHOD
/begin COMPU_VTAB SY_MDI_Compu "" TAB_VERB 2 0 "False" 1 "True" /end COMPU_VTAB
/begin COMPU_METHOD SY_MDMXEXC_Compu "" TAB_VERB "%6.3" "" COMPU_TAB_REF SY_MDMXEXC_Compu /end COMPU_METHOD
/begin COMPU_VTAB SY_MDMXEXC_Compu "" TAB_VERB 2 0 "False" 1 "True" /end COMPU_VTAB
/begin COMPU_METHOD SY_MEVD172_Compu "" RAT_FUNC "%6.2" "" COEFFS 0 1 0 0 0 1 /end COMPU_METHOD
/begin COMPU_METHOD SY_MSDKN_Compu "" TAB_VERB "%6.3" "" COMPU_TAB_REF SY_MSDKN_Compu /end COMPU_METHOD
/begin COMPU_VTAB SY_MSDKN_Compu "" TAB_VERB 2 0 "False" 1 "True" /end COMPU_VTAB
/begin COMPU_METHOD SY_MSGRED_Compu "" TAB_VERB "%6.3" "" COMPU_TAB_REF SY_MSGRED_Compu /end COMPU_METHOD
/begin COMPU_VTAB SY_MSGRED_Compu "" TAB_VERB 2 0 "False" 1 "True" /end COMPU_VTAB
/begin COMPU_METHOD SY_MSVKOMP_Compu "" TAB_VERB "%6.3" "" COMPU_TAB_REF SY_MSVKOMP_Compu /end COMPU_METHOD
/begin COMPU_VTAB SY_MSVKOMP_Compu "" TAB_VERB 10 0 "MSV-Ansteuerung Förderenderegelung, z.B. HDP2" 1 "MSV-Ansteuerung Förderbeginnregelung, z.B. Hitachi" 2 "MSV_DBCTR_PWM" 3 "MSV_SAC" 4 "MSV_Hitachi_Generation3" 5 "MSV_Hitachi_Generation1" 6 "MSV_Hitachi_RB" 7 "MSV_RB_HDP5evo" 8 "MSV_RB_HDP5-MSV_RB_HDP5evo" 9 "MSV_Conti_RB" /end COMPU_VTAB
/begin COMPU_METHOD SY_MTRXBLR_Compu "" TAB_VERB "%6.3" "" COMPU_TAB_REF SY_MTRXBLR_Compu /end COMPU_METHOD
/begin COMPU_VTAB SY_MTRXBLR_Compu "" TAB_VERB 2 0 "False" 1 "True" /end COMPU_VTAB
/begin COMPU_METHOD SY_NG_Compu "" TAB_VERB "%6.3" "" COMPU_TAB_REF SY_NG_Compu /end COMPU_METHOD
/begin COMPU_VTAB SY_NG_Compu "" TAB_VERB 4 0 "SY_NG_0" 1 "SY_NG_1" 2 "SY_NG_2" 3 "SY_NG_3" /end COMPU_VTAB
/begin COMPU_METHOD SY_NLLKHFH_Compu "" TAB_VERB "%6.3" "" COMPU_TAB_REF SY_NLLKHFH_Compu /end COMPU_METHOD
/begin COMPU_VTAB SY_NLLKHFH_Compu "" TAB_VERB 2 0 "SY_NLLKHFH=0" 1 "SY_NLLKHFH=1" /end COMPU_VTAB
/begin COMPU_METHOD SY_NLZOFF_Compu "" TAB_VERB "%6.3" "" COMPU_TAB_REF SY_NLZOFF_Compu /end COMPU_METHOD
/begin COMPU_VTAB SY_NLZOFF_Compu "" TAB_VERB 2 0 "false" 1 "true" /end COMPU_VTAB
/begin COMPU_METHOD SY_NOHK_Compu "" TAB_VERB "%6.3" "" COMPU_TAB_REF SY_NOHK_Compu /end COMPU_METHOD
/begin COMPU_VTAB SY_NOHK_Compu "" TAB_VERB 2 0 "kein NOx-Sensor hinter Kat" 1 "NOx-Sensor hinter Kat" /end COMPU_VTAB
/begin COMPU_METHOD SY_NOKT_Compu "" TAB_VERB "%6.3" "" COMPU_TAB_REF SY_NOKT_Compu /end COMPU_METHOD
/begin COMPU_VTAB SY_NOKT_Compu "" TAB_VERB 2 0 "no" 1 "dzwzk" /end COMPU_VTAB
/begin COMPU_METHOD SY_NOXKAT2_Compu "" TAB_VERB "%6.3" "" COMPU_TAB_REF SY_NOXKAT2_Compu /end COMPU_METHOD
/begin COMPU_VTAB SY_NOXKAT2_Compu "" TAB_VERB 2 0 "NOx-Speicherkat in Abgassystem nicht verbaut" 1 "NOx-Speicherkat in Abgassystem verbaut" /end COMPU_VTAB
/begin COMPU_METHOD SY_NOXKAT_Compu "" TAB_VERB "%6.3" "" COMPU_TAB_REF SY_NOXKAT_Compu /end COMPU_METHOD
/begin COMPU_VTAB SY_NOXKAT_Compu "" TAB_VERB 2 0 "kein NOx-Speicherkat vorhanden" 1 "NOx-Speicherkat vorhanden" /end COMPU_VTAB
/begin COMPU_METHOD SY_NSAC_Compu "" RAT_FUNC "%6.2" "" COEFFS 0 1 0 0 0 1 /end COMPU_METHOD
/begin COMPU_METHOD SY_NSAD_Compu "" TAB_VERB "%6.3" "" COMPU_TAB_REF SY_NSAD_Compu /end COMPU_METHOD
/begin COMPU_VTAB SY_NSAD_Compu "" TAB_VERB 2 0 "keine Nachstartadaption" 1 "Nachstartadaption" /end COMPU_VTAB
/begin COMPU_METHOD SY_NSALT_Compu "" RAT_FUNC "%6.2" "" COEFFS 0 1 0 0 0 1 /end COMPU_METHOD
/begin COMPU_METHOD SY_NSASG_Compu "" RAT_FUNC "%6.2" "" COEFFS 0 1 0 0 0 1 /end COMPU_METHOD
/begin COMPU_METHOD SY_NSBLP_Compu "" RAT_FUNC "%6.2" "" COEFFS 0 1 0 0 0 1 /end COMPU_METHOD
/begin COMPU_METHOD SY_NSCAM_Compu "" RAT_FUNC "%6.2" "" COEFFS 0 1 0 0 0 1 /end COMPU_METHOD
/begin COMPU_METHOD SY_NSCAT_Compu "" RAT_FUNC "%6.2" "" COEFFS 0 1 0 0 0 1 /end COMPU_METHOD
/begin COMPU_METHOD SY_NSCDE_Compu "" RAT_FUNC "%6.2" "" COEFFS 0 1 0 0 0 1 /end COMPU_METHOD
/begin COMPU_METHOD SY_NSCRP_Compu "" RAT_FUNC "%6.2" "" COEFFS 0 1 0 0 0 1 /end COMPU_METHOD
/begin COMPU_METHOD SY_NSCVT_Compu "" RAT_FUNC "%6.2" "" COEFFS 0 1 0 0 0 1 /end COMPU_METHOD
/begin COMPU_METHOD temp_q4p4703Em8_om48_DegC "" RAT_FUNC "%6.2" "Grad C" COEFFS 0 67108864 3221225472 0 0 3 /end COMPU_METHOD
/begin COMPU_METHOD temp_q7p324Em4_DegC "" RAT_FUNC "%6.5" "Grad C" COEFFS 0 4096 0 0 0 3 /end COMPU_METHOD
/begin COMPU_METHOD temp_qn7p324Em4_DegC "" RAT_FUNC "%8.7" "Grad C" COEFFS 0 -4096 0 0 0 3 /end COMPU_METHOD
/begin COMPU_METHOD temp_ub_q0p75_o48 "" RAT_FUNC "%6.2" "Grad C" COEFFS 0 1 48 0 0 0.75 /end COMPU_METHOD
/begin COMPU_METHOD TransR "" RAT_FUNC "%6.4" "-" COEFFS 0 100 0 0 0 1 /end COMPU_METHOD
/begin COMPU_METHOD t_q0p04 "" RAT_FUNC "%6.4" "s" COEFFS 0 100 0 0 0 4 /end COMPU_METHOD
/begin COMPU_METHOD vel_q0p01 "" RAT_FUNC "%6.4" "km/h" COEFFS 0 100 0 0 0 1 /end COMPU_METHOD
/begin COMPU_METHOD zw_q0p1 "" RAT_FUNC "%6.3" "Grad KW" COEFFS 0 10 0 0 0 1 /end COMPU_METHOD
/begin COMPU_METHOD zw_sb_q0p75 "" RAT_FUNC "%6.3" "Grad KW" COEFFS 0 255 0 0 0 191.25 /end COMPU_METHOD
/begin RECORD_LAYOUT Axis_Xu16 NO_AXIS_PTS_X 1 UWORD AXIS_PTS_X 2 UWORD INDEX_INCR DIRECT /end RECORD_LAYOUT
/begin RECORD_LAYOUT Axis_Xu8 NO_AXIS_PTS_X 1 UBYTE AXIS_PTS_X 2 UBYTE INDEX_INCR DIRECT /end RECORD_LAYOUT
/begin RECORD_LAYOUT MapG_Wu16 FNC_VALUES 1 UWORD COLUMN_DIR DIRECT /end RECORD_LAYOUT
/begin RECORD_LAYOUT MapG_Wu8 FNC_VALUES 1 UBYTE COLUMN_DIR DIRECT /end RECORD_LAYOUT
/begin RECORD_LAYOUT Map_Xs16Ys16Ws16 NO_AXIS_PTS_X 1 SWORD NO_AXIS_PTS_Y 2 SWORD AXIS_PTS_X 3 SWORD INDEX_INCR DIRECT AXIS_PTS_Y 4 SWORD INDEX_INCR DIRECT FNC_VALUES 5 SWORD COLUMN_DIR DIRECT /end RECORD_LAYOUT
/begin RECORD_LAYOUT Map_Xu8Yu8Wu8 NO_AXIS_PTS_X 1 UBYTE NO_AXIS_PTS_Y 2 UBYTE AXIS_PTS_X 3 UBYTE INDEX_INCR DIRECT AXIS_PTS_Y 4 UBYTE INDEX_INCR DIRECT FNC_VALUES 5 UBYTE COLUMN_DIR DIRECT /end RECORD_LAYOUT
/begin RECORD_LAYOUT Mo_DataCurveSstS16WS16 NO_AXIS_PTS_X 1 SWORD AXIS_PTS_X 2 SWORD INDEX_INCR DIRECT FNC_VALUES 3 SWORD COLUMN_DIR DIRECT /end RECORD_LAYOUT
/begin RECORD_LAYOUT Mo_DataCurveSstU8WU8 NO_AXIS_PTS_X 1 UBYTE AXIS_PTS_X 2 UBYTE INDEX_INCR DIRECT FNC_VALUES 3 UBYTE COLUMN_DIR DIRECT /end RECORD_LAYOUT
/begin RECORD_LAYOUT ValA_Wu8 FNC_VALUES 1 UBYTE COLUMN_DIR DIRECT /end RECORD_LAYOUT
/begin RECORD_LAYOUT Val_Ws16 FNC_VALUES 1 SWORD COLUMN_DIR DIRECT /end RECORD_LAYOUT
/begin RECORD_LAYOUT Val_Wu16 FNC_VALUES 1 UWORD COLUMN_DIR DIRECT /end RECORD_LAYOUT
/begin RECORD_LAYOUT Val_Wu32 FNC_VALUES 1 ULONG COLUMN_DIR DIRECT /end RECORD_LAYOUT
/begin RECORD_LAYOUT Val_Wu8 FNC_VALUES 1 UBYTE COLUMN_DIR DIRECT /end RECORD_LAYOUT
/end MODULE
/end PROJECT
