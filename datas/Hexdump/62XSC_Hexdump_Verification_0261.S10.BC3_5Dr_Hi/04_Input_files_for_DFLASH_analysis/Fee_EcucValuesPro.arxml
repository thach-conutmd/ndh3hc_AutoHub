AUTOSAR XML (schema 4-1-1)
package /RB/UBK/Project/EcucModuleConfigurationValuess
  module config Fee
    181 x FeeBlockConfiguration, all with FeeRbCallbackEnd=NULL_PTR, FeeRbCallbackError=NULL_PTR, FeeRbDeviceIndex=0:
      BSWM_CFG_NVM_BLOCK: FeeBlockSize=2, FeeImmediateData=false, FeeNumberOfWriteCycles=1, FeeRbBlockPersistentId=46303, FeeRbFirstReadDataMigration=false, FeeRbNoFallback=false, FeeRbOrigin=NVM, FeeRbSecLevel=1, FeeRbSurvival=false, FeeRbVarBlockLength=false
      DCM_CALIBID: FeeBlockSize=16, FeeImmediateData=false, FeeNumberOfWriteCycles=1, FeeRbBlockPersistentId=21397, FeeRbFirstReadDataMigration=false, FeeRbNoFallback=false, FeeRbOrigin=NVM, FeeRbSecLevel=1, FeeRbSurvival=false, FeeRbVarBlockLength=false
      DCM_ECUID: FeeBlockSize=10, FeeImmediateData=false, FeeNumberOfWriteCycles=1, FeeRbBlockPersistentId=42366, FeeRbFirstReadDataMigration=false, FeeRbNoFallback=false, FeeRbOrigin=NVM, FeeRbSecLevel=1, FeeRbSurvival=false, FeeRbVarBlockLength=false
      DCM_PD: FeeBlockSize=4, FeeImmediateData=false, FeeNumberOfWriteCycles=1, FeeRbBlockPersistentId=27069, FeeRbFirstReadDataMigration=false, FeeRbNoFallback=false, FeeRbOrigin=NVM, FeeRbSecLevel=1, FeeRbSurvival=false, FeeRbVarBlockLength=false
      DCM_PROGID: FeeBlockSize=14, FeeImmediateData=false, FeeNumberOfWriteCycles=1, FeeRbBlockPersistentId=15515, FeeRbFirstReadDataMigration=false, FeeRbNoFallback=false, FeeRbOrigin=NVM, FeeRbSecLevel=1, FeeRbSurvival=false, FeeRbVarBlockLength=false
      DCM_REWREVE_CNTERASEREQ: FeeBlockSize=1, FeeImmediateData=false, FeeNumberOfWriteCycles=1, FeeRbBlockPersistentId=53069, FeeRbFirstReadDataMigration=false, FeeRbNoFallback=false, FeeRbOrigin=NVM, FeeRbSecLevel=1, FeeRbSurvival=false, FeeRbVarBlockLength=false
      DCM_REWREVE_CNTPROGSESSIONWITHERASEREQ: FeeBlockSize=1, FeeImmediateData=false, FeeNumberOfWriteCycles=1, FeeRbBlockPersistentId=59638, FeeRbFirstReadDataMigration=false, FeeRbNoFallback=false, FeeRbOrigin=NVM, FeeRbSecLevel=1, FeeRbSurvival=false, FeeRbVarBlockLength=false
      DCM_REWREVE_INFOVALID: FeeBlockSize=2, FeeImmediateData=false, FeeNumberOfWriteCycles=1, FeeRbBlockPersistentId=52040, FeeRbFirstReadDataMigration=false, FeeRbNoFallback=false, FeeRbOrigin=NVM, FeeRbSecLevel=1, FeeRbSurvival=false, FeeRbVarBlockLength=false
      DCM_RSCOTSN: FeeBlockSize=10, FeeImmediateData=false, FeeNumberOfWriteCycles=1, FeeRbBlockPersistentId=6563, FeeRbFirstReadDataMigration=false, FeeRbNoFallback=false, FeeRbOrigin=NVM, FeeRbSecLevel=1, FeeRbSurvival=false, FeeRbVarBlockLength=false
      DCM_SECACOEFF: FeeBlockSize=6, FeeImmediateData=false, FeeNumberOfWriteCycles=1, FeeRbBlockPersistentId=45557, FeeRbFirstReadDataMigration=false, FeeRbNoFallback=false, FeeRbOrigin=NVM, FeeRbSecLevel=1, FeeRbSurvival=false, FeeRbVarBlockLength=false
      DCM_SIGNALG_KEYID: FeeBlockSize=3, FeeImmediateData=false, FeeNumberOfWriteCycles=1, FeeRbBlockPersistentId=33774, FeeRbFirstReadDataMigration=false, FeeRbNoFallback=false, FeeRbOrigin=NVM, FeeRbSecLevel=1, FeeRbSurvival=false, FeeRbVarBlockLength=false
      DCM_SWHIST: FeeBlockSize=8, FeeImmediateData=false, FeeNumberOfWriteCycles=1, FeeRbBlockPersistentId=65521, FeeRbFirstReadDataMigration=false, FeeRbNoFallback=false, FeeRbOrigin=NVM, FeeRbSecLevel=1, FeeRbSurvival=false, FeeRbVarBlockLength=false
      DCM_SWVERSID: FeeBlockSize=6, FeeImmediateData=false, FeeNumberOfWriteCycles=1, FeeRbBlockPersistentId=33217, FeeRbFirstReadDataMigration=false, FeeRbNoFallback=false, FeeRbOrigin=NVM, FeeRbSecLevel=1, FeeRbSurvival=false, FeeRbVarBlockLength=false
      DCM_VIN: FeeBlockSize=17, FeeImmediateData=false, FeeNumberOfWriteCycles=1, FeeRbBlockPersistentId=18707, FeeRbFirstReadDataMigration=false, FeeRbNoFallback=false, FeeRbOrigin=NVM, FeeRbSecLevel=1, FeeRbSurvival=false, FeeRbVarBlockLength=false
      DCM_VINEXTN: FeeBlockSize=3, FeeImmediateData=false, FeeNumberOfWriteCycles=1, FeeRbBlockPersistentId=10686, FeeRbFirstReadDataMigration=false, FeeRbNoFallback=false, FeeRbOrigin=NVM, FeeRbSecLevel=1, FeeRbSurvival=false, FeeRbVarBlockLength=false
      DCM_VINLEN: FeeBlockSize=1, FeeImmediateData=false, FeeNumberOfWriteCycles=1, FeeRbBlockPersistentId=35657, FeeRbFirstReadDataMigration=false, FeeRbNoFallback=false, FeeRbOrigin=NVM, FeeRbSecLevel=1, FeeRbSurvival=false, FeeRbVarBlockLength=false
      DCM_VPIDATA: FeeBlockSize=12, FeeImmediateData=false, FeeNumberOfWriteCycles=1, FeeRbBlockPersistentId=17029, FeeRbFirstReadDataMigration=false, FeeRbNoFallback=false, FeeRbOrigin=NVM, FeeRbSecLevel=1, FeeRbSurvival=false, FeeRbVarBlockLength=false
      DRIVE_PRDS_BNK0BLK00_NVM: FeeBlockSize=600, FeeImmediateData=false, FeeNumberOfWriteCycles=1, FeeRbBlockPersistentId=7016, FeeRbFirstReadDataMigration=false, FeeRbNoFallback=false, FeeRbOrigin=NVM, FeeRbSecLevel=1, FeeRbSurvival=false, FeeRbVarBlockLength=false
      DRIVE_PRDS_BNK0BLK01_NVM: FeeBlockSize=2625, FeeImmediateData=false, FeeNumberOfWriteCycles=1, FeeRbBlockPersistentId=4721, FeeRbFirstReadDataMigration=false, FeeRbNoFallback=false, FeeRbOrigin=NVM, FeeRbSecLevel=1, FeeRbSurvival=false, FeeRbVarBlockLength=false
      DRIVE_PRDS_BNK0BLK02_NVM: FeeBlockSize=675, FeeImmediateData=false, FeeNumberOfWriteCycles=1, FeeRbBlockPersistentId=6418, FeeRbFirstReadDataMigration=false, FeeRbNoFallback=false, FeeRbOrigin=NVM, FeeRbSecLevel=1, FeeRbSurvival=false, FeeRbVarBlockLength=false
      DRIVE_PRDS_BNK0BLK04_NVM: FeeBlockSize=750, FeeImmediateData=false, FeeNumberOfWriteCycles=1, FeeRbBlockPersistentId=7773, FeeRbFirstReadDataMigration=false, FeeRbNoFallback=false, FeeRbOrigin=NVM, FeeRbSecLevel=1, FeeRbSurvival=false, FeeRbVarBlockLength=false
      DRIVE_PRDS_BNK0BLK05_NVM: FeeBlockSize=150, FeeImmediateData=false, FeeNumberOfWriteCycles=1, FeeRbBlockPersistentId=7461, FeeRbFirstReadDataMigration=false, FeeRbNoFallback=false, FeeRbOrigin=NVM, FeeRbSecLevel=1, FeeRbSurvival=false, FeeRbVarBlockLength=false
      DRIVE_PRDS_BNK0BLK06_NVM: FeeBlockSize=615, FeeImmediateData=false, FeeNumberOfWriteCycles=1, FeeRbBlockPersistentId=7253, FeeRbFirstReadDataMigration=false, FeeRbNoFallback=false, FeeRbOrigin=NVM, FeeRbSecLevel=1, FeeRbSurvival=false, FeeRbVarBlockLength=false
      DRIVE_PRDS_BNK0BLK07_NVM: FeeBlockSize=180, FeeImmediateData=false, FeeNumberOfWriteCycles=1, FeeRbBlockPersistentId=8070, FeeRbFirstReadDataMigration=false, FeeRbNoFallback=false, FeeRbOrigin=NVM, FeeRbSecLevel=1, FeeRbSurvival=false, FeeRbVarBlockLength=false
      DRIVE_PRDS_BNK0BLK09_NVM: FeeBlockSize=165, FeeImmediateData=false, FeeNumberOfWriteCycles=1, FeeRbBlockPersistentId=794, FeeRbFirstReadDataMigration=false, FeeRbNoFallback=false, FeeRbOrigin=NVM, FeeRbSecLevel=1, FeeRbSurvival=false, FeeRbVarBlockLength=false
      DRIVE_PRDS_BNK0BLK0A_NVM: FeeBlockSize=720, FeeImmediateData=false, FeeNumberOfWriteCycles=1, FeeRbBlockPersistentId=31464, FeeRbFirstReadDataMigration=false, FeeRbNoFallback=false, FeeRbOrigin=NVM, FeeRbSecLevel=1, FeeRbSurvival=false, FeeRbVarBlockLength=false
      DRIVE_PRDS_BNK0BLK0B_NVM: FeeBlockSize=720, FeeImmediateData=false, FeeNumberOfWriteCycles=1, FeeRbBlockPersistentId=31081, FeeRbFirstReadDataMigration=false, FeeRbNoFallback=false, FeeRbOrigin=NVM, FeeRbSecLevel=1, FeeRbSurvival=false, FeeRbVarBlockLength=false
      DRIVE_PRDS_BNK0BLK0C_NVM: FeeBlockSize=1450, FeeImmediateData=false, FeeNumberOfWriteCycles=1, FeeRbBlockPersistentId=32531, FeeRbFirstReadDataMigration=false, FeeRbNoFallback=false, FeeRbOrigin=NVM, FeeRbSecLevel=1, FeeRbSurvival=false, FeeRbVarBlockLength=false
      DRIVE_PRDS_BNK0BLK0D_NVM: FeeBlockSize=960, FeeImmediateData=false, FeeNumberOfWriteCycles=1, FeeRbBlockPersistentId=32635, FeeRbFirstReadDataMigration=false, FeeRbNoFallback=false, FeeRbOrigin=NVM, FeeRbSecLevel=1, FeeRbSurvival=false, FeeRbVarBlockLength=false
      DRIVE_PRDS_BNK0BLK0E_NVM: FeeBlockSize=30, FeeImmediateData=false, FeeNumberOfWriteCycles=1, FeeRbBlockPersistentId=32165, FeeRbFirstReadDataMigration=false, FeeRbNoFallback=false, FeeRbOrigin=NVM, FeeRbSecLevel=1, FeeRbSurvival=false, FeeRbVarBlockLength=false
      DRIVE_PRDS_BNK0BLK0F_NVM: FeeBlockSize=41, FeeImmediateData=false, FeeNumberOfWriteCycles=1, FeeRbBlockPersistentId=32275, FeeRbFirstReadDataMigration=false, FeeRbNoFallback=false, FeeRbOrigin=NVM, FeeRbSecLevel=1, FeeRbSurvival=false, FeeRbVarBlockLength=false
      DRIVE_PRDS_BNK0BLK10_NVM: FeeBlockSize=42, FeeImmediateData=false, FeeNumberOfWriteCycles=1, FeeRbBlockPersistentId=2066, FeeRbFirstReadDataMigration=false, FeeRbNoFallback=false, FeeRbOrigin=NVM, FeeRbSecLevel=1, FeeRbSurvival=false, FeeRbVarBlockLength=false
      DRIVE_PRDS_BNK0BLK11_NVM: FeeBlockSize=42, FeeImmediateData=false, FeeNumberOfWriteCycles=1, FeeRbBlockPersistentId=2322, FeeRbFirstReadDataMigration=false, FeeRbNoFallback=false, FeeRbOrigin=NVM, FeeRbSecLevel=1, FeeRbSurvival=false, FeeRbVarBlockLength=false
      DRIVE_PRDS_BNK0BLK12_NVM: FeeBlockSize=42, FeeImmediateData=false, FeeNumberOfWriteCycles=1, FeeRbBlockPersistentId=2707, FeeRbFirstReadDataMigration=false, FeeRbNoFallback=false, FeeRbOrigin=NVM, FeeRbSecLevel=1, FeeRbSurvival=false, FeeRbVarBlockLength=false
      DRIVE_PRDS_BNK0BLK13_NVM: FeeBlockSize=42, FeeImmediateData=false, FeeNumberOfWriteCycles=1, FeeRbBlockPersistentId=2963, FeeRbFirstReadDataMigration=false, FeeRbNoFallback=false, FeeRbOrigin=NVM, FeeRbSecLevel=1, FeeRbSurvival=false, FeeRbVarBlockLength=false
      DRIVE_PRDS_BNK0BLK14_NVM: FeeBlockSize=4, FeeImmediateData=false, FeeNumberOfWriteCycles=1, FeeRbBlockPersistentId=3519, FeeRbFirstReadDataMigration=false, FeeRbNoFallback=false, FeeRbOrigin=NVM, FeeRbSecLevel=1, FeeRbSurvival=false, FeeRbVarBlockLength=false
      DRIVE_PRDS_BNK0BLK15_NVM: FeeBlockSize=29, FeeImmediateData=false, FeeNumberOfWriteCycles=1, FeeRbBlockPersistentId=3238, FeeRbFirstReadDataMigration=false, FeeRbNoFallback=false, FeeRbOrigin=NVM, FeeRbSecLevel=1, FeeRbSurvival=false, FeeRbVarBlockLength=false
      DRIVE_PRDS_BNK0BLK16_NVM: FeeBlockSize=150, FeeImmediateData=false, FeeNumberOfWriteCycles=1, FeeRbBlockPersistentId=4012, FeeRbFirstReadDataMigration=false, FeeRbNoFallback=false, FeeRbOrigin=NVM, FeeRbSecLevel=1, FeeRbSurvival=false, FeeRbVarBlockLength=false
      DRIVE_PRDS_BNK0BLK17_NVM: FeeBlockSize=750, FeeImmediateData=false, FeeNumberOfWriteCycles=1, FeeRbBlockPersistentId=3284, FeeRbFirstReadDataMigration=false, FeeRbNoFallback=false, FeeRbOrigin=NVM, FeeRbSecLevel=1, FeeRbSurvival=false, FeeRbVarBlockLength=false
      DRIVE_PRDS_BNK0BLK18_NVM: FeeBlockSize=150, FeeImmediateData=false, FeeNumberOfWriteCycles=1, FeeRbBlockPersistentId=4897, FeeRbFirstReadDataMigration=false, FeeRbNoFallback=false, FeeRbOrigin=NVM, FeeRbSecLevel=1, FeeRbSurvival=false, FeeRbVarBlockLength=false
      DRIVE_PRDS_BNK0BLK19_NVM: FeeBlockSize=30, FeeImmediateData=false, FeeNumberOfWriteCycles=1, FeeRbBlockPersistentId=4777, FeeRbFirstReadDataMigration=false, FeeRbNoFallback=false, FeeRbOrigin=NVM, FeeRbSecLevel=1, FeeRbSurvival=false, FeeRbVarBlockLength=false
      DRIVE_PRDS_BNK0BLK1A_NVM: FeeBlockSize=1725, FeeImmediateData=false, FeeNumberOfWriteCycles=1, FeeRbBlockPersistentId=28557, FeeRbFirstReadDataMigration=false, FeeRbNoFallback=false, FeeRbOrigin=NVM, FeeRbSecLevel=1, FeeRbSurvival=false, FeeRbVarBlockLength=false
      DRIVE_PRDS_BNK0BLK1B_NVM: FeeBlockSize=720, FeeImmediateData=false, FeeNumberOfWriteCycles=1, FeeRbBlockPersistentId=26721, FeeRbFirstReadDataMigration=false, FeeRbNoFallback=false, FeeRbOrigin=NVM, FeeRbSecLevel=1, FeeRbSurvival=false, FeeRbVarBlockLength=false
      DRIVE_PRDS_BNK1BLK00_NVM: FeeBlockSize=3500, FeeImmediateData=false, FeeNumberOfWriteCycles=1, FeeRbBlockPersistentId=1428, FeeRbFirstReadDataMigration=false, FeeRbNoFallback=false, FeeRbOrigin=NVM, FeeRbSecLevel=1, FeeRbSurvival=false, FeeRbVarBlockLength=false
      DRIVE_PRDS_BNK1BLK02_NVM: FeeBlockSize=400, FeeImmediateData=false, FeeNumberOfWriteCycles=1, FeeRbBlockPersistentId=2857, FeeRbFirstReadDataMigration=false, FeeRbNoFallback=false, FeeRbOrigin=NVM, FeeRbSecLevel=1, FeeRbSurvival=false, FeeRbVarBlockLength=false
      DRIVE_PRDS_BNK1BLK03_NVM: FeeBlockSize=140, FeeImmediateData=false, FeeNumberOfWriteCycles=1, FeeRbBlockPersistentId=2869, FeeRbFirstReadDataMigration=false, FeeRbNoFallback=false, FeeRbOrigin=NVM, FeeRbSecLevel=1, FeeRbSurvival=false, FeeRbVarBlockLength=false
      DRIVE_PRDS_BNK1BLK04_NVM: FeeBlockSize=70, FeeImmediateData=false, FeeNumberOfWriteCycles=1, FeeRbBlockPersistentId=3581, FeeRbFirstReadDataMigration=false, FeeRbNoFallback=false, FeeRbOrigin=NVM, FeeRbSecLevel=1, FeeRbSurvival=false, FeeRbVarBlockLength=false
      DRIVE_PRDS_BNK1BLK05_NVM: FeeBlockSize=18, FeeImmediateData=false, FeeNumberOfWriteCycles=1, FeeRbBlockPersistentId=3241, FeeRbFirstReadDataMigration=false, FeeRbNoFallback=false, FeeRbOrigin=NVM, FeeRbSecLevel=1, FeeRbSurvival=false, FeeRbVarBlockLength=false
      DRIVE_PRDS_BNK2BLK00_NVM: FeeBlockSize=3500, FeeImmediateData=false, FeeNumberOfWriteCycles=1, FeeRbBlockPersistentId=13964, FeeRbFirstReadDataMigration=false, FeeRbNoFallback=false, FeeRbOrigin=NVM, FeeRbSecLevel=1, FeeRbSurvival=false, FeeRbVarBlockLength=false
      DRIVE_PRDS_BNK2BLK02_NVM: FeeBlockSize=400, FeeImmediateData=false, FeeNumberOfWriteCycles=1, FeeRbBlockPersistentId=14385, FeeRbFirstReadDataMigration=false, FeeRbNoFallback=false, FeeRbOrigin=NVM, FeeRbSecLevel=1, FeeRbSurvival=false, FeeRbVarBlockLength=false
      DRIVE_PRDS_BNK2BLK03_NVM: FeeBlockSize=140, FeeImmediateData=false, FeeNumberOfWriteCycles=1, FeeRbBlockPersistentId=14381, FeeRbFirstReadDataMigration=false, FeeRbNoFallback=false, FeeRbOrigin=NVM, FeeRbSecLevel=1, FeeRbSurvival=false, FeeRbVarBlockLength=false
      DRIVE_PRDS_BNK2BLK04_NVM: FeeBlockSize=70, FeeImmediateData=false, FeeNumberOfWriteCycles=1, FeeRbBlockPersistentId=16101, FeeRbFirstReadDataMigration=false, FeeRbNoFallback=false, FeeRbOrigin=NVM, FeeRbSecLevel=1, FeeRbSurvival=false, FeeRbVarBlockLength=false
      DRIVE_PRDS_BNK2BLK05_NVM: FeeBlockSize=18, FeeImmediateData=false, FeeNumberOfWriteCycles=1, FeeRbBlockPersistentId=16305, FeeRbFirstReadDataMigration=false, FeeRbNoFallback=false, FeeRbOrigin=NVM, FeeRbSecLevel=1, FeeRbSurvival=false, FeeRbVarBlockLength=false
      DRIVE_PRDS_BNK3BLK00_NVM: FeeBlockSize=5400, FeeImmediateData=false, FeeNumberOfWriteCycles=1, FeeRbBlockPersistentId=16176, FeeRbFirstReadDataMigration=false, FeeRbNoFallback=false, FeeRbOrigin=NVM, FeeRbSecLevel=1, FeeRbSurvival=false, FeeRbVarBlockLength=false
      DRIVE_PRDS_BNK3BLK01_NVM: FeeBlockSize=54, FeeImmediateData=false, FeeNumberOfWriteCycles=1, FeeRbBlockPersistentId=11038, FeeRbFirstReadDataMigration=false, FeeRbNoFallback=false, FeeRbOrigin=NVM, FeeRbSecLevel=1, FeeRbSurvival=false, FeeRbVarBlockLength=false
      ECUM_CFG_NVM_BLOCK: FeeBlockSize=8, FeeImmediateData=false, FeeNumberOfWriteCycles=1, FeeRbBlockPersistentId=62203, FeeRbFirstReadDataMigration=false, FeeRbNoFallback=false, FeeRbOrigin=NVM, FeeRbSecLevel=1, FeeRbSurvival=false, FeeRbVarBlockLength=false
      EpmErr_stErrCntrlNvMBlk: FeeBlockSize=2, FeeImmediateData=false, FeeNumberOfWriteCycles=1, FeeRbBlockPersistentId=4019, FeeRbFirstReadDataMigration=false, FeeRbNoFallback=false, FeeRbOrigin=NVM, FeeRbSecLevel=1, FeeRbSurvival=false, FeeRbVarBlockLength=false
      EpmErr_stErrInfoNvMBlk: FeeBlockSize=200, FeeImmediateData=false, FeeNumberOfWriteCycles=1, FeeRbBlockPersistentId=61886, FeeRbFirstReadDataMigration=false, FeeRbNoFallback=false, FeeRbOrigin=NVM, FeeRbSecLevel=1, FeeRbSurvival=false, FeeRbVarBlockLength=false
      I14229_PROGEVENT_STATUS: FeeBlockSize=1, FeeImmediateData=false, FeeNumberOfWriteCycles=1, FeeRbBlockPersistentId=19646, FeeRbFirstReadDataMigration=false, FeeRbNoFallback=false, FeeRbOrigin=NVM, FeeRbSecLevel=1, FeeRbSurvival=false, FeeRbVarBlockLength=false
      MoCEMM_structBlk_Nvm: FeeBlockSize=172, FeeImmediateData=false, FeeNumberOfWriteCycles=1, FeeRbBlockPersistentId=28175, FeeRbFirstReadDataMigration=false, FeeRbNoFallback=false, FeeRbOrigin=NVM, FeeRbSecLevel=1, FeeRbSurvival=false, FeeRbVarBlockLength=false
      NvM_ConfigId: FeeBlockSize=2, FeeImmediateData=false, FeeNumberOfWriteCycles=1, FeeRbBlockPersistentId=30244, FeeRbFirstReadDataMigration=false, FeeRbNoFallback=false, FeeRbOrigin=NVM, FeeRbSecLevel=2, FeeRbSurvival=false, FeeRbVarBlockLength=false
      rba_IoExtLib_DrvBlk: FeeBlockSize=4, FeeImmediateData=false, FeeNumberOfWriteCycles=1, FeeRbBlockPersistentId=44, FeeRbFirstReadDataMigration=false, FeeRbNoFallback=false, FeeRbOrigin=NVM, FeeRbSecLevel=1, FeeRbSurvival=false, FeeRbVarBlockLength=false
      rba_IoExtLib_IniBlk: FeeBlockSize=4, FeeImmediateData=false, FeeNumberOfWriteCycles=1, FeeRbBlockPersistentId=43120, FeeRbFirstReadDataMigration=false, FeeRbNoFallback=false, FeeRbOrigin=NVM, FeeRbSecLevel=1, FeeRbSurvival=false, FeeRbVarBlockLength=false
      rba_IoSigRtc_StopCounter_Blk: FeeBlockSize=1, FeeImmediateData=false, FeeNumberOfWriteCycles=1, FeeRbBlockPersistentId=62317, FeeRbFirstReadDataMigration=false, FeeRbNoFallback=false, FeeRbOrigin=NVM, FeeRbSecLevel=2, FeeRbSurvival=false, FeeRbVarBlockLength=false
      rba_MRly_Diag_StkNvMBlk: FeeBlockSize=8, FeeImmediateData=false, FeeNumberOfWriteCycles=1, FeeRbBlockPersistentId=2618, FeeRbFirstReadDataMigration=false, FeeRbNoFallback=false, FeeRbOrigin=NVM, FeeRbSecLevel=1, FeeRbSurvival=false, FeeRbVarBlockLength=false
      rba_MSTrace_LTMax_CSA0: FeeBlockSize=2, FeeImmediateData=false, FeeNumberOfWriteCycles=1, FeeRbBlockPersistentId=64755, FeeRbFirstReadDataMigration=false, FeeRbNoFallback=false, FeeRbOrigin=NVM, FeeRbSecLevel=1, FeeRbSurvival=false, FeeRbVarBlockLength=false
      rba_MSTrace_LTMax_CSA1: FeeBlockSize=2, FeeImmediateData=false, FeeNumberOfWriteCycles=1, FeeRbBlockPersistentId=60794, FeeRbFirstReadDataMigration=false, FeeRbNoFallback=false, FeeRbOrigin=NVM, FeeRbSecLevel=1, FeeRbSurvival=false, FeeRbVarBlockLength=false
      rba_MSTrace_LTMax_CSA2: FeeBlockSize=2, FeeImmediateData=false, FeeNumberOfWriteCycles=1, FeeRbBlockPersistentId=57184, FeeRbFirstReadDataMigration=false, FeeRbNoFallback=false, FeeRbOrigin=NVM, FeeRbSecLevel=1, FeeRbSurvival=false, FeeRbVarBlockLength=false
      rba_MSTrace_LTMax_User0: FeeBlockSize=2, FeeImmediateData=false, FeeNumberOfWriteCycles=1, FeeRbBlockPersistentId=19220, FeeRbFirstReadDataMigration=false, FeeRbNoFallback=false, FeeRbOrigin=NVM, FeeRbSecLevel=1, FeeRbSurvival=false, FeeRbVarBlockLength=false
      rba_MSTrace_LTMax_User1: FeeBlockSize=2, FeeImmediateData=false, FeeNumberOfWriteCycles=1, FeeRbBlockPersistentId=19093, FeeRbFirstReadDataMigration=false, FeeRbNoFallback=false, FeeRbOrigin=NVM, FeeRbSecLevel=1, FeeRbSurvival=false, FeeRbVarBlockLength=false
      rba_MSTrace_LTMax_User2: FeeBlockSize=2, FeeImmediateData=false, FeeNumberOfWriteCycles=1, FeeRbBlockPersistentId=22558, FeeRbFirstReadDataMigration=false, FeeRbNoFallback=false, FeeRbOrigin=NVM, FeeRbSecLevel=1, FeeRbSurvival=false, FeeRbVarBlockLength=false
      rba_MemDiag_StrdErr_Blk: FeeBlockSize=8, FeeImmediateData=false, FeeNumberOfWriteCycles=1, FeeRbBlockPersistentId=32399, FeeRbFirstReadDataMigration=false, FeeRbNoFallback=false, FeeRbOrigin=NVM, FeeRbSecLevel=1, FeeRbSurvival=false, FeeRbVarBlockLength=false
      rba_OsMeasmt_CoreLoadNvMTable: FeeBlockSize=6, FeeImmediateData=false, FeeNumberOfWriteCycles=1, FeeRbBlockPersistentId=9532, FeeRbFirstReadDataMigration=false, FeeRbNoFallback=false, FeeRbOrigin=NVM, FeeRbSecLevel=1, FeeRbSurvival=false, FeeRbVarBlockLength=false
      rba_OsMeasmt_RespTimeNvMTable: FeeBlockSize=36, FeeImmediateData=false, FeeNumberOfWriteCycles=1, FeeRbBlockPersistentId=65136, FeeRbFirstReadDataMigration=false, FeeRbNoFallback=false, FeeRbOrigin=NVM, FeeRbSecLevel=1, FeeRbSurvival=false, FeeRbVarBlockLength=false
      rba_Reset_ExtHistBuf_Blk: FeeBlockSize=160, FeeImmediateData=false, FeeNumberOfWriteCycles=1, FeeRbBlockPersistentId=2605, FeeRbFirstReadDataMigration=false, FeeRbNoFallback=false, FeeRbOrigin=NVM, FeeRbSecLevel=1, FeeRbSurvival=false, FeeRbVarBlockLength=false
      rba_Reset_HistBuf_Blk: FeeBlockSize=16, FeeImmediateData=false, FeeNumberOfWriteCycles=1, FeeRbBlockPersistentId=20498, FeeRbFirstReadDataMigration=false, FeeRbNoFallback=false, FeeRbOrigin=NVM, FeeRbSecLevel=1, FeeRbSurvival=false, FeeRbVarBlockLength=false
      rba_SyC_ObservationCounters_IrrSwOffTrigEngRun_Blk: FeeBlockSize=1, FeeImmediateData=false, FeeNumberOfWriteCycles=1, FeeRbBlockPersistentId=11144, FeeRbFirstReadDataMigration=false, FeeRbNoFallback=false, FeeRbOrigin=NVM, FeeRbSecLevel=1, FeeRbSurvival=false, FeeRbVarBlockLength=false
      rba_SyC_ObservationCounters_IrrSwOff_Blk: FeeBlockSize=1, FeeImmediateData=false, FeeNumberOfWriteCycles=1, FeeRbBlockPersistentId=59001, FeeRbFirstReadDataMigration=false, FeeRbNoFallback=false, FeeRbOrigin=NVM, FeeRbSecLevel=1, FeeRbSurvival=false, FeeRbVarBlockLength=false
      rba_SyC_ShutdownServices_Shutdown_Blk: FeeBlockSize=24, FeeImmediateData=false, FeeNumberOfWriteCycles=1, FeeRbBlockPersistentId=24328, FeeRbFirstReadDataMigration=false, FeeRbNoFallback=false, FeeRbOrigin=NVM, FeeRbSecLevel=1, FeeRbSurvival=false, FeeRbVarBlockLength=false
      rba_SyC_States_PostDrive_Prolongers_Blk: FeeBlockSize=2, FeeImmediateData=false, FeeNumberOfWriteCycles=1, FeeRbBlockPersistentId=19738, FeeRbFirstReadDataMigration=false, FeeRbNoFallback=false, FeeRbOrigin=NVM, FeeRbSecLevel=1, FeeRbSurvival=false, FeeRbVarBlockLength=false
      rba_SyC_States_PrepareShutdown_Prolongers_Blk: FeeBlockSize=2, FeeImmediateData=false, FeeNumberOfWriteCycles=1, FeeRbBlockPersistentId=45162, FeeRbFirstReadDataMigration=false, FeeRbNoFallback=false, FeeRbOrigin=NVM, FeeRbSecLevel=1, FeeRbSurvival=false, FeeRbVarBlockLength=false
      rba_SyC_States_TimeoutHistory_Blk: FeeBlockSize=7, FeeImmediateData=false, FeeNumberOfWriteCycles=1, FeeRbBlockPersistentId=28036, FeeRbFirstReadDataMigration=false, FeeRbNoFallback=false, FeeRbOrigin=NVM, FeeRbSecLevel=1, FeeRbSurvival=false, FeeRbVarBlockLength=false
      rba_SyC_States_Wait_Prolongers_Blk: FeeBlockSize=2, FeeImmediateData=false, FeeNumberOfWriteCycles=1, FeeRbBlockPersistentId=25775, FeeRbFirstReadDataMigration=false, FeeRbNoFallback=false, FeeRbOrigin=NVM, FeeRbSecLevel=1, FeeRbSurvival=false, FeeRbVarBlockLength=false
      rba_TrapLog_CallStackCore1_a_u32_Blk: FeeBlockSize=192, FeeImmediateData=false, FeeNumberOfWriteCycles=1, FeeRbBlockPersistentId=53271, FeeRbFirstReadDataMigration=false, FeeRbNoFallback=false, FeeRbOrigin=NVM, FeeRbSecLevel=1, FeeRbSurvival=false, FeeRbVarBlockLength=false
      rba_TrapLog_CallStackCore2_a_u32_Blk: FeeBlockSize=192, FeeImmediateData=false, FeeNumberOfWriteCycles=1, FeeRbBlockPersistentId=49693, FeeRbFirstReadDataMigration=false, FeeRbNoFallback=false, FeeRbOrigin=NVM, FeeRbSecLevel=1, FeeRbSurvival=false, FeeRbVarBlockLength=false
      rba_TrapLog_CallStack_a_u32_Blk: FeeBlockSize=192, FeeImmediateData=false, FeeNumberOfWriteCycles=1, FeeRbBlockPersistentId=16237, FeeRbFirstReadDataMigration=false, FeeRbNoFallback=false, FeeRbOrigin=NVM, FeeRbSecLevel=1, FeeRbSurvival=false, FeeRbVarBlockLength=false
      rba_TrapLog_RegCore1_st_Blk: FeeBlockSize=312, FeeImmediateData=false, FeeNumberOfWriteCycles=1, FeeRbBlockPersistentId=22296, FeeRbFirstReadDataMigration=false, FeeRbNoFallback=false, FeeRbOrigin=NVM, FeeRbSecLevel=1, FeeRbSurvival=false, FeeRbVarBlockLength=false
      rba_TrapLog_RegCore2_st_Blk: FeeBlockSize=312, FeeImmediateData=false, FeeNumberOfWriteCycles=1, FeeRbBlockPersistentId=21657, FeeRbFirstReadDataMigration=false, FeeRbNoFallback=false, FeeRbOrigin=NVM, FeeRbSecLevel=1, FeeRbSurvival=false, FeeRbVarBlockLength=false
      rba_TrapLog_Reg_Blk: FeeBlockSize=1056, FeeImmediateData=false, FeeNumberOfWriteCycles=1, FeeRbBlockPersistentId=9111, FeeRbFirstReadDataMigration=false, FeeRbNoFallback=false, FeeRbOrigin=NVM, FeeRbSecLevel=1, FeeRbSurvival=false, FeeRbVarBlockLength=false
      Alt_Block: FeeBlockSize=20, FeeImmediateData=FALSE, FeeNumberOfWriteCycles=1, FeeRbBlockPersistentId=30593, FeeRbOrigin=ADAPTER, FeeRbRobustness=FALSE, FeeRbSecLevel=2
      APPMaxLrn_Data: FeeBlockSize=8, FeeImmediateData=FALSE, FeeNumberOfWriteCycles=1, FeeRbBlockPersistentId=50675, FeeRbOrigin=ADAPTER, FeeRbRobustness=FALSE, FeeRbSecLevel=2
      BATTUSTBYDIA: FeeBlockSize=8, FeeImmediateData=FALSE, FeeNumberOfWriteCycles=1, FeeRbBlockPersistentId=44507, FeeRbOrigin=ADAPTER, FeeRbRobustness=FALSE, FeeRbSecLevel=1
      BlockEBF: FeeBlockSize=8, FeeImmediateData=FALSE, FeeNumberOfWriteCycles=0, FeeRbBlockPersistentId=58484, FeeRbOrigin=ADAPTER, FeeRbRobustness=FALSE, FeeRbSecLevel=1
      Brk_Data: FeeBlockSize=12, FeeImmediateData=FALSE, FeeNumberOfWriteCycles=1, FeeRbBlockPersistentId=27043, FeeRbOrigin=ADAPTER, FeeRbRobustness=FALSE, FeeRbSecLevel=2
      Clth_Data: FeeBlockSize=8, FeeImmediateData=FALSE, FeeNumberOfWriteCycles=0, FeeRbBlockPersistentId=45172, FeeRbOrigin=ADAPTER, FeeRbRobustness=FALSE, FeeRbSecLevel=2
      ComCIL: FeeBlockSize=8, FeeImmediateData=FALSE, FeeNumberOfWriteCycles=1, FeeRbBlockPersistentId=39115, FeeRbOrigin=ADAPTER, FeeRbRobustness=FALSE, FeeRbSecLevel=1
      CrCtl_CnclReason: FeeBlockSize=24, FeeImmediateData=FALSE, FeeNumberOfWriteCycles=1, FeeRbBlockPersistentId=60405, FeeRbOrigin=ADAPTER, FeeRbRobustness=FALSE, FeeRbSecLevel=1
      CrCtl_ErrMTVehSpd: FeeBlockSize=8, FeeImmediateData=FALSE, FeeNumberOfWriteCycles=1, FeeRbBlockPersistentId=56019, FeeRbOrigin=ADAPTER, FeeRbRobustness=FALSE, FeeRbSecLevel=1
      CrCUI_Meter: FeeBlockSize=8, FeeImmediateData=FALSE, FeeNumberOfWriteCycles=1, FeeRbBlockPersistentId=16658, FeeRbOrigin=ADAPTER, FeeRbRobustness=FALSE, FeeRbSecLevel=1
      I14229_RC: FeeBlockSize=8, FeeImmediateData=FALSE, FeeNumberOfWriteCycles=1, FeeRbBlockPersistentId=26412, FeeRbOrigin=ADAPTER, FeeRbRobustness=FALSE, FeeRbSecLevel=1
      TempModelEGRVlv: FeeBlockSize=8, FeeImmediateData=FALSE, FeeNumberOfWriteCycles=1, FeeRbBlockPersistentId=42598, FeeRbOrigin=ADAPTER, FeeRbRobustness=FALSE, FeeRbSecLevel=2
      RelPosEGRVlv: FeeBlockSize=16, FeeImmediateData=FALSE, FeeNumberOfWriteCycles=1, FeeRbBlockPersistentId=21292, FeeRbOrigin=ADAPTER, FeeRbRobustness=FALSE, FeeRbSecLevel=1
      EGRVlv: FeeBlockSize=24, FeeImmediateData=FALSE, FeeNumberOfWriteCycles=1, FeeRbBlockPersistentId=25515, FeeRbOrigin=ADAPTER, FeeRbRobustness=FALSE, FeeRbSecLevel=1
      DELib: FeeBlockSize=8, FeeImmediateData=FALSE, FeeNumberOfWriteCycles=1, FeeRbBlockPersistentId=59472, FeeRbOrigin=ADAPTER, FeeRbRobustness=FALSE, FeeRbSecLevel=2
      JamHealEepEGRVlv: FeeBlockSize=12, FeeImmediateData=FALSE, FeeNumberOfWriteCycles=1, FeeRbBlockPersistentId=50034, FeeRbOrigin=ADAPTER, FeeRbRobustness=FALSE, FeeRbSecLevel=1
      ActrLimnCntrEGRVlv: FeeBlockSize=8, FeeImmediateData=FALSE, FeeNumberOfWriteCycles=1, FeeRbBlockPersistentId=32681, FeeRbOrigin=ADAPTER, FeeRbRobustness=FALSE, FeeRbSecLevel=1
      TrlPtrEGRVlv: FeeBlockSize=8, FeeImmediateData=FALSE, FeeNumberOfWriteCycles=1, FeeRbBlockPersistentId=40649, FeeRbOrigin=ADAPTER, FeeRbRobustness=FALSE, FeeRbSecLevel=1
      DFES_Clear: FeeBlockSize=28, FeeImmediateData=FALSE, FeeNumberOfWriteCycles=0, FeeRbBlockPersistentId=60645, FeeRbOrigin=ADAPTER, FeeRbRobustness=FALSE, FeeRbSecLevel=2
      DSMDUR_MICumCont: FeeBlockSize=12, FeeImmediateData=FALSE, FeeNumberOfWriteCycles=1, FeeRbBlockPersistentId=41675, FeeRbOrigin=ADAPTER, FeeRbRobustness=FALSE, FeeRbSecLevel=2
      DsplECU_MeterReadMETK: FeeBlockSize=8, FeeImmediateData=FALSE, FeeNumberOfWriteCycles=1, FeeRbBlockPersistentId=8383, FeeRbOrigin=ADAPTER, FeeRbRobustness=FALSE, FeeRbSecLevel=1
      EngPrt_OvrSpdMon: FeeBlockSize=8, FeeImmediateData=FALSE, FeeNumberOfWriteCycles=1, FeeRbBlockPersistentId=55406, FeeRbOrigin=ADAPTER, FeeRbRobustness=FALSE, FeeRbSecLevel=1
      EnvT_VdMdl2: FeeBlockSize=8, FeeImmediateData=FALSE, FeeNumberOfWriteCycles=1, FeeRbBlockPersistentId=48464, FeeRbOrigin=ADAPTER, FeeRbRobustness=FALSE, FeeRbSecLevel=1
      EpmCaS: FeeBlockSize=28, FeeImmediateData=FALSE, FeeNumberOfWriteCycles=1, FeeRbBlockPersistentId=28984, FeeRbOrigin=ADAPTER, FeeRbRobustness=FALSE, FeeRbSecLevel=2
      EpmCaS_Adap: FeeBlockSize=28, FeeImmediateData=FALSE, FeeNumberOfWriteCycles=1, FeeRbBlockPersistentId=11042, FeeRbOrigin=ADAPTER, FeeRbRobustness=FALSE, FeeRbSecLevel=2
      FfPrm_EthCalc: FeeBlockSize=8, FeeImmediateData=FALSE, FeeNumberOfWriteCycles=1, FeeRbBlockPersistentId=32659, FeeRbOrigin=ADAPTER, FeeRbRobustness=FALSE, FeeRbSecLevel=2
      GGFETH: FeeBlockSize=44, FeeImmediateData=FALSE, FeeNumberOfWriteCycles=1, FeeRbBlockPersistentId=53326, FeeRbOrigin=ADAPTER, FeeRbRobustness=FALSE, FeeRbSecLevel=1
      GlbDa_DrvgCycCntrData: FeeBlockSize=8, FeeImmediateData=FALSE, FeeNumberOfWriteCycles=1, FeeRbBlockPersistentId=59738, FeeRbOrigin=ADAPTER, FeeRbRobustness=FALSE, FeeRbSecLevel=1
      GlbDa_Block: FeeBlockSize=8, FeeImmediateData=FALSE, FeeNumberOfWriteCycles=1, FeeRbBlockPersistentId=5426, FeeRbOrigin=ADAPTER, FeeRbRobustness=FALSE, FeeRbSecLevel=2
      IVGdiCtl_CvoAdpn: FeeBlockSize=120, FeeImmediateData=FALSE, FeeNumberOfWriteCycles=1, FeeRbBlockPersistentId=22862, FeeRbOrigin=ADAPTER, FeeRbRobustness=FALSE, FeeRbSecLevel=1
      IVGdiCtl_CvoAdpn_Step2: FeeBlockSize=44, FeeImmediateData=FALSE, FeeNumberOfWriteCycles=1, FeeRbBlockPersistentId=34386, FeeRbOrigin=ADAPTER, FeeRbRobustness=FALSE, FeeRbSecLevel=1
      IVGdiCtl_CvoAdpn_Vcos0_dti: FeeBlockSize=32, FeeImmediateData=FALSE, FeeNumberOfWriteCycles=1, FeeRbBlockPersistentId=8123, FeeRbOrigin=ADAPTER, FeeRbRobustness=FALSE, FeeRbSecLevel=1
      IVGdiCtl_CvoAdpn_Vcos1_dti: FeeBlockSize=32, FeeImmediateData=FALSE, FeeNumberOfWriteCycles=1, FeeRbBlockPersistentId=7738, FeeRbOrigin=ADAPTER, FeeRbRobustness=FALSE, FeeRbSecLevel=1
      IVGdiCtl_CvoAdpn_Vcos2_dti: FeeBlockSize=32, FeeImmediateData=FALSE, FeeNumberOfWriteCycles=1, FeeRbBlockPersistentId=3249, FeeRbOrigin=ADAPTER, FeeRbRobustness=FALSE, FeeRbSecLevel=1
      IVGdiCtl_CvoAdpn_Vcos3_dti: FeeBlockSize=32, FeeImmediateData=FALSE, FeeNumberOfWriteCycles=1, FeeRbBlockPersistentId=3376, FeeRbOrigin=ADAPTER, FeeRbRobustness=FALSE, FeeRbSecLevel=1
      IVGdiCtl_CvoAdpn_Vcos4_dti: FeeBlockSize=32, FeeImmediateData=FALSE, FeeNumberOfWriteCycles=1, FeeRbBlockPersistentId=14767, FeeRbOrigin=ADAPTER, FeeRbRobustness=FALSE, FeeRbSecLevel=1
      IVGdiCtl_CvoAdpn_Vcos5_dti: FeeBlockSize=32, FeeImmediateData=FALSE, FeeNumberOfWriteCycles=1, FeeRbBlockPersistentId=14382, FeeRbOrigin=ADAPTER, FeeRbRobustness=FALSE, FeeRbSecLevel=1
      IVGdiCtl_CvoAdpn_Vcos0_tantot: FeeBlockSize=16, FeeImmediateData=FALSE, FeeNumberOfWriteCycles=1, FeeRbBlockPersistentId=51064, FeeRbOrigin=ADAPTER, FeeRbRobustness=FALSE, FeeRbSecLevel=1
      IVGdiCtl_CvoAdpn_Vcos1_tantot: FeeBlockSize=16, FeeImmediateData=FALSE, FeeNumberOfWriteCycles=1, FeeRbBlockPersistentId=50937, FeeRbOrigin=ADAPTER, FeeRbRobustness=FALSE, FeeRbSecLevel=1
      IVGdiCtl_CvoAdpn_Vcos2_tantot: FeeBlockSize=16, FeeImmediateData=FALSE, FeeNumberOfWriteCycles=1, FeeRbBlockPersistentId=54386, FeeRbOrigin=ADAPTER, FeeRbRobustness=FALSE, FeeRbSecLevel=1
      IVGdiCtl_CvoAdpn_Vcos3_tantot: FeeBlockSize=16, FeeImmediateData=FALSE, FeeNumberOfWriteCycles=1, FeeRbBlockPersistentId=54771, FeeRbOrigin=ADAPTER, FeeRbRobustness=FALSE, FeeRbSecLevel=1
      IVGdiCtl_CvoAdpn_Vcos4_tantot: FeeBlockSize=16, FeeImmediateData=FALSE, FeeNumberOfWriteCycles=1, FeeRbBlockPersistentId=57708, FeeRbOrigin=ADAPTER, FeeRbRobustness=FALSE, FeeRbSecLevel=1
      IVGdiCtl_CvoAdpn_Vcos5_tantot: FeeBlockSize=16, FeeImmediateData=FALSE, FeeNumberOfWriteCycles=1, FeeRbBlockPersistentId=57581, FeeRbOrigin=ADAPTER, FeeRbRobustness=FALSE, FeeRbSecLevel=1
      IVGdiCtl_CvoAdpn_DrgPtr: FeeBlockSize=68, FeeImmediateData=FALSE, FeeNumberOfWriteCycles=1, FeeRbBlockPersistentId=25035, FeeRbOrigin=ADAPTER, FeeRbRobustness=FALSE, FeeRbSecLevel=1
      IVGdiCtl_CvoSigEvln: FeeBlockSize=12, FeeImmediateData=FALSE, FeeNumberOfWriteCycles=1, FeeRbBlockPersistentId=30855, FeeRbOrigin=ADAPTER, FeeRbRobustness=FALSE, FeeRbSecLevel=1
      KRVEKO_SUPKNKCNTR: FeeBlockSize=56, FeeImmediateData=FALSE, FeeNumberOfWriteCycles=1, FeeRbBlockPersistentId=7966, FeeRbOrigin=ADAPTER, FeeRbRobustness=FALSE, FeeRbSecLevel=2
      LLim_Data: FeeBlockSize=12, FeeImmediateData=FALSE, FeeNumberOfWriteCycles=1, FeeRbBlockPersistentId=33777, FeeRbOrigin=ADAPTER, FeeRbRobustness=FALSE, FeeRbSecLevel=1
      MisfDet_SegTiAdpn: FeeBlockSize=12, FeeImmediateData=FALSE, FeeNumberOfWriteCycles=1, FeeRbBlockPersistentId=33533, FeeRbOrigin=ADAPTER, FeeRbRobustness=FALSE, FeeRbSecLevel=1
      OilSwmpT_VdMdl2: FeeBlockSize=12, FeeImmediateData=FALSE, FeeNumberOfWriteCycles=1, FeeRbBlockPersistentId=41796, FeeRbOrigin=ADAPTER, FeeRbRobustness=FALSE, FeeRbSecLevel=1
      PIDA6_Block: FeeBlockSize=8, FeeImmediateData=FALSE, FeeNumberOfWriteCycles=1, FeeRbBlockPersistentId=665, FeeRbOrigin=ADAPTER, FeeRbRobustness=FALSE, FeeRbSecLevel=2
      FactoryData: FeeBlockSize=132, FeeImmediateData=FALSE, FeeNumberOfWriteCycles=1, FeeRbBlockPersistentId=15151, FeeRbOrigin=ADAPTER, FeeRbRobustness=FALSE, FeeRbSecLevel=1
      EnvramState: FeeBlockSize=20, FeeImmediateData=FALSE, FeeNumberOfWriteCycles=1, FeeRbBlockPersistentId=27922, FeeRbOrigin=ADAPTER, FeeRbRobustness=FALSE, FeeRbSecLevel=1
      SupplyMem: FeeBlockSize=20, FeeImmediateData=FALSE, FeeNumberOfWriteCycles=1, FeeRbBlockPersistentId=53058, FeeRbOrigin=ADAPTER, FeeRbRobustness=FALSE, FeeRbSecLevel=1
      Sia_IgnLck: FeeBlockSize=8, FeeImmediateData=FALSE, FeeNumberOfWriteCycles=1, FeeRbBlockPersistentId=48349, FeeRbOrigin=ADAPTER, FeeRbRobustness=FALSE, FeeRbSecLevel=2
      EEPData1: FeeBlockSize=116, FeeImmediateData=FALSE, FeeNumberOfWriteCycles=0, FeeRbBlockPersistentId=64546, FeeRbOrigin=ADAPTER, FeeRbRobustness=FALSE, FeeRbSecLevel=2
      Strt_Data: FeeBlockSize=16, FeeImmediateData=FALSE, FeeNumberOfWriteCycles=1, FeeRbBlockPersistentId=34791, FeeRbOrigin=ADAPTER, FeeRbRobustness=FALSE, FeeRbSecLevel=1
      ThrVlv_OffsLrn: FeeBlockSize=24, FeeImmediateData=FALSE, FeeNumberOfWriteCycles=2, FeeRbBlockPersistentId=61304, FeeRbOrigin=ADAPTER, FeeRbRobustness=FALSE, FeeRbSecLevel=1
      TiEngOn_EngRtMngt: FeeBlockSize=16, FeeImmediateData=FALSE, FeeNumberOfWriteCycles=1, FeeRbBlockPersistentId=14906, FeeRbOrigin=ADAPTER, FeeRbRobustness=FALSE, FeeRbSecLevel=2
      TiEngOn_TotEngRt: FeeBlockSize=12, FeeImmediateData=FALSE, FeeNumberOfWriteCycles=1, FeeRbBlockPersistentId=50808, FeeRbOrigin=ADAPTER, FeeRbRobustness=FALSE, FeeRbSecLevel=2
      TiOff_VdClk: FeeBlockSize=16, FeeImmediateData=FALSE, FeeNumberOfWriteCycles=2, FeeRbBlockPersistentId=17539, FeeRbOrigin=ADAPTER, FeeRbRobustness=FALSE, FeeRbSecLevel=2
      TiOff_VdDiag: FeeBlockSize=16, FeeImmediateData=FALSE, FeeNumberOfWriteCycles=2, FeeRbBlockPersistentId=24499, FeeRbOrigin=ADAPTER, FeeRbRobustness=FALSE, FeeRbSecLevel=2
      TiOff_VdTiEngOff: FeeBlockSize=16, FeeImmediateData=FALSE, FeeNumberOfWriteCycles=1, FeeRbBlockPersistentId=20280, FeeRbOrigin=ADAPTER, FeeRbRobustness=FALSE, FeeRbSecLevel=2
      TiOff_VdTiStrtEndOff: FeeBlockSize=16, FeeImmediateData=FALSE, FeeNumberOfWriteCycles=1, FeeRbBlockPersistentId=19881, FeeRbOrigin=ADAPTER, FeeRbRobustness=FALSE, FeeRbSecLevel=2
      Cnt_St: FeeBlockSize=8, FeeImmediateData=FALSE, FeeNumberOfWriteCycles=1, FeeRbBlockPersistentId=52342, FeeRbOrigin=ADAPTER, FeeRbRobustness=FALSE, FeeRbSecLevel=1
      Cnt_U16: FeeBlockSize=8, FeeImmediateData=FALSE, FeeNumberOfWriteCycles=1, FeeRbBlockPersistentId=6688, FeeRbOrigin=ADAPTER, FeeRbRobustness=FALSE, FeeRbSecLevel=1
      Cnt_U32: FeeBlockSize=12, FeeImmediateData=FALSE, FeeNumberOfWriteCycles=1, FeeRbBlockPersistentId=19718, FeeRbOrigin=ADAPTER, FeeRbRobustness=FALSE, FeeRbSecLevel=1
      Cnt_U8: FeeBlockSize=8, FeeImmediateData=FALSE, FeeNumberOfWriteCycles=1, FeeRbBlockPersistentId=41836, FeeRbOrigin=ADAPTER, FeeRbRobustness=FALSE, FeeRbSecLevel=1
      DrkDchaDistbn: FeeBlockSize=56, FeeImmediateData=FALSE, FeeNumberOfWriteCycles=1, FeeRbBlockPersistentId=65384, FeeRbOrigin=ADAPTER, FeeRbRobustness=FALSE, FeeRbSecLevel=1
      Histogram1: FeeBlockSize=44, FeeImmediateData=FALSE, FeeNumberOfWriteCycles=1, FeeRbBlockPersistentId=31016, FeeRbOrigin=ADAPTER, FeeRbRobustness=FALSE, FeeRbSecLevel=1
      Histogram10: FeeBlockSize=40, FeeImmediateData=FALSE, FeeNumberOfWriteCycles=1, FeeRbBlockPersistentId=56168, FeeRbOrigin=ADAPTER, FeeRbRobustness=FALSE, FeeRbSecLevel=1
      Histogram2: FeeBlockSize=40, FeeImmediateData=FALSE, FeeNumberOfWriteCycles=2, FeeRbBlockPersistentId=27438, FeeRbOrigin=ADAPTER, FeeRbRobustness=FALSE, FeeRbSecLevel=1
      Histogram11: FeeBlockSize=28, FeeImmediateData=FALSE, FeeNumberOfWriteCycles=1, FeeRbBlockPersistentId=51804, FeeRbOrigin=ADAPTER, FeeRbRobustness=FALSE, FeeRbSecLevel=1
      Histogram3: FeeBlockSize=36, FeeImmediateData=FALSE, FeeNumberOfWriteCycles=1, FeeRbBlockPersistentId=27307, FeeRbOrigin=ADAPTER, FeeRbRobustness=FALSE, FeeRbSecLevel=1
      Histogram4: FeeBlockSize=56, FeeImmediateData=FALSE, FeeNumberOfWriteCycles=1, FeeRbBlockPersistentId=24483, FeeRbOrigin=ADAPTER, FeeRbRobustness=FALSE, FeeRbSecLevel=1
      Histogram5: FeeBlockSize=84, FeeImmediateData=FALSE, FeeNumberOfWriteCycles=1, FeeRbBlockPersistentId=24134, FeeRbOrigin=ADAPTER, FeeRbRobustness=FALSE, FeeRbSecLevel=1
      Histogram6: FeeBlockSize=44, FeeImmediateData=FALSE, FeeNumberOfWriteCycles=1, FeeRbBlockPersistentId=19508, FeeRbOrigin=ADAPTER, FeeRbRobustness=FALSE, FeeRbSecLevel=1
      Histogram7: FeeBlockSize=24, FeeImmediateData=FALSE, FeeNumberOfWriteCycles=1, FeeRbBlockPersistentId=19849, FeeRbOrigin=ADAPTER, FeeRbRobustness=FALSE, FeeRbSecLevel=1
      Histogram8: FeeBlockSize=24, FeeImmediateData=FALSE, FeeNumberOfWriteCycles=1, FeeRbBlockPersistentId=13880, FeeRbOrigin=ADAPTER, FeeRbRobustness=FALSE, FeeRbSecLevel=1
      Histogram9: FeeBlockSize=40, FeeImmediateData=FALSE, FeeNumberOfWriteCycles=1, FeeRbBlockPersistentId=14217, FeeRbOrigin=ADAPTER, FeeRbRobustness=FALSE, FeeRbSecLevel=1
      IDurgIS: FeeBlockSize=8, FeeImmediateData=FALSE, FeeNumberOfWriteCycles=1, FeeRbBlockPersistentId=65356, FeeRbOrigin=ADAPTER, FeeRbRobustness=FALSE, FeeRbSecLevel=1
      OverWrPrevn: FeeBlockSize=8, FeeImmediateData=FALSE, FeeNumberOfWriteCycles=2, FeeRbBlockPersistentId=27289, FeeRbOrigin=ADAPTER, FeeRbRobustness=FALSE, FeeRbSecLevel=1
      QBatt: FeeBlockSize=12, FeeImmediateData=FALSE, FeeNumberOfWriteCycles=1, FeeRbBlockPersistentId=12195, FeeRbOrigin=ADAPTER, FeeRbRobustness=FALSE, FeeRbSecLevel=1
      RMeanHist: FeeBlockSize=16, FeeImmediateData=FALSE, FeeNumberOfWriteCycles=2, FeeRbBlockPersistentId=6432, FeeRbOrigin=ADAPTER, FeeRbRobustness=FALSE, FeeRbSecLevel=1
      BattROthMean: FeeBlockSize=16, FeeImmediateData=FALSE, FeeNumberOfWriteCycles=2, FeeRbBlockPersistentId=18478, FeeRbOrigin=ADAPTER, FeeRbRobustness=FALSE, FeeRbSecLevel=1
      BattROthMean4Dcyc: FeeBlockSize=16, FeeImmediateData=FALSE, FeeNumberOfWriteCycles=2, FeeRbBlockPersistentId=62451, FeeRbOrigin=ADAPTER, FeeRbRobustness=FALSE, FeeRbSecLevel=1
      Ti_U32: FeeBlockSize=8, FeeImmediateData=FALSE, FeeNumberOfWriteCycles=1, FeeRbBlockPersistentId=6676, FeeRbOrigin=ADAPTER, FeeRbRobustness=FALSE, FeeRbSecLevel=1
      UBattEBS: FeeBlockSize=8, FeeImmediateData=FALSE, FeeNumberOfWriteCycles=1, FeeRbBlockPersistentId=52852, FeeRbOrigin=ADAPTER, FeeRbRobustness=FALSE, FeeRbSecLevel=1
      UDurgIS: FeeBlockSize=12, FeeImmediateData=FALSE, FeeNumberOfWriteCycles=1, FeeRbBlockPersistentId=9645, FeeRbOrigin=ADAPTER, FeeRbRobustness=FALSE, FeeRbSecLevel=1
      UnstyDrkDchaI: FeeBlockSize=36, FeeImmediateData=FALSE, FeeNumberOfWriteCycles=1, FeeRbBlockPersistentId=33878, FeeRbOrigin=ADAPTER, FeeRbRobustness=FALSE, FeeRbSecLevel=1
      VehStc_Ti: FeeBlockSize=20, FeeImmediateData=FALSE, FeeNumberOfWriteCycles=1, FeeRbBlockPersistentId=42227, FeeRbOrigin=ADAPTER, FeeRbRobustness=FALSE, FeeRbSecLevel=1
      VehStc_Ti_IgnEF: FeeBlockSize=8, FeeImmediateData=FALSE, FeeNumberOfWriteCycles=2, FeeRbBlockPersistentId=40191, FeeRbOrigin=ADAPTER, FeeRbRobustness=FALSE, FeeRbSecLevel=1
      Envram: FeeBlockSize=16232, FeeImmediateData=FALSE, FeeNumberOfWriteCycles=1, FeeRbBlockPersistentId=50313, FeeRbOrigin=ADAPTER, FeeRbRobustness=TRUE, FeeRbSecLevel=1
    FeeGeneral:
      FeeDevErrorDetect = true
      FeeIndex = 0
      FeePollingMode = true
      FeeRbActSafetyChecks = true
      FeeRbActSurvivalEval = true
      FeeRbActUnknownBlockReorg = false
      FeeRbActUnknownBlockReorgCacheSize = 0
      FeeRbAddonsCCAS = false
      FeeRbConfirmSingleStorageBlockloss = true
      FeeRbFsSelect = FS2
      FeeRbMaintainRedundantBlocks = true
      FeeRbReadForce = false
      FeeSetModeSupported = false
      FeeVersionInfoApi = false
      FeeVirtualPageSize = 0
