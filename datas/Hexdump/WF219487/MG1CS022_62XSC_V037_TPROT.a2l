ASAP2_VERSION 1 60
/begin PROJECT MG1CS022 "MG1CS022"
/begin HEADER "" VERSION "MG1CS022_62XSC_V037_TPROT" PROJECT_NO MG1CS022 /end HEADER
/begin MODULE DIM ""
/begin MOD_COMMON "" BYTE_ORDER MSB_LAST ALIGNMENT_BYTE 1 ALIGNMENT_WORD 2 ALIGNMENT_LONG 4 ALIGNMENT_INT64 4 ALIGNMENT_FLOAT32_IEEE 4 ALIGNMENT_FLOAT64_IEEE 4 DATA_SIZE 32 /end MOD_COMMON
/begin CHARACTERISTIC HEGO_ctRiCalc_C "Number of calculations of the internal resistance" VALUE 0x805563F9 RB_Val_Wu8 255.0 dez 0.00 255.0 FORMAT "%5.1" /end CHARACTERISTIC
/begin CHARACTERISTIC HEGO_duErrElecMinLdPls_C "Threshold sensor voltage difference for electrical min error (short to ground)" VALUE 0x80556270 RB_Val_Wu16 4.998779 spg_q1p221Em3_V 0.00 4.998779 FORMAT "%8.6" EXTENDED_LIMITS 0.00 79.99878 /end CHARACTERISTIC
/begin CHARACTERISTIC HEGO_duErrElecSigLdPls_C "Threshold sensor voltage with Load for electrical sig error (wire interruption)" VALUE 0x80556272 RB_Val_Wu16 4.998779 spg_q1p221Em3_V 0.00 4.998779 FORMAT "%8.6" EXTENDED_LIMITS 0.00 79.99878 /end CHARACTERISTIC
/begin CHARACTERISTIC HEGO_duRiAftFrz_C "Voltage difference after freeze during Ri measurement" VALUE 0x805563FA RB_Val_Wu16 4.998779 spg_q1p221Em3_V 0.00 4.998779 FORMAT "%8.6" EXTENDED_LIMITS 0.00 79.99878 /end CHARACTERISTIC
/begin CHARACTERISTIC HEGO_duTCerChg_CUR "HEGO sensor voltage change caused by ceramic temperature change" CURVE 0x805563FC RB_Curve_U16_S16_Static 0.4166540 q6p357Em6_V_DIV_K -0.2083270 0.2083270 FORMAT "%9.7" EXTENDED_LIMITS -0.2083333 0.2083270
 /begin AXIS_DESCR STD_AXIS NO_INPUT_QUANTITY spg_q1p221Em3_V 16 0.00 4.998779 FORMAT "%8.6" EXTENDED_LIMITS 0.00 79.99878 DEPOSIT ABSOLUTE /end AXIS_DESCR
/end CHARACTERISTIC
/begin CHARACTERISTIC HEGO_flgDebDHtgAftStop_CW "Codebit debouncing of heater performance diagnosis after stop-phase" VALUE 0x80556300 RB_Val_Wu8 1.00000000000 B_TRUE 0.00 1.00000000000 FORMAT "%13.11" /end CHARACTERISTIC
/begin CHARACTERISTIC HEGO_flgDiDesLamChk_CW "Consideration of desired lambda value check for electrical diagnosis of short circuit to battery" VALUE 0x80556274 RB_Val_Wu8 1.00000000000 B_TRUE 0.00 1.00000000000 FORMAT "%13.11" /end CHARACTERISTIC
/begin CHARACTERISTIC HEGO_flgEnaElecMaxNplColdSnsr_CW "code word for enabilng the diagnoses heater coupling and short circuit to battery for cold sensor" VALUE 0x80556275 RB_Val_Wu8 1.00000000000 B_TRUE 0.00 1.00000000000 FORMAT "%13.11" /end CHARACTERISTIC
/begin CHARACTERISTIC HEGO_flgPmpO2Ref_C "CW for HEGO sensor type with pumped O2 reference" VALUE 0x80556276 RB_Val_Wu8 1.00000000000 B_TRUE 0.00 1.00000000000 FORMAT "%13.11" /end CHARACTERISTIC
/begin CHARACTERISTIC HEGO_flgS2B1Prsnt_C "calibration flag HEGO-sensor 2 bank 1 present" VALUE 0x8055643E RB_Val_Wu8 1.00000000000 B_TRUE 0.00 1.00000000000 FORMAT "%13.11" /end CHARACTERISTIC
/begin CHARACTERISTIC HEGO_flgS2UTNom_CW "Codebit calculation of HEGO sensor 2 voltage at nominal temperature" VALUE 0x8055643F RB_Val_Wu8 1.00000000000 B_TRUE 0.00 1.00000000000 FORMAT "%13.11" /end CHARACTERISTIC
/begin CHARACTERISTIC HEGO_flgSnsrOperRdnOverRi_CW "codeword choosing only Ri-condition for sensor operation readiness independant of sensor type" VALUE 0x80556277 RB_Val_Wu8 1.00000000000 B_TRUE 0.00 1.00000000000 FORMAT "%13.11" /end CHARACTERISTIC
/begin CHARACTERISTIC HEGO_flgVltgBasSymc_C "flag to choose the base sensor voltage for symmetrization" VALUE 0x80556440 RB_Val_Wu8 1.00000000000 B_TRUE 0.00 1.00000000000 FORMAT "%13.11" /end CHARACTERISTIC
/begin CHARACTERISTIC HEGO_flgVltgSymc_C "flag to activate symmetrization of HEGO sensor voltage" VALUE 0x80556441 RB_Val_Wu8 1.00000000000 B_TRUE 0.00 1.00000000000 FORMAT "%13.11" /end CHARACTERISTIC
/begin CHARACTERISTIC HEGO_nrTstPls_C "max. number of test pulses in a driving cycle" VALUE 0x805563DC RB_Val_Wu32 4294967295.00 OneToOne 0.00 4294967295.00 FORMAT "%13.2" /end CHARACTERISTIC
/begin CHARACTERISTIC HEGO_numMinVoltMeasmtElecMax_C "minimum number of voltage measurements sufficient for ElecMax (SCB) diagnosis debounce" VALUE 0x80556278 RB_Val_Wu8 254.0 dez 1.0 255.0 FORMAT "%5.1" EXTENDED_LIMITS 0.00 255.0 /end CHARACTERISTIC
/begin CHARACTERISTIC HEGO_numRiOkOpRdn_C "Threshold number of Ri measurements for sensor operation readiness" VALUE 0x80556279 RB_Val_Wu8 255.0 dez 0.00 255.0 FORMAT "%5.1" /end CHARACTERISTIC
/begin CHARACTERISTIC HEGO_OBDElecS2B1_I.stDElec_CW "Electrical diagnostics, HEGO sensor 2 bank 1 / Code word electrical diagnostics for HEGO sensors" VALUE 0x805562A0 RB_Val_Wu8 255.0 dez 0.00 255.0 FORMAT "%5.1" /end CHARACTERISTIC
/begin CHARACTERISTIC HEGO_OBDHtgS2B1_I.resRiThresDHtgLoTemp_MAP "Heater performance diagnosis, HEGO sensor 2 bank 1 / Map for internal resistance threshold for heater performance diagnosis, low temperature mode" MAP 0x80556344 RB_Map_U16U16_U16 131070.0 r_uw_q2 0.00 131070.0 FORMAT "%8.1"
 /begin AXIS_DESCR STD_AXIS HEGO_OBDHtgS2B1_I.tEGFlt temp_q0p0234_o273 5 -273.150 1262.827 FORMAT "%8.3" DEPOSIT ABSOLUTE /end AXIS_DESCR
 /begin AXIS_DESCR STD_AXIS HEGO_OBDHtgS2B1_I.pwrHtgFlt fak_q0p01 5 0.00 2.550000 FORMAT "%8.6" EXTENDED_LIMITS 0.00 655.3500 DEPOSIT ABSOLUTE /end AXIS_DESCR
/end CHARACTERISTIC
/begin CHARACTERISTIC HEGO_OBDHtgS2B1_I.resRiThresDHtg_MAP "Heater performance diagnosis, HEGO sensor 2 bank 1 / Map for internal resistance threshold for heater performance diagnosis" MAP 0x8055638E RB_Map_U16U16_U16 131070.0 r_uw_q2 0.00 131070.0 FORMAT "%8.1"
 /begin AXIS_DESCR STD_AXIS HEGO_OBDHtgS2B1_I.tEGFlt temp_q0p0234_o273 5 -273.150 1262.827 FORMAT "%8.3" DEPOSIT ABSOLUTE /end AXIS_DESCR
 /begin AXIS_DESCR STD_AXIS HEGO_OBDHtgS2B1_I.pwrHtgFlt fak_q0p01 5 0.00 2.550000 FORMAT "%8.6" EXTENDED_LIMITS 0.00 655.3500 DEPOSIT ABSOLUTE /end AXIS_DESCR
/end CHARACTERISTIC
/begin CHARACTERISTIC HEGO_OBDHtgS2B1_I.stDHtg_CW "Heater performance diagnosis, HEGO sensor 2 bank 1 / Code word heater performance diagnosis (class)" VALUE 0x805563D8 RB_Val_Wu8 255.0 dez 0.00 255.0 FORMAT "%5.1" /end CHARACTERISTIC
/begin CHARACTERISTIC HEGO_OBDHtrPsS2B1_I.tiDebDHtrPsEnaFst_C "Heater powerstage diagnostics, HEGO sensor 2 bank 1 / debounce time for enabling diagnosis of weak heater power stage, when condition for low heater current is given" VALUE 0x805563F4 RB_Val_Wu8 25.50 t_q0p1 0.00 25.50 FORMAT "%5.2" /end CHARACTERISTIC
/begin CHARACTERISTIC HEGO_OBDHtrPsS2B1_I.tiDebDHtrPsEna_C "Heater powerstage diagnostics, HEGO sensor 2 bank 1 / debounce time for enabling diagnosis of weak heater power stage, when condition for low heater current has to be achieved by heating up the sensor" VALUE 0x805563F5 RB_Val_Wu8 25.50 t_q0p1 0.00 25.50 FORMAT "%5.2" /end CHARACTERISTIC
/begin CHARACTERISTIC HEGO_OBDHtrPsS2B1_I.uBattMaxDHtrPs_C "Heater powerstage diagnostics, HEGO sensor 2 bank 1 / maximum voltage for heater power stage diagnosis, when sensor is not heated" VALUE 0x805563F6 RB_Val_Wu16 25.59961 spg_q0p00039 0.00 25.59961 FORMAT "%8.5" /end CHARACTERISTIC
/begin CHARACTERISTIC HEGO_OpRdnS2B1_I.flgHtgSuff_CW "Operating readiness, HEGO sensor 2 bank 1 / Codeword: considering bHtgSuff for setting sensor operation and diagnosis readines" VALUE 0x805562A8 RB_Val_Wu8 1.00000000000 B_TRUE 0.00 1.00000000000 FORMAT "%13.11" /end CHARACTERISTIC
/begin CHARACTERISTIC HEGO_OpRdnS2B1_I.stOpRdn_CW "Operating readiness, HEGO sensor 2 bank 1 / Code word operating readiness for HEGO sensors" VALUE 0x805562A9 RB_Val_Wu8 255.0 dez 0.00 255.0 FORMAT "%5.1" /end CHARACTERISTIC
/begin CHARACTERISTIC HEGO_OpRdnS2B1_I.tCerMdlThdExptOpRdn_C "Operating readiness, HEGO sensor 2 bank 1 / Modelled sensor ceramic temperature threshold for expected operation readiness" VALUE 0x805562AA RB_Val_Wu16 1535.977 temp_q0p0234_o273 -273.150 1262.827 FORMAT "%8.3" /end CHARACTERISTIC
/begin CHARACTERISTIC HEGO_OpRdnS2B1_I.tiDebErrStk_C "Operating readiness, HEGO sensor 2 bank 1 / Debouncing time for stuck error" VALUE 0x805562AC RB_Val_Wu16 6552.500 t_q0p1 1.000 6553.500 FORMAT "%8.3" EXTENDED_LIMITS 0.00 6553.500 /end CHARACTERISTIC
/begin CHARACTERISTIC HEGO_OpRdnS2B1_I.tiDebExptOpRdn_CUR "Operating readiness, HEGO sensor 2 bank 1 / Debouncing time for expected operating readiness" CURVE 0x805562AE RB_Curve_U16_U16 6553.500 t_q0p1 0.00 6553.500 FORMAT "%8.3"
 /begin AXIS_DESCR STD_AXIS HEGO_OpRdnS2B1_I.tEGOpRdn temp_q0p0234_om273 4 -273.150 1262.827 FORMAT "%8.3" DEPOSIT ABSOLUTE /end AXIS_DESCR
/end CHARACTERISTIC
/begin CHARACTERISTIC HEGO_OpRdnS2B1_I.tiDebPrtHtgFin_C "Operating readiness, HEGO sensor 2 bank 1 / Debouncing time protective heating finished" VALUE 0x805562C0 RB_Val_Wu16 6553.500 t_q0p1 0.00 6553.500 FORMAT "%8.3" /end CHARACTERISTIC
/begin CHARACTERISTIC HEGO_resErrElecSigRi_C "Threshold internal resistance for electrical sig error (wire interruption)" VALUE 0x8055627A RB_Val_Wu16 131070.0 r_uw_q2 0.00 131070.0 FORMAT "%8.1" /end CHARACTERISTIC
/begin CHARACTERISTIC HEGO_resRiHystDHtg_C "Internal resistance hysteresis for HEGO heater performance diagnostics" VALUE 0x80556302 RB_Val_Wu16 131070.0 r_uw_q2 0.00 131070.0 FORMAT "%8.1" /end CHARACTERISTIC
/begin CHARACTERISTIC HEGO_resRiMaxHtgSuff_C "Maximum value for internal resistance for sufficient heating" VALUE 0x80556304 RB_Val_Wu16 131070.0 r_uw_q2 0.00 131070.0 FORMAT "%8.1" /end CHARACTERISTIC
/begin CHARACTERISTIC HEGO_resRiNom_C "Nominal internal resistance Ri of HEGO sensors" VALUE 0x80556442 RB_Val_Wu16 131070.0 r_uw_q2 0.00 131070.0 FORMAT "%8.1" /end CHARACTERISTIC
/begin CHARACTERISTIC HEGO_resRiOpRdn_C "Threshold internal resistance for HEGO sensor operating readiness" VALUE 0x8055627C RB_Val_Wu16 131070.0 r_uw_q2 0.00 131070.0 FORMAT "%8.1" /end CHARACTERISTIC
/begin CHARACTERISTIC HEGO_resRiTCer_CUR "Internal sensor resistance as a function of the ceramic temperature" CURVE 0x80556444 RB_Curve_U16_U16 131070.0 r_uw_q2 0.00 131070.0 FORMAT "%8.1"
 /begin AXIS_DESCR STD_AXIS NO_INPUT_QUANTITY temp_q0p0234_o273 16 -273.150 1262.827 FORMAT "%8.3" DEPOSIT ABSOLUTE /end AXIS_DESCR
/end CHARACTERISTIC
/begin CHARACTERISTIC HEGO_resRstErrElecSigRi_C "Threshold internal resistance for reset of electrical sig error (wire interruption)" VALUE 0x8055627E RB_Val_Wu16 131070.0 r_uw_q2 0.00 131070.0 FORMAT "%8.1" /end CHARACTERISTIC
/begin CHARACTERISTIC HEGO_resTCerRiMax_C "Max resistance of sensor ceramic temperature curve" VALUE 0x80556486 RB_Val_Wu16 131070.0 r_uw_q2 0.00 131070.0 FORMAT "%8.1" /end CHARACTERISTIC
/begin CHARACTERISTIC HEGO_resTCerRiMin_C "Min resistance of sensor ceramic temperature curve" VALUE 0x80556488 RB_Val_Wu16 131070.0 r_uw_q2 0.00 131070.0 FORMAT "%8.1" /end CHARACTERISTIC
/begin CHARACTERISTIC HEGO_rS2LamLinCNGHiRes_CUR "Sensor characteristics (lambda linearization) for CNG, HEGO sensor 2" CURVE 0x8055648A RB_Curve_U16_U16 1.999969 fak_q3p0518Em5 0.00 1.999969 FORMAT "%8.6"
 /begin AXIS_DESCR STD_AXIS HEGO_uLamHiResS2 spg_q1p221Em3_V 24 0.00 4.998779 FORMAT "%8.6" EXTENDED_LIMITS 0.00 79.99878 DEPOSIT ABSOLUTE /end AXIS_DESCR
/end CHARACTERISTIC
/begin CHARACTERISTIC HEGO_rS2LamLinHiRes_CUR "Sensor characteristics (lambda linearization), HEGO sensor 2" CURVE 0x805564EC RB_Curve_U16_U16 1.999969 fak_q3p0518Em5 0.00 1.999969 FORMAT "%8.6"
 /begin AXIS_DESCR STD_AXIS HEGO_uLamHiResS2 spg_q1p221Em3_V 24 0.00 4.998779 FORMAT "%8.6" EXTENDED_LIMITS 0.00 79.99878 DEPOSIT ABSOLUTE /end AXIS_DESCR
/end CHARACTERISTIC
/begin CHARACTERISTIC HEGO_SensS2B1_I.facRiCorr_M "Signal acquisition of HEGO sensor 2 bank 1 / Correction factor for Ri, based on sensor voltage and exhaust gas temperature" MAP 0x8055666C RB_Map_U16S16_S16 3.999878 fak_uw_b8 0.00 3.999878 FORMAT "%8.6" EXTENDED_LIMITS -4.000000 3.999878
 /begin AXIS_DESCR STD_AXIS NO_INPUT_QUANTITY spg_q1p221Em3_V 4 0.00 4.998779 FORMAT "%8.6" EXTENDED_LIMITS 0.00 79.99878 DEPOSIT ABSOLUTE /end AXIS_DESCR
 /begin AXIS_DESCR STD_AXIS NO_INPUT_QUANTITY Temp_Cels 4 -3549.940 3003.560 FORMAT "%8.3" DEPOSIT ABSOLUTE /end AXIS_DESCR
/end CHARACTERISTIC
/begin CHARACTERISTIC HEGO_SensS2B1_I.tiDebEnaRiVltg_C "Signal acquisition of HEGO sensor 2 bank 1 / Debounce time of the sensor voltage enable condition for the measurement of the internal resistance" VALUE 0x805566A0 RB_Val_Wu8 2.550 t_q0p01 0.00 2.550 FORMAT "%5.3" /end CHARACTERISTIC
/begin CHARACTERISTIC HEGO_SensS2B1_I.uRiLoLim_C "Signal acquisition of HEGO sensor 2 bank 1 / Lower sensor voltage limit for the measurement of the internal resistance" VALUE 0x805566A2 RB_Val_Wu16 4.998779 spg_q1p221Em3_V 0.00 4.998779 FORMAT "%8.6" EXTENDED_LIMITS 0.00 79.99878 /end CHARACTERISTIC
/begin CHARACTERISTIC HEGO_SensS2B1_I.uRiOORLim_C "Signal acquisition of HEGO sensor 2 bank 1 / lower boundary (for certain error detection Out Of Range Low) of admissible voltage range for Ri-measurements" VALUE 0x805566A4 RB_Val_Wu16 4.998779 spg_q1p221Em3_V 0.00 4.998779 FORMAT "%8.6" EXTENDED_LIMITS 0.00 79.99878 /end CHARACTERISTIC
/begin CHARACTERISTIC HEGO_SensS2B1_I.uRiUpLim_C "Signal acquisition of HEGO sensor 2 bank 1 / Upper sensor voltage limit for the measurement of the internal resistance" VALUE 0x805566A6 RB_Val_Wu16 4.998779 spg_q1p221Em3_V 0.00 4.998779 FORMAT "%8.6" EXTENDED_LIMITS 0.00 79.99878 /end CHARACTERISTIC
/begin CHARACTERISTIC HEGO_SnsrTMdlS2B1_I.facHeatgPwrCnvnT_C "sensor temperature model, class instance sensor 2 bank 1 / Heat convection factor of sensor heater power to sensor temperature." VALUE 0x805562C8 RB_Val_Wu16 0.6553500 q0p00001_degC_DIV_W 0.00 0.6553500 FORMAT "%9.7" /end CHARACTERISTIC
/begin CHARACTERISTIC HEGO_SnsrTMdlS2B1_I.facTHeatFlowEgWall_C "sensor temperature model, class instance sensor 2 bank 1 / Heat convection factor of heat flow from exhaust wall to sensor temperature." VALUE 0x805562CA RB_Val_Wu16 65.53500 q0p001_W_DIV_K 0.00 65.53500 FORMAT "%8.5" /end CHARACTERISTIC
/begin CHARACTERISTIC HEGO_SnsrTMdlS2B1_I.facTHeatFlowEg_T "sensor temperature model, class instance sensor 2 bank 1 / Heat convection factor of heat flow from engine to sensor temperature" CURVE 0x805562CC RB_Curve_R32_U16_Static 65.53500 q0p001_W_DIV_K 0.00 65.53500 FORMAT "%8.5"
 /begin AXIS_DESCR STD_AXIS NO_INPUT_QUANTITY AirMassPerTime_float 5 0.00 50000.0000 FORMAT "%10.4" EXTENDED_LIMITS -3.40282347E+038 3.40282347E+038 DEPOSIT ABSOLUTE /end AXIS_DESCR
/end CHARACTERISTIC
/begin CHARACTERISTIC HEGO_SnsrTMdlS2B1_I.facTHeatFlowEng_C "sensor temperature model, class instance sensor 2 bank 1 / Heat convection factor of heat flow from engine to sensor temperature." VALUE 0x805562F0 RB_Val_Wu16 65.53500 q0p001_W_DIV_K 0.00 65.53500 FORMAT "%8.5" /end CHARACTERISTIC
/begin CHARACTERISTIC HEGO_SnsrTMdlS2B1_I.facTHeatFlowIntkAir_C "sensor temperature model, class instance sensor 2 bank 1 / Heat convection factor of heat flow from intake air to sensor temperature." VALUE 0x805562F2 RB_Val_Wu16 65.53500 q0p001_W_DIV_K 0.00 65.53500 FORMAT "%8.5" /end CHARACTERISTIC
/begin CHARACTERISTIC HEGO_SnsrTMdlS2B1_I.rHeatr_T "sensor temperature model, class instance sensor 2 bank 1 / Curve, heater resistance dependeng on modelled sensor ceramic temperature" CURVE 0x805562F4 RB_Curve_U16_U16 25.59961 r_q0p00039_Ohm 0.00 25.59961 FORMAT "%8.5"
 /begin AXIS_DESCR STD_AXIS HEGO_SnsrTMdlS2B1_I.tCerMdlWpDisp temp_q0p0234_om273 2 -273.150 1262.827 FORMAT "%8.3" DEPOSIT ABSOLUTE /end AXIS_DESCR
/end CHARACTERISTIC
/begin CHARACTERISTIC HEGO_SnsrTMdlS2B1_I.rLossHeatrPS_C "sensor temperature model, class instance sensor 2 bank 1 / parameter: resistance of heater supply line, for considering voltage drop of battery voltage for sensor heater" VALUE 0x805562FE RB_Val_Wu16 25.59961 r_q0p00039_Ohm 0.00 25.59961 FORMAT "%8.5" /end CHARACTERISTIC
/begin CHARACTERISTIC HEGO_stDElec_CW "Codeword for electrical diagnostics for HEGO sensors" VALUE 0x80556280 RB_Val_Wu8 255.0 dez 0.00 255.0 FORMAT "%5.1" /end CHARACTERISTIC
/begin CHARACTERISTIC HEGO_stHeatrPSDiagDeactvn_C "Codeword Deactivation Diagnosis Powerstage Heater" VALUE 0x805563E0 RB_Val_Wu16 65535.00 dez 0.00 65535.00 FORMAT "%8.2" /end CHARACTERISTIC
/begin CHARACTERISTIC HEGO_stS2DHtg_CW "Code word heater performance diagnosis, HEGO sensor 2" VALUE 0x80556306 RB_Val_Wu8 255.0 dez 0.00 255.0 FORMAT "%5.1" /end CHARACTERISTIC
/begin CHARACTERISTIC HEGO_stS2Ps_CW "Code word heater powerstage, HEGO sensor 2" VALUE 0x805563E2 RB_Val_Wu8 255.0 dez 0.00 255.0 FORMAT "%5.1" /end CHARACTERISTIC
/begin CHARACTERISTIC HEGO_stSensHw_CW "Code word HEGO sensor hardware" VALUE 0x8055654E RB_Val_Wu8 255.0 dez 0.00 255.0 FORMAT "%5.1" /end CHARACTERISTIC
/begin CHARACTERISTIC HEGO_stSens_CW "Code word HEGO_Sens" VALUE 0x805563F8 RB_Val_Wu8 255.0 dez 0.00 255.0 FORMAT "%5.1" /end CHARACTERISTIC
/begin CHARACTERISTIC HEGO_tAmbMinDHtrPs_C "Ambient temperature threshold for HEGO heater power stage diagnosis" VALUE 0x805563E4 RB_Val_Ws16 6553.500 Temp_Cels -3549.940 3003.560 FORMAT "%8.3" /end CHARACTERISTIC
/begin CHARACTERISTIC HEGO_tCerRi_CUR "HEGO sensor ceramic temperature as a function of internal resistance" CURVE 0x80556550 RB_Curve_U16_U16 1535.977 temp_q0p0234_o273 -273.150 1262.827 FORMAT "%8.3"
 /begin AXIS_DESCR STD_AXIS NO_INPUT_QUANTITY r_uw_q2 16 0.00 131070.0 FORMAT "%8.1" DEPOSIT ABSOLUTE /end AXIS_DESCR
/end CHARACTERISTIC
/begin CHARACTERISTIC HEGO_tEGDHtgMax_C "Maximum exhaust gas temperature for heater performance diagnosis" VALUE 0x80556308 RB_Val_Wu16 1535.977 temp_q0p0234_o273 -273.150 1262.827 FORMAT "%8.3" /end CHARACTERISTIC
/begin CHARACTERISTIC HEGO_tEGDHtgMin_C "Minimum exhaust gas temperature for heater performance diagnosis" VALUE 0x8055630A RB_Val_Wu16 1535.977 temp_q0p0234_o273 -273.150 1262.827 FORMAT "%8.3" /end CHARACTERISTIC
/begin CHARACTERISTIC HEGO_tEGDHtgShrtTrpMax_C "Maximum exhaust gas temperature for heater performance diagnosis in short trip" VALUE 0x8055630C RB_Val_Wu16 1535.977 temp_q0p0234_o273 -273.150 1262.827 FORMAT "%8.3" /end CHARACTERISTIC
/begin CHARACTERISTIC HEGO_tEGDHtgShrtTrpMin_C "Minimum exhaust gas tempearture for heater performance diagnosis in short trip" VALUE 0x8055630E RB_Val_Wu16 1535.977 temp_q0p0234_o273 -273.150 1262.827 FORMAT "%8.3" /end CHARACTERISTIC
/begin CHARACTERISTIC HEGO_tEGErrElecSigRi_C "Threshold exhaust gas temperature for electrical sig error (wire interruption) due to Ri" VALUE 0x80556282 RB_Val_Wu16 1535.977 temp_q0p0234_om273 -273.150 1262.827 FORMAT "%8.3" /end CHARACTERISTIC
/begin CHARACTERISTIC HEGO_tEGFltMin_C "Mimimum filtered exhaust gas temperature" VALUE 0x80556310 RB_Val_Wu16 1535.977 temp_q0p0234_o273 -273.150 1262.827 FORMAT "%8.3" /end CHARACTERISTIC
/begin CHARACTERISTIC HEGO_tiBtwElecFlt_C "time between test pulses for electrical errors" VALUE 0x805563E6 RB_Val_Wu16 655350.0 Time_ms 0.00 655350.0 FORMAT "%8.1" /end CHARACTERISTIC
/begin CHARACTERISTIC HEGO_tiBtwOTFlt_C "time between test pulses for overtemperature error" VALUE 0x805563E8 RB_Val_Wu16 655.3500 Time_s 0.00 655.3500 FORMAT "%8.4" /end CHARACTERISTIC
/begin CHARACTERISTIC HEGO_tiDebDHtgFuncReq_C "Debouncing time function request for heater performance diagnosis" VALUE 0x80556312 RB_Val_Wu8 25.50 t_q0p1 0.00 25.50 FORMAT "%5.2" /end CHARACTERISTIC
/begin CHARACTERISTIC HEGO_tiDebDHtgStop_C "Debouncing time stop phase for heater performance diagnosis" VALUE 0x80556314 RB_Val_Wu16 6553.500 t_q0p1 0.00 6553.500 FORMAT "%8.3" /end CHARACTERISTIC
/begin CHARACTERISTIC HEGO_tiDebDHtgStrt_C "Debouncing time start phase for heater performance diagnosis" VALUE 0x80556316 RB_Val_Wu16 6553.500 t_q0p1 0.00 6553.500 FORMAT "%8.3" /end CHARACTERISTIC
/begin CHARACTERISTIC HEGO_tiDebDPERiThresDHtg_C "Debouncing time for dew-point end to switch Ri threshold" VALUE 0x80556318 RB_Val_Wu8 25.50 t_q0p1 0.00 25.50 FORMAT "%5.2" /end CHARACTERISTIC
/begin CHARACTERISTIC HEGO_tiDebEnaDHtgCtlExt_C "Debouncing time for external heating control heating performance diagnosis enable" VALUE 0x80556319 RB_Val_Wu8 25.50 t_q0p1 0.00 25.50 FORMAT "%5.2" /end CHARACTERISTIC
/begin CHARACTERISTIC HEGO_tiDebErrElecMax_C "Debouncing time for electrical max error (short to battery voltage)" VALUE 0x80556284 RB_Val_Wu8 25.50 t_q0p1 0.00 25.50 FORMAT "%5.2" /end CHARACTERISTIC
/begin CHARACTERISTIC HEGO_tiDebErrElecMinSus_C "Debouncing time for electrical min error suspicion" VALUE 0x80556285 RB_Val_Wu8 25.50 t_q0p1 0.00 25.50 FORMAT "%5.2" /end CHARACTERISTIC
/begin CHARACTERISTIC HEGO_tiDebErrElecMin_C "Debouncing time for electrical min error (short to ground)" VALUE 0x80556286 RB_Val_Wu8 25.50 t_q0p1 0.00 25.50 FORMAT "%5.2" /end CHARACTERISTIC
/begin CHARACTERISTIC HEGO_tiDebErrElecSigSus_C "Debouncing time for electrical sig error suspicion" VALUE 0x80556287 RB_Val_Wu8 25.50 t_q0p1 0.00 25.50 FORMAT "%5.2" /end CHARACTERISTIC
/begin CHARACTERISTIC HEGO_tiDebErrHtgFIDRls_C "Debouncing time heater performance error after FID release" VALUE 0x8055631A RB_Val_Wu16 6553.500 t_q0p1 0.00 6553.500 FORMAT "%8.3" /end CHARACTERISTIC
/begin CHARACTERISTIC HEGO_tiDebErrHtg_C "Debouncing time heater performance error" VALUE 0x8055631C RB_Val_Wu8 25.50 t_q0p1 0.00 25.50 FORMAT "%5.2" /end CHARACTERISTIC
/begin CHARACTERISTIC HEGO_tiDebGenDElec_C "General debouncing time for electrical diagnostics" VALUE 0x80556288 RB_Val_Wu8 25.50 t_q0p1 0.00 25.50 FORMAT "%5.2" /end CHARACTERISTIC
/begin CHARACTERISTIC HEGO_tiDebHealHtgErr_C "Debouncing time healing for heater performance diagnosis in case of error" VALUE 0x8055631D RB_Val_Wu8 25.50 t_q0p1 0.00 25.50 FORMAT "%5.2" /end CHARACTERISTIC
/begin CHARACTERISTIC HEGO_tiDebHealHtg_C "Debouncing time healing for heater performance diagnosis" VALUE 0x8055631E RB_Val_Wu8 25.50 t_q0p1 0.00 25.50 FORMAT "%5.2" /end CHARACTERISTIC
/begin CHARACTERISTIC HEGO_tiDebRstErrStkCVB_C "Debouncing time for reset of error stuck in countervoltage band" VALUE 0x80556289 RB_Val_Wu8 25.50 t_q0p1 0.00 25.50 FORMAT "%5.2" /end CHARACTERISTIC
/begin CHARACTERISTIC HEGO_tiDebStrtEndDHtg_C "Debouncing time for PID41 after start end for heater performance diagnostics" VALUE 0x8055631F RB_Val_Wu8 25.50 t_q0p1 0.00 25.50 FORMAT "%5.2" /end CHARACTERISTIC
/begin CHARACTERISTIC HEGO_tiDebTAmbHtrPs_C "Debouncing time for valid ambient temperature" VALUE 0x805563EA RB_Val_Wu8 25.50 t_q0p1 0.00 25.50 FORMAT "%5.2" /end CHARACTERISTIC
/begin CHARACTERISTIC HEGO_tiDelLdPlsMin_C "Delay time between two load pulses in case of min error suspicion" VALUE 0x8055628A RB_Val_Wu8 25.40 t_q0p1 0.10 25.50 FORMAT "%5.2" EXTENDED_LIMITS 0.00 25.50 /end CHARACTERISTIC
/begin CHARACTERISTIC HEGO_tiDelLdPlsSig_C "Delay time between two load pulses in case of sig error suspicion" VALUE 0x8055628B RB_Val_Wu8 25.40 t_q0p1 0.10 25.50 FORMAT "%5.2" EXTENDED_LIMITS 0.00 25.50 /end CHARACTERISTIC
/begin CHARACTERISTIC HEGO_tiDelLdPls_C "Waiting time between two load pulses" VALUE 0x80556592 RB_Val_Wu16 6553.300 t_q0p1 0.200 6553.500 FORMAT "%8.3" EXTENDED_LIMITS 0.00 6553.500 /end CHARACTERISTIC
/begin CHARACTERISTIC HEGO_tiDelOpRdnRiPls_C "Waiting time between Ri pulses for operating readiness detection" VALUE 0x80556594 RB_Val_Wu8 25.30 t_q0p1 0.20 25.50 FORMAT "%5.2" EXTENDED_LIMITS 0.00 25.50 /end CHARACTERISTIC
/begin CHARACTERISTIC HEGO_tiDelRiPls_C "Delay time between two Ri measurement pulses" VALUE 0x80556595 RB_Val_Wu8 2.550 t_q0p01 0.00 2.550 FORMAT "%5.3" /end CHARACTERISTIC
/begin CHARACTERISTIC HEGO_tiEngStopDHtgMin_C "Minimum engine stop time for heater performance diagnosis" VALUE 0x80556320 RB_Val_Wu16 65535.00 t_q1 0.00 65535.00 FORMAT "%8.2" /end CHARACTERISTIC
/begin CHARACTERISTIC HEGO_tiFltPwrHtg_C "Heater power filter time constant for heater performance diagnosis" VALUE 0x80556322 RB_Val_Wu16 6553.4999985 zk100msxs_uw_b6553p6 0.1000015 6553.6000000 FORMAT "%12.7" EXTENDED_LIMITS 0.10000152590 6553.6000000 /end CHARACTERISTIC
/begin CHARACTERISTIC HEGO_tiFltTempEG_CUR "Exhaust gas temperature filter time constant for heater performance diagnosis" CURVE 0x80556324 RB_Curve_U16_U16 6553.4999985 zk100msxs_uw_b6553p6 0.1000015 6553.6000000 FORMAT "%12.7" EXTENDED_LIMITS 0.10000152590 6553.6000000
 /begin AXIS_DESCR STD_AXIS NO_INPUT_QUANTITY m_q0p1 5 0.00 6553.500 FORMAT "%8.3" DEPOSIT ABSOLUTE /end AXIS_DESCR
/end CHARACTERISTIC
/begin CHARACTERISTIC HEGO_tIntkAirDHtgMin_C "Minimum intake air temperature for heater performance diagnosis" VALUE 0x8055633A RB_Val_Wu8 191.3 temp_q0p75_om48 -48.0 143.3 FORMAT "%5.1" /end CHARACTERISTIC
/begin CHARACTERISTIC HEGO_tiPolarRedPls_C "Duration of pulse for polarization reduction" VALUE 0x80556596 RB_Val_Wu8 0.01500 t_q0p001 0.00 0.01500 FORMAT "%7.5" EXTENDED_LIMITS 0.00 0.2550 /end CHARACTERISTIC
/begin CHARACTERISTIC HEGO_tiS2FrzSigRiAcqn_C "Sensor signal freeze time after measurement of internal resistance, HEGO sensor 2" VALUE 0x80556597 RB_Val_Wu8 2.540 t_q0p01 0.010 2.550 FORMAT "%5.3" EXTENDED_LIMITS 0.00 2.550 /end CHARACTERISTIC
/begin CHARACTERISTIC HEGO_tiSmotngSymc_C "Time constant for smoothing of sensor voltage in case of symmetrization" VALUE 0x80556598 RB_Val_Wu16 655.3400 t_q0p01 0.0100 655.3500 FORMAT "%8.4" EXTENDED_LIMITS 0.00 655.3500 /end CHARACTERISTIC
/begin CHARACTERISTIC HEGO_uBattDHeatgMax_C "Maximum battery voltage for heater performance diagnosis" VALUE 0x8055633C RB_Val_Ws16 1310700. Volt_Batt -655360.0 655340.0 FORMAT "%8.1" /end CHARACTERISTIC
/begin CHARACTERISTIC HEGO_uBattDHeatgMin_C "Mimimum battery voltage for heater performance diagnosis" VALUE 0x8055633E RB_Val_Ws16 1310700. Volt_Batt -655360.0 655340.0 FORMAT "%8.1" /end CHARACTERISTIC
/begin CHARACTERISTIC HEGO_uBattMinDElec_C "Minimum battery voltage for electrical diagnostics" VALUE 0x8055628C RB_Val_Wu8 25.50 spg_q0p1 0.00 25.50 FORMAT "%5.2" /end CHARACTERISTIC
/begin CHARACTERISTIC HEGO_uBattMinDHtrPs_C "minimum battery voltage for heater power stage diagnosis" VALUE 0x805563EC RB_Val_Wu16 25.59961 spg_q0p00039 0.00 25.59961 FORMAT "%8.5" /end CHARACTERISTIC
/begin CHARACTERISTIC HEGO_uErrElecMaxColdSnsr_C "Sensor voltage threshold for Elec-Max fault for cold sensor" VALUE 0x8055628E RB_Val_Wu16 4.995117 spg_q0p00488 0.00 4.995117 FORMAT "%8.6" EXTENDED_LIMITS 0.00 319.9951 /end CHARACTERISTIC
/begin CHARACTERISTIC HEGO_uErrElecMaxNormOper_C "signal line SCB diagnosis threshold for fully heated sensor" VALUE 0x80556290 RB_Val_Wu16 4.995117 spg_q0p00488 0.00 4.995117 FORMAT "%8.6" EXTENDED_LIMITS 0.00 319.9951 /end CHARACTERISTIC
/begin CHARACTERISTIC HEGO_uErrElecMinORRLow_C "Out-of-range-low voltage-threshold (Elec-Min fault criterion) for LSFX4" VALUE 0x80556292 RB_Val_Wu16 4.995117 spg_q0p00488 0.00 4.995117 FORMAT "%8.6" EXTENDED_LIMITS 0.00 319.9951 /end CHARACTERISTIC
/begin CHARACTERISTIC HEGO_uErrElecMin_C "Voltage threshold for electrical min error (short to ground)" VALUE 0x80556294 RB_Val_Wu16 4.995117 spg_q0p00488 0.00 4.995117 FORMAT "%8.6" EXTENDED_LIMITS 0.00 319.9951 /end CHARACTERISTIC
/begin CHARACTERISTIC HEGO_uS23LeanOpRdn_C "Threshold lean voltage for operating readiness, HEGO sensors 2 and 3" VALUE 0x80556296 RB_Val_Wu16 4.995117 spg_q0p00488 0.00 4.995117 FORMAT "%8.6" EXTENDED_LIMITS 0.00 319.9951 /end CHARACTERISTIC
/begin CHARACTERISTIC HEGO_uS23RichOpRdn_C "Threshold rich voltage for operating readiness, HEGO sensors 2 and 3" VALUE 0x80556298 RB_Val_Wu16 4.995117 spg_q0p00488 0.00 4.995117 FORMAT "%8.6" EXTENDED_LIMITS 0.00 319.9951 /end CHARACTERISTIC
/begin CHARACTERISTIC HEGO_uS2InvLamLinCNGHiRes_CUR "Sensor characteristics (inverse lambda linearization) for CNG, HEGO sensor 2" CURVE 0x8055659A RB_Curve_U16_U16 4.998779 spg_q1p221Em3_V 0.00 4.998779 FORMAT "%8.6" EXTENDED_LIMITS 0.00 79.99878
 /begin AXIS_DESCR STD_AXIS HEGO_facLamLinHiResS2 fak_q3p0518Em5 24 0.00 1.999969 FORMAT "%8.6" DEPOSIT ABSOLUTE /end AXIS_DESCR
/end CHARACTERISTIC
/begin CHARACTERISTIC HEGO_uS2InvLamLinHiRes_CUR "Sensor characteristics (inverse lambda linearization), HEGO sensor 2" CURVE 0x805565FC RB_Curve_U16_U16 4.998779 spg_q1p221Em3_V 0.00 4.998779 FORMAT "%8.6" EXTENDED_LIMITS 0.00 79.99878
 /begin AXIS_DESCR STD_AXIS HEGO_facLamLinHiResS2 fak_q3p0518Em5 24 0.00 1.999969 FORMAT "%8.6" DEPOSIT ABSOLUTE /end AXIS_DESCR
/end CHARACTERISTIC
/begin CHARACTERISTIC HESrv_numBnk_CA "Stores which cylinder belongs to which bank" VAL_BLK 0x805566A8 ValA_Wu8 1.000 OneToOne 0.00 1.000 FORMAT "%5.3" EXTENDED_LIMITS 0.00 255.0 NUMBER 4 /end CHARACTERISTIC
/begin CHARACTERISTIC HESrv_stRmtInjVlv_CA "Stores which cylinder belongs to which ECU" VAL_BLK 0x805566AC ValA_Wu8 1.000 OneToOne 0.00 1.000 FORMAT "%5.3" EXTENDED_LIMITS 0.00 255.0 NUMBER 4 /end CHARACTERISTIC
/begin CHARACTERISTIC HESrv_swtMSidConf_C "MSid configuration switch" VALUE 0x805566B2 Val_Wu8 255.0 OneToOne 0.00 255.0 FORMAT "%5.1" /end CHARACTERISTIC
/begin CHARACTERISTIC HESrv_swtPOpVis_C "Calibration parameter to select the bank used for working point indication of a common CURVE/MAP within a twin-flow system" VALUE 0x805566B0 Val_Wu8 1.00000000000 HESrv_SwtPOpVis 0.00 1.00000000000 FORMAT "%13.11" /end CHARACTERISTIC
/begin CHARACTERISTIC HESrv_swtScndFlwActv_C "Calibration parameter to switch off the second flow within a twin-flow system if this feature was enabled" VALUE 0x805566B1 Val_Wu8 1.000 OneToOne 0.00 1.000 FORMAT "%5.3" EXTENDED_LIMITS 0.00 255.0 /end CHARACTERISTIC
/begin CHARACTERISTIC HLSDem_aLASMax_C "Maximum allowed vehicle acceleration for the release of the vehicle acceleration dependent low idle speed setpoint offset" VALUE 0x805566B4 RB_Val_Ws16 65.53500 Acc -32.76800 32.76700 FORMAT "%8.5" /end CHARACTERISTIC
/begin CHARACTERISTIC HLSDem_aLASMin_C "Minimum allowed vehicle acceleration for the release of the vehicle acceleration dependent low idle speed setpoint offset" VALUE 0x805566B6 RB_Val_Ws16 65.53500 Acc -32.76800 32.76700 FORMAT "%8.5" /end CHARACTERISTIC
/begin CHARACTERISTIC HLSDem_dKnCtlSlopNeg_C "Negative slope for limitation in case of active safety ignition retardation" VALUE 0x80556A0C RB_Val_Wu16 32767.50 EngNGrd 0.00 32767.50 FORMAT "%8.2" /end CHARACTERISTIC
/begin CHARACTERISTIC HLSDem_dKnCtlSlopPos_C "Positive slope for limitation in case of active safety ignition retardation" VALUE 0x80556A0E RB_Val_Wu16 32767.50 EngNGrd 0.00 32767.50 FORMAT "%8.2" /end CHARACTERISTIC
/begin CHARACTERISTIC HLSDem_dpMstCylBrkRightHysDelta_C "Threshold for the hysteresis used for the slope of the master cylinder pressure for the activation of drive-off support" VALUE 0x805566B8 RB_Val_Ws16 6553500. PreshPa_10ms -3276800. 3276700. FORMAT "%8.0" /end CHARACTERISTIC
/begin CHARACTERISTIC HLSDem_drClthHysMax_C "Derivative upper threshold to enable drive off support in hysteresis" VALUE 0x805566BA RB_Val_Ws16 255.9961 Prc_Fact256 -128.0000 127.9961 FORMAT "%8.4" /end CHARACTERISTIC
/begin CHARACTERISTIC HLSDem_drClthHysMin_C "Derivative lower threshold to enable drive off support in hysteresis" VALUE 0x805566BC RB_Val_Ws16 255.9961 Prc_Fact256 -128.0000 127.9961 FORMAT "%8.4" /end CHARACTERISTIC
/begin CHARACTERISTIC HLSDem_DrvOffSuprtMstCyldp_CUR "master cylinder brake pressure gradient" CURVE 0x805566BE RB_Curve_S16_S16 6553500. PreshPa_10ms -3276800. 3276700. FORMAT "%8.0"
 /begin AXIS_DESCR STD_AXIS HLSDem_pMstCylBrk p_ub_q10 6 -327680.0 327670.0 FORMAT "%8.1" DEPOSIT ABSOLUTE /end AXIS_DESCR
/end CHARACTERISTIC
/begin CHARACTERISTIC HLSDem_DrvOffSuprtRampHiGrdtNegSlop_C "Negative slope parameter for the drive-off setpoint ramp when the vehicle speed is above a threshold" VALUE 0x805566D8 RB_Val_Ws32 32767999.9924 RmpEngN -16384000.0000 16383999.9924 FORMAT "%13.4" /end CHARACTERISTIC
/begin CHARACTERISTIC HLSDem_DrvOffSuprtRampHiGrdtPosSlop_C "Positive slope parameter for the drive-off setpoint ramp when the vehicle speed is above a threshold" VALUE 0x805566DC RB_Val_Ws32 32767999.9924 RmpEngN -16384000.0000 16383999.9924 FORMAT "%13.4" /end CHARACTERISTIC
/begin CHARACTERISTIC HLSDem_DrvOffSuprtRampLoGrdtNegSlop_C "Negative slope parameter for the drive-off setpoint ramp when the vehicle speed is below a threshold" VALUE 0x805566E0 RB_Val_Ws32 32767999.9924 RmpEngN -16384000.0000 16383999.9924 FORMAT "%13.4" /end CHARACTERISTIC
/begin CHARACTERISTIC HLSDem_DrvOffSuprtRampLoGrdtPosSlop_C "Positive slope parameter for the drive-off setpoint ramp when the vehicle speed is below a threshold" VALUE 0x805566E4 RB_Val_Ws32 32767999.9924 RmpEngN -16384000.0000 16383999.9924 FORMAT "%13.4" /end CHARACTERISTIC
/begin CHARACTERISTIC HLSDem_DrvOffSuprtSpIncrNeg_C "Negetive ramp parameter for driveoff setpoint increase" VALUE 0x805566E8 RB_Val_Ws16 32767.50 nmot_sw_q0p5 -16384.00 16383.50 FORMAT "%8.2" /end CHARACTERISTIC
/begin CHARACTERISTIC HLSDem_DrvOffSuprtSpIncrPos_C "Positive ramp parameter for driveoff setpoint increase" VALUE 0x805566EA RB_Val_Ws16 32767.50 nmot_sw_q0p5 -16384.00 16383.50 FORMAT "%8.2" /end CHARACTERISTIC
/begin CHARACTERISTIC HLSDem_dtOilHys_C "Delta temperature to calculate the upper limit of the the hysterisis , for the calculation of oil temperature." VALUE 0x80556A10 RB_Val_Ws16 6553.500 Temp_Cels -3549.940 3003.560 FORMAT "%8.3" /end CHARACTERISTIC
/begin CHARACTERISTIC HLSDem_dtWrmHys_C "Delta temperature for the hysteresis in the calculation of warm up status." VALUE 0x80556A12 RB_Val_Ws16 6553.500 Temp_Cels -3549.940 3003.560 FORMAT "%8.3" /end CHARACTERISTIC
/begin CHARACTERISTIC HLSDem_facAirOvhtPrv_MAP "Weighting factor for NMAX-limitation, dependent on intake air temperature" MAP 0x80556A14 RB_Map_S16S16_S16 7.999878 Fact -4.000000 3.999878 FORMAT "%8.6"
 /begin AXIS_DESCR STD_AXIS HLSDem_tAir_mp Temp_Cels 8 -3549.940 3003.560 FORMAT "%8.3" DEPOSIT ABSOLUTE /end AXIS_DESCR
 /begin AXIS_DESCR STD_AXIS Epm_nEng EngN 8 -16384.00 16383.50 FORMAT "%8.2" DEPOSIT ABSOLUTE /end AXIS_DESCR
/end CHARACTERISTIC
/begin CHARACTERISTIC HLSDem_facCTOvhtPrvMax_MAP "Weighting factor for NMAX-limitation, dependent on temperature of coolant medium" MAP 0x80556AB8 RB_Map_S16S16_S16 7.999878 Fact -4.000000 3.999878 FORMAT "%8.6"
 /begin AXIS_DESCR STD_AXIS CEngDsT_t Temp_Cels 8 -3549.940 3003.560 FORMAT "%8.3" DEPOSIT ABSOLUTE /end AXIS_DESCR
 /begin AXIS_DESCR STD_AXIS VehV_v Vel 8 -327.6800 327.6700 FORMAT "%8.4" DEPOSIT ABSOLUTE /end AXIS_DESCR
/end CHARACTERISTIC
/begin CHARACTERISTIC HLSDem_facDrvOffCouplRaceOffs_C "Factor for coupling condition offset for drive off support for race mode" VALUE 0x805566EC RB_Val_Wu8 25.50 Fact_q0p1_COMPU 0.00 25.50 FORMAT "%5.2" /end CHARACTERISTIC
/begin CHARACTERISTIC HLSDem_facDrvOffCouplSprtOffs_C "Factor for coupling condition offset for drive off support for sport mode" VALUE 0x805566ED RB_Val_Wu8 25.50 Fact_q0p1_COMPU 0.00 25.50 FORMAT "%5.2" /end CHARACTERISTIC
/begin CHARACTERISTIC HLSDem_facDrvOffDeadZoneRaceOffs_C "Factor for Accelerator dead way condition offset for drive off support for race mode" VALUE 0x805566EE RB_Val_Wu8 25.50 Fact_q0p1_COMPU 0.00 25.50 FORMAT "%5.2" /end CHARACTERISTIC
/begin CHARACTERISTIC HLSDem_facDrvOffDeadZoneSprtOffs_C "Factor for Accelerator dead way condition offset for drive off support for sport mode" VALUE 0x805566EF RB_Val_Wu8 25.50 Fact_q0p1_COMPU 0.00 25.50 FORMAT "%5.2" /end CHARACTERISTIC
/begin CHARACTERISTIC HLSDem_facDrvOffGearRat_CUR "Clutch-slip dependent curve for a factor for the calculation of the low idle speed setpoint offset in the case of a non-analogous clutch sensor" CURVE 0x805566F0 RB_Curve_S16_S16 7.999878 Fact -4.000000 3.999878 FORMAT "%8.6"
 /begin AXIS_DESCR STD_AXIS HLSDem_rGearDrvOffFlt Fact_10000 8 -3.276800 3.276700 FORMAT "%8.6" DEPOSIT ABSOLUTE /end AXIS_DESCR
/end CHARACTERISTIC
/begin CHARACTERISTIC HLSDem_facDrvOffsLAS_CUR "Vehicle acceleration dependent curve for a factor for the calculation of the low idle speed setpoint offset in the case of a non-analogous clutch sensor" CURVE 0x80556712 RB_Curve_S16_S16 7.999878 Fact -4.000000 3.999878 FORMAT "%8.6"
 /begin AXIS_DESCR STD_AXIS LAS_a Acc 8 -32.76800 32.76700 FORMAT "%8.5" DEPOSIT ABSOLUTE /end AXIS_DESCR
/end CHARACTERISTIC
/begin CHARACTERISTIC HLSDem_facDrvOffSuprtRaceOffs_C "Factor for Drive-Off Condition offset for drive off support for race mode" VALUE 0x80556734 RB_Val_Wu8 25.50 Fact_q0p1_COMPU 0.00 25.50 FORMAT "%5.2" /end CHARACTERISTIC
/begin CHARACTERISTIC HLSDem_facDrvOffSuprtSprtOffs_C "Factor for Drive-Off Condition offset for drive off support for sport mode" VALUE 0x80556735 RB_Val_Wu8 25.50 Fact_q0p1_COMPU 0.00 25.50 FORMAT "%5.2" /end CHARACTERISTIC
/begin CHARACTERISTIC HLSDem_facFlTempMax_MAP "Weighting factor for NMAX-limitation, dependent on fuel temperature" MAP 0x80556B5C RB_Map_S16S16_S16 7.999878 Fact -4.000000 3.999878 FORMAT "%8.6"
 /begin AXIS_DESCR STD_AXIS FuelT_t Temp_Cels 8 -3549.940 3003.560 FORMAT "%8.3" DEPOSIT ABSOLUTE /end AXIS_DESCR
 /begin AXIS_DESCR STD_AXIS Epm_nEng EngN 8 -16384.00 16383.50 FORMAT "%8.2" DEPOSIT ABSOLUTE /end AXIS_DESCR
/end CHARACTERISTIC
/begin CHARACTERISTIC HLSDem_facOffsAppDeadZoneNorm_C "Factor for Accelerator dead way condition offset for drive off support for normal mode" VALUE 0x80556736 RB_Val_Wu8 25.50 Fact_q0p1_COMPU 0.00 25.50 FORMAT "%5.2" /end CHARACTERISTIC
/begin CHARACTERISTIC HLSDem_facOffsCouplNorm_C "Factor for coupling condition offset for drive off support for normal mode" VALUE 0x80556737 RB_Val_Wu8 25.50 Fact_q0p1_COMPU 0.00 25.50 FORMAT "%5.2" /end CHARACTERISTIC
/begin CHARACTERISTIC HLSDem_facOffsDrvOffClthKisspnt_CUR "Factor for the offset of the low idle speed setpoint in dependency of the deviation of the analog clutch signal from modified kiss point" CURVE 0x80556738 RB_Curve_S16_S16 7.999878 Fact -4.000000 3.999878 FORMAT "%8.6"
 /begin AXIS_DESCR STD_AXIS HLSDem_rClthKisspntDiff Prc_Fact256 8 -128.0000 127.9961 FORMAT "%8.4" DEPOSIT ABSOLUTE /end AXIS_DESCR
/end CHARACTERISTIC
/begin CHARACTERISTIC HLSDem_facOffsDrvOffNorm_C "Factor for Drive-Off Condition offset for drive off support for normal mode" VALUE 0x8055675A RB_Val_Wu8 25.50 Fact_q0p1_COMPU 0.00 25.50 FORMAT "%5.2" /end CHARACTERISTIC
/begin CHARACTERISTIC HLSDem_facOffsDrvOffPhiCorr_CUR "Road gradient dependent curve for a factor for the calculation of the low idle speed setpoint offset" CURVE 0x8055675C RB_Curve_S16_S16 7.999878 Fact -4.000000 3.999878 FORMAT "%8.6"
 /begin AXIS_DESCR STD_AXIS LAS_facRoadGrdt Prc_Fact100 8 -327.6800 327.6700 FORMAT "%8.4" DEPOSIT ABSOLUTE /end AXIS_DESCR
/end CHARACTERISTIC
/begin CHARACTERISTIC HLSDem_facOffsDrvOff_CUR "Factor due to clutch pedal speed release" CURVE 0x8055677E RB_Curve_S16_S16 7.999878 Fact -4.000000 3.999878 FORMAT "%8.6"
 /begin AXIS_DESCR STD_AXIS Clth_drFlt Prc_Fact256 8 -128.0000 127.9961 FORMAT "%8.4" DEPOSIT ABSOLUTE /end AXIS_DESCR
/end CHARACTERISTIC
/begin CHARACTERISTIC HLSDem_facOffsEnvtlPCorrn_T "Environmental pressure dependent correction offset factor for the drive-off suport of MT vehicles" CURVE 0x805567A0 RB_Curve_S16_S16 7.999878 Fact -4.000000 3.999878 FORMAT "%8.6"
 /begin AXIS_DESCR STD_AXIS EnvP_p Pres_hPa 4 -32768.00 32767.00 FORMAT "%8.2" DEPOSIT ABSOLUTE /end AXIS_DESCR
/end CHARACTERISTIC
/begin CHARACTERISTIC HLSDem_facOilOvhtPrvMax_MAP "Weighting factor for NMAX-limitation, dependent on oil temperature" MAP 0x80556C00 RB_Map_S16S16_S16 7.999878 Fact -4.000000 3.999878 FORMAT "%8.6"
 /begin AXIS_DESCR STD_AXIS HLSDem_tOil Temp_Cels 8 -3549.940 3003.560 FORMAT "%8.3" DEPOSIT ABSOLUTE /end AXIS_DESCR
 /begin AXIS_DESCR STD_AXIS Epm_nEng EngN 8 -16384.00 16383.50 FORMAT "%8.2" DEPOSIT ABSOLUTE /end AXIS_DESCR
/end CHARACTERISTIC
/begin CHARACTERISTIC HLSDem_facOvhtThresGovHi_C "Upper threshold limit for NMAX-limitation due to temperature for governor." VALUE 0x80556CA4 RB_Val_Ws16 7.999878 Fact -4.000000 3.999878 FORMAT "%8.6" /end CHARACTERISTIC
/begin CHARACTERISTIC HLSDem_facOvhtThresGovLo_C "Lower threshold limit for NMAX-limitation due to temperature for governor." VALUE 0x80556CA6 RB_Val_Ws16 7.999878 Fact -4.000000 3.999878 FORMAT "%8.6" /end CHARACTERISTIC
/begin CHARACTERISTIC HLSDem_facOvhtThresHi_C "Upper threshold limit for NMAX-limitation due to temperature" VALUE 0x80556CA8 RB_Val_Ws16 7.999878 Fact -4.000000 3.999878 FORMAT "%8.6" /end CHARACTERISTIC
/begin CHARACTERISTIC HLSDem_facOvhtThresLo_C "Lower threshold limit for NMAX-limitation due to temperature" VALUE 0x80556CAA RB_Val_Ws16 7.999878 Fact -4.000000 3.999878 FORMAT "%8.6" /end CHARACTERISTIC
/begin CHARACTERISTIC HLSDem_facRvsGearCreepSp_C "Factor of creep setpoint when reverse gear is engaged" VALUE 0x805567B2 RB_Val_Wu8 12.75 fak_q0p05 0.00 12.75 FORMAT "%5.2" /end CHARACTERISTIC
/begin CHARACTERISTIC HLSDem_facRvsGearDrvOffSp_C "Factor of drive off (MT or CVT) setpoint when reverse gear is engaged" VALUE 0x805567B3 RB_Val_Wu8 12.75 fak_q0p05 0.00 12.75 FORMAT "%5.2" /end CHARACTERISTIC
/begin CHARACTERISTIC HLSDem_facRvsGearKissPntSp_C "Factor of kiss point setpoint when reverse gear is engaged" VALUE 0x805567B4 RB_Val_Wu8 12.75 fak_q0p05 0.00 12.75 FORMAT "%5.2" /end CHARACTERISTIC
/begin CHARACTERISTIC HLSDem_facSpIncrKissPnt_T "Factor for kiss-point setpoint calculation" CURVE 0x805567B6 RB_Curve_S16_S16 7.999878 Fact -4.000000 3.999878 FORMAT "%8.6"
 /begin AXIS_DESCR STD_AXIS VehV_v Vel 6 -327.6800 327.6700 FORMAT "%8.4" DEPOSIT ABSOLUTE /end AXIS_DESCR
/end CHARACTERISTIC
/begin CHARACTERISTIC HLSDem_flgChkClthStandStill_C "Enabling of clutch state for activation of engine-speed limitation by vehicle standstill to protect the engine and the clutch" VALUE 0x80556CAC RB_Val_Wu8 1.00000000000 B_TRUE 0.00 1.00000000000 FORMAT "%13.11" /end CHARACTERISTIC
/begin CHARACTERISTIC HLSDem_flgGearNeutralPosSelnMT_C "Calibration to activate or deactivate gear neautral position condition in MT" VALUE 0x805567D0 RB_Val_Wboolean 1.00000000000 B_TRUE 0.00 1.00000000000 FORMAT "%13.11" /end CHARACTERISTIC
/begin CHARACTERISTIC HLSDem_flgNoGripActv_C "Parameter to switch between standstll conditions" VALUE 0x80556CAD RB_Val_Wu8 1.00000000000 B_TRUE 0.00 1.00000000000 FORMAT "%13.11" /end CHARACTERISTIC
/begin CHARACTERISTIC HLSDem_flgSelBrkHldSysActvCdn_C "calibration to enable driveoff setpoint during brake hold system active" VALUE 0x805567D1 RB_Val_Wboolean 1.00000000000 B_TRUE 0.00 1.00000000000 FORMAT "%13.11" /end CHARACTERISTIC
/begin CHARACTERISTIC HLSDem_nDrvOffSuprtAbsltSpMT_CUR "engine temperature dependent drive off support offset" CURVE 0x805567D2 RB_Curve_U8_S16_Static 32767.50 nmot_sw_q0p5 -16384.00 16383.50 FORMAT "%8.2"
 /begin AXIS_DESCR STD_AXIS tmot temp_ub_q0p75_o48 8 -48.0 143.3 FORMAT "%5.1" DEPOSIT ABSOLUTE /end AXIS_DESCR
/end CHARACTERISTIC
/begin CHARACTERISTIC HLSDem_nDrvOffSuprtAbsltSp_MAP "Characteristic MAP for unfiltered low idle speed setpoint for drive-off support when HLSDem_swtDrvOffSuprtSpMod_C == 1" MAP 0x805567EC RB_Map_S16U8_S16 32767.50 nmot_sw_q0p5 -16384.00 16383.50 FORMAT "%8.2"
 /begin AXIS_DESCR STD_AXIS HLSDem_pMstCylBrk p_ub_q10 8 -327680.0 327670.0 FORMAT "%8.1" DEPOSIT ABSOLUTE /end AXIS_DESCR
 /begin AXIS_DESCR STD_AXIS tmot temp_ub_q0p75_o48 8 -48.0 143.3 FORMAT "%5.1" DEPOSIT ABSOLUTE /end AXIS_DESCR
/end CHARACTERISTIC
/begin CHARACTERISTIC HLSDem_nDrvOffSuprtOffs_CUR "Curve for the offset of the low-idle setpoint (used when HLSDem_swtDrvOffSuprtSpMod_C == 0)" CURVE 0x80556888 RB_Curve_S16_S16 32767.50 nmot_sw_q0p5 -16384.00 16383.50 FORMAT "%8.2"
 /begin AXIS_DESCR STD_AXIS HLSDem_pMstCylBrk p_ub_q10 10 -327680.0 327670.0 FORMAT "%8.1" DEPOSIT ABSOLUTE /end AXIS_DESCR
/end CHARACTERISTIC
/begin CHARACTERISTIC HLSDem_nDrvOffSuprtSpIncr_C "Calibration parameter for Drvoff support setpoint increase" VALUE 0x805568B2 RB_Val_Ws16 32767.50 nmot_sw_q0p5 -16384.00 16383.50 FORMAT "%8.2" /end CHARACTERISTIC
/begin CHARACTERISTIC HLSDem_nDrvOffSuprtSpIncr_M "Calibration parameter for Drvoff support setpoint increase(tmot, fho)" MAP 0x805568B4 RB_Map_U8U8_S16 32767.50 nmot_sw_q0p5 -16384.00 16383.50 FORMAT "%8.2"
 /begin AXIS_DESCR STD_AXIS tmot temp_ub_q0p75_o48 6 -48.0 143.3 FORMAT "%5.1" DEPOSIT ABSOLUTE /end AXIS_DESCR
 /begin AXIS_DESCR STD_AXIS fho fak_ub_b4 6 0.00 3.984 FORMAT "%5.3" DEPOSIT ABSOLUTE /end AXIS_DESCR
/end CHARACTERISTIC
/begin CHARACTERISTIC HLSDem_nDrvOffSuprtSpLimMax_C "Maximum for the low idle set point offset for drive-off support" VALUE 0x8055690A RB_Val_Ws16 32767.50 nmot_sw_q0p5 -16384.00 16383.50 FORMAT "%8.2" /end CHARACTERISTIC
/begin CHARACTERISTIC HLSDem_nEngMaxGov_MAP "Demanded engine speed during high temperature for governor." MAP 0x80556CAE RB_Map_S16S16_S16 32767.50 EngN -16384.00 16383.50 FORMAT "%8.2"
 /begin AXIS_DESCR STD_AXIS VehV_v Vel 8 -327.6800 327.6700 FORMAT "%8.4" DEPOSIT ABSOLUTE /end AXIS_DESCR
 /begin AXIS_DESCR STD_AXIS HLSDem_facEngSpdLimGov Fact 8 -4.000000 3.999878 FORMAT "%8.6" DEPOSIT ABSOLUTE /end AXIS_DESCR
/end CHARACTERISTIC
/begin CHARACTERISTIC HLSDem_nEngMax_MAP "Demanded engine speed during high temperature" MAP 0x80556D52 RB_Map_S16S16_S16 32767.50 EngN -16384.00 16383.50 FORMAT "%8.2"
 /begin AXIS_DESCR STD_AXIS VehV_v Vel 8 -327.6800 327.6700 FORMAT "%8.4" DEPOSIT ABSOLUTE /end AXIS_DESCR
 /begin AXIS_DESCR STD_AXIS HLSDem_facEngSpdLim Fact 8 -4.000000 3.999878 FORMAT "%8.6" DEPOSIT ABSOLUTE /end AXIS_DESCR
/end CHARACTERISTIC
/begin CHARACTERISTIC HLSDem_nLimAvusWarn_C "NMAX-limitation in case of AVS failure" VALUE 0x80556DF6 RB_Val_Ws16 32767.50 EngN -16384.00 16383.50 FORMAT "%8.2" /end CHARACTERISTIC
/begin CHARACTERISTIC HLSDem_nLimLftLimp_C "Engine speed limitation for valve lift system" VALUE 0x80556DF8 RB_Val_Ws16 32767.50 EngN -16384.00 16383.50 FORMAT "%8.2" /end CHARACTERISTIC
/begin CHARACTERISTIC HLSDem_nMaxErr1Lim_C "Engine speed limit on the inhibition of the FId_HLSDemErr1" VALUE 0x80556DFA RB_Val_Ws16 32767.50 EngN -16384.00 16383.50 FORMAT "%8.2" /end CHARACTERISTIC
/begin CHARACTERISTIC HLSDem_nMaxErr2Lim_C "Engine speed limit on the inhibition of the FId_HLSDemErr2" VALUE 0x80556DFC RB_Val_Ws16 32767.50 EngN -16384.00 16383.50 FORMAT "%8.2" /end CHARACTERISTIC
/begin CHARACTERISTIC HLSDem_nMaxHiSprt_CUR "Maximally permissible engine speed (short-term increased height) in Sportgasses" CURVE 0x80556DFE RB_Curve_S16_S16 32767.50 EngN -16384.00 16383.50 FORMAT "%8.2"
 /begin AXIS_DESCR STD_AXIS PT_rTrq TransR 10 -327.6800 327.6700 FORMAT "%8.4" DEPOSIT ABSOLUTE /end AXIS_DESCR
/end CHARACTERISTIC
/begin CHARACTERISTIC HLSDem_nMaxHiTipp_CUR "Maximum permissible engine speed in tip shift gutter (short increase)" CURVE 0x80556E28 RB_Curve_S16_S16 32767.50 EngN -16384.00 16383.50 FORMAT "%8.2"
 /begin AXIS_DESCR STD_AXIS PT_rTrq TransR 10 -327.6800 327.6700 FORMAT "%8.4" DEPOSIT ABSOLUTE /end AXIS_DESCR
/end CHARACTERISTIC
/begin CHARACTERISTIC HLSDem_nMaxHi_CUR "Maximum permissible engine speed (short increase)" CURVE 0x80556E52 RB_Curve_S16_S16 32767.50 EngN -16384.00 16383.50 FORMAT "%8.2"
 /begin AXIS_DESCR STD_AXIS PT_rTrq TransR 10 -327.6800 327.6700 FORMAT "%8.4" DEPOSIT ABSOLUTE /end AXIS_DESCR
/end CHARACTERISTIC
/begin CHARACTERISTIC HLSDem_nMaxKnCtl_C "Engine speed limit at safety ignition retard by knock control" VALUE 0x80556E7C RB_Val_Ws16 32767.50 EngN -16384.00 16383.50 FORMAT "%8.2" /end CHARACTERISTIC
/begin CHARACTERISTIC HLSDem_nMaxOffsSpIncr_C "Maximum offest for drvoff-setpoint" VALUE 0x8055690C RB_Val_Ws16 32767.50 nmot_sw_q0p5 -16384.00 16383.50 FORMAT "%8.2" /end CHARACTERISTIC
/begin CHARACTERISTIC HLSDem_nMaxOilT_MAP "Max engine speed limit at high oil temperature." MAP 0x80556E7E RB_Map_S16S16_S16 32767.50 EngN -16384.00 16383.50 FORMAT "%8.2"
 /begin AXIS_DESCR STD_AXIS HLSDem_tOilHys Temp_Cels 8 -3549.940 3003.560 FORMAT "%8.3" DEPOSIT ABSOLUTE /end AXIS_DESCR
 /begin AXIS_DESCR STD_AXIS PT_rTrq TransR 10 -327.6800 327.6700 FORMAT "%8.4" DEPOSIT ABSOLUTE /end AXIS_DESCR
/end CHARACTERISTIC
/begin CHARACTERISTIC HLSDem_nMaxShtrp_C "Higher engine speed limit at function request from customer service" VALUE 0x80556F46 RB_Val_Ws16 32767.50 EngN -16384.00 16383.50 FORMAT "%8.2" /end CHARACTERISTIC
/begin CHARACTERISTIC HLSDem_nMaxStandSigErr_C "engine speed limitation for stand still with sensor fault" VALUE 0x80556F48 RB_Val_Ws16 32767.50 EngN -16384.00 16383.50 FORMAT "%8.2" /end CHARACTERISTIC
/begin CHARACTERISTIC HLSDem_nMaxStandStill_CW "Codeword: maximum engine speed when vehicle is standing" VALUE 0x80556F4A RB_Val_Wu8 255.0 OneToOne 0.00 255.0 FORMAT "%5.1" /end CHARACTERISTIC
/begin CHARACTERISTIC HLSDem_nMaxStand_C "Maximum engine speed when vehicle is standing" VALUE 0x80556F4C RB_Val_Ws16 32767.50 EngN -16384.00 16383.50 FORMAT "%8.2" /end CHARACTERISTIC
/begin CHARACTERISTIC HLSDem_nMaxStdOfs_C "Offset for standard engine speed limit in the calculation of HLSDem_bNMaxHi" VALUE 0x80556F4E RB_Val_Ws16 32767.50 EngN -16384.00 16383.50 FORMAT "%8.2" /end CHARACTERISTIC
/begin CHARACTERISTIC HLSDem_nMaxStdSprt_CUR "Maximally permissible engine speed (stationary) in sport mode" CURVE 0x80556F50 RB_Curve_S16_S16 32767.50 EngN -16384.00 16383.50 FORMAT "%8.2"
 /begin AXIS_DESCR STD_AXIS PT_rTrq TransR 10 -327.6800 327.6700 FORMAT "%8.4" DEPOSIT ABSOLUTE /end AXIS_DESCR
/end CHARACTERISTIC
/begin CHARACTERISTIC HLSDem_nMaxStdTipp_CUR "Maximum permissible engine speed in tip shift gutter (stationary)" CURVE 0x80556F7A RB_Curve_S16_S16 32767.50 EngN -16384.00 16383.50 FORMAT "%8.2"
 /begin AXIS_DESCR STD_AXIS PT_rTrq TransR 10 -327.6800 327.6700 FORMAT "%8.4" DEPOSIT ABSOLUTE /end AXIS_DESCR
/end CHARACTERISTIC
/begin CHARACTERISTIC HLSDem_nMaxStd_CUR "Maximum permissible engine speed (stationary)" CURVE 0x80556FA4 RB_Curve_S16_S16 32767.50 EngN -16384.00 16383.50 FORMAT "%8.2"
 /begin AXIS_DESCR STD_AXIS PT_rTrq TransR 10 -327.6800 327.6700 FORMAT "%8.4" DEPOSIT ABSOLUTE /end AXIS_DESCR
/end CHARACTERISTIC
/begin CHARACTERISTIC HLSDem_nMaxTEng_CUR "Engine speed limit at high engine temperature." CURVE 0x80556FCE RB_Curve_S16_S16 32767.50 EngN -16384.00 16383.50 FORMAT "%8.2"
 /begin AXIS_DESCR STD_AXIS EngDa_tEng Temp_Cels 10 -3549.940 3003.560 FORMAT "%8.3" DEPOSIT ABSOLUTE /end AXIS_DESCR
/end CHARACTERISTIC
/begin CHARACTERISTIC HLSDem_nOffsAppDeadZone_CUR "Low-idle speed offset for drive-off support dependent on the weighted voltage diffenence between accped sensor 1 and accped sensor 2" CURVE 0x8055690E RB_Curve_S16_S16 32767.50 nmot_sw_q0p5 -16384.00 16383.50 FORMAT "%8.2"
 /begin AXIS_DESCR STD_AXIS HLSDem_facAppDeadZone Fact 4 -4.000000 3.999878 FORMAT "%8.6" DEPOSIT ABSOLUTE /end AXIS_DESCR
/end CHARACTERISTIC
/begin CHARACTERISTIC HLSDem_nOffsCoupling_C "Base factor for the calculation of the low idle speed setpoint offset for drive-off support" VALUE 0x80556920 RB_Val_Ws16 32767.50 nmot_sw_q0p5 -16384.00 16383.50 FORMAT "%8.2" /end CHARACTERISTIC
/begin CHARACTERISTIC HLSDem_nOffsDrvOff_C "Additive part of the low idle speed setpoint offset for drive-off support" VALUE 0x80556922 RB_Val_Ws16 32767.50 nmot_sw_q0p5 -16384.00 16383.50 FORMAT "%8.2" /end CHARACTERISTIC
/begin CHARACTERISTIC HLSDem_nOffsSpIncrCreep_C "creep offset for drvoff-Calibration" VALUE 0x80556924 RB_Val_Ws16 32767.50 nmot_sw_q0p5 -16384.00 16383.50 FORMAT "%8.2" /end CHARACTERISTIC
/begin CHARACTERISTIC HLSDem_nOffsSpIncrCreep_T "creep offset for drvoff-Map" CURVE 0x80556926 RB_Curve_S16_S16 32767.50 nmot_sw_q0p5 -16384.00 16383.50 FORMAT "%8.2"
 /begin AXIS_DESCR STD_AXIS VehV_v Vel 6 -327.6800 327.6700 FORMAT "%8.4" DEPOSIT ABSOLUTE /end AXIS_DESCR
/end CHARACTERISTIC
/begin CHARACTERISTIC HLSDem_nOffsSpIncrKissPnt_M "Kisspoint setpoint for drvoff-map" MAP 0x80556940 RB_Map_U8U8_S16 32767.50 nmot_sw_q0p5 -16384.00 16383.50 FORMAT "%8.2"
 /begin AXIS_DESCR STD_AXIS tmot temp_ub_q0p75_o48 6 -48.0 143.3 FORMAT "%5.1" DEPOSIT ABSOLUTE /end AXIS_DESCR
 /begin AXIS_DESCR STD_AXIS fho fak_ub_b4 6 0.00 3.984 FORMAT "%5.3" DEPOSIT ABSOLUTE /end AXIS_DESCR
/end CHARACTERISTIC
/begin CHARACTERISTIC HLSDem_pMstCylBrkLeftHysDelta_C "Threshold for the hysteresis(against Brake pressure) used for MCP detection in Drive off support activation" VALUE 0x80556998 RB_Val_Ws32 8589934590.00 PresAC_hPa -4294967296.00 4294967294.00 FORMAT "%13.2" /end CHARACTERISTIC
/begin CHARACTERISTIC HLSDem_pMstCylBrkLeftHysMin_C "Threshold for the hysteresis(against Brake pressure) used for MCP detection in Drive off support activation" VALUE 0x8055699C RB_Val_Ws32 8589934590.00 PresAC_hPa -4294967296.00 4294967294.00 FORMAT "%13.2" /end CHARACTERISTIC
/begin CHARACTERISTIC HLSDem_rClthDrvAwyMax_C "High clutch position value to enable drive off support" VALUE 0x805569A0 RB_Val_Ws16 255.9961 Prc_Fact256 -128.0000 127.9961 FORMAT "%8.4" /end CHARACTERISTIC
/begin CHARACTERISTIC HLSDem_rClthDrvAwyMin_C "Low clutch position value to enable drive off support" VALUE 0x805569A2 RB_Val_Ws16 255.9961 Prc_Fact256 -128.0000 127.9961 FORMAT "%8.4" /end CHARACTERISTIC
/begin CHARACTERISTIC HLSDem_rClthKisspntGain_C "Gain for the modification of the clutch kissing point" VALUE 0x805569A4 RB_Val_Ws16 7.999878 Fact -4.000000 3.999878 FORMAT "%8.6" /end CHARACTERISTIC
/begin CHARACTERISTIC HLSDem_rClthKisspntOffset_C "Offset for the modification of the clutch kissing point" VALUE 0x805569A6 RB_Val_Ws16 255.9961 Prc_Fact256 -128.0000 127.9961 FORMAT "%8.4" /end CHARACTERISTIC
/begin CHARACTERISTIC HLSDem_rClthMaxOffs1EnaThreshold_C "clutch ratio threshold to detect the maximum value of drive off" VALUE 0x805569A8 RB_Val_Ws16 255.9961 Prc_Fact256 -128.0000 127.9961 FORMAT "%8.4" /end CHARACTERISTIC
/begin CHARACTERISTIC HLSDem_rClthMaxOffs1Ena_C "Threshold for the clutch ratio for the activation of a part of the drive-off support" VALUE 0x805569AA RB_Val_Ws16 255.9961 Prc_Fact256 -128.0000 127.9961 FORMAT "%8.4" /end CHARACTERISTIC
/begin CHARACTERISTIC HLSDem_rClthPsdThd_C "Threshold to check, if clutch is open" VALUE 0x80556FF8 RB_Val_Ws16 100.0000 Prc_Fact256 0.00 100.0000 FORMAT "%8.4" EXTENDED_LIMITS -128.0000 127.9961 /end CHARACTERISTIC
/begin CHARACTERISTIC HLSDem_rDrvOffSuprtAThd_C "Maximum threshold for acceleration pedal ratio" VALUE 0x805569AC RB_Val_Ws16 799.9878 Prc -400.0000 399.9878 FORMAT "%8.4" /end CHARACTERISTIC
/begin CHARACTERISTIC HLSDem_rMaxClthPosSpIncr_C "Max cluth position for kisspoint setpoint calulation" VALUE 0x805569AE RB_Val_Ws16 255.9961 Prc_Fact256 -128.0000 127.9961 FORMAT "%8.4" /end CHARACTERISTIC
/begin CHARACTERISTIC HLSDem_rMaxClthRatSpIncr_C "Max cluth ratio for kisspoint setpoint calulation" VALUE 0x805569B0 RB_Val_Ws16 255.9961 Prc_Fact256 -128.0000 127.9961 FORMAT "%8.4" /end CHARACTERISTIC
/begin CHARACTERISTIC HLSDem_rMaxDiDrvOff_C "Threshold for the clutch ratio for the deactivation of the drive-off support" VALUE 0x805569B2 RB_Val_Ws16 255.9961 Prc_Fact256 -128.0000 127.9961 FORMAT "%8.4" /end CHARACTERISTIC
/begin CHARACTERISTIC HLSDem_rMinClthPosSpIncr_C "Min cluth ratio for kisspoint setpoint calulation" VALUE 0x805569B4 RB_Val_Ws16 255.9961 Prc_Fact256 -128.0000 127.9961 FORMAT "%8.4" /end CHARACTERISTIC
/begin CHARACTERISTIC HLSDem_rMinClthRatSpIncr_C "Min cluth ratio for kisspoint setpoint calulation" VALUE 0x805569B6 RB_Val_Ws16 255.9961 Prc_Fact256 -128.0000 127.9961 FORMAT "%8.4" /end CHARACTERISTIC
/begin CHARACTERISTIC HLSDem_stClthPsd_C "Calibration parameter to dectect cluth position to activate or deactivate Drive-off conditions" VALUE 0x805569B8 RB_Val_Wu8 7.000 OneToOne 0.00 7.000 FORMAT "%5.3" EXTENDED_LIMITS 0.00 255.0 /end CHARACTERISTIC
/begin CHARACTERISTIC HLSDem_stDrvOffSuprtDiMaskAST_C "Bitmask for the configuration of the disabling conditions of drive-off support of vehicles without MT" VALUE 0x805569BA RB_Val_Wu16 65535.00 OneToOne 0.00 65535.00 FORMAT "%8.2" /end CHARACTERISTIC
/begin CHARACTERISTIC HLSDem_stDrvOffSuprtDiMask_C "Mask for selecting different conditions for disabling drive-off support feature" VALUE 0x805569BC RB_Val_Wu16 65535.00 OneToOne 0.00 65535.00 FORMAT "%8.2" /end CHARACTERISTIC
/begin CHARACTERISTIC HLSDem_stDrvOffSuprtDisbl_C "Calibration to disable or enable drive off support" VALUE 0x805569BE RB_Val_Wboolean 1.00000000000 B_TRUE 0.00 1.00000000000 FORMAT "%13.11" /end CHARACTERISTIC
/begin CHARACTERISTIC HLSDem_stDrvOffSuprtEnaMaskAST_C "Bitmask for the configuration of the enabling conditions of drive-off support of vehicles without MT" VALUE 0x805569C0 RB_Val_Wu16 65535.00 OneToOne 0.00 65535.00 FORMAT "%8.2" /end CHARACTERISTIC
/begin CHARACTERISTIC HLSDem_stDrvOffSuprtEnaMask_C "Mask for selecting different conditions for enabling drive-off support feature" VALUE 0x805569C2 RB_Val_Wu16 65535.00 OneToOne 0.00 65535.00 FORMAT "%8.2" /end CHARACTERISTIC
/begin CHARACTERISTIC HLSDem_stEngOperModSeln_FT "Satus to select drivability mode for parameter" CURVE 0x805569C4 RB_Curve_U8_U8 255.0 OneToOne 0.00 255.0 FORMAT "%5.1"
 /begin AXIS_DESCR STD_AXIS Com_stEngMapReq OneToOne 16 0.00 255.0 FORMAT "%5.1" DEPOSIT ABSOLUTE /end AXIS_DESCR
/end CHARACTERISTIC
/begin CHARACTERISTIC HLSDem_stNMaxEngGov_CW "Status: Partcular engine speed limitation considered for engine speed limitation for governor." VALUE 0x80556FFC RB_Val_Wu32 4294967295.00 OneToOne 0.00 4294967295.00 FORMAT "%13.2" /end CHARACTERISTIC
/begin CHARACTERISTIC HLSDem_stNMaxEng_CW "Codewort of function %HLSDem_nMaxEng" VALUE 0x80557000 RB_Val_Wu8 255.0 OneToOne 0.00 255.0 FORMAT "%5.1" /end CHARACTERISTIC
/begin CHARACTERISTIC HLSDem_stNMaxPrio_CW "Status: condition set desired transmission speed" VALUE 0x80557004 RB_Val_Wu32 4294967295.00 OneToOne 0.00 4294967295.00 FORMAT "%13.2" /end CHARACTERISTIC
/begin CHARACTERISTIC HLSDem_stOvhtEngMaxGov_CW "Status: Limitations that should be considered for overheat engine speed limitation for Governor." VALUE 0x80557008 RB_Val_Wu16 65535.00 OneToOne 0.00 65535.00 FORMAT "%8.2" /end CHARACTERISTIC
/begin CHARACTERISTIC HLSDem_stWarn2500_CW "Speed limitations which is to be displayed as, engine speed limited to 2500rpm in Combi." VALUE 0x8055700A RB_Val_Wu16 65535.00 OneToOne 0.00 65535.00 FORMAT "%8.2" /end CHARACTERISTIC
/begin CHARACTERISTIC HLSDem_stWarn4000_CW "Speed limitations which is to be displayed as, engine speed limited to 4000rpm in Combi." VALUE 0x8055700C RB_Val_Wu16 65535.00 OneToOne 0.00 65535.00 FORMAT "%8.2" /end CHARACTERISTIC
/begin CHARACTERISTIC HLSDem_stWarn6000_CW "Speed limitations which is to be displayed as, engine speed limited to 6000rpm in Combi." VALUE 0x8055700E RB_Val_Wu16 65535.00 OneToOne 0.00 65535.00 FORMAT "%8.2" /end CHARACTERISTIC
/begin CHARACTERISTIC HLSDem_swtClthDetEna_C "Switch to chose the type of clutch state detection" VALUE 0x805569E5 RB_Val_Wu8 255.0 OneToOne 0.00 255.0 FORMAT "%5.1" /end CHARACTERISTIC
/begin CHARACTERISTIC HLSDem_SwtDeactvDrvOffSuprtOffs_C "Drive off deactivation for creep feature" VALUE 0x805569E6 RB_Val_Wboolean 1.00000000000 B_TRUE 0.00 1.00000000000 FORMAT "%13.11" /end CHARACTERISTIC
/begin CHARACTERISTIC HLSDem_swtDrvOffSuprtSpMod_C "Switch to select different ways of determining the unfiltered setpoint for drive-off support" VALUE 0x805569E7 RB_Val_Wu8 255.0 OneToOne 0.00 255.0 FORMAT "%5.1" /end CHARACTERISTIC
/begin CHARACTERISTIC HLSDem_swtDrvOffSuprtSpSeln_C "Switch select nstat(HLSDem_nSetPlo) OR Drive off setpoint for ramping of drive-off setpoint" VALUE 0x805569E8 RB_Val_Wu8 255.0 OneToOne 0.00 255.0 FORMAT "%5.1" /end CHARACTERISTIC
/begin CHARACTERISTIC HLSDem_tiBrkHldSysActvTOFF_C "Time duration for turnoff delay for brake hold system active to activate driveoff setpoint" VALUE 0x805569E9 RB_Val_Wu8 5.100 t_q0p02 0.00 5.100 FORMAT "%5.3" /end CHARACTERISTIC
/begin CHARACTERISTIC HLSDem_tiDeadTimeFirstEngStrtPassd_C "Time delay parameter to wait for first engine start to be finished" VALUE 0x805569EA RB_Val_Wu16 1310700. Time_ms_20ms 0.00 1310700. FORMAT "%8.0" /end CHARACTERISTIC
/begin CHARACTERISTIC HLSDem_tiDelNMaxESP_C "Delay time for the unblocking of the ESP switch at the maximum speed limitation" VALUE 0x80557010 RB_Val_Ws32 2147.48364700 Time_Dt 0.00 2147.48364700 FORMAT "%13.8" EXTENDED_LIMITS -2147.48364800 2147.48364700 /end CHARACTERISTIC
/begin CHARACTERISTIC HLSDem_tiDlyDrvOffSuprtSpIncrCVT_C "Time delay parameter to release condition of drive -off in case CVT" VALUE 0x805569EC RB_Val_Wu16 1310700. Time_ms_20ms 0.00 1310700. FORMAT "%8.0" /end CHARACTERISTIC
/begin CHARACTERISTIC HLSDem_tiDlySpIncrMT_C "time delay for activation of drvoff for MT" VALUE 0x805569EE RB_Val_Wu16 1310700. Time_ms_20ms 0.00 1310700. FORMAT "%8.0" /end CHARACTERISTIC
/begin CHARACTERISTIC HLSDem_tiDrvOffSuprtEnaThd_C "Maximum duration of drive-off support" VALUE 0x805569F0 RB_Val_Wu16 1310700. Time_ms_20ms 0.00 1310700. FORMAT "%8.0" /end CHARACTERISTIC
/begin CHARACTERISTIC HLSDem_tiGearRatDrvOffFlt_C "Time constant for PT1 filtering of the ratio of gearbox input shaft speed and engine speed to estimate the clutch slip" VALUE 0x805569F4 RB_Val_Ws32 4294.9672940000000 TimeDelay_s 0.0000020000000 4294.9672959999998 FORMAT "%19.14" EXTENDED_LIMITS 0.000002000000001 4294.9672959999998 /end CHARACTERISTIC
/begin CHARACTERISTIC HLSDem_tiKnCntl_C "Delay for activating the engine speed limitationin case of active safety ignition retardation" VALUE 0x80557014 RB_Val_Wu8 25.50 t_q0p1 0.00 25.50 FORMAT "%5.2" /end CHARACTERISTIC
/begin CHARACTERISTIC HLSDem_tiMaxNMaxHi_CUR "Maximum duration for raised engine speed limit" CURVE 0x80557016 RB_Curve_S16_S16 2147.500 Time_sec_1 0.00 2147.500 FORMAT "%8.3" EXTENDED_LIMITS -3276.800 3276.700
 /begin AXIS_DESCR STD_AXIS PT_rTrq TransR 10 -327.6800 327.6700 FORMAT "%8.4" DEPOSIT ABSOLUTE /end AXIS_DESCR
/end CHARACTERISTIC
/begin CHARACTERISTIC HLSDem_tiNMaxBlw_C "Dwell time below lower engine speed limit before activation of upper limit" VALUE 0x80557040 RB_Val_Ws32 2147.48364700 Time_Dt 0.00 2147.48364700 FORMAT "%13.8" EXTENDED_LIMITS -2147.48364800 2147.48364700 /end CHARACTERISTIC
/begin CHARACTERISTIC HLSDem_tiNMaxStand_C "Delay time of maximum speed limitation during stillstand" VALUE 0x80557044 RB_Val_Ws32 2147.48364700 Time_Dt 0.00 2147.48364700 FORMAT "%13.8" EXTENDED_LIMITS -2147.48364800 2147.48364700 /end CHARACTERISTIC
/begin CHARACTERISTIC HLSDem_tNMaxHi_C "Engine temperature threshold for activation of increased engine speed limit" VALUE 0x80557048 RB_Val_Ws16 6553.500 Temp_Cels -3549.940 3003.560 FORMAT "%8.3" /end CHARACTERISTIC
/begin CHARACTERISTIC HLSDem_tWrm_C "Temperature limit (Nmax-limittion) for separation between cold engine mode and warm engine mode" VALUE 0x8055704A RB_Val_Ws16 6553.500 Temp_Cels -3549.940 3003.560 FORMAT "%8.3" /end CHARACTERISTIC
/begin CHARACTERISTIC HLSDem_uPedDeadZone_C "Weighting factor for the voltage difference between accped sensor 1 and accped sensor 2" VALUE 0x805569F8 RB_Val_Ws16 13107.00 Volt -6553.600 6553.400 FORMAT "%8.3" /end CHARACTERISTIC
/begin CHARACTERISTIC HLSDem_vActStandStill_C "Vehicle speed threshold for activation of engine speed limitation during still stand" VALUE 0x8055704C RB_Val_Ws16 655.3500 Vel -327.6800 327.6700 FORMAT "%8.4" /end CHARACTERISTIC
/begin CHARACTERISTIC HLSDem_vDrvOffSuprtVehVThd_C "Threshold for distinguishing between lower and higher vehicle velocity for the ramp slope parameters" VALUE 0x805569FA RB_Val_Ws16 655.3500 Vel -327.6800 327.6700 FORMAT "%8.4" /end CHARACTERISTIC
/begin CHARACTERISTIC HLSDem_vDrvOffVehVHysMax_C "Maximum threshold of hysteresis for vehicle velocity" VALUE 0x805569FC RB_Val_Ws16 655.3500 Vel -327.6800 327.6700 FORMAT "%8.4" /end CHARACTERISTIC
/begin CHARACTERISTIC HLSDem_vDrvOffVehVHysMin_C "Minimum threshold of hysteresis for vehicle velocity" VALUE 0x805569FE RB_Val_Ws16 655.3500 Vel -327.6800 327.6700 FORMAT "%8.4" /end CHARACTERISTIC
/begin CHARACTERISTIC HLSDem_vMaxVehVelSpIncrCreep_C "max vehicle velocity for activation of drvoff creep" VALUE 0x80556A00 RB_Val_Ws16 655.3500 Vel -327.6800 327.6700 FORMAT "%8.4" /end CHARACTERISTIC
/begin CHARACTERISTIC HLSDem_vMaxVehVelSpIncrCVT_C "max vehicle velocity for activation of drvoff CVT" VALUE 0x80556A02 RB_Val_Ws16 655.3500 Vel -327.6800 327.6700 FORMAT "%8.4" /end CHARACTERISTIC
/begin CHARACTERISTIC HLSDem_vMaxVehVelSpIncrMT_C "max vehicle velocity for activation of drvoff MT" VALUE 0x80556A04 RB_Val_Ws16 655.3500 Vel -327.6800 327.6700 FORMAT "%8.4" /end CHARACTERISTIC
/begin CHARACTERISTIC HLSDem_vMinVehVelSpIncrCreep_C "min vehicle velocity for activation of drvoff creep" VALUE 0x80556A06 RB_Val_Ws16 655.3500 Vel -327.6800 327.6700 FORMAT "%8.4" /end CHARACTERISTIC
/begin CHARACTERISTIC HLSDem_vMinVehVelSpIncrCVT_C "min vehicle velocity for activation of drvoff CVT" VALUE 0x80556A08 RB_Val_Ws16 655.3500 Vel -327.6800 327.6700 FORMAT "%8.4" /end CHARACTERISTIC
/begin CHARACTERISTIC HLSDem_vMinVehVelSpIncrMT_C "min vehicle velocity for activation of drvoff MT" VALUE 0x80556A0A RB_Val_Ws16 655.3500 Vel -327.6800 327.6700 FORMAT "%8.4" /end CHARACTERISTIC
/begin CHARACTERISTIC HLSDem_vNMaxHi_C "Vehicle speed threshold for activation of increased engine speed limit" VALUE 0x8055704E RB_Val_Ws16 655.3500 Vel -327.6800 327.6700 FORMAT "%8.4" /end CHARACTERISTIC
/begin MEASUREMENT B_wrm "Hysteresis for HLSDem_bNMaxWrm" UBYTE B_TRUE 1 100 0.00 1.00000000000 BIT_MASK 0x1 FORMAT "%13.11" ECU_ADDRESS 0x70000226 /end MEASUREMENT
/begin MEASUREMENT DelRiPlsT_I.timeCounter "time delay between two Ri-pulses / Remaining time of the timer" UBYTE t_q0p01 1 100 0.00 2.550 FORMAT "%5.3" ECU_ADDRESS 0x6000AFC8 /end MEASUREMENT
/begin MEASUREMENT HEGO_bDHtgTempIntkAirOk "Bit intake air temperature ok for heater performance diagnosis" UBYTE B_TRUE 1 100 0.00 1.00000000000 BIT_MASK 0x1 FORMAT "%13.11" ECU_ADDRESS 0x7000022E /end MEASUREMENT
/begin MEASUREMENT HEGO_bDHtgTiEngStopOk "Bit engine stop time ok for heater performance diagnosis" UBYTE B_TRUE 1 100 0.00 1.00000000000 BIT_MASK 0x1 FORMAT "%13.11" ECU_ADDRESS 0x7000022D /end MEASUREMENT
/begin MEASUREMENT HEGO_bEnaDElecPhy "Bit physical enable conditions for electrical HEGO sensor diagnostics met" UBYTE B_TRUE 1 100 0.00 1.00000000000 BIT_MASK 0x1 FORMAT "%13.11" ECU_ADDRESS 0x700008EB /end MEASUREMENT
/begin MEASUREMENT HEGO_bEnaDHtgAftStop "Bit enable condition for heater performance diagnosis after stop-phase" UBYTE B_TRUE 1 100 0.00 1.00000000000 BIT_MASK 0x1 FORMAT "%13.11" ECU_ADDRESS 0x7000022C /end MEASUREMENT
/begin MEASUREMENT HEGO_bEnaDPs "Bit heater power stage diagnostics enabled" UBYTE B_TRUE 1 100 0.00 1.00000000000 BIT_MASK 0x1 FORMAT "%13.11" ECU_ADDRESS 0x700008EA /end MEASUREMENT
/begin MEASUREMENT HEGO_bFCMClrS2B1OBDHtg "FCM Clear request, Sensor 2 Bank 1" UBYTE B_TRUE 1 100 0.00 1.00000000000 BIT_MASK 0x1 FORMAT "%13.11" ECU_ADDRESS 0x7000022B /end MEASUREMENT
/begin MEASUREMENT HEGO_bRiPlsReq "Bit pulse for measurement of internal resistance requested" UBYTE B_TRUE 1 100 0.00 1.00000000000 BIT_MASK 0x1 FORMAT "%13.11" ECU_ADDRESS 0x70000228 /end MEASUREMENT
/begin MEASUREMENT HEGO_bS2B1EnaDElec "Bit electrical diagnostics enabled, HEGO sensor 2 bank 1" UBYTE B_TRUE 1 100 0.00 1.00000000000 BIT_MASK 0x1 FORMAT "%13.11" ECU_ADDRESS 0x700008E9 /end MEASUREMENT
/begin MEASUREMENT HEGO_bS2B1EnaDHtg "Bit heater performance diagnosis enabled, HEGO sensor 2 bank 1" UBYTE B_TRUE 1 100 0.00 1.00000000000 BIT_MASK 0x1 FORMAT "%13.11" ECU_ADDRESS 0x700008E8 /end MEASUREMENT
/begin MEASUREMENT HEGO_bS2B1ErrElecHtrCpl "Bit electrical error heater coupling, HEGO sensor 2 bank 1" UBYTE B_TRUE 1 100 0.00 1.00000000000 BIT_MASK 0x1 FORMAT "%13.11" ECU_ADDRESS 0x700008E7 /end MEASUREMENT
/begin MEASUREMENT HEGO_bS2B1ErrElecMinWoDeb "Bit electrical min error without debouncing, HEGO sensor 2 bank 1" UBYTE B_TRUE 1 100 0.00 1.00000000000 BIT_MASK 0x1 FORMAT "%13.11" ECU_ADDRESS 0x700008E6 /end MEASUREMENT
/begin MEASUREMENT HEGO_bS2B1ErrElecSig "Bit electrical sig error (wire interruption), HEGO sensor 2 bank 1" UBYTE B_TRUE 1 100 0.00 1.00000000000 BIT_MASK 0x1 FORMAT "%13.11" ECU_ADDRESS 0x700008E5 /end MEASUREMENT
/begin MEASUREMENT HEGO_bS2B1ErrElecSigPrev "Bit electrical sig error (wire interruption) in previous trip, HEGO sensor 2 bank 1" UBYTE B_TRUE 1 100 0.00 1.00000000000 BIT_MASK 0x1 FORMAT "%13.11" ECU_ADDRESS 0x700008E4 /end MEASUREMENT
/begin MEASUREMENT HEGO_bS2B1ErrElecSigRi "Bit elctrical sig error (wire interruption) due to Ri, HEGO sensor 1 bank 2" UBYTE B_TRUE 1 100 0.00 1.00000000000 BIT_MASK 0x1 FORMAT "%13.11" ECU_ADDRESS 0x700008E3 /end MEASUREMENT
/begin MEASUREMENT HEGO_bS2B1ExptOpRdn "Bit expected operating readiness, HEGO sensor 2 bank 1" UBYTE B_TRUE 1 100 0.00 1.00000000000 BIT_MASK 0x1 FORMAT "%13.11" ECU_ADDRESS 0x700008E2 /end MEASUREMENT
/begin MEASUREMENT HEGO_bS2B1FrzRi "Bit sensor signal frozen due to measurement of internal resistance, Heated Exhaust Gas Oxygen sensor 2 bank 1" UBYTE B_TRUE 1 100 0.00 1.00000000000 BIT_MASK 0x1 FORMAT "%13.11" ECU_ADDRESS 0x700008E1 /end MEASUREMENT
/begin MEASUREMENT HEGO_bS2B1HtgSuffRi "Bit sufficient heating (Ri low enough), HEGO sensor 2 bank 1" UBYTE B_TRUE 1 100 0.00 1.00000000000 BIT_MASK 0x1 FORMAT "%13.11" ECU_ADDRESS 0x700008DA /end MEASUREMENT
/begin MEASUREMENT HEGO_bS2B1InVldErr "Bit signal invalid due to error, HEGO sensor 2 bank 1" UBYTE B_TRUE 1 100 0.00 1.00000000000 BIT_MASK 0x1 FORMAT "%13.11" ECU_ADDRESS 0x700008D9 /end MEASUREMENT
/begin MEASUREMENT HEGO_bS2B1LdPlsMinReq "Bit load pulses requested due to min error (short to ground) suspicion, HEGO sensor 2 bank 1" UBYTE B_TRUE 1 100 0.00 1.00000000000 BIT_MASK 0x1 FORMAT "%13.11" ECU_ADDRESS 0x700008D8 /end MEASUREMENT
/begin MEASUREMENT HEGO_bS2B1LdPlsRslt "Bit result of load pulse measurement is available, HEGO sensor 2 bank 1" UBYTE B_TRUE 1 100 0.00 1.00000000000 BIT_MASK 0x1 FORMAT "%13.11" ECU_ADDRESS 0x700008D7 /end MEASUREMENT
/begin MEASUREMENT HEGO_bS2B1LdPlsSigCnfReq "Bit load pulses requested to confirm sig error (wire interruption) suspicion, HEGO sensor 2 bank 1" UBYTE B_TRUE 1 100 0.00 1.00000000000 BIT_MASK 0x1 FORMAT "%13.11" ECU_ADDRESS 0x700008D6 /end MEASUREMENT
/begin MEASUREMENT HEGO_bS2B1LdPlsSigReq "Bit load pulse requested due to sig error (wire interruption) suspicion, HEGO sensor 2 bank 1" UBYTE B_TRUE 1 100 0.00 1.00000000000 BIT_MASK 0x1 FORMAT "%13.11" ECU_ADDRESS 0x700008D5 /end MEASUREMENT
/begin MEASUREMENT HEGO_bS2B1NewRi "Bit New Ri value available, HEGO sensor 2 bank 1" UBYTE B_TRUE 1 100 0.00 1.00000000000 BIT_MASK 0x1 FORMAT "%13.11" ECU_ADDRESS 0x700008D4 /end MEASUREMENT
/begin MEASUREMENT HEGO_bS2B1OpRdnRiReq "Ri measurement requsest for operation readiness detection, HEGO sensor 2 bank 1" UBYTE B_TRUE 1 100 0.00 1.00000000000 BIT_MASK 0x1 FORMAT "%13.11" ECU_ADDRESS 0x700008D3 /end MEASUREMENT
/begin MEASUREMENT HEGO_bS2B1RiPlsReq "Bit pulse for measurement of internal resistance requested, HEGO sensor 2 bank 1" UBYTE B_TRUE 1 100 0.00 1.00000000000 BIT_MASK 0x1 FORMAT "%13.11" ECU_ADDRESS 0x70000227 /end MEASUREMENT
/begin MEASUREMENT HEGO_bS2B1Vld "Bit signal valid, Heated Exhaust Gas Oxygen sensor 2 bank 1" UBYTE B_TRUE 1 100 0.00 1.00000000000 BIT_MASK 0x1 FORMAT "%13.11" ECU_ADDRESS 0x700008D2 /end MEASUREMENT
/begin MEASUREMENT HEGO_bS2B1VldRi "Bit internal resistance is valid, HEGO sensor 2 bank 1" UBYTE B_TRUE 1 100 0.00 1.00000000000 BIT_MASK 0x1 FORMAT "%13.11" ECU_ADDRESS 0x700008D1 /end MEASUREMENT
/begin MEASUREMENT HEGO_DebDHtgAftStopFF_I.status "Flip Flop condition for engine speed above a threshold for enabling sensor heating. / current value of RS-FF" UBYTE B_TRUE 1 100 0.00 1.00000000000 BIT_MASK 0x1 FORMAT "%13.11" ECU_ADDRESS 0x6000AFCA /end MEASUREMENT
/begin MEASUREMENT HEGO_DebDHtgGenFuncReqTONV_I.outbit "Debouncing on function scan tool request for sensor heating diagnosis. / return value" UBYTE B_TRUE 1 100 0.00 1.00000000000 BIT_MASK 0x1 FORMAT "%13.11" ECU_ADDRESS 0x60006C22 /end MEASUREMENT
/begin MEASUREMENT HEGO_DebDHtgGenFuncReqTONV_I.time "Debouncing on function scan tool request for sensor heating diagnosis. / expired delay time" UBYTE t_q0p1 1 100 0.00 25.50 FORMAT "%5.2" ECU_ADDRESS 0x60006C23 /end MEASUREMENT
/begin MEASUREMENT HEGO_DebDHtgStopEF_I.buffer "edge falling Debouncing stop phase for heater performance diagnosis / memory to detect falling edge" UBYTE B_TRUE 1 100 0.00 1.00000000000 BIT_MASK 0x1 FORMAT "%13.11" ECU_ADDRESS 0x60006C20 /end MEASUREMENT
/begin MEASUREMENT HEGO_DebDHtgStopEF_I.oldSignal "edge falling Debouncing stop phase for heater performance diagnosis / memory to detect falling edge" UBYTE B_TRUE 1 100 0.00 1.00000000000 BIT_MASK 0x1 FORMAT "%13.11" ECU_ADDRESS 0x60006C21 /end MEASUREMENT
/begin MEASUREMENT HEGO_DebDHtgStopTOFFV_I.outbit "Debouncing stop phase for heater performance diagnosis / Output Bit" UBYTE B_TRUE 1 100 0.00 1.00000000000 BIT_MASK 0x1 FORMAT "%13.11" ECU_ADDRESS 0x60006C1C /end MEASUREMENT
/begin MEASUREMENT HEGO_DebDHtgStopTOFFV_I.time "Debouncing stop phase for heater performance diagnosis / Occured Time" UWORD t_q0p1 1 100 0.00 6553.500 FORMAT "%8.3" ECU_ADDRESS 0x60006C1E /end MEASUREMENT
/begin MEASUREMENT HEGO_DebDHtgStrtER_I.buffer "Edge rise condition based on engine speed for enabling sensor heating diagnosis after a stop. / rising edge detected" UBYTE B_TRUE 1 100 0.00 1.00000000000 BIT_MASK 0x1 FORMAT "%13.11" ECU_ADDRESS 0x60006C1A /end MEASUREMENT
/begin MEASUREMENT HEGO_DebDHtgStrtER_I.oldSignal "Edge rise condition based on engine speed for enabling sensor heating diagnosis after a stop. / flag rising edge" UBYTE B_TRUE 1 100 0.00 1.00000000000 BIT_MASK 0x1 FORMAT "%13.11" ECU_ADDRESS 0x60006C1B /end MEASUREMENT
/begin MEASUREMENT HEGO_DebDHtgStrtTONV_I.outbit "Debounce time based on engine speed for enabling sensor diagnosis after a stop. / return value" UBYTE B_TRUE 1 100 0.00 1.00000000000 BIT_MASK 0x1 FORMAT "%13.11" ECU_ADDRESS 0x60006C16 /end MEASUREMENT
/begin MEASUREMENT HEGO_DebDHtgStrtTONV_I.time "Debounce time based on engine speed for enabling sensor diagnosis after a stop. / expired delay time" UWORD t_q0p1 1 100 0.00 6553.500 FORMAT "%8.3" ECU_ADDRESS 0x60006C18 /end MEASUREMENT
/begin MEASUREMENT HEGO_DebTAmbHtrPsTONV_I.outbit "turn on delay for release power stage diagnosis w.r.t. ambient temperature / return value" UBYTE B_TRUE 1 100 0.00 1.00000000000 BIT_MASK 0x1 FORMAT "%13.11" ECU_ADDRESS 0x60006C14 /end MEASUREMENT
/begin MEASUREMENT HEGO_DebTAmbHtrPsTONV_I.time "turn on delay for release power stage diagnosis w.r.t. ambient temperature / expired delay time" UBYTE t_q0p1 1 100 0.00 25.50 FORMAT "%5.2" ECU_ADDRESS 0x60006C15 /end MEASUREMENT
/begin MEASUREMENT HEGO_DHtgEGTMStrtB1ER_I.buffer "Edge rise detection of sensor start temperature in dew point end. / rising edge detected" UBYTE B_TRUE 1 100 0.00 1.00000000000 BIT_MASK 0x1 FORMAT "%13.11" ECU_ADDRESS 0x60006C24 /end MEASUREMENT
/begin MEASUREMENT HEGO_DHtgEGTMStrtB1ER_I.oldSignal "Edge rise detection of sensor start temperature in dew point end. / flag rising edge" UBYTE B_TRUE 1 100 0.00 1.00000000000 BIT_MASK 0x1 FORMAT "%13.11" ECU_ADDRESS 0x60006C25 /end MEASUREMENT
/begin MEASUREMENT HEGO_dresS2B1RiThresMin "Running minimum of difference between internal resistance value and threshold, HEGO sensor 2 bank 1" SLONG r_uw_q2 1 100 -131070.000000 131070.000000 FORMAT "%13.6" ECU_ADDRESS 0x50004F90 /end MEASUREMENT
/begin MEASUREMENT HEGO_dresS2B1RiThresMinNV "Running minimum of difference between internal resistance value and threshold, HEGO sensor 2 bank 1" SLONG r_uw_q2 1 100 -131070.000000 131070.000000 FORMAT "%13.6" ECU_ADDRESS 0x60038FA4 /end MEASUREMENT
/begin MEASUREMENT HEGO_facLamLinHiResS2 "Factor lambda, HEGO sensor 2 working point display" UWORD fak_q3p0518Em5 1 100 0.00 1.999969 FORMAT "%8.6" ECU_ADDRESS 0x700052A8 /end MEASUREMENT
/begin MEASUREMENT HEGO_flgDrvDsmEntryDIntPs "flag integrated power stage diagnosis enabling conditions given, considering battery voltage and DSM-Init" UBYTE B_TRUE 1 100 0.00 1.00000000000 BIT_MASK 0x1 FORMAT "%13.11" ECU_ADDRESS 0x700008CF /end MEASUREMENT
/begin MEASUREMENT HEGO_flgDrvDsmTripChgdOBDHtg "flag: DSM initialization done" UBYTE B_TRUE 1 100 0.00 1.00000000000 BIT_MASK 0x1 FORMAT "%13.11" ECU_ADDRESS 0x6000F8E1 /end MEASUREMENT
/begin MEASUREMENT HEGO_flgDrvDSMTripChgFinshdOBDElec "flag: DSM initialization done" UBYTE B_TRUE 1 100 0.00 1.00000000000 BIT_MASK 0x1 FORMAT "%13.11" ECU_ADDRESS 0x700008D0 /end MEASUREMENT
/begin MEASUREMENT HEGO_flgEnaDWeakPsCmn "enabling condition for diagnosis of weak power stage w.r.t. ambient temperature" UBYTE B_TRUE 1 100 0.00 1.00000000000 BIT_MASK 0x1 FORMAT "%13.11" ECU_ADDRESS 0x700008CE /end MEASUREMENT
/begin MEASUREMENT HEGO_flgEnvtlCond "Environmental condition for heater performance diagnosis" UBYTE B_TRUE 1 100 0.00 1.00000000000 BIT_MASK 0x1 FORMAT "%13.11" ECU_ADDRESS 0x7000022A /end MEASUREMENT
/begin MEASUREMENT HEGO_flgExhS2B1AvlEF_I.buffer "edge falling: calibration flag HEGO-sensor 2 bank 1 present / memory to detect falling edge" UBYTE B_TRUE 1 100 0.00 1.00000000000 BIT_MASK 0x1 FORMAT "%13.11" ECU_ADDRESS 0x60006C12 /end MEASUREMENT
/begin MEASUREMENT HEGO_flgExhS2B1AvlEF_I.oldSignal "edge falling: calibration flag HEGO-sensor 2 bank 1 present / memory to detect falling edge" UBYTE B_TRUE 1 100 0.00 1.00000000000 BIT_MASK 0x1 FORMAT "%13.11" ECU_ADDRESS 0x60006C13 /end MEASUREMENT
/begin MEASUREMENT HEGO_flgFCMClrReqdOBDElec100msS2 "FCMClr reset variable" UBYTE B_TRUE 1 100 0.00 1.00000000000 BIT_MASK 0x1 FORMAT "%13.11" ECU_ADDRESS 0x700008CD /end MEASUREMENT
/begin MEASUREMENT HEGO_flgFCMClrReqdOBDElec10msS2 "FCMClr reset variable" UBYTE B_TRUE 1 100 0.00 1.00000000000 BIT_MASK 0x1 FORMAT "%13.11" ECU_ADDRESS 0x700008CC /end MEASUREMENT
/begin MEASUREMENT HEGO_flgFCMClrReqdOBDHtg "FCM-Clear requested" UBYTE B_TRUE 1 100 0.00 1.00000000000 BIT_MASK 0x1 FORMAT "%13.11" ECU_ADDRESS 0x70000229 /end MEASUREMENT
/begin MEASUREMENT HEGO_flgFCMClrReqdSens_100ms "HEGO_Sens Fault code memory clear requested for 100ms task" UBYTE B_TRUE 1 100 0.00 1.00000000000 BIT_MASK 0x1 FORMAT "%13.11" ECU_ADDRESS 0x700008CB /end MEASUREMENT
/begin MEASUREMENT HEGO_flgFCMClrReqdSens_10ms "HEGO_Sens Fault code memory clear requested for 10ms task" UBYTE B_TRUE 1 100 0.00 1.00000000000 BIT_MASK 0x1 FORMAT "%13.11" ECU_ADDRESS 0x700008CA /end MEASUREMENT
/begin MEASUREMENT HEGO_flgLamEnaElecMaxS2B1 "lambda not rich for ElecMax-Diagnosis for binary sensor 2 bank 1 (primarily with air reference)" UBYTE B_TRUE 1 100 0.00 1.00000000000 BIT_MASK 0x1 FORMAT "%13.11" ECU_ADDRESS 0x700008C8 /end MEASUREMENT
/begin MEASUREMENT HEGO_flgNumVoltMeasmtElecMaxSuffS2B1 "flag number of voltage measurements sufficient for ElecMax (SCB) diagnosis debounce sensor 2 bank 1" UBYTE B_TRUE 1 100 0.00 1.00000000000 BIT_MASK 0x1 FORMAT "%13.11" ECU_ADDRESS 0x700008C7 /end MEASUREMENT
/begin MEASUREMENT HEGO_flgPwrStgEnaCond "general enabling condition for power stage diagnosis" UBYTE B_TRUE 1 100 0.00 1.00000000000 BIT_MASK 0x1 FORMAT "%13.11" ECU_ADDRESS 0x700008C6 /end MEASUREMENT
/begin MEASUREMENT HEGO_flgVldTstrS2B1 "sensor operation readiness of binary sensor 2 bank 1 for tester device" UBYTE B_TRUE 1 100 0.00 1.00000000000 BIT_MASK 0x1 FORMAT "%13.11" ECU_ADDRESS 0x6000EE30 /end MEASUREMENT
/begin MEASUREMENT HEGO_idxSensRiPls "Sensor index for measurement of internal resistance" UBYTE dez 1 100 0.00 255.0 FORMAT "%5.1" ECU_ADDRESS 0x6000AFC9 /end MEASUREMENT
/begin MEASUREMENT HEGO_numCalcRiS2B1 "numerator for indication of executed Ri-pulse sensor 2 bank 1" UBYTE dez 1 100 0.00 255.0 FORMAT "%5.1" ECU_ADDRESS 0x6000EF69 /end MEASUREMENT
/begin MEASUREMENT HEGO_numNewRiS2B1 "Numerator for indication of a new Ri value sensor 2 bank 1" UBYTE dez 1 100 0.00 255.0 FORMAT "%5.1" ECU_ADDRESS 0x6000EF68 /end MEASUREMENT
/begin MEASUREMENT HEGO_numTCerRiVldS2B1 "indication of a valid ceramic temperature sensor 2 bank 1, when numerator is incremented" UBYTE dez 1 100 0.00 255.0 FORMAT "%5.1" ECU_ADDRESS 0x6000F41F /end MEASUREMENT
/begin MEASUREMENT HEGO_numVoltMeasmtElecMaxS2B1 "running counter of voltage measurement S2B1 during heater OFF state wo. Ri-pulse." UBYTE dez 1 100 0.00 255.0 FORMAT "%5.1" ECU_ADDRESS 0x70003708 /end MEASUREMENT
/begin MEASUREMENT HEGO_OBDElecS2B1_I.bErrElecMinWoDeb "Electrical diagnostics, HEGO sensor 2 bank 1 / Bit electrical error without debouncing" UBYTE B_TRUE 1 100 0.00 1.00000000000 BIT_MASK 0x1 FORMAT "%13.11" ECU_ADDRESS 0x60006C27 /end MEASUREMENT
/begin MEASUREMENT HEGO_OBDElecS2B1_I.bErrElecSig "Electrical diagnostics, HEGO sensor 2 bank 1 / Bit electrical sig error (wire interruption)" UBYTE B_TRUE 1 100 0.00 1.00000000000 BIT_MASK 0x1 FORMAT "%13.11" ECU_ADDRESS 0x60006C28 /end MEASUREMENT
/begin MEASUREMENT HEGO_OBDElecS2B1_I.bErrElecSus "Electrical diagnostics, HEGO sensor 2 bank 1 / Bit suspicion of electical sensor failure" UBYTE B_TRUE 1 100 0.00 1.00000000000 BIT_MASK 0x1 FORMAT "%13.11" ECU_ADDRESS 0x60006C29 /end MEASUREMENT
/begin MEASUREMENT HEGO_OBDElecS2B1_I.bErrHtrCpl "Electrical diagnostics, HEGO sensor 2 bank 1 / Bit electrical error heater coupling" UBYTE B_TRUE 1 100 0.00 1.00000000000 BIT_MASK 0x1 FORMAT "%13.11" ECU_ADDRESS 0x60006C2A /end MEASUREMENT
/begin MEASUREMENT HEGO_OBDElecS2B1_I.bFCMClrReqdCL100ms "Electrical diagnostics, HEGO sensor 2 bank 1 / FCM Clear request for CL_100ms task" UBYTE B_TRUE 1 100 0.00 1.00000000000 BIT_MASK 0x1 FORMAT "%13.11" ECU_ADDRESS 0x60006C2B /end MEASUREMENT
/begin MEASUREMENT HEGO_OBDElecS2B1_I.bNoErrElecMinSus "Electrical diagnostics, HEGO sensor 2 bank 1 / Bit no electrical min error suspicion" UBYTE B_TRUE 1 100 0.00 1.00000000000 BIT_MASK 0x1 FORMAT "%13.11" ECU_ADDRESS 0x60006C26 /end MEASUREMENT
/begin MEASUREMENT HEGO_OBDElecS2B1_I.ctReset100ms "Electrical diagnostics, HEGO sensor 2 bank 1 / Post drive leave counter for 100ms process" UBYTE OneToOne 1 100 0.00 255.0 FORMAT "%5.1" ECU_ADDRESS 0x60006C2C /end MEASUREMENT
/begin MEASUREMENT HEGO_OBDElecS2B1_I.flgDiagElecMax "Electrical diagnostics, HEGO sensor 2 bank 1 / Condition Elec Max diagnosis done" UBYTE B_TRUE 1 100 0.00 1.00000000000 BIT_MASK 0x2 FORMAT "%13.11" ECU_ADDRESS 0x60006C26 /end MEASUREMENT
/begin MEASUREMENT HEGO_OBDElecS2B1_I.flgDiagElecMaxUHi "Electrical diagnostics, HEGO sensor 2 bank 1 / internal flag, that SCB diagnosis is debounced completely." UBYTE B_TRUE 1 100 0.00 1.00000000000 BIT_MASK 0x4 FORMAT "%13.11" ECU_ADDRESS 0x60006C26 /end MEASUREMENT
/begin MEASUREMENT HEGO_OBDElecS2B1_I.flgDiagElecMin "Electrical diagnostics, HEGO sensor 2 bank 1 / Condition Elec Min diagnosis done" UBYTE B_TRUE 1 100 0.00 1.00000000000 BIT_MASK 0x8 FORMAT "%13.11" ECU_ADDRESS 0x60006C26 /end MEASUREMENT
/begin MEASUREMENT HEGO_OBDElecS2B1_I.flgErrElecMax "Electrical diagnostics, HEGO sensor 2 bank 1 / internal flag, that SCB error has been detected." UBYTE B_TRUE 1 100 0.00 1.00000000000 BIT_MASK 0x10 FORMAT "%13.11" ECU_ADDRESS 0x60006C26 /end MEASUREMENT
/begin MEASUREMENT HEGO_OBDElecS2B1_I.flgLamEnaElecMax "Electrical diagnostics, HEGO sensor 2 bank 1 / lambda not rich for ElecMax-Diagnosis for binary sensor (primarily with air reference)" UBYTE B_TRUE 1 100 0.00 1.00000000000 BIT_MASK 0x1 FORMAT "%13.11" ECU_ADDRESS 0x60006C2D /end MEASUREMENT
/begin MEASUREMENT HEGO_OBDElecS2B1_I.flgNumvoltMeasmtElecMaxSuff "Electrical diagnostics, HEGO sensor 2 bank 1 / internal flag: necessary number of voltage measurements during heater off state for ElecMax diagnosis is reached." UBYTE B_TRUE 1 100 0.00 1.00000000000 BIT_MASK 0x20 FORMAT "%13.11" ECU_ADDRESS 0x60006C26 /end MEASUREMENT
/begin MEASUREMENT HEGO_OBDElecS2B1_I.DebDiagElecMaxTONV_I.outbit "Electrical diagnostics, HEGO sensor 2 bank 1 / Debounce for Elec Max diagnosis enabling conditions / return value" UBYTE B_TRUE 1 100 0.00 1.00000000000 BIT_MASK 0x1 FORMAT "%13.11" ECU_ADDRESS 0x60006C2E /end MEASUREMENT
/begin MEASUREMENT HEGO_OBDElecS2B1_I.DebDiagElecMaxTONV_I.time "Electrical diagnostics, HEGO sensor 2 bank 1 / Debounce for Elec Max diagnosis enabling conditions / expired delay time" UBYTE t_q0p1 1 100 0.00 25.50 FORMAT "%5.2" ECU_ADDRESS 0x60006C2F /end MEASUREMENT
/begin MEASUREMENT HEGO_OBDElecS2B1_I.DebDiagElecMinTONV_I.outbit "Electrical diagnostics, HEGO sensor 2 bank 1 / Debounce for Elec Min diagnosis enabling conditions / return value" UBYTE B_TRUE 1 100 0.00 1.00000000000 BIT_MASK 0x1 FORMAT "%13.11" ECU_ADDRESS 0x60006C30 /end MEASUREMENT
/begin MEASUREMENT HEGO_OBDElecS2B1_I.DebDiagElecMinTONV_I.time "Electrical diagnostics, HEGO sensor 2 bank 1 / Debounce for Elec Min diagnosis enabling conditions / expired delay time" UBYTE t_q0p1 1 100 0.00 25.50 FORMAT "%5.2" ECU_ADDRESS 0x60006C31 /end MEASUREMENT
/begin MEASUREMENT HEGO_OBDElecS2B1_I.DebErrElecMaxTONV_I.outbit "Electrical diagnostics, HEGO sensor 2 bank 1 / Debouncing of electrical max error (short to battery voltage) / return value" UBYTE B_TRUE 1 100 0.00 1.00000000000 BIT_MASK 0x1 FORMAT "%13.11" ECU_ADDRESS 0x60006C32 /end MEASUREMENT
/begin MEASUREMENT HEGO_OBDElecS2B1_I.DebErrElecMaxTONV_I.time "Electrical diagnostics, HEGO sensor 2 bank 1 / Debouncing of electrical max error (short to battery voltage) / expired delay time" UBYTE t_q0p1 1 100 0.00 25.50 FORMAT "%5.2" ECU_ADDRESS 0x60006C33 /end MEASUREMENT
/begin MEASUREMENT HEGO_OBDElecS2B1_I.DebErrElecMinSusTONV_I.outbit "Electrical diagnostics, HEGO sensor 2 bank 1 / Debouncing of electrical min error suspicion / return value" UBYTE B_TRUE 1 100 0.00 1.00000000000 BIT_MASK 0x1 FORMAT "%13.11" ECU_ADDRESS 0x60006C34 /end MEASUREMENT
/begin MEASUREMENT HEGO_OBDElecS2B1_I.DebErrElecMinSusTONV_I.time "Electrical diagnostics, HEGO sensor 2 bank 1 / Debouncing of electrical min error suspicion / expired delay time" UBYTE t_q0p1 1 100 0.00 25.50 FORMAT "%5.2" ECU_ADDRESS 0x60006C35 /end MEASUREMENT
/begin MEASUREMENT HEGO_OBDElecS2B1_I.DebErrElecMinTONV_I.outbit "Electrical diagnostics, HEGO sensor 2 bank 1 / Debouncing of electrical min error (short to ground) / return value" UBYTE B_TRUE 1 100 0.00 1.00000000000 BIT_MASK 0x1 FORMAT "%13.11" ECU_ADDRESS 0x60006C36 /end MEASUREMENT
/begin MEASUREMENT HEGO_OBDElecS2B1_I.DebErrElecMinTONV_I.time "Electrical diagnostics, HEGO sensor 2 bank 1 / Debouncing of electrical min error (short to ground) / expired delay time" UBYTE t_q0p1 1 100 0.00 25.50 FORMAT "%5.2" ECU_ADDRESS 0x60006C37 /end MEASUREMENT
/begin MEASUREMENT HEGO_OBDElecS2B1_I.DebErrElecSigSusTONV_I.outbit "Electrical diagnostics, HEGO sensor 2 bank 1 / Debouncing of electrical sig error suspicion / return value" UBYTE B_TRUE 1 100 0.00 1.00000000000 BIT_MASK 0x1 FORMAT "%13.11" ECU_ADDRESS 0x60006C38 /end MEASUREMENT
/begin MEASUREMENT HEGO_OBDElecS2B1_I.DebErrElecSigSusTONV_I.time "Electrical diagnostics, HEGO sensor 2 bank 1 / Debouncing of electrical sig error suspicion / expired delay time" UBYTE t_q0p1 1 100 0.00 25.50 FORMAT "%5.2" ECU_ADDRESS 0x60006C39 /end MEASUREMENT
/begin MEASUREMENT HEGO_OBDElecS2B1_I.DebRstErrElecMinTONV_I.outbit "Electrical diagnostics, HEGO sensor 2 bank 1 / Debouncing reset of electrical min error (short to ground) / return value" UBYTE B_TRUE 1 100 0.00 1.00000000000 BIT_MASK 0x1 FORMAT "%13.11" ECU_ADDRESS 0x60006C3A /end MEASUREMENT
/begin MEASUREMENT HEGO_OBDElecS2B1_I.DebRstErrElecMinTONV_I.time "Electrical diagnostics, HEGO sensor 2 bank 1 / Debouncing reset of electrical min error (short to ground) / expired delay time" UBYTE t_q0p1 1 100 0.00 25.50 FORMAT "%5.2" ECU_ADDRESS 0x60006C3B /end MEASUREMENT
/begin MEASUREMENT HEGO_OBDElecS2B1_I.ErrElecMaxFF_I.status "Electrical diagnostics, HEGO sensor 2 bank 1 / Flipflop electrical max error (short to battery) / current value of RS-FF" UBYTE B_TRUE 1 100 0.00 1.00000000000 BIT_MASK 0x1 FORMAT "%13.11" ECU_ADDRESS 0x60006C3C /end MEASUREMENT
/begin MEASUREMENT HEGO_OBDElecS2B1_I.ErrElecMinFF_I.status "Electrical diagnostics, HEGO sensor 2 bank 1 / Flipflop electrical min error (short to ground) / current value of RS-FF" UBYTE B_TRUE 1 100 0.00 1.00000000000 BIT_MASK 0x1 FORMAT "%13.11" ECU_ADDRESS 0x60006C3D /end MEASUREMENT
/begin MEASUREMENT HEGO_OBDElecS2B1_I.ErrElecSigRiFF_I.status "Electrical diagnostics, HEGO sensor 2 bank 1 / Flipflop electrical sig error (wire interruption) due to Ri / current value of RS-FF" UBYTE B_TRUE 1 100 0.00 1.00000000000 BIT_MASK 0x1 FORMAT "%13.11" ECU_ADDRESS 0x60006C3E /end MEASUREMENT
/begin MEASUREMENT HEGO_OBDElecS2B1_I.Min_I.bErrMinLdPls "Electrical diagnostics, HEGO sensor 2 bank 1 / Electrical min error (short to ground) diagnosis for HEGO sensors / Bit electrical min error (short to ground) detected by load pulse check" UBYTE B_TRUE 1 100 0.00 1.00000000000 BIT_MASK 0x1 FORMAT "%13.11" ECU_ADDRESS 0x60006C40 /end MEASUREMENT
/begin MEASUREMENT HEGO_OBDElecS2B1_I.Min_I.bLdPlsMinReq "Electrical diagnostics, HEGO sensor 2 bank 1 / Electrical min error (short to ground) diagnosis for HEGO sensors / Bit load pulses requested due to min error (short to ground) suspicion" UBYTE B_TRUE 1 100 0.00 1.00000000000 BIT_MASK 0x1 FORMAT "%13.11" ECU_ADDRESS 0x60006C41 /end MEASUREMENT
/begin MEASUREMENT HEGO_OBDElecS2B1_I.Min_I.flgMinDiagEnad "Electrical diagnostics, HEGO sensor 2 bank 1 / Electrical min error (short to ground) diagnosis for HEGO sensors / Condition Elec Min diagnosis enabled after suspicion is debounced." UBYTE B_TRUE 1 100 0.00 1.00000000000 BIT_MASK 0x1 FORMAT "%13.11" ECU_ADDRESS 0x60006C42 /end MEASUREMENT
/begin MEASUREMENT HEGO_OBDElecS2B1_I.Min_I.sm "Electrical diagnostics, HEGO sensor 2 bank 1 / Electrical min error (short to ground) diagnosis for HEGO sensors / State-index of state-machine for electrical min error diagnosis" UBYTE HEGO_OBDElecMin_CLS_sm_tab_verb 1 100 0.00 3.00000000000 FORMAT "%13.11" ECU_ADDRESS 0x60006C43 /end MEASUREMENT
/begin MEASUREMENT HEGO_OBDElecS2B1_I.Min_I.DelLdPlsMinTR_I.timeCounter "Electrical diagnostics, HEGO sensor 2 bank 1 / Electrical min error (short to ground) diagnosis for HEGO sensors / Timer Retrigger / Remaining time of the timer" UBYTE t_q0p1 1 100 0.00 25.50 FORMAT "%5.2" ECU_ADDRESS 0x60006C44 /end MEASUREMENT
/begin MEASUREMENT HEGO_OBDElecS2B1_I.Sig_I.bErrSigLdPls "Electrical diagnostics, HEGO sensor 2 bank 1 / Electrical sig error (wire interruption) diagnosis for HEGO sensors / Bit electrical sig error (wire interruption) detected by load pulse check" UBYTE B_TRUE 1 100 0.00 1.00000000000 BIT_MASK 0x1 FORMAT "%13.11" ECU_ADDRESS 0x60006C46 /end MEASUREMENT
/begin MEASUREMENT HEGO_OBDElecS2B1_I.Sig_I.bErrSigSusLdPls "Electrical diagnostics, HEGO sensor 2 bank 1 / Electrical sig error (wire interruption) diagnosis for HEGO sensors / Bit electrical sig error (wire interruption) suspicion after load pulse check" UBYTE B_TRUE 1 100 0.00 1.00000000000 BIT_MASK 0x1 FORMAT "%13.11" ECU_ADDRESS 0x60006C47 /end MEASUREMENT
/begin MEASUREMENT HEGO_OBDElecS2B1_I.Sig_I.bLdPlsSigCnfExe "Electrical diagnostics, HEGO sensor 2 bank 1 / Electrical sig error (wire interruption) diagnosis for HEGO sensors / Bit load pulses executed to confirm sig error (wire interruption) suspicion" UBYTE B_TRUE 1 100 0.00 1.00000000000 BIT_MASK 0x1 FORMAT "%13.11" ECU_ADDRESS 0x60006C48 /end MEASUREMENT
/begin MEASUREMENT HEGO_OBDElecS2B1_I.Sig_I.bLdPlsSigCnfReq "Electrical diagnostics, HEGO sensor 2 bank 1 / Electrical sig error (wire interruption) diagnosis for HEGO sensors / Bit load pulses requested to confirm sig error (wire interruption) suspicion" UBYTE B_TRUE 1 100 0.00 1.00000000000 BIT_MASK 0x1 FORMAT "%13.11" ECU_ADDRESS 0x60006C49 /end MEASUREMENT
/begin MEASUREMENT HEGO_OBDElecS2B1_I.Sig_I.bLdPlsSigExe "Electrical diagnostics, HEGO sensor 2 bank 1 / Electrical sig error (wire interruption) diagnosis for HEGO sensors / Bit load pulse executed due to sig error (wire interruption) suspicion" UBYTE B_TRUE 1 100 0.00 1.00000000000 BIT_MASK 0x1 FORMAT "%13.11" ECU_ADDRESS 0x60006C4A /end MEASUREMENT
/begin MEASUREMENT HEGO_OBDElecS2B1_I.Sig_I.bLdPlsSigReq "Electrical diagnostics, HEGO sensor 2 bank 1 / Electrical sig error (wire interruption) diagnosis for HEGO sensors / Bit load pulse requested due to sig error (wire interruption) suspicion" UBYTE B_TRUE 1 100 0.00 1.00000000000 BIT_MASK 0x1 FORMAT "%13.11" ECU_ADDRESS 0x60006C4B /end MEASUREMENT
/begin MEASUREMENT HEGO_OBDElecS2B1_I.Sig_I.sm "Electrical diagnostics, HEGO sensor 2 bank 1 / Electrical sig error (wire interruption) diagnosis for HEGO sensors / State-index of state-machine for electrical sig error diagnosis" UBYTE HEGO_OBDElecSig_CLS_sm_tab_verb 1 100 0.00 4.00000000000 FORMAT "%13.11" ECU_ADDRESS 0x60006C4C /end MEASUREMENT
/begin MEASUREMENT HEGO_OBDElecS2B1_I.Sig_I.DelLdPlsSigTR_I.timeCounter "Electrical diagnostics, HEGO sensor 2 bank 1 / Electrical sig error (wire interruption) diagnosis for HEGO sensors / Timer Retrigger / Remaining time of the timer" UBYTE t_q0p1 1 100 0.00 25.50 FORMAT "%5.2" ECU_ADDRESS 0x60006C4D /end MEASUREMENT
/begin MEASUREMENT HEGO_OBDHtgS2B1_I.bEnaDHtg "Heater performance diagnosis, HEGO sensor 2 bank 1 / Bit heater performance diagnosis enabled" UBYTE B_TRUE 1 100 0.00 1.00000000000 BIT_MASK 0x1 FORMAT "%13.11" ECU_ADDRESS 0x500019E5 /end MEASUREMENT
/begin MEASUREMENT HEGO_OBDHtgS2B1_I.bEnaDHtgFCMClrEngRun "Heater performance diagnosis, HEGO sensor 2 bank 1 / Bit heater performance diagnosis enabled in case of fcmclr with running engine" UBYTE B_TRUE 1 100 0.00 1.00000000000 BIT_MASK 0x1 FORMAT "%13.11" ECU_ADDRESS 0x500019E4 /end MEASUREMENT
/begin MEASUREMENT HEGO_OBDHtgS2B1_I.bErrHtg "Heater performance diagnosis, HEGO sensor 2 bank 1 / Bit heater performance fault" UBYTE B_TRUE 1 100 0.00 1.00000000000 BIT_MASK 0x1 FORMAT "%13.11" ECU_ADDRESS 0x500019E6 /end MEASUREMENT
/begin MEASUREMENT HEGO_OBDHtgS2B1_I.bHealHtg "Heater performance diagnosis, HEGO sensor 2 bank 1 / Bit healing of heater performance error" UBYTE B_TRUE 1 100 0.00 1.00000000000 BIT_MASK 0x2 FORMAT "%13.11" ECU_ADDRESS 0x500019E4 /end MEASUREMENT
/begin MEASUREMENT HEGO_OBDHtgS2B1_I.bHtgSuffRi "Heater performance diagnosis, HEGO sensor 2 bank 1 / Bit sufficient heating (Ri low enough)" UBYTE B_TRUE 1 100 0.00 1.00000000000 BIT_MASK 0x1 FORMAT "%13.11" ECU_ADDRESS 0x500019E7 /end MEASUREMENT
/begin MEASUREMENT HEGO_OBDHtgS2B1_I.bRiImPlausHi "Heater performance diagnosis, HEGO sensor 2 bank 1 / Bit Ri implausibly high" UBYTE B_TRUE 1 100 0.00 1.00000000000 BIT_MASK 0x4 FORMAT "%13.11" ECU_ADDRESS 0x500019E4 /end MEASUREMENT
/begin MEASUREMENT HEGO_OBDHtgS2B1_I.bRlsDHtg "Heater performance diagnosis, HEGO sensor 2 bank 1 / Bit release heater performance diagnosis" UBYTE B_TRUE 1 100 0.00 1.00000000000 BIT_MASK 0x8 FORMAT "%13.11" ECU_ADDRESS 0x500019E4 /end MEASUREMENT
/begin MEASUREMENT HEGO_OBDHtgS2B1_I.pwrHtgFlt "Heater performance diagnosis, HEGO sensor 2 bank 1 / Filtered normalized heating power" UBYTE fak_q0p01 1 100 0.00 2.550 FORMAT "%5.3" ECU_ADDRESS 0x500019E8 /end MEASUREMENT
/begin MEASUREMENT HEGO_OBDHtgS2B1_I.resRiThresDHtg "Heater performance diagnosis, HEGO sensor 2 bank 1 / Threshold internal resistance for heater performance diagnosis" UWORD r_uw_q2 1 100 0.00 131070.0 FORMAT "%8.1" ECU_ADDRESS 0x500019EA /end MEASUREMENT
/begin MEASUREMENT HEGO_OBDHtgS2B1_I.tEGFlt "Heater performance diagnosis, HEGO sensor 2 bank 1 / Filtered exhaust gas temperature for heater performance diagnosis" UWORD temp_q0p0234_o273 1 100 -273.150 1262.827 FORMAT "%8.3" ECU_ADDRESS 0x500019EC /end MEASUREMENT
/begin MEASUREMENT HEGO_OBDHtgS2B1_I.DHtgGenFuncReqFF_I.status "Heater performance diagnosis, HEGO sensor 2 bank 1 / General function request via scan tool for sensor heating testing / current value of RS-FF" UBYTE B_TRUE 1 100 0.00 1.00000000000 BIT_MASK 0x1 FORMAT "%13.11" ECU_ADDRESS 0x500019EE /end MEASUREMENT
/begin MEASUREMENT HEGO_OBDHtgS2B1_I.DebDPERiThresDHtgTONV_I.outbit "Heater performance diagnosis, HEGO sensor 2 bank 1 / Debouncing time for dew-point end to switch Ri threshold / return value" UBYTE B_TRUE 1 100 0.00 1.00000000000 BIT_MASK 0x1 FORMAT "%13.11" ECU_ADDRESS 0x500019F0 /end MEASUREMENT
/begin MEASUREMENT HEGO_OBDHtgS2B1_I.DebDPERiThresDHtgTONV_I.time "Heater performance diagnosis, HEGO sensor 2 bank 1 / Debouncing time for dew-point end to switch Ri threshold / expired delay time" UBYTE t_q0p1 1 100 0.00 25.50 FORMAT "%5.2" ECU_ADDRESS 0x500019F1 /end MEASUREMENT
/begin MEASUREMENT HEGO_OBDHtgS2B1_I.DebEnaDHtgCtlExtTONV_I.outbit "Heater performance diagnosis, HEGO sensor 2 bank 1 / TONV: Deboucing time external heating control heating performance diagnosis enable / return value" UBYTE B_TRUE 1 100 0.00 1.00000000000 BIT_MASK 0x1 FORMAT "%13.11" ECU_ADDRESS 0x500019F2 /end MEASUREMENT
/begin MEASUREMENT HEGO_OBDHtgS2B1_I.DebEnaDHtgCtlExtTONV_I.time "Heater performance diagnosis, HEGO sensor 2 bank 1 / TONV: Deboucing time external heating control heating performance diagnosis enable / expired delay time" UBYTE t_q0p1 1 100 0.00 25.50 FORMAT "%5.2" ECU_ADDRESS 0x500019F3 /end MEASUREMENT
/begin MEASUREMENT HEGO_OBDHtgS2B1_I.DebErrHtgFIDRlsTONV_I.outbit "Heater performance diagnosis, HEGO sensor 2 bank 1 / Debouncing heater performance error after FID release / return value" UBYTE B_TRUE 1 100 0.00 1.00000000000 BIT_MASK 0x1 FORMAT "%13.11" ECU_ADDRESS 0x500019F4 /end MEASUREMENT
/begin MEASUREMENT HEGO_OBDHtgS2B1_I.DebErrHtgFIDRlsTONV_I.time "Heater performance diagnosis, HEGO sensor 2 bank 1 / Debouncing heater performance error after FID release / expired delay time" UWORD t_q0p1 1 100 0.00 6553.500 FORMAT "%8.3" ECU_ADDRESS 0x500019F6 /end MEASUREMENT
/begin MEASUREMENT HEGO_OBDHtgS2B1_I.DebErrHtgIUMPRTONV_I.outbit "Heater performance diagnosis, HEGO sensor 2 bank 1 / Delay for debouncing of heater perormance error (IUMPR) / return value" UBYTE B_TRUE 1 100 0.00 1.00000000000 BIT_MASK 0x1 FORMAT "%13.11" ECU_ADDRESS 0x500019F8 /end MEASUREMENT
/begin MEASUREMENT HEGO_OBDHtgS2B1_I.DebErrHtgIUMPRTONV_I.time "Heater performance diagnosis, HEGO sensor 2 bank 1 / Delay for debouncing of heater perormance error (IUMPR) / expired delay time" UBYTE t_q0p1 1 100 0.00 25.50 FORMAT "%5.2" ECU_ADDRESS 0x500019F9 /end MEASUREMENT
/begin MEASUREMENT HEGO_OBDHtgS2B1_I.DebHealHtgTONV_I.outbit "Heater performance diagnosis, HEGO sensor 2 bank 1 / Debouncing of heater performance error healing / return value" UBYTE B_TRUE 1 100 0.00 1.00000000000 BIT_MASK 0x1 FORMAT "%13.11" ECU_ADDRESS 0x500019FA /end MEASUREMENT
/begin MEASUREMENT HEGO_OBDHtgS2B1_I.DebHealHtgTONV_I.time "Heater performance diagnosis, HEGO sensor 2 bank 1 / Debouncing of heater performance error healing / expired delay time" UBYTE t_q0p1 1 100 0.00 25.50 FORMAT "%5.2" ECU_ADDRESS 0x500019FB /end MEASUREMENT
/begin MEASUREMENT HEGO_OBDHtgS2B1_I.DebStrtEndDHtgTONV_I.outbit "Heater performance diagnosis, HEGO sensor 2 bank 1 / Debouncing for PID41 after start end for heater performance diagnostics / return value" UBYTE B_TRUE 1 100 0.00 1.00000000000 BIT_MASK 0x1 FORMAT "%13.11" ECU_ADDRESS 0x500019FC /end MEASUREMENT
/begin MEASUREMENT HEGO_OBDHtgS2B1_I.DebStrtEndDHtgTONV_I.time "Heater performance diagnosis, HEGO sensor 2 bank 1 / Debouncing for PID41 after start end for heater performance diagnostics / expired delay time" UBYTE t_q0p1 1 100 0.00 25.50 FORMAT "%5.2" ECU_ADDRESS 0x500019FD /end MEASUREMENT
/begin MEASUREMENT HEGO_OBDHtgS2B1_I.PwrHtgLPT_I.memory "Heater performance diagnosis, HEGO sensor 2 bank 1 / Low-pass filter for heater power / current lowpass value" ULONG fak_q1p5259Em7 1 100 0.00 655.359999847 FORMAT "%13.9" ECU_ADDRESS 0x50001A00 /end MEASUREMENT
/begin MEASUREMENT HEGO_OBDHtgS2B1_I.TempEGLPT_I.memory "Heater performance diagnosis, HEGO sensor 2 bank 1 / Low-pass filter for exhaust gas temperature / current lowpass value" ULONG temp_q3p57Em7_om273 1 100 -273.15000000 1262.84999964 FORMAT "%13.8" ECU_ADDRESS 0x50001A04 /end MEASUREMENT
/begin MEASUREMENT HEGO_OBDHtgS2B1_I.flgDebErrHtgTONV_I.outbit "Heater performance diagnosis, HEGO sensor 2 bank 1 / Delay for debouncing of heater performance error / return value" UBYTE B_TRUE 1 100 0.00 1.00000000000 BIT_MASK 0x1 FORMAT "%13.11" ECU_ADDRESS 0x50001A08 /end MEASUREMENT
/begin MEASUREMENT HEGO_OBDHtgS2B1_I.flgDebErrHtgTONV_I.time "Heater performance diagnosis, HEGO sensor 2 bank 1 / Delay for debouncing of heater performance error / expired delay time" UBYTE t_q0p1 1 100 0.00 25.50 FORMAT "%5.2" ECU_ADDRESS 0x50001A09 /end MEASUREMENT
/begin MEASUREMENT HEGO_OBDHtg_ctReIni "ReInitialization request counter for HEGO_OBDHtg" UBYTE OneToOne 1 100 0.00 255.0 FORMAT "%5.1" ECU_ADDRESS 0x6000AFCB /end MEASUREMENT
/begin MEASUREMENT HEGO_OBDHtrPsS2B1_I.bDHtrPsEna "Heater powerstage diagnostics, HEGO sensor 2 bank 1 / Bit heater power stage diagnostics enabled" UBYTE B_TRUE 1 100 0.00 1.00000000000 BIT_MASK 0x1 FORMAT "%13.11" ECU_ADDRESS 0x60002784 /end MEASUREMENT
/begin MEASUREMENT HEGO_OBDHtrPsS2B1_I.bFCMClrReqdCL100ms "Heater powerstage diagnostics, HEGO sensor 2 bank 1 / FCM Clear requested for CL_100ms task" UBYTE B_TRUE 1 100 0.00 1.00000000000 BIT_MASK 0x1 FORMAT "%13.11" ECU_ADDRESS 0x60002785 /end MEASUREMENT
/begin MEASUREMENT HEGO_OBDHtrPsS2B1_I.stErrInfo "Heater powerstage diagnostics, HEGO sensor 2 bank 1 / status variable for power stage diagnosis error information" ULONG OneToOne 1 100 0.00 4294967295.00 FORMAT "%13.2" ECU_ADDRESS 0x60002788 /end MEASUREMENT
/begin MEASUREMENT HEGO_OBDHtrPsS2B1_I.DHtrPsEnaTONV_I.outbit "Heater powerstage diagnostics, HEGO sensor 2 bank 1 / Debouncing of enable conditions for heater power stage diagnostics / return value" UBYTE B_TRUE 1 100 0.00 1.00000000000 BIT_MASK 0x1 FORMAT "%13.11" ECU_ADDRESS 0x6000278C /end MEASUREMENT
/begin MEASUREMENT HEGO_OBDHtrPsS2B1_I.DHtrPsEnaTONV_I.time "Heater powerstage diagnostics, HEGO sensor 2 bank 1 / Debouncing of enable conditions for heater power stage diagnostics / expired delay time" UBYTE t_q0p1 1 100 0.00 25.50 FORMAT "%5.2" ECU_ADDRESS 0x6000278D /end MEASUREMENT
/begin MEASUREMENT HEGO_OBDHtrPsS2B1_I.DebDHtrPsEnaFstTONV_I.outbit "Heater powerstage diagnostics, HEGO sensor 2 bank 1 / Debouncing of fast enable conditions for heater power stage diagnostics / return value" UBYTE B_TRUE 1 100 0.00 1.00000000000 BIT_MASK 0x1 FORMAT "%13.11" ECU_ADDRESS 0x6000278E /end MEASUREMENT
/begin MEASUREMENT HEGO_OBDHtrPsS2B1_I.DebDHtrPsEnaFstTONV_I.time "Heater powerstage diagnostics, HEGO sensor 2 bank 1 / Debouncing of fast enable conditions for heater power stage diagnostics / expired delay time" UBYTE t_q0p1 1 100 0.00 25.50 FORMAT "%5.2" ECU_ADDRESS 0x6000278F /end MEASUREMENT
/begin MEASUREMENT HEGO_OpRdnS2B1_I.bEna "Operating readiness, HEGO sensor 2 bank 1 / Bit enable conditions" UBYTE B_TRUE 1 100 0.00 1.00000000000 BIT_MASK 0x1 FORMAT "%13.11" ECU_ADDRESS 0x600133BA /end MEASUREMENT
/begin MEASUREMENT HEGO_OpRdnS2B1_I.bEnaDElec "Operating readiness, HEGO sensor 2 bank 1 / Bit electrical diagnostics enabled" UBYTE B_TRUE 1 100 0.00 1.00000000000 BIT_MASK 0x2 FORMAT "%13.11" ECU_ADDRESS 0x600133BA /end MEASUREMENT
/begin MEASUREMENT HEGO_OpRdnS2B1_I.bEnaOpRdnSens "Operating readiness, HEGO sensor 2 bank 1 / Bit enable operation readiness based on sensor signals" UBYTE B_TRUE 1 100 0.00 1.00000000000 BIT_MASK 0x1 FORMAT "%13.11" ECU_ADDRESS 0x600133BB /end MEASUREMENT
/begin MEASUREMENT HEGO_OpRdnS2B1_I.bEnaSigChkd "Operating readiness, HEGO sensor 2 bank 1 / Bit enable conditions signal error checked" UBYTE B_TRUE 1 100 0.00 1.00000000000 BIT_MASK 0x2 FORMAT "%13.11" ECU_ADDRESS 0x600133BB /end MEASUREMENT
/begin MEASUREMENT HEGO_OpRdnS2B1_I.bErrSigPrev "Operating readiness, HEGO sensor 2 bank 1 / Bit electrical sig error (wire interruption) in previous trip" UBYTE B_TRUE 1 100 0.00 1.00000000000 BIT_MASK 0x4 FORMAT "%13.11" ECU_ADDRESS 0x600133BA /end MEASUREMENT
/begin MEASUREMENT HEGO_OpRdnS2B1_I.bExptOpRdn "Operating readiness, HEGO sensor 2 bank 1 / Flag expected operation readiness" UBYTE B_TRUE 1 100 0.00 1.00000000000 BIT_MASK 0x4 FORMAT "%13.11" ECU_ADDRESS 0x600133BB /end MEASUREMENT
/begin MEASUREMENT HEGO_OpRdnS2B1_I.bFCMClrReqdCL100ms "Operating readiness, HEGO sensor 2 bank 1 / FCM clear request for CL_100ms taks" UBYTE B_TRUE 1 100 0.00 1.00000000000 BIT_MASK 0x1 FORMAT "%13.11" ECU_ADDRESS 0x600133BC /end MEASUREMENT
/begin MEASUREMENT HEGO_OpRdnS2B1_I.bHEGOInVldErr "Operating readiness, HEGO sensor 2 bank 1 / Reset of sensor readiness due to failure" UBYTE B_TRUE 1 100 0.00 1.00000000000 BIT_MASK 0x1 FORMAT "%13.11" ECU_ADDRESS 0x600133BD /end MEASUREMENT
/begin MEASUREMENT HEGO_OpRdnS2B1_I.bHtgOk "Operating readiness, HEGO sensor 2 bank 1 / Bit heating OK" UBYTE B_TRUE 1 100 0.00 1.00000000000 BIT_MASK 0x1 FORMAT "%13.11" ECU_ADDRESS 0x600133BE /end MEASUREMENT
/begin MEASUREMENT HEGO_OpRdnS2B1_I.bOpRdnRiReq "Operating readiness, HEGO sensor 2 bank 1 / Bit Ri measurement request for sensor operating readiness" UBYTE B_TRUE 1 100 0.00 1.00000000000 BIT_MASK 0x8 FORMAT "%13.11" ECU_ADDRESS 0x600133BA /end MEASUREMENT
/begin MEASUREMENT HEGO_OpRdnS2B1_I.bRiOkOpRdn "Operating readiness, HEGO sensor 2 bank 1 / Bit Ri ok for operating readiness" UBYTE B_TRUE 1 100 0.00 1.00000000000 BIT_MASK 0x20 FORMAT "%13.11" ECU_ADDRESS 0x600133BA /end MEASUREMENT
/begin MEASUREMENT HEGO_OpRdnS2B1_I.bSVld "Operating readiness, HEGO sensor 2 bank 1 / Bit sensor signal valid" UBYTE B_TRUE 1 100 0.00 1.00000000000 BIT_MASK 0x40 FORMAT "%13.11" ECU_ADDRESS 0x600133BA /end MEASUREMENT
/begin MEASUREMENT HEGO_OpRdnS2B1_I.bStkCVB "Operating readiness, HEGO sensor 2 bank 1 / Bit stuck in counter voltage band" UBYTE B_TRUE 1 100 0.00 1.00000000000 BIT_MASK 0x8 FORMAT "%13.11" ECU_ADDRESS 0x600133BB /end MEASUREMENT
/begin MEASUREMENT HEGO_OpRdnS2B1_I.flgTCerMdlOk "Operating readiness, HEGO sensor 2 bank 1 / Flag modelled sensor ceramic temperature is okay" UBYTE B_TRUE 1 100 0.00 1.00000000000 BIT_MASK 0x10 FORMAT "%13.11" ECU_ADDRESS 0x600133BB /end MEASUREMENT
/begin MEASUREMENT HEGO_OpRdnS2B1_I.numCalcRiOpRdn "Operating readiness, HEGO sensor 2 bank 1 / Number of Ri calculations for operation readiness" UBYTE dez 1 100 0.00 255.0 FORMAT "%5.1" ECU_ADDRESS 0x600133BF /end MEASUREMENT
/begin MEASUREMENT HEGO_OpRdnS2B1_I.tEGOpRdn "Operating readiness, HEGO sensor 2 bank 1 / Exhaust gas temperature for operation readiness detection" UWORD temp_q0p0234_om273 1 100 -273.150 1262.827 FORMAT "%8.3" ECU_ADDRESS 0x600133C0 /end MEASUREMENT
/begin MEASUREMENT HEGO_OpRdnS2B1_I.DebErrStkTONV_I.outbit "Operating readiness, HEGO sensor 2 bank 1 / Debouncing of stuck error / return value" UBYTE B_TRUE 1 100 0.00 1.00000000000 BIT_MASK 0x1 FORMAT "%13.11" ECU_ADDRESS 0x600133C2 /end MEASUREMENT
/begin MEASUREMENT HEGO_OpRdnS2B1_I.DebErrStkTONV_I.time "Operating readiness, HEGO sensor 2 bank 1 / Debouncing of stuck error / expired delay time" UWORD t_q0p1 1 100 0.00 6553.500 FORMAT "%8.3" ECU_ADDRESS 0x600133C4 /end MEASUREMENT
/begin MEASUREMENT HEGO_OpRdnS2B1_I.DebExptOpRdnTONV_I.outbit "Operating readiness, HEGO sensor 2 bank 1 / Debouncing of expected operating readiness / return value" UBYTE B_TRUE 1 100 0.00 1.00000000000 BIT_MASK 0x1 FORMAT "%13.11" ECU_ADDRESS 0x600133C6 /end MEASUREMENT
/begin MEASUREMENT HEGO_OpRdnS2B1_I.DebExptOpRdnTONV_I.time "Operating readiness, HEGO sensor 2 bank 1 / Debouncing of expected operating readiness / expired delay time" UWORD t_q0p1 1 100 0.00 6553.500 FORMAT "%8.3" ECU_ADDRESS 0x600133C8 /end MEASUREMENT
/begin MEASUREMENT HEGO_OpRdnS2B1_I.DebPrtHtgFinTONV_I.outbit "Operating readiness, HEGO sensor 2 bank 1 / Debouncing of protective heating finished / return value" UBYTE B_TRUE 1 100 0.00 1.00000000000 BIT_MASK 0x1 FORMAT "%13.11" ECU_ADDRESS 0x600133CA /end MEASUREMENT
/begin MEASUREMENT HEGO_OpRdnS2B1_I.DebPrtHtgFinTONV_I.time "Operating readiness, HEGO sensor 2 bank 1 / Debouncing of protective heating finished / expired delay time" UWORD t_q0p1 1 100 0.00 6553.500 FORMAT "%8.3" ECU_ADDRESS 0x600133CC /end MEASUREMENT
/begin MEASUREMENT HEGO_OpRdnS2B1_I.DebSVldTONV_I.outbit "Operating readiness, HEGO sensor 2 bank 1 / Debouncing sensor signal valid / return value" UBYTE B_TRUE 1 100 0.00 1.00000000000 BIT_MASK 0x1 FORMAT "%13.11" ECU_ADDRESS 0x600133D0 /end MEASUREMENT
/begin MEASUREMENT HEGO_OpRdnS2B1_I.DebSVldTONV_I.time "Operating readiness, HEGO sensor 2 bank 1 / Debouncing sensor signal valid / expired delay time" UBYTE t_q0p1 1 100 0.00 25.50 FORMAT "%5.2" ECU_ADDRESS 0x600133D1 /end MEASUREMENT
/begin MEASUREMENT HEGO_OpRdnS2B1_I.EnaOpRdnHtgFF_I.status "Operating readiness, HEGO sensor 2 bank 1 / Enable cold operation readiness / current value of RS-FF" UBYTE B_TRUE 1 100 0.00 1.00000000000 BIT_MASK 0x1 FORMAT "%13.11" ECU_ADDRESS 0x600133D2 /end MEASUREMENT
/begin MEASUREMENT HEGO_OpRdnS2B1_I.OpRdnMemFF_I.status "Operating readiness, HEGO sensor 2 bank 1 / Flipflop operation readiness / current value of RS-FF" UBYTE B_TRUE 1 100 0.00 1.00000000000 BIT_MASK 0x1 FORMAT "%13.11" ECU_ADDRESS 0x600133D3 /end MEASUREMENT
/begin MEASUREMENT HEGO_OpRdnS2B1_I.SVldFF_I.status "Operating readiness, HEGO sensor 2 bank 1 / Flipflop sensor signal valid / current value of RS-FF" UBYTE B_TRUE 1 100 0.00 1.00000000000 BIT_MASK 0x1 FORMAT "%13.11" ECU_ADDRESS 0x600133D4 /end MEASUREMENT
/begin MEASUREMENT HEGO_OpRdnS2B1_I.StkCVBSusFF_I.status "Operating readiness, HEGO sensor 2 bank 1 / Flipflop suspicion of stuck in countervoltage band / current value of RS-FF" UBYTE B_TRUE 1 100 0.00 1.00000000000 BIT_MASK 0x1 FORMAT "%13.11" ECU_ADDRESS 0x600133D5 /end MEASUREMENT
/begin MEASUREMENT HEGO_OpRdnS2B1_I.numRiOkCTR_I.counter "Operating readiness, HEGO sensor 2 bank 1 / Counter for valid Ri measurements / current counter value" UBYTE dez 1 100 0.00 255.0 FORMAT "%5.1" ECU_ADDRESS 0x600133D6 /end MEASUREMENT
/begin MEASUREMENT HEGO_resS2B1Ri "Internal resistance, HEGO sensor 2 bank 1" UWORD r_uw_q2 1 100 0.00 131070.0 FORMAT "%8.1" ECU_ADDRESS 0x600085F8 /end MEASUREMENT
/begin MEASUREMENT HEGO_resS2B1RiCorrd "Corrected Internal resistance, HEGO sensor 2 bank 1" UWORD r_uw_q2 1 100 0.00 131070.0 FORMAT "%8.1" ECU_ADDRESS 0x600085F6 /end MEASUREMENT
/begin MEASUREMENT HEGO_resS2B1RiCorrdFild "Temperature related corrected unfiltered internal resistance,HEGO sensor 2 bank 1" UWORD r_uw_q2 1 100 0.00 131070.0 FORMAT "%8.1" ECU_ADDRESS 0x600085F4 /end MEASUREMENT
/begin MEASUREMENT HEGO_resS2B1RiNoFlt "Unfiltered internal resistance, HEGO sensor 2 bank 1" UWORD r_uw_q2 1 100 0.00 131070.0 FORMAT "%8.1" ECU_ADDRESS 0x60013F72 /end MEASUREMENT
/begin MEASUREMENT HEGO_resS2B1RiThres "Threshold internal resistance, HEGO sensor 2 bank 1" UWORD r_uw_q2 1 100 0.00 131070.0 FORMAT "%8.1" ECU_ADDRESS 0x600085F0 /end MEASUREMENT
/begin MEASUREMENT HEGO_rS2B1Lam "Lambda, HEGO sensor 2 bank 1" UWORD fak_q3p0518Em5 1 100 0.00 1.999969 FORMAT "%8.6" ECU_ADDRESS 0x700053A8 /end MEASUREMENT
/begin MEASUREMENT HEGO_rS2B1LamHiRes "Lambda, HEGO sensor 2 bank 1" UWORD fak_q3p0518Em5 1 100 0.00 1.999969 FORMAT "%8.6" ECU_ADDRESS 0x700053AA /end MEASUREMENT
/begin MEASUREMENT HEGO_SensS2B1_ctReIni "sensor 2 bank 1 specific counter to trigger ReIni if not equal to SyC_ctPostDrvLeave" UBYTE dez 1 100 0.00 255.0 FORMAT "%5.1" ECU_ADDRESS 0x70002E62 /end MEASUREMENT
/begin MEASUREMENT HEGO_SensS2B1_I.bCalcRi "Signal acquisition of HEGO sensor 2 bank 1 / Bit claculate internal resistance" UBYTE B_TRUE 1 100 0.00 1.00000000000 BIT_MASK 0x1 FORMAT "%13.11" ECU_ADDRESS 0x500056DD /end MEASUREMENT
/begin MEASUREMENT HEGO_SensS2B1_I.bDelOpRdnRiPls "Signal acquisition of HEGO sensor 2 bank 1 / Bit delay for sensor operation detection Ri pulse active" UBYTE B_TRUE 1 100 0.00 1.00000000000 BIT_MASK 0x1 FORMAT "%13.11" ECU_ADDRESS 0x500056DC /end MEASUREMENT
/begin MEASUREMENT HEGO_SensS2B1_I.bEnaLdPls "Signal acquisition of HEGO sensor 2 bank 1 / Bit load pulse check enabled" UBYTE B_TRUE 1 100 0.00 1.00000000000 BIT_MASK 0x1 FORMAT "%13.11" ECU_ADDRESS 0x60012629 /end MEASUREMENT
/begin MEASUREMENT HEGO_SensS2B1_I.bEnaOpRdnRiPls "Signal acquisition of HEGO sensor 2 bank 1 / Bit operation readiness detection Ri pulse enabled" UBYTE B_TRUE 1 100 0.00 1.00000000000 BIT_MASK 0x1 FORMAT "%13.11" ECU_ADDRESS 0x6001262A /end MEASUREMENT
/begin MEASUREMENT HEGO_SensS2B1_I.bEnaRi "Signal acquisition of HEGO sensor 2 bank 1 / Bit measurement of internal resistance enabled" UBYTE B_TRUE 1 100 0.00 1.00000000000 BIT_MASK 0x1 FORMAT "%13.11" ECU_ADDRESS 0x60012628 /end MEASUREMENT
/begin MEASUREMENT HEGO_SensS2B1_I.bEnaRiFlt "Signal acquisition of HEGO sensor 2 bank 1 / Bit enable transfer of current internal resistance to the filter" UBYTE B_TRUE 1 100 0.00 1.00000000000 BIT_MASK 0x2 FORMAT "%13.11" ECU_ADDRESS 0x500056DC /end MEASUREMENT
/begin MEASUREMENT HEGO_SensS2B1_I.bEnaRiSens "Signal acquisition of HEGO sensor 2 bank 1 / Bit enable condition for Ri measurement" UBYTE B_TRUE 1 100 0.00 1.00000000000 BIT_MASK 0x2 FORMAT "%13.11" ECU_ADDRESS 0x60012628 /end MEASUREMENT
/begin MEASUREMENT HEGO_SensS2B1_I.bFCMClrReqd100ms "Signal acquisition of HEGO sensor 2 bank 1 / FCM_Clear requested for _100ms task" UBYTE B_TRUE 1 100 0.00 1.00000000000 BIT_MASK 0x1 FORMAT "%13.11" ECU_ADDRESS 0x500056DE /end MEASUREMENT
/begin MEASUREMENT HEGO_SensS2B1_I.bFCMClrReqd1ms "Signal acquisition of HEGO sensor 2 bank 1 / FCM_Clear requested for _1ms task" UBYTE B_TRUE 1 100 0.00 1.00000000000 BIT_MASK 0x1 FORMAT "%13.11" ECU_ADDRESS 0x5000028C /end MEASUREMENT
/begin MEASUREMENT HEGO_SensS2B1_I.bFrzRi "Signal acquisition of HEGO sensor 2 bank 1 / Bit sensor signal frozen due to measurement of internal resistance" UBYTE B_TRUE 1 100 0.00 1.00000000000 BIT_MASK 0x1 FORMAT "%13.11" ECU_ADDRESS 0x6001262B /end MEASUREMENT
/begin MEASUREMENT HEGO_SensS2B1_I.bFrzRiPrev "Signal acquisition of HEGO sensor 2 bank 1 / flag voltage freezed due to Ri-measurement with value of previous sequence call" UBYTE B_TRUE 1 100 0.00 1.00000000000 BIT_MASK 0x1 FORMAT "%13.11" ECU_ADDRESS 0x5000028D /end MEASUREMENT
/begin MEASUREMENT HEGO_SensS2B1_I.bLdPlsEval "Signal acquisition of HEGO sensor 2 bank 1 / Bit evaluate result of load pulse check" UBYTE B_TRUE 1 100 0.00 1.00000000000 BIT_MASK 0x4 FORMAT "%13.11" ECU_ADDRESS 0x500056DC /end MEASUREMENT
/begin MEASUREMENT HEGO_SensS2B1_I.bLdPlsFin "Signal acquisition of HEGO sensor 2 bank 1 / Bit load pulse check finished" UBYTE B_TRUE 1 100 0.00 1.00000000000 BIT_MASK 0x8 FORMAT "%13.11" ECU_ADDRESS 0x500056DC /end MEASUREMENT
/begin MEASUREMENT HEGO_SensS2B1_I.bLdPlsRslt "Signal acquisition of HEGO sensor 2 bank 1 / Bit result of load pulse measurement is available" UBYTE B_TRUE 1 100 0.00 1.00000000000 BIT_MASK 0x1 FORMAT "%13.11" ECU_ADDRESS 0x6001262C /end MEASUREMENT
/begin MEASUREMENT HEGO_SensS2B1_I.bNewRi "Signal acquisition of HEGO sensor 2 bank 1 / Bit New Ri value available" UBYTE B_TRUE 1 100 0.00 1.00000000000 BIT_MASK 0x1 FORMAT "%13.11" ECU_ADDRESS 0x500056DF /end MEASUREMENT
/begin MEASUREMENT HEGO_SensS2B1_I.bPlausRi "Signal acquisition of HEGO sensor 2 bank 1 / Bit current internal resistance is plausible" UBYTE B_TRUE 1 100 0.00 1.00000000000 BIT_MASK 0x10 FORMAT "%13.11" ECU_ADDRESS 0x500056DC /end MEASUREMENT
/begin MEASUREMENT HEGO_SensS2B1_I.bPolarRedPls "Signal acquisition of HEGO sensor 2 bank 1 / Bit pulse for polarization reduction" UBYTE B_TRUE 1 100 0.00 1.00000000000 BIT_MASK 0x1 FORMAT "%13.11" ECU_ADDRESS 0x5000028E /end MEASUREMENT
/begin MEASUREMENT HEGO_SensS2B1_I.bRiMeas "Signal acquisition of HEGO sensor 2 bank 1 / bit: Ri-measurement done (independent from validity of measurement)" UBYTE B_TRUE 1 100 0.00 1.00000000000 BIT_MASK 0x1 FORMAT "%13.11" ECU_ADDRESS 0x500056E0 /end MEASUREMENT
/begin MEASUREMENT HEGO_SensS2B1_I.bRiPls "Signal acquisition of HEGO sensor 2 bank 1 / Bit pulse for measurement of internal resistance" UBYTE B_TRUE 1 100 0.00 1.00000000000 BIT_MASK 0x1 FORMAT "%13.11" ECU_ADDRESS 0x5000028F /end MEASUREMENT
/begin MEASUREMENT HEGO_SensS2B1_I.bRiTrg "Signal acquisition of HEGO sensor 2 bank 1 / Bit trigger measurement of internal resistance" UBYTE B_TRUE 1 100 0.00 1.00000000000 BIT_MASK 0x1 FORMAT "%13.11" ECU_ADDRESS 0x50000290 /end MEASUREMENT
/begin MEASUREMENT HEGO_SensS2B1_I.bVldRi "Signal acquisition of HEGO sensor 2 bank 1 / Bit internal resistance is valid" UBYTE B_TRUE 1 100 0.00 1.00000000000 BIT_MASK 0x1 FORMAT "%13.11" ECU_ADDRESS 0x500056E1 /end MEASUREMENT
/begin MEASUREMENT HEGO_SensS2B1_I.ctLdPls "Signal acquisition of HEGO sensor 2 bank 1 / Number of load pulses" UBYTE dez 1 100 0.00 255.0 FORMAT "%5.1" ECU_ADDRESS 0x6001262D /end MEASUREMENT
/begin MEASUREMENT HEGO_SensS2B1_I.flgCdnStMacTran02 "Signal acquisition of HEGO sensor 2 bank 1 / transition condition from _0_measure_us to _2_ri_acquisition for Ri-measurement" UBYTE B_TRUE 1 100 0.00 1.00000000000 BIT_MASK 0x4 FORMAT "%13.11" ECU_ADDRESS 0x60012628 /end MEASUREMENT
/begin MEASUREMENT HEGO_SensS2B1_I.flgCdnStMacTran12 "Signal acquisition of HEGO sensor 2 bank 1 / transition condition from _1_pending to _2_ri_acquisition for Ri-measurement" UBYTE B_TRUE 1 100 0.00 1.00000000000 BIT_MASK 0x8 FORMAT "%13.11" ECU_ADDRESS 0x60012628 /end MEASUREMENT
/begin MEASUREMENT HEGO_SensS2B1_I.flgInitVolt "Signal acquisition of HEGO sensor 2 bank 1 / Flag initial voltage acquisition has happened with necessary conditions" UBYTE B_TRUE 1 100 0.00 1.00000000000 BIT_MASK 0x1 FORMAT "%13.11" ECU_ADDRESS 0x50000291 /end MEASUREMENT
/begin MEASUREMENT HEGO_SensS2B1_I.flgNewUSExtd "Signal acquisition of HEGO sensor 2 bank 1 / voltage acquisition done newly" UBYTE B_TRUE 1 100 0.00 1.00000000000 BIT_MASK 0x1 FORMAT "%13.11" ECU_ADDRESS 0x50000292 /end MEASUREMENT
/begin MEASUREMENT HEGO_SensS2B1_I.flgNumVoltMeasmtElecMaxSuff "Signal acquisition of HEGO sensor 2 bank 1 / class internal flag number of voltage measurements for ElecMax-(SCB) diagnosis debounce sufficient" UBYTE B_TRUE 1 100 0.00 1.00000000000 BIT_MASK 0x1 FORMAT "%13.11" ECU_ADDRESS 0x50000293 /end MEASUREMENT
/begin MEASUREMENT HEGO_SensS2B1_I.numCalcRi "Signal acquisition of HEGO sensor 2 bank 1 / Numerator for indication of executed Ri-pulse" UBYTE dez 1 100 0.00 255.0 FORMAT "%5.1" ECU_ADDRESS 0x500056E2 /end MEASUREMENT
/begin MEASUREMENT HEGO_SensS2B1_I.numLdPlsMax "Signal acquisition of HEGO sensor 2 bank 1 / Maximum number of load pulses" UBYTE dez 1 100 0.00 255.0 FORMAT "%5.1" ECU_ADDRESS 0x6001262E /end MEASUREMENT
/begin MEASUREMENT HEGO_SensS2B1_I.numNewRi "Signal acquisition of HEGO sensor 2 bank 1 / Numerator for indication of a new Ri value" UBYTE dez 1 100 0.00 255.0 FORMAT "%5.1" ECU_ADDRESS 0x500056E3 /end MEASUREMENT
/begin MEASUREMENT HEGO_SensS2B1_I.numVoltMeasmtElecMax "Signal acquisition of HEGO sensor 2 bank 1 / class internal counter of voltage measurement for elecMax-diagnosis" UBYTE dez 1 100 0.00 255.0 FORMAT "%5.1" ECU_ADDRESS 0x50000294 /end MEASUREMENT
/begin MEASUREMENT HEGO_SensS2B1_I.resRi "Signal acquisition of HEGO sensor 2 bank 1 / Internal resistance of HEGO sensor" UWORD r_uw_q2 1 100 0.00 131070.0 FORMAT "%8.1" ECU_ADDRESS 0x500056E4 /end MEASUREMENT
/begin MEASUREMENT HEGO_SensS2B1_I.resRiCorrd "Signal acquisition of HEGO sensor 2 bank 1 / Corrected internal resistance" UWORD r_uw_q2 1 100 0.00 131070.0 FORMAT "%8.1" ECU_ADDRESS 0x500056E6 /end MEASUREMENT
/begin MEASUREMENT HEGO_SensS2B1_I.resRiCorrdFild "Signal acquisition of HEGO sensor 2 bank 1 / Temperature releated corrected Internal resistance" UWORD r_uw_q2 1 100 0.00 131070.0 FORMAT "%8.1" ECU_ADDRESS 0x500056E8 /end MEASUREMENT
/begin MEASUREMENT HEGO_SensS2B1_I.resRiCorrdPrev "Signal acquisition of HEGO sensor 2 bank 1 / Previous corrected internal resistance" UWORD r_uw_q2 1 100 0.00 131070.0 FORMAT "%8.1" ECU_ADDRESS 0x500056EA /end MEASUREMENT
/begin MEASUREMENT HEGO_SensS2B1_I.resRiNoFlt "Signal acquisition of HEGO sensor 2 bank 1 / Unfiltered internal resistance of HEGO sensor" UWORD r_uw_q2 1 100 0.00 131070.0 FORMAT "%8.1" ECU_ADDRESS 0x500056EC /end MEASUREMENT
/begin MEASUREMENT HEGO_SensS2B1_I.sm "Signal acquisition of HEGO sensor 2 bank 1 / State-index of state-machine for signal acquisition" UBYTE HEGO_Sens_CLS_sm_tab_verb 1 100 0.00 2.00000000000 FORMAT "%13.11" ECU_ADDRESS 0x6001262F /end MEASUREMENT
/begin MEASUREMENT HEGO_SensS2B1_I.uLdPls "Signal acquisition of HEGO sensor 2 bank 1 / Voltage resulting from load pulse check" UWORD spg_q1p221Em3_V 1 100 0.00 4.998779 FORMAT "%8.6" ECU_ADDRESS 0x500056EE /end MEASUREMENT
/begin MEASUREMENT HEGO_SensS2B1_I.uLdPlsDiff "Signal acquisition of HEGO sensor 2 bank 1 / Voltage difference due to load pulse" UWORD spg_q1p221Em3_V 1 100 0.00 15.00000 FORMAT "%8.5" ECU_ADDRESS 0x60012630 /end MEASUREMENT
/begin MEASUREMENT HEGO_SensS2B1_I.uRiAftFrz "Signal acquisition of HEGO sensor 2 bank 1 / Sensor voltage after freeze due to measurement of the internal resistance" UWORD spg_q1p221Em3_V 1 100 0.00 4.998779 FORMAT "%8.6" ECU_ADDRESS 0x60012634 /end MEASUREMENT
/begin MEASUREMENT HEGO_SensS2B1_I.uRiWiLd "Signal acquisition of HEGO sensor 2 bank 1 / Sensor voltage with load for the measurement of the internal resistance" UWORD spg_q1p221Em3_V 1 100 0.00 4.998779 FORMAT "%8.6" ECU_ADDRESS 0x50000296 /end MEASUREMENT
/begin MEASUREMENT HEGO_SensS2B1_I.uRiWoLd "Signal acquisition of HEGO sensor 2 bank 1 / Sensor voltage without load for the measurement of the internal resistance" UWORD spg_q1p221Em3_V 1 100 0.00 4.998779 FORMAT "%8.6" ECU_ADDRESS 0x50000298 /end MEASUREMENT
/begin MEASUREMENT HEGO_SensS2B1_I.uSExtd "Signal acquisition of HEGO sensor 2 bank 1 / Output voltage of HEGO sensor, extended range" UWORD spg_q1p221Em3_V 1 100 0.00 4.998779 FORMAT "%8.6" ECU_ADDRESS 0x60012636 /end MEASUREMENT
/begin MEASUREMENT HEGO_SensS2B1_I.uSExtdHeatrOff "Signal acquisition of HEGO sensor 2 bank 1 / measured voltage during heater off state" UWORD spg_q1p221Em3_V 1 100 0.00 4.998779 FORMAT "%8.6" ECU_ADDRESS 0x5000029A /end MEASUREMENT
/begin MEASUREMENT HEGO_SensS2B1_I.uVoltMeasmtFildElecMax "Signal acquisition of HEGO sensor 2 bank 1 / filtered voltage inside HEGO_Sens_CLS value for ElecMax diagnosis" UWORD spg_q1p221Em3_V 1 100 0.00 4.998779 FORMAT "%8.6" ECU_ADDRESS 0x5000029C /end MEASUREMENT
/begin MEASUREMENT HEGO_SensS2B1_I.DebEnaRiVltgTONV_I.outbit "Signal acquisition of HEGO sensor 2 bank 1 / Debouncing of Ri measurement (sensor voltage) / return value" UBYTE B_TRUE 1 100 0.00 1.00000000000 BIT_MASK 0x1 FORMAT "%13.11" ECU_ADDRESS 0x60012638 /end MEASUREMENT
/begin MEASUREMENT HEGO_SensS2B1_I.DebEnaRiVltgTONV_I.time "Signal acquisition of HEGO sensor 2 bank 1 / Debouncing of Ri measurement (sensor voltage) / expired delay time" UBYTE t_q0p01 1 100 0.00 2.550 FORMAT "%5.3" ECU_ADDRESS 0x60012639 /end MEASUREMENT
/begin MEASUREMENT HEGO_SensS2B1_I.DelLdPlsT_I.timeCounter "Signal acquisition of HEGO sensor 2 bank 1 / Timer for waiting between two load pulses / Remaining time of the timer" UWORD t_q0p1 1 100 0.00 6553.500 FORMAT "%8.3" ECU_ADDRESS 0x500056F0 /end MEASUREMENT
/begin MEASUREMENT HEGO_SensS2B1_I.DelOpRdnRiPlsT_I.timeCounter "Signal acquisition of HEGO sensor 2 bank 1 / Delay after operation readiness detection Ri pulse / Remaining time of the timer" UBYTE t_q0p1 1 100 0.00 25.50 FORMAT "%5.2" ECU_ADDRESS 0x500056F2 /end MEASUREMENT
/begin MEASUREMENT HEGO_SensS2B1_I.FrzRiT_I.timeCounter "Signal acquisition of HEGO sensor 2 bank 1 / Timer for freeze of sensor voltage during Ri measurement / Remaining time of the timer" UBYTE t_q0p01 1 100 0.00 2.550 FORMAT "%5.3" ECU_ADDRESS 0x6001263A /end MEASUREMENT
/begin MEASUREMENT HEGO_SensS2B1_I.NewRiTR_I.timeCounter "Signal acquisition of HEGO sensor 2 bank 1 / Timer for up-to-dateness of Ri value / Remaining time of the timer" UBYTE t_q0p1 1 100 0.00 25.50 FORMAT "%5.2" ECU_ADDRESS 0x500056F3 /end MEASUREMENT
/begin MEASUREMENT HEGO_SensS2B1_I.PolarRedPlsT_I.timeCounter "Signal acquisition of HEGO sensor 2 bank 1 / Timer for duration of pulse for polarization recuction / Remaining time of the timer" UWORD t_q0p001 1 100 0.00 65.53500 FORMAT "%8.5" ECU_ADDRESS 0x5000029E /end MEASUREMENT
/begin MEASUREMENT HEGO_SensS2B1_I.RiCalcCTR_I.counter "Signal acquisition of HEGO sensor 2 bank 1 / Counter for number of calculations of the internal resistance / current counter value" UBYTE dez 1 100 0.00 255.0 FORMAT "%5.1" ECU_ADDRESS 0x6001263B /end MEASUREMENT
/begin MEASUREMENT HEGO_SensS2B1_I.RiCorrdDL_I.memory "Signal acquisition of HEGO sensor 2 bank 1 / Digital lowpass for T-corrected internal resistance / current lowpass value" ULONG r_q3p0518Em5 1 100 0.00 131071.999969 FORMAT "%13.6" ECU_ADDRESS 0x6001263C /end MEASUREMENT
/begin MEASUREMENT HEGO_SensS2B1_I.RiDL_I.memory "Signal acquisition of HEGO sensor 2 bank 1 / Digital lowpass for internal resistance / current lowpass value" ULONG r_q3p0518Em5 1 100 0.00 131071.999969 FORMAT "%13.6" ECU_ADDRESS 0x60012640 /end MEASUREMENT
/begin MEASUREMENT HEGO_SensS2B1_I.RiNoPlausCTR_I.counter "Signal acquisition of HEGO sensor 2 bank 1 / Counter implausible measurements of the internal resistance / current counter value" UBYTE dez 1 100 0.00 255.0 FORMAT "%5.1" ECU_ADDRESS 0x60012644 /end MEASUREMENT
/begin MEASUREMENT HEGO_SensS2B1_I.RiPlsT_I.timeCounter "Signal acquisition of HEGO sensor 2 bank 1 / Timer for duration of Ri measurement pulse / Remaining time of the timer" UBYTE t_q0p001 1 100 0.00 0.2550 FORMAT "%6.4" ECU_ADDRESS 0x500002A0 /end MEASUREMENT
/begin MEASUREMENT HEGO_SensS2B1_I.bLdPlsSigCnfReqER_I.buffer "Signal acquisition of HEGO sensor 2 bank 1 / Rising edge of bLdPlsSigCnfReq / rising edge detected" UBYTE B_TRUE 1 100 0.00 1.00000000000 BIT_MASK 0x1 FORMAT "%13.11" ECU_ADDRESS 0x60012646 /end MEASUREMENT
/begin MEASUREMENT HEGO_SensS2B1_I.bLdPlsSigCnfReqER_I.oldSignal "Signal acquisition of HEGO sensor 2 bank 1 / Rising edge of bLdPlsSigCnfReq / flag rising edge" UBYTE B_TRUE 1 100 0.00 1.00000000000 BIT_MASK 0x1 FORMAT "%13.11" ECU_ADDRESS 0x60012647 /end MEASUREMENT
/begin MEASUREMENT HEGO_SensS2B1_I.bLdPlsSigReqER_I.buffer "Signal acquisition of HEGO sensor 2 bank 1 / Rising edge of bLdPlsSigReq / rising edge detected" UBYTE B_TRUE 1 100 0.00 1.00000000000 BIT_MASK 0x1 FORMAT "%13.11" ECU_ADDRESS 0x60012648 /end MEASUREMENT
/begin MEASUREMENT HEGO_SensS2B1_I.bLdPlsSigReqER_I.oldSignal "Signal acquisition of HEGO sensor 2 bank 1 / Rising edge of bLdPlsSigReq / flag rising edge" UBYTE B_TRUE 1 100 0.00 1.00000000000 BIT_MASK 0x1 FORMAT "%13.11" ECU_ADDRESS 0x60012649 /end MEASUREMENT
/begin MEASUREMENT HEGO_SensS2B1_I.flgHeatgOffTONV_I.outbit "Signal acquisition of HEGO sensor 2 bank 1 / Delay of heater OFF state for voltage acquisition for Heater coupling detection in ElecMax diagnosis / return value" UBYTE B_TRUE 1 100 0.00 1.00000000000 BIT_MASK 0x1 FORMAT "%13.11" ECU_ADDRESS 0x500002A2 /end MEASUREMENT
/begin MEASUREMENT HEGO_SensS2B1_I.flgHeatgOffTONV_I.time "Signal acquisition of HEGO sensor 2 bank 1 / Delay of heater OFF state for voltage acquisition for Heater coupling detection in ElecMax diagnosis / expired delay time" UBYTE t_q0p001 1 100 0.00 0.2550 FORMAT "%6.4" ECU_ADDRESS 0x500002A3 /end MEASUREMENT
/begin MEASUREMENT HEGO_SensS2B1_I.uVoltMeasmtElecMaxDL_I.memory "Signal acquisition of HEGO sensor 2 bank 1 / filter for measured voltages during heater off for ElecMax-diagnosis / current lowpass value" ULONG spg_q1p8626Em8_V 1 100 0.00 4.99999998137 FORMAT "%13.11" ECU_ADDRESS 0x500002A4 /end MEASUREMENT
/begin MEASUREMENT HEGO_SigCorS2B1_I.duDifT "class instance for HEGO signal correction sensor 2 bank 1 / Voltage deviation caused by temperature deviation, HEGO" SWORD spg_q1p221Em3_V 1 100 -2.500000 2.498779 FORMAT "%8.6" ECU_ADDRESS 0x500056F6 /end MEASUREMENT
/begin MEASUREMENT HEGO_SigCorS2B1_I.duSigCor "class instance for HEGO signal correction sensor 2 bank 1 / Voltage signal correction dependant on ceramic temperature" SWORD spg_q1p221Em3_V 1 100 -2.500000 2.498779 FORMAT "%8.6" ECU_ADDRESS 0x500056F8 /end MEASUREMENT
/begin MEASUREMENT HEGO_SigCorS2B1_I.numNewRiOld "class instance for HEGO signal correction sensor 2 bank 1 / numerator copy of new Ri for new-Ri-value-indication" UBYTE dez 1 100 0.00 255.0 FORMAT "%5.1" ECU_ADDRESS 0x70002E60 /end MEASUREMENT
/begin MEASUREMENT HEGO_SigCorS2B1_I.numTCerRiVld "class instance for HEGO signal correction sensor 2 bank 1 / Numerator for indication of a valid ceramic temperature sensor 1 bank 1" UBYTE dez 1 100 0.00 255.0 FORMAT "%5.1" ECU_ADDRESS 0x70002E61 /end MEASUREMENT
/begin MEASUREMENT HEGO_SigCorS2B1_I.resRi "class instance for HEGO signal correction sensor 2 bank 1 / internal resistance considering Ri-aging" UWORD r_uw_q2 1 100 0.00 131070.0 FORMAT "%8.1" ECU_ADDRESS 0x500056FA /end MEASUREMENT
/begin MEASUREMENT HEGO_SigCorS2B1_I.resRiElec "class instance for HEGO signal correction sensor 2 bank 1 / initernal resistance in electrical contest" UWORD r_uw_q2 1 100 0.00 131070.0 FORMAT "%8.1" ECU_ADDRESS 0x500056FC /end MEASUREMENT
/begin MEASUREMENT HEGO_SigCorS2B1_I.resRiWpDisp "class instance for HEGO signal correction sensor 2 bank 1 / internal resistance considering Ri-aging" UWORD r_uw_q2 1 100 0.00 131070.0 FORMAT "%8.1" ECU_ADDRESS 0x500056FE /end MEASUREMENT
/begin MEASUREMENT HEGO_SigCorS2B1_I.tCerAct "class instance for HEGO signal correction sensor 2 bank 1 / Actual ceramic temperature, HEGO" UWORD temp_q0p0234_o273 1 100 -273.150 1262.827 FORMAT "%8.3" ECU_ADDRESS 0x50005700 /end MEASUREMENT
/begin MEASUREMENT HEGO_SigCorS2B1_I.tCerNom "class instance for HEGO signal correction sensor 2 bank 1 / Nominal ceramic temperature, HEGO" UWORD temp_q0p0234_o273 1 100 -273.150 1262.827 FORMAT "%8.3" ECU_ADDRESS 0x50005702 /end MEASUREMENT
/begin MEASUREMENT HEGO_SigCorS2B1_I.uNernst "class instance for HEGO signal correction sensor 2 bank 1 / Nernst voltage without electrical circuit, HEGO" UWORD spg_q1p221Em3_V 1 100 0.00 4.998779 FORMAT "%8.6" ECU_ADDRESS 0x50005704 /end MEASUREMENT
/begin MEASUREMENT HEGO_SigCorS2B1_I.uNernstTCor "class instance for HEGO signal correction sensor 2 bank 1 / Nernst volatge at nominal temperature" UWORD spg_q1p221Em3_V 1 100 0.00 4.998779 FORMAT "%8.6" ECU_ADDRESS 0x50005706 /end MEASUREMENT
/begin MEASUREMENT HEGO_SigCorS2B1_I.uTNom "class instance for HEGO signal correction sensor 2 bank 1 / Nernst voltage at nominal temperature, HEGO" UWORD spg_q1p221Em3_V 1 100 0.00 4.998779 FORMAT "%8.6" ECU_ADDRESS 0x50005708 /end MEASUREMENT
/begin MEASUREMENT HEGO_SigCorS2B1_I.uTNomCor "class instance for HEGO signal correction sensor 2 bank 1 / temperature corrected measured sensor voltage" UWORD spg_q1p221Em3_V 1 100 0.00 4.998779 FORMAT "%8.6" ECU_ADDRESS 0x5000570A /end MEASUREMENT
/begin MEASUREMENT HEGO_SnsrTMdlS2B1_I.ctReset100ms "sensor temperature model, class instance sensor 2 bank 1 / Counter reset for interfaces in 100ms" UBYTE OneToOne 1 100 0.00 255.0 FORMAT "%5.1" ECU_ADDRESS 0x60002790 /end MEASUREMENT
/begin MEASUREMENT HEGO_SnsrTMdlS2B1_I.dtMdlEg "sensor temperature model, class instance sensor 2 bank 1 / temperature difference between exhaust gas and sensor ceramic temperature model" SWORD temp_q0p0234 1 100 -768.0000 767.9766 FORMAT "%8.4" ECU_ADDRESS 0x60002792 /end MEASUREMENT
/begin MEASUREMENT HEGO_SnsrTMdlS2B1_I.dtMdlEgWall "sensor temperature model, class instance sensor 2 bank 1 / temperature difference between exhaust gas wall and sensor ceramic temperature model" SWORD temp_q0p0234 1 100 -768.0000 767.9766 FORMAT "%8.4" ECU_ADDRESS 0x60002794 /end MEASUREMENT
/begin MEASUREMENT HEGO_SnsrTMdlS2B1_I.dtMdlEng "sensor temperature model, class instance sensor 2 bank 1 / temperature difference between engine and sensor ceramic temperature model" SWORD temp_q0p0234 1 100 -768.0000 767.9766 FORMAT "%8.4" ECU_ADDRESS 0x60002796 /end MEASUREMENT
/begin MEASUREMENT HEGO_SnsrTMdlS2B1_I.dtMdlIntkAir "sensor temperature model, class instance sensor 2 bank 1 / temperature difference between intake air and sensor ceramic temperature model" SWORD temp_q0p0234 1 100 -768.0000 767.9766 FORMAT "%8.4" ECU_ADDRESS 0x60002798 /end MEASUREMENT
/begin MEASUREMENT HEGO_SnsrTMdlS2B1_I.flgReset "sensor temperature model, class instance sensor 2 bank 1 / Flag reset in FcmClr" UBYTE B_TRUE 1 100 0.00 1.00000000000 BIT_MASK 0x1 FORMAT "%13.11" ECU_ADDRESS 0x6000279A /end MEASUREMENT
/begin MEASUREMENT HEGO_SnsrTMdlS2B1_I.iPHeatr "sensor temperature model, class instance sensor 2 bank 1 / Heater current" UWORD i_q0p00039_A 1 100 0.00 24.99962 FORMAT "%8.5" ECU_ADDRESS 0x6000279C /end MEASUREMENT
/begin MEASUREMENT HEGO_SnsrTMdlS2B1_I.pwrMdlEg "sensor temperature model, class instance sensor 2 bank 1 / Modelled heat flow from exhaust gas to sensor ceramic" SWORD leist_q0p00244 1 100 -80.00000 79.99756 FORMAT "%8.5" ECU_ADDRESS 0x6000279E /end MEASUREMENT
/begin MEASUREMENT HEGO_SnsrTMdlS2B1_I.pwrMdlEgWall "sensor temperature model, class instance sensor 2 bank 1 / Modelled heat flow from exhaust wall to sensor ceramic" SWORD leist_q0p00244 1 100 -80.00000 79.99756 FORMAT "%8.5" ECU_ADDRESS 0x600027A0 /end MEASUREMENT
/begin MEASUREMENT HEGO_SnsrTMdlS2B1_I.pwrMdlEng "sensor temperature model, class instance sensor 2 bank 1 / Modelled heat flow from engine to sensor ceramic" SWORD leist_q0p00244 1 100 -80.00000 79.99756 FORMAT "%8.5" ECU_ADDRESS 0x600027A2 /end MEASUREMENT
/begin MEASUREMENT HEGO_SnsrTMdlS2B1_I.pwrMdlHeatr "sensor temperature model, class instance sensor 2 bank 1 / Modelled heat flow from sensor heater to sensor ceramic" UWORD leist_q0p00244 1 100 0.00 159.9976 FORMAT "%8.4" ECU_ADDRESS 0x600027A4 /end MEASUREMENT
/begin MEASUREMENT HEGO_SnsrTMdlS2B1_I.pwrMdlIntAir "sensor temperature model, class instance sensor 2 bank 1 / Modelled heat flow from intake air to sensor ceramic" SWORD leist_q0p00244 1 100 -80.00000 79.99756 FORMAT "%8.5" ECU_ADDRESS 0x600027A6 /end MEASUREMENT
/begin MEASUREMENT HEGO_SnsrTMdlS2B1_I.rHeatr "sensor temperature model, class instance sensor 2 bank 1 / Heater resistance" UWORD r_q0p00039_Ohm 1 100 0.00 25.59961 FORMAT "%8.5" ECU_ADDRESS 0x600027A8 /end MEASUREMENT
/begin MEASUREMENT HEGO_SnsrTMdlS2B1_I.tCerMdl "sensor temperature model, class instance sensor 2 bank 1 / modelled sensor ceramic temperature" SLONG temp_q1p5259Em6_om273 1 100 -3549.94000000 3003.65999847 FORMAT "%13.8" ECU_ADDRESS 0x600027AC /end MEASUREMENT
/begin MEASUREMENT HEGO_SnsrTMdlS2B1_I.tCerMdlWpDisp "sensor temperature model, class instance sensor 2 bank 1 / modelled sensor ceramic temperature" UWORD temp_q0p0234_om273 1 100 -273.150 1262.827 FORMAT "%8.3" ECU_ADDRESS 0x600027B0 /end MEASUREMENT
/begin MEASUREMENT HEGO_tS2B1CerAct "Actual ceramic temperature, HEGO sensor 2 bank 1" UWORD temp_q0p0234_o273 1 100 -273.150 1262.827 FORMAT "%8.3" ECU_ADDRESS 0x700053AC /end MEASUREMENT
/begin MEASUREMENT HEGO_tS2B1EGFltDHtg "Filtered exhaust gas temperature for heater performance diagnosis, HEGO sensor 2 bank 1" UWORD temp_q0p0234_o273 1 100 -273.150 1262.827 FORMAT "%8.3" ECU_ADDRESS 0x600085EE /end MEASUREMENT
/begin MEASUREMENT HEGO_tS2CerNom "Nominal ceramic temperature, HEGO sensor 2" UWORD temp_q0p0234_o273 1 100 -273.150 1262.827 FORMAT "%8.3" ECU_ADDRESS 0x700053AE /end MEASUREMENT
/begin MEASUREMENT HEGO_uLamHiResS2 "Last modified sensor voltage befor tranfer to lambda, HEGO sensor 2 working point display" UWORD spg_q1p221Em3_V 1 100 0.00 4.998779 FORMAT "%8.6" ECU_ADDRESS 0x600133D8 /end MEASUREMENT
/begin MEASUREMENT HEGO_uS2B1 "Output voltage of Heated Exhaust Gas Oxygen sensor 2 bank 1" UBYTE spg_q0p00488 1 100 0.00 1.245 FORMAT "%5.3" ECU_ADDRESS 0x6000F41E /end MEASUREMENT
/begin MEASUREMENT HEGO_uS2B1Extd "Output voltage of HEGO sensor 2 bank 1, extended range" UWORD spg_q0p00488 1 100 0.00 4.995117 FORMAT "%8.6" ECU_ADDRESS 0x60008C0A /end MEASUREMENT
/begin MEASUREMENT HEGO_uS2B1HiRes "Output voltage of Heated Exhaust Gas Oxygen sensor 2 bank 1, high resolution" UWORD spg_q1p221Em3_V 1 100 0.00 4.998779 FORMAT "%8.6" ECU_ADDRESS 0x700053B0 /end MEASUREMENT
/begin MEASUREMENT HEGO_uS2B1LamHiRes "Last modified sensor voltage before transfer to lambda, Heated Exhaust Gas Oxygen sensor 2 bank 1" UWORD spg_q1p221Em3_V 1 100 0.00 4.998779 FORMAT "%8.6" ECU_ADDRESS 0x60008C08 /end MEASUREMENT
/begin MEASUREMENT HEGO_uS2B1LdPls "Voltage resulting from load pulse check, HEGO sensor 2 bank 1" UWORD spg_q1p221Em3_V 1 100 0.00 4.998779 FORMAT "%8.6" ECU_ADDRESS 0x600085EC /end MEASUREMENT
/begin MEASUREMENT HEGO_uS2B1SymcHiRes "Symmetrized sensor voltage, Heated Exhaust Gas Oxygen sensor 2 bank 1" UWORD spg_q1p221Em3_V 1 100 0.00 4.998779 FORMAT "%8.6" ECU_ADDRESS 0x60008C06 /end MEASUREMENT
/begin MEASUREMENT HEGO_uS2B1Tstr "Output voltage of HEGO sensor 2 bank 1, for tester" UBYTE spg_q0p005 1 100 0.00 1.275 FORMAT "%5.3" ECU_ADDRESS 0x7000549D /end MEASUREMENT
/begin MEASUREMENT HEGO_uS2B1WiH2HiRes "Output voltage of HEGO sensor 2 bank 1, with hydrogen influence, high resolution" UWORD spg_q1p221Em3_V 1 100 0.00 4.998779 FORMAT "%8.6" ECU_ADDRESS 0x60008C04 /end MEASUREMENT
/begin MEASUREMENT HEGO_uS2B1WoDynSimHiRes "Output voltage of HEGO sensor 2 bank 1, without dynamics simulation, high resolution" UWORD spg_q1p221Em3_V 1 100 0.00 4.998779 FORMAT "%8.6" ECU_ADDRESS 0x60013F74 /end MEASUREMENT
/begin MEASUREMENT HEGO_uVoltMeasmtFildElecMaxS2B1 "filtered voltage during heater off state for ElecMax-diagnosis, S2B1" UWORD spg_q1p221Em3_V 1 100 0.00 4.998779 FORMAT "%8.6" ECU_ADDRESS 0x70003970 /end MEASUREMENT
/begin MEASUREMENT HEGO_VltgSymcS2B1_I.flgLtrDly "Sensor voltage symmetrization, HEGO sensor 2 bank 1 / Flag asymemtric delay time lean-rich" UBYTE B_TRUE 1 100 0.00 1.00000000000 BIT_MASK 0x1 FORMAT "%13.11" ECU_ADDRESS 0x60002740 /end MEASUREMENT
/begin MEASUREMENT HEGO_VltgSymcS2B1_I.flgLtrSlow "Sensor voltage symmetrization, HEGO sensor 2 bank 1 / Flag asymemtric slow-down lean-rich" UBYTE B_TRUE 1 100 0.00 1.00000000000 BIT_MASK 0x2 FORMAT "%13.11" ECU_ADDRESS 0x60002740 /end MEASUREMENT
/begin MEASUREMENT HEGO_VltgSymcS2B1_I.flgLtrTran "Sensor voltage symmetrization, HEGO sensor 2 bank 1 / Flag asymemtric transition time lean-rich" UBYTE B_TRUE 1 100 0.00 1.00000000000 BIT_MASK 0x4 FORMAT "%13.11" ECU_ADDRESS 0x60002740 /end MEASUREMENT
/begin MEASUREMENT HEGO_VltgSymcS2B1_I.flgRtlDly "Sensor voltage symmetrization, HEGO sensor 2 bank 1 / Flag asymemtric delay time rich-lean" UBYTE B_TRUE 1 100 0.00 1.00000000000 BIT_MASK 0x8 FORMAT "%13.11" ECU_ADDRESS 0x60002740 /end MEASUREMENT
/begin MEASUREMENT HEGO_VltgSymcS2B1_I.flgRtlSlow "Sensor voltage symmetrization, HEGO sensor 2 bank 1 / Flag asymemtric slow-down rich-lean" UBYTE B_TRUE 1 100 0.00 1.00000000000 BIT_MASK 0x10 FORMAT "%13.11" ECU_ADDRESS 0x60002740 /end MEASUREMENT
/begin MEASUREMENT HEGO_VltgSymcS2B1_I.flgRtlTran "Sensor voltage symmetrization, HEGO sensor 2 bank 1 / Flag asymemtric transition time rich-lean" UBYTE B_TRUE 1 100 0.00 1.00000000000 BIT_MASK 0x20 FORMAT "%13.11" ECU_ADDRESS 0x60002740 /end MEASUREMENT
/begin MEASUREMENT HEGO_VltgSymcS2B1_I.flgSymcEna "Sensor voltage symmetrization, HEGO sensor 2 bank 1 / Flag enable symmetrization" UBYTE B_TRUE 1 100 0.00 1.00000000000 BIT_MASK 0x40 FORMAT "%13.11" ECU_ADDRESS 0x60002740 /end MEASUREMENT
/begin MEASUREMENT HEGO_VltgSymcS2B1_I.uSmotngOld "Sensor voltage symmetrization, HEGO sensor 2 bank 1 / Smoothed sensor voltage, old value" UWORD spg_q1p221Em3_V 1 100 0.00 4.998779 FORMAT "%8.6" ECU_ADDRESS 0x60002742 /end MEASUREMENT
/begin MEASUREMENT HEGO_VltgSymcS2B1_I.uSymc "Sensor voltage symmetrization, HEGO sensor 2 bank 1 / Symmetrized sensor voltage" UWORD spg_q1p221Em3_V 1 100 0.00 4.998779 FORMAT "%8.6" ECU_ADDRESS 0x60002744 /end MEASUREMENT
/begin MEASUREMENT HEGO_VltgSymcS2B1_I.uSymcTran "Sensor voltage symmetrization, HEGO sensor 2 bank 1 / Sensor voltage after transition time symmetrization" UWORD spg_q1p221Em3_V 1 100 0.00 4.998779 FORMAT "%8.6" ECU_ADDRESS 0x60002746 /end MEASUREMENT
/begin MEASUREMENT HEGO_VltgSymcS2B1_I.flgSlowER_I.buffer "Sensor voltage symmetrization, HEGO sensor 2 bank 1 / Rising edge of asymmetric slow-down / rising edge detected" UBYTE B_TRUE 1 100 0.00 1.00000000000 BIT_MASK 0x1 FORMAT "%13.11" ECU_ADDRESS 0x60002748 /end MEASUREMENT
/begin MEASUREMENT HEGO_VltgSymcS2B1_I.flgSlowER_I.oldSignal "Sensor voltage symmetrization, HEGO sensor 2 bank 1 / Rising edge of asymmetric slow-down / flag rising edge" UBYTE B_TRUE 1 100 0.00 1.00000000000 BIT_MASK 0x1 FORMAT "%13.11" ECU_ADDRESS 0x60002749 /end MEASUREMENT
/begin MEASUREMENT HEGO_VltgSymcS2B1_I.flgSymcDlyEnaER_I.buffer "Sensor voltage symmetrization, HEGO sensor 2 bank 1 / Rising edge of enable condition for delay time symmetrization / rising edge detected" UBYTE B_TRUE 1 100 0.00 1.00000000000 BIT_MASK 0x1 FORMAT "%13.11" ECU_ADDRESS 0x6000274A /end MEASUREMENT
/begin MEASUREMENT HEGO_VltgSymcS2B1_I.flgSymcDlyEnaER_I.oldSignal "Sensor voltage symmetrization, HEGO sensor 2 bank 1 / Rising edge of enable condition for delay time symmetrization / flag rising edge" UBYTE B_TRUE 1 100 0.00 1.00000000000 BIT_MASK 0x1 FORMAT "%13.11" ECU_ADDRESS 0x6000274B /end MEASUREMENT
/begin MEASUREMENT HEGO_VltgSymcS2B1_I.flgSymcTranEnaER_I.buffer "Sensor voltage symmetrization, HEGO sensor 2 bank 1 / Rising edge of enable condition for transition time symmetrization / rising edge detected" UBYTE B_TRUE 1 100 0.00 1.00000000000 BIT_MASK 0x1 FORMAT "%13.11" ECU_ADDRESS 0x6000274C /end MEASUREMENT
/begin MEASUREMENT HEGO_VltgSymcS2B1_I.flgSymcTranEnaER_I.oldSignal "Sensor voltage symmetrization, HEGO sensor 2 bank 1 / Rising edge of enable condition for transition time symmetrization / flag rising edge" UBYTE B_TRUE 1 100 0.00 1.00000000000 BIT_MASK 0x1 FORMAT "%13.11" ECU_ADDRESS 0x6000274D /end MEASUREMENT
/begin MEASUREMENT HEGO_VltgSymcS2B1_I.uDlyDTTtOptSens_I.buffer "Sensor voltage symmetrization, HEGO sensor 2 bank 1 / Delay for delay time symmetrization / Delay for symmetrization" UWORD spg_q1p221Em3_V 1 100 0.00 4.998779 FORMAT "%8.6" ARRAY_SIZE 21 ECU_ADDRESS 0x6000274E /end MEASUREMENT
/begin MEASUREMENT HEGO_VltgSymcS2B1_I.uDlyDTTtOptSens_I.counter "Sensor voltage symmetrization, HEGO sensor 2 bank 1 / Delay for delay time symmetrization / Delay for symmetrization" UWORD fak_uw_b2 1 100 0.00 1.000000 FORMAT "%8.6" ECU_ADDRESS 0x60002778 /end MEASUREMENT
/begin MEASUREMENT HEGO_VltgSymcS2B1_I.uDlyDTTtOptSens_I.pointer "Sensor voltage symmetrization, HEGO sensor 2 bank 1 / Delay for delay time symmetrization / Delay for symmetrization" UBYTE dez 1 100 0.00 255.0 FORMAT "%5.1" ECU_ADDRESS 0x6000277A /end MEASUREMENT
/begin MEASUREMENT HEGO_VltgSymcS2B1_I.uSmotngLT_I.memory "Sensor voltage symmetrization, HEGO sensor 2 bank 1 / Smoothing of sensor voltage for direction detection in case if symmetrization / current lowpass value" ULONG spg_q1p8626Em8_V 1 100 0.00 4.99999998137 FORMAT "%13.11" ECU_ADDRESS 0x6000277C /end MEASUREMENT
/begin MEASUREMENT HEGO_VltgSymcS2B1_I.uTranLT_I.memory "Sensor voltage symmetrization, HEGO sensor 2 bank 1 / Lowpass filter for transition time symmetrization / current lowpass value" ULONG spg_q1p8626Em8_V 1 100 0.00 4.99999998137 FORMAT "%13.11" ECU_ADDRESS 0x60002780 /end MEASUREMENT
/begin MEASUREMENT HESrv_stMSid "ECU ID in 2 ECU concepts" UBYTE HESrv_stMSid_t 1 100 0.00 255.000000000 FORMAT "%13.9" ECU_ADDRESS 0x6000F41D /end MEASUREMENT
/begin MEASUREMENT HLSDem_bDrvOffSuprtActv "Drive-off support is active" UBYTE B_TRUE 1 100 0.00 1.00000000000 BIT_MASK 0x1 FORMAT "%13.11" ECU_ADDRESS 0x6000F0FA /end MEASUREMENT
/begin MEASUREMENT HLSDem_bErr1 "Engine speed limitation by the inhibition of the FId_HLSDemErr1" UBYTE B_TRUE 1 100 0.00 1.00000000000 BIT_MASK 0x1 FORMAT "%13.11" ECU_ADDRESS 0x70000225 /end MEASUREMENT
/begin MEASUREMENT HLSDem_bErr2 "Engine speed limitation by the inhibition of the FId_HLSDemErr2" UBYTE B_TRUE 1 100 0.00 1.00000000000 BIT_MASK 0x1 FORMAT "%13.11" ECU_ADDRESS 0x70000224 /end MEASUREMENT
/begin MEASUREMENT HLSDem_bNMaxHi "Condition short increase of engine speed limit" UBYTE B_TRUE 1 100 0.00 1.00000000000 BIT_MASK 0x1 FORMAT "%13.11" ECU_ADDRESS 0x70000223 /end MEASUREMENT
/begin MEASUREMENT HLSDem_bNMaxHiTmp "Limitation of engine speed because of high temperature" UBYTE B_TRUE 1 100 0.00 1.00000000000 BIT_MASK 0x1 FORMAT "%13.11" ECU_ADDRESS 0x700008C3 /end MEASUREMENT
/begin MEASUREMENT HLSDem_bNMaxHiTmpLmpOn "Request hot lamp on because of limitation of engine speed" UBYTE B_TRUE 1 100 0.00 1.00000000000 BIT_MASK 0x1 FORMAT "%13.11" ECU_ADDRESS 0x700008C2 /end MEASUREMENT
/begin MEASUREMENT HLSDem_bNMaxKnCtl "Condition engine speed limitation at safety ignition retard by knock control" UBYTE B_TRUE 1 100 0.00 1.00000000000 BIT_MASK 0x1 FORMAT "%13.11" ECU_ADDRESS 0x70000222 /end MEASUREMENT
/begin MEASUREMENT HLSDem_bNMaxPrio "Condition set desired transmission speed" UBYTE B_TRUE 1 100 0.00 1.00000000000 BIT_MASK 0x1 FORMAT "%13.11" ECU_ADDRESS 0x700008C1 /end MEASUREMENT
/begin MEASUREMENT HLSDem_bNMaxRed "Reduce of maximum engine speed" UBYTE B_TRUE 1 100 0.00 1.00000000000 BIT_MASK 0x1 FORMAT "%13.11" ECU_ADDRESS 0x700008C0 /end MEASUREMENT
/begin MEASUREMENT HLSDem_bNMaxWrm "Speed limit warm-up activ" UBYTE B_TRUE 1 100 0.00 1.00000000000 BIT_MASK 0x1 FORMAT "%13.11" ECU_ADDRESS 0x700008BE /end MEASUREMENT
/begin MEASUREMENT HLSDem_bOvhtEngNLim "Engine speed limitation due to high temperatures active" UBYTE B_TRUE 1 100 0.00 1.00000000000 BIT_MASK 0x1 FORMAT "%13.11" ECU_ADDRESS 0x700008BD /end MEASUREMENT
/begin MEASUREMENT HLSDem_bOvhtEngNLimGov "Engine speed limitation due to high temperatures for governor active." UBYTE B_TRUE 1 100 0.00 1.00000000000 BIT_MASK 0x1 FORMAT "%13.11" ECU_ADDRESS 0x700008BC /end MEASUREMENT
/begin MEASUREMENT HLSDem_bStandStillLimActv "Standstill limitation active." UBYTE B_TRUE 1 100 0.00 1.00000000000 BIT_MASK 0x1 FORMAT "%13.11" ECU_ADDRESS 0x70000221 /end MEASUREMENT
/begin MEASUREMENT HLSDem_bVehStand "Status standstill of vehicle" UBYTE B_TRUE 1 100 0.00 1.00000000000 BIT_MASK 0x1 FORMAT "%13.11" ECU_ADDRESS 0x6000AFC3 /end MEASUREMENT
/begin MEASUREMENT HLSDem_facAppDeadZone "Weighted voltage difference between accelerator pedal sensor 1 and accelerator pedal sensor 2" SWORD Fact 1 100 -4.000000 3.999878 FORMAT "%8.6" ECU_ADDRESS 0x600090A6 /end MEASUREMENT
/begin MEASUREMENT HLSDem_facEngSpdLim "Weighing factor for Engine speed limitation from different temperatures." SWORD Fact 1 100 -4.000000 3.999878 FORMAT "%8.6" ECU_ADDRESS 0x600133DA /end MEASUREMENT
/begin MEASUREMENT HLSDem_facEngSpdLimGov "Weighing factor for Engine speed limitation for governor from different temperatures." SWORD Fact 1 100 -4.000000 3.999878 FORMAT "%8.6" ECU_ADDRESS 0x600133DC /end MEASUREMENT
/begin MEASUREMENT HLSDem_flgRceModActv "Flag to indicate race mode related drivability parameters are active" UBYTE B_TRUE 1 100 0.00 1.00000000000 BIT_MASK 0x1 FORMAT "%13.11" ECU_ADDRESS 0x6000F0F9 /end MEASUREMENT
/begin MEASUREMENT HLSDem_flgSpdClthGearAccrSigErr "Bit, if sensor fault of spd, clth, gear, accr is detected" UBYTE B_TRUE 1 100 0.00 1.00000000000 BIT_MASK 0x1 FORMAT "%13.11" ECU_ADDRESS 0x6000AFC2 /end MEASUREMENT
/begin MEASUREMENT HLSDem_flgSptModActv "Flag to indicate sport mode related drivability parameters are active" UBYTE B_TRUE 1 100 0.00 1.00000000000 BIT_MASK 0x1 FORMAT "%13.11" ECU_ADDRESS 0x6000F0F8 /end MEASUREMENT
/begin MEASUREMENT HLSDem_KnCtlTONVNM_I.time "Delay for knock control error limitation / Delay Time" UBYTE t_q0p1 1 100 0.00 25.50 FORMAT "%5.2" ECU_ADDRESS 0x600140C3 /end MEASUREMENT
/begin MEASUREMENT HLSDem_KnCtl_NRamp_I.nRampMem "Ramp for knock control error limitation / Temporary variable of ramp for engine speed limitation in drive off" SLONG EngN 1 100 -1073741824.00 1073741823.50 FORMAT "%13.2" ECU_ADDRESS 0x6000273C /end MEASUREMENT
/begin MEASUREMENT HLSDem_nDrvOffSuprtAbsltSp "Unfiltered Low idle setpoint for drive-off support when HLSDem_swtDrvOffSuprtSpMod_C == 1" SWORD nmot_sw_q0p5 1 100 -16384.00 16383.50 FORMAT "%8.2" ECU_ADDRESS 0x60006C10 /end MEASUREMENT
/begin MEASUREMENT HLSDem_nDrvOffSuprtBascSpLo "Basic low idle speed for drive-off support (used when HLSDem_swtDrvOffSuprtSpMod_C == 0)" SWORD nmot_sw_q0p5 1 100 -16384.00 16383.50 FORMAT "%8.2" ECU_ADDRESS 0x60006C0E /end MEASUREMENT
/begin MEASUREMENT HLSDem_nDrvOffSuprtOffs "Offset engine speed for drive-off support (used when HLSDem_swtDrvOffSuprtSpMod_C == 0)" SWORD nmot_sw_q0p5 1 100 -16384.00 16383.50 FORMAT "%8.2" ECU_ADDRESS 0x60006C0C /end MEASUREMENT
/begin MEASUREMENT HLSDem_nDrvOffSuprtSp "Low idle setpoint demand from drive-off support" SWORD nmot_sw_q0p5 1 100 -16384.00 16383.50 FORMAT "%8.2" ECU_ADDRESS 0x600090A4 /end MEASUREMENT
/begin MEASUREMENT HLSDem_nDrvOffSuprtSpIncr "Drvoff support setpoint" SWORD nmot_sw_q0p5 1 100 -16384.00 16383.50 FORMAT "%8.2" ECU_ADDRESS 0x600090A2 /end MEASUREMENT
/begin MEASUREMENT HLSDem_nDrvOffSuprtSpRaw "Unfiltered low idle setpoint for drive-off support" SWORD nmot_sw_q0p5 1 100 -16384.00 16383.50 FORMAT "%8.2" ECU_ADDRESS 0x60006C0A /end MEASUREMENT
/begin MEASUREMENT HLSDem_nKnCtlLim "Max engine speed allowed due to active safety ignition retardation active" SWORD EngN 1 100 -16384.00 16383.50 FORMAT "%8.2" ECU_ADDRESS 0x60006C02 /end MEASUREMENT
/begin MEASUREMENT HLSDem_nMax "Desired engine speed for rpm control" SWORD EngN 1 100 -16384.00 16383.50 FORMAT "%8.2" ECU_ADDRESS 0x60013F76 /end MEASUREMENT
/begin MEASUREMENT HLSDem_nMaxAVSLimGov_mp "Engine speed limitation including AVS" SWORD EngN 1 100 -16384.00 16383.50 FORMAT "%8.2" ECU_ADDRESS 0x7000A264 /end MEASUREMENT
/begin MEASUREMENT HLSDem_nMaxBDELimGov_mp "Engine speed limitation including BDE limitation." SWORD EngN 1 100 -16384.00 16383.50 FORMAT "%8.2" ECU_ADDRESS 0x7000A262 /end MEASUREMENT
/begin MEASUREMENT HLSDem_nMaxBefLim "Maximum permissible engine speed before limitations." SWORD EngN 1 100 -16384.00 16383.50 FORMAT "%8.2" ECU_ADDRESS 0x60006C00 /end MEASUREMENT
/begin MEASUREMENT HLSDem_nMaxChaElgLimGov_mp "Engine speed limitation including ChaElg limitation." SWORD EngN 1 100 -16384.00 16383.50 FORMAT "%8.2" ECU_ADDRESS 0x7000A260 /end MEASUREMENT
/begin MEASUREMENT HLSDem_nMaxEng "Max. allowed engine speed, filtering allowed" SWORD EngN 1 100 -16384.00 16383.50 FORMAT "%8.2" ECU_ADDRESS 0x6000883C /end MEASUREMENT
/begin MEASUREMENT HLSDem_nMaxEngFlt "Max. allowed engine speed, filtering allowed" SWORD EngN 1 100 -16384.00 16383.50 FORMAT "%8.2" ECU_ADDRESS 0x60013F78 /end MEASUREMENT
/begin MEASUREMENT HLSDem_nMaxEngFltGov "Max. allowed engine speed, filtering allowed , for governor" SWORD EngN 1 100 -16384.00 16383.50 FORMAT "%8.2" ECU_ADDRESS 0x60013F7A /end MEASUREMENT
/begin MEASUREMENT HLSDem_nMaxEngUnFlt "Max. allowed engine speed, filtering not allowed" SWORD EngN 1 100 -16384.00 16383.50 FORMAT "%8.2" ECU_ADDRESS 0x60013F7C /end MEASUREMENT
/begin MEASUREMENT HLSDem_nMaxEngWoHalt "Engine speed limitation without standstill limitation" SWORD EngN 1 100 -16384.00 16383.50 FORMAT "%8.2" ECU_ADDRESS 0x6000883A /end MEASUREMENT
/begin MEASUREMENT HLSDem_nMaxEngWoHaltGov "Engine speed limitation without standstill limitation for governor" SWORD EngN 1 100 -16384.00 16383.50 FORMAT "%8.2" ECU_ADDRESS 0x60013F7E /end MEASUREMENT
/begin MEASUREMENT HLSDem_nMaxErr1Lim "Engine speed limitation including Error 1 limitation" SWORD EngN 1 100 -16384.00 16383.50 FORMAT "%8.2" ECU_ADDRESS 0x60006BFE /end MEASUREMENT
/begin MEASUREMENT HLSDem_nMaxErr2Lim "Engine speed limitation including Error 2 limitation" SWORD EngN 1 100 -16384.00 16383.50 FORMAT "%8.2" ECU_ADDRESS 0x60006BFC /end MEASUREMENT
/begin MEASUREMENT HLSDem_nMaxErrLimGov_mp "Engine speed limitation including Error limitation." SWORD EngN 1 100 -16384.00 16383.50 FORMAT "%8.2" ECU_ADDRESS 0x7000A25E /end MEASUREMENT
/begin MEASUREMENT HLSDem_nMaxHiStd "Engine speed limitation during normal conditions" SWORD EngN 1 100 -16384.00 16383.50 FORMAT "%8.2" ECU_ADDRESS 0x60013F80 /end MEASUREMENT
/begin MEASUREMENT HLSDem_nMaxHi_mp "Increased engine speed limit" SWORD EngN 1 100 -16384.00 16383.50 FORMAT "%8.2" ECU_ADDRESS 0x7000A25C /end MEASUREMENT
/begin MEASUREMENT HLSDem_nMaxKnCtlLimGov_mp "Engine speed limitation including Knock control limitation." SWORD EngN 1 100 -16384.00 16383.50 FORMAT "%8.2" ECU_ADDRESS 0x7000A25A /end MEASUREMENT
/begin MEASUREMENT HLSDem_nMaxStd_mp "Stationary engine speed limit" SWORD EngN 1 100 -16384.00 16383.50 FORMAT "%8.2" ECU_ADDRESS 0x7000A258 /end MEASUREMENT
/begin MEASUREMENT HLSDem_nMaxT "Engine speed limit based on oil and engine temperature." SWORD EngN 1 100 -16384.00 16383.50 FORMAT "%8.2" ECU_ADDRESS 0x600133DE /end MEASUREMENT
/begin MEASUREMENT HLSDem_nOffsDrvOffSpIncKissPnt "Kisspoint setpoint for drvoff" SWORD nmot_sw_q0p5 1 100 -16384.00 16383.50 FORMAT "%8.2" ECU_ADDRESS 0x60009096 /end MEASUREMENT
/begin MEASUREMENT HLSDem_nOffsSpIncrCreep "creep offset for drvoff" SWORD nmot_sw_q0p5 1 100 -16384.00 16383.50 FORMAT "%8.2" ECU_ADDRESS 0x60009094 /end MEASUREMENT
/begin MEASUREMENT HLSDem_nOvhtEngNLim "Engine speed limitation due to high temperatures" SWORD EngN 1 100 -16384.00 16383.50 FORMAT "%8.2" ECU_ADDRESS 0x60013F82 /end MEASUREMENT
/begin MEASUREMENT HLSDem_nOvhtEngNLimGov "Engine speed limitation due to high temperatures for governor." SWORD EngN 1 100 -16384.00 16383.50 FORMAT "%8.2" ECU_ADDRESS 0x60013F84 /end MEASUREMENT
/begin MEASUREMENT HLSDem_pMstCylBrk "Master cylinder Pressure (with low resolution)" SWORD p_ub_q10 1 100 -327680.0 327670.0 FORMAT "%8.1" ECU_ADDRESS 0x60006C08 /end MEASUREMENT
/begin MEASUREMENT HLSDem_rClthKisspntDiff "Deviation of the analog clutch signal from modified kiss point" SWORD Prc_Fact256 1 100 -128.0000 127.9961 FORMAT "%8.4" ECU_ADDRESS 0x60009090 /end MEASUREMENT
/begin MEASUREMENT HLSDem_rGearDrvOff "Unfiltered ratio of gearbox input shaft speed and engine speed to estimate the clutch slip" SWORD Fact_10000 1 100 -3.276800 3.276700 FORMAT "%8.6" ECU_ADDRESS 0x6000908E /end MEASUREMENT
/begin MEASUREMENT HLSDem_rGearDrvOffFlt "Filtered ratio of gearbox input shaft speed and engine speed to estimate the clutch slip" SWORD Fact_10000 1 100 -3.276800 3.276700 FORMAT "%8.6" ECU_ADDRESS 0x6000908C /end MEASUREMENT
/begin MEASUREMENT HLSDem_stAvusWarn "Decides the speed limit be to displayed as 6000rpm or 4000 rpm or 2500rpm." UBYTE OneToOne 1 100 0.00 255.0 FORMAT "%5.1" ECU_ADDRESS 0x6001413A /end MEASUREMENT
/begin MEASUREMENT HLSDem_stDrvOffMT "offset activation for drive off support with manual transmission" UWORD OneToOne 1 100 0.00 255.0000 FORMAT "%8.4" ECU_ADDRESS 0x60008C02 /end MEASUREMENT
/begin MEASUREMENT HLSDem_stDrvOffSpIncrCVT "status of driveoff activation-CVT" UBYTE B_TRUE 1 100 0.00 1.00000000000 BIT_MASK 0x1 FORMAT "%13.11" ECU_ADDRESS 0x6000F0F7 /end MEASUREMENT
/begin MEASUREMENT HLSDem_stDrvOffSpIncrKissPnt "status of driveoff activation-Kisspoint" UBYTE B_TRUE 1 100 0.00 1.00000000000 BIT_MASK 0x1 FORMAT "%13.11" ECU_ADDRESS 0x6000F0F6 /end MEASUREMENT
/begin MEASUREMENT HLSDem_stDrvOffSpIncrMT "status of driveoff activation-MT" UBYTE B_TRUE 1 100 0.00 1.00000000000 BIT_MASK 0x1 FORMAT "%13.11" ECU_ADDRESS 0x6000F0F5 /end MEASUREMENT
/begin MEASUREMENT HLSDem_stDrvOffSuprtDiCdn "Bit coded status message for all disabling conditions for drive-off support" UWORD OneToOne 1 100 0.00 65535.00 FORMAT "%8.2" ECU_ADDRESS 0x60006C06 /end MEASUREMENT
/begin MEASUREMENT HLSDem_stDrvOffSuprtEnaCdn "Bit coded status message for all activation conditions for drive-off support" UWORD OneToOne 1 100 0.00 65535.00 FORMAT "%8.2" ECU_ADDRESS 0x60006C04 /end MEASUREMENT
/begin MEASUREMENT HLSDem_stDrvOffSuprtSpFilTyp "Number of filtration method for requested engine speed setpoint for drive-off-support in setpoint coordination" UBYTE OneToOne 1 100 0.00 255.0 FORMAT "%5.1" ECU_ADDRESS 0x6000F41B /end MEASUREMENT
/begin MEASUREMENT HLSDem_stDrvOffSuprtSpIncr "status of the drive off activation condition (MT OR CVT)" UBYTE B_TRUE 1 100 0.00 1.00000000000 BIT_MASK 0x1 FORMAT "%13.11" ECU_ADDRESS 0x6000F0F4 /end MEASUREMENT
/begin MEASUREMENT HLSDem_stEngOperModSeln "Satus to select drivability mode for parameter" UBYTE OneToOne 1 100 0.00 255.0 FORMAT "%5.1" ECU_ADDRESS 0x6000AFC6 /end MEASUREMENT
/begin MEASUREMENT HLSDem_stNLimEng "Status Engine speed limitation active by different sources" ULONG OneToOne 1 100 0.00 4294967295.00 FORMAT "%13.2" ECU_ADDRESS 0x60003758 /end MEASUREMENT
/begin MEASUREMENT HLSDem_stNMaxDeacStand "Status of deactivation conditions for reduced engine speed limit during standstill" UBYTE OneToOne 1 100 0.00 255.0 FORMAT "%5.1" ECU_ADDRESS 0x6000AFC1 /end MEASUREMENT
/begin MEASUREMENT HLSDem_stSIncrCondCVT "local variable for Idle speed increase (CVT)" UBYTE B_TRUE 1 100 0.00 1.00000000000 BIT_MASK 0x1 FORMAT "%13.11" ECU_ADDRESS 0x6000AFC5 /end MEASUREMENT
/begin MEASUREMENT HLSDem_stSIncrCondMT "local variable for Idle speed increase (MT)" UBYTE B_TRUE 1 100 0.00 1.00000000000 BIT_MASK 0x1 FORMAT "%13.11" ECU_ADDRESS 0x6000AFC4 /end MEASUREMENT
/begin MEASUREMENT HLSDem_tAir_mp "temperature selected from temperature field" SWORD Temp_Cels 1 100 -3549.940 3003.560 FORMAT "%8.3" ECU_ADDRESS 0x7000A256 /end MEASUREMENT
/begin MEASUREMENT HLSDem_tOil "Oil temperature" SWORD Temp_Cels 1 100 -3549.940 3003.560 FORMAT "%8.3" ECU_ADDRESS 0x60013F8C /end MEASUREMENT
/begin MEASUREMENT HLSDem_tOilHys "Stable Oil temperature after hysteresis." SWORD Temp_Cels 1 100 -3549.940 3003.560 FORMAT "%8.3" ECU_ADDRESS 0x600133E0 /end MEASUREMENT
/begin MEASUREMENT HLSDem_tOilUp "Upper limit of Oil temperature hysteresis" SWORD Temp_Cels 1 100 -3549.940 3003.560 FORMAT "%8.3" ECU_ADDRESS 0x600133E2 /end MEASUREMENT
/begin FUNCTION HEGO_OBDElec "1.54.0    Electrical diagnostics for binary oxygen sensors"
 /begin DEF_CHARACTERISTIC HEGO_duErrElecMinLdPls_C HEGO_duErrElecSigLdPls_C HEGO_flgDiDesLamChk_CW HEGO_flgEnaElecMaxNplColdSnsr_CW HEGO_flgPmpO2Ref_C HEGO_flgSnsrOperRdnOverRi_CW HEGO_numMinVoltMeasmtElecMax_C HEGO_numRiOkOpRdn_C HEGO_OBDElecS2B1_I.stDElec_CW HEGO_OpRdnS2B1_I.flgHtgSuff_CW HEGO_OpRdnS2B1_I.stOpRdn_CW HEGO_OpRdnS2B1_I.tCerMdlThdExptOpRdn_C HEGO_OpRdnS2B1_I.tiDebErrStk_C HEGO_OpRdnS2B1_I.tiDebExptOpRdn_CUR HEGO_OpRdnS2B1_I.tiDebPrtHtgFin_C HEGO_resErrElecSigRi_C HEGO_resRiOpRdn_C HEGO_resRstErrElecSigRi_C HEGO_SnsrTMdlS2B1_I.facHeatgPwrCnvnT_C HEGO_SnsrTMdlS2B1_I.facTHeatFlowEgWall_C HEGO_SnsrTMdlS2B1_I.facTHeatFlowEg_T HEGO_SnsrTMdlS2B1_I.facTHeatFlowEng_C HEGO_SnsrTMdlS2B1_I.facTHeatFlowIntkAir_C HEGO_SnsrTMdlS2B1_I.rHeatr_T HEGO_SnsrTMdlS2B1_I.rLossHeatrPS_C HEGO_stDElec_CW HEGO_tEGErrElecSigRi_C HEGO_tiDebErrElecMax_C HEGO_tiDebErrElecMinSus_C HEGO_tiDebErrElecMin_C HEGO_tiDebErrElecSigSus_C HEGO_tiDebGenDElec_C HEGO_tiDebRstErrStkCVB_C HEGO_tiDelLdPlsMin_C HEGO_tiDelLdPlsSig_C HEGO_uBattMinDElec_C HEGO_uErrElecMaxColdSnsr_C HEGO_uErrElecMaxNormOper_C HEGO_uErrElecMinORRLow_C HEGO_uErrElecMin_C HEGO_uS23LeanOpRdn_C HEGO_uS23RichOpRdn_C /end DEF_CHARACTERISTIC
 /begin REF_CHARACTERISTIC HEGO_flgReIniSnsrTMdl_C HEGO_resRiMaxPlaus_C HEGO_flgS2B1Prsnt_C /end REF_CHARACTERISTIC
 /begin IN_MEASUREMENT BattU_u B_bevab_msg B_sa_msg Eep_EnvRamInvld EngStrt_bStrtEnd ExhMod_tExhS2B1 ExhMod_tWallS2B1 HEGO_bS2B1HtgPrtFin HEGO_bS2B1HtgSuff HEGO_bS2B1LdPlsRslt HEGO_bS2B1NewRi HEGO_bS2B1VldRi HEGO_flgNumVoltMeasmtElecMaxSuffS2B1 HEGO_numCalcRiS2B1 HEGO_resS2B1Ri HEGO_resS2B1RiCorrd HEGO_rS2B1HtgLim HEGO_tS2B1CerAct HEGO_uS2B1Extd HEGO_uS2B1LdPls HEGO_uVoltMeasmtFildElecMaxS2B1 lamsons_w_msg SyC_ctPostDrvLeave SyC_stSub TWCC_bEnaRichPurgB1 /end IN_MEASUREMENT
 /begin OUT_MEASUREMENT HEGO_bS2B1EnaDElec HEGO_bS2B1ErrElecHtrCpl HEGO_bS2B1ErrElecMinWoDeb HEGO_bS2B1ErrElecSig HEGO_bS2B1ErrElecSigPrev HEGO_bS2B1ErrElecSigRi HEGO_bS2B1ExptOpRdn HEGO_bS2B1InVldErr HEGO_bS2B1LdPlsMinReq HEGO_bS2B1LdPlsSigCnfReq HEGO_bS2B1LdPlsSigReq HEGO_bS2B1OpRdnRiReq HEGO_bS2B1Vld HEGO_flgLamEnaElecMaxS2B1 HEGO_flgVldTstrS2B1 /end OUT_MEASUREMENT
 /begin LOC_MEASUREMENT HEGO_bEnaDElecPhy HEGO_flgDrvDSMTripChgFinshdOBDElec HEGO_flgFCMClrReqdOBDElec100msS2 HEGO_flgFCMClrReqdOBDElec10msS2 HEGO_OBDElecS2B1_I.bErrElecMinWoDeb HEGO_OBDElecS2B1_I.bErrElecSig HEGO_OBDElecS2B1_I.bErrElecSus HEGO_OBDElecS2B1_I.bErrHtrCpl HEGO_OBDElecS2B1_I.bFCMClrReqdCL100ms HEGO_OBDElecS2B1_I.bNoErrElecMinSus HEGO_OBDElecS2B1_I.ctReset100ms HEGO_OBDElecS2B1_I.flgDiagElecMax HEGO_OBDElecS2B1_I.flgDiagElecMaxUHi HEGO_OBDElecS2B1_I.flgDiagElecMin HEGO_OBDElecS2B1_I.flgErrElecMax HEGO_OBDElecS2B1_I.flgLamEnaElecMax HEGO_OBDElecS2B1_I.flgNumvoltMeasmtElecMaxSuff HEGO_OBDElecS2B1_I.DebDiagElecMaxTONV_I.outbit HEGO_OBDElecS2B1_I.DebDiagElecMaxTONV_I.time HEGO_OBDElecS2B1_I.DebDiagElecMinTONV_I.outbit HEGO_OBDElecS2B1_I.DebDiagElecMinTONV_I.time HEGO_OBDElecS2B1_I.DebErrElecMaxTONV_I.outbit HEGO_OBDElecS2B1_I.DebErrElecMaxTONV_I.time HEGO_OBDElecS2B1_I.DebErrElecMinSusTONV_I.outbit HEGO_OBDElecS2B1_I.DebErrElecMinSusTONV_I.time HEGO_OBDElecS2B1_I.DebErrElecMinTONV_I.outbit HEGO_OBDElecS2B1_I.DebErrElecMinTONV_I.time HEGO_OBDElecS2B1_I.DebErrElecSigSusTONV_I.outbit HEGO_OBDElecS2B1_I.DebErrElecSigSusTONV_I.time HEGO_OBDElecS2B1_I.DebRstErrElecMinTONV_I.outbit HEGO_OBDElecS2B1_I.DebRstErrElecMinTONV_I.time HEGO_OBDElecS2B1_I.ErrElecMaxFF_I.status HEGO_OBDElecS2B1_I.ErrElecMinFF_I.status HEGO_OBDElecS2B1_I.ErrElecSigRiFF_I.status HEGO_OBDElecS2B1_I.Min_I.bErrMinLdPls HEGO_OBDElecS2B1_I.Min_I.bLdPlsMinReq HEGO_OBDElecS2B1_I.Min_I.flgMinDiagEnad HEGO_OBDElecS2B1_I.Min_I.sm HEGO_OBDElecS2B1_I.Min_I.DelLdPlsMinTR_I.timeCounter HEGO_OBDElecS2B1_I.Sig_I.bErrSigLdPls HEGO_OBDElecS2B1_I.Sig_I.bErrSigSusLdPls HEGO_OBDElecS2B1_I.Sig_I.bLdPlsSigCnfExe HEGO_OBDElecS2B1_I.Sig_I.bLdPlsSigCnfReq HEGO_OBDElecS2B1_I.Sig_I.bLdPlsSigExe HEGO_OBDElecS2B1_I.Sig_I.bLdPlsSigReq HEGO_OBDElecS2B1_I.Sig_I.sm HEGO_OBDElecS2B1_I.Sig_I.DelLdPlsSigTR_I.timeCounter HEGO_OpRdnS2B1_I.bEna HEGO_OpRdnS2B1_I.bEnaDElec HEGO_OpRdnS2B1_I.bEnaOpRdnSens HEGO_OpRdnS2B1_I.bEnaSigChkd HEGO_OpRdnS2B1_I.bErrSigPrev HEGO_OpRdnS2B1_I.bExptOpRdn HEGO_OpRdnS2B1_I.bFCMClrReqdCL100ms HEGO_OpRdnS2B1_I.bHEGOInVldErr HEGO_OpRdnS2B1_I.bHtgOk HEGO_OpRdnS2B1_I.bOpRdnRiReq HEGO_OpRdnS2B1_I.bRiOkOpRdn HEGO_OpRdnS2B1_I.bSVld HEGO_OpRdnS2B1_I.bStkCVB HEGO_OpRdnS2B1_I.flgTCerMdlOk HEGO_OpRdnS2B1_I.numCalcRiOpRdn HEGO_OpRdnS2B1_I.tEGOpRdn HEGO_OpRdnS2B1_I.DebErrStkTONV_I.outbit HEGO_OpRdnS2B1_I.DebErrStkTONV_I.time HEGO_OpRdnS2B1_I.DebExptOpRdnTONV_I.outbit HEGO_OpRdnS2B1_I.DebExptOpRdnTONV_I.time HEGO_OpRdnS2B1_I.DebPrtHtgFinTONV_I.outbit HEGO_OpRdnS2B1_I.DebPrtHtgFinTONV_I.time HEGO_OpRdnS2B1_I.DebSVldTONV_I.outbit HEGO_OpRdnS2B1_I.DebSVldTONV_I.time HEGO_OpRdnS2B1_I.EnaOpRdnHtgFF_I.status HEGO_OpRdnS2B1_I.OpRdnMemFF_I.status HEGO_OpRdnS2B1_I.SVldFF_I.status HEGO_OpRdnS2B1_I.StkCVBSusFF_I.status HEGO_OpRdnS2B1_I.numRiOkCTR_I.counter HEGO_SnsrTMdlS2B1_I.ctReset100ms HEGO_SnsrTMdlS2B1_I.dtMdlEg HEGO_SnsrTMdlS2B1_I.dtMdlEgWall HEGO_SnsrTMdlS2B1_I.dtMdlEng HEGO_SnsrTMdlS2B1_I.dtMdlIntkAir HEGO_SnsrTMdlS2B1_I.flgReset HEGO_SnsrTMdlS2B1_I.iPHeatr HEGO_SnsrTMdlS2B1_I.pwrMdlEg HEGO_SnsrTMdlS2B1_I.pwrMdlEgWall HEGO_SnsrTMdlS2B1_I.pwrMdlEng HEGO_SnsrTMdlS2B1_I.pwrMdlHeatr HEGO_SnsrTMdlS2B1_I.pwrMdlIntAir HEGO_SnsrTMdlS2B1_I.rHeatr HEGO_SnsrTMdlS2B1_I.tCerMdl HEGO_SnsrTMdlS2B1_I.tCerMdlWpDisp /end LOC_MEASUREMENT
 FUNCTION_VERSION "1.54.0" /end FUNCTION
/begin FUNCTION HEGO_OBDHtg "1.35.0    Heating performance diagnostics for binary oxygen sensors"
 /begin DEF_CHARACTERISTIC HEGO_flgDebDHtgAftStop_CW HEGO_OBDHtgS2B1_I.resRiThresDHtgLoTemp_MAP HEGO_OBDHtgS2B1_I.resRiThresDHtg_MAP HEGO_OBDHtgS2B1_I.stDHtg_CW HEGO_resRiHystDHtg_C HEGO_resRiMaxHtgSuff_C HEGO_stS2DHtg_CW HEGO_tEGDHtgMax_C HEGO_tEGDHtgMin_C HEGO_tEGDHtgShrtTrpMax_C HEGO_tEGDHtgShrtTrpMin_C HEGO_tEGFltMin_C HEGO_tiDebDHtgFuncReq_C HEGO_tiDebDHtgStop_C HEGO_tiDebDHtgStrt_C HEGO_tiDebDPERiThresDHtg_C HEGO_tiDebEnaDHtgCtlExt_C HEGO_tiDebErrHtgFIDRls_C HEGO_tiDebErrHtg_C HEGO_tiDebHealHtgErr_C HEGO_tiDebHealHtg_C HEGO_tiDebStrtEndDHtg_C HEGO_tiEngStopDHtgMin_C HEGO_tiFltPwrHtg_C HEGO_tiFltTempEG_CUR HEGO_tIntkAirDHtgMin_C HEGO_uBattDHeatgMax_C HEGO_uBattDHeatgMin_C /end DEF_CHARACTERISTIC
 /begin REF_CHARACTERISTIC HEGO_flgS2B1Prsnt_C /end REF_CHARACTERISTIC
 /begin IN_MEASUREMENT BattU_u B_sa_msg Eep_EnvRamInvld EngStrt_bStrtEnd ExhMod_flgDewPntEndS2B1 ExhMod_flgTSnsrStrtCalcdB1 ExhMod_mfExhCat1B1 ExhMod_tExhS2B1 HEGO_bS2B1ErrElecSigRi HEGO_bS2B1ExptOpRdn HEGO_bS2B1VldRi HEGO_pwrS2B1Htg HEGO_resS2B1RiCorrdFild SyC_ctPostDrvLeave SyC_stSub tans_msg TiEngOff_stTiFirstStrt TiEngOff_tiFirstStrt /end IN_MEASUREMENT
 /begin OUT_MEASUREMENT HEGO_bEnaDPs HEGO_bS2B1EnaDHtg HEGO_bS2B1HtgSuffRi HEGO_dresS2B1RiThresMin HEGO_resS2B1RiThres HEGO_tS2B1EGFltDHtg /end OUT_MEASUREMENT
 /begin LOC_MEASUREMENT HEGO_bDHtgTempIntkAirOk HEGO_bDHtgTiEngStopOk HEGO_bEnaDHtgAftStop HEGO_bFCMClrS2B1OBDHtg HEGO_DebDHtgAftStopFF_I.status HEGO_DebDHtgGenFuncReqTONV_I.outbit HEGO_DebDHtgGenFuncReqTONV_I.time HEGO_DebDHtgStopEF_I.buffer HEGO_DebDHtgStopEF_I.oldSignal HEGO_DebDHtgStopTOFFV_I.outbit HEGO_DebDHtgStopTOFFV_I.time HEGO_DebDHtgStrtER_I.buffer HEGO_DebDHtgStrtER_I.oldSignal HEGO_DebDHtgStrtTONV_I.outbit HEGO_DebDHtgStrtTONV_I.time HEGO_DHtgEGTMStrtB1ER_I.buffer HEGO_DHtgEGTMStrtB1ER_I.oldSignal HEGO_dresS2B1RiThresMinNV HEGO_flgDrvDsmTripChgdOBDHtg HEGO_flgEnvtlCond HEGO_flgFCMClrReqdOBDHtg HEGO_OBDHtgS2B1_I.bEnaDHtg HEGO_OBDHtgS2B1_I.bEnaDHtgFCMClrEngRun HEGO_OBDHtgS2B1_I.bErrHtg HEGO_OBDHtgS2B1_I.bHealHtg HEGO_OBDHtgS2B1_I.bHtgSuffRi HEGO_OBDHtgS2B1_I.bRiImPlausHi HEGO_OBDHtgS2B1_I.bRlsDHtg HEGO_OBDHtgS2B1_I.pwrHtgFlt HEGO_OBDHtgS2B1_I.resRiThresDHtg HEGO_OBDHtgS2B1_I.tEGFlt HEGO_OBDHtgS2B1_I.DHtgGenFuncReqFF_I.status HEGO_OBDHtgS2B1_I.DebDPERiThresDHtgTONV_I.outbit HEGO_OBDHtgS2B1_I.DebDPERiThresDHtgTONV_I.time HEGO_OBDHtgS2B1_I.DebEnaDHtgCtlExtTONV_I.outbit HEGO_OBDHtgS2B1_I.DebEnaDHtgCtlExtTONV_I.time HEGO_OBDHtgS2B1_I.DebErrHtgFIDRlsTONV_I.outbit HEGO_OBDHtgS2B1_I.DebErrHtgFIDRlsTONV_I.time HEGO_OBDHtgS2B1_I.DebErrHtgIUMPRTONV_I.outbit HEGO_OBDHtgS2B1_I.DebErrHtgIUMPRTONV_I.time HEGO_OBDHtgS2B1_I.DebHealHtgTONV_I.outbit HEGO_OBDHtgS2B1_I.DebHealHtgTONV_I.time HEGO_OBDHtgS2B1_I.DebStrtEndDHtgTONV_I.outbit HEGO_OBDHtgS2B1_I.DebStrtEndDHtgTONV_I.time HEGO_OBDHtgS2B1_I.PwrHtgLPT_I.memory HEGO_OBDHtgS2B1_I.TempEGLPT_I.memory HEGO_OBDHtgS2B1_I.flgDebErrHtgTONV_I.outbit HEGO_OBDHtgS2B1_I.flgDebErrHtgTONV_I.time HEGO_OBDHtg_ctReIni /end LOC_MEASUREMENT
 FUNCTION_VERSION "1.35.0" /end FUNCTION
/begin FUNCTION HEGO_OBDHtrPs "1.30.0    Heater power stage diagnosis binary oxygen sensors"
 /begin DEF_CHARACTERISTIC HEGO_nrTstPls_C HEGO_OBDHtrPsS2B1_I.tiDebDHtrPsEnaFst_C HEGO_OBDHtrPsS2B1_I.tiDebDHtrPsEna_C HEGO_OBDHtrPsS2B1_I.uBattMaxDHtrPs_C HEGO_stHeatrPSDiagDeactvn_C HEGO_stS2Ps_CW HEGO_tAmbMinDHtrPs_C HEGO_tiBtwElecFlt_C HEGO_tiBtwOTFlt_C HEGO_tiDebTAmbHtrPs_C HEGO_uBattMinDHtrPs_C /end DEF_CHARACTERISTIC
 /begin REF_CHARACTERISTIC HEGO_flgS2B1Prsnt_C /end REF_CHARACTERISTIC
 /begin IN_MEASUREMENT BattU_u DevLib_stPwrStgEnaCond EnvT_t HEGO_bS2B1HtgEna HEGO_bS2B1HtgStrt SyC_stSub T15_st /end IN_MEASUREMENT
 /begin LOC_MEASUREMENT HEGO_DebTAmbHtrPsTONV_I.outbit HEGO_DebTAmbHtrPsTONV_I.time HEGO_flgDrvDsmEntryDIntPs HEGO_flgEnaDWeakPsCmn HEGO_flgPwrStgEnaCond HEGO_OBDHtrPsS2B1_I.bDHtrPsEna HEGO_OBDHtrPsS2B1_I.bFCMClrReqdCL100ms HEGO_OBDHtrPsS2B1_I.stErrInfo HEGO_OBDHtrPsS2B1_I.DHtrPsEnaTONV_I.outbit HEGO_OBDHtrPsS2B1_I.DHtrPsEnaTONV_I.time HEGO_OBDHtrPsS2B1_I.DebDHtrPsEnaFstTONV_I.outbit HEGO_OBDHtrPsS2B1_I.DebDHtrPsEnaFstTONV_I.time /end LOC_MEASUREMENT
 FUNCTION_VERSION "1.30.0" /end FUNCTION
/begin FUNCTION HEGO_Sens "1.53.1    Signal acquisition for binary oxygen sensors"
 /begin DEF_CHARACTERISTIC HEGO_stSens_CW HEGO_ctRiCalc_C HEGO_duRiAftFrz_C HEGO_duTCerChg_CUR HEGO_flgS2B1Prsnt_C HEGO_flgS2UTNom_CW HEGO_flgVltgBasSymc_C HEGO_flgVltgSymc_C HEGO_resRiNom_C HEGO_resRiTCer_CUR HEGO_resTCerRiMax_C HEGO_resTCerRiMin_C HEGO_rS2LamLinCNGHiRes_CUR HEGO_rS2LamLinHiRes_CUR HEGO_SensS2B1_I.facRiCorr_M HEGO_SensS2B1_I.tiDebEnaRiVltg_C HEGO_SensS2B1_I.uRiLoLim_C HEGO_SensS2B1_I.uRiOORLim_C HEGO_SensS2B1_I.uRiUpLim_C HEGO_stSensHw_CW HEGO_tCerRi_CUR HEGO_tiDelLdPls_C HEGO_tiDelOpRdnRiPls_C HEGO_tiDelRiPls_C HEGO_tiPolarRedPls_C HEGO_tiS2FrzSigRiAcqn_C HEGO_tiSmotngSymc_C HEGO_uS2InvLamLinCNGHiRes_CUR HEGO_uS2InvLamLinHiRes_CUR /end DEF_CHARACTERISTIC
 /begin REF_CHARACTERISTIC HEGO_numMinVoltMeasmtElecMax_C /end REF_CHARACTERISTIC
 /begin IN_MEASUREMENT EGSDU_flgS2B1AsymcFltEvln EGSDU_flgS2B1InhbRiEvln EGSDU_tiS2B1LtrDlySymcEvln EGSDU_tiS2B1LtrTranSymcEvln EGSDU_tiS2B1RtlDlySymcEvln EGSDU_tiS2B1RtlTranSymcEvln ExhMod_facIntrpnGslSecFu ExhMod_tExhS2B1 HEGO_bS2B1ErrElecHtrCpl HEGO_bS2B1ErrElecSigPrev HEGO_bS2B1ExptOpRdn HEGO_bS2B1HtgOn HEGO_bS2B1HtgRiReq HEGO_bS2B1LdPlsMinReq HEGO_bS2B1LdPlsSigCnfReq HEGO_bS2B1LdPlsSigReq HEGO_bS2B1OpRdnRiReq HEGO_flgLamEnaElecMaxS2B1 HEGO_flgS2B1InhbRiMeasmtElDiag SyC_ctPostDrvLeave /end IN_MEASUREMENT
 /begin OUT_MEASUREMENT HEGO_bS2B1FrzRi HEGO_bS2B1LdPlsRslt HEGO_bS2B1NewRi HEGO_bS2B1VldRi HEGO_flgNumVoltMeasmtElecMaxSuffS2B1 HEGO_numCalcRiS2B1 HEGO_numNewRiS2B1 HEGO_numTCerRiVldS2B1 HEGO_numVoltMeasmtElecMaxS2B1 HEGO_resS2B1Ri HEGO_resS2B1RiCorrd HEGO_resS2B1RiCorrdFild HEGO_resS2B1RiNoFlt HEGO_rS2B1Lam HEGO_rS2B1LamHiRes HEGO_tS2B1CerAct HEGO_tS2CerNom HEGO_uS2B1 HEGO_uS2B1Extd HEGO_uS2B1HiRes HEGO_uS2B1LamHiRes HEGO_uS2B1LdPls HEGO_uS2B1SymcHiRes HEGO_uS2B1Tstr HEGO_uS2B1WiH2HiRes HEGO_uS2B1WoDynSimHiRes HEGO_uVoltMeasmtFildElecMaxS2B1 /end OUT_MEASUREMENT
 /begin LOC_MEASUREMENT DelRiPlsT_I.timeCounter HEGO_bRiPlsReq HEGO_bS2B1RiPlsReq HEGO_facLamLinHiResS2 HEGO_flgExhS2B1AvlEF_I.buffer HEGO_flgExhS2B1AvlEF_I.oldSignal HEGO_flgFCMClrReqdSens_100ms HEGO_flgFCMClrReqdSens_10ms HEGO_idxSensRiPls HEGO_SensS2B1_ctReIni HEGO_SensS2B1_I.bCalcRi HEGO_SensS2B1_I.bDelOpRdnRiPls HEGO_SensS2B1_I.bEnaLdPls HEGO_SensS2B1_I.bEnaOpRdnRiPls HEGO_SensS2B1_I.bEnaRi HEGO_SensS2B1_I.bEnaRiFlt HEGO_SensS2B1_I.bEnaRiSens HEGO_SensS2B1_I.bFCMClrReqd100ms HEGO_SensS2B1_I.bFCMClrReqd1ms HEGO_SensS2B1_I.bFrzRi HEGO_SensS2B1_I.bFrzRiPrev HEGO_SensS2B1_I.bLdPlsEval HEGO_SensS2B1_I.bLdPlsFin HEGO_SensS2B1_I.bLdPlsRslt HEGO_SensS2B1_I.bNewRi HEGO_SensS2B1_I.bPlausRi HEGO_SensS2B1_I.bPolarRedPls HEGO_SensS2B1_I.bRiMeas HEGO_SensS2B1_I.bRiPls HEGO_SensS2B1_I.bRiTrg HEGO_SensS2B1_I.bVldRi HEGO_SensS2B1_I.ctLdPls HEGO_SensS2B1_I.flgCdnStMacTran02 HEGO_SensS2B1_I.flgCdnStMacTran12 HEGO_SensS2B1_I.flgInitVolt HEGO_SensS2B1_I.flgNewUSExtd HEGO_SensS2B1_I.flgNumVoltMeasmtElecMaxSuff HEGO_SensS2B1_I.numCalcRi HEGO_SensS2B1_I.numLdPlsMax HEGO_SensS2B1_I.numNewRi HEGO_SensS2B1_I.numVoltMeasmtElecMax HEGO_SensS2B1_I.resRi HEGO_SensS2B1_I.resRiCorrd HEGO_SensS2B1_I.resRiCorrdFild HEGO_SensS2B1_I.resRiCorrdPrev HEGO_SensS2B1_I.resRiNoFlt HEGO_SensS2B1_I.sm HEGO_SensS2B1_I.uLdPls HEGO_SensS2B1_I.uLdPlsDiff HEGO_SensS2B1_I.uRiAftFrz HEGO_SensS2B1_I.uRiWiLd HEGO_SensS2B1_I.uRiWoLd HEGO_SensS2B1_I.uSExtd HEGO_SensS2B1_I.uSExtdHeatrOff HEGO_SensS2B1_I.uVoltMeasmtFildElecMax HEGO_SensS2B1_I.DebEnaRiVltgTONV_I.outbit HEGO_SensS2B1_I.DebEnaRiVltgTONV_I.time HEGO_SensS2B1_I.DelLdPlsT_I.timeCounter HEGO_SensS2B1_I.DelOpRdnRiPlsT_I.timeCounter HEGO_SensS2B1_I.FrzRiT_I.timeCounter HEGO_SensS2B1_I.NewRiTR_I.timeCounter HEGO_SensS2B1_I.PolarRedPlsT_I.timeCounter HEGO_SensS2B1_I.RiCalcCTR_I.counter HEGO_SensS2B1_I.RiCorrdDL_I.memory HEGO_SensS2B1_I.RiDL_I.memory HEGO_SensS2B1_I.RiNoPlausCTR_I.counter HEGO_SensS2B1_I.RiPlsT_I.timeCounter HEGO_SensS2B1_I.bLdPlsSigCnfReqER_I.buffer HEGO_SensS2B1_I.bLdPlsSigCnfReqER_I.oldSignal HEGO_SensS2B1_I.bLdPlsSigReqER_I.buffer HEGO_SensS2B1_I.bLdPlsSigReqER_I.oldSignal HEGO_SensS2B1_I.flgHeatgOffTONV_I.outbit HEGO_SensS2B1_I.flgHeatgOffTONV_I.time HEGO_SensS2B1_I.uVoltMeasmtElecMaxDL_I.memory HEGO_SigCorS2B1_I.duDifT HEGO_SigCorS2B1_I.duSigCor HEGO_SigCorS2B1_I.numNewRiOld HEGO_SigCorS2B1_I.numTCerRiVld HEGO_SigCorS2B1_I.resRi HEGO_SigCorS2B1_I.resRiElec HEGO_SigCorS2B1_I.resRiWpDisp HEGO_SigCorS2B1_I.tCerAct HEGO_SigCorS2B1_I.tCerNom HEGO_SigCorS2B1_I.uNernst HEGO_SigCorS2B1_I.uNernstTCor HEGO_SigCorS2B1_I.uTNom HEGO_SigCorS2B1_I.uTNomCor HEGO_uLamHiResS2 HEGO_VltgSymcS2B1_I.flgLtrDly HEGO_VltgSymcS2B1_I.flgLtrSlow HEGO_VltgSymcS2B1_I.flgLtrTran HEGO_VltgSymcS2B1_I.flgRtlDly HEGO_VltgSymcS2B1_I.flgRtlSlow HEGO_VltgSymcS2B1_I.flgRtlTran HEGO_VltgSymcS2B1_I.flgSymcEna HEGO_VltgSymcS2B1_I.uSmotngOld HEGO_VltgSymcS2B1_I.uSymc HEGO_VltgSymcS2B1_I.uSymcTran HEGO_VltgSymcS2B1_I.flgSlowER_I.buffer HEGO_VltgSymcS2B1_I.flgSlowER_I.oldSignal HEGO_VltgSymcS2B1_I.flgSymcDlyEnaER_I.buffer HEGO_VltgSymcS2B1_I.flgSymcDlyEnaER_I.oldSignal HEGO_VltgSymcS2B1_I.flgSymcTranEnaER_I.buffer HEGO_VltgSymcS2B1_I.flgSymcTranEnaER_I.oldSignal HEGO_VltgSymcS2B1_I.uDlyDTTtOptSens_I.buffer HEGO_VltgSymcS2B1_I.uDlyDTTtOptSens_I.counter HEGO_VltgSymcS2B1_I.uDlyDTTtOptSens_I.pointer HEGO_VltgSymcS2B1_I.uSmotngLT_I.memory HEGO_VltgSymcS2B1_I.uTranLT_I.memory /end LOC_MEASUREMENT
 FUNCTION_VERSION "1.53.1" /end FUNCTION
/begin FUNCTION HESrv_Lib "7.3.0     High-End Service Library"
 /begin DEF_CHARACTERISTIC HESrv_numBnk_CA HESrv_stRmtInjVlv_CA HESrv_swtPOpVis_C HESrv_swtScndFlwActv_C /end DEF_CHARACTERISTIC
 FUNCTION_VERSION "7.3.0" /end FUNCTION
/begin FUNCTION HESrv_MacroDef "2.7.0     High-End Service Macro Definition" FUNCTION_VERSION "2.7.0" /end FUNCTION
/begin FUNCTION HESrv_MSid "9.2.0     High-End Master Slave Identification" /begin DEF_CHARACTERISTIC HESrv_swtMSidConf_C /end DEF_CHARACTERISTIC /begin OUT_MEASUREMENT HESrv_stMSid /end OUT_MEASUREMENT FUNCTION_VERSION "9.2.0" /end FUNCTION
/begin FUNCTION HESrv_RCVnsync "5.1.0     Copy process from redoubled messages to cylinderspezific calculation" FUNCTION_VERSION "5.1.0" /end FUNCTION
/begin FUNCTION HLSDem_DrvOffSuprt "1.9.0_1.7.0Detection of drive-off of the vehicle and request of an increased low idle setpoint to support the drive-off"
 /begin DEF_CHARACTERISTIC HLSDem_aLASMax_C HLSDem_aLASMin_C HLSDem_dpMstCylBrkRightHysDelta_C HLSDem_drClthHysMax_C HLSDem_drClthHysMin_C HLSDem_DrvOffSuprtMstCyldp_CUR HLSDem_DrvOffSuprtRampHiGrdtNegSlop_C HLSDem_DrvOffSuprtRampHiGrdtPosSlop_C HLSDem_DrvOffSuprtRampLoGrdtNegSlop_C HLSDem_DrvOffSuprtRampLoGrdtPosSlop_C HLSDem_DrvOffSuprtSpIncrNeg_C HLSDem_DrvOffSuprtSpIncrPos_C HLSDem_facDrvOffCouplRaceOffs_C HLSDem_facDrvOffCouplSprtOffs_C HLSDem_facDrvOffDeadZoneRaceOffs_C HLSDem_facDrvOffDeadZoneSprtOffs_C HLSDem_facDrvOffGearRat_CUR HLSDem_facDrvOffsLAS_CUR HLSDem_facDrvOffSuprtRaceOffs_C HLSDem_facDrvOffSuprtSprtOffs_C HLSDem_facOffsAppDeadZoneNorm_C HLSDem_facOffsCouplNorm_C HLSDem_facOffsDrvOffClthKisspnt_CUR HLSDem_facOffsDrvOffNorm_C HLSDem_facOffsDrvOffPhiCorr_CUR HLSDem_facOffsDrvOff_CUR HLSDem_facOffsEnvtlPCorrn_T HLSDem_facRvsGearCreepSp_C HLSDem_facRvsGearDrvOffSp_C HLSDem_facRvsGearKissPntSp_C HLSDem_facSpIncrKissPnt_T HLSDem_flgGearNeutralPosSelnMT_C HLSDem_flgSelBrkHldSysActvCdn_C HLSDem_nDrvOffSuprtAbsltSpMT_CUR HLSDem_nDrvOffSuprtAbsltSp_MAP HLSDem_nDrvOffSuprtOffs_CUR HLSDem_nDrvOffSuprtSpIncr_C HLSDem_nDrvOffSuprtSpIncr_M HLSDem_nDrvOffSuprtSpLimMax_C HLSDem_nMaxOffsSpIncr_C HLSDem_nOffsAppDeadZone_CUR HLSDem_nOffsCoupling_C HLSDem_nOffsDrvOff_C HLSDem_nOffsSpIncrCreep_C HLSDem_nOffsSpIncrCreep_T HLSDem_nOffsSpIncrKissPnt_M HLSDem_pMstCylBrkLeftHysDelta_C HLSDem_pMstCylBrkLeftHysMin_C HLSDem_rClthDrvAwyMax_C HLSDem_rClthDrvAwyMin_C HLSDem_rClthKisspntGain_C HLSDem_rClthKisspntOffset_C HLSDem_rClthMaxOffs1EnaThreshold_C HLSDem_rClthMaxOffs1Ena_C HLSDem_rDrvOffSuprtAThd_C HLSDem_rMaxClthPosSpIncr_C HLSDem_rMaxClthRatSpIncr_C HLSDem_rMaxDiDrvOff_C HLSDem_rMinClthPosSpIncr_C HLSDem_rMinClthRatSpIncr_C HLSDem_stClthPsd_C HLSDem_stDrvOffSuprtDiMaskAST_C HLSDem_stDrvOffSuprtDiMask_C HLSDem_stDrvOffSuprtDisbl_C HLSDem_stDrvOffSuprtEnaMaskAST_C HLSDem_stDrvOffSuprtEnaMask_C HLSDem_stEngOperModSeln_FT HLSDem_swtClthDetEna_C HLSDem_SwtDeactvDrvOffSuprtOffs_C HLSDem_swtDrvOffSuprtSpMod_C HLSDem_swtDrvOffSuprtSpSeln_C HLSDem_tiBrkHldSysActvTOFF_C HLSDem_tiDeadTimeFirstEngStrtPassd_C HLSDem_tiDlyDrvOffSuprtSpIncrCVT_C HLSDem_tiDlySpIncrMT_C HLSDem_tiDrvOffSuprtEnaThd_C HLSDem_tiGearRatDrvOffFlt_C HLSDem_uPedDeadZone_C HLSDem_vDrvOffSuprtVehVThd_C HLSDem_vDrvOffVehVHysMax_C HLSDem_vDrvOffVehVHysMin_C HLSDem_vMaxVehVelSpIncrCreep_C HLSDem_vMaxVehVelSpIncrCVT_C HLSDem_vMaxVehVelSpIncrMT_C HLSDem_vMinVehVelSpIncrCreep_C HLSDem_vMinVehVelSpIncrCVT_C HLSDem_vMinVehVelSpIncrMT_C /end DEF_CHARACTERISTIC
 /begin REF_CHARACTERISTIC PT_rTraGear1_C /end REF_CHARACTERISTIC
 /begin IN_MEASUREMENT APP_r APP_uRaw1 APP_uRaw2 BrkP_dpMstCyl BrkP_p Brk_st B_kh_msg Clth3_st Clth_drFlt Clth_r Clth_rKisspnt Clth_st Clth_stClthExtd Clth_swtClthType Com_stBrkHldSys Com_stEngMapReq CoVOM_bEngFrstStrtPassed EnvP_p Epm_nEng fho Gbx_stNPos Gbx_stPNPos Gbx_stRvsPos GlbDa_lWhlCirc HLSDem_nSetPLo HndBrk_stDebVal LAS_a LAS_facRoadGrdt nstatfil_msg PT_stTraType SyC_stSub tmot VehMot_rTrqDfftl VehV_v /end IN_MEASUREMENT
 /begin OUT_MEASUREMENT HLSDem_bDrvOffSuprtActv HLSDem_facAppDeadZone HLSDem_flgRceModActv HLSDem_flgSptModActv HLSDem_nDrvOffSuprtSp HLSDem_nOffsSpIncrCreep HLSDem_rClthKisspntDiff HLSDem_rGearDrvOff HLSDem_rGearDrvOffFlt HLSDem_stDrvOffMT HLSDem_stDrvOffSuprtSpFilTyp HLSDem_stDrvOffSuprtSpIncr /end OUT_MEASUREMENT
 /begin LOC_MEASUREMENT HLSDem_nDrvOffSuprtAbsltSp HLSDem_nDrvOffSuprtBascSpLo HLSDem_nDrvOffSuprtOffs HLSDem_nDrvOffSuprtSpIncr HLSDem_nDrvOffSuprtSpRaw HLSDem_nOffsDrvOffSpIncKissPnt HLSDem_pMstCylBrk HLSDem_stDrvOffSpIncrCVT HLSDem_stDrvOffSpIncrKissPnt HLSDem_stDrvOffSpIncrMT HLSDem_stDrvOffSuprtDiCdn HLSDem_stDrvOffSuprtEnaCdn HLSDem_stEngOperModSeln HLSDem_stSIncrCondCVT HLSDem_stSIncrCondMT /end LOC_MEASUREMENT
 FUNCTION_VERSION "1.9.0_1.7.0" /end FUNCTION
/begin FUNCTION HLSDem_NMaxEng "1.49.0    Calculation max. engine speed depending on combustion engine demand"
 /begin DEF_CHARACTERISTIC HLSDem_dKnCtlSlopNeg_C HLSDem_dKnCtlSlopPos_C HLSDem_dtOilHys_C HLSDem_dtWrmHys_C HLSDem_facAirOvhtPrv_MAP HLSDem_facCTOvhtPrvMax_MAP HLSDem_facFlTempMax_MAP HLSDem_facOilOvhtPrvMax_MAP HLSDem_facOvhtThresGovHi_C HLSDem_facOvhtThresGovLo_C HLSDem_facOvhtThresHi_C HLSDem_facOvhtThresLo_C HLSDem_flgChkClthStandStill_C HLSDem_flgNoGripActv_C HLSDem_nEngMaxGov_MAP HLSDem_nEngMax_MAP HLSDem_nLimAvusWarn_C HLSDem_nLimLftLimp_C HLSDem_nMaxErr1Lim_C HLSDem_nMaxErr2Lim_C HLSDem_nMaxHiSprt_CUR HLSDem_nMaxHiTipp_CUR HLSDem_nMaxHi_CUR HLSDem_nMaxKnCtl_C HLSDem_nMaxOilT_MAP HLSDem_nMaxShtrp_C HLSDem_nMaxStandSigErr_C HLSDem_nMaxStandStill_CW HLSDem_nMaxStand_C HLSDem_nMaxStdOfs_C HLSDem_nMaxStdSprt_CUR HLSDem_nMaxStdTipp_CUR HLSDem_nMaxStd_CUR HLSDem_nMaxTEng_CUR HLSDem_rClthPsdThd_C HLSDem_stNMaxEngGov_CW HLSDem_stNMaxEng_CW HLSDem_stNMaxPrio_CW HLSDem_stOvhtEngMaxGov_CW HLSDem_stWarn2500_CW HLSDem_stWarn4000_CW HLSDem_stWarn6000_CW HLSDem_tiDelNMaxESP_C HLSDem_tiKnCntl_C HLSDem_tiMaxNMaxHi_CUR HLSDem_tiNMaxBlw_C HLSDem_tiNMaxStand_C HLSDem_tNMaxHi_C HLSDem_tWrm_C HLSDem_vActStandStill_C HLSDem_vNMaxHi_C /end DEF_CHARACTERISTIC
 /begin IN_MEASUREMENT Air_tCACDs CEngDsT_t Clth_r Clth_st Clth_stClthExtd Clth_swtClthType EngDa_tEng EngPrt_bOvhtEngLim EngPrt_nOvhtEngLim Epm_nEng FuelT_t FuPHi_flgNMax FuPHi_nMax Gbx_nRrngEngSpdInh Gbx_stGearLvr GEVCtl_flgLftLimpNLim HLSDem_bNMaxRmpUp IKCtl_flgSftyRtdt InjSys_nMaxHPInjVlvStkOpn MoX_nMaxICOMsg Oil_stAvusWarn Oil_tSwmp PT_bNoGrip PT_rTrq PT_stTraType Shtrp_stAct SpdGov_bNLimActv StbIntv_bESPErr StbIntv_bTCSDeActv Tra_bCANErrMax Tra_numGear VehV_v /end IN_MEASUREMENT
 /begin OUT_MEASUREMENT HLSDem_bNMaxHiTmp HLSDem_bNMaxHiTmpLmpOn HLSDem_bNMaxPrio HLSDem_bNMaxRed HLSDem_bNMaxWrm HLSDem_bOvhtEngNLim HLSDem_bOvhtEngNLimGov HLSDem_nMax HLSDem_nMaxEng HLSDem_nMaxEngFlt HLSDem_nMaxEngFltGov HLSDem_nMaxEngUnFlt HLSDem_nMaxEngWoHalt HLSDem_nMaxEngWoHaltGov HLSDem_nMaxHiStd HLSDem_nOvhtEngNLim HLSDem_nOvhtEngNLimGov HLSDem_stAvusWarn HLSDem_stNLimEng HLSDem_tOil /end OUT_MEASUREMENT
 /begin LOC_MEASUREMENT B_wrm HLSDem_bErr1 HLSDem_bErr2 HLSDem_bNMaxHi HLSDem_bNMaxKnCtl HLSDem_bStandStillLimActv HLSDem_bVehStand HLSDem_facEngSpdLim HLSDem_facEngSpdLimGov HLSDem_flgSpdClthGearAccrSigErr HLSDem_KnCtlTONVNM_I.time HLSDem_KnCtl_NRamp_I.nRampMem HLSDem_nKnCtlLim HLSDem_nMaxAVSLimGov_mp HLSDem_nMaxBDELimGov_mp HLSDem_nMaxBefLim HLSDem_nMaxChaElgLimGov_mp HLSDem_nMaxErr1Lim HLSDem_nMaxErr2Lim HLSDem_nMaxErrLimGov_mp HLSDem_nMaxHi_mp HLSDem_nMaxKnCtlLimGov_mp HLSDem_nMaxStd_mp HLSDem_nMaxT HLSDem_stNMaxDeacStand HLSDem_tAir_mp HLSDem_tOilHys HLSDem_tOilUp /end LOC_MEASUREMENT
 FUNCTION_VERSION "1.49.0" /end FUNCTION
/begin COMPU_METHOD Acc "" RAT_FUNC "%6.5" "m/s^2" COEFFS 0 1000 0 0 0 1 /end COMPU_METHOD
/begin COMPU_METHOD AirMassPerTime_float "" RAT_FUNC "%6.2" "Kg/h" COEFFS 0 1 0 0 0 1 /end COMPU_METHOD
/begin COMPU_METHOD B_TRUE "" TAB_VERB "%6.3" "" COMPU_TAB_REF B_TRUE /end COMPU_METHOD
/begin COMPU_VTAB B_TRUE "" TAB_VERB 2 0 "FALSE" 1 "TRUE" /end COMPU_VTAB
/begin COMPU_METHOD dez "" RAT_FUNC "%6.2" "" COEFFS 0 1 0 0 0 1 /end COMPU_METHOD
/begin COMPU_METHOD EngN "" RAT_FUNC "%6.3" "rpm" COEFFS 0 2 0 0 0 1 /end COMPU_METHOD
/begin COMPU_METHOD EngNGrd "" RAT_FUNC "%6.3" "rpm/s" COEFFS 0 2 0 0 0 1 /end COMPU_METHOD
/begin COMPU_METHOD Fact "" RAT_FUNC "%6.5" "-" COEFFS 0 8192 0 0 0 1 /end COMPU_METHOD
/begin COMPU_METHOD Fact_10000 "" RAT_FUNC "%7.6" "-" COEFFS 0 10000 0 0 0 1 /end COMPU_METHOD
/begin COMPU_METHOD Fact_q0p1_COMPU "" RAT_FUNC "%6.3" "-" COEFFS 0 10 0 0 0 1 /end COMPU_METHOD
/begin COMPU_METHOD fak_q0p01 "" RAT_FUNC "%6.4" "" COEFFS 0 100 0 0 0 1 /end COMPU_METHOD
/begin COMPU_METHOD fak_q0p05 "" RAT_FUNC "%6.4" "" COEFFS 0 1 0 0 0 0.05 /end COMPU_METHOD
/begin COMPU_METHOD fak_q1p5259Em7 "" RAT_FUNC "%9.8" "" COEFFS 0 6553600 0 0 0 1 /end COMPU_METHOD
/begin COMPU_METHOD fak_q3p0518Em5 "" RAT_FUNC "%7.6" "" COEFFS 0 32768 0 0 0 1 /end COMPU_METHOD
/begin COMPU_METHOD fak_ub_b4 "" RAT_FUNC "%6.4" "-" COEFFS 0 256 0 0 0 4 /end COMPU_METHOD
/begin COMPU_METHOD fak_uw_b2 "" RAT_FUNC "%7.6" "-" COEFFS 0 65536 0 0 0 2 /end COMPU_METHOD
/begin COMPU_METHOD fak_uw_b8 "" RAT_FUNC "%6.5" "-" COEFFS 0 65536 0 0 0 8 /end COMPU_METHOD
/begin COMPU_METHOD HEGO_OBDElecMin_CLS_sm_tab_verb "" TAB_VERB "%6.3" "" COMPU_TAB_REF HEGO_OBDElecMin_CLS_sm_tab_verb /end COMPU_METHOD
/begin COMPU_VTAB HEGO_OBDElecMin_CLS_sm_tab_verb "" TAB_VERB 4 0 "_0_start_min" 1 "_1_waiting_min" 2 "_2_request_3_load_pulses_min" 3 "_3_check_result_min" /end COMPU_VTAB
/begin COMPU_METHOD HEGO_OBDElecSig_CLS_sm_tab_verb "" TAB_VERB "%6.3" "" COMPU_TAB_REF HEGO_OBDElecSig_CLS_sm_tab_verb /end COMPU_METHOD
/begin COMPU_VTAB HEGO_OBDElecSig_CLS_sm_tab_verb "" TAB_VERB 5 0 "_0_start_sig" 1 "_1_waiting_sig" 2 "_2_request_load_pulse_sig" 3 "_3_check_result_sig" 4 "_4_request_3_load_pulses_sig" /end COMPU_VTAB
/begin COMPU_METHOD HEGO_Sens_CLS_sm_tab_verb "" TAB_VERB "%6.3" "" COMPU_TAB_REF HEGO_Sens_CLS_sm_tab_verb /end COMPU_METHOD
/begin COMPU_VTAB HEGO_Sens_CLS_sm_tab_verb "" TAB_VERB 3 0 "_0_measure_us" 1 "_1_pending" 2 "_2_ri_acquisition" /end COMPU_VTAB
/begin COMPU_METHOD HESrv_stMSid_t "" TAB_VERB "%6.3" "" COMPU_TAB_REF HESrv_stMSid_t /end COMPU_METHOD
/begin COMPU_VTAB HESrv_stMSid_t "" TAB_VERB 3 0 "Master" 1 "Slave" 255 "Standalone" /end COMPU_VTAB
/begin COMPU_METHOD HESrv_SwtPOpVis "" TAB_VERB "%6.3" "" COMPU_TAB_REF HESrv_SwtPOpVis /end COMPU_METHOD
/begin COMPU_VTAB HESrv_SwtPOpVis "" TAB_VERB 2 0 "Bank 1" 1 "Bank 2" /end COMPU_VTAB
/begin COMPU_METHOD i_q0p00039_A "" RAT_FUNC "%6.5" "A" COEFFS 0 65536 0 0 0 25 /end COMPU_METHOD
/begin COMPU_METHOD leist_q0p00244 "" RAT_FUNC "%6.4" "W" COEFFS 0 4096 0 0 0 10 /end COMPU_METHOD
/begin COMPU_METHOD m_q0p1 "" RAT_FUNC "%6.3" "kg/h" COEFFS 0 10 0 0 0 1 /end COMPU_METHOD
/begin COMPU_METHOD nmot_sw_q0p5 "" RAT_FUNC "%6.3" "1/min" COEFFS 0 2 0 0 0 1 /end COMPU_METHOD
/begin COMPU_METHOD OneToOne "" RAT_FUNC "%6.2" "-" COEFFS 0 1 0 0 0 1 /end COMPU_METHOD
/begin COMPU_METHOD PosMCKd_4 "" RAT_FUNC "%7.6" "%/AgCA" COEFFS 0 36000.0000000088 0 0 0 1 /end COMPU_METHOD
/begin COMPU_METHOD PosMCKi "" RAT_FUNC "%6.5" "%/(AgCA*s)" COEFFS 0 4718.59200000115 0 0 0 1 /end COMPU_METHOD
/begin COMPU_METHOD PosMCKi_2 "" RAT_FUNC "%6.5" "%/(AgCA*s)" COEFFS 0 2359.29600000058 0 0 0 1 /end COMPU_METHOD
/begin COMPU_METHOD PosMCKp "" RAT_FUNC "%7.6" "%/AgCA" COEFFS 0 72000.0000000176 0 0 0 1 /end COMPU_METHOD
/begin COMPU_METHOD PosMCKp_32 "" RAT_FUNC "%6.5" "%/AgCA" COEFFS 0 2250.00000000055 0 0 0 1 /end COMPU_METHOD
/begin COMPU_METHOD POSTDRV_SOFTRST_SY_Compu "" TAB_VERB "%6.3" "" COMPU_TAB_REF POSTDRV_SOFTRST_SY_Compu /end COMPU_METHOD
/begin COMPU_VTAB POSTDRV_SOFTRST_SY_Compu "" TAB_VERB 2 0 "false" 1 "true" /end COMPU_VTAB
/begin COMPU_METHOD POUTLVLVDSSNSRTYP_SC_Compu "" TAB_VERB "%6.3" "" COMPU_TAB_REF POUTLVLVDSSNSRTYP_SC_Compu /end COMPU_METHOD
/begin COMPU_VTAB POUTLVLVDSSNSRTYP_SC_Compu "" TAB_VERB 4 0 "P_SNSRABSNT" 1 "P_ABSLTSNSR" 2 "P_DFTLSNSR" 3 "P_ABSLTDFTLSNSR" /end COMPU_VTAB
/begin COMPU_METHOD POUTLVLVDS_ACTVTOFFSADPN_SC_Compu "" TAB_VERB "%6.3" "" COMPU_TAB_REF POUTLVLVDS_ACTVTOFFSADPN_SC_Compu /end COMPU_METHOD
/begin COMPU_VTAB POUTLVLVDS_ACTVTOFFSADPN_SC_Compu "" TAB_VERB 2 0 "DISABLED" 1 "ACTIVE" /end COMPU_VTAB
/begin COMPU_METHOD POUTLVLVDS_TYPAVL_SC_Compu "" TAB_VERB "%6.3" "" COMPU_TAB_REF POUTLVLVDS_TYPAVL_SC_Compu /end COMPU_METHOD
/begin COMPU_VTAB POUTLVLVDS_TYPAVL_SC_Compu "" TAB_VERB 2 0 "FALSE" 1 "TRUE" /end COMPU_VTAB
/begin COMPU_METHOD PPFILDIFSNSR_SC_Compu "" TAB_VERB "%6.3" "" COMPU_TAB_REF PPFILDIFSNSR_SC_Compu /end COMPU_METHOD
/begin COMPU_VTAB PPFILDIFSNSR_SC_Compu "" TAB_VERB 2 0 "False" 1 "True" /end COMPU_VTAB
/begin COMPU_METHOD PPFLTDIFFASICT_TYPAVL_SC_Compu "" TAB_VERB "%6.3" "" COMPU_TAB_REF PPFLTDIFFASICT_TYPAVL_SC_Compu /end COMPU_METHOD
/begin COMPU_VTAB PPFLTDIFFASICT_TYPAVL_SC_Compu "" TAB_VERB 2 0 "False" 1 "True" /end COMPU_VTAB
/begin COMPU_METHOD PPFLTDIFFCH1_TYPAVL_SC_Compu "" TAB_VERB "%6.3" "" COMPU_TAB_REF PPFLTDIFFCH1_TYPAVL_SC_Compu /end COMPU_METHOD
/begin COMPU_VTAB PPFLTDIFFCH1_TYPAVL_SC_Compu "" TAB_VERB 2 0 "False" 1 "True" /end COMPU_VTAB
/begin COMPU_METHOD PPFLTDIFFCH2_TYPAVL_SC_Compu "" TAB_VERB "%6.3" "" COMPU_TAB_REF PPFLTDIFFCH2_TYPAVL_SC_Compu /end COMPU_METHOD
/begin COMPU_VTAB PPFLTDIFFCH2_TYPAVL_SC_Compu "" TAB_VERB 2 0 "False" 1 "True" /end COMPU_VTAB
/begin COMPU_METHOD PPFLTDIFF_TYPAVL_SY_Compu "" TAB_VERB "%6.3" "" COMPU_TAB_REF PPFLTDIFF_TYPAVL_SY_Compu /end COMPU_METHOD
/begin COMPU_VTAB PPFLTDIFF_TYPAVL_SY_Compu "" TAB_VERB 2 0 "False" 1 "True" /end COMPU_VTAB
/begin COMPU_METHOD PPFLTDIFF_TYPTWINFLW_SC_Compu "" TAB_VERB "%6.3" "" COMPU_TAB_REF PPFLTDIFF_TYPTWINFLW_SC_Compu /end COMPU_METHOD
/begin COMPU_VTAB PPFLTDIFF_TYPTWINFLW_SC_Compu "" TAB_VERB 2 0 "False" 1 "True" /end COMPU_VTAB
/begin COMPU_METHOD PPFLTDS_TYPAVL_SC_Compu "" TAB_VERB "%6.3" "" COMPU_TAB_REF PPFLTDS_TYPAVL_SC_Compu /end COMPU_METHOD
/begin COMPU_VTAB PPFLTDS_TYPAVL_SC_Compu "" TAB_VERB 2 0 "False" 1 "True" /end COMPU_VTAB
/begin COMPU_METHOD PPFLTUS_TYPAVL_SY_Compu "" TAB_VERB "%6.3" "" COMPU_TAB_REF PPFLTUS_TYPAVL_SY_Compu /end COMPU_METHOD
/begin COMPU_VTAB PPFLTUS_TYPAVL_SY_Compu "" TAB_VERB 2 0 "False" 1 "True" /end COMPU_VTAB
/begin COMPU_METHOD Prc "" RAT_FUNC "%6.4" "%" COEFFS 0 81.92 0 0 0 1 /end COMPU_METHOD
/begin COMPU_METHOD Prc2EffGrad "" RAT_FUNC "%7.6" "1/(%*s)" COEFFS 0 10000 0 0 0 1 /end COMPU_METHOD
/begin COMPU_METHOD PrcSlp "" RAT_FUNC "%6.4" "%/s" COEFFS 0 819.2 0 0 0 1 /end COMPU_METHOD
/begin COMPU_METHOD Prc_Fact100 "" RAT_FUNC "%6.4" "%" COEFFS 0 100 0 0 0 1 /end COMPU_METHOD
/begin COMPU_METHOD Prc_Fact256 "" RAT_FUNC "%6.4" "%" COEFFS 0 256 0 0 0 1 /end COMPU_METHOD
/begin COMPU_METHOD Prc_q0p1_COMPU "" RAT_FUNC "%6.3" "%" COEFFS 0 10 0 0 0 1 /end COMPU_METHOD
/begin COMPU_METHOD PRECRASHSFTYENA_SC_Compu "" TAB_VERB "%6.3" "" COMPU_TAB_REF PRECRASHSFTYENA_SC_Compu /end COMPU_METHOD
/begin COMPU_VTAB PRECRASHSFTYENA_SC_Compu "" TAB_VERB 2 0 "False" 1 "True" /end COMPU_VTAB
/begin COMPU_METHOD PREIGNPROTNENCHMTCYLIND_SC_Compu "" TAB_VERB "%6.3" "" COMPU_TAB_REF PREIGNPROTNENCHMTCYLIND_SC_Compu /end COMPU_METHOD
/begin COMPU_VTAB PREIGNPROTNENCHMTCYLIND_SC_Compu "" TAB_VERB 2 0 "False" 1 "True" /end COMPU_VTAB
/begin COMPU_METHOD PresAC_hPa "" RAT_FUNC "%6.2" "hPa" COEFFS 0 0.5 0 0 0 1 /end COMPU_METHOD
/begin COMPU_METHOD PreshPa_10ms "" RAT_FUNC "%6.0" "hPa/s" COEFFS 0 0.01 0 0 0 1 /end COMPU_METHOD
/begin COMPU_METHOD PreshPa_FnReso "" RAT_FUNC "%6.3" "hPa" COEFFS 0 10 0 0 0 1 /end COMPU_METHOD
/begin COMPU_METHOD PreshPa_HiRes "" RAT_FUNC "%6.4" "hPa" COEFFS 0 100 0 0 0 1 /end COMPU_METHOD
/begin COMPU_METHOD PresInv_hPa "" RAT_FUNC "%10.9" "1/hPa" COEFFS 0 10000000 0 0 0 1 /end COMPU_METHOD
/begin COMPU_METHOD PresRail_sec "" RAT_FUNC "%6.0" "hPa/s" COEFFS 0 0.0025 0 0 0 1 /end COMPU_METHOD
/begin COMPU_METHOD Pres_hPa "" RAT_FUNC "%6.2" "hPa" COEFFS 0 1 0 0 0 1 /end COMPU_METHOD
/begin COMPU_METHOD p_ub_q10 "" RAT_FUNC "%6.1" "hPa" COEFFS 0 1 0 0 0 10 /end COMPU_METHOD
/begin COMPU_METHOD q0p00001_degC_DIV_W "" RAT_FUNC "%8.7" "degC/W" COEFFS 0 100000 0 0 0 1 /end COMPU_METHOD
/begin COMPU_METHOD q0p001_W_DIV_K "" RAT_FUNC "%6.5" "W/K" COEFFS 0 1000 0 0 0 1 /end COMPU_METHOD
/begin COMPU_METHOD q6p357Em6_V_DIV_K "" RAT_FUNC "%8.7" "V/K" COEFFS 0 786432 0 0 0 5 /end COMPU_METHOD
/begin COMPU_METHOD RmpEngN "" RAT_FUNC "%6.4" "rpm/s" COEFFS 0 131.072 0 0 0 1 /end COMPU_METHOD
/begin COMPU_METHOD r_q0p00039_Ohm "" RAT_FUNC "%6.5" "Ohm" COEFFS 0 65536 0 0 0 25.6 /end COMPU_METHOD
/begin COMPU_METHOD r_q3p0518Em5 "" RAT_FUNC "%7.6" "Ohm" COEFFS 0 32768 0 0 0 1 /end COMPU_METHOD
/begin COMPU_METHOD r_uw_q2 "" RAT_FUNC "%6.2" "Ohm" COEFFS 0 1 0 0 0 2 /end COMPU_METHOD
/begin COMPU_METHOD spg_q0p00039 "" RAT_FUNC "%6.5" "V" COEFFS 0 1 0 0 0 0.000390625 /end COMPU_METHOD
/begin COMPU_METHOD spg_q0p00488 "" RAT_FUNC "%6.4" "V" COEFFS 0 1024 0 0 0 5 /end COMPU_METHOD
/begin COMPU_METHOD spg_q0p005 "" RAT_FUNC "%6.4" "V" COEFFS 0 1 0 0 0 0.005 /end COMPU_METHOD
/begin COMPU_METHOD spg_q0p1 "" RAT_FUNC "%6.3" "V" COEFFS 0 1 0 0 0 0.1 /end COMPU_METHOD
/begin COMPU_METHOD spg_q1p221Em3_V "" RAT_FUNC "%6.4" "V" COEFFS 0 65536 0 0 0 80 /end COMPU_METHOD
/begin COMPU_METHOD spg_q1p8626Em8_V "" RAT_FUNC "%10.9" "V" COEFFS 0 268435456 0 0 0 5 /end COMPU_METHOD
/begin COMPU_METHOD Temp_Cels "" RAT_FUNC "%6.1" "deg C" COEFFS 0 10 2731.4 0 0 1 /end COMPU_METHOD
/begin COMPU_METHOD temp_q0p0234 "" RAT_FUNC "%6.4" "K" COEFFS 0 256 0 0 0 6 /end COMPU_METHOD
/begin COMPU_METHOD temp_q0p0234_o273 "" RAT_FUNC "%6.1" "Grad C" COEFFS 0 1 273.15 0 0 0.0234375 /end COMPU_METHOD
/begin COMPU_METHOD temp_q0p0234_om273 "" RAT_FUNC "%6.1" "Grad C" COEFFS 0 640 174816 0 0 15 /end COMPU_METHOD
/begin COMPU_METHOD temp_q0p75_om48 "" RAT_FUNC "%6.2" "Grad C" COEFFS 0 4 192 0 0 3 /end COMPU_METHOD
/begin COMPU_METHOD temp_q1p5259Em6_om273 "" RAT_FUNC "%6.1" "°C" COEFFS 0 65536 17900503.04 0 0 0.1 /end COMPU_METHOD
/begin COMPU_METHOD temp_q3p57Em7_om273 "" RAT_FUNC "%6.1" "Grad C" COEFFS 0 8388608 2291348275.2 0 0 3 /end COMPU_METHOD
/begin COMPU_METHOD temp_ub_q0p75_o48 "" RAT_FUNC "%6.2" "Grad C" COEFFS 0 1 48 0 0 0.75 /end COMPU_METHOD
/begin COMPU_METHOD TimeDelay_s "" RAT_FUNC "%6.1" "s" COEFFS 0 0 1 0 0.00023283064365387 0 /end COMPU_METHOD
/begin COMPU_METHOD Time_Dt "" RAT_FUNC "%9.8" "s" COEFFS 0 1000000 0 0 0 1 /end COMPU_METHOD
/begin COMPU_METHOD Time_ms "" RAT_FUNC "%6.1" "ms" COEFFS 0 0.1 0 0 0 1 /end COMPU_METHOD
/begin COMPU_METHOD Time_ms_20ms "" RAT_FUNC "%6.1" "ms" COEFFS 0 0.05 0 0 0 1 /end COMPU_METHOD
/begin COMPU_METHOD Time_s "" RAT_FUNC "%6.4" "s" COEFFS 0 100 0 0 0 1 /end COMPU_METHOD
/begin COMPU_METHOD Time_sec_1 "" RAT_FUNC "%6.3" "s" COEFFS 0 10 0 0 0 1 /end COMPU_METHOD
/begin COMPU_METHOD TransR "" RAT_FUNC "%6.4" "-" COEFFS 0 100 0 0 0 1 /end COMPU_METHOD
/begin COMPU_METHOD t_q0p001 "" RAT_FUNC "%6.5" "s" COEFFS 0 1000 0 0 0 1 /end COMPU_METHOD
/begin COMPU_METHOD t_q0p01 "" RAT_FUNC "%6.4" "s" COEFFS 0 100 0 0 0 1 /end COMPU_METHOD
/begin COMPU_METHOD t_q0p02 "" RAT_FUNC "%6.4" "s" COEFFS 0 100 0 0 0 2 /end COMPU_METHOD
/begin COMPU_METHOD t_q0p1 "" RAT_FUNC "%6.3" "s" COEFFS 0 10 0 0 0 1 /end COMPU_METHOD
/begin COMPU_METHOD t_q1 "" RAT_FUNC "%6.2" "s" COEFFS 0 1 0 0 0 1 /end COMPU_METHOD
/begin COMPU_METHOD Vel "" RAT_FUNC "%6.4" "km/h" COEFFS 0 100 0 0 0 1 /end COMPU_METHOD
/begin COMPU_METHOD Volt "" RAT_FUNC "%6.3" "mV" COEFFS 0 5 0 0 0 1 /end COMPU_METHOD
/begin COMPU_METHOD Volt_Batt "" RAT_FUNC "%6.1" "mV" COEFFS 0 0.05 0 0 0 1 /end COMPU_METHOD
/begin COMPU_METHOD zk100msxs_uw_b6553p6 "" RAT_FUNC "%6.1" "s" COEFFS 0 0 65536 0 10 0 /end COMPU_METHOD
/begin RECORD_LAYOUT RB_Curve_R32_U16_Static NO_AXIS_PTS_X 1 ULONG AXIS_PTS_X 2 FLOAT32_IEEE INDEX_INCR DIRECT FNC_VALUES 3 UWORD COLUMN_DIR DIRECT STATIC_RECORD_LAYOUT /end RECORD_LAYOUT
/begin RECORD_LAYOUT RB_Curve_S16_S16 NO_AXIS_PTS_X 1 SWORD AXIS_PTS_X 2 SWORD INDEX_INCR DIRECT FNC_VALUES 3 SWORD COLUMN_DIR DIRECT /end RECORD_LAYOUT
/begin RECORD_LAYOUT RB_Curve_U16_S16_Static NO_AXIS_PTS_X 1 UWORD AXIS_PTS_X 2 UWORD INDEX_INCR DIRECT FNC_VALUES 3 SWORD COLUMN_DIR DIRECT STATIC_RECORD_LAYOUT /end RECORD_LAYOUT
/begin RECORD_LAYOUT RB_Curve_U16_U16 NO_AXIS_PTS_X 1 UWORD AXIS_PTS_X 2 UWORD INDEX_INCR DIRECT FNC_VALUES 3 UWORD COLUMN_DIR DIRECT /end RECORD_LAYOUT
/begin RECORD_LAYOUT RB_Curve_U8_S16_Static NO_AXIS_PTS_X 1 UBYTE AXIS_PTS_X 2 UBYTE INDEX_INCR DIRECT FNC_VALUES 3 SWORD COLUMN_DIR DIRECT STATIC_RECORD_LAYOUT /end RECORD_LAYOUT
/begin RECORD_LAYOUT RB_Curve_U8_U8 NO_AXIS_PTS_X 1 UBYTE AXIS_PTS_X 2 UBYTE INDEX_INCR DIRECT FNC_VALUES 3 UBYTE COLUMN_DIR DIRECT /end RECORD_LAYOUT
/begin RECORD_LAYOUT RB_Map_S16S16_S16 NO_AXIS_PTS_X 1 SWORD NO_AXIS_PTS_Y 2 SWORD AXIS_PTS_X 3 SWORD INDEX_INCR DIRECT AXIS_PTS_Y 4 SWORD INDEX_INCR DIRECT FNC_VALUES 5 SWORD COLUMN_DIR DIRECT /end RECORD_LAYOUT
/begin RECORD_LAYOUT RB_Map_S16U8_S16 NO_AXIS_PTS_X 1 SWORD NO_AXIS_PTS_Y 2 SWORD AXIS_PTS_X 3 SWORD INDEX_INCR DIRECT AXIS_PTS_Y 4 UBYTE INDEX_INCR DIRECT FNC_VALUES 5 SWORD COLUMN_DIR DIRECT /end RECORD_LAYOUT
/begin RECORD_LAYOUT RB_Map_U16S16_S16 NO_AXIS_PTS_X 1 UWORD NO_AXIS_PTS_Y 2 UWORD AXIS_PTS_X 3 UWORD INDEX_INCR DIRECT AXIS_PTS_Y 4 SWORD INDEX_INCR DIRECT FNC_VALUES 5 SWORD COLUMN_DIR DIRECT /end RECORD_LAYOUT
/begin RECORD_LAYOUT RB_Map_U16U16_U16 NO_AXIS_PTS_X 1 UWORD NO_AXIS_PTS_Y 2 UWORD AXIS_PTS_X 3 UWORD INDEX_INCR DIRECT AXIS_PTS_Y 4 UWORD INDEX_INCR DIRECT FNC_VALUES 5 UWORD COLUMN_DIR DIRECT /end RECORD_LAYOUT
/begin RECORD_LAYOUT RB_Map_U8U8_S16 NO_AXIS_PTS_X 1 UBYTE NO_AXIS_PTS_Y 2 UBYTE AXIS_PTS_X 3 UBYTE INDEX_INCR DIRECT AXIS_PTS_Y 4 UBYTE INDEX_INCR DIRECT FNC_VALUES 5 SWORD COLUMN_DIR DIRECT /end RECORD_LAYOUT
/begin RECORD_LAYOUT RB_Val_Wboolean FNC_VALUES 1 UBYTE COLUMN_DIR DIRECT /end RECORD_LAYOUT
/begin RECORD_LAYOUT RB_Val_Ws16 FNC_VALUES 1 SWORD COLUMN_DIR DIRECT /end RECORD_LAYOUT
/begin RECORD_LAYOUT RB_Val_Ws32 FNC_VALUES 1 SLONG COLUMN_DIR DIRECT /end RECORD_LAYOUT
/begin RECORD_LAYOUT RB_Val_Wu16 FNC_VALUES 1 UWORD COLUMN_DIR DIRECT /end RECORD_LAYOUT
/begin RECORD_LAYOUT RB_Val_Wu32 FNC_VALUES 1 ULONG COLUMN_DIR DIRECT /end RECORD_LAYOUT
/begin RECORD_LAYOUT RB_Val_Wu8 FNC_VALUES 1 UBYTE COLUMN_DIR DIRECT /end RECORD_LAYOUT
/begin RECORD_LAYOUT ValA_Wu8 FNC_VALUES 1 UBYTE COLUMN_DIR DIRECT /end RECORD_LAYOUT
/begin RECORD_LAYOUT Val_Wu8 FNC_VALUES 1 UBYTE COLUMN_DIR DIRECT /end RECORD_LAYOUT
/end MODULE
/end PROJECT
