ASAP2_VERSION 1 60
/begin PROJECT MG1CS022 "MG1CS022"
/begin HEADER "" VERSION "MG1CS022_62XSC_V037_TPROT" PROJECT_NO MG1CS022 /end HEADER
/begin MODULE DIM ""
/begin MOD_COMMON "" BYTE_ORDER MSB_LAST ALIGNMENT_BYTE 1 ALIGNMENT_WORD 2 ALIGNMENT_LONG 4 ALIGNMENT_INT64 4 ALIGNMENT_FLOAT32_IEEE 4 ALIGNMENT_FLOAT64_IEEE 4 DATA_SIZE 32 /end MOD_COMMON
/begin CHARACTERISTIC AGRVPSHYSHIGH_C "" VALUE 0x8057E49C RB_Val_Wu16 99.99847 rel_uw_b100 0.00 99.99847 FORMAT "%8.5" /end CHARACTERISTIC
/begin CHARACTERISTIC AGRVPSHYSLOW_C "" VALUE 0x8057E49E RB_Val_Wu16 99.99847 rel_uw_b100 0.00 99.99847 FORMAT "%8.5" /end CHARACTERISTIC
/begin CHARACTERISTIC agrvpsHysSwt_C "" VALUE 0x8057E4A0 RB_Val_Wu8 1.00000000000 B_TRUE 0.00 1.00000000000 FORMAT "%13.11" /end CHARACTERISTIC
/begin CHARACTERISTIC agrvpsHysVal_C "" VALUE 0x8057E4A2 RB_Val_Wu16 99.99847 rel_uw_b100 0.00 99.99847 FORMAT "%8.5" /end CHARACTERISTIC
/begin CHARACTERISTIC AHEAGW "Number of misfire at which the emission limit is exceeded" VALUE 0x8057E4A4 RB_Val_Wu16 65535.00 dez 0.00 65535.00 FORMAT "%8.2" /end CHARACTERISTIC
/begin CHARACTERISTIC AirC_stSwtPrs_C "Calibration for AC switch pressed/unpressed status" VALUE 0x8057E4A6 RB_Val_Wu8 255.0 OneToOne 0.00 255.0 FORMAT "%5.1" /end CHARACTERISTIC
/begin CHARACTERISTIC AltIO_DiagPs_CW "Codeword for Alternator Diagnosis" VALUE 0x8057E4A7 RB_Val_Wu8 255.0 OneToOne 0.00 255.0 FORMAT "%5.1" /end CHARACTERISTIC
/begin CHARACTERISTIC Alt_stDchaAltUpprLimStk_C "Calibration for Judgement for discharge with ACG upper limit stuck" VALUE 0x8057E4A8 RB_Val_Wu8 1.00000000000 B_TRUE 0.00 1.00000000000 FORMAT "%13.11" /end CHARACTERISTIC
/begin CHARACTERISTIC App_flgSRCLo1HiImpdChk_C "" VALUE 0x8057E4A9 RB_Val_Wu8 1.00000000000 B_TRUE 0.00 1.00000000000 FORMAT "%13.11" /end CHARACTERISTIC
/begin CHARACTERISTIC App_flgSRCLo2HiImpdChk_C "" VALUE 0x8057E4AA RB_Val_Wu8 1.00000000000 B_TRUE 0.00 1.00000000000 FORMAT "%13.11" /end CHARACTERISTIC
/begin CHARACTERISTIC APP_flgT15HealEnad_C "Calibration to enable SRC healing during T15 reset" VALUE 0x8057E4AB RB_Val_Wu8 1.00000000000 B_TRUE 0.00 1.00000000000 FORMAT "%13.11" /end CHARACTERISTIC
/begin CHARACTERISTIC App_swtHiImpdChkEna_C "Switch to enable the High impedance check" VALUE 0x8057E4AC RB_Val_Wu8 1.00000000000 B_TRUE 0.00 1.00000000000 FORMAT "%13.11" /end CHARACTERISTIC
/begin CHARACTERISTIC ATS_TrbCh_B1.LimitTypeMsk_C "Actuator test ATS_TrbCh_B1 / Tester demand monitoring enable mask for actuators" VALUE 0x8058A6E8 Val_Wu8 255.0 OneToOne 0.00 255.0 FORMAT "%5.1" /end CHARACTERISTIC
/begin CHARACTERISTIC ATS_TrbCh_B1.CnvNorm_C "Actuator test ATS_TrbCh_B1 / Conversion norm used for conversion to/from internal scaling" VALUE 0x8058A6E9 Val_Wu8 255.0 OneToOne 0.00 255.0 FORMAT "%5.1" /end CHARACTERISTIC
/begin CHARACTERISTIC ATS_TrbCh_B1.LowLim_C "Actuator test ATS_TrbCh_B1 / Lower limit for monitoring" VALUE 0x8058A6EA Val_Ws16 511.9922 rel_q0p0078125 -256.0000 255.9922 FORMAT "%8.4" /end CHARACTERISTIC
/begin CHARACTERISTIC ATS_TrbCh_B1.UpLim_C "Actuator test ATS_TrbCh_B1 / Upper limit for monitoring" VALUE 0x8058A6EC Val_Ws16 511.9922 rel_q0p0078125 -256.0000 255.9922 FORMAT "%8.4" /end CHARACTERISTIC
/begin CHARACTERISTIC ATS_TrbCh_B1.CnvFac_C "Actuator test ATS_TrbCh_B1 / Factor used for conversion to/from internal scaling" VALUE 0x8058A6F0 Val_Ws32 4294967295.00 OneToOne -2147483648.00 2147483647.00 FORMAT "%13.2" /end CHARACTERISTIC
/begin CHARACTERISTIC ATS_TrbCh_B1.CnvOfs_C "Actuator test ATS_TrbCh_B1 / Offset used for conversion to/from internal scaling" VALUE 0x8058A6F4 Val_Ws16 65535.00 OneToOne -32768.00 32767.00 FORMAT "%8.2" /end CHARACTERISTIC
/begin CHARACTERISTIC ATS_TrbCh_B1.DfltVal_C "Actuator test ATS_TrbCh_B1 / Default value for standbytest" VALUE 0x8058A6F6 Val_Ws16 65535.00 OneToOne -32768.00 32767.00 FORMAT "%8.2" /end CHARACTERISTIC
/begin CHARACTERISTIC bdemodst_msg_C "GDI desired mode cranking" VALUE 0x8057E4AD RB_Val_Wu8 255.0 OneToOne 0.00 255.0 FORMAT "%5.1" /end CHARACTERISTIC
/begin CHARACTERISTIC BrkBst_pMaxIntkMnfldHiRng_C "Calibration label for Maximum intake manifold pressure for boost pressure control with higher range" VALUE 0x8057E4AE RB_Val_Wu16 5119.922 p_uw_q0p078 0.00 5119.922 FORMAT "%8.3" /end CHARACTERISTIC
/begin CHARACTERISTIC BrkPed_pForISABIdleStop_C "" VALUE 0x8057E4B0 RB_Val_Ws16 6553.500 Pres -3276.800 3276.700 FORMAT "%8.3" /end CHARACTERISTIC
/begin CHARACTERISTIC Brk_stEBBBrkDetn_C "" VALUE 0x8057E4B2 RB_Val_Wboolean 1.00000000000 B_TRUE 0.00 1.00000000000 FORMAT "%13.11" /end CHARACTERISTIC
/begin CHARACTERISTIC B_agrvg_msg_C "" VALUE 0x8057E4B3 RB_Val_Wu8 1.00000000000 B_TRUE 0.00 1.00000000000 FORMAT "%13.11" /end CHARACTERISTIC
/begin CHARACTERISTIC B_agrvsg_msg_C "calibration to update B_agrvsg_msg" VALUE 0x8057E4B4 RB_Val_Wu8 1.00000000000 B_TRUE 0.00 1.00000000000 FORMAT "%13.11" /end CHARACTERISTIC
/begin CHARACTERISTIC B_bkvnhom_msg_C "" VALUE 0x8057E4B5 RB_Val_Wu8 1.00000000000 B_TRUE 0.00 1.00000000000 FORMAT "%13.11" /end CHARACTERISTIC
/begin CHARACTERISTIC B_cdkvssc_msg_C "" VALUE 0x8057E4B6 RB_Val_Wu8 1.00000000000 B_TRUE 0.00 1.00000000000 FORMAT "%13.11" /end CHARACTERISTIC
/begin CHARACTERISTIC B_cdtesps_msg_C "Fuel pump calibration" VALUE 0x8057E4B7 RB_Val_Wu8 1.00000000000 B_TRUE 0.00 1.00000000000 FORMAT "%13.11" /end CHARACTERISTIC
/begin CHARACTERISTIC B_clradbbo_msg_C "calibration of B_clradbbo_msg" VALUE 0x8057E4B8 RB_Val_Wu8 1.00000000000 B_TRUE 0.00 1.00000000000 FORMAT "%13.11" /end CHARACTERISTIC
/begin CHARACTERISTIC B_disagrkd_msg_C "Condition EGR disable caused by catalyst diagnosis" VALUE 0x8057E4B9 RB_Val_Wu8 1.00000000000 B_TRUE 0.00 1.00000000000 FORMAT "%13.11" /end CHARACTERISTIC
/begin CHARACTERISTIC B_dtdisagr_msg_C "Sperrung AGR durch bei aktiver TEV-Prüfung Disabling of EGR by active CPV check" VALUE 0x8057E4BA RB_Val_Wu8 1.00000000000 B_TRUE 0.00 1.00000000000 FORMAT "%13.11" /end CHARACTERISTIC
/begin CHARACTERISTIC B_dteird_msg_C "" VALUE 0x8057E4BB RB_Val_Wu8 1.00000000000 B_TRUE 0.00 1.00000000000 FORMAT "%13.11" /end CHARACTERISTIC
/begin CHARACTERISTIC B_dtevact_msg_C "" VALUE 0x8057E4BC RB_Val_Wu8 1.00000000000 B_TRUE 0.00 1.00000000000 FORMAT "%13.11" /end CHARACTERISTIC
/begin CHARACTERISTIC B_eagrv_msg_C "" VALUE 0x8057E4BD RB_Val_Wu8 1.00000000000 B_TRUE 0.00 1.00000000000 FORMAT "%13.11" /end CHARACTERISTIC
/begin CHARACTERISTIC B_faagr_msg_C "" VALUE 0x8057E4BE RB_Val_Wu8 1.00000000000 B_TRUE 0.00 1.00000000000 FORMAT "%13.11" /end CHARACTERISTIC
/begin CHARACTERISTIC B_fabe_msg_C "Sw adapter calibration for B_fabe_msg" VALUE 0x8057E4BF RB_Val_Wu8 1.00000000000 B_TRUE 0.00 1.00000000000 FORMAT "%13.11" /end CHARACTERISTIC
/begin CHARACTERISTIC B_fates_msg_C "" VALUE 0x8057E4C0 RB_Val_Wu8 1.00000000000 B_TRUE 0.00 1.00000000000 FORMAT "%13.11" /end CHARACTERISTIC
/begin CHARACTERISTIC B_fststamap_msg_C "" VALUE 0x8057E4C1 RB_Val_Wu8 1.00000000000 B_TRUE 0.00 1.00000000000 FORMAT "%13.11" /end CHARACTERISTIC
/begin CHARACTERISTIC B_lradp1mn_msg_C "" VALUE 0x8057E4C2 RB_Val_Wboolean 1.00000000000 B_TRUE 0.00 1.00000000000 FORMAT "%13.11" /end CHARACTERISTIC
/begin CHARACTERISTIC B_lradp1mx_msg_C "" VALUE 0x8057E4C3 RB_Val_Wboolean 1.00000000000 B_TRUE 0.00 1.00000000000 FORMAT "%13.11" /end CHARACTERISTIC
/begin CHARACTERISTIC B_rkapp_msg_C "codeword parameter for variant management" VALUE 0x8057E4C4 RB_Val_Wu8 1.00000000000 B_TRUE 0.00 1.00000000000 FORMAT "%13.11" /end CHARACTERISTIC
/begin CHARACTERISTIC B_tavdkgg_msg_C "" VALUE 0x8057E4C5 RB_Val_Wu8 1.00000000000 B_TRUE 0.00 1.00000000000 FORMAT "%13.11" /end CHARACTERISTIC
/begin CHARACTERISTIC B_teftstft_msg_C "" VALUE 0x8057E4C6 RB_Val_Wu8 1.00000000000 B_TRUE 0.00 1.00000000000 FORMAT "%13.11" /end CHARACTERISTIC
/begin CHARACTERISTIC CACPmpRly_ATS.LimitTypeMsk_C "Actuator test CACPmpRly_ATS / Tester demand monitoring enable mask for actuators" VALUE 0x8058A6FC Val_Wu8 255.0 OneToOne 0.00 255.0 FORMAT "%5.1" /end CHARACTERISTIC
/begin CHARACTERISTIC CACPmpRly_ATS.CnvNorm_C "Actuator test CACPmpRly_ATS / Conversion norm used for conversion to/from internal scaling" VALUE 0x8058A6FD Val_Wu8 255.0 OneToOne 0.00 255.0 FORMAT "%5.1" /end CHARACTERISTIC
/begin CHARACTERISTIC CACPmpRly_ATS.LowLim_C "Actuator test CACPmpRly_ATS / Lower limit for monitoring" VALUE 0x8058A6FE Val_Ws16 65535.00 OneToOne -32768.00 32767.00 FORMAT "%8.2" /end CHARACTERISTIC
/begin CHARACTERISTIC CACPmpRly_ATS.UpLim_C "Actuator test CACPmpRly_ATS / Upper limit for monitoring" VALUE 0x8058A700 Val_Ws16 65535.00 OneToOne -32768.00 32767.00 FORMAT "%8.2" /end CHARACTERISTIC
/begin CHARACTERISTIC CACPmpRly_ATS.CnvFac_C "Actuator test CACPmpRly_ATS / Factor used for conversion to/from internal scaling" VALUE 0x8058A704 Val_Ws32 4294967295.00 OneToOne -2147483648.00 2147483647.00 FORMAT "%13.2" /end CHARACTERISTIC
/begin CHARACTERISTIC CACPmpRly_ATS.CnvOfs_C "Actuator test CACPmpRly_ATS / Offset used for conversion to/from internal scaling" VALUE 0x8058A708 Val_Ws16 65535.00 OneToOne -32768.00 32767.00 FORMAT "%8.2" /end CHARACTERISTIC
/begin CHARACTERISTIC CACPmpRly_ATS.DfltVal_C "Actuator test CACPmpRly_ATS / Default value for standbytest" VALUE 0x8058A70A Val_Ws16 65535.00 OneToOne -32768.00 32767.00 FORMAT "%8.2" /end CHARACTERISTIC
/begin CHARACTERISTIC CACPmp_ATS.LimitTypeMsk_C "Actuator test CACPmp_ATS / Tester demand monitoring enable mask for actuators" VALUE 0x8058A70C Val_Wu8 255.0 OneToOne 0.00 255.0 FORMAT "%5.1" /end CHARACTERISTIC
/begin CHARACTERISTIC CACPmp_ATS.CnvNorm_C "Actuator test CACPmp_ATS / Conversion norm used for conversion to/from internal scaling" VALUE 0x8058A70D Val_Wu8 255.0 OneToOne 0.00 255.0 FORMAT "%5.1" /end CHARACTERISTIC
/begin CHARACTERISTIC CACPmp_ATS.LowLim_C "Actuator test CACPmp_ATS / Lower limit for monitoring" VALUE 0x8058A70E Val_Wu16 99.99847 rel_uw_b100 0.00 99.99847 FORMAT "%8.5" /end CHARACTERISTIC
/begin CHARACTERISTIC CACPmp_ATS.UpLim_C "Actuator test CACPmp_ATS / Upper limit for monitoring" VALUE 0x8058A710 Val_Wu16 99.99847 rel_uw_b100 0.00 99.99847 FORMAT "%8.5" /end CHARACTERISTIC
/begin CHARACTERISTIC CACPmp_ATS.CnvFac_C "Actuator test CACPmp_ATS / Factor used for conversion to/from internal scaling" VALUE 0x8058A714 Val_Ws32 4294967295.00 OneToOne -2147483648.00 2147483647.00 FORMAT "%13.2" /end CHARACTERISTIC
/begin CHARACTERISTIC CACPmp_ATS.CnvOfs_C "Actuator test CACPmp_ATS / Offset used for conversion to/from internal scaling" VALUE 0x8058A718 Val_Ws16 65535.00 OneToOne -32768.00 32767.00 FORMAT "%8.2" /end CHARACTERISTIC
/begin CHARACTERISTIC CACPmp_ATS.DfltVal_C "Actuator test CACPmp_ATS / Default value for standbytest" VALUE 0x8058A71A Val_Wu16 65535.00 OneToOne 0.00 65535.00 FORMAT "%8.2" /end CHARACTERISTIC
/begin CHARACTERISTIC CByVlvB1_Test_ATS.LimitTypeMsk_C "Actuator test CByVlvB1_Test_ATS / Tester demand monitoring enable mask for actuators" VALUE 0x8058A71C Val_Wu8 255.0 OneToOne 0.00 255.0 FORMAT "%5.1" /end CHARACTERISTIC
/begin CHARACTERISTIC CByVlvB1_Test_ATS.CnvNorm_C "Actuator test CByVlvB1_Test_ATS / Conversion norm used for conversion to/from internal scaling" VALUE 0x8058A71D Val_Wu8 255.0 OneToOne 0.00 255.0 FORMAT "%5.1" /end CHARACTERISTIC
/begin CHARACTERISTIC CByVlvB1_Test_ATS.LowLim_C "Actuator test CByVlvB1_Test_ATS / Lower limit for monitoring" VALUE 0x8058A71E Val_Ws16 799.9878 Prc -400.0000 399.9878 FORMAT "%8.4" /end CHARACTERISTIC
/begin CHARACTERISTIC CByVlvB1_Test_ATS.UpLim_C "Actuator test CByVlvB1_Test_ATS / Upper limit for monitoring" VALUE 0x8058A720 Val_Ws16 799.9878 Prc -400.0000 399.9878 FORMAT "%8.4" /end CHARACTERISTIC
/begin CHARACTERISTIC CByVlvB1_Test_ATS.CnvFac_C "Actuator test CByVlvB1_Test_ATS / Factor used for conversion to/from internal scaling" VALUE 0x8058A724 Val_Ws32 4294967295.00 OneToOne -2147483648.00 2147483647.00 FORMAT "%13.2" /end CHARACTERISTIC
/begin CHARACTERISTIC CByVlvB1_Test_ATS.CnvOfs_C "Actuator test CByVlvB1_Test_ATS / Offset used for conversion to/from internal scaling" VALUE 0x8058A728 Val_Ws16 65535.00 OneToOne -32768.00 32767.00 FORMAT "%8.2" /end CHARACTERISTIC
/begin CHARACTERISTIC CByVlvB1_Test_ATS.DfltVal_C "Actuator test CByVlvB1_Test_ATS / Default value for standbytest" VALUE 0x8058A72A Val_Ws16 65535.00 OneToOne -32768.00 32767.00 FORMAT "%8.2" /end CHARACTERISTIC
/begin CHARACTERISTIC CDAGR "code word DAGR inactive (EURO-coding)" VALUE 0x8057E4C7 RB_Val_Wu8 255.0 dez 0.00 255.0 FORMAT "%5.1" /end CHARACTERISTIC
/begin CHARACTERISTIC CDEHFM "code word for activation of HFM Functions" VALUE 0x8057E4C8 RB_Val_Wu8 255.0 dez 0.00 255.0 FORMAT "%5.1" /end CHARACTERISTIC
/begin CHARACTERISTIC CDKVS "code word: DKVS active/inactive, CD..=0 -> no diagnosis" VALUE 0x8057E4C9 RB_Val_Wu8 255.0 dez 0.00 255.0 FORMAT "%5.1" /end CHARACTERISTIC
/begin CHARACTERISTIC CDLLR "code word DLLR inactive (EURO-coding), CD..=0 -> no diagnosis" VALUE 0x8057E4CA RB_Val_Wu8 255.0 dez 0.00 255.0 FORMAT "%5.1" /end CHARACTERISTIC
/begin CHARACTERISTIC CDTES "code word disable canister-purge monitoring (Euro coding), CD..=0 -> no dia." VALUE 0x8057E4CB RB_Val_Wu8 255.0 dez 0.00 255.0 FORMAT "%5.1" /end CHARACTERISTIC
/begin CHARACTERISTIC Clth_drFlt_C "Calibration label for Filtered Gradient of clutch pedal sensor" VALUE 0x8057E4CC RB_Val_Ws16 255.9961 Prc_Fact256 -128.0000 127.9961 FORMAT "%8.4" /end CHARACTERISTIC
/begin CHARACTERISTIC Clth_rKisspnt_C "calibration for Kiss point (Ratio of clutch at which the clutch torque is zero)" VALUE 0x8057E4CE RB_Val_Ws16 255.9961 Prc_Fact256 -128.0000 127.9961 FORMAT "%8.4" /end CHARACTERISTIC
/begin CHARACTERISTIC Clth_stClthExtd_C "calibration for Extended clutch pedal status" VALUE 0x8057E4D0 RB_Val_Wu8 255.0 OneToOne 0.00 255.0 FORMAT "%5.1" /end CHARACTERISTIC
/begin CHARACTERISTIC Clth_swtClthType_C "Switch to select the clutch signal source for calculation of 25% and 75% switching point" VALUE 0x8057E4D1 RB_Val_Wu8 255.0 OneToOne 0.00 255.0 FORMAT "%5.1" /end CHARACTERISTIC
/begin CHARACTERISTIC CoEOM_stEOMDesWoCatHtg_C "configuration for CoEOM_stEOMDesWoCatHtg" VALUE 0x8057E4D2 RB_Val_Wu16 7951.00000000 CoEOM_stEomStgTot_VERB 0.00 7951.00000000 FORMAT "%13.8" /end CHARACTERISTIC
/begin CHARACTERISTIC ComDCDC_stDiagCirc1_C "" VALUE 0x8057E4D4 RB_Val_Wu8 255.0 OneToOne 0.00 255.0 FORMAT "%5.1" /end CHARACTERISTIC
/begin CHARACTERISTIC ComDCDC_stDiagCirc2_C "" VALUE 0x8057E4D5 RB_Val_Wu8 255.0 OneToOne 0.00 255.0 FORMAT "%5.1" /end CHARACTERISTIC
/begin CHARACTERISTIC ComDCDC_stRxErr_C "Calibration for DCDC reception error flag (ID 0x10 Byte1 bit 3)" VALUE 0x8057E4D6 RB_Val_Wu8 255.0 OneToOne 0.00 255.0 FORMAT "%5.1" /end CHARACTERISTIC
/begin CHARACTERISTIC Com_flgACCNorm_C "" VALUE 0x8057E4D7 RB_Val_Wboolean 1.00000000000 B_TRUE 0.00 1.00000000000 FORMAT "%13.11" /end CHARACTERISTIC
/begin CHARACTERISTIC Com_flgEAT9Norm_C "" VALUE 0x8057E4D8 RB_Val_Wboolean 1.00000000000 B_TRUE 0.00 1.00000000000 FORMAT "%13.11" /end CHARACTERISTIC
/begin CHARACTERISTIC Com_flgManModIndcn_C "" VALUE 0x8057E4D9 RB_Val_Wu8 1.00000000000 B_TRUE 0.00 1.00000000000 FORMAT "%13.11" /end CHARACTERISTIC
/begin CHARACTERISTIC Com_numGearTrgt_C "Default value for target gear information recieved over CAN" VALUE 0x8057E4DA RB_Val_Wu8 255.0 OneToOne 0.00 255.0 FORMAT "%5.1" /end CHARACTERISTIC
/begin CHARACTERISTIC Com_rEEV1PosFb_C "" VALUE 0x8057E4DB RB_Val_Wu8 127.5 rel_ub_b127p5 0.00 127.5 FORMAT "%5.1" /end CHARACTERISTIC
/begin CHARACTERISTIC Com_stACCSpdUnit_C "Cal for Unit of speed of car for customizing" VALUE 0x8057E4DC RB_Val_Wu8 255.0 OneToOne 0.00 255.0 FORMAT "%5.1" /end CHARACTERISTIC
/begin CHARACTERISTIC Com_stADSSpdLim_C "ADS Speed Limit Request calibration" VALUE 0x8057E4DD RB_Val_Wu8 255.0 OneToOne 0.00 255.0 FORMAT "%5.1" /end CHARACTERISTIC
/begin CHARACTERISTIC Com_stATEnaCond_C "AT enable condition recieved over CAN" VALUE 0x8057E4DE RB_Val_Wu8 255.0 OneToOne 0.00 255.0 FORMAT "%5.1" /end CHARACTERISTIC
/begin CHARACTERISTIC Com_stATErr4_C "Status of AT failure in case of vehicle speed sensor defect" VALUE 0x8057E4DF RB_Val_Wu8 255.0 OneToOne 0.00 255.0 FORMAT "%5.1" /end CHARACTERISTIC
/begin CHARACTERISTIC Com_stATShftUpDwnReq_C "Calibration for AT Shift Indicator Lamp status" VALUE 0x8057E4E0 RB_Val_Wu8 255.0 OneToOne 0.00 255.0 FORMAT "%5.1" /end CHARACTERISTIC
/begin CHARACTERISTIC Com_stAYC_C "Default value for AYCB mode" VALUE 0x8057E4E1 RB_Val_Wu8 255.0 OneToOne 0.00 255.0 FORMAT "%5.1" /end CHARACTERISTIC
/begin CHARACTERISTIC Com_stCamHealDisp_C "Cal for Displaying of camera dirty" VALUE 0x8057E4E2 RB_Val_Wu8 255.0 OneToOne 0.00 255.0 FORMAT "%5.1" /end CHARACTERISTIC
/begin CHARACTERISTIC Com_stDispDmdEnvCdn_C "Cal for Request to display additional sign post information which is recognized. (R side)" VALUE 0x8057E4E3 RB_Val_Wu8 255.0 OneToOne 0.00 255.0 FORMAT "%5.1" /end CHARACTERISTIC
/begin CHARACTERISTIC Com_stDispDmdSignRi_C "Calibration for Display demand of sign in knowledge(R side)" VALUE 0x8057E4E4 RB_Val_Wu8 255.0 OneToOne 0.00 255.0 FORMAT "%5.1" /end CHARACTERISTIC
/begin CHARACTERISTIC Com_stEAT3Mon_C "Calibration for Status for EAT3 error monitoring" VALUE 0x8057E4E5 RB_Val_Wu8 255.0 OneToOne 0.00 255.0 FORMAT "%5.1" /end CHARACTERISTIC
/begin CHARACTERISTIC Com_stEngMapReq_C "Calibration for Com_stEngMapReq" VALUE 0x8057E4E6 RB_Val_Wu8 255.0 OneToOne 0.00 255.0 FORMAT "%5.1" /end CHARACTERISTIC
/begin CHARACTERISTIC Com_stEVPIdleStopFail_C "Calibration for Idle Stop Failure for EVP" VALUE 0x8057E4E7 RB_Val_Wu8 255.0 OneToOne 0.00 255.0 FORMAT "%5.1" /end CHARACTERISTIC
/begin CHARACTERISTIC Com_stEVPIdleStopReq_C "Calibration for Idle Stop enable disable Permission in EVP" VALUE 0x8057E4E8 RB_Val_Wu8 255.0 OneToOne 0.00 255.0 FORMAT "%5.1" /end CHARACTERISTIC
/begin CHARACTERISTIC Com_stISEBBFail_C "Dummy Calibration for EBB failure information from VSA" VALUE 0x8057E4E9 RB_Val_Wu8 255.0 OneToOne 0.00 255.0 FORMAT "%5.1" /end CHARACTERISTIC
/begin CHARACTERISTIC Com_stMonMET_C "cal for Error State in MET used for monitoring" VALUE 0x8057E4EA RB_Val_Wu8 255.0 OneToOne 0.00 255.0 FORMAT "%5.1" /end CHARACTERISTIC
/begin CHARACTERISTIC Com_stNotTxDrvgF_C "" VALUE 0x8057E4EB RB_Val_Wu8 255.0 OneToOne 0.00 255.0 FORMAT "%5.1" /end CHARACTERISTIC
/begin CHARACTERISTIC Com_tqDesENGT1Max_C "Calibration for maximum limit for Torque Demand by driver" VALUE 0x8057E4EC RB_Val_Ws16 6553.500 Trq -3276.800 3276.700 FORMAT "%8.3" /end CHARACTERISTIC
/begin CHARACTERISTIC Com_vDigVehMph_C "" VALUE 0x8057E4EE RB_Val_Wu8 255.0 Vel_CrCtl1_MPH 0.00 255.0 FORMAT "%5.1" /end CHARACTERISTIC
/begin CHARACTERISTIC Conv_tiLvrChgDrvRvs_CUR "Dummy curve used for calculation of Time debound of gear lever shift from drive to reverse" CURVE 0x8057E4F0 RB_Curve_S16_S16 655350.0 TimeDeb -327680.0 327670.0 FORMAT "%8.1"
 /begin AXIS_DESCR STD_AXIS NO_INPUT_QUANTITY Temp_Cels 14 -3549.940 3003.560 FORMAT "%8.3" DEPOSIT ABSOLUTE /end AXIS_DESCR
/end CHARACTERISTIC
/begin CHARACTERISTIC Conv_tiLvrChgRvsDrv_CUR "Dummy curve used for calculation of Time debound of gear lever shift from reverse to drive" CURVE 0x8057E52A RB_Curve_S16_S16 655350.0 TimeDeb -327680.0 327670.0 FORMAT "%8.1"
 /begin AXIS_DESCR STD_AXIS NO_INPUT_QUANTITY Temp_Cels 14 -3549.940 3003.560 FORMAT "%8.3" DEPOSIT ABSOLUTE /end AXIS_DESCR
/end CHARACTERISTIC
/begin CHARACTERISTIC Conv_tiRevLvrOffNeut_CUR "Dummy curve used for calculation of Debounce time when transition from reverse gear to Neutral." CURVE 0x8057E564 RB_Curve_S16_S16 655350.0 TimeDeb -327680.0 327670.0 FORMAT "%8.1"
 /begin AXIS_DESCR STD_AXIS NO_INPUT_QUANTITY Temp_Cels 14 -3549.940 3003.560 FORMAT "%8.3" DEPOSIT ABSOLUTE /end AXIS_DESCR
/end CHARACTERISTIC
/begin CHARACTERISTIC Conv_tiRevLvrOffPark_CUR "Dummy curve used for calculation of Debounce time when transition from reverse gear to Park" CURVE 0x8057E59E RB_Curve_S16_S16 655350.0 TimeDeb -327680.0 327670.0 FORMAT "%8.1"
 /begin AXIS_DESCR STD_AXIS NO_INPUT_QUANTITY Temp_Cels 14 -3549.940 3003.560 FORMAT "%8.3" DEPOSIT ABSOLUTE /end AXIS_DESCR
/end CHARACTERISTIC
/begin CHARACTERISTIC Conv_tqResvTDpdtDRACOn_CUR "Dummy curve used for calucatation of Temperature dependant reserve torque of gear lever shift from drive to reverse and vice versa when AC on" CURVE 0x8057E5D8 RB_Curve_S16_S16 6553.500 Trq -3276.800 3276.700 FORMAT "%8.3"
 /begin AXIS_DESCR STD_AXIS NO_INPUT_QUANTITY Temp_Cels 14 -3549.940 3003.560 FORMAT "%8.3" DEPOSIT ABSOLUTE /end AXIS_DESCR
/end CHARACTERISTIC
/begin CHARACTERISTIC Conv_tqResvTDpdtDR_CUR "Dummy curve used for calucatation of Temperature dependant reserve torque of gear lever shift from drive to reverse and vice versa when AC off" CURVE 0x8057E612 RB_Curve_S16_S16 6553.500 Trq -3276.800 3276.700 FORMAT "%8.3"
 /begin AXIS_DESCR STD_AXIS NO_INPUT_QUANTITY Temp_Cels 14 -3549.940 3003.560 FORMAT "%8.3" DEPOSIT ABSOLUTE /end AXIS_DESCR
/end CHARACTERISTIC
/begin CHARACTERISTIC CPV_ADDCTL_ATS_ATS.LimitTypeMsk_C "Actuator test CPV_ADDCTL_ATS_ATS / Tester demand monitoring enable mask for actuators" VALUE 0x8058A72C Val_Wu8 255.0 OneToOne 0.00 255.0 FORMAT "%5.1" /end CHARACTERISTIC
/begin CHARACTERISTIC CPV_ADDCTL_ATS_ATS.CnvNorm_C "Actuator test CPV_ADDCTL_ATS_ATS / Conversion norm used for conversion to/from internal scaling" VALUE 0x8058A72D Val_Wu8 255.0 OneToOne 0.00 255.0 FORMAT "%5.1" /end CHARACTERISTIC
/begin CHARACTERISTIC CPV_ADDCTL_ATS_ATS.LowLim_C "Actuator test CPV_ADDCTL_ATS_ATS / Lower limit for monitoring" VALUE 0x8058A72E Val_Wu16 99.99847 rel_uw_b100 0.00 99.99847 FORMAT "%8.5" /end CHARACTERISTIC
/begin CHARACTERISTIC CPV_ADDCTL_ATS_ATS.UpLim_C "Actuator test CPV_ADDCTL_ATS_ATS / Upper limit for monitoring" VALUE 0x8058A730 Val_Wu16 99.99847 rel_uw_b100 0.00 99.99847 FORMAT "%8.5" /end CHARACTERISTIC
/begin CHARACTERISTIC CPV_ADDCTL_ATS_ATS.CnvFac_C "Actuator test CPV_ADDCTL_ATS_ATS / Factor used for conversion to/from internal scaling" VALUE 0x8058A734 Val_Ws32 4294967295.00 OneToOne -2147483648.00 2147483647.00 FORMAT "%13.2" /end CHARACTERISTIC
/begin CHARACTERISTIC CPV_ADDCTL_ATS_ATS.CnvOfs_C "Actuator test CPV_ADDCTL_ATS_ATS / Offset used for conversion to/from internal scaling" VALUE 0x8058A738 Val_Ws16 65535.00 OneToOne -32768.00 32767.00 FORMAT "%8.2" /end CHARACTERISTIC
/begin CHARACTERISTIC CPV_ADDCTL_ATS_ATS.DfltVal_C "Actuator test CPV_ADDCTL_ATS_ATS / Default value for standbytest" VALUE 0x8058A73A Val_Wu16 65535.00 OneToOne 0.00 65535.00 FORMAT "%8.2" /end CHARACTERISTIC
/begin CHARACTERISTIC CrCtl_stIDASTqModFailr_C "" VALUE 0x8057E64C RB_Val_Wu8 255.0 OneToOne 0.00 255.0 FORMAT "%5.1" /end CHARACTERISTIC
/begin CHARACTERISTIC CrCUI_stPlusRDrvMod_C "" VALUE 0x8057E64D RB_Val_Wboolean 1.000 OneToOne 0.00 1.000 FORMAT "%5.3" EXTENDED_LIMITS 0.00 255.0 /end CHARACTERISTIC
/begin CHARACTERISTIC CWAGR "Code word for EGR on/off" VALUE 0x8057E64E RB_Val_Wu8 255.0 dez 0.00 255.0 FORMAT "%5.1" /end CHARACTERISTIC
/begin CHARACTERISTIC CWKTAGRA "codeword short circuit test egr" VALUE 0x8057E64F RB_Val_Wu8 255.0 dez 0.00 255.0 FORMAT "%5.1" /end CHARACTERISTIC
/begin CHARACTERISTIC CWRR "Codeword for evaluation of the inert gas rate" VALUE 0x8057E650 RB_Val_Wu8 255.0 dez 0.00 255.0 FORMAT "%5.1" /end CHARACTERISTIC
/begin CHARACTERISTIC CW_CY329_Boost_Perm_On_Test "" VALUE 0x8057E651 RB_Val_Wu8 255.0 OneToOne 0.00 255.0 FORMAT "%5.1" /end CHARACTERISTIC
/begin CHARACTERISTIC CW_EGRVlv_r_Test "" VALUE 0x8057E652 RB_Val_Ws16 799.9878 Prc -400.0000 399.9878 FORMAT "%8.4" /end CHARACTERISTIC
/begin CHARACTERISTIC Dspl_stCrsASLSelInfo_C "Cal for Cruise Control ASL select information" VALUE 0x8057E654 RB_Val_Wu8 255.0 OneToOne 0.00 255.0 FORMAT "%5.1" /end CHARACTERISTIC
/begin CHARACTERISTIC DWOGVE "Open angle: gas exch. vlv. intake closes to intake opens" VALUE 0x8057E656 RB_Val_Ws16 1023.984 kw_q0p0156 -512.0000 511.9844 FORMAT "%8.4" /end CHARACTERISTIC
/begin CHARACTERISTIC EGRVlv_rGovDesVal_C "" VALUE 0x8057E658 RB_Val_Ws16 799.9878 Prc -400.0000 399.9878 FORMAT "%8.4" /end CHARACTERISTIC
/begin CHARACTERISTIC EGRVlv_tiGovDesDelay_C "" VALUE 0x8057E65C RB_Val_Wu32 4294967.29500 t_q0p001 0.00 4294967.29500 FORMAT "%13.5" /end CHARACTERISTIC
/begin CHARACTERISTIC ElecLd_stSRCChk_C "" VALUE 0x8057E660 RB_Val_Wu8 255.0 OneToOne 0.00 255.0 FORMAT "%5.1" /end CHARACTERISTIC
/begin CHARACTERISTIC ElM_tqActWoAcsyCmp_C "" VALUE 0x8057E662 RB_Val_Ws16 6553.500 Trq -3276.800 3276.700 FORMAT "%8.3" /end CHARACTERISTIC
/begin CHARACTERISTIC ESS_bEngStrtEna_C "Calibration for enablingdisabling start release from the electrical system" VALUE 0x8057E664 RB_Val_Wu8 1.00000000000 B_TRUE 0.00 1.00000000000 FORMAT "%13.11" /end CHARACTERISTIC
/begin CHARACTERISTIC etakhtrp_w_msg_C "" VALUE 0x8057E666 RB_Val_Wu16 1.999969 fak_uw_b2 0.00 1.999969 FORMAT "%8.6" /end CHARACTERISTIC
/begin CHARACTERISTIC ExhMgT_flgRelsLamCptProtn_C "" VALUE 0x8057E668 RB_Val_Wu8 1.00000000000 B_TRUE 0.00 1.00000000000 FORMAT "%13.11" /end CHARACTERISTIC
/begin CHARACTERISTIC ExhMod_flgStTMdlIninCat1B1_C "Sw adapters equivalent calibration" VALUE 0x8057E669 RB_Val_Wu8 1.00000000000 B_TRUE 0.00 1.00000000000 FORMAT "%13.11" /end CHARACTERISTIC
/begin CHARACTERISTIC ExhMod_flgStTMdlIninCat2B1_C "" VALUE 0x8057E66A RB_Val_Wu8 1.00000000000 B_TRUE 0.00 1.00000000000 FORMAT "%13.11" /end CHARACTERISTIC
/begin CHARACTERISTIC ExhMod_uThresRichPurgO2StrgCat1_C "Voltage threshold cat purge" VALUE 0x8057E66B RB_Val_Wu8 1.245 spg_q0p00488 0.00 1.245 FORMAT "%5.3" /end CHARACTERISTIC
/begin CHARACTERISTIC FfPrm_flgModCalc_msg_C "" VALUE 0x8057E66C RB_Val_Wu8 1.00000000000 B_TRUE 0.00 1.00000000000 FORMAT "%13.11" /end CHARACTERISTIC
/begin CHARACTERISTIC FKFUPSFET "Factor correction conversion pressure to charge depending on ethanol rate" CURVE 0x8057E66E RB_Curve_U16_U16 1.999969 fak_uw_b2 0.00 1.999969 FORMAT "%8.6"
 /begin AXIS_DESCR STD_AXIS NO_INPUT_QUANTITY fak_uw_b2 2 0.00 1.999969 FORMAT "%8.6" DEPOSIT ABSOLUTE /end AXIS_DESCR
/end CHARACTERISTIC
/begin CHARACTERISTIC flamlu_w_msg_C "flamlu_w_msg calibration" VALUE 0x8057E678 RB_Val_Wu16 15.99976 fak_uw_b16 0.00 15.99976 FORMAT "%8.5" /end CHARACTERISTIC
/begin CHARACTERISTIC FlMA_flgIninFinshdBGAUSG_C "" VALUE 0x8057E67A RB_Val_Wu8 1.00000000000 B_TRUE 0.00 1.00000000000 FORMAT "%13.11" /end CHARACTERISTIC
/begin CHARACTERISTIC FlMA_flgIninFinshdLAMKORRLL_C "" VALUE 0x8057E67B RB_Val_Wu8 1.00000000000 B_TRUE 0.00 1.00000000000 FORMAT "%13.11" /end CHARACTERISTIC
/begin CHARACTERISTIC FuPHi_flgOnOffCtrlFadeOut_C "calibration to update FuPHi_flgOnOffCtrlFadeOut" VALUE 0x8057E67C RB_Val_Wu8 1.00000000000 B_TRUE 0.00 1.00000000000 FORMAT "%13.11" /end CHARACTERISTIC
/begin CHARACTERISTIC GbxRevLck_ATS.LimitTypeMsk_C "Actuator test GbxRevLck_ATS / Tester demand monitoring enable mask for actuators" VALUE 0x8058A78C Val_Wu8 255.0 OneToOne 0.00 255.0 FORMAT "%5.1" /end CHARACTERISTIC
/begin CHARACTERISTIC GbxRevLck_ATS.CnvNorm_C "Actuator test GbxRevLck_ATS / Conversion norm used for conversion to/from internal scaling" VALUE 0x8058A78D Val_Wu8 255.0 OneToOne 0.00 255.0 FORMAT "%5.1" /end CHARACTERISTIC
/begin CHARACTERISTIC GbxRevLck_ATS.LowLim_C "Actuator test GbxRevLck_ATS / Lower limit for monitoring" VALUE 0x8058A78E Val_Ws16 65535.00 OneToOne -32768.00 32767.00 FORMAT "%8.2" /end CHARACTERISTIC
/begin CHARACTERISTIC GbxRevLck_ATS.UpLim_C "Actuator test GbxRevLck_ATS / Upper limit for monitoring" VALUE 0x8058A790 Val_Ws16 65535.00 OneToOne -32768.00 32767.00 FORMAT "%8.2" /end CHARACTERISTIC
/begin CHARACTERISTIC GbxRevLck_ATS.CnvFac_C "Actuator test GbxRevLck_ATS / Factor used for conversion to/from internal scaling" VALUE 0x8058A794 Val_Ws32 4294967295.00 OneToOne -2147483648.00 2147483647.00 FORMAT "%13.2" /end CHARACTERISTIC
/begin CHARACTERISTIC GbxRevLck_ATS.CnvOfs_C "Actuator test GbxRevLck_ATS / Offset used for conversion to/from internal scaling" VALUE 0x8058A798 Val_Ws16 65535.00 OneToOne -32768.00 32767.00 FORMAT "%8.2" /end CHARACTERISTIC
/begin CHARACTERISTIC GbxRevLck_ATS.DfltVal_C "Actuator test GbxRevLck_ATS / Default value for standbytest" VALUE 0x8058A79A Val_Ws16 65535.00 OneToOne -32768.00 32767.00 FORMAT "%8.2" /end CHARACTERISTIC
/begin CHARACTERISTIC Gbx_bATSlipOpn_C "" VALUE 0x8057E67D RB_Val_Wu8 1.00000000000 B_TRUE 0.00 1.00000000000 FORMAT "%13.11" /end CHARACTERISTIC
/begin CHARACTERISTIC Gbx_bNCmp_C "" VALUE 0x8057E67E RB_Val_Wboolean 1.00000000000 B_TRUE 0.00 1.00000000000 FORMAT "%13.11" /end CHARACTERISTIC
/begin CHARACTERISTIC Gbx_bTIIIntv_C "calibration to update Gbx_bTIIIntv" VALUE 0x8057E67F RB_Val_Wu8 1.00000000000 B_TRUE 0.00 1.00000000000 FORMAT "%13.11" /end CHARACTERISTIC
/begin CHARACTERISTIC Gbx_flgNCtrlImp_C "Calibration for Operation of N control execution flag" VALUE 0x8057E680 RB_Val_Wboolean 1.00000000000 B_TRUE 0.00 1.00000000000 FORMAT "%13.11" /end CHARACTERISTIC
/begin CHARACTERISTIC Gbx_flgNCtrlRetStrt_C "Calibration for N control return judgement flag at brake ON" VALUE 0x8057E681 RB_Val_Wboolean 1.00000000000 B_TRUE 0.00 1.00000000000 FORMAT "%13.11" /end CHARACTERISTIC
/begin CHARACTERISTIC Gbx_nRrngEngSpdInh_C "Calibration for Gbx_nRrngEngSpdInh" VALUE 0x8057E682 RB_Val_Ws16 32767.50 EngN -16384.00 16383.50 FORMAT "%8.2" /end CHARACTERISTIC
/begin CHARACTERISTIC Gbx_rConvSlip_C "Cal for Transmission torque converter slip" VALUE 0x8057E684 RB_Val_Ws16 327.6750 CrCtlSlipRat -163.8400 163.8350 FORMAT "%8.4" /end CHARACTERISTIC
/begin CHARACTERISTIC Gbx_trqActClth_C "calibration to update Gbx_trqActClth" VALUE 0x8057E686 RB_Val_Ws16 3276.700 Trq 0.00 3276.700 FORMAT "%8.3" EXTENDED_LIMITS -3276.800 3276.700 /end CHARACTERISTIC
/begin CHARACTERISTIC Gbx_uAPPMaxLrn_C "Calibration for Gearbox AT accelerator max learned voltage" VALUE 0x8057E688 RB_Val_Ws16 1310700. Volt_Batt -655360.0 655340.0 FORMAT "%8.1" /end CHARACTERISTIC
/begin CHARACTERISTIC GEVCtl_agWidthCamProfLoLftIntk_C "Width of the intake valve cam profile (small cam) referred to 0.5mm lift" VALUE 0x8057E68A RB_Val_Ws16 1023.984 kw_q0p0156 -512.0000 511.9844 FORMAT "%8.4" /end CHARACTERISTIC
/begin CHARACTERISTIC GEVlv_agExtrpnOutlB1_C "Dummy calibration parameter to fix open interface in SWAdp" VALUE 0x8057E68C RB_Val_Ws16 511.9844 kw_q0p0156 0.00 511.9844 FORMAT "%8.4" EXTENDED_LIMITS -512.0000 511.9844 /end CHARACTERISTIC
/begin CHARACTERISTIC GEVlv_agOutlB1_C "calibration of GEVlv_agOutlB1" VALUE 0x8057E68E RB_Val_Ws16 511.9844 kw_q0p0156 0.00 511.9844 FORMAT "%8.4" EXTENDED_LIMITS -512.0000 511.9844 /end CHARACTERISTIC
/begin CHARACTERISTIC HEGO_flgReIniSnsrTMdl_C "ReInitialization of sensor temperature model is activated" VALUE 0x8057E690 RB_Val_Wu8 1.00000000000 B_TRUE 0.00 1.00000000000 FORMAT "%13.11" /end CHARACTERISTIC
/begin CHARACTERISTIC HEGO_resRiMaxPlaus_C "maximum plausible Ri, above which an open signal line can be expected" VALUE 0x8057E692 RB_Val_Wu16 131070.0 r_uw_q2 0.00 131070.0 FORMAT "%8.1" /end CHARACTERISTIC
/begin CHARACTERISTIC I14229iocbiCrCtl1_stVal_C "Calibration for Status of CrCtl 1 SFT" VALUE 0x8057E694 RB_Val_Wu16 65535.00 OneToOne 0.00 65535.00 FORMAT "%8.2" /end CHARACTERISTIC
/begin CHARACTERISTIC I14229iocbiCrCtl_stVal_C "Calibration for Status of Cruise control lamp SFT" VALUE 0x8057E696 RB_Val_Wu16 65535.00 OneToOne 0.00 65535.00 FORMAT "%8.2" /end CHARACTERISTIC
/begin CHARACTERISTIC I14229_stAutoStrtEna_C "status indicate Auto Start is supported" VALUE 0x8057E698 RB_Val_Wu8 255.0 OneToOne 0.00 255.0 FORMAT "%5.1" /end CHARACTERISTIC
/begin CHARACTERISTIC I14229_stShipModActv_C "" VALUE 0x8057E699 RB_Val_Wboolean 1.00000000000 B_TRUE 0.00 1.00000000000 FORMAT "%13.11" /end CHARACTERISTIC
/begin CHARACTERISTIC I14229_stShipMod_C "" VALUE 0x8057E69A RB_Val_Wu8 2.00000000000 I14229_SHIPMOD_VERB 0.00 2.00000000000 FORMAT "%13.11" /end CHARACTERISTIC
/begin CHARACTERISTIC Ign_IgnAgDplKnkLimn_M "Ignition angle correction due to knock limit shif (word)" MAP 0x8057E69C RB_Map_U16U16_S16 6553.500 zw_q0p1 -3276.800 3276.700 FORMAT "%8.3"
 /begin AXIS_DESCR STD_AXIS NO_INPUT_QUANTITY nmot_sw_q0p25 8 0.00 16383.75 FORMAT "%8.2" DEPOSIT ABSOLUTE /end AXIS_DESCR
 /begin AXIS_DESCR STD_AXIS NO_INPUT_QUANTITY fak_uw_b16 12 0.00 15.99976 FORMAT "%8.5" DEPOSIT ABSOLUTE /end AXIS_DESCR
/end CHARACTERISTIC
/begin AXIS_PTS Ign_nEng20_AX "Distribution dependent of Epm_nEng(20)" 0x8057E788 Epm_nEng RB_Axis_S16 32767.50 EngN 20 -16384.00 16383.50 FORMAT "%8.2" DEPOSIT ABSOLUTE /end AXIS_PTS
/begin AXIS_PTS Ign_nEngVS12_AX "engine speed dep.map" 0x8057E7B2 Epm_nEng RB_Axis_S16 32767.50 EngN 20 -16384.00 16383.50 FORMAT "%8.2" DEPOSIT ABSOLUTE /end AXIS_PTS
/begin AXIS_PTS Ign_ratChrgAirVS12_AX "load dep. map" 0x8057E7DC Ign_ratChrgAirCyl RB_Axis_U16 1535.977 rel_q0p0234 12 0.00 1535.977 FORMAT "%8.3" DEPOSIT ABSOLUTE /end AXIS_PTS
/begin CHARACTERISTIC InjSys_facMixAdpnIdle_a_CA "Dummy calibration parameter to close open interface in SWAdp" VAL_BLK 0x8057E7F6 RB_ValA_Wu16 1.999969 fak_q3p0518Em5 0.00 1.999969 FORMAT "%8.6" NUMBER 4 /end CHARACTERISTIC
/begin CHARACTERISTIC InjSys_facPreIgnMix_a_CA "" VAL_BLK 0x8057E7FE RB_ValA_Wu16 1.999969 fak_uw_b2 0.00 1.999969 FORMAT "%8.6" NUMBER 4 /end CHARACTERISTIC
/begin CHARACTERISTIC InjSys_idxVcosPntTran_C "Index-point viscosity transition range CVO" VALUE 0x8057E806 RB_Val_Wu8 255.0 dez 0.00 255.0 FORMAT "%5.1" /end CHARACTERISTIC
/begin CHARACTERISTIC InjSys_stTranTPist_1 "" VALUE 0x8057E807 RB_Val_Wu8 255.0 OneToOne 0.00 255.0 FORMAT "%5.1" /end CHARACTERISTIC
/begin CHARACTERISTIC LAS_facRoadGrdt_C "Calibration label for Factor for Road gradient" VALUE 0x8057E808 RB_Val_Ws16 327.6700 Prc_Fact100 0.00 327.6700 FORMAT "%8.4" EXTENDED_LIMITS -327.6800 327.6700 /end CHARACTERISTIC
/begin CHARACTERISTIC NSWO1 "engine-speed threshold 1 for switching calculation" VALUE 0x8057E80A RB_Val_Wu8 10200. nmot_ub_q40 0.00 10200. FORMAT "%5.0" /end CHARACTERISTIC
/begin CHARACTERISTIC NSWO2 "engine-speed threshold 2 for switching calculation" VALUE 0x8057E80B RB_Val_Wu8 10200. nmot_ub_q40 0.00 10200. FORMAT "%5.0" /end CHARACTERISTIC
/begin CHARACTERISTIC PCR_pDesVal_C "desired boost pressure" VALUE 0x8057E80C RB_Val_Ws16 65535.00 Pres_hPa -32768.00 32767.00 FORMAT "%8.2" /end CHARACTERISTIC
/begin CHARACTERISTIC PHAACTROUTL_CTL_ATS_ATS.LimitTypeMsk_C "Actuator test PHAACTROUTL_CTL_ATS_ATS / Tester demand monitoring enable mask for actuators" VALUE 0x8058A83C Val_Wu8 255.0 OneToOne 0.00 255.0 FORMAT "%5.1" /end CHARACTERISTIC
/begin CHARACTERISTIC PHAACTROUTL_CTL_ATS_ATS.CnvNorm_C "Actuator test PHAACTROUTL_CTL_ATS_ATS / Conversion norm used for conversion to/from internal scaling" VALUE 0x8058A83D Val_Wu8 255.0 OneToOne 0.00 255.0 FORMAT "%5.1" /end CHARACTERISTIC
/begin CHARACTERISTIC PHAACTROUTL_CTL_ATS_ATS.LowLim_C "Actuator test PHAACTROUTL_CTL_ATS_ATS / Lower limit for monitoring" VALUE 0x8058A83E Val_Ws16 1023.984 kw_q0p0156 -512.0000 511.9844 FORMAT "%8.4" /end CHARACTERISTIC
/begin CHARACTERISTIC PHAACTROUTL_CTL_ATS_ATS.UpLim_C "Actuator test PHAACTROUTL_CTL_ATS_ATS / Upper limit for monitoring" VALUE 0x8058A840 Val_Ws16 1023.984 kw_q0p0156 -512.0000 511.9844 FORMAT "%8.4" /end CHARACTERISTIC
/begin CHARACTERISTIC PHAACTROUTL_CTL_ATS_ATS.CnvFac_C "Actuator test PHAACTROUTL_CTL_ATS_ATS / Factor used for conversion to/from internal scaling" VALUE 0x8058A844 Val_Ws32 4294967295.00 OneToOne -2147483648.00 2147483647.00 FORMAT "%13.2" /end CHARACTERISTIC
/begin CHARACTERISTIC PHAACTROUTL_CTL_ATS_ATS.CnvOfs_C "Actuator test PHAACTROUTL_CTL_ATS_ATS / Offset used for conversion to/from internal scaling" VALUE 0x8058A848 Val_Ws16 65535.00 OneToOne -32768.00 32767.00 FORMAT "%8.2" /end CHARACTERISTIC
/begin CHARACTERISTIC PHAACTROUTL_CTL_ATS_ATS.DfltVal_C "Actuator test PHAACTROUTL_CTL_ATS_ATS / Default value for standbytest" VALUE 0x8058A84A Val_Ws16 65535.00 OneToOne -32768.00 32767.00 FORMAT "%8.2" /end CHARACTERISTIC
/begin CHARACTERISTIC psmxbkvg_w_msg_C "" VALUE 0x8057E80E RB_Val_Wu16 2559.961 p_uw_q0p039 0.00 2559.961 FORMAT "%8.3" /end CHARACTERISTIC
/begin CHARACTERISTIC PTDist_flgCrkSftMintqSeln_C "Calibration to select minimum accessible engine torque" VALUE 0x8057E810 RB_Val_Wu8 1.00000000000 B_TRUE 0.00 1.00000000000 FORMAT "%13.11" /end CHARACTERISTIC
/begin CHARACTERISTIC PTDist_flgEnaTCMFCOReqByp_C "Powertrain flag Enable TCM FCO Request Bypass" VALUE 0x8057E811 RB_Val_Wu8 1.00000000000 B_TRUE 0.00 1.00000000000 FORMAT "%13.11" /end CHARACTERISTIC
/begin CHARACTERISTIC PTDist_tqdeltaTCMFCOReq_C "Powertrain Torque Delta TCM FCO Request" VALUE 0x8057E812 RB_Val_Ws16 6553.500 md_q0p1 -3276.800 3276.700 FORMAT "%8.3" /end CHARACTERISTIC
/begin CHARACTERISTIC PthSet_trqInrWoIntv_C "" VALUE 0x8057E814 RB_Val_Ws16 3276.700 Trq 0.00 3276.700 FORMAT "%8.3" EXTENDED_LIMITS -3276.800 3276.700 /end CHARACTERISTIC
/begin CHARACTERISTIC StrtCtl_bFstStrtCtOff_C "Parameter to enable fast starter cut off at direct start" VALUE 0x8057E816 RB_Val_Wu8 1.00000000000 B_TRUE 0.00 1.00000000000 FORMAT "%13.11" /end CHARACTERISTIC
/begin CHARACTERISTIC SWAdp_dnEngCoM2_T "" CURVE 0x8057E818 RB_Curve_S16_S16 32767.50 EngN -16384.00 16383.50 FORMAT "%8.2"
 /begin AXIS_DESCR STD_AXIS HLSDem_nSetPLo EngN 4 -16384.00 16383.50 FORMAT "%8.2" DEPOSIT ABSOLUTE /end AXIS_DESCR
/end CHARACTERISTIC
/begin CHARACTERISTIC SWAdp_nEngCoM2_M "" MAP 0x8057E82A RB_Map_U16S16_S16 32767.50 EngN -16384.00 16383.50 FORMAT "%8.2"
 /begin AXIS_DESCR STD_AXIS PEnv_p p_sw_q0p039 5 0.00 2559.961 FORMAT "%8.3" DEPOSIT ABSOLUTE /end AXIS_DESCR
 /begin AXIS_DESCR STD_AXIS EngStrt_tStrtCoor Temp_Cels 5 -273.140 3003.560 FORMAT "%8.3" EXTENDED_LIMITS -3549.940 3003.560 DEPOSIT ABSOLUTE /end AXIS_DESCR
/end CHARACTERISTIC
/begin CHARACTERISTIC SWAdp_swtTrqSeIn_C "" VALUE 0x8057E874 RB_Val_Wboolean 1.00000000000 B_TRUE 0.00 1.00000000000 FORMAT "%13.11" /end CHARACTERISTIC
/begin CHARACTERISTIC SysDiag_SwtCModEnbl_C "Activation switch for Certification mode calculation" VALUE 0x8057EC76 RB_Val_Wu8 255.0 OneToOne 0.00 255.0 FORMAT "%5.1" /end CHARACTERISTIC
/begin CHARACTERISTIC SysDiag_tiCModEng_C "Time duration for Certification mode calculation" VALUE 0x8057EC78 RB_Val_Wu16 655.3500 t_q0p01 0.00 655.3500 FORMAT "%8.4" /end CHARACTERISTIC
/begin CHARACTERISTIC tfuelsq_C "" VALUE 0x8057E875 RB_Val_Wu8 191.3 temp_ub_q0p75_o48 -48.0 143.3 FORMAT "%5.1" /end CHARACTERISTIC
/begin CHARACTERISTIC TGAGRVMAX "max. exhaust gas temperature at egr valve" VALUE 0x8057E876 RB_Val_Wu16 1535.977 temp_q0p0234_o273 -273.150 1262.827 FORMAT "%8.3" /end CHARACTERISTIC
/begin CHARACTERISTIC THS2ME_stConf_CW "Codeword: Configuration of THS2ME" VALUE 0x8057E878 RB_Val_Wu8 255.0 dez 0.00 255.0 FORMAT "%5.1" /end CHARACTERISTIC
/begin CHARACTERISTIC tolc_msg_C "" VALUE 0x8057E879 RB_Val_Wu8 255.0 temp_ub_q1_o60 -60.0 195.0 FORMAT "%5.1" /end CHARACTERISTIC
/begin CHARACTERISTIC tumc_msg_C "calibration for Ambient temperature received CAN message" VALUE 0x8057E87A RB_Val_Wu8 191.3 temp_ub_q0p75_o48 -48.0 143.3 FORMAT "%5.1" /end CHARACTERISTIC
/begin CHARACTERISTIC UEGO_flgAirScav_C "" VALUE 0x8057E87B RB_Val_Wu8 1.00000000000 B_TRUE 0.00 1.00000000000 FORMAT "%13.11" /end CHARACTERISTIC
/begin CHARACTERISTIC VehMot_tqCluDesGenericLimn_C "configuration for VehMot_tqCluDesGenericLimn" VALUE 0x8057E87C RB_Val_Ws16 6553.500 Trq -3276.800 3276.700 FORMAT "%8.3" /end CHARACTERISTIC
/begin CHARACTERISTIC VehMot_tqCluLeadGenericLimn_C "configuration for VehMot_tqCluLeadGenericLimn" VALUE 0x8057E87E RB_Val_Ws16 6553.500 Trq -3276.800 3276.700 FORMAT "%8.3" /end CHARACTERISTIC
/begin CHARACTERISTIC VF2ME_THRESBKOE_C "threshold value torque demand for air condition compressor" VALUE 0x8057E880 RB_Val_Ws16 6553.500 Trq -3276.800 3276.700 FORMAT "%8.3" /end CHARACTERISTIC
/begin CHARACTERISTIC ZWAPPL "Application interface ignition angle adjustment" VALUE 0x8057E882 RB_Val_Ws8 191.3 kw_q0p75 -96.00 95.25 FORMAT "%5.2" /end CHARACTERISTIC
/begin MEASUREMENT ACCI_aReq "acceleration request from ACC" SWORD Acc 1 100 -32.76800 32.76700 FORMAT "%8.5" ECU_ADDRESS 0x60000626 /end MEASUREMENT
/begin MEASUREMENT ACCI_bACCPrs "Adaptive Cruise Control present status" UBYTE B_TRUE 1 100 0.00 1.00000000000 BIT_MASK 0x1 FORMAT "%13.11" ECU_ADDRESS 0x70000C5A /end MEASUREMENT
/begin MEASUREMENT ACCI_stReq "Status of acceleration request" UBYTE OneToOne 1 100 0.00 255.0 FORMAT "%5.1" ECU_ADDRESS 0x6000F056 /end MEASUREMENT
/begin MEASUREMENT ACCI_trqDes "desired torque from ACC" SLONG TrqPrpHigh 1 100 -214748364.800 214748364.700 FORMAT "%13.3" ECU_ADDRESS 0x600037B4 /end MEASUREMENT
/begin MEASUREMENT AccPed_flgIDSFctAvl "Integrated Dynamic System functional is available" UBYTE B_TRUE 1 100 0.00 1.00000000000 BIT_MASK 0x1 FORMAT "%13.11" ECU_ADDRESS 0x70000C4E /end MEASUREMENT
/begin MEASUREMENT AccPed_flgVehSpedSigFailr "Vehicle speed signal failure flag" UBYTE B_TRUE 1 100 0.00 1.00000000000 BIT_MASK 0x1 FORMAT "%13.11" ECU_ADDRESS 0x6000F28F /end MEASUREMENT
/begin MEASUREMENT AccPed_tqBasEng "Base torque value for IMT" SWORD Trq 1 100 -3276.800 3276.700 FORMAT "%8.3" ECU_ADDRESS 0x600093CC /end MEASUREMENT
/begin MEASUREMENT ACCtl_stDecelACCutDmd "Deceleration AC CUT demand" UBYTE B_TRUE 1 100 0.00 1.00000000000 BIT_MASK 0x1 FORMAT "%13.11" ECU_ADDRESS 0x70000C57 /end MEASUREMENT
/begin MEASUREMENT ACC_bExsMinDstBrkReq "Status indicating distance in minimum" UBYTE OneToOne 1 100 0.00 255.0 FORMAT "%5.1" ECU_ADDRESS 0x6000F7A9 /end MEASUREMENT
/begin MEASUREMENT ACC_bFail "ACC fail status" UBYTE OneToOne 1 100 0.00 255.0 FORMAT "%5.1" ECU_ADDRESS 0x6000F7A8 /end MEASUREMENT
/begin MEASUREMENT ACC_bFrtCar "Status indicating vehicle in front" UBYTE OneToOne 1 100 0.00 255.0 FORMAT "%5.1" ECU_ADDRESS 0x6000F7A7 /end MEASUREMENT
/begin MEASUREMENT ACC_bJmpDes "Status indicating jump to desired velocity" UBYTE OneToOne 1 100 0.00 255.0 FORMAT "%5.1" ECU_ADDRESS 0x6000F7A6 /end MEASUREMENT
/begin MEASUREMENT ACC_rTrqAccRed "Target acceleration reduction ratio" SWORD Prc_CrCtl2 1 100 -3276.800 3276.700 FORMAT "%8.3" ECU_ADDRESS 0x60009436 /end MEASUREMENT
/begin MEASUREMENT ACC_st "ACC status" UBYTE OneToOne 1 100 0.00 255.0 FORMAT "%5.1" ECU_ADDRESS 0x6000F7A5 /end MEASUREMENT
/begin MEASUREMENT ACC_stACCDR1Req "ACC down request 1 received over CAN" UBYTE OneToOne 1 100 0.00 255.0 FORMAT "%5.1" ECU_ADDRESS 0x6000F055 /end MEASUREMENT
/begin MEASUREMENT ACC_stACCDR2Req "ACC down request 2 received over CAN" UBYTE OneToOne 1 100 0.00 255.0 FORMAT "%5.1" ECU_ADDRESS 0x6000F054 /end MEASUREMENT
/begin MEASUREMENT ACC_vDes "Desired velocity for ACC" SLONG Vel_CrCtl 1 100 -8388608.00000 8388607.99609 FORMAT "%13.5" ECU_ADDRESS 0x60003A04 /end MEASUREMENT
/begin MEASUREMENT AFS_mAirPerCyl "Air mass per cylinder" SWORD AirMassPerCyl 1 100 -3276.800 3276.700 FORMAT "%8.3" ECU_ADDRESS 0x70003C14 /end MEASUREMENT
/begin MEASUREMENT agrvp_w_msg "EGR- valve position, 16bit" UWORD rel_uw_b100 1 100 0.00 99.99847 FORMAT "%8.5" ECU_ADDRESS 0x60008B34 /end MEASUREMENT
/begin MEASUREMENT AirC_bBackliteHeatgReq "Driver demand backlite heating" UBYTE B_TRUE 1 100 0.00 1.00000000000 BIT_MASK 0x1 FORMAT "%13.11" ECU_ADDRESS 0x70000C4B /end MEASUREMENT
/begin MEASUREMENT AirC_stSwtPrs "Air Condition present" UBYTE OneToOne 1 100 0.00 255.0 FORMAT "%5.1" ECU_ADDRESS 0x6000F793 /end MEASUREMENT
/begin MEASUREMENT AirMod_mfBrkBooster "Modelled air mass flow from brake booster" UWORD m_q0p1 1 100 0.00 6553.500 FORMAT "%8.3" ECU_ADDRESS 0x60008D50 /end MEASUREMENT
/begin MEASUREMENT AirMod_ratChrgDeltaSwtAirSys "Delta Airmass after switch" SWORD rel_q0p0234 1 100 -768.0000 767.9766 FORMAT "%8.4" ECU_ADDRESS 0x600093A8 /end MEASUREMENT
/begin MEASUREMENT AirSys_tFld "Temperature field, induction system" SWORD Temp_Cels 1 100 -3549.940 3003.560 FORMAT "%8.3" ARRAY_SIZE 1 ECU_ADDRESS 0x600068DE /end MEASUREMENT
/begin MEASUREMENT Air_tCACDs "Temperature down stream of charged air cooler" SWORD Temp_Cels 1 100 -3549.940 3003.560 FORMAT "%8.3" ECU_ADDRESS 0x60013E00 /end MEASUREMENT
/begin MEASUREMENT Air_tEGRClrLPDs "Low Pressure EGR cooler downstream Temperature" SWORD Temp_Cels 1 100 -3549.940 3003.560 FORMAT "%8.3" ECU_ADDRESS 0x60008A32 /end MEASUREMENT
/begin MEASUREMENT alchpct_msg "Alcohol Fuel Percentage for PID52" UBYTE rel_q0p39 1 100 0.00 99.61 FORMAT "%5.2" ECU_ADDRESS 0x6000F303 /end MEASUREMENT
/begin MEASUREMENT AltIO_uMeasd "Measured alternator voltage" SWORD Volt_Batt 1 100 -655360.0 655340.0 FORMAT "%8.1" ECU_ADDRESS 0x60008A30 /end MEASUREMENT
/begin MEASUREMENT APP1_uRaw "." SWORD Volt 1 100 0.00 6553.400 FORMAT "%8.3" ECU_ADDRESS 0x60009422 /end MEASUREMENT
/begin MEASUREMENT App_flgHiImpdChkEna "Enabling condition for high impedance check" UBYTE B_TRUE 1 100 0.00 1.00000000000 BIT_MASK 0x1 FORMAT "%13.11" ECU_ADDRESS 0x70000C47 /end MEASUREMENT
/begin MEASUREMENT App_flgSRCLo1HiImpdChk "Result of high impedance check for sensor 1" UBYTE B_TRUE 1 100 0.00 1.00000000000 BIT_MASK 0x1 FORMAT "%13.11" ECU_ADDRESS 0x70000C46 /end MEASUREMENT
/begin MEASUREMENT App_flgSRCLo2HiImpdChk "Result of high impedance check for sensor 2" UBYTE B_TRUE 1 100 0.00 1.00000000000 BIT_MASK 0x1 FORMAT "%13.11" ECU_ADDRESS 0x70000C45 /end MEASUREMENT
/begin MEASUREMENT ASDrf_trqInrSet "ASD reference filter torque output" SWORD md_q0p1 1 100 0.00 3276.700 FORMAT "%8.3" ECU_ADDRESS 0x600093D8 /end MEASUREMENT
/begin MEASUREMENT AuxHtg_bActv "Auxiliary vehicle heater active" UBYTE B_TRUE 1 100 0.00 1.00000000000 BIT_MASK 0x1 FORMAT "%13.11" ECU_ADDRESS 0x70000C44 /end MEASUREMENT
/begin MEASUREMENT BattU_uFild "Battery voltage filtered" SWORD Volt_Batt 1 100 -655360.0 655340.0 FORMAT "%8.1" ECU_ADDRESS 0x60008A1E /end MEASUREMENT
/begin MEASUREMENT bdemodkh_msg "GDI desired mode catalyst heating" UBYTE OneToOne 1 100 0.00 255.0 FORMAT "%5.1" ECU_ADDRESS 0x6000F301 /end MEASUREMENT
/begin MEASUREMENT bdemodst_msg "GDI desired mode cranking" UBYTE OneToOne 1 100 0.00 255.0 FORMAT "%5.1" ECU_ADDRESS 0x6000F300 /end MEASUREMENT
/begin MEASUREMENT Blwr_flgActv "AC-blower active" UBYTE B_TRUE 1 100 0.00 1.00000000000 BIT_MASK 0x1 FORMAT "%13.11" ECU_ADDRESS 0x70000ADF /end MEASUREMENT
/begin MEASUREMENT BrkBstP_p "Sensed Pressure of Brake Booster pressure sensor" SWORD Pres_hPa 1 100 -32768.00 32767.00 FORMAT "%8.2" ECU_ADDRESS 0x6000938C /end MEASUREMENT
/begin MEASUREMENT BrkBst_pMaxIntkMnfldHiRng "Maximum intake manifold pressure for boost pressure control with higher range" UWORD p_uw_q0p078 1 100 0.00 5119.922 FORMAT "%8.3" ECU_ADDRESS 0x60008D48 /end MEASUREMENT
/begin MEASUREMENT BrkPed_pForISABIdleStop "Brake pressure required at wheel for a given inclination to avoid roll back" SWORD Pres 1 100 -3276.800 3276.700 FORMAT "%8.3" ECU_ADDRESS 0x6000936E /end MEASUREMENT
/begin MEASUREMENT BrkP_uRaw "Raw voltage signal from brake pressure sensor." SWORD Volt 1 100 0.00 6553.400 FORMAT "%8.3" ECU_ADDRESS 0x6000937A /end MEASUREMENT
/begin MEASUREMENT Brk_pMnCyl "Pressure of main cylinder of brake pedal" SWORD Pres_LoRes_COMPU 1 100 -327.6800 327.6700 FORMAT "%8.4" ECU_ADDRESS 0x6000936A /end MEASUREMENT
/begin MEASUREMENT Brk_r "Standardized angle of brake pedal" SWORD Prc 1 100 -400.0000 399.9878 FORMAT "%8.4" ECU_ADDRESS 0x60009368 /end MEASUREMENT
/begin MEASUREMENT Brk_stEBBBrkDetn "Status to indicate vehicle is equipped with EBB Brake system" UBYTE B_TRUE 1 100 0.00 1.00000000000 BIT_MASK 0x1 FORMAT "%13.11" ECU_ADDRESS 0x70000ADC /end MEASUREMENT
/begin MEASUREMENT B_agrvdisa_msg "target position of EGR valve is not adjustable due to mechanical design" UBYTE B_TRUE 1 100 0.00 1.00000000000 BIT_MASK 0x1 FORMAT "%13.11" ECU_ADDRESS 0x70000C3F /end MEASUREMENT
/begin MEASUREMENT B_agrvg_msg "actual position of egr valve is valid" UBYTE B_TRUE 1 100 0.00 1.00000000000 BIT_MASK 0x1 FORMAT "%13.11" ECU_ADDRESS 0x6000F287 /end MEASUREMENT
/begin MEASUREMENT B_agrvsg_msg "target position of egr-valve is reachable" UBYTE B_TRUE 1 100 0.00 1.00000000000 BIT_MASK 0x1 FORMAT "%13.11" ECU_ADDRESS 0x6000F286 /end MEASUREMENT
/begin MEASUREMENT B_ate_msg "Condition: fault of exhaust gas temperature sensor in the system" UBYTE B_TRUE 1 100 0.00 1.00000000000 BIT_MASK 0x1 FORMAT "%13.11" ECU_ADDRESS 0x70000C3B /end MEASUREMENT
/begin MEASUREMENT B_bkvagrab_msg "condition egr off caused by brake booster" UBYTE B_TRUE 1 100 0.00 1.00000000000 BIT_MASK 0x1 FORMAT "%13.11" ECU_ADDRESS 0x70000C32 /end MEASUREMENT
/begin MEASUREMENT B_bkvmsisr_msg "Condition massflow into manifold from brake booster" UBYTE B_TRUE 1 100 0.00 1.00000000000 BIT_MASK 0x1 FORMAT "%13.11" ECU_ADDRESS 0x70000C31 /end MEASUREMENT
/begin MEASUREMENT B_bkvnhom_msg "Demand of emergency operation HOM, because ps_msg psmxbkvg_msg." UBYTE B_TRUE 1 100 0.00 1.00000000000 BIT_MASK 0x1 FORMAT "%13.11" ECU_ADDRESS 0x70000C30 /end MEASUREMENT
/begin MEASUREMENT B_bkvnkhab_msg "cond.: idle speed for catalyst heating cut off, because not enough pressure for" UBYTE B_TRUE 1 100 0.00 1.00000000000 BIT_MASK 0x1 FORMAT "%13.11" ECU_ADDRESS 0x70000C2F /end MEASUREMENT
/begin MEASUREMENT B_bkvnwab_msg "condition camshaft in position with min overlapping, because break booster empty" UBYTE B_TRUE 1 100 0.00 1.00000000000 BIT_MASK 0x1 FORMAT "%13.11" ECU_ADDRESS 0x70000C2E /end MEASUREMENT
/begin MEASUREMENT B_bkvsta_msg "Condition: start engine because of brake booster control" UBYTE B_TRUE 1 100 0.00 1.00000000000 BIT_MASK 0x1 FORMAT "%13.11" ECU_ADDRESS 0x6000024A /end MEASUREMENT
/begin MEASUREMENT B_cdagrs_msg "enable egr system diagnosis" UBYTE B_TRUE 1 100 0.00 1.00000000000 BIT_MASK 0x1 FORMAT "%13.11" ECU_ADDRESS 0x70000C2B /end MEASUREMENT
/begin MEASUREMENT B_cdagr_msg "function active per codeword CDAGR" UBYTE B_TRUE 1 100 0.00 1.00000000000 BIT_MASK 0x1 FORMAT "%13.11" ECU_ADDRESS 0x70000C2C /end MEASUREMENT
/begin MEASUREMENT B_cdehfm_msg "function %DHFM active per codeword CDEHFM in %KONCW" UBYTE B_TRUE 1 100 0.00 1.00000000000 BIT_MASK 0x1 FORMAT "%13.11" ECU_ADDRESS 0x70000C2A /end MEASUREMENT
/begin MEASUREMENT B_cdkvssc_msg "function active per codeword CDKVSSC" UBYTE B_TRUE 1 100 0.00 1.00000000000 BIT_MASK 0x1 FORMAT "%13.11" ECU_ADDRESS 0x70000C26 /end MEASUREMENT
/begin MEASUREMENT B_cdkvs_msg "function active per codeword CDKVS" UBYTE B_TRUE 1 100 0.00 1.00000000000 BIT_MASK 0x1 FORMAT "%13.11" ECU_ADDRESS 0x70000C27 /end MEASUREMENT
/begin MEASUREMENT B_cdllrkh_msg "function idle speed diagnosis during catalyst heating active per codeword CDLLR" UBYTE B_TRUE 1 100 0.00 1.00000000000 BIT_MASK 0x1 FORMAT "%13.11" ECU_ADDRESS 0x70000C24 /end MEASUREMENT
/begin MEASUREMENT B_cdllr_msg "function normal idle speed diagnosis active per codeword CDLLR" UBYTE B_TRUE 1 100 0.00 1.00000000000 BIT_MASK 0x1 FORMAT "%13.11" ECU_ADDRESS 0x70000C25 /end MEASUREMENT
/begin MEASUREMENT B_cdmd "function active per codeword CDMD" UBYTE B_TRUE 1 100 0.00 1.00000000000 BIT_MASK 0x4 FORMAT "%13.11" ECU_ADDRESS 0x6000ADB5 /end MEASUREMENT
/begin MEASUREMENT B_cdtesps_msg "function active per codeword CDTESPS" UBYTE B_TRUE 1 100 0.00 1.00000000000 BIT_MASK 0x1 FORMAT "%13.11" ECU_ADDRESS 0x70000C20 /end MEASUREMENT
/begin MEASUREMENT B_cdtes_msg "function active per codeword CDTES or CWDTES" UBYTE B_TRUE 1 100 0.00 1.00000000000 BIT_MASK 0x1 FORMAT "%13.11" ECU_ADDRESS 0x70000C22 /end MEASUREMENT
/begin MEASUREMENT B_clradbbo_msg "Condition: clear selective adaptive value Gasoline in oil" UBYTE B_TRUE 1 100 0.00 1.00000000000 BIT_MASK 0x1 FORMAT "%13.11" ECU_ADDRESS 0x6000F273 /end MEASUREMENT
/begin MEASUREMENT B_cscltka_msg "Clear-Flag coldstart diagnosis Temperature Sensore Radiator Outlet" UBYTE B_TRUE 1 100 0.00 1.00000000000 BIT_MASK 0x1 FORMAT "%13.11" ECU_ADDRESS 0x6000F272 /end MEASUREMENT
/begin MEASUREMENT B_cvt_msg "Continuously variable transmission." UBYTE B_TRUE 1 100 0.00 1.00000000000 BIT_MASK 0x1 FORMAT "%13.11" ECU_ADDRESS 0x70000C1B /end MEASUREMENT
/begin MEASUREMENT B_cwagrap_msg "condition switch to application value" UBYTE B_TRUE 1 100 0.00 1.00000000000 BIT_MASK 0x1 FORMAT "%13.11" ECU_ADDRESS 0x70000C1A /end MEASUREMENT
/begin MEASUREMENT B_cwagrhap_msg "condition codewort egr homogeneous calibration" UBYTE B_TRUE 1 100 0.00 1.00000000000 BIT_MASK 0x1 FORMAT "%13.11" ECU_ADDRESS 0x70000C19 /end MEASUREMENT
/begin MEASUREMENT B_dcy "condition for 'driving cycle' fulfilled" UBYTE B_TRUE 1 100 0.00 1.00000000000 BIT_MASK 0x1 FORMAT "%13.11" ECU_ADDRESS 0x70000C17 /end MEASUREMENT
/begin MEASUREMENT B_diagrkt_msg "disable EGR because of water cooler Temperature at EGR valve is too high" UBYTE B_TRUE 1 100 0.00 1.00000000000 BIT_MASK 0x1 FORMAT "%13.11" ECU_ADDRESS 0x70000C12 /end MEASUREMENT
/begin MEASUREMENT B_disagrkd_msg "Condition EGR disable caused by catalyst diagnosis" UBYTE B_TRUE 1 100 0.00 1.00000000000 BIT_MASK 0x1 FORMAT "%13.11" ECU_ADDRESS 0x70000C10 /end MEASUREMENT
/begin MEASUREMENT B_dknotb "Condition: some throttle valve backup mode active" UBYTE B_TRUE 1 100 0.00 1.00000000000 BIT_MASK 0x1 FORMAT "%13.11" ECU_ADDRESS 0x70000C0F /end MEASUREMENT
/begin MEASUREMENT B_dksbeg "condition: limiting throttle-valve setpoint value" UBYTE B_TRUE 1 100 0.00 1.00000000000 BIT_MASK 0x1 FORMAT "%13.11" ECU_ADDRESS 0x70000C0E /end MEASUREMENT
/begin MEASUREMENT B_dksc "kc: sensor lose fit detection active" UBYTE B_TRUE 1 100 0.00 1.00000000000 BIT_MASK 0x1 FORMAT "%13.11" ECU_ADDRESS 0x70000C0D /end MEASUREMENT
/begin MEASUREMENT B_dtdisagr_msg "Sperrung AGR durch bei aktiver TEV-Prüfung Disabling of EGR by active CPV check" UBYTE B_TRUE 1 100 0.00 1.00000000000 BIT_MASK 0x1 FORMAT "%13.11" ECU_ADDRESS 0x70000C02 /end MEASUREMENT
/begin MEASUREMENT B_dteaam_msg "Condition diagnosis CPV by opening the CPV active possible" UBYTE B_TRUE 1 100 0.00 1.00000000000 BIT_MASK 0x1 FORMAT "%13.11" ECU_ADDRESS 0x6000F271 /end MEASUREMENT
/begin MEASUREMENT B_dteird_msg "Condition: Release of denominator increment CPV diagnosis" UBYTE B_TRUE 1 100 0.00 1.00000000000 BIT_MASK 0x1 FORMAT "%13.11" ECU_ADDRESS 0x70000C01 /end MEASUREMENT
/begin MEASUREMENT B_dtevact_msg "condition for start of TEV opening" UBYTE B_TRUE 1 100 0.00 1.00000000000 BIT_MASK 0x1 FORMAT "%13.11" ECU_ADDRESS 0x6000F270 /end MEASUREMENT
/begin MEASUREMENT B_dtmbh_msg "Condition correction of temperature if blockheater detected" UBYTE B_TRUE 1 100 0.00 1.00000000000 BIT_MASK 0x1 FORMAT "%13.11" ECU_ADDRESS 0x70000C00 /end MEASUREMENT
/begin MEASUREMENT B_eagrv_msg "mechanical error of egr valve (e.g. valve is stuck)" UBYTE B_TRUE 1 100 0.00 1.00000000000 BIT_MASK 0x1 FORMAT "%13.11" ECU_ADDRESS 0x70000BFD /end MEASUREMENT
/begin MEASUREMENT B_eepwf_msg "Condition Power fail Electrically Erasable Programmable Read only Memory" UBYTE B_TRUE 1 100 0.00 1.00000000000 BIT_MASK 0x1 FORMAT "%13.11" ECU_ADDRESS 0x70000BF9 /end MEASUREMENT
/begin MEASUREMENT B_faagr_msg "Condition function request EGR and diagnostic routine for short test" UBYTE B_TRUE 1 100 0.00 1.00000000000 BIT_MASK 0x1 FORMAT "%13.11" ECU_ADDRESS 0x70000BD0 /end MEASUREMENT
/begin MEASUREMENT B_faam_msg "request of general torque margin quick trip" UBYTE B_TRUE 1 100 0.00 1.00000000000 BIT_MASK 0x1 FORMAT "%13.11" ECU_ADDRESS 0x70000BCF /end MEASUREMENT
/begin MEASUREMENT B_fabe_msg "condition function request end of line test" UBYTE B_TRUE 1 100 0.00 1.00000000000 BIT_MASK 0x1 FORMAT "%13.11" ECU_ADDRESS 0x6000F264 /end MEASUREMENT
/begin MEASUREMENT B_faeonv_msg "indication if service test is requested" UBYTE B_TRUE 1 100 0.00 1.00000000000 BIT_MASK 0x1 FORMAT "%13.11" ECU_ADDRESS 0x6000F263 /end MEASUREMENT
/begin MEASUREMENT B_fafkmsla_msg "Condition: Requirement for the clearing of the slow filling adaption values" UBYTE B_TRUE 1 100 0.00 1.00000000000 BIT_MASK 0x1 FORMAT "%13.11" ECU_ADDRESS 0x70000BCD /end MEASUREMENT
/begin MEASUREMENT B_fahfm_msg "Condition function request MAF" UBYTE B_TRUE 1 100 0.00 1.00000000000 BIT_MASK 0x1 FORMAT "%13.11" ECU_ADDRESS 0x60000932 /end MEASUREMENT
/begin MEASUREMENT B_falshvs_msg "Condition Function demand oxygen sensor heating before start" UBYTE B_TRUE 1 100 0.00 1.00000000000 BIT_MASK 0x1 FORMAT "%13.11" ECU_ADDRESS 0x6000F262 /end MEASUREMENT
/begin MEASUREMENT B_falzsr_msg "Condition function request diagnosis leckage to manifold for short test" UBYTE B_TRUE 1 100 0.00 1.00000000000 BIT_MASK 0x1 FORMAT "%13.11" ECU_ADDRESS 0x70000BCC /end MEASUREMENT
/begin MEASUREMENT B_fates_msg "condition service tester request for canister purge valve diagnosis (CPV diagnosis)" UBYTE B_TRUE 1 100 0.00 1.00000000000 BIT_MASK 0x1 FORMAT "%13.11" ECU_ADDRESS 0x70000BCA /end MEASUREMENT
/begin MEASUREMENT B_fatldeg_msg "condition service function request for smallest leak diagnosis in garage" UBYTE B_TRUE 1 100 0.00 1.00000000000 BIT_MASK 0x1 FORMAT "%13.11" ECU_ADDRESS 0x6000F261 /end MEASUREMENT
/begin MEASUREMENT B_fatlde_msg "condition service function request for leak detection diagnosis in garage" UBYTE B_TRUE 1 100 0.00 1.00000000000 BIT_MASK 0x1 FORMAT "%13.11" ECU_ADDRESS 0x70000BC9 /end MEASUREMENT
/begin MEASUREMENT B_fatlds_msg "diagnostic stop explict request from tester" UBYTE B_TRUE 1 100 0.00 1.00000000000 BIT_MASK 0x1 FORMAT "%13.11" ECU_ADDRESS 0x70000BC8 /end MEASUREMENT
/begin MEASUREMENT B_fa_msg "condition general function request" UBYTE B_TRUE 1 100 0.00 1.00000000000 BIT_MASK 0x1 FORMAT "%13.11" ECU_ADDRESS 0x6000F265 /end MEASUREMENT
/begin MEASUREMENT B_fststamap_msg "condition separate parameters for ECO FAST START" UBYTE B_TRUE 1 100 0.00 1.00000000000 BIT_MASK 0x1 FORMAT "%13.11" ECU_ADDRESS 0x70000BB7 /end MEASUREMENT
/begin MEASUREMENT B_hsp "GDI mode homogeneous-split" UBYTE B_TRUE 1 100 0.00 1.00000000000 BIT_MASK 0x1 FORMAT "%13.11" ECU_ADDRESS 0x70000BA7 /end MEASUREMENT
/begin MEASUREMENT B_khagrab_msg "Condition: EGR cut-off because of catalyst heating" UBYTE B_TRUE 1 100 0.00 1.00000000000 BIT_MASK 0x1 FORMAT "%13.11" ECU_ADDRESS 0x70000BA2 /end MEASUREMENT
/begin MEASUREMENT B_khatrip_msg "request catalyst heating for end of line test" UBYTE B_TRUE 1 100 0.00 1.00000000000 BIT_MASK 0x1 FORMAT "%13.11" ECU_ADDRESS 0x70000B9C /end MEASUREMENT
/begin MEASUREMENT B_kl15 "condition ignition switch on" UBYTE B_TRUE 1 100 0.00 1.00000000000 BIT_MASK 0x1 FORMAT "%13.11" ECU_ADDRESS 0x70000B97 /end MEASUREMENT
/begin MEASUREMENT B_kl15_msg "condition ignition switch on" UBYTE B_TRUE 1 100 0.00 1.00000000000 BIT_MASK 0x1 FORMAT "%13.11" ECU_ADDRESS 0x6000020B /end MEASUREMENT
/begin MEASUREMENT B_koe_msg "Condition for air conditioner compressor ON" UBYTE B_TRUE 1 100 0.00 1.00000000000 BIT_MASK 0x1 FORMAT "%13.11" ECU_ADDRESS 0x70000B96 /end MEASUREMENT
/begin MEASUREMENT B_kstebf_msg "condition initial fuelling" UBYTE B_TRUE 1 100 0.00 1.00000000000 BIT_MASK 0x1 FORMAT "%13.11" ECU_ADDRESS 0x6000F240 /end MEASUREMENT
/begin MEASUREMENT B_ldsua_msg "Condition boost control: overrun air circulation valve active (open)" UBYTE B_TRUE 1 100 0.00 1.00000000000 BIT_MASK 0x1 FORMAT "%13.11" ECU_ADDRESS 0x70000B88 /end MEASUREMENT
/begin MEASUREMENT B_ll "Idle speed from driver's sight" UBYTE B_TRUE 1 100 0.00 1.00000000000 BIT_MASK 0x1 FORMAT "%13.11" ECU_ADDRESS 0x70000B85 /end MEASUREMENT
/begin MEASUREMENT B_llri "Condition activation of I-part of idle speed control" UBYTE B_TRUE 1 100 0.00 1.00000000000 BIT_MASK 0x1 FORMAT "%13.11" ECU_ADDRESS 0x70000B81 /end MEASUREMENT
/begin MEASUREMENT B_lradp1mn_msg "B_lradp1mn VAR Valid Bedingung Min unterschritten Condition Min undershot" UBYTE B_TRUE 1 100 0.00 1.00000000000 BIT_MASK 0x1 FORMAT "%13.11" ECU_ADDRESS 0x6000EE96 /end MEASUREMENT
/begin MEASUREMENT B_lradp1mx_msg "Condition Max undershot" UBYTE B_TRUE 1 100 0.00 1.00000000000 BIT_MASK 0x1 FORMAT "%13.11" ECU_ADDRESS 0x6000EE95 /end MEASUREMENT
/begin MEASUREMENT B_lrebps_msg "Bedingung Lambdaregelung durch kundenspezifische LREBPS gesperrt" UBYTE B_TRUE 1 100 0.00 1.00000000000 BIT_MASK 0x1 FORMAT "%13.11" ECU_ADDRESS 0x60000206 /end MEASUREMENT
/begin MEASUREMENT B_lsuoffs_msg "Offset fault of LSU." UBYTE B_TRUE 1 100 0.00 1.00000000000 BIT_MASK 0x1 FORMAT "%13.11" ECU_ADDRESS 0x70000B70 /end MEASUREMENT
/begin MEASUREMENT B_m8te_msg "condition to enable function evap system by SAE J1879 Mode 8 TID 01" UBYTE B_TRUE 1 100 0.00 1.00000000000 BIT_MASK 0x1 FORMAT "%13.11" ECU_ADDRESS 0x6000F23D /end MEASUREMENT
/begin MEASUREMENT B_mdbgagr_msg "Torque limitation activated in case of open clamping EGR valve" UBYTE B_TRUE 1 100 0.00 1.00000000000 BIT_MASK 0x1 FORMAT "%13.11" ECU_ADDRESS 0x70000B6F /end MEASUREMENT
/begin MEASUREMENT B_mdmi "Condition misfire detection low load-threshold" UBYTE B_TRUE 1 100 0.00 1.00000000000 BIT_MASK 0x1 FORMAT "%13.11" ECU_ADDRESS 0x70000B6D /end MEASUREMENT
/begin MEASUREMENT B_mdstop "misfire detection stop" UBYTE B_TRUE 1 100 0.00 1.00000000000 BIT_MASK 0x1 FORMAT "%13.11" ECU_ADDRESS 0x70000B6C /end MEASUREMENT
/begin MEASUREMENT B_milstp "statistic of misfire detection (%DMDMIL) stop" UBYTE B_TRUE 1 100 0.00 1.00000000000 BIT_MASK 0x1 FORMAT "%13.11" ECU_ADDRESS 0x70000B6A /end MEASUREMENT
/begin MEASUREMENT B_nachl "ECU control for ECU switch off delay" UBYTE B_TRUE 1 100 0.00 1.00000000000 BIT_MASK 0x1 FORMAT "%13.11" ECU_ADDRESS 0x70000B5F /end MEASUREMENT
/begin MEASUREMENT B_nachlauf_msg "ECU control for ECU switch off delay" UBYTE B_TRUE 1 100 0.00 1.00000000000 BIT_MASK 0x1 FORMAT "%13.11" ECU_ADDRESS 0x600001F3 /end MEASUREMENT
/begin MEASUREMENT B_nachl_msg "ECU control for ECU switch off delay" UBYTE B_TRUE 1 100 0.00 1.00000000000 BIT_MASK 0x1 FORMAT "%13.11" ECU_ADDRESS 0x600001F4 /end MEASUREMENT
/begin MEASUREMENT B_nmot "condition engine speed: n > NMIN" UBYTE B_TRUE 1 100 0.00 1.00000000000 BIT_MASK 0x1 FORMAT "%13.11" ECU_ADDRESS 0x70000B5B /end MEASUREMENT
/begin MEASUREMENT B_norm_msg "ECU-condition normal engine management operation" UBYTE B_TRUE 1 100 0.00 1.00000000000 BIT_MASK 0x1 FORMAT "%13.11" ECU_ADDRESS 0x600001F0 /end MEASUREMENT
/begin MEASUREMENT B_nostoagr_msg "Condition Engine stop (start-stop) forbid from active external EGR" UBYTE B_TRUE 1 100 0.00 1.00000000000 BIT_MASK 0x1 FORMAT "%13.11" ECU_ADDRESS 0x70000B56 /end MEASUREMENT
/begin MEASUREMENT B_nswo1_msg "condition for engine-speed threshold 1 for switching calculation" UBYTE B_TRUE 1 100 0.00 1.00000000000 BIT_MASK 0x1 FORMAT "%13.11" ECU_ADDRESS 0x70000B50 /end MEASUREMENT
/begin MEASUREMENT B_nswo2_msg "engine-speed threshold 2 switching calculation" UBYTE B_TRUE 1 100 0.00 1.00000000000 BIT_MASK 0x1 FORMAT "%13.11" ECU_ADDRESS 0x70000B4F /end MEASUREMENT
/begin MEASUREMENT B_rkapp_msg "condition: calibration of rk" UBYTE B_TRUE 1 100 0.00 1.00000000000 BIT_MASK 0x1 FORMAT "%13.11" ECU_ADDRESS 0x70000B33 /end MEASUREMENT
/begin MEASUREMENT B_rriesap_msg "condition application value extern egr inert gas" UBYTE B_TRUE 1 100 0.00 1.00000000000 BIT_MASK 0x1 FORMAT "%13.11" ECU_ADDRESS 0x7000363B /end MEASUREMENT
/begin MEASUREMENT B_stend "condition end of start" UBYTE B_TRUE 1 100 0.00 1.00000000000 BIT_MASK 0x1 FORMAT "%13.11" ECU_ADDRESS 0x70000B27 /end MEASUREMENT
/begin MEASUREMENT B_stveset_msg "Condition for pre injection" UBYTE B_TRUE 1 100 0.00 1.00000000000 BIT_MASK 0x1 FORMAT "%13.11" ECU_ADDRESS 0x70000B1C /end MEASUREMENT
/begin MEASUREMENT B_syntizw "condition cylinder counter zzylh and zzyls synchronized" UBYTE B_TRUE 1 100 0.00 1.00000000000 BIT_MASK 0x1 FORMAT "%13.11" ECU_ADDRESS 0x70000107 /end MEASUREMENT
/begin MEASUREMENT B_tavdkgg_msg "Intake air temperature tavdk is valid" UBYTE B_TRUE 1 100 0.00 1.00000000000 BIT_MASK 0x1 FORMAT "%13.11" ECU_ADDRESS 0x70000B15 /end MEASUREMENT
/begin MEASUREMENT B_tavvmg_msg "Condition: air temperature upstream booster from model is valid" UBYTE B_TRUE 1 100 0.00 1.00000000000 BIT_MASK 0x1 FORMAT "%13.11" ECU_ADDRESS 0x6000F216 /end MEASUREMENT
/begin MEASUREMENT B_teftstft_msg "condition for first-start function with application code word" UBYTE B_TRUE 1 100 0.00 1.00000000000 BIT_MASK 0x1 FORMAT "%13.11" ECU_ADDRESS 0x70000B14 /end MEASUREMENT
/begin MEASUREMENT B_tippg_msg "Condition Gear lifter in position Tipp shift gutter" UBYTE B_TRUE 1 100 0.00 1.00000000000 BIT_MASK 0x1 FORMAT "%13.11" ECU_ADDRESS 0x70000B0D /end MEASUREMENT
/begin MEASUREMENT B_tolcb_msg "cond. Error status of oil temperature and oil level from combi message or from COWIV" UBYTE B_TRUE 1 100 0.00 1.00000000000 BIT_MASK 0x1 FORMAT "%13.11" ECU_ADDRESS 0x70000B08 /end MEASUREMENT
/begin MEASUREMENT B_urstsprr "Bit to lock primal fuelling" UBYTE B_TRUE 1 100 0.00 1.00000000000 BIT_MASK 0x1 FORMAT "%13.11" ECU_ADDRESS 0x70000AF4 /end MEASUREMENT
/begin MEASUREMENT B_vheg "Condition high valve lift active" UBYTE B_TRUE 1 100 0.00 1.00000000000 BIT_MASK 0x1 FORMAT "%13.11" ECU_ADDRESS 0x6000F20F /end MEASUREMENT
/begin MEASUREMENT B_vhegfe "condition: high valve lift for timing of air charge determination ( one calculation step before calculation of air charge for switched cylinder)" UBYTE B_TRUE 1 100 0.00 1.00000000000 BIT_MASK 0x1 FORMAT "%13.11" ECU_ADDRESS 0x70000AF2 /end MEASUREMENT
/begin MEASUREMENT B_vhegv "Condition actual combustion cylinder is filled with large intake valve lift" UBYTE B_TRUE 1 100 0.00 1.00000000000 BIT_MASK 0x1 FORMAT "%13.11" ECU_ADDRESS 0x70000AF1 /end MEASUREMENT
/begin MEASUREMENT B_vhegzw "Condition actual ignition cylinder is filled with large intake valve lift" UBYTE B_TRUE 1 100 0.00 1.00000000000 BIT_MASK 0x1 FORMAT "%13.11" ECU_ADDRESS 0x70000AF0 /end MEASUREMENT
/begin MEASUREMENT B_wakeup_msg "ECU-condition wake up operation" UBYTE B_TRUE 1 100 0.00 1.00000000000 BIT_MASK 0x1 FORMAT "%13.11" ECU_ADDRESS 0x600001BC /end MEASUREMENT
/begin MEASUREMENT CAClg_ratCoolgMax "Charge air cooling ratio maximum" UWORD rel_uw_b100 1 100 0.00 99.99847 FORMAT "%8.5" ECU_ADDRESS 0x60008D46 /end MEASUREMENT
/begin MEASUREMENT CAClg_ratCoolgMedHi "Charge air cooling ratio medium high" UWORD rel_uw_b100 1 100 0.00 99.99847 FORMAT "%8.5" ECU_ADDRESS 0x60008D44 /end MEASUREMENT
/begin MEASUREMENT CAClg_ratCoolgMedLo "Charge air cooling ratio medium low" UWORD rel_uw_b100 1 100 0.00 99.99847 FORMAT "%8.5" ECU_ADDRESS 0x60008D42 /end MEASUREMENT
/begin MEASUREMENT CAClg_ratCoolgMin "Charge air cooling ratio minimum" UWORD rel_uw_b100 1 100 0.00 99.99847 FORMAT "%8.5" ECU_ADDRESS 0x60008D40 /end MEASUREMENT
/begin MEASUREMENT CACPmpRly_stPs "CAC pump relay powerstage output" UBYTE B_TRUE 1 100 0.00 1.00000000000 BIT_MASK 0x1 FORMAT "%13.11" ECU_ADDRESS 0x70000ADB /end MEASUREMENT
/begin MEASUREMENT CACPmp_nSens "CAC pump speed sensor" ULONG RBPtCel_n_1p0_1 1 100 0.00 4294967295.00 FORMAT "%13.2" ECU_ADDRESS 0x600038E8 /end MEASUREMENT
/begin MEASUREMENT CACPmp_rDC "PWM signal for charge air cooler pump" SWORD DtyCyc 1 100 -327.6800 327.6700 FORMAT "%8.4" ECU_ADDRESS 0x60009366 /end MEASUREMENT
/begin MEASUREMENT CACPmp_uPlausyHiThd "CAC pump battery high thershold message" SWORD Volt_Batt 1 100 -655360.0 655340.0 FORMAT "%8.1" ECU_ADDRESS 0x60009364 /end MEASUREMENT
/begin MEASUREMENT CACPmp_uPlausyLoThd "CAC pump battery Low thershold message" SWORD Volt_Batt 1 100 -655360.0 655340.0 FORMAT "%8.1" ECU_ADDRESS 0x60009362 /end MEASUREMENT
/begin MEASUREMENT CB_flgFlsProgmEveSts "Flag for Reprogramming event detection" UBYTE OneToOne 1 100 0.00 255.0 FORMAT "%5.1" ECU_ADDRESS 0x6000F04D /end MEASUREMENT
/begin MEASUREMENT CEngDsT_tStopStrtEndOff "engine coolant stop temperature at start end off time" SWORD Temp_Cels 1 100 -3549.940 3003.560 FORMAT "%8.3" ECU_ADDRESS 0x60008A08 /end MEASUREMENT
/begin MEASUREMENT CEngUsT_flgColdStrtHeal "Heal flag of coolant temperature sensor cold start diagnosis" UBYTE B_TRUE 1 100 0.00 1.00000000000 BIT_MASK 0x1 FORMAT "%13.11" ECU_ADDRESS 0x70000A9E /end MEASUREMENT
/begin MEASUREMENT Clth_drFlt "Filtered Gradient of clutch pedal sensor" SWORD Prc_Fact256 1 100 -128.0000 127.9961 FORMAT "%8.4" ECU_ADDRESS 0x60009342 /end MEASUREMENT
/begin MEASUREMENT Clth_rKisspnt "Kiss point (Ratio of clutch at which the clutch torque is zero)" SWORD Prc_Fact256 1 100 -128.0000 127.9961 FORMAT "%8.4" ECU_ADDRESS 0x6000933E /end MEASUREMENT
/begin MEASUREMENT Clth_stClthExtd "Extended clutch pedal status" UBYTE OneToOne 1 100 0.00 255.0 FORMAT "%5.1" ECU_ADDRESS 0x6000F777 /end MEASUREMENT
/begin MEASUREMENT Clth_swtClthType "switch for clutch signal selection" UBYTE OneToOne 1 100 0.00 255.0 FORMAT "%5.1" ECU_ADDRESS 0x6000F771 /end MEASUREMENT
/begin MEASUREMENT CoDsplCtl_stLmp4Out "Lamp4 output status" UBYTE OneToOne 1 100 0.00 255.0 FORMAT "%5.1" ECU_ADDRESS 0x6000F770 /end MEASUREMENT
/begin MEASUREMENT CoDsplCtl_stLmp5Out "Lamp5 output status" UBYTE dez 1 100 0.00 255.0 FORMAT "%5.1" ECU_ADDRESS 0x6000F76F /end MEASUREMENT
/begin MEASUREMENT CoEng_bCtOffCon "release condition for Cut Off" UBYTE B_TRUE 1 100 0.00 1.00000000000 BIT_MASK 0x1 FORMAT "%13.11" ECU_ADDRESS 0x70000A77 /end MEASUREMENT
/begin MEASUREMENT CoEng_bFrstStrtEnd "Condition end of first start" UBYTE B_TRUE 1 100 0.00 1.00000000000 BIT_MASK 0x1 FORMAT "%13.11" ECU_ADDRESS 0x70000A76 /end MEASUREMENT
/begin MEASUREMENT CoEng_bHEM "Condition half engine mode (HEM) active" UBYTE B_TRUE 1 100 0.00 1.00000000000 BIT_MASK 0x1 FORMAT "%13.11" ECU_ADDRESS 0x70000A75 /end MEASUREMENT
/begin MEASUREMENT CoEng_bStrtEndIA "condition end of start for ignition release" UBYTE B_TRUE 1 100 0.00 1.00000000000 BIT_MASK 0x1 FORMAT "%13.11" ECU_ADDRESS 0x60000938 /end MEASUREMENT
/begin MEASUREMENT CoEng_bStrtEndSpdGov "condition end of start for speed governor" UBYTE B_TRUE 1 100 0.00 1.00000000000 BIT_MASK 0x1 FORMAT "%13.11" ECU_ADDRESS 0x70000A6F /end MEASUREMENT
/begin MEASUREMENT CoEng_bStrtEndTrqStruct "Condition end of start for activation of Md-structure" UBYTE B_TRUE 1 100 0.00 1.00000000000 BIT_MASK 0x1 FORMAT "%13.11" ECU_ADDRESS 0x6000093A /end MEASUREMENT
/begin MEASUREMENT CoEng_tiNormalOBD "Engine running time - for OBD requirement" ULONG Time_sec_q1_COMPU 1 100 0.00 4294967295.00 FORMAT "%13.2" ECU_ADDRESS 0x60013100 /end MEASUREMENT
/begin MEASUREMENT CoEng_tiStrtDly "Delay time at startup" SWORD Time_ms 1 100 -327680.0 327670.0 FORMAT "%8.1" ECU_ADDRESS 0x6000932A /end MEASUREMENT
/begin MEASUREMENT CoEOM_flgCvlcIgnRels "Ignition angle release due to valve lift switch" UBYTE B_TRUE 1 100 0.00 1.00000000000 BIT_MASK 0x1 FORMAT "%13.11" ECU_ADDRESS 0x60000934 /end MEASUREMENT
/begin MEASUREMENT CoEOM_stEOMDesWoCatHtg "Desired engine operating mode without consideration of request from catalyst heating" UWORD CoEOM_stEomStgTot_VERB 1 100 0.00 7951.00000000 FORMAT "%13.8" ECU_ADDRESS 0x60008D3C /end MEASUREMENT
/begin MEASUREMENT CoETS_trqInrLead "desired lead (inner) torque (without Filter/ with reserve)" SWORD Trq 1 100 -3276.800 3276.700 FORMAT "%8.3" ECU_ADDRESS 0x60009338 /end MEASUREMENT
/begin MEASUREMENT CoETS_trqInrSetWoIntvWoCo "Torque demand for set path without interventions without coordination" SWORD md_q0p1 1 100 0.00 3276.700 FORMAT "%8.3" ECU_ADDRESS 0x60009336 /end MEASUREMENT
/begin MEASUREMENT CoETS_trqUnFltLead "Unfiltered compensation torque on lead path" SWORD md_q0p1 1 100 -3276.800 3276.700 FORMAT "%8.3" ECU_ADDRESS 0x60009330 /end MEASUREMENT
/begin MEASUREMENT CoETS_trqUnFltSet "Compensation torque of ""loss torque compensation"" to bypass filter influences on the set path which is partly compensated" SWORD Trq 1 100 -3276.800 3276.700 FORMAT "%8.3" ECU_ADDRESS 0x6000932E /end MEASUREMENT
/begin MEASUREMENT ComDCDC_stAbnormInp1 "Input Circuit Failure 1" UBYTE OneToOne 1 100 0.00 255.0 FORMAT "%5.1" ECU_ADDRESS 0x6000F02B /end MEASUREMENT
/begin MEASUREMENT ComDCDC_stAbnormInp2 "Input Circuit Failure 2" UBYTE OneToOne 1 100 0.00 255.0 FORMAT "%5.1" ECU_ADDRESS 0x6000F02A /end MEASUREMENT
/begin MEASUREMENT ComDCDC_stAbnormOutp1 "Output Circuit Failure 1" UBYTE OneToOne 1 100 0.00 255.0 FORMAT "%5.1" ECU_ADDRESS 0x6000F029 /end MEASUREMENT
/begin MEASUREMENT ComDCDC_stAbnormOutp2 "Output Circuit Failure 2" UBYTE OneToOne 1 100 0.00 255.0 FORMAT "%5.1" ECU_ADDRESS 0x6000F028 /end MEASUREMENT
/begin MEASUREMENT ComDCDC_stAbnormOvrheat1 "Thermal Warning 1" UBYTE OneToOne 1 100 0.00 255.0 FORMAT "%5.1" ECU_ADDRESS 0x6000F027 /end MEASUREMENT
/begin MEASUREMENT ComDCDC_stAbnormOvrheat2 "Thermal Warning 2" UBYTE OneToOne 1 100 0.00 255.0 FORMAT "%5.1" ECU_ADDRESS 0x6000F026 /end MEASUREMENT
/begin MEASUREMENT ComDCDC_stBoostChkFailr "Boost Failure" UBYTE OneToOne 1 100 0.00 255.0 FORMAT "%5.1" ECU_ADDRESS 0x6000F025 /end MEASUREMENT
/begin MEASUREMENT ComDCDC_stBoostUOper "Unit state" UBYTE OneToOne 1 100 0.00 255.0 FORMAT "%5.1" ECU_ADDRESS 0x6000F024 /end MEASUREMENT
/begin MEASUREMENT ComDCDC_stCSTOnFailr "CST Failure" UBYTE OneToOne 1 100 0.00 255.0 FORMAT "%5.1" ECU_ADDRESS 0x6000F023 /end MEASUREMENT
/begin MEASUREMENT ComDCDC_stDiagCirc1 "Status of DC-DC converter circuit 1" UBYTE OneToOne 1 100 0.00 255.0 FORMAT "%5.1" ECU_ADDRESS 0x6000F70F /end MEASUREMENT
/begin MEASUREMENT ComDCDC_stDiagCirc2 "Status of DC-DC converter circuit 2" UBYTE OneToOne 1 100 0.00 255.0 FORMAT "%5.1" ECU_ADDRESS 0x6000F70E /end MEASUREMENT
/begin MEASUREMENT ComDCDC_stRxErr "DCDC reception error flag (ID 0x10 Byte1 bit 3)" UBYTE OneToOne 1 100 0.00 255.0 FORMAT "%5.1" ECU_ADDRESS 0x6000F706 /end MEASUREMENT
/begin MEASUREMENT ComDCDC_stVSTIntFailr "Internal Failure" UBYTE OneToOne 1 100 0.00 255.0 FORMAT "%5.1" ECU_ADDRESS 0x6000F022 /end MEASUREMENT
/begin MEASUREMENT Com_bBrkPedON "EBB brake pedal ON" UBYTE OneToOne 1 100 0.00 255.0 FORMAT "%5.1" ECU_ADDRESS 0x6000F6E3 /end MEASUREMENT
/begin MEASUREMENT Com_dACCCmdVehSpdDispd "ACC Command Vehicle Speed Displayed" UBYTE OneToOne 1 100 0.00 255.0 FORMAT "%5.1" ECU_ADDRESS 0x6000F69F /end MEASUREMENT
/begin MEASUREMENT Com_flgACCNorm "ACC Frame communication normal flag. (FId_ComACC is not inhibited)" UBYTE B_TRUE 1 100 0.00 1.00000000000 BIT_MASK 0x1 FORMAT "%13.11" ECU_ADDRESS 0x6000F17E /end MEASUREMENT
/begin MEASUREMENT Com_flgAcOn "Flag that indicates AC is ON" UBYTE B_TRUE 1 100 0.00 1.00000000000 BIT_MASK 0x1 FORMAT "%13.11" ECU_ADDRESS 0x6000F17D /end MEASUREMENT
/begin MEASUREMENT Com_flgEAT9Norm "EAT9 Frame communication normal flag. (FId_ComEAT9 is not inhibited)" UBYTE B_TRUE 1 100 0.00 1.00000000000 BIT_MASK 0x1 FORMAT "%13.11" ECU_ADDRESS 0x6000F17A /end MEASUREMENT
/begin MEASUREMENT Com_flgManModIndcn "Manual Mode Indication" UBYTE B_TRUE 1 100 0.00 1.00000000000 BIT_MASK 0x1 FORMAT "%13.11" ECU_ADDRESS 0x70000A5C /end MEASUREMENT
/begin MEASUREMENT Com_flgUpshiftMod "Flag to indicate whether upshifting mode is in progress or not" UBYTE OneToOne 1 100 0.00 1.000 FORMAT "%5.3" ECU_ADDRESS 0x6000EFF6 /end MEASUREMENT
/begin MEASUREMENT Com_lTotOdo "Odometer received over CAN mesage" ULONG RBPtCel_dst_0p1_2 1 100 0.00 429496729.500 FORMAT "%13.3" ECU_ADDRESS 0x50004D9C /end MEASUREMENT
/begin MEASUREMENT Com_nrIdAlt "Alternator ID" UBYTE OneToOne 1 100 0.00 255.0 FORMAT "%5.1" ECU_ADDRESS 0x6000EFF2 /end MEASUREMENT
/begin MEASUREMENT Com_nrIdChp "Alternator chip ID" UBYTE OneToOne 1 100 0.00 255.0 FORMAT "%5.1" ECU_ADDRESS 0x6000EFF1 /end MEASUREMENT
/begin MEASUREMENT Com_nrIdMnfc "Alternator manifactuerer ID" UBYTE OneToOne 1 100 0.00 255.0 FORMAT "%5.1" ECU_ADDRESS 0x6000EFF0 /end MEASUREMENT
/begin MEASUREMENT Com_numGearTrgt "Selected gear information raw value from Gearbox ECU" UBYTE OneToOne 1 100 0.00 255.0 FORMAT "%5.1" ECU_ADDRESS 0x6000F646 /end MEASUREMENT
/begin MEASUREMENT Com_pEVPMnfldP "Brake relative negative pressure for EVP" SWORD Pres_mmhg_q2p685 1 100 -87982.08 87979.40 FORMAT "%8.2" ECU_ADDRESS 0x600089E6 /end MEASUREMENT
/begin MEASUREMENT Com_rAltLoad "Alternator load percentage" SWORD Prc 1 100 -400.0000 399.9878 FORMAT "%8.4" ECU_ADDRESS 0x600089E4 /end MEASUREMENT
/begin MEASUREMENT Com_rClthPos "Clutch Position" SWORD Prc 1 100 -400.0000 399.9878 FORMAT "%8.4" ECU_ADDRESS 0x60009286 /end MEASUREMENT
/begin MEASUREMENT Com_rEEV1PosFb "EEV1 feedback position" UBYTE rel_ub_b127p5 1 100 0.00 127.5 FORMAT "%5.1" ECU_ADDRESS 0x6000F642 /end MEASUREMENT
/begin MEASUREMENT Com_stACCAMon "Monitoring status of ACCA Erro Condition" UBYTE OneToOne 1 100 0.00 255.0 FORMAT "%5.1" ECU_ADDRESS 0x6000F63B /end MEASUREMENT
/begin MEASUREMENT Com_stACCBMon "Monitoring status of ACCB Error Condition" UBYTE OneToOne 1 100 0.00 255.0 FORMAT "%5.1" ECU_ADDRESS 0x6000F639 /end MEASUREMENT
/begin MEASUREMENT Com_stACCIgrBrk "The throttle demand in a brake" UBYTE OneToOne 1 100 0.00 255.0 FORMAT "%5.1" ECU_ADDRESS 0x6000F637 /end MEASUREMENT
/begin MEASUREMENT Com_stACCSpdUnit "Unit of speed of car for customizing" UBYTE OneToOne 1 100 0.00 255.0 FORMAT "%5.1" ECU_ADDRESS 0x6000F636 /end MEASUREMENT
/begin MEASUREMENT Com_stACCTrsmGearChgReq "ACC Transmission Gear Change Request" UBYTE OneToOne 1 100 0.00 255.0 FORMAT "%5.1" ECU_ADDRESS 0x6000F635 /end MEASUREMENT
/begin MEASUREMENT Com_stACType "Selected AC control type information" UBYTE dez 1 100 0.00 255.0 FORMAT "%5.1" ECU_ADDRESS 0x6000EFDD /end MEASUREMENT
/begin MEASUREMENT Com_stADSSpdLim "ADS Speed Limit Request" UBYTE OneToOne 1 100 0.00 255.0 FORMAT "%5.1" ECU_ADDRESS 0x6000F630 /end MEASUREMENT
/begin MEASUREMENT Com_stATEnaCond "AT enable condition recieved over CAN" UBYTE OneToOne 1 100 0.00 255.0 FORMAT "%5.1" ECU_ADDRESS 0x6000F62E /end MEASUREMENT
/begin MEASUREMENT Com_stATErr4 "Status of AT failure in case of vehicle speed sensor defect" UBYTE OneToOne 1 100 0.00 255.0 FORMAT "%5.1" ECU_ADDRESS 0x6000F62D /end MEASUREMENT
/begin MEASUREMENT Com_stATISS "The status of AT ISS system condition" UBYTE OneToOne 1 100 0.00 255.0 FORMAT "%5.1" ECU_ADDRESS 0x6000EFDC /end MEASUREMENT
/begin MEASUREMENT Com_stATPrkgProc "parking process status" UBYTE OneToOne 1 100 0.00 255.0 FORMAT "%5.1" ECU_ADDRESS 0x6000EFDB /end MEASUREMENT
/begin MEASUREMENT Com_stATShftUpDwnReq "AT Shift Indicator Lamp status" UBYTE OneToOne 1 100 0.00 255.0 FORMAT "%5.1" ECU_ADDRESS 0x6000F62B /end MEASUREMENT
/begin MEASUREMENT Com_stAYC "AYC mode status" UBYTE OneToOne 1 100 0.00 255.0 FORMAT "%5.1" ECU_ADDRESS 0x6000F62A /end MEASUREMENT
/begin MEASUREMENT Com_stBCDGearEngmt "BCD Gear engagement" UBYTE OneToOne 1 100 0.00 255.0 FORMAT "%5.1" ECU_ADDRESS 0x6000F619 /end MEASUREMENT
/begin MEASUREMENT Com_stBrk "Status of Brk/FDR" UBYTE OneToOne 1 100 0.00 255.0 FORMAT "%5.1" ECU_ADDRESS 0x6000F616 /end MEASUREMENT
/begin MEASUREMENT Com_stBrkPedON "EBB brake Pedal ON status" UBYTE OneToOne 1 100 0.00 255.0 FORMAT "%5.1" ECU_ADDRESS 0x6000F613 /end MEASUREMENT
/begin MEASUREMENT Com_stCamHealDisp "Displaying of camera dirty" UBYTE OneToOne 1 100 0.00 255.0 FORMAT "%5.1" ECU_ADDRESS 0x6000F60A /end MEASUREMENT
/begin MEASUREMENT Com_stClth "Clutch Status" UBYTE OneToOne 1 100 0.00 255.0 FORMAT "%5.1" ECU_ADDRESS 0x6000EFD6 /end MEASUREMENT
/begin MEASUREMENT Com_stDispDmdEnvCdn "Request to display additional sign post information which is recognized. (R side)" UBYTE OneToOne 1 100 0.00 255.0 FORMAT "%5.1" ECU_ADDRESS 0x6000F5F6 /end MEASUREMENT
/begin MEASUREMENT Com_stDispDmdSignRi "Display demand of sign in knowledge(R side)" UBYTE OneToOne 1 100 0.00 255.0 FORMAT "%5.1" ECU_ADDRESS 0x6000F5F5 /end MEASUREMENT
/begin MEASUREMENT Com_stEAT3Mon "Status for EAT3 error monitoring" UBYTE OneToOne 1 100 0.00 255.0 FORMAT "%5.1" ECU_ADDRESS 0x6000F5EE /end MEASUREMENT
/begin MEASUREMENT Com_stEBB "EBB Status" UBYTE OneToOne 1 100 0.00 255.0 FORMAT "%5.1" ECU_ADDRESS 0x6000F5E6 /end MEASUREMENT
/begin MEASUREMENT Com_stEmgcyStrtReqOutSel "Emergency Engine Start Request" UBYTE OneToOne 1 100 0.00 255.0 FORMAT "%5.1" ECU_ADDRESS 0x6000F5CD /end MEASUREMENT
/begin MEASUREMENT Com_stEngCustRevMatchFct "Customization existence of Rev Match function" UBYTE OneToOne 1 100 0.00 255.0 FORMAT "%5.1" ECU_ADDRESS 0x6000EFCE /end MEASUREMENT
/begin MEASUREMENT Com_stEngInhibReq "Request status Message for Inhibition" UBYTE OneToOne 1 100 0.00 255.0 FORMAT "%5.1" ECU_ADDRESS 0x6000EFCD /end MEASUREMENT
/begin MEASUREMENT Com_stEngMapReq "Sport mode information for throttle progression request" UBYTE OneToOne 1 100 0.00 255.0 FORMAT "%5.1" ECU_ADDRESS 0x6000F5C6 /end MEASUREMENT
/begin MEASUREMENT Com_stEngRevMatchFct "Setting state of Rev Match function" UBYTE OneToOne 1 100 0.00 255.0 FORMAT "%5.1" ECU_ADDRESS 0x6000F5C5 /end MEASUREMENT
/begin MEASUREMENT Com_stEngSrvMod "Engine Service Mode Information" UBYTE B_TRUE 1 100 0.00 1.00000000000 BIT_MASK 0x1 FORMAT "%13.11" ECU_ADDRESS 0x6000F164 /end MEASUREMENT
/begin MEASUREMENT Com_stEVPIdleStopFail "Status for Idle Stop Failure for EVP" UBYTE OneToOne 1 100 0.00 255.0 FORMAT "%5.1" ECU_ADDRESS 0x6000F5CF /end MEASUREMENT
/begin MEASUREMENT Com_stEVPIdleStopReq "Status for Idle Stop enable disable Permission in EVP" UBYTE OneToOne 1 100 0.00 255.0 FORMAT "%5.1" ECU_ADDRESS 0x6000F5CE /end MEASUREMENT
/begin MEASUREMENT Com_stGbxNPos "Gearbox Neutral Position" UBYTE OneToOne 1 100 0.00 255.0 FORMAT "%5.1" ECU_ADDRESS 0x6000F5A6 /end MEASUREMENT
/begin MEASUREMENT Com_stGrip "Status Grip Powertrain" UBYTE dez 1 100 0.00 255.0 FORMAT "%5.1" ECU_ADDRESS 0x6000F5A2 /end MEASUREMENT
/begin MEASUREMENT Com_stIngearEngmt "Ingear engagement status" UBYTE OneToOne 1 100 0.00 255.0 FORMAT "%5.1" ECU_ADDRESS 0x6000F589 /end MEASUREMENT
/begin MEASUREMENT Com_stInShiftNeut "Actual transmission position for N-range" UBYTE B_TRUE 1 100 0.00 1.00000000000 BIT_MASK 0x1 FORMAT "%13.11" ECU_ADDRESS 0x70000A5B /end MEASUREMENT
/begin MEASUREMENT Com_stInShiftPrkg "Actual transmission position for P-range" UBYTE B_TRUE 1 100 0.00 1.00000000000 BIT_MASK 0x1 FORMAT "%13.11" ECU_ADDRESS 0x70000A5A /end MEASUREMENT
/begin MEASUREMENT Com_stISEBBFail "EBB failure information from VSA" UBYTE OneToOne 1 100 0.00 255.0 FORMAT "%5.1" ECU_ADDRESS 0x6000F58D /end MEASUREMENT
/begin MEASUREMENT Com_stLSFStrtValDmd "Low Speed Follow - Start Value Demand" UBYTE OneToOne 1 100 0.00 255.0 FORMAT "%5.1" ECU_ADDRESS 0x6000F585 /end MEASUREMENT
/begin MEASUREMENT Com_stMonMET "Error State in MET used for monitoring" UBYTE OneToOne 1 100 0.00 255.0 FORMAT "%5.1" ECU_ADDRESS 0x6000F576 /end MEASUREMENT
/begin MEASUREMENT Com_stPPos "status of gear park" UBYTE B_TRUE 1 100 0.00 1.00000000000 BIT_MASK 0x1 FORMAT "%13.11" ECU_ADDRESS 0x70000A59 /end MEASUREMENT
/begin MEASUREMENT Com_stRxEBBADeb "Debounced Status of EBBA Frame Reception" UBYTE OneToOne 1 100 0.00 255.0 FORMAT "%5.1" ECU_ADDRESS 0x6000F554 /end MEASUREMENT
/begin MEASUREMENT Com_stRxEBBAOk "Error Staus of EBBA Frame Reception" UBYTE OneToOne 1 100 0.00 255.0 FORMAT "%5.1" ECU_ADDRESS 0x6000F553 /end MEASUREMENT
/begin MEASUREMENT Com_stShiftPosnIndcn "Shift position indication for S-Matic" UBYTE OneToOne 1 100 0.00 255.0 FORMAT "%5.1" ECU_ADDRESS 0x6000F53C /end MEASUREMENT
/begin MEASUREMENT Com_stSptSwtDeb "Status of sport mode switch" UBYTE OneToOne 1 100 0.00 255.0 FORMAT "%5.1" ECU_ADDRESS 0x6000EFC4 /end MEASUREMENT
/begin MEASUREMENT Com_stStrtReqOutSel "Normal Engine Start Request" UBYTE OneToOne 1 100 0.00 255.0 FORMAT "%5.1" ECU_ADDRESS 0x6000F533 /end MEASUREMENT
/begin MEASUREMENT Com_stT50 "Status T50" UBYTE OneToOne 1 100 0.00 255.0 FORMAT "%5.1" ECU_ADDRESS 0x6000F52F /end MEASUREMENT
/begin MEASUREMENT Com_stTCamAbnormDisp "Displaying of camera temperature abnormality" UBYTE OneToOne 1 100 0.00 255.0 FORMAT "%5.1" ECU_ADDRESS 0x6000F52C /end MEASUREMENT
/begin MEASUREMENT Com_stTSRClrReas "Clear Reason for TSR(Camera unit)" UBYTE OneToOne 1 100 0.00 255.0 FORMAT "%5.1" ECU_ADDRESS 0x6000F52A /end MEASUREMENT
/begin MEASUREMENT Com_trqDesENGT1 "Torque Demand by driver" SLONG TrqCom 1 100 -13107.2000000 13107.0000000 FORMAT "%13.7" ECU_ADDRESS 0x600039A8 /end MEASUREMENT
/begin MEASUREMENT Com_trqDesENGT2 "Torque Data By Driver Request" SLONG RBPtCel_tq_1p0_1 1 100 -2147483648.00 2147483647.00 FORMAT "%13.2" ECU_ADDRESS 0x600039A4 /end MEASUREMENT
/begin MEASUREMENT Com_trqEngENG16 "Engine Torque Data for ENG16 frame" SWORD TrqCom 1 100 -6553.600 6553.400 FORMAT "%8.3" ECU_ADDRESS 0x60000688 /end MEASUREMENT
/begin MEASUREMENT Com_trqEngEstimd "Estimated engine Torque" SWORD TrqCom 1 100 -6553.600 6553.400 FORMAT "%8.3" ECU_ADDRESS 0x60009250 /end MEASUREMENT
/begin MEASUREMENT Conv_trqOilCoolrPmp "Compensation torque from converter oil cooler pump" SWORD Trq 1 100 -3276.800 3276.700 FORMAT "%8.3" ECU_ADDRESS 0x60009236 /end MEASUREMENT
/begin MEASUREMENT Conv_trqOilCoolrPmpRepl "Replacement value for compensation torque from converter oil cooler pump" SWORD Trq 1 100 -3276.800 3276.700 FORMAT "%8.3" ECU_ADDRESS 0x60009234 /end MEASUREMENT
/begin MEASUREMENT CoPOM_bRelDstCEng "Release of antijerking on ENG" UBYTE B_TRUE 1 100 0.00 1.00000000000 BIT_MASK 0x1 FORMAT "%13.11" ECU_ADDRESS 0x6000F1B2 /end MEASUREMENT
/begin MEASUREMENT CoPOM_facTrqDynDist "factor for torque distribution of low idle controler" SWORD Fact 1 100 -4.000000 3.999878 FORMAT "%8.6" ECU_ADDRESS 0x60009318 /end MEASUREMENT
/begin MEASUREMENT CoPOM_numStrt "Start number (Request to start) from OpMode module" UBYTE OneToOne 1 100 0.00 255.0 FORMAT "%5.1" ECU_ADDRESS 0x6000F733 /end MEASUREMENT
/begin MEASUREMENT CoPOM_stM "Operating mode of hybrid system" UBYTE OneToOne 1 100 0.00 255.0 FORMAT "%5.1" ECU_ADDRESS 0x6000F730 /end MEASUREMENT
/begin MEASUREMENT CoPOM_stMnSt "Operation mode of hybrid system (binary representation)" UBYTE OneToOne 1 100 0.00 255.0 FORMAT "%5.1" ECU_ADDRESS 0x6000F72F /end MEASUREMENT
/begin MEASUREMENT CoPOM_tqDesEmQsty "Desired torque of the electric motor considering interventions from engine coordinator." SWORD Trq 1 100 -3276.800 3276.700 FORMAT "%8.3" ECU_ADDRESS 0x60009316 /end MEASUREMENT
/begin MEASUREMENT CoPOM_tqEmDynMin "Minimum dynamic torque of the electric motor for the usage in torque structure." SWORD Trq 1 100 -3276.800 3276.700 FORMAT "%8.3" ECU_ADDRESS 0x60009314 /end MEASUREMENT
/begin MEASUREMENT CoPT_bTraPrtActvLead "Actual torque co-ordination on lead path through transmission protection active" UBYTE B_TRUE 1 100 0.00 1.00000000000 BIT_MASK 0x1 FORMAT "%13.11" ECU_ADDRESS 0x70000A6C /end MEASUREMENT
/begin MEASUREMENT CoPT_bTraShftActvDes "Actual torque co-ordination on Des path through transmission shifting active" UBYTE B_TRUE 1 100 0.00 1.00000000000 BIT_MASK 0x1 FORMAT "%13.11" ECU_ADDRESS 0x70000A6B /end MEASUREMENT
/begin MEASUREMENT CoPT_bTraShftActvLead "Actual torque co-ordination on Lead path through transmission shifting active" UBYTE B_TRUE 1 100 0.00 1.00000000000 BIT_MASK 0x1 FORMAT "%13.11" ECU_ADDRESS 0x70000A6A /end MEASUREMENT
/begin MEASUREMENT CoPT_trqClthWoIntv "Set point torque without interventions" SWORD Trq 1 100 -3276.800 3276.700 FORMAT "%8.3" ECU_ADDRESS 0x6000930A /end MEASUREMENT
/begin MEASUREMENT CoPT_trqDesCompEng "Application parameter for Engine torque desired for compensation" SWORD Trq 1 100 -3276.800 3276.700 FORMAT "%8.3" ECU_ADDRESS 0x60013E56 /end MEASUREMENT
/begin MEASUREMENT CoPT_trqResvEng "Combustion engine torque reserve" SWORD Trq 1 100 -3276.800 3276.700 FORMAT "%8.3" ECU_ADDRESS 0x60013E58 /end MEASUREMENT
/begin MEASUREMENT CoVeh_flgPtcShtOff "flag PTC de-activation request" UBYTE B_TRUE 1 100 0.00 1.00000000000 BIT_MASK 0x1 FORMAT "%13.11" ECU_ADDRESS 0x70000A5D /end MEASUREMENT
/begin MEASUREMENT CoVeh_tqDrvOff2MaxAC "Maximum AC torque in drive off condition" SWORD Trq 1 100 -3276.800 3276.700 FORMAT "%8.3" ECU_ADDRESS 0x600092EC /end MEASUREMENT
/begin MEASUREMENT CoVeh_tqIdleMaxAC "Maximum AC torque in idle condition" SWORD Trq 1 100 -3276.800 3276.700 FORMAT "%8.3" ECU_ADDRESS 0x600092EA /end MEASUREMENT
/begin MEASUREMENT CoVeh_trqDesComp "compensation torque by active low idle governor (signal 3)" SWORD Trq 1 100 -3276.800 3276.700 FORMAT "%8.3" ECU_ADDRESS 0x60013E5C /end MEASUREMENT
/begin MEASUREMENT CoVM_bSIActvDes "Stability intervention active." UBYTE B_TRUE 1 100 0.00 1.00000000000 BIT_MASK 0x1 FORMAT "%13.11" ECU_ADDRESS 0x70000A69 /end MEASUREMENT
/begin MEASUREMENT CoVM_bSIActvLead "Actual torque coordination VSC-sided on lead path active" UBYTE B_TRUE 1 100 0.00 1.00000000000 BIT_MASK 0x1 FORMAT "%13.11" ECU_ADDRESS 0x70000A68 /end MEASUREMENT
/begin MEASUREMENT CoVM_trqLead "Propulsion torque after coordination with ESP interventions(wheel torque)" SLONG TrqPrpHigh 1 100 -214748364.800 214748364.700 FORMAT "%13.3" ECU_ADDRESS 0x600039C8 /end MEASUREMENT
/begin MEASUREMENT CoVOM_stAutoRstrtReq "status of Automatic restart request" UBYTE B_TRUE 1 100 0.00 1.00000000000 BIT_MASK 0x1 FORMAT "%13.11" ECU_ADDRESS 0x70000A62 /end MEASUREMENT
/begin MEASUREMENT CoVOM_stAutoRstrtReqGr1 "Automatic engine restart request group 1 condition" UBYTE B_TRUE 1 100 0.00 1.00000000000 BIT_MASK 0x1 FORMAT "%13.11" ECU_ADDRESS 0x70000A61 /end MEASUREMENT
/begin MEASUREMENT CoVOM_stAutoRstrtReqGr2 "Automatic engine restart request group 2 condition" UBYTE B_TRUE 1 100 0.00 1.00000000000 BIT_MASK 0x1 FORMAT "%13.11" ECU_ADDRESS 0x70000A60 /end MEASUREMENT
/begin MEASUREMENT CoVOM_stRstrtNoPtd "Variant Device driver for digital input" UBYTE B_TRUE 1 100 0.00 1.00000000000 BIT_MASK 0x1 FORMAT "%13.11" ECU_ADDRESS 0x70000A5E /end MEASUREMENT
/begin MEASUREMENT CoVOM_stStopRelsMask "Stop release mask status in operation state" ULONG OneToOne 1 100 0.00 4294967295.00 FORMAT "%13.2" ECU_ADDRESS 0x600038DC /end MEASUREMENT
/begin MEASUREMENT CoVOM_stStopReqMask "Stop request mask status in opertation state" ULONG OneToOne 1 100 0.00 4294967295.00 FORMAT "%13.2" ECU_ADDRESS 0x600038D4 /end MEASUREMENT
/begin MEASUREMENT CoVOM_stStrtReqMask "Status of the start request mask" ULONG OneToOne 1 100 0.00 4294967295.00 FORMAT "%13.2" ECU_ADDRESS 0x600038C8 /end MEASUREMENT
/begin MEASUREMENT CrCtl_aReq "Acceleration request of Cruise Control" SWORD Acc 1 100 -32.76800 32.76700 FORMAT "%8.5" ECU_ADDRESS 0x600089CC /end MEASUREMENT
/begin MEASUREMENT CrCtl_stIDASTqModFailr "IDAS torque mode fail status" UBYTE OneToOne 1 100 0.00 255.0 FORMAT "%5.1" ECU_ADDRESS 0x6000F47D /end MEASUREMENT
/begin MEASUREMENT CrCUI_stPlusRDrvMod "Status of +R drive mode actived" UBYTE OneToOne 1 100 0.00 1.000 FORMAT "%5.3" ECU_ADDRESS 0x6000F152 /end MEASUREMENT
/begin MEASUREMENT CrC_stKey "Cruise Control Key status" UBYTE OneToOne 1 100 0.00 255.0 FORMAT "%5.1" ECU_ADDRESS 0x6000F4B0 /end MEASUREMENT
/begin MEASUREMENT CThmst_r "Setpoint value for coolant thermostat actuator" SWORD Prc 1 100 -400.0000 399.9878 FORMAT "%8.4" ECU_ADDRESS 0x60009344 /end MEASUREMENT
/begin MEASUREMENT Dfftl_bLowRng "Status reduction gearbox" UBYTE B_TRUE 1 100 0.00 1.00000000000 BIT_MASK 0x1 FORMAT "%13.11" ECU_ADDRESS 0x70000A53 /end MEASUREMENT
/begin MEASUREMENT dmsnte_w_msg "Standardized mass flow change through PCV" SWORD m_q0p1 1 100 -3276.800 3276.700 FORMAT "%8.3" ECU_ADDRESS 0x60008DA4 /end MEASUREMENT
/begin MEASUREMENT DReqSwt_stClrDeb "Status of Diagnostic Memory Clear Switch after debouncing" UBYTE OneToOne 1 100 0.00 255.0 FORMAT "%5.1" ECU_ADDRESS 0x5000600A /end MEASUREMENT
/begin MEASUREMENT DrvPrgSwt_bSprt "bit information: sport driving program is active" UBYTE B_TRUE 1 100 0.00 1.00000000000 BIT_MASK 0x1 FORMAT "%13.11" ECU_ADDRESS 0x6000F14B /end MEASUREMENT
/begin MEASUREMENT DrvPrgSwt_bSprtPlus "bit information: sport plus driving program is active" UBYTE B_TRUE 1 100 0.00 1.00000000000 BIT_MASK 0x1 FORMAT "%13.11" ECU_ADDRESS 0x70000A52 /end MEASUREMENT
/begin MEASUREMENT DrvPrgSwt_bWntr "bit information: winter driving program is active" UBYTE B_TRUE 1 100 0.00 1.00000000000 BIT_MASK 0x1 FORMAT "%13.11" ECU_ADDRESS 0x6000F14A /end MEASUREMENT
/begin MEASUREMENT DrvPrgSwt_stActEco "Driver program switch for select the mode of operation ECO(DrvPrgSwt_stActEco =1) and Normal mode(DrvPrgSwt_stActEco =0)" UBYTE B_TRUE 1 100 0.00 1.00000000000 BIT_MASK 0x1 FORMAT "%13.11" ECU_ADDRESS 0x6000F149 /end MEASUREMENT
/begin MEASUREMENT DsplCtl_nEngSpdDisp "Display engine speed" SWORD EngN 1 100 -16384.00 16383.50 FORMAT "%8.2" ECU_ADDRESS 0x600091EE /end MEASUREMENT
/begin MEASUREMENT DsplCtl_stPredEngSpd "Predicted engine speed state" UBYTE OneToOne 1 100 0.00 255.0 FORMAT "%5.1" ECU_ADDRESS 0x6000F462 /end MEASUREMENT
/begin MEASUREMENT Dspl_bVelInMiles "Unit of the displayed vehicle speed" UBYTE B_TRUE 1 100 0.00 1.00000000000 BIT_MASK 0x1 FORMAT "%13.11" ECU_ADDRESS 0x6000F148 /end MEASUREMENT
/begin MEASUREMENT Dspl_stCrsASLSelInfo "Cruise Control / ASL select information" UBYTE OneToOne 1 100 0.00 255.0 FORMAT "%5.1" ECU_ADDRESS 0x6000F460 /end MEASUREMENT
/begin MEASUREMENT Ebs_iBatt "Current from battery sensor after filtering" SWORD i_q0p1_A 1 100 -3276.800 3276.700 FORMAT "%8.3" ECU_ADDRESS 0x600089B0 /end MEASUREMENT
/begin MEASUREMENT EEM_chBatt "battery charge (SOF)" SWORD Ch_Ah_q0p5_COMPU 1 100 -16384.00 16383.50 FORMAT "%8.2" ECU_ADDRESS 0x600089C4 /end MEASUREMENT
/begin MEASUREMENT EEM_stBattChAc "Accuracy state of the battery charge" UBYTE OneToOne 1 100 0.00 255.0 FORMAT "%5.1" ECU_ADDRESS 0x6000EFB6 /end MEASUREMENT
/begin MEASUREMENT Eep_stISSStorgDiagActv "" UBYTE OneToOne 1 100 0.00 255.0 FORMAT "%5.1" ECU_ADDRESS 0x6000EFA9 /end MEASUREMENT
/begin MEASUREMENT EGRVlv_stGovDesVal_mp "" UBYTE B_TRUE 1 100 0.00 1.00000000000 BIT_MASK 0x1 FORMAT "%13.11" ECU_ADDRESS 0x70003622 /end MEASUREMENT
/begin MEASUREMENT ehlpks_sc "Auxiliary error flag: knock sensor loose fit detection error." UBYTE dez 1 100 0.00 255.0 FORMAT "%5.1" ECU_ADDRESS 0x6000F2FC /end MEASUREMENT
/begin MEASUREMENT ElecLd_iSensLd "Sensed value of the Electric Load current as read from sensor" SWORD Curr_A 1 100 -327.6800 327.6700 FORMAT "%8.4" ECU_ADDRESS 0x60009182 /end MEASUREMENT
/begin MEASUREMENT ElecLd_stSRCChk "Status of SRC monitoring for ElecLd" UBYTE OneToOne 1 100 0.00 255.0 FORMAT "%5.1" ECU_ADDRESS 0x6000F452 /end MEASUREMENT
/begin MEASUREMENT ElM_stOperModDes "Desired operation mode of electric motor" UBYTE OneToOne 1 100 0.00 255.0 FORMAT "%5.1" ECU_ADDRESS 0x6000F454 /end MEASUREMENT
/begin MEASUREMENT ElM_tqActWoAcsyCmp "Actual torque from E-machine in Torque mode but set to 0Nm in Voltage mode" SWORD Trq 1 100 -3276.800 3276.700 FORMAT "%8.3" ECU_ADDRESS 0x600091AC /end MEASUREMENT
/begin MEASUREMENT ElM_tqDes "Desired torque of electric motor" SWORD Trq 1 100 -3276.800 3276.700 FORMAT "%8.3" ECU_ADDRESS 0x600091AA /end MEASUREMENT
/begin MEASUREMENT ElM_tqMaxGenr "Maximum allowed generator torque of electric motor" SWORD Trq 1 100 -3276.800 3276.700 FORMAT "%8.3" ECU_ADDRESS 0x600091A8 /end MEASUREMENT
/begin MEASUREMENT ElM_tqMaxTqCtrl "Positive torque limitation in torque controlled mode" SWORD Trq 1 100 -3276.800 3276.700 FORMAT "%8.3" ECU_ADDRESS 0x600091A6 /end MEASUREMENT
/begin MEASUREMENT ElM_tqMinTqCtrl "Negative torque limitation in torque controlled mode" SWORD Trq 1 100 -3276.800 3276.700 FORMAT "%8.3" ECU_ADDRESS 0x600091A4 /end MEASUREMENT
/begin MEASUREMENT ElM_trqAct "Current torque of the electrical engine" SWORD Trq 1 100 -3276.800 3276.700 FORMAT "%8.3" ECU_ADDRESS 0x600091A2 /end MEASUREMENT
/begin MEASUREMENT EngDa_tFld "Engine temperature field" SWORD Temp_Cels 1 100 -3549.940 3003.560 FORMAT "%8.3" ARRAY_SIZE 4 ECU_ADDRESS 0x50005CD0 /end MEASUREMENT
/begin MEASUREMENT EngDa_tiEngOnOBD "Engine on time (OBD)" ULONG TimeEngOn 1 100 0.00 4294967295.00 FORMAT "%13.2" ECU_ADDRESS 0x600038B8 /end MEASUREMENT
/begin MEASUREMENT EngPrt_bNLimRed "Reduce of maximum engine speed" UBYTE B_TRUE 1 100 0.00 1.00000000000 BIT_MASK 0x1 FORMAT "%13.11" ECU_ADDRESS 0x6000F13F /end MEASUREMENT
/begin MEASUREMENT EngStrt_EomWrmUp3_I.stOperMod "Class instance for interface between the warm up coordinator and CoEng (third request) / Priority-element of the operation mode structure" ULONG OneToOne 1 100 0.00 4294967295.00 FORMAT "%13.2" ECU_ADDRESS 0x70001F54 /end MEASUREMENT
/begin MEASUREMENT EngStrt_EomWrmUp3_I.stOperModPrio "Class instance for interface between the warm up coordinator and CoEng (third request) / Stage-element of the operation mode structure" UBYTE OneToOne 1 100 0.00 255.0 FORMAT "%5.1" ECU_ADDRESS 0x70001F58 /end MEASUREMENT
/begin MEASUREMENT EngStrt_EomWrmUp3_I.stOperModStg "Class instance for interface between the warm up coordinator and CoEng (third request) / Operation-mode element of the operation mode structure" UWORD OneToOne 1 100 0.00 65535.00 FORMAT "%8.2" ECU_ADDRESS 0x70001F5A /end MEASUREMENT
/begin MEASUREMENT EngStrt_nEngRstrtStgy2ThdLo "engine threshold restart strategy: nEng greater threshold means stgy 2, less than means stgy 3" SWORD EngN 1 100 -16384.00 16383.50 FORMAT "%8.2" ECU_ADDRESS 0x60008996 /end MEASUREMENT
/begin MEASUREMENT EnvT_stTSens "Status of the EnvT sensors" UBYTE OneToOne 1 100 0.00 255.0 FORMAT "%5.1" ECU_ADDRESS 0x6000F445 /end MEASUREMENT
/begin MEASUREMENT EnvT_tSens "Raw physical value" SWORD Temp_Cels 1 100 -3549.940 3003.560 FORMAT "%8.3" ECU_ADDRESS 0x6000915A /end MEASUREMENT
/begin MEASUREMENT EnvT_uRaw "Sensor signal raw voltage" SWORD Volt 1 100 0.00 6553.400 FORMAT "%8.3" ECU_ADDRESS 0x60009158 /end MEASUREMENT
/begin MEASUREMENT ERClntVlv_r "Commanded value from application SW" SWORD Prc 1 100 -400.0000 399.9878 FORMAT "%8.4" ECU_ADDRESS 0x600091BA /end MEASUREMENT
/begin MEASUREMENT ESS_bEngStrtEna "Start release from the electrical system" UBYTE B_TRUE 1 100 0.00 1.00000000000 BIT_MASK 0x1 FORMAT "%13.11" ECU_ADDRESS 0x700009AD /end MEASUREMENT
/begin MEASUREMENT etakhmn_w_msg "minimal necessary engine efficiency during catalyst heating during cold start legacy" UWORD fak_uw_b2 1 100 0.00 1.999969 FORMAT "%8.6" ECU_ADDRESS 0x60008540 /end MEASUREMENT
/begin MEASUREMENT etakhtrp_w_msg "desired engine efficiency for catalyst heating in case of end of line test requirement" UWORD fak_uw_b2 1 100 0.00 1.999969 FORMAT "%8.6" ECU_ADDRESS 0x6000853E /end MEASUREMENT
/begin MEASUREMENT ExhMgT_flgRelsLamCptProtn "Flag indicates EGR is ready for component protection" UBYTE B_TRUE 1 100 0.00 1.00000000000 BIT_MASK 0x1 FORMAT "%13.11" ECU_ADDRESS 0x70000964 /end MEASUREMENT
/begin MEASUREMENT ExhMgT_ratFillgCptProtn "max attainable air charge at full load for component protection" UWORD rel_uw_q0p0234 1 100 0.00 1535.977 FORMAT "%8.3" ECU_ADDRESS 0x600086F8 /end MEASUREMENT
/begin MEASUREMENT ExhMgT_tCat1SelnRst "selected catalyst temperature in the dependence of the catalyst heating requirement is reset" SWORD Temp_Cels 1 100 -3549.940 3003.560 FORMAT "%8.3" ECU_ADDRESS 0x60009152 /end MEASUREMENT
/begin MEASUREMENT ExhMod_flgStTMdlIninCat1B1 "Status of the temperature model intialisation of Catalyst 1 Bank 1" UBYTE B_TRUE 1 100 0.00 1.00000000000 BIT_MASK 0x1 FORMAT "%13.11" ECU_ADDRESS 0x70000944 /end MEASUREMENT
/begin MEASUREMENT ExhMod_flgStTMdlIninCat2B1 "Status of the temperature model intialisation of Catalyst 2 Bank 1" UBYTE B_TRUE 1 100 0.00 1.00000000000 BIT_MASK 0x1 FORMAT "%13.11" ECU_ADDRESS 0x70000943 /end MEASUREMENT
/begin MEASUREMENT ExhMod_pRelPfilDs "Modelled relative pressure downstream of particulate filter" SWORD Pres_hPa 1 100 -32768.00 32767.00 FORMAT "%8.2" ECU_ADDRESS 0x60009146 /end MEASUREMENT
/begin MEASUREMENT Fan2_r "Fan demand fan 2" SWORD Prc 1 100 -400.0000 399.9878 FORMAT "%8.4" ECU_ADDRESS 0x60009144 /end MEASUREMENT
/begin MEASUREMENT FanCtl_rFan1ActMdl "duty cycle of fan for fuel temperature model" UBYTE tv_ub_b100 1 100 0.00 99.61 FORMAT "%5.2" ECU_ADDRESS 0x6000F439 /end MEASUREMENT
/begin MEASUREMENT FanCtl_stFanCtrlEnd "Status of fan control end" UBYTE B_TRUE 1 100 0.00 1.00000000000 BIT_MASK 0x1 FORMAT "%13.11" ECU_ADDRESS 0x6000EE43 /end MEASUREMENT
/begin MEASUREMENT Fan_rPs "PWM output ratio for fan actuator 1" SWORD DtyCyc 1 100 -327.6800 327.6700 FORMAT "%8.4" ECU_ADDRESS 0x60008870 /end MEASUREMENT
/begin MEASUREMENT fethmnmx "ethanol content interpolation factor" UBYTE fak_ub_b2 1 100 0.00 1.992188 FORMAT "%8.6" ECU_ADDRESS 0x6000F2FB /end MEASUREMENT
/begin MEASUREMENT fethmnmx_w "ethanol content interpolation factor" UWORD fak_uw_b2 1 100 0.00 1.999969 FORMAT "%8.6" ECU_ADDRESS 0x60008B1C /end MEASUREMENT
/begin MEASUREMENT FfPrm_facFuAdpnNeut "Fuel adaptation neutral value" UWORD fak_uw_b2 1 100 0.00 1.999969 FORMAT "%8.6" ECU_ADDRESS 0x60008608 /end MEASUREMENT
/begin MEASUREMENT FfPrm_flgEthFastAdpn "Ethanol fuel fast adaptation" UBYTE B_TRUE 1 100 0.00 1.00000000000 BIT_MASK 0x1 FORMAT "%13.11" ECU_ADDRESS 0x6000EE3E /end MEASUREMENT
/begin MEASUREMENT FfPrm_flgFuAdpnInhbn "Ethanol fuel adaptation inhibition" UBYTE B_TRUE 1 100 0.00 1.00000000000 BIT_MASK 0x1 FORMAT "%13.11" ECU_ADDRESS 0x6000EE3B /end MEASUREMENT
/begin MEASUREMENT FfPrm_flgModCalc_msg "Model based ethanol content calculation active" UBYTE B_TRUE 1 100 0.00 1.00000000000 BIT_MASK 0x1 FORMAT "%13.11" ECU_ADDRESS 0x7000093F /end MEASUREMENT
/begin MEASUREMENT FfPrm_flgNeutValReq "Fuel adaptation neutral value request" UBYTE B_TRUE 1 100 0.00 1.00000000000 BIT_MASK 0x1 FORMAT "%13.11" ECU_ADDRESS 0x6000EE3A /end MEASUREMENT
/begin MEASUREMENT ffuelev_w_msg "Correction factor fuel blend for injection time at injection valve" UWORD fak_uw_b2 1 100 0.00 1.999969 FORMAT "%8.6" ECU_ADDRESS 0x60008B1A /end MEASUREMENT
/begin MEASUREMENT fho "Altitude correction factor" UBYTE fak_ub_b4 1 100 0.00 3.984 FORMAT "%5.3" ECU_ADDRESS 0x6000F2F9 /end MEASUREMENT
/begin MEASUREMENT flamlu_w_msg "Ratio total charge to charge in cylinder" UWORD fak_uw_b16 1 100 0.00 15.99976 FORMAT "%8.5" ECU_ADDRESS 0x60008B18 /end MEASUREMENT
/begin MEASUREMENT flb_w_msg "Factor charge-movement" UWORD fak_uw_b1 1 100 0.00 0.9999847 FORMAT "%9.7" ECU_ADDRESS 0x60008B14 /end MEASUREMENT
/begin MEASUREMENT FlMA_flgIninFinshdBGAUSG "Initialization of BGAUSG has finished" UBYTE B_TRUE 1 100 0.00 1.00000000000 BIT_MASK 0x1 FORMAT "%13.11" ECU_ADDRESS 0x70000935 /end MEASUREMENT
/begin MEASUREMENT FlMA_flgIninFinshdLAMKORRLL "Initialization of LAMKORRLL has finished" UBYTE B_TRUE 1 100 0.00 1.00000000000 BIT_MASK 0x1 FORMAT "%13.11" ECU_ADDRESS 0x70000934 /end MEASUREMENT
/begin MEASUREMENT FlSys_dvolFlCons "Fuel consumption l/h of the torque relevant injection quantity" SWORD FlConsum_l_h 1 100 -327.6800 327.6700 FORMAT "%8.4" ECU_ADDRESS 0x7000539A /end MEASUREMENT
/begin MEASUREMENT fra_w "multiplicative correction of the mixture adaptation (word)" UWORD fak_uw_b2 1 100 0.00 1.999969 FORMAT "%8.6" ECU_ADDRESS 0x60008B12 /end MEASUREMENT
/begin MEASUREMENT FrmR_nConvTurb "Unfiltered turbine speed (n_t_v)" UWORD nmot_q1 1 100 0.00 65535.00 FORMAT "%8.2" ECU_ADDRESS 0x60008C1E /end MEASUREMENT
/begin MEASUREMENT ftead_w "factor fuel purge adaptation" SWORD fak_sw_b64 1 100 -64.00000 63.99805 FORMAT "%8.5" ECU_ADDRESS 0x60008D9A /end MEASUREMENT
/begin MEASUREMENT FuPHi_EomHiPSnsrDiag_I.stOperMod "Instance of class CoEOM_OperMod_t for Eom demand based on high pressure fuel sensor diagnosis / Priority-element of the operation mode structure" ULONG OneToOne 1 100 0.00 4294967295.00 FORMAT "%13.2" ECU_ADDRESS 0x70001F4C /end MEASUREMENT
/begin MEASUREMENT FuPHi_EomHiPSnsrDiag_I.stOperModPrio "Instance of class CoEOM_OperMod_t for Eom demand based on high pressure fuel sensor diagnosis / Stage-element of the operation mode structure" UBYTE OneToOne 1 100 0.00 255.0 FORMAT "%5.1" ECU_ADDRESS 0x70001F50 /end MEASUREMENT
/begin MEASUREMENT FuPHi_EomHiPSnsrDiag_I.stOperModStg "Instance of class CoEOM_OperMod_t for Eom demand based on high pressure fuel sensor diagnosis / Operation-mode element of the operation mode structure" UWORD OneToOne 1 100 0.00 65535.00 FORMAT "%8.2" ECU_ADDRESS 0x70001F52 /end MEASUREMENT
/begin MEASUREMENT FuPHi_flgOnOffCtrlFadeOut "Condition permanent fade out of mass flow valve during on off control active" UBYTE B_TRUE 1 100 0.00 1.00000000000 BIT_MASK 0x1 FORMAT "%13.11" ECU_ADDRESS 0x70000930 /end MEASUREMENT
/begin MEASUREMENT GbxMTAT_stTraType "Type of Transmission selected from hardware" UBYTE OneToOne 1 100 0.00 255.0 FORMAT "%5.1" ECU_ADDRESS 0x6000F427 /end MEASUREMENT
/begin MEASUREMENT Gbx_bASTIntv "Message for status of AST intervention" UBYTE B_TRUE 1 100 0.00 1.00000000000 BIT_MASK 0x1 FORMAT "%13.11" ECU_ADDRESS 0x700008F6 /end MEASUREMENT
/begin MEASUREMENT Gbx_bASTNeutr "Message for status of neutral state of AST" UBYTE OneToOne 1 100 0.00 255.0 FORMAT "%5.1" ECU_ADDRESS 0x60014139 /end MEASUREMENT
/begin MEASUREMENT Gbx_bATSlipOpn "Gear box ATS Slip open" UBYTE B_TRUE 1 100 0.00 1.00000000000 BIT_MASK 0x1 FORMAT "%13.11" ECU_ADDRESS 0x6000F100 /end MEASUREMENT
/begin MEASUREMENT Gbx_bGearShftActv "Status of Gear Shift" UBYTE B_TRUE 1 100 0.00 1.00000000000 BIT_MASK 0x1 FORMAT "%13.11" ECU_ADDRESS 0x700008F5 /end MEASUREMENT
/begin MEASUREMENT Gbx_bHaltDisEgdActv "stand still disengagement of the gearbox active" UBYTE B_TRUE 1 100 0.00 1.00000000000 BIT_MASK 0x1 FORMAT "%13.11" ECU_ADDRESS 0x700008F4 /end MEASUREMENT
/begin MEASUREMENT Gbx_bLimp "Gearbox in limp home mode" UBYTE B_TRUE 1 100 0.00 1.00000000000 BIT_MASK 0x1 FORMAT "%13.11" ECU_ADDRESS 0x700008F3 /end MEASUREMENT
/begin MEASUREMENT Gbx_bNCmp "Gear box Compensation" UBYTE B_TRUE 1 100 0.00 1.00000000000 BIT_MASK 0x1 FORMAT "%13.11" ECU_ADDRESS 0x6000F0FE /end MEASUREMENT
/begin MEASUREMENT Gbx_bOvrRstrtActv "Support of overrun switch off" UBYTE B_TRUE 1 100 0.00 1.00000000000 BIT_MASK 0x1 FORMAT "%13.11" ECU_ADDRESS 0x700008F2 /end MEASUREMENT
/begin MEASUREMENT Gbx_bRevGear "Message for active status of reverse gear shifting" UBYTE B_TRUE 1 100 0.00 1.00000000000 BIT_MASK 0x1 FORMAT "%13.11" ECU_ADDRESS 0x700008F1 /end MEASUREMENT
/begin MEASUREMENT Gbx_bSailActv "ComCIL interface for CAN signal GE2_Segeln_aktiv" UBYTE B_TRUE 1 100 0.00 1.00000000000 BIT_MASK 0x1 FORMAT "%13.11" ECU_ADDRESS 0x700008F0 /end MEASUREMENT
/begin MEASUREMENT Gbx_bTIIIntv "Release for increasing gearbox intervention torque of received" UBYTE B_TRUE 1 100 0.00 1.00000000000 BIT_MASK 0x1 FORMAT "%13.11" ECU_ADDRESS 0x700008EF /end MEASUREMENT
/begin MEASUREMENT Gbx_bTSCIntv "Release for decreasing gearbox intervention torque of received" UBYTE B_TRUE 1 100 0.00 1.00000000000 BIT_MASK 0x1 FORMAT "%13.11" ECU_ADDRESS 0x700008EE /end MEASUREMENT
/begin MEASUREMENT Gbx_flgNCtrlImp "Operation of N control execution flag" UBYTE B_TRUE 1 100 0.00 1.00000000000 BIT_MASK 0x1 FORMAT "%13.11" ECU_ADDRESS 0x700008ED /end MEASUREMENT
/begin MEASUREMENT Gbx_flgNCtrlRetStrt "N control return judgement flag at brake ON" UBYTE B_TRUE 1 100 0.00 1.00000000000 BIT_MASK 0x1 FORMAT "%13.11" ECU_ADDRESS 0x700008EC /end MEASUREMENT
/begin MEASUREMENT Gbx_nASTDes "Synchronized desired engine speed" SWORD EngN 1 100 -16384.00 16383.50 FORMAT "%8.2" ECU_ADDRESS 0x600090DC /end MEASUREMENT
/begin MEASUREMENT Gbx_nRrngEngSpdInh "Maximum engine speed for rear gear sent from gearbox" SWORD EngN 1 100 -16384.00 16383.50 FORMAT "%8.2" ECU_ADDRESS 0x70003BC4 /end MEASUREMENT
/begin MEASUREMENT Gbx_numGear "Status of Actual gear" SBYTE dez 1 100 -128.0 127.0 FORMAT "%5.1" ECU_ADDRESS 0x6000F7B8 /end MEASUREMENT
/begin MEASUREMENT Gbx_numGearTrgt "Status of Desired gear" SWORD OneToOne 1 100 -32768.00 32767.00 FORMAT "%8.2" ECU_ADDRESS 0x600006CC /end MEASUREMENT
/begin MEASUREMENT Gbx_ratOilCoolrPmp "Gear box oil pump load ratio over CAN" SWORD Prc 1 100 -400.0000 399.9878 FORMAT "%8.4" ECU_ADDRESS 0x600090CE /end MEASUREMENT
/begin MEASUREMENT Gbx_rConvSlip "Transmission torque converter slip" SWORD CrCtlSlipRat 1 100 -163.8400 163.8350 FORMAT "%8.4" ECU_ADDRESS 0x600090D2 /end MEASUREMENT
/begin MEASUREMENT Gbx_rFanClgDem "Percentage of Fan Cooling Demand" SWORD Prc 1 100 -400.0000 399.9878 FORMAT "%8.4" ECU_ADDRESS 0x60013F68 /end MEASUREMENT
/begin MEASUREMENT Gbx_rTrq "Transmission function information from Gearbox ECU" SWORD TransR 1 100 -327.6800 327.6700 FORMAT "%8.4" ECU_ADDRESS 0x600090D0 /end MEASUREMENT
/begin MEASUREMENT Gbx_rTrqTra "Message for ratio of transmission torque" SWORD TransR 1 100 -327.6800 327.6700 FORMAT "%8.4" ECU_ADDRESS 0x70003BC2 /end MEASUREMENT
/begin MEASUREMENT Gbx_stHaltDisEgdActv "Stand still disengagement of the gearbox status" UBYTE OneToOne 1 100 0.00 255.0 FORMAT "%5.1" ECU_ADDRESS 0x6000EF6A /end MEASUREMENT
/begin MEASUREMENT Gbx_stRevLck "The control value recieved from ASW for Lock control(ON/OFF)" UBYTE OneToOne 1 100 0.00 255.0 FORMAT "%5.1" ECU_ADDRESS 0x6000F423 /end MEASUREMENT
/begin MEASUREMENT Gbx_stSpstReq "start stop request from Gearbox ECU via CAN" UBYTE OneToOne 1 100 0.00 255.0 FORMAT "%5.1" ECU_ADDRESS 0x6000F420 /end MEASUREMENT
/begin MEASUREMENT Gbx_tClntDes "Set point value of the coolant temperature (via CAN)" SWORD Temp_Cels 1 100 -3549.940 3003.560 FORMAT "%8.3" ECU_ADDRESS 0x600090CC /end MEASUREMENT
/begin MEASUREMENT Gbx_tiASTDes "Synchronization time" SWORD Time_s 1 100 -327.6800 327.6700 FORMAT "%8.4" ECU_ADDRESS 0x600090C8 /end MEASUREMENT
/begin MEASUREMENT Gbx_trqActClth "Actual torque transmission K0" SWORD Trq 1 100 0.00 3276.700 FORMAT "%8.3" ECU_ADDRESS 0x600090C6 /end MEASUREMENT
/begin MEASUREMENT Gbx_trqPrt "Max stabilized transmission torque" SWORD Trq 1 100 -3276.800 3276.700 FORMAT "%8.3" ECU_ADDRESS 0x60008842 /end MEASUREMENT
/begin MEASUREMENT Gbx_trqTIIDes "Torque desired by gearbox received on CAN (P057)" SWORD Trq 1 100 -3276.800 3276.700 FORMAT "%8.3" ECU_ADDRESS 0x60013F6A /end MEASUREMENT
/begin MEASUREMENT Gbx_trqTIILead "Lead intervention torque for increasing gearbox intervention" SWORD Trq 1 100 -3276.800 3276.700 FORMAT "%8.3" ECU_ADDRESS 0x60008840 /end MEASUREMENT
/begin MEASUREMENT Gbx_trqTSCIntvDes "Internal engine target torque" SWORD Trq 1 100 -3276.800 3276.700 FORMAT "%8.3" ECU_ADDRESS 0x60013F6C /end MEASUREMENT
/begin MEASUREMENT Gbx_trqTSCIntvLead "Internal engine target torque" SWORD Trq 1 100 -3276.800 3276.700 FORMAT "%8.3" ECU_ADDRESS 0x6000883E /end MEASUREMENT
/begin MEASUREMENT Gbx_uAPPMaxLrn "Gearbox AT accelerator max learned voltage" SWORD Volt_Batt 1 100 -655360.0 655340.0 FORMAT "%8.1" ECU_ADDRESS 0x600090BC /end MEASUREMENT
/begin MEASUREMENT GEVCtl_agMinAdpdOutl "Advanced mechanical stop position adapted by the camshaft adaptation outlet" SWORD kw_q0p0156 1 100 -512.0000 511.9844 FORMAT "%8.4" ECU_ADDRESS 0x60009132 /end MEASUREMENT
/begin MEASUREMENT GEVCtl_agRefPosnOutlB1 "Reference position of the phase actuator outlet camshaft bank 1 (currentless actuator)" SWORD kw_q0p0156 1 100 -512.0000 511.9844 FORMAT "%8.4" ECU_ADDRESS 0x6000912C /end MEASUREMENT
/begin MEASUREMENT GEVCtl_agSpHomHiLftOutl "Desired value outlet camshaft HOM mode high lift" SWORD kw_q0p0156 1 100 -512.0000 511.9844 FORMAT "%8.4" ECU_ADDRESS 0x60008852 /end MEASUREMENT
/begin MEASUREMENT GEVCtl_agSpHomLoLftOutl "Desired value outlet camshaft HOM mode low lift" SWORD kw_q0p0156 1 100 -512.0000 511.9844 FORMAT "%8.4" ECU_ADDRESS 0x6000884C /end MEASUREMENT
/begin MEASUREMENT GEVCtl_agSpOutlB1 "Desired position phase actuator outlet camshaft Bank 1" SWORD kw_q0p0156 1 100 -512.0000 511.9844 FORMAT "%8.4" ECU_ADDRESS 0x60009100 /end MEASUREMENT
/begin MEASUREMENT GEVCtl_flgPhaActrTestEnaFctOutl "Actuator test for outlet camshaft (short trip) requested by tester" UBYTE B_TRUE 1 100 0.00 1.00000000000 BIT_MASK 0x1 FORMAT "%13.11" ECU_ADDRESS 0x70000924 /end MEASUREMENT
/begin MEASUREMENT GEVCtl_flgSpIdleOutl "Condition setpoint outlet camshaft for idling active" UBYTE B_TRUE 1 100 0.00 1.00000000000 BIT_MASK 0x1 FORMAT "%13.11" ECU_ADDRESS 0x6000F112 /end MEASUREMENT
/begin MEASUREMENT GEVCtl_stGslSpOutl "Operation mode of the outlet camshaft (gasoline projects)" UBYTE OneToOne 1 100 0.00 255.0 FORMAT "%5.1" ECU_ADDRESS 0x6000F434 /end MEASUREMENT
/begin MEASUREMENT GEVlv_agExtrpnOutlB1 "Actual position cam phase actuator outlet camshaft bank1" SWORD kw_q0p0156 1 100 0.00 511.9844 FORMAT "%8.4" ECU_ADDRESS 0x600090EA /end MEASUREMENT
/begin MEASUREMENT GEVlv_agOutlB1 "Actual position cam phase actuator outlet camshaft bank1" SWORD kw_q0p0156 1 100 0.00 511.9844 FORMAT "%8.4" ECU_ADDRESS 0x600090E6 /end MEASUREMENT
/begin MEASUREMENT GEVlv_flgElecErrDebActvIntkB1 "flag for electrical error debounce active information for intake bank1" UBYTE B_TRUE 1 100 0.00 1.00000000000 BIT_MASK 0x1 FORMAT "%13.11" ECU_ADDRESS 0x70000907 /end MEASUREMENT
/begin MEASUREMENT GEVlv_flgPhaActrErrSuspcOutlB1 "condition suspect of error camshaft actuator outlet" UBYTE B_TRUE 1 100 0.00 1.00000000000 BIT_MASK 0x1 FORMAT "%13.11" ECU_ADDRESS 0x70000904 /end MEASUREMENT
/begin MEASUREMENT GlbDa_lDstVeh "total distance travelled of vehicle" SLONG Length 1 100 -2147483648.00 2147483647.00 FORMAT "%13.2" ECU_ADDRESS 0x60003970 /end MEASUREMENT
/begin MEASUREMENT grundwert_msg "space between SW reference mark to TDC in KW" UBYTE kw_q1 1 100 0.00 255.0 FORMAT "%5.1" ECU_ADDRESS 0x50006064 /end MEASUREMENT
/begin MEASUREMENT GSHDem_flgInhbnGSH "Changes required" UBYTE B_TRUE 1 100 0.00 1.00000000000 BIT_MASK 0x1 FORMAT "%13.11" ECU_ADDRESS 0x6000F101 /end MEASUREMENT
/begin MEASUREMENT HEGO_flgS2B1EnaLamCtlColdOper "lambda control enabled for Cold operation sensor 2 bank 1" UBYTE B_TRUE 1 100 0.00 1.00000000000 BIT_MASK 0x1 FORMAT "%13.11" ECU_ADDRESS 0x700008C5 /end MEASUREMENT
/begin MEASUREMENT HiPSys_flgDeactvnFuInjInhbn "Flag for fuel cut inhibition in case of rail pressure max failure detection" UBYTE B_TRUE 1 100 0.00 1.00000000000 BIT_MASK 0x1 FORMAT "%13.11" ECU_ADDRESS 0x700008BA /end MEASUREMENT
/begin MEASUREMENT HLSDem_nSetPTrckCpy "Copy of idle reference speed" SWORD nmot_sw_q0p5 1 100 -16384.00 16383.50 FORMAT "%8.2" ECU_ADDRESS 0x700053B2 /end MEASUREMENT
/begin MEASUREMENT HndBrk_stDebVal "Debounced value of Hand Brake switch" UBYTE OneToOne 1 100 0.00 255.0 FORMAT "%5.1" ECU_ADDRESS 0x6000F418 /end MEASUREMENT
/begin MEASUREMENT I14229iocbiCrCtl1_stVal "Status of CrCtl 1 SFT" UWORD OneToOne 1 100 0.00 65535.00 FORMAT "%8.2" ECU_ADDRESS 0x600085E8 /end MEASUREMENT
/begin MEASUREMENT I14229iocbiCrCtl_stVal "Status of Cruise control lamp SFT" UWORD OneToOne 1 100 0.00 65535.00 FORMAT "%8.2" ECU_ADDRESS 0x600085E6 /end MEASUREMENT
/begin MEASUREMENT I14229_stShipMod "shipping Mode State" UBYTE I14229_SHIPMOD_VERB 1 100 0.00 2.00000000000 FORMAT "%13.11" ECU_ADDRESS 0x6000F3FB /end MEASUREMENT
/begin MEASUREMENT I14229_stShipModActv "Shipping Mode Active State" UBYTE B_TRUE 1 100 0.00 1.00000000000 BIT_MASK 0x1 FORMAT "%13.11" ECU_ADDRESS 0x6000F0EF /end MEASUREMENT
/begin MEASUREMENT Ign_diaShftKnkL_s16 "lambda dependent shift of the knock limit in primary ign.angle" SWORD zw_q0p1 1 100 -3276.800 3276.700 FORMAT "%8.3" ECU_ADDRESS 0x50005D96 /end MEASUREMENT
/begin MEASUREMENT IKCtl_flgReqEnchmtWithInteg "Condition for fuel enrichment demand at recognized pre-ignition based on integrator" UBYTE B_TRUE 1 100 0.00 1.00000000000 BIT_MASK 0x1 FORMAT "%13.11" ECU_ADDRESS 0x6000F0ED /end MEASUREMENT
/begin MEASUREMENT IKCtl_iaDynAdpnOffs_s16 "ignition retard during dyn-function of knock control" SWORD zw_q0p1 1 100 -3276.800 3276.700 FORMAT "%8.3" ECU_ADDRESS 0x500007E4 /end MEASUREMENT
/begin MEASUREMENT IKCtl_ratLamPreIgn "lambda request during Pre-Ignition condition" UWORD fak_uw_b16 1 100 0.00 15.99976 FORMAT "%8.5" ECU_ADDRESS 0x60008BEE /end MEASUREMENT
/begin MEASUREMENT imlatm_w "integrated air mass flow from engine start to max. value (word)" UWORD m_uw_b23p3 1 100 0.00 23.30133 FORMAT "%8.5" ECU_ADDRESS 0x60008B06 /end MEASUREMENT
/begin MEASUREMENT InjCrv_tAir "Air temperature for environment corrections" SWORD Temp_Cels 1 100 -3549.940 3003.560 FORMAT "%8.3" ECU_ADDRESS 0x70003B92 /end MEASUREMENT
/begin MEASUREMENT InjCtl_qSetUnBal "current injection quantity" SWORD InjMass 1 100 -327.6800 327.6700 FORMAT "%8.4" ECU_ADDRESS 0x60009072 /end MEASUREMENT
/begin MEASUREMENT InjSys_cntrSync0 "S0-synchro counter" ULONG dez 1 100 0.00 4294967295.00 FORMAT "%13.2" ECU_ADDRESS 0x70003DF4 /end MEASUREMENT
/begin MEASUREMENT InjSys_cntrSync1 "S1-synchro counter" ULONG dez 1 100 0.00 4294967295.00 FORMAT "%13.2" ECU_ADDRESS 0x70003DF0 /end MEASUREMENT
/begin MEASUREMENT InjSys_ctCylAdvMax "max. range of advanced cylinder counter Gen_ctCylAdv" UBYTE dez 1 100 0.00 255.0 FORMAT "%5.1" ECU_ADDRESS 0x70001F2A /end MEASUREMENT
/begin MEASUREMENT InjSys_ctCylAdvOffsGdi "advanced cylinder counter for GDI injection" UBYTE OneToOne 1 100 0.00 255.0 FORMAT "%5.1" ECU_ADDRESS 0x700036F1 /end MEASUREMENT
/begin MEASUREMENT InjSys_ctCylAdvOffsHom "advanced cylinder counter for homogeneous injection" UBYTE dez 1 100 0.00 255.0 FORMAT "%5.1" ECU_ADDRESS 0x700036F0 /end MEASUREMENT
/begin MEASUREMENT InjSys_ctCylAdvOffsStrat "advanced cylinder counter for stractified injection" UBYTE dez 1 100 0.00 255.0 FORMAT "%5.1" ECU_ADDRESS 0x700036EF /end MEASUREMENT
/begin MEASUREMENT InjSys_facMixAdpnIdle_a "factor mixture adaption" UWORD fak_q3p0518Em5 1 100 0.00 1.999969 FORMAT "%8.6" ARRAY_SIZE 4 ECU_ADDRESS 0x600068D6 /end MEASUREMENT
/begin MEASUREMENT InjSys_facPreIgnMix_a "Enrichment factor for cylinder individual prevention of pre-ignition" UWORD fak_uw_b2 1 100 0.00 1.999969 FORMAT "%8.6" ARRAY_SIZE 4 ECU_ADDRESS 0x600068CE /end MEASUREMENT
/begin MEASUREMENT InjSys_idxNxtCylAdv "Cylinder index related to Gen_idxCylAdv" UBYTE dez 1 100 0.00 255.0 FORMAT "%5.1" ECU_ADDRESS 0x700036C1 /end MEASUREMENT
/begin MEASUREMENT InjSys_nrRedStgEnf "number of enforced cut off cylinders without torque structure requests" UBYTE dez 1 100 0.00 255.0 FORMAT "%5.1" ECU_ADDRESS 0x6000F3E9 /end MEASUREMENT
/begin MEASUREMENT InjSys_ofsCylCntrHom "Offset of cylinder counter for calculation of homogeneous injection, i.e. number of segments between calculation point and Ignition Top Dead Center (TDC)" UBYTE dez 1 100 0.00 255.0 FORMAT "%5.1" ECU_ADDRESS 0x5000099A /end MEASUREMENT
/begin MEASUREMENT InjSys_ofsCylCntrStrat "Offset of cylinder counter for calculation of the stratified injection, i.e. number of segments between calculation point and ignition TDC" UBYTE dez 1 100 0.00 255.0 FORMAT "%5.1" ECU_ADDRESS 0x5000099B /end MEASUREMENT
/begin MEASUREMENT InjSys_stTranTPist "state change of operation mode in transition piston temperature" UBYTE OneToOne 1 100 0.00 255.0 FORMAT "%5.1" ECU_ADDRESS 0x6000F3E2 /end MEASUREMENT
/begin MEASUREMENT InjSys_tiInjOpenCorrdSyn1 "corrected injection time open valve S1 timing" ULONG t_q0p0004_ms 1 100 0.00 1717986.91800 FORMAT "%13.5" ARRAY_SIZE 4 ECU_ADDRESS 0x70001F5C /end MEASUREMENT
/begin MEASUREMENT IntkAirT_t "Actual physical value" SWORD Temp_Cels 1 100 -3549.940 3003.560 FORMAT "%8.3" ECU_ADDRESS 0x6000906A /end MEASUREMENT
/begin MEASUREMENT IntkAirT_uSnsr3CrssSwtLoc "Spannungswert des Ansauglufttemperatursensors Snsr3, lokal" UWORD volt 1 100 0.00 5000.000 FORMAT "%8.3" ECU_ADDRESS 0x60008BD4 /end MEASUREMENT
/begin MEASUREMENT IVGdiCtl_CvoAdpn_MeasFrzFrm_t.Cyl "Structure: Freeze frame from IVGdiCtl_CvoAdpn / Structure: Freeze frame from IVGdiCtl_CvoAdpn: cylinder" UBYTE OneToOne 1 100 0.00 255.0 FORMAT "%5.1" ECU_ADDRESS 0x70001F38 /end MEASUREMENT
/begin MEASUREMENT IVGdiCtl_CvoAdpn_MeasFrzFrm_t.POper "Structure: Freeze frame from IVGdiCtl_CvoAdpn / Structure: Freeze frame from IVGdiCtl_CvoAdpn: POper" UWORD RBPtCel_p_0p002_1 1 100 0.00 131.0700 FORMAT "%8.4" ECU_ADDRESS 0x70001F3A /end MEASUREMENT
/begin MEASUREMENT IVGdiCtl_CvoAdpn_MeasFrzFrm_t.Pls "Structure: Freeze frame from IVGdiCtl_CvoAdpn / Structure: Freeze frame from IVGdiCtl_CvoAdpn: Pls" UBYTE OneToOne 1 100 0.00 255.0 FORMAT "%5.1" ECU_ADDRESS 0x70001F3C /end MEASUREMENT
/begin MEASUREMENT IVGdiCtl_CvoAdpn_MeasFrzFrm_t.PlsInfo "Structure: Freeze frame from IVGdiCtl_CvoAdpn / Structure: Freeze frame from IVGdiCtl_CvoAdpn: PlsInfo" UWORD OneToOne 1 100 0.00 65535.00 FORMAT "%8.2" ECU_ADDRESS 0x70001F3E /end MEASUREMENT
/begin MEASUREMENT IVGdiCtl_CvoAdpn_MeasFrzFrm_t.Valid "Structure: Freeze frame from IVGdiCtl_CvoAdpn / Structure: Freeze frame from IVGdiCtl_CvoAdpn: Valid" UBYTE B_TRUE 1 100 0.00 1.00000000000 BIT_MASK 0x1 FORMAT "%13.11" ECU_ADDRESS 0x70001F40 /end MEASUREMENT
/begin MEASUREMENT IVGdiCtl_CvoAdpn_MeasFrzFrm_t.VcosOper "Structure: Freeze frame from IVGdiCtl_CvoAdpn / Operation viscosity" UWORD RBPtCel_vcos_5p0em5_1 1 100 0.00 3.000000 FORMAT "%8.6" ECU_ADDRESS 0x70001F42 /end MEASUREMENT
/begin MEASUREMENT IVGdiCtl_CvoAdpn_MeasFrzFrm_t.desTiOpen "Structure: Freeze frame from IVGdiCtl_CvoAdpn / Desired open time Ti" UWORD t_q1p0_us 1 100 0.00 65535.00 FORMAT "%8.2" ECU_ADDRESS 0x70001F44 /end MEASUREMENT
/begin MEASUREMENT IVGdiCtl_CvoAdpn_MeasFrzFrm_t.dti "Structure: Freeze frame from IVGdiCtl_CvoAdpn / Structure: Freeze frame from IVGdiCtl_CvoAdpn: dti" SWORD OneToOne 1 100 -32768.00 32767.00 FORMAT "%8.2" ECU_ADDRESS 0x70001F46 /end MEASUREMENT
/begin MEASUREMENT IVGdiCtl_CvoAdpn_MeasFrzFrm_t.idxP "Structure: Freeze frame from IVGdiCtl_CvoAdpn / Structure: Freeze frame from IVGdiCtl_CvoAdpn: idxP" UBYTE OneToOne 1 100 0.00 255.0 FORMAT "%5.1" ECU_ADDRESS 0x70001F48 /end MEASUREMENT
/begin MEASUREMENT IVGdiCtl_CvoAdpn_MeasFrzFrm_t.idxVcos "Structure: Freeze frame from IVGdiCtl_CvoAdpn / Viscocity index" UBYTE OneToOne 1 100 0.00 255.0 FORMAT "%5.1" ECU_ADDRESS 0x70001F49 /end MEASUREMENT
/begin MEASUREMENT IVGdiCtl_CvoAdpn_MeasFrzFrm_t.tiPse "Structure: Freeze frame from IVGdiCtl_CvoAdpn / Pause time for measure pulse" UWORD OneToOne 1 100 0.00 65535.00 FORMAT "%8.2" ECU_ADDRESS 0x70001F4A /end MEASUREMENT
/begin MEASUREMENT kmstand_l_msg "distance_km with a precision of 1km" ULONG s_q1_km 1 100 0.00 4294967295.00 FORMAT "%13.2" ECU_ADDRESS 0x6000387C /end MEASUREMENT
/begin MEASUREMENT LAS_facRoadGrdt "Factor for Road gradient" SWORD Prc_Fact100 1 100 0.00 327.6700 FORMAT "%8.4" ECU_ADDRESS 0x60009066 /end MEASUREMENT
/begin MEASUREMENT LLim_bFcoDes_msg "Desired fuel cutoff" UBYTE B_TRUE 1 100 0.00 1.00000000000 BIT_MASK 0x1 FORMAT "%13.11" ECU_ADDRESS 0x70000821 /end MEASUREMENT
/begin MEASUREMENT LLim_flgEngSt "Engine state for speed limiter" UBYTE B_TRUE 1 100 0.00 1.00000000000 BIT_MASK 0x1 FORMAT "%13.11" ECU_ADDRESS 0x6000F0E8 /end MEASUREMENT
/begin MEASUREMENT LLim_flgVehSpdHi "Vehicle speed limiter is high" UBYTE B_TRUE 1 100 0.00 1.00000000000 BIT_MASK 0x1 FORMAT "%13.11" ECU_ADDRESS 0x6000F0E6 /end MEASUREMENT
/begin MEASUREMENT lutskzyl_w "engine roughness test value, corrected, array with all cylinders" SWORD lu_MEx 1 100 -232.8306 232.8235 FORMAT "%8.4" ARRAY_SIZE 4 ECU_ADDRESS 0x600068C6 /end MEASUREMENT
/begin MEASUREMENT MESCtrlr_nSpDif "Difference between set point and current engine speed" SWORD EngN 1 100 0.00 16383.50 FORMAT "%8.2" ECU_ADDRESS 0x6000904A /end MEASUREMENT
/begin MEASUREMENT MFDspl_flgFuCapWarn "Fuel Cap Warning" UBYTE B_TRUE 1 100 0.00 1.00000000000 BIT_MASK 0x1 FORMAT "%13.11" ECU_ADDRESS 0x6000F0E0 /end MEASUREMENT
/begin MEASUREMENT MfVD_bSpPrHld "Hold pressure setpoint for adaptation" UBYTE B_TRUE 1 100 0.00 1.00000000000 BIT_MASK 0x1 FORMAT "%13.11" ECU_ADDRESS 0x70003606 /end MEASUREMENT
/begin MEASUREMENT miszul_w_msg "maximum permissible indicated torque" UWORD rel_uw_b100 1 100 0.00 99.99847 FORMAT "%8.5" ECU_ADDRESS 0x60008AE0 /end MEASUREMENT
/begin MEASUREMENT mkioel_w_msg "total fuel mass in engine oil" UWORD m_q0p02133 1 100 0.00 1398.080 FORMAT "%8.3" ECU_ADDRESS 0x600084FC /end MEASUREMENT
/begin MEASUREMENT MoFTerminal_stT50EmgyMsg "T50 enable start enable message" UBYTE OneToOne 1 100 0.00 255.0 FORMAT "%5.1" ECU_ADDRESS 0x6000F385 /end MEASUREMENT
/begin MEASUREMENT mshfmst_w "air mass flow HFM 16-Bit value for scantool" UWORD m_q0p1 1 100 0.00 6553.500 FORMAT "%8.3" ECU_ADDRESS 0x60008ADA /end MEASUREMENT
/begin MEASUREMENT mste_msg "mass flow purge control into the manifold" UBYTE m_ub_b25p6 1 100 0.00 25.50 FORMAT "%5.2" ECU_ADDRESS 0x50006065 /end MEASUREMENT
/begin MEASUREMENT nltrstdone_msg "nltrstdone_msg" UBYTE B_TRUE 1 100 0.00 1.00000000000 BIT_MASK 0x1 FORMAT "%13.11" ECU_ADDRESS 0x600001AD /end MEASUREMENT
/begin MEASUREMENT nmot "Low resolution Engine speed" UBYTE nmot_ub_q40 1 100 0.00 10200. FORMAT "%5.0" ECU_ADDRESS 0x6000F2F0 /end MEASUREMENT
/begin MEASUREMENT nmot_w "Engine speed" UWORD nmot_uw_q0p25 1 100 0.00 16383.75 FORMAT "%8.2" ECU_ADDRESS 0x60014032 /end MEASUREMENT
/begin MEASUREMENT nstat "Stationary reference speed" UBYTE nmot_ub_q10 1 100 0.00 2550. FORMAT "%5.0" ECU_ADDRESS 0x6000F2E5 /end MEASUREMENT
/begin MEASUREMENT OilLfT_degOilDetern "The degree of engine oil deterioration (for E-OIL Life processing)." SWORD rel_q0p1 1 100 -3276.800 3276.700 FORMAT "%8.3" ECU_ADDRESS 0x60009022 /end MEASUREMENT
/begin MEASUREMENT OilLfT_dstOilLfTiRedMilg "The mileage reduced value of an OIL life (for E-OIL Life processing)." UWORD dist_uw_q1 1 100 0.00 65535.00 FORMAT "%8.2" ECU_ADDRESS 0x60008BA8 /end MEASUREMENT
/begin MEASUREMENT OilLfT_mAirPerCyl "The amount of inhaled air in a cylinder" SWORD AirMassPerCyl 1 100 -3276.800 3276.700 FORMAT "%8.3" ECU_ADDRESS 0x600087F4 /end MEASUREMENT
/begin MEASUREMENT OilLfT_stFailOilTSnsr "Status of engine oil life system failure due to Oil Temperature sensor error" UBYTE B_TRUE 1 100 0.00 1.00000000000 BIT_MASK 0x1 FORMAT "%13.11" ECU_ADDRESS 0x700007D2 /end MEASUREMENT
/begin MEASUREMENT OilLfT_stFailSafeActn "The failsafe action execution about engine oil deterioration system is done by 1." UBYTE B_TRUE 1 100 0.00 1.00000000000 BIT_MASK 0x1 FORMAT "%13.11" ECU_ADDRESS 0x700007D1 /end MEASUREMENT
/begin MEASUREMENT OilLfT_stRstCmpl "Reset completion flag" UBYTE dez 1 100 0.00 255.0 FORMAT "%5.1" ECU_ADDRESS 0x6000098C /end MEASUREMENT
/begin MEASUREMENT OilLfT_stTstrActv "Values written to EEPROM from tester" UBYTE OneToOne 1 100 0.00 255.0 FORMAT "%5.1" ECU_ADDRESS 0x6000F36B /end MEASUREMENT
/begin MEASUREMENT OilLfT_tiOilLfTi "OIL life period (for E-OIL Life processing)." SBYTE RBPtCel_ti_1p0_5 1 100 0.00 127.0 FORMAT "%5.1" ECU_ADDRESS 0x6000F7B5 /end MEASUREMENT
/begin MEASUREMENT OilPmp_rPsOilPmp "duty-cycle for determination of sensor state" SWORD Prc 1 100 -400.0000 399.9878 FORMAT "%8.4" ECU_ADDRESS 0x6000901E /end MEASUREMENT
/begin MEASUREMENT OilP_p "Oil pressure" SWORD Pres_hPa 1 100 -32768.00 32767.00 FORMAT "%8.2" ECU_ADDRESS 0x60009020 /end MEASUREMENT
/begin MEASUREMENT OilSwmpT_uSnsrRaw "ADC-voltage of the oil temperature sensor" SWORD volt 1 100 -6553.600 6553.400 FORMAT "%8.3" ECU_ADDRESS 0x6000901C /end MEASUREMENT
/begin MEASUREMENT Oil_stAvusWarn "Warning: limitaion due to AVS-failure" UBYTE B_TRUE 1 100 0.00 1.00000000000 BIT_MASK 0x1 FORMAT "%13.11" ECU_ADDRESS 0x700007C8 /end MEASUREMENT
/begin MEASUREMENT Oil_stOilLow "This is SW-VARIABLE" UBYTE OneToOne 1 100 0.00 255.0 FORMAT "%5.1" ECU_ADDRESS 0x6000F36A /end MEASUREMENT
/begin MEASUREMENT PCR_pDesVal "" SWORD Pres_hPa 1 100 -32768.00 32767.00 FORMAT "%8.2" ECU_ADDRESS 0x60013F9E /end MEASUREMENT
/begin MEASUREMENT PEnv_dataDigSens "Digital raw data from ambient ait pressure sensor" ULONG spg_q1p221Em3_V 1 100 0.00 5242879.99878 FORMAT "%13.5" ECU_ADDRESS 0x6000389C /end MEASUREMENT
/begin MEASUREMENT PFltDes_flgInhbOverrun "Fuel cut off is not allowed if the particulate filte is full" UBYTE B_TRUE 1 100 0.00 1.00000000000 BIT_MASK 0x1 FORMAT "%13.11" ECU_ADDRESS 0x700007B4 /end MEASUREMENT
/begin MEASUREMENT PhyMod_trqDynEng "dynamic engine torque" SWORD md_sw_q0p1 1 100 -3276.800 3276.700 FORMAT "%8.3" ECU_ADDRESS 0x60008FCE /end MEASUREMENT
/begin MEASUREMENT pndkpu_msg "quotient: pressure downstream throttle valve ambient pressure" UBYTE fak_ub_b2 1 100 0.00 1.992188 FORMAT "%8.6" ECU_ADDRESS 0x6000F2E2 /end MEASUREMENT
/begin MEASUREMENT prist_w_msg "Filtered rail pressure real value (absolut pressure)" UWORD p_q0p0005 1 100 0.00 32.76750 FORMAT "%8.5" ECU_ADDRESS 0x60008AAC /end MEASUREMENT
/begin MEASUREMENT psmxbkvg_w_msg "max. manifold air pressure for boost pressure control" UWORD p_uw_q0p039 1 100 0.00 2559.961 FORMAT "%8.3" ECU_ADDRESS 0x600084E4 /end MEASUREMENT
/begin MEASUREMENT pspu_msg "quotient: manifold pressure ambient pressure" UBYTE fak_ub_b2 1 100 0.00 1.992188 FORMAT "%8.6" ECU_ADDRESS 0x6000F2E1 /end MEASUREMENT
/begin MEASUREMENT psrr_w "intake manifold pressure (absolute) not corrected" UWORD p_q0p078 1 100 0.00 5119.922 FORMAT "%8.3" ECU_ADDRESS 0x600068C4 /end MEASUREMENT
/begin MEASUREMENT PTDist_flgEmStrtgTqActv "Flag to check whether desired torque for electric motor is for starting of the engine" UBYTE B_TRUE 1 100 0.00 1.00000000000 BIT_MASK 0x1 FORMAT "%13.11" ECU_ADDRESS 0x700007AD /end MEASUREMENT
/begin MEASUREMENT PTDist_flgEvModSetLimnActv "EV mode limits the set engine torque" UBYTE B_TRUE 1 100 0.00 1.00000000000 BIT_MASK 0x1 FORMAT "%13.11" ECU_ADDRESS 0x700007AC /end MEASUREMENT
/begin MEASUREMENT PThrVlvUs_uRawB1 "raw voltage of pressure sensor throttle valve upstream" UWORD Volt_q0p00007629 1 100 0.00 4.999665 FORMAT "%8.6" ECU_ADDRESS 0x60008B94 /end MEASUREMENT
/begin MEASUREMENT PthSet_flgCritTqIncPhd "Prohibited critical torque increase" UBYTE B_TRUE 1 100 0.00 1.00000000000 BIT_MASK 0x1 FORMAT "%13.11" ECU_ADDRESS 0x6000F0BB /end MEASUREMENT
/begin MEASUREMENT PthSet_flgCylIndFcoStrtd "Condition: Fuel cut off started" UBYTE B_TRUE 1 100 0.00 1.00000000000 BIT_MASK 0x1 FORMAT "%13.11" ECU_ADDRESS 0x700007A2 /end MEASUREMENT
/begin MEASUREMENT PthSet_flgFcoRdy "Condition: Fuel cut off ready" UBYTE B_TRUE 1 100 0.00 1.00000000000 BIT_MASK 0x1 FORMAT "%13.11" ECU_ADDRESS 0x6000F0BA /end MEASUREMENT
/begin MEASUREMENT PthSet_stOvrRunCoord "State of overrun detection of the overrun coordinator (0: no overrun; 1:overrun)" UBYTE OneToOne 1 100 0.00 1.000 FORMAT "%5.3" ECU_ADDRESS 0x7000366E /end MEASUREMENT
/begin MEASUREMENT PthSet_tiExptFcoStrt "Time after which FCO will start" ULONG Time_ms_to_us 1 100 0.00 4294967.29500 FORMAT "%13.5" ECU_ADDRESS 0x50004FB4 /end MEASUREMENT
/begin MEASUREMENT PthSet_trqInrFlt "Filtered torque request for set path" SWORD md_q0p1 1 100 -3276.800 3276.700 FORMAT "%8.3" ECU_ADDRESS 0x60013FBA /end MEASUREMENT
/begin MEASUREMENT PthSet_trqInrSet "PthSet: inner torque set value" SWORD Trq 1 100 -3276.800 3276.700 FORMAT "%8.3" ECU_ADDRESS 0x700053C2 /end MEASUREMENT
/begin MEASUREMENT PthSet_trqInrWoIntv "Driver's request torque without disturbance controller, gearbox intervention and stability intervention" SWORD Trq 1 100 0.00 3276.700 FORMAT "%8.3" ECU_ADDRESS 0x60008FA4 /end MEASUREMENT
/begin MEASUREMENT PTODi_trqCrSLeadUnlim "Torque request for Lead-path engine without EngDem-limitation" SWORD Trq 1 100 -3276.800 3276.700 FORMAT "%8.3" ECU_ADDRESS 0x60000734 /end MEASUREMENT
/begin MEASUREMENT PT_bCtOffPhd "Status of fuel cut-off inhibition" UBYTE B_TRUE 1 100 0.00 1.00000000000 BIT_MASK 0x1 FORMAT "%13.11" ECU_ADDRESS 0x700007AB /end MEASUREMENT
/begin MEASUREMENT PT_flgLimnFCOReq "Fuel Cut Off request status" UBYTE B_TRUE 1 100 0.00 1.00000000000 BIT_MASK 0x1 FORMAT "%13.11" ECU_ADDRESS 0x6000F0C9 /end MEASUREMENT
/begin MEASUREMENT PT_tqCluMinWoFco "Minimum clutch torque without cutoff" SWORD Trq 1 100 -3276.800 3276.700 FORMAT "%8.3" ECU_ADDRESS 0x60008FEA /end MEASUREMENT
/begin MEASUREMENT PT_trqCrSLeadPOp "propulsion lead torque for operation mode selection (crankshaft torque)" SWORD Trq 1 100 -3276.800 3276.700 FORMAT "%8.3" ECU_ADDRESS 0x60013FAC /end MEASUREMENT
/begin MEASUREMENT PT_trqCrSWoIntv "Set point torque without interventions on crankshaft torque level" SWORD Trq 1 100 -3276.800 3276.700 FORMAT "%8.3" ECU_ADDRESS 0x600087AA /end MEASUREMENT
/begin MEASUREMENT PT_trqTraPrt "maximum allowed inner torque" SWORD Trq 1 100 -3276.800 3276.700 FORMAT "%8.3" ECU_ADDRESS 0x600087A8 /end MEASUREMENT
/begin MEASUREMENT PT_trqWhlMaxEng "Maximum wheel torque from the engine" SLONG TrqPrpHigh 1 100 -214748364.800 214748364.700 FORMAT "%13.3" ECU_ADDRESS 0x6000394C /end MEASUREMENT
/begin MEASUREMENT PT_trqWhlMinWoCtOff "Minimum wheel torque with internal combustion engine firing" SLONG TrqPrpHigh 1 100 -214748364.800 214748364.700 FORMAT "%13.3" ECU_ADDRESS 0x60003940 /end MEASUREMENT
/begin MEASUREMENT pu_w "Ambient pressure" UWORD p_uw_q0p039 1 100 0.00 2559.961 FORMAT "%8.3" ECU_ADDRESS 0x60000830 /end MEASUREMENT
/begin MEASUREMENT pvds_w_msg "Desired pressure upstream throttle valve (values from 0...5120hPa)" UWORD p_uw_q0p078 1 100 0.00 5119.922 FORMAT "%8.3" ECU_ADDRESS 0x60008AA0 /end MEASUREMENT
/begin MEASUREMENT pvv_w_msg "pressure upstream booster" UWORD p_uw_q0p039 1 100 0.00 2559.961 FORMAT "%8.3" ECU_ADDRESS 0x60008A9E /end MEASUREMENT
/begin MEASUREMENT resdhshe_msg "set value LS-heating downstream of cat. during tester request" UBYTE dez 1 100 0.00 255.0 FORMAT "%5.1" ECU_ADDRESS 0x6000F2DC /end MEASUREMENT
/begin MEASUREMENT rlfgdsvheg_w_msg "Relative fresh air charge based on high lift, DSS based" UWORD rel_q0p0234 1 100 0.00 1535.977 FORMAT "%8.3" ECU_ADDRESS 0x60008A94 /end MEASUREMENT
/begin MEASUREMENT rlfgdsvhek_w_msg "Relative fresh air charge based on low lift, DSS based" UWORD rel_q0p0234 1 100 0.00 1535.977 FORMAT "%8.3" ECU_ADDRESS 0x60008A92 /end MEASUREMENT
/begin MEASUREMENT rlmxbkv_w_msg "max.permitted air charge for brake booster" UWORD rel_uw_q0p0234 1 100 0.00 1535.977 FORMAT "%8.3" ECU_ADDRESS 0x6001403C /end MEASUREMENT
/begin MEASUREMENT rlsol_w "desired relative air charge" UWORD rel_q0p02344 1 100 0.00 1535.977 FORMAT "%8.3" ECU_ADDRESS 0x60008A7E /end MEASUREMENT
/begin MEASUREMENT rltedte_w_msg "from DTEV calculated relative charge through the purge control valve" UWORD rel_q0p000001907 1 100 0.00 0.1249981 FORMAT "%9.7" ECU_ADDRESS 0x60008A7C /end MEASUREMENT
/begin MEASUREMENT rl_w "Relative air charge (Word)" UWORD rel_q0p0234 1 100 0.00 1535.977 FORMAT "%8.3" ECU_ADDRESS 0x600084DA /end MEASUREMENT
/begin MEASUREMENT RrDfogSwt_stRawVal "Raw value of Rear defogger switch signal" UBYTE OneToOne 1 100 0.00 255.0 FORMAT "%5.1" ECU_ADDRESS 0x60014148 /end MEASUREMENT
/begin MEASUREMENT Shtrp_rTrqSetPointDia "Desired torque for Dia" SWORD Prc 1 100 -400.0000 399.9878 FORMAT "%8.4" ECU_ADDRESS 0x60013FD0 /end MEASUREMENT
/begin MEASUREMENT Shtrp_stAct "Short Trip diagnosis is active" UBYTE OneToOne 1 100 0.00 255.0 FORMAT "%5.1" ECU_ADDRESS 0x6000F357 /end MEASUREMENT
/begin MEASUREMENT SpdGov_bNLimFCOReq "Fuel Cut-Off request for Engine speed limitation" UBYTE B_TRUE 1 100 0.00 1.00000000000 BIT_MASK 0x1 FORMAT "%13.11" ECU_ADDRESS 0x7000079A /end MEASUREMENT
/begin MEASUREMENT SpdGov_trqEngPrtLimMech "Torque limitation due to NMAX-limitation" SWORD md_sw_q0p1 1 100 -3276.800 3276.700 FORMAT "%8.3" ECU_ADDRESS 0x60008F60 /end MEASUREMENT
/begin MEASUREMENT StbIntv_bESPErr "ESP system status" UBYTE B_TRUE 1 100 0.00 1.00000000000 BIT_MASK 0x1 FORMAT "%13.11" ECU_ADDRESS 0x70000799 /end MEASUREMENT
/begin MEASUREMENT StbIntv_bTCSDeActv "Status TCS deactivated" UBYTE B_TRUE 1 100 0.00 1.00000000000 BIT_MASK 0x1 FORMAT "%13.11" ECU_ADDRESS 0x70000798 /end MEASUREMENT
/begin MEASUREMENT StrtCtl_bFstStrtCtOff "condition for fast starter cut off at direct start" UBYTE B_TRUE 1 100 0.00 1.00000000000 BIT_MASK 0x1 FORMAT "%13.11" ECU_ADDRESS 0x70000797 /end MEASUREMENT
/begin MEASUREMENT StrtCtl_stClthForStrtReqJdg "the judgment flag of clutch condition for start request" UBYTE B_TRUE 1 100 0.00 1.00000000000 BIT_MASK 0x1 FORMAT "%13.11" ECU_ADDRESS 0x6000F095 /end MEASUREMENT
/begin MEASUREMENT StWhl_dphiAg "Steering Wheel Angle velocity" SWORD AngleDerivative 1 100 -2048.000 2047.938 FORMAT "%8.3" ECU_ADDRESS 0x60008F5A /end MEASUREMENT
/begin MEASUREMENT StWhl_phiAg "Steering Wheel Angle" SWORD Angle 1 100 -1024.000 1023.969 FORMAT "%8.3" ECU_ADDRESS 0x60008F58 /end MEASUREMENT
/begin MEASUREMENT SWAdp_idxInjSysIdle "" UBYTE OneToOne 1 100 0.00 255.0 FORMAT "%5.1" ECU_ADDRESS 0x6000ADB8 /end MEASUREMENT
/begin MEASUREMENT SyC_ctDrvEnter "Global drive cycle counter which is incremented when system state DRIVE is entered" UBYTE OneToOne 1 100 0.00 255.0 FORMAT "%5.1" ECU_ADDRESS 0x50006058 /end MEASUREMENT
/begin MEASUREMENT SyC_ctIrrSwOff "Counter for detection of irregular switch-off of the ECU" UBYTE OneToOne 1 100 0.00 255.0 FORMAT "%5.1" ECU_ADDRESS 0x6000F7DF /end MEASUREMENT
/begin MEASUREMENT SyC_ctPostDrvLeave "" UBYTE OneToOne 1 100 0.00 255.0 FORMAT "%5.1" ECU_ADDRESS 0x50006059 /end MEASUREMENT
/begin MEASUREMENT SyC_StcRchdZero "Variable to indicate that counter has reached zero." UBYTE B_TRUE 1 100 0.00 1.00000000000 BIT_MASK 0x1 FORMAT "%13.11" ECU_ADDRESS 0x6000F08F /end MEASUREMENT
/begin MEASUREMENT SyC_stHistTiPostDrvMax "State of the last time exceedings in PostDrive" UBYTE OneToOne 1 100 0.00 255.0 FORMAT "%5.1" ECU_ADDRESS 0x6000F340 /end MEASUREMENT
/begin MEASUREMENT SyC_stMn "Current system/ECU state" UBYTE ExeCon_State_01 1 100 0.00 3.00000000000 FORMAT "%13.11" ECU_ADDRESS 0x6000F7DE /end MEASUREMENT
/begin MEASUREMENT SyC_stMnOld "Previous system/ECU state" UBYTE ExeCon_State_01 1 100 0.00 3.00000000000 FORMAT "%13.11" ECU_ADDRESS 0x6000F7DD /end MEASUREMENT
/begin MEASUREMENT SyC_stPostDrv "PostDrive control state" UBYTE SyC_PostDrv_State 1 100 0.00 8.00000000000 FORMAT "%13.11" ECU_ADDRESS 0x700054A3 /end MEASUREMENT
/begin MEASUREMENT SyC_stPostDrvDel "post-drive delay request" UBYTE OneToOne 1 100 0.00 255.0 FORMAT "%5.1" ECU_ADDRESS 0x6000F7C2 /end MEASUREMENT
/begin MEASUREMENT SyC_stPreDrv "" UBYTE SyC_PreDrv_State 1 100 0.00 9.00000000000 FORMAT "%13.11" ECU_ADDRESS 0x6000F7DC /end MEASUREMENT
/begin MEASUREMENT SyC_stPreDrvDel "Variable to check if predrive is prolonged or not" UBYTE OneToOne 1 100 0.00 255.0 FORMAT "%5.1" ECU_ADDRESS 0x700054A4 /end MEASUREMENT
/begin MEASUREMENT SyC_stSub "" UBYTE ExeCon_State_02 1 100 0.00 6.00000000000 FORMAT "%13.11" ECU_ADDRESS 0x5000605A /end MEASUREMENT
/begin MEASUREMENT SyC_stSubOld "Previous system/ECU sub-state" UBYTE ExeCon_State_02 1 100 0.00 6.00000000000 FORMAT "%13.11" ECU_ADDRESS 0x5000605B /end MEASUREMENT
/begin MEASUREMENT SyC_stSwtOn_mp "Status current reason for switching-on ECU" UBYTE OneToOne 1 100 0.00 255.0 FORMAT "%5.1" ECU_ADDRESS 0x70009EE5 /end MEASUREMENT
/begin MEASUREMENT SyC_stVldTiEcuOff "ECU off time valid" UBYTE OneToOne 1 100 0.00 255.0 BIT_MASK 0x1 FORMAT "%5.1" ECU_ADDRESS 0x6000F7C1 /end MEASUREMENT
/begin MEASUREMENT SyC_tiBoot_mp "Time from ECU switch-on until system state SYC_INI is reached" ULONG Time_usec_q1_COMPU 1 100 0.00 4294967295.00 FORMAT "%13.2" ECU_ADDRESS 0x70009A08 /end MEASUREMENT
/begin MEASUREMENT SyC_tiDrv "Time since state SYC_DRIVE was reached" ULONG Time_msec_q10_COMPU 1 100 0.00 42949672950.0 FORMAT "%13.1" ECU_ADDRESS 0x600131B4 /end MEASUREMENT
/begin MEASUREMENT SyC_tiEcuOff "ECU off time" SLONG Time_sec_q1_COMPU 1 100 -2147483648.00 2147483647.00 FORMAT "%13.2" ECU_ADDRESS 0x600131BC /end MEASUREMENT
/begin MEASUREMENT SyC_tiFrst10ms "Time from ECU boot until the first 10ms task" UWORD Time_msec_q1_COMPU 1 100 0.00 65535.00 FORMAT "%8.2" ECU_ADDRESS 0x6000944E /end MEASUREMENT
/begin MEASUREMENT SyC_tiIniEnd_mp "Duration of system state SYC_INIEND" UWORD Time_usec_q1_COMPU 1 100 0.00 65535.00 FORMAT "%8.2" ECU_ADDRESS 0x70009C42 /end MEASUREMENT
/begin MEASUREMENT SyC_tiIniSyn_mp "Duration of system state SYC_INISYN" UWORD Time_usec_q1_COMPU 1 100 0.00 65535.00 FORMAT "%8.2" ECU_ADDRESS 0x70009C40 /end MEASUREMENT
/begin MEASUREMENT SyC_tiIni_mp "Duration of system state SYC_INI" ULONG Time_usec_q1_COMPU 1 100 0.00 4294967295.00 FORMAT "%13.2" ECU_ADDRESS 0x70009A04 /end MEASUREMENT
/begin MEASUREMENT SyC_tiPostDrv "Time since state SYC_POSTDRIVE was reached" ULONG Time_msec_q10_COMPU 1 100 0.00 42949672950.0 FORMAT "%13.1" ECU_ADDRESS 0x50004FC0 /end MEASUREMENT
/begin MEASUREMENT SyC_tiPreDrv "Time since state SYC_PREDRIVE was reached" ULONG Time_msec_q10_COMPU 1 100 0.00 42949672950.0 FORMAT "%13.1" ECU_ADDRESS 0x50004FC8 /end MEASUREMENT
/begin MEASUREMENT SysDiag_flgAppPressed "Flag for APP pressed in test coordinator" UBYTE B_TRUE 1 100 0.00 1.00000000000 BIT_MASK 0x1 FORMAT "%13.11" ECU_ADDRESS 0x6000F08E /end MEASUREMENT
/begin MEASUREMENT SysDiag_flgCModJdg "Sysdiag Judgment mode state" UBYTE B_TRUE 1 100 0.00 1.00000000000 BIT_MASK 0x1 FORMAT "%13.11" ECU_ADDRESS 0x6000F08D /end MEASUREMENT
/begin MEASUREMENT SysDiag_flgComErr "SysDiag flag com error" UBYTE B_TRUE 1 100 0.00 1.00000000000 BIT_MASK 0x1 FORMAT "%13.11" ECU_ADDRESS 0x6000F08C /end MEASUREMENT
/begin MEASUREMENT SysDiag_flgModInhb "Inhibit state" UBYTE B_TRUE 1 100 0.00 1.00000000000 BIT_MASK 0x1 FORMAT "%13.11" ECU_ADDRESS 0x6000F08B /end MEASUREMENT
/begin MEASUREMENT SysDiag_flgStCANRx "SysDiag flag for CAN receive" UBYTE B_TRUE 1 100 0.00 1.00000000000 BIT_MASK 0x1 FORMAT "%13.11" ECU_ADDRESS 0x6000F08A /end MEASUREMENT
/begin MEASUREMENT SysDiag_flgTiCMod "Duration limit for Certification mode calculation" UBYTE B_TRUE 1 100 0.00 1.00000000000 BIT_MASK 0x1 FORMAT "%13.11" ECU_ADDRESS 0x6000F089 /end MEASUREMENT
/begin MEASUREMENT SysDiag_nrAppUpDwnCnt1 "Accelerator pedal Pressed and released count1" UBYTE OneToOne 1 100 0.00 255.0 FORMAT "%5.1" ECU_ADDRESS 0x6000F33F /end MEASUREMENT
/begin MEASUREMENT SysDiag_nrAppUpDwnCnt2 "Accelerator pedal Pressed and released count2" UBYTE OneToOne 1 100 0.00 255.0 FORMAT "%5.1" ECU_ADDRESS 0x6000F33E /end MEASUREMENT
/begin MEASUREMENT SysDiag_nrAppUpDwnCnt3 "Accelerator pedal Pressed and released count3" UBYTE OneToOne 1 100 0.00 255.0 FORMAT "%5.1" ECU_ADDRESS 0x6000F33D /end MEASUREMENT
/begin MEASUREMENT SysDiag_nrBrkUpDwnCnt "Brk Count" UBYTE OneToOne 1 100 0.00 255.0 FORMAT "%5.1" ECU_ADDRESS 0x6000F33C /end MEASUREMENT
/begin MEASUREMENT SysDiag_stGearLvr "SysDiag status of gear level" UBYTE OneToOne 1 100 0.00 255.0 FORMAT "%5.1" ECU_ADDRESS 0x6000F33B /end MEASUREMENT
/begin MEASUREMENT SysDiag_stGearLvrOld "SysDiag status of old gear level" UBYTE OneToOne 1 100 0.00 255.0 FORMAT "%5.1" ECU_ADDRESS 0x6000ADB4 /end MEASUREMENT
/begin MEASUREMENT SysDiag_stLvrSet "SysDiag status gear lever set" UBYTE B_TRUE 1 100 0.00 1.00000000000 BIT_MASK 0x1 FORMAT "%13.11" ECU_ADDRESS 0x6000F088 /end MEASUREMENT
/begin MEASUREMENT SysDiag_stOldClth3st "Clth3st old status" UBYTE OneToOne 1 100 0.00 255.0 FORMAT "%5.1" ECU_ADDRESS 0x6000ADB3 /end MEASUREMENT
/begin MEASUREMENT SysDiag_stT15 "Sysdiag T15-On state" UBYTE B_TRUE 1 100 0.00 1.00000000000 BIT_MASK 0x1 FORMAT "%13.11" ECU_ADDRESS 0x6000ADB2 /end MEASUREMENT
/begin MEASUREMENT SysDiag_stTestMod "test mode" UBYTE OneToOne 1 100 0.00 255.0 FORMAT "%5.1" ECU_ADDRESS 0x6000F33A /end MEASUREMENT
/begin MEASUREMENT tahrlsu_w_msg "Duty cycle for lambda sensor heater" UWORD rel_q0p003052 1 100 0.00 199.9969 FORMAT "%8.4" ECU_ADDRESS 0x60008A74 /end MEASUREMENT
/begin MEASUREMENT tans "intake air temperature" UBYTE temp_ub_q0p75_o48 1 100 -48.0 143.3 FORMAT "%5.1" ECU_ADDRESS 0x6000F2DA /end MEASUREMENT
/begin MEASUREMENT tateout_w "output duty cycle for canister purge valve (16 bit)" UWORD rel_q0p00153 1 100 0.00 99.99847 FORMAT "%8.5" ECU_ADDRESS 0x60008A6E /end MEASUREMENT
/begin MEASUREMENT tatesoll_w_msg "desired duty cycle of the PCV (16 bit)" UWORD rel_q0p00153 1 100 0.00 99.99847 FORMAT "%8.5" ECU_ADDRESS 0x60008A66 /end MEASUREMENT
/begin MEASUREMENT tavvm_w_msg "air temperature upstream booster from model [°C]" UWORD temp_q0p0234_o273 1 100 -273.150 1262.827 FORMAT "%8.3" ECU_ADDRESS 0x60008A64 /end MEASUREMENT
/begin MEASUREMENT TECU_t "ECU Temperature." SWORD Temp_Cels 1 100 -273.140 3003.560 FORMAT "%8.3" ECU_ADDRESS 0x60008F44 /end MEASUREMENT
/begin MEASUREMENT temp_AirSys_tFld "" UBYTE OneToOne 1 100 0.00 255.0 FORMAT "%5.1" ECU_ADDRESS 0x6000ADB7 /end MEASUREMENT
/begin MEASUREMENT temp_i "" UBYTE OneToOne 1 100 0.00 255.0 FORMAT "%5.1" ECU_ADDRESS 0x70001F6C /end MEASUREMENT
/begin MEASUREMENT temp_InjSys_facPreIgnMix_a "" UBYTE OneToOne 1 100 0.00 255.0 FORMAT "%5.1" ECU_ADDRESS 0x6000ADB6 /end MEASUREMENT
/begin MEASUREMENT tfa1linf "physical temperature value, which takes place by conversion of low pass filtered sensor voltage wtfa1f_w" UBYTE temp_ub_q0p75 1 100 0.00 191.3 FORMAT "%5.1" ECU_ADDRESS 0x6000F2D4 /end MEASUREMENT
/begin MEASUREMENT tfuelsq "fuel temperature (sensor, model or subsitute value)" UBYTE temp_ub_q0p75_o48 1 100 -48.0 143.3 FORMAT "%5.1" ECU_ADDRESS 0x6000F2D3 /end MEASUREMENT
/begin MEASUREMENT TiOff_stTiStrtEndOffVW "off time of start-end recognition for customer" UBYTE OneToOne 1 100 0.00 255.0 FORMAT "%5.1" ECU_ADDRESS 0x6000EF20 /end MEASUREMENT
/begin MEASUREMENT TMECmb_facCamsftIntkPosnEgr "Intake camshaft position interpolation factor including potential external EGR" UBYTE fak_ub_b1 1 100 0.00 0.9961 ECU_ADDRESS 0x6000F336 /end MEASUREMENT
/begin MEASUREMENT tmot "Engine temperature" UBYTE temp_ub_q0p75_o48 1 100 -48.0 143.3 FORMAT "%5.1" ECU_ADDRESS 0x6000F2D1 /end MEASUREMENT
/begin MEASUREMENT tmottstr_w "Coolant Engine Temperature for PID-Service" UWORD temp_q0p0234_o273 1 100 -273.150 1262.827 FORMAT "%8.3" ECU_ADDRESS 0x60008A58 /end MEASUREMENT
/begin MEASUREMENT tmst "engine temperature at start" UBYTE temp_ub_q0p75_o48 1 100 -48.0 143.3 FORMAT "%5.1" ECU_ADDRESS 0x6000F2CF /end MEASUREMENT
/begin MEASUREMENT tnachl_w_msg "time of ECU switch off delay" UWORD t100msxs_uw_b6553p6 1 100 0.00 6553.500 FORMAT "%8.3" ECU_ADDRESS 0x6003956C /end MEASUREMENT
/begin MEASUREMENT tnse_w "time counter at end of start (16 bit)" UWORD t100msxs_uw_b6553p5 1 100 0.00 6553.500 FORMAT "%8.3" ECU_ADDRESS 0x60008A56 /end MEASUREMENT
/begin MEASUREMENT tnst_msg "time after end of start" UBYTE t_q1 1 100 0.00 255.0 FORMAT "%5.1" ECU_ADDRESS 0x6000F2CD /end MEASUREMENT
/begin MEASUREMENT tnst_w "time after end of start" UWORD t_q0p01 1 100 0.00 655.3500 FORMAT "%8.4" ECU_ADDRESS 0x60008A54 /end MEASUREMENT
/begin MEASUREMENT toch "oil temperature in cylinder head" UBYTE temp_ub_q0p75_o48 1 100 -48.0 143.3 FORMAT "%5.1" ECU_ADDRESS 0x6000F2CC /end MEASUREMENT
/begin MEASUREMENT tolc_msg "oil temperature from combi or from COWIV" UBYTE temp_ub_q1_o60 1 100 -60.0 195.0 FORMAT "%5.1" ECU_ADDRESS 0x6000F2CB /end MEASUREMENT
/begin MEASUREMENT Tra_bCANErrMax "Priority of speed limitation in case of CAN errors" UBYTE B_TRUE 1 100 0.00 1.00000000000 BIT_MASK 0x1 FORMAT "%13.11" ECU_ADDRESS 0x600001AF /end MEASUREMENT
/begin MEASUREMENT Tra_nPrdcInpN "Predicted rotational speed after gearbox intervention" SWORD EngN 1 100 -16384.00 16383.50 FORMAT "%8.2" ECU_ADDRESS 0x60008F2E /end MEASUREMENT
/begin MEASUREMENT Tra_stEngStop "The status of the engine stalling judge" UBYTE OneToOne 1 100 0.00 255.0 FORMAT "%5.1" ECU_ADDRESS 0x6000F32E /end MEASUREMENT
/begin MEASUREMENT TrbCh_flgLongTermAdpnHistB1 "History indicator for long term adaptation" UBYTE B_TRUE 1 100 0.00 1.00000000000 BIT_MASK 0x1 FORMAT "%13.11" ECU_ADDRESS 0x70000744 /end MEASUREMENT
/begin MEASUREMENT TrbCh_ratDesB1 "Desired position for the turbocharger" SWORD rel_q0p0078125 1 100 -256.0000 255.9922 FORMAT "%8.4" ECU_ADDRESS 0x60008EEC /end MEASUREMENT
/begin MEASUREMENT TrbCh_ratDutyCycB1 "Control duty cycle" SWORD rel_q0p0078125 1 100 -256.0000 255.9922 FORMAT "%8.4" ECU_ADDRESS 0x60008EEA /end MEASUREMENT
/begin MEASUREMENT TrbCh_uLongTermClsdSensB1 "Long term adaptation value of lower electrical stop sensor 1 bank 1" UWORD spg_q1p221Em3_V 1 100 0.00 79.99878 FORMAT "%8.5" ECU_ADDRESS 0x60008B78 /end MEASUREMENT
/begin MEASUREMENT TrbCh_uRawSens1B1 "Raw sensor value of the actuator. Sensor 1, Bank 1 message" UWORD spg_q1p221Em3_V 1 100 0.00 79.99878 FORMAT "%8.5" ECU_ADDRESS 0x60008B76 /end MEASUREMENT
/begin MEASUREMENT TrbCh_uShoTermClsdSensB1 "Short term adaptation value of lower electrical stop sensor 1 bank 1" UWORD spg_q1p221Em3_V 1 100 0.00 79.99878 FORMAT "%8.5" ECU_ADDRESS 0x60008B74 /end MEASUREMENT
/begin MEASUREMENT TrsmEmac_ratElmTrsm "Transmission ratio of electric machine" SWORD TransR 1 100 -327.6800 327.6700 FORMAT "%8.4" ECU_ADDRESS 0x60008EE8 /end MEASUREMENT
/begin MEASUREMENT tumc_msg "Ambient temperature received CAN message" UBYTE temp_ub_q0p75_o48 1 100 -48.0 143.3 FORMAT "%5.1" ECU_ADDRESS 0x6000F2CA /end MEASUREMENT
/begin MEASUREMENT tvlueft_msg "duty cycle of fan for fuel temperature model" UBYTE tv_ub_b100 1 100 0.00 99.61 FORMAT "%5.2" ECU_ADDRESS 0x6000EEC5 /end MEASUREMENT
/begin MEASUREMENT TWCD_bEnaOSCB1 "Condition OSC Measurement enabled, bank 1" UBYTE B_TRUE 1 100 0.00 1.00000000000 BIT_MASK 0x1 FORMAT "%13.11" ECU_ADDRESS 0x70000756 /end MEASUREMENT
/begin MEASUREMENT TWCD_bFinOSCMeasB1 "Condition OSC measurement finished, bank 1" UBYTE B_TRUE 1 100 0.00 1.00000000000 BIT_MASK 0x1 FORMAT "%13.11" ECU_ADDRESS 0x70000755 /end MEASUREMENT
/begin MEASUREMENT UEGO_flgAirScav "condition to indicate scavenging is active" UBYTE B_TRUE 1 100 0.00 1.00000000000 BIT_MASK 0x1 FORMAT "%13.11" ECU_ADDRESS 0x70000743 /end MEASUREMENT
/begin MEASUREMENT UEGO_iIPmpSrv1S1B1 "physically corrected pump current for tester sensor 1 bank 1" SWORD i_q1_uA 1 100 -32768.00 32767.00 FORMAT "%8.2" ECU_ADDRESS 0x700053EA /end MEASUREMENT
/begin MEASUREMENT ufst_w_msg "AD Input voltage tank level sensor" UWORD spg_uw_q0p004888 1 100 0.00 320.3351 FORMAT "%8.4" ECU_ADDRESS 0x60008A4E /end MEASUREMENT
/begin MEASUREMENT VehMot_stStabIntv "Status torque intervention ESP interventions" UBYTE OneToOne 1 100 0.00 255.0 FORMAT "%5.1" ECU_ADDRESS 0x6000F30A /end MEASUREMENT
/begin MEASUREMENT VehMot_tqCluDesGenericLimn "Extended generic limitation on des path" SWORD Trq 1 100 -3276.800 3276.700 FORMAT "%8.3" ECU_ADDRESS 0x60008DD8 /end MEASUREMENT
/begin MEASUREMENT VehMot_tqCluGenericLim "Generic torque limitation at clutch level" SWORD Trq 1 100 -3276.800 3276.700 FORMAT "%8.3" ECU_ADDRESS 0x6000877E /end MEASUREMENT
/begin MEASUREMENT VehMot_tqCluLeadGenericLimn "Extended generic limitation on lead path (consist of engine torque only)" SWORD Trq 1 100 -3276.800 3276.700 FORMAT "%8.3" ECU_ADDRESS 0x60008DD4 /end MEASUREMENT
/begin MEASUREMENT VehMot_trqDes "Desired torque for propulsion (transmission output torque)" SLONG TrqPrpHigh 1 100 -52428.8000000 52428.7000000 FORMAT "%13.7" ECU_ADDRESS 0x60003768 /end MEASUREMENT
/begin MEASUREMENT VehMot_trqDesAcs "Required Torque of Vehicle Motion acsessories" SWORD Trq 1 100 -3276.800 3276.700 FORMAT "%8.3" ECU_ADDRESS 0x60008DD2 /end MEASUREMENT
/begin MEASUREMENT VehPos_rIncIX "Road Resistance Index information from Gearbox ECU" SWORD PrcHigh 1 100 -32.76800 32.76700 FORMAT "%8.5" ECU_ADDRESS 0x60008DD0 /end MEASUREMENT
/begin MEASUREMENT VehV_flgStandStill "Standstill detection condition" UBYTE B_TRUE 1 100 0.00 1.00000000000 BIT_MASK 0x1 FORMAT "%13.11" ECU_ADDRESS 0x600001AE /end MEASUREMENT
/begin MEASUREMENT vfzg "vehicle speed (km/h)" UBYTE vfzg_ub_q1p25 1 100 0.00 318.8 FORMAT "%5.1" ECU_ADDRESS 0x6000F2C9 /end MEASUREMENT
/begin MEASUREMENT VMD_trqEngDesCom "Unlimited driving torque for CAN : DRVTRQ" SLONG TrqPrpHigh 1 100 -214748364.800 214748364.700 FORMAT "%13.3" ECU_ADDRESS 0x70005268 /end MEASUREMENT
/begin MEASUREMENT WaHt_flgHeatrRiseReq "Flag to enable the water temperature rise demand request." UBYTE B_TRUE 1 100 0.00 1.00000000000 BIT_MASK 0x1 FORMAT "%13.11" ECU_ADDRESS 0x700006D3 /end MEASUREMENT
/begin MEASUREMENT WaHt_tDeltaEngT "Delta Engine temperature" SWORD Temp_Cels 1 100 -3549.940 3003.560 FORMAT "%8.3" ECU_ADDRESS 0x60008DAE /end MEASUREMENT
/begin MEASUREMENT wdks_w "desired throttle angle w.r.t. to lower mechanical stop" UWORD relDK_uw_b100 1 100 0.00 100.0000 FORMAT "%8.4" ECU_ADDRESS 0x600008A2 /end MEASUREMENT
/begin MEASUREMENT wkratst "wkra updated with synchro" SBYTE kw_q0p75 1 100 0.00 95.25 FORMAT "%5.2" ECU_ADDRESS 0x6000F7AB /end MEASUREMENT
/begin MEASUREMENT wped_w "normalized angle acceleration pedal" UWORD relPED_q0p00153 1 100 0.00 100.0000 FORMAT "%8.4" ECU_ADDRESS 0x60008A42 /end MEASUREMENT
/begin MEASUREMENT wtacvol_w "Row voltage value of AC volume temperature over ADC" UWORD spg_uw_q0p00488 1 100 0.00 319.9951 FORMAT "%8.4" ECU_ADDRESS 0x60008A3E /end MEASUREMENT
/begin MEASUREMENT zzbank_msg "cylinder allocation to exhaust banks" UBYTE dez 1 100 0.00 255.0 FORMAT "%5.1" ECU_ADDRESS 0x6000EEC4 /end MEASUREMENT
/begin MEASUREMENT zzylhue_msg "cylinder counter for homogeneous injection für monitoring" UBYTE dez 1 100 0.00 11.00 FORMAT "%5.2" ECU_ADDRESS 0x7000364D /end MEASUREMENT
/begin MEASUREMENT zzylh_msg "cylinder counter for homogeneous injection" UBYTE dez 1 100 0.00 11.00 FORMAT "%5.2" ECU_ADDRESS 0x7000364E /end MEASUREMENT
/begin MEASUREMENT zzyls_msg "cylinder counter for stratified injection" UBYTE dez 1 100 0.00 11.00 FORMAT "%5.2" ECU_ADDRESS 0x7000364C /end MEASUREMENT
/begin MEASUREMENT zzylzue_msg "SW-cylinder counter for ignition calculation" UBYTE dez 1 100 0.00 11.00 FORMAT "%5.2" ECU_ADDRESS 0x7000364B /end MEASUREMENT
/begin FUNCTION SWAdp "159.0.0_3.11.0central SW-Adapter (legacy)"
 /begin DEF_CHARACTERISTIC AGRVPSHYSHIGH_C AGRVPSHYSLOW_C agrvpsHysSwt_C agrvpsHysVal_C AHEAGW AirC_stSwtPrs_C AltIO_DiagPs_CW Alt_stDchaAltUpprLimStk_C App_flgSRCLo1HiImpdChk_C App_flgSRCLo2HiImpdChk_C APP_flgT15HealEnad_C App_swtHiImpdChkEna_C ATS_TrbCh_B1.LimitTypeMsk_C ATS_TrbCh_B1.CnvNorm_C ATS_TrbCh_B1.LowLim_C ATS_TrbCh_B1.UpLim_C ATS_TrbCh_B1.CnvFac_C ATS_TrbCh_B1.CnvOfs_C ATS_TrbCh_B1.DfltVal_C bdemodst_msg_C BrkBst_pMaxIntkMnfldHiRng_C BrkPed_pForISABIdleStop_C Brk_stEBBBrkDetn_C B_agrvg_msg_C B_agrvsg_msg_C B_bkvnhom_msg_C B_cdkvssc_msg_C B_cdtesps_msg_C B_clradbbo_msg_C B_disagrkd_msg_C B_dtdisagr_msg_C B_dteird_msg_C B_dtevact_msg_C B_eagrv_msg_C B_faagr_msg_C B_fabe_msg_C B_fates_msg_C B_fststamap_msg_C B_lradp1mn_msg_C B_lradp1mx_msg_C B_rkapp_msg_C B_tavdkgg_msg_C B_teftstft_msg_C CACPmpRly_ATS.LimitTypeMsk_C CACPmpRly_ATS.CnvNorm_C CACPmpRly_ATS.LowLim_C CACPmpRly_ATS.UpLim_C CACPmpRly_ATS.CnvFac_C CACPmpRly_ATS.CnvOfs_C CACPmpRly_ATS.DfltVal_C CACPmp_ATS.LimitTypeMsk_C CACPmp_ATS.CnvNorm_C CACPmp_ATS.LowLim_C CACPmp_ATS.UpLim_C CACPmp_ATS.CnvFac_C CACPmp_ATS.CnvOfs_C CACPmp_ATS.DfltVal_C CByVlvB1_Test_ATS.LimitTypeMsk_C CByVlvB1_Test_ATS.CnvNorm_C CByVlvB1_Test_ATS.LowLim_C CByVlvB1_Test_ATS.UpLim_C CByVlvB1_Test_ATS.CnvFac_C CByVlvB1_Test_ATS.CnvOfs_C CByVlvB1_Test_ATS.DfltVal_C CDAGR CDEHFM CDKVS CDLLR CDTES Clth_drFlt_C Clth_rKisspnt_C Clth_stClthExtd_C Clth_swtClthType_C CoEOM_stEOMDesWoCatHtg_C ComDCDC_stDiagCirc1_C ComDCDC_stDiagCirc2_C ComDCDC_stRxErr_C Com_flgACCNorm_C Com_flgEAT9Norm_C Com_flgManModIndcn_C Com_numGearTrgt_C Com_rEEV1PosFb_C Com_stACCSpdUnit_C Com_stADSSpdLim_C Com_stATEnaCond_C Com_stATErr4_C Com_stATShftUpDwnReq_C Com_stAYC_C Com_stCamHealDisp_C Com_stDispDmdEnvCdn_C Com_stDispDmdSignRi_C Com_stEAT3Mon_C Com_stEngMapReq_C Com_stEVPIdleStopFail_C Com_stEVPIdleStopReq_C Com_stISEBBFail_C Com_stMonMET_C Com_stNotTxDrvgF_C Com_tqDesENGT1Max_C Com_vDigVehMph_C Conv_tiLvrChgDrvRvs_CUR Conv_tiLvrChgRvsDrv_CUR Conv_tiRevLvrOffNeut_CUR Conv_tiRevLvrOffPark_CUR Conv_tqResvTDpdtDRACOn_CUR Conv_tqResvTDpdtDR_CUR CPV_ADDCTL_ATS_ATS.LimitTypeMsk_C CPV_ADDCTL_ATS_ATS.CnvNorm_C CPV_ADDCTL_ATS_ATS.LowLim_C CPV_ADDCTL_ATS_ATS.UpLim_C CPV_ADDCTL_ATS_ATS.CnvFac_C CPV_ADDCTL_ATS_ATS.CnvOfs_C CPV_ADDCTL_ATS_ATS.DfltVal_C CrCtl_stIDASTqModFailr_C CrCUI_stPlusRDrvMod_C CWAGR CWKTAGRA CWRR CW_CY329_Boost_Perm_On_Test CW_EGRVlv_r_Test Dspl_stCrsASLSelInfo_C DWOGVE EGRVlv_rGovDesVal_C EGRVlv_tiGovDesDelay_C ElecLd_stSRCChk_C ElM_tqActWoAcsyCmp_C ESS_bEngStrtEna_C etakhtrp_w_msg_C ExhMgT_flgRelsLamCptProtn_C ExhMod_flgStTMdlIninCat1B1_C ExhMod_flgStTMdlIninCat2B1_C ExhMod_uThresRichPurgO2StrgCat1_C FfPrm_flgModCalc_msg_C FKFUPSFET flamlu_w_msg_C FlMA_flgIninFinshdBGAUSG_C FlMA_flgIninFinshdLAMKORRLL_C FuPHi_flgOnOffCtrlFadeOut_C GbxRevLck_ATS.LimitTypeMsk_C GbxRevLck_ATS.CnvNorm_C GbxRevLck_ATS.LowLim_C GbxRevLck_ATS.UpLim_C GbxRevLck_ATS.CnvFac_C GbxRevLck_ATS.CnvOfs_C GbxRevLck_ATS.DfltVal_C Gbx_bATSlipOpn_C Gbx_bNCmp_C Gbx_bTIIIntv_C Gbx_flgNCtrlImp_C Gbx_flgNCtrlRetStrt_C Gbx_nRrngEngSpdInh_C Gbx_rConvSlip_C Gbx_trqActClth_C Gbx_uAPPMaxLrn_C GEVCtl_agWidthCamProfLoLftIntk_C GEVlv_agExtrpnOutlB1_C GEVlv_agOutlB1_C HEGO_flgReIniSnsrTMdl_C HEGO_resRiMaxPlaus_C I14229iocbiCrCtl1_stVal_C I14229iocbiCrCtl_stVal_C I14229_stAutoStrtEna_C I14229_stShipModActv_C I14229_stShipMod_C Ign_IgnAgDplKnkLimn_M Ign_nEng20_AX Ign_nEngVS12_AX Ign_ratChrgAirVS12_AX InjSys_facMixAdpnIdle_a_CA InjSys_facPreIgnMix_a_CA InjSys_idxVcosPntTran_C InjSys_stTranTPist_1 LAS_facRoadGrdt_C NSWO1 NSWO2 PCR_pDesVal_C PHAACTROUTL_CTL_ATS_ATS.LimitTypeMsk_C PHAACTROUTL_CTL_ATS_ATS.CnvNorm_C PHAACTROUTL_CTL_ATS_ATS.LowLim_C PHAACTROUTL_CTL_ATS_ATS.UpLim_C PHAACTROUTL_CTL_ATS_ATS.CnvFac_C PHAACTROUTL_CTL_ATS_ATS.CnvOfs_C PHAACTROUTL_CTL_ATS_ATS.DfltVal_C psmxbkvg_w_msg_C PTDist_flgCrkSftMintqSeln_C PTDist_flgEnaTCMFCOReqByp_C PTDist_tqdeltaTCMFCOReq_C PthSet_trqInrWoIntv_C StrtCtl_bFstStrtCtOff_C SWAdp_dnEngCoM2_T SWAdp_nEngCoM2_M SWAdp_swtTrqSeIn_C tfuelsq_C TGAGRVMAX THS2ME_stConf_CW tolc_msg_C tumc_msg_C UEGO_flgAirScav_C VehMot_tqCluDesGenericLimn_C VehMot_tqCluLeadGenericLimn_C VF2ME_THRESBKOE_C ZWAPPL /end DEF_CHARACTERISTIC
 /begin REF_CHARACTERISTIC CoVOM_stStopRelsMask_C CoVOM_stStopReqMask_C CoVOM_stStrtReqMask_C MDNORM MisfDet_swtOn_C /end REF_CHARACTERISTIC
 /begin IN_MEASUREMENT AccPed_tqMapBasd ACCtl_flgACReq ACCtl_stTrqResv ActMod_trqCrS ActMod_trqInr AC_trqDes AC_trqMaxAC AFS_mfSnsrPid agrvps_w_msg AirC_stCmprAct APP_r ASDrf_trqClthFlt BattU_u BrkBstP_pAftFil BrkS_flgBrkPmpgDetd B_dknotb_msg B_dksbeg_msg B_dksc_msg B_gtumg_msg B_invlvbcd_msg B_khakt_msg B_kh_msg B_kl15_msg B_llri_msg B_ll_msg B_mdmi_msg B_mdstop_msg B_milstp_msg B_nachl_msg B_stendll_msg B_tldinfo_msg B_tldobd_msg B_tospg_msg B_vhegfe_msg CBUtil_stReProgEvnt CEngDsT_t CEngDsT_tSnsrTstr CEngDsT_tStrt CEngUsT_flgSnsrColdChkClr CEngUsT_t Clth_r Clth_st CoEng_bCtOffConDel CoEng_flgRelsFco CoEng_stMai CoEng_tiScneEngStrtPrmIdH1F CoEOM_flgEomIgnRels CoESS_flgUReq CoETS_trqInrLeadWoCo CoETS_trqInrLimSet CoETS_trqInrSetCo ComAlt_rAltDyc CoME_trqDesComp Com_bReDEFSwCdn Com_bTSCIntvFast Com_lDst Com_rTrsmTotFild Com_stClrCmplInfoVINRegst Com_stShftInNeutr Com_stShftInPark Com_stTrsmFailMod Com_stVINWrClrDone Com_stWiprActvnCdn Com_tMtrEva Com_uFlLvlRaw CoVeh_trqAcs DCM_stCurrDiagcSession drldvls_w_msg DSMAUX_stDCy_msg ECT_bFCOEnaCmpnPrt Eep_EnvRamHist Eep_EnvRamInvld EGRVlv_r EGRVlv_ratActPosnB1 EGRVlv_rGovDesVal ehlpks_sc_msg EngStrt_bFrstStrtEnd EngStrt_bStrtEnd EngStrt_flgStrtEndIgn EngStrt_flgStrtEndTqStruct EngStrt_mFuOil_msg EngStrt_tiAftStrtEnd EngStrt_tStrtCoor EngTrqPtd_trqSet EnvP_p EnvT_t Epm_nEng Epm_nEngLRes Epm_numCyl ExhMod_mAirMfIntegEngStrt ExhMod_tExhCat1DsB1 Fan_r Fan_r2 Fan_stPs fethmnmx_msg fethmnmx_w_msg FfPrm_facFuAdpnInjr FfPrm_perEth fho_msg fra_w_msg ftead_w_msg FuelT_t FuPHi_pRail fwnwe_msg Gbx_nTrbn Gbx_stConvClth GlbDa_lDst GlbDa_lTotDst GlbDa_stTrqDem HLSDem_bNMaxRed HLSDem_nSetPLo HLSDem_nSetPTrck IgCtl_diaBascLam Ign_bVlvLInNxtCmbs Ign_bVlvLInNxtIAs Ign_ratChrgAirCyl IKCtl_agAdpnCurr_s16 IKCtl_agDynAdpnOffs_s8 InjSys_dvolFu InjSys_stActRedStg InjSys_tiInjOpenSyn1 IntkAirT_tIntkMnfld IntkAirT_tSnsr2 IntkAirT_tThrVlvUs LIGov_nDiff LIGov_trq LLim_bFcoDes LsComp_tqCmpActvSpdGovr LsComp_tqSwilLossNotFild lutskzyl_w_msg mshfm_w_msg mste_w_msg OilSwmpT_t Oil_p PEnv_dataDigSnsr PEnv_dpAirFilThr PEnv_p PhyMod_tqJEng pndkpu_w_msg psrr_w_msg PtCoornDyn_flgStabyIntvActvDes PtCoornDyn_flgStabyIntvDecActvDes PtCoornDyn_flgStabyIntvIncActvDes PtCoornDyn_flgTrsmIntvActvDes PtCoornDyn_stIntvDecLead PtCoornDyn_stIntvLead PtCoornDyn_tqCluDesWoTrsmIntv PtCoornDyn_tqCrksftLead PTDist_tqCrksftSet PthSet_bCylIndivFCOBef PthSet_bOvrRun PthSet_stOvrRun PthSet_trqInrIA PT_rTrq PT_stTraType PT_tqCluEngWoIntvExt PT_tqCluTrsmProtn PT_tqDesENGT1 PT_tqDesENGT2 PT_tqEngENG16 PT_tqEngEstimtd PT_tqResvEng PT_trqLos rlsol_w_msg rl_w_msg RngMod_trqClthMin RngMod_trqCrSMax RngMod_trqCrSMin RngMod_trqCrSMinWoCtOff RngMod_trqCrSSetMin RngMod_trqInrMinWoCtOff RngMod_trqLos SpdGov_facComp SpdGov_trqClthLimMechDes SpdGov_trqSet SrvCSwt_st StatyCoorn_tqCluDesLimd StatyCoorn_tqCluDrvDmdDes SyC_stSub SysDiag_flgCModJdg tans_msg tateout_w_msg tatesoll1_w_msg TCE_flgCylIndFcoStrtd TCE_flgFcoRdy TCE_tiExptFcoStrt TiEngOn_tiTotEngRt tnst_w_msg toch_msg TWCD_flgMeasFinB1 UEGO_ratHeatrPwrStgCtrlS1B1 VehMot_rTrqDfftl VehV_v VMD_tqCluDes wdks_w_msg /end IN_MEASUREMENT
 /begin OUT_MEASUREMENT ACCI_aReq ACCI_bACCPrs ACCI_stReq ACCI_trqDes AccPed_flgIDSFctAvl AccPed_flgVehSpedSigFailr AccPed_tqBasEng ACCtl_stDecelACCutDmd ACC_bExsMinDstBrkReq ACC_bFail ACC_bFrtCar ACC_bJmpDes ACC_rTrqAccRed ACC_st ACC_stACCDR1Req ACC_stACCDR2Req ACC_vDes AFS_mAirPerCyl agrvp_w_msg AirC_bBackliteHeatgReq AirC_stSwtPrs AirMod_mfBrkBooster AirMod_ratChrgDeltaSwtAirSys AirSys_tFld Air_tCACDs Air_tEGRClrLPDs alchpct_msg AltIO_uMeasd APP1_uRaw App_flgHiImpdChkEna App_flgSRCLo1HiImpdChk App_flgSRCLo2HiImpdChk ASDrf_trqInrSet AuxHtg_bActv BattU_uFild bdemodkh_msg bdemodst_msg Blwr_flgActv BrkBstP_p BrkBst_pMaxIntkMnfldHiRng BrkPed_pForISABIdleStop BrkP_uRaw Brk_pMnCyl Brk_r Brk_stEBBBrkDetn B_agrvdisa_msg B_agrvg_msg B_agrvsg_msg B_ate_msg B_bkvagrab_msg B_bkvmsisr_msg B_bkvnhom_msg B_bkvnkhab_msg B_bkvnwab_msg B_bkvsta_msg B_cdagrs_msg B_cdagr_msg B_cdehfm_msg B_cdkvssc_msg B_cdkvs_msg B_cdllrkh_msg B_cdllr_msg B_cdmd B_cdtesps_msg B_cdtes_msg B_clradbbo_msg B_cscltka_msg B_cvt_msg B_cwagrap_msg B_cwagrhap_msg B_dcy B_diagrkt_msg B_disagrkd_msg B_dknotb B_dksbeg B_dksc B_dtdisagr_msg B_dteaam_msg B_dteird_msg B_dtevact_msg B_dtmbh_msg B_eagrv_msg B_eepwf_msg B_faagr_msg B_faam_msg B_fabe_msg B_faeonv_msg B_fafkmsla_msg B_fahfm_msg B_falshvs_msg B_falzsr_msg B_fates_msg B_fatldeg_msg B_fatlde_msg B_fatlds_msg B_fa_msg B_fststamap_msg B_hsp B_khagrab_msg B_khatrip_msg B_kl15 B_koe_msg B_kstebf_msg B_ldsua_msg B_ll B_llri B_lradp1mn_msg B_lradp1mx_msg B_lrebps_msg B_lsuoffs_msg B_m8te_msg B_mdbgagr_msg B_mdmi B_mdstop B_milstp B_nachl B_nmot B_nostoagr_msg B_nswo1_msg B_nswo2_msg B_rkapp_msg B_rriesap_msg B_stend B_stveset_msg B_tavdkgg_msg B_tavvmg_msg B_teftstft_msg B_tippg_msg B_tolcb_msg B_urstsprr B_vheg B_vhegfe B_vhegv B_vhegzw CAClg_ratCoolgMax CAClg_ratCoolgMedHi CAClg_ratCoolgMedLo CAClg_ratCoolgMin CACPmpRly_stPs CACPmp_nSens CACPmp_rDC CACPmp_uPlausyHiThd CACPmp_uPlausyLoThd CB_flgFlsProgmEveSts CEngDsT_tStopStrtEndOff CEngUsT_flgColdStrtHeal Clth_drFlt Clth_rKisspnt Clth_stClthExtd Clth_swtClthType CoDsplCtl_stLmp4Out CoDsplCtl_stLmp5Out CoEng_bCtOffCon CoEng_bFrstStrtEnd CoEng_bHEM CoEng_bStrtEndIA CoEng_bStrtEndSpdGov CoEng_bStrtEndTrqStruct CoEng_tiNormalOBD CoEng_tiStrtDly CoEOM_flgCvlcIgnRels CoEOM_stEOMDesWoCatHtg CoETS_trqInrLead CoETS_trqInrSetWoIntvWoCo CoETS_trqUnFltLead CoETS_trqUnFltSet ComDCDC_stAbnormInp1 ComDCDC_stAbnormInp2 ComDCDC_stAbnormOutp1 ComDCDC_stAbnormOutp2 ComDCDC_stAbnormOvrheat1 ComDCDC_stAbnormOvrheat2 ComDCDC_stBoostChkFailr ComDCDC_stBoostUOper ComDCDC_stCSTOnFailr ComDCDC_stDiagCirc1 ComDCDC_stDiagCirc2 ComDCDC_stRxErr ComDCDC_stVSTIntFailr Com_bBrkPedON Com_dACCCmdVehSpdDispd Com_flgACCNorm Com_flgAcOn Com_flgEAT9Norm Com_flgManModIndcn Com_flgUpshiftMod Com_lTotOdo Com_nrIdAlt Com_nrIdChp Com_nrIdMnfc Com_numGearTrgt Com_pEVPMnfldP Com_rAltLoad Com_rClthPos Com_rEEV1PosFb Com_stACCAMon Com_stACCBMon Com_stACCIgrBrk Com_stACCSpdUnit Com_stACCTrsmGearChgReq Com_stACType Com_stADSSpdLim Com_stATEnaCond Com_stATErr4 Com_stATISS Com_stATPrkgProc Com_stATShftUpDwnReq Com_stAYC Com_stBCDGearEngmt Com_stBrk Com_stBrkPedON Com_stCamHealDisp Com_stClth Com_stDispDmdEnvCdn Com_stDispDmdSignRi Com_stEAT3Mon Com_stEBB Com_stEmgcyStrtReqOutSel Com_stEngCustRevMatchFct Com_stEngInhibReq Com_stEngMapReq Com_stEngRevMatchFct Com_stEngSrvMod Com_stEVPIdleStopFail Com_stEVPIdleStopReq Com_stGbxNPos Com_stGrip Com_stIngearEngmt Com_stInShiftNeut Com_stInShiftPrkg Com_stISEBBFail Com_stLSFStrtValDmd Com_stMonMET Com_stPPos Com_stRxEBBADeb Com_stRxEBBAOk Com_stShiftPosnIndcn Com_stSptSwtDeb Com_stStrtReqOutSel Com_stT50 Com_stTCamAbnormDisp Com_stTSRClrReas Com_trqDesENGT1 Com_trqDesENGT2 Com_trqEngENG16 Com_trqEngEstimd Conv_trqOilCoolrPmp Conv_trqOilCoolrPmpRepl CoPOM_bRelDstCEng CoPOM_facTrqDynDist CoPOM_numStrt CoPOM_stM CoPOM_stMnSt CoPOM_tqDesEmQsty CoPOM_tqEmDynMin CoPT_bTraPrtActvLead CoPT_bTraShftActvDes CoPT_bTraShftActvLead CoPT_trqClthWoIntv CoPT_trqDesCompEng CoPT_trqResvEng CoVeh_flgPtcShtOff CoVeh_tqDrvOff2MaxAC CoVeh_tqIdleMaxAC CoVeh_trqDesComp CoVM_bSIActvDes CoVM_bSIActvLead CoVM_trqLead CoVOM_stAutoRstrtReq CoVOM_stAutoRstrtReqGr1 CoVOM_stAutoRstrtReqGr2 CoVOM_stRstrtNoPtd CoVOM_stStopRelsMask CoVOM_stStopReqMask CoVOM_stStrtReqMask CrCtl_aReq CrCtl_stIDASTqModFailr CrCUI_stPlusRDrvMod CrC_stKey CThmst_r Dfftl_bLowRng dmsnte_w_msg DReqSwt_stClrDeb DrvPrgSwt_bSprt DrvPrgSwt_bSprtPlus DrvPrgSwt_bWntr DrvPrgSwt_stActEco DsplCtl_nEngSpdDisp DsplCtl_stPredEngSpd Dspl_bVelInMiles Dspl_stCrsASLSelInfo Ebs_iBatt EEM_chBatt EEM_stBattChAc Eep_stISSStorgDiagActv ehlpks_sc ElecLd_iSensLd ElecLd_stSRCChk ElM_stOperModDes ElM_tqActWoAcsyCmp ElM_tqDes ElM_tqMaxGenr ElM_tqMaxTqCtrl ElM_tqMinTqCtrl ElM_trqAct EngDa_tFld EngDa_tiEngOnOBD EngPrt_bNLimRed EngStrt_EomWrmUp3_I.stOperMod EngStrt_EomWrmUp3_I.stOperModPrio EngStrt_EomWrmUp3_I.stOperModStg EngStrt_nEngRstrtStgy2ThdLo EnvT_stTSens EnvT_tSens EnvT_uRaw ERClntVlv_r ESS_bEngStrtEna etakhmn_w_msg etakhtrp_w_msg ExhMgT_flgRelsLamCptProtn ExhMgT_ratFillgCptProtn ExhMgT_tCat1SelnRst ExhMod_flgStTMdlIninCat1B1 ExhMod_flgStTMdlIninCat2B1 ExhMod_pRelPfilDs Fan2_r FanCtl_rFan1ActMdl FanCtl_stFanCtrlEnd Fan_rPs fethmnmx fethmnmx_w FfPrm_facFuAdpnNeut FfPrm_flgEthFastAdpn FfPrm_flgFuAdpnInhbn FfPrm_flgModCalc_msg FfPrm_flgNeutValReq ffuelev_w_msg fho flamlu_w_msg flb_w_msg FlMA_flgIninFinshdBGAUSG FlMA_flgIninFinshdLAMKORRLL FlSys_dvolFlCons fra_w FrmR_nConvTurb ftead_w FuPHi_EomHiPSnsrDiag_I.stOperMod FuPHi_EomHiPSnsrDiag_I.stOperModPrio FuPHi_EomHiPSnsrDiag_I.stOperModStg FuPHi_flgOnOffCtrlFadeOut GbxMTAT_stTraType Gbx_bASTIntv Gbx_bASTNeutr Gbx_bATSlipOpn Gbx_bGearShftActv Gbx_bHaltDisEgdActv Gbx_bLimp Gbx_bNCmp Gbx_bOvrRstrtActv Gbx_bRevGear Gbx_bSailActv Gbx_bTIIIntv Gbx_bTSCIntv Gbx_flgNCtrlImp Gbx_flgNCtrlRetStrt Gbx_nASTDes Gbx_nRrngEngSpdInh Gbx_numGear Gbx_numGearTrgt Gbx_ratOilCoolrPmp Gbx_rConvSlip Gbx_rFanClgDem Gbx_rTrq Gbx_rTrqTra Gbx_stHaltDisEgdActv Gbx_stRevLck Gbx_stSpstReq Gbx_tClntDes Gbx_tiASTDes Gbx_trqActClth Gbx_trqPrt Gbx_trqTIIDes Gbx_trqTIILead Gbx_trqTSCIntvDes Gbx_trqTSCIntvLead Gbx_uAPPMaxLrn GEVCtl_agMinAdpdOutl GEVCtl_agRefPosnOutlB1 GEVCtl_agSpHomHiLftOutl GEVCtl_agSpHomLoLftOutl GEVCtl_agSpOutlB1 GEVCtl_flgPhaActrTestEnaFctOutl GEVCtl_flgSpIdleOutl GEVCtl_stGslSpOutl GEVlv_agExtrpnOutlB1 GEVlv_agOutlB1 GEVlv_flgElecErrDebActvIntkB1 GEVlv_flgPhaActrErrSuspcOutlB1 GlbDa_lDstVeh grundwert_msg GSHDem_flgInhbnGSH HEGO_flgS2B1EnaLamCtlColdOper HiPSys_flgDeactvnFuInjInhbn HLSDem_nSetPTrckCpy HndBrk_stDebVal I14229iocbiCrCtl1_stVal I14229iocbiCrCtl_stVal I14229_stShipMod I14229_stShipModActv Ign_diaShftKnkL_s16 IKCtl_flgReqEnchmtWithInteg IKCtl_iaDynAdpnOffs_s16 IKCtl_ratLamPreIgn imlatm_w InjCrv_tAir InjCtl_qSetUnBal InjSys_facMixAdpnIdle_a InjSys_facPreIgnMix_a InjSys_nrRedStgEnf InjSys_stTranTPist InjSys_tiInjOpenCorrdSyn1 IntkAirT_t IntkAirT_uSnsr3CrssSwtLoc IVGdiCtl_CvoAdpn_MeasFrzFrm_t.Cyl IVGdiCtl_CvoAdpn_MeasFrzFrm_t.POper IVGdiCtl_CvoAdpn_MeasFrzFrm_t.Pls IVGdiCtl_CvoAdpn_MeasFrzFrm_t.PlsInfo IVGdiCtl_CvoAdpn_MeasFrzFrm_t.Valid IVGdiCtl_CvoAdpn_MeasFrzFrm_t.VcosOper IVGdiCtl_CvoAdpn_MeasFrzFrm_t.desTiOpen IVGdiCtl_CvoAdpn_MeasFrzFrm_t.dti IVGdiCtl_CvoAdpn_MeasFrzFrm_t.idxP IVGdiCtl_CvoAdpn_MeasFrzFrm_t.idxVcos IVGdiCtl_CvoAdpn_MeasFrzFrm_t.tiPse kmstand_l_msg LAS_facRoadGrdt LLim_bFcoDes_msg LLim_flgEngSt LLim_flgVehSpdHi lutskzyl_w MESCtrlr_nSpDif MFDspl_flgFuCapWarn MfVD_bSpPrHld miszul_w_msg mkioel_w_msg MoFTerminal_stT50EmgyMsg mshfmst_w mste_msg nmot nmot_w nstat OilLfT_degOilDetern OilLfT_dstOilLfTiRedMilg OilLfT_mAirPerCyl OilLfT_stFailOilTSnsr OilLfT_stFailSafeActn OilLfT_stRstCmpl OilLfT_stTstrActv OilLfT_tiOilLfTi OilPmp_rPsOilPmp OilP_p OilSwmpT_uSnsrRaw Oil_stAvusWarn Oil_stOilLow PCR_pDesVal PEnv_dataDigSens PFltDes_flgInhbOverrun PhyMod_trqDynEng pndkpu_msg prist_w_msg psmxbkvg_w_msg pspu_msg psrr_w PTDist_flgEmStrtgTqActv PTDist_flgEvModSetLimnActv PThrVlvUs_uRawB1 PthSet_flgCritTqIncPhd PthSet_flgCylIndFcoStrtd PthSet_flgFcoRdy PthSet_stOvrRunCoord PthSet_tiExptFcoStrt PthSet_trqInrFlt PthSet_trqInrSet PthSet_trqInrWoIntv PTODi_trqCrSLeadUnlim PT_bCtOffPhd PT_flgLimnFCOReq PT_tqCluMinWoFco PT_trqCrSLeadPOp PT_trqCrSWoIntv PT_trqTraPrt PT_trqWhlMaxEng PT_trqWhlMinWoCtOff pu_w pvds_w_msg pvv_w_msg resdhshe_msg rlfgdsvheg_w_msg rlfgdsvhek_w_msg rlmxbkv_w_msg rlsol_w rltedte_w_msg rl_w RrDfogSwt_stRawVal Shtrp_rTrqSetPointDia Shtrp_stAct SpdGov_bNLimFCOReq SpdGov_trqEngPrtLimMech StbIntv_bESPErr StbIntv_bTCSDeActv StrtCtl_bFstStrtCtOff StrtCtl_stClthForStrtReqJdg StWhl_dphiAg StWhl_phiAg SyC_StcRchdZero SyC_stHistTiPostDrvMax SysDiag_stTestMod tahrlsu_w_msg tans tateout_w tatesoll_w_msg tavvm_w_msg TECU_t tfa1linf tfuelsq TiOff_stTiStrtEndOffVW TMECmb_facCamsftIntkPosnEgr tmot tmottstr_w tmst tnse_w tnst_msg tnst_w toch tolc_msg Tra_bCANErrMax Tra_nPrdcInpN Tra_stEngStop TrbCh_flgLongTermAdpnHistB1 TrbCh_ratDesB1 TrbCh_ratDutyCycB1 TrbCh_uLongTermClsdSensB1 TrbCh_uRawSens1B1 TrbCh_uShoTermClsdSensB1 TrsmEmac_ratElmTrsm tumc_msg tvlueft_msg TWCD_bEnaOSCB1 TWCD_bFinOSCMeasB1 UEGO_flgAirScav UEGO_iIPmpSrv1S1B1 ufst_w_msg VehMot_stStabIntv VehMot_tqCluDesGenericLimn VehMot_tqCluGenericLim VehMot_tqCluLeadGenericLimn VehMot_trqDes VehMot_trqDesAcs VehPos_rIncIX VehV_flgStandStill vfzg VMD_trqEngDesCom WaHt_flgHeatrRiseReq WaHt_tDeltaEngT wdks_w wkratst wped_w wtacvol_w zzbank_msg /end OUT_MEASUREMENT
 /begin LOC_MEASUREMENT EGRVlv_stGovDesVal_mp SWAdp_idxInjSysIdle temp_AirSys_tFld temp_i temp_InjSys_facPreIgnMix_a /end LOC_MEASUREMENT
 FUNCTION_VERSION "159.0.0_3.11.0" /end FUNCTION
/begin FUNCTION SyC2ME "10.4.0    Interface Adapter System Control to ME" /begin IN_MEASUREMENT Eep_EnvRamHist Eep_EnvRamInvld SyC_stSub T15_st /end IN_MEASUREMENT
 /begin OUT_MEASUREMENT B_nachlauf_msg B_nachl_msg B_norm_msg B_wakeup_msg tnachl_w_msg /end OUT_MEASUREMENT
 /begin LOC_MEASUREMENT nltrstdone_msg /end LOC_MEASUREMENT
 FUNCTION_VERSION "10.4.0" /end FUNCTION
/begin FUNCTION SyC_Vld2Lcy "1.19.0    SW Adapter System Control: Mapping Valid to Legacy Interface Elements" /begin IN_MEASUREMENT CoEng_st DSM_TripChgAndClrFinshd Epm_nEng /end IN_MEASUREMENT
 /begin OUT_MEASUREMENT SyC_ctDrvEnter SyC_ctIrrSwOff SyC_ctPostDrvLeave SyC_stMn SyC_stMnOld SyC_stPostDrv SyC_stPostDrvDel SyC_stPreDrv SyC_stPreDrvDel SyC_stSub SyC_stSubOld SyC_stVldTiEcuOff SyC_tiDrv SyC_tiEcuOff SyC_tiFrst10ms SyC_tiPostDrv SyC_tiPreDrv /end OUT_MEASUREMENT
 /begin LOC_MEASUREMENT SyC_stSwtOn_mp SyC_tiBoot_mp SyC_tiIniEnd_mp SyC_tiIniSyn_mp SyC_tiIni_mp /end LOC_MEASUREMENT
 FUNCTION_VERSION "1.19.0" /end FUNCTION
/begin FUNCTION SYNTIZW "4.5.0     BDE synchronization injection/ignition" /begin IN_MEASUREMENT Epm_ctCyl Epm_numCyl Gen_ctCylAdv /end IN_MEASUREMENT
 /begin OUT_MEASUREMENT InjSys_cntrSync0 InjSys_cntrSync1 InjSys_ctCylAdvOffsGdi InjSys_ctCylAdvOffsHom InjSys_ctCylAdvOffsStrat InjSys_idxNxtCylAdv InjSys_ofsCylCntrHom InjSys_ofsCylCntrStrat zzylhue_msg zzylh_msg zzyls_msg zzylzue_msg /end OUT_MEASUREMENT
 /begin LOC_MEASUREMENT B_syntizw InjSys_ctCylAdvMax /end LOC_MEASUREMENT
 FUNCTION_VERSION "4.5.0" /end FUNCTION
/begin FUNCTION SysDiag_TestCoorr "4.0.0     Test Coordinator" /begin DEF_CHARACTERISTIC SysDiag_SwtCModEnbl_C SysDiag_tiCModEng_C /end DEF_CHARACTERISTIC
 /begin IN_MEASUREMENT APP_r Brk_st Clth3_st Com_stRxEATBDeb Com_stSpdSnsrFailr Gbx_stGearLvr PT_stTraType T15_st T50_st VehV_v /end IN_MEASUREMENT
 /begin OUT_MEASUREMENT SysDiag_flgAppPressed SysDiag_flgCModJdg SysDiag_flgComErr SysDiag_flgModInhb SysDiag_flgStCANRx SysDiag_flgTiCMod SysDiag_nrAppUpDwnCnt1 SysDiag_nrAppUpDwnCnt2 SysDiag_nrAppUpDwnCnt3 SysDiag_nrBrkUpDwnCnt SysDiag_stGearLvr SysDiag_stLvrSet /end OUT_MEASUREMENT
 /begin LOC_MEASUREMENT SysDiag_stGearLvrOld SysDiag_stOldClth3st SysDiag_stT15 /end LOC_MEASUREMENT
 FUNCTION_VERSION "4.0.0" /end FUNCTION
/begin FUNCTION T152MED "10.6.0    Interface Adapter T15 to MED" /begin IN_MEASUREMENT T15_st /end IN_MEASUREMENT /begin OUT_MEASUREMENT B_kl15_msg /end OUT_MEASUREMENT FUNCTION_VERSION "10.6.0" /end FUNCTION
/begin COMPU_METHOD Acc "" RAT_FUNC "%6.5" "m/s^2" COEFFS 0 1000 0 0 0 1 /end COMPU_METHOD
/begin COMPU_METHOD AirMassPerCyl "" RAT_FUNC "%6.3" "mg/Hub" COEFFS 0 10 0 0 0 1 /end COMPU_METHOD
/begin COMPU_METHOD Angle "" RAT_FUNC "%6.4" "deg" COEFFS 0 32 0 0 0 1 /end COMPU_METHOD
/begin COMPU_METHOD AngleDerivative "" RAT_FUNC "%6.4" "deg/s" COEFFS 0 16 0 0 0 1 /end COMPU_METHOD
/begin COMPU_METHOD B_TRUE "" TAB_VERB "%6.3" "" COMPU_TAB_REF B_TRUE /end COMPU_METHOD
/begin COMPU_VTAB B_TRUE "" TAB_VERB 2 0 "FALSE" 1 "TRUE" /end COMPU_VTAB
/begin COMPU_METHOD Ch_Ah_q0p5_COMPU "" RAT_FUNC "%6.3" "Ah" COEFFS 0 2 0 0 0 1 /end COMPU_METHOD
/begin COMPU_METHOD CoEOM_stEomStgTot_VERB "" TAB_VERB "%6.3" "-" COMPU_TAB_REF CoEOM_stEomStgTot_VERB /end COMPU_METHOD
/begin COMPU_VTAB CoEOM_stEomStgTot_VERB "" TAB_VERB 513 0 "Base_HOM-SNGL_FullLft" 1 "Base_HOM_FullLft" 2 "Base_HSP_FullLft" 3 "Base_HSPIC_FullLft" 4 "Base_HOM-SNGL_EIVC" 5 "Base_HOM_EIVC" 6 "Base_HSP_EIVC" 7 "Base_HSPIC_EIVC" 8 "n/a [00;08]" 9 "n/a [00;09]" 10 "n/a [00;10]" 11 "n/a [00;11]" 12 "n/a [00;12]" 13 "n/a [00;13]" 14 "n/a [00;14]" 15 "n/a [00;15]" 255 "No_Demand" 256 "WarmUp_HOM-SNGL_FullLft" 257 "WarmUp_HOM_FullLft" 258 "WarmUp_HSP_FullLft" 259 "WarmUp_HSPIC_FullLft" 260 "WarmUp_HOM-SNGL_EIVC" 261 "WarmUp_HOM_EIVC" 262 "WarmUp_HSP_EIVC" 263 "WarmUp_HSPIC_EIVC" 264 "n/a [01;08]" 265 "n/a [01;09]" 266 "n/a [01;10]" 267 "n/a [01;11]" 268 "n/a [01;12]" 269 "n/a [01;13]" 270 "n/a [01;14]" 271 "n/a [01;15]" 512 "CatHtg_HOM-SNGL_FullLft" 513 "CatHtg_HOM_FullLft" 514 "CatHtg_HSP_FullLft" 515 "CatHtg_HSPIC_FullLft" 516 "CatHtg_HOM-SNGL_EIVC" 517 "CatHtg_HOM_EIVC" 518 "CatHtg_HSP_EIVC" 519 "CatHtg_HSPIC_EIVC" 520 "n/a [02;08]" 521 "n/a [02;09]" 522 "n/a [02;10]" 523 "n/a [02;11]" 524 "n/a [02;12]" 525 "n/a [02;13]" 526 "n/a [02;14]" 527 "n/a [02;15]" 768 "Start_FullLft" 769 "n/a [03;01]" 770 "n/a [03;02]" 771 "n/a [03;03]" 772 "Start_EIVC" 773 "n/a [03;05]" 774 "n/a [03;06]" 775 "n/a [03;07]" 776 "n/a [03;08]" 777 "n/a [03;09]" 778 "n/a [03;10]" 779 "n/a [03;11]" 780 "n/a [03;12]" 781 "n/a [03;13]" 782 "n/a [03;14]" 783 "n/a [03;15]" 1024 "n/a [04;00]" 1025 "n/a [04;01]" 1026 "n/a [04;02]" 1027 "n/a [04;03]" 1028 "n/a [04;04]" 1029 "n/a [04;05]" 1030 "n/a [04;06]" 1031 "n/a [04;07]" 1032 "n/a [04;08]" 1033 "n/a [04;09]" 1034 "n/a [04;10]" 1035 "n/a [04;11]" 1036 "n/a [04;12]" 1037 "n/a [04;13]" 1038 "n/a [04;14]" 1039 "n/a [04;15]" 1280 "n/a [05;00]" 1281 "n/a [05;01]" 1282 "n/a [05;02]" 1283 "n/a [05;03]" 1284 "n/a [05;04]" 1285 "n/a [05;05]" 1286 "n/a [05;06]" 1287 "n/a [05;07]" 1288 "n/a [05;08]" 1289 "n/a [05;09]" 1290 "n/a [05;10]" 1291 "n/a [05;11]" 1292 "n/a [05;12]" 1293 "n/a [05;13]" 1294 "n/a [05;14]" 1295 "n/a [05;15]" 1536 "n/a [06;00]" 1537 "n/a [06;01]" 1538 "n/a [06;02]" 1539 "n/a [06;03]" 1540 "n/a [06;04]" 1541 "n/a [06;05]" 1542 "n/a [06;06]" 1543 "n/a [06;07]" 1544 "n/a [06;08]" 1545 "n/a [06;09]" 1546 "n/a [06;10]" 1547 "n/a [06;11]" 1548 "n/a [06;12]" 1549 "n/a [06;13]" 1550 "n/a [06;14]" 1551 "n/a [06;15]" 1792 "n/a [07;00]" 1793 "n/a [07;01]" 1794 "n/a [07;02]" 1795 "n/a [07;03]" 1796 "n/a [07;04]" 1797 "n/a [07;05]" 1798 "n/a [07;06]" 1799 "n/a [07;07]" 1800 "n/a [07;08]" 1801 "n/a [07;09]" 1802 "n/a [07;10]" 1803 "n/a [07;11]" 1804 "n/a [07;12]" 1805 "n/a [07;13]" 1806 "n/a [07;14]" 1807 "n/a [07;15]" 2048 "n/a [08;00]" 2049 "n/a [08;01]" 2050 "n/a [08;02]" 2051 "n/a [08;03]" 2052 "n/a [08;04]" 2053 "n/a [08;05]" 2054 "n/a [08;06]" 2055 "n/a [08;07]" 2056 "n/a [08;08]" 2057 "n/a [08;09]" 2058 "n/a [08;10]" 2059 "n/a [08;11]" 2060 "n/a [08;12]" 2061 "n/a [08;13]" 2062 "n/a [08;14]" 2063 "n/a [08;15]" 2304 "n/a [09;00]" 2305 "n/a [09;01]" 2306 "n/a [09;02]" 2307 "n/a [09;03]" 2308 "n/a [09;04]" 2309 "n/a [09;05]" 2310 "n/a [09;06]" 2311 "n/a [09;07]" 2312 "n/a [09;08]" 2313 "n/a [09;09]" 2314 "n/a [09;10]" 2315 "n/a [09;11]" 2316 "n/a [09;12]" 2317 "n/a [09;13]" 2318 "n/a [09;14]" 2319 "n/a [09;15]" 2560 "n/a [10;00]" 2561 "n/a [10;01]" 2562 "n/a [10;02]" 2563 "n/a [10;03]" 2564 "n/a [10;04]" 2565 "n/a [10;05]" 2566 "n/a [10;06]" 2567 "n/a [10;07]" 2568 "n/a [10;08]" 2569 "n/a [10;09]" 2570 "n/a [10;10]" 2571 "n/a [10;11]" 2572 "n/a [10;12]" 2573 "n/a [10;13]" 2574 "n/a [10;14]" 2575 "n/a [10;15]" 2816 "n/a [11;00]" 2817 "n/a [11;01]" 2818 "n/a [11;02]" 2819 "n/a [11;03]" 2820 "n/a [11;04]" 2821 "n/a [11;05]" 2822 "n/a [11;06]" 2823 "n/a [11;07]" 2824 "n/a [11;08]" 2825 "n/a [11;09]" 2826 "n/a [11;10]" 2827 "n/a [11;11]" 2828 "n/a [11;12]" 2829 "n/a [11;13]" 2830 "n/a [11;14]" 2831 "n/a [11;15]" 3072 "n/a [12;00]" 3073 "n/a [12;01]" 3074 "n/a [12;02]" 3075 "n/a [12;03]" 3076 "n/a [12;04]" 3077 "n/a [12;05]" 3078 "n/a [12;06]" 3079 "n/a [12;07]" 3080 "n/a [12;08]" 3081 "n/a [12;09]" 3082 "n/a [12;10]" 3083 "n/a [12;11]" 3084 "n/a [12;12]" 3085 "n/a [12;13]" 3086 "n/a [12;14]" 3087 "n/a [12;15]" 3328 "n/a [13;00]" 3329 "n/a [13;01]" 3330 "n/a [13;02]" 3331 "n/a [13;03]" 3332 "n/a [13;04]" 3333 "n/a [13;05]" 3334 "n/a [13;06]" 3335 "n/a [13;07]" 3336 "n/a [13;08]" 3337 "n/a [13;09]" 3338 "n/a [13;10]" 3339 "n/a [13;11]" 3340 "n/a [13;12]" 3341 "n/a [13;13]" 3342 "n/a [13;14]" 3343 "n/a [13;15]" 3584 "n/a [14;00]" 3585 "n/a [14;01]" 3586 "n/a [14;02]" 3587 "n/a [14;03]" 3588 "n/a [14;04]" 3589 "n/a [14;05]" 3590 "n/a [14;06]" 3591 "n/a [14;07]" 3592 "n/a [14;08]" 3593 "n/a [14;09]" 3594 "n/a [14;10]" 3595 "n/a [14;11]" 3596 "n/a [14;12]" 3597 "n/a [14;13]" 3598 "n/a [14;14]" 3599 "n/a [14;15]" 3840 "n/a [15;00]" 3841 "n/a [15;01]" 3842 "n/a [15;02]" 3843 "n/a [15;03]" 3844 "n/a [15;04]" 3845 "n/a [15;05]" 3846 "n/a [15;06]" 3847 "n/a [15;07]" 3848 "n/a [15;08]" 3849 "n/a [15;09]" 3850 "n/a [15;10]" 3851 "n/a [15;11]" 3852 "n/a [15;12]" 3853 "n/a [15;13]" 3854 "n/a [15;14]" 3855 "n/a [15;15]" 4096 "n/a [16;00]" 4097 "n/a [16;01]" 4098 "n/a [16;02]" 4099 "n/a [16;03]" 4100 "n/a [16;04]" 4101 "n/a [16;05]" 4102 "n/a [16;06]" 4103 "n/a [16;07]" 4104 "n/a [16;08]" 4105 "n/a [16;09]" 4106 "n/a [16;10]" 4107 "n/a [16;11]" 4108 "n/a [16;12]" 4109 "n/a [16;13]" 4110 "n/a [16;14]" 4111 "n/a [16;15]" 4352 "n/a [17;00]" 4353 "n/a [17;01]" 4354 "n/a [17;02]" 4355 "n/a [17;03]" 4356 "n/a [17;04]" 4357 "n/a [17;05]" 4358 "n/a [17;06]" 4359 "n/a [17;07]" 4360 "n/a [17;08]" 4361 "n/a [17;09]" 4362 "n/a [17;10]" 4363 "n/a [17;11]" 4364 "n/a [17;12]" 4365 "n/a [17;13]" 4366 "n/a [17;14]" 4367 "n/a [17;15]" 4608 "n/a [18;00]" 4609 "n/a [18;01]" 4610 "n/a [18;02]" 4611 "n/a [18;03]" 4612 "n/a [18;04]" 4613 "n/a [18;05]" 4614 "n/a [18;06]" 4615 "n/a [18;07]" 4616 "n/a [18;08]" 4617 "n/a [18;09]" 4618 "n/a [18;10]" 4619 "n/a [18;11]" 4620 "n/a [18;12]" 4621 "n/a [18;13]" 4622 "n/a [18;14]" 4623 "n/a [18;15]" 4864 "n/a [19;00]" 4865 "n/a [19;01]" 4866 "n/a [19;02]" 4867 "n/a [19;03]" 4868 "n/a [19;04]" 4869 "n/a [19;05]" 4870 "n/a [19;06]" 4871 "n/a [19;07]" 4872 "n/a [19;08]" 4873 "n/a [19;09]" 4874 "n/a [19;10]" 4875 "n/a [19;11]" 4876 "n/a [19;12]" 4877 "n/a [19;13]" 4878 "n/a [19;14]" 4879 "n/a [19;15]" 5120 "n/a [20;00]" 5121 "n/a [20;01]" 5122 "n/a [20;02]" 5123 "n/a [20;03]" 5124 "n/a [20;04]" 5125 "n/a [20;05]" 5126 "n/a [20;06]" 5127 "n/a [20;07]" 5128 "n/a [20;08]" 5129 "n/a [20;09]" 5130 "n/a [20;10]" 5131 "n/a [20;11]" 5132 "n/a [20;12]" 5133 "n/a [20;13]" 5134 "n/a [20;14]" 5135 "n/a [20;15]" 5376 "n/a [21;00]" 5377 "n/a [21;01]" 5378 "n/a [21;02]" 5379 "n/a [21;03]" 5380 "n/a [21;04]" 5381 "n/a [21;05]" 5382 "n/a [21;06]" 5383 "n/a [21;07]" 5384 "n/a [21;08]" 5385 "n/a [21;09]" 5386 "n/a [21;10]" 5387 "n/a [21;11]" 5388 "n/a [21;12]" 5389 "n/a [21;13]" 5390 "n/a [21;14]" 5391 "n/a [21;15]" 5632 "n/a [22;00]" 5633 "n/a [22;01]" 5634 "n/a [22;02]" 5635 "n/a [22;03]" 5636 "n/a [22;04]" 5637 "n/a [22;05]" 5638 "n/a [22;06]" 5639 "n/a [22;07]" 5640 "n/a [22;08]" 5641 "n/a [22;09]" 5642 "n/a [22;10]" 5643 "n/a [22;11]" 5644 "n/a [22;12]" 5645 "n/a [22;13]" 5646 "n/a [22;14]" 5647 "n/a [22;15]" 5888 "n/a [23;00]" 5889 "n/a [23;01]" 5890 "n/a [23;02]" 5891 "n/a [23;03]" 5892 "n/a [23;04]" 5893 "n/a [23;05]" 5894 "n/a [23;06]" 5895 "n/a [23;07]" 5896 "n/a [23;08]" 5897 "n/a [23;09]" 5898 "n/a [23;10]" 5899 "n/a [23;11]" 5900 "n/a [23;12]" 5901 "n/a [23;13]" 5902 "n/a [23;14]" 5903 "n/a [23;15]" 6144 "n/a [24;00]" 6145 "n/a [24;01]" 6146 "n/a [24;02]" 6147 "n/a [24;03]" 6148 "n/a [24;04]" 6149 "n/a [24;05]" 6150 "n/a [24;06]" 6151 "n/a [24;07]" 6152 "n/a [24;08]" 6153 "n/a [24;09]" 6154 "n/a [24;10]" 6155 "n/a [24;11]" 6156 "n/a [24;12]" 6157 "n/a [24;13]" 6158 "n/a [24;14]" 6159 "n/a [24;15]" 6400 "n/a [25;00]" 6401 "n/a [25;01]" 6402 "n/a [25;02]" 6403 "n/a [25;03]" 6404 "n/a [25;04]" 6405 "n/a [25;05]" 6406 "n/a [25;06]" 6407 "n/a [25;07]" 6408 "n/a [25;08]" 6409 "n/a [25;09]" 6410 "n/a [25;10]" 6411 "n/a [25;11]" 6412 "n/a [25;12]" 6413 "n/a [25;13]" 6414 "n/a [25;14]" 6415 "n/a [25;15]" 6656 "n/a [26;00]" 6657 "n/a [26;01]" 6658 "n/a [26;02]" 6659 "n/a [26;03]" 6660 "n/a [26;04]" 6661 "n/a [26;05]" 6662 "n/a [26;06]" 6663 "n/a [26;07]" 6664 "n/a [26;08]" 6665 "n/a [26;09]" 6666 "n/a [26;10]" 6667 "n/a [26;11]" 6668 "n/a [26;12]" 6669 "n/a [26;13]" 6670 "n/a [26;14]" 6671 "n/a [26;15]" 6912 "n/a [27;00]" 6913 "n/a [27;01]" 6914 "n/a [27;02]" 6915 "n/a [27;03]" 6916 "n/a [27;04]" 6917 "n/a [27;05]" 6918 "n/a [27;06]" 6919 "n/a [27;07]" 6920 "n/a [27;08]" 6921 "n/a [27;09]" 6922 "n/a [27;10]" 6923 "n/a [27;11]" 6924 "n/a [27;12]" 6925 "n/a [27;13]" 6926 "n/a [27;14]" 6927 "n/a [27;15]" 7168 "n/a [28;00]" 7169 "n/a [28;01]" 7170 "n/a [28;02]" 7171 "n/a [28;03]" 7172 "n/a [28;04]" 7173 "n/a [28;05]" 7174 "n/a [28;06]" 7175 "n/a [28;07]" 7176 "n/a [28;08]" 7177 "n/a [28;09]" 7178 "n/a [28;10]" 7179 "n/a [28;11]" 7180 "n/a [28;12]" 7181 "n/a [28;13]" 7182 "n/a [28;14]" 7183 "n/a [28;15]" 7424 "n/a [29;00]" 7425 "n/a [29;01]" 7426 "n/a [29;02]" 7427 "n/a [29;03]" 7428 "n/a [29;04]" 7429 "n/a [29;05]" 7430 "n/a [29;06]" 7431 "n/a [29;07]" 7432 "n/a [29;08]" 7433 "n/a [29;09]" 7434 "n/a [29;10]" 7435 "n/a [29;11]" 7436 "n/a [29;12]" 7437 "n/a [29;13]" 7438 "n/a [29;14]" 7439 "n/a [29;15]" 7680 "n/a [30;00]" 7681 "n/a [30;01]" 7682 "n/a [30;02]" 7683 "n/a [30;03]" 7684 "n/a [30;04]" 7685 "n/a [30;05]" 7686 "n/a [30;06]" 7687 "n/a [30;07]" 7688 "n/a [30;08]" 7689 "n/a [30;09]" 7690 "n/a [30;10]" 7691 "n/a [30;11]" 7692 "n/a [30;12]" 7693 "n/a [30;13]" 7694 "n/a [30;14]" 7695 "n/a [30;15]" 7936 "n/a [31;00]" 7937 "n/a [31;01]" 7938 "n/a [31;02]" 7939 "n/a [31;03]" 7940 "n/a [31;04]" 7941 "n/a [31;05]" 7942 "n/a [31;06]" 7943 "n/a [31;07]" 7944 "n/a [31;08]" 7945 "n/a [31;09]" 7946 "n/a [31;10]" 7947 "n/a [31;11]" 7948 "n/a [31;12]" 7949 "n/a [31;13]" 7950 "n/a [31;14]" 7951 "n/a [31;15]" /end COMPU_VTAB
/begin COMPU_METHOD CrCtlSlipRat "" RAT_FUNC "%6.4" "%" COEFFS 0 200 0 0 0 1 /end COMPU_METHOD
/begin COMPU_METHOD Curr_A "" RAT_FUNC "%6.4" "A" COEFFS 0 100 0 0 0 1 /end COMPU_METHOD
/begin COMPU_METHOD dez "" RAT_FUNC "%6.2" "" COEFFS 0 1 0 0 0 1 /end COMPU_METHOD
/begin COMPU_METHOD dist_uw_q1 "" RAT_FUNC "%6.2" "Km" COEFFS 0 1 0 0 0 1 /end COMPU_METHOD
/begin COMPU_METHOD DtyCyc "" RAT_FUNC "%6.4" "%" COEFFS 0 100 0 0 0 1 /end COMPU_METHOD
/begin COMPU_METHOD EngN "" RAT_FUNC "%6.3" "rpm" COEFFS 0 2 0 0 0 1 /end COMPU_METHOD
/begin COMPU_METHOD ExeCon_State_01 "" TAB_VERB "%6.3" "" COMPU_TAB_REF ExeCon_State_01 /end COMPU_METHOD
/begin COMPU_VTAB ExeCon_State_01 "" TAB_VERB 4 0 "SYC_BOOT" 1 "SYC_PROC_INIT" 2 "SYC_PROC_EXEC" 3 "SYC_SHUTDOWN" /end COMPU_VTAB
/begin COMPU_METHOD ExeCon_State_02 "" TAB_VERB "%6.3" "" COMPU_TAB_REF ExeCon_State_02 /end COMPU_METHOD
/begin COMPU_VTAB ExeCon_State_02 "" TAB_VERB 7 0 "SYC_INI" 1 "SYC_INISYN" 2 "SYC_INIEND" 3 "SYC_PREDRIVE" 4 "SYC_DRIVE" 5 "SYC_POSTDRIVE" 6 "SYC_POST_OS_EXIT" /end COMPU_VTAB
/begin COMPU_METHOD Fact "" RAT_FUNC "%6.5" "-" COEFFS 0 8192 0 0 0 1 /end COMPU_METHOD
/begin COMPU_METHOD fak_q3p0518Em5 "" RAT_FUNC "%7.6" "" COEFFS 0 32768 0 0 0 1 /end COMPU_METHOD
/begin COMPU_METHOD fak_sw_b64 "" RAT_FUNC "%6.4" "-" COEFFS 0 65536 0 0 0 128 /end COMPU_METHOD
/begin COMPU_METHOD fak_ub_b1 "" RAT_FUNC "%6.4" "-" COEFFS 0 256 0 0 0 1 /end COMPU_METHOD
/begin COMPU_METHOD fak_ub_b2 "" RAT_FUNC "%8.5" "-" COEFFS 0 256 0 0 0 2 /end COMPU_METHOD
/begin COMPU_METHOD fak_ub_b4 "" RAT_FUNC "%6.4" "-" COEFFS 0 256 0 0 0 4 /end COMPU_METHOD
/begin COMPU_METHOD fak_uw_b1 "" RAT_FUNC "%7.6" "-" COEFFS 0 65536 0 0 0 1 /end COMPU_METHOD
/begin COMPU_METHOD fak_uw_b16 "" RAT_FUNC "%6.5" "-" COEFFS 0 65536 0 0 0 16 /end COMPU_METHOD
/begin COMPU_METHOD fak_uw_b2 "" RAT_FUNC "%7.6" "-" COEFFS 0 65536 0 0 0 2 /end COMPU_METHOD
/begin COMPU_METHOD FlConsum_l_h "" RAT_FUNC "%6.4" "l/h" COEFFS 0 100 0 0 0 1 /end COMPU_METHOD
/begin COMPU_METHOD I14229_SHIPMOD_VERB "" TAB_VERB "%6.3" "" COMPU_TAB_REF I14229_SHIPMOD_VERB /end COMPU_METHOD
/begin COMPU_VTAB I14229_SHIPMOD_VERB "" TAB_VERB 3 0 "I14229_NORMMOD" 1 "I14229_MODA" 2 "I14229_MODB" /end COMPU_VTAB
/begin COMPU_METHOD InjMass "" RAT_FUNC "%6.4" "mg/hub" COEFFS 0 100 0 0 0 1 /end COMPU_METHOD
/begin COMPU_METHOD i_q0p1_A "" RAT_FUNC "%6.3" "A" COEFFS 0 1 0 0 0 0.1 /end COMPU_METHOD
/begin COMPU_METHOD i_q1_uA "" RAT_FUNC "%6.2" "uA" COEFFS 0 1 0 0 0 1 /end COMPU_METHOD
/begin COMPU_METHOD kw_q0p0156 "" RAT_FUNC "%6.4" "Grad KW" COEFFS 0 64 0 0 0 1 /end COMPU_METHOD
/begin COMPU_METHOD kw_q0p75 "" RAT_FUNC "%6.3" "Grad KW" COEFFS 0 4 0 0 0 3 /end COMPU_METHOD
/begin COMPU_METHOD kw_q1 "" RAT_FUNC "%6.2" "Grad KW" COEFFS 0 1 0 0 0 1 /end COMPU_METHOD
/begin COMPU_METHOD Length "" RAT_FUNC "%6.2" "m" COEFFS 0 1 0 0 0 1 /end COMPU_METHOD
/begin COMPU_METHOD lu_MEx "" RAT_FUNC "%6.4" "(Umdr./sec)^2" COEFFS 0 140.7374884 0 0 0 1 /end COMPU_METHOD
/begin COMPU_METHOD md_q0p1 "" RAT_FUNC "%6.3" "Nm" COEFFS 0 10 0 0 0 1 /end COMPU_METHOD
/begin COMPU_METHOD md_sw_q0p1 "" RAT_FUNC "%6.3" "Nm" COEFFS 0 10 0 0 0 1 /end COMPU_METHOD
/begin COMPU_METHOD m_q0p02133 "" RAT_FUNC "%6.4" "g" COEFFS 0 375 0 0 0 8 /end COMPU_METHOD
/begin COMPU_METHOD m_q0p1 "" RAT_FUNC "%6.3" "kg/h" COEFFS 0 10 0 0 0 1 /end COMPU_METHOD
/begin COMPU_METHOD m_ub_b25p6 "" RAT_FUNC "%6.3" "kg/h" COEFFS 0 256 0 0 0 25.6 /end COMPU_METHOD
/begin COMPU_METHOD m_uw_b23p3 "" RAT_FUNC "%6.5" "kg" COEFFS 0 2812.5 0 0 0 1 /end COMPU_METHOD
/begin COMPU_METHOD nmot_q1 "" RAT_FUNC "%6.2" "1/min" COEFFS 0 1 0 0 0 1 /end COMPU_METHOD
/begin COMPU_METHOD nmot_sw_q0p25 "" RAT_FUNC "%6.3" "1/min" COEFFS 0 1 0 0 0 0.25 /end COMPU_METHOD
/begin COMPU_METHOD nmot_sw_q0p5 "" RAT_FUNC "%6.3" "1/min" COEFFS 0 2 0 0 0 1 /end COMPU_METHOD
/begin COMPU_METHOD nmot_ub_q10 "" RAT_FUNC "%6.1" "1/min" COEFFS 0 1 0 0 0 10 /end COMPU_METHOD
/begin COMPU_METHOD nmot_ub_q40 "" RAT_FUNC "%6.1" "1/min" COEFFS 0 1 0 0 0 40 /end COMPU_METHOD
/begin COMPU_METHOD nmot_uw_q0p25 "" RAT_FUNC "%6.3" "1/min" COEFFS 0 1 0 0 0 0.25 /end COMPU_METHOD
/begin COMPU_METHOD OneToOne "" RAT_FUNC "%6.2" "-" COEFFS 0 1 0 0 0 1 /end COMPU_METHOD
/begin COMPU_METHOD Prc "" RAT_FUNC "%6.4" "%" COEFFS 0 81.92 0 0 0 1 /end COMPU_METHOD
/begin COMPU_METHOD PrcHigh "" RAT_FUNC "%6.5" "%" COEFFS 0 1000 0 0 0 1 /end COMPU_METHOD
/begin COMPU_METHOD Prc_CrCtl2 "" RAT_FUNC "%6.3" "%" COEFFS 0 10 0 0 0 1 /end COMPU_METHOD
/begin COMPU_METHOD Prc_Fact100 "" RAT_FUNC "%6.4" "%" COEFFS 0 100 0 0 0 1 /end COMPU_METHOD
/begin COMPU_METHOD Prc_Fact256 "" RAT_FUNC "%6.4" "%" COEFFS 0 256 0 0 0 1 /end COMPU_METHOD
/begin COMPU_METHOD Pres "" RAT_FUNC "%6.3" "kPa" COEFFS 0 10 0 0 0 1 /end COMPU_METHOD
/begin COMPU_METHOD Pres_hPa "" RAT_FUNC "%6.2" "hPa" COEFFS 0 1 0 0 0 1 /end COMPU_METHOD
/begin COMPU_METHOD Pres_LoRes_COMPU "" RAT_FUNC "%6.4" "MPa" COEFFS 0 100 0 0 0 1 /end COMPU_METHOD
/begin COMPU_METHOD Pres_mmhg_q2p685 "" RAT_FUNC "%6.2" "mmHg" COEFFS 0 256 0 0 0 687.36 /end COMPU_METHOD
/begin COMPU_METHOD p_q0p0005 "" RAT_FUNC "%6.5" "MPa" COEFFS 0 10000 0 0 0 5 /end COMPU_METHOD
/begin COMPU_METHOD p_q0p078 "" RAT_FUNC "%6.4" "hPa" COEFFS 0 64 0 0 0 5 /end COMPU_METHOD
/begin COMPU_METHOD p_sw_q0p039 "" RAT_FUNC "%6.4" "hPa" COEFFS 0 256 0 0 0 10 /end COMPU_METHOD
/begin COMPU_METHOD p_uw_q0p039 "" RAT_FUNC "%6.4" "hPa" COEFFS 0 256 0 0 0 10 /end COMPU_METHOD
/begin COMPU_METHOD p_uw_q0p078 "" RAT_FUNC "%6.4" "hPa" COEFFS 0 256 0 0 0 20 /end COMPU_METHOD
/begin COMPU_METHOD RBPtCel_dst_0p1_2 "" RAT_FUNC "%6.3" "km" COEFFS 0 10 0 0 0 1 /end COMPU_METHOD
/begin COMPU_METHOD RBPtCel_n_1p0_1 "" RAT_FUNC "%6.2" "rpm" COEFFS 0 1 0 0 0 1 /end COMPU_METHOD
/begin COMPU_METHOD RBPtCel_p_0p002_1 "" RAT_FUNC "%6.4" "MPa" COEFFS 0 1000 0 0 0 2 /end COMPU_METHOD
/begin COMPU_METHOD RBPtCel_ti_1p0_5 "" RAT_FUNC "%6.2" "Yr" COEFFS 0 1 0 0 0 1 /end COMPU_METHOD
/begin COMPU_METHOD RBPtCel_tq_1p0_1 "" RAT_FUNC "%6.2" "Nm" COEFFS 0 1 0 0 0 1 /end COMPU_METHOD
/begin COMPU_METHOD RBPtCel_vcos_5p0em5_1 "" RAT_FUNC "%7.6" "mPaSec" COEFFS 0 20000 0 0 0 1 /end COMPU_METHOD
/begin COMPU_METHOD relDK_uw_b100 "" RAT_FUNC "%6.4" "%DK" COEFFS 0 65535 0 0 0 100 /end COMPU_METHOD
/begin COMPU_METHOD relPED_q0p00153 "" RAT_FUNC "%6.4" "% PED" COEFFS 0 65535 0 0 0 100 /end COMPU_METHOD
/begin COMPU_METHOD rel_q0p000001907 "" RAT_FUNC "%8.7" "%" COEFFS 0 524288 0 0 0 1 /end COMPU_METHOD
/begin COMPU_METHOD rel_q0p00153 "" RAT_FUNC "%6.4" "%" COEFFS 0 65536 0 0 0 100 /end COMPU_METHOD
/begin COMPU_METHOD rel_q0p003052 "" RAT_FUNC "%6.4" "%" COEFFS 0 65536 0 0 0 200 /end COMPU_METHOD
/begin COMPU_METHOD rel_q0p0078125 "" RAT_FUNC "%6.4" "%" COEFFS 0 128 0 0 0 1 /end COMPU_METHOD
/begin COMPU_METHOD rel_q0p0234 "" RAT_FUNC "%6.4" "%" COEFFS 0 128 0 0 0 3 /end COMPU_METHOD
/begin COMPU_METHOD rel_q0p02344 "" RAT_FUNC "%6.4" "%" COEFFS 0 32 0 0 0 0.75 /end COMPU_METHOD
/begin COMPU_METHOD rel_q0p1 "" RAT_FUNC "%6.3" "%" COEFFS 0 10 0 0 0 1 /end COMPU_METHOD
/begin COMPU_METHOD rel_q0p39 "" RAT_FUNC "%6.3" "%" COEFFS 0 256 0 0 0 100 /end COMPU_METHOD
/begin COMPU_METHOD rel_ub_b127p5 "" RAT_FUNC "%6.3" "%" COEFFS 0 2 0 0 0 1 /end COMPU_METHOD
/begin COMPU_METHOD rel_uw_b100 "" RAT_FUNC "%6.4" "%" COEFFS 0 65536 0 0 0 100 /end COMPU_METHOD
/begin COMPU_METHOD rel_uw_q0p0234 "" RAT_FUNC "%6.4" "%" COEFFS 0 32 0 0 0 0.75 /end COMPU_METHOD
/begin COMPU_METHOD r_uw_q2 "" RAT_FUNC "%6.2" "Ohm" COEFFS 0 1 0 0 0 2 /end COMPU_METHOD
/begin COMPU_METHOD spg_q0p00488 "" RAT_FUNC "%6.4" "V" COEFFS 0 1024 0 0 0 5 /end COMPU_METHOD
/begin COMPU_METHOD spg_q1p221Em3_V "" RAT_FUNC "%6.4" "V" COEFFS 0 65536 0 0 0 80 /end COMPU_METHOD
/begin COMPU_METHOD spg_uw_q0p00488 "" RAT_FUNC "%6.4" "V" COEFFS 0 1024 0 0 0 5 /end COMPU_METHOD
/begin COMPU_METHOD spg_uw_q0p004888 "" RAT_FUNC "%6.4" "V" COEFFS 0 1 0 0 0 0.004888 /end COMPU_METHOD
/begin COMPU_METHOD SyC_PostDrv_State "" TAB_VERB "%6.3" "" COMPU_TAB_REF SyC_PostDrv_State /end COMPU_METHOD
/begin COMPU_VTAB SyC_PostDrv_State "" TAB_VERB 9 0 "SYC_POSTDRV_INACTV" 1 "SYC_POSTDRV_DSM_BGN" 2 "SYC_POSTDRV_EEP_BGN" 3 "SYC_POSTDRV_WAIT" 4 "SYC_POSTDRV_NWM" 5 "SYC_POSTDRV_DSM_END" 6 "SYC_POSTDRV_EEP_END" 7 "SYC_POSTDRV_MIN_TIME" 8 "SYC_POSTDRV_DONE" /end COMPU_VTAB
/begin COMPU_METHOD SyC_PreDrv_State "" TAB_VERB "%6.3" "" COMPU_TAB_REF SyC_PreDrv_State /end COMPU_METHOD
/begin COMPU_VTAB SyC_PreDrv_State "" TAB_VERB 10 0 "SYC_PREDRV_INI_DRV" 1 "SYC_PREDRV_DONE" 2 "SYC_PREDRV_INI_SHDWN" 3 "SYC_PREDRV_PROLONG" 4 "SYC_PREDRV_NWM" 5 "SYC_PREDRV_EEP" 6 "SYC_PREDRV_DSM" 7 "SYC_PREDRV_MR" 8 "SYC_PREDRV_MOM" 9 "SYC_PREDRV_EXIT" /end COMPU_VTAB
/begin COMPU_METHOD s_q1_km "" RAT_FUNC "%6.2" "Km" COEFFS 0 1 0 0 0 1 /end COMPU_METHOD
/begin COMPU_METHOD t100msxs_uw_b6553p5 "" RAT_FUNC "%6.3" "s" COEFFS 0 1 0 0 0 0.1 /end COMPU_METHOD
/begin COMPU_METHOD t100msxs_uw_b6553p6 "" RAT_FUNC "%6.3" "s" COEFFS 0 10 0 0 0 1 /end COMPU_METHOD
/begin COMPU_METHOD Temp_Cels "" RAT_FUNC "%6.1" "deg C" COEFFS 0 10 2731.4 0 0 1 /end COMPU_METHOD
/begin COMPU_METHOD temp_q0p0234_o273 "" RAT_FUNC "%6.1" "Grad C" COEFFS 0 1 273.15 0 0 0.0234375 /end COMPU_METHOD
/begin COMPU_METHOD temp_ub_q0p75 "" RAT_FUNC "%6.3" "Grad C" COEFFS 0 1 0 0 0 0.75 /end COMPU_METHOD
/begin COMPU_METHOD temp_ub_q0p75_o48 "" RAT_FUNC "%6.2" "Grad C" COEFFS 0 1 48 0 0 0.75 /end COMPU_METHOD
/begin COMPU_METHOD temp_ub_q1_o60 "" RAT_FUNC "%6.2" "Grad C" COEFFS 0 1 60 0 0 1 /end COMPU_METHOD
/begin COMPU_METHOD Time100_us "" RAT_FUNC "%6.0" "us" COEFFS 0 0.01 0 0 0 1 /end COMPU_METHOD
/begin COMPU_METHOD TimeDeb "" RAT_FUNC "%6.1" "ms" COEFFS 0 0.1 0 0 0 1 /end COMPU_METHOD
/begin COMPU_METHOD TimeEngOn "" RAT_FUNC "%6.2" "s" COEFFS 0 1 0 0 0 1 /end COMPU_METHOD
/begin COMPU_METHOD TimeEngOnOBD "" RAT_FUNC "%6.2" "min" COEFFS 0 1 0 0 0 1 /end COMPU_METHOD
/begin COMPU_METHOD TimeGPTATick "" RAT_FUNC "%6.4" "ns" COEFFS 0 20 0 0 0 1 /end COMPU_METHOD
/begin COMPU_METHOD TimeHrsEngOn "" RAT_FUNC "%6.0" "[100h]" COEFFS 0 0.01 0 0 0 1 /end COMPU_METHOD
/begin COMPU_METHOD TimeRed_OvrNght "" RAT_FUNC "%6.2" "s" COEFFS 0 0.390625 0 0 0 1 /end COMPU_METHOD
/begin COMPU_METHOD Time_1s "" RAT_FUNC "%6.2" "s" COEFFS 0 1 0 0 0 1 /end COMPU_METHOD
/begin COMPU_METHOD Time_Dt_ms "" RAT_FUNC "%6.5" "ms" COEFFS 0 1000 0 0 0 1 /end COMPU_METHOD
/begin COMPU_METHOD Time_ms "" RAT_FUNC "%6.1" "ms" COEFFS 0 0.1 0 0 0 1 /end COMPU_METHOD
/begin COMPU_METHOD Time_msec_q10_COMPU "" RAT_FUNC "%6.1" "ms" COEFFS 0 1 0 0 0 10 /end COMPU_METHOD
/begin COMPU_METHOD Time_msec_q1_COMPU "" RAT_FUNC "%6.2" "ms" COEFFS 0 1 0 0 0 1 /end COMPU_METHOD
/begin COMPU_METHOD Time_ms_q0p01_COMPU "" RAT_FUNC "%6.4" "ms" COEFFS 0 100 0 0 0 1 /end COMPU_METHOD
/begin COMPU_METHOD Time_ms_to_us "" RAT_FUNC "%6.5" "ms" COEFFS 0 1000 0 0 0 1 /end COMPU_METHOD
/begin COMPU_METHOD Time_s "" RAT_FUNC "%6.4" "s" COEFFS 0 100 0 0 0 1 /end COMPU_METHOD
/begin COMPU_METHOD Time_sec_q1_COMPU "" RAT_FUNC "%6.2" "s" COEFFS 0 1 0 0 0 1 /end COMPU_METHOD
/begin COMPU_METHOD Time_s_Ext "" RAT_FUNC "%6.3" "" COEFFS 0 10 0 0 0 1 /end COMPU_METHOD
/begin COMPU_METHOD Time_s_LoRes "" RAT_FUNC "%6.2" "s" COEFFS 0 1 0 0 0 1 /end COMPU_METHOD
/begin COMPU_METHOD Time_usec_q1_COMPU "" RAT_FUNC "%6.2" "us" COEFFS 0 1 0 0 0 1 /end COMPU_METHOD
/begin COMPU_METHOD Time_WLvlPWM "" RAT_FUNC "%6.4" "ms" COEFFS 0 20 0 0 0 1 /end COMPU_METHOD
/begin COMPU_METHOD TINTKVLVDSDYN_SC_Compu "" TAB_VERB "%6.3" "" COMPU_TAB_REF TINTKVLVDSDYN_SC_Compu /end COMPU_METHOD
/begin COMPU_VTAB TINTKVLVDSDYN_SC_Compu "" TAB_VERB 2 0 "False" 1 "True" /end COMPU_VTAB
/begin COMPU_METHOD TINTKVUS_TYPAVL_SY_Compu "" TAB_VERB "%6.3" "" COMPU_TAB_REF TINTKVUS_TYPAVL_SY_Compu /end COMPU_METHOD
/begin COMPU_VTAB TINTKVUS_TYPAVL_SY_Compu "" TAB_VERB 2 0 "False" 1 "True" /end COMPU_VTAB
/begin COMPU_METHOD TIOFF_DIAGENA_SC_Compu "" TAB_VERB "%6.3" "" COMPU_TAB_REF TIOFF_DIAGENA_SC_Compu /end COMPU_METHOD
/begin COMPU_VTAB TIOFF_DIAGENA_SC_Compu "" TAB_VERB 2 0 "False" 1 "True" /end COMPU_VTAB
/begin COMPU_METHOD TIOFF_VDMDLCLKENA_SC_Compu "" TAB_VERB "%6.3" "" COMPU_TAB_REF TIOFF_VDMDLCLKENA_SC_Compu /end COMPU_METHOD
/begin COMPU_VTAB TIOFF_VDMDLCLKENA_SC_Compu "" TAB_VERB 2 0 "False" 1 "True" /end COMPU_VTAB
/begin COMPU_METHOD TransR "" RAT_FUNC "%6.4" "-" COEFFS 0 100 0 0 0 1 /end COMPU_METHOD
/begin COMPU_METHOD Trq "" RAT_FUNC "%6.3" "Nm" COEFFS 0 10 0 0 0 1 /end COMPU_METHOD
/begin COMPU_METHOD TrqCom "" RAT_FUNC "%6.3" "Nm" COEFFS 0 5 0 0 0 1 /end COMPU_METHOD
/begin COMPU_METHOD TrqPrpHigh "" RAT_FUNC "%6.3" "Nm" COEFFS 0 10 0 0 0 1 /end COMPU_METHOD
/begin COMPU_METHOD tv_ub_b100 "" RAT_FUNC "%6.3" "%TV" COEFFS 0 256 0 0 0 100 /end COMPU_METHOD
/begin COMPU_METHOD t_q0p0004_ms "" RAT_FUNC "%6.5" "ms" COEFFS 0 10000 0 0 0 4 /end COMPU_METHOD
/begin COMPU_METHOD t_q0p001 "" RAT_FUNC "%6.5" "s" COEFFS 0 1000 0 0 0 1 /end COMPU_METHOD
/begin COMPU_METHOD t_q0p01 "" RAT_FUNC "%6.4" "s" COEFFS 0 100 0 0 0 1 /end COMPU_METHOD
/begin COMPU_METHOD t_q1 "" RAT_FUNC "%6.2" "s" COEFFS 0 1 0 0 0 1 /end COMPU_METHOD
/begin COMPU_METHOD t_q1p0_us "" RAT_FUNC "%6.2" "us" COEFFS 0 1 0 0 0 1 /end COMPU_METHOD
/begin COMPU_METHOD Vel_CrCtl "" RAT_FUNC "%6.4" "km/h" COEFFS 0 256 0 0 0 1 /end COMPU_METHOD
/begin COMPU_METHOD Vel_CrCtl1_MPH "" RAT_FUNC "%6.2" "MPH" COEFFS 0 1 0 0 0 1 /end COMPU_METHOD
/begin COMPU_METHOD vfzg_ub_q1p25 "" RAT_FUNC "%6.2" "km/h" COEFFS 0 1 0 0 0 1.25 /end COMPU_METHOD
/begin COMPU_METHOD Volt "" RAT_FUNC "%6.3" "mV" COEFFS 0 5 0 0 0 1 /end COMPU_METHOD
/begin COMPU_METHOD volt "" RAT_FUNC "%6.3" "mV" COEFFS 0 5 0 0 0 1 /end COMPU_METHOD
/begin COMPU_METHOD Volt_Batt "" RAT_FUNC "%6.1" "mV" COEFFS 0 0.05 0 0 0 1 /end COMPU_METHOD
/begin COMPU_METHOD Volt_q0p00007629 "" RAT_FUNC "%7.6" "V" COEFFS 0 13107.8778345786 0 0 0 1 /end COMPU_METHOD
/begin COMPU_METHOD zw_q0p1 "" RAT_FUNC "%6.3" "Grad KW" COEFFS 0 10 0 0 0 1 /end COMPU_METHOD
/begin RECORD_LAYOUT RB_Axis_S16 NO_AXIS_PTS_X 1 SWORD AXIS_PTS_X 2 SWORD INDEX_INCR DIRECT /end RECORD_LAYOUT
/begin RECORD_LAYOUT RB_Axis_U16 NO_AXIS_PTS_X 1 UWORD AXIS_PTS_X 2 UWORD INDEX_INCR DIRECT /end RECORD_LAYOUT
/begin RECORD_LAYOUT RB_Curve_S16_S16 NO_AXIS_PTS_X 1 SWORD AXIS_PTS_X 2 SWORD INDEX_INCR DIRECT FNC_VALUES 3 SWORD COLUMN_DIR DIRECT /end RECORD_LAYOUT
/begin RECORD_LAYOUT RB_Curve_U16_U16 NO_AXIS_PTS_X 1 UWORD AXIS_PTS_X 2 UWORD INDEX_INCR DIRECT FNC_VALUES 3 UWORD COLUMN_DIR DIRECT /end RECORD_LAYOUT
/begin RECORD_LAYOUT RB_Map_U16S16_S16 NO_AXIS_PTS_X 1 UWORD NO_AXIS_PTS_Y 2 UWORD AXIS_PTS_X 3 UWORD INDEX_INCR DIRECT AXIS_PTS_Y 4 SWORD INDEX_INCR DIRECT FNC_VALUES 5 SWORD COLUMN_DIR DIRECT /end RECORD_LAYOUT
/begin RECORD_LAYOUT RB_Map_U16U16_S16 NO_AXIS_PTS_X 1 UWORD NO_AXIS_PTS_Y 2 UWORD AXIS_PTS_X 3 UWORD INDEX_INCR DIRECT AXIS_PTS_Y 4 UWORD INDEX_INCR DIRECT FNC_VALUES 5 SWORD COLUMN_DIR DIRECT /end RECORD_LAYOUT
/begin RECORD_LAYOUT RB_ValA_Wu16 FNC_VALUES 1 UWORD COLUMN_DIR DIRECT /end RECORD_LAYOUT
/begin RECORD_LAYOUT RB_Val_Wboolean FNC_VALUES 1 UBYTE COLUMN_DIR DIRECT /end RECORD_LAYOUT
/begin RECORD_LAYOUT RB_Val_Ws16 FNC_VALUES 1 SWORD COLUMN_DIR DIRECT /end RECORD_LAYOUT
/begin RECORD_LAYOUT RB_Val_Ws8 FNC_VALUES 1 SBYTE COLUMN_DIR DIRECT /end RECORD_LAYOUT
/begin RECORD_LAYOUT RB_Val_Wu16 FNC_VALUES 1 UWORD COLUMN_DIR DIRECT /end RECORD_LAYOUT
/begin RECORD_LAYOUT RB_Val_Wu32 FNC_VALUES 1 ULONG COLUMN_DIR DIRECT /end RECORD_LAYOUT
/begin RECORD_LAYOUT RB_Val_Wu8 FNC_VALUES 1 UBYTE COLUMN_DIR DIRECT /end RECORD_LAYOUT
/begin RECORD_LAYOUT Val_Ws16 FNC_VALUES 1 SWORD COLUMN_DIR DIRECT /end RECORD_LAYOUT
/begin RECORD_LAYOUT Val_Ws32 FNC_VALUES 1 SLONG COLUMN_DIR DIRECT /end RECORD_LAYOUT
/begin RECORD_LAYOUT Val_Wu16 FNC_VALUES 1 UWORD COLUMN_DIR DIRECT /end RECORD_LAYOUT
/begin RECORD_LAYOUT Val_Wu8 FNC_VALUES 1 UBYTE COLUMN_DIR DIRECT /end RECORD_LAYOUT
/end MODULE
/end PROJECT
