ASAP2_VERSION 1 60
/begin PROJECT MG1CS022 "MG1CS022"
/begin HEADER "" VERSION "MG1CS022_62XSC_V037_TPROT" PROJECT_NO MG1CS022 /end HEADER
/begin MODULE DIM ""
/begin MOD_COMMON "" BYTE_ORDER MSB_LAST ALIGNMENT_BYTE 1 ALIGNMENT_WORD 2 ALIGNMENT_LONG 4 ALIGNMENT_INT64 4 ALIGNMENT_FLOAT32_IEEE 4 ALIGNMENT_FLOAT64_IEEE 4 DATA_SIZE 32 /end MOD_COMMON
/begin CHARACTERISTIC APRBVACP "Maximum number of times this process can be activated without exiting Phase 2" VALUE 0x8053B2AE RB_Val_Wu8 255.0 dez 0.00 255.0 FORMAT "%5.1" /end CHARACTERISTIC
/begin CHARACTERISTIC CWDEONVTC "service test enabled" VALUE 0x8053B718 RB_Val_Wu8 255.0 dez 0.00 255.0 FORMAT "%5.1" /end CHARACTERISTIC
/begin CHARACTERISTIC CWDTESKTC "code word for DTESK tester communication" VALUE 0x8053B2A4 RB_Val_Wu8 255.0 dez 0.00 255.0 FORMAT "%5.1" /end CHARACTERISTIC
/begin CHARACTERISTIC CWDTESKZA "code word for features of %DTESKZA" VALUE 0x8053B06C RB_Val_Wu8 255.0 dez 0.00 255.0 FORMAT "%5.1" /end CHARACTERISTIC
/begin CHARACTERISTIC CWEONV "code word EONV diagnosis" VALUE 0x8053B6D4 RB_Val_Wu8 255.0 dez 0.00 255.0 FORMAT "%5.1" /end CHARACTERISTIC
/begin CHARACTERISTIC CWEONVIR "configuration code word für DEONVIR" VALUE 0x8053B6C2 RB_Val_Wu8 255.0 dez 0.00 255.0 FORMAT "%5.1" /end CHARACTERISTIC
/begin CHARACTERISTIC DDPTEAR "pressure difference for termination of vacuum built-up" VALUE 0x8053B06E RB_Val_Ws16 79.99878 p_q0p00122 -40.00000 39.99878 FORMAT "%8.5" /end CHARACTERISTIC
/begin CHARACTERISTIC DDPTEDT05 "pressure difference for further vacuum built up (0.5-mm-check)" VALUE 0x8053B070 RB_Val_Ws16 79.99878 p_q0p00122 -40.00000 39.99878 FORMAT "%8.5" /end CHARACTERISTIC
/begin CHARACTERISTIC DDPTEKU "lower threshold for difference pressure while compensation gradient generation" VALUE 0x8053B072 RB_Val_Ws16 79.99878 p_q0p00122 -40.00000 39.99878 FORMAT "%8.5" /end CHARACTERISTIC
/begin CHARACTERISTIC Diff_rTrqDfftl_C "Defaultvalue for the Differential ratio" VALUE 0x8053B73C RB_Val_Ws16 655.3500 TransR -327.6800 327.6700 FORMAT "%8.4" /end CHARACTERISTIC
/begin CHARACTERISTIC DMSNSTLD "Minimum deviation of CPV mass flow for tank leakage diagnosis" VALUE 0x8053B074 RB_Val_Wu16 25.59961 m_uw_b25p6 0.00 25.59961 FORMAT "%8.5" /end CHARACTERISTIC
/begin CHARACTERISTIC DPDELTA "pressure changing for detection of responding tank pressure sensor" VALUE 0x8053B076 RB_Val_Ws16 79.99878 p_q0p00122 -40.00000 39.99878 FORMAT "%8.5" /end CHARACTERISTIC
/begin CHARACTERISTIC DPDTED "pressure difference for check of tank pressure minimum" VALUE 0x8053B078 RB_Val_Ws16 79.99878 p_q0p00122 -40.00000 39.99878 FORMAT "%8.5" /end CHARACTERISTIC
/begin CHARACTERISTIC DPKOND "pressure difference for abort of diagnosis at fuel condensation" VALUE 0x8053B07A RB_Val_Ws16 79.99878 p_q0p00122 -40.00000 39.99878 FORMAT "%8.5" /end CHARACTERISTIC
/begin CHARACTERISTIC DPLINMX "Threshold for Change of Pressure deviation for linearisation check for tank leakage diagnosis" VALUE 0x8053B07C RB_Val_Wu16 79.99878 p_q0p00122 0.00 79.99878 FORMAT "%8.5" /end CHARACTERISTIC
/begin CHARACTERISTIC DPTEDPU "positive pressure threshold for refuelling detection" VALUE 0x8053B722 RB_Val_Ws16 79.99878 p_q0p00122 -40.00000 39.99878 FORMAT "%8.5" /end CHARACTERISTIC
/begin CHARACTERISTIC DPTEDSCH "pressure difference during PCV-shot" VALUE 0x8053B07E RB_Val_Ws16 79.99756 p_q0p00122 -39.99878 39.99878 FORMAT "%8.5" EXTENDED_LIMITS -40.00000 39.99878 /end CHARACTERISTIC
/begin CHARACTERISTIC DPTEDTD "threshold for band pass filtered pressure for detection of opened filler cap" VALUE 0x8053B724 RB_Val_Wu16 79.99878 p_q0p00122 0.00 79.99878 FORMAT "%8.5" /end CHARACTERISTIC
/begin CHARACTERISTIC DPTEDTK "threshold for band pass filtered pressure for refuelling detection" VALUE 0x8053B726 RB_Val_Ws16 79.99878 p_q0p00122 -40.00000 39.99878 FORMAT "%8.5" /end CHARACTERISTIC
/begin CHARACTERISTIC DPTLDDU "threshold for detection that pressure obtain target pressure" VALUE 0x8053B080 RB_Val_Ws16 79.99878 p_q0p00122 -40.00000 39.99878 FORMAT "%8.5" /end CHARACTERISTIC
/begin CHARACTERISTIC DTESKZA_GKTEDKX05_CUR "max. compensation gradient for smallest leak detection" CURVE 0x8053B082 RB_Curve_U16_U16 1.562476 pgrad_q2p38Em5 0.00 1.562476 FORMAT "%8.6"
 /begin AXIS_DESCR STD_AXIS fstt_w_msg vol_q0p1_l 4 0.00 6553.500 FORMAT "%8.3" DEPOSIT ABSOLUTE /end AXIS_DESCR
/end CHARACTERISTIC
/begin CHARACTERISTIC DTESKZA_LimpGKTEDKX05_C "max. compensation gradient for smallest leak detection" VALUE 0x8053B094 RB_Val_Wu16 1.562476 pgrad_q2p38Em5 0.00 1.562476 FORMAT "%8.6" /end CHARACTERISTIC
/begin CHARACTERISTIC EONVDKMN "Min distance at a configurable speed to enable the EONV diag." VALUE 0x8053B6D6 RB_Val_Wu16 91020.83 s_q1p3888_m 0.00 91020.83 FORMAT "%8.2" /end CHARACTERISTIC
/begin CHARACTERISTIC EONVEFC "Coefficient used for 0.020"" EWMA calculation when in the failing state" VALUE 0x8053B6C3 RB_Val_Wu8 1.000000 fak_ub_b2 0.00 1.000000 FORMAT "%8.6" EXTENDED_LIMITS 0.00 1.992188 /end CHARACTERISTIC
/begin CHARACTERISTIC EONVEFS "start value for EWMA filter" VALUE 0x8053B6C4 RB_Val_Wu16 1.999969 fak_uw_b2 0.00 1.999969 FORMAT "%8.6" /end CHARACTERISTIC
/begin CHARACTERISTIC EONVEFT "Threshold value to set out the MIL it is exceeded by EWMA filter result" VALUE 0x8053B6C6 RB_Val_Wu16 1.999969 fak_uw_b2 0.00 1.999969 FORMAT "%8.6" /end CHARACTERISTIC
/begin CHARACTERISTIC EONVENFC "Filter coefficient used for 0.020"" EWMA calc. when currently in passing state" VALUE 0x8053B6C8 RB_Val_Wu8 1.000000 fak_ub_b2 0.00 1.000000 FORMAT "%8.6" EXTENDED_LIMITS 0.00 1.992188 /end CHARACTERISTIC
/begin CHARACTERISTIC EONVENFT "The EWMA threshold value that will be used when the system is passing" VALUE 0x8053B6CA RB_Val_Wu16 1.999969 fak_uw_b2 0.00 1.999969 FORMAT "%8.6" /end CHARACTERISTIC
/begin CHARACTERISTIC EONVETSP "Num EWMA test samples required before diagnostic report a pass" VALUE 0x8053B6CC RB_Val_Wu8 255.0 dez 0.00 255.0 FORMAT "%5.1" /end CHARACTERISTIC
/begin CHARACTERISTIC EONVFST "Default fuel level for EONV when no external system is present" VALUE 0x8053B2B0 RB_Val_Wu16 6553.500 vol_q0p1_l 0.00 6553.500 FORMAT "%8.3" /end CHARACTERISTIC
/begin CHARACTERISTIC EONVSRS "necessary result of overpressure phase after detecting a pressure peak to finish the diagnosis immediately" VALUE 0x8053B2B2 RB_Val_Wu16 0.1499939 fak_uw_b2 0.00 0.1499939 FORMAT "%9.7" EXTENDED_LIMITS 0.00 1.999969 /end CHARACTERISTIC
/begin CHARACTERISTIC EONVSTFT "Threshold value to set the MIL once it is exceeded by EWMA" VALUE 0x8053B6CE RB_Val_Wu16 1.999969 fak_uw_b2 0.00 1.999969 FORMAT "%8.6" /end CHARACTERISTIC
/begin CHARACTERISTIC Eonv_pPeakMaxRejSuspc_M "maximum pressure threshold for suspicion in the overpressure phase for a pressure pattern, for which there is not enough selectivity between a leak and tight system" MAP 0x8053B2B4 RB_Map_U8U16_U16 39.99878 p_q0p00122 0.00 39.99878 FORMAT "%8.5" EXTENDED_LIMITS 0.00 79.99878
 /begin AXIS_DESCR STD_AXIS tumg_msg temp_ub_q0p75_o48 9 -48.0 143.3 FORMAT "%5.1" DEPOSIT ABSOLUTE /end AXIS_DESCR
 /begin AXIS_DESCR STD_AXIS fstteonv_w vol_q0p1_l 15 0.00 6553.500 FORMAT "%8.3" DEPOSIT ABSOLUTE /end AXIS_DESCR
/end CHARACTERISTIC
/begin CHARACTERISTIC Eonv_pPeakMinRejSuspc_M "minimum pressure threshold for suspicion in the overpressure phase for a pressure pattern, for which there is not enough selectivity between a leak and tight system" MAP 0x8053B3EC RB_Map_U8U16_U16 39.99878 p_q0p00122 0.00 39.99878 FORMAT "%8.5" EXTENDED_LIMITS 0.00 79.99878
 /begin AXIS_DESCR STD_AXIS tumg_msg temp_ub_q0p75_o48 9 -48.0 143.3 FORMAT "%5.1" DEPOSIT ABSOLUTE /end AXIS_DESCR
 /begin AXIS_DESCR STD_AXIS fstteonv_w vol_q0p1_l 15 0.00 6553.500 FORMAT "%8.3" DEPOSIT ABSOLUTE /end AXIS_DESCR
/end CHARACTERISTIC
/begin CHARACTERISTIC Eonv_pThdErrWoEWMA_M "final threshold for pressure difference between overpressure and underpressure phase" MAP 0x8053B524 RB_Map_S16U16_U16 39.99878 p_q0p00122 0.00 39.99878 FORMAT "%8.5" EXTENDED_LIMITS 0.00 79.99878
 /begin AXIS_DESCR STD_AXIS EnvT_t Temp_Cels 9 -3549.940 3003.560 FORMAT "%8.3" DEPOSIT ABSOLUTE /end AXIS_DESCR
 /begin AXIS_DESCR STD_AXIS fstteonv_w vol_q0p1_l 9 0.00 6553.500 FORMAT "%8.3" DEPOSIT ABSOLUTE /end AXIS_DESCR
/end CHARACTERISTIC
/begin CHARACTERISTIC Eonv_stAlg_C "Codeword for DEONVALG" VALUE 0x8053B5EE RB_Val_Wu8 255.0 OneToOne 0.00 255.0 FORMAT "%5.1" /end CHARACTERISTIC
/begin CHARACTERISTIC FSTTTLD "fuel level replacement value from tank leak diagnosis" VALUE 0x8053B096 RB_Val_Wu16 6553.500 vol_q0p1_l 0.00 6553.500 FORMAT "%8.3" /end CHARACTERISTIC
/begin CHARACTERISTIC GKTEDKXFA "Max. compensation gradient for smallest leak detection (0.5-mm-check) in EOL testing" VALUE 0x8053B098 RB_Val_Wu16 1.562476 pgrad_q2p38Em5 0.00 1.562476 FORMAT "%8.6" /end CHARACTERISTIC
/begin CHARACTERISTIC GKTEDKXFAG "Max. compensation gradient for smallest leak detection (0.5-mm-check) in garage testing" VALUE 0x8053B09A RB_Val_Wu16 1.562476 pgrad_q2p38Em5 0.00 1.562476 FORMAT "%8.6" /end CHARACTERISTIC
/begin CHARACTERISTIC KFEONVPT "Pressure threshold attainable only by system with leak less than 0.020""" MAP 0x8053B5F0 RB_Map_U8U16_U16 39.84253 p_q0p00122 0.15625 39.99878 FORMAT "%8.5" EXTENDED_LIMITS 0.00 79.99878
 /begin AXIS_DESCR STD_AXIS Eonv_tAmbAir temp_ub_q0p75_o48 9 -48.0 143.3 FORMAT "%5.1" DEPOSIT ABSOLUTE /end AXIS_DESCR
 /begin AXIS_DESCR STD_AXIS fstteonv_w vol_q0p1_l 9 0.00 6553.500 FORMAT "%8.3" DEPOSIT ABSOLUTE /end AXIS_DESCR
/end CHARACTERISTIC
/begin CHARACTERISTIC KLDPENVTDUD "Modelled value of environment temperature" CURVE 0x8053B09C RB_Curve_S16_S16 79.99878 p_q0p00122 -40.00000 39.99878 FORMAT "%8.5"
 /begin AXIS_DESCR STD_AXIS EnvT_t Temp_Cels 6 -3549.940 3003.560 FORMAT "%8.3" DEPOSIT ABSOLUTE /end AXIS_DESCR
/end CHARACTERISTIC
/begin CHARACTERISTIC KLFSTTEWM "fuel level replacement values depends from integrated CPV-mass flow at vacuum built up" CURVE 0x8053B0B6 RB_Curve_U16_U16 6553.500 vol_q0p1_l 0.00 6553.500 FORMAT "%8.3"
 /begin AXIS_DESCR STD_AXIS msnitld_w_msg m_3p47222Em4_g 10 0.00 22.75521 FORMAT "%8.5" DEPOSIT ABSOLUTE /end AXIS_DESCR
/end CHARACTERISTIC
/begin CHARACTERISTIC KLMSSTLD "characteristic linie requested CPV-Mass-Flow over time for tank leakage diagnosis" CURVE 0x8053B0E0 RB_Curve_U8_U16_Static 25.59961 m_uw_b25p6 0.00 25.59961 FORMAT "%8.5"
 /begin AXIS_DESCR STD_AXIS tdtedps t_q0p1 6 0.00 25.50 FORMAT "%5.2" DEPOSIT ABSOLUTE /end AXIS_DESCR
/end CHARACTERISTIC
/begin CHARACTERISTIC KLTCENGDSTGK05 "time for measurement of compensation gradient (0.5-mm-check)" CURVE 0x8053B0F4 RB_Curve_S16_U8_Static 25.50 t_q0p1 0.00 25.50 FORMAT "%5.2"
 /begin AXIS_DESCR STD_AXIS CEngDsT_tStrt Temp_Cels 4 -3549.940 3003.560 FORMAT "%8.3" DEPOSIT ABSOLUTE /end AXIS_DESCR
/end CHARACTERISTIC
/begin CHARACTERISTIC KLTMSTVDDMX05 "maximum duration of vacuum decay (0.5-mm-check)" CURVE 0x8053B102 RB_Curve_S16_U8_Static 25.50 t_q0p1 0.00 25.50 FORMAT "%5.2"
 /begin AXIS_DESCR STD_AXIS CEngDsT_tStrt Temp_Cels 4 -3549.940 3003.560 FORMAT "%8.3" DEPOSIT ABSOLUTE /end AXIS_DESCR
/end CHARACTERISTIC
/begin CHARACTERISTIC MSIDST "Threshold integrated CPV-mass flow for diagnosis for CPV stuck closed" VALUE 0x8053B110 RB_Val_Wu16 22.75521 m_3p47222Em4_g 0.00 22.75521 FORMAT "%8.5" /end CHARACTERISTIC
/begin CHARACTERISTIC MSNTVMX05 "Threshold of integrated Massflow for rough leak detection at tevschuss (0.5-mm-check)" VALUE 0x8053B112 RB_Val_Wu16 22.75521 m_3p47222Em4_g 0.00 22.75521 FORMAT "%8.5" /end CHARACTERISTIC
/begin CHARACTERISTIC MSTLDTC "Threshold mass flow for complete closing of CPV for Tank Leakage Diagnosis" VALUE 0x8053B114 RB_Val_Wu16 25.59961 m_uw_b25p6 0.00 25.59961 FORMAT "%8.5" /end CHARACTERISTIC
/begin CHARACTERISTIC PEONVDFP "decrease/increase in pressure after a peak needed to identify it as a overpressure/vacuum peak" VALUE 0x8053B6B0 RB_Val_Ws16 79.99878 p_q0p00122 -40.00000 39.99878 FORMAT "%8.5" /end CHARACTERISTIC
/begin CHARACTERISTIC PEONVPZERO "boundary at which pressure is considered zero in EONV" VALUE 0x8053B6B2 RB_Val_Ws16 79.99878 p_q0p00122 -40.00000 39.99878 FORMAT "%8.5" /end CHARACTERISTIC
/begin CHARACTERISTIC PPRBMX "Lower boundary at which pressure is considered essentially zero" VALUE 0x8053B6B4 RB_Val_Ws16 79.99878 p_q0p00122 -40.00000 39.99878 FORMAT "%8.5" /end CHARACTERISTIC
/begin CHARACTERISTIC PTEBPTH "threshold for band pass filtered rectified pressure for slosh detection" VALUE 0x8053B728 RB_Val_Wu16 79.99878 p_q0p00122 0.00 79.99878 FORMAT "%8.5" /end CHARACTERISTIC
/begin CHARACTERISTIC PTEDE "pressure difference for stabilized tank pressure" VALUE 0x8053B116 RB_Val_Ws16 79.99878 p_q0p00122 -40.00000 39.99878 FORMAT "%8.5" /end CHARACTERISTIC
/begin CHARACTERISTIC PUEONVMN "min ambient pressure for EONV diagnostic" VALUE 0x8053B6D8 RB_Val_Wu8 1275. p_ub_q5 0.00 1275. FORMAT "%5.0" /end CHARACTERISTIC
/begin CHARACTERISTIC PurgeLeakDiag_mfIntegdCpv_C "Threshold integrated CPV-mass flow for detection of CPV is sticked with some foreign substances after long term usage" VALUE 0x8053B118 RB_Val_Wu16 22.75521 m_3p47222Em4_g 0.00 22.75521 FORMAT "%8.5" /end CHARACTERISTIC
/begin CHARACTERISTIC PurgLeakDiag_facEthMaxEonv_C "Max. ethanol content in fuel for tank leakage diagnosis through EONV" VALUE 0x8053B6DA RB_Val_Wu16 1.999969 fak_uw_b2 0.00 1.999969 FORMAT "%8.6" /end CHARACTERISTIC
/begin CHARACTERISTIC PurgLeakDiag_facIncCpvMf_T "Factor to increase mass flow request of the purge valve during dtesk diagnosis" CURVE 0x8053B11A RB_Curve_U16_U16 25.59961 fak_uw_b25p6 0.00 25.59961 FORMAT "%8.5"
 /begin AXIS_DESCR STD_AXIS msnitld_w_msg m_3p47222Em4_g 6 0.00 22.75521 FORMAT "%8.5" DEPOSIT ABSOLUTE /end AXIS_DESCR
/end CHARACTERISTIC
/begin CHARACTERISTIC PurgLeakDiag_flgDlyEonvEngOff_C "Usage of engine-off time for calculation of afterrun-delay time until start of EONV diagnosis" VALUE 0x8053B6DC RB_Val_Wboolean 1.00000000000 B_TRUE 0.00 1.00000000000 FORMAT "%13.11" /end CHARACTERISTIC
/begin CHARACTERISTIC PurgLeakDiag_mfMinIntegdVacPha_T "minimum integrated massflow during vaccum phase" CURVE 0x8053B134 RB_Curve_U16_U16 22.75521 m_3p47222Em4_g 0.00 22.75521 FORMAT "%8.5"
 /begin AXIS_DESCR STD_AXIS fstttld_w_msg vol_q0p1_l 10 0.00 6553.500 FORMAT "%8.3" DEPOSIT ABSOLUTE /end AXIS_DESCR
/end CHARACTERISTIC
/begin CHARACTERISTIC PurgLeakDiag_ThdTarPEOL_M "Target pressure threshold for EOL" MAP 0x8053B15E RB_Map_U16S16_S16 79.99878 p_q0p00122 -40.00000 39.99878 FORMAT "%8.5"
 /begin AXIS_DESCR STD_AXIS fstt_w_msg vol_q0p1_l 10 0.00 6553.500 FORMAT "%8.3" DEPOSIT ABSOLUTE /end AXIS_DESCR
 /begin AXIS_DESCR STD_AXIS EnvT_t Temp_Cels 6 -3549.940 3003.560 FORMAT "%8.3" DEPOSIT ABSOLUTE /end AXIS_DESCR
/end CHARACTERISTIC
/begin CHARACTERISTIC PurgLeakDiag_ThdTarP_M "Target pressure threshold" MAP 0x8053B1FA RB_Map_U16S16_S16 79.99878 p_q0p00122 -40.00000 39.99878 FORMAT "%8.5"
 /begin AXIS_DESCR STD_AXIS fstt_w_msg vol_q0p1_l 10 0.00 6553.500 FORMAT "%8.3" DEPOSIT ABSOLUTE /end AXIS_DESCR
 /begin AXIS_DESCR STD_AXIS EnvT_t Temp_Cels 6 -3549.940 3003.560 FORMAT "%8.3" DEPOSIT ABSOLUTE /end AXIS_DESCR
/end CHARACTERISTIC
/begin CHARACTERISTIC PurgLeakDiag_tiDlyEonvDiag_T "Afterrun-delay time until tank leakage diagnosis start through EONV" CURVE 0x8053B6DE RB_Curve_S16_U16_Static 6553.500 t_q0p1 0.00 6553.500 FORMAT "%8.3"
 /begin AXIS_DESCR STD_AXIS EnvT_t Temp_Cels 6 -3549.940 3003.560 FORMAT "%8.3" DEPOSIT ABSOLUTE /end AXIS_DESCR
/end CHARACTERISTIC
/begin CHARACTERISTIC PurgLeakDiag_volDiagBlkdLineErrThd_C "Error threshold of the calculated free gas valume of the EVAP system for the blocked line diagnosis, to detect a blocked line error" VALUE 0x8053B296 RB_Val_Wu16 655.3500 vol_q0p01_l 0.00 655.3500 FORMAT "%8.4" /end CHARACTERISTIC
/begin CHARACTERISTIC PVACBMN "Lower boundary at which vacuum is considered to be building" VALUE 0x8053B6B6 RB_Val_Ws16 79.99878 p_q0p00122 -40.00000 39.99878 FORMAT "%8.5" /end CHARACTERISTIC
/begin CHARACTERISTIC SEONVDISMN "required minimum distance for EONV start by tester" VALUE 0x8053B71A RB_Val_Wu16 91020.83 s_q1p3888_m 0.00 91020.83 FORMAT "%8.2" /end CHARACTERISTIC
/begin CHARACTERISTIC SFEONVA "threshold of canister load factor for EONV abortion" VALUE 0x8053B6F8 RB_Val_Ws16 127.9980 fak_sw_b64 -64.00000 63.99805 FORMAT "%8.5" /end CHARACTERISTIC
/begin CHARACTERISTIC SFEONVAR "threshold of canister load factor for reset EONV abortion" VALUE 0x8053B6FA RB_Val_Ws16 127.9980 fak_sw_b64 -64.00000 63.99805 FORMAT "%8.5" /end CHARACTERISTIC
/begin CHARACTERISTIC TBPVACMN "The minimum time to wait between Phase 1 and Phase 2" VALUE 0x8053B714 RB_Val_Wu16 6553.500 t_q0p1 0.00 6553.500 FORMAT "%8.3" /end CHARACTERISTIC
/begin CHARACTERISTIC TCOOLMN "Min. coolant temperarure to be sure that the engine has warmed up" VALUE 0x8053B6FC RB_Val_Wu8 191.3 temp_ub_q0p75_o48 -48.0 143.3 FORMAT "%5.1" /end CHARACTERISTIC
/begin CHARACTERISTIC TDIAGMX "The elapsed time allowed to execute the EONV Diagnostic" VALUE 0x8053B6B8 RB_Val_Wu16 6553.500 t_q0p1 0.00 6553.500 FORMAT "%8.3" /end CHARACTERISTIC
/begin CHARACTERISTIC TDIFEONVMX "max. temperature-difference for EONV diagnosis" VALUE 0x8053B6FD RB_Val_Wu8 191.3 temp_ub_q0p75 0.00 191.3 FORMAT "%5.1" /end CHARACTERISTIC
/begin CHARACTERISTIC TDTED "time out for detection of tight purge system" VALUE 0x8053B298 RB_Val_Wu8 25.50 t_q0p1 0.00 25.50 FORMAT "%5.2" /end CHARACTERISTIC
/begin CHARACTERISTIC TDTLDFSTVE "delay time for information fuel level valid in driving distance debouncing EONV" VALUE 0x8053B6D0 RB_Val_Wu8 25.50 t_q0p1 0.00 25.50 FORMAT "%5.2" /end CHARACTERISTIC
/begin CHARACTERISTIC TDTLIN "time window for linearisation check for tank leakage diagnosis" VALUE 0x8053B299 RB_Val_Wu8 25.50 t_q0p1 0.00 25.50 FORMAT "%5.2" /end CHARACTERISTIC
/begin CHARACTERISTIC TEFABE "Duration diagnosis-systemtest at end of line" VALUE 0x8053B2A6 RB_Val_Wu16 393210.0 t6minxmin_q6 0.00 393210.0 FORMAT "%8.1" /end CHARACTERISTIC
/begin CHARACTERISTIC TEONVAHMN "Lower boundary of the ambient air temperature window by hot start used to enable EONV" VALUE 0x8053B71C RB_Val_Wu8 191.3 temp_ub_q0p75_o48 -48.0 143.3 FORMAT "%5.1" /end CHARACTERISTIC
/begin CHARACTERISTIC TEONVAHMX "Upper boundary of the ambient air temperature window by hot start used to enable EONV" VALUE 0x8053B71D RB_Val_Wu8 191.3 temp_ub_q0p75_o48 -48.0 143.3 FORMAT "%5.1" /end CHARACTERISTIC
/begin CHARACTERISTIC TEONVAMN "Lower boundary of the ambient air temperature window by cold start used to enable EONV" VALUE 0x8053B6FE RB_Val_Wu8 191.3 temp_ub_q0p75_o48 -48.0 143.3 FORMAT "%5.1" /end CHARACTERISTIC
/begin CHARACTERISTIC TEONVAMX "Upper boundary of the ambient air temperature window by cold start used to enable EONV" VALUE 0x8053B6FF RB_Val_Wu8 191.3 temp_ub_q0p75_o48 -48.0 143.3 FORMAT "%5.1" /end CHARACTERISTIC
/begin CHARACTERISTIC TEONVCSMX "DEONV Enable condition hold time." VALUE 0x8053B700 RB_Val_Wu16 262140.0 t_q4_s 0.00 262140.0 FORMAT "%8.1" /end CHARACTERISTIC
/begin CHARACTERISTIC TEONVDFP "time decrease/increase in pressure after a peak needed to identify it as a overpressure/vacuum" VALUE 0x8053B6BA RB_Val_Wu16 6553.500 t_q0p1 0.00 6553.500 FORMAT "%8.3" /end CHARACTERISTIC
/begin CHARACTERISTIC TEONVERTMN "minimum engine run time for EONV start by tester" VALUE 0x8053B71E RB_Val_Wu16 6553.500 t_q0p1 0.00 6553.500 FORMAT "%8.3" /end CHARACTERISTIC
/begin CHARACTERISTIC TEONVST "time used to indicate the pressure has stabilized at zero (EONV-diagn.)" VALUE 0x8053B6BC RB_Val_Wu16 6553.500 t_q0p1 0.00 6553.500 FORMAT "%8.3" /end CHARACTERISTIC
/begin CHARACTERISTIC TEONVVACBP "Time unsed to indicate the Phase 1 vacuum build (EONV-diagnostic)" VALUE 0x8053B6BE RB_Val_Wu8 25.50 t_q0p1 0.00 25.50 FORMAT "%5.2" /end CHARACTERISTIC
/begin CHARACTERISTIC TERMN "Min. Engine run time to start EONV to be sure engine has warmed up" VALUE 0x8053B702 RB_Val_Wu16 6553.500 t_q0p1 0.00 6553.500 FORMAT "%8.3" /end CHARACTERISTIC
/begin CHARACTERISTIC TFATLDMX "max. duration for tank leak diagnosis systemtest at end of line" VALUE 0x8053B2A8 RB_Val_Wu16 6553.500 t_q0p1 0.00 6553.500 FORMAT "%8.3" /end CHARACTERISTIC
/begin CHARACTERISTIC TFATLDMXEOL "max. duration for tank leak diagnosis system test at end of line during EOL test request" VALUE 0x8053B2AA RB_Val_Wu16 6553.500 t_q0p1 0.00 6553.500 FORMAT "%8.3" /end CHARACTERISTIC
/begin CHARACTERISTIC TLDPTFFA "fast filter time constant for low pass filtering of fuel tank pressure" VALUE 0x8053B72A RB_Val_Wu16 655.34999985 zk10msxs_uw_b655p36 0.01000015 655.36000000 FORMAT "%12.8" EXTENDED_LIMITS 0.010000152590 655.36000000 /end CHARACTERISTIC
/begin CHARACTERISTIC TLDPTFHP "filter time constant for high pass filtering of fuel tank pressure" VALUE 0x8053B72C RB_Val_Wu16 6553.4999985 zk100msxs_uw_b6553p6 0.1000015 6553.6000000 FORMAT "%12.7" EXTENDED_LIMITS 0.10000152590 6553.6000000 /end CHARACTERISTIC
/begin CHARACTERISTIC TLDPTFNO "filter time constant for noise reduction of fuel tank pressure signal" VALUE 0x8053B72E RB_Val_Wu16 655.34999985 zk10msxs_uw_b655p36 0.01000015 655.36000000 FORMAT "%12.8" EXTENDED_LIMITS 0.010000152590 655.36000000 /end CHARACTERISTIC
/begin CHARACTERISTIC TLDPTFSH "filter constant for tank pressure high pass filtering for slosh detection" VALUE 0x8053B730 RB_Val_Wu16 6553.4999985 zk100msxs_uw_b6553p6 0.1000015 6553.6000000 FORMAT "%12.7" EXTENDED_LIMITS 0.10000152590 6553.6000000 /end CHARACTERISTIC
/begin CHARACTERISTIC TLDPTFSL "slow filter time constant for low pass filtering of fuel tank pressure" VALUE 0x8053B732 RB_Val_Wu16 655.34999985 zk10msxs_uw_b655p36 0.01000015 655.36000000 FORMAT "%12.8" EXTENDED_LIMITS 0.010000152590 655.36000000 /end CHARACTERISTIC
/begin CHARACTERISTIC TMSEONVMX "max. engine-temperature threshold for EONV diagnosis" VALUE 0x8053B704 RB_Val_Wu8 191.3 temp_ub_q0p75_o48 -48.0 143.3 FORMAT "%5.1" /end CHARACTERISTIC
/begin CHARACTERISTIC TMSEONVTMX "maximum engine temperature for EONV start by tester" VALUE 0x8053B720 RB_Val_Wu8 191.3 temp_ub_q0p75_o48 -48.0 143.3 FORMAT "%5.1" /end CHARACTERISTIC
/begin CHARACTERISTIC TOCVVACP "Open time for canister vent after pressure build in Phase 2" VALUE 0x8053B716 RB_Val_Wu16 6553.500 t_q0p1 0.00 6553.500 FORMAT "%8.3" /end CHARACTERISTIC
/begin CHARACTERISTIC TPMMX "Max. time to execute the pressure monitoring of the EONV Diag." VALUE 0x8053B6C0 RB_Val_Wu16 6553.500 t_q0p1 0.00 6553.500 FORMAT "%8.3" /end CHARACTERISTIC
/begin CHARACTERISTIC TPTEE05 "time for detection of stabilized tank pressure (0.5-mm-check)" VALUE 0x8053B29A RB_Val_Wu8 25.50 t_q0p1 0.00 25.50 FORMAT "%5.2" /end CHARACTERISTIC
/begin CHARACTERISTIC TPTEEBMX "maximum waiting time for detection of stabilized tank pressure" VALUE 0x8053B29B RB_Val_Wu8 25.50 t_q0p1 0.00 25.50 FORMAT "%5.2" /end CHARACTERISTIC
/begin CHARACTERISTIC TSTPTLD "Delay time for decision Tank Leakage Diagnosis can not run" VALUE 0x8053B2AC RB_Val_Wu8 25.50 t_q0p1 0.00 25.50 FORMAT "%5.2" /end CHARACTERISTIC
/begin CHARACTERISTIC TTEDWD05 "waiting time before measurement of vacuum decay gradient (0.5-mm-Prüfung)" VALUE 0x8053B29C RB_Val_Wu8 25.50 t_q0p1 0.00 25.50 FORMAT "%5.2" /end CHARACTERISTIC
/begin CHARACTERISTIC TTEDWU "waiting time if pressure sensor at lower limit" VALUE 0x8053B29D RB_Val_Wu8 25.50 t_q0p1 0.00 25.50 FORMAT "%5.2" /end CHARACTERISTIC
/begin CHARACTERISTIC TTLDFRRS "time for take-back the lambda controller reset from tank leak diagnosis" VALUE 0x8053B29E RB_Val_Wu8 25.50 t_q0p1 0.00 25.50 FORMAT "%5.2" /end CHARACTERISTIC
/begin CHARACTERISTIC TTLDFRRW "Delay time for lambda-controller reset after TEV closing" VALUE 0x8053B29F RB_Val_Wu8 25.50 t_q0p1 0.00 25.50 FORMAT "%5.2" /end CHARACTERISTIC
/begin CHARACTERISTIC TTLDVNL "ECU switch off delay after end of tank leak diagnosis" VALUE 0x8053B705 RB_Val_Wu8 25.50 t_q0p1 0.00 25.50 FORMAT "%5.2" /end CHARACTERISTIC
/begin CHARACTERISTIC TTLDVNLST "ECU switch off delay after end of tank leak diagnosis in case of service bay test" VALUE 0x8053B706 RB_Val_Wu16 6553.500 t_q0p1 0.00 6553.500 FORMAT "%8.3" /end CHARACTERISTIC
/begin CHARACTERISTIC TVAAV05 "delay time before closing of canister vent valve (0.5-mm-check)" VALUE 0x8053B2A0 RB_Val_Wu8 25.50 t_q0p1 0.00 25.50 FORMAT "%5.2" /end CHARACTERISTIC
/begin CHARACTERISTIC TWDTESKF "wating time from finish DTESK until start EONV" VALUE 0x8053B708 RB_Val_Wu8 25.50 t_q0p1 0.00 25.50 FORMAT "%5.2" /end CHARACTERISTIC
/begin CHARACTERISTIC TWEONVHCLR "delay time for reset EONV abortion because of high canister load" VALUE 0x8053B70A RB_Val_Wu16 65535.00 t_q1 0.00 65535.00 FORMAT "%8.2" /end CHARACTERISTIC
/begin CHARACTERISTIC TWTEFBPW "waiting time for switching filter time contants of band filter (word)" VALUE 0x8053B734 RB_Val_Wu8 25.50 t_q0p1 0.00 25.50 FORMAT "%5.2" /end CHARACTERISTIC
/begin CHARACTERISTIC UBEONVMN "Min. system voltage below which EONV Diagnoses is not enabled" VALUE 0x8053B70C RB_Val_Wu8 25.50 spg_q0p1 0.00 25.50 FORMAT "%5.2" /end CHARACTERISTIC
/begin CHARACTERISTIC VehMot_tqWhlDftlProtn_C "Differential protection torque at wheel level" VALUE 0x8053B738 RB_Val_Ws32 429496729.500 Trq -214748364.800 214748364.700 FORMAT "%13.3" /end CHARACTERISTIC
/begin CHARACTERISTIC VHDISTMN "Mileage at which the EONV Diagnostic can begin running" VALUE 0x8053B710 RB_Val_Ws32 4294967295.00 Length -2147483648.00 2147483647.00 FORMAT "%13.2" /end CHARACTERISTIC
/begin CHARACTERISTIC ZKMSNTLD "Time konstant for closing the cpv before tank leakage diagnosis" VALUE 0x8053B2A2 RB_Val_Wu16 6553.4999985 zk100msxs_uw_b6553p6 0.1000015 6553.6000000 FORMAT "%12.7" EXTENDED_LIMITS 0.10000152590 6553.6000000 /end CHARACTERISTIC
/begin MEASUREMENT aktend_msg "finished tank leak diagnosis" UBYTE dez 1 100 0.00 255.0 FORMAT "%5.1" ECU_ADDRESS 0x6000141E /end MEASUREMENT
/begin MEASUREMENT B_abbrtld_msg "Condition: stop of the tank leak diagnosis" UBYTE B_TRUE 1 100 0.00 1.00000000000 BIT_MASK 0x1 FORMAT "%13.11" ECU_ADDRESS 0x60001403 /end MEASUREMENT
/begin MEASUREMENT B_ccveonv_msg "canister close valve is closed for EONV" UBYTE B_TRUE 1 100 0.00 1.00000000000 BIT_MASK 0x1 FORMAT "%13.11" ECU_ADDRESS 0x60000249 /end MEASUREMENT
/begin MEASUREMENT B_dsteonvfcl_msg "fault clear EONV" UBYTE B_TRUE 1 100 0.00 1.00000000000 BIT_MASK 0x1 FORMAT "%13.11" ECU_ADDRESS 0x6003955C /end MEASUREMENT
/begin MEASUREMENT B_dteaav_msg "canister vent valve closed" UBYTE B_TRUE 1 100 0.00 1.00000000000 BIT_MASK 0x1 FORMAT "%13.11" ECU_ADDRESS 0x600013F7 /end MEASUREMENT
/begin MEASUREMENT B_dtefrr_msg "condition of lambda controller reset" UBYTE B_TRUE 1 100 0.00 1.00000000000 BIT_MASK 0x1 FORMAT "%13.11" ECU_ADDRESS 0x600013F6 /end MEASUREMENT
/begin MEASUREMENT B_dtetk_msg "Condition refueling recognized" UBYTE B_TRUE 1 100 0.00 1.00000000000 BIT_MASK 0x1 FORMAT "%13.11" ECU_ADDRESS 0x600013F3 /end MEASUREMENT
/begin MEASUREMENT B_eaav_msg "internal condition: AAV error" UBYTE B_TRUE 1 100 0.00 1.00000000000 BIT_MASK 0x1 FORMAT "%13.11" ECU_ADDRESS 0x600013F2 /end MEASUREMENT
/begin MEASUREMENT B_eeonvld "EONV: 0.02inch leak was detected in previous diagnosis" UBYTE B_TRUE 1 100 0.00 1.00000000000 BIT_MASK 0x1 FORMAT "%13.11" ECU_ADDRESS 0x6003943C /end MEASUREMENT
/begin MEASUREMENT B_eeonv_msg "evap system monitoring - 0.02inch leak" UBYTE B_TRUE 1 100 0.00 1.00000000000 BIT_MASK 0x1 FORMAT "%13.11" ECU_ADDRESS 0x600013EE /end MEASUREMENT
/begin MEASUREMENT B_endeonv_msg "EONV diagnosis is finished" UBYTE B_TRUE 1 100 0.00 1.00000000000 BIT_MASK 0x1 FORMAT "%13.11" ECU_ADDRESS 0x600013EA /end MEASUREMENT
/begin MEASUREMENT B_eonirn_msg "Condition: Small leak has been or could have been detected." UBYTE B_TRUE 1 100 0.00 1.00000000000 BIT_MASK 0x1 FORMAT "%13.11" ECU_ADDRESS 0x600013E8 /end MEASUREMENT
/begin MEASUREMENT B_eonperlk "Condition 0.5mm leak: last test with leak" UBYTE B_TRUE 1 100 0.00 1.00000000000 BIT_MASK 0x1 FORMAT "%13.11" ECU_ADDRESS 0x6003943B /end MEASUREMENT
/begin MEASUREMENT B_eonperno "Condition 0.5mm leak: last test without leak" UBYTE B_TRUE 1 100 0.00 1.00000000000 BIT_MASK 0x1 FORMAT "%13.11" ECU_ADDRESS 0x6003943A /end MEASUREMENT
/begin MEASUREMENT B_eonvab_msg "condition EONV aborted" UBYTE B_TRUE 1 100 0.00 1.00000000000 BIT_MASK 0x1 FORMAT "%13.11" ECU_ADDRESS 0x6000022D /end MEASUREMENT
/begin MEASUREMENT B_eonvmil_msg "MIL on because of EONV" UBYTE B_TRUE 1 100 0.00 1.00000000000 BIT_MASK 0x1 FORMAT "%13.11" ECU_ADDRESS 0x60039559 /end MEASUREMENT
/begin MEASUREMENT B_eonvnerr_msg "condition EONV enabled due to no master errors being set" UBYTE B_TRUE 1 100 0.00 1.00000000000 BIT_MASK 0x1 FORMAT "%13.11" ECU_ADDRESS 0x6000022C /end MEASUREMENT
/begin MEASUREMENT B_eonvrssf_msg "Reset of B_eonvsfen due to too short standing time or detected refueling" UBYTE B_TRUE 1 100 0.00 1.00000000000 BIT_MASK 0x1 FORMAT "%13.11" ECU_ADDRESS 0x600013E7 /end MEASUREMENT
/begin MEASUREMENT B_eonvsrd "indication if service test has been done" UBYTE B_TRUE 1 100 0.00 1.00000000000 BIT_MASK 0x1 FORMAT "%13.11" ECU_ADDRESS 0x600000F3 /end MEASUREMENT
/begin MEASUREMENT B_etesgg_msg "internal condition: rough leak gradient error detected" UBYTE B_TRUE 1 100 0.00 1.00000000000 BIT_MASK 0x1 FORMAT "%13.11" ECU_ADDRESS 0x600013E3 /end MEASUREMENT
/begin MEASUREMENT B_etvtldmn_msg "condition purge control valve min-error detected by tank leak diagnostics" UBYTE B_TRUE 1 100 0.00 1.00000000000 BIT_MASK 0x1 FORMAT "%13.11" ECU_ADDRESS 0x600013E1 /end MEASUREMENT
/begin MEASUREMENT B_etvtldmx_msg "condition purge control valve max-error detected by tank leak diagnostics" UBYTE B_TRUE 1 100 0.00 1.00000000000 BIT_MASK 0x1 FORMAT "%13.11" ECU_ADDRESS 0x600013E0 /end MEASUREMENT
/begin MEASUREMENT B_eveonvac_msg "environment related conditions for tank leak diagnosis fulfilled" UBYTE B_TRUE 1 100 0.00 1.00000000000 BIT_MASK 0x1 FORMAT "%13.11" ECU_ADDRESS 0x6000022A /end MEASUREMENT
/begin MEASUREMENT B_eveonvoc_msg "operation conditions for tank leak diagnosis EONV fulfilled" UBYTE B_TRUE 1 100 0.00 1.00000000000 BIT_MASK 0x1 FORMAT "%13.11" ECU_ADDRESS 0x60000229 /end MEASUREMENT
/begin MEASUREMENT B_fadstof_msg "condition service function request for tank pressure sensor offset diagnosis" UBYTE B_TRUE 1 100 0.00 1.00000000000 BIT_MASK 0x1 FORMAT "%13.11" ECU_ADDRESS 0x6000EEA3 /end MEASUREMENT
/begin MEASUREMENT B_faeonvdt_msg "indication if service test DTESK is requested from EONV" UBYTE B_TRUE 1 100 0.00 1.00000000000 BIT_MASK 0x1 FORMAT "%13.11" ECU_ADDRESS 0x60000227 /end MEASUREMENT
/begin MEASUREMENT B_fatld05_msg "condition service function request for smallest leak diagnosis" UBYTE B_TRUE 1 100 0.00 1.00000000000 BIT_MASK 0x1 FORMAT "%13.11" ECU_ADDRESS 0x600013DD /end MEASUREMENT
/begin MEASUREMENT B_feonv_msg "EONV is finished" UBYTE B_TRUE 1 100 0.00 1.00000000000 BIT_MASK 0x1 FORMAT "%13.11" ECU_ADDRESS 0x60000223 /end MEASUREMENT
/begin MEASUREMENT B_hotst "hot sart" UBYTE B_TRUE 1 100 0.00 1.00000000000 BIT_MASK 0x1 FORMAT "%13.11" ECU_ADDRESS 0x600000F2 /end MEASUREMENT
/begin MEASUREMENT B_iatlddu_msg "internal abortion of tld because of pressure undershooting" UBYTE B_TRUE 1 100 0.00 1.00000000000 BIT_MASK 0x1 FORMAT "%13.11" ECU_ADDRESS 0x600013D1 /end MEASUREMENT
/begin MEASUREMENT B_iatldha_msg "internal abortion of the TLD because of high evaporation" UBYTE B_TRUE 1 100 0.00 1.00000000000 BIT_MASK 0x1 FORMAT "%13.11" ECU_ADDRESS 0x600013D0 /end MEASUREMENT
/begin MEASUREMENT B_iatldko_msg "internal abortion of the TLD because of fuel condensation" UBYTE B_TRUE 1 100 0.00 1.00000000000 BIT_MASK 0x1 FORMAT "%13.11" ECU_ADDRESS 0x600013CF /end MEASUREMENT
/begin MEASUREMENT B_iatldms_msg "internal abortion of tld: Massflow of CPV to small" UBYTE B_TRUE 1 100 0.00 1.00000000000 BIT_MASK 0x1 FORMAT "%13.11" ECU_ADDRESS 0x600013CE /end MEASUREMENT
/begin MEASUREMENT B_iatldpt_msg "internal abortion of tld: pressure does not stabilize" UBYTE B_TRUE 1 100 0.00 1.00000000000 BIT_MASK 0x1 FORMAT "%13.11" ECU_ADDRESS 0x600013CD /end MEASUREMENT
/begin MEASUREMENT B_infoEONVmax "information 0.02inch leak EONV" UBYTE B_TRUE 1 100 0.00 1.00000000000 BIT_MASK 0x1 FORMAT "%13.11" ECU_ADDRESS 0x60000FB1 /end MEASUREMENT
/begin MEASUREMENT B_nldte_msg "request for ECM afterrun from leak detection" UBYTE B_TRUE 1 100 0.00 1.00000000000 BIT_MASK 0x1 FORMAT "%13.11" ECU_ADDRESS 0x600001F2 /end MEASUREMENT
/begin MEASUREMENT B_nvdicscm_msg "cold start checks met for EONV diagnosis" UBYTE B_TRUE 1 100 0.00 1.00000000000 BIT_MASK 0x1 FORMAT "%13.11" ECU_ADDRESS 0x60036E14 /end MEASUREMENT
/begin MEASUREMENT B_occveonv_msg "condition opening canister close valve" UBYTE B_TRUE 1 100 0.00 1.00000000000 BIT_MASK 0x1 FORMAT "%13.11" ECU_ADDRESS 0x600001EE /end MEASUREMENT
/begin MEASUREMENT B_ppheonv_msg "pressure phase EONV is activated" UBYTE B_TRUE 1 100 0.00 1.00000000000 BIT_MASK 0x1 FORMAT "%13.11" ECU_ADDRESS 0x600001E4 /end MEASUREMENT
/begin MEASUREMENT B_pphfeonv_msg "pressure phase EONV is finished" UBYTE B_TRUE 1 100 0.00 1.00000000000 BIT_MASK 0x1 FORMAT "%13.11" ECU_ADDRESS 0x600001E3 /end MEASUREMENT
/begin MEASUREMENT B_ptfslo_msg "tank pressure filtering with slow filter time constant" UBYTE B_TRUE 1 100 0.00 1.00000000000 BIT_MASK 0x1 FORMAT "%13.11" ECU_ADDRESS 0x600013C7 /end MEASUREMENT
/begin MEASUREMENT B_rqeonv "physically allowed tank leak tests after enable conditions (DSM not included)" UBYTE B_TRUE 1 100 0.00 1.00000000000 BIT_MASK 0x1 FORMAT "%13.11" ECU_ADDRESS 0x600000F8 /end MEASUREMENT
/begin MEASUREMENT B_runeonv_msg "running tank leak diagnosis EONV" UBYTE B_TRUE 1 100 0.00 1.00000000000 BIT_MASK 0x1 FORMAT "%13.11" ECU_ADDRESS 0x600001D7 /end MEASUREMENT
/begin MEASUREMENT B_sbteonva_msg "EONV service test access accepted" UBYTE B_TRUE 1 100 0.00 1.00000000000 BIT_MASK 0x1 FORMAT "%13.11" ECU_ADDRESS 0x600001D6 /end MEASUREMENT
/begin MEASUREMENT B_sfatlde "latched tank leak diagnosis function request" UBYTE B_TRUE 1 100 0.00 1.00000000000 BIT_MASK 0x1 FORMAT "%13.11" ECU_ADDRESS 0x60000FC4 /end MEASUREMENT
/begin MEASUREMENT B_sm8te "Condition Mode 8 Request Stored" UBYTE B_TRUE 1 100 0.00 1.00000000000 BIT_MASK 0x1 FORMAT "%13.11" ECU_ADDRESS 0x60000FC3 /end MEASUREMENT
/begin MEASUREMENT B_tldav_msg "condition tank leak diagnosis active" UBYTE B_TRUE 1 100 0.00 1.00000000000 BIT_MASK 0x1 FORMAT "%13.11" ECU_ADDRESS 0x600013B7 /end MEASUREMENT
/begin MEASUREMENT B_tldpsd_msg "fuel slosh detected with fuel tank pressure signal" UBYTE B_TRUE 1 100 0.00 1.00000000000 BIT_MASK 0x1 FORMAT "%13.11" ECU_ADDRESS 0x600013AE /end MEASUREMENT
/begin MEASUREMENT B_tldtehcl "tank leak diagnosis is aborted because of high canister load" UBYTE B_TRUE 1 100 0.00 1.00000000000 BIT_MASK 0x1 FORMAT "%13.11" ECU_ADDRESS 0x600001C2 /end MEASUREMENT
/begin MEASUREMENT B_tldto_msg "condition for start of TEV opening from TLD" UBYTE B_TRUE 1 100 0.00 1.00000000000 BIT_MASK 0x1 FORMAT "%13.11" ECU_ADDRESS 0x600013A8 /end MEASUREMENT
/begin MEASUREMENT B_ubeonva_msg "condition EONV aborted due to battery voltage" UBYTE B_TRUE 1 100 0.00 1.00000000000 BIT_MASK 0x1 FORMAT "%13.11" ECU_ADDRESS 0x600001C0 /end MEASUREMENT
/begin MEASUREMENT B_vpheonv_msg "vacuum phase EONV is activated" UBYTE B_TRUE 1 100 0.00 1.00000000000 BIT_MASK 0x1 FORMAT "%13.11" ECU_ADDRESS 0x600001BE /end MEASUREMENT
/begin MEASUREMENT B_vphseonv_msg "condition start vacuum phase without opening canister close valve" UBYTE B_TRUE 1 100 0.00 1.00000000000 BIT_MASK 0x1 FORMAT "%13.11" ECU_ADDRESS 0x600001BD /end MEASUREMENT
/begin MEASUREMENT B_zaav_msg "internal condition: AAV check complete" UBYTE B_TRUE 1 100 0.00 1.00000000000 BIT_MASK 0x1 FORMAT "%13.11" ECU_ADDRESS 0x600013A4 /end MEASUREMENT
/begin MEASUREMENT B_zeonv_msg "cycle flag of evap system monitoring - 0.02inch leak" UBYTE B_TRUE 1 100 0.00 1.00000000000 BIT_MASK 0x1 FORMAT "%13.11" ECU_ADDRESS 0x600013A1 /end MEASUREMENT
/begin MEASUREMENT B_ztesgg_msg "internal condition rough leak gradient check complete" UBYTE B_TRUE 1 100 0.00 1.00000000000 BIT_MASK 0x1 FORMAT "%13.11" ECU_ADDRESS 0x6000139E /end MEASUREMENT
/begin MEASUREMENT B_ztevtld_msg "purge control valve test performed by tank leak diagnosis in present DCY" UBYTE B_TRUE 1 100 0.00 1.00000000000 BIT_MASK 0x1 FORMAT "%13.11" ECU_ADDRESS 0x6000139C /end MEASUREMENT
/begin MEASUREMENT cccvoeonv "EONV counter canister close valve open during Phase 2" UBYTE dez 1 100 0.00 255.0 FORMAT "%5.1" ECU_ADDRESS 0x60000FC1 /end MEASUREMENT
/begin MEASUREMENT ddpterl_w_msg "threshold differential tank pressure for rough leak check" SWORD p_q0p00122 1 100 -40.00000 39.99878 FORMAT "%8.5" ECU_ADDRESS 0x600014D0 /end MEASUREMENT
/begin MEASUREMENT DEONVDFP_flgRstDsm "DSM Clear request flag for function DEONVDFP" UBYTE B_TRUE 1 100 0.00 1.00000000000 BIT_MASK 0x1 FORMAT "%13.11" ECU_ADDRESS 0x60000FB0 /end MEASUREMENT
/begin MEASUREMENT DEONVEB_flgRstDsm "Flag for DSM clear process" UBYTE B_TRUE 1 100 0.00 1.00000000000 BIT_MASK 0x1 FORMAT "%13.11" ECU_ADDRESS 0x600000F7 /end MEASUREMENT
/begin MEASUREMENT DEONVEB_pEnvP "Ambient pressure" UBYTE p_ub_q5 1 100 0.00 1275. FORMAT "%5.0" ECU_ADDRESS 0x60000FAF /end MEASUREMENT
/begin MEASUREMENT DEONVEB_tCEngDstStop "engine coolant temperature at engine stop or cut-off cranking" UBYTE temp_ub_q0p75_o48 1 100 -48.0 143.3 FORMAT "%5.1" ECU_ADDRESS 0x60000FAE /end MEASUREMENT
/begin MEASUREMENT DEONVEB_tCEngDsTStrtFrst "Engine coolant downstream temperature during the first engine start of the driving cycle." UBYTE temp_ub_q0p75_o48 1 100 -48.0 143.3 FORMAT "%5.1" ECU_ADDRESS 0x60000FAD /end MEASUREMENT
/begin MEASUREMENT DEONVEB_tEnvT "Actual physical value" UBYTE temp_ub_q0p75_o48 1 100 -48.0 143.3 FORMAT "%5.1" ECU_ADDRESS 0x60000FAC /end MEASUREMENT
/begin MEASUREMENT DEONVEB_uBatt "Battery voltage" UBYTE spg_q0p1 1 100 0.00 25.50 FORMAT "%5.2" ECU_ADDRESS 0x60000FAB /end MEASUREMENT
/begin MEASUREMENT DINH_DSQSrv7Vis "Service 0x07 visibility of DSQs" UWORD OneToOne 1 100 0.00 65535.00 FORMAT "%8.2" ARRAY_SIZE 3 ECU_ADDRESS 0x50005968 /end MEASUREMENT
/begin MEASUREMENT DINH_FIdSrv7Vis "Service 0x07 visibility of FIds" UWORD OneToOne 1 100 0.00 65535.00 FORMAT "%8.2" ARRAY_SIZE 61 ECU_ADDRESS 0x5000596E /end MEASUREMENT
/begin MEASUREMENT DINH_nrActvInhReas.FID_AFRA "Number of active inhibit reasons for the FIds / Number of active inhibit reasons for FID_AFRA" UWORD DINH_ct_Compu 1 100 -4095.000 4096.000 BIT_MASK 0x1fff FORMAT "%8.3" ECU_ADDRESS 0x6001358E /end MEASUREMENT
/begin MEASUREMENT DINH_nrActvInhReas.FID_AORA "Number of active inhibit reasons for the FIds / Number of active inhibit reasons for FID_AORA" UWORD DINH_ct_Compu 1 100 -4095.000 4096.000 BIT_MASK 0x1fff FORMAT "%8.3" ECU_ADDRESS 0x60013590 /end MEASUREMENT
/begin MEASUREMENT DINH_nrActvInhReas.FID_ATEH "Number of active inhibit reasons for the FIds / Number of active inhibit reasons for FID_ATEH" UWORD DINH_ct_Compu 1 100 -4095.000 4096.000 BIT_MASK 0x1fff FORMAT "%8.3" ECU_ADDRESS 0x60013592 /end MEASUREMENT
/begin MEASUREMENT DINH_nrActvInhReas.FID_ATEL "Number of active inhibit reasons for the FIds / Number of active inhibit reasons for FID_ATEL" UWORD DINH_ct_Compu 1 100 -4095.000 4096.000 BIT_MASK 0x1fff FORMAT "%8.3" ECU_ADDRESS 0x60013594 /end MEASUREMENT
/begin MEASUREMENT DINH_nrActvInhReas.FID_ATEN "Number of active inhibit reasons for the FIds / Number of active inhibit reasons for FID_ATEN" UWORD DINH_ct_Compu 1 100 -4095.000 4096.000 BIT_MASK 0x1fff FORMAT "%8.3" ECU_ADDRESS 0x60013596 /end MEASUREMENT
/begin MEASUREMENT DINH_nrActvInhReas.FID_ATLDI "Number of active inhibit reasons for the FIds / Number of active inhibit reasons for FID_ATLDI" UWORD DINH_ct_Compu 1 100 -4095.000 4096.000 BIT_MASK 0x1fff FORMAT "%8.3" ECU_ADDRESS 0x60013598 /end MEASUREMENT
/begin MEASUREMENT DINH_nrActvInhReas.FID_ATLDO "Number of active inhibit reasons for the FIds / Number of active inhibit reasons for FID_ATLDO" UWORD DINH_ct_Compu 1 100 -4095.000 4096.000 BIT_MASK 0x1fff FORMAT "%8.3" ECU_ADDRESS 0x6001359A /end MEASUREMENT
/begin MEASUREMENT DINH_nrActvInhReas.FID_BEONV "Number of active inhibit reasons for the FIds / Number of active inhibit reasons for FID_BEONV" UWORD DINH_ct_Compu 1 100 -4095.000 4096.000 BIT_MASK 0x1fff FORMAT "%8.3" ECU_ADDRESS 0x6001359C /end MEASUREMENT
/begin MEASUREMENT DINH_nrActvInhReas.FId_EGSDCmnSeg1B1Parl "Number of active inhibit reasons for the FIds / Number of active inhibit reasons for FId_EGSDCmnSeg1B1Parl" UWORD DINH_ct_Compu 1 100 -4095.000 4096.000 BIT_MASK 0x1fff FORMAT "%8.3" ECU_ADDRESS 0x6001359E /end MEASUREMENT
/begin MEASUREMENT DINH_nrActvInhReas.FID_BAGRA "Number of active inhibit reasons for the FIds / Number of active inhibit reasons for FID_BAGRA" UWORD DINH_ct_Compu 1 100 -4095.000 4096.000 BIT_MASK 0x1fff FORMAT "%8.3" ECU_ADDRESS 0x600135A0 /end MEASUREMENT
/begin MEASUREMENT DINH_nrActvInhReas.FID_BAGRASD "Number of active inhibit reasons for the FIds / Number of active inhibit reasons for FID_BAGRASD" UWORD DINH_ct_Compu 1 100 -4095.000 4096.000 BIT_MASK 0x1fff FORMAT "%8.3" ECU_ADDRESS 0x600135A2 /end MEASUREMENT
/begin MEASUREMENT DINH_nrActvInhReas.FID_BDSTOF "Number of active inhibit reasons for the FIds / Number of active inhibit reasons for FID_BDSTOF" UWORD DINH_ct_Compu 1 100 -4095.000 4096.000 BIT_MASK 0x1fff FORMAT "%8.3" ECU_ADDRESS 0x600135A4 /end MEASUREMENT
/begin MEASUREMENT DINH_nrActvInhReas.FID_BFVDFRM "Number of active inhibit reasons for the FIds / Number of active inhibit reasons for FID_BFVDFRM" UWORD DINH_ct_Compu 1 100 -4095.000 4096.000 BIT_MASK 0x1fff FORMAT "%8.3" ECU_ADDRESS 0x600135A6 /end MEASUREMENT
/begin MEASUREMENT DINH_nrActvInhReas.FID_BHOM "Number of active inhibit reasons for the FIds / Number of active inhibit reasons for FID_BHOM" UWORD DINH_ct_Compu 1 100 -4095.000 4096.000 BIT_MASK 0x1fff FORMAT "%8.3" ECU_ADDRESS 0x600135A8 /end MEASUREMENT
/begin MEASUREMENT DINH_nrActvInhReas.FID_BLLRH "Number of active inhibit reasons for the FIds / Number of active inhibit reasons for FID_BLLRH" UWORD DINH_ct_Compu 1 100 -4095.000 4096.000 BIT_MASK 0x1fff FORMAT "%8.3" ECU_ADDRESS 0x600135AA /end MEASUREMENT
/begin MEASUREMENT DINH_nrActvInhReas.FID_BLLRKH "Number of active inhibit reasons for the FIds / Number of active inhibit reasons for FID_BLLRKH" UWORD DINH_ct_Compu 1 100 -4095.000 4096.000 BIT_MASK 0x1fff FORMAT "%8.3" ECU_ADDRESS 0x600135AC /end MEASUREMENT
/begin MEASUREMENT DINH_nrActvInhReas.FID_BPLSU "Number of active inhibit reasons for the FIds / Number of active inhibit reasons for FID_BPLSU" UWORD DINH_ct_Compu 1 100 -4095.000 4096.000 BIT_MASK 0x1fff FORMAT "%8.3" ECU_ADDRESS 0x600135AE /end MEASUREMENT
/begin MEASUREMENT DINH_nrActvInhReas.FID_FRAMBAVMB "Number of active inhibit reasons for the FIds / Number of active inhibit reasons for FID_FRAMBAVMB" UWORD DINH_ct_Compu 1 100 -4095.000 4096.000 BIT_MASK 0x1fff FORMAT "%8.3" ECU_ADDRESS 0x600135B0 /end MEASUREMENT
/begin MEASUREMENT DINH_nrActvInhReas.FId_CatHeatgColdStrtReq "Number of active inhibit reasons for the FIds / Number of active inhibit reasons for FId_CatHeatgColdStrtReq" UWORD DINH_ct_Compu 1 100 -4095.000 4096.000 BIT_MASK 0x1fff FORMAT "%8.3" ECU_ADDRESS 0x600135B2 /end MEASUREMENT
/begin MEASUREMENT DINH_nrActvInhReas.FId_CatHeatgWrmReq "Number of active inhibit reasons for the FIds / Number of active inhibit reasons for FId_CatHeatgWrmReq" UWORD DINH_ct_Compu 1 100 -4095.000 4096.000 BIT_MASK 0x1fff FORMAT "%8.3" ECU_ADDRESS 0x600135B4 /end MEASUREMENT
/begin MEASUREMENT DINH_nrActvInhReas.FId_DSMBDEPHSpOpMode "Number of active inhibit reasons for the FIds / Number of active inhibit reasons for FId_DSMBDEPHSpOpMode" UWORD DINH_ct_Compu 1 100 -4095.000 4096.000 BIT_MASK 0x1fff FORMAT "%8.3" ECU_ADDRESS 0x600135B6 /end MEASUREMENT
/begin MEASUREMENT DINH_nrActvInhReas.FId_EGRVlvCoord "Number of active inhibit reasons for the FIds / Number of active inhibit reasons for FId_EGRVlvCoord" UWORD DINH_ct_Compu 1 100 -4095.000 4096.000 BIT_MASK 0x1fff FORMAT "%8.3" ECU_ADDRESS 0x600135B8 /end MEASUREMENT
/begin MEASUREMENT DINH_nrActvInhReas.FId_EGSDO2FuTrmB1 "Number of active inhibit reasons for the FIds / Number of active inhibit reasons for FId_EGSDO2FuTrmB1" UWORD DINH_ct_Compu 1 100 -4095.000 4096.000 BIT_MASK 0x1fff FORMAT "%8.3" ECU_ADDRESS 0x600135BA /end MEASUREMENT
/begin MEASUREMENT DINH_nrActvInhReas.FId_EGSDO2SnsrMntdRelsS1B1 "Number of active inhibit reasons for the FIds / Number of active inhibit reasons for FId_EGSDO2SnsrMntdRelsS1B1" UWORD DINH_ct_Compu 1 100 -4095.000 4096.000 BIT_MASK 0x1fff FORMAT "%8.3" ECU_ADDRESS 0x600135BC /end MEASUREMENT
/begin MEASUREMENT DINH_nrActvInhReas.FId_EGSDO2_LamOffsFastS1B1 "Number of active inhibit reasons for the FIds / Number of active inhibit reasons for FId_EGSDO2_LamOffsFastS1B1" UWORD DINH_ct_Compu 1 100 -4095.000 4096.000 BIT_MASK 0x1fff FORMAT "%8.3" ECU_ADDRESS 0x600135BE /end MEASUREMENT
/begin MEASUREMENT DINH_nrActvInhReas.FId_MisfDetDnAdpnNv "Number of active inhibit reasons for the FIds / Number of active inhibit reasons for FId_MisfDetDnAdpnNv" UWORD DINH_ct_Compu 1 100 -4095.000 4096.000 BIT_MASK 0x1fff FORMAT "%8.3" ECU_ADDRESS 0x600135C0 /end MEASUREMENT
/begin MEASUREMENT DINH_nrActvInhReas.FId_bascadpncvo "Number of active inhibit reasons for the FIds / Number of active inhibit reasons for FId_bascadpncvo" UWORD DINH_ct_Compu 1 100 -4095.000 4096.000 BIT_MASK 0x1fff FORMAT "%8.3" ECU_ADDRESS 0x600135C2 /end MEASUREMENT
/begin MEASUREMENT DINH_nrActvInhReas.FID_AGRS "Number of active inhibit reasons for the FIds / Number of active inhibit reasons for FID_AGRS" UWORD DINH_ct_Compu 1 100 -4095.000 4096.000 BIT_MASK 0x1fff FORMAT "%8.3" ECU_ADDRESS 0x600135C4 /end MEASUREMENT
/begin MEASUREMENT DINH_nrActvInhReas.FID_BBAGR "Number of active inhibit reasons for the FIds / Number of active inhibit reasons for FID_BBAGR" UWORD DINH_ct_Compu 1 100 -4095.000 4096.000 BIT_MASK 0x1fff FORMAT "%8.3" ECU_ADDRESS 0x600135C6 /end MEASUREMENT
/begin MEASUREMENT DINH_nrActvInhReas.FID_BBAGRA "Number of active inhibit reasons for the FIds / Number of active inhibit reasons for FID_BBAGRA" UWORD DINH_ct_Compu 1 100 -4095.000 4096.000 BIT_MASK 0x1fff FORMAT "%8.3" ECU_ADDRESS 0x600135C8 /end MEASUREMENT
/begin MEASUREMENT DINH_nrActvInhReas.FID_BGFKMS "Number of active inhibit reasons for the FIds / Number of active inhibit reasons for FID_BGFKMS" UWORD DINH_ct_Compu 1 100 -4095.000 4096.000 BIT_MASK 0x1fff FORMAT "%8.3" ECU_ADDRESS 0x600135CA /end MEASUREMENT
/begin MEASUREMENT DINH_nrActvInhReas.FID_BGMSDKS "Number of active inhibit reasons for the FIds / Number of active inhibit reasons for FID_BGMSDKS" UWORD DINH_ct_Compu 1 100 -4095.000 4096.000 BIT_MASK 0x1fff FORMAT "%8.3" ECU_ADDRESS 0x600135CC /end MEASUREMENT
/begin MEASUREMENT DINH_nrActvInhReas.FID_CAGRSUS "Number of active inhibit reasons for the FIds / Number of active inhibit reasons for FID_CAGRSUS" UWORD DINH_ct_Compu 1 100 -4095.000 4096.000 BIT_MASK 0x1fff FORMAT "%8.3" ECU_ADDRESS 0x600135CE /end MEASUREMENT
/begin MEASUREMENT DINH_nrActvInhReas.FID_CBGTFUELM "Number of active inhibit reasons for the FIds / Number of active inhibit reasons for FID_CBGTFUELM" UWORD DINH_ct_Compu 1 100 -4095.000 4096.000 BIT_MASK 0x1fff FORMAT "%8.3" ECU_ADDRESS 0x600135D0 /end MEASUREMENT
/begin MEASUREMENT DINH_nrActvInhReas.FID_CBGTHDEV "Number of active inhibit reasons for the FIds / Number of active inhibit reasons for FID_CBGTHDEV" UWORD DINH_ct_Compu 1 100 -4095.000 4096.000 BIT_MASK 0x1fff FORMAT "%8.3" ECU_ADDRESS 0x600135D2 /end MEASUREMENT
/begin MEASUREMENT DINH_nrActvInhReas.FID_CDESVF "Number of active inhibit reasons for the FIds / Number of active inhibit reasons for FID_CDESVF" UWORD DINH_ct_Compu 1 100 -4095.000 4096.000 BIT_MASK 0x1fff FORMAT "%8.3" ECU_ADDRESS 0x600135D4 /end MEASUREMENT
/begin MEASUREMENT DINH_nrActvInhReas.FID_CDETHS "Number of active inhibit reasons for the FIds / Number of active inhibit reasons for FID_CDETHS" UWORD DINH_ct_Compu 1 100 -4095.000 4096.000 BIT_MASK 0x1fff FORMAT "%8.3" ECU_ADDRESS 0x600135D6 /end MEASUREMENT
/begin MEASUREMENT DINH_nrActvInhReas.FID_CDRCTSTRT "Number of active inhibit reasons for the FIds / Number of active inhibit reasons for FID_CDRCTSTRT" UWORD DINH_ct_Compu 1 100 -4095.000 4096.000 BIT_MASK 0x1fff FORMAT "%8.3" ECU_ADDRESS 0x600135D8 /end MEASUREMENT
/begin MEASUREMENT DINH_nrActvInhReas.FID_CDSKV "Number of active inhibit reasons for the FIds / Number of active inhibit reasons for FID_CDSKV" UWORD DINH_ct_Compu 1 100 -4095.000 4096.000 BIT_MASK 0x1fff FORMAT "%8.3" ECU_ADDRESS 0x600135DA /end MEASUREMENT
/begin MEASUREMENT DINH_nrActvInhReas.FID_CDSKVRNO "Number of active inhibit reasons for the FIds / Number of active inhibit reasons for FID_CDSKVRNO" UWORD DINH_ct_Compu 1 100 -4095.000 4096.000 BIT_MASK 0x1fff FORMAT "%8.3" ECU_ADDRESS 0x600135DC /end MEASUREMENT
/begin MEASUREMENT DINH_nrActvInhReas.FID_CDSKVRPO "Number of active inhibit reasons for the FIds / Number of active inhibit reasons for FID_CDSKVRPO" UWORD DINH_ct_Compu 1 100 -4095.000 4096.000 BIT_MASK 0x1fff FORMAT "%8.3" ECU_ADDRESS 0x600135DE /end MEASUREMENT
/begin MEASUREMENT DINH_nrActvInhReas.FID_CDSKVRaty "Number of active inhibit reasons for the FIds / Number of active inhibit reasons for FID_CDSKVRaty" UWORD DINH_ct_Compu 1 100 -4095.000 4096.000 BIT_MASK 0x1fff FORMAT "%8.3" ECU_ADDRESS 0x600135E0 /end MEASUREMENT
/begin MEASUREMENT DINH_nrActvInhReas.FID_CDSKVRng "Number of active inhibit reasons for the FIds / Number of active inhibit reasons for FID_CDSKVRng" UWORD DINH_ct_Compu 1 100 -4095.000 4096.000 BIT_MASK 0x1fff FORMAT "%8.3" ECU_ADDRESS 0x600135E2 /end MEASUREMENT
/begin MEASUREMENT DINH_nrActvInhReas.FID_CDSKVS "Number of active inhibit reasons for the FIds / Number of active inhibit reasons for FID_CDSKVS" UWORD DINH_ct_Compu 1 100 -4095.000 4096.000 BIT_MASK 0x1fff FORMAT "%8.3" ECU_ADDRESS 0x600135E4 /end MEASUREMENT
/begin MEASUREMENT DINH_nrActvInhReas.FID_CDSTR "Number of active inhibit reasons for the FIds / Number of active inhibit reasons for FID_CDSTR" UWORD DINH_ct_Compu 1 100 -4095.000 4096.000 BIT_MASK 0x1fff FORMAT "%8.3" ECU_ADDRESS 0x600135E6 /end MEASUREMENT
/begin MEASUREMENT DINH_nrActvInhReas.FID_CDSTTI "Number of active inhibit reasons for the FIds / Number of active inhibit reasons for FID_CDSTTI" UWORD DINH_ct_Compu 1 100 -4095.000 4096.000 BIT_MASK 0x1fff FORMAT "%8.3" ECU_ADDRESS 0x600135E8 /end MEASUREMENT
/begin MEASUREMENT DINH_nrActvInhReas.FID_CETHG "Number of active inhibit reasons for the FIds / Number of active inhibit reasons for FID_CETHG" UWORD DINH_ct_Compu 1 100 -4095.000 4096.000 BIT_MASK 0x1fff FORMAT "%8.3" ECU_ADDRESS 0x600135EA /end MEASUREMENT
/begin MEASUREMENT DINH_nrActvInhReas.FID_CETHSPLnpl "Number of active inhibit reasons for the FIds / Number of active inhibit reasons for FID_CETHSPLnpl" UWORD DINH_ct_Compu 1 100 -4095.000 4096.000 BIT_MASK 0x1fff FORMAT "%8.3" ECU_ADDRESS 0x600135EC /end MEASUREMENT
/begin MEASUREMENT DINH_nrActvInhReas.FID_CETHSTPLnpl "Number of active inhibit reasons for the FIds / Number of active inhibit reasons for FID_CETHSTPLnpl" UWORD DINH_ct_Compu 1 100 -4095.000 4096.000 BIT_MASK 0x1fff FORMAT "%8.3" ECU_ADDRESS 0x600135EE /end MEASUREMENT
/begin MEASUREMENT DINH_nrActvInhReas.FID_CETKHL "Number of active inhibit reasons for the FIds / Number of active inhibit reasons for FID_CETKHL" UWORD DINH_ct_Compu 1 100 -4095.000 4096.000 BIT_MASK 0x1fff FORMAT "%8.3" ECU_ADDRESS 0x600135F0 /end MEASUREMENT
/begin MEASUREMENT DINH_nrActvInhReas.FID_CETKHT "Number of active inhibit reasons for the FIds / Number of active inhibit reasons for FID_CETKHT" UWORD DINH_ct_Compu 1 100 -4095.000 4096.000 BIT_MASK 0x1fff FORMAT "%8.3" ECU_ADDRESS 0x600135F2 /end MEASUREMENT
/begin MEASUREMENT DINH_nrActvInhReas.FID_CGDISTRT "Number of active inhibit reasons for the FIds / Number of active inhibit reasons for FID_CGDISTRT" UWORD DINH_ct_Compu 1 100 -4095.000 4096.000 BIT_MASK 0x1fff FORMAT "%8.3" ECU_ADDRESS 0x600135F4 /end MEASUREMENT
/begin MEASUREMENT DINH_nrActvInhReas.FID_CGLSRDP "Number of active inhibit reasons for the FIds / Number of active inhibit reasons for FID_CGLSRDP" UWORD DINH_ct_Compu 1 100 -4095.000 4096.000 BIT_MASK 0x1fff FORMAT "%8.3" ECU_ADDRESS 0x600135F6 /end MEASUREMENT
/begin MEASUREMENT DINH_nrActvInhReas.FID_CHDR "Number of active inhibit reasons for the FIds / Number of active inhibit reasons for FID_CHDR" UWORD DINH_ct_Compu 1 100 -4095.000 4096.000 BIT_MASK 0x1fff FORMAT "%8.3" ECU_ADDRESS 0x600135F8 /end MEASUREMENT
/begin MEASUREMENT DINH_nrActvInhReas.FID_CHDRKH "Number of active inhibit reasons for the FIds / Number of active inhibit reasons for FID_CHDRKH" UWORD DINH_ct_Compu 1 100 -4095.000 4096.000 BIT_MASK 0x1fff FORMAT "%8.3" ECU_ADDRESS 0x600135FA /end MEASUREMENT
/begin MEASUREMENT DINH_nrActvInhReas.FID_CHDRPL "Number of active inhibit reasons for the FIds / Number of active inhibit reasons for FID_CHDRPL" UWORD DINH_ct_Compu 1 100 -4095.000 4096.000 BIT_MASK 0x1fff FORMAT "%8.3" ECU_ADDRESS 0x600135FC /end MEASUREMENT
/begin MEASUREMENT DINH_nrActvInhReas.FID_CLLKHV "Number of active inhibit reasons for the FIds / Number of active inhibit reasons for FID_CLLKHV" UWORD DINH_ct_Compu 1 100 -4095.000 4096.000 BIT_MASK 0x1fff FORMAT "%8.3" ECU_ADDRESS 0x600135FE /end MEASUREMENT
/begin MEASUREMENT DINH_nrActvInhReas.FID_CLLRHV "Number of active inhibit reasons for the FIds / Number of active inhibit reasons for FID_CLLRHV" UWORD DINH_ct_Compu 1 100 -4095.000 4096.000 BIT_MASK 0x1fff FORMAT "%8.3" ECU_ADDRESS 0x60013600 /end MEASUREMENT
/begin MEASUREMENT DINH_nrActvInhReas.FID_CLZSRDP "Number of active inhibit reasons for the FIds / Number of active inhibit reasons for FID_CLZSRDP" UWORD DINH_ct_Compu 1 100 -4095.000 4096.000 BIT_MASK 0x1fff FORMAT "%8.3" ECU_ADDRESS 0x60013602 /end MEASUREMENT
/begin MEASUREMENT DINH_nrActvInhReas.FID_CLZSRHP "Number of active inhibit reasons for the FIds / Number of active inhibit reasons for FID_CLZSRHP" UWORD DINH_ct_Compu 1 100 -4095.000 4096.000 BIT_MASK 0x1fff FORMAT "%8.3" ECU_ADDRESS 0x60013604 /end MEASUREMENT
/begin MEASUREMENT DINH_nrActvInhReas.FID_CNLHP "Number of active inhibit reasons for the FIds / Number of active inhibit reasons for FID_CNLHP" UWORD DINH_ct_Compu 1 100 -4095.000 4096.000 BIT_MASK 0x1fff FORMAT "%8.3" ECU_ADDRESS 0x60013606 /end MEASUREMENT
/begin MEASUREMENT DINH_nrActvInhReas.FID_CNLHP2 "Number of active inhibit reasons for the FIds / Number of active inhibit reasons for FID_CNLHP2" UWORD DINH_ct_Compu 1 100 -4095.000 4096.000 BIT_MASK 0x1fff FORMAT "%8.3" ECU_ADDRESS 0x60013608 /end MEASUREMENT
/begin MEASUREMENT DINH_nrActvInhReas.FID_CNLKO2 "Number of active inhibit reasons for the FIds / Number of active inhibit reasons for FID_CNLKO2" UWORD DINH_ct_Compu 1 100 -4095.000 4096.000 BIT_MASK 0x1fff FORMAT "%8.3" ECU_ADDRESS 0x6001360A /end MEASUREMENT
/begin MEASUREMENT DINH_nrActvInhReas.FID_CNLKO3 "Number of active inhibit reasons for the FIds / Number of active inhibit reasons for FID_CNLKO3" UWORD DINH_ct_Compu 1 100 -4095.000 4096.000 BIT_MASK 0x1fff FORMAT "%8.3" ECU_ADDRESS 0x6001360C /end MEASUREMENT
/begin MEASUREMENT DINH_nrActvInhReas.FID_CNLLP "Number of active inhibit reasons for the FIds / Number of active inhibit reasons for FID_CNLLP" UWORD DINH_ct_Compu 1 100 -4095.000 4096.000 BIT_MASK 0x1fff FORMAT "%8.3" ECU_ADDRESS 0x6001360E /end MEASUREMENT
/begin MEASUREMENT DINH_nrActvInhReas.FID_CNLPL "Number of active inhibit reasons for the FIds / Number of active inhibit reasons for FID_CNLPL" UWORD DINH_ct_Compu 1 100 -4095.000 4096.000 BIT_MASK 0x1fff FORMAT "%8.3" ECU_ADDRESS 0x60013610 /end MEASUREMENT
/begin MEASUREMENT DINH_nrActvInhReas.FID_CNLPS "Number of active inhibit reasons for the FIds / Number of active inhibit reasons for FID_CNLPS" UWORD DINH_ct_Compu 1 100 -4095.000 4096.000 BIT_MASK 0x1fff FORMAT "%8.3" ECU_ADDRESS 0x60013612 /end MEASUREMENT
/begin MEASUREMENT DINH_nrActvInhReas.FID_CNSAD "Number of active inhibit reasons for the FIds / Number of active inhibit reasons for FID_CNSAD" UWORD DINH_ct_Compu 1 100 -4095.000 4096.000 BIT_MASK 0x1fff FORMAT "%8.3" ECU_ADDRESS 0x60013614 /end MEASUREMENT
/begin MEASUREMENT DINH_nrActvInhReas.FID_CNSAD2 "Number of active inhibit reasons for the FIds / Number of active inhibit reasons for FID_CNSAD2" UWORD DINH_ct_Compu 1 100 -4095.000 4096.000 BIT_MASK 0x1fff FORMAT "%8.3" ECU_ADDRESS 0x60013616 /end MEASUREMENT
/begin MEASUREMENT DINH_nrActvInhReas.FID_CPSRB "Number of active inhibit reasons for the FIds / Number of active inhibit reasons for FID_CPSRB" UWORD DINH_ct_Compu 1 100 -4095.000 4096.000 BIT_MASK 0x1fff FORMAT "%8.3" ECU_ADDRESS 0x60013618 /end MEASUREMENT
/begin MEASUREMENT DINH_nrActvInhReas.FID_CPSRP "Number of active inhibit reasons for the FIds / Number of active inhibit reasons for FID_CPSRP" UWORD DINH_ct_Compu 1 100 -4095.000 4096.000 BIT_MASK 0x1fff FORMAT "%8.3" ECU_ADDRESS 0x6001361A /end MEASUREMENT
/begin MEASUREMENT DINH_nrActvInhReas.FID_CSTHDR "Number of active inhibit reasons for the FIds / Number of active inhibit reasons for FID_CSTHDR" UWORD DINH_ct_Compu 1 100 -4095.000 4096.000 BIT_MASK 0x1fff FORMAT "%8.3" ECU_ADDRESS 0x6001361C /end MEASUREMENT
/begin MEASUREMENT DINH_nrActvInhReas.FID_CSTRTCTL "Number of active inhibit reasons for the FIds / Number of active inhibit reasons for FID_CSTRTCTL" UWORD DINH_ct_Compu 1 100 -4095.000 4096.000 BIT_MASK 0x1fff FORMAT "%8.3" ECU_ADDRESS 0x6001361E /end MEASUREMENT
/begin MEASUREMENT DINH_nrActvInhReas.FID_CTESF "Number of active inhibit reasons for the FIds / Number of active inhibit reasons for FID_CTESF" UWORD DINH_ct_Compu 1 100 -4095.000 4096.000 BIT_MASK 0x1fff FORMAT "%8.3" ECU_ADDRESS 0x60013620 /end MEASUREMENT
/begin MEASUREMENT DINH_nrActvInhReas.FID_CTESG "Number of active inhibit reasons for the FIds / Number of active inhibit reasons for FID_CTESG" UWORD DINH_ct_Compu 1 100 -4095.000 4096.000 BIT_MASK 0x1fff FORMAT "%8.3" ECU_ADDRESS 0x60013622 /end MEASUREMENT
/begin MEASUREMENT DINH_nrActvInhReas.FID_CTHIPSTRT "Number of active inhibit reasons for the FIds / Number of active inhibit reasons for FID_CTHIPSTRT" UWORD DINH_ct_Compu 1 100 -4095.000 4096.000 BIT_MASK 0x1fff FORMAT "%8.3" ECU_ADDRESS 0x60013624 /end MEASUREMENT
/begin MEASUREMENT DINH_nrActvInhReas.FID_CTKACS "Number of active inhibit reasons for the FIds / Number of active inhibit reasons for FID_CTKACS" UWORD DINH_ct_Compu 1 100 -4095.000 4096.000 BIT_MASK 0x1fff FORMAT "%8.3" ECU_ADDRESS 0x60013626 /end MEASUREMENT
/begin MEASUREMENT DINH_nrActvInhReas.FID_CTMSV "Number of active inhibit reasons for the FIds / Number of active inhibit reasons for FID_CTMSV" UWORD DINH_ct_Compu 1 100 -4095.000 4096.000 BIT_MASK 0x1fff FORMAT "%8.3" ECU_ADDRESS 0x60013628 /end MEASUREMENT
/begin MEASUREMENT DINH_nrActvInhReas.FID_CTOSP "Number of active inhibit reasons for the FIds / Number of active inhibit reasons for FID_CTOSP" UWORD DINH_ct_Compu 1 100 -4095.000 4096.000 BIT_MASK 0x1fff FORMAT "%8.3" ECU_ADDRESS 0x6001362A /end MEASUREMENT
/begin MEASUREMENT DINH_nrActvInhReas.FID_DHFERR "Number of active inhibit reasons for the FIds / Number of active inhibit reasons for FID_DHFERR" UWORD DINH_ct_Compu 1 100 -4095.000 4096.000 BIT_MASK 0x1fff FORMAT "%8.3" ECU_ADDRESS 0x6001362C /end MEASUREMENT
/begin MEASUREMENT DINH_nrActvInhReas.FID_DKRSA "Number of active inhibit reasons for the FIds / Number of active inhibit reasons for FID_DKRSA" UWORD DINH_ct_Compu 1 100 -4095.000 4096.000 BIT_MASK 0x1fff FORMAT "%8.3" ECU_ADDRESS 0x6001362E /end MEASUREMENT
/begin MEASUREMENT DINH_nrActvInhReas.FID_DLLRBandEndTst "Number of active inhibit reasons for the FIds / Number of active inhibit reasons for FID_DLLRBandEndTst" UWORD DINH_ct_Compu 1 100 -4095.000 4096.000 BIT_MASK 0x1fff FORMAT "%8.3" ECU_ADDRESS 0x60013630 /end MEASUREMENT
/begin MEASUREMENT DINH_nrActvInhReas.FID_DLLRShrtTrpSpdRmp "Number of active inhibit reasons for the FIds / Number of active inhibit reasons for FID_DLLRShrtTrpSpdRmp" UWORD DINH_ct_Compu 1 100 -4095.000 4096.000 BIT_MASK 0x1fff FORMAT "%8.3" ECU_ADDRESS 0x60013632 /end MEASUREMENT
/begin MEASUREMENT DINH_nrActvInhReas.FID_FEDKAHB "Number of active inhibit reasons for the FIds / Number of active inhibit reasons for FID_FEDKAHB" UWORD DINH_ct_Compu 1 100 -4095.000 4096.000 BIT_MASK 0x1fff FORMAT "%8.3" ECU_ADDRESS 0x60013634 /end MEASUREMENT
/begin MEASUREMENT DINH_nrActvInhReas.FID_FEDKAPB "Number of active inhibit reasons for the FIds / Number of active inhibit reasons for FID_FEDKAPB" UWORD DINH_ct_Compu 1 100 -4095.000 4096.000 BIT_MASK 0x1fff FORMAT "%8.3" ECU_ADDRESS 0x60013636 /end MEASUREMENT
/begin MEASUREMENT DINH_nrActvInhReas.FID_FEDSSB "Number of active inhibit reasons for the FIds / Number of active inhibit reasons for FID_FEDSSB" UWORD DINH_ct_Compu 1 100 -4095.000 4096.000 BIT_MASK 0x1fff FORMAT "%8.3" ECU_ADDRESS 0x60013638 /end MEASUREMENT
/begin MEASUREMENT DINH_nrActvInhReas.FID_FOFSTP "Number of active inhibit reasons for the FIds / Number of active inhibit reasons for FID_FOFSTP" UWORD DINH_ct_Compu 1 100 -4095.000 4096.000 BIT_MASK 0x1fff FORMAT "%8.3" ECU_ADDRESS 0x6001363A /end MEASUREMENT
/begin MEASUREMENT DINH_nrActvInhReas.FID_FONSTP "Number of active inhibit reasons for the FIds / Number of active inhibit reasons for FID_FONSTP" UWORD DINH_ct_Compu 1 100 -4095.000 4096.000 BIT_MASK 0x1fff FORMAT "%8.3" ECU_ADDRESS 0x6001363C /end MEASUREMENT
/begin MEASUREMENT DINH_nrActvInhReas.FID_FUEDK "Number of active inhibit reasons for the FIds / Number of active inhibit reasons for FID_FUEDK" UWORD DINH_ct_Compu 1 100 -4095.000 4096.000 BIT_MASK 0x1fff FORMAT "%8.3" ECU_ADDRESS 0x6001363E /end MEASUREMENT
/begin MEASUREMENT DINH_nrActvInhReas.FID_FVLRA "Number of active inhibit reasons for the FIds / Number of active inhibit reasons for FID_FVLRA" UWORD DINH_ct_Compu 1 100 -4095.000 4096.000 BIT_MASK 0x1fff FORMAT "%8.3" ECU_ADDRESS 0x60013640 /end MEASUREMENT
/begin MEASUREMENT DINH_nrActvInhReas.FID_KRREGact "Number of active inhibit reasons for the FIds / Number of active inhibit reasons for FID_KRREGact" UWORD DINH_ct_Compu 1 100 -4095.000 4096.000 BIT_MASK 0x1fff FORMAT "%8.3" ECU_ADDRESS 0x60013642 /end MEASUREMENT
/begin MEASUREMENT DINH_nrActvInhReas.FID_KRREGloc "Number of active inhibit reasons for the FIds / Number of active inhibit reasons for FID_KRREGloc" UWORD DINH_ct_Compu 1 100 -4095.000 4096.000 BIT_MASK 0x1fff FORMAT "%8.3" ECU_ADDRESS 0x60013644 /end MEASUREMENT
/begin MEASUREMENT DINH_nrActvInhReas.FID_LRADLSU "Number of active inhibit reasons for the FIds / Number of active inhibit reasons for FID_LRADLSU" UWORD DINH_ct_Compu 1 100 -4095.000 4096.000 BIT_MASK 0x1fff FORMAT "%8.3" ECU_ADDRESS 0x60013646 /end MEASUREMENT
/begin MEASUREMENT DINH_nrActvInhReas.FID_LRALSVErr "Number of active inhibit reasons for the FIds / Number of active inhibit reasons for FID_LRALSVErr" UWORD DINH_ct_Compu 1 100 -4095.000 4096.000 BIT_MASK 0x1fff FORMAT "%8.3" ECU_ADDRESS 0x60013648 /end MEASUREMENT
/begin MEASUREMENT DINH_nrActvInhReas.FID_LRAPLLSU "Number of active inhibit reasons for the FIds / Number of active inhibit reasons for FID_LRAPLLSU" UWORD DINH_ct_Compu 1 100 -4095.000 4096.000 BIT_MASK 0x1fff FORMAT "%8.3" ECU_ADDRESS 0x6001364A /end MEASUREMENT
/begin MEASUREMENT DINH_nrActvInhReas.FID_LUSTP "Number of active inhibit reasons for the FIds / Number of active inhibit reasons for FID_LUSTP" UWORD DINH_ct_Compu 1 100 -4095.000 4096.000 BIT_MASK 0x1fff FORMAT "%8.3" ECU_ADDRESS 0x6001364C /end MEASUREMENT
/begin MEASUREMENT DINH_nrActvInhReas.FID_LnKS1 "Number of active inhibit reasons for the FIds / Number of active inhibit reasons for FID_LnKS1" UWORD DINH_ct_Compu 1 100 -4095.000 4096.000 BIT_MASK 0x1fff FORMAT "%8.3" ECU_ADDRESS 0x6001364E /end MEASUREMENT
/begin MEASUREMENT DINH_nrActvInhReas.FID_PLSUV "Number of active inhibit reasons for the FIds / Number of active inhibit reasons for FID_PLSUV" UWORD DINH_ct_Compu 1 100 -4095.000 4096.000 BIT_MASK 0x1fff FORMAT "%8.3" ECU_ADDRESS 0x60013650 /end MEASUREMENT
/begin MEASUREMENT DINH_nrActvInhReas.FID_PSRMOZDG "Number of active inhibit reasons for the FIds / Number of active inhibit reasons for FID_PSRMOZDG" UWORD DINH_ct_Compu 1 100 -4095.000 4096.000 BIT_MASK 0x1fff FORMAT "%8.3" ECU_ADDRESS 0x60013652 /end MEASUREMENT
/begin MEASUREMENT DINH_nrActvInhReas.FID_PSRMOZG "Number of active inhibit reasons for the FIds / Number of active inhibit reasons for FID_PSRMOZG" UWORD DINH_ct_Compu 1 100 -4095.000 4096.000 BIT_MASK 0x1fff FORMAT "%8.3" ECU_ADDRESS 0x60013654 /end MEASUREMENT
/begin MEASUREMENT DINH_nrActvInhReas.FID_STRTDIA "Number of active inhibit reasons for the FIds / Number of active inhibit reasons for FID_STRTDIA" UWORD DINH_ct_Compu 1 100 -4095.000 4096.000 BIT_MASK 0x1fff FORMAT "%8.3" ECU_ADDRESS 0x60013656 /end MEASUREMENT
/begin MEASUREMENT DINH_nrActvInhReas.FID_STRTSTM "Number of active inhibit reasons for the FIds / Number of active inhibit reasons for FID_STRTSTM" UWORD DINH_ct_Compu 1 100 -4095.000 4096.000 BIT_MASK 0x1fff FORMAT "%8.3" ECU_ADDRESS 0x60013658 /end MEASUREMENT
/begin MEASUREMENT DINH_nrActvInhReas.FID_TFA1CSMW "Number of active inhibit reasons for the FIds / Number of active inhibit reasons for FID_TFA1CSMW" UWORD DINH_ct_Compu 1 100 -4095.000 4096.000 BIT_MASK 0x1fff FORMAT "%8.3" ECU_ADDRESS 0x6001365A /end MEASUREMENT
/begin MEASUREMENT DINH_nrActvInhReas.FID_TFA2CSMW "Number of active inhibit reasons for the FIds / Number of active inhibit reasons for FID_TFA2CSMW" UWORD DINH_ct_Compu 1 100 -4095.000 4096.000 BIT_MASK 0x1fff FORMAT "%8.3" ECU_ADDRESS 0x6001365C /end MEASUREMENT
/begin MEASUREMENT DINH_nrActvInhReas.FID_TKACSMW "Number of active inhibit reasons for the FIds / Number of active inhibit reasons for FID_TKACSMW" UWORD DINH_ct_Compu 1 100 -4095.000 4096.000 BIT_MASK 0x1fff FORMAT "%8.3" ECU_ADDRESS 0x6001365E /end MEASUREMENT
/begin MEASUREMENT DINH_nrActvInhReas.FID_TMCSMW "Number of active inhibit reasons for the FIds / Number of active inhibit reasons for FID_TMCSMW" UWORD DINH_ct_Compu 1 100 -4095.000 4096.000 BIT_MASK 0x1fff FORMAT "%8.3" ECU_ADDRESS 0x60013660 /end MEASUREMENT
/begin MEASUREMENT DINH_nrActvInhReas.FID_TOCHOilSwmpTQly "Number of active inhibit reasons for the FIds / Number of active inhibit reasons for FID_TOCHOilSwmpTQly" UWORD DINH_ct_Compu 1 100 -4095.000 4096.000 BIT_MASK 0x1fff FORMAT "%8.3" ECU_ADDRESS 0x60013662 /end MEASUREMENT
/begin MEASUREMENT DINH_nrActvInhReas.FID_TOCHTME "Number of active inhibit reasons for the FIds / Number of active inhibit reasons for FID_TOCHTME" UWORD DINH_ct_Compu 1 100 -4095.000 4096.000 BIT_MASK 0x1fff FORMAT "%8.3" ECU_ADDRESS 0x60013664 /end MEASUREMENT
/begin MEASUREMENT DINH_nrActvInhReas.FID_TOSPCSMW "Number of active inhibit reasons for the FIds / Number of active inhibit reasons for FID_TOSPCSMW" UWORD DINH_ct_Compu 1 100 -4095.000 4096.000 BIT_MASK 0x1fff FORMAT "%8.3" ECU_ADDRESS 0x60013666 /end MEASUREMENT
/begin MEASUREMENT DINH_nrActvInhReas.FID_TSRLX "Number of active inhibit reasons for the FIds / Number of active inhibit reasons for FID_TSRLX" UWORD DINH_ct_Compu 1 100 -4095.000 4096.000 BIT_MASK 0x1fff FORMAT "%8.3" ECU_ADDRESS 0x60013668 /end MEASUREMENT
/begin MEASUREMENT DINH_nrActvInhReas.FID_UEGOHeatrRlyS1B1 "Number of active inhibit reasons for the FIds / Number of active inhibit reasons for FID_UEGOHeatrRlyS1B1" UWORD DINH_ct_Compu 1 100 -4095.000 4096.000 BIT_MASK 0x1fff FORMAT "%8.3" ECU_ADDRESS 0x6001366A /end MEASUREMENT
/begin MEASUREMENT DINH_nrActvInhReas.FID_VehStvSSEOk "Number of active inhibit reasons for the FIds / Number of active inhibit reasons for FID_VehStvSSEOk" UWORD DINH_ct_Compu 1 100 -4095.000 4096.000 BIT_MASK 0x1fff FORMAT "%8.3" ECU_ADDRESS 0x6001366C /end MEASUREMENT
/begin MEASUREMENT DINH_nrActvInhReas.FID_VldtLamPlausMaxS1B1 "Number of active inhibit reasons for the FIds / Number of active inhibit reasons for FID_VldtLamPlausMaxS1B1" UWORD DINH_ct_Compu 1 100 -4095.000 4096.000 BIT_MASK 0x1fff FORMAT "%8.3" ECU_ADDRESS 0x6001366E /end MEASUREMENT
/begin MEASUREMENT DINH_nrActvInhReas.FID_VldtLamPlausMinS1B1 "Number of active inhibit reasons for the FIds / Number of active inhibit reasons for FID_VldtLamPlausMinS1B1" UWORD DINH_ct_Compu 1 100 -4095.000 4096.000 BIT_MASK 0x1fff FORMAT "%8.3" ECU_ADDRESS 0x60013670 /end MEASUREMENT
/begin MEASUREMENT DINH_nrActvInhReas.FId_ACClntPSSPMon "Number of active inhibit reasons for the FIds / Number of active inhibit reasons for FId_ACClntPSSPMon" UWORD DINH_ct_Compu 1 100 -4095.000 4096.000 BIT_MASK 0x1fff FORMAT "%8.3" ECU_ADDRESS 0x60013672 /end MEASUREMENT
/begin MEASUREMENT DINH_nrActvInhReas.FId_ACCompComCANBusOff "Number of active inhibit reasons for the FIds / Number of active inhibit reasons for FId_ACCompComCANBusOff" UWORD DINH_ct_Compu 1 100 -4095.000 4096.000 BIT_MASK 0x1fff FORMAT "%8.3" ECU_ADDRESS 0x60013674 /end MEASUREMENT
/begin MEASUREMENT DINH_nrActvInhReas.FId_ACCompComCANErrMtr "Number of active inhibit reasons for the FIds / Number of active inhibit reasons for FId_ACCompComCANErrMtr" UWORD DINH_ct_Compu 1 100 -4095.000 4096.000 BIT_MASK 0x1fff FORMAT "%8.3" ECU_ADDRESS 0x60013676 /end MEASUREMENT
/begin MEASUREMENT DINH_nrActvInhReas.FId_ACComp_HiUTWSnsrErr "Number of active inhibit reasons for the FIds / Number of active inhibit reasons for FId_ACComp_HiUTWSnsrErr" UWORD DINH_ct_Compu 1 100 -4095.000 4096.000 BIT_MASK 0x1fff FORMAT "%8.3" ECU_ADDRESS 0x60013678 /end MEASUREMENT
/begin MEASUREMENT DINH_nrActvInhReas.FId_ACComp_LoUTWSnsrErr "Number of active inhibit reasons for the FIds / Number of active inhibit reasons for FId_ACComp_LoUTWSnsrErr" UWORD DINH_ct_Compu 1 100 -4095.000 4096.000 BIT_MASK 0x1fff FORMAT "%8.3" ECU_ADDRESS 0x6001367A /end MEASUREMENT
/begin MEASUREMENT DINH_nrActvInhReas.FId_ACComp_PDSnsrErr "Number of active inhibit reasons for the FIds / Number of active inhibit reasons for FId_ACComp_PDSnsrErr" UWORD DINH_ct_Compu 1 100 -4095.000 4096.000 BIT_MASK 0x1fff FORMAT "%8.3" ECU_ADDRESS 0x6001367C /end MEASUREMENT
/begin MEASUREMENT DINH_nrActvInhReas.FId_ACComp_VehSpdSnsrErr "Number of active inhibit reasons for the FIds / Number of active inhibit reasons for FId_ACComp_VehSpdSnsrErr" UWORD DINH_ct_Compu 1 100 -4095.000 4096.000 BIT_MASK 0x1fff FORMAT "%8.3" ECU_ADDRESS 0x6001367E /end MEASUREMENT
/begin MEASUREMENT DINH_nrActvInhReas.FId_ACCtl_ACStrtCut "Number of active inhibit reasons for the FIds / Number of active inhibit reasons for FId_ACCtl_ACStrtCut" UWORD DINH_ct_Compu 1 100 -4095.000 4096.000 BIT_MASK 0x1fff FORMAT "%8.3" ECU_ADDRESS 0x60013680 /end MEASUREMENT
/begin MEASUREMENT DINH_nrActvInhReas.FId_ACCtl_APP1 "Number of active inhibit reasons for the FIds / Number of active inhibit reasons for FId_ACCtl_APP1" UWORD DINH_ct_Compu 1 100 -4095.000 4096.000 BIT_MASK 0x1fff FORMAT "%8.3" ECU_ADDRESS 0x60013682 /end MEASUREMENT
/begin MEASUREMENT DINH_nrActvInhReas.FId_ACCtl_APP2 "Number of active inhibit reasons for the FIds / Number of active inhibit reasons for FId_ACCtl_APP2" UWORD DINH_ct_Compu 1 100 -4095.000 4096.000 BIT_MASK 0x1fff FORMAT "%8.3" ECU_ADDRESS 0x60013684 /end MEASUREMENT
/begin MEASUREMENT DINH_nrActvInhReas.FId_ACCtl_APPSync "Number of active inhibit reasons for the FIds / Number of active inhibit reasons for FId_ACCtl_APPSync" UWORD DINH_ct_Compu 1 100 -4095.000 4096.000 BIT_MASK 0x1fff FORMAT "%8.3" ECU_ADDRESS 0x60013686 /end MEASUREMENT
/begin MEASUREMENT DINH_nrActvInhReas.FId_ACCtl_AcOff "Number of active inhibit reasons for the FIds / Number of active inhibit reasons for FId_ACCtl_AcOff" UWORD DINH_ct_Compu 1 100 -4095.000 4096.000 BIT_MASK 0x1fff FORMAT "%8.3" ECU_ADDRESS 0x60013688 /end MEASUREMENT
/begin MEASUREMENT DINH_nrActvInhReas.FId_ACCtl_Clmb "Number of active inhibit reasons for the FIds / Number of active inhibit reasons for FId_ACCtl_Clmb" UWORD DINH_ct_Compu 1 100 -4095.000 4096.000 BIT_MASK 0x1fff FORMAT "%8.3" ECU_ADDRESS 0x6001368A /end MEASUREMENT
/begin MEASUREMENT DINH_nrActvInhReas.FId_ACCtl_DK1 "Number of active inhibit reasons for the FIds / Number of active inhibit reasons for FId_ACCtl_DK1" UWORD DINH_ct_Compu 1 100 -4095.000 4096.000 BIT_MASK 0x1fff FORMAT "%8.3" ECU_ADDRESS 0x6001368C /end MEASUREMENT
/begin MEASUREMENT DINH_nrActvInhReas.FId_ACCtl_DK2 "Number of active inhibit reasons for the FIds / Number of active inhibit reasons for FId_ACCtl_DK2" UWORD DINH_ct_Compu 1 100 -4095.000 4096.000 BIT_MASK 0x1fff FORMAT "%8.3" ECU_ADDRESS 0x6001368E /end MEASUREMENT
/begin MEASUREMENT DINH_nrActvInhReas.FId_ACCtl_DKSync "Number of active inhibit reasons for the FIds / Number of active inhibit reasons for FId_ACCtl_DKSync" UWORD DINH_ct_Compu 1 100 -4095.000 4096.000 BIT_MASK 0x1fff FORMAT "%8.3" ECU_ADDRESS 0x60013690 /end MEASUREMENT
/begin MEASUREMENT DINH_nrActvInhReas.FId_ACCtl_VehSpdSnsrErr "Number of active inhibit reasons for the FIds / Number of active inhibit reasons for FId_ACCtl_VehSpdSnsrErr" UWORD DINH_ct_Compu 1 100 -4095.000 4096.000 BIT_MASK 0x1fff FORMAT "%8.3" ECU_ADDRESS 0x60013692 /end MEASUREMENT
/begin MEASUREMENT DINH_nrActvInhReas.FId_ACCtl_pAC "Number of active inhibit reasons for the FIds / Number of active inhibit reasons for FId_ACCtl_pAC" UWORD DINH_ct_Compu 1 100 -4095.000 4096.000 BIT_MASK 0x1fff FORMAT "%8.3" ECU_ADDRESS 0x60013694 /end MEASUREMENT
/begin MEASUREMENT DINH_nrActvInhReas.FId_ACEvpTCANErr "Number of active inhibit reasons for the FIds / Number of active inhibit reasons for FId_ACEvpTCANErr" UWORD DINH_ct_Compu 1 100 -4095.000 4096.000 BIT_MASK 0x1fff FORMAT "%8.3" ECU_ADDRESS 0x60013696 /end MEASUREMENT
/begin MEASUREMENT DINH_nrActvInhReas.FId_ACEvpTFrzVal "Number of active inhibit reasons for the FIds / Number of active inhibit reasons for FId_ACEvpTFrzVal" UWORD DINH_ct_Compu 1 100 -4095.000 4096.000 BIT_MASK 0x1fff FORMAT "%8.3" ECU_ADDRESS 0x60013698 /end MEASUREMENT
/begin MEASUREMENT DINH_nrActvInhReas.FId_ACEvpTPhysRng "Number of active inhibit reasons for the FIds / Number of active inhibit reasons for FId_ACEvpTPhysRng" UWORD DINH_ct_Compu 1 100 -4095.000 4096.000 BIT_MASK 0x1fff FORMAT "%8.3" ECU_ADDRESS 0x6001369A /end MEASUREMENT
/begin MEASUREMENT DINH_nrActvInhReas.FId_ACEvpTRplVal "Number of active inhibit reasons for the FIds / Number of active inhibit reasons for FId_ACEvpTRplVal" UWORD DINH_ct_Compu 1 100 -4095.000 4096.000 BIT_MASK 0x1fff FORMAT "%8.3" ECU_ADDRESS 0x6001369C /end MEASUREMENT
/begin MEASUREMENT DINH_nrActvInhReas.FId_AFCLFailr "Number of active inhibit reasons for the FIds / Number of active inhibit reasons for FId_AFCLFailr" UWORD DINH_ct_Compu 1 100 -4095.000 4096.000 BIT_MASK 0x1fff FORMAT "%8.3" ECU_ADDRESS 0x6001369E /end MEASUREMENT
/begin MEASUREMENT DINH_nrActvInhReas.FId_AFS "Number of active inhibit reasons for the FIds / Number of active inhibit reasons for FId_AFS" UWORD DINH_ct_Compu 1 100 -4095.000 4096.000 BIT_MASK 0x1fff FORMAT "%8.3" ECU_ADDRESS 0x600136A0 /end MEASUREMENT
/begin MEASUREMENT DINH_nrActvInhReas.FId_AFSPhyRng "Number of active inhibit reasons for the FIds / Number of active inhibit reasons for FId_AFSPhyRng" UWORD DINH_ct_Compu 1 100 -4095.000 4096.000 BIT_MASK 0x1fff FORMAT "%8.3" ECU_ADDRESS 0x600136A2 /end MEASUREMENT
/begin MEASUREMENT DINH_nrActvInhReas.FId_APP1SigPath "Number of active inhibit reasons for the FIds / Number of active inhibit reasons for FId_APP1SigPath" UWORD DINH_ct_Compu 1 100 -4095.000 4096.000 BIT_MASK 0x1fff FORMAT "%8.3" ECU_ADDRESS 0x600136A4 /end MEASUREMENT
/begin MEASUREMENT DINH_nrActvInhReas.FId_APP2SigPath "Number of active inhibit reasons for the FIds / Number of active inhibit reasons for FId_APP2SigPath" UWORD DINH_ct_Compu 1 100 -4095.000 4096.000 BIT_MASK 0x1fff FORMAT "%8.3" ECU_ADDRESS 0x600136A6 /end MEASUREMENT
/begin MEASUREMENT DINH_nrActvInhReas.FId_APPBrkErr "Number of active inhibit reasons for the FIds / Number of active inhibit reasons for FId_APPBrkErr" UWORD DINH_ct_Compu 1 100 -4095.000 4096.000 BIT_MASK 0x1fff FORMAT "%8.3" ECU_ADDRESS 0x600136A8 /end MEASUREMENT
/begin MEASUREMENT DINH_nrActvInhReas.FId_APPLETVldnErr "Number of active inhibit reasons for the FIds / Number of active inhibit reasons for FId_APPLETVldnErr" UWORD DINH_ct_Compu 1 100 -4095.000 4096.000 BIT_MASK 0x1fff FORMAT "%8.3" ECU_ADDRESS 0x600136AA /end MEASUREMENT
/begin MEASUREMENT DINH_nrActvInhReas.FId_APPLrn "Number of active inhibit reasons for the FIds / Number of active inhibit reasons for FId_APPLrn" UWORD DINH_ct_Compu 1 100 -4095.000 4096.000 BIT_MASK 0x1fff FORMAT "%8.3" ECU_ADDRESS 0x600136AC /end MEASUREMENT
/begin MEASUREMENT DINH_nrActvInhReas.FId_APPVehVErr "Number of active inhibit reasons for the FIds / Number of active inhibit reasons for FId_APPVehVErr" UWORD DINH_ct_Compu 1 100 -4095.000 4096.000 BIT_MASK 0x1fff FORMAT "%8.3" ECU_ADDRESS 0x600136AE /end MEASUREMENT
/begin MEASUREMENT DINH_nrActvInhReas.FId_AccPedDrvModComErr "Number of active inhibit reasons for the FIds / Number of active inhibit reasons for FId_AccPedDrvModComErr" UWORD DINH_ct_Compu 1 100 -4095.000 4096.000 BIT_MASK 0x1fff FORMAT "%8.3" ECU_ADDRESS 0x600136B0 /end MEASUREMENT
/begin MEASUREMENT DINH_nrActvInhReas.FId_AccPedDrvModFailr "Number of active inhibit reasons for the FIds / Number of active inhibit reasons for FId_AccPedDrvModFailr" UWORD DINH_ct_Compu 1 100 -4095.000 4096.000 BIT_MASK 0x1fff FORMAT "%8.3" ECU_ADDRESS 0x600136B2 /end MEASUREMENT
/begin MEASUREMENT DINH_nrActvInhReas.FId_AccPedNMaxLim "Number of active inhibit reasons for the FIds / Number of active inhibit reasons for FId_AccPedNMaxLim" UWORD DINH_ct_Compu 1 100 -4095.000 4096.000 BIT_MASK 0x1fff FORMAT "%8.3" ECU_ADDRESS 0x600136B4 /end MEASUREMENT
/begin MEASUREMENT DINH_nrActvInhReas.FId_AccPedNMinLim "Number of active inhibit reasons for the FIds / Number of active inhibit reasons for FId_AccPedNMinLim" UWORD DINH_ct_Compu 1 100 -4095.000 4096.000 BIT_MASK 0x1fff FORMAT "%8.3" ECU_ADDRESS 0x600136B6 /end MEASUREMENT
/begin MEASUREMENT DINH_nrActvInhReas.FId_AccPedNMinLimBrkApp "Number of active inhibit reasons for the FIds / Number of active inhibit reasons for FId_AccPedNMinLimBrkApp" UWORD DINH_ct_Compu 1 100 -4095.000 4096.000 BIT_MASK 0x1fff FORMAT "%8.3" ECU_ADDRESS 0x600136B8 /end MEASUREMENT
/begin MEASUREMENT DINH_nrActvInhReas.FId_AccPedTrqLim "Number of active inhibit reasons for the FIds / Number of active inhibit reasons for FId_AccPedTrqLim" UWORD DINH_ct_Compu 1 100 -4095.000 4096.000 BIT_MASK 0x1fff FORMAT "%8.3" ECU_ADDRESS 0x600136BA /end MEASUREMENT
/begin MEASUREMENT DINH_nrActvInhReas.FId_AfsDdDiag "Number of active inhibit reasons for the FIds / Number of active inhibit reasons for FId_AfsDdDiag" UWORD DINH_ct_Compu 1 100 -4095.000 4096.000 BIT_MASK 0x1fff FORMAT "%8.3" ECU_ADDRESS 0x600136BC /end MEASUREMENT
/begin MEASUREMENT DINH_nrActvInhReas.FId_AfsDiagErr "Number of active inhibit reasons for the FIds / Number of active inhibit reasons for FId_AfsDiagErr" UWORD DINH_ct_Compu 1 100 -4095.000 4096.000 BIT_MASK 0x1fff FORMAT "%8.3" ECU_ADDRESS 0x600136BE /end MEASUREMENT
/begin MEASUREMENT DINH_nrActvInhReas.FId_AfsDiagTst "Number of active inhibit reasons for the FIds / Number of active inhibit reasons for FId_AfsDiagTst" UWORD DINH_ct_Compu 1 100 -4095.000 4096.000 BIT_MASK 0x1fff FORMAT "%8.3" ECU_ADDRESS 0x600136C0 /end MEASUREMENT
/begin MEASUREMENT DINH_nrActvInhReas.FId_AfsPlausDiag "Number of active inhibit reasons for the FIds / Number of active inhibit reasons for FId_AfsPlausDiag" UWORD DINH_ct_Compu 1 100 -4095.000 4096.000 BIT_MASK 0x1fff FORMAT "%8.3" ECU_ADDRESS 0x600136C2 /end MEASUREMENT
/begin MEASUREMENT DINH_nrActvInhReas.FId_AfsVrntDiag "Number of active inhibit reasons for the FIds / Number of active inhibit reasons for FId_AfsVrntDiag" UWORD DINH_ct_Compu 1 100 -4095.000 4096.000 BIT_MASK 0x1fff FORMAT "%8.3" ECU_ADDRESS 0x600136C4 /end MEASUREMENT
/begin MEASUREMENT DINH_nrActvInhReas.FId_AirCClntPFrzVal "Number of active inhibit reasons for the FIds / Number of active inhibit reasons for FId_AirCClntPFrzVal" UWORD DINH_ct_Compu 1 100 -4095.000 4096.000 BIT_MASK 0x1fff FORMAT "%8.3" ECU_ADDRESS 0x600136C6 /end MEASUREMENT
/begin MEASUREMENT DINH_nrActvInhReas.FId_AirCClntPRplVal "Number of active inhibit reasons for the FIds / Number of active inhibit reasons for FId_AirCClntPRplVal" UWORD DINH_ct_Compu 1 100 -4095.000 4096.000 BIT_MASK 0x1fff FORMAT "%8.3" ECU_ADDRESS 0x600136C8 /end MEASUREMENT
/begin MEASUREMENT DINH_nrActvInhReas.FId_AirCSwt "Number of active inhibit reasons for the FIds / Number of active inhibit reasons for FId_AirCSwt" UWORD DINH_ct_Compu 1 100 -4095.000 4096.000 BIT_MASK 0x1fff FORMAT "%8.3" ECU_ADDRESS 0x600136CA /end MEASUREMENT
/begin MEASUREMENT DINH_nrActvInhReas.FId_AirDvPAdpnPEnv "Number of active inhibit reasons for the FIds / Number of active inhibit reasons for FId_AirDvPAdpnPEnv" UWORD DINH_ct_Compu 1 100 -4095.000 4096.000 BIT_MASK 0x1fff FORMAT "%8.3" ECU_ADDRESS 0x600136CC /end MEASUREMENT
/begin MEASUREMENT DINH_nrActvInhReas.FId_AirDvPAdpnPIntkVUsB1 "Number of active inhibit reasons for the FIds / Number of active inhibit reasons for FId_AirDvPAdpnPIntkVUsB1" UWORD DINH_ct_Compu 1 100 -4095.000 4096.000 BIT_MASK 0x1fff FORMAT "%8.3" ECU_ADDRESS 0x600136CE /end MEASUREMENT
/begin MEASUREMENT DINH_nrActvInhReas.FId_AirDvPPSnsrAdpn_PModeActv "Number of active inhibit reasons for the FIds / Number of active inhibit reasons for FId_AirDvPPSnsrAdpn_PModeActv" UWORD DINH_ct_Compu 1 100 -4095.000 4096.000 BIT_MASK 0x1fff FORMAT "%8.3" ECU_ADDRESS 0x600136D0 /end MEASUREMENT
/begin MEASUREMENT DINH_nrActvInhReas.FId_AltACGFailr "Number of active inhibit reasons for the FIds / Number of active inhibit reasons for FId_AltACGFailr" UWORD DINH_ct_Compu 1 100 -4095.000 4096.000 BIT_MASK 0x1fff FORMAT "%8.3" ECU_ADDRESS 0x600136D2 /end MEASUREMENT
/begin MEASUREMENT DINH_nrActvInhReas.FId_AltAPPErrSt "Number of active inhibit reasons for the FIds / Number of active inhibit reasons for FId_AltAPPErrSt" UWORD DINH_ct_Compu 1 100 -4095.000 4096.000 BIT_MASK 0x1fff FORMAT "%8.3" ECU_ADDRESS 0x600136D4 /end MEASUREMENT
/begin MEASUREMENT DINH_nrActvInhReas.FId_AltBattMngtFailr "Number of active inhibit reasons for the FIds / Number of active inhibit reasons for FId_AltBattMngtFailr" UWORD DINH_ct_Compu 1 100 -4095.000 4096.000 BIT_MASK 0x1fff FORMAT "%8.3" ECU_ADDRESS 0x600136D6 /end MEASUREMENT
/begin MEASUREMENT DINH_nrActvInhReas.FId_AltBrkErrSt "Number of active inhibit reasons for the FIds / Number of active inhibit reasons for FId_AltBrkErrSt" UWORD DINH_ct_Compu 1 100 -4095.000 4096.000 BIT_MASK 0x1fff FORMAT "%8.3" ECU_ADDRESS 0x600136D8 /end MEASUREMENT
/begin MEASUREMENT DINH_nrActvInhReas.FId_AltComErr "Number of active inhibit reasons for the FIds / Number of active inhibit reasons for FId_AltComErr" UWORD DINH_ct_Compu 1 100 -4095.000 4096.000 BIT_MASK 0x1fff FORMAT "%8.3" ECU_ADDRESS 0x600136DA /end MEASUREMENT
/begin MEASUREMENT DINH_nrActvInhReas.FId_AltENGB "Number of active inhibit reasons for the FIds / Number of active inhibit reasons for FId_AltENGB" UWORD DINH_ct_Compu 1 100 -4095.000 4096.000 BIT_MASK 0x1fff FORMAT "%8.3" ECU_ADDRESS 0x600136DC /end MEASUREMENT
/begin MEASUREMENT DINH_nrActvInhReas.FId_AltElecLoadErr "Number of active inhibit reasons for the FIds / Number of active inhibit reasons for FId_AltElecLoadErr" UWORD DINH_ct_Compu 1 100 -4095.000 4096.000 BIT_MASK 0x1fff FORMAT "%8.3" ECU_ADDRESS 0x600136DE /end MEASUREMENT
/begin MEASUREMENT DINH_nrActvInhReas.FId_AltEnvTErr "Number of active inhibit reasons for the FIds / Number of active inhibit reasons for FId_AltEnvTErr" UWORD DINH_ct_Compu 1 100 -4095.000 4096.000 BIT_MASK 0x1fff FORMAT "%8.3" ECU_ADDRESS 0x600136E0 /end MEASUREMENT
/begin MEASUREMENT DINH_nrActvInhReas.FId_AltFFAltLoadFast "Number of active inhibit reasons for the FIds / Number of active inhibit reasons for FId_AltFFAltLoadFast" UWORD DINH_ct_Compu 1 100 -4095.000 4096.000 BIT_MASK 0x1fff FORMAT "%8.3" ECU_ADDRESS 0x600136E2 /end MEASUREMENT
/begin MEASUREMENT DINH_nrActvInhReas.FId_AltFFAltLoadSlow "Number of active inhibit reasons for the FIds / Number of active inhibit reasons for FId_AltFFAltLoadSlow" UWORD DINH_ct_Compu 1 100 -4095.000 4096.000 BIT_MASK 0x1fff FORMAT "%8.3" ECU_ADDRESS 0x600136E4 /end MEASUREMENT
/begin MEASUREMENT DINH_nrActvInhReas.FId_AltIOACGErr "Number of active inhibit reasons for the FIds / Number of active inhibit reasons for FId_AltIOACGErr" UWORD DINH_ct_Compu 1 100 -4095.000 4096.000 BIT_MASK 0x1fff FORMAT "%8.3" ECU_ADDRESS 0x600136E6 /end MEASUREMENT
/begin MEASUREMENT DINH_nrActvInhReas.FId_AltIOACGLinComFailr "Number of active inhibit reasons for the FIds / Number of active inhibit reasons for FId_AltIOACGLinComFailr" UWORD DINH_ct_Compu 1 100 -4095.000 4096.000 BIT_MASK 0x1fff FORMAT "%8.3" ECU_ADDRESS 0x600136E8 /end MEASUREMENT
/begin MEASUREMENT DINH_nrActvInhReas.FId_AltIOComErr "Number of active inhibit reasons for the FIds / Number of active inhibit reasons for FId_AltIOComErr" UWORD DINH_ct_Compu 1 100 -4095.000 4096.000 BIT_MASK 0x1fff FORMAT "%8.3" ECU_ADDRESS 0x600136EA /end MEASUREMENT
/begin MEASUREMENT DINH_nrActvInhReas.FId_AltLinErr "Number of active inhibit reasons for the FIds / Number of active inhibit reasons for FId_AltLinErr" UWORD DINH_ct_Compu 1 100 -4095.000 4096.000 BIT_MASK 0x1fff FORMAT "%8.3" ECU_ADDRESS 0x600136EC /end MEASUREMENT
/begin MEASUREMENT DINH_nrActvInhReas.FId_AltPwr "Number of active inhibit reasons for the FIds / Number of active inhibit reasons for FId_AltPwr" UWORD DINH_ct_Compu 1 100 -4095.000 4096.000 BIT_MASK 0x1fff FORMAT "%8.3" ECU_ADDRESS 0x600136EE /end MEASUREMENT
/begin MEASUREMENT DINH_nrActvInhReas.FId_AltVehVErrSt "Number of active inhibit reasons for the FIds / Number of active inhibit reasons for FId_AltVehVErrSt" UWORD DINH_ct_Compu 1 100 -4095.000 4096.000 BIT_MASK 0x1fff FORMAT "%8.3" ECU_ADDRESS 0x600136F0 /end MEASUREMENT
/begin MEASUREMENT DINH_nrActvInhReas.FId_AltvCluFail "Number of active inhibit reasons for the FIds / Number of active inhibit reasons for FId_AltvCluFail" UWORD DINH_ct_Compu 1 100 -4095.000 4096.000 BIT_MASK 0x1fff FORMAT "%8.3" ECU_ADDRESS 0x600136F2 /end MEASUREMENT
/begin MEASUREMENT DINH_nrActvInhReas.FId_BGAGRTS "Number of active inhibit reasons for the FIds / Number of active inhibit reasons for FId_BGAGRTS" UWORD DINH_ct_Compu 1 100 -4095.000 4096.000 BIT_MASK 0x1fff FORMAT "%8.3" ECU_ADDRESS 0x600136F4 /end MEASUREMENT
/begin MEASUREMENT DINH_nrActvInhReas.FId_BGFKMSEPSR "Number of active inhibit reasons for the FIds / Number of active inhibit reasons for FId_BGFKMSEPSR" UWORD DINH_ct_Compu 1 100 -4095.000 4096.000 BIT_MASK 0x1fff FORMAT "%8.3" ECU_ADDRESS 0x600136F6 /end MEASUREMENT
/begin MEASUREMENT DINH_nrActvInhReas.FId_BGFKMSEPU "Number of active inhibit reasons for the FIds / Number of active inhibit reasons for FId_BGFKMSEPU" UWORD DINH_ct_Compu 1 100 -4095.000 4096.000 BIT_MASK 0x1fff FORMAT "%8.3" ECU_ADDRESS 0x600136F8 /end MEASUREMENT
/begin MEASUREMENT DINH_nrActvInhReas.FId_BGFKMSESumClr "Number of active inhibit reasons for the FIds / Number of active inhibit reasons for FId_BGFKMSESumClr" UWORD DINH_ct_Compu 1 100 -4095.000 4096.000 BIT_MASK 0x1fff FORMAT "%8.3" ECU_ADDRESS 0x600136FA /end MEASUREMENT
/begin MEASUREMENT DINH_nrActvInhReas.FId_BGFKMSHFME "Number of active inhibit reasons for the FIds / Number of active inhibit reasons for FId_BGFKMSHFME" UWORD DINH_ct_Compu 1 100 -4095.000 4096.000 BIT_MASK 0x1fff FORMAT "%8.3" ECU_ADDRESS 0x600136FC /end MEASUREMENT
/begin MEASUREMENT DINH_nrActvInhReas.FId_BGFKMSHFMZ "Number of active inhibit reasons for the FIds / Number of active inhibit reasons for FId_BGFKMSHFMZ" UWORD DINH_ct_Compu 1 100 -4095.000 4096.000 BIT_MASK 0x1fff FORMAT "%8.3" ECU_ADDRESS 0x600136FE /end MEASUREMENT
/begin MEASUREMENT DINH_nrActvInhReas.FId_BGFKMSZPSR "Number of active inhibit reasons for the FIds / Number of active inhibit reasons for FId_BGFKMSZPSR" UWORD DINH_ct_Compu 1 100 -4095.000 4096.000 BIT_MASK 0x1fff FORMAT "%8.3" ECU_ADDRESS 0x60013700 /end MEASUREMENT
/begin MEASUREMENT DINH_nrActvInhReas.FId_BGOSCCat1B1 "Number of active inhibit reasons for the FIds / Number of active inhibit reasons for FId_BGOSCCat1B1" UWORD DINH_ct_Compu 1 100 -4095.000 4096.000 BIT_MASK 0x1fff FORMAT "%8.3" ECU_ADDRESS 0x60013702 /end MEASUREMENT
/begin MEASUREMENT DINH_nrActvInhReas.FId_BGOSCCat2B1 "Number of active inhibit reasons for the FIds / Number of active inhibit reasons for FId_BGOSCCat2B1" UWORD DINH_ct_Compu 1 100 -4095.000 4096.000 BIT_MASK 0x1fff FORMAT "%8.3" ECU_ADDRESS 0x60013704 /end MEASUREMENT
/begin MEASUREMENT DINH_nrActvInhReas.FId_BattAltFailr "Number of active inhibit reasons for the FIds / Number of active inhibit reasons for FId_BattAltFailr" UWORD DINH_ct_Compu 1 100 -4095.000 4096.000 BIT_MASK 0x1fff FORMAT "%8.3" ECU_ADDRESS 0x60013706 /end MEASUREMENT
/begin MEASUREMENT DINH_nrActvInhReas.FId_BattMngtFailr "Number of active inhibit reasons for the FIds / Number of active inhibit reasons for FId_BattMngtFailr" UWORD DINH_ct_Compu 1 100 -4095.000 4096.000 BIT_MASK 0x1fff FORMAT "%8.3" ECU_ADDRESS 0x60013708 /end MEASUREMENT
/begin MEASUREMENT DINH_nrActvInhReas.FId_BattSigPtd "Number of active inhibit reasons for the FIds / Number of active inhibit reasons for FId_BattSigPtd" UWORD DINH_ct_Compu 1 100 -4095.000 4096.000 BIT_MASK 0x1fff FORMAT "%8.3" ECU_ADDRESS 0x6001370A /end MEASUREMENT
/begin MEASUREMENT DINH_nrActvInhReas.FId_BattU2MEDSRC "Number of active inhibit reasons for the FIds / Number of active inhibit reasons for FId_BattU2MEDSRC" UWORD DINH_ct_Compu 1 100 -4095.000 4096.000 BIT_MASK 0x1fff FORMAT "%8.3" ECU_ADDRESS 0x6001370C /end MEASUREMENT
/begin MEASUREMENT DINH_nrActvInhReas.FId_BattUDrpPrvOff "Number of active inhibit reasons for the FIds / Number of active inhibit reasons for FId_BattUDrpPrvOff" UWORD DINH_ct_Compu 1 100 -4095.000 4096.000 BIT_MASK 0x1fff FORMAT "%8.3" ECU_ADDRESS 0x6001370E /end MEASUREMENT
/begin MEASUREMENT DINH_nrActvInhReas.FId_BattUFrzVal "Number of active inhibit reasons for the FIds / Number of active inhibit reasons for FId_BattUFrzVal" UWORD DINH_ct_Compu 1 100 -4095.000 4096.000 BIT_MASK 0x1fff FORMAT "%8.3" ECU_ADDRESS 0x60013710 /end MEASUREMENT
/begin MEASUREMENT DINH_nrActvInhReas.FId_BattUHiFailrEna "Number of active inhibit reasons for the FIds / Number of active inhibit reasons for FId_BattUHiFailrEna" UWORD DINH_ct_Compu 1 100 -4095.000 4096.000 BIT_MASK 0x1fff FORMAT "%8.3" ECU_ADDRESS 0x60013712 /end MEASUREMENT
/begin MEASUREMENT DINH_nrActvInhReas.FId_BattUIMGTCUCANFailr "Number of active inhibit reasons for the FIds / Number of active inhibit reasons for FId_BattUIMGTCUCANFailr" UWORD DINH_ct_Compu 1 100 -4095.000 4096.000 BIT_MASK 0x1fff FORMAT "%8.3" ECU_ADDRESS 0x60013714 /end MEASUREMENT
/begin MEASUREMENT DINH_nrActvInhReas.FId_BattULoFailrEna "Number of active inhibit reasons for the FIds / Number of active inhibit reasons for FId_BattULoFailrEna" UWORD DINH_ct_Compu 1 100 -4095.000 4096.000 BIT_MASK 0x1fff FORMAT "%8.3" ECU_ADDRESS 0x60013716 /end MEASUREMENT
/begin MEASUREMENT DINH_nrActvInhReas.FId_BattUReplVal "Number of active inhibit reasons for the FIds / Number of active inhibit reasons for FId_BattUReplVal" UWORD DINH_ct_Compu 1 100 -4095.000 4096.000 BIT_MASK 0x1fff FORMAT "%8.3" ECU_ADDRESS 0x60013718 /end MEASUREMENT
/begin MEASUREMENT DINH_nrActvInhReas.FId_BattUSRC "Number of active inhibit reasons for the FIds / Number of active inhibit reasons for FId_BattUSRC" UWORD DINH_ct_Compu 1 100 -4095.000 4096.000 BIT_MASK 0x1fff FORMAT "%8.3" ECU_ADDRESS 0x6001371A /end MEASUREMENT
/begin MEASUREMENT DINH_nrActvInhReas.FId_BlwrComErr "Number of active inhibit reasons for the FIds / Number of active inhibit reasons for FId_BlwrComErr" UWORD DINH_ct_Compu 1 100 -4095.000 4096.000 BIT_MASK 0x1fff FORMAT "%8.3" ECU_ADDRESS 0x6001371C /end MEASUREMENT
/begin MEASUREMENT DINH_nrActvInhReas.FId_BrkBstMdl "Number of active inhibit reasons for the FIds / Number of active inhibit reasons for FId_BrkBstMdl" UWORD DINH_ct_Compu 1 100 -4095.000 4096.000 BIT_MASK 0x1fff FORMAT "%8.3" ECU_ADDRESS 0x6001371E /end MEASUREMENT
/begin MEASUREMENT DINH_nrActvInhReas.FId_BrkBstMdlBrkP "Number of active inhibit reasons for the FIds / Number of active inhibit reasons for FId_BrkBstMdlBrkP" UWORD DINH_ct_Compu 1 100 -4095.000 4096.000 BIT_MASK 0x1fff FORMAT "%8.3" ECU_ADDRESS 0x60013720 /end MEASUREMENT
/begin MEASUREMENT DINH_nrActvInhReas.FId_BrkBstMdlBrkSt "Number of active inhibit reasons for the FIds / Number of active inhibit reasons for FId_BrkBstMdlBrkSt" UWORD DINH_ct_Compu 1 100 -4095.000 4096.000 BIT_MASK 0x1fff FORMAT "%8.3" ECU_ADDRESS 0x60013722 /end MEASUREMENT
/begin MEASUREMENT DINH_nrActvInhReas.FId_BrkBstMdlEnvP "Number of active inhibit reasons for the FIds / Number of active inhibit reasons for FId_BrkBstMdlEnvP" UWORD DINH_ct_Compu 1 100 -4095.000 4096.000 BIT_MASK 0x1fff FORMAT "%8.3" ECU_ADDRESS 0x60013724 /end MEASUREMENT
/begin MEASUREMENT DINH_nrActvInhReas.FId_BrkBstPDetnInhbn "Number of active inhibit reasons for the FIds / Number of active inhibit reasons for FId_BrkBstPDetnInhbn" UWORD DINH_ct_Compu 1 100 -4095.000 4096.000 BIT_MASK 0x1fff FORMAT "%8.3" ECU_ADDRESS 0x60013726 /end MEASUREMENT
/begin MEASUREMENT DINH_nrActvInhReas.FId_BrkBstPMstCylPSnsrFail "Number of active inhibit reasons for the FIds / Number of active inhibit reasons for FId_BrkBstPMstCylPSnsrFail" UWORD DINH_ct_Compu 1 100 -4095.000 4096.000 BIT_MASK 0x1fff FORMAT "%8.3" ECU_ADDRESS 0x60013728 /end MEASUREMENT
/begin MEASUREMENT DINH_nrActvInhReas.FId_BrkBstPSnsrStuckDetn "Number of active inhibit reasons for the FIds / Number of active inhibit reasons for FId_BrkBstPSnsrStuckDetn" UWORD DINH_ct_Compu 1 100 -4095.000 4096.000 BIT_MASK 0x1fff FORMAT "%8.3" ECU_ADDRESS 0x6001372A /end MEASUREMENT
/begin MEASUREMENT DINH_nrActvInhReas.FId_BrkBstSigPath "Number of active inhibit reasons for the FIds / Number of active inhibit reasons for FId_BrkBstSigPath" UWORD DINH_ct_Compu 1 100 -4095.000 4096.000 BIT_MASK 0x1fff FORMAT "%8.3" ECU_ADDRESS 0x6001372C /end MEASUREMENT
/begin MEASUREMENT DINH_nrActvInhReas.FId_BrkBstVehVv "Number of active inhibit reasons for the FIds / Number of active inhibit reasons for FId_BrkBstVehVv" UWORD DINH_ct_Compu 1 100 -4095.000 4096.000 BIT_MASK 0x1fff FORMAT "%8.3" ECU_ADDRESS 0x6001372E /end MEASUREMENT
/begin MEASUREMENT DINH_nrActvInhReas.FId_BrkMnSwtErr "Number of active inhibit reasons for the FIds / Number of active inhibit reasons for FId_BrkMnSwtErr" UWORD DINH_ct_Compu 1 100 -4095.000 4096.000 BIT_MASK 0x1fff FORMAT "%8.3" ECU_ADDRESS 0x60013730 /end MEASUREMENT
/begin MEASUREMENT DINH_nrActvInhReas.FId_BrkPFrzVal "Number of active inhibit reasons for the FIds / Number of active inhibit reasons for FId_BrkPFrzVal" UWORD DINH_ct_Compu 1 100 -4095.000 4096.000 BIT_MASK 0x1fff FORMAT "%8.3" ECU_ADDRESS 0x60013732 /end MEASUREMENT
/begin MEASUREMENT DINH_nrActvInhReas.FId_BrkPOilPres "Number of active inhibit reasons for the FIds / Number of active inhibit reasons for FId_BrkPOilPres" UWORD DINH_ct_Compu 1 100 -4095.000 4096.000 BIT_MASK 0x1fff FORMAT "%8.3" ECU_ADDRESS 0x60013734 /end MEASUREMENT
/begin MEASUREMENT DINH_nrActvInhReas.FId_BrkPReplVal "Number of active inhibit reasons for the FIds / Number of active inhibit reasons for FId_BrkPReplVal" UWORD DINH_ct_Compu 1 100 -4095.000 4096.000 BIT_MASK 0x1fff FORMAT "%8.3" ECU_ADDRESS 0x60013736 /end MEASUREMENT
/begin MEASUREMENT DINH_nrActvInhReas.FId_BrkPedEngStopEna "Number of active inhibit reasons for the FIds / Number of active inhibit reasons for FId_BrkPedEngStopEna" UWORD DINH_ct_Compu 1 100 -4095.000 4096.000 BIT_MASK 0x1fff FORMAT "%8.3" ECU_ADDRESS 0x60013738 /end MEASUREMENT
/begin MEASUREMENT DINH_nrActvInhReas.FId_BrkRdntSwtErr "Number of active inhibit reasons for the FIds / Number of active inhibit reasons for FId_BrkRdntSwtErr" UWORD DINH_ct_Compu 1 100 -4095.000 4096.000 BIT_MASK 0x1fff FORMAT "%8.3" ECU_ADDRESS 0x6001373A /end MEASUREMENT
/begin MEASUREMENT DINH_nrActvInhReas.FId_CAGRSDS "Number of active inhibit reasons for the FIds / Number of active inhibit reasons for FId_CAGRSDS" UWORD DINH_ct_Compu 1 100 -4095.000 4096.000 BIT_MASK 0x1fff FORMAT "%8.3" ECU_ADDRESS 0x6001373C /end MEASUREMENT
/begin MEASUREMENT DINH_nrActvInhReas.FId_CEngDsTColdStrt "Number of active inhibit reasons for the FIds / Number of active inhibit reasons for FId_CEngDsTColdStrt" UWORD DINH_ct_Compu 1 100 -4095.000 4096.000 BIT_MASK 0x1fff FORMAT "%8.3" ECU_ADDRESS 0x6001373E /end MEASUREMENT
/begin MEASUREMENT DINH_nrActvInhReas.FId_CEngDsTColdStrtErr "Number of active inhibit reasons for the FIds / Number of active inhibit reasons for FId_CEngDsTColdStrtErr" UWORD DINH_ct_Compu 1 100 -4095.000 4096.000 BIT_MASK 0x1fff FORMAT "%8.3" ECU_ADDRESS 0x60013740 /end MEASUREMENT
/begin MEASUREMENT DINH_nrActvInhReas.FId_CEngDsTHSC "Number of active inhibit reasons for the FIds / Number of active inhibit reasons for FId_CEngDsTHSC" UWORD DINH_ct_Compu 1 100 -4095.000 4096.000 BIT_MASK 0x1fff FORMAT "%8.3" ECU_ADDRESS 0x60013742 /end MEASUREMENT
/begin MEASUREMENT DINH_nrActvInhReas.FId_CEngDsTLSC "Number of active inhibit reasons for the FIds / Number of active inhibit reasons for FId_CEngDsTLSC" UWORD DINH_ct_Compu 1 100 -4095.000 4096.000 BIT_MASK 0x1fff FORMAT "%8.3" ECU_ADDRESS 0x60013744 /end MEASUREMENT
/begin MEASUREMENT DINH_nrActvInhReas.FId_CEngDsTPlausErr "Number of active inhibit reasons for the FIds / Number of active inhibit reasons for FId_CEngDsTPlausErr" UWORD DINH_ct_Compu 1 100 -4095.000 4096.000 BIT_MASK 0x1fff FORMAT "%8.3" ECU_ADDRESS 0x60013746 /end MEASUREMENT
/begin MEASUREMENT DINH_nrActvInhReas.FId_CEngDsTReplMdlEngStop "Number of active inhibit reasons for the FIds / Number of active inhibit reasons for FId_CEngDsTReplMdlEngStop" UWORD DINH_ct_Compu 1 100 -4095.000 4096.000 BIT_MASK 0x1fff FORMAT "%8.3" ECU_ADDRESS 0x60013748 /end MEASUREMENT
/begin MEASUREMENT DINH_nrActvInhReas.FId_CEngDsTSTC "Number of active inhibit reasons for the FIds / Number of active inhibit reasons for FId_CEngDsTSTC" UWORD DINH_ct_Compu 1 100 -4095.000 4096.000 BIT_MASK 0x1fff FORMAT "%8.3" ECU_ADDRESS 0x6001374A /end MEASUREMENT
/begin MEASUREMENT DINH_nrActvInhReas.FId_CEngDsTSnsrElec "Number of active inhibit reasons for the FIds / Number of active inhibit reasons for FId_CEngDsTSnsrElec" UWORD DINH_ct_Compu 1 100 -4095.000 4096.000 BIT_MASK 0x1fff FORMAT "%8.3" ECU_ADDRESS 0x6001374C /end MEASUREMENT
/begin MEASUREMENT DINH_nrActvInhReas.FId_CEngDsTSwtReplMdl "Number of active inhibit reasons for the FIds / Number of active inhibit reasons for FId_CEngDsTSwtReplMdl" UWORD DINH_ct_Compu 1 100 -4095.000 4096.000 BIT_MASK 0x1fff FORMAT "%8.3" ECU_ADDRESS 0x6001374E /end MEASUREMENT
/begin MEASUREMENT DINH_nrActvInhReas.FId_CEngUsTColdChkErr "Number of active inhibit reasons for the FIds / Number of active inhibit reasons for FId_CEngUsTColdChkErr" UWORD DINH_ct_Compu 1 100 -4095.000 4096.000 BIT_MASK 0x1fff FORMAT "%8.3" ECU_ADDRESS 0x60013750 /end MEASUREMENT
/begin MEASUREMENT DINH_nrActvInhReas.FId_CEngUsTCrssChk "Number of active inhibit reasons for the FIds / Number of active inhibit reasons for FId_CEngUsTCrssChk" UWORD DINH_ct_Compu 1 100 -4095.000 4096.000 BIT_MASK 0x1fff FORMAT "%8.3" ECU_ADDRESS 0x60013752 /end MEASUREMENT
/begin MEASUREMENT DINH_nrActvInhReas.FId_CEngUsTElecErr "Number of active inhibit reasons for the FIds / Number of active inhibit reasons for FId_CEngUsTElecErr" UWORD DINH_ct_Compu 1 100 -4095.000 4096.000 BIT_MASK 0x1fff FORMAT "%8.3" ECU_ADDRESS 0x60013754 /end MEASUREMENT
/begin MEASUREMENT DINH_nrActvInhReas.FId_CEngUsTSnsrElecErr "Number of active inhibit reasons for the FIds / Number of active inhibit reasons for FId_CEngUsTSnsrElecErr" UWORD DINH_ct_Compu 1 100 -4095.000 4096.000 BIT_MASK 0x1fff FORMAT "%8.3" ECU_ADDRESS 0x60013756 /end MEASUREMENT
/begin MEASUREMENT DINH_nrActvInhReas.FId_CEngUsTSwtReplMdl "Number of active inhibit reasons for the FIds / Number of active inhibit reasons for FId_CEngUsTSwtReplMdl" UWORD DINH_ct_Compu 1 100 -4095.000 4096.000 BIT_MASK 0x1fff FORMAT "%8.3" ECU_ADDRESS 0x60013758 /end MEASUREMENT
/begin MEASUREMENT DINH_nrActvInhReas.FId_CInjCatHeatgDiag "Number of active inhibit reasons for the FIds / Number of active inhibit reasons for FId_CInjCatHeatgDiag" UWORD DINH_ct_Compu 1 100 -4095.000 4096.000 BIT_MASK 0x1fff FORMAT "%8.3" ECU_ADDRESS 0x6001375A /end MEASUREMENT
/begin MEASUREMENT DINH_nrActvInhReas.FId_CMSUDKSOM1 "Number of active inhibit reasons for the FIds / Number of active inhibit reasons for FId_CMSUDKSOM1" UWORD DINH_ct_Compu 1 100 -4095.000 4096.000 BIT_MASK 0x1fff FORMAT "%8.3" ECU_ADDRESS 0x6001375C /end MEASUREMENT
/begin MEASUREMENT DINH_nrActvInhReas.FId_CMSUDKSOM2 "Number of active inhibit reasons for the FIds / Number of active inhibit reasons for FId_CMSUDKSOM2" UWORD DINH_ct_Compu 1 100 -4095.000 4096.000 BIT_MASK 0x1fff FORMAT "%8.3" ECU_ADDRESS 0x6001375E /end MEASUREMENT
/begin MEASUREMENT DINH_nrActvInhReas.FId_CatHeatgEomShtrpAct "Number of active inhibit reasons for the FIds / Number of active inhibit reasons for FId_CatHeatgEomShtrpAct" UWORD DINH_ct_Compu 1 100 -4095.000 4096.000 BIT_MASK 0x1fff FORMAT "%8.3" ECU_ADDRESS 0x60013760 /end MEASUREMENT
/begin MEASUREMENT DINH_nrActvInhReas.FId_ChrctlAgrsErr "Number of active inhibit reasons for the FIds / Number of active inhibit reasons for FId_ChrctlAgrsErr" UWORD DINH_ct_Compu 1 100 -4095.000 4096.000 BIT_MASK 0x1fff FORMAT "%8.3" ECU_ADDRESS 0x60013762 /end MEASUREMENT
/begin MEASUREMENT DINH_nrActvInhReas.FId_ChrctlAgrscf "Number of active inhibit reasons for the FIds / Number of active inhibit reasons for FId_ChrctlAgrscf" UWORD DINH_ct_Compu 1 100 -4095.000 4096.000 BIT_MASK 0x1fff FORMAT "%8.3" ECU_ADDRESS 0x60013764 /end MEASUREMENT
/begin MEASUREMENT DINH_nrActvInhReas.FId_ClntTempENGB "Number of active inhibit reasons for the FIds / Number of active inhibit reasons for FId_ClntTempENGB" UWORD DINH_ct_Compu 1 100 -4095.000 4096.000 BIT_MASK 0x1fff FORMAT "%8.3" ECU_ADDRESS 0x60013766 /end MEASUREMENT
/begin MEASUREMENT DINH_nrActvInhReas.FId_Clth "Number of active inhibit reasons for the FIds / Number of active inhibit reasons for FId_Clth" UWORD DINH_ct_Compu 1 100 -4095.000 4096.000 BIT_MASK 0x1fff FORMAT "%8.3" ECU_ADDRESS 0x60013768 /end MEASUREMENT
/begin MEASUREMENT DINH_nrActvInhReas.FId_Clth2 "Number of active inhibit reasons for the FIds / Number of active inhibit reasons for FId_Clth2" UWORD DINH_ct_Compu 1 100 -4095.000 4096.000 BIT_MASK 0x1fff FORMAT "%8.3" ECU_ADDRESS 0x6001376A /end MEASUREMENT
/begin MEASUREMENT DINH_nrActvInhReas.FId_Clth3StuckOn "Number of active inhibit reasons for the FIds / Number of active inhibit reasons for FId_Clth3StuckOn" UWORD DINH_ct_Compu 1 100 -4095.000 4096.000 BIT_MASK 0x1fff FORMAT "%8.3" ECU_ADDRESS 0x6001376C /end MEASUREMENT
/begin MEASUREMENT DINH_nrActvInhReas.FId_Clth4 "Number of active inhibit reasons for the FIds / Number of active inhibit reasons for FId_Clth4" UWORD DINH_ct_Compu 1 100 -4095.000 4096.000 BIT_MASK 0x1fff FORMAT "%8.3" ECU_ADDRESS 0x6001376E /end MEASUREMENT
/begin MEASUREMENT DINH_nrActvInhReas.FId_ClthCAN "Number of active inhibit reasons for the FIds / Number of active inhibit reasons for FId_ClthCAN" UWORD DINH_ct_Compu 1 100 -4095.000 4096.000 BIT_MASK 0x1fff FORMAT "%8.3" ECU_ADDRESS 0x60013770 /end MEASUREMENT
/begin MEASUREMENT DINH_nrActvInhReas.FId_ClthMax "Number of active inhibit reasons for the FIds / Number of active inhibit reasons for FId_ClthMax" UWORD DINH_ct_Compu 1 100 -4095.000 4096.000 BIT_MASK 0x1fff FORMAT "%8.3" ECU_ADDRESS 0x60013772 /end MEASUREMENT
/begin MEASUREMENT DINH_nrActvInhReas.FId_ClthStk "Number of active inhibit reasons for the FIds / Number of active inhibit reasons for FId_ClthStk" UWORD DINH_ct_Compu 1 100 -4095.000 4096.000 BIT_MASK 0x1fff FORMAT "%8.3" ECU_ADDRESS 0x60013774 /end MEASUREMENT
/begin MEASUREMENT DINH_nrActvInhReas.FId_ClthStkErr "Number of active inhibit reasons for the FIds / Number of active inhibit reasons for FId_ClthStkErr" UWORD DINH_ct_Compu 1 100 -4095.000 4096.000 BIT_MASK 0x1fff FORMAT "%8.3" ECU_ADDRESS 0x60013776 /end MEASUREMENT
/begin MEASUREMENT DINH_nrActvInhReas.FId_ClthStkFailr "Number of active inhibit reasons for the FIds / Number of active inhibit reasons for FId_ClthStkFailr" UWORD DINH_ct_Compu 1 100 -4095.000 4096.000 BIT_MASK 0x1fff FORMAT "%8.3" ECU_ADDRESS 0x60013778 /end MEASUREMENT
/begin MEASUREMENT DINH_nrActvInhReas.FId_ClthStkOFFStuck "Number of active inhibit reasons for the FIds / Number of active inhibit reasons for FId_ClthStkOFFStuck" UWORD DINH_ct_Compu 1 100 -4095.000 4096.000 BIT_MASK 0x1fff FORMAT "%8.3" ECU_ADDRESS 0x6001377A /end MEASUREMENT
/begin MEASUREMENT DINH_nrActvInhReas.FId_ClthStkONStuck "Number of active inhibit reasons for the FIds / Number of active inhibit reasons for FId_ClthStkONStuck" UWORD DINH_ct_Compu 1 100 -4095.000 4096.000 BIT_MASK 0x1fff FORMAT "%8.3" ECU_ADDRESS 0x6001377C /end MEASUREMENT
/begin MEASUREMENT DINH_nrActvInhReas.FId_ClthSwtFailr "Number of active inhibit reasons for the FIds / Number of active inhibit reasons for FId_ClthSwtFailr" UWORD DINH_ct_Compu 1 100 -4095.000 4096.000 BIT_MASK 0x1fff FORMAT "%8.3" ECU_ADDRESS 0x6001377E /end MEASUREMENT
/begin MEASUREMENT DINH_nrActvInhReas.FId_CntrShaftFailr "Number of active inhibit reasons for the FIds / Number of active inhibit reasons for FId_CntrShaftFailr" UWORD DINH_ct_Compu 1 100 -4095.000 4096.000 BIT_MASK 0x1fff FORMAT "%8.3" ECU_ADDRESS 0x60013780 /end MEASUREMENT
/begin MEASUREMENT DINH_nrActvInhReas.FId_CoEOMGdiEomErrLcy "Number of active inhibit reasons for the FIds / Number of active inhibit reasons for FId_CoEOMGdiEomErrLcy" UWORD DINH_ct_Compu 1 100 -4095.000 4096.000 BIT_MASK 0x1fff FORMAT "%8.3" ECU_ADDRESS 0x60013782 /end MEASUREMENT
/begin MEASUREMENT DINH_nrActvInhReas.FId_CoESSBlowrVld "Number of active inhibit reasons for the FIds / Number of active inhibit reasons for FId_CoESSBlowrVld" UWORD DINH_ct_Compu 1 100 -4095.000 4096.000 BIT_MASK 0x1fff FORMAT "%8.3" ECU_ADDRESS 0x60013784 /end MEASUREMENT
/begin MEASUREMENT DINH_nrActvInhReas.FId_CoETM "Number of active inhibit reasons for the FIds / Number of active inhibit reasons for FId_CoETM" UWORD DINH_ct_Compu 1 100 -4095.000 4096.000 BIT_MASK 0x1fff FORMAT "%8.3" ECU_ADDRESS 0x60013786 /end MEASUREMENT
/begin MEASUREMENT DINH_nrActvInhReas.FId_CoETS_StTrqLimErr1 "Number of active inhibit reasons for the FIds / Number of active inhibit reasons for FId_CoETS_StTrqLimErr1" UWORD DINH_ct_Compu 1 100 -4095.000 4096.000 BIT_MASK 0x1fff FORMAT "%8.3" ECU_ADDRESS 0x60013788 /end MEASUREMENT
/begin MEASUREMENT DINH_nrActvInhReas.FId_CoETS_StTrqLimErr2 "Number of active inhibit reasons for the FIds / Number of active inhibit reasons for FId_CoETS_StTrqLimErr2" UWORD DINH_ct_Compu 1 100 -4095.000 4096.000 BIT_MASK 0x1fff FORMAT "%8.3" ECU_ADDRESS 0x6001378A /end MEASUREMENT
/begin MEASUREMENT DINH_nrActvInhReas.FId_CoEngStopEnblStSpEngT "Number of active inhibit reasons for the FIds / Number of active inhibit reasons for FId_CoEngStopEnblStSpEngT" UWORD DINH_ct_Compu 1 100 -4095.000 4096.000 BIT_MASK 0x1fff FORMAT "%8.3" ECU_ADDRESS 0x6001378C /end MEASUREMENT
/begin MEASUREMENT DINH_nrActvInhReas.FId_CoEngStopEnblStSpLSU "Number of active inhibit reasons for the FIds / Number of active inhibit reasons for FId_CoEngStopEnblStSpLSU" UWORD DINH_ct_Compu 1 100 -4095.000 4096.000 BIT_MASK 0x1fff FORMAT "%8.3" ECU_ADDRESS 0x6001378E /end MEASUREMENT
/begin MEASUREMENT DINH_nrActvInhReas.FId_CoEngStopEnblStSpTcT "Number of active inhibit reasons for the FIds / Number of active inhibit reasons for FId_CoEngStopEnblStSpTcT" UWORD DINH_ct_Compu 1 100 -4095.000 4096.000 BIT_MASK 0x1fff FORMAT "%8.3" ECU_ADDRESS 0x60013790 /end MEASUREMENT
/begin MEASUREMENT DINH_nrActvInhReas.FId_CoEngStopEnblSysErr "Number of active inhibit reasons for the FIds / Number of active inhibit reasons for FId_CoEngStopEnblSysErr" UWORD DINH_ct_Compu 1 100 -4095.000 4096.000 BIT_MASK 0x1fff FORMAT "%8.3" ECU_ADDRESS 0x60013792 /end MEASUREMENT
/begin MEASUREMENT DINH_nrActvInhReas.FId_CoEngVlvLftSpIntk "Number of active inhibit reasons for the FIds / Number of active inhibit reasons for FId_CoEngVlvLftSpIntk" UWORD DINH_ct_Compu 1 100 -4095.000 4096.000 BIT_MASK 0x1fff FORMAT "%8.3" ECU_ADDRESS 0x60013794 /end MEASUREMENT
/begin MEASUREMENT DINH_nrActvInhReas.FId_CoPOMStrtgDevStrtr "Number of active inhibit reasons for the FIds / Number of active inhibit reasons for FId_CoPOMStrtgDevStrtr" UWORD DINH_ct_Compu 1 100 -4095.000 4096.000 BIT_MASK 0x1fff FORMAT "%8.3" ECU_ADDRESS 0x60013796 /end MEASUREMENT
/begin MEASUREMENT DINH_nrActvInhReas.FId_CoPOM_FirstStrtAut "Number of active inhibit reasons for the FIds / Number of active inhibit reasons for FId_CoPOM_FirstStrtAut" UWORD DINH_ct_Compu 1 100 -4095.000 4096.000 BIT_MASK 0x1fff FORMAT "%8.3" ECU_ADDRESS 0x60013798 /end MEASUREMENT
/begin MEASUREMENT DINH_nrActvInhReas.FId_CoTS_SwtOff "Number of active inhibit reasons for the FIds / Number of active inhibit reasons for FId_CoTS_SwtOff" UWORD DINH_ct_Compu 1 100 -4095.000 4096.000 BIT_MASK 0x1fff FORMAT "%8.3" ECU_ADDRESS 0x6001379A /end MEASUREMENT
/begin MEASUREMENT DINH_nrActvInhReas.FId_CoVOMACCComFailr "Number of active inhibit reasons for the FIds / Number of active inhibit reasons for FId_CoVOMACCComFailr" UWORD DINH_ct_Compu 1 100 -4095.000 4096.000 BIT_MASK 0x1fff FORMAT "%8.3" ECU_ADDRESS 0x6001379C /end MEASUREMENT
/begin MEASUREMENT DINH_nrActvInhReas.FId_CoVOMBrkPedISABSigFailr "Number of active inhibit reasons for the FIds / Number of active inhibit reasons for FId_CoVOMBrkPedISABSigFailr" UWORD DINH_ct_Compu 1 100 -4095.000 4096.000 BIT_MASK 0x1fff FORMAT "%8.3" ECU_ADDRESS 0x6001379E /end MEASUREMENT
/begin MEASUREMENT DINH_nrActvInhReas.FId_CoVOMEngCrkAbort "Number of active inhibit reasons for the FIds / Number of active inhibit reasons for FId_CoVOMEngCrkAbort" UWORD DINH_ct_Compu 1 100 -4095.000 4096.000 BIT_MASK 0x1fff FORMAT "%8.3" ECU_ADDRESS 0x600137A0 /end MEASUREMENT
/begin MEASUREMENT DINH_nrActvInhReas.FId_CoVOMEngRstrtEnaCdn "Number of active inhibit reasons for the FIds / Number of active inhibit reasons for FId_CoVOMEngRstrtEnaCdn" UWORD DINH_ct_Compu 1 100 -4095.000 4096.000 BIT_MASK 0x1fff FORMAT "%8.3" ECU_ADDRESS 0x600137A2 /end MEASUREMENT
/begin MEASUREMENT DINH_nrActvInhReas.FId_CoVOMISSEng "Number of active inhibit reasons for the FIds / Number of active inhibit reasons for FId_CoVOMISSEng" UWORD DINH_ct_Compu 1 100 -4095.000 4096.000 BIT_MASK 0x1fff FORMAT "%8.3" ECU_ADDRESS 0x600137A4 /end MEASUREMENT
/begin MEASUREMENT DINH_nrActvInhReas.FId_ComACRly "Number of active inhibit reasons for the FIds / Number of active inhibit reasons for FId_ComACRly" UWORD DINH_ct_Compu 1 100 -4095.000 4096.000 BIT_MASK 0x1fff FORMAT "%8.3" ECU_ADDRESS 0x600137A6 /end MEASUREMENT
/begin MEASUREMENT DINH_nrActvInhReas.FId_ComAPPSensFail "Number of active inhibit reasons for the FIds / Number of active inhibit reasons for FId_ComAPPSensFail" UWORD DINH_ct_Compu 1 100 -4095.000 4096.000 BIT_MASK 0x1fff FORMAT "%8.3" ECU_ADDRESS 0x600137A8 /end MEASUREMENT
/begin MEASUREMENT DINH_nrActvInhReas.FId_ComAPedl "Number of active inhibit reasons for the FIds / Number of active inhibit reasons for FId_ComAPedl" UWORD DINH_ct_Compu 1 100 -4095.000 4096.000 BIT_MASK 0x1fff FORMAT "%8.3" ECU_ADDRESS 0x600137AA /end MEASUREMENT
/begin MEASUREMENT DINH_nrActvInhReas.FId_ComAYCA "Number of active inhibit reasons for the FIds / Number of active inhibit reasons for FId_ComAYCA" UWORD DINH_ct_Compu 1 100 -4095.000 4096.000 BIT_MASK 0x1fff FORMAT "%8.3" ECU_ADDRESS 0x600137AC /end MEASUREMENT
/begin MEASUREMENT DINH_nrActvInhReas.FId_ComAYCAMon "Number of active inhibit reasons for the FIds / Number of active inhibit reasons for FId_ComAYCAMon" UWORD DINH_ct_Compu 1 100 -4095.000 4096.000 BIT_MASK 0x1fff FORMAT "%8.3" ECU_ADDRESS 0x600137AE /end MEASUREMENT
/begin MEASUREMENT DINH_nrActvInhReas.FId_ComAYCD "Number of active inhibit reasons for the FIds / Number of active inhibit reasons for FId_ComAYCD" UWORD DINH_ct_Compu 1 100 -4095.000 4096.000 BIT_MASK 0x1fff FORMAT "%8.3" ECU_ADDRESS 0x600137B0 /end MEASUREMENT
/begin MEASUREMENT DINH_nrActvInhReas.FId_ComAYCDMon "Number of active inhibit reasons for the FIds / Number of active inhibit reasons for FId_ComAYCDMon" UWORD DINH_ct_Compu 1 100 -4095.000 4096.000 BIT_MASK 0x1fff FORMAT "%8.3" ECU_ADDRESS 0x600137B2 /end MEASUREMENT
/begin MEASUREMENT DINH_nrActvInhReas.FId_ComAYCF "Number of active inhibit reasons for the FIds / Number of active inhibit reasons for FId_ComAYCF" UWORD DINH_ct_Compu 1 100 -4095.000 4096.000 BIT_MASK 0x1fff FORMAT "%8.3" ECU_ADDRESS 0x600137B4 /end MEASUREMENT
/begin MEASUREMENT DINH_nrActvInhReas.FId_ComAYCFMon "Number of active inhibit reasons for the FIds / Number of active inhibit reasons for FId_ComAYCFMon" UWORD DINH_ct_Compu 1 100 -4095.000 4096.000 BIT_MASK 0x1fff FORMAT "%8.3" ECU_ADDRESS 0x600137B6 /end MEASUREMENT
/begin MEASUREMENT DINH_nrActvInhReas.FId_ComAYCG "Number of active inhibit reasons for the FIds / Number of active inhibit reasons for FId_ComAYCG" UWORD DINH_ct_Compu 1 100 -4095.000 4096.000 BIT_MASK 0x1fff FORMAT "%8.3" ECU_ADDRESS 0x600137B8 /end MEASUREMENT
/begin MEASUREMENT DINH_nrActvInhReas.FId_ComAYCGMon "Number of active inhibit reasons for the FIds / Number of active inhibit reasons for FId_ComAYCGMon" UWORD DINH_ct_Compu 1 100 -4095.000 4096.000 BIT_MASK 0x1fff FORMAT "%8.3" ECU_ADDRESS 0x600137BA /end MEASUREMENT
/begin MEASUREMENT DINH_nrActvInhReas.FId_ComAYCI "Number of active inhibit reasons for the FIds / Number of active inhibit reasons for FId_ComAYCI" UWORD DINH_ct_Compu 1 100 -4095.000 4096.000 BIT_MASK 0x1fff FORMAT "%8.3" ECU_ADDRESS 0x600137BC /end MEASUREMENT
/begin MEASUREMENT DINH_nrActvInhReas.FId_ComAYCIMon "Number of active inhibit reasons for the FIds / Number of active inhibit reasons for FId_ComAYCIMon" UWORD DINH_ct_Compu 1 100 -4095.000 4096.000 BIT_MASK 0x1fff FORMAT "%8.3" ECU_ADDRESS 0x600137BE /end MEASUREMENT
/begin MEASUREMENT DINH_nrActvInhReas.FId_ComAirPThrUsSnsrErr "Number of active inhibit reasons for the FIds / Number of active inhibit reasons for FId_ComAirPThrUsSnsrErr" UWORD DINH_ct_Compu 1 100 -4095.000 4096.000 BIT_MASK 0x1fff FORMAT "%8.3" ECU_ADDRESS 0x600137C0 /end MEASUREMENT
/begin MEASUREMENT DINH_nrActvInhReas.FId_ComAltFail "Number of active inhibit reasons for the FIds / Number of active inhibit reasons for FId_ComAltFail" UWORD DINH_ct_Compu 1 100 -4095.000 4096.000 BIT_MASK 0x1fff FORMAT "%8.3" ECU_ADDRESS 0x600137C2 /end MEASUREMENT
/begin MEASUREMENT DINH_nrActvInhReas.FId_ComAppVehSnsrFailr "Number of active inhibit reasons for the FIds / Number of active inhibit reasons for FId_ComAppVehSnsrFailr" UWORD DINH_ct_Compu 1 100 -4095.000 4096.000 BIT_MASK 0x1fff FORMAT "%8.3" ECU_ADDRESS 0x600137C4 /end MEASUREMENT
/begin MEASUREMENT DINH_nrActvInhReas.FId_ComBCM1 "Number of active inhibit reasons for the FIds / Number of active inhibit reasons for FId_ComBCM1" UWORD DINH_ct_Compu 1 100 -4095.000 4096.000 BIT_MASK 0x1fff FORMAT "%8.3" ECU_ADDRESS 0x600137C6 /end MEASUREMENT
/begin MEASUREMENT DINH_nrActvInhReas.FId_ComBCM1Mon "Number of active inhibit reasons for the FIds / Number of active inhibit reasons for FId_ComBCM1Mon" UWORD DINH_ct_Compu 1 100 -4095.000 4096.000 BIT_MASK 0x1fff FORMAT "%8.3" ECU_ADDRESS 0x600137C8 /end MEASUREMENT
/begin MEASUREMENT DINH_nrActvInhReas.FId_ComBCMUnitCfmdErr "Number of active inhibit reasons for the FIds / Number of active inhibit reasons for FId_ComBCMUnitCfmdErr" UWORD DINH_ct_Compu 1 100 -4095.000 4096.000 BIT_MASK 0x1fff FORMAT "%8.3" ECU_ADDRESS 0x600137CA /end MEASUREMENT
/begin MEASUREMENT DINH_nrActvInhReas.FId_ComBCMUnitNotTstd "Number of active inhibit reasons for the FIds / Number of active inhibit reasons for FId_ComBCMUnitNotTstd" UWORD DINH_ct_Compu 1 100 -4095.000 4096.000 BIT_MASK 0x1fff FORMAT "%8.3" ECU_ADDRESS 0x600137CC /end MEASUREMENT
/begin MEASUREMENT DINH_nrActvInhReas.FId_ComBstCtrl "Number of active inhibit reasons for the FIds / Number of active inhibit reasons for FId_ComBstCtrl" UWORD DINH_ct_Compu 1 100 -4095.000 4096.000 BIT_MASK 0x1fff FORMAT "%8.3" ECU_ADDRESS 0x600137CE /end MEASUREMENT
/begin MEASUREMENT DINH_nrActvInhReas.FId_ComCANVEHICLEBusOff "Number of active inhibit reasons for the FIds / Number of active inhibit reasons for FId_ComCANVEHICLEBusOff" UWORD DINH_ct_Compu 1 100 -4095.000 4096.000 BIT_MASK 0x1fff FORMAT "%8.3" ECU_ADDRESS 0x600137D0 /end MEASUREMENT
/begin MEASUREMENT DINH_nrActvInhReas.FId_ComCGW1 "Number of active inhibit reasons for the FIds / Number of active inhibit reasons for FId_ComCGW1" UWORD DINH_ct_Compu 1 100 -4095.000 4096.000 BIT_MASK 0x1fff FORMAT "%8.3" ECU_ADDRESS 0x600137D2 /end MEASUREMENT
/begin MEASUREMENT DINH_nrActvInhReas.FId_ComCGW1Mon "Number of active inhibit reasons for the FIds / Number of active inhibit reasons for FId_ComCGW1Mon" UWORD DINH_ct_Compu 1 100 -4095.000 4096.000 BIT_MASK 0x1fff FORMAT "%8.3" ECU_ADDRESS 0x600137D4 /end MEASUREMENT
/begin MEASUREMENT DINH_nrActvInhReas.FId_ComClthSt "Number of active inhibit reasons for the FIds / Number of active inhibit reasons for FId_ComClthSt" UWORD DINH_ct_Compu 1 100 -4095.000 4096.000 BIT_MASK 0x1fff FORMAT "%8.3" ECU_ADDRESS 0x600137D6 /end MEASUREMENT
/begin MEASUREMENT DINH_nrActvInhReas.FId_ComConvClth "Number of active inhibit reasons for the FIds / Number of active inhibit reasons for FId_ComConvClth" UWORD DINH_ct_Compu 1 100 -4095.000 4096.000 BIT_MASK 0x1fff FORMAT "%8.3" ECU_ADDRESS 0x600137D8 /end MEASUREMENT
/begin MEASUREMENT DINH_nrActvInhReas.FId_ComCrCtlReq "Number of active inhibit reasons for the FIds / Number of active inhibit reasons for FId_ComCrCtlReq" UWORD DINH_ct_Compu 1 100 -4095.000 4096.000 BIT_MASK 0x1fff FORMAT "%8.3" ECU_ADDRESS 0x600137DA /end MEASUREMENT
/begin MEASUREMENT DINH_nrActvInhReas.FId_ComCrsMaiIndcnLampReq "Number of active inhibit reasons for the FIds / Number of active inhibit reasons for FId_ComCrsMaiIndcnLampReq" UWORD DINH_ct_Compu 1 100 -4095.000 4096.000 BIT_MASK 0x1fff FORMAT "%8.3" ECU_ADDRESS 0x600137DC /end MEASUREMENT
/begin MEASUREMENT DINH_nrActvInhReas.FId_ComCrsSetIndcnLampReq "Number of active inhibit reasons for the FIds / Number of active inhibit reasons for FId_ComCrsSetIndcnLampReq" UWORD DINH_ct_Compu 1 100 -4095.000 4096.000 BIT_MASK 0x1fff FORMAT "%8.3" ECU_ADDRESS 0x600137DE /end MEASUREMENT
/begin MEASUREMENT DINH_nrActvInhReas.FId_ComDCDCCdn "Number of active inhibit reasons for the FIds / Number of active inhibit reasons for FId_ComDCDCCdn" UWORD DINH_ct_Compu 1 100 -4095.000 4096.000 BIT_MASK 0x1fff FORMAT "%8.3" ECU_ADDRESS 0x600137E0 /end MEASUREMENT
/begin MEASUREMENT DINH_nrActvInhReas.FId_ComDCDCErr "Number of active inhibit reasons for the FIds / Number of active inhibit reasons for FId_ComDCDCErr" UWORD DINH_ct_Compu 1 100 -4095.000 4096.000 BIT_MASK 0x1fff FORMAT "%8.3" ECU_ADDRESS 0x600137E2 /end MEASUREMENT
/begin MEASUREMENT DINH_nrActvInhReas.FId_ComDesGearCurr "Number of active inhibit reasons for the FIds / Number of active inhibit reasons for FId_ComDesGearCurr" UWORD DINH_ct_Compu 1 100 -4095.000 4096.000 BIT_MASK 0x1fff FORMAT "%8.3" ECU_ADDRESS 0x600137E4 /end MEASUREMENT
/begin MEASUREMENT DINH_nrActvInhReas.FId_ComDetrmAirM "Number of active inhibit reasons for the FIds / Number of active inhibit reasons for FId_ComDetrmAirM" UWORD DINH_ct_Compu 1 100 -4095.000 4096.000 BIT_MASK 0x1fff FORMAT "%8.3" ECU_ADDRESS 0x600137E6 /end MEASUREMENT
/begin MEASUREMENT DINH_nrActvInhReas.FId_ComDwnShiftCtrlReq "Number of active inhibit reasons for the FIds / Number of active inhibit reasons for FId_ComDwnShiftCtrlReq" UWORD DINH_ct_Compu 1 100 -4095.000 4096.000 BIT_MASK 0x1fff FORMAT "%8.3" ECU_ADDRESS 0x600137E8 /end MEASUREMENT
/begin MEASUREMENT DINH_nrActvInhReas.FId_ComEAT1 "Number of active inhibit reasons for the FIds / Number of active inhibit reasons for FId_ComEAT1" UWORD DINH_ct_Compu 1 100 -4095.000 4096.000 BIT_MASK 0x1fff FORMAT "%8.3" ECU_ADDRESS 0x600137EA /end MEASUREMENT
/begin MEASUREMENT DINH_nrActvInhReas.FId_ComEAT10 "Number of active inhibit reasons for the FIds / Number of active inhibit reasons for FId_ComEAT10" UWORD DINH_ct_Compu 1 100 -4095.000 4096.000 BIT_MASK 0x1fff FORMAT "%8.3" ECU_ADDRESS 0x600137EC /end MEASUREMENT
/begin MEASUREMENT DINH_nrActvInhReas.FId_ComEAT10Mon "Number of active inhibit reasons for the FIds / Number of active inhibit reasons for FId_ComEAT10Mon" UWORD DINH_ct_Compu 1 100 -4095.000 4096.000 BIT_MASK 0x1fff FORMAT "%8.3" ECU_ADDRESS 0x600137EE /end MEASUREMENT
/begin MEASUREMENT DINH_nrActvInhReas.FId_ComEAT11 "Number of active inhibit reasons for the FIds / Number of active inhibit reasons for FId_ComEAT11" UWORD DINH_ct_Compu 1 100 -4095.000 4096.000 BIT_MASK 0x1fff FORMAT "%8.3" ECU_ADDRESS 0x600137F0 /end MEASUREMENT
/begin MEASUREMENT DINH_nrActvInhReas.FId_ComEAT11Mon "Number of active inhibit reasons for the FIds / Number of active inhibit reasons for FId_ComEAT11Mon" UWORD DINH_ct_Compu 1 100 -4095.000 4096.000 BIT_MASK 0x1fff FORMAT "%8.3" ECU_ADDRESS 0x600137F2 /end MEASUREMENT
/begin MEASUREMENT DINH_nrActvInhReas.FId_ComEAT12 "Number of active inhibit reasons for the FIds / Number of active inhibit reasons for FId_ComEAT12" UWORD DINH_ct_Compu 1 100 -4095.000 4096.000 BIT_MASK 0x1fff FORMAT "%8.3" ECU_ADDRESS 0x600137F4 /end MEASUREMENT
/begin MEASUREMENT DINH_nrActvInhReas.FId_ComEAT12Mon "Number of active inhibit reasons for the FIds / Number of active inhibit reasons for FId_ComEAT12Mon" UWORD DINH_ct_Compu 1 100 -4095.000 4096.000 BIT_MASK 0x1fff FORMAT "%8.3" ECU_ADDRESS 0x600137F6 /end MEASUREMENT
/begin MEASUREMENT DINH_nrActvInhReas.FId_ComEAT13 "Number of active inhibit reasons for the FIds / Number of active inhibit reasons for FId_ComEAT13" UWORD DINH_ct_Compu 1 100 -4095.000 4096.000 BIT_MASK 0x1fff FORMAT "%8.3" ECU_ADDRESS 0x600137F8 /end MEASUREMENT
/begin MEASUREMENT DINH_nrActvInhReas.FId_ComEAT13Mon "Number of active inhibit reasons for the FIds / Number of active inhibit reasons for FId_ComEAT13Mon" UWORD DINH_ct_Compu 1 100 -4095.000 4096.000 BIT_MASK 0x1fff FORMAT "%8.3" ECU_ADDRESS 0x600137FA /end MEASUREMENT
/begin MEASUREMENT DINH_nrActvInhReas.FId_ComEAT1Mon "Number of active inhibit reasons for the FIds / Number of active inhibit reasons for FId_ComEAT1Mon" UWORD DINH_ct_Compu 1 100 -4095.000 4096.000 BIT_MASK 0x1fff FORMAT "%8.3" ECU_ADDRESS 0x600137FC /end MEASUREMENT
/begin MEASUREMENT DINH_nrActvInhReas.FId_ComEAT2 "Number of active inhibit reasons for the FIds / Number of active inhibit reasons for FId_ComEAT2" UWORD DINH_ct_Compu 1 100 -4095.000 4096.000 BIT_MASK 0x1fff FORMAT "%8.3" ECU_ADDRESS 0x600137FE /end MEASUREMENT
/begin MEASUREMENT DINH_nrActvInhReas.FId_ComEAT2Mon "Number of active inhibit reasons for the FIds / Number of active inhibit reasons for FId_ComEAT2Mon" UWORD DINH_ct_Compu 1 100 -4095.000 4096.000 BIT_MASK 0x1fff FORMAT "%8.3" ECU_ADDRESS 0x60013800 /end MEASUREMENT
/begin MEASUREMENT DINH_nrActvInhReas.FId_ComEAT4 "Number of active inhibit reasons for the FIds / Number of active inhibit reasons for FId_ComEAT4" UWORD DINH_ct_Compu 1 100 -4095.000 4096.000 BIT_MASK 0x1fff FORMAT "%8.3" ECU_ADDRESS 0x60013802 /end MEASUREMENT
/begin MEASUREMENT DINH_nrActvInhReas.FId_ComEAT4Mon "Number of active inhibit reasons for the FIds / Number of active inhibit reasons for FId_ComEAT4Mon" UWORD DINH_ct_Compu 1 100 -4095.000 4096.000 BIT_MASK 0x1fff FORMAT "%8.3" ECU_ADDRESS 0x60013804 /end MEASUREMENT
/begin MEASUREMENT DINH_nrActvInhReas.FId_ComEAT6 "Number of active inhibit reasons for the FIds / Number of active inhibit reasons for FId_ComEAT6" UWORD DINH_ct_Compu 1 100 -4095.000 4096.000 BIT_MASK 0x1fff FORMAT "%8.3" ECU_ADDRESS 0x60013806 /end MEASUREMENT
/begin MEASUREMENT DINH_nrActvInhReas.FId_ComEAT6Mon "Number of active inhibit reasons for the FIds / Number of active inhibit reasons for FId_ComEAT6Mon" UWORD DINH_ct_Compu 1 100 -4095.000 4096.000 BIT_MASK 0x1fff FORMAT "%8.3" ECU_ADDRESS 0x60013808 /end MEASUREMENT
/begin MEASUREMENT DINH_nrActvInhReas.FId_ComEAT7 "Number of active inhibit reasons for the FIds / Number of active inhibit reasons for FId_ComEAT7" UWORD DINH_ct_Compu 1 100 -4095.000 4096.000 BIT_MASK 0x1fff FORMAT "%8.3" ECU_ADDRESS 0x6001380A /end MEASUREMENT
/begin MEASUREMENT DINH_nrActvInhReas.FId_ComEAT7Mon "Number of active inhibit reasons for the FIds / Number of active inhibit reasons for FId_ComEAT7Mon" UWORD DINH_ct_Compu 1 100 -4095.000 4096.000 BIT_MASK 0x1fff FORMAT "%8.3" ECU_ADDRESS 0x6001380C /end MEASUREMENT
/begin MEASUREMENT DINH_nrActvInhReas.FId_ComEAT8 "Number of active inhibit reasons for the FIds / Number of active inhibit reasons for FId_ComEAT8" UWORD DINH_ct_Compu 1 100 -4095.000 4096.000 BIT_MASK 0x1fff FORMAT "%8.3" ECU_ADDRESS 0x6001380E /end MEASUREMENT
/begin MEASUREMENT DINH_nrActvInhReas.FId_ComEAT8Mon "Number of active inhibit reasons for the FIds / Number of active inhibit reasons for FId_ComEAT8Mon" UWORD DINH_ct_Compu 1 100 -4095.000 4096.000 BIT_MASK 0x1fff FORMAT "%8.3" ECU_ADDRESS 0x60013810 /end MEASUREMENT
/begin MEASUREMENT DINH_nrActvInhReas.FId_ComEATA "Number of active inhibit reasons for the FIds / Number of active inhibit reasons for FId_ComEATA" UWORD DINH_ct_Compu 1 100 -4095.000 4096.000 BIT_MASK 0x1fff FORMAT "%8.3" ECU_ADDRESS 0x60013812 /end MEASUREMENT
/begin MEASUREMENT DINH_nrActvInhReas.FId_ComEATAMon "Number of active inhibit reasons for the FIds / Number of active inhibit reasons for FId_ComEATAMon" UWORD DINH_ct_Compu 1 100 -4095.000 4096.000 BIT_MASK 0x1fff FORMAT "%8.3" ECU_ADDRESS 0x60013814 /end MEASUREMENT
/begin MEASUREMENT DINH_nrActvInhReas.FId_ComEATB "Number of active inhibit reasons for the FIds / Number of active inhibit reasons for FId_ComEATB" UWORD DINH_ct_Compu 1 100 -4095.000 4096.000 BIT_MASK 0x1fff FORMAT "%8.3" ECU_ADDRESS 0x60013816 /end MEASUREMENT
/begin MEASUREMENT DINH_nrActvInhReas.FId_ComEATBMon "Number of active inhibit reasons for the FIds / Number of active inhibit reasons for FId_ComEATBMon" UWORD DINH_ct_Compu 1 100 -4095.000 4096.000 BIT_MASK 0x1fff FORMAT "%8.3" ECU_ADDRESS 0x60013818 /end MEASUREMENT
/begin MEASUREMENT DINH_nrActvInhReas.FId_ComEATC "Number of active inhibit reasons for the FIds / Number of active inhibit reasons for FId_ComEATC" UWORD DINH_ct_Compu 1 100 -4095.000 4096.000 BIT_MASK 0x1fff FORMAT "%8.3" ECU_ADDRESS 0x6001381A /end MEASUREMENT
/begin MEASUREMENT DINH_nrActvInhReas.FId_ComEATCMon "Number of active inhibit reasons for the FIds / Number of active inhibit reasons for FId_ComEATCMon" UWORD DINH_ct_Compu 1 100 -4095.000 4096.000 BIT_MASK 0x1fff FORMAT "%8.3" ECU_ADDRESS 0x6001381C /end MEASUREMENT
/begin MEASUREMENT DINH_nrActvInhReas.FId_ComEBSSelfDiagErr "Number of active inhibit reasons for the FIds / Number of active inhibit reasons for FId_ComEBSSelfDiagErr" UWORD DINH_ct_Compu 1 100 -4095.000 4096.000 BIT_MASK 0x1fff FORMAT "%8.3" ECU_ADDRESS 0x6001381E /end MEASUREMENT
/begin MEASUREMENT DINH_nrActvInhReas.FId_ComECUHwErr "Number of active inhibit reasons for the FIds / Number of active inhibit reasons for FId_ComECUHwErr" UWORD DINH_ct_Compu 1 100 -4095.000 4096.000 BIT_MASK 0x1fff FORMAT "%8.3" ECU_ADDRESS 0x60013820 /end MEASUREMENT
/begin MEASUREMENT DINH_nrActvInhReas.FId_ComEGRVlvErr "Number of active inhibit reasons for the FIds / Number of active inhibit reasons for FId_ComEGRVlvErr" UWORD DINH_ct_Compu 1 100 -4095.000 4096.000 BIT_MASK 0x1fff FORMAT "%8.3" ECU_ADDRESS 0x60013822 /end MEASUREMENT
/begin MEASUREMENT DINH_nrActvInhReas.FId_ComEMSIntAirTemp "Number of active inhibit reasons for the FIds / Number of active inhibit reasons for FId_ComEMSIntAirTemp" UWORD DINH_ct_Compu 1 100 -4095.000 4096.000 BIT_MASK 0x1fff FORMAT "%8.3" ECU_ADDRESS 0x60013824 /end MEASUREMENT
/begin MEASUREMENT DINH_nrActvInhReas.FId_ComEPB "Number of active inhibit reasons for the FIds / Number of active inhibit reasons for FId_ComEPB" UWORD DINH_ct_Compu 1 100 -4095.000 4096.000 BIT_MASK 0x1fff FORMAT "%8.3" ECU_ADDRESS 0x60013826 /end MEASUREMENT
/begin MEASUREMENT DINH_nrActvInhReas.FId_ComEPBB "Number of active inhibit reasons for the FIds / Number of active inhibit reasons for FId_ComEPBB" UWORD DINH_ct_Compu 1 100 -4095.000 4096.000 BIT_MASK 0x1fff FORMAT "%8.3" ECU_ADDRESS 0x60013828 /end MEASUREMENT
/begin MEASUREMENT DINH_nrActvInhReas.FId_ComEPBBMon "Number of active inhibit reasons for the FIds / Number of active inhibit reasons for FId_ComEPBBMon" UWORD DINH_ct_Compu 1 100 -4095.000 4096.000 BIT_MASK 0x1fff FORMAT "%8.3" ECU_ADDRESS 0x6001382A /end MEASUREMENT
/begin MEASUREMENT DINH_nrActvInhReas.FId_ComEPBMon "Number of active inhibit reasons for the FIds / Number of active inhibit reasons for FId_ComEPBMon" UWORD DINH_ct_Compu 1 100 -4095.000 4096.000 BIT_MASK 0x1fff FORMAT "%8.3" ECU_ADDRESS 0x6001382C /end MEASUREMENT
/begin MEASUREMENT DINH_nrActvInhReas.FId_ComEPS1 "Number of active inhibit reasons for the FIds / Number of active inhibit reasons for FId_ComEPS1" UWORD DINH_ct_Compu 1 100 -4095.000 4096.000 BIT_MASK 0x1fff FORMAT "%8.3" ECU_ADDRESS 0x6001382E /end MEASUREMENT
/begin MEASUREMENT DINH_nrActvInhReas.FId_ComEPS1Mon "Number of active inhibit reasons for the FIds / Number of active inhibit reasons for FId_ComEPS1Mon" UWORD DINH_ct_Compu 1 100 -4095.000 4096.000 BIT_MASK 0x1fff FORMAT "%8.3" ECU_ADDRESS 0x60013830 /end MEASUREMENT
/begin MEASUREMENT DINH_nrActvInhReas.FId_ComEPSUnitCfmdErr "Number of active inhibit reasons for the FIds / Number of active inhibit reasons for FId_ComEPSUnitCfmdErr" UWORD DINH_ct_Compu 1 100 -4095.000 4096.000 BIT_MASK 0x1fff FORMAT "%8.3" ECU_ADDRESS 0x60013832 /end MEASUREMENT
/begin MEASUREMENT DINH_nrActvInhReas.FId_ComEPSUnitNotTstd "Number of active inhibit reasons for the FIds / Number of active inhibit reasons for FId_ComEPSUnitNotTstd" UWORD DINH_ct_Compu 1 100 -4095.000 4096.000 BIT_MASK 0x1fff FORMAT "%8.3" ECU_ADDRESS 0x60013834 /end MEASUREMENT
/begin MEASUREMENT DINH_nrActvInhReas.FId_ComEngBrkOvrdInfo "Number of active inhibit reasons for the FIds / Number of active inhibit reasons for FId_ComEngBrkOvrdInfo" UWORD DINH_ct_Compu 1 100 -4095.000 4096.000 BIT_MASK 0x1fff FORMAT "%8.3" ECU_ADDRESS 0x60013836 /end MEASUREMENT
/begin MEASUREMENT DINH_nrActvInhReas.FId_ComEngBrkOvrdMtr "Number of active inhibit reasons for the FIds / Number of active inhibit reasons for FId_ComEngBrkOvrdMtr" UWORD DINH_ct_Compu 1 100 -4095.000 4096.000 BIT_MASK 0x1fff FORMAT "%8.3" ECU_ADDRESS 0x60013838 /end MEASUREMENT
/begin MEASUREMENT DINH_nrActvInhReas.FId_ComEngBrkSwErr "Number of active inhibit reasons for the FIds / Number of active inhibit reasons for FId_ComEngBrkSwErr" UWORD DINH_ct_Compu 1 100 -4095.000 4096.000 BIT_MASK 0x1fff FORMAT "%8.3" ECU_ADDRESS 0x6001383A /end MEASUREMENT
/begin MEASUREMENT DINH_nrActvInhReas.FId_ComEngPosng "Number of active inhibit reasons for the FIds / Number of active inhibit reasons for FId_ComEngPosng" UWORD DINH_ct_Compu 1 100 -4095.000 4096.000 BIT_MASK 0x1fff FORMAT "%8.3" ECU_ADDRESS 0x6001383C /end MEASUREMENT
/begin MEASUREMENT DINH_nrActvInhReas.FId_ComEngRPMLim "Number of active inhibit reasons for the FIds / Number of active inhibit reasons for FId_ComEngRPMLim" UWORD DINH_ct_Compu 1 100 -4095.000 4096.000 BIT_MASK 0x1fff FORMAT "%8.3" ECU_ADDRESS 0x6001383E /end MEASUREMENT
/begin MEASUREMENT DINH_nrActvInhReas.FId_ComEngTrqLim "Number of active inhibit reasons for the FIds / Number of active inhibit reasons for FId_ComEngTrqLim" UWORD DINH_ct_Compu 1 100 -4095.000 4096.000 BIT_MASK 0x1fff FORMAT "%8.3" ECU_ADDRESS 0x60013840 /end MEASUREMENT
/begin MEASUREMENT DINH_nrActvInhReas.FId_ComEnvtlAirPSnsrErr "Number of active inhibit reasons for the FIds / Number of active inhibit reasons for FId_ComEnvtlAirPSnsrErr" UWORD DINH_ct_Compu 1 100 -4095.000 4096.000 BIT_MASK 0x1fff FORMAT "%8.3" ECU_ADDRESS 0x60013842 /end MEASUREMENT
/begin MEASUREMENT DINH_nrActvInhReas.FId_ComEstmTqNormJdg "Number of active inhibit reasons for the FIds / Number of active inhibit reasons for FId_ComEstmTqNormJdg" UWORD DINH_ct_Compu 1 100 -4095.000 4096.000 BIT_MASK 0x1fff FORMAT "%8.3" ECU_ADDRESS 0x60013844 /end MEASUREMENT
/begin MEASUREMENT DINH_nrActvInhReas.FId_ComEthnlSErr "Number of active inhibit reasons for the FIds / Number of active inhibit reasons for FId_ComEthnlSErr" UWORD DINH_ct_Compu 1 100 -4095.000 4096.000 BIT_MASK 0x1fff FORMAT "%8.3" ECU_ADDRESS 0x60013846 /end MEASUREMENT
/begin MEASUREMENT DINH_nrActvInhReas.FId_ComFlSply "Number of active inhibit reasons for the FIds / Number of active inhibit reasons for FId_ComFlSply" UWORD DINH_ct_Compu 1 100 -4095.000 4096.000 BIT_MASK 0x1fff FORMAT "%8.3" ECU_ADDRESS 0x60013848 /end MEASUREMENT
/begin MEASUREMENT DINH_nrActvInhReas.FId_ComFuCnsBitDurgIdleStop "Number of active inhibit reasons for the FIds / Number of active inhibit reasons for FId_ComFuCnsBitDurgIdleStop" UWORD DINH_ct_Compu 1 100 -4095.000 4096.000 BIT_MASK 0x1fff FORMAT "%8.3" ECU_ADDRESS 0x6001384A /end MEASUREMENT
/begin MEASUREMENT DINH_nrActvInhReas.FId_ComGEVCntrl "Number of active inhibit reasons for the FIds / Number of active inhibit reasons for FId_ComGEVCntrl" UWORD DINH_ct_Compu 1 100 -4095.000 4096.000 BIT_MASK 0x1fff FORMAT "%8.3" ECU_ADDRESS 0x6001384C /end MEASUREMENT
/begin MEASUREMENT DINH_nrActvInhReas.FId_ComGbxNPosFail "Number of active inhibit reasons for the FIds / Number of active inhibit reasons for FId_ComGbxNPosFail" UWORD DINH_ct_Compu 1 100 -4095.000 4096.000 BIT_MASK 0x1fff FORMAT "%8.3" ECU_ADDRESS 0x6001384E /end MEASUREMENT
/begin MEASUREMENT DINH_nrActvInhReas.FId_ComGbxTemp "Number of active inhibit reasons for the FIds / Number of active inhibit reasons for FId_ComGbxTemp" UWORD DINH_ct_Compu 1 100 -4095.000 4096.000 BIT_MASK 0x1fff FORMAT "%8.3" ECU_ADDRESS 0x60013850 /end MEASUREMENT
/begin MEASUREMENT DINH_nrActvInhReas.FId_ComGwIMG1 "Number of active inhibit reasons for the FIds / Number of active inhibit reasons for FId_ComGwIMG1" UWORD DINH_ct_Compu 1 100 -4095.000 4096.000 BIT_MASK 0x1fff FORMAT "%8.3" ECU_ADDRESS 0x60013852 /end MEASUREMENT
/begin MEASUREMENT DINH_nrActvInhReas.FId_ComGwIMG1Mon "Number of active inhibit reasons for the FIds / Number of active inhibit reasons for FId_ComGwIMG1Mon" UWORD DINH_ct_Compu 1 100 -4095.000 4096.000 BIT_MASK 0x1fff FORMAT "%8.3" ECU_ADDRESS 0x60013854 /end MEASUREMENT
/begin MEASUREMENT DINH_nrActvInhReas.FId_ComGwIMG3 "Number of active inhibit reasons for the FIds / Number of active inhibit reasons for FId_ComGwIMG3" UWORD DINH_ct_Compu 1 100 -4095.000 4096.000 BIT_MASK 0x1fff FORMAT "%8.3" ECU_ADDRESS 0x60013856 /end MEASUREMENT
/begin MEASUREMENT DINH_nrActvInhReas.FId_ComGwIMG3Mon "Number of active inhibit reasons for the FIds / Number of active inhibit reasons for FId_ComGwIMG3Mon" UWORD DINH_ct_Compu 1 100 -4095.000 4096.000 BIT_MASK 0x1fff FORMAT "%8.3" ECU_ADDRESS 0x60013858 /end MEASUREMENT
/begin MEASUREMENT DINH_nrActvInhReas.FId_ComGwIMG4 "Number of active inhibit reasons for the FIds / Number of active inhibit reasons for FId_ComGwIMG4" UWORD DINH_ct_Compu 1 100 -4095.000 4096.000 BIT_MASK 0x1fff FORMAT "%8.3" ECU_ADDRESS 0x6001385A /end MEASUREMENT
/begin MEASUREMENT DINH_nrActvInhReas.FId_ComGwIMG4Mon "Number of active inhibit reasons for the FIds / Number of active inhibit reasons for FId_ComGwIMG4Mon" UWORD DINH_ct_Compu 1 100 -4095.000 4096.000 BIT_MASK 0x1fff FORMAT "%8.3" ECU_ADDRESS 0x6001385C /end MEASUREMENT
/begin MEASUREMENT DINH_nrActvInhReas.FId_ComGwIMG5 "Number of active inhibit reasons for the FIds / Number of active inhibit reasons for FId_ComGwIMG5" UWORD DINH_ct_Compu 1 100 -4095.000 4096.000 BIT_MASK 0x1fff FORMAT "%8.3" ECU_ADDRESS 0x6001385E /end MEASUREMENT
/begin MEASUREMENT DINH_nrActvInhReas.FId_ComGwIMG5Mon "Number of active inhibit reasons for the FIds / Number of active inhibit reasons for FId_ComGwIMG5Mon" UWORD DINH_ct_Compu 1 100 -4095.000 4096.000 BIT_MASK 0x1fff FORMAT "%8.3" ECU_ADDRESS 0x60013860 /end MEASUREMENT
/begin MEASUREMENT DINH_nrActvInhReas.FId_ComGwIMG6 "Number of active inhibit reasons for the FIds / Number of active inhibit reasons for FId_ComGwIMG6" UWORD DINH_ct_Compu 1 100 -4095.000 4096.000 BIT_MASK 0x1fff FORMAT "%8.3" ECU_ADDRESS 0x60013862 /end MEASUREMENT
/begin MEASUREMENT DINH_nrActvInhReas.FId_ComGwIMG6Mon "Number of active inhibit reasons for the FIds / Number of active inhibit reasons for FId_ComGwIMG6Mon" UWORD DINH_ct_Compu 1 100 -4095.000 4096.000 BIT_MASK 0x1fff FORMAT "%8.3" ECU_ADDRESS 0x60013864 /end MEASUREMENT
/begin MEASUREMENT DINH_nrActvInhReas.FId_ComHFMSnsrErr "Number of active inhibit reasons for the FIds / Number of active inhibit reasons for FId_ComHFMSnsrErr" UWORD DINH_ct_Compu 1 100 -4095.000 4096.000 BIT_MASK 0x1fff FORMAT "%8.3" ECU_ADDRESS 0x60013866 /end MEASUREMENT
/begin MEASUREMENT DINH_nrActvInhReas.FId_ComIDASB "Number of active inhibit reasons for the FIds / Number of active inhibit reasons for FId_ComIDASB" UWORD DINH_ct_Compu 1 100 -4095.000 4096.000 BIT_MASK 0x1fff FORMAT "%8.3" ECU_ADDRESS 0x60013868 /end MEASUREMENT
/begin MEASUREMENT DINH_nrActvInhReas.FId_ComIDASBMon "Number of active inhibit reasons for the FIds / Number of active inhibit reasons for FId_ComIDASBMon" UWORD DINH_ct_Compu 1 100 -4095.000 4096.000 BIT_MASK 0x1fff FORMAT "%8.3" ECU_ADDRESS 0x6001386A /end MEASUREMENT
/begin MEASUREMENT DINH_nrActvInhReas.FId_ComIDASBUnitCfmdErr "Number of active inhibit reasons for the FIds / Number of active inhibit reasons for FId_ComIDASBUnitCfmdErr" UWORD DINH_ct_Compu 1 100 -4095.000 4096.000 BIT_MASK 0x1fff FORMAT "%8.3" ECU_ADDRESS 0x6001386C /end MEASUREMENT
/begin MEASUREMENT DINH_nrActvInhReas.FId_ComIDASBUnitNotTstd "Number of active inhibit reasons for the FIds / Number of active inhibit reasons for FId_ComIDASBUnitNotTstd" UWORD DINH_ct_Compu 1 100 -4095.000 4096.000 BIT_MASK 0x1fff FORMAT "%8.3" ECU_ADDRESS 0x6001386E /end MEASUREMENT
/begin MEASUREMENT DINH_nrActvInhReas.FId_ComIDASEngFail "Number of active inhibit reasons for the FIds / Number of active inhibit reasons for FId_ComIDASEngFail" UWORD DINH_ct_Compu 1 100 -4095.000 4096.000 BIT_MASK 0x1fff FORMAT "%8.3" ECU_ADDRESS 0x60013870 /end MEASUREMENT
/begin MEASUREMENT DINH_nrActvInhReas.FId_ComIDASEngFailMil "Number of active inhibit reasons for the FIds / Number of active inhibit reasons for FId_ComIDASEngFailMil" UWORD DINH_ct_Compu 1 100 -4095.000 4096.000 BIT_MASK 0x1fff FORMAT "%8.3" ECU_ADDRESS 0x60013872 /end MEASUREMENT
/begin MEASUREMENT DINH_nrActvInhReas.FId_ComIMGUnitCfmdErr "Number of active inhibit reasons for the FIds / Number of active inhibit reasons for FId_ComIMGUnitCfmdErr" UWORD DINH_ct_Compu 1 100 -4095.000 4096.000 BIT_MASK 0x1fff FORMAT "%8.3" ECU_ADDRESS 0x60013874 /end MEASUREMENT
/begin MEASUREMENT DINH_nrActvInhReas.FId_ComIMGUnitNotTstd "Number of active inhibit reasons for the FIds / Number of active inhibit reasons for FId_ComIMGUnitNotTstd" UWORD DINH_ct_Compu 1 100 -4095.000 4096.000 BIT_MASK 0x1fff FORMAT "%8.3" ECU_ADDRESS 0x60013876 /end MEASUREMENT
/begin MEASUREMENT DINH_nrActvInhReas.FId_ComISG2 "Number of active inhibit reasons for the FIds / Number of active inhibit reasons for FId_ComISG2" UWORD DINH_ct_Compu 1 100 -4095.000 4096.000 BIT_MASK 0x1fff FORMAT "%8.3" ECU_ADDRESS 0x60013878 /end MEASUREMENT
/begin MEASUREMENT DINH_nrActvInhReas.FId_ComIgnCtrl "Number of active inhibit reasons for the FIds / Number of active inhibit reasons for FId_ComIgnCtrl" UWORD DINH_ct_Compu 1 100 -4095.000 4096.000 BIT_MASK 0x1fff FORMAT "%8.3" ECU_ADDRESS 0x6001387A /end MEASUREMENT
/begin MEASUREMENT DINH_nrActvInhReas.FId_ComInjCtrl "Number of active inhibit reasons for the FIds / Number of active inhibit reasons for FId_ComInjCtrl" UWORD DINH_ct_Compu 1 100 -4095.000 4096.000 BIT_MASK 0x1fff FORMAT "%8.3" ECU_ADDRESS 0x6001387C /end MEASUREMENT
/begin MEASUREMENT DINH_nrActvInhReas.FId_ComIntkAirPSnsrErr "Number of active inhibit reasons for the FIds / Number of active inhibit reasons for FId_ComIntkAirPSnsrErr" UWORD DINH_ct_Compu 1 100 -4095.000 4096.000 BIT_MASK 0x1fff FORMAT "%8.3" ECU_ADDRESS 0x6001387E /end MEASUREMENT
/begin MEASUREMENT DINH_nrActvInhReas.FId_ComLamCtrl "Number of active inhibit reasons for the FIds / Number of active inhibit reasons for FId_ComLamCtrl" UWORD DINH_ct_Compu 1 100 -4095.000 4096.000 BIT_MASK 0x1fff FORMAT "%8.3" ECU_ADDRESS 0x60013880 /end MEASUREMENT
/begin MEASUREMENT DINH_nrActvInhReas.FId_ComMETA "Number of active inhibit reasons for the FIds / Number of active inhibit reasons for FId_ComMETA" UWORD DINH_ct_Compu 1 100 -4095.000 4096.000 BIT_MASK 0x1fff FORMAT "%8.3" ECU_ADDRESS 0x60013882 /end MEASUREMENT
/begin MEASUREMENT DINH_nrActvInhReas.FId_ComMETAMon "Number of active inhibit reasons for the FIds / Number of active inhibit reasons for FId_ComMETAMon" UWORD DINH_ct_Compu 1 100 -4095.000 4096.000 BIT_MASK 0x1fff FORMAT "%8.3" ECU_ADDRESS 0x60013884 /end MEASUREMENT
/begin MEASUREMENT DINH_nrActvInhReas.FId_ComMETC "Number of active inhibit reasons for the FIds / Number of active inhibit reasons for FId_ComMETC" UWORD DINH_ct_Compu 1 100 -4095.000 4096.000 BIT_MASK 0x1fff FORMAT "%8.3" ECU_ADDRESS 0x60013886 /end MEASUREMENT
/begin MEASUREMENT DINH_nrActvInhReas.FId_ComMETCMon "Number of active inhibit reasons for the FIds / Number of active inhibit reasons for FId_ComMETCMon" UWORD DINH_ct_Compu 1 100 -4095.000 4096.000 BIT_MASK 0x1fff FORMAT "%8.3" ECU_ADDRESS 0x60013888 /end MEASUREMENT
/begin MEASUREMENT DINH_nrActvInhReas.FId_ComMETD "Number of active inhibit reasons for the FIds / Number of active inhibit reasons for FId_ComMETD" UWORD DINH_ct_Compu 1 100 -4095.000 4096.000 BIT_MASK 0x1fff FORMAT "%8.3" ECU_ADDRESS 0x6001388A /end MEASUREMENT
/begin MEASUREMENT DINH_nrActvInhReas.FId_ComMETDMon "Number of active inhibit reasons for the FIds / Number of active inhibit reasons for FId_ComMETDMon" UWORD DINH_ct_Compu 1 100 -4095.000 4096.000 BIT_MASK 0x1fff FORMAT "%8.3" ECU_ADDRESS 0x6001388C /end MEASUREMENT
/begin MEASUREMENT DINH_nrActvInhReas.FId_ComMETE2 "Number of active inhibit reasons for the FIds / Number of active inhibit reasons for FId_ComMETE2" UWORD DINH_ct_Compu 1 100 -4095.000 4096.000 BIT_MASK 0x1fff FORMAT "%8.3" ECU_ADDRESS 0x6001388E /end MEASUREMENT
/begin MEASUREMENT DINH_nrActvInhReas.FId_ComMETE2Mon "Number of active inhibit reasons for the FIds / Number of active inhibit reasons for FId_ComMETE2Mon" UWORD DINH_ct_Compu 1 100 -4095.000 4096.000 BIT_MASK 0x1fff FORMAT "%8.3" ECU_ADDRESS 0x60013890 /end MEASUREMENT
/begin MEASUREMENT DINH_nrActvInhReas.FId_ComMETF "Number of active inhibit reasons for the FIds / Number of active inhibit reasons for FId_ComMETF" UWORD DINH_ct_Compu 1 100 -4095.000 4096.000 BIT_MASK 0x1fff FORMAT "%8.3" ECU_ADDRESS 0x60013892 /end MEASUREMENT
/begin MEASUREMENT DINH_nrActvInhReas.FId_ComMETFMon "Number of active inhibit reasons for the FIds / Number of active inhibit reasons for FId_ComMETFMon" UWORD DINH_ct_Compu 1 100 -4095.000 4096.000 BIT_MASK 0x1fff FORMAT "%8.3" ECU_ADDRESS 0x60013894 /end MEASUREMENT
/begin MEASUREMENT DINH_nrActvInhReas.FId_ComMETG "Number of active inhibit reasons for the FIds / Number of active inhibit reasons for FId_ComMETG" UWORD DINH_ct_Compu 1 100 -4095.000 4096.000 BIT_MASK 0x1fff FORMAT "%8.3" ECU_ADDRESS 0x60013896 /end MEASUREMENT
/begin MEASUREMENT DINH_nrActvInhReas.FId_ComMETGMon "Number of active inhibit reasons for the FIds / Number of active inhibit reasons for FId_ComMETGMon" UWORD DINH_ct_Compu 1 100 -4095.000 4096.000 BIT_MASK 0x1fff FORMAT "%8.3" ECU_ADDRESS 0x60013898 /end MEASUREMENT
/begin MEASUREMENT DINH_nrActvInhReas.FId_ComMETH "Number of active inhibit reasons for the FIds / Number of active inhibit reasons for FId_ComMETH" UWORD DINH_ct_Compu 1 100 -4095.000 4096.000 BIT_MASK 0x1fff FORMAT "%8.3" ECU_ADDRESS 0x6001389A /end MEASUREMENT
/begin MEASUREMENT DINH_nrActvInhReas.FId_ComMETH2 "Number of active inhibit reasons for the FIds / Number of active inhibit reasons for FId_ComMETH2" UWORD DINH_ct_Compu 1 100 -4095.000 4096.000 BIT_MASK 0x1fff FORMAT "%8.3" ECU_ADDRESS 0x6001389C /end MEASUREMENT
/begin MEASUREMENT DINH_nrActvInhReas.FId_ComMETH2Mon "Number of active inhibit reasons for the FIds / Number of active inhibit reasons for FId_ComMETH2Mon" UWORD DINH_ct_Compu 1 100 -4095.000 4096.000 BIT_MASK 0x1fff FORMAT "%8.3" ECU_ADDRESS 0x6001389E /end MEASUREMENT
/begin MEASUREMENT DINH_nrActvInhReas.FId_ComMETHMon "Number of active inhibit reasons for the FIds / Number of active inhibit reasons for FId_ComMETHMon" UWORD DINH_ct_Compu 1 100 -4095.000 4096.000 BIT_MASK 0x1fff FORMAT "%8.3" ECU_ADDRESS 0x600138A0 /end MEASUREMENT
/begin MEASUREMENT DINH_nrActvInhReas.FId_ComMETI "Number of active inhibit reasons for the FIds / Number of active inhibit reasons for FId_ComMETI" UWORD DINH_ct_Compu 1 100 -4095.000 4096.000 BIT_MASK 0x1fff FORMAT "%8.3" ECU_ADDRESS 0x600138A2 /end MEASUREMENT
/begin MEASUREMENT DINH_nrActvInhReas.FId_ComMETIMon "Number of active inhibit reasons for the FIds / Number of active inhibit reasons for FId_ComMETIMon" UWORD DINH_ct_Compu 1 100 -4095.000 4096.000 BIT_MASK 0x1fff FORMAT "%8.3" ECU_ADDRESS 0x600138A4 /end MEASUREMENT
/begin MEASUREMENT DINH_nrActvInhReas.FId_ComMETK "Number of active inhibit reasons for the FIds / Number of active inhibit reasons for FId_ComMETK" UWORD DINH_ct_Compu 1 100 -4095.000 4096.000 BIT_MASK 0x1fff FORMAT "%8.3" ECU_ADDRESS 0x600138A6 /end MEASUREMENT
/begin MEASUREMENT DINH_nrActvInhReas.FId_ComMETKMon "Number of active inhibit reasons for the FIds / Number of active inhibit reasons for FId_ComMETKMon" UWORD DINH_ct_Compu 1 100 -4095.000 4096.000 BIT_MASK 0x1fff FORMAT "%8.3" ECU_ADDRESS 0x600138A8 /end MEASUREMENT
/begin MEASUREMENT DINH_nrActvInhReas.FId_ComMETL "Number of active inhibit reasons for the FIds / Number of active inhibit reasons for FId_ComMETL" UWORD DINH_ct_Compu 1 100 -4095.000 4096.000 BIT_MASK 0x1fff FORMAT "%8.3" ECU_ADDRESS 0x600138AA /end MEASUREMENT
/begin MEASUREMENT DINH_nrActvInhReas.FId_ComMETLMon "Number of active inhibit reasons for the FIds / Number of active inhibit reasons for FId_ComMETLMon" UWORD DINH_ct_Compu 1 100 -4095.000 4096.000 BIT_MASK 0x1fff FORMAT "%8.3" ECU_ADDRESS 0x600138AC /end MEASUREMENT
/begin MEASUREMENT DINH_nrActvInhReas.FId_ComMETM "Number of active inhibit reasons for the FIds / Number of active inhibit reasons for FId_ComMETM" UWORD DINH_ct_Compu 1 100 -4095.000 4096.000 BIT_MASK 0x1fff FORMAT "%8.3" ECU_ADDRESS 0x600138AE /end MEASUREMENT
/begin MEASUREMENT DINH_nrActvInhReas.FId_ComMETMMon "Number of active inhibit reasons for the FIds / Number of active inhibit reasons for FId_ComMETMMon" UWORD DINH_ct_Compu 1 100 -4095.000 4096.000 BIT_MASK 0x1fff FORMAT "%8.3" ECU_ADDRESS 0x600138B0 /end MEASUREMENT
/begin MEASUREMENT DINH_nrActvInhReas.FId_ComMETN "Number of active inhibit reasons for the FIds / Number of active inhibit reasons for FId_ComMETN" UWORD DINH_ct_Compu 1 100 -4095.000 4096.000 BIT_MASK 0x1fff FORMAT "%8.3" ECU_ADDRESS 0x600138B2 /end MEASUREMENT
/begin MEASUREMENT DINH_nrActvInhReas.FId_ComMETNMon "Number of active inhibit reasons for the FIds / Number of active inhibit reasons for FId_ComMETNMon" UWORD DINH_ct_Compu 1 100 -4095.000 4096.000 BIT_MASK 0x1fff FORMAT "%8.3" ECU_ADDRESS 0x600138B4 /end MEASUREMENT
/begin MEASUREMENT DINH_nrActvInhReas.FId_ComMETUnitCfmdErr "Number of active inhibit reasons for the FIds / Number of active inhibit reasons for FId_ComMETUnitCfmdErr" UWORD DINH_ct_Compu 1 100 -4095.000 4096.000 BIT_MASK 0x1fff FORMAT "%8.3" ECU_ADDRESS 0x600138B6 /end MEASUREMENT
/begin MEASUREMENT DINH_nrActvInhReas.FId_ComMETUnitNotTstd "Number of active inhibit reasons for the FIds / Number of active inhibit reasons for FId_ComMETUnitNotTstd" UWORD DINH_ct_Compu 1 100 -4095.000 4096.000 BIT_MASK 0x1fff FORMAT "%8.3" ECU_ADDRESS 0x600138B8 /end MEASUREMENT
/begin MEASUREMENT DINH_nrActvInhReas.FId_ComMisf "Number of active inhibit reasons for the FIds / Number of active inhibit reasons for FId_ComMisf" UWORD DINH_ct_Compu 1 100 -4095.000 4096.000 BIT_MASK 0x1fff FORMAT "%8.3" ECU_ADDRESS 0x600138BA /end MEASUREMENT
/begin MEASUREMENT DINH_nrActvInhReas.FId_ComMon "Number of active inhibit reasons for the FIds / Number of active inhibit reasons for FId_ComMon" UWORD DINH_ct_Compu 1 100 -4095.000 4096.000 BIT_MASK 0x1fff FORMAT "%8.3" ECU_ADDRESS 0x600138BC /end MEASUREMENT
/begin MEASUREMENT DINH_nrActvInhReas.FId_ComNTrbn "Number of active inhibit reasons for the FIds / Number of active inhibit reasons for FId_ComNTrbn" UWORD DINH_ct_Compu 1 100 -4095.000 4096.000 BIT_MASK 0x1fff FORMAT "%8.3" ECU_ADDRESS 0x600138BE /end MEASUREMENT
/begin MEASUREMENT DINH_nrActvInhReas.FId_ComODOff "Number of active inhibit reasons for the FIds / Number of active inhibit reasons for FId_ComODOff" UWORD DINH_ct_Compu 1 100 -4095.000 4096.000 BIT_MASK 0x1fff FORMAT "%8.3" ECU_ADDRESS 0x600138C0 /end MEASUREMENT
/begin MEASUREMENT DINH_nrActvInhReas.FId_ComOilLvlLamp "Number of active inhibit reasons for the FIds / Number of active inhibit reasons for FId_ComOilLvlLamp" UWORD DINH_ct_Compu 1 100 -4095.000 4096.000 BIT_MASK 0x1fff FORMAT "%8.3" ECU_ADDRESS 0x600138C2 /end MEASUREMENT
/begin MEASUREMENT DINH_nrActvInhReas.FId_ComOilPWarnLamp "Number of active inhibit reasons for the FIds / Number of active inhibit reasons for FId_ComOilPWarnLamp" UWORD DINH_ct_Compu 1 100 -4095.000 4096.000 BIT_MASK 0x1fff FORMAT "%8.3" ECU_ADDRESS 0x600138C4 /end MEASUREMENT
/begin MEASUREMENT DINH_nrActvInhReas.FId_ComPASensFail "Number of active inhibit reasons for the FIds / Number of active inhibit reasons for FId_ComPASensFail" UWORD DINH_ct_Compu 1 100 -4095.000 4096.000 BIT_MASK 0x1fff FORMAT "%8.3" ECU_ADDRESS 0x600138C6 /end MEASUREMENT
/begin MEASUREMENT DINH_stDFCPid41Di "Disable status of all DFCs for PID41 calculation due to service 07 visible faults." UWORD OneToOne 1 100 0.00 65535.00 FORMAT "%8.2" ARRAY_SIZE 57 ECU_ADDRESS 0x6000740A /end MEASUREMENT
/begin MEASUREMENT dplin_w "Change of Pressure deviation for linearisation check for tank leakage diagnosis" SWORD p_q0p00122 1 100 -40.00000 39.99878 FORMAT "%8.5" ECU_ADDRESS 0x60000FCA /end MEASUREMENT
/begin MEASUREMENT Dsteonv_msg "distance EONV result" SLONG Length 1 100 0.00 2147483647.00 FORMAT "%13.2" ECU_ADDRESS 0x600395D0 /end MEASUREMENT
/begin MEASUREMENT dtesktc_flgclr "Flag for setting the dsm clear condition for DTESKTC" UBYTE B_TRUE 1 100 0.00 1.00000000000 BIT_MASK 0x1 FORMAT "%13.11" ECU_ADDRESS 0x60000FC2 /end MEASUREMENT
/begin MEASUREMENT eonvabort_msg "Enumeration abort of EONV service test" UBYTE dez 1 100 0.00 255.0 FORMAT "%5.1" ECU_ADDRESS 0x6000141C /end MEASUREMENT
/begin MEASUREMENT eonvddr_w_msg "remaining drive distance to start service test" UWORD s_q0p1_km 1 100 0.00 6553.500 FORMAT "%8.3" ECU_ADDRESS 0x60001492 /end MEASUREMENT
/begin MEASUREMENT eonvdtko_w_msg "EONV value for distance travelled this key on" UWORD s_q1p3888_m 1 100 0.00 91020.83 FORMAT "%8.2" ECU_ADDRESS 0x60001490 /end MEASUREMENT
/begin MEASUREMENT eonvewma_w_msg "EWMA filtered value for 0.02 leak test" UWORD fak_uw_b2 1 100 0.00 1.999969 FORMAT "%8.6" ECU_ADDRESS 0x60039580 /end MEASUREMENT
/begin MEASUREMENT eonvewth_w_msg "0.020 EWMA threshold for EONV leak decision" UWORD fak_uw_b2 1 100 0.00 1.999969 FORMAT "%8.6" ECU_ADDRESS 0x6000148E /end MEASUREMENT
/begin MEASUREMENT eonvfd "number of 0.02"" EWMA filter test samples" UBYTE dez 1 100 0.00 255.0 FORMAT "%5.1" ECU_ADDRESS 0x60039439 /end MEASUREMENT
/begin MEASUREMENT eonvnr_w_msg "EONV normalized result" UWORD fak_uw_b2 1 100 0.00 1.999969 FORMAT "%8.6" ECU_ADDRESS 0x6000148C /end MEASUREMENT
/begin MEASUREMENT eonvresult_msg "engine off natural vacuum service bay test result" UBYTE dez 1 100 0.00 255.0 FORMAT "%5.1" ECU_ADDRESS 0x6000141B /end MEASUREMENT
/begin MEASUREMENT eonvrtr_w_msg "remaining motor run time to start service test" UWORD t_q0p1 1 100 0.00 6553.500 FORMAT "%8.3" ECU_ADDRESS 0x6000148A /end MEASUREMENT
/begin MEASUREMENT eonvsta_msg "indication if service test is accepted" UBYTE dez 1 100 0.00 255.0 FORMAT "%5.1" ECU_ADDRESS 0x6000141A /end MEASUREMENT
/begin MEASUREMENT eonvstdr_msg "denial reason for service test" UBYTE dez 1 100 0.00 255.0 FORMAT "%5.1" ECU_ADDRESS 0x60001419 /end MEASUREMENT
/begin MEASUREMENT eonvstmcp_msg "reason why service test malfunction codes present" UBYTE dez 1 100 0.00 255.0 FORMAT "%5.1" ECU_ADDRESS 0x60001418 /end MEASUREMENT
/begin MEASUREMENT Eonv_flgColdStrtVld "Cold start calculation is valid" UBYTE B_TRUE 1 100 0.00 1.00000000000 BIT_MASK 0x1 FORMAT "%13.11" ECU_ADDRESS 0x600001B6 /end MEASUREMENT
/begin MEASUREMENT Eonv_flgPEnvVld "Environmental pressure condition for EONV is valid" UBYTE B_TRUE 1 100 0.00 1.00000000000 BIT_MASK 0x1 FORMAT "%13.11" ECU_ADDRESS 0x600001B5 /end MEASUREMENT
/begin MEASUREMENT Eonv_pDifLeakErrWoEwma "pressure difference for leak decision between overpressure and vacuum phase, if EWMA filter is deactivated" SWORD p_q0p00122 1 100 -40.00000 39.99878 FORMAT "%8.5" ECU_ADDRESS 0x600014D8 /end MEASUREMENT
/begin MEASUREMENT Eonv_pThdErrWoEWMA "pressure threshold to detect a leak if EWMA filter is deactivated" SWORD p_q0p00122 1 100 -40.00000 39.99878 FORMAT "%8.5" ECU_ADDRESS 0x600014D6 /end MEASUREMENT
/begin MEASUREMENT Eonv_stLeakErrWoEwma "Error-Flag EONV, if EWMA filter is deactivated" UBYTE B_TRUE 1 100 0.00 1.00000000000 BIT_MASK 0x1 FORMAT "%13.11" ECU_ADDRESS 0x600001B4 /end MEASUREMENT
/begin MEASUREMENT Eonv_stRejDiagRes "Diagnosis is rejected, because with the measured pressure curve pattern, there is no selectivity between leak and tight system" UBYTE B_TRUE 1 100 0.00 1.00000000000 BIT_MASK 0x1 FORMAT "%13.11" ECU_ADDRESS 0x600001B3 /end MEASUREMENT
/begin MEASUREMENT Eonv_stRejDiagResActv "rejection of diagnosis because of the pressure curve pattern is activated" UBYTE B_TRUE 1 100 0.00 1.00000000000 BIT_MASK 0x1 FORMAT "%13.11" ECU_ADDRESS 0x70000989 /end MEASUREMENT
/begin MEASUREMENT Eonv_stRejDiagResSuspc "Suspicion in the overpressure phase for a pressure pattern, for which there is not enough selectivity between a leak and tight system" UBYTE B_TRUE 1 100 0.00 1.00000000000 BIT_MASK 0x1 FORMAT "%13.11" ECU_ADDRESS 0x600000F9 /end MEASUREMENT
/begin MEASUREMENT Eonv_tAmbAir "Ambient air temperature" UBYTE temp_ub_q0p75_o48 1 100 -48.0 143.3 FORMAT "%5.1" ECU_ADDRESS 0x60000FC0 /end MEASUREMENT
/begin MEASUREMENT evapesbts_msg "evaporative emissions service bay test status" UBYTE dez 1 100 0.00 255.0 FORMAT "%5.1" ECU_ADDRESS 0x60001417 /end MEASUREMENT
/begin MEASUREMENT frdter_w_msg "lambda control factor as reference value for CPV diagnosis" UWORD fak_uw_b2 1 100 0.00 1.999969 FORMAT "%8.6" ECU_ADDRESS 0x60001486 /end MEASUREMENT
/begin MEASUREMENT fstteonv_w "fuel level for EONV" UWORD vol_q0p1_l 1 100 0.00 6553.500 FORMAT "%8.3" ECU_ADDRESS 0x60000FBE /end MEASUREMENT
/begin MEASUREMENT fstttld_w_msg "fuel level calculated with tank leak diagnosis" UWORD vol_q0p1_l 1 100 0.00 6553.500 FORMAT "%8.3" ECU_ADDRESS 0x6000147E /end MEASUREMENT
/begin MEASUREMENT gkomp_w_msg "compensation gradient" UWORD pgrad_q2p38Em5 1 100 0.00 1.562476 FORMAT "%8.6" ECU_ADDRESS 0x6000146A /end MEASUREMENT
/begin MEASUREMENT gudab_w_msg "vacuum decay gradient" UWORD pgrad_q2p38Em5 1 100 0.00 1.562476 FORMAT "%8.6" ECU_ADDRESS 0x60001464 /end MEASUREMENT
/begin MEASUREMENT msnitld_w_msg "Integrated CPV - mass flow for tank leakage diagnosis" UWORD m_3p47222Em4_g 1 100 0.00 22.75521 FORMAT "%8.5" ECU_ADDRESS 0x60001454 /end MEASUREMENT
/begin MEASUREMENT msnstld_w_msg "requested mass flow through purge control valve for tank leakage diagnosis" UWORD m_uw_b25p6 1 100 0.00 25.59961 FORMAT "%8.5" ECU_ADDRESS 0x60001452 /end MEASUREMENT
/begin MEASUREMENT pdptedud_w_msg "Modelled value of environment temperature" SWORD p_q0p00122 1 100 -40.00000 39.99878 FORMAT "%8.5" ECU_ADDRESS 0x600014CA /end MEASUREMENT
/begin MEASUREMENT peonvpp_w "EONV pressure maximum" SWORD p_q0p00122 1 100 -40.00000 39.99878 FORMAT "%8.5" ECU_ADDRESS 0x60000FBC /end MEASUREMENT
/begin MEASUREMENT peonvpt_w "pressure threshold attainable only by system with leak less than 0.020""" SWORD p_q0p00122 1 100 -40.00000 39.99878 FORMAT "%8.5" ECU_ADDRESS 0x60000FBA /end MEASUREMENT
/begin MEASUREMENT peonvvp_w "EONV pressure minimum" SWORD p_q0p00122 1 100 -40.00000 39.99878 FORMAT "%8.5" ECU_ADDRESS 0x60000FB8 /end MEASUREMENT
/begin MEASUREMENT peonvvt_w "EONV vacuum threshold for phase 2" SWORD p_q0p00122 1 100 -40.00000 39.99878 FORMAT "%8.5" ECU_ADDRESS 0x60000FB6 /end MEASUREMENT
/begin MEASUREMENT ptebprct_w "band pass filtered rectified tank pressure signal for slosh detection" UWORD p_q0p00122 1 100 0.00 79.99878 FORMAT "%8.5" ECU_ADDRESS 0x60000FA8 /end MEASUREMENT
/begin MEASUREMENT ptebp_w "band pass filtered tank pressure signal for refuelling or cap opening detection" SWORD p_q0p00122 1 100 -40.00000 39.99878 FORMAT "%8.5" ECU_ADDRESS 0x60000FA6 /end MEASUREMENT
/begin MEASUREMENT ptetp_w_msg "Filtered tank pressure (16 Bit) for DTESK" SWORD p_q0p00122 1 100 -40.00000 39.99878 FORMAT "%8.5" ECU_ADDRESS 0x600014BC /end MEASUREMENT
/begin MEASUREMENT pttpstrt_w "start pressure for TLD : DTESK" SWORD p_q0p00122 1 100 -40.00000 39.99878 FORMAT "%8.5" ECU_ADDRESS 0x60000FC8 /end MEASUREMENT
/begin MEASUREMENT pttp_w_msg "lowpass filtered tank pressure" SWORD p_q0p00122 1 100 -40.00000 39.99878 FORMAT "%8.5" ECU_ADDRESS 0x60001628 /end MEASUREMENT
/begin MEASUREMENT pttr_w_msg "reference value of differential tank pressure" SWORD p_q0p00122 1 100 -40.00000 39.99878 FORMAT "%8.5" ECU_ADDRESS 0x600014BA /end MEASUREMENT
/begin MEASUREMENT ptvfstrt_w "start pressure for TLD : DEONV" SWORD p_q0p00122 1 100 -40.00000 39.99878 FORMAT "%8.5" ECU_ADDRESS 0x60000FA4 /end MEASUREMENT
/begin MEASUREMENT ptvf_w_msg "tank pressure filtered" SWORD p_q0p00122 1 100 -40.00000 39.99878 FORMAT "%8.5" ECU_ADDRESS 0x600014B8 /end MEASUREMENT
/begin MEASUREMENT PurgLeakDiag_facEonvSngNrmRes "EONV single normalised result" UWORD fak_uw_b2 1 100 0.00 1.999969 FORMAT "%8.6" ECU_ADDRESS 0x60039450 /end MEASUREMENT
/begin MEASUREMENT PurgLeakDiag_flgCycCpvStuckClsdChk "Cycle flag for CPV stuck closed check completed" UBYTE B_TRUE 1 100 0.00 1.00000000000 BIT_MASK 0x1 FORMAT "%13.11" ECU_ADDRESS 0x60001395 /end MEASUREMENT
/begin MEASUREMENT PurgLeakDiag_flgCycCpvStuckOpenChk "Cycle flag for CPV stuck open check completed" UBYTE B_TRUE 1 100 0.00 1.00000000000 BIT_MASK 0x1 FORMAT "%13.11" ECU_ADDRESS 0x60001394 /end MEASUREMENT
/begin MEASUREMENT PurgLeakDiag_flgDiagBlkdLineActv "blocked line diagnosis is calibrated to active" UBYTE B_TRUE 1 100 0.00 1.00000000000 BIT_MASK 0x1 FORMAT "%13.11" ECU_ADDRESS 0x6000EE1D /end MEASUREMENT
/begin MEASUREMENT PurgLeakDiag_flgDiagBlkdLineCyc "Cycle flag of the blocked line error of a blocked line between tank and active carbon canister" UBYTE B_TRUE 1 100 0.00 1.00000000000 BIT_MASK 0x1 FORMAT "%13.11" ECU_ADDRESS 0x6000EE1C /end MEASUREMENT
/begin MEASUREMENT PurgLeakDiag_flgDiagBlkdLineErr "Error flag of the blocked line error of a blocked line between tank and active carbon canister" UBYTE B_TRUE 1 100 0.00 1.00000000000 BIT_MASK 0x1 FORMAT "%13.11" ECU_ADDRESS 0x6000EE1B /end MEASUREMENT
/begin MEASUREMENT PurgLeakDiag_flgDteskTstrReq "condition service function request for 2.3mm leak diagnosis at EOL" UBYTE B_TRUE 1 100 0.00 1.00000000000 BIT_MASK 0x1 FORMAT "%13.11" ECU_ADDRESS 0x60001393 /end MEASUREMENT
/begin MEASUREMENT PurgLeakDiag_flgEonvDiagEnad "EONV diagnosis enabled" UBYTE B_TRUE 1 100 0.00 1.00000000000 BIT_MASK 0x1 FORMAT "%13.11" ECU_ADDRESS 0x600000F6 /end MEASUREMENT
/begin MEASUREMENT PurgLeakDiag_lenDstDrvnBfrStrtEonv "Distance driven by vehiucle before start of EONV diagnosis" SLONG Length 1 100 -2147483648.00 2147483647.00 FORMAT "%13.2" ECU_ADDRESS 0x6003944C /end MEASUREMENT
/begin MEASUREMENT PurgLeakDiag_mfDifGasCapChk "massflow difference from threshold during gas cap check" UWORD m_3p47222Em4_g 1 100 0.00 22.75521 FORMAT "%8.5" ECU_ADDRESS 0x60039454 /end MEASUREMENT
/begin MEASUREMENT PurgLeakDiag_mfDifLrgLeakChk "massfflow difference from threshold during large leak check" UWORD m_3p47222Em4_g 1 100 0.00 22.75521 FORMAT "%8.5" ECU_ADDRESS 0x60039452 /end MEASUREMENT
/begin MEASUREMENT PurgLeakDiag_mIntglMfDiagBlkdLine "Integrated Massflow over the CPV during vacuum build up of DTESK for the blocked line diagnosis" UWORD m_3p47222Em4_g 1 100 0.00 22.75521 FORMAT "%8.5" ECU_ADDRESS 0x6000747C /end MEASUREMENT
/begin MEASUREMENT PurgLeakDiag_nrEonvDiagResAvl "Number of EONV diagnosis results available" UWORD OneToOne 1 100 0.00 65535.00 FORMAT "%8.2" ECU_ADDRESS 0x6003944A /end MEASUREMENT
/begin MEASUREMENT PurgLeakDiag_pPPhaEonv "Pressure during pressure phase of EONV" SWORD p_q0p00122 1 100 -40.00000 39.99878 FORMAT "%8.5" ECU_ADDRESS 0x60039448 /end MEASUREMENT
/begin MEASUREMENT PurgLeakDiag_pVacPhaEonv "Pressure during vaccum phase of EONV" SWORD p_q0p00122 1 100 -40.00000 39.99878 FORMAT "%8.5" ECU_ADDRESS 0x60039446 /end MEASUREMENT
/begin MEASUREMENT PurgLeakDiag_stDteskDetdOkSys "flag to indicate that DTESK detected an OK system" UBYTE B_TRUE 1 100 0.00 1.00000000000 BIT_MASK 0x1 FORMAT "%13.11" ECU_ADDRESS 0x600000F5 /end MEASUREMENT
/begin MEASUREMENT PurgLeakDiag_stEonvAbortReas "abort reasons for EONV diagnosis" UBYTE OneToOne 1 100 0.00 255.0 FORMAT "%5.1" ECU_ADDRESS 0x60039438 /end MEASUREMENT
/begin MEASUREMENT PurgLeakDiag_stEonvDiagRes "Status of current EONV diagnosis result" UBYTE B_TRUE 1 100 0.00 1.00000000000 BIT_MASK 0x1 FORMAT "%13.11" ECU_ADDRESS 0x60036DE3 /end MEASUREMENT
/begin MEASUREMENT PurgLeakDiag_stEonvDiagStopd "flag to indiacte EONV diagnosis has stopped" UBYTE B_TRUE 1 100 0.00 1.00000000000 BIT_MASK 0x1 FORMAT "%13.11" ECU_ADDRESS 0x600000F4 /end MEASUREMENT
/begin MEASUREMENT PurgLeakDiag_stEonvInhbnReas "inhibition reasons for EONV diagnosis" UBYTE OneToOne 1 100 0.00 255.0 FORMAT "%5.1" ECU_ADDRESS 0x60039437 /end MEASUREMENT
/begin MEASUREMENT PurgLeakDiag_tAmbTStrtEonv "Ambient temperature at start of EONV diagnosis" SWORD Temp_Cels 1 100 -3549.940 3003.560 FORMAT "%8.3" ECU_ADDRESS 0x60039444 /end MEASUREMENT
/begin MEASUREMENT PurgLeakDiag_tiPPhaEonv "Time for pressure phase of EONV" UWORD t_q0p1 1 100 0.00 6553.500 FORMAT "%8.3" ECU_ADDRESS 0x60039442 /end MEASUREMENT
/begin MEASUREMENT PurgLeakDiag_tiVapPhaEonv "Tiem for vacuum phase of EONV" UWORD t_q0p1 1 100 0.00 6553.500 FORMAT "%8.3" ECU_ADDRESS 0x60039440 /end MEASUREMENT
/begin MEASUREMENT PurgLeakDiag_volDiagBlkdLine "Calculated free gas valume of the EVAP system for the blocked line diagnosis" UWORD vol_q0p01_l 1 100 0.00 655.3500 FORMAT "%8.4" ECU_ADDRESS 0x600085A4 /end MEASUREMENT
/begin MEASUREMENT PurgLeakDiag_volFuLvlStrtEonv "Fuel LEvel at start of EONV diagnosis" UWORD vol_q0p1_l 1 100 0.00 6553.500 FORMAT "%8.3" ECU_ADDRESS 0x6003943E /end MEASUREMENT
/begin MEASUREMENT seonvcts "state number of the EONV state machine" UBYTE dez 1 100 0.00 255.0 FORMAT "%5.1" ECU_ADDRESS 0x60000FAA /end MEASUREMENT
/begin MEASUREMENT stptldab_msg "function state counter abort reason for tank leak diagnosis for tester" UBYTE dez 1 100 0.00 255.0 FORMAT "%5.1" ECU_ADDRESS 0x60039560 /end MEASUREMENT
/begin MEASUREMENT stptld_msg "function state counter tank leak diagnosis for tester" UBYTE dez 1 100 0.00 255.0 FORMAT "%5.1" ECU_ADDRESS 0x60039561 /end MEASUREMENT
/begin MEASUREMENT tdtedp "time for miscellaneous measurements" UBYTE t_q0p1 1 100 0.00 25.50 FORMAT "%5.2" ECU_ADDRESS 0x60000FC7 /end MEASUREMENT
/begin MEASUREMENT tdtedppr_msg "Check-time for miscellaneous measurements" UBYTE t_q0p1 1 100 0.00 25.50 FORMAT "%5.2" ECU_ADDRESS 0x6000140D /end MEASUREMENT
/begin MEASUREMENT tdtedps "time for spezial miscellaneous measurements" UBYTE t_q0p1 1 100 0.00 25.50 FORMAT "%5.2" ECU_ADDRESS 0x60000FC6 /end MEASUREMENT
/begin MEASUREMENT teonvv "timer for EONV phase 1 vacuum build" UBYTE t_q0p1 1 100 0.00 25.50 FORMAT "%5.2" ECU_ADDRESS 0x60000FB4 /end MEASUREMENT
/begin MEASUREMENT teonvzer_w "timer for EONV pressure stabilization at zero" UWORD t_q0p1 1 100 0.00 6553.500 FORMAT "%8.3" ECU_ADDRESS 0x60000FB2 /end MEASUREMENT
/begin MEASUREMENT ttldfrr "Time counter for setting of B_tldfrr" UBYTE t_q0p1 1 100 0.00 25.50 FORMAT "%5.2" ECU_ADDRESS 0x60000FC5 /end MEASUREMENT
/begin MEASUREMENT VehMot_rTrqDfftl "Torque ratio of differential" SWORD TransR 1 100 -327.6800 327.6700 FORMAT "%8.4" ECU_ADDRESS 0x60008DDC /end MEASUREMENT
/begin MEASUREMENT VehMot_tqCluDftlProtn "Differential protection torque at clutch level" SWORD Trq 1 100 -3276.800 3276.700 FORMAT "%8.3" ECU_ADDRESS 0x60008DD6 /end MEASUREMENT
/begin MEASUREMENT VehMot_trqPrtDfftl "Differential protection torque" SLONG TrqPrpHigh 1 100 -214748364.800 214748364.700 FORMAT "%13.3" ECU_ADDRESS 0x50004FF8 /end MEASUREMENT
/begin MEASUREMENT zadiagpr_msg "state pointer for check state of Mode06" UBYTE dez 1 100 0.00 255.0 FORMAT "%5.1" ECU_ADDRESS 0x60001404 /end MEASUREMENT
/begin MEASUREMENT zadiag_msg "pointer for TLD processing" UBYTE dez 1 100 0.00 255.0 FORMAT "%5.1" ECU_ADDRESS 0x60001405 /end MEASUREMENT
/begin FUNCTION DiagLeakDtesk_StMac "30201.1.0 Tank leak diagnosis DTESK state machine"
 /begin DEF_CHARACTERISTIC CWDTESKZA DDPTEAR DDPTEDT05 DDPTEKU DMSNSTLD DPDELTA DPDTED DPKOND DPLINMX DPTEDSCH DPTLDDU DTESKZA_GKTEDKX05_CUR DTESKZA_LimpGKTEDKX05_C FSTTTLD GKTEDKXFA GKTEDKXFAG KLDPENVTDUD KLFSTTEWM KLMSSTLD KLTCENGDSTGK05 KLTMSTVDDMX05 MSIDST MSNTVMX05 MSTLDTC PTEDE PurgeLeakDiag_mfIntegdCpv_C PurgLeakDiag_facIncCpvMf_T PurgLeakDiag_mfMinIntegdVacPha_T PurgLeakDiag_ThdTarPEOL_M PurgLeakDiag_ThdTarP_M PurgLeakDiag_volDiagBlkdLineErrThd_C TDTED TDTLIN TPTEE05 TPTEEBMX TTEDWD05 TTEDWU TTLDFRRS TTLDFRRW TVAAV05 ZKMSNTLD /end DEF_CHARACTERISTIC
 /begin IN_MEASUREMENT aktlauf_msg B_dte_msg B_fatld05_msg B_fatldeg_msg B_fsttldv_msg CEngDsT_tStrt CstrPurg_mfCpvDteskBlkdLine Eep_EnvRamHist Eep_EnvRamInvld EnvT_t frm_w_msg fstt_w_msg mstedte_w_msg PEnv_p pttp_w_msg SyC_stSub tumg_msg /end IN_MEASUREMENT
 /begin OUT_MEASUREMENT aktend_msg B_abbrtld_msg B_dteaav_msg B_dtefrr_msg B_eaav_msg B_etesgg_msg B_etvtldmn_msg B_etvtldmx_msg B_iatlddu_msg B_iatldha_msg B_iatldko_msg B_iatldms_msg B_iatldpt_msg B_ptfslo_msg B_tldav_msg B_tldto_msg B_zaav_msg B_ztesgg_msg B_ztevtld_msg ddpterl_w_msg frdter_w_msg fstttld_w_msg gkomp_w_msg gudab_w_msg msnitld_w_msg msnstld_w_msg pdptedud_w_msg pttr_w_msg PurgLeakDiag_flgCycCpvStuckClsdChk PurgLeakDiag_flgCycCpvStuckOpenChk PurgLeakDiag_flgDiagBlkdLineActv PurgLeakDiag_flgDiagBlkdLineCyc PurgLeakDiag_flgDiagBlkdLineErr PurgLeakDiag_mIntglMfDiagBlkdLine PurgLeakDiag_volDiagBlkdLine tdtedppr_msg zadiagpr_msg zadiag_msg /end OUT_MEASUREMENT
 /begin LOC_MEASUREMENT dplin_w pttpstrt_w PurgLeakDiag_mfDifGasCapChk PurgLeakDiag_mfDifLrgLeakChk tdtedp tdtedps ttldfrr /end LOC_MEASUREMENT
 FUNCTION_VERSION "30201.1.0" /end FUNCTION
/begin FUNCTION DiagLeakDtesk_Tstr "30201.3.0 Tank leak diagnosis DTESK tester output" /begin DEF_CHARACTERISTIC CWDTESKTC TEFABE TFATLDMX TFATLDMXEOL TSTPTLD /end DEF_CHARACTERISTIC
 /begin IN_MEASUREMENT aktlauf_msg B_cddtesk_msg B_dtetk_msg B_eaav_msg B_etesf_msg B_etesgg_msg B_etesk_msg B_etvtldmn_msg B_etvtldmx_msg B_faeonvdt_msg B_fatlde_msg B_fatlds_msg B_iatlddu_msg B_iatldha_msg B_iatldko_msg B_iatldms_msg B_iatldpt_msg B_m8te_msg B_punxc_msg B_tldhb05_msg B_tldpsd_msg B_tldres_msg B_tldstnai_msg B_tldstpt_msg B_tldstub_msg B_zdstof_msg B_ztesf_msg B_ztesk_msg Epm_stSpd reqdtesk_msg SyC_stSub top_w_msg /end IN_MEASUREMENT
 /begin OUT_MEASUREMENT B_fadstof_msg B_fatld05_msg PurgLeakDiag_flgDteskTstrReq stptldab_msg stptld_msg /end OUT_MEASUREMENT
 /begin LOC_MEASUREMENT B_sfatlde B_sm8te dtesktc_flgclr /end LOC_MEASUREMENT
 FUNCTION_VERSION "30201.3.0" /end FUNCTION
/begin FUNCTION DiagLeakEonv_Alg "30201.0.0 Tank leak diagnosis EONV algorithm"
 /begin DEF_CHARACTERISTIC APRBVACP EONVFST EONVSRS Eonv_pPeakMaxRejSuspc_M Eonv_pPeakMinRejSuspc_M Eonv_pThdErrWoEWMA_M Eonv_stAlg_C KFEONVPT PEONVDFP PEONVPZERO PPRBMX PVACBMN TDIAGMX TEONVDFP TEONVST TEONVVACBP TPMMX /end DEF_CHARACTERISTIC
 /begin IN_MEASUREMENT B_cdeonv_msg B_fsttldv_msg B_ppheonv_msg B_runeonv_msg B_vpheonv_msg Eep_EnvRamHist Eep_EnvRamInvld EnvT_t fstt_w_msg GlbDa_lTotDst ptvf_w_msg SyC_stSub tnachl_w_msg tumg_msg /end IN_MEASUREMENT
 /begin OUT_MEASUREMENT B_feonv_msg B_occveonv_msg B_pphfeonv_msg B_vphseonv_msg eonvnr_w_msg Eonv_pDifLeakErrWoEwma Eonv_pThdErrWoEWMA Eonv_stLeakErrWoEwma Eonv_stRejDiagRes Eonv_stRejDiagResActv /end OUT_MEASUREMENT
 /begin LOC_MEASUREMENT cccvoeonv Eonv_stRejDiagResSuspc Eonv_tAmbAir fstteonv_w peonvpp_w peonvpt_w peonvvp_w peonvvt_w PurgLeakDiag_facEonvSngNrmRes PurgLeakDiag_lenDstDrvnBfrStrtEonv PurgLeakDiag_nrEonvDiagResAvl PurgLeakDiag_pPPhaEonv PurgLeakDiag_pVacPhaEonv PurgLeakDiag_stEonvDiagRes PurgLeakDiag_tAmbTStrtEonv PurgLeakDiag_tiPPhaEonv PurgLeakDiag_tiVapPhaEonv PurgLeakDiag_volFuLvlStrtEonv teonvv teonvzer_w /end LOC_MEASUREMENT
 FUNCTION_VERSION "30201.0.0" /end FUNCTION
/begin FUNCTION DiagLeakEonv_Dsm "30201.1.0 Tank leak diagnosis EONV DSM"
 /begin DEF_CHARACTERISTIC CWEONVIR EONVEFC EONVEFS EONVEFT EONVENFC EONVENFT EONVETSP EONVSTFT TDTLDFSTVE /end DEF_CHARACTERISTIC
 /begin REF_CHARACTERISTIC TDIAGMX /end REF_CHARACTERISTIC
 /begin IN_MEASUREMENT B_cdeonv_msg B_eonvab_msg B_etesk_msg B_eveonvac_msg B_eveonvoc_msg B_faeonv_msg B_feonv_msg B_fsttldv_msg B_nachl_msg B_nvdicscm_msg B_tankg_msg B_tank_msg B_tesfmilerr_msg B_tesfmil_msg B_tesgmilerr_msg B_tesgmil_msg B_ztesk_msg eonvnr_w_msg Eonv_flgColdStrtVld Eonv_flgPEnvVld Eonv_pDifLeakErrWoEwma Eonv_pThdErrWoEWMA Eonv_stLeakErrWoEwma Eonv_stRejDiagResActv GlbDa_lTotDst SyC_stSub tengszlst_msg tengsz_w_msg /end IN_MEASUREMENT
 /begin OUT_MEASUREMENT B_dsteonvfcl_msg B_eeonv_msg B_endeonv_msg B_eonirn_msg B_eonvmil_msg B_eonvrssf_msg B_zeonv_msg Dsteonv_msg eonvewma_w_msg eonvewth_w_msg /end OUT_MEASUREMENT
 /begin LOC_MEASUREMENT B_eeonvld B_eonperlk B_eonperno B_infoEONVmax DEONVDFP_flgRstDsm eonvfd /end LOC_MEASUREMENT
 FUNCTION_VERSION "30201.1.0" /end FUNCTION
/begin FUNCTION DiagLeakEonv_EnaCdn "30201.0.0 Tank leak diagnosis EONV enable conditions"
 /begin DEF_CHARACTERISTIC CWEONV EONVDKMN PUEONVMN PurgLeakDiag_facEthMaxEonv_C PurgLeakDiag_flgDlyEonvEngOff_C PurgLeakDiag_tiDlyEonvDiag_T SFEONVA SFEONVAR TCOOLMN TDIFEONVMX TEONVAMN TEONVAMX TEONVCSMX TERMN TMSEONVMX TTLDVNL TTLDVNLST TWDTESKF TWEONVHCLR UBEONVMN VHDISTMN /end DEF_CHARACTERISTIC
 /begin IN_MEASUREMENT aktlauf_msg BattU_u B_cdeonv_msg B_dtetk_msg B_endeonv_msg B_fstdmn_msg B_fstdmx_msg B_fsttldv_msg B_nachl_msg B_sbteonva_msg B_tldpsd_msg B_tumgg_msg CEngDsT_tStop CEngDsT_tStrtFrst Eep_EnvRamHist Eep_EnvRamInvld EngStrt_bFrstStrtEnd EnvT_t Eonv_stRejDiagRes Eonv_stRejDiagResActv Epm_stSpd fethev_w_msg ftead_w_msg GlbDa_lDstVeh PEnv_p SyC_stSub tengszlst_msg tengsz_w_msg TiEngOff_ti tnachl_w_msg tnsez_w_msg VehV_v /end IN_MEASUREMENT
 /begin OUT_MEASUREMENT B_eonvab_msg B_eonvnerr_msg B_eveonvac_msg B_eveonvoc_msg B_nldte_msg B_nvdicscm_msg B_runeonv_msg B_ubeonva_msg eonvdtko_w_msg Eonv_flgColdStrtVld Eonv_flgPEnvVld /end OUT_MEASUREMENT
 /begin LOC_MEASUREMENT B_rqeonv B_tldtehcl DEONVEB_flgRstDsm DEONVEB_pEnvP DEONVEB_tCEngDstStop DEONVEB_tCEngDsTStrtFrst DEONVEB_tEnvT DEONVEB_uBatt PurgLeakDiag_flgEonvDiagEnad PurgLeakDiag_stDteskDetdOkSys PurgLeakDiag_stEonvAbortReas PurgLeakDiag_stEonvDiagStopd PurgLeakDiag_stEonvInhbnReas /end LOC_MEASUREMENT
 FUNCTION_VERSION "30201.0.0" /end FUNCTION
/begin FUNCTION DiagLeakEonv_StMac "30201.0.0 Tank leak diagnosis EONV state machine" /begin DEF_CHARACTERISTIC TBPVACMN TOCVVACP /end DEF_CHARACTERISTIC
 /begin IN_MEASUREMENT B_feonv_msg B_occveonv_msg B_pphfeonv_msg B_runeonv_msg B_vphseonv_msg SyC_stSub /end IN_MEASUREMENT
 /begin OUT_MEASUREMENT B_ccveonv_msg B_ppheonv_msg B_vpheonv_msg /end OUT_MEASUREMENT
 /begin LOC_MEASUREMENT seonvcts /end LOC_MEASUREMENT
 FUNCTION_VERSION "30201.0.0" /end FUNCTION
/begin FUNCTION DiagLeakEonv_Tstr "30201.0.0 Tank leak diagnosis EONV tester output"
 /begin DEF_CHARACTERISTIC CWDEONVTC SEONVDISMN TEONVAHMN TEONVAHMX TEONVERTMN TMSEONVTMX /end DEF_CHARACTERISTIC
 /begin REF_CHARACTERISTIC TEONVAMN TEONVAMX /end REF_CHARACTERISTIC
 /begin IN_MEASUREMENT B_cddtesk_msg B_cdeonv_msg B_dtetk_msg B_dte_msg B_eeonv_msg B_endeonv_msg B_endtesk_msg B_eonvnerr_msg B_etesk_msg B_faeonv_msg B_fstdmn_msg B_fstdmx_msg B_kl15_msg B_nvdicscm_msg B_runeonv_msg B_tldpsd_msg B_ubeonva_msg B_zeonv_msg CEngDsT_tStrtFrst EnvT_t eonvdtko_w_msg Eonv_stRejDiagRes Eonv_stRejDiagResActv Epm_stSpd SyC_stSub tnsez_w_msg /end IN_MEASUREMENT
 /begin OUT_MEASUREMENT B_faeonvdt_msg B_sbteonva_msg eonvabort_msg eonvddr_w_msg eonvresult_msg eonvrtr_w_msg eonvsta_msg eonvstdr_msg eonvstmcp_msg evapesbts_msg /end OUT_MEASUREMENT
 /begin LOC_MEASUREMENT B_eonvsrd B_hotst /end LOC_MEASUREMENT
 FUNCTION_VERSION "30201.0.0" /end FUNCTION
/begin FUNCTION DiagPTank_Fil "30303.0.0 Tank pressure preparetion (p.ex. offset, filtering)"
 /begin DEF_CHARACTERISTIC DPTEDPU DPTEDTD DPTEDTK PTEBPTH TLDPTFFA TLDPTFHP TLDPTFNO TLDPTFSH TLDPTFSL TWTEFBPW /end DEF_CHARACTERISTIC
 /begin IN_MEASUREMENT B_nachl_msg B_ptfslo_msg B_runeonv_msg B_tldcvs_msg ptek_w_msg SyC_stSub /end IN_MEASUREMENT
 /begin OUT_MEASUREMENT B_dtetk_msg B_tldpsd_msg ptetp_w_msg pttp_w_msg ptvf_w_msg /end OUT_MEASUREMENT
 /begin LOC_MEASUREMENT ptebprct_w ptebp_w ptvfstrt_w /end LOC_MEASUREMENT
 FUNCTION_VERSION "30303.0.0" /end FUNCTION
/begin FUNCTION Diff_PlausPrtTrq "135.0.0   Differential protection torque - Error substitute reactions" /begin DEF_CHARACTERISTIC VehMot_tqWhlDftlProtn_C /end DEF_CHARACTERISTIC /begin IN_MEASUREMENT AccPed_rTrq PT_trqLos /end IN_MEASUREMENT /begin OUT_MEASUREMENT VehMot_tqCluDftlProtn VehMot_trqPrtDfftl /end OUT_MEASUREMENT FUNCTION_VERSION "135.0.0" /end FUNCTION
/begin FUNCTION Diff_TrqRat "23.4.0    Differential ratio - Error substitute reactions" /begin DEF_CHARACTERISTIC Diff_rTrqDfftl_C /end DEF_CHARACTERISTIC /begin OUT_MEASUREMENT VehMot_rTrqDfftl /end OUT_MEASUREMENT FUNCTION_VERSION "23.4.0" /end FUNCTION
/begin FUNCTION DINH "30000.27.0_1.0.0Diagnostic Inhibit Handler" /begin OUT_MEASUREMENT DINH_stDFCPid41Di /end OUT_MEASUREMENT
 /begin LOC_MEASUREMENT DINH_DSQSrv7Vis DINH_FIdSrv7Vis DINH_nrActvInhReas.FID_AFRA DINH_nrActvInhReas.FID_AORA DINH_nrActvInhReas.FID_ATEH DINH_nrActvInhReas.FID_ATEL DINH_nrActvInhReas.FID_ATEN DINH_nrActvInhReas.FID_ATLDI DINH_nrActvInhReas.FID_ATLDO DINH_nrActvInhReas.FID_BEONV DINH_nrActvInhReas.FId_EGSDCmnSeg1B1Parl DINH_nrActvInhReas.FID_BAGRA DINH_nrActvInhReas.FID_BAGRASD DINH_nrActvInhReas.FID_BDSTOF DINH_nrActvInhReas.FID_BFVDFRM DINH_nrActvInhReas.FID_BHOM DINH_nrActvInhReas.FID_BLLRH DINH_nrActvInhReas.FID_BLLRKH DINH_nrActvInhReas.FID_BPLSU DINH_nrActvInhReas.FID_FRAMBAVMB DINH_nrActvInhReas.FId_CatHeatgColdStrtReq DINH_nrActvInhReas.FId_CatHeatgWrmReq DINH_nrActvInhReas.FId_DSMBDEPHSpOpMode DINH_nrActvInhReas.FId_EGRVlvCoord DINH_nrActvInhReas.FId_EGSDO2FuTrmB1 DINH_nrActvInhReas.FId_EGSDO2SnsrMntdRelsS1B1 DINH_nrActvInhReas.FId_EGSDO2_LamOffsFastS1B1 DINH_nrActvInhReas.FId_MisfDetDnAdpnNv DINH_nrActvInhReas.FId_bascadpncvo DINH_nrActvInhReas.FID_AGRS DINH_nrActvInhReas.FID_BBAGR DINH_nrActvInhReas.FID_BBAGRA DINH_nrActvInhReas.FID_BGFKMS DINH_nrActvInhReas.FID_BGMSDKS DINH_nrActvInhReas.FID_CAGRSUS DINH_nrActvInhReas.FID_CBGTFUELM DINH_nrActvInhReas.FID_CBGTHDEV DINH_nrActvInhReas.FID_CDESVF DINH_nrActvInhReas.FID_CDETHS DINH_nrActvInhReas.FID_CDRCTSTRT DINH_nrActvInhReas.FID_CDSKV DINH_nrActvInhReas.FID_CDSKVRNO DINH_nrActvInhReas.FID_CDSKVRPO DINH_nrActvInhReas.FID_CDSKVRaty DINH_nrActvInhReas.FID_CDSKVRng DINH_nrActvInhReas.FID_CDSKVS DINH_nrActvInhReas.FID_CDSTR DINH_nrActvInhReas.FID_CDSTTI DINH_nrActvInhReas.FID_CETHG DINH_nrActvInhReas.FID_CETHSPLnpl DINH_nrActvInhReas.FID_CETHSTPLnpl DINH_nrActvInhReas.FID_CETKHL DINH_nrActvInhReas.FID_CETKHT DINH_nrActvInhReas.FID_CGDISTRT DINH_nrActvInhReas.FID_CGLSRDP DINH_nrActvInhReas.FID_CHDR DINH_nrActvInhReas.FID_CHDRKH DINH_nrActvInhReas.FID_CHDRPL DINH_nrActvInhReas.FID_CLLKHV DINH_nrActvInhReas.FID_CLLRHV DINH_nrActvInhReas.FID_CLZSRDP DINH_nrActvInhReas.FID_CLZSRHP DINH_nrActvInhReas.FID_CNLHP DINH_nrActvInhReas.FID_CNLHP2 DINH_nrActvInhReas.FID_CNLKO2 DINH_nrActvInhReas.FID_CNLKO3 DINH_nrActvInhReas.FID_CNLLP DINH_nrActvInhReas.FID_CNLPL DINH_nrActvInhReas.FID_CNLPS DINH_nrActvInhReas.FID_CNSAD DINH_nrActvInhReas.FID_CNSAD2 DINH_nrActvInhReas.FID_CPSRB DINH_nrActvInhReas.FID_CPSRP DINH_nrActvInhReas.FID_CSTHDR DINH_nrActvInhReas.FID_CSTRTCTL DINH_nrActvInhReas.FID_CTESF DINH_nrActvInhReas.FID_CTESG DINH_nrActvInhReas.FID_CTHIPSTRT DINH_nrActvInhReas.FID_CTKACS DINH_nrActvInhReas.FID_CTMSV DINH_nrActvInhReas.FID_CTOSP DINH_nrActvInhReas.FID_DHFERR DINH_nrActvInhReas.FID_DKRSA DINH_nrActvInhReas.FID_DLLRBandEndTst DINH_nrActvInhReas.FID_DLLRShrtTrpSpdRmp DINH_nrActvInhReas.FID_FEDKAHB DINH_nrActvInhReas.FID_FEDKAPB DINH_nrActvInhReas.FID_FEDSSB DINH_nrActvInhReas.FID_FOFSTP DINH_nrActvInhReas.FID_FONSTP DINH_nrActvInhReas.FID_FUEDK DINH_nrActvInhReas.FID_FVLRA DINH_nrActvInhReas.FID_KRREGact DINH_nrActvInhReas.FID_KRREGloc DINH_nrActvInhReas.FID_LRADLSU DINH_nrActvInhReas.FID_LRALSVErr DINH_nrActvInhReas.FID_LRAPLLSU DINH_nrActvInhReas.FID_LUSTP DINH_nrActvInhReas.FID_LnKS1 DINH_nrActvInhReas.FID_PLSUV DINH_nrActvInhReas.FID_PSRMOZDG DINH_nrActvInhReas.FID_PSRMOZG DINH_nrActvInhReas.FID_STRTDIA DINH_nrActvInhReas.FID_STRTSTM DINH_nrActvInhReas.FID_TFA1CSMW DINH_nrActvInhReas.FID_TFA2CSMW DINH_nrActvInhReas.FID_TKACSMW DINH_nrActvInhReas.FID_TMCSMW DINH_nrActvInhReas.FID_TOCHOilSwmpTQly DINH_nrActvInhReas.FID_TOCHTME DINH_nrActvInhReas.FID_TOSPCSMW DINH_nrActvInhReas.FID_TSRLX DINH_nrActvInhReas.FID_UEGOHeatrRlyS1B1 DINH_nrActvInhReas.FID_VehStvSSEOk DINH_nrActvInhReas.FID_VldtLamPlausMaxS1B1 DINH_nrActvInhReas.FID_VldtLamPlausMinS1B1 DINH_nrActvInhReas.FId_ACClntPSSPMon DINH_nrActvInhReas.FId_ACCompComCANBusOff DINH_nrActvInhReas.FId_ACCompComCANErrMtr DINH_nrActvInhReas.FId_ACComp_HiUTWSnsrErr DINH_nrActvInhReas.FId_ACComp_LoUTWSnsrErr DINH_nrActvInhReas.FId_ACComp_PDSnsrErr DINH_nrActvInhReas.FId_ACComp_VehSpdSnsrErr DINH_nrActvInhReas.FId_ACCtl_ACStrtCut DINH_nrActvInhReas.FId_ACCtl_APP1 DINH_nrActvInhReas.FId_ACCtl_APP2 DINH_nrActvInhReas.FId_ACCtl_APPSync DINH_nrActvInhReas.FId_ACCtl_AcOff DINH_nrActvInhReas.FId_ACCtl_Clmb DINH_nrActvInhReas.FId_ACCtl_DK1 DINH_nrActvInhReas.FId_ACCtl_DK2 DINH_nrActvInhReas.FId_ACCtl_DKSync DINH_nrActvInhReas.FId_ACCtl_VehSpdSnsrErr DINH_nrActvInhReas.FId_ACCtl_pAC DINH_nrActvInhReas.FId_ACEvpTCANErr DINH_nrActvInhReas.FId_ACEvpTFrzVal DINH_nrActvInhReas.FId_ACEvpTPhysRng DINH_nrActvInhReas.FId_ACEvpTRplVal DINH_nrActvInhReas.FId_AFCLFailr DINH_nrActvInhReas.FId_AFS DINH_nrActvInhReas.FId_AFSPhyRng DINH_nrActvInhReas.FId_APP1SigPath DINH_nrActvInhReas.FId_APP2SigPath DINH_nrActvInhReas.FId_APPBrkErr DINH_nrActvInhReas.FId_APPLETVldnErr DINH_nrActvInhReas.FId_APPLrn DINH_nrActvInhReas.FId_APPVehVErr DINH_nrActvInhReas.FId_AccPedDrvModComErr DINH_nrActvInhReas.FId_AccPedDrvModFailr DINH_nrActvInhReas.FId_AccPedNMaxLim DINH_nrActvInhReas.FId_AccPedNMinLim DINH_nrActvInhReas.FId_AccPedNMinLimBrkApp DINH_nrActvInhReas.FId_AccPedTrqLim DINH_nrActvInhReas.FId_AfsDdDiag DINH_nrActvInhReas.FId_AfsDiagErr DINH_nrActvInhReas.FId_AfsDiagTst DINH_nrActvInhReas.FId_AfsPlausDiag DINH_nrActvInhReas.FId_AfsVrntDiag DINH_nrActvInhReas.FId_AirCClntPFrzVal DINH_nrActvInhReas.FId_AirCClntPRplVal DINH_nrActvInhReas.FId_AirCSwt DINH_nrActvInhReas.FId_AirDvPAdpnPEnv DINH_nrActvInhReas.FId_AirDvPAdpnPIntkVUsB1 DINH_nrActvInhReas.FId_AirDvPPSnsrAdpn_PModeActv DINH_nrActvInhReas.FId_AltACGFailr DINH_nrActvInhReas.FId_AltAPPErrSt DINH_nrActvInhReas.FId_AltBattMngtFailr DINH_nrActvInhReas.FId_AltBrkErrSt DINH_nrActvInhReas.FId_AltComErr DINH_nrActvInhReas.FId_AltENGB DINH_nrActvInhReas.FId_AltElecLoadErr DINH_nrActvInhReas.FId_AltEnvTErr DINH_nrActvInhReas.FId_AltFFAltLoadFast DINH_nrActvInhReas.FId_AltFFAltLoadSlow DINH_nrActvInhReas.FId_AltIOACGErr DINH_nrActvInhReas.FId_AltIOACGLinComFailr DINH_nrActvInhReas.FId_AltIOComErr DINH_nrActvInhReas.FId_AltLinErr DINH_nrActvInhReas.FId_AltPwr DINH_nrActvInhReas.FId_AltVehVErrSt DINH_nrActvInhReas.FId_AltvCluFail DINH_nrActvInhReas.FId_BGAGRTS DINH_nrActvInhReas.FId_BGFKMSEPSR DINH_nrActvInhReas.FId_BGFKMSEPU DINH_nrActvInhReas.FId_BGFKMSESumClr DINH_nrActvInhReas.FId_BGFKMSHFME DINH_nrActvInhReas.FId_BGFKMSHFMZ DINH_nrActvInhReas.FId_BGFKMSZPSR DINH_nrActvInhReas.FId_BGOSCCat1B1 DINH_nrActvInhReas.FId_BGOSCCat2B1 DINH_nrActvInhReas.FId_BattAltFailr DINH_nrActvInhReas.FId_BattMngtFailr DINH_nrActvInhReas.FId_BattSigPtd DINH_nrActvInhReas.FId_BattU2MEDSRC DINH_nrActvInhReas.FId_BattUDrpPrvOff DINH_nrActvInhReas.FId_BattUFrzVal DINH_nrActvInhReas.FId_BattUHiFailrEna DINH_nrActvInhReas.FId_BattUIMGTCUCANFailr DINH_nrActvInhReas.FId_BattULoFailrEna DINH_nrActvInhReas.FId_BattUReplVal DINH_nrActvInhReas.FId_BattUSRC DINH_nrActvInhReas.FId_BlwrComErr DINH_nrActvInhReas.FId_BrkBstMdl DINH_nrActvInhReas.FId_BrkBstMdlBrkP DINH_nrActvInhReas.FId_BrkBstMdlBrkSt DINH_nrActvInhReas.FId_BrkBstMdlEnvP DINH_nrActvInhReas.FId_BrkBstPDetnInhbn DINH_nrActvInhReas.FId_BrkBstPMstCylPSnsrFail DINH_nrActvInhReas.FId_BrkBstPSnsrStuckDetn DINH_nrActvInhReas.FId_BrkBstSigPath DINH_nrActvInhReas.FId_BrkBstVehVv DINH_nrActvInhReas.FId_BrkMnSwtErr DINH_nrActvInhReas.FId_BrkPFrzVal DINH_nrActvInhReas.FId_BrkPOilPres DINH_nrActvInhReas.FId_BrkPReplVal DINH_nrActvInhReas.FId_BrkPedEngStopEna DINH_nrActvInhReas.FId_BrkRdntSwtErr DINH_nrActvInhReas.FId_CAGRSDS DINH_nrActvInhReas.FId_CEngDsTColdStrt DINH_nrActvInhReas.FId_CEngDsTColdStrtErr DINH_nrActvInhReas.FId_CEngDsTHSC DINH_nrActvInhReas.FId_CEngDsTLSC DINH_nrActvInhReas.FId_CEngDsTPlausErr DINH_nrActvInhReas.FId_CEngDsTReplMdlEngStop DINH_nrActvInhReas.FId_CEngDsTSTC DINH_nrActvInhReas.FId_CEngDsTSnsrElec DINH_nrActvInhReas.FId_CEngDsTSwtReplMdl DINH_nrActvInhReas.FId_CEngUsTColdChkErr DINH_nrActvInhReas.FId_CEngUsTCrssChk DINH_nrActvInhReas.FId_CEngUsTElecErr DINH_nrActvInhReas.FId_CEngUsTSnsrElecErr DINH_nrActvInhReas.FId_CEngUsTSwtReplMdl DINH_nrActvInhReas.FId_CInjCatHeatgDiag DINH_nrActvInhReas.FId_CMSUDKSOM1 DINH_nrActvInhReas.FId_CMSUDKSOM2 DINH_nrActvInhReas.FId_CatHeatgEomShtrpAct DINH_nrActvInhReas.FId_ChrctlAgrsErr DINH_nrActvInhReas.FId_ChrctlAgrscf DINH_nrActvInhReas.FId_ClntTempENGB DINH_nrActvInhReas.FId_Clth DINH_nrActvInhReas.FId_Clth2 DINH_nrActvInhReas.FId_Clth3StuckOn DINH_nrActvInhReas.FId_Clth4 DINH_nrActvInhReas.FId_ClthCAN DINH_nrActvInhReas.FId_ClthMax DINH_nrActvInhReas.FId_ClthStk DINH_nrActvInhReas.FId_ClthStkErr DINH_nrActvInhReas.FId_ClthStkFailr DINH_nrActvInhReas.FId_ClthStkOFFStuck DINH_nrActvInhReas.FId_ClthStkONStuck DINH_nrActvInhReas.FId_ClthSwtFailr DINH_nrActvInhReas.FId_CntrShaftFailr DINH_nrActvInhReas.FId_CoEOMGdiEomErrLcy DINH_nrActvInhReas.FId_CoESSBlowrVld DINH_nrActvInhReas.FId_CoETM DINH_nrActvInhReas.FId_CoETS_StTrqLimErr1 DINH_nrActvInhReas.FId_CoETS_StTrqLimErr2 DINH_nrActvInhReas.FId_CoEngStopEnblStSpEngT DINH_nrActvInhReas.FId_CoEngStopEnblStSpLSU DINH_nrActvInhReas.FId_CoEngStopEnblStSpTcT DINH_nrActvInhReas.FId_CoEngStopEnblSysErr DINH_nrActvInhReas.FId_CoEngVlvLftSpIntk DINH_nrActvInhReas.FId_CoPOMStrtgDevStrtr DINH_nrActvInhReas.FId_CoPOM_FirstStrtAut DINH_nrActvInhReas.FId_CoTS_SwtOff DINH_nrActvInhReas.FId_CoVOMACCComFailr DINH_nrActvInhReas.FId_CoVOMBrkPedISABSigFailr DINH_nrActvInhReas.FId_CoVOMEngCrkAbort DINH_nrActvInhReas.FId_CoVOMEngRstrtEnaCdn DINH_nrActvInhReas.FId_CoVOMISSEng DINH_nrActvInhReas.FId_ComACRly DINH_nrActvInhReas.FId_ComAPPSensFail DINH_nrActvInhReas.FId_ComAPedl DINH_nrActvInhReas.FId_ComAYCA DINH_nrActvInhReas.FId_ComAYCAMon DINH_nrActvInhReas.FId_ComAYCD DINH_nrActvInhReas.FId_ComAYCDMon DINH_nrActvInhReas.FId_ComAYCF DINH_nrActvInhReas.FId_ComAYCFMon DINH_nrActvInhReas.FId_ComAYCG DINH_nrActvInhReas.FId_ComAYCGMon DINH_nrActvInhReas.FId_ComAYCI DINH_nrActvInhReas.FId_ComAYCIMon DINH_nrActvInhReas.FId_ComAirPThrUsSnsrErr DINH_nrActvInhReas.FId_ComAltFail DINH_nrActvInhReas.FId_ComAppVehSnsrFailr DINH_nrActvInhReas.FId_ComBCM1 DINH_nrActvInhReas.FId_ComBCM1Mon DINH_nrActvInhReas.FId_ComBCMUnitCfmdErr DINH_nrActvInhReas.FId_ComBCMUnitNotTstd DINH_nrActvInhReas.FId_ComBstCtrl DINH_nrActvInhReas.FId_ComCANVEHICLEBusOff DINH_nrActvInhReas.FId_ComCGW1 DINH_nrActvInhReas.FId_ComCGW1Mon DINH_nrActvInhReas.FId_ComClthSt DINH_nrActvInhReas.FId_ComConvClth DINH_nrActvInhReas.FId_ComCrCtlReq DINH_nrActvInhReas.FId_ComCrsMaiIndcnLampReq DINH_nrActvInhReas.FId_ComCrsSetIndcnLampReq DINH_nrActvInhReas.FId_ComDCDCCdn DINH_nrActvInhReas.FId_ComDCDCErr DINH_nrActvInhReas.FId_ComDesGearCurr DINH_nrActvInhReas.FId_ComDetrmAirM DINH_nrActvInhReas.FId_ComDwnShiftCtrlReq DINH_nrActvInhReas.FId_ComEAT1 DINH_nrActvInhReas.FId_ComEAT10 DINH_nrActvInhReas.FId_ComEAT10Mon DINH_nrActvInhReas.FId_ComEAT11 DINH_nrActvInhReas.FId_ComEAT11Mon DINH_nrActvInhReas.FId_ComEAT12 DINH_nrActvInhReas.FId_ComEAT12Mon DINH_nrActvInhReas.FId_ComEAT13 DINH_nrActvInhReas.FId_ComEAT13Mon DINH_nrActvInhReas.FId_ComEAT1Mon DINH_nrActvInhReas.FId_ComEAT2 DINH_nrActvInhReas.FId_ComEAT2Mon DINH_nrActvInhReas.FId_ComEAT4 DINH_nrActvInhReas.FId_ComEAT4Mon DINH_nrActvInhReas.FId_ComEAT6 DINH_nrActvInhReas.FId_ComEAT6Mon DINH_nrActvInhReas.FId_ComEAT7 DINH_nrActvInhReas.FId_ComEAT7Mon DINH_nrActvInhReas.FId_ComEAT8 DINH_nrActvInhReas.FId_ComEAT8Mon DINH_nrActvInhReas.FId_ComEATA DINH_nrActvInhReas.FId_ComEATAMon DINH_nrActvInhReas.FId_ComEATB DINH_nrActvInhReas.FId_ComEATBMon DINH_nrActvInhReas.FId_ComEATC DINH_nrActvInhReas.FId_ComEATCMon DINH_nrActvInhReas.FId_ComEBSSelfDiagErr DINH_nrActvInhReas.FId_ComECUHwErr DINH_nrActvInhReas.FId_ComEGRVlvErr DINH_nrActvInhReas.FId_ComEMSIntAirTemp DINH_nrActvInhReas.FId_ComEPB DINH_nrActvInhReas.FId_ComEPBB DINH_nrActvInhReas.FId_ComEPBBMon DINH_nrActvInhReas.FId_ComEPBMon DINH_nrActvInhReas.FId_ComEPS1 DINH_nrActvInhReas.FId_ComEPS1Mon DINH_nrActvInhReas.FId_ComEPSUnitCfmdErr DINH_nrActvInhReas.FId_ComEPSUnitNotTstd DINH_nrActvInhReas.FId_ComEngBrkOvrdInfo DINH_nrActvInhReas.FId_ComEngBrkOvrdMtr DINH_nrActvInhReas.FId_ComEngBrkSwErr DINH_nrActvInhReas.FId_ComEngPosng DINH_nrActvInhReas.FId_ComEngRPMLim DINH_nrActvInhReas.FId_ComEngTrqLim DINH_nrActvInhReas.FId_ComEnvtlAirPSnsrErr DINH_nrActvInhReas.FId_ComEstmTqNormJdg DINH_nrActvInhReas.FId_ComEthnlSErr DINH_nrActvInhReas.FId_ComFlSply DINH_nrActvInhReas.FId_ComFuCnsBitDurgIdleStop DINH_nrActvInhReas.FId_ComGEVCntrl DINH_nrActvInhReas.FId_ComGbxNPosFail DINH_nrActvInhReas.FId_ComGbxTemp DINH_nrActvInhReas.FId_ComGwIMG1 DINH_nrActvInhReas.FId_ComGwIMG1Mon DINH_nrActvInhReas.FId_ComGwIMG3 DINH_nrActvInhReas.FId_ComGwIMG3Mon DINH_nrActvInhReas.FId_ComGwIMG4 DINH_nrActvInhReas.FId_ComGwIMG4Mon DINH_nrActvInhReas.FId_ComGwIMG5 DINH_nrActvInhReas.FId_ComGwIMG5Mon DINH_nrActvInhReas.FId_ComGwIMG6 DINH_nrActvInhReas.FId_ComGwIMG6Mon DINH_nrActvInhReas.FId_ComHFMSnsrErr DINH_nrActvInhReas.FId_ComIDASB DINH_nrActvInhReas.FId_ComIDASBMon DINH_nrActvInhReas.FId_ComIDASBUnitCfmdErr DINH_nrActvInhReas.FId_ComIDASBUnitNotTstd DINH_nrActvInhReas.FId_ComIDASEngFail DINH_nrActvInhReas.FId_ComIDASEngFailMil DINH_nrActvInhReas.FId_ComIMGUnitCfmdErr DINH_nrActvInhReas.FId_ComIMGUnitNotTstd DINH_nrActvInhReas.FId_ComISG2 DINH_nrActvInhReas.FId_ComIgnCtrl DINH_nrActvInhReas.FId_ComInjCtrl DINH_nrActvInhReas.FId_ComIntkAirPSnsrErr DINH_nrActvInhReas.FId_ComLamCtrl DINH_nrActvInhReas.FId_ComMETA DINH_nrActvInhReas.FId_ComMETAMon DINH_nrActvInhReas.FId_ComMETC DINH_nrActvInhReas.FId_ComMETCMon DINH_nrActvInhReas.FId_ComMETD DINH_nrActvInhReas.FId_ComMETDMon DINH_nrActvInhReas.FId_ComMETE2 DINH_nrActvInhReas.FId_ComMETE2Mon DINH_nrActvInhReas.FId_ComMETF DINH_nrActvInhReas.FId_ComMETFMon DINH_nrActvInhReas.FId_ComMETG DINH_nrActvInhReas.FId_ComMETGMon DINH_nrActvInhReas.FId_ComMETH DINH_nrActvInhReas.FId_ComMETH2 DINH_nrActvInhReas.FId_ComMETH2Mon DINH_nrActvInhReas.FId_ComMETHMon DINH_nrActvInhReas.FId_ComMETI DINH_nrActvInhReas.FId_ComMETIMon DINH_nrActvInhReas.FId_ComMETK DINH_nrActvInhReas.FId_ComMETKMon DINH_nrActvInhReas.FId_ComMETL DINH_nrActvInhReas.FId_ComMETLMon DINH_nrActvInhReas.FId_ComMETM DINH_nrActvInhReas.FId_ComMETMMon DINH_nrActvInhReas.FId_ComMETN DINH_nrActvInhReas.FId_ComMETNMon DINH_nrActvInhReas.FId_ComMETUnitCfmdErr DINH_nrActvInhReas.FId_ComMETUnitNotTstd DINH_nrActvInhReas.FId_ComMisf DINH_nrActvInhReas.FId_ComMon DINH_nrActvInhReas.FId_ComNTrbn DINH_nrActvInhReas.FId_ComODOff DINH_nrActvInhReas.FId_ComOilLvlLamp DINH_nrActvInhReas.FId_ComOilPWarnLamp DINH_nrActvInhReas.FId_ComPASensFail /end LOC_MEASUREMENT
 FUNCTION_VERSION "30000.27.0_1.0.0" /end FUNCTION
/begin COMPU_METHOD B_TRUE "" TAB_VERB "%6.3" "" COMPU_TAB_REF B_TRUE /end COMPU_METHOD
/begin COMPU_VTAB B_TRUE "" TAB_VERB 2 0 "FALSE" 1 "TRUE" /end COMPU_VTAB
/begin COMPU_METHOD dez "" RAT_FUNC "%6.2" "" COEFFS 0 1 0 0 0 1 /end COMPU_METHOD
/begin COMPU_METHOD DINH_ct_Compu "" RAT_FUNC "%6.0" "" COEFFS 0 -1 4096 0 0 1 /end COMPU_METHOD
/begin COMPU_METHOD ESNSAD_INHCUST_SY_Compu "" TAB_VERB "%6.3" "" COMPU_TAB_REF ESNSAD_INHCUST_SY_Compu /end COMPU_METHOD
/begin COMPU_VTAB ESNSAD_INHCUST_SY_Compu "" TAB_VERB 2 0 "False" 1 "True" /end COMPU_VTAB
/begin COMPU_METHOD Eta "" RAT_FUNC "%6.4" "Nm/(mg/cyc)" COEFFS 0 128 0 0 0 1 /end COMPU_METHOD
/begin COMPU_METHOD Eta1 "" RAT_FUNC "%6.4" "-" COEFFS 0 128 0 0 0 1 /end COMPU_METHOD
/begin COMPU_METHOD Eta2 "" RAT_FUNC "%6.4" "" COEFFS 0 128 0 0 0 1 /end COMPU_METHOD
/begin COMPU_METHOD ETCtlGovKd_fac "" RAT_FUNC "%7.6" "-" COEFFS 0 12800 0 0 0 1 /end COMPU_METHOD
/begin COMPU_METHOD ETCtlGovKi_fac "" RAT_FUNC "%8.7" "-" COEFFS 0 429496.7296 0 0 0 1 /end COMPU_METHOD
/begin COMPU_METHOD ETCtlGovKp_fac "" RAT_FUNC "%7.6" "-" COEFFS 0 25600 0 0 0 1 /end COMPU_METHOD
/begin COMPU_METHOD ETCtlGovRmp "" RAT_FUNC "%6.3" "s" COEFFS 0 0 1 0 0.0152587890625 0 /end COMPU_METHOD
/begin COMPU_METHOD ETCtlGov_p0q001 "" RAT_FUNC "%6.5" "-" COEFFS 0 1000 0 0 0 1 /end COMPU_METHOD
/begin COMPU_METHOD ETC_Act_SY_Compu "" TAB_VERB "%6.3" "" COMPU_TAB_REF ETC_Act_SY_Compu /end COMPU_METHOD
/begin COMPU_VTAB ETC_Act_SY_Compu "" TAB_VERB 2 0 "False" 1 "True" /end COMPU_VTAB
/begin COMPU_METHOD ETHDETN_SC_Compu "" TAB_VERB "%6.3" "" COMPU_TAB_REF ETHDETN_SC_Compu /end COMPU_METHOD
/begin COMPU_VTAB ETHDETN_SC_Compu "" TAB_VERB 3 0 "ETHDETN_NO" 1 "ETHDETN_SNSR" 2 "ETHDETN_MDL" /end COMPU_VTAB
/begin COMPU_METHOD ETHTSYN_SC_Compu "" TAB_VERB "%6.3" "" COMPU_TAB_REF ETHTSYN_SC_Compu /end COMPU_METHOD
/begin COMPU_VTAB ETHTSYN_SC_Compu "" TAB_VERB 2 0 "False" 1 "True" /end COMPU_VTAB
/begin COMPU_METHOD ETH_SC_Compu "" TAB_VERB "%6.3" "" COMPU_TAB_REF ETH_SC_Compu /end COMPU_METHOD
/begin COMPU_VTAB ETH_SC_Compu "" TAB_VERB 2 0 "False" 1 "True" /end COMPU_VTAB
/begin COMPU_METHOD ETKS_SY_Compu "" TAB_VERB "%6.3" "" COMPU_TAB_REF ETKS_SY_Compu /end COMPU_METHOD
/begin COMPU_VTAB ETKS_SY_Compu "" TAB_VERB 2 0 "No ETKS" 1 "ETKS" /end COMPU_VTAB
/begin COMPU_METHOD ETS_LEAN_SY_Compu "" RAT_FUNC "%6.2" "" COEFFS 0 1 0 0 0 1 /end COMPU_METHOD
/begin COMPU_METHOD ETS_NSC_SY_Compu "" RAT_FUNC "%6.2" "" COEFFS 0 1 0 0 0 1 /end COMPU_METHOD
/begin COMPU_METHOD ETS_PFLT1_SY_Compu "" RAT_FUNC "%6.2" "" COEFFS 0 1 0 0 0 1 /end COMPU_METHOD
/begin COMPU_METHOD ETS_PFLT2_SY_Compu "" RAT_FUNC "%6.2" "" COEFFS 0 1 0 0 0 1 /end COMPU_METHOD
/begin COMPU_METHOD ETS_PHC_SY_Compu "" RAT_FUNC "%6.2" "" COEFFS 0 1 0 0 0 1 /end COMPU_METHOD
/begin COMPU_METHOD ETS_SOX_SY_Compu "" RAT_FUNC "%6.2" "" COEFFS 0 1 0 0 0 1 /end COMPU_METHOD
/begin COMPU_METHOD EVAPACTR_CCV_SC_Compu "" TAB_VERB "%6.3" "" COMPU_TAB_REF EVAPACTR_CCV_SC_Compu /end COMPU_METHOD
/begin COMPU_VTAB EVAPACTR_CCV_SC_Compu "" TAB_VERB 2 0 "00_NO_CCV" 1 "01_DO_OPEN" /end COMPU_VTAB
/begin COMPU_METHOD EVAPACTR_CPPUHILOAD_SC_Compu "" TAB_VERB "%6.3" "" COMPU_TAB_REF EVAPACTR_CPPUHILOAD_SC_Compu /end COMPU_METHOD
/begin COMPU_VTAB EVAPACTR_CPPUHILOAD_SC_Compu "" TAB_VERB 3 0 "00_NO_CPPU" 1 "01_CPPU" 2 "02_CODWORD" /end COMPU_VTAB
/begin COMPU_METHOD EVAPACTR_CPVPWRSTG_SC_Compu "" TAB_VERB "%6.3" "" COMPU_TAB_REF EVAPACTR_CPVPWRSTG_SC_Compu /end COMPU_METHOD
/begin COMPU_VTAB EVAPACTR_CPVPWRSTG_SC_Compu "" TAB_VERB 3 0 "NO_CPV_PS_DIAG" 1 "CPV_STD_PS_DIAG" 2 "CPV_PS_DIAG_BTS7200" /end COMPU_VTAB
/begin COMPU_METHOD EVAPACTR_DMTLFRQDETN_SC_Compu "" TAB_VERB "%6.3" "" COMPU_TAB_REF EVAPACTR_DMTLFRQDETN_SC_Compu /end COMPU_METHOD
/begin COMPU_VTAB EVAPACTR_DMTLFRQDETN_SC_Compu "" TAB_VERB 5 0 "00_NO_FRQDETN" 1 "01_FRQDETN_RIPPEL" 2 "02_CODWORD" 3 "03_FREQDETN_BACKEMF" 4 "04_FREQDETN_TIBASD" /end COMPU_VTAB
/begin COMPU_METHOD EVAPACTR_VAR_SY_Compu "" TAB_VERB "%6.3" "" COMPU_TAB_REF EVAPACTR_VAR_SY_Compu /end COMPU_METHOD
/begin COMPU_VTAB EVAPACTR_VAR_SY_Compu "" TAB_VERB 58 0 "kein Kundenbezug" 1 "DAI" 3 "VWW" 4 "POR" 5 "AUD" 6 "OPE" 9 "FIA" 11 "BMW" 14 "PSA" 15 "REN" 17 "ALF" 18 "SAB" 19 "VOL" 20 "NIS" 21 "GMU" 22 "FOR" 26 "IMJ" 36 "MAN" 51 "SEA" 53 "CHR" 54 "JAG" 55 "ROL" 69 "FER" 72 "TOY" 73 "LAM" 123 "MIT" 147 "HYU" 159 "HON" 160 "MAZ" 183 "CU" 190 "LRG" 204 "VVW" 214 "AVT" 242 "Iveco" 243 "DMC" 248 "SUZ" 267 "SSANGYONG" 270 "KEF" 289 "AMG" 308 "TAT" 319 "MVM" 327 "OTOSAN" 328 "MM" 385 "UAES" 590 "Scania" 609 "Deutz" 720 "Greatwall" 745 "JMC Ford" 788 "Saic Motor" 828 "RBCD" 898 "MFTBC" 936 "Anhui_Quanchai" 944 "DOOSAN Infracore" 984 "FAW - Wuxi" 999 "ALL" 2887 "Nonox" 9454 "Fuso" 9707 "Hatz" /end COMPU_VTAB
/begin COMPU_METHOD fak_sw_b64 "" RAT_FUNC "%6.4" "-" COEFFS 0 65536 0 0 0 128 /end COMPU_METHOD
/begin COMPU_METHOD fak_ub_b2 "" RAT_FUNC "%8.5" "-" COEFFS 0 256 0 0 0 2 /end COMPU_METHOD
/begin COMPU_METHOD fak_uw_b2 "" RAT_FUNC "%7.6" "-" COEFFS 0 65536 0 0 0 2 /end COMPU_METHOD
/begin COMPU_METHOD fak_uw_b25p6 "" RAT_FUNC "%6.5" "-" COEFFS 0 2560 0 0 0 1 /end COMPU_METHOD
/begin COMPU_METHOD Length "" RAT_FUNC "%6.2" "m" COEFFS 0 1 0 0 0 1 /end COMPU_METHOD
/begin COMPU_METHOD m_3p47222Em4_g "" RAT_FUNC "%6.5" "g" COEFFS 0 2880 0 0 0 1 /end COMPU_METHOD
/begin COMPU_METHOD m_uw_b25p6 "" RAT_FUNC "%6.5" "kg/h" COEFFS 0 65536 0 0 0 25.6 /end COMPU_METHOD
/begin COMPU_METHOD OneToOne "" RAT_FUNC "%6.2" "-" COEFFS 0 1 0 0 0 1 /end COMPU_METHOD
/begin COMPU_METHOD pgrad_q2p38Em5 "" RAT_FUNC "%7.6" "hPa/s" COEFFS 0 65536 0 0 0 1.5625 /end COMPU_METHOD
/begin COMPU_METHOD p_q0p00122 "" RAT_FUNC "%6.4" "hPa" COEFFS 0 65536 0 0 0 80 /end COMPU_METHOD
/begin COMPU_METHOD p_ub_q5 "" RAT_FUNC "%6.2" "hPa" COEFFS 0 1 0 0 0 5 /end COMPU_METHOD
/begin COMPU_METHOD spg_q0p1 "" RAT_FUNC "%6.3" "V" COEFFS 0 1 0 0 0 0.1 /end COMPU_METHOD
/begin COMPU_METHOD s_q0p1_km "" RAT_FUNC "%6.3" "Km" COEFFS 0 1 0 0 0 0.1 /end COMPU_METHOD
/begin COMPU_METHOD s_q1p3888_m "" RAT_FUNC "%6.2" "m" COEFFS 0 18 0 0 0 25 /end COMPU_METHOD
/begin COMPU_METHOD t6minxmin_q6 "" RAT_FUNC "%6.2" "min" COEFFS 0 1 0 0 0 6 /end COMPU_METHOD
/begin COMPU_METHOD Temp_Cels "" RAT_FUNC "%6.1" "deg C" COEFFS 0 10 2731.4 0 0 1 /end COMPU_METHOD
/begin COMPU_METHOD temp_ub_q0p75 "" RAT_FUNC "%6.3" "Grad C" COEFFS 0 1 0 0 0 0.75 /end COMPU_METHOD
/begin COMPU_METHOD temp_ub_q0p75_o48 "" RAT_FUNC "%6.2" "Grad C" COEFFS 0 1 48 0 0 0.75 /end COMPU_METHOD
/begin COMPU_METHOD TransR "" RAT_FUNC "%6.4" "-" COEFFS 0 100 0 0 0 1 /end COMPU_METHOD
/begin COMPU_METHOD Trq "" RAT_FUNC "%6.3" "Nm" COEFFS 0 10 0 0 0 1 /end COMPU_METHOD
/begin COMPU_METHOD TrqPrpHigh "" RAT_FUNC "%6.3" "Nm" COEFFS 0 10 0 0 0 1 /end COMPU_METHOD
/begin COMPU_METHOD t_q0p1 "" RAT_FUNC "%6.3" "s" COEFFS 0 10 0 0 0 1 /end COMPU_METHOD
/begin COMPU_METHOD t_q1 "" RAT_FUNC "%6.2" "s" COEFFS 0 1 0 0 0 1 /end COMPU_METHOD
/begin COMPU_METHOD t_q4_s "" RAT_FUNC "%6.2" "s" COEFFS 0 1 0 0 0 4 /end COMPU_METHOD
/begin COMPU_METHOD vol_q0p01_l "" RAT_FUNC "%6.4" "L" COEFFS 0 100 0 0 0 1 /end COMPU_METHOD
/begin COMPU_METHOD vol_q0p1_l "" RAT_FUNC "%6.3" "l" COEFFS 0 1 0 0 0 0.1 /end COMPU_METHOD
/begin COMPU_METHOD zk100msxs_uw_b6553p6 "" RAT_FUNC "%6.1" "s" COEFFS 0 0 65536 0 10 0 /end COMPU_METHOD
/begin COMPU_METHOD zk10msxs_uw_b655p36 "" RAT_FUNC "%6.2" "s" COEFFS 0 0 65536 0 100 0 /end COMPU_METHOD
/begin RECORD_LAYOUT RB_Curve_S16_S16 NO_AXIS_PTS_X 1 SWORD AXIS_PTS_X 2 SWORD INDEX_INCR DIRECT FNC_VALUES 3 SWORD COLUMN_DIR DIRECT /end RECORD_LAYOUT
/begin RECORD_LAYOUT RB_Curve_S16_U16_Static NO_AXIS_PTS_X 1 SWORD AXIS_PTS_X 2 SWORD INDEX_INCR DIRECT FNC_VALUES 3 UWORD COLUMN_DIR DIRECT STATIC_RECORD_LAYOUT /end RECORD_LAYOUT
/begin RECORD_LAYOUT RB_Curve_S16_U8_Static NO_AXIS_PTS_X 1 SWORD AXIS_PTS_X 2 SWORD INDEX_INCR DIRECT FNC_VALUES 3 UBYTE COLUMN_DIR DIRECT STATIC_RECORD_LAYOUT /end RECORD_LAYOUT
/begin RECORD_LAYOUT RB_Curve_U16_U16 NO_AXIS_PTS_X 1 UWORD AXIS_PTS_X 2 UWORD INDEX_INCR DIRECT FNC_VALUES 3 UWORD COLUMN_DIR DIRECT /end RECORD_LAYOUT
/begin RECORD_LAYOUT RB_Curve_U8_U16_Static NO_AXIS_PTS_X 1 UBYTE AXIS_PTS_X 2 UBYTE INDEX_INCR DIRECT FNC_VALUES 3 UWORD COLUMN_DIR DIRECT STATIC_RECORD_LAYOUT /end RECORD_LAYOUT
/begin RECORD_LAYOUT RB_Map_S16U16_U16 NO_AXIS_PTS_X 1 SWORD NO_AXIS_PTS_Y 2 SWORD AXIS_PTS_X 3 SWORD INDEX_INCR DIRECT AXIS_PTS_Y 4 UWORD INDEX_INCR DIRECT FNC_VALUES 5 UWORD ROW_DIR DIRECT /end RECORD_LAYOUT
/begin RECORD_LAYOUT RB_Map_U16S16_S16 NO_AXIS_PTS_X 1 UWORD NO_AXIS_PTS_Y 2 UWORD AXIS_PTS_X 3 UWORD INDEX_INCR DIRECT AXIS_PTS_Y 4 SWORD INDEX_INCR DIRECT FNC_VALUES 5 SWORD COLUMN_DIR DIRECT /end RECORD_LAYOUT
/begin RECORD_LAYOUT RB_Map_U8U16_U16 NO_AXIS_PTS_X 1 UBYTE NO_AXIS_PTS_Y 2 UBYTE AXIS_PTS_X 3 UBYTE INDEX_INCR DIRECT AXIS_PTS_Y 4 UWORD INDEX_INCR DIRECT FNC_VALUES 5 UWORD ROW_DIR DIRECT /end RECORD_LAYOUT
/begin RECORD_LAYOUT RB_Val_Wboolean FNC_VALUES 1 UBYTE COLUMN_DIR DIRECT /end RECORD_LAYOUT
/begin RECORD_LAYOUT RB_Val_Ws16 FNC_VALUES 1 SWORD COLUMN_DIR DIRECT /end RECORD_LAYOUT
/begin RECORD_LAYOUT RB_Val_Ws32 FNC_VALUES 1 SLONG COLUMN_DIR DIRECT /end RECORD_LAYOUT
/begin RECORD_LAYOUT RB_Val_Wu16 FNC_VALUES 1 UWORD COLUMN_DIR DIRECT /end RECORD_LAYOUT
/begin RECORD_LAYOUT RB_Val_Wu8 FNC_VALUES 1 UBYTE COLUMN_DIR DIRECT /end RECORD_LAYOUT
/end MODULE
/end PROJECT
