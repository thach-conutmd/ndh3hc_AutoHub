ASAP2_VERSION 1 60
/begin PROJECT MG1CS022 "MG1CS022"
/begin HEADER "" VERSION "MG1CS022_62XSC_V037_TPROT" PROJECT_NO MG1CS022 /end HEADER
/begin MODULE DIM ""
/begin MOD_COMMON "" BYTE_ORDER MSB_LAST ALIGNMENT_BYTE 1 ALIGNMENT_WORD 2 ALIGNMENT_LONG 4 ALIGNMENT_INT64 4 ALIGNMENT_FLOAT32_IEEE 4 ALIGNMENT_FLOAT64_IEEE 4 DATA_SIZE 32 /end MOD_COMMON
/begin CHARACTERISTIC T50_stDftVal_C "Calibratable default value of T50 status" VALUE 0x8057EC7A Val_Wu8 255.0 OneToOne 0.00 255.0 FORMAT "%5.1" /end CHARACTERISTIC
/begin CHARACTERISTIC T50_stEmgyDfl_C "Default value for emergency start request from T50" VALUE 0x8059149C Val_Wu8 255.0 OneToOne 0.00 255.0 FORMAT "%5.1" /end CHARACTERISTIC
/begin CHARACTERISTIC T50_stNormDfl_C "Default value for normal start request from T50" VALUE 0x8059149D Val_Wu8 255.0 OneToOne 0.00 255.0 FORMAT "%5.1" /end CHARACTERISTIC
/begin CHARACTERISTIC T50_swtEmgyReq_C "Switch to select whether the emergency start request is from hardware, OutSel or both." VALUE 0x8059149E Val_Wu8 255.0 OneToOne 0.00 255.0 FORMAT "%5.1" /end CHARACTERISTIC
/begin CHARACTERISTIC T50_swtNormReq_C "Switch to select whether the normal start request is from hardware, OutSel or both." VALUE 0x8059149F Val_Wu8 255.0 OneToOne 0.00 255.0 FORMAT "%5.1" /end CHARACTERISTIC
/begin CHARACTERISTIC T50_swtSigSel_C "To select between h\w signal or can signal" VALUE 0x8057EC7B Val_Wu8 2.000 OneToOne 0.00 2.000 FORMAT "%5.3" EXTENDED_LIMITS 0.00 255.0 /end CHARACTERISTIC
/begin CHARACTERISTIC T50_tiDebHiLo_C "Debounce time period for High to Low transition for T50 signal" VALUE 0x80591498 Val_Wu16 655350.0 TimeDeb 0.00 655350.0 FORMAT "%8.1" /end CHARACTERISTIC
/begin CHARACTERISTIC T50_tiDebLoHi_C "Debounce time peiod for Low to High transition for T50 signal" VALUE 0x8059149A Val_Wu16 655350.0 TimeDeb 0.00 655350.0 FORMAT "%8.1" /end CHARACTERISTIC
/begin CHARACTERISTIC T50_tiEmgcyReq_C "Applicable time for emergency request" VALUE 0x805914A0 Val_Wu16 655350.0 Time_ms 0.00 655350.0 FORMAT "%8.1" /end CHARACTERISTIC
/begin CHARACTERISTIC TCE_flgGenericFcoReq_C "Calibration for generic Fuel Cut Off request" VALUE 0x8057EC7C RB_Val_Wboolean 1.00000000000 B_TRUE 0.00 1.00000000000 FORMAT "%13.11" /end CHARACTERISTIC
/begin CHARACTERISTIC TCE_flgGenericFcoRst_C "Calibration for generic Fuel Cut Off reset" VALUE 0x8057EC7D RB_Val_Wboolean 1.00000000000 B_TRUE 0.00 1.00000000000 FORMAT "%13.11" /end CHARACTERISTIC
/begin CHARACTERISTIC TCE_numCcoThd_C "Threshold for number of cylinder in cut-off to set the FCO started flag" VALUE 0x8057EC80 RB_Val_Wu8 255.0 OneToOne 0.00 255.0 FORMAT "%5.1" /end CHARACTERISTIC
/begin CHARACTERISTIC TCE_tiExptFcoStrt_C "Time after which FCO will start" VALUE 0x8057EC84 RB_Val_Wu32 4294967.29500 Time_ms2us 0.00 4294967.29500 FORMAT "%13.5" /end CHARACTERISTIC
/begin CHARACTERISTIC TCE_tqOverrunOffsThdAcOn_M "Threshold torque when AC ON" MAP 0x8057EC88 RB_Map_S16S16_S16 6553.500 Trq -3276.800 3276.700 FORMAT "%8.3"
 /begin AXIS_DESCR STD_AXIS TCE_nEngTmp EngN 8 -16384.00 16383.50 FORMAT "%8.2" DEPOSIT ABSOLUTE /end AXIS_DESCR
 /begin AXIS_DESCR STD_AXIS TCE_tqInnrSetCo Trq 8 0.00 3276.700 FORMAT "%8.3" EXTENDED_LIMITS -3276.800 3276.700 DEPOSIT ABSOLUTE /end AXIS_DESCR
/end CHARACTERISTIC
/begin CHARACTERISTIC TCE_tqOverrunOffsThd_M "Threshold torque" MAP 0x8057ED2C RB_Map_S16S16_S16 6553.500 Trq -3276.800 3276.700 FORMAT "%8.3"
 /begin AXIS_DESCR STD_AXIS TCE_nEngTmp EngN 8 -16384.00 16383.50 FORMAT "%8.2" DEPOSIT ABSOLUTE /end AXIS_DESCR
 /begin AXIS_DESCR STD_AXIS TCE_tqInnrSetCo Trq 8 0.00 3276.700 FORMAT "%8.3" EXTENDED_LIMITS -3276.800 3276.700 DEPOSIT ABSOLUTE /end AXIS_DESCR
/end CHARACTERISTIC
/begin CHARACTERISTIC TDevCrssChk_stCfgSwt_C "Configuration switch for Tdev_CrssChk" VALUE 0x8057EDD0 RB_Val_Wu8 255.0 OneToOne 0.00 255.0 FORMAT "%5.1" /end CHARACTERISTIC
/begin CHARACTERISTIC TDevCrssChk_stEnaSnsrForCalcAvrg_C "Codeword for choise of sensors for calculation of mean value in coldstart diagnosis" VALUE 0x8057EDD2 RB_Val_Wu16 65535.00 OneToOne 0.00 65535.00 FORMAT "%8.2" /end CHARACTERISTIC
/begin CHARACTERISTIC TDevCrssChk_stSnsrEnaForColdChk_C "Codeword for choise of sensors for execution of coldstart dignosis" VALUE 0x8057EDD4 RB_Val_Wu16 65535.00 OneToOne 0.00 65535.00 FORMAT "%8.2" /end CHARACTERISTIC
/begin CHARACTERISTIC TDevCrssChk_tDiffColdStrtMaxThd_C "Upper Threshold for detection of coldstart error" VALUE 0x8057EDD6 RB_Val_Ws16 6553.500 Temp_Cels -3549.940 3003.560 FORMAT "%8.3" /end CHARACTERISTIC
/begin CHARACTERISTIC TDevCrssChk_tDiffColdStrtMinThd_C "Lower Threshold for detection of coldstart error" VALUE 0x8057EDD8 RB_Val_Ws16 6553.500 Temp_Cels -3549.940 3003.560 FORMAT "%8.3" /end CHARACTERISTIC
/begin CHARACTERISTIC TDevCrssChk_tDiffIntkAirTMaxThd_C "Upper Threshold for detection of coldstart error (IntkAirT)" VALUE 0x8057EDDA RB_Val_Ws16 6553.500 Temp_Cels -3549.940 3003.560 FORMAT "%8.3" /end CHARACTERISTIC
/begin CHARACTERISTIC TDevCrssChk_tDiffIntkAirTMinThd_C "Lower Threshold for detection of coldstart error (IntkAirT)" VALUE 0x8057EDDC RB_Val_Ws16 6553.500 Temp_Cels -3549.940 3003.560 FORMAT "%8.3" /end CHARACTERISTIC
/begin CHARACTERISTIC TDevCrssChk_tiDebEngOff_C "CrossCheck parameter for debounce of engine speed signal (turn off delay)" VALUE 0x8057EDDE RB_Val_Wu8 255.0 t_q1 0.00 255.0 FORMAT "%5.1" /end CHARACTERISTIC
/begin CHARACTERISTIC TDevCrssChk_tiDebEngOn_C "CrossCheck parameter for debounce of engine speed signal (turn ofndelay)" VALUE 0x8057EDDF RB_Val_Wu8 255.0 t_q1 0.00 255.0 FORMAT "%5.1" /end CHARACTERISTIC
/begin CHARACTERISTIC TDevCrssChk_tiForBlkHeatrDetn_C "CrossCheck timeslot for block heater detection" VALUE 0x8057EDE0 RB_Val_Wu8 255.0 t_q1 0.00 255.0 FORMAT "%5.1" /end CHARACTERISTIC
/begin CHARACTERISTIC TDevCrssChk_tiForEngStrtFaild_C "CrossCheck timeslot for detection of engine start failure" VALUE 0x8057EDE1 RB_Val_Wu8 255.0 t_q1 0.00 255.0 FORMAT "%5.1" /end CHARACTERISTIC
/begin CHARACTERISTIC TDevCrssChk_tiMaxForColdStrtDiag_C "CrossCheck maximum timeslot for coldstart diagnosis" VALUE 0x8057EDE2 RB_Val_Wu8 10.00 t_q1 0.00 10.00 FORMAT "%5.2" EXTENDED_LIMITS 0.00 255.0 /end CHARACTERISTIC
/begin CHARACTERISTIC TDevCrssChk_tiMinEngCoolgDwn_T "Minimum engine cool down time corresponding to engine stop temperature" CURVE 0x8057EDE4 RB_Curve_S16_U16_Static 262140.0 t_q4_s 0.00 262140.0 FORMAT "%8.1"
 /begin AXIS_DESCR STD_AXIS CEngDsT_tStop Temp_Cels 3 -3549.940 3003.560 FORMAT "%8.3" DEPOSIT ABSOLUTE /end AXIS_DESCR
/end CHARACTERISTIC
/begin CHARACTERISTIC TDevCrssChk_tiT15Dly_C "CrossCheck time for T15 delay" VALUE 0x8057EDF2 RB_Val_Wu8 255.0 t_q1 0.00 255.0 FORMAT "%5.1" /end CHARACTERISTIC
/begin CHARACTERISTIC TDevCrssChk_tMinThdForEngStal_C "CrossCheck Minimum temperaute threshold for diagnosis at abortive start" VALUE 0x8057EDF4 RB_Val_Ws16 6553.500 Temp_Cels -3549.940 3003.560 FORMAT "%8.3" /end CHARACTERISTIC
/begin CHARACTERISTIC ThDev_flgACMaiSwtCodVal_C "Status of AC switch in case of coded configuration" VALUE 0x8057FD58 RB_Val_Wu8 1.00000000000 B_TRUE 0.00 1.00000000000 FORMAT "%13.11" /end CHARACTERISTIC
/begin CHARACTERISTIC ThDev_stACMaiSwtSig_C "The source of the main AC switch" VALUE 0x8057FD59 RB_Val_Wu8 255.0 OneToOne 0.00 255.0 FORMAT "%5.1" /end CHARACTERISTIC
/begin CHARACTERISTIC ThrVlv_flgLimpAirPosnFctEnaB1_C "Limp air position enable for Bank1 Calibration" VALUE 0x80505588 Val_Wu8 1.000 OneToOne 0.00 1.000 FORMAT "%5.3" EXTENDED_LIMITS 0.00 255.0 /end CHARACTERISTIC
/begin CHARACTERISTIC ThrVlv_IfClsdOffsLrnPrm_IF.nrDcycOffsLrnExeRels_C "Interface class instance, provides calibration parameters to calculate and check lower mechanical stop / Number of driving cycles by which offset learning execution is performed again" VALUE 0x8050558A Val_Wu8 255.0 OneToOne 0.00 255.0 FORMAT "%5.1" /end CHARACTERISTIC
/begin CHARACTERISTIC ThrVlv_IfClsdOffsLrnPrm_IF.ratOffsLrnDutyCycThd_C "Interface class instance, provides calibration parameters to calculate and check lower mechanical stop / Duty Cycle threshold to start calculation of mechanical stop" VALUE 0x8050558C Val_Ws16 511.9922 rel_q0p0078125 -256.0000 255.9922 FORMAT "%8.4" /end CHARACTERISTIC
/begin CHARACTERISTIC ThrVlv_IfClsdOffsLrnPrm_IF.ratOffsLrnStep_C "Interface class instance, provides calibration parameters to calculate and check lower mechanical stop / Position step- size to ramp into mechanical stop" VALUE 0x8050558E Val_Ws16 511.9922 rel_q0p0078125 -256.0000 255.9922 FORMAT "%8.4" /end CHARACTERISTIC
/begin CHARACTERISTIC ThrVlv_IfClsdOffsLrnPrm_IF.ratOffsLrnStrtPosn_C "Interface class instance, provides calibration parameters to calculate and check lower mechanical stop / Desired position value to start ramping into mechanical stop" VALUE 0x80505590 Val_Ws16 511.9922 rel_q0p0078125 -256.0000 255.9922 FORMAT "%8.4" /end CHARACTERISTIC
/begin CHARACTERISTIC ThrVlv_IfClsdOffsLrnPrm_IF.ratOffsLrnStrtRng_C "Interface class instance, provides calibration parameters to calculate and check lower mechanical stop / Range for actual position value (offset to Desired position value) to start ramping into mechanical stop" VALUE 0x80505592 Val_Ws16 511.9922 rel_q0p0078125 -256.0000 255.9922 FORMAT "%8.4" /end CHARACTERISTIC
/begin CHARACTERISTIC ThrVlv_IfClsdOffsLrnPrm_IF.tiOffsLrnStopPosn_C "Interface class instance, provides calibration parameters to calculate and check lower mechanical stop / Duration for average calculation of learned voltage at mechanical stop" VALUE 0x80505594 Val_Wu16 655.3500 t_q0p01 0.00 655.3500 FORMAT "%8.4" /end CHARACTERISTIC
/begin CHARACTERISTIC ThrVlv_IfClsdOffsLrnPrm_IF.tiOffsLrnTout_C "Interface class instance, provides calibration parameters to calculate and check lower mechanical stop / Timeout value for each individual learning step of mechanical stop learning" VALUE 0x80505596 Val_Wu16 655.3500 t_q0p01 0.00 655.3500 FORMAT "%8.4" /end CHARACTERISTIC
/begin CHARACTERISTIC ThrVlv_IfClsdOffsLrnPrm_IF.uElecOffsStopPosn_C "Interface class instance, provides calibration parameters to calculate and check lower mechanical stop / electrical offset for learned voltage at mechanical stop" VALUE 0x80505598 Val_Wu16 79.99878 spg_q1p221Em3_V 0.00 79.99878 FORMAT "%8.5" /end CHARACTERISTIC
/begin CHARACTERISTIC ThrVlv_IfClsdOffsLrnPrm_IF.uElecStopPosn_C "Interface class instance, provides calibration parameters to calculate and check lower mechanical stop / voltage at mechanical stop in case no learned values available or offset learning error applied" VALUE 0x8050559A Val_Wu16 79.99878 spg_q1p221Em3_V 0.00 79.99878 FORMAT "%8.5" /end CHARACTERISTIC
/begin CHARACTERISTIC ThrVlv_IfClsdOffsLrnPrm_IF.uElecStopSnsr1Max_C "Interface class instance, provides calibration parameters to calculate and check lower mechanical stop / Threshold for maximum voltage value allowed at mechanical stop, position sensor 1" VALUE 0x8050559C Val_Wu16 79.99878 spg_q1p221Em3_V 0.00 79.99878 FORMAT "%8.5" /end CHARACTERISTIC
/begin CHARACTERISTIC ThrVlv_IfClsdOffsLrnPrm_IF.uElecStopSnsr1Min_C "Interface class instance, provides calibration parameters to calculate and check lower mechanical stop / Threshold for minimum voltage value allowed at mechanical stop, position sensor 1" VALUE 0x8050559E Val_Wu16 79.99878 spg_q1p221Em3_V 0.00 79.99878 FORMAT "%8.5" /end CHARACTERISTIC
/begin CHARACTERISTIC ThrVlv_IfClsdOffsLrnPrm_IF.uOffsLrnCalcNotPlaus_C "Interface class instance, provides calibration parameters to calculate and check lower mechanical stop / Threshold for allowed voltage difference during mean value calculation at mechanical stop, position sensor 1" VALUE 0x805055A0 Val_Ws16 79.99878 spg_q1p221Em3_V -40.00000 39.99878 FORMAT "%8.5" /end CHARACTERISTIC
/begin CHARACTERISTIC ThrVlv_IfColdCdnOffsPrm_IF.flgCalcColdCdnOffs_C "Interface class instance, provides calibration parameters to calculate and check for position offset at cold temperature conditions / Function to calculate offset in case of cold condition and valve stuck enabled" VALUE 0x805055A8 Val_Wu8 1.000 OneToOne 0.00 1.000 FORMAT "%5.3" EXTENDED_LIMITS 0.00 255.0 /end CHARACTERISTIC
/begin CHARACTERISTIC ThrVlv_IfColdCdnOffsPrm_IF.flgColdCdnOffsMonRels_C "Interface class instance, provides calibration parameters to calculate and check for position offset at cold temperature conditions / Calculation of offset in case of cold conditions released by monitoring conditions" VALUE 0x805055A9 Val_Wu8 1.000 OneToOne 0.00 1.000 FORMAT "%5.3" EXTENDED_LIMITS 0.00 255.0 /end CHARACTERISTIC
/begin CHARACTERISTIC ThrVlv_IfColdCdnOffsPrm_IF.flgColdCdnOffsSimn_C "Interface class instance, provides calibration parameters to calculate and check for position offset at cold temperature conditions / Offset simulation in case of cold temperature condition active" VALUE 0x805055AA Val_Wu8 1.000 OneToOne 0.00 1.000 FORMAT "%5.3" EXTENDED_LIMITS 0.00 255.0 /end CHARACTERISTIC
/begin CHARACTERISTIC ThrVlv_IfColdCdnOffsPrm_IF.flgColdCdnT_MAP "Interface class instance, provides calibration parameters to calculate and check for position offset at cold temperature conditions / MAP to calibrate Cold temperature condition" MAP 0x805055AC Map_Xs16Ys16Ws16 1.000000 dez 0.00 1.000000 FORMAT "%8.6" EXTENDED_LIMITS -32768.00 32767.00
 /begin AXIS_DESCR STD_AXIS NO_INPUT_QUANTITY Temp_Cels 10 -3549.940 3003.560 FORMAT "%8.3" DEPOSIT ABSOLUTE /end AXIS_DESCR
 /begin AXIS_DESCR STD_AXIS NO_INPUT_QUANTITY Temp_Cels 10 -3549.940 3003.560 FORMAT "%8.3" DEPOSIT ABSOLUTE /end AXIS_DESCR
/end CHARACTERISTIC
/begin CHARACTERISTIC ThrVlv_IfColdCdnOffsPrm_IF.flgRvsColdCdnRampDwnCompl_C "Interface class instance, provides calibration parameters to calculate and check for position offset at cold temperature conditions / Stepwise ramp down of offset from cold temperature conditions to 0 at once, even if desired position is not 0, active" VALUE 0x805056A0 Val_Wu8 1.000 OneToOne 0.00 1.000 FORMAT "%5.3" EXTENDED_LIMITS 0.00 255.0 /end CHARACTERISTIC
/begin CHARACTERISTIC ThrVlv_IfColdCdnOffsPrm_IF.ratActGrdtColdCdnOffs_C "Interface class instance, provides calibration parameters to calculate and check for position offset at cold temperature conditions / Valve speed threshold to check for stuck valve at cold temperature conditions" VALUE 0x805056A2 Val_Ws16 3839.941 q0p0586_pc_DIV_s -1920.000 1919.941 FORMAT "%8.3" /end CHARACTERISTIC
/begin CHARACTERISTIC ThrVlv_IfColdCdnOffsPrm_IF.ratColdCdnOffsDutyCycMax_C "Interface class instance, provides calibration parameters to calculate and check for position offset at cold temperature conditions / Duty Cycle threshold to calculate offset at cold temperature conditions" VALUE 0x805056A4 Val_Ws16 511.9922 rel_q0p0078125 -256.0000 255.9922 FORMAT "%8.4" /end CHARACTERISTIC
/begin CHARACTERISTIC ThrVlv_IfColdCdnOffsPrm_IF.ratColdCdnOffsDutyCycMin_C "Interface class instance, provides calibration parameters to calculate and check for position offset at cold temperature conditions / Duty Cycle threshold to reduce offset from cold temperature conditions gradually" VALUE 0x805056A6 Val_Ws16 511.9922 rel_q0p0078125 -256.0000 255.9922 FORMAT "%8.4" /end CHARACTERISTIC
/begin CHARACTERISTIC ThrVlv_IfColdCdnOffsPrm_IF.ratColdCdnOffsPosnThd_C "Interface class instance, provides calibration parameters to calculate and check for position offset at cold temperature conditions / Threshold for desired position to release check for cold temperature conditions" VALUE 0x805056A8 Val_Ws16 511.9922 rel_q0p0078125 -256.0000 255.9922 FORMAT "%8.4" /end CHARACTERISTIC
/begin CHARACTERISTIC ThrVlv_IfColdCdnOffsPrm_IF.ratColdCdnRelActPosn_C "Interface class instance, provides calibration parameters to calculate and check for position offset at cold temperature conditions / Threshold for actual position relative to desired position (offset) to release check for cold temperature conditions" VALUE 0x805056AA Val_Ws16 511.9922 rel_q0p0078125 -256.0000 255.9922 FORMAT "%8.4" /end CHARACTERISTIC
/begin CHARACTERISTIC ThrVlv_IfColdCdnOffsPrm_IF.tAirColdCdnMltd_C "Interface class instance, provides calibration parameters to calculate and check for position offset at cold temperature conditions / Melted air temperature threshold to reduce offset from cold temperature conditions gradually" VALUE 0x805056AC Val_Ws16 6553.500 Temp_Cels -3549.940 3003.560 FORMAT "%8.3" /end CHARACTERISTIC
/begin CHARACTERISTIC ThrVlv_IfColdCdnOffsPrm_IF.tEngColdCdnMltd_C "Interface class instance, provides calibration parameters to calculate and check for position offset at cold temperature conditions / Melted engine temperature threshold to reduce offset from cold temperature conditions gradually" VALUE 0x805056AE Val_Ws16 6553.500 Temp_Cels -3549.940 3003.560 FORMAT "%8.3" /end CHARACTERISTIC
/begin CHARACTERISTIC ThrVlv_IfColdCdnOffsPrm_IF.tiDeltaRatActColdCdnOffsMin_C "Interface class instance, provides calibration parameters to calculate and check for position offset at cold temperature conditions / PT1 filter time for valve speed" VALUE 0x805056B0 Val_Ws32 2147.48364600 Time_Dt 0.00000100 2147.48364700 FORMAT "%13.8" EXTENDED_LIMITS -2147.48364800 2147.48364700 /end CHARACTERISTIC
/begin CHARACTERISTIC ThrVlv_IfColdCdnOffsPrm_IF.tiDutyCycColdCdnOffsDly_C "Interface class instance, provides calibration parameters to calculate and check for position offset at cold temperature conditions / Time for which Duty Cycle threshold must be exceeded to start calculation for offset at cold temperature conditions" VALUE 0x805056B4 Val_Ws32 4294.96729500 Time_Dt -2147.48364800 2147.48364700 FORMAT "%13.8" /end CHARACTERISTIC
/begin CHARACTERISTIC ThrVlv_IfColdCdnOffsPrm_IF.tiDutyCycRvsColdCdnOffsDly_C "Interface class instance, provides calibration parameters to calculate and check for position offset at cold temperature conditions / Time for which Duty Cycle threshold must be exceeded to stop reducing of offset from cold temperature conditions gradually" VALUE 0x805056B8 Val_Ws32 4294.96729500 Time_Dt -2147.48364800 2147.48364700 FORMAT "%13.8" /end CHARACTERISTIC
/begin CHARACTERISTIC ThrVlv_IfColdCdnOffsPrm_IF.uColdCdnOffsMax_C "Interface class instance, provides calibration parameters to calculate and check for position offset at cold temperature conditions / Maximum allowed voltage offset at cold temperature conditions" VALUE 0x805056BC Val_Ws16 79.99878 spg_q1p221Em3_V -40.00000 39.99878 FORMAT "%8.5" /end CHARACTERISTIC
/begin CHARACTERISTIC ThrVlv_IfColdCdnOffsPrm_IF.uColdCdnOffsMin_C "Interface class instance, provides calibration parameters to calculate and check for position offset at cold temperature conditions / Minimum allowed voltage offset at cold temperature conditions" VALUE 0x805056BE Val_Ws16 79.99878 spg_q1p221Em3_V -40.00000 39.99878 FORMAT "%8.5" /end CHARACTERISTIC
/begin CHARACTERISTIC ThrVlv_IfColdCdnOffsPrm_IF.uColdCdnOffsSimn_C "Interface class instance, provides calibration parameters to calculate and check for position offset at cold temperature conditions / Simulated voltage offset for cold temperature condition" VALUE 0x805056C0 Val_Wu16 79.99878 spg_q1p221Em3_V 0.00 79.99878 FORMAT "%8.5" /end CHARACTERISTIC
/begin CHARACTERISTIC ThrVlv_IfColdCdnOffsPrm_IF.uColdCdnOffsStep_C "Interface class instance, provides calibration parameters to calculate and check for position offset at cold temperature conditions / Voltage step- size to reduce offset from cold temperature conditions" VALUE 0x805056C2 Val_Wu16 79.99878 spg_q1p221Em3_V 0.00 79.99878 FORMAT "%8.5" /end CHARACTERISTIC
/begin CHARACTERISTIC ThrVlv_IfColdCdnOffsPrm_IF.uColdCdnOffs_C "Interface class instance, provides calibration parameters to calculate and check for position offset at cold temperature conditions / Additional offset to calculated offset from cold temperature conditions" VALUE 0x805056C4 Val_Wu16 79.99878 spg_q1p221Em3_V 0.00 79.99878 FORMAT "%8.5" /end CHARACTERISTIC
/begin CHARACTERISTIC ThrVlv_IfLimpAirPosnPrm_IF.numDetLimpAirPosnCyc_C "Interface class instance, provides calibration parameters to calculate and check limp air position / Number of learning cycles to determine limp air position" VALUE 0x805056C8 Val_Wu8 127.0 OneToOne 0.00 127.0 FORMAT "%5.1" EXTENDED_LIMITS 0.00 255.0 /end CHARACTERISTIC
/begin CHARACTERISTIC ThrVlv_IfLimpAirPosnPrm_IF.tiLimpAirPosnCalc_C "Interface class instance, provides calibration parameters to calculate and check limp air position / Duration for avarage calculation of limp air position" VALUE 0x805056CA Val_Wu16 655.3500 t_q0p01 0.00 655.3500 FORMAT "%8.4" /end CHARACTERISTIC
/begin CHARACTERISTIC ThrVlv_IfLimpAirPosnPrm_IF.tiLimpAirPosnStabDly_C "Interface class instance, provides calibration parameters to calculate and check limp air position / Time until actuator has levelled off into limp air position after power stage switch off" VALUE 0x805056CC Val_Wu16 655.3500 t_q0p01 0.00 655.3500 FORMAT "%8.4" /end CHARACTERISTIC
/begin CHARACTERISTIC ThrVlv_IfLimpAirPosnPrm_IF.uLimpAirPosnDrift_C "Interface class instance, provides calibration parameters to calculate and check limp air position / Threshold for maximum drift of limp air position related to first learned value" VALUE 0x805056CE Val_Wu16 79.99878 spg_q1p221Em3_V 0.00 79.99878 FORMAT "%8.5" /end CHARACTERISTIC
/begin CHARACTERISTIC ThrVlv_IfLimpAirPosnPrm_IF.uLimpAirPosnMax_C "Interface class instance, provides calibration parameters to calculate and check limp air position / Threshold for maximum absolute limp air position allowed" VALUE 0x805056D0 Val_Wu16 79.99878 spg_q1p221Em3_V 0.00 79.99878 FORMAT "%8.5" /end CHARACTERISTIC
/begin CHARACTERISTIC ThrVlv_IfLimpAirPosnPrm_IF.uLimpAirPosnMin_C "Interface class instance, provides calibration parameters to calculate and check limp air position / Threshold for minimum absolute limp air position allowed" VALUE 0x805056D2 Val_Wu16 79.99878 spg_q1p221Em3_V 0.00 79.99878 FORMAT "%8.5" /end CHARACTERISTIC
/begin CHARACTERISTIC ThrVlv_IfLimpAirPosnPrm_IF.uLimpAirPosnPlaus_C "Interface class instance, provides calibration parameters to calculate and check limp air position / Threshold for plausibility check of actual learned value versus last stored value" VALUE 0x805056D4 Val_Wu16 79.99878 spg_q1p221Em3_V 0.00 79.99878 FORMAT "%8.5" /end CHARACTERISTIC
/begin CHARACTERISTIC ThrVlv_IfOffsLrnRels_IF.nEngSpdThd_C "Interface class instance, provides calibration parameters to calculate the release conditions for offset learning / Engine speed threshold for offset learning release" VALUE 0x805056D6 Val_Wu16 32767.50 nmot_q0p5 0.00 32767.50 FORMAT "%8.2" /end CHARACTERISTIC
/begin CHARACTERISTIC ThrVlv_IfOffsLrnRels_IF.stRlsMsk_C "Interface class instance, provides calibration parameters to calculate the release conditions for offset learning / Mask to select release conditions for offset learning" VALUE 0x805056D8 Val_Wu16 65535.00 OneToOne 0.00 65535.00 FORMAT "%8.2" /end CHARACTERISTIC
/begin CHARACTERISTIC ThrVlv_IfOffsLrnRels_IF.tAirMax_C "Interface class instance, provides calibration parameters to calculate the release conditions for offset learning / Maximum air temperature threshold for offset learning release" VALUE 0x805056DA Val_Ws16 6553.500 Temp_Cels -3549.940 3003.560 FORMAT "%8.3" /end CHARACTERISTIC
/begin CHARACTERISTIC ThrVlv_IfOffsLrnRels_IF.tAirMin_C "Interface class instance, provides calibration parameters to calculate the release conditions for offset learning / Minimum air temperature threshold for offset learning release" VALUE 0x805056DC Val_Ws16 6553.500 Temp_Cels -3549.940 3003.560 FORMAT "%8.3" /end CHARACTERISTIC
/begin CHARACTERISTIC ThrVlv_IfOffsLrnRels_IF.tEngMax_C "Interface class instance, provides calibration parameters to calculate the release conditions for offset learning / Maximum engine temperature threshold for offset learning release" VALUE 0x805056DE Val_Ws16 6553.500 Temp_Cels -3549.940 3003.560 FORMAT "%8.3" /end CHARACTERISTIC
/begin CHARACTERISTIC ThrVlv_IfOffsLrnRels_IF.tEngMin_C "Interface class instance, provides calibration parameters to calculate the release conditions for offset learning / Minimum engine temperature threshold for offset learning release" VALUE 0x805056E0 Val_Ws16 6553.500 Temp_Cels -3549.940 3003.560 FORMAT "%8.3" /end CHARACTERISTIC
/begin CHARACTERISTIC ThrVlv_IfOffsLrnRels_IF.uBattMax_C "Interface class instance, provides calibration parameters to calculate the release conditions for offset learning / Maximum battery voltage threshold for offset learning release" VALUE 0x805056E2 Val_Ws16 1310700. Volt_Batt -655360.0 655340.0 FORMAT "%8.1" /end CHARACTERISTIC
/begin CHARACTERISTIC ThrVlv_IfOffsLrnRels_IF.uBattMin_C "Interface class instance, provides calibration parameters to calculate the release conditions for offset learning / Minimum battery voltage threshold for offset learning release" VALUE 0x805056E4 Val_Ws16 1310700. Volt_Batt -655360.0 655340.0 FORMAT "%8.1" /end CHARACTERISTIC
/begin CHARACTERISTIC ThrVlv_IfOffsLrnRels_IF.vVehVThd_C "Interface class instance, provides calibration parameters to calculate the release conditions for offset learning / Vehicle speed threshold for offset learning release" VALUE 0x805056E6 Val_Ws16 655.3500 Vel -327.6800 327.6700 FORMAT "%8.4" /end CHARACTERISTIC
/begin CHARACTERISTIC ThrVlv_IfOffsLrnSnsr2Prm_IF.uElecStopSnsr2Max_C "Interface class instance, provides calibration parameters to calculate and check Sensor2 values at lower mechanical stop / Threshold for maximum voltage value allowed at mechanical stop, position sensor 2" VALUE 0x805056E8 Val_Wu16 79.99878 spg_q1p221Em3_V 0.00 79.99878 FORMAT "%8.5" /end CHARACTERISTIC
/begin CHARACTERISTIC ThrVlv_IfOffsLrnSnsr2Prm_IF.uElecStopSnsr2Min_C "Interface class instance, provides calibration parameters to calculate and check Sensor2 values at lower mechanical stop / Threshold for minimum voltage value allowed at mechanical stop, position sensor 2" VALUE 0x805056EA Val_Wu16 79.99878 spg_q1p221Em3_V 0.00 79.99878 FORMAT "%8.5" /end CHARACTERISTIC
/begin CHARACTERISTIC ThrVlv_IfOpenSprgChk_IF.flgOpenSprgChk_C "Interface class instance, provides calibration parameters to calculate open spring check. / Ceaning function enabled" VALUE 0x805056EC Val_Wu8 1.000 OneToOne 0.00 1.000 FORMAT "%5.3" EXTENDED_LIMITS 0.00 255.0 /end CHARACTERISTIC
/begin CHARACTERISTIC ThrVlv_IfPsDiagPrm_IF.tiOpenLoadDiagTout_C "Interface class instance, provides calibration parameters to calculate and verify power stage diagnosis, bank 1 / Timeout value to wait for power stage open load- diagnosis" VALUE 0x805056EE Val_Wu16 655.3500 t_q0p01 0.00 655.3500 FORMAT "%8.4" /end CHARACTERISTIC
/begin CHARACTERISTIC ThrVlv_IfRetSprgChkRels_IF.nEngSpdThd_C "Interface class instance, provides calibration parameters to calculate the release conditions for return spring check / Engine speed threshold for offset learning release" VALUE 0x805056F0 Val_Wu16 32767.50 nmot_q0p5 0.00 32767.50 FORMAT "%8.2" /end CHARACTERISTIC
/begin CHARACTERISTIC ThrVlv_IfRetSprgChkRels_IF.stRlsMsk_C "Interface class instance, provides calibration parameters to calculate the release conditions for return spring check / Mask to select release conditions for offset learning" VALUE 0x805056F2 Val_Wu16 65535.00 OneToOne 0.00 65535.00 FORMAT "%8.2" /end CHARACTERISTIC
/begin CHARACTERISTIC ThrVlv_IfRetSprgChkRels_IF.tAirMax_C "Interface class instance, provides calibration parameters to calculate the release conditions for return spring check / Maximum air temperature threshold for offset learning release" VALUE 0x805056F4 Val_Ws16 6553.500 Temp_Cels -3549.940 3003.560 FORMAT "%8.3" /end CHARACTERISTIC
/begin CHARACTERISTIC ThrVlv_IfRetSprgChkRels_IF.tAirMin_C "Interface class instance, provides calibration parameters to calculate the release conditions for return spring check / Minimum air temperature threshold for offset learning release" VALUE 0x805056F6 Val_Ws16 6553.500 Temp_Cels -3549.940 3003.560 FORMAT "%8.3" /end CHARACTERISTIC
/begin CHARACTERISTIC ThrVlv_IfRetSprgChkRels_IF.tEngMax_C "Interface class instance, provides calibration parameters to calculate the release conditions for return spring check / Maximum engine temperature threshold for offset learning release" VALUE 0x805056F8 Val_Ws16 6553.500 Temp_Cels -3549.940 3003.560 FORMAT "%8.3" /end CHARACTERISTIC
/begin CHARACTERISTIC ThrVlv_IfRetSprgChkRels_IF.tEngMin_C "Interface class instance, provides calibration parameters to calculate the release conditions for return spring check / Minimum engine temperature threshold for offset learning release" VALUE 0x805056FA Val_Ws16 6553.500 Temp_Cels -3549.940 3003.560 FORMAT "%8.3" /end CHARACTERISTIC
/begin CHARACTERISTIC ThrVlv_IfRetSprgChkRels_IF.uBattMax_C "Interface class instance, provides calibration parameters to calculate the release conditions for return spring check / Maximum battery voltage threshold for offset learning release" VALUE 0x805056FC Val_Ws16 1310700. Volt_Batt -655360.0 655340.0 FORMAT "%8.1" /end CHARACTERISTIC
/begin CHARACTERISTIC ThrVlv_IfRetSprgChkRels_IF.uBattMin_C "Interface class instance, provides calibration parameters to calculate the release conditions for return spring check / Minimum battery voltage threshold for offset learning release" VALUE 0x805056FE Val_Ws16 1310700. Volt_Batt -655360.0 655340.0 FORMAT "%8.1" /end CHARACTERISTIC
/begin CHARACTERISTIC ThrVlv_IfRetSprgChkRels_IF.vVehVThd_C "Interface class instance, provides calibration parameters to calculate the release conditions for return spring check / Vehicle speed threshold for offset learning release" VALUE 0x80505700 Val_Ws16 655.3500 Vel -327.6800 327.6700 FORMAT "%8.4" /end CHARACTERISTIC
/begin CHARACTERISTIC ThrVlv_IfSprgChkPrm_IF.ratLimpAirRng_C "Interface class instance, provides calibration parameters to calculate and verify return spring check / Range for actual position (offset to limp air position) to check whether limp air position is reached via return spring or via open spring" VALUE 0x80505702 Val_Ws16 511.9922 rel_q0p0078125 -256.0000 255.9922 FORMAT "%8.4" /end CHARACTERISTIC
/begin CHARACTERISTIC ThrVlv_IfSprgChkPrm_IF.ratOpenSprgSprdRng_C "Interface class instance, provides calibration parameters to calculate and verify return spring check / Range for actual position (offset to desired value) to check whether open spring spread position is reached" VALUE 0x80505704 Val_Ws16 511.9922 rel_q0p0078125 -256.0000 255.9922 FORMAT "%8.4" /end CHARACTERISTIC
/begin CHARACTERISTIC ThrVlv_IfSprgChkPrm_IF.ratRetSprgSprdRng_C "Interface class instance, provides calibration parameters to calculate and verify return spring check / Range for actual position (offset to desired value) to check whether return spring spread position is reached" VALUE 0x80505706 Val_Ws16 511.9922 rel_q0p0078125 -256.0000 255.9922 FORMAT "%8.4" /end CHARACTERISTIC
/begin CHARACTERISTIC ThrVlv_IfSprgChkPrm_IF.ratRetSprgSprd_C "Interface class instance, provides calibration parameters to calculate and verify return spring check / Position by which return spring is spread starting from power off position" VALUE 0x80505708 Val_Ws16 511.9922 rel_q0p0078125 -256.0000 255.9922 FORMAT "%8.4" /end CHARACTERISTIC
/begin CHARACTERISTIC ThrVlv_IfSprgChkPrm_IF.tiOpenSprgLimpAirPosn_C "Interface class instance, provides calibration parameters to calculate and verify return spring check / Maximum duration until limp air position must have been reached via open spring" VALUE 0x8050570A Val_Wu16 655.3500 t_q0p01 0.00 655.3500 FORMAT "%8.4" /end CHARACTERISTIC
/begin CHARACTERISTIC ThrVlv_IfSprgChkPrm_IF.tiOpenSprgSprd_C "Interface class instance, provides calibration parameters to calculate and verify return spring check / Maximum duration until open spring spread position must have been reached" VALUE 0x8050570C Val_Wu16 655.3500 t_q0p01 0.00 655.3500 FORMAT "%8.4" /end CHARACTERISTIC
/begin CHARACTERISTIC ThrVlv_IfSprgChkPrm_IF.tiRetSprgLimpAirPosn_C "Interface class instance, provides calibration parameters to calculate and verify return spring check / Maximum duration until limp air position must have been reached via return spring" VALUE 0x8050570E Val_Wu16 655.3500 t_q0p01 0.00 655.3500 FORMAT "%8.4" /end CHARACTERISTIC
/begin CHARACTERISTIC ThrVlv_IfSprgChkPrm_IF.tiRetSprgSprd_C "Interface class instance, provides calibration parameters to calculate and verify return spring check / Maximum duration until return spring spread position must have been reached" VALUE 0x80505710 Val_Wu16 655.3500 t_q0p01 0.00 655.3500 FORMAT "%8.4" /end CHARACTERISTIC
/begin CHARACTERISTIC ThrVlv_IfTmpOffsLrnPrm_IF.ratActGrdtTmpOffsLrn_C "Interface class instance, provides calibration parameters to calculate a temporary offset at lower mechanical stop / Valve speed threshold to start calculation of temporary adaptation" VALUE 0x80505714 Val_Ws16 3839.941 q0p0586_pc_DIV_s -1920.000 1919.941 FORMAT "%8.3" /end CHARACTERISTIC
/begin CHARACTERISTIC ThrVlv_IfTmpOffsLrnPrm_IF.ratDesActDe_C "Interface class instance, provides calibration parameters to calculate a temporary offset at lower mechanical stop / Control deviation threshold to stop calculation of temporary adaptation" VALUE 0x80505716 Val_Ws16 511.9922 rel_q0p0078125 -256.0000 255.9922 FORMAT "%8.4" /end CHARACTERISTIC
/begin CHARACTERISTIC ThrVlv_IfTmpOffsLrnPrm_IF.ratTmpOffsLrnDutyCycMax_C "Interface class instance, provides calibration parameters to calculate a temporary offset at lower mechanical stop / Duty Cycle threshold to start calculation of temporary adaptation" VALUE 0x80505718 Val_Ws16 511.9922 rel_q0p0078125 -256.0000 255.9922 FORMAT "%8.4" /end CHARACTERISTIC
/begin CHARACTERISTIC ThrVlv_IfTmpOffsLrnPrm_IF.ratTmpOffsLrnDutyCycMin_C "Interface class instance, provides calibration parameters to calculate a temporary offset at lower mechanical stop / Duty Cycle threshold to stop calculation of temporary adaptation" VALUE 0x8050571A Val_Ws16 511.9922 rel_q0p0078125 -256.0000 255.9922 FORMAT "%8.4" /end CHARACTERISTIC
/begin CHARACTERISTIC ThrVlv_IfTmpOffsLrnPrm_IF.ratTmpOffsLrnPosnThd_C "Interface class instance, provides calibration parameters to calculate a temporary offset at lower mechanical stop / Threshold for desired position to release temporary adaptation check" VALUE 0x8050571C Val_Ws16 511.9922 rel_q0p0078125 -256.0000 255.9922 FORMAT "%8.4" /end CHARACTERISTIC
/begin CHARACTERISTIC ThrVlv_IfTmpOffsLrnPrm_IF.tEngTmpOffsMin_C "Interface class instance, provides calibration parameters to calculate a temporary offset at lower mechanical stop / Minimum engine temperature threshold to release temporary adaptation check" VALUE 0x8050571E Val_Ws16 6553.500 Temp_Cels -3549.940 3003.560 FORMAT "%8.3" /end CHARACTERISTIC
/begin CHARACTERISTIC ThrVlv_IfTmpOffsLrnPrm_IF.tiDeltaRatActTmpOffsMin_C "Interface class instance, provides calibration parameters to calculate a temporary offset at lower mechanical stop / PT1 filter time for valve speed" VALUE 0x80505720 Val_Ws32 2147.48364600 Time_Dt 0.00000100 2147.48364700 FORMAT "%13.8" EXTENDED_LIMITS -2147.48364800 2147.48364700 /end CHARACTERISTIC
/begin CHARACTERISTIC ThrVlv_IfTmpOffsLrnPrm_IF.tiDutyCycTmpOffsLrnDly_C "Interface class instance, provides calibration parameters to calculate a temporary offset at lower mechanical stop / Time for which Duty Cycle threshold must be exceeded to start calculation of temporary adaptation" VALUE 0x80505724 Val_Ws32 4294.96729500 Time_Dt -2147.48364800 2147.48364700 FORMAT "%13.8" /end CHARACTERISTIC
/begin CHARACTERISTIC ThrVlv_IfTmpOffsLrnPrm_IF.tiTmpOffsLrnRvsAdpn_C "Interface class instance, provides calibration parameters to calculate a temporary offset at lower mechanical stop / Waiting time until a reverse adaptation of temporary offset is started" VALUE 0x80505728 Val_Ws16 655.3500 Time_s -327.6800 327.6700 FORMAT "%8.4" /end CHARACTERISTIC
/begin CHARACTERISTIC ThrVlv_IfTmpOffsLrnPrm_IF.uTmpOffsLrnOffsMax_C "Interface class instance, provides calibration parameters to calculate a temporary offset at lower mechanical stop / Maximum allowed voltage offset for temporary adaptation" VALUE 0x8050572A Val_Ws16 79.99878 spg_q1p221Em3_V -40.00000 39.99878 FORMAT "%8.5" /end CHARACTERISTIC
/begin CHARACTERISTIC ThrVlv_IfTmpOffsLrnPrm_IF.uTmpOffsLrnOffsMin_C "Interface class instance, provides calibration parameters to calculate a temporary offset at lower mechanical stop / Minimum allowed voltage offset for temporary adaptation" VALUE 0x8050572C Val_Ws16 79.99878 spg_q1p221Em3_V -40.00000 39.99878 FORMAT "%8.5" /end CHARACTERISTIC
/begin CHARACTERISTIC ThrVlv_IfTmpOffsLrnPrm_IF.uTmpOffsLrnStep_C "Interface class instance, provides calibration parameters to calculate a temporary offset at lower mechanical stop / Voltage step- size by which temporary offset is increase at each calculation cycle" VALUE 0x8050572E Val_Wu16 79.99878 spg_q1p221Em3_V 0.00 79.99878 FORMAT "%8.5" /end CHARACTERISTIC
/begin CHARACTERISTIC ThrVlv_nThdForIrrvFuCutOffB1_C "Engine speed threshold to trigger safety fuel cut off in case of battery voltage depression" VALUE 0x80505584 Val_Ws16 18384.50 EngN -16384.00 2000.50 FORMAT "%8.2" EXTENDED_LIMITS -16384.00 16383.50 /end CHARACTERISTIC
/begin CHARACTERISTIC ThrVlv_OffsLrn_I.stOffsLrnSysStEnbl_C "Class instance of public class for offset learning / Bit Mask to enable offset learning for certain system states" VALUE 0x80505738 Val_Wu16 65535.00 OneToOne 0.00 65535.00 FORMAT "%8.2" /end CHARACTERISTIC
/begin CHARACTERISTIC ThrVlv_OffsLrn_I.stOffsLrnTrig_C "Class instance of public class for offset learning / Bit mask to trigger offset learning or first offset learning via calibration" VALUE 0x8050573A Val_Wu8 255.0 OneToOne 0.00 255.0 FORMAT "%5.1" /end CHARACTERISTIC
/begin CHARACTERISTIC ThrVlv_OffsLrn_I.tiOffsLrnPostDriveDly_C "Class instance of public class for offset learning / Delay time before offset learning will be started in Post Drive" VALUE 0x8050573C Val_Ws32 4294.96729500 Time_Dt -2147.48364800 2147.48364700 FORMAT "%13.8" /end CHARACTERISTIC
/begin CHARACTERISTIC ThrVlv_OffsLrn_I.tiOffsLrnT15OnDly_C "Class instance of public class for offset learning / Delay time before offset learning will be started after T15 On" VALUE 0x80505740 Val_Ws32 4294.96729500 Time_Dt -2147.48364800 2147.48364700 FORMAT "%13.8" /end CHARACTERISTIC
/begin CHARACTERISTIC ThrVlv_OffsLrn_I.tiPostDrivePwrStgOffDly_C "Class instance of public class for offset learning / Delay time for power stage Off indication in Post Drive" VALUE 0x80505744 Val_Ws32 4294.96729500 Time_Dt -2147.48364800 2147.48364700 FORMAT "%13.8" /end CHARACTERISTIC
/begin CHARACTERISTIC ThrVlv_OffsLrn_I.uDiffEepStoreThres_C "Class instance of public class for offset learning / Voltage difference between old and new learned Value at lower mechanical stop to store values in EEP" VALUE 0x80505748 Val_Wu16 79.99878 spg_q1p221Em3_V 0.00 79.99878 FORMAT "%8.5" /end CHARACTERISTIC
/begin CHARACTERISTIC ThrVlv_OffsLrn_I.uMovZon_C "Class instance of public class for offset learning / Voltage lift range which defines the moving zone 0 - 100 of the valve" VALUE 0x8050574A Val_Wu16 79.99878 spg_q1p221Em3_V 0.00 79.99878 FORMAT "%8.5" /end CHARACTERISTIC
/begin CHARACTERISTIC ThrVlv_OffsLrn_I.uStopOpenSens1Max_C "Class instance of public class for offset learning / Maximum voltage limit for open position of the valve" VALUE 0x8050574C Val_Wu16 79.99878 spg_q1p221Em3_V 0.00 79.99878 FORMAT "%8.5" /end CHARACTERISTIC
/begin CHARACTERISTIC ThrVlv_stMonCfgB1_C "ThrVlv_stMon: Applicationmask" VALUE 0x80505586 Val_Wu8 255.0 OneToOne 0.00 255.0 FORMAT "%5.1" /end CHARACTERISTIC
/begin CHARACTERISTIC ThrVlv_tiDebBattUDepB1_C "Debounce time for battery voltage depression" VALUE 0x80505587 Val_Wu8 0.1000 t10msxs_ub_b2p55 0.00 0.1000 EXTENDED_LIMITS 0.00 2.550 /end CHARACTERISTIC
/begin CHARACTERISTIC ThrVlv_tiDebDblErrSuspc_C "Debounce time: Double sensor error suspicion" VALUE 0x80505580 Val_Ws32 4294.96729500 Time_Dt -2147.48364800 2147.48364700 FORMAT "%13.8" /end CHARACTERISTIC
/begin MEASUREMENT AirMod_flgMaiChrgSensErr "Error main charge sensor" UBYTE OneToOne 1 100 0.00 1.000 BIT_MASK 0x1 FORMAT "%5.3" ECU_ADDRESS 0x6000F911 /end MEASUREMENT
/begin MEASUREMENT B_dknolu_msg "condition: limp-home operation active" UBYTE OneToOne 1 100 0.00 1.000 BIT_MASK 0x1 FORMAT "%5.3" ECU_ADDRESS 0x600140FF /end MEASUREMENT
/begin MEASUREMENT B_dknotb_msg "Condition: some throttle valve backup mode active" UBYTE OneToOne 1 100 0.00 1.000 BIT_MASK 0x1 FORMAT "%5.3" ECU_ADDRESS 0x6000F910 /end MEASUREMENT
/begin MEASUREMENT B_dknot_msg "condition: continued operation with a single remaining throttle actuator poti" UBYTE OneToOne 1 100 0.00 1.000 BIT_MASK 0x1 FORMAT "%5.3" ECU_ADDRESS 0x60014100 /end MEASUREMENT
/begin MEASUREMENT B_dkp1e_msg "Condition: defect in throttle actuator potentiometer 1" UBYTE OneToOne 1 100 0.00 1.000 BIT_MASK 0x1 FORMAT "%5.3" ECU_ADDRESS 0x60014101 /end MEASUREMENT
/begin MEASUREMENT B_dkp2e_msg "condition: defect in throttle actuator potentiometer 2" UBYTE OneToOne 1 100 0.00 1.000 BIT_MASK 0x1 FORMAT "%5.3" ECU_ADDRESS 0x60014102 /end MEASUREMENT
/begin MEASUREMENT B_dkpiu_msg "Condition: irreversible SKA (ICO)" UBYTE OneToOne 1 100 0.00 1.000 BIT_MASK 0x1 FORMAT "%5.3" ECU_ADDRESS 0x6000F90F /end MEASUREMENT
/begin MEASUREMENT B_dkpru_msg "Condition: reversible SKA (ICO)" UBYTE OneToOne 1 100 0.00 1.000 BIT_MASK 0x1 FORMAT "%5.3" ECU_ADDRESS 0x60014103 /end MEASUREMENT
/begin MEASUREMENT B_dkpu_msg "condition: safety fuel cut-off" UBYTE OneToOne 1 100 0.00 1.000 BIT_MASK 0x1 FORMAT "%5.3" ECU_ADDRESS 0x60014104 /end MEASUREMENT
/begin MEASUREMENT B_dksbeg_msg "condition: limiting throttle-valve setpoint value" UBYTE OneToOne 1 100 0.00 1.000 BIT_MASK 0x1 FORMAT "%5.3" ECU_ADDRESS 0x6000F90E /end MEASUREMENT
/begin MEASUREMENT B_dveada_msg "condition: disabling injection during DV-E-adaptation" UBYTE OneToOne 1 100 0.00 1.000 BIT_MASK 0x1 FORMAT "%5.3" ECU_ADDRESS 0x6000F90D /end MEASUREMENT
/begin MEASUREMENT B_edks_msg "Condition fault in throttle-valve sensor" UBYTE OneToOne 1 100 0.00 1.000 BIT_MASK 0x1 FORMAT "%5.3" ECU_ADDRESS 0x60014105 /end MEASUREMENT
/begin MEASUREMENT B_i_ska_fr_msg "FR error reaction irreversible SKA (safety fuel shut-down)" UBYTE OneToOne 1 100 0.00 1.000 BIT_MASK 0x1 FORMAT "%5.3" ECU_ADDRESS 0x6000F90C /end MEASUREMENT
/begin MEASUREMENT B_lrnwsur_msg "Cond.: Storing of DV-E adaption values into original system successful (RAM-Val.)" UBYTE OneToOne 1 100 0.00 1.000 BIT_MASK 0x1 FORMAT "%5.3" ECU_ADDRESS 0x6000F90A /end MEASUREMENT
/begin MEASUREMENT B_lrnws_msg "learned value save bit" UBYTE OneToOne 1 100 0.00 1.000 BIT_MASK 0x1 FORMAT "%5.3" ECU_ADDRESS 0x6000F90B /end MEASUREMENT
/begin MEASUREMENT B_nldve_msg "Request of control unit after-run by DVE" UBYTE OneToOne 1 100 0.00 1.000 BIT_MASK 0x1 FORMAT "%5.3" ECU_ADDRESS 0x60014109 /end MEASUREMENT
/begin MEASUREMENT B_notlu_fr_msg "Request for NFB from Function controller" UBYTE OneToOne 1 100 0.00 1.000 BIT_MASK 0x1 FORMAT "%5.3" ECU_ADDRESS 0x6001410A /end MEASUREMENT
/begin MEASUREMENT B_ubdve_msg "Condition: Battery voltage for DV-E control OK" UBYTE OneToOne 1 100 0.00 1.000 BIT_MASK 0x1 FORMAT "%5.3" ECU_ADDRESS 0x6001410C /end MEASUREMENT
/begin MEASUREMENT B_ubpvg_msg "condition: battery voltage sufficient for 5-V potentiometer supply" UBYTE OneToOne 1 100 0.00 1.000 BIT_MASK 0x1 FORMAT "%5.3" ECU_ADDRESS 0x6001410D /end MEASUREMENT
/begin MEASUREMENT B_ub_ok_msg "Battery voltage o.k." UBYTE OneToOne 1 100 0.00 1.000 BIT_MASK 0x1 FORMAT "%5.3" ECU_ADDRESS 0x6001410B /end MEASUREMENT
/begin MEASUREMENT B_wdksg_msg "Condition: Setpoint Angle Throttle Valve valid" UBYTE OneToOne 1 100 0.00 1.000 BIT_MASK 0x1 FORMAT "%5.3" ECU_ADDRESS 0x6000F909 /end MEASUREMENT
/begin MEASUREMENT CEngDsT_flgColdStrtDi "Coolant temperature sensor cold start diagnosis disabled" UBYTE B_TRUE 1 100 0.00 1.00000000000 BIT_MASK 0x1 FORMAT "%13.11" ECU_ADDRESS 0x70000AD9 /end MEASUREMENT
/begin MEASUREMENT CEngDsT_flgColdStrtFinal "Final flag of coolant temperature sensor cold start diagnosis" UBYTE B_TRUE 1 100 0.00 1.00000000000 BIT_MASK 0x1 FORMAT "%13.11" ECU_ADDRESS 0x70000AD8 /end MEASUREMENT
/begin MEASUREMENT CEngDsT_flgColdStrtHeal "Heal flag of coolant temperature sensor cold start diagnosis" UBYTE B_TRUE 1 100 0.00 1.00000000000 BIT_MASK 0x1 FORMAT "%13.11" ECU_ADDRESS 0x70000AD7 /end MEASUREMENT
/begin MEASUREMENT CEngDsT_flgColdStrtMaxErr "Max error flag of coolant temperature sensor cold start diagnosis" UBYTE B_TRUE 1 100 0.00 1.00000000000 BIT_MASK 0x1 FORMAT "%13.11" ECU_ADDRESS 0x70000AD6 /end MEASUREMENT
/begin MEASUREMENT CEngDsT_flgColdStrtMinErr "Min error flag of coolant temperature sensor cold start diagnosis" UBYTE B_TRUE 1 100 0.00 1.00000000000 BIT_MASK 0x1 FORMAT "%13.11" ECU_ADDRESS 0x70000AD5 /end MEASUREMENT
/begin MEASUREMENT CEngDsT_flgColdStrtRiseNr "Increment IUMPR counter of coolant temperature sensor cold start diagnosis" UBYTE B_TRUE 1 100 0.00 1.00000000000 BIT_MASK 0x1 FORMAT "%13.11" ECU_ADDRESS 0x70000AD4 /end MEASUREMENT
/begin MEASUREMENT CEngUsT_flgColdStrtDi "Coolant temperature sensor cold start diagnosis disabled" UBYTE B_TRUE 1 100 0.00 1.00000000000 BIT_MASK 0x1 FORMAT "%13.11" ECU_ADDRESS 0x70000AA0 /end MEASUREMENT
/begin MEASUREMENT CEngUsT_flgColdStrtFinal "Final flag of coolant temperature sensor cold start diagnosis" UBYTE B_TRUE 1 100 0.00 1.00000000000 BIT_MASK 0x1 FORMAT "%13.11" ECU_ADDRESS 0x70000A9F /end MEASUREMENT
/begin MEASUREMENT CEngUsT_flgColdStrtMaxErr "Max error flag of coolant temperature sensor cold start diagnosis" UBYTE B_TRUE 1 100 0.00 1.00000000000 BIT_MASK 0x1 FORMAT "%13.11" ECU_ADDRESS 0x70000A9D /end MEASUREMENT
/begin MEASUREMENT CEngUsT_flgColdStrtMaxHeal "Max healing coldstart diagnosis of engine cooleant upstream sensor" UBYTE B_TRUE 1 100 0.00 1.00000000000 BIT_MASK 0x1 FORMAT "%13.11" ECU_ADDRESS 0x70000A9C /end MEASUREMENT
/begin MEASUREMENT CEngUsT_flgColdStrtMinErr "Min error flag of coolant temperature sensor cold start diagnosis" UBYTE B_TRUE 1 100 0.00 1.00000000000 BIT_MASK 0x1 FORMAT "%13.11" ECU_ADDRESS 0x70000A9B /end MEASUREMENT
/begin MEASUREMENT CEngUsT_flgColdStrtMinHeal "Min healing coldstart diagnosis of engine cooleant upstream sensor" UBYTE B_TRUE 1 100 0.00 1.00000000000 BIT_MASK 0x1 FORMAT "%13.11" ECU_ADDRESS 0x70000A9A /end MEASUREMENT
/begin MEASUREMENT CEngUsT_flgColdStrtRiseNr "Increment IUMPR counter of coolant temperature sensor cold start diagnosis" UBYTE B_TRUE 1 100 0.00 1.00000000000 BIT_MASK 0x1 FORMAT "%13.11" ECU_ADDRESS 0x70000A99 /end MEASUREMENT
/begin MEASUREMENT ChrCtl_flgUnthrAgMaiSens "Flag: Throttle angle calculated from main charge sensor is unthrottled" UBYTE OneToOne 1 100 0.00 1.000 BIT_MASK 0x1 FORMAT "%5.3" ECU_ADDRESS 0x6000F908 /end MEASUREMENT
/begin MEASUREMENT ChrCtl_rActPosMnChrgSensB1 "Unthrottled replacement angle from main charge sensor" SWORD rel_q0p0078125 1 100 -256.0000 255.9922 FORMAT "%8.4" ECU_ADDRESS 0x600095C0 /end MEASUREMENT
/begin MEASUREMENT ChrCtl_ratDesPosnThrVlvB1 "Desired throttle valve position" SWORD rel_q0p0078125 1 100 -256.0000 255.9922 FORMAT "%8.4" ECU_ADDRESS 0x600095BE /end MEASUREMENT
/begin MEASUREMENT dwdkba_w_msg "gradient of actual throttle blade position" SWORD relDK_q0p02441 1 100 -800.0000 799.9756 FORMAT "%8.4" ECU_ADDRESS 0x60014006 /end MEASUREMENT
/begin MEASUREMENT IntkAirT_flgColdStrt1Final "Final flag of intake air temperature sensor 1 cold start diagnosis" UBYTE B_TRUE 1 100 0.00 1.00000000000 BIT_MASK 0x1 FORMAT "%13.11" ECU_ADDRESS 0x70000864 /end MEASUREMENT
/begin MEASUREMENT IntkAirT_flgColdStrt2Final "Final flag of intake air temperature sensor 2 cold start diagnosis" UBYTE B_TRUE 1 100 0.00 1.00000000000 BIT_MASK 0x1 FORMAT "%13.11" ECU_ADDRESS 0x70000863 /end MEASUREMENT
/begin MEASUREMENT IntkAirT_flgCrss1MaxErr "Error flag of the max.error of the Cross-Check by cold start for sensor 1, debounced" UBYTE B_TRUE 1 100 0.00 1.00000000000 BIT_MASK 0x1 FORMAT "%13.11" ECU_ADDRESS 0x70000862 /end MEASUREMENT
/begin MEASUREMENT IntkAirT_flgCrss1MaxHeal "Healing flag of the max.error of the Cross-Check by cold start for sensor 1, debounced" UBYTE B_TRUE 1 100 0.00 1.00000000000 BIT_MASK 0x1 FORMAT "%13.11" ECU_ADDRESS 0x70000861 /end MEASUREMENT
/begin MEASUREMENT IntkAirT_flgCrss1MinErr "Error flag of the min.error of the Cross-Check by cold start for sensor 1, debounced" UBYTE B_TRUE 1 100 0.00 1.00000000000 BIT_MASK 0x1 FORMAT "%13.11" ECU_ADDRESS 0x70000860 /end MEASUREMENT
/begin MEASUREMENT IntkAirT_flgCrss1MinHeal "Healing flag of the max.error of the Cross-Check by cold start for sensor 1, debounced" UBYTE B_TRUE 1 100 0.00 1.00000000000 BIT_MASK 0x1 FORMAT "%13.11" ECU_ADDRESS 0x7000085F /end MEASUREMENT
/begin MEASUREMENT IntkAirT_flgCrss2MaxErr "Error flag of the max.error of the Cross-Check by cold start for sensor 2, debounced" UBYTE B_TRUE 1 100 0.00 1.00000000000 BIT_MASK 0x1 FORMAT "%13.11" ECU_ADDRESS 0x7000085E /end MEASUREMENT
/begin MEASUREMENT IntkAirT_flgCrss2MaxHeal "Healing flag of the max.error of the Cross-Check by cold start for sensor 2, debounced" UBYTE B_TRUE 1 100 0.00 1.00000000000 BIT_MASK 0x1 FORMAT "%13.11" ECU_ADDRESS 0x7000085D /end MEASUREMENT
/begin MEASUREMENT IntkAirT_flgCrss2MinErr "Error flag of the min.error of the Cross-Check by cold start for sensor 2, debounced" UBYTE B_TRUE 1 100 0.00 1.00000000000 BIT_MASK 0x1 FORMAT "%13.11" ECU_ADDRESS 0x7000085C /end MEASUREMENT
/begin MEASUREMENT IntkAirT_flgCrss2MinHeal "Healing flag of the max.error of the Cross-Check by cold start for sensor 2, debounced" UBYTE B_TRUE 1 100 0.00 1.00000000000 BIT_MASK 0x1 FORMAT "%13.11" ECU_ADDRESS 0x7000085B /end MEASUREMENT
/begin MEASUREMENT IntkAirT_flgCrssChk1NumrInc "release iumpr-numerator for the Cross-Check by cold start for intake air temperature sensor 1" UBYTE B_TRUE 1 100 0.00 1.00000000000 BIT_MASK 0x1 FORMAT "%13.11" ECU_ADDRESS 0x7000085A /end MEASUREMENT
/begin MEASUREMENT IntkAirT_flgCrssChk2NumrInc "release iumpr-numerator for the Cross-Check by cold start for intake air temperature sensor 2" UBYTE B_TRUE 1 100 0.00 1.00000000000 BIT_MASK 0x1 FORMAT "%13.11" ECU_ADDRESS 0x70000859 /end MEASUREMENT
/begin MEASUREMENT lrnstat_msg "statusbyte DV-E-adaption routine for tester-communication" UBYTE dez 1 100 0.00 255.0 FORMAT "%5.1" ECU_ADDRESS 0x6000F7D5 /end MEASUREMENT
/begin MEASUREMENT s1fl2p11_msg "Interface for mode 01+02 absolute throttle position in supply voltage" UBYTE dez 1 100 0.00 255.0 FORMAT "%5.1" ARRAY_SIZE 2 ECU_ADDRESS 0x6000F7D3 /end MEASUREMENT
/begin MEASUREMENT T15_flgOn "Terminal 15 state" UBYTE OneToOne 1 100 0.00 1.000 BIT_MASK 0x1 FORMAT "%5.3" ECU_ADDRESS 0x700054A5 /end MEASUREMENT
/begin MEASUREMENT T15_st "" UBYTE OneToOne 1 100 0.00 1.000 BIT_MASK 0x1 FORMAT "%5.3" ECU_ADDRESS 0x6000F7C0 /end MEASUREMENT
/begin MEASUREMENT T15_stRaw "Raw value of Terminal 15 status" UBYTE OneToOne 1 100 0.00 255.0 FORMAT "%5.1" ECU_ADDRESS 0x700054A6 /end MEASUREMENT
/begin MEASUREMENT T15_stRawTurnOffDly_Sq "signal quality message for T15stRAW" UBYTE SigQly_COMPU_VERB 1 100 0.00 15.0000000000 FORMAT "%13.10" ECU_ADDRESS 0x6000F339 /end MEASUREMENT
/begin MEASUREMENT T50_st "Status of T50 signal" UBYTE OneToOne 1 100 0.00 255.0 FORMAT "%5.1" ECU_ADDRESS 0x6000F7DB /end MEASUREMENT
/begin MEASUREMENT T50_stDebVal "Debounce value of T50 status from Digital input" UBYTE OneToOne 1 100 0.00 255.0 FORMAT "%5.1" ECU_ADDRESS 0x6000F338 /end MEASUREMENT
/begin MEASUREMENT T50_stEmgcy "status of T50 emergency cranking request" UBYTE OneToOne 1 100 0.00 255.0 FORMAT "%5.1" ECU_ADDRESS 0x6000F7DA /end MEASUREMENT
/begin MEASUREMENT T50_stRaw "Terminal 50 feedback raw signal" UBYTE OneToOne 1 100 0.00 255.0 FORMAT "%5.1" ECU_ADDRESS 0x6000F337 /end MEASUREMENT
/begin MEASUREMENT TCE_flgCylIndFcoStrtd "Flag to indicates individual FCO is started" UBYTE B_TRUE 1 100 0.00 1.00000000000 BIT_MASK 0x1 FORMAT "%13.11" ECU_ADDRESS 0x6000F087 /end MEASUREMENT
/begin MEASUREMENT TCE_flgFcoRdy "Flag to indicates FCO Ready" UBYTE B_TRUE 1 100 0.00 1.00000000000 BIT_MASK 0x1 FORMAT "%13.11" ECU_ADDRESS 0x6000F086 /end MEASUREMENT
/begin MEASUREMENT TCE_flgGenericFcoReq "Fuel Cut Off Generic Request" UBYTE B_TRUE 1 100 0.00 1.00000000000 BIT_MASK 0x1 FORMAT "%13.11" ECU_ADDRESS 0x6000F085 /end MEASUREMENT
/begin MEASUREMENT TCE_flgGenericFcoRst "Fuel Cut Off Generic Reset" UBYTE B_TRUE 1 100 0.00 1.00000000000 BIT_MASK 0x1 FORMAT "%13.11" ECU_ADDRESS 0x6000F084 /end MEASUREMENT
/begin MEASUREMENT TCE_nEngTmp "Engine speed at the time when the fuel cutoff release from coeng is set" SWORD EngN 1 100 -16384.00 16383.50 FORMAT "%8.2" ECU_ADDRESS 0x600068C2 /end MEASUREMENT
/begin MEASUREMENT TCE_tiExptFcoStrt "Expected time to start FCO" ULONG Time_ms2us 1 100 0.00 4294967.29500 FORMAT "%13.5" ECU_ADDRESS 0x60003894 /end MEASUREMENT
/begin MEASUREMENT TCE_tiExptFcoTmr "Time output of expected fuel cut-off timer" ULONG Time_ms2us 1 100 0.00 2147483.64700 FORMAT "%13.5" ECU_ADDRESS 0x60002658 /end MEASUREMENT
/begin MEASUREMENT TCE_tqInnrSetCo "Driver demand torque at the time when the fuel cutoff release from coeng is set" SWORD Trq 1 100 0.00 3276.700 FORMAT "%8.3" ECU_ADDRESS 0x600068C0 /end MEASUREMENT
/begin MEASUREMENT TDevCrssChk_flgBlkHeatrActvd "Blockheater activated at coldstart diagnosis" UBYTE B_TRUE 1 100 0.00 1.00000000000 BIT_MASK 0x1 FORMAT "%13.11" ECU_ADDRESS 0x70000794 /end MEASUREMENT
/begin MEASUREMENT TDevCrssChk_flgCEngBlkTDiagRel "Enginge Block Temperature electic valid" UBYTE B_TRUE 1 100 0.00 1.00000000000 BIT_MASK 0x1 FORMAT "%13.11" ECU_ADDRESS 0x70000793 /end MEASUREMENT
/begin MEASUREMENT TDevCrssChk_flgCEngDsTDiagRel "Enginge Downstream Temperature electic valid" UBYTE B_TRUE 1 100 0.00 1.00000000000 BIT_MASK 0x1 FORMAT "%13.11" ECU_ADDRESS 0x70000792 /end MEASUREMENT
/begin MEASUREMENT TDevCrssChk_flgCEngUsTDiagRel "Enginge Upstream Temperature electic valid" UBYTE B_TRUE 1 100 0.00 1.00000000000 BIT_MASK 0x1 FORMAT "%13.11" ECU_ADDRESS 0x70000791 /end MEASUREMENT
/begin MEASUREMENT TDevCrssChk_flgCHdTDiagRel "Cylinderhead Temperature electic valid" UBYTE B_TRUE 1 100 0.00 1.00000000000 BIT_MASK 0x1 FORMAT "%13.11" ECU_ADDRESS 0x70000790 /end MEASUREMENT
/begin MEASUREMENT TDevCrssChk_flgCTHeatgRetDiagRel "Heating Return Temperature electic valid" UBYTE B_TRUE 1 100 0.00 1.00000000000 BIT_MASK 0x1 FORMAT "%13.11" ECU_ADDRESS 0x7000078F /end MEASUREMENT
/begin MEASUREMENT TDevCrssChk_flgDiagRels "CrossCheck Diagnosis released" UBYTE B_TRUE 1 100 0.00 1.00000000000 BIT_MASK 0x1 FORMAT "%13.11" ECU_ADDRESS 0x7000078E /end MEASUREMENT
/begin MEASUREMENT TDevCrssChk_flgEngMidTDiagRel "Engine Middle Temperature electic valid" UBYTE B_TRUE 1 100 0.00 1.00000000000 BIT_MASK 0x1 FORMAT "%13.11" ECU_ADDRESS 0x7000078D /end MEASUREMENT
/begin MEASUREMENT TDevCrssChk_flgEngRunngDeb "CrossCheck Diagnosis Combustion Engine running, debounced" UBYTE B_TRUE 1 100 0.00 1.00000000000 BIT_MASK 0x1 FORMAT "%13.11" ECU_ADDRESS 0x7000078C /end MEASUREMENT
/begin MEASUREMENT TDevCrssChk_flgEngStrtNotSucCyc "Engine Start in currenct cycle not successful yet" UBYTE B_TRUE 1 100 0.00 1.00000000000 BIT_MASK 0x1 FORMAT "%13.11" ECU_ADDRESS 0x7000078B /end MEASUREMENT
/begin MEASUREMENT TDevCrssChk_flgEnvTDiagRel "Environment-Temperature electic valid" UBYTE B_TRUE 1 100 0.00 1.00000000000 BIT_MASK 0x1 FORMAT "%13.11" ECU_ADDRESS 0x7000078A /end MEASUREMENT
/begin MEASUREMENT TDevCrssChk_flgFirstStrt "CrossCheck FirstStart of combustion engine executed" UBYTE B_TRUE 1 100 0.00 1.00000000000 BIT_MASK 0x1 FORMAT "%13.11" ECU_ADDRESS 0x70000789 /end MEASUREMENT
/begin MEASUREMENT TDevCrssChk_flgInhbnCptDfct "Lock of CrossCheck in case of component defect" UBYTE B_TRUE 1 100 0.00 1.00000000000 BIT_MASK 0x1 FORMAT "%13.11" ECU_ADDRESS 0x70000788 /end MEASUREMENT
/begin MEASUREMENT TDevCrssChk_flgIntkAirT1DiagRel "Intake Air Temperature 1 electic valid" UBYTE B_TRUE 1 100 0.00 1.00000000000 BIT_MASK 0x1 FORMAT "%13.11" ECU_ADDRESS 0x70000787 /end MEASUREMENT
/begin MEASUREMENT TDevCrssChk_flgIntkAirT2DiagRel "Intake Air Temperature 2 electic valid" UBYTE B_TRUE 1 100 0.00 1.00000000000 BIT_MASK 0x1 FORMAT "%13.11" ECU_ADDRESS 0x70000786 /end MEASUREMENT
/begin MEASUREMENT TDevCrssChk_flgIntkAirT3DiagRel "Intake Air Temperature 3 electic valid" UBYTE B_TRUE 1 100 0.00 1.00000000000 BIT_MASK 0x1 FORMAT "%13.11" ECU_ADDRESS 0x70000785 /end MEASUREMENT
/begin MEASUREMENT TDevCrssChk_flgIntkAirT4DiagRel "Intake Air Temperature 4 electic valid" UBYTE B_TRUE 1 100 0.00 1.00000000000 BIT_MASK 0x1 FORMAT "%13.11" ECU_ADDRESS 0x70000784 /end MEASUREMENT
/begin MEASUREMENT TDevCrssChk_flgOilFilTDiagRel "Oil Filter Temperature electic valid" UBYTE B_TRUE 1 100 0.00 1.00000000000 BIT_MASK 0x1 FORMAT "%13.11" ECU_ADDRESS 0x70000783 /end MEASUREMENT
/begin MEASUREMENT TDevCrssChk_flgOilGlryTDiagRel "Oil Gallery Temperature Sensor electrical valid" UBYTE B_TRUE 1 100 0.00 1.00000000000 BIT_MASK 0x1 FORMAT "%13.11" ECU_ADDRESS 0x70000782 /end MEASUREMENT
/begin MEASUREMENT TDevCrssChk_flgOilSwmpTDiagRel "OilSwamp Temperature electic valid" UBYTE B_TRUE 1 100 0.00 1.00000000000 BIT_MASK 0x1 FORMAT "%13.11" ECU_ADDRESS 0x70000781 /end MEASUREMENT
/begin MEASUREMENT TDevCrssChk_flgPrelCEngDsTErr "ColdstartdDiagnosis preliminary error CEngDsT" UBYTE B_TRUE 1 100 0.00 1.00000000000 BIT_MASK 0x1 FORMAT "%13.11" ECU_ADDRESS 0x70000780 /end MEASUREMENT
/begin MEASUREMENT TDevCrssChk_flgPrelCEngDsTHeal "ColdstartdDiagnosis preliminary healing CEngDsT" UBYTE B_TRUE 1 100 0.00 1.00000000000 BIT_MASK 0x1 FORMAT "%13.11" ECU_ADDRESS 0x7000077F /end MEASUREMENT
/begin MEASUREMENT TDevCrssChk_flgPrelCEngDsTMaxErr "ColdstartdDiagnosis preliminary max error CEngDsT" UBYTE B_TRUE 1 100 0.00 1.00000000000 BIT_MASK 0x1 FORMAT "%13.11" ECU_ADDRESS 0x7000077E /end MEASUREMENT
/begin MEASUREMENT TDevCrssChk_flgPrelCEngDsTMinErr "ColdstartdDiagnosis preliminary min error CEngDsT" UBYTE B_TRUE 1 100 0.00 1.00000000000 BIT_MASK 0x1 FORMAT "%13.11" ECU_ADDRESS 0x7000077D /end MEASUREMENT
/begin MEASUREMENT TDevCrssChk_flgPrelCEngUsTMaxErr "ColdstartdDiagnosis preliminary max error CEngUsT" UBYTE B_TRUE 1 100 0.00 1.00000000000 BIT_MASK 0x1 FORMAT "%13.11" ECU_ADDRESS 0x7000077C /end MEASUREMENT
/begin MEASUREMENT TDevCrssChk_flgPrelCEngUsTMaxHeal "ColdstartdDiagnosis preliminary max healing CEngUsT" UBYTE B_TRUE 1 100 0.00 1.00000000000 BIT_MASK 0x1 FORMAT "%13.11" ECU_ADDRESS 0x7000077B /end MEASUREMENT
/begin MEASUREMENT TDevCrssChk_flgPrelCEngUsTMinErr "ColdstartdDiagnosis preliminary min error CEngUsT" UBYTE B_TRUE 1 100 0.00 1.00000000000 BIT_MASK 0x1 FORMAT "%13.11" ECU_ADDRESS 0x7000077A /end MEASUREMENT
/begin MEASUREMENT TDevCrssChk_flgPrelCEngUsTMinHeal "ColdstartdDiagnosis preliminary min healing CEngUsT" UBYTE B_TRUE 1 100 0.00 1.00000000000 BIT_MASK 0x1 FORMAT "%13.11" ECU_ADDRESS 0x70000779 /end MEASUREMENT
/begin MEASUREMENT TDevCrssChk_flgPrelIntkAirT1Heal "ColdstartdDiagnosis preliminary healing IntkAirT1" UBYTE B_TRUE 1 100 0.00 1.00000000000 BIT_MASK 0x1 FORMAT "%13.11" ECU_ADDRESS 0x70000778 /end MEASUREMENT
/begin MEASUREMENT TDevCrssChk_flgPrelIntkAirT1MaxErr "ColdstartdDiagnosis preliminary max error IntkAirT1" UBYTE B_TRUE 1 100 0.00 1.00000000000 BIT_MASK 0x1 FORMAT "%13.11" ECU_ADDRESS 0x70000777 /end MEASUREMENT
/begin MEASUREMENT TDevCrssChk_flgPrelIntkAirT1MinErr "ColdstartdDiagnosis preliminary min error IntkAirT1" UBYTE B_TRUE 1 100 0.00 1.00000000000 BIT_MASK 0x1 FORMAT "%13.11" ECU_ADDRESS 0x70000776 /end MEASUREMENT
/begin MEASUREMENT TDevCrssChk_flgPrelIntkAirT2Heal "ColdstartdDiagnosis preliminary healing IntkAirT2" UBYTE B_TRUE 1 100 0.00 1.00000000000 BIT_MASK 0x1 FORMAT "%13.11" ECU_ADDRESS 0x70000775 /end MEASUREMENT
/begin MEASUREMENT TDevCrssChk_flgPrelIntkAirT2MaxErr "ColdstartdDiagnosis preliminary max error IntkAirT2" UBYTE B_TRUE 1 100 0.00 1.00000000000 BIT_MASK 0x1 FORMAT "%13.11" ECU_ADDRESS 0x70000774 /end MEASUREMENT
/begin MEASUREMENT TDevCrssChk_flgPrelIntkAirT2MinErr "ColdstartdDiagnosis preliminary min error IntkAirT2" UBYTE B_TRUE 1 100 0.00 1.00000000000 BIT_MASK 0x1 FORMAT "%13.11" ECU_ADDRESS 0x70000773 /end MEASUREMENT
/begin MEASUREMENT TDevCrssChk_flgPrpSysInactv "CrossCheck Flag for propulsion system inactive" UBYTE B_TRUE 1 100 0.00 1.00000000000 BIT_MASK 0x1 FORMAT "%13.11" ECU_ADDRESS 0x70000772 /end MEASUREMENT
/begin MEASUREMENT TDevCrssChk_flgT15Dly "CrossCheck Flag T15 delayed" UBYTE B_TRUE 1 100 0.00 1.00000000000 BIT_MASK 0x1 FORMAT "%13.11" ECU_ADDRESS 0x70000771 /end MEASUREMENT
/begin MEASUREMENT TDevCrssChk_flgTFlTnkDiagRel "TFlTnk signal electrical valid" UBYTE B_TRUE 1 100 0.00 1.00000000000 BIT_MASK 0x1 FORMAT "%13.11" ECU_ADDRESS 0x70000770 /end MEASUREMENT
/begin MEASUREMENT TDevCrssChk_st "State of Tdev CrossCheck Diagnosis" UBYTE OneToOne 1 100 0.00 255.0 FORMAT "%5.1" ECU_ADDRESS 0x6000EF2B /end MEASUREMENT
/begin MEASUREMENT TDevCrssChk_tFrzAvg "Temperture mean value, calculated out of freeze values from provided temperature sensors" SWORD Temp_Cels 1 100 -3549.940 3003.560 FORMAT "%8.3" ECU_ADDRESS 0x600087A4 /end MEASUREMENT
/begin MEASUREMENT TDevCrssChk_tIntkAirT1Min "CrossCheck Minimum IntkAirT1 temperature. Monitor" SWORD Temp_Cels 1 100 -3549.940 3003.560 FORMAT "%8.3" ECU_ADDRESS 0x600087A2 /end MEASUREMENT
/begin MEASUREMENT TDevCrssChk_tIntkAirT2Min "CrossCheck Minimum IntkAirT2 temperature. Monitor" SWORD Temp_Cels 1 100 -3549.940 3003.560 FORMAT "%8.3" ECU_ADDRESS 0x600087A0 /end MEASUREMENT
/begin MEASUREMENT TDev_flgColdStrtDiagFinshd "Flag to indicate successful completion of cold start diagnosis(error could be found)" UBYTE B_TRUE 1 100 0.00 1.00000000000 BIT_MASK 0x1 FORMAT "%13.11" ECU_ADDRESS 0x7000076F /end MEASUREMENT
/begin MEASUREMENT TDev_flgDSMRprt1000ms "Flag to enable reporting of diagnosis results to DSM (after DSM Re-Initialization) for 1000ms task" UBYTE B_TRUE 1 100 0.00 1.00000000000 BIT_MASK 0x1 FORMAT "%13.11" ECU_ADDRESS 0x7000076E /end MEASUREMENT
/begin MEASUREMENT TDev_flgDSMRprt100ms "Flag to enable reporting of diagnosis results to DSM (after DSM Re-Initialization) for 100ms task" UBYTE B_TRUE 1 100 0.00 1.00000000000 BIT_MASK 0x1 FORMAT "%13.11" ECU_ADDRESS 0x7000076D /end MEASUREMENT
/begin MEASUREMENT TDev_tRefColdStrtChk "Refernce value for cold start diagnosis from all available sensors" SWORD temp_q0p75 1 100 -24576.00 24575.25 FORMAT "%8.2" ECU_ADDRESS 0x6000879E /end MEASUREMENT
/begin MEASUREMENT ThDev_flgACMaiSwtCodVal "Status of AC switch in case of coded configuration" UBYTE B_TRUE 1 100 0.00 1.00000000000 BIT_MASK 0x1 FORMAT "%13.11" ECU_ADDRESS 0x6000EE19 /end MEASUREMENT
/begin MEASUREMENT ThDev_stMaiSwtACSig "The source of the main AC switch" UBYTE OneToOne 1 100 0.00 255.0 FORMAT "%5.1" ECU_ADDRESS 0x6000EF26 /end MEASUREMENT
/begin MEASUREMENT ThrVlv_bDblSensErrSuspcDeb_msg "Double sensor error suspicion - debounced" UBYTE OneToOne 1 100 0.00 1.000 BIT_MASK 0x1 FORMAT "%5.3" ECU_ADDRESS 0x6001414B /end MEASUREMENT
/begin MEASUREMENT ThrVlv_bSngSensErr_msg "Single Sensor Error at Throttle Valve occured" UBYTE OneToOne 1 100 0.00 1.000 BIT_MASK 0x1 FORMAT "%5.3" ECU_ADDRESS 0x6001414C /end MEASUREMENT
/begin MEASUREMENT ThrVlv_dRatPrVB1 "Slope of the throttle valve angle" UWORD rel_q0p002441 1 100 0.00 159.9976 FORMAT "%8.4" ECU_ADDRESS 0x6000944C /end MEASUREMENT
/begin MEASUREMENT ThrVlv_flgAdpnRelsB1 "Release of adaptation" UBYTE OneToOne 1 100 0.00 1.000 BIT_MASK 0x1 FORMAT "%5.3" ECU_ADDRESS 0x6000F905 /end MEASUREMENT
/begin MEASUREMENT ThrVlv_flgBattFltB1 "Too low battery voltage bank 1" UBYTE OneToOne 1 100 0.00 1.000 BIT_MASK 0x1 FORMAT "%5.3" ECU_ADDRESS 0x6000ADB1 /end MEASUREMENT
/begin MEASUREMENT ThrVlv_flgColdCdnOffsActvB1 "Offset check at cold temperature conditions active" UBYTE OneToOne 1 100 0.00 1.000 BIT_MASK 0x1 FORMAT "%5.3" ECU_ADDRESS 0x6000F904 /end MEASUREMENT
/begin MEASUREMENT ThrVlv_flgColdCdnTB1 "Cold temperature conditions detected" UBYTE OneToOne 1 100 0.00 1.000 BIT_MASK 0x1 FORMAT "%5.3" ECU_ADDRESS 0x6000F903 /end MEASUREMENT
/begin MEASUREMENT ThrVlv_flgDiInjB1 "Injection disabled by one of the throttle valve adaptation routines" UBYTE OneToOne 1 100 0.00 1.000 BIT_MASK 0x1 FORMAT "%5.3" ECU_ADDRESS 0x6000F8FE /end MEASUREMENT
/begin MEASUREMENT ThrVlv_flgDKnplErrActB1 "Rising edge to set sum error B1" UBYTE OneToOne 1 100 0.00 1.000 BIT_MASK 0x1 FORMAT "%5.3" ECU_ADDRESS 0x600140CA /end MEASUREMENT
/begin MEASUREMENT ThrVlv_flgDKnplErrOldB1 "Falling edge healing sum error B1" UBYTE OneToOne 1 100 0.00 1.000 BIT_MASK 0x1 FORMAT "%5.3" ECU_ADDRESS 0x600140CB /end MEASUREMENT
/begin MEASUREMENT ThrVlv_flgIrrvBattFltB1 "Irreversible battery fault bank 1" UBYTE OneToOne 1 100 0.00 1.000 BIT_MASK 0x1 FORMAT "%5.3" ECU_ADDRESS 0x6000ADB0 /end MEASUREMENT
/begin MEASUREMENT ThrVlv_flgIrrvFuCutOffB1 "Irreversible safety fuel cut off SKA" UBYTE OneToOne 1 100 0.00 1.000 BIT_MASK 0x1 FORMAT "%5.3" ECU_ADDRESS 0x6001414D /end MEASUREMENT
/begin MEASUREMENT ThrVlv_flgLimpAirPosnFctEnaB1 "Limp air position enable for Bank1" UBYTE OneToOne 1 100 0.00 1.000 BIT_MASK 0x1 FORMAT "%5.3" ECU_ADDRESS 0x6000F7BF /end MEASUREMENT
/begin MEASUREMENT ThrVlv_flgLimpModeB1 "Limp home driving requested" UBYTE OneToOne 1 100 0.00 1.000 BIT_MASK 0x1 FORMAT "%5.3" ECU_ADDRESS 0x5000605D /end MEASUREMENT
/begin MEASUREMENT ThrVlv_flgMonDsmClearDmd_B1 "Demand for fault memory clearing bank 1" UBYTE OneToOne 1 100 0.00 1.000 BIT_MASK 0x1 FORMAT "%5.3" ECU_ADDRESS 0x6000ADAF /end MEASUREMENT
/begin MEASUREMENT ThrVlv_flgOffsLrnAbortB1 "Offset learning aborted" UBYTE OneToOne 1 100 0.00 1.000 BIT_MASK 0x1 FORMAT "%5.3" ECU_ADDRESS 0x700054A9 /end MEASUREMENT
/begin MEASUREMENT ThrVlv_flgOffsLrnDsmClrDmdB1 "Request for DMS-Clear throttle valve offset learning, bank 1" UBYTE OneToOne 1 100 0.00 1.000 BIT_MASK 0x1 FORMAT "%5.3" ECU_ADDRESS 0x6000ADAC /end MEASUREMENT
/begin MEASUREMENT ThrVlv_flgOffsLrnPsOffB1 "Request powerstage off from ThrVlv_OffsLrn" UBYTE OneToOne 1 100 0.00 1.000 BIT_MASK 0x1 FORMAT "%5.3" ECU_ADDRESS 0x6000F8FB /end MEASUREMENT
/begin MEASUREMENT ThrVlv_flgOffsLrnSucB1 "Offset learning finished successfully" UBYTE OneToOne 1 100 0.00 1.000 BIT_MASK 0x1 FORMAT "%5.3" ECU_ADDRESS 0x6000F8FA /end MEASUREMENT
/begin MEASUREMENT ThrVlv_flgRegTqRednB1 "Request torque limitation" UBYTE OneToOne 1 100 0.00 1.000 BIT_MASK 0x1 FORMAT "%5.3" ECU_ADDRESS 0x6000F8F7 /end MEASUREMENT
/begin MEASUREMENT ThrVlv_flgReqFuCutOffB1 "Request safety fuel cut off" UBYTE OneToOne 1 100 0.00 1.000 BIT_MASK 0x1 FORMAT "%5.3" ECU_ADDRESS 0x5000605E /end MEASUREMENT
/begin MEASUREMENT ThrVlv_flgRvsbBattFltB1 "Reversible battery fault bank 1" UBYTE OneToOne 1 100 0.00 1.000 BIT_MASK 0x1 FORMAT "%5.3" ECU_ADDRESS 0x6000ADAE /end MEASUREMENT
/begin MEASUREMENT ThrVlv_flgRvsbFuCutOffB1 "Request reversible safety fuel cut off SKA" UBYTE OneToOne 1 100 0.00 1.000 BIT_MASK 0x1 FORMAT "%5.3" ECU_ADDRESS 0x6000F8F5 /end MEASUREMENT
/begin MEASUREMENT ThrVlv_flgSnsrDiagPrmsB1 "Flag: Permission for sensor diagnosis given" UBYTE OneToOne 1 100 0.00 1.000 BIT_MASK 0x1 FORMAT "%5.3" ECU_ADDRESS 0x6000ADAD /end MEASUREMENT
/begin MEASUREMENT ThrVlv_flgUBattSuffB1 "Battery voltage for throttle valve operation sufficient" UBYTE OneToOne 1 100 0.00 1.000 BIT_MASK 0x1 FORMAT "%5.3" ECU_ADDRESS 0x6000F8F3 /end MEASUREMENT
/begin MEASUREMENT ThrVlv_nrOffsLrnCycB1 "Counter of driving cycles for offset learning execution, 1st flow" UBYTE OneToOne 1 100 0.00 255.0 FORMAT "%5.1" ECU_ADDRESS 0x60038B18 /end MEASUREMENT
/begin MEASUREMENT ThrVlv_nrOffsLrnStepB1 "Actual offset learning step" UWORD OneToOne 1 100 0.00 65535.00 FORMAT "%8.2" ECU_ADDRESS 0x700053D8 /end MEASUREMENT
/begin MEASUREMENT ThrVlv_OffsLrn_I.Snsr1DriftCmpArr "Class instance of public class for offset learning / Array for average calculation (sensor 1)" SWORD spg_q1p221Em3_V 1 100 -40.00000 39.99878 FORMAT "%8.5" ARRAY_SIZE 20 ECU_ADDRESS 0x6001274C /end MEASUREMENT
/begin MEASUREMENT ThrVlv_OffsLrn_I.Snsr2DriftCmpArr "Class instance of public class for offset learning / Array for average calculation (sensor 2)" SWORD spg_q1p221Em3_V 1 100 -40.00000 39.99878 FORMAT "%8.5" ARRAY_SIZE 20 ECU_ADDRESS 0x60012774 /end MEASUREMENT
/begin MEASUREMENT ThrVlv_OffsLrn_I.USens1LWRLHPDif "Class instance of public class for offset learning / Deviation of actual to reference voltage" SLONG spg_q1p221Em3_V 1 100 -2621440.00000 2621439.99878 FORMAT "%13.5" ECU_ADDRESS 0x6001279C /end MEASUREMENT
/begin MEASUREMENT ThrVlv_OffsLrn_I.dratActGrdtColdCdn "Class instance of public class for offset learning / Gradient of actual value position at check for cold temperature conditions" SWORD q0p0586_pc_DIV_s 1 100 -1920.000 1919.941 FORMAT "%8.3" ECU_ADDRESS 0x600127A2 /end MEASUREMENT
/begin MEASUREMENT ThrVlv_OffsLrn_I.dratActGrdtColdCdn_PT1In "Class instance of public class for offset learning / Gradient of actual value position at check for cold temperature conditions Pt1 in" SWORD q0p0586_pc_DIV_s 1 100 -1920.000 1919.941 FORMAT "%8.3" ECU_ADDRESS 0x600127A4 /end MEASUREMENT
/begin MEASUREMENT ThrVlv_OffsLrn_I.dratActGrdtIceChk "Class instance of public class for offset learning / Gradient of actual value position for ice check" SWORD q0p0586_pc_DIV_s 1 100 -1920.000 1919.941 FORMAT "%8.3" ECU_ADDRESS 0x600127A6 /end MEASUREMENT
/begin MEASUREMENT ThrVlv_OffsLrn_I.dratActGrdtIceChkEngRun "Class instance of public class for offset learning / Gradient of actual value position for ice check at engine running" SWORD q0p0586_pc_DIV_s 1 100 -1920.000 1919.941 FORMAT "%8.3" ECU_ADDRESS 0x600127A8 /end MEASUREMENT
/begin MEASUREMENT ThrVlv_OffsLrn_I.dratActGrdtTempOffsLrn "Class instance of public class for offset learning / Gradient of actual value position for temporary offset learning" SWORD q0p0586_pc_DIV_s 1 100 -1920.000 1919.941 FORMAT "%8.3" ECU_ADDRESS 0x600127AA /end MEASUREMENT
/begin MEASUREMENT ThrVlv_OffsLrn_I.dratActGrdtTempOffsLrn_PT1In "Class instance of public class for offset learning / Gradient of actual value position for temporary offset learning PT1 in" SWORD q0p0586_pc_DIV_s 1 100 -1920.000 1919.941 FORMAT "%8.3" ECU_ADDRESS 0x600127AC /end MEASUREMENT
/begin MEASUREMENT ThrVlv_OffsLrn_I.facUBatt "Class instance of public class for offset learning / Battery voltage compensation based on 13,5V reference voltage" UWORD fak_q6p1035Em5 1 100 0.00 3.999939 FORMAT "%8.6" ECU_ADDRESS 0x600127AE /end MEASUREMENT
/begin MEASUREMENT ThrVlv_OffsLrn_I.facWghtSlopSnsr1DriftNew "Class instance of public class for offset learning / New weight factor of the actual region (sensor 1)" UBYTE OneToOne 1 100 0.00 255.0 FORMAT "%5.1" ECU_ADDRESS 0x600127B0 /end MEASUREMENT
/begin MEASUREMENT ThrVlv_OffsLrn_I.facWghtSlopSnsr1DriftOld "Class instance of public class for offset learning / Old weight factor of the actual region (sensor 1)" UBYTE OneToOne 1 100 0.00 255.0 FORMAT "%5.1" ECU_ADDRESS 0x600127B1 /end MEASUREMENT
/begin MEASUREMENT ThrVlv_OffsLrn_I.facWghtSlopSnsr1DriftRng1 "Class instance of public class for offset learning / Weight factor for first, cold temperature region (sensor 1)" UBYTE OneToOne 1 100 0.00 255.0 FORMAT "%5.1" ECU_ADDRESS 0x60038AD8 /end MEASUREMENT
/begin MEASUREMENT ThrVlv_OffsLrn_I.facWghtSlopSnsr1DriftRng2 "Class instance of public class for offset learning / Weight factor for second temperature region (sensor 1)" UBYTE OneToOne 1 100 0.00 255.0 FORMAT "%5.1" ECU_ADDRESS 0x60038AD9 /end MEASUREMENT
/begin MEASUREMENT ThrVlv_OffsLrn_I.facWghtSlopSnsr1DriftRng3 "Class instance of public class for offset learning / Weight factor for third, hot temperature region (sensor 1)" UBYTE OneToOne 1 100 0.00 255.0 FORMAT "%5.1" ECU_ADDRESS 0x60038ADA /end MEASUREMENT
/begin MEASUREMENT ThrVlv_OffsLrn_I.facWghtSlopSnsr2DriftNew "Class instance of public class for offset learning / New weight factor of the actual region (sensor 2)" UBYTE OneToOne 1 100 0.00 255.0 FORMAT "%5.1" ECU_ADDRESS 0x600127B2 /end MEASUREMENT
/begin MEASUREMENT ThrVlv_OffsLrn_I.facWghtSlopSnsr2DriftOld "Class instance of public class for offset learning / Old weight factor of the actual region (sensor 2)" UBYTE OneToOne 1 100 0.00 255.0 FORMAT "%5.1" ECU_ADDRESS 0x600127B3 /end MEASUREMENT
/begin MEASUREMENT ThrVlv_OffsLrn_I.facWghtSlopSnsr2DriftRng1 "Class instance of public class for offset learning / Weight factor for first, cold temperature region (sensor 2)" UBYTE OneToOne 1 100 0.00 255.0 FORMAT "%5.1" ECU_ADDRESS 0x60038ADB /end MEASUREMENT
/begin MEASUREMENT ThrVlv_OffsLrn_I.facWghtSlopSnsr2DriftRng2 "Class instance of public class for offset learning / Weight factor for second temperature region (sensor 2)" UBYTE OneToOne 1 100 0.00 255.0 FORMAT "%5.1" ECU_ADDRESS 0x60038ADC /end MEASUREMENT
/begin MEASUREMENT ThrVlv_OffsLrn_I.facWghtSlopSnsr2DriftRng3 "Class instance of public class for offset learning / Weight factor for third, hot temperature region (sensor 2)" UBYTE OneToOne 1 100 0.00 255.0 FORMAT "%5.1" ECU_ADDRESS 0x60038ADD /end MEASUREMENT
/begin MEASUREMENT ThrVlv_OffsLrn_I.facWghtSnsrDriftRng0Ref "Class instance of public class for offset learning / Weight factor for the nominal reference position" UBYTE OneToOne 1 100 0.00 255.0 FORMAT "%5.1" ECU_ADDRESS 0x60038ADE /end MEASUREMENT
/begin MEASUREMENT ThrVlv_OffsLrn_I.flgBrknLvrDetd "Class instance of public class for offset learning / Broken Lever has been detected" UBYTE OneToOne 1 100 0.00 1.000 BIT_MASK 0x1 FORMAT "%5.3" ECU_ADDRESS 0x600127B4 /end MEASUREMENT
/begin MEASUREMENT ThrVlv_OffsLrn_I.flgClngActv "Class instance of public class for offset learning / Cleaning active" UBYTE OneToOne 1 100 0.00 1.000 BIT_MASK 0x1 FORMAT "%5.3" ECU_ADDRESS 0x600127B5 /end MEASUREMENT
/begin MEASUREMENT ThrVlv_OffsLrn_I.flgClngCalc "Class instance of public class for offset learning / Cleaning function chosen" UBYTE OneToOne 1 100 0.00 1.000 BIT_MASK 0x1 FORMAT "%5.3" ECU_ADDRESS 0x600127B6 /end MEASUREMENT
/begin MEASUREMENT ThrVlv_OffsLrn_I.flgClngFinshd "Class instance of public class for offset learning / Cleaning finished" UBYTE OneToOne 1 100 0.00 1.000 BIT_MASK 0x1 FORMAT "%5.3" ECU_ADDRESS 0x600127B7 /end MEASUREMENT
/begin MEASUREMENT ThrVlv_OffsLrn_I.flgClngRampStartPosn "Class instance of public class for offset learning / Start position for cleaning to ramp to lower mechanical sto reached" UBYTE OneToOne 1 100 0.00 1.000 BIT_MASK 0x1 FORMAT "%5.3" ECU_ADDRESS 0x600127B8 /end MEASUREMENT
/begin MEASUREMENT ThrVlv_OffsLrn_I.flgClngRels "Class instance of public class for offset learning / Cleaning released" UBYTE OneToOne 1 100 0.00 1.000 BIT_MASK 0x1 FORMAT "%5.3" ECU_ADDRESS 0x600127B9 /end MEASUREMENT
/begin MEASUREMENT ThrVlv_OffsLrn_I.flgColdCdnOffsActv "Class instance of public class for offset learning / Offset check at cold temperature conditions active" UBYTE OneToOne 1 100 0.00 1.000 BIT_MASK 0x1 FORMAT "%5.3" ECU_ADDRESS 0x600127BA /end MEASUREMENT
/begin MEASUREMENT ThrVlv_OffsLrn_I.flgColdCdnT "Class instance of public class for offset learning / Cold temperature conditions detected" UBYTE OneToOne 1 100 0.00 1.000 BIT_MASK 0x1 FORMAT "%5.3" ECU_ADDRESS 0x600127BB /end MEASUREMENT
/begin MEASUREMENT ThrVlv_OffsLrn_I.flgDiInj "Class instance of public class for offset learning / Injection disabled by one of the adaptation routines" UBYTE OneToOne 1 100 0.00 1.000 BIT_MASK 0x1 FORMAT "%5.3" ECU_ADDRESS 0x600127BC /end MEASUREMENT
/begin MEASUREMENT ThrVlv_OffsLrn_I.flgDiStrtr "Class instance of public class for offset learning / condition to disable meshing of starter pinion active" UBYTE OneToOne 1 100 0.00 1.000 BIT_MASK 0x1 FORMAT "%5.3" ECU_ADDRESS 0x600127BD /end MEASUREMENT
/begin MEASUREMENT ThrVlv_OffsLrn_I.flgExePsDiag "Class instance of public class for offset learning / Power stage diagnosis, during offset learning functions is executed" UBYTE OneToOne 1 100 0.00 1.000 BIT_MASK 0x1 FORMAT "%5.3" ECU_ADDRESS 0x600127BF /end MEASUREMENT
/begin MEASUREMENT ThrVlv_OffsLrn_I.flgExtOffsLrnTrig "Class instance of public class for offset learning / external Trigger to start offset learning" UBYTE OneToOne 1 100 0.00 1.000 BIT_MASK 0x1 FORMAT "%5.3" ECU_ADDRESS 0x600127C0 /end MEASUREMENT
/begin MEASUREMENT ThrVlv_OffsLrn_I.flgFrstLrnPrfm "Class instance of public class for offset learning / First learning performed" UBYTE OneToOne 1 100 0.00 1.000 BIT_MASK 0x1 FORMAT "%5.3" ECU_ADDRESS 0x600127C1 /end MEASUREMENT
/begin MEASUREMENT ThrVlv_OffsLrn_I.flgFrstSnsrDriftCmp "Class instance of public class for offset learning / Flag of first sensordrift learning" UBYTE OneToOne 1 100 0.00 1.000 BIT_MASK 0x1 FORMAT "%5.3" ECU_ADDRESS 0x600127C2 /end MEASUREMENT
/begin MEASUREMENT ThrVlv_OffsLrn_I.flgIceChkActv "Class instance of public class for offset learning / Ice check active" UBYTE OneToOne 1 100 0.00 1.000 BIT_MASK 0x1 FORMAT "%5.3" ECU_ADDRESS 0x600127C3 /end MEASUREMENT
/begin MEASUREMENT ThrVlv_OffsLrn_I.flgIceChkClsdErr "Class instance of public class for offset learning / Ice error direction closed detected" UBYTE OneToOne 1 100 0.00 1.000 BIT_MASK 0x1 FORMAT "%5.3" ECU_ADDRESS 0x600127C4 /end MEASUREMENT
/begin MEASUREMENT ThrVlv_OffsLrn_I.flgIceChkEngRunActv "Class instance of public class for offset learning / Ice check at engine running active" UBYTE OneToOne 1 100 0.00 1.000 BIT_MASK 0x1 FORMAT "%5.3" ECU_ADDRESS 0x600127C5 /end MEASUREMENT
/begin MEASUREMENT ThrVlv_OffsLrn_I.flgIceChkEngRunClsd "Class instance of public class for offset learning / Ice direction closed detected for ice check at engine running" UBYTE OneToOne 1 100 0.00 1.000 BIT_MASK 0x1 FORMAT "%5.3" ECU_ADDRESS 0x600127C6 /end MEASUREMENT
/begin MEASUREMENT ThrVlv_OffsLrn_I.flgIceChkEngRunClsdOffs "Class instance of public class for offset learning / Ice direction closed below limp air position detected, offset based on detected ice position active" UBYTE OneToOne 1 100 0.00 1.000 BIT_MASK 0x1 FORMAT "%5.3" ECU_ADDRESS 0x600127C7 /end MEASUREMENT
/begin MEASUREMENT ThrVlv_OffsLrn_I.flgIceChkEngRunClsdOffsRels "Class instance of public class for offset learning / Offset calculation for ice below limp air position released" UBYTE OneToOne 1 100 0.00 1.000 BIT_MASK 0x1 FORMAT "%5.3" ECU_ADDRESS 0x600127C8 /end MEASUREMENT
/begin MEASUREMENT ThrVlv_OffsLrn_I.flgIceChkEngRunExe "Class instance of public class for offset learning / Ice removal attempt for ice check at engine running is executed, including waiting for repetition" UBYTE OneToOne 1 100 0.00 1.000 BIT_MASK 0x1 FORMAT "%5.3" ECU_ADDRESS 0x600127C9 /end MEASUREMENT
/begin MEASUREMENT ThrVlv_OffsLrn_I.flgIceChkEngRunOpen "Class instance of public class for offset learning / Ice direction open detected for ice check at engine running" UBYTE OneToOne 1 100 0.00 1.000 BIT_MASK 0x1 FORMAT "%5.3" ECU_ADDRESS 0x600127CA /end MEASUREMENT
/begin MEASUREMENT ThrVlv_OffsLrn_I.flgIceChkEngRunRamp "Class instance of public class for offset learning / Ramp to open position desired value active in case of successful ice removal direction open" UBYTE OneToOne 1 100 0.00 1.000 BIT_MASK 0x1 FORMAT "%5.3" ECU_ADDRESS 0x600127CB /end MEASUREMENT
/begin MEASUREMENT ThrVlv_OffsLrn_I.flgIceChkEngRunT "Class instance of public class for offset learning / Cold temperature conditions for ice check at engine running detected" UBYTE OneToOne 1 100 0.00 1.000 BIT_MASK 0x1 FORMAT "%5.3" ECU_ADDRESS 0x600127CC /end MEASUREMENT
/begin MEASUREMENT ThrVlv_OffsLrn_I.flgIceChkEngRunTog "Class instance of public class for offset learning / Offset to calculate actual set point value for ice removal attempt is added (False) or subtracted (True)" UBYTE OneToOne 1 100 0.00 1.000 BIT_MASK 0x1 FORMAT "%5.3" ECU_ADDRESS 0x600127CD /end MEASUREMENT
/begin MEASUREMENT ThrVlv_OffsLrn_I.flgIceChkFinshd "Class instance of public class for offset learning / Ice check finished" UBYTE OneToOne 1 100 0.00 1.000 BIT_MASK 0x1 FORMAT "%5.3" ECU_ADDRESS 0x600127CE /end MEASUREMENT
/begin MEASUREMENT ThrVlv_OffsLrn_I.flgIceChkOpenErr "Class instance of public class for offset learning / Ice error direction open detected" UBYTE OneToOne 1 100 0.00 1.000 BIT_MASK 0x1 FORMAT "%5.3" ECU_ADDRESS 0x600127CF /end MEASUREMENT
/begin MEASUREMENT ThrVlv_OffsLrn_I.flgIceChkRels "Class instance of public class for offset learning / Ice check released" UBYTE OneToOne 1 100 0.00 1.000 BIT_MASK 0x1 FORMAT "%5.3" ECU_ADDRESS 0x600127D0 /end MEASUREMENT
/begin MEASUREMENT ThrVlv_OffsLrn_I.flgIceChkWakeupDlyFinshd "Class instance of public class for offset learning / Start delay for ice check after wake up is finished" UBYTE OneToOne 1 100 0.00 1.000 BIT_MASK 0x1 FORMAT "%5.3" ECU_ADDRESS 0x600127D1 /end MEASUREMENT
/begin MEASUREMENT ThrVlv_OffsLrn_I.flgKeepColdCdnOffs "Class instance of public class for offset learning / Actual offset for cold temperature conditions is kept" UBYTE OneToOne 1 100 0.00 1.000 BIT_MASK 0x1 FORMAT "%5.3" ECU_ADDRESS 0x600127D2 /end MEASUREMENT
/begin MEASUREMENT ThrVlv_OffsLrn_I.flgKeepIceChkEngRunOffs "Class instance of public class for offset learning / Actual offset from ice check at engine running is kept" UBYTE OneToOne 1 100 0.00 1.000 BIT_MASK 0x1 FORMAT "%5.3" ECU_ADDRESS 0x600127D3 /end MEASUREMENT
/begin MEASUREMENT ThrVlv_OffsLrn_I.flgLimpAirPosnNpl "Class instance of public class for offset learning / Limp Air position not plausible" UBYTE OneToOne 1 100 0.00 1.000 BIT_MASK 0x1 FORMAT "%5.3" ECU_ADDRESS 0x600127D5 /end MEASUREMENT
/begin MEASUREMENT ThrVlv_OffsLrn_I.flgLimpAirPosnSuc "Class instance of public class for offset learning / Learning of Limp Air position successful" UBYTE OneToOne 1 100 0.00 1.000 BIT_MASK 0x1 FORMAT "%5.3" ECU_ADDRESS 0x600127D6 /end MEASUREMENT
/begin MEASUREMENT ThrVlv_OffsLrn_I.flgLongShoTermAdpnCalc "Class instance of public class for offset learning / Long term and short term adaptation chosen" UBYTE OneToOne 1 100 0.00 1.000 BIT_MASK 0x1 FORMAT "%5.3" ECU_ADDRESS 0x600127D7 /end MEASUREMENT
/begin MEASUREMENT ThrVlv_OffsLrn_I.flgLongTermAdpnHist "Class instance of public class for offset learning / Long term adaptation history" UBYTE OneToOne 1 100 0.00 1.000 BIT_MASK 0x1 FORMAT "%5.3" ECU_ADDRESS 0x600127D8 /end MEASUREMENT
/begin MEASUREMENT ThrVlv_OffsLrn_I.flgLongTermAdpnInhbn "Class instance of public class for offset learning / Long term adaptation not released" UBYTE OneToOne 1 100 0.00 1.000 BIT_MASK 0x1 FORMAT "%5.3" ECU_ADDRESS 0x600127D9 /end MEASUREMENT
/begin MEASUREMENT ThrVlv_OffsLrn_I.flgLongTermAdpnRst "Class instance of public class for offset learning / Long term adaptation indication to reset to First learn values only once" UBYTE OneToOne 1 100 0.00 1.000 BIT_MASK 0x1 FORMAT "%5.3" ECU_ADDRESS 0x600127DA /end MEASUREMENT
/begin MEASUREMENT ThrVlv_OffsLrn_I.flgOffsLrnAbort "Class instance of public class for offset learning / Offset learning aborted" UBYTE OneToOne 1 100 0.00 1.000 BIT_MASK 0x1 FORMAT "%5.3" ECU_ADDRESS 0x600127DB /end MEASUREMENT
/begin MEASUREMENT ThrVlv_OffsLrn_I.flgOffsLrnActv "Class instance of public class for offset learning / Offset learning active" UBYTE OneToOne 1 100 0.00 1.000 BIT_MASK 0x1 FORMAT "%5.3" ECU_ADDRESS 0x600127DC /end MEASUREMENT
/begin MEASUREMENT ThrVlv_OffsLrn_I.flgOffsLrnClsdPosnSuc "Class instance of public class for offset learning / Offset learning of closed position successful" UBYTE OneToOne 1 100 0.00 1.000 BIT_MASK 0x1 FORMAT "%5.3" ECU_ADDRESS 0x600127DD /end MEASUREMENT
/begin MEASUREMENT ThrVlv_OffsLrn_I.flgOffsLrnRepnDly "Class instance of public class for offset learning / Delay until permanent offset learning can be repeated active" UBYTE OneToOne 1 100 0.00 1.000 BIT_MASK 0x1 FORMAT "%5.3" ECU_ADDRESS 0x600127E0 /end MEASUREMENT
/begin MEASUREMENT ThrVlv_OffsLrn_I.flgOffsLrnSuc "Class instance of public class for offset learning / Offset learning successful" UBYTE OneToOne 1 100 0.00 1.000 BIT_MASK 0x1 FORMAT "%5.3" ECU_ADDRESS 0x600127E1 /end MEASUREMENT
/begin MEASUREMENT ThrVlv_OffsLrn_I.flgOpenSprgChkCalc "Class instance of public class for offset learning / Open spring check chosen" UBYTE OneToOne 1 100 0.00 1.000 BIT_MASK 0x1 FORMAT "%5.3" ECU_ADDRESS 0x600127E2 /end MEASUREMENT
/begin MEASUREMENT ThrVlv_OffsLrn_I.flgPSOffSnsrDriftCmp "Class instance of public class for offset learning / Flag to request disabling of power stage during sensordrift learning" UBYTE OneToOne 1 100 0.00 1.000 BIT_MASK 0x1 FORMAT "%5.3" ECU_ADDRESS 0x600127E4 /end MEASUREMENT
/begin MEASUREMENT ThrVlv_OffsLrn_I.flgPhyRngClsdExcd "Class instance of public class for offset learning / Physical range check threshold direction closed exceeded" UBYTE OneToOne 1 100 0.00 1.000 BIT_MASK 0x1 FORMAT "%5.3" ECU_ADDRESS 0x600127E5 /end MEASUREMENT
/begin MEASUREMENT ThrVlv_OffsLrn_I.flgPhyRngOpenExcd "Class instance of public class for offset learning / Physical range check threshold direction open exceeded" UBYTE OneToOne 1 100 0.00 1.000 BIT_MASK 0x1 FORMAT "%5.3" ECU_ADDRESS 0x600127E6 /end MEASUREMENT
/begin MEASUREMENT ThrVlv_OffsLrn_I.flgPostDrivePwrStgOff "Class instance of public class for offset learning / Power stage off in post drive for at least .tiPostDrivePwrStgOffDly_C" UBYTE OneToOne 1 100 0.00 1.000 BIT_MASK 0x1 FORMAT "%5.3" ECU_ADDRESS 0x60038ADF /end MEASUREMENT
/begin MEASUREMENT ThrVlv_OffsLrn_I.flgPrmntOffsLrnActv "Class instance of public class for offset learning / Permanent offset learning active" UBYTE OneToOne 1 100 0.00 1.000 BIT_MASK 0x1 FORMAT "%5.3" ECU_ADDRESS 0x600127E8 /end MEASUREMENT
/begin MEASUREMENT ThrVlv_OffsLrn_I.flgPsDiagFinshd "Class instance of public class for offset learning / Power stage diagnosis, during offset learning functions finished" UBYTE OneToOne 1 100 0.00 1.000 BIT_MASK 0x1 FORMAT "%5.3" ECU_ADDRESS 0x600127EB /end MEASUREMENT
/begin MEASUREMENT ThrVlv_OffsLrn_I.flgPsDiagOpenLoad "Class instance of public class for offset learning / Power stage open load- diagnosis during offset learning functions is executed" UBYTE OneToOne 1 100 0.00 1.000 BIT_MASK 0x1 FORMAT "%5.3" ECU_ADDRESS 0x600127EC /end MEASUREMENT
/begin MEASUREMENT ThrVlv_OffsLrn_I.flgReqSnsrDriftDesPosn "Class instance of public class for offset learning / Flag to request that the sensordrift learning calculates the desired position of the throttle valve" UBYTE OneToOne 1 100 0.00 1.000 BIT_MASK 0x1 FORMAT "%5.3" ECU_ADDRESS 0x600127EE /end MEASUREMENT
/begin MEASUREMENT ThrVlv_OffsLrn_I.flgRetSprgChkAbort "Class instance of public class for offset learning / Return spring check aborted" UBYTE OneToOne 1 100 0.00 1.000 BIT_MASK 0x1 FORMAT "%5.3" ECU_ADDRESS 0x600127EF /end MEASUREMENT
/begin MEASUREMENT ThrVlv_OffsLrn_I.flgRetSprgChkActv "Class instance of public class for offset learning / Return spring check active" UBYTE OneToOne 1 100 0.00 1.000 BIT_MASK 0x1 FORMAT "%5.3" ECU_ADDRESS 0x600127F0 /end MEASUREMENT
/begin MEASUREMENT ThrVlv_OffsLrn_I.flgRetSprgChkCalc "Class instance of public class for offset learning / Return spring check chosen" UBYTE OneToOne 1 100 0.00 1.000 BIT_MASK 0x1 FORMAT "%5.3" ECU_ADDRESS 0x600127F1 /end MEASUREMENT
/begin MEASUREMENT ThrVlv_OffsLrn_I.flgRetSprgChkPrfm "Class instance of public class for offset learning / Return spring check performed" UBYTE OneToOne 1 100 0.00 1.000 BIT_MASK 0x1 FORMAT "%5.3" ECU_ADDRESS 0x600127F2 /end MEASUREMENT
/begin MEASUREMENT ThrVlv_OffsLrn_I.flgRetSprgChkRls "Class instance of public class for offset learning / Return spring check released" UBYTE OneToOne 1 100 0.00 1.000 BIT_MASK 0x1 FORMAT "%5.3" ECU_ADDRESS 0x600127F3 /end MEASUREMENT
/begin MEASUREMENT ThrVlv_OffsLrn_I.flgRetSprgChkSuc "Class instance of public class for offset learning / Return spring check successful" UBYTE OneToOne 1 100 0.00 1.000 BIT_MASK 0x1 FORMAT "%5.3" ECU_ADDRESS 0x600127F4 /end MEASUREMENT
/begin MEASUREMENT ThrVlv_OffsLrn_I.flgRlsSnsrDriftCmp "Class instance of public class for offset learning / Flag for the release of sensordrift learning" UBYTE OneToOne 1 100 0.00 1.000 BIT_MASK 0x1 FORMAT "%5.3" ECU_ADDRESS 0x600127F5 /end MEASUREMENT
/begin MEASUREMENT ThrVlv_OffsLrn_I.flgSnsrDriftCmpPt1Ini "Class instance of public class for offset learning / Flag to initialize pt-elements to estimate the temperature of the thorrtle valve" UBYTE OneToOne 1 100 0.00 1.000 BIT_MASK 0x1 FORMAT "%5.3" ECU_ADDRESS 0x600127F6 /end MEASUREMENT
/begin MEASUREMENT ThrVlv_OffsLrn_I.flgSnsrDriftCmpSuc "Class instance of public class for offset learning / Flag to show successfull sensordrift learning" UBYTE OneToOne 1 100 0.00 1.000 BIT_MASK 0x1 FORMAT "%5.3" ECU_ADDRESS 0x600127F7 /end MEASUREMENT
/begin MEASUREMENT ThrVlv_OffsLrn_I.flgTAdjmtColdIni "Class instance of public class for offset learning / Adaptation value of lower electrical stop at low temperatures has to be learned newly" UBYTE OneToOne 1 100 0.00 1.000 BIT_MASK 0x1 FORMAT "%5.3" ECU_ADDRESS 0x60038AE0 /end MEASUREMENT
/begin MEASUREMENT ThrVlv_OffsLrn_I.flgTAdjmtRels "Class instance of public class for offset learning / Reference temperature based calculation for temperatue related offset released" UBYTE OneToOne 1 100 0.00 1.000 BIT_MASK 0x1 FORMAT "%5.3" ECU_ADDRESS 0x600127F9 /end MEASUREMENT
/begin MEASUREMENT ThrVlv_OffsLrn_I.flgTmpOffsLrnActv "Class instance of public class for offset learning / Temporary adaptation active" UBYTE OneToOne 1 100 0.00 1.000 BIT_MASK 0x1 FORMAT "%5.3" ECU_ADDRESS 0x600127FA /end MEASUREMENT
/begin MEASUREMENT ThrVlv_OffsLrn_I.flgUElStopCalcnNotPlaus "Class instance of public class for offset learning / Voltage value during calculation of mechanical stop not plausible" UBYTE OneToOne 1 100 0.00 1.000 BIT_MASK 0x1 FORMAT "%5.3" ECU_ADDRESS 0x600127FB /end MEASUREMENT
/begin MEASUREMENT ThrVlv_OffsLrn_I.nrClngCyc "Class instance of public class for offset learning / Counter of cleaning cycles while cleaning is performed" UBYTE OneToOne 1 100 0.00 255.0 FORMAT "%5.1" ECU_ADDRESS 0x600127FC /end MEASUREMENT
/begin MEASUREMENT ThrVlv_OffsLrn_I.nrClngStep "Class instance of public class for offset learning / Actual cleaning step" UBYTE OneToOne 1 100 0.00 255.0 FORMAT "%5.1" ECU_ADDRESS 0x600127FD /end MEASUREMENT
/begin MEASUREMENT ThrVlv_OffsLrn_I.nrDcycClng "Class instance of public class for offset learning / Counter of driving cycles for cleaning execution" UBYTE OneToOne 1 100 0.00 255.0 FORMAT "%5.1" ECU_ADDRESS 0x60038AE1 /end MEASUREMENT
/begin MEASUREMENT ThrVlv_OffsLrn_I.nrIceChkEngRunTogCyc "Class instance of public class for offset learning / Counter for number of attempts to remove ice at engine running" UBYTE OneToOne 1 100 0.00 255.0 FORMAT "%5.1" ECU_ADDRESS 0x600127FE /end MEASUREMENT
/begin MEASUREMENT ThrVlv_OffsLrn_I.nrIceChkStep "Class instance of public class for offset learning / Actual step for ice check" UBYTE OneToOne 1 100 0.00 255.0 FORMAT "%5.1" ECU_ADDRESS 0x600127FF /end MEASUREMENT
/begin MEASUREMENT ThrVlv_OffsLrn_I.nrIceChkWakeupCyc "Class instance of public class for offset learning / Counter for ice break attempts after wake up without engine start" UBYTE OneToOne 1 100 0.00 255.0 FORMAT "%5.1" ECU_ADDRESS 0x60012800 /end MEASUREMENT
/begin MEASUREMENT ThrVlv_OffsLrn_I.nrIceRmvAtmpt "Class instance of public class for offset learning / Number of attempts to remove the ice" UBYTE dez 1 100 0.00 255.0 FORMAT "%5.1" ECU_ADDRESS 0x60012801 /end MEASUREMENT
/begin MEASUREMENT ThrVlv_OffsLrn_I.nrOffsLrnCyc "Class instance of public class for offset learning / Counter of driving cycles for offset learning execution" UBYTE OneToOne 1 100 0.00 255.0 FORMAT "%5.1" ECU_ADDRESS 0x60012802 /end MEASUREMENT
/begin MEASUREMENT ThrVlv_OffsLrn_I.nrOffsLrnStep "Class instance of public class for offset learning / Actual offset learning step" UWORD OneToOne 1 100 0.00 65535.00 FORMAT "%8.2" ECU_ADDRESS 0x60012804 /end MEASUREMENT
/begin MEASUREMENT ThrVlv_OffsLrn_I.nrRetOpndSprgCyc "Class instance of public class for offset learning / Number of trials for transient oscillation into limp air position by open and by return spring" UBYTE OneToOne 1 100 0.00 255.0 FORMAT "%5.1" ECU_ADDRESS 0x60012806 /end MEASUREMENT
/begin MEASUREMENT ThrVlv_OffsLrn_I.nrRetSprgChkStep "Class instance of public class for offset learning / Actual step for return spring check" UWORD OneToOne 1 100 0.00 65535.00 FORMAT "%8.2" ECU_ADDRESS 0x60012808 /end MEASUREMENT
/begin MEASUREMENT ThrVlv_OffsLrn_I.nrSnsrDriftCmpStep "Class instance of public class for offset learning / Actual step of statemachine to learn sensordrift" UBYTE OneToOne 1 100 0.00 255.0 FORMAT "%5.1" ECU_ADDRESS 0x6001280A /end MEASUREMENT
/begin MEASUREMENT ThrVlv_OffsLrn_I.nrSnsrDriftIdx "Class instance of public class for offset learning / Index for accessing an array during average voltage calculation" UBYTE OneToOne 1 100 0.00 255.0 FORMAT "%5.1" ECU_ADDRESS 0x6001280B /end MEASUREMENT
/begin MEASUREMENT ThrVlv_OffsLrn_I.nrSnsrDriftRng "Class instance of public class for offset learning / Actual temperature region for sensordrift learning" UBYTE OneToOne 1 100 0.00 255.0 FORMAT "%5.1" ECU_ADDRESS 0x6001280C /end MEASUREMENT
/begin MEASUREMENT ThrVlv_OffsLrn_I.nrSnsrDriftVldyChkCyc "Class instance of public class for offset learning / Amount of driving cycles after which sensordrift is validated" UWORD OneToOne 1 100 0.00 65535.00 FORMAT "%8.2" ECU_ADDRESS 0x60038AE2 /end MEASUREMENT
/begin MEASUREMENT ThrVlv_OffsLrn_I.ratActOld "Class instance of public class for offset learning / Actual position value from previous calculation cycle" SWORD rel_q0p0078125 1 100 -256.0000 255.9922 FORMAT "%8.4" ECU_ADDRESS 0x6001280E /end MEASUREMENT
/begin MEASUREMENT ThrVlv_OffsLrn_I.ratActOldColdCdn "Class instance of public class for offset learning / Actual position value from previous calculation cycle for Offset check at cold temperature conditions" SWORD rel_q0p0078125 1 100 -256.0000 255.9922 FORMAT "%8.4" ECU_ADDRESS 0x60012810 /end MEASUREMENT
/begin MEASUREMENT ThrVlv_OffsLrn_I.ratActOldIceChk "Class instance of public class for offset learning / Actual position value from previous calculation cycle for ice check" SWORD rel_q0p0078125 1 100 -256.0000 255.9922 FORMAT "%8.4" ECU_ADDRESS 0x60012812 /end MEASUREMENT
/begin MEASUREMENT ThrVlv_OffsLrn_I.ratActOldIceChkEngRun "Class instance of public class for offset learning / Actual position value from previous calculation cycle for ice check at engine running" SWORD rel_q0p0078125 1 100 -256.0000 255.9922 FORMAT "%8.4" ECU_ADDRESS 0x60012814 /end MEASUREMENT
/begin MEASUREMENT ThrVlv_OffsLrn_I.ratDutyCycOffsLrnLim "Class instance of public class for offset learning / Value for dynamic duty cycle limitation at offset learning" SWORD rel_q0p0078125 1 100 -256.0000 255.9922 FORMAT "%8.4" ECU_ADDRESS 0x60012818 /end MEASUREMENT
/begin MEASUREMENT ThrVlv_OffsLrn_I.ratIceChkEngRun "Class instance of public class for offset learning / Detected ice position for ice check at engine running" SWORD rel_q0p0078125 1 100 -256.0000 255.9922 FORMAT "%8.4" ECU_ADDRESS 0x6001281A /end MEASUREMENT
/begin MEASUREMENT ThrVlv_OffsLrn_I.ratSnsr1DriftAct "Class instance of public class for offset learning / Gradient of sensordrift in the actual temperature region (sensor 1)" SLONG q6p357Em6_V_DIV_K 1 100 -13653.3333333 13653.3333270 FORMAT "%13.7" ECU_ADDRESS 0x60038AE4 /end MEASUREMENT
/begin MEASUREMENT ThrVlv_OffsLrn_I.ratSnsr1DriftNew "Class instance of public class for offset learning / New gradient of sensordrift in the actual temperature region (sensor 1)" SLONG q6p357Em6_V_DIV_K 1 100 -13653.3333333 13653.3333270 FORMAT "%13.7" ECU_ADDRESS 0x60038AE8 /end MEASUREMENT
/begin MEASUREMENT ThrVlv_OffsLrn_I.ratSnsr1DriftOld "Class instance of public class for offset learning / Old gradient of sensordrift in the actual temperature region (sensor 1)" SLONG q6p357Em6_V_DIV_K 1 100 -13653.3333333 13653.3333270 FORMAT "%13.7" ECU_ADDRESS 0x60038AEC /end MEASUREMENT
/begin MEASUREMENT ThrVlv_OffsLrn_I.ratSnsr1DriftRng1 "Class instance of public class for offset learning / Gradient of sensordrift in the first, cold temperature region (sensor 1)" SLONG q6p357Em6_V_DIV_K 1 100 -13653.3333333 13653.3333270 FORMAT "%13.7" ECU_ADDRESS 0x60038AF0 /end MEASUREMENT
/begin MEASUREMENT ThrVlv_OffsLrn_I.ratSnsr1DriftRng2 "Class instance of public class for offset learning / Gradient of sensordrift in the second temperature region (sensor 1)" SLONG q6p357Em6_V_DIV_K 1 100 -13653.3333333 13653.3333270 FORMAT "%13.7" ECU_ADDRESS 0x60038AF4 /end MEASUREMENT
/begin MEASUREMENT ThrVlv_OffsLrn_I.ratSnsr1DriftRng3 "Class instance of public class for offset learning / Gradient of sensordrift in the third, hot temperature region (sensor 1)" SLONG q6p357Em6_V_DIV_K 1 100 -13653.3333333 13653.3333270 FORMAT "%13.7" ECU_ADDRESS 0x60038AF8 /end MEASUREMENT
/begin MEASUREMENT ThrVlv_OffsLrn_I.ratSnsr2DriftAct "Class instance of public class for offset learning / Gradient of sensordrift in the actual temperature region (sensor 2)" SLONG q6p357Em6_V_DIV_K 1 100 -13653.3333333 13653.3333270 FORMAT "%13.7" ECU_ADDRESS 0x60038AFC /end MEASUREMENT
/begin MEASUREMENT ThrVlv_OffsLrn_I.ratSnsr2DriftNew "Class instance of public class for offset learning / New gradient of sensordrift in the actual temperature region (sensor 2)" SLONG q6p357Em6_V_DIV_K 1 100 -13653.3333333 13653.3333270 FORMAT "%13.7" ECU_ADDRESS 0x60038B00 /end MEASUREMENT
/begin MEASUREMENT ThrVlv_OffsLrn_I.ratSnsr2DriftOld "Class instance of public class for offset learning / Old gradient of sensordrift in the actual temperature region (sensor 2)" SLONG q6p357Em6_V_DIV_K 1 100 -13653.3333333 13653.3333270 FORMAT "%13.7" ECU_ADDRESS 0x60038B04 /end MEASUREMENT
/begin MEASUREMENT ThrVlv_OffsLrn_I.ratSnsr2DriftRng1 "Class instance of public class for offset learning / Gradient of sensordrift in the first, cold temperature region (sensor 2)" SLONG q6p357Em6_V_DIV_K 1 100 -13653.3333333 13653.3333270 FORMAT "%13.7" ECU_ADDRESS 0x60038B08 /end MEASUREMENT
/begin MEASUREMENT ThrVlv_OffsLrn_I.ratSnsr2DriftRng2 "Class instance of public class for offset learning / Gradient of sensordrift in the second temperature region (sensor 2)" SLONG q6p357Em6_V_DIV_K 1 100 -13653.3333333 13653.3333270 FORMAT "%13.7" ECU_ADDRESS 0x60038B0C /end MEASUREMENT
/begin MEASUREMENT ThrVlv_OffsLrn_I.ratSnsr2DriftRng3 "Class instance of public class for offset learning / Gradient of sensordrift in the third, hot temperature region (sensor 2)" SLONG q6p357Em6_V_DIV_K 1 100 -13653.3333333 13653.3333270 FORMAT "%13.7" ECU_ADDRESS 0x60038B10 /end MEASUREMENT
/begin MEASUREMENT ThrVlv_OffsLrn_I.stClngRlsCond "Class instance of public class for offset learning / Bitmask for status of cleaning release conditions" UWORD OneToOne 1 100 0.00 65535.00 FORMAT "%8.2" ECU_ADDRESS 0x60012828 /end MEASUREMENT
/begin MEASUREMENT ThrVlv_OffsLrn_I.stDevTypSC "Class instance of public class for offset learning / device type" UWORD OneToOne 1 100 0.00 65535.00 FORMAT "%8.2" ECU_ADDRESS 0x6001282A /end MEASUREMENT
/begin MEASUREMENT ThrVlv_OffsLrn_I.stIceChkMod "Class instance of public class for offset learning / Ice check mode" UBYTE OneToOne 1 100 0.00 255.0 FORMAT "%5.1" ECU_ADDRESS 0x6001282C /end MEASUREMENT
/begin MEASUREMENT ThrVlv_OffsLrn_I.stIceChkRlsCond "Class instance of public class for offset learning / Bitmask for status of ice check release conditions" UWORD OneToOne 1 100 0.00 65535.00 FORMAT "%8.2" ECU_ADDRESS 0x6001282E /end MEASUREMENT
/begin MEASUREMENT ThrVlv_OffsLrn_I.stLimpAirPosnLrn "Class instance of public class for offset learning / Actual learning step of limp air position" UWORD OneToOne 1 100 0.00 65535.00 FORMAT "%8.2" ECU_ADDRESS 0x60012830 /end MEASUREMENT
/begin MEASUREMENT ThrVlv_OffsLrn_I.stLongShoTermAdpn "Class instance of public class for offset learning / Bit mask for release status of long term and short term adaptation" UBYTE OneToOne 1 100 0.00 255.0 FORMAT "%5.1" ECU_ADDRESS 0x60012832 /end MEASUREMENT
/begin MEASUREMENT ThrVlv_OffsLrn_I.stMonBrknLvrDetd "Class instance of public class for offset learning / Broken lever detection monitoring status" UBYTE OneToOne 1 100 0.00 255.0 FORMAT "%5.1" ECU_ADDRESS 0x60012833 /end MEASUREMENT
/begin MEASUREMENT ThrVlv_OffsLrn_I.stOffsLrnOper "Class instance of public class for offset learning / Status for offset learning" UBYTE OneToOne 1 100 0.00 255.0 FORMAT "%5.1" ECU_ADDRESS 0x6001283F /end MEASUREMENT
/begin MEASUREMENT ThrVlv_OffsLrn_I.stOffsLrnRlsCond "Class instance of public class for offset learning / Bitmask for status of offset Learning release conditions" UWORD OneToOne 1 100 0.00 65535.00 FORMAT "%8.2" ECU_ADDRESS 0x60012840 /end MEASUREMENT
/begin MEASUREMENT ThrVlv_OffsLrn_I.stOffsLrnSt "Class instance of public class for offset learning / Bitmask for status of offset Learning" UWORD OneToOne 1 100 0.00 65535.00 FORMAT "%8.2" ECU_ADDRESS 0x60012842 /end MEASUREMENT
/begin MEASUREMENT ThrVlv_OffsLrn_I.stRetSprgChkRlsCond "Class instance of public class for offset learning / Bitmask for status of return spring release conditions" UWORD OneToOne 1 100 0.00 65535.00 FORMAT "%8.2" ECU_ADDRESS 0x60012844 /end MEASUREMENT
/begin MEASUREMENT ThrVlv_OffsLrn_I.tExhMnfOld "Class instance of public class for offset learning / Latest used Exhaustgas temperature manifold to calculate temperature dependent offset" SWORD Temp_Cels 1 100 -3549.940 3003.560 FORMAT "%8.3" ECU_ADDRESS 0x60012846 /end MEASUREMENT
/begin MEASUREMENT ThrVlv_OffsLrn_I.tExhMnfRef "Class instance of public class for offset learning / Reference exhaustgas temperature manifold after latest calculation of temperature dependent offset" SWORD Temp_Cels 1 100 -3549.940 3003.560 FORMAT "%8.3" ECU_ADDRESS 0x60012848 /end MEASUREMENT
/begin MEASUREMENT ThrVlv_OffsLrn_I.tSnsrDriftRngLst "Class instance of public class for offset learning / Temperature of the last successfull learning" SWORD Temp_Cels 1 100 -3549.940 3003.560 FORMAT "%8.3" ECU_ADDRESS 0x6001284A /end MEASUREMENT
/begin MEASUREMENT ThrVlv_OffsLrn_I.tSnsrEtcFil "Class instance of public class for offset learning / Estimated temperature of throttle valve sensor" SWORD Temp_Cels 1 100 -3549.940 3003.560 FORMAT "%8.3" ECU_ADDRESS 0x6001284C /end MEASUREMENT
/begin MEASUREMENT ThrVlv_OffsLrn_I.uAvgSnsr1LwrLHP "Class instance of public class for offset learning / Average sensor 1 voltage at limp home position" UWORD spg_q1p221Em3_V 1 100 0.00 79.99878 FORMAT "%8.5" ECU_ADDRESS 0x60012850 /end MEASUREMENT
/begin MEASUREMENT ThrVlv_OffsLrn_I.uAvgSnsr2LwrLHP "Class instance of public class for offset learning / Average sensor 2 voltage at limp home position" UWORD spg_q1p221Em3_V 1 100 0.00 79.99878 FORMAT "%8.5" ECU_ADDRESS 0x60012852 /end MEASUREMENT
/begin MEASUREMENT ThrVlv_OffsLrn_I.uDifElStopClsdActCold "Class instance of public class for offset learning / Voltage difference between actual learned Value at lower mechanical stop and reference value at low temperatures" SWORD spg_q1p221Em3_V 1 100 -40.00000 39.99878 FORMAT "%8.5" ECU_ADDRESS 0x60012854 /end MEASUREMENT
/begin MEASUREMENT ThrVlv_OffsLrn_I.uDifTOffs "Class instance of public class for offset learning / Temperature related offset for lower mechanical stop" SWORD spg_q1p221Em3_V 1 100 -40.00000 39.99878 FORMAT "%8.5" ECU_ADDRESS 0x60012856 /end MEASUREMENT
/begin MEASUREMENT ThrVlv_OffsLrn_I.uDifTOffsAct "Class instance of public class for offset learning / Temperature related offset for lower mechanical stop for actual calculation" SWORD spg_q1p221Em3_V 1 100 -40.00000 39.99878 FORMAT "%8.5" ECU_ADDRESS 0x60012858 /end MEASUREMENT
/begin MEASUREMENT ThrVlv_OffsLrn_I.uDifTOffsRef "Class instance of public class for offset learning / Temperature related offset for lower mechanical stop from previous calculation" SWORD spg_q1p221Em3_V 1 100 -40.00000 39.99878 FORMAT "%8.5" ECU_ADDRESS 0x6001285A /end MEASUREMENT
/begin MEASUREMENT ThrVlv_OffsLrn_I.uElStopClsdSens1 "Class instance of public class for offset learning / Actual learned sensor voltage of sensor 1 at the lower mechanical stop" UWORD spg_q1p221Em3_V 1 100 0.00 79.99878 FORMAT "%8.5" ECU_ADDRESS 0x6001285C /end MEASUREMENT
/begin MEASUREMENT ThrVlv_OffsLrn_I.uElStopClsdSens1Old "Class instance of public class for offset learning / Copy of last learned sensor voltage of sensor 1 at the lower mechanical stop during permanent Offset learning" UWORD spg_q1p221Em3_V 1 100 0.00 79.99878 FORMAT "%8.5" ECU_ADDRESS 0x60012860 /end MEASUREMENT
/begin MEASUREMENT ThrVlv_OffsLrn_I.uElStopClsdSens2 "Class instance of public class for offset learning / Actual learned sensor voltage of sensor 2 at the lower mechanical stop" UWORD spg_q1p221Em3_V 1 100 0.00 79.99878 FORMAT "%8.5" ECU_ADDRESS 0x60012862 /end MEASUREMENT
/begin MEASUREMENT ThrVlv_OffsLrn_I.uElStopOpenSens1 "Class instance of public class for offset learning / Actual learned sensor voltage of sensor 1 at the upper mechanical stop" UWORD spg_q1p221Em3_V 1 100 0.00 79.99878 FORMAT "%8.5" ECU_ADDRESS 0x60012866 /end MEASUREMENT
/begin MEASUREMENT ThrVlv_OffsLrn_I.uElStopOpenSens1Frst "Class instance of public class for offset learning / Learned reference sensor voltage of sensor 1 at the upper mechanical stop" UWORD spg_q1p221Em3_V 1 100 0.00 79.99878 FORMAT "%8.5" ECU_ADDRESS 0x60012868 /end MEASUREMENT
/begin MEASUREMENT ThrVlv_OffsLrn_I.uElStopOpenSens2 "Class instance of public class for offset learning / Actual learned sensor voltage of sensor 2 at the upper mechanical stop" UWORD spg_q1p221Em3_V 1 100 0.00 79.99878 FORMAT "%8.5" ECU_ADDRESS 0x6001286A /end MEASUREMENT
/begin MEASUREMENT ThrVlv_OffsLrn_I.uElStopOpenSens2Frst "Class instance of public class for offset learning / Learned reference sensor voltage of sensor 2 at the upper mechanical stop" UWORD spg_q1p221Em3_V 1 100 0.00 79.99878 FORMAT "%8.5" ECU_ADDRESS 0x6001286C /end MEASUREMENT
/begin MEASUREMENT ThrVlv_OffsLrn_I.uLimpAirPosnOpenSens1 "Class instance of public class for offset learning / Variable to sum up voltage of sensor 1 at limp air position for mean value, open spring" UWORD spg_q1p221Em3_V 1 100 0.00 79.99878 FORMAT "%8.5" ECU_ADDRESS 0x6001286E /end MEASUREMENT
/begin MEASUREMENT ThrVlv_OffsLrn_I.uLimpAirPosnOpenSens2 "Class instance of public class for offset learning / Variable to sum up voltage of sensor 2 at limp air position for mean value, open spring" UWORD spg_q1p221Em3_V 1 100 0.00 79.99878 FORMAT "%8.5" ECU_ADDRESS 0x60012870 /end MEASUREMENT
/begin MEASUREMENT ThrVlv_OffsLrn_I.uLimpAirPosnRetSens1 "Class instance of public class for offset learning / Variable to sum up voltage of sensor 1 at limp air position for mean value, open spring" UWORD spg_q1p221Em3_V 1 100 0.00 79.99878 FORMAT "%8.5" ECU_ADDRESS 0x60012872 /end MEASUREMENT
/begin MEASUREMENT ThrVlv_OffsLrn_I.uLimpAirPosnRetSens2 "Class instance of public class for offset learning / Variable to sum up voltage of sensor 2 at limp air position for mean value, open spring" UWORD spg_q1p221Em3_V 1 100 0.00 79.99878 FORMAT "%8.5" ECU_ADDRESS 0x60012874 /end MEASUREMENT
/begin MEASUREMENT ThrVlv_OffsLrn_I.uLongTermClsdSens1 "Class instance of public class for offset learning / Long term adaptation value of lower electrical stop sensor 1" UWORD spg_q1p221Em3_V 1 100 0.00 79.99878 FORMAT "%8.5" ECU_ADDRESS 0x6001287E /end MEASUREMENT
/begin MEASUREMENT ThrVlv_OffsLrn_I.uSens1DeltaOldAct "Class instance of public class for offset learning / Sensor voltage difference during mean value calculation at mechanical stop in case of voltage direction turns away from mechanical stop, position sensor 1" SWORD spg_q1p221Em3_V 1 100 -40.00000 39.99878 FORMAT "%8.5" ECU_ADDRESS 0x60012880 /end MEASUREMENT
/begin MEASUREMENT ThrVlv_OffsLrn_I.uSens1LimpAirPosnTmp "Class instance of public class for offset learning / Actual learned sensor voltage of sensor 1 at limp air position after mean value calculation" UWORD spg_q1p221Em3_V 1 100 0.00 79.99878 FORMAT "%8.5" ECU_ADDRESS 0x60012882 /end MEASUREMENT
/begin MEASUREMENT ThrVlv_OffsLrn_I.uSens1LwrLHPref "Class instance of public class for offset learning / Nominal sensor 1 voltage at limp home position" UWORD spg_q1p221Em3_V 1 100 0.00 79.99878 FORMAT "%8.5" ECU_ADDRESS 0x60038B14 /end MEASUREMENT
/begin MEASUREMENT ThrVlv_OffsLrn_I.uSens1OffsLrnCalcnOld "Class instance of public class for offset learning / voltage of sensor 1 read in previous calculation cycle during mean value calculation of sensor voltage at the mechanical stop" UWORD spg_q1p221Em3_V 1 100 0.00 79.99878 FORMAT "%8.5" ECU_ADDRESS 0x60012884 /end MEASUREMENT
/begin MEASUREMENT ThrVlv_OffsLrn_I.uSens1OffsLrnTmp "Class instance of public class for offset learning / Variable for mean value calculation of actual learned sensor voltage of sensor 1 at the mechanical stop" UWORD spg_q1p221Em3_V 1 100 0.00 79.99878 FORMAT "%8.5" ECU_ADDRESS 0x60012886 /end MEASUREMENT
/begin MEASUREMENT ThrVlv_OffsLrn_I.uSens2DeltaOldAct "Class instance of public class for offset learning / Sensor voltage difference during mean value calculation at mechanical stop in case of voltage direction turns away from mechanical stop, position sensor 2" SWORD spg_q1p221Em3_V 1 100 -40.00000 39.99878 FORMAT "%8.5" ECU_ADDRESS 0x6001288C /end MEASUREMENT
/begin MEASUREMENT ThrVlv_OffsLrn_I.uSens2LimpAirPosnTmp "Class instance of public class for offset learning / Actual learned sensor voltage of sensor 2 at limp air position after mean value calculation" UWORD spg_q1p221Em3_V 1 100 0.00 79.99878 FORMAT "%8.5" ECU_ADDRESS 0x6001288E /end MEASUREMENT
/begin MEASUREMENT ThrVlv_OffsLrn_I.uSens2LwrLHPref "Class instance of public class for offset learning / Nominal sensor 2 voltage at limp home position" UWORD spg_q1p221Em3_V 1 100 0.00 79.99878 FORMAT "%8.5" ECU_ADDRESS 0x60038B16 /end MEASUREMENT
/begin MEASUREMENT ThrVlv_OffsLrn_I.uSens2OffsLrnCalcnOld "Class instance of public class for offset learning / voltage of sensor 2 read in previous calculation cycle during mean value calculation of sensor voltage at the mechanical stop" UWORD spg_q1p221Em3_V 1 100 0.00 79.99878 FORMAT "%8.5" ECU_ADDRESS 0x60012890 /end MEASUREMENT
/begin MEASUREMENT ThrVlv_OffsLrn_I.uSens2OffsLrnTmp "Class instance of public class for offset learning / Variable for mean value calculation of actual learned sensor voltage of sensor 2 at the mechanical stop" UWORD spg_q1p221Em3_V 1 100 0.00 79.99878 FORMAT "%8.5" ECU_ADDRESS 0x60012892 /end MEASUREMENT
/begin MEASUREMENT ThrVlv_OffsLrn_I.uSensLwrLHPref_Temp "Class instance of public class for offset learning / Temporary value for the voltage of sensor 1 for the reference position" UWORD spg_q1p221Em3_V 1 100 0.00 79.99878 FORMAT "%8.5" ECU_ADDRESS 0x60012898 /end MEASUREMENT
/begin MEASUREMENT ThrVlv_OffsLrn_I.uShoTermClsdSens1 "Class instance of public class for offset learning / Short term adaptation value of lower electrical stop sensor 1" UWORD spg_q1p221Em3_V 1 100 0.00 79.99878 FORMAT "%8.5" ECU_ADDRESS 0x6001289A /end MEASUREMENT
/begin MEASUREMENT ThrVlv_OffsLrn_I.uSnsr1TDriftOffs "Class instance of public class for offset learning / Calculated offset compared to reference value for sensor 1 voltage at the actual temperature" SWORD spg_q1p221Em3_V 1 100 -40.00000 39.99878 FORMAT "%8.5" ECU_ADDRESS 0x6001289C /end MEASUREMENT
/begin MEASUREMENT ThrVlv_OffsLrn_I.uSnsr1TDriftOffsLimd "Class instance of public class for offset learning / Limited offset for sensor 1" SWORD spg_q1p221Em3_V 1 100 -40.00000 39.99878 FORMAT "%8.5" ECU_ADDRESS 0x6001289E /end MEASUREMENT
/begin MEASUREMENT ThrVlv_OffsLrn_I.uSnsr2TDriftOffs "Class instance of public class for offset learning / Calculated offset compared to reference value for sensor 2 voltage at the actual temperature" SWORD spg_q1p221Em3_V 1 100 -40.00000 39.99878 FORMAT "%8.5" ECU_ADDRESS 0x600128A0 /end MEASUREMENT
/begin MEASUREMENT ThrVlv_OffsLrn_I.uSnsr2TDriftOffsLimd "Class instance of public class for offset learning / Limited offset for sensor 2" SWORD spg_q1p221Em3_V 1 100 -40.00000 39.99878 FORMAT "%8.5" ECU_ADDRESS 0x600128A2 /end MEASUREMENT
/begin MEASUREMENT ThrVlv_OffsLrn_I.uStopColdCdnSens1 "Class instance of public class for offset learning / Calculated offset at cold temperature conditions for actual learned sensor voltage of sensor 1" SWORD spg_q1p221Em3_V 1 100 -40.00000 39.99878 FORMAT "%8.5" ECU_ADDRESS 0x600128A4 /end MEASUREMENT
/begin MEASUREMENT ThrVlv_OffsLrn_I.uStopColdCdnSens2 "Class instance of public class for offset learning / Calculated offset at cold temperature conditions for actual learned sensor voltage of sensor 2" SWORD spg_q1p221Em3_V 1 100 -40.00000 39.99878 FORMAT "%8.5" ECU_ADDRESS 0x600128A6 /end MEASUREMENT
/begin MEASUREMENT ThrVlv_OffsLrn_I.uStopIceChkEngRunSens1 "Class instance of public class for offset learning / Calculated offset for ice check at engine running for actual learned sensor voltage of sensor 1" SWORD spg_q1p221Em3_V 1 100 -40.00000 39.99878 FORMAT "%8.5" ECU_ADDRESS 0x600128A8 /end MEASUREMENT
/begin MEASUREMENT ThrVlv_OffsLrn_I.uStopIceChkEngRunSens2 "Class instance of public class for offset learning / Calculated offset for ice check at engine running for actual learned sensor voltage of sensor 2" SWORD spg_q1p221Em3_V 1 100 -40.00000 39.99878 FORMAT "%8.5" ECU_ADDRESS 0x600128AA /end MEASUREMENT
/begin MEASUREMENT ThrVlv_OffsLrn_I.uSumSens1 "Class instance of public class for offset learning / Sum of sensor 1 during the calculation of an average value" ULONG spg_q1p221Em3_V 1 100 0.00 5242879.99878 FORMAT "%13.5" ECU_ADDRESS 0x600128AC /end MEASUREMENT
/begin MEASUREMENT ThrVlv_OffsLrn_I.uSumSens2 "Class instance of public class for offset learning / Sum of sensor 2 during the calculation of an average value" ULONG spg_q1p221Em3_V 1 100 0.00 5242879.99878 FORMAT "%13.5" ECU_ADDRESS 0x600128B0 /end MEASUREMENT
/begin MEASUREMENT ThrVlv_OffsLrn_I.uTAdjmtColdClsdSens1 "Class instance of public class for offset learning / Adaptation value of lower electrical stop sensor 1 bank 1, learned at low temperatures" UWORD spg_q1p221Em3_V 1 100 0.00 79.99878 FORMAT "%8.5" ECU_ADDRESS 0x600128B4 /end MEASUREMENT
/begin MEASUREMENT ThrVlv_OffsLrn_I.uTmpStopClsdSens1 "Class instance of public class for offset learning / Temporary learned offset for actual learned sensor voltage of sensor 1" SWORD spg_q1p221Em3_V 1 100 -40.00000 39.99878 FORMAT "%8.5" ECU_ADDRESS 0x600128B6 /end MEASUREMENT
/begin MEASUREMENT ThrVlv_OffsLrn_I.uTmpStopClsdSens2 "Class instance of public class for offset learning / Temporary learned offset for actual learned sensor voltage of sensor 2" SWORD spg_q1p221Em3_V 1 100 -40.00000 39.99878 FORMAT "%8.5" ECU_ADDRESS 0x600128B8 /end MEASUREMENT
/begin MEASUREMENT ThrVlv_ratAdpnB1 "Desired value for adaptation of throttle valve of motor bench one" SWORD rel_q0p0078125 1 100 -256.0000 255.9922 FORMAT "%8.4" ECU_ADDRESS 0x600094EC /end MEASUREMENT
/begin MEASUREMENT ThrVlv_ratLimpAirPosnB1 "Limp home position of the throttle valve" SWORD rel_q0p0078125 1 100 -256.0000 255.9922 FORMAT "%8.4" ECU_ADDRESS 0x600094E4 /end MEASUREMENT
/begin MEASUREMENT ThrVlv_ratOffsClsdPosnB1 "Offset for the lower mechanical stop because of dirt" SWORD rel_q0p0078125 1 100 -256.0000 255.9922 FORMAT "%8.4" ECU_ADDRESS 0x600094E2 /end MEASUREMENT
/begin MEASUREMENT ThrVlv_ratOpenPosnMaxB1 "Upper limitation of the desired value" SWORD rel_q0p0078125 1 100 -256.0000 255.9922 FORMAT "%8.4" ECU_ADDRESS 0x600094E0 /end MEASUREMENT
/begin MEASUREMENT ThrVlv_stCmbTyp_MP "measurement point combustion type" UBYTE OneToOne 1 100 0.00 255.0 FORMAT "%5.1" ECU_ADDRESS 0x70009EE4 /end MEASUREMENT
/begin MEASUREMENT ThrVlv_stMonClsdPosnOffsLrnB1 "Offset learning monitoring status for lower mechanical stop" UBYTE OneToOne 1 100 0.00 255.0 FORMAT "%5.1" ECU_ADDRESS 0x700054B2 /end MEASUREMENT
/begin MEASUREMENT ThrVlv_stMonIceDetdB1 "Monitoring status for ice breaking" UBYTE OneToOne 1 100 0.00 255.0 FORMAT "%5.1" ECU_ADDRESS 0x700054B3 /end MEASUREMENT
/begin MEASUREMENT ThrVlv_stMonLimpAirPosnLrnB1 "Offset learning monitoring status for limp air position" UBYTE OneToOne 1 100 0.00 255.0 FORMAT "%5.1" ECU_ADDRESS 0x700054B4 /end MEASUREMENT
/begin MEASUREMENT ThrVlv_stMonOpenSprgChkB1 "Monitoring status for opening spring check" UBYTE OneToOne 1 100 0.00 255.0 FORMAT "%5.1" ECU_ADDRESS 0x700054B5 /end MEASUREMENT
/begin MEASUREMENT ThrVlv_stMonRetSprgChkB1 "Monitoring status for return spring check" UBYTE OneToOne 1 100 0.00 255.0 FORMAT "%5.1" ECU_ADDRESS 0x700054B6 /end MEASUREMENT
/begin MEASUREMENT ThrVlv_stOffsLrnAbortCaseB1 "Bitmask with abortion cases of offset learning" UBYTE OneToOne 1 100 0.00 255.0 FORMAT "%5.1" ECU_ADDRESS 0x6000F7D8 /end MEASUREMENT
/begin MEASUREMENT ThrVlv_stOffsLrnOperB1 "Status of offset learning process" UBYTE OneToOne 1 100 0.00 255.0 FORMAT "%5.1" ECU_ADDRESS 0x700054B7 /end MEASUREMENT
/begin MEASUREMENT ThrVlv_stOffsLrnStB1 "status bit list of offset learning" UWORD OneToOne 1 100 0.00 65535.00 FORMAT "%8.2" ECU_ADDRESS 0x60009444 /end MEASUREMENT
/begin MEASUREMENT ThrVlv_tiDebBattUB1_CL_I.cntDebTi "Debounce timer battery voltage depression bank 1 / Internal counter of the DebUpDwn class" SLONG Time_Dt 1 100 -2147.48364800 2147.48364700 FORMAT "%13.8" ECU_ADDRESS 0x60002654 /end MEASUREMENT
/begin MEASUREMENT ThrVlv_uElStopClsdSens1B1 "Actual learned sensor voltage of sensor 1 at the lower mechanical stop" UWORD spg_q1p221Em3_V 1 100 0.00 79.99878 FORMAT "%8.5" ECU_ADDRESS 0x700053E0 /end MEASUREMENT
/begin MEASUREMENT ThrVlv_uElStopClsdSens1FrstB1 "Learned reference sensor voltage of sensor 1 at the lower mechanical stop" UWORD spg_q1p221Em3_V 1 100 0.00 79.99878 FORMAT "%8.5" ECU_ADDRESS 0x60009442 /end MEASUREMENT
/begin MEASUREMENT ThrVlv_uElStopClsdSens2B1 "Actual learned sensor voltage of sensor 2 at the lower mechanical stop" UWORD spg_q1p221Em3_V 1 100 0.00 79.99878 FORMAT "%8.5" ECU_ADDRESS 0x700053E2 /end MEASUREMENT
/begin MEASUREMENT ThrVlv_uElStopClsdSens2FrstB1 "Learned reference sensor voltage of sensor 2 at the lower mechanical stop" UWORD spg_q1p221Em3_V 1 100 0.00 79.99878 FORMAT "%8.5" ECU_ADDRESS 0x60009440 /end MEASUREMENT
/begin MEASUREMENT ThrVlv_uLimpAirPosnSens1B1 "Learned sensor voltage of sensor 1 at limp air position, bank 1" UWORD spg_q1p221Em3_V 1 100 0.00 79.99878 FORMAT "%8.5" ECU_ADDRESS 0x700053E4 /end MEASUREMENT
/begin MEASUREMENT ThrVlv_uLimpAirPosnSens1FrstB1_MP "Learned reference sensor voltage of sensor 1 at limp air position" UWORD spg_q1p221Em3_V 1 100 0.00 79.99878 FORMAT "%8.5" ECU_ADDRESS 0x70009C3E /end MEASUREMENT
/begin MEASUREMENT ThrVlv_uLimpAirPosnSens2B1 "Learned sensor voltage of sensor 2 at limp air position, bank 1" UWORD spg_q1p221Em3_V 1 100 0.00 79.99878 FORMAT "%8.5" ECU_ADDRESS 0x700053E6 /end MEASUREMENT
/begin MEASUREMENT wdk1ba_w_msg "throttle angle with respect to lower mechanical stop (Throttle 1)" SWORD relDK_q0p02441 1 100 -800.0000 799.9756 FORMAT "%8.4" ECU_ADDRESS 0x70005410 /end MEASUREMENT
/begin MEASUREMENT wdkba_msg "throttle angle referred to lower limit" UBYTE relDK_ub_b100 1 100 0.00 100.0 FORMAT "%5.1" ECU_ADDRESS 0x60014176 /end MEASUREMENT
/begin MEASUREMENT wdkba_w_msg "throttle angle with respect to lower mechanical stop" SWORD relDK_q0p02441 1 100 -800.0000 799.9756 FORMAT "%8.4" ECU_ADDRESS 0x600094DE /end MEASUREMENT
/begin MEASUREMENT wdkink_w_msg "Current increment of throttle-valve target value" UWORD rel_uw_b100 1 100 0.00 99.99847 FORMAT "%8.5" ECU_ADDRESS 0x6001404C /end MEASUREMENT
/begin MEASUREMENT wdkma_w_msg "Throttle position angle signal with tolerances maximal" UWORD rel_uw_b100 1 100 0.00 99.99847 FORMAT "%8.5" ECU_ADDRESS 0x6001404E /end MEASUREMENT
/begin MEASUREMENT wdkmi_w_msg "Throttle position angle signal with tolerances minimal" UWORD rel_uw_b100 1 100 0.00 99.99847 FORMAT "%8.5" ECU_ADDRESS 0x60014050 /end MEASUREMENT
/begin MEASUREMENT wdknlp_w_msg "throttle angle in the limphome air position" UWORD relDK_uw_b100 1 100 0.00 100.0000 FORMAT "%8.4" ECU_ADDRESS 0x60014052 /end MEASUREMENT
/begin MEASUREMENT wdkpm_w_msg "throttle angle with respect to lower mechanical stop (average value or in case of sensor error, the current chosen throttle plate angle wdk_w)" UWORD rel_uw_b100 1 100 0.00 99.99847 FORMAT "%8.5" ECU_ADDRESS 0x60014054 /end MEASUREMENT
/begin MEASUREMENT wdk_w_msg "Throttle position angle signal 16 bits" UWORD rel_uw_b100 1 100 0.00 99.99847 FORMAT "%8.5" ECU_ADDRESS 0x70005412 /end MEASUREMENT
/begin FUNCTION T15_Vld2Lcy "1.11.0    SW Adapter Terminal15 Component Package: Mapping Valid to Legacy Interface Elements" /begin OUT_MEASUREMENT T15_flgOn T15_st T15_stRaw T15_stRawTurnOffDly_Sq /end OUT_MEASUREMENT FUNCTION_VERSION "1.11.0" /end FUNCTION
/begin FUNCTION T50_DD "41.1.0    Start request T50 - driver device"
 /begin DEF_CHARACTERISTIC T50_stDftVal_C T50_swtSigSel_C T50_tiDebHiLo_C T50_tiDebLoHi_C /end DEF_CHARACTERISTIC
 /begin IN_MEASUREMENT Com_stT50 /end IN_MEASUREMENT
 /begin OUT_MEASUREMENT T50_stDebVal /end OUT_MEASUREMENT
 /begin LOC_MEASUREMENT T50_stRaw /end LOC_MEASUREMENT
 FUNCTION_VERSION "41.1.0" /end FUNCTION
/begin FUNCTION T50_VD "36.0.0    Start request T50 - virtual device"
 /begin DEF_CHARACTERISTIC T50_stEmgyDfl_C T50_stNormDfl_C T50_swtEmgyReq_C T50_swtNormReq_C T50_tiEmgcyReq_C /end DEF_CHARACTERISTIC
 /begin IN_MEASUREMENT Com_stEmgcyStrtReqOutSel Com_stStrtReqOutSel MoFTerminal_stT50EmgyMsg /end IN_MEASUREMENT
 /begin OUT_MEASUREMENT T50_st T50_stEmgcy /end OUT_MEASUREMENT
 FUNCTION_VERSION "36.0.0" /end FUNCTION
/begin FUNCTION TCE_Adpr "123.0.0_1.2.0Torque Coordination Engine Adapter" /begin DEF_CHARACTERISTIC TCE_flgGenericFcoReq_C TCE_flgGenericFcoRst_C /end DEF_CHARACTERISTIC /begin IN_MEASUREMENT CoPT_flgFuCutOffActv /end IN_MEASUREMENT /begin OUT_MEASUREMENT TCE_flgGenericFcoReq TCE_flgGenericFcoRst /end OUT_MEASUREMENT FUNCTION_VERSION "123.0.0_1.2.0" /end FUNCTION
/begin FUNCTION TCE_ComSigPrepn "1.1.0     TCE Communication Signal Preparation"
 /begin DEF_CHARACTERISTIC TCE_numCcoThd_C TCE_tiExptFcoStrt_C TCE_tqOverrunOffsThdAcOn_M TCE_tqOverrunOffsThd_M /end DEF_CHARACTERISTIC
 /begin IN_MEASUREMENT AirC_stCmprAct CoEng_bCtOffConDel CoETS_trqInrSetCo ECT_bFCOEnaCmpnPrt Epm_nEng Gbx_stPNPos InjSys_stActRedStg PthSet_bCylIndivFCOBef PthSet_stOvrRun RngMod_trqInrMinWoCtOff /end IN_MEASUREMENT
 /begin OUT_MEASUREMENT TCE_flgCylIndFcoStrtd TCE_flgFcoRdy TCE_tiExptFcoStrt /end OUT_MEASUREMENT
 /begin LOC_MEASUREMENT TCE_nEngTmp TCE_tiExptFcoTmr TCE_tqInnrSetCo /end LOC_MEASUREMENT
 FUNCTION_VERSION "1.1.0" /end FUNCTION
/begin FUNCTION TDev_Adpr "3.2.0     Adapter Function for calculation of component within BC TDev" /begin IN_MEASUREMENT DSMAUX_stDsmClrActv /end IN_MEASUREMENT /begin OUT_MEASUREMENT TDev_flgDSMRprt1000ms TDev_flgDSMRprt100ms /end OUT_MEASUREMENT FUNCTION_VERSION "3.2.0" /end FUNCTION
/begin FUNCTION TDev_CrssChk "5.5.0     CrossCkeck-Diagnosis for TemperatureDevices"
 /begin DEF_CHARACTERISTIC TDevCrssChk_stCfgSwt_C TDevCrssChk_stEnaSnsrForCalcAvrg_C TDevCrssChk_stSnsrEnaForColdChk_C TDevCrssChk_tDiffColdStrtMaxThd_C TDevCrssChk_tDiffColdStrtMinThd_C TDevCrssChk_tDiffIntkAirTMaxThd_C TDevCrssChk_tDiffIntkAirTMinThd_C TDevCrssChk_tiDebEngOff_C TDevCrssChk_tiDebEngOn_C TDevCrssChk_tiForBlkHeatrDetn_C TDevCrssChk_tiForEngStrtFaild_C TDevCrssChk_tiMaxForColdStrtDiag_C TDevCrssChk_tiMinEngCoolgDwn_T TDevCrssChk_tiT15Dly_C TDevCrssChk_tMinThdForEngStal_C /end DEF_CHARACTERISTIC
 /begin IN_MEASUREMENT B_cscltka_msg B_tmmn_msg CEngDsT_flgSnsrColdStrtClr CEngDsT_tSnsrFild CEngDsT_tStop CEngUsT_tSens EngStrt_bStrtEnd Epm_stSpd IntkAirT_flgSnsr1CrssChkClr IntkAirT_flgSnsr2CrssChkClr IntkAirT_tSnsrFild1 IntkAirT_tSnsrFild2 SyC_stSub T15_st TiEngOff_stTi TiEngOff_ti /end IN_MEASUREMENT
 /begin OUT_MEASUREMENT CEngDsT_flgColdStrtDi CEngDsT_flgColdStrtFinal CEngDsT_flgColdStrtHeal CEngDsT_flgColdStrtMaxErr CEngDsT_flgColdStrtMinErr CEngDsT_flgColdStrtRiseNr CEngUsT_flgColdStrtDi CEngUsT_flgColdStrtFinal CEngUsT_flgColdStrtMaxErr CEngUsT_flgColdStrtMaxHeal CEngUsT_flgColdStrtMinErr CEngUsT_flgColdStrtMinHeal CEngUsT_flgColdStrtRiseNr IntkAirT_flgColdStrt1Final IntkAirT_flgColdStrt2Final IntkAirT_flgCrss1MaxErr IntkAirT_flgCrss1MaxHeal IntkAirT_flgCrss1MinErr IntkAirT_flgCrss1MinHeal IntkAirT_flgCrss2MaxErr IntkAirT_flgCrss2MaxHeal IntkAirT_flgCrss2MinErr IntkAirT_flgCrss2MinHeal IntkAirT_flgCrssChk1NumrInc IntkAirT_flgCrssChk2NumrInc TDevCrssChk_tFrzAvg TDev_flgColdStrtDiagFinshd TDev_tRefColdStrtChk /end OUT_MEASUREMENT
 /begin LOC_MEASUREMENT TDevCrssChk_flgBlkHeatrActvd TDevCrssChk_flgCEngBlkTDiagRel TDevCrssChk_flgCEngDsTDiagRel TDevCrssChk_flgCEngUsTDiagRel TDevCrssChk_flgCHdTDiagRel TDevCrssChk_flgCTHeatgRetDiagRel TDevCrssChk_flgDiagRels TDevCrssChk_flgEngMidTDiagRel TDevCrssChk_flgEngRunngDeb TDevCrssChk_flgEngStrtNotSucCyc TDevCrssChk_flgEnvTDiagRel TDevCrssChk_flgFirstStrt TDevCrssChk_flgInhbnCptDfct TDevCrssChk_flgIntkAirT1DiagRel TDevCrssChk_flgIntkAirT2DiagRel TDevCrssChk_flgIntkAirT3DiagRel TDevCrssChk_flgIntkAirT4DiagRel TDevCrssChk_flgOilFilTDiagRel TDevCrssChk_flgOilGlryTDiagRel TDevCrssChk_flgOilSwmpTDiagRel TDevCrssChk_flgPrelCEngDsTErr TDevCrssChk_flgPrelCEngDsTHeal TDevCrssChk_flgPrelCEngDsTMaxErr TDevCrssChk_flgPrelCEngDsTMinErr TDevCrssChk_flgPrelCEngUsTMaxErr TDevCrssChk_flgPrelCEngUsTMaxHeal TDevCrssChk_flgPrelCEngUsTMinErr TDevCrssChk_flgPrelCEngUsTMinHeal TDevCrssChk_flgPrelIntkAirT1Heal TDevCrssChk_flgPrelIntkAirT1MaxErr TDevCrssChk_flgPrelIntkAirT1MinErr TDevCrssChk_flgPrelIntkAirT2Heal TDevCrssChk_flgPrelIntkAirT2MaxErr TDevCrssChk_flgPrelIntkAirT2MinErr TDevCrssChk_flgPrpSysInactv TDevCrssChk_flgT15Dly TDevCrssChk_flgTFlTnkDiagRel TDevCrssChk_st TDevCrssChk_tIntkAirT1Min TDevCrssChk_tIntkAirT2Min /end LOC_MEASUREMENT
 FUNCTION_VERSION "5.5.0" /end FUNCTION
/begin FUNCTION ThDev_Cfg "1.1.0     Provides specific configurations for ThDev" /begin DEF_CHARACTERISTIC ThDev_flgACMaiSwtCodVal_C ThDev_stACMaiSwtSig_C /end DEF_CHARACTERISTIC /begin OUT_MEASUREMENT ThDev_flgACMaiSwtCodVal ThDev_stMaiSwtACSig /end OUT_MEASUREMENT FUNCTION_VERSION "1.1.0" /end FUNCTION
/begin FUNCTION ThrVlv_Adpn "6.7.0     Adapter for new throttle valve DGS software" /begin DEF_CHARACTERISTIC ThrVlv_tiDebDblErrSuspc_C /end DEF_CHARACTERISTIC
 /begin IN_MEASUREMENT B_fhfs_msg B_wdkhfu_msg SyC_stSub ThrVlv_dRatPrVB1 ThrVlv_flgDblSensErrSuspcB1 ThrVlv_flgDesValVldB1 ThrVlv_flgDiInjB1 ThrVlv_flgIrrvFuCutOffB1 ThrVlv_flgLimpModeB1 ThrVlv_flgRegTqRednB1 ThrVlv_flgReqFuCutOffB1 ThrVlv_flgRvsbFuCutOffB1 ThrVlv_flgSngSensErrB1 ThrVlv_flgSngSensErrSuspcB1 ThrVlv_flgUBattSuffB1 ThrVlv_flgXPostDrvB1 ThrVlv_ratActPosnB1 ThrVlv_ratActPosnMaxB1 ThrVlv_ratActPosnMinB1 ThrVlv_ratLimpAirPosnB1 ThrVlv_stMonSensB1 ThrVlv_uSens1B1 wdkhf_w_msg wdks_w_msg /end IN_MEASUREMENT
 /begin OUT_MEASUREMENT AirMod_flgMaiChrgSensErr B_dknolu_msg B_dknotb_msg B_dknot_msg B_dkp1e_msg B_dkp2e_msg B_dkpiu_msg B_dkpru_msg B_dkpu_msg B_dksbeg_msg B_dveada_msg B_edks_msg B_i_ska_fr_msg B_lrnwsur_msg B_lrnws_msg B_nldve_msg B_notlu_fr_msg B_ubdve_msg B_ubpvg_msg B_ub_ok_msg B_wdksg_msg ChrCtl_flgUnthrAgMaiSens ChrCtl_rActPosMnChrgSensB1 ChrCtl_ratDesPosnThrVlvB1 dwdkba_w_msg lrnstat_msg s1fl2p11_msg ThrVlv_bDblSensErrSuspcDeb_msg ThrVlv_bSngSensErr_msg wdk1ba_w_msg wdkba_msg wdkba_w_msg wdkink_w_msg wdkma_w_msg wdkmi_w_msg wdknlp_w_msg wdkpm_w_msg wdk_w_msg /end OUT_MEASUREMENT
 FUNCTION_VERSION "6.7.0" /end FUNCTION
/begin FUNCTION ThrVlv_Mon "1.24.1    Interface to DSM"
 /begin DEF_CHARACTERISTIC ThrVlv_nThdForIrrvFuCutOffB1_C ThrVlv_stMonCfgB1_C ThrVlv_tiDebBattUDepB1_C /end DEF_CHARACTERISTIC
 /begin IN_MEASUREMENT BattU_u CoEng_stMai DSMAUX_stDsmClrActv Epm_nEng Mo_flgICOMsg SyC_stSub ThrVlv_flgDblSensErrB1 ThrVlv_flgLimpAirPosnNotReaB1 ThrVlv_flgSngSensErrB1 ThrVlv_stMonClsdPosnOffsLrnB1 ThrVlv_stMonLimpAirPosnLrnB1 ThrVlv_stMonOpenSprgChkB1 ThrVlv_stMonPosnCtrlB1 ThrVlv_stMonPsIfB1 ThrVlv_stMonRetSprgChkB1 ThrVlv_stMonSensB1 ThrVlv_stOffsLrnAbortCaseB1 /end IN_MEASUREMENT
 /begin OUT_MEASUREMENT ThrVlv_flgIrrvFuCutOffB1 ThrVlv_flgLimpModeB1 ThrVlv_flgRegTqRednB1 ThrVlv_flgReqFuCutOffB1 ThrVlv_flgRvsbFuCutOffB1 ThrVlv_flgUBattSuffB1 /end OUT_MEASUREMENT
 /begin LOC_MEASUREMENT ThrVlv_flgBattFltB1 ThrVlv_flgDKnplErrActB1 ThrVlv_flgDKnplErrOldB1 ThrVlv_flgIrrvBattFltB1 ThrVlv_flgMonDsmClearDmd_B1 ThrVlv_flgRvsbBattFltB1 ThrVlv_flgSnsrDiagPrmsB1 ThrVlv_tiDebBattUB1_CL_I.cntDebTi /end LOC_MEASUREMENT
 FUNCTION_VERSION "1.24.1" /end FUNCTION
/begin FUNCTION ThrVlv_OffsLrn "1.37.0    Adaptation of mechanical characteristic values"
 /begin DEF_CHARACTERISTIC ThrVlv_flgLimpAirPosnFctEnaB1_C ThrVlv_IfClsdOffsLrnPrm_IF.nrDcycOffsLrnExeRels_C ThrVlv_IfClsdOffsLrnPrm_IF.ratOffsLrnDutyCycThd_C ThrVlv_IfClsdOffsLrnPrm_IF.ratOffsLrnStep_C ThrVlv_IfClsdOffsLrnPrm_IF.ratOffsLrnStrtPosn_C ThrVlv_IfClsdOffsLrnPrm_IF.ratOffsLrnStrtRng_C ThrVlv_IfClsdOffsLrnPrm_IF.tiOffsLrnStopPosn_C ThrVlv_IfClsdOffsLrnPrm_IF.tiOffsLrnTout_C ThrVlv_IfClsdOffsLrnPrm_IF.uElecOffsStopPosn_C ThrVlv_IfClsdOffsLrnPrm_IF.uElecStopPosn_C ThrVlv_IfClsdOffsLrnPrm_IF.uElecStopSnsr1Max_C ThrVlv_IfClsdOffsLrnPrm_IF.uElecStopSnsr1Min_C ThrVlv_IfClsdOffsLrnPrm_IF.uOffsLrnCalcNotPlaus_C ThrVlv_IfColdCdnOffsPrm_IF.flgCalcColdCdnOffs_C ThrVlv_IfColdCdnOffsPrm_IF.flgColdCdnOffsMonRels_C ThrVlv_IfColdCdnOffsPrm_IF.flgColdCdnOffsSimn_C ThrVlv_IfColdCdnOffsPrm_IF.flgColdCdnT_MAP ThrVlv_IfColdCdnOffsPrm_IF.flgRvsColdCdnRampDwnCompl_C ThrVlv_IfColdCdnOffsPrm_IF.ratActGrdtColdCdnOffs_C ThrVlv_IfColdCdnOffsPrm_IF.ratColdCdnOffsDutyCycMax_C ThrVlv_IfColdCdnOffsPrm_IF.ratColdCdnOffsDutyCycMin_C ThrVlv_IfColdCdnOffsPrm_IF.ratColdCdnOffsPosnThd_C ThrVlv_IfColdCdnOffsPrm_IF.ratColdCdnRelActPosn_C ThrVlv_IfColdCdnOffsPrm_IF.tAirColdCdnMltd_C ThrVlv_IfColdCdnOffsPrm_IF.tEngColdCdnMltd_C ThrVlv_IfColdCdnOffsPrm_IF.tiDeltaRatActColdCdnOffsMin_C ThrVlv_IfColdCdnOffsPrm_IF.tiDutyCycColdCdnOffsDly_C ThrVlv_IfColdCdnOffsPrm_IF.tiDutyCycRvsColdCdnOffsDly_C ThrVlv_IfColdCdnOffsPrm_IF.uColdCdnOffsMax_C ThrVlv_IfColdCdnOffsPrm_IF.uColdCdnOffsMin_C ThrVlv_IfColdCdnOffsPrm_IF.uColdCdnOffsSimn_C ThrVlv_IfColdCdnOffsPrm_IF.uColdCdnOffsStep_C ThrVlv_IfColdCdnOffsPrm_IF.uColdCdnOffs_C ThrVlv_IfLimpAirPosnPrm_IF.numDetLimpAirPosnCyc_C ThrVlv_IfLimpAirPosnPrm_IF.tiLimpAirPosnCalc_C ThrVlv_IfLimpAirPosnPrm_IF.tiLimpAirPosnStabDly_C ThrVlv_IfLimpAirPosnPrm_IF.uLimpAirPosnDrift_C ThrVlv_IfLimpAirPosnPrm_IF.uLimpAirPosnMax_C ThrVlv_IfLimpAirPosnPrm_IF.uLimpAirPosnMin_C ThrVlv_IfLimpAirPosnPrm_IF.uLimpAirPosnPlaus_C ThrVlv_IfOffsLrnRels_IF.nEngSpdThd_C ThrVlv_IfOffsLrnRels_IF.stRlsMsk_C ThrVlv_IfOffsLrnRels_IF.tAirMax_C ThrVlv_IfOffsLrnRels_IF.tAirMin_C ThrVlv_IfOffsLrnRels_IF.tEngMax_C ThrVlv_IfOffsLrnRels_IF.tEngMin_C ThrVlv_IfOffsLrnRels_IF.uBattMax_C ThrVlv_IfOffsLrnRels_IF.uBattMin_C ThrVlv_IfOffsLrnRels_IF.vVehVThd_C ThrVlv_IfOffsLrnSnsr2Prm_IF.uElecStopSnsr2Max_C ThrVlv_IfOffsLrnSnsr2Prm_IF.uElecStopSnsr2Min_C ThrVlv_IfOpenSprgChk_IF.flgOpenSprgChk_C ThrVlv_IfPsDiagPrm_IF.tiOpenLoadDiagTout_C ThrVlv_IfRetSprgChkRels_IF.nEngSpdThd_C ThrVlv_IfRetSprgChkRels_IF.stRlsMsk_C ThrVlv_IfRetSprgChkRels_IF.tAirMax_C ThrVlv_IfRetSprgChkRels_IF.tAirMin_C ThrVlv_IfRetSprgChkRels_IF.tEngMax_C ThrVlv_IfRetSprgChkRels_IF.tEngMin_C ThrVlv_IfRetSprgChkRels_IF.uBattMax_C ThrVlv_IfRetSprgChkRels_IF.uBattMin_C ThrVlv_IfRetSprgChkRels_IF.vVehVThd_C ThrVlv_IfSprgChkPrm_IF.ratLimpAirRng_C ThrVlv_IfSprgChkPrm_IF.ratOpenSprgSprdRng_C ThrVlv_IfSprgChkPrm_IF.ratRetSprgSprdRng_C ThrVlv_IfSprgChkPrm_IF.ratRetSprgSprd_C ThrVlv_IfSprgChkPrm_IF.tiOpenSprgLimpAirPosn_C ThrVlv_IfSprgChkPrm_IF.tiOpenSprgSprd_C ThrVlv_IfSprgChkPrm_IF.tiRetSprgLimpAirPosn_C ThrVlv_IfSprgChkPrm_IF.tiRetSprgSprd_C ThrVlv_IfTmpOffsLrnPrm_IF.ratActGrdtTmpOffsLrn_C ThrVlv_IfTmpOffsLrnPrm_IF.ratDesActDe_C ThrVlv_IfTmpOffsLrnPrm_IF.ratTmpOffsLrnDutyCycMax_C ThrVlv_IfTmpOffsLrnPrm_IF.ratTmpOffsLrnDutyCycMin_C ThrVlv_IfTmpOffsLrnPrm_IF.ratTmpOffsLrnPosnThd_C ThrVlv_IfTmpOffsLrnPrm_IF.tEngTmpOffsMin_C ThrVlv_IfTmpOffsLrnPrm_IF.tiDeltaRatActTmpOffsMin_C ThrVlv_IfTmpOffsLrnPrm_IF.tiDutyCycTmpOffsLrnDly_C ThrVlv_IfTmpOffsLrnPrm_IF.tiTmpOffsLrnRvsAdpn_C ThrVlv_IfTmpOffsLrnPrm_IF.uTmpOffsLrnOffsMax_C ThrVlv_IfTmpOffsLrnPrm_IF.uTmpOffsLrnOffsMin_C ThrVlv_IfTmpOffsLrnPrm_IF.uTmpOffsLrnStep_C ThrVlv_OffsLrn_I.stOffsLrnSysStEnbl_C ThrVlv_OffsLrn_I.stOffsLrnTrig_C ThrVlv_OffsLrn_I.tiOffsLrnPostDriveDly_C ThrVlv_OffsLrn_I.tiOffsLrnT15OnDly_C ThrVlv_OffsLrn_I.tiPostDrivePwrStgOffDly_C ThrVlv_OffsLrn_I.uDiffEepStoreThres_C ThrVlv_OffsLrn_I.uMovZon_C ThrVlv_OffsLrn_I.uStopOpenSens1Max_C /end DEF_CHARACTERISTIC
 /begin IN_MEASUREMENT BattU_u EngDa_tEng Epm_nEng IntkAirT_tThrVlvUs SyC_stSub ThrVlv_facUBattB1 ThrVlv_flgActrOnB1 ThrVlv_flgLimpModeB1 ThrVlv_flgOpenLoadDiagFinshdB1 ThrVlv_flgRegTqRednB1 ThrVlv_flgReqFuCutOffB1 ThrVlv_flgUBattSuffB1 ThrVlv_ratActIntB1 ThrVlv_ratDesB1 ThrVlv_ratDutyCycB1 ThrVlv_stMonPsIfB1 ThrVlv_stPosnCtrlStB1 ThrVlv_uSens1B1 ThrVlv_uSens2B1 VehV_v /end IN_MEASUREMENT
 /begin OUT_MEASUREMENT ThrVlv_dRatPrVB1 ThrVlv_flgAdpnRelsB1 ThrVlv_flgColdCdnOffsActvB1 ThrVlv_flgColdCdnTB1 ThrVlv_flgDiInjB1 ThrVlv_flgLimpAirPosnFctEnaB1 ThrVlv_flgOffsLrnAbortB1 ThrVlv_flgOffsLrnPsOffB1 ThrVlv_flgOffsLrnSucB1 ThrVlv_nrOffsLrnStepB1 ThrVlv_ratAdpnB1 ThrVlv_ratLimpAirPosnB1 ThrVlv_ratOffsClsdPosnB1 ThrVlv_ratOpenPosnMaxB1 ThrVlv_stMonClsdPosnOffsLrnB1 ThrVlv_stMonIceDetdB1 ThrVlv_stMonLimpAirPosnLrnB1 ThrVlv_stMonOpenSprgChkB1 ThrVlv_stMonRetSprgChkB1 ThrVlv_stOffsLrnAbortCaseB1 ThrVlv_stOffsLrnOperB1 ThrVlv_stOffsLrnStB1 ThrVlv_uElStopClsdSens1B1 ThrVlv_uElStopClsdSens1FrstB1 ThrVlv_uElStopClsdSens2B1 ThrVlv_uElStopClsdSens2FrstB1 ThrVlv_uLimpAirPosnSens1B1 ThrVlv_uLimpAirPosnSens2B1 /end OUT_MEASUREMENT
 /begin LOC_MEASUREMENT ThrVlv_flgOffsLrnDsmClrDmdB1 ThrVlv_nrOffsLrnCycB1 ThrVlv_OffsLrn_I.Snsr1DriftCmpArr ThrVlv_OffsLrn_I.Snsr2DriftCmpArr ThrVlv_OffsLrn_I.USens1LWRLHPDif ThrVlv_OffsLrn_I.dratActGrdtColdCdn ThrVlv_OffsLrn_I.dratActGrdtColdCdn_PT1In ThrVlv_OffsLrn_I.dratActGrdtIceChk ThrVlv_OffsLrn_I.dratActGrdtIceChkEngRun ThrVlv_OffsLrn_I.dratActGrdtTempOffsLrn ThrVlv_OffsLrn_I.dratActGrdtTempOffsLrn_PT1In ThrVlv_OffsLrn_I.facUBatt ThrVlv_OffsLrn_I.facWghtSlopSnsr1DriftNew ThrVlv_OffsLrn_I.facWghtSlopSnsr1DriftOld ThrVlv_OffsLrn_I.facWghtSlopSnsr1DriftRng1 ThrVlv_OffsLrn_I.facWghtSlopSnsr1DriftRng2 ThrVlv_OffsLrn_I.facWghtSlopSnsr1DriftRng3 ThrVlv_OffsLrn_I.facWghtSlopSnsr2DriftNew ThrVlv_OffsLrn_I.facWghtSlopSnsr2DriftOld ThrVlv_OffsLrn_I.facWghtSlopSnsr2DriftRng1 ThrVlv_OffsLrn_I.facWghtSlopSnsr2DriftRng2 ThrVlv_OffsLrn_I.facWghtSlopSnsr2DriftRng3 ThrVlv_OffsLrn_I.facWghtSnsrDriftRng0Ref ThrVlv_OffsLrn_I.flgBrknLvrDetd ThrVlv_OffsLrn_I.flgClngActv ThrVlv_OffsLrn_I.flgClngCalc ThrVlv_OffsLrn_I.flgClngFinshd ThrVlv_OffsLrn_I.flgClngRampStartPosn ThrVlv_OffsLrn_I.flgClngRels ThrVlv_OffsLrn_I.flgColdCdnOffsActv ThrVlv_OffsLrn_I.flgColdCdnT ThrVlv_OffsLrn_I.flgDiInj ThrVlv_OffsLrn_I.flgDiStrtr ThrVlv_OffsLrn_I.flgExePsDiag ThrVlv_OffsLrn_I.flgExtOffsLrnTrig ThrVlv_OffsLrn_I.flgFrstLrnPrfm ThrVlv_OffsLrn_I.flgFrstSnsrDriftCmp ThrVlv_OffsLrn_I.flgIceChkActv ThrVlv_OffsLrn_I.flgIceChkClsdErr ThrVlv_OffsLrn_I.flgIceChkEngRunActv ThrVlv_OffsLrn_I.flgIceChkEngRunClsd ThrVlv_OffsLrn_I.flgIceChkEngRunClsdOffs ThrVlv_OffsLrn_I.flgIceChkEngRunClsdOffsRels ThrVlv_OffsLrn_I.flgIceChkEngRunExe ThrVlv_OffsLrn_I.flgIceChkEngRunOpen ThrVlv_OffsLrn_I.flgIceChkEngRunRamp ThrVlv_OffsLrn_I.flgIceChkEngRunT ThrVlv_OffsLrn_I.flgIceChkEngRunTog ThrVlv_OffsLrn_I.flgIceChkFinshd ThrVlv_OffsLrn_I.flgIceChkOpenErr ThrVlv_OffsLrn_I.flgIceChkRels ThrVlv_OffsLrn_I.flgIceChkWakeupDlyFinshd ThrVlv_OffsLrn_I.flgKeepColdCdnOffs ThrVlv_OffsLrn_I.flgKeepIceChkEngRunOffs ThrVlv_OffsLrn_I.flgLimpAirPosnNpl ThrVlv_OffsLrn_I.flgLimpAirPosnSuc ThrVlv_OffsLrn_I.flgLongShoTermAdpnCalc ThrVlv_OffsLrn_I.flgLongTermAdpnHist ThrVlv_OffsLrn_I.flgLongTermAdpnInhbn ThrVlv_OffsLrn_I.flgLongTermAdpnRst ThrVlv_OffsLrn_I.flgOffsLrnAbort ThrVlv_OffsLrn_I.flgOffsLrnActv ThrVlv_OffsLrn_I.flgOffsLrnClsdPosnSuc ThrVlv_OffsLrn_I.flgOffsLrnRepnDly ThrVlv_OffsLrn_I.flgOffsLrnSuc ThrVlv_OffsLrn_I.flgOpenSprgChkCalc ThrVlv_OffsLrn_I.flgPSOffSnsrDriftCmp ThrVlv_OffsLrn_I.flgPhyRngClsdExcd ThrVlv_OffsLrn_I.flgPhyRngOpenExcd ThrVlv_OffsLrn_I.flgPostDrivePwrStgOff ThrVlv_OffsLrn_I.flgPrmntOffsLrnActv ThrVlv_OffsLrn_I.flgPsDiagFinshd ThrVlv_OffsLrn_I.flgPsDiagOpenLoad ThrVlv_OffsLrn_I.flgReqSnsrDriftDesPosn ThrVlv_OffsLrn_I.flgRetSprgChkAbort ThrVlv_OffsLrn_I.flgRetSprgChkActv ThrVlv_OffsLrn_I.flgRetSprgChkCalc ThrVlv_OffsLrn_I.flgRetSprgChkPrfm ThrVlv_OffsLrn_I.flgRetSprgChkRls ThrVlv_OffsLrn_I.flgRetSprgChkSuc ThrVlv_OffsLrn_I.flgRlsSnsrDriftCmp ThrVlv_OffsLrn_I.flgSnsrDriftCmpPt1Ini ThrVlv_OffsLrn_I.flgSnsrDriftCmpSuc ThrVlv_OffsLrn_I.flgTAdjmtColdIni ThrVlv_OffsLrn_I.flgTAdjmtRels ThrVlv_OffsLrn_I.flgTmpOffsLrnActv ThrVlv_OffsLrn_I.flgUElStopCalcnNotPlaus ThrVlv_OffsLrn_I.nrClngCyc ThrVlv_OffsLrn_I.nrClngStep ThrVlv_OffsLrn_I.nrDcycClng ThrVlv_OffsLrn_I.nrIceChkEngRunTogCyc ThrVlv_OffsLrn_I.nrIceChkStep ThrVlv_OffsLrn_I.nrIceChkWakeupCyc ThrVlv_OffsLrn_I.nrIceRmvAtmpt ThrVlv_OffsLrn_I.nrOffsLrnCyc ThrVlv_OffsLrn_I.nrOffsLrnStep ThrVlv_OffsLrn_I.nrRetOpndSprgCyc ThrVlv_OffsLrn_I.nrRetSprgChkStep ThrVlv_OffsLrn_I.nrSnsrDriftCmpStep ThrVlv_OffsLrn_I.nrSnsrDriftIdx ThrVlv_OffsLrn_I.nrSnsrDriftRng ThrVlv_OffsLrn_I.nrSnsrDriftVldyChkCyc ThrVlv_OffsLrn_I.ratActOld ThrVlv_OffsLrn_I.ratActOldColdCdn ThrVlv_OffsLrn_I.ratActOldIceChk ThrVlv_OffsLrn_I.ratActOldIceChkEngRun ThrVlv_OffsLrn_I.ratDutyCycOffsLrnLim ThrVlv_OffsLrn_I.ratIceChkEngRun ThrVlv_OffsLrn_I.ratSnsr1DriftAct ThrVlv_OffsLrn_I.ratSnsr1DriftNew ThrVlv_OffsLrn_I.ratSnsr1DriftOld ThrVlv_OffsLrn_I.ratSnsr1DriftRng1 ThrVlv_OffsLrn_I.ratSnsr1DriftRng2 ThrVlv_OffsLrn_I.ratSnsr1DriftRng3 ThrVlv_OffsLrn_I.ratSnsr2DriftAct ThrVlv_OffsLrn_I.ratSnsr2DriftNew ThrVlv_OffsLrn_I.ratSnsr2DriftOld ThrVlv_OffsLrn_I.ratSnsr2DriftRng1 ThrVlv_OffsLrn_I.ratSnsr2DriftRng2 ThrVlv_OffsLrn_I.ratSnsr2DriftRng3 ThrVlv_OffsLrn_I.stClngRlsCond ThrVlv_OffsLrn_I.stDevTypSC ThrVlv_OffsLrn_I.stIceChkMod ThrVlv_OffsLrn_I.stIceChkRlsCond ThrVlv_OffsLrn_I.stLimpAirPosnLrn ThrVlv_OffsLrn_I.stLongShoTermAdpn ThrVlv_OffsLrn_I.stMonBrknLvrDetd ThrVlv_OffsLrn_I.stOffsLrnOper ThrVlv_OffsLrn_I.stOffsLrnRlsCond ThrVlv_OffsLrn_I.stOffsLrnSt ThrVlv_OffsLrn_I.stRetSprgChkRlsCond ThrVlv_OffsLrn_I.tExhMnfOld ThrVlv_OffsLrn_I.tExhMnfRef ThrVlv_OffsLrn_I.tSnsrDriftRngLst ThrVlv_OffsLrn_I.tSnsrEtcFil ThrVlv_OffsLrn_I.uAvgSnsr1LwrLHP ThrVlv_OffsLrn_I.uAvgSnsr2LwrLHP ThrVlv_OffsLrn_I.uDifElStopClsdActCold ThrVlv_OffsLrn_I.uDifTOffs ThrVlv_OffsLrn_I.uDifTOffsAct ThrVlv_OffsLrn_I.uDifTOffsRef ThrVlv_OffsLrn_I.uElStopClsdSens1 ThrVlv_OffsLrn_I.uElStopClsdSens1Old ThrVlv_OffsLrn_I.uElStopClsdSens2 ThrVlv_OffsLrn_I.uElStopOpenSens1 ThrVlv_OffsLrn_I.uElStopOpenSens1Frst ThrVlv_OffsLrn_I.uElStopOpenSens2 ThrVlv_OffsLrn_I.uElStopOpenSens2Frst ThrVlv_OffsLrn_I.uLimpAirPosnOpenSens1 ThrVlv_OffsLrn_I.uLimpAirPosnOpenSens2 ThrVlv_OffsLrn_I.uLimpAirPosnRetSens1 ThrVlv_OffsLrn_I.uLimpAirPosnRetSens2 ThrVlv_OffsLrn_I.uLongTermClsdSens1 ThrVlv_OffsLrn_I.uSens1DeltaOldAct ThrVlv_OffsLrn_I.uSens1LimpAirPosnTmp ThrVlv_OffsLrn_I.uSens1LwrLHPref ThrVlv_OffsLrn_I.uSens1OffsLrnCalcnOld ThrVlv_OffsLrn_I.uSens1OffsLrnTmp ThrVlv_OffsLrn_I.uSens2DeltaOldAct ThrVlv_OffsLrn_I.uSens2LimpAirPosnTmp ThrVlv_OffsLrn_I.uSens2LwrLHPref ThrVlv_OffsLrn_I.uSens2OffsLrnCalcnOld ThrVlv_OffsLrn_I.uSens2OffsLrnTmp ThrVlv_OffsLrn_I.uSensLwrLHPref_Temp ThrVlv_OffsLrn_I.uShoTermClsdSens1 ThrVlv_OffsLrn_I.uSnsr1TDriftOffs ThrVlv_OffsLrn_I.uSnsr1TDriftOffsLimd ThrVlv_OffsLrn_I.uSnsr2TDriftOffs ThrVlv_OffsLrn_I.uSnsr2TDriftOffsLimd ThrVlv_OffsLrn_I.uStopColdCdnSens1 ThrVlv_OffsLrn_I.uStopColdCdnSens2 ThrVlv_OffsLrn_I.uStopIceChkEngRunSens1 ThrVlv_OffsLrn_I.uStopIceChkEngRunSens2 ThrVlv_OffsLrn_I.uSumSens1 ThrVlv_OffsLrn_I.uSumSens2 ThrVlv_OffsLrn_I.uTAdjmtColdClsdSens1 ThrVlv_OffsLrn_I.uTmpStopClsdSens1 ThrVlv_OffsLrn_I.uTmpStopClsdSens2 ThrVlv_stCmbTyp_MP ThrVlv_uLimpAirPosnSens1FrstB1_MP /end LOC_MEASUREMENT
 FUNCTION_VERSION "1.37.0" /end FUNCTION
/begin COMPU_METHOD B_TRUE "" TAB_VERB "%6.3" "" COMPU_TAB_REF B_TRUE /end COMPU_METHOD
/begin COMPU_VTAB B_TRUE "" TAB_VERB 2 0 "FALSE" 1 "TRUE" /end COMPU_VTAB
/begin COMPU_METHOD dez "" RAT_FUNC "%6.2" "" COEFFS 0 1 0 0 0 1 /end COMPU_METHOD
/begin COMPU_METHOD EngN "" RAT_FUNC "%6.3" "rpm" COEFFS 0 2 0 0 0 1 /end COMPU_METHOD
/begin COMPU_METHOD fak_q6p1035Em5 "" RAT_FUNC "%7.6" "-" COEFFS 0 65536 0 0 0 4 /end COMPU_METHOD
/begin COMPU_METHOD nmot_q0p5 "" RAT_FUNC "%6.3" "1/min" COEFFS 0 2 0 0 0 1 /end COMPU_METHOD
/begin COMPU_METHOD OneToOne "" RAT_FUNC "%6.2" "-" COEFFS 0 1 0 0 0 1 /end COMPU_METHOD
/begin COMPU_METHOD q0p0586_pc_DIV_s "" RAT_FUNC "%6.4" "%/s" COEFFS 0 256 0 0 0 15 /end COMPU_METHOD
/begin COMPU_METHOD q6p357Em6_V_DIV_K "" RAT_FUNC "%8.7" "V/K" COEFFS 0 786432 0 0 0 5 /end COMPU_METHOD
/begin COMPU_METHOD relDK_q0p02441 "" RAT_FUNC "%6.4" "%DK" COEFFS 0 65536 0 0 0 1600 /end COMPU_METHOD
/begin COMPU_METHOD relDK_ub_b100 "" RAT_FUNC "%6.3" "%DK" COEFFS 0 255 0 0 0 100 /end COMPU_METHOD
/begin COMPU_METHOD relDK_uw_b100 "" RAT_FUNC "%6.4" "%DK" COEFFS 0 65535 0 0 0 100 /end COMPU_METHOD
/begin COMPU_METHOD rel_q0p002441 "" RAT_FUNC "%6.4" "%/V" COEFFS 0 65536 0 0 0 160 /end COMPU_METHOD
/begin COMPU_METHOD rel_q0p0078125 "" RAT_FUNC "%6.4" "%" COEFFS 0 128 0 0 0 1 /end COMPU_METHOD
/begin COMPU_METHOD rel_uw_b100 "" RAT_FUNC "%6.4" "%" COEFFS 0 65536 0 0 0 100 /end COMPU_METHOD
/begin COMPU_METHOD SigQly_COMPU_VERB "" TAB_VERB "%6.3" "" COMPU_TAB_REF SigQly_COMPU_VERB /end COMPU_METHOD
/begin COMPU_VTAB SigQly_COMPU_VERB "" TAB_VERB 16 0 "SIGQLY_NOTCALC" 1 "SIGQLY_INIT" 2 "SIGQLY_OK" 3 "SIGQLY_MODEL" 4 "SIGQLY_REPLACEMENT" 5 "SIGQLY_FROZEN" 6 "SIGQLY_INVALID" 7 "SIGQLY_RESERVED_7" 8 "SIGQLY_RESERVED_8" 9 "SIGQLY_RESERVED_9" 10 "SIGQLY_RESERVED_10" 11 "SIGQLY_RESERVED_11" 12 "SIGQLY_RESERVED_12" 13 "SIGQLY_RESERVED_13" 14 "SIGQLY_RESERVED_14" 15 "SIGQLY_RESERVED_15" /end COMPU_VTAB
/begin COMPU_METHOD spg_q1p221Em3_V "" RAT_FUNC "%6.4" "V" COEFFS 0 65536 0 0 0 80 /end COMPU_METHOD
/begin COMPU_METHOD t10msxs_ub_b2p55 "" RAT_FUNC "%6.4" "s" COEFFS 0 1 0 0 0 0.01 /end COMPU_METHOD
/begin COMPU_METHOD Temp_Cels "" RAT_FUNC "%6.1" "deg C" COEFFS 0 10 2731.4 0 0 1 /end COMPU_METHOD
/begin COMPU_METHOD temp_q0p75 "" RAT_FUNC "%6.3" "GradC" COEFFS 0 4 0 0 0 3 /end COMPU_METHOD
/begin COMPU_METHOD TimeDeb "" RAT_FUNC "%6.1" "ms" COEFFS 0 0.1 0 0 0 1 /end COMPU_METHOD
/begin COMPU_METHOD Time_Dt "" RAT_FUNC "%9.8" "s" COEFFS 0 1000000 0 0 0 1 /end COMPU_METHOD
/begin COMPU_METHOD Time_ms "" RAT_FUNC "%6.1" "ms" COEFFS 0 0.1 0 0 0 1 /end COMPU_METHOD
/begin COMPU_METHOD Time_ms2us "" RAT_FUNC "%6.5" "ms" COEFFS 0 1000 0 0 0 1 /end COMPU_METHOD
/begin COMPU_METHOD Time_s "" RAT_FUNC "%6.4" "s" COEFFS 0 100 0 0 0 1 /end COMPU_METHOD
/begin COMPU_METHOD TIOFF_VDTICMBOFFENA_SC_Compu "" TAB_VERB "%6.3" "" COMPU_TAB_REF TIOFF_VDTICMBOFFENA_SC_Compu /end COMPU_METHOD
/begin COMPU_VTAB TIOFF_VDTICMBOFFENA_SC_Compu "" TAB_VERB 2 0 "False" 1 "True" /end COMPU_VTAB
/begin COMPU_METHOD TIOFF_VDTIENGOFFENA_SC_Compu "" TAB_VERB "%6.3" "" COMPU_TAB_REF TIOFF_VDTIENGOFFENA_SC_Compu /end COMPU_METHOD
/begin COMPU_VTAB TIOFF_VDTIENGOFFENA_SC_Compu "" TAB_VERB 2 0 "False" 1 "True" /end COMPU_VTAB
/begin COMPU_METHOD TIOFF_VDTIPRPSYSACTVOFFENA_SC_Compu "" TAB_VERB "%6.3" "" COMPU_TAB_REF TIOFF_VDTIPRPSYSACTVOFFENA_SC_Compu /end COMPU_METHOD
/begin COMPU_VTAB TIOFF_VDTIPRPSYSACTVOFFENA_SC_Compu "" TAB_VERB 2 0 "False" 1 "True" /end COMPU_VTAB
/begin COMPU_METHOD TIOFF_VDTISTRTENDOFFENA_SC_Compu "" TAB_VERB "%6.3" "" COMPU_TAB_REF TIOFF_VDTISTRTENDOFFENA_SC_Compu /end COMPU_METHOD
/begin COMPU_VTAB TIOFF_VDTISTRTENDOFFENA_SC_Compu "" TAB_VERB 2 0 "False" 1 "True" /end COMPU_VTAB
/begin COMPU_METHOD TIPIN_SY_Compu "" TAB_VERB "%6.3" "" COMPU_TAB_REF TIPIN_SY_Compu /end COMPU_METHOD
/begin COMPU_VTAB TIPIN_SY_Compu "" TAB_VERB 2 0 "0" 1 "1" /end COMPU_VTAB
/begin COMPU_METHOD TLE7209_SY_Compu "" TAB_VERB "%6.3" "" COMPU_TAB_REF TLE7209_SY_Compu /end COMPU_METHOD
/begin COMPU_VTAB TLE7209_SY_Compu "" TAB_VERB 3 0 "no TLE7209" 1 "one TLE7209" 2 "two TLE7209" /end COMPU_VTAB
/begin COMPU_METHOD TLE75602_SC_Compu "" TAB_VERB "%6.3" "" COMPU_TAB_REF TLE75602_SC_Compu /end COMPU_METHOD
/begin COMPU_VTAB TLE75602_SC_Compu "" TAB_VERB 4 0 "no Tle75602" 1 "one Tle75602" 2 "two Tle75602" 3 "three Tle75602" /end COMPU_VTAB
/begin COMPU_METHOD TMEOBDACTV_SC_Compu "" TAB_VERB "%6.3" "" COMPU_TAB_REF TMEOBDACTV_SC_Compu /end COMPU_METHOD
/begin COMPU_VTAB TMEOBDACTV_SC_Compu "" TAB_VERB 2 0 "False" 1 "True" /end COMPU_VTAB
/begin COMPU_METHOD TME_CCOFADEOUT_SC_Compu "" TAB_VERB "%6.3" "" COMPU_TAB_REF TME_CCOFADEOUT_SC_Compu /end COMPU_METHOD
/begin COMPU_VTAB TME_CCOFADEOUT_SC_Compu "" TAB_VERB 2 0 "False" 1 "True" /end COMPU_VTAB
/begin COMPU_METHOD TME_CHRGAIRVLVSWT_SC_Compu "" TAB_VERB "%6.3" "" COMPU_TAB_REF TME_CHRGAIRVLVSWT_SC_Compu /end COMPU_METHOD
/begin COMPU_VTAB TME_CHRGAIRVLVSWT_SC_Compu "" TAB_VERB 2 0 "False" 1 "True" /end COMPU_VTAB
/begin COMPU_METHOD TME_CHRGEXCHLOSSMDLSELN_SC_Compu "" TAB_VERB "%6.3" "" COMPU_TAB_REF TME_CHRGEXCHLOSSMDLSELN_SC_Compu /end COMPU_METHOD
/begin COMPU_VTAB TME_CHRGEXCHLOSSMDLSELN_SC_Compu "" TAB_VERB 3 0 "0" 1 "1" 2 "2" /end COMPU_VTAB
/begin COMPU_METHOD TME_CHRGEXCHLOSSPOSNSELN_SC_Compu "" TAB_VERB "%6.3" "" COMPU_TAB_REF TME_CHRGEXCHLOSSPOSNSELN_SC_Compu /end COMPU_METHOD
/begin COMPU_VTAB TME_CHRGEXCHLOSSPOSNSELN_SC_Compu "" TAB_VERB 2 0 "not_combined" 1 "combined" /end COMPU_VTAB
/begin COMPU_METHOD TME_CYLBNKSPCIAACTEFF_SC_Compu "" TAB_VERB "%6.3" "" COMPU_TAB_REF TME_CYLBNKSPCIAACTEFF_SC_Compu /end COMPU_METHOD
/begin COMPU_VTAB TME_CYLBNKSPCIAACTEFF_SC_Compu "" TAB_VERB 2 0 "Deactivated" 1 "Activated" /end COMPU_VTAB
/begin COMPU_METHOD TME_CYLSPCAIRSYSIF_SC_Compu "" TAB_VERB "%6.3" "" COMPU_TAB_REF TME_CYLSPCAIRSYSIF_SC_Compu /end COMPU_METHOD
/begin COMPU_VTAB TME_CYLSPCAIRSYSIF_SC_Compu "" TAB_VERB 2 0 "DISABLED" 1 "ENABLED" /end COMPU_VTAB
/begin COMPU_METHOD TME_CYLSPCIGNIF_SC_Compu "" TAB_VERB "%6.3" "" COMPU_TAB_REF TME_CYLSPCIGNIF_SC_Compu /end COMPU_METHOD
/begin COMPU_VTAB TME_CYLSPCIGNIF_SC_Compu "" TAB_VERB 2 0 "DISABLED" 1 "ENABLED" /end COMPU_VTAB
/begin COMPU_METHOD TME_CYLSPCTQMDLIF_SC_Compu "" TAB_VERB "%6.3" "" COMPU_TAB_REF TME_CYLSPCTQMDLIF_SC_Compu /end COMPU_METHOD
/begin COMPU_VTAB TME_CYLSPCTQMDLIF_SC_Compu "" TAB_VERB 2 0 "DISABLED" 1 "ENABLED" /end COMPU_VTAB
/begin COMPU_METHOD TME_DRGTQMDLSELN_SC_Compu "" TAB_VERB "%6.3" "" COMPU_TAB_REF TME_DRGTQMDLSELN_SC_Compu /end COMPU_METHOD
/begin COMPU_VTAB TME_DRGTQMDLSELN_SC_Compu "" TAB_VERB 2 0 "Conventional model" 1 "Engine load dependent model" /end COMPU_VTAB
/begin COMPU_METHOD TME_FAKETAIA_SC_Compu "" TAB_VERB "%6.3" "" COMPU_TAB_REF TME_FAKETAIA_SC_Compu /end COMPU_METHOD
/begin COMPU_VTAB TME_FAKETAIA_SC_Compu "" TAB_VERB 7 0 "none" 1 "common curve, load" 2 "sep. curves, load" 3 "sep. curves + 2nd fuel, load" 4 "common map, load and speed" 5 "sep. maps, load and speed" 6 "sep. maps + 2nd fuel, load and speed" /end COMPU_VTAB
/begin COMPU_METHOD TME_STATYLTEIAEFFCALCN_SC_Compu "" TAB_VERB "%6.3" "" COMPU_TAB_REF TME_STATYLTEIAEFFCALCN_SC_Compu /end COMPU_METHOD
/begin COMPU_VTAB TME_STATYLTEIAEFFCALCN_SC_Compu "" TAB_VERB 2 0 "False" 1 "True" /end COMPU_VTAB
/begin COMPU_METHOD TME_TCORRETA_SC_Compu "" TAB_VERB "%6.3" "" COMPU_TAB_REF TME_TCORRETA_SC_Compu /end COMPU_METHOD
/begin COMPU_VTAB TME_TCORRETA_SC_Compu "" TAB_VERB 2 0 "False" 1 "True" /end COMPU_VTAB
/begin COMPU_METHOD TME_TQINNRMAXGBX_SC_Compu "" RAT_FUNC "%6.2" "" COEFFS 0 1 0 0 0 1 /end COMPU_METHOD
/begin COMPU_METHOD TME_TQMINACCRPEDL_SC_Compu "" TAB_VERB "%6.3" "" COMPU_TAB_REF TME_TQMINACCRPEDL_SC_Compu /end COMPU_METHOD
/begin COMPU_VTAB TME_TQMINACCRPEDL_SC_Compu "" TAB_VERB 2 0 "Disabled" 1 "Enabled" /end COMPU_VTAB
/begin COMPU_METHOD TME_VAR_SY_Compu "" TAB_VERB "%6.3" "" COMPU_TAB_REF TME_VAR_SY_Compu /end COMPU_METHOD
/begin COMPU_VTAB TME_VAR_SY_Compu "" TAB_VERB 45 1 "DAI" 3 "VWW" 4 "POR" 5 "AUD" 6 "OPE" 9 "FIA" 11 "BMW" 14 "PSA" 15 "REN" 17 "ALF" 18 "SAB" 19 "VOL" 20 "NIS" 21 "GMU" 22 "FOR" 26 "IMJ" 51 "SEA" 53 "CHR" 54 "JAG" 55 "ROL" 69 "FER" 72 "TOY" 123 "MIT" 147 "HYU" 159 "HON" 160 "MAZ" 183 "CU" 190 "LRG" 204 "VVW" 214 "AVT" 242 "Iveco" 243 "DMC" 248 "SUZ" 267 "SSANGYONG" 270 "KEF" 289 "AMG" 308 "TAT" 319 "MVM" 328 "MM" 385 "UAES" 590 "Scania" 828 "RBCD" 999 "ALL" 2887 "Nonox" 9454 "Fuso" /end COMPU_VTAB
/begin COMPU_METHOD TME_VIMMDL_SC_Compu "" TAB_VERB "%6.3" "" COMPU_TAB_REF TME_VIMMDL_SC_Compu /end COMPU_METHOD
/begin COMPU_VTAB TME_VIMMDL_SC_Compu "" TAB_VERB 3 0 "VIM_noMdl" 1 "VIM_basMdl" 2 "VIM_extMdl" /end COMPU_VTAB
/begin COMPU_METHOD TME_VIRTIA_SC_Compu "" TAB_VERB "%6.3" "" COMPU_TAB_REF TME_VIRTIA_SC_Compu /end COMPU_METHOD
/begin COMPU_VTAB TME_VIRTIA_SC_Compu "" TAB_VERB 2 0 "False" 1 "True" /end COMPU_VTAB
/begin COMPU_METHOD TME_VIRTTQ_SC_Compu "" TAB_VERB "%6.3" "" COMPU_TAB_REF TME_VIRTTQ_SC_Compu /end COMPU_METHOD
/begin COMPU_VTAB TME_VIRTTQ_SC_Compu "" TAB_VERB 2 0 "False" 1 "True" /end COMPU_VTAB
/begin COMPU_METHOD TMFWPRT_SY_Compu "" TAB_VERB "%6.3" "" COMPU_TAB_REF TMFWPRT_SY_Compu /end COMPU_METHOD
/begin COMPU_VTAB TMFWPRT_SY_Compu "" TAB_VERB 5 0 "TMFW protection is disabled" 1 "EngPrt_TMFWShutoff is activated" 2 "StSys_TrqShutOff is activated" 3 "BBZMS is activated" 4 "EngPrt_TMFWShutoff  and StSys_TrqShutoff is activa" /end COMPU_VTAB
/begin COMPU_METHOD Trq "" RAT_FUNC "%6.3" "Nm" COEFFS 0 10 0 0 0 1 /end COMPU_METHOD
/begin COMPU_METHOD t_q0p01 "" RAT_FUNC "%6.4" "s" COEFFS 0 100 0 0 0 1 /end COMPU_METHOD
/begin COMPU_METHOD t_q1 "" RAT_FUNC "%6.2" "s" COEFFS 0 1 0 0 0 1 /end COMPU_METHOD
/begin COMPU_METHOD t_q4_s "" RAT_FUNC "%6.2" "s" COEFFS 0 1 0 0 0 4 /end COMPU_METHOD
/begin COMPU_METHOD Vel "" RAT_FUNC "%6.4" "km/h" COEFFS 0 100 0 0 0 1 /end COMPU_METHOD
/begin COMPU_METHOD Volt_Batt "" RAT_FUNC "%6.1" "mV" COEFFS 0 0.05 0 0 0 1 /end COMPU_METHOD
/begin RECORD_LAYOUT Map_Xs16Ys16Ws16 NO_AXIS_PTS_X 1 SWORD NO_AXIS_PTS_Y 2 SWORD AXIS_PTS_X 3 SWORD INDEX_INCR DIRECT AXIS_PTS_Y 4 SWORD INDEX_INCR DIRECT FNC_VALUES 5 SWORD COLUMN_DIR DIRECT /end RECORD_LAYOUT
/begin RECORD_LAYOUT RB_Curve_S16_U16_Static NO_AXIS_PTS_X 1 SWORD AXIS_PTS_X 2 SWORD INDEX_INCR DIRECT FNC_VALUES 3 UWORD COLUMN_DIR DIRECT STATIC_RECORD_LAYOUT /end RECORD_LAYOUT
/begin RECORD_LAYOUT RB_Map_S16S16_S16 NO_AXIS_PTS_X 1 SWORD NO_AXIS_PTS_Y 2 SWORD AXIS_PTS_X 3 SWORD INDEX_INCR DIRECT AXIS_PTS_Y 4 SWORD INDEX_INCR DIRECT FNC_VALUES 5 SWORD COLUMN_DIR DIRECT /end RECORD_LAYOUT
/begin RECORD_LAYOUT RB_Val_Wboolean FNC_VALUES 1 UBYTE COLUMN_DIR DIRECT /end RECORD_LAYOUT
/begin RECORD_LAYOUT RB_Val_Ws16 FNC_VALUES 1 SWORD COLUMN_DIR DIRECT /end RECORD_LAYOUT
/begin RECORD_LAYOUT RB_Val_Wu16 FNC_VALUES 1 UWORD COLUMN_DIR DIRECT /end RECORD_LAYOUT
/begin RECORD_LAYOUT RB_Val_Wu32 FNC_VALUES 1 ULONG COLUMN_DIR DIRECT /end RECORD_LAYOUT
/begin RECORD_LAYOUT RB_Val_Wu8 FNC_VALUES 1 UBYTE COLUMN_DIR DIRECT /end RECORD_LAYOUT
/begin RECORD_LAYOUT Val_Ws16 FNC_VALUES 1 SWORD COLUMN_DIR DIRECT /end RECORD_LAYOUT
/begin RECORD_LAYOUT Val_Ws32 FNC_VALUES 1 SLONG COLUMN_DIR DIRECT /end RECORD_LAYOUT
/begin RECORD_LAYOUT Val_Wu16 FNC_VALUES 1 UWORD COLUMN_DIR DIRECT /end RECORD_LAYOUT
/begin RECORD_LAYOUT Val_Wu8 FNC_VALUES 1 UBYTE COLUMN_DIR DIRECT /end RECORD_LAYOUT
/end MODULE
/end PROJECT
