ASAP2_VERSION 1 60
/begin PROJECT MG1CS022 "MG1CS022"
/begin HEADER "" VERSION "MG1CS022_62XSC_V037_TPROT" PROJECT_NO MG1CS022 /end HEADER
/begin MODULE DIM ""
/begin MOD_COMMON "" BYTE_ORDER MSB_LAST ALIGNMENT_BYTE 1 ALIGNMENT_WORD 2 ALIGNMENT_LONG 4 ALIGNMENT_INT64 4 ALIGNMENT_FLOAT32_IEEE 4 ALIGNMENT_FLOAT64_IEEE 4 DATA_SIZE 32 /end MOD_COMMON
/begin CHARACTERISTIC AFDAGR "error counter fast egr adaptation" VALUE 0x8053A778 RB_Val_Wu8 255.0 dez 0.00 255.0 FORMAT "%5.1" /end CHARACTERISTIC
/begin CHARACTERISTIC AFDAGRK "error counter fast egr adaptation" VALUE 0x8053A779 RB_Val_Wu8 255.0 dez 0.00 255.0 FORMAT "%5.1" /end CHARACTERISTIC
/begin CHARACTERISTIC AGDAGR "counter fast egr adaptation" VALUE 0x8053A77A RB_Val_Wu8 255.0 dez 0.00 255.0 FORMAT "%5.1" /end CHARACTERISTIC
/begin CHARACTERISTIC AGDAGRK "counter fast egr adaptation" VALUE 0x8053A77B RB_Val_Wu8 255.0 dez 0.00 255.0 FORMAT "%5.1" /end CHARACTERISTIC
/begin CHARACTERISTIC CALIBID "Calibration ID (Programmstep making) according to SAE J1979 for Mode $09" VAL_BLK 0x80505A2C KwbUb 255.0 dez 0.00 255.0 FORMAT "%5.1" NUMBER 16 /end CHARACTERISTIC
/begin CHARACTERISTIC ComDia_nMaxServCDI_C "maximum enginespeed to clear diagnostic information" VALUE 0x8058AEA4 RB_Val_Ws16 32767.50 EngN -16384.00 16383.50 FORMAT "%8.2" /end CHARACTERISTIC
/begin CHARACTERISTIC COMDIA_TGEFN_CA "Test Group Engine Family Number" VAL_BLK 0x8053AD84 ValA_Wu8 255.0 dez 0.00 255.0 FORMAT "%5.1" NUMBER 12 /end CHARACTERISTIC
/begin AXIS_PTS CrCtl_vAccnBas_AX "Axis Points for Acceleration Base of cruise control" 0x80539970 CrCtl_vVehUpByte Axis_Xs16 255.0000 Vel_CrCtl1 12 0.00 255.0000 FORMAT "%8.4" EXTENDED_LIMITS -32768.00 32767.00 DEPOSIT ABSOLUTE /end AXIS_PTS
/begin AXIS_PTS CrCtl_vAccnBas_AXIS "Axis Points for Acceleration Base of cruise control" 0x8053998A CrCtl_vVehUpByte Axis_Xs16 255.0000 Vel_CrCtl1 6 0.00 255.0000 FORMAT "%8.4" EXTENDED_LIMITS -32768.00 32767.00 DEPOSIT ABSOLUTE /end AXIS_PTS
/begin CHARACTERISTIC CrCtl_vAccnDR7DwnSlpCoast_CUR "Accel. Data for DR7 Judgement at CC down slope during coast" CURVE 0x80539AF8 RB_Cur_Xs16Ws16 127.9961 Vel_CrCtl 0.00 127.9961 FORMAT "%8.4" EXTENDED_LIMITS -128.0000 127.9961
 /begin AXIS_DESCR STD_AXIS CrCtl_vVehUpByte Vel_CrCtl1 6 0.00 32767.00 FORMAT "%8.2" EXTENDED_LIMITS -32768.00 32767.00 DEPOSIT ABSOLUTE /end AXIS_DESCR
/end CHARACTERISTIC
/begin CHARACTERISTIC CrCtl_vAccnDR7DwnSlp_CUR "Accel. Data for DR7 Judgement at CC down slope" CURVE 0x80539B12 RB_Cur_Xs16Ws16 127.9961 Vel_CrCtl 0.00 127.9961 FORMAT "%8.4" EXTENDED_LIMITS -128.0000 127.9961
 /begin AXIS_DESCR STD_AXIS CrCtl_vVehUpByte Vel_CrCtl1 6 0.00 32767.00 FORMAT "%8.2" EXTENDED_LIMITS -32768.00 32767.00 DEPOSIT ABSOLUTE /end AXIS_DESCR
/end CHARACTERISTIC
/begin CHARACTERISTIC CrCtl_vAccnDvtDR1ACCCnclUpSlp_C "During ACC followup control,deviation in accel data for DR1 judgement of up slope" VALUE 0x80539B2C Val_Ws16 255.9961 Vel_CrCtl -128.0000 127.9961 FORMAT "%8.4" /end CHARACTERISTIC
/begin CHARACTERISTIC CrCtl_vAccnDvtDR1ACCUpSlp_C "During ACC follow-up control,deviation in accel data for DR1 judgement" VALUE 0x80539B2E Val_Ws16 255.9961 Vel_CrCtl -128.0000 127.9961 FORMAT "%8.4" /end CHARACTERISTIC
/begin CHARACTERISTIC CrCtl_vAccnDvtDR1CnclUpSlp_C "DR1 cancel judgement for CC up slope" VALUE 0x80539B30 Val_Ws16 255.9961 Vel_CrCtl -128.0000 127.9961 FORMAT "%8.4" /end CHARACTERISTIC
/begin CHARACTERISTIC CrCtl_vAccnDvtDR1UpSlp_C "Deviation in accel data for DR1 judgement at CC up slope" VALUE 0x80539B32 Val_Ws16 255.9961 Vel_CrCtl -128.0000 127.9961 FORMAT "%8.4" /end CHARACTERISTIC
/begin CHARACTERISTIC CrCtl_vAccnDvtDR2ACCCnclUpSlp_C "During ACC followup control,deviation in accel data for DR2 judgement of up slope" VALUE 0x80539B34 Val_Ws16 255.9961 Vel_CrCtl -128.0000 127.9961 FORMAT "%8.4" /end CHARACTERISTIC
/begin CHARACTERISTIC CrCtl_vAccnDvtDR2ACCUpSlp_C "During ACC follow-up control,deviation in accel data for DR2 judgement" VALUE 0x80539B36 Val_Ws16 255.9961 Vel_CrCtl -128.0000 127.9961 FORMAT "%8.4" /end CHARACTERISTIC
/begin CHARACTERISTIC CrCtl_vAccnDvtDR2CnclUpSlp_C "DR2 cancel judgement for CC up slope" VALUE 0x80539B38 Val_Ws16 255.9961 Vel_CrCtl -128.0000 127.9961 FORMAT "%8.4" /end CHARACTERISTIC
/begin CHARACTERISTIC CrCtl_vAccnDvtDR2UpSlp_C "Deviation in accel data for DR2 judgement at CC up slope" VALUE 0x80539B3A Val_Ws16 255.9961 Vel_CrCtl -128.0000 127.9961 FORMAT "%8.4" /end CHARACTERISTIC
/begin CHARACTERISTIC CrCtl_vAccnDvtDR3ACCCnclUpSlp_C "During ACC followup control,deviation in accel data for DR3 cancel judgement of up slope" VALUE 0x80539B3C Val_Ws16 255.9961 Vel_CrCtl -128.0000 127.9961 FORMAT "%8.4" /end CHARACTERISTIC
/begin CHARACTERISTIC CrCtl_vAccnDvtDR3ACCUpSlp_C "During ACC follow-up control,deviation in accel data for DR3 judgement up slope" VALUE 0x80539B3E Val_Ws16 255.9961 Vel_CrCtl -128.0000 127.9961 FORMAT "%8.4" /end CHARACTERISTIC
/begin CHARACTERISTIC CrCtl_vAccnDvtDR3CnclUpSlp_C "DR3 cancel judgement for CC up slope" VALUE 0x80539B40 Val_Ws16 255.9961 Vel_CrCtl -128.0000 127.9961 FORMAT "%8.4" /end CHARACTERISTIC
/begin CHARACTERISTIC CrCtl_vAccnDvtDR3UpSlp_C "Deviation in accel data for DR3 judgement at CC up slope" VALUE 0x80539B42 Val_Ws16 255.9961 Vel_CrCtl -128.0000 127.9961 FORMAT "%8.4" /end CHARACTERISTIC
/begin CHARACTERISTIC CrCtl_vAccnDvtDR4ACCCnclUpSlp_C "During ACC follow-up control,deviation in accel data for DR4 judgement of up slope" VALUE 0x80539B44 Val_Ws16 255.9961 Vel_CrCtl -128.0000 127.9961 FORMAT "%8.4" /end CHARACTERISTIC
/begin CHARACTERISTIC CrCtl_vAccnDvtDR4ACCUpSlp_C "During ACC follow-up control,deviation in accel data for DR4 judgement" VALUE 0x80539B46 Val_Ws16 255.9961 Vel_CrCtl -128.0000 127.9961 FORMAT "%8.4" /end CHARACTERISTIC
/begin CHARACTERISTIC CrCtl_vAccnDvtDR4CnclUpSlp_C "DR4 cancel judgement for CC up slope" VALUE 0x80539B48 Val_Ws16 255.9961 Vel_CrCtl -128.0000 127.9961 FORMAT "%8.4" /end CHARACTERISTIC
/begin CHARACTERISTIC CrCtl_vAccnDvtDR4UpSlp_C "Deviation in accel data for DR4 judgement at CC up slope" VALUE 0x80539B4A Val_Ws16 255.9961 Vel_CrCtl -128.0000 127.9961 FORMAT "%8.4" /end CHARACTERISTIC
/begin CHARACTERISTIC CrCtl_vAccnDvtDR5ACCCnclUpSlp_C "During ACC follow-up control,deviation in accel data for DR5 judgement of up slope" VALUE 0x80539B4C Val_Ws16 255.9961 Vel_CrCtl -128.0000 127.9961 FORMAT "%8.4" /end CHARACTERISTIC
/begin CHARACTERISTIC CrCtl_vAccnDvtDR5ACCUpSlp_C "During ACC follow-up control,deviation in accel data for DR5 judgement" VALUE 0x80539B4E Val_Ws16 255.9961 Vel_CrCtl -128.0000 127.9961 FORMAT "%8.4" /end CHARACTERISTIC
/begin CHARACTERISTIC CrCtl_vAccnDvtDR5CnclUpSlp_C "DR5 cancel judgement for CC up slope" VALUE 0x80539B50 Val_Ws16 255.9961 Vel_CrCtl -128.0000 127.9961 FORMAT "%8.4" /end CHARACTERISTIC
/begin CHARACTERISTIC CrCtl_vAccnDvtDR5UpSlp_C "Deviation in accel data for DR5 judgement at CC up slope" VALUE 0x80539B52 Val_Ws16 255.9961 Vel_CrCtl -128.0000 127.9961 FORMAT "%8.4" /end CHARACTERISTIC
/begin CHARACTERISTIC CrCtl_vAccnDvtDR6ACCCnclUpSlp_C "During ACC follow-up control,deviation in accel data for DR6 judgement of up slope" VALUE 0x80539B54 Val_Ws16 255.9961 Vel_CrCtl -128.0000 127.9961 FORMAT "%8.4" /end CHARACTERISTIC
/begin CHARACTERISTIC CrCtl_vAccnDvtDR6ACCUpSlp_C "During ACC follow-up control,deviation in accel data for DR6 judgement" VALUE 0x80539B56 Val_Ws16 255.9961 Vel_CrCtl -128.0000 127.9961 FORMAT "%8.4" /end CHARACTERISTIC
/begin CHARACTERISTIC CrCtl_vAccnDvtDR6CnclUpSlp_C "DR6 cancel judgement for CC up slope" VALUE 0x80539B58 Val_Ws16 255.9961 Vel_CrCtl -128.0000 127.9961 FORMAT "%8.4" /end CHARACTERISTIC
/begin CHARACTERISTIC CrCtl_vAccnDvtDR6UpSlp_C "Deviation in accel data for DR6 judgement at CC up slope" VALUE 0x80539B5A Val_Ws16 255.9961 Vel_CrCtl -128.0000 127.9961 FORMAT "%8.4" /end CHARACTERISTIC
/begin CHARACTERISTIC CrCtl_vAccnDvtDR7ACCCnclUpSlp_C "During ACC follow-up control,deviation in accel data for DR7 judgement of up slope" VALUE 0x80539B5C Val_Ws16 255.9961 Vel_CrCtl -128.0000 127.9961 FORMAT "%8.4" /end CHARACTERISTIC
/begin CHARACTERISTIC CrCtl_vAccnDvtDR7ACCUpSlp_C "During ACC follow-up control,deviation in accel data for DR7 judgement" VALUE 0x80539B5E Val_Ws16 255.9961 Vel_CrCtl -128.0000 127.9961 FORMAT "%8.4" /end CHARACTERISTIC
/begin CHARACTERISTIC CrCtl_vAccnDvtDR7CnclUpSlp_C "DR7 cancel judgement for CC up slope" VALUE 0x80539B60 Val_Ws16 255.9961 Vel_CrCtl -128.0000 127.9961 FORMAT "%8.4" /end CHARACTERISTIC
/begin CHARACTERISTIC CrCtl_vAccnDvtDR7UpSlp_C "Deviation in accel data for DR6 judgement at CC up slope" VALUE 0x80539B62 Val_Ws16 255.9961 Vel_CrCtl -128.0000 127.9961 FORMAT "%8.4" /end CHARACTERISTIC
/begin CHARACTERISTIC CrCtl_vACCRPntHysLoNTGKmh_GCUR "Curve for ACC RP hysteresis Lo(Not Top Gear)(Km/h spec)" CURVE 0x80539B64 CurG_Ws16 127.9961 Vel_CrCtl 0.00 127.9961 FORMAT "%8.4" EXTENDED_LIMITS -128.0000 127.9961
 /begin AXIS_DESCR COM_AXIS CrCtl_vVehUpBytTbl_mp Vel_CrCtl1 6 0.00 255.0000 FORMAT "%8.4" EXTENDED_LIMITS -32768.00 32767.00 AXIS_PTS_REF CrCtl_vRPntDLimHys_AXIS /end AXIS_DESCR
/end CHARACTERISTIC
/begin CHARACTERISTIC CrCtl_vACCRPntHysLoNTG_GCUR "Curve for ACC RP hysteresis Lo(Not Top Gear)" CURVE 0x80539B70 CurG_Ws16 127.9961 Vel_CrCtl 0.00 127.9961 FORMAT "%8.4" EXTENDED_LIMITS -128.0000 127.9961
 /begin AXIS_DESCR COM_AXIS CrCtl_vVehUpBytTbl_mp Vel_CrCtl1 6 0.00 255.0000 FORMAT "%8.4" EXTENDED_LIMITS -32768.00 32767.00 AXIS_PTS_REF CrCtl_vRPntDLimHys_AXIS /end AXIS_DESCR
/end CHARACTERISTIC
/begin CHARACTERISTIC CrCtl_vACCRPntHysLoTGKmh_GCUR "Curve for ACC RP hysteresis Lo(Top Gear)(Km/h spec)" CURVE 0x80539B7C CurG_Ws16 127.9961 Vel_CrCtl 0.00 127.9961 FORMAT "%8.4" EXTENDED_LIMITS -128.0000 127.9961
 /begin AXIS_DESCR COM_AXIS CrCtl_vVehUpBytTbl_mp Vel_CrCtl1 6 0.00 255.0000 FORMAT "%8.4" EXTENDED_LIMITS -32768.00 32767.00 AXIS_PTS_REF CrCtl_vRPntDLimHys_AXIS /end AXIS_DESCR
/end CHARACTERISTIC
/begin CHARACTERISTIC CrCtl_vACCRPntHysLoTG_GCUR "Curve for ACC RP hysteresis Lo(Top Gear)" CURVE 0x80539B88 CurG_Ws16 127.9961 Vel_CrCtl 0.00 127.9961 FORMAT "%8.4" EXTENDED_LIMITS -128.0000 127.9961
 /begin AXIS_DESCR COM_AXIS CrCtl_vVehUpBytTbl_mp Vel_CrCtl1 6 0.00 255.0000 FORMAT "%8.4" EXTENDED_LIMITS -32768.00 32767.00 AXIS_PTS_REF CrCtl_vRPntDLimHys_AXIS /end AXIS_DESCR
/end CHARACTERISTIC
/begin AXIS_PTS CrCtl_vAPPLim_AXIS "Axis Points for APP Limit speed of cruise control" 0x80539B94 CrCtl_vVehSpd_mp Axis_Xs16 65535.00 Vel_CrCtl1 12 -32768.00 32767.00 FORMAT "%8.2" DEPOSIT ABSOLUTE /end AXIS_PTS
/begin CHARACTERISTIC CrCtl_vCmftACCRPntHysLoNTG_GCUR "Curve for ACC RP hysteresis Lo(Not Top Gear) for Comfort mode" CURVE 0x80539BAE CurG_Ws16 127.9961 Vel_CrCtl 0.00 127.9961 FORMAT "%8.4" EXTENDED_LIMITS -128.0000 127.9961
 /begin AXIS_DESCR COM_AXIS CrCtl_vVehUpBytTbl_mp Vel_CrCtl1 6 0.00 255.0000 FORMAT "%8.4" EXTENDED_LIMITS -32768.00 32767.00 AXIS_PTS_REF CrCtl_vRPntDLimHys_AXIS /end AXIS_DESCR
/end CHARACTERISTIC
/begin CHARACTERISTIC CrCtl_vCmftACCRPntHysLoTG_GCUR "Curve for ACC RP hysteresis Lo(Top Gear) for Comfort mode" CURVE 0x80539BBA CurG_Ws16 127.9961 Vel_CrCtl 0.00 127.9961 FORMAT "%8.4" EXTENDED_LIMITS -128.0000 127.9961
 /begin AXIS_DESCR COM_AXIS CrCtl_vVehUpBytTbl_mp Vel_CrCtl1 6 0.00 255.0000 FORMAT "%8.4" EXTENDED_LIMITS -32768.00 32767.00 AXIS_PTS_REF CrCtl_vRPntDLimHys_AXIS /end AXIS_DESCR
/end CHARACTERISTIC
/begin CHARACTERISTIC CrCtl_vCmftDLimHysHiNTG_GCUR "Curve for CCACC DL hysteresis Hi(Not Top Gear) for Comfort mode" CURVE 0x80539BC6 CurG_Ws16 127.9961 Vel_CrCtl 0.00 127.9961 FORMAT "%8.4" EXTENDED_LIMITS -128.0000 127.9961
 /begin AXIS_DESCR COM_AXIS CrCtl_vVehUpBytTbl_mp Vel_CrCtl1 6 0.00 255.0000 FORMAT "%8.4" EXTENDED_LIMITS -32768.00 32767.00 AXIS_PTS_REF CrCtl_vRPntDLimHys_AXIS /end AXIS_DESCR
/end CHARACTERISTIC
/begin CHARACTERISTIC CrCtl_vCmftDLimHysHiTG_GCUR "Curve for CCACC DL hysteresis Hi(Top Gear) for Comfort mode" CURVE 0x80539BD2 CurG_Ws16 127.9961 Vel_CrCtl 0.00 127.9961 FORMAT "%8.4" EXTENDED_LIMITS -128.0000 127.9961
 /begin AXIS_DESCR COM_AXIS CrCtl_vVehUpBytTbl_mp Vel_CrCtl1 6 0.00 255.0000 FORMAT "%8.4" EXTENDED_LIMITS -32768.00 32767.00 AXIS_PTS_REF CrCtl_vRPntDLimHys_AXIS /end AXIS_DESCR
/end CHARACTERISTIC
/begin CHARACTERISTIC CrCtl_vCmftDLimHysLoNTG_GCUR "Curve for CCACC DL hysteresis Lo(Not Top Gear) for Comfort mode" CURVE 0x80539BDE CurG_Ws16 127.9961 Vel_CrCtl 0.00 127.9961 FORMAT "%8.4" EXTENDED_LIMITS -128.0000 127.9961
 /begin AXIS_DESCR COM_AXIS CrCtl_vVehUpBytTbl_mp Vel_CrCtl1 6 0.00 255.0000 FORMAT "%8.4" EXTENDED_LIMITS -32768.00 32767.00 AXIS_PTS_REF CrCtl_vRPntDLimHys_AXIS /end AXIS_DESCR
/end CHARACTERISTIC
/begin CHARACTERISTIC CrCtl_vCmftDLimHysLoTG_GCUR "Curve for CCACC DL hysteresis Lo(Top Gear) for Comfort mode" CURVE 0x80539BEA CurG_Ws16 127.9961 Vel_CrCtl 0.00 127.9961 FORMAT "%8.4" EXTENDED_LIMITS -128.0000 127.9961
 /begin AXIS_DESCR COM_AXIS CrCtl_vVehUpBytTbl_mp Vel_CrCtl1 6 0.00 255.0000 FORMAT "%8.4" EXTENDED_LIMITS -32768.00 32767.00 AXIS_PTS_REF CrCtl_vRPntDLimHys_AXIS /end AXIS_DESCR
/end CHARACTERISTIC
/begin CHARACTERISTIC CrCtl_vCmftRPntHysHiNTG_GCUR "Curve for CC RP hysteresis Hi(Not Top Gear) for Comfort mode" CURVE 0x80539BF6 CurG_Ws16 127.9961 Vel_CrCtl 0.00 127.9961 FORMAT "%8.4" EXTENDED_LIMITS -128.0000 127.9961
 /begin AXIS_DESCR COM_AXIS CrCtl_vVehUpBytTbl_mp Vel_CrCtl1 6 0.00 255.0000 FORMAT "%8.4" EXTENDED_LIMITS -32768.00 32767.00 AXIS_PTS_REF CrCtl_vRPntDLimHys_AXIS /end AXIS_DESCR
/end CHARACTERISTIC
/begin CHARACTERISTIC CrCtl_vCmftRPntHysHiTG_GCUR "Curve for CC RP hysteresis Hi(Top Gear) for Comfort mode" CURVE 0x80539C02 CurG_Ws16 127.9961 Vel_CrCtl 0.00 127.9961 FORMAT "%8.4" EXTENDED_LIMITS -128.0000 127.9961
 /begin AXIS_DESCR COM_AXIS CrCtl_vVehUpBytTbl_mp Vel_CrCtl1 6 0.00 255.0000 FORMAT "%8.4" EXTENDED_LIMITS -32768.00 32767.00 AXIS_PTS_REF CrCtl_vRPntDLimHys_AXIS /end AXIS_DESCR
/end CHARACTERISTIC
/begin CHARACTERISTIC CrCtl_vCmftRPntHysLoNTG_GCUR "Curve for CC RP hysteresis Lo(Not Top Gear) for Comfort mode" CURVE 0x80539C0E CurG_Ws16 127.9961 Vel_CrCtl 0.00 127.9961 FORMAT "%8.4" EXTENDED_LIMITS -128.0000 127.9961
 /begin AXIS_DESCR COM_AXIS CrCtl_vVehUpBytTbl_mp Vel_CrCtl1 6 0.00 255.0000 FORMAT "%8.4" EXTENDED_LIMITS -32768.00 32767.00 AXIS_PTS_REF CrCtl_vRPntDLimHys_AXIS /end AXIS_DESCR
/end CHARACTERISTIC
/begin CHARACTERISTIC CrCtl_vCmftRPntHysLoTG_GCUR "Curve for CC RP hysteresis Lo(Top Gear) for Comfort mode" CURVE 0x80539C1A CurG_Ws16 127.9961 Vel_CrCtl 0.00 127.9961 FORMAT "%8.4" EXTENDED_LIMITS -128.0000 127.9961
 /begin AXIS_DESCR COM_AXIS CrCtl_vVehUpBytTbl_mp Vel_CrCtl1 6 0.00 255.0000 FORMAT "%8.4" EXTENDED_LIMITS -32768.00 32767.00 AXIS_PTS_REF CrCtl_vRPntDLimHys_AXIS /end AXIS_DESCR
/end CHARACTERISTIC
/begin CHARACTERISTIC CrCtl_vContTUDvtECOff_CUR "Deviation speed for selecting variation of desired vehicle speed for ECON (Continuous TAPUP, Disable hysteresis, ECON sw ON)" CURVE 0x80539C26 RB_Cur_Xs16Ws16 127.9961 Vel_CrCtl 0.00 127.9961 FORMAT "%8.4" EXTENDED_LIMITS -128.0000 127.9961
 /begin AXIS_DESCR STD_AXIS CrCtl_vVehUpByte Vel_CrCtl1 12 0.00 255.0000 FORMAT "%8.4" EXTENDED_LIMITS -32768.00 32767.00 DEPOSIT ABSOLUTE /end AXIS_DESCR
/end CHARACTERISTIC
/begin CHARACTERISTIC CrCtl_vContTUDvtECOn_CUR "Offset value of 2nd desired vehicle speed (ECON sw OFF)" CURVE 0x80539C58 RB_Cur_Xs16Ws16 127.9961 Vel_CrCtl 0.00 127.9961 FORMAT "%8.4" EXTENDED_LIMITS -128.0000 127.9961
 /begin AXIS_DESCR STD_AXIS CrCtl_vVehUpByte Vel_CrCtl1 12 0.00 255.0000 FORMAT "%8.4" EXTENDED_LIMITS -32768.00 32767.00 DEPOSIT ABSOLUTE /end AXIS_DESCR
/end CHARACTERISTIC
/begin CHARACTERISTIC CrCtl_vContTUDvtHysECOff_CUR "Deviation speed for selecting variation of desired vehicle speed for ECON (Continuous TAPUP, Enable hysteresis, ECON sw ON)" CURVE 0x80539C8A RB_Cur_Xs16Ws16 127.9961 Vel_CrCtl 0.00 127.9961 FORMAT "%8.4" EXTENDED_LIMITS -128.0000 127.9961
 /begin AXIS_DESCR STD_AXIS CrCtl_vVehUpByte Vel_CrCtl1 12 0.00 255.0000 FORMAT "%8.4" EXTENDED_LIMITS -32768.00 32767.00 DEPOSIT ABSOLUTE /end AXIS_DESCR
/end CHARACTERISTIC
/begin CHARACTERISTIC CrCtl_vContTUDvtHysECOn_CUR "Deviation speed for selecting variation of desired vehicle speed for ECON (Continuous TAPUP, Disable hysteresis, ECON sw OFF)" CURVE 0x80539CBC RB_Cur_Xs16Ws16 127.9961 Vel_CrCtl 0.00 127.9961 FORMAT "%8.4" EXTENDED_LIMITS -128.0000 127.9961
 /begin AXIS_DESCR STD_AXIS CrCtl_vVehUpByte Vel_CrCtl1 12 0.00 255.0000 FORMAT "%8.4" EXTENDED_LIMITS -32768.00 32767.00 DEPOSIT ABSOLUTE /end AXIS_DESCR
/end CHARACTERISTIC
/begin CHARACTERISTIC CrCtl_vContTUECOffDesInc1_MAP "Added value2 in each 100ms to desired vehicle speed for ECON (ECON sw OFF, Continuous TAPUP)" MAP 0x80539CEE Map_Xs16Ys16Ws16 127.9961 Vel_CrCtl 0.00 127.9961 FORMAT "%8.4" EXTENDED_LIMITS -128.0000 127.9961
 /begin AXIS_DESCR STD_AXIS CrCtl_vVehUpByte Vel_CrCtl1 12 0.00 255.0000 FORMAT "%8.4" EXTENDED_LIMITS -32768.00 32767.00 DEPOSIT ABSOLUTE /end AXIS_DESCR
 /begin AXIS_DESCR STD_AXIS CrCtl_rEstSlpFltVal Prc_CrCtl4 9 -128.0000 127.9961 FORMAT "%8.4" DEPOSIT ABSOLUTE /end AXIS_DESCR
/end CHARACTERISTIC
/begin CHARACTERISTIC CrCtl_vContTUECOffDesInc2_CUR "Added value1 in each 100ms to desired vehicle speed for ECON (ECON sw ON, Continuous TAPUP)" CURVE 0x80539DF4 RB_Cur_Xs16Ws16 127.9961 Vel_CrCtl 0.00 127.9961 FORMAT "%8.4" EXTENDED_LIMITS -128.0000 127.9961
 /begin AXIS_DESCR STD_AXIS CrCtl_vSpdDvt_mp Vel_CrCtl 9 -128.0000 127.9961 FORMAT "%8.4" DEPOSIT ABSOLUTE /end AXIS_DESCR
/end CHARACTERISTIC
/begin CHARACTERISTIC CrCtl_vContTUECOnDesInc1_MAP "Added value2 in each 100ms to desired vehicle speed for ECON (ECON sw ON, Continuous TAPUP)" MAP 0x80539E1A Map_Xs16Ys16Ws16 127.9961 Vel_CrCtl 0.00 127.9961 FORMAT "%8.4" EXTENDED_LIMITS -128.0000 127.9961
 /begin AXIS_DESCR STD_AXIS CrCtl_vVehUpByte Vel_CrCtl1 12 0.00 255.0000 FORMAT "%8.4" EXTENDED_LIMITS -32768.00 32767.00 DEPOSIT ABSOLUTE /end AXIS_DESCR
 /begin AXIS_DESCR STD_AXIS CrCtl_rEstSlpFltVal Prc_CrCtl4 9 -128.0000 127.9961 FORMAT "%8.4" DEPOSIT ABSOLUTE /end AXIS_DESCR
/end CHARACTERISTIC
/begin CHARACTERISTIC CrCtl_vContTUECOnDesInc2_CUR "Selected easily condition to change desired vehicle speed for ECON" CURVE 0x80539F20 RB_Cur_Xs16Ws16 127.9961 Vel_CrCtl 0.00 127.9961 FORMAT "%8.4" EXTENDED_LIMITS -128.0000 127.9961
 /begin AXIS_DESCR STD_AXIS CrCtl_vSpdDvt_mp Vel_CrCtl 9 -128.0000 127.9961 FORMAT "%8.4" DEPOSIT ABSOLUTE /end AXIS_DESCR
/end CHARACTERISTIC
/begin CHARACTERISTIC CrCtl_vDes2OffsECOff_MAP "Offset value of 2nd desired vehicle speed (ECON sw ON)" MAP 0x80539F46 Map_Xs16Ys16Ws16 255.9961 Vel_CrCtl -128.0000 127.9961 FORMAT "%8.4"
 /begin AXIS_DESCR STD_AXIS CrCtl_vVehUpByte Vel_CrCtl1 12 0.00 255.0000 FORMAT "%8.4" EXTENDED_LIMITS -32768.00 32767.00 DEPOSIT ABSOLUTE /end AXIS_DESCR
 /begin AXIS_DESCR STD_AXIS CrCtl_rEstSlpFltVal Prc_CrCtl4 9 -128.0000 127.9961 FORMAT "%8.4" DEPOSIT ABSOLUTE /end AXIS_DESCR
/end CHARACTERISTIC
/begin CHARACTERISTIC CrCtl_vDes2OffsECOn_MAP "Added value1 in each 100ms to desired vehicle speed for ECON (ECON sw OFF)" MAP 0x8053A04C Map_Xs16Ys16Ws16 255.9961 Vel_CrCtl -128.0000 127.9961 FORMAT "%8.4"
 /begin AXIS_DESCR STD_AXIS CrCtl_vVehUpByte Vel_CrCtl1 12 0.00 255.0000 FORMAT "%8.4" EXTENDED_LIMITS -32768.00 32767.00 DEPOSIT ABSOLUTE /end AXIS_DESCR
 /begin AXIS_DESCR STD_AXIS CrCtl_rEstSlpFltVal Prc_CrCtl4 9 -128.0000 127.9961 FORMAT "%8.4" DEPOSIT ABSOLUTE /end AXIS_DESCR
/end CHARACTERISTIC
/begin CHARACTERISTIC CrCtl_vDesClthOnStrtAdd_C "setpoint speed add value for Cruise Control Clutch On Start" VALUE 0x8053A154 Val_Ws32 8388607.99609 Vel_CrCtl 0.00 8388607.99609 FORMAT "%13.5" EXTENDED_LIMITS -8388608.00000 8388607.99609 /end CHARACTERISTIC
/begin CHARACTERISTIC CrCtl_vDLimHysHiNTGKmh_GCUR "Curve for CC/ACC DL hysteresis Hi(Not Top Gear)(Km/h spec)" CURVE 0x8053A158 CurG_Ws16 127.9961 Vel_CrCtl 0.00 127.9961 FORMAT "%8.4" EXTENDED_LIMITS -128.0000 127.9961
 /begin AXIS_DESCR COM_AXIS CrCtl_vVehUpBytTbl_mp Vel_CrCtl1 6 0.00 255.0000 FORMAT "%8.4" EXTENDED_LIMITS -32768.00 32767.00 AXIS_PTS_REF CrCtl_vRPntDLimHys_AXIS /end AXIS_DESCR
/end CHARACTERISTIC
/begin CHARACTERISTIC CrCtl_vDLimHysHiNTG_GCUR "Curve for CC/ACC DL hysteresis Hi(Not Top Gear)" CURVE 0x8053A164 CurG_Ws16 127.9961 Vel_CrCtl 0.00 127.9961 FORMAT "%8.4" EXTENDED_LIMITS -128.0000 127.9961
 /begin AXIS_DESCR COM_AXIS CrCtl_vVehUpBytTbl_mp Vel_CrCtl1 6 0.00 255.0000 FORMAT "%8.4" EXTENDED_LIMITS -32768.00 32767.00 AXIS_PTS_REF CrCtl_vRPntDLimHys_AXIS /end AXIS_DESCR
/end CHARACTERISTIC
/begin CHARACTERISTIC CrCtl_vDLimHysHiTGKmh_GCUR "Curve for CC/ACC DL hysteresis Hi(Top Gear)(Km/h spec)" CURVE 0x8053A170 CurG_Ws16 127.9961 Vel_CrCtl 0.00 127.9961 FORMAT "%8.4" EXTENDED_LIMITS -128.0000 127.9961
 /begin AXIS_DESCR COM_AXIS CrCtl_vVehUpBytTbl_mp Vel_CrCtl1 6 0.00 255.0000 FORMAT "%8.4" EXTENDED_LIMITS -32768.00 32767.00 AXIS_PTS_REF CrCtl_vRPntDLimHys_AXIS /end AXIS_DESCR
/end CHARACTERISTIC
/begin CHARACTERISTIC CrCtl_vDLimHysHiTG_GCUR "Curve for CC/ACC DL hysteresis Hi(Top Gear)(Km/h spec)" CURVE 0x8053A17C CurG_Ws16 127.9961 Vel_CrCtl 0.00 127.9961 FORMAT "%8.4" EXTENDED_LIMITS -128.0000 127.9961
 /begin AXIS_DESCR COM_AXIS CrCtl_vVehUpBytTbl_mp Vel_CrCtl1 6 0.00 255.0000 FORMAT "%8.4" EXTENDED_LIMITS -32768.00 32767.00 AXIS_PTS_REF CrCtl_vRPntDLimHys_AXIS /end AXIS_DESCR
/end CHARACTERISTIC
/begin CHARACTERISTIC CrCtl_vDLimHysLoNTGKmh_GCUR "Curve for CC/ACC DL hysteresis Lo(Not Top Gear)(Km/h spec)" CURVE 0x8053A188 CurG_Ws16 127.9961 Vel_CrCtl 0.00 127.9961 FORMAT "%8.4" EXTENDED_LIMITS -128.0000 127.9961
 /begin AXIS_DESCR COM_AXIS CrCtl_vVehUpBytTbl_mp Vel_CrCtl1 6 0.00 255.0000 FORMAT "%8.4" EXTENDED_LIMITS -32768.00 32767.00 AXIS_PTS_REF CrCtl_vRPntDLimHys_AXIS /end AXIS_DESCR
/end CHARACTERISTIC
/begin CHARACTERISTIC CrCtl_vDLimHysLoNTG_GCUR "Curve for CC/ACC DL hysteresis Lo(Not Top Gear)" CURVE 0x8053A194 CurG_Ws16 127.9961 Vel_CrCtl 0.00 127.9961 FORMAT "%8.4" EXTENDED_LIMITS -128.0000 127.9961
 /begin AXIS_DESCR COM_AXIS CrCtl_vVehUpBytTbl_mp Vel_CrCtl1 6 0.00 255.0000 FORMAT "%8.4" EXTENDED_LIMITS -32768.00 32767.00 AXIS_PTS_REF CrCtl_vRPntDLimHys_AXIS /end AXIS_DESCR
/end CHARACTERISTIC
/begin CHARACTERISTIC CrCtl_vDLimHysLoTGKmh_GCUR "Curve for CC/ACC DL hysteresis Lo(Top Gear)(Km/h spec)" CURVE 0x8053A1A0 CurG_Ws16 127.9961 Vel_CrCtl 0.00 127.9961 FORMAT "%8.4" EXTENDED_LIMITS -128.0000 127.9961
 /begin AXIS_DESCR COM_AXIS CrCtl_vVehUpBytTbl_mp Vel_CrCtl1 6 0.00 255.0000 FORMAT "%8.4" EXTENDED_LIMITS -32768.00 32767.00 AXIS_PTS_REF CrCtl_vRPntDLimHys_AXIS /end AXIS_DESCR
/end CHARACTERISTIC
/begin CHARACTERISTIC CrCtl_vDLimHysLoTG_GCUR "Curve for CC/ACC DL hysteresis Lo(Top Gear)" CURVE 0x8053A1AC CurG_Ws16 127.9961 Vel_CrCtl 0.00 127.9961 FORMAT "%8.4" EXTENDED_LIMITS -128.0000 127.9961
 /begin AXIS_DESCR COM_AXIS CrCtl_vVehUpBytTbl_mp Vel_CrCtl1 6 0.00 255.0000 FORMAT "%8.4" EXTENDED_LIMITS -32768.00 32767.00 AXIS_PTS_REF CrCtl_vRPntDLimHys_AXIS /end AXIS_DESCR
/end CHARACTERISTIC
/begin CHARACTERISTIC CrCtl_vDR1DvtDwnSlp_C "Data on speed deviation for DR1 judgement at CC down slp" VALUE 0x8053A1B8 Val_Ws16 255.9961 Vel_CrCtl -128.0000 127.9961 FORMAT "%8.4" /end CHARACTERISTIC
/begin CHARACTERISTIC CrCtl_vDR1HiHysUpLimACCDnSlp_C "Lo hysterisis for DR1 upper speed limit at ACC down slope" VALUE 0x8053A1BC Val_Ws32 16777215.9961 Vel_CrCtl -8388608.00000 8388607.99609 FORMAT "%13.5" /end CHARACTERISTIC
/begin CHARACTERISTIC CrCtl_vDR1HiHysUpLimUpSlp_C "Hi Hys for D1 upper speed limit of CC at up slope" VALUE 0x8053A1C0 Val_Ws32 16777215.9961 Vel_CrCtl -8388608.00000 8388607.99609 FORMAT "%13.5" /end CHARACTERISTIC
/begin CHARACTERISTIC CrCtl_vDR1LoHysUpLimACCDnSlp_C "Lo Hysteresis of DR1 upper limit of vehicle speed for ACC down slope" VALUE 0x8053A1C4 Val_Ws32 16777215.9961 Vel_CrCtl -8388608.00000 8388607.99609 FORMAT "%13.5" /end CHARACTERISTIC
/begin CHARACTERISTIC CrCtl_vDR1LoHysUpLimUpSlp_C "Lo Hysteresis for DR1 upper speed limit at CC up slope" VALUE 0x8053A1C8 Val_Ws32 16777215.9961 Vel_CrCtl -8388608.00000 8388607.99609 FORMAT "%13.5" /end CHARACTERISTIC
/begin CHARACTERISTIC CrCtl_vDR2DvtDwnSlp_C "Data on speed deviation for DR2 judgement at CC down slp" VALUE 0x8053A1CC Val_Ws16 255.9961 Vel_CrCtl -128.0000 127.9961 FORMAT "%8.4" /end CHARACTERISTIC
/begin CHARACTERISTIC CrCtl_vDR2HiHysUpLimACCDnSlp_C "Hi Hysterisis for DR2 upper speed limit at ACC down slope" VALUE 0x8053A1D0 Val_Ws32 16777215.9961 Vel_CrCtl -8388608.00000 8388607.99609 FORMAT "%13.5" /end CHARACTERISTIC
/begin CHARACTERISTIC CrCtl_vDR2HiHysUpLimDnSlp_C "Hi Hysteresis of DR2 upper limit of vehicle speed for CC down slope" VALUE 0x8053A1D4 Val_Ws32 16777215.9961 Vel_CrCtl -8388608.00000 8388607.99609 FORMAT "%13.5" /end CHARACTERISTIC
/begin CHARACTERISTIC CrCtl_vDR2HiHysUpLimUpSlp_C "Hi Hys for D2 upper speed limit of CC at up slope" VALUE 0x8053A1D8 Val_Ws32 16777215.9961 Vel_CrCtl -8388608.00000 8388607.99609 FORMAT "%13.5" /end CHARACTERISTIC
/begin CHARACTERISTIC CrCtl_vDR2LoHysUpLimACCDnSlp_C "Lo Hysteresis of DR2 upper limit of vehicle speed for ACC down slope" VALUE 0x8053A1DC Val_Ws32 16777215.9961 Vel_CrCtl -8388608.00000 8388607.99609 FORMAT "%13.5" /end CHARACTERISTIC
/begin CHARACTERISTIC CrCtl_vDR2LoHysUpLimDnSlp_C "Lo Hysteresis for DR2 upper speed limit at CC down slope" VALUE 0x8053A1E0 Val_Ws32 16777215.9961 Vel_CrCtl -8388608.00000 8388607.99609 FORMAT "%13.5" /end CHARACTERISTIC
/begin CHARACTERISTIC CrCtl_vDR2LoHysUpLimUpSlp_C "Lo Hysteresis for DR2 upper speed limit at CC up slope" VALUE 0x8053A1E4 Val_Ws32 16777215.9961 Vel_CrCtl -8388608.00000 8388607.99609 FORMAT "%13.5" /end CHARACTERISTIC
/begin CHARACTERISTIC CrCtl_vDR3DvtDwnSlp_C "Data on speed deviation for DR3 judgement at CC down slp" VALUE 0x8053A1E8 Val_Ws16 255.9961 Vel_CrCtl -128.0000 127.9961 FORMAT "%8.4" /end CHARACTERISTIC
/begin CHARACTERISTIC CrCtl_vDR3HiHysUpLimACCDnSlp_C "Hi Hysterisis for DR3 upper speed limit at ACC down slope" VALUE 0x8053A1EC Val_Ws32 16777215.9961 Vel_CrCtl -8388608.00000 8388607.99609 FORMAT "%13.5" /end CHARACTERISTIC
/begin CHARACTERISTIC CrCtl_vDR3HiHysUpLimDnSlp_C "Hi Hysteresis of DR3 upper limit of vehicle speed for CC down slope" VALUE 0x8053A1F0 Val_Ws32 16777215.9961 Vel_CrCtl -8388608.00000 8388607.99609 FORMAT "%13.5" /end CHARACTERISTIC
/begin CHARACTERISTIC CrCtl_vDR3HiHysUpLimUpSlp_C "Hi Hys for D3 upper speed limit of CC at up slope" VALUE 0x8053A1F4 Val_Ws32 16777215.9961 Vel_CrCtl -8388608.00000 8388607.99609 FORMAT "%13.5" /end CHARACTERISTIC
/begin CHARACTERISTIC CrCtl_vDR3LoHysUpLimACCDnSlp_C "Lo Hysteresis of DR3 upper limit of vehicle speed for ACC down slope" VALUE 0x8053A1F8 Val_Ws32 16777215.9961 Vel_CrCtl -8388608.00000 8388607.99609 FORMAT "%13.5" /end CHARACTERISTIC
/begin CHARACTERISTIC CrCtl_vDR3LoHysUpLimDnSlp_C "Lo Hysteresis for DR3 upper speed limit at CC down slope" VALUE 0x8053A1FC Val_Ws32 16777215.9961 Vel_CrCtl -8388608.00000 8388607.99609 FORMAT "%13.5" /end CHARACTERISTIC
/begin CHARACTERISTIC CrCtl_vDR3LoHysUpLimUpSlp_C "Lo Hysteresis for DR3 upper speed limit at CC up slope" VALUE 0x8053A200 Val_Ws32 16777215.9961 Vel_CrCtl -8388608.00000 8388607.99609 FORMAT "%13.5" /end CHARACTERISTIC
/begin CHARACTERISTIC CrCtl_vDR4DvtDwnSlp_C "Data on speed deviation for DR4 judgement at CC down slope" VALUE 0x8053A204 Val_Ws16 255.9961 Vel_CrCtl -128.0000 127.9961 FORMAT "%8.4" /end CHARACTERISTIC
/begin CHARACTERISTIC CrCtl_vDR4HiHysUpLimACCDnSlp_C "Lo hysterisis for DR4 upper speed limit at ACC down slope" VALUE 0x8053A208 Val_Ws32 16777215.9961 Vel_CrCtl -8388608.00000 8388607.99609 FORMAT "%13.5" /end CHARACTERISTIC
/begin CHARACTERISTIC CrCtl_vDR4HiHysUpLimDnSlp_C "Hi Hysteresis of DR4 upper limit of vehicle speed for CC down slope" VALUE 0x8053A20C Val_Ws32 16777215.9961 Vel_CrCtl -8388608.00000 8388607.99609 FORMAT "%13.5" /end CHARACTERISTIC
/begin CHARACTERISTIC CrCtl_vDR4HiHysUpLimUpSlp_C "Hi Hys for D4 upper speed limit of CC at up slope" VALUE 0x8053A210 Val_Ws32 16777215.9961 Vel_CrCtl -8388608.00000 8388607.99609 FORMAT "%13.5" /end CHARACTERISTIC
/begin CHARACTERISTIC CrCtl_vDR4LoHysUpLimACCDnSlp_C "Lo Hysteresis of DR4 upper limit of vehicle speed for ACC down slope" VALUE 0x8053A214 Val_Ws32 16777215.9961 Vel_CrCtl -8388608.00000 8388607.99609 FORMAT "%13.5" /end CHARACTERISTIC
/begin CHARACTERISTIC CrCtl_vDR4LoHysUpLimDnSlp_C "Lo Hysteresis for DR4 upper speed limit at CC down slope" VALUE 0x8053A218 Val_Ws32 16777215.9961 Vel_CrCtl -8388608.00000 8388607.99609 FORMAT "%13.5" /end CHARACTERISTIC
/begin CHARACTERISTIC CrCtl_vDR4LoHysUpLimUpSlp_C "Lo Hysteresis for DR4 upper speed limit at CC up slope" VALUE 0x8053A21C Val_Ws32 16777215.9961 Vel_CrCtl -8388608.00000 8388607.99609 FORMAT "%13.5" /end CHARACTERISTIC
/begin CHARACTERISTIC CrCtl_vDR5DvtDwnSlp_C "Data on speed deviation for DR5 judgement at CC down slope" VALUE 0x8053A220 Val_Ws16 255.9961 Vel_CrCtl -128.0000 127.9961 FORMAT "%8.4" /end CHARACTERISTIC
/begin CHARACTERISTIC CrCtl_vDR5HiHysUpLimACCDnSlp_C "Hi hysterisis for DR5 upper speed limit at ACC down slope" VALUE 0x8053A224 Val_Ws32 16777215.9961 Vel_CrCtl -8388608.00000 8388607.99609 FORMAT "%13.5" /end CHARACTERISTIC
/begin CHARACTERISTIC CrCtl_vDR5HiHysUpLimDnSlp_C "Hi Hysteresis of DR5 upper limit of vehicle speed for CC down slope" VALUE 0x8053A228 Val_Ws32 16777215.9961 Vel_CrCtl -8388608.00000 8388607.99609 FORMAT "%13.5" /end CHARACTERISTIC
/begin CHARACTERISTIC CrCtl_vDR5HiHysUpLimUpSlp_C "Hi Hys for DR5 upper speed limit of CC at up slope" VALUE 0x8053A22C Val_Ws32 16777215.9961 Vel_CrCtl -8388608.00000 8388607.99609 FORMAT "%13.5" /end CHARACTERISTIC
/begin CHARACTERISTIC CrCtl_vDR5LoHysUpLimACCDnSlp_C "Lo Hysteresis of DR5 upper limit of vehicle speed for ACC down slope" VALUE 0x8053A230 Val_Ws32 16777215.9961 Vel_CrCtl -8388608.00000 8388607.99609 FORMAT "%13.5" /end CHARACTERISTIC
/begin CHARACTERISTIC CrCtl_vDR5LoHysUpLimDnSlp_C "Lo Hysteresis for DR5 upper speed limit at CC down slope" VALUE 0x8053A234 Val_Ws32 16777215.9961 Vel_CrCtl -8388608.00000 8388607.99609 FORMAT "%13.5" /end CHARACTERISTIC
/begin CHARACTERISTIC CrCtl_vDR5LoHysUpLimUpSlp_C "Lo Hysteresis for DR5 upper speed limit at CC up slope" VALUE 0x8053A238 Val_Ws32 16777215.9961 Vel_CrCtl -8388608.00000 8388607.99609 FORMAT "%13.5" /end CHARACTERISTIC
/begin CHARACTERISTIC CrCtl_vDR6DvtDwnSlp_C "Data on speed deviation for DR6 judgement at CC down slope" VALUE 0x8053A23C Val_Ws16 255.9961 Vel_CrCtl -128.0000 127.9961 FORMAT "%8.4" /end CHARACTERISTIC
/begin CHARACTERISTIC CrCtl_vDR6HiHysUpLimACCDnSlp_C "Lo hysterisis for DR6 upper speed limit at ACC down slope" VALUE 0x8053A240 Val_Ws32 16777215.9961 Vel_CrCtl -8388608.00000 8388607.99609 FORMAT "%13.5" /end CHARACTERISTIC
/begin CHARACTERISTIC CrCtl_vDR6HiHysUpLimDnSlp_C "Hi Hysteresis of DR6 upper limit of vehicle speed for CC down slope" VALUE 0x8053A244 Val_Ws32 16777215.9961 Vel_CrCtl -8388608.00000 8388607.99609 FORMAT "%13.5" /end CHARACTERISTIC
/begin CHARACTERISTIC CrCtl_vDR6HiHysUpLimUpSlp_C "Hi Hys for DR6 upper speed limit of CC at up slope" VALUE 0x8053A248 Val_Ws32 16777215.9961 Vel_CrCtl -8388608.00000 8388607.99609 FORMAT "%13.5" /end CHARACTERISTIC
/begin CHARACTERISTIC CrCtl_vDR6LoHysUpLimACCDnSlp_C "Lo Hysteresis of DR6 upper limit of vehicle speed for ACC down slope" VALUE 0x8053A24C Val_Ws32 16777215.9961 Vel_CrCtl -8388608.00000 8388607.99609 FORMAT "%13.5" /end CHARACTERISTIC
/begin CHARACTERISTIC CrCtl_vDR6LoHysUpLimDnSlp_C "Lo Hysteresis for DR6 upper speed limit at CC down slope" VALUE 0x8053A250 Val_Ws32 16777215.9961 Vel_CrCtl -8388608.00000 8388607.99609 FORMAT "%13.5" /end CHARACTERISTIC
/begin CHARACTERISTIC CrCtl_vDR6LoHysUpLimUpSlp_C "Lo Hysteresis for DR6 upper speed limit at CC up slope" VALUE 0x8053A254 Val_Ws32 16777215.9961 Vel_CrCtl -8388608.00000 8388607.99609 FORMAT "%13.5" /end CHARACTERISTIC
/begin CHARACTERISTIC CrCtl_vDR7DvtDwnSlp_C "Data on speed deviation for DR7 judgement at CC down slope" VALUE 0x8053A258 Val_Ws16 255.9961 Vel_CrCtl -128.0000 127.9961 FORMAT "%8.4" /end CHARACTERISTIC
/begin CHARACTERISTIC CrCtl_vDR7HiHysUpLimACCDnSlp_C "Lo hysterisis for DR7 upper speed limit at ACC down slope" VALUE 0x8053A25C Val_Ws32 16777215.9961 Vel_CrCtl -8388608.00000 8388607.99609 FORMAT "%13.5" /end CHARACTERISTIC
/begin CHARACTERISTIC CrCtl_vDR7HiHysUpLimDnSlp_C "Hi Hysteresis of DR7 upper limit of vehicle speed for CC down slope" VALUE 0x8053A260 Val_Ws32 16777215.9961 Vel_CrCtl -8388608.00000 8388607.99609 FORMAT "%13.5" /end CHARACTERISTIC
/begin CHARACTERISTIC CrCtl_vDR7HiHysUpLimUpSlp_C "Hi Hys for DR7 upper speed limit of CC at up slope" VALUE 0x8053A264 Val_Ws32 16777215.9961 Vel_CrCtl -8388608.00000 8388607.99609 FORMAT "%13.5" /end CHARACTERISTIC
/begin CHARACTERISTIC CrCtl_vDR7LoHysUpLimACCDnSlp_C "Lo Hysteresis of DR7 upper limit of vehicle speed for ACC down slope" VALUE 0x8053A268 Val_Ws32 16777215.9961 Vel_CrCtl -8388608.00000 8388607.99609 FORMAT "%13.5" /end CHARACTERISTIC
/begin CHARACTERISTIC CrCtl_vDR7LoHysUpLimDnSlp_C "Lo Hysteresis for DR7 upper speed limit at CC down slope" VALUE 0x8053A26C Val_Ws32 16777215.9961 Vel_CrCtl -8388608.00000 8388607.99609 FORMAT "%13.5" /end CHARACTERISTIC
/begin CHARACTERISTIC CrCtl_vDR7LoHysUpLimUpSlp_C "Lo Hysteresis for DR7 upper speed limit at CC up slope" VALUE 0x8053A270 Val_Ws32 16777215.9961 Vel_CrCtl -8388608.00000 8388607.99609 FORMAT "%13.5" /end CHARACTERISTIC
/begin CHARACTERISTIC CrCtl_vECAccCtlTarAStd_GCUR "Correct value of initial request APP for ECON" CURVE 0x8053A274 CurG_Ws16 255.9961 Vel_CrCtl -128.0000 127.9961 FORMAT "%8.4"
 /begin AXIS_DESCR COM_AXIS CrCtl_vVehUpByte Vel_CrCtl1 6 0.00 255.0000 FORMAT "%8.4" EXTENDED_LIMITS -32768.00 32767.00 AXIS_PTS_REF CrCtl_vAccnBas_AXIS /end AXIS_DESCR
/end CHARACTERISTIC
/begin CHARACTERISTIC CrCtl_vECDR1DvtDwnSlp_C "Data on speed deviation for DR1 judgement at CC down slp for ECON" VALUE 0x8053A280 Val_Ws16 10.00000 Vel_CrCtl 0.00 10.00000 FORMAT "%8.5" EXTENDED_LIMITS -128.0000 127.9961 /end CHARACTERISTIC
/begin CHARACTERISTIC CrCtl_vECDR2DvtDwnSlp_C "Data on speed deviation for DR2 judgement at CC down slp for ECON" VALUE 0x8053A282 Val_Ws16 10.00000 Vel_CrCtl 0.00 10.00000 FORMAT "%8.5" EXTENDED_LIMITS -128.0000 127.9961 /end CHARACTERISTIC
/begin CHARACTERISTIC CrCtl_vECDR3DvtDwnSlp_C "Data on speed deviation for DR3 judgement at CC down slp for ECON" VALUE 0x8053A284 Val_Ws16 10.00000 Vel_CrCtl 0.00 10.00000 FORMAT "%8.5" EXTENDED_LIMITS -128.0000 127.9961 /end CHARACTERISTIC
/begin CHARACTERISTIC CrCtl_vECDR4DvtDwnSlp_C "Data on speed deviation for DR4 judgement at CC down slp for ECON" VALUE 0x8053A286 Val_Ws16 10.00000 Vel_CrCtl 0.00 10.00000 FORMAT "%8.5" EXTENDED_LIMITS -128.0000 127.9961 /end CHARACTERISTIC
/begin CHARACTERISTIC CrCtl_vECDR5DvtDwnSlp_C "Data on speed deviation for DR5 judgement at CC down slp for ECON" VALUE 0x8053A288 Val_Ws16 10.00000 Vel_CrCtl 0.00 10.00000 FORMAT "%8.5" EXTENDED_LIMITS -128.0000 127.9961 /end CHARACTERISTIC
/begin CHARACTERISTIC CrCtl_vECDR6DvtDwnSlp_C "Data on speed deviation for DR6 judgement at CC down slp for ECON" VALUE 0x8053A28A Val_Ws16 10.00000 Vel_CrCtl 0.00 10.00000 FORMAT "%8.5" EXTENDED_LIMITS -128.0000 127.9961 /end CHARACTERISTIC
/begin CHARACTERISTIC CrCtl_vECDR7DvtDwnSlp_C "Data on speed deviation for DR7 judgement at CC down slp for ECON" VALUE 0x8053A28C Val_Ws16 10.00000 Vel_CrCtl 0.00 10.00000 FORMAT "%8.5" EXTENDED_LIMITS -128.0000 127.9961 /end CHARACTERISTIC
/begin CHARACTERISTIC CrCtl_vECDvtDR1UpSlp_C "Deviation in accel data for DR1 judgement at CC up slope for ECON" VALUE 0x8053A28E Val_Ws16 127.9961 Vel_CrCtl 0.00 127.9961 FORMAT "%8.4" EXTENDED_LIMITS -128.0000 127.9961 /end CHARACTERISTIC
/begin CHARACTERISTIC CrCtl_vECDvtDR2UpSlp_C "Deviation in accel data for DR2 judgement at CC up slope for ECON" VALUE 0x8053A290 Val_Ws16 127.9961 Vel_CrCtl 0.00 127.9961 FORMAT "%8.4" EXTENDED_LIMITS -128.0000 127.9961 /end CHARACTERISTIC
/begin CHARACTERISTIC CrCtl_vECDvtDR3UpSlp_C "Deviation in accel data for DR3 judgement at CC up slope for ECON" VALUE 0x8053A292 Val_Ws16 127.9961 Vel_CrCtl 0.00 127.9961 FORMAT "%8.4" EXTENDED_LIMITS -128.0000 127.9961 /end CHARACTERISTIC
/begin CHARACTERISTIC CrCtl_vECDvtDR4UpSlp_C "Deviation in accel data for DR4 judgement at CC up slope for ECON" VALUE 0x8053A294 Val_Ws16 127.9961 Vel_CrCtl 0.00 127.9961 FORMAT "%8.4" EXTENDED_LIMITS -128.0000 127.9961 /end CHARACTERISTIC
/begin CHARACTERISTIC CrCtl_vECDvtDR5UpSlp_C "Deviation in accel data for DR5 judgement at CC up slope for ECON" VALUE 0x8053A296 Val_Ws16 127.9961 Vel_CrCtl 0.00 127.9961 FORMAT "%8.4" EXTENDED_LIMITS -128.0000 127.9961 /end CHARACTERISTIC
/begin CHARACTERISTIC CrCtl_vECDvtDR6UpSlp_C "Deviation in accel data for DR6 judgement at CC up slope for ECON" VALUE 0x8053A298 Val_Ws16 127.9961 Vel_CrCtl 0.00 127.9961 FORMAT "%8.4" EXTENDED_LIMITS -128.0000 127.9961 /end CHARACTERISTIC
/begin CHARACTERISTIC CrCtl_vECDvtDR7UpSlp_C "Deviation in accel data for DR7 judgement at CC up slope for ECON" VALUE 0x8053A29A Val_Ws16 127.9961 Vel_CrCtl 0.00 127.9961 FORMAT "%8.4" EXTENDED_LIMITS -128.0000 127.9961 /end CHARACTERISTIC
/begin CHARACTERISTIC CrCtl_vEcoACCRPntHysLoNTG_GCUR "Curve for ACC RP hysteresis Lo(Not Top Gear) for Eco mode" CURVE 0x8053A29C CurG_Ws16 127.9961 Vel_CrCtl 0.00 127.9961 FORMAT "%8.4" EXTENDED_LIMITS -128.0000 127.9961
 /begin AXIS_DESCR COM_AXIS CrCtl_vVehUpBytTbl_mp Vel_CrCtl1 6 0.00 255.0000 FORMAT "%8.4" EXTENDED_LIMITS -32768.00 32767.00 AXIS_PTS_REF CrCtl_vRPntDLimHys_AXIS /end AXIS_DESCR
/end CHARACTERISTIC
/begin CHARACTERISTIC CrCtl_vEcoACCRPntHysLoTG_GCUR "Curve for ACC RP hysteresis Lo(Top Gear) for Eco mode" CURVE 0x8053A2A8 CurG_Ws16 127.9961 Vel_CrCtl 0.00 127.9961 FORMAT "%8.4" EXTENDED_LIMITS -128.0000 127.9961
 /begin AXIS_DESCR COM_AXIS CrCtl_vVehUpBytTbl_mp Vel_CrCtl1 6 0.00 255.0000 FORMAT "%8.4" EXTENDED_LIMITS -32768.00 32767.00 AXIS_PTS_REF CrCtl_vRPntDLimHys_AXIS /end AXIS_DESCR
/end CHARACTERISTIC
/begin CHARACTERISTIC CrCtl_vEcoDLimHysHiNTG_GCUR "Curve for CCACC DL hysteresis Hi(Not Top Gear) for Eco mode" CURVE 0x8053A2B4 CurG_Ws16 127.9961 Vel_CrCtl 0.00 127.9961 FORMAT "%8.4" EXTENDED_LIMITS -128.0000 127.9961
 /begin AXIS_DESCR COM_AXIS CrCtl_vVehUpBytTbl_mp Vel_CrCtl1 6 0.00 255.0000 FORMAT "%8.4" EXTENDED_LIMITS -32768.00 32767.00 AXIS_PTS_REF CrCtl_vRPntDLimHys_AXIS /end AXIS_DESCR
/end CHARACTERISTIC
/begin CHARACTERISTIC CrCtl_vEcoDLimHysHiTG_GCUR "Curve for CCACC DL hysteresis Hi(Top Gear) for Eco mode" CURVE 0x8053A2C0 CurG_Ws16 127.9961 Vel_CrCtl 0.00 127.9961 FORMAT "%8.4" EXTENDED_LIMITS -128.0000 127.9961
 /begin AXIS_DESCR COM_AXIS CrCtl_vVehUpBytTbl_mp Vel_CrCtl1 6 0.00 255.0000 FORMAT "%8.4" EXTENDED_LIMITS -32768.00 32767.00 AXIS_PTS_REF CrCtl_vRPntDLimHys_AXIS /end AXIS_DESCR
/end CHARACTERISTIC
/begin CHARACTERISTIC CrCtl_vEcoDLimHysLoNTG_GCUR "Curve for CCACC DL hysteresis Lo(Not Top Gear) for Eco mode" CURVE 0x8053A2CC CurG_Ws16 127.9961 Vel_CrCtl 0.00 127.9961 FORMAT "%8.4" EXTENDED_LIMITS -128.0000 127.9961
 /begin AXIS_DESCR COM_AXIS CrCtl_vVehUpBytTbl_mp Vel_CrCtl1 6 0.00 255.0000 FORMAT "%8.4" EXTENDED_LIMITS -32768.00 32767.00 AXIS_PTS_REF CrCtl_vRPntDLimHys_AXIS /end AXIS_DESCR
/end CHARACTERISTIC
/begin CHARACTERISTIC CrCtl_vEcoDLimHysLoTG_GCUR "Curve for CCACC DL hysteresis Lo(Top Gear) for Eco mode" CURVE 0x8053A2D8 CurG_Ws16 127.9961 Vel_CrCtl 0.00 127.9961 FORMAT "%8.4" EXTENDED_LIMITS -128.0000 127.9961
 /begin AXIS_DESCR COM_AXIS CrCtl_vVehUpBytTbl_mp Vel_CrCtl1 6 0.00 255.0000 FORMAT "%8.4" EXTENDED_LIMITS -32768.00 32767.00 AXIS_PTS_REF CrCtl_vRPntDLimHys_AXIS /end AXIS_DESCR
/end CHARACTERISTIC
/begin CHARACTERISTIC CrCtl_vECOffDesInc1_MAP "Added value2 in each 100ms to desired vehicle speed for ECON (ECON sw OFF)" MAP 0x8053A2E4 Map_Xs16Ys16Ws16 127.9961 Vel_CrCtl 0.00 127.9961 FORMAT "%8.4" EXTENDED_LIMITS -128.0000 127.9961
 /begin AXIS_DESCR STD_AXIS CrCtl_vVehUpByte Vel_CrCtl1 12 0.00 255.0000 FORMAT "%8.4" EXTENDED_LIMITS -32768.00 32767.00 DEPOSIT ABSOLUTE /end AXIS_DESCR
 /begin AXIS_DESCR STD_AXIS CrCtl_rEstSlpFltVal Prc_CrCtl4 9 -128.0000 127.9961 FORMAT "%8.4" DEPOSIT ABSOLUTE /end AXIS_DESCR
/end CHARACTERISTIC
/begin CHARACTERISTIC CrCtl_vECOffDesInc2_CUR "Added value1 in each 100ms to desired vehicle speed for ECON (ECON sw ON)" CURVE 0x8053A3EA RB_Cur_Xs16Ws16 127.9961 Vel_CrCtl 0.00 127.9961 FORMAT "%8.4" EXTENDED_LIMITS -128.0000 127.9961
 /begin AXIS_DESCR STD_AXIS CrCtl_vSpdDvt_mp Vel_CrCtl 9 -128.0000 127.9961 FORMAT "%8.4" DEPOSIT ABSOLUTE /end AXIS_DESCR
/end CHARACTERISTIC
/begin CHARACTERISTIC CrCtl_vECOffDvtDwn1_C "Accel differential coeffecient for DR3 judgement at ACC_F/B" VALUE 0x8053A410 Val_Ws16 127.9961 Vel_CrCtl 0.00 127.9961 FORMAT "%8.4" EXTENDED_LIMITS -128.0000 127.9961 /end CHARACTERISTIC
/begin CHARACTERISTIC CrCtl_vECOffDvtDwn2_C "Accel differential coeffecient for DR3 judgement at ACC_F/B for ECON" VALUE 0x8053A412 Val_Ws16 127.9961 Vel_CrCtl 0.00 127.9961 FORMAT "%8.4" EXTENDED_LIMITS -128.0000 127.9961 /end CHARACTERISTIC
/begin CHARACTERISTIC CrCtl_vECOffDvtDwn3_C "Accel differential coeffecient for DR3 judgement at CC_ACCEL for ECON" VALUE 0x8053A414 Val_Ws16 127.9961 Vel_CrCtl 0.00 127.9961 FORMAT "%8.4" EXTENDED_LIMITS -128.0000 127.9961 /end CHARACTERISTIC
/begin CHARACTERISTIC CrCtl_vECOffDvtDwn4_C "Data on speed deviation for DR1 judgement at CC down slp for ECON" VALUE 0x8053A416 Val_Ws16 127.9961 Vel_CrCtl 0.00 127.9961 FORMAT "%8.4" EXTENDED_LIMITS -128.0000 127.9961 /end CHARACTERISTIC
/begin CHARACTERISTIC CrCtl_vECOffDvtUp2_C "Accel differential coeffecient for DR1 judgement at ACC_F/B" VALUE 0x8053A418 Val_Ws16 127.9961 Vel_CrCtl 0.00 127.9961 FORMAT "%8.4" EXTENDED_LIMITS -128.0000 127.9961 /end CHARACTERISTIC
/begin CHARACTERISTIC CrCtl_vECOffDvtUp3_C "Accel differential coeffecient for DR1 judgement at ACC_F/B for ECON" VALUE 0x8053A41A Val_Ws16 127.9961 Vel_CrCtl 0.00 127.9961 FORMAT "%8.4" EXTENDED_LIMITS -128.0000 127.9961 /end CHARACTERISTIC
/begin CHARACTERISTIC CrCtl_vECOffDvtUp4_C "Accel differential coeffecient for DR1 judgement at CC_ACCEL for ECON" VALUE 0x8053A41C Val_Ws16 127.9961 Vel_CrCtl 0.00 127.9961 FORMAT "%8.4" EXTENDED_LIMITS -128.0000 127.9961 /end CHARACTERISTIC
/begin CHARACTERISTIC CrCtl_vECOffDvtUp5_C "During ACC follow-up control,deviation in accel data for DR2 judgement for ECON" VALUE 0x8053A41E Val_Ws16 127.9961 Vel_CrCtl 0.00 127.9961 FORMAT "%8.4" EXTENDED_LIMITS -128.0000 127.9961 /end CHARACTERISTIC
/begin CHARACTERISTIC CrCtl_vECOnDesInc1_MAP "Added value2 in each 100ms to desired vehicle speed for ECON (ECON sw ON)" MAP 0x8053A420 Map_Xs16Ys16Ws16 127.9961 Vel_CrCtl 0.00 127.9961 FORMAT "%8.4" EXTENDED_LIMITS -128.0000 127.9961
 /begin AXIS_DESCR STD_AXIS CrCtl_vVehUpByte Vel_CrCtl1 12 0.00 255.0000 FORMAT "%8.4" EXTENDED_LIMITS -32768.00 32767.00 DEPOSIT ABSOLUTE /end AXIS_DESCR
 /begin AXIS_DESCR STD_AXIS CrCtl_rEstSlpFltVal Prc_CrCtl4 9 -128.0000 127.9961 FORMAT "%8.4" DEPOSIT ABSOLUTE /end AXIS_DESCR
/end CHARACTERISTIC
/begin CHARACTERISTIC CrCtl_vECOnDesInc2_CUR "Added value1 in each 100ms to desired vehicle speed for ECON (ECON sw OFF, Continuous TAPUP)" CURVE 0x8053A526 RB_Cur_Xs16Ws16 127.9961 Vel_CrCtl 0.00 127.9961 FORMAT "%8.4" EXTENDED_LIMITS -128.0000 127.9961
 /begin AXIS_DESCR STD_AXIS CrCtl_vSpdDvt_mp Vel_CrCtl 9 -128.0000 127.9961 FORMAT "%8.4" DEPOSIT ABSOLUTE /end AXIS_DESCR
/end CHARACTERISTIC
/begin CHARACTERISTIC CrCtl_vECOnDvtDwn1_C "Data on speed deviation for DR2 judgement at CC down slp for ECON" VALUE 0x8053A54C Val_Ws16 127.9961 Vel_CrCtl 0.00 127.9961 FORMAT "%8.4" EXTENDED_LIMITS -128.0000 127.9961 /end CHARACTERISTIC
/begin CHARACTERISTIC CrCtl_vECOnDvtDwn2_C "Data on speed deviation for DR3 judgement at CC down slp for ECON" VALUE 0x8053A54E Val_Ws16 127.9961 Vel_CrCtl 0.00 127.9961 FORMAT "%8.4" EXTENDED_LIMITS -128.0000 127.9961 /end CHARACTERISTIC
/begin CHARACTERISTIC CrCtl_vECOnDvtDwn3_C "Output select flag for DR1 judgement at CC down slp for ECON" VALUE 0x8053A550 Val_Ws16 127.9961 Vel_CrCtl 0.00 127.9961 FORMAT "%8.4" EXTENDED_LIMITS -128.0000 127.9961 /end CHARACTERISTIC
/begin CHARACTERISTIC CrCtl_vECOnDvtDwn4_C "Output select flag for DR2 judgement at CC down slp for ECON" VALUE 0x8053A552 Val_Ws16 127.9961 Vel_CrCtl 0.00 127.9961 FORMAT "%8.4" EXTENDED_LIMITS -128.0000 127.9961 /end CHARACTERISTIC
/begin CHARACTERISTIC CrCtl_vECOnDvtUp2_C "Deviation in accel data for DR2 judgement at CC up slope for ECON" VALUE 0x8053A554 Val_Ws16 127.9961 Vel_CrCtl 0.00 127.9961 FORMAT "%8.4" EXTENDED_LIMITS -128.0000 127.9961 /end CHARACTERISTIC
/begin CHARACTERISTIC CrCtl_vECOnDvtUp3_C "Accel differential coeffecient data for DR2 judgement at CC_RESUME for ECON" VALUE 0x8053A556 Val_Ws16 127.9961 Vel_CrCtl 0.00 127.9961 FORMAT "%8.4" EXTENDED_LIMITS -128.0000 127.9961 /end CHARACTERISTIC
/begin CHARACTERISTIC CrCtl_vECOnDvtUp4_C "Accel differential coeffecient data for DR2 judgement at ACC_RESUME" VALUE 0x8053A558 Val_Ws16 127.9961 Vel_CrCtl 0.00 127.9961 FORMAT "%8.4" EXTENDED_LIMITS -128.0000 127.9961 /end CHARACTERISTIC
/begin CHARACTERISTIC CrCtl_vECOnDvtUp5_C "Accel differential coeffecient data for DR2 judgement at ACC_RESUME for ECON" VALUE 0x8053A55A Val_Ws16 127.9961 Vel_CrCtl 0.00 127.9961 FORMAT "%8.4" EXTENDED_LIMITS -128.0000 127.9961 /end CHARACTERISTIC
/begin CHARACTERISTIC CrCtl_vEcoRPntHysHiNTG_GCUR "Curve for CC RP hysteresis Hi(Not Top Gear) for Eco mode" CURVE 0x8053A55C CurG_Ws16 127.9961 Vel_CrCtl 0.00 127.9961 FORMAT "%8.4" EXTENDED_LIMITS -128.0000 127.9961
 /begin AXIS_DESCR COM_AXIS CrCtl_vVehUpBytTbl_mp Vel_CrCtl1 6 0.00 255.0000 FORMAT "%8.4" EXTENDED_LIMITS -32768.00 32767.00 AXIS_PTS_REF CrCtl_vRPntDLimHys_AXIS /end AXIS_DESCR
/end CHARACTERISTIC
/begin CHARACTERISTIC CrCtl_vEcoRPntHysHiTG_GCUR "Curve for CC RP hysteresis Hi(Top Gear) for Eco mode" CURVE 0x8053A568 CurG_Ws16 127.9961 Vel_CrCtl 0.00 127.9961 FORMAT "%8.4" EXTENDED_LIMITS -128.0000 127.9961
 /begin AXIS_DESCR COM_AXIS CrCtl_vVehUpBytTbl_mp Vel_CrCtl1 6 0.00 255.0000 FORMAT "%8.4" EXTENDED_LIMITS -32768.00 32767.00 AXIS_PTS_REF CrCtl_vRPntDLimHys_AXIS /end AXIS_DESCR
/end CHARACTERISTIC
/begin CHARACTERISTIC CrCtl_vEcoRPntHysLoNTG_GCUR "Curve for CC RP hysteresis Lo(Not Top Gear) for Eco mode" CURVE 0x8053A574 CurG_Ws16 127.9961 Vel_CrCtl 0.00 127.9961 FORMAT "%8.4" EXTENDED_LIMITS -128.0000 127.9961
 /begin AXIS_DESCR COM_AXIS CrCtl_vVehUpBytTbl_mp Vel_CrCtl1 6 0.00 255.0000 FORMAT "%8.4" EXTENDED_LIMITS -32768.00 32767.00 AXIS_PTS_REF CrCtl_vRPntDLimHys_AXIS /end AXIS_DESCR
/end CHARACTERISTIC
/begin CHARACTERISTIC CrCtl_vEcoRPntHysLoTG_GCUR "Curve for CC RP hysteresis Lo(Top Gear) for Eco mode" CURVE 0x8053A580 CurG_Ws16 127.9961 Vel_CrCtl 0.00 127.9961 FORMAT "%8.4" EXTENDED_LIMITS -128.0000 127.9961
 /begin AXIS_DESCR COM_AXIS CrCtl_vVehUpBytTbl_mp Vel_CrCtl1 6 0.00 255.0000 FORMAT "%8.4" EXTENDED_LIMITS -32768.00 32767.00 AXIS_PTS_REF CrCtl_vRPntDLimHys_AXIS /end AXIS_DESCR
/end CHARACTERISTIC
/begin CHARACTERISTIC CrCtl_vECTarAStdKmh_GCUR "Curve for target acceleration standerd value for ECON (km/h spec)" CURVE 0x8053A58C CurG_Ws16 255.9961 Vel_CrCtl -128.0000 127.9961 FORMAT "%8.4"
 /begin AXIS_DESCR COM_AXIS CrCtl_vVehUpByte Vel_CrCtl1 6 0.00 255.0000 FORMAT "%8.4" EXTENDED_LIMITS -32768.00 32767.00 AXIS_PTS_REF CrCtl_vAccnBas_AXIS /end AXIS_DESCR
/end CHARACTERISTIC
/begin CHARACTERISTIC CrCtl_vECTarAStd_GCUR "Curve for target acceleration standerd value for ECON (during accel)" CURVE 0x8053A598 CurG_Ws16 255.9961 Vel_CrCtl -128.0000 127.9961 FORMAT "%8.4"
 /begin AXIS_DESCR COM_AXIS CrCtl_vVehUpByte Vel_CrCtl1 6 0.00 255.0000 FORMAT "%8.4" EXTENDED_LIMITS -32768.00 32767.00 AXIS_PTS_REF CrCtl_vAccnBas_AXIS /end AXIS_DESCR
/end CHARACTERISTIC
/begin AXIS_PTS CrCtl_vFdbkArea_AX "Axis Points for Feedback Area speed of cruise control" 0x8053A5A4 CrCtl_vDesUpByte_mp Axis_Xs16 255.0000 Vel_CrCtl1 12 0.00 255.0000 FORMAT "%8.4" EXTENDED_LIMITS -32768.00 32767.00 DEPOSIT ABSOLUTE /end AXIS_PTS
/begin AXIS_PTS CrCtl_vFdbkArea_AXIS "Axis Points for Feedback Area speed of cruise control" 0x8053A5BE CrCtl_vDesUpByte_mp Axis_Xs16 255.0000 Vel_CrCtl1 6 0.00 255.0000 FORMAT "%8.4" EXTENDED_LIMITS -32768.00 32767.00 DEPOSIT ABSOLUTE /end AXIS_PTS
/begin CHARACTERISTIC CrCtl_vGearDwn1UpLim_C "Gear Down 1 Upper Limit Speed value" VALUE 0x8053A5CC Val_Ws32 8388607.99609 Vel_CrCtl 0.00 8388607.99609 FORMAT "%13.5" EXTENDED_LIMITS -8388608.00000 8388607.99609 /end CHARACTERISTIC
/begin CHARACTERISTIC CrCtl_vGearDwn1UpReqClr_C "Gear Down 1 Up request clear Speed value" VALUE 0x8053A5D0 Val_Ws32 8388607.99609 Vel_CrCtl 0.00 8388607.99609 FORMAT "%13.5" EXTENDED_LIMITS -8388608.00000 8388607.99609 /end CHARACTERISTIC
/begin CHARACTERISTIC CrCtl_vGearDwn1UpReq_C "Gear Down 1 Up request Speed value" VALUE 0x8053A5D4 Val_Ws32 8388607.99609 Vel_CrCtl 0.00 8388607.99609 FORMAT "%13.5" EXTENDED_LIMITS -8388608.00000 8388607.99609 /end CHARACTERISTIC
/begin CHARACTERISTIC CrCtl_vGearDwn2UpLim_C "Gear Down 2 Upper Limit Speed value" VALUE 0x8053A5D8 Val_Ws32 8388607.99609 Vel_CrCtl 0.00 8388607.99609 FORMAT "%13.5" EXTENDED_LIMITS -8388608.00000 8388607.99609 /end CHARACTERISTIC
/begin CHARACTERISTIC CrCtl_vGearDwn2UpReqClr_C "Gear Down 2 Up request clear Speed value" VALUE 0x8053A5DC Val_Ws32 8388607.99609 Vel_CrCtl 0.00 8388607.99609 FORMAT "%13.5" EXTENDED_LIMITS -8388608.00000 8388607.99609 /end CHARACTERISTIC
/begin CHARACTERISTIC CrCtl_vGearDwn2UpReq_C "Gear Down 2 Up request Speed value" VALUE 0x8053A5E0 Val_Ws32 8388607.99609 Vel_CrCtl 0.00 8388607.99609 FORMAT "%13.5" EXTENDED_LIMITS -8388608.00000 8388607.99609 /end CHARACTERISTIC
/begin CHARACTERISTIC CrCtl_vGearDwn3UpLim_C "Gear Down 3 Upper Limit Speed value" VALUE 0x8053A5E4 Val_Ws32 8388607.99609 Vel_CrCtl 0.00 8388607.99609 FORMAT "%13.5" EXTENDED_LIMITS -8388608.00000 8388607.99609 /end CHARACTERISTIC
/begin CHARACTERISTIC CrCtl_vGearDwn3UpReqClr_C "Gear Down 3 Up request clear Speed value" VALUE 0x8053A5E8 Val_Ws32 8388607.99609 Vel_CrCtl 0.00 8388607.99609 FORMAT "%13.5" EXTENDED_LIMITS -8388608.00000 8388607.99609 /end CHARACTERISTIC
/begin CHARACTERISTIC CrCtl_vGearDwn3UpReq_C "Gear Down 3 Up request Speed value" VALUE 0x8053A5EC Val_Ws32 8388607.99609 Vel_CrCtl 0.00 8388607.99609 FORMAT "%13.5" EXTENDED_LIMITS -8388608.00000 8388607.99609 /end CHARACTERISTIC
/begin CHARACTERISTIC CrCtl_vGearDwn4UpLim_C "Gear Down 4 Upper Limit Speed value" VALUE 0x8053A5F0 Val_Ws32 8388607.99609 Vel_CrCtl 0.00 8388607.99609 FORMAT "%13.5" EXTENDED_LIMITS -8388608.00000 8388607.99609 /end CHARACTERISTIC
/begin CHARACTERISTIC CrCtl_vGearDwn4UpReqClr_C "Gear Down 4 Up request clear Speed value" VALUE 0x8053A5F4 Val_Ws32 8388607.99609 Vel_CrCtl 0.00 8388607.99609 FORMAT "%13.5" EXTENDED_LIMITS -8388608.00000 8388607.99609 /end CHARACTERISTIC
/begin CHARACTERISTIC CrCtl_vGearDwn4UpReq_C "Gear Down 4 Up request Speed value" VALUE 0x8053A5F8 Val_Ws32 8388607.99609 Vel_CrCtl 0.00 8388607.99609 FORMAT "%13.5" EXTENDED_LIMITS -8388608.00000 8388607.99609 /end CHARACTERISTIC
/begin CHARACTERISTIC CrCtl_vInitOffSpdVar_C "initial off vehicle speed variant value" VALUE 0x8053A5FC Val_Ws32 127.996093750 Vel_CrCtl 0.00 127.996093750 FORMAT "%13.9" EXTENDED_LIMITS -8388608.00000 8388607.99609 /end CHARACTERISTIC
/begin AXIS_PTS CrCtl_vLSFStrtAPP_AXIS "Axis for LSF start demand value" 0x8053A600 CrCtl_vVehUpByte Axis_Xs16 65535.00 Vel_CrCtl1 12 -32768.00 32767.00 FORMAT "%8.2" DEPOSIT ABSOLUTE /end AXIS_PTS
/begin CHARACTERISTIC CrCtl_vLSFStrt_C "Calibration parameter for minimum velocity for LSF" VALUE 0x8053A61C Val_Ws32 16777215.9961 Vel_CrCtl -8388608.00000 8388607.99609 FORMAT "%13.5" /end CHARACTERISTIC
/begin CHARACTERISTIC CrCtl_vResOffEndDvtCor_C "Corrected deviation speed to check the end of resume off control" VALUE 0x8053A620 Val_Ws16 255.9961 Vel_CrCtl -128.0000 127.9961 FORMAT "%8.4" /end CHARACTERISTIC
/begin AXIS_PTS CrCtl_vRPntDLimHys_AXIS "Axis Points for Resume point (HILO) Decel limit (HILO) speed hysteresis of cruise control" 0x8053A622 CrCtl_vVehUpBytTbl_mp Axis_Xs16 255.0000 Vel_CrCtl1 6 0.00 255.0000 FORMAT "%8.4" EXTENDED_LIMITS -32768.00 32767.00 DEPOSIT ABSOLUTE /end AXIS_PTS
/begin CHARACTERISTIC CrCtl_vRPntHysHiNTGKmh_GCUR "Curve for CC/ACC RP hysteresis Hi(Not Top Gear)(Km/h spec)" CURVE 0x8053A630 CurG_Ws16 127.9961 Vel_CrCtl 0.00 127.9961 FORMAT "%8.4" EXTENDED_LIMITS -128.0000 127.9961
 /begin AXIS_DESCR COM_AXIS CrCtl_vVehUpBytTbl_mp Vel_CrCtl1 6 0.00 255.0000 FORMAT "%8.4" EXTENDED_LIMITS -32768.00 32767.00 AXIS_PTS_REF CrCtl_vRPntDLimHys_AXIS /end AXIS_DESCR
/end CHARACTERISTIC
/begin CHARACTERISTIC CrCtl_vRPntHysHiNTG_GCUR "Curve for CC/ACC RP hysteresis Hi(Not Top Gear)" CURVE 0x8053A63C CurG_Ws16 127.9961 Vel_CrCtl 0.00 127.9961 FORMAT "%8.4" EXTENDED_LIMITS -128.0000 127.9961
 /begin AXIS_DESCR COM_AXIS CrCtl_vVehUpBytTbl_mp Vel_CrCtl1 6 0.00 255.0000 FORMAT "%8.4" EXTENDED_LIMITS -32768.00 32767.00 AXIS_PTS_REF CrCtl_vRPntDLimHys_AXIS /end AXIS_DESCR
/end CHARACTERISTIC
/begin CHARACTERISTIC CrCtl_vRPntHysHiTGKmh_GCUR "Curve for CC/ACC RP hysteresis Hi(Top Gear)(Km/h spec)" CURVE 0x8053A648 CurG_Ws16 127.9961 Vel_CrCtl 0.00 127.9961 FORMAT "%8.4" EXTENDED_LIMITS -128.0000 127.9961
 /begin AXIS_DESCR COM_AXIS CrCtl_vVehUpBytTbl_mp Vel_CrCtl1 6 0.00 255.0000 FORMAT "%8.4" EXTENDED_LIMITS -32768.00 32767.00 AXIS_PTS_REF CrCtl_vRPntDLimHys_AXIS /end AXIS_DESCR
/end CHARACTERISTIC
/begin CHARACTERISTIC CrCtl_vRPntHysHiTG_GCUR "Curve for CC/ACC RP hysteresis Hi(Top Gear)" CURVE 0x8053A654 CurG_Ws16 127.9961 Vel_CrCtl 0.00 127.9961 FORMAT "%8.4" EXTENDED_LIMITS -128.0000 127.9961
 /begin AXIS_DESCR COM_AXIS CrCtl_vVehUpBytTbl_mp Vel_CrCtl1 6 0.00 255.0000 FORMAT "%8.4" EXTENDED_LIMITS -32768.00 32767.00 AXIS_PTS_REF CrCtl_vRPntDLimHys_AXIS /end AXIS_DESCR
/end CHARACTERISTIC
/begin CHARACTERISTIC CrCtl_vRPntHysLoNTGKmh_GCUR "Curve for CC RP hysteresis Lo(Not Top Gear)(Km/h spec)" CURVE 0x8053A660 CurG_Ws16 127.9961 Vel_CrCtl 0.00 127.9961 FORMAT "%8.4" EXTENDED_LIMITS -128.0000 127.9961
 /begin AXIS_DESCR COM_AXIS CrCtl_vVehUpBytTbl_mp Vel_CrCtl1 6 0.00 255.0000 FORMAT "%8.4" EXTENDED_LIMITS -32768.00 32767.00 AXIS_PTS_REF CrCtl_vRPntDLimHys_AXIS /end AXIS_DESCR
/end CHARACTERISTIC
/begin CHARACTERISTIC CrCtl_vRPntHysLoNTG_GCUR "Curve for CC RP hysteresis Lo(Not Top Gear)" CURVE 0x8053A66C CurG_Ws16 127.9961 Vel_CrCtl 0.00 127.9961 FORMAT "%8.4" EXTENDED_LIMITS -128.0000 127.9961
 /begin AXIS_DESCR COM_AXIS CrCtl_vVehUpBytTbl_mp Vel_CrCtl1 6 0.00 255.0000 FORMAT "%8.4" EXTENDED_LIMITS -32768.00 32767.00 AXIS_PTS_REF CrCtl_vRPntDLimHys_AXIS /end AXIS_DESCR
/end CHARACTERISTIC
/begin CHARACTERISTIC CrCtl_vRPntHysLoTGKmh_GCUR "Curve for CC RP hysteresis Lo(Top Gear)(Km/h spec)" CURVE 0x8053A678 CurG_Ws16 127.9961 Vel_CrCtl 0.00 127.9961 FORMAT "%8.4" EXTENDED_LIMITS -128.0000 127.9961
 /begin AXIS_DESCR COM_AXIS CrCtl_vVehUpBytTbl_mp Vel_CrCtl1 6 0.00 255.0000 FORMAT "%8.4" EXTENDED_LIMITS -32768.00 32767.00 AXIS_PTS_REF CrCtl_vRPntDLimHys_AXIS /end AXIS_DESCR
/end CHARACTERISTIC
/begin CHARACTERISTIC CrCtl_vRPntHysLoTG_GCUR "Curve for CC RP hysteresis Lo(Top Gear)" CURVE 0x8053A684 CurG_Ws16 127.9961 Vel_CrCtl 0.00 127.9961 FORMAT "%8.4" EXTENDED_LIMITS -128.0000 127.9961
 /begin AXIS_DESCR COM_AXIS CrCtl_vVehUpBytTbl_mp Vel_CrCtl1 6 0.00 255.0000 FORMAT "%8.4" EXTENDED_LIMITS -32768.00 32767.00 AXIS_PTS_REF CrCtl_vRPntDLimHys_AXIS /end AXIS_DESCR
/end CHARACTERISTIC
/begin CHARACTERISTIC CrCtl_vSpdVarDR1CnclDwnSlp_C "Speed variation for judging DR1 cancellation at CC down slope" VALUE 0x8053A690 Val_Ws16 255.9961 Vel_CrCtl -128.0000 127.9961 FORMAT "%8.4" /end CHARACTERISTIC
/begin CHARACTERISTIC CrCtl_vSpdVarDR2CnclDwnSlp_C "Speed variation for judging DR2 cancellation at CC down slope" VALUE 0x8053A692 Val_Ws16 255.9961 Vel_CrCtl -128.0000 127.9961 FORMAT "%8.4" /end CHARACTERISTIC
/begin CHARACTERISTIC CrCtl_vSpdVarDR3CnclDwnSlp_C "Speed variation for judging DR3 cancellation at CC down slope" VALUE 0x8053A694 Val_Ws16 255.9961 Vel_CrCtl -128.0000 127.9961 FORMAT "%8.4" /end CHARACTERISTIC
/begin CHARACTERISTIC CrCtl_vSpdVarDR4CnclDwnSlp_C "Speed variation for judging DR4 cancellation at CC down slope" VALUE 0x8053A696 Val_Ws16 255.9961 Vel_CrCtl -128.0000 127.9961 FORMAT "%8.4" /end CHARACTERISTIC
/begin CHARACTERISTIC CrCtl_vSpdVarDR5CnclDwnSlp_C "Speed variation for judging DR5 cancellation at CC down slope" VALUE 0x8053A698 Val_Ws16 255.9961 Vel_CrCtl -128.0000 127.9961 FORMAT "%8.4" /end CHARACTERISTIC
/begin CHARACTERISTIC CrCtl_vSpdVarDR6CnclDwnSlp_C "Speed variation for judging DR6 cancellation at CC down slope" VALUE 0x8053A69A Val_Ws16 255.9961 Vel_CrCtl -128.0000 127.9961 FORMAT "%8.4" /end CHARACTERISTIC
/begin CHARACTERISTIC CrCtl_vSpdVarDR7CnclDwnSlp_C "Speed variation for judging DR7 cancellation at CC down slope" VALUE 0x8053A69C Val_Ws16 255.9961 Vel_CrCtl -128.0000 127.9961 FORMAT "%8.4" /end CHARACTERISTIC
/begin CHARACTERISTIC CrCtl_vSptACCRPntHysLoNTG_GCUR "Curve for ACC RP hysteresis Lo(Not Top Gear) for sport mode" CURVE 0x8053A69E CurG_Ws16 127.9961 Vel_CrCtl 0.00 127.9961 FORMAT "%8.4" EXTENDED_LIMITS -128.0000 127.9961
 /begin AXIS_DESCR COM_AXIS CrCtl_vVehUpBytTbl_mp Vel_CrCtl1 6 0.00 255.0000 FORMAT "%8.4" EXTENDED_LIMITS -32768.00 32767.00 AXIS_PTS_REF CrCtl_vRPntDLimHys_AXIS /end AXIS_DESCR
/end CHARACTERISTIC
/begin CHARACTERISTIC CrCtl_vSptACCRPntHysLoTG_GCUR "Curve for ACC RP hysteresis Lo(Top Gear) for sport mode" CURVE 0x8053A6AA CurG_Ws16 127.9961 Vel_CrCtl 0.00 127.9961 FORMAT "%8.4" EXTENDED_LIMITS -128.0000 127.9961
 /begin AXIS_DESCR COM_AXIS CrCtl_vVehUpBytTbl_mp Vel_CrCtl1 6 0.00 255.0000 FORMAT "%8.4" EXTENDED_LIMITS -32768.00 32767.00 AXIS_PTS_REF CrCtl_vRPntDLimHys_AXIS /end AXIS_DESCR
/end CHARACTERISTIC
/begin CHARACTERISTIC CrCtl_vSptDLimHysHiNTG_GCUR "Curve for CCACC DL hysteresis Hi(Not Top Gear) for sport mode" CURVE 0x8053A6B6 CurG_Ws16 127.9961 Vel_CrCtl 0.00 127.9961 FORMAT "%8.4" EXTENDED_LIMITS -128.0000 127.9961
 /begin AXIS_DESCR COM_AXIS CrCtl_vVehUpBytTbl_mp Vel_CrCtl1 6 0.00 255.0000 FORMAT "%8.4" EXTENDED_LIMITS -32768.00 32767.00 AXIS_PTS_REF CrCtl_vRPntDLimHys_AXIS /end AXIS_DESCR
/end CHARACTERISTIC
/begin CHARACTERISTIC CrCtl_vSptDLimHysHiTG_GCUR "Curve for CCACC DL hysteresis Hi(Top Gear) for sport mode" CURVE 0x8053A6C2 CurG_Ws16 127.9961 Vel_CrCtl 0.00 127.9961 FORMAT "%8.4" EXTENDED_LIMITS -128.0000 127.9961
 /begin AXIS_DESCR COM_AXIS CrCtl_vVehUpBytTbl_mp Vel_CrCtl1 6 0.00 255.0000 FORMAT "%8.4" EXTENDED_LIMITS -32768.00 32767.00 AXIS_PTS_REF CrCtl_vRPntDLimHys_AXIS /end AXIS_DESCR
/end CHARACTERISTIC
/begin CHARACTERISTIC CrCtl_vSptDLimHysLoNTG_GCUR "Curve for CCACC DL hysteresis Lo(Not Top Gear) for sport mode" CURVE 0x8053A6CE CurG_Ws16 127.9961 Vel_CrCtl 0.00 127.9961 FORMAT "%8.4" EXTENDED_LIMITS -128.0000 127.9961
 /begin AXIS_DESCR COM_AXIS CrCtl_vVehUpBytTbl_mp Vel_CrCtl1 6 0.00 255.0000 FORMAT "%8.4" EXTENDED_LIMITS -32768.00 32767.00 AXIS_PTS_REF CrCtl_vRPntDLimHys_AXIS /end AXIS_DESCR
/end CHARACTERISTIC
/begin CHARACTERISTIC CrCtl_vSptDLimHysLoTG_GCUR "Curve for CCACC DL hysteresis Lo(Top Gear) for sport mode" CURVE 0x8053A6DA CurG_Ws16 127.9961 Vel_CrCtl 0.00 127.9961 FORMAT "%8.4" EXTENDED_LIMITS -128.0000 127.9961
 /begin AXIS_DESCR COM_AXIS CrCtl_vVehUpBytTbl_mp Vel_CrCtl1 6 0.00 255.0000 FORMAT "%8.4" EXTENDED_LIMITS -32768.00 32767.00 AXIS_PTS_REF CrCtl_vRPntDLimHys_AXIS /end AXIS_DESCR
/end CHARACTERISTIC
/begin CHARACTERISTIC CrCtl_vSptRPntHysHiNTG_GCUR "Curve for CC RP hysteresis Hi(Not Top Gear) for sport mode" CURVE 0x8053A6E6 CurG_Ws16 127.9961 Vel_CrCtl 0.00 127.9961 FORMAT "%8.4" EXTENDED_LIMITS -128.0000 127.9961
 /begin AXIS_DESCR COM_AXIS CrCtl_vVehUpBytTbl_mp Vel_CrCtl1 6 0.00 255.0000 FORMAT "%8.4" EXTENDED_LIMITS -32768.00 32767.00 AXIS_PTS_REF CrCtl_vRPntDLimHys_AXIS /end AXIS_DESCR
/end CHARACTERISTIC
/begin CHARACTERISTIC CrCtl_vSptRPntHysHiTG_GCUR "Curve for CC RP hysteresis Hi(Top Gear) for sport mode" CURVE 0x8053A6F2 CurG_Ws16 127.9961 Vel_CrCtl 0.00 127.9961 FORMAT "%8.4" EXTENDED_LIMITS -128.0000 127.9961
 /begin AXIS_DESCR COM_AXIS CrCtl_vVehUpBytTbl_mp Vel_CrCtl1 6 0.00 255.0000 FORMAT "%8.4" EXTENDED_LIMITS -32768.00 32767.00 AXIS_PTS_REF CrCtl_vRPntDLimHys_AXIS /end AXIS_DESCR
/end CHARACTERISTIC
/begin CHARACTERISTIC CrCtl_vSptRPntHysLoNTG_GCUR "Curve for CC RP hysteresis Lo(Not Top Gear) for sport mode" CURVE 0x8053A6FE CurG_Ws16 127.9961 Vel_CrCtl 0.00 127.9961 FORMAT "%8.4" EXTENDED_LIMITS -128.0000 127.9961
 /begin AXIS_DESCR COM_AXIS CrCtl_vVehUpBytTbl_mp Vel_CrCtl1 6 0.00 255.0000 FORMAT "%8.4" EXTENDED_LIMITS -32768.00 32767.00 AXIS_PTS_REF CrCtl_vRPntDLimHys_AXIS /end AXIS_DESCR
/end CHARACTERISTIC
/begin CHARACTERISTIC CrCtl_vSptRPntHysLoTG_GCUR "Curve for CC RP hysteresis Lo(Top Gear) for sport mode" CURVE 0x8053A70A CurG_Ws16 127.9961 Vel_CrCtl 0.00 127.9961 FORMAT "%8.4" EXTENDED_LIMITS -128.0000 127.9961
 /begin AXIS_DESCR COM_AXIS CrCtl_vVehUpBytTbl_mp Vel_CrCtl1 6 0.00 255.0000 FORMAT "%8.4" EXTENDED_LIMITS -32768.00 32767.00 AXIS_PTS_REF CrCtl_vRPntDLimHys_AXIS /end AXIS_DESCR
/end CHARACTERISTIC
/begin AXIS_PTS CrCtl_vTapDnInit_AXIS "Axis Points for Tap Down initial speed of cruise control" 0x8053A716 CrCtl_vVehUpByte Axis_Xs16 255.0000 Vel_CrCtl1 6 0.00 255.0000 FORMAT "%8.4" EXTENDED_LIMITS -32768.00 32767.00 DEPOSIT ABSOLUTE /end AXIS_PTS
/begin AXIS_PTS CrCtl_vTapUpInit_AXIS "Axis Points for Tap Up initial speed of cruise control" 0x8053A724 CrCtl_vVehUpByte Axis_Xs16 255.0000 Vel_CrCtl1 6 0.00 255.0000 FORMAT "%8.4" EXTENDED_LIMITS -32768.00 32767.00 DEPOSIT ABSOLUTE /end AXIS_PTS
/begin CHARACTERISTIC CrCtl_vThdCtOffAllwd_C "delta velocity to reset CrCtl- fuel cutoff prohibition" VALUE 0x8053A732 Val_Ws16 255.9961 Vel_CrCtl -128.0000 127.9961 FORMAT "%8.4" /end CHARACTERISTIC
/begin CHARACTERISTIC CrCtl_vThdCtOffPhd_C "delta velocity to set CrCtl- fuel cutoff prohibition" VALUE 0x8053A734 Val_Ws16 255.9961 Vel_CrCtl -128.0000 127.9961 FORMAT "%8.4" /end CHARACTERISTIC
/begin CHARACTERISTIC CrCtl_vThresPla_C "Vehicle speed threshold for detecting the plausibility error in vehicle speed for Cruise Control" VALUE 0x8053A736 Val_Ws16 327.6700 Vel 0.00 327.6700 FORMAT "%8.4" EXTENDED_LIMITS -327.6800 327.6700 /end CHARACTERISTIC
/begin CHARACTERISTIC CrCtl_vTopGearUpLim_C "Top Gear Upper Limit Speed value" VALUE 0x8053A738 Val_Ws32 8388607.99609 Vel_CrCtl 0.00 8388607.99609 FORMAT "%13.5" EXTENDED_LIMITS -8388608.00000 8388607.99609 /end CHARACTERISTIC
/begin CHARACTERISTIC CrCtl_vTrgAccnAccAdd_C "Target acceleration Accel additional value" VALUE 0x8053A73C Val_Ws32 127.996093750 Vel_CrCtl 0.00 127.996093750 FORMAT "%13.9" EXTENDED_LIMITS -8388608.00000 8388607.99609 /end CHARACTERISTIC
/begin CHARACTERISTIC CrCtl_vTrgAccnStandKmh_GCUR "Curve for target acceleration standerd value(km/h spec)" CURVE 0x8053A740 CurG_Ws16 127.9922 Vel_CrCtl 0.0039 127.9961 FORMAT "%8.4" EXTENDED_LIMITS -128.0000 127.9961
 /begin AXIS_DESCR COM_AXIS CrCtl_vVehUpByte Vel_CrCtl1 6 0.00 255.0000 FORMAT "%8.4" EXTENDED_LIMITS -32768.00 32767.00 AXIS_PTS_REF CrCtl_vAccnBas_AXIS /end AXIS_DESCR
/end CHARACTERISTIC
/begin CHARACTERISTIC CrCtl_vTrgAccnStand_GCUR "Curve for target acceleration standerd value" CURVE 0x8053A74C CurG_Ws16 127.9922 Vel_CrCtl 0.0039 127.9961 FORMAT "%8.4" EXTENDED_LIMITS -128.0000 127.9961
 /begin AXIS_DESCR COM_AXIS CrCtl_vVehUpByte Vel_CrCtl1 6 0.00 255.0000 FORMAT "%8.4" EXTENDED_LIMITS -32768.00 32767.00 AXIS_PTS_REF CrCtl_vAccnBas_AXIS /end AXIS_DESCR
/end CHARACTERISTIC
/begin CHARACTERISTIC CrCtl_vTrgAccnStdLSF_GCUR "Curve for target acceleration standard value for LSF" CURVE 0x8053A758 CurG_Ws16 255.9961 Vel_CrCtl -128.0000 127.9961 FORMAT "%8.4"
 /begin AXIS_DESCR COM_AXIS CrCtl_vVehUpByte Vel_CrCtl1 12 0.00 255.0000 FORMAT "%8.4" EXTENDED_LIMITS -32768.00 32767.00 AXIS_PTS_REF CrCtl_vAccnBas_AX /end AXIS_DESCR
/end CHARACTERISTIC
/begin CHARACTERISTIC CrCtl_vTrgVehSpdDvt_C "Control deviation in target vehicle speed for judging the set CC_DR mask timer" VALUE 0x8053A770 Val_Ws32 16777215.9961 Vel_CrCtl -8388608.00000 8388607.99609 FORMAT "%13.5" /end CHARACTERISTIC
/begin CHARACTERISTIC CrCUI_ctACCASLSwtErr_C "Counter value for ACC/ASL switch error detection" VALUE 0x80533504 Val_Wu16 32767.00 OneToOne 0.00 32767.00 FORMAT "%8.2" EXTENDED_LIMITS 0.00 65535.00 /end CHARACTERISTIC
/begin CHARACTERISTIC CrCUI_ctACCASLSwt_C "Counter value for ACC/ASL switch check" VALUE 0x80533506 Val_Wu8 127.0 OneToOne 0.00 127.0 FORMAT "%5.1" EXTENDED_LIMITS 0.00 255.0 /end CHARACTERISTIC
/begin CHARACTERISTIC CrCUI_ctATFWDPosn_C "Counter value for FWD position check for AT vehicle" VALUE 0x80533507 Val_Wu8 127.0 OneToOne 0.00 127.0 FORMAT "%5.1" EXTENDED_LIMITS 0.00 255.0 /end CHARACTERISTIC
/begin CHARACTERISTIC CrCUI_ctCancelSwtDeb_C "counter value for CANCEL SW" VALUE 0x80533508 Val_Wu8 127.0 OneToOne 0.00 127.0 FORMAT "%5.1" EXTENDED_LIMITS 0.00 255.0 /end CHARACTERISTIC
/begin CHARACTERISTIC CrCUI_ctCANRxErr1_C "Counter value for CAN Rx Main Switch Error" VALUE 0x80533509 Val_Wu8 127.0 OneToOne 0.00 127.0 FORMAT "%5.1" EXTENDED_LIMITS 0.00 255.0 /end CHARACTERISTIC
/begin CHARACTERISTIC CrCUI_ctCANRxErr_C "counter value for CAN Rx Error" VALUE 0x8053350A Val_Wu8 127.0 OneToOne 0.00 127.0 FORMAT "%5.1" EXTENDED_LIMITS 0.00 255.0 /end CHARACTERISTIC
/begin CHARACTERISTIC CrCUI_ctCrsSwtErr_C "Counter value for Cruise control switch error detection" VALUE 0x8053350C Val_Wu16 32767.00 OneToOne 0.00 32767.00 FORMAT "%8.2" EXTENDED_LIMITS 0.00 65535.00 /end CHARACTERISTIC
/begin CHARACTERISTIC CrCUI_ctEAT2RxErr_C "Counter value for EAT2 frame Rx Error" VALUE 0x8053350E Val_Wu8 127.0 OneToOne 0.00 127.0 FORMAT "%5.1" EXTENDED_LIMITS 0.00 255.0 /end CHARACTERISTIC
/begin CHARACTERISTIC CrCUI_ctMaiSwtDeb_C "counter value for the Cruise Control Main SW" VALUE 0x8053350F Val_Wu8 127.0 OneToOne 0.00 127.0 FORMAT "%5.1" EXTENDED_LIMITS 0.00 255.0 /end CHARACTERISTIC
/begin CHARACTERISTIC CrCUI_ctSwtDeb_C "counter value for the Cruise Control SW" VALUE 0x80533510 Val_Wu8 127.0 OneToOne 0.00 127.0 FORMAT "%5.1" EXTENDED_LIMITS 0.00 255.0 /end CHARACTERISTIC
/begin CHARACTERISTIC CrCUI_facNeFlt_C "factor of Filtered Ne value for Cruise Control" VALUE 0x80533512 Val_Ws16 255.9961 Fact_CrCtl -128.0000 127.9961 FORMAT "%8.4" /end CHARACTERISTIC
/begin CHARACTERISTIC CrCUI_flgTypTSRLimSpd_C "Type of TSR limit speed information" VALUE 0x80533514 Val_Wu8 1.000 OneToOne 0.00 1.000 FORMAT "%5.3" EXTENDED_LIMITS 0.00 255.0 /end CHARACTERISTIC
/begin CHARACTERISTIC CrCUI_nACCBrkCnclLoLim_GCUR "Curve for ACC auto brake cancel Low limit Ne value" CURVE 0x80533516 CurG_Ws16 65535.00 EngNCrCtl -32768.00 32767.00 FORMAT "%8.2"
 /begin AXIS_DESCR COM_AXIS CrCUI_nLIDes EngNCrCtl 6 0.00 32767.00 FORMAT "%8.2" EXTENDED_LIMITS -32768.00 32767.00 AXIS_PTS_REF CrCUI_nChkVal_AXIS /end AXIS_DESCR
/end CHARACTERISTIC
/begin AXIS_PTS CrCUI_nChkVal_AXIS "Axis Points for Ne Check Value of cruise control" 0x80533522 CrCUI_nLIDes Axis_Xs16 32767.00 EngNCrCtl 6 0.00 32767.00 FORMAT "%8.2" EXTENDED_LIMITS -32768.00 32767.00 DEPOSIT ABSOLUTE /end AXIS_PTS
/begin CHARACTERISTIC CrCUI_nCnclLoLim_GCUR "Curve for Cruise Control cancel Low limit Ne value" CURVE 0x80533530 CurG_Ws16 32767.00 EngNCrCtl 0.00 32767.00 FORMAT "%8.2" EXTENDED_LIMITS -32768.00 32767.00
 /begin AXIS_DESCR COM_AXIS CrCUI_nLIDes EngNCrCtl 6 0.00 32767.00 FORMAT "%8.2" EXTENDED_LIMITS -32768.00 32767.00 AXIS_PTS_REF CrCUI_nChkVal_AXIS /end AXIS_DESCR
/end CHARACTERISTIC
/begin CHARACTERISTIC CrCUI_nCnclUpoLim_C "Cruise Control cancel Upper limit Ne value" VALUE 0x8053353C Val_Ws16 32767.00 EngNCrCtl 0.00 32767.00 FORMAT "%8.2" EXTENDED_LIMITS -32768.00 32767.00 /end CHARACTERISTIC
/begin CHARACTERISTIC CrCUI_nShftDnReq_GCUR "Curve for Shift down request Ne Check value" CURVE 0x8053353E CurG_Ws16 32767.00 EngNCrCtl 0.00 32767.00 FORMAT "%8.2" EXTENDED_LIMITS -32768.00 32767.00
 /begin AXIS_DESCR COM_AXIS CrCUI_nLIDes EngNCrCtl 6 0.00 32767.00 FORMAT "%8.2" EXTENDED_LIMITS -32768.00 32767.00 AXIS_PTS_REF CrCUI_nChkVal_AXIS /end AXIS_DESCR
/end CHARACTERISTIC
/begin CHARACTERISTIC CrCUI_numCrsASLForceSel_C "Cruise control/ASL force select of number" VALUE 0x8053354A Val_Wu8 127.0 OneToOne 0.00 127.0 FORMAT "%5.1" EXTENDED_LIMITS 0.00 255.0 /end CHARACTERISTIC
/begin CHARACTERISTIC CrCUI_numGearTrgt_CA "Target gear number for cheking gear information" VAL_BLK 0x8053354B ValA_Wu8 255.0 OneToOne 0.00 255.0 FORMAT "%5.1" NUMBER 12 /end CHARACTERISTIC
/begin CHARACTERISTIC CrCUI_numLSF_C "Calibration parameter for LSF mode selection for ACC" VALUE 0x80533557 Val_Wu8 255.0 OneToOne 0.00 255.0 FORMAT "%5.1" /end CHARACTERISTIC
/begin CHARACTERISTIC CrCUI_numTSRErr_C "TSR error judgement value" VALUE 0x80533558 Val_Wu8 255.0 OneToOne 0.00 255.0 FORMAT "%5.1" /end CHARACTERISTIC
/begin CHARACTERISTIC CrCUI_numTSRInfo_CUR "Calculate vehicle speed from the received TSR signature info" CURVE 0x8053355A Cur_Xs16Ws16 65535.00 OneToOne -32768.00 32767.00 FORMAT "%8.2"
 /begin AXIS_DESCR STD_AXIS Com_stDispDmdSignRi OneToOne 128 -32768. 32767. FORMAT "%5.0" DEPOSIT ABSOLUTE /end AXIS_DESCR
/end CHARACTERISTIC
/begin CHARACTERISTIC CrCUI_rGearChk0_C "Gear Down Check value 0" VALUE 0x8053375C Val_Ws32 16777215.9961 NToVel_CrCtl -8388608.00000 8388607.99609 FORMAT "%13.5" /end CHARACTERISTIC
/begin CHARACTERISTIC CrCUI_rGearChk1_C "Gear Down Check value 1" VALUE 0x80533760 Val_Ws32 16777215.9961 NToVel_CrCtl -8388608.00000 8388607.99609 FORMAT "%13.5" /end CHARACTERISTIC
/begin CHARACTERISTIC CrCUI_rGearChk2_C "Gear Down Check value 2" VALUE 0x80533764 Val_Ws32 16777215.9961 NToVel_CrCtl -8388608.00000 8388607.99609 FORMAT "%13.5" /end CHARACTERISTIC
/begin CHARACTERISTIC CrCUI_rGearChk3_C "Gear Down Check value 3" VALUE 0x80533768 Val_Ws32 16777215.9961 NToVel_CrCtl -8388608.00000 8388607.99609 FORMAT "%13.5" /end CHARACTERISTIC
/begin CHARACTERISTIC CrCUI_rGearChk4_C "Gear Down Check value 4" VALUE 0x8053376C Val_Ws32 16777215.9961 NToVel_CrCtl -8388608.00000 8388607.99609 FORMAT "%13.5" /end CHARACTERISTIC
/begin CHARACTERISTIC CrCUI_rGearChk5_C "Gear Down Check value 5" VALUE 0x80533770 Val_Ws32 16777215.9961 NToVel_CrCtl -8388608.00000 8388607.99609 FORMAT "%13.5" /end CHARACTERISTIC
/begin CHARACTERISTIC CrCUI_rNv0_C "ratio n/v for Gear Down 0 check value" VALUE 0x80533774 Val_Ws32 16777215.9961 NToVel_CrCtl -8388608.00000 8388607.99609 FORMAT "%13.5" /end CHARACTERISTIC
/begin CHARACTERISTIC CrCUI_rNv1_C "ratio n/v for Gear Down 1 check value" VALUE 0x80533778 Val_Ws32 16777215.9961 NToVel_CrCtl -8388608.00000 8388607.99609 FORMAT "%13.5" /end CHARACTERISTIC
/begin CHARACTERISTIC CrCUI_rNv2_C "ratio n/v for Gear Down 2 check value" VALUE 0x8053377C Val_Ws32 16777215.9961 NToVel_CrCtl -8388608.00000 8388607.99609 FORMAT "%13.5" /end CHARACTERISTIC
/begin CHARACTERISTIC CrCUI_rNv3_C "ratio n/v for Gear Down 3 check value" VALUE 0x80533780 Val_Ws32 16777215.9961 NToVel_CrCtl -8388608.00000 8388607.99609 FORMAT "%13.5" /end CHARACTERISTIC
/begin CHARACTERISTIC CrCUI_rNv4_C "ratio n/v for Gear Down 4 check value" VALUE 0x80533784 Val_Ws32 16777215.9961 NToVel_CrCtl -8388608.00000 8388607.99609 FORMAT "%13.5" /end CHARACTERISTIC
/begin CHARACTERISTIC CrCUI_rNv5_C "ratio n/v for Gear Down 5 check value" VALUE 0x80533788 Val_Ws32 16777215.9961 NToVel_CrCtl -8388608.00000 8388607.99609 FORMAT "%13.5" /end CHARACTERISTIC
/begin CHARACTERISTIC CrCUI_stASLtoISASpdLim_C "Enable switch for continuing speed limit control at the transition from ASL to ISA via LIM SW 1: Control continuation 0: Control cancellation" VALUE 0x8053378C Val_Wu8 255.0 OneToOne 0.00 255.0 FORMAT "%5.1" /end CHARACTERISTIC
/begin CHARACTERISTIC CrCUI_stClthCont_C "Clutch continuation data" VALUE 0x8053378D Val_Wu8 1.000 OneToOne 0.00 1.000 FORMAT "%5.3" EXTENDED_LIMITS 0.00 255.0 /end CHARACTERISTIC
/begin CHARACTERISTIC CrCUI_stClthOnNeChk_C "Clutch on Ne Check select value" VALUE 0x8053378E Val_Wu8 1.000 OneToOne 0.00 1.000 FORMAT "%5.3" EXTENDED_LIMITS 0.00 255.0 /end CHARACTERISTIC
/begin CHARACTERISTIC CrCUI_stECON_C "Added value2 in each 100ms to desired vehicle speed for ECON (ECON sw OFF)" VALUE 0x8053378F Val_Wu8 1.000 OneToOne 0.00 1.000 FORMAT "%5.3" EXTENDED_LIMITS 0.00 255.0 /end CHARACTERISTIC
/begin CHARACTERISTIC CrCUI_stFctInfo_C "Information of CC/ACC/ASL function" VALUE 0x80533790 Val_Wu8 255.0 OneToOne 0.00 255.0 FORMAT "%5.1" /end CHARACTERISTIC
/begin CHARACTERISTIC CrCUI_stGearDownNoLSF_C "Gear Down Number for LSF control" VALUE 0x80533791 Val_Wu8 255.0 OneToOne 0.00 255.0 FORMAT "%5.1" /end CHARACTERISTIC
/begin CHARACTERISTIC CrCUI_stGearDownNo_CA "Gear Down Number for cruise control" VAL_BLK 0x80533792 ValA_Wu8 255.0 OneToOne 0.00 255.0 FORMAT "%5.1" NUMBER 12 /end CHARACTERISTIC
/begin CHARACTERISTIC CrCUI_stGuidDispOff_C "Cruise control guidance display off indication" VALUE 0x8053A774 Val_Wu8 255.0 OneToOne 0.00 255.0 FORMAT "%5.1" /end CHARACTERISTIC
/begin CHARACTERISTIC CrCUI_stIDSCmft_C "Status of Comfort drive mode active" VALUE 0x8053379E Val_Wu8 255.0 OneToOne 0.00 255.0 FORMAT "%5.1" /end CHARACTERISTIC
/begin CHARACTERISTIC CrCUI_stIDSEco_C "Status of Eco drive mode active" VALUE 0x8053379F Val_Wu8 255.0 OneToOne 0.00 255.0 FORMAT "%5.1" /end CHARACTERISTIC
/begin CHARACTERISTIC CrCUI_stIDSSpt_C "Status of Sport drive mode active" VALUE 0x805337A0 Val_Wu8 255.0 OneToOne 0.00 255.0 FORMAT "%5.1" /end CHARACTERISTIC
/begin CHARACTERISTIC CrCUI_stISAContJdgTSRClr_CUR "Calculate ISA control continuation judgment value when TSR is cleared" CURVE 0x805337A2 Cur_Xs16Ws16 65535.00 OneToOne -32768.00 32767.00 FORMAT "%8.2"
 /begin AXIS_DESCR STD_AXIS Com_stTSRClrReas OneToOne 8 -32768. 32767. FORMAT "%5.0" DEPOSIT ABSOLUTE /end AXIS_DESCR
/end CHARACTERISTIC
/begin CHARACTERISTIC CrCUI_stISAtoASLbyResSet_C "Enable switch for transition from ISA to ASL via RES (+)SET (-) during ISA." VALUE 0x805337C4 Val_Wu8 255.0 OneToOne 0.00 255.0 FORMAT "%5.1" /end CHARACTERISTIC
/begin CHARACTERISTIC CrCUI_stMETSpdDspEna_C "Status for display control vehicle speed in meter panel" VALUE 0x805337C5 Val_Wu8 1.000 OneToOne 0.00 1.000 FORMAT "%5.3" EXTENDED_LIMITS 0.00 255.0 /end CHARACTERISTIC
/begin CHARACTERISTIC CrCUI_stMetSpdUnitSwt_C "Calibration to select Unit Switching Menu" VALUE 0x805337C6 Val_Wu8 1.000 OneToOne 0.00 1.000 FORMAT "%5.3" EXTENDED_LIMITS 0.00 255.0 /end CHARACTERISTIC
/begin CHARACTERISTIC CrCUI_stShftPosChkDisbl_C "Disable flag for checking shift position" VALUE 0x805337C7 Val_Wu8 255.0 OneToOne 0.00 255.0 FORMAT "%5.1" /end CHARACTERISTIC
/begin CHARACTERISTIC CrCUI_stSimulResChk_C "Simultaneous On Check value for RESUME SW" VALUE 0x805337C8 Val_Wu8 1.000 OneToOne 0.00 1.000 FORMAT "%5.3" EXTENDED_LIMITS 0.00 255.0 /end CHARACTERISTIC
/begin CHARACTERISTIC CrCUI_stSimulSetChk_C "Simultaneous On Check value for SET SW" VALUE 0x805337C9 Val_Wu8 1.000 OneToOne 0.00 1.000 FORMAT "%5.3" EXTENDED_LIMITS 0.00 255.0 /end CHARACTERISTIC
/begin CHARACTERISTIC CrCUI_stSwtFwdPosnInfo_C "Forward Position information switch" VALUE 0x805337CA Val_Wu8 1.000 OneToOne 0.00 1.000 FORMAT "%5.3" EXTENDED_LIMITS 0.00 255.0 /end CHARACTERISTIC
/begin CHARACTERISTIC CrCUI_stVehUn_C "Vehicle speed unit for CC/ASL when meter does not send vehicle speed unit information" VALUE 0x805337CB Val_Wu8 1.000 OneToOne 0.00 1.000 FORMAT "%5.3" EXTENDED_LIMITS 0.00 255.0 /end CHARACTERISTIC
/begin CHARACTERISTIC CrCUI_swtATFWDPosnCntr_C "Software switch for FWD position check counter set for AT vehicle" VALUE 0x805337CC Val_Wu8 1.000 OneToOne 0.00 1.000 FORMAT "%5.3" EXTENDED_LIMITS 0.00 255.0 /end CHARACTERISTIC
/begin CHARACTERISTIC CrCUI_swtCCSpdDispEnfSeln_C "Force selection for existence set-speed-display" VALUE 0x805337CD Val_Wu8 1.000 OneToOne 0.00 1.000 FORMAT "%5.3" EXTENDED_LIMITS 0.00 255.0 /end CHARACTERISTIC
/begin CHARACTERISTIC CrCUI_swtCrsSwtTypSel_C "Software switch for Cruise control switch type select" VALUE 0x805337CE Val_Wu8 1.000 OneToOne 0.00 1.000 FORMAT "%5.3" EXTENDED_LIMITS 0.00 255.0 /end CHARACTERISTIC
/begin CHARACTERISTIC CrCUI_swtMETTyp_C "Speed meter type" VALUE 0x805337CF Val_Wu8 1.000 OneToOne 0.00 1.000 FORMAT "%5.3" EXTENDED_LIMITS 0.00 255.0 /end CHARACTERISTIC
/begin CHARACTERISTIC CrCUI_swtVehUnForceSel_C "Switch that selects vehicle speed unit forcibly" VALUE 0x805337D0 Val_Wu8 1.000 OneToOne 0.00 1.000 FORMAT "%5.3" EXTENDED_LIMITS 0.00 255.0 /end CHARACTERISTIC
/begin CHARACTERISTIC CrCUI_tiACCAppSpdChng_C "ACC Accel Vehicle speed display time" VALUE 0x805337D2 Val_Ws16 3276700. Time_ms_100ms 0.00 3276700. FORMAT "%8.0" EXTENDED_LIMITS -3276800. 3276700. /end CHARACTERISTIC
/begin CHARACTERISTIC CrCUI_tiACCClthCncl_C "ACC Clutch SW Cancel check time" VALUE 0x805337D4 Val_Ws16 327670.0 Time_ms 0.00 327670.0 FORMAT "%8.1" EXTENDED_LIMITS -327680.0 327670.0 /end CHARACTERISTIC
/begin CHARACTERISTIC CrCUI_tiACCCoaSpdChng_C "ACC Coast Vehicle speed display time" VALUE 0x805337D6 Val_Ws16 3276700. Time_ms_100ms 0.00 3276700. FORMAT "%8.0" EXTENDED_LIMITS -3276800. 3276700. /end CHARACTERISTIC
/begin CHARACTERISTIC CrCUI_tiACCSpdNoUpdRes_C "ACC Accel Vehicle speed display not update request time" VALUE 0x805337D8 Val_Ws16 327670.0 Time_ms 0.00 327670.0 FORMAT "%8.1" EXTENDED_LIMITS -327680.0 327670.0 /end CHARACTERISTIC
/begin CHARACTERISTIC CrCUI_tiACCSpdNoUpdSet_C "ACC Coast Vehicle speed display not update request time" VALUE 0x805337DA Val_Ws16 327670.0 Time_ms 0.00 327670.0 FORMAT "%8.1" EXTENDED_LIMITS -327680.0 327670.0 /end CHARACTERISTIC
/begin CHARACTERISTIC CrCUI_tiACCSwtResApp_C "ACC Accel check time for RESUME SW" VALUE 0x805337DC Val_Ws16 327670.0 Time_ms 0.00 327670.0 FORMAT "%8.1" EXTENDED_LIMITS -327680.0 327670.0 /end CHARACTERISTIC
/begin CHARACTERISTIC CrCUI_tiACCSwtSetCoa_C "ACC Coast check time for SET SW" VALUE 0x805337DE Val_Ws16 327670.0 Time_ms 0.00 327670.0 FORMAT "%8.1" EXTENDED_LIMITS -327680.0 327670.0 /end CHARACTERISTIC
/begin CHARACTERISTIC CrCUI_tiAutoBrkActvChk_C "Time for Auto Brake Active Check." VALUE 0x805337E0 Val_Ws16 327670.0 Time_ms 0.00 327670.0 FORMAT "%8.1" EXTENDED_LIMITS -327680.0 327670.0 /end CHARACTERISTIC
/begin CHARACTERISTIC CrCUI_tiAYCCond_C "AYC condition check time" VALUE 0x805337E2 Val_Ws16 327670.0 Time_ms 0.00 327670.0 FORMAT "%8.1" EXTENDED_LIMITS -327680.0 327670.0 /end CHARACTERISTIC
/begin CHARACTERISTIC CrCUI_tiCCASLMETVehUnFlt_C "Timer of filter for meter customize information" VALUE 0x805337E4 Val_Ws16 327670.0 Time_ms 0.00 327670.0 FORMAT "%8.1" EXTENDED_LIMITS -327680.0 327670.0 /end CHARACTERISTIC
/begin CHARACTERISTIC CrCUI_tiCCASLVehUnInit_C "Time of initial setup for CC/ASL vehicle speed unit" VALUE 0x805337E6 Val_Ws16 327670.0 Time_ms 0.00 327670.0 FORMAT "%8.1" EXTENDED_LIMITS -327680.0 327670.0 /end CHARACTERISTIC
/begin CHARACTERISTIC CrCUI_tiContnsErrChk_C "Time of Cruise control error continuous check value" VALUE 0x805337E8 Val_Ws16 327670.0 Time_ms 0.00 327670.0 FORMAT "%8.1" EXTENDED_LIMITS -327680.0 327670.0 /end CHARACTERISTIC
/begin CHARACTERISTIC CrCUI_tiCrsASLSelInfo_C "Time of CC/ASL select information check value" VALUE 0x805337EA Val_Ws16 327670.0 Time_ms 0.00 327670.0 FORMAT "%8.1" EXTENDED_LIMITS -327680.0 327670.0 /end CHARACTERISTIC
/begin CHARACTERISTIC CrCUI_tiFWDpos_C "FWD position judgment timer in CC_AT vehicles" VALUE 0x805337EC Val_Ws16 327670.0 Time_ms 0.00 327670.0 FORMAT "%8.1" EXTENDED_LIMITS -327680.0 327670.0 /end CHARACTERISTIC
/begin CHARACTERISTIC CrCUI_tiGearOff_C "Gear off check time" VALUE 0x805337EE Val_Ws16 327670.0 Time_ms 0.00 327670.0 FORMAT "%8.1" EXTENDED_LIMITS -327680.0 327670.0 /end CHARACTERISTIC
/begin CHARACTERISTIC CrCUI_tiLSFStpJdgHysHi_C "Time for upper threshold for LSF stop judgement hysterisis" VALUE 0x805337F0 Val_Ws16 655350.0 Time_ms -327680.0 327670.0 FORMAT "%8.1" /end CHARACTERISTIC
/begin CHARACTERISTIC CrCUI_tiLSFStpJdgHysLo_C "Time for lower threshold for LSF stop judgement hysterisis" VALUE 0x805337F2 Val_Ws16 655350.0 Time_ms -327680.0 327670.0 FORMAT "%8.1" /end CHARACTERISTIC
/begin CHARACTERISTIC CrCUI_tiMETCustInfoFlt_C "Timer of filter for meter customize information" VALUE 0x805337F4 Val_Ws16 327670.0 Time_ms 0.00 327670.0 FORMAT "%8.1" EXTENDED_LIMITS -327680.0 327670.0 /end CHARACTERISTIC
/begin CHARACTERISTIC CrCUI_tiResuOnSpdUpd_C "Time of updated vehicle speed during Res SW is on" VALUE 0x805337F6 Val_Ws16 3276700. Time_ms_100ms 0.00 3276700. FORMAT "%8.0" EXTENDED_LIMITS -3276800. 3276700. /end CHARACTERISTIC
/begin CHARACTERISTIC CrCUI_tiSetOnSpdUpd_C "Time of updated vehicle speed during Set SW is on" VALUE 0x805337F8 Val_Ws16 3276700. Time_ms_100ms 0.00 3276700. FORMAT "%8.0" EXTENDED_LIMITS -3276800. 3276700. /end CHARACTERISTIC
/begin CHARACTERISTIC CrCUI_tiShftDn5Det_C "Shift Down 5 Detect check time" VALUE 0x805337FA Val_Ws16 327670.0 Time_ms 0.00 327670.0 FORMAT "%8.1" EXTENDED_LIMITS -327680.0 327670.0 /end CHARACTERISTIC
/begin CHARACTERISTIC CrCUI_tiShftDnDet_C "Shift Down Detect check time" VALUE 0x805337FC Val_Ws16 327670.0 Time_ms 0.00 327670.0 FORMAT "%8.1" EXTENDED_LIMITS -327680.0 327670.0 /end CHARACTERISTIC
/begin CHARACTERISTIC CrCUI_tiShftDnRls_C "Shift Down Rlease check time" VALUE 0x805337FE Val_Ws16 327670.0 Time_ms 0.00 327670.0 FORMAT "%8.1" EXTENDED_LIMITS -327680.0 327670.0 /end CHARACTERISTIC
/begin CHARACTERISTIC CrCUI_tiSwtBrkMn_C "Brake Main SW check time" VALUE 0x80533800 Val_Ws16 327670.0 Time_ms 0.00 327670.0 FORMAT "%8.1" EXTENDED_LIMITS -327680.0 327670.0 /end CHARACTERISTIC
/begin CHARACTERISTIC CrCUI_tiSwtBrkRed_C "Brake Redundant SW check time" VALUE 0x80533802 Val_Ws16 327670.0 Time_ms 0.00 327670.0 FORMAT "%8.1" EXTENDED_LIMITS -327680.0 327670.0 /end CHARACTERISTIC
/begin CHARACTERISTIC CrCUI_tiSwtClth_C "Clutch SW check time" VALUE 0x80533804 Val_Ws16 327670.0 Time_ms 0.00 327670.0 FORMAT "%8.1" EXTENDED_LIMITS -327680.0 327670.0 /end CHARACTERISTIC
/begin CHARACTERISTIC CrCUI_tiSwtInhb_C "Inhibit time for switch information from CAN" VALUE 0x80533806 Val_Ws16 327670.0 Time_ms 0.00 327670.0 FORMAT "%8.1" EXTENDED_LIMITS -327680.0 327670.0 /end CHARACTERISTIC
/begin CHARACTERISTIC CrCUI_tiSwtResApp_C "Accel check time for RESUME SW" VALUE 0x80533808 Val_Ws16 327670.0 Time_ms 0.00 327670.0 FORMAT "%8.1" EXTENDED_LIMITS -327680.0 327670.0 /end CHARACTERISTIC
/begin CHARACTERISTIC CrCUI_tiSwtSetCoa_C "Coast check time for SET SW" VALUE 0x8053380A Val_Ws16 327670.0 Time_ms 0.00 327670.0 FORMAT "%8.1" EXTENDED_LIMITS -327680.0 327670.0 /end CHARACTERISTIC
/begin CHARACTERISTIC CrCUI_tiTSRErrDet_C "Time for detecting camera temperature abnormality,dirty and breakdown" VALUE 0x8053380C Val_Ws16 327670.0 Time_ms 0.00 327670.0 FORMAT "%8.1" EXTENDED_LIMITS -327680.0 327670.0 /end CHARACTERISTIC
/begin CHARACTERISTIC CrCUI_vLSFStpJdgHysHi_C "Upper threshold for vehicle velocity limit for LSF stop judgement" VALUE 0x80533810 Val_Ws32 16777215.9961 Vel_CrCtl -8388608.00000 8388607.99609 FORMAT "%13.5" /end CHARACTERISTIC
/begin CHARACTERISTIC CrCUI_vLSFStpJdgHysLo_C "Lower threshold for vehicle velocity limit for LSF stop judgement" VALUE 0x80533814 Val_Ws32 16777215.9961 Vel_CrCtl -8388608.00000 8388607.99609 FORMAT "%13.5" /end CHARACTERISTIC
/begin CHARACTERISTIC CWDAGRS "codeword diagnosis egr system" VALUE 0x8053A77C RB_Val_Wu8 255.0 dez 0.00 255.0 FORMAT "%5.1" /end CHARACTERISTIC
/begin CHARACTERISTIC DAGRSRLSDENDISA "target position of egr valve not adjustable" VALUE 0x8053A77E RB_Val_Wu16 99.99847 rel_q0p00153 0.00 99.99847 FORMAT "%8.5" /end CHARACTERISTIC
/begin CHARACTERISTIC DAGRSRLSDENENA "target position of egr valve adjustable again" VALUE 0x8053A780 RB_Val_Wu16 99.99847 rel_q0p00153 0.00 99.99847 FORMAT "%8.5" /end CHARACTERISTIC
/begin CHARACTERISTIC DFBAGRAEG "difference correction egr adaption (Dt1-calculation)" VALUE 0x8053A782 RB_Val_Wu16 1.999969 fak_q3p0518Em5 0.00 1.999969 FORMAT "%8.6" /end CHARACTERISTIC
/begin CHARACTERISTIC DFBAGRAKT "difference correction egr adaption (Dt1-calculation)" VALUE 0x8053A784 RB_Val_Wu16 1.999969 fak_q3p0518Em5 0.00 1.999969 FORMAT "%8.6" /end CHARACTERISTIC
/begin CHARACTERISTIC DOFVAGRAEG "difference valve offset correction egr adaption (DT1-calculation)" VALUE 0x8053A786 RB_Val_Wu16 99.99847 rel_q0p00153 0.00 99.99847 FORMAT "%8.5" /end CHARACTERISTIC
/begin CHARACTERISTIC DOFVAGRAKT "difference valve offset correction egr adaption (DT1-calculation)" VALUE 0x8053A788 RB_Val_Wu16 99.99847 rel_q0p00153 0.00 99.99847 FORMAT "%8.5" /end CHARACTERISTIC
/begin CHARACTERISTIC EROTAN "Exhaust Regulation or Type Approval Number" VAL_BLK 0x8053AD90 ValA_Wu8 255.0 dez 0.00 255.0 FORMAT "%5.1" NUMBER 17 /end CHARACTERISTIC
/begin CHARACTERISTIC I14229DarkCurrHistMonrPrmFmt_C "Parameter Format Value for Dark Current history Monitor Data (DID E402)" VALUE 0x8058AEB2 Val_Wu8 255.0 OneToOne 0.00 255.0 FORMAT "%5.1" /end CHARACTERISTIC
/begin CHARACTERISTIC I14229DarkCurrHistMonrPrmLen_C "Parameter Length Value for Dark Current history Monitor Data (DID E402)" VALUE 0x8058AEB3 Val_Wu8 255.0 OneToOne 0.00 255.0 FORMAT "%5.1" /end CHARACTERISTIC
/begin CHARACTERISTIC I14229_DiumprDFC_CA "DFC Element Calibration Array for reading DIUMPR records" VAL_BLK 0x8053ADA2 RB_ValA_Wu16 906.000000000 DFC_Verb 0.00 906.000000000 FORMAT "%13.9" NUMBER 39 /end CHARACTERISTIC
/begin CHARACTERISTIC I14229_nrStrtrCtrl_AlgTypID_C "Algorithm type ID for Engine starter information" VALUE 0x8058AEB4 Val_Wu8 255.0 OneToOne 0.00 255.0 FORMAT "%5.1" /end CHARACTERISTIC
/begin CHARACTERISTIC I14229_nrStrtrCtrl_DataLen_C "Valid data length for Engine starter information" VALUE 0x8058AEB5 Val_Wu8 255.0 OneToOne 0.00 255.0 FORMAT "%5.1" /end CHARACTERISTIC
/begin CHARACTERISTIC I14229_numAFCLLng_C "Label to indicate the valid data length in bytes in the AFCL parameters" VALUE 0x8058AEB6 Val_Wu8 255.0 OneToOne 0.00 255.0 FORMAT "%5.1" /end CHARACTERISTIC
/begin CHARACTERISTIC I14229_numAFCLTyp_C "parameter to select the AFCL parameters format type" VALUE 0x8058AEB7 Val_Wu8 255.0 OneToOne 0.00 255.0 FORMAT "%5.1" /end CHARACTERISTIC
/begin CHARACTERISTIC I14229_numCompID_CA "Calibration for ECU Component ID" VAL_BLK 0x8058AEB8 ValA_Wu8 255.0 OneToOne 0.00 255.0 FORMAT "%5.1" NUMBER 17 /end CHARACTERISTIC
/begin CHARACTERISTIC I14229_numOilLfT_DataLen_C "Valid data length(Used in process for inspection)" VALUE 0x8058AEC9 Val_Wu8 255.0 OneToOne 0.00 255.0 FORMAT "%5.1" /end CHARACTERISTIC
/begin CHARACTERISTIC I14229_numProgID_CA "Calibration for ECU Program ID" VAL_BLK 0x8053ADF0 RB_ValA_Wu8 255.0 OneToOne 0.00 255.0 FORMAT "%5.1" NUMBER 14 /end CHARACTERISTIC
/begin CHARACTERISTIC I14229_numReWrECUID_CA "ECU ID for rewriting (Info Read Service)" VAL_BLK 0x8053ADFE RB_ValA_Wu8 255.0 OneToOne 0.00 255.0 FORMAT "%5.1" NUMBER 5 /end CHARACTERISTIC
/begin CHARACTERISTIC I14229_RcDid0212Ena_C "Calibration to select between support or not support for service 31, DID 0212" VALUE 0x8053AE03 Val_Wu8 255.0 OneToOne 0.00 255.0 FORMAT "%5.1" /end CHARACTERISTIC
/begin CHARACTERISTIC I14229_RcDid0213Ena_C "Calibration to enable DID 0x0213" VALUE 0x8053AE04 Val_Wu8 255.0 OneToOne 0.00 255.0 FORMAT "%5.1" /end CHARACTERISTIC
/begin CHARACTERISTIC I14229_RcDid021CEna_C "Calibration to select between support or not support for service 31, DID 021C" VALUE 0x8053AE05 Val_Wu8 255.0 OneToOne 0.00 255.0 FORMAT "%5.1" /end CHARACTERISTIC
/begin CHARACTERISTIC I14229_stFuLvlSnsr_C "Calibration to enable DID2613 PDR0C-0D" VALUE 0x8053AE06 RB_Val_Wu8 255.0 OneToOne 0.00 255.0 FORMAT "%5.1" /end CHARACTERISTIC
/begin CHARACTERISTIC I14229_stPCSEvapSwt_C "Calibration switch for DIDE801" VALUE 0x8053AE07 RB_Val_Wu8 255.0 OneToOne 0.00 255.0 FORMAT "%5.1" /end CHARACTERISTIC
/begin CHARACTERISTIC I14229_stSnsrFildEna_C "Calibration for Enable or Disable IG Voltage output" VALUE 0x8053AE08 RB_Val_Wu8 255.0 OneToOne 0.00 255.0 FORMAT "%5.1" /end CHARACTERISTIC
/begin CHARACTERISTIC I14229_stVSAEquip_C "VSA equipment information" VALUE 0x8053AE09 Val_Wu8 255.0 OneToOne 0.00 255.0 FORMAT "%5.1" /end CHARACTERISTIC
/begin CHARACTERISTIC I14229_swtFlTankEna_C "Calibration for enabling DID" VALUE 0x8053AE0A RB_Val_Wu8 255.0 OneToOne 0.00 255.0 FORMAT "%5.1" /end CHARACTERISTIC
/begin CHARACTERISTIC I14229_swtIntkAirTSnsr2_C "Calibration for enabling DID" VALUE 0x8053AE0B RB_Val_Wu8 255.0 OneToOne 0.00 255.0 FORMAT "%5.1" /end CHARACTERISTIC
/begin CHARACTERISTIC I14229_swtOilSnrEna_C "Calibration for enabling DID" VALUE 0x8053AE0C RB_Val_Wu8 255.0 OneToOne 0.00 255.0 FORMAT "%5.1" /end CHARACTERISTIC
/begin CHARACTERISTIC I14229_swtRDBI2610IntkAirTSnsr2_C "Calibration for enabling DID" VALUE 0x8053AE0D RB_Val_Wu8 255.0 OneToOne 0.00 255.0 FORMAT "%5.1" /end CHARACTERISTIC
/begin CHARACTERISTIC I14229_swtRDBI2617_C "Calibration for enabling DID" VALUE 0x8053AE0E Val_Wu8 255.0 OneToOne 0.00 255.0 FORMAT "%5.1" /end CHARACTERISTIC
/begin CHARACTERISTIC I14229_swtRDBI2627_C "Calibration for enabling DID" VALUE 0x8053AE0F Val_Wu8 255.0 OneToOne 0.00 255.0 FORMAT "%5.1" /end CHARACTERISTIC
/begin CHARACTERISTIC I14229_swtRDBI2666_C "Calibration for enabling DID" VALUE 0x8053AE10 Val_Wu8 255.0 OneToOne 0.00 255.0 FORMAT "%5.1" /end CHARACTERISTIC
/begin CHARACTERISTIC I14229_swtRDBI2688_C "Calibration for enabling DID" VALUE 0x8053AE11 Val_Wu8 255.0 OneToOne 0.00 255.0 FORMAT "%5.1" /end CHARACTERISTIC
/begin CHARACTERISTIC I14229_swtRDBI2689_C "Calibration for enabling DID" VALUE 0x8053AE12 Val_Wu8 255.0 OneToOne 0.00 255.0 FORMAT "%5.1" /end CHARACTERISTIC
/begin CHARACTERISTIC I14229_swtRDBI268C_C "Calibration for enabling DID" VALUE 0x8053AE13 Val_Wu8 255.0 OneToOne 0.00 255.0 FORMAT "%5.1" /end CHARACTERISTIC
/begin CHARACTERISTIC I14229_swtRDBI269B_C "Calibration for enabling DID" VALUE 0x8053AE14 Val_Wu8 255.0 OneToOne 0.00 255.0 FORMAT "%5.1" /end CHARACTERISTIC
/begin CHARACTERISTIC I14229_swtRDBI269E_C "Calibration for enabling DID" VALUE 0x8053AE15 Val_Wu8 255.0 OneToOne 0.00 255.0 FORMAT "%5.1" /end CHARACTERISTIC
/begin CHARACTERISTIC I14229_swtRDBI26A0_C "Calibration for enabling DID" VALUE 0x8053AE16 Val_Wu8 255.0 OneToOne 0.00 255.0 FORMAT "%5.1" /end CHARACTERISTIC
/begin CHARACTERISTIC I14229_swtRDBI26A1_C "Calibration for enabling DID" VALUE 0x8053AE17 Val_Wu8 255.0 OneToOne 0.00 255.0 FORMAT "%5.1" /end CHARACTERISTIC
/begin CHARACTERISTIC I14229_swtRDBI26A3_C "Calibration for enabling DID" VALUE 0x8053AE18 Val_Wu8 255.0 OneToOne 0.00 255.0 FORMAT "%5.1" /end CHARACTERISTIC
/begin CHARACTERISTIC I14229_swtRDBIDiumprRES_C "Calibration for enabling DID" VALUE 0x8053AE19 RB_Val_Wu8 255.0 OneToOne 0.00 255.0 FORMAT "%5.1" /end CHARACTERISTIC
/begin CHARACTERISTIC I14229_swtRDBIE801_C "Calibration for enabling DID" VALUE 0x8053AE1A Val_Wu8 255.0 default 0.00 255.0 FORMAT "%5.1" /end CHARACTERISTIC
/begin CHARACTERISTIC I14229_swtRDBIE81F_C "Calibration for enabling DID" VALUE 0x8053AE1B Val_Wu8 255.0 OneToOne 0.00 255.0 FORMAT "%5.1" /end CHARACTERISTIC
/begin CHARACTERISTIC I14229_swtVTMEna_C "Calibration for enabling DID" VALUE 0x8053AE1C RB_Val_Wu8 255.0 OneToOne 0.00 255.0 FORMAT "%5.1" /end CHARACTERISTIC
/begin CHARACTERISTIC I14229_tiCVORstFinshd_C "Time to return when it have request reset CVO" VALUE 0x8058AECA Val_Ws16 655350.0 Time_ms -327680.0 327670.0 FORMAT "%8.1" /end CHARACTERISTIC
/begin CHARACTERISTIC I14229_WdbiDidE805Ena_C "Calibration to select between support or not support service 2E, DIDE805" VALUE 0x8058AECC Val_Wu8 1.000 OneToOne 0.00 1.000 FORMAT "%5.3" EXTENDED_LIMITS 0.00 255.0 /end CHARACTERISTIC
/begin CHARACTERISTIC I14229_WdbiDidE81FEna_C "Calibration to select between support or not support service 2E, DIDE81F" VALUE 0x8058AECD Val_Wu8 1.000 OneToOne 0.00 1.000 FORMAT "%5.3" EXTENDED_LIMITS 0.00 255.0 /end CHARACTERISTIC
/begin CHARACTERISTIC Immo_numSAID_C "Calibration parameter for SAID changes" VALUE 0x8058AEA6 RB_Val_Wu8 255.0 OneToOne 0.00 255.0 FORMAT "%5.1" /end CHARACTERISTIC
/begin CHARACTERISTIC KBDAGRSMN "minimum egr aperture factor for error diagnostic" VALUE 0x8053A78A RB_Val_Wu16 1.999969 fak_q3p0518Em5 0.00 1.999969 FORMAT "%8.6" /end CHARACTERISTIC
/begin CHARACTERISTIC KBDAHYMN "hysteres for egr apertur correction minimum threshold" VALUE 0x8053A78C RB_Val_Wu16 1.999969 fak_q3p0518Em5 0.00 1.999969 FORMAT "%8.6" /end CHARACTERISTIC
/begin CHARACTERISTIC KBDAKTMN "minimum egr aperture factor for error diagnostic short test" VALUE 0x8053A78E RB_Val_Wu16 1.999969 fak_q3p0518Em5 0.00 1.999969 FORMAT "%8.6" /end CHARACTERISTIC
/begin CHARACTERISTIC Linappl_swtLinSdl_C "switch for LIN scheduler" VALUE 0x8053AE1D RB_Val_Wu8 255.0 OneToOne 0.00 255.0 FORMAT "%5.1" /end CHARACTERISTIC
/begin CHARACTERISTIC SecuAcs_numCustTyp10SC_C "Calibration for Type X security" VALUE 0x8058AEA8 RB_Val_Wu16 65535.00 OneToOne 0.00 65535.00 FORMAT "%8.2" /end CHARACTERISTIC
/begin CHARACTERISTIC SecuAcs_numCustTyp3SC_C "Calibration for Type 3 security" VALUE 0x8058AEAA RB_Val_Wu8 255.0 OneToOne 0.00 255.0 FORMAT "%5.1" /end CHARACTERISTIC
/begin CHARACTERISTIC SecuAcs_numCustTyp4SC_C "Calibration for Type 4 security" VALUE 0x8058AEAB RB_Val_Wu8 255.0 OneToOne 0.00 255.0 FORMAT "%5.1" /end CHARACTERISTIC
/begin CHARACTERISTIC SecuAcs_numS1_C "Security coefficent 1 for key calculation" VALUE 0x8058AEAC RB_Val_Wu16 65535.00 OneToOne 0.00 65535.00 FORMAT "%8.2" /end CHARACTERISTIC
/begin CHARACTERISTIC SecuAcs_numS2_C "Security coefficent 2 for key calculation" VALUE 0x8058AEAE RB_Val_Wu16 65535.00 OneToOne 0.00 65535.00 FORMAT "%8.2" /end CHARACTERISTIC
/begin CHARACTERISTIC SecuAcs_numS3_C "Security coefficent 3 for key calculation" VALUE 0x8058AEB0 RB_Val_Wu16 65535.00 OneToOne 0.00 65535.00 FORMAT "%8.2" /end CHARACTERISTIC
/begin CHARACTERISTIC TVAGRFBG "delay time EGR correction stabilized" VALUE 0x8053A790 RB_Val_Wu16 6553.500 t_q0p1 0.00 6553.500 FORMAT "%8.3" /end CHARACTERISTIC
/begin CHARACTERISTIC TVAGRFBGKT "delay time EGR correction stabilized short test" VALUE 0x8053A792 RB_Val_Wu16 6553.500 t_q0p1 0.00 6553.500 FORMAT "%8.3" /end CHARACTERISTIC
/begin CHARACTERISTIC TVAGROEG "delay time EGR offset correction stabilized" VALUE 0x8053A794 RB_Val_Wu16 6553.500 t_q0p1 0.00 6553.500 FORMAT "%8.3" /end CHARACTERISTIC
/begin CHARACTERISTIC TVAGROEGKT "delay time EGR offset correction stabilized short test" VALUE 0x8053A796 RB_Val_Wu16 6553.500 t_q0p1 0.00 6553.500 FORMAT "%8.3" /end CHARACTERISTIC
/begin CHARACTERISTIC TVEDAGRS "delay time healing diagnostic egr system" VALUE 0x8053A798 RB_Val_Wu16 6553.500 t_q0p1 0.00 6553.500 FORMAT "%8.3" /end CHARACTERISTIC
/begin CHARACTERISTIC TVHDAGRS "delay time error diagnostic egr system" VALUE 0x8053A79A RB_Val_Wu16 6553.500 t_q0p1 0.00 6553.500 FORMAT "%8.3" /end CHARACTERISTIC
/begin CHARACTERISTIC ZKFBDA "time constant egr correction stabilized" VALUE 0x8053A79C RB_Val_Wu16 6553.4999985 zk100msxs_uw_b6553 0.1000015 6553.6000000 FORMAT "%12.7" EXTENDED_LIMITS 0.10000152590 6553.6000000 /end CHARACTERISTIC
/begin CHARACTERISTIC ZKFBDAKT "time constant egr correction stabilized short test" VALUE 0x8053A79E RB_Val_Wu16 6553.4999985 zk100msxs_uw_b6553 0.1000015 6553.6000000 FORMAT "%12.7" EXTENDED_LIMITS 0.10000152590 6553.6000000 /end CHARACTERISTIC
/begin CHARACTERISTIC ZKOFDA "time constant egr correction offset stabilized" VALUE 0x8053A7A0 RB_Val_Wu16 6553.4999985 zk100msxs_uw_b6553 0.1000015 6553.6000000 FORMAT "%12.7" EXTENDED_LIMITS 0.10000152590 6553.6000000 /end CHARACTERISTIC
/begin CHARACTERISTIC ZKOFDAKT "time constant egr correction offset stabilized short test" VALUE 0x8053A7A2 RB_Val_Wu16 6553.4999985 zk100msxs_uw_b6553 0.1000015 6553.6000000 FORMAT "%12.7" EXTENDED_LIMITS 0.10000152590 6553.6000000 /end CHARACTERISTIC
/begin MEASUREMENT BasSvr_bFuncTstReq "condition general function request" UBYTE B_TRUE 1 100 0.00 1.00000000000 BIT_MASK 0x1 FORMAT "%13.11" ECU_ADDRESS 0x6000F8E9 /end MEASUREMENT
/begin MEASUREMENT B_dagrsdtrus_msg "Condition write Mode 6 values upstream EGR" UBYTE B_TRUE 1 100 0.00 1.00000000000 BIT_MASK 0x1 FORMAT "%13.11" ECU_ADDRESS 0x60000246 /end MEASUREMENT
/begin MEASUREMENT B_dagrsdtr_msg "Condition write Mode 6 values" UBYTE B_TRUE 1 100 0.00 1.00000000000 BIT_MASK 0x1 FORMAT "%13.11" ECU_ADDRESS 0x60000247 /end MEASUREMENT
/begin MEASUREMENT B_dagrssfl "Condition egr diagnostic during fuel cut off completed upstream EGR slow" UBYTE B_TRUE 1 100 0.00 1.00000000000 BIT_MASK 0x1 FORMAT "%13.11" ECU_ADDRESS 0x6000011F /end MEASUREMENT
/begin MEASUREMENT B_dagrssfsc "Condition egr diagnostic during fuel cut off completed upstream EGR fast" UBYTE B_TRUE 1 100 0.00 1.00000000000 BIT_MASK 0x1 FORMAT "%13.11" ECU_ADDRESS 0x6000011E /end MEASUREMENT
/begin MEASUREMENT B_dagrssf_msg "Condition egr diagnostic during fuel cut off completed" UBYTE B_TRUE 1 100 0.00 1.00000000000 BIT_MASK 0x1 FORMAT "%13.11" ECU_ADDRESS 0x60000244 /end MEASUREMENT
/begin MEASUREMENT B_fbagreg "Condition factor (aperture) correction EGR has stabilized" UBYTE B_TRUE 1 100 0.00 1.00000000000 BIT_MASK 0x1 FORMAT "%13.11" ECU_ADDRESS 0x6000011D /end MEASUREMENT
/begin MEASUREMENT B_fbagrmnl "Condition factor correction (aperture) mass flow EGR minimum upstream valve slow" UBYTE B_TRUE 1 100 0.00 1.00000000000 BIT_MASK 0x1 FORMAT "%13.11" ECU_ADDRESS 0x6000011C /end MEASUREMENT
/begin MEASUREMENT B_fbagrmnsc "Condition factor correction (aperture) mass flow EGR minimum upstream valve fast" UBYTE B_TRUE 1 100 0.00 1.00000000000 BIT_MASK 0x1 FORMAT "%13.11" ECU_ADDRESS 0x6000011B /end MEASUREMENT
/begin MEASUREMENT B_fkblagr "condition correction of egr line profile" UBYTE B_TRUE 1 100 0.00 1.00000000000 BIT_MASK 0x1 FORMAT "%13.11" ECU_ADDRESS 0x6000011A /end MEASUREMENT
/begin MEASUREMENT B_fkblagrs "condition correction of egr line profile (fast adaptation)" UBYTE B_TRUE 1 100 0.00 1.00000000000 BIT_MASK 0x1 FORMAT "%13.11" ECU_ADDRESS 0x60000119 /end MEASUREMENT
/begin MEASUREMENT B_ofagreg_msg "Condition offset EGR has stabilized" UBYTE B_TRUE 1 100 0.00 1.00000000000 BIT_MASK 0x1 FORMAT "%13.11" ECU_ADDRESS 0x600001ED /end MEASUREMENT
/begin MEASUREMENT CrCUI_ctACCAppSpdChng_mp "Counter for ACC Speedd Change" UWORD OneToOne 1 100 0.00 65535.00 FORMAT "%8.2" ECU_ADDRESS 0x7000A3AA /end MEASUREMENT
/begin MEASUREMENT CrCUI_ctACCASLSwtErr_mp "Counter of ACC/ASL switch error detection" UWORD OneToOne 1 100 0.00 65535.00 FORMAT "%8.2" ECU_ADDRESS 0x7000A3A8 /end MEASUREMENT
/begin MEASUREMENT CrCUI_ctACCASLSwtFild_mp "Counter of ACC/ASL switch filter" UBYTE OneToOne 1 100 0.00 255.0 FORMAT "%5.1" ECU_ADDRESS 0x7000A3A6 /end MEASUREMENT
/begin MEASUREMENT CrCUI_ctACCCoaSpdChng_mp "Counter value for the Coast Vehicle speed display" UWORD OneToOne 1 100 0.00 65535.00 FORMAT "%8.2" ECU_ADDRESS 0x7000A3A4 /end MEASUREMENT
/begin MEASUREMENT CrCUI_ctATFWDPosn_mp "Counter of FWD position check for AT vehicle" UBYTE OneToOne 1 100 0.00 255.0 FORMAT "%5.1" ECU_ADDRESS 0x7000A3A3 /end MEASUREMENT
/begin MEASUREMENT CrCUI_ctCancelSwtDeb_mp "Counter for debouncing cancel switch status" UBYTE OneToOne 1 100 0.00 255.0 FORMAT "%5.1" ECU_ADDRESS 0x7000A3A2 /end MEASUREMENT
/begin MEASUREMENT CrCUI_ctCANRxErr1_mp "Counter value for CAN Rx Main Switch receive error" UBYTE OneToOne 1 100 0.00 255.0 FORMAT "%5.1" ECU_ADDRESS 0x7000A3A1 /end MEASUREMENT
/begin MEASUREMENT CrCUI_ctCANRxErr_mp "Counter for debouncing the CAN recieve error" UBYTE OneToOne 1 100 0.00 255.0 FORMAT "%5.1" ECU_ADDRESS 0x7000A3A0 /end MEASUREMENT
/begin MEASUREMENT CrCUI_ctCrsSwtErr_mp "Counter of Cruise control switch error detection" UWORD OneToOne 1 100 0.00 65535.00 FORMAT "%8.2" ECU_ADDRESS 0x7000A39E /end MEASUREMENT
/begin MEASUREMENT CrCUI_ctCrsSwtFild_mp "Counter of Cruise control switch filter" UBYTE OneToOne 1 100 0.00 255.0 FORMAT "%5.1" ECU_ADDRESS 0x7000A39C /end MEASUREMENT
/begin MEASUREMENT CrCUI_ctEAT2RxErr_mp "Counter of EAT2 communication error check" UBYTE OneToOne 1 100 0.00 255.0 FORMAT "%5.1" ECU_ADDRESS 0x7000A39B /end MEASUREMENT
/begin MEASUREMENT CrCUI_ctMainSwtDeb_mp "Counter for debouncing main switch status" UBYTE OneToOne 1 100 0.00 255.0 FORMAT "%5.1" ECU_ADDRESS 0x7000A39A /end MEASUREMENT
/begin MEASUREMENT CrCUI_ctResSwtDeb_mp "Counter for debouncing resume switch status" UBYTE OneToOne 1 100 0.00 255.0 FORMAT "%5.1" ECU_ADDRESS 0x7000A399 /end MEASUREMENT
/begin MEASUREMENT CrCUI_ctResuOnSpdUpd "Counter of updated vehicle speed during Res SW is on" UWORD OneToOne 1 100 0.00 65535.00 FORMAT "%8.2" ECU_ADDRESS 0x60008CDA /end MEASUREMENT
/begin MEASUREMENT CrCUI_ctSetOnSpdUpd "Counter of updated vehicle speed during Set SW is on" UWORD OneToOne 1 100 0.00 65535.00 FORMAT "%8.2" ECU_ADDRESS 0x60008CD8 /end MEASUREMENT
/begin MEASUREMENT CrCUI_ctSetSwtDeb_mp "Counter for debouncing set switch status" UBYTE OneToOne 1 100 0.00 255.0 FORMAT "%5.1" ECU_ADDRESS 0x7000A398 /end MEASUREMENT
/begin MEASUREMENT CrCUI_flgAutoBrkActvChk "Flag for autobrake active check" UBYTE OneToOne 1 100 0.00 255.0 FORMAT "%5.1" ECU_ADDRESS 0x6000F4EE /end MEASUREMENT
/begin MEASUREMENT CrCUI_flgClrEEPROM "The clear EEPROM flag" UBYTE B_TRUE 1 100 0.00 1.00000000000 BIT_MASK 0x1 FORMAT "%13.11" ECU_ADDRESS 0x60001074 /end MEASUREMENT
/begin MEASUREMENT CrCUI_flgCrCUICANRxNorm "Cruise control user interface CAN Rx normal. (FId_CrCUICANRxErr is not inhibited)" UBYTE B_TRUE 1 100 0.00 1.00000000000 BIT_MASK 0x1 FORMAT "%13.11" ECU_ADDRESS 0x6000F157 /end MEASUREMENT
/begin MEASUREMENT CrCUI_flgCrsCtrlShtOffEngNorm "Cruise control shut off engine normal. (FId_CrCtlShutOffEng is not inhibited)" UBYTE B_TRUE 1 100 0.00 1.00000000000 BIT_MASK 0x1 FORMAT "%13.11" ECU_ADDRESS 0x6000F156 /end MEASUREMENT
/begin MEASUREMENT CrCUI_nACCBrkCnclLoLim_mp "ACC auto brake cancel Low limit Ne value" SWORD EngNCrCtl 1 100 -32768.00 32767.00 FORMAT "%8.2" ECU_ADDRESS 0x7000A396 /end MEASUREMENT
/begin MEASUREMENT CrCUI_nCnclLoLim_mp "Cruise Control cancel Low limit Ne value" SWORD EngNCrCtl 1 100 -32768.00 32767.00 FORMAT "%8.2" ECU_ADDRESS 0x7000A394 /end MEASUREMENT
/begin MEASUREMENT CrCUI_nEngSpd "Engine speed for CrCtl" SWORD EngNCrCtl 1 100 -32768.00 32767.00 FORMAT "%8.2" ECU_ADDRESS 0x60009230 /end MEASUREMENT
/begin MEASUREMENT CrCUI_nFlt "Filtered Ne value for Cruise Control" SWORD EngNCrCtl 1 100 -32768.00 32767.00 FORMAT "%8.2" ECU_ADDRESS 0x6000922E /end MEASUREMENT
/begin MEASUREMENT CrCUI_nFltDiff "Cruise Control difference Filtered Ne value" SWORD EngNCrCtl 1 100 -32768.00 32767.00 FORMAT "%8.2" ECU_ADDRESS 0x6000922C /end MEASUREMENT
/begin MEASUREMENT CrCUI_nFltOld_mp "Old Filtered Ne value for Cruise Control" SWORD EngNCrCtl 1 100 -32768.00 32767.00 FORMAT "%8.2" ECU_ADDRESS 0x7000A392 /end MEASUREMENT
/begin MEASUREMENT CrCUI_nLIDes "engine speed setpoint of Low Idle Governor for Cruise Control" SWORD EngNCrCtl 1 100 -32768.00 32767.00 FORMAT "%8.2" ECU_ADDRESS 0x6000922A /end MEASUREMENT
/begin MEASUREMENT CrCUI_nShftDnReq_mp "Shift down request Ne Check value" SWORD EngNCrCtl 1 100 -32768.00 32767.00 FORMAT "%8.2" ECU_ADDRESS 0x7000A390 /end MEASUREMENT
/begin MEASUREMENT CrCUI_numGearPosnADAS "Current Gear position information for Valeo-ADAS" UBYTE OneToOne 1 100 0.00 255.0 FORMAT "%5.1" ECU_ADDRESS 0x6000F4ED /end MEASUREMENT
/begin MEASUREMENT CrCUI_numLSF "State of LSF mode selection for ACC" UBYTE OneToOne 1 100 0.00 255.0 FORMAT "%5.1" ECU_ADDRESS 0x6000F4EC /end MEASUREMENT
/begin MEASUREMENT CrCUI_numSelMode "State of mode selection of CCASLISA 0:CC 1:ASL 2:ISA" UBYTE OneToOne 1 100 0.00 255.0 FORMAT "%5.1" ECU_ADDRESS 0x6000F4EB /end MEASUREMENT
/begin MEASUREMENT CrCUI_numTSRLimSpd "The traffic signature information which TSR detects(including the speed limiting signature)" UBYTE OneToOne 1 100 0.00 255.0 FORMAT "%5.1" ECU_ADDRESS 0x6000F4EA /end MEASUREMENT
/begin MEASUREMENT CrCUI_rNvAbs0_mp "absolute value of ratio n/v 0" SLONG NToVel_CrCtl 1 100 -8388608.00000 8388607.99609 FORMAT "%13.5" ECU_ADDRESS 0x7000A38C /end MEASUREMENT
/begin MEASUREMENT CrCUI_rNvAbs1_mp "absolute value of ratio n/v 1" SLONG NToVel_CrCtl 1 100 -8388608.00000 8388607.99609 FORMAT "%13.5" ECU_ADDRESS 0x7000A388 /end MEASUREMENT
/begin MEASUREMENT CrCUI_rNvAbs2_mp "absolute value of ratio n/v 2" SLONG NToVel_CrCtl 1 100 -8388608.00000 8388607.99609 FORMAT "%13.5" ECU_ADDRESS 0x7000A384 /end MEASUREMENT
/begin MEASUREMENT CrCUI_rNvAbs3_mp "absolute value of ratio n/v 3" SLONG NToVel_CrCtl 1 100 -8388608.00000 8388607.99609 FORMAT "%13.5" ECU_ADDRESS 0x7000A380 /end MEASUREMENT
/begin MEASUREMENT CrCUI_rNvAbs4_mp "absolute value of ratio n/v 4" SLONG NToVel_CrCtl 1 100 -8388608.00000 8388607.99609 FORMAT "%13.5" ECU_ADDRESS 0x7000A37C /end MEASUREMENT
/begin MEASUREMENT CrCUI_rNvSubsGear5_mp "value of ratio n/v data 5 - Gear Down Check value 5" SLONG NToVel_CrCtl 1 100 -8388608.00000 8388607.99609 FORMAT "%13.5" ECU_ADDRESS 0x7000A378 /end MEASUREMENT
/begin MEASUREMENT CrCUI_rNv_mp "stored ratio engine speed to vehicle speed" SLONG NToVel_CrCtl 1 100 -8388608.00000 8388607.99609 FORMAT "%13.5" ECU_ADDRESS 0x7000A374 /end MEASUREMENT
/begin MEASUREMENT CrCUI_stACCASLErrTmrIdc_mp "Status of ACC/ASL switch error continuous check timer indication" UBYTE OneToOne 1 100 0.00 255.0 FORMAT "%5.1" ECU_ADDRESS 0x7000A373 /end MEASUREMENT
/begin MEASUREMENT CrCUI_stACCASLSwtErrDet "Status of ACCASL switch error detection" UBYTE OneToOne 1 100 0.00 255.0 FORMAT "%5.1" ECU_ADDRESS 0x6000F4E9 /end MEASUREMENT
/begin MEASUREMENT CrCUI_stACCASLSwtFild_mp "Status of Filtered ACC/ASL switch information" UBYTE OneToOne 1 100 0.00 255.0 FORMAT "%5.1" ECU_ADDRESS 0x7000A372 /end MEASUREMENT
/begin MEASUREMENT CrCUI_stACCASLSwtOld_mp "Status of ACC/ASL switch information old value" UBYTE OneToOne 1 100 0.00 255.0 FORMAT "%5.1" ECU_ADDRESS 0x7000A371 /end MEASUREMENT
/begin MEASUREMENT CrCUI_stACCBrkCnclReq "Status of ACC auto brake cancel request flag" UBYTE OneToOne 1 100 0.00 255.0 FORMAT "%5.1" ECU_ADDRESS 0x6000F4E8 /end MEASUREMENT
/begin MEASUREMENT CrCUI_stACCClthCont "Status value for ACC Clutch Control" UBYTE OneToOne 1 100 0.00 255.0 FORMAT "%5.1" ECU_ADDRESS 0x6000F4E7 /end MEASUREMENT
/begin MEASUREMENT CrCUI_stACCClthOn "Status for ACC Clutch on flag" UBYTE OneToOne 1 100 0.00 255.0 FORMAT "%5.1" ECU_ADDRESS 0x6000F4E6 /end MEASUREMENT
/begin MEASUREMENT CrCUI_stACCNoUpdReq "Status of Vehicle speed display not update request for ACC" UBYTE OneToOne 1 100 0.00 255.0 FORMAT "%5.1" ECU_ADDRESS 0x6000F4E5 /end MEASUREMENT
/begin MEASUREMENT CrCUI_stACCSpdIndTrg "tatus for Coast/Accel Vehicle speed display trigger flag" UBYTE OneToOne 1 100 0.00 255.0 FORMAT "%5.1" ECU_ADDRESS 0x6000F4E4 /end MEASUREMENT
/begin MEASUREMENT CrCUI_stASLMainDeb "Status of after decided main sw for ASL" UBYTE OneToOne 1 100 0.00 255.0 FORMAT "%5.1" ECU_ADDRESS 0x6000F4E3 /end MEASUREMENT
/begin MEASUREMENT CrCUI_stASLSpdNoUpdReq "Status of desired vehicle speed display no update request" UBYTE OneToOne 1 100 0.00 255.0 FORMAT "%5.1" ECU_ADDRESS 0x6000F4E2 /end MEASUREMENT
/begin MEASUREMENT CrCUI_stASLtoISASpdLim "Flag indicates that speed limiting control will continue in ISA at the transition from ASL to ISA via LIM SW" UBYTE OneToOne 1 100 0.00 255.0 FORMAT "%5.1" ECU_ADDRESS 0x6000F4E1 /end MEASUREMENT
/begin MEASUREMENT CrCUI_stATShft "Shift position flag in CC_AT vehicles." UBYTE OneToOne 1 100 0.00 255.0 FORMAT "%5.1" ECU_ADDRESS 0x6000F4E0 /end MEASUREMENT
/begin MEASUREMENT CrCUI_stAYCCond "Status value for AYC condition" UBYTE OneToOne 1 100 0.00 255.0 FORMAT "%5.1" ECU_ADDRESS 0x6000F4DF /end MEASUREMENT
/begin MEASUREMENT CrCUI_stBkupChk "Status of backup ram check for CC-ASL" UBYTE OneToOne 1 100 0.00 255.0 FORMAT "%5.1" ECU_ADDRESS 0x6000F4DE /end MEASUREMENT
/begin MEASUREMENT CrCUI_stCancelSwt "Status value of CANCEL SW" UBYTE OneToOne 1 100 0.00 255.0 FORMAT "%5.1" ECU_ADDRESS 0x6000F4DB /end MEASUREMENT
/begin MEASUREMENT CrCUI_stCANRxErr "Status of CAN Rx error" UBYTE OneToOne 1 100 0.00 255.0 FORMAT "%5.1" ECU_ADDRESS 0x6000F4DD /end MEASUREMENT
/begin MEASUREMENT CrCUI_stCCASLMETVehUnFlt_mp "The vehicle speed unit for CC-ASL after filter" UBYTE OneToOne 1 100 0.00 255.0 FORMAT "%5.1" ECU_ADDRESS 0x7000A370 /end MEASUREMENT
/begin MEASUREMENT CrCUI_stCCASLVehUn "Status of vehicle speed unit for CC/ASL" UBYTE OneToOne 1 100 0.00 255.0 FORMAT "%5.1" ECU_ADDRESS 0x6000F4DC /end MEASUREMENT
/begin MEASUREMENT CrCUI_stCCSpdDispExist "Cruise Control Set-speed-display is exist or not" UBYTE OneToOne 1 100 0.00 255.0 BIT_MASK 0x1 FORMAT "%5.1" ECU_ADDRESS 0x6000F155 /end MEASUREMENT
/begin MEASUREMENT CrCUI_stClthCond "Status value for Clutch condition" UBYTE OneToOne 1 100 0.00 255.0 FORMAT "%5.1" ECU_ADDRESS 0x6000F4DA /end MEASUREMENT
/begin MEASUREMENT CrCUI_stClu "Status of Clutch status for ACC" UBYTE OneToOne 1 100 0.00 255.0 FORMAT "%5.1" ECU_ADDRESS 0x6000F4D9 /end MEASUREMENT
/begin MEASUREMENT CrCUI_stCluOld_mp "Status of old clutch status for ACC" UBYTE OneToOne 1 100 0.00 255.0 FORMAT "%5.1" ECU_ADDRESS 0x7000A36F /end MEASUREMENT
/begin MEASUREMENT CrCUI_stCmftDrvMod "Status of Comfort drive mode active" UBYTE OneToOne 1 100 0.00 255.0 FORMAT "%5.1" ECU_ADDRESS 0x6000F154 /end MEASUREMENT
/begin MEASUREMENT CrCUI_stCntFstChk "Status for ACCEL/COAST Vehicle speed display first countup check" UBYTE OneToOne 1 100 0.00 255.0 FORMAT "%5.1" ECU_ADDRESS 0x6000F4D8 /end MEASUREMENT
/begin MEASUREMENT CrCUI_stCrsASLSelFild "Status of Filtered CCASL select switch condition" UBYTE OneToOne 1 100 0.00 255.0 FORMAT "%5.1" ECU_ADDRESS 0x6000F4D7 /end MEASUREMENT
/begin MEASUREMENT CrCUI_stCrsASLSelFildOld_mp "Old filtered value of CC\ASL select switch information(CrCUI_stCrsASLSelFild)" UBYTE OneToOne 1 100 0.00 255.0 FORMAT "%5.1" ECU_ADDRESS 0x7000A36E /end MEASUREMENT
/begin MEASUREMENT CrCUI_stCrsASLSelRes_mp "Status of Filtered CC/ASL select result" UBYTE OneToOne 1 100 0.00 255.0 FORMAT "%5.1" ECU_ADDRESS 0x7000A36D /end MEASUREMENT
/begin MEASUREMENT CrCUI_stCrsErrTmrIdc_mp "Status of Cruise control switch error continuous check timer indication" UBYTE OneToOne 1 100 0.00 255.0 FORMAT "%5.1" ECU_ADDRESS 0x7000A36C /end MEASUREMENT
/begin MEASUREMENT CrCUI_stCrsSwtErrDet "Status of Cruise control switch error detection" UBYTE OneToOne 1 100 0.00 255.0 FORMAT "%5.1" ECU_ADDRESS 0x6000F4D6 /end MEASUREMENT
/begin MEASUREMENT CrCUI_stCrsSwtFild "Status of Filtered Cruise Switch" UBYTE OneToOne 1 100 0.00 255.0 FORMAT "%5.1" ECU_ADDRESS 0x6000F4D5 /end MEASUREMENT
/begin MEASUREMENT CrCUI_stCrsSwtFildOld_mp "Status of Filtered Cruise control switch information old value" UBYTE OneToOne 1 100 0.00 255.0 FORMAT "%5.1" ECU_ADDRESS 0x7000A36B /end MEASUREMENT
/begin MEASUREMENT CrCUI_stCrsSwtOld_mp "Status of Cruise control switch information old value" UBYTE OneToOne 1 100 0.00 255.0 FORMAT "%5.1" ECU_ADDRESS 0x7000A36A /end MEASUREMENT
/begin MEASUREMENT CrCUI_stCvtLmap "Status of L positions for CVT" UBYTE OneToOne 1 100 0.00 1.000 FORMAT "%5.3" ECU_ADDRESS 0x6000F4D4 /end MEASUREMENT
/begin MEASUREMENT CrCUI_stEAT2RxErr "Status of EAT2 communication error" UBYTE OneToOne 1 100 0.00 255.0 FORMAT "%5.1" ECU_ADDRESS 0x6000F4D3 /end MEASUREMENT
/begin MEASUREMENT CrCUI_stEcoDrvMod "Status of ECON drive mode active" UBYTE OneToOne 1 100 0.00 255.0 FORMAT "%5.1" ECU_ADDRESS 0x6000F153 /end MEASUREMENT
/begin MEASUREMENT CrCUI_stECONActv "Status of ECON active for Cruise control" UBYTE OneToOne 1 100 0.00 255.0 FORMAT "%5.1" ECU_ADDRESS 0x6000F4D2 /end MEASUREMENT
/begin MEASUREMENT CrCUI_stECONActvOld "Status of Old ECON active for Cruise control" UBYTE OneToOne 1 100 0.00 255.0 FORMAT "%5.1" ECU_ADDRESS 0x6000F4D1 /end MEASUREMENT
/begin MEASUREMENT CrCUI_stFctInfo "Status of CCACCASL function equipped" UBYTE OneToOne 1 100 0.00 255.0 FORMAT "%5.1" ECU_ADDRESS 0x6000F4CF /end MEASUREMENT
/begin MEASUREMENT CrCUI_stFiSysFailCond "Status value for Fi system fail condition" UBYTE OneToOne 1 100 0.00 255.0 FORMAT "%5.1" ECU_ADDRESS 0x6000F4CE /end MEASUREMENT
/begin MEASUREMENT CrCUI_stFWDPos "Forward shift position flag for AT\CVT" UBYTE OneToOne 1 100 0.00 255.0 FORMAT "%5.1" ECU_ADDRESS 0x6000F4D0 /end MEASUREMENT
/begin MEASUREMENT CrCUI_stGearDownNo "Status value for Gear Down No" UBYTE OneToOne 1 100 0.00 255.0 FORMAT "%5.1" ECU_ADDRESS 0x6000F4CD /end MEASUREMENT
/begin MEASUREMENT CrCUI_stISAContTSRClr "ISA control continuation information when TSR is cleared" UBYTE OneToOne 1 100 0.00 255.0 FORMAT "%5.1" ECU_ADDRESS 0x6000F4CC /end MEASUREMENT
/begin MEASUREMENT CrCUI_stISAModeMnSW "ISA mode Main SW status" UBYTE OneToOne 1 100 0.00 255.0 FORMAT "%5.1" ECU_ADDRESS 0x6000F4CB /end MEASUREMENT
/begin MEASUREMENT CrCUI_stISAtoASLbyResSet "Flag indicates that transition from ISA to ASL happens due to operation of RES (+)SET (-) during ISA." UBYTE OneToOne 1 100 0.00 255.0 FORMAT "%5.1" ECU_ADDRESS 0x6000F4CA /end MEASUREMENT
/begin MEASUREMENT CrCUI_stKeyRead "status of key read from inputs" UBYTE OneToOne 1 100 0.00 255.0 FORMAT "%5.1" ECU_ADDRESS 0x6000F4C9 /end MEASUREMENT
/begin MEASUREMENT CrCUI_stLowGearCancel "Status value for Low Gear cancel" UBYTE OneToOne 1 100 0.00 255.0 FORMAT "%5.1" ECU_ADDRESS 0x6000F4C7 /end MEASUREMENT
/begin MEASUREMENT CrCUI_stLSFStpJdg "Status of LSF stop judgement" UBYTE OneToOne 1 100 0.00 255.0 FORMAT "%5.1" ECU_ADDRESS 0x6000F4C8 /end MEASUREMENT
/begin MEASUREMENT CrCUI_stMainDeb "Status of after decided main sw for cruise control" UBYTE OneToOne 1 100 0.00 255.0 FORMAT "%5.1" ECU_ADDRESS 0x6000F4C5 /end MEASUREMENT
/begin MEASUREMENT CrCUI_stMaiSwtInter_mp "Status of Cruise control Main switch condition(intermediate value)" UBYTE OneToOne 1 100 0.00 255.0 FORMAT "%5.1" ECU_ADDRESS 0x7000A369 /end MEASUREMENT
/begin MEASUREMENT CrCUI_stMETCustInfoFlt_mp "Status of meter customize information after filter" UBYTE OneToOne 1 100 0.00 255.0 FORMAT "%5.1" ECU_ADDRESS 0x7000A368 /end MEASUREMENT
/begin MEASUREMENT CrCUI_stMETSpdDspEna "Status for display control vehicle speed in meter panel" UBYTE OneToOne 1 100 0.00 255.0 FORMAT "%5.1" ECU_ADDRESS 0x6000F4C6 /end MEASUREMENT
/begin MEASUREMENT CrCUI_stModeChgCncl "Flag indicates that the mode transition within CC\ASL\ISA is going to happen." UBYTE OneToOne 1 100 0.00 255.0 FORMAT "%5.1" ECU_ADDRESS 0x6000F4C4 /end MEASUREMENT
/begin MEASUREMENT CrCUI_stNeDnCncl "Status of Cruise Control Cancel from Ne down flag" UBYTE OneToOne 1 100 0.00 255.0 FORMAT "%5.1" ECU_ADDRESS 0x6000F4C3 /end MEASUREMENT
/begin MEASUREMENT CrCUI_stNeUpCncl "Status of Cruise Control Cancel from Ne Up flag" UBYTE OneToOne 1 100 0.00 255.0 FORMAT "%5.1" ECU_ADDRESS 0x6000F4C2 /end MEASUREMENT
/begin MEASUREMENT CrCUI_stShftDnReq "Status of Driver Shift down request flag" UBYTE OneToOne 1 100 0.00 255.0 FORMAT "%5.1" ECU_ADDRESS 0x6000F4C1 /end MEASUREMENT
/begin MEASUREMENT CrCUI_stShftDnRls_mp "Status value for Shift Down Release condition 0 to 4" UBYTE OneToOne 1 100 0.00 255.0 FORMAT "%5.1" ECU_ADDRESS 0x7000A367 /end MEASUREMENT
/begin MEASUREMENT CrCUI_stShftPosCANErr "CAN error flag related to shift position information for AT\CVT" UBYTE OneToOne 1 100 0.00 255.0 FORMAT "%5.1" ECU_ADDRESS 0x6000F4C0 /end MEASUREMENT
/begin MEASUREMENT CrCUI_stSptDrvMod "Status of Sport drive mode active" UBYTE OneToOne 1 100 0.00 255.0 FORMAT "%5.1" ECU_ADDRESS 0x6000F151 /end MEASUREMENT
/begin MEASUREMENT CrCUI_stSwtBrkMnDeb "Status value of Brake Main SW" UBYTE OneToOne 1 100 0.00 255.0 FORMAT "%5.1" ECU_ADDRESS 0x6000F4BF /end MEASUREMENT
/begin MEASUREMENT CrCUI_stSwtBrkMnLSF "Status value of Brake Main SW for LSF" UBYTE OneToOne 1 100 0.00 255.0 FORMAT "%5.1" ECU_ADDRESS 0x6000F4BE /end MEASUREMENT
/begin MEASUREMENT CrCUI_stSwtBrkMnOld "Old status value of Brake Main SW" UBYTE OneToOne 1 100 0.00 255.0 FORMAT "%5.1" ECU_ADDRESS 0x6000F4BD /end MEASUREMENT
/begin MEASUREMENT CrCUI_stSwtBrkRedDeb "Status value of Brake Redundant SW" UBYTE OneToOne 1 100 0.00 255.0 FORMAT "%5.1" ECU_ADDRESS 0x6000F4BC /end MEASUREMENT
/begin MEASUREMENT CrCUI_stSwtBrkRedLSF "Status value of Brake Redundant SW for LSF" UBYTE OneToOne 1 100 0.00 255.0 FORMAT "%5.1" ECU_ADDRESS 0x6000F4BB /end MEASUREMENT
/begin MEASUREMENT CrCUI_stSwtBrkRedOld "Old status value of Brake Redundant SW" UBYTE OneToOne 1 100 0.00 255.0 FORMAT "%5.1" ECU_ADDRESS 0x6000F4BA /end MEASUREMENT
/begin MEASUREMENT CrCUI_stSwtClthDeb "Status value for Clutch SW" UBYTE OneToOne 1 100 0.00 255.0 FORMAT "%5.1" ECU_ADDRESS 0x6000F4B9 /end MEASUREMENT
/begin MEASUREMENT CrCUI_stSwtMainDeb_mp "Status value of MAIN SW" UBYTE OneToOne 1 100 0.00 255.0 FORMAT "%5.1" ECU_ADDRESS 0x7000A366 /end MEASUREMENT
/begin MEASUREMENT CrCUI_stSwtOnSpdUpd "Status of updated vehicle speed during Res SW is on" UBYTE OneToOne 1 100 0.00 255.0 FORMAT "%5.1" ECU_ADDRESS 0x6000F4B8 /end MEASUREMENT
/begin MEASUREMENT CrCUI_stSwtOpErr "Status for SW operation Error" UBYTE OneToOne 1 100 0.00 255.0 FORMAT "%5.1" ECU_ADDRESS 0x6000F4B7 /end MEASUREMENT
/begin MEASUREMENT CrCUI_stSwtResDeb_mp "Status value of RESUME SW" UBYTE OneToOne 1 100 0.00 255.0 FORMAT "%5.1" ECU_ADDRESS 0x7000A365 /end MEASUREMENT
/begin MEASUREMENT CrCUI_stSwtResNo "Status for RESUME SW condition No" UBYTE OneToOne 1 100 0.00 255.0 FORMAT "%5.1" ECU_ADDRESS 0x6000F4B6 /end MEASUREMENT
/begin MEASUREMENT CrCUI_stSwtSetDeb_mp "Status value of SET SW" UBYTE OneToOne 1 100 0.00 255.0 FORMAT "%5.1" ECU_ADDRESS 0x7000A364 /end MEASUREMENT
/begin MEASUREMENT CrCUI_stSwtSetNo "Status for SET SW condition No" UBYTE OneToOne 1 100 0.00 255.0 FORMAT "%5.1" ECU_ADDRESS 0x6000F4B5 /end MEASUREMENT
/begin MEASUREMENT CrCUI_stTmrEndChk "Status for ACCEL/COAST timer end check" UBYTE OneToOne 1 100 0.00 255.0 FORMAT "%5.1" ECU_ADDRESS 0x6000F4B3 /end MEASUREMENT
/begin MEASUREMENT CrCUI_stTSRErr "Status of TSR error (CAN communication error, TSR failure, or TSR function temporary stops)" UBYTE OneToOne 1 100 0.00 255.0 FORMAT "%5.1" ECU_ADDRESS 0x6000F4B4 /end MEASUREMENT
/begin MEASUREMENT CrCUI_stVehUn "Status of vehicle speed unit for cruise control" UBYTE OneToOne 1 100 0.00 255.0 FORMAT "%5.1" ECU_ADDRESS 0x6000F4B2 /end MEASUREMENT
/begin MEASUREMENT CrCUI_swtMETTyp "Status of vehicle speed unit for CC/ASL" UBYTE OneToOne 1 100 0.00 255.0 FORMAT "%5.1" ECU_ADDRESS 0x6000F4B1 /end MEASUREMENT
/begin MEASUREMENT CrCUI_tiACCAppSpdChng_mp "Timer for Accel Vehicle speed display Check" SWORD Time_ms_100ms 1 100 -3276800. 3276700. FORMAT "%8.0" ECU_ADDRESS 0x7000A362 /end MEASUREMENT
/begin MEASUREMENT CrCUI_tiACCASLContnsErr_mp "Timer of ACC/ASL switch error continuous check" SWORD Time_ms 1 100 -327680.0 327670.0 FORMAT "%8.1" ECU_ADDRESS 0x7000A360 /end MEASUREMENT
/begin MEASUREMENT CrCUI_tiACCClthCncl_mp "Timer for ACC Clutch SW Cancel Check" SWORD Time_ms 1 100 -327680.0 327670.0 FORMAT "%8.1" ECU_ADDRESS 0x7000A35E /end MEASUREMENT
/begin MEASUREMENT CrCUI_tiACCClthUpdExtn_mp "Timer of updating clutch status extension for ACC" SWORD Time_ms 1 100 -327680.0 327670.0 FORMAT "%8.1" ECU_ADDRESS 0x7000A35C /end MEASUREMENT
/begin MEASUREMENT CrCUI_tiACCCoaSpdChng_mp "Timer for Coast Vehicle speed display Check" SWORD Time_ms_100ms 1 100 -3276800. 3276700. FORMAT "%8.0" ECU_ADDRESS 0x7000A35A /end MEASUREMENT
/begin MEASUREMENT CrCUI_tiACCSpdNoUpdRes_mp "Timer for Accel Vehicle speed display not update request Check" SWORD Time_ms 1 100 -327680.0 327670.0 FORMAT "%8.1" ECU_ADDRESS 0x7000A358 /end MEASUREMENT
/begin MEASUREMENT CrCUI_tiACCSpdNoUpdSet_mp "Timer for Coast Vehicle speed display not update request Check" SWORD Time_ms 1 100 -327680.0 327670.0 FORMAT "%8.1" ECU_ADDRESS 0x7000A356 /end MEASUREMENT
/begin MEASUREMENT CrCUI_tiAutoBrkActvChk "Timer for Auto Brake Active check." SWORD Time_ms 1 100 -327680.0 327670.0 FORMAT "%8.1" ECU_ADDRESS 0x60009228 /end MEASUREMENT
/begin MEASUREMENT CrCUI_tiAYCCond_mp "Timer of AYC condition check time" SWORD Time_ms 1 100 -327680.0 327670.0 FORMAT "%8.1" ECU_ADDRESS 0x7000A354 /end MEASUREMENT
/begin MEASUREMENT CrCUI_tiCCASLMETVehUnFlt_mp "Timer of filter for CC-ASL vehicle speed unit" SWORD Time_ms 1 100 -327680.0 327670.0 FORMAT "%8.1" ECU_ADDRESS 0x7000A352 /end MEASUREMENT
/begin MEASUREMENT CrCUI_tiCrsASLSelInfo_mp "Timer of CC/ASL select information" SWORD Time_ms 1 100 -327680.0 327670.0 FORMAT "%8.1" ECU_ADDRESS 0x7000A350 /end MEASUREMENT
/begin MEASUREMENT CrCUI_tiCrsContnsErr_mp "Timer of Cruise control switch error continuous check" SWORD Time_ms 1 100 -327680.0 327670.0 FORMAT "%8.1" ECU_ADDRESS 0x7000A34E /end MEASUREMENT
/begin MEASUREMENT CrCUI_tiFWDpos_mp "FWD position judgement timer in CC_AT vehicles" SWORD Time_ms 1 100 -327680.0 327670.0 FORMAT "%8.1" ECU_ADDRESS 0x7000A34C /end MEASUREMENT
/begin MEASUREMENT CrCUI_tiGearOff_mp "Timer for Gear off Check" SWORD Time_ms 1 100 -327680.0 327670.0 FORMAT "%8.1" ECU_ADDRESS 0x7000A34A /end MEASUREMENT
/begin MEASUREMENT CrCUI_tiLSFStpJdgHysHi_mp "Timer for upper threshold for LSF stop judgement hysterisis" SWORD Time_ms 1 100 -327680.0 327670.0 FORMAT "%8.1" ECU_ADDRESS 0x7000A348 /end MEASUREMENT
/begin MEASUREMENT CrCUI_tiLSFStpJdgHysLo_mp "Timer for lower threshold for LSF stop judgement hysterisis" SWORD Time_ms 1 100 -327680.0 327670.0 FORMAT "%8.1" ECU_ADDRESS 0x7000A346 /end MEASUREMENT
/begin MEASUREMENT CrCUI_tiMETCustInfoFlt_mp "Timer of filter for CC-ASL vehicle speed unit" SWORD Time_ms 1 100 -327680.0 327670.0 FORMAT "%8.1" ECU_ADDRESS 0x7000A344 /end MEASUREMENT
/begin MEASUREMENT CrCUI_tiResuOnSpdUpd_mp "Timre of updated vehicle speed during Res SW is on" SWORD Time_ms_100ms 1 100 -3276800. 3276700. FORMAT "%8.0" ECU_ADDRESS 0x7000A342 /end MEASUREMENT
/begin MEASUREMENT CrCUI_tiSetOnSpdUpd_mp "Timre of updated vehicle speed during Set SW is on" SWORD Time_ms_100ms 1 100 -3276800. 3276700. FORMAT "%8.0" ECU_ADDRESS 0x7000A340 /end MEASUREMENT
/begin MEASUREMENT CrCUI_tiShftDn0Det_mp "Timer for Shift Down 0 Detect Check" SWORD Time_ms 1 100 -327680.0 327670.0 FORMAT "%8.1" ECU_ADDRESS 0x7000A33E /end MEASUREMENT
/begin MEASUREMENT CrCUI_tiShftDn0Rls_mp "Timer for Shift Down 0 Rlease Check" SWORD Time_ms 1 100 -327680.0 327670.0 FORMAT "%8.1" ECU_ADDRESS 0x7000A33C /end MEASUREMENT
/begin MEASUREMENT CrCUI_tiShftDn1Det_mp "Timer for Shift Down 1 Detect Check" SWORD Time_ms 1 100 -327680.0 327670.0 FORMAT "%8.1" ECU_ADDRESS 0x7000A33A /end MEASUREMENT
/begin MEASUREMENT CrCUI_tiShftDn1Rls_mp "TTimer for Shift Down 1 Rlease Check" SWORD Time_ms 1 100 -327680.0 327670.0 FORMAT "%8.1" ECU_ADDRESS 0x7000A338 /end MEASUREMENT
/begin MEASUREMENT CrCUI_tiShftDn2Det_mp "Timer for Shift Down 2 Detect Check" SWORD Time_ms 1 100 -327680.0 327670.0 FORMAT "%8.1" ECU_ADDRESS 0x7000A336 /end MEASUREMENT
/begin MEASUREMENT CrCUI_tiShftDn2Rls_mp "TTimer for Shift Down 2 Rlease Check" SWORD Time_ms 1 100 -327680.0 327670.0 FORMAT "%8.1" ECU_ADDRESS 0x7000A334 /end MEASUREMENT
/begin MEASUREMENT CrCUI_tiShftDn3Det_mp "Timer for Shift Down 3 Detect Check" SWORD Time_ms 1 100 -327680.0 327670.0 FORMAT "%8.1" ECU_ADDRESS 0x7000A332 /end MEASUREMENT
/begin MEASUREMENT CrCUI_tiShftDn3Rls_mp "TTimer for Shift Down 3 Rlease Check" SWORD Time_ms 1 100 -327680.0 327670.0 FORMAT "%8.1" ECU_ADDRESS 0x7000A330 /end MEASUREMENT
/begin MEASUREMENT CrCUI_tiShftDn4Det_mp "Timer for Shift Down 4 Detect Check" SWORD Time_ms 1 100 -327680.0 327670.0 FORMAT "%8.1" ECU_ADDRESS 0x7000A32E /end MEASUREMENT
/begin MEASUREMENT CrCUI_tiShftDn4Rls_mp "TTimer for Shift Down 4 Rlease Check" SWORD Time_ms 1 100 -327680.0 327670.0 FORMAT "%8.1" ECU_ADDRESS 0x7000A32C /end MEASUREMENT
/begin MEASUREMENT CrCUI_tiShftDn5Det_mp "Timer for Shift Down 5 Detect Check" SWORD Time_ms 1 100 -327680.0 327670.0 FORMAT "%8.1" ECU_ADDRESS 0x7000A32A /end MEASUREMENT
/begin MEASUREMENT CrCUI_tiSwtBrkMn_mp "Timer for Brake Main SW Check" SWORD Time_ms 1 100 -327680.0 327670.0 FORMAT "%8.1" ECU_ADDRESS 0x7000A328 /end MEASUREMENT
/begin MEASUREMENT CrCUI_tiSwtBrkRed_mp "Timer for Brake Redundant SW Check" SWORD Time_ms 1 100 -327680.0 327670.0 FORMAT "%8.1" ECU_ADDRESS 0x7000A326 /end MEASUREMENT
/begin MEASUREMENT CrCUI_tiSwtClth_mp "Timer for Clutch SW Check" SWORD Time_ms 1 100 -327680.0 327670.0 FORMAT "%8.1" ECU_ADDRESS 0x7000A324 /end MEASUREMENT
/begin MEASUREMENT CrCUI_tiSwtResApp_mp "Timer of Accel check time for RESUME SW" SWORD Time_ms 1 100 -327680.0 327670.0 FORMAT "%8.1" ECU_ADDRESS 0x7000A322 /end MEASUREMENT
/begin MEASUREMENT CrCUI_tiSwtSetCoa_mp "Timer of coast check time for SET SW" SWORD Time_ms 1 100 -327680.0 327670.0 FORMAT "%8.1" ECU_ADDRESS 0x7000A320 /end MEASUREMENT
/begin MEASUREMENT CrCUI_tiTSRErr_mp "Timer for detecting camera temperature abnormality,dirty and breakdown" SWORD Time_ms 1 100 -327680.0 327670.0 FORMAT "%8.1" ECU_ADDRESS 0x7000A31E /end MEASUREMENT
/begin MEASUREMENT CrCUI_vMETSpd "Meter Vehicle Speed for Cruise Control" SLONG Vel_CrCtl 1 100 -8388608.00000 8388607.99609 FORMAT "%13.5" ECU_ADDRESS 0x6000399C /end MEASUREMENT
/begin MEASUREMENT CrCUI_vMETSpd2 "Vehicle speed from meter panel" SLONG Vel_CrCtl 1 100 -8388608.00000 8388607.99609 FORMAT "%13.5" ECU_ADDRESS 0x600039A0 /end MEASUREMENT
/begin MEASUREMENT CtT_stDiagEna "Enable condition for the fault detection of the thermostat diagnosis" UBYTE B_TRUE 1 100 0.00 1.00000000000 BIT_MASK 0x1 FORMAT "%13.11" ECU_ADDRESS 0x6000EE68 /end MEASUREMENT
/begin MEASUREMENT CtT_stReiniMdl "Condition to reset the temperature model for the permanent diagnosis" UBYTE B_TRUE 1 100 0.00 1.00000000000 BIT_MASK 0x1 FORMAT "%13.11" ECU_ADDRESS 0x6000EE67 /end MEASUREMENT
/begin MEASUREMENT DcmDspUds_DID_requestIBChk "Internal variable to request the Info Block check internaly" UBYTE DcmDspUds_DID_requestIBChk_Cnv 1 100 0.00 2.00000000000 FORMAT "%13.11" ECU_ADDRESS 0x600008A6 /end MEASUREMENT
/begin MEASUREMENT Dcm_stCallWr "Call state of writing information into EEPROM" UBYTE OneToOne 1 100 0.00 255.0 FORMAT "%5.1" ECU_ADDRESS 0x6000F464 /end MEASUREMENT
/begin MEASUREMENT DCM_stCurrDiagcSession "Status message for Currently active diagnostic session" UWORD OneToOne 1 100 0.00 65535.00 FORMAT "%8.2" ECU_ADDRESS 0x600094D8 /end MEASUREMENT
/begin MEASUREMENT Dcm_stEepOrder "EEPROM order state of writing information into EEPROM" UBYTE OneToOne 1 100 0.00 255.0 FORMAT "%5.1" ECU_ADDRESS 0x6000F463 /end MEASUREMENT
/begin MEASUREMENT dfbagr_w "difference value correction factor egr (aperture)" UWORD fak_q3p0518Em5 1 100 0.00 1.999969 FORMAT "%8.6" ECU_ADDRESS 0x60001072 /end MEASUREMENT
/begin MEASUREMENT dofvpagr_w "difference value offset correction egr" UWORD rel_q0p00153 1 100 0.00 99.99847 FORMAT "%8.5" ECU_ADDRESS 0x60001070 /end MEASUREMENT
/begin MEASUREMENT I14229_ratEthSp "Ethanol concentration" UWORD rel_q0p1 1 100 0.00 6553.500 FORMAT "%8.3" ECU_ADDRESS 0x60009476 /end MEASUREMENT
/begin MEASUREMENT I14229_rPCSDuty "The PCS duty for SDA EVAP" UBYTE rel_q0p39 1 100 0.00 99.61 FORMAT "%5.2" ECU_ADDRESS 0x6000E835 /end MEASUREMENT
/begin MEASUREMENT I14229_stSuppRst "Suppress reset flag" UBYTE OneToOne 1 100 0.00 255.0 FORMAT "%5.1" ECU_ADDRESS 0x700035F4 /end MEASUREMENT
/begin MEASUREMENT m6sagrf_w_msg "mode 6 - memory: threshold value from diagnosis EGR-flow" UWORD fak_q3p0518Em5 1 100 0.00 1.999969 FORMAT "%8.6" ECU_ADDRESS 0x6000145A /end MEASUREMENT
/begin MEASUREMENT m6sagrx_w "threshold egr mass flow diagnostic" UWORD fak_q3p0518Em5 1 100 0.00 1.999969 FORMAT "%8.6" ECU_ADDRESS 0x60039488 /end MEASUREMENT
/begin MEASUREMENT m6wagrf_w_msg "mode 6 - memory: measured value from diagnosis EGR-flow" UWORD fak_q3p0518Em5 1 100 0.00 1.999969 FORMAT "%8.6" ECU_ADDRESS 0x60001458 /end MEASUREMENT
/begin MEASUREMENT m6wagrx_w "measurement value egr mass flow diagnostic" UWORD fak_q3p0518Em5 1 100 0.00 1.999969 FORMAT "%8.6" ECU_ADDRESS 0x60039486 /end MEASUREMENT
/begin MEASUREMENT RDBIRES_0 "Rdbi resolution bit 0" UBYTE dez 1 100 0.00 255.0 FORMAT "%5.1" ECU_ADDRESS 0x6000E834 /end MEASUREMENT
/begin MEASUREMENT RDBIRES_1 "Rdbi resolution bit 1" UBYTE dez 1 100 0.00 255.0 FORMAT "%5.1" ECU_ADDRESS 0x6000E833 /end MEASUREMENT
/begin MEASUREMENT RDBIRES_2 "Reserve Bit for RDBI with value is 2" UWORD dez 1 100 0.00 65535.00 FORMAT "%8.2" ECU_ADDRESS 0x6000749A /end MEASUREMENT
/begin MEASUREMENT RDBIRES_4 "RDBI reserved value 0x04" UBYTE dez 1 100 0.00 255.0 FORMAT "%5.1" ECU_ADDRESS 0x6000E832 /end MEASUREMENT
/begin MEASUREMENT RDBIRES_FF "RDBI service label" UBYTE dez 1 100 0.00 255.0 FORMAT "%5.1" ECU_ADDRESS 0x6000E831 /end MEASUREMENT
/begin MEASUREMENT RDBI_FIX "RDBI service label" UBYTE dez 1 100 0.00 255.0 FORMAT "%5.1" ECU_ADDRESS 0x6000E830 /end MEASUREMENT
/begin MEASUREMENT RDBI_FIX_1 "Fixed value for RDBI" UBYTE dez 1 100 0.00 255.0 FORMAT "%5.1" ECU_ADDRESS 0x6000E82F /end MEASUREMENT
/begin MEASUREMENT RESERVED_BIT0 "reserved bit 0 flag" UBYTE dez 1 100 0.00 255.0 FORMAT "%5.1" ECU_ADDRESS 0x6000E82E /end MEASUREMENT
/begin MEASUREMENT RESERVED_BIT1 "reserved bit 1 flag" UBYTE dez 1 100 0.00 255.0 FORMAT "%5.1" ECU_ADDRESS 0x6000E82D /end MEASUREMENT
/begin MEASUREMENT SecuAcs_stSecuLvl "Status message for currently active secuirty levels" UBYTE OneToOne 1 100 0.00 255.0 FORMAT "%5.1" ECU_ADDRESS 0x60000990 /end MEASUREMENT
/begin FUNCTION CrCtl_TrqCalc "6.3.0     Cruise Control torque calculation"
 /begin DEF_CHARACTERISTIC CrCtl_vAccnDR7DwnSlpCoast_CUR CrCtl_vAccnDR7DwnSlp_CUR CrCtl_vAccnDvtDR1ACCCnclUpSlp_C CrCtl_vAccnDvtDR1ACCUpSlp_C CrCtl_vAccnDvtDR1CnclUpSlp_C CrCtl_vAccnDvtDR1UpSlp_C CrCtl_vAccnDvtDR2ACCCnclUpSlp_C CrCtl_vAccnDvtDR2ACCUpSlp_C CrCtl_vAccnDvtDR2CnclUpSlp_C CrCtl_vAccnDvtDR2UpSlp_C CrCtl_vAccnDvtDR3ACCCnclUpSlp_C CrCtl_vAccnDvtDR3ACCUpSlp_C CrCtl_vAccnDvtDR3CnclUpSlp_C CrCtl_vAccnDvtDR3UpSlp_C CrCtl_vAccnDvtDR4ACCCnclUpSlp_C CrCtl_vAccnDvtDR4ACCUpSlp_C CrCtl_vAccnDvtDR4CnclUpSlp_C CrCtl_vAccnDvtDR4UpSlp_C CrCtl_vAccnDvtDR5ACCCnclUpSlp_C CrCtl_vAccnDvtDR5ACCUpSlp_C CrCtl_vAccnDvtDR5CnclUpSlp_C CrCtl_vAccnDvtDR5UpSlp_C CrCtl_vAccnDvtDR6ACCCnclUpSlp_C CrCtl_vAccnDvtDR6ACCUpSlp_C CrCtl_vAccnDvtDR6CnclUpSlp_C CrCtl_vAccnDvtDR6UpSlp_C CrCtl_vAccnDvtDR7ACCCnclUpSlp_C CrCtl_vAccnDvtDR7ACCUpSlp_C CrCtl_vAccnDvtDR7CnclUpSlp_C CrCtl_vAccnDvtDR7UpSlp_C CrCtl_vACCRPntHysLoNTGKmh_GCUR CrCtl_vACCRPntHysLoNTG_GCUR CrCtl_vACCRPntHysLoTGKmh_GCUR CrCtl_vACCRPntHysLoTG_GCUR CrCtl_vAPPLim_AXIS CrCtl_vCmftACCRPntHysLoNTG_GCUR CrCtl_vCmftACCRPntHysLoTG_GCUR CrCtl_vCmftDLimHysHiNTG_GCUR CrCtl_vCmftDLimHysHiTG_GCUR CrCtl_vCmftDLimHysLoNTG_GCUR CrCtl_vCmftDLimHysLoTG_GCUR CrCtl_vCmftRPntHysHiNTG_GCUR CrCtl_vCmftRPntHysHiTG_GCUR CrCtl_vCmftRPntHysLoNTG_GCUR CrCtl_vCmftRPntHysLoTG_GCUR CrCtl_vContTUDvtECOff_CUR CrCtl_vContTUDvtECOn_CUR CrCtl_vContTUDvtHysECOff_CUR CrCtl_vContTUDvtHysECOn_CUR CrCtl_vContTUECOffDesInc1_MAP CrCtl_vContTUECOffDesInc2_CUR CrCtl_vContTUECOnDesInc1_MAP CrCtl_vContTUECOnDesInc2_CUR CrCtl_vDes2OffsECOff_MAP CrCtl_vDes2OffsECOn_MAP CrCtl_vDesClthOnStrtAdd_C CrCtl_vDLimHysHiNTGKmh_GCUR CrCtl_vDLimHysHiNTG_GCUR CrCtl_vDLimHysHiTGKmh_GCUR CrCtl_vDLimHysHiTG_GCUR CrCtl_vDLimHysLoNTGKmh_GCUR CrCtl_vDLimHysLoNTG_GCUR CrCtl_vDLimHysLoTGKmh_GCUR CrCtl_vDLimHysLoTG_GCUR CrCtl_vDR1DvtDwnSlp_C CrCtl_vDR1HiHysUpLimACCDnSlp_C CrCtl_vDR1HiHysUpLimUpSlp_C CrCtl_vDR1LoHysUpLimACCDnSlp_C CrCtl_vDR1LoHysUpLimUpSlp_C CrCtl_vDR2DvtDwnSlp_C CrCtl_vDR2HiHysUpLimACCDnSlp_C CrCtl_vDR2HiHysUpLimDnSlp_C CrCtl_vDR2HiHysUpLimUpSlp_C CrCtl_vDR2LoHysUpLimACCDnSlp_C CrCtl_vDR2LoHysUpLimDnSlp_C CrCtl_vDR2LoHysUpLimUpSlp_C CrCtl_vDR3DvtDwnSlp_C CrCtl_vDR3HiHysUpLimACCDnSlp_C CrCtl_vDR3HiHysUpLimDnSlp_C CrCtl_vDR3HiHysUpLimUpSlp_C CrCtl_vDR3LoHysUpLimACCDnSlp_C CrCtl_vDR3LoHysUpLimDnSlp_C CrCtl_vDR3LoHysUpLimUpSlp_C CrCtl_vDR4DvtDwnSlp_C CrCtl_vDR4HiHysUpLimACCDnSlp_C CrCtl_vDR4HiHysUpLimDnSlp_C CrCtl_vDR4HiHysUpLimUpSlp_C CrCtl_vDR4LoHysUpLimACCDnSlp_C CrCtl_vDR4LoHysUpLimDnSlp_C CrCtl_vDR4LoHysUpLimUpSlp_C CrCtl_vDR5DvtDwnSlp_C CrCtl_vDR5HiHysUpLimACCDnSlp_C CrCtl_vDR5HiHysUpLimDnSlp_C CrCtl_vDR5HiHysUpLimUpSlp_C CrCtl_vDR5LoHysUpLimACCDnSlp_C CrCtl_vDR5LoHysUpLimDnSlp_C CrCtl_vDR5LoHysUpLimUpSlp_C CrCtl_vDR6DvtDwnSlp_C CrCtl_vDR6HiHysUpLimACCDnSlp_C CrCtl_vDR6HiHysUpLimDnSlp_C CrCtl_vDR6HiHysUpLimUpSlp_C CrCtl_vDR6LoHysUpLimACCDnSlp_C CrCtl_vDR6LoHysUpLimDnSlp_C CrCtl_vDR6LoHysUpLimUpSlp_C CrCtl_vDR7DvtDwnSlp_C CrCtl_vDR7HiHysUpLimACCDnSlp_C CrCtl_vDR7HiHysUpLimDnSlp_C CrCtl_vDR7HiHysUpLimUpSlp_C CrCtl_vDR7LoHysUpLimACCDnSlp_C CrCtl_vDR7LoHysUpLimDnSlp_C CrCtl_vDR7LoHysUpLimUpSlp_C CrCtl_vECAccCtlTarAStd_GCUR CrCtl_vECDR1DvtDwnSlp_C CrCtl_vECDR2DvtDwnSlp_C CrCtl_vECDR3DvtDwnSlp_C CrCtl_vECDR4DvtDwnSlp_C CrCtl_vECDR5DvtDwnSlp_C CrCtl_vECDR6DvtDwnSlp_C CrCtl_vECDR7DvtDwnSlp_C CrCtl_vECDvtDR1UpSlp_C CrCtl_vECDvtDR2UpSlp_C CrCtl_vECDvtDR3UpSlp_C CrCtl_vECDvtDR4UpSlp_C CrCtl_vECDvtDR5UpSlp_C CrCtl_vECDvtDR6UpSlp_C CrCtl_vECDvtDR7UpSlp_C CrCtl_vEcoACCRPntHysLoNTG_GCUR CrCtl_vEcoACCRPntHysLoTG_GCUR CrCtl_vEcoDLimHysHiNTG_GCUR CrCtl_vEcoDLimHysHiTG_GCUR CrCtl_vEcoDLimHysLoNTG_GCUR CrCtl_vEcoDLimHysLoTG_GCUR CrCtl_vECOffDesInc1_MAP CrCtl_vECOffDesInc2_CUR CrCtl_vECOffDvtDwn1_C CrCtl_vECOffDvtDwn2_C CrCtl_vECOffDvtDwn3_C CrCtl_vECOffDvtDwn4_C CrCtl_vECOffDvtUp2_C CrCtl_vECOffDvtUp3_C CrCtl_vECOffDvtUp4_C CrCtl_vECOffDvtUp5_C CrCtl_vECOnDesInc1_MAP CrCtl_vECOnDesInc2_CUR CrCtl_vECOnDvtDwn1_C CrCtl_vECOnDvtDwn2_C CrCtl_vECOnDvtDwn3_C CrCtl_vECOnDvtDwn4_C CrCtl_vECOnDvtUp2_C CrCtl_vECOnDvtUp3_C CrCtl_vECOnDvtUp4_C CrCtl_vECOnDvtUp5_C CrCtl_vEcoRPntHysHiNTG_GCUR CrCtl_vEcoRPntHysHiTG_GCUR CrCtl_vEcoRPntHysLoNTG_GCUR CrCtl_vEcoRPntHysLoTG_GCUR CrCtl_vECTarAStdKmh_GCUR CrCtl_vECTarAStd_GCUR CrCtl_vFdbkArea_AX CrCtl_vFdbkArea_AXIS CrCtl_vGearDwn1UpLim_C CrCtl_vGearDwn1UpReqClr_C CrCtl_vGearDwn1UpReq_C CrCtl_vGearDwn2UpLim_C CrCtl_vGearDwn2UpReqClr_C CrCtl_vGearDwn2UpReq_C CrCtl_vGearDwn3UpLim_C CrCtl_vGearDwn3UpReqClr_C CrCtl_vGearDwn3UpReq_C CrCtl_vGearDwn4UpLim_C CrCtl_vGearDwn4UpReqClr_C CrCtl_vGearDwn4UpReq_C CrCtl_vInitOffSpdVar_C CrCtl_vLSFStrtAPP_AXIS CrCtl_vLSFStrt_C CrCtl_vResOffEndDvtCor_C CrCtl_vRPntDLimHys_AXIS CrCtl_vRPntHysHiNTGKmh_GCUR CrCtl_vRPntHysHiNTG_GCUR CrCtl_vRPntHysHiTGKmh_GCUR CrCtl_vRPntHysHiTG_GCUR CrCtl_vRPntHysLoNTGKmh_GCUR CrCtl_vRPntHysLoNTG_GCUR CrCtl_vRPntHysLoTGKmh_GCUR CrCtl_vRPntHysLoTG_GCUR CrCtl_vSpdVarDR1CnclDwnSlp_C CrCtl_vSpdVarDR2CnclDwnSlp_C CrCtl_vSpdVarDR3CnclDwnSlp_C CrCtl_vSpdVarDR4CnclDwnSlp_C CrCtl_vSpdVarDR5CnclDwnSlp_C CrCtl_vSpdVarDR6CnclDwnSlp_C CrCtl_vSpdVarDR7CnclDwnSlp_C CrCtl_vSptACCRPntHysLoNTG_GCUR CrCtl_vSptACCRPntHysLoTG_GCUR CrCtl_vSptDLimHysHiNTG_GCUR CrCtl_vSptDLimHysHiTG_GCUR CrCtl_vSptDLimHysLoNTG_GCUR CrCtl_vSptDLimHysLoTG_GCUR CrCtl_vSptRPntHysHiNTG_GCUR CrCtl_vSptRPntHysHiTG_GCUR CrCtl_vSptRPntHysLoNTG_GCUR CrCtl_vSptRPntHysLoTG_GCUR CrCtl_vTapDnInit_AXIS CrCtl_vTapUpInit_AXIS CrCtl_vThdCtOffAllwd_C CrCtl_vThdCtOffPhd_C CrCtl_vThresPla_C CrCtl_vTopGearUpLim_C CrCtl_vTrgAccnAccAdd_C CrCtl_vTrgAccnStandKmh_GCUR CrCtl_vTrgAccnStand_GCUR CrCtl_vTrgAccnStdLSF_GCUR CrCtl_vTrgVehSpdDvt_C CrCUI_stGuidDispOff_C /end DEF_CHARACTERISTIC
 FUNCTION_VERSION "6.3.0" /end FUNCTION
/begin FUNCTION CrCUI_GetUI "87.2.0    cruise control user interface"
 /begin DEF_CHARACTERISTIC CrCUI_ctACCASLSwtErr_C CrCUI_ctACCASLSwt_C CrCUI_ctATFWDPosn_C CrCUI_ctCancelSwtDeb_C CrCUI_ctCANRxErr1_C CrCUI_ctCANRxErr_C CrCUI_ctCrsSwtErr_C CrCUI_ctEAT2RxErr_C CrCUI_ctMaiSwtDeb_C CrCUI_ctSwtDeb_C CrCUI_facNeFlt_C CrCUI_flgTypTSRLimSpd_C CrCUI_nACCBrkCnclLoLim_GCUR CrCUI_nChkVal_AXIS CrCUI_nCnclLoLim_GCUR CrCUI_nCnclUpoLim_C CrCUI_nShftDnReq_GCUR CrCUI_numCrsASLForceSel_C CrCUI_numGearTrgt_CA CrCUI_numLSF_C CrCUI_numTSRErr_C CrCUI_numTSRInfo_CUR CrCUI_rGearChk0_C CrCUI_rGearChk1_C CrCUI_rGearChk2_C CrCUI_rGearChk3_C CrCUI_rGearChk4_C CrCUI_rGearChk5_C CrCUI_rNv0_C CrCUI_rNv1_C CrCUI_rNv2_C CrCUI_rNv3_C CrCUI_rNv4_C CrCUI_rNv5_C CrCUI_stASLtoISASpdLim_C CrCUI_stClthCont_C CrCUI_stClthOnNeChk_C CrCUI_stECON_C CrCUI_stFctInfo_C CrCUI_stGearDownNoLSF_C CrCUI_stGearDownNo_CA CrCUI_stIDSCmft_C CrCUI_stIDSEco_C CrCUI_stIDSSpt_C CrCUI_stISAContJdgTSRClr_CUR CrCUI_stISAtoASLbyResSet_C CrCUI_stMETSpdDspEna_C CrCUI_stMetSpdUnitSwt_C CrCUI_stShftPosChkDisbl_C CrCUI_stSimulResChk_C CrCUI_stSimulSetChk_C CrCUI_stSwtFwdPosnInfo_C CrCUI_stVehUn_C CrCUI_swtATFWDPosnCntr_C CrCUI_swtCCSpdDispEnfSeln_C CrCUI_swtCrsSwtTypSel_C CrCUI_swtMETTyp_C CrCUI_swtVehUnForceSel_C CrCUI_tiACCAppSpdChng_C CrCUI_tiACCClthCncl_C CrCUI_tiACCCoaSpdChng_C CrCUI_tiACCSpdNoUpdRes_C CrCUI_tiACCSpdNoUpdSet_C CrCUI_tiACCSwtResApp_C CrCUI_tiACCSwtSetCoa_C CrCUI_tiAutoBrkActvChk_C CrCUI_tiAYCCond_C CrCUI_tiCCASLMETVehUnFlt_C CrCUI_tiCCASLVehUnInit_C CrCUI_tiContnsErrChk_C CrCUI_tiCrsASLSelInfo_C CrCUI_tiFWDpos_C CrCUI_tiGearOff_C CrCUI_tiLSFStpJdgHysHi_C CrCUI_tiLSFStpJdgHysLo_C CrCUI_tiMETCustInfoFlt_C CrCUI_tiResuOnSpdUpd_C CrCUI_tiSetOnSpdUpd_C CrCUI_tiShftDn5Det_C CrCUI_tiShftDnDet_C CrCUI_tiShftDnRls_C CrCUI_tiSwtBrkMn_C CrCUI_tiSwtBrkRed_C CrCUI_tiSwtClth_C CrCUI_tiSwtInhb_C CrCUI_tiSwtResApp_C CrCUI_tiSwtSetCoa_C CrCUI_tiTSRErrDet_C CrCUI_vLSFStpJdgHysHi_C CrCUI_vLSFStpJdgHysLo_C /end DEF_CHARACTERISTIC
 /begin REF_CHARACTERISTIC CrCtl_facSpdUnConv_C CrCtl_numACCType_C CrCtl_numATType_C CrCtl_SwtDRnrEna_C LLim_numISAMetType_C /end REF_CHARACTERISTIC
 /begin IN_MEASUREMENT AccPed_swtDrvMod Brk_stMnRaw Brk_stRedRaw Clth2_st Com_bDigMtrUnit Com_flgEAT9Norm Com_flgEATANorm Com_numCvtGearShiftMap Com_numGearTrgt Com_stACCBrk Com_stACCSpdUnit Com_stATEnaCond Com_stCamHealDisp Com_stCvtPosnPrms Com_stDispDmdEnvCdn Com_stDispDmdSignRi Com_stEAT8Mon Com_stEATBMon Com_stECON Com_stFrmRxEna Com_stISABasSpd Com_stMonMET Com_stMonMETA Com_stMonMETL Com_stMtrCustDftReq Com_stMtrCustFlg Com_stShftInD Com_stTarSpdDisp Com_stTCamAbnormDisp Com_stTSRClrReas Com_vAnaVeh Com_vDigVeh Com_vDigVehRaw CoVMD_stSwtCCASLTqSeln CrCtl_numACCType CrCtl_stACCCond CrCtl_stACCReqNoDet CrCtl_stModeNo CrCtl_tiIGNOnVeh CrCtl_vVehCont CrC_stKey Dspl_bVelInMiles Dspl_stACCASLSwtInfo Dspl_stCrsASLSelInfo Dspl_stCrsMaiSwtInfo Dspl_stCrsSwtInfo Epm_nEng Gbx_stRvsPos LLim_stActvLmp SpdGov_nSetPLo StbIntv_bAYCIntvActv SyC_ctIrrSwOff SyC_stHistTiPostDrvMax T15_st Tra_numGear VehV_v /end IN_MEASUREMENT
 /begin OUT_MEASUREMENT CrCUI_ctResuOnSpdUpd CrCUI_ctSetOnSpdUpd CrCUI_flgAutoBrkActvChk CrCUI_flgCrCUICANRxNorm CrCUI_flgCrsCtrlShtOffEngNorm CrCUI_nEngSpd CrCUI_nFlt CrCUI_nFltDiff CrCUI_nLIDes CrCUI_numGearPosnADAS CrCUI_numLSF CrCUI_numSelMode CrCUI_numTSRLimSpd CrCUI_stACCASLSwtErrDet CrCUI_stACCBrkCnclReq CrCUI_stACCClthCont CrCUI_stACCClthOn CrCUI_stACCNoUpdReq CrCUI_stACCSpdIndTrg CrCUI_stASLMainDeb CrCUI_stASLSpdNoUpdReq CrCUI_stASLtoISASpdLim CrCUI_stATShft CrCUI_stAYCCond CrCUI_stBkupChk CrCUI_stCancelSwt CrCUI_stCANRxErr CrCUI_stCCASLVehUn CrCUI_stCCSpdDispExist CrCUI_stClthCond CrCUI_stClu CrCUI_stCmftDrvMod CrCUI_stCntFstChk CrCUI_stCrsASLSelFild CrCUI_stCrsSwtErrDet CrCUI_stCrsSwtFild CrCUI_stCvtLmap CrCUI_stEAT2RxErr CrCUI_stEcoDrvMod CrCUI_stECONActv CrCUI_stECONActvOld CrCUI_stFctInfo CrCUI_stFiSysFailCond CrCUI_stFWDPos CrCUI_stGearDownNo CrCUI_stISAContTSRClr CrCUI_stISAModeMnSW CrCUI_stISAtoASLbyResSet CrCUI_stKeyRead CrCUI_stLowGearCancel CrCUI_stLSFStpJdg CrCUI_stMainDeb CrCUI_stMETSpdDspEna CrCUI_stModeChgCncl CrCUI_stNeDnCncl CrCUI_stNeUpCncl CrCUI_stShftDnReq CrCUI_stShftPosCANErr CrCUI_stSptDrvMod CrCUI_stSwtBrkMnDeb CrCUI_stSwtBrkMnLSF CrCUI_stSwtBrkRedDeb CrCUI_stSwtBrkRedLSF CrCUI_stSwtClthDeb CrCUI_stSwtOnSpdUpd CrCUI_stSwtOpErr CrCUI_stSwtResNo CrCUI_stSwtSetNo CrCUI_stTmrEndChk CrCUI_stTSRErr CrCUI_stVehUn CrCUI_swtMETTyp CrCUI_tiAutoBrkActvChk CrCUI_vMETSpd CrCUI_vMETSpd2 /end OUT_MEASUREMENT
 /begin LOC_MEASUREMENT CrCUI_ctACCAppSpdChng_mp CrCUI_ctACCASLSwtErr_mp CrCUI_ctACCASLSwtFild_mp CrCUI_ctACCCoaSpdChng_mp CrCUI_ctATFWDPosn_mp CrCUI_ctCancelSwtDeb_mp CrCUI_ctCANRxErr1_mp CrCUI_ctCANRxErr_mp CrCUI_ctCrsSwtErr_mp CrCUI_ctCrsSwtFild_mp CrCUI_ctEAT2RxErr_mp CrCUI_ctMainSwtDeb_mp CrCUI_ctResSwtDeb_mp CrCUI_ctSetSwtDeb_mp CrCUI_flgClrEEPROM CrCUI_nACCBrkCnclLoLim_mp CrCUI_nCnclLoLim_mp CrCUI_nFltOld_mp CrCUI_nShftDnReq_mp CrCUI_rNvAbs0_mp CrCUI_rNvAbs1_mp CrCUI_rNvAbs2_mp CrCUI_rNvAbs3_mp CrCUI_rNvAbs4_mp CrCUI_rNvSubsGear5_mp CrCUI_rNv_mp CrCUI_stACCASLErrTmrIdc_mp CrCUI_stACCASLSwtFild_mp CrCUI_stACCASLSwtOld_mp CrCUI_stCCASLMETVehUnFlt_mp CrCUI_stCluOld_mp CrCUI_stCrsASLSelFildOld_mp CrCUI_stCrsASLSelRes_mp CrCUI_stCrsErrTmrIdc_mp CrCUI_stCrsSwtFildOld_mp CrCUI_stCrsSwtOld_mp CrCUI_stMaiSwtInter_mp CrCUI_stMETCustInfoFlt_mp CrCUI_stShftDnRls_mp CrCUI_stSwtBrkMnOld CrCUI_stSwtBrkRedOld CrCUI_stSwtMainDeb_mp CrCUI_stSwtResDeb_mp CrCUI_stSwtSetDeb_mp CrCUI_tiACCAppSpdChng_mp CrCUI_tiACCASLContnsErr_mp CrCUI_tiACCClthCncl_mp CrCUI_tiACCClthUpdExtn_mp CrCUI_tiACCCoaSpdChng_mp CrCUI_tiACCSpdNoUpdRes_mp CrCUI_tiACCSpdNoUpdSet_mp CrCUI_tiAYCCond_mp CrCUI_tiCCASLMETVehUnFlt_mp CrCUI_tiCrsASLSelInfo_mp CrCUI_tiCrsContnsErr_mp CrCUI_tiFWDpos_mp CrCUI_tiGearOff_mp CrCUI_tiLSFStpJdgHysHi_mp CrCUI_tiLSFStpJdgHysLo_mp CrCUI_tiMETCustInfoFlt_mp CrCUI_tiResuOnSpdUpd_mp CrCUI_tiSetOnSpdUpd_mp CrCUI_tiShftDn0Det_mp CrCUI_tiShftDn0Rls_mp CrCUI_tiShftDn1Det_mp CrCUI_tiShftDn1Rls_mp CrCUI_tiShftDn2Det_mp CrCUI_tiShftDn2Rls_mp CrCUI_tiShftDn3Det_mp CrCUI_tiShftDn3Rls_mp CrCUI_tiShftDn4Det_mp CrCUI_tiShftDn4Rls_mp CrCUI_tiShftDn5Det_mp CrCUI_tiSwtBrkMn_mp CrCUI_tiSwtBrkRed_mp CrCUI_tiSwtClth_mp CrCUI_tiSwtResApp_mp CrCUI_tiSwtSetCoa_mp CrCUI_tiTSRErr_mp /end LOC_MEASUREMENT
 FUNCTION_VERSION "87.2.0" /end FUNCTION
/begin FUNCTION CrCUI_Lib "1.1.0_2.1.0Cruise Control User interface Library functions" /begin REF_CHARACTERISTIC LLim_numISAMetType_C /end REF_CHARACTERISTIC
 /begin IN_MEASUREMENT CrCUI_stASLMainDeb CrCUI_stMainDeb Dspl_stCrsASLSelInfo Dspl_stCrsMaiSwtInfo /end IN_MEASUREMENT
 FUNCTION_VERSION "1.1.0_2.1.0" /end FUNCTION
/begin FUNCTION CtT_Ctx "1.1.0     context for thermostat diagnosis" /begin OUT_MEASUREMENT CtT_stDiagEna CtT_stReiniMdl /end OUT_MEASUREMENT FUNCTION_VERSION "1.1.0" /end FUNCTION
/begin FUNCTION DAGRS "10.0.0    Diagnosis AGR-system"
 /begin DEF_CHARACTERISTIC AFDAGR AFDAGRK AGDAGR AGDAGRK CWDAGRS DAGRSRLSDENDISA DAGRSRLSDENENA DFBAGRAEG DFBAGRAKT DOFVAGRAEG DOFVAGRAKT KBDAGRSMN KBDAHYMN KBDAKTMN TVAGRFBG TVAGRFBGKT TVAGROEG TVAGROEGKT TVEDAGRS TVHDAGRS ZKFBDA ZKFBDAKT ZKOFDA ZKOFDAKT /end DEF_CHARACTERISTIC
 /begin IN_MEASUREMENT agrvps_w_msg B_agron_msg B_cdagrs_msg B_enkbagr_msg B_enofagr_msg B_faagr_msg B_ktagrs_msg B_rapslmds_msg B_zdagrss_msg Eep_EnvRamInvld fkblagrs_w_msg fkblagr_w_msg ofvpagr_w_msg SyC_stSub /end IN_MEASUREMENT
 /begin OUT_MEASUREMENT B_dagrsdtrus_msg B_dagrsdtr_msg B_dagrssf_msg B_ofagreg_msg m6sagrf_w_msg m6wagrf_w_msg /end OUT_MEASUREMENT
 /begin LOC_MEASUREMENT B_dagrssfl B_dagrssfsc B_fbagreg B_fbagrmnl B_fbagrmnsc B_fkblagr B_fkblagrs dfbagr_w dofvpagr_w m6sagrx_w m6wagrx_w /end LOC_MEASUREMENT
 FUNCTION_VERSION "10.0.0" /end FUNCTION
/begin FUNCTION DAGRSV "5.0.0     EGR-diagnosis, mode6-service routine" /begin IN_MEASUREMENT B_dagrsdtrus_msg m6sagrf_w_msg m6wagrf_w_msg SyC_stSub /end IN_MEASUREMENT FUNCTION_VERSION "5.0.0" /end FUNCTION
/begin FUNCTION DASrvLib_AdpvPosnCtrl "1.0.1     This FC provides an adaptive position controller to control an electrical actuator via h-bridge." FUNCTION_VERSION "1.0.1" /end FUNCTION
/begin FUNCTION DASrvLib_ClnVrfy "1.0.0     Clean and Verify Function" FUNCTION_VERSION "1.0.0" /end FUNCTION
/begin FUNCTION DASrvLib_DblDioEvln "1.0.0     Evaluation of two DIO inputs with error handling" FUNCTION_VERSION "1.0.0" /end FUNCTION
/begin FUNCTION DASrvLib_DiagRngChk "1.1.0     Diagnosis range check on input signal" FUNCTION_VERSION "1.1.0" /end FUNCTION
/begin FUNCTION DASrvLib_GetAdcSrc "1.0.0     Analogue input port reading with signal range check" FUNCTION_VERSION "1.0.0" /end FUNCTION
/begin FUNCTION DASrvLib_GetAdcSrcQly "1.0.0     analogue input port reading with signal range check and quality status" FUNCTION_VERSION "1.0.0" /end FUNCTION
/begin FUNCTION DASrvLib_GetAdcSwt "1.0.0     ADC reading and provison of logical switch state" FUNCTION_VERSION "1.0.0" /end FUNCTION
/begin FUNCTION DASrvLib_GetAdcSwtDiag "1.0.0     Analogue input reading, provison of logical switch state and signal diagnosis" FUNCTION_VERSION "1.0.0" /end FUNCTION
/begin FUNCTION DASrvLib_GetDioDeb "1.0.0     DIO reading and debouncing" FUNCTION_VERSION "1.0.0" /end FUNCTION
/begin FUNCTION DASrvLib_GovDvtMon "1.0.0     Governor deviation monitoring" FUNCTION_VERSION "1.0.0" /end FUNCTION
/begin FUNCTION DASrvLib_OffsDetrmLimn "1.0.1     Offset Determination" FUNCTION_VERSION "1.0.1" /end FUNCTION
/begin FUNCTION DASrvLib_OffsDetrmRefZero "1.0.0     class for calculating offset with reference to zero" FUNCTION_VERSION "1.0.0" /end FUNCTION
/begin FUNCTION DASrvLib_OffsFadeIn "1.0.0     Fade in of offset for the input signal" FUNCTION_VERSION "1.0.0" /end FUNCTION
/begin FUNCTION DASrvLib_PosnChgCntr "1.0.0     Actuator position change counter" FUNCTION_VERSION "1.0.0" /end FUNCTION
/begin FUNCTION DASrvLib_SegEndPrdn "1.0.0     Prediction of input signal to the end of segment" FUNCTION_VERSION "1.0.0" /end FUNCTION
/begin FUNCTION DASrvLib_StuckInRngChk "1.0.0     class for stuck in range check" FUNCTION_VERSION "1.0.0" /end FUNCTION
/begin FUNCTION DASrvLib_TransHndlgSwt "1.0.1     Ramp for the transition between two inputs" FUNCTION_VERSION "1.0.1" /end FUNCTION
/begin FUNCTION DcmCore_DslDsd_Appl "1997.5.0  Adaptions of DcmCore Dsl and Dsd"
 /begin DEF_CHARACTERISTIC ComDia_nMaxServCDI_C Immo_numSAID_C SecuAcs_numCustTyp10SC_C SecuAcs_numCustTyp3SC_C SecuAcs_numCustTyp4SC_C SecuAcs_numS1_C SecuAcs_numS2_C SecuAcs_numS3_C /end DEF_CHARACTERISTIC
 /begin REF_CHARACTERISTIC I14229_swtRDBI2617_C I14229_swtRDBI2627_C I14229_swtRDBI2666_C I14229_swtRDBI2688_C I14229_swtRDBI2689_C I14229_swtRDBI268C_C I14229_swtRDBI269B_C I14229_swtRDBI269E_C I14229_swtRDBI26A0_C I14229_swtRDBI26A1_C I14229_swtRDBI26A3_C I14229_swtRDBIE801_C I14229_swtRDBIE81F_C /end REF_CHARACTERISTIC
 /begin IN_MEASUREMENT B_fatlde_msg B_fatlds_msg CoVOM_bSSEEna CoVOM_bSSEEngStopPassed DcmAppl_flgAuthentPassd DcmDspUds_flgSessionKeyRegstSt Epm_nEng I14229iocp_numEXE I14229iocp_numREQ T15_st VehV_v /end IN_MEASUREMENT
 /begin OUT_MEASUREMENT BasSvr_bFuncTstReq DCM_stCurrDiagcSession I14229_stSuppRst SecuAcs_stSecuLvl /end OUT_MEASUREMENT
 FUNCTION_VERSION "1997.5.0" /end FUNCTION
/begin FUNCTION DcmDspUDS_Authent "1997.0.0  CUBAS DCM DSP for UDS, Authentication Service"
 /begin IN_MEASUREMENT DcmAppl_flgAuthentPassd DcmDspUds_flgAuthentRejctd DcmDspUds_flgSessionKeyRegstSt /end IN_MEASUREMENT
 FUNCTION_VERSION "1997.0.0" /end FUNCTION
/begin FUNCTION DcmDspUDS_DID "1997.17.0 Configuration and Implementation of the DIDs for the DCM UDS Services (RDBI, WDBI, IOCBI)"
 /begin DEF_CHARACTERISTIC CALIBID COMDIA_TGEFN_CA EROTAN I14229DarkCurrHistMonrPrmFmt_C I14229DarkCurrHistMonrPrmLen_C I14229_DiumprDFC_CA I14229_nrStrtrCtrl_AlgTypID_C I14229_nrStrtrCtrl_DataLen_C I14229_numAFCLLng_C I14229_numAFCLTyp_C I14229_numCompID_CA I14229_numOilLfT_DataLen_C I14229_numProgID_CA I14229_numReWrECUID_CA I14229_RcDid0212Ena_C I14229_RcDid0213Ena_C I14229_RcDid021CEna_C I14229_stFuLvlSnsr_C I14229_stPCSEvapSwt_C I14229_stSnsrFildEna_C I14229_stVSAEquip_C I14229_swtFlTankEna_C I14229_swtIntkAirTSnsr2_C I14229_swtOilSnrEna_C I14229_swtRDBI2610IntkAirTSnsr2_C I14229_swtRDBI2617_C I14229_swtRDBI2627_C I14229_swtRDBI2666_C I14229_swtRDBI2688_C I14229_swtRDBI2689_C I14229_swtRDBI268C_C I14229_swtRDBI269B_C I14229_swtRDBI269E_C I14229_swtRDBI26A0_C I14229_swtRDBI26A1_C I14229_swtRDBI26A3_C I14229_swtRDBIDiumprRES_C I14229_swtRDBIE801_C I14229_swtRDBIE81F_C I14229_swtVTMEna_C I14229_tiCVORstFinshd_C I14229_WdbiDidE805Ena_C I14229_WdbiDidE81FEna_C Linappl_swtLinSdl_C /end DEF_CHARACTERISTIC
 /begin REF_CHARACTERISTIC CWEVMZVE I14229_tiEthconcActvTmr_C MisfDet_swtOn_C /end REF_CHARACTERISTIC
 /begin IN_MEASUREMENT AccPed_tqMapBasd ActMod_trqInr AFS_mfSnsrPid AFS_uSnsrRawB1 AirC_stPsCmpr AirC_stSwt AirC_uAnaRawClnt AirMod_ratRelAirM Alt_iExctLim Alt_rAltExct Alt_uFinalDes APP_r APP_uRaw1 APP_uRaw2 BattU_stStabPs BattU_uSens BattU_uSnsrFild Batt_flgBattExch Batt_flgChrgILo Batt_flgDeternDetd Batt_flgInhbSpst Batt_lMaxCnsChk Batt_lMinCnsChk Batt_qChrgCnsChkAH Batt_qCnsChkAH Batt_qDchaCnsChkAH Batt_qMaxCnsChkAH Batt_qMinCnsChkAH Batt_qSumHi Batt_qSumLo Batt_rMean Batt_stCalc Batt_stEngStopInhbn BdInt_stInhbReas BrkPed_flgISABBrkPSuffVehStill BrkPed_flgSlopeExcd BrkPed_flgVehStandStill Brk_stMn Brk_stRed B_btaavet_msg B_btaave_msg B_cdmd B_deseehr_msg B_dmdsteol B_kl15_msg B_llri_msg B_mdstop B_nmax_msg B_sa_msg B_tldcvs_msg CEngDsT_tPID05Tstr CEngDsT_uRaw CEngUsT_t CEngUsT_uSnsr Clth3_st Clth_st CoEng_stStopEng CoEng_tiCranking CoEng_tiNormalOBD ComAlt_stElecTypB ComAlt_stHiTempTypB ComAlt_stMchnTypB ComDCDC_stAbnormInp1 ComDCDC_stAbnormInp2 ComDCDC_stAbnormOutp1 ComDCDC_stAbnormOutp2 ComDCDC_stAbnormOvrheat1 ComDCDC_stAbnormOvrheat2 ComDCDC_stBoostChkFailr ComDCDC_stBoostUOper ComDCDC_stCSTHist ComDCDC_stCSTOnFailr ComDCDC_stVSTIntFailr ComEBS_BattID ComEBS_rBattSensCh ComEBS_rBattStrat ComEBS_stSensErr ComEBS_tiDurAftIgnOff ComEBS_uBattSens ComEBS_uBattUCO Com_bBliChrg Com_flgEbsRst Com_iBattEBS Com_lDst Com_rFlLvlFlt Com_rMeasdBattREbs Com_stCvtPosnPrms Com_stI Com_stISABEna Com_stPreStop Com_stShftInNeutr Com_stShftInPark Com_stShipMod Com_stSoc Com_stStSpEngStop Com_stT Com_stTranStop Com_stU Com_tBattEBS Com_trqAYCFDes Com_uPeak CoVeh_trqAcs CoVOM_bSSEEna CoVOM_bStopReq CoVOM_bVXSinceStrtDeb CoVOM_stISStopInhb COVOM_stNotHiAlti CoVOM_stStopReqCdn CoVOM_stStopRls CrCtl_stLmpOn CrCtl_stShutOffCode0 CrCtl_stShutOffCode1 CrCtl_stShutOffCode2 CrCtl_stShutOffCode3 CrCtl_stShutOffCode4 CrCtl_stShutOffCode5 CrCtl_stShutOffCode6 CrCtl_stShutOffCode7 CrCtl_stShutOffCode8 CrCtl_stShutOffCode9 DIUMPR_ctGenDenom DIUMPR_ctIgn DRIVE_numDTCFrz DRIVE_stCurTrgMode DRIVE_stHardToStrt DSMRdy_xPId1 Dspl_stCrsSwtInfo Ebs_qBliChrg Ebs_qBliDcha Ebs_qBliDchaTotDcyc Ebs_stStbIEBSByt0 Ebs_stStbIEBSByt1 Ebs_stStbIEBSByt2 Ebs_stStbIEBSByt3 Ebs_stStbIEBSByt4 Ebs_tiDurnAftIgnOffDcyc ECUSerNum EGRVlv_rGovDvtNrm EGSDCmn_flgCat1B1EnaTRngLoParl EGSDCmn_flgSeg1B1ReldParl EngStrt_ratOilDilAmnt EngTrqPtd_trqLead EngTrqPtd_trqSet EpmCaS_ctErrSig EpmCaS_ctNoSig Epm_nEng Epm_nEngRaw ErrLmp_stMIL ESS_bEngStopEna ETHSCP_perEthRaw Fan_stPs flglrs_msg FlLvl_volPlausyCycFuInj fra_w_msg frm_w_msg fstu_w_msg ftead_w_msg FuPHi_pPID23 FuPHi_uHiResl fzabgs_w_msg fzabgzyl_w_msg Gbx_stNPos Gbx_stPNPosnDeb Gbx_stRvsPos GEVCtl_agMaxAdpdIntk GEVCtl_flgPhaEnaIntk GEVlv_ratPhaIntkB1 GlbDa_lenTotDstDcycHiResl HEGO_bS2B1EnaDElec HEGO_bS2B1HtgOn HEGO_uS2B1Extd HEGO_uS2B1HiRes I14229CoEng_tiNormalOBDPrevDcyc I14229EpmCaS_ctErrSig1 I14229EpmCaS_ctNoSig1 I14229GlbDa_lTotDstDCHiReslPrevDcyc I14229InjTstFlg_stVal I14229IntkAirT_tSnsrTstrMax I14229IntkAirT_tSnsrTstrMin I14229iocpMDA_numABV I14229iocpMDA_numACGC I14229iocpMDA_numAPS I14229iocpMDA_numEGR I14229iocpMDA_numPSC I14229iocpMDA_numRFAN I14229iocpMDA_numRvsLck I14229iocpMDA_numVTEC I14229iocpMDA_stABV I14229iocpMDA_stACGC I14229iocpMDA_stAPS I14229iocpMDA_stEGR I14229iocpMDA_stOilPCtrl I14229iocpMDA_stPSC I14229iocpMDA_stRFAN I14229iocpMDA_stRvsLck I14229iocpMDA_stVTEC I14229iocp_numCtlSt I14229iocp_numEXE I14229iocp_numREQ I14229iocp_stAInjDAct I14229iocp_stSFTRJC I14229rcCrCtl_stLmp I14229RDBI_nOvrSpd I14229RDBI_tiOvrSpd i14229_agIntkB1GEVlv i14229_agIntkB1GEVlvSig i14229_agSpIntkB1GevCtl I14229_AirC_pAnaClnt I14229_Brk_st I14229_Brk_stRed I14229_Com_aLgtG I14229_ElcWastGatLift_s32 I14229_ElecLd_iEPSLoadOnly I14229_EpmCaS_ctErrSig2 I14229_EpmCaS_ctNoSig2 I14229_EpmCrS_ctCaSRev I14229_EpmCrS_ctErrSig I14229_flgEthSp I14229_fzabgs_w I14229_fzabgzyl_w I14229_Gbx_uAna1NPosRaw I14229_Gbx_uAna2NPosRaw I14229_GEVCtl_agMaxAdpdIntk I14229_ivzabg_w I14229_lDst I14229_LongTermAdpnVal_s32 I14229_nstat I14229_numDTCFrzFrmHi I14229_numDTCFrzFrmLo I14229_numDTCFrzFrmMid I14229_pEngSrtMin I14229_perEthnlCompuCnvnTmp I14229_ps_w I14229_rHtgS2B1 I14229_rTrqPT I14229_stClth3 I14229_stGbxRvsPos I14229_stKSdiag I14229_stSuppRst I14229_stTURBODV I14229_tiInj1On I14229_tIntkAirTSnsr2 I14229_tiOilFlowCompl I14229_tiSia I14229_tka I14229_tkaMax I14229_tkaMin I14229_tmotMaxCurrDcyc I14229_tmotMaxPrevDcyc I14229_tmotMinCurrDcyc I14229_tmotMinPrevDcyc I14229_tSnsrFild1 I14229_ubsq I14229_udst I14229_umsrln_w I14229_wdkba_w I14229_wdks_w I14229_wped1 I14229_wped2 I14229_zwist I15031_srv9_ValidCVN Ign_ia_cyl1 IKCtl_agAdpnCurr_s16 IKCtl_agKnkAvrg_s8 IKCtl_wIntgRef_au32 IntkAirT_tSnsr2 IntkAirT_uSnsr1Exprt IntkAirT_uSnsr2CrssSwtLoc lamsobd_w_msg longft1_w_msg lutskzyl_w_msg MILLmp_stReqBln MILLmp_stReqOn MisfDet_stcEmiThd MisfDet_stStcEmiStrt mshfm_w_msg ofmsndkh1_w_msg ofmsndkh2_w_msg Oil_bPWarn Oil_pSensPSwmp Oil_uRawPSwmp ora_w_msg PEnv_dataDigSnsr PEnv_pRaw PIntkVUs_uRawUnFlt priobbora_msg prsoll_w_msg PSP_stPs ps_w_msg PtCoornDyn_tqCluDes PtCoornDyn_tqCluLeadTrsmIntv ptek_w_msg PthLead_trqInrNoMon PThrVlvUs_uRawB1 PthSet_trqInrLtd PT_stTraType PT_trqLos pvd_w_msg rlabs_w_msg RngMod_trqDiffAdap RngMod_trqInrMinWoCtOff SecuAcs_stSecuLvl Sia_stIgnLck SrvCSwt_st Strt_stPs Strt_stTstrActv Strt_uStrtMonDia StSpSwt_st SyC_stSub T50_st tahrlsu_w_msg tatesoll_w_msg thdev_msg ThrVlv_flgLimpModeB1 ThrVlv_flgOffsLrnAbortB1 ThrVlv_flgOffsLrnSucB1 ThrVlv_flgRegTqRednB1 ThrVlv_flgReqFuCutOffB1 ThrVlv_ratActSens1AbsltB1_u8 ThrVlv_ratActSens1RelB1_u8 ThrVlv_uElStopClsdSens1B1 ThrVlv_uElStopClsdSens2B1 ThrVlv_uRawSens1B1 ThrVlv_uRawSens2B1 TiEngOff_ti tmst Tra_numGear TrbCh_flgLongTermAdpnHistB1 TrbCh_ratDesB1 TrbCh_uRawSens1B1 TWCD_numMeasB1 TWCD_rOSCAvrgPriB1 UEGO_iIPmpSrv1S1B1 UEGO_iIPmpSrvS1B1 UEGO_ratLamSrv1S1B1 ufst_w_msg VehStc_cntBattSnsrPOR VehStc_cntDcyc VehStc_cntIS VehStc_cntISInhbSwt VehStc_cntISStrtrActvn VehStc_cntJS VehStc_cntSt1Tran VehStc_cntSt4Tran VehStc_cntSt8Tran VehStc_dataDurAftIgnOffCmprHstg VehStc_dataEngOnCmprHstg VehStc_dataISDurnCmprHstg VehStc_dataTAirOutdCmprHstg VehStc_dataTBattEBSCmprHstg VehStc_dataUBattEBSCmprHstg VehStc_dataUnstyDrkDchaIDistbn VehStc_divdAirOutdCmprPrm VehStc_divdDurAftIgnOffCmprPrm VehStc_divdEngOnCmprPrm VehStc_divdISDurnCmprPrm VehStc_divdTBattEBSCmprPrm VehStc_divdUBattEBSCmprPrm VehStc_iBattMinDurgIS VehStc_iUBattMinDurgIS VehStc_lDstCity VehStc_lDstCityEco VehStc_lDstHighWay VehStc_lDstHighWayEco VehStc_numFuDiagRecA VehStc_numMisfDetnHiEctA VehStc_numMisfDetnLoEctA VehStc_numMisfDetnNormA VehStc_qBattChrg VehStc_qBattDcha VehStc_ratSOCIgnOffLstDcyc VehStc_ratSOCIgnOnCurrDcyc VehStc_ratSOCIgnOnLstDcyc VehStc_rDiagRsltB1A VehStc_resBattROthMean4Dcyc VehStc_stSOCIgnOffLstDcyc VehStc_stSOCIgnOnCurrDcyc VehStc_stSOCIgnOnLstDcyc VehStc_stSubRcdr VehStc_tBattIgnOffLstDcyc VehStc_tBattIgnOnCurrDcyc VehStc_tBattIgnOnLstDcyc VehStc_tiBattChrg VehStc_tiBattDcha VehStc_tiDrvg VehStc_tiEngOnDurn VehStc_tiHdLiOn VehStc_tiIGPOnDurn VehStc_tiISInhbMod VehStc_tiRtCity VehStc_tiRtCityEco VehStc_tiRtHighWay VehStc_tiRtHighWayEco VehStc_tiRtISSOffAC VehStc_tiRtISSOffBat VehStc_tiRtISSOffBrkBoost VehStc_tiRtISSOffDCDC VehStc_tiRtISSOffPwrSteer VehStc_tiRtISSOffSys VehStc_tiRtISSOffTempEng VehStc_tiRtISSOffUser VehStc_tiRtISSOffvVeh VehStc_tiRtStop VehStc_tiRtStopSpstOn VehStc_tiTotIgnOnLstDcyc VehStc_tiTotIS VehStc_uBattMinDurgIS VehStc_uIBattMinDurgIS VehStc_uMinBattEbs VehStc_volCnsCityDcyc VehStc_volCnsCityEcoDcyc VehStc_volCnsHighWayDcyc VehStc_volCnsHighWayEcoDcyc VehStc_volCnsStopDcyc VehV_v VehV_vSens VlvLft_flgCtrlActrIntk1 VlvLft_flgFbVlvStIntk VlvLft_pSnsrIntk wblagrs_w_msg wdkba_w_msg /end IN_MEASUREMENT
 /begin OUT_MEASUREMENT I14229_rPCSDuty RDBIRES_0 RDBIRES_1 RDBIRES_2 RDBIRES_4 RDBIRES_FF RDBI_FIX RDBI_FIX_1 RESERVED_BIT0 RESERVED_BIT1 /end OUT_MEASUREMENT
 /begin LOC_MEASUREMENT DcmDspUds_DID_requestIBChk Dcm_stCallWr Dcm_stEepOrder I14229_ratEthSp /end LOC_MEASUREMENT
 FUNCTION_VERSION "1997.17.0" /end FUNCTION
/begin FUNCTION DcmDspUDS_DSC "49.2.0    DCM UDS DiagnosticSessionControl" FUNCTION_VERSION "49.2.0" /end FUNCTION
/begin COMPU_METHOD B_TRUE "" TAB_VERB "%6.3" "" COMPU_TAB_REF B_TRUE /end COMPU_METHOD
/begin COMPU_VTAB B_TRUE "" TAB_VERB 2 0 "FALSE" 1 "TRUE" /end COMPU_VTAB
/begin COMPU_METHOD DcmDspUds_DID_requestIBChk_Cnv "" TAB_VERB "%6.3" "" COMPU_TAB_REF DcmDspUds_DID_requestIBChk_Cnv /end COMPU_METHOD
/begin COMPU_VTAB DcmDspUds_DID_requestIBChk_Cnv "" TAB_VERB 3 0 "DCMDSPUDS_DID_REQUESTIBCHK_INACTIVE" 1 "DCMDSPUDS_DID_REQUESTIBCHK_REQUESTED" 2 "DCMDSPUDS_DID_REQUESTIBCHK_PERFORMED" /end COMPU_VTAB
/begin COMPU_METHOD dez "" RAT_FUNC "%6.2" "" COEFFS 0 1 0 0 0 1 /end COMPU_METHOD
/begin COMPU_METHOD DFC_Verb "" TAB_VERB "%6.3" "-" COMPU_TAB_REF DFC_Verb /end COMPU_METHOD
/begin COMPU_VTAB DFC_Verb "" TAB_VERB 907 0 "DFC_Unused" 1 "DFC_AAVEmax" 2 "DFC_AAVEmin" 3 "DFC_AAVEsig" 508 "DFC_AAVmin" 379 "DFC_ACEvpTPhysRngHi" 380 "DFC_ACEvpTPhysRngLo" 381 "DFC_ACEvpTSRCMax" 382 "DFC_ACEvpTSRCMin" 288 "DFC_AfsPhyRngHiB1" 289 "DFC_AfsPhyRngLoB1" 510 "DFC_AfsPlausDiagHi" 511 "DFC_AfsPlausDiagLo" 383 "DFC_AfsRawSigRngHiB1" 384 "DFC_AfsRawSigRngLoB1" 415 "DFC_AfsSigErrLineHiB1" 416 "DFC_AfsSigErrLineLoB1" 385 "DFC_AfsSnsrErrB1" 512 "DFC_AfsVrntDiagErrB1" 509 "DFC_AGRSUS" 386 "DFC_AirCClntPAnaSRCMax" 387 "DFC_AirCClntPAnaSRCMin" 290 "DFC_AirCCmprOL" 291 "DFC_AirCCmprOvrTemp" 292 "DFC_AirCCmprSCB" 293 "DFC_AirCCmprSCG" 388 "DFC_AirCSwtNpl" 389 "DFC_AirCSwtSig" 294 "DFC_AltErr" 4 "DFC_AltIOACGFailr" 5 "DFC_AltIOACGHiVltg" 6 "DFC_AltIOACGLoVltg" 7 "DFC_AltIOACGTHi" 8 "DFC_AltIODConnACG" 513 "DFC_AppAllSnsrDfct" 10 "DFC_BattUHiFailr" 11 "DFC_BattULoFailr" 295 "DFC_BattUSRCMax" 296 "DFC_BattUSRCMin" 516 "DFC_BattUStdbyDiaOL" 514 "DFC_BBKRnldg" 515 "DFC_BBKRsyne" 9 "DFC_BGOELWAF" 517 "DFC_BigLeakIntkMnfldEmiInfl" 518 "DFC_BlkdLineTank" 390 "DFC_Brk" 12 "DFC_BrkBstPDriftHiErr" 13 "DFC_BrkBstPDriftLoErr" 14 "DFC_BrkBstPSnsrStuck" 391 "DFC_BrkBstSensSCB" 392 "DFC_BrkBstSensSCG" 15 "DFC_BrkMnSwtContOn" 519 "DFC_BrkMnSwtContOnWarnLmp" 16 "DFC_BrkMnSwtNotStp" 520 "DFC_BrkMnSwtNotStpWarnLmp" 17 "DFC_BrkNpl" 18 "DFC_BrkRdntSwtContOn" 521 "DFC_BrkRdntSwtContOnWarnLmp" 19 "DFC_BrkRdntSwtNotStp" 522 "DFC_BrkRdntSwtNotStpWarnLmp" 393 "DFC_BrkSig" 496 "DFC_BSWM_E_ACTION_FAILED" 497 "DFC_BSWM_E_INTRPTQUEUE_FULL" 472 "DFC_BusDiagCANAPPLBusOff" 473 "DFC_BusDiagCANCANCBusOff" 474 "DFC_BusDiagCANVEHICLEBusOff" 490 "DFC_CAN_E_TIMEOUT" 523 "DFC_CEngDsTColdStrtMax" 524 "DFC_CEngDsTColdStrtMin" 525 "DFC_CEngDsTImps" 526 "DFC_CEngDsTPlausHSC" 527 "DFC_CEngDsTPlausLSC" 528 "DFC_CEngDsTPlausSTC" 531 "DFC_CEngDsTSig" 529 "DFC_CEngDsTSRCMax" 530 "DFC_CEngDsTSRCMin" 532 "DFC_CEngUsTColdStrtMax" 533 "DFC_CEngUsTColdStrtMin" 534 "DFC_CEngUsTLooseCnctn" 535 "DFC_CEngUsTSRCMax" 536 "DFC_CEngUsTSRCMin" 432 "DFC_Clth2ONStuck" 433 "DFC_Clth2ONStuckLdc" 20 "DFC_Clth3ONStuck" 434 "DFC_Clth3ONStuckLdc" 435 "DFC_Clth3ONStuckPostDrv" 21 "DFC_Clth4OFFStuck" 436 "DFC_Clth4ONStuck" 437 "DFC_Clth4ONStuckLdc" 260 "DFC_ClthMax" 412 "DFC_ClthNpl" 22 "DFC_ClthOFFStuck" 23 "DFC_ClthONStuck" 394 "DFC_ClthSig" 24 "DFC_ClthStkFailInfo" 25 "DFC_ComACFailInfo" 26 "DFC_ComATFTValErr" 27 "DFC_ComATMILReq" 28 "DFC_ComAYCAChksum" 29 "DFC_ComAYCARingCnt" 30 "DFC_ComAYCATOut" 31 "DFC_ComAYCDChkSum" 32 "DFC_ComAYCDTOut" 33 "DFC_ComAYCFChksum" 34 "DFC_ComAYCFRingCnt" 35 "DFC_ComAYCFTOut" 36 "DFC_ComAYCGChksum" 37 "DFC_ComAYCGRingCnt" 38 "DFC_ComAYCGTOut" 39 "DFC_ComAYCIChkSum" 40 "DFC_ComAYCIRingCnt" 41 "DFC_ComAYCITOut" 42 "DFC_ComBCM1ChkSum" 43 "DFC_ComBCM1RingCnt" 44 "DFC_ComBCM1TOut" 438 "DFC_ComBCMUnit" 45 "DFC_ComCANABusOffErr" 46 "DFC_ComCANBBusOffErr" 47 "DFC_ComCANCBusOffErr" 48 "DFC_ComCGW1ChkSum" 49 "DFC_ComCGW1RingCnt" 50 "DFC_ComCGW1TOut" 297 "DFC_ComChksTCU1" 298 "DFC_ComChksTCU11" 299 "DFC_ComChksTCU12" 300 "DFC_ComChksTCU13" 301 "DFC_ComChksTCU2" 302 "DFC_ComChksTCU3" 303 "DFC_ComChksTCU4" 304 "DFC_ComCntTCU1" 305 "DFC_ComCntTCU11" 306 "DFC_ComCntTCU12" 307 "DFC_ComCntTCU13" 308 "DFC_ComCntTCU2" 309 "DFC_ComCntTCU3" 310 "DFC_ComCntTCU4" 51 "DFC_ComConvBoostErr" 52 "DFC_ComConvSlipErr" 537 "DFC_ComDCDCACCFailr" 53 "DFC_ComDCDCPrfmncErr" 54 "DFC_ComDCDCTempWarn" 439 "DFC_ComDLCTCU01" 440 "DFC_ComDLCTCU02" 441 "DFC_ComDLCTCU1" 442 "DFC_ComDLCTCU11" 443 "DFC_ComDLCTCU12" 444 "DFC_ComDLCTCU13" 445 "DFC_ComDLCTCU14" 446 "DFC_ComDLCTCU2" 447 "DFC_ComDLCTCU3" 448 "DFC_ComDLCTCU4" 55 "DFC_ComEAT10Chksum" 56 "DFC_ComEAT10RingCnt" 57 "DFC_ComEAT10TOut" 58 "DFC_ComEAT11ChkSum" 59 "DFC_ComEAT11RingCnt" 60 "DFC_ComEAT11TOut" 61 "DFC_ComEAT12ChkSum" 62 "DFC_ComEAT12RingCnt" 63 "DFC_ComEAT12TOut" 64 "DFC_ComEAT13ChkSum" 65 "DFC_ComEAT13RingCnt" 66 "DFC_ComEAT13TOut" 67 "DFC_ComEAT1Chksum" 68 "DFC_ComEAT1RingCnt" 69 "DFC_ComEAT1TOut" 70 "DFC_ComEAT2ChkSum" 71 "DFC_ComEAT2RingCnt" 72 "DFC_ComEAT2TOut" 73 "DFC_ComEAT4ChkSum" 74 "DFC_ComEAT4RingCnt" 75 "DFC_ComEAT4TOut" 76 "DFC_ComEAT6Chksum" 77 "DFC_ComEAT6RingCnt" 78 "DFC_ComEAT6TOut" 79 "DFC_ComEAT7Chksum" 80 "DFC_ComEAT7RingCnt" 81 "DFC_ComEAT7TOut" 82 "DFC_ComEAT8Chksum" 83 "DFC_ComEAT8RingCnt" 84 "DFC_ComEAT8TOut" 85 "DFC_ComEATAChksum" 86 "DFC_ComEATARingCnt" 87 "DFC_ComEATATOut" 88 "DFC_ComEATBChkSum" 89 "DFC_ComEATBRingCnt" 90 "DFC_ComEATBTOut" 91 "DFC_ComEATCChksum" 92 "DFC_ComEATCRingCnt" 93 "DFC_ComEATCTOut" 103 "DFC_ComEngCanRxErr" 94 "DFC_ComEPBBChkSum" 95 "DFC_ComEPBBRingCnt" 96 "DFC_ComEPBBTOut" 97 "DFC_ComEPBChksum" 99 "DFC_ComEPBctRing" 98 "DFC_ComEPBTOut" 100 "DFC_ComEPS1Chksum" 101 "DFC_ComEPS1RingCnt" 102 "DFC_ComEPS1TOut" 449 "DFC_ComEPSUnit" 104 "DFC_ComGrvySnsrErr" 105 "DFC_ComGwIMG1ChkSum" 106 "DFC_ComGwIMG1RingCnt" 107 "DFC_ComGwIMG1TOut" 108 "DFC_ComGwIMG3ChkSum" 109 "DFC_ComGwIMG3RingCnt" 110 "DFC_ComGwIMG3TOut" 111 "DFC_ComGwIMG4ChkSum" 112 "DFC_ComGwIMG4RingCnt" 113 "DFC_ComGwIMG4TOut" 114 "DFC_ComGwIMG5ChkSum" 115 "DFC_ComGwIMG5RingCnt" 116 "DFC_ComGwIMG5TOut" 117 "DFC_ComGwIMG6ChkSum" 118 "DFC_ComGwIMG6RingCnt" 119 "DFC_ComGwIMG6TOut" 120 "DFC_ComIDASBChksum" 121 "DFC_ComIDASBRingCnt" 122 "DFC_ComIDASBTOut" 450 "DFC_ComIDASBUnit" 123 "DFC_ComIMGMILReq" 451 "DFC_ComIMGUnit" 124 "DFC_ComISSPrms" 125 "DFC_ComMETAChksum" 126 "DFC_ComMETAChksumPstDrv" 127 "DFC_ComMETARingCnt" 128 "DFC_ComMETARingCntPstDrv" 129 "DFC_ComMETATOut" 130 "DFC_ComMETATOutPstDrv" 131 "DFC_ComMETCChksum" 132 "DFC_ComMETCRingCnt" 133 "DFC_ComMETCTOut" 134 "DFC_ComMETDChksum" 135 "DFC_ComMETDRingCnt" 136 "DFC_ComMETDTOut" 137 "DFC_ComMETE2Chksum" 138 "DFC_ComMETE2RingCnt" 139 "DFC_ComMETE2TOut" 140 "DFC_ComMETFChksum" 141 "DFC_ComMETFRingCnt" 142 "DFC_ComMETFTOut" 143 "DFC_ComMETGChksum" 144 "DFC_ComMETGRingCnt" 145 "DFC_ComMETGTOut" 146 "DFC_ComMETH2Chksum" 147 "DFC_ComMETH2RingCnt" 148 "DFC_ComMETH2TOut" 149 "DFC_ComMETHChksum" 150 "DFC_ComMETHRingCnt" 151 "DFC_ComMETHTOut" 152 "DFC_ComMETIChksum" 153 "DFC_ComMETIRingCnt" 154 "DFC_ComMETITOut" 155 "DFC_ComMETKChksum" 156 "DFC_ComMETKRingCnt" 157 "DFC_ComMETKTOut" 158 "DFC_ComMETLChksum" 159 "DFC_ComMETLRingCnt" 160 "DFC_ComMETLTOut" 161 "DFC_ComMETMChksum" 162 "DFC_ComMETMRingCnt" 163 "DFC_ComMETMTOut" 164 "DFC_ComMETNChksum" 165 "DFC_ComMETNRingCnt" 166 "DFC_ComMETNTOut" 452 "DFC_ComMETUnit" 167 "DFC_ComMtrCom" 168 "DFC_ComPCUChkSum" 169 "DFC_ComPCURingCnt" 170 "DFC_ComPCUTOut" 171 "DFC_ComSRSAChksum" 172 "DFC_ComSRSARingCnt" 173 "DFC_ComSRSATOut" 174 "DFC_ComSRSBChksum" 175 "DFC_ComSRSBRingCnt" 176 "DFC_ComSRSBTOut" 177 "DFC_ComSRSChksum" 178 "DFC_ComSRSErr" 179 "DFC_ComSRSRingCnt" 180 "DFC_ComSRSTOut" 453 "DFC_ComSRSUnit" 311 "DFC_ComTOutTCU01" 312 "DFC_ComTOutTCU02" 313 "DFC_ComTOutTCU1" 314 "DFC_ComTOutTCU11" 315 "DFC_ComTOutTCU12" 316 "DFC_ComTOutTCU13" 317 "DFC_ComTOutTCU14" 318 "DFC_ComTOutTCU2" 319 "DFC_ComTOutTCU3" 320 "DFC_ComTOutTCU4" 181 "DFC_ComVehSpdPndFltTCU" 454 "DFC_ComVSAUnit" 538 "DFC_DCDCFltDet" 321 "DFC_DevLibBattUHi" 322 "DFC_DevLibBattULo" 357 "DFC_DHFHD" 558 "DFC_DiagCpv1DteskLoLoadStuckClsd" 559 "DFC_DiagCpv1DteskLoLoadStuckOpen" 541 "DFC_DKnpl" 539 "DFC_DKRSA" 540 "DFC_DKVSmax" 542 "DFC_DSKVRmax" 543 "DFC_DSKVRmin" 544 "DFC_DSKVRnpl" 545 "DFC_DSKVRsig" 546 "DFC_DSKVSsig" 547 "DFC_DSSmax" 548 "DFC_DSTDmax" 549 "DFC_DSTEmax" 550 "DFC_DSTEmin" 551 "DFC_DSTOFmax" 552 "DFC_DSTRmax" 553 "DFC_DSTRmin" 554 "DFC_DSTRnpl" 555 "DFC_DSTRsig" 556 "DFC_DSTTI" 557 "DFC_DSUmax" 182 "DFC_EbsChartcCurrErr" 183 "DFC_EbsSelfDiagErr" 455 "DFC_EbsSocFlt" 395 "DFC_EGRVlvCurrLim" 560 "DFC_EGRVlvDrftClsd" 561 "DFC_EGRVlvDrftOpn" 323 "DFC_EGRVlvFailSafeActv" 324 "DFC_EGRVlvGovDvtCld" 562 "DFC_EGRVlvJamVlvClsd" 563 "DFC_EGRVlvJamVlvOpn" 396 "DFC_EGRVlvOL" 397 "DFC_EGRVlvOvrTemp" 325 "DFC_EGRVlvPhysSRCMax" 326 "DFC_EGRVlvPhysSRCMin" 398 "DFC_EGRVlvSCB" 399 "DFC_EGRVlvSCG" 564 "DFC_EGRVlvSprgBrk" 400 "DFC_EGRVlvSRCMax" 401 "DFC_EGRVlvSRCMin" 565 "DFC_EGRVlvTempMdlEEPErr" 566 "DFC_EGRVlvTmpErr" 567 "DFC_EGSDUS2B1LtrDly" 568 "DFC_EGSDUS2B1LtrPT1" 569 "DFC_EGSDUS2B1RtlDly" 570 "DFC_EGSDUS2B1RtlPT1" 571 "DFC_EGSDUS2B1TarLean" 572 "DFC_EGSDUS2B1TarRich" 586 "DFC_EngICO" 587 "DFC_EngPrtOvrSpdMon" 573 "DFC_EONVmax" 588 "DFC_EpmCaSI1ErrSig" 589 "DFC_EpmCaSI1MntErr" 590 "DFC_EpmCaSI1NoSigMax" 591 "DFC_EpmCaSI1NoSigMin" 592 "DFC_EpmCaSI1OfsErr" 593 "DFC_EpmCrSDGI" 594 "DFC_EpmCrSErrSig" 595 "DFC_EpmCrSNoSig" 596 "DFC_EtaEngIdleNonCsers" 597 "DFC_EtaEngPtlNonCsers" 574 "DFC_ETAKHLmax" 575 "DFC_ETAKHTmax" 576 "DFC_ETHSEmax" 577 "DFC_ETHSEmin" 578 "DFC_ETHSFmax" 579 "DFC_ETHSFmin" 580 "DFC_ETHSFsig" 581 "DFC_ETHSNPWmax" 582 "DFC_ETHSNPWmin" 583 "DFC_ETHSNPWsig" 584 "DFC_ETHSPLnpl" 585 "DFC_ETHSTPLnpl" 327 "DFC_FanDIOOL_0" 328 "DFC_FanDIOOL_1" 329 "DFC_FanDIOOvrTemp_0" 330 "DFC_FanDIOOvrTemp_1" 331 "DFC_FanDIOSCB_0" 332 "DFC_FanDIOSCB_1" 333 "DFC_FanDIOSCG_0" 334 "DFC_FanDIOSCG_1" 598 "DFC_FRAmax" 599 "DFC_FRAmin" 600 "DFC_FSTEmax" 601 "DFC_FSTEmin" 605 "DFC_FSTmax" 602 "DFC_FSTRmax" 603 "DFC_FSTRmin" 604 "DFC_FSTRnpl" 606 "DFC_FTDLAmax" 607 "DFC_FTDLAmin" 608 "DFC_FuPHiSnsrEleclmax" 609 "DFC_FuPHiSnsrEleclmin" 610 "DFC_FuPHiSnsrEleclnpl" 611 "DFC_FuPHiSnsrURngMax" 612 "DFC_FuPHiSnsrURngMin" 613 "DFC_FuSnsrPhyRngMaxErr" 614 "DFC_FuSnsrPhyRngMinErr" 188 "DFC_GbxCANDigPlausErr" 189 "DFC_GbxNPos1SRCMax" 190 "DFC_GbxNPos1SRCMin" 191 "DFC_GbxNPos2SRCMax" 192 "DFC_GbxNPos2SRCMin" 193 "DFC_GbxNPosAlvChk" 194 "DFC_GbxNPosSyncErr" 413 "DFC_GbxPNPosnDrvCdn" 414 "DFC_GbxPNPosnPlausy" 618 "DFC_GbxRvsSwtStk" 615 "DFC_GEVlvLockPinDiagIntkB1" 184 "DFC_GEVlvPhaCsersIntkB1" 185 "DFC_GEVlvPhaPsOpenLoadIntkB1" 186 "DFC_GEVlvPhaPsShoToBattIntkB1" 187 "DFC_GEVlvPhaPsShoToGndIntkB1" 616 "DFC_GEVlvPhaSlowIntkB1" 617 "DFC_GEVlvPhaTargIntkB1" 619 "DFC_HDRKHmax" 620 "DFC_HDRKHmin" 623 "DFC_HDRmax" 624 "DFC_HDRmin" 621 "DFC_HDRPLmax" 622 "DFC_HDRPLmin" 625 "DFC_HEGOS2B1ElecMax" 626 "DFC_HEGOS2B1ElecMin" 627 "DFC_HEGOS2B1ElecSig" 628 "DFC_HEGOS2B1HtgNpl" 195 "DFC_HEGOS2B1HtrPsMax" 196 "DFC_HEGOS2B1HtrPsMin" 197 "DFC_HEGOS2B1HtrPsSig" 629 "DFC_HEV00max" 630 "DFC_HEV01max" 631 "DFC_HEV02max" 632 "DFC_HEV03max" 633 "DFC_HEVE0max" 634 "DFC_HEVE1max" 635 "DFC_HFMmax" 636 "DFC_HiPSysHiPMaxLimExcdd" 402 "DFC_HLSDemOvhtEngLim" 456 "DFC_I14229VINErr" 261 "DFC_IgnClPs_DevComErr" 262 "DFC_IgnClPs_LineOl_0" 263 "DFC_IgnClPs_LineOl_1" 264 "DFC_IgnClPs_LineOl_2" 265 "DFC_IgnClPs_LineOl_3" 266 "DFC_IgnClPs_LineScb_0" 267 "DFC_IgnClPs_LineScb_1" 268 "DFC_IgnClPs_LineScb_2" 269 "DFC_IgnClPs_LineScb_3" 270 "DFC_IgnClPs_LineScg_0" 271 "DFC_IgnClPs_LineScg_1" 272 "DFC_IgnClPs_LineScg_2" 273 "DFC_IgnClPs_LineScg_3" 457 "DFC_InjCatHeatgErr" 458 "DFC_InjSysMulInjDiagErr" 358 "DFC_InjVlv_DI_DcDc" 359 "DFC_InjVlv_DI_NoLd_0" 360 "DFC_InjVlv_DI_NoLd_1" 361 "DFC_InjVlv_DI_NoLd_2" 362 "DFC_InjVlv_DI_NoLd_3" 363 "DFC_InjVlv_DI_ScBnk_0" 364 "DFC_InjVlv_DI_ScBnk_1" 365 "DFC_InjVlv_DI_ScBnk_2" 366 "DFC_InjVlv_DI_ScBnk_3" 367 "DFC_InjVlv_DI_ScCyl_0" 368 "DFC_InjVlv_DI_ScCyl_1" 369 "DFC_InjVlv_DI_ScCyl_2" 370 "DFC_InjVlv_DI_ScCyl_3" 371 "DFC_InjVlv_DI_ScHsLs_0" 372 "DFC_InjVlv_DI_ScHsLs_1" 373 "DFC_InjVlv_DI_ScHsLs_2" 374 "DFC_InjVlv_DI_ScHsLs_3" 652 "DFC_IntkAirTAirFltDsCrssMax" 653 "DFC_IntkAirTAirFltDsCrssMin" 654 "DFC_IntkAirTAirFltDsHSCMax" 655 "DFC_IntkAirTAirFltDsImps" 656 "DFC_IntkAirTAirFltDsPRCMax" 657 "DFC_IntkAirTAirFltDsPRCMin" 658 "DFC_IntkAirTAirFltDsSRCMax" 659 "DFC_IntkAirTAirFltDsSRCMin" 660 "DFC_IntkAirTAirFltDsSTC" 661 "DFC_IntkAirTIntkMnfldCrssMax" 662 "DFC_IntkAirTIntkMnfldCrssMin" 663 "DFC_IntkAirTIntkMnfldHSCMax" 664 "DFC_IntkAirTIntkMnfldImps" 665 "DFC_IntkAirTIntkMnfldPRCMax" 666 "DFC_IntkAirTIntkMnfldPRCMin" 667 "DFC_IntkAirTIntkMnfldSRCMax" 668 "DFC_IntkAirTIntkMnfldSRCMin" 669 "DFC_IntkAirTIntkMnfldSTC" 647 "DFC_IVGdiCtl_CvoErr" 648 "DFC_IVGdiCtl_CvoSigPlaus_0" 649 "DFC_IVGdiCtl_CvoSigPlaus_1" 650 "DFC_IVGdiCtl_CvoSigPlaus_2" 651 "DFC_IVGdiCtl_CvoSigPlaus_3" 637 "DFC_IVGdiCtlCvoErrMax_0" 638 "DFC_IVGdiCtlCvoErrMax_1" 639 "DFC_IVGdiCtlCvoErrMax_2" 640 "DFC_IVGdiCtlCvoErrMax_3" 641 "DFC_IVGdiCtlCvoErrMin_0" 642 "DFC_IVGdiCtlCvoErrMin_1" 643 "DFC_IVGdiCtlCvoErrMin_2" 644 "DFC_IVGdiCtlCvoErrMin_3" 645 "DFC_IVGdiCtlCvoErrMinMax" 646 "DFC_IVGdiCtlCvoSigPlausErrSmrCdn" 428 "DFC_KnDetSens1PortAMax" 429 "DFC_KnDetSens1PortAMin" 430 "DFC_KnDetSens1PortBMax" 431 "DFC_KnDetSens1PortBMin" 670 "DFC_KRREGRLMX" 671 "DFC_KRVEKOCVLCI" 672 "DFC_KRVEKOENCHMT" 673 "DFC_KRVEKOENCHMT0" 674 "DFC_KRVEKOENCHMT1" 675 "DFC_KRVEKOENCHMT2" 676 "DFC_KRVEKOENCHMT3" 677 "DFC_KRVEKOENCHMT4" 678 "DFC_KRVEKOENCHMT5" 679 "DFC_KRVEKOENCHMT6" 680 "DFC_KRVEKOENCHMT7" 274 "DFC_KRVEKOEVAB" 275 "DFC_KRVEKOEVAB0" 276 "DFC_KRVEKOEVAB1" 277 "DFC_KRVEKOEVAB2" 278 "DFC_KRVEKOEVAB3" 681 "DFC_KRVEKORLMX" 682 "DFC_KRVEKORLMXL" 683 "DFC_KS1max" 684 "DFC_KS1min" 687 "DFC_LamDynDiagS1B1" 688 "DFC_LeakIntkMnfldEmiInfl" 491 "DFC_LIN_E_TIMEOUT" 465 "DFC_LinACGUnit" 466 "DFC_LinAEVUnit" 198 "DFC_LinCSErrACG" 199 "DFC_LinCSErrAEV" 200 "DFC_LinCSErrDCDC" 201 "DFC_LinCSErrEBS" 467 "DFC_LinEBSUnit" 689 "DFC_LinFrameErrDCDC" 202 "DFC_LinHdrTimeoutErrACG" 203 "DFC_LinHdrTimeoutErrAEV" 204 "DFC_LinHdrTimeoutErrDCDC" 205 "DFC_LinHdrTimeoutErrEBS" 206 "DFC_LinMsgTimeoutErrACG" 207 "DFC_LinMsgTimeoutErrAEV" 208 "DFC_LinMsgTimeoutErrDCDC" 209 "DFC_LinMsgTimeoutErrEBS" 210 "DFC_LinNoStrtComErr" 690 "DFC_LinOverrunErrDCDC" 459 "DFC_LLRHmax" 460 "DFC_LLRHmin" 461 "DFC_LLRHnpl" 462 "DFC_LLRKHmax" 463 "DFC_LLRKHmin" 464 "DFC_LLRKHnpl" 685 "DFC_LMmax" 211 "DFC_LowPresOilP" 686 "DFC_LZSRnpl" 691 "DFC_MD00max" 692 "DFC_MDBmax" 693 "DFC_MDCat" 694 "DFC_MDCatCrit" 695 "DFC_MDCatCurr" 696 "DFC_MDCyl_0" 697 "DFC_MDCyl_1" 698 "DFC_MDCyl_2" 699 "DFC_MDCyl_3" 700 "DFC_MDEmi" 701 "DFC_MDEmiStrt" 702 "DFC_MDFco" 705 "DFC_MDmax" 703 "DFC_MDMpl" 704 "DFC_MDSegTiAdpn" 375 "DFC_MfPsDiaOpenLoad1" 376 "DFC_MfPsDiaScHiS1" 377 "DFC_MfPsDiaScHiSLowS1" 378 "DFC_MfPsDiaScLowS1" 706 "DFC_MFuOilMax" 228 "DFC_MisfDetdVWhlFrntLePlaus" 229 "DFC_MisfDetdVWhlFrntRiPlaus" 230 "DFC_MisfDetdVWhlReLePlaus" 231 "DFC_MisfDetdVWhlReRiPlaus" 212 "DFC_MisfDetVWhlFrntLeOORHi" 213 "DFC_MisfDetVWhlFrntLeRatyHi" 214 "DFC_MisfDetVWhlFrntLeRatyLo" 215 "DFC_MisfDetVWhlFrntLeStuck" 216 "DFC_MisfDetVWhlFrntRiOORHi" 217 "DFC_MisfDetVWhlFrntRiRatyHi" 218 "DFC_MisfDetVWhlFrntRiRatyLo" 219 "DFC_MisfDetVWhlFrntRiStuck" 220 "DFC_MisfDetVWhlReLeOORHi" 221 "DFC_MisfDetVWhlReLeRatyHi" 222 "DFC_MisfDetVWhlReLeRatyLo" 223 "DFC_MisfDetVWhlReLeStuck" 224 "DFC_MisfDetVWhlReRiOORHi" 225 "DFC_MisfDetVWhlReRiRatyHi" 226 "DFC_MisfDetVWhlReRiRatyLo" 227 "DFC_MisfDetVWhlReRiStuck" 801 "DFC_MoCADCNTP" 802 "DFC_MoCADCTst" 803 "DFC_MoCSOPICO" 805 "DFC_MoFAirFilgPrdc" 806 "DFC_MoFAirFlCtOffGdi" 807 "DFC_MoFAirFlCylGdi" 808 "DFC_MoFAirFlFF" 809 "DFC_MoFAirFlIn" 810 "DFC_MoFAirFlMixCtlGdiChkAirFl" 811 "DFC_MoFAirFlMixCtlGdiChkCtrl" 812 "DFC_MoFAirFlMode" 804 "DFC_MoFAPP" 813 "DFC_MoFESpd" 814 "DFC_MoFIACo" 815 "DFC_MoFICOL1" 816 "DFC_MoFICOL2" 817 "DFC_MoFStrt" 818 "DFC_MoFTrqCmp" 819 "DFC_MoFTrqCmpMax" 820 "DFC_MoFTrqCmpMin" 821 "DFC_MoFVarPostBldSel" 707 "DFC_MOXEMM_SMU_ALM0_0" 708 "DFC_MOXEMM_SMU_ALM0_1" 709 "DFC_MOXEMM_SMU_ALM0_10" 710 "DFC_MOXEMM_SMU_ALM0_11" 711 "DFC_MOXEMM_SMU_ALM0_13" 712 "DFC_MOXEMM_SMU_ALM0_14" 713 "DFC_MOXEMM_SMU_ALM0_2" 714 "DFC_MOXEMM_SMU_ALM0_22" 715 "DFC_MOXEMM_SMU_ALM0_23" 716 "DFC_MOXEMM_SMU_ALM0_4" 717 "DFC_MOXEMM_SMU_ALM0_5" 718 "DFC_MOXEMM_SMU_ALM0_7" 719 "DFC_MOXEMM_SMU_ALM0_8" 720 "DFC_MOXEMM_SMU_ALM10_16" 721 "DFC_MOXEMM_SMU_ALM10_17" 722 "DFC_MOXEMM_SMU_ALM10_21" 723 "DFC_MOXEMM_SMU_ALM11_0" 724 "DFC_MOXEMM_SMU_ALM11_1" 725 "DFC_MOXEMM_SMU_ALM11_2" 726 "DFC_MOXEMM_SMU_ALM11_3" 727 "DFC_MOXEMM_SMU_ALM11_4" 728 "DFC_MOXEMM_SMU_ALM11_5" 729 "DFC_MOXEMM_SMU_ALM11_8" 730 "DFC_MOXEMM_SMU_ALM11_9" 731 "DFC_MOXEMM_SMU_ALM1_0" 732 "DFC_MOXEMM_SMU_ALM1_1" 733 "DFC_MOXEMM_SMU_ALM1_10" 734 "DFC_MOXEMM_SMU_ALM1_11" 735 "DFC_MOXEMM_SMU_ALM1_13" 736 "DFC_MOXEMM_SMU_ALM1_14" 737 "DFC_MOXEMM_SMU_ALM1_2" 738 "DFC_MOXEMM_SMU_ALM1_22" 739 "DFC_MOXEMM_SMU_ALM1_23" 740 "DFC_MOXEMM_SMU_ALM1_4" 741 "DFC_MOXEMM_SMU_ALM1_5" 742 "DFC_MOXEMM_SMU_ALM1_7" 743 "DFC_MOXEMM_SMU_ALM1_8" 744 "DFC_MOXEMM_SMU_ALM21_0" 745 "DFC_MOXEMM_SMU_ALM21_16" 746 "DFC_MOXEMM_SMU_ALM21_3" 747 "DFC_MOXEMM_SMU_ALM2_1" 748 "DFC_MOXEMM_SMU_ALM2_10" 749 "DFC_MOXEMM_SMU_ALM2_11" 750 "DFC_MOXEMM_SMU_ALM2_13" 751 "DFC_MOXEMM_SMU_ALM2_14" 752 "DFC_MOXEMM_SMU_ALM2_22" 753 "DFC_MOXEMM_SMU_ALM2_23" 754 "DFC_MOXEMM_SMU_ALM2_4" 755 "DFC_MOXEMM_SMU_ALM2_5" 756 "DFC_MOXEMM_SMU_ALM2_7" 757 "DFC_MOXEMM_SMU_ALM2_8" 758 "DFC_MOXEMM_SMU_ALM6_0" 759 "DFC_MOXEMM_SMU_ALM6_11" 760 "DFC_MOXEMM_SMU_ALM6_12" 761 "DFC_MOXEMM_SMU_ALM6_14" 762 "DFC_MOXEMM_SMU_ALM6_15" 763 "DFC_MOXEMM_SMU_ALM6_17" 764 "DFC_MOXEMM_SMU_ALM6_18" 765 "DFC_MOXEMM_SMU_ALM6_20" 766 "DFC_MOXEMM_SMU_ALM6_21" 767 "DFC_MOXEMM_SMU_ALM6_25" 768 "DFC_MOXEMM_SMU_ALM6_4" 769 "DFC_MOXEMM_SMU_ALM6_5" 770 "DFC_MOXEMM_SMU_ALM6_7" 771 "DFC_MOXEMM_SMU_ALM6_8" 772 "DFC_MOXEMM_SMU_ALM7_1" 773 "DFC_MOXEMM_SMU_ALM7_12" 774 "DFC_MOXEMM_SMU_ALM7_13" 775 "DFC_MOXEMM_SMU_ALM7_14" 776 "DFC_MOXEMM_SMU_ALM7_15" 777 "DFC_MOXEMM_SMU_ALM7_16" 778 "DFC_MOXEMM_SMU_ALM7_17" 779 "DFC_MOXEMM_SMU_ALM7_2" 780 "DFC_MOXEMM_SMU_ALM7_20" 781 "DFC_MOXEMM_SMU_ALM7_25" 782 "DFC_MOXEMM_SMU_ALM7_26" 783 "DFC_MOXEMM_SMU_ALM7_28" 784 "DFC_MOXEMM_SMU_ALM7_29" 785 "DFC_MOXEMM_SMU_ALM7_30" 786 "DFC_MOXEMM_SMU_ALM7_31" 787 "DFC_MOXEMM_SMU_ALM8_0" 788 "DFC_MOXEMM_SMU_ALM8_1" 789 "DFC_MOXEMM_SMU_ALM8_10" 790 "DFC_MOXEMM_SMU_ALM8_11" 791 "DFC_MOXEMM_SMU_ALM8_12" 792 "DFC_MOXEMM_SMU_ALM8_16" 793 "DFC_MOXEMM_SMU_ALM8_18" 794 "DFC_MOXEMM_SMU_ALM8_2" 795 "DFC_MOXEMM_SMU_ALM8_3" 796 "DFC_MOXEMM_SMU_ALM8_31" 797 "DFC_MOXEMM_SMU_ALM8_4" 798 "DFC_MOXEMM_SMU_ALM9_0" 799 "DFC_MOXEMM_SMU_ALM9_15" 800 "DFC_MOXEMM_SMU_ALM9_3" 822 "DFC_MoXEMMHwLTMCUFW" 823 "DFC_MoXEMMHwLTMonBIST" 824 "DFC_MoXEMMHwLTRegMonTest" 825 "DFC_MoXEMMHwLTStbySMUAlvTest" 826 "DFC_MoXEMMHwLTTempSens" 827 "DFC_MoXEMMHwLTUCBCfg" 335 "DFC_MRlyDcOL" 336 "DFC_MRlyDcSCB" 337 "DFC_MRlyDcSCG" 492 "DFC_MRlyOL" 493 "DFC_MRlySCB" 494 "DFC_MRlySCG" 828 "DFC_NWSEmax" 829 "DFC_NWSmax" 830 "DFC_OCWDAABEActv" 831 "DFC_OCWDACom" 832 "DFC_OCWDAErrPin" 833 "DFC_OCWDAOvrVltg" 836 "DFC_OilPPlaus" 403 "DFC_OilPSwmpSRCMax" 404 "DFC_OilPSwmpSRCMin" 834 "DFC_ORAmax" 835 "DFC_ORAmin" 847 "DFC_P_VSE11_OL" 848 "DFC_P_VSE11_SCB" 849 "DFC_P_VSE11_SCG" 417 "DFC_PEnvCcMax" 418 "DFC_PEnvCcMin" 419 "DFC_PEnvRngChkMax" 420 "DFC_PEnvRngChkMin" 232 "DFC_PEnvSigRngMax" 233 "DFC_PEnvSigRngMin" 421 "DFC_PEnvSnsrPlaus" 850 "DFC_PhyHighAPP1" 851 "DFC_PhyHighAPP2" 852 "DFC_PhyLowAPP1" 853 "DFC_PhyLowAPP2" 405 "DFC_PIntkVUsLineHiB1" 406 "DFC_PIntkVUsLineLoB1" 837 "DFC_PLLSUmax" 838 "DFC_PLLSUmin" 338 "DFC_PSPOL" 339 "DFC_PSPOvrTemp" 340 "DFC_PSPSCB" 341 "DFC_PSPSCG" 839 "DFC_PSR1max" 840 "DFC_PSRBmax" 841 "DFC_PSRBmin" 845 "DFC_PSRmax" 842 "DFC_PSRPmax" 843 "DFC_PSRPmin" 844 "DFC_PSRPsig" 846 "DFC_PUmax" 475 "DFC_RBA_IODIAGPWR_rba_IoExtCy329_SignalVltSply_0" 476 "DFC_RBA_IODIAGPWR_rba_IoExtCy329_SignalVltSply_0OT" 477 "DFC_RBA_IODIAGPWR_rba_IoExtCy329_SignalVltSply_0OV" 478 "DFC_RBA_IODIAGPWR_rba_IoExtCy329_SignalVltSply_0SCG" 479 "DFC_RBA_IODIAGPWR_rba_IoExtCy329_SignalVltSply_0UV" 480 "DFC_RBA_IODIAGPWR_rba_IoExtCy329_SignalVltSply_1" 481 "DFC_RBA_IODIAGPWR_rba_IoExtCy329_SignalVltSply_1OT" 482 "DFC_RBA_IODIAGPWR_rba_IoExtCy329_SignalVltSply_1OV" 483 "DFC_RBA_IODIAGPWR_rba_IoExtCy329_SignalVltSply_1SCG" 484 "DFC_RBA_IODIAGPWR_rba_IoExtCy329_SignalVltSply_1UV" 485 "DFC_RBA_IODIAGPWR_rba_IoExtCy329_SignalVltSply_2" 486 "DFC_RBA_IODIAGPWR_rba_IoExtCy329_SignalVltSply_2OT" 487 "DFC_RBA_IODIAGPWR_rba_IoExtCy329_SignalVltSply_2OV" 488 "DFC_RBA_IODIAGPWR_rba_IoExtCy329_SignalVltSply_2SCG" 489 "DFC_RBA_IODIAGPWR_rba_IoExtCy329_SignalVltSply_2UV" 498 "DFC_RBA_IOEXTLIB_KEEPALIVE_DRV" 499 "DFC_RBA_IOEXTLIB_KEEPALIVE_INI" 500 "DFC_rba_IoSigRtc_StopCounter" 502 "DFC_rba_MemDiag_MemReadErr" 503 "DFC_rba_MemDiag_MemWrErr" 501 "DFC_rba_MRly_Diag_Stk_Event" 495 "DFC_rba_MultiStackTrace_Threshold" 504 "DFC_rba_SyC_IrrSwOffTrigEngRun_Event" 505 "DFC_rba_T15_Diag_ComInVld_Event" 506 "DFC_rba_T15_Diag_ComOff_HwOn_Event" 507 "DFC_rba_T15_Diag_ComOn_HwOff_Event" 468 "DFC_RoughRoad" 469 "DFC_SiaEEPRdErr" 470 "DFC_SiaEEPWrngCod" 854 "DFC_SRCHighAPP1" 855 "DFC_SRCHighAPP2" 856 "DFC_SRCLowAPP1" 857 "DFC_SRCLowAPP2" 858 "DFC_SSpMon2" 859 "DFC_STHDRmax" 234 "DFC_StmFault" 236 "DFC_StrtCtlErr" 235 "DFC_StrtCtOffPth" 237 "DFC_StrtFault" 238 "DFC_StrtLckJudg1" 239 "DFC_StrtLckJudg2" 240 "DFC_StrtOL" 241 "DFC_StrtOL2" 242 "DFC_StrtSCB" 243 "DFC_StrtSCB2" 244 "DFC_StrtSCG" 245 "DFC_StrtSCG2" 246 "DFC_StrtStkRly1" 247 "DFC_StrtStkRly2" 860 "DFC_SWReset_0" 861 "DFC_SWReset_1" 862 "DFC_SWReset_2" 863 "DFC_SyncAPP" 342 "DFC_T50Err" 865 "DFC_TAmax_Dummy" 864 "DFC_TANKLnpl" 866 "DFC_TESFmax" 867 "DFC_TESGmax" 248 "DFC_TEVEmax" 249 "DFC_TEVEmin" 250 "DFC_TEVEsig" 875 "DFC_ThrVlvClsdPosnFirstOffsLrnImpoB1" 876 "DFC_ThrVlvClsdPosnOffsLrnImpoB1" 877 "DFC_ThrVlvClsdPosnOffsLrnMaxB1" 878 "DFC_ThrVlvClsdPosnOffsLrnMinB1" 879 "DFC_ThrVlvCtrlDeB1" 880 "DFC_ThrVlvDycB1" 881 "DFC_ThrVlvLimpAirPosnMaxAbsltDriftB1" 882 "DFC_ThrVlvLimpAirPosnMaxB1" 883 "DFC_ThrVlvLimpAirPosnMaxRelDriftB1" 884 "DFC_ThrVlvLimpAirPosnMinB1" 343 "DFC_ThrVlvLoBattB1" 885 "DFC_ThrVlvOpenLoadB1" 886 "DFC_ThrVlvOpenSprgB1" 887 "DFC_ThrVlvOpenSprgSprdB1" 888 "DFC_ThrVlvOpenSprgTwnB1" 889 "DFC_ThrVlvOverTB1" 890 "DFC_ThrVlvRetSprgB1" 891 "DFC_ThrVlvRetSprgSprdB1" 892 "DFC_ThrVlvRetSprgTwnB1" 893 "DFC_ThrVlvSens1MaxB1" 900 "DFC_ThrvlvSens1MinB1" 894 "DFC_ThrVlvSens1NplB1" 895 "DFC_ThrVlvSens2MaxB1" 896 "DFC_ThrVlvSens2MinB1" 897 "DFC_ThrVlvSens2NplB1" 898 "DFC_ThrVlvShoCircB1" 899 "DFC_ThrVlvSpiErrB1" 901 "DFC_TiOffTBasdChkFast" 902 "DFC_TiOffTBasdChkSlow" 868 "DFC_TKAEmax" 869 "DFC_TKAEmin" 870 "DFC_TKARmax" 871 "DFC_TKARnpl" 872 "DFC_TMmax_Dummy" 873 "DFC_TUMmax_Dummy" 874 "DFC_TWCDPriCatB1" 251 "DFC_UegoHeatrPrfmncLoS1B1" 422 "DFC_UEGOHeatrRlyPsOLS1B1" 423 "DFC_UEGOHeatrRlyPsSCBS1B1" 424 "DFC_UEGOHeatrRlyPsSCGS1B1" 471 "DFC_UegoHeatrStrtS1B1" 425 "DFC_UegoHeatrWireOlS1B1" 426 "DFC_UegoHeatrWireScbS1B1" 427 "DFC_UegoHeatrWireScgS1B1" 279 "DFC_UegoSigEcuAsicS1B1" 280 "DFC_UegoSigEcuComS1B1" 344 "DFC_UegoSigOperPlausS1B1" 281 "DFC_UegoSigSnsrS1B1" 282 "DFC_UegoSigWireOlApesS1B1" 283 "DFC_UegoSigWireOlIpeS1B1" 284 "DFC_UegoSigWireOlReS1B1" 285 "DFC_UegoSigWireRCmpS1B1" 286 "DFC_UegoSigWireScbS1B1" 287 "DFC_UegoSigWireScgS1B1" 903 "DFC_UEGOSnsrMntdS1B1" 252 "DFC_VehVAllPlaus" 253 "DFC_VehVNCSnsrElecFailr" 345 "DFC_VehVPhysRngHi" 407 "DFC_VehVPhysRngLo" 254 "DFC_VehVPlausCan" 255 "DFC_VehVPlausFco" 256 "DFC_VehVPlausPwr" 257 "DFC_VehVPlausV2N" 346 "DFC_VehVSclOutOL" 347 "DFC_VehVSclOutOT" 348 "DFC_VehVSclOutSCB" 349 "DFC_VehVSclOutSCG" 904 "DFC_VehVSig" 408 "DFC_VehVSigCan" 409 "DFC_VehVSigCanSafe" 350 "DFC_VehVSigFL" 351 "DFC_VehVSigFR" 352 "DFC_VehVSigRL" 353 "DFC_VehVSigRR" 354 "DFC_VehVSnsrARngHi" 355 "DFC_VehVSnsrBRngHi" 356 "DFC_VehVSpdRtyDiag" 258 "DFC_VehVSpdSnsrAElecFailr" 259 "DFC_VehVSpdSnsrBElecFailr" 410 "DFC_VlvLftFbOilPSnsrIntk11SRCMax" 411 "DFC_VlvLftFbOilPSnsrIntk11SRCMin" 905 "DFC_VlvLftFbSwtIntk11SpclFail" 906 "DFC_VlvLftFbSwtIntk11StdFail" DEFAULT_VALUE "---" /end COMPU_VTAB
/begin COMPU_METHOD DSMBAS_SELNPID93BHVR_SC_Compu "" TAB_VERB "%6.3" "" COMPU_TAB_REF DSMBAS_SELNPID93BHVR_SC_Compu /end COMPU_METHOD
/begin COMPU_VTAB DSMBAS_SELNPID93BHVR_SC_Compu "" TAB_VERB 3 0 "DISABLE" 1 "READY_TO_DRIVE" 2 "ENGINE_RUNNING" /end COMPU_VTAB
/begin COMPU_METHOD DSMBAS_SELPID41BHVR_SC_Compu "" TAB_VERB "%6.3" "" COMPU_TAB_REF DSMBAS_SELPID41BHVR_SC_Compu /end COMPU_METHOD
/begin COMPU_VTAB DSMBAS_SELPID41BHVR_SC_Compu "" TAB_VERB 2 0 "PID41_DCYBASED" 1 "PID41_KEYONBASED" /end COMPU_VTAB
/begin COMPU_METHOD DSMBAS_TESTFAILDSNCELSTCLR_SC_Compu "" TAB_VERB "%6.3" "" COMPU_TAB_REF DSMBAS_TESTFAILDSNCELSTCLR_SC_Compu /end COMPU_METHOD
/begin COMPU_VTAB DSMBAS_TESTFAILDSNCELSTCLR_SC_Compu "" TAB_VERB 2 0 "False" 1 "True" /end COMPU_VTAB
/begin COMPU_METHOD DSMBAS_VAR_SY_Compu "" TAB_VERB "%6.3" "" COMPU_TAB_REF DSMBAS_VAR_SY_Compu /end COMPU_METHOD
/begin COMPU_VTAB DSMBAS_VAR_SY_Compu "" TAB_VERB 55 0 "kein Kundenbezug" 1 "DAI" 3 "VWW" 4 "POR" 5 "AUD" 6 "OPE" 9 "FIA" 11 "BMW" 14 "PSA" 15 "REN" 17 "ALF" 18 "SAB" 19 "VOL" 20 "NIS" 21 "GMU" 22 "FOR" 26 "IMJ" 36 "MAN" 51 "SEA" 53 "CHR" 54 "JAG" 55 "ROL" 69 "FER" 72 "TOY" 123 "MIT" 147 "HYU" 159 "HON" 160 "MAZ" 183 "CU" 190 "LRG" 204 "VVW" 214 "AVT" 242 "Iveco" 243 "DMC" 248 "SUZ" 267 "SSANGYONG" 270 "KEF" 289 "AMG" 308 "TAT" 319 "MVM" 328 "MM" 385 "UAES" 578 "AL" 590 "SCANIA" 609 "Deutz" 760 "WEICHAI" 828 "RBCD" 898 "MFTBC" 973 "YANMARJP" 984 "FAW" 999 "ALL" 2887 "Nonox" 9407 "DHC" 9454 "Fuso" 9740 "Navistar" /end COMPU_VTAB
/begin COMPU_METHOD DSMBAS_VIRTSDLG_SC_Compu "" TAB_VERB "%6.3" "" COMPU_TAB_REF DSMBAS_VIRTSDLG_SC_Compu /end COMPU_METHOD
/begin COMPU_VTAB DSMBAS_VIRTSDLG_SC_Compu "" TAB_VERB 2 0 "False" 1 "True" /end COMPU_VTAB
/begin COMPU_METHOD DSMBDEP_SY_Compu "" TAB_VERB "%6.3" "" COMPU_TAB_REF DSMBDEP_SY_Compu /end COMPU_METHOD
/begin COMPU_VTAB DSMBDEP_SY_Compu "" TAB_VERB 2 0 "False" 1 "True" /end COMPU_VTAB
/begin COMPU_METHOD DSMCONF_DEBMULDCY_SC_Compu "" TAB_VERB "%6.3" "" COMPU_TAB_REF DSMCONF_DEBMULDCY_SC_Compu /end COMPU_METHOD
/begin COMPU_VTAB DSMCONF_DEBMULDCY_SC_Compu "" TAB_VERB 2 0 "False" 1 "True" /end COMPU_VTAB
/begin COMPU_METHOD DSMCONF_NUMSPAREFID_SC_Compu "" RAT_FUNC "%6.2" "" COEFFS 0 1 0 0 0 1 /end COMPU_METHOD
/begin COMPU_METHOD DSMDUR_MIL_GLB_SY_Compu "" TAB_VERB "%6.3" "" COMPU_TAB_REF DSMDUR_MIL_GLB_SY_Compu /end COMPU_METHOD
/begin COMPU_VTAB DSMDUR_MIL_GLB_SY_Compu "" TAB_VERB 2 0 "FALSE" 1 "TRUE" /end COMPU_VTAB
/begin COMPU_METHOD DSMDUR_SUPPID4D_SC_Compu "" TAB_VERB "%6.3" "" COMPU_TAB_REF DSMDUR_SUPPID4D_SC_Compu /end COMPU_METHOD
/begin COMPU_VTAB DSMDUR_SUPPID4D_SC_Compu "" TAB_VERB 2 0 "False" 1 "True" /end COMPU_VTAB
/begin COMPU_METHOD DSMDUR_SUPPID4E_SC_Compu "" TAB_VERB "%6.3" "" COMPU_TAB_REF DSMDUR_SUPPID4E_SC_Compu /end COMPU_METHOD
/begin COMPU_VTAB DSMDUR_SUPPID4E_SC_Compu "" TAB_VERB 2 0 "False" 1 "True" /end COMPU_VTAB
/begin COMPU_METHOD DSMRDY_ENA_FLSYSFORCELABEL_SC_Compu "" TAB_VERB "%6.3" "" COMPU_TAB_REF DSMRDY_ENA_FLSYSFORCELABEL_SC_Compu /end COMPU_METHOD
/begin COMPU_VTAB DSMRDY_ENA_FLSYSFORCELABEL_SC_Compu "" TAB_VERB 2 0 "False" 1 "True" /end COMPU_VTAB
/begin COMPU_METHOD DSMRDY_ENGSPEC_SY_Compu "" TAB_VERB "%6.3" "" COMPU_TAB_REF DSMRDY_ENGSPEC_SY_Compu /end COMPU_METHOD
/begin COMPU_VTAB DSMRDY_ENGSPEC_SY_Compu "" TAB_VERB 2 0 "FALSE" 1 "TRUE" /end COMPU_VTAB
/begin COMPU_METHOD DSMRDY_INHP41_SY_Compu "" RAT_FUNC "%6.2" "" COEFFS 0 1 0 0 0 1 /end COMPU_METHOD
/begin COMPU_METHOD DSMRDY_SUPPID41_SY_Compu "" TAB_VERB "%6.3" "" COMPU_TAB_REF DSMRDY_SUPPID41_SY_Compu /end COMPU_METHOD
/begin COMPU_VTAB DSMRDY_SUPPID41_SY_Compu "" TAB_VERB 2 0 "FALSE" 1 "TRUE" /end COMPU_VTAB
/begin COMPU_METHOD DSMRDY_VERS_SC_Compu "" TAB_VERB "%6.3" "" COMPU_TAB_REF DSMRDY_VERS_SC_Compu /end COMPU_METHOD
/begin COMPU_VTAB DSMRDY_VERS_SC_Compu "" TAB_VERB 3 0 "DSMRDY_PRE_2009" 1 "DSMRDY_2009" 2 "DSMRDY_2020" /end COMPU_VTAB
/begin COMPU_METHOD DSM_DISBLGRPSIZE_SY_Compu "" RAT_FUNC "%6.2" "" COEFFS 0 1 0 0 0 1 /end COMPU_METHOD
/begin COMPU_METHOD DSM_DOBD_SC_Compu "" TAB_VERB "%6.3" "" COMPU_TAB_REF DSM_DOBD_SC_Compu /end COMPU_METHOD
/begin COMPU_VTAB DSM_DOBD_SC_Compu "" TAB_VERB 2 0 "False" 1 "True" /end COMPU_VTAB
/begin COMPU_METHOD DSM_DSM2SG_SY_Compu "" TAB_VERB "%6.3" "" COMPU_TAB_REF DSM_DSM2SG_SY_Compu /end COMPU_METHOD
/begin COMPU_VTAB DSM_DSM2SG_SY_Compu "" TAB_VERB 2 0 "False" 1 "True" /end COMPU_VTAB
/begin COMPU_METHOD DSM_DSMADENA_SC_Compu "" TAB_VERB "%6.3" "" COMPU_TAB_REF DSM_DSMADENA_SC_Compu /end COMPU_METHOD
/begin COMPU_VTAB DSM_DSMADENA_SC_Compu "" TAB_VERB 2 0 "DISABLE" 1 "ENABLE" /end COMPU_VTAB
/begin COMPU_METHOD DSM_DSMAPLCTRLDDIAGCYC_SC_Compu "" TAB_VERB "%6.3" "" COMPU_TAB_REF DSM_DSMAPLCTRLDDIAGCYC_SC_Compu /end COMPU_METHOD
/begin COMPU_VTAB DSM_DSMAPLCTRLDDIAGCYC_SC_Compu "" TAB_VERB 2 0 "False" 1 "True" /end COMPU_VTAB
/begin COMPU_METHOD DSM_FAILCNT_SY_Compu "" TAB_VERB "%6.3" "" COMPU_TAB_REF DSM_FAILCNT_SY_Compu /end COMPU_METHOD
/begin COMPU_VTAB DSM_FAILCNT_SY_Compu "" TAB_VERB 2 0 "False" 1 "True" /end COMPU_VTAB
/begin COMPU_METHOD DSM_FAULTSEQ_SY_Compu "" TAB_VERB "%6.3" "" COMPU_TAB_REF DSM_FAULTSEQ_SY_Compu /end COMPU_METHOD
/begin COMPU_VTAB DSM_FAULTSEQ_SY_Compu "" TAB_VERB 2 0 "False" 1 "True" /end COMPU_VTAB
/begin COMPU_METHOD DSM_HDOBD_SY_Compu "" TAB_VERB "%6.3" "" COMPU_TAB_REF DSM_HDOBD_SY_Compu /end COMPU_METHOD
/begin COMPU_VTAB DSM_HDOBD_SY_Compu "" TAB_VERB 2 0 "False" 1 "True" /end COMPU_VTAB
/begin COMPU_METHOD DSM_INHRLS_SY_Compu "" TAB_VERB "%6.3" "" COMPU_TAB_REF DSM_INHRLS_SY_Compu /end COMPU_METHOD
/begin COMPU_VTAB DSM_INHRLS_SY_Compu "" TAB_VERB 2 0 "0" 1 "1" /end COMPU_VTAB
/begin COMPU_METHOD DSM_MDOBD_SY_Compu "" TAB_VERB "%6.3" "" COMPU_TAB_REF DSM_MDOBD_SY_Compu /end COMPU_METHOD
/begin COMPU_VTAB DSM_MDOBD_SY_Compu "" TAB_VERB 2 0 "False" 1 "True" /end COMPU_VTAB
/begin COMPU_METHOD DSM_TESTMODDIAGCODLAMP_SC_Compu "" TAB_VERB "%6.3" "" COMPU_TAB_REF DSM_TESTMODDIAGCODLAMP_SC_Compu /end COMPU_METHOD
/begin COMPU_VTAB DSM_TESTMODDIAGCODLAMP_SC_Compu "" TAB_VERB 2 0 "Disabled" 1 "Enabled" /end COMPU_VTAB
/begin COMPU_METHOD DSM_WUCDET_SY_Compu "" TAB_VERB "%6.3" "" COMPU_TAB_REF DSM_WUCDET_SY_Compu /end COMPU_METHOD
/begin COMPU_VTAB DSM_WUCDET_SY_Compu "" TAB_VERB 7 0 "0" 1 "1" 2 "2" 3 "3" 4 "4" 5 "5" 255 "255" /end COMPU_VTAB
/begin COMPU_METHOD DTERSV_SC_Compu "" TAB_VERB "%6.3" "" COMPU_TAB_REF DTERSV_SC_Compu /end COMPU_METHOD
/begin COMPU_VTAB DTERSV_SC_Compu "" TAB_VERB 2 0 "False" 1 "True" /end COMPU_VTAB
/begin COMPU_METHOD dTrq "" RAT_FUNC "%6.3" "Nm/s" COEFFS 0 10 0 0 0 1 /end COMPU_METHOD
/begin COMPU_METHOD DTR_LEGIFC_SY_Compu "" TAB_VERB "%6.3" "" COMPU_TAB_REF DTR_LEGIFC_SY_Compu /end COMPU_METHOD
/begin COMPU_VTAB DTR_LEGIFC_SY_Compu "" TAB_VERB 2 0 "DISABLED" 1 "ENABLED" /end COMPU_VTAB
/begin COMPU_METHOD DtTemp_KPerSec_q0p01_COMPU "" RAT_FUNC "%6.4" "K/s" COEFFS 0 100 0 0 0 1 /end COMPU_METHOD
/begin COMPU_METHOD DtyCycSlp "" RAT_FUNC "%6.5" "%/s" COEFFS 0 1000 0 0 0 1 /end COMPU_METHOD
/begin COMPU_METHOD dt_TempKelv_p_s "" RAT_FUNC "%6.3" "K/s" COEFFS 0 10 0 0 0 1 /end COMPU_METHOD
/begin COMPU_METHOD DVE_VERS_SY_Compu "" TAB_VERB "%6.3" "" COMPU_TAB_REF DVE_VERS_SY_Compu /end COMPU_METHOD
/begin COMPU_VTAB DVE_VERS_SY_Compu "" TAB_VERB 2 1 "DV-E powered by main relay" 2 "DV-E powered by injection relay" /end COMPU_VTAB
/begin COMPU_METHOD DYNDMDCHRGCTRLCAMSFT_SC_Compu "" TAB_VERB "%6.3" "" COMPU_TAB_REF DYNDMDCHRGCTRLCAMSFT_SC_Compu /end COMPU_METHOD
/begin COMPU_VTAB DYNDMDCHRGCTRLCAMSFT_SC_Compu "" TAB_VERB 3 0 "no special charge control by camshaft" 1 "charge control by camshaft (map based)" 2 "charge control during naturally-aspirated area wit" /end COMPU_VTAB
/begin COMPU_METHOD ECAT_NRBRICK_SC_Compu "" TAB_VERB "%6.3" "" COMPU_TAB_REF ECAT_NRBRICK_SC_Compu /end COMPU_METHOD
/begin COMPU_VTAB ECAT_NRBRICK_SC_Compu "" TAB_VERB 3 0 "0" 1 "1" 2 "2" /end COMPU_VTAB
/begin COMPU_METHOD ECLTYP_SY_Compu "" TAB_VERB "%6.3" "" COMPU_TAB_REF ECLTYP_SY_Compu /end COMPU_METHOD
/begin COMPU_VTAB ECLTYP_SY_Compu "" TAB_VERB 3 0 "ECLTYP_NOCLTH" 1 "ECLTYP_IMPCLTH" 2 "ECLTYP_PROPCLTH" /end COMPU_VTAB
/begin COMPU_METHOD ECOMOD_SC_Compu "" TAB_VERB "%6.3" "" COMPU_TAB_REF ECOMOD_SC_Compu /end COMPU_METHOD
/begin COMPU_VTAB ECOMOD_SC_Compu "" TAB_VERB 2 0 "False" 1 "True" /end COMPU_VTAB
/begin COMPU_METHOD ECSSTRTSTOPCOAST_SC_Compu "" TAB_VERB "%6.3" "" COMPU_TAB_REF ECSSTRTSTOPCOAST_SC_Compu /end COMPU_METHOD
/begin COMPU_VTAB ECSSTRTSTOPCOAST_SC_Compu "" TAB_VERB 2 0 "DISABLED" 1 "ENABLED" /end COMPU_VTAB
/begin COMPU_METHOD ECUNUM_SY_Compu "" TAB_VERB "%6.3" "" COMPU_TAB_REF ECUNUM_SY_Compu /end COMPU_METHOD
/begin COMPU_VTAB ECUNUM_SY_Compu "" TAB_VERB 3 1 "ECUNUM_1" 2 "ECUNUM_2" 3 "ECUNUM_3" /end COMPU_VTAB
/begin COMPU_METHOD ECUOFF_TMR_SY_Compu "" TAB_VERB "%6.3" "" COMPU_TAB_REF ECUOFF_TMR_SY_Compu /end COMPU_METHOD
/begin COMPU_VTAB ECUOFF_TMR_SY_Compu "" TAB_VERB 7 0 "0" 1 "1" 2 "2" 3 "3" 4 "4" 5 "5" 6 "6" /end COMPU_VTAB
/begin COMPU_METHOD ECUTYP_SC_Compu "" TAB_VERB "%6.3" "" COMPU_TAB_REF ECUTYP_SC_Compu /end COMPU_METHOD
/begin COMPU_VTAB ECUTYP_SC_Compu "" TAB_VERB 8 0 "EngEcu" 1 "InvrEcu" 2 "VehEcu" 3 "BattEcu" 4 "DosECU" 6 "PmpECU" 7 "TCMEcu" 8 "FuCellEcu" /end COMPU_VTAB
/begin COMPU_METHOD ECU_GENR_SY_Compu "" TAB_VERB "%6.3" "" COMPU_TAB_REF ECU_GENR_SY_Compu /end COMPU_METHOD
/begin COMPU_VTAB ECU_GENR_SY_Compu "" TAB_VERB 8 0 "Mx7" 1 "Mx9" 2 "Mx17" 3 "EDC17" 4 "VMx17" 5 "DCU17" 6 "MDG1C" 7 "MDG2" /end COMPU_VTAB
/begin COMPU_METHOD EffGrad "" RAT_FUNC "%7.6" "1/s" COEFFS 0 10000 0 0 0 1 /end COMPU_METHOD
/begin COMPU_METHOD EffGradAr "" RAT_FUNC "%8.7" "1/s" COEFFS 0 100000 0 0 0 1 /end COMPU_METHOD
/begin COMPU_METHOD EffGradPrc "" RAT_FUNC "%8.7" "1/s" COEFFS 0 819200 0 0 0 1 /end COMPU_METHOD
/begin COMPU_METHOD EGRCAMSFT_SC_Compu "" RAT_FUNC "%6.2" "" COEFFS 0 1 0 0 0 1 /end COMPU_METHOD
/begin COMPU_METHOD EGRCLGPRS_SY_Compu "" TAB_VERB "%6.3" "" COMPU_TAB_REF EGRCLGPRS_SY_Compu /end COMPU_METHOD
/begin COMPU_VTAB EGRCLGPRS_SY_Compu "" TAB_VERB 2 0 "False" 1 "True" /end COMPU_VTAB
/begin COMPU_METHOD EGRFROMEXHMNFLDFORCHRGSYS_SC_Compu "" TAB_VERB "%6.3" "" COMPU_TAB_REF EGRFROMEXHMNFLDFORCHRGSYS_SC_Compu /end COMPU_METHOD
/begin COMPU_VTAB EGRFROMEXHMNFLDFORCHRGSYS_SC_Compu "" TAB_VERB 2 0 "False" 1 "True" /end COMPU_VTAB
/begin COMPU_METHOD EGRHPMIXPOSN_SC_Compu "" TAB_VERB "%6.3" "" COMPU_TAB_REF EGRHPMIXPOSN_SC_Compu /end COMPU_METHOD
/begin COMPU_VTAB EGRHPMIXPOSN_SC_Compu "" TAB_VERB 2 0 "0" 1 "1" /end COMPU_VTAB
/begin COMPU_METHOD EGRLPACTRCONF_SY_Compu "" TAB_VERB "%6.3" "" COMPU_TAB_REF EGRLPACTRCONF_SY_Compu /end COMPU_METHOD
/begin COMPU_VTAB EGRLPACTRCONF_SY_Compu "" TAB_VERB 5 0 "0" 1 "1" 2 "2" 3 "3" 4 "4" /end COMPU_VTAB
/begin COMPU_METHOD EGRLPPRS_SY_Compu "" TAB_VERB "%6.3" "" COMPU_TAB_REF EGRLPPRS_SY_Compu /end COMPU_METHOD
/begin COMPU_VTAB EGRLPPRS_SY_Compu "" TAB_VERB 2 0 "FALSE" 1 "TRUE" /end COMPU_VTAB
/begin COMPU_METHOD EGRVLVAIRACTR_SC_Compu "" TAB_VERB "%6.3" "" COMPU_TAB_REF EGRVLVAIRACTR_SC_Compu /end COMPU_METHOD
/begin COMPU_VTAB EGRVLVAIRACTR_SC_Compu "" TAB_VERB 2 0 "False" 1 "True" /end COMPU_VTAB
/begin COMPU_METHOD EGRVLVCOOLG_SC_Compu "" TAB_VERB "%6.3" "" COMPU_TAB_REF EGRVLVCOOLG_SC_Compu /end COMPU_METHOD
/begin COMPU_VTAB EGRVLVCOOLG_SC_Compu "" TAB_VERB 2 0 "NOT_COOLED" 1 "COOLANT" /end COMPU_VTAB
/begin COMPU_METHOD EGRVLVINSDT_TYPAVL_SC_Compu "" TAB_VERB "%6.3" "" COMPU_TAB_REF EGRVLVINSDT_TYPAVL_SC_Compu /end COMPU_METHOD
/begin COMPU_VTAB EGRVLVINSDT_TYPAVL_SC_Compu "" TAB_VERB 2 0 "False" 1 "True" /end COMPU_VTAB
/begin COMPU_METHOD EGRVLVI_TYPAVL_SC_Compu "" TAB_VERB "%6.3" "" COMPU_TAB_REF EGRVLVI_TYPAVL_SC_Compu /end COMPU_METHOD
/begin COMPU_VTAB EGRVLVI_TYPAVL_SC_Compu "" TAB_VERB 2 0 "False" 1 "True" /end COMPU_VTAB
/begin COMPU_METHOD EGRVLVLPI_TYPAVL_SC_Compu "" TAB_VERB "%6.3" "" COMPU_TAB_REF EGRVLVLPI_TYPAVL_SC_Compu /end COMPU_METHOD
/begin COMPU_VTAB EGRVLVLPI_TYPAVL_SC_Compu "" TAB_VERB 2 0 "False" 1 "True" /end COMPU_VTAB
/begin COMPU_METHOD EGRVLV_TYPAVL_SC_Compu "" TAB_VERB "%6.3" "" COMPU_TAB_REF EGRVLV_TYPAVL_SC_Compu /end COMPU_METHOD
/begin COMPU_VTAB EGRVLV_TYPAVL_SC_Compu "" TAB_VERB 2 0 "False" 1 "True" /end COMPU_VTAB
/begin COMPU_METHOD EGRVLV_TYPAVL_SY_Compu "" TAB_VERB "%6.3" "" COMPU_TAB_REF EGRVLV_TYPAVL_SY_Compu /end COMPU_METHOD
/begin COMPU_VTAB EGRVLV_TYPAVL_SY_Compu "" TAB_VERB 2 0 "FALSE" 1 "TRUE" /end COMPU_VTAB
/begin COMPU_METHOD EGSDIAPARL_SC_Compu "" TAB_VERB "%6.3" "" COMPU_TAB_REF EGSDIAPARL_SC_Compu /end COMPU_METHOD
/begin COMPU_VTAB EGSDIAPARL_SC_Compu "" TAB_VERB 2 0 "False" 1 "True" /end COMPU_VTAB
/begin COMPU_METHOD EGSDIA_ATS_SC_Compu "" TAB_VERB "%6.3" "" COMPU_TAB_REF EGSDIA_ATS_SC_Compu /end COMPU_METHOD
/begin COMPU_VTAB EGSDIA_ATS_SC_Compu "" TAB_VERB 2 0 "False" 1 "True" /end COMPU_VTAB
/begin COMPU_METHOD EGSDIA_CATHEATGTWCDIAG_SC_Compu "" TAB_VERB "%6.3" "" COMPU_TAB_REF EGSDIA_CATHEATGTWCDIAG_SC_Compu /end COMPU_METHOD
/begin COMPU_VTAB EGSDIA_CATHEATGTWCDIAG_SC_Compu "" TAB_VERB 2 0 "No catalyst heating for TWC diagnose" 1 "Catalyst heating for TWC diagnose" /end COMPU_VTAB
/begin COMPU_METHOD EGSDIA_CONSDRPRODRESI_SC_Compu "" TAB_VERB "%6.3" "" COMPU_TAB_REF EGSDIA_CONSDRPRODRESI_SC_Compu /end COMPU_METHOD
/begin COMPU_VTAB EGSDIA_CONSDRPRODRESI_SC_Compu "" TAB_VERB 2 0 "False" 1 "True" /end COMPU_VTAB
/begin COMPU_METHOD EGSDIA_CSTRPURGLOLOADEXCLSN_SC_Compu "" TAB_VERB "%6.3" "" COMPU_TAB_REF EGSDIA_CSTRPURGLOLOADEXCLSN_SC_Compu /end COMPU_METHOD
/begin COMPU_VTAB EGSDIA_CSTRPURGLOLOADEXCLSN_SC_Compu "" TAB_VERB 2 0 "False" 1 "True" /end COMPU_VTAB
/begin COMPU_METHOD EGSDIA_LAMDYNMULTIDFC_SC_Compu "" TAB_VERB "%6.3" "" COMPU_TAB_REF EGSDIA_LAMDYNMULTIDFC_SC_Compu /end COMPU_METHOD
/begin COMPU_VTAB EGSDIA_LAMDYNMULTIDFC_SC_Compu "" TAB_VERB 2 0 "One_DFC" 1 "Multiple_DFCs" /end COMPU_VTAB
/begin COMPU_METHOD EGSDIA_LAMPLAUS_SC_Compu "" TAB_VERB "%6.3" "" COMPU_TAB_REF EGSDIA_LAMPLAUS_SC_Compu /end COMPU_METHOD
/begin COMPU_VTAB EGSDIA_LAMPLAUS_SC_Compu "" TAB_VERB 3 0 "0" 1 "1" 2 "2" /end COMPU_VTAB
/begin COMPU_METHOD EGSDIA_SNSRTYPES0B1_SC_Compu "" TAB_VERB "%6.3" "" COMPU_TAB_REF EGSDIA_SNSRTYPES0B1_SC_Compu /end COMPU_METHOD
/begin COMPU_VTAB EGSDIA_SNSRTYPES0B1_SC_Compu "" TAB_VERB 4 0 "NO_SENSOR" 1 "UEGO_SENSOR" 2 "NOX_SENSOR" 3 "HEGO_SENSOR" /end COMPU_VTAB
/begin COMPU_METHOD EngN "" RAT_FUNC "%6.3" "rpm" COEFFS 0 2 0 0 0 1 /end COMPU_METHOD
/begin COMPU_METHOD EngNCrCtl "" RAT_FUNC "%6.2" "rpm" COEFFS 0 1 0 0 0 1 /end COMPU_METHOD
/begin COMPU_METHOD Fact_CrCtl "" RAT_FUNC "%6.4" "-" COEFFS 0 256 0 0 0 1 /end COMPU_METHOD
/begin COMPU_METHOD fak_q3p0518Em5 "" RAT_FUNC "%7.6" "" COEFFS 0 32768 0 0 0 1 /end COMPU_METHOD
/begin COMPU_METHOD NToVel_CrCtl "" RAT_FUNC "%6.4" "-" COEFFS 0 256 0 0 0 1 /end COMPU_METHOD
/begin COMPU_METHOD OneToOne "" RAT_FUNC "%6.2" "-" COEFFS 0 1 0 0 0 1 /end COMPU_METHOD
/begin COMPU_METHOD Prc_CrCtl4 "" RAT_FUNC "%6.4" "%" COEFFS 0 256 0 0 0 1 /end COMPU_METHOD
/begin COMPU_METHOD rel_q0p00153 "" RAT_FUNC "%6.4" "%" COEFFS 0 65536 0 0 0 100 /end COMPU_METHOD
/begin COMPU_METHOD rel_q0p1 "" RAT_FUNC "%6.3" "%" COEFFS 0 10 0 0 0 1 /end COMPU_METHOD
/begin COMPU_METHOD rel_q0p39 "" RAT_FUNC "%6.3" "%" COEFFS 0 256 0 0 0 100 /end COMPU_METHOD
/begin COMPU_METHOD Time_ms "" RAT_FUNC "%6.1" "ms" COEFFS 0 0.1 0 0 0 1 /end COMPU_METHOD
/begin COMPU_METHOD Time_ms_100ms "" RAT_FUNC "%6.0" "ms" COEFFS 0 0.01 0 0 0 1 /end COMPU_METHOD
/begin COMPU_METHOD t_q0p1 "" RAT_FUNC "%6.3" "s" COEFFS 0 10 0 0 0 1 /end COMPU_METHOD
/begin COMPU_METHOD Vel "" RAT_FUNC "%6.4" "km/h" COEFFS 0 100 0 0 0 1 /end COMPU_METHOD
/begin COMPU_METHOD Vel_CrCtl "" RAT_FUNC "%6.4" "km/h" COEFFS 0 256 0 0 0 1 /end COMPU_METHOD
/begin COMPU_METHOD Vel_CrCtl1 "" RAT_FUNC "%6.2" "km/h" COEFFS 0 1 0 0 0 1 /end COMPU_METHOD
/begin COMPU_METHOD zk100msxs_uw_b6553 "" RAT_FUNC "%6.1" "s" COEFFS 0 0 65536 0 10 0 /end COMPU_METHOD
/begin COMPU_METHOD default "" RAT_FUNC "%6.2" "" COEFFS 0 1 0 0 0 1 /end COMPU_METHOD
/*********** End of merged RECORD_LAYOUT blocks ***********/
/begin RECORD_LAYOUT Axis_Xs16 NO_AXIS_PTS_X 1 SWORD AXIS_PTS_X 2 SWORD INDEX_INCR DIRECT /end RECORD_LAYOUT
/begin RECORD_LAYOUT CurG_Ws16 FNC_VALUES 1 SWORD COLUMN_DIR DIRECT /end RECORD_LAYOUT
/begin RECORD_LAYOUT Cur_Xs16Ws16 NO_AXIS_PTS_X 1 SWORD AXIS_PTS_X 2 SWORD INDEX_INCR DIRECT FNC_VALUES 3 SWORD COLUMN_DIR DIRECT /end RECORD_LAYOUT
/begin RECORD_LAYOUT KwbUb FNC_VALUES 1 UBYTE COLUMN_DIR DIRECT /end RECORD_LAYOUT
/begin RECORD_LAYOUT Map_Xs16Ys16Ws16 NO_AXIS_PTS_X 1 SWORD NO_AXIS_PTS_Y 2 SWORD AXIS_PTS_X 3 SWORD INDEX_INCR DIRECT AXIS_PTS_Y 4 SWORD INDEX_INCR DIRECT FNC_VALUES 5 SWORD COLUMN_DIR DIRECT /end RECORD_LAYOUT
/begin RECORD_LAYOUT RB_Cur_Xs16Ws16 NO_AXIS_PTS_X 1 SWORD AXIS_PTS_X 2 SWORD INDEX_INCR DIRECT FNC_VALUES 3 SWORD COLUMN_DIR DIRECT /end RECORD_LAYOUT
/begin RECORD_LAYOUT RB_ValA_Wu16 FNC_VALUES 1 UWORD COLUMN_DIR DIRECT /end RECORD_LAYOUT
/begin RECORD_LAYOUT RB_ValA_Wu8 FNC_VALUES 1 UBYTE COLUMN_DIR DIRECT /end RECORD_LAYOUT
/begin RECORD_LAYOUT RB_Val_Ws16 FNC_VALUES 1 SWORD COLUMN_DIR DIRECT /end RECORD_LAYOUT
/begin RECORD_LAYOUT RB_Val_Wu16 FNC_VALUES 1 UWORD COLUMN_DIR DIRECT /end RECORD_LAYOUT
/begin RECORD_LAYOUT RB_Val_Wu8 FNC_VALUES 1 UBYTE COLUMN_DIR DIRECT /end RECORD_LAYOUT
/begin RECORD_LAYOUT ValA_Wu8 FNC_VALUES 1 UBYTE COLUMN_DIR DIRECT /end RECORD_LAYOUT
/begin RECORD_LAYOUT Val_Ws16 FNC_VALUES 1 SWORD COLUMN_DIR DIRECT /end RECORD_LAYOUT
/begin RECORD_LAYOUT Val_Ws32 FNC_VALUES 1 SLONG COLUMN_DIR DIRECT /end RECORD_LAYOUT
/begin RECORD_LAYOUT Val_Wu16 FNC_VALUES 1 UWORD COLUMN_DIR DIRECT /end RECORD_LAYOUT
/begin RECORD_LAYOUT Val_Wu8 FNC_VALUES 1 UBYTE COLUMN_DIR DIRECT /end RECORD_LAYOUT
/end MODULE
/end PROJECT
