ASAP2_VERSION 1 60
/begin PROJECT MG1CS022 "MG1CS022"
/begin HEADER "" VERSION "MG1CS022_62XSC_V037_TPROT" PROJECT_NO MG1CS022 /end HEADER
/begin MODULE DIM ""
/begin MOD_COMMON "" BYTE_ORDER MSB_LAST ALIGNMENT_BYTE 1 ALIGNMENT_WORD 2 ALIGNMENT_LONG 4 ALIGNMENT_INT64 4 ALIGNMENT_FLOAT32_IEEE 4 ALIGNMENT_FLOAT64_IEEE 4 DATA_SIZE 32 /end MOD_COMMON
/begin CHARACTERISTIC ANZAUSGADA "Number of significant adaptation-periods for adated fuel evaporation from oil" VALUE 0x805431E8 RB_Val_Wu16 65535.00 dez 0.00 65535.00 FORMAT "%8.2" /end CHARACTERISTIC
/begin CHARACTERISTIC AUSGTIA "Array for configuration of the oder of teh measures maximize ti" VAL_BLK 0x805431EA RB_ValA_Wu8 255.0 dez 0.00 255.0 FORMAT "%5.1" NUMBER 3 /end CHARACTERISTIC
/begin CHARACTERISTIC CWAUSGMOD "code word for configuration of model for fuel evaporation from oil" VALUE 0x805431ED RB_Val_Wu8 255.0 dez 0.00 255.0 FORMAT "%5.1" /end CHARACTERISTIC
/begin CHARACTERISTIC CWBGAUSG "code word for configuration of BGAUSG" VALUE 0x805431EE RB_Val_Wu8 255.0 dez 0.00 255.0 FORMAT "%5.1" /end CHARACTERISTIC
/begin CHARACTERISTIC CWBGOELWF "Codeword for the function BGOELWAFA" VALUE 0x80543500 RB_Val_Wu8 255.0 dez 0.00 255.0 FORMAT "%5.1" /end CHARACTERISTIC
/begin CHARACTERISTIC CWSTENGKH "Codeword: release switch off engine in due of exhaust system" VALUE 0x8053F27C RB_Val_Wu16 65535.00 dez 0.00 65535.00 FORMAT "%8.2" /end CHARACTERISTIC
/begin CHARACTERISTIC DCHANGEANR "delta enrichment of lambda" VALUE 0x8054343E RB_Val_Wu16 0.9999847 fak_q1p5258Em5 0.00 0.9999847 FORMAT "%9.7" /end CHARACTERISTIC
/begin CHARACTERISTIC DDMLLKORLU "Threshold switch off LAMKORRLL at rough idlespeed behaviour" CURVE 0x80543440 RB_Curve_S16_U16_Static 199.9969 rel_sw_b100 0.00 199.9969 FORMAT "%8.4"
 /begin AXIS_DESCR STD_AXIS sdluts_w_msg lu_MEx 5 -232.8306 232.8235 FORMAT "%8.4" DEPOSIT ABSOLUTE /end AXIS_DESCR
/end CHARACTERISTIC
/begin CHARACTERISTIC DFAMPLANR "delta maximum enrichment of lamba at idle" VALUE 0x80543456 RB_Val_Wu16 0.9999847 fak_q1p5258Em5 0.00 0.9999847 FORMAT "%9.7" /end CHARACTERISTIC
/begin CHARACTERISTIC DFGAUSGLIM "Delta hysteresis for significant evaporation from oil" VALUE 0x805431EF RB_Val_Wu8 1.992188 fak_ub_b2 0.00 1.992188 FORMAT "%8.6" /end CHARACTERISTIC
/begin CHARACTERISTIC DFRMNOAUSG "Threshold for mixture control for detection of end of evaporation" VALUE 0x805431F0 RB_Val_Wu8 1.992188 fak_ub_b2 0.00 1.992188 FORMAT "%8.6" /end CHARACTERISTIC
/begin CHARACTERISTIC DLAKORMX "maximum of delta of the correction of lambda at idle" VALUE 0x80543458 RB_Val_Wu16 1.999969 fak_uw_b2 0.00 1.999969 FORMAT "%8.6" /end CHARACTERISTIC
/begin CHARACTERISTIC DLNANRMXTM "Char, line lean activation" CURVE 0x8054345A RB_Curve_S16_S16 1.999969 fak_sw_b1 -1.000000 0.999969 FORMAT "%8.6" EXTENDED_LIMITS -1.000000 0.9999695
 /begin AXIS_DESCR STD_AXIS EngStrt_tEng temp_ub_q0p75_o48 5 -48.0000 143.2500 FORMAT "%8.4" EXTENDED_LIMITS -24624.00 24527.25 DEPOSIT ABSOLUTE /end AXIS_DESCR
/end CHARACTERISTIC
/begin CHARACTERISTIC DMRTMKI "Increment of control factor of torque limitation due to engine temperature" VALUE 0x80542BB8 RB_Val_Wu8 1.992188 fak_ub_b2 0.00 1.992188 FORMAT "%8.6" /end CHARACTERISTIC
/begin CHARACTERISTIC DMRTMKIE "Increment factor for torque limitation due to engine temperature." VALUE 0x80542CA8 RB_Val_Wu8 1.992188 fak_ub_b2 0.00 1.992188 FORMAT "%8.6" /end CHARACTERISTIC
/begin CHARACTERISTIC DMXOELUB "Histersys value for setting mx. level of fuel in oil" VALUE 0x80543502 RB_Val_Wu16 2684.314 m_q0p04096 0.00 2684.314 FORMAT "%8.3" /end CHARACTERISTIC
/begin CHARACTERISTIC DNSOLLKORX "threshold of allowed speed difference (nsol-nstat) for the activation of the correction of lambda at idle" VALUE 0x80543470 RB_Val_Wu16 32767.50 nmot_q0p5 0.00 32767.50 FORMAT "%8.2" /end CHARACTERISTIC
/begin CHARACTERISTIC DRIANRMXTM "Char. Line rich lambda activation" CURVE 0x80543472 RB_Curve_S16_S16 1.999969 fak_sw_b1 -1.000000 0.999969 FORMAT "%8.6" EXTENDED_LIMITS -1.000000 0.9999695
 /begin AXIS_DESCR STD_AXIS EngStrt_tEng temp_ub_q0p75_o48 5 -48.0000 143.2500 FORMAT "%8.4" EXTENDED_LIMITS -24624.00 24527.25 DEPOSIT ABSOLUTE /end AXIS_DESCR
/end CHARACTERISTIC
/begin CHARACTERISTIC DTMIBG "Delta temperature for hysteresis loop" VALUE 0x80542BB9 RB_Val_Wu8 191.3 temp_ub_b191p25 0.00 191.3 FORMAT "%5.1" /end CHARACTERISTIC
/begin CHARACTERISTIC EngPrt_dPwrExhGasOvht_T "Ramp slopes for power limitation at exhaust gas overheating" CURVE 0x80542AD0 RB_Curve_S16_S16 3276.700 Pwr_10kW_Sec 0.00 3276.700 FORMAT "%8.3" EXTENDED_LIMITS -3276.800 3276.700
 /begin AXIS_DESCR STD_AXIS EngPrt_tManifMod_MP TempDiff_Kelv 7 -3276.800 3276.700 FORMAT "%8.3" DEPOSIT ABSOLUTE /end AXIS_DESCR
/end CHARACTERISTIC
/begin CHARACTERISTIC EngPrt_dPwrRampEgrFailrNeg_C "Negative slope of ramp for power limitation at EGR error" VALUE 0x80542AEE RB_Val_Ws16 3276.700 Pwr_10kW_Sec 0.00 3276.700 FORMAT "%8.3" EXTENDED_LIMITS -3276.800 3276.700 /end CHARACTERISTIC
/begin CHARACTERISTIC EngPrt_dPwrRampEgrFailrPos_C "Positive slope of ramp for power limitation at EGR error" VALUE 0x80542AF0 RB_Val_Ws16 3276.700 Pwr_10kW_Sec 0.00 3276.700 FORMAT "%8.3" EXTENDED_LIMITS -3276.800 3276.700 /end CHARACTERISTIC
/begin CHARACTERISTIC EngPrt_facNEngEgrFailr_CUR "Engine-speed dependent factor for power limitation at EGR error" CURVE 0x80542AF2 RB_Curve_S16_S16 2.999878 Fact 1.000000 3.999878 FORMAT "%8.6" EXTENDED_LIMITS -4.000000 3.999878
 /begin AXIS_DESCR STD_AXIS Epm_nEng EngN 4 -16384.00 16383.50 FORMAT "%8.2" DEPOSIT ABSOLUTE /end AXIS_DESCR
/end CHARACTERISTIC
/begin CHARACTERISTIC EngPrt_facPwrExhGasOvht_C "Factor for power limitation at at exhaust gas overheating." VALUE 0x80542B04 RB_Val_Ws16 2.999878 Fact 1.000000 3.999878 FORMAT "%8.6" EXTENDED_LIMITS -4.000000 3.999878 /end CHARACTERISTIC
/begin CHARACTERISTIC EngPrt_facTqLimHiEngTGearDpdt_T "Factor for torque limitation depending on engine speed and gear" MAP 0x80542BBA RB_Map_S16S16_S16 1.992188 fak_ub_b2 0.00 1.992188 FORMAT "%8.6" EXTENDED_LIMITS -256.0000 255.9922
 /begin AXIS_DESCR STD_AXIS Epm_nEng EngN 6 -16384.00 16383.50 FORMAT "%8.2" DEPOSIT ABSOLUTE /end AXIS_DESCR
 /begin AXIS_DESCR STD_AXIS Tra_numGear OneToOne 11 -128.0000 127.0000 FORMAT "%8.4" EXTENDED_LIMITS -32768.00 32767.00 DEPOSIT ABSOLUTE /end AXIS_DESCR
/end CHARACTERISTIC
/begin CHARACTERISTIC EngPrt_pwrExhGasOvht_CUR "Ramp target value for power limitation at exhaust gas overheating" CURVE 0x80542B06 RB_Curve_S16_S16 327.6700 Pwr_kW 0.00 327.6700 FORMAT "%8.4" EXTENDED_LIMITS -327.6800 327.6700
 /begin AXIS_DESCR STD_AXIS EngPrt_tManifMod_MP TempDiff_Kelv 4 -3276.800 3276.700 FORMAT "%8.3" DEPOSIT ABSOLUTE /end AXIS_DESCR
/end CHARACTERISTIC
/begin CHARACTERISTIC EngPrt_pwrLimEgrFailr_MAP "EGR-valve position and manifold temperature dependent power limitation at EGR error" MAP 0x80542B18 RB_Map_S16S16_S16 327.6700 Pwr_kW 0.00 327.6700 FORMAT "%8.4" EXTENDED_LIMITS -327.6800 327.6700
 /begin AXIS_DESCR STD_AXIS agrvpmx_w rel_sw_b100 6 0.00 99.99695 FORMAT "%8.5" EXTENDED_LIMITS -100.0000 99.99695 DEPOSIT ABSOLUTE /end AXIS_DESCR
 /begin AXIS_DESCR STD_AXIS ExhMod_tExhMnfB1 Temp_Cels 6 -3549.940 3003.560 FORMAT "%8.3" DEPOSIT ABSOLUTE /end AXIS_DESCR
/end CHARACTERISTIC
/begin CHARACTERISTIC EngPrt_pwrRampLimOvhtIni_C "Initial value for power ramps" VALUE 0x80542B7C RB_Val_Ws32 21474836.4700 Pwr_kW 0.00 21474836.4700 FORMAT "%13.4" EXTENDED_LIMITS -21474836.4800 21474836.4700 /end CHARACTERISTIC
/begin CHARACTERISTIC EngPrt_pwrTqIntMaxOffs_C "Offset for power target value when no exhaust gas overheating present" VALUE 0x80542B80 RB_Val_Ws16 327.6700 Pwr_kW 0.00 327.6700 FORMAT "%8.4" EXTENDED_LIMITS -327.6800 327.6700 /end CHARACTERISTIC
/begin CHARACTERISTIC EngPrt_swtOilTempSel_C "Switch to select engine temperature or engine oil temperature" VALUE 0x80542C64 RB_Val_Wu8 255.0 dez 0.00 255.0 FORMAT "%5.1" /end CHARACTERISTIC
/begin CHARACTERISTIC EngPrt_tExhOvhtThres_T "Temperature threshold for power limitation at exhaust gas overheating" CURVE 0x80542B82 RB_Curve_U16_U16 3276.700 Temp_Cels -273.140 3003.560 FORMAT "%8.3" EXTENDED_LIMITS -273.1400 6280.360
 /begin AXIS_DESCR STD_AXIS lambas_w_msg fak_uw_b16 13 0.00 15.99976 FORMAT "%8.5" DEPOSIT ABSOLUTE /end AXIS_DESCR
/end CHARACTERISTIC
/begin CHARACTERISTIC EngReq_dtqLimnFfv_MAP "Torque gradient (reference value) of the lead path for Flex-Fuel vehicles" MAP 0x80542CAA RB_Map_S16S16_S16 32767.00 TrqPerSec 0.00 32767.00 FORMAT "%8.2" EXTENDED_LIMITS -32768.00 32767.00
 /begin AXIS_DESCR STD_AXIS EngDa_tEng Temp_Cels 9 -3549.940 3003.560 FORMAT "%8.3" DEPOSIT ABSOLUTE /end AXIS_DESCR
 /begin AXIS_DESCR STD_AXIS EngReq_fethstoeLocLRes fak_q3p0518Em5 6 0.00 0.9999695 FORMAT "%9.7" EXTENDED_LIMITS -1.000000 0.9999695 DEPOSIT ABSOLUTE /end AXIS_DESCR
/end CHARACTERISTIC
/begin CHARACTERISTIC EngReq_facDtqLimnFfv_MAP "Factor for the torque gradient of the lead path for Flex-Fuel vehicles" MAP 0x80542D38 RB_Map_S16S16_S16 1.999939 fak_q6p1035Em5 0.00 1.999939 FORMAT "%8.6" EXTENDED_LIMITS -2.000000 1.999939
 /begin AXIS_DESCR STD_AXIS Epm_nEng EngN 9 -16384.00 16383.50 FORMAT "%8.2" DEPOSIT ABSOLUTE /end AXIS_DESCR
 /begin AXIS_DESCR STD_AXIS CoEng_tiNormalRed TimeRed 6 -5242.880 5242.720 FORMAT "%8.3" DEPOSIT ABSOLUTE /end AXIS_DESCR
/end CHARACTERISTIC
/begin CHARACTERISTIC EngReq_facTqLimnpDifIntk_T "Control factor of torque limitation due to intake manifold pressure deviation" CURVE 0x80542DC6 RB_Curve_S16_U16_Static 1.992188 fak_q0p0078 0.00 1.992188 FORMAT "%8.6" EXTENDED_LIMITS 0.00 511.9922
 /begin AXIS_DESCR STD_AXIS EngReq_pDifIntkMnfld p_sw_q0p078 7 -2560.000 2559.922 FORMAT "%8.3" DEPOSIT ABSOLUTE /end AXIS_DESCR
/end CHARACTERISTIC
/begin CHARACTERISTIC EngReq_pDesIntkMnfld_C "Desired Intake manifold pressure" VALUE 0x80542DE4 RB_Val_Wu16 5119.922 p_q0p078 0.00 5119.922 FORMAT "%8.3" /end CHARACTERISTIC
/begin CHARACTERISTIC EngReq_tEngpCorrnThd_C "Engine temperature threshold for enabling torque limitation correction due to intake manifold pressure" VALUE 0x80542DE6 RB_Val_Wu8 191.3 temp_ub_q0p75_o48 -48.0 143.3 FORMAT "%5.1" /end CHARACTERISTIC
/begin CHARACTERISTIC EngReq_tqAbsLimnFfv_M "Map for torque limitation based on engine speed and ethanol content" MAP 0x80542DE8 RB_Map_S16S16_S16 6553.500 Trq -3276.800 3276.700 FORMAT "%8.3"
 /begin AXIS_DESCR STD_AXIS Epm_nEng EngN 8 -16384.00 16383.50 FORMAT "%8.2" DEPOSIT ABSOLUTE /end AXIS_DESCR
 /begin AXIS_DESCR STD_AXIS EngReq_facEthnlCntnt_Loc fak_sw_b2 6 0.00 1.999939 FORMAT "%8.6" EXTENDED_LIMITS -2.000000 1.999939 DEPOSIT ABSOLUTE /end AXIS_DESCR
/end CHARACTERISTIC
/begin CHARACTERISTIC EngReq_tqMnLimFfv_MAP "Min. Torque value for differential torque limitation" MAP 0x80542E68 RB_Map_S16S16_S16 6553.500 Trq -3276.800 3276.700 FORMAT "%8.3"
 /begin AXIS_DESCR STD_AXIS EngDa_tEng Temp_Cels 4 -3549.940 3003.560 FORMAT "%8.3" DEPOSIT ABSOLUTE /end AXIS_DESCR
 /begin AXIS_DESCR STD_AXIS EngReq_fethstoeLocLRes fak_q3p0518Em5 4 0.00 0.9999695 FORMAT "%9.7" EXTENDED_LIMITS -1.000000 0.9999695 DEPOSIT ABSOLUTE /end AXIS_DESCR
/end CHARACTERISTIC
/begin CHARACTERISTIC EngReq_trqLimFfvCfg_C "Codeword for EngReq_trLimFfvCfg function" VALUE 0x80542E9C RB_Val_Wu8 255.0 dez 0.00 255.0 FORMAT "%5.1" /end CHARACTERISTIC
/begin CHARACTERISTIC EngStrt_agRefPntCep_C "Reference angle to the determination of the reference speed" VALUE 0x80542F4C RB_Val_Ws16 1439.978 AngleCrS -720.0000 719.9780 FORMAT "%8.4" /end CHARACTERISTIC
/begin AXIS_PTS EngStrt_agToTgtITdcCep_AX "Axe distribution for running rest angle (CrS) to target TDC" 0x80542F4E EngStrt_agToTgtITdcCep RB_Axis_S16 1439.978 AngleCrS 10 -720.0000 719.9780 FORMAT "%8.4" DEPOSIT ABSOLUTE /end AXIS_PTS
/begin CHARACTERISTIC EngStrt_cntrInjStrtEndSpdGovr_C "minimum number of injections for release of engine speed control" VALUE 0x80543698 RB_Val_Wu8 255.0 OneToOne 0.00 255.0 FORMAT "%5.1" /end CHARACTERISTIC
/begin CHARACTERISTIC EngStrt_dataStrtCoor_C "Codeword EngStrt_StrtCoor" VALUE 0x8054354C RB_Val_Wu8 255.0 OneToOne 0.00 255.0 FORMAT "%5.1" /end CHARACTERISTIC
/begin CHARACTERISTIC EngStrt_dataStrtEnd_C "codeword for EngStrt_StrtEnd" VALUE 0x80543699 RB_Val_Wu8 255.0 OneToOne 0.00 255.0 FORMAT "%5.1" /end CHARACTERISTIC
/begin CHARACTERISTIC EngStrt_dataSysRels_C "Codeword EngStrt_StrtSysRels" VALUE 0x805445C0 RB_Val_Wu8 255.0 OneToOne 0.00 255.0 FORMAT "%5.1" /end CHARACTERISTIC
/begin CHARACTERISTIC EngStrt_dataWrmUpCoor_C "Codeword EngStrt_WrmUpCoor" VALUE 0x805445DC RB_Val_Wu8 255.0 OneToOne 0.00 255.0 FORMAT "%5.1" /end CHARACTERISTIC
/begin CHARACTERISTIC EngStrt_dnEngCoM1_T "Engine speed offset for start type ENGSTRT_COMRUNNG" CURVE 0x8054354E RB_Curve_S16_S16 32767.50 EngN -16384.00 16383.50 FORMAT "%8.2"
 /begin AXIS_DESCR STD_AXIS HLSDem_nSetPLo EngN 3 -16384.00 16383.50 FORMAT "%8.2" DEPOSIT ABSOLUTE /end AXIS_DESCR
/end CHARACTERISTIC
/begin CHARACTERISTIC EngStrt_dnEngCoM2_T "Engine speed offset for start type ENGSTRT_COMSTRTG" CURVE 0x8054355C RB_Curve_S16_S16 32767.50 EngN -16384.00 16383.50 FORMAT "%8.2"
 /begin AXIS_DESCR STD_AXIS HLSDem_nSetPLo EngN 3 -16384.00 16383.50 FORMAT "%8.2" DEPOSIT ABSOLUTE /end AXIS_DESCR
/end CHARACTERISTIC
/begin AXIS_PTS EngStrt_facEthCurr_AX "Distribution for the ethanol correction factor" 0x805445DE EngStrt_facEthCurr RB_Axis_U16 1.999969 fak_uw_b2 4 0.00 1.999969 FORMAT "%8.6" DEPOSIT ABSOLUTE /end AXIS_PTS
/begin CHARACTERISTIC EngStrt_facFuEth_T "Curve for the correction due to the ethanol content" CURVE 0x805431F2 RB_Curve_U16_U8_Static 1.000000 fak_ub_b2 0.00 1.000000 FORMAT "%8.6" EXTENDED_LIMITS 0.00 1.992188
 /begin AXIS_DESCR STD_AXIS FfPrm_facEthCurr fak_uw_b2 5 0.00 1.999969 FORMAT "%8.6" DEPOSIT ABSOLUTE /end AXIS_DESCR
/end CHARACTERISTIC
/begin CHARACTERISTIC EngStrt_facFuEvapOilSlow_C "Correction factor of slow evaporating fuel of the oil" VALUE 0x80543204 RB_Val_Wu16 7.999878 fak_uw_b8 0.00 7.999878 FORMAT "%8.6" /end CHARACTERISTIC
/begin CHARACTERISTIC EngStrt_facFuInpOilTraCmp_T "Fuel input into oil due to transient compensation depending on air mass flow" CURVE 0x80543206 RB_Curve_U8_U8 1.992188 fak_ub_b2 0.00 1.992188 FORMAT "%8.6"
 /begin AXIS_DESCR STD_AXIS ml_msg m_q4_kg_DIV_h 5 0.00 1020. FORMAT "%5.0" DEPOSIT ABSOLUTE /end AXIS_DESCR
/end CHARACTERISTIC
/begin CHARACTERISTIC EngStrt_facIpolAltiCep_T "characteristic curve for the conversion of the interpolation factor altitude" CURVE 0x80542F64 RB_Curve_U16_U8_Static 0.9961 fak_ub_b1 0.00 0.9961
 /begin AXIS_DESCR STD_AXIS PEnv_facCorrAlti fak_uw_b4 6 0.00 3.999939 FORMAT "%8.6" DEPOSIT ABSOLUTE /end AXIS_DESCR
/end CHARACTERISTIC
/begin CHARACTERISTIC EngStrt_facMaxTotEvap_T "Max. total evaporation rate" CURVE 0x80543212 RB_Curve_S16_S8_Static 1.992 fak_sb_b1 -1.000 0.992 FORMAT "%5.3" EXTENDED_LIMITS -1.000 0.9922
 /begin AXIS_DESCR STD_AXIS Epm_nEng EngN 4 -16384.00 16383.50 FORMAT "%8.2" DEPOSIT ABSOLUTE /end AXIS_DESCR
/end CHARACTERISTIC
/begin CHARACTERISTIC EngStrt_facMFlowFuOilSlow_C "Correction factor to calculate the part of the fuel in oil mass flow which evaporates slowly or not at all" VALUE 0x80543220 RB_Val_Wu16 7.999878 fak_uw_b8 0.00 7.999878 FORMAT "%8.6" /end CHARACTERISTIC
/begin CHARACTERISTIC EngStrt_FacPspu_M "correction factor dependent on engine speed and the quotient of manifold pressure" MAP 0x80543222 RB_Map_U8U8_U8 1.992188 fak_ub_b2 0.00 1.992188 FORMAT "%8.6"
 /begin AXIS_DESCR STD_AXIS EngStrt_nEng nmot_ub_q40 8 0.00 10200. FORMAT "%5.0" DEPOSIT ABSOLUTE /end AXIS_DESCR
 /begin AXIS_DESCR STD_AXIS pndkpu_msg fak_ub_b2 6 0.00 1.992188 FORMAT "%8.6" DEPOSIT ABSOLUTE /end AXIS_DESCR
/end CHARACTERISTIC
/begin CHARACTERISTIC EngStrt_facTHspWrmUpEth_M "Factor min. engine coolant temperature for homogeneous split mode for Flexfuel" MAP 0x805445E8 RB_Map_S16S16_U8 1.992188 fak_ub_b2 0.00 1.992188 FORMAT "%8.6"
 /begin AXIS_DESCR STD_AXIS IntkAirT_tIntkMnfld Temp_Cels 4 -3549.940 3003.560 FORMAT "%8.3" DEPOSIT ABSOLUTE /end AXIS_DESCR
 /begin AXIS_DESCR STD_AXIS FlSys_tFlHPSys Temp_Cels 4 -273.140 3003.560 FORMAT "%8.3" EXTENDED_LIMITS -3549.940 3003.560 DEPOSIT ABSOLUTE /end AXIS_DESCR
/end CHARACTERISTIC
/begin CHARACTERISTIC EngStrt_facTStrtOilFuCatHeatg_T "Curve fuel input into oil depending of the start temperature during catalyst heating" CURVE 0x80543262 RB_Curve_U8_U8 1.000000 fak_ub_b2 0.00 1.000000 FORMAT "%8.6" EXTENDED_LIMITS 0.00 1.992188
 /begin AXIS_DESCR STD_AXIS EngStrt_tStrt temp_ub_q0p75_o48 8 -48.0 143.3 FORMAT "%5.1" DEPOSIT ABSOLUTE /end AXIS_DESCR
/end CHARACTERISTIC
/begin CHARACTERISTIC EngStrt_idxClassSelnInjRels_T "Curve class selector for injection release during start" CURVE 0x805433FE RB_Curve_U16_U8_Static 255.0 OneToOne 0.00 255.0 FORMAT "%5.1"
 /begin AXIS_DESCR STD_AXIS EngStrt_stStrtReq ENGSTRT_STSTRTREQ_SET_COMPU_VERB 19 0.00 32770.0000000 FORMAT "%13.7" DEPOSIT ABSOLUTE /end AXIS_DESCR
/end CHARACTERISTIC
/begin CHARACTERISTIC EngStrt_idxClassSelnStrtEnd_T "Curve class selector for detection of end of start" CURVE 0x8054369A RB_Curve_U16_U8_Static 4.00000000000 ENGSTRT_IDXSTRTEND_SET_COMPU_VERB 0.00 4.00000000000 FORMAT "%13.11"
 /begin AXIS_DESCR STD_AXIS EngStrt_stStrtReq ENGSTRT_STSTRTREQ_SET_COMPU_VERB 19 0.00 32770.0000000 FORMAT "%13.7" DEPOSIT ABSOLUTE /end AXIS_DESCR
/end CHARACTERISTIC
/begin CHARACTERISTIC EngStrt_idxInstSelnNEngCrit_T "Curve class instance selector for detection of end of start over engine speed under critical start condition" CURVE 0x805436D6 RB_Curve_U16_U8_Static 0.00 STRTEND_NENGCRIT_SET_COMPU_VERB 0.00 0.00 FORMAT "%13.2"
 /begin AXIS_DESCR STD_AXIS EngStrt_stStrtReq ENGSTRT_STSTRTREQ_SET_COMPU_VERB 19 0.00 32770.0000000 FORMAT "%13.7" DEPOSIT ABSOLUTE /end AXIS_DESCR
/end CHARACTERISTIC
/begin CHARACTERISTIC EngStrt_idxInstSelnNEngDeb_T "Curve class instance selector for detection of end of start over engine speed , injection counter and debouncing" CURVE 0x80543712 RB_Curve_U16_U8_Static 0.00 STRTEND_NENGDEB_SET_COMPU_VERB 0.00 0.00 FORMAT "%13.2"
 /begin AXIS_DESCR STD_AXIS EngStrt_stStrtReq ENGSTRT_STSTRTREQ_SET_COMPU_VERB 19 0.00 32770.0000000 FORMAT "%13.7" DEPOSIT ABSOLUTE /end AXIS_DESCR
/end CHARACTERISTIC
/begin CHARACTERISTIC EngStrt_idxInstSelnNEngNrInj_T "Curve class instance selector for detection of end of start over engine speed and injection counter" CURVE 0x8054374E RB_Curve_U16_U8_Static 1.00000000000 STRTEND_NENGNRINJ_SET_COMPU_VERB 0.00 1.00000000000 FORMAT "%13.11"
 /begin AXIS_DESCR STD_AXIS EngStrt_stStrtReq ENGSTRT_STSTRTREQ_SET_COMPU_VERB 19 0.00 32770.0000000 FORMAT "%13.7" DEPOSIT ABSOLUTE /end AXIS_DESCR
/end CHARACTERISTIC
/begin CHARACTERISTIC EngStrt_idxInstSelnNEng_T "Curve class instance selector for detection of end of start over engine speed" CURVE 0x8054378A RB_Curve_U16_U8_Static 3.00000000000 STRTEND_NENG_SET_COMPU_VERB 0.00 3.00000000000 FORMAT "%13.11"
 /begin AXIS_DESCR STD_AXIS EngStrt_stStrtReq ENGSTRT_STSTRTREQ_SET_COMPU_VERB 19 0.00 32770.0000000 FORMAT "%13.7" DEPOSIT ABSOLUTE /end AXIS_DESCR
/end CHARACTERISTIC
/begin CHARACTERISTIC EngStrt_idxSelnOverrun_T "Curve class instance selector for overrun" CURVE 0x805437C6 RB_Curve_U16_U8_Static 255.0 OneToOne 0.00 255.0 FORMAT "%5.1"
 /begin AXIS_DESCR STD_AXIS EngStrt_stStrtReq ENGSTRT_STSTRTREQ_SET_COMPU_VERB 19 0.00 32770.0000000 FORMAT "%13.7" DEPOSIT ABSOLUTE /end AXIS_DESCR
/end CHARACTERISTIC
/begin CHARACTERISTIC EngStrt_mFuOilHysDelta_C "Hysteresis delta für hsteresis threshold of maximum fuel in oil" VALUE 0x80543274 RB_Val_Wu16 2097.120 m_q0p032_g 0.00 2097.120 FORMAT "%8.3" /end CHARACTERISTIC
/begin CHARACTERISTIC EngStrt_mFuOilMaxSlow_C "Maximum value for the fuel mass in the engine oil which evaporates slowly or not at all" VALUE 0x80543276 RB_Val_Wu16 2097.120 m_q0p032_g 0.00 2097.120 FORMAT "%8.3" /end CHARACTERISTIC
/begin CHARACTERISTIC EngStrt_mFuOilMax_C "maximum threshold of fuel mass in oil to set error DFC_MFuOilMax, which requests a oil change." VALUE 0x80543278 RB_Val_Wu16 2097.120 m_q0p032_g 0.00 2097.120 FORMAT "%8.3" /end CHARACTERISTIC
/begin CHARACTERISTIC EngStrt_mFuOilSlowInin_C "Calibration interface for initialization of the slow evaporating fuel mass" VALUE 0x8054327A RB_Val_Wu16 2097.120 m_q0p032_g 0.00 2097.120 FORMAT "%8.3" /end CHARACTERISTIC
/begin CHARACTERISTIC EngStrt_mLrngMaxFuEvapOil_T "Learning speed of the fuel evaporation from engine oil depending of mass of fuel in oil" CURVE 0x8054327C RB_Curve_U16_U16 177775.1 mgrd_q2p7126_mg_DIV_s2 0.00 177775.1 FORMAT "%8.1"
 /begin AXIS_DESCR STD_AXIS EngStrt_mFuOilFast m_q0p032_g 5 0.00 2097.120 FORMAT "%8.3" DEPOSIT ABSOLUTE /end AXIS_DESCR
/end CHARACTERISTIC
/begin CHARACTERISTIC EngStrt_mLrngMaxFuEvap_M "Maximum value for learning speed of the fuel evaporation from engine oil" MAP 0x80543292 RB_Map_U16U16_U16 177775.1 mgrd_q2p7126_mg_DIV_s2 0.00 177775.1 FORMAT "%8.1"
 /begin AXIS_DESCR STD_AXIS ml_w_msg m_uw_b6553p5 5 0.00 6553.500 FORMAT "%8.3" DEPOSIT ABSOLUTE /end AXIS_DESCR
 /begin AXIS_DESCR STD_AXIS EngStrt_mFuOilFast m_q0p032_g 4 0.00 2097.120 FORMAT "%8.3" DEPOSIT ABSOLUTE /end AXIS_DESCR
/end CHARACTERISTIC
/begin CHARACTERISTIC EngStrt_nActvtCep_C "below this engine speed, CEP should be active" VALUE 0x80542F78 RB_Val_Ws16 32767.50 EngN -16384.00 16383.50 FORMAT "%8.2" /end CHARACTERISTIC
/begin CHARACTERISTIC EngStrt_nDisblNewSync_C "Engine speed threshold for using re-synchro prohibition for T15 stops" VALUE 0x8050557C Val_Ws16 32767.50 EngN -16384.00 16383.50 FORMAT "%8.2" /end CHARACTERISTIC
/begin CHARACTERISTIC EngStrt_nEngCoM1_M "Engine speed threshold for start type ENGSTRT_COMRUNNG" MAP 0x8054356A RB_Map_U16S16_S16 32767.50 EngN -16384.00 16383.50 FORMAT "%8.2"
 /begin AXIS_DESCR STD_AXIS PEnv_p p_q0p039 5 0.00 2559.961 FORMAT "%8.3" DEPOSIT ABSOLUTE /end AXIS_DESCR
 /begin AXIS_DESCR STD_AXIS EngStrt_tStrtCoor Temp_Cels 5 -273.140 3003.560 FORMAT "%8.3" EXTENDED_LIMITS -3549.940 3003.560 DEPOSIT ABSOLUTE /end AXIS_DESCR
/end CHARACTERISTIC
/begin CHARACTERISTIC EngStrt_nEngCoM2_M "Engine speed threshold for start type ENGSTRT_COMSTRTG" MAP 0x805435B4 RB_Map_U16S16_S16 32767.50 EngN -16384.00 16383.50 FORMAT "%8.2"
 /begin AXIS_DESCR STD_AXIS PEnv_p p_q0p039 5 0.00 2559.961 FORMAT "%8.3" DEPOSIT ABSOLUTE /end AXIS_DESCR
 /begin AXIS_DESCR STD_AXIS EngStrt_tStrtCoor Temp_Cels 5 -273.140 3003.560 FORMAT "%8.3" EXTENDED_LIMITS -3549.940 3003.560 DEPOSIT ABSOLUTE /end AXIS_DESCR
/end CHARACTERISTIC
/begin CHARACTERISTIC EngStrt_nEngHspWrmUpEthCurr_T "Curve for the offset-threshold for maximal engine speed for HSP-mode during warm-up for Flexfuel" CURVE 0x8054460C RB_Curve_U16_S16_Static 32767.50 EngN -16384.00 16383.50 FORMAT "%8.2"
 /begin AXIS_DESCR STD_AXIS EngStrt_facEthCurr fak_uw_b2 10 0.00 1.999969 FORMAT "%8.6" DEPOSIT ABSOLUTE /end AXIS_DESCR
/end CHARACTERISTIC
/begin CHARACTERISTIC EngStrt_nEngHspWrmUpHys_C "hysteresis for stopping HSP-mode dependent on nmot" VALUE 0x80544636 RB_Val_Ws16 32767.50 EngN -16384.00 16383.50 FORMAT "%8.2" /end CHARACTERISTIC
/begin CHARACTERISTIC EngStrt_nEngHspWrmUp_C "rpm-threshold for maximal engine speed for HSP-mode during warm-up" VALUE 0x80544638 RB_Val_Ws16 32767.50 EngN -16384.00 16383.50 FORMAT "%8.2" /end CHARACTERISTIC
/begin AXIS_PTS EngStrt_nEngMaxCritStrtEnd_AX "Base point distribution over maximum engine speed for start under critical situation" 0x80543802 EngStrt_nEngMaxCrit RB_Axis_S16 32767.50 EngN 4 -16384.00 16383.50 FORMAT "%8.2" DEPOSIT ABSOLUTE /end AXIS_PTS
/begin CHARACTERISTIC EngStrt_nEngNegMaxCep_T "characteristic curve for calibration of the maximum negative engine speed dependent on the engine speed in the referenz point" CURVE 0x80542F7A RB_Curve_S16_S16 32767.50 EngN -16384.00 16383.50 FORMAT "%8.2"
 /begin AXIS_DESCR STD_AXIS EngStrt_nEngAtCurrIgnTdcCep EngN 8 -16384.00 16383.50 FORMAT "%8.2" DEPOSIT ABSOLUTE /end AXIS_DESCR
/end CHARACTERISTIC
/begin CHARACTERISTIC EngStrt_nEngThdCep_C "calibration value of the engine speed threshold" VALUE 0x80542F9C RB_Val_Ws16 32767.50 EngN -16384.00 16383.50 FORMAT "%8.2" /end CHARACTERISTIC
/begin CHARACTERISTIC EngStrt_nMnNoStaCom "Threshold engine speed for permission of starter assist at change of mind" VALUE 0x805445D8 RB_Val_Ws16 32767.50 EngN -16384.00 16383.50 FORMAT "%8.2" /end CHARACTERISTIC
/begin AXIS_PTS EngStrt_nRefPntCep_AX "distribution of values for engine speed at referenz point 360 deg CrS before target TDC" 0x80542F9E EngStrt_nRefPntCep RB_Axis_S16 32767.50 EngN 9 -16384.00 16383.50 FORMAT "%8.2" DEPOSIT ABSOLUTE /end AXIS_PTS
/begin CHARACTERISTIC EngStrt_nrInjEthCurrHspWrmUpRstrt_GM "Group map for the max. number of combustion in hsp mode for follow up start for flex fuel" MAP 0x8054463A RB_MapGroup_U16 65535.00 OneToOne 0.00 65535.00 FORMAT "%8.2"
 /begin AXIS_DESCR COM_AXIS EngStrt_facEthCurr fak_uw_b2 4 0.00 1.999969 FORMAT "%8.6" AXIS_PTS_REF EngStrt_facEthCurr_AX /end AXIS_DESCR
 /begin AXIS_DESCR COM_AXIS EngStrt_tStrtCoor Temp_Cels 6 -273.140 3003.560 FORMAT "%8.3" EXTENDED_LIMITS -3549.940 3003.560 AXIS_PTS_REF EngStrt_tStrtCoor_AX /end AXIS_DESCR
/end CHARACTERISTIC
/begin CHARACTERISTIC EngStrt_nrInjEthCurrHspWrmUp_GM "Group map for the max. number of combustions in hsp mode at high pressure start for flex fuel" MAP 0x8054466A RB_MapGroup_U16 65535.00 OneToOne 0.00 65535.00 FORMAT "%8.2"
 /begin AXIS_DESCR COM_AXIS EngStrt_facEthCurr fak_uw_b2 4 0.00 1.999969 FORMAT "%8.6" AXIS_PTS_REF EngStrt_facEthCurr_AX /end AXIS_DESCR
 /begin AXIS_DESCR COM_AXIS EngStrt_tStrtCoor Temp_Cels 6 -273.140 3003.560 FORMAT "%8.3" EXTENDED_LIMITS -3549.940 3003.560 AXIS_PTS_REF EngStrt_tStrtCoor_AX /end AXIS_DESCR
/end CHARACTERISTIC
/begin CHARACTERISTIC EngStrt_nrSelnTdcsCep_M "map for application of the rest TDCs until engine stop" MAP 0x80542FB2 RB_Map_S16S16_U8 255.0 OneToOne 0.00 255.0 FORMAT "%5.1"
 /begin AXIS_DESCR STD_AXIS EngStrt_nEngActChkdBlwThdCorrdCep EngN 10 -16384.00 16383.50 FORMAT "%8.2" DEPOSIT ABSOLUTE /end AXIS_DESCR
 /begin AXIS_DESCR STD_AXIS EngStrt_dnTdcsAbvBlwThdCep EngN 10 -16384.00 16383.50 FORMAT "%8.2" DEPOSIT ABSOLUTE /end AXIS_DESCR
/end CHARACTERISTIC
/begin CHARACTERISTIC EngStrt_nrWCycPreInj_T "Number of working cycle during preinjection" CURVE 0x805445C2 RB_Curve_S16_U8_Static 255.0 OneToOne 0.00 255.0 FORMAT "%5.1"
 /begin AXIS_DESCR STD_AXIS EngStrt_tStrtCoor Temp_Cels 3 -273.140 3003.560 FORMAT "%8.3" EXTENDED_LIMITS -3549.940 3003.560 DEPOSIT ABSOLUTE /end AXIS_DESCR
/end CHARACTERISTIC
/begin CHARACTERISTIC EngStrt_nStrtEndInit_C "engine speed threshold end-of-start, if there is already engine speed in ECU init-phase" VALUE 0x8054380C RB_Val_Ws16 32767.50 EngN -16384.00 16383.50 FORMAT "%8.2" /end CHARACTERISTIC
/begin CHARACTERISTIC EngStrt_nStrt_C "engine speed threshold for detection start" VALUE 0x8054380E RB_Val_Ws16 32767.50 EngN -16384.00 16383.50 FORMAT "%8.2" /end CHARACTERISTIC
/begin CHARACTERISTIC EngStrt_nTdcBlwThdTCorrnCep_T "characteristic curve for calibration of the correction value of the engine speed for the determination of the rest TDCs concerning temperature" CURVE 0x80543042 RB_Curve_S16_S16 32767.50 EngN -16384.00 16383.50 FORMAT "%8.2"
 /begin AXIS_DESCR STD_AXIS EngStrt_tCorrCep Temp_Cels 8 -3549.940 3003.560 FORMAT "%8.3" DEPOSIT ABSOLUTE /end AXIS_DESCR
/end CHARACTERISTIC
/begin CHARACTERISTIC EngStrt_nVehSpdMax_C "Maximum threshold for vehicle speed above which direct start is requested." VALUE 0x805445CE RB_Val_Ws16 655.3500 Vel -327.6800 327.6700 FORMAT "%8.4" /end CHARACTERISTIC
/begin CHARACTERISTIC EngStrt_nVehSpdMin_C "Minimum threshold for vehicle speed below which direct start is requested." VALUE 0x805445D0 RB_Val_Ws16 655.3500 Vel -327.6800 327.6700 FORMAT "%8.4" /end CHARACTERISTIC
/begin CHARACTERISTIC EngStrt_pIntkBefCepMin_T "characteristic for observation of the intake manifold pressure" CURVE 0x80543064 RB_Curve_S16_S16 2559.922 P_hPa_q0p078125_COMPU 0.00 2559.922 FORMAT "%8.3" EXTENDED_LIMITS -2560.000 2559.922
 /begin AXIS_DESCR STD_AXIS Epm_nEngLowSpdXP EngN 4 -16384.00 16383.50 FORMAT "%8.2" DEPOSIT ABSOLUTE /end AXIS_DESCR
/end CHARACTERISTIC
/begin CHARACTERISTIC EngStrt_pOilInjRels_C "Oil pressure threshold to release the injection for start at end of line" VALUE 0x8054343A RB_Val_Ws16 65535.00 Pres_hPa -32768.00 32767.00 FORMAT "%8.2" /end CHARACTERISTIC
/begin AXIS_PTS EngStrt_pStrtEnd_AX "Base point distribution over ambient pressure for detection of end of start" 0x80543810 PEnv_p RB_Axis_U16 2559.961 p_q0p039 8 0.00 2559.961 FORMAT "%8.3" DEPOSIT ABSOLUTE /end AXIS_PTS
/begin CHARACTERISTIC EngStrt_ratAgThrVlvDesCepAlti_GM "map for the calibration of the CEP-throttle valve set point for altitude" MAP 0x80543076 RB_MapGroup_S16 799.9878 Prc -400.0000 399.9878 FORMAT "%8.4"
 /begin AXIS_DESCR COM_AXIS EngStrt_agToTgtITdcCep AngleCrS 10 -720.0000 719.9780 FORMAT "%8.4" AXIS_PTS_REF EngStrt_agToTgtITdcCep_AX /end AXIS_DESCR
 /begin AXIS_DESCR COM_AXIS EngStrt_nRefPntCep EngN 9 -16384.00 16383.50 FORMAT "%8.2" AXIS_PTS_REF EngStrt_nRefPntCep_AX /end AXIS_DESCR
/end CHARACTERISTIC
/begin CHARACTERISTIC EngStrt_ratAgThrVlvDesCep_GM "map for the calibration of the throttle valve set point for CEP" MAP 0x8054312A RB_MapGroup_S16 799.9878 Prc -400.0000 399.9878 FORMAT "%8.4"
 /begin AXIS_DESCR COM_AXIS EngStrt_agToTgtITdcCep AngleCrS 10 -720.0000 719.9780 FORMAT "%8.4" AXIS_PTS_REF EngStrt_agToTgtITdcCep_AX /end AXIS_DESCR
 /begin AXIS_DESCR COM_AXIS EngStrt_nRefPntCep EngN 9 -16384.00 16383.50 FORMAT "%8.2" AXIS_PTS_REF EngStrt_nRefPntCep_AX /end AXIS_DESCR
/end CHARACTERISTIC
/begin CHARACTERISTIC EngStrt_ratMFlowFuEvapOilSlow_T "Curve evaporation rate of the slowly evaporating fuel out of oil" CURVE 0x805432D0 RB_Curve_U8_U16_Static 99.99847 rel_q0p00152 0.00 99.99847 FORMAT "%8.5"
 /begin AXIS_DESCR STD_AXIS EngStrt_tOil temp_ub_q0p75_o48 12 -48.0 143.3 FORMAT "%5.1" DEPOSIT ABSOLUTE /end AXIS_DESCR
/end CHARACTERISTIC
/begin CHARACTERISTIC EngStrt_relMAirHspWrmUpEthCurr_T "Curve for the Offset characteristic curve dependent on temperature for the maximum relative air charge for HSP-mode in the start and poststart for Flexfue" CURVE 0x8054469A RB_Curve_U16_U16 1535.977 rel_q0p02344 0.00 1535.977 FORMAT "%8.3"
 /begin AXIS_DESCR STD_AXIS EngStrt_facEthCurr fak_uw_b2 10 0.00 1.999969 FORMAT "%8.6" DEPOSIT ABSOLUTE /end AXIS_DESCR
/end CHARACTERISTIC
/begin CHARACTERISTIC EngStrt_relMAirHspWrmUpHys_C "hysteresis for start and stop of HSP-mode dependent on air charge" VALUE 0x805446C4 RB_Val_Wu16 1535.977 rel_q0p02344 0.00 1535.977 FORMAT "%8.3" /end CHARACTERISTIC
/begin CHARACTERISTIC EngStrt_relMAirHspWrmUp_GT "Characteristic curve dependent on temperature for the maximum relative air charge for HSP-mode in the start and poststart" CURVE 0x805446C6 RB_CurveGroup_U16 1535.977 rel_q0p02344 0.00 1535.977 FORMAT "%8.3"
 /begin AXIS_DESCR COM_AXIS EngStrt_tStrtCoor Temp_Cels 6 -273.140 3003.560 FORMAT "%8.3" EXTENDED_LIMITS -3549.940 3003.560 AXIS_PTS_REF EngStrt_tStrtCoor_AX /end AXIS_DESCR
/end CHARACTERISTIC
/begin CHARACTERISTIC EngStrt_stCfgCoMBhvr_T "curve to configure the behaviour of the process Proc_EngReStrt at change of mind" CURVE 0x80543510 RB_Curve_U16_U8_Static 255.0 OneToOne 0.00 255.0 FORMAT "%5.1"
 /begin AXIS_DESCR STD_AXIS EngStrt_stStrtReq ENGSTRT_STSTRTREQ_SET_COMPU_VERB 19 0.00 32770.0000000 FORMAT "%13.7" DEPOSIT ABSOLUTE /end AXIS_DESCR
/end CHARACTERISTIC
/begin CHARACTERISTIC EngStrt_stCfgHipEOL_C "Codeword to configure the end of line start as high pressure start" VALUE 0x805435FE RB_Val_Wu8 255.0 OneToOne 0.00 255.0 FORMAT "%5.1" /end CHARACTERISTIC
/begin CHARACTERISTIC EngStrt_stConfCep_C "status byte to configure CEP" VALUE 0x805431DE RB_Val_Wu8 255.0 OneToOne 0.00 255.0 FORMAT "%5.1" /end CHARACTERISTIC
/begin CHARACTERISTIC EngStrt_stEomStgWrmUp1_C "stage of the operating mode warm up" VALUE 0x805446D2 RB_Val_Wu16 65535.00 OneToOne 0.00 65535.00 FORMAT "%8.2" /end CHARACTERISTIC
/begin CHARACTERISTIC EngStrt_stEomStgWrmUp2_C "stage of the operating mode warm up(second request)" VALUE 0x805446D4 RB_Val_Wu16 65535.00 OneToOne 0.00 65535.00 FORMAT "%8.2" /end CHARACTERISTIC
/begin CHARACTERISTIC EngStrt_stEomStgWrmUp3S1_C "stage of the operating mode warm up (first request) for following start" VALUE 0x805446D6 RB_Val_Wu16 65535.00 OneToOne 0.00 65535.00 FORMAT "%8.2" /end CHARACTERISTIC
/begin CHARACTERISTIC EngStrt_stEomStgWrmUp3S2_C "stage of the operating mode warm up (second request) for following start" VALUE 0x805446D8 RB_Val_Wu16 65535.00 OneToOne 0.00 65535.00 FORMAT "%8.2" /end CHARACTERISTIC
/begin CHARACTERISTIC EngStrt_stEomStgWrmUpAllwd_T "curve stage of the operating mode warm up (allowed operating modes)" CURVE 0x805446DA RB_Curve_U8_U16_Static 65535.00 OneToOne 0.00 65535.00 FORMAT "%8.2"
 /begin AXIS_DESCR STD_AXIS EngStrt_stEomWrmUpAllwd OneToOne 16 0.00 255.0 FORMAT "%5.1" DEPOSIT ABSOLUTE /end AXIS_DESCR
/end CHARACTERISTIC
/begin CHARACTERISTIC EngStrt_stEomStrt_C "State of the mode of operation Start" VALUE 0x80543600 RB_Val_Wu16 7951.00000000 CoEOM_stEomStgTot_VERB 0.00 7951.00000000 FORMAT "%13.8" /end CHARACTERISTIC
/begin CHARACTERISTIC EngStrt_stEomWrmUp1_C "State of the mode of operation warm up (first request)" VALUE 0x8054470C RB_Val_Wu32 4294967295.00 OneToOne 0.00 4294967295.00 FORMAT "%13.2" /end CHARACTERISTIC
/begin CHARACTERISTIC EngStrt_stEomWrmUp2_C "State of the mode of operation warm up (second request)" VALUE 0x80544710 RB_Val_Wu32 4294967295.00 OneToOne 0.00 4294967295.00 FORMAT "%13.2" /end CHARACTERISTIC
/begin CHARACTERISTIC EngStrt_stEomWrmUp3S1_C "State of the mode of operation warm up (First request) for following start" VALUE 0x80544714 RB_Val_Wu32 4294967295.00 OneToOne 0.00 4294967295.00 FORMAT "%13.2" /end CHARACTERISTIC
/begin CHARACTERISTIC EngStrt_stEomWrmUp3S2_C "State of the mode of operation warm up (second request) for following start" VALUE 0x80544718 RB_Val_Wu32 4294967295.00 OneToOne 0.00 4294967295.00 FORMAT "%13.2" /end CHARACTERISTIC
/begin CHARACTERISTIC EngStrt_stEomWrmUpAllwd_T "curve state of the operating mode warm up (allowed operating modes)" CURVE 0x8054471C RB_Curve_S16_R32_Static 2.00000000E+037 OneToOne -1.00000000E+037 1.00000000E+037 FORMAT "%13.3" EXTENDED_LIMITS -3.40282347E+038 3.40282347E+038
 /begin AXIS_DESCR STD_AXIS EngStrt_stEomWrmUpAllwdLoc OneToOne 16 0.00 255.0000 FORMAT "%8.4" EXTENDED_LIMITS -32768.00 32767.00 DEPOSIT ABSOLUTE /end AXIS_DESCR
/end CHARACTERISTIC
/begin CHARACTERISTIC EngStrt_stPrioWrmUp1_C "Priority of the mode of operation warm up (first request)" VALUE 0x80544780 RB_Val_Wu8 255.0 OneToOne 0.00 255.0 FORMAT "%5.1" /end CHARACTERISTIC
/begin CHARACTERISTIC EngStrt_stPrioWrmUp2_C "Priority of the mode of operation warm up (second request)" VALUE 0x80544781 RB_Val_Wu8 255.0 OneToOne 0.00 255.0 FORMAT "%5.1" /end CHARACTERISTIC
/begin CHARACTERISTIC EngStrt_stPrioWrmUpAllwd_C "Priority of the mode of operation warm up (allowed operating modes)" VALUE 0x80544782 RB_Val_Wu8 255.0 OneToOne 0.00 255.0 FORMAT "%5.1" /end CHARACTERISTIC
/begin CHARACTERISTIC EngStrt_stStrtEndTqStruct_T "configuration curve to delete delay between end of start injection and torque structure release" CURVE 0x80543822 RB_Curve_U16_U8_Static 255.0 OneToOne 0.00 255.0 FORMAT "%5.1"
 /begin AXIS_DESCR STD_AXIS EngStrt_stStrtReq ENGSTRT_STSTRTREQ_SET_COMPU_VERB 19 0.00 32770.0000000 FORMAT "%13.7" DEPOSIT ABSOLUTE /end AXIS_DESCR
/end CHARACTERISTIC
/begin CHARACTERISTIC EngStrt_stStrtPrioCoM_CA "Priority list for the selection of the start type at change of mind" VAL_BLK 0x80543602 RB_ValA_Wu16 32770.0000000 ENGSTRT_STSTRTREQ_SET_COMPU_VERB 0.00 32770.0000000 FORMAT "%13.7" NUMBER 19 /end CHARACTERISTIC
/begin CHARACTERISTIC EngStrt_stStrtPrioFirst_CA "Priority list for the selection of the start type at first start" VAL_BLK 0x80543628 RB_ValA_Wu16 32770.0000000 ENGSTRT_STSTRTREQ_SET_COMPU_VERB 0.00 32770.0000000 FORMAT "%13.7" NUMBER 19 /end CHARACTERISTIC
/begin CHARACTERISTIC EngStrt_stStrtPrioFolw_CA "Priority list for the selection of the start type at following start" VAL_BLK 0x8054364E RB_ValA_Wu16 32770.0000000 ENGSTRT_STSTRTREQ_SET_COMPU_VERB 0.00 32770.0000000 FORMAT "%13.7" NUMBER 19 /end CHARACTERISTIC
/begin CHARACTERISTIC EngStrt_stStrtReqAppl_C "Application value for start type (independant of priorisation)" VALUE 0x80543674 RB_Val_Wu16 32770.0000000 ENGSTRT_STSTRTREQ_SET_COMPU_VERB 0.00 32770.0000000 FORMAT "%13.7" /end CHARACTERISTIC
/begin CHARACTERISTIC EngStrt_stStrtSitAppl_C "Application value for start situation (independant of priorisation)" VALUE 0x80543676 RB_Val_Wu8 255.0 OneToOne 0.00 255.0 FORMAT "%5.1" /end CHARACTERISTIC
/begin CHARACTERISTIC EngStrt_tActvtCep_C "above this temperature, CEP should be active" VALUE 0x805431E0 RB_Val_Ws16 6553.500 Temp_Cels -3549.940 3003.560 FORMAT "%8.3" /end CHARACTERISTIC
/begin CHARACTERISTIC EngStrt_tDrctStrtHi_C "high temperature threshold for direct start release" VALUE 0x80543678 RB_Val_Ws16 3276.700 Temp_Cels -273.140 3003.560 FORMAT "%8.3" EXTENDED_LIMITS -3549.940 3003.560 /end CHARACTERISTIC
/begin CHARACTERISTIC EngStrt_tDrctStrtLo_C "low temperature threshold for direct start release" VALUE 0x8054367A RB_Val_Ws16 3276.700 Temp_Cels -273.140 3003.560 FORMAT "%8.3" EXTENDED_LIMITS -3549.940 3003.560 /end CHARACTERISTIC
/begin CHARACTERISTIC EngStrt_tFrstStrtStallgConf_C "Calibration for temperature threshold for First Start situation during engine stalling" VALUE 0x8054367C RB_Val_Ws16 6553.500 Temp_Cels -3549.940 3003.560 FORMAT "%8.3" /end CHARACTERISTIC
/begin CHARACTERISTIC EngStrt_tHiPStrtCold_C "temperature threshold for the high pressure start cold" VALUE 0x8054367E RB_Val_Ws16 3276.700 Temp_Cels -273.140 3003.560 FORMAT "%8.3" EXTENDED_LIMITS -3549.940 3003.560 /end CHARACTERISTIC
/begin CHARACTERISTIC EngStrt_tHiPStrtHi_C "upper threshold temperature for high pressure start" VALUE 0x805445D2 RB_Val_Ws16 3276.700 Temp_Cels -273.140 3003.560 FORMAT "%8.3" EXTENDED_LIMITS -3549.940 3003.560 /end CHARACTERISTIC
/begin CHARACTERISTIC EngStrt_tHiPStrtLo_C "lower threshold temperature for high pressure start" VALUE 0x805445D4 RB_Val_Ws16 3276.700 Temp_Cels -273.140 3003.560 FORMAT "%8.3" EXTENDED_LIMITS -3549.940 3003.560 /end CHARACTERISTIC
/begin CHARACTERISTIC EngStrt_tHiPStrtMid_T "curve temperature threshold for the high pressure start middle" CURVE 0x80543680 RB_Curve_U8_S16_Static 3276.700 Temp_Cels -273.140 3003.560 FORMAT "%8.3" EXTENDED_LIMITS -3549.940 3003.560
 /begin AXIS_DESCR STD_AXIS fethstoe_msg fak_ub_b2 4 0.00 1.992188 FORMAT "%8.6" DEPOSIT ABSOLUTE /end AXIS_DESCR
/end CHARACTERISTIC
/begin CHARACTERISTIC EngStrt_tHiPStrtPreInj_C "temperature threshold for start with preinjection" VALUE 0x8054368E RB_Val_Ws16 3276.700 Temp_Cels -273.140 3003.560 FORMAT "%8.3" EXTENDED_LIMITS -3549.940 3003.560 /end CHARACTERISTIC
/begin CHARACTERISTIC EngStrt_tHiPStrtWrm_C "temperature threshold for the high pressure start warm" VALUE 0x80543690 RB_Val_Ws16 3276.700 Temp_Cels -273.140 3003.560 FORMAT "%8.3" EXTENDED_LIMITS -3549.940 3003.560 /end CHARACTERISTIC
/begin CHARACTERISTIC EngStrt_tHspWrmUpEthCurr_GM "Group map for the Offset min. engine coolant temperature for homogeneous split mode for Flexfuel" MAP 0x80544784 RB_MapGroup_S16 3276.700 Temp_Cels -273.140 3003.560 FORMAT "%8.3" EXTENDED_LIMITS -3549.940 3003.560
 /begin AXIS_DESCR COM_AXIS EngStrt_facEthCurr fak_uw_b2 4 0.00 1.999969 FORMAT "%8.6" AXIS_PTS_REF EngStrt_facEthCurr_AX /end AXIS_DESCR
 /begin AXIS_DESCR COM_AXIS EngStrt_tStrtCoor Temp_Cels 6 -273.140 3003.560 FORMAT "%8.3" EXTENDED_LIMITS -3549.940 3003.560 AXIS_PTS_REF EngStrt_tStrtCoor_AX /end AXIS_DESCR
/end CHARACTERISTIC
/begin CHARACTERISTIC EngStrt_tHspWrmUpHi_GT "Max. engine coolant temperature dependent of engine temperature at start for homogeneous split mode" CURVE 0x805447B4 RB_CurveGroup_S16 3276.700 Temp_Cels -273.140 3003.560 FORMAT "%8.3" EXTENDED_LIMITS -3549.940 3003.560
 /begin AXIS_DESCR COM_AXIS EngStrt_tStrtCoor Temp_Cels 6 -273.140 3003.560 FORMAT "%8.3" EXTENDED_LIMITS -3549.940 3003.560 AXIS_PTS_REF EngStrt_tStrtCoor_AX /end AXIS_DESCR
/end CHARACTERISTIC
/begin CHARACTERISTIC EngStrt_tHspWrmUpHys_C "Hysteresis min. engine coolant temperature for homogeneous split mode" VALUE 0x805447C0 RB_Val_Ws16 3276.700 Temp_Kelv 0.00 3276.700 FORMAT "%8.3" EXTENDED_LIMITS -3276.800 3276.700 /end CHARACTERISTIC
/begin CHARACTERISTIC EngStrt_tHspWrmUpLo_C "Min. engine coolant temperature for homogeneous split mode" VALUE 0x805447C2 RB_Val_Ws16 3276.700 Temp_Cels -273.140 3003.560 FORMAT "%8.3" EXTENDED_LIMITS -3549.940 3003.560 /end CHARACTERISTIC
/begin CHARACTERISTIC EngStrt_tHspWrmUp_C "Min. engine coolant temperature for homogeneous split mode" VALUE 0x805447C4 RB_Val_Ws16 3276.700 Temp_Cels -273.140 3003.560 FORMAT "%8.3" EXTENDED_LIMITS -3549.940 3003.560 /end CHARACTERISTIC
/begin CHARACTERISTIC EngStrt_tiAfterStrtEndMin_C "Time following start-up with switchover ban homogeneous - stratified" VALUE 0x805447C6 RB_Val_Wu16 655.3500 t10msxs_uw_b655p35 0.00 655.3500 FORMAT "%8.4" /end CHARACTERISTIC
/begin CHARACTERISTIC EngStrt_tiDisblNewSyncMax_C "maximum time until DisblNewSync is ended" VALUE 0x8050557E Val_Wu16 655.3500 ti_s_q0p01_COMPU 0.00 655.3500 FORMAT "%8.4" /end CHARACTERISTIC
/begin CHARACTERISTIC EngStrt_tiDlyCoMWaitStrtr_C "Delay time to maintain ENGSTRT_COMWAITSTRTR in case of start request close to engine standstill" VALUE 0x80543692 RB_Val_Wu8 2.550 t_q0p01 0.00 2.550 FORMAT "%5.3" /end CHARACTERISTIC
/begin CHARACTERISTIC EngStrt_tiDlyNoStrtReq_C "time delay to trigger a priorisation without start request" VALUE 0x80543693 RB_Val_Wu8 2.550 t_q0p01 0.00 2.550 FORMAT "%5.3" /end CHARACTERISTIC
/begin CHARACTERISTIC EngStrt_tiDlyStrtEndTqStruct_T "Curve delay time after end of start to set the release of the torque structure" CURVE 0x8054385E RB_Curve_U16_U16 655.3500 t_q0p01 0.00 655.3500 FORMAT "%8.4"
 /begin AXIS_DESCR STD_AXIS EngStrt_stStrtReq ENGSTRT_STSTRTREQ_SET_COMPU_VERB 19 0.00 32770.0000000 FORMAT "%13.7" DEPOSIT ABSOLUTE /end AXIS_DESCR
/end CHARACTERISTIC
/begin CHARACTERISTIC EngStrt_tiDlySyncnLoss_C "time delay after transition in STARTING to check the synchronisation loss" VALUE 0x805445D6 RB_Val_Wu8 2.550 t_q0p01 0.00 2.550 FORMAT "%5.3" /end CHARACTERISTIC
/begin CHARACTERISTIC EngStrt_tiEngStpDrctStrt_C "Allowed engine stop time for direct start" VALUE 0x80543694 RB_Val_Ws32 4294967295.00 Time_sec_q1_COMPU -2147483648.00 2147483647.00 FORMAT "%13.2" /end CHARACTERISTIC
/begin CHARACTERISTIC EngStrt_tiMaxInjRelsOilP_C "Max. time without injection release for start at end of line" VALUE 0x8054343C RB_Val_Wu16 655.3500 t_q0p01 0.00 655.3500 FORMAT "%8.4" /end CHARACTERISTIC
/begin CHARACTERISTIC EngStrt_tiRdyMinCep_C "delay from EPM_SPD_ZERO until standstill of the engine is confirmed by CEP" VALUE 0x805431E4 RB_Val_Ws32 4294.96729500 Time_Dt -2147.48364800 2147.48364700 FORMAT "%13.8" /end CHARACTERISTIC
/begin CHARACTERISTIC EngStrt_tMaxEngFuInpOil_C "maximum engine temperature for fuel input into oil due to transient compensation." VALUE 0x805432F6 RB_Val_Ws16 6553.500 Temp_Cels -3549.940 3003.560 FORMAT "%8.3" /end CHARACTERISTIC
/begin AXIS_PTS EngStrt_tStrtCoor_AX "Base point distribution start temperature" 0x805447C8 EngStrt_tStrtCoor RB_Axis_S16 3276.700 Temp_Cels 6 -273.140 3003.560 FORMAT "%8.3" EXTENDED_LIMITS -3549.940 3003.560 DEPOSIT ABSOLUTE /end AXIS_PTS
/begin CHARACTERISTIC EngStrt_tStrtEndSpdGovr_C "Minumim temperature to activate the early idle control at follow-up start" VALUE 0x805438AC RB_Val_Ws16 3276.700 Temp_Cels -273.140 3003.560 FORMAT "%8.3" EXTENDED_LIMITS -3549.940 3003.560 /end CHARACTERISTIC
/begin AXIS_PTS EngStrt_tStrtEnd_AX "Base point distribution engine temperature for the detection of end of start" 0x805438AE EngStrt_tCoor RB_Axis_S16 3276.700 Temp_Cels 12 -273.140 3003.560 FORMAT "%8.3" EXTENDED_LIMITS -3549.940 3003.560 DEPOSIT ABSOLUTE /end AXIS_PTS
/begin CHARACTERISTIC EngStrt_tThdEngOpModWrmStrt_C "threshold tempreature to change the Engine operation mode request for warm up" VALUE 0x805447D6 RB_Val_Ws16 3276.700 Temp_Cels -273.140 3003.560 FORMAT "%8.3" EXTENDED_LIMITS -3549.940 3003.560 /end CHARACTERISTIC
/begin CHARACTERISTIC ExhMgT_tCat1MaxStopEngMax_T "temperature curve for first catalyst till no relase of switch off engine is allowed" CURVE 0x8053F27E RB_Curve_U16_S16_Static 6553.500 Temp_Cels -3549.940 3003.560 FORMAT "%8.3"
 /begin AXIS_DESCR STD_AXIS ExhMod_ratO2StrCat1MinBnk fak_q3p0518Em5 4 0.00 1.999969 FORMAT "%8.6" DEPOSIT ABSOLUTE /end AXIS_DESCR
/end CHARACTERISTIC
/begin CHARACTERISTIC ExhMgT_tCat1O2StorgMin_T "minimum temperature in first catalyst for relase of switch off engine" CURVE 0x8053F290 RB_Curve_U16_S16_Static 6553.500 Temp_Cels -3549.940 3003.560 FORMAT "%8.3"
 /begin AXIS_DESCR STD_AXIS ExhMod_ratO2StrCat1MinBnk fak_q3p0518Em5 4 0.00 1.999969 FORMAT "%8.6" DEPOSIT ABSOLUTE /end AXIS_DESCR
/end CHARACTERISTIC
/begin CHARACTERISTIC ExhMgT_tCat2MaxStopEngMax_C "temperature threshold for second catalyst till no relase of switch off engine is allowed" VALUE 0x8053F2A2 RB_Val_Ws16 6553.500 Temp_Cels -3549.940 3003.560 FORMAT "%8.3" /end CHARACTERISTIC
/begin CHARACTERISTIC ExhMgT_tCat2O2StorgMin_C "Parameter for minimum temperature in second catalyst for relase of switch off engine" VALUE 0x8053F2A4 RB_Val_Ws16 6553.500 Temp_Cels -3549.940 3003.560 FORMAT "%8.3" /end CHARACTERISTIC
/begin CHARACTERISTIC FAIR2FUEL "Conversion factor from air mass flow to fuel mass flow" VALUE 0x805432F8 RB_Val_Wu16 62.99902 fak_uw_b64 1.00000 63.99902 FORMAT "%8.5" EXTENDED_LIMITS 0.00 63.99902 /end CHARACTERISTIC
/begin CHARACTERISTIC FAMPLANRMX "Maximum amplitude of suggestion function for lambda correction at idle" CURVE 0x80543488 RB_Curve_U16_U16 0.9999847 fak_q1p5258Em5 0.00 0.9999847 FORMAT "%9.7"
 /begin AXIS_DESCR STD_AXIS lakotmp_w fak_uw_b4 5 0.00 3.999939 FORMAT "%8.6" DEPOSIT ABSOLUTE /end AXIS_DESCR
/end CHARACTERISTIC
/begin CHARACTERISTIC FAUSGENDTO "Factor for scaling the max.evaporation rate from oil after detection of the end of evaporation" VALUE 0x805432FA RB_Val_Wu8 6.938 fak_ub_b8 1.031 7.969 FORMAT "%5.3" EXTENDED_LIMITS 0.00 7.969 /end CHARACTERISTIC
/begin CHARACTERISTIC FBAMPANR "Factor of evaluation of the duration of fat- and poor-lambda in dependence of the suggested amplitude" CURVE 0x8054349E RB_Curve_U16_U16 0.9999847 fak_q1p5258Em5 0.00 0.9999847 FORMAT "%9.7"
 /begin AXIS_DESCR STD_AXIS famplanr_w_msg fak_q1p5258Em5 3 0.00 0.9999847 FORMAT "%9.7" DEPOSIT ABSOLUTE /end AXIS_DESCR
/end CHARACTERISTIC
/begin CHARACTERISTIC FBEWLAMKOR "factor of evaluation of the result of the quotient of the correction of lambda at idle" VALUE 0x805434AC RB_Val_Wu16 49.99924 fak_q0p000763 0.00 49.99924 FORMAT "%8.5" /end CHARACTERISTIC
/begin CHARACTERISTIC FGAUSGIO "low threshold hysteresis for critical evaporation proportion of fuel need" VALUE 0x805432FB RB_Val_Wu8 1.992188 fak_ub_b2 0.00 1.992188 FORMAT "%8.6" /end CHARACTERISTIC
/begin CHARACTERISTIC FGAUSGLIM "Threshold for significant evaporation of fuel from oil" VALUE 0x805432FC RB_Val_Wu8 1.992188 fak_ub_b2 0.00 1.992188 FORMAT "%8.6" /end CHARACTERISTIC
/begin CHARACTERISTIC FGAUSGMX "upper threshold hysteresis for critical evaporation proportion of fuel need" VALUE 0x805432FD RB_Val_Wu8 1.992188 fak_ub_b2 0.00 1.992188 FORMAT "%8.6" /end CHARACTERISTIC
/begin CHARACTERISTIC FLAANRSO "highest threshold of DT1 for the activation of the correction of lambda at idle" CURVE 0x805434AE RB_Curve_U16_U16 0.9999847 fak_uw_b1 0.00 0.9999847 FORMAT "%9.7"
 /begin AXIS_DESCR STD_AXIS dflaanr_w fak_uw_b2 5 0.00 1.999969 FORMAT "%8.6" DEPOSIT ABSOLUTE /end AXIS_DESCR
/end CHARACTERISTIC
/begin CHARACTERISTIC FLAANRSU "lowest threshold of DT1 for the activation of the correction of lambda at idle" CURVE 0x805434C4 RB_Curve_U16_U16 0.9999847 fak_uw_b1 0.00 0.9999847 FORMAT "%9.7"
 /begin AXIS_DESCR STD_AXIS dflaanr_w fak_uw_b2 5 0.00 1.999969 FORMAT "%8.6" DEPOSIT ABSOLUTE /end AXIS_DESCR
/end CHARACTERISTIC
/begin CHARACTERISTIC KFWMIXNAL "Factor for torque limitation depending on engine speed and falkg" MAP 0x80542E9D RB_Map_U8U8_U8 1.992188 fak_ub_b2 0.00 1.992188 FORMAT "%8.6"
 /begin AXIS_DESCR STD_AXIS EngReq_nmotLoc nmot_ub_q40 8 0.00 10000. FORMAT "%5.0" EXTENDED_LIMITS 0.00 10200. DEPOSIT ABSOLUTE /end AXIS_DESCR
 /begin AXIS_DESCR STD_AXIS EngReq_fethmnmxLoc fak_ub_b2 6 0.00 1.992188 FORMAT "%8.6" DEPOSIT ABSOLUTE /end AXIS_DESCR
/end CHARACTERISTIC
/begin CHARACTERISTIC KFWMIXTMT "Factor for torque limitation depending on engine speed and time after end of start" MAP 0x80542EDE RB_Map_U8U16_U8 1.992188 fak_ub_b2 0.00 1.992188 FORMAT "%8.6"
 /begin AXIS_DESCR STD_AXIS EngReq_tmotLoc temp_ub_q0p75_o48 8 -48.0 143.3 FORMAT "%5.1" DEPOSIT ABSOLUTE /end AXIS_DESCR
 /begin AXIS_DESCR STD_AXIS EngReq_tnstLoc t10msxs_uw_b655p35 8 0.00 655.3500 FORMAT "%8.4" DEPOSIT ABSOLUTE /end AXIS_DESCR
/end CHARACTERISTIC
/begin CHARACTERISTIC KLAUSGEMKLR "Curve: Correction factor of fuel evaporation from oil due to amount of fuel in oil" CURVE 0x805432FE RB_Curve_U16_U8_Static 1.992188 fak_ub_b2 0.00 1.992188 FORMAT "%8.6"
 /begin AXIS_DESCR STD_AXIS EngStrt_mFuOilFast m_q0p032_g 6 0.00 2097.120 FORMAT "%8.3" DEPOSIT ABSOLUTE /end AXIS_DESCR
/end CHARACTERISTIC
/begin CHARACTERISTIC KLAUSGMNST "Curve min. evaporation rate of the fuel out of oil during start" CURVE 0x80543312 RB_Curve_U16_S16_Static 14222.01 m_q0p2170 -7111.111 7110.894 FORMAT "%8.3"
 /begin AXIS_DESCR STD_AXIS mskausmx_w_msg m_q0p2170 5 0.00 14222.01 FORMAT "%8.2" DEPOSIT ABSOLUTE /end AXIS_DESCR
/end CHARACTERISTIC
/begin CHARACTERISTIC KLAUSGR "Curve evaporation rate of the fuel out of oil" CURVE 0x80543328 RB_Curve_U8_U16_Static 99.99847 rel_q0p00152 0.00 99.99847 FORMAT "%8.5"
 /begin AXIS_DESCR STD_AXIS EngStrt_tOil temp_ub_q0p75_o48 12 -48.0 143.3 FORMAT "%5.1" DEPOSIT ABSOLUTE /end AXIS_DESCR
/end CHARACTERISTIC
/begin CHARACTERISTIC KLAUSGRMX "Curve max. evaporation rate of the fuel out of oil (envelope curve)" CURVE 0x8054334E RB_Curve_U8_U16_Static 99.99847 rel_q0p00152 0.00 99.99847 FORMAT "%8.5"
 /begin AXIS_DESCR STD_AXIS EngStrt_tOil temp_ub_q0p75_o48 12 -48.0 143.3 FORMAT "%5.1" DEPOSIT ABSOLUTE /end AXIS_DESCR
/end CHARACTERISTIC
/begin CHARACTERISTIC KLAUSGST "Curve: weight factor depending of engine shutt-off time for evaporation from oil during start" CURVE 0x80543374 RB_Curve_U16_U8_Static 1.992188 fak_ub_b2 0.00 1.992188 FORMAT "%8.6"
 /begin AXIS_DESCR STD_AXIS tengsq1_w_msg t_q1 6 0.00 65535.00 FORMAT "%8.2" DEPOSIT ABSOLUTE /end AXIS_DESCR
/end CHARACTERISTIC
/begin CHARACTERISTIC KLFINOELTS "Curve fuel input into oil depending of the start temperature" CURVE 0x80543388 RB_Curve_U8_U8 1.000000 fak_ub_b2 0.00 1.000000 FORMAT "%8.6" EXTENDED_LIMITS 0.00 1.992188
 /begin AXIS_DESCR STD_AXIS EngStrt_tStrt temp_ub_q0p75_o48 8 -48.0 143.3 FORMAT "%5.1" DEPOSIT ABSOLUTE /end AXIS_DESCR
/end CHARACTERISTIC
/begin CHARACTERISTIC KLFLAKORMK "curve: correction in flakorm_w" CURVE 0x8054339A RB_Curve_U16_U16 1.999969 fak_uw_b2 0.00 1.999969 FORMAT "%8.6"
 /begin AXIS_DESCR STD_AXIS flakorm_w_msg fak_uw_b2 4 0.00 1.999969 FORMAT "%8.6" DEPOSIT ABSOLUTE /end AXIS_DESCR
/end CHARACTERISTIC
/begin CHARACTERISTIC KLFRMAUSG "Curve: correction in frm_w" CURVE 0x805433AC RB_Curve_U16_U16 1.999969 fak_uw_b2 0.00 1.999969 FORMAT "%8.6"
 /begin AXIS_DESCR STD_AXIS frm_w_msg fak_uw_b2 4 0.00 1.999969 FORMAT "%8.6" DEPOSIT ABSOLUTE /end AXIS_DESCR
/end CHARACTERISTIC
/begin CHARACTERISTIC KLFRTMKI "Look up table control factor from engine temperature" CURVE 0x80542C65 RB_Curve_U8_U8 1.992188 fak_ub_b2 0.00 1.992188 FORMAT "%8.6"
 /begin AXIS_DESCR STD_AXIS EngPrt_tmotmdb temp_ub_q0p75_o48 16 -48.0 143.3 FORMAT "%5.1" DEPOSIT ABSOLUTE /end AXIS_DESCR
/end CHARACTERISTIC
/begin CHARACTERISTIC KLIMLTMST "line for integrated air mass to reset of condition for request of a prohibition of an engine stop (B_nostopkh)" CURVE 0x8053F2A6 RB_Curve_S16_U16_Static 23.30133 m_uw_b23p3 0.00 23.30133 FORMAT "%8.5"
 /begin AXIS_DESCR STD_AXIS ExhMgT_tStrtStopEng Temp_Cels 4 -3549.940 3003.560 FORMAT "%8.3" DEPOSIT ABSOLUTE /end AXIS_DESCR
/end CHARACTERISTIC
/begin CHARACTERISTIC KLWMIXGI "Factor for torque limitation depending on gear" CURVE 0x80542F38 RB_Curve_S8_U8_Static 1.992188 fak_ub_b2 0.00 1.992188 FORMAT "%8.6"
 /begin AXIS_DESCR STD_AXIS EngReq_gangsistLoc dez 8 -128.0 127.0 FORMAT "%5.1" DEPOSIT ABSOLUTE /end AXIS_DESCR
/end CHARACTERISTIC
/begin CHARACTERISTIC MDGAT "Look up table for torque limitation by high exhaust temperature" CURVE 0x80542C86 RB_Curve_S16_U16_Static 99.99847 rel_uw_b100 0.00 99.99847 FORMAT "%8.5"
 /begin AXIS_DESCR STD_AXIS Epm_nEng EngN 6 -16384.00 16383.50 FORMAT "%8.2" DEPOSIT ABSOLUTE /end AXIS_DESCR
/end CHARACTERISTIC
/begin CHARACTERISTIC MIFALAUSG "Threshold torque for fast diasble of inj. time increase request due to evaporation" VALUE 0x805433BE RB_Val_Wu16 99.99847 rel_uw_b100 0.00 99.99847 FORMAT "%8.5" /end CHARACTERISTIC
/begin CHARACTERISTIC MKIOELAP "Calibration value for the fuel mass in oil" VALUE 0x805433C0 RB_Val_Wu16 2097.120 m_q0p032_g 0.00 2097.120 FORMAT "%8.3" /end CHARACTERISTIC
/begin CHARACTERISTIC MKIOELMX "Maximum value for the fuel mass in the engine oil" VALUE 0x805433C2 RB_Val_Wu16 2097.120 m_q0p032_g 0.00 2097.120 FORMAT "%8.3" /end CHARACTERISTIC
/begin CHARACTERISTIC MKIOELMXUB "Maximum value for the fuel mass in the engine oil (mkioelub_w)" VALUE 0x80543504 RB_Val_Wu16 2684.314 m_q0p04096 0.00 2684.314 FORMAT "%8.3" /end CHARACTERISTIC
/begin CHARACTERISTIC MKIOELUBAP "Calibration value for the fuel mass in oil (mkioelub_w)" VALUE 0x80543506 RB_Val_Wu16 2684.314 m_q0p04096 0.00 2684.314 FORMAT "%8.3" /end CHARACTERISTIC
/begin CHARACTERISTIC MKMNAUSG "Min value of fuel in oil for ""mskausev_w"" increase." VALUE 0x805433C4 RB_Val_Wu16 2097.120 m_q0p032_g 0.00 2097.120 FORMAT "%8.3" /end CHARACTERISTIC
/begin CHARACTERISTIC MKNLLEHRTI "Min. fuel in oil value for requirement idle eingine speed increase" VALUE 0x805433C6 RB_Val_Wu16 2097.120 m_q0p032_g 0.00 2097.120 FORMAT "%8.3" /end CHARACTERISTIC
/begin CHARACTERISTIC MSKADAPHI "max fuel need value to enable evaporation adaptation" VALUE 0x805433C8 RB_Val_Wu16 65535.00 mgrad_q1_mgdivs 0.00 65535.00 FORMAT "%8.2" /end CHARACTERISTIC
/begin CHARACTERISTIC MSKALLKETO "Lower threshold of outgassing for activation LAMKORRLL" CURVE 0x805434DA RB_Curve_U8_U16_Static 14222.01 m_q0p2170 0.00 14222.01 FORMAT "%8.2"
 /begin AXIS_DESCR STD_AXIS oilswmp_t temp_uw_q0p75_o48 4 -48.0 143.3 FORMAT "%5.1" DEPOSIT ABSOLUTE /end AXIS_DESCR
/end CHARACTERISTIC
/begin CHARACTERISTIC MSKAUSEND "Threshold max. evaporation mass flow from oil for the detection of the end of evaporation from oil" VALUE 0x805433CA RB_Val_Ws16 14222.01 m_q0p2170 -7111.111 7110.894 FORMAT "%8.3" /end CHARACTERISTIC
/begin CHARACTERISTIC MSKAUSKRIT "Threshold for the max. evaporation limitaion mskausmx_w to enable the ramp-on functionality" VALUE 0x805433CC RB_Val_Wu16 14222.01 m_q0p2170 0.00 14222.01 FORMAT "%8.2" /end CHARACTERISTIC
/begin CHARACTERISTIC MSKAUSMNST "min. Evaporated fuel (from engine oil) mass flowrate for inclusion in start computation" VALUE 0x805433CE RB_Val_Wu16 14222.01 m_q0p2170 0.00 14222.01 FORMAT "%8.2" /end CHARACTERISTIC
/begin CHARACTERISTIC MSKMINAUSG "Min value for evaporated fuel mass flowrate from engine oil after motor is warm" VALUE 0x805433D0 RB_Val_Wu16 14222.01 m_q0p2170 0.00 14222.01 FORMAT "%8.2" /end CHARACTERISTIC
/begin CHARACTERISTIC MSKROFINC "increment of gradient limited limitation of the fuel evaporation from oil during ramp-off functionality" VALUE 0x805433D2 RB_Val_Ws16 14222.01 m_q0p2170 -7111.111 7110.894 FORMAT "%8.3" /end CHARACTERISTIC
/begin CHARACTERISTIC MSKRONINC "increment of the fuel evaporation from oil offset for ramp-on functionality" VALUE 0x805433D4 RB_Val_Wu8 55.34 m_q0p2170 0.00 55.34 FORMAT "%5.2" /end CHARACTERISTIC
/begin CHARACTERISTIC MSKRONMX "max. value of fuel evaporation from oil offset for ramp-on functionality" VALUE 0x805433D6 RB_Val_Wu16 14222.01 m_q0p2170 0.00 14222.01 FORMAT "%8.2" /end CHARACTERISTIC
/begin CHARACTERISTIC MX1OELUB "First maximal level of fuel in oil (Worsening of performance)" VALUE 0x80543508 RB_Val_Wu16 2684.314 m_q0p04096 0.00 2684.314 FORMAT "%8.3" /end CHARACTERISTIC
/begin CHARACTERISTIC MX2OELUB "Second maximal level of fuel in oil reached (risk for components)" VALUE 0x8054350A RB_Val_Wu16 2684.314 m_q0p04096 0.00 2684.314 FORMAT "%8.3" /end CHARACTERISTIC
/begin CHARACTERISTIC NENG.EngStrt_facEthStrtEnd_T "Class instance to detect end of start based on engine speed threshold / Table: factor ethanol startend" CURVE 0x80543F0C RB_Curve_U16_U8_Static 0.9961 fak_ub_b1 0.00 0.9961
 /begin AXIS_DESCR STD_AXIS NO_INPUT_QUANTITY fak_uw_b2 4 0.00 1.999969 FORMAT "%8.6" DEPOSIT ABSOLUTE /end AXIS_DESCR
/end CHARACTERISTIC
/begin CHARACTERISTIC NENG.nStrtEndEth_GM "Class instance to detect end of start based on engine speed threshold / Group Map: etahnol startend relational speed" MAP 0x80543F1A RB_MapGroup_S16 32767.50 EngN -16384.00 16383.50 FORMAT "%8.2"
 /begin AXIS_DESCR COM_AXIS EngStrt_tCoor Temp_Cels 12 -273.140 3003.560 FORMAT "%8.3" EXTENDED_LIMITS -3549.940 3003.560 AXIS_PTS_REF EngStrt_tStrtEnd_AX /end AXIS_DESCR
 /begin AXIS_DESCR COM_AXIS PEnv_p p_q0p039 8 0.00 2559.961 FORMAT "%8.3" AXIS_PTS_REF EngStrt_pStrtEnd_AX /end AXIS_DESCR
/end CHARACTERISTIC
/begin CHARACTERISTIC NENG.nStrtEnd_GM "Class instance to detect end of start based on engine speed threshold / Map engine speed threshold to detect end of start" MAP 0x80543FDA RB_MapGroup_S16 32767.50 EngN -16384.00 16383.50 FORMAT "%8.2"
 /begin AXIS_DESCR COM_AXIS EngStrt_tCoor Temp_Cels 12 -273.140 3003.560 FORMAT "%8.3" EXTENDED_LIMITS -3549.940 3003.560 AXIS_PTS_REF EngStrt_tStrtEnd_AX /end AXIS_DESCR
 /begin AXIS_DESCR COM_AXIS PEnv_p p_q0p039 8 0.00 2559.961 FORMAT "%8.3" AXIS_PTS_REF EngStrt_pStrtEnd_AX /end AXIS_DESCR
/end CHARACTERISTIC
/begin CHARACTERISTIC NENGCRIT.nStrtEndCrit_GM "Class instance to detect end of start based on engine speed threshold under critical start condition / Map engine speed threshold for critical start condition to detect end of start" MAP 0x805440A0 RB_MapGroup_S16 32767.50 EngN -16384.00 16383.50 FORMAT "%8.2"
 /begin AXIS_DESCR COM_AXIS EngStrt_tCoor Temp_Cels 12 -273.140 3003.560 FORMAT "%8.3" EXTENDED_LIMITS -3549.940 3003.560 AXIS_PTS_REF EngStrt_tStrtEnd_AX /end AXIS_DESCR
 /begin AXIS_DESCR COM_AXIS PEnv_p p_q0p039 8 0.00 2559.961 FORMAT "%8.3" AXIS_PTS_REF EngStrt_pStrtEnd_AX /end AXIS_DESCR
/end CHARACTERISTIC
/begin CHARACTERISTIC NENGCRIT.nStrtEnd_GM "Class instance to detect end of start based on engine speed threshold under critical start condition / Map engine speed threshold to detect end of start" MAP 0x80544160 RB_MapGroup_S16 32767.50 EngN -16384.00 16383.50 FORMAT "%8.2"
 /begin AXIS_DESCR COM_AXIS EngStrt_tCoor Temp_Cels 12 -273.140 3003.560 FORMAT "%8.3" EXTENDED_LIMITS -3549.940 3003.560 AXIS_PTS_REF EngStrt_tStrtEnd_AX /end AXIS_DESCR
 /begin AXIS_DESCR COM_AXIS PEnv_p p_q0p039 8 0.00 2559.961 FORMAT "%8.3" AXIS_PTS_REF EngStrt_pStrtEnd_AX /end AXIS_DESCR
/end CHARACTERISTIC
/begin CHARACTERISTIC NENGCRIT.tiStrtgStrtEndCrit_GM "Class instance to detect end of start based on engine speed threshold under critical start condition / Map start time to switch to engine speed threshold for critical start condition" MAP 0x80544220 RB_MapGroup_U16 655.3500 t_q0p01 0.00 655.3500 FORMAT "%8.4"
 /begin AXIS_DESCR COM_AXIS EngStrt_tCoor Temp_Cels 12 -273.140 3003.560 FORMAT "%8.3" EXTENDED_LIMITS -3549.940 3003.560 AXIS_PTS_REF EngStrt_tStrtEnd_AX /end AXIS_DESCR
 /begin AXIS_DESCR COM_AXIS EngStrt_nEngMaxCrit EngN 4 -16384.00 16383.50 FORMAT "%8.2" AXIS_PTS_REF EngStrt_nEngMaxCritStrtEnd_AX /end AXIS_DESCR
/end CHARACTERISTIC
/begin CHARACTERISTIC NENGDEB.EngStrt_facEthStrtEnd_T "Class instance to detect end of start based on engine speed threshold, injection counter and debouncing / Table: factor ethanol startend" CURVE 0x80544284 RB_Curve_U16_U8_Static 0.9961 fak_ub_b1 0.00 0.9961
 /begin AXIS_DESCR STD_AXIS NO_INPUT_QUANTITY fak_uw_b2 4 0.00 1.999969 FORMAT "%8.6" DEPOSIT ABSOLUTE /end AXIS_DESCR
/end CHARACTERISTIC
/begin CHARACTERISTIC NENGDEB.dnEngStrtDeb_C "Class instance to detect end of start based on engine speed threshold, injection counter and debouncing / engine speed gradient to detect end of start" VALUE 0x80544292 RB_Val_Ws16 32767.50 EngNGrd -16384.00 16383.50 FORMAT "%8.2" /end CHARACTERISTIC
/begin CHARACTERISTIC NENGDEB.nStrtEndEth_GM "Class instance to detect end of start based on engine speed threshold, injection counter and debouncing / Group Map: etahnol startend relational speed" MAP 0x80544294 RB_MapGroup_S16 32767.50 EngN -16384.00 16383.50 FORMAT "%8.2"
 /begin AXIS_DESCR COM_AXIS EngStrt_tCoor Temp_Cels 12 -273.140 3003.560 FORMAT "%8.3" EXTENDED_LIMITS -3549.940 3003.560 AXIS_PTS_REF EngStrt_tStrtEnd_AX /end AXIS_DESCR
 /begin AXIS_DESCR COM_AXIS PEnv_p p_q0p039 8 0.00 2559.961 FORMAT "%8.3" AXIS_PTS_REF EngStrt_pStrtEnd_AX /end AXIS_DESCR
/end CHARACTERISTIC
/begin CHARACTERISTIC NENGDEB.nStrtEnd_GM "Class instance to detect end of start based on engine speed threshold, injection counter and debouncing / Map engine speed threshold to detect end of start" MAP 0x80544354 RB_MapGroup_S16 32767.50 EngN -16384.00 16383.50 FORMAT "%8.2"
 /begin AXIS_DESCR COM_AXIS EngStrt_tCoor Temp_Cels 12 -273.140 3003.560 FORMAT "%8.3" EXTENDED_LIMITS -3549.940 3003.560 AXIS_PTS_REF EngStrt_tStrtEnd_AX /end AXIS_DESCR
 /begin AXIS_DESCR COM_AXIS PEnv_p p_q0p039 8 0.00 2559.961 FORMAT "%8.3" AXIS_PTS_REF EngStrt_pStrtEnd_AX /end AXIS_DESCR
/end CHARACTERISTIC
/begin CHARACTERISTIC NENGDEB.nrInjStrtEnd_GT "Class instance to detect end of start based on engine speed threshold, injection counter and debouncing / Curve injection counter threshold to detect end of start" CURVE 0x80544414 RB_CurveGroup_U8 255.0 OneToOne 0.00 255.0 FORMAT "%5.1"
 /begin AXIS_DESCR COM_AXIS EngStrt_tCoor Temp_Cels 12 -273.140 3003.560 FORMAT "%8.3" EXTENDED_LIMITS -3549.940 3003.560 AXIS_PTS_REF EngStrt_tStrtEnd_AX /end AXIS_DESCR
/end CHARACTERISTIC
/begin CHARACTERISTIC NENGDEB.tiDnEngStrtDeb_C "Class instance to detect end of start based on engine speed threshold, injection counter and debouncing / Debouncing time after engine speed gradient to detect end of start" VALUE 0x80544420 RB_Val_Wu8 2.550 t_q0p01 0.00 2.550 FORMAT "%5.3" /end CHARACTERISTIC
/begin CHARACTERISTIC NENGDEB.tiNEngStrtDebMax_C "Class instance to detect end of start based on engine speed threshold, injection counter and debouncing / Max. debouncing time after beginning of start to detect end of start" VALUE 0x80544421 RB_Val_Wu8 2.550 t_q0p01 0.00 2.550 FORMAT "%5.3" /end CHARACTERISTIC
/begin CHARACTERISTIC NENGNRINJ.EngStrt_facEthStrtEnd_T "Class instance to detect end of start based on engine speed threshold and injection counter / Table: factor ethanol startend" CURVE 0x80544424 RB_Curve_U16_U8_Static 0.9961 fak_ub_b1 0.00 0.9961
 /begin AXIS_DESCR STD_AXIS NO_INPUT_QUANTITY fak_uw_b2 4 0.00 1.999969 FORMAT "%8.6" DEPOSIT ABSOLUTE /end AXIS_DESCR
/end CHARACTERISTIC
/begin CHARACTERISTIC NENGNRINJ.nStrtEndEth_GM "Class instance to detect end of start based on engine speed threshold and injection counter / Group Map: etahnol startend relational speed" MAP 0x80544432 RB_MapGroup_S16 32767.50 EngN -16384.00 16383.50 FORMAT "%8.2"
 /begin AXIS_DESCR COM_AXIS EngStrt_tCoor Temp_Cels 12 -273.140 3003.560 FORMAT "%8.3" EXTENDED_LIMITS -3549.940 3003.560 AXIS_PTS_REF EngStrt_tStrtEnd_AX /end AXIS_DESCR
 /begin AXIS_DESCR COM_AXIS PEnv_p p_q0p039 8 0.00 2559.961 FORMAT "%8.3" AXIS_PTS_REF EngStrt_pStrtEnd_AX /end AXIS_DESCR
/end CHARACTERISTIC
/begin CHARACTERISTIC NENGNRINJ.nStrtEnd_GM "Class instance to detect end of start based on engine speed threshold and injection counter / Map engine speed threshold to detect end of start" MAP 0x805444F2 RB_MapGroup_S16 32767.50 EngN -16384.00 16383.50 FORMAT "%8.2"
 /begin AXIS_DESCR COM_AXIS EngStrt_tCoor Temp_Cels 12 -273.140 3003.560 FORMAT "%8.3" EXTENDED_LIMITS -3549.940 3003.560 AXIS_PTS_REF EngStrt_tStrtEnd_AX /end AXIS_DESCR
 /begin AXIS_DESCR COM_AXIS PEnv_p p_q0p039 8 0.00 2559.961 FORMAT "%8.3" AXIS_PTS_REF EngStrt_pStrtEnd_AX /end AXIS_DESCR
/end CHARACTERISTIC
/begin CHARACTERISTIC NENGNRINJ.nrInjStrtEnd_GT "Class instance to detect end of start based on engine speed threshold and injection counter / Curve injection counter threshold to detect end of start" CURVE 0x805445B2 RB_CurveGroup_U8 255.0 OneToOne 0.00 255.0 FORMAT "%5.1"
 /begin AXIS_DESCR COM_AXIS EngStrt_tCoor Temp_Cels 12 -273.140 3003.560 FORMAT "%8.3" EXTENDED_LIMITS -3549.940 3003.560 AXIS_PTS_REF EngStrt_tStrtEnd_AX /end AXIS_DESCR
/end CHARACTERISTIC
/begin CHARACTERISTIC NENGNRINJ_FOLW.EngStrt_facEthStrtEnd_T "Class to detect end of start based on engine speed and injection counter / Table: factor ethanol startend" CURVE 0x805438C8 RB_Curve_U16_U8_Static 0.9961 fak_ub_b1 0.00 0.9961
 /begin AXIS_DESCR STD_AXIS NO_INPUT_QUANTITY fak_uw_b2 4 0.00 1.999969 FORMAT "%8.6" DEPOSIT ABSOLUTE /end AXIS_DESCR
/end CHARACTERISTIC
/begin CHARACTERISTIC NENGNRINJ_FOLW.nStrtEndEth_GM "Class to detect end of start based on engine speed and injection counter / Group Map: etahnol startend relational speed" MAP 0x805438D6 RB_MapGroup_S16 32767.50 EngN -16384.00 16383.50 FORMAT "%8.2"
 /begin AXIS_DESCR COM_AXIS EngStrt_tCoor Temp_Cels 12 -273.140 3003.560 FORMAT "%8.3" EXTENDED_LIMITS -3549.940 3003.560 AXIS_PTS_REF EngStrt_tStrtEnd_AX /end AXIS_DESCR
 /begin AXIS_DESCR COM_AXIS PEnv_p p_q0p039 8 0.00 2559.961 FORMAT "%8.3" AXIS_PTS_REF EngStrt_pStrtEnd_AX /end AXIS_DESCR
/end CHARACTERISTIC
/begin CHARACTERISTIC NENGNRINJ_FOLW.nStrtEnd_GM "Class to detect end of start based on engine speed and injection counter / Map engine speed threshold to detect end of start" MAP 0x80543996 RB_MapGroup_S16 32767.50 EngN -16384.00 16383.50 FORMAT "%8.2"
 /begin AXIS_DESCR COM_AXIS EngStrt_tCoor Temp_Cels 12 -273.140 3003.560 FORMAT "%8.3" EXTENDED_LIMITS -3549.940 3003.560 AXIS_PTS_REF EngStrt_tStrtEnd_AX /end AXIS_DESCR
 /begin AXIS_DESCR COM_AXIS PEnv_p p_q0p039 8 0.00 2559.961 FORMAT "%8.3" AXIS_PTS_REF EngStrt_pStrtEnd_AX /end AXIS_DESCR
/end CHARACTERISTIC
/begin CHARACTERISTIC NENGNRINJ_FOLW.nrInjStrtEnd_GT "Class to detect end of start based on engine speed and injection counter / Curve injection counter threshold to detect end of start" CURVE 0x80543A56 RB_CurveGroup_U8 255.0 OneToOne 0.00 255.0 FORMAT "%5.1"
 /begin AXIS_DESCR COM_AXIS EngStrt_tCoor Temp_Cels 12 -273.140 3003.560 FORMAT "%8.3" EXTENDED_LIMITS -3549.940 3003.560 AXIS_PTS_REF EngStrt_tStrtEnd_AX /end AXIS_DESCR
/end CHARACTERISTIC
/begin CHARACTERISTIC NENG_COM.EngStrt_facEthStrtEnd_T "Class to detect end of start based on engine speed / Table: factor ethanol startend" CURVE 0x80543A62 RB_Curve_U16_U8_Static 0.9961 fak_ub_b1 0.00 0.9961
 /begin AXIS_DESCR STD_AXIS NO_INPUT_QUANTITY fak_uw_b2 4 0.00 1.999969 FORMAT "%8.6" DEPOSIT ABSOLUTE /end AXIS_DESCR
/end CHARACTERISTIC
/begin CHARACTERISTIC NENG_COM.nStrtEndEth_GM "Class to detect end of start based on engine speed / Group Map: etahnol startend relational speed" MAP 0x80543A70 RB_MapGroup_S16 32767.50 EngN -16384.00 16383.50 FORMAT "%8.2"
 /begin AXIS_DESCR COM_AXIS EngStrt_tCoor Temp_Cels 12 -273.140 3003.560 FORMAT "%8.3" EXTENDED_LIMITS -3549.940 3003.560 AXIS_PTS_REF EngStrt_tStrtEnd_AX /end AXIS_DESCR
 /begin AXIS_DESCR COM_AXIS PEnv_p p_q0p039 8 0.00 2559.961 FORMAT "%8.3" AXIS_PTS_REF EngStrt_pStrtEnd_AX /end AXIS_DESCR
/end CHARACTERISTIC
/begin CHARACTERISTIC NENG_COM.nStrtEnd_GM "Class to detect end of start based on engine speed / Map engine speed threshold to detect end of start" MAP 0x80543B30 RB_MapGroup_S16 32767.50 EngN -16384.00 16383.50 FORMAT "%8.2"
 /begin AXIS_DESCR COM_AXIS EngStrt_tCoor Temp_Cels 12 -273.140 3003.560 FORMAT "%8.3" EXTENDED_LIMITS -3549.940 3003.560 AXIS_PTS_REF EngStrt_tStrtEnd_AX /end AXIS_DESCR
 /begin AXIS_DESCR COM_AXIS PEnv_p p_q0p039 8 0.00 2559.961 FORMAT "%8.3" AXIS_PTS_REF EngStrt_pStrtEnd_AX /end AXIS_DESCR
/end CHARACTERISTIC
/begin CHARACTERISTIC NENG_EOL.EngStrt_facEthStrtEnd_T "Class to detect end of start based on engine speed / Table: factor ethanol startend" CURVE 0x80543BF0 RB_Curve_U16_U8_Static 0.9961 fak_ub_b1 0.00 0.9961
 /begin AXIS_DESCR STD_AXIS NO_INPUT_QUANTITY fak_uw_b2 4 0.00 1.999969 FORMAT "%8.6" DEPOSIT ABSOLUTE /end AXIS_DESCR
/end CHARACTERISTIC
/begin CHARACTERISTIC NENG_EOL.nStrtEndEth_GM "Class to detect end of start based on engine speed / Group Map: etahnol startend relational speed" MAP 0x80543BFE RB_MapGroup_S16 32767.50 EngN -16384.00 16383.50 FORMAT "%8.2"
 /begin AXIS_DESCR COM_AXIS EngStrt_tCoor Temp_Cels 12 -273.140 3003.560 FORMAT "%8.3" EXTENDED_LIMITS -3549.940 3003.560 AXIS_PTS_REF EngStrt_tStrtEnd_AX /end AXIS_DESCR
 /begin AXIS_DESCR COM_AXIS PEnv_p p_q0p039 8 0.00 2559.961 FORMAT "%8.3" AXIS_PTS_REF EngStrt_pStrtEnd_AX /end AXIS_DESCR
/end CHARACTERISTIC
/begin CHARACTERISTIC NENG_EOL.nStrtEnd_GM "Class to detect end of start based on engine speed / Map engine speed threshold to detect end of start" MAP 0x80543CBE RB_MapGroup_S16 32767.50 EngN -16384.00 16383.50 FORMAT "%8.2"
 /begin AXIS_DESCR COM_AXIS EngStrt_tCoor Temp_Cels 12 -273.140 3003.560 FORMAT "%8.3" EXTENDED_LIMITS -3549.940 3003.560 AXIS_PTS_REF EngStrt_tStrtEnd_AX /end AXIS_DESCR
 /begin AXIS_DESCR COM_AXIS PEnv_p p_q0p039 8 0.00 2559.961 FORMAT "%8.3" AXIS_PTS_REF EngStrt_pStrtEnd_AX /end AXIS_DESCR
/end CHARACTERISTIC
/begin CHARACTERISTIC NENG_FOLW.EngStrt_facEthStrtEnd_T "Class to detect end of start based on engine speed / Table: factor ethanol startend" CURVE 0x80543D7E RB_Curve_U16_U8_Static 0.9961 fak_ub_b1 0.00 0.9961
 /begin AXIS_DESCR STD_AXIS NO_INPUT_QUANTITY fak_uw_b2 4 0.00 1.999969 FORMAT "%8.6" DEPOSIT ABSOLUTE /end AXIS_DESCR
/end CHARACTERISTIC
/begin CHARACTERISTIC NENG_FOLW.nStrtEndEth_GM "Class to detect end of start based on engine speed / Group Map: etahnol startend relational speed" MAP 0x80543D8C RB_MapGroup_S16 32767.50 EngN -16384.00 16383.50 FORMAT "%8.2"
 /begin AXIS_DESCR COM_AXIS EngStrt_tCoor Temp_Cels 12 -273.140 3003.560 FORMAT "%8.3" EXTENDED_LIMITS -3549.940 3003.560 AXIS_PTS_REF EngStrt_tStrtEnd_AX /end AXIS_DESCR
 /begin AXIS_DESCR COM_AXIS PEnv_p p_q0p039 8 0.00 2559.961 FORMAT "%8.3" AXIS_PTS_REF EngStrt_pStrtEnd_AX /end AXIS_DESCR
/end CHARACTERISTIC
/begin CHARACTERISTIC NENG_FOLW.nStrtEnd_GM "Class to detect end of start based on engine speed / Map engine speed threshold to detect end of start" MAP 0x80543E4C RB_MapGroup_S16 32767.50 EngN -16384.00 16383.50 FORMAT "%8.2"
 /begin AXIS_DESCR COM_AXIS EngStrt_tCoor Temp_Cels 12 -273.140 3003.560 FORMAT "%8.3" EXTENDED_LIMITS -3549.940 3003.560 AXIS_PTS_REF EngStrt_tStrtEnd_AX /end AXIS_DESCR
 /begin AXIS_DESCR COM_AXIS PEnv_p p_q0p039 8 0.00 2559.961 FORMAT "%8.3" AXIS_PTS_REF EngStrt_pStrtEnd_AX /end AXIS_DESCR
/end CHARACTERISTIC
/begin CHARACTERISTIC NLIMRKLAKO "RPM Thresholdfor limitation of fuel evaporation from oil mass flow for monitoring" VALUE 0x805433D8 RB_Val_Wu8 10200. nmot_ub_q40 0.00 10200. FORMAT "%5.0" /end CHARACTERISTIC
/begin CHARACTERISTIC NLLKORRE "Engine speed switch off threshold for LAMKORRLL" VALUE 0x805434E8 RB_Val_Wu16 16383.75 nmot_uw_q0p25 0.00 16383.75 FORMAT "%8.2" /end CHARACTERISTIC
/begin CHARACTERISTIC RKAUSGLIM "rkausg_w limit for monitoring (max. enrichment, without stimulation rkalakor_w)" VALUE 0x805433DA RB_Val_Ws16 3071.953 rel_sw_b1536 -1536.000 1535.953 FORMAT "%8.3" /end CHARACTERISTIC
/begin CHARACTERISTIC RKAUSLILAK "rkausg_w limit for monitoring (max. enrichment, with stimulation rkalakor_w) for low rpm" VALUE 0x805433DC RB_Val_Ws16 3071.953 rel_sw_b1536 -1536.000 1535.953 FORMAT "%8.3" /end CHARACTERISTIC
/begin CHARACTERISTIC SDLUROABR "Threshold for aborting the ramp-on functionality of the fuel evaporation from oil" VALUE 0x805433DE RB_Val_Ws16 465.6542 lu_MEx -232.8306 232.8235 FORMAT "%8.4" /end CHARACTERISTIC
/begin CHARACTERISTIC TAGAT "Time constant for torque limitation regulation" VALUE 0x80542CA0 RB_Val_Wu16 6553.4999985 zk100msxs_uw_b6553p6 0.1000015 6553.6000000 FORMAT "%12.7" EXTENDED_LIMITS 0.10000152590 6553.6000000 /end CHARACTERISTIC
/begin CHARACTERISTIC TAUSGABST "fausgabst reset time constant" VALUE 0x805433E0 RB_Val_Wu8 5.100 t_q0p02 0.00 5.100 FORMAT "%5.3" /end CHARACTERISTIC
/begin CHARACTERISTIC TAUSGADAP "Duration of the adaptation-period for the fuel evaporation from oil" VALUE 0x805433E2 RB_Val_Wu16 1310.700 t_q0p02 0.00 1310.700 FORMAT "%8.3" /end CHARACTERISTIC
/begin CHARACTERISTIC TAUSGEND "Debounce time for the detection of the end of evaporation from oil" VALUE 0x805433E4 RB_Val_Wu16 1310.700 t_q0p02 0.00 1310.700 FORMAT "%8.3" /end CHARACTERISTIC
/begin CHARACTERISTIC TDBGOELERR "Debouncing time to reset error condition: Maximal level of fuel in oil reached" VALUE 0x8054350C RB_Val_Wu16 65535.00 t_q1 0.00 65535.00 FORMAT "%8.2" /end CHARACTERISTIC
/begin CHARACTERISTIC TDBGOELERS "Debouncing time to set error condition: Maximal level of fuel in oil reached" VALUE 0x8054350E RB_Val_Wu16 65535.00 t_q1 0.00 65535.00 FORMAT "%8.2" /end CHARACTERISTIC
/begin CHARACTERISTIC TDENSENGBL "time delay for release of engine stop when operational readiness of oxygen sensors is reached" VALUE 0x8053F2B8 RB_Val_Wu8 25.50 t_q0p1 0.00 25.50 FORMAT "%5.2" /end CHARACTERISTIC
/begin CHARACTERISTIC TDENSENGTP "time delay for release of engine stop when dew-point is reached" VALUE 0x8053F2B9 RB_Val_Wu8 25.50 t_q0p1 0.00 25.50 FORMAT "%5.2" /end CHARACTERISTIC
/begin CHARACTERISTIC TDLLKORRE "Switch on delay for LAMKORRLL" VALUE 0x805434EA RB_Val_Wu16 1310.700 t_q0p02 0.00 1310.700 FORMAT "%8.3" /end CHARACTERISTIC
/begin CHARACTERISTIC TFLAKORM "delay time for set bit of the lamda correction at idle" VALUE 0x805434EC RB_Val_Wu16 1310.700 t_q0p02 0.00 1310.700 FORMAT "%8.3" /end CHARACTERISTIC
/begin CHARACTERISTIC TILIMAUSG "Threshold min. injection time for injection time increase requests" VALUE 0x805433E6 RB_Val_Wu16 65.53500 t_q0p001_ms 0.00 65.53500 FORMAT "%8.5" /end CHARACTERISTIC
/begin CHARACTERISTIC TIMNLAMKOR "Lower threshold of injection time for Lambda correction actice" VALUE 0x805434EE RB_Val_Wu16 65.53500 t_q0p001_ms 0.00 65.53500 FORMAT "%8.5" /end CHARACTERISTIC
/begin CHARACTERISTIC TLAMKERFIL "time constant for lowpass-filtering of the lambda correction at idle" VALUE 0x805434F0 RB_Val_Wu16 1310.6999997 zk20msxs_uw_b1310p72 0.0200003 1310.7200000 FORMAT "%12.7" EXTENDED_LIMITS 0.020000305180 1310.7200000 /end CHARACTERISTIC
/begin CHARACTERISTIC TLAMKHPFIL "time constant for DT1-filtering of the lambda correction at idle" VALUE 0x805434F2 RB_Val_Wu16 1310.6999997 zk20msxs_uw_b1310p72 0.0200003 1310.7200000 FORMAT "%12.7" EXTENDED_LIMITS 0.020000305180 1310.7200000 /end CHARACTERISTIC
/begin CHARACTERISTIC TLAMKLRFIL "time constant for prefiltering of the reaction of idle control of the correction of lambda at idle" VALUE 0x805434F4 RB_Val_Wu16 1310.6999997 zk20msxs_uw_b1310p72 0.0200003 1310.7200000 FORMAT "%12.7" EXTENDED_LIMITS 0.020000305180 1310.7200000 /end CHARACTERISTIC
/begin CHARACTERISTIC TLEANLKORL "basis time for correction of lambda poor at idle" VALUE 0x805434F6 RB_Val_Wu16 1310.700 t_q0p02 0.00 1310.700 FORMAT "%8.3" /end CHARACTERISTIC
/begin CHARACTERISTIC TLRNOAUSG "Debounce time for the detection of the end of evaporation from oil, when mixture control operation remains small" VALUE 0x805433E8 RB_Val_Wu16 1310.700 t_q0p02 0.00 1310.700 FORMAT "%8.3" /end CHARACTERISTIC
/begin CHARACTERISTIC TMINOELMX "Max. engine temperature for fuel input into oil" VALUE 0x805433EA RB_Val_Wu8 191.3 temp_ub_q0p75_o48 -48.0 143.3 FORMAT "%5.1" /end CHARACTERISTIC
/begin CHARACTERISTIC TMKAUGFIL "The time constant for the evaporated fuel (from engine oil) mass flowrate mixing after engine start" VALUE 0x805433EC RB_Val_Wu16 6553.500 t100msxs_uw_b6553p5 0.00 6553.500 FORMAT "%8.3" /end CHARACTERISTIC
/begin CHARACTERISTIC TMLLRORRE "engine temperature threshold for lambdas correction at idle" VALUE 0x805434F8 RB_Val_Wu8 191.3 temp_ub_q0p75_o48 -48.0 143.3 FORMAT "%5.1" /end CHARACTERISTIC
/begin CHARACTERISTIC TMSKROABR "Time constant for ramp-off of after abort of ramp-on functionality" VALUE 0x805433EE RB_Val_Wu16 1310.700 t_q0p02 0.00 1310.700 FORMAT "%8.3" /end CHARACTERISTIC
/begin CHARACTERISTIC TMXMIBG "Maximum temperature for torque limitation" VALUE 0x80542CA2 RB_Val_Wu8 191.3 temp_ub_q0p75_o48 -48.0 143.3 FORMAT "%5.1" /end CHARACTERISTIC
/begin CHARACTERISTIC TNGAT "Time constant for torque limitation by exhaust temperature" VALUE 0x80542CA4 RB_Val_Wu16 6553.4999985 zk100msxs_uw_b6553p6 0.1000015 6553.6000000 FORMAT "%12.7" EXTENDED_LIMITS 0.10000152590 6553.6000000 /end CHARACTERISTIC
/begin CHARACTERISTIC TNSTLAKOLL "Switch on delay for LAMKORRLL after engine start" VALUE 0x805434FA RB_Val_Wu16 655.3500 t_q0p01 0.00 655.3500 FORMAT "%8.4" /end CHARACTERISTIC
/begin CHARACTERISTIC TOSPAUSGKR "Oil temperature min. threshold for critical fuel evaporation from oil (enable ramp-on functionality)" VALUE 0x805433F0 RB_Val_Wu8 191.3 temp_ub_q0p75_o48 -48.0 143.3 FORMAT "%5.1" /end CHARACTERISTIC
/begin CHARACTERISTIC TOSPMNAUSG "Oil Temperature threshold for ""mskausev_w"" increase" VALUE 0x805433F1 RB_Val_Wu8 191.3 temp_ub_q0p75_o48 -48.0 143.3 FORMAT "%5.1" /end CHARACTERISTIC
/begin CHARACTERISTIC TRICHLKORL "Basis time for correction phase of lambda at idle" VALUE 0x805434FC RB_Val_Wu16 1310.700 t_q0p02 0.00 1310.700 FORMAT "%8.3" /end CHARACTERISTIC
/begin CHARACTERISTIC TROAUSG "Time constant for imcrementation of max. limitation of fuel evaporation trough max. gradient limitation during ramp-off functionality" VALUE 0x805433F2 RB_Val_Wu8 51.00 t_q0p2 0.00 51.00 FORMAT "%5.2" /end CHARACTERISTIC
/begin CHARACTERISTIC TRONAUSG "Time constant for imcrementation of min. evaporation mass flow of fuel evaporation during ramp-on functionality" VALUE 0x805433F3 RB_Val_Wu8 5.100 t_q0p02 0.00 5.100 FORMAT "%5.3" /end CHARACTERISTIC
/begin CHARACTERISTIC TVGAT "Delay time for torque limitation by exhaust temperature" VALUE 0x80542CA6 RB_Val_Wu8 25.50 t_q0p1 0.00 25.50 FORMAT "%5.2" /end CHARACTERISTIC
/begin CHARACTERISTIC TVGATUP "Turn on delay time for torque limitation by exhaust temperature" VALUE 0x80542CA7 RB_Val_Wu8 25.50 t_q0p1 0.00 25.50 FORMAT "%5.2" /end CHARACTERISTIC
/begin CHARACTERISTIC TWLRAUSG "Debounce time for the evaporation adaptation after activation of the lambda control" VALUE 0x805433F4 RB_Val_Wu8 5.100 t_q0p02 0.00 5.100 FORMAT "%5.3" /end CHARACTERISTIC
/begin CHARACTERISTIC TWMRAUSG "Time delay after request for increase of torque reserve due to evaporation" VALUE 0x805433F6 RB_Val_Wu16 1310.700 t_q0p02 0.00 1310.700 FORMAT "%8.3" /end CHARACTERISTIC
/begin CHARACTERISTIC TWMRAUSOFF "Time delay after request cancellation for increase of torque reserve due to evaporation" VALUE 0x805433F8 RB_Val_Wu16 1310.700 t_q0p02 0.00 1310.700 FORMAT "%8.3" /end CHARACTERISTIC
/begin CHARACTERISTIC TWTIMNAUSG "Time delay for for injection time increase requests" VALUE 0x805433FA RB_Val_Wu8 5.100 t_q0p02 0.00 5.100 FORMAT "%5.3" /end CHARACTERISTIC
/begin CHARACTERISTIC UMSRLNAGMN "Minimum value from umsrln_w for the relative fuel evaporation (from engine oil)" VALUE 0x805433FC RB_Val_Wu16 32.76750 m_q0p0005 0.00 32.76750 FORMAT "%8.5" /end CHARACTERISTIC
/begin CHARACTERISTIC VFZGLKORRE "Switch off threshold vehicle speed for LAMKORRLL" VALUE 0x805434FE RB_Val_Wu16 511.9922 vfzg_uw_b512 0.00 511.9922 FORMAT "%8.4" /end CHARACTERISTIC
/begin MEASUREMENT agrvpmx_w "max. EGR-valve position in case of two EGR-valves" SWORD rel_sw_b100 1 100 0.00 99.99695 FORMAT "%8.5" ECU_ADDRESS 0x600071F0 /end MEASUREMENT
/begin MEASUREMENT ausgadap "Number of significant adaptation-periods for fuel evaporation from oil" UBYTE dez 1 100 0.00 255.0 FORMAT "%5.1" ECU_ADDRESS 0x6000B1C6 /end MEASUREMENT
/begin MEASUREMENT B_abor_msg "high amount of fuel in oil" UBYTE B_TRUE 1 100 0.00 1.00000000000 BIT_MASK 0x1 FORMAT "%13.11" ECU_ADDRESS 0x6000EEB6 /end MEASUREMENT
/begin MEASUREMENT B_ausadact_msg "Condtion: adaptation of evaporation from oil is active" UBYTE B_TRUE 1 100 0.00 1.00000000000 BIT_MASK 0x1 FORMAT "%13.11" ECU_ADDRESS 0x6000F285 /end MEASUREMENT
/begin MEASUREMENT B_ausgadap "Condition: evaporation from oil has been sufficiently learned" UBYTE B_TRUE 1 100 0.00 1.00000000000 BIT_MASK 0x1 FORMAT "%13.11" ECU_ADDRESS 0x600390C6 /end MEASUREMENT
/begin MEASUREMENT B_ausgakt_msg "Condition function %BGAUSG is active" UBYTE B_TRUE 1 100 0.00 1.00000000000 BIT_MASK 0x1 FORMAT "%13.11" ECU_ADDRESS 0x6000F284 /end MEASUREMENT
/begin MEASUREMENT B_ausgend_msg "Condition: End of evaporation from oil detected" UBYTE B_TRUE 1 100 0.00 1.00000000000 BIT_MASK 0x1 FORMAT "%13.11" ECU_ADDRESS 0x6000F283 /end MEASUREMENT
/begin MEASUREMENT B_ausgkrit_msg "Condition fuel evaporation from oil has reached a critical level" UBYTE B_TRUE 1 100 0.00 1.00000000000 BIT_MASK 0x1 FORMAT "%13.11" ECU_ADDRESS 0x6000F282 /end MEASUREMENT
/begin MEASUREMENT B_ausgti1 "Condition for activation of measure to maximize ti 1" UBYTE B_TRUE 1 100 0.00 1.00000000000 BIT_MASK 0x1 FORMAT "%13.11" ECU_ADDRESS 0x6000B1C5 /end MEASUREMENT
/begin MEASUREMENT B_ausgti2 "Condition for activation of measure to maximize ti 2" UBYTE B_TRUE 1 100 0.00 1.00000000000 BIT_MASK 0x1 FORMAT "%13.11" ECU_ADDRESS 0x6000B1C4 /end MEASUREMENT
/begin MEASUREMENT B_ausgti3 "Condition for activation of measure to maximize ti 3" UBYTE B_TRUE 1 100 0.00 1.00000000000 BIT_MASK 0x1 FORMAT "%13.11" ECU_ADDRESS 0x6000B1C3 /end MEASUREMENT
/begin MEASUREMENT B_cwsteng0 "evaluation of Bit0 of codeword CWSTENGKH" UBYTE B_TRUE 1 100 0.00 1.00000000000 BIT_MASK 0x1 FORMAT "%13.11" ECU_ADDRESS 0x700002DB /end MEASUREMENT
/begin MEASUREMENT B_cwsteng1 "evaluation of Bit1 of codeword CWSTENGKH" UBYTE B_TRUE 1 100 0.00 1.00000000000 BIT_MASK 0x1 FORMAT "%13.11" ECU_ADDRESS 0x700002DA /end MEASUREMENT
/begin MEASUREMENT B_cwsteng3 "evaluation of Bit3 of codeword CWSTENGKH" UBYTE B_TRUE 1 100 0.00 1.00000000000 BIT_MASK 0x1 FORMAT "%13.11" ECU_ADDRESS 0x700002D9 /end MEASUREMENT
/begin MEASUREMENT B_cwsteng4 "evaluation of Bit4 of codeword CWSTENGKH" UBYTE B_TRUE 1 100 0.00 1.00000000000 BIT_MASK 0x1 FORMAT "%13.11" ECU_ADDRESS 0x700002D8 /end MEASUREMENT
/begin MEASUREMENT B_cwsteng6 "evaluation of Bit6 of codeword CWSTENGKH" UBYTE B_TRUE 1 100 0.00 1.00000000000 BIT_MASK 0x1 FORMAT "%13.11" ECU_ADDRESS 0x700002D7 /end MEASUREMENT
/begin MEASUREMENT B_cwsteng7 "evaluation of Bi7 of codeword CWSTENGKH" UBYTE B_TRUE 1 100 0.00 1.00000000000 BIT_MASK 0x1 FORMAT "%13.11" ECU_ADDRESS 0x700002D6 /end MEASUREMENT
/begin MEASUREMENT B_cwsteng8 "reset of condition of a request for a prohibition of an engine stop (B_nostopkh) if the catalist heating is finished or the minimal temperature of the catalysts are exceeded." UBYTE B_TRUE 1 100 0.00 1.00000000000 BIT_MASK 0x1 FORMAT "%13.11" ECU_ADDRESS 0x700002D5 /end MEASUREMENT
/begin MEASUREMENT B_cwsteng9 "Selection bit for motor start temperatur CEngDst_tStrt or CHdT_tStart" UBYTE B_TRUE 1 100 0.00 1.00000000000 BIT_MASK 0x1 FORMAT "%13.11" ECU_ADDRESS 0x700002D4 /end MEASUREMENT
/begin MEASUREMENT B_dbgoele "Condition error excessive fuel amount in oil" UBYTE B_TRUE 1 100 0.00 1.00000000000 BIT_MASK 0x1 FORMAT "%13.11" ECU_ADDRESS 0x60036DD2 /end MEASUREMENT
/begin MEASUREMENT B_dirst_msg "condition direct start" UBYTE B_TRUE 1 100 0.00 1.00000000000 BIT_MASK 0x1 FORMAT "%13.11" ECU_ADDRESS 0x70000C11 /end MEASUREMENT
/begin MEASUREMENT B_engrest_msg "EngReStrt- task was called" UBYTE B_TRUE 1 100 0.00 1.00000000000 BIT_MASK 0x1 FORMAT "%13.11" ECU_ADDRESS 0x70000BEC /end MEASUREMENT
/begin MEASUREMENT B_evaproff "Condition Fuel evaporation adaptation ramp-off functionality is active" UBYTE B_TRUE 1 100 0.00 1.00000000000 BIT_MASK 0x1 FORMAT "%13.11" ECU_ADDRESS 0x6000F266 /end MEASUREMENT
/begin MEASUREMENT B_evapron "Condition Fuel evaporation adaptation ramp-on functionality is active" UBYTE B_TRUE 1 100 0.00 1.00000000000 BIT_MASK 0x1 FORMAT "%13.11" ECU_ADDRESS 0x6000B1C2 /end MEASUREMENT
/begin MEASUREMENT B_lakoriaf "Condition Lambda Correction active (DT1 filtered signal in window" UBYTE B_TRUE 1 100 0.00 1.00000000000 BIT_MASK 0x1 FORMAT "%13.11" ECU_ADDRESS 0x600000EA /end MEASUREMENT
/begin MEASUREMENT B_lamkora_msg "Condition lambda correction active during idle" UBYTE B_TRUE 1 100 0.00 1.00000000000 BIT_MASK 0x1 FORMAT "%13.11" ECU_ADDRESS 0x60000208 /end MEASUREMENT
/begin MEASUREMENT B_lamkoren_msg "condition lambda correction a idle" UBYTE B_TRUE 1 100 0.00 1.00000000000 BIT_MASK 0x1 FORMAT "%13.11" ECU_ADDRESS 0x60000207 /end MEASUREMENT
/begin MEASUREMENT B_lrnoausg "Condtion no evaporation from oil compensation need detected by mixture control" UBYTE B_TRUE 1 100 0.00 1.00000000000 BIT_MASK 0x1 FORMAT "%13.11" ECU_ADDRESS 0x6000B1C1 /end MEASUREMENT
/begin MEASUREMENT B_mx1oelub_msg "First maximal level of fuel in oil reached" UBYTE B_TRUE 1 100 0.00 1.00000000000 BIT_MASK 0x1 FORMAT "%13.11" ECU_ADDRESS 0x60036E16 /end MEASUREMENT
/begin MEASUREMENT B_mx2oelub_msg "Second maximal level of fuel in oil reached" UBYTE B_TRUE 1 100 0.00 1.00000000000 BIT_MASK 0x1 FORMAT "%13.11" ECU_ADDRESS 0x70000B60 /end MEASUREMENT
/begin MEASUREMENT B_nllerhti_msg "Condition: request for idle engine rpm increase due to short injection time" UBYTE B_TRUE 1 100 0.00 1.00000000000 BIT_MASK 0x1 FORMAT "%13.11" ECU_ADDRESS 0x6000F234 /end MEASUREMENT
/begin MEASUREMENT B_nostacom_msg "Condition change of mind without starter assist" UBYTE B_TRUE 1 100 0.00 1.00000000000 BIT_MASK 0x1 FORMAT "%13.11" ECU_ADDRESS 0x70000B57 /end MEASUREMENT
/begin MEASUREMENT B_nsengtmx_msg "no release engine stop in due of to great exhaust temperatures" UBYTE B_TRUE 1 100 0.00 1.00000000000 BIT_MASK 0x1 FORMAT "%13.11" ECU_ADDRESS 0x70000B51 /end MEASUREMENT
/begin MEASUREMENT B_prmaxti_msg "Condition: request for rail pressure decrease due to short injection time" UBYTE B_TRUE 1 100 0.00 1.00000000000 BIT_MASK 0x1 FORMAT "%13.11" ECU_ADDRESS 0x6000F22F /end MEASUREMENT
/begin MEASUREMENT B_rampakt "Mixture ramp lambda corection in the idling activ" UBYTE B_TRUE 1 100 0.00 1.00000000000 BIT_MASK 0x1 FORMAT "%13.11" ECU_ADDRESS 0x600000E9 /end MEASUREMENT
/begin MEASUREMENT B_richanr "Condition enrichment with Lambda correction at idle" UBYTE B_TRUE 1 100 0.00 1.00000000000 BIT_MASK 0x1 FORMAT "%13.11" ECU_ADDRESS 0x600000E8 /end MEASUREMENT
/begin MEASUREMENT B_ronabr "Condition: fuel evaporation from oil ramp-on functionality abort" UBYTE B_TRUE 1 100 0.00 1.00000000000 BIT_MASK 0x1 FORMAT "%13.11" ECU_ADDRESS 0x6000B1C0 /end MEASUREMENT
/begin MEASUREMENT B_ronoff "Condition: fuel evaporation from oil ramp-off of ramp-on functionality active" UBYTE B_TRUE 1 100 0.00 1.00000000000 BIT_MASK 0x1 FORMAT "%13.11" ECU_ADDRESS 0x6000B1BF /end MEASUREMENT
/begin MEASUREMENT B_stainjen_msg "Condition enable start injection" UBYTE B_TRUE 1 100 0.00 1.00000000000 BIT_MASK 0x1 FORMAT "%13.11" ECU_ADDRESS 0x70000B2C /end MEASUREMENT
/begin MEASUREMENT B_stendes_msg "Condition: end of start also for injection" UBYTE B_TRUE 1 100 0.00 1.00000000000 BIT_MASK 0x1 FORMAT "%13.11" ECU_ADDRESS 0x7000363A /end MEASUREMENT
/begin MEASUREMENT B_stendll_msg "condition end of start for release of engine speed control" UBYTE B_TRUE 1 100 0.00 1.00000000000 BIT_MASK 0x1 FORMAT "%13.11" ECU_ADDRESS 0x70003639 /end MEASUREMENT
/begin MEASUREMENT B_stendmd_msg "Condition end of start for activation of md structure" UBYTE B_TRUE 1 100 0.00 1.00000000000 BIT_MASK 0x1 FORMAT "%13.11" ECU_ADDRESS 0x70003638 /end MEASUREMENT
/begin MEASUREMENT B_stendzw_msg "condition end of start for ignition release" UBYTE B_TRUE 1 100 0.00 1.00000000000 BIT_MASK 0x1 FORMAT "%13.11" ECU_ADDRESS 0x70003637 /end MEASUREMENT
/begin MEASUREMENT B_stengtmn_msg "enable engine stop when a minimum temperature inside exhaust system is exceeded" UBYTE B_TRUE 1 100 0.00 1.00000000000 BIT_MASK 0x1 FORMAT "%13.11" ECU_ADDRESS 0x70000B26 /end MEASUREMENT
/begin MEASUREMENT B_sthdrb_msg "Environment conditions for start with high fuel pressure" UBYTE B_TRUE 1 100 0.00 1.00000000000 BIT_MASK 0x1 FORMAT "%13.11" ECU_ADDRESS 0x70000B25 /end MEASUREMENT
/begin MEASUREMENT B_stoevab_msg "Condition injection cutoff for stop request" UBYTE B_TRUE 1 100 0.00 1.00000000000 BIT_MASK 0x1 FORMAT "%13.11" ECU_ADDRESS 0x70000B24 /end MEASUREMENT
/begin MEASUREMENT B_stopeng_msg "Condition engine in stop phase" UBYTE B_TRUE 1 100 0.00 1.00000000000 BIT_MASK 0x1 FORMAT "%13.11" ECU_ADDRESS 0x70000B23 /end MEASUREMENT
/begin MEASUREMENT B_stopping_msg "Condition engine stopping" UBYTE B_TRUE 1 100 0.00 1.00000000000 BIT_MASK 0x1 FORMAT "%13.11" ECU_ADDRESS 0x70000B22 /end MEASUREMENT
/begin MEASUREMENT B_stopz_msg "condition first stop phase in cycle initiated" UBYTE B_TRUE 1 100 0.00 1.00000000000 BIT_MASK 0x1 FORMAT "%13.11" ECU_ADDRESS 0x70000B21 /end MEASUREMENT
/begin MEASUREMENT B_stostcom_msg "Condition start order during engine runout" UBYTE B_TRUE 1 100 0.00 1.00000000000 BIT_MASK 0x1 FORMAT "%13.11" ECU_ADDRESS 0x70000B20 /end MEASUREMENT
/begin MEASUREMENT B_stprep_msg "condition start preparation" UBYTE B_TRUE 1 100 0.00 1.00000000000 BIT_MASK 0x1 FORMAT "%13.11" ECU_ADDRESS 0x70000B1F /end MEASUREMENT
/begin MEASUREMENT B_strtena_msg "condition start enable" UBYTE B_TRUE 1 100 0.00 1.00000000000 BIT_MASK 0x1 FORMAT "%13.11" ECU_ADDRESS 0x70000B1E /end MEASUREMENT
/begin MEASUREMENT CatH_B_ensengblTONV_I.outbit "time delay for release of engine stop when operational readiness of oxygen sensors is reached / return value" UBYTE B_TRUE 1 100 0.00 1.00000000000 BIT_MASK 0x1 FORMAT "%13.11" ECU_ADDRESS 0x600071E0 /end MEASUREMENT
/begin MEASUREMENT CatH_B_ensengblTONV_I.time "time delay for release of engine stop when operational readiness of oxygen sensors is reached / expired delay time" UBYTE t_q0p1 1 100 0.00 25.50 FORMAT "%5.2" ECU_ADDRESS 0x600071E1 /end MEASUREMENT
/begin MEASUREMENT CatH_B_ensengtpTONV_I.outbit "time delay for release of engine stop when dew-point is reached / return value" UBYTE B_TRUE 1 100 0.00 1.00000000000 BIT_MASK 0x1 FORMAT "%13.11" ECU_ADDRESS 0x600071DE /end MEASUREMENT
/begin MEASUREMENT CatH_B_ensengtpTONV_I.time "time delay for release of engine stop when dew-point is reached / expired delay time" UBYTE t_q0p1 1 100 0.00 25.50 FORMAT "%5.2" ECU_ADDRESS 0x600071DF /end MEASUREMENT
/begin MEASUREMENT dflaanr_w "delta maximum enrichment of lamba at idle" UWORD fak_uw_b2 1 100 0.00 1.999969 FORMAT "%8.6" ECU_ADDRESS 0x60000F98 /end MEASUREMENT
/begin MEASUREMENT dmllrdt1_w "DT1-filtered reaction idle control after enrichment of lamda" SWORD rel_sw_b100 1 100 -100.0000 99.9969 FORMAT "%8.4" ECU_ADDRESS 0x60000F96 /end MEASUREMENT
/begin MEASUREMENT dmllrgf_w "lowpass filtered reaction of idle control after enrichment correction of lambda" SWORD rel_sw_b100 1 100 -100.0000 99.9969 FORMAT "%8.4" ECU_ADDRESS 0x60000F94 /end MEASUREMENT
/begin MEASUREMENT dmllrg_w "intervention of idle control inclusiv the adaption of torque loss." SWORD rel_sw_b100 1 100 -100.0000 99.9969 FORMAT "%8.4" ECU_ADDRESS 0x60000F92 /end MEASUREMENT
/begin MEASUREMENT EngPrt_dPwrExhGasOvht "Ramp slopes for power limitation at exhaust gas overheating" SWORD Pwr_10kW_Sec 1 100 0.00 3276.700 FORMAT "%8.3" ECU_ADDRESS 0x6000058E /end MEASUREMENT
/begin MEASUREMENT EngPrt_facTrqLimnHiEngT "Control factor of torque limitation due to engine temperature" UBYTE fak_ub_b2 1 100 0.00 1.992188 FORMAT "%8.6" ECU_ADDRESS 0x6000EFA8 /end MEASUREMENT
/begin MEASUREMENT EngPrt_facTrqUnLimHiEngT_MP "Unlimited control factor of torque limitation due to engine temperature" UBYTE fak_ub_b2 1 100 0.00 1.992188 FORMAT "%8.6" ECU_ADDRESS 0x7000A2BD /end MEASUREMENT
/begin MEASUREMENT EngPrt_flgLimHiExhGasTemp "Debounced Knock control safety ignition retarding" UBYTE B_TRUE 1 100 0.00 1.00000000000 BIT_MASK 0x1 FORMAT "%13.11" ECU_ADDRESS 0x6000B1D1 /end MEASUREMENT
/begin MEASUREMENT EngPrt_flgtrqLimEngLoTempActvn_MP "Release condition for limiting the torque during engine low temperature" UBYTE B_TRUE 1 100 0.00 1.00000000000 BIT_MASK 0x1 FORMAT "%13.11" ECU_ADDRESS 0x7000A2BC /end MEASUREMENT
/begin MEASUREMENT EngPrt_pwrExhGasOvhtLim "Power limitation in case of exhaust gas overheating" SLONG Pwr_kW 1 100 0.00 21474836.4700 FORMAT "%13.4" ECU_ADDRESS 0x70005140 /end MEASUREMENT
/begin MEASUREMENT EngPrt_pwrExhGasOvhtTar "Target value for power limitation at exhaust gas overheating" SLONG Pwr_kW 1 100 0.00 21474836.4700 FORMAT "%13.4" ECU_ADDRESS 0x70005220 /end MEASUREMENT
/begin MEASUREMENT EngPrt_pwrIntMax_MP "Target value for power limitation" SLONG Pwr_kW 1 100 -21474836.4800 21474836.4700 FORMAT "%13.4" ECU_ADDRESS 0x7000A2C0 /end MEASUREMENT
/begin MEASUREMENT EngPrt_pwrLimEgr "Power limitation in case of open clamping EGR-valve" SLONG Pwr_kW 1 100 0.00 21474836.4700 FORMAT "%13.4" ECU_ADDRESS 0x600125E8 /end MEASUREMENT
/begin MEASUREMENT EngPrt_pwrLimEgrFailrTar "Target value for power limitation at EGR error" SLONG Pwr_kW 1 100 0.00 21474836.4700 FORMAT "%13.4" ECU_ADDRESS 0x70005224 /end MEASUREMENT
/begin MEASUREMENT EngPrt_pwrLimOvht "Power limitation due to high temperatures" SLONG Pwr_kW 1 100 0.00 21474836.4700 FORMAT "%13.4" ECU_ADDRESS 0x70005144 /end MEASUREMENT
/begin MEASUREMENT EngPrt_PwrRampExhGasOvht_I.RampMem "Power ramp depending exhaust gas / Power ramp" SLONG Pwr_kW 1 100 -21474836.4800 21474836.4700 FORMAT "%13.4" ECU_ADDRESS 0x600125E0 /end MEASUREMENT
/begin MEASUREMENT EngPrt_PwrRampLimEgr_I.RampMem "Power ramp depending on EGR Limitation / Power ramp" SLONG Pwr_kW 1 100 -21474836.4800 21474836.4700 FORMAT "%13.4" ECU_ADDRESS 0x600125E4 /end MEASUREMENT
/begin MEASUREMENT EngPrt_tManifMod_MP "Temperature difference to threshold in manifold" SWORD TempDiff_Kelv 1 100 -3276.800 3276.700 FORMAT "%8.3" ECU_ADDRESS 0x7000A2BE /end MEASUREMENT
/begin MEASUREMENT EngPrt_tmotmdb "Temperature selected for torque limitation during high engine temperature" UBYTE temp_ub_q0p75_o48 1 100 -48.0 143.3 FORMAT "%5.1" ECU_ADDRESS 0x6000B1D0 /end MEASUREMENT
/begin MEASUREMENT EngPrt_trqLim "Limitation torque for engine mechanic protection by torque limitation (as inner engine torque)" SWORD Trq 1 100 0.00 3276.700 FORMAT "%8.3" ECU_ADDRESS 0x6000917A /end MEASUREMENT
/begin MEASUREMENT EngPrt_trqLimEngTemp "Torque limitation due to increased engine temperature" SWORD Trq 1 100 0.00 3276.700 FORMAT "%8.3" ECU_ADDRESS 0x6000899A /end MEASUREMENT
/begin MEASUREMENT EngPrt_trqLimHiExhGasTemp "Torque limitation by high exhaust gas temperature" SWORD Trq 1 100 0.00 3276.700 FORMAT "%8.3" ECU_ADDRESS 0x60008998 /end MEASUREMENT
/begin MEASUREMENT EngPrt_trqLimHiExhGasTemp_LT.memory "Low-pass filter for torque limitation by high exhaust gas temperature / current lowpass value" SLONG Trq 1 100 0.00 214748364.700 FORMAT "%13.3" ECU_ADDRESS 0x60002BAC /end MEASUREMENT
/begin MEASUREMENT EngPrt_trqLimLead "Resulting limiting torque engine protection lead path" SWORD Trq 1 100 0.00 3276.700 FORMAT "%8.3" ECU_ADDRESS 0x60009178 /end MEASUREMENT
/begin MEASUREMENT EngPrt_trqLimOvhtPrv "Torque limitation due to high temperatures" SWORD Trq 1 100 0.00 3276.700 FORMAT "%8.3" ECU_ADDRESS 0x60009172 /end MEASUREMENT
/begin MEASUREMENT EngReq_facCtlFfv "Control factor of torque limitation for flex-fuel vehicles" UBYTE Fact1 1 100 0.00 1.992 FORMAT "%5.3" ECU_ADDRESS 0x6000B1CF /end MEASUREMENT
/begin MEASUREMENT EngReq_facEthnlCntnt_Loc "ethanol content factor (local)" SWORD fak_sw_b2 1 100 0.00 1.999939 FORMAT "%8.6" ECU_ADDRESS 0x600071EE /end MEASUREMENT
/begin MEASUREMENT EngReq_fethmnmxLoc "Local value of fethmnmx_w" UBYTE fak_ub_b2 1 100 0.00 1.992188 FORMAT "%8.6" ECU_ADDRESS 0x6000B1CE /end MEASUREMENT
/begin MEASUREMENT EngReq_fethstoeLoc "Local value of fethstoe_w" UWORD fak_uw_b2 1 100 0.00 1.999969 FORMAT "%8.6" ECU_ADDRESS 0x600071EC /end MEASUREMENT
/begin MEASUREMENT EngReq_fethstoeLocLRes "Local value of fethstoe_w less resolution" SWORD fak_q3p0518Em5 1 100 0.00 0.9999695 FORMAT "%9.7" ECU_ADDRESS 0x600071EA /end MEASUREMENT
/begin MEASUREMENT EngReq_gangsistLoc "Local value of Tra_numGear" SBYTE dez 1 100 -128.0 127.0 FORMAT "%5.1" ECU_ADDRESS 0x6000B1CD /end MEASUREMENT
/begin MEASUREMENT EngReq_nmotLoc "Local value of Epm_nEng" UBYTE nmot_ub_q40 1 100 0.00 10000. FORMAT "%5.0" ECU_ADDRESS 0x6000B1CC /end MEASUREMENT
/begin MEASUREMENT EngReq_pDifIntkMnfld "Difference of Intake manifold pressure from desired value" SWORD p_sw_q0p078 1 100 -2560.000 2559.922 FORMAT "%8.3" ECU_ADDRESS 0x600071E8 /end MEASUREMENT
/begin MEASUREMENT EngReq_tmotLoc "Local value of EngDa_tEng" UBYTE temp_ub_q0p75_o48 1 100 -48.0 143.3 FORMAT "%5.1" ECU_ADDRESS 0x6000B1CB /end MEASUREMENT
/begin MEASUREMENT EngReq_tnstLoc "Local value of CoEng_tiNormalRed" UWORD t10msxs_uw_b655p35 1 100 0.00 655.3500 FORMAT "%8.4" ECU_ADDRESS 0x600071E6 /end MEASUREMENT
/begin MEASUREMENT EngReq_tqAbsLimnFfv_Loc "torque limitation based on engine speed and ethanol content(local)" SWORD Trq 1 100 -3276.800 3276.700 FORMAT "%8.3" ECU_ADDRESS 0x600071E4 /end MEASUREMENT
/begin MEASUREMENT EngReq_tqDfftlLimnFfv_mp "Dynamical torque limitation for the gradient limition upon the lead path for Flex-Fuel vehicles." SWORD Trq 1 100 -3276.800 3276.700 FORMAT "%8.3" ECU_ADDRESS 0x7000A2BA /end MEASUREMENT
/begin MEASUREMENT EngReq_tqLimnFfv "Torque limitation for specific flex-fuel-spezifische funktionality" SWORD Trq 1 100 -3276.800 3276.700 FORMAT "%8.3" ECU_ADDRESS 0x60009170 /end MEASUREMENT
/begin MEASUREMENT EngReq_trqLim "Torque limitation due to engine requests" SWORD Trq 1 100 0.00 3276.700 FORMAT "%8.3" ECU_ADDRESS 0x6000916E /end MEASUREMENT
/begin MEASUREMENT EngReq_trqLimLead "Torque limitation (Lead-path) dur to engine requests" SWORD Trq 1 100 0.00 3276.700 FORMAT "%8.3" ECU_ADDRESS 0x6000916C /end MEASUREMENT
/begin MEASUREMENT EngStrt_adjValLoc "Local variable for updating the adjustment values of AVS" SWORD OneToOne 1 100 -32768.00 32767.00 FORMAT "%8.2" ECU_ADDRESS 0x600071AA /end MEASUREMENT
/begin MEASUREMENT EngStrt_agCrsCep_mp "measure point crankshaft angle (absolute) CEP 1ms grid" SWORD AngleCrS 1 100 -720.0000 719.9780 FORMAT "%8.4" ECU_ADDRESS 0x7000A2B8 /end MEASUREMENT
/begin MEASUREMENT EngStrt_agToTgtIgnTdcAtCrsStopCep "Crankshaft angle to target TDC at the time of CrS-standstill" SWORD AngleCrS 1 100 -720.0000 719.9780 FORMAT "%8.4" ECU_ADDRESS 0x60009168 /end MEASUREMENT
/begin MEASUREMENT EngStrt_agToTgtITdcCep "running rest angle (CrS) to target TDC" SWORD AngleCrS 1 100 -720.0000 719.9780 FORMAT "%8.4" ECU_ADDRESS 0x6000916A /end MEASUREMENT
/begin MEASUREMENT EngStrt_agToTgtITdcRvsRotCep "Crankshaft angle (rest angle) to target TDC in the transition from forward to backward rotation" SWORD AngleCrS 1 100 -720.0000 719.9780 FORMAT "%8.4" ECU_ADDRESS 0x60000590 /end MEASUREMENT
/begin MEASUREMENT EngStrt_bChgOfMnd "bit change of mind" UBYTE B_TRUE 1 100 0.00 1.00000000000 BIT_MASK 0x1 FORMAT "%13.11" ECU_ADDRESS 0x700009A8 /end MEASUREMENT
/begin MEASUREMENT EngStrt_bFrstStrtEnd "Condition: first end of start in cycle" UBYTE B_TRUE 1 100 0.00 1.00000000000 BIT_MASK 0x1 FORMAT "%13.11" ECU_ADDRESS 0x6000F13E /end MEASUREMENT
/begin MEASUREMENT EngStrt_bRstrtWoStaAsst "Condition change of mind without starter assist" UBYTE B_TRUE 1 100 0.00 1.00000000000 BIT_MASK 0x1 FORMAT "%13.11" ECU_ADDRESS 0x700009A7 /end MEASUREMENT
/begin MEASUREMENT EngStrt_bStrt "condition start" UBYTE B_TRUE 1 100 0.00 1.00000000000 BIT_MASK 0x1 FORMAT "%13.11" ECU_ADDRESS 0x6000F13D /end MEASUREMENT
/begin MEASUREMENT EngStrt_bStrtEnd "end of start reached, combustion engine runs on its own power" UBYTE B_TRUE 1 100 0.00 1.00000000000 BIT_MASK 0x1 FORMAT "%13.11" ECU_ADDRESS 0x6000F13C /end MEASUREMENT
/begin MEASUREMENT EngStrt_cntrInjStrtEnd "injection counter" UBYTE OneToOne 1 100 0.00 255.0 FORMAT "%5.1" ECU_ADDRESS 0x6000095B /end MEASUREMENT
/begin MEASUREMENT EngStrt_cntrRstrtEve "(rolling) counter for restart-events" UBYTE OneToOne 1 100 0.00 255.0 FORMAT "%5.1" ECU_ADDRESS 0x6000F44D /end MEASUREMENT
/begin MEASUREMENT EngStrt_ctrIncEngPosIgnTdc "Copy of the CrS-tooth counter at recognized TDC" UWORD OneToOne 1 100 0.00 65535.00 FORMAT "%8.2" ECU_ADDRESS 0x60000592 /end MEASUREMENT
/begin MEASUREMENT EngStrt_ctrIncEngPosOld "Old value of the CrS-tooth counter" UWORD OneToOne 1 100 0.00 65535.00 FORMAT "%8.2" ECU_ADDRESS 0x600071DC /end MEASUREMENT
/begin MEASUREMENT EngStrt_ctStrtEnd100msDrvEnter "Local Counter for Drive enter in 100ms for EngStrt_StrtEnd" UBYTE OneToOne 1 100 0.00 255.0 FORMAT "%5.1" ECU_ADDRESS 0x600140B3 /end MEASUREMENT
/begin MEASUREMENT EngStrt_ctStrtEnd10msDrvEnter "local counetr for 10ms drive enter in StrtEnd" UBYTE OneToOne 1 100 0.00 255.0 FORMAT "%5.1" ECU_ADDRESS 0x60014128 /end MEASUREMENT
/begin MEASUREMENT EngStrt_ctStrtEndSyncS1DrvEnter "local counetr for SyncS1 drive enter in StrtEnd" UBYTE OneToOne 1 100 0.00 255.0 FORMAT "%5.1" ECU_ADDRESS 0x50000952 /end MEASUREMENT
/begin MEASUREMENT EngStrt_ctVld2Lcy10msDrvEnter "Local counter for 10ms drive enter in EngStrt_Vld2Lcy" UBYTE OneToOne 1 100 0.00 255.0 FORMAT "%5.1" ECU_ADDRESS 0x6000F44C /end MEASUREMENT
/begin MEASUREMENT EngStrt_ctWrmUpCoorDrvEntr "Local variable to store the global drive enter counter(SyC_ctDrvEnter)" UBYTE OneToOne 1 100 0.00 255.0 FORMAT "%5.1" ECU_ADDRESS 0x6000B19D /end MEASUREMENT
/begin MEASUREMENT EngStrt_dnTdcsAbvBlwThdCep "mean engine speed gradient between the TDCs below and above the engine speed threshold" SWORD EngN 1 100 -16384.00 16383.50 FORMAT "%8.2" ECU_ADDRESS 0x600071DA /end MEASUREMENT
/begin MEASUREMENT EngStrt_EomStrt_I.stOperMod "Class instance for interface between the start coordinator and CoEng / Priority-element of the operation mode structure" ULONG OneToOne 1 100 0.00 4294967295.00 FORMAT "%13.2" ECU_ADDRESS 0x60000384 /end MEASUREMENT
/begin MEASUREMENT EngStrt_EomStrt_I.stOperModPrio "Class instance for interface between the start coordinator and CoEng / Stage-element of the operation mode structure" UBYTE OneToOne 1 100 0.00 255.0 FORMAT "%5.1" ECU_ADDRESS 0x60000388 /end MEASUREMENT
/begin MEASUREMENT EngStrt_EomStrt_I.stOperModStg "Class instance for interface between the start coordinator and CoEng / Operation-mode element of the operation mode structure" UWORD OneToOne 1 100 0.00 65535.00 FORMAT "%8.2" ECU_ADDRESS 0x6000038A /end MEASUREMENT
/begin MEASUREMENT EngStrt_EomWrmUp1_I.stOperMod "Class instance for interface between the warm up coordinator and CoEng (first request) / Priority-element of the operation mode structure" ULONG OneToOne 1 100 0.00 4294967295.00 FORMAT "%13.2" ECU_ADDRESS 0x5000020C /end MEASUREMENT
/begin MEASUREMENT EngStrt_EomWrmUp1_I.stOperModPrio "Class instance for interface between the warm up coordinator and CoEng (first request) / Stage-element of the operation mode structure" UBYTE OneToOne 1 100 0.00 255.0 FORMAT "%5.1" ECU_ADDRESS 0x50000210 /end MEASUREMENT
/begin MEASUREMENT EngStrt_EomWrmUp1_I.stOperModStg "Class instance for interface between the warm up coordinator and CoEng (first request) / Operation-mode element of the operation mode structure" UWORD OneToOne 1 100 0.00 65535.00 FORMAT "%8.2" ECU_ADDRESS 0x50000212 /end MEASUREMENT
/begin MEASUREMENT EngStrt_EomWrmUp2_I.stOperMod "Class instance for interface between the warm up coordinator and CoEng (second request) / Priority-element of the operation mode structure" ULONG OneToOne 1 100 0.00 4294967295.00 FORMAT "%13.2" ECU_ADDRESS 0x50000214 /end MEASUREMENT
/begin MEASUREMENT EngStrt_EomWrmUp2_I.stOperModPrio "Class instance for interface between the warm up coordinator and CoEng (second request) / Stage-element of the operation mode structure" UBYTE OneToOne 1 100 0.00 255.0 FORMAT "%5.1" ECU_ADDRESS 0x50000218 /end MEASUREMENT
/begin MEASUREMENT EngStrt_EomWrmUp2_I.stOperModStg "Class instance for interface between the warm up coordinator and CoEng (second request) / Operation-mode element of the operation mode structure" UWORD OneToOne 1 100 0.00 65535.00 FORMAT "%8.2" ECU_ADDRESS 0x5000021A /end MEASUREMENT
/begin MEASUREMENT EngStrt_EomWrmUpAllwd_I.stOperMod "Class instance for interface between the warm up coordinator and CoEng (allowed operating modes) / Priority-element of the operation mode structure" ULONG OneToOne 1 100 0.00 4294967295.00 FORMAT "%13.2" ECU_ADDRESS 0x70003038 /end MEASUREMENT
/begin MEASUREMENT EngStrt_EomWrmUpAllwd_I.stOperModPrio "Class instance for interface between the warm up coordinator and CoEng (allowed operating modes) / Stage-element of the operation mode structure" UBYTE OneToOne 1 100 0.00 255.0 FORMAT "%5.1" ECU_ADDRESS 0x7000303C /end MEASUREMENT
/begin MEASUREMENT EngStrt_EomWrmUpAllwd_I.stOperModStg "Class instance for interface between the warm up coordinator and CoEng (allowed operating modes) / Operation-mode element of the operation mode structure" UWORD OneToOne 1 100 0.00 65535.00 FORMAT "%8.2" ECU_ADDRESS 0x7000303E /end MEASUREMENT
/begin MEASUREMENT EngStrt_facEthCurr "Ethanol content of current stoichiometric correction (ffuel_w) interpolation factor" UWORD fak_uw_b2 1 100 0.00 1.999969 FORMAT "%8.6" ECU_ADDRESS 0x60007198 /end MEASUREMENT
/begin MEASUREMENT EngStrt_facIpolAltiCep "interpolation factor altitude for the air control element control CEP" UBYTE fak_ub_b1 1 100 0.00 0.9961 ECU_ADDRESS 0x6000B1C8 /end MEASUREMENT
/begin MEASUREMENT EngStrt_facRelEvapFuMEngOilLoc "Local Variable for relative evaporated fuel mass of the engine oil" SWORD rel_sw_b1536 1 100 -1536.000 1535.953 FORMAT "%8.3" ECU_ADDRESS 0x600071CC /end MEASUREMENT
/begin MEASUREMENT EngStrt_flgBlwRefPntCep "indication that the rest angle is below the point from which the reference speed is valid" UBYTE B_TRUE 1 100 0.00 1.00000000000 BIT_MASK 0x1 FORMAT "%13.11" ECU_ADDRESS 0x700009A6 /end MEASUREMENT
/begin MEASUREMENT EngStrt_flgCepActv "the CEP function has access to the air actuator" UBYTE B_TRUE 1 100 0.00 1.00000000000 BIT_MASK 0x1 FORMAT "%13.11" ECU_ADDRESS 0x700009A5 /end MEASUREMENT
/begin MEASUREMENT EngStrt_flgCepEnad "operating conditions of CEP are fulfilled (CEP function is enabled)" UBYTE B_TRUE 1 100 0.00 1.00000000000 BIT_MASK 0x1 FORMAT "%13.11" ECU_ADDRESS 0x700009A4 /end MEASUREMENT
/begin MEASUREMENT EngStrt_flgCepIgnTdcRea "signalization, that a TDC was reached" UBYTE B_TRUE 1 100 0.00 1.00000000000 BIT_MASK 0x1 FORMAT "%13.11" ECU_ADDRESS 0x700002D3 /end MEASUREMENT
/begin MEASUREMENT EngStrt_flgCepIgnTdcReaAck "TDC reached in the lower grid (10ms or 20ms) to reset the bit in the 1ms process" UBYTE B_TRUE 1 100 0.00 1.00000000000 BIT_MASK 0x1 FORMAT "%13.11" ECU_ADDRESS 0x700002D2 /end MEASUREMENT
/begin MEASUREMENT EngStrt_flgClear "Flag to check if DSM is enabled" UBYTE B_TRUE 1 100 0.00 1.00000000000 BIT_MASK 0x1 FORMAT "%13.11" ECU_ADDRESS 0x700002CC /end MEASUREMENT
/begin MEASUREMENT EngStrt_flgClrd "Flag to check if DSM is enabled" UBYTE B_TRUE 1 100 0.00 1.00000000000 BIT_MASK 0x1 FORMAT "%13.11" ECU_ADDRESS 0x700002CB /end MEASUREMENT
/begin MEASUREMENT EngStrt_flgComReqd "change of mind was requested (by combustion engine start coordinator)" UBYTE B_TRUE 1 100 0.00 1.00000000000 BIT_MASK 0x1 FORMAT "%13.11" ECU_ADDRESS 0x700009A3 /end MEASUREMENT
/begin MEASUREMENT EngStrt_flgDisblNewSyncActv "Re-synchro prohibition active" UBYTE OneToOne 1 100 0.00 1.000 BIT_MASK 0x1 FORMAT "%5.3" ECU_ADDRESS 0x6000B1B5 /end MEASUREMENT
/begin MEASUREMENT EngStrt_flgDisblNewSyncActvOld "Flag to disable new sync active old" UBYTE OneToOne 1 100 0.00 1.000 BIT_MASK 0x1 FORMAT "%5.3" ECU_ADDRESS 0x6000B1B4 /end MEASUREMENT
/begin MEASUREMENT EngStrt_flgDisblNewSyncLtq "condition disable new synchonization in post drive" UBYTE OneToOne 1 100 0.00 1.000 BIT_MASK 0x1 FORMAT "%5.3" ECU_ADDRESS 0x6000B1B3 /end MEASUREMENT
/begin MEASUREMENT EngStrt_flgDrctStrtEna "Condition direct start enabled" UBYTE B_TRUE 1 100 0.00 1.00000000000 BIT_MASK 0x1 FORMAT "%13.11" ECU_ADDRESS 0x700002CA /end MEASUREMENT
/begin MEASUREMENT EngStrt_flgDrctStrtPhy "Physical condition for direct start fulfilled" UBYTE B_TRUE 1 100 0.00 1.00000000000 BIT_MASK 0x1 FORMAT "%13.11" ECU_ADDRESS 0x700009A2 /end MEASUREMENT
/begin MEASUREMENT EngStrt_flgDrctStrtRels "Release condition for direct start" UBYTE B_TRUE 1 100 0.00 1.00000000000 BIT_MASK 0x1 FORMAT "%13.11" ECU_ADDRESS 0x700009A1 /end MEASUREMENT
/begin MEASUREMENT EngStrt_flgDrctStrtVld "direct start is valid" UBYTE B_TRUE 1 100 0.00 1.00000000000 BIT_MASK 0x1 FORMAT "%13.11" ECU_ADDRESS 0x700002C9 /end MEASUREMENT
/begin MEASUREMENT EngStrt_flgDsmPrmsEnaCep "DSM enabling for CEP" UBYTE B_TRUE 1 100 0.00 1.00000000000 BIT_MASK 0x1 FORMAT "%13.11" ECU_ADDRESS 0x700002D1 /end MEASUREMENT
/begin MEASUREMENT EngStrt_flgDsmPrmsVehVInhb "Flag for DSM to set Vehicle velocity Inhibition" UBYTE B_TRUE 1 100 0.00 1.00000000000 BIT_MASK 0x1 FORMAT "%13.11" ECU_ADDRESS 0x700002CD /end MEASUREMENT
/begin MEASUREMENT EngStrt_flgEngStall "Condition for engine stall" UBYTE B_TRUE 1 100 0.00 1.00000000000 BIT_MASK 0x1 FORMAT "%13.11" ECU_ADDRESS 0x6000B1B2 /end MEASUREMENT
/begin MEASUREMENT EngStrt_flgEngStallg "Condition egine stalling detected" UBYTE B_TRUE 1 100 0.00 1.00000000000 BIT_MASK 0x1 FORMAT "%13.11" ECU_ADDRESS 0x6000F138 /end MEASUREMENT
/begin MEASUREMENT EngStrt_flgEngStopDtctd "detection of engine standstill for CEP" UBYTE B_TRUE 1 100 0.00 1.00000000000 BIT_MASK 0x1 FORMAT "%13.11" ECU_ADDRESS 0x700002D0 /end MEASUREMENT
/begin MEASUREMENT EngStrt_flgEngStopOrd "Flag to save the stop order in one runout" UBYTE B_TRUE 1 100 0.00 1.00000000000 BIT_MASK 0x1 FORMAT "%13.11" ECU_ADDRESS 0x700002CF /end MEASUREMENT
/begin MEASUREMENT EngStrt_flgEngStrtOrd "detection of start order for the start coordination" UBYTE B_TRUE 1 100 0.00 1.00000000000 BIT_MASK 0x1 FORMAT "%13.11" ECU_ADDRESS 0x6000F137 /end MEASUREMENT
/begin MEASUREMENT EngStrt_flgGdiStrtRels "Release condition for all GDI starts" UBYTE B_TRUE 1 100 0.00 1.00000000000 BIT_MASK 0x1 FORMAT "%13.11" ECU_ADDRESS 0x700009A0 /end MEASUREMENT
/begin MEASUREMENT EngStrt_flgHiPStrtPhy "physical conditions for release of high pressure start" UBYTE B_TRUE 1 100 0.00 1.00000000000 BIT_MASK 0x1 FORMAT "%13.11" ECU_ADDRESS 0x7000099F /end MEASUREMENT
/begin MEASUREMENT EngStrt_flgHiPStrtRels "Release condition for all high pressure starts" UBYTE B_TRUE 1 100 0.00 1.00000000000 BIT_MASK 0x1 FORMAT "%13.11" ECU_ADDRESS 0x7000099E /end MEASUREMENT
/begin MEASUREMENT EngStrt_flgHspWrmUpAirLoc "Local Varibale to check for the air charge for warm up with homogeneous split operating mode is fullfilled" UBYTE B_TRUE 1 100 0.00 1.00000000000 BIT_MASK 0x1 FORMAT "%13.11" ECU_ADDRESS 0x6000B19C /end MEASUREMENT
/begin MEASUREMENT EngStrt_flgHspWrmUpAllwdLoc "Local Varibale to check for the warm up with homogeneous split operating mode is allowed" UBYTE B_TRUE 1 100 0.00 1.00000000000 BIT_MASK 0x1 FORMAT "%13.11" ECU_ADDRESS 0x6000B19B /end MEASUREMENT
/begin MEASUREMENT EngStrt_flgHspWrmUpNEngLoc "local variable to check on engine speed for warm up with homogeneous split operating mode is fullfilled" UBYTE B_TRUE 1 100 0.00 1.00000000000 BIT_MASK 0x1 FORMAT "%13.11" ECU_ADDRESS 0x6000B19A /end MEASUREMENT
/begin MEASUREMENT EngStrt_flgHspWrmUpReq "request warm up with homogeneous split operating mode" UBYTE B_TRUE 1 100 0.00 1.00000000000 BIT_MASK 0x1 FORMAT "%13.11" ECU_ADDRESS 0x6000F133 /end MEASUREMENT
/begin MEASUREMENT EngStrt_flgInjProhb "Injection Prohibition during start" UBYTE B_TRUE 1 100 0.00 1.00000000000 BIT_MASK 0x1 FORMAT "%13.11" ECU_ADDRESS 0x7000099D /end MEASUREMENT
/begin MEASUREMENT EngStrt_flgInjSysRels "Release condition injection system (GDI or PFI)" UBYTE B_TRUE 1 100 0.00 1.00000000000 BIT_MASK 0x1 FORMAT "%13.11" ECU_ADDRESS 0x7000099C /end MEASUREMENT
/begin MEASUREMENT EngStrt_flgMFuOilMax "Condition limit of fuel in oil rechead for DFC_MFuOilMax entry" UBYTE B_TRUE 1 100 0.00 1.00000000000 BIT_MASK 0x1 FORMAT "%13.11" ECU_ADDRESS 0x6000B1B9 /end MEASUREMENT
/begin MEASUREMENT EngStrt_flgNEngBlwThdCep "TDC reached and engine speed is below the engine speed threshold (moment of initialisation of the restangle counter)" UBYTE B_TRUE 1 100 0.00 1.00000000000 BIT_MASK 0x1 FORMAT "%13.11" ECU_ADDRESS 0x7000099B /end MEASUREMENT
/begin MEASUREMENT EngStrt_flgNoHiPStrt "High pressure start not possible" UBYTE B_TRUE 1 100 0.00 1.00000000000 BIT_MASK 0x1 FORMAT "%13.11" ECU_ADDRESS 0x700002C8 /end MEASUREMENT
/begin MEASUREMENT EngStrt_flgOilChgDne "Oil change completed (rising edge)" UBYTE B_TRUE 1 100 0.00 1.00000000000 BIT_MASK 0x1 FORMAT "%13.11" ECU_ADDRESS 0x6000B1BA /end MEASUREMENT
/begin MEASUREMENT EngStrt_flgOilChgDneMdl "Condition oil change detected (Model)" UBYTE B_TRUE 1 100 0.00 1.00000000000 BIT_MASK 0x1 FORMAT "%13.11" ECU_ADDRESS 0x6000B1BE /end MEASUREMENT
/begin MEASUREMENT EngStrt_flgOverrun "Condition overrun transition" UBYTE B_TRUE 1 100 0.00 1.00000000000 BIT_MASK 0x1 FORMAT "%13.11" ECU_ADDRESS 0x6000F131 /end MEASUREMENT
/begin MEASUREMENT EngStrt_flgPreInjRels "Release condition for start with preinjection" UBYTE B_TRUE 1 100 0.00 1.00000000000 BIT_MASK 0x1 FORMAT "%13.11" ECU_ADDRESS 0x7000099A /end MEASUREMENT
/begin MEASUREMENT EngStrt_flgRePrio "Start reprioritisation" UBYTE B_TRUE 1 100 0.00 1.00000000000 BIT_MASK 0x1 FORMAT "%13.11" ECU_ADDRESS 0x6000F130 /end MEASUREMENT
/begin MEASUREMENT EngStrt_flgRePrioEngStrtg "repriorisation at engine starting" UBYTE B_TRUE 1 100 0.00 1.00000000000 BIT_MASK 0x1 FORMAT "%13.11" ECU_ADDRESS 0x6000B1B1 /end MEASUREMENT
/begin MEASUREMENT EngStrt_flgReStrtCoMReqd "Restart-Task Change-of-Mind requested (but not yet executed)" UBYTE B_TRUE 1 100 0.00 1.00000000000 BIT_MASK 0x1 FORMAT "%13.11" ECU_ADDRESS 0x70000999 /end MEASUREMENT
/begin MEASUREMENT EngStrt_flgReStrtDly "Bit to delay the EngReStrt-Task in case CoM for GDI engines" UBYTE B_TRUE 1 100 0.00 1.00000000000 BIT_MASK 0x1 FORMAT "%13.11" ECU_ADDRESS 0x70000998 /end MEASUREMENT
/begin MEASUREMENT EngStrt_flgReStrtStpReqd "Restart-Task Stopped Engine requested (but not yet executed)" UBYTE B_TRUE 1 100 0.00 1.00000000000 BIT_MASK 0x1 FORMAT "%13.11" ECU_ADDRESS 0x70000997 /end MEASUREMENT
/begin MEASUREMENT EngStrt_flgReStrtStrtReqd "Restart-Task at Engine Start requested (but not yet executed)" UBYTE B_TRUE 1 100 0.00 1.00000000000 BIT_MASK 0x1 FORMAT "%13.11" ECU_ADDRESS 0x70000996 /end MEASUREMENT
/begin MEASUREMENT EngStrt_flgRvsRotCepDtctd "reverse rotation of crankshaft is detected by CEP" UBYTE B_TRUE 1 100 0.00 1.00000000000 BIT_MASK 0x1 FORMAT "%13.11" ECU_ADDRESS 0x700002CE /end MEASUREMENT
/begin MEASUREMENT EngStrt_flgStrtAbort "Start abort" UBYTE B_TRUE 1 100 0.00 1.00000000000 BIT_MASK 0x1 FORMAT "%13.11" ECU_ADDRESS 0x6000F12E /end MEASUREMENT
/begin MEASUREMENT EngStrt_flgStrtEna "Current start type is active" UBYTE B_TRUE 1 100 0.00 1.00000000000 BIT_MASK 0x1 FORMAT "%13.11" ECU_ADDRESS 0x6000B1B0 /end MEASUREMENT
/begin MEASUREMENT EngStrt_flgStrtEnaCoMRunng "start type ENGSTRT_COMRUNNG is possible" UBYTE B_TRUE 1 100 0.00 1.00000000000 BIT_MASK 0x1 FORMAT "%13.11" ECU_ADDRESS 0x6000B1AF /end MEASUREMENT
/begin MEASUREMENT EngStrt_flgStrtEnaCoMStrtg "start type ENGSTRT_COMSTRTG is possible" UBYTE B_TRUE 1 100 0.00 1.00000000000 BIT_MASK 0x1 FORMAT "%13.11" ECU_ADDRESS 0x6000B1AE /end MEASUREMENT
/begin MEASUREMENT EngStrt_flgStrtEnaCoMWait "start type ENGSTRT_COMWAITSTRTR is possible" UBYTE B_TRUE 1 100 0.00 1.00000000000 BIT_MASK 0x1 FORMAT "%13.11" ECU_ADDRESS 0x6000B1AD /end MEASUREMENT
/begin MEASUREMENT EngStrt_flgStrtEnaHiP "high pressure start types ENGSTRT_HIPxxx are possible" UBYTE B_TRUE 1 100 0.00 1.00000000000 BIT_MASK 0x1 FORMAT "%13.11" ECU_ADDRESS 0x6000B1AC /end MEASUREMENT
/begin MEASUREMENT EngStrt_flgStrtEnaPreInj "start type ENGSTRT_PREINJ is possible" UBYTE B_TRUE 1 100 0.00 1.00000000000 BIT_MASK 0x1 FORMAT "%13.11" ECU_ADDRESS 0x6000B1AB /end MEASUREMENT
/begin MEASUREMENT EngStrt_flgStrtEndIgn "condition end of start for ignition release" UBYTE B_TRUE 1 100 0.00 1.00000000000 BIT_MASK 0x1 FORMAT "%13.11" ECU_ADDRESS 0x7000361D /end MEASUREMENT
/begin MEASUREMENT EngStrt_flgStrtEndInj "End of start for injection" UBYTE B_TRUE 1 100 0.00 1.00000000000 BIT_MASK 0x1 FORMAT "%13.11" ECU_ADDRESS 0x7000361C /end MEASUREMENT
/begin MEASUREMENT EngStrt_flgStrtEndSpdGovr "condition end of start for release of engine speed control" UBYTE B_TRUE 1 100 0.00 1.00000000000 BIT_MASK 0x1 FORMAT "%13.11" ECU_ADDRESS 0x7000361B /end MEASUREMENT
/begin MEASUREMENT EngStrt_flgStrtEndTqStruct "Condition end of start for activation of md structure" UBYTE B_TRUE 1 100 0.00 1.00000000000 BIT_MASK 0x1 FORMAT "%13.11" ECU_ADDRESS 0x7000361A /end MEASUREMENT
/begin MEASUREMENT EngStrt_flgStrtFaild "failed start is detected" UBYTE B_TRUE 1 100 0.00 1.00000000000 BIT_MASK 0x1 FORMAT "%13.11" ECU_ADDRESS 0x6000F12C /end MEASUREMENT
/begin MEASUREMENT EngStrt_flgStrtrStrtRels "Release condition for all starts with the starter" UBYTE B_TRUE 1 100 0.00 1.00000000000 BIT_MASK 0x1 FORMAT "%13.11" ECU_ADDRESS 0x70000994 /end MEASUREMENT
/begin MEASUREMENT EngStrt_flgStrtTmngErly "Flag to Indicate the Condition for early calculation of injection setpoints" UBYTE B_TRUE 1 100 0.00 1.00000000000 BIT_MASK 0x1 FORMAT "%13.11" ECU_ADDRESS 0x70003619 /end MEASUREMENT
/begin MEASUREMENT EngStrt_flgTrigRstrtCom "trigger Restart-Task in case of Change-of-Mind" UBYTE B_TRUE 1 100 0.00 1.00000000000 BIT_MASK 0x1 FORMAT "%13.11" ECU_ADDRESS 0x70000993 /end MEASUREMENT
/begin MEASUREMENT EngStrt_idxClassSeldStrtEnd "selected class for end of start detection" UBYTE ENGSTRT_IDXSTRTEND_SET_COMPU_VERB 1 100 0.00 4.00000000000 FORMAT "%13.11" ECU_ADDRESS 0x6000B19E /end MEASUREMENT
/begin MEASUREMENT EngStrt_idxTarTdcCep "cylinder index of the Cep target cylinder" UBYTE OneToOne 1 100 0.00 255.0 FORMAT "%5.1" ECU_ADDRESS 0x6000F44B /end MEASUREMENT
/begin MEASUREMENT EngStrt_idxTdc "cylinder index of the cylinder which has just reached his TDC" UBYTE OneToOne 1 100 0.00 255.0 FORMAT "%5.1" ECU_ADDRESS 0x600008B7 /end MEASUREMENT
/begin MEASUREMENT EngStrt_mfFuEvapOilSlow "Mass flow of slowy evaporating fuel in oil" UWORD m_q0p2170 1 100 0.00 14222.01 FORMAT "%8.2" ECU_ADDRESS 0x600071B6 /end MEASUREMENT
/begin MEASUREMENT EngStrt_mfFuOilSlow "Mass floe of fuel input into the öl which is slowy or not evaporating" UWORD m_q0p2170 1 100 0.00 14222.01 FORMAT "%8.2" ECU_ADDRESS 0x600071B4 /end MEASUREMENT
/begin MEASUREMENT EngStrt_mFuOilFast "Mass of fuel part in oil which is evaporating fast" UWORD m_q0p032_g 1 100 0.00 2097.120 FORMAT "%8.3" ECU_ADDRESS 0x60039592 /end MEASUREMENT
/begin MEASUREMENT EngStrt_mFuOilSlow "Mass of fuel part in oil which is evaporating slowly" UWORD m_q0p032_g 1 100 0.00 2097.120 FORMAT "%8.3" ECU_ADDRESS 0x600390C4 /end MEASUREMENT
/begin MEASUREMENT EngStrt_mFuOil_msg "total fuel mass in engine oil, new identifier: mid resolution" UWORD m_q0p032_g 1 100 0.00 2097.120 FORMAT "%8.3" ECU_ADDRESS 0x60039590 /end MEASUREMENT
/begin MEASUREMENT EngStrt_nEng "Engine Speed" UBYTE nmot_ub_q40 1 100 0.00 10200. FORMAT "%5.0" ECU_ADDRESS 0x6000B1B8 /end MEASUREMENT
/begin MEASUREMENT EngStrt_nEngActChkdAbvThdCep "engine speed freeze at the TDC above the engine speed threshold" SWORD EngN 1 100 -16384.00 16383.50 FORMAT "%8.2" ECU_ADDRESS 0x600071D8 /end MEASUREMENT
/begin MEASUREMENT EngStrt_nEngActChkdBlwThdCep "engine speed freeze at the TDC below the engine speed threshold" SWORD EngN 1 100 -16384.00 16383.50 FORMAT "%8.2" ECU_ADDRESS 0x600071D6 /end MEASUREMENT
/begin MEASUREMENT EngStrt_nEngActChkdBlwThdCorrdCep "corrected engine speed value for determination of the rest TDCs" SWORD EngN 1 100 -16384.00 16383.50 FORMAT "%8.2" ECU_ADDRESS 0x600071D4 /end MEASUREMENT
/begin MEASUREMENT EngStrt_nEngAtCurrIgnTdcCep "engine speed at the current TDC" SWORD EngN 1 100 -16384.00 16383.50 FORMAT "%8.2" ECU_ADDRESS 0x60000594 /end MEASUREMENT
/begin MEASUREMENT EngStrt_nEngAtPrevIgnTdcCep "engine speed at the previous TDC" SWORD EngN 1 100 -16384.00 16383.50 FORMAT "%8.2" ECU_ADDRESS 0x60000596 /end MEASUREMENT
/begin MEASUREMENT EngStrt_nEngMaxCrit "maximum engine speed for start under critical situation" SWORD EngN 1 100 -16384.00 16383.50 FORMAT "%8.2" ECU_ADDRESS 0x70005290 /end MEASUREMENT
/begin MEASUREMENT EngStrt_nEngNegMaxCep "maximum negative engine speed in backwards rotation using CEP" SWORD EngN 1 100 -16384.00 16383.50 FORMAT "%8.2" ECU_ADDRESS 0x60009166 /end MEASUREMENT
/begin MEASUREMENT EngStrt_nEngThdCep "engine speed threshold for activation of the CEP intervention" SWORD EngN 1 100 -16384.00 16383.50 FORMAT "%8.2" ECU_ADDRESS 0x600071D2 /end MEASUREMENT
/begin MEASUREMENT EngStrt_nRefPntCep "engine speed at referenz point 360 deg CrS before target TDC" SWORD EngN 1 100 -16384.00 16383.50 FORMAT "%8.2" ECU_ADDRESS 0x60009164 /end MEASUREMENT
/begin MEASUREMENT EngStrt_nrRestTdcsCep "number of rest TDCs from engine speed threshold until engine standstill using CEP" UBYTE OneToOne 1 100 0.00 255.0 FORMAT "%5.1" ECU_ADDRESS 0x6000B1C7 /end MEASUREMENT
/begin MEASUREMENT EngStrt_nTdcBlwThdTCorrnCep "correction value of the engine speed for the determination of the rest TDCs concerning temperature" SWORD EngN 1 100 -16384.00 16383.50 FORMAT "%8.2" ECU_ADDRESS 0x600071D0 /end MEASUREMENT
/begin MEASUREMENT EngStrt_ratAgThrVlvDesCep "set point of the throttle valve opening requested from CEP" SWORD Prc 1 100 -400.0000 399.9878 FORMAT "%8.4" ECU_ADDRESS 0x60009162 /end MEASUREMENT
/begin MEASUREMENT EngStrt_ratOilDilAmnt "The estimated dilution ratio to the threshold of specific fault detection suspension" UBYTE OneToOne 1 100 0.00 255.0 FORMAT "%5.1" ECU_ADDRESS 0x6000EFA6 /end MEASUREMENT
/begin MEASUREMENT EngStrt_stEomWrmUpAllwd "allowed operating mode for warm up" UBYTE OneToOne 1 100 0.00 255.0 FORMAT "%5.1" ECU_ADDRESS 0x6000F44A /end MEASUREMENT
/begin MEASUREMENT EngStrt_stEomWrmUpAllwdLoc "local copy of EngStrt_stEomWrmUpAllwd" SWORD OneToOne 1 100 0.00 255.0000 FORMAT "%8.4" ECU_ADDRESS 0x70005374 /end MEASUREMENT
/begin MEASUREMENT EngStrt_stFstStrt "Status for Fast Start" UBYTE OneToOne 1 100 0.00 255.0 FORMAT "%5.1" ECU_ADDRESS 0x6000F449 /end MEASUREMENT
/begin MEASUREMENT EngStrt_stInjRelsStrtg "Status injection release during start" UBYTE OneToOne 1 100 0.00 255.0 FORMAT "%5.1" ECU_ADDRESS 0x6000F448 /end MEASUREMENT
/begin MEASUREMENT EngStrt_stListCoMRunng "Assignment of ENGSTRT_COMRUNNG in the priority lists" UBYTE OneToOne 1 100 0.00 255.0 FORMAT "%5.1" ECU_ADDRESS 0x6000B1AA /end MEASUREMENT
/begin MEASUREMENT EngStrt_stListCoMStrtg "Assignment of ENGSTRT_COMSTRTG in the priority lists" UBYTE OneToOne 1 100 0.00 255.0 FORMAT "%5.1" ECU_ADDRESS 0x6000B1A9 /end MEASUREMENT
/begin MEASUREMENT EngStrt_stListCoMWaitStrtr "Assignment of ENGSTRT_COMWAITSTRTR in the priority lists" UBYTE OneToOne 1 100 0.00 255.0 FORMAT "%5.1" ECU_ADDRESS 0x6000B1A8 /end MEASUREMENT
/begin MEASUREMENT EngStrt_stListEOL "Assignment of ENGSTRT_EOL in the priority lists" UBYTE OneToOne 1 100 0.00 255.0 FORMAT "%5.1" ECU_ADDRESS 0x6000B1A7 /end MEASUREMENT
/begin MEASUREMENT EngStrt_stListFolw "Assignment of ENGSTRT_FOLW in the priority lists" UBYTE OneToOne 1 100 0.00 255.0 FORMAT "%5.1" ECU_ADDRESS 0x6000B1A6 /end MEASUREMENT
/begin MEASUREMENT EngStrt_stListHiPCold "Assignment of ENGSTRT_HIPCOLD in the priority lists" UBYTE OneToOne 1 100 0.00 255.0 FORMAT "%5.1" ECU_ADDRESS 0x6000B1A5 /end MEASUREMENT
/begin MEASUREMENT EngStrt_stListHipEOL "Assignment of ENGSTRT_HIPEOL in the priority lists" UBYTE OneToOne 1 100 0.00 255.0 FORMAT "%5.1" ECU_ADDRESS 0x6000B1A4 /end MEASUREMENT
/begin MEASUREMENT EngStrt_stListHiPMid "Assignment of ENGSTRT_HIPMID in the priority lists" UBYTE OneToOne 1 100 0.00 255.0 FORMAT "%5.1" ECU_ADDRESS 0x6000B1A3 /end MEASUREMENT
/begin MEASUREMENT EngStrt_stListHiPWrm "Assignment of ENGSTRT_HIPWRM in the priority lists" UBYTE OneToOne 1 100 0.00 255.0 FORMAT "%5.1" ECU_ADDRESS 0x6000B1A2 /end MEASUREMENT
/begin MEASUREMENT EngStrt_stListLoP "Assignment of ENGSTRT_LOP in the priority lists" UBYTE OneToOne 1 100 0.00 255.0 FORMAT "%5.1" ECU_ADDRESS 0x6000B1A1 /end MEASUREMENT
/begin MEASUREMENT EngStrt_stListPreInj "Assignment of ENGSTRT_PREINJ in the priority lists" UBYTE OneToOne 1 100 0.00 255.0 FORMAT "%5.1" ECU_ADDRESS 0x6000B1A0 /end MEASUREMENT
/begin MEASUREMENT EngStrt_stListStrtrDrct "Assignment of ENGSTRT_STRTR_DRCT in the priority lists" UBYTE OneToOne 1 100 0.00 255.0 FORMAT "%5.1" ECU_ADDRESS 0x6000B19F /end MEASUREMENT
/begin MEASUREMENT EngStrt_stRstrtRsn "reason for last call of ReStartTask" UBYTE EngStrt_stRstrtRsn_VERB 1 100 0.00 5.00000000000 FORMAT "%13.11" ECU_ADDRESS 0x6000F447 /end MEASUREMENT
/begin MEASUREMENT EngStrt_stRstrtStgy "restart strategy in case of Change of Mind" UBYTE EngStrt_stRstrtStgy_VERB 1 100 0.00 4.00000000000 FORMAT "%13.11" ECU_ADDRESS 0x6000F851 /end MEASUREMENT
/begin MEASUREMENT EngStrt_stStrtAvlAry "Array available start type" UWORD ENGSTRT_STSTRTREQ_SET_COMPU_VERB 1 100 0.00 32770.0000000 FORMAT "%13.7" ARRAY_SIZE 19 ECU_ADDRESS 0x5000551E /end MEASUREMENT
/begin MEASUREMENT EngStrt_stStrtPrio "Priority of the selected start type" UWORD OneToOne 1 100 0.00 65535.00 FORMAT "%8.2" ECU_ADDRESS 0x600071A8 /end MEASUREMENT
/begin MEASUREMENT EngStrt_stStrtReq "Start type from the start coordinator" UWORD ENGSTRT_STSTRTREQ_SET_COMPU_VERB 1 100 0.00 32770.0000000 FORMAT "%13.7" ECU_ADDRESS 0x60013EAC /end MEASUREMENT
/begin MEASUREMENT EngStrt_stStrtReqLoc "Start type from the start coordinator (local variable)" UWORD ENGSTRT_STSTRTREQ_SET_COMPU_VERB 1 100 0.00 32770.0000000 FORMAT "%13.7" ECU_ADDRESS 0x600071A6 /end MEASUREMENT
/begin MEASUREMENT EngStrt_stStrtSit "engine start situation (first start, following start, change of mind...)" UBYTE OneToOne 1 100 0.00 255.0 FORMAT "%5.1" ECU_ADDRESS 0x60014129 /end MEASUREMENT
/begin MEASUREMENT EngStrt_tCoor "Engine temperature for the start coordinator" SWORD Temp_Cels 1 100 -273.140 3003.560 FORMAT "%8.3" ECU_ADDRESS 0x60013EAE /end MEASUREMENT
/begin MEASUREMENT EngStrt_tCorrCep "temperature after choice" SWORD Temp_Cels 1 100 -3549.940 3003.560 FORMAT "%8.3" ECU_ADDRESS 0x600071CE /end MEASUREMENT
/begin MEASUREMENT EngStrt_tEng "Engine temperature" UBYTE temp_ub_q0p75_o48 1 100 -48.0 143.3 FORMAT "%5.1" ECU_ADDRESS 0x60000F90 /end MEASUREMENT
/begin MEASUREMENT EngStrt_tHiPStrtHi "Temperature for upper threshold high pressure start" SWORD Temp_Cels 1 100 -273.140 3003.560 FORMAT "%8.3" ECU_ADDRESS 0x6000719C /end MEASUREMENT
/begin MEASUREMENT EngStrt_tHiPStrtLo "Temperature for lower threshold high pressure start" SWORD Temp_Cels 1 100 -273.140 3003.560 FORMAT "%8.3" ECU_ADDRESS 0x6000719A /end MEASUREMENT
/begin MEASUREMENT EngStrt_tiAftFirstStrtEnd "time counter at first end of start in cycle" UWORD t_q0p1 1 100 0.00 6553.500 FORMAT "%8.3" ECU_ADDRESS 0x60008716 /end MEASUREMENT
/begin MEASUREMENT EngStrt_tiAftStrtEnd "time after end of start" UWORD t_q0p01 1 100 0.00 655.3500 FORMAT "%8.4" ECU_ADDRESS 0x60013EB2 /end MEASUREMENT
/begin MEASUREMENT EngStrt_tiAftStrtEndLowRes "time after end of start" UWORD t_q0p1 1 100 0.00 6553.500 FORMAT "%8.3" ECU_ADDRESS 0x60008714 /end MEASUREMENT
/begin MEASUREMENT EngStrt_tiDisblNewSyncMax "time counter: duration of DisblNewSync" UWORD ti_s_q0p01_COMPU 1 100 0.00 655.3500 FORMAT "%8.4" ECU_ADDRESS 0x600390BE /end MEASUREMENT
/begin MEASUREMENT EngStrt_tiOperAftFirstStrtEnd "time of engine operation from first end of start (over ECU-cycle)" UWORD t_q0p1 1 100 0.00 6553.500 FORMAT "%8.3" ECU_ADDRESS 0x60008712 /end MEASUREMENT
/begin MEASUREMENT EngStrt_tOil "Oil temperature in sump, measured or modelled" UBYTE temp_ub_q0p75_o48 1 100 -48.0 143.3 FORMAT "%5.1" ECU_ADDRESS 0x6000B1B7 /end MEASUREMENT
/begin MEASUREMENT EngStrt_tStopCoor "engine coolant temperature at engine stop" SWORD Temp_Cels 1 100 -273.140 3003.560 FORMAT "%8.3" ECU_ADDRESS 0x60009160 /end MEASUREMENT
/begin MEASUREMENT EngStrt_tStrt "Starting value of downstream engine coolant temperature" UBYTE temp_ub_q0p75_o48 1 100 -48.0 143.3 FORMAT "%5.1" ECU_ADDRESS 0x6000F446 /end MEASUREMENT
/begin MEASUREMENT EngStrt_tStrtCoor "Start temperature for the start coordinator" SWORD Temp_Cels 1 100 -273.140 3003.560 FORMAT "%8.3" ECU_ADDRESS 0x60013EB0 /end MEASUREMENT
/begin MEASUREMENT ExhMgT_flgNoStopEngCatHeatg "condition stop prohibition because of a request from the exhaust system" UBYTE B_TRUE 1 100 0.00 1.00000000000 BIT_MASK 0x1 FORMAT "%13.11" ECU_ADDRESS 0x70000965 /end MEASUREMENT
/begin MEASUREMENT ExhMgT_tStrtStopEng "selected motor temperature for resetting the requirement of an engine stop prohibition" SWORD Temp_Cels 1 100 -3549.940 3003.560 FORMAT "%8.3" ECU_ADDRESS 0x600071E2 /end MEASUREMENT
/begin MEASUREMENT famplanr_w_msg "factor amplitude of enrichment" UWORD fak_q1p5258Em5 1 100 0.00 0.9999847 FORMAT "%9.7" ECU_ADDRESS 0x6000160E /end MEASUREMENT
/begin MEASUREMENT fausgabst "Evaporated fuel multiplicative factor due to engine Stop time" UBYTE fak_ub_b2 1 100 0.00 1.992188 FORMAT "%8.6" ECU_ADDRESS 0x6000B1BD /end MEASUREMENT
/begin MEASUREMENT fausgenred "Reduction factor of the mass fuel in oil after detection of end of evaporation from oil" UBYTE fak_ub_b2 1 100 0.00 1.992188 FORMAT "%8.6" ECU_ADDRESS 0x6000B1BC /end MEASUREMENT
/begin MEASUREMENT fgausg_msg "Ratio between the evaporation from oil and the base fuel mass needed by the motor" UBYTE fak_ub_b2 1 100 0.00 1.992188 FORMAT "%8.6" ECU_ADDRESS 0x6000F2FA /end MEASUREMENT
/begin MEASUREMENT fgausmx_msg "max. proportion of evaporating fuel from the engine oil to the fuel demand (model based)" UBYTE fak_ub_b2 1 100 0.00 1.992188 FORMAT "%8.6" ECU_ADDRESS 0x6000EEF3 /end MEASUREMENT
/begin MEASUREMENT fkausgmx_w "Factor max. fuel evaporation (engine oil) rate (from enveloppe curve)" UWORD rel_q0p00152 1 100 0.00 99.99847 FORMAT "%8.5" ECU_ADDRESS 0x600071B2 /end MEASUREMENT
/begin MEASUREMENT fkausgr_w_msg "Factor fuel evaporation (engine oil) rate" UWORD rel_q0p00152 1 100 0.00 99.99847 FORMAT "%8.5" ECU_ADDRESS 0x60008526 /end MEASUREMENT
/begin MEASUREMENT fkeinoel "Fctor proportion of fuel going into oil instead of exhaust" UBYTE fak_ub_b2 1 100 0.00 1.992188 FORMAT "%8.6" ECU_ADDRESS 0x6000B1B6 /end MEASUREMENT
/begin MEASUREMENT flaanreg_w_msg "factor lambda excitation for lambda correction at idle" UWORD fak_uw_b2 1 100 0.00 1.999969 FORMAT "%8.6" ECU_ADDRESS 0x600015FA /end MEASUREMENT
/begin MEASUREMENT flakormk_w "factor lamda correction at idle with correction" UWORD fak_uw_b2 1 100 0.00 1.999969 FORMAT "%8.6" ECU_ADDRESS 0x600071CA /end MEASUREMENT
/begin MEASUREMENT flakorm_w_msg "factor lamda correction at idle" UWORD fak_uw_b2 1 100 0.00 1.999969 FORMAT "%8.6" ECU_ADDRESS 0x600015F8 /end MEASUREMENT
/begin MEASUREMENT flanrdt1_w "DT1-filtered lambda correction at idle" SWORD fak_sw_b1 1 100 -1.000000 0.999969 FORMAT "%8.6" ECU_ADDRESS 0x60000F8E /end MEASUREMENT
/begin MEASUREMENT fleananr_w "factor poor suggestion" UWORD fak_uw_b2 1 100 0.00 1.999969 FORMAT "%8.6" ECU_ADDRESS 0x60000F8C /end MEASUREMENT
/begin MEASUREMENT fmkioel_w "Ramp-down factor for evaporation offset adaptation" UWORD fak_uw_b2 1 100 0.00 1.999969 FORMAT "%8.6" ECU_ADDRESS 0x600071B0 /end MEASUREMENT
/begin MEASUREMENT frichanr_w "factor enrichment suggestion" UWORD fak_uw_b2 1 100 0.00 1.999969 FORMAT "%8.6" ECU_ADDRESS 0x60000F8A /end MEASUREMENT
/begin MEASUREMENT frtmal "control factor of torque limitation due to engine temperature and falkg" UBYTE fak_ub_b2 1 100 0.00 1.992188 FORMAT "%8.6" ECU_ADDRESS 0x6000B1CA /end MEASUREMENT
/begin MEASUREMENT frtmalps "control factor of torque limitation due to engine temperature, ethanol content and intake manifold pressure" UBYTE fak_ub_b2 1 100 0.00 1.992188 FORMAT "%8.6" ECU_ADDRESS 0x6000B1C9 /end MEASUREMENT
/begin MEASUREMENT FuEvapOil_bGdiPfiActv "BIT to represent GDI PFI activation" UBYTE B_TRUE 1 100 0.00 1.00000000000 BIT_MASK 0x1 FORMAT "%13.11" ECU_ADDRESS 0x6000B1BB /end MEASUREMENT
/begin MEASUREMENT kintauso_w "Fuel evaporation (from engine oil) offset adaptation speed" UWORD mgrd_q2p7126_mg_DIV_s2 1 100 0.00 177775.1 FORMAT "%8.1" ECU_ADDRESS 0x600071C8 /end MEASUREMENT
/begin MEASUREMENT lakolean_w "correction of lambda at poor suggestion" SWORD fak_q6p1035Em5 1 100 -2.000000 1.999939 FORMAT "%8.6" ECU_ADDRESS 0x60000F88 /end MEASUREMENT
/begin MEASUREMENT lakorich_w "correction of lambda at enrichment suggestion" SWORD fak_q6p1035Em5 1 100 -2.000000 1.999939 FORMAT "%8.6" ECU_ADDRESS 0x60000F86 /end MEASUREMENT
/begin MEASUREMENT lakormit_w "mean value of lambda correction at idle" SWORD fak_q6p1035Em5 1 100 -2.000000 1.999939 FORMAT "%8.6" ECU_ADDRESS 0x60000F84 /end MEASUREMENT
/begin MEASUREMENT lakotmp_w "temp. Lamda correction" UWORD fak_uw_b4 1 100 0.00 3.999939 FORMAT "%8.6" ECU_ADDRESS 0x60000F82 /end MEASUREMENT
/begin MEASUREMENT lamrplk_w_msg "lambda during idle" UWORD fak_uw_b2 1 100 0.00 1.999969 FORMAT "%8.6" ECU_ADDRESS 0x600015E8 /end MEASUREMENT
/begin MEASUREMENT mkioelub_w_msg "total fuel mass in engine oil (large range)" UWORD m_q0p04096 1 100 0.00 2684.314 FORMAT "%8.3" ECU_ADDRESS 0x60039570 /end MEASUREMENT
/begin MEASUREMENT mskaadmn_w "Minimum fuel evaporation from oil adaptation mass flowrate" SWORD m_q0p2170 1 100 -7111.111 7110.894 FORMAT "%8.3" ECU_ADDRESS 0x600071C6 /end MEASUREMENT
/begin MEASUREMENT mskaadmx_w "Maximum fuel evaporation from oil adaptation mass flowrate" SWORD m_q0p2170 1 100 -7111.111 7110.894 FORMAT "%8.3" ECU_ADDRESS 0x60008D8C /end MEASUREMENT
/begin MEASUREMENT mskagmx_w "Maximum total evaporated fuel (from engine oil) mass flowrate (maximal rate satisfied)" SWORD m_q0p2170 1 100 -7111.111 7110.894 FORMAT "%8.3" ECU_ADDRESS 0x600071C4 /end MEASUREMENT
/begin MEASUREMENT mskausev_w "Model based value of evaporated fuel mass flowrate from engine oil" UWORD m_q0p2170 1 100 0.00 14222.01 FORMAT "%8.2" ECU_ADDRESS 0x600071AE /end MEASUREMENT
/begin MEASUREMENT mskausg_w_msg "Evaporated fuel (from engine oil) mass flowrate" SWORD m_q0p2170 1 100 -7111.111 7110.894 FORMAT "%8.3" ECU_ADDRESS 0x60008D8A /end MEASUREMENT
/begin MEASUREMENT mskausmx_w_msg "max. Evaporated fuel (from engine oil) mass flowrate" UWORD m_q0p2170 1 100 0.00 14222.01 FORMAT "%8.2" ECU_ADDRESS 0x60008AD8 /end MEASUREMENT
/begin MEASUREMENT mskausnv_w "Evaporated fuel (from engine oil) mass flowrate stored as NV" SWORD m_q0p2170 1 100 -7111.111 7110.894 FORMAT "%8.3" ECU_ADDRESS 0x600390C2 /end MEASUREMENT
/begin MEASUREMENT mskausst_w "Evaporated fuel (from engine oil) mass flowrate - Start Value (unlimited)" SWORD m_q0p2170 1 100 -7111.111 7110.894 FORMAT "%8.3" ECU_ADDRESS 0x600071C2 /end MEASUREMENT
/begin MEASUREMENT mskgbd_w "Fuel mass needed engine basic amount" UWORD mgrad_q1_mgdivs 1 100 0.00 65535.00 FORMAT "%8.2" ECU_ADDRESS 0x60008AD6 /end MEASUREMENT
/begin MEASUREMENT mskioel_w_msg "Fuel mass flow rate into the engine oil" UWORD m_q0p2170 1 100 0.00 14222.01 FORMAT "%8.2" ECU_ADDRESS 0x600084F6 /end MEASUREMENT
/begin MEASUREMENT msklimmn_w "Fuel evaporation from oil adaptation mass flowrate limit for monitoring (max. enrichment)" SWORD m_q0p2170 1 100 -7111.111 7110.894 FORMAT "%8.3" ECU_ADDRESS 0x600071C0 /end MEASUREMENT
/begin MEASUREMENT mskrofmx_w "initial value of the max. limitation of the fuel evaporation from oil after end of adaptation" UWORD m_q0p2170 1 100 0.00 14222.01 FORMAT "%8.2" ECU_ADDRESS 0x60008AD4 /end MEASUREMENT
/begin MEASUREMENT mskrof_w "max. fuel evaporation from gradient limited limitation during ramp-off functionality" SWORD m_q0p2170 1 100 -7111.111 7110.894 FORMAT "%8.3" ECU_ADDRESS 0x600071BE /end MEASUREMENT
/begin MEASUREMENT mskroini_w "Initial value of evaporated fuel (from engine oil) mass flowrate at end of adaptation" SWORD m_q0p2170 1 100 -7111.111 7110.894 FORMAT "%8.3" ECU_ADDRESS 0x60008D88 /end MEASUREMENT
/begin MEASUREMENT mskron_w "fuel evaporation from oil offset for ramp-on functionality" UWORD m_q0p2170 1 100 0.00 14222.01 FORMAT "%8.2" ECU_ADDRESS 0x600071BC /end MEASUREMENT
/begin MEASUREMENT mskstob_w "Fuel mass needed engine stoichiometric amount" UWORD mgrad_q1_mgdivs 1 100 0.00 65535.00 FORMAT "%8.2" ECU_ADDRESS 0x60008AD2 /end MEASUREMENT
/begin MEASUREMENT mskueuk_w "Contamination due to transient compensation" UWORD m_q0p2170 1 100 0.00 14222.01 FORMAT "%8.2" ECU_ADDRESS 0x60008AD0 /end MEASUREMENT
/begin MEASUREMENT mskue_w "Excessively injected fuel mass flowrate" UWORD m_q0p2170 1 100 0.00 14222.01 FORMAT "%8.2" ECU_ADDRESS 0x600071AC /end MEASUREMENT
/begin MEASUREMENT mskukg_w "rel. fuel mass transition compensation based on load" UWORD mgrad_q1_mgdivs 1 100 0.00 65535.00 FORMAT "%8.2" ECU_ADDRESS 0x600071BA /end MEASUREMENT
/begin MEASUREMENT oilswmp_t "Warmup oil" UBYTE temp_ub_q0p75_o48 1 100 -48.0 143.3 FORMAT "%5.1" ECU_ADDRESS 0x60000F80 /end MEASUREMENT
/begin MEASUREMENT qdt1lk_w "Quotient DT1 filtered idle speed control related to DT1 Lambda activation" SWORD fak_q6p1035Em5 1 100 -2.000000 1.999939 FORMAT "%8.6" ECU_ADDRESS 0x60000F7E /end MEASUREMENT
/begin MEASUREMENT rkausgloc_w "fuel evaporated mass of the engine oil" SWORD rel_sw_b1536 1 100 -1536.000 1535.953 FORMAT "%8.3" ECU_ADDRESS 0x600071B8 /end MEASUREMENT
/begin MEASUREMENT rkausg_w_msg "fuel evaporated mass of the engine oil" SWORD rel_sw_b1536 1 100 -1536.000 1535.953 FORMAT "%8.3" ECU_ADDRESS 0x60008D84 /end MEASUREMENT
/begin MEASUREMENT rklakor_w_msg "relativ set point of fuel for the correction lambda at idle" SWORD rel_q0p046875 1 100 -1536.000 1535.953 FORMAT "%8.3" ECU_ADDRESS 0x60001626 /end MEASUREMENT
/begin MEASUREMENT StSys_stStrt "state of starting system" UBYTE OneToOne 1 100 0.00 255.0 FORMAT "%5.1" ECU_ADDRESS 0x60000991 /end MEASUREMENT
/begin MEASUREMENT tistrtdly_msg "remaining time for delay of starter control" UBYTE t10msxs_ub_q0p01 1 100 0.00 2.550 FORMAT "%5.3" ECU_ADDRESS 0x700054BE /end MEASUREMENT
/begin MEASUREMENT tnsezmot_w_msg "time of engine operation from first end of start (over ECU-cycle)" UWORD t_q0p1 1 100 0.00 6553.500 FORMAT "%8.3" ECU_ADDRESS 0x60014048 /end MEASUREMENT
/begin MEASUREMENT tnsez_w_msg "time counter at first end of start in cycle (16 bit)" UWORD t_q0p1 1 100 0.00 6553.500 FORMAT "%8.3" ECU_ADDRESS 0x600084B8 /end MEASUREMENT
/begin MEASUREMENT tnse_w_msg "time counter at end of start (16 bit)" UWORD t_q0p1 1 100 0.00 6553.500 FORMAT "%8.3" ECU_ADDRESS 0x600084BA /end MEASUREMENT
/begin MEASUREMENT tnst_w_msg "time after end of start" UWORD t_q0p01 1 100 0.00 655.3500 FORMAT "%8.4" ECU_ADDRESS 0x60008A52 /end MEASUREMENT
/begin MEASUREMENT towafent_w "Debounce time counter for healing of the errror excessive fuel amount in oil" UWORD t_q1 1 100 0.00 65535.00 FORMAT "%8.2" ECU_ADDRESS 0x600390C0 /end MEASUREMENT
/begin FUNCTION EngPrt_PrtLimOvht "21.6.0    Overheat Protection"
 /begin DEF_CHARACTERISTIC EngPrt_dPwrExhGasOvht_T EngPrt_dPwrRampEgrFailrNeg_C EngPrt_dPwrRampEgrFailrPos_C EngPrt_facNEngEgrFailr_CUR EngPrt_facPwrExhGasOvht_C EngPrt_pwrExhGasOvht_CUR EngPrt_pwrLimEgrFailr_MAP EngPrt_pwrRampLimOvhtIni_C EngPrt_pwrTqIntMaxOffs_C EngPrt_tExhOvhtThres_T /end DEF_CHARACTERISTIC
 /begin IN_MEASUREMENT B_mdbgagr_msg EGRVlv_ratActPosnB1 Epm_nEng ExhMod_tExhMnfB1 lambas_w_msg RngMod_trqInrMax /end IN_MEASUREMENT
 /begin OUT_MEASUREMENT EngPrt_pwrExhGasOvhtTar EngPrt_pwrLimEgrFailrTar EngPrt_trqLimOvhtPrv /end OUT_MEASUREMENT
 /begin LOC_MEASUREMENT agrvpmx_w EngPrt_dPwrExhGasOvht EngPrt_pwrExhGasOvhtLim EngPrt_pwrIntMax_MP EngPrt_pwrLimEgr EngPrt_pwrLimOvht EngPrt_PwrRampExhGasOvht_I.RampMem EngPrt_PwrRampLimEgr_I.RampMem EngPrt_tManifMod_MP /end LOC_MEASUREMENT
 FUNCTION_VERSION "21.6.0" /end FUNCTION
/begin FUNCTION EngPrt_TrqLimCalc "4.30.0    Resulting Engine Protection Limitation"
 /begin DEF_CHARACTERISTIC DMRTMKI DTMIBG EngPrt_facTqLimHiEngTGearDpdt_T EngPrt_swtOilTempSel_C KLFRTMKI MDGAT TAGAT TMXMIBG TNGAT TVGAT TVGATUP /end DEF_CHARACTERISTIC
 /begin IN_MEASUREMENT CEngDsT_t EngPrt_tqBltDrvVbrDampr EngPrt_trqLimOvhtPrv Epm_nEng fmi2trq_w_msg IKCtl_flgSftyRtdt OilSwmpT_t PTODi_trqCrSLeadUnlim RngMod_trqCrSMin RngMod_trqInrMax Tra_numGear /end IN_MEASUREMENT
 /begin OUT_MEASUREMENT EngPrt_facTrqLimnHiEngT EngPrt_trqLim EngPrt_trqLimLead /end OUT_MEASUREMENT
 /begin LOC_MEASUREMENT EngPrt_facTrqUnLimHiEngT_MP EngPrt_flgLimHiExhGasTemp EngPrt_flgtrqLimEngLoTempActvn_MP EngPrt_tmotmdb EngPrt_trqLimEngTemp EngPrt_trqLimHiExhGasTemp EngPrt_trqLimHiExhGasTemp_LT.memory /end LOC_MEASUREMENT
 FUNCTION_VERSION "4.30.0" /end FUNCTION
/begin FUNCTION EngReq_TrqLimCalc "4.20.0    Motor Requirements" /begin IN_MEASUREMENT EngReq_tqLimnFfv /end IN_MEASUREMENT /begin OUT_MEASUREMENT EngReq_trqLim EngReq_trqLimLead /end OUT_MEASUREMENT FUNCTION_VERSION "4.20.0" /end FUNCTION
/begin FUNCTION EngReq_TrqLimFfv "1.3.0     Torque limitation for flex-fuel vehicles"
 /begin DEF_CHARACTERISTIC DMRTMKIE EngReq_dtqLimnFfv_MAP EngReq_facDtqLimnFfv_MAP EngReq_facTqLimnpDifIntk_T EngReq_pDesIntkMnfld_C EngReq_tEngpCorrnThd_C EngReq_tqAbsLimnFfv_M EngReq_tqMnLimFfv_MAP EngReq_trqLimFfvCfg_C KFWMIXNAL KFWMIXTMT KLWMIXGI /end DEF_CHARACTERISTIC
 /begin IN_MEASUREMENT APP_r CEngDsT_t CoEng_tiNormalRed EngDa_tEng Epm_nEng fethstoe_w_msg PIntkVUs_pRaw PthLead_trqInrLead PTODi_trqCrSLeadUnlim RngMod_trqCrSMin RngMod_trqInrMax Tra_numGear /end IN_MEASUREMENT
 /begin OUT_MEASUREMENT EngReq_tqLimnFfv /end OUT_MEASUREMENT
 /begin LOC_MEASUREMENT EngReq_facCtlFfv EngReq_facEthnlCntnt_Loc EngReq_fethmnmxLoc EngReq_fethstoeLoc EngReq_fethstoeLocLRes EngReq_gangsistLoc EngReq_nmotLoc EngReq_pDifIntkMnfld EngReq_tmotLoc EngReq_tnstLoc EngReq_tqAbsLimnFfv_Loc EngReq_tqDfftlLimnFfv_mp frtmal frtmalps /end LOC_MEASUREMENT
 FUNCTION_VERSION "1.3.0" /end FUNCTION
/begin FUNCTION ENGSTKH "2.5.0     Release Stop combustion engine in due of exhaust system"
 /begin DEF_CHARACTERISTIC CWSTENGKH ExhMgT_tCat1MaxStopEngMax_T ExhMgT_tCat1O2StorgMin_T ExhMgT_tCat2MaxStopEngMax_C ExhMgT_tCat2O2StorgMin_C KLIMLTMST TDENSENGBL TDENSENGTP /end DEF_CHARACTERISTIC
 /begin IN_MEASUREMENT B_khakt_msg B_kh_msg B_sbblsu_msg CEngDsT_tStrt EngStrt_bFrstStrtEnd ExhMod_flgDewPntEndS1B1 ExhMod_flgDewPntEndS2B1 ExhMod_mAirMfIntegEngFirstStrt ExhMod_ratO2StrCat1MinBnk ExhMod_tCat1MaxB1 ExhMod_tCat1MinB1 ExhMod_tCat2MaxB1 ExhMod_tCat2MinB1 HEGO_bS2B1Vld SyC_stSub /end IN_MEASUREMENT
 /begin OUT_MEASUREMENT B_nsengtmx_msg B_stengtmn_msg ExhMgT_flgNoStopEngCatHeatg /end OUT_MEASUREMENT
 /begin LOC_MEASUREMENT B_cwsteng0 B_cwsteng1 B_cwsteng3 B_cwsteng4 B_cwsteng6 B_cwsteng7 B_cwsteng8 B_cwsteng9 CatH_B_ensengblTONV_I.outbit CatH_B_ensengblTONV_I.time CatH_B_ensengtpTONV_I.outbit CatH_B_ensengtpTONV_I.time ExhMgT_tStrtStopEng /end LOC_MEASUREMENT
 FUNCTION_VERSION "2.5.0" /end FUNCTION
/begin FUNCTION EngStrt_CtrldEngStopPosng "6.6.0     Controlled Engine Stop Positioning"
 /begin DEF_CHARACTERISTIC EngStrt_agRefPntCep_C EngStrt_agToTgtITdcCep_AX EngStrt_facIpolAltiCep_T EngStrt_nActvtCep_C EngStrt_nEngNegMaxCep_T EngStrt_nEngThdCep_C EngStrt_nRefPntCep_AX EngStrt_nrSelnTdcsCep_M EngStrt_nTdcBlwThdTCorrnCep_T EngStrt_pIntkBefCepMin_T EngStrt_ratAgThrVlvDesCepAlti_GM EngStrt_ratAgThrVlvDesCep_GM EngStrt_stConfCep_C EngStrt_tActvtCep_C EngStrt_tiRdyMinCep_C /end DEF_CHARACTERISTIC
 /begin IN_MEASUREMENT B_stopping_msg CEngDsT_t CoVeh_stEngStopOrd CoVeh_stEngStrtOrd EpmCrS_phiSeg EpmHCrS_ctIncEngPos Epm_nEng Epm_nEngLowSpdXP Epm_numCyl Epm_phiCyl Epm_stOpMode Epm_stSpd OilSwmpT_t PEnv_facCorrAlti PIntkVUs_p SyC_stSub /end IN_MEASUREMENT
 /begin OUT_MEASUREMENT EngStrt_agToTgtIgnTdcAtCrsStopCep EngStrt_agToTgtITdcCep EngStrt_flgBlwRefPntCep EngStrt_flgCepActv EngStrt_flgCepEnad EngStrt_flgNEngBlwThdCep EngStrt_idxTarTdcCep EngStrt_nEngNegMaxCep EngStrt_nRefPntCep EngStrt_ratAgThrVlvDesCep /end OUT_MEASUREMENT
 /begin LOC_MEASUREMENT EngStrt_agCrsCep_mp EngStrt_agToTgtITdcRvsRotCep EngStrt_ctrIncEngPosIgnTdc EngStrt_ctrIncEngPosOld EngStrt_dnTdcsAbvBlwThdCep EngStrt_facIpolAltiCep EngStrt_flgCepIgnTdcRea EngStrt_flgCepIgnTdcReaAck EngStrt_flgDsmPrmsEnaCep EngStrt_flgEngStopDtctd EngStrt_flgEngStopOrd EngStrt_flgRvsRotCepDtctd EngStrt_idxTdc EngStrt_nEngActChkdAbvThdCep EngStrt_nEngActChkdBlwThdCep EngStrt_nEngActChkdBlwThdCorrdCep EngStrt_nEngAtCurrIgnTdcCep EngStrt_nEngAtPrevIgnTdcCep EngStrt_nEngThdCep EngStrt_nrRestTdcsCep EngStrt_nTdcBlwThdTCorrnCep EngStrt_tCorrCep /end LOC_MEASUREMENT
 FUNCTION_VERSION "6.6.0" /end FUNCTION
/begin FUNCTION EngStrt_FuEvapOil "7.9.0_1.4.0Modelling and adaptation of fuel evaporation from oil"
 /begin DEF_CHARACTERISTIC ANZAUSGADA AUSGTIA CWAUSGMOD CWBGAUSG DFGAUSGLIM DFRMNOAUSG EngStrt_facFuEth_T EngStrt_facFuEvapOilSlow_C EngStrt_facFuInpOilTraCmp_T EngStrt_facMaxTotEvap_T EngStrt_facMFlowFuOilSlow_C EngStrt_FacPspu_M EngStrt_facTStrtOilFuCatHeatg_T EngStrt_mFuOilHysDelta_C EngStrt_mFuOilMaxSlow_C EngStrt_mFuOilMax_C EngStrt_mFuOilSlowInin_C EngStrt_mLrngMaxFuEvapOil_T EngStrt_mLrngMaxFuEvap_M EngStrt_ratMFlowFuEvapOilSlow_T EngStrt_tMaxEngFuInpOil_C FAIR2FUEL FAUSGENDTO FGAUSGIO FGAUSGLIM FGAUSGMX KLAUSGEMKLR KLAUSGMNST KLAUSGR KLAUSGRMX KLAUSGST KLFINOELTS KLFLAKORMK KLFRMAUSG MIFALAUSG MKIOELAP MKIOELMX MKMNAUSG MKNLLEHRTI MSKADAPHI MSKAUSEND MSKAUSKRIT MSKAUSMNST MSKMINAUSG MSKROFINC MSKRONINC MSKRONMX NLIMRKLAKO RKAUSGLIM RKAUSLILAK SDLUROABR TAUSGABST TAUSGADAP TAUSGEND TILIMAUSG TLRNOAUSG TMINOELMX TMKAUGFIL TMSKROABR TOSPAUSGKR TOSPMNAUSG TROAUSG TRONAUSG TWLRAUSG TWMRAUSG TWMRAUSOFF TWTIMNAUSG UMSRLNAGMN /end DEF_CHARACTERISTIC
 /begin IN_MEASUREMENT B_clradbbo_msg B_evloc_msg B_khakt_msg B_lamkoren_msg B_ll_msg B_lr_msg B_sa_msg B_sdluts_msg B_stendes_msg CEngDsT_t CEngDsT_tStrt EngStrt_bStrtEnd Epm_nEng Epm_nEngLRes Epm_stSpd FfPrm_facEthCurr flakorm_w_msg fnswl_w_msg frm_w_msg fst_w_msg lamsbg_w_msg mifal_w_msg ml_msg ml_w_msg OilSwmpT_t pndkpu_msg rklakor_w_msg rkukg_w_msg sdluts_w_msg SyC_stSub tengsq1_w_msg TiEngOff_stTi timinausggdi_w_msg tnse_w_msg umsrln_w_msg /end IN_MEASUREMENT
 /begin OUT_MEASUREMENT B_abor_msg B_ausadact_msg B_ausgakt_msg B_ausgend_msg B_ausgkrit_msg B_nllerhti_msg B_prmaxti_msg EngStrt_flgOilChgDne EngStrt_mFuOilFast EngStrt_mFuOil_msg EngStrt_ratOilDilAmnt fgausg_msg fgausmx_msg fkausgr_w_msg mskausg_w_msg mskausmx_w_msg mskioel_w_msg rkausg_w_msg /end OUT_MEASUREMENT
 /begin LOC_MEASUREMENT ausgadap B_ausgadap B_ausgti1 B_ausgti2 B_ausgti3 B_evaproff B_evapron B_lrnoausg B_ronabr B_ronoff EngStrt_facRelEvapFuMEngOilLoc EngStrt_flgMFuOilMax EngStrt_flgOilChgDneMdl EngStrt_mfFuEvapOilSlow EngStrt_mfFuOilSlow EngStrt_mFuOilSlow EngStrt_nEng EngStrt_tOil EngStrt_tStrt fausgabst fausgenred fkausgmx_w fkeinoel flakormk_w fmkioel_w FuEvapOil_bGdiPfiActv kintauso_w mskaadmn_w mskaadmx_w mskagmx_w mskausev_w mskausnv_w mskausst_w mskgbd_w msklimmn_w mskrofmx_w mskrof_w mskroini_w mskron_w mskstob_w mskueuk_w mskue_w mskukg_w rkausgloc_w /end LOC_MEASUREMENT
 FUNCTION_VERSION "7.9.0_1.4.0" /end FUNCTION
/begin FUNCTION EngStrt_GlbDef "3.4.0     Global definitions in EngStrt" FUNCTION_VERSION "3.4.0" /end FUNCTION
/begin FUNCTION EngStrt_InjProhb "1.12.0    Injection Prohibition during Start"
 /begin DEF_CHARACTERISTIC EngStrt_idxClassSelnInjRels_T EngStrt_pOilInjRels_C EngStrt_tiMaxInjRelsOilP_C /end DEF_CHARACTERISTIC
 /begin IN_MEASUREMENT CoEng_stMai EngStrt_flgInjRels EngStrt_flgStrtEndInj EngStrt_stStrtReq OilP_p /end IN_MEASUREMENT
 /begin OUT_MEASUREMENT EngStrt_flgInjProhb /end OUT_MEASUREMENT
 /begin LOC_MEASUREMENT EngStrt_stInjRelsStrtg /end LOC_MEASUREMENT
 FUNCTION_VERSION "1.12.0" /end FUNCTION
/begin FUNCTION EngStrt_LamCorrnIdle "3.3.0     Lambda correction based on idle speed control"
 /begin DEF_CHARACTERISTIC DCHANGEANR DDMLLKORLU DFAMPLANR DLAKORMX DLNANRMXTM DNSOLLKORX DRIANRMXTM FAMPLANRMX FBAMPANR FBEWLAMKOR FLAANRSO FLAANRSU MSKALLKETO NLLKORRE TDLLKORRE TFLAKORM TIMNLAMKOR TLAMKERFIL TLAMKHPFIL TLAMKLRFIL TLEANLKORL TMLLRORRE TNSTLAKOLL TRICHLKORL VFZGLKORRE /end DEF_CHARACTERISTIC
 /begin IN_MEASUREMENT B_ausgakt_msg B_kh_msg B_lr_msg CEngDsT_t Clth_st Epm_nEng fra_w_msg ftrq2mi_w_msg HLSDem_nSetPLo HLSDem_nSetPTrck InjSys_facPc lambas_w_msg LIGov_trqI LIGov_trqP mskausmx_w_msg OilSwmpT_t rlp_w_msg RngMod_trqDiffAdap sdluts_w_msg SyC_stSub timnausg_w_msg tnst_w_msg VehV_v /end IN_MEASUREMENT
 /begin OUT_MEASUREMENT B_lamkora_msg B_lamkoren_msg famplanr_w_msg flaanreg_w_msg flakorm_w_msg lamrplk_w_msg rklakor_w_msg /end OUT_MEASUREMENT
 /begin LOC_MEASUREMENT B_lakoriaf B_rampakt B_richanr dflaanr_w dmllrdt1_w dmllrgf_w dmllrg_w EngStrt_flgDsmPrmsVehVInhb EngStrt_tEng flanrdt1_w fleananr_w frichanr_w lakolean_w lakorich_w lakormit_w lakotmp_w oilswmp_t qdt1lk_w /end LOC_MEASUREMENT
 FUNCTION_VERSION "3.3.0" /end FUNCTION
/begin FUNCTION EngStrt_ReqOilWrmUp "2.3.0     Request oil warm up"
 /begin DEF_CHARACTERISTIC CWBGOELWF DMXOELUB MKIOELMXUB MKIOELUBAP MX1OELUB MX2OELUB TDBGOELERR TDBGOELERS /end DEF_CHARACTERISTIC
 /begin IN_MEASUREMENT B_ausgend_msg B_clradbbo_msg B_evloc_msg EngStrt_mFuOil_msg Epm_stSpd fkausgr_w_msg mskioel_w_msg SyC_stSub /end IN_MEASUREMENT
 /begin OUT_MEASUREMENT B_mx1oelub_msg B_mx2oelub_msg mkioelub_w_msg /end OUT_MEASUREMENT
 /begin LOC_MEASUREMENT B_dbgoele EngStrt_adjValLoc EngStrt_flgClear EngStrt_flgClrd towafent_w /end LOC_MEASUREMENT
 FUNCTION_VERSION "2.3.0" /end FUNCTION
/begin FUNCTION EngStrt_Stop "240.11.0  engine stop" /begin DEF_CHARACTERISTIC EngStrt_nDisblNewSync_C EngStrt_tiDisblNewSyncMax_C /end DEF_CHARACTERISTIC /begin IN_MEASUREMENT CoEng_stMai EngStrt_stStrtReq Epm_nEngTooth10ms Epm_stSpd /end IN_MEASUREMENT /begin OUT_MEASUREMENT EngStrt_stRstrtStgy /end OUT_MEASUREMENT
 /begin LOC_MEASUREMENT EngStrt_flgDisblNewSyncActv EngStrt_flgDisblNewSyncActvOld EngStrt_flgDisblNewSyncLtq EngStrt_tiDisblNewSyncMax /end LOC_MEASUREMENT
 FUNCTION_VERSION "240.11.0" /end FUNCTION
/begin FUNCTION EngStrt_Strt "140.17.0  start preparation, activation of restart-task" /begin DEF_CHARACTERISTIC EngStrt_stCfgCoMBhvr_T /end DEF_CHARACTERISTIC
 /begin IN_MEASUREMENT CoEng_stMai CoEng_stMaiOld EngStrt_flgEngStrtOrd EngStrt_stStrtReq EngStrt_stStrtSit Epm_stSpd Strt_stStaActv /end IN_MEASUREMENT
 /begin OUT_MEASUREMENT EngStrt_cntrRstrtEve EngStrt_flgReStrtDly EngStrt_stRstrtRsn /end OUT_MEASUREMENT
 /begin LOC_MEASUREMENT EngStrt_flgComReqd EngStrt_flgReStrtCoMReqd EngStrt_flgReStrtStpReqd EngStrt_flgReStrtStrtReqd EngStrt_flgTrigRstrtCom /end LOC_MEASUREMENT
 FUNCTION_VERSION "140.17.0" /end FUNCTION
/begin FUNCTION EngStrt_StrtCoor "1.28.0_1.2.0Start coordinator for combustion engine"
 /begin DEF_CHARACTERISTIC EngStrt_dataStrtCoor_C EngStrt_dnEngCoM1_T EngStrt_dnEngCoM2_T EngStrt_nEngCoM1_M EngStrt_nEngCoM2_M EngStrt_stCfgHipEOL_C EngStrt_stEomStrt_C EngStrt_stStrtPrioCoM_CA EngStrt_stStrtPrioFirst_CA EngStrt_stStrtPrioFolw_CA EngStrt_stStrtReqAppl_C EngStrt_stStrtSitAppl_C EngStrt_tDrctStrtHi_C EngStrt_tDrctStrtLo_C EngStrt_tFrstStrtStallgConf_C EngStrt_tHiPStrtCold_C EngStrt_tHiPStrtMid_T EngStrt_tHiPStrtPreInj_C EngStrt_tHiPStrtWrm_C EngStrt_tiDlyCoMWaitStrtr_C EngStrt_tiDlyNoStrtReq_C EngStrt_tiEngStpDrctStrt_C /end DEF_CHARACTERISTIC
 /begin IN_MEASUREMENT B_ebfmod_msg B_urstsprr_msg CoEng_stMai CoEng_stMaiOld CoVeh_stEngStrtOrd EngStrt_bFrstStrtEnd EngStrt_flgDrctStrtPhy EngStrt_flgDrctStrtRels EngStrt_flgGdiStrtRels EngStrt_flgHiPStrt EngStrt_flgInjSysRels EngStrt_flgPreInjRels EngStrt_flgStrtrStrtRels EngStrt_tCoor EngStrt_tStrtCoor EpmRRS_bEngSwOff Epm_nEng10ms fethstoe_msg HLSDem_nSetPLo PEnv_p Strt_stStaActv TiOff_stTiStrtEndOff TiOff_tiStrtEndOff /end IN_MEASUREMENT
 /begin OUT_MEASUREMENT EngStrt_EomStrt_I.stOperMod EngStrt_EomStrt_I.stOperModPrio EngStrt_EomStrt_I.stOperModStg EngStrt_flgEngStallg EngStrt_flgEngStrtOrd EngStrt_flgRePrio EngStrt_flgStrtAbort EngStrt_flgStrtFaild EngStrt_stStrtReq EngStrt_stStrtSit /end OUT_MEASUREMENT
 /begin LOC_MEASUREMENT EngStrt_flgEngStall EngStrt_flgRePrioEngStrtg EngStrt_flgStrtEna EngStrt_flgStrtEnaCoMRunng EngStrt_flgStrtEnaCoMStrtg EngStrt_flgStrtEnaCoMWait EngStrt_flgStrtEnaHiP EngStrt_flgStrtEnaPreInj EngStrt_stListCoMRunng EngStrt_stListCoMStrtg EngStrt_stListCoMWaitStrtr EngStrt_stListEOL EngStrt_stListFolw EngStrt_stListHiPCold EngStrt_stListHipEOL EngStrt_stListHiPMid EngStrt_stListHiPWrm EngStrt_stListLoP EngStrt_stListPreInj EngStrt_stListStrtrDrct EngStrt_stStrtAvlAry EngStrt_stStrtPrio EngStrt_stStrtReqLoc /end LOC_MEASUREMENT
 FUNCTION_VERSION "1.28.0_1.2.0" /end FUNCTION
/begin FUNCTION EngStrt_StrtEnd "3.19.0_1.2.0Condition Engine start"
 /begin DEF_CHARACTERISTIC EngStrt_cntrInjStrtEndSpdGovr_C EngStrt_dataStrtEnd_C EngStrt_idxClassSelnStrtEnd_T EngStrt_idxInstSelnNEngCrit_T EngStrt_idxInstSelnNEngDeb_T EngStrt_idxInstSelnNEngNrInj_T EngStrt_idxInstSelnNEng_T EngStrt_idxSelnOverrun_T EngStrt_nEngMaxCritStrtEnd_AX EngStrt_nStrtEndInit_C EngStrt_nStrt_C EngStrt_pStrtEnd_AX EngStrt_stStrtEndTqStruct_T EngStrt_tiDlyStrtEndTqStruct_T EngStrt_tStrtEndSpdGovr_C EngStrt_tStrtEnd_AX NENG.EngStrt_facEthStrtEnd_T NENG.nStrtEndEth_GM NENG.nStrtEnd_GM NENGCRIT.nStrtEndCrit_GM NENGCRIT.nStrtEnd_GM NENGCRIT.tiStrtgStrtEndCrit_GM NENGDEB.EngStrt_facEthStrtEnd_T NENGDEB.dnEngStrtDeb_C NENGDEB.nStrtEndEth_GM NENGDEB.nStrtEnd_GM NENGDEB.nrInjStrtEnd_GT NENGDEB.tiDnEngStrtDeb_C NENGDEB.tiNEngStrtDebMax_C NENGNRINJ.EngStrt_facEthStrtEnd_T NENGNRINJ.nStrtEndEth_GM NENGNRINJ.nStrtEnd_GM NENGNRINJ.nrInjStrtEnd_GT NENGNRINJ_FOLW.EngStrt_facEthStrtEnd_T NENGNRINJ_FOLW.nStrtEndEth_GM NENGNRINJ_FOLW.nStrtEnd_GM NENGNRINJ_FOLW.nrInjStrtEnd_GT NENG_COM.EngStrt_facEthStrtEnd_T NENG_COM.nStrtEndEth_GM NENG_COM.nStrtEnd_GM NENG_EOL.EngStrt_facEthStrtEnd_T NENG_EOL.nStrtEndEth_GM NENG_EOL.nStrtEnd_GM NENG_FOLW.EngStrt_facEthStrtEnd_T NENG_FOLW.nStrtEndEth_GM NENG_FOLW.nStrtEnd_GM /end DEF_CHARACTERISTIC
 /begin IN_MEASUREMENT anztib_msg CoEng_stMai EngStrt_stRstrtRsn EngStrt_stStrtReq EngStrt_stStrtSit EngStrt_tCoor EngStrt_tStrtCoor Epm_dnEng Epm_nEng Epm_nEng10ms Epm_stSpd FfPrm_facEthCurr HLSDem_nSetPLo InjSys_flgInjTmngErly PEnv_p PthSet_stOvrRun Strt_stStaActv SyC_ctDrvEnter /end IN_MEASUREMENT
 /begin OUT_MEASUREMENT B_stendes_msg B_stendll_msg B_stendmd_msg B_stendzw_msg EngStrt_bFrstStrtEnd EngStrt_bStrt EngStrt_bStrtEnd EngStrt_cntrInjStrtEnd EngStrt_flgOverrun EngStrt_flgStrtEndIgn EngStrt_flgStrtEndInj EngStrt_flgStrtEndSpdGovr EngStrt_flgStrtEndTqStruct EngStrt_tiAftFirstStrtEnd EngStrt_tiAftStrtEnd EngStrt_tiAftStrtEndLowRes EngStrt_tiOperAftFirstStrtEnd tnsezmot_w_msg tnsez_w_msg tnse_w_msg tnst_w_msg /end OUT_MEASUREMENT
 /begin LOC_MEASUREMENT EngStrt_ctStrtEnd100msDrvEnter EngStrt_ctStrtEnd10msDrvEnter EngStrt_ctStrtEndSyncS1DrvEnter EngStrt_flgStrtTmngErly EngStrt_idxClassSeldStrtEnd EngStrt_nEngMaxCrit /end LOC_MEASUREMENT
 FUNCTION_VERSION "3.19.0_1.2.0" /end FUNCTION
/begin FUNCTION EngStrt_StrtSysRels "1.21.0    System Releases for Engine Start"
 /begin DEF_CHARACTERISTIC EngStrt_dataSysRels_C EngStrt_nrWCycPreInj_T EngStrt_nVehSpdMax_C EngStrt_nVehSpdMin_C EngStrt_tHiPStrtHi_C EngStrt_tHiPStrtLo_C EngStrt_tiDlySyncnLoss_C /end DEF_CHARACTERISTIC
 /begin IN_MEASUREMENT anztib_msg B_hdpoff_msg B_rldirsta_msg B_tfuelg_msg B_wks_msg CEngDsT_t CEngDsT_tStop CEngDsT_tStrt CoEng_stMai EngStrt_bFrstStrtEnd EngStrt_flgFuPRels Epm_numCyl Epm_stOpMode Epm_stSync FlSys_tFlHPSys IntkAirT_tIntkMnfld OilSwmpT_t VehV_v /end IN_MEASUREMENT
 /begin OUT_MEASUREMENT EngStrt_flgDrctStrtPhy EngStrt_flgDrctStrtRels EngStrt_flgGdiStrtRels EngStrt_flgHiPStrtPhy EngStrt_flgHiPStrtRels EngStrt_flgInjSysRels EngStrt_flgPreInjRels EngStrt_flgStrtrStrtRels EngStrt_tCoor EngStrt_tStopCoor EngStrt_tStrtCoor /end OUT_MEASUREMENT
 /begin LOC_MEASUREMENT EngStrt_flgDrctStrtEna EngStrt_flgDrctStrtVld EngStrt_flgNoHiPStrt EngStrt_tHiPStrtHi EngStrt_tHiPStrtLo /end LOC_MEASUREMENT
 FUNCTION_VERSION "1.21.0" /end FUNCTION
/begin FUNCTION EngStrt_Vld2Lcy "8.12.0    interface adapter BC EngStrt to old software" /begin DEF_CHARACTERISTIC EngStrt_nMnNoStaCom /end DEF_CHARACTERISTIC
 /begin IN_MEASUREMENT CoEng_stMai CoVeh_stEngStopOrd CoVeh_stEngStrtOrd EngStrt_bStrtEnd EngStrt_flgDrctStrt EngStrt_flgDrctStrtRels EngStrt_flgHiPStrtRels EngStrt_flgInjProhb EngStrt_flgInjRels EngStrt_stRstrtRsn EngStrt_stRstrtStgy EngStrt_stStrtReq Epm_nEngTooth10ms Epm_stEngPos Epm_stSpd SyC_ctDrvEnter /end IN_MEASUREMENT
 /begin OUT_MEASUREMENT B_dirst_msg B_engrest_msg B_nostacom_msg B_stainjen_msg B_sthdrb_msg B_stoevab_msg B_stopeng_msg B_stopping_msg B_stopz_msg B_stostcom_msg B_stprep_msg B_strtena_msg EngStrt_bChgOfMnd EngStrt_bRstrtWoStaAsst EngStrt_stFstStrt StSys_stStrt tistrtdly_msg /end OUT_MEASUREMENT
 /begin LOC_MEASUREMENT EngStrt_ctVld2Lcy10msDrvEnter /end LOC_MEASUREMENT
 FUNCTION_VERSION "8.12.0" /end FUNCTION
/begin FUNCTION EngStrt_WrmUpCoor "2.6.0_1.2.0Combustion Engine Warm Up Coordinator"
 /begin DEF_CHARACTERISTIC EngStrt_dataWrmUpCoor_C EngStrt_facEthCurr_AX EngStrt_facTHspWrmUpEth_M EngStrt_nEngHspWrmUpEthCurr_T EngStrt_nEngHspWrmUpHys_C EngStrt_nEngHspWrmUp_C EngStrt_nrInjEthCurrHspWrmUpRstrt_GM EngStrt_nrInjEthCurrHspWrmUp_GM EngStrt_relMAirHspWrmUpEthCurr_T EngStrt_relMAirHspWrmUpHys_C EngStrt_relMAirHspWrmUp_GT EngStrt_stEomStgWrmUp1_C EngStrt_stEomStgWrmUp2_C EngStrt_stEomStgWrmUp3S1_C EngStrt_stEomStgWrmUp3S2_C EngStrt_stEomStgWrmUpAllwd_T EngStrt_stEomWrmUp1_C EngStrt_stEomWrmUp2_C EngStrt_stEomWrmUp3S1_C EngStrt_stEomWrmUp3S2_C EngStrt_stEomWrmUpAllwd_T EngStrt_stPrioWrmUp1_C EngStrt_stPrioWrmUp2_C EngStrt_stPrioWrmUpAllwd_C EngStrt_tHspWrmUpEthCurr_GM EngStrt_tHspWrmUpHi_GT EngStrt_tHspWrmUpHys_C EngStrt_tHspWrmUpLo_C EngStrt_tHspWrmUp_C EngStrt_tiAfterStrtEndMin_C EngStrt_tStrtCoor_AX EngStrt_tThdEngOpModWrmStrt_C /end DEF_CHARACTERISTIC
 /begin IN_MEASUREMENT AirMod_ratChrgAirCyl anztib_w_msg B_stopz_msg CoEng_stMai EngStrt_bStrtEnd EngStrt_tCoor EngStrt_tiAftStrtEnd EngStrt_tStrtCoor Epm_nEng FfPrm_facEthCurr FlSys_tFlHPSys IntkAirT_tIntkMnfld SyC_ctDrvEnter /end IN_MEASUREMENT
 /begin OUT_MEASUREMENT EngStrt_EomWrmUp1_I.stOperMod EngStrt_EomWrmUp1_I.stOperModPrio EngStrt_EomWrmUp1_I.stOperModStg EngStrt_EomWrmUp2_I.stOperMod EngStrt_EomWrmUp2_I.stOperModPrio EngStrt_EomWrmUp2_I.stOperModStg EngStrt_EomWrmUpAllwd_I.stOperMod EngStrt_EomWrmUpAllwd_I.stOperModPrio EngStrt_EomWrmUpAllwd_I.stOperModStg EngStrt_flgHspWrmUpReq EngStrt_stEomWrmUpAllwd /end OUT_MEASUREMENT
 /begin LOC_MEASUREMENT EngStrt_ctWrmUpCoorDrvEntr EngStrt_facEthCurr EngStrt_flgHspWrmUpAirLoc EngStrt_flgHspWrmUpAllwdLoc EngStrt_flgHspWrmUpNEngLoc EngStrt_stEomWrmUpAllwdLoc /end LOC_MEASUREMENT
 FUNCTION_VERSION "2.6.0_1.2.0" /end FUNCTION
/begin COMPU_METHOD AngleCrS "" RAT_FUNC "%6.4" "deg CrS" COEFFS 0 45.5111111111 0 0 0 1 /end COMPU_METHOD
/begin COMPU_METHOD B_TRUE "" TAB_VERB "%6.3" "" COMPU_TAB_REF B_TRUE /end COMPU_METHOD
/begin COMPU_VTAB B_TRUE "" TAB_VERB 2 0 "FALSE" 1 "TRUE" /end COMPU_VTAB
/begin COMPU_METHOD CoEOM_stEomStgTot_VERB "" TAB_VERB "%6.3" "-" COMPU_TAB_REF CoEOM_stEomStgTot_VERB /end COMPU_METHOD
/begin COMPU_VTAB CoEOM_stEomStgTot_VERB "" TAB_VERB 513 0 "Base_HOM-SNGL_FullLft" 1 "Base_HOM_FullLft" 2 "Base_HSP_FullLft" 3 "Base_HSPIC_FullLft" 4 "Base_HOM-SNGL_EIVC" 5 "Base_HOM_EIVC" 6 "Base_HSP_EIVC" 7 "Base_HSPIC_EIVC" 8 "n/a [00;08]" 9 "n/a [00;09]" 10 "n/a [00;10]" 11 "n/a [00;11]" 12 "n/a [00;12]" 13 "n/a [00;13]" 14 "n/a [00;14]" 15 "n/a [00;15]" 255 "No_Demand" 256 "WarmUp_HOM-SNGL_FullLft" 257 "WarmUp_HOM_FullLft" 258 "WarmUp_HSP_FullLft" 259 "WarmUp_HSPIC_FullLft" 260 "WarmUp_HOM-SNGL_EIVC" 261 "WarmUp_HOM_EIVC" 262 "WarmUp_HSP_EIVC" 263 "WarmUp_HSPIC_EIVC" 264 "n/a [01;08]" 265 "n/a [01;09]" 266 "n/a [01;10]" 267 "n/a [01;11]" 268 "n/a [01;12]" 269 "n/a [01;13]" 270 "n/a [01;14]" 271 "n/a [01;15]" 512 "CatHtg_HOM-SNGL_FullLft" 513 "CatHtg_HOM_FullLft" 514 "CatHtg_HSP_FullLft" 515 "CatHtg_HSPIC_FullLft" 516 "CatHtg_HOM-SNGL_EIVC" 517 "CatHtg_HOM_EIVC" 518 "CatHtg_HSP_EIVC" 519 "CatHtg_HSPIC_EIVC" 520 "n/a [02;08]" 521 "n/a [02;09]" 522 "n/a [02;10]" 523 "n/a [02;11]" 524 "n/a [02;12]" 525 "n/a [02;13]" 526 "n/a [02;14]" 527 "n/a [02;15]" 768 "Start_FullLft" 769 "n/a [03;01]" 770 "n/a [03;02]" 771 "n/a [03;03]" 772 "Start_EIVC" 773 "n/a [03;05]" 774 "n/a [03;06]" 775 "n/a [03;07]" 776 "n/a [03;08]" 777 "n/a [03;09]" 778 "n/a [03;10]" 779 "n/a [03;11]" 780 "n/a [03;12]" 781 "n/a [03;13]" 782 "n/a [03;14]" 783 "n/a [03;15]" 1024 "n/a [04;00]" 1025 "n/a [04;01]" 1026 "n/a [04;02]" 1027 "n/a [04;03]" 1028 "n/a [04;04]" 1029 "n/a [04;05]" 1030 "n/a [04;06]" 1031 "n/a [04;07]" 1032 "n/a [04;08]" 1033 "n/a [04;09]" 1034 "n/a [04;10]" 1035 "n/a [04;11]" 1036 "n/a [04;12]" 1037 "n/a [04;13]" 1038 "n/a [04;14]" 1039 "n/a [04;15]" 1280 "n/a [05;00]" 1281 "n/a [05;01]" 1282 "n/a [05;02]" 1283 "n/a [05;03]" 1284 "n/a [05;04]" 1285 "n/a [05;05]" 1286 "n/a [05;06]" 1287 "n/a [05;07]" 1288 "n/a [05;08]" 1289 "n/a [05;09]" 1290 "n/a [05;10]" 1291 "n/a [05;11]" 1292 "n/a [05;12]" 1293 "n/a [05;13]" 1294 "n/a [05;14]" 1295 "n/a [05;15]" 1536 "n/a [06;00]" 1537 "n/a [06;01]" 1538 "n/a [06;02]" 1539 "n/a [06;03]" 1540 "n/a [06;04]" 1541 "n/a [06;05]" 1542 "n/a [06;06]" 1543 "n/a [06;07]" 1544 "n/a [06;08]" 1545 "n/a [06;09]" 1546 "n/a [06;10]" 1547 "n/a [06;11]" 1548 "n/a [06;12]" 1549 "n/a [06;13]" 1550 "n/a [06;14]" 1551 "n/a [06;15]" 1792 "n/a [07;00]" 1793 "n/a [07;01]" 1794 "n/a [07;02]" 1795 "n/a [07;03]" 1796 "n/a [07;04]" 1797 "n/a [07;05]" 1798 "n/a [07;06]" 1799 "n/a [07;07]" 1800 "n/a [07;08]" 1801 "n/a [07;09]" 1802 "n/a [07;10]" 1803 "n/a [07;11]" 1804 "n/a [07;12]" 1805 "n/a [07;13]" 1806 "n/a [07;14]" 1807 "n/a [07;15]" 2048 "n/a [08;00]" 2049 "n/a [08;01]" 2050 "n/a [08;02]" 2051 "n/a [08;03]" 2052 "n/a [08;04]" 2053 "n/a [08;05]" 2054 "n/a [08;06]" 2055 "n/a [08;07]" 2056 "n/a [08;08]" 2057 "n/a [08;09]" 2058 "n/a [08;10]" 2059 "n/a [08;11]" 2060 "n/a [08;12]" 2061 "n/a [08;13]" 2062 "n/a [08;14]" 2063 "n/a [08;15]" 2304 "n/a [09;00]" 2305 "n/a [09;01]" 2306 "n/a [09;02]" 2307 "n/a [09;03]" 2308 "n/a [09;04]" 2309 "n/a [09;05]" 2310 "n/a [09;06]" 2311 "n/a [09;07]" 2312 "n/a [09;08]" 2313 "n/a [09;09]" 2314 "n/a [09;10]" 2315 "n/a [09;11]" 2316 "n/a [09;12]" 2317 "n/a [09;13]" 2318 "n/a [09;14]" 2319 "n/a [09;15]" 2560 "n/a [10;00]" 2561 "n/a [10;01]" 2562 "n/a [10;02]" 2563 "n/a [10;03]" 2564 "n/a [10;04]" 2565 "n/a [10;05]" 2566 "n/a [10;06]" 2567 "n/a [10;07]" 2568 "n/a [10;08]" 2569 "n/a [10;09]" 2570 "n/a [10;10]" 2571 "n/a [10;11]" 2572 "n/a [10;12]" 2573 "n/a [10;13]" 2574 "n/a [10;14]" 2575 "n/a [10;15]" 2816 "n/a [11;00]" 2817 "n/a [11;01]" 2818 "n/a [11;02]" 2819 "n/a [11;03]" 2820 "n/a [11;04]" 2821 "n/a [11;05]" 2822 "n/a [11;06]" 2823 "n/a [11;07]" 2824 "n/a [11;08]" 2825 "n/a [11;09]" 2826 "n/a [11;10]" 2827 "n/a [11;11]" 2828 "n/a [11;12]" 2829 "n/a [11;13]" 2830 "n/a [11;14]" 2831 "n/a [11;15]" 3072 "n/a [12;00]" 3073 "n/a [12;01]" 3074 "n/a [12;02]" 3075 "n/a [12;03]" 3076 "n/a [12;04]" 3077 "n/a [12;05]" 3078 "n/a [12;06]" 3079 "n/a [12;07]" 3080 "n/a [12;08]" 3081 "n/a [12;09]" 3082 "n/a [12;10]" 3083 "n/a [12;11]" 3084 "n/a [12;12]" 3085 "n/a [12;13]" 3086 "n/a [12;14]" 3087 "n/a [12;15]" 3328 "n/a [13;00]" 3329 "n/a [13;01]" 3330 "n/a [13;02]" 3331 "n/a [13;03]" 3332 "n/a [13;04]" 3333 "n/a [13;05]" 3334 "n/a [13;06]" 3335 "n/a [13;07]" 3336 "n/a [13;08]" 3337 "n/a [13;09]" 3338 "n/a [13;10]" 3339 "n/a [13;11]" 3340 "n/a [13;12]" 3341 "n/a [13;13]" 3342 "n/a [13;14]" 3343 "n/a [13;15]" 3584 "n/a [14;00]" 3585 "n/a [14;01]" 3586 "n/a [14;02]" 3587 "n/a [14;03]" 3588 "n/a [14;04]" 3589 "n/a [14;05]" 3590 "n/a [14;06]" 3591 "n/a [14;07]" 3592 "n/a [14;08]" 3593 "n/a [14;09]" 3594 "n/a [14;10]" 3595 "n/a [14;11]" 3596 "n/a [14;12]" 3597 "n/a [14;13]" 3598 "n/a [14;14]" 3599 "n/a [14;15]" 3840 "n/a [15;00]" 3841 "n/a [15;01]" 3842 "n/a [15;02]" 3843 "n/a [15;03]" 3844 "n/a [15;04]" 3845 "n/a [15;05]" 3846 "n/a [15;06]" 3847 "n/a [15;07]" 3848 "n/a [15;08]" 3849 "n/a [15;09]" 3850 "n/a [15;10]" 3851 "n/a [15;11]" 3852 "n/a [15;12]" 3853 "n/a [15;13]" 3854 "n/a [15;14]" 3855 "n/a [15;15]" 4096 "n/a [16;00]" 4097 "n/a [16;01]" 4098 "n/a [16;02]" 4099 "n/a [16;03]" 4100 "n/a [16;04]" 4101 "n/a [16;05]" 4102 "n/a [16;06]" 4103 "n/a [16;07]" 4104 "n/a [16;08]" 4105 "n/a [16;09]" 4106 "n/a [16;10]" 4107 "n/a [16;11]" 4108 "n/a [16;12]" 4109 "n/a [16;13]" 4110 "n/a [16;14]" 4111 "n/a [16;15]" 4352 "n/a [17;00]" 4353 "n/a [17;01]" 4354 "n/a [17;02]" 4355 "n/a [17;03]" 4356 "n/a [17;04]" 4357 "n/a [17;05]" 4358 "n/a [17;06]" 4359 "n/a [17;07]" 4360 "n/a [17;08]" 4361 "n/a [17;09]" 4362 "n/a [17;10]" 4363 "n/a [17;11]" 4364 "n/a [17;12]" 4365 "n/a [17;13]" 4366 "n/a [17;14]" 4367 "n/a [17;15]" 4608 "n/a [18;00]" 4609 "n/a [18;01]" 4610 "n/a [18;02]" 4611 "n/a [18;03]" 4612 "n/a [18;04]" 4613 "n/a [18;05]" 4614 "n/a [18;06]" 4615 "n/a [18;07]" 4616 "n/a [18;08]" 4617 "n/a [18;09]" 4618 "n/a [18;10]" 4619 "n/a [18;11]" 4620 "n/a [18;12]" 4621 "n/a [18;13]" 4622 "n/a [18;14]" 4623 "n/a [18;15]" 4864 "n/a [19;00]" 4865 "n/a [19;01]" 4866 "n/a [19;02]" 4867 "n/a [19;03]" 4868 "n/a [19;04]" 4869 "n/a [19;05]" 4870 "n/a [19;06]" 4871 "n/a [19;07]" 4872 "n/a [19;08]" 4873 "n/a [19;09]" 4874 "n/a [19;10]" 4875 "n/a [19;11]" 4876 "n/a [19;12]" 4877 "n/a [19;13]" 4878 "n/a [19;14]" 4879 "n/a [19;15]" 5120 "n/a [20;00]" 5121 "n/a [20;01]" 5122 "n/a [20;02]" 5123 "n/a [20;03]" 5124 "n/a [20;04]" 5125 "n/a [20;05]" 5126 "n/a [20;06]" 5127 "n/a [20;07]" 5128 "n/a [20;08]" 5129 "n/a [20;09]" 5130 "n/a [20;10]" 5131 "n/a [20;11]" 5132 "n/a [20;12]" 5133 "n/a [20;13]" 5134 "n/a [20;14]" 5135 "n/a [20;15]" 5376 "n/a [21;00]" 5377 "n/a [21;01]" 5378 "n/a [21;02]" 5379 "n/a [21;03]" 5380 "n/a [21;04]" 5381 "n/a [21;05]" 5382 "n/a [21;06]" 5383 "n/a [21;07]" 5384 "n/a [21;08]" 5385 "n/a [21;09]" 5386 "n/a [21;10]" 5387 "n/a [21;11]" 5388 "n/a [21;12]" 5389 "n/a [21;13]" 5390 "n/a [21;14]" 5391 "n/a [21;15]" 5632 "n/a [22;00]" 5633 "n/a [22;01]" 5634 "n/a [22;02]" 5635 "n/a [22;03]" 5636 "n/a [22;04]" 5637 "n/a [22;05]" 5638 "n/a [22;06]" 5639 "n/a [22;07]" 5640 "n/a [22;08]" 5641 "n/a [22;09]" 5642 "n/a [22;10]" 5643 "n/a [22;11]" 5644 "n/a [22;12]" 5645 "n/a [22;13]" 5646 "n/a [22;14]" 5647 "n/a [22;15]" 5888 "n/a [23;00]" 5889 "n/a [23;01]" 5890 "n/a [23;02]" 5891 "n/a [23;03]" 5892 "n/a [23;04]" 5893 "n/a [23;05]" 5894 "n/a [23;06]" 5895 "n/a [23;07]" 5896 "n/a [23;08]" 5897 "n/a [23;09]" 5898 "n/a [23;10]" 5899 "n/a [23;11]" 5900 "n/a [23;12]" 5901 "n/a [23;13]" 5902 "n/a [23;14]" 5903 "n/a [23;15]" 6144 "n/a [24;00]" 6145 "n/a [24;01]" 6146 "n/a [24;02]" 6147 "n/a [24;03]" 6148 "n/a [24;04]" 6149 "n/a [24;05]" 6150 "n/a [24;06]" 6151 "n/a [24;07]" 6152 "n/a [24;08]" 6153 "n/a [24;09]" 6154 "n/a [24;10]" 6155 "n/a [24;11]" 6156 "n/a [24;12]" 6157 "n/a [24;13]" 6158 "n/a [24;14]" 6159 "n/a [24;15]" 6400 "n/a [25;00]" 6401 "n/a [25;01]" 6402 "n/a [25;02]" 6403 "n/a [25;03]" 6404 "n/a [25;04]" 6405 "n/a [25;05]" 6406 "n/a [25;06]" 6407 "n/a [25;07]" 6408 "n/a [25;08]" 6409 "n/a [25;09]" 6410 "n/a [25;10]" 6411 "n/a [25;11]" 6412 "n/a [25;12]" 6413 "n/a [25;13]" 6414 "n/a [25;14]" 6415 "n/a [25;15]" 6656 "n/a [26;00]" 6657 "n/a [26;01]" 6658 "n/a [26;02]" 6659 "n/a [26;03]" 6660 "n/a [26;04]" 6661 "n/a [26;05]" 6662 "n/a [26;06]" 6663 "n/a [26;07]" 6664 "n/a [26;08]" 6665 "n/a [26;09]" 6666 "n/a [26;10]" 6667 "n/a [26;11]" 6668 "n/a [26;12]" 6669 "n/a [26;13]" 6670 "n/a [26;14]" 6671 "n/a [26;15]" 6912 "n/a [27;00]" 6913 "n/a [27;01]" 6914 "n/a [27;02]" 6915 "n/a [27;03]" 6916 "n/a [27;04]" 6917 "n/a [27;05]" 6918 "n/a [27;06]" 6919 "n/a [27;07]" 6920 "n/a [27;08]" 6921 "n/a [27;09]" 6922 "n/a [27;10]" 6923 "n/a [27;11]" 6924 "n/a [27;12]" 6925 "n/a [27;13]" 6926 "n/a [27;14]" 6927 "n/a [27;15]" 7168 "n/a [28;00]" 7169 "n/a [28;01]" 7170 "n/a [28;02]" 7171 "n/a [28;03]" 7172 "n/a [28;04]" 7173 "n/a [28;05]" 7174 "n/a [28;06]" 7175 "n/a [28;07]" 7176 "n/a [28;08]" 7177 "n/a [28;09]" 7178 "n/a [28;10]" 7179 "n/a [28;11]" 7180 "n/a [28;12]" 7181 "n/a [28;13]" 7182 "n/a [28;14]" 7183 "n/a [28;15]" 7424 "n/a [29;00]" 7425 "n/a [29;01]" 7426 "n/a [29;02]" 7427 "n/a [29;03]" 7428 "n/a [29;04]" 7429 "n/a [29;05]" 7430 "n/a [29;06]" 7431 "n/a [29;07]" 7432 "n/a [29;08]" 7433 "n/a [29;09]" 7434 "n/a [29;10]" 7435 "n/a [29;11]" 7436 "n/a [29;12]" 7437 "n/a [29;13]" 7438 "n/a [29;14]" 7439 "n/a [29;15]" 7680 "n/a [30;00]" 7681 "n/a [30;01]" 7682 "n/a [30;02]" 7683 "n/a [30;03]" 7684 "n/a [30;04]" 7685 "n/a [30;05]" 7686 "n/a [30;06]" 7687 "n/a [30;07]" 7688 "n/a [30;08]" 7689 "n/a [30;09]" 7690 "n/a [30;10]" 7691 "n/a [30;11]" 7692 "n/a [30;12]" 7693 "n/a [30;13]" 7694 "n/a [30;14]" 7695 "n/a [30;15]" 7936 "n/a [31;00]" 7937 "n/a [31;01]" 7938 "n/a [31;02]" 7939 "n/a [31;03]" 7940 "n/a [31;04]" 7941 "n/a [31;05]" 7942 "n/a [31;06]" 7943 "n/a [31;07]" 7944 "n/a [31;08]" 7945 "n/a [31;09]" 7946 "n/a [31;10]" 7947 "n/a [31;11]" 7948 "n/a [31;12]" 7949 "n/a [31;13]" 7950 "n/a [31;14]" 7951 "n/a [31;15]" /end COMPU_VTAB
/begin COMPU_METHOD dez "" RAT_FUNC "%6.2" "" COEFFS 0 1 0 0 0 1 /end COMPU_METHOD
/begin COMPU_METHOD EngN "" RAT_FUNC "%6.3" "rpm" COEFFS 0 2 0 0 0 1 /end COMPU_METHOD
/begin COMPU_METHOD EngNGrd "" RAT_FUNC "%6.3" "rpm/s" COEFFS 0 2 0 0 0 1 /end COMPU_METHOD
/begin COMPU_METHOD ENGSTRT_IDXSTRTEND_SET_COMPU_VERB "" TAB_VERB "%6.3" "-" COMPU_TAB_REF ENGSTRT_IDXSTRTEND_SET_COMPU_VERB /end COMPU_METHOD
/begin COMPU_VTAB ENGSTRT_IDXSTRTEND_SET_COMPU_VERB "" TAB_VERB 5 0 "IDXSTRTEND_NONE" 1 "IDXSTRTEND_NENG" 2 "IDXSTRTEND_NENGNRINJ" 3 "IDXSTRTEND_NENGDEB" 4 "IDXSTRTEND_NENGCRIT" /end COMPU_VTAB
/begin COMPU_METHOD EngStrt_stRstrtRsn_VERB "" TAB_VERB "%6.3" "" COMPU_TAB_REF EngStrt_stRstrtRsn_VERB /end COMPU_METHOD
/begin COMPU_VTAB EngStrt_stRstrtRsn_VERB "" TAB_VERB 6 0 "ENGSTRT_RSTRTRSN_NONE" 1 "ENGSTRT_RSTRTRSN_STRT" 2 "ENGSTRT_RSTRTRSN_STP" 3 "ENGSTRT_RSTRTRSN_COMSTARTING" 4 "ENGSTRT_RSTRTRSN_COMRUNNING" 5 "ENGSTRT_RESTRTRSN_EXTERNAL" /end COMPU_VTAB
/begin COMPU_METHOD EngStrt_stRstrtStgy_VERB "" TAB_VERB "%6.3" "" COMPU_TAB_REF EngStrt_stRstrtStgy_VERB /end COMPU_METHOD
/begin COMPU_VTAB EngStrt_stRstrtStgy_VERB "" TAB_VERB 5 0 "ENGSTRT_RSTRTSTGY_UNDEF" 1 "ENGSTRT_RSTRTSTGY_RUNNING" 2 "ENGSTRT_RSTRTSTGY_STARTING" 3 "ENGSTRT_RSTRTSTGY_WAIT_FOR_STARTER" 4 "ENGSTRT_RSTRTSTGY_NOCOM_STARTER" /end COMPU_VTAB
/begin COMPU_METHOD ENGSTRT_STSTRTREQ_SET_COMPU_VERB "" TAB_VERB "%6.3" "-" COMPU_TAB_REF ENGSTRT_STSTRTREQ_SET_COMPU_VERB /end COMPU_METHOD
/begin COMPU_VTAB ENGSTRT_STSTRTREQ_SET_COMPU_VERB "" TAB_VERB 19 0 "ENGSTRT_NOSTRT" 1024 "ENGSTRT_LOP" 1028 "ENGSTRT_EOL" 1029 "ENGSTRT_PREINJ" 1031 "ENGSTRT_HIPEOL" 8192 "ENGSTRT_COMRUNNG" 8193 "ENGSTRT_COMSTRTG" 8194 "ENGSTRT_COMWAITSTRTR" 16384 "ENGSTRT_FOLW" 16385 "ENGSTRT_STRTR_DRCT" 32768 "ENGSTRT_HIPCOLD" 32769 "ENGSTRT_HIPMID" 32770 "ENGSTRT_HIPWRM" 256 "ENGSTRT_FOLWWRM" 257 "ENGSTRT_FOLWMID" 258 "ENGSTRT_FOLWCOLD" 259 "ENGSTRT_STRTR_DRCTWRM" 260 "ENGSTRT_STRTR_DRCTMID" 261 "ENGSTRT_STRTR_DRCTCOLD" /end COMPU_VTAB
/begin COMPU_METHOD Fact "" RAT_FUNC "%6.5" "-" COEFFS 0 8192 0 0 0 1 /end COMPU_METHOD
/begin COMPU_METHOD Fact1 "" RAT_FUNC "%6.4" "-" COEFFS 0 128 0 0 0 1 /end COMPU_METHOD
/begin COMPU_METHOD fak_q0p000763 "" RAT_FUNC "%6.5" "" COEFFS 0 65536 0 0 0 50 /end COMPU_METHOD
/begin COMPU_METHOD fak_q0p0078 "" RAT_FUNC "%6.4" "-" COEFFS 0 128 0 0 0 1 /end COMPU_METHOD
/begin COMPU_METHOD fak_q1p5258Em5 "" RAT_FUNC "%7.6" "h/kg" COEFFS 0 65536 0 0 0 1 /end COMPU_METHOD
/begin COMPU_METHOD fak_q3p0518Em5 "" RAT_FUNC "%7.6" "" COEFFS 0 32768 0 0 0 1 /end COMPU_METHOD
/begin COMPU_METHOD fak_q6p1035Em5 "" RAT_FUNC "%7.6" "-" COEFFS 0 65536 0 0 0 4 /end COMPU_METHOD
/begin COMPU_METHOD fak_sb_b1 "" RAT_FUNC "%6.4" "-" COEFFS 0 256 0 0 0 2 /end COMPU_METHOD
/begin COMPU_METHOD fak_sw_b1 "" RAT_FUNC "%7.6" "-" COEFFS 0 65536 0 0 0 2 /end COMPU_METHOD
/begin COMPU_METHOD fak_sw_b2 "" RAT_FUNC "%7.6" "-" COEFFS 0 65536 0 0 0 4 /end COMPU_METHOD
/begin COMPU_METHOD fak_ub_b1 "" RAT_FUNC "%6.4" "-" COEFFS 0 256 0 0 0 1 /end COMPU_METHOD
/begin COMPU_METHOD fak_ub_b2 "" RAT_FUNC "%8.5" "-" COEFFS 0 256 0 0 0 2 /end COMPU_METHOD
/begin COMPU_METHOD fak_ub_b8 "" RAT_FUNC "%6.4" "-" COEFFS 0 256 0 0 0 8 /end COMPU_METHOD
/begin COMPU_METHOD fak_uw_b1 "" RAT_FUNC "%7.6" "-" COEFFS 0 65536 0 0 0 1 /end COMPU_METHOD
/begin COMPU_METHOD fak_uw_b16 "" RAT_FUNC "%6.5" "-" COEFFS 0 65536 0 0 0 16 /end COMPU_METHOD
/begin COMPU_METHOD fak_uw_b2 "" RAT_FUNC "%7.6" "-" COEFFS 0 65536 0 0 0 2 /end COMPU_METHOD
/begin COMPU_METHOD fak_uw_b4 "" RAT_FUNC "%7.6" "-" COEFFS 0 65536 0 0 0 4 /end COMPU_METHOD
/begin COMPU_METHOD fak_uw_b64 "" RAT_FUNC "%6.5" "-" COEFFS 0 65536 0 0 0 64 /end COMPU_METHOD
/begin COMPU_METHOD fak_uw_b8 "" RAT_FUNC "%6.5" "-" COEFFS 0 65536 0 0 0 8 /end COMPU_METHOD
/begin COMPU_METHOD HESRV_MSID_SSPMON_SC_Compu "" TAB_VERB "%6.3" "" COMPU_TAB_REF HESRV_MSID_SSPMON_SC_Compu /end COMPU_METHOD
/begin COMPU_VTAB HESRV_MSID_SSPMON_SC_Compu "" TAB_VERB 4 0 "0" 1 "1" 2 "2" 3 "3" /end COMPU_VTAB
/begin COMPU_METHOD HESRV_MSTSLAVECAL_SC_Compu "" TAB_VERB "%6.3" "" COMPU_TAB_REF HESRV_MSTSLAVECAL_SC_Compu /end COMPU_METHOD
/begin COMPU_VTAB HESRV_MSTSLAVECAL_SC_Compu "" TAB_VERB 2 0 "False" 1 "True" /end COMPU_VTAB
/begin COMPU_METHOD HESRV_MSTSLAVEINFOEEPUPD_SC_Compu "" TAB_VERB "%6.3" "" COMPU_TAB_REF HESRV_MSTSLAVEINFOEEPUPD_SC_Compu /end COMPU_METHOD
/begin COMPU_VTAB HESRV_MSTSLAVEINFOEEPUPD_SC_Compu "" TAB_VERB 2 0 "False" 1 "True" /end COMPU_VTAB
/begin COMPU_METHOD HESRV_SEGPROCENA_SC_Compu "" TAB_VERB "%6.3" "" COMPU_TAB_REF HESRV_SEGPROCENA_SC_Compu /end COMPU_METHOD
/begin COMPU_VTAB HESRV_SEGPROCENA_SC_Compu "" TAB_VERB 2 0 "False" 1 "True" /end COMPU_VTAB
/begin COMPU_METHOD HESRV_SWCSTNCARYSIZE_SC_Compu "" RAT_FUNC "%6.2" "" COEFFS 0 1 0 0 0 1 /end COMPU_METHOD
/begin COMPU_METHOD HESRV_SWCSTNCCHK_SC_Compu "" TAB_VERB "%6.3" "" COMPU_TAB_REF HESRV_SWCSTNCCHK_SC_Compu /end COMPU_METHOD
/begin COMPU_VTAB HESRV_SWCSTNCCHK_SC_Compu "" TAB_VERB 3 0 "HESRV_NOTUSED" 1 "HESRV_CSTNCCHKECU1" 2 "HESRV_CSTNCCHKECU2" /end COMPU_VTAB
/begin COMPU_METHOD HESRV_SWCSTNCSTGY_SC_Compu "" TAB_VERB "%6.3" "" COMPU_TAB_REF HESRV_SWCSTNCSTGY_SC_Compu /end COMPU_METHOD
/begin COMPU_VTAB HESRV_SWCSTNCSTGY_SC_Compu "" TAB_VERB 4 0 "0" 1 "1" 2 "2" 3 "3" /end COMPU_VTAB
/begin COMPU_METHOD HEVCHGR_SY_Compu "" TAB_VERB "%6.3" "" COMPU_TAB_REF HEVCHGR_SY_Compu /end COMPU_METHOD
/begin COMPU_VTAB HEVCHGR_SY_Compu "" TAB_VERB 5 0 "NOCHGR" 1 "CHGR_UHV" 2 "CHGR_UHVLV" 3 "CHGR_BHV" 4 "CHGR_BHVLV" /end COMPU_VTAB
/begin COMPU_METHOD HEVPLINAVL_SC_Compu "" TAB_VERB "%6.3" "" COMPU_TAB_REF HEVPLINAVL_SC_Compu /end COMPU_METHOD
/begin COMPU_VTAB HEVPLINAVL_SC_Compu "" TAB_VERB 2 0 "False" 1 "True" /end COMPU_VTAB
/begin COMPU_METHOD HEVTYP_SY_Compu "" TAB_VERB "%6.3" "" COMPU_TAB_REF HEVTYP_SY_Compu /end COMPU_METHOD
/begin COMPU_VTAB HEVTYP_SY_Compu "" TAB_VERB 8 0 "0" 1 "HEVTYP_SER" 2 "HEVTYP_SERPARL" 3 "HEVTYP_PWRSPLT" 4 "HEVTYP_PARL" 5 "HEVTYP_EAD" 6 "HEVTYP_EDCT" 7 "HEVTYP_PARLSER" /end COMPU_VTAB
/begin COMPU_METHOD HIPSYSEXTIFHPPMPOFF_SC_Compu "" TAB_VERB "%6.3" "" COMPU_TAB_REF HIPSYSEXTIFHPPMPOFF_SC_Compu /end COMPU_METHOD
/begin COMPU_VTAB HIPSYSEXTIFHPPMPOFF_SC_Compu "" TAB_VERB 2 0 "NO_EXTIF" 1 "EXTIFINJSYS" /end COMPU_VTAB
/begin COMPU_METHOD HIPSYS_ADAPCTRL_SC_Compu "" TAB_VERB "%6.3" "" COMPU_TAB_REF HIPSYS_ADAPCTRL_SC_Compu /end COMPU_METHOD
/begin COMPU_VTAB HIPSYS_ADAPCTRL_SC_Compu "" TAB_VERB 2 0 "False" 1 "True" /end COMPU_VTAB
/begin COMPU_METHOD HIPSYS_HIPPMPPLAUSDGNSTYP_SC_Compu "" TAB_VERB "%6.3" "" COMPU_TAB_REF HIPSYS_HIPPMPPLAUSDGNSTYP_SC_Compu /end COMPU_METHOD
/begin COMPU_VTAB HIPSYS_HIPPMPPLAUSDGNSTYP_SC_Compu "" TAB_VERB 3 0 "NONE" 1 "DHDRPP" 2 "HiPSys_HiPPmpPlaus" /end COMPU_VTAB
/begin COMPU_METHOD HIPSYS_LIMPLIMNPHDRMIN_SC_Compu "" TAB_VERB "%6.3" "" COMPU_TAB_REF HIPSYS_LIMPLIMNPHDRMIN_SC_Compu /end COMPU_METHOD
/begin COMPU_VTAB HIPSYS_LIMPLIMNPHDRMIN_SC_Compu "" TAB_VERB 2 0 "False" 1 "True" /end COMPU_VTAB
/begin COMPU_METHOD HIPSYS_LIMPLOPHDRKHMIN_SC_Compu "" TAB_VERB "%6.3" "" COMPU_TAB_REF HIPSYS_LIMPLOPHDRKHMIN_SC_Compu /end COMPU_METHOD
/begin COMPU_VTAB HIPSYS_LIMPLOPHDRKHMIN_SC_Compu "" TAB_VERB 2 0 "False" 1 "True" /end COMPU_VTAB
/begin COMPU_METHOD HIPSYS_LIMPLOPHDRMIN_SC_Compu "" TAB_VERB "%6.3" "" COMPU_TAB_REF HIPSYS_LIMPLOPHDRMIN_SC_Compu /end COMPU_METHOD
/begin COMPU_VTAB HIPSYS_LIMPLOPHDRMIN_SC_Compu "" TAB_VERB 2 0 "False" 1 "True" /end COMPU_VTAB
/begin COMPU_METHOD HIREDNSTGGEARINTERTHR_SC_Compu "" TAB_VERB "%6.3" "" COMPU_TAB_REF HIREDNSTGGEARINTERTHR_SC_Compu /end COMPU_METHOD
/begin COMPU_VTAB HIREDNSTGGEARINTERTHR_SC_Compu "" TAB_VERB 2 0 "False" 1 "True" /end COMPU_VTAB
/begin COMPU_METHOD HLN_SY_Compu "" TAB_VERB "%6.3" "" COMPU_TAB_REF HLN_SY_Compu /end COMPU_METHOD
/begin COMPU_VTAB HLN_SY_Compu "" TAB_VERB 2 0 "False" 1 "True" /end COMPU_VTAB
/begin COMPU_METHOD HLSDEMERR1_SY_Compu "" TAB_VERB "%6.3" "" COMPU_TAB_REF HLSDEMERR1_SY_Compu /end COMPU_METHOD
/begin COMPU_VTAB HLSDEMERR1_SY_Compu "" TAB_VERB 2 0 "False" 1 "True" /end COMPU_VTAB
/begin COMPU_METHOD HLSDEMERR2_SY_Compu "" TAB_VERB "%6.3" "" COMPU_TAB_REF HLSDEMERR2_SY_Compu /end COMPU_METHOD
/begin COMPU_VTAB HLSDEMERR2_SY_Compu "" TAB_VERB 2 0 "False" 1 "True" /end COMPU_VTAB
/begin COMPU_METHOD HLSDEM_DRVOFFSUPRTENA_SC_Compu "" TAB_VERB "%6.3" "" COMPU_TAB_REF HLSDEM_DRVOFFSUPRTENA_SC_Compu /end COMPU_METHOD
/begin COMPU_VTAB HLSDEM_DRVOFFSUPRTENA_SC_Compu "" TAB_VERB 2 0 "False" 1 "True" /end COMPU_VTAB
/begin COMPU_METHOD HLSDEM_GEARLIM_SY_Compu "" TAB_VERB "%6.3" "" COMPU_TAB_REF HLSDEM_GEARLIM_SY_Compu /end COMPU_METHOD
/begin COMPU_VTAB HLSDEM_GEARLIM_SY_Compu "" TAB_VERB 2 0 "False" 1 "True" /end COMPU_VTAB
/begin COMPU_METHOD HLSDEM_INHOUSE_SC_Compu "" TAB_VERB "%6.3" "" COMPU_TAB_REF HLSDEM_INHOUSE_SC_Compu /end COMPU_METHOD
/begin COMPU_VTAB HLSDEM_INHOUSE_SC_Compu "" TAB_VERB 2 0 "False" 1 "True" /end COMPU_VTAB
/begin COMPU_METHOD HLSDEM_NMINWOTRAINTV_SY_Compu "" TAB_VERB "%6.3" "" COMPU_TAB_REF HLSDEM_NMINWOTRAINTV_SY_Compu /end COMPU_METHOD
/begin COMPU_VTAB HLSDEM_NMINWOTRAINTV_SY_Compu "" TAB_VERB 2 0 "0" 1 "1" /end COMPU_VTAB
/begin COMPU_METHOD HLSMON_NRPNTSTENG_SC_Compu "" RAT_FUNC "%6.2" "" COEFFS 0 1 0 0 0 1 /end COMPU_METHOD
/begin COMPU_METHOD HPDIFF_TYPAVL_SC_Compu "" TAB_VERB "%6.3" "" COMPU_TAB_REF HPDIFF_TYPAVL_SC_Compu /end COMPU_METHOD
/begin COMPU_VTAB HPDIFF_TYPAVL_SC_Compu "" TAB_VERB 2 0 "False" 1 "True" /end COMPU_VTAB
/begin COMPU_METHOD HPIN_TYPAVL_SC_Compu "" TAB_VERB "%6.3" "" COMPU_TAB_REF HPIN_TYPAVL_SC_Compu /end COMPU_METHOD
/begin COMPU_VTAB HPIN_TYPAVL_SC_Compu "" TAB_VERB 2 0 "False" 1 "True" /end COMPU_VTAB
/begin COMPU_METHOD HPOUTPRR_TYPAVL_SY_Compu "" TAB_VERB "%6.3" "" COMPU_TAB_REF HPOUTPRR_TYPAVL_SY_Compu /end COMPU_METHOD
/begin COMPU_VTAB HPOUTPRR_TYPAVL_SY_Compu "" TAB_VERB 2 0 "False" 1 "True" /end COMPU_VTAB
/begin COMPU_METHOD HTIN_TYPAVL_SC_Compu "" TAB_VERB "%6.3" "" COMPU_TAB_REF HTIN_TYPAVL_SC_Compu /end COMPU_METHOD
/begin COMPU_VTAB HTIN_TYPAVL_SC_Compu "" TAB_VERB 2 0 "False" 1 "True" /end COMPU_VTAB
/begin COMPU_METHOD HTOUT_TYPAVL_SC_Compu "" TAB_VERB "%6.3" "" COMPU_TAB_REF HTOUT_TYPAVL_SC_Compu /end COMPU_METHOD
/begin COMPU_VTAB HTOUT_TYPAVL_SC_Compu "" TAB_VERB 2 0 "False" 1 "True" /end COMPU_VTAB
/begin COMPU_METHOD HumEnvSnsrUsd_SC_Compu "" TAB_VERB "%6.3" "" COMPU_TAB_REF HumEnvSnsrUsd_SC_Compu /end COMPU_METHOD
/begin COMPU_VTAB HumEnvSnsrUsd_SC_Compu "" TAB_VERB 5 0 "No Sensor used" 1 "Bosch_PWM" 2 "Hitachi_PWM" 3 "Bosch_SENT" 4 "Bosch_LIN" /end COMPU_VTAB
/begin COMPU_METHOD HVACHEATPMPP_TYPAVL_SC_Compu "" TAB_VERB "%6.3" "" COMPU_TAB_REF HVACHEATPMPP_TYPAVL_SC_Compu /end COMPU_METHOD
/begin COMPU_VTAB HVACHEATPMPP_TYPAVL_SC_Compu "" TAB_VERB 2 0 "False" 1 "True" /end COMPU_VTAB
/begin COMPU_METHOD HVACHEATPMPT_TYPAVL_SC_Compu "" TAB_VERB "%6.3" "" COMPU_TAB_REF HVACHEATPMPT_TYPAVL_SC_Compu /end COMPU_METHOD
/begin COMPU_VTAB HVACHEATPMPT_TYPAVL_SC_Compu "" TAB_VERB 2 0 "False" 1 "True" /end COMPU_VTAB
/begin COMPU_METHOD HWDPD_SC_Compu "" TAB_VERB "%6.3" "" COMPU_TAB_REF HWDPD_SC_Compu /end COMPU_METHOD
/begin COMPU_VTAB HWDPD_SC_Compu "" TAB_VERB 3 0 "HWDPD_NEUT" 1 "HWDPD_SWNOTSEL" 2 "HWDPD_SWSEL" /end COMPU_VTAB
/begin COMPU_METHOD HYBADDLELECAXLE_SC_Compu "" TAB_VERB "%6.3" "" COMPU_TAB_REF HYBADDLELECAXLE_SC_Compu /end COMPU_METHOD
/begin COMPU_VTAB HYBADDLELECAXLE_SC_Compu "" TAB_VERB 2 0 "NOADDLELACAXLE" 1 "ADDLELECAXLE" /end COMPU_VTAB
/begin COMPU_METHOD I15031EXTD_CVNALGCUST_SC_Compu "" TAB_VERB "%6.3" "" COMPU_TAB_REF I15031EXTD_CVNALGCUST_SC_Compu /end COMPU_METHOD
/begin COMPU_VTAB I15031EXTD_CVNALGCUST_SC_Compu "" TAB_VERB 2 0 "PLATFORM" 1 "HONDA" /end COMPU_VTAB
/begin COMPU_METHOD I15031SRV9VT_SC_Compu "" TAB_VERB "%6.3" "" COMPU_TAB_REF I15031SRV9VT_SC_Compu /end COMPU_METHOD
/begin COMPU_VTAB I15031SRV9VT_SC_Compu "" TAB_VERB 2 0 "VT_disabled" 1 "VT_enabled" /end COMPU_VTAB
/begin COMPU_METHOD I15031_CVNALG_SC_Compu "" TAB_VERB "%6.3" "" COMPU_TAB_REF I15031_CVNALG_SC_Compu /end COMPU_METHOD
/begin COMPU_VTAB I15031_CVNALG_SC_Compu "" TAB_VERB 4 1 "CVN_ALG_CRC32_DIABAS" 2 "CVN_ALG_CRC32_SECULIBS" 3 "CVN_ALG_SHA256_BCL" 4 "CVN_ALG_SHA256_HSM" /end COMPU_VTAB
/begin COMPU_METHOD I15031_EXTCVNSTORGBHVR_SC_Compu "" TAB_VERB "%6.3" "" COMPU_TAB_REF I15031_EXTCVNSTORGBHVR_SC_Compu /end COMPU_METHOD
/begin COMPU_VTAB I15031_EXTCVNSTORGBHVR_SC_Compu "" TAB_VERB 2 1 "PSTDRV" 2 "RAS1s" /end COMPU_VTAB
/begin COMPU_METHOD I15031_OBD_CNTL_SC_Compu "" TAB_VERB "%6.3" "" COMPU_TAB_REF I15031_OBD_CNTL_SC_Compu /end COMPU_METHOD
/begin COMPU_VTAB I15031_OBD_CNTL_SC_Compu "" TAB_VERB 4 0 "I15031_ACTIVE" 1 "I15031_SRV_ADJUST" 2 "I15031_INACTIVE" 3 "I15031_NOT_EXISTING" /end COMPU_VTAB
/begin COMPU_METHOD I15031_SRV8_SY_Compu "" TAB_VERB "%6.3" "" COMPU_TAB_REF I15031_SRV8_SY_Compu /end COMPU_METHOD
/begin COMPU_VTAB I15031_SRV8_SY_Compu "" TAB_VERB 2 0 "0" 1 "1" /end COMPU_VTAB
/begin COMPU_METHOD I15031_SRV9AES_SC_Compu "" TAB_VERB "%6.3" "" COMPU_TAB_REF I15031_SRV9AES_SC_Compu /end COMPU_METHOD
/begin COMPU_VTAB I15031_SRV9AES_SC_Compu "" TAB_VERB 2 0 "False" 1 "True" /end COMPU_VTAB
/begin COMPU_METHOD I27145_SC_Compu "" TAB_VERB "%6.3" "" COMPU_TAB_REF I27145_SC_Compu /end COMPU_METHOD
/begin COMPU_VTAB I27145_SC_Compu "" TAB_VERB 2 0 "False" 1 "True" /end COMPU_VTAB
/begin COMPU_METHOD IDLESPDADJMTDRVPROG_SC_Compu "" TAB_VERB "%6.3" "" COMPU_TAB_REF IDLESPDADJMTDRVPROG_SC_Compu /end COMPU_METHOD
/begin COMPU_VTAB IDLESPDADJMTDRVPROG_SC_Compu "" TAB_VERB 3 0 "No_adjmnt" 1 "Drvgmode" 2 "DrvgFildgAdjmnt" /end COMPU_VTAB
/begin COMPU_METHOD IDLSHTDWN_SY_Compu "" TAB_VERB "%6.3" "" COMPU_TAB_REF IDLSHTDWN_SY_Compu /end COMPU_METHOD
/begin COMPU_VTAB IDLSHTDWN_SY_Compu "" TAB_VERB 2 0 "False" 1 "True" /end COMPU_VTAB
/begin COMPU_METHOD IGCSELN_SC_Compu "" TAB_VERB "%6.3" "" COMPU_TAB_REF IGCSELN_SC_Compu /end COMPU_METHOD
/begin COMPU_VTAB IGCSELN_SC_Compu "" TAB_VERB 4 0 "Not_Avl" 1 "FirstGenn_BOSCH" 2 "SecondGenn_BOSCH" 3 "ThirdGenn_BOSCH" /end COMPU_VTAB
/begin COMPU_METHOD lu_MEx "" RAT_FUNC "%6.4" "(Umdr./sec)^2" COEFFS 0 140.7374884 0 0 0 1 /end COMPU_METHOD
/begin COMPU_METHOD mgrad_q1_mgdivs "" RAT_FUNC "%6.2" "mg/s" COEFFS 0 1 0 0 0 1 /end COMPU_METHOD
/begin COMPU_METHOD mgrd_q2p7126_mg_DIV_s2 "" RAT_FUNC "%6.2" "mg/s2" COEFFS 0 589824 0 0 0 1600000 /end COMPU_METHOD
/begin COMPU_METHOD m_q0p0005 "" RAT_FUNC "%6.5" "kg/(h*%)" COEFFS 0 1 0 0 0 0.0005 /end COMPU_METHOD
/begin COMPU_METHOD m_q0p032_g "" RAT_FUNC "%6.4" "g" COEFFS 0 1 0 0 0 0.032 /end COMPU_METHOD
/begin COMPU_METHOD m_q0p04096 "" RAT_FUNC "%6.4" "g" COEFFS 0 1 0 0 0 0.04096 /end COMPU_METHOD
/begin COMPU_METHOD m_q0p2170 "" RAT_FUNC "%6.3" "mg/s" COEFFS 0 9216 0 0 0 2000 /end COMPU_METHOD
/begin COMPU_METHOD m_q4_kg_DIV_h "" RAT_FUNC "%6.2" "kg/h" COEFFS 0 1 0 0 0 4 /end COMPU_METHOD
/begin COMPU_METHOD m_uw_b23p3 "" RAT_FUNC "%6.5" "kg" COEFFS 0 2812.5 0 0 0 1 /end COMPU_METHOD
/begin COMPU_METHOD m_uw_b6553p5 "" RAT_FUNC "%6.3" "kg/h" COEFFS 0 1 0 0 0 0.1 /end COMPU_METHOD
/begin COMPU_METHOD nmot_q0p5 "" RAT_FUNC "%6.3" "1/min" COEFFS 0 2 0 0 0 1 /end COMPU_METHOD
/begin COMPU_METHOD nmot_ub_q40 "" RAT_FUNC "%6.1" "1/min" COEFFS 0 1 0 0 0 40 /end COMPU_METHOD
/begin COMPU_METHOD nmot_uw_q0p25 "" RAT_FUNC "%6.3" "1/min" COEFFS 0 1 0 0 0 0.25 /end COMPU_METHOD
/begin COMPU_METHOD OneToOne "" RAT_FUNC "%6.2" "-" COEFFS 0 1 0 0 0 1 /end COMPU_METHOD
/begin COMPU_METHOD Prc "" RAT_FUNC "%6.4" "%" COEFFS 0 81.92 0 0 0 1 /end COMPU_METHOD
/begin COMPU_METHOD Pres_hPa "" RAT_FUNC "%6.2" "hPa" COEFFS 0 1 0 0 0 1 /end COMPU_METHOD
/begin COMPU_METHOD Pwr_10kW_Sec "" RAT_FUNC "%6.3" "kW/s" COEFFS 0 10 0 0 0 1 /end COMPU_METHOD
/begin COMPU_METHOD Pwr_kW "" RAT_FUNC "%6.4" "kW" COEFFS 0 100 0 0 0 1 /end COMPU_METHOD
/begin COMPU_METHOD P_hPa_q0p078125_COMPU "" RAT_FUNC "%6.4" "hPa" COEFFS 0 12.8 0 0 0 1 /end COMPU_METHOD
/begin COMPU_METHOD p_q0p039 "" RAT_FUNC "%6.4" "hPa" COEFFS 0 256 0 0 0 10 /end COMPU_METHOD
/begin COMPU_METHOD p_q0p078 "" RAT_FUNC "%6.4" "hPa" COEFFS 0 64 0 0 0 5 /end COMPU_METHOD
/begin COMPU_METHOD p_sw_q0p078 "" RAT_FUNC "%6.4" "hPa" COEFFS 0 65536 0 0 0 5120 /end COMPU_METHOD
/begin COMPU_METHOD rel_q0p00152 "" RAT_FUNC "%6.4" "%/s" COEFFS 0 65536 0 0 0 100 /end COMPU_METHOD
/begin COMPU_METHOD rel_q0p02344 "" RAT_FUNC "%6.4" "%" COEFFS 0 32 0 0 0 0.75 /end COMPU_METHOD
/begin COMPU_METHOD rel_q0p046875 "" RAT_FUNC "%6.4" "%" COEFFS 0 65536 0 0 0 3072 /end COMPU_METHOD
/begin COMPU_METHOD rel_sw_b100 "" RAT_FUNC "%6.4" "%" COEFFS 0 32768 0 0 0 100 /end COMPU_METHOD
/begin COMPU_METHOD rel_sw_b1536 "" RAT_FUNC "%6.4" "%" COEFFS 0 65536 0 0 0 3072 /end COMPU_METHOD
/begin COMPU_METHOD rel_uw_b100 "" RAT_FUNC "%6.4" "%" COEFFS 0 65536 0 0 0 100 /end COMPU_METHOD
/begin COMPU_METHOD STRTEND_NENGCRIT_SET_COMPU_VERB "" TAB_VERB "%6.3" "-" COMPU_TAB_REF STRTEND_NENGCRIT_SET_COMPU_VERB /end COMPU_METHOD
/begin COMPU_VTAB STRTEND_NENGCRIT_SET_COMPU_VERB "" TAB_VERB 1 0 "NENGCRIT" /end COMPU_VTAB
/begin COMPU_METHOD STRTEND_NENGDEB_SET_COMPU_VERB "" TAB_VERB "%6.3" "-" COMPU_TAB_REF STRTEND_NENGDEB_SET_COMPU_VERB /end COMPU_METHOD
/begin COMPU_VTAB STRTEND_NENGDEB_SET_COMPU_VERB "" TAB_VERB 1 0 "NENGDEB" /end COMPU_VTAB
/begin COMPU_METHOD STRTEND_NENGNRINJ_SET_COMPU_VERB "" TAB_VERB "%6.3" "-" COMPU_TAB_REF STRTEND_NENGNRINJ_SET_COMPU_VERB /end COMPU_METHOD
/begin COMPU_VTAB STRTEND_NENGNRINJ_SET_COMPU_VERB "" TAB_VERB 2 0 "NENGNRINJ" 1 "NENGNRINJ_FOLW" /end COMPU_VTAB
/begin COMPU_METHOD STRTEND_NENG_SET_COMPU_VERB "" TAB_VERB "%6.3" "-" COMPU_TAB_REF STRTEND_NENG_SET_COMPU_VERB /end COMPU_METHOD
/begin COMPU_VTAB STRTEND_NENG_SET_COMPU_VERB "" TAB_VERB 4 0 "NENG" 1 "NENG_FOLW" 2 "NENG_COM" 3 "NENG_EOL" /end COMPU_VTAB
/begin COMPU_METHOD t100msxs_uw_b6553p5 "" RAT_FUNC "%6.3" "s" COEFFS 0 1 0 0 0 0.1 /end COMPU_METHOD
/begin COMPU_METHOD t10msxs_ub_q0p01 "" RAT_FUNC "%6.4" "s" COEFFS 0 1 0 0 0 0.01 /end COMPU_METHOD
/begin COMPU_METHOD t10msxs_uw_b655p35 "" RAT_FUNC "%6.4" "s" COEFFS 0 1 0 0 0 0.01 /end COMPU_METHOD
/begin COMPU_METHOD TempDiff_Kelv "" RAT_FUNC "%6.3" "K" COEFFS 0 10 0 0 0 1 /end COMPU_METHOD
/begin COMPU_METHOD Temp_Cels "" RAT_FUNC "%6.1" "deg C" COEFFS 0 10 2731.4 0 0 1 /end COMPU_METHOD
/begin COMPU_METHOD Temp_Kelv "" RAT_FUNC "%6.3" "K" COEFFS 0 10 0 0 0 1 /end COMPU_METHOD
/begin COMPU_METHOD temp_ub_b191p25 "" RAT_FUNC "%6.3" "Grad C" COEFFS 0 1 0 0 0 0.75 /end COMPU_METHOD
/begin COMPU_METHOD temp_ub_q0p75_o48 "" RAT_FUNC "%6.2" "Grad C" COEFFS 0 1 48 0 0 0.75 /end COMPU_METHOD
/begin COMPU_METHOD temp_uw_q0p75_o48 "" RAT_FUNC "%6.2" "Grad C" COEFFS 0 1 48 0 0 0.75 /end COMPU_METHOD
/begin COMPU_METHOD TimeRed "" RAT_FUNC "%6.3" "s" COEFFS 0 6.25 0 0 0 1 /end COMPU_METHOD
/begin COMPU_METHOD Time_Dt "" RAT_FUNC "%9.8" "s" COEFFS 0 1000000 0 0 0 1 /end COMPU_METHOD
/begin COMPU_METHOD Time_sec_q1_COMPU "" RAT_FUNC "%6.2" "s" COEFFS 0 1 0 0 0 1 /end COMPU_METHOD
/begin COMPU_METHOD ti_s_q0p01_COMPU "" RAT_FUNC "%6.4" "s" COEFFS 0 100 0 0 0 1 /end COMPU_METHOD
/begin COMPU_METHOD Trq "" RAT_FUNC "%6.3" "Nm" COEFFS 0 10 0 0 0 1 /end COMPU_METHOD
/begin COMPU_METHOD TrqPerSec "" RAT_FUNC "%6.2" "Nm/s" COEFFS 0 1 0 0 0 1 /end COMPU_METHOD
/begin COMPU_METHOD t_q0p001_ms "" RAT_FUNC "%6.5" "ms" COEFFS 0 1 0 0 0 0.001 /end COMPU_METHOD
/begin COMPU_METHOD t_q0p01 "" RAT_FUNC "%6.4" "s" COEFFS 0 100 0 0 0 1 /end COMPU_METHOD
/begin COMPU_METHOD t_q0p02 "" RAT_FUNC "%6.4" "s" COEFFS 0 100 0 0 0 2 /end COMPU_METHOD
/begin COMPU_METHOD t_q0p1 "" RAT_FUNC "%6.3" "s" COEFFS 0 10 0 0 0 1 /end COMPU_METHOD
/begin COMPU_METHOD t_q0p2 "" RAT_FUNC "%6.3" "s" COEFFS 0 10 0 0 0 2 /end COMPU_METHOD
/begin COMPU_METHOD t_q1 "" RAT_FUNC "%6.2" "s" COEFFS 0 1 0 0 0 1 /end COMPU_METHOD
/begin COMPU_METHOD Vel "" RAT_FUNC "%6.4" "km/h" COEFFS 0 100 0 0 0 1 /end COMPU_METHOD
/begin COMPU_METHOD vfzg_uw_b512 "" RAT_FUNC "%6.4" "km/h" COEFFS 0 65536 0 0 0 512 /end COMPU_METHOD
/begin COMPU_METHOD zk100msxs_uw_b6553p6 "" RAT_FUNC "%6.1" "s" COEFFS 0 0 65536 0 10 0 /end COMPU_METHOD
/begin COMPU_METHOD zk20msxs_uw_b1310p72 "" RAT_FUNC "%6.1" "s" COEFFS 0 0 65536 0 50 0 /end COMPU_METHOD
/begin RECORD_LAYOUT RB_Axis_S16 NO_AXIS_PTS_X 1 SWORD AXIS_PTS_X 2 SWORD INDEX_INCR DIRECT /end RECORD_LAYOUT
/begin RECORD_LAYOUT RB_Axis_U16 NO_AXIS_PTS_X 1 UWORD AXIS_PTS_X 2 UWORD INDEX_INCR DIRECT /end RECORD_LAYOUT
/begin RECORD_LAYOUT RB_CurveGroup_S16 FNC_VALUES 1 SWORD COLUMN_DIR DIRECT /end RECORD_LAYOUT
/begin RECORD_LAYOUT RB_CurveGroup_U16 FNC_VALUES 1 UWORD COLUMN_DIR DIRECT /end RECORD_LAYOUT
/begin RECORD_LAYOUT RB_CurveGroup_U8 FNC_VALUES 1 UBYTE COLUMN_DIR DIRECT /end RECORD_LAYOUT
/begin RECORD_LAYOUT RB_Curve_S16_R32_Static NO_AXIS_PTS_X 1 SWORD AXIS_PTS_X 2 SWORD INDEX_INCR DIRECT FNC_VALUES 3 FLOAT32_IEEE COLUMN_DIR DIRECT STATIC_RECORD_LAYOUT /end RECORD_LAYOUT
/begin RECORD_LAYOUT RB_Curve_S16_S16 NO_AXIS_PTS_X 1 SWORD AXIS_PTS_X 2 SWORD INDEX_INCR DIRECT FNC_VALUES 3 SWORD COLUMN_DIR DIRECT /end RECORD_LAYOUT
/begin RECORD_LAYOUT RB_Curve_S16_S8_Static NO_AXIS_PTS_X 1 SWORD AXIS_PTS_X 2 SWORD INDEX_INCR DIRECT FNC_VALUES 3 SBYTE COLUMN_DIR DIRECT STATIC_RECORD_LAYOUT /end RECORD_LAYOUT
/begin RECORD_LAYOUT RB_Curve_S16_U16_Static NO_AXIS_PTS_X 1 SWORD AXIS_PTS_X 2 SWORD INDEX_INCR DIRECT FNC_VALUES 3 UWORD COLUMN_DIR DIRECT STATIC_RECORD_LAYOUT /end RECORD_LAYOUT
/begin RECORD_LAYOUT RB_Curve_S16_U8_Static NO_AXIS_PTS_X 1 SWORD AXIS_PTS_X 2 SWORD INDEX_INCR DIRECT FNC_VALUES 3 UBYTE COLUMN_DIR DIRECT STATIC_RECORD_LAYOUT /end RECORD_LAYOUT
/begin RECORD_LAYOUT RB_Curve_S8_U8_Static NO_AXIS_PTS_X 1 SBYTE AXIS_PTS_X 2 SBYTE INDEX_INCR DIRECT FNC_VALUES 3 UBYTE COLUMN_DIR DIRECT STATIC_RECORD_LAYOUT /end RECORD_LAYOUT
/begin RECORD_LAYOUT RB_Curve_U16_S16_Static NO_AXIS_PTS_X 1 UWORD AXIS_PTS_X 2 UWORD INDEX_INCR DIRECT FNC_VALUES 3 SWORD COLUMN_DIR DIRECT STATIC_RECORD_LAYOUT /end RECORD_LAYOUT
/begin RECORD_LAYOUT RB_Curve_U16_U16 NO_AXIS_PTS_X 1 UWORD AXIS_PTS_X 2 UWORD INDEX_INCR DIRECT FNC_VALUES 3 UWORD COLUMN_DIR DIRECT /end RECORD_LAYOUT
/begin RECORD_LAYOUT RB_Curve_U16_U8_Static NO_AXIS_PTS_X 1 UWORD AXIS_PTS_X 2 UWORD INDEX_INCR DIRECT FNC_VALUES 3 UBYTE COLUMN_DIR DIRECT STATIC_RECORD_LAYOUT /end RECORD_LAYOUT
/begin RECORD_LAYOUT RB_Curve_U8_S16_Static NO_AXIS_PTS_X 1 UBYTE AXIS_PTS_X 2 UBYTE INDEX_INCR DIRECT FNC_VALUES 3 SWORD COLUMN_DIR DIRECT STATIC_RECORD_LAYOUT /end RECORD_LAYOUT
/begin RECORD_LAYOUT RB_Curve_U8_U16_Static NO_AXIS_PTS_X 1 UBYTE AXIS_PTS_X 2 UBYTE INDEX_INCR DIRECT FNC_VALUES 3 UWORD COLUMN_DIR DIRECT STATIC_RECORD_LAYOUT /end RECORD_LAYOUT
/begin RECORD_LAYOUT RB_Curve_U8_U8 NO_AXIS_PTS_X 1 UBYTE AXIS_PTS_X 2 UBYTE INDEX_INCR DIRECT FNC_VALUES 3 UBYTE COLUMN_DIR DIRECT /end RECORD_LAYOUT
/begin RECORD_LAYOUT RB_MapGroup_S16 FNC_VALUES 1 SWORD COLUMN_DIR DIRECT /end RECORD_LAYOUT
/begin RECORD_LAYOUT RB_MapGroup_U16 FNC_VALUES 1 UWORD COLUMN_DIR DIRECT /end RECORD_LAYOUT
/begin RECORD_LAYOUT RB_Map_S16S16_S16 NO_AXIS_PTS_X 1 SWORD NO_AXIS_PTS_Y 2 SWORD AXIS_PTS_X 3 SWORD INDEX_INCR DIRECT AXIS_PTS_Y 4 SWORD INDEX_INCR DIRECT FNC_VALUES 5 SWORD COLUMN_DIR DIRECT /end RECORD_LAYOUT
/begin RECORD_LAYOUT RB_Map_S16S16_U8 NO_AXIS_PTS_X 1 SWORD NO_AXIS_PTS_Y 2 SWORD AXIS_PTS_X 3 SWORD INDEX_INCR DIRECT AXIS_PTS_Y 4 SWORD INDEX_INCR DIRECT FNC_VALUES 5 UBYTE COLUMN_DIR DIRECT /end RECORD_LAYOUT
/begin RECORD_LAYOUT RB_Map_U16S16_S16 NO_AXIS_PTS_X 1 UWORD NO_AXIS_PTS_Y 2 UWORD AXIS_PTS_X 3 UWORD INDEX_INCR DIRECT AXIS_PTS_Y 4 SWORD INDEX_INCR DIRECT FNC_VALUES 5 SWORD COLUMN_DIR DIRECT /end RECORD_LAYOUT
/begin RECORD_LAYOUT RB_Map_U16U16_U16 NO_AXIS_PTS_X 1 UWORD NO_AXIS_PTS_Y 2 UWORD AXIS_PTS_X 3 UWORD INDEX_INCR DIRECT AXIS_PTS_Y 4 UWORD INDEX_INCR DIRECT FNC_VALUES 5 UWORD COLUMN_DIR DIRECT /end RECORD_LAYOUT
/begin RECORD_LAYOUT RB_Map_U8U16_U8 NO_AXIS_PTS_X 1 UBYTE NO_AXIS_PTS_Y 2 UBYTE AXIS_PTS_X 3 UBYTE INDEX_INCR DIRECT AXIS_PTS_Y 4 UWORD INDEX_INCR DIRECT FNC_VALUES 5 UBYTE ROW_DIR DIRECT /end RECORD_LAYOUT
/begin RECORD_LAYOUT RB_Map_U8U8_U8 NO_AXIS_PTS_X 1 UBYTE NO_AXIS_PTS_Y 2 UBYTE AXIS_PTS_X 3 UBYTE INDEX_INCR DIRECT AXIS_PTS_Y 4 UBYTE INDEX_INCR DIRECT FNC_VALUES 5 UBYTE COLUMN_DIR DIRECT /end RECORD_LAYOUT
/begin RECORD_LAYOUT RB_ValA_Wu16 FNC_VALUES 1 UWORD COLUMN_DIR DIRECT /end RECORD_LAYOUT
/begin RECORD_LAYOUT RB_ValA_Wu8 FNC_VALUES 1 UBYTE COLUMN_DIR DIRECT /end RECORD_LAYOUT
/begin RECORD_LAYOUT RB_Val_Ws16 FNC_VALUES 1 SWORD COLUMN_DIR DIRECT /end RECORD_LAYOUT
/begin RECORD_LAYOUT RB_Val_Ws32 FNC_VALUES 1 SLONG COLUMN_DIR DIRECT /end RECORD_LAYOUT
/begin RECORD_LAYOUT RB_Val_Wu16 FNC_VALUES 1 UWORD COLUMN_DIR DIRECT /end RECORD_LAYOUT
/begin RECORD_LAYOUT RB_Val_Wu32 FNC_VALUES 1 ULONG COLUMN_DIR DIRECT /end RECORD_LAYOUT
/begin RECORD_LAYOUT RB_Val_Wu8 FNC_VALUES 1 UBYTE COLUMN_DIR DIRECT /end RECORD_LAYOUT
/begin RECORD_LAYOUT Val_Ws16 FNC_VALUES 1 SWORD COLUMN_DIR DIRECT /end RECORD_LAYOUT
/begin RECORD_LAYOUT Val_Wu16 FNC_VALUES 1 UWORD COLUMN_DIR DIRECT /end RECORD_LAYOUT
/end MODULE
/end PROJECT
