ASAP2_VERSION 1 60
/begin PROJECT MG1CS022 "MG1CS022"
/begin HEADER "" VERSION "MG1CS022_62XSC_V037_TPROT" PROJECT_NO MG1CS022 /end HEADER
/begin MODULE DIM ""
/begin MOD_COMMON "" BYTE_ORDER MSB_LAST ALIGNMENT_BYTE 1 ALIGNMENT_WORD 2 ALIGNMENT_LONG 4 ALIGNMENT_INT64 4 ALIGNMENT_FLOAT32_IEEE 4 ALIGNMENT_FLOAT64_IEEE 4 DATA_SIZE 32 /end MOD_COMMON
/begin CHARACTERISTIC CWKUPPL "Code word for clutch" VALUE 0x805711C8 RB_Val_Wu8 255.0 dez 0.00 255.0 FORMAT "%5.1" /end CHARACTERISTIC
/begin CHARACTERISTIC CWLLRMR "Code word for the configuration of torque reserve in engine speed control" VALUE 0x805711C9 RB_Val_Wu8 255.0 dez 0.00 255.0 FORMAT "%5.1" /end CHARACTERISTIC
/begin CHARACTERISTIC CWLLRMR2 "Code word for the configuration of torque reserve in engine speed control" VALUE 0x805711CA RB_Val_Wu8 255.0 dez 0.00 255.0 FORMAT "%5.1" /end CHARACTERISTIC
/begin CHARACTERISTIC CWLLRNSNF "Codeword %LLRNSNF" VALUE 0x80571A38 RB_Val_Wu8 255.0 dez 0.00 255.0 FORMAT "%5.1" /end CHARACTERISTIC
/begin CHARACTERISTIC DMRESHH "Reduction rate for increased torque reserve during rear window heating" VALUE 0x805711CB RB_Val_Wu8 0.3891 rel_q0p00153 0.00 0.3891 /end CHARACTERISTIC
/begin CHARACTERISTIC DMRESLLDOWN "Torque reserve parameter for reduction in torque reserve raised just after engine speed undershoot" VALUE 0x805711CC RB_Val_Wu8 0.3891 rel_q0p00153 0.00 0.3891 /end CHARACTERISTIC
/begin CHARACTERISTIC DMRESLLUP "Engine speed control: Increase rate for torque reserve" VALUE 0x805711CD RB_Val_Wu8 0.3891 rel_q0p00153 0.00 0.3891 /end CHARACTERISTIC
/begin CHARACTERISTIC DMRESUB "Increment to reduce the torque reserve for undervoltage" VALUE 0x805711CE RB_Val_Wu8 0.3891 rel_q0p00153 0.00 0.3891 /end CHARACTERISTIC
/begin CHARACTERISTIC DNLLRESW "Engine speed control: Threshold for the engine speed deviation for increasing the torque reserve" VALUE 0x805711D0 RB_Val_Ws16 16383.75 nmot_sw_q0p25 -8192.000 8191.750 FORMAT "%8.3" /end CHARACTERISTIC
/begin CHARACTERISTIC DNNSNF "threshold for dns to deactivate speed tracking" VALUE 0x80571A3A RB_Val_Ws16 16383.50 nmot_sw_q0p5 0.00 16383.50 FORMAT "%8.2" EXTENDED_LIMITS -16384.00 16383.50 /end CHARACTERISTIC
/begin CHARACTERISTIC DNSNFFAST "speed threshold of nsol-limitation at ECO fast start" VALUE 0x80571A3C RB_Val_Ws16 32767.50 nmot_sw_q0p5 -16384.00 16383.50 FORMAT "%8.2" /end CHARACTERISTIC
/begin CHARACTERISTIC DNSNFNORM "speed threshold of nsol-limitation at ECO normal start" VALUE 0x80571A3E RB_Val_Ws16 32767.50 nmot_sw_q0p5 -16384.00 16383.50 FORMAT "%8.2" /end CHARACTERISTIC
/begin CHARACTERISTIC DNSNFX_W "Offset to determine the upper limit of target speed" VALUE 0x80571A40 RB_Val_Ws16 16383.50 nmot_sw_q0p5 0.00 16383.50 FORMAT "%8.2" EXTENDED_LIMITS -16384.00 16383.50 /end CHARACTERISTIC
/begin CHARACTERISTIC DUBATG "Limit for torque reserve at battery voltage undershoot." VALUE 0x805711D2 RB_Val_Wu16 25.59961 spg_q0p00039 0.00 25.59961 FORMAT "%8.5" /end CHARACTERISTIC
/begin CHARACTERISTIC DUBSUBQ "Increment to reduce the torque reserve for undervoltage" VALUE 0x805711D4 RB_Val_Wu16 25.59961 spg_q0p00039 0.00 25.59961 FORMAT "%8.5" /end CHARACTERISTIC
/begin CHARACTERISTIC FNSNF "factor for desired engine-speed correction" VALUE 0x80571A42 RB_Val_Wu8 0.9961 fak_ub_b1 0.00 0.9961 /end CHARACTERISTIC
/begin CHARACTERISTIC FNSSTKM "Factor to weight the desired speed at start during catalyst heating" CURVE 0x80571A44 RB_CurveGroup_U16 1.992188 fak_ub_b2 0.00 1.992188 FORMAT "%8.6" EXTENDED_LIMITS 0.00 511.9922
 /begin AXIS_DESCR COM_AXIS llrnsnf_stm06llublLoc temp_ub_q0p75_o48 6 -48.0 143.3 FORMAT "%5.1" AXIS_PTS_REF STM06LLUBL /end AXIS_DESCR
/end CHARACTERISTIC
/begin CHARACTERISTIC FNSSTM "Factor for target engine speed during start" CURVE 0x80571A50 RB_CurveGroup_U16 1.992188 fak_ub_b2 0.00 1.992188 FORMAT "%8.6" EXTENDED_LIMITS 0.00 511.9922
 /begin AXIS_DESCR COM_AXIS llrnsnf_stm06llublLoc temp_ub_q0p75_o48 6 -48.0 143.3 FORMAT "%5.1" AXIS_PTS_REF STM06LLUBL /end AXIS_DESCR
/end CHARACTERISTIC
/begin CHARACTERISTIC FZNSMGA "time constant correction factor related to gangi" CURVE 0x80571A5C RB_Curve_S16_U8_Static 127.498 rfak_q0p5 0.502 128.000 FORMAT "%7.3" EXTENDED_LIMITS 0.501961 128.000
 /begin AXIS_DESCR STD_AXIS gangsist_llrnsnf_loc dez 6 -128.0000 127.0000 FORMAT "%8.4" EXTENDED_LIMITS -32768.00 32767.00 DEPOSIT ABSOLUTE /end AXIS_DESCR
/end CHARACTERISTIC
/begin CHARACTERISTIC FZNSMTM "time constant correction factor related to tmot" CURVE 0x80571A70 RB_CurveGroup_U8 127.498 rfak_q0p5 0.502 128.000 FORMAT "%7.3" EXTENDED_LIMITS 0.501961 128.000
 /begin AXIS_DESCR COM_AXIS llrnsnf_stm06llublLoc temp_ub_q0p75_o48 6 -48.0 143.3 FORMAT "%5.1" AXIS_PTS_REF STM06LLUBL /end AXIS_DESCR
/end CHARACTERISTIC
/begin CHARACTERISTIC KFAUSGKRT "characteristic map: torque reserve for flex fuel" MAP 0x805711D6 RB_Map_U8U8_U8 24.90 rel_ub_b25 0.00 24.90 FORMAT "%5.2"
 /begin AXIS_DESCR STD_AXIS LLRMR_tmot_tmp temp_ub_q0p75_o48 4 -48.0 143.3 FORMAT "%5.1" DEPOSIT ABSOLUTE /end AXIS_DESCR
 /begin AXIS_DESCR STD_AXIS LLRMR_nmot_tmp nmot_ub_q40 4 0.00 10200. FORMAT "%5.0" DEPOSIT ABSOLUTE /end AXIS_DESCR
/end CHARACTERISTIC
/begin CHARACTERISTIC KFAUSGLR "map: torque reserve for flex fuel, lambda control active" MAP 0x805711F0 RB_Map_U8U16_U8 24.90 rel_ub_b25 0.00 24.90 FORMAT "%5.2"
 /begin AXIS_DESCR STD_AXIS LLRMR_nmot_tmp nmot_ub_q40 3 0.00 10200. FORMAT "%5.0" DEPOSIT ABSOLUTE /end AXIS_DESCR
 /begin AXIS_DESCR STD_AXIS llrmrfrm_w fak_uw_b2 3 0.00 1.999969 FORMAT "%8.6" DEPOSIT ABSOLUTE /end AXIS_DESCR
/end CHARACTERISTIC
/begin CHARACTERISTIC KFETAZWOFF "Offset for minimum ignition angle effectiveness dependent on drivers torque wish and engine speed" MAP 0x80571206 RB_MapGroup_U16 1.000000 fak_uw_b2 0.00 1.000000 FORMAT "%8.6" EXTENDED_LIMITS 0.00 1.999969
 /begin AXIS_DESCR COM_AXIS LLRMR_nmotw_tmp nmot_uw_q0p25 8 0.00 16383.75 FORMAT "%8.2" AXIS_PTS_REF SNM06LLUWL /end AXIS_DESCR
 /begin AXIS_DESCR COM_AXIS LLRMR_mifa_w_tmp rel_uw_b100 8 0.00 99.99847 FORMAT "%8.5" AXIS_PTS_REF SMI04LLUBL /end AXIS_DESCR
/end CHARACTERISTIC
/begin CHARACTERISTIC KFFKTMRFS "Torque reserve factor for closed powertrain" MAP 0x80571286 RB_Map_U8U8_U8 3.984 fak_ub_b4 0.00 3.984 FORMAT "%5.3"
 /begin AXIS_DESCR STD_AXIS LLRMR_vfzg_tmp vfzg_ub_q1p25 3 0.00 318.8 FORMAT "%5.1" DEPOSIT ABSOLUTE /end AXIS_DESCR
 /begin AXIS_DESCR STD_AXIS LLRMR_tmot_tmp temp_ub_q0p75_o48 3 -48.0 143.3 FORMAT "%5.1" DEPOSIT ABSOLUTE /end AXIS_DESCR
/end CHARACTERISTIC
/begin CHARACTERISTIC KFMRENHER "torque reserve at idle and near-idle zone, engine heating" MAP 0x80571298 RB_Map_S16U8_U16 99.99847 rel_uw_b100 0.00 99.99847 FORMAT "%8.5"
 /begin AXIS_DESCR STD_AXIS WaHt_tDeltaEngT Temp_Cels 6 -3549.940 3003.560 FORMAT "%8.3" DEPOSIT ABSOLUTE /end AXIS_DESCR
 /begin AXIS_DESCR STD_AXIS tumg_msg temp_ub_q0p75_o48 6 -48.0 143.3 FORMAT "%5.1" DEPOSIT ABSOLUTE /end AXIS_DESCR
/end CHARACTERISTIC
/begin CHARACTERISTIC KFMRES "Engine speed control: Torque reserve at idle and near-idle zone" MAP 0x805712F6 RB_MapGroup_U8 24.90 rel_ub_b25 0.00 24.90 FORMAT "%5.2"
 /begin AXIS_DESCR COM_AXIS LLRMR_nmotw_tmp nmot_uw_q0p25 8 0.00 16383.75 FORMAT "%8.2" AXIS_PTS_REF SNM06LLUWL /end AXIS_DESCR
 /begin AXIS_DESCR COM_AXIS LLRMR_mifa_w_tmp rel_uw_b100 8 0.00 99.99847 FORMAT "%8.5" AXIS_PTS_REF SMI04LLUBL /end AXIS_DESCR
/end CHARACTERISTIC
/begin CHARACTERISTIC KFMRESAC "Torque reserve offset for vehicles with air conditioner" MAP 0x80571336 RB_MapGroup_U8 24.90 rel_ub_b25 0.00 24.90 FORMAT "%5.2"
 /begin AXIS_DESCR COM_AXIS LLRMR_nmotw_tmp nmot_uw_q0p25 8 0.00 16383.75 FORMAT "%8.2" AXIS_PTS_REF SNM06LLUWL /end AXIS_DESCR
 /begin AXIS_DESCR COM_AXIS LLRMR_mifa_w_tmp rel_uw_b100 8 0.00 99.99847 FORMAT "%8.5" AXIS_PTS_REF SMI04LLUBL /end AXIS_DESCR
/end CHARACTERISTIC
/begin CHARACTERISTIC KFMRESACT "Torque reseve offset from Testing for vehicles with air conditioner" MAP 0x80571376 RB_MapGroup_U8 24.90 rel_ub_b25 0.00 24.90 FORMAT "%5.2"
 /begin AXIS_DESCR COM_AXIS LLRMR_nmotw_tmp nmot_uw_q0p25 8 0.00 16383.75 FORMAT "%8.2" AXIS_PTS_REF SNM06LLUWL /end AXIS_DESCR
 /begin AXIS_DESCR COM_AXIS LLRMR_mifa_w_tmp rel_uw_b100 8 0.00 99.99847 FORMAT "%8.5" AXIS_PTS_REF SMI04LLUBL /end AXIS_DESCR
/end CHARACTERISTIC
/begin CHARACTERISTIC KFMRESETH "LLR: torque reserve at idle and near-idle zone for 100 percent ethanol" MAP 0x805713B6 RB_MapGroup_U8 24.90 rel_ub_b25 0.00 24.90 FORMAT "%5.2"
 /begin AXIS_DESCR COM_AXIS LLRMR_nmotw_tmp nmot_uw_q0p25 8 0.00 16383.75 FORMAT "%8.2" AXIS_PTS_REF SNM06LLUWL /end AXIS_DESCR
 /begin AXIS_DESCR COM_AXIS LLRMR_mifa_w_tmp rel_uw_b100 8 0.00 99.99847 FORMAT "%8.5" AXIS_PTS_REF SMI04LLUBL /end AXIS_DESCR
/end CHARACTERISTIC
/begin CHARACTERISTIC KFMRESFS "Engine speed control: Torque reserve at idle and near-idle zone for closed powertrain" MAP 0x805713F6 RB_MapGroup_U8 24.90 rel_ub_b25 0.00 24.90 FORMAT "%5.2"
 /begin AXIS_DESCR COM_AXIS LLRMR_nmotw_tmp nmot_uw_q0p25 8 0.00 16383.75 FORMAT "%8.2" AXIS_PTS_REF SNM06LLUWL /end AXIS_DESCR
 /begin AXIS_DESCR COM_AXIS LLRMR_mifa_w_tmp rel_uw_b100 8 0.00 99.99847 FORMAT "%8.5" AXIS_PTS_REF SMI04LLUBL /end AXIS_DESCR
/end CHARACTERISTIC
/begin CHARACTERISTIC KFMRESFSETH "LLR: torque reserve at idle and near-idle zone for 100 percent ethanol" MAP 0x80571436 RB_MapGroup_U8 24.90 rel_ub_b25 0.00 24.90 FORMAT "%5.2"
 /begin AXIS_DESCR COM_AXIS LLRMR_nmotw_tmp nmot_uw_q0p25 8 0.00 16383.75 FORMAT "%8.2" AXIS_PTS_REF SNM06LLUWL /end AXIS_DESCR
 /begin AXIS_DESCR COM_AXIS LLRMR_mifa_w_tmp rel_uw_b100 8 0.00 99.99847 FORMAT "%8.5" AXIS_PTS_REF SMI04LLUBL /end AXIS_DESCR
/end CHARACTERISTIC
/begin CHARACTERISTIC KFMRESFSSAIL "Engine speed control: Torque reserve at idle and near-idle zone for closed powertrain, Sailing" MAP 0x80571476 RB_MapGroup_U8 24.90 rel_ub_b25 0.00 24.90 FORMAT "%5.2"
 /begin AXIS_DESCR COM_AXIS LLRMR_nmotw_tmp nmot_uw_q0p25 8 0.00 16383.75 FORMAT "%8.2" AXIS_PTS_REF SNM06LLUWL /end AXIS_DESCR
 /begin AXIS_DESCR COM_AXIS LLRMR_mifa_w_tmp rel_uw_b100 8 0.00 99.99847 FORMAT "%8.5" AXIS_PTS_REF SMI04LLUBL /end AXIS_DESCR
/end CHARACTERISTIC
/begin CHARACTERISTIC KFMRESFSSP "Engine speed control: Torque reserve at idle and near-idle zone for closed powertrain, Sport" MAP 0x805714B6 RB_MapGroup_U8 24.90 rel_ub_b25 0.00 24.90 FORMAT "%5.2"
 /begin AXIS_DESCR COM_AXIS LLRMR_nmotw_tmp nmot_uw_q0p25 8 0.00 16383.75 FORMAT "%8.2" AXIS_PTS_REF SNM06LLUWL /end AXIS_DESCR
 /begin AXIS_DESCR COM_AXIS LLRMR_mifa_w_tmp rel_uw_b100 8 0.00 99.99847 FORMAT "%8.5" AXIS_PTS_REF SMI04LLUBL /end AXIS_DESCR
/end CHARACTERISTIC
/begin CHARACTERISTIC KFMRESFSSPP "Engine speed control: Torque reserve at idle and near-idle zone for closed powertrain, SportPlus" MAP 0x805714F6 RB_MapGroup_U8 24.90 rel_ub_b25 0.00 24.90 FORMAT "%5.2"
 /begin AXIS_DESCR COM_AXIS LLRMR_nmotw_tmp nmot_uw_q0p25 8 0.00 16383.75 FORMAT "%8.2" AXIS_PTS_REF SNM06LLUWL /end AXIS_DESCR
 /begin AXIS_DESCR COM_AXIS LLRMR_mifa_w_tmp rel_uw_b100 8 0.00 99.99847 FORMAT "%8.5" AXIS_PTS_REF SMI04LLUBL /end AXIS_DESCR
/end CHARACTERISTIC
/begin CHARACTERISTIC KFMRESI "Engine speed control: Torque reserve at idle and near-idle zone, open powertrain" MAP 0x80571536 RB_MapGroup_U8 24.90 rel_ub_b25 0.00 24.90 FORMAT "%5.2"
 /begin AXIS_DESCR COM_AXIS LLRMR_nmotw_tmp nmot_uw_q0p25 8 0.00 16383.75 FORMAT "%8.2" AXIS_PTS_REF SNM06LLUWL /end AXIS_DESCR
 /begin AXIS_DESCR COM_AXIS LLRMR_mifa_w_tmp rel_uw_b100 8 0.00 99.99847 FORMAT "%8.5" AXIS_PTS_REF SMI04LLUBL /end AXIS_DESCR
/end CHARACTERISTIC
/begin CHARACTERISTIC KFMRESK "Engine speed control: Torque reserve at idle and near-idle zone, closed powertrain" MAP 0x80571576 RB_MapGroup_U8 24.90 rel_ub_b25 0.00 24.90 FORMAT "%5.2"
 /begin AXIS_DESCR COM_AXIS LLRMR_nmotw_tmp nmot_uw_q0p25 8 0.00 16383.75 FORMAT "%8.2" AXIS_PTS_REF SNM06LLUWL /end AXIS_DESCR
 /begin AXIS_DESCR COM_AXIS LLRMR_mifa_w_tmp rel_uw_b100 8 0.00 99.99847 FORMAT "%8.5" AXIS_PTS_REF SMI04LLUBL /end AXIS_DESCR
/end CHARACTERISTIC
/begin CHARACTERISTIC KFMRESKH "Torque reserve during catalyst heating" MAP 0x805715B6 RB_MapGroup_U8 24.90 rel_ub_b25 0.00 24.90 FORMAT "%5.2"
 /begin AXIS_DESCR COM_AXIS LLRMR_dns_temp nmot_sw_q0p5 6 -16384.00 16383.50 FORMAT "%8.2" AXIS_PTS_REF SNS06LLSBL /end AXIS_DESCR
 /begin AXIS_DESCR COM_AXIS LLRMR_tmot_tmp temp_ub_q0p75_o48 4 -48.0 143.3 FORMAT "%5.1" AXIS_PTS_REF STM04SAUBL /end AXIS_DESCR
/end CHARACTERISTIC
/begin CHARACTERISTIC KFMRESLT "map: temperature and engine speed depending torque reserve limit" MAP 0x805715CE RB_Map_U8U8_U8 24.90 rel_ub_b25 0.00 24.90 FORMAT "%5.2"
 /begin AXIS_DESCR STD_AXIS LLRMR_tmot_tmp temp_ub_q0p75_o48 4 -48.0 143.3 FORMAT "%5.1" DEPOSIT ABSOLUTE /end AXIS_DESCR
 /begin AXIS_DESCR STD_AXIS LLRMR_nmot_tmp nmot_ub_q40 4 0.00 10200. FORMAT "%5.0" DEPOSIT ABSOLUTE /end AXIS_DESCR
/end CHARACTERISTIC
/begin CHARACTERISTIC KFMRESNL "Torque reserve in non idling state" MAP 0x805715E8 RB_MapGroup_U8 24.90 rel_ub_b25 0.00 24.90 FORMAT "%5.2"
 /begin AXIS_DESCR COM_AXIS LLRMR_nmotw_tmp nmot_uw_q0p25 8 0.00 16383.75 FORMAT "%8.2" AXIS_PTS_REF SNM06LLUWL /end AXIS_DESCR
 /begin AXIS_DESCR COM_AXIS LLRMR_mifa_w_tmp rel_uw_b100 8 0.00 99.99847 FORMAT "%8.5" AXIS_PTS_REF SMI04LLUBL /end AXIS_DESCR
/end CHARACTERISTIC
/begin CHARACTERISTIC KFMRESSAIL "Engine speed control: Torque reserve at idle and near-idle zone for closed powertrain, Sailing" MAP 0x80571628 RB_MapGroup_U8 24.90 rel_ub_b25 0.00 24.90 FORMAT "%5.2"
 /begin AXIS_DESCR COM_AXIS LLRMR_nmotw_tmp nmot_uw_q0p25 8 0.00 16383.75 FORMAT "%8.2" AXIS_PTS_REF SNM06LLUWL /end AXIS_DESCR
 /begin AXIS_DESCR COM_AXIS LLRMR_mifa_w_tmp rel_uw_b100 8 0.00 99.99847 FORMAT "%8.5" AXIS_PTS_REF SMI04LLUBL /end AXIS_DESCR
/end CHARACTERISTIC
/begin CHARACTERISTIC KFMRESSP "Engine speed control: Torque reserve at idle and near-idle zone, Sport" MAP 0x80571668 RB_MapGroup_U8 24.90 rel_ub_b25 0.00 24.90 FORMAT "%5.2"
 /begin AXIS_DESCR COM_AXIS LLRMR_nmotw_tmp nmot_uw_q0p25 8 0.00 16383.75 FORMAT "%8.2" AXIS_PTS_REF SNM06LLUWL /end AXIS_DESCR
 /begin AXIS_DESCR COM_AXIS LLRMR_mifa_w_tmp rel_uw_b100 8 0.00 99.99847 FORMAT "%8.5" AXIS_PTS_REF SMI04LLUBL /end AXIS_DESCR
/end CHARACTERISTIC
/begin CHARACTERISTIC KFMRESSPP "Engine speed control: Torque reserve at idle and near-idle zone, SportPlus" MAP 0x805716A8 RB_MapGroup_U8 24.90 rel_ub_b25 0.00 24.90 FORMAT "%5.2"
 /begin AXIS_DESCR COM_AXIS LLRMR_nmotw_tmp nmot_uw_q0p25 8 0.00 16383.75 FORMAT "%8.2" AXIS_PTS_REF SNM06LLUWL /end AXIS_DESCR
 /begin AXIS_DESCR COM_AXIS LLRMR_mifa_w_tmp rel_uw_b100 8 0.00 99.99847 FORMAT "%8.5" AXIS_PTS_REF SMI04LLUBL /end AXIS_DESCR
/end CHARACTERISTIC
/begin CHARACTERISTIC KFMRESTA "Torque margin dependent on intake air temperature" MAP 0x805716E8 RB_MapGroup_U8 24.90 rel_ub_b25 0.00 24.90 FORMAT "%5.2"
 /begin AXIS_DESCR COM_AXIS LLRMR_tans_temp temp_ub_q0p75_o48 4 -48.0 143.3 FORMAT "%5.1" AXIS_PTS_REF STA04LLUBL /end AXIS_DESCR
 /begin AXIS_DESCR COM_AXIS LLRMR_mifa_w_tmp rel_uw_b100 8 0.00 99.99847 FORMAT "%8.5" AXIS_PTS_REF SMI04LLUBL /end AXIS_DESCR
/end CHARACTERISTIC
/begin CHARACTERISTIC KFMRTAETH "Torque margin dependent on nmot and fethmnmx" MAP 0x80571708 RB_Map_U8U8_U8 24.90 rel_ub_b25 0.00 24.90 FORMAT "%5.2"
 /begin AXIS_DESCR STD_AXIS LLRMR_nmot_tmp nmot_ub_q40 6 0.00 10200. FORMAT "%5.0" DEPOSIT ABSOLUTE /end AXIS_DESCR
 /begin AXIS_DESCR STD_AXIS LLRMR_fethmumx_tmp fak_ub_b2 4 0.00 1.992188 FORMAT "%8.6" DEPOSIT ABSOLUTE /end AXIS_DESCR
/end CHARACTERISTIC
/begin CHARACTERISTIC KLAUSGKLR "characteristic curve: torque reserve for flex fuel, lambda control inactive" CURVE 0x8057172C RB_Curve_U8_U8 24.90 rel_ub_b25 0.00 24.90 FORMAT "%5.2"
 /begin AXIS_DESCR STD_AXIS LLRMR_nmot_tmp nmot_ub_q40 5 0.00 10200. FORMAT "%5.0" DEPOSIT ABSOLUTE /end AXIS_DESCR
/end CHARACTERISTIC
/begin CHARACTERISTIC KLDMRESTM "Map for temperature-dependent reduction of the torque reserve after start" CURVE 0x80571737 RB_Curve_U8_U8 0.3891 rel_q0p00153 0.00 0.3891
 /begin AXIS_DESCR STD_AXIS LLRMR_tmot_tmp temp_ub_q0p75_o48 4 -48.0 143.3 FORMAT "%5.1" DEPOSIT ABSOLUTE /end AXIS_DESCR
/end CHARACTERISTIC
/begin CHARACTERISTIC KLDNLLDE "characteristic curve: torque reserve for speed undershoot" CURVE 0x80571740 RB_Curve_S16_S8_Static 25500. nmotg_sb_q100 -12800. 12700. FORMAT "%5.0"
 /begin AXIS_DESCR STD_AXIS LLRMR_dns_temp nmot_sw_q0p5 6 -16384.00 16383.50 FORMAT "%8.2" DEPOSIT ABSOLUTE /end AXIS_DESCR
/end CHARACTERISTIC
/begin CHARACTERISTIC KLDNSNFST "speed threshold of nsol-limitation in start from characteristic line" CURVE 0x80571A76 RB_CurveGroup_S16 16383.50 nmot_sw_q0p5 0.00 16383.50 FORMAT "%8.2" EXTENDED_LIMITS -16384.00 16383.50
 /begin AXIS_DESCR COM_AXIS tmst_llrnsnf_loc temp_ub_q0p75_o48 8 -48.0 143.3 FORMAT "%5.1" AXIS_PTS_REF STS08ESUBL /end AXIS_DESCR
/end CHARACTERISTIC
/begin CHARACTERISTIC KLGNGW "gear dependent factor for non idle" CURVE 0x80571754 RB_Curve_U8_U8 1.000 fak_uw_q0p1 0.00 1.000 FORMAT "%5.3" EXTENDED_LIMITS 0.00 25.50
 /begin AXIS_DESCR STD_AXIS LLRMR_gangi_tmp OneToOne 6 0.00 255.0 FORMAT "%5.1" DEPOSIT ABSOLUTE /end AXIS_DESCR
/end CHARACTERISTIC
/begin CHARACTERISTIC KLGNSTAT "Gear dependent offset of the engine speed for the activation of underspeed detection to increase the torque reserve" CURVE 0x80571761 RB_Curve_U8_U8 10200. nmot_ub_q40 0.00 10200. FORMAT "%5.0"
 /begin AXIS_DESCR STD_AXIS LLRMR_gangi_tmp OneToOne 10 0.00 255.0 FORMAT "%5.1" DEPOSIT ABSOLUTE /end AXIS_DESCR
/end CHARACTERISTIC
/begin CHARACTERISTIC KLIPMRETH "LLR: torque reserve at idle and near-idle zone interpolation factor" CURVE 0x80571776 RB_Curve_U8_U8 0.9961 fak_ub_b1 0.00 0.9961
 /begin AXIS_DESCR STD_AXIS LLRMR_fethmumx_tmp fak_ub_b2 6 0.00 1.992188 FORMAT "%8.6" DEPOSIT ABSOLUTE /end AXIS_DESCR
/end CHARACTERISTIC
/begin CHARACTERISTIC KLMRESLLSTA "Intake air temperature dependent torque reserve when underspeed is detected" CURVE 0x80571783 RB_Curve_U8_U8 24.90 rel_ub_b25 0.00 24.90 FORMAT "%5.2"
 /begin AXIS_DESCR STD_AXIS LLRMR_tans_temp temp_ub_q0p75_o48 6 -48.0 143.3 FORMAT "%5.1" DEPOSIT ABSOLUTE /end AXIS_DESCR
/end CHARACTERISTIC
/begin CHARACTERISTIC KLMRESPHIR "Adaption of base torque reserve to road resistance index" CURVE 0x80571790 RB_Curve_S16_U8_Static 24.90 rel_ub_b25 0.00 24.90 FORMAT "%5.2"
 /begin AXIS_DESCR STD_AXIS VehPos_rIncIX PrcHigh 6 -32.76800 32.76700 FORMAT "%8.5" DEPOSIT ABSOLUTE /end AXIS_DESCR
/end CHARACTERISTIC
/begin CHARACTERISTIC KLMRESTM "characteristic for torque reserve after start" CURVE 0x805717A4 RB_Curve_U8_U8 24.90 rel_ub_b25 0.00 24.90 FORMAT "%5.2"
 /begin AXIS_DESCR STD_AXIS LLRMR_tmot_tmp temp_ub_q0p75_o48 4 -48.0 143.3 FORMAT "%5.1" DEPOSIT ABSOLUTE /end AXIS_DESCR
/end CHARACTERISTIC
/begin CHARACTERISTIC KLMRESUB "Torque reserve depending on voltage drop" CURVE 0x805717AE RB_Curve_U16_U8_Static 24.90 rel_ub_b25 0.00 24.90 FORMAT "%5.2"
 /begin AXIS_DESCR STD_AXIS dmresubg spg_q0p00039 5 0.00 25.59961 FORMAT "%8.5" DEPOSIT ABSOLUTE /end AXIS_DESCR
/end CHARACTERISTIC
/begin CHARACTERISTIC KLMRHO "map: altitude depending torque reserve" CURVE 0x805717C0 RB_Curve_U8_U8 24.90 rel_ub_b25 0.00 24.90 FORMAT "%5.2"
 /begin AXIS_DESCR STD_AXIS LLRMR_fho_tmp fak_ub_b4 10 0.00 3.984 FORMAT "%5.3" DEPOSIT ABSOLUTE /end AXIS_DESCR
/end CHARACTERISTIC
/begin CHARACTERISTIC KLMRHOFS "Curve: Altitude depending offset for the torque reserve for engaged driving position" CURVE 0x805717D5 RB_Curve_U8_U8 24.90 rel_ub_b25 0.00 24.90 FORMAT "%5.2"
 /begin AXIS_DESCR STD_AXIS LLRMR_fho_tmp fak_ub_b4 10 0.00 3.984 FORMAT "%5.3" DEPOSIT ABSOLUTE /end AXIS_DESCR
/end CHARACTERISTIC
/begin CHARACTERISTIC KLTVRESTM "Map for formation of a temperature-dependent switch-off time for the torque reserve after start" CURVE 0x805717EA RB_Curve_U8_U16_Static 1310.700 t20msxs_uw_q0p02 0.00 1310.700 FORMAT "%8.3"
 /begin AXIS_DESCR STD_AXIS LLRMR_tmot_tmp temp_ub_q0p75_o48 4 -48.0 143.3 FORMAT "%5.1" DEPOSIT ABSOLUTE /end AXIS_DESCR
/end CHARACTERISTIC
/begin CHARACTERISTIC KLVANF "characteristic curve: torque reserve for standing start" CURVE 0x805717F8 RB_Curve_U8_U8 158.8 vfzg_ub_q1p25 0.00 158.8 FORMAT "%5.1" EXTENDED_LIMITS 0.00 318.8
 /begin AXIS_DESCR STD_AXIS LLRMR_tosp_tmp temp_ub_q0p75_o48 4 -48.0 143.3 FORMAT "%5.1" DEPOSIT ABSOLUTE /end AXIS_DESCR
/end CHARACTERISTIC
/begin CHARACTERISTIC KLZNSM "time constant for decay of desired idling speed" CURVE 0x80571A86 RB_CurveGroup_U16 655.34999985 zk10msxs_uw_b655p36 0.01000015 655.36000000 FORMAT "%12.8" EXTENDED_LIMITS 0.010000152590 655.36000000
 /begin AXIS_DESCR COM_AXIS llrnsnf_sns06llsbLoc nmotd_sb_q10 6 -1280. 1270. FORMAT "%5.0" AXIS_PTS_REF LLRNSNF_nSpLoDiff_X_Ax /end AXIS_DESCR
/end CHARACTERISTIC
/begin CHARACTERISTIC KLZNSMTRA "time constant for decay of desired idling speed for transmisson engine speed demand" CURVE 0x80571A92 RB_CurveGroup_U16 655.34999985 zk10msxs_uw_b655p36 0.01000015 655.36000000 FORMAT "%12.8" EXTENDED_LIMITS 0.010000152590 655.36000000
 /begin AXIS_DESCR COM_AXIS llrnsnf_sns06llsbLoc nmotd_sb_q10 6 -1280. 1270. FORMAT "%5.0" AXIS_PTS_REF LLRNSNF_nSpLoDiff_X_Ax /end AXIS_DESCR
/end CHARACTERISTIC
/begin CHARACTERISTIC KNSNF_W "Engine speed follow-up inhibition band" VALUE 0x80571A9E RB_Val_Ws16 16383.50 nmot_sw_q0p5 0.00 16383.50 FORMAT "%8.2" EXTENDED_LIMITS -16384.00 16383.50 /end CHARACTERISTIC
/begin CHARACTERISTIC LIVFZDE "Speed limit for speed undershoot." VALUE 0x80571801 RB_Val_Wu8 318.8 vfzg_ub_q1p25 0.00 318.8 FORMAT "%5.1" /end CHARACTERISTIC
/begin CHARACTERISTIC LIVFZMNDE "Minimum Vehicle velocity limit for speed undershoot." VALUE 0x80571802 RB_Val_Wu8 318.8 vfzg_ub_q1p25 0.00 318.8 FORMAT "%5.1" /end CHARACTERISTIC
/begin CHARACTERISTIC LLim_aDifNeg_C "Maximum negative change of Acceleration Request per cycle" VALUE 0x80578914 Val_Ws16 65.53500 Acc -32.76800 32.76700 FORMAT "%8.5" /end CHARACTERISTIC
/begin CHARACTERISTIC LLim_aDifPos_C "Maximum Positive change of Acceleration Request per cycle" VALUE 0x80578916 Val_Ws16 65.53500 Acc -32.76800 32.76700 FORMAT "%8.5" /end CHARACTERISTIC
/begin CHARACTERISTIC LLim_aMSL_CUR "Curve for Speed limiter acceleration limit" CURVE 0x80578918 Cur_Xs16Ws16 65.53500 Acc -32.76800 32.76700 FORMAT "%8.5"
 /begin AXIS_DESCR STD_AXIS LLim_dvMSL_mp Vel 9 -327.6800 327.6700 FORMAT "%8.4" DEPOSIT ABSOLUTE /end AXIS_DESCR
/end CHARACTERISTIC
/begin CHARACTERISTIC LLim_axMax_C "Upper Bound for acceleration request" VALUE 0x8057893E Val_Ws16 65.53500 Acc -32.76800 32.76700 FORMAT "%8.5" /end CHARACTERISTIC
/begin CHARACTERISTIC LLim_ctASLAppATOpenLrn_C "Counter value for AT full open learn value translation check" VALUE 0x80571BBC Val_Wu8 127.0 OneToOne 0.00 127.0 FORMAT "%5.1" EXTENDED_LIMITS 0.00 255.0 /end CHARACTERISTIC
/begin CHARACTERISTIC LLim_facAcclDeclCor_CUR "Curve for decelerate correction factor(for accelerate speed control)" CURVE 0x80571BBE RB_Curve_S16_S16 1023.984 Fact_CrCtl2 -512.0000 511.9844 FORMAT "%8.4"
 /begin AXIS_DESCR STD_AXIS CrCtl_vASLVehCont Vel 12 -327.6800 327.6700 FORMAT "%8.4" DEPOSIT ABSOLUTE /end AXIS_DESCR
/end CHARACTERISTIC
/begin CHARACTERISTIC LLim_facAPPDiffCor1LGCls_MAP "MAP for Correction factor based on difference of accel pedal position(for 1 level lower gear and close side)" MAP 0x80571BF0 RB_Map_S16S16_S16 511.9922 Fact1 -256.0000 255.9922 FORMAT "%8.4"
 /begin AXIS_DESCR STD_AXIS LLim_rDesReq_mp APPCrCtl1 12 -163.8400 163.8350 FORMAT "%8.4" DEPOSIT ABSOLUTE /end AXIS_DESCR
 /begin AXIS_DESCR STD_AXIS CrCtl_vASLVehCont Vel 12 -327.6800 327.6700 FORMAT "%8.4" DEPOSIT ABSOLUTE /end AXIS_DESCR
/end CHARACTERISTIC
/begin CHARACTERISTIC LLim_facAPPDiffCor1LG_MAP "MAP for Correction factor based on difference of accel pedal position(for 1 level lower gear)" MAP 0x80571D44 RB_Map_S16S16_S16 511.9922 Fact1 -256.0000 255.9922 FORMAT "%8.4"
 /begin AXIS_DESCR STD_AXIS LLim_rDesReq_mp APPCrCtl1 12 -163.8400 163.8350 FORMAT "%8.4" DEPOSIT ABSOLUTE /end AXIS_DESCR
 /begin AXIS_DESCR STD_AXIS CrCtl_vASLVehCont Vel 12 -327.6800 327.6700 FORMAT "%8.4" DEPOSIT ABSOLUTE /end AXIS_DESCR
/end CHARACTERISTIC
/begin CHARACTERISTIC LLim_facAPPDiffCor2LGCls_MAP "MAP for Correction factor based on difference of accel pedal position(for 2 level lower gear and close side)" MAP 0x80571E98 RB_Map_S16S16_S16 511.9922 Fact1 -256.0000 255.9922 FORMAT "%8.4"
 /begin AXIS_DESCR STD_AXIS LLim_rDesReq_mp APPCrCtl1 12 -163.8400 163.8350 FORMAT "%8.4" DEPOSIT ABSOLUTE /end AXIS_DESCR
 /begin AXIS_DESCR STD_AXIS CrCtl_vASLVehCont Vel 12 -327.6800 327.6700 FORMAT "%8.4" DEPOSIT ABSOLUTE /end AXIS_DESCR
/end CHARACTERISTIC
/begin CHARACTERISTIC LLim_facAPPDiffCor2LG_MAP "MAP for Correction factor based on difference of accel pedal position(for 2 level lower gear)" MAP 0x80571FEC RB_Map_S16S16_S16 511.9922 Fact1 -256.0000 255.9922 FORMAT "%8.4"
 /begin AXIS_DESCR STD_AXIS LLim_rDesReq_mp APPCrCtl1 12 -163.8400 163.8350 FORMAT "%8.4" DEPOSIT ABSOLUTE /end AXIS_DESCR
 /begin AXIS_DESCR STD_AXIS CrCtl_vASLVehCont Vel 12 -327.6800 327.6700 FORMAT "%8.4" DEPOSIT ABSOLUTE /end AXIS_DESCR
/end CHARACTERISTIC
/begin CHARACTERISTIC LLim_facAPPDiffCor3LGCls_MAP "MAP for Correction factor based on difference of accel pedal position(for 3 level lower gear and close side)" MAP 0x80572140 RB_Map_S16S16_S16 511.9922 Fact1 -256.0000 255.9922 FORMAT "%8.4"
 /begin AXIS_DESCR STD_AXIS LLim_rDesReq_mp APPCrCtl1 12 -163.8400 163.8350 FORMAT "%8.4" DEPOSIT ABSOLUTE /end AXIS_DESCR
 /begin AXIS_DESCR STD_AXIS CrCtl_vASLVehCont Vel 12 -327.6800 327.6700 FORMAT "%8.4" DEPOSIT ABSOLUTE /end AXIS_DESCR
/end CHARACTERISTIC
/begin CHARACTERISTIC LLim_facAPPDiffCor3LG_MAP "MAP for Correction factor based on difference of accel pedal position(for 3 level lower gear)" MAP 0x80572294 RB_Map_S16S16_S16 511.9922 Fact1 -256.0000 255.9922 FORMAT "%8.4"
 /begin AXIS_DESCR STD_AXIS LLim_rDesReq_mp APPCrCtl1 12 -163.8400 163.8350 FORMAT "%8.4" DEPOSIT ABSOLUTE /end AXIS_DESCR
 /begin AXIS_DESCR STD_AXIS CrCtl_vASLVehCont Vel 12 -327.6800 327.6700 FORMAT "%8.4" DEPOSIT ABSOLUTE /end AXIS_DESCR
/end CHARACTERISTIC
/begin CHARACTERISTIC LLim_facAPPDiffCor4LGCls_MAP "MAP for Correction factor based on difference of accel pedal position(for 4 level lower gear and close side)" MAP 0x805723E8 RB_Map_S16S16_S16 511.9922 Fact1 -256.0000 255.9922 FORMAT "%8.4"
 /begin AXIS_DESCR STD_AXIS LLim_rDesReq_mp APPCrCtl1 12 -163.8400 163.8350 FORMAT "%8.4" DEPOSIT ABSOLUTE /end AXIS_DESCR
 /begin AXIS_DESCR STD_AXIS CrCtl_vASLVehCont Vel 12 -327.6800 327.6700 FORMAT "%8.4" DEPOSIT ABSOLUTE /end AXIS_DESCR
/end CHARACTERISTIC
/begin CHARACTERISTIC LLim_facAPPDiffCor4LG_MAP "MAP for Correction factor based on difference of accel pedal position(for 4 level lower gear)" MAP 0x8057253C RB_Map_S16S16_S16 511.9922 Fact1 -256.0000 255.9922 FORMAT "%8.4"
 /begin AXIS_DESCR STD_AXIS LLim_rDesReq_mp APPCrCtl1 12 -163.8400 163.8350 FORMAT "%8.4" DEPOSIT ABSOLUTE /end AXIS_DESCR
 /begin AXIS_DESCR STD_AXIS CrCtl_vASLVehCont Vel 12 -327.6800 327.6700 FORMAT "%8.4" DEPOSIT ABSOLUTE /end AXIS_DESCR
/end CHARACTERISTIC
/begin CHARACTERISTIC LLim_facAPPDiffCor5LGCls_MAP "MAP for Correction factor based on difference of accel pedal position(for 5 level lower gear and close side)" MAP 0x80572690 RB_Map_S16S16_S16 511.9922 Fact1 -256.0000 255.9922 FORMAT "%8.4"
 /begin AXIS_DESCR STD_AXIS LLim_rDesReq_mp APPCrCtl1 12 -163.8400 163.8350 FORMAT "%8.4" DEPOSIT ABSOLUTE /end AXIS_DESCR
 /begin AXIS_DESCR STD_AXIS CrCtl_vASLVehCont Vel 12 -327.6800 327.6700 FORMAT "%8.4" DEPOSIT ABSOLUTE /end AXIS_DESCR
/end CHARACTERISTIC
/begin CHARACTERISTIC LLim_facAPPDiffCor5LG_MAP "MAP for Correction factor based on difference of accel pedal position(for 5 level lower gear)" MAP 0x805727E4 RB_Map_S16S16_S16 511.9922 Fact1 -256.0000 255.9922 FORMAT "%8.4"
 /begin AXIS_DESCR STD_AXIS LLim_rDesReq_mp APPCrCtl1 12 -163.8400 163.8350 FORMAT "%8.4" DEPOSIT ABSOLUTE /end AXIS_DESCR
 /begin AXIS_DESCR STD_AXIS CrCtl_vASLVehCont Vel 12 -327.6800 327.6700 FORMAT "%8.4" DEPOSIT ABSOLUTE /end AXIS_DESCR
/end CHARACTERISTIC
/begin CHARACTERISTIC LLim_facAPPDiffCorTGCls_MAP "MAP for Correction factor based on difference of accel pedal position(for the top gear and close side)" MAP 0x80572938 RB_Map_S16S16_S16 511.9922 Fact1 -256.0000 255.9922 FORMAT "%8.4"
 /begin AXIS_DESCR STD_AXIS LLim_rDesReq_mp APPCrCtl1 12 -163.8400 163.8350 FORMAT "%8.4" DEPOSIT ABSOLUTE /end AXIS_DESCR
 /begin AXIS_DESCR STD_AXIS CrCtl_vASLVehCont Vel 12 -327.6800 327.6700 FORMAT "%8.4" DEPOSIT ABSOLUTE /end AXIS_DESCR
/end CHARACTERISTIC
/begin CHARACTERISTIC LLim_facAPPDiffCorTG_MAP "MAP for Correction factor based on difference of accel pedal position(for the top gear)" MAP 0x80572A8C RB_Map_S16S16_S16 511.9922 Fact1 -256.0000 255.9922 FORMAT "%8.4"
 /begin AXIS_DESCR STD_AXIS LLim_rDesReq_mp APPCrCtl1 12 -163.8400 163.8350 FORMAT "%8.4" DEPOSIT ABSOLUTE /end AXIS_DESCR
 /begin AXIS_DESCR STD_AXIS CrCtl_vASLVehCont Vel 12 -327.6800 327.6700 FORMAT "%8.4" DEPOSIT ABSOLUTE /end AXIS_DESCR
/end CHARACTERISTIC
/begin CHARACTERISTIC LLim_facAPPReqItmFlt_C "Factor of interim value for filtered request accel pedal position" VALUE 0x80572BE0 Val_Ws16 255.9961 Fact_CrCtl -128.0000 127.9961 FORMAT "%8.4" /end CHARACTERISTIC
/begin CHARACTERISTIC LLim_facCnvVehUn_C "Conversion factor for unit of vehicle speed" VALUE 0x80572BE2 Val_Ws16 3.276700 Fact_10000 0.00 3.276700 FORMAT "%8.6" EXTENDED_LIMITS -3.276800 3.276700 /end CHARACTERISTIC
/begin CHARACTERISTIC LLim_facConstDeclCor_CUR "Curve for decelerate correction factor(for constant speed control)" CURVE 0x80572BE4 RB_Curve_S16_S16 1023.984 Fact_CrCtl2 -512.0000 511.9844 FORMAT "%8.4"
 /begin AXIS_DESCR STD_AXIS LLim_vDes_mp Vel 12 -327.6800 327.6700 FORMAT "%8.4" DEPOSIT ABSOLUTE /end AXIS_DESCR
/end CHARACTERISTIC
/begin CHARACTERISTIC LLim_facFdbkAcclP1LG_CUR "Curve for acceleration Feed Back P coefficient factor value(for 1 level lower gear)" CURVE 0x80572C16 RB_Curve_S16_S16 1023.984 Fact_CrCtl2 -512.0000 511.9844 FORMAT "%8.4"
 /begin AXIS_DESCR STD_AXIS CrCtl_vASLVehCont Vel 12 -327.6800 327.6700 FORMAT "%8.4" DEPOSIT ABSOLUTE /end AXIS_DESCR
/end CHARACTERISTIC
/begin CHARACTERISTIC LLim_facFdbkAcclP2LG_CUR "Curve for acceleration Feed Back P coefficient factor value(for 2 level lower gear)" CURVE 0x80572C48 RB_Curve_S16_S16 1023.984 Fact_CrCtl2 -512.0000 511.9844 FORMAT "%8.4"
 /begin AXIS_DESCR STD_AXIS CrCtl_vASLVehCont Vel 12 -327.6800 327.6700 FORMAT "%8.4" DEPOSIT ABSOLUTE /end AXIS_DESCR
/end CHARACTERISTIC
/begin CHARACTERISTIC LLim_facFdbkAcclP3LG_CUR "Curve for acceleration Feed Back P coefficient factor value(for 3 level lower gear)" CURVE 0x80572C7A RB_Curve_S16_S16 1023.984 Fact_CrCtl2 -512.0000 511.9844 FORMAT "%8.4"
 /begin AXIS_DESCR STD_AXIS CrCtl_vASLVehCont Vel 12 -327.6800 327.6700 FORMAT "%8.4" DEPOSIT ABSOLUTE /end AXIS_DESCR
/end CHARACTERISTIC
/begin CHARACTERISTIC LLim_facFdbkAcclP4LG_CUR "Curve for acceleration Feed Back P coefficient factor value(for 4 level lower gear)" CURVE 0x80572CAC RB_Curve_S16_S16 1023.984 Fact_CrCtl2 -512.0000 511.9844 FORMAT "%8.4"
 /begin AXIS_DESCR STD_AXIS CrCtl_vASLVehCont Vel 12 -327.6800 327.6700 FORMAT "%8.4" DEPOSIT ABSOLUTE /end AXIS_DESCR
/end CHARACTERISTIC
/begin CHARACTERISTIC LLim_facFdbkAcclP5LG_CUR "Curve for acceleration Feed Back P coefficient factor value(for 5 level lower gear)" CURVE 0x80572CDE RB_Curve_S16_S16 1023.984 Fact_CrCtl2 -512.0000 511.9844 FORMAT "%8.4"
 /begin AXIS_DESCR STD_AXIS CrCtl_vASLVehCont Vel 12 -327.6800 327.6700 FORMAT "%8.4" DEPOSIT ABSOLUTE /end AXIS_DESCR
/end CHARACTERISTIC
/begin CHARACTERISTIC LLim_facFdbkAcclPTG_CUR "Curve for acceleration Feed Back P coefficient factor value(for the top gear)" CURVE 0x80572D10 RB_Curve_S16_S16 1023.984 Fact_CrCtl2 -512.0000 511.9844 FORMAT "%8.4"
 /begin AXIS_DESCR STD_AXIS CrCtl_vASLVehCont Vel 12 -327.6800 327.6700 FORMAT "%8.4" DEPOSIT ABSOLUTE /end AXIS_DESCR
/end CHARACTERISTIC
/begin CHARACTERISTIC LLim_facFdbkD1LG_MAP "MAP for Feed Back D coefficient factor value (for 1 level lower gear)" MAP 0x80572D42 RB_Map_S16S16_S16 1023.984 Fact_CrCtl2 -512.0000 511.9844 FORMAT "%8.4"
 /begin AXIS_DESCR STD_AXIS LLim_vDes_mp Vel 12 -327.6800 327.6700 FORMAT "%8.4" DEPOSIT ABSOLUTE /end AXIS_DESCR
 /begin AXIS_DESCR STD_AXIS LLim_vSpdDvt_mp Vel 9 -327.6800 327.6700 FORMAT "%8.4" DEPOSIT ABSOLUTE /end AXIS_DESCR
/end CHARACTERISTIC
/begin CHARACTERISTIC LLim_facFdbkD2LG_MAP "MAP for Feed Back D coefficient factor value (for 2 level lower gear)" MAP 0x80572E48 RB_Map_S16S16_S16 1023.984 Fact_CrCtl2 -512.0000 511.9844 FORMAT "%8.4"
 /begin AXIS_DESCR STD_AXIS LLim_vDes_mp Vel 12 -327.6800 327.6700 FORMAT "%8.4" DEPOSIT ABSOLUTE /end AXIS_DESCR
 /begin AXIS_DESCR STD_AXIS LLim_vSpdDvt_mp Vel 9 -327.6800 327.6700 FORMAT "%8.4" DEPOSIT ABSOLUTE /end AXIS_DESCR
/end CHARACTERISTIC
/begin CHARACTERISTIC LLim_facFdbkD3LG_MAP "MAP for Feed Back D coefficient factor value (for 3 level lower gear)" MAP 0x80572F4E RB_Map_S16S16_S16 1023.984 Fact_CrCtl2 -512.0000 511.9844 FORMAT "%8.4"
 /begin AXIS_DESCR STD_AXIS LLim_vDes_mp Vel 12 -327.6800 327.6700 FORMAT "%8.4" DEPOSIT ABSOLUTE /end AXIS_DESCR
 /begin AXIS_DESCR STD_AXIS LLim_vSpdDvt_mp Vel 9 -327.6800 327.6700 FORMAT "%8.4" DEPOSIT ABSOLUTE /end AXIS_DESCR
/end CHARACTERISTIC
/begin CHARACTERISTIC LLim_facFdbkD4LG_MAP "MAP for Feed Back D coefficient factor value (for 4 level lower gear)" MAP 0x80573054 RB_Map_S16S16_S16 1023.984 Fact_CrCtl2 -512.0000 511.9844 FORMAT "%8.4"
 /begin AXIS_DESCR STD_AXIS LLim_vDes_mp Vel 12 -327.6800 327.6700 FORMAT "%8.4" DEPOSIT ABSOLUTE /end AXIS_DESCR
 /begin AXIS_DESCR STD_AXIS LLim_vSpdDvt_mp Vel 9 -327.6800 327.6700 FORMAT "%8.4" DEPOSIT ABSOLUTE /end AXIS_DESCR
/end CHARACTERISTIC
/begin CHARACTERISTIC LLim_facFdbkD5LG_MAP "MAP for Feed Back D coefficient factor value (for 5 level lower gear)" MAP 0x8057315A RB_Map_S16S16_S16 1023.984 Fact_CrCtl2 -512.0000 511.9844 FORMAT "%8.4"
 /begin AXIS_DESCR STD_AXIS LLim_vDes_mp Vel 12 -327.6800 327.6700 FORMAT "%8.4" DEPOSIT ABSOLUTE /end AXIS_DESCR
 /begin AXIS_DESCR STD_AXIS LLim_vSpdDvt_mp Vel 9 -327.6800 327.6700 FORMAT "%8.4" DEPOSIT ABSOLUTE /end AXIS_DESCR
/end CHARACTERISTIC
/begin CHARACTERISTIC LLim_facFdbkDLmap_MAP "MAP for feedback D coefficient factor value (for L positions)" MAP 0x80573260 RB_Map_S16S16_S16 1023.984 Fact_CrCtl2 -512.0000 511.9844 FORMAT "%8.4"
 /begin AXIS_DESCR STD_AXIS LLim_vDes_mp Vel 12 -327.6800 327.6700 FORMAT "%8.4" DEPOSIT ABSOLUTE /end AXIS_DESCR
 /begin AXIS_DESCR STD_AXIS LLim_vSpdDvt_mp Vel 9 -327.6800 327.6700 FORMAT "%8.4" DEPOSIT ABSOLUTE /end AXIS_DESCR
/end CHARACTERISTIC
/begin CHARACTERISTIC LLim_facFdbkDTG_MAP "MAP for Feed Back D coefficient factor value (for the top gear)" MAP 0x80573366 RB_Map_S16S16_S16 1023.984 Fact_CrCtl2 -512.0000 511.9844 FORMAT "%8.4"
 /begin AXIS_DESCR STD_AXIS LLim_vDes_mp Vel 12 -327.6800 327.6700 FORMAT "%8.4" DEPOSIT ABSOLUTE /end AXIS_DESCR
 /begin AXIS_DESCR STD_AXIS LLim_vSpdDvt_mp Vel 9 -327.6800 327.6700 FORMAT "%8.4" DEPOSIT ABSOLUTE /end AXIS_DESCR
/end CHARACTERISTIC
/begin CHARACTERISTIC LLim_facFdbkP1LG_MAP "MAP for Feed Back P coefficient factor value (for 1 level lower gear)" MAP 0x8057346C RB_Map_S16S16_S16 63.99902 Fact_CrCtl3 -32.00000 31.99902 FORMAT "%8.5"
 /begin AXIS_DESCR STD_AXIS LLim_vDes_mp Vel 12 -327.6800 327.6700 FORMAT "%8.4" DEPOSIT ABSOLUTE /end AXIS_DESCR
 /begin AXIS_DESCR STD_AXIS LLim_vSpdDvt_mp Vel 9 -327.6800 327.6700 FORMAT "%8.4" DEPOSIT ABSOLUTE /end AXIS_DESCR
/end CHARACTERISTIC
/begin CHARACTERISTIC LLim_facFdbkP2LG_MAP "MAP for Feed Back P coefficient factor value (for 2 level lower gear)" MAP 0x80573572 RB_Map_S16S16_S16 63.99902 Fact_CrCtl3 -32.00000 31.99902 FORMAT "%8.5"
 /begin AXIS_DESCR STD_AXIS LLim_vDes_mp Vel 12 -327.6800 327.6700 FORMAT "%8.4" DEPOSIT ABSOLUTE /end AXIS_DESCR
 /begin AXIS_DESCR STD_AXIS LLim_vSpdDvt_mp Vel 9 -327.6800 327.6700 FORMAT "%8.4" DEPOSIT ABSOLUTE /end AXIS_DESCR
/end CHARACTERISTIC
/begin CHARACTERISTIC LLim_facFdbkP3LG_MAP "MAP for Feed Back P coefficient factor value (for 3 level lower gear)" MAP 0x80573678 RB_Map_S16S16_S16 63.99902 Fact_CrCtl3 -32.00000 31.99902 FORMAT "%8.5"
 /begin AXIS_DESCR STD_AXIS LLim_vDes_mp Vel 12 -327.6800 327.6700 FORMAT "%8.4" DEPOSIT ABSOLUTE /end AXIS_DESCR
 /begin AXIS_DESCR STD_AXIS LLim_vSpdDvt_mp Vel 9 -327.6800 327.6700 FORMAT "%8.4" DEPOSIT ABSOLUTE /end AXIS_DESCR
/end CHARACTERISTIC
/begin CHARACTERISTIC LLim_facFdbkP4LG_MAP "MAP for Feed Back P coefficient factor value (for 4 level lower gear)" MAP 0x8057377E RB_Map_S16S16_S16 63.99902 Fact_CrCtl3 -32.00000 31.99902 FORMAT "%8.5"
 /begin AXIS_DESCR STD_AXIS LLim_vDes_mp Vel 12 -327.6800 327.6700 FORMAT "%8.4" DEPOSIT ABSOLUTE /end AXIS_DESCR
 /begin AXIS_DESCR STD_AXIS LLim_vSpdDvt_mp Vel 9 -327.6800 327.6700 FORMAT "%8.4" DEPOSIT ABSOLUTE /end AXIS_DESCR
/end CHARACTERISTIC
/begin CHARACTERISTIC LLim_facFdbkP5LG_MAP "MAP for Feed Back P coefficient factor value (for 5 level lower gear)" MAP 0x80573884 RB_Map_S16S16_S16 63.99902 Fact_CrCtl3 -32.00000 31.99902 FORMAT "%8.5"
 /begin AXIS_DESCR STD_AXIS LLim_vDes_mp Vel 12 -327.6800 327.6700 FORMAT "%8.4" DEPOSIT ABSOLUTE /end AXIS_DESCR
 /begin AXIS_DESCR STD_AXIS LLim_vSpdDvt_mp Vel 9 -327.6800 327.6700 FORMAT "%8.4" DEPOSIT ABSOLUTE /end AXIS_DESCR
/end CHARACTERISTIC
/begin CHARACTERISTIC LLim_facFdbkPLmap_MAP "MAP for feedback P coefficient factor value (for L positions)" MAP 0x8057398A RB_Map_S16S16_S16 63.99902 Fact_CrCtl3 -32.00000 31.99902 FORMAT "%8.5"
 /begin AXIS_DESCR STD_AXIS LLim_vDes_mp Vel 12 -327.6800 327.6700 FORMAT "%8.4" DEPOSIT ABSOLUTE /end AXIS_DESCR
 /begin AXIS_DESCR STD_AXIS LLim_vSpdDvt_mp Vel 9 -327.6800 327.6700 FORMAT "%8.4" DEPOSIT ABSOLUTE /end AXIS_DESCR
/end CHARACTERISTIC
/begin CHARACTERISTIC LLim_facFdbkPTG_MAP "MAP for Feed Back P coefficient factor value (for the top gear)" MAP 0x80573A90 RB_Map_S16S16_S16 63.99902 Fact_CrCtl3 -32.00000 31.99902 FORMAT "%8.5"
 /begin AXIS_DESCR STD_AXIS LLim_vDes_mp Vel 12 -327.6800 327.6700 FORMAT "%8.4" DEPOSIT ABSOLUTE /end AXIS_DESCR
 /begin AXIS_DESCR STD_AXIS LLim_vSpdDvt_mp Vel 9 -327.6800 327.6700 FORMAT "%8.4" DEPOSIT ABSOLUTE /end AXIS_DESCR
/end CHARACTERISTIC
/begin CHARACTERISTIC LLim_facSpdUnConv_C "Factor of vehicle speed unit conversion data" VALUE 0x80573B96 Val_Ws16 255.9961 Fact_CrCtl -128.0000 127.9961 FORMAT "%8.4" /end CHARACTERISTIC
/begin CHARACTERISTIC LLim_facSptAPPDiffCor1LGCls_MAP "MAP for Correction factor based on difference of accel pedal position(for 1 level lower gear and close side) for sport mode" MAP 0x80573B98 RB_Map_S16S16_S16 511.9922 Fact1 -256.0000 255.9922 FORMAT "%8.4"
 /begin AXIS_DESCR STD_AXIS LLim_rDesReq_mp APPCrCtl1 12 -163.8400 163.8350 FORMAT "%8.4" DEPOSIT ABSOLUTE /end AXIS_DESCR
 /begin AXIS_DESCR STD_AXIS CrCtl_vASLVehCont Vel 12 -327.6800 327.6700 FORMAT "%8.4" DEPOSIT ABSOLUTE /end AXIS_DESCR
/end CHARACTERISTIC
/begin CHARACTERISTIC LLim_facSptAPPDiffCor1LG_MAP "MAP for Correction factor based on difference of accel pedal position(for 1 level lower gear and open side) for sport mode" MAP 0x80573CEC RB_Map_S16S16_S16 511.9922 Fact1 -256.0000 255.9922 FORMAT "%8.4"
 /begin AXIS_DESCR STD_AXIS LLim_rDesReq_mp APPCrCtl1 12 -163.8400 163.8350 FORMAT "%8.4" DEPOSIT ABSOLUTE /end AXIS_DESCR
 /begin AXIS_DESCR STD_AXIS CrCtl_vASLVehCont Vel 12 -327.6800 327.6700 FORMAT "%8.4" DEPOSIT ABSOLUTE /end AXIS_DESCR
/end CHARACTERISTIC
/begin CHARACTERISTIC LLim_facSptAPPDiffCor2LGCls_MAP "MAP for Correction factor based on difference of accel pedal position(for 2 level lower gear and close side) for sport mode" MAP 0x80573E40 RB_Map_S16S16_S16 511.9922 Fact1 -256.0000 255.9922 FORMAT "%8.4"
 /begin AXIS_DESCR STD_AXIS LLim_rDesReq_mp APPCrCtl1 12 -163.8400 163.8350 FORMAT "%8.4" DEPOSIT ABSOLUTE /end AXIS_DESCR
 /begin AXIS_DESCR STD_AXIS CrCtl_vASLVehCont Vel 12 -327.6800 327.6700 FORMAT "%8.4" DEPOSIT ABSOLUTE /end AXIS_DESCR
/end CHARACTERISTIC
/begin CHARACTERISTIC LLim_facSptAPPDiffCor2LG_MAP "MAP for Correction factor based on difference of accel pedal position(for 2 level lower gear and open side) for sport mode" MAP 0x80573F94 RB_Map_S16S16_S16 511.9922 Fact1 -256.0000 255.9922 FORMAT "%8.4"
 /begin AXIS_DESCR STD_AXIS LLim_rDesReq_mp APPCrCtl1 12 -163.8400 163.8350 FORMAT "%8.4" DEPOSIT ABSOLUTE /end AXIS_DESCR
 /begin AXIS_DESCR STD_AXIS CrCtl_vASLVehCont Vel 12 -327.6800 327.6700 FORMAT "%8.4" DEPOSIT ABSOLUTE /end AXIS_DESCR
/end CHARACTERISTIC
/begin CHARACTERISTIC LLim_facSptAPPDiffCor3LGCls_MAP "MAP for Correction factor based on difference of accel pedal position(for 3 level lower gear and close side) for sport mode" MAP 0x805740E8 RB_Map_S16S16_S16 511.9922 Fact1 -256.0000 255.9922 FORMAT "%8.4"
 /begin AXIS_DESCR STD_AXIS LLim_rDesReq_mp APPCrCtl1 12 -163.8400 163.8350 FORMAT "%8.4" DEPOSIT ABSOLUTE /end AXIS_DESCR
 /begin AXIS_DESCR STD_AXIS CrCtl_vASLVehCont Vel 12 -327.6800 327.6700 FORMAT "%8.4" DEPOSIT ABSOLUTE /end AXIS_DESCR
/end CHARACTERISTIC
/begin CHARACTERISTIC LLim_facSptAPPDiffCor3LG_MAP "MAP for Correction factor based on difference of accel pedal position(for 3 level lower gear and open side) for sport mode" MAP 0x8057423C RB_Map_S16S16_S16 511.9922 Fact1 -256.0000 255.9922 FORMAT "%8.4"
 /begin AXIS_DESCR STD_AXIS LLim_rDesReq_mp APPCrCtl1 12 -163.8400 163.8350 FORMAT "%8.4" DEPOSIT ABSOLUTE /end AXIS_DESCR
 /begin AXIS_DESCR STD_AXIS CrCtl_vASLVehCont Vel 12 -327.6800 327.6700 FORMAT "%8.4" DEPOSIT ABSOLUTE /end AXIS_DESCR
/end CHARACTERISTIC
/begin CHARACTERISTIC LLim_facSptAPPDiffCor4LGCls_MAP "MAP for Correction factor based on difference of accel pedal position(for 4 level lower gear and close side) for sport mode" MAP 0x80574390 RB_Map_S16S16_S16 511.9922 Fact1 -256.0000 255.9922 FORMAT "%8.4"
 /begin AXIS_DESCR STD_AXIS LLim_rDesReq_mp APPCrCtl1 12 -163.8400 163.8350 FORMAT "%8.4" DEPOSIT ABSOLUTE /end AXIS_DESCR
 /begin AXIS_DESCR STD_AXIS CrCtl_vASLVehCont Vel 12 -327.6800 327.6700 FORMAT "%8.4" DEPOSIT ABSOLUTE /end AXIS_DESCR
/end CHARACTERISTIC
/begin CHARACTERISTIC LLim_facSptAPPDiffCor4LG_MAP "MAP for Correction factor based on difference of accel pedal position(for 4 level lower gear and open side) for sport mode" MAP 0x805744E4 RB_Map_S16S16_S16 511.9922 Fact1 -256.0000 255.9922 FORMAT "%8.4"
 /begin AXIS_DESCR STD_AXIS LLim_rDesReq_mp APPCrCtl1 12 -163.8400 163.8350 FORMAT "%8.4" DEPOSIT ABSOLUTE /end AXIS_DESCR
 /begin AXIS_DESCR STD_AXIS CrCtl_vASLVehCont Vel 12 -327.6800 327.6700 FORMAT "%8.4" DEPOSIT ABSOLUTE /end AXIS_DESCR
/end CHARACTERISTIC
/begin CHARACTERISTIC LLim_facSptAPPDiffCor5LGCls_MAP "MAP for Correction factor based on difference of accel pedal position(for 5 level lower gear and close side) for sport mode" MAP 0x80574638 RB_Map_S16S16_S16 511.9922 Fact1 -256.0000 255.9922 FORMAT "%8.4"
 /begin AXIS_DESCR STD_AXIS LLim_rDesReq_mp APPCrCtl1 12 -163.8400 163.8350 FORMAT "%8.4" DEPOSIT ABSOLUTE /end AXIS_DESCR
 /begin AXIS_DESCR STD_AXIS CrCtl_vASLVehCont Vel 12 -327.6800 327.6700 FORMAT "%8.4" DEPOSIT ABSOLUTE /end AXIS_DESCR
/end CHARACTERISTIC
/begin CHARACTERISTIC LLim_facSptAPPDiffCor5LG_MAP "MAP for Correction factor based on difference of accel pedal position(for 5 level lower gear and open side) for sport mode" MAP 0x8057478C RB_Map_S16S16_S16 511.9922 Fact1 -256.0000 255.9922 FORMAT "%8.4"
 /begin AXIS_DESCR STD_AXIS LLim_rDesReq_mp APPCrCtl1 12 -163.8400 163.8350 FORMAT "%8.4" DEPOSIT ABSOLUTE /end AXIS_DESCR
 /begin AXIS_DESCR STD_AXIS CrCtl_vASLVehCont Vel 12 -327.6800 327.6700 FORMAT "%8.4" DEPOSIT ABSOLUTE /end AXIS_DESCR
/end CHARACTERISTIC
/begin CHARACTERISTIC LLim_facSptAPPdiffCorLmapCls_MAP "MAP for correction factor based on difference of accelerator pedal position(for L positions and close side)" MAP 0x805748E0 RB_Map_S16S16_S16 511.9922 Fact1 -256.0000 255.9922 FORMAT "%8.4"
 /begin AXIS_DESCR STD_AXIS LLim_rDesReq_mp APPCrCtl1 12 -163.8400 163.8350 FORMAT "%8.4" DEPOSIT ABSOLUTE /end AXIS_DESCR
 /begin AXIS_DESCR STD_AXIS CrCtl_vASLVehCont Vel 12 -327.6800 327.6700 FORMAT "%8.4" DEPOSIT ABSOLUTE /end AXIS_DESCR
/end CHARACTERISTIC
/begin CHARACTERISTIC LLim_facSptAPPdiffCorLmap_MAP "MAP for correction factor based on difference of accelerator pedal position(for L positions)" MAP 0x80574A34 RB_Map_S16S16_S16 511.9922 Fact1 -256.0000 255.9922 FORMAT "%8.4"
 /begin AXIS_DESCR STD_AXIS LLim_rDesReq_mp APPCrCtl1 12 -163.8400 163.8350 FORMAT "%8.4" DEPOSIT ABSOLUTE /end AXIS_DESCR
 /begin AXIS_DESCR STD_AXIS CrCtl_vASLVehCont Vel 12 -327.6800 327.6700 FORMAT "%8.4" DEPOSIT ABSOLUTE /end AXIS_DESCR
/end CHARACTERISTIC
/begin CHARACTERISTIC LLim_facSptAPPDiffCorTGCls_MAP "MAP for Correction factor based on difference of accel pedal position(for the top gear and close side) for sport mode" MAP 0x80574B88 RB_Map_S16S16_S16 511.9922 Fact1 -256.0000 255.9922 FORMAT "%8.4"
 /begin AXIS_DESCR STD_AXIS LLim_rDesReq_mp APPCrCtl1 12 -163.8400 163.8350 FORMAT "%8.4" DEPOSIT ABSOLUTE /end AXIS_DESCR
 /begin AXIS_DESCR STD_AXIS CrCtl_vASLVehCont Vel 12 -327.6800 327.6700 FORMAT "%8.4" DEPOSIT ABSOLUTE /end AXIS_DESCR
/end CHARACTERISTIC
/begin CHARACTERISTIC LLim_facSptAPPDiffCorTG_MAP "MAP for Correction factor based on difference of accel pedal position(for the top gear and open side) for sport mode" MAP 0x80574CDC RB_Map_S16S16_S16 511.9922 Fact1 -256.0000 255.9922 FORMAT "%8.4"
 /begin AXIS_DESCR STD_AXIS LLim_rDesReq_mp APPCrCtl1 12 -163.8400 163.8350 FORMAT "%8.4" DEPOSIT ABSOLUTE /end AXIS_DESCR
 /begin AXIS_DESCR STD_AXIS CrCtl_vASLVehCont Vel 12 -327.6800 327.6700 FORMAT "%8.4" DEPOSIT ABSOLUTE /end AXIS_DESCR
/end CHARACTERISTIC
/begin CHARACTERISTIC LLim_facSptFdbkAcclP1LG_CUR "Curve for acceleration Feed Back P coefficient factor value( for 1 level lower gear) for sport mode" CURVE 0x80574E30 RB_Curve_S16_S16 1023.984 Fact_CrCtl2 -512.0000 511.9844 FORMAT "%8.4"
 /begin AXIS_DESCR STD_AXIS CrCtl_vASLVehCont Vel 12 -327.6800 327.6700 FORMAT "%8.4" DEPOSIT ABSOLUTE /end AXIS_DESCR
/end CHARACTERISTIC
/begin CHARACTERISTIC LLim_facSptFdbkAcclP2LG_CUR "Curve for acceleration Feed Back P coefficient factor value( for 2 level lower gear) for sport mode" CURVE 0x80574E62 RB_Curve_S16_S16 1023.984 Fact_CrCtl2 -512.0000 511.9844 FORMAT "%8.4"
 /begin AXIS_DESCR STD_AXIS CrCtl_vASLVehCont Vel 12 -327.6800 327.6700 FORMAT "%8.4" DEPOSIT ABSOLUTE /end AXIS_DESCR
/end CHARACTERISTIC
/begin CHARACTERISTIC LLim_facSptFdbkAcclP3LG_CUR "Curve for acceleration Feed Back P coefficient factor value( for 3 level lower gear) for sport mode" CURVE 0x80574E94 RB_Curve_S16_S16 1023.984 Fact_CrCtl2 -512.0000 511.9844 FORMAT "%8.4"
 /begin AXIS_DESCR STD_AXIS CrCtl_vASLVehCont Vel 12 -327.6800 327.6700 FORMAT "%8.4" DEPOSIT ABSOLUTE /end AXIS_DESCR
/end CHARACTERISTIC
/begin CHARACTERISTIC LLim_facSptFdbkAcclP4LG_CUR "Curve for acceleration Feed Back P coefficient factor value( for 4 level lower gear) for sport mode" CURVE 0x80574EC6 RB_Curve_S16_S16 1023.984 Fact_CrCtl2 -512.0000 511.9844 FORMAT "%8.4"
 /begin AXIS_DESCR STD_AXIS CrCtl_vASLVehCont Vel 12 -327.6800 327.6700 FORMAT "%8.4" DEPOSIT ABSOLUTE /end AXIS_DESCR
/end CHARACTERISTIC
/begin CHARACTERISTIC LLim_facSptFdbkAcclP5LG_CUR "Curve for acceleration Feed Back P coefficient factor value( for 5 level lower gear) for sport mode" CURVE 0x80574EF8 RB_Curve_S16_S16 1023.984 Fact_CrCtl2 -512.0000 511.9844 FORMAT "%8.4"
 /begin AXIS_DESCR STD_AXIS CrCtl_vASLVehCont Vel 12 -327.6800 327.6700 FORMAT "%8.4" DEPOSIT ABSOLUTE /end AXIS_DESCR
/end CHARACTERISTIC
/begin CHARACTERISTIC LLim_facSptFdbkAcclPLmap_CUR "Curve for acceleration feedback P coefficient factor value( for L positions)" CURVE 0x80574F2A RB_Curve_S16_S16 1023.984 Fact_CrCtl2 -512.0000 511.9844 FORMAT "%8.4"
 /begin AXIS_DESCR STD_AXIS CrCtl_vASLVehCont Vel 12 -327.6800 327.6700 FORMAT "%8.4" DEPOSIT ABSOLUTE /end AXIS_DESCR
/end CHARACTERISTIC
/begin CHARACTERISTIC LLim_facSptFdbkAcclPTG_CUR "Curve for acceleration Feed Back P coefficient factor value( for the top gear) for sport mode" CURVE 0x80574F5C RB_Curve_S16_S16 1023.984 Fact_CrCtl2 -512.0000 511.9844 FORMAT "%8.4"
 /begin AXIS_DESCR STD_AXIS CrCtl_vASLVehCont Vel 12 -327.6800 327.6700 FORMAT "%8.4" DEPOSIT ABSOLUTE /end AXIS_DESCR
/end CHARACTERISTIC
/begin CHARACTERISTIC LLim_facSptFdbkD1LG_MAP "MAP for Feed Back D coefficient factor value (for 1 level lower gear) for sport mode" MAP 0x80574F8E RB_Map_S16S16_S16 1023.984 Fact_CrCtl2 -512.0000 511.9844 FORMAT "%8.4"
 /begin AXIS_DESCR STD_AXIS LLim_vDes_mp Vel 12 -327.6800 327.6700 FORMAT "%8.4" DEPOSIT ABSOLUTE /end AXIS_DESCR
 /begin AXIS_DESCR STD_AXIS LLim_vSpdDvt_mp Vel 9 -327.6800 327.6700 FORMAT "%8.4" DEPOSIT ABSOLUTE /end AXIS_DESCR
/end CHARACTERISTIC
/begin CHARACTERISTIC LLim_facSptFdbkD2LG_MAP "MAP for Feed Back D coefficient factor value (for 2 level lower gear) for sport mode" MAP 0x80575094 RB_Map_S16S16_S16 1023.984 Fact_CrCtl2 -512.0000 511.9844 FORMAT "%8.4"
 /begin AXIS_DESCR STD_AXIS LLim_vDes_mp Vel 12 -327.6800 327.6700 FORMAT "%8.4" DEPOSIT ABSOLUTE /end AXIS_DESCR
 /begin AXIS_DESCR STD_AXIS LLim_vSpdDvt_mp Vel 9 -327.6800 327.6700 FORMAT "%8.4" DEPOSIT ABSOLUTE /end AXIS_DESCR
/end CHARACTERISTIC
/begin CHARACTERISTIC LLim_facSptFdbkD3LG_MAP "MAP for Feed Back D coefficient factor value (for 3 level lower gear) for sport mode" MAP 0x8057519A RB_Map_S16S16_S16 1023.984 Fact_CrCtl2 -512.0000 511.9844 FORMAT "%8.4"
 /begin AXIS_DESCR STD_AXIS LLim_vDes_mp Vel 12 -327.6800 327.6700 FORMAT "%8.4" DEPOSIT ABSOLUTE /end AXIS_DESCR
 /begin AXIS_DESCR STD_AXIS LLim_vSpdDvt_mp Vel 9 -327.6800 327.6700 FORMAT "%8.4" DEPOSIT ABSOLUTE /end AXIS_DESCR
/end CHARACTERISTIC
/begin CHARACTERISTIC LLim_facSptFdbkD4LG_MAP "MAP for Feed Back D coefficient factor value (for 4 level lower gear) for sport mode" MAP 0x805752A0 RB_Map_S16S16_S16 1023.984 Fact_CrCtl2 -512.0000 511.9844 FORMAT "%8.4"
 /begin AXIS_DESCR STD_AXIS LLim_vDes_mp Vel 12 -327.6800 327.6700 FORMAT "%8.4" DEPOSIT ABSOLUTE /end AXIS_DESCR
 /begin AXIS_DESCR STD_AXIS LLim_vSpdDvt_mp Vel 9 -327.6800 327.6700 FORMAT "%8.4" DEPOSIT ABSOLUTE /end AXIS_DESCR
/end CHARACTERISTIC
/begin CHARACTERISTIC LLim_facSptFdbkD5LG_MAP "MAP for Feed Back D coefficient factor value (for 5 level lower gear) for sport mode" MAP 0x805753A6 RB_Map_S16S16_S16 1023.984 Fact_CrCtl2 -512.0000 511.9844 FORMAT "%8.4"
 /begin AXIS_DESCR STD_AXIS LLim_vDes_mp Vel 12 -327.6800 327.6700 FORMAT "%8.4" DEPOSIT ABSOLUTE /end AXIS_DESCR
 /begin AXIS_DESCR STD_AXIS LLim_vSpdDvt_mp Vel 9 -327.6800 327.6700 FORMAT "%8.4" DEPOSIT ABSOLUTE /end AXIS_DESCR
/end CHARACTERISTIC
/begin CHARACTERISTIC LLim_facSptFdbkDTG_MAP "MAP for Feed Back D coefficient factor value (for the top gear) for sport mode" MAP 0x805754AC RB_Map_S16S16_S16 1023.984 Fact_CrCtl2 -512.0000 511.9844 FORMAT "%8.4"
 /begin AXIS_DESCR STD_AXIS LLim_vDes_mp Vel 12 -327.6800 327.6700 FORMAT "%8.4" DEPOSIT ABSOLUTE /end AXIS_DESCR
 /begin AXIS_DESCR STD_AXIS LLim_vSpdDvt_mp Vel 9 -327.6800 327.6700 FORMAT "%8.4" DEPOSIT ABSOLUTE /end AXIS_DESCR
/end CHARACTERISTIC
/begin CHARACTERISTIC LLim_facSptFdbkP1LG_MAP "MAP for Feed Back P coefficient factor value (for 1 level lower gear) for sport mode" MAP 0x805755B2 RB_Map_S16S16_S16 63.99902 Fact_CrCtl3 -32.00000 31.99902 FORMAT "%8.5"
 /begin AXIS_DESCR STD_AXIS LLim_vDes_mp Vel 12 -327.6800 327.6700 FORMAT "%8.4" DEPOSIT ABSOLUTE /end AXIS_DESCR
 /begin AXIS_DESCR STD_AXIS LLim_vSpdDvt_mp Vel 9 -327.6800 327.6700 FORMAT "%8.4" DEPOSIT ABSOLUTE /end AXIS_DESCR
/end CHARACTERISTIC
/begin CHARACTERISTIC LLim_facSptFdbkP2LG_MAP "MAP for Feed Back P coefficient factor value (for 2 level lower gear) for sport mode" MAP 0x805756B8 RB_Map_S16S16_S16 63.99902 Fact_CrCtl3 -32.00000 31.99902 FORMAT "%8.5"
 /begin AXIS_DESCR STD_AXIS LLim_vDes_mp Vel 12 -327.6800 327.6700 FORMAT "%8.4" DEPOSIT ABSOLUTE /end AXIS_DESCR
 /begin AXIS_DESCR STD_AXIS LLim_vSpdDvt_mp Vel 9 -327.6800 327.6700 FORMAT "%8.4" DEPOSIT ABSOLUTE /end AXIS_DESCR
/end CHARACTERISTIC
/begin CHARACTERISTIC LLim_facSptFdbkP3LG_MAP "MAP for Feed Back P coefficient factor value (for 3 level lower gear) for sport mode" MAP 0x805757BE RB_Map_S16S16_S16 63.99902 Fact_CrCtl3 -32.00000 31.99902 FORMAT "%8.5"
 /begin AXIS_DESCR STD_AXIS LLim_vDes_mp Vel 12 -327.6800 327.6700 FORMAT "%8.4" DEPOSIT ABSOLUTE /end AXIS_DESCR
 /begin AXIS_DESCR STD_AXIS LLim_vSpdDvt_mp Vel 9 -327.6800 327.6700 FORMAT "%8.4" DEPOSIT ABSOLUTE /end AXIS_DESCR
/end CHARACTERISTIC
/begin CHARACTERISTIC LLim_facSptFdbkP4LG_MAP "MAP for Feed Back P coefficient factor value (for 4 level lower gear) for sport mode" MAP 0x805758C4 RB_Map_S16S16_S16 63.99902 Fact_CrCtl3 -32.00000 31.99902 FORMAT "%8.5"
 /begin AXIS_DESCR STD_AXIS LLim_vDes_mp Vel 12 -327.6800 327.6700 FORMAT "%8.4" DEPOSIT ABSOLUTE /end AXIS_DESCR
 /begin AXIS_DESCR STD_AXIS LLim_vSpdDvt_mp Vel 9 -327.6800 327.6700 FORMAT "%8.4" DEPOSIT ABSOLUTE /end AXIS_DESCR
/end CHARACTERISTIC
/begin CHARACTERISTIC LLim_facSptFdbkP5LG_MAP "MAP for Feed Back P coefficient factor value (for 5 level lower gear) for sport mode" MAP 0x805759CA RB_Map_S16S16_S16 63.99902 Fact_CrCtl3 -32.00000 31.99902 FORMAT "%8.5"
 /begin AXIS_DESCR STD_AXIS LLim_vDes_mp Vel 12 -327.6800 327.6700 FORMAT "%8.4" DEPOSIT ABSOLUTE /end AXIS_DESCR
 /begin AXIS_DESCR STD_AXIS LLim_vSpdDvt_mp Vel 9 -327.6800 327.6700 FORMAT "%8.4" DEPOSIT ABSOLUTE /end AXIS_DESCR
/end CHARACTERISTIC
/begin CHARACTERISTIC LLim_facSptFdbkPTG_MAP "MAP for Feed Back P coefficient factor value (for the top gear) for sport mode" MAP 0x80575AD0 RB_Map_S16S16_S16 63.99902 Fact_CrCtl3 -32.00000 31.99902 FORMAT "%8.5"
 /begin AXIS_DESCR STD_AXIS LLim_vDes_mp Vel 12 -327.6800 327.6700 FORMAT "%8.4" DEPOSIT ABSOLUTE /end AXIS_DESCR
 /begin AXIS_DESCR STD_AXIS LLim_vSpdDvt_mp Vel 9 -327.6800 327.6700 FORMAT "%8.4" DEPOSIT ABSOLUTE /end AXIS_DESCR
/end CHARACTERISTIC
/begin CHARACTERISTIC LLim_flgASLDispCncl_C "To enabledisable ASL display cancellation based on variant" VALUE 0x80575BD6 Val_Wu8 1.000 OneToOne 0.00 1.000 FORMAT "%5.3" EXTENDED_LIMITS 0.00 255.0 /end CHARACTERISTIC
/begin CHARACTERISTIC LLim_flgMemSpdDisp_C "To enabledisable Memory speed display based on variant" VALUE 0x80575BD7 Val_Wu8 1.000 OneToOne 0.00 1.000 FORMAT "%5.3" EXTENDED_LIMITS 0.00 255.0 /end CHARACTERISTIC
/begin CHARACTERISTIC LLim_flgMtrTypIndcnVehSpdASLCtrl_C "Meter type for indication of vehicle speed by ASL control" VALUE 0x80575BD8 Val_Wu8 1.000 OneToOne 0.00 1.000 FORMAT "%5.3" EXTENDED_LIMITS 0.00 255.0 /end CHARACTERISTIC
/begin CHARACTERISTIC LLim_nASLAppClsLrnStrtAdd_C "NE value to checking APP close learning start for ASL" VALUE 0x80575BDA Val_Ws16 65535.00 EngNCrCtl -32768.00 32767.00 FORMAT "%8.2" /end CHARACTERISTIC
/begin CHARACTERISTIC LLim_numASLResSel_C "Number to select operation when returning from resume control" VALUE 0x80575BDC Val_Wu8 127.0 OneToOne 0.00 127.0 FORMAT "%5.1" EXTENDED_LIMITS 0.00 255.0 /end CHARACTERISTIC
/begin CHARACTERISTIC LLim_numASLSpdInfoMOnNCtl_C "Vehicle speed dispay information for ASL when main sw on and no control" VALUE 0x80575BDE Val_Ws16 32767.00 OneToOne 0.00 32767.00 FORMAT "%8.2" EXTENDED_LIMITS -32768.00 32767.00 /end CHARACTERISTIC
/begin CHARACTERISTIC LLim_numISALimSpdOffsetLoMph_C "Offset lower limit of ISA limit speed (mph)" VALUE 0x80575BE0 Val_Wu8 255.0 OneToOne 0.00 255.0 FORMAT "%5.1" /end CHARACTERISTIC
/begin CHARACTERISTIC LLim_numISALimSpdOffsetLo_C "Offset lower limit of ISA limit speed (kmh)" VALUE 0x80575BE1 Val_Wu8 255.0 OneToOne 0.00 255.0 FORMAT "%5.1" /end CHARACTERISTIC
/begin CHARACTERISTIC LLim_numISALimSpdOffsetUpMph_C "Offset upper limit of ISA limit speed (mph)" VALUE 0x80575BE2 Val_Wu8 255.0 OneToOne 0.00 255.0 FORMAT "%5.1" /end CHARACTERISTIC
/begin CHARACTERISTIC LLim_numISALimSpdOffsetUp_C "Offset upper limit of ISA limit speed (kmh)" VALUE 0x80575BE3 Val_Wu8 255.0 OneToOne 0.00 255.0 FORMAT "%5.1" /end CHARACTERISTIC
/begin CHARACTERISTIC LLim_numISAMetType_C "Unit type for CC\ASL\ISA mode judgement 0: Meter unit 1: FI-ECU" VALUE 0x80575BE4 Val_Wu8 255.0 OneToOne 0.00 255.0 FORMAT "%5.1" /end CHARACTERISTIC
/begin CHARACTERISTIC LLim_numSpdInfoMOnNCtl_C "Vehicle speed dispay information for CC when main sw on and no control" VALUE 0x80575BE6 Val_Ws16 32767.00 OneToOne 0.00 32767.00 FORMAT "%8.2" EXTENDED_LIMITS -32768.00 32767.00 /end CHARACTERISTIC
/begin CHARACTERISTIC LLim_r10msAddVar_C "APP request every 10ms Add variant value" VALUE 0x80575BE8 Val_Ws16 327.6750 APPCrCtl1 -163.8400 163.8350 FORMAT "%8.4" /end CHARACTERISTIC
/begin CHARACTERISTIC LLim_r10msSubVar_C "APP request every 10ms Sub variant value" VALUE 0x80575BEA Val_Ws16 327.6750 APPCrCtl1 -163.8400 163.8350 FORMAT "%8.4" /end CHARACTERISTIC
/begin CHARACTERISTIC LLim_rAPPAddVal_C "Driver accel pedal position add value for ASL" VALUE 0x80575BEC Val_Ws16 327.6750 APPCrCtl1 -163.8400 163.8350 FORMAT "%8.4" /end CHARACTERISTIC
/begin CHARACTERISTIC LLim_rAPPFulChk_C "Accel pedal full open check value for ASL" VALUE 0x80575BEE Val_Ws16 327.6750 APPCrCtl1 -163.8400 163.8350 FORMAT "%8.4" /end CHARACTERISTIC
/begin CHARACTERISTIC LLim_rAPPLimTmpRlsAPP_C "Accel pedal value during enabling temporary release of APP limitation" VALUE 0x80575BF0 Val_Ws16 163.8350 APPCrCtl1 0.00 163.8350 FORMAT "%8.4" EXTENDED_LIMITS -163.8400 163.8350 /end CHARACTERISTIC
/begin CHARACTERISTIC LLim_rAPPMaxDevl_CUR "Curve for maximum accel pedal position for ASL (for development)" CURVE 0x80575BF2 RB_Curve_S16_S16 327.6750 APPCrCtl1 -163.8400 163.8350 FORMAT "%8.4"
 /begin AXIS_DESCR STD_AXIS LLim_vMemSpdFin_mp Vel 12 -327.6800 327.6700 FORMAT "%8.4" DEPOSIT ABSOLUTE /end AXIS_DESCR
/end CHARACTERISTIC
/begin CHARACTERISTIC LLim_rAPPMax_CUR "Curve for maximum accel pedal position for ASL" CURVE 0x80575C24 RB_Curve_S16_S16 327.6750 APPCrCtl1 -163.8400 163.8350 FORMAT "%8.4"
 /begin AXIS_DESCR STD_AXIS CrCtl_vASLVehCont Vel 12 -327.6800 327.6700 FORMAT "%8.4" DEPOSIT ABSOLUTE /end AXIS_DESCR
/end CHARACTERISTIC
/begin CHARACTERISTIC LLim_rAPPOff1LG_MAP "MAP for Accel pedal off output value(for 1 level lower gear)" MAP 0x80575C56 RB_Map_S16S16_S16 327.6750 APPCrCtl1 -163.8400 163.8350 FORMAT "%8.4"
 /begin AXIS_DESCR STD_AXIS CrCtl_vASLVehCont Vel 12 -327.6800 327.6700 FORMAT "%8.4" DEPOSIT ABSOLUTE /end AXIS_DESCR
 /begin AXIS_DESCR STD_AXIS CrCtl_rEstSlpFltVal Prc_CrCtl4 9 -128.0000 127.9961 FORMAT "%8.4" DEPOSIT ABSOLUTE /end AXIS_DESCR
/end CHARACTERISTIC
/begin CHARACTERISTIC LLim_rAPPOff2LG_MAP "MAP for Accel pedal off output value(for 2 level lower gear)" MAP 0x80575D5C RB_Map_S16S16_S16 327.6750 APPCrCtl1 -163.8400 163.8350 FORMAT "%8.4"
 /begin AXIS_DESCR STD_AXIS CrCtl_vASLVehCont Vel 12 -327.6800 327.6700 FORMAT "%8.4" DEPOSIT ABSOLUTE /end AXIS_DESCR
 /begin AXIS_DESCR STD_AXIS CrCtl_rEstSlpFltVal Prc_CrCtl4 9 -128.0000 127.9961 FORMAT "%8.4" DEPOSIT ABSOLUTE /end AXIS_DESCR
/end CHARACTERISTIC
/begin CHARACTERISTIC LLim_rAPPOff3LG_MAP "MAP for Accel pedal off output value(for 3 level lower gear)" MAP 0x80575E62 RB_Map_S16S16_S16 327.6750 APPCrCtl1 -163.8400 163.8350 FORMAT "%8.4"
 /begin AXIS_DESCR STD_AXIS CrCtl_vASLVehCont Vel 12 -327.6800 327.6700 FORMAT "%8.4" DEPOSIT ABSOLUTE /end AXIS_DESCR
 /begin AXIS_DESCR STD_AXIS CrCtl_rEstSlpFltVal Prc_CrCtl4 9 -128.0000 127.9961 FORMAT "%8.4" DEPOSIT ABSOLUTE /end AXIS_DESCR
/end CHARACTERISTIC
/begin CHARACTERISTIC LLim_rAPPOff4LG_MAP "MAP for Accel pedal off output value(for 4 level lower gear)" MAP 0x80575F68 RB_Map_S16S16_S16 327.6750 APPCrCtl1 -163.8400 163.8350 FORMAT "%8.4"
 /begin AXIS_DESCR STD_AXIS CrCtl_vASLVehCont Vel 12 -327.6800 327.6700 FORMAT "%8.4" DEPOSIT ABSOLUTE /end AXIS_DESCR
 /begin AXIS_DESCR STD_AXIS CrCtl_rEstSlpFltVal Prc_CrCtl4 9 -128.0000 127.9961 FORMAT "%8.4" DEPOSIT ABSOLUTE /end AXIS_DESCR
/end CHARACTERISTIC
/begin CHARACTERISTIC LLim_rAPPOff5LG_MAP "MAP for Accel pedal off output value(for 5 level lower gear)" MAP 0x8057606E RB_Map_S16S16_S16 327.6750 APPCrCtl1 -163.8400 163.8350 FORMAT "%8.4"
 /begin AXIS_DESCR STD_AXIS CrCtl_vASLVehCont Vel 12 -327.6800 327.6700 FORMAT "%8.4" DEPOSIT ABSOLUTE /end AXIS_DESCR
 /begin AXIS_DESCR STD_AXIS CrCtl_rEstSlpFltVal Prc_CrCtl4 9 -128.0000 127.9961 FORMAT "%8.4" DEPOSIT ABSOLUTE /end AXIS_DESCR
/end CHARACTERISTIC
/begin CHARACTERISTIC LLim_rAPPOffLmap_MAP "MAP for acceleration pedal off output value(for L positions)" MAP 0x80576174 RB_Map_S16S16_S16 327.6750 APPCrCtl1 -163.8400 163.8350 FORMAT "%8.4"
 /begin AXIS_DESCR STD_AXIS CrCtl_vASLVehCont Vel 12 -327.6800 327.6700 FORMAT "%8.4" DEPOSIT ABSOLUTE /end AXIS_DESCR
 /begin AXIS_DESCR STD_AXIS CrCtl_rEstSlpFltVal Prc_CrCtl4 9 -128.0000 127.9961 FORMAT "%8.4" DEPOSIT ABSOLUTE /end AXIS_DESCR
/end CHARACTERISTIC
/begin CHARACTERISTIC LLim_rAPPOffTG_MAP "MAP for Accel pedal off output value(for the top gear)" MAP 0x8057627A RB_Map_S16S16_S16 327.6750 APPCrCtl1 -163.8400 163.8350 FORMAT "%8.4"
 /begin AXIS_DESCR STD_AXIS CrCtl_vASLVehCont Vel 12 -327.6800 327.6700 FORMAT "%8.4" DEPOSIT ABSOLUTE /end AXIS_DESCR
 /begin AXIS_DESCR STD_AXIS CrCtl_rEstSlpFltVal Prc_CrCtl4 9 -128.0000 127.9961 FORMAT "%8.4" DEPOSIT ABSOLUTE /end AXIS_DESCR
/end CHARACTERISTIC
/begin CHARACTERISTIC LLim_rAPPReqSet1LG_MAP "MAP for Accel pedal opening when ASL SET(for 1 level lower gear)" MAP 0x80576380 RB_Map_S16S16_S16 327.6750 APPCrCtl1 -163.8400 163.8350 FORMAT "%8.4"
 /begin AXIS_DESCR STD_AXIS CrCtl_vASLVehCont Vel 12 -327.6800 327.6700 FORMAT "%8.4" DEPOSIT ABSOLUTE /end AXIS_DESCR
 /begin AXIS_DESCR STD_AXIS CrCtl_rEstSlpFltVal Prc_CrCtl4 9 -128.0000 127.9961 FORMAT "%8.4" DEPOSIT ABSOLUTE /end AXIS_DESCR
/end CHARACTERISTIC
/begin CHARACTERISTIC LLim_rAPPReqSet2LG_MAP "MAP for Accel pedal opening when ASL SET(for 2 level lower gear)" MAP 0x80576486 RB_Map_S16S16_S16 327.6750 APPCrCtl1 -163.8400 163.8350 FORMAT "%8.4"
 /begin AXIS_DESCR STD_AXIS CrCtl_vASLVehCont Vel 12 -327.6800 327.6700 FORMAT "%8.4" DEPOSIT ABSOLUTE /end AXIS_DESCR
 /begin AXIS_DESCR STD_AXIS CrCtl_rEstSlpFltVal Prc_CrCtl4 9 -128.0000 127.9961 FORMAT "%8.4" DEPOSIT ABSOLUTE /end AXIS_DESCR
/end CHARACTERISTIC
/begin CHARACTERISTIC LLim_rAPPReqSet3LG_MAP "MAP for Accel pedal opening when ASL SET(for 3 level lower gear)" MAP 0x8057658C RB_Map_S16S16_S16 327.6750 APPCrCtl1 -163.8400 163.8350 FORMAT "%8.4"
 /begin AXIS_DESCR STD_AXIS CrCtl_vASLVehCont Vel 12 -327.6800 327.6700 FORMAT "%8.4" DEPOSIT ABSOLUTE /end AXIS_DESCR
 /begin AXIS_DESCR STD_AXIS CrCtl_rEstSlpFltVal Prc_CrCtl4 9 -128.0000 127.9961 FORMAT "%8.4" DEPOSIT ABSOLUTE /end AXIS_DESCR
/end CHARACTERISTIC
/begin CHARACTERISTIC LLim_rAPPReqSet4LG_MAP "MAP for Accel pedal opening when ASL SET(for 4 level lower gear)" MAP 0x80576692 RB_Map_S16S16_S16 327.6750 APPCrCtl1 -163.8400 163.8350 FORMAT "%8.4"
 /begin AXIS_DESCR STD_AXIS CrCtl_vASLVehCont Vel 12 -327.6800 327.6700 FORMAT "%8.4" DEPOSIT ABSOLUTE /end AXIS_DESCR
 /begin AXIS_DESCR STD_AXIS CrCtl_rEstSlpFltVal Prc_CrCtl4 9 -128.0000 127.9961 FORMAT "%8.4" DEPOSIT ABSOLUTE /end AXIS_DESCR
/end CHARACTERISTIC
/begin CHARACTERISTIC LLim_rAPPReqSet5LG_MAP "MAP for Accel pedal opening when ASL SET(for 5 level lower gear)" MAP 0x80576798 RB_Map_S16S16_S16 327.6750 APPCrCtl1 -163.8400 163.8350 FORMAT "%8.4"
 /begin AXIS_DESCR STD_AXIS CrCtl_vASLVehCont Vel 12 -327.6800 327.6700 FORMAT "%8.4" DEPOSIT ABSOLUTE /end AXIS_DESCR
 /begin AXIS_DESCR STD_AXIS CrCtl_rEstSlpFltVal Prc_CrCtl4 9 -128.0000 127.9961 FORMAT "%8.4" DEPOSIT ABSOLUTE /end AXIS_DESCR
/end CHARACTERISTIC
/begin CHARACTERISTIC LLim_rAPPReqSetLmap_MAP "MAP for acceleration pedal opening when ASL SET(for L positions)" MAP 0x8057689E RB_Map_S16S16_S16 327.6750 APPCrCtl1 -163.8400 163.8350 FORMAT "%8.4"
 /begin AXIS_DESCR STD_AXIS CrCtl_vASLVehCont Vel 12 -327.6800 327.6700 FORMAT "%8.4" DEPOSIT ABSOLUTE /end AXIS_DESCR
 /begin AXIS_DESCR STD_AXIS CrCtl_rEstSlpFltVal Prc_CrCtl4 9 -128.0000 127.9961 FORMAT "%8.4" DEPOSIT ABSOLUTE /end AXIS_DESCR
/end CHARACTERISTIC
/begin CHARACTERISTIC LLim_rAPPReqSetTG_MAP "MAP for Accel pedal opening when ASL SET(for the top gear)" MAP 0x805769A4 RB_Map_S16S16_S16 327.6750 APPCrCtl1 -163.8400 163.8350 FORMAT "%8.4"
 /begin AXIS_DESCR STD_AXIS CrCtl_vASLVehCont Vel 12 -327.6800 327.6700 FORMAT "%8.4" DEPOSIT ABSOLUTE /end AXIS_DESCR
 /begin AXIS_DESCR STD_AXIS CrCtl_rEstSlpFltVal Prc_CrCtl4 9 -128.0000 127.9961 FORMAT "%8.4" DEPOSIT ABSOLUTE /end AXIS_DESCR
/end CHARACTERISTIC
/begin CHARACTERISTIC LLim_rAPPRetValAftLimRls_CUR "Accel pedal return value after finishing temporary release of APP limitation" CURVE 0x80576AAA RB_Curve_S16_S16 163.8350 APPCrCtl1 0.00 163.8350 FORMAT "%8.4" EXTENDED_LIMITS -163.8400 163.8350
 /begin AXIS_DESCR STD_AXIS LLim_rAPPLimTmpRlsAPPOld_mp APPCrCtl1 12 -163.8400 163.8350 FORMAT "%8.4" DEPOSIT ABSOLUTE /end AXIS_DESCR
/end CHARACTERISTIC
/begin CHARACTERISTIC LLim_rChngGearChkAPP_C "Accel pedal value to check the gear change operation" VALUE 0x80576ADC Val_Ws16 163.8350 APPCrCtl1 0.00 163.8350 FORMAT "%8.4" EXTENDED_LIMITS -163.8400 163.8350 /end CHARACTERISTIC
/begin CHARACTERISTIC LLim_rCnclAPPAdd_CUR "Curve for accel pedal position add value for ASL cancel" CURVE 0x80576ADE RB_Curve_S16_S16 327.6750 APPCrCtl1 -163.8400 163.8350 FORMAT "%8.4"
 /begin AXIS_DESCR STD_AXIS LLim_rAPPReqFin_mp APPCrCtl1 12 -163.8400 163.8350 FORMAT "%8.4" DEPOSIT ABSOLUTE /end AXIS_DESCR
/end CHARACTERISTIC
/begin CHARACTERISTIC LLim_rCnclIniAPPAdd_CUR "Curve for initial accel pedal position add value for ASL cancel" CURVE 0x80576B10 RB_Curve_S16_S16 327.6750 APPCrCtl1 -163.8400 163.8350 FORMAT "%8.4"
 /begin AXIS_DESCR STD_AXIS LLim_rAPPReqFin_mp APPCrCtl1 12 -163.8400 163.8350 FORMAT "%8.4" DEPOSIT ABSOLUTE /end AXIS_DESCR
/end CHARACTERISTIC
/begin CHARACTERISTIC LLim_rDesAddValFAStrt_CUR "Curve for addition value of desired accel pedal opening in ASL (For free area start)" CURVE 0x80576B42 RB_Curve_S16_S16 327.6750 APPCrCtl1 -163.8400 163.8350 FORMAT "%8.4"
 /begin AXIS_DESCR STD_AXIS CrCtl_vASLVehCont Vel 12 -327.6800 327.6700 FORMAT "%8.4" DEPOSIT ABSOLUTE /end AXIS_DESCR
/end CHARACTERISTIC
/begin CHARACTERISTIC LLim_rDesAddValFreeArea_CUR "Curve for addition value of desired accel pedal opening in ASL (For free area)" CURVE 0x80576B74 RB_Curve_S16_S16 327.6750 APPCrCtl1 -163.8400 163.8350 FORMAT "%8.4"
 /begin AXIS_DESCR STD_AXIS CrCtl_vASLVehCont Vel 12 -327.6800 327.6700 FORMAT "%8.4" DEPOSIT ABSOLUTE /end AXIS_DESCR
/end CHARACTERISTIC
/begin CHARACTERISTIC LLim_rDesAPPDiffLim_C "Limited value for difference of desired accel pedal position" VALUE 0x80576BA6 Val_Ws16 327.6750 APPCrCtl1 -163.8400 163.8350 FORMAT "%8.4" /end CHARACTERISTIC
/begin CHARACTERISTIC LLim_rDesSubVal_CUR "Curve for subtraction value of desired accel pedal opening in ASL" CURVE 0x80576BA8 RB_Curve_S16_S16 327.6750 APPCrCtl1 -163.8400 163.8350 FORMAT "%8.4"
 /begin AXIS_DESCR STD_AXIS CrCtl_vASLVehCont Vel 12 -327.6800 327.6700 FORMAT "%8.4" DEPOSIT ABSOLUTE /end AXIS_DESCR
/end CHARACTERISTIC
/begin CHARACTERISTIC LLim_rISACnclAPPAdd_CUR "Curve for accel pedal position add value for ISA cancel" CURVE 0x80576BDA RB_Curve_S16_S16 327.6750 APPCrCtl1 -163.8400 163.8350 FORMAT "%8.4"
 /begin AXIS_DESCR STD_AXIS LLim_rAPPReqFin_mp APPCrCtl1 12 -163.8400 163.8350 FORMAT "%8.4" DEPOSIT ABSOLUTE /end AXIS_DESCR
/end CHARACTERISTIC
/begin CHARACTERISTIC LLim_rISACnclIniAPPAdd_CUR "Curve for initial accel pedal position add value for ISA cancel" CURVE 0x80576C0C RB_Curve_S16_S16 327.6750 APPCrCtl1 -163.8400 163.8350 FORMAT "%8.4"
 /begin AXIS_DESCR STD_AXIS LLim_rAPPReqFin_mp APPCrCtl1 12 -163.8400 163.8350 FORMAT "%8.4" DEPOSIT ABSOLUTE /end AXIS_DESCR
/end CHARACTERISTIC
/begin CHARACTERISTIC LLim_rSptAPPMaxDevl_CUR "Curve for maximum accel pedal position for ASL (for development) for sport mode" CURVE 0x80576C3E RB_Curve_S16_S16 327.6750 APPCrCtl1 -163.8400 163.8350 FORMAT "%8.4"
 /begin AXIS_DESCR STD_AXIS LLim_vMemSpdFin_mp Vel 12 -327.6800 327.6700 FORMAT "%8.4" DEPOSIT ABSOLUTE /end AXIS_DESCR
/end CHARACTERISTIC
/begin CHARACTERISTIC LLim_rSptAPPOff1LG_MAP "MAP for Accel pedal off output value(for 1 level lower gear) for sport mode" MAP 0x80576C70 RB_Map_S16S16_S16 327.6750 APPCrCtl1 -163.8400 163.8350 FORMAT "%8.4"
 /begin AXIS_DESCR STD_AXIS CrCtl_vASLVehCont Vel 12 -327.6800 327.6700 FORMAT "%8.4" DEPOSIT ABSOLUTE /end AXIS_DESCR
 /begin AXIS_DESCR STD_AXIS CrCtl_rEstSlpFltVal Prc_CrCtl4 9 -128.0000 127.9961 FORMAT "%8.4" DEPOSIT ABSOLUTE /end AXIS_DESCR
/end CHARACTERISTIC
/begin CHARACTERISTIC LLim_rSptAPPOff2LG_MAP "MAP for Accel pedal off output value(for 2 level lower gear) for sport mode" MAP 0x80576D76 RB_Map_S16S16_S16 327.6750 APPCrCtl1 -163.8400 163.8350 FORMAT "%8.4"
 /begin AXIS_DESCR STD_AXIS CrCtl_vASLVehCont Vel 12 -327.6800 327.6700 FORMAT "%8.4" DEPOSIT ABSOLUTE /end AXIS_DESCR
 /begin AXIS_DESCR STD_AXIS CrCtl_rEstSlpFltVal Prc_CrCtl4 9 -128.0000 127.9961 FORMAT "%8.4" DEPOSIT ABSOLUTE /end AXIS_DESCR
/end CHARACTERISTIC
/begin CHARACTERISTIC LLim_rSptAPPOff3LG_MAP "MAP for Accel pedal off output value(for 3 level lower gear) for sport mode" MAP 0x80576E7C RB_Map_S16S16_S16 327.6750 APPCrCtl1 -163.8400 163.8350 FORMAT "%8.4"
 /begin AXIS_DESCR STD_AXIS CrCtl_vASLVehCont Vel 12 -327.6800 327.6700 FORMAT "%8.4" DEPOSIT ABSOLUTE /end AXIS_DESCR
 /begin AXIS_DESCR STD_AXIS CrCtl_rEstSlpFltVal Prc_CrCtl4 9 -128.0000 127.9961 FORMAT "%8.4" DEPOSIT ABSOLUTE /end AXIS_DESCR
/end CHARACTERISTIC
/begin CHARACTERISTIC LLim_rSptAPPOff4LG_MAP "MAP for Accel pedal off output value(for 4 level lower gear) for sport mode" MAP 0x80576F82 RB_Map_S16S16_S16 327.6750 APPCrCtl1 -163.8400 163.8350 FORMAT "%8.4"
 /begin AXIS_DESCR STD_AXIS CrCtl_vASLVehCont Vel 12 -327.6800 327.6700 FORMAT "%8.4" DEPOSIT ABSOLUTE /end AXIS_DESCR
 /begin AXIS_DESCR STD_AXIS CrCtl_rEstSlpFltVal Prc_CrCtl4 9 -128.0000 127.9961 FORMAT "%8.4" DEPOSIT ABSOLUTE /end AXIS_DESCR
/end CHARACTERISTIC
/begin CHARACTERISTIC LLim_rSptAPPOff5LG_MAP "MAP for Accel pedal off output value(for 5 level lower gear) for sport mode" MAP 0x80577088 RB_Map_S16S16_S16 327.6750 APPCrCtl1 -163.8400 163.8350 FORMAT "%8.4"
 /begin AXIS_DESCR STD_AXIS CrCtl_vASLVehCont Vel 12 -327.6800 327.6700 FORMAT "%8.4" DEPOSIT ABSOLUTE /end AXIS_DESCR
 /begin AXIS_DESCR STD_AXIS CrCtl_rEstSlpFltVal Prc_CrCtl4 9 -128.0000 127.9961 FORMAT "%8.4" DEPOSIT ABSOLUTE /end AXIS_DESCR
/end CHARACTERISTIC
/begin CHARACTERISTIC LLim_rSptAPPOffTG_MAP "MAP for Accel pedal off output value(for the top gear) for sport mode" MAP 0x8057718E RB_Map_S16S16_S16 327.6750 APPCrCtl1 -163.8400 163.8350 FORMAT "%8.4"
 /begin AXIS_DESCR STD_AXIS CrCtl_vASLVehCont Vel 12 -327.6800 327.6700 FORMAT "%8.4" DEPOSIT ABSOLUTE /end AXIS_DESCR
 /begin AXIS_DESCR STD_AXIS CrCtl_rEstSlpFltVal Prc_CrCtl4 9 -128.0000 127.9961 FORMAT "%8.4" DEPOSIT ABSOLUTE /end AXIS_DESCR
/end CHARACTERISTIC
/begin CHARACTERISTIC LLim_rSptAPPReqSet1LG_MAP "MAP for Accel pedal opening when ASL SET(for 1 level lower gear) for sport mode" MAP 0x80577294 RB_Map_S16S16_S16 327.6750 APPCrCtl1 -163.8400 163.8350 FORMAT "%8.4"
 /begin AXIS_DESCR STD_AXIS CrCtl_vASLVehCont Vel 12 -327.6800 327.6700 FORMAT "%8.4" DEPOSIT ABSOLUTE /end AXIS_DESCR
 /begin AXIS_DESCR STD_AXIS CrCtl_rEstSlpFltVal Prc_CrCtl4 9 -128.0000 127.9961 FORMAT "%8.4" DEPOSIT ABSOLUTE /end AXIS_DESCR
/end CHARACTERISTIC
/begin CHARACTERISTIC LLim_rSptAPPReqSet2LG_MAP "MAP for Accel pedal opening when ASL SET(for 2 level lower gear) for sport mode" MAP 0x8057739A RB_Map_S16S16_S16 327.6750 APPCrCtl1 -163.8400 163.8350 FORMAT "%8.4"
 /begin AXIS_DESCR STD_AXIS CrCtl_vASLVehCont Vel 12 -327.6800 327.6700 FORMAT "%8.4" DEPOSIT ABSOLUTE /end AXIS_DESCR
 /begin AXIS_DESCR STD_AXIS CrCtl_rEstSlpFltVal Prc_CrCtl4 9 -128.0000 127.9961 FORMAT "%8.4" DEPOSIT ABSOLUTE /end AXIS_DESCR
/end CHARACTERISTIC
/begin CHARACTERISTIC LLim_rSptAPPReqSet3LG_MAP "MAP for Accel pedal opening when ASL SET(for 3 level lower gear) for sport mode" MAP 0x805774A0 RB_Map_S16S16_S16 327.6750 APPCrCtl1 -163.8400 163.8350 FORMAT "%8.4"
 /begin AXIS_DESCR STD_AXIS CrCtl_vASLVehCont Vel 12 -327.6800 327.6700 FORMAT "%8.4" DEPOSIT ABSOLUTE /end AXIS_DESCR
 /begin AXIS_DESCR STD_AXIS CrCtl_rEstSlpFltVal Prc_CrCtl4 9 -128.0000 127.9961 FORMAT "%8.4" DEPOSIT ABSOLUTE /end AXIS_DESCR
/end CHARACTERISTIC
/begin CHARACTERISTIC LLim_rSptAPPReqSet4LG_MAP "MAP for Accel pedal opening when ASL SET(for 4 level lower gear) for sport mode" MAP 0x805775A6 RB_Map_S16S16_S16 327.6750 APPCrCtl1 -163.8400 163.8350 FORMAT "%8.4"
 /begin AXIS_DESCR STD_AXIS CrCtl_vASLVehCont Vel 12 -327.6800 327.6700 FORMAT "%8.4" DEPOSIT ABSOLUTE /end AXIS_DESCR
 /begin AXIS_DESCR STD_AXIS CrCtl_rEstSlpFltVal Prc_CrCtl4 9 -128.0000 127.9961 FORMAT "%8.4" DEPOSIT ABSOLUTE /end AXIS_DESCR
/end CHARACTERISTIC
/begin CHARACTERISTIC LLim_rSptAPPReqSet5LG_MAP "MAP for Accel pedal opening when ASL SET(for 5 level lower gear) for sport mode" MAP 0x805776AC RB_Map_S16S16_S16 327.6750 APPCrCtl1 -163.8400 163.8350 FORMAT "%8.4"
 /begin AXIS_DESCR STD_AXIS CrCtl_vASLVehCont Vel 12 -327.6800 327.6700 FORMAT "%8.4" DEPOSIT ABSOLUTE /end AXIS_DESCR
 /begin AXIS_DESCR STD_AXIS CrCtl_rEstSlpFltVal Prc_CrCtl4 9 -128.0000 127.9961 FORMAT "%8.4" DEPOSIT ABSOLUTE /end AXIS_DESCR
/end CHARACTERISTIC
/begin CHARACTERISTIC LLim_rSptAPPReqSetTG_MAP "MAP for Accel pedal opening when ASL SET(for the top gear) for sport mode" MAP 0x805777B2 RB_Map_S16S16_S16 327.6750 APPCrCtl1 -163.8400 163.8350 FORMAT "%8.4"
 /begin AXIS_DESCR STD_AXIS CrCtl_vASLVehCont Vel 12 -327.6800 327.6700 FORMAT "%8.4" DEPOSIT ABSOLUTE /end AXIS_DESCR
 /begin AXIS_DESCR STD_AXIS CrCtl_rEstSlpFltVal Prc_CrCtl4 9 -128.0000 127.9961 FORMAT "%8.4" DEPOSIT ABSOLUTE /end AXIS_DESCR
/end CHARACTERISTIC
/begin CHARACTERISTIC LLim_stAPPLrnSel_C "Switch to select APP learning method 0: TCU takes care 1: ECU takes care" VALUE 0x805778B8 Val_Wu8 1.000 OneToOne 0.00 1.000 FORMAT "%5.3" EXTENDED_LIMITS 0.00 255.0 /end CHARACTERISTIC
/begin CHARACTERISTIC LLim_stASLResCdnChk_C "Status for selecting resume control shift condition" VALUE 0x805778B9 Val_Wu8 1.000 OneToOne 0.00 1.000 FORMAT "%5.3" EXTENDED_LIMITS 0.00 255.0 /end CHARACTERISTIC
/begin CHARACTERISTIC LLim_stCCASLDataChkEna_C "Status for implementing mutual data check of CC and ASL" VALUE 0x805778BA Val_Wu8 1.000 OneToOne 0.00 1.000 FORMAT "%5.3" EXTENDED_LIMITS 0.00 255.0 /end CHARACTERISTIC
/begin CHARACTERISTIC LLim_stGearMapNo_CA "Array for Gear Map Number for longitudinal Limiter" VAL_BLK 0x805778BB ValA_Wu8 255.0 OneToOne 0.00 255.0 FORMAT "%5.1" NUMBER 5 /end CHARACTERISTIC
/begin CHARACTERISTIC LLim_stIDASTrqLowSelA_C "Calibration to determine the IDAS LLIM status based on information received from IDAS ECU" VALUE 0x805778C0 Val_Wu8 255.0 OneToOne 0.00 255.0 FORMAT "%5.1" /end CHARACTERISTIC
/begin CHARACTERISTIC LLim_stIDASTrqLowSelB_C "Calibration to determine the IDAS LLIM status based on information received from IDAS ECU" VALUE 0x805778C1 Val_Wu8 255.0 OneToOne 0.00 255.0 FORMAT "%5.1" /end CHARACTERISTIC
/begin CHARACTERISTIC LLim_stISAContTSRClr_C "ISA control continuation implementation selection when TSR is cleared 0: Not continue ISA control 1: Continue ISA control" VALUE 0x805778C2 Val_Wu8 1.000 OneToOne 0.00 1.000 FORMAT "%5.3" EXTENDED_LIMITS 0.00 255.0 /end CHARACTERISTIC
/begin CHARACTERISTIC LLim_stISATempStpAcclRecvr_C "Enable switch for recovering accel ratio at ISA temporary stop" VALUE 0x805778C3 Val_Wu8 255.0 OneToOne 0.00 255.0 FORMAT "%5.1" /end CHARACTERISTIC
/begin CHARACTERISTIC LLim_swtAcclLimDisbl_C "Software switch to desable of Acceleration limit" VALUE 0x805778C4 Val_Wu8 255.0 OneToOne 0.00 255.0 FORMAT "%5.1" /end CHARACTERISTIC
/begin CHARACTERISTIC LLim_swtAPPLimTmpRls_C "Switch to enable temporary release of APP limitation" VALUE 0x805778C5 Val_Wu8 1.000 OneToOne 0.00 1.000 FORMAT "%5.3" EXTENDED_LIMITS 0.00 255.0 /end CHARACTERISTIC
/begin CHARACTERISTIC LLim_swtAPPMinSel_C "Software switch to Minimum selected of accel pedal position" VALUE 0x805778C6 Val_Wu8 255.0 OneToOne 0.00 255.0 FORMAT "%5.1" /end CHARACTERISTIC
/begin CHARACTERISTIC LLim_swtASLAppClsLrnSel_C "Switch to select APP Close Learning for ASL" VALUE 0x805778C7 Val_Wu8 1.000 OneToOne 0.00 1.000 FORMAT "%5.3" EXTENDED_LIMITS 0.00 255.0 /end CHARACTERISTIC
/begin CHARACTERISTIC LLim_swtASLAppOpenLrnSel_C "Switch to select APP Open Learning for ASL" VALUE 0x805778C8 Val_Wu8 1.000 OneToOne 0.00 1.000 FORMAT "%5.3" EXTENDED_LIMITS 0.00 255.0 /end CHARACTERISTIC
/begin CHARACTERISTIC LLim_swtASLAppSel_C "Software switch of selecting acceleration pedal position for ASL" VALUE 0x805778C9 Val_Wu8 1.000 OneToOne 0.00 1.000 FORMAT "%5.3" EXTENDED_LIMITS 0.00 255.0 /end CHARACTERISTIC
/begin CHARACTERISTIC LLim_swtASLRxErrChkSel_C "Software switch for ASL Rx frame error detect selection" VALUE 0x805778CA Val_Wu8 1.000 OneToOne 0.00 1.000 FORMAT "%5.3" EXTENDED_LIMITS 0.00 255.0 /end CHARACTERISTIC
/begin CHARACTERISTIC LLim_swtCCSpdNoUpdReq_C "This selects whether alarm is triggered or not." VALUE 0x805778CB Val_Wu8 255.0 OneToOne 0.00 255.0 FORMAT "%5.1" /end CHARACTERISTIC
/begin CHARACTERISTIC LLim_swtCnclAcclLimEna_C "Software switch to enable of acceleration limit in case of ASL cancel" VALUE 0x805778CC Val_Wu8 255.0 OneToOne 0.00 255.0 FORMAT "%5.1" /end CHARACTERISTIC
/begin CHARACTERISTIC LLim_swtDevlLimSel_C "Switch to select APP limitation for development" VALUE 0x805778CD Val_Wu8 1.000 OneToOne 0.00 1.000 FORMAT "%5.3" EXTENDED_LIMITS 0.00 255.0 /end CHARACTERISTIC
/begin CHARACTERISTIC LLim_swtKickDwnClickCncl_C "Software switch to cancel of Kick down click" VALUE 0x805778CE Val_Wu8 1.000 OneToOne 0.00 1.000 FORMAT "%5.3" EXTENDED_LIMITS 0.00 255.0 /end CHARACTERISTIC
/begin CHARACTERISTIC LLim_swtResu1Disbl_C "Software switch for return to disable in case of resume" VALUE 0x805778CF Val_Wu8 1.000 OneToOne 0.00 1.000 FORMAT "%5.3" EXTENDED_LIMITS 0.00 255.0 /end CHARACTERISTIC
/begin CHARACTERISTIC LLim_swtSetSpdCorEna_C "Enable switch to correct set speed for ASL" VALUE 0x805778D0 Val_Wu8 1.000 OneToOne 0.00 1.000 FORMAT "%5.3" EXTENDED_LIMITS 0.00 255.0 /end CHARACTERISTIC
/begin CHARACTERISTIC LLim_swtSpdNoUpdReq_C "Switch that change requirement for no update set vehicle speed value show in meter display." VALUE 0x805778D1 Val_Wu8 1.000 OneToOne 0.00 1.000 FORMAT "%5.3" EXTENDED_LIMITS 0.00 255.0 /end CHARACTERISTIC
/begin CHARACTERISTIC LLim_tiAPPLimTmpRls_C "Timer to enable temporary release of APP limitation" VALUE 0x805778D2 Val_Ws16 3276700. Time_ms_100ms 0.00 3276700. FORMAT "%8.0" EXTENDED_LIMITS -3276800. 3276700. /end CHARACTERISTIC
/begin CHARACTERISTIC LLim_tiArChgAppSel_C "Time to change APP difference with area change" VALUE 0x805778D4 Val_Ws16 6553500. Time_ms_100ms -3276800. 3276700. FORMAT "%8.0" /end CHARACTERISTIC
/begin CHARACTERISTIC LLim_tiASLAppClsLrnStrtWait_C "Timer of waiting APP close learning start" VALUE 0x805778D6 Val_Ws16 327670.0 Time_ms 0.00 327670.0 FORMAT "%8.1" EXTENDED_LIMITS -327680.0 327670.0 /end CHARACTERISTIC
/begin CHARACTERISTIC LLim_tiASLAppClsLrnUpd0_C "Wait timer for first update of APP close learning value" VALUE 0x805778D8 Val_Ws16 3276700. Time_ms_100ms 0.00 3276700. FORMAT "%8.0" EXTENDED_LIMITS -3276800. 3276700. /end CHARACTERISTIC
/begin CHARACTERISTIC LLim_tiASLAppClsLrnUpd1_C "Wait timer for update of APP close learning value except first update" VALUE 0x805778DA Val_Ws16 3276700. Time_ms_100ms 0.00 3276700. FORMAT "%8.0" EXTENDED_LIMITS -3276800. 3276700. /end CHARACTERISTIC
/begin CHARACTERISTIC LLim_tiASLAppOpenAlrm_C "Timer of checking APP full open alarm continuation for ASL" VALUE 0x805778DC Val_Ws16 3276700. Time_ms_100ms 0.00 3276700. FORMAT "%8.0" EXTENDED_LIMITS -3276800. 3276700. /end CHARACTERISTIC
/begin CHARACTERISTIC LLim_tiASLAppOpenLrnStrt_C "Timer of checking APP open learning start" VALUE 0x805778DE Val_Ws16 327670.0 Time_ms 0.00 327670.0 FORMAT "%8.1" EXTENDED_LIMITS -327680.0 327670.0 /end CHARACTERISTIC
/begin CHARACTERISTIC LLim_tiASLRxErrChk_C "Time of ASL Rx Frame error check value" VALUE 0x805778E0 Val_Ws16 327670.0 Time_ms 0.00 327670.0 FORMAT "%8.1" EXTENDED_LIMITS -327680.0 327670.0 /end CHARACTERISTIC
/begin CHARACTERISTIC LLim_tiASLSet_C "Wait time until ASL state shift from PRESET to SET" VALUE 0x805778E2 Val_Ws16 327670.0 Time_ms 0.00 327670.0 FORMAT "%8.1" EXTENDED_LIMITS -327680.0 327670.0 /end CHARACTERISTIC
/begin CHARACTERISTIC LLim_tiCCASLDataErr_C "Time to detect mutual data check error of CC and ASL" VALUE 0x805778E4 Val_Ws16 327670.0 Time_ms 0.00 327670.0 FORMAT "%8.1" EXTENDED_LIMITS -327680.0 327670.0 /end CHARACTERISTIC
/begin CHARACTERISTIC LLim_tiCtlExtn_C "Time of ASL control extension" VALUE 0x805778E6 Val_Ws16 655350.0 Time_ms -327680.0 327670.0 FORMAT "%8.1" /end CHARACTERISTIC
/begin CHARACTERISTIC LLim_tiISACtlExtn_C "Time of ISA control extension" VALUE 0x805778E8 Val_Ws16 655350.0 Time_ms -327680.0 327670.0 FORMAT "%8.1" /end CHARACTERISTIC
/begin CHARACTERISTIC LLim_tiOvrSpdAlrmFin_C "Time of ASL over vehicle speed alarm finish check" VALUE 0x805778EA Val_Ws16 6553500. Time_ms_100ms -3276800. 3276700. FORMAT "%8.0" /end CHARACTERISTIC
/begin CHARACTERISTIC LLim_tiOvrSpdAlrmStrt2_C "Timer2 of ASL over vehicle speed alarm start check" VALUE 0x805778EC Val_Ws16 6553500. Time_ms_100ms -3276800. 3276700. FORMAT "%8.0" /end CHARACTERISTIC
/begin CHARACTERISTIC LLim_tiOvrSpdAlrmStrt_C "Time of ASL over vehicle speed alarm start check" VALUE 0x805778EE Val_Ws16 6553500. Time_ms_100ms -3276800. 3276700. FORMAT "%8.0" /end CHARACTERISTIC
/begin CHARACTERISTIC LLim_tiSetSpdBlnOff2_C "Time2 of Set vehicle speed Blink Off" VALUE 0x805778F0 Val_Ws16 6553500. Time_ms_100ms -3276800. 3276700. FORMAT "%8.0" /end CHARACTERISTIC
/begin CHARACTERISTIC LLim_tiSetSpdBlnOff3_C "Time3 of Set vehicle speed Blink Off" VALUE 0x805778F2 Val_Ws16 6553500. Time_ms_100ms -3276800. 3276700. FORMAT "%8.0" /end CHARACTERISTIC
/begin CHARACTERISTIC LLim_tiSetSpdBlnOff4_C "Time4 of Set vehicle speed Blink Off" VALUE 0x805778F4 Val_Ws16 6553500. Time_ms_100ms -3276800. 3276700. FORMAT "%8.0" /end CHARACTERISTIC
/begin CHARACTERISTIC LLim_tiSetSpdBlnOn2_C "Time2 of Set vehicle speed Blink On" VALUE 0x805778F6 Val_Ws16 6553500. Time_ms_100ms -3276800. 3276700. FORMAT "%8.0" /end CHARACTERISTIC
/begin CHARACTERISTIC LLim_tiSetSpdBlnOn3_C "Time3 of Set vehicle speed Blink On" VALUE 0x805778F8 Val_Ws16 6553500. Time_ms_100ms -3276800. 3276700. FORMAT "%8.0" /end CHARACTERISTIC
/begin CHARACTERISTIC LLim_tiSetSpdBlnOn4_C "Time4 of Set vehicle speed Blink On" VALUE 0x805778FA Val_Ws16 6553500. Time_ms_100ms -3276800. 3276700. FORMAT "%8.0" /end CHARACTERISTIC
/begin CHARACTERISTIC LLim_tqFcoDesHi_C "Upper hysteresis threshold for desired fuel cutoff" VALUE 0x80578940 Val_Ws32 429496729.500 TrqPrpHigh -214748364.800 214748364.700 FORMAT "%13.3" /end CHARACTERISTIC
/begin CHARACTERISTIC LLim_tqFcoDesLo_C "Lower hysteresis threshold for desired fuel cutoff" VALUE 0x80578944 Val_Ws32 429496729.500 TrqPrpHigh -214748364.800 214748364.700 FORMAT "%13.3" /end CHARACTERISTIC
/begin CHARACTERISTIC LLim_uASLAppClsLrnChkDvt_C "Differential voltage to check APP close learning start for ASL" VALUE 0x805778FC Val_Ws16 13107.00 Volt -6553.600 6553.400 FORMAT "%8.3" /end CHARACTERISTIC
/begin CHARACTERISTIC LLim_uASLAppClsLrnLoLim_C "Lower limit voltage of APP close learning for ASL" VALUE 0x805778FE Val_Ws16 13107.00 Volt -6553.600 6553.400 FORMAT "%8.3" /end CHARACTERISTIC
/begin CHARACTERISTIC LLim_uASLAppClsLrnUpLim_C "Upper limit voltage of APP close learning for ASL" VALUE 0x80577900 Val_Ws16 13107.00 Volt -6553.600 6553.400 FORMAT "%8.3" /end CHARACTERISTIC
/begin CHARACTERISTIC LLim_uASLAppClsNoLrn_C "Acceleration pedal sensor voltage value of close learning result for ASL" VALUE 0x80577902 Val_Ws16 13107.00 Volt -6553.600 6553.400 FORMAT "%8.3" /end CHARACTERISTIC
/begin CHARACTERISTIC LLim_uASLAppOpenChk_C "Voltage to check APP full open for ASL" VALUE 0x80577904 Val_Ws16 13107.00 Volt -6553.600 6553.400 FORMAT "%8.3" /end CHARACTERISTIC
/begin CHARACTERISTIC LLim_uASLAppOpenLrnLoLim_C "Lower limit voltage of APP open learning for ASL" VALUE 0x80577906 Val_Ws16 13107.00 Volt -6553.600 6553.400 FORMAT "%8.3" /end CHARACTERISTIC
/begin CHARACTERISTIC LLim_uASLAppOpenLrnUpLim_C "Upper limit voltage of APP open learning for ASL" VALUE 0x80577908 Val_Ws16 13107.00 Volt -6553.600 6553.400 FORMAT "%8.3" /end CHARACTERISTIC
/begin CHARACTERISTIC LLim_uASLAppSnsrErr_C "APP sensor volatage value during error condition" VALUE 0x8057790A Val_Ws16 13107.00 Volt -6553.600 6553.400 FORMAT "%8.3" /end CHARACTERISTIC
/begin CHARACTERISTIC LLim_uASLAppSnsrUpLim_C "Upper limit voltage of acceleration pedal position sensor" VALUE 0x8057790C Val_Ws16 13107.00 Volt -6553.600 6553.400 FORMAT "%8.3" /end CHARACTERISTIC
/begin CHARACTERISTIC LLim_vAcclLim_CUR "Curve for acceleration limit value for ASL" CURVE 0x8057790E RB_Curve_S16_S16 655.3500 Vel -327.6800 327.6700 FORMAT "%8.4"
 /begin AXIS_DESCR STD_AXIS CrCtl_vASLVehCont Vel 12 -327.6800 327.6700 FORMAT "%8.4" DEPOSIT ABSOLUTE /end AXIS_DESCR
/end CHARACTERISTIC
/begin CHARACTERISTIC LLim_vAPPLimTmpRlsSpdDvt_C "Vehicle speed deviation to continue temporary release of APP limitation" VALUE 0x80577940 Val_Ws16 655.3500 Vel -327.6800 327.6700 FORMAT "%8.4" /end CHARACTERISTIC
/begin CHARACTERISTIC LLim_vCnclAcclLim_CUR "Curve for acceleration limit value for ASL cancel" CURVE 0x80577942 RB_Curve_S16_S16 655.3500 Vel -327.6800 327.6700 FORMAT "%8.4"
 /begin AXIS_DESCR STD_AXIS CrCtl_vASLVehCont Vel 12 -327.6800 327.6700 FORMAT "%8.4" DEPOSIT ABSOLUTE /end AXIS_DESCR
/end CHARACTERISTIC
/begin CHARACTERISTIC LLim_vDLimHysHi1LG_CUR "Curve for ASL Vehicle spped for DL (hysteresis Hi) value(for 1 level lower gear)" CURVE 0x80577974 RB_Curve_S16_S16 655.3500 Vel -327.6800 327.6700 FORMAT "%8.4"
 /begin AXIS_DESCR STD_AXIS LLim_vDes_mp Vel 12 -327.6800 327.6700 FORMAT "%8.4" DEPOSIT ABSOLUTE /end AXIS_DESCR
/end CHARACTERISTIC
/begin CHARACTERISTIC LLim_vDLimHysHi2LG_CUR "Curve for ASL Vehicle spped for DL (hysteresis Hi) value(for 2 level lower gear)" CURVE 0x805779A6 RB_Curve_S16_S16 655.3500 Vel -327.6800 327.6700 FORMAT "%8.4"
 /begin AXIS_DESCR STD_AXIS LLim_vDes_mp Vel 12 -327.6800 327.6700 FORMAT "%8.4" DEPOSIT ABSOLUTE /end AXIS_DESCR
/end CHARACTERISTIC
/begin CHARACTERISTIC LLim_vDLimHysHi3LG_CUR "Curve for ASL Vehicle spped for DL (hysteresis Hi) value(for 3 level lower gear)" CURVE 0x805779D8 RB_Curve_S16_S16 655.3500 Vel -327.6800 327.6700 FORMAT "%8.4"
 /begin AXIS_DESCR STD_AXIS LLim_vDes_mp Vel 12 -327.6800 327.6700 FORMAT "%8.4" DEPOSIT ABSOLUTE /end AXIS_DESCR
/end CHARACTERISTIC
/begin CHARACTERISTIC LLim_vDLimHysHi4LG_CUR "Curve for ASL Vehicle spped for DL (hysteresis Hi) value(for 4 level lower gear)" CURVE 0x80577A0A RB_Curve_S16_S16 655.3500 Vel -327.6800 327.6700 FORMAT "%8.4"
 /begin AXIS_DESCR STD_AXIS LLim_vDes_mp Vel 12 -327.6800 327.6700 FORMAT "%8.4" DEPOSIT ABSOLUTE /end AXIS_DESCR
/end CHARACTERISTIC
/begin CHARACTERISTIC LLim_vDLimHysHi5LG_CUR "Curve for ASL Vehicle spped for DL (hysteresis Hi) value(for 5 level lower gear)" CURVE 0x80577A3C RB_Curve_S16_S16 655.3500 Vel -327.6800 327.6700 FORMAT "%8.4"
 /begin AXIS_DESCR STD_AXIS LLim_vDes_mp Vel 12 -327.6800 327.6700 FORMAT "%8.4" DEPOSIT ABSOLUTE /end AXIS_DESCR
/end CHARACTERISTIC
/begin CHARACTERISTIC LLim_vDLimHysHiLmap_CUR "Curve for ASL vehicle speed for DL (hysteresis Hi) value(for L positions)" CURVE 0x80577A6E RB_Curve_S16_S16 655.3500 Vel -327.6800 327.6700 FORMAT "%8.4"
 /begin AXIS_DESCR STD_AXIS LLim_vDes_mp Vel 12 -327.6800 327.6700 FORMAT "%8.4" DEPOSIT ABSOLUTE /end AXIS_DESCR
/end CHARACTERISTIC
/begin CHARACTERISTIC LLim_vDLimHysHiTG_CUR "Curve for ASL Vehicle spped for DL (hysteresis Hi) value(for the top gear)" CURVE 0x80577AA0 RB_Curve_S16_S16 655.3500 Vel -327.6800 327.6700 FORMAT "%8.4"
 /begin AXIS_DESCR STD_AXIS LLim_vDes_mp Vel 12 -327.6800 327.6700 FORMAT "%8.4" DEPOSIT ABSOLUTE /end AXIS_DESCR
/end CHARACTERISTIC
/begin CHARACTERISTIC LLim_vDLimHysLo1LG_CUR "Curve for ASL Vehicle spped for DL (hysteresis Lo) value(for 1 level lower gear)" CURVE 0x80577AD2 RB_Curve_S16_S16 655.3500 Vel -327.6800 327.6700 FORMAT "%8.4"
 /begin AXIS_DESCR STD_AXIS LLim_vDes_mp Vel 12 -327.6800 327.6700 FORMAT "%8.4" DEPOSIT ABSOLUTE /end AXIS_DESCR
/end CHARACTERISTIC
/begin CHARACTERISTIC LLim_vDLimHysLo2LG_CUR "Curve for ASL Vehicle spped for DL (hysteresis Lo) value(for 2 level lower gear)" CURVE 0x80577B04 RB_Curve_S16_S16 655.3500 Vel -327.6800 327.6700 FORMAT "%8.4"
 /begin AXIS_DESCR STD_AXIS LLim_vDes_mp Vel 12 -327.6800 327.6700 FORMAT "%8.4" DEPOSIT ABSOLUTE /end AXIS_DESCR
/end CHARACTERISTIC
/begin CHARACTERISTIC LLim_vDLimHysLo3LG_CUR "Curve for ASL Vehicle spped for DL (hysteresis Lo) value(for 3 level lower gear)" CURVE 0x80577B36 RB_Curve_S16_S16 655.3500 Vel -327.6800 327.6700 FORMAT "%8.4"
 /begin AXIS_DESCR STD_AXIS LLim_vDes_mp Vel 12 -327.6800 327.6700 FORMAT "%8.4" DEPOSIT ABSOLUTE /end AXIS_DESCR
/end CHARACTERISTIC
/begin CHARACTERISTIC LLim_vDLimHysLo4LG_CUR "Curve for ASL Vehicle spped for DL (hysteresis Lo) value(for 4 level lower gear)" CURVE 0x80577B68 RB_Curve_S16_S16 655.3500 Vel -327.6800 327.6700 FORMAT "%8.4"
 /begin AXIS_DESCR STD_AXIS LLim_vDes_mp Vel 12 -327.6800 327.6700 FORMAT "%8.4" DEPOSIT ABSOLUTE /end AXIS_DESCR
/end CHARACTERISTIC
/begin CHARACTERISTIC LLim_vDLimHysLo5LG_CUR "Curve for ASL Vehicle spped for DL (hysteresis Lo) value(for 5 level lower gear)" CURVE 0x80577B9A RB_Curve_S16_S16 655.3500 Vel -327.6800 327.6700 FORMAT "%8.4"
 /begin AXIS_DESCR STD_AXIS LLim_vDes_mp Vel 12 -327.6800 327.6700 FORMAT "%8.4" DEPOSIT ABSOLUTE /end AXIS_DESCR
/end CHARACTERISTIC
/begin CHARACTERISTIC LLim_vDLimHysLoLmap_CUR "Curve for ASL vehicle speed for DL (hysteresis Lo) value(for L positions)" CURVE 0x80577BCC RB_Curve_S16_S16 655.3500 Vel -327.6800 327.6700 FORMAT "%8.4"
 /begin AXIS_DESCR STD_AXIS LLim_vDes_mp Vel 12 -327.6800 327.6700 FORMAT "%8.4" DEPOSIT ABSOLUTE /end AXIS_DESCR
/end CHARACTERISTIC
/begin CHARACTERISTIC LLim_vDLimHysLoTG_CUR "Curve for ASL Vehicle spped for DL (hysteresis Lo) value(for the top gear)" CURVE 0x80577BFE RB_Curve_S16_S16 655.3500 Vel -327.6800 327.6700 FORMAT "%8.4"
 /begin AXIS_DESCR STD_AXIS LLim_vDes_mp Vel 12 -327.6800 327.6700 FORMAT "%8.4" DEPOSIT ABSOLUTE /end AXIS_DESCR
/end CHARACTERISTIC
/begin CHARACTERISTIC LLim_vDvtSpdOvrAlrmHysHi_C "Vehicle speed deviation value for over speed alarm check(hysteresis Hi)" VALUE 0x80577C30 Val_Ws16 655.3500 Vel -327.6800 327.6700 FORMAT "%8.4" /end CHARACTERISTIC
/begin CHARACTERISTIC LLim_vDvtSpdOvrAlrmHysLo_C "Vehicle speed deviation value for over speed alarm check(hysteresis Lo)" VALUE 0x80577C32 Val_Ws16 655.3500 Vel -327.6800 327.6700 FORMAT "%8.4" /end CHARACTERISTIC
/begin CHARACTERISTIC LLim_vISACnclAcclLim_CUR "Curve for acceleration limit value for ISA cancel" CURVE 0x80577C34 RB_Curve_S16_S16 655.3500 Vel -327.6800 327.6700 FORMAT "%8.4"
 /begin AXIS_DESCR STD_AXIS CrCtl_vASLVehCont Vel 12 -327.6800 327.6700 FORMAT "%8.4" DEPOSIT ABSOLUTE /end AXIS_DESCR
/end CHARACTERISTIC
/begin CHARACTERISTIC LLim_vISAMemSpdLoLimKmh_C "ISA memory lower limit vehicle speed (kmh)" VALUE 0x80577C66 Val_Ws16 655.3500 Vel -327.6800 327.6700 FORMAT "%8.4" /end CHARACTERISTIC
/begin CHARACTERISTIC LLim_vISAMemSpdLoLimMPH_C "ISA memory lower limit vehicle speed (MPH)" VALUE 0x80577C68 Val_Ws32 16777215.9961 Vel_CrCtl_MPH -8388608.00000 8388607.99609 FORMAT "%13.5" /end CHARACTERISTIC
/begin CHARACTERISTIC LLim_vLimSpdIniUpdKmh_C "Initial updated amount of limited veh speed during ASL SW is on (km/h)" VALUE 0x80577C6C Val_Ws16 65535.00 Vel_CrCtl1 -32768.00 32767.00 FORMAT "%8.2" /end CHARACTERISTIC
/begin CHARACTERISTIC LLim_vLimSpdIniUpdMPH_C "Initial updated amount of limited veh speed during ASL SW is on (MPH)" VALUE 0x80577C6E Val_Ws16 65535.00 Vel_CrCtl1_MPH -32768.00 32767.00 FORMAT "%8.2" /end CHARACTERISTIC
/begin CHARACTERISTIC LLim_vLimSpdUpdKmh_C "Updated amount of limited veh speed during ASL SW is on (km/h)" VALUE 0x80577C70 Val_Ws16 65535.00 Vel_CrCtl1 -32768.00 32767.00 FORMAT "%8.2" /end CHARACTERISTIC
/begin CHARACTERISTIC LLim_vLimSpdUpdMPH_C "Updated amount of limited veh speed during ASL SW is on (MPH)" VALUE 0x80577C72 Val_Ws16 65535.00 Vel_CrCtl1_MPH -32768.00 32767.00 FORMAT "%8.2" /end CHARACTERISTIC
/begin CHARACTERISTIC LLim_vMaxFixdFailr_C "The limitation of vehicle speed when failure happened" VALUE 0x80578948 Val_Ws16 655.3500 Vel -327.6800 327.6700 FORMAT "%8.4" /end CHARACTERISTIC
/begin CHARACTERISTIC LLim_vMaxFix_C "Maximum Speed Limit" VALUE 0x8057894A Val_Ws16 655.3500 Vel -327.6800 327.6700 FORMAT "%8.4" /end CHARACTERISTIC
/begin CHARACTERISTIC LLim_vMaxSlopFailr_C "The ramp slope to make vehicle speed slow down gra-dually till reached the limitation" VALUE 0x8057894C Val_Ws16 9.999847 q6553p6_RmpVel_low -5.000000 4.999847 FORMAT "%8.6" /end CHARACTERISTIC
/begin CHARACTERISTIC LLim_vMemSpdCorKmh_C "Correct value of memory speed for ASL (km/h)" VALUE 0x80577C74 Val_Ws16 655.3500 Vel -327.6800 327.6700 FORMAT "%8.4" /end CHARACTERISTIC
/begin CHARACTERISTIC LLim_vMemSpdCorMPH_C "Correct value of memory speed for ASL (MPH)" VALUE 0x80577C76 Val_Ws16 65535.00 Vel_CrCtl1_MPH -32768.00 32767.00 FORMAT "%8.2" /end CHARACTERISTIC
/begin CHARACTERISTIC LLim_vMemSpdKMHOffsHysHi_C "High threshold for vehicle speed memory offset in KMPH" VALUE 0x80577C78 Val_Wu16 655.3500 Vel 0.00 655.3500 FORMAT "%8.4" /end CHARACTERISTIC
/begin CHARACTERISTIC LLim_vMemSpdKMHOffsHysLo_C "Low threshold for vehicle speed memory offset in KMPH" VALUE 0x80577C7A Val_Wu16 655.3500 Vel 0.00 655.3500 FORMAT "%8.4" /end CHARACTERISTIC
/begin CHARACTERISTIC LLim_vMemSpdLoLimKmh_C "Lower limit of the memeory vehicle speed for ASL(km/h)" VALUE 0x80577C7C Val_Ws16 655.3500 Vel -327.6800 327.6700 FORMAT "%8.4" /end CHARACTERISTIC
/begin CHARACTERISTIC LLim_vMemSpdLoLimMPH_C "Lower limit of the memeory vehicle speed for ASL(MPH)" VALUE 0x80577C80 Val_Ws32 16777215.9961 Vel_CrCtl_MPH -8388608.00000 8388607.99609 FORMAT "%13.5" /end CHARACTERISTIC
/begin CHARACTERISTIC LLim_vMemSpdMPHOffsHysHi_C "High threshold for vehicle speed memory offset in MPH" VALUE 0x80577C84 Val_Wu16 655.3500 Vel 0.00 655.3500 FORMAT "%8.4" /end CHARACTERISTIC
/begin CHARACTERISTIC LLim_vMemSpdMPHOffsHysLo_C "Low threshold for vehicle speed memory offset in MPH" VALUE 0x80577C86 Val_Wu16 655.3500 Vel 0.00 655.3500 FORMAT "%8.4" /end CHARACTERISTIC
/begin CHARACTERISTIC LLim_vMemSpdUpLimKmh_C "Upper limit of the memeory vehicle speed for ASL(km/h)" VALUE 0x80577C88 Val_Ws16 655.3500 Vel -327.6800 327.6700 FORMAT "%8.4" /end CHARACTERISTIC
/begin CHARACTERISTIC LLim_vMemSpdUpLimMPH_C "Upper limit of the memeory vehicle speed for ASL(MPH)" VALUE 0x80577C8C Val_Ws32 16777215.9961 Vel_CrCtl_MPH -8388608.00000 8388607.99609 FORMAT "%13.5" /end CHARACTERISTIC
/begin CHARACTERISTIC LLim_vNoCtlPntHysHi1LG_CUR "Curve fir ASL Vehicle spped for non control point (hysteresis Hi) value(for 1 level lower gear)" CURVE 0x80577C90 RB_Curve_S16_S16 655.3500 Vel -327.6800 327.6700 FORMAT "%8.4"
 /begin AXIS_DESCR STD_AXIS LLim_vDes_mp Vel 12 -327.6800 327.6700 FORMAT "%8.4" DEPOSIT ABSOLUTE /end AXIS_DESCR
/end CHARACTERISTIC
/begin CHARACTERISTIC LLim_vNoCtlPntHysHi2LG_CUR "Curve fir ASL Vehicle spped for non control point (hysteresis Hi) value(for 2 level lower gear)" CURVE 0x80577CC2 RB_Curve_S16_S16 655.3500 Vel -327.6800 327.6700 FORMAT "%8.4"
 /begin AXIS_DESCR STD_AXIS LLim_vDes_mp Vel 12 -327.6800 327.6700 FORMAT "%8.4" DEPOSIT ABSOLUTE /end AXIS_DESCR
/end CHARACTERISTIC
/begin CHARACTERISTIC LLim_vNoCtlPntHysHi3LG_CUR "Curve fir ASL Vehicle spped for non control point (hysteresis Hi) value(for 3 level lower gear)" CURVE 0x80577CF4 RB_Curve_S16_S16 655.3500 Vel -327.6800 327.6700 FORMAT "%8.4"
 /begin AXIS_DESCR STD_AXIS LLim_vDes_mp Vel 12 -327.6800 327.6700 FORMAT "%8.4" DEPOSIT ABSOLUTE /end AXIS_DESCR
/end CHARACTERISTIC
/begin CHARACTERISTIC LLim_vNoCtlPntHysHi4LG_CUR "Curve fir ASL Vehicle spped for non control point (hysteresis Hi) value(for 4 level lower gear)" CURVE 0x80577D26 RB_Curve_S16_S16 655.3500 Vel -327.6800 327.6700 FORMAT "%8.4"
 /begin AXIS_DESCR STD_AXIS LLim_vDes_mp Vel 12 -327.6800 327.6700 FORMAT "%8.4" DEPOSIT ABSOLUTE /end AXIS_DESCR
/end CHARACTERISTIC
/begin CHARACTERISTIC LLim_vNoCtlPntHysHi5LG_CUR "Curve fir ASL Vehicle spped for non control point (hysteresis Hi) value(for 5 level lower gear)" CURVE 0x80577D58 RB_Curve_S16_S16 655.3500 Vel -327.6800 327.6700 FORMAT "%8.4"
 /begin AXIS_DESCR STD_AXIS LLim_vDes_mp Vel 12 -327.6800 327.6700 FORMAT "%8.4" DEPOSIT ABSOLUTE /end AXIS_DESCR
/end CHARACTERISTIC
/begin CHARACTERISTIC LLim_vNoCtlPntHysHiLmap_CUR "Curve for ASL vehicle speed for non control point (hysteresis Hi) value(for L positions)" CURVE 0x80577D8A RB_Curve_S16_S16 655.3500 Vel -327.6800 327.6700 FORMAT "%8.4"
 /begin AXIS_DESCR STD_AXIS LLim_vDes_mp Vel 12 -327.6800 327.6700 FORMAT "%8.4" DEPOSIT ABSOLUTE /end AXIS_DESCR
/end CHARACTERISTIC
/begin CHARACTERISTIC LLim_vNoCtlPntHysHiTG_CUR "Curve fir ASL Vehicle spped for non control point (hysteresis Hi) value(for the top gear)" CURVE 0x80577DBC RB_Curve_S16_S16 655.3500 Vel -327.6800 327.6700 FORMAT "%8.4"
 /begin AXIS_DESCR STD_AXIS LLim_vDes_mp Vel 12 -327.6800 327.6700 FORMAT "%8.4" DEPOSIT ABSOLUTE /end AXIS_DESCR
/end CHARACTERISTIC
/begin CHARACTERISTIC LLim_vNoCtlPntHysLo1LG_CUR "Curve fir ASL Vehicle spped for non control point (hysteresis Lo) value(for 1 level lower gear)" CURVE 0x80577DEE RB_Curve_S16_S16 655.3500 Vel -327.6800 327.6700 FORMAT "%8.4"
 /begin AXIS_DESCR STD_AXIS LLim_vDes_mp Vel 12 -327.6800 327.6700 FORMAT "%8.4" DEPOSIT ABSOLUTE /end AXIS_DESCR
/end CHARACTERISTIC
/begin CHARACTERISTIC LLim_vNoCtlPntHysLo2LG_CUR "Curve fir ASL Vehicle spped for non control point (hysteresis Lo) value(for 2 level lower gear)" CURVE 0x80577E20 RB_Curve_S16_S16 655.3500 Vel -327.6800 327.6700 FORMAT "%8.4"
 /begin AXIS_DESCR STD_AXIS LLim_vDes_mp Vel 12 -327.6800 327.6700 FORMAT "%8.4" DEPOSIT ABSOLUTE /end AXIS_DESCR
/end CHARACTERISTIC
/begin CHARACTERISTIC LLim_vNoCtlPntHysLo3LG_CUR "Curve fir ASL Vehicle spped for non control point (hysteresis Lo) value(for 3 level lower gear)" CURVE 0x80577E52 RB_Curve_S16_S16 655.3500 Vel -327.6800 327.6700 FORMAT "%8.4"
 /begin AXIS_DESCR STD_AXIS LLim_vDes_mp Vel 12 -327.6800 327.6700 FORMAT "%8.4" DEPOSIT ABSOLUTE /end AXIS_DESCR
/end CHARACTERISTIC
/begin CHARACTERISTIC LLim_vNoCtlPntHysLo4LG_CUR "Curve fir ASL Vehicle spped for non control point (hysteresis Lo) value(for 4 level lower gear)" CURVE 0x80577E84 RB_Curve_S16_S16 655.3500 Vel -327.6800 327.6700 FORMAT "%8.4"
 /begin AXIS_DESCR STD_AXIS LLim_vDes_mp Vel 12 -327.6800 327.6700 FORMAT "%8.4" DEPOSIT ABSOLUTE /end AXIS_DESCR
/end CHARACTERISTIC
/begin CHARACTERISTIC LLim_vNoCtlPntHysLo5LG_CUR "Curve fir ASL Vehicle spped for non control point (hysteresis Lo) value(for 5 level lower gear)" CURVE 0x80577EB6 RB_Curve_S16_S16 655.3500 Vel -327.6800 327.6700 FORMAT "%8.4"
 /begin AXIS_DESCR STD_AXIS LLim_vDes_mp Vel 12 -327.6800 327.6700 FORMAT "%8.4" DEPOSIT ABSOLUTE /end AXIS_DESCR
/end CHARACTERISTIC
/begin CHARACTERISTIC LLim_vNoCtlPntHysLoLmap_CUR "Curve for ASL vehicle speed for non control point (hysteresis Lo) value(for L positions)" CURVE 0x80577EE8 RB_Curve_S16_S16 655.3500 Vel -327.6800 327.6700 FORMAT "%8.4"
 /begin AXIS_DESCR STD_AXIS LLim_vDes_mp Vel 12 -327.6800 327.6700 FORMAT "%8.4" DEPOSIT ABSOLUTE /end AXIS_DESCR
/end CHARACTERISTIC
/begin CHARACTERISTIC LLim_vNoCtlPntHysLoTG_CUR "Curve fir ASL Vehicle spped for non control point (hysteresis Lo) value(for the top gear)" CURVE 0x80577F1A RB_Curve_S16_S16 655.3500 Vel -327.6800 327.6700 FORMAT "%8.4"
 /begin AXIS_DESCR STD_AXIS LLim_vDes_mp Vel 12 -327.6800 327.6700 FORMAT "%8.4" DEPOSIT ABSOLUTE /end AXIS_DESCR
/end CHARACTERISTIC
/begin CHARACTERISTIC LLim_vRPntHysHi1LG_CUR "Curve for ASL Vehicle spped for RP (hysteresis Hi) value(for 1 level lower gear)" CURVE 0x80577F4C RB_Curve_S16_S16 655.3500 Vel -327.6800 327.6700 FORMAT "%8.4"
 /begin AXIS_DESCR STD_AXIS LLim_vDes_mp Vel 12 -327.6800 327.6700 FORMAT "%8.4" DEPOSIT ABSOLUTE /end AXIS_DESCR
/end CHARACTERISTIC
/begin CHARACTERISTIC LLim_vRPntHysHi2LG_CUR "Curve for ASL Vehicle spped for RP (hysteresis Hi) value(for 2 level lower gear)" CURVE 0x80577F7E RB_Curve_S16_S16 655.3500 Vel -327.6800 327.6700 FORMAT "%8.4"
 /begin AXIS_DESCR STD_AXIS LLim_vDes_mp Vel 12 -327.6800 327.6700 FORMAT "%8.4" DEPOSIT ABSOLUTE /end AXIS_DESCR
/end CHARACTERISTIC
/begin CHARACTERISTIC LLim_vRPntHysHi3LG_CUR "Curve for ASL Vehicle spped for RP (hysteresis Hi) value(for 3 level lower gear)" CURVE 0x80577FB0 RB_Curve_S16_S16 655.3500 Vel -327.6800 327.6700 FORMAT "%8.4"
 /begin AXIS_DESCR STD_AXIS LLim_vDes_mp Vel 12 -327.6800 327.6700 FORMAT "%8.4" DEPOSIT ABSOLUTE /end AXIS_DESCR
/end CHARACTERISTIC
/begin CHARACTERISTIC LLim_vRPntHysHi4LG_CUR "Curve for ASL Vehicle spped for RP (hysteresis Hi) value(for 4 level lower gear)" CURVE 0x80577FE2 RB_Curve_S16_S16 655.3500 Vel -327.6800 327.6700 FORMAT "%8.4"
 /begin AXIS_DESCR STD_AXIS LLim_vDes_mp Vel 12 -327.6800 327.6700 FORMAT "%8.4" DEPOSIT ABSOLUTE /end AXIS_DESCR
/end CHARACTERISTIC
/begin CHARACTERISTIC LLim_vRPntHysHi5LG_CUR "Curve for ASL Vehicle spped for RP (hysteresis Hi) value(for 5 level lower gear)" CURVE 0x80578014 RB_Curve_S16_S16 655.3500 Vel -327.6800 327.6700 FORMAT "%8.4"
 /begin AXIS_DESCR STD_AXIS LLim_vDes_mp Vel 12 -327.6800 327.6700 FORMAT "%8.4" DEPOSIT ABSOLUTE /end AXIS_DESCR
/end CHARACTERISTIC
/begin CHARACTERISTIC LLim_vRPntHysHiLmap_CUR "Curve for ASL vehicle speed for RP (hysteresis Hi) value(for L positions)" CURVE 0x80578046 RB_Curve_S16_S16 655.3500 Vel -327.6800 327.6700 FORMAT "%8.4"
 /begin AXIS_DESCR STD_AXIS LLim_vDes_mp Vel 12 -327.6800 327.6700 FORMAT "%8.4" DEPOSIT ABSOLUTE /end AXIS_DESCR
/end CHARACTERISTIC
/begin CHARACTERISTIC LLim_vRPntHysHiTG_CUR "Curve for ASL Vehicle spped for RP (hysteresis Hi) value(for the top gear)" CURVE 0x80578078 RB_Curve_S16_S16 655.3500 Vel -327.6800 327.6700 FORMAT "%8.4"
 /begin AXIS_DESCR STD_AXIS LLim_vDes_mp Vel 12 -327.6800 327.6700 FORMAT "%8.4" DEPOSIT ABSOLUTE /end AXIS_DESCR
/end CHARACTERISTIC
/begin CHARACTERISTIC LLim_vRPntHysLo1LG_CUR "Curve for ASL Vehicle spped for RP (hysteresis Lo) value(for 1 level lower gear)" CURVE 0x805780AA RB_Curve_S16_S16 655.3500 Vel -327.6800 327.6700 FORMAT "%8.4"
 /begin AXIS_DESCR STD_AXIS LLim_vDes_mp Vel 12 -327.6800 327.6700 FORMAT "%8.4" DEPOSIT ABSOLUTE /end AXIS_DESCR
/end CHARACTERISTIC
/begin CHARACTERISTIC LLim_vRPntHysLo2LG_CUR "Curve for ASL Vehicle spped for RP (hysteresis Lo) value(for 2 level lower gear)" CURVE 0x805780DC RB_Curve_S16_S16 655.3500 Vel -327.6800 327.6700 FORMAT "%8.4"
 /begin AXIS_DESCR STD_AXIS LLim_vDes_mp Vel 12 -327.6800 327.6700 FORMAT "%8.4" DEPOSIT ABSOLUTE /end AXIS_DESCR
/end CHARACTERISTIC
/begin CHARACTERISTIC LLim_vRPntHysLo3LG_CUR "Curve for ASL Vehicle spped for RP (hysteresis Lo) value(for 3 level lower gear)" CURVE 0x8057810E RB_Curve_S16_S16 655.3500 Vel -327.6800 327.6700 FORMAT "%8.4"
 /begin AXIS_DESCR STD_AXIS LLim_vDes_mp Vel 12 -327.6800 327.6700 FORMAT "%8.4" DEPOSIT ABSOLUTE /end AXIS_DESCR
/end CHARACTERISTIC
/begin CHARACTERISTIC LLim_vRPntHysLo4LG_CUR "Curve for ASL Vehicle spped for RP (hysteresis Lo) value(for 4 level lower gear)" CURVE 0x80578140 RB_Curve_S16_S16 655.3500 Vel -327.6800 327.6700 FORMAT "%8.4"
 /begin AXIS_DESCR STD_AXIS LLim_vDes_mp Vel 12 -327.6800 327.6700 FORMAT "%8.4" DEPOSIT ABSOLUTE /end AXIS_DESCR
/end CHARACTERISTIC
/begin CHARACTERISTIC LLim_vRPntHysLo5LG_CUR "Curve for ASL Vehicle spped for RP (hysteresis Lo) value(for 5 level lower gear)" CURVE 0x80578172 RB_Curve_S16_S16 655.3500 Vel -327.6800 327.6700 FORMAT "%8.4"
 /begin AXIS_DESCR STD_AXIS LLim_vDes_mp Vel 12 -327.6800 327.6700 FORMAT "%8.4" DEPOSIT ABSOLUTE /end AXIS_DESCR
/end CHARACTERISTIC
/begin CHARACTERISTIC LLim_vRPntHysLoLmap_CUR "Curve for ASL vehicle speed for RP (hysteresis Lo) value(for L positions)" CURVE 0x805781A4 RB_Curve_S16_S16 655.3500 Vel -327.6800 327.6700 FORMAT "%8.4"
 /begin AXIS_DESCR STD_AXIS LLim_vDes_mp Vel 12 -327.6800 327.6700 FORMAT "%8.4" DEPOSIT ABSOLUTE /end AXIS_DESCR
/end CHARACTERISTIC
/begin CHARACTERISTIC LLim_vRPntHysLoTG_CUR "Curve for ASL Vehicle spped for RP (hysteresis Lo) value(for the top gear)" CURVE 0x805781D6 RB_Curve_S16_S16 655.3500 Vel -327.6800 327.6700 FORMAT "%8.4"
 /begin AXIS_DESCR STD_AXIS LLim_vDes_mp Vel 12 -327.6800 327.6700 FORMAT "%8.4" DEPOSIT ABSOLUTE /end AXIS_DESCR
/end CHARACTERISTIC
/begin CHARACTERISTIC LLim_vSptDLimHysHi1LG_CUR "Curve for ASL Vehicle speed for DL (hysteresis Hi) value for sport mode( for 1 level lower gear)" CURVE 0x80578208 RB_Curve_S16_S16 655.3500 Vel -327.6800 327.6700 FORMAT "%8.4"
 /begin AXIS_DESCR STD_AXIS LLim_vDes_mp Vel 12 -327.6800 327.6700 FORMAT "%8.4" DEPOSIT ABSOLUTE /end AXIS_DESCR
/end CHARACTERISTIC
/begin CHARACTERISTIC LLim_vSptDLimHysHi2LG_CUR "Curve for ASL Vehicle speed for DL (hysteresis Hi) value for sport mode( for 2 level lower gear)" CURVE 0x8057823A RB_Curve_S16_S16 655.3500 Vel -327.6800 327.6700 FORMAT "%8.4"
 /begin AXIS_DESCR STD_AXIS LLim_vDes_mp Vel 12 -327.6800 327.6700 FORMAT "%8.4" DEPOSIT ABSOLUTE /end AXIS_DESCR
/end CHARACTERISTIC
/begin CHARACTERISTIC LLim_vSptDLimHysHi3LG_CUR "Curve for ASL Vehicle speed for DL (hysteresis Hi) value for sport mode( for 3 level lower gear)" CURVE 0x8057826C RB_Curve_S16_S16 655.3500 Vel -327.6800 327.6700 FORMAT "%8.4"
 /begin AXIS_DESCR STD_AXIS LLim_vDes_mp Vel 12 -327.6800 327.6700 FORMAT "%8.4" DEPOSIT ABSOLUTE /end AXIS_DESCR
/end CHARACTERISTIC
/begin CHARACTERISTIC LLim_vSptDLimHysHi4LG_CUR "Curve for ASL Vehicle speed for DL (hysteresis Hi) value for sport mode( for 4 level lower gear)" CURVE 0x8057829E RB_Curve_S16_S16 655.3500 Vel -327.6800 327.6700 FORMAT "%8.4"
 /begin AXIS_DESCR STD_AXIS LLim_vDes_mp Vel 12 -327.6800 327.6700 FORMAT "%8.4" DEPOSIT ABSOLUTE /end AXIS_DESCR
/end CHARACTERISTIC
/begin CHARACTERISTIC LLim_vSptDLimHysHi5LG_CUR "Curve for ASL Vehicle speed for DL (hysteresis Hi) value for sport mode( for 5 level lower gear)" CURVE 0x805782D0 RB_Curve_S16_S16 655.3500 Vel -327.6800 327.6700 FORMAT "%8.4"
 /begin AXIS_DESCR STD_AXIS LLim_vDes_mp Vel 12 -327.6800 327.6700 FORMAT "%8.4" DEPOSIT ABSOLUTE /end AXIS_DESCR
/end CHARACTERISTIC
/begin CHARACTERISTIC LLim_vSptDLimHysHiTG_CUR "Curve for ASL Vehicle speed for DL (hysteresis Hi) value for sport mode( for the top gear)" CURVE 0x80578302 RB_Curve_S16_S16 655.3500 Vel -327.6800 327.6700 FORMAT "%8.4"
 /begin AXIS_DESCR STD_AXIS LLim_vDes_mp Vel 12 -327.6800 327.6700 FORMAT "%8.4" DEPOSIT ABSOLUTE /end AXIS_DESCR
/end CHARACTERISTIC
/begin CHARACTERISTIC LLim_vSptDLimHysLo1LG_CUR "Curve for ASL Vehicle speed for DL (hysteresis Lo) value for sport mode( for 1 level lower gear)" CURVE 0x80578334 RB_Curve_S16_S16 655.3500 Vel -327.6800 327.6700 FORMAT "%8.4"
 /begin AXIS_DESCR STD_AXIS LLim_vDes_mp Vel 12 -327.6800 327.6700 FORMAT "%8.4" DEPOSIT ABSOLUTE /end AXIS_DESCR
/end CHARACTERISTIC
/begin CHARACTERISTIC LLim_vSptDLimHysLo2LG_CUR "Curve for ASL Vehicle speed for DL (hysteresis Lo) value for sport mode( for 2 level lower gear)" CURVE 0x80578366 RB_Curve_S16_S16 655.3500 Vel -327.6800 327.6700 FORMAT "%8.4"
 /begin AXIS_DESCR STD_AXIS LLim_vDes_mp Vel 12 -327.6800 327.6700 FORMAT "%8.4" DEPOSIT ABSOLUTE /end AXIS_DESCR
/end CHARACTERISTIC
/begin CHARACTERISTIC LLim_vSptDLimHysLo3LG_CUR "Curve for ASL Vehicle speed for DL (hysteresis Lo) value for sport mode( for 3 level lower gear)" CURVE 0x80578398 RB_Curve_S16_S16 655.3500 Vel -327.6800 327.6700 FORMAT "%8.4"
 /begin AXIS_DESCR STD_AXIS LLim_vDes_mp Vel 12 -327.6800 327.6700 FORMAT "%8.4" DEPOSIT ABSOLUTE /end AXIS_DESCR
/end CHARACTERISTIC
/begin CHARACTERISTIC LLim_vSptDLimHysLo4LG_CUR "Curve for ASL Vehicle speed for DL (hysteresis Lo) value for sport mode( for 4 level lower gear)" CURVE 0x805783CA RB_Curve_S16_S16 655.3500 Vel -327.6800 327.6700 FORMAT "%8.4"
 /begin AXIS_DESCR STD_AXIS LLim_vDes_mp Vel 12 -327.6800 327.6700 FORMAT "%8.4" DEPOSIT ABSOLUTE /end AXIS_DESCR
/end CHARACTERISTIC
/begin CHARACTERISTIC LLim_vSptDLimHysLo5LG_CUR "Curve for ASL Vehicle speed for DL (hysteresis Lo) value for sport mode( for 5 level lower gear)" CURVE 0x805783FC RB_Curve_S16_S16 655.3500 Vel -327.6800 327.6700 FORMAT "%8.4"
 /begin AXIS_DESCR STD_AXIS LLim_vDes_mp Vel 12 -327.6800 327.6700 FORMAT "%8.4" DEPOSIT ABSOLUTE /end AXIS_DESCR
/end CHARACTERISTIC
/begin CHARACTERISTIC LLim_vSptDLimHysLoTG_CUR "Curve for ASL Vehicle speed for DL (hysteresis Lo) value for sport mode( for the top gear)" CURVE 0x8057842E RB_Curve_S16_S16 655.3500 Vel -327.6800 327.6700 FORMAT "%8.4"
 /begin AXIS_DESCR STD_AXIS LLim_vDes_mp Vel 12 -327.6800 327.6700 FORMAT "%8.4" DEPOSIT ABSOLUTE /end AXIS_DESCR
/end CHARACTERISTIC
/begin CHARACTERISTIC LLim_vSptNoCtlPntHysHi1LG_CUR "Curve for ASL Vehicle speed for non control point (hysteresis Hi) value for sport mode(for 1 level lower gear)" CURVE 0x80578460 RB_Curve_S16_S16 655.3500 Vel -327.6800 327.6700 FORMAT "%8.4"
 /begin AXIS_DESCR STD_AXIS LLim_vDes_mp Vel 12 -327.6800 327.6700 FORMAT "%8.4" DEPOSIT ABSOLUTE /end AXIS_DESCR
/end CHARACTERISTIC
/begin CHARACTERISTIC LLim_vSptNoCtlPntHysHi2LG_CUR "Curve for ASL Vehicle speed for non control point (hysteresis Hi) value for sport mode(for 2 level lower gear)" CURVE 0x80578492 RB_Curve_S16_S16 655.3500 Vel -327.6800 327.6700 FORMAT "%8.4"
 /begin AXIS_DESCR STD_AXIS LLim_vDes_mp Vel 12 -327.6800 327.6700 FORMAT "%8.4" DEPOSIT ABSOLUTE /end AXIS_DESCR
/end CHARACTERISTIC
/begin CHARACTERISTIC LLim_vSptNoCtlPntHysHi3LG_CUR "Curve for ASL Vehicle speed for non control point (hysteresis Hi) value for sport mode(for 3 level lower gear)" CURVE 0x805784C4 RB_Curve_S16_S16 655.3500 Vel -327.6800 327.6700 FORMAT "%8.4"
 /begin AXIS_DESCR STD_AXIS LLim_vDes_mp Vel 12 -327.6800 327.6700 FORMAT "%8.4" DEPOSIT ABSOLUTE /end AXIS_DESCR
/end CHARACTERISTIC
/begin CHARACTERISTIC LLim_vSptNoCtlPntHysHi4LG_CUR "Curve for ASL Vehicle speed for non control point (hysteresis Hi) value for sport mode(for 4 level lower gear)" CURVE 0x805784F6 RB_Curve_S16_S16 655.3500 Vel -327.6800 327.6700 FORMAT "%8.4"
 /begin AXIS_DESCR STD_AXIS LLim_vDes_mp Vel 12 -327.6800 327.6700 FORMAT "%8.4" DEPOSIT ABSOLUTE /end AXIS_DESCR
/end CHARACTERISTIC
/begin CHARACTERISTIC LLim_vSptNoCtlPntHysHi5LG_CUR "Curve for ASL Vehicle speed for non control point (hysteresis Hi) value for sport mode(for 5 level lower gear)" CURVE 0x80578528 RB_Curve_S16_S16 655.3500 Vel -327.6800 327.6700 FORMAT "%8.4"
 /begin AXIS_DESCR STD_AXIS LLim_vDes_mp Vel 12 -327.6800 327.6700 FORMAT "%8.4" DEPOSIT ABSOLUTE /end AXIS_DESCR
/end CHARACTERISTIC
/begin CHARACTERISTIC LLim_vSptNoCtlPntHysHiTG_CUR "Curve for ASL Vehicle speed for non control point (hysteresis Hi) value for sport mode(for the top gear)" CURVE 0x8057855A RB_Curve_S16_S16 655.3500 Vel -327.6800 327.6700 FORMAT "%8.4"
 /begin AXIS_DESCR STD_AXIS LLim_vDes_mp Vel 12 -327.6800 327.6700 FORMAT "%8.4" DEPOSIT ABSOLUTE /end AXIS_DESCR
/end CHARACTERISTIC
/begin CHARACTERISTIC LLim_vSptNoCtlPntHysLo1LG_CUR "Curve for ASL Vehicle speed for non control point (hysteresis Lo) value for sport mode(for 1 level lower gear)" CURVE 0x8057858C RB_Curve_S16_S16 655.3500 Vel -327.6800 327.6700 FORMAT "%8.4"
 /begin AXIS_DESCR STD_AXIS LLim_vDes_mp Vel 12 -327.6800 327.6700 FORMAT "%8.4" DEPOSIT ABSOLUTE /end AXIS_DESCR
/end CHARACTERISTIC
/begin CHARACTERISTIC LLim_vSptNoCtlPntHysLo2LG_CUR "Curve for ASL Vehicle speed for non control point (hysteresis Lo) value for sport mode(for 2 level lower gear)" CURVE 0x805785BE RB_Curve_S16_S16 655.3500 Vel -327.6800 327.6700 FORMAT "%8.4"
 /begin AXIS_DESCR STD_AXIS LLim_vDes_mp Vel 12 -327.6800 327.6700 FORMAT "%8.4" DEPOSIT ABSOLUTE /end AXIS_DESCR
/end CHARACTERISTIC
/begin CHARACTERISTIC LLim_vSptNoCtlPntHysLo3LG_CUR "Curve for ASL Vehicle speed for non control point (hysteresis Lo) value for sport mode(for 3 level lower gear)" CURVE 0x805785F0 RB_Curve_S16_S16 655.3500 Vel -327.6800 327.6700 FORMAT "%8.4"
 /begin AXIS_DESCR STD_AXIS LLim_vDes_mp Vel 12 -327.6800 327.6700 FORMAT "%8.4" DEPOSIT ABSOLUTE /end AXIS_DESCR
/end CHARACTERISTIC
/begin CHARACTERISTIC LLim_vSptNoCtlPntHysLo4LG_CUR "Curve for ASL Vehicle speed for non control point (hysteresis Lo) value for sport mode(for 4 level lower gear)" CURVE 0x80578622 RB_Curve_S16_S16 655.3500 Vel -327.6800 327.6700 FORMAT "%8.4"
 /begin AXIS_DESCR STD_AXIS LLim_vDes_mp Vel 12 -327.6800 327.6700 FORMAT "%8.4" DEPOSIT ABSOLUTE /end AXIS_DESCR
/end CHARACTERISTIC
/begin CHARACTERISTIC LLim_vSptNoCtlPntHysLo5LG_CUR "Curve for ASL Vehicle speed for non control point (hysteresis Lo) value for sport mode(for 5 level lower gear)" CURVE 0x80578654 RB_Curve_S16_S16 655.3500 Vel -327.6800 327.6700 FORMAT "%8.4"
 /begin AXIS_DESCR STD_AXIS LLim_vDes_mp Vel 12 -327.6800 327.6700 FORMAT "%8.4" DEPOSIT ABSOLUTE /end AXIS_DESCR
/end CHARACTERISTIC
/begin CHARACTERISTIC LLim_vSptNoCtlPntHysLoTG_CUR "Curve for ASL Vehicle speed for non control point (hysteresis Lo) value for sport mode(for the gear)" CURVE 0x80578686 RB_Curve_S16_S16 655.3500 Vel -327.6800 327.6700 FORMAT "%8.4"
 /begin AXIS_DESCR STD_AXIS LLim_vDes_mp Vel 12 -327.6800 327.6700 FORMAT "%8.4" DEPOSIT ABSOLUTE /end AXIS_DESCR
/end CHARACTERISTIC
/begin CHARACTERISTIC LLim_vSptRPntHysHi1LG_CUR "Curve for ASL Vehicle spped for RP (hysteresis Hi) value for sport mode ( for 1 level lower gear)" CURVE 0x805786B8 RB_Curve_S16_S16 655.3500 Vel -327.6800 327.6700 FORMAT "%8.4"
 /begin AXIS_DESCR STD_AXIS LLim_vDes_mp Vel 12 -327.6800 327.6700 FORMAT "%8.4" DEPOSIT ABSOLUTE /end AXIS_DESCR
/end CHARACTERISTIC
/begin CHARACTERISTIC LLim_vSptRPntHysHi2LG_CUR "Curve for ASL Vehicle spped for RP (hysteresis Hi) value for sport mode ( for 2 level lower gear)" CURVE 0x805786EA RB_Curve_S16_S16 655.3500 Vel -327.6800 327.6700 FORMAT "%8.4"
 /begin AXIS_DESCR STD_AXIS LLim_vDes_mp Vel 12 -327.6800 327.6700 FORMAT "%8.4" DEPOSIT ABSOLUTE /end AXIS_DESCR
/end CHARACTERISTIC
/begin CHARACTERISTIC LLim_vSptRPntHysHi3LG_CUR "Curve for ASL Vehicle spped for RP (hysteresis Hi) value for sport mode ( for 3 level lower gear)" CURVE 0x8057871C RB_Curve_S16_S16 655.3500 Vel -327.6800 327.6700 FORMAT "%8.4"
 /begin AXIS_DESCR STD_AXIS LLim_vDes_mp Vel 12 -327.6800 327.6700 FORMAT "%8.4" DEPOSIT ABSOLUTE /end AXIS_DESCR
/end CHARACTERISTIC
/begin CHARACTERISTIC LLim_vSptRPntHysHi4LG_CUR "Curve for ASL Vehicle spped for RP (hysteresis Hi) value for sport mode ( for 4 level lower gear)" CURVE 0x8057874E RB_Curve_S16_S16 655.3500 Vel -327.6800 327.6700 FORMAT "%8.4"
 /begin AXIS_DESCR STD_AXIS LLim_vDes_mp Vel 12 -327.6800 327.6700 FORMAT "%8.4" DEPOSIT ABSOLUTE /end AXIS_DESCR
/end CHARACTERISTIC
/begin CHARACTERISTIC LLim_vSptRPntHysHi5LG_CUR "Curve for ASL Vehicle spped for RP (hysteresis Hi) value for sport mode ( for 5 level lower gear)" CURVE 0x80578780 RB_Curve_S16_S16 655.3500 Vel -327.6800 327.6700 FORMAT "%8.4"
 /begin AXIS_DESCR STD_AXIS LLim_vDes_mp Vel 12 -327.6800 327.6700 FORMAT "%8.4" DEPOSIT ABSOLUTE /end AXIS_DESCR
/end CHARACTERISTIC
/begin CHARACTERISTIC LLim_vSptRPntHysHiTG_CUR "Curve for ASL Vehicle spped for RP (hysteresis Hi) value for sport mode ( for the top gear)" CURVE 0x805787B2 RB_Curve_S16_S16 655.3500 Vel -327.6800 327.6700 FORMAT "%8.4"
 /begin AXIS_DESCR STD_AXIS LLim_vDes_mp Vel 12 -327.6800 327.6700 FORMAT "%8.4" DEPOSIT ABSOLUTE /end AXIS_DESCR
/end CHARACTERISTIC
/begin CHARACTERISTIC LLim_vSptRPntHysLo1LG_CUR "Curve for ASL Vehicle spped for RP (hysteresis Lo) value for sport mode ( for 1 level lower gear)" CURVE 0x805787E4 RB_Curve_S16_S16 655.3500 Vel -327.6800 327.6700 FORMAT "%8.4"
 /begin AXIS_DESCR STD_AXIS LLim_vDes_mp Vel 12 -327.6800 327.6700 FORMAT "%8.4" DEPOSIT ABSOLUTE /end AXIS_DESCR
/end CHARACTERISTIC
/begin CHARACTERISTIC LLim_vSptRPntHysLo2LG_CUR "Curve for ASL Vehicle spped for RP (hysteresis Lo) value for sport mode ( for 2 level lower gear)" CURVE 0x80578816 RB_Curve_S16_S16 655.3500 Vel -327.6800 327.6700 FORMAT "%8.4"
 /begin AXIS_DESCR STD_AXIS LLim_vDes_mp Vel 12 -327.6800 327.6700 FORMAT "%8.4" DEPOSIT ABSOLUTE /end AXIS_DESCR
/end CHARACTERISTIC
/begin CHARACTERISTIC LLim_vSptRPntHysLo3LG_CUR "Curve for ASL Vehicle spped for RP (hysteresis Lo) value for sport mode ( for 3 level lower gear)" CURVE 0x80578848 RB_Curve_S16_S16 655.3500 Vel -327.6800 327.6700 FORMAT "%8.4"
 /begin AXIS_DESCR STD_AXIS LLim_vDes_mp Vel 12 -327.6800 327.6700 FORMAT "%8.4" DEPOSIT ABSOLUTE /end AXIS_DESCR
/end CHARACTERISTIC
/begin CHARACTERISTIC LLim_vSptRPntHysLo4LG_CUR "Curve for ASL Vehicle spped for RP (hysteresis Lo) value for sport mode ( for 4 level lower gear)" CURVE 0x8057887A RB_Curve_S16_S16 655.3500 Vel -327.6800 327.6700 FORMAT "%8.4"
 /begin AXIS_DESCR STD_AXIS LLim_vDes_mp Vel 12 -327.6800 327.6700 FORMAT "%8.4" DEPOSIT ABSOLUTE /end AXIS_DESCR
/end CHARACTERISTIC
/begin CHARACTERISTIC LLim_vSptRPntHysLo5LG_CUR "Curve for ASL Vehicle spped for RP (hysteresis Lo) value for sport mode ( for 5 level lower gear)" CURVE 0x805788AC RB_Curve_S16_S16 655.3500 Vel -327.6800 327.6700 FORMAT "%8.4"
 /begin AXIS_DESCR STD_AXIS LLim_vDes_mp Vel 12 -327.6800 327.6700 FORMAT "%8.4" DEPOSIT ABSOLUTE /end AXIS_DESCR
/end CHARACTERISTIC
/begin CHARACTERISTIC LLim_vSptRPntHysLoTG_CUR "Curve for ASL Vehicle spped for RP (hysteresis Lo) value for sport mode ( for the top gear)" CURVE 0x805788DE RB_Curve_S16_S16 655.3500 Vel -327.6800 327.6700 FORMAT "%8.4"
 /begin AXIS_DESCR STD_AXIS LLim_vDes_mp Vel 12 -327.6800 327.6700 FORMAT "%8.4" DEPOSIT ABSOLUTE /end AXIS_DESCR
/end CHARACTERISTIC
/begin CHARACTERISTIC LLim_vStrtSpdDvt_C "Vehicle speed deviation value for ASL start check" VALUE 0x80578910 Val_Ws16 655.3500 Vel -327.6800 327.6700 FORMAT "%8.4" /end CHARACTERISTIC
/begin CHARACTERISTIC LLim_vThres_C "Velocity Threshold for activating Speed Limiter" VALUE 0x8057894E Val_Ws16 655.3500 Vel -327.6800 327.6700 FORMAT "%8.4" /end CHARACTERISTIC
/begin CHARACTERISTIC LLim_vTmpRelsAlrmDif_C "Sound alarm if difference between current velocity and set velocity is greater than this value." VALUE 0x80578912 Val_Ws16 655.3500 Vel -327.6800 327.6700 FORMAT "%8.4" /end CHARACTERISTIC
/begin CHARACTERISTIC LLRMR_facTqResvHeatrReq_M "Weighting factor for torque reserve for engine heat up (non-idle)" MAP 0x80571804 RB_Map_S16U16_U16 327.6750 fak_q0p005 0.00 327.6750 FORMAT "%8.4"
 /begin AXIS_DESCR STD_AXIS Epm_nEng EngN 6 -16384.00 16383.50 FORMAT "%8.2" DEPOSIT ABSOLUTE /end AXIS_DESCR
 /begin AXIS_DESCR STD_AXIS rl_w_msg rel_q0p0234 8 0.00 1535.977 FORMAT "%8.3" DEPOSIT ABSOLUTE /end AXIS_DESCR
/end CHARACTERISTIC
/begin CHARACTERISTIC LLRMR_facTqResvIdleBrkNotActv_M "Torque reserve factor for open powertrain when brake not active" MAP 0x80571884 RB_Map_U8S16_U8 3.984 fak_ub_b4 0.00 3.984 FORMAT "%5.3"
 /begin AXIS_DESCR STD_AXIS LLRMR_vfzg_tmp vfzg_ub_q1p25 8 0.00 318.8 FORMAT "%5.1" DEPOSIT ABSOLUTE /end AXIS_DESCR
 /begin AXIS_DESCR STD_AXIS PT_rTrq TransR 8 -327.6800 327.6700 FORMAT "%8.4" DEPOSIT ABSOLUTE /end AXIS_DESCR
/end CHARACTERISTIC
/begin CHARACTERISTIC LLRMR_facTqResvIdle_M "Torque reserve factor for open powertrain" MAP 0x805718DE RB_Map_U8S8_U8 3.984 fak_ub_b4 0.00 3.984 FORMAT "%5.3"
 /begin AXIS_DESCR STD_AXIS LLRMR_vfzg_tmp vfzg_ub_q1p25 3 0.00 318.8 FORMAT "%5.1" DEPOSIT ABSOLUTE /end AXIS_DESCR
 /begin AXIS_DESCR STD_AXIS Tra_numGear OneToOne 3 -128.0 127.0 FORMAT "%5.1" DEPOSIT ABSOLUTE /end AXIS_DESCR
/end CHARACTERISTIC
/begin CHARACTERISTIC LLRMR_nIdleTqResvThd_C "engine speed threshold to activate the factor for torque reserve at idle" VALUE 0x805718F0 RB_Val_Wu16 16383.75 nmot_uw_q0p25 0.00 16383.75 FORMAT "%8.2" /end CHARACTERISTIC
/begin CHARACTERISTIC LLRMR_nMinNThdRst_C "Engine speed threshold for reset of torque reserve during engine shut off" VALUE 0x805718F2 RB_Val_Wu8 10200. nmot_ub_q40 0.00 10200. FORMAT "%5.0" /end CHARACTERISTIC
/begin CHARACTERISTIC LLRMR_percEngGrdtDwnRmp_C "Decrement to reduce the torque reserve depending on engine speed gradient" VALUE 0x805718F4 RB_Val_Wu16 99.99847 rel_uw_b100 0.00 99.99847 FORMAT "%8.5" /end CHARACTERISTIC
/begin CHARACTERISTIC LLRMR_percTqResvEngGrdt_MAP "Map for the torque reserve depending on engine speed gradient" MAP 0x805718F6 RB_Map_S16S16_U16 99.99847 rel_uw_b100 0.00 99.99847 FORMAT "%8.5"
 /begin AXIS_DESCR STD_AXIS Epm_dnEngFlt EngNGrd 8 -16384.00 16383.50 FORMAT "%8.2" DEPOSIT ABSOLUTE /end AXIS_DESCR
 /begin AXIS_DESCR STD_AXIS LLRMR_dns_temp nmot_sw_q0p5 4 -16384.00 16383.50 FORMAT "%8.2" DEPOSIT ABSOLUTE /end AXIS_DESCR
/end CHARACTERISTIC
/begin CHARACTERISTIC LLRMR_percTqResvHeatrReq_M "Torque reserve for improved engine heat up (non-idle)" MAP 0x80571952 RB_Map_S16S16_U16 99.99847 rel_uw_b100 0.00 99.99847 FORMAT "%8.5"
 /begin AXIS_DESCR STD_AXIS WaHt_tDeltaEngT Temp_Cels 6 -3549.940 3003.560 FORMAT "%8.3" DEPOSIT ABSOLUTE /end AXIS_DESCR
 /begin AXIS_DESCR STD_AXIS EnvT_t Temp_Cels 6 -3549.940 3003.560 FORMAT "%8.3" DEPOSIT ABSOLUTE /end AXIS_DESCR
/end CHARACTERISTIC
/begin CHARACTERISTIC LLRMR_percTqResvMin_C "Torque reserve in case of minimum ignition angle effectiveness is zero" VALUE 0x805719B6 RB_Val_Wu16 99.99847 rel_uw_b100 0.00 99.99847 FORMAT "%8.5" /end CHARACTERISTIC
/begin CHARACTERISTIC LLRMR_percTqResvThdDrv_C "Threshold for drivers torque wish to ramp the non idle torque reserve" VALUE 0x805719B8 RB_Val_Wu16 99.99847 rel_uw_b100 0.00 99.99847 FORMAT "%8.5" /end CHARACTERISTIC
/begin CHARACTERISTIC LLRMR_slopeNegTqResv_C "Negative slope for torque reserve in non idle" VALUE 0x805719BC RB_Val_Ws32 99999.9999767 q2p32831_Perc_DIV_s -50000.0000000 49999.9999767 FORMAT "%13.7" /end CHARACTERISTIC
/begin CHARACTERISTIC LLRMR_slopePosTqResv_C "Positive slope for torque reserve in non idle" VALUE 0x805719C0 RB_Val_Ws32 99999.9999767 q2p32831_Perc_DIV_s -50000.0000000 49999.9999767 FORMAT "%13.7" /end CHARACTERISTIC
/begin CHARACTERISTIC LLRMR_stCluOpnCmpl_C "bit used for the sensitivity of the clutch state in case of large movements of the clutch pedal" VALUE 0x805719C4 RB_Val_Wu8 7.000 dez 0.00 7.000 FORMAT "%5.3" EXTENDED_LIMITS 0.00 255.0 /end CHARACTERISTIC
/begin CHARACTERISTIC LLRMR_stCluOpnNotCmpl_C "bit used for the sensitivity of the clutch state in case of small movements of the clutch pedal" VALUE 0x805719C5 RB_Val_Wu8 7.000 dez 0.00 7.000 FORMAT "%5.3" EXTENDED_LIMITS 0.00 255.0 /end CHARACTERISTIC
/begin CHARACTERISTIC LLRMR_swtFltSeln_C "Filtered Engine speed gradient selection switch" VALUE 0x805719C6 RB_Val_Wu8 255.0 OneToOne 0.00 255.0 FORMAT "%5.1" /end CHARACTERISTIC
/begin CHARACTERISTIC LLRMR_tCatMaxActvt_C "Upper limit for maximum catalyst temperature for activation of hysteresis at sportive mode" VALUE 0x805719C8 RB_Val_Ws16 3276.700 Temp_Cels -273.140 3003.560 FORMAT "%8.3" EXTENDED_LIMITS -3549.940 3003.560 /end CHARACTERISTIC
/begin CHARACTERISTIC LLRMR_tCatMaxDeactvt_C "Lower limit for maximum catalyst temperature for deactivation of hysteresis at sportive mode" VALUE 0x805719CA RB_Val_Ws16 3276.700 Temp_Cels -273.140 3003.560 FORMAT "%8.3" EXTENDED_LIMITS -3549.940 3003.560 /end CHARACTERISTIC
/begin CHARACTERISTIC LLRMR_tiDlyRmpEngGrdt_C "Hold time for the torque reserve depending on engine speed gradient" VALUE 0x805719CC RB_Val_Wu16 1310.700 t_q0p02 0.00 1310.700 FORMAT "%8.3" /end CHARACTERISTIC
/begin CHARACTERISTIC LLRMR_tMinTqResvActv_C "engine temper threshold to activate the factor for torque reserve at idle" VALUE 0x805719CE RB_Val_Wu8 191.3 temp_ub_q0p75_o48 -48.0 143.3 FORMAT "%5.1" /end CHARACTERISTIC
/begin CHARACTERISTIC LLRNSNF_flgSwtNGrdt_C "flag for filtered engine speed gradient switch" VALUE 0x80571AA0 RB_Val_Wboolean 1.00000000000 B_TRUE 0.00 1.00000000000 FORMAT "%13.11" /end CHARACTERISTIC
/begin AXIS_PTS LLRNSNF_nSpLoDiff_X_Ax "Datapoint distribution, set-speed deviation, 06 datapoints., idle-speed control." 0x80571AA1 llrnsnf_sns06llsbLoc RB_Axis_S8 2550. nmotd_sb_q10 6 -1280. 1270. FORMAT "%5.0" DEPOSIT ABSOLUTE /end AXIS_PTS
/begin CHARACTERISTIC MRENSTA "Offset of the engine speed for the activation of underspeed detection to increase the torque reserve" VALUE 0x805719CF RB_Val_Wu8 10200. nmot_ub_q40 0.00 10200. FORMAT "%5.0" /end CHARACTERISTIC
/begin CHARACTERISTIC MRESHH "Torque reserve during rear window heating." VALUE 0x805719D0 RB_Val_Wu8 24.90 rel_ub_b25 0.00 24.90 FORMAT "%5.2" /end CHARACTERISTIC
/begin CHARACTERISTIC MRESUB "additional torque reserve for undervoltage" VALUE 0x805719D1 RB_Val_Wu8 24.90 rel_ub_b25 0.00 24.90 FORMAT "%5.2" /end CHARACTERISTIC
/begin CHARACTERISTIC NGNSNF "Threshold of speed gradient for starting dynamic target idle speed calculation" VALUE 0x80571AA8 RB_Val_Wu8 25500. nmotg_ub_q100 0.00 25500. FORMAT "%5.0" /end CHARACTERISTIC
/begin CHARACTERISTIC NSOLMX_W "maximum limitation of target idle speed" VALUE 0x80571AAA RB_Val_Ws16 16383.50 nmot_sw_q0p5 0.00 16383.50 FORMAT "%8.2" EXTENDED_LIMITS -16384.00 16383.50 /end CHARACTERISTIC
/begin CHARACTERISTIC SDLLRMR "Engine speed threshold to deactivate the torque reserve for engine speed control" VALUE 0x805719D2 RB_Val_Wu8 10200. nmot_ub_q40 0.00 10200. FORMAT "%5.0" /end CHARACTERISTIC
/begin AXIS_PTS SMI04LLUBL "distribution: ind. torque for torque-reserve" 0x805719D4 LLRMR_mifa_w_tmp RB_Axis_U16 99.99847 rel_uw_b100 8 0.00 99.99847 FORMAT "%8.5" DEPOSIT ABSOLUTE /end AXIS_PTS
/begin AXIS_PTS SNM06LLUWL "distribution of engine speed" 0x805719E6 LLRMR_nmotw_tmp RB_Axis_U16 16383.75 nmot_uw_q0p25 8 0.00 16383.75 FORMAT "%8.2" DEPOSIT ABSOLUTE /end AXIS_PTS
/begin AXIS_PTS SNS06LLSBL "Datapoint distribution, set-speed deviation, 06 datapoints., idle-speed control." 0x805719F8 LLRMR_dns_temp RB_Axis_S16 32767.50 nmot_sw_q0p5 6 -16384.00 16383.50 FORMAT "%8.2" DEPOSIT ABSOLUTE /end AXIS_PTS
/begin AXIS_PTS STA04LLUBL "distribution: tans for torque resreve" 0x80571A06 LLRMR_tans_temp RB_Axis_U8 191.3 temp_ub_q0p75_o48 4 -48.0 143.3 FORMAT "%5.1" DEPOSIT ABSOLUTE /end AXIS_PTS
/begin AXIS_PTS STM04SAUBL "Datapoint distribution, engine temperature, 4 datapoints" 0x80571A0B LLRMR_tmot_tmp RB_Axis_U8 191.3 temp_ub_q0p75_o48 4 -48.0 143.3 FORMAT "%5.1" DEPOSIT ABSOLUTE /end AXIS_PTS
/begin AXIS_PTS STM06LLUBL "Datapoint distribution, engine temperature, 6 datapoints" 0x80571AAC llrnsnf_stm06llublLoc RB_Axis_U8 191.3 temp_ub_q0p75_o48 6 -48.0 143.3 FORMAT "%5.1" DEPOSIT ABSOLUTE /end AXIS_PTS
/begin AXIS_PTS STS08ESUBL "Distribution for engine coolant temperature at start" 0x80571AB3 tmst_llrnsnf_loc RB_Axis_U8 191.3 temp_ub_q0p75_o48 8 -48.0 143.3 FORMAT "%5.1" DEPOSIT ABSOLUTE /end AXIS_PTS
/begin CHARACTERISTIC TDDEANF "turn-on delay: deacitvation speed tracking" VALUE 0x80571ABC RB_Val_Wu8 2.550 t_q0p01 0.00 2.550 FORMAT "%5.3" /end CHARACTERISTIC
/begin CHARACTERISTIC TDDIRSTLL "delay time for different engine speed tracking at an engine restart" VALUE 0x80571ABE RB_Val_Wu16 655.3500 t_q0p01 0.00 655.3500 FORMAT "%8.4" /end CHARACTERISTIC
/begin CHARACTERISTIC TDDMRLLR "time constant for filter torque reserve" CURVE 0x80571A10 RB_Curve_U16_U16 1310.680 t_q0p02 0.020 1310.700 FORMAT "%8.3" EXTENDED_LIMITS 0.00 1310.700
 /begin AXIS_DESCR STD_AXIS ddmrllr_w rel_uw_b100 3 0.00 99.99847 FORMAT "%8.5" DEPOSIT ABSOLUTE /end AXIS_DESCR
/end CHARACTERISTIC
/begin CHARACTERISTIC TDMRESHH "Hold time for the increased torque reserve after rear window heating request." VALUE 0x80571A1E RB_Val_Wu8 5.100 t_q0p02 0.00 5.100 FORMAT "%5.3" /end CHARACTERISTIC
/begin CHARACTERISTIC TDMRESLW "Inhibition time for the increased torque reserve after engine start" VALUE 0x80571A20 RB_Val_Wu16 655.3500 t10msxs_uw_b655p35 0.00 655.3500 FORMAT "%8.4" /end CHARACTERISTIC
/begin CHARACTERISTIC TDMRESUB "Hold time for increased torque reserve after battery voltage drop" VALUE 0x80571A22 RB_Val_Wu8 5.100 t_q0p02 0.00 5.100 FORMAT "%5.3" /end CHARACTERISTIC
/begin CHARACTERISTIC TDSIGNHH "Inhibition time for increased torque reserve after rear window heating request." VALUE 0x80571A23 RB_Val_Wu8 5.100 t_q0p02 0.00 5.100 FORMAT "%5.3" /end CHARACTERISTIC
/begin CHARACTERISTIC TDUBSQ "Hold time for increased torque reserve after battery voltage drop" VALUE 0x80571A24 RB_Val_Wu8 5.100 t_q0p02 0.00 5.100 FORMAT "%5.3" /end CHARACTERISTIC
/begin CHARACTERISTIC TDUBSTND "Time delay for activation of torque reserve after battery voltage drop after start" VALUE 0x80571A26 RB_Val_Wu16 655.3500 t10msxs_uw_b655p35 0.00 655.3500 FORMAT "%8.4" /end CHARACTERISTIC
/begin CHARACTERISTIC TMOTDIRST "Engine temperature threshold to enable map changeover during engine restart" VALUE 0x80571AC0 RB_Val_Wu8 191.3 temp_ub_q0p75_o48 -48.0 143.3 FORMAT "%5.1" /end CHARACTERISTIC
/begin CHARACTERISTIC TOFFAUSGKR "Torque reserve for engine speed control: Turnoff delay for fuel evaporation from oil has reached a critical level" VALUE 0x80571A28 RB_Val_Wu8 5.100 t_q0p02 0.00 5.100 FORMAT "%5.3" /end CHARACTERISTIC
/begin CHARACTERISTIC TVAUSGKR "Time constant Low pass filter for flex fuel" VALUE 0x80571A2A RB_Val_Wu16 1310.680 t_q0p02 0.020 1310.700 FORMAT "%8.3" EXTENDED_LIMITS 0.00 1310.700 /end CHARACTERISTIC
/begin CHARACTERISTIC TVAUSGLR "Torque reserve for engine speed control: Time constant of low pass filter for fast mean value of lambda control in case of flex fuel" VALUE 0x80571A2C RB_Val_Wu16 1310.680 t_q0p02 0.020 1310.700 FORMAT "%8.3" EXTENDED_LIMITS 0.00 1310.700 /end CHARACTERISTIC
/begin CHARACTERISTIC TVGRMR "Delay time for gear at torque reserve after speed undershoot" VALUE 0x80571A2E RB_Val_Wu8 5.100 t20msxs_ub_b5p1 0.00 5.100 FORMAT "%5.3" /end CHARACTERISTIC
/begin CHARACTERISTIC TVRESLL "Hold time for increased torque reserve after engine speed drop" VALUE 0x80571A30 RB_Val_Wu16 1310.700 t_q0p02 0.00 1310.700 FORMAT "%8.3" /end CHARACTERISTIC
/begin CHARACTERISTIC VANF "Speed threshold for approach support" VALUE 0x80571A32 RB_Val_Wu8 318.8 vfzg_ub_q1p25 0.00 318.8 FORMAT "%5.1" /end CHARACTERISTIC
/begin CHARACTERISTIC ZKDMRUB "time constant for battery voltage filter" VALUE 0x80571A34 RB_Val_Wu16 1310.680 t_q0p02 0.020 1310.700 FORMAT "%8.3" EXTENDED_LIMITS 0.00 1310.700 /end CHARACTERISTIC
/begin CHARACTERISTIC ZKDMRUBF "time constant for battery voltage filter(faster)" VALUE 0x80571A36 RB_Val_Wu16 1310.680 t_q0p02 0.020 1310.700 FORMAT "%8.3" EXTENDED_LIMITS 0.00 1310.700 /end CHARACTERISTIC
/begin MEASUREMENT B_freezenf_msg "condition: deactivating speed tracking" UBYTE B_TRUE 1 100 0.00 1.00000000000 BIT_MASK 0x1 FORMAT "%13.11" ECU_ADDRESS 0x6000F25F /end MEASUREMENT
/begin MEASUREMENT B_kuplaus "Clutch is pressed: Powertrain is open" UBYTE B_TRUE 1 100 0.00 1.00000000000 BIT_MASK 0x1 FORMAT "%13.11" ECU_ADDRESS 0x6000AF1B /end MEASUREMENT
/begin MEASUREMENT B_llde_msg "Condition speed undershoot" UBYTE B_TRUE 1 100 0.00 1.00000000000 BIT_MASK 0x1 FORMAT "%13.11" ECU_ADDRESS 0x6000F23E /end MEASUREMENT
/begin MEASUREMENT B_zwafh_msg "enabling spark operation for vehicle drive-up-support" UBYTE B_TRUE 1 100 0.00 1.00000000000 BIT_MASK 0x1 FORMAT "%13.11" ECU_ADDRESS 0x6000F201 /end MEASUREMENT
/begin MEASUREMENT ddmrllr_w "delta of torque reserve for idle speed control" UWORD rel_uw_b100 1 100 0.00 99.99847 FORMAT "%8.5" ECU_ADDRESS 0x6001346C /end MEASUREMENT
/begin MEASUREMENT dmralt "offset torque based on altitude" UBYTE rel_ub_b25 1 100 0.00 24.90 FORMAT "%5.2" ECU_ADDRESS 0x600140CF /end MEASUREMENT
/begin MEASUREMENT dmrdiaiv_w "Offset torque reserve at small injection time" UWORD rel_uw_b100 1 100 0.00 99.99847 FORMAT "%8.5" ECU_ADDRESS 0x60013470 /end MEASUREMENT
/begin MEASUREMENT dmrenher_w "torque reserve for improving the engine heating" UWORD rel_uw_b100 1 100 0.00 99.99847 FORMAT "%8.5" ECU_ADDRESS 0x60006AD8 /end MEASUREMENT
/begin MEASUREMENT dmresb_w "Basic torque reserve at idle" UWORD rel_uw_b100 1 100 0.00 99.99847 FORMAT "%8.5" ECU_ADDRESS 0x60006AD6 /end MEASUREMENT
/begin MEASUREMENT dmresll_w_msg "Increased torque reserve at idle after speed undershoot" UWORD rel_q0p00153 1 100 0.00 99.99847 FORMAT "%8.5" ECU_ADDRESS 0x60008B32 /end MEASUREMENT
/begin MEASUREMENT dmresubg "Highest detected undervolage for calculation of the torque reserves" UWORD spg_q0p00039 1 100 0.00 25.59961 FORMAT "%8.5" ECU_ADDRESS 0x60006AD4 /end MEASUREMENT
/begin MEASUREMENT dmresub_mp "Measuring point of offset reserve for under voltage" UWORD rel_q0p00153 1 100 0.00 99.99847 FORMAT "%8.5" ECU_ADDRESS 0x7000A154 /end MEASUREMENT
/begin MEASUREMENT dmrllr_w_msg "torque reserve for idle speed control" UWORD rel_uw_b100 1 100 0.00 99.99847 FORMAT "%8.5" ECU_ADDRESS 0x60008B30 /end MEASUREMENT
/begin MEASUREMENT gangsist_llrnsnf_loc "Current gear" SBYTE dez 1 100 -128.0 127.0 FORMAT "%5.1" ECU_ADDRESS 0x6000AF12 /end MEASUREMENT
/begin MEASUREMENT HLSDem_nSetPLoDiff "LLR: difference of idle speed precontrol" SWORD nmot_sw_q0p5 1 100 -16384.00 16383.50 FORMAT "%8.2" ECU_ADDRESS 0x60013F88 /end MEASUREMENT
/begin MEASUREMENT HLSDem_nSetPTrck "Idle reference speed" SWORD nmot_sw_q0p5 1 100 -16384.00 16383.50 FORMAT "%8.2" ECU_ADDRESS 0x60013F8A /end MEASUREMENT
/begin MEASUREMENT LLim_aMSL_mp "Acceleration limit from Maximum SL" SWORD Acc 1 100 -32.76800 32.76700 FORMAT "%8.5" ECU_ADDRESS 0x7000A232 /end MEASUREMENT
/begin MEASUREMENT LLim_aReq "Requested acceleration of Speed Limiter" SWORD Acc 1 100 -32.76800 32.76700 FORMAT "%8.5" ECU_ADDRESS 0x6000905E /end MEASUREMENT
/begin MEASUREMENT LLim_axReq "Ramped acceleration request of Speed Limiter" SWORD Acc 1 100 -32.76800 32.76700 FORMAT "%8.5" ECU_ADDRESS 0x6000905C /end MEASUREMENT
/begin MEASUREMENT LLim_bFcoDes "Desired fuel cutoff" UBYTE B_TRUE 1 100 0.00 1.00000000000 BIT_MASK 0x1 FORMAT "%13.11" ECU_ADDRESS 0x70000822 /end MEASUREMENT
/begin MEASUREMENT LLim_ctASLAppATOpenLrn_mp "Status for temporary release of APP limitation" UBYTE OneToOne 1 100 0.00 255.0 FORMAT "%5.1" ECU_ADDRESS 0x7000A22C /end MEASUREMENT
/begin MEASUREMENT LLim_dvMSL_mp "Difference of current velocity to maximum vehicle velocity" SWORD Vel 1 100 -327.6800 327.6700 FORMAT "%8.4" ECU_ADDRESS 0x7000A230 /end MEASUREMENT
/begin MEASUREMENT LLim_facAcclP_mp "Factor of acceleration control P coefficient" SWORD Fact_CrCtl2 1 100 -512.0000 511.9844 FORMAT "%8.4" ECU_ADDRESS 0x7000A22A /end MEASUREMENT
/begin MEASUREMENT LLim_facAcclShutOff_mp "Factor of shut off correction for accelerate speed control" SWORD Fact_CrCtl2 1 100 -512.0000 511.9844 FORMAT "%8.4" ECU_ADDRESS 0x7000A228 /end MEASUREMENT
/begin MEASUREMENT LLim_facAPPDiffCor_mp "Correction factor based on difference of accel pedal position" SWORD Fact1 1 100 -256.0000 255.9922 FORMAT "%8.4" ECU_ADDRESS 0x7000A226 /end MEASUREMENT
/begin MEASUREMENT LLim_facConstD_mp "Factor of constant speed control D coefficient" SWORD Fact_CrCtl2 1 100 -512.0000 511.9844 FORMAT "%8.4" ECU_ADDRESS 0x7000A224 /end MEASUREMENT
/begin MEASUREMENT LLim_facConstP_mp "Factor of constant speed control P coefficient" SWORD Fact_CrCtl3 1 100 -32.00000 31.99902 FORMAT "%8.5" ECU_ADDRESS 0x7000A222 /end MEASUREMENT
/begin MEASUREMENT LLim_facConstShutOff_mp "Factor of shut off correction for constant speed control" SWORD Fact_CrCtl2 1 100 -512.0000 511.9844 FORMAT "%8.4" ECU_ADDRESS 0x7000A220 /end MEASUREMENT
/begin MEASUREMENT LLim_flgASLCtrlTmpHalt "Flag during ASL control temporarily halt" UBYTE OneToOne 1 100 0.00 1.000 FORMAT "%5.3" ECU_ADDRESS 0x6000F3E1 /end MEASUREMENT
/begin MEASUREMENT LLim_flgASLOverSpd "Flag during ASL overspeed" UBYTE OneToOne 1 100 0.00 1.000 FORMAT "%5.3" ECU_ADDRESS 0x6000F3E0 /end MEASUREMENT
/begin MEASUREMENT LLim_flgISAOccUnitChg "Status of occurrence of kph mph unit changing" UBYTE OneToOne 1 100 0.00 1.000 FORMAT "%5.3" ECU_ADDRESS 0x60000EF4 /end MEASUREMENT
/begin MEASUREMENT LLim_flgMemDisp "Memory display function existance" UBYTE OneToOne 1 100 0.00 1.000 FORMAT "%5.3" ECU_ADDRESS 0x6000F3DF /end MEASUREMENT
/begin MEASUREMENT LLim_flgRmpFailr "Flag active ramp of speed limitation when chassis failure" UBYTE B_TRUE 1 100 0.00 1.00000000000 BIT_MASK 0x1 FORMAT "%13.11" ECU_ADDRESS 0x6000F0E7 /end MEASUREMENT
/begin MEASUREMENT LLim_numMETAlrm "Number of indicate meter display alarm" UBYTE OneToOne 1 100 0.00 255.0 FORMAT "%5.1" ECU_ADDRESS 0x6000F3DE /end MEASUREMENT
/begin MEASUREMENT LLim_numMETDspSelOld_mp "Old value of LLim_numMETDspSel_mp" UBYTE OneToOne 1 100 0.00 255.0 FORMAT "%5.1" ECU_ADDRESS 0x7000A21E /end MEASUREMENT
/begin MEASUREMENT LLim_numMETDspSel_mp "Selection number of meter display" UBYTE OneToOne 1 100 0.00 255.0 FORMAT "%5.1" ECU_ADDRESS 0x7000A21D /end MEASUREMENT
/begin MEASUREMENT LLim_numMETMemSpd "Number of memory vehicle speed for meter display in ASL" SWORD OneToOne 1 100 -32768.00 32767.00 FORMAT "%8.2" ECU_ADDRESS 0x6000905A /end MEASUREMENT
/begin MEASUREMENT LLim_numMETSpdBlnOld_mp "Previous number to select how to blink display speed for ASL" UBYTE OneToOne 1 100 0.00 255.0 FORMAT "%5.1" ECU_ADDRESS 0x7000A21C /end MEASUREMENT
/begin MEASUREMENT LLim_numMETSpdBln_mp "Number to select how to blink display speed for ASL" UBYTE OneToOne 1 100 0.00 255.0 FORMAT "%5.1" ECU_ADDRESS 0x7000A21B /end MEASUREMENT
/begin MEASUREMENT LLim_numTSRLimSpdClr_mp "Traffic sign information to be displayed on meter for ISA continue at TSR clear" UBYTE OneToOne 1 100 0.00 255.0 FORMAT "%5.1" ECU_ADDRESS 0x7000A21A /end MEASUREMENT
/begin MEASUREMENT LLim_numTSRLimSpdOffset_mp "Traffic sign information to be displayed on meter for ISA set vehicle speed with offset" UBYTE OneToOne 1 100 0.00 255.0 FORMAT "%5.1" ECU_ADDRESS 0x7000A219 /end MEASUREMENT
/begin MEASUREMENT LLim_numTSRLimSpdOld_mp "Old value of CrCUI_numTSRLimSpd" UBYTE OneToOne 1 100 0.00 255.0 FORMAT "%5.1" ECU_ADDRESS 0x7000A218 /end MEASUREMENT
/begin MEASUREMENT LLim_rAcclReqVar_mp "Request accel pedal position variation value of accelerate speed control" SLONG APPCrCtl1 1 100 -10737418.2400 10737418.2350 FORMAT "%13.4" ECU_ADDRESS 0x7000A214 /end MEASUREMENT
/begin MEASUREMENT LLim_rAppASLCncl_mp "Acceleration pedal position for checking ASL cancel" SWORD APPCrCtl1 1 100 -163.8400 163.8350 FORMAT "%8.4" ECU_ADDRESS 0x7000A210 /end MEASUREMENT
/begin MEASUREMENT LLim_rAPPCnclRetAcclLim_mp "Return value of accel pedal position when ASL cancel is turned on(acceleration limitation)" SWORD APPCrCtl1 1 100 -163.8400 163.8350 FORMAT "%8.4" ECU_ADDRESS 0x7000A20E /end MEASUREMENT
/begin MEASUREMENT LLim_rAPPCnclRetFin_mp "Final return value of accel pedal position when ASL cancel is turned on" SWORD APPCrCtl1 1 100 -163.8400 163.8350 FORMAT "%8.4" ECU_ADDRESS 0x7000A20C /end MEASUREMENT
/begin MEASUREMENT LLim_rAPPCnclRet_mp "Return value of accel pedal position when ASL cancel is turned on" SWORD APPCrCtl1 1 100 -163.8400 163.8350 FORMAT "%8.4" ECU_ADDRESS 0x7000A20A /end MEASUREMENT
/begin MEASUREMENT LLim_rAPPIniReq_mp "Initial request accel pedal position for ASL" SWORD APPCrCtl1 1 100 -163.8400 163.8350 FORMAT "%8.4" ECU_ADDRESS 0x7000A208 /end MEASUREMENT
/begin MEASUREMENT LLim_rAPPLimTmpRlsAPPOld_mp "Previous valur of accel pedal value during enabling temporary release of APP limitation" SWORD APPCrCtl1 1 100 -163.8400 163.8350 FORMAT "%8.4" ECU_ADDRESS 0x7000A206 /end MEASUREMENT
/begin MEASUREMENT LLim_rAPPLimTmpRlsAPP_mp "Accel pedal value during enabling temporary release of APP limitation" SWORD APPCrCtl1 1 100 -163.8400 163.8350 FORMAT "%8.4" ECU_ADDRESS 0x7000A204 /end MEASUREMENT
/begin MEASUREMENT LLim_rAPPMax_mp "Maximum accel pedal position for ASL" SWORD APPCrCtl1 1 100 -163.8400 163.8350 FORMAT "%8.4" ECU_ADDRESS 0x7000A202 /end MEASUREMENT
/begin MEASUREMENT LLim_rAPPReqFin_mp "Decided value of requirement accelerator position for ASL" SWORD APPCrCtl1 1 100 -163.8400 163.8350 FORMAT "%8.4" ECU_ADDRESS 0x7000A200 /end MEASUREMENT
/begin MEASUREMENT LLim_rAPPReqItmFltOld_mp "Old Interim value of filtered request accel pedal position" SWORD APPCrCtl1 1 100 -163.8400 163.8350 FORMAT "%8.4" ECU_ADDRESS 0x7000A1FE /end MEASUREMENT
/begin MEASUREMENT LLim_rAPPReqItmFlt_mp "Interim value of filtered request accel pedal position" SWORD APPCrCtl1 1 100 -163.8400 163.8350 FORMAT "%8.4" ECU_ADDRESS 0x7000A1FC /end MEASUREMENT
/begin MEASUREMENT LLim_rAPPReqItm_mp "Interim value of request accel pedal position" SWORD APPCrCtl1 1 100 -163.8400 163.8350 FORMAT "%8.4" ECU_ADDRESS 0x7000A1FA /end MEASUREMENT
/begin MEASUREMENT LLim_rAPP_mp "Driver accel pedal position" SWORD APPCrCtl1 1 100 -163.8400 163.8350 FORMAT "%8.4" ECU_ADDRESS 0x7000A1F8 /end MEASUREMENT
/begin MEASUREMENT LLim_rCCASLAppReq "APP ratio request of CC or ASL for AT" SWORD Prc 1 100 -400.0000 399.9878 FORMAT "%8.4" ECU_ADDRESS 0x60009058 /end MEASUREMENT
/begin MEASUREMENT LLim_rConstReqVar_mp "Request accel pedal position variation value of constant speed control" SLONG APPCrCtl1 1 100 -10737418.2400 10737418.2350 FORMAT "%13.4" ECU_ADDRESS 0x7000A1F4 /end MEASUREMENT
/begin MEASUREMENT LLim_rDeclReqVar_mp "Request accel pedal position variation value of decelerate speed control" SWORD APPCrCtl1 1 100 -163.8400 163.8350 FORMAT "%8.4" ECU_ADDRESS 0x7000A1F0 /end MEASUREMENT
/begin MEASUREMENT LLim_rDes "Desired accel pedal position for ASL" SWORD Prc 1 100 -400.0000 399.9878 FORMAT "%8.4" ECU_ADDRESS 0x60009056 /end MEASUREMENT
/begin MEASUREMENT LLim_rDesReq_mp "Request desired accel pedal position" SWORD APPCrCtl1 1 100 -163.8400 163.8350 FORMAT "%8.4" ECU_ADDRESS 0x7000A1EE /end MEASUREMENT
/begin MEASUREMENT LLim_rDiff100msItm_mp "100ms cycle difference APP ratio request interim value" SWORD APPCrCtl1 1 100 -163.8400 163.8350 FORMAT "%8.4" ECU_ADDRESS 0x7000A1EC /end MEASUREMENT
/begin MEASUREMENT LLim_rDiff100ms_mp "100ms cycle difference APP ratio request value" SWORD APPCrCtl1 1 100 -163.8400 163.8350 FORMAT "%8.4" ECU_ADDRESS 0x7000A1EA /end MEASUREMENT
/begin MEASUREMENT LLim_stActive "Active flag for adjustable speed limiter" UBYTE OneToOne 1 100 0.00 255.0 FORMAT "%5.1" ECU_ADDRESS 0x6000F3DB /end MEASUREMENT
/begin MEASUREMENT LLim_stActvLmp "Status of speed limiter active condition lamp" UBYTE OneToOne 1 100 0.00 255.0 FORMAT "%5.1" ECU_ADDRESS 0x6000F3DA /end MEASUREMENT
/begin MEASUREMENT LLim_stActvLmpItm1 "Intermediate status1 of speed limiter active condition lamp" UBYTE OneToOne 1 100 0.00 255.0 FORMAT "%5.1" ECU_ADDRESS 0x6000F3D9 /end MEASUREMENT
/begin MEASUREMENT LLim_stActvLmpItm2 "Intermediate status2 of speed limiter active condition lamp" UBYTE OneToOne 1 100 0.00 255.0 FORMAT "%5.1" ECU_ADDRESS 0x6000F3D8 /end MEASUREMENT
/begin MEASUREMENT LLim_stAlrmSoundStrtEdge "ASL warning sound start edge" UBYTE OneToOne 1 100 0.00 255.0 FORMAT "%5.1" ECU_ADDRESS 0x6000F3D7 /end MEASUREMENT
/begin MEASUREMENT LLim_stAlrmStrtEdge "Selection status of continuation time for ASL alarm." UBYTE OneToOne 1 100 0.00 255.0 FORMAT "%5.1" ECU_ADDRESS 0x6000F3D6 /end MEASUREMENT
/begin MEASUREMENT LLim_stAPPLimTmpRls_mp "Status for temporary release of APP limitation" UBYTE OneToOne 1 100 0.00 255.0 FORMAT "%5.1" ECU_ADDRESS 0x7000A1E8 /end MEASUREMENT
/begin MEASUREMENT LLim_stAPPOffReq_mp "Status of accel pedal position off request flag" UBYTE OneToOne 1 100 0.00 255.0 FORMAT "%5.1" ECU_ADDRESS 0x7000A1E7 /end MEASUREMENT
/begin MEASUREMENT LLim_stAPPOvr_mp "Status of accel pedal position over flag" UBYTE OneToOne 1 100 0.00 255.0 FORMAT "%5.1" ECU_ADDRESS 0x7000A1E6 /end MEASUREMENT
/begin MEASUREMENT LLim_stASLAppClsLrnHist_mp "History status of updating APP close learning value" UBYTE OneToOne 1 100 0.00 255.0 FORMAT "%5.1" ECU_ADDRESS 0x7000A1E5 /end MEASUREMENT
/begin MEASUREMENT LLim_stASLAppOpenAlrm_mp "Status of APP full open alarm" UBYTE OneToOne 1 100 0.00 255.0 FORMAT "%5.1" ECU_ADDRESS 0x7000A1E4 /end MEASUREMENT
/begin MEASUREMENT LLim_stASLIdasbCanErr "Active status of IDAS CAN communication error for speed limiter" UBYTE OneToOne 1 100 0.00 255.0 FORMAT "%5.1" ECU_ADDRESS 0x6000F3DD /end MEASUREMENT
/begin MEASUREMENT LLim_stASLRxErrDet "Status of ASL communication error detection" UBYTE OneToOne 1 100 0.00 255.0 FORMAT "%5.1" ECU_ADDRESS 0x6000F3DC /end MEASUREMENT
/begin MEASUREMENT LLim_stCCASLDataErr "Status of mutual data error detection of CC and ASL" UBYTE OneToOne 1 100 0.00 255.0 FORMAT "%5.1" ECU_ADDRESS 0x6000F3D5 /end MEASUREMENT
/begin MEASUREMENT LLim_stCnclAlrm_mp "Status of cancel alarm for ASL" UBYTE OneToOne 1 100 0.00 255.0 FORMAT "%5.1" ECU_ADDRESS 0x7000A1E3 /end MEASUREMENT
/begin MEASUREMENT LLim_stCondNo_mp "Status of ASL condition No." UBYTE OneToOne 1 100 0.00 255.0 FORMAT "%5.1" ECU_ADDRESS 0x7000A1E2 /end MEASUREMENT
/begin MEASUREMENT LLim_stIniOut_mp "Status of initialize output flag" UBYTE OneToOne 1 100 0.00 255.0 FORMAT "%5.1" ECU_ADDRESS 0x7000A1E1 /end MEASUREMENT
/begin MEASUREMENT LLim_stIniReq_mp "Status of initialize request flag" UBYTE OneToOne 1 100 0.00 255.0 FORMAT "%5.1" ECU_ADDRESS 0x7000A1E0 /end MEASUREMENT
/begin MEASUREMENT LLim_stISACnclAcclRecvr_mp "Flag indicates that accel pedal is in recovering due to ISA cancelled." UBYTE OneToOne 1 100 0.00 255.0 FORMAT "%5.1" ECU_ADDRESS 0x7000A1DF /end MEASUREMENT
/begin MEASUREMENT LLim_stISAContTSRClr "ISA control continuation flag when TSR is cleared" UBYTE OneToOne 1 100 0.00 255.0 FORMAT "%5.1" ECU_ADDRESS 0x6000F3D4 /end MEASUREMENT
/begin MEASUREMENT LLim_stISAContTSRClrOld_mp "Old value of ISA control continuation information when TSR is cleared" UBYTE OneToOne 1 100 0.00 255.0 FORMAT "%5.1" ECU_ADDRESS 0x7000A1DE /end MEASUREMENT
/begin MEASUREMENT LLim_stISATempStpOld_mp "Old value of Llim_stISATempStp_mp" UBYTE OneToOne 1 100 0.00 255.0 FORMAT "%5.1" ECU_ADDRESS 0x7000A1DD /end MEASUREMENT
/begin MEASUREMENT LLim_stISATempStp_mp "Status of ISA mode is temporarily cancelled during ISA control" UBYTE OneToOne 1 100 0.00 255.0 FORMAT "%5.1" ECU_ADDRESS 0x7000A1DC /end MEASUREMENT
/begin MEASUREMENT LLim_stMetCCMode1 "ASL Meter Display Mode 1" UBYTE OneToOne 1 100 0.00 255.0 FORMAT "%5.1" ECU_ADDRESS 0x6000F3D1 /end MEASUREMENT
/begin MEASUREMENT LLim_stMetCCMode2 "ASL Meter Display Mode 2" UBYTE OneToOne 1 100 0.00 255.0 FORMAT "%5.1" ECU_ADDRESS 0x6000F3D0 /end MEASUREMENT
/begin MEASUREMENT LLim_stMETVehUn "Status of vehicle speed unit for indicating meter in ASL" UBYTE OneToOne 1 100 0.00 255.0 FORMAT "%5.1" ECU_ADDRESS 0x6000F3D3 /end MEASUREMENT
/begin MEASUREMENT LLim_stModeNo "Status for ASL Mode No." UBYTE OneToOne 1 100 0.00 255.0 FORMAT "%5.1" ECU_ADDRESS 0x6000F3CF /end MEASUREMENT
/begin MEASUREMENT LLim_stModeNoOld_mp "Previous status for ASL Mode No." UBYTE OneToOne 1 100 0.00 255.0 FORMAT "%5.1" ECU_ADDRESS 0x7000A1DB /end MEASUREMENT
/begin MEASUREMENT LLim_stMSLActv "Condition Maximum Speed limiter is active" UBYTE OneToOne 1 100 0.00 255.0 FORMAT "%5.1" ECU_ADDRESS 0x6000F3D2 /end MEASUREMENT
/begin MEASUREMENT LLim_stReq "Status of acceleration request of Speed limiter" UBYTE B_TRUE 1 100 0.00 1.00000000000 BIT_MASK 0x1 FORMAT "%13.11" ECU_ADDRESS 0x6000F0E5 /end MEASUREMENT
/begin MEASUREMENT LLim_stResWait_mp "Status of waiting ASL state shift to RESUME and PRESET" UBYTE OneToOne 1 100 0.00 255.0 FORMAT "%5.1" ECU_ADDRESS 0x7000A1DA /end MEASUREMENT
/begin MEASUREMENT LLim_stSetSpdIdcBlnOff_mp "Status of indicate ASL set vehicle speed blink off" UBYTE OneToOne 1 100 0.00 255.0 FORMAT "%5.1" ECU_ADDRESS 0x7000A1D9 /end MEASUREMENT
/begin MEASUREMENT LLim_stSpdNoUpdReq "Status of (CC or ACC) desired vehicle speed display no update request." UBYTE OneToOne 1 100 0.00 255.0 FORMAT "%5.1" ECU_ADDRESS 0x6000F3CE /end MEASUREMENT
/begin MEASUREMENT LLim_stVehSpdAreaNoOld_mp "Old ASL area no. of control vehicle speed" UBYTE OneToOne 1 100 0.00 255.0 FORMAT "%5.1" ECU_ADDRESS 0x7000A1D8 /end MEASUREMENT
/begin MEASUREMENT LLim_stVehSpdAreaNo_mp "ASL area no. of control vehicle speed" UBYTE OneToOne 1 100 0.00 255.0 FORMAT "%5.1" ECU_ADDRESS 0x7000A1D7 /end MEASUREMENT
/begin MEASUREMENT LLim_stVehSpdOver_mp "Status of over speed for ASL" UBYTE OneToOne 1 100 0.00 255.0 FORMAT "%5.1" ECU_ADDRESS 0x7000A1D6 /end MEASUREMENT
/begin MEASUREMENT LLim_stVehUnSelOld_mp "Status of old selected value by ASL vehicle speed unit" UBYTE OneToOne 1 100 0.00 255.0 FORMAT "%5.1" ECU_ADDRESS 0x7000A1D5 /end MEASUREMENT
/begin MEASUREMENT LLim_stVehUnSel_mp "Status of selected value by ASL vehicle speed unit" UBYTE OneToOne 1 100 0.00 255.0 FORMAT "%5.1" ECU_ADDRESS 0x7000A1D4 /end MEASUREMENT
/begin MEASUREMENT LLim_tiAPPLimTmpRls_mp "Timer that check the end of temporary release of APP limitation" SWORD Time_ms_100ms 1 100 -3276800. 3276700. FORMAT "%8.0" ECU_ADDRESS 0x7000A1D2 /end MEASUREMENT
/begin MEASUREMENT LLim_tiArChgAppSel_mp "Time to change APP difference with area change" SWORD Time_ms_100ms 1 100 -3276800. 3276700. FORMAT "%8.0" ECU_ADDRESS 0x7000A1D0 /end MEASUREMENT
/begin MEASUREMENT LLim_tiASLAppClsLrnStrt_mp "Timer of checking APP close learning start" SWORD Time_ms 1 100 -327680.0 327670.0 FORMAT "%8.1" ECU_ADDRESS 0x7000A1CE /end MEASUREMENT
/begin MEASUREMENT LLim_tiASLAppClsLrnUpd_mp "Wait timer for update of APP close learning value" SWORD Time_ms_100ms 1 100 -3276800. 3276700. FORMAT "%8.0" ECU_ADDRESS 0x7000A1CC /end MEASUREMENT
/begin MEASUREMENT LLim_tiASLAppOpenAlrm_mp "Timer of checking APP full open alarm continuation for ASL" SWORD Time_ms_100ms 1 100 -3276800. 3276700. FORMAT "%8.0" ECU_ADDRESS 0x7000A1CA /end MEASUREMENT
/begin MEASUREMENT LLim_tiASLAppOpenLrnStrt_mp "Timer of checking APP open learning start" SWORD Time_ms 1 100 -327680.0 327670.0 FORMAT "%8.1" ECU_ADDRESS 0x7000A1C8 /end MEASUREMENT
/begin MEASUREMENT LLim_tiASLCnclSound "Duration of ASL cancellation beep sound alert" SWORD Time_ms_100ms 1 100 -3276800. 3276700. FORMAT "%8.0" ECU_ADDRESS 0x60000EF2 /end MEASUREMENT
/begin MEASUREMENT LLim_tiASLIdasbErr_mp "." SWORD Time_ms 1 100 -327680.0 327670.0 FORMAT "%8.1" ECU_ADDRESS 0x7000A1C6 /end MEASUREMENT
/begin MEASUREMENT LLim_tiASLRxErr_mp "Timer of ASL communication error" SWORD Time_ms 1 100 -327680.0 327670.0 FORMAT "%8.1" ECU_ADDRESS 0x7000A1C4 /end MEASUREMENT
/begin MEASUREMENT LLim_tiASLSet_mp "Timer of ASL state shift timing from PRESET to SET" SWORD Time_ms 1 100 -327680.0 327670.0 FORMAT "%8.1" ECU_ADDRESS 0x7000A1C2 /end MEASUREMENT
/begin MEASUREMENT LLim_tiCCASLDataErr_mp "Timer of mutual data error of CC and ASL" SWORD Time_ms 1 100 -327680.0 327670.0 FORMAT "%8.1" ECU_ADDRESS 0x7000A1C0 /end MEASUREMENT
/begin MEASUREMENT LLim_tiCnclAlrm_mp "Timer of ASL cancel alarm" SWORD Time_ms_100ms 1 100 -3276800. 3276700. FORMAT "%8.0" ECU_ADDRESS 0x7000A1BE /end MEASUREMENT
/begin MEASUREMENT LLim_tiCtlExtn_mp "Timer of ASL control extension" SWORD Time_ms 1 100 -327680.0 327670.0 FORMAT "%8.1" ECU_ADDRESS 0x7000A1BC /end MEASUREMENT
/begin MEASUREMENT LLim_tiISATempStpBlnk_mp "Timer for blinking for vehicle speed display at ISA temporary stop" SWORD Time_ms_100ms 1 100 -3276800. 3276700. FORMAT "%8.0" ECU_ADDRESS 0x7000A1BA /end MEASUREMENT
/begin MEASUREMENT LLim_tiOvrSpdAlrmFin_mp "Timer of ASL over vehicle speed alarm finish check" SWORD Time_ms_100ms 1 100 -3276800. 3276700. FORMAT "%8.0" ECU_ADDRESS 0x7000A1B8 /end MEASUREMENT
/begin MEASUREMENT LLim_tiOvrSpdAlrmStrt_mp "Timer of ASL over vehicle speed alarm start check" SWORD Time_ms_100ms 1 100 -3276800. 3276700. FORMAT "%8.0" ECU_ADDRESS 0x7000A1B6 /end MEASUREMENT
/begin MEASUREMENT LLim_tiSetSpdBlnOff_mp "Timer of Set vehicle speed Blink Off" SWORD Time_ms_100ms 1 100 -3276800. 3276700. FORMAT "%8.0" ECU_ADDRESS 0x7000A1B4 /end MEASUREMENT
/begin MEASUREMENT LLim_tiSetSpdBlnOn_mp "Timer of Set vehicle speed Blink On" SWORD Time_ms_100ms 1 100 -3276800. 3276700. FORMAT "%8.0" ECU_ADDRESS 0x7000A1B2 /end MEASUREMENT
/begin MEASUREMENT LLim_uASLAppATSnsrOpenLrnOld_mp "Old AP sensor voltage(full open learn value) for AT" SWORD Volt_Batt 1 100 -655360.0 655340.0 FORMAT "%8.1" ECU_ADDRESS 0x7000A1B0 /end MEASUREMENT
/begin MEASUREMENT LLim_uASLAppClsLrnStrt_mp "Acceleration pedal sensor voltage of checking close learning start for ASL" SWORD Volt 1 100 -6553.600 6553.400 FORMAT "%8.3" ECU_ADDRESS 0x7000A1AE /end MEASUREMENT
/begin MEASUREMENT LLim_uASLAppClsLrn_mp "Acceleration pedal sensor voltage of close learning result for ASL" SWORD Volt 1 100 -6553.600 6553.400 FORMAT "%8.3" ECU_ADDRESS 0x7000A1AC /end MEASUREMENT
/begin MEASUREMENT LLim_uASLAppOpenLrnStrt_mp "Acceleration pedal sensor voltage of checking open learning start for ASL" SWORD Volt 1 100 -6553.600 6553.400 FORMAT "%8.3" ECU_ADDRESS 0x7000A1AA /end MEASUREMENT
/begin MEASUREMENT LLim_uASLAppOpenLrn_mp "Acceleration pedal sensor voltage of open learning result for ASL" SWORD Volt 1 100 -6553.600 6553.400 FORMAT "%8.3" ECU_ADDRESS 0x7000A1A8 /end MEASUREMENT
/begin MEASUREMENT LLim_uASLAppSnsr_mp "Acceleration pedal sensor voltage for ASL" SWORD Volt 1 100 -6553.600 6553.400 FORMAT "%8.3" ECU_ADDRESS 0x7000A1A6 /end MEASUREMENT
/begin MEASUREMENT LLim_vAcclDvt_mp "Accelerate deviation value for ASL" SWORD Vel 1 100 -327.6800 327.6700 FORMAT "%8.4" ECU_ADDRESS 0x7000A1A4 /end MEASUREMENT
/begin MEASUREMENT LLim_vAPPLimTmpRlsSpd_mp "Vehicle speed at start of APP limitation temporary release" SWORD Vel 1 100 -327.6800 327.6700 FORMAT "%8.4" ECU_ADDRESS 0x7000A1A2 /end MEASUREMENT
/begin MEASUREMENT LLim_vDesAccl_mp "Desired accelerate value for ASL" SWORD Vel 1 100 -327.6800 327.6700 FORMAT "%8.4" ECU_ADDRESS 0x7000A1A0 /end MEASUREMENT
/begin MEASUREMENT LLim_vDes_mp "Desired vehicle speed for ASL control" SWORD Vel 1 100 -327.6800 327.6700 FORMAT "%8.4" ECU_ADDRESS 0x7000A19E /end MEASUREMENT
/begin MEASUREMENT LLim_vDLimHysHi_mp "ASL Vehicle spped for DL (hysteresis Hi) value" SWORD Vel 1 100 -327.6800 327.6700 FORMAT "%8.4" ECU_ADDRESS 0x7000A19C /end MEASUREMENT
/begin MEASUREMENT LLim_vDLimHysLo_mp "ASL Vehicle spped for DL (hysteresis Lo) value" SWORD Vel 1 100 -327.6800 327.6700 FORMAT "%8.4" ECU_ADDRESS 0x7000A19A /end MEASUREMENT
/begin MEASUREMENT LLim_vDLim_mp "ASL Vehicle speed for Disel limit" SWORD Vel 1 100 -327.6800 327.6700 FORMAT "%8.4" ECU_ADDRESS 0x7000A198 /end MEASUREMENT
/begin MEASUREMENT LLim_vISALimSpdOffsetLo_mp "Lower limit speed with offset calculated by current TSR limit speed" SWORD Vel 1 100 -327.6800 327.6700 FORMAT "%8.4" ECU_ADDRESS 0x7000A196 /end MEASUREMENT
/begin MEASUREMENT LLim_vISALimSpdOffsetUp_mp "Upper limit speed with offset calculated by current TSR limit speed" SWORD Vel 1 100 -327.6800 327.6700 FORMAT "%8.4" ECU_ADDRESS 0x7000A194 /end MEASUREMENT
/begin MEASUREMENT LLim_vMaxMSLFailr "Vehicle velocity limited when chassis failure" SWORD Vel 1 100 -327.6800 327.6700 FORMAT "%8.4" ECU_ADDRESS 0x60009054 /end MEASUREMENT
/begin MEASUREMENT LLim_vMaxMSL_mp "Maximum Limit Speed" SWORD Vel 1 100 -327.6800 327.6700 FORMAT "%8.4" ECU_ADDRESS 0x7000A22E /end MEASUREMENT
/begin MEASUREMENT LLim_vMemDisp "Memory speed display" UWORD Vel 1 100 0.00 655.3500 FORMAT "%8.4" ECU_ADDRESS 0x60008BD0 /end MEASUREMENT
/begin MEASUREMENT LLim_vMemSpdAftCncl_mp "Memory vehicle speed of after ASL cancel" SWORD Vel 1 100 -327.6800 327.6700 FORMAT "%8.4" ECU_ADDRESS 0x7000A192 /end MEASUREMENT
/begin MEASUREMENT LLim_vMemSpdFinAftCor_mp "Final value of ASL memory vehicle speed after correction" SWORD Vel 1 100 -327.6800 327.6700 FORMAT "%8.4" ECU_ADDRESS 0x7000A190 /end MEASUREMENT
/begin MEASUREMENT LLim_vMemSpdFin_mp "Final value of ASL memory vehicle speed" SWORD Vel 1 100 -327.6800 327.6700 FORMAT "%8.4" ECU_ADDRESS 0x7000A18E /end MEASUREMENT
/begin MEASUREMENT LLim_vMemSpdLoLim_mp "Memory vehicle speed lower limit value for ASL" SWORD Vel 1 100 -327.6800 327.6700 FORMAT "%8.4" ECU_ADDRESS 0x7000A18C /end MEASUREMENT
/begin MEASUREMENT LLim_vMemSpdMPH_mp "Memory vehicle speed(MPH) for ASL" SLONG Vel_CrCtl_MPH 1 100 -8388608.00000 8388607.99609 FORMAT "%13.5" ECU_ADDRESS 0x7000A188 /end MEASUREMENT
/begin MEASUREMENT LLim_vMemSpdOld_mp "Old value of LLim_vMemSpd_mp" SWORD Vel 1 100 -327.6800 327.6700 FORMAT "%8.4" ECU_ADDRESS 0x7000A186 /end MEASUREMENT
/begin MEASUREMENT LLim_vMemSpdResOnKmh_mp "ASL Memory vehicle speed during Res SW is on(Km/h)" SWORD Vel_CrCtl1 1 100 -32768.00 32767.00 FORMAT "%8.2" ECU_ADDRESS 0x7000A184 /end MEASUREMENT
/begin MEASUREMENT LLim_vMemSpdResOnMPH_mp "ASL Memory vehicle speed during Res SW is on(MPH)" SWORD Vel_CrCtl1_MPH 1 100 -32768.00 32767.00 FORMAT "%8.2" ECU_ADDRESS 0x7000A182 /end MEASUREMENT
/begin MEASUREMENT LLim_vMemSpdResTrnOnKmh_mp "ASL Memory vehicle speed when Res SW is turned on(Km/h)" SWORD Vel_CrCtl1 1 100 -32768.00 32767.00 FORMAT "%8.2" ECU_ADDRESS 0x7000A180 /end MEASUREMENT
/begin MEASUREMENT LLim_vMemSpdResTrnOnMPH_mp "ASL Memory vehicle speed when Res SW is turned on(MPH)" SWORD Vel_CrCtl1_MPH 1 100 -32768.00 32767.00 FORMAT "%8.2" ECU_ADDRESS 0x7000A17E /end MEASUREMENT
/begin MEASUREMENT LLim_vMemSpdSetOnKmh_mp "ASL Memory vehicle speed during Set SW is on(Km/h)" SWORD Vel_CrCtl1 1 100 -32768.00 32767.00 FORMAT "%8.2" ECU_ADDRESS 0x7000A17C /end MEASUREMENT
/begin MEASUREMENT LLim_vMemSpdSetOnMPH_mp "ASL Memory vehicle speed during Set SW is on(MPH)" SWORD Vel_CrCtl1_MPH 1 100 -32768.00 32767.00 FORMAT "%8.2" ECU_ADDRESS 0x7000A17A /end MEASUREMENT
/begin MEASUREMENT LLim_vMemSpdSetTrnOnKmh_mp "ASL Memory vehicle speed when Set SW is turned on(Km/h)" SWORD Vel_CrCtl1 1 100 -32768.00 32767.00 FORMAT "%8.2" ECU_ADDRESS 0x7000A178 /end MEASUREMENT
/begin MEASUREMENT LLim_vMemSpdSetTrnOnMPH_mp "ASL Memory vehicle speed when Set SW is turned on(MPH)" SWORD Vel_CrCtl1_MPH 1 100 -32768.00 32767.00 FORMAT "%8.2" ECU_ADDRESS 0x7000A176 /end MEASUREMENT
/begin MEASUREMENT LLim_vMemSpdSwtOnKmh_mp "ASL Memory vehicle speed during SW is on(Km/h)" SWORD Vel 1 100 -327.6800 327.6700 FORMAT "%8.4" ECU_ADDRESS 0x7000A174 /end MEASUREMENT
/begin MEASUREMENT LLim_vMemSpdSwtOnMPH_mp "ASL Memory vehicle speed during SW is on(MPH)" SLONG Vel_CrCtl_MPH 1 100 -8388608.00000 8388607.99609 FORMAT "%13.5" ECU_ADDRESS 0x7000A170 /end MEASUREMENT
/begin MEASUREMENT LLim_vMemSpdUpLim_mp "Memory vehicle speed upper limit value for ASL" SWORD Vel 1 100 -327.6800 327.6700 FORMAT "%8.4" ECU_ADDRESS 0x7000A16E /end MEASUREMENT
/begin MEASUREMENT LLim_vMemSpdVerfDat_mp "Data for ASL memory vehicle speed verification" SWORD Vel 1 100 -327.6800 327.6700 FORMAT "%8.4" ECU_ADDRESS 0x7000A16C /end MEASUREMENT
/begin MEASUREMENT LLim_vMemSpd_mp "Memory vehicle speed for ASL" SWORD Vel 1 100 -327.6800 327.6700 FORMAT "%8.4" ECU_ADDRESS 0x7000A16A /end MEASUREMENT
/begin MEASUREMENT LLim_vMETMemSpdItmKmh_mp "Interim value of memory vehicle speed for indicating meter in ASL (km/h)" SWORD Vel_CrCtl1 1 100 -32768.00 32767.00 FORMAT "%8.2" ECU_ADDRESS 0x7000A168 /end MEASUREMENT
/begin MEASUREMENT LLim_vMETMemSpdItmMPH_mp "Interim value of memory vehicle speed for indicating meter in ASL (MPH)" SWORD Vel_CrCtl1_MPH 1 100 -32768.00 32767.00 FORMAT "%8.2" ECU_ADDRESS 0x7000A166 /end MEASUREMENT
/begin MEASUREMENT LLim_vNoCtlPntHysHi_mp "ASL Vehicle spped for non control point(hysteresis Hi) value" SWORD Vel 1 100 -327.6800 327.6700 FORMAT "%8.4" ECU_ADDRESS 0x7000A164 /end MEASUREMENT
/begin MEASUREMENT LLim_vNoCtlPntHysLo_mp "ASL Vehicle spped for non control point(hysteresis Lo) value" SWORD Vel 1 100 -327.6800 327.6700 FORMAT "%8.4" ECU_ADDRESS 0x7000A162 /end MEASUREMENT
/begin MEASUREMENT LLim_vNoCtlPnt_mp "ASL Vehicle spped for non control point" SWORD Vel 1 100 -327.6800 327.6700 FORMAT "%8.4" ECU_ADDRESS 0x7000A160 /end MEASUREMENT
/begin MEASUREMENT LLim_vRPntHysHi_mp "ASL Vehicle spped for RP (hysteresis Hi) value" SWORD Vel 1 100 -327.6800 327.6700 FORMAT "%8.4" ECU_ADDRESS 0x7000A15E /end MEASUREMENT
/begin MEASUREMENT LLim_vRPntHysLo_mp "ASL Vehicle spped for RP (hysteresis Lo) value" SWORD Vel 1 100 -327.6800 327.6700 FORMAT "%8.4" ECU_ADDRESS 0x7000A15C /end MEASUREMENT
/begin MEASUREMENT LLim_vRPnt_mp "ASL Vehicle speed for Resume Point" SWORD Vel 1 100 -327.6800 327.6700 FORMAT "%8.4" ECU_ADDRESS 0x7000A15A /end MEASUREMENT
/begin MEASUREMENT LLim_vSpdDvt_mp "Deviation of ASL vehicle speed" SWORD Vel 1 100 -327.6800 327.6700 FORMAT "%8.4" ECU_ADDRESS 0x7000A158 /end MEASUREMENT
/begin MEASUREMENT LLim_vTSRLimSpdTmp_mp "Limiting vehicle speed received through the TSR" SWORD Vel 1 100 -327.6800 327.6700 FORMAT "%8.4" ECU_ADDRESS 0x7000A156 /end MEASUREMENT
/begin MEASUREMENT llrmrfrm_w "fast mean value of lambda control factor, filtered and used in LLRMR (word)" UWORD fak_uw_b2 1 100 0.00 1.999969 FORMAT "%8.6" ECU_ADDRESS 0x60006AD2 /end MEASUREMENT
/begin MEASUREMENT LLRMR_bTrqResActv "Bit; torque-reserve active" UBYTE B_TRUE 1 100 0.00 1.00000000000 BIT_MASK 0x1 FORMAT "%13.11" ECU_ADDRESS 0x6000F0EA /end MEASUREMENT
/begin MEASUREMENT LLRMR_bTrqResInActv "Bit; torque-reserve not active" UBYTE B_TRUE 1 100 0.00 1.00000000000 BIT_MASK 0x1 FORMAT "%13.11" ECU_ADDRESS 0x6000F0E9 /end MEASUREMENT
/begin MEASUREMENT LLRMR_dmreshh "Variable for reduction rate for increased torque reserve during rear window heating" UBYTE B_TRUE 1 100 0.00 1.00000000000 BIT_MASK 0x1 FORMAT "%13.11" ECU_ADDRESS 0x6000AF1A /end MEASUREMENT
/begin MEASUREMENT llrmr_dmresll "corrected torque reserve after engine speed drop down" UWORD rel_q0p00153 1 100 0.00 99.99847 FORMAT "%8.5" ECU_ADDRESS 0x60013476 /end MEASUREMENT
/begin MEASUREMENT LLRMR_dns_temp "local value for dns in LLRMR" SWORD nmot_sw_q0p5 1 100 -16384.00 16383.50 FORMAT "%8.2" ECU_ADDRESS 0x60006AD0 /end MEASUREMENT
/begin MEASUREMENT LLRMR_etazwmn "minimum ignition angle effectiveness + offset calculated in LLRMR" UWORD fak_uw_b2 1 100 0.00 1.000000 FORMAT "%8.6" ECU_ADDRESS 0x60006ACE /end MEASUREMENT
/begin MEASUREMENT LLRMR_fethmumx_tmp "local value for fethmnmx in LLRMR (MDG1)" UBYTE fak_ub_b2 1 100 0.00 1.992188 FORMAT "%8.6" ECU_ADDRESS 0x6000AF19 /end MEASUREMENT
/begin MEASUREMENT LLRMR_fho_tmp "local value for fho in LLRMR (MDG1)" UBYTE fak_ub_b4 1 100 0.00 3.984 FORMAT "%5.3" ECU_ADDRESS 0x600140C8 /end MEASUREMENT
/begin MEASUREMENT LLRMR_flgClthStDefn "Give either the state of the bit LLRMR_stCluOpnNotCmpl_C or bit LLRMR_stCluOpnCmpl_C of the clutch state" UBYTE B_TRUE 1 100 0.00 1.00000000000 BIT_MASK 0x1 FORMAT "%13.11" ECU_ADDRESS 0x60000EF1 /end MEASUREMENT
/begin MEASUREMENT LLRMR_flgTrsmClthSt "Give the state of the bit LLRMR_stCluOpnNotCmpl_C of the clutch state in case of Manual Transmission, or FALSE if the transmission is not manual" UBYTE B_TRUE 1 100 0.00 1.00000000000 BIT_MASK 0x1 FORMAT "%13.11" ECU_ADDRESS 0x60000EF0 /end MEASUREMENT
/begin MEASUREMENT LLRMR_gangi_tmp "local value for gangi in LLRMR (MDG1)" UBYTE OneToOne 1 100 0.00 255.0 FORMAT "%5.1" ECU_ADDRESS 0x6000AF18 /end MEASUREMENT
/begin MEASUREMENT LLRMR_mibmn "internal base torque + offset calculated in LLRMR, LLRMR lower limit for given mode" UWORD rel_uw_b100 1 100 0.00 99.99847 FORMAT "%8.5" ECU_ADDRESS 0x60006ACC /end MEASUREMENT
/begin MEASUREMENT LLRMR_mifa_w_tmp "local value for mifa_w in LLRMR (MDG1)" UWORD rel_uw_b100 1 100 0.00 99.99847 FORMAT "%8.5" ECU_ADDRESS 0x60006ACA /end MEASUREMENT
/begin MEASUREMENT LLRMR_nmotw_tmp "local value for nmot_w in LLRMR (MDG1)" UWORD nmot_uw_q0p25 1 100 0.00 16383.75 FORMAT "%8.2" ECU_ADDRESS 0x60006AC8 /end MEASUREMENT
/begin MEASUREMENT LLRMR_nmot_tmp "local value for nmot in LLRMR (MDG1)" UBYTE nmot_ub_q40 1 100 0.00 10200. FORMAT "%5.0" ECU_ADDRESS 0x6000AF17 /end MEASUREMENT
/begin MEASUREMENT LLRMR_percTqResvBas "torque reserve in non idle - base torque reserve" UWORD rel_uw_b100 1 100 0.00 99.99847 FORMAT "%8.5" ECU_ADDRESS 0x60006AC6 /end MEASUREMENT
/begin MEASUREMENT LLRMR_percTqResvDrvMod "Torque reserve in non idle- dependent on driving program , limited" UWORD rel_uw_b100 1 100 0.00 99.99847 FORMAT "%8.5" ECU_ADDRESS 0x600133F2 /end MEASUREMENT
/begin MEASUREMENT LLRMR_percTqResvEngGrdt "Torque reserve depending on engine speed gradient" UWORD rel_uw_b100 1 100 0.00 99.99847 FORMAT "%8.5" ECU_ADDRESS 0x60008BD2 /end MEASUREMENT
/begin MEASUREMENT LLRMR_percTqResvEngGrdtOld "Torque reserve depending on engine speed gradient (old value)" UWORD rel_uw_b100 1 100 0.00 99.99847 FORMAT "%8.5" ECU_ADDRESS 0x60006AC4 /end MEASUREMENT
/begin MEASUREMENT LLRMR_percTqResvHeatrReq "Torque reserve for improved engine heat up (non-idle)" UWORD rel_uw_b100 1 100 0.00 99.99847 FORMAT "%8.5" ECU_ADDRESS 0x60006AC2 /end MEASUREMENT
/begin MEASUREMENT LLRMR_percTqResvLtd "Torque reserve non idle - limited" UWORD rel_uw_b100 1 100 0.00 99.99847 FORMAT "%8.5" ECU_ADDRESS 0x60006AC0 /end MEASUREMENT
/begin MEASUREMENT LLRMR_percTqResvOffsLtd "Torque reserve in non idle limited by minimal distance to etazwmn_w_msg" UWORD rel_uw_b100 1 100 0.00 99.99847 FORMAT "%8.5" ECU_ADDRESS 0x60006ABE /end MEASUREMENT
/begin MEASUREMENT LLRMR_percTqResvSpv "Torque reserve non idle sportive" UWORD rel_uw_b100 1 100 0.00 99.99847 FORMAT "%8.5" ECU_ADDRESS 0x600133F4 /end MEASUREMENT
/begin MEASUREMENT LLRMR_percTqResvWght "gear based weighted torque reserve non idle" UWORD rel_uw_b100 1 100 0.00 99.99847 FORMAT "%8.5" ECU_ADDRESS 0x600133F6 /end MEASUREMENT
/begin MEASUREMENT LLRMR_tans_temp "local value for tans in LLRMR (MDG1)" UBYTE temp_ub_q0p75_o48 1 100 -48.0 143.3 FORMAT "%5.1" ECU_ADDRESS 0x6000AF16 /end MEASUREMENT
/begin MEASUREMENT LLRMR_tmot_tmp "local value for tmot in LLRMR (MDG1)" UBYTE temp_ub_q0p75_o48 1 100 -48.0 143.3 FORMAT "%5.1" ECU_ADDRESS 0x6000AF15 /end MEASUREMENT
/begin MEASUREMENT LLRMR_tnst_tmp "Local variable for time after end of start" UWORD t10msxs_uw_b655p35 1 100 0.00 655.3500 FORMAT "%8.4" ECU_ADDRESS 0x60006ABC /end MEASUREMENT
/begin MEASUREMENT LLRMR_tosp_tmp "Local value of tosp" UBYTE temp_ub_q0p75_o48 1 100 -48.0 143.3 FORMAT "%5.1" ECU_ADDRESS 0x6000AF14 /end MEASUREMENT
/begin MEASUREMENT LLRMR_vfzg_tmp "local value for vehicle speed in LLRMR (MDG1)" UBYTE vfzg_ub_q1p25 1 100 0.00 318.8 FORMAT "%5.1" ECU_ADDRESS 0x6000AF13 /end MEASUREMENT
/begin MEASUREMENT LLRNSNF_bReqdTrckSpRst "tracking sepoint reset bit when drive off is active" UBYTE B_TRUE 1 100 0.00 1.00000000000 BIT_MASK 0x1 FORMAT "%13.11" ECU_ADDRESS 0x6000AF11 /end MEASUREMENT
/begin MEASUREMENT LLRNSNF_dnEngFlt "filtered engine speed gradient" UBYTE B_TRUE 1 100 0.00 1.00000000000 BIT_MASK 0x1 FORMAT "%13.11" ECU_ADDRESS 0x6000AF10 /end MEASUREMENT
/begin MEASUREMENT LLRNSNF_nOffsSpLoTrckEna "Low idle set point offset to enable tracking" SWORD nmot_sw_q0p5 1 100 0.00 16383.50 FORMAT "%8.2" ECU_ADDRESS 0x60009062 /end MEASUREMENT
/begin MEASUREMENT llrnsnf_sns06llsbLoc "llrnsnf" SBYTE nmotd_sb_q10 1 100 -1280. 1270. FORMAT "%5.0" ECU_ADDRESS 0x6000AF0F /end MEASUREMENT
/begin MEASUREMENT llrnsnf_stm06llublLoc "llrnsnf" UBYTE temp_ub_q0p75_o48 1 100 -48.0 143.3 FORMAT "%5.1" ECU_ADDRESS 0x6000AF0E /end MEASUREMENT
/begin MEASUREMENT nsnf_w "LLR: followed-up target speed" SWORD nmot_sw_q0p5 1 100 0.00 16383.50 FORMAT "%8.2" ECU_ADDRESS 0x60006AB8 /end MEASUREMENT
/begin MEASUREMENT nsst_msg "Initialisation value for desired RPM during start" UBYTE nmot_ub_q10 1 100 0.00 2550. FORMAT "%5.0" ECU_ADDRESS 0x6000F2E6 /end MEASUREMENT
/begin MEASUREMENT nstteold_w "frozen nstate" SWORD nmot_sw_q0p5 1 100 0.00 16383.50 FORMAT "%8.2" ECU_ADDRESS 0x60006AB6 /end MEASUREMENT
/begin MEASUREMENT SpdGov_trqResvRel "Relative torque reserve for idle speed control" SWORD md_sw_q0p1 1 100 -3276.800 3276.700 FORMAT "%8.3" ECU_ADDRESS 0x60008F5E /end MEASUREMENT
/begin MEASUREMENT tmp_fakll "Factor to weight the desired speed at start during catalyst heating" UWORD fak_ub_b2 1 100 0.00 1.992188 FORMAT "%8.6" ECU_ADDRESS 0x60006AB4 /end MEASUREMENT
/begin MEASUREMENT tmst_llrnsnf_loc "Engine temperengine temperature at startature" UBYTE temp_ub_q0p75_o48 1 100 -48.0 143.3 FORMAT "%5.1" ECU_ADDRESS 0x6000AF0D /end MEASUREMENT
/begin MEASUREMENT ubsqfilf_w "filtered battery voltage(faster)" UWORD spg_q0p00039 1 100 0.00 25.59961 FORMAT "%8.5" ECU_ADDRESS 0x60013482 /end MEASUREMENT
/begin MEASUREMENT ubsqfil_w "filtered battery voltage" UWORD spg_q0p00039 1 100 0.00 25.59961 FORMAT "%8.5" ECU_ADDRESS 0x60006ABA /end MEASUREMENT
/begin MEASUREMENT zknslo1_w "local variable to tap interface" UWORD zk10msxs_uw_b655p36 1 100 0.01000015 655.36000000 FORMAT "%12.8" ECU_ADDRESS 0x60006AB2 /end MEASUREMENT
/begin MEASUREMENT zknslo_w "Time constant for Engine speed set point tracing" UWORD zk10msxs_uw_b655p36 1 100 0.01000015 655.36000000 FORMAT "%12.8" ECU_ADDRESS 0x60006AB0 /end MEASUREMENT
/begin FUNCTION LLim_calcLim "106.0.0   Acceleration request from Speed Limiter"
 /begin DEF_CHARACTERISTIC LLim_aDifNeg_C LLim_aDifPos_C LLim_aMSL_CUR LLim_axMax_C LLim_tqFcoDesHi_C LLim_tqFcoDesLo_C LLim_vMaxFixdFailr_C LLim_vMaxFix_C LLim_vMaxSlopFailr_C LLim_vThres_C /end DEF_CHARACTERISTIC
 /begin IN_MEASUREMENT Com_stADSSpdLim CoVMD_trqLLim GlbDa_vXFlt LLim_stActive PT_trqWhlMinWoCtOff T15_st VehMot_aPrpCurr /end IN_MEASUREMENT
 /begin OUT_MEASUREMENT LLim_aReq LLim_axReq LLim_bFcoDes LLim_stMSLActv LLim_stReq /end OUT_MEASUREMENT
 /begin LOC_MEASUREMENT LLim_aMSL_mp LLim_dvMSL_mp LLim_flgRmpFailr LLim_vMaxMSLFailr LLim_vMaxMSL_mp /end LOC_MEASUREMENT
 FUNCTION_VERSION "106.0.0" /end FUNCTION
/begin FUNCTION LLim_CalcLimExt "13.0.0    Demand for limitation of maximum vehicle speed from extern"
 /begin DEF_CHARACTERISTIC LLim_ctASLAppATOpenLrn_C LLim_facAcclDeclCor_CUR LLim_facAPPDiffCor1LGCls_MAP LLim_facAPPDiffCor1LG_MAP LLim_facAPPDiffCor2LGCls_MAP LLim_facAPPDiffCor2LG_MAP LLim_facAPPDiffCor3LGCls_MAP LLim_facAPPDiffCor3LG_MAP LLim_facAPPDiffCor4LGCls_MAP LLim_facAPPDiffCor4LG_MAP LLim_facAPPDiffCor5LGCls_MAP LLim_facAPPDiffCor5LG_MAP LLim_facAPPDiffCorTGCls_MAP LLim_facAPPDiffCorTG_MAP LLim_facAPPReqItmFlt_C LLim_facCnvVehUn_C LLim_facConstDeclCor_CUR LLim_facFdbkAcclP1LG_CUR LLim_facFdbkAcclP2LG_CUR LLim_facFdbkAcclP3LG_CUR LLim_facFdbkAcclP4LG_CUR LLim_facFdbkAcclP5LG_CUR LLim_facFdbkAcclPTG_CUR LLim_facFdbkD1LG_MAP LLim_facFdbkD2LG_MAP LLim_facFdbkD3LG_MAP LLim_facFdbkD4LG_MAP LLim_facFdbkD5LG_MAP LLim_facFdbkDLmap_MAP LLim_facFdbkDTG_MAP LLim_facFdbkP1LG_MAP LLim_facFdbkP2LG_MAP LLim_facFdbkP3LG_MAP LLim_facFdbkP4LG_MAP LLim_facFdbkP5LG_MAP LLim_facFdbkPLmap_MAP LLim_facFdbkPTG_MAP LLim_facSpdUnConv_C LLim_facSptAPPDiffCor1LGCls_MAP LLim_facSptAPPDiffCor1LG_MAP LLim_facSptAPPDiffCor2LGCls_MAP LLim_facSptAPPDiffCor2LG_MAP LLim_facSptAPPDiffCor3LGCls_MAP LLim_facSptAPPDiffCor3LG_MAP LLim_facSptAPPDiffCor4LGCls_MAP LLim_facSptAPPDiffCor4LG_MAP LLim_facSptAPPDiffCor5LGCls_MAP LLim_facSptAPPDiffCor5LG_MAP LLim_facSptAPPdiffCorLmapCls_MAP LLim_facSptAPPdiffCorLmap_MAP LLim_facSptAPPDiffCorTGCls_MAP LLim_facSptAPPDiffCorTG_MAP LLim_facSptFdbkAcclP1LG_CUR LLim_facSptFdbkAcclP2LG_CUR LLim_facSptFdbkAcclP3LG_CUR LLim_facSptFdbkAcclP4LG_CUR LLim_facSptFdbkAcclP5LG_CUR LLim_facSptFdbkAcclPLmap_CUR LLim_facSptFdbkAcclPTG_CUR LLim_facSptFdbkD1LG_MAP LLim_facSptFdbkD2LG_MAP LLim_facSptFdbkD3LG_MAP LLim_facSptFdbkD4LG_MAP LLim_facSptFdbkD5LG_MAP LLim_facSptFdbkDTG_MAP LLim_facSptFdbkP1LG_MAP LLim_facSptFdbkP2LG_MAP LLim_facSptFdbkP3LG_MAP LLim_facSptFdbkP4LG_MAP LLim_facSptFdbkP5LG_MAP LLim_facSptFdbkPTG_MAP LLim_flgASLDispCncl_C LLim_flgMemSpdDisp_C LLim_flgMtrTypIndcnVehSpdASLCtrl_C LLim_nASLAppClsLrnStrtAdd_C LLim_numASLResSel_C LLim_numASLSpdInfoMOnNCtl_C LLim_numISALimSpdOffsetLoMph_C LLim_numISALimSpdOffsetLo_C LLim_numISALimSpdOffsetUpMph_C LLim_numISALimSpdOffsetUp_C LLim_numISAMetType_C LLim_numSpdInfoMOnNCtl_C LLim_r10msAddVar_C LLim_r10msSubVar_C LLim_rAPPAddVal_C LLim_rAPPFulChk_C LLim_rAPPLimTmpRlsAPP_C LLim_rAPPMaxDevl_CUR LLim_rAPPMax_CUR LLim_rAPPOff1LG_MAP LLim_rAPPOff2LG_MAP LLim_rAPPOff3LG_MAP LLim_rAPPOff4LG_MAP LLim_rAPPOff5LG_MAP LLim_rAPPOffLmap_MAP LLim_rAPPOffTG_MAP LLim_rAPPReqSet1LG_MAP LLim_rAPPReqSet2LG_MAP LLim_rAPPReqSet3LG_MAP LLim_rAPPReqSet4LG_MAP LLim_rAPPReqSet5LG_MAP LLim_rAPPReqSetLmap_MAP LLim_rAPPReqSetTG_MAP LLim_rAPPRetValAftLimRls_CUR LLim_rChngGearChkAPP_C LLim_rCnclAPPAdd_CUR LLim_rCnclIniAPPAdd_CUR LLim_rDesAddValFAStrt_CUR LLim_rDesAddValFreeArea_CUR LLim_rDesAPPDiffLim_C LLim_rDesSubVal_CUR LLim_rISACnclAPPAdd_CUR LLim_rISACnclIniAPPAdd_CUR LLim_rSptAPPMaxDevl_CUR LLim_rSptAPPOff1LG_MAP LLim_rSptAPPOff2LG_MAP LLim_rSptAPPOff3LG_MAP LLim_rSptAPPOff4LG_MAP LLim_rSptAPPOff5LG_MAP LLim_rSptAPPOffTG_MAP LLim_rSptAPPReqSet1LG_MAP LLim_rSptAPPReqSet2LG_MAP LLim_rSptAPPReqSet3LG_MAP LLim_rSptAPPReqSet4LG_MAP LLim_rSptAPPReqSet5LG_MAP LLim_rSptAPPReqSetTG_MAP LLim_stAPPLrnSel_C LLim_stASLResCdnChk_C LLim_stCCASLDataChkEna_C LLim_stGearMapNo_CA LLim_stIDASTrqLowSelA_C LLim_stIDASTrqLowSelB_C LLim_stISAContTSRClr_C LLim_stISATempStpAcclRecvr_C LLim_swtAcclLimDisbl_C LLim_swtAPPLimTmpRls_C LLim_swtAPPMinSel_C LLim_swtASLAppClsLrnSel_C LLim_swtASLAppOpenLrnSel_C LLim_swtASLAppSel_C LLim_swtASLRxErrChkSel_C LLim_swtCCSpdNoUpdReq_C LLim_swtCnclAcclLimEna_C LLim_swtDevlLimSel_C LLim_swtKickDwnClickCncl_C LLim_swtResu1Disbl_C LLim_swtSetSpdCorEna_C LLim_swtSpdNoUpdReq_C LLim_tiAPPLimTmpRls_C LLim_tiArChgAppSel_C LLim_tiASLAppClsLrnStrtWait_C LLim_tiASLAppClsLrnUpd0_C LLim_tiASLAppClsLrnUpd1_C LLim_tiASLAppOpenAlrm_C LLim_tiASLAppOpenLrnStrt_C LLim_tiASLRxErrChk_C LLim_tiASLSet_C LLim_tiCCASLDataErr_C LLim_tiCtlExtn_C LLim_tiISACtlExtn_C LLim_tiOvrSpdAlrmFin_C LLim_tiOvrSpdAlrmStrt2_C LLim_tiOvrSpdAlrmStrt_C LLim_tiSetSpdBlnOff2_C LLim_tiSetSpdBlnOff3_C LLim_tiSetSpdBlnOff4_C LLim_tiSetSpdBlnOn2_C LLim_tiSetSpdBlnOn3_C LLim_tiSetSpdBlnOn4_C LLim_uASLAppClsLrnChkDvt_C LLim_uASLAppClsLrnLoLim_C LLim_uASLAppClsLrnUpLim_C LLim_uASLAppClsNoLrn_C LLim_uASLAppOpenChk_C LLim_uASLAppOpenLrnLoLim_C LLim_uASLAppOpenLrnUpLim_C LLim_uASLAppSnsrErr_C LLim_uASLAppSnsrUpLim_C LLim_vAcclLim_CUR LLim_vAPPLimTmpRlsSpdDvt_C LLim_vCnclAcclLim_CUR LLim_vDLimHysHi1LG_CUR LLim_vDLimHysHi2LG_CUR LLim_vDLimHysHi3LG_CUR LLim_vDLimHysHi4LG_CUR LLim_vDLimHysHi5LG_CUR LLim_vDLimHysHiLmap_CUR LLim_vDLimHysHiTG_CUR LLim_vDLimHysLo1LG_CUR LLim_vDLimHysLo2LG_CUR LLim_vDLimHysLo3LG_CUR LLim_vDLimHysLo4LG_CUR LLim_vDLimHysLo5LG_CUR LLim_vDLimHysLoLmap_CUR LLim_vDLimHysLoTG_CUR LLim_vDvtSpdOvrAlrmHysHi_C LLim_vDvtSpdOvrAlrmHysLo_C LLim_vISACnclAcclLim_CUR LLim_vISAMemSpdLoLimKmh_C LLim_vISAMemSpdLoLimMPH_C LLim_vLimSpdIniUpdKmh_C LLim_vLimSpdIniUpdMPH_C LLim_vLimSpdUpdKmh_C LLim_vLimSpdUpdMPH_C LLim_vMemSpdCorKmh_C LLim_vMemSpdCorMPH_C LLim_vMemSpdKMHOffsHysHi_C LLim_vMemSpdKMHOffsHysLo_C LLim_vMemSpdLoLimKmh_C LLim_vMemSpdLoLimMPH_C LLim_vMemSpdMPHOffsHysHi_C LLim_vMemSpdMPHOffsHysLo_C LLim_vMemSpdUpLimKmh_C LLim_vMemSpdUpLimMPH_C LLim_vNoCtlPntHysHi1LG_CUR LLim_vNoCtlPntHysHi2LG_CUR LLim_vNoCtlPntHysHi3LG_CUR LLim_vNoCtlPntHysHi4LG_CUR LLim_vNoCtlPntHysHi5LG_CUR LLim_vNoCtlPntHysHiLmap_CUR LLim_vNoCtlPntHysHiTG_CUR LLim_vNoCtlPntHysLo1LG_CUR LLim_vNoCtlPntHysLo2LG_CUR LLim_vNoCtlPntHysLo3LG_CUR LLim_vNoCtlPntHysLo4LG_CUR LLim_vNoCtlPntHysLo5LG_CUR LLim_vNoCtlPntHysLoLmap_CUR LLim_vNoCtlPntHysLoTG_CUR LLim_vRPntHysHi1LG_CUR LLim_vRPntHysHi2LG_CUR LLim_vRPntHysHi3LG_CUR LLim_vRPntHysHi4LG_CUR LLim_vRPntHysHi5LG_CUR LLim_vRPntHysHiLmap_CUR LLim_vRPntHysHiTG_CUR LLim_vRPntHysLo1LG_CUR LLim_vRPntHysLo2LG_CUR LLim_vRPntHysLo3LG_CUR LLim_vRPntHysLo4LG_CUR LLim_vRPntHysLo5LG_CUR LLim_vRPntHysLoLmap_CUR LLim_vRPntHysLoTG_CUR LLim_vSptDLimHysHi1LG_CUR LLim_vSptDLimHysHi2LG_CUR LLim_vSptDLimHysHi3LG_CUR LLim_vSptDLimHysHi4LG_CUR LLim_vSptDLimHysHi5LG_CUR LLim_vSptDLimHysHiTG_CUR LLim_vSptDLimHysLo1LG_CUR LLim_vSptDLimHysLo2LG_CUR LLim_vSptDLimHysLo3LG_CUR LLim_vSptDLimHysLo4LG_CUR LLim_vSptDLimHysLo5LG_CUR LLim_vSptDLimHysLoTG_CUR LLim_vSptNoCtlPntHysHi1LG_CUR LLim_vSptNoCtlPntHysHi2LG_CUR LLim_vSptNoCtlPntHysHi3LG_CUR LLim_vSptNoCtlPntHysHi4LG_CUR LLim_vSptNoCtlPntHysHi5LG_CUR LLim_vSptNoCtlPntHysHiTG_CUR LLim_vSptNoCtlPntHysLo1LG_CUR LLim_vSptNoCtlPntHysLo2LG_CUR LLim_vSptNoCtlPntHysLo3LG_CUR LLim_vSptNoCtlPntHysLo4LG_CUR LLim_vSptNoCtlPntHysLo5LG_CUR LLim_vSptNoCtlPntHysLoTG_CUR LLim_vSptRPntHysHi1LG_CUR LLim_vSptRPntHysHi2LG_CUR LLim_vSptRPntHysHi3LG_CUR LLim_vSptRPntHysHi4LG_CUR LLim_vSptRPntHysHi5LG_CUR LLim_vSptRPntHysHiTG_CUR LLim_vSptRPntHysLo1LG_CUR LLim_vSptRPntHysLo2LG_CUR LLim_vSptRPntHysLo3LG_CUR LLim_vSptRPntHysLo4LG_CUR LLim_vSptRPntHysLo5LG_CUR LLim_vSptRPntHysLoTG_CUR LLim_vStrtSpdDvt_C LLim_vTmpRelsAlrmDif_C /end DEF_CHARACTERISTIC
 /begin REF_CHARACTERISTIC CrCtl_tiIdasbErr_C CrCUI_stFctInfo_C CrCUI_stISAtoASLbyResSet_C /end REF_CHARACTERISTIC
 /begin IN_MEASUREMENT AccPed_swtDrvMod APP_r APP_rMaxLrnUnFlt APP_uRaw1 CoEng_st Com_bDigMtrUnit Com_flgGwIMG3Norm Com_flgIDASBNorm Com_stATErr4 Com_stEAT3Mon Com_stIDASEngFail Com_stIDASInhb Com_stIDASTrqLowSel Com_stSpdSnsrFailr CoVMD_rCrCtlACCReq CoVMD_rLLimACCReq CoVMD_stSwtCCASLTqSeln CrCtl_numACCType CrCtl_numATType CrCtl_rDes CrCtl_rEstSlpFltVal CrCtl_stActive CrCtl_stASLSysOffReq CrCtl_stASLTaskCont CrCtl_stCond CrCtl_stErrMTVehSpd CrCtl_stLmpOn CrCtl_tiContInhib CrCtl_tiIGNOnVeh CrCtl_vACCMemSpdKmh CrCtl_vACCMemSpdMPH CrCtl_vASLAcclFltVal CrCtl_vASLVehCont CrCtl_vMemSpd CrCUI_ctResuOnSpdUpd CrCUI_ctSetOnSpdUpd CrCUI_numSelMode CrCUI_numTSRLimSpd CrCUI_stACCASLSwtErrDet CrCUI_stACCClthOn CrCUI_stACCNoUpdReq CrCUI_stASLMainDeb CrCUI_stASLSpdNoUpdReq CrCUI_stASLtoISASpdLim CrCUI_stCancelSwt CrCUI_stCANRxErr CrCUI_stCCASLVehUn CrCUI_stCrsASLSelFild CrCUI_stCrsSwtErrDet CrCUI_stCrsSwtFild CrCUI_stCvtLmap CrCUI_stFctInfo CrCUI_stGearDownNo CrCUI_stISAContTSRClr CrCUI_stISAModeMnSW CrCUI_stISAtoASLbyResSet CrCUI_stMainDeb CrCUI_stMETSpdDspEna CrCUI_stModeChgCncl CrCUI_stSwtClthDeb CrCUI_stSwtOnSpdUpd CrCUI_stSwtResNo CrCUI_stSwtSetNo CrCUI_stTSRErr CrCUI_stVehUn CrCUI_swtMETTyp CrCUI_vMETSpd CrCUI_vMETSpd2 Dspl_stASLRxErr Epm_nEng Gbx_uAPPMaxLrn I14229_stSuppRst PT_stTraType SpdGov_nSetPLo SyC_ctIrrSwOff SyC_stHistTiPostDrvMax T15_st VehV_vSens /end IN_MEASUREMENT
 /begin OUT_MEASUREMENT LLim_flgASLCtrlTmpHalt LLim_flgASLOverSpd LLim_flgMemDisp LLim_numMETAlrm LLim_numMETMemSpd LLim_rCCASLAppReq LLim_rDes LLim_stActive LLim_stActvLmp LLim_stActvLmpItm1 LLim_stActvLmpItm2 LLim_stAlrmSoundStrtEdge LLim_stAlrmStrtEdge LLim_stASLIdasbCanErr LLim_stASLRxErrDet LLim_stCCASLDataErr LLim_stISAContTSRClr LLim_stMetCCMode1 LLim_stMetCCMode2 LLim_stMETVehUn LLim_stModeNo LLim_stSpdNoUpdReq LLim_vMemDisp /end OUT_MEASUREMENT
 /begin LOC_MEASUREMENT LLim_ctASLAppATOpenLrn_mp LLim_facAcclP_mp LLim_facAcclShutOff_mp LLim_facAPPDiffCor_mp LLim_facConstD_mp LLim_facConstP_mp LLim_facConstShutOff_mp LLim_flgISAOccUnitChg LLim_numMETDspSelOld_mp LLim_numMETDspSel_mp LLim_numMETSpdBlnOld_mp LLim_numMETSpdBln_mp LLim_numTSRLimSpdClr_mp LLim_numTSRLimSpdOffset_mp LLim_numTSRLimSpdOld_mp LLim_rAcclReqVar_mp LLim_rAppASLCncl_mp LLim_rAPPCnclRetAcclLim_mp LLim_rAPPCnclRetFin_mp LLim_rAPPCnclRet_mp LLim_rAPPIniReq_mp LLim_rAPPLimTmpRlsAPPOld_mp LLim_rAPPLimTmpRlsAPP_mp LLim_rAPPMax_mp LLim_rAPPReqFin_mp LLim_rAPPReqItmFltOld_mp LLim_rAPPReqItmFlt_mp LLim_rAPPReqItm_mp LLim_rAPP_mp LLim_rConstReqVar_mp LLim_rDeclReqVar_mp LLim_rDesReq_mp LLim_rDiff100msItm_mp LLim_rDiff100ms_mp LLim_stAPPLimTmpRls_mp LLim_stAPPOffReq_mp LLim_stAPPOvr_mp LLim_stASLAppClsLrnHist_mp LLim_stASLAppOpenAlrm_mp LLim_stCnclAlrm_mp LLim_stCondNo_mp LLim_stIniOut_mp LLim_stIniReq_mp LLim_stISACnclAcclRecvr_mp LLim_stISAContTSRClrOld_mp LLim_stISATempStpOld_mp LLim_stISATempStp_mp LLim_stModeNoOld_mp LLim_stResWait_mp LLim_stSetSpdIdcBlnOff_mp LLim_stVehSpdAreaNoOld_mp LLim_stVehSpdAreaNo_mp LLim_stVehSpdOver_mp LLim_stVehUnSelOld_mp LLim_stVehUnSel_mp LLim_tiAPPLimTmpRls_mp LLim_tiArChgAppSel_mp LLim_tiASLAppClsLrnStrt_mp LLim_tiASLAppClsLrnUpd_mp LLim_tiASLAppOpenAlrm_mp LLim_tiASLAppOpenLrnStrt_mp LLim_tiASLCnclSound LLim_tiASLIdasbErr_mp LLim_tiASLRxErr_mp LLim_tiASLSet_mp LLim_tiCCASLDataErr_mp LLim_tiCnclAlrm_mp LLim_tiCtlExtn_mp LLim_tiISATempStpBlnk_mp LLim_tiOvrSpdAlrmFin_mp LLim_tiOvrSpdAlrmStrt_mp LLim_tiSetSpdBlnOff_mp LLim_tiSetSpdBlnOn_mp LLim_uASLAppATSnsrOpenLrnOld_mp LLim_uASLAppClsLrnStrt_mp LLim_uASLAppClsLrn_mp LLim_uASLAppOpenLrnStrt_mp LLim_uASLAppOpenLrn_mp LLim_uASLAppSnsr_mp LLim_vAcclDvt_mp LLim_vAPPLimTmpRlsSpd_mp LLim_vDesAccl_mp LLim_vDes_mp LLim_vDLimHysHi_mp LLim_vDLimHysLo_mp LLim_vDLim_mp LLim_vISALimSpdOffsetLo_mp LLim_vISALimSpdOffsetUp_mp LLim_vMemSpdAftCncl_mp LLim_vMemSpdFinAftCor_mp LLim_vMemSpdFin_mp LLim_vMemSpdLoLim_mp LLim_vMemSpdMPH_mp LLim_vMemSpdOld_mp LLim_vMemSpdResOnKmh_mp LLim_vMemSpdResOnMPH_mp LLim_vMemSpdResTrnOnKmh_mp LLim_vMemSpdResTrnOnMPH_mp LLim_vMemSpdSetOnKmh_mp LLim_vMemSpdSetOnMPH_mp LLim_vMemSpdSetTrnOnKmh_mp LLim_vMemSpdSetTrnOnMPH_mp LLim_vMemSpdSwtOnKmh_mp LLim_vMemSpdSwtOnMPH_mp LLim_vMemSpdUpLim_mp LLim_vMemSpdVerfDat_mp LLim_vMemSpd_mp LLim_vMETMemSpdItmKmh_mp LLim_vMETMemSpdItmMPH_mp LLim_vNoCtlPntHysHi_mp LLim_vNoCtlPntHysLo_mp LLim_vNoCtlPnt_mp LLim_vRPntHysHi_mp LLim_vRPntHysLo_mp LLim_vRPnt_mp LLim_vSpdDvt_mp LLim_vTSRLimSpdTmp_mp /end LOC_MEASUREMENT
 FUNCTION_VERSION "13.0.0" /end FUNCTION
/begin FUNCTION LLim_Lib "1.4.0_2.1.0Adjustable Speed Limiter Library functions" /begin IN_MEASUREMENT AccPed_swtDrvMod CrCUI_stCvtLmap CrCUI_stSptDrvMod /end IN_MEASUREMENT FUNCTION_VERSION "1.4.0_2.1.0" /end FUNCTION
/begin FUNCTION LLRMR "28.1.0    Torque reserve for idle speed control"
 /begin DEF_CHARACTERISTIC CWKUPPL CWLLRMR CWLLRMR2 DMRESHH DMRESLLDOWN DMRESLLUP DMRESUB DNLLRESW DUBATG DUBSUBQ KFAUSGKRT KFAUSGLR KFETAZWOFF KFFKTMRFS KFMRENHER KFMRES KFMRESAC KFMRESACT KFMRESETH KFMRESFS KFMRESFSETH KFMRESFSSAIL KFMRESFSSP KFMRESFSSPP KFMRESI KFMRESK KFMRESKH KFMRESLT KFMRESNL KFMRESSAIL KFMRESSP KFMRESSPP KFMRESTA KFMRTAETH KLAUSGKLR KLDMRESTM KLDNLLDE KLGNGW KLGNSTAT KLIPMRETH KLMRESLLSTA KLMRESPHIR KLMRESTM KLMRESUB KLMRHO KLMRHOFS KLTVRESTM KLVANF LIVFZDE LIVFZMNDE LLRMR_facTqResvHeatrReq_M LLRMR_facTqResvIdleBrkNotActv_M LLRMR_facTqResvIdle_M LLRMR_nIdleTqResvThd_C LLRMR_nMinNThdRst_C LLRMR_percEngGrdtDwnRmp_C LLRMR_percTqResvEngGrdt_MAP LLRMR_percTqResvHeatrReq_M LLRMR_percTqResvMin_C LLRMR_percTqResvThdDrv_C LLRMR_slopeNegTqResv_C LLRMR_slopePosTqResv_C LLRMR_stCluOpnCmpl_C LLRMR_stCluOpnNotCmpl_C LLRMR_swtFltSeln_C LLRMR_tCatMaxActvt_C LLRMR_tCatMaxDeactvt_C LLRMR_tiDlyRmpEngGrdt_C LLRMR_tMinTqResvActv_C MRENSTA MRESHH MRESUB SDLLRMR SMI04LLUBL SNM06LLUWL SNS06LLSBL STA04LLUBL STM04SAUBL TDDMRLLR TDMRESHH TDMRESLW TDMRESUB TDSIGNHH TDUBSQ TDUBSTND TOFFAUSGKR TVAUSGKR TVAUSGLR TVGRMR TVRESLL VANF ZKDMRUB ZKDMRUBF /end DEF_CHARACTERISTIC
 /begin IN_MEASUREMENT AirC_bBackliteHeatgReq BattU_u Brk_st B_ausgkrit_msg B_fs_msg B_khakw_msg B_kh_msg B_koe_msg B_ll_msg B_lr_msg B_sa_msg B_stoanf_msg CEngDsT_t Clth_st Com_flgLETAcTqResvReplcmt Com_stAC DOGov_trqResv DrvPrgSwt_bSprt DrvPrgSwt_bSprtPlus EngStrt_bStrt EnvT_t Epm_dnEngAvg Epm_dnEngAvgFlt Epm_dnEngFlt Epm_nEng Epm_nEngLRes etazwmn_w_msg ExhMod_tCat1MaxB1 fethmnmx_msg fmi2trq_w_msg frm_w_msg gangi_msg Gbx_bSailActv HLSDem_nSetPLo mibmn_w_msg mibmx_w_msg mifa_w_msg OilSwmpT_t PEnv_facCorrAlti PT_rTrq PT_stTraType rl_w_msg SpdGov_nSetPLo tans_msg tnst_w_msg Tra_numGear tumg_msg VehPos_rIncIX VehV_v WaHt_flgHeatrRiseReq WaHt_tDeltaEngT /end IN_MEASUREMENT
 /begin OUT_MEASUREMENT B_llde_msg B_zwafh_msg dmresll_w_msg dmrllr_w_msg LLRMR_bTrqResActv LLRMR_bTrqResInActv LLRMR_percTqResvEngGrdt SpdGov_trqResvRel /end OUT_MEASUREMENT
 /begin LOC_MEASUREMENT B_kuplaus ddmrllr_w dmralt dmrdiaiv_w dmrenher_w dmresb_w dmresubg dmresub_mp llrmrfrm_w LLRMR_dmreshh llrmr_dmresll LLRMR_dns_temp LLRMR_etazwmn LLRMR_fethmumx_tmp LLRMR_fho_tmp LLRMR_flgClthStDefn LLRMR_flgTrsmClthSt LLRMR_gangi_tmp LLRMR_mibmn LLRMR_mifa_w_tmp LLRMR_nmotw_tmp LLRMR_nmot_tmp LLRMR_percTqResvBas LLRMR_percTqResvDrvMod LLRMR_percTqResvEngGrdtOld LLRMR_percTqResvHeatrReq LLRMR_percTqResvLtd LLRMR_percTqResvOffsLtd LLRMR_percTqResvSpv LLRMR_percTqResvWght LLRMR_tans_temp LLRMR_tmot_tmp LLRMR_tnst_tmp LLRMR_tosp_tmp LLRMR_vfzg_tmp ubsqfilf_w ubsqfil_w /end LOC_MEASUREMENT
 FUNCTION_VERSION "28.1.0" /end FUNCTION
/begin FUNCTION LLRNSNF "28.1.0    Idle speed guidance"
 /begin DEF_CHARACTERISTIC CWLLRNSNF DNNSNF DNSNFFAST DNSNFNORM DNSNFX_W FNSNF FNSSTKM FNSSTM FZNSMGA FZNSMTM KLDNSNFST KLZNSM KLZNSMTRA KNSNF_W LLRNSNF_flgSwtNGrdt_C LLRNSNF_nSpLoDiff_X_Ax NGNSNF NSOLMX_W STM06LLUBL STS08ESUBL TDDEANF TDDIRSTLL TMOTDIRST /end DEF_CHARACTERISTIC
 /begin IN_MEASUREMENT B_enllri_msg B_fststamap_msg B_khn_msg B_llrein_msg B_llrst_msg B_ll_msg B_nswo1_msg B_staanf_msg CEngDsT_t CEngDsT_tStrt CoPT_nMinTra Epm_dnEngAvg Epm_dnEngAvgFlt Epm_nEng gangsist_msg HLSDem_bDrvOffSuprtActv HLSDem_nDrvOffSuprtSp HLSDem_nDrvOffSuprtSpRaw HLSDem_nSetPLo /end IN_MEASUREMENT
 /begin OUT_MEASUREMENT B_freezenf_msg HLSDem_nSetPLoDiff HLSDem_nSetPTrck LLRNSNF_nOffsSpLoTrckEna nsst_msg /end OUT_MEASUREMENT
 /begin LOC_MEASUREMENT gangsist_llrnsnf_loc LLRNSNF_bReqdTrckSpRst LLRNSNF_dnEngFlt llrnsnf_sns06llsbLoc llrnsnf_stm06llublLoc nsnf_w nstteold_w tmp_fakll tmst_llrnsnf_loc zknslo1_w zknslo_w /end LOC_MEASUREMENT
 FUNCTION_VERSION "28.1.0" /end FUNCTION
/begin COMPU_METHOD Acc "" RAT_FUNC "%6.5" "m/s^2" COEFFS 0 1000 0 0 0 1 /end COMPU_METHOD
/begin COMPU_METHOD APPCrCtl1 "" RAT_FUNC "%6.4" "%" COEFFS 0 200 0 0 0 1 /end COMPU_METHOD
/begin COMPU_METHOD B_TRUE "" TAB_VERB "%6.3" "" COMPU_TAB_REF B_TRUE /end COMPU_METHOD
/begin COMPU_VTAB B_TRUE "" TAB_VERB 2 0 "FALSE" 1 "TRUE" /end COMPU_VTAB
/begin COMPU_METHOD dez "" RAT_FUNC "%6.2" "" COEFFS 0 1 0 0 0 1 /end COMPU_METHOD
/begin COMPU_METHOD EngN "" RAT_FUNC "%6.3" "rpm" COEFFS 0 2 0 0 0 1 /end COMPU_METHOD
/begin COMPU_METHOD EngNCrCtl "" RAT_FUNC "%6.2" "rpm" COEFFS 0 1 0 0 0 1 /end COMPU_METHOD
/begin COMPU_METHOD EngNGrd "" RAT_FUNC "%6.3" "rpm/s" COEFFS 0 2 0 0 0 1 /end COMPU_METHOD
/begin COMPU_METHOD Fact1 "" RAT_FUNC "%6.4" "-" COEFFS 0 128 0 0 0 1 /end COMPU_METHOD
/begin COMPU_METHOD Fact_10000 "" RAT_FUNC "%7.6" "-" COEFFS 0 10000 0 0 0 1 /end COMPU_METHOD
/begin COMPU_METHOD Fact_CrCtl "" RAT_FUNC "%6.4" "-" COEFFS 0 256 0 0 0 1 /end COMPU_METHOD
/begin COMPU_METHOD Fact_CrCtl2 "" RAT_FUNC "%6.4" "-" COEFFS 0 64 0 0 0 1 /end COMPU_METHOD
/begin COMPU_METHOD Fact_CrCtl3 "" RAT_FUNC "%6.5" "-" COEFFS 0 1024 0 0 0 1 /end COMPU_METHOD
/begin COMPU_METHOD fak_q0p005 "" RAT_FUNC "%6.4" "" COEFFS 0 200 0 0 0 1 /end COMPU_METHOD
/begin COMPU_METHOD fak_ub_b1 "" RAT_FUNC "%6.4" "-" COEFFS 0 256 0 0 0 1 /end COMPU_METHOD
/begin COMPU_METHOD fak_ub_b2 "" RAT_FUNC "%8.5" "-" COEFFS 0 256 0 0 0 2 /end COMPU_METHOD
/begin COMPU_METHOD fak_ub_b4 "" RAT_FUNC "%6.4" "-" COEFFS 0 256 0 0 0 4 /end COMPU_METHOD
/begin COMPU_METHOD fak_uw_b2 "" RAT_FUNC "%7.6" "-" COEFFS 0 65536 0 0 0 2 /end COMPU_METHOD
/begin COMPU_METHOD fak_uw_q0p1 "" RAT_FUNC "%6.3" "" COEFFS 0 1 0 0 0 0.1 /end COMPU_METHOD
/begin COMPU_METHOD md_sw_q0p1 "" RAT_FUNC "%6.3" "Nm" COEFFS 0 10 0 0 0 1 /end COMPU_METHOD
/begin COMPU_METHOD nmotd_sb_q10 "" RAT_FUNC "%6.1" "1/min" COEFFS 0 1 0 0 0 10 /end COMPU_METHOD
/begin COMPU_METHOD nmotg_sb_q100 "" RAT_FUNC "%6.0" "1/min/s" COEFFS 0 1 0 0 0 100 /end COMPU_METHOD
/begin COMPU_METHOD nmotg_ub_q100 "" RAT_FUNC "%6.0" "1/min/s" COEFFS 0 1 0 0 0 100 /end COMPU_METHOD
/begin COMPU_METHOD nmot_sw_q0p25 "" RAT_FUNC "%6.3" "1/min" COEFFS 0 1 0 0 0 0.25 /end COMPU_METHOD
/begin COMPU_METHOD nmot_sw_q0p5 "" RAT_FUNC "%6.3" "1/min" COEFFS 0 2 0 0 0 1 /end COMPU_METHOD
/begin COMPU_METHOD nmot_ub_q10 "" RAT_FUNC "%6.1" "1/min" COEFFS 0 1 0 0 0 10 /end COMPU_METHOD
/begin COMPU_METHOD nmot_ub_q40 "" RAT_FUNC "%6.1" "1/min" COEFFS 0 1 0 0 0 40 /end COMPU_METHOD
/begin COMPU_METHOD nmot_uw_q0p25 "" RAT_FUNC "%6.3" "1/min" COEFFS 0 1 0 0 0 0.25 /end COMPU_METHOD
/begin COMPU_METHOD OneToOne "" RAT_FUNC "%6.2" "-" COEFFS 0 1 0 0 0 1 /end COMPU_METHOD
/begin COMPU_METHOD Prc "" RAT_FUNC "%6.4" "%" COEFFS 0 81.92 0 0 0 1 /end COMPU_METHOD
/begin COMPU_METHOD PrcHigh "" RAT_FUNC "%6.5" "%" COEFFS 0 1000 0 0 0 1 /end COMPU_METHOD
/begin COMPU_METHOD Prc_CrCtl4 "" RAT_FUNC "%6.4" "%" COEFFS 0 256 0 0 0 1 /end COMPU_METHOD
/begin COMPU_METHOD q2p32831_Perc_DIV_s "" RAT_FUNC "%7.6" "%/s" COEFFS 0 4294967296 0 0 0 100000 /end COMPU_METHOD
/begin COMPU_METHOD q6553p6_RmpVel_low "" RAT_FUNC "%6.5" "(km/h)/s" COEFFS 0 65536 0 0 0 10 /end COMPU_METHOD
/begin COMPU_METHOD rel_q0p00153 "" RAT_FUNC "%6.4" "%" COEFFS 0 65536 0 0 0 100 /end COMPU_METHOD
/begin COMPU_METHOD rel_q0p0234 "" RAT_FUNC "%6.4" "%" COEFFS 0 128 0 0 0 3 /end COMPU_METHOD
/begin COMPU_METHOD rel_ub_b25 "" RAT_FUNC "%6.3" "%" COEFFS 0 256 0 0 0 25 /end COMPU_METHOD
/begin COMPU_METHOD rel_uw_b100 "" RAT_FUNC "%6.4" "%" COEFFS 0 65536 0 0 0 100 /end COMPU_METHOD
/begin COMPU_METHOD rfak_q0p5 "" RAT_FUNC "%6.2" "-" COEFFS 0 0 128 0 1 0 /end COMPU_METHOD
/begin COMPU_METHOD spg_q0p00039 "" RAT_FUNC "%6.5" "V" COEFFS 0 1 0 0 0 0.000390625 /end COMPU_METHOD
/begin COMPU_METHOD SY_ATLB_Compu "" TAB_VERB "%6.3" "" COMPU_TAB_REF SY_ATLB_Compu /end COMPU_METHOD
/begin COMPU_VTAB SY_ATLB_Compu "" TAB_VERB 2 0 "keine Turbo-Bypassklappe" 1 "Turbo-Bypassklappe" /end COMPU_VTAB
/begin COMPU_METHOD SY_ATMTURB_Compu "" TAB_VERB "%6.3" "" COMPU_TAB_REF SY_ATMTURB_Compu /end COMPU_METHOD
/begin COMPU_VTAB SY_ATMTURB_Compu "" TAB_VERB 2 0 "ATMTURB_NOPRES" 1 "ATMTURB_PRES" /end COMPU_VTAB
/begin COMPU_METHOD SY_ATMZA_Compu "" TAB_VERB "%6.3" "" COMPU_TAB_REF SY_ATMZA_Compu /end COMPU_METHOD
/begin COMPU_VTAB SY_ATMZA_Compu "" TAB_VERB 2 0 "%ATMZA nicht vorhanden" 1 "%ATMZA vorhanden" /end COMPU_VTAB
/begin COMPU_METHOD SY_ATR_Compu "" TAB_VERB "%6.3" "" COMPU_TAB_REF SY_ATR_Compu /end COMPU_METHOD
/begin COMPU_VTAB SY_ATR_Compu "" TAB_VERB 2 0 "keine Abgastemperatursensoren vorhanden" 1 "Abgastemperatursensoren vorhanden" /end COMPU_VTAB
/begin COMPU_METHOD SY_ATURB_Compu "" TAB_VERB "%6.3" "" COMPU_TAB_REF SY_ATURB_Compu /end COMPU_METHOD
/begin COMPU_VTAB SY_ATURB_Compu "" TAB_VERB 4 0 "no_turbine" 1 "wastegate" 2 "vtg" 3 "varturb" /end COMPU_VTAB
/begin COMPU_METHOD SY_AUFLAD2_Compu "" TAB_VERB "%6.3" "" COMPU_TAB_REF SY_AUFLAD2_Compu /end COMPU_METHOD
/begin COMPU_VTAB SY_AUFLAD2_Compu "" TAB_VERB 2 0 "no_2_bank_charging" 1 "2_bank_charging" /end COMPU_VTAB
/begin COMPU_METHOD SY_AUFLAD_Compu "" TAB_VERB "%6.3" "" COMPU_TAB_REF SY_AUFLAD_Compu /end COMPU_METHOD
/begin COMPU_VTAB SY_AUFLAD_Compu "" TAB_VERB 2 0 "no_supercharging" 1 "supercharging" /end COMPU_VTAB
/begin COMPU_METHOD SY_BATTSG_Compu "" TAB_VERB "%6.3" "" COMPU_TAB_REF SY_BATTSG_Compu /end COMPU_METHOD
/begin COMPU_VTAB SY_BATTSG_Compu "" TAB_VERB 2 0 "kein 2 Batterie Boardkonzept" 1 "2 Batterie Boardkonzept" /end COMPU_VTAB
/begin COMPU_METHOD SY_BBBO_Compu "" TAB_VERB "%6.3" "" COMPU_TAB_REF SY_BBBO_Compu /end COMPU_METHOD
/begin COMPU_VTAB SY_BBBO_Compu "" TAB_VERB 2 0 "False" 1 "True" /end COMPU_VTAB
/begin COMPU_METHOD SY_BBKOPT_Compu "" TAB_VERB "%6.3" "" COMPU_TAB_REF SY_BBKOPT_Compu /end COMPU_METHOD
/begin COMPU_VTAB SY_BBKOPT_Compu "" TAB_VERB 2 0 "False" 1 "True" /end COMPU_VTAB
/begin COMPU_METHOD SY_BBSAWE_Compu "" TAB_VERB "%6.3" "" COMPU_TAB_REF SY_BBSAWE_Compu /end COMPU_METHOD
/begin COMPU_VTAB SY_BBSAWE_Compu "" TAB_VERB 2 0 "False" 1 "True" /end COMPU_VTAB
/begin COMPU_METHOD SY_BDE_Compu "" TAB_VERB "%6.3" "" COMPU_TAB_REF SY_BDE_Compu /end COMPU_METHOD
/begin COMPU_VTAB SY_BDE_Compu "" TAB_VERB 2 0 "Saugrohreinspritzer" 1 "Benzindirekteinspritzer" /end COMPU_VTAB
/begin COMPU_METHOD SY_BGD3PK_Compu "" TAB_VERB "%6.3" "" COMPU_TAB_REF SY_BGD3PK_Compu /end COMPU_METHOD
/begin COMPU_VTAB SY_BGD3PK_Compu "" TAB_VERB 2 0 "False" 1 "True" /end COMPU_VTAB
/begin COMPU_METHOD t10msxs_uw_b655p35 "" RAT_FUNC "%6.4" "s" COEFFS 0 1 0 0 0 0.01 /end COMPU_METHOD
/begin COMPU_METHOD t20msxs_ub_b5p1 "" RAT_FUNC "%6.4" "s" COEFFS 0 1 0 0 0 0.02 /end COMPU_METHOD
/begin COMPU_METHOD t20msxs_uw_q0p02 "" RAT_FUNC "%6.4" "s" COEFFS 0 1 0 0 0 0.02 /end COMPU_METHOD
/begin COMPU_METHOD Temp_Cels "" RAT_FUNC "%6.1" "deg C" COEFFS 0 10 2731.4 0 0 1 /end COMPU_METHOD
/begin COMPU_METHOD temp_ub_q0p75_o48 "" RAT_FUNC "%6.2" "Grad C" COEFFS 0 1 48 0 0 0.75 /end COMPU_METHOD
/begin COMPU_METHOD Time_ms "" RAT_FUNC "%6.1" "ms" COEFFS 0 0.1 0 0 0 1 /end COMPU_METHOD
/begin COMPU_METHOD Time_ms_100ms "" RAT_FUNC "%6.0" "ms" COEFFS 0 0.01 0 0 0 1 /end COMPU_METHOD
/begin COMPU_METHOD TransR "" RAT_FUNC "%6.4" "-" COEFFS 0 100 0 0 0 1 /end COMPU_METHOD
/begin COMPU_METHOD TrqPrpHigh "" RAT_FUNC "%6.3" "Nm" COEFFS 0 10 0 0 0 1 /end COMPU_METHOD
/begin COMPU_METHOD t_q0p01 "" RAT_FUNC "%6.4" "s" COEFFS 0 100 0 0 0 1 /end COMPU_METHOD
/begin COMPU_METHOD t_q0p02 "" RAT_FUNC "%6.4" "s" COEFFS 0 100 0 0 0 2 /end COMPU_METHOD
/begin COMPU_METHOD Vel "" RAT_FUNC "%6.4" "km/h" COEFFS 0 100 0 0 0 1 /end COMPU_METHOD
/begin COMPU_METHOD Vel_CrCtl1 "" RAT_FUNC "%6.2" "km/h" COEFFS 0 1 0 0 0 1 /end COMPU_METHOD
/begin COMPU_METHOD Vel_CrCtl1_MPH "" RAT_FUNC "%6.2" "MPH" COEFFS 0 1 0 0 0 1 /end COMPU_METHOD
/begin COMPU_METHOD Vel_CrCtl_MPH "" RAT_FUNC "%6.4" "MPH" COEFFS 0 256 0 0 0 1 /end COMPU_METHOD
/begin COMPU_METHOD vfzg_ub_q1p25 "" RAT_FUNC "%6.2" "km/h" COEFFS 0 1 0 0 0 1.25 /end COMPU_METHOD
/begin COMPU_METHOD Volt "" RAT_FUNC "%6.3" "mV" COEFFS 0 5 0 0 0 1 /end COMPU_METHOD
/begin COMPU_METHOD Volt_Batt "" RAT_FUNC "%6.1" "mV" COEFFS 0 0.05 0 0 0 1 /end COMPU_METHOD
/begin COMPU_METHOD zk10msxs_uw_b655p36 "" RAT_FUNC "%6.2" "s" COEFFS 0 0 65536 0 100 0 /end COMPU_METHOD
/begin RECORD_LAYOUT Cur_Xs16Ws16 NO_AXIS_PTS_X 1 SWORD AXIS_PTS_X 2 SWORD INDEX_INCR DIRECT FNC_VALUES 3 SWORD COLUMN_DIR DIRECT /end RECORD_LAYOUT
/begin RECORD_LAYOUT RB_Axis_S16 NO_AXIS_PTS_X 1 SWORD AXIS_PTS_X 2 SWORD INDEX_INCR DIRECT /end RECORD_LAYOUT
/begin RECORD_LAYOUT RB_Axis_S8 NO_AXIS_PTS_X 1 SBYTE AXIS_PTS_X 2 SBYTE INDEX_INCR DIRECT /end RECORD_LAYOUT
/begin RECORD_LAYOUT RB_Axis_U16 NO_AXIS_PTS_X 1 UWORD AXIS_PTS_X 2 UWORD INDEX_INCR DIRECT /end RECORD_LAYOUT
/begin RECORD_LAYOUT RB_Axis_U8 NO_AXIS_PTS_X 1 UBYTE AXIS_PTS_X 2 UBYTE INDEX_INCR DIRECT /end RECORD_LAYOUT
/begin RECORD_LAYOUT RB_CurveGroup_S16 FNC_VALUES 1 SWORD COLUMN_DIR DIRECT /end RECORD_LAYOUT
/begin RECORD_LAYOUT RB_CurveGroup_U16 FNC_VALUES 1 UWORD COLUMN_DIR DIRECT /end RECORD_LAYOUT
/begin RECORD_LAYOUT RB_CurveGroup_U8 FNC_VALUES 1 UBYTE COLUMN_DIR DIRECT /end RECORD_LAYOUT
/begin RECORD_LAYOUT RB_Curve_S16_S16 NO_AXIS_PTS_X 1 SWORD AXIS_PTS_X 2 SWORD INDEX_INCR DIRECT FNC_VALUES 3 SWORD COLUMN_DIR DIRECT /end RECORD_LAYOUT
/begin RECORD_LAYOUT RB_Curve_S16_S8_Static NO_AXIS_PTS_X 1 SWORD AXIS_PTS_X 2 SWORD INDEX_INCR DIRECT FNC_VALUES 3 SBYTE COLUMN_DIR DIRECT STATIC_RECORD_LAYOUT /end RECORD_LAYOUT
/begin RECORD_LAYOUT RB_Curve_S16_U8_Static NO_AXIS_PTS_X 1 SWORD AXIS_PTS_X 2 SWORD INDEX_INCR DIRECT FNC_VALUES 3 UBYTE COLUMN_DIR DIRECT STATIC_RECORD_LAYOUT /end RECORD_LAYOUT
/begin RECORD_LAYOUT RB_Curve_U16_U16 NO_AXIS_PTS_X 1 UWORD AXIS_PTS_X 2 UWORD INDEX_INCR DIRECT FNC_VALUES 3 UWORD COLUMN_DIR DIRECT /end RECORD_LAYOUT
/begin RECORD_LAYOUT RB_Curve_U16_U8_Static NO_AXIS_PTS_X 1 UWORD AXIS_PTS_X 2 UWORD INDEX_INCR DIRECT FNC_VALUES 3 UBYTE COLUMN_DIR DIRECT STATIC_RECORD_LAYOUT /end RECORD_LAYOUT
/begin RECORD_LAYOUT RB_Curve_U8_U16_Static NO_AXIS_PTS_X 1 UBYTE AXIS_PTS_X 2 UBYTE INDEX_INCR DIRECT FNC_VALUES 3 UWORD COLUMN_DIR DIRECT STATIC_RECORD_LAYOUT /end RECORD_LAYOUT
/begin RECORD_LAYOUT RB_Curve_U8_U8 NO_AXIS_PTS_X 1 UBYTE AXIS_PTS_X 2 UBYTE INDEX_INCR DIRECT FNC_VALUES 3 UBYTE COLUMN_DIR DIRECT /end RECORD_LAYOUT
/begin RECORD_LAYOUT RB_MapGroup_U16 FNC_VALUES 1 UWORD COLUMN_DIR DIRECT /end RECORD_LAYOUT
/begin RECORD_LAYOUT RB_MapGroup_U8 FNC_VALUES 1 UBYTE COLUMN_DIR DIRECT /end RECORD_LAYOUT
/begin RECORD_LAYOUT RB_Map_S16S16_S16 NO_AXIS_PTS_X 1 SWORD NO_AXIS_PTS_Y 2 SWORD AXIS_PTS_X 3 SWORD INDEX_INCR DIRECT AXIS_PTS_Y 4 SWORD INDEX_INCR DIRECT FNC_VALUES 5 SWORD COLUMN_DIR DIRECT /end RECORD_LAYOUT
/begin RECORD_LAYOUT RB_Map_S16S16_U16 NO_AXIS_PTS_X 1 SWORD NO_AXIS_PTS_Y 2 SWORD AXIS_PTS_X 3 SWORD INDEX_INCR DIRECT AXIS_PTS_Y 4 SWORD INDEX_INCR DIRECT FNC_VALUES 5 UWORD COLUMN_DIR DIRECT /end RECORD_LAYOUT
/begin RECORD_LAYOUT RB_Map_S16U16_U16 NO_AXIS_PTS_X 1 SWORD NO_AXIS_PTS_Y 2 SWORD AXIS_PTS_X 3 SWORD INDEX_INCR DIRECT AXIS_PTS_Y 4 UWORD INDEX_INCR DIRECT FNC_VALUES 5 UWORD ROW_DIR DIRECT /end RECORD_LAYOUT
/begin RECORD_LAYOUT RB_Map_S16U8_U16 NO_AXIS_PTS_X 1 SWORD NO_AXIS_PTS_Y 2 SWORD AXIS_PTS_X 3 SWORD INDEX_INCR DIRECT AXIS_PTS_Y 4 UBYTE INDEX_INCR DIRECT FNC_VALUES 5 UWORD COLUMN_DIR DIRECT /end RECORD_LAYOUT
/begin RECORD_LAYOUT RB_Map_U8S16_U8 NO_AXIS_PTS_X 1 UBYTE NO_AXIS_PTS_Y 2 UBYTE AXIS_PTS_X 3 UBYTE INDEX_INCR DIRECT AXIS_PTS_Y 4 SWORD INDEX_INCR DIRECT FNC_VALUES 5 UBYTE ROW_DIR DIRECT /end RECORD_LAYOUT
/begin RECORD_LAYOUT RB_Map_U8S8_U8 NO_AXIS_PTS_X 1 UBYTE NO_AXIS_PTS_Y 2 UBYTE AXIS_PTS_X 3 UBYTE INDEX_INCR DIRECT AXIS_PTS_Y 4 SBYTE INDEX_INCR DIRECT FNC_VALUES 5 UBYTE COLUMN_DIR DIRECT /end RECORD_LAYOUT
/begin RECORD_LAYOUT RB_Map_U8U16_U8 NO_AXIS_PTS_X 1 UBYTE NO_AXIS_PTS_Y 2 UBYTE AXIS_PTS_X 3 UBYTE INDEX_INCR DIRECT AXIS_PTS_Y 4 UWORD INDEX_INCR DIRECT FNC_VALUES 5 UBYTE ROW_DIR DIRECT /end RECORD_LAYOUT
/begin RECORD_LAYOUT RB_Map_U8U8_U8 NO_AXIS_PTS_X 1 UBYTE NO_AXIS_PTS_Y 2 UBYTE AXIS_PTS_X 3 UBYTE INDEX_INCR DIRECT AXIS_PTS_Y 4 UBYTE INDEX_INCR DIRECT FNC_VALUES 5 UBYTE COLUMN_DIR DIRECT /end RECORD_LAYOUT
/begin RECORD_LAYOUT RB_Val_Wboolean FNC_VALUES 1 UBYTE COLUMN_DIR DIRECT /end RECORD_LAYOUT
/begin RECORD_LAYOUT RB_Val_Ws16 FNC_VALUES 1 SWORD COLUMN_DIR DIRECT /end RECORD_LAYOUT
/begin RECORD_LAYOUT RB_Val_Ws32 FNC_VALUES 1 SLONG COLUMN_DIR DIRECT /end RECORD_LAYOUT
/begin RECORD_LAYOUT RB_Val_Wu16 FNC_VALUES 1 UWORD COLUMN_DIR DIRECT /end RECORD_LAYOUT
/begin RECORD_LAYOUT RB_Val_Wu8 FNC_VALUES 1 UBYTE COLUMN_DIR DIRECT /end RECORD_LAYOUT
/begin RECORD_LAYOUT ValA_Wu8 FNC_VALUES 1 UBYTE COLUMN_DIR DIRECT /end RECORD_LAYOUT
/begin RECORD_LAYOUT Val_Ws16 FNC_VALUES 1 SWORD COLUMN_DIR DIRECT /end RECORD_LAYOUT
/begin RECORD_LAYOUT Val_Ws32 FNC_VALUES 1 SLONG COLUMN_DIR DIRECT /end RECORD_LAYOUT
/begin RECORD_LAYOUT Val_Wu16 FNC_VALUES 1 UWORD COLUMN_DIR DIRECT /end RECORD_LAYOUT
/begin RECORD_LAYOUT Val_Wu8 FNC_VALUES 1 UBYTE COLUMN_DIR DIRECT /end RECORD_LAYOUT
/end MODULE
/end PROJECT
