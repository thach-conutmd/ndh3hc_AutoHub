ASAP2_VERSION 1 60
/begin PROJECT MG1CS022 "MG1CS022"
/begin HEADER "" VERSION "MG1CS022_62XSC_V037_TPROT" PROJECT_NO MG1CS022 /end HEADER
/begin MODULE DIM ""
/begin MOD_COMMON "" BYTE_ORDER MSB_LAST ALIGNMENT_BYTE 1 ALIGNMENT_WORD 2 ALIGNMENT_LONG 4 ALIGNMENT_INT64 4 ALIGNMENT_FLOAT32_IEEE 4 ALIGNMENT_FLOAT64_IEEE 4 DATA_SIZE 32 /end MOD_COMMON
/begin CHARACTERISTIC CWDKRSA "code word: kc-diagnosis signal evaluation" VALUE 0x8053A990 RB_Val_Wu8 255.0 dez 0.00 255.0 FORMAT "%5.1" /end CHARACTERISTIC
/begin CHARACTERISTIC CWDKS "code word knock sensor diagnosis" VALUE 0x8053A934 RB_Val_Wu8 255.0 dez 0.00 255.0 FORMAT "%5.1" /end CHARACTERISTIC
/begin CHARACTERISTIC CWDKVBDEPL "Codeword of function DKVBDEPL" VALUE 0x8053AA46 RB_Val_Wu8 255.0 dez 0.00 255.0 FORMAT "%5.1" /end CHARACTERISTIC
/begin CHARACTERISTIC CWFFUEL "Code word to configure the adaptation values for the fuel system diagnose in flex engines with no fuel sensor" VALUE 0x8053AAA4 RB_Val_Wu8 255.0 OneToOne 0.00 255.0 FORMAT "%5.1" /end CHARACTERISTIC
/begin CHARACTERISTIC CWHDRKH "Codeword for diagnosis hdrkh during catalyst heating" VALUE 0x8053AA47 RB_Val_Wu8 255.0 dez 0.00 255.0 FORMAT "%5.1" /end CHARACTERISTIC
/begin CHARACTERISTIC DFRAESTAB "Delta-FRA for setting of ""FRA-stable"" when diagnosis-threshold is reached" VALUE 0x8053AAA6 RB_Val_Wu16 1.999969 fak_uw_b2 0.00 1.999969 FORMAT "%8.6" /end CHARACTERISTIC
/begin CHARACTERISTIC DFRASTAB "delta-FRA for setting of ""FRA stable""" VALUE 0x8053AAA8 RB_Val_Wu16 1.999969 fak_uw_b2 0.00 1.999969 FORMAT "%8.6" /end CHARACTERISTIC
/begin CHARACTERISTIC DFRMSTAB "Delta of filtered lambda correction for setting of ""FRM stable""" VALUE 0x8053AAAA RB_Val_Wu16 1.999969 fak_uw_b2 0.00 1.999969 FORMAT "%8.6" /end CHARACTERISTIC
/begin CHARACTERISTIC DIUMPR_CldStrtDenCldStrtTyp_C "Global switch for selection of ColdStart Denominator type (EOBD ColdStart or CARB Evap)" VALUE 0x804F50DC Val_Wu8 1.00000000000 DIUMPR_CldStrtDenCldStrtTyp_C_Verb 0.00 1.00000000000 FORMAT "%13.11" /end CHARACTERISTIC
/begin CHARACTERISTIC DIUMPR_ctGen.l500MDInc_C "criterias to count general denominator and ignition cycle counter / Number of increments of the internal odometer to reach a interval of 10 km" VALUE 0x804F50DE Val_Ws16 65535.00 OneToOne -32768.00 32767.00 FORMAT "%8.2" READ_ONLY /end CHARACTERISTIC
/begin CHARACTERISTIC DIUMPR_ctGen.l500MD_C "criterias to count general denominator and ignition cycle counter / minimal driven distance to release special 500 miles denominator" VALUE 0x804F50E0 Val_Wu8 1260. DIUMPR_l10km 0.00 1260. FORMAT "%5.0" EXTENDED_LIMITS 0.00 2550. READ_ONLY /end CHARACTERISTIC
/begin CHARACTERISTIC DIUMPR_ctGen.pEnvMin_C "criterias to count general denominator and ignition cycle counter / maximum elevation (represented by minimum air pressure)" VALUE 0x804F50E2 Val_Ws16 65535.00 Pres_hPa -32768.00 32767.00 FORMAT "%8.2" /end CHARACTERISTIC
/begin CHARACTERISTIC DIUMPR_ctGen.rAPPMax_C "criterias to count general denominator and ignition cycle counter / maximum accelerator pedal position for idle detection" VALUE 0x804F50E4 Val_Ws16 799.9878 Prc -400.0000 399.9878 FORMAT "%8.4" /end CHARACTERISTIC
/begin CHARACTERISTIC DIUMPR_ctGen.tEnvMin_C "criterias to count general denominator and ignition cycle counter / mimimum ambient temperatur" VALUE 0x804F50E6 Val_Ws16 6553.500 Temp_Cels -3549.940 3003.560 FORMAT "%8.3" /end CHARACTERISTIC
/begin CHARACTERISTIC DIUMPR_ctGen.tiActrMin_C "criterias to count general denominator and ignition cycle counter / minimum activation time of a component to increment denominator" VALUE 0x804F50E8 Val_Wu8 25.50 DIUMPR_ti100ms 0.00 25.50 FORMAT "%5.2" /end CHARACTERISTIC
/begin CHARACTERISTIC DIUMPR_ctGen.tiFuEngOpMin_C "criterias to count general denominator and ignition cycle counter / Minimal time for fueled engine firm(operation)" VALUE 0x804F50EA Val_Wu16 6553.500 DIUMPR_ti100ms 0.00 6553.500 FORMAT "%8.3" READ_ONLY /end CHARACTERISTIC
/begin CHARACTERISTIC DIUMPR_ctGen.tiIdlMin_C "criterias to count general denominator and ignition cycle counter / minimum operation time in idle state" VALUE 0x804F50EC Val_Wu16 6553.500 DIUMPR_ti100ms 0.00 6553.500 FORMAT "%8.3" /end CHARACTERISTIC
/begin CHARACTERISTIC DIUMPR_ctGen.tiIgnCycMin_C "criterias to count general denominator and ignition cycle counter / Minimum TIme limit for increment of Ignition cycle counter" VALUE 0x804F50EE Val_Wu8 25.50 DIUMPR_ti100ms 0.00 25.50 FORMAT "%5.2" READ_ONLY /end CHARACTERISTIC
/begin CHARACTERISTIC DIUMPR_ctGen.tiIgnMin_C "criterias to count general denominator and ignition cycle counter / Minimum Fueled Engine Operation Time for the Fueled Engine Ignition Cycle counter" VALUE 0x804F50EF Val_Wu8 25.50 DIUMPR_ti100ms 0.00 25.50 FORMAT "%5.2" READ_ONLY /end CHARACTERISTIC
/begin CHARACTERISTIC DIUMPR_ctGen.tiOpMin_C "criterias to count general denominator and ignition cycle counter / minimum operation time" VALUE 0x804F50F0 Val_Wu16 6553.500 DIUMPR_ti100ms 0.00 6553.500 FORMAT "%8.3" /end CHARACTERISTIC
/begin CHARACTERISTIC DIUMPR_ctGen.tiSigContActv_C "criterias to count general denominator and ignition cycle counter / minimum energising time twice required for a component to increment the denominator" VALUE 0x804F50F2 Val_Wu8 3.000 DIUMPR_ti100ms 0.00 3.000 FORMAT "%5.3" EXTENDED_LIMITS 0.00 25.50 /end CHARACTERISTIC
/begin CHARACTERISTIC DIUMPR_ctGen.tiVehSpdMin_C "criterias to count general denominator and ignition cycle counter / minimum operation time about 25 miles per hour" VALUE 0x804F50F4 Val_Wu16 6553.500 DIUMPR_ti100ms 0.00 6553.500 FORMAT "%8.3" /end CHARACTERISTIC
/begin CHARACTERISTIC DIUMPR_ctGen.vVehIdlMax_C "criterias to count general denominator and ignition cycle counter / maximim vehicle speed for idle detection" VALUE 0x804F50F6 Val_Ws16 655.3500 Vel -327.6800 327.6700 FORMAT "%8.4" /end CHARACTERISTIC
/begin CHARACTERISTIC DIUMPR_ctGen.vVehMin_C "criterias to count general denominator and ignition cycle counter / minimum vehicle speed" VALUE 0x804F50F8 Val_Ws16 655.3500 Vel -327.6800 327.6700 FORMAT "%8.4" /end CHARACTERISTIC
/begin CHARACTERISTIC DIUMPR_Ctl.FID_BEONV_C "IUPR control byte / control byte for in-use performance monitoring of FID_BEONV" VALUE 0x804F50FA Val_Wu8 255.0 OneToOne 0.00 255.0 FORMAT "%5.1" /end CHARACTERISTIC
/begin CHARACTERISTIC DIUMPR_Ctl.FID_BDSTOF_C "IUPR control byte / control byte for in-use performance monitoring of FID_BDSTOF" VALUE 0x804F50FB Val_Wu8 255.0 OneToOne 0.00 255.0 FORMAT "%5.1" /end CHARACTERISTIC
/begin CHARACTERISTIC DIUMPR_Ctl.FID_BLLRH_C "IUPR control byte / control byte for in-use performance monitoring of FID_BLLRH" VALUE 0x804F50FC Val_Wu8 255.0 OneToOne 0.00 255.0 FORMAT "%5.1" /end CHARACTERISTIC
/begin CHARACTERISTIC DIUMPR_Ctl.FID_BLLRKH_C "IUPR control byte / control byte for in-use performance monitoring of FID_BLLRKH" VALUE 0x804F50FD Val_Wu8 255.0 OneToOne 0.00 255.0 FORMAT "%5.1" /end CHARACTERISTIC
/begin CHARACTERISTIC DIUMPR_Ctl.FID_BPLSU_C "IUPR control byte / control byte for in-use performance monitoring of FID_BPLSU" VALUE 0x804F50FE Val_Wu8 255.0 OneToOne 0.00 255.0 FORMAT "%5.1" /end CHARACTERISTIC
/begin CHARACTERISTIC DIUMPR_Ctl.FId_EGSDO2FuTrmB1_C "IUPR control byte / control byte for in-use performance monitoring of FId_EGSDO2FuTrmB1" VALUE 0x804F50FF Val_Wu8 255.0 OneToOne 0.00 255.0 FORMAT "%5.1" /end CHARACTERISTIC
/begin CHARACTERISTIC DIUMPR_Ctl.FId_EGSDO2SnsrMntdRelsS1B1_C "IUPR control byte / control byte for in-use performance monitoring of FId_EGSDO2SnsrMntdRelsS1B1" VALUE 0x804F5100 Val_Wu8 255.0 OneToOne 0.00 255.0 FORMAT "%5.1" /end CHARACTERISTIC
/begin CHARACTERISTIC DIUMPR_Ctl.FID_CAGRSUS_C "IUPR control byte / control byte for in-use performance monitoring of FID_CAGRSUS" VALUE 0x804F5101 Val_Wu8 255.0 OneToOne 0.00 255.0 FORMAT "%5.1" /end CHARACTERISTIC
/begin CHARACTERISTIC DIUMPR_Ctl.FID_CDSKVRaty_C "IUPR control byte / control byte for in-use performance monitoring of FID_CDSKVRaty" VALUE 0x804F5102 Val_Wu8 255.0 OneToOne 0.00 255.0 FORMAT "%5.1" /end CHARACTERISTIC
/begin CHARACTERISTIC DIUMPR_Ctl.FID_CDSTR_C "IUPR control byte / control byte for in-use performance monitoring of FID_CDSTR" VALUE 0x804F5103 Val_Wu8 255.0 OneToOne 0.00 255.0 FORMAT "%5.1" /end CHARACTERISTIC
/begin CHARACTERISTIC DIUMPR_Ctl.FID_CETHSPLnpl_C "IUPR control byte / control byte for in-use performance monitoring of FID_CETHSPLnpl" VALUE 0x804F5104 Val_Wu8 255.0 OneToOne 0.00 255.0 FORMAT "%5.1" /end CHARACTERISTIC
/begin CHARACTERISTIC DIUMPR_Ctl.FID_CETHSTPLnpl_C "IUPR control byte / control byte for in-use performance monitoring of FID_CETHSTPLnpl" VALUE 0x804F5105 Val_Wu8 255.0 OneToOne 0.00 255.0 FORMAT "%5.1" /end CHARACTERISTIC
/begin CHARACTERISTIC DIUMPR_Ctl.FID_CETKHL_C "IUPR control byte / control byte for in-use performance monitoring of FID_CETKHL" VALUE 0x804F5106 Val_Wu8 255.0 OneToOne 0.00 255.0 FORMAT "%5.1" /end CHARACTERISTIC
/begin CHARACTERISTIC DIUMPR_Ctl.FID_CETKHT_C "IUPR control byte / control byte for in-use performance monitoring of FID_CETKHT" VALUE 0x804F5107 Val_Wu8 255.0 OneToOne 0.00 255.0 FORMAT "%5.1" /end CHARACTERISTIC
/begin CHARACTERISTIC DIUMPR_Ctl.FID_CGLSRDP_C "IUPR control byte / control byte for in-use performance monitoring of FID_CGLSRDP" VALUE 0x804F5108 Val_Wu8 255.0 OneToOne 0.00 255.0 FORMAT "%5.1" /end CHARACTERISTIC
/begin CHARACTERISTIC DIUMPR_Ctl.FID_CHDRKH_C "IUPR control byte / control byte for in-use performance monitoring of FID_CHDRKH" VALUE 0x804F5109 Val_Wu8 255.0 OneToOne 0.00 255.0 FORMAT "%5.1" /end CHARACTERISTIC
/begin CHARACTERISTIC DIUMPR_Ctl.FID_CLZSRDP_C "IUPR control byte / control byte for in-use performance monitoring of FID_CLZSRDP" VALUE 0x804F510A Val_Wu8 255.0 OneToOne 0.00 255.0 FORMAT "%5.1" /end CHARACTERISTIC
/begin CHARACTERISTIC DIUMPR_Ctl.FID_CLZSRHP_C "IUPR control byte / control byte for in-use performance monitoring of FID_CLZSRHP" VALUE 0x804F510B Val_Wu8 255.0 OneToOne 0.00 255.0 FORMAT "%5.1" /end CHARACTERISTIC
/begin CHARACTERISTIC DIUMPR_Ctl.FID_CPSRP_C "IUPR control byte / control byte for in-use performance monitoring of FID_CPSRP" VALUE 0x804F510C Val_Wu8 255.0 OneToOne 0.00 255.0 FORMAT "%5.1" /end CHARACTERISTIC
/begin CHARACTERISTIC DIUMPR_Ctl.FID_CTESF_C "IUPR control byte / control byte for in-use performance monitoring of FID_CTESF" VALUE 0x804F510D Val_Wu8 255.0 OneToOne 0.00 255.0 FORMAT "%5.1" /end CHARACTERISTIC
/begin CHARACTERISTIC DIUMPR_Ctl.FID_CTESG_C "IUPR control byte / control byte for in-use performance monitoring of FID_CTESG" VALUE 0x804F510E Val_Wu8 255.0 OneToOne 0.00 255.0 FORMAT "%5.1" /end CHARACTERISTIC
/begin CHARACTERISTIC DIUMPR_Ctl.FID_CTKACS_C "IUPR control byte / control byte for in-use performance monitoring of FID_CTKACS" VALUE 0x804F510F Val_Wu8 255.0 OneToOne 0.00 255.0 FORMAT "%5.1" /end CHARACTERISTIC
/begin CHARACTERISTIC DIUMPR_Ctl.FId_AfsPlausDiag_C "IUPR control byte / control byte for in-use performance monitoring of FId_AfsPlausDiag" VALUE 0x804F5110 Val_Wu8 255.0 OneToOne 0.00 255.0 FORMAT "%5.1" /end CHARACTERISTIC
/begin CHARACTERISTIC DIUMPR_Ctl.FId_CEngDsTColdStrt_C "IUPR control byte / control byte for in-use performance monitoring of FId_CEngDsTColdStrt" VALUE 0x804F5111 Val_Wu8 255.0 OneToOne 0.00 255.0 FORMAT "%5.1" /end CHARACTERISTIC
/begin CHARACTERISTIC DIUMPR_Ctl.FId_CEngDsTHSC_C "IUPR control byte / control byte for in-use performance monitoring of FId_CEngDsTHSC" VALUE 0x804F5112 Val_Wu8 255.0 OneToOne 0.00 255.0 FORMAT "%5.1" /end CHARACTERISTIC
/begin CHARACTERISTIC DIUMPR_Ctl.FId_CEngDsTLSC_C "IUPR control byte / control byte for in-use performance monitoring of FId_CEngDsTLSC" VALUE 0x804F5113 Val_Wu8 255.0 OneToOne 0.00 255.0 FORMAT "%5.1" /end CHARACTERISTIC
/begin CHARACTERISTIC DIUMPR_Ctl.FId_CEngDsTSTC_C "IUPR control byte / control byte for in-use performance monitoring of FId_CEngDsTSTC" VALUE 0x804F5114 Val_Wu8 255.0 OneToOne 0.00 255.0 FORMAT "%5.1" /end CHARACTERISTIC
/begin CHARACTERISTIC DIUMPR_Ctl.FId_CEngUsTCrssChk_C "IUPR control byte / control byte for in-use performance monitoring of FId_CEngUsTCrssChk" VALUE 0x804F5115 Val_Wu8 255.0 OneToOne 0.00 255.0 FORMAT "%5.1" /end CHARACTERISTIC
/begin CHARACTERISTIC DIUMPR_Ctl.FId_CInjCatHeatgDiag_C "IUPR control byte / control byte for in-use performance monitoring of FId_CInjCatHeatgDiag" VALUE 0x804F5116 Val_Wu8 255.0 OneToOne 0.00 255.0 FORMAT "%5.1" /end CHARACTERISTIC
/begin CHARACTERISTIC DIUMPR_Ctl.FId_DiagBlkdLine_C "IUPR control byte / control byte for in-use performance monitoring of FId_DiagBlkdLine" VALUE 0x804F5117 Val_Wu8 255.0 OneToOne 0.00 255.0 FORMAT "%5.1" /end CHARACTERISTIC
/begin CHARACTERISTIC DIUMPR_Ctl.FId_DiagCpv1DteskLoLoad_C "IUPR control byte / control byte for in-use performance monitoring of FId_DiagCpv1DteskLoLoad" VALUE 0x804F5118 Val_Wu8 255.0 OneToOne 0.00 255.0 FORMAT "%5.1" /end CHARACTERISTIC
/begin CHARACTERISTIC DIUMPR_Ctl.FId_EGSDUS2B1LtrDly_C "IUPR control byte / control byte for in-use performance monitoring of FId_EGSDUS2B1LtrDly" VALUE 0x804F5119 Val_Wu8 255.0 OneToOne 0.00 255.0 FORMAT "%5.1" /end CHARACTERISTIC
/begin CHARACTERISTIC DIUMPR_Ctl.FId_EGSDUS2B1LtrPT1_C "IUPR control byte / control byte for in-use performance monitoring of FId_EGSDUS2B1LtrPT1" VALUE 0x804F511A Val_Wu8 255.0 OneToOne 0.00 255.0 FORMAT "%5.1" /end CHARACTERISTIC
/begin CHARACTERISTIC DIUMPR_Ctl.FId_EGSDUS2B1RtlDly_C "IUPR control byte / control byte for in-use performance monitoring of FId_EGSDUS2B1RtlDly" VALUE 0x804F511B Val_Wu8 255.0 OneToOne 0.00 255.0 FORMAT "%5.1" /end CHARACTERISTIC
/begin CHARACTERISTIC DIUMPR_Ctl.FId_EGSDUS2B1RtlPT1_C "IUPR control byte / control byte for in-use performance monitoring of FId_EGSDUS2B1RtlPT1" VALUE 0x804F511C Val_Wu8 255.0 OneToOne 0.00 255.0 FORMAT "%5.1" /end CHARACTERISTIC
/begin CHARACTERISTIC DIUMPR_Ctl.FId_EGSDUS2B1TarLean_C "IUPR control byte / control byte for in-use performance monitoring of FId_EGSDUS2B1TarLean" VALUE 0x804F511D Val_Wu8 255.0 OneToOne 0.00 255.0 FORMAT "%5.1" /end CHARACTERISTIC
/begin CHARACTERISTIC DIUMPR_Ctl.FId_EGSDUS2B1TarRich_C "IUPR control byte / control byte for in-use performance monitoring of FId_EGSDUS2B1TarRich" VALUE 0x804F511E Val_Wu8 255.0 OneToOne 0.00 255.0 FORMAT "%5.1" /end CHARACTERISTIC
/begin CHARACTERISTIC DIUMPR_Ctl.FId_EpmCaSOfsErrCaSI1_C "IUPR control byte / control byte for in-use performance monitoring of FId_EpmCaSOfsErrCaSI1" VALUE 0x804F511F Val_Wu8 255.0 OneToOne 0.00 255.0 FORMAT "%5.1" /end CHARACTERISTIC
/begin CHARACTERISTIC DIUMPR_Ctl.FId_EtaEngIdleNonCsers_C "IUPR control byte / control byte for in-use performance monitoring of FId_EtaEngIdleNonCsers" VALUE 0x804F5120 Val_Wu8 255.0 OneToOne 0.00 255.0 FORMAT "%5.1" /end CHARACTERISTIC
/begin CHARACTERISTIC DIUMPR_Ctl.FId_EtaEngPtlNonCsers_C "IUPR control byte / control byte for in-use performance monitoring of FId_EtaEngPtlNonCsers" VALUE 0x804F5121 Val_Wu8 255.0 OneToOne 0.00 255.0 FORMAT "%5.1" /end CHARACTERISTIC
/begin CHARACTERISTIC DIUMPR_Ctl.FId_FlDevPlauDiagFuSnsr_C "IUPR control byte / control byte for in-use performance monitoring of FId_FlDevPlauDiagFuSnsr" VALUE 0x804F5122 Val_Wu8 255.0 OneToOne 0.00 255.0 FORMAT "%5.1" /end CHARACTERISTIC
/begin CHARACTERISTIC DIUMPR_Ctl.FId_GEVlvLockPinDiagIntkB1_C "IUPR control byte / control byte for in-use performance monitoring of FId_GEVlvLockPinDiagIntkB1" VALUE 0x804F5123 Val_Wu8 255.0 OneToOne 0.00 255.0 FORMAT "%5.1" /end CHARACTERISTIC
/begin CHARACTERISTIC DIUMPR_Ctl.FId_GEVlvPhaDiagEnaCsersIntkB1_C "IUPR control byte / control byte for in-use performance monitoring of FId_GEVlvPhaDiagEnaCsersIntkB1" VALUE 0x804F5124 Val_Wu8 255.0 OneToOne 0.00 255.0 FORMAT "%5.1" /end CHARACTERISTIC
/begin CHARACTERISTIC DIUMPR_Ctl.FId_GEVlvPhaDiagEnaIntkB1_C "IUPR control byte / control byte for in-use performance monitoring of FId_GEVlvPhaDiagEnaIntkB1" VALUE 0x804F5125 Val_Wu8 255.0 OneToOne 0.00 255.0 FORMAT "%5.1" /end CHARACTERISTIC
/begin CHARACTERISTIC DIUMPR_Ctl.FId_HEGOS2B1DHtg_C "IUPR control byte / control byte for in-use performance monitoring of FId_HEGOS2B1DHtg" VALUE 0x804F5126 Val_Wu8 255.0 OneToOne 0.00 255.0 FORMAT "%5.1" /end CHARACTERISTIC
/begin CHARACTERISTIC DIUMPR_Ctl.FId_InhbLamDynS1B1_C "IUPR control byte / control byte for in-use performance monitoring of FId_InhbLamDynS1B1" VALUE 0x804F5127 Val_Wu8 255.0 OneToOne 0.00 255.0 FORMAT "%5.1" /end CHARACTERISTIC
/begin CHARACTERISTIC DIUMPR_Ctl.FId_InjSysMulInjDiagErr_C "IUPR control byte / control byte for in-use performance monitoring of FId_InjSysMulInjDiagErr" VALUE 0x804F5128 Val_Wu8 255.0 OneToOne 0.00 255.0 FORMAT "%5.1" /end CHARACTERISTIC
/begin CHARACTERISTIC DIUMPR_Ctl.FId_IntkAirTAirFltDsCrssChk_C "IUPR control byte / control byte for in-use performance monitoring of FId_IntkAirTAirFltDsCrssChk" VALUE 0x804F5129 Val_Wu8 255.0 OneToOne 0.00 255.0 FORMAT "%5.1" /end CHARACTERISTIC
/begin CHARACTERISTIC DIUMPR_Ctl.FId_IntkAirTAirFltDsPlausChk_C "IUPR control byte / control byte for in-use performance monitoring of FId_IntkAirTAirFltDsPlausChk" VALUE 0x804F512A Val_Wu8 255.0 OneToOne 0.00 255.0 FORMAT "%5.1" /end CHARACTERISTIC
/begin CHARACTERISTIC DIUMPR_Ctl.FId_IntkAirTIntkMnfldCrssChk_C "IUPR control byte / control byte for in-use performance monitoring of FId_IntkAirTIntkMnfldCrssChk" VALUE 0x804F512B Val_Wu8 255.0 OneToOne 0.00 255.0 FORMAT "%5.1" /end CHARACTERISTIC
/begin CHARACTERISTIC DIUMPR_Ctl.FId_IntkAirTIntkMnfldPlausChk_C "IUPR control byte / control byte for in-use performance monitoring of FId_IntkAirTIntkMnfldPlausChk" VALUE 0x804F512C Val_Wu8 255.0 OneToOne 0.00 255.0 FORMAT "%5.1" /end CHARACTERISTIC
/begin CHARACTERISTIC DIUMPR_Ctl.FId_PEnvPlausDiagVDD_C "IUPR control byte / control byte for in-use performance monitoring of FId_PEnvPlausDiagVDD" VALUE 0x804F512D Val_Wu8 255.0 OneToOne 0.00 255.0 FORMAT "%5.1" /end CHARACTERISTIC
/begin CHARACTERISTIC DIUMPR_Ctl.FId_P_VSE11_Diag_C "IUPR control byte / control byte for in-use performance monitoring of FId_P_VSE11_Diag" VALUE 0x804F512E Val_Wu8 255.0 OneToOne 0.00 255.0 FORMAT "%5.1" /end CHARACTERISTIC
/begin CHARACTERISTIC DIUMPR_Ctl.FId_TWCDPriCatParB1_C "IUPR control byte / control byte for in-use performance monitoring of FId_TWCDPriCatParB1" VALUE 0x804F512F Val_Wu8 255.0 OneToOne 0.00 255.0 FORMAT "%5.1" /end CHARACTERISTIC
/begin CHARACTERISTIC DIUMPR_Ctl.FId_TiOffTBasdChkFast_C "IUPR control byte / control byte for in-use performance monitoring of FId_TiOffTBasdChkFast" VALUE 0x804F5130 Val_Wu8 255.0 OneToOne 0.00 255.0 FORMAT "%5.1" /end CHARACTERISTIC
/begin CHARACTERISTIC DIUMPR_Ctl.FId_TiOffTBasdChkSlow_C "IUPR control byte / control byte for in-use performance monitoring of FId_TiOffTBasdChkSlow" VALUE 0x804F5131 Val_Wu8 255.0 OneToOne 0.00 255.0 FORMAT "%5.1" /end CHARACTERISTIC
/begin CHARACTERISTIC DIUMPR_Ctl.FId_UEGOHeatrPrfmncDiagRelsS1B1_C "IUPR control byte / control byte for in-use performance monitoring of FId_UEGOHeatrPrfmncDiagRelsS1B1" VALUE 0x804F5132 Val_Wu8 255.0 OneToOne 0.00 255.0 FORMAT "%5.1" /end CHARACTERISTIC
/begin CHARACTERISTIC DIUMPR_Ctl.FId_UEGOStrtDiagRelsS1B1_C "IUPR control byte / control byte for in-use performance monitoring of FId_UEGOStrtDiagRelsS1B1" VALUE 0x804F5133 Val_Wu8 255.0 OneToOne 0.00 255.0 FORMAT "%5.1" /end CHARACTERISTIC
/begin CHARACTERISTIC DIUMPR_Ctl.FId_VlvLftFbSwtIntk11Diag_C "IUPR control byte / control byte for in-use performance monitoring of FId_VlvLftFbSwtIntk11Diag" VALUE 0x804F5134 Val_Wu8 255.0 OneToOne 0.00 255.0 FORMAT "%5.1" /end CHARACTERISTIC
/begin CHARACTERISTIC DIUMPR_DFC.FID_BEONV_C "IUMPR related DFC / assigned fault check for in-use performance monitoring of FID_BEONV" VALUE 0x804F5136 Val_Wu16 906.000000000 DFC_Verb 0.00 906.000000000 FORMAT "%13.9" /end CHARACTERISTIC
/begin CHARACTERISTIC DIUMPR_DFC.FID_BDSTOF_C "IUMPR related DFC / assigned fault check for in-use performance monitoring of FID_BDSTOF" VALUE 0x804F5138 Val_Wu16 906.000000000 DFC_Verb 0.00 906.000000000 FORMAT "%13.9" /end CHARACTERISTIC
/begin CHARACTERISTIC DIUMPR_DFC.FID_BLLRH_C "IUMPR related DFC / assigned fault check for in-use performance monitoring of FID_BLLRH" VALUE 0x804F513A Val_Wu16 906.000000000 DFC_Verb 0.00 906.000000000 FORMAT "%13.9" /end CHARACTERISTIC
/begin CHARACTERISTIC DIUMPR_DFC.FID_BLLRKH_C "IUMPR related DFC / assigned fault check for in-use performance monitoring of FID_BLLRKH" VALUE 0x804F513C Val_Wu16 906.000000000 DFC_Verb 0.00 906.000000000 FORMAT "%13.9" /end CHARACTERISTIC
/begin CHARACTERISTIC DIUMPR_DFC.FID_BPLSU_C "IUMPR related DFC / assigned fault check for in-use performance monitoring of FID_BPLSU" VALUE 0x804F513E Val_Wu16 906.000000000 DFC_Verb 0.00 906.000000000 FORMAT "%13.9" /end CHARACTERISTIC
/begin CHARACTERISTIC DIUMPR_DFC.FId_EGSDO2FuTrmB1_C "IUMPR related DFC / assigned fault check for in-use performance monitoring of FId_EGSDO2FuTrmB1" VALUE 0x804F5140 Val_Wu16 906.000000000 DFC_Verb 0.00 906.000000000 FORMAT "%13.9" /end CHARACTERISTIC
/begin CHARACTERISTIC DIUMPR_DFC.FId_EGSDO2SnsrMntdRelsS1B1_C "IUMPR related DFC / assigned fault check for in-use performance monitoring of FId_EGSDO2SnsrMntdRelsS1B1" VALUE 0x804F5142 Val_Wu16 906.000000000 DFC_Verb 0.00 906.000000000 FORMAT "%13.9" /end CHARACTERISTIC
/begin CHARACTERISTIC DIUMPR_DFC.FID_CAGRSUS_C "IUMPR related DFC / assigned fault check for in-use performance monitoring of FID_CAGRSUS" VALUE 0x804F5144 Val_Wu16 906.000000000 DFC_Verb 0.00 906.000000000 FORMAT "%13.9" /end CHARACTERISTIC
/begin CHARACTERISTIC DIUMPR_DFC.FID_CDSKVRaty_C "IUMPR related DFC / assigned fault check for in-use performance monitoring of FID_CDSKVRaty" VALUE 0x804F5146 Val_Wu16 906.000000000 DFC_Verb 0.00 906.000000000 FORMAT "%13.9" /end CHARACTERISTIC
/begin CHARACTERISTIC DIUMPR_DFC.FID_CDSTR_C "IUMPR related DFC / assigned fault check for in-use performance monitoring of FID_CDSTR" VALUE 0x804F5148 Val_Wu16 906.000000000 DFC_Verb 0.00 906.000000000 FORMAT "%13.9" /end CHARACTERISTIC
/begin CHARACTERISTIC DIUMPR_DFC.FID_CETHSPLnpl_C "IUMPR related DFC / assigned fault check for in-use performance monitoring of FID_CETHSPLnpl" VALUE 0x804F514A Val_Wu16 906.000000000 DFC_Verb 0.00 906.000000000 FORMAT "%13.9" /end CHARACTERISTIC
/begin CHARACTERISTIC DIUMPR_DFC.FID_CETHSTPLnpl_C "IUMPR related DFC / assigned fault check for in-use performance monitoring of FID_CETHSTPLnpl" VALUE 0x804F514C Val_Wu16 906.000000000 DFC_Verb 0.00 906.000000000 FORMAT "%13.9" /end CHARACTERISTIC
/begin CHARACTERISTIC DIUMPR_DFC.FID_CETKHL_C "IUMPR related DFC / assigned fault check for in-use performance monitoring of FID_CETKHL" VALUE 0x804F514E Val_Wu16 906.000000000 DFC_Verb 0.00 906.000000000 FORMAT "%13.9" /end CHARACTERISTIC
/begin CHARACTERISTIC DIUMPR_DFC.FID_CETKHT_C "IUMPR related DFC / assigned fault check for in-use performance monitoring of FID_CETKHT" VALUE 0x804F5150 Val_Wu16 906.000000000 DFC_Verb 0.00 906.000000000 FORMAT "%13.9" /end CHARACTERISTIC
/begin CHARACTERISTIC DIUMPR_DFC.FID_CGLSRDP_C "IUMPR related DFC / assigned fault check for in-use performance monitoring of FID_CGLSRDP" VALUE 0x804F5152 Val_Wu16 906.000000000 DFC_Verb 0.00 906.000000000 FORMAT "%13.9" /end CHARACTERISTIC
/begin CHARACTERISTIC DIUMPR_DFC.FID_CHDRKH_C "IUMPR related DFC / assigned fault check for in-use performance monitoring of FID_CHDRKH" VALUE 0x804F5154 Val_Wu16 906.000000000 DFC_Verb 0.00 906.000000000 FORMAT "%13.9" /end CHARACTERISTIC
/begin CHARACTERISTIC DIUMPR_DFC.FID_CLZSRDP_C "IUMPR related DFC / assigned fault check for in-use performance monitoring of FID_CLZSRDP" VALUE 0x804F5156 Val_Wu16 906.000000000 DFC_Verb 0.00 906.000000000 FORMAT "%13.9" /end CHARACTERISTIC
/begin CHARACTERISTIC DIUMPR_DFC.FID_CLZSRHP_C "IUMPR related DFC / assigned fault check for in-use performance monitoring of FID_CLZSRHP" VALUE 0x804F5158 Val_Wu16 906.000000000 DFC_Verb 0.00 906.000000000 FORMAT "%13.9" /end CHARACTERISTIC
/begin CHARACTERISTIC DIUMPR_DFC.FID_CPSRP_C "IUMPR related DFC / assigned fault check for in-use performance monitoring of FID_CPSRP" VALUE 0x804F515A Val_Wu16 906.000000000 DFC_Verb 0.00 906.000000000 FORMAT "%13.9" /end CHARACTERISTIC
/begin CHARACTERISTIC DIUMPR_DFC.FID_CTESF_C "IUMPR related DFC / assigned fault check for in-use performance monitoring of FID_CTESF" VALUE 0x804F515C Val_Wu16 906.000000000 DFC_Verb 0.00 906.000000000 FORMAT "%13.9" /end CHARACTERISTIC
/begin CHARACTERISTIC DIUMPR_DFC.FID_CTESG_C "IUMPR related DFC / assigned fault check for in-use performance monitoring of FID_CTESG" VALUE 0x804F515E Val_Wu16 906.000000000 DFC_Verb 0.00 906.000000000 FORMAT "%13.9" /end CHARACTERISTIC
/begin CHARACTERISTIC DIUMPR_DFC.FID_CTKACS_C "IUMPR related DFC / assigned fault check for in-use performance monitoring of FID_CTKACS" VALUE 0x804F5160 Val_Wu16 906.000000000 DFC_Verb 0.00 906.000000000 FORMAT "%13.9" /end CHARACTERISTIC
/begin CHARACTERISTIC DIUMPR_DFC.FId_AfsPlausDiag_C "IUMPR related DFC / assigned fault check for in-use performance monitoring of FId_AfsPlausDiag" VALUE 0x804F5162 Val_Wu16 906.000000000 DFC_Verb 0.00 906.000000000 FORMAT "%13.9" /end CHARACTERISTIC
/begin CHARACTERISTIC DIUMPR_DFC.FId_CEngDsTColdStrt_C "IUMPR related DFC / assigned fault check for in-use performance monitoring of FId_CEngDsTColdStrt" VALUE 0x804F5164 Val_Wu16 906.000000000 DFC_Verb 0.00 906.000000000 FORMAT "%13.9" /end CHARACTERISTIC
/begin CHARACTERISTIC DIUMPR_DFC.FId_CEngDsTHSC_C "IUMPR related DFC / assigned fault check for in-use performance monitoring of FId_CEngDsTHSC" VALUE 0x804F5166 Val_Wu16 906.000000000 DFC_Verb 0.00 906.000000000 FORMAT "%13.9" /end CHARACTERISTIC
/begin CHARACTERISTIC DIUMPR_DFC.FId_CEngDsTLSC_C "IUMPR related DFC / assigned fault check for in-use performance monitoring of FId_CEngDsTLSC" VALUE 0x804F5168 Val_Wu16 906.000000000 DFC_Verb 0.00 906.000000000 FORMAT "%13.9" /end CHARACTERISTIC
/begin CHARACTERISTIC DIUMPR_DFC.FId_CEngDsTSTC_C "IUMPR related DFC / assigned fault check for in-use performance monitoring of FId_CEngDsTSTC" VALUE 0x804F516A Val_Wu16 906.000000000 DFC_Verb 0.00 906.000000000 FORMAT "%13.9" /end CHARACTERISTIC
/begin CHARACTERISTIC DIUMPR_DFC.FId_CEngUsTCrssChk_C "IUMPR related DFC / assigned fault check for in-use performance monitoring of FId_CEngUsTCrssChk" VALUE 0x804F516C Val_Wu16 906.000000000 DFC_Verb 0.00 906.000000000 FORMAT "%13.9" /end CHARACTERISTIC
/begin CHARACTERISTIC DIUMPR_DFC.FId_CInjCatHeatgDiag_C "IUMPR related DFC / assigned fault check for in-use performance monitoring of FId_CInjCatHeatgDiag" VALUE 0x804F516E Val_Wu16 906.000000000 DFC_Verb 0.00 906.000000000 FORMAT "%13.9" /end CHARACTERISTIC
/begin CHARACTERISTIC DIUMPR_DFC.FId_DiagBlkdLine_C "IUMPR related DFC / assigned fault check for in-use performance monitoring of FId_DiagBlkdLine" VALUE 0x804F5170 Val_Wu16 906.000000000 DFC_Verb 0.00 906.000000000 FORMAT "%13.9" /end CHARACTERISTIC
/begin CHARACTERISTIC DIUMPR_DFC.FId_DiagCpv1DteskLoLoad_C "IUMPR related DFC / assigned fault check for in-use performance monitoring of FId_DiagCpv1DteskLoLoad" VALUE 0x804F5172 Val_Wu16 906.000000000 DFC_Verb 0.00 906.000000000 FORMAT "%13.9" /end CHARACTERISTIC
/begin CHARACTERISTIC DIUMPR_DFC.FId_EGSDUS2B1LtrDly_C "IUMPR related DFC / assigned fault check for in-use performance monitoring of FId_EGSDUS2B1LtrDly" VALUE 0x804F5174 Val_Wu16 906.000000000 DFC_Verb 0.00 906.000000000 FORMAT "%13.9" /end CHARACTERISTIC
/begin CHARACTERISTIC DIUMPR_DFC.FId_EGSDUS2B1LtrPT1_C "IUMPR related DFC / assigned fault check for in-use performance monitoring of FId_EGSDUS2B1LtrPT1" VALUE 0x804F5176 Val_Wu16 906.000000000 DFC_Verb 0.00 906.000000000 FORMAT "%13.9" /end CHARACTERISTIC
/begin CHARACTERISTIC DIUMPR_DFC.FId_EGSDUS2B1RtlDly_C "IUMPR related DFC / assigned fault check for in-use performance monitoring of FId_EGSDUS2B1RtlDly" VALUE 0x804F5178 Val_Wu16 906.000000000 DFC_Verb 0.00 906.000000000 FORMAT "%13.9" /end CHARACTERISTIC
/begin CHARACTERISTIC DIUMPR_DFC.FId_EGSDUS2B1RtlPT1_C "IUMPR related DFC / assigned fault check for in-use performance monitoring of FId_EGSDUS2B1RtlPT1" VALUE 0x804F517A Val_Wu16 906.000000000 DFC_Verb 0.00 906.000000000 FORMAT "%13.9" /end CHARACTERISTIC
/begin CHARACTERISTIC DIUMPR_DFC.FId_EGSDUS2B1TarLean_C "IUMPR related DFC / assigned fault check for in-use performance monitoring of FId_EGSDUS2B1TarLean" VALUE 0x804F517C Val_Wu16 906.000000000 DFC_Verb 0.00 906.000000000 FORMAT "%13.9" /end CHARACTERISTIC
/begin CHARACTERISTIC DIUMPR_DFC.FId_EGSDUS2B1TarRich_C "IUMPR related DFC / assigned fault check for in-use performance monitoring of FId_EGSDUS2B1TarRich" VALUE 0x804F517E Val_Wu16 906.000000000 DFC_Verb 0.00 906.000000000 FORMAT "%13.9" /end CHARACTERISTIC
/begin CHARACTERISTIC DIUMPR_DFC.FId_EpmCaSOfsErrCaSI1_C "IUMPR related DFC / assigned fault check for in-use performance monitoring of FId_EpmCaSOfsErrCaSI1" VALUE 0x804F5180 Val_Wu16 906.000000000 DFC_Verb 0.00 906.000000000 FORMAT "%13.9" /end CHARACTERISTIC
/begin CHARACTERISTIC DIUMPR_DFC.FId_EtaEngIdleNonCsers_C "IUMPR related DFC / assigned fault check for in-use performance monitoring of FId_EtaEngIdleNonCsers" VALUE 0x804F5182 Val_Wu16 906.000000000 DFC_Verb 0.00 906.000000000 FORMAT "%13.9" /end CHARACTERISTIC
/begin CHARACTERISTIC DIUMPR_DFC.FId_EtaEngPtlNonCsers_C "IUMPR related DFC / assigned fault check for in-use performance monitoring of FId_EtaEngPtlNonCsers" VALUE 0x804F5184 Val_Wu16 906.000000000 DFC_Verb 0.00 906.000000000 FORMAT "%13.9" /end CHARACTERISTIC
/begin CHARACTERISTIC DIUMPR_DFC.FId_FlDevPlauDiagFuSnsr_C "IUMPR related DFC / assigned fault check for in-use performance monitoring of FId_FlDevPlauDiagFuSnsr" VALUE 0x804F5186 Val_Wu16 906.000000000 DFC_Verb 0.00 906.000000000 FORMAT "%13.9" /end CHARACTERISTIC
/begin CHARACTERISTIC DIUMPR_DFC.FId_GEVlvLockPinDiagIntkB1_C "IUMPR related DFC / assigned fault check for in-use performance monitoring of FId_GEVlvLockPinDiagIntkB1" VALUE 0x804F5188 Val_Wu16 906.000000000 DFC_Verb 0.00 906.000000000 FORMAT "%13.9" /end CHARACTERISTIC
/begin CHARACTERISTIC DIUMPR_DFC.FId_GEVlvPhaDiagEnaCsersIntkB1_C "IUMPR related DFC / assigned fault check for in-use performance monitoring of FId_GEVlvPhaDiagEnaCsersIntkB1" VALUE 0x804F518A Val_Wu16 906.000000000 DFC_Verb 0.00 906.000000000 FORMAT "%13.9" /end CHARACTERISTIC
/begin CHARACTERISTIC DIUMPR_DFC.FId_GEVlvPhaDiagEnaIntkB1_C "IUMPR related DFC / assigned fault check for in-use performance monitoring of FId_GEVlvPhaDiagEnaIntkB1" VALUE 0x804F518C Val_Wu16 906.000000000 DFC_Verb 0.00 906.000000000 FORMAT "%13.9" /end CHARACTERISTIC
/begin CHARACTERISTIC DIUMPR_DFC.FId_HEGOS2B1DHtg_C "IUMPR related DFC / assigned fault check for in-use performance monitoring of FId_HEGOS2B1DHtg" VALUE 0x804F518E Val_Wu16 906.000000000 DFC_Verb 0.00 906.000000000 FORMAT "%13.9" /end CHARACTERISTIC
/begin CHARACTERISTIC DIUMPR_DFC.FId_InhbLamDynS1B1_C "IUMPR related DFC / assigned fault check for in-use performance monitoring of FId_InhbLamDynS1B1" VALUE 0x804F5190 Val_Wu16 906.000000000 DFC_Verb 0.00 906.000000000 FORMAT "%13.9" /end CHARACTERISTIC
/begin CHARACTERISTIC DIUMPR_DFC.FId_InjSysMulInjDiagErr_C "IUMPR related DFC / assigned fault check for in-use performance monitoring of FId_InjSysMulInjDiagErr" VALUE 0x804F5192 Val_Wu16 906.000000000 DFC_Verb 0.00 906.000000000 FORMAT "%13.9" /end CHARACTERISTIC
/begin CHARACTERISTIC DIUMPR_DFC.FId_IntkAirTAirFltDsCrssChk_C "IUMPR related DFC / assigned fault check for in-use performance monitoring of FId_IntkAirTAirFltDsCrssChk" VALUE 0x804F5194 Val_Wu16 906.000000000 DFC_Verb 0.00 906.000000000 FORMAT "%13.9" /end CHARACTERISTIC
/begin CHARACTERISTIC DIUMPR_DFC.FId_IntkAirTAirFltDsPlausChk_C "IUMPR related DFC / assigned fault check for in-use performance monitoring of FId_IntkAirTAirFltDsPlausChk" VALUE 0x804F5196 Val_Wu16 906.000000000 DFC_Verb 0.00 906.000000000 FORMAT "%13.9" /end CHARACTERISTIC
/begin CHARACTERISTIC DIUMPR_DFC.FId_IntkAirTIntkMnfldCrssChk_C "IUMPR related DFC / assigned fault check for in-use performance monitoring of FId_IntkAirTIntkMnfldCrssChk" VALUE 0x804F5198 Val_Wu16 906.000000000 DFC_Verb 0.00 906.000000000 FORMAT "%13.9" /end CHARACTERISTIC
/begin CHARACTERISTIC DIUMPR_DFC.FId_IntkAirTIntkMnfldPlausChk_C "IUMPR related DFC / assigned fault check for in-use performance monitoring of FId_IntkAirTIntkMnfldPlausChk" VALUE 0x804F519A Val_Wu16 906.000000000 DFC_Verb 0.00 906.000000000 FORMAT "%13.9" /end CHARACTERISTIC
/begin CHARACTERISTIC DIUMPR_DFC.FId_PEnvPlausDiagVDD_C "IUMPR related DFC / assigned fault check for in-use performance monitoring of FId_PEnvPlausDiagVDD" VALUE 0x804F519C Val_Wu16 906.000000000 DFC_Verb 0.00 906.000000000 FORMAT "%13.9" /end CHARACTERISTIC
/begin CHARACTERISTIC DIUMPR_DFC.FId_P_VSE11_Diag_C "IUMPR related DFC / assigned fault check for in-use performance monitoring of FId_P_VSE11_Diag" VALUE 0x804F519E Val_Wu16 906.000000000 DFC_Verb 0.00 906.000000000 FORMAT "%13.9" /end CHARACTERISTIC
/begin CHARACTERISTIC DIUMPR_DFC.FId_TWCDPriCatParB1_C "IUMPR related DFC / assigned fault check for in-use performance monitoring of FId_TWCDPriCatParB1" VALUE 0x804F51A0 Val_Wu16 906.000000000 DFC_Verb 0.00 906.000000000 FORMAT "%13.9" /end CHARACTERISTIC
/begin CHARACTERISTIC DIUMPR_DFC.FId_TiOffTBasdChkFast_C "IUMPR related DFC / assigned fault check for in-use performance monitoring of FId_TiOffTBasdChkFast" VALUE 0x804F51A2 Val_Wu16 906.000000000 DFC_Verb 0.00 906.000000000 FORMAT "%13.9" /end CHARACTERISTIC
/begin CHARACTERISTIC DIUMPR_DFC.FId_TiOffTBasdChkSlow_C "IUMPR related DFC / assigned fault check for in-use performance monitoring of FId_TiOffTBasdChkSlow" VALUE 0x804F51A4 Val_Wu16 906.000000000 DFC_Verb 0.00 906.000000000 FORMAT "%13.9" /end CHARACTERISTIC
/begin CHARACTERISTIC DIUMPR_DFC.FId_UEGOHeatrPrfmncDiagRelsS1B1_C "IUMPR related DFC / assigned fault check for in-use performance monitoring of FId_UEGOHeatrPrfmncDiagRelsS1B1" VALUE 0x804F51A6 Val_Wu16 906.000000000 DFC_Verb 0.00 906.000000000 FORMAT "%13.9" /end CHARACTERISTIC
/begin CHARACTERISTIC DIUMPR_DFC.FId_UEGOStrtDiagRelsS1B1_C "IUMPR related DFC / assigned fault check for in-use performance monitoring of FId_UEGOStrtDiagRelsS1B1" VALUE 0x804F51A8 Val_Wu16 906.000000000 DFC_Verb 0.00 906.000000000 FORMAT "%13.9" /end CHARACTERISTIC
/begin CHARACTERISTIC DIUMPR_DFC.FId_VlvLftFbSwtIntk11Diag_C "IUMPR related DFC / assigned fault check for in-use performance monitoring of FId_VlvLftFbSwtIntk11Diag" VALUE 0x804F51AA Val_Wu16 906.000000000 DFC_Verb 0.00 906.000000000 FORMAT "%13.9" /end CHARACTERISTIC
/begin CHARACTERISTIC DIUMPR_FilAFRIPFGrp_C "Filter AFRI and PF groups in infotype 08 output for IUMPR" VALUE 0x804F51AC Val_Wu8 1.00000000000 DIUMPR_FilAFRIPFGrp_C_Verbal 0.00 1.00000000000 FORMAT "%13.11" /end CHARACTERISTIC
/begin CHARACTERISTIC DIUMPR_Grp.FID_BEONV_C "IUPR group / component group for in-use performance monitoring of FID_BEONV" VALUE 0x804F51AE Val_Wu8 14.0000000000 DIUMPR_GroupVerb 0.00 14.0000000000 FORMAT "%13.10" /end CHARACTERISTIC
/begin CHARACTERISTIC DIUMPR_Grp.FID_BDSTOF_C "IUPR group / component group for in-use performance monitoring of FID_BDSTOF" VALUE 0x804F51AF Val_Wu8 14.0000000000 DIUMPR_GroupVerb 0.00 14.0000000000 FORMAT "%13.10" /end CHARACTERISTIC
/begin CHARACTERISTIC DIUMPR_Grp.FID_BLLRH_C "IUPR group / component group for in-use performance monitoring of FID_BLLRH" VALUE 0x804F51B0 Val_Wu8 14.0000000000 DIUMPR_GroupVerb 0.00 14.0000000000 FORMAT "%13.10" /end CHARACTERISTIC
/begin CHARACTERISTIC DIUMPR_Grp.FID_BLLRKH_C "IUPR group / component group for in-use performance monitoring of FID_BLLRKH" VALUE 0x804F51B1 Val_Wu8 14.0000000000 DIUMPR_GroupVerb 0.00 14.0000000000 FORMAT "%13.10" /end CHARACTERISTIC
/begin CHARACTERISTIC DIUMPR_Grp.FID_BPLSU_C "IUPR group / component group for in-use performance monitoring of FID_BPLSU" VALUE 0x804F51B2 Val_Wu8 14.0000000000 DIUMPR_GroupVerb 0.00 14.0000000000 FORMAT "%13.10" /end CHARACTERISTIC
/begin CHARACTERISTIC DIUMPR_Grp.FId_EGSDO2FuTrmB1_C "IUPR group / component group for in-use performance monitoring of FId_EGSDO2FuTrmB1" VALUE 0x804F51B3 Val_Wu8 14.0000000000 DIUMPR_GroupVerb 0.00 14.0000000000 FORMAT "%13.10" /end CHARACTERISTIC
/begin CHARACTERISTIC DIUMPR_Grp.FId_EGSDO2SnsrMntdRelsS1B1_C "IUPR group / component group for in-use performance monitoring of FId_EGSDO2SnsrMntdRelsS1B1" VALUE 0x804F51B4 Val_Wu8 14.0000000000 DIUMPR_GroupVerb 0.00 14.0000000000 FORMAT "%13.10" /end CHARACTERISTIC
/begin CHARACTERISTIC DIUMPR_Grp.FID_CAGRSUS_C "IUPR group / component group for in-use performance monitoring of FID_CAGRSUS" VALUE 0x804F51B5 Val_Wu8 14.0000000000 DIUMPR_GroupVerb 0.00 14.0000000000 FORMAT "%13.10" /end CHARACTERISTIC
/begin CHARACTERISTIC DIUMPR_Grp.FID_CDSKVRaty_C "IUPR group / component group for in-use performance monitoring of FID_CDSKVRaty" VALUE 0x804F51B6 Val_Wu8 14.0000000000 DIUMPR_GroupVerb 0.00 14.0000000000 FORMAT "%13.10" /end CHARACTERISTIC
/begin CHARACTERISTIC DIUMPR_Grp.FID_CDSTR_C "IUPR group / component group for in-use performance monitoring of FID_CDSTR" VALUE 0x804F51B7 Val_Wu8 14.0000000000 DIUMPR_GroupVerb 0.00 14.0000000000 FORMAT "%13.10" /end CHARACTERISTIC
/begin CHARACTERISTIC DIUMPR_Grp.FID_CETHSPLnpl_C "IUPR group / component group for in-use performance monitoring of FID_CETHSPLnpl" VALUE 0x804F51B8 Val_Wu8 14.0000000000 DIUMPR_GroupVerb 0.00 14.0000000000 FORMAT "%13.10" /end CHARACTERISTIC
/begin CHARACTERISTIC DIUMPR_Grp.FID_CETHSTPLnpl_C "IUPR group / component group for in-use performance monitoring of FID_CETHSTPLnpl" VALUE 0x804F51B9 Val_Wu8 14.0000000000 DIUMPR_GroupVerb 0.00 14.0000000000 FORMAT "%13.10" /end CHARACTERISTIC
/begin CHARACTERISTIC DIUMPR_Grp.FID_CETKHL_C "IUPR group / component group for in-use performance monitoring of FID_CETKHL" VALUE 0x804F51BA Val_Wu8 14.0000000000 DIUMPR_GroupVerb 0.00 14.0000000000 FORMAT "%13.10" /end CHARACTERISTIC
/begin CHARACTERISTIC DIUMPR_Grp.FID_CETKHT_C "IUPR group / component group for in-use performance monitoring of FID_CETKHT" VALUE 0x804F51BB Val_Wu8 14.0000000000 DIUMPR_GroupVerb 0.00 14.0000000000 FORMAT "%13.10" /end CHARACTERISTIC
/begin CHARACTERISTIC DIUMPR_Grp.FID_CGLSRDP_C "IUPR group / component group for in-use performance monitoring of FID_CGLSRDP" VALUE 0x804F51BC Val_Wu8 14.0000000000 DIUMPR_GroupVerb 0.00 14.0000000000 FORMAT "%13.10" /end CHARACTERISTIC
/begin CHARACTERISTIC DIUMPR_Grp.FID_CHDRKH_C "IUPR group / component group for in-use performance monitoring of FID_CHDRKH" VALUE 0x804F51BD Val_Wu8 14.0000000000 DIUMPR_GroupVerb 0.00 14.0000000000 FORMAT "%13.10" /end CHARACTERISTIC
/begin CHARACTERISTIC DIUMPR_Grp.FID_CLZSRDP_C "IUPR group / component group for in-use performance monitoring of FID_CLZSRDP" VALUE 0x804F51BE Val_Wu8 14.0000000000 DIUMPR_GroupVerb 0.00 14.0000000000 FORMAT "%13.10" /end CHARACTERISTIC
/begin CHARACTERISTIC DIUMPR_Grp.FID_CLZSRHP_C "IUPR group / component group for in-use performance monitoring of FID_CLZSRHP" VALUE 0x804F51BF Val_Wu8 14.0000000000 DIUMPR_GroupVerb 0.00 14.0000000000 FORMAT "%13.10" /end CHARACTERISTIC
/begin CHARACTERISTIC DIUMPR_Grp.FID_CPSRP_C "IUPR group / component group for in-use performance monitoring of FID_CPSRP" VALUE 0x804F51C0 Val_Wu8 14.0000000000 DIUMPR_GroupVerb 0.00 14.0000000000 FORMAT "%13.10" /end CHARACTERISTIC
/begin CHARACTERISTIC DIUMPR_Grp.FID_CTESF_C "IUPR group / component group for in-use performance monitoring of FID_CTESF" VALUE 0x804F51C1 Val_Wu8 14.0000000000 DIUMPR_GroupVerb 0.00 14.0000000000 FORMAT "%13.10" /end CHARACTERISTIC
/begin CHARACTERISTIC DIUMPR_Grp.FID_CTESG_C "IUPR group / component group for in-use performance monitoring of FID_CTESG" VALUE 0x804F51C2 Val_Wu8 14.0000000000 DIUMPR_GroupVerb 0.00 14.0000000000 FORMAT "%13.10" /end CHARACTERISTIC
/begin CHARACTERISTIC DIUMPR_Grp.FID_CTKACS_C "IUPR group / component group for in-use performance monitoring of FID_CTKACS" VALUE 0x804F51C3 Val_Wu8 14.0000000000 DIUMPR_GroupVerb 0.00 14.0000000000 FORMAT "%13.10" /end CHARACTERISTIC
/begin CHARACTERISTIC DIUMPR_Grp.FId_AfsPlausDiag_C "IUPR group / component group for in-use performance monitoring of FId_AfsPlausDiag" VALUE 0x804F51C4 Val_Wu8 14.0000000000 DIUMPR_GroupVerb 0.00 14.0000000000 FORMAT "%13.10" /end CHARACTERISTIC
/begin CHARACTERISTIC DIUMPR_Grp.FId_CEngDsTColdStrt_C "IUPR group / component group for in-use performance monitoring of FId_CEngDsTColdStrt" VALUE 0x804F51C5 Val_Wu8 14.0000000000 DIUMPR_GroupVerb 0.00 14.0000000000 FORMAT "%13.10" /end CHARACTERISTIC
/begin CHARACTERISTIC DIUMPR_Grp.FId_CEngDsTHSC_C "IUPR group / component group for in-use performance monitoring of FId_CEngDsTHSC" VALUE 0x804F51C6 Val_Wu8 14.0000000000 DIUMPR_GroupVerb 0.00 14.0000000000 FORMAT "%13.10" /end CHARACTERISTIC
/begin CHARACTERISTIC DIUMPR_Grp.FId_CEngDsTLSC_C "IUPR group / component group for in-use performance monitoring of FId_CEngDsTLSC" VALUE 0x804F51C7 Val_Wu8 14.0000000000 DIUMPR_GroupVerb 0.00 14.0000000000 FORMAT "%13.10" /end CHARACTERISTIC
/begin CHARACTERISTIC DIUMPR_Grp.FId_CEngDsTSTC_C "IUPR group / component group for in-use performance monitoring of FId_CEngDsTSTC" VALUE 0x804F51C8 Val_Wu8 14.0000000000 DIUMPR_GroupVerb 0.00 14.0000000000 FORMAT "%13.10" /end CHARACTERISTIC
/begin CHARACTERISTIC DIUMPR_Grp.FId_CEngUsTCrssChk_C "IUPR group / component group for in-use performance monitoring of FId_CEngUsTCrssChk" VALUE 0x804F51C9 Val_Wu8 14.0000000000 DIUMPR_GroupVerb 0.00 14.0000000000 FORMAT "%13.10" /end CHARACTERISTIC
/begin CHARACTERISTIC DIUMPR_Grp.FId_CInjCatHeatgDiag_C "IUPR group / component group for in-use performance monitoring of FId_CInjCatHeatgDiag" VALUE 0x804F51CA Val_Wu8 14.0000000000 DIUMPR_GroupVerb 0.00 14.0000000000 FORMAT "%13.10" /end CHARACTERISTIC
/begin CHARACTERISTIC DIUMPR_Grp.FId_DiagBlkdLine_C "IUPR group / component group for in-use performance monitoring of FId_DiagBlkdLine" VALUE 0x804F51CB Val_Wu8 14.0000000000 DIUMPR_GroupVerb 0.00 14.0000000000 FORMAT "%13.10" /end CHARACTERISTIC
/begin CHARACTERISTIC DIUMPR_Grp.FId_DiagCpv1DteskLoLoad_C "IUPR group / component group for in-use performance monitoring of FId_DiagCpv1DteskLoLoad" VALUE 0x804F51CC Val_Wu8 14.0000000000 DIUMPR_GroupVerb 0.00 14.0000000000 FORMAT "%13.10" /end CHARACTERISTIC
/begin CHARACTERISTIC DIUMPR_Grp.FId_EGSDUS2B1LtrDly_C "IUPR group / component group for in-use performance monitoring of FId_EGSDUS2B1LtrDly" VALUE 0x804F51CD Val_Wu8 14.0000000000 DIUMPR_GroupVerb 0.00 14.0000000000 FORMAT "%13.10" /end CHARACTERISTIC
/begin CHARACTERISTIC DIUMPR_Grp.FId_EGSDUS2B1LtrPT1_C "IUPR group / component group for in-use performance monitoring of FId_EGSDUS2B1LtrPT1" VALUE 0x804F51CE Val_Wu8 14.0000000000 DIUMPR_GroupVerb 0.00 14.0000000000 FORMAT "%13.10" /end CHARACTERISTIC
/begin CHARACTERISTIC DIUMPR_Grp.FId_EGSDUS2B1RtlDly_C "IUPR group / component group for in-use performance monitoring of FId_EGSDUS2B1RtlDly" VALUE 0x804F51CF Val_Wu8 14.0000000000 DIUMPR_GroupVerb 0.00 14.0000000000 FORMAT "%13.10" /end CHARACTERISTIC
/begin CHARACTERISTIC DIUMPR_Grp.FId_EGSDUS2B1RtlPT1_C "IUPR group / component group for in-use performance monitoring of FId_EGSDUS2B1RtlPT1" VALUE 0x804F51D0 Val_Wu8 14.0000000000 DIUMPR_GroupVerb 0.00 14.0000000000 FORMAT "%13.10" /end CHARACTERISTIC
/begin CHARACTERISTIC DIUMPR_Grp.FId_EGSDUS2B1TarLean_C "IUPR group / component group for in-use performance monitoring of FId_EGSDUS2B1TarLean" VALUE 0x804F51D1 Val_Wu8 14.0000000000 DIUMPR_GroupVerb 0.00 14.0000000000 FORMAT "%13.10" /end CHARACTERISTIC
/begin CHARACTERISTIC DIUMPR_Grp.FId_EGSDUS2B1TarRich_C "IUPR group / component group for in-use performance monitoring of FId_EGSDUS2B1TarRich" VALUE 0x804F51D2 Val_Wu8 14.0000000000 DIUMPR_GroupVerb 0.00 14.0000000000 FORMAT "%13.10" /end CHARACTERISTIC
/begin CHARACTERISTIC DIUMPR_Grp.FId_EpmCaSOfsErrCaSI1_C "IUPR group / component group for in-use performance monitoring of FId_EpmCaSOfsErrCaSI1" VALUE 0x804F51D3 Val_Wu8 14.0000000000 DIUMPR_GroupVerb 0.00 14.0000000000 FORMAT "%13.10" /end CHARACTERISTIC
/begin CHARACTERISTIC DIUMPR_Grp.FId_EtaEngIdleNonCsers_C "IUPR group / component group for in-use performance monitoring of FId_EtaEngIdleNonCsers" VALUE 0x804F51D4 Val_Wu8 14.0000000000 DIUMPR_GroupVerb 0.00 14.0000000000 FORMAT "%13.10" /end CHARACTERISTIC
/begin CHARACTERISTIC DIUMPR_Grp.FId_EtaEngPtlNonCsers_C "IUPR group / component group for in-use performance monitoring of FId_EtaEngPtlNonCsers" VALUE 0x804F51D5 Val_Wu8 14.0000000000 DIUMPR_GroupVerb 0.00 14.0000000000 FORMAT "%13.10" /end CHARACTERISTIC
/begin CHARACTERISTIC DIUMPR_Grp.FId_FlDevPlauDiagFuSnsr_C "IUPR group / component group for in-use performance monitoring of FId_FlDevPlauDiagFuSnsr" VALUE 0x804F51D6 Val_Wu8 14.0000000000 DIUMPR_GroupVerb 0.00 14.0000000000 FORMAT "%13.10" /end CHARACTERISTIC
/begin CHARACTERISTIC DIUMPR_Grp.FId_GEVlvLockPinDiagIntkB1_C "IUPR group / component group for in-use performance monitoring of FId_GEVlvLockPinDiagIntkB1" VALUE 0x804F51D7 Val_Wu8 14.0000000000 DIUMPR_GroupVerb 0.00 14.0000000000 FORMAT "%13.10" /end CHARACTERISTIC
/begin CHARACTERISTIC DIUMPR_Grp.FId_GEVlvPhaDiagEnaCsersIntkB1_C "IUPR group / component group for in-use performance monitoring of FId_GEVlvPhaDiagEnaCsersIntkB1" VALUE 0x804F51D8 Val_Wu8 14.0000000000 DIUMPR_GroupVerb 0.00 14.0000000000 FORMAT "%13.10" /end CHARACTERISTIC
/begin CHARACTERISTIC DIUMPR_Grp.FId_GEVlvPhaDiagEnaIntkB1_C "IUPR group / component group for in-use performance monitoring of FId_GEVlvPhaDiagEnaIntkB1" VALUE 0x804F51D9 Val_Wu8 14.0000000000 DIUMPR_GroupVerb 0.00 14.0000000000 FORMAT "%13.10" /end CHARACTERISTIC
/begin CHARACTERISTIC DIUMPR_Grp.FId_HEGOS2B1DHtg_C "IUPR group / component group for in-use performance monitoring of FId_HEGOS2B1DHtg" VALUE 0x804F51DA Val_Wu8 14.0000000000 DIUMPR_GroupVerb 0.00 14.0000000000 FORMAT "%13.10" /end CHARACTERISTIC
/begin CHARACTERISTIC DIUMPR_Grp.FId_InhbLamDynS1B1_C "IUPR group / component group for in-use performance monitoring of FId_InhbLamDynS1B1" VALUE 0x804F51DB Val_Wu8 14.0000000000 DIUMPR_GroupVerb 0.00 14.0000000000 FORMAT "%13.10" /end CHARACTERISTIC
/begin CHARACTERISTIC DIUMPR_Grp.FId_InjSysMulInjDiagErr_C "IUPR group / component group for in-use performance monitoring of FId_InjSysMulInjDiagErr" VALUE 0x804F51DC Val_Wu8 14.0000000000 DIUMPR_GroupVerb 0.00 14.0000000000 FORMAT "%13.10" /end CHARACTERISTIC
/begin CHARACTERISTIC DIUMPR_Grp.FId_IntkAirTAirFltDsCrssChk_C "IUPR group / component group for in-use performance monitoring of FId_IntkAirTAirFltDsCrssChk" VALUE 0x804F51DD Val_Wu8 14.0000000000 DIUMPR_GroupVerb 0.00 14.0000000000 FORMAT "%13.10" /end CHARACTERISTIC
/begin CHARACTERISTIC DIUMPR_Grp.FId_IntkAirTAirFltDsPlausChk_C "IUPR group / component group for in-use performance monitoring of FId_IntkAirTAirFltDsPlausChk" VALUE 0x804F51DE Val_Wu8 14.0000000000 DIUMPR_GroupVerb 0.00 14.0000000000 FORMAT "%13.10" /end CHARACTERISTIC
/begin CHARACTERISTIC DIUMPR_Grp.FId_IntkAirTIntkMnfldCrssChk_C "IUPR group / component group for in-use performance monitoring of FId_IntkAirTIntkMnfldCrssChk" VALUE 0x804F51DF Val_Wu8 14.0000000000 DIUMPR_GroupVerb 0.00 14.0000000000 FORMAT "%13.10" /end CHARACTERISTIC
/begin CHARACTERISTIC DIUMPR_Grp.FId_IntkAirTIntkMnfldPlausChk_C "IUPR group / component group for in-use performance monitoring of FId_IntkAirTIntkMnfldPlausChk" VALUE 0x804F51E0 Val_Wu8 14.0000000000 DIUMPR_GroupVerb 0.00 14.0000000000 FORMAT "%13.10" /end CHARACTERISTIC
/begin CHARACTERISTIC DIUMPR_Grp.FId_PEnvPlausDiagVDD_C "IUPR group / component group for in-use performance monitoring of FId_PEnvPlausDiagVDD" VALUE 0x804F51E1 Val_Wu8 14.0000000000 DIUMPR_GroupVerb 0.00 14.0000000000 FORMAT "%13.10" /end CHARACTERISTIC
/begin CHARACTERISTIC DIUMPR_Grp.FId_P_VSE11_Diag_C "IUPR group / component group for in-use performance monitoring of FId_P_VSE11_Diag" VALUE 0x804F51E2 Val_Wu8 14.0000000000 DIUMPR_GroupVerb 0.00 14.0000000000 FORMAT "%13.10" /end CHARACTERISTIC
/begin CHARACTERISTIC DIUMPR_Grp.FId_TWCDPriCatParB1_C "IUPR group / component group for in-use performance monitoring of FId_TWCDPriCatParB1" VALUE 0x804F51E3 Val_Wu8 14.0000000000 DIUMPR_GroupVerb 0.00 14.0000000000 FORMAT "%13.10" /end CHARACTERISTIC
/begin CHARACTERISTIC DIUMPR_Grp.FId_TiOffTBasdChkFast_C "IUPR group / component group for in-use performance monitoring of FId_TiOffTBasdChkFast" VALUE 0x804F51E4 Val_Wu8 14.0000000000 DIUMPR_GroupVerb 0.00 14.0000000000 FORMAT "%13.10" /end CHARACTERISTIC
/begin CHARACTERISTIC DIUMPR_Grp.FId_TiOffTBasdChkSlow_C "IUPR group / component group for in-use performance monitoring of FId_TiOffTBasdChkSlow" VALUE 0x804F51E5 Val_Wu8 14.0000000000 DIUMPR_GroupVerb 0.00 14.0000000000 FORMAT "%13.10" /end CHARACTERISTIC
/begin CHARACTERISTIC DIUMPR_Grp.FId_UEGOHeatrPrfmncDiagRelsS1B1_C "IUPR group / component group for in-use performance monitoring of FId_UEGOHeatrPrfmncDiagRelsS1B1" VALUE 0x804F51E6 Val_Wu8 14.0000000000 DIUMPR_GroupVerb 0.00 14.0000000000 FORMAT "%13.10" /end CHARACTERISTIC
/begin CHARACTERISTIC DIUMPR_Grp.FId_UEGOStrtDiagRelsS1B1_C "IUPR group / component group for in-use performance monitoring of FId_UEGOStrtDiagRelsS1B1" VALUE 0x804F51E7 Val_Wu8 14.0000000000 DIUMPR_GroupVerb 0.00 14.0000000000 FORMAT "%13.10" /end CHARACTERISTIC
/begin CHARACTERISTIC DIUMPR_Grp.FId_VlvLftFbSwtIntk11Diag_C "IUPR group / component group for in-use performance monitoring of FId_VlvLftFbSwtIntk11Diag" VALUE 0x804F51E8 Val_Wu8 14.0000000000 DIUMPR_GroupVerb 0.00 14.0000000000 FORMAT "%13.10" /end CHARACTERISTIC
/begin CHARACTERISTIC DIUMPR_tCldStrtDenCldStrtOfs_C "maximum difference between engine and ambient air temperature for coldstart detection at ColdStart Denominator" VALUE 0x804F51EA Val_Ws16 6553.500 Temp_Cels -3549.940 3003.560 FORMAT "%8.3" READ_ONLY /end CHARACTERISTIC
/begin CHARACTERISTIC DIUMPR_tCldStrtDenECTMax_C "maximum engine temperature for coldstart detection at ColdStart Denominator" VALUE 0x804F51EC Val_Ws16 6553.500 Temp_Cels -3549.940 3003.560 FORMAT "%8.3" READ_ONLY /end CHARACTERISTIC
/begin CHARACTERISTIC DIUMPR_tCldStrtOfs_C "maximum delta between ambient air temperature and engine temperature at engine start for cold start detection (Evap Denominator)" VALUE 0x804F51EE Val_Ws16 6553.500 Temp_Cels -3549.940 3003.560 FORMAT "%8.3" READ_ONLY /end CHARACTERISTIC
/begin CHARACTERISTIC DIUMPR_tEvapDenMax_C "maximum of ambient air temperatur and engine temperature for evaluation of cumulative time condition and cold start detection (Evap Denominator)" VALUE 0x804F51F0 Val_Ws16 6553.500 Temp_Cels -3549.940 3003.560 FORMAT "%8.3" READ_ONLY /end CHARACTERISTIC
/begin CHARACTERISTIC DIUMPR_tEvapDenMin_C "minimum of ambient air temperatur and engine temperature for evaluation of cumulative time condition and cold start detection (Evap Denominator)" VALUE 0x804F51F2 Val_Ws16 6553.500 Temp_Cels -3549.940 3003.560 FORMAT "%8.3" READ_ONLY /end CHARACTERISTIC
/begin CHARACTERISTIC DIUMPR_tiCldStrtDenEngStrtDelay_C "Time period after engine start to delay the cold start evaluation at ColdStart Denominator" VALUE 0x804F51F4 Val_Wu16 30.00000 DIUMPR_ti100ms 0.00 30.00000 FORMAT "%8.5" EXTENDED_LIMITS 0.00 6553.500 /end CHARACTERISTIC
/begin CHARACTERISTIC DIUMPR_tiEngStrtCum_C "Cumulative time since engine start necessary for evap denominator release" VALUE 0x804F51F6 Val_Wu16 6553.500 DIUMPR_ti100ms 0.00 6553.500 FORMAT "%8.3" READ_ONLY /end CHARACTERISTIC
/begin CHARACTERISTIC DIUMPR_tiEvapDenEngStrtDelay_C "Time period after engine start to delay the cold start evaluation" VALUE 0x804F51F8 Val_Wu16 30.00000 DIUMPR_ti100ms 0.00 30.00000 FORMAT "%8.5" EXTENDED_LIMITS 0.00 6553.500 /end CHARACTERISTIC
/begin CHARACTERISTIC DIUMPR_xSelTstrNumrInctLock_C "Numerator increment behavior when tester is connected. If set to LOCK, the numerator will not increment. If set to NO_LOCK the numerator will be incremented." VALUE 0x8058A9D0 Val_Wu8 1.00000000000 DIUMPR_xSelTstrNumrInctLock_C_Verbal 0.00 1.00000000000 FORMAT "%13.11" /end CHARACTERISTIC
/begin CHARACTERISTIC DKRSAM "threshold for number of errors knock control evaluation measuring window" VALUE 0x8053A992 RB_Val_Wu16 65535.00 dez 0.00 65535.00 FORMAT "%8.2" /end CHARACTERISTIC
/begin CHARACTERISTIC DKRSAS "threshold for number of errors knock control evaluation combustion" VALUE 0x8053A994 RB_Val_Wu16 65535.00 dez 0.00 65535.00 FORMAT "%8.2" /end CHARACTERISTIC
/begin CHARACTERISTIC DORAESTAB "Delta-ORA for setting of ""ORA-stable"" when diagnosis-threshold is reached" VALUE 0x8053AAAC RB_Val_Ws16 3071.953 rel_sw_b1536 -1536.000 1535.953 FORMAT "%8.3" /end CHARACTERISTIC
/begin CHARACTERISTIC DORASTAB "delta-ORA for setting of ""ORA stable""" VALUE 0x8053AAAE RB_Val_Ws16 3071.953 rel_sw_b1536 -1536.000 1535.953 FORMAT "%8.3" /end CHARACTERISTIC
/begin CHARACTERISTIC FlMA_stStabDetnDurnInc_C "Codeword to configure the extension of stability detection time" VALUE 0x8053AAB0 RB_Val_Wu8 255.0 dez 0.00 255.0 FORMAT "%5.1" /end CHARACTERISTIC
/begin CHARACTERISTIC FlMA_tiAddAdpnStabTstrReq_C "Monitoring duration for ORA during Line End Test for Honda" VALUE 0x8053AAB1 RB_Val_Wu8 51.00 t200msxs_ub_b51 0.00 51.00 FORMAT "%5.2" /end CHARACTERISTIC
/begin CHARACTERISTIC FRADN "lower fault detection value FRA" VALUE 0x8053AAB2 RB_Val_Wu16 1.999969 fak_uw_b2 0.00 1.999969 FORMAT "%8.6" /end CHARACTERISTIC
/begin CHARACTERISTIC FRADX "upper fault detection value FRA" VALUE 0x8053AAB4 RB_Val_Wu16 1.999969 fak_uw_b2 0.00 1.999969 FORMAT "%8.6" /end CHARACTERISTIC
/begin CHARACTERISTIC FuPHi_facRelMMaxPmpRateDiag_T "characteristic line of max. fuel mass for plausibility check of high-pressure-system" CURVE 0x8053A996 RB_Curve_S16_U16_Static 3071.953 rel_uw_b3072 0.00 3071.953 FORMAT "%8.3"
 /begin AXIS_DESCR STD_AXIS Epm_nEng EngN 6 -16384.00 16383.50 FORMAT "%8.2" DEPOSIT ABSOLUTE /end AXIS_DESCR
/end CHARACTERISTIC
/begin CHARACTERISTIC FuPHi_nPRailDiagCsersMin_C "Engine speed minimum threshold for rail pressure diagnostic of CSERS high pressure diagnosis" VALUE 0x8053AA48 RB_Val_Ws16 32767.50 EngN -16384.00 16383.50 FORMAT "%8.2" /end CHARACTERISTIC
/begin CHARACTERISTIC FuPHi_pLimpNegGrdtLim_M "Map for the limitation of the negative pressure gradient at the transition to limp mode" MAP 0x8053A9B0 RB_Map_S16U16_U16 131.0700 RBPtCel_p_0p002_1 0.00 131.0700 FORMAT "%8.4"
 /begin AXIS_DESCR STD_AXIS Epm_nEng EngN 4 -16384.00 16383.50 FORMAT "%8.2" DEPOSIT ABSOLUTE /end AXIS_DESCR
 /begin AXIS_DESCR STD_AXIS rkvmeeffsel_w rel_uw_b3072 4 0.00 3071.953 FORMAT "%8.3" DEPOSIT ABSOLUTE /end AXIS_DESCR
/end CHARACTERISTIC
/begin CHARACTERISTIC FuPHi_pLimpPosGrdtLim_T "Table for the limitation of the positive pressure gradient at the transition to limp mode" CURVE 0x8053A9E4 RB_Curve_S16_U16_Static 131.0700 RBPtCel_p_0p002_1 0.00 131.0700 FORMAT "%8.4"
 /begin AXIS_DESCR STD_AXIS Epm_nEng EngN 5 -16384.00 16383.50 FORMAT "%8.2" DEPOSIT ABSOLUTE /end AXIS_DESCR
/end CHARACTERISTIC
/begin CHARACTERISTIC FuPHi_pMaxErrHDRKH_C "threshold maximum error HDRKH" VALUE 0x8053AA4A RB_Val_Ws16 65.53600 RBPtCel_p_0p002_1 -65.53600 0.00 FORMAT "%8.5" EXTENDED_LIMITS -65.53600 65.53400 /end CHARACTERISTIC
/begin CHARACTERISTIC FuPHi_pMaxErrHDR_C "threshold maximum error HDR" VALUE 0x8053AA4C RB_Val_Ws16 65.53600 RBPtCel_p_0p002_1 -65.53600 0.00 FORMAT "%8.5" EXTENDED_LIMITS -65.53600 65.53400 /end CHARACTERISTIC
/begin CHARACTERISTIC FuPHi_pMaxFailrHDRPlaus_C "threshold maximum failure HDR plausibel" VALUE 0x8053AA4E RB_Val_Ws16 65.53400 RBPtCel_p_0p002_1 0.00 65.53400 FORMAT "%8.5" EXTENDED_LIMITS -65.53600 65.53400 /end CHARACTERISTIC
/begin CHARACTERISTIC FuPHi_pMaxLimExcddErr_C "The Limit exceeded maximum error" VALUE 0x8053AA50 RB_Val_Wu16 131.0700 RBPtCel_p_0p002_1 0.00 131.0700 FORMAT "%8.4" /end CHARACTERISTIC
/begin CHARACTERISTIC FuPHi_pMaxRailSpLimp_C "Maximum setpoint rail pressure in limp home mode" VALUE 0x8053A9FA RB_Val_Wu16 131.0700 RBPtCel_p_0p002_1 0.00 131.0700 FORMAT "%8.4" /end CHARACTERISTIC
/begin CHARACTERISTIC FuPHi_pMinErrHDRKH_C "threshold minimum error HDRKH" VALUE 0x8053AA52 RB_Val_Ws16 65.53400 RBPtCel_p_0p002_1 0.00 65.53400 FORMAT "%8.5" EXTENDED_LIMITS -65.53600 65.53400 /end CHARACTERISTIC
/begin CHARACTERISTIC FuPHi_pMinErrHDR_C "threshold minimum error HDR" VALUE 0x8053AA54 RB_Val_Ws16 65.53400 RBPtCel_p_0p002_1 0.00 65.53400 FORMAT "%8.5" EXTENDED_LIMITS -65.53600 65.53400 /end CHARACTERISTIC
/begin CHARACTERISTIC FuPHi_pMinFailrHDRPlaus_C "threshold minimum failure HDR plausibel" VALUE 0x8053AA56 RB_Val_Ws16 65.53600 RBPtCel_p_0p002_1 -65.53600 0.00 FORMAT "%8.5" EXTENDED_LIMITS -65.53600 65.53400 /end CHARACTERISTIC
/begin CHARACTERISTIC FuPHi_pMinPInjCmprnStk_C "Minimum pressure for injections in the compression stroke" VALUE 0x8053A9FC RB_Val_Wu16 131.0700 RBPtCel_p_0p002_1 0.00 131.0700 FORMAT "%8.4" /end CHARACTERISTIC
/begin CHARACTERISTIC FuPHi_pRailDiagCsersDynDeltaRng_C "Threshold for dynamic delta rail pressure setpoint of CSERS high pressure diagnosis" VALUE 0x8053AA58 RB_Val_Wu16 131.0700 RBPtCel_p_0p002_1 0.00 131.0700 FORMAT "%8.4" /end CHARACTERISTIC
/begin CHARACTERISTIC FuPHi_pRailDiagCsersMax_C "Maximum set pressure value for rail pressure diagnostic of CSERS high pressure diagnosis" VALUE 0x8053AA5A RB_Val_Wu16 131.0700 RBPtCel_p_0p002_1 0.00 131.0700 FORMAT "%8.4" /end CHARACTERISTIC
/begin CHARACTERISTIC FuPHi_pRailDiagCsersMin_C "Minimum set pressure value for rail pressure diagnostic of CSERS high pressure diagnosis" VALUE 0x8053AA5C RB_Val_Wu16 131.0700 RBPtCel_p_0p002_1 0.00 131.0700 FORMAT "%8.4" /end CHARACTERISTIC
/begin CHARACTERISTIC FuPHi_pRailSensBkup_M "Backup-value for rail-pressure sensor" MAP 0x8053A9FE RB_Map_S16U16_U16 131.0700 RBPtCel_p_0p002_1 0.00 131.0700 FORMAT "%8.4"
 /begin AXIS_DESCR STD_AXIS Epm_nEng EngN 4 -16384.00 16383.50 FORMAT "%8.2" DEPOSIT ABSOLUTE /end AXIS_DESCR
 /begin AXIS_DESCR STD_AXIS rkvmeeffsel_w rel_uw_b3072 3 0.00 3071.953 FORMAT "%8.3" DEPOSIT ABSOLUTE /end AXIS_DESCR
/end CHARACTERISTIC
/begin CHARACTERISTIC FuPHi_pRlThresActvLimp_C "threshold for rail pressure to activate limp home mode high rail pressure" VALUE 0x8053AA28 RB_Val_Wu16 131.0700 RBPtCel_p_0p002_1 0.00 131.0700 FORMAT "%8.4" /end CHARACTERISTIC
/begin CHARACTERISTIC FuPHi_pSpFuTemp_T "characteristic line setpoint pressure limitation dep. on fuel temperature" CURVE 0x8053AA2A RB_Curve_U8_U16_Static 131.0700 RBPtCel_p_0p002_1 0.00 131.0700 FORMAT "%8.4"
 /begin AXIS_DESCR STD_AXIS tprmxout temp_ub_q0p75_o48 3 -48.0 143.3 FORMAT "%5.1" DEPOSIT ABSOLUTE /end AXIS_DESCR
/end CHARACTERISTIC
/begin CHARACTERISTIC FuPHi_stCfgDiagCsersPlaus_C "Codeword for configuration of CSERS above and beyond features within high pressure diagnosis" VALUE 0x8053AA5E RB_Val_Wu8 255.0 dez 0.00 255.0 FORMAT "%5.1" /end CHARACTERISTIC
/begin CHARACTERISTIC FuPHi_tBattMaxMSV_C "Maximum time threshold allowed battery voltage control Mass Flow Valve" VALUE 0x8053AA34 RB_Val_Wu16 1310.700 t_q0p02 0.00 1310.700 FORMAT "%8.3" /end CHARACTERISTIC
/begin CHARACTERISTIC FuPHi_tiDebPRailDiagCsersDynDelta_C "Debounce time for dynamic delta rail pressure of CSERS high pressure diagnosis" VALUE 0x8053AA60 RB_Val_Wu16 1310.700 t_q0p02 0.00 1310.700 FORMAT "%8.3" /end CHARACTERISTIC
/begin CHARACTERISTIC FuPHi_tiDebPRailDiagCsers_C "Debounce time for rail pressure setpoint range condition of CSERS high pressure diagnosis" VALUE 0x8053AA62 RB_Val_Wu16 1310.700 t_q0p02 0.00 1310.700 FORMAT "%8.3" /end CHARACTERISTIC
/begin CHARACTERISTIC FuPHi_tiTnPRailDiagCsersDynDelta_C "Time constant for filtering rail pressure setpoint of CSERS high pressure diagnosis" VALUE 0x8053AA64 RB_Val_Wu16 1310.6999997 zk20msxs_uw_b1310 0.0200003 1310.7200000 FORMAT "%12.7" EXTENDED_LIMITS 0.020000305180 1310.7200000 /end CHARACTERISTIC
/begin CHARACTERISTIC FuPHi_tPRailDiagCsersMin_C "Engine temperature minimum threshold for rail pressure diagnostic of CSERS high pressure diagnosis" VALUE 0x8053AA66 RB_Val_Ws16 6553.500 Temp_Cels -3549.940 3003.560 FORMAT "%8.3" /end CHARACTERISTIC
/begin CHARACTERISTIC FuPHi_uBattMaxMSV_C "Maximum allowed battery voltage control Mass Flow Valve" VALUE 0x8053AA36 RB_Val_Ws16 1310700. Volt_Batt -655360.0 655340.0 FORMAT "%8.1" /end CHARACTERISTIC
/begin CHARACTERISTIC HiPSys_tiDlyHiPMaxLimExcddErr_C "debouncing time for activating limp home with high rail pressures" VALUE 0x8053AA68 RB_Val_Wu8 25.50 t100msxs_ub_b25p5 0.00 25.50 FORMAT "%5.2" /end CHARACTERISTIC
/begin CHARACTERISTIC IKCtl_facDgnsLowrThd_GT "lower threshold for knocksensor diagnosis" CURVE 0x8053A936 RB_CurveGroup_U16 25.59961 spg_q3p906Em4_V_ms 0.00 25.59961 FORMAT "%8.5"
 /begin AXIS_DESCR COM_AXIS Epm_nEng EngN 13 -16384.00 16383.50 FORMAT "%8.2" AXIS_PTS_REF IKCtl_nEngVar13_X_AX /end AXIS_DESCR
/end CHARACTERISTIC
/begin CHARACTERISTIC IKCtl_facDgnsUpprThd_GT "upper engine speed threshold for knocksensor diagnosis" CURVE 0x8053A950 RB_CurveGroup_U16 25.59961 spg_q3p906Em4_V_ms 0.00 25.59961 FORMAT "%8.5"
 /begin AXIS_DESCR COM_AXIS Epm_nEng EngN 13 -16384.00 16383.50 FORMAT "%8.2" AXIS_PTS_REF IKCtl_nEngVar13_X_AX /end AXIS_DESCR
/end CHARACTERISTIC
/begin CHARACTERISTIC IKCtl_facNDiagMax "upper diagnostic threshold for knock-sensor diagnosis" VALUE 0x8053A96A RB_Val_Ws16 32767.50 EngN -16384.00 16383.50 FORMAT "%8.2" /end CHARACTERISTIC
/begin CHARACTERISTIC IKCtl_facNDiagMin "lower diagnostic threshold for knock-sensor diagnosis" VALUE 0x8053A96C RB_Val_Ws16 32767.50 EngN -16384.00 16383.50 FORMAT "%8.2" /end CHARACTERISTIC
/begin AXIS_PTS IKCtl_nEngVar13_X_AX "KC: Datapoint distribution engine speed of group A" 0x80557300 Epm_nEng RB_Axis_S16 32767.50 EngN 13 -16384.00 16383.50 FORMAT "%8.2" DEPOSIT ABSOLUTE /end AXIS_PTS
/begin CHARACTERISTIC IKCtl_nLowrThdDiag "lower engine speed threshold for knock-sensor lose fit detection" VALUE 0x8053A96E RB_Val_Ws16 32767.50 EngN -16384.00 16383.50 FORMAT "%8.2" /end CHARACTERISTIC
/begin CHARACTERISTIC IKCtl_nUpprThdDiag "upper engine speed threshold for knock-sensor lose fit detection" VALUE 0x8053A970 RB_Val_Ws16 32767.50 EngN -16384.00 16383.50 FORMAT "%8.2" /end CHARACTERISTIC
/begin CHARACTERISTIC IKCtl_uThdLooseCnctnDiag "Reference voltage threshold for diagnosis of knock sensor loose fit detection." CURVE 0x8053A972 RB_CurveGroup_U16 25.59961 spg_q3p906Em4_V_ms 0.00 25.59961 FORMAT "%8.5"
 /begin AXIS_DESCR COM_AXIS Epm_nEng EngN 13 -16384.00 16383.50 FORMAT "%8.2" AXIS_PTS_REF IKCtl_nEngVar13_X_AX /end AXIS_DESCR
/end CHARACTERISTIC
/begin CHARACTERISTIC KLHDRMNRL "charcteristic curve for debouncing hdr min error" CURVE 0x8053AA6A RB_Curve_U16_U16 1310.700 t_q0p02 0.00 1310.700 FORMAT "%8.3"
 /begin AXIS_DESCR STD_AXIS rl_w_msg rel_uw_q0p0234 5 0.00 1535.977 FORMAT "%8.3" DEPOSIT ABSOLUTE /end AXIS_DESCR
/end CHARACTERISTIC
/begin CHARACTERISTIC KRFHKS "fault frequency - knock sensors" VALUE 0x8053A98C RB_Val_Wu8 255.0 dez 0.00 255.0 FORMAT "%5.1" /end CHARACTERISTIC
/begin CHARACTERISTIC KRZYLDIAG "Selection of (noisy) cylinders for KS-diagnosis" VALUE 0x8053A98D RB_Val_Wu8 255.0 dez 0.00 255.0 FORMAT "%5.1" /end CHARACTERISTIC
/begin CHARACTERISTIC NMAXNLHP "engine speed limit in case of too high rail pressures" VALUE 0x8053AA38 RB_Val_Wu16 16383.75 nmot_uw_q0p25 0.00 16383.75 FORMAT "%8.2" /end CHARACTERISTIC
/begin CHARACTERISTIC NMAXNLLP "engine speed limit in case of a insufficient rail pressure" VALUE 0x8053AA3A RB_Val_Wu16 16383.75 nmot_uw_q0p25 0.00 16383.75 FORMAT "%8.2" /end CHARACTERISTIC
/begin CHARACTERISTIC ORADN "lower threshold for diagnosis of additive correction" VALUE 0x8053AAB6 RB_Val_Ws16 3071.953 rel_sw_b1536 -1536.000 1535.953 FORMAT "%8.3" /end CHARACTERISTIC
/begin CHARACTERISTIC ORADX "upper threshold for diagnosis of additive correction" VALUE 0x8053AAB8 RB_Val_Ws16 3071.953 rel_sw_b1536 -1536.000 1535.953 FORMAT "%8.3" /end CHARACTERISTIC
/begin CHARACTERISTIC RKMNHDP "Min. required fuel mass for plausibility check of high-pressure-system" VALUE 0x8053AA3C RB_Val_Wu16 3071.953 rel_uw_b3072 0.00 3071.953 FORMAT "%8.3" /end CHARACTERISTIC
/begin CHARACTERISTIC SDFRA "Threshold to reset stability of ora in case of change frai" VALUE 0x8053AABA RB_Val_Wu16 1.999969 fak_uw_b2 0.00 1.999969 FORMAT "%8.6" /end CHARACTERISTIC
/begin CHARACTERISTIC SDFRAINIT "Threshold to reset stability of ora in case of change frai after reset of adaptation values" VALUE 0x8053AABC RB_Val_Wu16 1.999969 fak_uw_b2 0.00 1.999969 FORMAT "%8.6" /end CHARACTERISTIC
/begin CHARACTERISTIC SDORA "Threshold to reset stability of fra in case of change ora" VALUE 0x8053AABE RB_Val_Ws16 3071.953 rel_sw_b1536 -1536.000 1535.953 FORMAT "%8.3" /end CHARACTERISTIC
/begin CHARACTERISTIC SDORAINIT "Threshold to reset stability of fra in case of change ora after reset of adaptation values" VALUE 0x8053AAC0 RB_Val_Ws16 3071.953 rel_sw_b1536 -1536.000 1535.953 FORMAT "%8.3" /end CHARACTERISTIC
/begin CHARACTERISTIC TDHDRH "Time constant healing debounce E_HDR" VALUE 0x8053AA80 RB_Val_Wu16 1310.700 t_q0p02 0.00 1310.700 FORMAT "%8.3" /end CHARACTERISTIC
/begin CHARACTERISTIC TDHDRKHH "Time constant healing debounce E_HDRKH" VALUE 0x8053AA82 RB_Val_Wu16 1310.700 t_q0p02 0.00 1310.700 FORMAT "%8.3" /end CHARACTERISTIC
/begin CHARACTERISTIC TDHDRKHMN "Time constant fault debounce min-error HDRKH" VALUE 0x8053AA84 RB_Val_Wu16 1310.700 t_q0p02 0.00 1310.700 FORMAT "%8.3" /end CHARACTERISTIC
/begin CHARACTERISTIC TDHDRKHMX "Time constant fault debounce max-error HDRKH" VALUE 0x8053AA86 RB_Val_Wu16 1310.700 t_q0p02 0.00 1310.700 FORMAT "%8.3" /end CHARACTERISTIC
/begin CHARACTERISTIC TDHDRMN "Time constant fault debounce min-error HDR" VALUE 0x8053AA88 RB_Val_Wu16 1310.700 t_q0p02 0.00 1310.700 FORMAT "%8.3" /end CHARACTERISTIC
/begin CHARACTERISTIC TDHDRMNTAL "Debouncing time min-error HDR when tank level is low" VALUE 0x8053AA8A RB_Val_Wu16 1310.700 t_q0p02 0.00 1310.700 FORMAT "%8.3" /end CHARACTERISTIC
/begin CHARACTERISTIC TDHDRMX "Time constant fault debounce max-error HDR" VALUE 0x8053AA8C RB_Val_Wu16 1310.700 t_q0p02 0.00 1310.700 FORMAT "%8.3" /end CHARACTERISTIC
/begin CHARACTERISTIC TDHDRPLH "Time constant healing debounce E_hdrpl" VALUE 0x8053AA8E RB_Val_Wu16 1310.700 t_q0p02 0.00 1310.700 FORMAT "%8.3" /end CHARACTERISTIC
/begin CHARACTERISTIC TDHDRPLMN "Time constant fault debounce min-error HDRPL" VALUE 0x8053AA90 RB_Val_Wu16 1310.700 t_q0p02 0.00 1310.700 FORMAT "%8.3" /end CHARACTERISTIC
/begin CHARACTERISTIC TDHDRPLMX "Time constant fault debounce max-error HDRPL" VALUE 0x8053AA92 RB_Val_Wu16 1310.700 t_q0p02 0.00 1310.700 FORMAT "%8.3" /end CHARACTERISTIC
/begin CHARACTERISTIC TDHDRPLTAL "Debouncing time max-error HDRPL when tank level is low" VALUE 0x8053AA94 RB_Val_Wu16 1310.700 t_q0p02 0.00 1310.700 FORMAT "%8.3" /end CHARACTERISTIC
/begin CHARACTERISTIC TDNLHP "debouncing time for activating limp home with high rail pressures" VALUE 0x8053AA3E RB_Val_Wu8 25.50 t100msxs_ub_b25p5 0.00 25.50 FORMAT "%5.2" /end CHARACTERISTIC
/begin CHARACTERISTIC TEFRA "Detection time for ""FRA stable"" by exceed of diagnostic threshold" VALUE 0x8053AAC2 RB_Val_Wu8 51.00 t200msxs_ub_b51 0.00 51.00 FORMAT "%5.2" /end CHARACTERISTIC
/begin CHARACTERISTIC TEHLPKS "Debounce counter value for knock sensor loose fit detection." VALUE 0x8053A98E RB_Val_Wu8 255.0 dez 0.00 255.0 FORMAT "%5.1" /end CHARACTERISTIC
/begin CHARACTERISTIC TEORA "Detection time for ""ORA stable"" by exceed of diagnostic threshold" VALUE 0x8053AAC3 RB_Val_Wu8 51.00 t200msxs_ub_b51 0.00 51.00 FORMAT "%5.2" /end CHARACTERISTIC
/begin CHARACTERISTIC TFPRDIFF "Time constant filter of control deviation high-pressure control" VALUE 0x8053AA96 RB_Val_Wu16 1310.6999997 zk20msxs_uw_b1310 0.0200003 1310.7200000 FORMAT "%12.7" EXTENDED_LIMITS 0.020000305180 1310.7200000 /end CHARACTERISTIC
/begin CHARACTERISTIC TFPRDR "Time constant filter of rail pressure controller output" VALUE 0x8053AA98 RB_Val_Wu16 1310.6999997 zk20msxs_uw_b1310 0.0200003 1310.7200000 FORMAT "%12.7" EXTENDED_LIMITS 0.020000305180 1310.7200000 /end CHARACTERISTIC
/begin CHARACTERISTIC TFPRMAXTF "time constant for low pass filter of setpoint pressure limitation dep. on fuel temperature" VALUE 0x8053AA40 RB_Val_Wu16 6553.4999985 zk100msxs_uw_b6553p6 0.1000015 6553.6000000 FORMAT "%12.7" EXTENDED_LIMITS 0.10000152590 6553.6000000 /end CHARACTERISTIC
/begin CHARACTERISTIC TFRA "monitoring duration sufficient for fra" VALUE 0x8053AAC4 RB_Val_Wu8 51.00 t200msxs_ub_b51 0.00 51.00 FORMAT "%5.2" /end CHARACTERISTIC
/begin CHARACTERISTIC TLRASTMN "Minimum time for partial intervalto detect stability frai and ora" VALUE 0x8053AAC5 RB_Val_Wu8 51.00 t200msxs_ub_b51 0.00 51.00 FORMAT "%5.2" /end CHARACTERISTIC
/begin CHARACTERISTIC TNSTPRMX "Time threshold for end of pressure limitation due to tightness o-rings connection rail-injector" VALUE 0x8053AA42 RB_Val_Wu16 6553.500 t100msxs_uw_b6553p5 0.00 6553.500 FORMAT "%8.3" /end CHARACTERISTIC
/begin CHARACTERISTIC TOFEORAFFR "debounce time for reset of preliminary ORA-FreezeFrame" VALUE 0x8053AACA RB_Val_Wu8 51.00 t_q0p2 0.00 51.00 FORMAT "%5.2" /end CHARACTERISTIC
/begin CHARACTERISTIC TORA "monitoring duration sufficient for ora" VALUE 0x8053AAC6 RB_Val_Wu8 51.00 t200msxs_ub_b51 0.00 51.00 FORMAT "%5.2" /end CHARACTERISTIC
/begin CHARACTERISTIC TORAINIT "min. stabalization time of ""ORA stabil"" after reset of adaptation values" VALUE 0x8053AAC7 RB_Val_Wu8 51.00 t200msxs_ub_b51 0.00 51.00 FORMAT "%5.2" /end CHARACTERISTIC
/begin CHARACTERISTIC TSPRMX "temperature threshold for pressure limitation due to tightness o-rings connection rail-injector" VALUE 0x8053AA44 RB_Val_Wu8 191.3 temp_ub_q0p75_o48 -48.0 143.3 FORMAT "%5.1" /end CHARACTERISTIC
/begin CHARACTERISTIC TSPRMXO "Temperature threshold for end of pressure limitation due to tightness o-rings connection rail-injector" VALUE 0x8053AA45 RB_Val_Wu8 191.3 temp_ub_q0p75_o48 -48.0 143.3 FORMAT "%5.1" /end CHARACTERISTIC
/begin CHARACTERISTIC TVHDRAKT "time delay after end of start for enabling the high pressure diagnostic" VALUE 0x8053AA9A RB_Val_Wu16 6553.500 t_q0p1 0.00 6553.500 FORMAT "%8.3" /end CHARACTERISTIC
/begin CHARACTERISTIC TVHDRAKTKH "time delay after end of start for enabling the csers high pressure diagnostic" VALUE 0x8053AA9C RB_Val_Wu16 6553.500 t_q0p1 0.00 6553.500 FORMAT "%8.3" /end CHARACTERISTIC
/begin CHARACTERISTIC TVHDRESET "time delay after reset of inhibit conditions for enabling high pressure diagnistic" VALUE 0x8053AA9E RB_Val_Wu16 1310.700 t_q0p02 0.00 1310.700 FORMAT "%8.3" /end CHARACTERISTIC
/begin CHARACTERISTIC TVHDRKHRES "time delay after release of high pressure controller for enabling cold start hdr diagnostic" VALUE 0x8053AAA0 RB_Val_Wu16 1310.700 t_q0p02 0.00 1310.700 FORMAT "%8.3" /end CHARACTERISTIC
/begin CHARACTERISTIC TVHDRRES "time delay after release of high pressure controller for enabling high pressure diagnistic" VALUE 0x8053AAA2 RB_Val_Wu16 1310.700 t_q0p02 0.00 1310.700 FORMAT "%8.3" /end CHARACTERISTIC
/begin CHARACTERISTIC ZKDFRM "Time constant for Lowpass of dfrm_w" VALUE 0x8053AAC8 RB_Val_Wu16 13106.999997 zk200msxs_uw_b13107p2 0.200003 13107.200000 FORMAT "%12.6" EXTENDED_LIMITS 0.20000305180 13107.200000 /end CHARACTERISTIC
/begin MEASUREMENT B_dksc_msg "kc: sensor lose fit detection active" UBYTE B_TRUE 1 100 0.00 1.00000000000 BIT_MASK 0x1 FORMAT "%13.11" ECU_ADDRESS 0x70000C0C /end MEASUREMENT
/begin MEASUREMENT B_dkvbdepl_msg "condition plausibility check fuel supply system on" UBYTE B_TRUE 1 100 0.00 1.00000000000 BIT_MASK 0x1 FORMAT "%13.11" ECU_ADDRESS 0x600013FB /end MEASUREMENT
/begin MEASUREMENT B_ds2 "sensor diagnosis active, lower threshold" UBYTE B_TRUE 1 100 0.00 1.00000000000 BIT_MASK 0x1 FORMAT "%13.11" ECU_ADDRESS 0x70000376 /end MEASUREMENT
/begin MEASUREMENT B_edkvs_msg "condition for adaption fault thresholds momentarily exceeded" UBYTE B_TRUE 1 100 0.00 1.00000000000 BIT_MASK 0x1 FORMAT "%13.11" ECU_ADDRESS 0x70000BFA /end MEASUREMENT
/begin MEASUREMENT B_efmn "Condition lower diagnostic thresholds of multiplicative correction currently exceeded" UBYTE B_TRUE 1 100 0.00 1.00000000000 BIT_MASK 0x1 FORMAT "%13.11" ECU_ADDRESS 0x7000036E /end MEASUREMENT
/begin MEASUREMENT B_efmx "Condition upper diagnostic thresholds of multiplicative correction currently exceeded" UBYTE B_TRUE 1 100 0.00 1.00000000000 BIT_MASK 0x1 FORMAT "%13.11" ECU_ADDRESS 0x7000036D /end MEASUREMENT
/begin MEASUREMENT B_eframax_msg "Condition upper diagnostic thresholds of multiplicative correction currently exceeded" UBYTE B_TRUE 1 100 0.00 1.00000000000 BIT_MASK 0x1 FORMAT "%13.11" ECU_ADDRESS 0x70000BF6 /end MEASUREMENT
/begin MEASUREMENT B_eframin_msg "Condition lower diagnostic thresholds of multiplicative correction currently exceeded" UBYTE B_TRUE 1 100 0.00 1.00000000000 BIT_MASK 0x1 FORMAT "%13.11" ECU_ADDRESS 0x70000BF5 /end MEASUREMENT
/begin MEASUREMENT B_efra_msg "Condition diagnostic thresholds of multiplicative correction currently exceeded" UBYTE B_TRUE 1 100 0.00 1.00000000000 BIT_MASK 0x1 FORMAT "%13.11" ECU_ADDRESS 0x70000BF7 /end MEASUREMENT
/begin MEASUREMENT B_eomn "Condition lower diagnostic thresholds of additive correction actually exceeded" UBYTE B_TRUE 1 100 0.00 1.00000000000 BIT_MASK 0x1 FORMAT "%13.11" ECU_ADDRESS 0x7000036C /end MEASUREMENT
/begin MEASUREMENT B_eomx "Condition upper diagnostic thresholds of additive correction actually exceeded" UBYTE B_TRUE 1 100 0.00 1.00000000000 BIT_MASK 0x1 FORMAT "%13.11" ECU_ADDRESS 0x7000036B /end MEASUREMENT
/begin MEASUREMENT B_eoramax_msg "Condition upper diagnostic thresholds of additive correction actually exceeded" UBYTE B_TRUE 1 100 0.00 1.00000000000 BIT_MASK 0x1 FORMAT "%13.11" ECU_ADDRESS 0x70000BE8 /end MEASUREMENT
/begin MEASUREMENT B_eoramin_msg "Condition lower diagnostic thresholds of additive correction actually exceeded" UBYTE B_TRUE 1 100 0.00 1.00000000000 BIT_MASK 0x1 FORMAT "%13.11" ECU_ADDRESS 0x70000BE7 /end MEASUREMENT
/begin MEASUREMENT B_eora_msg "Condition diagnostic thresholds of additive correction actually exeeded" UBYTE B_TRUE 1 100 0.00 1.00000000000 BIT_MASK 0x1 FORMAT "%13.11" ECU_ADDRESS 0x70000BE9 /end MEASUREMENT
/begin MEASUREMENT B_eprail_msg "condition rail pressure error: enable torque limitation" UBYTE B_TRUE 1 100 0.00 1.00000000000 BIT_MASK 0x1 FORMAT "%13.11" ECU_ADDRESS 0x600013E6 /end MEASUREMENT
/begin MEASUREMENT B_fdgser_msg "FRA deviation exceeds the threshold SDFRA" UBYTE B_TRUE 1 100 0.00 1.00000000000 BIT_MASK 0x1 FORMAT "%13.11" ECU_ADDRESS 0x70000BC7 /end MEASUREMENT
/begin MEASUREMENT B_frast "Condition: last change of multipl. mixture correction smaller than threshold" UBYTE B_TRUE 1 100 0.00 1.00000000000 BIT_MASK 0x1 FORMAT "%13.11" ECU_ADDRESS 0x7000036A /end MEASUREMENT
/begin MEASUREMENT B_frastab_msg "Condition: FRA(multiplicative correction of mixture adaptation) integrator (local) stable" UBYTE B_TRUE 1 100 0.00 1.00000000000 BIT_MASK 0x1 FORMAT "%13.11" ECU_ADDRESS 0x70000BBD /end MEASUREMENT
/begin MEASUREMENT B_fstabzs_msg "Condition: B_frastab was set" UBYTE B_TRUE 1 100 0.00 1.00000000000 BIT_MASK 0x1 FORMAT "%13.11" ECU_ADDRESS 0x70000BB8 /end MEASUREMENT
/begin MEASUREMENT B_gaefra_msg "condition for fra portion of adaptive Lambda pilot control successful" UBYTE B_TRUE 1 100 0.00 1.00000000000 BIT_MASK 0x1 FORMAT "%13.11" ECU_ADDRESS 0x60036E27 /end MEASUREMENT
/begin MEASUREMENT B_gaeing_msg "condition basic adaption Bank 1 steady state" UBYTE B_TRUE 1 100 0.00 1.00000000000 BIT_MASK 0x1 FORMAT "%13.11" ECU_ADDRESS 0x60036E26 /end MEASUREMENT
/begin MEASUREMENT B_gaeora_msg "ORA adaptation stabilized since last reset (NV)" UBYTE B_TRUE 1 100 0.00 1.00000000000 BIT_MASK 0x1 FORMAT "%13.11" ECU_ADDRESS 0x60036E24 /end MEASUREMENT
/begin MEASUREMENT B_gae_msg "condition for adaptive Lambda pilot control successful" UBYTE B_TRUE 1 100 0.00 1.00000000000 BIT_MASK 0x1 FORMAT "%13.11" ECU_ADDRESS 0x70000BB3 /end MEASUREMENT
/begin MEASUREMENT B_hdpoff_msg "condition disable flow of high pressure pump" UBYTE B_TRUE 1 100 0.00 1.00000000000 BIT_MASK 0x1 FORMAT "%13.11" ECU_ADDRESS 0x600014F7 /end MEASUREMENT
/begin MEASUREMENT B_hdrakt_msg "Condition to enabel high pressure error path" UBYTE B_TRUE 1 100 0.00 1.00000000000 BIT_MASK 0x1 FORMAT "%13.11" ECU_ADDRESS 0x600014F6 /end MEASUREMENT
/begin MEASUREMENT B_hdrkhakt_msg "condition diagnosis hdrkh is active during catalyst heating" UBYTE B_TRUE 1 100 0.00 1.00000000000 BIT_MASK 0x1 FORMAT "%13.11" ECU_ADDRESS 0x600014F5 /end MEASUREMENT
/begin MEASUREMENT B_hdrplakt_msg "Condition enable plausibility chec of high pressure error path" UBYTE B_TRUE 1 100 0.00 1.00000000000 BIT_MASK 0x1 FORMAT "%13.11" ECU_ADDRESS 0x600014F4 /end MEASUREMENT
/begin MEASUREMENT B_hdr_msg "Flag to switch on high-pressure regulation" UBYTE B_TRUE 1 100 0.00 1.00000000000 BIT_MASK 0x1 FORMAT "%13.11" ECU_ADDRESS 0x600013D2 /end MEASUREMENT
/begin MEASUREMENT B_hlpkrsme "kc: auxiliary error flag signal evaluation measuring window" UBYTE B_TRUE 1 100 0.00 1.00000000000 BIT_MASK 0x1 FORMAT "%13.11" ECU_ADDRESS 0x70000375 /end MEASUREMENT
/begin MEASUREMENT B_hlpkrsmz "kc: auxiliary cycle flag signal evaluation measuring window" UBYTE B_TRUE 1 100 0.00 1.00000000000 BIT_MASK 0x1 FORMAT "%13.11" ECU_ADDRESS 0x70000374 /end MEASUREMENT
/begin MEASUREMENT B_hlpkrsse "kc: auxiliary error flag signal evaluation combustion" UBYTE B_TRUE 1 100 0.00 1.00000000000 BIT_MASK 0x1 FORMAT "%13.11" ECU_ADDRESS 0x70000373 /end MEASUREMENT
/begin MEASUREMENT B_hlpkrssz "kc: auxiliary cycle flag signal evaluation combustion" UBYTE B_TRUE 1 100 0.00 1.00000000000 BIT_MASK 0x1 FORMAT "%13.11" ECU_ADDRESS 0x70000372 /end MEASUREMENT
/begin MEASUREMENT B_invlvbcd_msg "Request Double Boostering due to Error High Pressure Pump delivers too much" UBYTE B_TRUE 1 100 0.00 1.00000000000 BIT_MASK 0x1 FORMAT "%13.11" ECU_ADDRESS 0x600013CC /end MEASUREMENT
/begin MEASUREMENT B_khdenom "condition for diagnosis hdrkh, catalyst heating is active" UBYTE B_TRUE 1 100 0.00 1.00000000000 BIT_MASK 0x1 FORMAT "%13.11" ECU_ADDRESS 0x60000F9C /end MEASUREMENT
/begin MEASUREMENT B_krensam "condition for release of signal evaluation measuring window" UBYTE B_TRUE 1 100 0.00 1.00000000000 BIT_MASK 0x1 FORMAT "%13.11" ECU_ADDRESS 0x70000371 /end MEASUREMENT
/begin MEASUREMENT B_krensas "condition for release of signal evaluation combustion" UBYTE B_TRUE 1 100 0.00 1.00000000000 BIT_MASK 0x1 FORMAT "%13.11" ECU_ADDRESS 0x70000370 /end MEASUREMENT
/begin MEASUREMENT B_msvoff_msg "condition MSV off" UBYTE B_TRUE 1 100 0.00 1.00000000000 BIT_MASK 0x1 FORMAT "%13.11" ECU_ADDRESS 0x600014EE /end MEASUREMENT
/begin MEASUREMENT B_nmaxmsv_msg "Condition engine speed limitation active by Mass Flow Valve failure" UBYTE B_TRUE 1 100 0.00 1.00000000000 BIT_MASK 0x1 FORMAT "%13.11" ECU_ADDRESS 0x600013CA /end MEASUREMENT
/begin MEASUREMENT B_odgser_msg "ORA deviation exceeds the threshold SDORA" UBYTE B_TRUE 1 100 0.00 1.00000000000 BIT_MASK 0x1 FORMAT "%13.11" ECU_ADDRESS 0x70000B4E /end MEASUREMENT
/begin MEASUREMENT B_orast "Condition: last change of additive mixture correction smaller than threshold" UBYTE B_TRUE 1 100 0.00 1.00000000000 BIT_MASK 0x1 FORMAT "%13.11" ECU_ADDRESS 0x70000369 /end MEASUREMENT
/begin MEASUREMENT B_orastab_msg "Condition: ORA(Additive correction of mixture adaptation) integrator (local) stable" UBYTE B_TRUE 1 100 0.00 1.00000000000 BIT_MASK 0x1 FORMAT "%13.11" ECU_ADDRESS 0x70000B49 /end MEASUREMENT
/begin MEASUREMENT B_ostabzs_msg "Condition: B_orastab was set after B_fstabzs" UBYTE B_TRUE 1 100 0.00 1.00000000000 BIT_MASK 0x1 FORMAT "%13.11" ECU_ADDRESS 0x70000B48 /end MEASUREMENT
/begin MEASUREMENT B_prmxnl_msg "condition maximum setpoint value rail pressure in limp home mode active" UBYTE B_TRUE 1 100 0.00 1.00000000000 BIT_MASK 0x1 FORMAT "%13.11" ECU_ADDRESS 0x600013C8 /end MEASUREMENT
/begin MEASUREMENT B_prnhsp_msg "Condition fuel pressure too low for HSP" UBYTE B_TRUE 1 100 0.00 1.00000000000 BIT_MASK 0x1 FORMAT "%13.11" ECU_ADDRESS 0x600014ED /end MEASUREMENT
/begin MEASUREMENT B_prnl_msg "Condition actual pressure demanded by diagnosis" UBYTE B_TRUE 1 100 0.00 1.00000000000 BIT_MASK 0x1 FORMAT "%13.11" ECU_ADDRESS 0x600014EC /end MEASUREMENT
/begin MEASUREMENT B_prnsch_msg "Condition fuel pressure too low for stratified mode" UBYTE B_TRUE 1 100 0.00 1.00000000000 BIT_MASK 0x1 FORMAT "%13.11" ECU_ADDRESS 0x600014EB /end MEASUREMENT
/begin MEASUREMENT B_tsprmx "condition railpressure limitation due to tightness o-rings connection rail-injector" UBYTE B_TRUE 1 100 0.00 1.00000000000 BIT_MASK 0x1 FORMAT "%13.11" ECU_ADDRESS 0x6000E80F /end MEASUREMENT
/begin MEASUREMENT B_zfra_msg "Cycle flag multiplicative mixture adaptation" UBYTE B_TRUE 1 100 0.00 1.00000000000 BIT_MASK 0x1 FORMAT "%13.11" ECU_ADDRESS 0x70000AE6 /end MEASUREMENT
/begin MEASUREMENT B_zhdrkh "condition cycle flag for diagnosis hdrkh during catalyst heating" UBYTE B_TRUE 1 100 0.00 1.00000000000 BIT_MASK 0x1 FORMAT "%13.11" ECU_ADDRESS 0x60000F9B /end MEASUREMENT
/begin MEASUREMENT B_zora_msg "if equal true, then ora(Additive correction of the mixture adaptation) is checked" UBYTE B_TRUE 1 100 0.00 1.00000000000 BIT_MASK 0x1 FORMAT "%13.11" ECU_ADDRESS 0x70000AE4 /end MEASUREMENT
/begin MEASUREMENT dfrmkf_w "filtered dfrm_w corrected with the P-part of the HK controller" UWORD fak_uw_b2 1 100 0.00 1.999969 FORMAT "%8.6" ECU_ADDRESS 0x60008546 /end MEASUREMENT
/begin MEASUREMENT DIUMPR_ctGenDenom "General denominator" UWORD OneToOne 1 100 0.00 65535.00 FORMAT "%8.2" ECU_ADDRESS 0x600388D2 /end MEASUREMENT
/begin MEASUREMENT DIUMPR_ctIgn "Ignition cycle counter" UWORD OneToOne 1 100 0.00 65535.00 FORMAT "%8.2" ECU_ADDRESS 0x600388D0 /end MEASUREMENT
/begin MEASUREMENT DIUMPR_Den.FID_BEONV "IUMPR denominator (config) / calculated denominator of in-use performance monitoring of FID_BEONV" UWORD OneToOne 1 100 0.00 65535.00 FORMAT "%8.2" ECU_ADDRESS 0x600387A8 /end MEASUREMENT
/begin MEASUREMENT DIUMPR_Den.FID_BDSTOF "IUMPR denominator (config) / calculated denominator of in-use performance monitoring of FID_BDSTOF" UWORD OneToOne 1 100 0.00 65535.00 FORMAT "%8.2" ECU_ADDRESS 0x600387AA /end MEASUREMENT
/begin MEASUREMENT DIUMPR_Den.FID_BLLRH "IUMPR denominator (config) / calculated denominator of in-use performance monitoring of FID_BLLRH" UWORD OneToOne 1 100 0.00 65535.00 FORMAT "%8.2" ECU_ADDRESS 0x600387AC /end MEASUREMENT
/begin MEASUREMENT DIUMPR_Den.FID_BLLRKH "IUMPR denominator (config) / calculated denominator of in-use performance monitoring of FID_BLLRKH" UWORD OneToOne 1 100 0.00 65535.00 FORMAT "%8.2" ECU_ADDRESS 0x600387AE /end MEASUREMENT
/begin MEASUREMENT DIUMPR_Den.FID_BPLSU "IUMPR denominator (config) / calculated denominator of in-use performance monitoring of FID_BPLSU" UWORD OneToOne 1 100 0.00 65535.00 FORMAT "%8.2" ECU_ADDRESS 0x600387B0 /end MEASUREMENT
/begin MEASUREMENT DIUMPR_Den.FId_EGSDO2FuTrmB1 "IUMPR denominator (config) / calculated denominator of in-use performance monitoring of FId_EGSDO2FuTrmB1" UWORD OneToOne 1 100 0.00 65535.00 FORMAT "%8.2" ECU_ADDRESS 0x600387B2 /end MEASUREMENT
/begin MEASUREMENT DIUMPR_Den.FId_EGSDO2SnsrMntdRelsS1B1 "IUMPR denominator (config) / calculated denominator of in-use performance monitoring of FId_EGSDO2SnsrMntdRelsS1B1" UWORD OneToOne 1 100 0.00 65535.00 FORMAT "%8.2" ECU_ADDRESS 0x600387B4 /end MEASUREMENT
/begin MEASUREMENT DIUMPR_Den.FID_CAGRSUS "IUMPR denominator (config) / calculated denominator of in-use performance monitoring of FID_CAGRSUS" UWORD OneToOne 1 100 0.00 65535.00 FORMAT "%8.2" ECU_ADDRESS 0x600387B6 /end MEASUREMENT
/begin MEASUREMENT DIUMPR_Den.FID_CDSKVRaty "IUMPR denominator (config) / calculated denominator of in-use performance monitoring of FID_CDSKVRaty" UWORD OneToOne 1 100 0.00 65535.00 FORMAT "%8.2" ECU_ADDRESS 0x600387B8 /end MEASUREMENT
/begin MEASUREMENT DIUMPR_Den.FID_CDSTR "IUMPR denominator (config) / calculated denominator of in-use performance monitoring of FID_CDSTR" UWORD OneToOne 1 100 0.00 65535.00 FORMAT "%8.2" ECU_ADDRESS 0x600387BA /end MEASUREMENT
/begin MEASUREMENT DIUMPR_Den.FID_CETHSPLnpl "IUMPR denominator (config) / calculated denominator of in-use performance monitoring of FID_CETHSPLnpl" UWORD OneToOne 1 100 0.00 65535.00 FORMAT "%8.2" ECU_ADDRESS 0x600387BC /end MEASUREMENT
/begin MEASUREMENT DIUMPR_Den.FID_CETHSTPLnpl "IUMPR denominator (config) / calculated denominator of in-use performance monitoring of FID_CETHSTPLnpl" UWORD OneToOne 1 100 0.00 65535.00 FORMAT "%8.2" ECU_ADDRESS 0x600387BE /end MEASUREMENT
/begin MEASUREMENT DIUMPR_Den.FID_CETKHL "IUMPR denominator (config) / calculated denominator of in-use performance monitoring of FID_CETKHL" UWORD OneToOne 1 100 0.00 65535.00 FORMAT "%8.2" ECU_ADDRESS 0x600387C0 /end MEASUREMENT
/begin MEASUREMENT DIUMPR_Den.FID_CETKHT "IUMPR denominator (config) / calculated denominator of in-use performance monitoring of FID_CETKHT" UWORD OneToOne 1 100 0.00 65535.00 FORMAT "%8.2" ECU_ADDRESS 0x600387C2 /end MEASUREMENT
/begin MEASUREMENT DIUMPR_Den.FID_CGLSRDP "IUMPR denominator (config) / calculated denominator of in-use performance monitoring of FID_CGLSRDP" UWORD OneToOne 1 100 0.00 65535.00 FORMAT "%8.2" ECU_ADDRESS 0x600387C4 /end MEASUREMENT
/begin MEASUREMENT DIUMPR_Den.FID_CHDRKH "IUMPR denominator (config) / calculated denominator of in-use performance monitoring of FID_CHDRKH" UWORD OneToOne 1 100 0.00 65535.00 FORMAT "%8.2" ECU_ADDRESS 0x600387C6 /end MEASUREMENT
/begin MEASUREMENT DIUMPR_Den.FID_CLZSRDP "IUMPR denominator (config) / calculated denominator of in-use performance monitoring of FID_CLZSRDP" UWORD OneToOne 1 100 0.00 65535.00 FORMAT "%8.2" ECU_ADDRESS 0x600387C8 /end MEASUREMENT
/begin MEASUREMENT DIUMPR_Den.FID_CLZSRHP "IUMPR denominator (config) / calculated denominator of in-use performance monitoring of FID_CLZSRHP" UWORD OneToOne 1 100 0.00 65535.00 FORMAT "%8.2" ECU_ADDRESS 0x600387CA /end MEASUREMENT
/begin MEASUREMENT DIUMPR_Den.FID_CPSRP "IUMPR denominator (config) / calculated denominator of in-use performance monitoring of FID_CPSRP" UWORD OneToOne 1 100 0.00 65535.00 FORMAT "%8.2" ECU_ADDRESS 0x600387CC /end MEASUREMENT
/begin MEASUREMENT DIUMPR_Den.FID_CTESF "IUMPR denominator (config) / calculated denominator of in-use performance monitoring of FID_CTESF" UWORD OneToOne 1 100 0.00 65535.00 FORMAT "%8.2" ECU_ADDRESS 0x600387CE /end MEASUREMENT
/begin MEASUREMENT DIUMPR_Den.FID_CTESG "IUMPR denominator (config) / calculated denominator of in-use performance monitoring of FID_CTESG" UWORD OneToOne 1 100 0.00 65535.00 FORMAT "%8.2" ECU_ADDRESS 0x600387D0 /end MEASUREMENT
/begin MEASUREMENT DIUMPR_Den.FID_CTKACS "IUMPR denominator (config) / calculated denominator of in-use performance monitoring of FID_CTKACS" UWORD OneToOne 1 100 0.00 65535.00 FORMAT "%8.2" ECU_ADDRESS 0x600387D2 /end MEASUREMENT
/begin MEASUREMENT DIUMPR_Den.FId_AfsPlausDiag "IUMPR denominator (config) / calculated denominator of in-use performance monitoring of FId_AfsPlausDiag" UWORD OneToOne 1 100 0.00 65535.00 FORMAT "%8.2" ECU_ADDRESS 0x600387D4 /end MEASUREMENT
/begin MEASUREMENT DIUMPR_Den.FId_CEngDsTColdStrt "IUMPR denominator (config) / calculated denominator of in-use performance monitoring of FId_CEngDsTColdStrt" UWORD OneToOne 1 100 0.00 65535.00 FORMAT "%8.2" ECU_ADDRESS 0x600387D6 /end MEASUREMENT
/begin MEASUREMENT DIUMPR_Den.FId_CEngDsTHSC "IUMPR denominator (config) / calculated denominator of in-use performance monitoring of FId_CEngDsTHSC" UWORD OneToOne 1 100 0.00 65535.00 FORMAT "%8.2" ECU_ADDRESS 0x600387D8 /end MEASUREMENT
/begin MEASUREMENT DIUMPR_Den.FId_CEngDsTLSC "IUMPR denominator (config) / calculated denominator of in-use performance monitoring of FId_CEngDsTLSC" UWORD OneToOne 1 100 0.00 65535.00 FORMAT "%8.2" ECU_ADDRESS 0x600387DA /end MEASUREMENT
/begin MEASUREMENT DIUMPR_Den.FId_CEngDsTSTC "IUMPR denominator (config) / calculated denominator of in-use performance monitoring of FId_CEngDsTSTC" UWORD OneToOne 1 100 0.00 65535.00 FORMAT "%8.2" ECU_ADDRESS 0x600387DC /end MEASUREMENT
/begin MEASUREMENT DIUMPR_Den.FId_CEngUsTCrssChk "IUMPR denominator (config) / calculated denominator of in-use performance monitoring of FId_CEngUsTCrssChk" UWORD OneToOne 1 100 0.00 65535.00 FORMAT "%8.2" ECU_ADDRESS 0x600387DE /end MEASUREMENT
/begin MEASUREMENT DIUMPR_Den.FId_CInjCatHeatgDiag "IUMPR denominator (config) / calculated denominator of in-use performance monitoring of FId_CInjCatHeatgDiag" UWORD OneToOne 1 100 0.00 65535.00 FORMAT "%8.2" ECU_ADDRESS 0x600387E0 /end MEASUREMENT
/begin MEASUREMENT DIUMPR_Den.FId_DiagBlkdLine "IUMPR denominator (config) / calculated denominator of in-use performance monitoring of FId_DiagBlkdLine" UWORD OneToOne 1 100 0.00 65535.00 FORMAT "%8.2" ECU_ADDRESS 0x600387E2 /end MEASUREMENT
/begin MEASUREMENT DIUMPR_Den.FId_DiagCpv1DteskLoLoad "IUMPR denominator (config) / calculated denominator of in-use performance monitoring of FId_DiagCpv1DteskLoLoad" UWORD OneToOne 1 100 0.00 65535.00 FORMAT "%8.2" ECU_ADDRESS 0x600387E4 /end MEASUREMENT
/begin MEASUREMENT DIUMPR_Den.FId_EGSDUS2B1LtrDly "IUMPR denominator (config) / calculated denominator of in-use performance monitoring of FId_EGSDUS2B1LtrDly" UWORD OneToOne 1 100 0.00 65535.00 FORMAT "%8.2" ECU_ADDRESS 0x600387E6 /end MEASUREMENT
/begin MEASUREMENT DIUMPR_Den.FId_EGSDUS2B1LtrPT1 "IUMPR denominator (config) / calculated denominator of in-use performance monitoring of FId_EGSDUS2B1LtrPT1" UWORD OneToOne 1 100 0.00 65535.00 FORMAT "%8.2" ECU_ADDRESS 0x600387E8 /end MEASUREMENT
/begin MEASUREMENT DIUMPR_Den.FId_EGSDUS2B1RtlDly "IUMPR denominator (config) / calculated denominator of in-use performance monitoring of FId_EGSDUS2B1RtlDly" UWORD OneToOne 1 100 0.00 65535.00 FORMAT "%8.2" ECU_ADDRESS 0x600387EA /end MEASUREMENT
/begin MEASUREMENT DIUMPR_Den.FId_EGSDUS2B1RtlPT1 "IUMPR denominator (config) / calculated denominator of in-use performance monitoring of FId_EGSDUS2B1RtlPT1" UWORD OneToOne 1 100 0.00 65535.00 FORMAT "%8.2" ECU_ADDRESS 0x600387EC /end MEASUREMENT
/begin MEASUREMENT DIUMPR_Den.FId_EGSDUS2B1TarLean "IUMPR denominator (config) / calculated denominator of in-use performance monitoring of FId_EGSDUS2B1TarLean" UWORD OneToOne 1 100 0.00 65535.00 FORMAT "%8.2" ECU_ADDRESS 0x600387EE /end MEASUREMENT
/begin MEASUREMENT DIUMPR_Den.FId_EGSDUS2B1TarRich "IUMPR denominator (config) / calculated denominator of in-use performance monitoring of FId_EGSDUS2B1TarRich" UWORD OneToOne 1 100 0.00 65535.00 FORMAT "%8.2" ECU_ADDRESS 0x600387F0 /end MEASUREMENT
/begin MEASUREMENT DIUMPR_Den.FId_EpmCaSOfsErrCaSI1 "IUMPR denominator (config) / calculated denominator of in-use performance monitoring of FId_EpmCaSOfsErrCaSI1" UWORD OneToOne 1 100 0.00 65535.00 FORMAT "%8.2" ECU_ADDRESS 0x600387F2 /end MEASUREMENT
/begin MEASUREMENT DIUMPR_Den.FId_EtaEngIdleNonCsers "IUMPR denominator (config) / calculated denominator of in-use performance monitoring of FId_EtaEngIdleNonCsers" UWORD OneToOne 1 100 0.00 65535.00 FORMAT "%8.2" ECU_ADDRESS 0x600387F4 /end MEASUREMENT
/begin MEASUREMENT DIUMPR_Den.FId_EtaEngPtlNonCsers "IUMPR denominator (config) / calculated denominator of in-use performance monitoring of FId_EtaEngPtlNonCsers" UWORD OneToOne 1 100 0.00 65535.00 FORMAT "%8.2" ECU_ADDRESS 0x600387F6 /end MEASUREMENT
/begin MEASUREMENT DIUMPR_Den.FId_FlDevPlauDiagFuSnsr "IUMPR denominator (config) / calculated denominator of in-use performance monitoring of FId_FlDevPlauDiagFuSnsr" UWORD OneToOne 1 100 0.00 65535.00 FORMAT "%8.2" ECU_ADDRESS 0x600387F8 /end MEASUREMENT
/begin MEASUREMENT DIUMPR_Den.FId_GEVlvLockPinDiagIntkB1 "IUMPR denominator (config) / calculated denominator of in-use performance monitoring of FId_GEVlvLockPinDiagIntkB1" UWORD OneToOne 1 100 0.00 65535.00 FORMAT "%8.2" ECU_ADDRESS 0x600387FA /end MEASUREMENT
/begin MEASUREMENT DIUMPR_Den.FId_GEVlvPhaDiagEnaCsersIntkB1 "IUMPR denominator (config) / calculated denominator of in-use performance monitoring of FId_GEVlvPhaDiagEnaCsersIntkB1" UWORD OneToOne 1 100 0.00 65535.00 FORMAT "%8.2" ECU_ADDRESS 0x600387FC /end MEASUREMENT
/begin MEASUREMENT DIUMPR_Den.FId_GEVlvPhaDiagEnaIntkB1 "IUMPR denominator (config) / calculated denominator of in-use performance monitoring of FId_GEVlvPhaDiagEnaIntkB1" UWORD OneToOne 1 100 0.00 65535.00 FORMAT "%8.2" ECU_ADDRESS 0x600387FE /end MEASUREMENT
/begin MEASUREMENT DIUMPR_Den.FId_HEGOS2B1DHtg "IUMPR denominator (config) / calculated denominator of in-use performance monitoring of FId_HEGOS2B1DHtg" UWORD OneToOne 1 100 0.00 65535.00 FORMAT "%8.2" ECU_ADDRESS 0x60038800 /end MEASUREMENT
/begin MEASUREMENT DIUMPR_Den.FId_InhbLamDynS1B1 "IUMPR denominator (config) / calculated denominator of in-use performance monitoring of FId_InhbLamDynS1B1" UWORD OneToOne 1 100 0.00 65535.00 FORMAT "%8.2" ECU_ADDRESS 0x60038802 /end MEASUREMENT
/begin MEASUREMENT DIUMPR_Den.FId_InjSysMulInjDiagErr "IUMPR denominator (config) / calculated denominator of in-use performance monitoring of FId_InjSysMulInjDiagErr" UWORD OneToOne 1 100 0.00 65535.00 FORMAT "%8.2" ECU_ADDRESS 0x60038804 /end MEASUREMENT
/begin MEASUREMENT DIUMPR_Den.FId_IntkAirTAirFltDsCrssChk "IUMPR denominator (config) / calculated denominator of in-use performance monitoring of FId_IntkAirTAirFltDsCrssChk" UWORD OneToOne 1 100 0.00 65535.00 FORMAT "%8.2" ECU_ADDRESS 0x60038806 /end MEASUREMENT
/begin MEASUREMENT DIUMPR_Den.FId_IntkAirTAirFltDsPlausChk "IUMPR denominator (config) / calculated denominator of in-use performance monitoring of FId_IntkAirTAirFltDsPlausChk" UWORD OneToOne 1 100 0.00 65535.00 FORMAT "%8.2" ECU_ADDRESS 0x60038808 /end MEASUREMENT
/begin MEASUREMENT DIUMPR_Den.FId_IntkAirTIntkMnfldCrssChk "IUMPR denominator (config) / calculated denominator of in-use performance monitoring of FId_IntkAirTIntkMnfldCrssChk" UWORD OneToOne 1 100 0.00 65535.00 FORMAT "%8.2" ECU_ADDRESS 0x6003880A /end MEASUREMENT
/begin MEASUREMENT DIUMPR_Den.FId_IntkAirTIntkMnfldPlausChk "IUMPR denominator (config) / calculated denominator of in-use performance monitoring of FId_IntkAirTIntkMnfldPlausChk" UWORD OneToOne 1 100 0.00 65535.00 FORMAT "%8.2" ECU_ADDRESS 0x6003880C /end MEASUREMENT
/begin MEASUREMENT DIUMPR_Den.FId_PEnvPlausDiagVDD "IUMPR denominator (config) / calculated denominator of in-use performance monitoring of FId_PEnvPlausDiagVDD" UWORD OneToOne 1 100 0.00 65535.00 FORMAT "%8.2" ECU_ADDRESS 0x6003880E /end MEASUREMENT
/begin MEASUREMENT DIUMPR_Den.FId_P_VSE11_Diag "IUMPR denominator (config) / calculated denominator of in-use performance monitoring of FId_P_VSE11_Diag" UWORD OneToOne 1 100 0.00 65535.00 FORMAT "%8.2" ECU_ADDRESS 0x60038810 /end MEASUREMENT
/begin MEASUREMENT DIUMPR_Den.FId_TWCDPriCatParB1 "IUMPR denominator (config) / calculated denominator of in-use performance monitoring of FId_TWCDPriCatParB1" UWORD OneToOne 1 100 0.00 65535.00 FORMAT "%8.2" ECU_ADDRESS 0x60038812 /end MEASUREMENT
/begin MEASUREMENT DIUMPR_Den.FId_TiOffTBasdChkFast "IUMPR denominator (config) / calculated denominator of in-use performance monitoring of FId_TiOffTBasdChkFast" UWORD OneToOne 1 100 0.00 65535.00 FORMAT "%8.2" ECU_ADDRESS 0x60038814 /end MEASUREMENT
/begin MEASUREMENT DIUMPR_Den.FId_TiOffTBasdChkSlow "IUMPR denominator (config) / calculated denominator of in-use performance monitoring of FId_TiOffTBasdChkSlow" UWORD OneToOne 1 100 0.00 65535.00 FORMAT "%8.2" ECU_ADDRESS 0x60038816 /end MEASUREMENT
/begin MEASUREMENT DIUMPR_Den.FId_UEGOHeatrPrfmncDiagRelsS1B1 "IUMPR denominator (config) / calculated denominator of in-use performance monitoring of FId_UEGOHeatrPrfmncDiagRelsS1B1" UWORD OneToOne 1 100 0.00 65535.00 FORMAT "%8.2" ECU_ADDRESS 0x60038818 /end MEASUREMENT
/begin MEASUREMENT DIUMPR_Den.FId_UEGOStrtDiagRelsS1B1 "IUMPR denominator (config) / calculated denominator of in-use performance monitoring of FId_UEGOStrtDiagRelsS1B1" UWORD OneToOne 1 100 0.00 65535.00 FORMAT "%8.2" ECU_ADDRESS 0x6003881A /end MEASUREMENT
/begin MEASUREMENT DIUMPR_Den.FId_VlvLftFbSwtIntk11Diag "IUMPR denominator (config) / calculated denominator of in-use performance monitoring of FId_VlvLftFbSwtIntk11Diag" UWORD OneToOne 1 100 0.00 65535.00 FORMAT "%8.2" ECU_ADDRESS 0x6003881C /end MEASUREMENT
/begin MEASUREMENT DIUMPR_Num.FID_BEONV "IUMPR numerator (config) / calculated numerator of in-use performance monitoring of FID_BEONV" UWORD OneToOne 1 100 0.00 65535.00 FORMAT "%8.2" ECU_ADDRESS 0x6003881E /end MEASUREMENT
/begin MEASUREMENT DIUMPR_Num.FID_BDSTOF "IUMPR numerator (config) / calculated numerator of in-use performance monitoring of FID_BDSTOF" UWORD OneToOne 1 100 0.00 65535.00 FORMAT "%8.2" ECU_ADDRESS 0x60038820 /end MEASUREMENT
/begin MEASUREMENT DIUMPR_Num.FID_BLLRH "IUMPR numerator (config) / calculated numerator of in-use performance monitoring of FID_BLLRH" UWORD OneToOne 1 100 0.00 65535.00 FORMAT "%8.2" ECU_ADDRESS 0x60038822 /end MEASUREMENT
/begin MEASUREMENT DIUMPR_Num.FID_BLLRKH "IUMPR numerator (config) / calculated numerator of in-use performance monitoring of FID_BLLRKH" UWORD OneToOne 1 100 0.00 65535.00 FORMAT "%8.2" ECU_ADDRESS 0x60038824 /end MEASUREMENT
/begin MEASUREMENT DIUMPR_Num.FID_BPLSU "IUMPR numerator (config) / calculated numerator of in-use performance monitoring of FID_BPLSU" UWORD OneToOne 1 100 0.00 65535.00 FORMAT "%8.2" ECU_ADDRESS 0x60038826 /end MEASUREMENT
/begin MEASUREMENT DIUMPR_Num.FId_EGSDO2FuTrmB1 "IUMPR numerator (config) / calculated numerator of in-use performance monitoring of FId_EGSDO2FuTrmB1" UWORD OneToOne 1 100 0.00 65535.00 FORMAT "%8.2" ECU_ADDRESS 0x60038828 /end MEASUREMENT
/begin MEASUREMENT DIUMPR_Num.FId_EGSDO2SnsrMntdRelsS1B1 "IUMPR numerator (config) / calculated numerator of in-use performance monitoring of FId_EGSDO2SnsrMntdRelsS1B1" UWORD OneToOne 1 100 0.00 65535.00 FORMAT "%8.2" ECU_ADDRESS 0x6003882A /end MEASUREMENT
/begin MEASUREMENT DIUMPR_Num.FID_CAGRSUS "IUMPR numerator (config) / calculated numerator of in-use performance monitoring of FID_CAGRSUS" UWORD OneToOne 1 100 0.00 65535.00 FORMAT "%8.2" ECU_ADDRESS 0x6003882C /end MEASUREMENT
/begin MEASUREMENT DIUMPR_Num.FID_CDSKVRaty "IUMPR numerator (config) / calculated numerator of in-use performance monitoring of FID_CDSKVRaty" UWORD OneToOne 1 100 0.00 65535.00 FORMAT "%8.2" ECU_ADDRESS 0x6003882E /end MEASUREMENT
/begin MEASUREMENT DIUMPR_Num.FID_CDSTR "IUMPR numerator (config) / calculated numerator of in-use performance monitoring of FID_CDSTR" UWORD OneToOne 1 100 0.00 65535.00 FORMAT "%8.2" ECU_ADDRESS 0x60038830 /end MEASUREMENT
/begin MEASUREMENT DIUMPR_Num.FID_CETHSPLnpl "IUMPR numerator (config) / calculated numerator of in-use performance monitoring of FID_CETHSPLnpl" UWORD OneToOne 1 100 0.00 65535.00 FORMAT "%8.2" ECU_ADDRESS 0x60038832 /end MEASUREMENT
/begin MEASUREMENT DIUMPR_Num.FID_CETHSTPLnpl "IUMPR numerator (config) / calculated numerator of in-use performance monitoring of FID_CETHSTPLnpl" UWORD OneToOne 1 100 0.00 65535.00 FORMAT "%8.2" ECU_ADDRESS 0x60038834 /end MEASUREMENT
/begin MEASUREMENT DIUMPR_Num.FID_CETKHL "IUMPR numerator (config) / calculated numerator of in-use performance monitoring of FID_CETKHL" UWORD OneToOne 1 100 0.00 65535.00 FORMAT "%8.2" ECU_ADDRESS 0x60038836 /end MEASUREMENT
/begin MEASUREMENT DIUMPR_Num.FID_CETKHT "IUMPR numerator (config) / calculated numerator of in-use performance monitoring of FID_CETKHT" UWORD OneToOne 1 100 0.00 65535.00 FORMAT "%8.2" ECU_ADDRESS 0x60038838 /end MEASUREMENT
/begin MEASUREMENT DIUMPR_Num.FID_CGLSRDP "IUMPR numerator (config) / calculated numerator of in-use performance monitoring of FID_CGLSRDP" UWORD OneToOne 1 100 0.00 65535.00 FORMAT "%8.2" ECU_ADDRESS 0x6003883A /end MEASUREMENT
/begin MEASUREMENT DIUMPR_Num.FID_CHDRKH "IUMPR numerator (config) / calculated numerator of in-use performance monitoring of FID_CHDRKH" UWORD OneToOne 1 100 0.00 65535.00 FORMAT "%8.2" ECU_ADDRESS 0x6003883C /end MEASUREMENT
/begin MEASUREMENT DIUMPR_Num.FID_CLZSRDP "IUMPR numerator (config) / calculated numerator of in-use performance monitoring of FID_CLZSRDP" UWORD OneToOne 1 100 0.00 65535.00 FORMAT "%8.2" ECU_ADDRESS 0x6003883E /end MEASUREMENT
/begin MEASUREMENT DIUMPR_Num.FID_CLZSRHP "IUMPR numerator (config) / calculated numerator of in-use performance monitoring of FID_CLZSRHP" UWORD OneToOne 1 100 0.00 65535.00 FORMAT "%8.2" ECU_ADDRESS 0x60038840 /end MEASUREMENT
/begin MEASUREMENT DIUMPR_Num.FID_CPSRP "IUMPR numerator (config) / calculated numerator of in-use performance monitoring of FID_CPSRP" UWORD OneToOne 1 100 0.00 65535.00 FORMAT "%8.2" ECU_ADDRESS 0x60038842 /end MEASUREMENT
/begin MEASUREMENT DIUMPR_Num.FID_CTESF "IUMPR numerator (config) / calculated numerator of in-use performance monitoring of FID_CTESF" UWORD OneToOne 1 100 0.00 65535.00 FORMAT "%8.2" ECU_ADDRESS 0x60038844 /end MEASUREMENT
/begin MEASUREMENT DIUMPR_Num.FID_CTESG "IUMPR numerator (config) / calculated numerator of in-use performance monitoring of FID_CTESG" UWORD OneToOne 1 100 0.00 65535.00 FORMAT "%8.2" ECU_ADDRESS 0x60038846 /end MEASUREMENT
/begin MEASUREMENT DIUMPR_Num.FID_CTKACS "IUMPR numerator (config) / calculated numerator of in-use performance monitoring of FID_CTKACS" UWORD OneToOne 1 100 0.00 65535.00 FORMAT "%8.2" ECU_ADDRESS 0x60038848 /end MEASUREMENT
/begin MEASUREMENT DIUMPR_Num.FId_AfsPlausDiag "IUMPR numerator (config) / calculated numerator of in-use performance monitoring of FId_AfsPlausDiag" UWORD OneToOne 1 100 0.00 65535.00 FORMAT "%8.2" ECU_ADDRESS 0x6003884A /end MEASUREMENT
/begin MEASUREMENT DIUMPR_Num.FId_CEngDsTColdStrt "IUMPR numerator (config) / calculated numerator of in-use performance monitoring of FId_CEngDsTColdStrt" UWORD OneToOne 1 100 0.00 65535.00 FORMAT "%8.2" ECU_ADDRESS 0x6003884C /end MEASUREMENT
/begin MEASUREMENT DIUMPR_Num.FId_CEngDsTHSC "IUMPR numerator (config) / calculated numerator of in-use performance monitoring of FId_CEngDsTHSC" UWORD OneToOne 1 100 0.00 65535.00 FORMAT "%8.2" ECU_ADDRESS 0x6003884E /end MEASUREMENT
/begin MEASUREMENT DIUMPR_Num.FId_CEngDsTLSC "IUMPR numerator (config) / calculated numerator of in-use performance monitoring of FId_CEngDsTLSC" UWORD OneToOne 1 100 0.00 65535.00 FORMAT "%8.2" ECU_ADDRESS 0x60038850 /end MEASUREMENT
/begin MEASUREMENT DIUMPR_Num.FId_CEngDsTSTC "IUMPR numerator (config) / calculated numerator of in-use performance monitoring of FId_CEngDsTSTC" UWORD OneToOne 1 100 0.00 65535.00 FORMAT "%8.2" ECU_ADDRESS 0x60038852 /end MEASUREMENT
/begin MEASUREMENT DIUMPR_Num.FId_CEngUsTCrssChk "IUMPR numerator (config) / calculated numerator of in-use performance monitoring of FId_CEngUsTCrssChk" UWORD OneToOne 1 100 0.00 65535.00 FORMAT "%8.2" ECU_ADDRESS 0x60038854 /end MEASUREMENT
/begin MEASUREMENT DIUMPR_Num.FId_CInjCatHeatgDiag "IUMPR numerator (config) / calculated numerator of in-use performance monitoring of FId_CInjCatHeatgDiag" UWORD OneToOne 1 100 0.00 65535.00 FORMAT "%8.2" ECU_ADDRESS 0x60038856 /end MEASUREMENT
/begin MEASUREMENT DIUMPR_Num.FId_DiagBlkdLine "IUMPR numerator (config) / calculated numerator of in-use performance monitoring of FId_DiagBlkdLine" UWORD OneToOne 1 100 0.00 65535.00 FORMAT "%8.2" ECU_ADDRESS 0x60038858 /end MEASUREMENT
/begin MEASUREMENT DIUMPR_Num.FId_DiagCpv1DteskLoLoad "IUMPR numerator (config) / calculated numerator of in-use performance monitoring of FId_DiagCpv1DteskLoLoad" UWORD OneToOne 1 100 0.00 65535.00 FORMAT "%8.2" ECU_ADDRESS 0x6003885A /end MEASUREMENT
/begin MEASUREMENT DIUMPR_Num.FId_EGSDUS2B1LtrDly "IUMPR numerator (config) / calculated numerator of in-use performance monitoring of FId_EGSDUS2B1LtrDly" UWORD OneToOne 1 100 0.00 65535.00 FORMAT "%8.2" ECU_ADDRESS 0x6003885C /end MEASUREMENT
/begin MEASUREMENT DIUMPR_Num.FId_EGSDUS2B1LtrPT1 "IUMPR numerator (config) / calculated numerator of in-use performance monitoring of FId_EGSDUS2B1LtrPT1" UWORD OneToOne 1 100 0.00 65535.00 FORMAT "%8.2" ECU_ADDRESS 0x6003885E /end MEASUREMENT
/begin MEASUREMENT DIUMPR_Num.FId_EGSDUS2B1RtlDly "IUMPR numerator (config) / calculated numerator of in-use performance monitoring of FId_EGSDUS2B1RtlDly" UWORD OneToOne 1 100 0.00 65535.00 FORMAT "%8.2" ECU_ADDRESS 0x60038860 /end MEASUREMENT
/begin MEASUREMENT DIUMPR_Num.FId_EGSDUS2B1RtlPT1 "IUMPR numerator (config) / calculated numerator of in-use performance monitoring of FId_EGSDUS2B1RtlPT1" UWORD OneToOne 1 100 0.00 65535.00 FORMAT "%8.2" ECU_ADDRESS 0x60038862 /end MEASUREMENT
/begin MEASUREMENT DIUMPR_Num.FId_EGSDUS2B1TarLean "IUMPR numerator (config) / calculated numerator of in-use performance monitoring of FId_EGSDUS2B1TarLean" UWORD OneToOne 1 100 0.00 65535.00 FORMAT "%8.2" ECU_ADDRESS 0x60038864 /end MEASUREMENT
/begin MEASUREMENT DIUMPR_Num.FId_EGSDUS2B1TarRich "IUMPR numerator (config) / calculated numerator of in-use performance monitoring of FId_EGSDUS2B1TarRich" UWORD OneToOne 1 100 0.00 65535.00 FORMAT "%8.2" ECU_ADDRESS 0x60038866 /end MEASUREMENT
/begin MEASUREMENT DIUMPR_Num.FId_EpmCaSOfsErrCaSI1 "IUMPR numerator (config) / calculated numerator of in-use performance monitoring of FId_EpmCaSOfsErrCaSI1" UWORD OneToOne 1 100 0.00 65535.00 FORMAT "%8.2" ECU_ADDRESS 0x60038868 /end MEASUREMENT
/begin MEASUREMENT DIUMPR_Num.FId_EtaEngIdleNonCsers "IUMPR numerator (config) / calculated numerator of in-use performance monitoring of FId_EtaEngIdleNonCsers" UWORD OneToOne 1 100 0.00 65535.00 FORMAT "%8.2" ECU_ADDRESS 0x6003886A /end MEASUREMENT
/begin MEASUREMENT DIUMPR_Num.FId_EtaEngPtlNonCsers "IUMPR numerator (config) / calculated numerator of in-use performance monitoring of FId_EtaEngPtlNonCsers" UWORD OneToOne 1 100 0.00 65535.00 FORMAT "%8.2" ECU_ADDRESS 0x6003886C /end MEASUREMENT
/begin MEASUREMENT DIUMPR_Num.FId_FlDevPlauDiagFuSnsr "IUMPR numerator (config) / calculated numerator of in-use performance monitoring of FId_FlDevPlauDiagFuSnsr" UWORD OneToOne 1 100 0.00 65535.00 FORMAT "%8.2" ECU_ADDRESS 0x6003886E /end MEASUREMENT
/begin MEASUREMENT DIUMPR_Num.FId_GEVlvLockPinDiagIntkB1 "IUMPR numerator (config) / calculated numerator of in-use performance monitoring of FId_GEVlvLockPinDiagIntkB1" UWORD OneToOne 1 100 0.00 65535.00 FORMAT "%8.2" ECU_ADDRESS 0x60038870 /end MEASUREMENT
/begin MEASUREMENT DIUMPR_Num.FId_GEVlvPhaDiagEnaCsersIntkB1 "IUMPR numerator (config) / calculated numerator of in-use performance monitoring of FId_GEVlvPhaDiagEnaCsersIntkB1" UWORD OneToOne 1 100 0.00 65535.00 FORMAT "%8.2" ECU_ADDRESS 0x60038872 /end MEASUREMENT
/begin MEASUREMENT DIUMPR_Num.FId_GEVlvPhaDiagEnaIntkB1 "IUMPR numerator (config) / calculated numerator of in-use performance monitoring of FId_GEVlvPhaDiagEnaIntkB1" UWORD OneToOne 1 100 0.00 65535.00 FORMAT "%8.2" ECU_ADDRESS 0x60038874 /end MEASUREMENT
/begin MEASUREMENT DIUMPR_Num.FId_HEGOS2B1DHtg "IUMPR numerator (config) / calculated numerator of in-use performance monitoring of FId_HEGOS2B1DHtg" UWORD OneToOne 1 100 0.00 65535.00 FORMAT "%8.2" ECU_ADDRESS 0x60038876 /end MEASUREMENT
/begin MEASUREMENT DIUMPR_Num.FId_InhbLamDynS1B1 "IUMPR numerator (config) / calculated numerator of in-use performance monitoring of FId_InhbLamDynS1B1" UWORD OneToOne 1 100 0.00 65535.00 FORMAT "%8.2" ECU_ADDRESS 0x60038878 /end MEASUREMENT
/begin MEASUREMENT DIUMPR_Num.FId_InjSysMulInjDiagErr "IUMPR numerator (config) / calculated numerator of in-use performance monitoring of FId_InjSysMulInjDiagErr" UWORD OneToOne 1 100 0.00 65535.00 FORMAT "%8.2" ECU_ADDRESS 0x6003887A /end MEASUREMENT
/begin MEASUREMENT DIUMPR_Num.FId_IntkAirTAirFltDsCrssChk "IUMPR numerator (config) / calculated numerator of in-use performance monitoring of FId_IntkAirTAirFltDsCrssChk" UWORD OneToOne 1 100 0.00 65535.00 FORMAT "%8.2" ECU_ADDRESS 0x6003887C /end MEASUREMENT
/begin MEASUREMENT DIUMPR_Num.FId_IntkAirTAirFltDsPlausChk "IUMPR numerator (config) / calculated numerator of in-use performance monitoring of FId_IntkAirTAirFltDsPlausChk" UWORD OneToOne 1 100 0.00 65535.00 FORMAT "%8.2" ECU_ADDRESS 0x6003887E /end MEASUREMENT
/begin MEASUREMENT DIUMPR_Num.FId_IntkAirTIntkMnfldCrssChk "IUMPR numerator (config) / calculated numerator of in-use performance monitoring of FId_IntkAirTIntkMnfldCrssChk" UWORD OneToOne 1 100 0.00 65535.00 FORMAT "%8.2" ECU_ADDRESS 0x60038880 /end MEASUREMENT
/begin MEASUREMENT DIUMPR_Num.FId_IntkAirTIntkMnfldPlausChk "IUMPR numerator (config) / calculated numerator of in-use performance monitoring of FId_IntkAirTIntkMnfldPlausChk" UWORD OneToOne 1 100 0.00 65535.00 FORMAT "%8.2" ECU_ADDRESS 0x60038882 /end MEASUREMENT
/begin MEASUREMENT DIUMPR_Num.FId_PEnvPlausDiagVDD "IUMPR numerator (config) / calculated numerator of in-use performance monitoring of FId_PEnvPlausDiagVDD" UWORD OneToOne 1 100 0.00 65535.00 FORMAT "%8.2" ECU_ADDRESS 0x60038884 /end MEASUREMENT
/begin MEASUREMENT DIUMPR_Num.FId_P_VSE11_Diag "IUMPR numerator (config) / calculated numerator of in-use performance monitoring of FId_P_VSE11_Diag" UWORD OneToOne 1 100 0.00 65535.00 FORMAT "%8.2" ECU_ADDRESS 0x60038886 /end MEASUREMENT
/begin MEASUREMENT DIUMPR_Num.FId_TWCDPriCatParB1 "IUMPR numerator (config) / calculated numerator of in-use performance monitoring of FId_TWCDPriCatParB1" UWORD OneToOne 1 100 0.00 65535.00 FORMAT "%8.2" ECU_ADDRESS 0x60038888 /end MEASUREMENT
/begin MEASUREMENT DIUMPR_Num.FId_TiOffTBasdChkFast "IUMPR numerator (config) / calculated numerator of in-use performance monitoring of FId_TiOffTBasdChkFast" UWORD OneToOne 1 100 0.00 65535.00 FORMAT "%8.2" ECU_ADDRESS 0x6003888A /end MEASUREMENT
/begin MEASUREMENT DIUMPR_Num.FId_TiOffTBasdChkSlow "IUMPR numerator (config) / calculated numerator of in-use performance monitoring of FId_TiOffTBasdChkSlow" UWORD OneToOne 1 100 0.00 65535.00 FORMAT "%8.2" ECU_ADDRESS 0x6003888C /end MEASUREMENT
/begin MEASUREMENT DIUMPR_Num.FId_UEGOHeatrPrfmncDiagRelsS1B1 "IUMPR numerator (config) / calculated numerator of in-use performance monitoring of FId_UEGOHeatrPrfmncDiagRelsS1B1" UWORD OneToOne 1 100 0.00 65535.00 FORMAT "%8.2" ECU_ADDRESS 0x6003888E /end MEASUREMENT
/begin MEASUREMENT DIUMPR_Num.FId_UEGOStrtDiagRelsS1B1 "IUMPR numerator (config) / calculated numerator of in-use performance monitoring of FId_UEGOStrtDiagRelsS1B1" UWORD OneToOne 1 100 0.00 65535.00 FORMAT "%8.2" ECU_ADDRESS 0x60038890 /end MEASUREMENT
/begin MEASUREMENT DIUMPR_Num.FId_VlvLftFbSwtIntk11Diag "IUMPR numerator (config) / calculated numerator of in-use performance monitoring of FId_VlvLftFbSwtIntk11Diag" UWORD OneToOne 1 100 0.00 65535.00 FORMAT "%8.2" ECU_ADDRESS 0x60038892 /end MEASUREMENT
/begin MEASUREMENT DIUMPR_numIndGrp "IUMPR record with smallest ratio within the component group" UWORD CfgRatio_Verb 1 100 0.00 800.000000000 FORMAT "%13.9" ARRAY_SIZE 14 ECU_ADDRESS 0x60009DB4 /end MEASUREMENT
/begin MEASUREMENT DIUMPR_rValRatMin "Smallest ratio within component group" UWORD Fact 1 100 0.00 7.999878 FORMAT "%8.6" ARRAY_SIZE 14 ECU_ADDRESS 0x500059E8 /end MEASUREMENT
/begin MEASUREMENT DIUMPR_St.FID_BEONV "IUMPR status (config) / status of in-use performance monitoring of FID_BEONV" UBYTE OneToOne 1 100 0.00 255.0 FORMAT "%5.1" ECU_ADDRESS 0x60038894 /end MEASUREMENT
/begin MEASUREMENT DIUMPR_St.FID_BDSTOF "IUMPR status (config) / status of in-use performance monitoring of FID_BDSTOF" UBYTE OneToOne 1 100 0.00 255.0 FORMAT "%5.1" ECU_ADDRESS 0x60038895 /end MEASUREMENT
/begin MEASUREMENT DIUMPR_St.FID_BLLRH "IUMPR status (config) / status of in-use performance monitoring of FID_BLLRH" UBYTE OneToOne 1 100 0.00 255.0 FORMAT "%5.1" ECU_ADDRESS 0x60038896 /end MEASUREMENT
/begin MEASUREMENT DIUMPR_St.FID_BLLRKH "IUMPR status (config) / status of in-use performance monitoring of FID_BLLRKH" UBYTE OneToOne 1 100 0.00 255.0 FORMAT "%5.1" ECU_ADDRESS 0x60038897 /end MEASUREMENT
/begin MEASUREMENT DIUMPR_St.FID_BPLSU "IUMPR status (config) / status of in-use performance monitoring of FID_BPLSU" UBYTE OneToOne 1 100 0.00 255.0 FORMAT "%5.1" ECU_ADDRESS 0x60038898 /end MEASUREMENT
/begin MEASUREMENT DIUMPR_St.FId_EGSDO2FuTrmB1 "IUMPR status (config) / status of in-use performance monitoring of FId_EGSDO2FuTrmB1" UBYTE OneToOne 1 100 0.00 255.0 FORMAT "%5.1" ECU_ADDRESS 0x60038899 /end MEASUREMENT
/begin MEASUREMENT DIUMPR_St.FId_EGSDO2SnsrMntdRelsS1B1 "IUMPR status (config) / status of in-use performance monitoring of FId_EGSDO2SnsrMntdRelsS1B1" UBYTE OneToOne 1 100 0.00 255.0 FORMAT "%5.1" ECU_ADDRESS 0x6003889A /end MEASUREMENT
/begin MEASUREMENT DIUMPR_St.FID_CAGRSUS "IUMPR status (config) / status of in-use performance monitoring of FID_CAGRSUS" UBYTE OneToOne 1 100 0.00 255.0 FORMAT "%5.1" ECU_ADDRESS 0x6003889B /end MEASUREMENT
/begin MEASUREMENT DIUMPR_St.FID_CDSKVRaty "IUMPR status (config) / status of in-use performance monitoring of FID_CDSKVRaty" UBYTE OneToOne 1 100 0.00 255.0 FORMAT "%5.1" ECU_ADDRESS 0x6003889C /end MEASUREMENT
/begin MEASUREMENT DIUMPR_St.FID_CDSTR "IUMPR status (config) / status of in-use performance monitoring of FID_CDSTR" UBYTE OneToOne 1 100 0.00 255.0 FORMAT "%5.1" ECU_ADDRESS 0x6003889D /end MEASUREMENT
/begin MEASUREMENT DIUMPR_St.FID_CETHSPLnpl "IUMPR status (config) / status of in-use performance monitoring of FID_CETHSPLnpl" UBYTE OneToOne 1 100 0.00 255.0 FORMAT "%5.1" ECU_ADDRESS 0x6003889E /end MEASUREMENT
/begin MEASUREMENT DIUMPR_St.FID_CETHSTPLnpl "IUMPR status (config) / status of in-use performance monitoring of FID_CETHSTPLnpl" UBYTE OneToOne 1 100 0.00 255.0 FORMAT "%5.1" ECU_ADDRESS 0x6003889F /end MEASUREMENT
/begin MEASUREMENT DIUMPR_St.FID_CETKHL "IUMPR status (config) / status of in-use performance monitoring of FID_CETKHL" UBYTE OneToOne 1 100 0.00 255.0 FORMAT "%5.1" ECU_ADDRESS 0x600388A0 /end MEASUREMENT
/begin MEASUREMENT DIUMPR_St.FID_CETKHT "IUMPR status (config) / status of in-use performance monitoring of FID_CETKHT" UBYTE OneToOne 1 100 0.00 255.0 FORMAT "%5.1" ECU_ADDRESS 0x600388A1 /end MEASUREMENT
/begin MEASUREMENT DIUMPR_St.FID_CGLSRDP "IUMPR status (config) / status of in-use performance monitoring of FID_CGLSRDP" UBYTE OneToOne 1 100 0.00 255.0 FORMAT "%5.1" ECU_ADDRESS 0x600388A2 /end MEASUREMENT
/begin MEASUREMENT DIUMPR_St.FID_CHDRKH "IUMPR status (config) / status of in-use performance monitoring of FID_CHDRKH" UBYTE OneToOne 1 100 0.00 255.0 FORMAT "%5.1" ECU_ADDRESS 0x600388A3 /end MEASUREMENT
/begin MEASUREMENT DIUMPR_St.FID_CLZSRDP "IUMPR status (config) / status of in-use performance monitoring of FID_CLZSRDP" UBYTE OneToOne 1 100 0.00 255.0 FORMAT "%5.1" ECU_ADDRESS 0x600388A4 /end MEASUREMENT
/begin MEASUREMENT DIUMPR_St.FID_CLZSRHP "IUMPR status (config) / status of in-use performance monitoring of FID_CLZSRHP" UBYTE OneToOne 1 100 0.00 255.0 FORMAT "%5.1" ECU_ADDRESS 0x600388A5 /end MEASUREMENT
/begin MEASUREMENT DIUMPR_St.FID_CPSRP "IUMPR status (config) / status of in-use performance monitoring of FID_CPSRP" UBYTE OneToOne 1 100 0.00 255.0 FORMAT "%5.1" ECU_ADDRESS 0x600388A6 /end MEASUREMENT
/begin MEASUREMENT DIUMPR_St.FID_CTESF "IUMPR status (config) / status of in-use performance monitoring of FID_CTESF" UBYTE OneToOne 1 100 0.00 255.0 FORMAT "%5.1" ECU_ADDRESS 0x600388A7 /end MEASUREMENT
/begin MEASUREMENT DIUMPR_St.FID_CTESG "IUMPR status (config) / status of in-use performance monitoring of FID_CTESG" UBYTE OneToOne 1 100 0.00 255.0 FORMAT "%5.1" ECU_ADDRESS 0x600388A8 /end MEASUREMENT
/begin MEASUREMENT DIUMPR_St.FID_CTKACS "IUMPR status (config) / status of in-use performance monitoring of FID_CTKACS" UBYTE OneToOne 1 100 0.00 255.0 FORMAT "%5.1" ECU_ADDRESS 0x600388A9 /end MEASUREMENT
/begin MEASUREMENT DIUMPR_St.FId_AfsPlausDiag "IUMPR status (config) / status of in-use performance monitoring of FId_AfsPlausDiag" UBYTE OneToOne 1 100 0.00 255.0 FORMAT "%5.1" ECU_ADDRESS 0x600388AA /end MEASUREMENT
/begin MEASUREMENT DIUMPR_St.FId_CEngDsTColdStrt "IUMPR status (config) / status of in-use performance monitoring of FId_CEngDsTColdStrt" UBYTE OneToOne 1 100 0.00 255.0 FORMAT "%5.1" ECU_ADDRESS 0x600388AB /end MEASUREMENT
/begin MEASUREMENT DIUMPR_St.FId_CEngDsTHSC "IUMPR status (config) / status of in-use performance monitoring of FId_CEngDsTHSC" UBYTE OneToOne 1 100 0.00 255.0 FORMAT "%5.1" ECU_ADDRESS 0x600388AC /end MEASUREMENT
/begin MEASUREMENT DIUMPR_St.FId_CEngDsTLSC "IUMPR status (config) / status of in-use performance monitoring of FId_CEngDsTLSC" UBYTE OneToOne 1 100 0.00 255.0 FORMAT "%5.1" ECU_ADDRESS 0x600388AD /end MEASUREMENT
/begin MEASUREMENT DIUMPR_St.FId_CEngDsTSTC "IUMPR status (config) / status of in-use performance monitoring of FId_CEngDsTSTC" UBYTE OneToOne 1 100 0.00 255.0 FORMAT "%5.1" ECU_ADDRESS 0x600388AE /end MEASUREMENT
/begin MEASUREMENT DIUMPR_St.FId_CEngUsTCrssChk "IUMPR status (config) / status of in-use performance monitoring of FId_CEngUsTCrssChk" UBYTE OneToOne 1 100 0.00 255.0 FORMAT "%5.1" ECU_ADDRESS 0x600388AF /end MEASUREMENT
/begin MEASUREMENT DIUMPR_St.FId_CInjCatHeatgDiag "IUMPR status (config) / status of in-use performance monitoring of FId_CInjCatHeatgDiag" UBYTE OneToOne 1 100 0.00 255.0 FORMAT "%5.1" ECU_ADDRESS 0x600388B0 /end MEASUREMENT
/begin MEASUREMENT DIUMPR_St.FId_DiagBlkdLine "IUMPR status (config) / status of in-use performance monitoring of FId_DiagBlkdLine" UBYTE OneToOne 1 100 0.00 255.0 FORMAT "%5.1" ECU_ADDRESS 0x600388B1 /end MEASUREMENT
/begin MEASUREMENT DIUMPR_St.FId_DiagCpv1DteskLoLoad "IUMPR status (config) / status of in-use performance monitoring of FId_DiagCpv1DteskLoLoad" UBYTE OneToOne 1 100 0.00 255.0 FORMAT "%5.1" ECU_ADDRESS 0x600388B2 /end MEASUREMENT
/begin MEASUREMENT DIUMPR_St.FId_EGSDUS2B1LtrDly "IUMPR status (config) / status of in-use performance monitoring of FId_EGSDUS2B1LtrDly" UBYTE OneToOne 1 100 0.00 255.0 FORMAT "%5.1" ECU_ADDRESS 0x600388B3 /end MEASUREMENT
/begin MEASUREMENT DIUMPR_St.FId_EGSDUS2B1LtrPT1 "IUMPR status (config) / status of in-use performance monitoring of FId_EGSDUS2B1LtrPT1" UBYTE OneToOne 1 100 0.00 255.0 FORMAT "%5.1" ECU_ADDRESS 0x600388B4 /end MEASUREMENT
/begin MEASUREMENT DIUMPR_St.FId_EGSDUS2B1RtlDly "IUMPR status (config) / status of in-use performance monitoring of FId_EGSDUS2B1RtlDly" UBYTE OneToOne 1 100 0.00 255.0 FORMAT "%5.1" ECU_ADDRESS 0x600388B5 /end MEASUREMENT
/begin MEASUREMENT DIUMPR_St.FId_EGSDUS2B1RtlPT1 "IUMPR status (config) / status of in-use performance monitoring of FId_EGSDUS2B1RtlPT1" UBYTE OneToOne 1 100 0.00 255.0 FORMAT "%5.1" ECU_ADDRESS 0x600388B6 /end MEASUREMENT
/begin MEASUREMENT DIUMPR_St.FId_EGSDUS2B1TarLean "IUMPR status (config) / status of in-use performance monitoring of FId_EGSDUS2B1TarLean" UBYTE OneToOne 1 100 0.00 255.0 FORMAT "%5.1" ECU_ADDRESS 0x600388B7 /end MEASUREMENT
/begin MEASUREMENT DIUMPR_St.FId_EGSDUS2B1TarRich "IUMPR status (config) / status of in-use performance monitoring of FId_EGSDUS2B1TarRich" UBYTE OneToOne 1 100 0.00 255.0 FORMAT "%5.1" ECU_ADDRESS 0x600388B8 /end MEASUREMENT
/begin MEASUREMENT DIUMPR_St.FId_EpmCaSOfsErrCaSI1 "IUMPR status (config) / status of in-use performance monitoring of FId_EpmCaSOfsErrCaSI1" UBYTE OneToOne 1 100 0.00 255.0 FORMAT "%5.1" ECU_ADDRESS 0x600388B9 /end MEASUREMENT
/begin MEASUREMENT DIUMPR_St.FId_EtaEngIdleNonCsers "IUMPR status (config) / status of in-use performance monitoring of FId_EtaEngIdleNonCsers" UBYTE OneToOne 1 100 0.00 255.0 FORMAT "%5.1" ECU_ADDRESS 0x600388BA /end MEASUREMENT
/begin MEASUREMENT DIUMPR_St.FId_EtaEngPtlNonCsers "IUMPR status (config) / status of in-use performance monitoring of FId_EtaEngPtlNonCsers" UBYTE OneToOne 1 100 0.00 255.0 FORMAT "%5.1" ECU_ADDRESS 0x600388BB /end MEASUREMENT
/begin MEASUREMENT DIUMPR_St.FId_FlDevPlauDiagFuSnsr "IUMPR status (config) / status of in-use performance monitoring of FId_FlDevPlauDiagFuSnsr" UBYTE OneToOne 1 100 0.00 255.0 FORMAT "%5.1" ECU_ADDRESS 0x600388BC /end MEASUREMENT
/begin MEASUREMENT DIUMPR_St.FId_GEVlvLockPinDiagIntkB1 "IUMPR status (config) / status of in-use performance monitoring of FId_GEVlvLockPinDiagIntkB1" UBYTE OneToOne 1 100 0.00 255.0 FORMAT "%5.1" ECU_ADDRESS 0x600388BD /end MEASUREMENT
/begin MEASUREMENT DIUMPR_St.FId_GEVlvPhaDiagEnaCsersIntkB1 "IUMPR status (config) / status of in-use performance monitoring of FId_GEVlvPhaDiagEnaCsersIntkB1" UBYTE OneToOne 1 100 0.00 255.0 FORMAT "%5.1" ECU_ADDRESS 0x600388BE /end MEASUREMENT
/begin MEASUREMENT DIUMPR_St.FId_GEVlvPhaDiagEnaIntkB1 "IUMPR status (config) / status of in-use performance monitoring of FId_GEVlvPhaDiagEnaIntkB1" UBYTE OneToOne 1 100 0.00 255.0 FORMAT "%5.1" ECU_ADDRESS 0x600388BF /end MEASUREMENT
/begin MEASUREMENT DIUMPR_St.FId_HEGOS2B1DHtg "IUMPR status (config) / status of in-use performance monitoring of FId_HEGOS2B1DHtg" UBYTE OneToOne 1 100 0.00 255.0 FORMAT "%5.1" ECU_ADDRESS 0x600388C0 /end MEASUREMENT
/begin MEASUREMENT DIUMPR_St.FId_InhbLamDynS1B1 "IUMPR status (config) / status of in-use performance monitoring of FId_InhbLamDynS1B1" UBYTE OneToOne 1 100 0.00 255.0 FORMAT "%5.1" ECU_ADDRESS 0x600388C1 /end MEASUREMENT
/begin MEASUREMENT DIUMPR_St.FId_InjSysMulInjDiagErr "IUMPR status (config) / status of in-use performance monitoring of FId_InjSysMulInjDiagErr" UBYTE OneToOne 1 100 0.00 255.0 FORMAT "%5.1" ECU_ADDRESS 0x600388C2 /end MEASUREMENT
/begin MEASUREMENT DIUMPR_St.FId_IntkAirTAirFltDsCrssChk "IUMPR status (config) / status of in-use performance monitoring of FId_IntkAirTAirFltDsCrssChk" UBYTE OneToOne 1 100 0.00 255.0 FORMAT "%5.1" ECU_ADDRESS 0x600388C3 /end MEASUREMENT
/begin MEASUREMENT DIUMPR_St.FId_IntkAirTAirFltDsPlausChk "IUMPR status (config) / status of in-use performance monitoring of FId_IntkAirTAirFltDsPlausChk" UBYTE OneToOne 1 100 0.00 255.0 FORMAT "%5.1" ECU_ADDRESS 0x600388C4 /end MEASUREMENT
/begin MEASUREMENT DIUMPR_St.FId_IntkAirTIntkMnfldCrssChk "IUMPR status (config) / status of in-use performance monitoring of FId_IntkAirTIntkMnfldCrssChk" UBYTE OneToOne 1 100 0.00 255.0 FORMAT "%5.1" ECU_ADDRESS 0x600388C5 /end MEASUREMENT
/begin MEASUREMENT DIUMPR_St.FId_IntkAirTIntkMnfldPlausChk "IUMPR status (config) / status of in-use performance monitoring of FId_IntkAirTIntkMnfldPlausChk" UBYTE OneToOne 1 100 0.00 255.0 FORMAT "%5.1" ECU_ADDRESS 0x600388C6 /end MEASUREMENT
/begin MEASUREMENT DIUMPR_St.FId_PEnvPlausDiagVDD "IUMPR status (config) / status of in-use performance monitoring of FId_PEnvPlausDiagVDD" UBYTE OneToOne 1 100 0.00 255.0 FORMAT "%5.1" ECU_ADDRESS 0x600388C7 /end MEASUREMENT
/begin MEASUREMENT DIUMPR_St.FId_P_VSE11_Diag "IUMPR status (config) / status of in-use performance monitoring of FId_P_VSE11_Diag" UBYTE OneToOne 1 100 0.00 255.0 FORMAT "%5.1" ECU_ADDRESS 0x600388C8 /end MEASUREMENT
/begin MEASUREMENT DIUMPR_St.FId_TWCDPriCatParB1 "IUMPR status (config) / status of in-use performance monitoring of FId_TWCDPriCatParB1" UBYTE OneToOne 1 100 0.00 255.0 FORMAT "%5.1" ECU_ADDRESS 0x600388C9 /end MEASUREMENT
/begin MEASUREMENT DIUMPR_St.FId_TiOffTBasdChkFast "IUMPR status (config) / status of in-use performance monitoring of FId_TiOffTBasdChkFast" UBYTE OneToOne 1 100 0.00 255.0 FORMAT "%5.1" ECU_ADDRESS 0x600388CA /end MEASUREMENT
/begin MEASUREMENT DIUMPR_St.FId_TiOffTBasdChkSlow "IUMPR status (config) / status of in-use performance monitoring of FId_TiOffTBasdChkSlow" UBYTE OneToOne 1 100 0.00 255.0 FORMAT "%5.1" ECU_ADDRESS 0x600388CB /end MEASUREMENT
/begin MEASUREMENT DIUMPR_St.FId_UEGOHeatrPrfmncDiagRelsS1B1 "IUMPR status (config) / status of in-use performance monitoring of FId_UEGOHeatrPrfmncDiagRelsS1B1" UBYTE OneToOne 1 100 0.00 255.0 FORMAT "%5.1" ECU_ADDRESS 0x600388CC /end MEASUREMENT
/begin MEASUREMENT DIUMPR_St.FId_UEGOStrtDiagRelsS1B1 "IUMPR status (config) / status of in-use performance monitoring of FId_UEGOStrtDiagRelsS1B1" UBYTE OneToOne 1 100 0.00 255.0 FORMAT "%5.1" ECU_ADDRESS 0x600388CD /end MEASUREMENT
/begin MEASUREMENT DIUMPR_St.FId_VlvLftFbSwtIntk11Diag "IUMPR status (config) / status of in-use performance monitoring of FId_VlvLftFbSwtIntk11Diag" UBYTE OneToOne 1 100 0.00 255.0 FORMAT "%5.1" ECU_ADDRESS 0x600388CE /end MEASUREMENT
/begin MEASUREMENT DIUMPR_stCldStrtDen "Release state of ColdStart Denominator" UBYTE OneToOne 1 100 0.00 255.0 BIT_MASK 0x1 FORMAT "%5.1" ECU_ADDRESS 0x600340C5 /end MEASUREMENT
/begin MEASUREMENT DIUMPR_stCldStrtDenCmpl "Completion of increment of Coldstart Denominator" UBYTE OneToOne 1 100 0.00 255.0 BIT_MASK 0x1 FORMAT "%5.1" ECU_ADDRESS 0x6000F7CA /end MEASUREMENT
/begin MEASUREMENT DIUMPR_stCldStrtDenCmplInh "Status of cold start denominator inhibit" UBYTE OneToOne 1 100 0.00 255.0 BIT_MASK 0x1 FORMAT "%5.1" ECU_ADDRESS 0x6000F94F /end MEASUREMENT
/begin MEASUREMENT DIUMPR_stCldStrtMon "state of additonal monitoring for ColdStart Denominator" UBYTE OneToOne 1 100 0.00 255.0 FORMAT "%5.1" ECU_ADDRESS 0x600340C4 /end MEASUREMENT
/begin MEASUREMENT DIUMPR_stEnaDenom "enable status for general denominator and ignition cycle counter" ULONG OneToOne 1 100 0.00 4294967295.00 FORMAT "%13.2" ECU_ADDRESS 0x600340B4 /end MEASUREMENT
/begin MEASUREMENT DIUMPR_stEnaPDTC "status of PDTC driving cycle condition" UBYTE OneToOne 1 100 0.00 255.0 FORMAT "%5.1" ECU_ADDRESS 0x600340A4 /end MEASUREMENT
/begin MEASUREMENT DIUMPR_stEvapDen "Evap Denominator" UBYTE OneToOne 1 100 0.00 255.0 BIT_MASK 0x1 FORMAT "%5.1" ECU_ADDRESS 0x600340D1 /end MEASUREMENT
/begin MEASUREMENT DIUMPR_stEvapDenCmpl "Completion of increment of Evaporative Denominator" UBYTE OneToOne 1 100 0.00 255.0 BIT_MASK 0x1 FORMAT "%5.1" ECU_ADDRESS 0x6000F7C9 /end MEASUREMENT
/begin MEASUREMENT DIUMPR_stEvapDenCmplInh "Status of Evap denominator inhibit" UBYTE OneToOne 1 100 0.00 255.0 BIT_MASK 0x1 FORMAT "%5.1" ECU_ADDRESS 0x6000F7C8 /end MEASUREMENT
/begin MEASUREMENT DIUMPR_stEvapDenPurgFlow "state if the common evap purge flow denominator conditions are met or not" UBYTE OneToOne 1 100 0.00 255.0 BIT_MASK 0x1 FORMAT "%5.1" ECU_ADDRESS 0x600340D0 /end MEASUREMENT
/begin MEASUREMENT DIUMPR_stEvapMon "status of additonal monitoring for release conditions of denominator for evap systems" UBYTE OneToOne 1 100 0.00 255.0 FORMAT "%5.1" ECU_ADDRESS 0x600340CF /end MEASUREMENT
/begin MEASUREMENT DIUMPR_stEvapMonPurgFlow "status of additonal monitoring for release conditions of denominator for evap purge flow systems" UBYTE OneToOne 1 100 0.00 255.0 FORMAT "%5.1" ECU_ADDRESS 0x600340CE /end MEASUREMENT
/begin MEASUREMENT DIUMPR_stFIdCldStrtDenom_mp "Inhibit state of FId_DIUMPRCldStrtMon" UBYTE OneToOne 1 100 0.00 255.0 FORMAT "%5.1" ECU_ADDRESS 0x70009FCF /end MEASUREMENT
/begin MEASUREMENT DIUMPR_stFIdEvapDenomPurgFlow_mp "Inhibit state of FId_DIUMPREvapMonPurgFlow" UBYTE OneToOne 1 100 0.00 255.0 FORMAT "%5.1" ECU_ADDRESS 0x70009FCE /end MEASUREMENT
/begin MEASUREMENT DIUMPR_stFIdEvapDenom_mp "Inhibit state of FId_DIUMPREvapMon resp. FId_DIUMPREvapMonPHEV" UBYTE OneToOne 1 100 0.00 255.0 FORMAT "%5.1" ECU_ADDRESS 0x70009FCD /end MEASUREMENT
/begin MEASUREMENT DIUMPR_stFIdGenDenom_mp "collected FId status (mode 7 visibility) of general denominator" UBYTE OneToOne 1 100 0.00 255.0 FORMAT "%5.1" ECU_ADDRESS 0x70009FCC /end MEASUREMENT
/begin MEASUREMENT DIUMPR_tiEngOpCum "cumulative time since engine start (for general denominator condition)" UWORD DIUMPR_ti100ms 1 100 0.00 6553.500 FORMAT "%8.3" ECU_ADDRESS 0x600340AE /end MEASUREMENT
/begin MEASUREMENT DIUMPR_tiEngOpCumPDTC "cumulative time since engine start (for PDTC condition)" UWORD DIUMPR_ti100ms 1 100 0.00 6553.500 FORMAT "%8.3" ECU_ADDRESS 0x600340A8 /end MEASUREMENT
/begin MEASUREMENT DIUMPR_tiEvapMonEngStrtCum "Cumulative time since engine start with specific ambient conditions for evap monitoring" UWORD DIUMPR_ti100ms 1 100 0.00 6553.500 FORMAT "%8.3" ECU_ADDRESS 0x600340CC /end MEASUREMENT
/begin MEASUREMENT DIUMPR_tiEvapMonPurgFlowEngStrtCum "Cumulative time since engine start with specific ambient conditions for evap purgeflow monitoring" UWORD DIUMPR_ti100ms 1 100 0.00 6553.500 FORMAT "%8.3" ECU_ADDRESS 0x600340CA /end MEASUREMENT
/begin MEASUREMENT DIUMPR_tiIdl "continuous vehicle operation at idle (for general denominator condition)" UWORD DIUMPR_ti100ms 1 100 0.00 6553.500 FORMAT "%8.3" ECU_ADDRESS 0x600340AC /end MEASUREMENT
/begin MEASUREMENT DIUMPR_tiIdlPDTC "continuous vehicle operation at idle (for PDTC driving cycle condition)" UWORD DIUMPR_ti100ms 1 100 0.00 6553.500 FORMAT "%8.3" ECU_ADDRESS 0x600340A6 /end MEASUREMENT
/begin MEASUREMENT DIUMPR_tiVehSpdCum "cumulative vehicle operation at or above 25 miles per hour (for general denominator condition)" UWORD DIUMPR_ti100ms 1 100 0.00 6553.500 FORMAT "%8.3" ECU_ADDRESS 0x600340B0 /end MEASUREMENT
/begin MEASUREMENT DIUMPR_tiVehSpdCumPDTC "cumulative vehicle operation at or above 25 miles per hour (for PDTC cycle condition)" UWORD DIUMPR_ti100ms 1 100 0.00 6553.500 FORMAT "%8.3" ECU_ADDRESS 0x600340AA /end MEASUREMENT
/begin MEASUREMENT dkvsorai_w "internal additive corection of mixture adaptation" SWORD rel_sw_b1536 1 100 -1536.000 1535.953 FORMAT "%8.3" ECU_ADDRESS 0x600073FE /end MEASUREMENT
/begin MEASUREMENT DKVS_flgDSMClrFra "Condition clearing fault memory of multiplicative adaptation value" UBYTE B_TRUE 1 100 0.00 1.00000000000 BIT_MASK 0x1 FORMAT "%13.11" ECU_ADDRESS 0x70000A58 /end MEASUREMENT
/begin MEASUREMENT DKVS_flgDSMClrOra "Condition clearing fault memory of additive adaptation value (bank 2)" UBYTE B_TRUE 1 100 0.00 1.00000000000 BIT_MASK 0x1 FORMAT "%13.11" ECU_ADDRESS 0x70000A57 /end MEASUREMENT
/begin MEASUREMENT ehlpks_max "auxiliary error flag: knock sensor max-error" UBYTE dez 1 100 0.00 255.0 FORMAT "%5.1" ECU_ADDRESS 0x600140D0 /end MEASUREMENT
/begin MEASUREMENT ehlpks_maxold "knock sensor max-error of the last check" UBYTE dez 1 100 0.00 255.0 FORMAT "%5.1" ECU_ADDRESS 0x6000E816 /end MEASUREMENT
/begin MEASUREMENT ehlpks_min "auxiliary error flag: knock sensor min-error" UBYTE dez 1 100 0.00 255.0 FORMAT "%5.1" ECU_ADDRESS 0x600140D1 /end MEASUREMENT
/begin MEASUREMENT ehlpks_sc_msg "Auxiliary error flag: knock sensor loose fit detection error." UBYTE dez 1 100 0.00 255.0 FORMAT "%5.1" ECU_ADDRESS 0x6000EEF9 /end MEASUREMENT
/begin MEASUREMENT FlMA_flgDSMClrDKVS "Condition clearing fault memory for function DKVS is active" UBYTE B_TRUE 1 100 0.00 1.00000000000 BIT_MASK 0x1 FORMAT "%13.11" ECU_ADDRESS 0x7000093C /end MEASUREMENT
/begin MEASUREMENT fmn_w "mininum diagnostic condition for fra in flex-fuel system" UWORD fak_uw_b2 1 100 0.00 1.999969 FORMAT "%8.6" ECU_ADDRESS 0x600073FC /end MEASUREMENT
/begin MEASUREMENT fmx_w "maximum diagnostic condition for fra in flex-fuel system" UWORD fak_uw_b2 1 100 0.00 1.999969 FORMAT "%8.6" ECU_ADDRESS 0x600073FA /end MEASUREMENT
/begin MEASUREMENT fraffc_w_msg "corrected multiplicative mixture adaptation value, if ffuel_w is filled with backupvalue" UWORD fak_uw_b2 1 100 0.00 1.999969 FORMAT "%8.6" ECU_ADDRESS 0x60008522 /end MEASUREMENT
/begin MEASUREMENT fraiov_w "frai value in case of stability fra" UWORD fak_uw_b2 1 100 0.00 1.999969 FORMAT "%8.6" ECU_ADDRESS 0x60039432 /end MEASUREMENT
/begin MEASUREMENT frairef_w "reference value multiplicative mixture correction" UWORD fak_uw_b2 1 100 0.00 1.999969 FORMAT "%8.6" ECU_ADDRESS 0x600073F8 /end MEASUREMENT
/begin MEASUREMENT FRASTTIMER.time "variable existing only due to software reason / Timer value minimum time" UBYTE t200msxs_ub_b51 1 100 0.00 51.00 FORMAT "%5.2" ECU_ADDRESS 0x600073F3 /end MEASUREMENT
/begin MEASUREMENT FuPHi_flgDiagPRailCsersExtdCdn "Flag extended condition for CSERS high pressure diagnosis fulfilled" UBYTE B_TRUE 1 100 0.00 1.00000000000 BIT_MASK 0x1 FORMAT "%13.11" ECU_ADDRESS 0x6000E80E /end MEASUREMENT
/begin MEASUREMENT FuPHi_flgNMax "Condition engine speed limitation active due to failure of high pressure system" UBYTE B_TRUE 1 100 0.00 1.00000000000 BIT_MASK 0x1 FORMAT "%13.11" ECU_ADDRESS 0x6000EE34 /end MEASUREMENT
/begin MEASUREMENT FuPHi_flgPRailCsersHealEna "Flag CSERS high pressure diagnosis healing enabled" UBYTE B_TRUE 1 100 0.00 1.00000000000 BIT_MASK 0x1 FORMAT "%13.11" ECU_ADDRESS 0x6000E80D /end MEASUREMENT
/begin MEASUREMENT FuPHi_flgPRailCsersNoWrgHeal "Non volatile flag CSERS high pressure diagnosis prevent wrong healing active" UBYTE B_TRUE 1 100 0.00 1.00000000000 BIT_MASK 0x1 FORMAT "%13.11" ECU_ADDRESS 0x60039436 /end MEASUREMENT
/begin MEASUREMENT FuPHi_flgPRailDiagInactv "Flag high pressure diagnosis disabled due to CSERS diagnosis" UBYTE B_TRUE 1 100 0.00 1.00000000000 BIT_MASK 0x1 FORMAT "%13.11" ECU_ADDRESS 0x6000E80C /end MEASUREMENT
/begin MEASUREMENT FuPHi_nMax "Engine speed limitation due to failure of high pressure system" SWORD EngN 1 100 -16384.00 16383.50 FORMAT "%8.2" ECU_ADDRESS 0x6000886A /end MEASUREMENT
/begin MEASUREMENT FuPHi_pHpCtrlrOutFild "Filtered high pressure controller output" SWORD RBPtCel_p_0p002_1 1 100 -65.53600 65.53400 FORMAT "%8.5" ECU_ADDRESS 0x60001656 /end MEASUREMENT
/begin MEASUREMENT FuPHi_pHpRglnDeFild "Filtered control deviation of the high pressure control" SWORD RBPtCel_p_0p002_1 1 100 -65.53600 65.53400 FORMAT "%8.5" ECU_ADDRESS 0x60001652 /end MEASUREMENT
/begin MEASUREMENT FuPHi_pHpRglnDekFild "Filtered control deviation of the high pressure control (diagnosis CSERS)" SWORD RBPtCel_p_0p002_1 1 100 -65.53600 65.53400 FORMAT "%8.5" ECU_ADDRESS 0x60001650 /end MEASUREMENT
/begin MEASUREMENT FuPHi_pMaxRailSpLimp "maximum setpoint value rail pressure in limp home mode" UWORD RBPtCel_p_0p002_1 1 100 0.00 131.0700 FORMAT "%8.4" ECU_ADDRESS 0x6000149C /end MEASUREMENT
/begin MEASUREMENT FuPHi_pRailCsersNoWrgHeal "Non volatile stored rail pressure value at error occurrence within CSERS high pressure diagnosis" UWORD RBPtCel_p_0p002_1 1 100 0.00 131.0700 FORMAT "%8.4" ECU_ADDRESS 0x60039434 /end MEASUREMENT
/begin MEASUREMENT FuPHi_pRailCsersSpDif "Pressure difference between CSERS and non-CSERS setpoint" SLONG RBPtCel_p_0p002_1 1 100 -131.072000000 131.070000000 FORMAT "%13.9" ECU_ADDRESS 0x60003020 /end MEASUREMENT
/begin MEASUREMENT FuPHi_pRailLimpHome "Actual pressure demanded by diagnosis" UWORD RBPtCel_p_0p002_1 1 100 0.00 131.0700 FORMAT "%8.4" ECU_ADDRESS 0x6000161A /end MEASUREMENT
/begin MEASUREMENT FuPHi_pRailSpDiagCsersDynDelta "Dynamic pressure setpoint delta for enabling CSERS diagnosis" SLONG RBPtCel_p_0p002_1 1 100 -131.072000000 131.070000000 FORMAT "%13.9" ECU_ADDRESS 0x6000301C /end MEASUREMENT
/begin MEASUREMENT FuPHi_pRailSpDiagCsersFild "Filtered CSERS setpoint for calculation of dynamic delta" UWORD RBPtCel_p_0p002_1 1 100 0.00 131.0700 FORMAT "%8.4" ECU_ADDRESS 0x60007402 /end MEASUREMENT
/begin MEASUREMENT FuPHi_tiDebHpMinErr "Debouncing time MIN error high pressure control" UWORD t_q0p02 1 100 0.00 1310.700 FORMAT "%8.3" ECU_ADDRESS 0x60007400 /end MEASUREMENT
/begin MEASUREMENT HiPSys_flgIniPRailLimpHome "condition:Actual pressure demanded by diagnosis during start" UBYTE B_TRUE 1 100 0.00 1.00000000000 BIT_MASK 0x1 FORMAT "%13.11" ECU_ADDRESS 0x60000FA2 /end MEASUREMENT
/begin MEASUREMENT HiPSys_flgMilInfoAvl "Availablility of DFES state of MIL concerning high pressure error (DFC_HDRmax)" UBYTE B_TRUE 1 100 0.00 1.00000000000 BIT_MASK 0x1 FORMAT "%13.11" ECU_ADDRESS 0x6000E80B /end MEASUREMENT
/begin MEASUREMENT HiPSys_stMilDiagcFltChkHiP "DFES state of MIL concerning high pressure error (DFC_HDRmax)" UBYTE OneToOne 1 100 0.00 255.0 FORMAT "%5.1" ECU_ADDRESS 0x6000E80A /end MEASUREMENT
/begin MEASUREMENT IKCtl_ctReIniDKRS "Local counter in DKRS for number of driving cycles (leave postdrive) to enable reinitialization" UBYTE OneToOne 1 100 0.00 255.0 FORMAT "%5.1" ECU_ADDRESS 0x600140C5 /end MEASUREMENT
/begin MEASUREMENT IKCtl_flgDiagActv "kc: sensor diagnosis active" UBYTE B_TRUE 1 100 0.00 1.00000000000 BIT_MASK 0x1 FORMAT "%13.11" ECU_ADDRESS 0x700008B4 /end MEASUREMENT
/begin MEASUREMENT IKCtl_flgDsmClrDKRSASyncS1 "DSMclear flags" UBYTE B_TRUE 1 100 0.00 1.00000000000 BIT_MASK 0x1 FORMAT "%13.11" ECU_ADDRESS 0x7000036F /end MEASUREMENT
/begin MEASUREMENT IKCtl_flgWinMeas "transfervalue status Complex Driver KnDet current combustion" UBYTE B_TRUE 1 100 0.00 1.00000000000 BIT_MASK 0x1 FORMAT "%13.11" ECU_ADDRESS 0x70000897 /end MEASUREMENT
/begin MEASUREMENT IKCtl_krrlsdiag "clearance for diagnosis" UBYTE dez 1 100 0.00 255.0 FORMAT "%5.1" ECU_ADDRESS 0x70003702 /end MEASUREMENT
/begin MEASUREMENT IKCtl_krstdiag "Status information of diagnosis" UBYTE dez 1 100 0.00 255.0 FORMAT "%5.1" ECU_ADDRESS 0x70003701 /end MEASUREMENT
/begin MEASUREMENT IKCtl_MeasWinChkRls "transfervalue status Complex Driver KnDet current combustion" UBYTE dez 1 100 0.00 255.0 FORMAT "%5.1" ECU_ADDRESS 0x6001413C /end MEASUREMENT
/begin MEASUREMENT IKCtl_stReIniDKRSA "Status ReIni Task for DKRSA" UBYTE dez 1 100 0.00 255.0 FORMAT "%5.1" ECU_ADDRESS 0x600008DC /end MEASUREMENT
/begin MEASUREMENT InjSys_bNMaxHPSys "Condition engine speed limitation active due to failure of high pressure system" UBYTE B_TRUE 1 100 0.00 1.00000000000 BIT_MASK 0x1 FORMAT "%13.11" ECU_ADDRESS 0x6000EE2D /end MEASUREMENT
/begin MEASUREMENT InjSys_nMaxHPSys "Condition engine speed limitation due to failure of high pressure system" SWORD EngN 1 100 -16384.00 16383.50 FORMAT "%8.2" ECU_ADDRESS 0x6000882A /end MEASUREMENT
/begin MEASUREMENT kcsdeb "Debounce counterfor knock sensor loose fit detection." UBYTE dez 1 100 0.00 255.0 FORMAT "%5.1" ARRAY_SIZE 1 ECU_ADDRESS 0x6000E815 /end MEASUREMENT
/begin MEASUREMENT nmaxmsv_w_msg "Engine speed limit Mass Flow Valve failure for default idle driving (NFB)" UWORD nmot_uw_q0p25 1 100 0.00 16383.75 FORMAT "%8.2" ECU_ADDRESS 0x60000F9E /end MEASUREMENT
/begin MEASUREMENT oraiov_w "orai value in case of stability orai" SWORD rel_sw_b1536 1 100 -1536.000 1535.953 FORMAT "%8.3" ECU_ADDRESS 0x60039430 /end MEASUREMENT
/begin MEASUREMENT orairef_w "reference value additive mixture correction" SWORD rel_sw_b1536 1 100 -1536.000 1535.953 FORMAT "%8.3" ECU_ADDRESS 0x600073F6 /end MEASUREMENT
/begin MEASUREMENT ORASTTIMER.time "variable existing only due to software reason / Timer value minimum time" UBYTE t200msxs_ub_b51 1 100 0.00 51.00 FORMAT "%5.2" ECU_ADDRESS 0x600073EF /end MEASUREMENT
/begin MEASUREMENT prdifff_w_msg "Filtered control deviation of the high pressure control" SWORD p_q0p0005 1 100 -16.38400 16.38350 FORMAT "%8.5" ECU_ADDRESS 0x60001634 /end MEASUREMENT
/begin MEASUREMENT prdiffk_w_msg "Filtered control deviation of the high pressure control" SWORD p_q0p0005 1 100 -16.38400 16.38350 FORMAT "%8.5" ECU_ADDRESS 0x60001632 /end MEASUREMENT
/begin MEASUREMENT prdrf_w_msg "Filtered high pressure controller output" SWORD p_q0p0005 1 100 -16.38400 16.38350 FORMAT "%8.5" ECU_ADDRESS 0x6000162E /end MEASUREMENT
/begin MEASUREMENT prmxnl_w_msg "maximum setpoint value rail pressure in limp home mode" UWORD p_q0p0005 1 100 0.00 32.76750 FORMAT "%8.5" ECU_ADDRESS 0x60001448 /end MEASUREMENT
/begin MEASUREMENT prnl_w_msg "Actual pressure demanded by diagnosis" UWORD p_q0p0005 1 100 0.00 32.76750 FORMAT "%8.5" ECU_ADDRESS 0x60001446 /end MEASUREMENT
/begin MEASUREMENT rkvmeeffsel_w "Appropriate relative fuel mass (for GDI and PDI systems)" UWORD rel_uw_b3072 1 100 0.00 3071.953 FORMAT "%8.3" ECU_ADDRESS 0x60000FA0 /end MEASUREMENT
/begin MEASUREMENT tdhdrkh10s_T.timeCounter "Timer to increment the IUMPr of HDRKH / Remaining time of the timer" UBYTE t_q0p1 1 100 0.00 25.50 FORMAT "%5.2" ECU_ADDRESS 0x60000F9A /end MEASUREMENT
/begin MEASUREMENT tfrastmn "min. time for stabil check of FRA" UBYTE t200msxs_ub_b51 1 100 0.00 51.00 FORMAT "%5.2" ECU_ADDRESS 0x6000E809 /end MEASUREMENT
/begin MEASUREMENT torastmn "min. time for stabil check of ora" UBYTE t200msxs_ub_b51 1 100 0.00 51.00 FORMAT "%5.2" ECU_ADDRESS 0x6000E808 /end MEASUREMENT
/begin MEASUREMENT tprmxout "Appropriate temperature used for limitation of maxiumum pressure set point" UBYTE temp_ub_q0p75_o48 1 100 -48.0 143.3 FORMAT "%5.1" ECU_ADDRESS 0x60000F9D /end MEASUREMENT
/begin MEASUREMENT udksoa_w "knock sensor diagnosis: actuel value upper threshold" UWORD spg_q3p906Em4_V_ms 1 100 0.00 25.59961 FORMAT "%8.5" ECU_ADDRESS 0x60007408 /end MEASUREMENT
/begin MEASUREMENT udkssua_w "Knock sensor diagnosis: actual value of knock sensor loose fit detection threshold(UDKSV6SUN)." UWORD spg_q3p906Em4_V_ms 1 100 0.00 25.59961 FORMAT "%8.5" ECU_ADDRESS 0x60007406 /end MEASUREMENT
/begin MEASUREMENT udksua_w "Knock sensor diagnosis: actual value of knock sensor loose fit detection threshold" UWORD spg_q3p906Em4_V_ms 1 100 0.00 25.59961 FORMAT "%8.5" ECU_ADDRESS 0x60007404 /end MEASUREMENT
/begin MEASUREMENT xzheil "healing counter knock sensor diagnosis" UBYTE dez 1 100 0.00 255.0 FORMAT "%5.1" ARRAY_SIZE 1 ECU_ADDRESS 0x6000E814 /end MEASUREMENT
/begin MEASUREMENT xzsen "debounce counter knock sensor diagnosis" UBYTE dez 1 100 0.00 255.0 FORMAT "%5.1" ARRAY_SIZE 1 ECU_ADDRESS 0x6000E813 /end MEASUREMENT
/begin MEASUREMENT zdkrsam "counter knock detection: number of signal evaluation errors (measuring window) within obersavtion period" UBYTE dez 1 100 0.00 255.0 FORMAT "%5.1" ECU_ADDRESS 0x6000E812 /end MEASUREMENT
/begin MEASUREMENT zdkrsas_w "counter knock detection: number of signal evaluation errors (combustion) within obersavtion period" UWORD dez 1 100 0.00 65535.00 FORMAT "%8.2" ECU_ADDRESS 0x500007B8 /end MEASUREMENT
/begin MEASUREMENT zkrdisam "counter for the period of observation for evaluation: measuring window" UBYTE dez 1 100 0.00 255.0 FORMAT "%5.1" ECU_ADDRESS 0x6000E811 /end MEASUREMENT
/begin MEASUREMENT zkrdisas_w "counter for the period of observation for evaluation: combustion" UWORD dez 1 100 0.00 65535.00 FORMAT "%8.2" ECU_ADDRESS 0x500007BA /end MEASUREMENT
/begin MEASUREMENT zkrzsam "cycle counter knock control evaluation measuring window" UBYTE dez 1 100 0.00 255.0 FORMAT "%5.1" ECU_ADDRESS 0x6000E810 /end MEASUREMENT
/begin MEASUREMENT zkrzsas "cycle counter knock control evaluation combustion" UBYTE dez 1 100 0.00 255.0 FORMAT "%5.1" ECU_ADDRESS 0x5000097E /end MEASUREMENT
/begin FUNCTION DIUMPR "30000.50.0_1.1.0Diagnostic In Use Monitor Performance Ratio"
 /begin DEF_CHARACTERISTIC DIUMPR_CldStrtDenCldStrtTyp_C DIUMPR_ctGen.l500MDInc_C DIUMPR_ctGen.l500MD_C DIUMPR_ctGen.pEnvMin_C DIUMPR_ctGen.rAPPMax_C DIUMPR_ctGen.tEnvMin_C DIUMPR_ctGen.tiActrMin_C DIUMPR_ctGen.tiFuEngOpMin_C DIUMPR_ctGen.tiIdlMin_C DIUMPR_ctGen.tiIgnCycMin_C DIUMPR_ctGen.tiIgnMin_C DIUMPR_ctGen.tiOpMin_C DIUMPR_ctGen.tiSigContActv_C DIUMPR_ctGen.tiVehSpdMin_C DIUMPR_ctGen.vVehIdlMax_C DIUMPR_ctGen.vVehMin_C DIUMPR_Ctl.FID_BEONV_C DIUMPR_Ctl.FID_BDSTOF_C DIUMPR_Ctl.FID_BLLRH_C DIUMPR_Ctl.FID_BLLRKH_C DIUMPR_Ctl.FID_BPLSU_C DIUMPR_Ctl.FId_EGSDO2FuTrmB1_C DIUMPR_Ctl.FId_EGSDO2SnsrMntdRelsS1B1_C DIUMPR_Ctl.FID_CAGRSUS_C DIUMPR_Ctl.FID_CDSKVRaty_C DIUMPR_Ctl.FID_CDSTR_C DIUMPR_Ctl.FID_CETHSPLnpl_C DIUMPR_Ctl.FID_CETHSTPLnpl_C DIUMPR_Ctl.FID_CETKHL_C DIUMPR_Ctl.FID_CETKHT_C DIUMPR_Ctl.FID_CGLSRDP_C DIUMPR_Ctl.FID_CHDRKH_C DIUMPR_Ctl.FID_CLZSRDP_C DIUMPR_Ctl.FID_CLZSRHP_C DIUMPR_Ctl.FID_CPSRP_C DIUMPR_Ctl.FID_CTESF_C DIUMPR_Ctl.FID_CTESG_C DIUMPR_Ctl.FID_CTKACS_C DIUMPR_Ctl.FId_AfsPlausDiag_C DIUMPR_Ctl.FId_CEngDsTColdStrt_C DIUMPR_Ctl.FId_CEngDsTHSC_C DIUMPR_Ctl.FId_CEngDsTLSC_C DIUMPR_Ctl.FId_CEngDsTSTC_C DIUMPR_Ctl.FId_CEngUsTCrssChk_C DIUMPR_Ctl.FId_CInjCatHeatgDiag_C DIUMPR_Ctl.FId_DiagBlkdLine_C DIUMPR_Ctl.FId_DiagCpv1DteskLoLoad_C DIUMPR_Ctl.FId_EGSDUS2B1LtrDly_C DIUMPR_Ctl.FId_EGSDUS2B1LtrPT1_C DIUMPR_Ctl.FId_EGSDUS2B1RtlDly_C DIUMPR_Ctl.FId_EGSDUS2B1RtlPT1_C DIUMPR_Ctl.FId_EGSDUS2B1TarLean_C DIUMPR_Ctl.FId_EGSDUS2B1TarRich_C DIUMPR_Ctl.FId_EpmCaSOfsErrCaSI1_C DIUMPR_Ctl.FId_EtaEngIdleNonCsers_C DIUMPR_Ctl.FId_EtaEngPtlNonCsers_C DIUMPR_Ctl.FId_FlDevPlauDiagFuSnsr_C DIUMPR_Ctl.FId_GEVlvLockPinDiagIntkB1_C DIUMPR_Ctl.FId_GEVlvPhaDiagEnaCsersIntkB1_C DIUMPR_Ctl.FId_GEVlvPhaDiagEnaIntkB1_C DIUMPR_Ctl.FId_HEGOS2B1DHtg_C DIUMPR_Ctl.FId_InhbLamDynS1B1_C DIUMPR_Ctl.FId_InjSysMulInjDiagErr_C DIUMPR_Ctl.FId_IntkAirTAirFltDsCrssChk_C DIUMPR_Ctl.FId_IntkAirTAirFltDsPlausChk_C DIUMPR_Ctl.FId_IntkAirTIntkMnfldCrssChk_C DIUMPR_Ctl.FId_IntkAirTIntkMnfldPlausChk_C DIUMPR_Ctl.FId_PEnvPlausDiagVDD_C DIUMPR_Ctl.FId_P_VSE11_Diag_C DIUMPR_Ctl.FId_TWCDPriCatParB1_C DIUMPR_Ctl.FId_TiOffTBasdChkFast_C DIUMPR_Ctl.FId_TiOffTBasdChkSlow_C DIUMPR_Ctl.FId_UEGOHeatrPrfmncDiagRelsS1B1_C DIUMPR_Ctl.FId_UEGOStrtDiagRelsS1B1_C DIUMPR_Ctl.FId_VlvLftFbSwtIntk11Diag_C DIUMPR_DFC.FID_BEONV_C DIUMPR_DFC.FID_BDSTOF_C DIUMPR_DFC.FID_BLLRH_C DIUMPR_DFC.FID_BLLRKH_C DIUMPR_DFC.FID_BPLSU_C DIUMPR_DFC.FId_EGSDO2FuTrmB1_C DIUMPR_DFC.FId_EGSDO2SnsrMntdRelsS1B1_C DIUMPR_DFC.FID_CAGRSUS_C DIUMPR_DFC.FID_CDSKVRaty_C DIUMPR_DFC.FID_CDSTR_C DIUMPR_DFC.FID_CETHSPLnpl_C DIUMPR_DFC.FID_CETHSTPLnpl_C DIUMPR_DFC.FID_CETKHL_C DIUMPR_DFC.FID_CETKHT_C DIUMPR_DFC.FID_CGLSRDP_C DIUMPR_DFC.FID_CHDRKH_C DIUMPR_DFC.FID_CLZSRDP_C DIUMPR_DFC.FID_CLZSRHP_C DIUMPR_DFC.FID_CPSRP_C DIUMPR_DFC.FID_CTESF_C DIUMPR_DFC.FID_CTESG_C DIUMPR_DFC.FID_CTKACS_C DIUMPR_DFC.FId_AfsPlausDiag_C DIUMPR_DFC.FId_CEngDsTColdStrt_C DIUMPR_DFC.FId_CEngDsTHSC_C DIUMPR_DFC.FId_CEngDsTLSC_C DIUMPR_DFC.FId_CEngDsTSTC_C DIUMPR_DFC.FId_CEngUsTCrssChk_C DIUMPR_DFC.FId_CInjCatHeatgDiag_C DIUMPR_DFC.FId_DiagBlkdLine_C DIUMPR_DFC.FId_DiagCpv1DteskLoLoad_C DIUMPR_DFC.FId_EGSDUS2B1LtrDly_C DIUMPR_DFC.FId_EGSDUS2B1LtrPT1_C DIUMPR_DFC.FId_EGSDUS2B1RtlDly_C DIUMPR_DFC.FId_EGSDUS2B1RtlPT1_C DIUMPR_DFC.FId_EGSDUS2B1TarLean_C DIUMPR_DFC.FId_EGSDUS2B1TarRich_C DIUMPR_DFC.FId_EpmCaSOfsErrCaSI1_C DIUMPR_DFC.FId_EtaEngIdleNonCsers_C DIUMPR_DFC.FId_EtaEngPtlNonCsers_C DIUMPR_DFC.FId_FlDevPlauDiagFuSnsr_C DIUMPR_DFC.FId_GEVlvLockPinDiagIntkB1_C DIUMPR_DFC.FId_GEVlvPhaDiagEnaCsersIntkB1_C DIUMPR_DFC.FId_GEVlvPhaDiagEnaIntkB1_C DIUMPR_DFC.FId_HEGOS2B1DHtg_C DIUMPR_DFC.FId_InhbLamDynS1B1_C DIUMPR_DFC.FId_InjSysMulInjDiagErr_C DIUMPR_DFC.FId_IntkAirTAirFltDsCrssChk_C DIUMPR_DFC.FId_IntkAirTAirFltDsPlausChk_C DIUMPR_DFC.FId_IntkAirTIntkMnfldCrssChk_C DIUMPR_DFC.FId_IntkAirTIntkMnfldPlausChk_C DIUMPR_DFC.FId_PEnvPlausDiagVDD_C DIUMPR_DFC.FId_P_VSE11_Diag_C DIUMPR_DFC.FId_TWCDPriCatParB1_C DIUMPR_DFC.FId_TiOffTBasdChkFast_C DIUMPR_DFC.FId_TiOffTBasdChkSlow_C DIUMPR_DFC.FId_UEGOHeatrPrfmncDiagRelsS1B1_C DIUMPR_DFC.FId_UEGOStrtDiagRelsS1B1_C DIUMPR_DFC.FId_VlvLftFbSwtIntk11Diag_C DIUMPR_FilAFRIPFGrp_C DIUMPR_Grp.FID_BEONV_C DIUMPR_Grp.FID_BDSTOF_C DIUMPR_Grp.FID_BLLRH_C DIUMPR_Grp.FID_BLLRKH_C DIUMPR_Grp.FID_BPLSU_C DIUMPR_Grp.FId_EGSDO2FuTrmB1_C DIUMPR_Grp.FId_EGSDO2SnsrMntdRelsS1B1_C DIUMPR_Grp.FID_CAGRSUS_C DIUMPR_Grp.FID_CDSKVRaty_C DIUMPR_Grp.FID_CDSTR_C DIUMPR_Grp.FID_CETHSPLnpl_C DIUMPR_Grp.FID_CETHSTPLnpl_C DIUMPR_Grp.FID_CETKHL_C DIUMPR_Grp.FID_CETKHT_C DIUMPR_Grp.FID_CGLSRDP_C DIUMPR_Grp.FID_CHDRKH_C DIUMPR_Grp.FID_CLZSRDP_C DIUMPR_Grp.FID_CLZSRHP_C DIUMPR_Grp.FID_CPSRP_C DIUMPR_Grp.FID_CTESF_C DIUMPR_Grp.FID_CTESG_C DIUMPR_Grp.FID_CTKACS_C DIUMPR_Grp.FId_AfsPlausDiag_C DIUMPR_Grp.FId_CEngDsTColdStrt_C DIUMPR_Grp.FId_CEngDsTHSC_C DIUMPR_Grp.FId_CEngDsTLSC_C DIUMPR_Grp.FId_CEngDsTSTC_C DIUMPR_Grp.FId_CEngUsTCrssChk_C DIUMPR_Grp.FId_CInjCatHeatgDiag_C DIUMPR_Grp.FId_DiagBlkdLine_C DIUMPR_Grp.FId_DiagCpv1DteskLoLoad_C DIUMPR_Grp.FId_EGSDUS2B1LtrDly_C DIUMPR_Grp.FId_EGSDUS2B1LtrPT1_C DIUMPR_Grp.FId_EGSDUS2B1RtlDly_C DIUMPR_Grp.FId_EGSDUS2B1RtlPT1_C DIUMPR_Grp.FId_EGSDUS2B1TarLean_C DIUMPR_Grp.FId_EGSDUS2B1TarRich_C DIUMPR_Grp.FId_EpmCaSOfsErrCaSI1_C DIUMPR_Grp.FId_EtaEngIdleNonCsers_C DIUMPR_Grp.FId_EtaEngPtlNonCsers_C DIUMPR_Grp.FId_FlDevPlauDiagFuSnsr_C DIUMPR_Grp.FId_GEVlvLockPinDiagIntkB1_C DIUMPR_Grp.FId_GEVlvPhaDiagEnaCsersIntkB1_C DIUMPR_Grp.FId_GEVlvPhaDiagEnaIntkB1_C DIUMPR_Grp.FId_HEGOS2B1DHtg_C DIUMPR_Grp.FId_InhbLamDynS1B1_C DIUMPR_Grp.FId_InjSysMulInjDiagErr_C DIUMPR_Grp.FId_IntkAirTAirFltDsCrssChk_C DIUMPR_Grp.FId_IntkAirTAirFltDsPlausChk_C DIUMPR_Grp.FId_IntkAirTIntkMnfldCrssChk_C DIUMPR_Grp.FId_IntkAirTIntkMnfldPlausChk_C DIUMPR_Grp.FId_PEnvPlausDiagVDD_C DIUMPR_Grp.FId_P_VSE11_Diag_C DIUMPR_Grp.FId_TWCDPriCatParB1_C DIUMPR_Grp.FId_TiOffTBasdChkFast_C DIUMPR_Grp.FId_TiOffTBasdChkSlow_C DIUMPR_Grp.FId_UEGOHeatrPrfmncDiagRelsS1B1_C DIUMPR_Grp.FId_UEGOStrtDiagRelsS1B1_C DIUMPR_Grp.FId_VlvLftFbSwtIntk11Diag_C DIUMPR_tCldStrtDenCldStrtOfs_C DIUMPR_tCldStrtDenECTMax_C DIUMPR_tCldStrtOfs_C DIUMPR_tEvapDenMax_C DIUMPR_tEvapDenMin_C DIUMPR_tiCldStrtDenEngStrtDelay_C DIUMPR_tiEngStrtCum_C DIUMPR_tiEvapDenEngStrtDelay_C DIUMPR_xSelTstrNumrInctLock_C /end DEF_CHARACTERISTIC
 /begin OUT_MEASUREMENT DIUMPR_stCldStrtDenCmpl DIUMPR_stCldStrtDenCmplInh DIUMPR_stEvapDenCmpl DIUMPR_stEvapDenCmplInh DIUMPR_stEvapMonPurgFlow /end OUT_MEASUREMENT
 /begin LOC_MEASUREMENT DIUMPR_ctGenDenom DIUMPR_ctIgn DIUMPR_Den.FID_BEONV DIUMPR_Den.FID_BDSTOF DIUMPR_Den.FID_BLLRH DIUMPR_Den.FID_BLLRKH DIUMPR_Den.FID_BPLSU DIUMPR_Den.FId_EGSDO2FuTrmB1 DIUMPR_Den.FId_EGSDO2SnsrMntdRelsS1B1 DIUMPR_Den.FID_CAGRSUS DIUMPR_Den.FID_CDSKVRaty DIUMPR_Den.FID_CDSTR DIUMPR_Den.FID_CETHSPLnpl DIUMPR_Den.FID_CETHSTPLnpl DIUMPR_Den.FID_CETKHL DIUMPR_Den.FID_CETKHT DIUMPR_Den.FID_CGLSRDP DIUMPR_Den.FID_CHDRKH DIUMPR_Den.FID_CLZSRDP DIUMPR_Den.FID_CLZSRHP DIUMPR_Den.FID_CPSRP DIUMPR_Den.FID_CTESF DIUMPR_Den.FID_CTESG DIUMPR_Den.FID_CTKACS DIUMPR_Den.FId_AfsPlausDiag DIUMPR_Den.FId_CEngDsTColdStrt DIUMPR_Den.FId_CEngDsTHSC DIUMPR_Den.FId_CEngDsTLSC DIUMPR_Den.FId_CEngDsTSTC DIUMPR_Den.FId_CEngUsTCrssChk DIUMPR_Den.FId_CInjCatHeatgDiag DIUMPR_Den.FId_DiagBlkdLine DIUMPR_Den.FId_DiagCpv1DteskLoLoad DIUMPR_Den.FId_EGSDUS2B1LtrDly DIUMPR_Den.FId_EGSDUS2B1LtrPT1 DIUMPR_Den.FId_EGSDUS2B1RtlDly DIUMPR_Den.FId_EGSDUS2B1RtlPT1 DIUMPR_Den.FId_EGSDUS2B1TarLean DIUMPR_Den.FId_EGSDUS2B1TarRich DIUMPR_Den.FId_EpmCaSOfsErrCaSI1 DIUMPR_Den.FId_EtaEngIdleNonCsers DIUMPR_Den.FId_EtaEngPtlNonCsers DIUMPR_Den.FId_FlDevPlauDiagFuSnsr DIUMPR_Den.FId_GEVlvLockPinDiagIntkB1 DIUMPR_Den.FId_GEVlvPhaDiagEnaCsersIntkB1 DIUMPR_Den.FId_GEVlvPhaDiagEnaIntkB1 DIUMPR_Den.FId_HEGOS2B1DHtg DIUMPR_Den.FId_InhbLamDynS1B1 DIUMPR_Den.FId_InjSysMulInjDiagErr DIUMPR_Den.FId_IntkAirTAirFltDsCrssChk DIUMPR_Den.FId_IntkAirTAirFltDsPlausChk DIUMPR_Den.FId_IntkAirTIntkMnfldCrssChk DIUMPR_Den.FId_IntkAirTIntkMnfldPlausChk DIUMPR_Den.FId_PEnvPlausDiagVDD DIUMPR_Den.FId_P_VSE11_Diag DIUMPR_Den.FId_TWCDPriCatParB1 DIUMPR_Den.FId_TiOffTBasdChkFast DIUMPR_Den.FId_TiOffTBasdChkSlow DIUMPR_Den.FId_UEGOHeatrPrfmncDiagRelsS1B1 DIUMPR_Den.FId_UEGOStrtDiagRelsS1B1 DIUMPR_Den.FId_VlvLftFbSwtIntk11Diag DIUMPR_Num.FID_BEONV DIUMPR_Num.FID_BDSTOF DIUMPR_Num.FID_BLLRH DIUMPR_Num.FID_BLLRKH DIUMPR_Num.FID_BPLSU DIUMPR_Num.FId_EGSDO2FuTrmB1 DIUMPR_Num.FId_EGSDO2SnsrMntdRelsS1B1 DIUMPR_Num.FID_CAGRSUS DIUMPR_Num.FID_CDSKVRaty DIUMPR_Num.FID_CDSTR DIUMPR_Num.FID_CETHSPLnpl DIUMPR_Num.FID_CETHSTPLnpl DIUMPR_Num.FID_CETKHL DIUMPR_Num.FID_CETKHT DIUMPR_Num.FID_CGLSRDP DIUMPR_Num.FID_CHDRKH DIUMPR_Num.FID_CLZSRDP DIUMPR_Num.FID_CLZSRHP DIUMPR_Num.FID_CPSRP DIUMPR_Num.FID_CTESF DIUMPR_Num.FID_CTESG DIUMPR_Num.FID_CTKACS DIUMPR_Num.FId_AfsPlausDiag DIUMPR_Num.FId_CEngDsTColdStrt DIUMPR_Num.FId_CEngDsTHSC DIUMPR_Num.FId_CEngDsTLSC DIUMPR_Num.FId_CEngDsTSTC DIUMPR_Num.FId_CEngUsTCrssChk DIUMPR_Num.FId_CInjCatHeatgDiag DIUMPR_Num.FId_DiagBlkdLine DIUMPR_Num.FId_DiagCpv1DteskLoLoad DIUMPR_Num.FId_EGSDUS2B1LtrDly DIUMPR_Num.FId_EGSDUS2B1LtrPT1 DIUMPR_Num.FId_EGSDUS2B1RtlDly DIUMPR_Num.FId_EGSDUS2B1RtlPT1 DIUMPR_Num.FId_EGSDUS2B1TarLean DIUMPR_Num.FId_EGSDUS2B1TarRich DIUMPR_Num.FId_EpmCaSOfsErrCaSI1 DIUMPR_Num.FId_EtaEngIdleNonCsers DIUMPR_Num.FId_EtaEngPtlNonCsers DIUMPR_Num.FId_FlDevPlauDiagFuSnsr DIUMPR_Num.FId_GEVlvLockPinDiagIntkB1 DIUMPR_Num.FId_GEVlvPhaDiagEnaCsersIntkB1 DIUMPR_Num.FId_GEVlvPhaDiagEnaIntkB1 DIUMPR_Num.FId_HEGOS2B1DHtg DIUMPR_Num.FId_InhbLamDynS1B1 DIUMPR_Num.FId_InjSysMulInjDiagErr DIUMPR_Num.FId_IntkAirTAirFltDsCrssChk DIUMPR_Num.FId_IntkAirTAirFltDsPlausChk DIUMPR_Num.FId_IntkAirTIntkMnfldCrssChk DIUMPR_Num.FId_IntkAirTIntkMnfldPlausChk DIUMPR_Num.FId_PEnvPlausDiagVDD DIUMPR_Num.FId_P_VSE11_Diag DIUMPR_Num.FId_TWCDPriCatParB1 DIUMPR_Num.FId_TiOffTBasdChkFast DIUMPR_Num.FId_TiOffTBasdChkSlow DIUMPR_Num.FId_UEGOHeatrPrfmncDiagRelsS1B1 DIUMPR_Num.FId_UEGOStrtDiagRelsS1B1 DIUMPR_Num.FId_VlvLftFbSwtIntk11Diag DIUMPR_numIndGrp DIUMPR_rValRatMin DIUMPR_St.FID_BEONV DIUMPR_St.FID_BDSTOF DIUMPR_St.FID_BLLRH DIUMPR_St.FID_BLLRKH DIUMPR_St.FID_BPLSU DIUMPR_St.FId_EGSDO2FuTrmB1 DIUMPR_St.FId_EGSDO2SnsrMntdRelsS1B1 DIUMPR_St.FID_CAGRSUS DIUMPR_St.FID_CDSKVRaty DIUMPR_St.FID_CDSTR DIUMPR_St.FID_CETHSPLnpl DIUMPR_St.FID_CETHSTPLnpl DIUMPR_St.FID_CETKHL DIUMPR_St.FID_CETKHT DIUMPR_St.FID_CGLSRDP DIUMPR_St.FID_CHDRKH DIUMPR_St.FID_CLZSRDP DIUMPR_St.FID_CLZSRHP DIUMPR_St.FID_CPSRP DIUMPR_St.FID_CTESF DIUMPR_St.FID_CTESG DIUMPR_St.FID_CTKACS DIUMPR_St.FId_AfsPlausDiag DIUMPR_St.FId_CEngDsTColdStrt DIUMPR_St.FId_CEngDsTHSC DIUMPR_St.FId_CEngDsTLSC DIUMPR_St.FId_CEngDsTSTC DIUMPR_St.FId_CEngUsTCrssChk DIUMPR_St.FId_CInjCatHeatgDiag DIUMPR_St.FId_DiagBlkdLine DIUMPR_St.FId_DiagCpv1DteskLoLoad DIUMPR_St.FId_EGSDUS2B1LtrDly DIUMPR_St.FId_EGSDUS2B1LtrPT1 DIUMPR_St.FId_EGSDUS2B1RtlDly DIUMPR_St.FId_EGSDUS2B1RtlPT1 DIUMPR_St.FId_EGSDUS2B1TarLean DIUMPR_St.FId_EGSDUS2B1TarRich DIUMPR_St.FId_EpmCaSOfsErrCaSI1 DIUMPR_St.FId_EtaEngIdleNonCsers DIUMPR_St.FId_EtaEngPtlNonCsers DIUMPR_St.FId_FlDevPlauDiagFuSnsr DIUMPR_St.FId_GEVlvLockPinDiagIntkB1 DIUMPR_St.FId_GEVlvPhaDiagEnaCsersIntkB1 DIUMPR_St.FId_GEVlvPhaDiagEnaIntkB1 DIUMPR_St.FId_HEGOS2B1DHtg DIUMPR_St.FId_InhbLamDynS1B1 DIUMPR_St.FId_InjSysMulInjDiagErr DIUMPR_St.FId_IntkAirTAirFltDsCrssChk DIUMPR_St.FId_IntkAirTAirFltDsPlausChk DIUMPR_St.FId_IntkAirTIntkMnfldCrssChk DIUMPR_St.FId_IntkAirTIntkMnfldPlausChk DIUMPR_St.FId_PEnvPlausDiagVDD DIUMPR_St.FId_P_VSE11_Diag DIUMPR_St.FId_TWCDPriCatParB1 DIUMPR_St.FId_TiOffTBasdChkFast DIUMPR_St.FId_TiOffTBasdChkSlow DIUMPR_St.FId_UEGOHeatrPrfmncDiagRelsS1B1 DIUMPR_St.FId_UEGOStrtDiagRelsS1B1 DIUMPR_St.FId_VlvLftFbSwtIntk11Diag DIUMPR_stCldStrtDen DIUMPR_stCldStrtMon DIUMPR_stEnaDenom DIUMPR_stEnaPDTC DIUMPR_stEvapDen DIUMPR_stEvapDenPurgFlow DIUMPR_stEvapMon DIUMPR_stFIdCldStrtDenom_mp DIUMPR_stFIdEvapDenomPurgFlow_mp DIUMPR_stFIdEvapDenom_mp DIUMPR_stFIdGenDenom_mp DIUMPR_tiEngOpCum DIUMPR_tiEngOpCumPDTC DIUMPR_tiEvapMonEngStrtCum DIUMPR_tiEvapMonPurgFlowEngStrtCum DIUMPR_tiIdl DIUMPR_tiIdlPDTC DIUMPR_tiVehSpdCum DIUMPR_tiVehSpdCumPDTC /end LOC_MEASUREMENT
 FUNCTION_VERSION "30000.50.0_1.1.0" /end FUNCTION
/begin FUNCTION DKRS "7.8.0     Diagnosis; knock sensor"
 /begin DEF_CHARACTERISTIC CWDKS IKCtl_facDgnsLowrThd_GT IKCtl_facDgnsUpprThd_GT IKCtl_facNDiagMax IKCtl_facNDiagMin IKCtl_nLowrThdDiag IKCtl_nUpprThdDiag IKCtl_uThdLooseCnctnDiag KRFHKS KRZYLDIAG TEHLPKS /end DEF_CHARACTERISTIC
 /begin REF_CHARACTERISTIC IKCtl_idxAsgnSnsr_CA IKCtl_nEngVar13_X_AX /end REF_CHARACTERISTIC
 /begin IN_MEASUREMENT DSM_TripChgFinshd Epm_nEng IKCtl_flgDiagEna IKCtl_flgKnkEna IKCtl_flgLoadDynDetn IKCtl_flgSpdDynDetn IKCtl_stInjDTot_b8 IKCtl_wIntgRef_au32 SyC_ctPostDrvLeave SyC_stSub /end IN_MEASUREMENT
 /begin OUT_MEASUREMENT B_dksc_msg ehlpks_sc_msg IKCtl_flgDiagActv /end OUT_MEASUREMENT
 /begin LOC_MEASUREMENT B_ds2 ehlpks_max ehlpks_maxold ehlpks_min IKCtl_ctReIniDKRS kcsdeb udksoa_w udkssua_w udksua_w xzheil xzsen /end LOC_MEASUREMENT
 FUNCTION_VERSION "7.8.0" /end FUNCTION
/begin FUNCTION DKRSA "2.9.0     diagnosis knock detection signal evaluation" /begin DEF_CHARACTERISTIC CWDKRSA DKRSAM DKRSAS /end DEF_CHARACTERISTIC /begin IN_MEASUREMENT DSM_TripChgFinshd Epm_numCyl Epm_stOpMode SyC_stSub /end IN_MEASUREMENT
 /begin OUT_MEASUREMENT IKCtl_flgWinMeas IKCtl_krrlsdiag IKCtl_krstdiag IKCtl_MeasWinChkRls /end OUT_MEASUREMENT
 /begin LOC_MEASUREMENT B_hlpkrsme B_hlpkrsmz B_hlpkrsse B_hlpkrssz B_krensam B_krensas IKCtl_flgDsmClrDKRSASyncS1 IKCtl_stReIniDKRSA zdkrsam zdkrsas_w zkrdisam zkrdisas_w zkrzsam zkrzsas /end LOC_MEASUREMENT
 FUNCTION_VERSION "2.9.0" /end FUNCTION
/begin FUNCTION DKVBDE "52.21.0_1.3.0Diagnosis Fuel Supply GDI"
 /begin DEF_CHARACTERISTIC FuPHi_facRelMMaxPmpRateDiag_T FuPHi_pLimpNegGrdtLim_M FuPHi_pLimpPosGrdtLim_T FuPHi_pMaxRailSpLimp_C FuPHi_pMinPInjCmprnStk_C FuPHi_pRailSensBkup_M FuPHi_pRlThresActvLimp_C FuPHi_pSpFuTemp_T FuPHi_tBattMaxMSV_C FuPHi_uBattMaxMSV_C NMAXNLHP NMAXNLLP RKMNHDP TDNLHP TFPRMAXTF TNSTPRMX TSPRMX TSPRMXO /end DEF_CHARACTERISTIC
 /begin IN_MEASUREMENT BattU_u B_ebfmod_msg B_entist_msg B_tfuelg_msg B_uprmnpl_msg CEngDsT_tStrt EngStrt_bStrtEnd Epm_nEng FlSys_tFlHPSys FuPHi_pRail FuPHi_pRailSp rkvmeeff_w_msg SyC_stSub tnse_w_msg /end IN_MEASUREMENT
 /begin OUT_MEASUREMENT B_dkvbdepl_msg B_eprail_msg B_hdpoff_msg B_hdr_msg B_invlvbcd_msg B_msvoff_msg B_nmaxmsv_msg B_prmxnl_msg B_prnhsp_msg B_prnl_msg B_prnsch_msg FuPHi_flgNMax FuPHi_nMax FuPHi_pMaxRailSpLimp FuPHi_pRailLimpHome InjSys_bNMaxHPSys InjSys_nMaxHPSys prmxnl_w_msg prnl_w_msg /end OUT_MEASUREMENT
 /begin LOC_MEASUREMENT B_tsprmx HiPSys_flgIniPRailLimpHome nmaxmsv_w_msg rkvmeeffsel_w tprmxout /end LOC_MEASUREMENT
 FUNCTION_VERSION "52.21.0_1.3.0" /end FUNCTION
/begin FUNCTION DKVBDEPL "51.10.0_2.3.0diagnosis plausibility check Fuel Supply GDI"
 /begin DEF_CHARACTERISTIC CWDKVBDEPL CWHDRKH FuPHi_nPRailDiagCsersMin_C FuPHi_pMaxErrHDRKH_C FuPHi_pMaxErrHDR_C FuPHi_pMaxFailrHDRPlaus_C FuPHi_pMaxLimExcddErr_C FuPHi_pMinErrHDRKH_C FuPHi_pMinErrHDR_C FuPHi_pMinFailrHDRPlaus_C FuPHi_pRailDiagCsersDynDeltaRng_C FuPHi_pRailDiagCsersMax_C FuPHi_pRailDiagCsersMin_C FuPHi_stCfgDiagCsersPlaus_C FuPHi_tiDebPRailDiagCsersDynDelta_C FuPHi_tiDebPRailDiagCsers_C FuPHi_tiTnPRailDiagCsersDynDelta_C FuPHi_tPRailDiagCsersMin_C HiPSys_tiDlyHiPMaxLimExcddErr_C KLHDRMNRL TDHDRH TDHDRKHH TDHDRKHMN TDHDRKHMX TDHDRMN TDHDRMNTAL TDHDRMX TDHDRPLH TDHDRPLMN TDHDRPLMX TDHDRPLTAL TFPRDIFF TFPRDR TVHDRAKT TVHDRAKTKH TVHDRESET TVHDRKHRES TVHDRRES /end DEF_CHARACTERISTIC
 /begin IN_MEASUREMENT B_dkvbdepl_msg B_hdrres_msg B_khakt_msg B_kh_msg B_tal_msg CEngDsT_t Epm_nEng FuPHi_pHpCtrlrOut FuPHi_pHpRglnDe FuPHi_pRail FuPHi_pRailSp FuPHi_pRailSpNoCatHeatg rl_w_msg SyC_stSub tnse_w_msg /end IN_MEASUREMENT
 /begin OUT_MEASUREMENT B_hdrakt_msg B_hdrkhakt_msg B_hdrplakt_msg FuPHi_pHpCtrlrOutFild FuPHi_pHpRglnDeFild FuPHi_pHpRglnDekFild prdifff_w_msg prdiffk_w_msg prdrf_w_msg /end OUT_MEASUREMENT
 /begin LOC_MEASUREMENT B_khdenom B_zhdrkh FuPHi_flgDiagPRailCsersExtdCdn FuPHi_flgPRailCsersHealEna FuPHi_flgPRailCsersNoWrgHeal FuPHi_flgPRailDiagInactv FuPHi_pRailCsersNoWrgHeal FuPHi_pRailCsersSpDif FuPHi_pRailSpDiagCsersDynDelta FuPHi_pRailSpDiagCsersFild FuPHi_tiDebHpMinErr HiPSys_flgMilInfoAvl HiPSys_stMilDiagcFltChkHiP tdhdrkh10s_T.timeCounter /end LOC_MEASUREMENT
 FUNCTION_VERSION "51.10.0_2.3.0" /end FUNCTION
/begin FUNCTION DKVS "30001.19.0_1.3.0Diagnosis; plausibility test fuel supply system"
 /begin DEF_CHARACTERISTIC CWFFUEL DFRAESTAB DFRASTAB DFRMSTAB DORAESTAB DORASTAB FlMA_stStabDetnDurnInc_C FlMA_tiAddAdpnStabTstrReq_C FRADN FRADX ORADN ORADX SDFRA SDFRAINIT SDORA SDORAINIT TEFRA TEORA TFRA TLRASTMN TORA TORAINIT ZKDFRM /end DEF_CHARACTERISTIC
 /begin REF_CHARACTERISTIC CWLRASTO /end REF_CHARACTERISTIC
 /begin IN_MEASUREMENT B_abor_msg B_frasc_msg B_fvlra_msg B_gaenres_msg B_lrafra_msg B_lraora_msg B_nofra_msg B_noora_msg B_orasc_msg B_refrast_msg B_reorast_msg B_reqlra_msg Com_flgLETORATmrThd dfrmk_w_msg FfPrm_flgModCalc_msg ffrakl_msg ffuelev_w_msg ffuel_w_msg FlMA_facFuEvapAddAdpnSpdRed FlMA_facFuEvapMulAdpnSpdRed FlMA_flgDSMClrLRAEB FlMA_flgIninFinshdAckd FlMA_flgIninTrig forakl_msg frai_w_msg frak_w_msg orai_w_msg orak_w_msg /end IN_MEASUREMENT
 /begin OUT_MEASUREMENT B_edkvs_msg B_eframax_msg B_eframin_msg B_efra_msg B_eoramax_msg B_eoramin_msg B_eora_msg B_fdgser_msg B_frastab_msg B_fstabzs_msg B_gaefra_msg B_gaeing_msg B_gaeora_msg B_gae_msg B_odgser_msg B_orastab_msg B_ostabzs_msg B_zfra_msg B_zora_msg fraffc_w_msg /end OUT_MEASUREMENT
 /begin LOC_MEASUREMENT B_efmn B_efmx B_eomn B_eomx B_frast B_orast dfrmkf_w dkvsorai_w DKVS_flgDSMClrFra DKVS_flgDSMClrOra FlMA_flgDSMClrDKVS fmn_w fmx_w fraiov_w frairef_w FRASTTIMER.time oraiov_w orairef_w ORASTTIMER.time tfrastmn torastmn /end LOC_MEASUREMENT
 FUNCTION_VERSION "30001.19.0_1.3.0" /end FUNCTION
/begin FUNCTION DKVSDFC "30001.8.0 DFC fault memory connection of %DKVS" /begin DEF_CHARACTERISTIC TOFEORAFFR /end DEF_CHARACTERISTIC
 /begin IN_MEASUREMENT B_cdkvs_msg B_eframax_msg B_eframin_msg B_eoramax_msg B_eoramin_msg B_fdgser_msg B_fstabzs_msg B_lrare_msg B_orastab_msg B_zfra_msg B_zora_msg FlMA_flgIninFinshdAckd FlMA_flgIninTrig /end IN_MEASUREMENT
 FUNCTION_VERSION "30001.8.0" /end FUNCTION
/begin COMPU_METHOD B_TRUE "" TAB_VERB "%6.3" "" COMPU_TAB_REF B_TRUE /end COMPU_METHOD
/begin COMPU_VTAB B_TRUE "" TAB_VERB 2 0 "FALSE" 1 "TRUE" /end COMPU_VTAB
/begin COMPU_METHOD CfgRatio_Verb "" TAB_VERB "%6.3" "-" COMPU_TAB_REF CfgRatio_Verb /end COMPU_METHOD
/begin COMPU_VTAB CfgRatio_Verb "" TAB_VERB 60 0 "FID_BEONV" 1 "FID_BDSTOF" 2 "FID_BLLRH" 3 "FID_BLLRKH" 4 "FID_BPLSU" 5 "FId_EGSDO2FuTrmB1" 6 "FId_EGSDO2SnsrMntdRelsS1B1" 7 "FID_CAGRSUS" 8 "FID_CDSKVRaty" 9 "FID_CDSTR" 10 "FID_CETHSPLnpl" 11 "FID_CETHSTPLnpl" 12 "FID_CETKHL" 13 "FID_CETKHT" 14 "FID_CGLSRDP" 15 "FID_CHDRKH" 16 "FID_CLZSRDP" 17 "FID_CLZSRHP" 18 "FID_CPSRP" 19 "FID_CTESF" 20 "FID_CTESG" 21 "FID_CTKACS" 22 "FId_AfsPlausDiag" 23 "FId_CEngDsTColdStrt" 24 "FId_CEngDsTHSC" 25 "FId_CEngDsTLSC" 26 "FId_CEngDsTSTC" 27 "FId_CEngUsTCrssChk" 28 "FId_CInjCatHeatgDiag" 29 "FId_DiagBlkdLine" 30 "FId_DiagCpv1DteskLoLoad" 31 "FId_EGSDUS2B1LtrDly" 32 "FId_EGSDUS2B1LtrPT1" 33 "FId_EGSDUS2B1RtlDly" 34 "FId_EGSDUS2B1RtlPT1" 35 "FId_EGSDUS2B1TarLean" 36 "FId_EGSDUS2B1TarRich" 37 "FId_EpmCaSOfsErrCaSI1" 38 "FId_EtaEngIdleNonCsers" 39 "FId_EtaEngPtlNonCsers" 40 "FId_FlDevPlauDiagFuSnsr" 41 "FId_GEVlvLockPinDiagIntkB1" 42 "FId_GEVlvPhaDiagEnaCsersIntkB1" 43 "FId_GEVlvPhaDiagEnaIntkB1" 44 "FId_HEGOS2B1DHtg" 45 "FId_InhbLamDynS1B1" 46 "FId_InjSysMulInjDiagErr" 47 "FId_IntkAirTAirFltDsCrssChk" 48 "FId_IntkAirTAirFltDsPlausChk" 49 "FId_IntkAirTIntkMnfldCrssChk" 50 "FId_IntkAirTIntkMnfldPlausChk" 51 "FId_PEnvPlausDiagVDD" 52 "FId_P_VSE11_Diag" 53 "FId_TWCDPriCatParB1" 54 "FId_TiOffTBasdChkFast" 55 "FId_TiOffTBasdChkSlow" 56 "FId_UEGOHeatrPrfmncDiagRelsS1B1" 57 "FId_UEGOStrtDiagRelsS1B1" 58 "FId_VlvLftFbSwtIntk11Diag" 800 "---" DEFAULT_VALUE "---" /end COMPU_VTAB
/begin COMPU_METHOD dez "" RAT_FUNC "%6.2" "" COEFFS 0 1 0 0 0 1 /end COMPU_METHOD
/begin COMPU_METHOD DFC_Verb "" TAB_VERB "%6.3" "-" COMPU_TAB_REF DFC_Verb /end COMPU_METHOD
/begin COMPU_VTAB DFC_Verb "" TAB_VERB 907 0 "DFC_Unused" 1 "DFC_AAVEmax" 2 "DFC_AAVEmin" 3 "DFC_AAVEsig" 508 "DFC_AAVmin" 379 "DFC_ACEvpTPhysRngHi" 380 "DFC_ACEvpTPhysRngLo" 381 "DFC_ACEvpTSRCMax" 382 "DFC_ACEvpTSRCMin" 288 "DFC_AfsPhyRngHiB1" 289 "DFC_AfsPhyRngLoB1" 510 "DFC_AfsPlausDiagHi" 511 "DFC_AfsPlausDiagLo" 383 "DFC_AfsRawSigRngHiB1" 384 "DFC_AfsRawSigRngLoB1" 415 "DFC_AfsSigErrLineHiB1" 416 "DFC_AfsSigErrLineLoB1" 385 "DFC_AfsSnsrErrB1" 512 "DFC_AfsVrntDiagErrB1" 509 "DFC_AGRSUS" 386 "DFC_AirCClntPAnaSRCMax" 387 "DFC_AirCClntPAnaSRCMin" 290 "DFC_AirCCmprOL" 291 "DFC_AirCCmprOvrTemp" 292 "DFC_AirCCmprSCB" 293 "DFC_AirCCmprSCG" 388 "DFC_AirCSwtNpl" 389 "DFC_AirCSwtSig" 294 "DFC_AltErr" 4 "DFC_AltIOACGFailr" 5 "DFC_AltIOACGHiVltg" 6 "DFC_AltIOACGLoVltg" 7 "DFC_AltIOACGTHi" 8 "DFC_AltIODConnACG" 513 "DFC_AppAllSnsrDfct" 10 "DFC_BattUHiFailr" 11 "DFC_BattULoFailr" 295 "DFC_BattUSRCMax" 296 "DFC_BattUSRCMin" 516 "DFC_BattUStdbyDiaOL" 514 "DFC_BBKRnldg" 515 "DFC_BBKRsyne" 9 "DFC_BGOELWAF" 517 "DFC_BigLeakIntkMnfldEmiInfl" 518 "DFC_BlkdLineTank" 390 "DFC_Brk" 12 "DFC_BrkBstPDriftHiErr" 13 "DFC_BrkBstPDriftLoErr" 14 "DFC_BrkBstPSnsrStuck" 391 "DFC_BrkBstSensSCB" 392 "DFC_BrkBstSensSCG" 15 "DFC_BrkMnSwtContOn" 519 "DFC_BrkMnSwtContOnWarnLmp" 16 "DFC_BrkMnSwtNotStp" 520 "DFC_BrkMnSwtNotStpWarnLmp" 17 "DFC_BrkNpl" 18 "DFC_BrkRdntSwtContOn" 521 "DFC_BrkRdntSwtContOnWarnLmp" 19 "DFC_BrkRdntSwtNotStp" 522 "DFC_BrkRdntSwtNotStpWarnLmp" 393 "DFC_BrkSig" 496 "DFC_BSWM_E_ACTION_FAILED" 497 "DFC_BSWM_E_INTRPTQUEUE_FULL" 472 "DFC_BusDiagCANAPPLBusOff" 473 "DFC_BusDiagCANCANCBusOff" 474 "DFC_BusDiagCANVEHICLEBusOff" 490 "DFC_CAN_E_TIMEOUT" 523 "DFC_CEngDsTColdStrtMax" 524 "DFC_CEngDsTColdStrtMin" 525 "DFC_CEngDsTImps" 526 "DFC_CEngDsTPlausHSC" 527 "DFC_CEngDsTPlausLSC" 528 "DFC_CEngDsTPlausSTC" 531 "DFC_CEngDsTSig" 529 "DFC_CEngDsTSRCMax" 530 "DFC_CEngDsTSRCMin" 532 "DFC_CEngUsTColdStrtMax" 533 "DFC_CEngUsTColdStrtMin" 534 "DFC_CEngUsTLooseCnctn" 535 "DFC_CEngUsTSRCMax" 536 "DFC_CEngUsTSRCMin" 432 "DFC_Clth2ONStuck" 433 "DFC_Clth2ONStuckLdc" 20 "DFC_Clth3ONStuck" 434 "DFC_Clth3ONStuckLdc" 435 "DFC_Clth3ONStuckPostDrv" 21 "DFC_Clth4OFFStuck" 436 "DFC_Clth4ONStuck" 437 "DFC_Clth4ONStuckLdc" 260 "DFC_ClthMax" 412 "DFC_ClthNpl" 22 "DFC_ClthOFFStuck" 23 "DFC_ClthONStuck" 394 "DFC_ClthSig" 24 "DFC_ClthStkFailInfo" 25 "DFC_ComACFailInfo" 26 "DFC_ComATFTValErr" 27 "DFC_ComATMILReq" 28 "DFC_ComAYCAChksum" 29 "DFC_ComAYCARingCnt" 30 "DFC_ComAYCATOut" 31 "DFC_ComAYCDChkSum" 32 "DFC_ComAYCDTOut" 33 "DFC_ComAYCFChksum" 34 "DFC_ComAYCFRingCnt" 35 "DFC_ComAYCFTOut" 36 "DFC_ComAYCGChksum" 37 "DFC_ComAYCGRingCnt" 38 "DFC_ComAYCGTOut" 39 "DFC_ComAYCIChkSum" 40 "DFC_ComAYCIRingCnt" 41 "DFC_ComAYCITOut" 42 "DFC_ComBCM1ChkSum" 43 "DFC_ComBCM1RingCnt" 44 "DFC_ComBCM1TOut" 438 "DFC_ComBCMUnit" 45 "DFC_ComCANABusOffErr" 46 "DFC_ComCANBBusOffErr" 47 "DFC_ComCANCBusOffErr" 48 "DFC_ComCGW1ChkSum" 49 "DFC_ComCGW1RingCnt" 50 "DFC_ComCGW1TOut" 297 "DFC_ComChksTCU1" 298 "DFC_ComChksTCU11" 299 "DFC_ComChksTCU12" 300 "DFC_ComChksTCU13" 301 "DFC_ComChksTCU2" 302 "DFC_ComChksTCU3" 303 "DFC_ComChksTCU4" 304 "DFC_ComCntTCU1" 305 "DFC_ComCntTCU11" 306 "DFC_ComCntTCU12" 307 "DFC_ComCntTCU13" 308 "DFC_ComCntTCU2" 309 "DFC_ComCntTCU3" 310 "DFC_ComCntTCU4" 51 "DFC_ComConvBoostErr" 52 "DFC_ComConvSlipErr" 537 "DFC_ComDCDCACCFailr" 53 "DFC_ComDCDCPrfmncErr" 54 "DFC_ComDCDCTempWarn" 439 "DFC_ComDLCTCU01" 440 "DFC_ComDLCTCU02" 441 "DFC_ComDLCTCU1" 442 "DFC_ComDLCTCU11" 443 "DFC_ComDLCTCU12" 444 "DFC_ComDLCTCU13" 445 "DFC_ComDLCTCU14" 446 "DFC_ComDLCTCU2" 447 "DFC_ComDLCTCU3" 448 "DFC_ComDLCTCU4" 55 "DFC_ComEAT10Chksum" 56 "DFC_ComEAT10RingCnt" 57 "DFC_ComEAT10TOut" 58 "DFC_ComEAT11ChkSum" 59 "DFC_ComEAT11RingCnt" 60 "DFC_ComEAT11TOut" 61 "DFC_ComEAT12ChkSum" 62 "DFC_ComEAT12RingCnt" 63 "DFC_ComEAT12TOut" 64 "DFC_ComEAT13ChkSum" 65 "DFC_ComEAT13RingCnt" 66 "DFC_ComEAT13TOut" 67 "DFC_ComEAT1Chksum" 68 "DFC_ComEAT1RingCnt" 69 "DFC_ComEAT1TOut" 70 "DFC_ComEAT2ChkSum" 71 "DFC_ComEAT2RingCnt" 72 "DFC_ComEAT2TOut" 73 "DFC_ComEAT4ChkSum" 74 "DFC_ComEAT4RingCnt" 75 "DFC_ComEAT4TOut" 76 "DFC_ComEAT6Chksum" 77 "DFC_ComEAT6RingCnt" 78 "DFC_ComEAT6TOut" 79 "DFC_ComEAT7Chksum" 80 "DFC_ComEAT7RingCnt" 81 "DFC_ComEAT7TOut" 82 "DFC_ComEAT8Chksum" 83 "DFC_ComEAT8RingCnt" 84 "DFC_ComEAT8TOut" 85 "DFC_ComEATAChksum" 86 "DFC_ComEATARingCnt" 87 "DFC_ComEATATOut" 88 "DFC_ComEATBChkSum" 89 "DFC_ComEATBRingCnt" 90 "DFC_ComEATBTOut" 91 "DFC_ComEATCChksum" 92 "DFC_ComEATCRingCnt" 93 "DFC_ComEATCTOut" 103 "DFC_ComEngCanRxErr" 94 "DFC_ComEPBBChkSum" 95 "DFC_ComEPBBRingCnt" 96 "DFC_ComEPBBTOut" 97 "DFC_ComEPBChksum" 99 "DFC_ComEPBctRing" 98 "DFC_ComEPBTOut" 100 "DFC_ComEPS1Chksum" 101 "DFC_ComEPS1RingCnt" 102 "DFC_ComEPS1TOut" 449 "DFC_ComEPSUnit" 104 "DFC_ComGrvySnsrErr" 105 "DFC_ComGwIMG1ChkSum" 106 "DFC_ComGwIMG1RingCnt" 107 "DFC_ComGwIMG1TOut" 108 "DFC_ComGwIMG3ChkSum" 109 "DFC_ComGwIMG3RingCnt" 110 "DFC_ComGwIMG3TOut" 111 "DFC_ComGwIMG4ChkSum" 112 "DFC_ComGwIMG4RingCnt" 113 "DFC_ComGwIMG4TOut" 114 "DFC_ComGwIMG5ChkSum" 115 "DFC_ComGwIMG5RingCnt" 116 "DFC_ComGwIMG5TOut" 117 "DFC_ComGwIMG6ChkSum" 118 "DFC_ComGwIMG6RingCnt" 119 "DFC_ComGwIMG6TOut" 120 "DFC_ComIDASBChksum" 121 "DFC_ComIDASBRingCnt" 122 "DFC_ComIDASBTOut" 450 "DFC_ComIDASBUnit" 123 "DFC_ComIMGMILReq" 451 "DFC_ComIMGUnit" 124 "DFC_ComISSPrms" 125 "DFC_ComMETAChksum" 126 "DFC_ComMETAChksumPstDrv" 127 "DFC_ComMETARingCnt" 128 "DFC_ComMETARingCntPstDrv" 129 "DFC_ComMETATOut" 130 "DFC_ComMETATOutPstDrv" 131 "DFC_ComMETCChksum" 132 "DFC_ComMETCRingCnt" 133 "DFC_ComMETCTOut" 134 "DFC_ComMETDChksum" 135 "DFC_ComMETDRingCnt" 136 "DFC_ComMETDTOut" 137 "DFC_ComMETE2Chksum" 138 "DFC_ComMETE2RingCnt" 139 "DFC_ComMETE2TOut" 140 "DFC_ComMETFChksum" 141 "DFC_ComMETFRingCnt" 142 "DFC_ComMETFTOut" 143 "DFC_ComMETGChksum" 144 "DFC_ComMETGRingCnt" 145 "DFC_ComMETGTOut" 146 "DFC_ComMETH2Chksum" 147 "DFC_ComMETH2RingCnt" 148 "DFC_ComMETH2TOut" 149 "DFC_ComMETHChksum" 150 "DFC_ComMETHRingCnt" 151 "DFC_ComMETHTOut" 152 "DFC_ComMETIChksum" 153 "DFC_ComMETIRingCnt" 154 "DFC_ComMETITOut" 155 "DFC_ComMETKChksum" 156 "DFC_ComMETKRingCnt" 157 "DFC_ComMETKTOut" 158 "DFC_ComMETLChksum" 159 "DFC_ComMETLRingCnt" 160 "DFC_ComMETLTOut" 161 "DFC_ComMETMChksum" 162 "DFC_ComMETMRingCnt" 163 "DFC_ComMETMTOut" 164 "DFC_ComMETNChksum" 165 "DFC_ComMETNRingCnt" 166 "DFC_ComMETNTOut" 452 "DFC_ComMETUnit" 167 "DFC_ComMtrCom" 168 "DFC_ComPCUChkSum" 169 "DFC_ComPCURingCnt" 170 "DFC_ComPCUTOut" 171 "DFC_ComSRSAChksum" 172 "DFC_ComSRSARingCnt" 173 "DFC_ComSRSATOut" 174 "DFC_ComSRSBChksum" 175 "DFC_ComSRSBRingCnt" 176 "DFC_ComSRSBTOut" 177 "DFC_ComSRSChksum" 178 "DFC_ComSRSErr" 179 "DFC_ComSRSRingCnt" 180 "DFC_ComSRSTOut" 453 "DFC_ComSRSUnit" 311 "DFC_ComTOutTCU01" 312 "DFC_ComTOutTCU02" 313 "DFC_ComTOutTCU1" 314 "DFC_ComTOutTCU11" 315 "DFC_ComTOutTCU12" 316 "DFC_ComTOutTCU13" 317 "DFC_ComTOutTCU14" 318 "DFC_ComTOutTCU2" 319 "DFC_ComTOutTCU3" 320 "DFC_ComTOutTCU4" 181 "DFC_ComVehSpdPndFltTCU" 454 "DFC_ComVSAUnit" 538 "DFC_DCDCFltDet" 321 "DFC_DevLibBattUHi" 322 "DFC_DevLibBattULo" 357 "DFC_DHFHD" 558 "DFC_DiagCpv1DteskLoLoadStuckClsd" 559 "DFC_DiagCpv1DteskLoLoadStuckOpen" 541 "DFC_DKnpl" 539 "DFC_DKRSA" 540 "DFC_DKVSmax" 542 "DFC_DSKVRmax" 543 "DFC_DSKVRmin" 544 "DFC_DSKVRnpl" 545 "DFC_DSKVRsig" 546 "DFC_DSKVSsig" 547 "DFC_DSSmax" 548 "DFC_DSTDmax" 549 "DFC_DSTEmax" 550 "DFC_DSTEmin" 551 "DFC_DSTOFmax" 552 "DFC_DSTRmax" 553 "DFC_DSTRmin" 554 "DFC_DSTRnpl" 555 "DFC_DSTRsig" 556 "DFC_DSTTI" 557 "DFC_DSUmax" 182 "DFC_EbsChartcCurrErr" 183 "DFC_EbsSelfDiagErr" 455 "DFC_EbsSocFlt" 395 "DFC_EGRVlvCurrLim" 560 "DFC_EGRVlvDrftClsd" 561 "DFC_EGRVlvDrftOpn" 323 "DFC_EGRVlvFailSafeActv" 324 "DFC_EGRVlvGovDvtCld" 562 "DFC_EGRVlvJamVlvClsd" 563 "DFC_EGRVlvJamVlvOpn" 396 "DFC_EGRVlvOL" 397 "DFC_EGRVlvOvrTemp" 325 "DFC_EGRVlvPhysSRCMax" 326 "DFC_EGRVlvPhysSRCMin" 398 "DFC_EGRVlvSCB" 399 "DFC_EGRVlvSCG" 564 "DFC_EGRVlvSprgBrk" 400 "DFC_EGRVlvSRCMax" 401 "DFC_EGRVlvSRCMin" 565 "DFC_EGRVlvTempMdlEEPErr" 566 "DFC_EGRVlvTmpErr" 567 "DFC_EGSDUS2B1LtrDly" 568 "DFC_EGSDUS2B1LtrPT1" 569 "DFC_EGSDUS2B1RtlDly" 570 "DFC_EGSDUS2B1RtlPT1" 571 "DFC_EGSDUS2B1TarLean" 572 "DFC_EGSDUS2B1TarRich" 586 "DFC_EngICO" 587 "DFC_EngPrtOvrSpdMon" 573 "DFC_EONVmax" 588 "DFC_EpmCaSI1ErrSig" 589 "DFC_EpmCaSI1MntErr" 590 "DFC_EpmCaSI1NoSigMax" 591 "DFC_EpmCaSI1NoSigMin" 592 "DFC_EpmCaSI1OfsErr" 593 "DFC_EpmCrSDGI" 594 "DFC_EpmCrSErrSig" 595 "DFC_EpmCrSNoSig" 596 "DFC_EtaEngIdleNonCsers" 597 "DFC_EtaEngPtlNonCsers" 574 "DFC_ETAKHLmax" 575 "DFC_ETAKHTmax" 576 "DFC_ETHSEmax" 577 "DFC_ETHSEmin" 578 "DFC_ETHSFmax" 579 "DFC_ETHSFmin" 580 "DFC_ETHSFsig" 581 "DFC_ETHSNPWmax" 582 "DFC_ETHSNPWmin" 583 "DFC_ETHSNPWsig" 584 "DFC_ETHSPLnpl" 585 "DFC_ETHSTPLnpl" 327 "DFC_FanDIOOL_0" 328 "DFC_FanDIOOL_1" 329 "DFC_FanDIOOvrTemp_0" 330 "DFC_FanDIOOvrTemp_1" 331 "DFC_FanDIOSCB_0" 332 "DFC_FanDIOSCB_1" 333 "DFC_FanDIOSCG_0" 334 "DFC_FanDIOSCG_1" 598 "DFC_FRAmax" 599 "DFC_FRAmin" 600 "DFC_FSTEmax" 601 "DFC_FSTEmin" 605 "DFC_FSTmax" 602 "DFC_FSTRmax" 603 "DFC_FSTRmin" 604 "DFC_FSTRnpl" 606 "DFC_FTDLAmax" 607 "DFC_FTDLAmin" 608 "DFC_FuPHiSnsrEleclmax" 609 "DFC_FuPHiSnsrEleclmin" 610 "DFC_FuPHiSnsrEleclnpl" 611 "DFC_FuPHiSnsrURngMax" 612 "DFC_FuPHiSnsrURngMin" 613 "DFC_FuSnsrPhyRngMaxErr" 614 "DFC_FuSnsrPhyRngMinErr" 188 "DFC_GbxCANDigPlausErr" 189 "DFC_GbxNPos1SRCMax" 190 "DFC_GbxNPos1SRCMin" 191 "DFC_GbxNPos2SRCMax" 192 "DFC_GbxNPos2SRCMin" 193 "DFC_GbxNPosAlvChk" 194 "DFC_GbxNPosSyncErr" 413 "DFC_GbxPNPosnDrvCdn" 414 "DFC_GbxPNPosnPlausy" 618 "DFC_GbxRvsSwtStk" 615 "DFC_GEVlvLockPinDiagIntkB1" 184 "DFC_GEVlvPhaCsersIntkB1" 185 "DFC_GEVlvPhaPsOpenLoadIntkB1" 186 "DFC_GEVlvPhaPsShoToBattIntkB1" 187 "DFC_GEVlvPhaPsShoToGndIntkB1" 616 "DFC_GEVlvPhaSlowIntkB1" 617 "DFC_GEVlvPhaTargIntkB1" 619 "DFC_HDRKHmax" 620 "DFC_HDRKHmin" 623 "DFC_HDRmax" 624 "DFC_HDRmin" 621 "DFC_HDRPLmax" 622 "DFC_HDRPLmin" 625 "DFC_HEGOS2B1ElecMax" 626 "DFC_HEGOS2B1ElecMin" 627 "DFC_HEGOS2B1ElecSig" 628 "DFC_HEGOS2B1HtgNpl" 195 "DFC_HEGOS2B1HtrPsMax" 196 "DFC_HEGOS2B1HtrPsMin" 197 "DFC_HEGOS2B1HtrPsSig" 629 "DFC_HEV00max" 630 "DFC_HEV01max" 631 "DFC_HEV02max" 632 "DFC_HEV03max" 633 "DFC_HEVE0max" 634 "DFC_HEVE1max" 635 "DFC_HFMmax" 636 "DFC_HiPSysHiPMaxLimExcdd" 402 "DFC_HLSDemOvhtEngLim" 456 "DFC_I14229VINErr" 261 "DFC_IgnClPs_DevComErr" 262 "DFC_IgnClPs_LineOl_0" 263 "DFC_IgnClPs_LineOl_1" 264 "DFC_IgnClPs_LineOl_2" 265 "DFC_IgnClPs_LineOl_3" 266 "DFC_IgnClPs_LineScb_0" 267 "DFC_IgnClPs_LineScb_1" 268 "DFC_IgnClPs_LineScb_2" 269 "DFC_IgnClPs_LineScb_3" 270 "DFC_IgnClPs_LineScg_0" 271 "DFC_IgnClPs_LineScg_1" 272 "DFC_IgnClPs_LineScg_2" 273 "DFC_IgnClPs_LineScg_3" 457 "DFC_InjCatHeatgErr" 458 "DFC_InjSysMulInjDiagErr" 358 "DFC_InjVlv_DI_DcDc" 359 "DFC_InjVlv_DI_NoLd_0" 360 "DFC_InjVlv_DI_NoLd_1" 361 "DFC_InjVlv_DI_NoLd_2" 362 "DFC_InjVlv_DI_NoLd_3" 363 "DFC_InjVlv_DI_ScBnk_0" 364 "DFC_InjVlv_DI_ScBnk_1" 365 "DFC_InjVlv_DI_ScBnk_2" 366 "DFC_InjVlv_DI_ScBnk_3" 367 "DFC_InjVlv_DI_ScCyl_0" 368 "DFC_InjVlv_DI_ScCyl_1" 369 "DFC_InjVlv_DI_ScCyl_2" 370 "DFC_InjVlv_DI_ScCyl_3" 371 "DFC_InjVlv_DI_ScHsLs_0" 372 "DFC_InjVlv_DI_ScHsLs_1" 373 "DFC_InjVlv_DI_ScHsLs_2" 374 "DFC_InjVlv_DI_ScHsLs_3" 652 "DFC_IntkAirTAirFltDsCrssMax" 653 "DFC_IntkAirTAirFltDsCrssMin" 654 "DFC_IntkAirTAirFltDsHSCMax" 655 "DFC_IntkAirTAirFltDsImps" 656 "DFC_IntkAirTAirFltDsPRCMax" 657 "DFC_IntkAirTAirFltDsPRCMin" 658 "DFC_IntkAirTAirFltDsSRCMax" 659 "DFC_IntkAirTAirFltDsSRCMin" 660 "DFC_IntkAirTAirFltDsSTC" 661 "DFC_IntkAirTIntkMnfldCrssMax" 662 "DFC_IntkAirTIntkMnfldCrssMin" 663 "DFC_IntkAirTIntkMnfldHSCMax" 664 "DFC_IntkAirTIntkMnfldImps" 665 "DFC_IntkAirTIntkMnfldPRCMax" 666 "DFC_IntkAirTIntkMnfldPRCMin" 667 "DFC_IntkAirTIntkMnfldSRCMax" 668 "DFC_IntkAirTIntkMnfldSRCMin" 669 "DFC_IntkAirTIntkMnfldSTC" 647 "DFC_IVGdiCtl_CvoErr" 648 "DFC_IVGdiCtl_CvoSigPlaus_0" 649 "DFC_IVGdiCtl_CvoSigPlaus_1" 650 "DFC_IVGdiCtl_CvoSigPlaus_2" 651 "DFC_IVGdiCtl_CvoSigPlaus_3" 637 "DFC_IVGdiCtlCvoErrMax_0" 638 "DFC_IVGdiCtlCvoErrMax_1" 639 "DFC_IVGdiCtlCvoErrMax_2" 640 "DFC_IVGdiCtlCvoErrMax_3" 641 "DFC_IVGdiCtlCvoErrMin_0" 642 "DFC_IVGdiCtlCvoErrMin_1" 643 "DFC_IVGdiCtlCvoErrMin_2" 644 "DFC_IVGdiCtlCvoErrMin_3" 645 "DFC_IVGdiCtlCvoErrMinMax" 646 "DFC_IVGdiCtlCvoSigPlausErrSmrCdn" 428 "DFC_KnDetSens1PortAMax" 429 "DFC_KnDetSens1PortAMin" 430 "DFC_KnDetSens1PortBMax" 431 "DFC_KnDetSens1PortBMin" 670 "DFC_KRREGRLMX" 671 "DFC_KRVEKOCVLCI" 672 "DFC_KRVEKOENCHMT" 673 "DFC_KRVEKOENCHMT0" 674 "DFC_KRVEKOENCHMT1" 675 "DFC_KRVEKOENCHMT2" 676 "DFC_KRVEKOENCHMT3" 677 "DFC_KRVEKOENCHMT4" 678 "DFC_KRVEKOENCHMT5" 679 "DFC_KRVEKOENCHMT6" 680 "DFC_KRVEKOENCHMT7" 274 "DFC_KRVEKOEVAB" 275 "DFC_KRVEKOEVAB0" 276 "DFC_KRVEKOEVAB1" 277 "DFC_KRVEKOEVAB2" 278 "DFC_KRVEKOEVAB3" 681 "DFC_KRVEKORLMX" 682 "DFC_KRVEKORLMXL" 683 "DFC_KS1max" 684 "DFC_KS1min" 687 "DFC_LamDynDiagS1B1" 688 "DFC_LeakIntkMnfldEmiInfl" 491 "DFC_LIN_E_TIMEOUT" 465 "DFC_LinACGUnit" 466 "DFC_LinAEVUnit" 198 "DFC_LinCSErrACG" 199 "DFC_LinCSErrAEV" 200 "DFC_LinCSErrDCDC" 201 "DFC_LinCSErrEBS" 467 "DFC_LinEBSUnit" 689 "DFC_LinFrameErrDCDC" 202 "DFC_LinHdrTimeoutErrACG" 203 "DFC_LinHdrTimeoutErrAEV" 204 "DFC_LinHdrTimeoutErrDCDC" 205 "DFC_LinHdrTimeoutErrEBS" 206 "DFC_LinMsgTimeoutErrACG" 207 "DFC_LinMsgTimeoutErrAEV" 208 "DFC_LinMsgTimeoutErrDCDC" 209 "DFC_LinMsgTimeoutErrEBS" 210 "DFC_LinNoStrtComErr" 690 "DFC_LinOverrunErrDCDC" 459 "DFC_LLRHmax" 460 "DFC_LLRHmin" 461 "DFC_LLRHnpl" 462 "DFC_LLRKHmax" 463 "DFC_LLRKHmin" 464 "DFC_LLRKHnpl" 685 "DFC_LMmax" 211 "DFC_LowPresOilP" 686 "DFC_LZSRnpl" 691 "DFC_MD00max" 692 "DFC_MDBmax" 693 "DFC_MDCat" 694 "DFC_MDCatCrit" 695 "DFC_MDCatCurr" 696 "DFC_MDCyl_0" 697 "DFC_MDCyl_1" 698 "DFC_MDCyl_2" 699 "DFC_MDCyl_3" 700 "DFC_MDEmi" 701 "DFC_MDEmiStrt" 702 "DFC_MDFco" 705 "DFC_MDmax" 703 "DFC_MDMpl" 704 "DFC_MDSegTiAdpn" 375 "DFC_MfPsDiaOpenLoad1" 376 "DFC_MfPsDiaScHiS1" 377 "DFC_MfPsDiaScHiSLowS1" 378 "DFC_MfPsDiaScLowS1" 706 "DFC_MFuOilMax" 228 "DFC_MisfDetdVWhlFrntLePlaus" 229 "DFC_MisfDetdVWhlFrntRiPlaus" 230 "DFC_MisfDetdVWhlReLePlaus" 231 "DFC_MisfDetdVWhlReRiPlaus" 212 "DFC_MisfDetVWhlFrntLeOORHi" 213 "DFC_MisfDetVWhlFrntLeRatyHi" 214 "DFC_MisfDetVWhlFrntLeRatyLo" 215 "DFC_MisfDetVWhlFrntLeStuck" 216 "DFC_MisfDetVWhlFrntRiOORHi" 217 "DFC_MisfDetVWhlFrntRiRatyHi" 218 "DFC_MisfDetVWhlFrntRiRatyLo" 219 "DFC_MisfDetVWhlFrntRiStuck" 220 "DFC_MisfDetVWhlReLeOORHi" 221 "DFC_MisfDetVWhlReLeRatyHi" 222 "DFC_MisfDetVWhlReLeRatyLo" 223 "DFC_MisfDetVWhlReLeStuck" 224 "DFC_MisfDetVWhlReRiOORHi" 225 "DFC_MisfDetVWhlReRiRatyHi" 226 "DFC_MisfDetVWhlReRiRatyLo" 227 "DFC_MisfDetVWhlReRiStuck" 801 "DFC_MoCADCNTP" 802 "DFC_MoCADCTst" 803 "DFC_MoCSOPICO" 805 "DFC_MoFAirFilgPrdc" 806 "DFC_MoFAirFlCtOffGdi" 807 "DFC_MoFAirFlCylGdi" 808 "DFC_MoFAirFlFF" 809 "DFC_MoFAirFlIn" 810 "DFC_MoFAirFlMixCtlGdiChkAirFl" 811 "DFC_MoFAirFlMixCtlGdiChkCtrl" 812 "DFC_MoFAirFlMode" 804 "DFC_MoFAPP" 813 "DFC_MoFESpd" 814 "DFC_MoFIACo" 815 "DFC_MoFICOL1" 816 "DFC_MoFICOL2" 817 "DFC_MoFStrt" 818 "DFC_MoFTrqCmp" 819 "DFC_MoFTrqCmpMax" 820 "DFC_MoFTrqCmpMin" 821 "DFC_MoFVarPostBldSel" 707 "DFC_MOXEMM_SMU_ALM0_0" 708 "DFC_MOXEMM_SMU_ALM0_1" 709 "DFC_MOXEMM_SMU_ALM0_10" 710 "DFC_MOXEMM_SMU_ALM0_11" 711 "DFC_MOXEMM_SMU_ALM0_13" 712 "DFC_MOXEMM_SMU_ALM0_14" 713 "DFC_MOXEMM_SMU_ALM0_2" 714 "DFC_MOXEMM_SMU_ALM0_22" 715 "DFC_MOXEMM_SMU_ALM0_23" 716 "DFC_MOXEMM_SMU_ALM0_4" 717 "DFC_MOXEMM_SMU_ALM0_5" 718 "DFC_MOXEMM_SMU_ALM0_7" 719 "DFC_MOXEMM_SMU_ALM0_8" 720 "DFC_MOXEMM_SMU_ALM10_16" 721 "DFC_MOXEMM_SMU_ALM10_17" 722 "DFC_MOXEMM_SMU_ALM10_21" 723 "DFC_MOXEMM_SMU_ALM11_0" 724 "DFC_MOXEMM_SMU_ALM11_1" 725 "DFC_MOXEMM_SMU_ALM11_2" 726 "DFC_MOXEMM_SMU_ALM11_3" 727 "DFC_MOXEMM_SMU_ALM11_4" 728 "DFC_MOXEMM_SMU_ALM11_5" 729 "DFC_MOXEMM_SMU_ALM11_8" 730 "DFC_MOXEMM_SMU_ALM11_9" 731 "DFC_MOXEMM_SMU_ALM1_0" 732 "DFC_MOXEMM_SMU_ALM1_1" 733 "DFC_MOXEMM_SMU_ALM1_10" 734 "DFC_MOXEMM_SMU_ALM1_11" 735 "DFC_MOXEMM_SMU_ALM1_13" 736 "DFC_MOXEMM_SMU_ALM1_14" 737 "DFC_MOXEMM_SMU_ALM1_2" 738 "DFC_MOXEMM_SMU_ALM1_22" 739 "DFC_MOXEMM_SMU_ALM1_23" 740 "DFC_MOXEMM_SMU_ALM1_4" 741 "DFC_MOXEMM_SMU_ALM1_5" 742 "DFC_MOXEMM_SMU_ALM1_7" 743 "DFC_MOXEMM_SMU_ALM1_8" 744 "DFC_MOXEMM_SMU_ALM21_0" 745 "DFC_MOXEMM_SMU_ALM21_16" 746 "DFC_MOXEMM_SMU_ALM21_3" 747 "DFC_MOXEMM_SMU_ALM2_1" 748 "DFC_MOXEMM_SMU_ALM2_10" 749 "DFC_MOXEMM_SMU_ALM2_11" 750 "DFC_MOXEMM_SMU_ALM2_13" 751 "DFC_MOXEMM_SMU_ALM2_14" 752 "DFC_MOXEMM_SMU_ALM2_22" 753 "DFC_MOXEMM_SMU_ALM2_23" 754 "DFC_MOXEMM_SMU_ALM2_4" 755 "DFC_MOXEMM_SMU_ALM2_5" 756 "DFC_MOXEMM_SMU_ALM2_7" 757 "DFC_MOXEMM_SMU_ALM2_8" 758 "DFC_MOXEMM_SMU_ALM6_0" 759 "DFC_MOXEMM_SMU_ALM6_11" 760 "DFC_MOXEMM_SMU_ALM6_12" 761 "DFC_MOXEMM_SMU_ALM6_14" 762 "DFC_MOXEMM_SMU_ALM6_15" 763 "DFC_MOXEMM_SMU_ALM6_17" 764 "DFC_MOXEMM_SMU_ALM6_18" 765 "DFC_MOXEMM_SMU_ALM6_20" 766 "DFC_MOXEMM_SMU_ALM6_21" 767 "DFC_MOXEMM_SMU_ALM6_25" 768 "DFC_MOXEMM_SMU_ALM6_4" 769 "DFC_MOXEMM_SMU_ALM6_5" 770 "DFC_MOXEMM_SMU_ALM6_7" 771 "DFC_MOXEMM_SMU_ALM6_8" 772 "DFC_MOXEMM_SMU_ALM7_1" 773 "DFC_MOXEMM_SMU_ALM7_12" 774 "DFC_MOXEMM_SMU_ALM7_13" 775 "DFC_MOXEMM_SMU_ALM7_14" 776 "DFC_MOXEMM_SMU_ALM7_15" 777 "DFC_MOXEMM_SMU_ALM7_16" 778 "DFC_MOXEMM_SMU_ALM7_17" 779 "DFC_MOXEMM_SMU_ALM7_2" 780 "DFC_MOXEMM_SMU_ALM7_20" 781 "DFC_MOXEMM_SMU_ALM7_25" 782 "DFC_MOXEMM_SMU_ALM7_26" 783 "DFC_MOXEMM_SMU_ALM7_28" 784 "DFC_MOXEMM_SMU_ALM7_29" 785 "DFC_MOXEMM_SMU_ALM7_30" 786 "DFC_MOXEMM_SMU_ALM7_31" 787 "DFC_MOXEMM_SMU_ALM8_0" 788 "DFC_MOXEMM_SMU_ALM8_1" 789 "DFC_MOXEMM_SMU_ALM8_10" 790 "DFC_MOXEMM_SMU_ALM8_11" 791 "DFC_MOXEMM_SMU_ALM8_12" 792 "DFC_MOXEMM_SMU_ALM8_16" 793 "DFC_MOXEMM_SMU_ALM8_18" 794 "DFC_MOXEMM_SMU_ALM8_2" 795 "DFC_MOXEMM_SMU_ALM8_3" 796 "DFC_MOXEMM_SMU_ALM8_31" 797 "DFC_MOXEMM_SMU_ALM8_4" 798 "DFC_MOXEMM_SMU_ALM9_0" 799 "DFC_MOXEMM_SMU_ALM9_15" 800 "DFC_MOXEMM_SMU_ALM9_3" 822 "DFC_MoXEMMHwLTMCUFW" 823 "DFC_MoXEMMHwLTMonBIST" 824 "DFC_MoXEMMHwLTRegMonTest" 825 "DFC_MoXEMMHwLTStbySMUAlvTest" 826 "DFC_MoXEMMHwLTTempSens" 827 "DFC_MoXEMMHwLTUCBCfg" 335 "DFC_MRlyDcOL" 336 "DFC_MRlyDcSCB" 337 "DFC_MRlyDcSCG" 492 "DFC_MRlyOL" 493 "DFC_MRlySCB" 494 "DFC_MRlySCG" 828 "DFC_NWSEmax" 829 "DFC_NWSmax" 830 "DFC_OCWDAABEActv" 831 "DFC_OCWDACom" 832 "DFC_OCWDAErrPin" 833 "DFC_OCWDAOvrVltg" 836 "DFC_OilPPlaus" 403 "DFC_OilPSwmpSRCMax" 404 "DFC_OilPSwmpSRCMin" 834 "DFC_ORAmax" 835 "DFC_ORAmin" 847 "DFC_P_VSE11_OL" 848 "DFC_P_VSE11_SCB" 849 "DFC_P_VSE11_SCG" 417 "DFC_PEnvCcMax" 418 "DFC_PEnvCcMin" 419 "DFC_PEnvRngChkMax" 420 "DFC_PEnvRngChkMin" 232 "DFC_PEnvSigRngMax" 233 "DFC_PEnvSigRngMin" 421 "DFC_PEnvSnsrPlaus" 850 "DFC_PhyHighAPP1" 851 "DFC_PhyHighAPP2" 852 "DFC_PhyLowAPP1" 853 "DFC_PhyLowAPP2" 405 "DFC_PIntkVUsLineHiB1" 406 "DFC_PIntkVUsLineLoB1" 837 "DFC_PLLSUmax" 838 "DFC_PLLSUmin" 338 "DFC_PSPOL" 339 "DFC_PSPOvrTemp" 340 "DFC_PSPSCB" 341 "DFC_PSPSCG" 839 "DFC_PSR1max" 840 "DFC_PSRBmax" 841 "DFC_PSRBmin" 845 "DFC_PSRmax" 842 "DFC_PSRPmax" 843 "DFC_PSRPmin" 844 "DFC_PSRPsig" 846 "DFC_PUmax" 475 "DFC_RBA_IODIAGPWR_rba_IoExtCy329_SignalVltSply_0" 476 "DFC_RBA_IODIAGPWR_rba_IoExtCy329_SignalVltSply_0OT" 477 "DFC_RBA_IODIAGPWR_rba_IoExtCy329_SignalVltSply_0OV" 478 "DFC_RBA_IODIAGPWR_rba_IoExtCy329_SignalVltSply_0SCG" 479 "DFC_RBA_IODIAGPWR_rba_IoExtCy329_SignalVltSply_0UV" 480 "DFC_RBA_IODIAGPWR_rba_IoExtCy329_SignalVltSply_1" 481 "DFC_RBA_IODIAGPWR_rba_IoExtCy329_SignalVltSply_1OT" 482 "DFC_RBA_IODIAGPWR_rba_IoExtCy329_SignalVltSply_1OV" 483 "DFC_RBA_IODIAGPWR_rba_IoExtCy329_SignalVltSply_1SCG" 484 "DFC_RBA_IODIAGPWR_rba_IoExtCy329_SignalVltSply_1UV" 485 "DFC_RBA_IODIAGPWR_rba_IoExtCy329_SignalVltSply_2" 486 "DFC_RBA_IODIAGPWR_rba_IoExtCy329_SignalVltSply_2OT" 487 "DFC_RBA_IODIAGPWR_rba_IoExtCy329_SignalVltSply_2OV" 488 "DFC_RBA_IODIAGPWR_rba_IoExtCy329_SignalVltSply_2SCG" 489 "DFC_RBA_IODIAGPWR_rba_IoExtCy329_SignalVltSply_2UV" 498 "DFC_RBA_IOEXTLIB_KEEPALIVE_DRV" 499 "DFC_RBA_IOEXTLIB_KEEPALIVE_INI" 500 "DFC_rba_IoSigRtc_StopCounter" 502 "DFC_rba_MemDiag_MemReadErr" 503 "DFC_rba_MemDiag_MemWrErr" 501 "DFC_rba_MRly_Diag_Stk_Event" 495 "DFC_rba_MultiStackTrace_Threshold" 504 "DFC_rba_SyC_IrrSwOffTrigEngRun_Event" 505 "DFC_rba_T15_Diag_ComInVld_Event" 506 "DFC_rba_T15_Diag_ComOff_HwOn_Event" 507 "DFC_rba_T15_Diag_ComOn_HwOff_Event" 468 "DFC_RoughRoad" 469 "DFC_SiaEEPRdErr" 470 "DFC_SiaEEPWrngCod" 854 "DFC_SRCHighAPP1" 855 "DFC_SRCHighAPP2" 856 "DFC_SRCLowAPP1" 857 "DFC_SRCLowAPP2" 858 "DFC_SSpMon2" 859 "DFC_STHDRmax" 234 "DFC_StmFault" 236 "DFC_StrtCtlErr" 235 "DFC_StrtCtOffPth" 237 "DFC_StrtFault" 238 "DFC_StrtLckJudg1" 239 "DFC_StrtLckJudg2" 240 "DFC_StrtOL" 241 "DFC_StrtOL2" 242 "DFC_StrtSCB" 243 "DFC_StrtSCB2" 244 "DFC_StrtSCG" 245 "DFC_StrtSCG2" 246 "DFC_StrtStkRly1" 247 "DFC_StrtStkRly2" 860 "DFC_SWReset_0" 861 "DFC_SWReset_1" 862 "DFC_SWReset_2" 863 "DFC_SyncAPP" 342 "DFC_T50Err" 865 "DFC_TAmax_Dummy" 864 "DFC_TANKLnpl" 866 "DFC_TESFmax" 867 "DFC_TESGmax" 248 "DFC_TEVEmax" 249 "DFC_TEVEmin" 250 "DFC_TEVEsig" 875 "DFC_ThrVlvClsdPosnFirstOffsLrnImpoB1" 876 "DFC_ThrVlvClsdPosnOffsLrnImpoB1" 877 "DFC_ThrVlvClsdPosnOffsLrnMaxB1" 878 "DFC_ThrVlvClsdPosnOffsLrnMinB1" 879 "DFC_ThrVlvCtrlDeB1" 880 "DFC_ThrVlvDycB1" 881 "DFC_ThrVlvLimpAirPosnMaxAbsltDriftB1" 882 "DFC_ThrVlvLimpAirPosnMaxB1" 883 "DFC_ThrVlvLimpAirPosnMaxRelDriftB1" 884 "DFC_ThrVlvLimpAirPosnMinB1" 343 "DFC_ThrVlvLoBattB1" 885 "DFC_ThrVlvOpenLoadB1" 886 "DFC_ThrVlvOpenSprgB1" 887 "DFC_ThrVlvOpenSprgSprdB1" 888 "DFC_ThrVlvOpenSprgTwnB1" 889 "DFC_ThrVlvOverTB1" 890 "DFC_ThrVlvRetSprgB1" 891 "DFC_ThrVlvRetSprgSprdB1" 892 "DFC_ThrVlvRetSprgTwnB1" 893 "DFC_ThrVlvSens1MaxB1" 900 "DFC_ThrvlvSens1MinB1" 894 "DFC_ThrVlvSens1NplB1" 895 "DFC_ThrVlvSens2MaxB1" 896 "DFC_ThrVlvSens2MinB1" 897 "DFC_ThrVlvSens2NplB1" 898 "DFC_ThrVlvShoCircB1" 899 "DFC_ThrVlvSpiErrB1" 901 "DFC_TiOffTBasdChkFast" 902 "DFC_TiOffTBasdChkSlow" 868 "DFC_TKAEmax" 869 "DFC_TKAEmin" 870 "DFC_TKARmax" 871 "DFC_TKARnpl" 872 "DFC_TMmax_Dummy" 873 "DFC_TUMmax_Dummy" 874 "DFC_TWCDPriCatB1" 251 "DFC_UegoHeatrPrfmncLoS1B1" 422 "DFC_UEGOHeatrRlyPsOLS1B1" 423 "DFC_UEGOHeatrRlyPsSCBS1B1" 424 "DFC_UEGOHeatrRlyPsSCGS1B1" 471 "DFC_UegoHeatrStrtS1B1" 425 "DFC_UegoHeatrWireOlS1B1" 426 "DFC_UegoHeatrWireScbS1B1" 427 "DFC_UegoHeatrWireScgS1B1" 279 "DFC_UegoSigEcuAsicS1B1" 280 "DFC_UegoSigEcuComS1B1" 344 "DFC_UegoSigOperPlausS1B1" 281 "DFC_UegoSigSnsrS1B1" 282 "DFC_UegoSigWireOlApesS1B1" 283 "DFC_UegoSigWireOlIpeS1B1" 284 "DFC_UegoSigWireOlReS1B1" 285 "DFC_UegoSigWireRCmpS1B1" 286 "DFC_UegoSigWireScbS1B1" 287 "DFC_UegoSigWireScgS1B1" 903 "DFC_UEGOSnsrMntdS1B1" 252 "DFC_VehVAllPlaus" 253 "DFC_VehVNCSnsrElecFailr" 345 "DFC_VehVPhysRngHi" 407 "DFC_VehVPhysRngLo" 254 "DFC_VehVPlausCan" 255 "DFC_VehVPlausFco" 256 "DFC_VehVPlausPwr" 257 "DFC_VehVPlausV2N" 346 "DFC_VehVSclOutOL" 347 "DFC_VehVSclOutOT" 348 "DFC_VehVSclOutSCB" 349 "DFC_VehVSclOutSCG" 904 "DFC_VehVSig" 408 "DFC_VehVSigCan" 409 "DFC_VehVSigCanSafe" 350 "DFC_VehVSigFL" 351 "DFC_VehVSigFR" 352 "DFC_VehVSigRL" 353 "DFC_VehVSigRR" 354 "DFC_VehVSnsrARngHi" 355 "DFC_VehVSnsrBRngHi" 356 "DFC_VehVSpdRtyDiag" 258 "DFC_VehVSpdSnsrAElecFailr" 259 "DFC_VehVSpdSnsrBElecFailr" 410 "DFC_VlvLftFbOilPSnsrIntk11SRCMax" 411 "DFC_VlvLftFbOilPSnsrIntk11SRCMin" 905 "DFC_VlvLftFbSwtIntk11SpclFail" 906 "DFC_VlvLftFbSwtIntk11StdFail" DEFAULT_VALUE "---" /end COMPU_VTAB
/begin COMPU_METHOD DIUMPR_CldStrtDenCldStrtTyp_C_Verb "" TAB_VERB "%6.3" "-" COMPU_TAB_REF DIUMPR_CldStrtDenCldStrtTyp_C_Verb /end COMPU_METHOD
/begin COMPU_VTAB DIUMPR_CldStrtDenCldStrtTyp_C_Verb "" TAB_VERB 2 0 "EOBD (ColdStart Denom)" 1 "CARB (Evap Denom)" /end COMPU_VTAB
/begin COMPU_METHOD DIUMPR_FilAFRIPFGrp_C_Verbal "" TAB_VERB "%6.3" "" COMPU_TAB_REF DIUMPR_FilAFRIPFGrp_C_Verbal /end COMPU_METHOD
/begin COMPU_VTAB DIUMPR_FilAFRIPFGrp_C_Verbal "" TAB_VERB 2 0 "No_Filter" 1 "Filter_AFRI_PF_Banks" /end COMPU_VTAB
/begin COMPU_METHOD DIUMPR_GroupVerb "" TAB_VERB "%6.3" "-" COMPU_TAB_REF DIUMPR_GroupVerb /end COMPU_METHOD
/begin COMPU_VTAB DIUMPR_GroupVerb "" TAB_VERB 15 0 "Catalyst_Bank1" 1 "Catalyst_Bank2" 2 "OxygenSensor_Bank1" 3 "OxygenSensor_Bank2" 4 "EGR_VVT" 5 "SecAirSys" 6 "EvpSys" 7 "SecOxySens_Bank1" 8 "SecOxySens_Bank2" 9 "AFRI_Bank1" 10 "AFRI_Bank2" 11 "PF_Bank1" 12 "PF_Bank2" 13 "Private" 14 "Unused" DEFAULT_VALUE "---" /end COMPU_VTAB
/begin COMPU_METHOD DIUMPR_l10km "" RAT_FUNC "%6.1" "km" COEFFS 0 1 0 0 0 10 /end COMPU_METHOD
/begin COMPU_METHOD DIUMPR_ti100ms "" RAT_FUNC "%6.3" "s" COEFFS 0 10 0 0 0 1 /end COMPU_METHOD
/begin COMPU_METHOD DIUMPR_xSelTstrNumrInctLock_C_Verbal "" TAB_VERB "%6.3" "" COMPU_TAB_REF DIUMPR_xSelTstrNumrInctLock_C_Verbal /end COMPU_METHOD
/begin COMPU_VTAB DIUMPR_xSelTstrNumrInctLock_C_Verbal "" TAB_VERB 2 0 "NO_LOCK" 1 "LOCK" /end COMPU_VTAB
/begin COMPU_METHOD EngN "" RAT_FUNC "%6.3" "rpm" COEFFS 0 2 0 0 0 1 /end COMPU_METHOD
/begin COMPU_METHOD EVAPDI_VAR_SY_Compu "" TAB_VERB "%6.3" "" COMPU_TAB_REF EVAPDI_VAR_SY_Compu /end COMPU_METHOD
/begin COMPU_VTAB EVAPDI_VAR_SY_Compu "" TAB_VERB 58 0 "kein Kundenbezug" 1 "DAI" 3 "VWW" 4 "POR" 5 "AUD" 6 "OPE" 9 "FIA" 11 "BMW" 14 "PSA" 15 "REN" 17 "ALF" 18 "SAB" 19 "VOL" 20 "NIS" 21 "GMU" 22 "FOR" 26 "IMJ" 36 "MAN" 51 "SEA" 53 "CHR" 54 "JAG" 55 "ROL" 69 "FER" 72 "TOY" 73 "LAM" 123 "MIT" 147 "HYU" 159 "HON" 160 "MAZ" 183 "CU" 190 "LRG" 204 "VVW" 214 "AVT" 242 "Iveco" 243 "DMC" 248 "SUZ" 267 "SSANGYONG" 270 "KEF" 289 "AMG" 308 "TAT" 319 "MVM" 327 "OTOSAN" 328 "MM" 385 "UAES" 590 "Scania" 609 "Deutz" 720 "Greatwall" 745 "JMC Ford" 788 "Saic Motor" 828 "RBCD" 898 "MFTBC" 936 "Anhui_Quanchai" 944 "DOOSAN Infracore" 984 "FAW - Wuxi" 999 "ALL" 2887 "Nonox" 9454 "Fuso" 9707 "Hatz" /end COMPU_VTAB
/begin COMPU_METHOD EVAPPU_LOADDETRMOLC_SC_Compu "" TAB_VERB "%6.3" "" COMPU_TAB_REF EVAPPU_LOADDETRMOLC_SC_Compu /end COMPU_METHOD
/begin COMPU_VTAB EVAPPU_LOADDETRMOLC_SC_Compu "" TAB_VERB 2 0 "False" 1 "True" /end COMPU_VTAB
/begin COMPU_METHOD EVAPPU_VAR_SY_Compu "" TAB_VERB "%6.3" "" COMPU_TAB_REF EVAPPU_VAR_SY_Compu /end COMPU_METHOD
/begin COMPU_VTAB EVAPPU_VAR_SY_Compu "" TAB_VERB 58 0 "kein Kundenbezug" 1 "DAI" 3 "VWW" 4 "POR" 5 "AUD" 6 "OPE" 9 "FIA" 11 "BMW" 14 "PSA" 15 "REN" 17 "ALF" 18 "SAB" 19 "VOL" 20 "NIS" 21 "GMU" 22 "FOR" 26 "IMJ" 36 "MAN" 51 "SEA" 53 "CHR" 54 "JAG" 55 "ROL" 69 "FER" 72 "TOY" 73 "LAM" 123 "MIT" 147 "HYU" 159 "HON" 160 "MAZ" 183 "CU" 190 "LRG" 204 "VVW" 214 "AVT" 242 "Iveco" 243 "DMC" 248 "SUZ" 267 "SSANGYONG" 270 "KEF" 289 "AMG" 308 "TAT" 319 "MVM" 327 "OTOSAN" 328 "MM" 385 "UAES" 590 "Scania" 609 "Deutz" 720 "Greatwall" 745 "JMC Ford" 788 "Saic Motor" 828 "RBCD" 898 "MFTBC" 936 "Anhui_Quanchai" 944 "DOOSAN Infracore" 984 "FAW - Wuxi" 999 "ALL" 2887 "Nonox" 9454 "Fuso" 9707 "Hatz" /end COMPU_VTAB
/begin COMPU_METHOD EVAPRDSMIXFLDP_TYPAVL_SC_Compu "" TAB_VERB "%6.3" "" COMPU_TAB_REF EVAPRDSMIXFLDP_TYPAVL_SC_Compu /end COMPU_METHOD
/begin COMPU_VTAB EVAPRDSMIXFLDP_TYPAVL_SC_Compu "" TAB_VERB 2 0 "False" 1 "True" /end COMPU_VTAB
/begin COMPU_METHOD EVAPRDSMIXFLDT_TYPAVL_SC_Compu "" TAB_VERB "%6.3" "" COMPU_TAB_REF EVAPRDSMIXFLDT_TYPAVL_SC_Compu /end COMPU_METHOD
/begin COMPU_VTAB EVAPRDSMIXFLDT_TYPAVL_SC_Compu "" TAB_VERB 2 0 "False" 1 "True" /end COMPU_VTAB
/begin COMPU_METHOD EVAPSNSR_DTESKEONV_SC_Compu "" TAB_VERB "%6.3" "" COMPU_TAB_REF EVAPSNSR_DTESKEONV_SC_Compu /end COMPU_METHOD
/begin COMPU_VTAB EVAPSNSR_DTESKEONV_SC_Compu "" TAB_VERB 2 0 "False" 1 "True" /end COMPU_VTAB
/begin COMPU_METHOD EVAPSNSR_PHILOADOFFSCHK_SC_Compu "" TAB_VERB "%6.3" "" COMPU_TAB_REF EVAPSNSR_PHILOADOFFSCHK_SC_Compu /end COMPU_METHOD
/begin COMPU_VTAB EVAPSNSR_PHILOADOFFSCHK_SC_Compu "" TAB_VERB 4 0 "00_NO_OFFSCHK" 1 "01_OFFSCHK" 2 "02_CODWORD" 3 "03_CRSSCHK" /end COMPU_VTAB
/begin COMPU_METHOD EVAPSNSR_PHILOADSTUCKCHK_SC_Compu "" TAB_VERB "%6.3" "" COMPU_TAB_REF EVAPSNSR_PHILOADSTUCKCHK_SC_Compu /end COMPU_METHOD
/begin COMPU_VTAB EVAPSNSR_PHILOADSTUCKCHK_SC_Compu "" TAB_VERB 4 0 "00_NO_STUCKCHK" 1 "01_STUCKCHK_GRDT" 2 "02_CODWORD" 3 "03_STUCKCHK_DRGPTR" /end COMPU_VTAB
/begin COMPU_METHOD EVAPSNSR_PHILOAD_SC_Compu "" TAB_VERB "%6.3" "" COMPU_TAB_REF EVAPSNSR_PHILOAD_SC_Compu /end COMPU_METHOD
/begin COMPU_VTAB EVAPSNSR_PHILOAD_SC_Compu "" TAB_VERB 3 0 "00_NO_SNSR" 1 "01_AI_SNSR" 2 "02_CODWORD" /end COMPU_VTAB
/begin COMPU_METHOD EVAPSNSR_PID32_SC_Compu "" TAB_VERB "%6.3" "" COMPU_TAB_REF EVAPSNSR_PID32_SC_Compu /end COMPU_METHOD
/begin COMPU_VTAB EVAPSNSR_PID32_SC_Compu "" TAB_VERB 6 0 "00_NOT_SUPRTD" 1 "01_PTANK" 2 "02_PPURGLINE_ACF_CPV" 3 "03_PPURGLINE_CPV_OWV" 4 "04_PHILOAD" 5 "05_CODEWORD" /end COMPU_VTAB
/begin COMPU_METHOD EVAPSNSR_PID53_SC_Compu "" TAB_VERB "%6.3" "" COMPU_TAB_REF EVAPSNSR_PID53_SC_Compu /end COMPU_METHOD
/begin COMPU_VTAB EVAPSNSR_PID53_SC_Compu "" TAB_VERB 6 0 "00_NOT_SUPRTD" 1 "01_PTANK" 2 "02_PPURGLINE_ACF_CPV" 3 "03_PPURGLINE_CPV_OWV" 4 "04_PHILOAD" 5 "05_CODWORD" /end COMPU_VTAB
/begin COMPU_METHOD EVAPSNSR_PID54_SC_Compu "" TAB_VERB "%6.3" "" COMPU_TAB_REF EVAPSNSR_PID54_SC_Compu /end COMPU_METHOD
/begin COMPU_VTAB EVAPSNSR_PID54_SC_Compu "" TAB_VERB 6 0 "00_NOT_SUPRTD" 1 "01_PTANK" 2 "02_PPURGLINE_ACF_CPV" 3 "03_PPURGLINE_CPV_OWV" 4 "04_PHILOAD" 5 "05_CODWORD" /end COMPU_VTAB
/begin COMPU_METHOD EVAPSNSR_PIDAE_SC_Compu "" TAB_VERB "%6.3" "" COMPU_TAB_REF EVAPSNSR_PIDAE_SC_Compu /end COMPU_METHOD
/begin COMPU_VTAB EVAPSNSR_PIDAE_SC_Compu "" TAB_VERB 6 0 "00_NOT_SUPRTD" 1 "01_PTANK" 2 "02_PPURGLINE_ACF_CPV" 3 "03_PPURGLINE_CPV_OWV" 4 "04_PHILOAD" 5 "05_CODWORD" /end COMPU_VTAB
/begin COMPU_METHOD EVAPSNSR_PPURGLINE_SC_Compu "" TAB_VERB "%6.3" "" COMPU_TAB_REF EVAPSNSR_PPURGLINE_SC_Compu /end COMPU_METHOD
/begin COMPU_VTAB EVAPSNSR_PPURGLINE_SC_Compu "" TAB_VERB 3 0 "00_NO_SNSR" 1 "01_AI_SNSR" 2 "02_CODWORD" /end COMPU_VTAB
/begin COMPU_METHOD EVAPSNSR_REFUFLAPSNSRDIAGSTGY_SC_Compu "" TAB_VERB "%6.3" "" COMPU_TAB_REF EVAPSNSR_REFUFLAPSNSRDIAGSTGY_SC_Compu /end COMPU_METHOD
/begin COMPU_VTAB EVAPSNSR_REFUFLAPSNSRDIAGSTGY_SC_Compu "" TAB_VERB 3 0 "NO_SNSR" 1 "STRATEGY_1" 2 "STRATEGY_2" /end COMPU_VTAB
/begin COMPU_METHOD EVAPSNSR_REFUFLAPSNSRTYP_SC_Compu "" TAB_VERB "%6.3" "" COMPU_TAB_REF EVAPSNSR_REFUFLAPSNSRTYP_SC_Compu /end COMPU_METHOD
/begin COMPU_VTAB EVAPSNSR_REFUFLAPSNSRTYP_SC_Compu "" TAB_VERB 3 0 "NO_SNSR" 1 "ANALOG" 2 "DIGITAL" /end COMPU_VTAB
/begin COMPU_METHOD EVAPSNSR_TCPVCRSSCHK_SC_Compu "" TAB_VERB "%6.3" "" COMPU_TAB_REF EVAPSNSR_TCPVCRSSCHK_SC_Compu /end COMPU_METHOD
/begin COMPU_VTAB EVAPSNSR_TCPVCRSSCHK_SC_Compu "" TAB_VERB 2 0 "False" 1 "True" /end COMPU_VTAB
/begin COMPU_METHOD EVAPSNSR_TPURGLINESNSRPOSN_SC_Compu "" TAB_VERB "%6.3" "" COMPU_TAB_REF EVAPSNSR_TPURGLINESNSRPOSN_SC_Compu /end COMPU_METHOD
/begin COMPU_VTAB EVAPSNSR_TPURGLINESNSRPOSN_SC_Compu "" TAB_VERB 3 0 "00_PURGLINE" 1 "01_HILOAD" 2 "02_CODWORD" /end COMPU_VTAB
/begin COMPU_METHOD Fact "" RAT_FUNC "%6.5" "-" COEFFS 0 8192 0 0 0 1 /end COMPU_METHOD
/begin COMPU_METHOD fak_uw_b2 "" RAT_FUNC "%7.6" "-" COEFFS 0 65536 0 0 0 2 /end COMPU_METHOD
/begin COMPU_METHOD nmot_uw_q0p25 "" RAT_FUNC "%6.3" "1/min" COEFFS 0 1 0 0 0 0.25 /end COMPU_METHOD
/begin COMPU_METHOD OneToOne "" RAT_FUNC "%6.2" "-" COEFFS 0 1 0 0 0 1 /end COMPU_METHOD
/begin COMPU_METHOD Prc "" RAT_FUNC "%6.4" "%" COEFFS 0 81.92 0 0 0 1 /end COMPU_METHOD
/begin COMPU_METHOD Pres_hPa "" RAT_FUNC "%6.2" "hPa" COEFFS 0 1 0 0 0 1 /end COMPU_METHOD
/begin COMPU_METHOD p_q0p0005 "" RAT_FUNC "%6.5" "MPa" COEFFS 0 10000 0 0 0 5 /end COMPU_METHOD
/begin COMPU_METHOD RBPtCel_p_0p002_1 "" RAT_FUNC "%6.4" "MPa" COEFFS 0 1000 0 0 0 2 /end COMPU_METHOD
/begin COMPU_METHOD rel_sw_b1536 "" RAT_FUNC "%6.4" "%" COEFFS 0 65536 0 0 0 3072 /end COMPU_METHOD
/begin COMPU_METHOD rel_uw_b3072 "" RAT_FUNC "%6.4" "%" COEFFS 0 65536 0 0 0 3072 /end COMPU_METHOD
/begin COMPU_METHOD rel_uw_q0p0234 "" RAT_FUNC "%6.4" "%" COEFFS 0 32 0 0 0 0.75 /end COMPU_METHOD
/begin COMPU_METHOD spg_q3p906Em4_V_ms "" RAT_FUNC "%6.5" "V*ms" COEFFS 0 65536 0 0 0 25.6 /end COMPU_METHOD
/begin COMPU_METHOD t100msxs_ub_b25p5 "" RAT_FUNC "%6.3" "s" COEFFS 0 1 0 0 0 0.1 /end COMPU_METHOD
/begin COMPU_METHOD t100msxs_uw_b6553p5 "" RAT_FUNC "%6.3" "s" COEFFS 0 1 0 0 0 0.1 /end COMPU_METHOD
/begin COMPU_METHOD t200msxs_ub_b51 "" RAT_FUNC "%6.3" "s" COEFFS 0 1 0 0 0 0.2 /end COMPU_METHOD
/begin COMPU_METHOD Temp_Cels "" RAT_FUNC "%6.1" "deg C" COEFFS 0 10 2731.4 0 0 1 /end COMPU_METHOD
/begin COMPU_METHOD temp_ub_q0p75_o48 "" RAT_FUNC "%6.2" "Grad C" COEFFS 0 1 48 0 0 0.75 /end COMPU_METHOD
/begin COMPU_METHOD t_q0p02 "" RAT_FUNC "%6.4" "s" COEFFS 0 100 0 0 0 2 /end COMPU_METHOD
/begin COMPU_METHOD t_q0p1 "" RAT_FUNC "%6.3" "s" COEFFS 0 10 0 0 0 1 /end COMPU_METHOD
/begin COMPU_METHOD t_q0p2 "" RAT_FUNC "%6.3" "s" COEFFS 0 10 0 0 0 2 /end COMPU_METHOD
/begin COMPU_METHOD Vel "" RAT_FUNC "%6.4" "km/h" COEFFS 0 100 0 0 0 1 /end COMPU_METHOD
/begin COMPU_METHOD Volt_Batt "" RAT_FUNC "%6.1" "mV" COEFFS 0 0.05 0 0 0 1 /end COMPU_METHOD
/begin COMPU_METHOD zk100msxs_uw_b6553p6 "" RAT_FUNC "%6.1" "s" COEFFS 0 0 65536 0 10 0 /end COMPU_METHOD
/begin COMPU_METHOD zk200msxs_uw_b13107p2 "" RAT_FUNC "%6.0" "s" COEFFS 0 0 65536 0 5 0 /end COMPU_METHOD
/begin COMPU_METHOD zk20msxs_uw_b1310 "" RAT_FUNC "%6.1" "s" COEFFS 0 0 65536 0 50 0 /end COMPU_METHOD
/begin RECORD_LAYOUT RB_Axis_S16 NO_AXIS_PTS_X 1 SWORD AXIS_PTS_X 2 SWORD INDEX_INCR DIRECT /end RECORD_LAYOUT
/begin RECORD_LAYOUT RB_CurveGroup_U16 FNC_VALUES 1 UWORD COLUMN_DIR DIRECT /end RECORD_LAYOUT
/begin RECORD_LAYOUT RB_Curve_S16_U16_Static NO_AXIS_PTS_X 1 SWORD AXIS_PTS_X 2 SWORD INDEX_INCR DIRECT FNC_VALUES 3 UWORD COLUMN_DIR DIRECT STATIC_RECORD_LAYOUT /end RECORD_LAYOUT
/begin RECORD_LAYOUT RB_Curve_U16_U16 NO_AXIS_PTS_X 1 UWORD AXIS_PTS_X 2 UWORD INDEX_INCR DIRECT FNC_VALUES 3 UWORD COLUMN_DIR DIRECT /end RECORD_LAYOUT
/begin RECORD_LAYOUT RB_Curve_U8_U16_Static NO_AXIS_PTS_X 1 UBYTE AXIS_PTS_X 2 UBYTE INDEX_INCR DIRECT FNC_VALUES 3 UWORD COLUMN_DIR DIRECT STATIC_RECORD_LAYOUT /end RECORD_LAYOUT
/begin RECORD_LAYOUT RB_Map_S16U16_U16 NO_AXIS_PTS_X 1 SWORD NO_AXIS_PTS_Y 2 SWORD AXIS_PTS_X 3 SWORD INDEX_INCR DIRECT AXIS_PTS_Y 4 UWORD INDEX_INCR DIRECT FNC_VALUES 5 UWORD ROW_DIR DIRECT /end RECORD_LAYOUT
/begin RECORD_LAYOUT RB_Val_Ws16 FNC_VALUES 1 SWORD COLUMN_DIR DIRECT /end RECORD_LAYOUT
/begin RECORD_LAYOUT RB_Val_Wu16 FNC_VALUES 1 UWORD COLUMN_DIR DIRECT /end RECORD_LAYOUT
/begin RECORD_LAYOUT RB_Val_Wu8 FNC_VALUES 1 UBYTE COLUMN_DIR DIRECT /end RECORD_LAYOUT
/begin RECORD_LAYOUT Val_Ws16 FNC_VALUES 1 SWORD COLUMN_DIR DIRECT /end RECORD_LAYOUT
/begin RECORD_LAYOUT Val_Wu16 FNC_VALUES 1 UWORD COLUMN_DIR DIRECT /end RECORD_LAYOUT
/begin RECORD_LAYOUT Val_Wu8 FNC_VALUES 1 UBYTE COLUMN_DIR DIRECT /end RECORD_LAYOUT
/end MODULE
/end PROJECT
