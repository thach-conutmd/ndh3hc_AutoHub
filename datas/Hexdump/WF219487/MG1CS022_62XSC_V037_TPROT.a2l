ASAP2_VERSION 1 60
/begin PROJECT MG1CS022 "MG1CS022"
/begin HEADER "" VERSION "MG1CS022_62XSC_V037_TPROT" PROJECT_NO MG1CS022 /end HEADER
/begin MODULE DIM ""
/begin MOD_COMMON "" BYTE_ORDER MSB_LAST ALIGNMENT_BYTE 1 ALIGNMENT_WORD 2 ALIGNMENT_LONG 4 ALIGNMENT_INT64 4 ALIGNMENT_FLOAT32_IEEE 4 ALIGNMENT_FLOAT64_IEEE 4 DATA_SIZE 32 /end MOD_COMMON
/begin CHARACTERISTIC EGRVlv_ActrPwrStgDrvr_Cal.swtConf_C "Class for Actuator power stage driver / e_:Minimum allowable motor torque/ motor torque threshold in downward direction to activate ramping:_e;d_:Minimales erlaubtes Motormoment in Richtung unten um Rampe zu aktivieren:_d" VALUE 0x8053B7B8 Val_Wu8 255.0 OneToOne 0.00 255.0 FORMAT "%5.1" /end CHARACTERISTIC
/begin CHARACTERISTIC EGRVlv_ActrPwrStgDrvr_Cal.stMOCSOPChk_C "Class for Actuator power stage driver / e_:Minimum upper motor torque:_e;d_:Minimum des oberen Motordrehmoments:_d" VALUE 0x8053B7B9 Val_Wu8 255.0 OneToOne 0.00 255.0 FORMAT "%5.1" /end CHARACTERISTIC
/begin CHARACTERISTIC EGRVlv_ActrPwrStgDrvr_Cal.swtPSDis_C "Class for Actuator power stage driver / e_:Minimum motor initial torque:_e;d_:Minimum des initialen Motormoments:_d" VALUE 0x8053B7BA Val_Wu16 65535.00 OneToOne 0.00 65535.00 FORMAT "%8.2" /end CHARACTERISTIC
/begin CHARACTERISTIC EGRVlv_ActrSpFiltiDesValFil_MAP "Slow response simulator map" MAP 0x8058B0B4 RB_Map_S16S16_S16 6.553500 q1Em4_s -3.276800 3.276700 FORMAT "%8.6"
 /begin AXIS_DESCR STD_AXIS NO_INPUT_QUANTITY Prc 25 -400.0000 399.9878 FORMAT "%8.4" DEPOSIT ABSOLUTE /end AXIS_DESCR
 /begin AXIS_DESCR STD_AXIS NO_INPUT_QUANTITY Prc 25 -400.0000 399.9878 FORMAT "%8.4" DEPOSIT ABSOLUTE /end AXIS_DESCR
/end CHARACTERISTIC
/begin CHARACTERISTIC EGRVlv_ActrSpGrdtLimnCal.numTempSnsr_C "Gradient limitation calibration parameters / e_:Label for selecting the desired temperature:_e;d_:Label zur Auwahl der gewünschten Temperatur:_d" VALUE 0x8053B7C2 Val_Wu16 255.000000000 DELIB_ALLTEMP_VERB_COMPU 0.00 255.000000000 FORMAT "%13.9" /end CHARACTERISTIC
/begin CHARACTERISTIC EGRVlv_ActrSpGrdtLimnCal.tHi_C "Gradient limitation calibration parameters / e_:Upper threshold for the temperature hysteresis of the desired temperature:_e;d_:Obere Schwelle der Temperaturhysterese der gewünschten Temperatur:_d" VALUE 0x8053B7C4 Val_Ws16 6553.500 Temp_Cels -3549.940 3003.560 FORMAT "%8.3" /end CHARACTERISTIC
/begin CHARACTERISTIC EGRVlv_ActrSpGrdtLimnCal.tLo_C "Gradient limitation calibration parameters / e_:Lower threshold for the temperature hysteresis of the desired temperature:_e;d_:Untere Schwelle der Temperaturhysterese der gewünschten Temperatur:_d" VALUE 0x8053B7C6 Val_Ws16 6553.500 Temp_Cels -3549.940 3003.560 FORMAT "%8.3" /end CHARACTERISTIC
/begin CHARACTERISTIC EGRVlv_ActrSpGrdtLimnCalPrm1.rActLo_C "Parameter structure 1 of the gradient limitation / e_:Lower threshold for activation range:_e;d_:Untere Schranke des Aktivierungsbereichs:_d" VALUE 0x8053B7C8 Val_Ws16 799.9878 Prc -400.0000 399.9878 FORMAT "%8.4" /end CHARACTERISTIC
/begin CHARACTERISTIC EGRVlv_ActrSpGrdtLimnCalPrm1.rActHi_C "Parameter structure 1 of the gradient limitation / e_:Upper threshold for activation range:_e;d_:Obere Schranke des Aktivierungsbereichs:_d" VALUE 0x8053B7CA Val_Ws16 799.9878 Prc -400.0000 399.9878 FORMAT "%8.4" /end CHARACTERISTIC
/begin CHARACTERISTIC EGRVlv_ActrSpGrdtLimnCalPrm1.rDesValLo_C "Parameter structure 1 of the gradient limitation / e_:Lower threshold for the setpoint PrfXXX_rGovDesValBXXX to enter the active area of the ramp with a controlled speed:_e;d_:Untere Schwelle für den Lagesollwert PrfXXX_rGovDesValBXXX um die Rampe mit kontrollierter Geschwindigkeit zu starten:_d" VALUE 0x8053B7CC Val_Ws16 799.9878 Prc -400.0000 399.9878 FORMAT "%8.4" /end CHARACTERISTIC
/begin CHARACTERISTIC EGRVlv_ActrSpGrdtLimnCalPrm1.rDesValHi_C "Parameter structure 1 of the gradient limitation / e_:Upper threshold for the setpoint PrfXXX_rGovDesValBXXX to enter the active area of the ramp with a controlled speed:_e;d_:Obere Schwelle für den Lagesollwert PrfXXX_rGovDesValBXXXum die Rampe mit kontrollierter Geschwindigkeit zu starten:_d" VALUE 0x8053B7CE Val_Ws16 799.9878 Prc -400.0000 399.9878 FORMAT "%8.4" /end CHARACTERISTIC
/begin CHARACTERISTIC EGRVlv_ActrSpGrdtLimnCalPrm1.rGrdtPos_C "Parameter structure 1 of the gradient limitation / e_:Maximum positive slope for active gradient limitation:_e;d_:Maximale positive Steigung bei aktiver Gradientenlimitierung:_d" VALUE 0x8053B7D0 Val_Ws32 52428799.9878 PrcSec -26214400.0000 26214399.9878 FORMAT "%13.4" /end CHARACTERISTIC
/begin CHARACTERISTIC EGRVlv_ActrSpGrdtLimnCalPrm1.rGrdtNeg_C "Parameter structure 1 of the gradient limitation / e_:Maximum negative slope for active gradient limitation:_e;d_:Maximale negative Steigung bei aktiver Gradientenlimitierung:_d" VALUE 0x8053B7D4 Val_Ws32 52428799.9878 PrcSec -26214400.0000 26214399.9878 FORMAT "%13.4" /end CHARACTERISTIC
/begin CHARACTERISTIC EGRVlv_ActrSpGrdtLimnCalPrm1.stMaskEnvCond_C "Parameter structure 1 of the gradient limitation / e_:Bitmask to activate the gradient limitation based on PrfXXX_GrdtLimnMpBXXX.stGrdtLimnEnvRls:_e;d_:Bitmaske zur Aktivierung der Gradientenlimitierung basierend auf PrfXXX_GrdtLimnMpBXXX.stGrdtLimnEnvRls:_d" VALUE 0x8053B7D8 Val_Wu16 65535.00 OneToOne 0.00 65535.00 FORMAT "%8.2" /end CHARACTERISTIC
/begin CHARACTERISTIC EGRVlv_ActrSpGrdtLimnCalPrm2.rActLo_C "Parameter structure 2 of the gradient limitation / e_:Lower threshold for activation range:_e;d_:Untere Schranke des Aktivierungsbereichs:_d" VALUE 0x8053B7DC Val_Ws16 799.9878 Prc -400.0000 399.9878 FORMAT "%8.4" /end CHARACTERISTIC
/begin CHARACTERISTIC EGRVlv_ActrSpGrdtLimnCalPrm2.rActHi_C "Parameter structure 2 of the gradient limitation / e_:Upper threshold for activation range:_e;d_:Obere Schranke des Aktivierungsbereichs:_d" VALUE 0x8053B7DE Val_Ws16 799.9878 Prc -400.0000 399.9878 FORMAT "%8.4" /end CHARACTERISTIC
/begin CHARACTERISTIC EGRVlv_ActrSpGrdtLimnCalPrm2.rDesValLo_C "Parameter structure 2 of the gradient limitation / e_:Lower threshold for the setpoint PrfXXX_rGovDesValBXXX to enter the active area of the ramp with a controlled speed:_e;d_:Untere Schwelle für den Lagesollwert PrfXXX_rGovDesValBXXX um die Rampe mit kontrollierter Geschwindigkeit zu starten:_d" VALUE 0x8053B7E0 Val_Ws16 799.9878 Prc -400.0000 399.9878 FORMAT "%8.4" /end CHARACTERISTIC
/begin CHARACTERISTIC EGRVlv_ActrSpGrdtLimnCalPrm2.rDesValHi_C "Parameter structure 2 of the gradient limitation / e_:Upper threshold for the setpoint PrfXXX_rGovDesValBXXX to enter the active area of the ramp with a controlled speed:_e;d_:Obere Schwelle für den Lagesollwert PrfXXX_rGovDesValBXXXum die Rampe mit kontrollierter Geschwindigkeit zu starten:_d" VALUE 0x8053B7E2 Val_Ws16 799.9878 Prc -400.0000 399.9878 FORMAT "%8.4" /end CHARACTERISTIC
/begin CHARACTERISTIC EGRVlv_ActrSpGrdtLimnCalPrm2.rGrdtPos_C "Parameter structure 2 of the gradient limitation / e_:Maximum positive slope for active gradient limitation:_e;d_:Maximale positive Steigung bei aktiver Gradientenlimitierung:_d" VALUE 0x8053B7E4 Val_Ws32 52428799.9878 PrcSec -26214400.0000 26214399.9878 FORMAT "%13.4" /end CHARACTERISTIC
/begin CHARACTERISTIC EGRVlv_ActrSpGrdtLimnCalPrm2.rGrdtNeg_C "Parameter structure 2 of the gradient limitation / e_:Maximum negative slope for active gradient limitation:_e;d_:Maximale negative Steigung bei aktiver Gradientenlimitierung:_d" VALUE 0x8053B7E8 Val_Ws32 52428799.9878 PrcSec -26214400.0000 26214399.9878 FORMAT "%13.4" /end CHARACTERISTIC
/begin CHARACTERISTIC EGRVlv_ActrSpGrdtLimnCalPrm2.stMaskEnvCond_C "Parameter structure 2 of the gradient limitation / e_:Bitmask to activate the gradient limitation based on PrfXXX_GrdtLimnMpBXXX.stGrdtLimnEnvRls:_e;d_:Bitmaske zur Aktivierung der Gradientenlimitierung basierend auf PrfXXX_GrdtLimnMpBXXX.stGrdtLimnEnvRls:_d" VALUE 0x8053B7EC Val_Wu16 65535.00 OneToOne 0.00 65535.00 FORMAT "%8.2" /end CHARACTERISTIC
/begin CHARACTERISTIC EGRVlv_ActrSpGrdtLimnCalPrm3.rActLo_C "Parameter structure 3 of the gradient limitation / e_:Lower threshold for activation range:_e;d_:Untere Schranke des Aktivierungsbereichs:_d" VALUE 0x8053B7F0 Val_Ws16 799.9878 Prc -400.0000 399.9878 FORMAT "%8.4" /end CHARACTERISTIC
/begin CHARACTERISTIC EGRVlv_ActrSpGrdtLimnCalPrm3.rActHi_C "Parameter structure 3 of the gradient limitation / e_:Upper threshold for activation range:_e;d_:Obere Schranke des Aktivierungsbereichs:_d" VALUE 0x8053B7F2 Val_Ws16 799.9878 Prc -400.0000 399.9878 FORMAT "%8.4" /end CHARACTERISTIC
/begin CHARACTERISTIC EGRVlv_ActrSpGrdtLimnCalPrm3.rDesValLo_C "Parameter structure 3 of the gradient limitation / e_:Lower threshold for the setpoint PrfXXX_rGovDesValBXXX to enter the active area of the ramp with a controlled speed:_e;d_:Untere Schwelle für den Lagesollwert PrfXXX_rGovDesValBXXX um die Rampe mit kontrollierter Geschwindigkeit zu starten:_d" VALUE 0x8053B7F4 Val_Ws16 799.9878 Prc -400.0000 399.9878 FORMAT "%8.4" /end CHARACTERISTIC
/begin CHARACTERISTIC EGRVlv_ActrSpGrdtLimnCalPrm3.rDesValHi_C "Parameter structure 3 of the gradient limitation / e_:Upper threshold for the setpoint PrfXXX_rGovDesValBXXX to enter the active area of the ramp with a controlled speed:_e;d_:Obere Schwelle für den Lagesollwert PrfXXX_rGovDesValBXXXum die Rampe mit kontrollierter Geschwindigkeit zu starten:_d" VALUE 0x8053B7F6 Val_Ws16 799.9878 Prc -400.0000 399.9878 FORMAT "%8.4" /end CHARACTERISTIC
/begin CHARACTERISTIC EGRVlv_ActrSpGrdtLimnCalPrm3.rGrdtPos_C "Parameter structure 3 of the gradient limitation / e_:Maximum positive slope for active gradient limitation:_e;d_:Maximale positive Steigung bei aktiver Gradientenlimitierung:_d" VALUE 0x8053B7F8 Val_Ws32 52428799.9878 PrcSec -26214400.0000 26214399.9878 FORMAT "%13.4" /end CHARACTERISTIC
/begin CHARACTERISTIC EGRVlv_ActrSpGrdtLimnCalPrm3.rGrdtNeg_C "Parameter structure 3 of the gradient limitation / e_:Maximum negative slope for active gradient limitation:_e;d_:Maximale negative Steigung bei aktiver Gradientenlimitierung:_d" VALUE 0x8053B7FC Val_Ws32 52428799.9878 PrcSec -26214400.0000 26214399.9878 FORMAT "%13.4" /end CHARACTERISTIC
/begin CHARACTERISTIC EGRVlv_ActrSpGrdtLimnCalPrm3.stMaskEnvCond_C "Parameter structure 3 of the gradient limitation / e_:Bitmask to activate the gradient limitation based on PrfXXX_GrdtLimnMpBXXX.stGrdtLimnEnvRls:_e;d_:Bitmaske zur Aktivierung der Gradientenlimitierung basierend auf PrfXXX_GrdtLimnMpBXXX.stGrdtLimnEnvRls:_d" VALUE 0x8053B800 Val_Wu16 65535.00 OneToOne 0.00 65535.00 FORMAT "%8.2" /end CHARACTERISTIC
/begin CHARACTERISTIC EGRVlv_ActrSpGrdtLimnCalPrm4.rActLo_C "Parameter structure 4 of the gradient limitation / e_:Lower threshold for activation range:_e;d_:Untere Schranke des Aktivierungsbereichs:_d" VALUE 0x8053B804 Val_Ws16 799.9878 Prc -400.0000 399.9878 FORMAT "%8.4" /end CHARACTERISTIC
/begin CHARACTERISTIC EGRVlv_ActrSpGrdtLimnCalPrm4.rActHi_C "Parameter structure 4 of the gradient limitation / e_:Upper threshold for activation range:_e;d_:Obere Schranke des Aktivierungsbereichs:_d" VALUE 0x8053B806 Val_Ws16 799.9878 Prc -400.0000 399.9878 FORMAT "%8.4" /end CHARACTERISTIC
/begin CHARACTERISTIC EGRVlv_ActrSpGrdtLimnCalPrm4.rDesValLo_C "Parameter structure 4 of the gradient limitation / e_:Lower threshold for the setpoint PrfXXX_rGovDesValBXXX to enter the active area of the ramp with a controlled speed:_e;d_:Untere Schwelle für den Lagesollwert PrfXXX_rGovDesValBXXX um die Rampe mit kontrollierter Geschwindigkeit zu starten:_d" VALUE 0x8053B808 Val_Ws16 799.9878 Prc -400.0000 399.9878 FORMAT "%8.4" /end CHARACTERISTIC
/begin CHARACTERISTIC EGRVlv_ActrSpGrdtLimnCalPrm4.rDesValHi_C "Parameter structure 4 of the gradient limitation / e_:Upper threshold for the setpoint PrfXXX_rGovDesValBXXX to enter the active area of the ramp with a controlled speed:_e;d_:Obere Schwelle für den Lagesollwert PrfXXX_rGovDesValBXXXum die Rampe mit kontrollierter Geschwindigkeit zu starten:_d" VALUE 0x8053B80A Val_Ws16 799.9878 Prc -400.0000 399.9878 FORMAT "%8.4" /end CHARACTERISTIC
/begin CHARACTERISTIC EGRVlv_ActrSpGrdtLimnCalPrm4.rGrdtPos_C "Parameter structure 4 of the gradient limitation / e_:Maximum positive slope for active gradient limitation:_e;d_:Maximale positive Steigung bei aktiver Gradientenlimitierung:_d" VALUE 0x8053B80C Val_Ws32 52428799.9878 PrcSec -26214400.0000 26214399.9878 FORMAT "%13.4" /end CHARACTERISTIC
/begin CHARACTERISTIC EGRVlv_ActrSpGrdtLimnCalPrm4.rGrdtNeg_C "Parameter structure 4 of the gradient limitation / e_:Maximum negative slope for active gradient limitation:_e;d_:Maximale negative Steigung bei aktiver Gradientenlimitierung:_d" VALUE 0x8053B810 Val_Ws32 52428799.9878 PrcSec -26214400.0000 26214399.9878 FORMAT "%13.4" /end CHARACTERISTIC
/begin CHARACTERISTIC EGRVlv_ActrSpGrdtLimnCalPrm4.stMaskEnvCond_C "Parameter structure 4 of the gradient limitation / e_:Bitmask to activate the gradient limitation based on PrfXXX_GrdtLimnMpBXXX.stGrdtLimnEnvRls:_e;d_:Bitmaske zur Aktivierung der Gradientenlimitierung basierend auf PrfXXX_GrdtLimnMpBXXX.stGrdtLimnEnvRls:_d" VALUE 0x8053B814 Val_Wu16 65535.00 OneToOne 0.00 65535.00 FORMAT "%8.2" /end CHARACTERISTIC
/begin CHARACTERISTIC EGRVlv_ActrSpGrdtLimnCalPrm5.rActLo_C "Parameter structure 5 of the gradient limitation / e_:Lower threshold for activation range:_e;d_:Untere Schranke des Aktivierungsbereichs:_d" VALUE 0x8053B818 Val_Ws16 799.9878 Prc -400.0000 399.9878 FORMAT "%8.4" /end CHARACTERISTIC
/begin CHARACTERISTIC EGRVlv_ActrSpGrdtLimnCalPrm5.rActHi_C "Parameter structure 5 of the gradient limitation / e_:Upper threshold for activation range:_e;d_:Obere Schranke des Aktivierungsbereichs:_d" VALUE 0x8053B81A Val_Ws16 799.9878 Prc -400.0000 399.9878 FORMAT "%8.4" /end CHARACTERISTIC
/begin CHARACTERISTIC EGRVlv_ActrSpGrdtLimnCalPrm5.rDesValLo_C "Parameter structure 5 of the gradient limitation / e_:Lower threshold for the setpoint PrfXXX_rGovDesValBXXX to enter the active area of the ramp with a controlled speed:_e;d_:Untere Schwelle für den Lagesollwert PrfXXX_rGovDesValBXXX um die Rampe mit kontrollierter Geschwindigkeit zu starten:_d" VALUE 0x8053B81C Val_Ws16 799.9878 Prc -400.0000 399.9878 FORMAT "%8.4" /end CHARACTERISTIC
/begin CHARACTERISTIC EGRVlv_ActrSpGrdtLimnCalPrm5.rDesValHi_C "Parameter structure 5 of the gradient limitation / e_:Upper threshold for the setpoint PrfXXX_rGovDesValBXXX to enter the active area of the ramp with a controlled speed:_e;d_:Obere Schwelle für den Lagesollwert PrfXXX_rGovDesValBXXXum die Rampe mit kontrollierter Geschwindigkeit zu starten:_d" VALUE 0x8053B81E Val_Ws16 799.9878 Prc -400.0000 399.9878 FORMAT "%8.4" /end CHARACTERISTIC
/begin CHARACTERISTIC EGRVlv_ActrSpGrdtLimnCalPrm5.rGrdtPos_C "Parameter structure 5 of the gradient limitation / e_:Maximum positive slope for active gradient limitation:_e;d_:Maximale positive Steigung bei aktiver Gradientenlimitierung:_d" VALUE 0x8053B820 Val_Ws32 52428799.9878 PrcSec -26214400.0000 26214399.9878 FORMAT "%13.4" /end CHARACTERISTIC
/begin CHARACTERISTIC EGRVlv_ActrSpGrdtLimnCalPrm5.rGrdtNeg_C "Parameter structure 5 of the gradient limitation / e_:Maximum negative slope for active gradient limitation:_e;d_:Maximale negative Steigung bei aktiver Gradientenlimitierung:_d" VALUE 0x8053B824 Val_Ws32 52428799.9878 PrcSec -26214400.0000 26214399.9878 FORMAT "%13.4" /end CHARACTERISTIC
/begin CHARACTERISTIC EGRVlv_ActrSpGrdtLimnCalPrm5.stMaskEnvCond_C "Parameter structure 5 of the gradient limitation / e_:Bitmask to activate the gradient limitation based on PrfXXX_GrdtLimnMpBXXX.stGrdtLimnEnvRls:_e;d_:Bitmaske zur Aktivierung der Gradientenlimitierung basierend auf PrfXXX_GrdtLimnMpBXXX.stGrdtLimnEnvRls:_d" VALUE 0x8053B828 Val_Wu16 65535.00 OneToOne 0.00 65535.00 FORMAT "%8.2" /end CHARACTERISTIC
/begin CHARACTERISTIC EGRVlv_ActvnDeactvnCdnCal.nMinActrActv_C "Activation and Deactivation conditions calibration class / e_:Engine speed threshold for permanent enable:_e;d_:Drehzahlschwelle zur permanenten Aktivierung:_d" VALUE 0x8053B82C RB_Val_Ws16 32767.50 EngN -16384.00 16383.50 FORMAT "%8.2" /end CHARACTERISTIC
/begin CHARACTERISTIC EGRVlv_ActvnDeactvnCdnCal.swtFlgShOffCtrlDne_C "Activation and Deactivation conditions calibration class / e_:Configuration switch for Shut Off Control Done logic:_e;d_:Konfigurationsschalter für interne Shut Off Control Done Logik:_d" VALUE 0x8053B82E RB_Val_Wu8 255.0 OneToOne 0.00 255.0 FORMAT "%5.1" /end CHARACTERISTIC
/begin CHARACTERISTIC EGRVlv_ActvnDeactvnCdnCal.tiShOffCtrlDne_C "Activation and Deactivation conditions calibration class / e_:Delay for deactivation when shut off is done:_e;d_:Verzögerung der Deaktivierung nach Motorabschaltung:_d" VALUE 0x8053B830 RB_Val_Ws16 655.3500 Time_s -327.6800 327.6700 FORMAT "%8.4" /end CHARACTERISTIC
/begin CHARACTERISTIC EGRVlv_ActvnDeactvnCdnCal.tiDeactvnStSp_C "Activation and Deactivation conditions calibration class / e_:Delay for deactivation during eco start/stop:_e;d_:Verzögerung der Deaktivierung während Eco Start/Stopp:_d" VALUE 0x8053B832 RB_Val_Ws16 655.3500 Time_s -327.6800 327.6700 FORMAT "%8.4" /end CHARACTERISTIC
/begin CHARACTERISTIC EGRVlv_ActvnDeactvnCdnCal.rActStSpThd_C "Activation and Deactivation conditions calibration class / e_:Actuator position threshold to permanently enable actuator during motor stop:_e;d_:Aktuatorpositionsschwelle zur permanenten Aktivierung des Aktuators während Motor Stopp:_d" VALUE 0x8053B834 RB_Val_Ws8 398.4 Prc_sint8 -200.0 198.4 FORMAT "%5.1" /end CHARACTERISTIC
/begin CHARACTERISTIC EGRVlv_ActvnDeactvnCdnCal.vDeactvnStSpThd_C "Activation and Deactivation conditions calibration class / e_:Vehicle velocity threshold for deactivation during eco start/stop:_e;d_:Fahrzeug Geschwindigkeitsschwelle zur Deaktivierung während Eco Start/Stopp:_d" VALUE 0x8053B836 RB_Val_Ws16 655.3500 Vel -327.6800 327.6700 FORMAT "%8.4" /end CHARACTERISTIC
/begin CHARACTERISTIC EGRVlv_ActvnDeactvnCdnCal.vActvnEngOffSailThd_C "Activation and Deactivation conditions calibration class / e_:Vehicle velocity threshold for deactivation during engine off sailing:_e;d_:Fahrzeug Geschwindigkeitsschwelle zur Deaktivierung während Motor-Aus Segeln:_d" VALUE 0x8053B838 RB_Val_Ws16 655.3500 Vel -327.6800 327.6700 FORMAT "%8.4" /end CHARACTERISTIC
/begin CHARACTERISTIC EGRVlv_ActvnDeactvnCdnCal.tiEngOffSail_C "Activation and Deactivation conditions calibration class / e_:Delay for deactivation at engine off sailing:_e;d_:Verzögerung der Deaktivierung bei Motor-Aus Segeln:_d" VALUE 0x8053B83A RB_Val_Ws16 655.3500 Time_s -327.6800 327.6700 FORMAT "%8.4" /end CHARACTERISTIC
/begin CHARACTERISTIC EGRVlv_ActvnDeactvnCdnCal.tiTerminalEngOff_C "Activation and Deactivation conditions calibration class / e_:Delay for deactivation at T15 engine off followed by T15 afterrun:_e;d_:Verzögerung der Deaktivierung bei Klemme 15 Motor-Aus gefolgt von T15 Nachlauf:_d" VALUE 0x8053B83C RB_Val_Ws16 655.3500 Time_s -327.6800 327.6700 FORMAT "%8.4" /end CHARACTERISTIC
/begin CHARACTERISTIC EGRVlv_ActvnDeactvnCdnCal.stActrEnaPreCdn_C "Activation and Deactivation conditions calibration class / e_:Mask to prevent activation under certain powerstage conditions:_e;d_:Maske zum Verhindern der Aktivierung bei bestimmten Betriebszuständen der Endstufe:_d" VALUE 0x8053B83E RB_Val_Wu16 65535.00 OneToOne 0.00 65535.00 FORMAT "%8.2" /end CHARACTERISTIC
/begin CHARACTERISTIC EGRVlv_ActvnDeactvnCdnCal.stActrDiCdn_C "Activation and Deactivation conditions calibration class / e_:Mask for deactivation under certain powerstage conditions:_e;d_:Maske zum Deaktivieren bei bestimmten Betriebszuständen der Endstufe:_d" VALUE 0x8053B840 RB_Val_Wu16 65535.00 OneToOne 0.00 65535.00 FORMAT "%8.2" /end CHARACTERISTIC
/begin CHARACTERISTIC EGRVlv_ATS.LimitTypeMsk_C "Actuator test EGRVlv_ATS / Tester demand monitoring enable mask for actuators" VALUE 0x8058A73C Val_Wu8 255.0 OneToOne 0.00 255.0 FORMAT "%5.1" /end CHARACTERISTIC
/begin CHARACTERISTIC EGRVlv_ATS.CnvNorm_C "Actuator test EGRVlv_ATS / Conversion norm used for conversion to/from internal scaling" VALUE 0x8058A73D Val_Wu8 255.0 OneToOne 0.00 255.0 FORMAT "%5.1" /end CHARACTERISTIC
/begin CHARACTERISTIC EGRVlv_ATS.LowLim_C "Actuator test EGRVlv_ATS / Lower limit for monitoring" VALUE 0x8058A73E Val_Ws16 799.9878 Prc -400.0000 399.9878 FORMAT "%8.4" /end CHARACTERISTIC
/begin CHARACTERISTIC EGRVlv_ATS.UpLim_C "Actuator test EGRVlv_ATS / Upper limit for monitoring" VALUE 0x8058A740 Val_Ws16 799.9878 Prc -400.0000 399.9878 FORMAT "%8.4" /end CHARACTERISTIC
/begin CHARACTERISTIC EGRVlv_ATS.CnvFac_C "Actuator test EGRVlv_ATS / Factor used for conversion to/from internal scaling" VALUE 0x8058A744 Val_Ws32 4294967295.00 OneToOne -2147483648.00 2147483647.00 FORMAT "%13.2" /end CHARACTERISTIC
/begin CHARACTERISTIC EGRVlv_ATS.CnvOfs_C "Actuator test EGRVlv_ATS / Offset used for conversion to/from internal scaling" VALUE 0x8058A748 Val_Ws16 65535.00 OneToOne -32768.00 32767.00 FORMAT "%8.2" /end CHARACTERISTIC
/begin CHARACTERISTIC EGRVlv_ATS.DfltVal_C "Actuator test EGRVlv_ATS / Default value for standbytest" VALUE 0x8058A74A Val_Ws16 65535.00 OneToOne -32768.00 32767.00 FORMAT "%8.2" /end CHARACTERISTIC
/begin CHARACTERISTIC EGRVlv_Cal.tiBattCorFacFlt_C "Struture for calibration parameters used in all Actuator EGRVlvs / " VALUE 0x8058B600 Val_Ws32 4294.9672940000000 TimeDelay_s 0.0000020000000 4294.9672959999998 FORMAT "%19.14" EXTENDED_LIMITS 0.000002000000001 4294.9672959999998 /end CHARACTERISTIC
/begin CHARACTERISTIC EGRVlv_Cal.rDesValFailSafe_C "Struture for calibration parameters used in all Actuator EGRVlvs / " VALUE 0x8058B604 Val_Ws16 799.9878 Prc -400.0000 399.9878 FORMAT "%8.4" /end CHARACTERISTIC
/begin CHARACTERISTIC EGRVlv_Cal.slpFailSafePos_C "Struture for calibration parameters used in all Actuator EGRVlvs / " VALUE 0x8058B608 Val_Ws32 799999.999814 RmpPrc -400000.000000 399999.999814 FORMAT "%13.6" /end CHARACTERISTIC
/begin CHARACTERISTIC EGRVlv_Cal.slpFailSafeNeg_C "Struture for calibration parameters used in all Actuator EGRVlvs / " VALUE 0x8058B60C Val_Ws32 799999.999814 RmpPrc -400000.000000 399999.999814 FORMAT "%13.6" /end CHARACTERISTIC
/begin CHARACTERISTIC EGRVlv_Cal.tiDesValFlt_C "Struture for calibration parameters used in all Actuator EGRVlvs / " VALUE 0x8058B610 Val_Ws32 4294.9672940000000 TimeDelay_s 0.0000020000000 4294.9672959999998 FORMAT "%19.14" EXTENDED_LIMITS 0.000002000000001 4294.9672959999998 /end CHARACTERISTIC
/begin CHARACTERISTIC EGRVlv_Cal.tiduRawFlt_C "Struture for calibration parameters used in all Actuator EGRVlvs / " VALUE 0x8058B614 Val_Ws32 4294.9672940000000 TimeDelay_s 0.0000020000000 4294.9672959999998 FORMAT "%19.14" EXTENDED_LIMITS 0.000002000000001 4294.9672959999998 /end CHARACTERISTIC
/begin CHARACTERISTIC EGRVlv_Cal.uFailSafeBattMin_C "Struture for calibration parameters used in all Actuator EGRVlvs / " VALUE 0x8058B618 Val_Ws16 1310700. Volt_Batt -655360.0 655340.0 FORMAT "%8.1" /end CHARACTERISTIC
/begin CHARACTERISTIC EGRVlv_Cal.uFailSafeBattMax_C "Struture for calibration parameters used in all Actuator EGRVlvs / " VALUE 0x8058B61A Val_Ws16 1310700. Volt_Batt -655360.0 655340.0 FORMAT "%8.1" /end CHARACTERISTIC
/begin CHARACTERISTIC EGRVlv_Cal.uBattMin_C "Struture for calibration parameters used in all Actuator EGRVlvs / " VALUE 0x8058B61C Val_Ws16 1310700. Volt_Batt -655360.0 655340.0 FORMAT "%8.1" /end CHARACTERISTIC
/begin CHARACTERISTIC EGRVlv_Cal.uBattMax_C "Struture for calibration parameters used in all Actuator EGRVlvs / " VALUE 0x8058B61E Val_Ws16 1310700. Volt_Batt -655360.0 655340.0 FORMAT "%8.1" /end CHARACTERISTIC
/begin CHARACTERISTIC EGRVlv_Cal.uBattMinNoLrn_C "Struture for calibration parameters used in all Actuator EGRVlvs / " VALUE 0x8058B620 Val_Ws16 1310700. Volt_Batt -655360.0 655340.0 FORMAT "%8.1" /end CHARACTERISTIC
/begin CHARACTERISTIC EGRVlv_Cal.uBattMaxNoLrn_C "Struture for calibration parameters used in all Actuator EGRVlvs / " VALUE 0x8058B622 Val_Ws16 1310700. Volt_Batt -655360.0 655340.0 FORMAT "%8.1" /end CHARACTERISTIC
/begin CHARACTERISTIC EGRVlv_Cal.facCorStrt_C "Struture for calibration parameters used in all Actuator EGRVlvs / " VALUE 0x8058B624 Val_Ws16 7.999878 Fact -4.000000 3.999878 FORMAT "%8.6" /end CHARACTERISTIC
/begin CHARACTERISTIC EGRVlv_Cal.numTEng_C "Struture for calibration parameters used in all Actuator EGRVlvs / " VALUE 0x8058B626 Val_Wu16 255.000000000 DELIB_ALLTEMP_VERB_COMPU 0.00 255.000000000 FORMAT "%13.9" /end CHARACTERISTIC
/begin CHARACTERISTIC EGRVlv_Cal.tEngMin_C "Struture for calibration parameters used in all Actuator EGRVlvs / " VALUE 0x8058B628 Val_Ws16 6553.500 Temp_Cels -3549.940 3003.560 FORMAT "%8.3" /end CHARACTERISTIC
/begin CHARACTERISTIC EGRVlv_Cal.tEngMax_C "Struture for calibration parameters used in all Actuator EGRVlvs / " VALUE 0x8058B62A Val_Ws16 6553.500 Temp_Cels -3549.940 3003.560 FORMAT "%8.3" /end CHARACTERISTIC
/begin CHARACTERISTIC EGRVlv_Cal.rCtlRngMin_C "Struture for calibration parameters used in all Actuator EGRVlvs / " VALUE 0x8058B62C Val_Ws16 799.9878 Prc -400.0000 399.9878 FORMAT "%8.4" /end CHARACTERISTIC
/begin CHARACTERISTIC EGRVlv_Cal.rCtlRngMax_C "Struture for calibration parameters used in all Actuator EGRVlvs / " VALUE 0x8058B62E Val_Ws16 799.9878 Prc -400.0000 399.9878 FORMAT "%8.4" /end CHARACTERISTIC
/begin CHARACTERISTIC EGRVlv_Cal.tiTempErrOk_C "Struture for calibration parameters used in all Actuator EGRVlvs / " VALUE 0x8058B630 Val_Ws16 655350.0 Time_ms -327680.0 327670.0 FORMAT "%8.1" /end CHARACTERISTIC
/begin CHARACTERISTIC EGRVlv_Cal.rActActrActv_C "Struture for calibration parameters used in all Actuator EGRVlvs / " VALUE 0x8058B632 Val_Ws16 799.9878 Prc -400.0000 399.9878 FORMAT "%8.4" /end CHARACTERISTIC
/begin CHARACTERISTIC EGRVlv_Cal.tiSoftShOff_C "Struture for calibration parameters used in all Actuator EGRVlvs / " VALUE 0x8058B634 Val_Ws16 655350.0 Time_ms -327680.0 327670.0 FORMAT "%8.1" /end CHARACTERISTIC
/begin CHARACTERISTIC EGRVlv_Cal.rDesValSoftShOff_C "Struture for calibration parameters used in all Actuator EGRVlvs / " VALUE 0x8058B636 Val_Ws16 799.9878 Prc -400.0000 399.9878 FORMAT "%8.4" /end CHARACTERISTIC
/begin CHARACTERISTIC EGRVlv_Cal.stActrDiaDis_C "Struture for calibration parameters used in all Actuator EGRVlvs / " VALUE 0x8058B638 Val_Wu16 65535.00 OneToOne 0.00 65535.00 FORMAT "%8.2" /end CHARACTERISTIC
/begin CHARACTERISTIC EGRVlv_Cal.stActrDis_C "Struture for calibration parameters used in all Actuator EGRVlvs / " VALUE 0x8058B63A Val_Wu16 65535.00 OneToOne 0.00 65535.00 FORMAT "%8.2" /end CHARACTERISTIC
/begin CHARACTERISTIC EGRVlv_Cal.numTempErrDef_C "Struture for calibration parameters used in all Actuator EGRVlvs / " VALUE 0x8058B63C Val_Wu8 255.0 OneToOne 0.00 255.0 FORMAT "%5.1" /end CHARACTERISTIC
/begin CHARACTERISTIC EGRVlv_Cal.swtNrmInv_C "Struture for calibration parameters used in all Actuator EGRVlvs / " VALUE 0x8058B63D Val_Wu8 255.0 OneToOne 0.00 255.0 FORMAT "%5.1" /end CHARACTERISTIC
/begin CHARACTERISTIC EGRVlv_Cal.rPwrStgDis_C "Struture for calibration parameters used in all Actuator EGRVlvs / " VALUE 0x8058B63E Val_Ws16 655.3500 DtyCyc -327.6800 327.6700 FORMAT "%8.4" /end CHARACTERISTIC
/begin CHARACTERISTIC EGRVlv_Cal.tAirSysFldMin_C "Struture for calibration parameters used in all Actuator EGRVlvs / " VALUE 0x8058B640 Val_Ws16 6553.500 Temp_Cels -3549.940 3003.560 FORMAT "%8.3" /end CHARACTERISTIC
/begin CHARACTERISTIC EGRVlv_Cal.tAirSysFldMax_C "Struture for calibration parameters used in all Actuator EGRVlvs / " VALUE 0x8058B642 Val_Ws16 6553.500 Temp_Cels -3549.940 3003.560 FORMAT "%8.3" /end CHARACTERISTIC
/begin CHARACTERISTIC EGRVlv_Cal.tExhFldMin_C "Struture for calibration parameters used in all Actuator EGRVlvs / " VALUE 0x8058B644 Val_Ws16 6553.500 Temp_Cels -3549.940 3003.560 FORMAT "%8.3" /end CHARACTERISTIC
/begin CHARACTERISTIC EGRVlv_Cal.tExhFldMax_C "Struture for calibration parameters used in all Actuator EGRVlvs / " VALUE 0x8058B646 Val_Ws16 6553.500 Temp_Cels -3549.940 3003.560 FORMAT "%8.3" /end CHARACTERISTIC
/begin CHARACTERISTIC EGRVlv_Cal.tEngDaFldMin_C "Struture for calibration parameters used in all Actuator EGRVlvs / " VALUE 0x8058B648 Val_Ws16 6553.500 Temp_Cels -3549.940 3003.560 FORMAT "%8.3" /end CHARACTERISTIC
/begin CHARACTERISTIC EGRVlv_Cal.tEngDaFldMax_C "Struture for calibration parameters used in all Actuator EGRVlvs / " VALUE 0x8058B64A Val_Ws16 6553.500 Temp_Cels -3549.940 3003.560 FORMAT "%8.3" /end CHARACTERISTIC
/begin CHARACTERISTIC EGRVlv_Cal.numExhTempDesVal_C "Struture for calibration parameters used in all Actuator EGRVlvs / " VALUE 0x8058B64C Val_Wu16 255.000000000 DELIB_ALLTEMP_VERB_COMPU 0.00 255.000000000 FORMAT "%13.9" /end CHARACTERISTIC
/begin CHARACTERISTIC EGRVlv_Cal.numAirTempDesVal_C "Struture for calibration parameters used in all Actuator EGRVlvs / " VALUE 0x8058B64E Val_Wu16 255.000000000 DELIB_ALLTEMP_VERB_COMPU 0.00 255.000000000 FORMAT "%13.9" /end CHARACTERISTIC
/begin CHARACTERISTIC EGRVlv_Cal.numEngDaTempDesVal_C "Struture for calibration parameters used in all Actuator EGRVlvs / " VALUE 0x8058B650 Val_Wu16 255.000000000 DELIB_ALLTEMP_VERB_COMPU 0.00 255.000000000 FORMAT "%13.9" /end CHARACTERISTIC
/begin CHARACTERISTIC EGRVlv_Cal.numTemp4_C "Struture for calibration parameters used in all Actuator EGRVlvs / " VALUE 0x8058B652 Val_Wu16 255.000000000 DELIB_ALLTEMP_VERB_COMPU 0.00 255.000000000 FORMAT "%13.9" /end CHARACTERISTIC
/begin CHARACTERISTIC EGRVlv_Cal.tiIni_C "Struture for calibration parameters used in all Actuator EGRVlvs / " VALUE 0x8058B654 Val_Wu8 255.0 Time_msec_q1_COMPU 0.00 255.0 FORMAT "%5.1" /end CHARACTERISTIC
/begin CHARACTERISTIC EGRVlv_Cal.rDesValIniStdBy_C "Struture for calibration parameters used in all Actuator EGRVlvs / " VALUE 0x8058B655 Val_Ws8 255.0 Pos_Prc_float -128.0 127.0 FORMAT "%5.1" /end CHARACTERISTIC
/begin CHARACTERISTIC EGRVlv_Cal.rDesValIni_C "Struture for calibration parameters used in all Actuator EGRVlvs / " VALUE 0x8058B656 Val_Ws8 255.0 Pos_Prc_float -128.0 127.0 FORMAT "%5.1" /end CHARACTERISTIC
/begin CHARACTERISTIC EGRVlv_Cal.tiDflDtyCyc_C "Struture for calibration parameters used in all Actuator EGRVlvs / " VALUE 0x8058B657 Val_Wu8 25500. q100_ms 0.00 25500. FORMAT "%5.0" /end CHARACTERISTIC
/begin CHARACTERISTIC EGRVlv_Cal.tidrDesValFlt_C "Struture for calibration parameters used in all Actuator EGRVlvs / " VALUE 0x8058B658 Val_Ws32 4294.9672940000000 TimeDelay_s 0.0000020000000 4294.9672959999998 FORMAT "%19.14" EXTENDED_LIMITS 0.000002000000001 4294.9672959999998 /end CHARACTERISTIC
/begin CHARACTERISTIC EGRVlv_Cal.rDesValCntMinThrd_C "Struture for calibration parameters used in all Actuator EGRVlvs / " VALUE 0x8058B65C Val_Wu16 799.9878 Prc 0.00 799.9878 FORMAT "%8.4" /end CHARACTERISTIC
/begin CHARACTERISTIC EGRVlv_Cal.swtRstrDesValCnt_C "Struture for calibration parameters used in all Actuator EGRVlvs / " VALUE 0x8058B65E Val_Wu8 255.0 OneToOne 0.00 255.0 FORMAT "%5.1" /end CHARACTERISTIC
/begin CHARACTERISTIC EGRVlv_Cal.swtActvn_C "Struture for calibration parameters used in all Actuator EGRVlvs / " VALUE 0x8058B65F Val_Wu8 255.0 OneToOne 0.00 255.0 FORMAT "%5.1" /end CHARACTERISTIC
/begin CHARACTERISTIC EGRVlv_Cal.swtDeactvnMask_C "Struture for calibration parameters used in all Actuator EGRVlvs / " VALUE 0x8058B660 Val_Wu8 255.0 OneToOne 0.00 255.0 FORMAT "%5.1" /end CHARACTERISTIC
/begin CHARACTERISTIC EGRVlv_Cal.duMovDet_C "Struture for calibration parameters used in all Actuator EGRVlvs / " VALUE 0x8058B662 Val_Ws16 655350.0 q10_mV_DIV_s -327680.0 327670.0 FORMAT "%8.1" /end CHARACTERISTIC
/begin CHARACTERISTIC EGRVlv_Cal.tiNMinActActvDly_C "Struture for calibration parameters used in all Actuator EGRVlvs / " VALUE 0x8058B664 Val_Ws16 655350.0 Time_ms -327680.0 327670.0 FORMAT "%8.1" /end CHARACTERISTIC
/begin CHARACTERISTIC EGRVlv_Cal.stTmpDeactv_C "Struture for calibration parameters used in all Actuator EGRVlvs / " VALUE 0x8058B666 Val_Wu16 65535.00 OneToOne 0.00 65535.00 FORMAT "%8.2" /end CHARACTERISTIC
/begin CHARACTERISTIC EGRVlv_ClnVrfyCal.uBattClnMax_C "Struture for calibration parameters used in Clean and Verify function / e_:The Clean and Verify function will only be executed, if the battery voltage is below this threshold:_e;d_:Die Clean and Verify Funktion wird nur ausgefuehrt, wenn die Batteriespannung unter der hier applizierten Schwelle liegt.:_d" VALUE 0x8058B668 Val_Ws16 1310700. Volt_Batt -655360.0 655340.0 FORMAT "%8.1" /end CHARACTERISTIC
/begin CHARACTERISTIC EGRVlv_ClnVrfyCal.uBattClnMin_C "Struture for calibration parameters used in Clean and Verify function / e_:The Clean and Verify function will only be executed, if the battery voltage is above this threshold:_e;d_:Die Clean and Verify Funktion wird nur ausgefuehrt, wenn die Batteriespannung über der hier applizierten Schwelle liegt.:_d" VALUE 0x8058B66A Val_Ws16 1310700. Volt_Batt -655360.0 655340.0 FORMAT "%8.1" /end CHARACTERISTIC
/begin CHARACTERISTIC EGRVlv_ClnVrfyCal.numMaxClnVerifyAbrt_C "Struture for calibration parameters used in Clean and Verify function / e_:Maximum number of aborted Clean and Verify cycles to disable Clean and Verify:_e;d_:Maximale Anzahl der abgebrochenen Clean and Verify Zyklen um die Funktion zu deaktivieren:_d" VALUE 0x8058B66C Val_Wu8 255.0 OneToOne 0.00 255.0 FORMAT "%5.1" /end CHARACTERISTIC
/begin CHARACTERISTIC EGRVlv_ClnVrfyCal.tiDesValOpn_C "Struture for calibration parameters used in Clean and Verify function / Maximum time for setpoint ""OPEN"" from clean-and-verify-function" VALUE 0x8058B66E Val_Ws16 655350.0 Time_ms -327680.0 327670.0 FORMAT "%8.1" /end CHARACTERISTIC
/begin CHARACTERISTIC EGRVlv_ClnVrfyCal.tiDesValClsd_C "Struture for calibration parameters used in Clean and Verify function / Maximum time for setpoint ""CLOSED"" from clean-and-verify-function" VALUE 0x8058B670 Val_Ws16 655350.0 Time_ms -327680.0 327670.0 FORMAT "%8.1" /end CHARACTERISTIC
/begin CHARACTERISTIC EGRVlv_ClnVrfyCal.rDesValOpn_C "Struture for calibration parameters used in Clean and Verify function / Setpoint ""OPEN"" from clean-and-verify-function" VALUE 0x8058B672 Val_Ws8 398.4 Prc_sint8 -200.0 198.4 FORMAT "%5.1" /end CHARACTERISTIC
/begin CHARACTERISTIC EGRVlv_ClnVrfyCal.rDesValClsd_C "Struture for calibration parameters used in Clean and Verify function / Setpoint ""CLOSED"" from clean-and-verify-function" VALUE 0x8058B673 Val_Ws8 398.4 Prc_sint8 -200.0 198.4 FORMAT "%5.1" /end CHARACTERISTIC
/begin CHARACTERISTIC EGRVlv_ClnVrfyCal.tiDesVal2_C "Struture for calibration parameters used in Clean and Verify function / Maximum time for setpoint ""OPEN"" and ""CLOSED"" for the clean-and-verify-function if the alternative set points are active" VALUE 0x8058B674 Val_Ws16 655350.0 Time_ms -327680.0 327670.0 FORMAT "%8.1" /end CHARACTERISTIC
/begin CHARACTERISTIC EGRVlv_ClnVrfyCal.rDesValOpn2_C "Struture for calibration parameters used in Clean and Verify function / Setpoint ""OPEN"" from clean-and-verify-function" VALUE 0x8058B676 Val_Ws8 398.4 Prc_sint8 -200.0 198.4 FORMAT "%5.1" /end CHARACTERISTIC
/begin CHARACTERISTIC EGRVlv_ClnVrfyCal.rDesValClsd2_C "Struture for calibration parameters used in Clean and Verify function / Setpoint ""CLOSED"" from clean-and-verify-function" VALUE 0x8058B677 Val_Ws8 398.4 Prc_sint8 -200.0 198.4 FORMAT "%5.1" /end CHARACTERISTIC
/begin CHARACTERISTIC EGRVlv_ClnVrfyCal.swtFeatClnVerify_C "Struture for calibration parameters used in Clean and Verify function / Configuration switch to enable clean-and-verify-function" VALUE 0x8058B678 Val_Wu16 65535.00 OneToOne 0.00 65535.00 FORMAT "%8.2" /end CHARACTERISTIC
/begin CHARACTERISTIC EGRVlv_ClnVrfyCal.numMaxClean_C "Struture for calibration parameters used in Clean and Verify function / Number of setpoint changes between rDesValOpn_C und rDesValClsd_C of clean-and-verify-function" VALUE 0x8058B67A Val_Wu8 255.0 OneToOne 0.00 255.0 FORMAT "%5.1" /end CHARACTERISTIC
/begin CHARACTERISTIC EGRVlv_ClnVrfyCal.numMaxClean2_C "Struture for calibration parameters used in Clean and Verify function / Number of setpoint changes between rDesValOpn_C und rDesValClsd_C of clean-and-verify-function" VALUE 0x8058B67B Val_Wu8 255.0 OneToOne 0.00 255.0 FORMAT "%5.1" /end CHARACTERISTIC
/begin CHARACTERISTIC EGRVlv_ClnVrfyCal.numMaxEndStop_C "Struture for calibration parameters used in Clean and Verify function / Number of setpoint changes between mechanical end stops of clean-and-verify-function" VALUE 0x8058B67C Val_Wu8 255.0 OneToOne 0.00 255.0 FORMAT "%5.1" /end CHARACTERISTIC
/begin CHARACTERISTIC EGRVlv_ClnVrfyCal.stClnVerifyCntMsk_C "Struture for calibration parameters used in Clean and Verify function / Mask to select the number of setpoint changes between rDesValOpn_C and rDesValClsd_C of clean-and-verify-function" VALUE 0x8058B67E Val_Wu16 65535.00 OneToOne 0.00 65535.00 FORMAT "%8.2" /end CHARACTERISTIC
/begin CHARACTERISTIC EGRVlv_ClnVrfyCal.numSprgActv_C "Struture for calibration parameters used in Clean and Verify function / Indicator of clean-and-verify-function phase where spring break detection should be done" VALUE 0x8058B680 Val_Wu8 255.0 OneToOne 0.00 255.0 FORMAT "%5.1" /end CHARACTERISTIC
/begin CHARACTERISTIC EGRVlv_ClnVrfyCal.rActSprgDiffPls_C "Struture for calibration parameters used in Clean and Verify function / plausibilisation threshold for spring break detection" VALUE 0x8058B682 Val_Ws16 799.9878 Prc -400.0000 399.9878 FORMAT "%8.4" /end CHARACTERISTIC
/begin CHARACTERISTIC EGRVlv_ClnVrfyCal.tiSprgBrk_C "Struture for calibration parameters used in Clean and Verify function / duration of spring break test" VALUE 0x8058B684 Val_Ws16 655350.0 Time_ms -327680.0 327670.0 FORMAT "%8.1" /end CHARACTERISTIC
/begin CHARACTERISTIC EGRVlv_ClnVrfyCal.qLoIdl_C "Struture for calibration parameters used in Clean and Verify function / Lower injection quantity limit for idle detection" VALUE 0x8058B686 Val_Ws16 655.3500 InjMass -327.6800 327.6700 FORMAT "%8.4" /end CHARACTERISTIC
/begin CHARACTERISTIC EGRVlv_ClnVrfyCal.nLoIdl_C "Struture for calibration parameters used in Clean and Verify function / Upper engine speed limit for idle detection" VALUE 0x8058B688 Val_Ws16 32767.50 EngN1 -16384.00 16383.50 FORMAT "%8.2" /end CHARACTERISTIC
/begin CHARACTERISTIC EGRVlv_ClnVrfyCal.tiLoIdl_C "Struture for calibration parameters used in Clean and Verify function / Time limit for idle detection" VALUE 0x8058B68A Val_Wu8 255.0 Time_sec_q1_COMPU 0.00 255.0 FORMAT "%5.1" /end CHARACTERISTIC
/begin CHARACTERISTIC EGRVlv_ClnVrfyCal.tiClnVrfySpct_C "Struture for calibration parameters used in Clean and Verify function / Time to delay the clean verify function when the engine is running" VALUE 0x8058B68B Val_Wu8 255.0 Time_sec_q1_COMPU 0.00 255.0 FORMAT "%5.1" /end CHARACTERISTIC
/begin CHARACTERISTIC EGRVlv_ClnVrfyCal.swtLrnSuc_C "Struture for calibration parameters used in Clean and Verify function / Select learning of open or close or both positions when offset learning triggered via c&v during LNGIDL" VALUE 0x8058B68C Val_Wu8 255.0 OneToOne 0.00 255.0 FORMAT "%5.1" /end CHARACTERISTIC
/begin CHARACTERISTIC EGRVlv_ClnVrfyCal.stClnVrfyOpModeMsk_C "Struture for calibration parameters used in Clean and Verify function / Operating mode & sub-stage wherein the clean verify should be active" VALUE 0x8058B690 Val_Wu32 4294967295.00 OneToOne 0.00 4294967295.00 FORMAT "%13.2" /end CHARACTERISTIC
/begin CHARACTERISTIC EGRVlv_ClnVrfyCal.ubatTstRlsClnVerify_C "Struture for calibration parameters used in Clean and Verify function / battery voltage threshold for C & V request from tester" VALUE 0x8058B694 Val_Ws16 1310700. Volt_Batt -655360.0 655340.0 FORMAT "%8.1" /end CHARACTERISTIC
/begin CHARACTERISTIC EGRVlv_ClnVrfyCal.tiClnVerifyLoIdlLck_C "Struture for calibration parameters used in Clean and Verify function / Lock period between cleaning activation due to long idle" VALUE 0x8058B696 Val_Wu8 1275. Time_sec_q5p0_COMPU 0.00 1275. FORMAT "%5.0" /end CHARACTERISTIC
/begin CHARACTERISTIC EGRVlv_ClnVrfyCal.pMinLoIdl_C "Struture for calibration parameters used in Clean and Verify function / Minimum pressure to active clean verify during" VALUE 0x8058B698 Val_Ws16 65535.00 Pres_hPa -32768.00 32767.00 FORMAT "%8.2" /end CHARACTERISTIC
/begin CHARACTERISTIC EGRVlv_ClnVrfyCal.swtPermActDeactvn_C "Struture for calibration parameters used in Clean and Verify function / Switch to disable influence of permanent active state on Clean and Verify request" VALUE 0x8058B69A Val_Wu8 255.0 OneToOne 0.00 255.0 FORMAT "%5.1" /end CHARACTERISTIC
/begin CHARACTERISTIC EGRVlv_ClnVrfyCal.swtEngSpdDeactvn_C "Struture for calibration parameters used in Clean and Verify function / Switch to decide if EngineSpeedReached is used for Starting Clean Verify(At PostDrive)" VALUE 0x8058B69B Val_Wu8 255.0 OneToOne 0.00 255.0 FORMAT "%5.1" /end CHARACTERISTIC
/begin CHARACTERISTIC EGRVlv_ClnVrfyCal.tiPreDrvClnVrfyMax_C "Struture for calibration parameters used in Clean and Verify function / Maximum time for clean verify trigger in predrive" VALUE 0x8058B69C Val_Wu32 42949672950.0 Time_msec_q10_COMPU 0.00 42949672950.0 FORMAT "%13.1" /end CHARACTERISTIC
/begin CHARACTERISTIC EGRVlv_ClnVrfyCal.tiPostDrvClnVrfyMax_C "Struture for calibration parameters used in Clean and Verify function / Maximum time for clean verify trigger in postdrive" VALUE 0x8058B6A0 Val_Wu32 42949672950.0 Time_msec_q10_COMPU 0.00 42949672950.0 FORMAT "%13.1" /end CHARACTERISTIC
/begin CHARACTERISTIC EGRVlv_ClnVrfyCal.swtEvalOfsLrnAvl_C "Struture for calibration parameters used in Clean and Verify function / Switch to evaluate offset learning available status for clean and verify trigger" VALUE 0x8058B6A4 Val_Wu8 255.0 OneToOne 0.00 255.0 FORMAT "%5.1" /end CHARACTERISTIC
/begin CHARACTERISTIC EGRVlv_ClnVrfyCal.numReaMechBndClnVrfyMax_C "Struture for calibration parameters used in Clean and Verify function / e_:Maximum number of times the clean verify is allowed to move the actuator to the mechanical boundary:_e;d_:Maximal erlaubte Anzahl von Clean und Verify Versuchen um den Aktuator in den mechanischen Anschlag zu bewegen.:_d" VALUE 0x8058B6A8 Val_Wu32 4294967295.00 OneToOne 0.00 4294967295.00 FORMAT "%13.2" /end CHARACTERISTIC
/begin CHARACTERISTIC EGRVlv_ClnVrfyCal.flgSwtSelfLrnEna_C "Struture for calibration parameters used in Clean and Verify function / e_:Calibration swtich to enable Self First Learn of end stop position at EOL:_e;d_:Applikationsschalter zum Aktivieren des selbständigen ersten Einlernen der Anschläge am Bandende.:_d" VALUE 0x8058B6AC Val_Wu8 255.0 OneToOne 0.00 255.0 FORMAT "%5.1" /end CHARACTERISTIC
/begin CHARACTERISTIC EGRVlv_coefHtTransfAirHsng_CUR "Heat transfer coefficient between the fresh air mass and the actuator housing" CURVE 0x8058B898 RB_Curve_S16_S16 655.3500 WattTempCels_q0p01_COMPU -327.6800 327.6700 FORMAT "%8.4"
 /begin AXIS_DESCR STD_AXIS AFS_mAirPerCyl AirMassPerCyl 25 -3276.800 3276.700 FORMAT "%8.3" DEPOSIT ABSOLUTE /end AXIS_DESCR
/end CHARACTERISTIC
/begin CHARACTERISTIC EGRVlv_coefHtTransfClntHsng_CUR "Heat transfer coefficient between the coolant and the actuator housing" CURVE 0x8058B8FE RB_Curve_S16_S16 655.3500 WattTempCels_q0p01_COMPU -327.6800 327.6700 FORMAT "%8.4"
 /begin AXIS_DESCR STD_AXIS Fan_rPs DtyCyc 25 -327.6800 327.6700 FORMAT "%8.4" DEPOSIT ABSOLUTE /end AXIS_DESCR
/end CHARACTERISTIC
/begin CHARACTERISTIC EGRVlv_coefHtTransfEnvHsng_MAP "Heat transfer coefficient between the Environment and the actuator housing" MAP 0x8058B964 RB_Map_S16S16_S16 655.3500 WattTempCels_q0p01_COMPU -327.6800 327.6700 FORMAT "%8.4"
 /begin AXIS_DESCR STD_AXIS VehV_v Vel 25 -327.6800 327.6700 FORMAT "%8.4" DEPOSIT ABSOLUTE /end AXIS_DESCR
 /begin AXIS_DESCR STD_AXIS Fan_rPs DtyCyc 25 -327.6800 327.6700 FORMAT "%8.4" DEPOSIT ABSOLUTE /end AXIS_DESCR
/end CHARACTERISTIC
/begin CHARACTERISTIC EGRVlv_DTYCYC_ATS.LimitTypeMsk_C "Actuator test EGRVlv_DTYCYC_ATS / Tester demand monitoring enable mask for actuators" VALUE 0x8058A74C Val_Wu8 255.0 OneToOne 0.00 255.0 FORMAT "%5.1" /end CHARACTERISTIC
/begin CHARACTERISTIC EGRVlv_DTYCYC_ATS.CnvNorm_C "Actuator test EGRVlv_DTYCYC_ATS / Conversion norm used for conversion to/from internal scaling" VALUE 0x8058A74D Val_Wu8 255.0 OneToOne 0.00 255.0 FORMAT "%5.1" /end CHARACTERISTIC
/begin CHARACTERISTIC EGRVlv_DTYCYC_ATS.LowLim_C "Actuator test EGRVlv_DTYCYC_ATS / Lower limit for monitoring" VALUE 0x8058A74E Val_Ws16 655.3500 DtyCyc -327.6800 327.6700 FORMAT "%8.4" /end CHARACTERISTIC
/begin CHARACTERISTIC EGRVlv_DTYCYC_ATS.UpLim_C "Actuator test EGRVlv_DTYCYC_ATS / Upper limit for monitoring" VALUE 0x8058A750 Val_Ws16 655.3500 DtyCyc -327.6800 327.6700 FORMAT "%8.4" /end CHARACTERISTIC
/begin CHARACTERISTIC EGRVlv_DTYCYC_ATS.CnvFac_C "Actuator test EGRVlv_DTYCYC_ATS / Factor used for conversion to/from internal scaling" VALUE 0x8058A754 Val_Ws32 4294967295.00 OneToOne -2147483648.00 2147483647.00 FORMAT "%13.2" /end CHARACTERISTIC
/begin CHARACTERISTIC EGRVlv_DTYCYC_ATS.CnvOfs_C "Actuator test EGRVlv_DTYCYC_ATS / Offset used for conversion to/from internal scaling" VALUE 0x8058A758 Val_Ws16 65535.00 OneToOne -32768.00 32767.00 FORMAT "%8.2" /end CHARACTERISTIC
/begin CHARACTERISTIC EGRVlv_DTYCYC_ATS.DfltVal_C "Actuator test EGRVlv_DTYCYC_ATS / Default value for standbytest" VALUE 0x8058A75A Val_Ws16 65535.00 OneToOne -32768.00 32767.00 FORMAT "%8.2" /end CHARACTERISTIC
/begin CHARACTERISTIC EGRVlv_ElecActrSpArbnCal.swtSpFltIniSel_C "Set-point arbiter calibration parameters / " VALUE 0x804D8648 Val_Wu8 255.0 OneToOne 0.00 255.0 FORMAT "%5.1" /end CHARACTERISTIC
/begin CHARACTERISTIC EGRVlv_ElecActrSpArbnCal.tiOpenDly_C "Set-point arbiter calibration parameters / " VALUE 0x804D8649 Val_Wu8 2550. Time_ms 0.00 2550. FORMAT "%5.0" /end CHARACTERISTIC
/begin CHARACTERISTIC EGRVlv_ElecActrSpArbnCal.tiClsdDly_C "Set-point arbiter calibration parameters / " VALUE 0x804D864A Val_Wu8 2550. Time_ms 0.00 2550. FORMAT "%5.0" /end CHARACTERISTIC
/begin CHARACTERISTIC EGRVlv_ElecActrSpArbnCal.rDesValThdClsdMin_C "Set-point arbiter calibration parameters / " VALUE 0x804D864C Val_Ws16 799.9878 Prc -400.0000 399.9878 FORMAT "%8.4" /end CHARACTERISTIC
/begin CHARACTERISTIC EGRVlv_ElecActrSpArbnCal.rDesValThdOpenMax_C "Set-point arbiter calibration parameters / " VALUE 0x804D864E Val_Ws16 799.9878 Prc -400.0000 399.9878 FORMAT "%8.4" /end CHARACTERISTIC
/begin CHARACTERISTIC EGRVlv_ElecActrSpArbnCldStrtCal.duCldMov_C "Cold start ramp calibration parameters / " VALUE 0x804D8644 Val_Ws16 655350.0 q10_mV_DIV_s -327680.0 327670.0 FORMAT "%8.1" /end CHARACTERISTIC
/begin CHARACTERISTIC EGRVlv_ElecActrSpArbnCldStrtCal.slpCldStrtRmp_C "Cold start ramp calibration parameters / " VALUE 0x804D8646 Val_Ws16 1562.476 RmpPrc16 -781.2500 781.2262 FORMAT "%8.4" /end CHARACTERISTIC
/begin CHARACTERISTIC EGRVlv_EnhdPosGovCal.tiDebMinMechBnd_C "" VALUE 0x8058C0E4 Val_Wu16 655350.0 Time_ms 0.00 655350.0 FORMAT "%8.1" /end CHARACTERISTIC
/begin CHARACTERISTIC EGRVlv_EnhdPosGovCal.tiDebMaxMechBnd_C "" VALUE 0x8058C0E6 Val_Wu16 655350.0 Time_ms 0.00 655350.0 FORMAT "%8.1" /end CHARACTERISTIC
/begin CHARACTERISTIC EGRVlv_EnhdPosGovCal.rGovDvtThresGovOn_C "" VALUE 0x8058C0E8 Val_Ws16 799.9878 Prc -400.0000 399.9878 FORMAT "%8.4" /end CHARACTERISTIC
/begin CHARACTERISTIC EGRVlv_EnhdPosGovCal.rGovDvtThresGovDelta_C "" VALUE 0x8058C0EA Val_Ws16 799.9878 Prc -400.0000 399.9878 FORMAT "%8.4" /end CHARACTERISTIC
/begin CHARACTERISTIC EGRVlv_EnhdPosGovCal.drDesValFltThresGovOn_C "" VALUE 0x8058C0EC Val_Ws16 7999.878 VlvVel -4000.000 3999.878 FORMAT "%8.3" /end CHARACTERISTIC
/begin CHARACTERISTIC EGRVlv_EnhdPosGovCal.rGovMax_C "" VALUE 0x8058C0EE Val_Ws16 799.9878 Prc -400.0000 399.9878 FORMAT "%8.4" /end CHARACTERISTIC
/begin CHARACTERISTIC EGRVlv_EnhdPosGovCal.rGovMin_C "" VALUE 0x8058C0F0 Val_Ws16 100.0000 Prc -100.0000 0.00 FORMAT "%8.4" EXTENDED_LIMITS -400.0000 399.9878 /end CHARACTERISTIC
/begin CHARACTERISTIC EGRVlv_EnhdPosGovCal.rGovLimEffMax_C "" VALUE 0x8058C0F2 Val_Ws16 799.9878 Prc -400.0000 399.9878 FORMAT "%8.4" /end CHARACTERISTIC
/begin CHARACTERISTIC EGRVlv_EnhdPosGovCal.duCldMov_C "" VALUE 0x8058C0F4 Val_Ws16 655350.0 q10_mV_DIV_s -327680.0 327670.0 FORMAT "%8.1" /end CHARACTERISTIC
/begin CHARACTERISTIC EGRVlv_EnhdPosGovCal.rGovMaxExtDem_C "" VALUE 0x8058C0F6 Val_Ws16 200.0000 Prc -100.0000 100.0000 FORMAT "%8.4" EXTENDED_LIMITS -400.0000 399.9878 /end CHARACTERISTIC
/begin CHARACTERISTIC EGRVlv_EnhdPosGovCal.iEffMdlHeat_C "" VALUE 0x8058C0F8 Val_Ws16 2047.969 Curr_A_q0p03125_COMPU -1024.000 1023.969 FORMAT "%8.3" /end CHARACTERISTIC
/begin CHARACTERISTIC EGRVlv_EnhdPosGovCal.iEffMdlCool_C "" VALUE 0x8058C0FA Val_Ws16 2047.969 Curr_A_q0p03125_COMPU -1024.000 1023.969 FORMAT "%8.3" /end CHARACTERISTIC
/begin CHARACTERISTIC EGRVlv_EnhdPosGovCal.stSpLimnDiMask_C "" VALUE 0x8058C0FC Val_Wu8 255.0 OneToOne 0.00 255.0 FORMAT "%5.1" /end CHARACTERISTIC
/begin CHARACTERISTIC EGRVlv_EnhdPosGovCal.numExtArmtrTSel_C "" VALUE 0x8058C0FE Val_Wu16 255.000000000 DELIB_ALLTEMP_VERB_COMPU 0.00 255.000000000 FORMAT "%13.9" /end CHARACTERISTIC
/begin CHARACTERISTIC EGRVlv_EnhdPosGovCal.tiArmtrFlt_C "" VALUE 0x8058C100 Val_Ws32 4294.9672940000000 TimeDelay_s 0.0000020000000 4294.9672959999998 FORMAT "%19.14" EXTENDED_LIMITS 0.000002000000001 4294.9672959999998 /end CHARACTERISTIC
/begin CHARACTERISTIC EGRVlv_EnhdPosGovCal.swtGovByp_C "" VALUE 0x8058C104 Val_Wu8 255.0 OneToOne 0.00 255.0 FORMAT "%5.1" /end CHARACTERISTIC
/begin CHARACTERISTIC EGRVlv_EnhdPosGovCal.rDesValMaxOff_C "" VALUE 0x8058C106 Val_Ws16 799.9878 Prc -400.0000 399.9878 FORMAT "%8.4" /end CHARACTERISTIC
/begin CHARACTERISTIC EGRVlv_EnhdPosGovCal.rDesValMinOff_C "" VALUE 0x8058C108 Val_Ws16 799.9878 Prc -400.0000 399.9878 FORMAT "%8.4" /end CHARACTERISTIC
/begin CHARACTERISTIC EGRVlv_EnhdPosGovCal.rDesValMin_C "" VALUE 0x8058C10A Val_Ws16 799.9878 Prc -400.0000 399.9878 FORMAT "%8.4" /end CHARACTERISTIC
/begin CHARACTERISTIC EGRVlv_EnhdPosGovCal.rDesValMax_C "" VALUE 0x8058C10C Val_Ws16 799.9878 Prc -400.0000 399.9878 FORMAT "%8.4" /end CHARACTERISTIC
/begin CHARACTERISTIC EGRVlv_EnhdPosGovCal.rGovDesValMin_C "" VALUE 0x8058C10E Val_Ws16 799.9878 Prc -400.0000 399.9878 FORMAT "%8.4" /end CHARACTERISTIC
/begin CHARACTERISTIC EGRVlv_EnhdPosGovCal.rGovDesValMax_C "" VALUE 0x8058C110 Val_Ws16 799.9878 Prc -400.0000 399.9878 FORMAT "%8.4" /end CHARACTERISTIC
/begin CHARACTERISTIC EGRVlv_EnhdPosGovCal.numMdnAvrgSpd_C "" VALUE 0x8058C112 Val_Wu8 255.0 OneToOne 0.00 255.0 FORMAT "%5.1" /end CHARACTERISTIC
/begin CHARACTERISTIC EGRVlv_EnhdPosGovCal.swtrGovDesVal_C "" VALUE 0x8058C113 Val_Wu8 255.0 OneToOne 0.00 255.0 FORMAT "%5.1" /end CHARACTERISTIC
/begin CHARACTERISTIC EGRVlv_EnhdPosGovCal.rIniI_C "" VALUE 0x8058C114 Val_Ws16 799.9878 Prc -400.0000 399.9878 FORMAT "%8.4" /end CHARACTERISTIC
/begin CHARACTERISTIC EGRVlv_EnhdPosGovCal.swtRlsLimDeactv_C "" VALUE 0x8058C116 Val_Wu8 255.0 OneToOne 0.00 255.0 FORMAT "%5.1" /end CHARACTERISTIC
/begin CHARACTERISTIC EGRVlv_facCapHtHsng_CUR "Factor of the heat capacity of the actuator housing" CURVE 0x8058BEAE RB_Curve_S16_S16 7.999878 Fact -4.000000 3.999878 FORMAT "%8.6"
 /begin AXIS_DESCR STD_AXIS EGRVlv_tEngTempGradAbs_mp TempDiff_Kelv 25 -3276.800 3276.700 FORMAT "%8.3" DEPOSIT ABSOLUTE /end AXIS_DESCR
/end CHARACTERISTIC
/begin CHARACTERISTIC EGRVlv_facClgEngEnv_CUR "Weighting factor to calculate how much the armature might have cooled based on the engine cooled and environment temperature" CURVE 0x8058BF14 RB_Curve_S16_S16 7.999878 Fact -4.000000 3.999878 FORMAT "%8.6"
 /begin AXIS_DESCR STD_AXIS EGRVlv_facClgEngEnvCrvIn_mp Fact 25 -4.000000 3.999878 FORMAT "%8.6" DEPOSIT ABSOLUTE /end AXIS_DESCR
/end CHARACTERISTIC
/begin CHARACTERISTIC EGRVlv_facPresDsbcLim_CUR "Pressure disturbance on the valve based correction factor for maximum and minimum position governor output limitation" CURVE 0x8058BF7A RB_Curve_S16_S16 7.999878 Fact -4.000000 3.999878 FORMAT "%8.6"
 /begin AXIS_DESCR STD_AXIS EGRVlv_pDsbc_mp Pres_hPa 25 -32768.00 32767.00 FORMAT "%8.2" DEPOSIT ABSOLUTE /end AXIS_DESCR
/end CHARACTERISTIC
/begin CHARACTERISTIC EGRVlv_LRN_ATS.LimitTypeMsk_C "Actuator test EGRVlv_LRN_ATS / Tester demand monitoring enable mask for actuators" VALUE 0x8058A75C Val_Wu8 255.0 OneToOne 0.00 255.0 FORMAT "%5.1" /end CHARACTERISTIC
/begin CHARACTERISTIC EGRVlv_LRN_ATS.CnvNorm_C "Actuator test EGRVlv_LRN_ATS / Conversion norm used for conversion to/from internal scaling" VALUE 0x8058A75D Val_Wu8 255.0 OneToOne 0.00 255.0 FORMAT "%5.1" /end CHARACTERISTIC
/begin CHARACTERISTIC EGRVlv_LRN_ATS.LowLim_C "Actuator test EGRVlv_LRN_ATS / Lower limit for monitoring" VALUE 0x8058A75E Val_Ws16 799.9878 Prc -400.0000 399.9878 FORMAT "%8.4" /end CHARACTERISTIC
/begin CHARACTERISTIC EGRVlv_LRN_ATS.UpLim_C "Actuator test EGRVlv_LRN_ATS / Upper limit for monitoring" VALUE 0x8058A760 Val_Ws16 799.9878 Prc -400.0000 399.9878 FORMAT "%8.4" /end CHARACTERISTIC
/begin CHARACTERISTIC EGRVlv_LRN_ATS.CnvFac_C "Actuator test EGRVlv_LRN_ATS / Factor used for conversion to/from internal scaling" VALUE 0x8058A764 Val_Ws32 4294967295.00 OneToOne -2147483648.00 2147483647.00 FORMAT "%13.2" /end CHARACTERISTIC
/begin CHARACTERISTIC EGRVlv_LRN_ATS.CnvOfs_C "Actuator test EGRVlv_LRN_ATS / Offset used for conversion to/from internal scaling" VALUE 0x8058A768 Val_Ws16 65535.00 OneToOne -32768.00 32767.00 FORMAT "%8.2" /end CHARACTERISTIC
/begin CHARACTERISTIC EGRVlv_LRN_ATS.DfltVal_C "Actuator test EGRVlv_LRN_ATS / Default value for standbytest" VALUE 0x8058A76A Val_Ws16 65535.00 OneToOne -32768.00 32767.00 FORMAT "%8.2" /end CHARACTERISTIC
/begin CHARACTERISTIC EGRVlv_MulHysCal.rDesValMin_C "set of parameters for multi hysteresis functionality / Minimum threshold to activate multi hysteresis functionality" VALUE 0x8058B6B0 Val_Ws16 799.9878 Prc -400.0000 399.9878 FORMAT "%8.4" /end CHARACTERISTIC
/begin CHARACTERISTIC EGRVlv_MulHysCal.rDesValMax_C "set of parameters for multi hysteresis functionality / Maximum threshold to activate multi hysteresis functionality" VALUE 0x8058B6B2 Val_Ws16 799.9878 Prc -400.0000 399.9878 FORMAT "%8.4" /end CHARACTERISTIC
/begin CHARACTERISTIC EGRVlv_numElecActr_C "SW Version of DELib_ElecActr calibration data" VALUE 0x8058BFE0 Val_Wu32 4294967295.00 OneToOne 0.00 4294967295.00 FORMAT "%13.2" /end CHARACTERISTIC
/begin CHARACTERISTIC EGRVlv_numMulHystChara_CA "Multi Hysteresis characteristics of hysteresis loop" VAL_BLK 0x8053B842 ValA_Wu8 255.0 OneToOne 0.00 255.0 FORMAT "%5.1" NUMBER 1 /end CHARACTERISTIC
/begin CHARACTERISTIC EGRVlv_PidGovr.facTqLossCmp_CUR "PID Governor Class / Temperature based Torque loss compensation curve" CURVE 0x8053C350 RB_Curve_S16_S16 7.999878 Fact -4.000000 3.999878 FORMAT "%8.6"
 /begin AXIS_DESCR STD_AXIS EGRVlv_PidGovr.tActrfacTqLossCmpCurInp Temp_Cels 25 -3549.940 3003.560 FORMAT "%8.3" DEPOSIT ABSOLUTE /end AXIS_DESCR
/end CHARACTERISTIC
/begin CHARACTERISTIC EGRVlv_PidGovr.rActrLim2_CUR "PID Governor Class / Curve to limit the actuator torque based on the sensed position" CURVE 0x8053C3B6 RB_Curve_S16_S16 799.9878 Prc -400.0000 399.9878 FORMAT "%8.4"
 /begin AXIS_DESCR STD_AXIS EGRVlv_PidGovr.uRawrActrLim2CurInp Volt 25 -6553.600 6553.400 FORMAT "%8.3" DEPOSIT ABSOLUTE /end AXIS_DESCR
/end CHARACTERISTIC
/begin CHARACTERISTIC EGRVlv_PidGovrCal.CoilCompKd_C "Calibration Parameter Structure for Elecactr PID Governor / DT1 filter gain to calculate the coil compensation duty cycle" VALUE 0x8053C41C RB_Val_Ws16 127.9980 Kd_1 -64.00000 63.99805 FORMAT "%8.5" /end CHARACTERISTIC
/begin CHARACTERISTIC EGRVlv_PidGovrCal.drDesValMaxIniI_C "Calibration Parameter Structure for Elecactr PID Governor / Maximum threshold of the derivative of the desired value leading to I-State initialization" VALUE 0x8053C41E RB_Val_Ws16 7999.878 VlvVel -4000.000 3999.878 FORMAT "%8.3" /end CHARACTERISTIC
/begin CHARACTERISTIC EGRVlv_PidGovrCal.drDesValMinIniI_C "Calibration Parameter Structure for Elecactr PID Governor / Minimum rate of change of desired value for initialisation of I part" VALUE 0x8053C420 RB_Val_Ws16 7999.878 VlvVel -4000.000 3999.878 FORMAT "%8.3" /end CHARACTERISTIC
/begin CHARACTERISTIC EGRVlv_PidGovrCal.drDesValNegIniI_C "Calibration Parameter Structure for Elecactr PID Governor / Negative threshold for desired value gradient" VALUE 0x8053C422 RB_Val_Ws16 7999.878 VlvVel -4000.000 3999.878 FORMAT "%8.3" /end CHARACTERISTIC
/begin CHARACTERISTIC EGRVlv_PidGovrCal.drDesValPosIniI_C "Calibration Parameter Structure for Elecactr PID Governor / Positive threshold for desired value gradient" VALUE 0x8053C424 RB_Val_Ws16 7999.878 VlvVel -4000.000 3999.878 FORMAT "%8.3" /end CHARACTERISTIC
/begin CHARACTERISTIC EGRVlv_PidGovrCal.drDesValRampIPartFrzMax_C "Calibration Parameter Structure for Elecactr PID Governor / e_:Maximum desired value gradient threshold to limit the I part when the slow desired value is detected:_e;d_:Maximale Schwelle des gewünschten Wertgradients zur Begrenzung des I-Anteils, wenn ein langsamer gewünschter Wert erkannt wird:_d" VALUE 0x8053C426 RB_Val_Ws16 7999.878 VlvVel -4000.000 3999.878 FORMAT "%8.3" /end CHARACTERISTIC
/begin CHARACTERISTIC EGRVlv_PidGovrCal.drDesValRampIPartFrzMin_C "Calibration Parameter Structure for Elecactr PID Governor / e_:Minimum desired value gradient threshold to limit the I part when the slow desired value is detected :_e;d_:Minimale Schwelle des gewünschten Wertgradients zur Begrenzung des I-Anteils, wenn ein langsamer gewünschter Wert erkannt wird:_d" VALUE 0x8053C428 RB_Val_Ws16 7999.878 VlvVel -4000.000 3999.878 FORMAT "%8.3" /end CHARACTERISTIC
/begin CHARACTERISTIC EGRVlv_PidGovrCal.rGovDvtMaxIniI_C "Calibration Parameter Structure for Elecactr PID Governor / Maximum threshold for governor deviation to initialize the I part of the governor" VALUE 0x8053C42A RB_Val_Ws16 799.9878 Prc -400.0000 399.9878 FORMAT "%8.4" /end CHARACTERISTIC
/begin CHARACTERISTIC EGRVlv_PidGovrCal.rGovDvtMinIniI_C "Calibration Parameter Structure for Elecactr PID Governor / Minimum governor deviation during initialisation of I part" VALUE 0x8053C42C RB_Val_Ws16 799.9756 Prc -399.9878 399.9878 FORMAT "%8.4" EXTENDED_LIMITS -400.0000 399.9878 /end CHARACTERISTIC
/begin CHARACTERISTIC EGRVlv_PidGovrCal.rGovDvtRampIPartFrzMin_C "Calibration Parameter Structure for Elecactr PID Governor / e_:Minimum governor deviation threshold to limit the I part when the slow desired value is detected:_e;d_:Minimale Schwelle der Reglerabweichung zur Begrenzung des I-Anteils, wenn ein langsamer gewünschter Wert erkannt wird:_d" VALUE 0x8053C42E RB_Val_Ws16 799.9878 Prc -400.0000 399.9878 FORMAT "%8.4" /end CHARACTERISTIC
/begin CHARACTERISTIC EGRVlv_PidGovrCal.rIntegMax_C "Calibration Parameter Structure for Elecactr PID Governor / Upper threshold for I-state limitation" VALUE 0x8053C430 RB_Val_Ws16 799.9878 Prc -400.0000 399.9878 FORMAT "%8.4" /end CHARACTERISTIC
/begin CHARACTERISTIC EGRVlv_PidGovrCal.rIntegMin_C "Calibration Parameter Structure for Elecactr PID Governor / Minimum value of integral part for PID governor" VALUE 0x8053C432 RB_Val_Ws16 799.9878 Prc -400.0000 399.9878 FORMAT "%8.4" /end CHARACTERISTIC
/begin CHARACTERISTIC EGRVlv_PidGovrCal.rOutIMaxIniI_C "Calibration Parameter Structure for Elecactr PID Governor / Threshold of the I-part leading to a reinitialization if the I-state if direction is changed" VALUE 0x8053C434 RB_Val_Ws16 799.9878 Prc -400.0000 399.9878 FORMAT "%8.4" /end CHARACTERISTIC
/begin CHARACTERISTIC EGRVlv_PidGovrCal.rOutIMax_C "Calibration Parameter Structure for Elecactr PID Governor / Upper threshold for limiting the I-part if holding current limitation is active" VALUE 0x8053C436 RB_Val_Ws16 799.9878 Prc -400.0000 399.9878 FORMAT "%8.4" /end CHARACTERISTIC
/begin CHARACTERISTIC EGRVlv_PidGovrCal.swtDT1In_C "Calibration Parameter Structure for Elecactr PID Governor / Selection of DT1 input" VALUE 0x8053C438 RB_Val_Wu8 255.0 OneToOne 0.00 255.0 FORMAT "%5.1" /end CHARACTERISTIC
/begin CHARACTERISTIC EGRVlv_PidGovrCal.tiCoilCompT1_C "Calibration Parameter Structure for Elecactr PID Governor / T1-filter time constant of the DT1-governor in the electrical compensation of the coil" VALUE 0x8053C43A RB_Val_Ws16 16.77670398 TimeDelay_s_2 0.00051202 16.77721600 FORMAT "%12.8" /end CHARACTERISTIC
/begin CHARACTERISTIC EGRVlv_PosGovCal.IKiFrcSlp_C "Position Governor parameter structure / " VALUE 0x8058C118 Val_Ws32 1000.00016391 Ki 0.00 1000.00016391 FORMAT "%13.8" EXTENDED_LIMITS -1000000.00000 999999.999534 /end CHARACTERISTIC
/begin CHARACTERISTIC EGRVlv_PosGovCal.tiGovDT1_C "Position Governor parameter structure / " VALUE 0x8058C11C Val_Ws16 16.77670398 TimeDelay_s_2 0.00051202 16.77721600 FORMAT "%12.8" /end CHARACTERISTIC
/begin CHARACTERISTIC EGRVlv_PosGovCal.rOutDMax_C "Position Governor parameter structure / " VALUE 0x8058C11E Val_Ws16 100.0000 Prc 0.00 100.0000 FORMAT "%8.4" EXTENDED_LIMITS -400.0000 399.9878 /end CHARACTERISTIC
/begin CHARACTERISTIC EGRVlv_PosGovCal.rGovDvtMaxFrcRmp_C "Position Governor parameter structure / " VALUE 0x8058C120 Val_Ws16 109.9976 Prc -9.9976 100.0000 FORMAT "%8.4" EXTENDED_LIMITS -400.0000 399.9878 /end CHARACTERISTIC
/begin CHARACTERISTIC EGRVlv_PosGovCal.rGovDvtFrcInactv_C "Position Governor parameter structure / " VALUE 0x8058C122 Val_Ws16 109.9976 Prc -9.9976 100.0000 FORMAT "%8.4" EXTENDED_LIMITS -400.0000 399.9878 /end CHARACTERISTIC
/begin CHARACTERISTIC EGRVlv_PosGovCal.rFrcMax_C "Position Governor parameter structure / " VALUE 0x8058C124 Val_Ws16 30.00488 Prc 0.00 30.00488 FORMAT "%8.5" EXTENDED_LIMITS -400.0000 399.9878 /end CHARACTERISTIC
/begin CHARACTERISTIC EGRVlv_PosGovCal.tiEMFCompT1_C "Position Governor parameter structure / " VALUE 0x8058C126 Val_Ws16 16.77670398 TimeDelay_s_2 0.00051202 16.77721600 FORMAT "%12.8" /end CHARACTERISTIC
/begin CHARACTERISTIC EGRVlv_PosGovCal.EMFCompKd_C "Position Governor parameter structure / " VALUE 0x8058C128 Val_Ws16 127.9980 Kd_1 -64.00000 63.99805 FORMAT "%8.5" /end CHARACTERISTIC
/begin CHARACTERISTIC EGRVlv_PosGovCal.duRawFrcRmpThres_C "Position Governor parameter structure / " VALUE 0x8058C12A Val_Ws16 655350.0 q10_mV_DIV_s -327680.0 327670.0 FORMAT "%8.1" /end CHARACTERISTIC
/begin CHARACTERISTIC EGRVlv_PosGovCal.rOutDFrcRmpThres_C "Position Governor parameter structure / " VALUE 0x8058C12C Val_Ws16 799.9878 Prc -400.0000 399.9878 FORMAT "%8.4" /end CHARACTERISTIC
/begin CHARACTERISTIC EGRVlv_PosGovCal.tiGovDesMaxIniI_C "Position Governor parameter structure / " VALUE 0x8058C12E Val_Wu16 655350.0 Time_ms 0.00 655350.0 FORMAT "%8.1" /end CHARACTERISTIC
/begin CHARACTERISTIC EGRVlv_PosGovCal.rGovDesMaxIniI_C "Position Governor parameter structure / " VALUE 0x8058C130 Val_Ws16 799.9878 Prc -400.0000 399.9878 FORMAT "%8.4" /end CHARACTERISTIC
/begin CHARACTERISTIC EGRVlv_PosGovCal.rActMaxIniI_C "Position Governor parameter structure / " VALUE 0x8058C132 Val_Ws16 799.9878 Prc -400.0000 399.9878 FORMAT "%8.4" /end CHARACTERISTIC
/begin CHARACTERISTIC EGRVlv_PosGovCal.rGovDesMinIniI_C "Position Governor parameter structure / " VALUE 0x8058C134 Val_Ws16 799.9878 Prc -400.0000 399.9878 FORMAT "%8.4" /end CHARACTERISTIC
/begin CHARACTERISTIC EGRVlv_PosGovCal.rActMinIniI_C "Position Governor parameter structure / " VALUE 0x8058C136 Val_Ws16 799.9878 Prc -400.0000 399.9878 FORMAT "%8.4" /end CHARACTERISTIC
/begin CHARACTERISTIC EGRVlv_PosGovCal.rGovDesValJmpMin_C "Position Governor parameter structure / " VALUE 0x8058C138 Val_Ws16 799.9878 Prc -400.0000 399.9878 FORMAT "%8.4" /end CHARACTERISTIC
/begin CHARACTERISTIC EGRVlv_PosGovCal.tiSettle_C "Position Governor parameter structure / " VALUE 0x8058C13A Val_Wu8 2550. Time_ms 0.00 2550. FORMAT "%5.0" /end CHARACTERISTIC
/begin CHARACTERISTIC EGRVlv_PosGovCal.rGovDvtOscThres_C "Position Governor parameter structure / " VALUE 0x8058C13C Val_Ws16 799.9878 Prc -400.0000 399.9878 FORMAT "%8.4" /end CHARACTERISTIC
/begin CHARACTERISTIC EGRVlv_PosGovCal.cntOscThres_C "Position Governor parameter structure / " VALUE 0x8058C13E Val_Wu8 255.0 OneToOne 0.00 255.0 FORMAT "%5.1" /end CHARACTERISTIC
/begin CHARACTERISTIC EGRVlv_PosGovCal.drGovDesValMinLimI_C "Position Governor parameter structure / " VALUE 0x8058C140 Val_Ws16 7999.878 VlvVel -4000.000 3999.878 FORMAT "%8.3" /end CHARACTERISTIC
/begin CHARACTERISTIC EGRVlv_PosGovCal.cntLimI_C "Position Governor parameter structure / " VALUE 0x8058C142 Val_Wu8 255.0 OneToOne 0.00 255.0 FORMAT "%5.1" /end CHARACTERISTIC
/begin CHARACTERISTIC EGRVlv_PosGovCal.numTempSel_C "Position Governor parameter structure / " VALUE 0x8058C144 Val_Wu16 255.000000000 DELIB_ALLTEMP_VERB_COMPU 0.00 255.000000000 FORMAT "%13.9" /end CHARACTERISTIC
/begin CHARACTERISTIC EGRVlv_PosGovCal.numPreCtlMapIn_C "Position Governor parameter structure / " VALUE 0x8058C146 Val_Wu8 2.00000000000 DELibPreCtlInSel_VERB 0.00 2.00000000000 FORMAT "%13.11" /end CHARACTERISTIC
/begin CHARACTERISTIC EGRVlv_PosGovCal.numPreCtlHystIn_C "Position Governor parameter structure / " VALUE 0x8058C147 Val_Wu8 2.00000000000 DELibPreCtlInSel_VERB 0.00 2.00000000000 FORMAT "%13.11" /end CHARACTERISTIC
/begin CHARACTERISTIC EGRVlv_PosGovCal.numPreCtlCurIn_C "Position Governor parameter structure / " VALUE 0x8058C148 Val_Wu8 2.00000000000 DELibPreCtlInSel_VERB 0.00 2.00000000000 FORMAT "%13.11" /end CHARACTERISTIC
/begin CHARACTERISTIC EGRVlv_PosGovCal.stLimIniIMask_C "Position Governor parameter structure / " VALUE 0x8058C14A Val_Wu16 65535.00 OneToOne 0.00 65535.00 FORMAT "%8.2" /end CHARACTERISTIC
/begin CHARACTERISTIC EGRVlv_PosGovCal.tiLimIniIRstDly_C "Position Governor parameter structure / " VALUE 0x8058C14C Val_Ws16 655350.0 Time_ms -327680.0 327670.0 FORMAT "%8.1" /end CHARACTERISTIC
/begin CHARACTERISTIC EGRVlv_PosGovCal.numPreCtlTemp_C "Position Governor parameter structure / " VALUE 0x8058C14E Val_Wu16 255.000000000 DELIB_ALLTEMP_VERB_COMPU 0.00 255.000000000 FORMAT "%13.9" /end CHARACTERISTIC
/begin CHARACTERISTIC EGRVlv_PosGovCal.tiGovDvtDT1_C "Position Governor parameter structure / " VALUE 0x8058C150 Val_Ws32 4294.9672940000000 TimeDelay_s 0.0000020000000 4294.9672959999998 FORMAT "%19.14" EXTENDED_LIMITS 0.000002000000001 4294.9672959999998 /end CHARACTERISTIC
/begin CHARACTERISTIC EGRVlv_PosGovCal.KdGovDvtDT1_C "Position Governor parameter structure / " VALUE 0x8058C154 Val_Ws32 4294.96729500 FactFine -2147.48364800 2147.48364700 FORMAT "%13.8" /end CHARACTERISTIC
/begin CHARACTERISTIC EGRVlv_PosGovCal.rGovTstMin_C "Position Governor parameter structure / " VALUE 0x8058C158 Val_Ws16 799.9878 Prc -400.0000 399.9878 FORMAT "%8.4" /end CHARACTERISTIC
/begin CHARACTERISTIC EGRVlv_PosGovCal.rGovTstMax_C "Position Governor parameter structure / " VALUE 0x8058C15A Val_Ws16 799.9878 Prc -400.0000 399.9878 FORMAT "%8.4" /end CHARACTERISTIC
/begin CHARACTERISTIC EGRVlv_Pwm.tiPer_C "PWM out parameter structure / Reference value for period duration (small type to limit dynamic range)" VALUE 0x8058B0AA Kw_Ws16 65535.00 OneToOne -32768.00 32767.00 FORMAT "%8.2" /end CHARACTERISTIC
/begin CHARACTERISTIC EGRVlv_Pwm.stLvl_C "PWM out parameter structure / Reference value for phase relationship in period units" VALUE 0x8058B0AC Kw_Wu8 255.0 OneToOne 0.00 255.0 FORMAT "%5.1" /end CHARACTERISTIC
/begin CHARACTERISTIC EGRVlv_Pwm.rMaxDty_C "PWM out parameter structure / Reference value for maximum duty cycle" VALUE 0x8058B0AE Kw_Ws16 655.3500 DtyCyc -327.6800 327.6700 FORMAT "%8.4" /end CHARACTERISTIC
/begin CHARACTERISTIC EGRVlv_Pwm.rPerUn_C "PWM out parameter structure / us per Pwmout_tiPeriod unit (1==us, 1000=ms)" VALUE 0x8058B0B0 Kw_Ws16 65535.00 TimeDT -32768.00 32767.00 FORMAT "%8.2" /end CHARACTERISTIC
/begin CHARACTERISTIC EGRVlv_Pwm.tiPh_C "PWM out parameter structure / Phase shift for the PWM signal" VALUE 0x8058B0B2 Kw_Ws16 65535.00 OneToOne -32768.00 32767.00 FORMAT "%8.2" /end CHARACTERISTIC
/begin CHARACTERISTIC EGRVlv_PwmOutCal.rMin_C " / Lower threshold to limit the duty cycle output" VALUE 0x8058C15C Val_Ws16 655.3500 DtyCyc -327.6800 327.6700 FORMAT "%8.4" /end CHARACTERISTIC
/begin CHARACTERISTIC EGRVlv_PwmOutCal.rMax_C " / Upper threshold to limit the duty cycle output" VALUE 0x8058C15E Val_Ws16 655.3500 DtyCyc -327.6800 327.6700 FORMAT "%8.4" /end CHARACTERISTIC
/begin CHARACTERISTIC EGRVlv_PwmOutCal.swtBattCor_C " / Battery voltage correction for the output duty cycle active" VALUE 0x8058C160 Val_Wu8 255.0 OneToOne 0.00 255.0 FORMAT "%5.1" /end CHARACTERISTIC
/begin CHARACTERISTIC EGRVlv_pwmPsDiagCal.nrTstPls_C "Calibraton structure for powerstage diagnosis / Maximum number of test impulses possible in one driving cycle." VALUE 0x8058B880 Kw_Wu32 4294967295.00 OneToOne 0.00 4294967295.00 FORMAT "%13.2" /end CHARACTERISTIC
/begin CHARACTERISTIC EGRVlv_pwmPsDiagCal.tiBtwElecFlt_C "Calibraton structure for powerstage diagnosis / Time between test in case a short circuit or open load is detected." VALUE 0x8058B884 Kw_Ws16 655350.0 Time_ms -327680.0 327670.0 FORMAT "%8.1" /end CHARACTERISTIC
/begin CHARACTERISTIC EGRVlv_pwmPsDiagCal.tiBtwOTFlt_C "Calibraton structure for powerstage diagnosis / Time between test when an over temperature error is detected." VALUE 0x8058B886 Kw_Ws16 655.3500 Time_s -327.6800 327.6700 FORMAT "%8.4" /end CHARACTERISTIC
/begin CHARACTERISTIC EGRVlv_rActrLim_M "MAP to limit the actuator torque based on the sensed voltage and the derivation of raw voltage value of position sensor" MAP 0x8053BE00 RB_Map_S16S16_S16 799.9878 Prc -400.0000 399.9878 FORMAT "%8.4"
 /begin AXIS_DESCR STD_AXIS EGRVlv_rAct Prc 25 -400.0000 399.9878 FORMAT "%8.4" DEPOSIT ABSOLUTE /end AXIS_DESCR
 /begin AXIS_DESCR STD_AXIS EGRVlv_duRawUnFild q10_mV_DIV_s 25 -327680.0 327670.0 FORMAT "%8.1" DEPOSIT ABSOLUTE /end AXIS_DESCR
/end CHARACTERISTIC
/begin CHARACTERISTIC EGRVlv_rActTst_CUR "Curve to convert the actuator positon to a new actual value which corresponds to the position convention of air model" CURVE 0x8058BFE4 RB_Curve_S16_S16 799.9878 Prc -400.0000 399.9878 FORMAT "%8.4"
 /begin AXIS_DESCR STD_AXIS EGRVlv_rAct Prc 25 -400.0000 399.9878 FORMAT "%8.4" DEPOSIT ABSOLUTE /end AXIS_DESCR
/end CHARACTERISTIC
/begin CHARACTERISTIC EGRVlv_ratActLin_CUR "Curve for autosar named message" CURVE 0x8058C162 RB_Curve_S16_S16 511.9922 rel_q0p0078125 -256.0000 255.9922 FORMAT "%8.4"
 /begin AXIS_DESCR STD_AXIS EGRVlv_rAct Prc 25 -400.0000 399.9878 FORMAT "%8.4" DEPOSIT ABSOLUTE /end AXIS_DESCR
/end CHARACTERISTIC
/begin CHARACTERISTIC EGRVlv_rCnv_CUR "Curve for set point to dutycycle conversion for single flow implementation" CURVE 0x8058C1C8 RB_Curve_S16_S16 655.3500 DtyCyc -327.6800 327.6700 FORMAT "%8.4"
 /begin AXIS_DESCR STD_AXIS EGRVlv_rActr Prc 25 -400.0000 399.9878 FORMAT "%8.4" DEPOSIT ABSOLUTE /end AXIS_DESCR
/end CHARACTERISTIC
/begin CHARACTERISTIC EGRVlv_rDesActrATS_CUR "Position setpoint curve for ATS" CURVE 0x8058B6B4 RB_Curve_S16_S16 799.9878 Prc -400.0000 399.9878 FORMAT "%8.4"
 /begin AXIS_DESCR STD_AXIS EGRVlv_rDesValATS_mp Prc 25 -400.0000 399.9878 FORMAT "%8.4" DEPOSIT ABSOLUTE /end AXIS_DESCR
/end CHARACTERISTIC
/begin CHARACTERISTIC EGRVlv_rDesActrHyst2CUR_CA "left hysteresis threshold" VAL_BLK 0x8058B71A ValA_Ws16 799.9878 Prc -400.0000 399.9878 FORMAT "%8.4" NUMBER 25 /end CHARACTERISTIC
/begin CHARACTERISTIC EGRVlv_rDesActrHyst_CUR "right hysteresis threshold" CURVE 0x8058B74C Cur_Xs16Ws16 799.9878 Prc -400.0000 399.9878 FORMAT "%8.4"
 /begin AXIS_DESCR STD_AXIS EGRVlv_rDesVal_mp Prc 25 -400.0000 399.9878 FORMAT "%8.4" DEPOSIT ABSOLUTE /end AXIS_DESCR
/end CHARACTERISTIC
/begin CHARACTERISTIC EGRVlv_rDesActrLrnATS_CUR "Position setpoint curve for LRNATS" CURVE 0x8058B7B2 RB_Curve_S16_S16 799.9878 Prc -400.0000 399.9878 FORMAT "%8.4"
 /begin AXIS_DESCR STD_AXIS EGRVlv_rDesValATS_mp Prc 25 -400.0000 399.9878 FORMAT "%8.4" DEPOSIT ABSOLUTE /end AXIS_DESCR
/end CHARACTERISTIC
/begin CHARACTERISTIC EGRVlv_rDesActr_CUR "Position setpoint curve" CURVE 0x8058B818 RB_Curve_S16_S16 799.9878 Prc -400.0000 399.9878 FORMAT "%8.4"
 /begin AXIS_DESCR STD_AXIS EGRVlv_r Prc 25 -400.0000 399.9878 FORMAT "%8.4" DEPOSIT ABSOLUTE /end AXIS_DESCR
/end CHARACTERISTIC
/begin CHARACTERISTIC EGRVlv_rDflDtyCyc_CUR "The Default dutycycle to the actuator when the EGRVlv_stMon2.DELIB_ELECACTR_STMON2_DFLMOV_BP is set" CURVE 0x8058C22E RB_Curve_S16_S16 799.9878 Prc -400.0000 399.9878 FORMAT "%8.4"
 /begin AXIS_DESCR STD_AXIS EGRVlv_tiDfltMov Time_msec_q1_COMPU 25 -32768.00 32767.00 FORMAT "%8.2" DEPOSIT ABSOLUTE /end AXIS_DESCR
/end CHARACTERISTIC
/begin CHARACTERISTIC EGRVlv_rGovActrRlsMax_CUR "Maximum DtyCyc for jam healing attempt" CURVE 0x8058AFDE RB_Curve_S16_S16 799.9878 Prc -400.0000 399.9878 FORMAT "%8.4"
 /begin AXIS_DESCR STD_AXIS EGRVlv_rAct Prc 25 -400.0000 399.9878 FORMAT "%8.4" DEPOSIT ABSOLUTE /end AXIS_DESCR
/end CHARACTERISTIC
/begin CHARACTERISTIC EGRVlv_rGovMaxTemp_M "Map for maximum governor output calculation based on actuator temperature" MAP 0x8053B8B6 Map_Xs16Ys16Ws16 799.9878 Prc -400.0000 399.9878 FORMAT "%8.4"
 /begin AXIS_DESCR STD_AXIS EGRVlv_tActr Temp_Cels 25 -3549.940 3003.560 FORMAT "%8.3" DEPOSIT ABSOLUTE /end AXIS_DESCR
 /begin AXIS_DESCR STD_AXIS EGRVlv_rGovDvt Prc 25 -400.0000 399.9878 FORMAT "%8.4" DEPOSIT ABSOLUTE /end AXIS_DESCR
/end CHARACTERISTIC
/begin CHARACTERISTIC EGRVlv_RlsFuncCal.rIniI_C "Calibration class instance for jam healing / Integrator initialization value" VALUE 0x8053B798 Val_Ws16 799.9878 Prc -400.0000 399.9878 FORMAT "%8.4" /end CHARACTERISTIC
/begin CHARACTERISTIC EGRVlv_RlsFuncCal.tiRlsMove_C "Calibration class instance for jam healing / Maximum time for a release attempt using maximum duty cycle" VALUE 0x8053B79A Val_Wu8 2550. Time_ms 0.00 2550. FORMAT "%5.0" /end CHARACTERISTIC
/begin CHARACTERISTIC EGRVlv_RlsFuncCal.tiRlsWait_C "Calibration class instance for jam healing / Maximum time between two release attempts" VALUE 0x8053B79B Val_Wu8 25500. q100_ms 0.00 25500. FORMAT "%5.0" /end CHARACTERISTIC
/begin CHARACTERISTIC EGRVlv_RlsFuncCal.tiRlsMoveMax_C "Calibration class instance for jam healing / Maximum time for a release attempt" VALUE 0x8053B79C Val_Wu8 2550. Time_ms 0.00 2550. FORMAT "%5.0" /end CHARACTERISTIC
/begin CHARACTERISTIC EGRVlv_RlsFuncCal.tiRlsMoveMin_C "Calibration class instance for jam healing / Minimum time for a release attempt" VALUE 0x8053B79D Val_Wu8 2550. Time_ms 0.00 2550. FORMAT "%5.0" /end CHARACTERISTIC
/begin CHARACTERISTIC EGRVlv_RlsFuncCal.tiDesValMoveBack_C "Calibration class instance for jam healing / Maximum time for a backward movement before a release attempt" VALUE 0x8053B79E Val_Wu8 2550. Time_ms 0.00 2550. FORMAT "%5.0" /end CHARACTERISTIC
/begin CHARACTERISTIC EGRVlv_RlsFuncCal.rDesValMoveBack_C "Calibration class instance for jam healing / Maximum backward movement before release movement" VALUE 0x8053B7A0 Val_Ws16 799.9878 Prc -400.0000 399.9878 FORMAT "%8.4" /end CHARACTERISTIC
/begin CHARACTERISTIC EGRVlv_RlsFuncCal.swtRlsTrigCdn_C "Calibration class instance for jam healing / Switch for release condition of jam healing function" VALUE 0x8053B7A2 Val_Wu8 255.0 OneToOne 0.00 255.0 FORMAT "%5.1" /end CHARACTERISTIC
/begin CHARACTERISTIC EGRVlv_RlsFuncCal.numRlsTryMax_C "Calibration class instance for jam healing / Maximum number of release attempts" VALUE 0x8053B7A3 Val_Wu8 255.0 OneToOne 0.00 255.0 FORMAT "%5.1" /end CHARACTERISTIC
/begin CHARACTERISTIC EGRVlv_RlsFuncCal.numRlsTryAbsMax_C "Calibration class instance for jam healing / Maximum total number of release attempts in a row" VALUE 0x8053B7A4 Val_Wu8 255.0 OneToOne 0.00 255.0 FORMAT "%5.1" /end CHARACTERISTIC
/begin CHARACTERISTIC EGRVlv_RlsFuncCal.numRlsTryAtmptMax_C "Calibration class instance for jam healing / Maximum total number of release attempts during actuator lifetime" VALUE 0x8053B7A8 Val_Wu32 4294967295.00 OneToOne 0.00 4294967295.00 FORMAT "%13.2" /end CHARACTERISTIC
/begin CHARACTERISTIC EGRVlv_RlsFuncCal.numRlsTryAbsDrvCycMax_C "Calibration class instance for jam healing / Maximum total number of release attempts in one driving cycle" VALUE 0x8053B7AC Val_Wu8 255.0 OneToOne 0.00 255.0 FORMAT "%5.1" /end CHARACTERISTIC
/begin CHARACTERISTIC EGRVlv_RlsFuncCal.numRlsAtmptVltgInctReqMax_C "Calibration class instance for jam healing / Maximum number of Voltage Increment Requests of Release attampts during actuator lifetime" VALUE 0x8053B7B0 Val_Wu32 4294967295.00 OneToOne 0.00 4294967295.00 FORMAT "%13.2" /end CHARACTERISTIC
/begin CHARACTERISTIC EGRVlv_RlsFuncCal.numRlsAbsltDcycVltgInctReqMax_C "Calibration class instance for jam healing / Maximum number of voltage increment requests of release attampts in one driving cycle" VALUE 0x8053B7B4 Val_Wu8 255.0 OneToOne 0.00 255.0 FORMAT "%5.1" /end CHARACTERISTIC
/begin CHARACTERISTIC EGRVlv_RlsFuncCal.swtConf_C "Calibration class instance for jam healing / Internal calibration switch for jam healing filter function" VALUE 0x8053B7B5 Val_Wu8 255.0 OneToOne 0.00 255.0 FORMAT "%5.1" /end CHARACTERISTIC
/begin CHARACTERISTIC EGRVlv_RlsFuncCal.ratGovrLimRelsWait_C "Calibration class instance for jam healing / DELib GLobal Service Jamming Heal Calculation" VALUE 0x8053B7B6 Val_Ws16 799.9878 Prc -400.0000 399.9878 FORMAT "%8.4" /end CHARACTERISTIC
/begin CHARACTERISTIC EGRVlv_rMaxMoveRels_CUR "Maximum allowable actuator movement to release the valve based on stuck actuator postition" CURVE 0x8058B044 RB_Curve_S16_S16 799.9878 Prc -400.0000 399.9878 FORMAT "%8.4"
 /begin AXIS_DESCR STD_AXIS EGRVlv_rActStuck Prc 25 -400.0000 399.9878 FORMAT "%8.4" DEPOSIT ABSOLUTE /end AXIS_DESCR
/end CHARACTERISTIC
/begin CHARACTERISTIC EGRVlv_rMulHystLeftThres_CA "Multi Hysteresis left hysteresis threshold" VAL_BLK 0x8053B844 ValA_Ws16 799.9878 Prc -400.0000 399.9878 FORMAT "%8.4" NUMBER 1 /end CHARACTERISTIC
/begin CHARACTERISTIC EGRVlv_rMulHystRightThres_CA "Multi Hysteresis right hysteresis threshold" VAL_BLK 0x8053B846 ValA_Ws16 799.9878 Prc -400.0000 399.9878 FORMAT "%8.4" NUMBER 1 /end CHARACTERISTIC
/begin CHARACTERISTIC EGRVlv_stPwrStgDiaDis_C "Bitmask to disable diagnosis" VALUE 0x8058B888 Val_Wu16 65535.00 OneToOne 0.00 65535.00 FORMAT "%8.2" /end CHARACTERISTIC
/begin CHARACTERISTIC EGRVlv_swtConf2_C "Second Main function switch" VALUE 0x8058B88C Val_Wu32 4294967295.00 OneToOne 0.00 4294967295.00 FORMAT "%13.2" /end CHARACTERISTIC
/begin CHARACTERISTIC EGRVlv_swtConf3_C "Third Main function switch" VALUE 0x8053B8B0 Val_Wu32 4294967295.00 OneToOne 0.00 4294967295.00 FORMAT "%13.2" /end CHARACTERISTIC
/begin CHARACTERISTIC EGRVlv_swtConfGrdtLimn_C "Set-point gradient limitation function switch" VALUE 0x8053B7C0 Val_Wu8 255.0 OneToOne 0.00 255.0 FORMAT "%5.1" /end CHARACTERISTIC
/begin CHARACTERISTIC EGRVlv_swtConfSpArbn_C "Set-point arbiter function switch" VALUE 0x8053B8B4 Val_Wu8 255.0 OneToOne 0.00 255.0 FORMAT "%5.1" /end CHARACTERISTIC
/begin CHARACTERISTIC EGRVlv_swtConfSpFil_C "Internal calibration switch for set point filter function" VALUE 0x8053B7BC Val_Wu8 255.0 OneToOne 0.00 255.0 FORMAT "%5.1" /end CHARACTERISTIC
/begin CHARACTERISTIC EGRVlv_swtConfSwVers167_C "Function switch to activate and deactivate 1.67 series branch features" VALUE 0x8058B890 Val_Wu32 4294967295.00 OneToOne 0.00 4294967295.00 FORMAT "%13.2" /end CHARACTERISTIC
/begin CHARACTERISTIC EGRVlv_swtConf_C "Main function switch" VALUE 0x8058B894 Val_Wu32 4294967295.00 OneToOne 0.00 4294967295.00 FORMAT "%13.2" /end CHARACTERISTIC
/begin CHARACTERISTIC EGRVlv_TempModelCal.coefHtTransfArmtrHsng_C "parameter structure for Actuator temperature model / Heat transfer co-efficient / thermal resistance between armature and housing" VALUE 0x8058C04C Val_Wu16 655.3500 WattTempCels_q0p01_COMPU 0.00 655.3500 FORMAT "%8.4" /end CHARACTERISTIC
/begin CHARACTERISTIC EGRVlv_TempModelCal.coefHtTransfEngHsng_C "parameter structure for Actuator temperature model / Heat transfer co-efficient / thermal resistance between engine and housing" VALUE 0x8058C04E Val_Wu16 655.3500 WattTempCels_q0p01_COMPU 0.00 655.3500 FORMAT "%8.4" /end CHARACTERISTIC
/begin CHARACTERISTIC EGRVlv_TempModelCal.coefHtTransfExhHsng_C "parameter structure for Actuator temperature model / Heat transfer co-efficient / thermal resistance between exhaust gas and housing" VALUE 0x8058C050 Val_Wu16 655.3500 WattTempCels_q0p01_COMPU 0.00 655.3500 FORMAT "%8.4" /end CHARACTERISTIC
/begin CHARACTERISTIC EGRVlv_TempModelCal.capHtHsng_C "parameter structure for Actuator temperature model / Inverse of heat capacity of housing" VALUE 0x8058C052 Val_Wu16 0.6553500 q0p00001_degC_DIV_W 0.00 0.6553500 FORMAT "%9.7" /end CHARACTERISTIC
/begin CHARACTERISTIC EGRVlv_TempModelCal.capHtArmtr_C "parameter structure for Actuator temperature model / Heat capacity of armature" VALUE 0x8058C054 Val_Wu16 0.6553500 q0p00001_degC_DIV_W 0.00 0.6553500 FORMAT "%9.7" /end CHARACTERISTIC
/begin CHARACTERISTIC EGRVlv_TempModelCal.tHsngMax_C "parameter structure for Actuator temperature model / Maximum housing temperature" VALUE 0x8058C056 Val_Ws16 6553.500 Temp_Cels -3549.940 3003.560 FORMAT "%8.3" /end CHARACTERISTIC
/begin CHARACTERISTIC EGRVlv_TempModelCal.tArmtrMax_C "parameter structure for Actuator temperature model / Maximum armature temperature" VALUE 0x8058C058 Val_Ws16 6553.500 Temp_Cels -3549.940 3003.560 FORMAT "%8.3" /end CHARACTERISTIC
/begin CHARACTERISTIC EGRVlv_TempModelCal.tDflArmtr_C "parameter structure for Actuator temperature model / Default actuator Armature temperature" VALUE 0x8058C05A Val_Ws16 6553.500 Temp_Cels -3549.940 3003.560 FORMAT "%8.3" /end CHARACTERISTIC
/begin CHARACTERISTIC EGRVlv_TempModelCal.tDflHsng_C "parameter structure for Actuator temperature model / Default actuator housing temperature" VALUE 0x8058C05C Val_Ws16 6553.500 Temp_Cels -3549.940 3003.560 FORMAT "%8.3" /end CHARACTERISTIC
/begin CHARACTERISTIC EGRVlv_TempModelCal.facEngCEngDsT_C "parameter structure for Actuator temperature model / Factor of the temperature difference between the engine and the coolant" VALUE 0x8058C05E Val_Ws16 7.999878 Fact -4.000000 3.999878 FORMAT "%8.6" /end CHARACTERISTIC
/begin CHARACTERISTIC EGRVlv_TempModelCal.tiTempModInit_C "parameter structure for Actuator temperature model / Time from engine start after which the temperature model is activated" VALUE 0x8058C060 Val_Ws16 655350.0 Time_ms -327680.0 327670.0 FORMAT "%8.1" /end CHARACTERISTIC
/begin CHARACTERISTIC EGRVlv_TempModelCal.tiEngTempGrad_C "parameter structure for Actuator temperature model / Minimum time difference for the calculation of the temperature gradient" VALUE 0x8058C064 Val_Ws32 42949672950.0 Time_ms -21474836480.0 21474836470.0 FORMAT "%13.1" /end CHARACTERISTIC
/begin CHARACTERISTIC EGRVlv_TempModelCal.numAirTempSelHsng_C "parameter structure for Actuator temperature model / Index for AirSys_tFld" VALUE 0x8058C068 Val_Wu16 255.000000000 DELIB_ALLTEMP_VERB_COMPU 0.00 255.000000000 FORMAT "%13.9" /end CHARACTERISTIC
/begin CHARACTERISTIC EGRVlv_TempModelCal.numEnvTempSelHsng_C "parameter structure for Actuator temperature model / Array index for the selection of the Environment temperature" VALUE 0x8058C06A Val_Wu16 255.000000000 DELIB_ALLTEMP_VERB_COMPU 0.00 255.000000000 FORMAT "%13.9" /end CHARACTERISTIC
/begin CHARACTERISTIC EGRVlv_TempModelCal.numEngTempSelHsng_C "parameter structure for Actuator temperature model / Label for selecting the desired engine temperature" VALUE 0x8058C06C Val_Wu16 255.000000000 DELIB_ALLTEMP_VERB_COMPU 0.00 255.000000000 FORMAT "%13.9" /end CHARACTERISTIC
/begin CHARACTERISTIC EGRVlv_TempModelCal.numExhTempSelHsng_C "parameter structure for Actuator temperature model / Label for selecting the desired exhaust temperature" VALUE 0x8058C06E Val_Wu16 255.000000000 DELIB_ALLTEMP_VERB_COMPU 0.00 255.000000000 FORMAT "%13.9" /end CHARACTERISTIC
/begin CHARACTERISTIC EGRVlv_TempModelCal.tDiffEngMin_C "parameter structure for Actuator temperature model / Minimum engine temperature change to decide the cooling effect" VALUE 0x8058C070 Val_Ws16 6553.500 Temp_Cels -3549.940 3003.560 FORMAT "%8.3" /end CHARACTERISTIC
/begin CHARACTERISTIC EGRVlv_TempModelCal.tDiffEngOffEnvMin_C "parameter structure for Actuator temperature model / Minimum temperature difference between engine and environment" VALUE 0x8058C072 Val_Ws16 6553.500 Temp_Cels -3549.940 3003.560 FORMAT "%8.3" /end CHARACTERISTIC
/begin CHARACTERISTIC EGRVlv_TempModelCal.numInitArmtrAir_C "parameter structure for Actuator temperature model / Label for selecting the desired air temperature for the initilization of actuator temperature" VALUE 0x8058C074 Val_Wu16 255.000000000 DELIB_ALLTEMP_VERB_COMPU 0.00 255.000000000 FORMAT "%13.9" /end CHARACTERISTIC
/begin CHARACTERISTIC EGRVlv_TempModelCal.numInitArmtrEng_C "parameter structure for Actuator temperature model / Label for selecting the desired engine temperature for the initilization of actuator temperature" VALUE 0x8058C076 Val_Wu16 255.000000000 DELIB_ALLTEMP_VERB_COMPU 0.00 255.000000000 FORMAT "%13.9" /end CHARACTERISTIC
/begin CHARACTERISTIC EGRVlv_TempModelCal.tArmtrThresHi_C "parameter structure for Actuator temperature model / Maximum Armature temperature threshold" VALUE 0x8058C078 Val_Ws16 6553.500 Temp_Cels -3549.940 3003.560 FORMAT "%8.3" /end CHARACTERISTIC
/begin CHARACTERISTIC EGRVlv_TempModelCal.tArmtrThresLo_C "parameter structure for Actuator temperature model / Minimum Armature temperature threshold" VALUE 0x8058C07A Val_Ws16 6553.500 Temp_Cels -3549.940 3003.560 FORMAT "%8.3" /end CHARACTERISTIC
/begin CHARACTERISTIC EGRVlv_tEngCld_CUR "Maximum temperature from DELib_idxArrSnsr[EGRVlv_CldStrtCal.numEngDaTempDesVal_C] to start setpint ramp after cold start detection" CURVE 0x8058C07C RB_Curve_S16_S16 6553.500 Temp_Cels -3549.940 3003.560 FORMAT "%8.3"
 /begin AXIS_DESCR STD_AXIS EnvT_t Temp_Cels 25 -3549.940 3003.560 FORMAT "%8.3" DEPOSIT ABSOLUTE /end AXIS_DESCR
/end CHARACTERISTIC
/begin CHARACTERISTIC EGRVlv_tiInpFlt_CUR "Input filter time constant" CURVE 0x8053B848 Cur_Xs16Ws16 6.553500 Time_s_100us -3.276800 3.276700 FORMAT "%8.6"
 /begin AXIS_DESCR STD_AXIS EGRVlv_r Prc 25 -400.0000 399.9878 FORMAT "%8.4" DEPOSIT ABSOLUTE /end AXIS_DESCR
/end CHARACTERISTIC
/begin CHARACTERISTIC EGRVlv_tiRawFltSnsrRead_MAP "Map to calibrate Time constant for PT1 filter that filters raw voltage value of position sensor" MAP 0x8059075A RB_Map_S16S16_S16 6.553500 q1Em4_s -3.276800 3.276700 FORMAT "%8.6"
 /begin AXIS_DESCR STD_AXIS EGRVlv_rGovDvtAbs Prc 25 -400.0000 399.9878 FORMAT "%8.4" DEPOSIT ABSOLUTE /end AXIS_DESCR
 /begin AXIS_DESCR STD_AXIS PCR_pDesVal Pres_hPa 25 -32768.00 32767.00 FORMAT "%8.2" DEPOSIT ABSOLUTE /end AXIS_DESCR
/end CHARACTERISTIC
/begin MEASUREMENT EGRVlv_ActrJamHealMp.stVltgInctReqInhbMp "Mesurement class instance for jam healing / e_:Status of Voltage Increment Request Inhibition:_e;d_:Status der Sperrung der Spannungsinkrementanforderung:_d" UBYTE OneToOne 1 100 0.00 255.0 FORMAT "%5.1" ECU_ADDRESS 0x70003082 /end MEASUREMENT
/begin MEASUREMENT EGRVlv_ActrJamHealMp.numJamHealMp "Mesurement class instance for jam healing / e_:Jam heal attempts counter:_e;d_:Zähler der Blockierungsheilversuche:_d" UBYTE OneToOne 1 100 0.00 255.0 FORMAT "%5.1" ECU_ADDRESS 0x70003083 /end MEASUREMENT
/begin MEASUREMENT EGRVlv_ActrJamHealMp.numJamHealAbsMp "Mesurement class instance for jam healing / e_:Total number of jam heal attempts:_e;d_:Gesamtanzahl der gestarteten Blockierungsheilversuche:_d" UBYTE OneToOne 1 100 0.00 255.0 FORMAT "%5.1" ECU_ADDRESS 0x70003084 /end MEASUREMENT
/begin MEASUREMENT EGRVlv_ActrSpFilMp.rDesValDeMp "Mesurement class instance for set point filter / e_:Deviation from the desired value:_e;d_:Reglerabweichung bezüglichn des Sollwertes:_d" SWORD Prc 1 100 -400.0000 399.9878 FORMAT "%8.4" ECU_ADDRESS 0x70003078 /end MEASUREMENT
/begin MEASUREMENT EGRVlv_ActrSpFilMp.tiDesValFilMp "Mesurement class instance for set point filter / e_:Time constant for the PT1 filter for the slow response simulator function:_e;d_:Zeitkonstante für den PT1 Filter für Simulationsfunktion der langsamen Reaktion:_d" SLONG TimeDelay_s 1 100 0.0000020000000 4294.9672959999998 FORMAT "%19.14" ECU_ADDRESS 0x7000307C /end MEASUREMENT
/begin MEASUREMENT EGRVlv_ActrSpGrdtLimnMp.rSlpPosMp "Mesurement class instance for gradient limitation / e_:Current maximum allowed positive slope of the gradient limitation:_e;d_:Aktulle maximal erlaubte positive Steigung der Gradientenlimitierung:_d" SLONG PrcSec 1 100 -26214400.0000 26214399.9878 FORMAT "%13.4" ECU_ADDRESS 0x70003068 /end MEASUREMENT
/begin MEASUREMENT EGRVlv_ActrSpGrdtLimnMp.rSlpNegMp "Mesurement class instance for gradient limitation / e_:Current maximum allowed negative slope of the gradient limitation:_e;d_:Aktulle maximal erlaubte negative Steigung der Gradientenlimitierung:_d" SLONG PrcSec 1 100 -26214400.0000 26214399.9878 FORMAT "%13.4" ECU_ADDRESS 0x7000306C /end MEASUREMENT
/begin MEASUREMENT EGRVlv_ActrSpGrdtLimnMp.stGrdtLimnEnvRlsMp "Mesurement class instance for gradient limitation / e_:Current state of environmental conditions:_e;d_:Aktueller Status der Umweltbedingungen:_d" UWORD OneToOne 1 100 0.00 65535.00 FORMAT "%8.2" ECU_ADDRESS 0x70003070 /end MEASUREMENT
/begin MEASUREMENT EGRVlv_ActrSpGrdtLimnMp.rDesValLimMp "Mesurement class instance for gradient limitation / e_:Current limited desired value:_e;d_:Aktueller limitierter Sollwert:_d" SWORD Prc 1 100 -400.0000 399.9878 FORMAT "%8.4" ECU_ADDRESS 0x70003072 /end MEASUREMENT
/begin MEASUREMENT EGRVlv_bIninSpFil "Trigger to reinitialize the set-point filter" UBYTE OneToOne 1 100 0.00 255.0 BIT_MASK 0x1 FORMAT "%5.1" ECU_ADDRESS 0x70003625 /end MEASUREMENT
/begin MEASUREMENT EGRVlv_cntActrDst_mp "Distance counter" UBYTE OneToOne 1 100 0.00 255.0 FORMAT "%5.1" ECU_ADDRESS 0x70009FBC /end MEASUREMENT
/begin MEASUREMENT EGRVlv_ctActrJamHealDSMClr "Function specific variable for dsm clear counter" UBYTE OneToOne 1 100 0.00 255.0 FORMAT "%5.1" ECU_ADDRESS 0x6000F45E /end MEASUREMENT
/begin MEASUREMENT EGRVlv_ctActrJamHealDSMClrOld "Function specific variable for dsm clear counter old" UBYTE OneToOne 1 100 0.00 255.0 FORMAT "%5.1" ECU_ADDRESS 0x6000B219 /end MEASUREMENT
/begin MEASUREMENT EGRVlv_ctActrJamHealReIni "Function specific variable for global drive cycle counter" UBYTE OneToOne 1 100 0.00 255.0 FORMAT "%5.1" ECU_ADDRESS 0x7000371B /end MEASUREMENT
/begin MEASUREMENT EGRVlv_ctrActrDst "Actuator distance counter (EEPROM)" UBYTE OneToOne 1 100 0.00 255.0 FORMAT "%5.1" ECU_ADDRESS 0x60000954 /end MEASUREMENT
/begin MEASUREMENT EGRVlv_ctrActrDstAVS "" UBYTE OneToOne 1 100 0.00 255.0 FORMAT "%5.1" ECU_ADDRESS 0x60000955 /end MEASUREMENT
/begin MEASUREMENT EGRVlv_dHtAirSys_mp "Heat exchanged between armature housing and fresh air" SLONG Pwr_q0p01_COMPU 1 100 -21474836.4800 21474836.4700 FORMAT "%13.4" ECU_ADDRESS 0x70009BEC /end MEASUREMENT
/begin MEASUREMENT EGRVlv_dHtArmtrHsng "Rate at which heat is generated in the armature" SWORD Pwr_q0p01_COMPU 1 100 -327.6800 327.6700 FORMAT "%8.4" ECU_ADDRESS 0x600095B4 /end MEASUREMENT
/begin MEASUREMENT EGRVlv_dHtCEngFan_mp "Heat exchanged between armature housing and coolant" SLONG Pwr_q0p01_COMPU 1 100 -21474836.4800 21474836.4700 FORMAT "%13.4" ECU_ADDRESS 0x70009BE8 /end MEASUREMENT
/begin MEASUREMENT EGRVlv_dHtEngDaFld_mp "Heat exchanged between armature housing and engine" SLONG Pwr_q0p01_COMPU 1 100 -21474836.4800 21474836.4700 FORMAT "%13.4" ECU_ADDRESS 0x70009BE4 /end MEASUREMENT
/begin MEASUREMENT EGRVlv_dHtEnvSys_mp "Heat exchanged between housing and environment" SLONG Pwr_q0p01_COMPU 1 100 -21474836.4800 21474836.4700 FORMAT "%13.4" ECU_ADDRESS 0x70009BE0 /end MEASUREMENT
/begin MEASUREMENT EGRVlv_dHtExhFld_mp "Heat exchanged between armature housing and exhaust" SLONG Pwr_q0p01_COMPU 1 100 -21474836.4800 21474836.4700 FORMAT "%13.4" ECU_ADDRESS 0x70009BDC /end MEASUREMENT
/begin MEASUREMENT EGRVlv_dHtHsngEnv_mp "Heat exchanged between armature housing and environment" SLONG Pwr_q0p01_COMPU 1 100 -21474836.4800 21474836.4700 FORMAT "%13.4" ECU_ADDRESS 0x70009BD8 /end MEASUREMENT
/begin MEASUREMENT EGRVlv_dHtHsng_mp "Heat exchanged between armature housing and coolant" SLONG Pwr_q0p01_COMPU 1 100 -21474836.4800 21474836.4700 FORMAT "%13.4" ECU_ADDRESS 0x70009BD4 /end MEASUREMENT
/begin MEASUREMENT EGRVlv_duRaw "Actuator speed" SWORD q10_mV_DIV_s 1 100 -327680.0 327670.0 FORMAT "%8.1" ECU_ADDRESS 0x600095AA /end MEASUREMENT
/begin MEASUREMENT EGRVlv_duRawUnFild "Derivation of raw voltage value of position sensor unfiltered" SWORD q10_mV_DIV_s 1 100 -327680.0 327670.0 FORMAT "%8.1" ECU_ADDRESS 0x600095A8 /end MEASUREMENT
/begin MEASUREMENT EGRVlv_facClgEngEnvCrvIn_mp "Input to curve EGRVlv_facClgEngEnvCrvIn_CUR" SWORD Fact 1 100 -4.000000 3.999878 FORMAT "%8.6" ECU_ADDRESS 0x70009D54 /end MEASUREMENT
/begin MEASUREMENT EGRVlv_flgActrSwtOffReq "Powerstage shutoff request from actuator driver" UBYTE OneToOne 1 100 0.00 255.0 FORMAT "%5.1" ECU_ADDRESS 0x6000F45C /end MEASUREMENT
/begin MEASUREMENT EGRVlv_flgDiagStrtClnVrfy "Status of clean and verify activation requests" UBYTE OneToOne 1 100 0.00 255.0 BIT_MASK 0x1 FORMAT "%5.1" ECU_ADDRESS 0x6000F7C7 /end MEASUREMENT
/begin MEASUREMENT EGRVlv_flgElecDiagSwtOffReq "Shutoff power stage when there is a power stage failure" UBYTE OneToOne 1 100 0.00 255.0 FORMAT "%5.1" ECU_ADDRESS 0x6000F45B /end MEASUREMENT
/begin MEASUREMENT EGRVlv_flgMonXPostDrv_mp "Measurement point which is set, when DELib prolongs the afterrun" UBYTE OneToOne 1 100 0.00 255.0 FORMAT "%5.1" ECU_ADDRESS 0x70009FBE /end MEASUREMENT
/begin MEASUREMENT EGRVlv_flgPwrStgReq "power stage required by DElib for controlling" UBYTE OneToOne 1 100 0.00 1.000 FORMAT "%5.3" ECU_ADDRESS 0x6000F45A /end MEASUREMENT
/begin MEASUREMENT EGRVlv_nrDesValCnt "counter value of the desired counter value" ULONG OneToOne 1 100 0.00 4294967295.00 FORMAT "%13.2" ECU_ADDRESS 0x60003A80 /end MEASUREMENT
/begin MEASUREMENT EGRVlv_nrDesValCntAVS "" ULONG OneToOne 1 100 0.00 4294967295.00 FORMAT "%13.2" ECU_ADDRESS 0x600004B8 /end MEASUREMENT
/begin MEASUREMENT EGRVlv_numClnVerify "Number of clean and verify cycles" UBYTE OneToOne 1 100 0.00 255.0 FORMAT "%5.1" ECU_ADDRESS 0x6000F863 /end MEASUREMENT
/begin MEASUREMENT EGRVlv_numClnVerifyAbrt "Number of aborted clean and verify cycles" UBYTE OneToOne 1 100 0.00 255.0 FORMAT "%5.1" ECU_ADDRESS 0x6000F862 /end MEASUREMENT
/begin MEASUREMENT EGRVlv_numJamHealAtmpt "Total number of jam healing attempts (EEPROM)" ULONG OneToOne 1 100 0.00 4294967295.00 FORMAT "%13.2" ECU_ADDRESS 0x70003E44 /end MEASUREMENT
/begin MEASUREMENT EGRVlv_numJamHealAtmptAVS "" ULONG OneToOne 1 100 0.00 4294967295.00 FORMAT "%13.2" ECU_ADDRESS 0x70003E40 /end MEASUREMENT
/begin MEASUREMENT EGRVlv_numReaMechBndAVS "" ULONG OneToOne 1 100 0.00 4294967295.00 FORMAT "%13.2" ECU_ADDRESS 0x600004BC /end MEASUREMENT
/begin MEASUREMENT EGRVlv_numSigID "Signal ID for power stage diagnosis" UWORD OneToOne 1 100 0.00 65535.00 FORMAT "%8.2" ECU_ADDRESS 0x6000734E /end MEASUREMENT
/begin MEASUREMENT EGRVlv_numSigID_mp "Signal ID for power stage diagnosis" UBYTE OneToOne 1 100 0.00 255.0 FORMAT "%5.1" ECU_ADDRESS 0x70009FBB /end MEASUREMENT
/begin MEASUREMENT EGRVlv_PidGovr.tActrfacTqLossCmpCurInp "PID Governor Class / Actuator temperature" SWORD Temp_Cels 1 100 -3549.940 3003.560 FORMAT "%8.3" ECU_ADDRESS 0x60000326 /end MEASUREMENT
/begin MEASUREMENT EGRVlv_PidGovr.uRawrActrLim2CurInp "PID Governor Class / Raw voltage value of position sensor" SWORD Volt 1 100 -6553.600 6553.400 FORMAT "%8.3" ECU_ADDRESS 0x60000328 /end MEASUREMENT
/begin MEASUREMENT EGRVlv_r "Commanded value from application SW" SWORD Prc 1 100 -400.0000 399.9878 FORMAT "%8.4" ECU_ADDRESS 0x600095A0 /end MEASUREMENT
/begin MEASUREMENT EGRVlv_rActNrm "commanded value of actuator position" UBYTE Prc_q0p392157_COMPU 1 100 0.00 100.0 FORMAT "%5.1" ECU_ADDRESS 0x6000F861 /end MEASUREMENT
/begin MEASUREMENT EGRVlv_rActr "" SWORD Prc 1 100 -400.0000 399.9878 FORMAT "%8.4" ECU_ADDRESS 0x60009596 /end MEASUREMENT
/begin MEASUREMENT EGRVlv_rActrLim "Torque limitation value based on actuator position" SWORD Prc 1 100 -400.0000 399.9878 FORMAT "%8.4" ECU_ADDRESS 0x60009594 /end MEASUREMENT
/begin MEASUREMENT EGRVlv_rActSprgDiff_mp "Way of valve during spring break test" SWORD Prc 1 100 -400.0000 399.9878 FORMAT "%8.4" ECU_ADDRESS 0x70009D5E /end MEASUREMENT
/begin MEASUREMENT EGRVlv_rActStuck "Actuator stuck position" SWORD Prc 1 100 -400.0000 399.9878 FORMAT "%8.4" ECU_ADDRESS 0x6000959C /end MEASUREMENT
/begin MEASUREMENT EGRVlv_rActTst "Actuatorposition for tester" SWORD Prc 1 100 -400.0000 399.9878 FORMAT "%8.4" ECU_ADDRESS 0x60009598 /end MEASUREMENT
/begin MEASUREMENT EGRVlv_rArbnDesVal "Desired value of set-point arbiter" SWORD Prc 1 100 -400.0000 399.9878 FORMAT "%8.4" ECU_ADDRESS 0x70003BFC /end MEASUREMENT
/begin MEASUREMENT EGRVlv_ratActPosnB1 "Autosar named Actuatorposition" SWORD rel_q0p0078125 1 100 -256.0000 255.9922 FORMAT "%8.4" ECU_ADDRESS 0x60013E78 /end MEASUREMENT
/begin MEASUREMENT EGRVlv_rCldStrtRmpMp "Position set point of the cold start ramp" SWORD Prc 1 100 -400.0000 399.9878 FORMAT "%8.4" ECU_ADDRESS 0x70003066 /end MEASUREMENT
/begin MEASUREMENT EGRVlv_rCmdNrm "Normalized desired value" UBYTE Prc_q0p392157_COMPU 1 100 0.00 100.0 FORMAT "%5.1" ECU_ADDRESS 0x6000F85F /end MEASUREMENT
/begin MEASUREMENT EGRVlv_rCnv_mp "Measurement point for output of the curve for single flow implementation." SWORD DtyCyc 1 100 -327.6800 327.6700 FORMAT "%8.4" ECU_ADDRESS 0x70009D4E /end MEASUREMENT
/begin MEASUREMENT EGRVlv_rCoilComp "Duty cycle for electrical compensation of coil." SWORD Prc 1 100 -400.0000 399.9878 FORMAT "%8.4" ECU_ADDRESS 0x60009592 /end MEASUREMENT
/begin MEASUREMENT EGRVlv_rDesActr_mp "desired value" SWORD Prc 1 100 -400.0000 399.9878 FORMAT "%8.4" ECU_ADDRESS 0x70009D5C /end MEASUREMENT
/begin MEASUREMENT EGRVlv_rDesVal "" SWORD Prc 1 100 -400.0000 399.9878 FORMAT "%8.4" ECU_ADDRESS 0x6000958E /end MEASUREMENT
/begin MEASUREMENT EGRVlv_rDesValATS_mp "desired value from ATS" SWORD Prc 1 100 -400.0000 399.9878 FORMAT "%8.4" ECU_ADDRESS 0x70009D5A /end MEASUREMENT
/begin MEASUREMENT EGRVlv_rDesValMax "Maximum desired position" SWORD Prc 1 100 -400.0000 399.9878 FORMAT "%8.4" ECU_ADDRESS 0x6000958C /end MEASUREMENT
/begin MEASUREMENT EGRVlv_rDesValMin "Minimum desired position" SWORD Prc 1 100 -400.0000 399.9878 FORMAT "%8.4" ECU_ADDRESS 0x6000958A /end MEASUREMENT
/begin MEASUREMENT EGRVlv_rDesValSty_mp "Replacement value for commanded position in steady state" SWORD Prc 1 100 -400.0000 399.9878 FORMAT "%8.4" ECU_ADDRESS 0x70009D58 /end MEASUREMENT
/begin MEASUREMENT EGRVlv_rDesVal_mp "desired value after linearization" SWORD Prc 1 100 -400.0000 399.9878 FORMAT "%8.4" ECU_ADDRESS 0x70009D56 /end MEASUREMENT
/begin MEASUREMENT EGRVlv_rFildSpFil "Filtered desired value of the set-point filter" SWORD Prc 1 100 -400.0000 399.9878 FORMAT "%8.4" ECU_ADDRESS 0x70003BF2 /end MEASUREMENT
/begin MEASUREMENT EGRVlv_rFrc "Duty cycle for friction compensation" SWORD Prc 1 100 -400.0000 399.9878 FORMAT "%8.4" ECU_ADDRESS 0x60009582 /end MEASUREMENT
/begin MEASUREMENT EGRVlv_rGovActr "Governor output" SWORD Prc 1 100 -400.0000 399.9878 FORMAT "%8.4" ECU_ADDRESS 0x6000957E /end MEASUREMENT
/begin MEASUREMENT EGRVlv_rGovDvt "" SWORD Prc 1 100 -400.0000 399.9878 FORMAT "%8.4" ECU_ADDRESS 0x60009574 /end MEASUREMENT
/begin MEASUREMENT EGRVlv_rGovDvtAbs "control deviation for PT1 Filter" SWORD Prc 1 100 -400.0000 399.9878 FORMAT "%8.4" ECU_ADDRESS 0x60009572 /end MEASUREMENT
/begin MEASUREMENT EGRVlv_rGovDvtNrm "commanded value of actuator governor deviation" UBYTE rel_q0p78_o100 1 100 -100.0 99.2 FORMAT "%5.1" ECU_ADDRESS 0x6000F85E /end MEASUREMENT
/begin MEASUREMENT EGRVlv_rGovMax "Maximum governor output limit" SWORD Prc 1 100 -400.0000 399.9878 FORMAT "%8.4" ECU_ADDRESS 0x6000956E /end MEASUREMENT
/begin MEASUREMENT EGRVlv_rGovMaxTemp "Armature temperature dependent maximum governor output" SWORD Prc 1 100 -400.0000 399.9878 FORMAT "%8.4" ECU_ADDRESS 0x6000956C /end MEASUREMENT
/begin MEASUREMENT EGRVlv_rGovMin "Minimum governor output limit" SWORD Prc 1 100 -400.0000 399.9878 FORMAT "%8.4" ECU_ADDRESS 0x6000956A /end MEASUREMENT
/begin MEASUREMENT EGRVlv_rGovMinTemp "Armature temperature dependent minimum governor output" SWORD Prc 1 100 -400.0000 399.9878 FORMAT "%8.4" ECU_ADDRESS 0x60009568 /end MEASUREMENT
/begin MEASUREMENT EGRVlv_rGovrActrHeal "Jam healing actuator ratio" SWORD Prc 1 100 -400.0000 399.9878 FORMAT "%8.4" ECU_ADDRESS 0x70003BF0 /end MEASUREMENT
/begin MEASUREMENT EGRVlv_rGrdtLimn "Desired value for set-point gradient limitaion" SWORD Prc 1 100 -400.0000 399.9878 FORMAT "%8.4" ECU_ADDRESS 0x70003BEE /end MEASUREMENT
/begin MEASUREMENT EGRVlv_rIninSpFil "Initialisation value for the set-point filter" SWORD Prc 1 100 -400.0000 399.9878 FORMAT "%8.4" ECU_ADDRESS 0x70003BEC /end MEASUREMENT
/begin MEASUREMENT EGRVlv_rInpFlt "Filtered input value" SWORD Prc 1 100 -400.0000 399.9878 FORMAT "%8.4" ECU_ADDRESS 0x600091EA /end MEASUREMENT
/begin MEASUREMENT EGRVlv_rJamHeal "Position set point for the jam healing function" SWORD Prc 1 100 -400.0000 399.9878 FORMAT "%8.4" ECU_ADDRESS 0x70003BEA /end MEASUREMENT
/begin MEASUREMENT EGRVlv_rNrm "Normalized actuator position" SWORD Prc 1 100 -400.0000 399.9878 FORMAT "%8.4" ECU_ADDRESS 0x60009560 /end MEASUREMENT
/begin MEASUREMENT EGRVlv_rOutD "Message for D governor for single flow implementation." SWORD Prc 1 100 -400.0000 399.9878 FORMAT "%8.4" ECU_ADDRESS 0x6000955E /end MEASUREMENT
/begin MEASUREMENT EGRVlv_rOutDRaw "Raw value of DT1 controller" SWORD Prc 1 100 -400.0000 399.9878 FORMAT "%8.4" ECU_ADDRESS 0x6000955C /end MEASUREMENT
/begin MEASUREMENT EGRVlv_rOutGrdtLimn "Desired value of set-point gradient limitaion" SWORD Prc 1 100 -400.0000 399.9878 FORMAT "%8.4" ECU_ADDRESS 0x70003BE8 /end MEASUREMENT
/begin MEASUREMENT EGRVlv_rOutI "Message for I governor for single flow implementation." SWORD Prc 1 100 -400.0000 399.9878 FORMAT "%8.4" ECU_ADDRESS 0x6000955A /end MEASUREMENT
/begin MEASUREMENT EGRVlv_rOutJamHeal "Position set point of the jam the healing function" SWORD Prc 1 100 -400.0000 399.9878 FORMAT "%8.4" ECU_ADDRESS 0x70003BE6 /end MEASUREMENT
/begin MEASUREMENT EGRVlv_rOutP "message for P governor for single flow implementation." SWORD Prc 1 100 -400.0000 399.9878 FORMAT "%8.4" ECU_ADDRESS 0x60009558 /end MEASUREMENT
/begin MEASUREMENT EGRVlv_rPs "Duty cycle to power stage" SWORD DtyCyc 1 100 -327.6800 327.6700 FORMAT "%8.4" ECU_ADDRESS 0x60009554 /end MEASUREMENT
/begin MEASUREMENT EGRVlv_rSpFil "Desired value for the set-point filter" SWORD Prc 1 100 -400.0000 399.9878 FORMAT "%8.4" ECU_ADDRESS 0x70003BE2 /end MEASUREMENT
/begin MEASUREMENT EGRVlv_rUnCmpdGovActr "Uncompensated governor value" SWORD Prc 1 100 -400.0000 399.9878 FORMAT "%8.4" ECU_ADDRESS 0x70003BE0 /end MEASUREMENT
/begin MEASUREMENT EGRVlv_SigTyp "Signal Type for power stage diagnosis" UBYTE OneToOne 1 100 0.00 255.0 FORMAT "%5.1" ECU_ADDRESS 0x6000B218 /end MEASUREMENT
/begin MEASUREMENT EGRVlv_stActrAvl "Status of actuator availability" UBYTE B_TRUE 1 100 0.00 1.00000000000 BIT_MASK 0x1 FORMAT "%13.11" ECU_ADDRESS 0x6000F146 /end MEASUREMENT
/begin MEASUREMENT EGRVlv_stActrCtrl "Status of actuator open loop/closed loop for OBD" UBYTE OneToOne 1 100 0.00 255.0 FORMAT "%5.1" ECU_ADDRESS 0x6000F85D /end MEASUREMENT
/begin MEASUREMENT EGRVlv_stActrDdReadCalc "Status flag for actual actuator position calculated" UBYTE OneToOne 1 100 0.00 255.0 BIT_MASK 0x1 FORMAT "%5.1" ECU_ADDRESS 0x6000F7C6 /end MEASUREMENT
/begin MEASUREMENT EGRVlv_stActrDiagDis "Actuator request for disable of Dianosis" UBYTE OneToOne 1 100 0.00 255.0 FORMAT "%5.1" ECU_ADDRESS 0x6000F85C /end MEASUREMENT
/begin MEASUREMENT EGRVlv_stActrROMAVS "Permanently stored actuator status for AVS SET intervention" UBYTE OneToOne 1 100 0.00 255.0 FORMAT "%5.1" ECU_ADDRESS 0x60000959 /end MEASUREMENT
/begin MEASUREMENT EGRVlv_stActvn "Status of activation conditions" UBYTE OneToOne 1 100 0.00 255.0 FORMAT "%5.1" ECU_ADDRESS 0x70003717 /end MEASUREMENT
/begin MEASUREMENT EGRVlv_stAVSRxRom "" UBYTE OneToOne 1 100 0.00 255.0 FORMAT "%5.1" ECU_ADDRESS 0x60000958 /end MEASUREMENT
/begin MEASUREMENT EGRVlv_stClnVerifyReq "Status of clean and verify activation requests" UWORD OneToOne 1 100 0.00 65535.00 FORMAT "%8.2" ECU_ADDRESS 0x600094D4 /end MEASUREMENT
/begin MEASUREMENT EGRVlv_stClnVrfyPreDrvTrig "Status of clean and verify trigger in PreDrive for offset learning" UBYTE OneToOne 1 100 0.00 255.0 FORMAT "%5.1" ECU_ADDRESS 0x60039147 /end MEASUREMENT
/begin MEASUREMENT EGRVlv_stClnVrfyRlsCnd "Status of clean and verify release conditions" UWORD OneToOne 1 100 0.00 65535.00 FORMAT "%8.2" ECU_ADDRESS 0x600094D2 /end MEASUREMENT
/begin MEASUREMENT EGRVlv_stClnVrfyRlsCndTst "Status of clean and verify release conditions for tester trigger" UWORD OneToOne 1 100 0.00 65535.00 FORMAT "%8.2" ECU_ADDRESS 0x600094D0 /end MEASUREMENT
/begin MEASUREMENT EGRVlv_stCtrl "Status of actuator open loop/closed loop" UBYTE OneToOne 1 100 0.00 255.0 FORMAT "%5.1" ECU_ADDRESS 0x6000F85A /end MEASUREMENT
/begin MEASUREMENT EGRVlv_stDeactvn "Status of deactivation conditions" UBYTE OneToOne 1 100 0.00 255.0 FORMAT "%5.1" ECU_ADDRESS 0x70003716 /end MEASUREMENT
/begin MEASUREMENT EGRVlv_stDFCSprgBrk "Status of the tested flag and fault of the DFC_SprgBrk during DSM Reini" UBYTE OneToOne 1 100 0.00 255.0 FORMAT "%5.1" ECU_ADDRESS 0x6000F859 /end MEASUREMENT
/begin MEASUREMENT EGRVlv_stEepWr "Status of Eep Write Process" UBYTE OneToOne 1 100 0.00 255.0 FORMAT "%5.1" ECU_ADDRESS 0x6000F858 /end MEASUREMENT
/begin MEASUREMENT EGRVlv_stElecDiag "Internal States of Monitoring driver" UBYTE OneToOne 1 100 0.00 255.0 FORMAT "%5.1" ECU_ADDRESS 0x6000F857 /end MEASUREMENT
/begin MEASUREMENT EGRVlv_stErrInfo "Powerstage raw Error Information" ULONG OneToOne 1 100 0.00 4294967295.00 FORMAT "%13.2" ECU_ADDRESS 0x60003A78 /end MEASUREMENT
/begin MEASUREMENT EGRVlv_stGovDeMon "Status of governor deviation monitoring" UBYTE B_TRUE 1 100 0.00 1.00000000000 BIT_MASK 0x1 FORMAT "%13.11" ECU_ADDRESS 0x70003623 /end MEASUREMENT
/begin MEASUREMENT EGRVlv_stGrdtLimnIninTrig "Set-point gradient limitaion initialization trigger" UBYTE OneToOne 1 100 0.00 255.0 BIT_MASK 0x1 FORMAT "%5.1" ECU_ADDRESS 0x70003621 /end MEASUREMENT
/begin MEASUREMENT EGRVlv_stJamHealTrigCdn "Status of the jam healing function start conditions" UBYTE OneToOne 1 100 0.00 255.0 FORMAT "%5.1" ECU_ADDRESS 0x70003087 /end MEASUREMENT
/begin MEASUREMENT EGRVlv_stLimIniI "Status of I part Limitation and initilization requests" UWORD OneToOne 1 100 0.00 65535.00 FORMAT "%8.2" ECU_ADDRESS 0x600094CC /end MEASUREMENT
/begin MEASUREMENT EGRVlv_stLimIniI_mp "measurement point for Status of I part Limitation and initilization requests" UWORD OneToOne 1 100 0.00 65535.00 FORMAT "%8.2" ECU_ADDRESS 0x70009D4C /end MEASUREMENT
/begin MEASUREMENT EGRVlv_stMon "status of system monitoring" ULONG OneToOne 1 100 0.00 4294967295.00 FORMAT "%13.2" ECU_ADDRESS 0x50004E6C /end MEASUREMENT
/begin MEASUREMENT EGRVlv_stMon3 "status of system monitoring" ULONG OneToOne 1 100 0.00 4294967295.00 FORMAT "%13.2" ECU_ADDRESS 0x50004E74 /end MEASUREMENT
/begin MEASUREMENT EGRVlv_stMonActrPwrStgDrvr "status of system monitoring" ULONG OneToOne 1 100 0.00 2147483647.00 FORMAT "%13.2" ECU_ADDRESS 0x600038C4 /end MEASUREMENT
/begin MEASUREMENT EGRVlv_stMonElecDiag "Status bits of Monitoring process" ULONG OneToOne 1 100 0.00 4294967295.00 FORMAT "%13.2" ECU_ADDRESS 0x50004E78 /end MEASUREMENT
/begin MEASUREMENT EGRVlv_stMonGlbElecdd "Internal status of system monitoring" ULONG OneToOne 1 100 0.00 2147483647.00 FORMAT "%13.2" ECU_ADDRESS 0x600038C0 /end MEASUREMENT
/begin MEASUREMENT EGRVlv_stMonGovr "status of system monitoring" ULONG OneToOne 1 100 0.00 4294967295.00 FORMAT "%13.2" ECU_ADDRESS 0x60003A74 /end MEASUREMENT
/begin MEASUREMENT EGRVlv_stMonGrdtLimn "Status of set-point gradient limitation" UBYTE OneToOne 1 100 0.00 255.0 FORMAT "%5.1" ECU_ADDRESS 0x70003075 /end MEASUREMENT
/begin MEASUREMENT EGRVlv_stMonJamHeal "Status message jam healing" UBYTE OneToOne 1 100 0.00 255.0 FORMAT "%5.1" ECU_ADDRESS 0x70003711 /end MEASUREMENT
/begin MEASUREMENT EGRVlv_stMonSpArbn "Status of set-point arbiter" UBYTE OneToOne 1 100 0.00 255.0 FORMAT "%5.1" ECU_ADDRESS 0x70003710 /end MEASUREMENT
/begin MEASUREMENT EGRVlv_stMonTstr "State of environmental condition for monitoring" ULONG OneToOne 1 100 0.00 4294967295.00 FORMAT "%13.2" ECU_ADDRESS 0x60003A70 /end MEASUREMENT
/begin MEASUREMENT EGRVlv_stPs "" UBYTE OneToOne 1 100 0.00 255.0 FORMAT "%5.1" ECU_ADDRESS 0x6000F855 /end MEASUREMENT
/begin MEASUREMENT EGRVlv_stPwrStgDrvr "Internal States of Powerstage driver" UBYTE OneToOne 1 100 0.00 255.0 FORMAT "%5.1" ECU_ADDRESS 0x6000F458 /end MEASUREMENT
/begin MEASUREMENT EGRVlv_stPwrStgQual "Current status of Hbridge quality" UBYTE OneToOne 1 100 0.00 255.0 FORMAT "%5.1" ECU_ADDRESS 0x6000F854 /end MEASUREMENT
/begin MEASUREMENT EGRVlv_stSyCWaitXPreDrv_mp "Status of PreDrive extension for clean and verify" UBYTE OneToOne 1 100 0.00 255.0 FORMAT "%5.1" ECU_ADDRESS 0x70009FBD /end MEASUREMENT
/begin MEASUREMENT EGRVlv_stTempModActv "Status of the Temperature Model" UBYTE OneToOne 1 100 0.00 255.0 BIT_MASK 0x1 FORMAT "%5.1" ECU_ADDRESS 0x6000F7C5 /end MEASUREMENT
/begin MEASUREMENT EGRVlv_stTrigJamHeal "Trigger condtion for jam healing function" UBYTE OneToOne 1 100 0.00 255.0 FORMAT "%5.1" ECU_ADDRESS 0x7000370F /end MEASUREMENT
/begin MEASUREMENT EGRVlv_stTstEnvActv "State of actuator environment triggered by tester" UBYTE OneToOne 1 100 0.00 255.0 FORMAT "%5.1" ECU_ADDRESS 0x6000F853 /end MEASUREMENT
/begin MEASUREMENT EGRVlv_stTstEnvCond "State of actuator environment conditions needed by tester" UWORD OneToOne 1 100 0.00 65535.00 FORMAT "%8.2" ECU_ADDRESS 0x600094C8 /end MEASUREMENT
/begin MEASUREMENT EGRVlv_swtConf2C "" ULONG OneToOne 1 100 0.00 4294967295.00 FORMAT "%13.2" ECU_ADDRESS 0x50004E8C /end MEASUREMENT
/begin MEASUREMENT EGRVlv_swtConf3C "Status of EGRVlv_swtConf3_C after initialization" ULONG OneToOne 1 100 0.00 4294967295.00 FORMAT "%13.2" ECU_ADDRESS 0x60003A6C /end MEASUREMENT
/begin MEASUREMENT EGRVlv_swtConfActrPwrStgDrvr "Internal configuration switch" UBYTE OneToOne 1 100 0.00 255.0 FORMAT "%5.1" ECU_ADDRESS 0x6000F457 /end MEASUREMENT
/begin MEASUREMENT EGRVlv_swtConfC "" ULONG OneToOne 1 100 0.00 4294967295.00 FORMAT "%13.2" ECU_ADDRESS 0x60003A68 /end MEASUREMENT
/begin MEASUREMENT EGRVlv_swtConfGrdtLimnC "Status of EGRVlv_swtConfGrdtLimn_C after initialization" UBYTE OneToOne 1 100 0.00 255.0 FORMAT "%5.1" ECU_ADDRESS 0x70003074 /end MEASUREMENT
/begin MEASUREMENT EGRVlv_swtConfJamHealC "Internal configuration switch jam healing function" UBYTE OneToOne 1 100 0.00 255.0 FORMAT "%5.1" ECU_ADDRESS 0x70003086 /end MEASUREMENT
/begin MEASUREMENT EGRVlv_swtConfSpArbnC "Status of EGRVlv_swtConfSpArbn_C after initialization" UBYTE OneToOne 1 100 0.00 255.0 FORMAT "%5.1" ECU_ADDRESS 0x70003064 /end MEASUREMENT
/begin MEASUREMENT EGRVlv_swtConfSpFilC "Internal configuration switch set-point filter" UBYTE OneToOne 1 100 0.00 255.0 FORMAT "%5.1" ECU_ADDRESS 0x70003080 /end MEASUREMENT
/begin MEASUREMENT EGRVlv_swtConfSwVersC "" ULONG OneToOne 1 100 0.00 4294967295.00 FORMAT "%13.2" ECU_ADDRESS 0x50004E90 /end MEASUREMENT
/begin MEASUREMENT EGRVlv_tArmtrInit "Init state of housing temperature integrator" SWORD Temp_Cels 1 100 -3549.940 3003.560 FORMAT "%8.3" ECU_ADDRESS 0x6000954E /end MEASUREMENT
/begin MEASUREMENT EGRVlv_tEngTempGradAbs_mp "Absolute engine temperature gradient" SWORD TempDiff_Kelv 1 100 -3276.800 3276.700 FORMAT "%8.3" ECU_ADDRESS 0x70009D52 /end MEASUREMENT
/begin MEASUREMENT EGRVlv_tEngTempGrad_mp "Engine temperature gradient" SWORD TempDiff_Kelv 1 100 -3276.800 3276.700 FORMAT "%8.3" ECU_ADDRESS 0x70009D50 /end MEASUREMENT
/begin MEASUREMENT EGRVlv_tHsng "Modelled DC motor housing temperature" SWORD Temp_Cels 1 100 -3549.940 3003.560 FORMAT "%8.3" ECU_ADDRESS 0x6000954C /end MEASUREMENT
/begin MEASUREMENT EGRVlv_tHsngInit "Init state of housing temperature integrator" SWORD Temp_Cels 1 100 -3549.940 3003.560 FORMAT "%8.3" ECU_ADDRESS 0x6000734A /end MEASUREMENT
/begin MEASUREMENT EGRVlv_tiActrLimnCntrAct "Temporary value of the actuator limiation counter" SLONG Time_s 1 100 -21474836.4800 21474836.4700 FORMAT "%13.4" ECU_ADDRESS 0x70003E4C /end MEASUREMENT
/begin MEASUREMENT EGRVlv_tiActrLimnCntrEep "Value of the actuator limitation counter for the EEP storage" SLONG Time_s 1 100 -21474836.4800 21474836.4700 FORMAT "%13.4" ECU_ADDRESS 0x70003E48 /end MEASUREMENT
/begin MEASUREMENT EGRVlv_tiDfltMov "Time since EGRVlv_stMon2.DELIB_ELECACTR_STMON2_DFLMOV_BP is set" SWORD Time_msec_q1_COMPU 1 100 -32768.00 32767.00 FORMAT "%8.2" ECU_ADDRESS 0x60009544 /end MEASUREMENT
/begin MEASUREMENT EGRVlv_tiPeriod "PWM period of H-bridge actuator" ULONG Time_usec_q1_COMPU 1 100 0.00 4294967295.00 FORMAT "%13.2" ECU_ADDRESS 0x60003A64 /end MEASUREMENT
/begin MEASUREMENT EGRVlv_tiRawFlt "Time constant for PT1 filter that filters raw voltage value of position sensor" SLONG TimeDelay_s 1 100 0.0000020000000 4294.9672959999998 FORMAT "%19.14" ECU_ADDRESS 0x50004E94 /end MEASUREMENT
/begin MEASUREMENT EGRVlv_tOfsAdjLstLrnClsdAVS "Best possible Temperature of the Actuator during learning at closed position for AVS SET intervention" SWORD Temp_Cels 1 100 -3549.940 3003.560 FORMAT "%8.3" ECU_ADDRESS 0x6000068C /end MEASUREMENT
/begin MEASUREMENT EGRVlv_tOfsAdjLstLrnOpnAVS "Best possible Temperature of the Actuator during learning at open position for AVS SET intervention" SWORD Temp_Cels 1 100 -3549.940 3003.560 FORMAT "%8.3" ECU_ADDRESS 0x6000068E /end MEASUREMENT
/begin MEASUREMENT EGRVlv_uRawPT1FltdElec "PT1 filtered raw voltage value of position sensor" SWORD Volt 1 100 -6553.600 6553.400 FORMAT "%8.3" ECU_ADDRESS 0x60009538 /end MEASUREMENT
/begin MEASUREMENT EGRVlv_uRelPosClsdLrnFstAVS "First learned value at closed position for AVS SET intervention" SWORD Volt 1 100 -6553.600 6553.400 FORMAT "%8.3" ECU_ADDRESS 0x60000690 /end MEASUREMENT
/begin MEASUREMENT EGRVlv_uRelPosClsdMaxRomAVS "Maximum / Minimun learned raw voltage value at closed position for AVS SET intervention" SWORD Volt 1 100 -6553.600 6553.400 FORMAT "%8.3" ECU_ADDRESS 0x60000694 /end MEASUREMENT
/begin MEASUREMENT EGRVlv_uRelPosClsdRomAVS "Learned raw voltage value at closed position for sensor curve calculation for AVS SET intervention" SWORD Volt 1 100 -6553.600 6553.400 FORMAT "%8.3" ECU_ADDRESS 0x6000069C /end MEASUREMENT
/begin MEASUREMENT EGRVlv_uRelPosOpnLrnFstAVS "First learned value at open position for AVS SET intervention" SWORD Volt 1 100 -6553.600 6553.400 FORMAT "%8.3" ECU_ADDRESS 0x600006A2 /end MEASUREMENT
/begin MEASUREMENT EGRVlv_uRelPosOpnRomAVS "Learned raw voltage value at opened position for sensor curve calculation for AVS SET intervention" SWORD Volt 1 100 -6553.600 6553.400 FORMAT "%8.3" ECU_ADDRESS 0x600006A6 /end MEASUREMENT
/begin FUNCTION EGRVlv_DELib_ActrJamHeal "4.1.0     EGRVlv"
 /begin DEF_CHARACTERISTIC EGRVlv_rGovActrRlsMax_CUR EGRVlv_RlsFuncCal.rIniI_C EGRVlv_RlsFuncCal.tiRlsMove_C EGRVlv_RlsFuncCal.tiRlsWait_C EGRVlv_RlsFuncCal.tiRlsMoveMax_C EGRVlv_RlsFuncCal.tiRlsMoveMin_C EGRVlv_RlsFuncCal.tiDesValMoveBack_C EGRVlv_RlsFuncCal.rDesValMoveBack_C EGRVlv_RlsFuncCal.swtRlsTrigCdn_C EGRVlv_RlsFuncCal.numRlsTryMax_C EGRVlv_RlsFuncCal.numRlsTryAbsMax_C EGRVlv_RlsFuncCal.numRlsTryAtmptMax_C EGRVlv_RlsFuncCal.numRlsTryAbsDrvCycMax_C EGRVlv_RlsFuncCal.numRlsAtmptVltgInctReqMax_C EGRVlv_RlsFuncCal.numRlsAbsltDcycVltgInctReqMax_C EGRVlv_RlsFuncCal.swtConf_C EGRVlv_RlsFuncCal.ratGovrLimRelsWait_C EGRVlv_rMaxMoveRels_CUR /end DEF_CHARACTERISTIC
 /begin IN_MEASUREMENT EGRVlv_numJamHealAtmptAVS EGRVlv_rAct EGRVlv_stAVSRxRom EGRVlv_stIninEep EGRVlv_swtConfSwVersC SyC_ctPostDrvLeave /end IN_MEASUREMENT
 /begin OUT_MEASUREMENT EGRVlv_ctActrJamHealDSMClr EGRVlv_numJamHealAtmpt EGRVlv_rActStuck EGRVlv_rGovrActrHeal EGRVlv_rJamHeal EGRVlv_rOutJamHeal EGRVlv_stMonJamHeal EGRVlv_stTrigJamHeal /end OUT_MEASUREMENT
 /begin LOC_MEASUREMENT EGRVlv_ActrJamHealMp.stVltgInctReqInhbMp EGRVlv_ActrJamHealMp.numJamHealMp EGRVlv_ActrJamHealMp.numJamHealAbsMp EGRVlv_ctActrJamHealDSMClrOld EGRVlv_ctActrJamHealReIni EGRVlv_stJamHealTrigCdn EGRVlv_swtConfJamHealC /end LOC_MEASUREMENT
 FUNCTION_VERSION "4.1.0" /end FUNCTION
/begin FUNCTION EGRVlv_DELib_ActrLimnCntr "1.3.0     EGRVlv" /begin IN_MEASUREMENT EGRVlv_rAct EGRVlv_rActr EGRVlv_rDesVal Epm_nEng /end IN_MEASUREMENT
 /begin OUT_MEASUREMENT EGRVlv_rUnCmpdGovActr EGRVlv_stGovDeMon EGRVlv_tiActrLimnCntrAct EGRVlv_tiActrLimnCntrEep /end OUT_MEASUREMENT
 FUNCTION_VERSION "1.3.0" /end FUNCTION
/begin FUNCTION EGRVlv_DELib_ActrPwrStgDrvr "3.0.0     EGRVlv"
 /begin DEF_CHARACTERISTIC EGRVlv_ActrPwrStgDrvr_Cal.swtConf_C EGRVlv_ActrPwrStgDrvr_Cal.stMOCSOPChk_C EGRVlv_ActrPwrStgDrvr_Cal.swtPSDis_C EGRVlv_Pwm.tiPer_C EGRVlv_Pwm.stLvl_C EGRVlv_Pwm.rMaxDty_C EGRVlv_Pwm.rPerUn_C EGRVlv_Pwm.tiPh_C /end DEF_CHARACTERISTIC
 /begin IN_MEASUREMENT DevLib_stPwrStgEnaCond EGRVlv_rPs EGRVlv_stElecDiag EGRVlv_stPs EGRVlv_tiPeriod /end IN_MEASUREMENT
 /begin OUT_MEASUREMENT EGRVlv_flgActrSwtOffReq EGRVlv_flgElecDiagSwtOffReq EGRVlv_flgPwrStgReq EGRVlv_stActrAvl EGRVlv_stMonActrPwrStgDrvr EGRVlv_stPwrStgDrvr EGRVlv_swtConfActrPwrStgDrvr /end OUT_MEASUREMENT
 /begin LOC_MEASUREMENT EGRVlv_numSigID EGRVlv_SigTyp EGRVlv_stMonGlbElecdd /end LOC_MEASUREMENT
 FUNCTION_VERSION "3.0.0" /end FUNCTION
/begin FUNCTION EGRVlv_DELib_ActrRCalcn "2.2.0     EGRVlv" FUNCTION_VERSION "2.2.0" /end FUNCTION
/begin FUNCTION EGRVlv_DELib_ActrSpFil "4.0.0     EGRVlv" /begin DEF_CHARACTERISTIC EGRVlv_ActrSpFiltiDesValFil_MAP EGRVlv_swtConfSpFil_C /end DEF_CHARACTERISTIC /begin IN_MEASUREMENT EGRVlv_rAct /end IN_MEASUREMENT
 /begin OUT_MEASUREMENT EGRVlv_bIninSpFil EGRVlv_rFildSpFil EGRVlv_rIninSpFil EGRVlv_rSpFil /end OUT_MEASUREMENT
 /begin LOC_MEASUREMENT EGRVlv_ActrSpFilMp.rDesValDeMp EGRVlv_ActrSpFilMp.tiDesValFilMp EGRVlv_swtConfSpFilC /end LOC_MEASUREMENT
 FUNCTION_VERSION "4.0.0" /end FUNCTION
/begin FUNCTION EGRVlv_DELib_ActrSpGrdtLimn "3.0.0     EGRVlv"
 /begin DEF_CHARACTERISTIC EGRVlv_ActrSpGrdtLimnCal.numTempSnsr_C EGRVlv_ActrSpGrdtLimnCal.tHi_C EGRVlv_ActrSpGrdtLimnCal.tLo_C EGRVlv_ActrSpGrdtLimnCalPrm1.rActLo_C EGRVlv_ActrSpGrdtLimnCalPrm1.rActHi_C EGRVlv_ActrSpGrdtLimnCalPrm1.rDesValLo_C EGRVlv_ActrSpGrdtLimnCalPrm1.rDesValHi_C EGRVlv_ActrSpGrdtLimnCalPrm1.rGrdtPos_C EGRVlv_ActrSpGrdtLimnCalPrm1.rGrdtNeg_C EGRVlv_ActrSpGrdtLimnCalPrm1.stMaskEnvCond_C EGRVlv_ActrSpGrdtLimnCalPrm2.rActLo_C EGRVlv_ActrSpGrdtLimnCalPrm2.rActHi_C EGRVlv_ActrSpGrdtLimnCalPrm2.rDesValLo_C EGRVlv_ActrSpGrdtLimnCalPrm2.rDesValHi_C EGRVlv_ActrSpGrdtLimnCalPrm2.rGrdtPos_C EGRVlv_ActrSpGrdtLimnCalPrm2.rGrdtNeg_C EGRVlv_ActrSpGrdtLimnCalPrm2.stMaskEnvCond_C EGRVlv_ActrSpGrdtLimnCalPrm3.rActLo_C EGRVlv_ActrSpGrdtLimnCalPrm3.rActHi_C EGRVlv_ActrSpGrdtLimnCalPrm3.rDesValLo_C EGRVlv_ActrSpGrdtLimnCalPrm3.rDesValHi_C EGRVlv_ActrSpGrdtLimnCalPrm3.rGrdtPos_C EGRVlv_ActrSpGrdtLimnCalPrm3.rGrdtNeg_C EGRVlv_ActrSpGrdtLimnCalPrm3.stMaskEnvCond_C EGRVlv_ActrSpGrdtLimnCalPrm4.rActLo_C EGRVlv_ActrSpGrdtLimnCalPrm4.rActHi_C EGRVlv_ActrSpGrdtLimnCalPrm4.rDesValLo_C EGRVlv_ActrSpGrdtLimnCalPrm4.rDesValHi_C EGRVlv_ActrSpGrdtLimnCalPrm4.rGrdtPos_C EGRVlv_ActrSpGrdtLimnCalPrm4.rGrdtNeg_C EGRVlv_ActrSpGrdtLimnCalPrm4.stMaskEnvCond_C EGRVlv_ActrSpGrdtLimnCalPrm5.rActLo_C EGRVlv_ActrSpGrdtLimnCalPrm5.rActHi_C EGRVlv_ActrSpGrdtLimnCalPrm5.rDesValLo_C EGRVlv_ActrSpGrdtLimnCalPrm5.rDesValHi_C EGRVlv_ActrSpGrdtLimnCalPrm5.rGrdtPos_C EGRVlv_ActrSpGrdtLimnCalPrm5.rGrdtNeg_C EGRVlv_ActrSpGrdtLimnCalPrm5.stMaskEnvCond_C EGRVlv_swtConfGrdtLimn_C /end DEF_CHARACTERISTIC
 /begin IN_MEASUREMENT CoEng_stMai DELib_idxArrSnsr DELib_xArrSnsr EGRVlv_rAct EGRVlv_stActrROM EGRVlv_stMon3 SyC_stSub T15_st /end IN_MEASUREMENT
 /begin OUT_MEASUREMENT EGRVlv_rGrdtLimn EGRVlv_rOutGrdtLimn EGRVlv_stGrdtLimnIninTrig /end OUT_MEASUREMENT
 /begin LOC_MEASUREMENT EGRVlv_ActrSpGrdtLimnMp.rSlpPosMp EGRVlv_ActrSpGrdtLimnMp.rSlpNegMp EGRVlv_ActrSpGrdtLimnMp.stGrdtLimnEnvRlsMp EGRVlv_ActrSpGrdtLimnMp.rDesValLimMp EGRVlv_stMonGrdtLimn EGRVlv_swtConfGrdtLimnC /end LOC_MEASUREMENT
 FUNCTION_VERSION "3.0.0" /end FUNCTION
/begin FUNCTION EGRVlv_DELib_ActvnDeactvnCdn "2.0.0     EGRVlv"
 /begin DEF_CHARACTERISTIC EGRVlv_ActvnDeactvnCdnCal.nMinActrActv_C EGRVlv_ActvnDeactvnCdnCal.swtFlgShOffCtrlDne_C EGRVlv_ActvnDeactvnCdnCal.tiShOffCtrlDne_C EGRVlv_ActvnDeactvnCdnCal.tiDeactvnStSp_C EGRVlv_ActvnDeactvnCdnCal.rActStSpThd_C EGRVlv_ActvnDeactvnCdnCal.vDeactvnStSpThd_C EGRVlv_ActvnDeactvnCdnCal.vActvnEngOffSailThd_C EGRVlv_ActvnDeactvnCdnCal.tiEngOffSail_C EGRVlv_ActvnDeactvnCdnCal.tiTerminalEngOff_C EGRVlv_ActvnDeactvnCdnCal.stActrEnaPreCdn_C EGRVlv_ActvnDeactvnCdnCal.stActrDiCdn_C /end DEF_CHARACTERISTIC
 /begin IN_MEASUREMENT CoEng_stMai CoEng_stMaiOld DevLib_stPwrStgEnaCond EGRVlv_rAct Epm_nEng SyC_stPreDrv SyC_stSub T15_st VehV_v /end IN_MEASUREMENT
 /begin OUT_MEASUREMENT EGRVlv_stActvn EGRVlv_stDeactvn /end OUT_MEASUREMENT
 FUNCTION_VERSION "2.0.0" /end FUNCTION
/begin FUNCTION EGRVlv_DELib_ElecActrAdpvPosnCtrl "4.0.0" FUNCTION_VERSION "4.0.0" /end FUNCTION
/begin FUNCTION EGRVlv_DELib_ElecActrAdpvPosnCtrlInp "4.0.0" FUNCTION_VERSION "4.0.0" /end FUNCTION
/begin FUNCTION EGRVlv_DELib_ElecActrAvs "2.1.0"
 /begin REF_CHARACTERISTIC EGRVlv_SensCal.uCtlRngMax_C EGRVlv_SensCal.uCtlRngMin_C EGRVlv_SensCal.uMin_C EGRVlv_SensCal.uMax_C EGRVlv_SensCal.uAvrgOpn_C EGRVlv_SensCal.uAvrgClsd_C EGRVlv_SensCal.uRefSens_C EGRVlv_SensCal.uRawMinClsd_C EGRVlv_SensCal.uRawMaxClsd_C EGRVlv_SensCal.uRawMinOpn_C EGRVlv_SensCal.uRawMaxOpn_C EGRVlv_SensCal.uRawMinMechBnd_C EGRVlv_SensCal.uRawMaxMechBnd_C EGRVlv_SensCal.uRawMaxElecClsd_C EGRVlv_SensCal.uRawMinElecClsd_C EGRVlv_SensCal.uRawMaxElecOpn_C EGRVlv_SensCal.uRawMinElecOpn_C /end REF_CHARACTERISTIC
 /begin IN_MEASUREMENT EGRVlv_ctrActrDst EGRVlv_nrDesValCnt EGRVlv_numJamHealAtmpt EGRVlv_numReaMechBnd EGRVlv_OfsLearn.d_mp EGRVlv_OfsLearn.k_mp EGRVlv_OfsLearn.uRelPosClsdLrnFst_mp EGRVlv_OfsLearn.uRelPosClsdLrnLst_mp EGRVlv_OfsLearn.uRelPosOpnLrnFst_mp EGRVlv_OfsLearn.uRelPosOpnLrnLst_mp EGRVlv_stActrROM EGRVlv_stMonVdSens EGRVlv_swtConf2C EGRVlv_tOfsAdjLstLrnClsd EGRVlv_tOfsAdjLstLrnOpn EGRVlv_uOffsClsd EGRVlv_uOffsOpn EGRVlv_uRelPosClsdLrnFst EGRVlv_uRelPosClsdMaxRom EGRVlv_uRelPosClsdRom EGRVlv_uRelPosOpnLrnFst EGRVlv_uRelPosOpnRom EnvT_t /end IN_MEASUREMENT
 /begin OUT_MEASUREMENT EGRVlv_ctrActrDstAVS EGRVlv_nrDesValCntAVS EGRVlv_numJamHealAtmptAVS EGRVlv_numReaMechBndAVS EGRVlv_stActrROMAVS EGRVlv_stAVSRxRom EGRVlv_tOfsAdjLstLrnClsdAVS EGRVlv_tOfsAdjLstLrnOpnAVS EGRVlv_uRelPosClsdLrnFstAVS EGRVlv_uRelPosClsdMaxRomAVS EGRVlv_uRelPosClsdRomAVS EGRVlv_uRelPosOpnLrnFstAVS EGRVlv_uRelPosOpnRomAVS /end OUT_MEASUREMENT
 FUNCTION_VERSION "2.1.0" /end FUNCTION
/begin FUNCTION EGRVlv_DELib_ElecActrCoorr "11.0.0"
 /begin DEF_CHARACTERISTIC EGRVlv_ATS.LimitTypeMsk_C EGRVlv_ATS.CnvNorm_C EGRVlv_ATS.LowLim_C EGRVlv_ATS.UpLim_C EGRVlv_ATS.CnvFac_C EGRVlv_ATS.CnvOfs_C EGRVlv_ATS.DfltVal_C EGRVlv_Cal.tiBattCorFacFlt_C EGRVlv_Cal.rDesValFailSafe_C EGRVlv_Cal.slpFailSafePos_C EGRVlv_Cal.slpFailSafeNeg_C EGRVlv_Cal.tiDesValFlt_C EGRVlv_Cal.tiduRawFlt_C EGRVlv_Cal.uFailSafeBattMin_C EGRVlv_Cal.uFailSafeBattMax_C EGRVlv_Cal.uBattMin_C EGRVlv_Cal.uBattMax_C EGRVlv_Cal.uBattMinNoLrn_C EGRVlv_Cal.uBattMaxNoLrn_C EGRVlv_Cal.facCorStrt_C EGRVlv_Cal.numTEng_C EGRVlv_Cal.tEngMin_C EGRVlv_Cal.tEngMax_C EGRVlv_Cal.rCtlRngMin_C EGRVlv_Cal.rCtlRngMax_C EGRVlv_Cal.tiTempErrOk_C EGRVlv_Cal.rActActrActv_C EGRVlv_Cal.tiSoftShOff_C EGRVlv_Cal.rDesValSoftShOff_C EGRVlv_Cal.stActrDiaDis_C EGRVlv_Cal.stActrDis_C EGRVlv_Cal.numTempErrDef_C EGRVlv_Cal.swtNrmInv_C EGRVlv_Cal.rPwrStgDis_C EGRVlv_Cal.tAirSysFldMin_C EGRVlv_Cal.tAirSysFldMax_C EGRVlv_Cal.tExhFldMin_C EGRVlv_Cal.tExhFldMax_C EGRVlv_Cal.tEngDaFldMin_C EGRVlv_Cal.tEngDaFldMax_C EGRVlv_Cal.numExhTempDesVal_C EGRVlv_Cal.numAirTempDesVal_C EGRVlv_Cal.numEngDaTempDesVal_C EGRVlv_Cal.numTemp4_C EGRVlv_Cal.tiIni_C EGRVlv_Cal.rDesValIniStdBy_C EGRVlv_Cal.rDesValIni_C EGRVlv_Cal.tiDflDtyCyc_C EGRVlv_Cal.tidrDesValFlt_C EGRVlv_Cal.rDesValCntMinThrd_C EGRVlv_Cal.swtRstrDesValCnt_C EGRVlv_Cal.swtActvn_C EGRVlv_Cal.swtDeactvnMask_C EGRVlv_Cal.duMovDet_C EGRVlv_Cal.tiNMinActActvDly_C EGRVlv_Cal.stTmpDeactv_C EGRVlv_ClnVrfyCal.uBattClnMax_C EGRVlv_ClnVrfyCal.uBattClnMin_C EGRVlv_ClnVrfyCal.numMaxClnVerifyAbrt_C EGRVlv_ClnVrfyCal.tiDesValOpn_C EGRVlv_ClnVrfyCal.tiDesValClsd_C EGRVlv_ClnVrfyCal.rDesValOpn_C EGRVlv_ClnVrfyCal.rDesValClsd_C EGRVlv_ClnVrfyCal.tiDesVal2_C EGRVlv_ClnVrfyCal.rDesValOpn2_C EGRVlv_ClnVrfyCal.rDesValClsd2_C EGRVlv_ClnVrfyCal.swtFeatClnVerify_C EGRVlv_ClnVrfyCal.numMaxClean_C EGRVlv_ClnVrfyCal.numMaxClean2_C EGRVlv_ClnVrfyCal.numMaxEndStop_C EGRVlv_ClnVrfyCal.stClnVerifyCntMsk_C EGRVlv_ClnVrfyCal.numSprgActv_C EGRVlv_ClnVrfyCal.rActSprgDiffPls_C EGRVlv_ClnVrfyCal.tiSprgBrk_C EGRVlv_ClnVrfyCal.qLoIdl_C EGRVlv_ClnVrfyCal.nLoIdl_C EGRVlv_ClnVrfyCal.tiLoIdl_C EGRVlv_ClnVrfyCal.tiClnVrfySpct_C EGRVlv_ClnVrfyCal.swtLrnSuc_C EGRVlv_ClnVrfyCal.stClnVrfyOpModeMsk_C EGRVlv_ClnVrfyCal.ubatTstRlsClnVerify_C EGRVlv_ClnVrfyCal.tiClnVerifyLoIdlLck_C EGRVlv_ClnVrfyCal.pMinLoIdl_C EGRVlv_ClnVrfyCal.swtPermActDeactvn_C EGRVlv_ClnVrfyCal.swtEngSpdDeactvn_C EGRVlv_ClnVrfyCal.tiPreDrvClnVrfyMax_C EGRVlv_ClnVrfyCal.tiPostDrvClnVrfyMax_C EGRVlv_ClnVrfyCal.swtEvalOfsLrnAvl_C EGRVlv_ClnVrfyCal.numReaMechBndClnVrfyMax_C EGRVlv_ClnVrfyCal.flgSwtSelfLrnEna_C EGRVlv_LRN_ATS.LimitTypeMsk_C EGRVlv_LRN_ATS.CnvNorm_C EGRVlv_LRN_ATS.LowLim_C EGRVlv_LRN_ATS.UpLim_C EGRVlv_LRN_ATS.CnvFac_C EGRVlv_LRN_ATS.CnvOfs_C EGRVlv_LRN_ATS.DfltVal_C EGRVlv_MulHysCal.rDesValMin_C EGRVlv_MulHysCal.rDesValMax_C EGRVlv_numMulHystChara_CA EGRVlv_rDesActrATS_CUR EGRVlv_rDesActrHyst2CUR_CA EGRVlv_rDesActrHyst_CUR EGRVlv_rDesActrLrnATS_CUR EGRVlv_rDesActr_CUR EGRVlv_rMulHystLeftThres_CA EGRVlv_rMulHystRightThres_CA EGRVlv_tiInpFlt_CUR /end DEF_CHARACTERISTIC
 /begin REF_CHARACTERISTIC EGRVlv_EnhdPosGovCal.tiDebMinMechBnd_C EGRVlv_EnhdPosGovCal.tiDebMaxMechBnd_C EGRVlv_EnhdPosGovCal.rGovDvtThresGovOn_C EGRVlv_EnhdPosGovCal.rGovDvtThresGovDelta_C EGRVlv_EnhdPosGovCal.drDesValFltThresGovOn_C EGRVlv_EnhdPosGovCal.rGovMax_C EGRVlv_EnhdPosGovCal.rGovMin_C EGRVlv_EnhdPosGovCal.rGovLimEffMax_C EGRVlv_EnhdPosGovCal.duCldMov_C EGRVlv_EnhdPosGovCal.rGovMaxExtDem_C EGRVlv_EnhdPosGovCal.iEffMdlHeat_C EGRVlv_EnhdPosGovCal.iEffMdlCool_C EGRVlv_EnhdPosGovCal.stSpLimnDiMask_C EGRVlv_EnhdPosGovCal.numExtArmtrTSel_C EGRVlv_EnhdPosGovCal.tiArmtrFlt_C EGRVlv_EnhdPosGovCal.swtGovByp_C EGRVlv_EnhdPosGovCal.rDesValMaxOff_C EGRVlv_EnhdPosGovCal.rDesValMinOff_C EGRVlv_EnhdPosGovCal.rDesValMin_C EGRVlv_EnhdPosGovCal.rDesValMax_C EGRVlv_EnhdPosGovCal.rGovDesValMin_C EGRVlv_EnhdPosGovCal.rGovDesValMax_C EGRVlv_EnhdPosGovCal.numMdnAvrgSpd_C EGRVlv_EnhdPosGovCal.swtrGovDesVal_C EGRVlv_EnhdPosGovCal.rIniI_C EGRVlv_EnhdPosGovCal.swtRlsLimDeactv_C EGRVlv_OfsLearnCal.nEngMax_C EGRVlv_OfsLearnCal.nEngMin_C EGRVlv_OfsLearnCal.numClnVerifyMin_C EGRVlv_OfsLearnCal.numTOfsLrnAdj_C EGRVlv_OfsLearnCal.pDsbcMax_C EGRVlv_OfsLearnCal.qSetUnBalQntyMax_C EGRVlv_OfsLearnCal.rOfsLrnAvlMinHi_C EGRVlv_OfsLearnCal.rOfsLrnAvlMinLo_C EGRVlv_OfsLearnCal.swtLrn_C EGRVlv_OfsLearnCal.tiAvrg_C EGRVlv_OfsLearnCal.tiOfsLrnStrt_C EGRVlv_OfsLearnCal.tiStFlgDsplLrn_C EGRVlv_OfsLearnCal.tiZycOffSetLrn_C EGRVlv_OfsLearnCal.uDstCalcClsd_C EGRVlv_OfsLearnCal.uDstCalcOpn_C EGRVlv_OfsLearnCal.uMaxDrftConscClsd_C EGRVlv_OfsLearnCal.uMaxDrftConscOpn_C EGRVlv_OfsLearnCal.uNewActrDetnThd_C EGRVlv_OfsLearnCal.uOffsClsd_C EGRVlv_OfsLearnCal.uOffsOpn_C EGRVlv_OfsLearnCal.uTempOfsAdjClsd_CUR EGRVlv_OfsLearnCal.uTempOfsAdjOpn_CUR EGRVlv_SensCal.uCtlRngMax_C EGRVlv_SensCal.uCtlRngMin_C EGRVlv_SensCal.uMin_C EGRVlv_SensCal.uMax_C EGRVlv_SensCal.uAvrgOpn_C EGRVlv_SensCal.uAvrgClsd_C EGRVlv_SensCal.uRefSens_C EGRVlv_SensCal.uRawMinClsd_C EGRVlv_SensCal.uRawMaxClsd_C EGRVlv_SensCal.uRawMinOpn_C EGRVlv_SensCal.uRawMaxOpn_C EGRVlv_SensCal.uRawMinMechBnd_C EGRVlv_SensCal.uRawMaxMechBnd_C EGRVlv_SensCal.uRawMaxElecClsd_C EGRVlv_SensCal.uRawMinElecClsd_C EGRVlv_SensCal.uRawMaxElecOpn_C EGRVlv_SensCal.uRawMinElecOpn_C /end REF_CHARACTERISTIC
 /begin IN_MEASUREMENT BattU_u CoEng_stMai CoEng_stMaiOld DELib_idxArrSnsr DELib_stFirstPreDrvOverCopy DELib_xArrSnsr DevLib_stPwrStgEnaCond EGRVlv_nrDesValCntAVS EGRVlv_numReaMechBnd EGRVlv_OfsLearnCal.locvar EGRVlv_OfsLearnCal.tOfsAdjuTempOfsAdjClsdCurInp EGRVlv_OfsLearnCal.tOfsAdjuTempOfsAdjOpnCurInp EGRVlv_rAct EGRVlv_rTransfCur EGRVlv_stActrROM EGRVlv_stActvn EGRVlv_stAVSRxRom EGRVlv_stDeactvn EGRVlv_stMon EGRVlv_stMon2 EGRVlv_stMonGovrDe EGRVlv_stMonVdSens EGRVlv_swtConf2C EGRVlv_swtConf3C EGRVlv_swtConfC EGRVlv_swtConfSwVersC EGRVlv_uRelPosnClsdLrn EGRVlv_uRelPosnOpenLrn Epm_nEng SyC_stPreDrv SyC_stSub SyC_tiPostDrv SyC_tiPreDrv /end IN_MEASUREMENT
 /begin OUT_MEASUREMENT EGRVlv_flgDiagStrtClnVrfy EGRVlv_nrDesValCnt EGRVlv_numClnVerify EGRVlv_numClnVerifyAbrt EGRVlv_r EGRVlv_rDesVal EGRVlv_rDesValMax EGRVlv_rDesValMin EGRVlv_stDFCSprgBrk EGRVlv_stMon3 EGRVlv_stTstEnvActv EGRVlv_stTstEnvCond /end OUT_MEASUREMENT
 /begin LOC_MEASUREMENT EGRVlv_flgMonXPostDrv_mp EGRVlv_rActSprgDiff_mp EGRVlv_rDesActr_mp EGRVlv_rDesValATS_mp EGRVlv_rDesValSty_mp EGRVlv_rDesVal_mp EGRVlv_rInpFlt EGRVlv_stClnVerifyReq EGRVlv_stClnVrfyPreDrvTrig EGRVlv_stClnVrfyRlsCnd EGRVlv_stClnVrfyRlsCndTst EGRVlv_stSyCWaitXPreDrv_mp /end LOC_MEASUREMENT
 FUNCTION_VERSION "11.0.0" /end FUNCTION
/begin FUNCTION EGRVlv_DELib_ElecActrDdSENTSlowRead "1.10.0" FUNCTION_VERSION "1.10.0" /end FUNCTION
/begin FUNCTION EGRVlv_DELib_ElecactrDdSnsrRead "10.2.0    EGRVlv" /begin DEF_CHARACTERISTIC EGRVlv_tiRawFltSnsrRead_MAP /end DEF_CHARACTERISTIC
 /begin REF_CHARACTERISTIC EGRVlv_Cal.tiBattCorFacFlt_C EGRVlv_Cal.rDesValFailSafe_C EGRVlv_Cal.slpFailSafePos_C EGRVlv_Cal.slpFailSafeNeg_C EGRVlv_Cal.tiDesValFlt_C EGRVlv_Cal.tiduRawFlt_C EGRVlv_Cal.uFailSafeBattMin_C EGRVlv_Cal.uFailSafeBattMax_C EGRVlv_Cal.uBattMin_C EGRVlv_Cal.uBattMax_C EGRVlv_Cal.uBattMinNoLrn_C EGRVlv_Cal.uBattMaxNoLrn_C EGRVlv_Cal.facCorStrt_C EGRVlv_Cal.numTEng_C EGRVlv_Cal.tEngMin_C EGRVlv_Cal.tEngMax_C EGRVlv_Cal.rCtlRngMin_C EGRVlv_Cal.rCtlRngMax_C EGRVlv_Cal.tiTempErrOk_C EGRVlv_Cal.rActActrActv_C EGRVlv_Cal.tiSoftShOff_C EGRVlv_Cal.rDesValSoftShOff_C EGRVlv_Cal.stActrDiaDis_C EGRVlv_Cal.stActrDis_C EGRVlv_Cal.numTempErrDef_C EGRVlv_Cal.swtNrmInv_C EGRVlv_Cal.rPwrStgDis_C EGRVlv_Cal.tAirSysFldMin_C EGRVlv_Cal.tAirSysFldMax_C EGRVlv_Cal.tExhFldMin_C EGRVlv_Cal.tExhFldMax_C EGRVlv_Cal.tEngDaFldMin_C EGRVlv_Cal.tEngDaFldMax_C EGRVlv_Cal.numExhTempDesVal_C EGRVlv_Cal.numAirTempDesVal_C EGRVlv_Cal.numEngDaTempDesVal_C EGRVlv_Cal.numTemp4_C EGRVlv_Cal.tiIni_C EGRVlv_Cal.rDesValIniStdBy_C EGRVlv_Cal.rDesValIni_C EGRVlv_Cal.tiDflDtyCyc_C EGRVlv_Cal.tidrDesValFlt_C EGRVlv_Cal.rDesValCntMinThrd_C EGRVlv_Cal.swtRstrDesValCnt_C EGRVlv_Cal.swtActvn_C EGRVlv_Cal.swtDeactvnMask_C EGRVlv_Cal.duMovDet_C EGRVlv_Cal.tiNMinActActvDly_C EGRVlv_Cal.stTmpDeactv_C EGRVlv_SensCal.uCtlRngMax_C EGRVlv_SensCal.uCtlRngMin_C EGRVlv_SensCal.uMin_C EGRVlv_SensCal.uMax_C EGRVlv_SensCal.uAvrgOpn_C EGRVlv_SensCal.uAvrgClsd_C EGRVlv_SensCal.uRefSens_C EGRVlv_SensCal.uRawMinClsd_C EGRVlv_SensCal.uRawMaxClsd_C EGRVlv_SensCal.uRawMinOpn_C EGRVlv_SensCal.uRawMaxOpn_C EGRVlv_SensCal.uRawMinMechBnd_C EGRVlv_SensCal.uRawMaxMechBnd_C EGRVlv_SensCal.uRawMaxElecClsd_C EGRVlv_SensCal.uRawMinElecClsd_C EGRVlv_SensCal.uRawMaxElecOpn_C EGRVlv_SensCal.uRawMinElecOpn_C /end REF_CHARACTERISTIC
 /begin IN_MEASUREMENT EGRVlv_FirCalc.cntrAvrgZr EGRVlv_FirCalc.flgRdDne EGRVlv_FirCalc.uRawAvrg EGRVlv_FirCalc.uRawFir EGRVlv_FirRead.cntr EGRVlv_FirRead.flgFirstRun EGRVlv_FirRead.idxArr EGRVlv_FirRead.uSum EGRVlv_rGovDvt EGRVlv_stActrROM EGRVlv_stMon2 EGRVlv_swtConf2C EGRVlv_swtConfC EGRVlv_uRawUnFltd PCR_pDesVal /end IN_MEASUREMENT
 /begin OUT_MEASUREMENT EGRVlv_duRawUnFild EGRVlv_stActrDdReadCalc EGRVlv_tiRawFlt EGRVlv_uRawPT1FltdElec /end OUT_MEASUREMENT
 /begin LOC_MEASUREMENT EGRVlv_rGovDvtAbs /end LOC_MEASUREMENT
 FUNCTION_VERSION "10.2.0" /end FUNCTION
/begin FUNCTION EGRVlv_DELib_ElecActrElecDiag "1.12.0    EGRVlv"
 /begin DEF_CHARACTERISTIC EGRVlv_pwmPsDiagCal.nrTstPls_C EGRVlv_pwmPsDiagCal.tiBtwElecFlt_C EGRVlv_pwmPsDiagCal.tiBtwOTFlt_C EGRVlv_stPwrStgDiaDis_C /end DEF_CHARACTERISTIC
 /begin IN_MEASUREMENT DevLib_stPwrStgEnaCond EGRVlv_flgElecDiagSwtOffReq EGRVlv_stMon3 EGRVlv_stPwrStgDrvr EGRVlv_swtConf2C EGRVlv_swtConfC /end IN_MEASUREMENT
 /begin OUT_MEASUREMENT EGRVlv_stActrDiagDis EGRVlv_stElecDiag EGRVlv_stErrInfo EGRVlv_stMonElecDiag EGRVlv_stPwrStgQual /end OUT_MEASUREMENT
 FUNCTION_VERSION "1.12.0" /end FUNCTION
/begin FUNCTION EGRVlv_DELib_ElecActrInin "14.2.0"
 /begin DEF_CHARACTERISTIC EGRVlv_swtConf2_C EGRVlv_swtConf3_C EGRVlv_swtConfSwVers167_C EGRVlv_swtConf_C /end DEF_CHARACTERISTIC
 /begin IN_MEASUREMENT EGRVlv_stActrAvl /end IN_MEASUREMENT
 /begin OUT_MEASUREMENT EGRVlv_swtConf2C EGRVlv_swtConf3C EGRVlv_swtConfC EGRVlv_swtConfSwVersC /end OUT_MEASUREMENT
 FUNCTION_VERSION "14.2.0" /end FUNCTION
/begin FUNCTION EGRVlv_DELib_ElecActrPosnChgCntr "6.0.0" FUNCTION_VERSION "6.0.0" /end FUNCTION
/begin FUNCTION EGRVlv_DELib_ElecActrSpArbn "3.0.0"
 /begin DEF_CHARACTERISTIC EGRVlv_ElecActrSpArbnCal.swtSpFltIniSel_C EGRVlv_ElecActrSpArbnCal.tiOpenDly_C EGRVlv_ElecActrSpArbnCal.tiClsdDly_C EGRVlv_ElecActrSpArbnCal.rDesValThdClsdMin_C EGRVlv_ElecActrSpArbnCal.rDesValThdOpenMax_C EGRVlv_ElecActrSpArbnCldStrtCal.duCldMov_C EGRVlv_ElecActrSpArbnCldStrtCal.slpCldStrtRmp_C EGRVlv_swtConfSpArbn_C /end DEF_CHARACTERISTIC
 /begin IN_MEASUREMENT EGRVlv_bIninSpFil EGRVlv_duRaw EGRVlv_rActSign EGRVlv_rDesVal EGRVlv_rFildSpFil EGRVlv_rGrdtLimn EGRVlv_rIninSpFil EGRVlv_rJamHeal EGRVlv_rOutGrdtLimn EGRVlv_rOutJamHeal EGRVlv_rSpFil EGRVlv_stGrdtLimnIninTrig EGRVlv_stMon EGRVlv_stMon2 EGRVlv_stMon3 EGRVlv_stMonGovrDe EGRVlv_stMonVdSens EGRVlv_stTrigJamHeal /end IN_MEASUREMENT
 /begin OUT_MEASUREMENT EGRVlv_rArbnDesVal EGRVlv_stMonSpArbn /end OUT_MEASUREMENT
 /begin LOC_MEASUREMENT EGRVlv_rCldStrtRmpMp EGRVlv_swtConfSpArbnC /end LOC_MEASUREMENT
 FUNCTION_VERSION "3.0.0" /end FUNCTION
/begin FUNCTION EGRVlv_DELib_ElecActrTest "9.1.0"
 /begin REF_CHARACTERISTIC EGRVlv_Cal.tiBattCorFacFlt_C EGRVlv_Cal.rDesValFailSafe_C EGRVlv_Cal.slpFailSafePos_C EGRVlv_Cal.slpFailSafeNeg_C EGRVlv_Cal.tiDesValFlt_C EGRVlv_Cal.tiduRawFlt_C EGRVlv_Cal.uFailSafeBattMin_C EGRVlv_Cal.uFailSafeBattMax_C EGRVlv_Cal.uBattMin_C EGRVlv_Cal.uBattMax_C EGRVlv_Cal.uBattMinNoLrn_C EGRVlv_Cal.uBattMaxNoLrn_C EGRVlv_Cal.facCorStrt_C EGRVlv_Cal.numTEng_C EGRVlv_Cal.tEngMin_C EGRVlv_Cal.tEngMax_C EGRVlv_Cal.rCtlRngMin_C EGRVlv_Cal.rCtlRngMax_C EGRVlv_Cal.tiTempErrOk_C EGRVlv_Cal.rActActrActv_C EGRVlv_Cal.tiSoftShOff_C EGRVlv_Cal.rDesValSoftShOff_C EGRVlv_Cal.stActrDiaDis_C EGRVlv_Cal.stActrDis_C EGRVlv_Cal.numTempErrDef_C EGRVlv_Cal.swtNrmInv_C EGRVlv_Cal.rPwrStgDis_C EGRVlv_Cal.tAirSysFldMin_C EGRVlv_Cal.tAirSysFldMax_C EGRVlv_Cal.tExhFldMin_C EGRVlv_Cal.tExhFldMax_C EGRVlv_Cal.tEngDaFldMin_C EGRVlv_Cal.tEngDaFldMax_C EGRVlv_Cal.numExhTempDesVal_C EGRVlv_Cal.numAirTempDesVal_C EGRVlv_Cal.numEngDaTempDesVal_C EGRVlv_Cal.numTemp4_C EGRVlv_Cal.tiIni_C EGRVlv_Cal.rDesValIniStdBy_C EGRVlv_Cal.rDesValIni_C EGRVlv_Cal.tiDflDtyCyc_C EGRVlv_Cal.tidrDesValFlt_C EGRVlv_Cal.rDesValCntMinThrd_C EGRVlv_Cal.swtRstrDesValCnt_C EGRVlv_Cal.swtActvn_C EGRVlv_Cal.swtDeactvnMask_C EGRVlv_Cal.duMovDet_C EGRVlv_Cal.tiNMinActActvDly_C EGRVlv_Cal.stTmpDeactv_C /end REF_CHARACTERISTIC
 /begin IN_MEASUREMENT EGRVlv_stOfsLrnEnvCond EGRVlv_swtConf2C EGRVlv_swtConfC Epm_nEng T15_st /end IN_MEASUREMENT
 FUNCTION_VERSION "9.1.0" /end FUNCTION
/begin FUNCTION EGRVlv_DELib_ElecActrVdMon "15.3.0"
 /begin DEF_CHARACTERISTIC EGRVlv_coefHtTransfAirHsng_CUR EGRVlv_coefHtTransfClntHsng_CUR EGRVlv_coefHtTransfEnvHsng_MAP EGRVlv_facCapHtHsng_CUR EGRVlv_facClgEngEnv_CUR EGRVlv_facPresDsbcLim_CUR EGRVlv_numElecActr_C EGRVlv_rActTst_CUR EGRVlv_rGovMaxTemp_M EGRVlv_TempModelCal.coefHtTransfArmtrHsng_C EGRVlv_TempModelCal.coefHtTransfEngHsng_C EGRVlv_TempModelCal.coefHtTransfExhHsng_C EGRVlv_TempModelCal.capHtHsng_C EGRVlv_TempModelCal.capHtArmtr_C EGRVlv_TempModelCal.tHsngMax_C EGRVlv_TempModelCal.tArmtrMax_C EGRVlv_TempModelCal.tDflArmtr_C EGRVlv_TempModelCal.tDflHsng_C EGRVlv_TempModelCal.facEngCEngDsT_C EGRVlv_TempModelCal.tiTempModInit_C EGRVlv_TempModelCal.tiEngTempGrad_C EGRVlv_TempModelCal.numAirTempSelHsng_C EGRVlv_TempModelCal.numEnvTempSelHsng_C EGRVlv_TempModelCal.numEngTempSelHsng_C EGRVlv_TempModelCal.numExhTempSelHsng_C EGRVlv_TempModelCal.tDiffEngMin_C EGRVlv_TempModelCal.tDiffEngOffEnvMin_C EGRVlv_TempModelCal.numInitArmtrAir_C EGRVlv_TempModelCal.numInitArmtrEng_C EGRVlv_TempModelCal.tArmtrThresHi_C EGRVlv_TempModelCal.tArmtrThresLo_C EGRVlv_tEngCld_CUR /end DEF_CHARACTERISTIC
 /begin REF_CHARACTERISTIC EGRVlv_Cal.tiBattCorFacFlt_C EGRVlv_Cal.rDesValFailSafe_C EGRVlv_Cal.slpFailSafePos_C EGRVlv_Cal.slpFailSafeNeg_C EGRVlv_Cal.tiDesValFlt_C EGRVlv_Cal.tiduRawFlt_C EGRVlv_Cal.uFailSafeBattMin_C EGRVlv_Cal.uFailSafeBattMax_C EGRVlv_Cal.uBattMin_C EGRVlv_Cal.uBattMax_C EGRVlv_Cal.uBattMinNoLrn_C EGRVlv_Cal.uBattMaxNoLrn_C EGRVlv_Cal.facCorStrt_C EGRVlv_Cal.numTEng_C EGRVlv_Cal.tEngMin_C EGRVlv_Cal.tEngMax_C EGRVlv_Cal.rCtlRngMin_C EGRVlv_Cal.rCtlRngMax_C EGRVlv_Cal.tiTempErrOk_C EGRVlv_Cal.rActActrActv_C EGRVlv_Cal.tiSoftShOff_C EGRVlv_Cal.rDesValSoftShOff_C EGRVlv_Cal.stActrDiaDis_C EGRVlv_Cal.stActrDis_C EGRVlv_Cal.numTempErrDef_C EGRVlv_Cal.swtNrmInv_C EGRVlv_Cal.rPwrStgDis_C EGRVlv_Cal.tAirSysFldMin_C EGRVlv_Cal.tAirSysFldMax_C EGRVlv_Cal.tExhFldMin_C EGRVlv_Cal.tExhFldMax_C EGRVlv_Cal.tEngDaFldMin_C EGRVlv_Cal.tEngDaFldMax_C EGRVlv_Cal.numExhTempDesVal_C EGRVlv_Cal.numAirTempDesVal_C EGRVlv_Cal.numEngDaTempDesVal_C EGRVlv_Cal.numTemp4_C EGRVlv_Cal.tiIni_C EGRVlv_Cal.rDesValIniStdBy_C EGRVlv_Cal.rDesValIni_C EGRVlv_Cal.tiDflDtyCyc_C EGRVlv_Cal.tidrDesValFlt_C EGRVlv_Cal.rDesValCntMinThrd_C EGRVlv_Cal.swtRstrDesValCnt_C EGRVlv_Cal.swtActvn_C EGRVlv_Cal.swtDeactvnMask_C EGRVlv_Cal.duMovDet_C EGRVlv_Cal.tiNMinActActvDly_C EGRVlv_Cal.stTmpDeactv_C EGRVlv_EnhdPosGovCal.tiDebMinMechBnd_C EGRVlv_EnhdPosGovCal.tiDebMaxMechBnd_C EGRVlv_EnhdPosGovCal.rGovDvtThresGovOn_C EGRVlv_EnhdPosGovCal.rGovDvtThresGovDelta_C EGRVlv_EnhdPosGovCal.drDesValFltThresGovOn_C EGRVlv_EnhdPosGovCal.rGovMax_C EGRVlv_EnhdPosGovCal.rGovMin_C EGRVlv_EnhdPosGovCal.rGovLimEffMax_C EGRVlv_EnhdPosGovCal.duCldMov_C EGRVlv_EnhdPosGovCal.rGovMaxExtDem_C EGRVlv_EnhdPosGovCal.iEffMdlHeat_C EGRVlv_EnhdPosGovCal.iEffMdlCool_C EGRVlv_EnhdPosGovCal.stSpLimnDiMask_C EGRVlv_EnhdPosGovCal.numExtArmtrTSel_C EGRVlv_EnhdPosGovCal.tiArmtrFlt_C EGRVlv_EnhdPosGovCal.swtGovByp_C EGRVlv_EnhdPosGovCal.rDesValMaxOff_C EGRVlv_EnhdPosGovCal.rDesValMinOff_C EGRVlv_EnhdPosGovCal.rDesValMin_C EGRVlv_EnhdPosGovCal.rDesValMax_C EGRVlv_EnhdPosGovCal.rGovDesValMin_C EGRVlv_EnhdPosGovCal.rGovDesValMax_C EGRVlv_EnhdPosGovCal.numMdnAvrgSpd_C EGRVlv_EnhdPosGovCal.swtrGovDesVal_C EGRVlv_EnhdPosGovCal.rIniI_C EGRVlv_EnhdPosGovCal.swtRlsLimDeactv_C EGRVlv_LrnTstCal.rDesValMaxLrnATS_C EGRVlv_LrnTstCal.rDesValMinLrnATS_C EGRVlv_LrnTstCal.rCtlRngMaxATS_C EGRVlv_LrnTstCal.rCtlRngMinATS_C EGRVlv_LrnTstCal.tiPerFrstLrn_C EGRVlv_LrnTstCal.tiPerResetLrn_C EGRVlv_PwmOutCal.rMin_C EGRVlv_PwmOutCal.rMax_C EGRVlv_PwmOutCal.swtBattCor_C EGRVlv_SensCal.uCtlRngMax_C EGRVlv_SensCal.uCtlRngMin_C EGRVlv_SensCal.uMin_C EGRVlv_SensCal.uMax_C EGRVlv_SensCal.uAvrgOpn_C EGRVlv_SensCal.uAvrgClsd_C EGRVlv_SensCal.uRefSens_C EGRVlv_SensCal.uRawMinClsd_C EGRVlv_SensCal.uRawMaxClsd_C EGRVlv_SensCal.uRawMinOpn_C EGRVlv_SensCal.uRawMaxOpn_C EGRVlv_SensCal.uRawMinMechBnd_C EGRVlv_SensCal.uRawMaxMechBnd_C EGRVlv_SensCal.uRawMaxElecClsd_C EGRVlv_SensCal.uRawMinElecClsd_C EGRVlv_SensCal.uRawMaxElecOpn_C EGRVlv_SensCal.uRawMinElecOpn_C /end REF_CHARACTERISTIC
 /begin IN_MEASUREMENT AFS_mAirPerCyl CEngDsT_t CoEng_tiNormal DELib_idxArrSnsr DELib_stEepTEngOff DELib_stFirstPreDrvOverCopy DELib_tEngOffEEP DELib_xArrSnsr DevLib_stPwrStgEnaCond EGRVlv_ctrActrDstAVS EGRVlv_flgActrSwtOffReq EGRVlv_flgElecDiagSwtOffReq EGRVlv_nrDesValCnt EGRVlv_numReaMechBnd EGRVlv_pDsbc EGRVlv_pDsbc_mp EGRVlv_rAct EGRVlv_rActSign EGRVlv_rDesVal EGRVlv_rGovDvt EGRVlv_rPs EGRVlv_rSens EGRVlv_stActrDiagDis EGRVlv_stActrROM EGRVlv_stAVSRxRom EGRVlv_stErrInfo EGRVlv_stMon2 EGRVlv_stMon3 EGRVlv_stMonActrPwrStgDrvr EGRVlv_stMonGovrDe EGRVlv_stMonVdSens EGRVlv_swtConf2C EGRVlv_swtConfC EGRVlv_swtConfSwVersC EGRVlv_tActr EGRVlv_tArmtr EGRVlv_tOfsAdjLstLrnClsd EGRVlv_tOfsAdjLstLrnOpn EGRVlv_uRaw EGRVlv_uRelPosClsdLrnFst EGRVlv_uRelPosClsdMaxRom EGRVlv_uRelPosClsdRom EGRVlv_uRelPosOpnLrnFst EGRVlv_uRelPosOpnRom EnvT_t Fan_rPs GlbDa_lTotDst SyC_stPreDrv SyC_stSub SyC_tiFrst10ms VehV_v /end IN_MEASUREMENT
 /begin OUT_MEASUREMENT EGRVlv_ctrActrDst EGRVlv_dHtArmtrHsng EGRVlv_rActTst EGRVlv_rGovMaxTemp EGRVlv_rGovMinTemp EGRVlv_stActrCtrl EGRVlv_stCtrl EGRVlv_stMon EGRVlv_stMonTstr EGRVlv_stTempModActv EGRVlv_tArmtrInit /end OUT_MEASUREMENT
 /begin LOC_MEASUREMENT EGRVlv_cntActrDst_mp EGRVlv_dHtAirSys_mp EGRVlv_dHtCEngFan_mp EGRVlv_dHtEngDaFld_mp EGRVlv_dHtEnvSys_mp EGRVlv_dHtExhFld_mp EGRVlv_dHtHsngEnv_mp EGRVlv_dHtHsng_mp EGRVlv_facClgEngEnvCrvIn_mp EGRVlv_rActNrm EGRVlv_rCmdNrm EGRVlv_rGovDvtNrm EGRVlv_rNrm EGRVlv_stEepWr EGRVlv_tEngTempGradAbs_mp EGRVlv_tEngTempGrad_mp EGRVlv_tHsng EGRVlv_tHsngInit /end LOC_MEASUREMENT
 FUNCTION_VERSION "15.3.0" /end FUNCTION
/begin FUNCTION EGRVlv_DELib_ElecActrVdPosnGovr "11.0.0"
 /begin DEF_CHARACTERISTIC EGRVlv_DTYCYC_ATS.LimitTypeMsk_C EGRVlv_DTYCYC_ATS.CnvNorm_C EGRVlv_DTYCYC_ATS.LowLim_C EGRVlv_DTYCYC_ATS.UpLim_C EGRVlv_DTYCYC_ATS.CnvFac_C EGRVlv_DTYCYC_ATS.CnvOfs_C EGRVlv_DTYCYC_ATS.DfltVal_C EGRVlv_EnhdPosGovCal.tiDebMinMechBnd_C EGRVlv_EnhdPosGovCal.tiDebMaxMechBnd_C EGRVlv_EnhdPosGovCal.rGovDvtThresGovOn_C EGRVlv_EnhdPosGovCal.rGovDvtThresGovDelta_C EGRVlv_EnhdPosGovCal.drDesValFltThresGovOn_C EGRVlv_EnhdPosGovCal.rGovMax_C EGRVlv_EnhdPosGovCal.rGovMin_C EGRVlv_EnhdPosGovCal.rGovLimEffMax_C EGRVlv_EnhdPosGovCal.duCldMov_C EGRVlv_EnhdPosGovCal.rGovMaxExtDem_C EGRVlv_EnhdPosGovCal.iEffMdlHeat_C EGRVlv_EnhdPosGovCal.iEffMdlCool_C EGRVlv_EnhdPosGovCal.stSpLimnDiMask_C EGRVlv_EnhdPosGovCal.numExtArmtrTSel_C EGRVlv_EnhdPosGovCal.tiArmtrFlt_C EGRVlv_EnhdPosGovCal.swtGovByp_C EGRVlv_EnhdPosGovCal.rDesValMaxOff_C EGRVlv_EnhdPosGovCal.rDesValMinOff_C EGRVlv_EnhdPosGovCal.rDesValMin_C EGRVlv_EnhdPosGovCal.rDesValMax_C EGRVlv_EnhdPosGovCal.rGovDesValMin_C EGRVlv_EnhdPosGovCal.rGovDesValMax_C EGRVlv_EnhdPosGovCal.numMdnAvrgSpd_C EGRVlv_EnhdPosGovCal.swtrGovDesVal_C EGRVlv_EnhdPosGovCal.rIniI_C EGRVlv_EnhdPosGovCal.swtRlsLimDeactv_C EGRVlv_PidGovr.facTqLossCmp_CUR EGRVlv_PidGovr.rActrLim2_CUR EGRVlv_PidGovrCal.CoilCompKd_C EGRVlv_PidGovrCal.drDesValMaxIniI_C EGRVlv_PidGovrCal.drDesValMinIniI_C EGRVlv_PidGovrCal.drDesValNegIniI_C EGRVlv_PidGovrCal.drDesValPosIniI_C EGRVlv_PidGovrCal.drDesValRampIPartFrzMax_C EGRVlv_PidGovrCal.drDesValRampIPartFrzMin_C EGRVlv_PidGovrCal.rGovDvtMaxIniI_C EGRVlv_PidGovrCal.rGovDvtMinIniI_C EGRVlv_PidGovrCal.rGovDvtRampIPartFrzMin_C EGRVlv_PidGovrCal.rIntegMax_C EGRVlv_PidGovrCal.rIntegMin_C EGRVlv_PidGovrCal.rOutIMaxIniI_C EGRVlv_PidGovrCal.rOutIMax_C EGRVlv_PidGovrCal.swtDT1In_C EGRVlv_PidGovrCal.tiCoilCompT1_C EGRVlv_PosGovCal.IKiFrcSlp_C EGRVlv_PosGovCal.tiGovDT1_C EGRVlv_PosGovCal.rOutDMax_C EGRVlv_PosGovCal.rGovDvtMaxFrcRmp_C EGRVlv_PosGovCal.rGovDvtFrcInactv_C EGRVlv_PosGovCal.rFrcMax_C EGRVlv_PosGovCal.tiEMFCompT1_C EGRVlv_PosGovCal.EMFCompKd_C EGRVlv_PosGovCal.duRawFrcRmpThres_C EGRVlv_PosGovCal.rOutDFrcRmpThres_C EGRVlv_PosGovCal.tiGovDesMaxIniI_C EGRVlv_PosGovCal.rGovDesMaxIniI_C EGRVlv_PosGovCal.rActMaxIniI_C EGRVlv_PosGovCal.rGovDesMinIniI_C EGRVlv_PosGovCal.rActMinIniI_C EGRVlv_PosGovCal.rGovDesValJmpMin_C EGRVlv_PosGovCal.tiSettle_C EGRVlv_PosGovCal.rGovDvtOscThres_C EGRVlv_PosGovCal.cntOscThres_C EGRVlv_PosGovCal.drGovDesValMinLimI_C EGRVlv_PosGovCal.cntLimI_C EGRVlv_PosGovCal.numTempSel_C EGRVlv_PosGovCal.numPreCtlMapIn_C EGRVlv_PosGovCal.numPreCtlHystIn_C EGRVlv_PosGovCal.numPreCtlCurIn_C EGRVlv_PosGovCal.stLimIniIMask_C EGRVlv_PosGovCal.tiLimIniIRstDly_C EGRVlv_PosGovCal.numPreCtlTemp_C EGRVlv_PosGovCal.tiGovDvtDT1_C EGRVlv_PosGovCal.KdGovDvtDT1_C EGRVlv_PosGovCal.rGovTstMin_C EGRVlv_PosGovCal.rGovTstMax_C EGRVlv_PwmOutCal.rMin_C EGRVlv_PwmOutCal.rMax_C EGRVlv_PwmOutCal.swtBattCor_C EGRVlv_rActrLim_M EGRVlv_ratActLin_CUR EGRVlv_rCnv_CUR EGRVlv_rDflDtyCyc_CUR /end DEF_CHARACTERISTIC
 /begin REF_CHARACTERISTIC EGRVlv_Cal.tiBattCorFacFlt_C EGRVlv_Cal.rDesValFailSafe_C EGRVlv_Cal.slpFailSafePos_C EGRVlv_Cal.slpFailSafeNeg_C EGRVlv_Cal.tiDesValFlt_C EGRVlv_Cal.tiduRawFlt_C EGRVlv_Cal.uFailSafeBattMin_C EGRVlv_Cal.uFailSafeBattMax_C EGRVlv_Cal.uBattMin_C EGRVlv_Cal.uBattMax_C EGRVlv_Cal.uBattMinNoLrn_C EGRVlv_Cal.uBattMaxNoLrn_C EGRVlv_Cal.facCorStrt_C EGRVlv_Cal.numTEng_C EGRVlv_Cal.tEngMin_C EGRVlv_Cal.tEngMax_C EGRVlv_Cal.rCtlRngMin_C EGRVlv_Cal.rCtlRngMax_C EGRVlv_Cal.tiTempErrOk_C EGRVlv_Cal.rActActrActv_C EGRVlv_Cal.tiSoftShOff_C EGRVlv_Cal.rDesValSoftShOff_C EGRVlv_Cal.stActrDiaDis_C EGRVlv_Cal.stActrDis_C EGRVlv_Cal.numTempErrDef_C EGRVlv_Cal.swtNrmInv_C EGRVlv_Cal.rPwrStgDis_C EGRVlv_Cal.tAirSysFldMin_C EGRVlv_Cal.tAirSysFldMax_C EGRVlv_Cal.tExhFldMin_C EGRVlv_Cal.tExhFldMax_C EGRVlv_Cal.tEngDaFldMin_C EGRVlv_Cal.tEngDaFldMax_C EGRVlv_Cal.numExhTempDesVal_C EGRVlv_Cal.numAirTempDesVal_C EGRVlv_Cal.numEngDaTempDesVal_C EGRVlv_Cal.numTemp4_C EGRVlv_Cal.tiIni_C EGRVlv_Cal.rDesValIniStdBy_C EGRVlv_Cal.rDesValIni_C EGRVlv_Cal.tiDflDtyCyc_C EGRVlv_Cal.tidrDesValFlt_C EGRVlv_Cal.rDesValCntMinThrd_C EGRVlv_Cal.swtRstrDesValCnt_C EGRVlv_Cal.swtActvn_C EGRVlv_Cal.swtDeactvnMask_C EGRVlv_Cal.duMovDet_C EGRVlv_Cal.tiNMinActActvDly_C EGRVlv_Cal.stTmpDeactv_C EGRVlv_LrnTstCal.rDesValMaxLrnATS_C EGRVlv_LrnTstCal.rDesValMinLrnATS_C EGRVlv_LrnTstCal.rCtlRngMaxATS_C EGRVlv_LrnTstCal.rCtlRngMinATS_C EGRVlv_LrnTstCal.tiPerFrstLrn_C EGRVlv_LrnTstCal.tiPerResetLrn_C EGRVlv_SensCal.uCtlRngMax_C EGRVlv_SensCal.uCtlRngMin_C EGRVlv_SensCal.uMin_C EGRVlv_SensCal.uMax_C EGRVlv_SensCal.uAvrgOpn_C EGRVlv_SensCal.uAvrgClsd_C EGRVlv_SensCal.uRefSens_C EGRVlv_SensCal.uRawMinClsd_C EGRVlv_SensCal.uRawMaxClsd_C EGRVlv_SensCal.uRawMinOpn_C EGRVlv_SensCal.uRawMaxOpn_C EGRVlv_SensCal.uRawMinMechBnd_C EGRVlv_SensCal.uRawMaxMechBnd_C EGRVlv_SensCal.uRawMaxElecClsd_C EGRVlv_SensCal.uRawMinElecClsd_C EGRVlv_SensCal.uRawMaxElecOpn_C EGRVlv_SensCal.uRawMinElecOpn_C /end REF_CHARACTERISTIC
 /begin IN_MEASUREMENT CoEng_st EGRVlv_drDesVal EGRVlv_drDesValFlt EGRVlv_duRawUnFild EGRVlv_facCorFlt EGRVlv_flgPwrStgReq EGRVlv_rAct EGRVlv_rDesVal EGRVlv_rEMFComp EGRVlv_rFildSpFil EGRVlv_rFricGovrInp EGRVlv_rGovDesVal EGRVlv_rGovMaxTemp EGRVlv_rGovMinTemp EGRVlv_rGovrActrHeal EGRVlv_rGovrMaxInp EGRVlv_rGovrMinInp EGRVlv_rHysCmpGovrInp EGRVlv_rPreCtlVal EGRVlv_rUnCmpdGovActr EGRVlv_stIniI EGRVlv_stMon EGRVlv_stMon2 EGRVlv_stMon3 EGRVlv_stMonActrPwrStgDrvr EGRVlv_swtConf2C EGRVlv_swtConf3C EGRVlv_swtConfC EGRVlv_swtConfSwVersC EGRVlv_tActr EGRVlv_tiRawFlt EGRVlv_uRaw /end IN_MEASUREMENT
 /begin OUT_MEASUREMENT EGRVlv_duRaw EGRVlv_rActr EGRVlv_rActrLim EGRVlv_ratActPosnB1 EGRVlv_rFrc EGRVlv_rGovActr EGRVlv_rGovDvt EGRVlv_rOutDRaw EGRVlv_rOutI EGRVlv_rOutP EGRVlv_rPs EGRVlv_stLimIniI EGRVlv_stMonGovr EGRVlv_stPs EGRVlv_tiDfltMov EGRVlv_tiPeriod /end OUT_MEASUREMENT
 /begin LOC_MEASUREMENT EGRVlv_numSigID_mp EGRVlv_PidGovr.tActrfacTqLossCmpCurInp EGRVlv_PidGovr.uRawrActrLim2CurInp EGRVlv_rCnv_mp EGRVlv_rCoilComp EGRVlv_rGovMax EGRVlv_rGovMin EGRVlv_rOutD EGRVlv_stLimIniI_mp /end LOC_MEASUREMENT
 FUNCTION_VERSION "11.0.0" /end FUNCTION
/begin COMPU_METHOD AirMassPerCyl "" RAT_FUNC "%6.3" "mg/Hub" COEFFS 0 10 0 0 0 1 /end COMPU_METHOD
/begin COMPU_METHOD B_TRUE "" TAB_VERB "%6.3" "" COMPU_TAB_REF B_TRUE /end COMPU_METHOD
/begin COMPU_VTAB B_TRUE "" TAB_VERB 2 0 "FALSE" 1 "TRUE" /end COMPU_VTAB
/begin COMPU_METHOD Curr_A_q0p03125_COMPU "" RAT_FUNC "%6.4" "A" COEFFS 0 32 0 0 0 1 /end COMPU_METHOD
/begin COMPU_METHOD DELibPreCtlInSel_VERB "" TAB_VERB "%6.3" "" COMPU_TAB_REF DELibPreCtlInSel_VERB /end COMPU_METHOD
/begin COMPU_VTAB DELibPreCtlInSel_VERB "" TAB_VERB 3 0 "DESVAL" 1 "GOVDESVAL" 2 "RACT" /end COMPU_VTAB
/begin COMPU_METHOD DELIB_ALLTEMP_VERB_COMPU "" TAB_VERB "%6.3" "" COMPU_TAB_REF DELIB_ALLTEMP_VERB_COMPU /end COMPU_METHOD
/begin COMPU_VTAB DELIB_ALLTEMP_VERB_COMPU "" TAB_VERB 11 5 "CENGDST" 15 "CENGUST" 20 "ENGDATENG" 0 "ENVT" 7 "FUELT" 55 "INTKAIRT" 82 "OILSWMPT" 17 "TEGRCLRLPDS" 25 "NRCAT" 254 "DFLTEMP" 255 "NOTEMP" /end COMPU_VTAB
/begin COMPU_METHOD DtyCyc "" RAT_FUNC "%6.4" "%" COEFFS 0 100 0 0 0 1 /end COMPU_METHOD
/begin COMPU_METHOD EngN "" RAT_FUNC "%6.3" "rpm" COEFFS 0 2 0 0 0 1 /end COMPU_METHOD
/begin COMPU_METHOD EngN1 "" RAT_FUNC "%6.3" "rpm" COEFFS 0 2 0 0 0 1 /end COMPU_METHOD
/begin COMPU_METHOD EXHMOD_PEXHMDLCFG_SC_Compu "" TAB_VERB "%6.3" "" COMPU_TAB_REF EXHMOD_PEXHMDLCFG_SC_Compu /end COMPU_METHOD
/begin COMPU_VTAB EXHMOD_PEXHMDLCFG_SC_Compu "" TAB_VERB 4 0 "0" 1 "1" 2 "2" 3 "3" /end COMPU_VTAB
/begin COMPU_METHOD EXHMOD_POSNCATGPF_SC_Compu "" TAB_VERB "%6.3" "" COMPU_TAB_REF EXHMOD_POSNCATGPF_SC_Compu /end COMPU_METHOD
/begin COMPU_VTAB EXHMOD_POSNCATGPF_SC_Compu "" TAB_VERB 6 0 "GPF_NO" 1 "GPF_CAT1" 2 "GPF_CAT2" 3 "GPF_CAT3" 4 "GPF_CAT4" 5 "GPF_CAT5" /end COMPU_VTAB
/begin COMPU_METHOD EXHMOD_SELNENGSTOPTI_SC_Compu "" TAB_VERB "%6.3" "" COMPU_TAB_REF EXHMOD_SELNENGSTOPTI_SC_Compu /end COMPU_METHOD
/begin COMPU_VTAB EXHMOD_SELNENGSTOPTI_SC_Compu "" TAB_VERB 3 0 "0" 1 "1" 2 "2" /end COMPU_VTAB
/begin COMPU_METHOD EXHMOD_STPWRHEATEXT_SC_Compu "" TAB_VERB "%6.3" "" COMPU_TAB_REF EXHMOD_STPWRHEATEXT_SC_Compu /end COMPU_METHOD
/begin COMPU_VTAB EXHMOD_STPWRHEATEXT_SC_Compu "" TAB_VERB 2 0 "False" 1 "True" /end COMPU_VTAB
/begin COMPU_METHOD EXHMOD_STTPISTCALCN_SC_Compu "" TAB_VERB "%6.3" "" COMPU_TAB_REF EXHMOD_STTPISTCALCN_SC_Compu /end COMPU_METHOD
/begin COMPU_VTAB EXHMOD_STTPISTCALCN_SC_Compu "" TAB_VERB 2 1 "TExhVlv_Imp" 2 "TExhVlv_Selectable" /end COMPU_VTAB
/begin COMPU_METHOD EXHMOD_TEXHFLTD_SC_Compu "" TAB_VERB "%6.3" "" COMPU_TAB_REF EXHMOD_TEXHFLTD_SC_Compu /end COMPU_METHOD
/begin COMPU_VTAB EXHMOD_TEXHFLTD_SC_Compu "" TAB_VERB 2 0 "False" 1 "True" /end COMPU_VTAB
/begin COMPU_METHOD EXHMOD_TMDLCATAGICORRN_SC_Compu "" TAB_VERB "%6.3" "" COMPU_TAB_REF EXHMOD_TMDLCATAGICORRN_SC_Compu /end COMPU_METHOD
/begin COMPU_VTAB EXHMOD_TMDLCATAGICORRN_SC_Compu "" TAB_VERB 2 0 "False" 1 "True" /end COMPU_VTAB
/begin COMPU_METHOD EXHMOD_TMDLSEPCANN_SC_Compu "" TAB_VERB "%6.3" "" COMPU_TAB_REF EXHMOD_TMDLSEPCANN_SC_Compu /end COMPU_METHOD
/begin COMPU_VTAB EXHMOD_TMDLSEPCANN_SC_Compu "" TAB_VERB 3 0 "0" 1 "1" 2 "2" /end COMPU_VTAB
/begin COMPU_METHOD EXHMOD_TMDLTC_SC_Compu "" TAB_VERB "%6.3" "" COMPU_TAB_REF EXHMOD_TMDLTC_SC_Compu /end COMPU_METHOD
/begin COMPU_VTAB EXHMOD_TMDLTC_SC_Compu "" TAB_VERB 3 0 "0" 1 "1" 2 "2" /end COMPU_VTAB
/begin COMPU_METHOD EXHMOD_TMDLTSNSRCMPTMT_SC_Compu "" TAB_VERB "%6.3" "" COMPU_TAB_REF EXHMOD_TMDLTSNSRCMPTMT_SC_Compu /end COMPU_METHOD
/begin COMPU_VTAB EXHMOD_TMDLTSNSRCMPTMT_SC_Compu "" TAB_VERB 2 0 "False" 1 "True" /end COMPU_VTAB
/begin COMPU_METHOD EXHMOD_TMDLVAIRCMPTMT_SC_Compu "" TAB_VERB "%6.3" "" COMPU_TAB_REF EXHMOD_TMDLVAIRCMPTMT_SC_Compu /end COMPU_METHOD
/begin COMPU_VTAB EXHMOD_TMDLVAIRCMPTMT_SC_Compu "" TAB_VERB 2 0 "False" 1 "True" /end COMPU_VTAB
/begin COMPU_METHOD EXHMOD_TPISTMDL_SC_Compu "" TAB_VERB "%6.3" "" COMPU_TAB_REF EXHMOD_TPISTMDL_SC_Compu /end COMPU_METHOD
/begin COMPU_VTAB EXHMOD_TPISTMDL_SC_Compu "" TAB_VERB 2 0 "No_piston_model" 1 "Piston_model" /end COMPU_VTAB
/begin COMPU_METHOD EXHMOD_TSPS1_SC_Compu "" TAB_VERB "%6.3" "" COMPU_TAB_REF EXHMOD_TSPS1_SC_Compu /end COMPU_METHOD
/begin COMPU_VTAB EXHMOD_TSPS1_SC_Compu "" TAB_VERB 2 0 "False" 1 "True" /end COMPU_VTAB
/begin COMPU_METHOD EXHMOD_TSPS2_SC_Compu "" TAB_VERB "%6.3" "" COMPU_TAB_REF EXHMOD_TSPS2_SC_Compu /end COMPU_METHOD
/begin COMPU_VTAB EXHMOD_TSPS2_SC_Compu "" TAB_VERB 2 0 "False" 1 "True" /end COMPU_VTAB
/begin COMPU_METHOD EXHMOD_TSPS3_SC_Compu "" TAB_VERB "%6.3" "" COMPU_TAB_REF EXHMOD_TSPS3_SC_Compu /end COMPU_METHOD
/begin COMPU_VTAB EXHMOD_TSPS3_SC_Compu "" TAB_VERB 2 0 "False" 1 "True" /end COMPU_VTAB
/begin COMPU_METHOD EXHMOD_TTHDLIOFFVBL_SC_Compu "" TAB_VERB "%6.3" "" COMPU_TAB_REF EXHMOD_TTHDLIOFFVBL_SC_Compu /end COMPU_METHOD
/begin COMPU_VTAB EXHMOD_TTHDLIOFFVBL_SC_Compu "" TAB_VERB 2 0 "DISABLE" 1 "ENABLE" /end COMPU_VTAB
/begin COMPU_METHOD EXHMOD_TVLVCORRNOFFS_SC_Compu "" TAB_VERB "%6.3" "" COMPU_TAB_REF EXHMOD_TVLVCORRNOFFS_SC_Compu /end COMPU_METHOD
/begin COMPU_VTAB EXHMOD_TVLVCORRNOFFS_SC_Compu "" TAB_VERB 2 0 "False" 1 "True" /end COMPU_VTAB
/begin COMPU_METHOD EXHMOD_TVLVDYN_SC_Compu "" TAB_VERB "%6.3" "" COMPU_TAB_REF EXHMOD_TVLVDYN_SC_Compu /end COMPU_METHOD
/begin COMPU_VTAB EXHMOD_TVLVDYN_SC_Compu "" TAB_VERB 3 0 "use_feature_conventional_model(low_pass)" 1 "use_feature_bridge_model" 2 "Conventional_or_bridge_model_can_be_chosen_via_CW" /end COMPU_VTAB
/begin COMPU_METHOD EXHMOD_TWNFLOWENGOUTL_SC_Compu "" TAB_VERB "%6.3" "" COMPU_TAB_REF EXHMOD_TWNFLOWENGOUTL_SC_Compu /end COMPU_METHOD
/begin COMPU_VTAB EXHMOD_TWNFLOWENGOUTL_SC_Compu "" TAB_VERB 2 0 "False" 1 "True" /end COMPU_VTAB
/begin COMPU_METHOD EXHMOD_VAR_SY_Compu "" TAB_VERB "%6.3" "" COMPU_TAB_REF EXHMOD_VAR_SY_Compu /end COMPU_METHOD
/begin COMPU_VTAB EXHMOD_VAR_SY_Compu "" TAB_VERB 48 1 "DAI" 3 "VWW" 4 "POR" 5 "AUD" 6 "OPE" 9 "FIA" 11 "BMW" 14 "PSA" 15 "REN" 17 "ALF" 18 "SAB" 19 "VOL" 20 "NIS" 21 "GMU" 22 "FOR" 26 "IMJ" 51 "SEA" 53 "CHR" 54 "JAG" 55 "ROL" 69 "FER" 72 "TOY" 123 "MIT" 147 "HYU" 159 "HON" 160 "MAZ" 183 "CU" 190 "LRG" 204 "VVW" 214 "AVT" 242 "Iveco" 243 "DMC" 248 "SUZ" 270 "KEF" 289 "AMG" 308 "TAT" 319 "MVM" 328 "MM" 385 "UAES" 590 "Scania" 828 "RBCD" 898 "MFTBC" 944 "DOOSAN" 984 "FAW" 999 "ALL" 2887 "Nonox" 9454 "Fuso" 9707 "HATZ" /end COMPU_VTAB
/begin COMPU_METHOD EXHMOD_VIRTMF_SC_Compu "" TAB_VERB "%6.3" "" COMPU_TAB_REF EXHMOD_VIRTMF_SC_Compu /end COMPU_METHOD
/begin COMPU_VTAB EXHMOD_VIRTMF_SC_Compu "" TAB_VERB 2 0 "False" 1 "True" /end COMPU_VTAB
/begin COMPU_METHOD EXHMOD_WTRCOOLGMNFLD_SC_Compu "" TAB_VERB "%6.3" "" COMPU_TAB_REF EXHMOD_WTRCOOLGMNFLD_SC_Compu /end COMPU_METHOD
/begin COMPU_VTAB EXHMOD_WTRCOOLGMNFLD_SC_Compu "" TAB_VERB 2 0 "False" 1 "True" /end COMPU_VTAB
/begin COMPU_METHOD EXHMOD_WTRMDL_SC_Compu "" TAB_VERB "%6.3" "" COMPU_TAB_REF EXHMOD_WTRMDL_SC_Compu /end COMPU_METHOD
/begin COMPU_VTAB EXHMOD_WTRMDL_SC_Compu "" TAB_VERB 2 0 "No_water_model" 1 "Water_model" /end COMPU_VTAB
/begin COMPU_METHOD EXHTEMP_CT_SENSORS_Compu "" TAB_VERB "%6.3" "" COMPU_TAB_REF EXHTEMP_CT_SENSORS_Compu /end COMPU_METHOD
/begin COMPU_VTAB EXHTEMP_CT_SENSORS_Compu "" TAB_VERB 13 1 "ONE" 8 "EIGHT" 9 "NINE" 10 "TEN" 11 "ELEVEN" 12 "TWELVE" 13 "THIRTEEN" 15 "FIFTEEN" 16 "SIXTEEN" 20 "TWENTY" 21 "TWENTY_ONE" 28 "TWENTYEIGHT" 30 "THIRTY" /end COMPU_VTAB
/begin COMPU_METHOD EXHVLV_AIRACTR_SC_Compu "" TAB_VERB "%6.3" "" COMPU_TAB_REF EXHVLV_AIRACTR_SC_Compu /end COMPU_METHOD
/begin COMPU_VTAB EXHVLV_AIRACTR_SC_Compu "" TAB_VERB 2 0 "False" 1 "True" /end COMPU_VTAB
/begin COMPU_METHOD EXH_SWTSENSPRSTPFLTDS_SY_Compu "" TAB_VERB "%6.3" "" COMPU_TAB_REF EXH_SWTSENSPRSTPFLTDS_SY_Compu /end COMPU_METHOD
/begin COMPU_VTAB EXH_SWTSENSPRSTPFLTDS_SY_Compu "" TAB_VERB 3 0 "0" 1 "1" 2 "2" /end COMPU_VTAB
/begin COMPU_METHOD EXH_SWTSENSPRSTPFLTUS_SY_Compu "" TAB_VERB "%6.3" "" COMPU_TAB_REF EXH_SWTSENSPRSTPFLTUS_SY_Compu /end COMPU_METHOD
/begin COMPU_VTAB EXH_SWTSENSPRSTPFLTUS_SY_Compu "" TAB_VERB 2 0 "FALSE" 1 "TRUE" /end COMPU_VTAB
/begin COMPU_METHOD EXTDTCOORR_SC_Compu "" TAB_VERB "%6.3" "" COMPU_TAB_REF EXTDTCOORR_SC_Compu /end COMPU_METHOD
/begin COMPU_VTAB EXTDTCOORR_SC_Compu "" TAB_VERB 2 0 "False" 1 "True" /end COMPU_VTAB
/begin COMPU_METHOD EXTENGSTRT_SY_Compu "" TAB_VERB "%6.3" "" COMPU_TAB_REF EXTENGSTRT_SY_Compu /end COMPU_METHOD
/begin COMPU_VTAB EXTENGSTRT_SY_Compu "" TAB_VERB 2 0 "0" 1 "1" /end COMPU_VTAB
/begin COMPU_METHOD EXTFULVLSRC_SC_Compu "" TAB_VERB "%6.3" "" COMPU_TAB_REF EXTFULVLSRC_SC_Compu /end COMPU_METHOD
/begin COMPU_VTAB EXTFULVLSRC_SC_Compu "" TAB_VERB 2 0 "0" 1 "1" /end COMPU_VTAB
/begin COMPU_METHOD FacReactVel_COMPU "" RAT_FUNC "%6.2" "mol/s/m" COEFFS 0 1 0 0 0 1 /end COMPU_METHOD
/begin COMPU_METHOD FacReactVel_q100p0_COMPU "" RAT_FUNC "%6.0" "mol/s/m" COEFFS 0 0.01 0 0 0 1 /end COMPU_METHOD
/begin COMPU_METHOD Fact "" RAT_FUNC "%6.5" "-" COEFFS 0 8192 0 0 0 1 /end COMPU_METHOD
/begin COMPU_METHOD Fact16384_COMPU "" RAT_FUNC "%7.6" "%/hPa" COEFFS 0 16384 0 0 0 1 /end COMPU_METHOD
/begin COMPU_METHOD Fact255_COMPU "" RAT_FUNC "%6.4" "-" COEFFS 0 255 0 0 0 1 /end COMPU_METHOD
/begin COMPU_METHOD Fact256 "" RAT_FUNC "%6.4" "-" COEFFS 0 256 0 0 0 1 /end COMPU_METHOD
/begin COMPU_METHOD Fact5 "" RAT_FUNC "%6.3" "-" COEFFS 0 2 0 0 0 1 /end COMPU_METHOD
/begin COMPU_METHOD Fact6 "" RAT_FUNC "%6.4" "-" COEFFS 0 500 0 0 0 1 /end COMPU_METHOD
/begin COMPU_METHOD Fact7 "" RAT_FUNC "%10.9" "-" COEFFS 0 10000000 0 0 0 1 /end COMPU_METHOD
/begin COMPU_METHOD Fact8 "" RAT_FUNC "%11.10" "-" COEFFS 0 100000000 0 0 0 1 /end COMPU_METHOD
/begin COMPU_METHOD Fact9 "" RAT_FUNC "%6.5" "-" COEFFS 0 5000 0 0 0 1 /end COMPU_METHOD
/begin COMPU_METHOD FactFine "" RAT_FUNC "%9.8" "-" COEFFS 0 1000000 0 0 0 1 /end COMPU_METHOD
/begin COMPU_METHOD FactLow1 "" RAT_FUNC "%6.4" "-" COEFFS 0 25 0 0 0 1 /end COMPU_METHOD
/begin COMPU_METHOD FactRev "" RAT_FUNC "%6.3" "-" COEFFS 0 10 0 0 0 1 /end COMPU_METHOD
/begin COMPU_METHOD Fact_100000 "" RAT_FUNC "%8.7" "-" COEFFS 0 100000 0 0 0 1 /end COMPU_METHOD
/begin COMPU_METHOD Fact_EGT "" RAT_FUNC "%6.5" "-" COEFFS 0 1000 0 0 0 1 /end COMPU_METHOD
/begin COMPU_METHOD Fact_NSC "" RAT_FUNC "%6.5" "-" COEFFS 0 1000 0 0 0 1 /end COMPU_METHOD
/begin COMPU_METHOD Fact_NSCEff "" RAT_FUNC "%7.6" "-" COEFFS 0 10000 0 0 0 1 /end COMPU_METHOD
/begin COMPU_METHOD Fact_q6554p0_COMPU "" RAT_FUNC "%7.0" "-" COEFFS 0 0.000152578577967653 0 0 0 1 /end COMPU_METHOD
/begin COMPU_METHOD Fact_SOx1 "" RAT_FUNC "%9.8" "-" COEFFS 0 1000000 0 0 0 1 /end COMPU_METHOD
/begin COMPU_METHOD Fact_VolNSC "" RAT_FUNC "%9.8" "-" COEFFS 0 1000000 0 0 0 1 /end COMPU_METHOD
/begin COMPU_METHOD Fac_q0p0001_COMPU "" RAT_FUNC "%7.6" "-" COEFFS 0 10000 0 0 0 1 /end COMPU_METHOD
/begin COMPU_METHOD InjMass "" RAT_FUNC "%6.4" "mg/hub" COEFFS 0 100 0 0 0 1 /end COMPU_METHOD
/begin COMPU_METHOD Kd_1 "" RAT_FUNC "%6.4" "1/1" COEFFS 0 512 0 0 0 1 /end COMPU_METHOD
/begin COMPU_METHOD Ki "" RAT_FUNC "%6.5" "1/s" COEFFS 0 2147.483648 0 0 0 1 /end COMPU_METHOD
/begin COMPU_METHOD OneToOne "" RAT_FUNC "%6.2" "-" COEFFS 0 1 0 0 0 1 /end COMPU_METHOD
/begin COMPU_METHOD Pos_Prc_float "" RAT_FUNC "%6.2" "%" COEFFS 0 1 0 0 0 1 /end COMPU_METHOD
/begin COMPU_METHOD Prc "" RAT_FUNC "%6.4" "%" COEFFS 0 81.92 0 0 0 1 /end COMPU_METHOD
/begin COMPU_METHOD PrcSec "" RAT_FUNC "%6.4" "%/s" COEFFS 0 81.92 0 0 0 1 /end COMPU_METHOD
/begin COMPU_METHOD Prc_q0p392157_COMPU "" RAT_FUNC "%6.3" "%" COEFFS 0 255 0 0 0 100 /end COMPU_METHOD
/begin COMPU_METHOD Prc_sint8 "" RAT_FUNC "%6.2" "%" COEFFS 0 0.64 0 0 0 1 /end COMPU_METHOD
/begin COMPU_METHOD Pres_hPa "" RAT_FUNC "%6.2" "hPa" COEFFS 0 1 0 0 0 1 /end COMPU_METHOD
/begin COMPU_METHOD Pwr_q0p01_COMPU "" RAT_FUNC "%6.4" "W" COEFFS 0 100 0 0 0 1 /end COMPU_METHOD
/begin COMPU_METHOD q0p00001_degC_DIV_W "" RAT_FUNC "%8.7" "degC/W" COEFFS 0 100000 0 0 0 1 /end COMPU_METHOD
/begin COMPU_METHOD q100_ms "" RAT_FUNC "%6.0" "ms" COEFFS 0 1 0 0 0 100 /end COMPU_METHOD
/begin COMPU_METHOD q10_mV_DIV_s "" RAT_FUNC "%6.1" "mV/s" COEFFS 0 1 0 0 0 10 /end COMPU_METHOD
/begin COMPU_METHOD q1Em4_s "" RAT_FUNC "%7.6" "s" COEFFS 0 10000 0 0 0 1 /end COMPU_METHOD
/begin COMPU_METHOD rel_q0p0078125 "" RAT_FUNC "%6.4" "%" COEFFS 0 128 0 0 0 1 /end COMPU_METHOD
/begin COMPU_METHOD rel_q0p78_o100 "" RAT_FUNC "%6.4" "%" COEFFS 0 256 25600 0 0 200 /end COMPU_METHOD
/begin COMPU_METHOD RmpPrc "" RAT_FUNC "%6.5" "%/s" COEFFS 0 5368.70912 0 0 0 1 /end COMPU_METHOD
/begin COMPU_METHOD RmpPrc16 "" RAT_FUNC "%6.4" "%/s" COEFFS 0 41.94304 0 0 0 1 /end COMPU_METHOD
/begin COMPU_METHOD TempDiff_Kelv "" RAT_FUNC "%6.3" "K" COEFFS 0 10 0 0 0 1 /end COMPU_METHOD
/begin COMPU_METHOD Temp_Cels "" RAT_FUNC "%6.1" "deg C" COEFFS 0 10 2731.4 0 0 1 /end COMPU_METHOD
/begin COMPU_METHOD TimeDelay_s "" RAT_FUNC "%6.1" "s" COEFFS 0 0 1 0 0.00023283064365387 0 /end COMPU_METHOD
/begin COMPU_METHOD TimeDelay_s_2 "" RAT_FUNC "%13.6" "s" COEFFS 0 0 1 0 0.0596046447753906 0 /end COMPU_METHOD
/begin COMPU_METHOD TimeDT "" RAT_FUNC "%6.2" "us" COEFFS 0 1 0 0 0 1 /end COMPU_METHOD
/begin COMPU_METHOD Time_ms "" RAT_FUNC "%6.1" "ms" COEFFS 0 0.1 0 0 0 1 /end COMPU_METHOD
/begin COMPU_METHOD Time_msec_q10_COMPU "" RAT_FUNC "%6.1" "ms" COEFFS 0 1 0 0 0 10 /end COMPU_METHOD
/begin COMPU_METHOD Time_msec_q1_COMPU "" RAT_FUNC "%6.2" "ms" COEFFS 0 1 0 0 0 1 /end COMPU_METHOD
/begin COMPU_METHOD Time_s "" RAT_FUNC "%6.4" "s" COEFFS 0 100 0 0 0 1 /end COMPU_METHOD
/begin COMPU_METHOD Time_sec_q1_COMPU "" RAT_FUNC "%6.2" "s" COEFFS 0 1 0 0 0 1 /end COMPU_METHOD
/begin COMPU_METHOD Time_sec_q5p0_COMPU "" RAT_FUNC "%6.2" "s" COEFFS 0 1 0 0 0 5 /end COMPU_METHOD
/begin COMPU_METHOD Time_s_100us "" RAT_FUNC "%7.6" "s" COEFFS 0 10000 0 0 0 1 /end COMPU_METHOD
/begin COMPU_METHOD Time_usec_q1_COMPU "" RAT_FUNC "%6.2" "us" COEFFS 0 1 0 0 0 1 /end COMPU_METHOD
/begin COMPU_METHOD Vel "" RAT_FUNC "%6.4" "km/h" COEFFS 0 100 0 0 0 1 /end COMPU_METHOD
/begin COMPU_METHOD VlvVel "" RAT_FUNC "%6.3" "%/s" COEFFS 0 8.192 0 0 0 1 /end COMPU_METHOD
/begin COMPU_METHOD Volt "" RAT_FUNC "%6.3" "mV" COEFFS 0 5 0 0 0 1 /end COMPU_METHOD
/begin COMPU_METHOD Volt_Batt "" RAT_FUNC "%6.1" "mV" COEFFS 0 0.05 0 0 0 1 /end COMPU_METHOD
/begin COMPU_METHOD WattTempCels_q0p01_COMPU "" RAT_FUNC "%6.4" "W/deg C" COEFFS 0 100 0 0 0 1 /end COMPU_METHOD
/begin RECORD_LAYOUT Cur_Xs16Ws16 NO_AXIS_PTS_X 1 SWORD AXIS_PTS_X 2 SWORD INDEX_INCR DIRECT FNC_VALUES 3 SWORD COLUMN_DIR DIRECT /end RECORD_LAYOUT
/begin RECORD_LAYOUT Kw_Ws16 FNC_VALUES 1 SWORD COLUMN_DIR DIRECT /end RECORD_LAYOUT
/begin RECORD_LAYOUT Kw_Wu32 FNC_VALUES 1 ULONG COLUMN_DIR DIRECT /end RECORD_LAYOUT
/begin RECORD_LAYOUT Kw_Wu8 FNC_VALUES 1 UBYTE COLUMN_DIR DIRECT /end RECORD_LAYOUT
/begin RECORD_LAYOUT Map_Xs16Ys16Ws16 NO_AXIS_PTS_X 1 SWORD NO_AXIS_PTS_Y 2 SWORD AXIS_PTS_X 3 SWORD INDEX_INCR DIRECT AXIS_PTS_Y 4 SWORD INDEX_INCR DIRECT FNC_VALUES 5 SWORD COLUMN_DIR DIRECT /end RECORD_LAYOUT
/begin RECORD_LAYOUT RB_Curve_S16_S16 NO_AXIS_PTS_X 1 SWORD AXIS_PTS_X 2 SWORD INDEX_INCR DIRECT FNC_VALUES 3 SWORD COLUMN_DIR DIRECT /end RECORD_LAYOUT
/begin RECORD_LAYOUT RB_Map_S16S16_S16 NO_AXIS_PTS_X 1 SWORD NO_AXIS_PTS_Y 2 SWORD AXIS_PTS_X 3 SWORD INDEX_INCR DIRECT AXIS_PTS_Y 4 SWORD INDEX_INCR DIRECT FNC_VALUES 5 SWORD COLUMN_DIR DIRECT /end RECORD_LAYOUT
/begin RECORD_LAYOUT RB_Val_Ws16 FNC_VALUES 1 SWORD COLUMN_DIR DIRECT /end RECORD_LAYOUT
/begin RECORD_LAYOUT RB_Val_Ws8 FNC_VALUES 1 SBYTE COLUMN_DIR DIRECT /end RECORD_LAYOUT
/begin RECORD_LAYOUT RB_Val_Wu16 FNC_VALUES 1 UWORD COLUMN_DIR DIRECT /end RECORD_LAYOUT
/begin RECORD_LAYOUT RB_Val_Wu8 FNC_VALUES 1 UBYTE COLUMN_DIR DIRECT /end RECORD_LAYOUT
/begin RECORD_LAYOUT ValA_Ws16 FNC_VALUES 1 SWORD COLUMN_DIR DIRECT /end RECORD_LAYOUT
/begin RECORD_LAYOUT ValA_Wu8 FNC_VALUES 1 UBYTE COLUMN_DIR DIRECT /end RECORD_LAYOUT
/begin RECORD_LAYOUT Val_Ws16 FNC_VALUES 1 SWORD COLUMN_DIR DIRECT /end RECORD_LAYOUT
/begin RECORD_LAYOUT Val_Ws32 FNC_VALUES 1 SLONG COLUMN_DIR DIRECT /end RECORD_LAYOUT
/begin RECORD_LAYOUT Val_Ws8 FNC_VALUES 1 SBYTE COLUMN_DIR DIRECT /end RECORD_LAYOUT
/begin RECORD_LAYOUT Val_Wu16 FNC_VALUES 1 UWORD COLUMN_DIR DIRECT /end RECORD_LAYOUT
/begin RECORD_LAYOUT Val_Wu32 FNC_VALUES 1 ULONG COLUMN_DIR DIRECT /end RECORD_LAYOUT
/begin RECORD_LAYOUT Val_Wu8 FNC_VALUES 1 UBYTE COLUMN_DIR DIRECT /end RECORD_LAYOUT
/end MODULE
/end PROJECT
