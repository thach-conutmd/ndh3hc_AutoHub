ASAP2_VERSION 1 60
/begin PROJECT MG1CS022 "MG1CS022"
/begin HEADER "" VERSION "MG1CS022_62XSC_V037_TPROT" PROJECT_NO MG1CS022 /end HEADER
/begin MODULE DIM ""
/begin MOD_COMMON "" BYTE_ORDER MSB_LAST ALIGNMENT_BYTE 1 ALIGNMENT_WORD 2 ALIGNMENT_LONG 4 ALIGNMENT_INT64 4 ALIGNMENT_FLOAT32_IEEE 4 ALIGNMENT_FLOAT64_IEEE 4 DATA_SIZE 32 /end MOD_COMMON
/begin CHARACTERISTIC Com_ctCRingEPB_C "Calibration for EPB Ring Counter Message." VALUE 0x8053F2BC Val_Wu8 3.000 OneToOne 0.00 3.000 FORMAT "%5.3" EXTENDED_LIMITS 0.00 255.0 /end CHARACTERISTIC
/begin CHARACTERISTIC Com_dEPBMaxDiff_C "Application constant for Maximum difference for EPB frame" VALUE 0x8053F2C0 Val_Wu32 4294967295.00 OneToOne 0.00 4294967295.00 FORMAT "%13.2" /end CHARACTERISTIC
/begin CHARACTERISTIC Com_dEPBMaxPer_C "Period for EPB frame" VALUE 0x8053F2C4 Val_Wu32 4294967295.00 OneToOne 0.00 4294967295.00 FORMAT "%13.2" /end CHARACTERISTIC
/begin CHARACTERISTIC Com_numCsumEPB_C "Default value for Checksum message for EPB frame in case of defective reception." VALUE 0x8053F2C8 Val_Wu8 15.00 OneToOne 0.00 15.00 FORMAT "%5.2" EXTENDED_LIMITS 0.00 255.0 /end CHARACTERISTIC
/begin CHARACTERISTIC EngTrqPtd_facSpdGovMax_CUR "engine speed dependent factor for limitation of maximum idle speed governor torque" CURVE 0x805447D8 RB_Curve_S16_U16_Static 1.000000 Fact 0.00 1.000000 FORMAT "%8.6" EXTENDED_LIMITS 0.00 7.999878
 /begin AXIS_DESCR STD_AXIS Epm_nEng EngN 8 -16384.00 16383.50 FORMAT "%8.2" DEPOSIT ABSOLUTE /end AXIS_DESCR
/end CHARACTERISTIC
/begin CHARACTERISTIC EngTrqPtd_nSpdGovPtd_C "Maximum permitted speed govenor operation engine speed" VALUE 0x805447FA RB_Val_Ws16 32767.50 EngN -16384.00 16383.50 FORMAT "%8.2" /end CHARACTERISTIC
/begin CHARACTERISTIC EngTrqPtd_trqResvMax_CUR "curve maximal reserve torque in extended monitoring" CURVE 0x805447FC RB_Curve_U8_S16_Static 6553.500 Trq -3276.800 3276.700 FORMAT "%8.3"
 /begin AXIS_DESCR STD_AXIS Epm_nEngLRes EngN_LRes 8 0.00 10200. FORMAT "%5.0" DEPOSIT ABSOLUTE /end AXIS_DESCR
/end CHARACTERISTIC
/begin CHARACTERISTIC EngTrqPtd_trqSpdGOfsPtd_CUR "Torque offset for permitted idle governor torque" CURVE 0x80544816 RB_Curve_S16_S16 3276.700 md_q0p1 0.00 3276.700 FORMAT "%8.3" EXTENDED_LIMITS -3276.800 3276.700
 /begin AXIS_DESCR STD_AXIS NO_INPUT_QUANTITY EngN 8 -16384.00 16383.50 FORMAT "%8.2" DEPOSIT ABSOLUTE /end AXIS_DESCR
/end CHARACTERISTIC
/begin CHARACTERISTIC EnvT_dmAFSMax_CUR "Load-Engine-Rotation-Area to release the EnvT-modelling" CURVE 0x80544A40 RB_Curve_S16_S16 6553.500 AirMassPerTime -3276.800 3276.700 FORMAT "%8.3"
 /begin AXIS_DESCR STD_AXIS EnvT_nEngStyMod EngN 8 -16384.00 16383.50 FORMAT "%8.2" DEPOSIT ABSOLUTE /end AXIS_DESCR
/end CHARACTERISTIC
/begin CHARACTERISTIC EnvT_dmAFSMinMod_CUR "air mass flow depending on vehicle spped" CURVE 0x80544A62 RB_Curve_S16_S16 6553.500 AirMassPerTime -3276.800 3276.700 FORMAT "%8.3"
 /begin AXIS_DESCR STD_AXIS EnvT_vVehStyMod Vel 4 -327.6800 327.6700 FORMAT "%8.4" DEPOSIT ABSOLUTE /end AXIS_DESCR
/end CHARACTERISTIC
/begin CHARACTERISTIC EnvT_drLPPrimModMax_C "Maximum delta load for injection for EnvT-Modelling" VALUE 0x80544A74 RB_Val_Ws16 1535.977 rel_sw_q0p0234 -768.0000 767.9766 FORMAT "%8.4" /end CHARACTERISTIC
/begin CHARACTERISTIC EnvT_drLPPrimModMin_C "Minimum delta load for injection for EnvT-Modelling" VALUE 0x80544A76 RB_Val_Ws16 1535.977 rel_sw_q0p0234 -768.0000 767.9766 FORMAT "%8.4" /end CHARACTERISTIC
/begin CHARACTERISTIC EnvT_dtCEngDsIntkAirMax_C "maximum difference between intake air temperature and engine temperature for initialisation" VALUE 0x80544A78 RB_Val_Ws16 6553.500 Temp_Cels -3549.940 3003.560 FORMAT "%8.3" /end CHARACTERISTIC
/begin CHARACTERISTIC EnvT_dtCEngDsPrimModBas_C "maximum difference between intake air temperature and engine temperature for cold start detection" VALUE 0x80544A7A RB_Val_Ws16 6553.500 Temp_Cels -3549.940 3003.560 FORMAT "%8.3" /end CHARACTERISTIC
/begin CHARACTERISTIC EnvT_IfAdprConf_CW "code word for the configuration of EnvT_IfAdpr" VALUE 0x80544A28 RB_Val_Wu8 255.0 dez 0.00 255.0 FORMAT "%5.1" /end CHARACTERISTIC
/begin CHARACTERISTIC EnvT_mAirAcmMinThdOffs_C "Offset for the Minimum threshold of Air Mass Accumulated for environment temperature modelling((Delta value from the previous value of EnvT_mAirAcmThdMdlRels_T))" VALUE 0x80544A7C RB_Val_Ws16 655.3500 AirMassKg -327.6800 327.6700 FORMAT "%8.4" /end CHARACTERISTIC
/begin CHARACTERISTIC EnvT_mAirAcmThdMdlRels_T "Curve which gives the threshold of Accumulated Air mass to release the environment temperature model" CURVE 0x80544A7E RB_Curve_S16_S16 655.3500 AirMassKg -327.6800 327.6700 FORMAT "%8.4"
 /begin AXIS_DESCR STD_AXIS EnvT_tDifTIntkTEnvMdl Temp_Cels 8 -3549.940 3003.560 FORMAT "%8.3" DEPOSIT ABSOLUTE /end AXIS_DESCR
/end CHARACTERISTIC
/begin CHARACTERISTIC EnvT_mAirModMinHot_C "Threshold for air mass for determination of EnvT-Modelling in case of hot engine" VALUE 0x80544AA0 RB_Val_Ws16 655.3500 AirMassKg -327.6800 327.6700 FORMAT "%8.4" /end CHARACTERISTIC
/begin CHARACTERISTIC EnvT_mAirModMin_C "Threshold for air mass for determination of EnvT-Modelling" VALUE 0x80544AA2 RB_Val_Ws16 655.3500 AirMassKg -327.6800 327.6700 FORMAT "%8.4" /end CHARACTERISTIC
/begin CHARACTERISTIC EnvT_maskAirFltDsSq_C "Calibration mask for signal quality of Intake Air temperature after Air filter" VALUE 0x80544AA4 RB_Val_Wu16 65535.00 OneToOne 0.00 65535.00 FORMAT "%8.2" /end CHARACTERISTIC
/begin CHARACTERISTIC EnvT_maskCEngDsTSq_C "Calibration mask for Signal Quality of Coolant temperature at engine output" VALUE 0x80544AA6 RB_Val_Wu16 65535.00 OneToOne 0.00 65535.00 FORMAT "%8.2" /end CHARACTERISTIC
/begin CHARACTERISTIC EnvT_maskIntkMnfldSq_C "Calibration mask for signal quality of Intake air temperature in manifold." VALUE 0x80544AA8 RB_Val_Wu16 65535.00 OneToOne 0.00 65535.00 FORMAT "%8.2" /end CHARACTERISTIC
/begin CHARACTERISTIC EnvT_stDfl_C "Default value for ambient temperature sensor" VALUE 0x80544A2E RB_Val_Wu8 255.0 OneToOne 0.00 255.0 FORMAT "%5.1" /end CHARACTERISTIC
/begin CHARACTERISTIC EnvT_stModDfl_C "Default status des EnvT-Modells" VALUE 0x80544AAA RB_Val_Wu8 255.0 OneToOne 0.00 255.0 FORMAT "%5.1" /end CHARACTERISTIC
/begin CHARACTERISTIC EnvT_swtCfg_CW "Code word (mask) for activating the main feature of the EnvT" VALUE 0x80544A2F RB_Val_Wu8 255.0 OneToOne 0.00 255.0 FORMAT "%5.1" /end CHARACTERISTIC
/begin CHARACTERISTIC EnvT_swtStSensMod_CW "Code word to enabe the sensor based model for EnvT-packet" VALUE 0x80544A30 RB_Val_Wu16 65535.00 OneToOne 0.00 65535.00 FORMAT "%8.2" /end CHARACTERISTIC
/begin CHARACTERISTIC EnvT_tCACDsCmuMax_C "Maximum value of Air_tCACDs for usage as substitute value in the communication time." VALUE 0x80544A32 RB_Val_Ws16 6553.500 Temp_Cels -3549.940 3003.560 FORMAT "%8.3" /end CHARACTERISTIC
/begin CHARACTERISTIC EnvT_tCACDsCmuMin_C "Minimum value of Air_tCACDs for using as substitute value in the communication time" VALUE 0x80544A34 RB_Val_Ws16 6553.500 Temp_Cels -3549.940 3003.560 FORMAT "%8.3" /end CHARACTERISTIC
/begin CHARACTERISTIC EnvT_tCEngDsHotDet_C "Engine temperature to detect a hot engine" VALUE 0x80544AAC RB_Val_Ws16 6553.500 Temp_Cels -3549.940 3003.560 FORMAT "%8.3" /end CHARACTERISTIC
/begin CHARACTERISTIC EnvT_tCEngDsMaxIniPrimMod_C "Maximum engine temperature to determin EnvT-Model in Initialisation" VALUE 0x80544AAE RB_Val_Ws16 6553.500 Temp_Cels -3549.940 3003.560 FORMAT "%8.3" /end CHARACTERISTIC
/begin CHARACTERISTIC EnvT_tCEngDsMaxPrimMod_C "Maximum engine temperature to determin EnvT-Model" VALUE 0x80544AB0 RB_Val_Ws16 6553.500 Temp_Cels -3549.940 3003.560 FORMAT "%8.3" /end CHARACTERISTIC
/begin CHARACTERISTIC EnvT_tCEngDsMinPrimMod_C "Minimum engine temperature to determin EnvT-Model" VALUE 0x80544AB2 RB_Val_Ws16 6553.500 Temp_Cels -3549.940 3003.560 FORMAT "%8.3" /end CHARACTERISTIC
/begin CHARACTERISTIC EnvT_tCEngDsPrimModCS_C "Maximum engine temperature to determine a cold start of EnvT-Model" VALUE 0x80544AB4 RB_Val_Ws16 6553.500 Temp_Cels -3549.940 3003.560 FORMAT "%8.3" /end CHARACTERISTIC
/begin CHARACTERISTIC EnvT_tCEngDsTMax_C "Maximum engine coolant temperature to calculate model value for ambient temperature" VALUE 0x80544B84 RB_Val_Ws16 6553.500 Temp_Cels -3549.940 3003.560 FORMAT "%8.3" /end CHARACTERISTIC
/begin CHARACTERISTIC EnvT_tCEngDsWarmPrimMod_C "engine temperature threshold to detect: engine warm" VALUE 0x80544AB6 RB_Val_Ws16 6553.500 Temp_Cels -3549.940 3003.560 FORMAT "%8.3" /end CHARACTERISTIC
/begin CHARACTERISTIC EnvT_tDifTCEngDsStrtVal_C "Maximum threshold for the difference between CEngDsT and CEngDsT_tStrt so that the Intake Temperature can be reliably applied as modelled Ambient Temperature" VALUE 0x80544AB8 RB_Val_Ws16 6553.500 Temp_Cels -3549.940 3003.560 FORMAT "%8.3" /end CHARACTERISTIC
/begin CHARACTERISTIC EnvT_tiDelSensMeas_C "Duration, in which a EnvT_t-value detected as valid once is retained even after loss of validity." VALUE 0x80544A36 RB_Val_Wu16 6553.500 t_q0p1 0.00 6553.500 FORMAT "%8.3" /end CHARACTERISTIC
/begin CHARACTERISTIC EnvT_tiEngOffPrimModCS_C "minimum engine off time to detect a cold start in EnvT-Modelling" VALUE 0x80544ABC RB_Val_Ws32 4294967295.00 Time_sec_q1_COMPU -2147483648.00 2147483647.00 FORMAT "%13.2" /end CHARACTERISTIC
/begin CHARACTERISTIC EnvT_tiModHeatingIndcr_C "Time constant of the low pass filter of the environmental temperature model" VALUE 0x80544AC0 RB_Val_Wu16 65534.00 t_q1 1.00 65535.00 FORMAT "%8.2" EXTENDED_LIMITS 0.00 65535.00 /end CHARACTERISTIC
/begin CHARACTERISTIC EnvT_tiModStyCnd_C "Delay time for remaining in state modelling of environmental temperature possible" VALUE 0x80544AC2 RB_Val_Wu8 255.0 t_q1 0.00 255.0 FORMAT "%5.1" /end CHARACTERISTIC
/begin CHARACTERISTIC EnvT_tiModWrmCntrMin_C "Minimum time of state engine is warm for the release of the environmental temperature modelling" VALUE 0x80544AC4 RB_Val_Wu16 65535.00 t_q1 0.00 65535.00 FORMAT "%8.2" /end CHARACTERISTIC
/begin CHARACTERISTIC EnvT_tIntkAirCorrnMdl_C "coefficient to calculate environment temperature" VALUE 0x80544B86 RB_Val_Ws16 6553.500 Temp_Cels -3549.940 3003.560 FORMAT "%8.3" /end CHARACTERISTIC
/begin CHARACTERISTIC EnvT_tIntkAirMaxPrimMod_C "Maximum intake air temperature to determine the environmental temperature model" VALUE 0x80544AC6 RB_Val_Ws16 6553.500 Temp_Cels -3549.940 3003.560 FORMAT "%8.3" /end CHARACTERISTIC
/begin CHARACTERISTIC EnvT_tIntkAirMinPrimMod_C "Minimum intake air temperature to determine the environmental temperature model" VALUE 0x80544AC8 RB_Val_Ws16 6553.500 Temp_Cels -3549.940 3003.560 FORMAT "%8.3" /end CHARACTERISTIC
/begin CHARACTERISTIC EnvT_tIntkCac_C "Default value for the intake air temperature within the CAC communikation" VALUE 0x80544A38 RB_Val_Ws16 6553.500 Temp_Cels -3549.940 3003.560 FORMAT "%8.3" /end CHARACTERISTIC
/begin CHARACTERISTIC EnvT_tIntkDfl_C "Default value for the intake air temperature within the environmental temperature model" VALUE 0x80544ACA RB_Val_Ws16 6553.500 Temp_Cels -3549.940 3003.560 FORMAT "%8.3" /end CHARACTERISTIC
/begin CHARACTERISTIC EnvT_tIntkSnsr_C "calibration parameter to select intake air temperatures." VALUE 0x80544B88 RB_Val_Wu8 255.0 OneToOne 0.00 255.0 FORMAT "%5.1" /end CHARACTERISTIC
/begin CHARACTERISTIC EnvT_tiPrimModEngRotDeb_C "Delay time for the locking of cold start after engine rotation" VALUE 0x80544ACC RB_Val_Wu8 255.0 t_q1 0.00 255.0 FORMAT "%5.1" /end CHARACTERISTIC
/begin CHARACTERISTIC EnvT_tiPrimModEngRotFall_C "Delay time for the locking of cold start after engineoff" VALUE 0x80544ACD RB_Val_Wu8 255.0 t_q1 0.00 255.0 FORMAT "%5.1" /end CHARACTERISTIC
/begin CHARACTERISTIC EnvT_tiPrimModIdleHotDet_C "Delay time for the detection of a hot engine in idle state" VALUE 0x80544ACE RB_Val_Wu16 65535.00 t_q1 0.00 65535.00 FORMAT "%8.2" /end CHARACTERISTIC
/begin CHARACTERISTIC EnvT_tModHeatingIndcr_MAP "Compensation for intake air temperature for determination of environmental air temperature" MAP 0x80544AD0 RB_Map_S16S16_S16 6553.500 Temp_Cels -3549.940 3003.560 FORMAT "%8.3"
 /begin AXIS_DESCR STD_AXIS EnvT_mfAirCylStyMod AirMassPerTime 8 -3276.800 3276.700 FORMAT "%8.3" DEPOSIT ABSOLUTE /end AXIS_DESCR
 /begin AXIS_DESCR STD_AXIS EnvT_tModHeatgIndcr Temp_Cels 8 -3549.940 3003.560 FORMAT "%8.3" DEPOSIT ABSOLUTE /end AXIS_DESCR
/end CHARACTERISTIC
/begin CHARACTERISTIC EnvT_tPrimModBasHotDetHi_C "Upper Intake air temperature threshold to detect a hot engine" VALUE 0x80544B74 RB_Val_Ws16 6553.500 Temp_Cels -3549.940 3003.560 FORMAT "%8.3" /end CHARACTERISTIC
/begin CHARACTERISTIC EnvT_tPrimModBasHotDetLo_C "Lower Intake air temperature threshold to detect a hot engine" VALUE 0x80544B76 RB_Val_Ws16 6553.500 Temp_Cels -3549.940 3003.560 FORMAT "%8.3" /end CHARACTERISTIC
/begin CHARACTERISTIC EnvT_tPrimModDfl_C "Default-value for the environmental temperature modelling" VALUE 0x80544B78 RB_Val_Ws16 6553.500 Temp_Cels -3549.940 3003.560 FORMAT "%8.3" /end CHARACTERISTIC
/begin CHARACTERISTIC EnvT_tSigValMax_C "Substitute value of the ambient temperature for the tester" VALUE 0x80544A3A RB_Val_Wu8 255.0 temp_q1p0_o40_degC -40.0 215.0 FORMAT "%5.1" /end CHARACTERISTIC
/begin CHARACTERISTIC EnvT_tValMax_C "maximal temperature to detemination the minimal value" VALUE 0x80544B7A RB_Val_Ws16 6553.500 Temp_Cels -3549.940 3003.560 FORMAT "%8.3" /end CHARACTERISTIC
/begin CHARACTERISTIC EnvT_tVDDfl_C "Default value of the EnvT" VALUE 0x80544A3C RB_Val_Ws16 6553.500 Temp_Cels -3549.940 3003.560 FORMAT "%8.3" /end CHARACTERISTIC
/begin CHARACTERISTIC EnvT_VDMod2_CW "code word 2 to configure the environmental temperature modelling" VALUE 0x80544B7C RB_Val_Wu8 255.0 OneToOne 0.00 255.0 FORMAT "%5.1" /end CHARACTERISTIC
/begin CHARACTERISTIC EnvT_VDMod3_CW "Code word3 to configure the environmental temperature modelling" VALUE 0x80544B7D RB_Val_Wu8 255.0 OneToOne 0.00 255.0 FORMAT "%5.1" /end CHARACTERISTIC
/begin CHARACTERISTIC EnvT_VDModSnsrSel_CW "code word for selection the temperatuere sensor" VALUE 0x80544B7E RB_Val_Wu16 255.0000 OneToOne 0.00 255.0000 FORMAT "%8.4" EXTENDED_LIMITS 0.00 65535.00 /end CHARACTERISTIC
/begin CHARACTERISTIC EnvT_VDMod_CW "Code word to configure the environmental temperature modelling" VALUE 0x80544B80 RB_Val_Wu8 255.0 OneToOne 0.00 255.0 FORMAT "%5.1" /end CHARACTERISTIC
/begin CHARACTERISTIC EnvT_vVehMinMdl_C "Minimum vehicle velocity to calculate model value for ambient temperature" VALUE 0x80544B8A RB_Val_Ws16 655.3500 Vel -327.6800 327.6700 FORMAT "%8.4" /end CHARACTERISTIC
/begin CHARACTERISTIC EnvT_vVehMinMod_C "Minimum vehicle speed to determine the environmental temperature model" VALUE 0x80544B82 RB_Val_Ws16 655.3500 Vel -327.6800 327.6700 FORMAT "%8.4" /end CHARACTERISTIC
/begin CHARACTERISTIC EpmBCa_facSegTimeAcc_CUR "factor to detect an acceleration after testinjection" CURVE 0x80590CBA Cur_Xs16Ws16 5.000000 EpmBCa_FacTstInj 0.00 5.000000 FORMAT "%8.6" EXTENDED_LIMITS -32.76800 32.76700
 /begin AXIS_DESCR STD_AXIS Epm_nEng EngN 3 -16384.00 16383.50 FORMAT "%8.2" DEPOSIT ABSOLUTE /end AXIS_DESCR
/end CHARACTERISTIC
/begin CHARACTERISTIC EpmBCa_facSegTimeConstHigh_C "upper limit to detect a constant enginge speed" VALUE 0x80590CC8 Val_Ws16 5.000000 EpmBCa_FacTstInj 0.00 5.000000 FORMAT "%8.6" EXTENDED_LIMITS -32.76800 32.76700 /end CHARACTERISTIC
/begin CHARACTERISTIC EpmBCa_facSegTimeConstLow_C "lower limit to detect a constant enginge speed" VALUE 0x80590CCA Val_Ws16 5.000000 EpmBCa_FacTstInj 0.00 5.000000 FORMAT "%8.6" EXTENDED_LIMITS -32.76800 32.76700 /end CHARACTERISTIC
/begin CHARACTERISTIC EpmBCa_nTstInjMax_C "maximum engine-speed at which testinjections are allowed" VALUE 0x80590CCC Val_Ws16 8000.000 EngN 0.00 8000.000 FORMAT "%8.3" EXTENDED_LIMITS -16384.00 16383.50 /end CHARACTERISTIC
/begin CHARACTERISTIC EpmBCa_numInjSer_C "number of testinjections in series" VALUE 0x80590CCE Val_Wu8 9.000 OneToOne 1.00 10.00 FORMAT "%5.2" EXTENDED_LIMITS 0.00 255.0 /end CHARACTERISTIC
/begin CHARACTERISTIC EpmBCa_numTstInjMax_C "maximum numbers of testinjections" VALUE 0x80590CD0 Val_Wu16 16000.00 OneToOne 0.00 16000.00 FORMAT "%8.2" EXTENDED_LIMITS 0.00 65535.00 /end CHARACTERISTIC
/begin CHARACTERISTIC EpmBCa_phiSegEndOld_C "end of old segment (segment which is not accelerated from a testinjection) - over this segment the time is read from the crankshaft-buffer" VALUE 0x80590CD2 Val_Ws16 719.9780 AngleCrS 0.00 719.9780 FORMAT "%8.4" EXTENDED_LIMITS -720.0000 719.9780 /end CHARACTERISTIC
/begin CHARACTERISTIC EpmBCa_phiSegLen_C "segmentlength which is used to get the segmenttime from the crankshaftbuffer for detecting an acceleration" VALUE 0x80590CD4 Val_Ws16 189.9976 AngleCrS 9.9976 199.9951 FORMAT "%8.4" EXTENDED_LIMITS -720.0000 719.9780 /end CHARACTERISTIC
/begin CHARACTERISTIC EpmBCr_facEngSpdRange_CUR "Defines engine speed range dependent factors for calculating the timeout angle in Backup Crankshaft mode." CURVE 0x80544B90 RB_Curve_S16_U16_Static 15.93750 EPM_FAC_PLAUS 0.00 15.93750 FORMAT "%8.5" EXTENDED_LIMITS 0.00 4095.938
 /begin AXIS_DESCR STD_AXIS EpmBCr_nEng EngN 4 0.00 16383.50 FORMAT "%8.2" EXTENDED_LIMITS -16384.00 16383.50 DEPOSIT ABSOLUTE /end AXIS_DESCR
/end CHARACTERISTIC
/begin CHARACTERISTIC EpmBCr_nEngPttFailTol_C "Maximum engine speed before toleranz mechanism gets deactivated" VALUE 0x80544B8C RB_Val_Ws16 6000.000 EngN 0.00 6000.000 FORMAT "%8.3" EXTENDED_LIMITS -16384.00 16383.50 /end CHARACTERISTIC
/begin CHARACTERISTIC EpmBCr_nrPttMtchFailMaxEve_C "Number of events where a mismatching pattern (due to incorrect segment duration time) is tolerated." VALUE 0x80544B8E RB_Val_Wu8 15.00 OneToOne 0.00 15.00 FORMAT "%5.2" EXTENDED_LIMITS 0.00 255.0 /end CHARACTERISTIC
/begin CHARACTERISTIC EpmBCr_rSegLimLowr_C "Lower limit to detect a segment duration time ratio being approximately 1" VALUE 0x80590CDC Val_Wu32 4294967.29500 EPMBCR_FACRATIO 0.00 4294967.29500 FORMAT "%13.5" /end CHARACTERISTIC
/begin CHARACTERISTIC EpmBCr_rSegLimUppr_C "Upper limit to detect a segment duration time ratio being approximately 1" VALUE 0x80590CE0 Val_Wu32 4294967.29500 EPMBCR_FACRATIO 0.00 4294967.29500 FORMAT "%13.5" /end CHARACTERISTIC
/begin CHARACTERISTIC EpmBCr_swtEnable_C "Enable Backup without Crankshaft" VALUE 0x80590CD6 Val_Wu8 2.000 OneToOne 0.00 2.000 FORMAT "%5.3" EXTENDED_LIMITS 0.00 255.0 /end CHARACTERISTIC
/begin CHARACTERISTIC EpmBCr_swtUpdEdge_C "Switch to decide whether backup mode without crankshaft does calculate engine speed and angle clock frequency at all camshaft edges or only at equidistant edges." VALUE 0x80590CE4 RB_Val_Wu8 1.00000000000 EpmBCr_swtUpdEdge_CM 0.00 1.00000000000 FORMAT "%13.11" /end CHARACTERISTIC
/begin CHARACTERISTIC EpmBCr_tEna_C "Threshold engine temperature to allow backup crankshaft" VALUE 0x80590CD8 Val_Ws16 6500.000 Temp_Cels -3500.040 2999.960 FORMAT "%8.3" EXTENDED_LIMITS -3549.940 3003.560 /end CHARACTERISTIC
/begin CHARACTERISTIC EpmCaS_dSegSeries_CA "series of camshaft segments" VAL_BLK 0x80590D04 ValA_Wu8 255.0 OneToOne 0.00 255.0 FORMAT "%5.1" NUMBER 10 /end CHARACTERISTIC
/begin CHARACTERISTIC EpmCaS_facAdapFil_C "filterfactor for the camshaft adaption" VALUE 0x80544BA4 Val_Ws32 1.00000000000 EpmCaS_Fac_Adap 0.00 1.00000000000 FORMAT "%13.11" EXTENDED_LIMITS -2147483.64800 2147483.64700 /end CHARACTERISTIC
/begin CHARACTERISTIC EpmCaS_facPlausHigh_GCUR "factor for the upper limit of the plaus-check of the camshaft-signals" CURVE 0x80590D0E CurG_Ws16 65.53500 EpmCaS_Fac_Plaus -32.76800 32.76700 FORMAT "%8.5"
 /begin AXIS_DESCR COM_AXIS EpmCaS_nEng EngN 3 -16384.00 16383.50 FORMAT "%8.2" AXIS_PTS_REF EpmCaS_facPlaus_DST /end AXIS_DESCR
/end CHARACTERISTIC
/begin CHARACTERISTIC EpmCaS_facPlausLow_GCUR "factor for the lower limit of the plaus-check of the camshaft-signals" CURVE 0x80590D14 CurG_Ws16 65.53500 EpmCaS_Fac_Plaus -32.76800 32.76700 FORMAT "%8.5"
 /begin AXIS_DESCR COM_AXIS EpmCaS_nEng EngN 3 -16384.00 16383.50 FORMAT "%8.2" AXIS_PTS_REF EpmCaS_facPlaus_DST /end AXIS_DESCR
/end CHARACTERISTIC
/begin AXIS_PTS EpmCaS_facPlaus_DST "Distribution values for the camshaft-signal plausibilisation" 0x80590D1A EpmCaS_nEng Axis_Xs16 32767.50 EngN 3 -16384.00 16383.50 FORMAT "%8.2" DEPOSIT ABSOLUTE /end AXIS_PTS
/begin CHARACTERISTIC EpmCaS_flgSwtSnglEdgeTol_C "Switch for activation of the single edge tolerance of the CTEDGE functionality for systems with variable camshaft" VALUE 0x80590CEA Val_Wu8 255.0 OneToOne 0.00 255.0 FORMAT "%5.1" /end CHARACTERISTIC
/begin CHARACTERISTIC EpmCaS_nMaxCaSSigInvld_C "Maximum engine speed threshold above which camshaft sensor signal is invalid" VALUE 0x80590D22 Val_Ws16 16000.00 EngN 0.00 16000.00 FORMAT "%8.2" EXTENDED_LIMITS -16384.00 16383.50 /end CHARACTERISTIC
/begin CHARACTERISTIC EpmCaS_nMaxCaSSigVld_C "maximum engine speed at which cam signal is valid" VALUE 0x80590D24 Val_Ws16 16000.00 EngN 0.00 16000.00 FORMAT "%8.2" EXTENDED_LIMITS -16384.00 16383.50 /end CHARACTERISTIC
/begin CHARACTERISTIC EpmCaS_nMinCaSSigInvld_C "Minimum engine speed threshold below which camshaft sensor signal is invalid" VALUE 0x80590D26 Val_Ws16 16000.00 EngN 0.00 16000.00 FORMAT "%8.2" EXTENDED_LIMITS -16384.00 16383.50 /end CHARACTERISTIC
/begin CHARACTERISTIC EpmCaS_nMinCaSSigVld_C "minimum engine speed at which cam signal is valid" VALUE 0x80590D28 Val_Ws16 16000.00 EngN 0.00 16000.00 FORMAT "%8.2" EXTENDED_LIMITS -16384.00 16383.50 /end CHARACTERISTIC
/begin CHARACTERISTIC EpmCaS_nrMaxTryAdpn_C "Calibratable number of adaptation tries or Maximum number of loops for Adaptation cycles" VALUE 0x80590CE8 Val_Wu16 65534.00 OneToOne 1.00 65535.00 FORMAT "%8.2" EXTENDED_LIMITS 0.00 65535.00 /end CHARACTERISTIC
/begin CHARACTERISTIC EpmCaS_numEdgeFltAvrg_CA "Definition of Reference edge for correcting position of current edge (number of equidistand edges before current edge)" VAL_BLK 0x80590D2A ValA_Wu8 255.0 OneToOne 0.00 255.0 FORMAT "%5.1" NUMBER 1 /end CHARACTERISTIC
/begin CHARACTERISTIC EpmCaS_numEdgeRefAdpn_C "The number of values per camshaft edge position to be averaged for Reference adaptation algorithm" VALUE 0x80544BA8 Val_Wu8 255.0 OneToOne 0.00 255.0 FORMAT "%5.1" /end CHARACTERISTIC
/begin CHARACTERISTIC EpmCaS_numErrSigDef_C "Limit of the debounce counter for recognizing a defect when camshaft disturbance occurs" VALUE 0x80590CEC Val_Wu16 248.0000 CrSRev2CrSInc 2.0000 250.0000 FORMAT "%8.4" EXTENDED_LIMITS 0.00 1092.250 /end CHARACTERISTIC
/begin CHARACTERISTIC EpmCaS_numErrSigOk_C "Limit of the debounce counter for healing a recognized camshaft disturbance" VALUE 0x80590CEE Val_Wu16 248.0000 CrSRev2CrSInc 2.0000 250.0000 FORMAT "%8.4" EXTENDED_LIMITS 0.00 1092.250 /end CHARACTERISTIC
/begin CHARACTERISTIC EpmCaS_numNoSigDef_C "Limit for debounce counter to recognize the loss of a camshaft signal" VALUE 0x80590CF0 Val_Wu16 248.0000 CrSRev2CrSInc 2.0000 250.0000 FORMAT "%8.4" EXTENDED_LIMITS 0.00 1092.250 /end CHARACTERISTIC
/begin CHARACTERISTIC EpmCaS_numOfsErr_C "number of camshaft revolution until fault path DFC_EpmCaS..OfsErr will set" VALUE 0x80590CF6 Val_Wu8 255.0 OneToOne 0.00 255.0 FORMAT "%5.1" /end CHARACTERISTIC
/begin CHARACTERISTIC EpmCaS_numPriCamSel_C "Primary camshaft which is used to calculate the engine speed from camshaft and to support backup mode" VALUE 0x80590D2B Val_Wu8 0.00 OneToOne 0.00 0.00 FORMAT "%5.2" EXTENDED_LIMITS 0.00 255.0 /end CHARACTERISTIC
/begin CHARACTERISTIC EpmCaS_numSegSerLst_C "index of last segmment in EpmCaS_dSegSeries" VALUE 0x80590D2C Val_Wu8 9.000 OneToOne 0.00 9.000 FORMAT "%5.3" EXTENDED_LIMITS 0.00 255.0 /end CHARACTERISTIC
/begin CHARACTERISTIC EpmCaS_phiAdpClb_CA "Angle for the calibratable adaptation" VAL_BLK 0x80544BAA ValA_Ws16 39.99023 AngleCrS -19.99512 19.99512 FORMAT "%8.5" EXTENDED_LIMITS -720.0000 719.9780 NUMBER 1 /end CHARACTERISTIC
/begin CHARACTERISTIC EpmCaS_phiDiffAdapMax_C "maximum angle-difference between real and adapted angle - adaption is running until this angle is reached" VALUE 0x80544BAC Val_Ws16 5.998535 AngleCrS 0.00 5.998535 FORMAT "%8.6" EXTENDED_LIMITS -720.0000 719.9780 /end CHARACTERISTIC
/begin CHARACTERISTIC EpmCaS_phiDiffLim_C "maximum angle-difference between real and adapted angle during adaption" VALUE 0x80544BAE Val_Ws16 50.00977 AngleCrS 0.00 50.00977 FORMAT "%8.5" EXTENDED_LIMITS -720.0000 719.9780 /end CHARACTERISTIC
/begin CHARACTERISTIC EpmCaS_phiDiffRefAdapMax_C "maximum angle-difference between reference and adapted position" VALUE 0x80544BB0 Val_Ws16 5.998535 AngleCrS 0.00 5.998535 FORMAT "%8.6" EXTENDED_LIMITS -720.0000 719.9780 /end CHARACTERISTIC
/begin CHARACTERISTIC EpmCaS_phiEdgeDvtMax_CA "Deactivation of filter if the dynamics between the reference edge and the current edge are larger than the corresponding value in EpmCaS_phiEdgeDvtMax_CA" VAL_BLK 0x80590D2E ValA_Ws16 1439.978 AngleCrS -720.0000 719.9780 FORMAT "%8.4" NUMBER 1 /end CHARACTERISTIC
/begin CHARACTERISTIC EpmCaS_phiLoLimIn_C "Lower angle limit of the actuator range for the intake camshaft (including tolerances)" VALUE 0x80590D30 Val_Ws16 1439.978 AngleCrS -720.0000 719.9780 FORMAT "%8.4" /end CHARACTERISTIC
/begin CHARACTERISTIC EpmCaS_phiMntErrMax_C "Upper limit of the tolerated angle difference of the installation position of the camshaft" VALUE 0x80590CF8 Val_Ws16 1439.978 AngleCrS -720.0000 719.9780 FORMAT "%8.4" /end CHARACTERISTIC
/begin CHARACTERISTIC EpmCaS_phiMntErrMin_C "Lower limit of the tolerated angle difference of the installation position of the camshaft" VALUE 0x80590CFA Val_Ws16 1439.978 AngleCrS -720.0000 719.9780 FORMAT "%8.4" /end CHARACTERISTIC
/begin CHARACTERISTIC EpmCaS_phiMntMax_C "Maximum twist of the installation position of the camshaft up to which the neutral point of the angle offset diagnosis is shifted." VALUE 0x80544BB2 Val_Ws16 360.0000 AngleCrS 0.00 360.0000 FORMAT "%8.4" EXTENDED_LIMITS -720.0000 719.9780 /end CHARACTERISTIC
/begin CHARACTERISTIC EpmCaS_phiNCorI1_CUR "engine speed dependent angle correction value of the inlet camshaft signal1" CURVE 0x80590D32 Cur_Xs16Ws16 1439.978 AngleCrS -720.0000 719.9780 FORMAT "%8.4"
 /begin AXIS_DESCR STD_AXIS Epm_nEng EngN 6 -16384.00 16383.50 FORMAT "%8.2" DEPOSIT ABSOLUTE /end AXIS_DESCR
/end CHARACTERISTIC
/begin CHARACTERISTIC EpmCaS_phiOfsMax_C "max. tolerated angle offset between camshaft and crankshaft" VALUE 0x80590CFC Val_Ws16 1439.978 AngleCrS -720.0000 719.9780 FORMAT "%8.4" /end CHARACTERISTIC
/begin CHARACTERISTIC EpmCaS_phiOfsMin_C "min. tolerated offset between camshaft and crankshaft" VALUE 0x80590CFE Val_Ws16 1439.978 AngleCrS -720.0000 719.9780 FORMAT "%8.4" /end CHARACTERISTIC
/begin CHARACTERISTIC EpmCaS_phiSegLenTol_CA "tolerance of each segment length" VAL_BLK 0x80590D4C ValA_Ws16 1439.978 AngleCrS -720.0000 719.9780 FORMAT "%8.4" NUMBER 10 /end CHARACTERISTIC
/begin CHARACTERISTIC EpmCaS_phiSegLen_CA "length of camshaft segments" VAL_BLK 0x80590D60 ValA_Ws16 719.9780 AngleCrS 0.00 719.9780 FORMAT "%8.4" EXTENDED_LIMITS -720.0000 719.9780 NUMBER 10 /end CHARACTERISTIC
/begin CHARACTERISTIC EpmCaS_phiSegOfs_CA "angle between physical zeroposition and start of EpmCaS_dSegSeries_C" VAL_BLK 0x80590D74 ValA_Ws16 719.9780 AngleCrS 0.00 719.9780 FORMAT "%8.4" EXTENDED_LIMITS -720.0000 719.9780 NUMBER 1 /end CHARACTERISTIC
/begin AXIS_PTS EpmCaS_phiTempCor05_DST "distribution for camshaft angle correction depending on temperature" 0x80590D76 EpmIf_tCoolant Axis_Xs16 6553.500 Temp_Cels 3 -3549.940 3003.560 FORMAT "%8.3" DEPOSIT ABSOLUTE /end AXIS_PTS
/begin CHARACTERISTIC EpmCaS_phiTempCorEngI1_CUR "Angle correction for first inlet camshaft based on temperature correction" CURVE 0x80590D7E Cur_Xs16Ws16 1439.978 AngleCrS -720.0000 719.9780 FORMAT "%8.4"
 /begin AXIS_DESCR STD_AXIS EpmCaS_tAgSnsrCorr Temp_Cels 10 -3549.940 3003.560 FORMAT "%8.3" DEPOSIT ABSOLUTE /end AXIS_DESCR
/end CHARACTERISTIC
/begin CHARACTERISTIC EpmCaS_phiTempCorI1_GCUR "angle correction for first inletcamshaft depending on temperature distribution" CURVE 0x80590DA8 CurG_Ws16 1439.978 AngleCrS -720.0000 719.9780 FORMAT "%8.4"
 /begin AXIS_DESCR COM_AXIS EpmIf_tCoolant Temp_Cels 3 -3549.940 3003.560 FORMAT "%8.3" AXIS_PTS_REF EpmCaS_phiTempCor05_DST /end AXIS_DESCR
/end CHARACTERISTIC
/begin CHARACTERISTIC EpmCaS_phiUpLimIn_C "Upper angle limit of the actuator range for the intake camshaft (including tolerances)" VALUE 0x80590DAE Val_Ws16 1439.978 AngleCrS -720.0000 719.9780 FORMAT "%8.4" /end CHARACTERISTIC
/begin CHARACTERISTIC EpmCaS_refAdapFac_C "factor for partial reference adaptation" VALUE 0x80544BB4 Val_Ws32 1.00000000000 EpmCaS_Fac_Adap 0.00 1.00000000000 FORMAT "%13.11" EXTENDED_LIMITS -2147483.64800 2147483.64700 /end CHARACTERISTIC
/begin CHARACTERISTIC EpmCaS_stActEdge_C "type of camshaft edges to be detected" VALUE 0x80590DB0 Val_Wu8 255.0 OneToOne 0.00 255.0 FORMAT "%5.1" /end CHARACTERISTIC
/begin CHARACTERISTIC EpmCaS_stDiagMode_C "Disable the camshaft diagnosis in EPM_MODE_OK if a camshaft fault is already detected." VALUE 0x80590CF2 Val_Wu8 255.0 OneToOne 0.00 255.0 FORMAT "%5.1" /end CHARACTERISTIC
/begin CHARACTERISTIC EpmCas_stDirOfsAvrgUnflt_C "direction of unfiltered angular displacement of the camshaft" VALUE 0x80590D00 Val_Wu8 255.0 OneToOne 0.00 255.0 FORMAT "%5.1" /end CHARACTERISTIC
/begin CHARACTERISTIC EpmCaS_stMinSyncCaSAg_C "minimal value of Epm_stSync after which the calculation of camshaft edges starts" VALUE 0x80590DB1 Val_Wu8 20.00 OneToOne 10.00 30.00 FORMAT "%5.2" EXTENDED_LIMITS 0.00 255.0 /end CHARACTERISTIC
/begin CHARACTERISTIC EpmCaS_stOfsDiagMode_C "Disable of camshaft offset in EPM_MODE_OK" VALUE 0x80590D01 Val_Wu8 7.000 OneToOne 0.00 7.000 FORMAT "%5.3" EXTENDED_LIMITS 0.00 255.0 /end CHARACTERISTIC
/begin CHARACTERISTIC EpmCaS_swtAdap_C "Switch for adaptation strategy" VALUE 0x80544BB8 Val_Wu8 255.0 OneToOne 0.00 255.0 FORMAT "%5.1" /end CHARACTERISTIC
/begin CHARACTERISTIC EpmCaS_swtAdpClb_C "Switch for calibratable adaptation correction" VALUE 0x80544BB9 Val_Wu8 1.000 OneToOne 0.00 1.000 FORMAT "%5.3" EXTENDED_LIMITS 0.00 255.0 /end CHARACTERISTIC
/begin CHARACTERISTIC EpmCaS_swtForceRefAdap_C "Trigger for reference adaptation and check of the installation position of the camshaft" VALUE 0x80544BBA Val_Wu8 1.000 OneToOne 0.00 1.000 FORMAT "%5.3" EXTENDED_LIMITS 0.00 255.0 /end CHARACTERISTIC
/begin CHARACTERISTIC EpmCaS_swtMeasCaS_C "Switch for measuring the camshaft raw values" VALUE 0x80590CF4 Val_Wu8 32.00 OneToOne 0.00 32.00 FORMAT "%5.2" EXTENDED_LIMITS 0.00 255.0 /end CHARACTERISTIC
/begin CHARACTERISTIC EpmCaS_swtSegTSel_C "Selection of temperature for camshaft angle correction" VALUE 0x80544BBC Val_Wu8 1.00000000000 EpmIf_swtTSel_VERB 0.00 1.00000000000 FORMAT "%13.11" /end CHARACTERISTIC
/begin CHARACTERISTIC EpmCaS_swtSeg_C "Setting for the calculation strategy of camshaft angle" VALUE 0x80590DB2 Val_Wu8 255.0 OneToOne 0.00 255.0 FORMAT "%5.1" /end CHARACTERISTIC
/begin CHARACTERISTIC EpmCaS_tiGlitchFilter_C "filtertime for the camshaft signal" VALUE 0x80590DB4 Val_Ws32 4294967295.00 OneToOne_us -2147483648.00 2147483647.00 FORMAT "%13.2" /end CHARACTERISTIC
/begin CHARACTERISTIC EpmCaS_tiOfsPT1_C "time factor for filtering camshaft offset" VALUE 0x80590D02 Val_Wu16 4294901.8 TimeDelay_ms 65.5 4294967.3 FORMAT "%12.1" /end CHARACTERISTIC
/begin CHARACTERISTIC EpmCaS_tiTimeout_C "after the last camshaftedge the system waits this time and then the valid time entries in the camshaftbuffer are cleared" VALUE 0x80590DB8 Val_Ws32 42949672950.0 Time_ms -21474836480.0 21474836470.0 FORMAT "%13.1" /end CHARACTERISTIC
/begin CHARACTERISTIC EpmCaS_tRefCal_C "reference temperature for camshaft calibration" VALUE 0x80590DBC Val_Ws16 6553.500 Temp_Cels -3549.940 3003.560 FORMAT "%8.3" /end CHARACTERISTIC
/begin CHARACTERISTIC EpmCrS_dnEngMax_C "max. engine deceleration to calculate the diagnosis for a disturbances of the crankshaft signal" VALUE 0x80590DC0 Val_Ws16 32767.00 EngNGrd -16383.50 16383.50 FORMAT "%8.2" EXTENDED_LIMITS -16384.00 16383.50 /end CHARACTERISTIC
/begin CHARACTERISTIC EpmCrS_facGapCrit1_C "factor for gap criteria one" VALUE 0x80590DE4 Val_Wu8 15.94 EPM_FAC_PLAUS 0.00 15.94 FORMAT "%5.2" /end CHARACTERISTIC
/begin CHARACTERISTIC EpmCrS_facGapCrit2_C "factor for gap criteria two" VALUE 0x80590DE5 Val_Wu8 15.94 EPM_FAC_PLAUS 0.00 15.94 FORMAT "%5.2" /end CHARACTERISTIC
/begin CHARACTERISTIC EpmCrS_facGapPlausHigh_CA "ratio to calculate the upper limit of the gap plausibility check of increment signal" VAL_BLK 0x80590DE6 ValA_Wu8 15.94 EPM_FAC_PLAUS 0.00 15.94 FORMAT "%5.2" NUMBER 4 /end CHARACTERISTIC
/begin CHARACTERISTIC EpmCrS_facIncPlausHigh_CA "factor crankshaft signal plausibility check high" VAL_BLK 0x80590DEA ValA_Wu8 15.94 EPM_FAC_PLAUS 0.00 15.94 FORMAT "%5.2" NUMBER 4 /end CHARACTERISTIC
/begin CHARACTERISTIC EpmCrS_facIncPlausLow_CA "factor crankshaft signal plausibility check low" VAL_BLK 0x80590DEE ValA_Wu8 15.94 EPM_FAC_PLAUS 0.00 15.94 FORMAT "%5.2" NUMBER 4 /end CHARACTERISTIC
/begin CHARACTERISTIC EpmCrS_facIncPlsFwdTolc_C "Tolerance of the forwardpuls width of DGI crankshaft sensor" VALUE 0x80590DF2 Val_Ws16 100.0000 Prc 0.00 100.0000 FORMAT "%8.4" EXTENDED_LIMITS -400.0000 399.9878 /end CHARACTERISTIC
/begin CHARACTERISTIC EpmCrS_facIncPlsRevTolc_C "Tolerance of the backwardpuls width of DGI crankshaft sensor" VALUE 0x80590DF4 Val_Ws16 100.0000 Prc 0.00 100.0000 FORMAT "%8.4" EXTENDED_LIMITS -400.0000 399.9878 /end CHARACTERISTIC
/begin CHARACTERISTIC EpmCrS_nDiagOff_C "engine speed threshold to switch off the crankshaft diagnosis" VALUE 0x80590DC2 Val_Ws16 8000.000 EngN 0.00 8000.000 FORMAT "%8.3" EXTENDED_LIMITS -16384.00 16383.50 /end CHARACTERISTIC
/begin CHARACTERISTIC EpmCrS_nDiagOn_C "Engine speed to switch on the crankshaft diagnosis" VALUE 0x80590DC4 Val_Ws16 8000.000 EngN 0.00 8000.000 FORMAT "%8.3" EXTENDED_LIMITS -16384.00 16383.50 /end CHARACTERISTIC
/begin CHARACTERISTIC EpmCrS_nMaxDGIPlaus_C "engine speed threshold after which reverse DGI impulses are ssumed to be implausible" VALUE 0x80590DC6 Val_Ws16 10000.00 EngN 0.00 10000.00 FORMAT "%8.2" EXTENDED_LIMITS -16384.00 16383.50 /end CHARACTERISTIC
/begin CHARACTERISTIC EpmCrS_nMaxInc_C "max speed for one increment period" VALUE 0x80590DF6 Val_Ws16 9980.000 EngN 20.00 10000.00 FORMAT "%8.2" EXTENDED_LIMITS -16384.00 16383.50 /end CHARACTERISTIC
/begin CHARACTERISTIC EpmCrS_nThreshRange_CA "array of speed thresholds for dynamic plaus" VAL_BLK 0x80590DF8 ValA_Ws32 16319.868465052328 EngN2tiIncPer 19.999999000000 16339.868464052328 FORMAT "%19.13" EXTENDED_LIMITS 0.001164153160604 2499999.8750000061 NUMBER 3 /end CHARACTERISTIC
/begin CHARACTERISTIC EpmCrS_nTiIncPerAvrg_CA "engine speed thresholds to set the number of crankshaft teeth to calculate the average for one tooth time" VAL_BLK 0x80590E04 ValA_Ws16 16363.00 EngN 20.00 16383.00 FORMAT "%8.2" EXTENDED_LIMITS -16384.00 16383.50 NUMBER 4 /end CHARACTERISTIC
/begin CHARACTERISTIC EpmCrS_numAgClkDeltaCrsvMax_C "Permitted maximum number of angle differences which are above the maximum angle" VALUE 0x80590E0C Val_Wu8 26.00 OneToOne 6.00 32.00 FORMAT "%5.2" EXTENDED_LIMITS 0.00 255.0 /end CHARACTERISTIC
/begin CHARACTERISTIC EpmCrS_numErrSigIncDef_C "step wide defect debouncing crankshaft disturbance" VALUE 0x80590DC8 Val_Ws16 32767.00 OneToOne 0.00 32767.00 FORMAT "%8.2" EXTENDED_LIMITS -32768.00 32767.00 /end CHARACTERISTIC
/begin CHARACTERISTIC EpmCrS_numErrSigIncOK_C "alternative decrement for error healing" VALUE 0x80590DCA Val_Ws16 32767.00 OneToOne 0.00 32767.00 FORMAT "%8.2" EXTENDED_LIMITS -32768.00 32767.00 /end CHARACTERISTIC
/begin CHARACTERISTIC EpmCrS_numErrSigMaxDef_C "max. number of disturbance until fault report crankshaft disturbance" VALUE 0x80590DCC Val_Ws16 32767.00 OneToOne 0.00 32767.00 FORMAT "%8.2" EXTENDED_LIMITS -32768.00 32767.00 /end CHARACTERISTIC
/begin CHARACTERISTIC EpmCrS_numErrSigMinOK_C "min. number of plausible crankshaft revolutions until healing" VALUE 0x80590DCE Val_Ws16 32767.00 OneToOne 0.00 32767.00 FORMAT "%8.2" EXTENDED_LIMITS -32768.00 32767.00 /end CHARACTERISTIC
/begin CHARACTERISTIC EpmCrS_numIgnInc_C "number of teeth to supress crankshaft signal" VALUE 0x80590E0D Val_Wu8 254.0 OneToOne 1.0 255.0 FORMAT "%5.1" EXTENDED_LIMITS 0.00 255.0 /end CHARACTERISTIC
/begin CHARACTERISTIC EpmCrS_numIncTiAvrgPlaus_C "Number of increments for averaging increment duration as base for selection of plausibility parameters" VALUE 0x80590E0E Val_Wu16 50.00000 OneToOne 0.00 50.00000 FORMAT "%8.5" EXTENDED_LIMITS 0.00 65535.00 /end CHARACTERISTIC
/begin CHARACTERISTIC EpmCrS_numNoSigDef_C "number of camshaft revolutions until fault report ""no crankshaft signal""" VALUE 0x80590DD0 Val_Ws16 32767.00 OneToOne 0.00 32767.00 FORMAT "%8.2" EXTENDED_LIMITS -32768.00 32767.00 /end CHARACTERISTIC
/begin CHARACTERISTIC EpmCrS_numPosDGIInc_C "increment of debounce counter of wrong DGI stop position" VALUE 0x80590DD2 Val_Wu8 255.0 OneToOne 0.00 255.0 FORMAT "%5.1" /end CHARACTERISTIC
/begin CHARACTERISTIC EpmCrS_numPosDGIMax_C "maximum value for the debounce counterof wrong DGI stop position" VALUE 0x80590DD3 Val_Wu8 255.0 OneToOne 0.00 255.0 FORMAT "%5.1" /end CHARACTERISTIC
/begin CHARACTERISTIC EpmCrS_numRRNotPlausInc_C "increment for debouncing of DGI reverse pulses" VALUE 0x80590DD4 Val_Ws16 32767.00 OneToOne 0.00 32767.00 FORMAT "%8.2" EXTENDED_LIMITS -32768.00 32767.00 /end CHARACTERISTIC
/begin CHARACTERISTIC EpmCrS_numRRNotPlausMax_C "maximum value for debouncing of DGI reverse pulses" VALUE 0x80590DD6 Val_Ws16 32767.00 OneToOne 0.00 32767.00 FORMAT "%8.2" EXTENDED_LIMITS -32768.00 32767.00 /end CHARACTERISTIC
/begin CHARACTERISTIC EpmCrS_numTiIncPerAvrg_CA "number of crankshaft teeth to calculate average of tooth time" VAL_BLK 0x80590E10 ValA_Wu8 50.00 OneToOne 0.00 50.00 FORMAT "%5.2" EXTENDED_LIMITS 0.00 255.0 NUMBER 4 /end CHARACTERISTIC
/begin CHARACTERISTIC EpmCrS_phiAgClkDeltaMax_C "Permitted maximum angle difference between the relative angle of the angle clock and the relative angle provided by the tooth counter" VALUE 0x80590E14 Val_Ws16 6.503906 AngleCrS 0.505371 7.009277 FORMAT "%8.6" EXTENDED_LIMITS -720.0000 719.9780 /end CHARACTERISTIC
/begin CHARACTERISTIC EpmCrS_phiDiffDGI_C "threshold for angle of re-synchronisation after start by engine stop position for the error entry of DGI" VALUE 0x80590DD8 Val_Ws16 29.99268 AngleCrS 0.00 29.99268 FORMAT "%8.5" EXTENDED_LIMITS -720.0000 719.9780 /end CHARACTERISTIC
/begin CHARACTERISTIC EpmCrS_stClrCntReSyncAgClkDeltaTot_C "Calibration value to reset the number of released re-synchronizations over all driving cycles" VALUE 0x80590E16 Val_Wu8 255.0 OneToOne 0.00 255.0 FORMAT "%5.1" /end CHARACTERISTIC
/begin CHARACTERISTIC EpmCrS_stDiagT50Reset_C "usage of terminal 50 information for crankshaft diagnosis" VALUE 0x80590DDA Val_Wu8 1.000 OneToOne 0.00 1.000 FORMAT "%5.3" EXTENDED_LIMITS 0.00 255.0 /end CHARACTERISTIC
/begin CHARACTERISTIC EpmCrS_stTTMeasure_C "activate tooth time measurement" VALUE 0x80590E40 Val_Wu8 255.0 OneToOne 0.00 255.0 FORMAT "%5.1" /end CHARACTERISTIC
/begin CHARACTERISTIC EpmCrS_swtEnableDiag_C "Switch off crankshaft diagnosis" VALUE 0x80590DDB Val_Wu8 255.0 OneToOne 0.00 255.0 FORMAT "%5.1" /end CHARACTERISTIC
/begin CHARACTERISTIC EpmCrS_swtMeasActvnS1_C "Measurement of the crank-shaft tooth-times in S1-interrupt is activated (==1)" VALUE 0x80590E41 Val_Wu8 255.0 OneToOne 0.00 255.0 FORMAT "%5.1" /end CHARACTERISTIC
/begin CHARACTERISTIC EpmCrS_swtRstDGIRRNotPlaus_C "Switch for resetting of DFC_EpmCrSDGIRRNotPlaus" VALUE 0x80590DDC Val_Wu8 255.0 OneToOne 0.00 255.0 FORMAT "%5.1" /end CHARACTERISTIC
/begin CHARACTERISTIC EpmCrS_swtRstDiag_C "Switch for resetting crankshaft diagnosis DFCs" VALUE 0x80590DDD Val_Wu8 255.0 OneToOne 0.00 255.0 FORMAT "%5.1" /end CHARACTERISTIC
/begin CHARACTERISTIC EpmCrS_swtSnsrTyp_C "Type of Crankshaft Hybrid sensor" VALUE 0x80590E17 Val_Wu8 2.00000000000 EpmCrS_swtSnsrTyp_State_t 0.00 2.00000000000 FORMAT "%13.11" /end CHARACTERISTIC
/begin CHARACTERISTIC EpmCrS_tiGlitchFilterActv_CA "glitch filter time for active edge of crankshaft signal" VAL_BLK 0x80590E18 ValA_Ws32 20.0000000000 OneToOne_us 0.00 20.0000000000 FORMAT "%13.10" EXTENDED_LIMITS -2147483648.00 2147483647.00 NUMBER 4 /end CHARACTERISTIC
/begin CHARACTERISTIC EpmCrS_tiGlitchFilterInActv_CA "glitch filter time for inactive edge of crankshaft signal" VAL_BLK 0x80590E28 ValA_Ws32 20.0000000000 OneToOne_us 0.00 20.0000000000 FORMAT "%13.10" EXTENDED_LIMITS -2147483648.00 2147483647.00 NUMBER 4 /end CHARACTERISTIC
/begin CHARACTERISTIC EpmCrS_tiIgnSig_C "time to supress the crankshaft signal" VALUE 0x80590E38 Val_Ws32 100000.000000 OneToOne_ms 0.00 100000.000000 FORMAT "%13.6" EXTENDED_LIMITS -2147483648.00 2147483647.00 /end CHARACTERISTIC
/begin CHARACTERISTIC EpmCrS_tiPlsFwd_C "Application label for forward pulse width of DGI crankshaft sensor" VALUE 0x80590E3C Val_Wu16 1000.000 GptaClc0_ti_COMPU 0.00 1000.000 FORMAT "%8.3" EXTENDED_LIMITS 0.00 3276.750 /end CHARACTERISTIC
/begin CHARACTERISTIC EpmCrS_tiPlsRvs_C "Application label for reverse pulse width of DGI crankshaft sensor" VALUE 0x80590E3E Val_Wu16 1000.000 GptaClc0_ti_COMPU 0.00 1000.000 FORMAT "%8.3" EXTENDED_LIMITS 0.00 3276.750 /end CHARACTERISTIC
/begin CHARACTERISTIC EpmCrS_VehV_v_Max_C "Upper limit of car speed to deactivate the diagnosis" VALUE 0x80590DDE Val_Ws16 655.3500 Vel -327.6800 327.6700 FORMAT "%8.4" /end CHARACTERISTIC
/begin CHARACTERISTIC EpmCrS_VehV_v_Min_C "Lower limit of car speed to deactivate the diagnosis" VALUE 0x80590DE0 Val_Ws16 655.3500 Vel -327.6800 327.6700 FORMAT "%8.4" /end CHARACTERISTIC
/begin CHARACTERISTIC EpmHAgClk_numAddTick_CA "Increment distribution of additional ticks of angle clock" VAL_BLK 0x80590E42 ValA_Wu8 255.0 OneToOne 0.00 255.0 FORMAT "%5.1" NUMBER 8 /end CHARACTERISTIC
/begin CHARACTERISTIC MoXTrqPtd_facTqErrMax_C "maximal increment of MoXTrqPtd_facTqErrSum per time" VALUE 0x80544838 RB_Val_Ws16 127.9980 rel_q0p00195_pc_s -64.00000 63.99805 FORMAT "%8.5" /end CHARACTERISTIC
/begin CHARACTERISTIC MoXTrqPtd_facTqErrMin_C "maximal decrement of MoXTrqPtd_facTqErrSum per time" VALUE 0x8054483A RB_Val_Ws16 127.9980 rel_q0p00195_pc_s -64.00000 63.99805 FORMAT "%8.5" /end CHARACTERISTIC
/begin CHARACTERISTIC MoXTrqPtd_facTqErrSumActvn_C "threshold for MoXTrqPtd_facTqErrSum to activate torque limitation from extended monitoring" VALUE 0x8054483C RB_Val_Wu16 127.9980 rel_q0p00195_pc_s 0.00 127.9980 FORMAT "%8.4" /end CHARACTERISTIC
/begin CHARACTERISTIC MoXTrqPtd_facTqErrSumDeactvn_C "threshold for MoXTrqPtd_facTqErrSum to deactivate torque limitation from extended monitoring" VALUE 0x8054483E RB_Val_Wu16 127.9980 rel_q0p00195_pc_s 0.00 127.9980 FORMAT "%8.4" /end CHARACTERISTIC
/begin CHARACTERISTIC MoXTrqPtd_flgEngLimActvdMnl_C "Calibration value for permanently activation of limitation of extended monitoring" VALUE 0x80544840 RB_Val_Wu8 1.00000000000 B_TRUE 0.00 1.00000000000 FORMAT "%13.11" /end CHARACTERISTIC
/begin CHARACTERISTIC MoXTrqPtd_tiDelRatTqPtdLvl2_C "delay time for the filtering of the permitted torque" VALUE 0x80544842 RB_Val_Wu16 1310.720 t_q0p04 0.00 1310.720 FORMAT "%8.3" EXTENDED_LIMITS 0.00 2621.400 /end CHARACTERISTIC
/begin CHARACTERISTIC MoXTrqPtd_tiEngLimDeactv_C "debounce time for the determination of the condition MoXTrqPtd_flgEngLimDeactv_MP" VALUE 0x80544844 RB_Val_Wu16 2621.400 t_q0p04 0.00 2621.400 FORMAT "%8.3" /end CHARACTERISTIC
/begin CHARACTERISTIC MoXTrqPtd_tiExtIntDeactv_C "Deactivation delay time for level2 status of gearbox intervention" VALUE 0x80544846 RB_Val_Wu16 655.3500 t_q0p01 0.00 655.3500 FORMAT "%8.4" /end CHARACTERISTIC
/begin CHARACTERISTIC MoXTrqPtd_tiFltRatTqPtdLvl2_C "low pass time constant for permitted torque in extended monitoring" VALUE 0x80544848 RB_Val_Wu16 2621.3600000 zk40msxs_uw_b2621p4 0.0400000 2621.4000000 FORMAT "%12.7" /end CHARACTERISTIC
/begin CHARACTERISTIC MoXTrqPtd_tqInrPtdSetDeactvn_C "threshold for EngTrqPtd_trqSet to deactivate torque limitation from extended monitoring" VALUE 0x8054484A RB_Val_Ws16 3276.700 md_q0p1 0.00 3276.700 FORMAT "%8.3" EXTENDED_LIMITS -3276.800 3276.700 /end CHARACTERISTIC
/begin CHARACTERISTIC MoXTrqPtd_tqOffsLvl2_M "offset for the permitted inner torque (corresponding level 2)" MAP 0x8054484C RB_Map_U8S16_S16 6553.500 Trq -3276.800 3276.700 FORMAT "%8.3"
 /begin AXIS_DESCR STD_AXIS MoFESpd_nEng nmot_q40 8 0.00 10200. FORMAT "%5.0" DEPOSIT ABSOLUTE /end AXIS_DESCR
 /begin AXIS_DESCR STD_AXIS MoXTrqPtd_tqInrPtd Trq 8 -3276.800 3276.700 FORMAT "%8.3" DEPOSIT ABSOLUTE /end AXIS_DESCR
/end CHARACTERISTIC
/begin CHARACTERISTIC MoXTrqPtd_tqPtdFltTqLimLeadOffs_C "offset for the determination of MoXTrqPtd_flgPtdFltEngLimLeadDeactv_MP" VALUE 0x805448E6 RB_Val_Ws16 3276.700 Trq 0.00 3276.700 FORMAT "%8.3" EXTENDED_LIMITS -3276.800 3276.700 /end CHARACTERISTIC
/begin CHARACTERISTIC MoXTrqPtd_tqPtdFltTqLimSetOffs_C "offset for the determination of MoXTrqPtd_flgPtdFltEngLimSetDeactv_MP" VALUE 0x805448E8 RB_Val_Ws16 3276.700 Trq 0.00 3276.700 FORMAT "%8.3" EXTENDED_LIMITS -3276.800 3276.700 /end CHARACTERISTIC
/begin CHARACTERISTIC MoX_ctTrqCmpEngLimActvn_C "threshold for MoF_ctTrqCmp to activate torque limitation from extended monitoring" VALUE 0x805448EA RB_Val_Wu8 255.0 OneToOne 0.00 255.0 FORMAT "%5.1" /end CHARACTERISTIC
/begin CHARACTERISTIC MoX_rTrqPtdFltWgh_CUR "weighting of the filtered permissible torque in function monitoring" CURVE 0x805448EB RB_Curve_U8_U8 99.22 rel_q0p39 0.39 99.61 FORMAT "%5.2" EXTENDED_LIMITS 0.00 99.61
 /begin AXIS_DESCR STD_AXIS NO_INPUT_QUANTITY rel_q0p39 8 0.00 99.61 FORMAT "%5.2" DEPOSIT ABSOLUTE /end AXIS_DESCR
/end CHARACTERISTIC
/begin CHARACTERISTIC MoX_tiEvacIntMan_C "the discharge time of the intake manifold in extended monitoring" VALUE 0x805448FC RB_Val_Wu16 1310.720 t_q0p04 0.00 1310.720 FORMAT "%8.3" EXTENDED_LIMITS 0.00 2621.400 /end CHARACTERISTIC
/begin CHARACTERISTIC MoX_tiFltDash_C "low pass filter time constant for permissible torque in extended monitoring" VALUE 0x805448FE RB_Val_Wu16 2621.3600000 zk40msxs_uw_b2621p4 0.0400000 2621.4000000 FORMAT "%12.7" /end CHARACTERISTIC
/begin CHARACTERISTIC MoX_trqInrMaxStrt_C "maximum inner torque during start in extended monitoring" VALUE 0x80544900 RB_Val_Ws16 6553.500 md_q0p1 -3276.800 3276.700 FORMAT "%8.3" /end CHARACTERISTIC
/begin CHARACTERISTIC MoX_trqNorm_C "maximum indicated engine torque for torque standardisation" VALUE 0x80544902 RB_Val_Ws16 3276.700 md_q0p1 0.00 3276.700 FORMAT "%8.3" EXTENDED_LIMITS -3276.800 3276.700 /end CHARACTERISTIC
/begin CHARACTERISTIC MoX_trqOfs_MAP "offset for maximum permissible torque" MAP 0x80544904 RB_Map_S16S16_S16 6553.500 md_q0p1 -3276.800 3276.700 FORMAT "%8.3"
 /begin AXIS_DESCR STD_AXIS Epm_nEng EngN 8 -16384.00 16383.50 FORMAT "%8.2" DEPOSIT ABSOLUTE /end AXIS_DESCR
 /begin AXIS_DESCR STD_AXIS MoXTqPtd_tqInrDes md_q0p1 8 -3276.800 3276.700 FORMAT "%8.3" DEPOSIT ABSOLUTE /end AXIS_DESCR
/end CHARACTERISTIC
/begin CHARACTERISTIC PEnv_facCnvnSlopDig_C "conversion slope for ambient air pressure sensor digital" VALUE 0x805449A8 RB_Val_Wu16 0.9999847 fak_uw_b1 0.00 0.9999847 FORMAT "%9.7" /end CHARACTERISTIC
/begin CHARACTERISTIC PEnv_flgDiSnsrPlaus_C "Switch of fault detection of sensor internal plausible diagnosis if TRUE" VALUE 0x805449AA RB_Val_Wu8 1.00000000000 B_TRUE 0.00 1.00000000000 FORMAT "%13.11" /end CHARACTERISTIC
/begin CHARACTERISTIC PEnv_flgErrStEna_C "Fault simulation and healing simulation in combination with PEnv_stSensErrVal_C if value True, use this only for tests in calibration mode." VALUE 0x805449AB RB_Val_Wu8 1.00000000000 B_TRUE 0.00 1.00000000000 FORMAT "%13.11" /end CHARACTERISTIC
/begin CHARACTERISTIC PEnv_pAirFil_T "pressure difference at air filter" CURVE 0x805449C0 RB_Curve_S16_S16 5119.922 p_q0p078 -2560.000 2559.922 FORMAT "%8.3"
 /begin AXIS_DESCR STD_AXIS NO_INPUT_QUANTITY m_uw_b6553p5 8 -3276.800 3276.700 FORMAT "%8.3" DEPOSIT ABSOLUTE /end AXIS_DESCR
/end CHARACTERISTIC
/begin CHARACTERISTIC PEnv_pCnvnOffs_C "conversion offset for ambient air pressure sensor" VALUE 0x805449AC RB_Val_Wu16 2559.961 p_q0p039 0.00 2559.961 FORMAT "%8.3" /end CHARACTERISTIC
/begin CHARACTERISTIC PEnv_pDft_C "substitute value for ambient pressure in case of sensor failure" VALUE 0x805449E2 RB_Val_Wu16 2559.961 p_q0p039 0.00 2559.961 FORMAT "%8.3" /end CHARACTERISTIC
/begin CHARACTERISTIC PEnv_pDifEnvIntkVUsIniMax_C "Delta manifold pressure to max mod. ambient pressure in start" VALUE 0x805449E4 RB_Val_Wu16 2559.961 p_q0p039 0.00 2559.961 FORMAT "%8.3" /end CHARACTERISTIC
/begin CHARACTERISTIC PEnv_pDifEnvIntkVUsIniMin_C "Delta manifold pressure to min. mod. ambient pressure in start" VALUE 0x805449E6 RB_Val_Wu16 2559.961 p_q0p039 0.00 2559.961 FORMAT "%8.3" /end CHARACTERISTIC
/begin CHARACTERISTIC PEnv_pDifEnvIntkVUsMax_C "Delta manifold pressure to max. mod. ambient pressure" VALUE 0x805449E8 RB_Val_Wu16 2559.961 p_q0p039 0.00 2559.961 FORMAT "%8.3" /end CHARACTERISTIC
/begin CHARACTERISTIC PEnv_pDifEnvIntkVUsMin_C "Delta manifold pressure to min. mod. ambient pressure" VALUE 0x805449EA RB_Val_Wu16 2559.961 p_q0p039 0.00 2559.961 FORMAT "%8.3" /end CHARACTERISTIC
/begin CHARACTERISTIC PEnv_pDifJmpMax_C "upper limit for continuous check" VALUE 0x80544A08 RB_Val_Wu16 2559.961 p_q0p039 0.00 2559.961 FORMAT "%8.3" /end CHARACTERISTIC
/begin CHARACTERISTIC PEnv_pDifLdcMax_C "upper limit for comparison of ambient pressure from last-/actual driving cycle" VALUE 0x80544A0A RB_Val_Wu16 2559.961 p_q0p039 0.00 2559.961 FORMAT "%8.3" /end CHARACTERISTIC
/begin CHARACTERISTIC PEnv_pMaxSnsrTolr_C "max tolerances of ambient pressure sensor" VALUE 0x80544A0C RB_Val_Wu16 2559.961 p_q0p039 0.00 2559.961 FORMAT "%8.3" /end CHARACTERISTIC
/begin CHARACTERISTIC PEnv_pMdlMaxThd_C "upper threshold for modelled ambient pressure" VALUE 0x805449EC RB_Val_Wu16 2559.961 p_q0p039 0.00 2559.961 FORMAT "%8.3" /end CHARACTERISTIC
/begin CHARACTERISTIC PEnv_pPlausThdMax_C "upper limit for range check ambient pressure" VALUE 0x80544A0E RB_Val_Wu16 2559.961 p_q0p039 0.00 2559.961 FORMAT "%8.3" /end CHARACTERISTIC
/begin CHARACTERISTIC PEnv_pPlausThdMin_C "lower limit for range check ambient pressure" VALUE 0x80544A10 RB_Val_Wu16 2559.961 p_q0p039 0.00 2559.961 FORMAT "%8.3" /end CHARACTERISTIC
/begin CHARACTERISTIC PEnv_ratUnthrMdlTolr_C "Additional offset to throttle opening for determining unthrottled condition" VALUE 0x805449EE RB_Val_Wu16 99.99847 rel_uw_b100 0.00 99.99847 FORMAT "%8.5" /end CHARACTERISTIC
/begin CHARACTERISTIC PEnv_stSensErrVal_C "Fault simulation and healing simulation in combination with PEnv_flgErrStEna_C, use this only for tests in calibration mode. Fault simulation with error masks, e.g. OBS_SPI_ERR_MASK__CRC_ERROR, healing with the value zero." VALUE 0x805449B0 RB_Val_Wu32 4294967295.00 OneToOne 0.00 4294967295.00 FORMAT "%13.2" /end CHARACTERISTIC
/begin CHARACTERISTIC PEnv_swtCodDiag_C "Codeword plausibilty diagnosis ambient air pressure sensor" VALUE 0x80544A12 RB_Val_Wu8 255.0 dez 0.00 255.0 FORMAT "%5.1" /end CHARACTERISTIC
/begin CHARACTERISTIC PEnv_swtCodVd_C "Code word ambient presure adaptation via pressure sensor at the intake manifold" VALUE 0x805449F0 RB_Val_Wu8 255.0 dez 0.00 255.0 FORMAT "%5.1" /end CHARACTERISTIC
/begin CHARACTERISTIC PEnv_tiCcLT_C "time constant for ambient pressure lowpass filter in continuity check" VALUE 0x80544A14 RB_Val_Ws32 4294.9672940000000 TimeDelay_s 0.0000020000000 4294.9672959999998 FORMAT "%19.14" EXTENDED_LIMITS 0.000002000000001 4294.9672959999998 /end CHARACTERISTIC
/begin CHARACTERISTIC PEnv_tiDebSnsrPlaus_C "Debounce time for sensor reset due to plausibility faults" VALUE 0x805449B4 RB_Val_Ws32 2147.48364700 Time_Dt 0.00 2147.48364700 FORMAT "%13.8" EXTENDED_LIMITS -2147.48364800 2147.48364700 /end CHARACTERISTIC
/begin CHARACTERISTIC PEnv_tiDlyEnagMdl_C "turn on delay time for enabling PEnv model calculation" VALUE 0x805449F4 RB_Val_Ws32 2147.48364700 Time_Dt 0.00 2147.48364700 FORMAT "%13.8" EXTENDED_LIMITS -2147.48364800 2147.48364700 /end CHARACTERISTIC
/begin CHARACTERISTIC PEnv_tiDlyHealIntkVUs_C "Time delay for zyklus from comparison with manifold pressure" VALUE 0x805449F8 RB_Val_Ws32 2147.48364700 Time_Dt 0.00 2147.48364700 FORMAT "%13.8" EXTENDED_LIMITS -2147.48364800 2147.48364700 /end CHARACTERISTIC
/begin CHARACTERISTIC PEnv_tiDlyRawVld_C "delay for condition ambient pressure signal valid" VALUE 0x80544A18 RB_Val_Ws32 4294.96729500 Time_Dt -2147.48364800 2147.48364700 FORMAT "%13.8" /end CHARACTERISTIC
/begin CHARACTERISTIC PEnv_tiDlyTilPBal "Time delay until pressure balance in air system after engine stop" VALUE 0x805449FC RB_Val_Ws32 2147.48364700 Time_Dt 0.00 2147.48364700 FORMAT "%13.8" EXTENDED_LIMITS -2147.48364800 2147.48364700 /end CHARACTERISTIC
/begin CHARACTERISTIC PEnv_tiDrvDly_C "Time delay for sensor reset in drive" VALUE 0x805449B8 RB_Val_Ws32 2147.48364700 Time_Dt 0.00 2147.48364700 FORMAT "%13.8" EXTENDED_LIMITS -2147.48364800 2147.48364700 /end CHARACTERISTIC
/begin CHARACTERISTIC PEnv_tiPLT_C "time constant for filtering PEnv_p and PEnv_FacCorrAlti" VALUE 0x80544A00 RB_Val_Ws32 2147.48364700 Time_Dt 0.00 2147.48364700 FORMAT "%13.8" EXTENDED_LIMITS -2147.48364800 2147.48364700 /end CHARACTERISTIC
/begin CHARACTERISTIC PEnv_tiSnsrBootDly_C "Time delay for sensor boot up after reset" VALUE 0x805449BC RB_Val_Ws32 2147.48364700 Time_Dt 0.00 2147.48364700 FORMAT "%13.8" EXTENDED_LIMITS -2147.48364800 2147.48364700 /end CHARACTERISTIC
/begin CHARACTERISTIC PEnv_tiStrtReplVld_C "Time after end of start at which PEnv_p corresponds to PEnv_p at the start" VALUE 0x80544A04 RB_Val_Wu16 6553.500 t100msxs_uw_b6553p5 0.00 6553.500 FORMAT "%8.3" /end CHARACTERISTIC
/begin CHARACTERISTIC SF_PU "Sum Fault PU" VAL_BLK 0x80544A1C RB_ValA_Wu16 82.0000000000 dfp_verbal 0.00 82.0000000000 FORMAT "%13.10" READ_ONLY NUMBER 5 /end CHARACTERISTIC
/begin CHARACTERISTIC TDGTUMTRIG "Delay time for B_trigcomp" VALUE 0x80544A2A RB_Val_Wu16 6553.500 t_q0p1 0.00 6553.500 FORMAT "%8.3" /end CHARACTERISTIC
/begin CHARACTERISTIC TUMTAI "initial value of ambient temperature" VALUE 0x80544A2C RB_Val_Wu8 191.3 temp_ub_q0p75_o48 -48.0 143.3 FORMAT "%5.1" /end CHARACTERISTIC
/begin MEASUREMENT B_gtumg_msg "validity of ambient temperature, set if model parth is determined, valid and actual or if there is no error in the sensor value" UBYTE B_TRUE 1 100 0.00 1.00000000000 BIT_MASK 0x1 FORMAT "%13.11" ECU_ADDRESS 0x70000BAE /end MEASUREMENT
/begin MEASUREMENT B_pugg_msg "condition: ambient pressure from sensor valid" UBYTE B_TRUE 1 100 0.00 1.00000000000 BIT_MASK 0x1 FORMAT "%13.11" ECU_ADDRESS 0x70000B39 /end MEASUREMENT
/begin MEASUREMENT B_pug_msg "condition: ambient pressure valid" UBYTE B_TRUE 1 100 0.00 1.00000000000 BIT_MASK 0x1 FORMAT "%13.11" ECU_ADDRESS 0x6000EE91 /end MEASUREMENT
/begin MEASUREMENT B_purg_msg "Condition ambient pressure sensor valid" UBYTE B_TRUE 1 100 0.00 1.00000000000 BIT_MASK 0x1 FORMAT "%13.11" ECU_ADDRESS 0x70000B38 /end MEASUREMENT
/begin MEASUREMENT B_trigcomp_msg "condition: calculated ambient temperature was updated" UBYTE B_TRUE 1 100 0.00 1.00000000000 BIT_MASK 0x1 FORMAT "%13.11" ECU_ADDRESS 0x70000B04 /end MEASUREMENT
/begin MEASUREMENT B_tumgg_envtifloc "condition: ambient air temperature sensormodel is error free(loc)" UBYTE B_TRUE 1 100 0.00 1.00000000000 BIT_MASK 0x1 FORMAT "%13.11" ECU_ADDRESS 0x700002BF /end MEASUREMENT
/begin MEASUREMENT B_tumgg_msg "condition: ambient air temperature sensormodel is error free" UBYTE B_TRUE 1 100 0.00 1.00000000000 BIT_MASK 0x1 FORMAT "%13.11" ECU_ADDRESS 0x70000B00 /end MEASUREMENT
/begin MEASUREMENT B_tummg_msg "inputs for ambient air temperature model without errors" UBYTE B_TRUE 1 100 0.00 1.00000000000 BIT_MASK 0x1 FORMAT "%13.11" ECU_ADDRESS 0x70000AFF /end MEASUREMENT
/begin MEASUREMENT B_tumnpl_msg "Condition ambient air temperature not plausible" UBYTE B_TRUE 1 100 0.00 1.00000000000 BIT_MASK 0x1 FORMAT "%13.11" ECU_ADDRESS 0x70000AFE /end MEASUREMENT
/begin MEASUREMENT Com_ctReIni10msEPB "ReInit Counter for EPB frame" UBYTE OneToOne 1 100 0.00 255.0 FORMAT "%5.1" ECU_ADDRESS 0x6000B18E /end MEASUREMENT
/begin MEASUREMENT Com_stRxEPB "EPB frame reception status" UBYTE OneToOne 1 100 0.00 255.0 FORMAT "%5.1" ECU_ADDRESS 0x6000F552 /end MEASUREMENT
/begin MEASUREMENT EngTrqPtd_trqLead "Limiting torque of lead path from the monitoring" SWORD md_q0p1 1 100 -3276.800 3276.700 FORMAT "%8.3" ECU_ADDRESS 0x60013EB4 /end MEASUREMENT
/begin MEASUREMENT EngTrqPtd_trqLeadWoResv "maximum permissible torque for lead path without reserve" SWORD md_q0p1 1 100 -3276.800 3276.700 FORMAT "%8.3" ECU_ADDRESS 0x6000915E /end MEASUREMENT
/begin MEASUREMENT EngTrqPtd_trqSet "Limiting torque of setpoint path from the monitoring" SWORD md_q0p1 1 100 -3276.800 3276.700 FORMAT "%8.3" ECU_ADDRESS 0x60013EB6 /end MEASUREMENT
/begin MEASUREMENT EngTrqPtd_trqSetWoTraIntv "maximum permissible torque for lead path without gearbox intervention" SWORD md_q0p1 1 100 -3276.800 3276.700 FORMAT "%8.3" ECU_ADDRESS 0x6000915C /end MEASUREMENT
/begin MEASUREMENT EnvT_bActvCSC "Bit: Cold start check of the EnvT activated" UBYTE B_TRUE 1 100 0.00 1.00000000000 BIT_MASK 0x1 FORMAT "%13.11" ECU_ADDRESS 0x70000992 /end MEASUREMENT
/begin MEASUREMENT EnvT_bActvDfl "Bit: activation of the test-mode of the EnvT" UBYTE B_TRUE 1 100 0.00 1.00000000000 BIT_MASK 0x1 FORMAT "%13.11" ECU_ADDRESS 0x70000991 /end MEASUREMENT
/begin MEASUREMENT EnvT_bActvMBC "Bit: Model based Check of the EnvT activated" UBYTE B_TRUE 1 100 0.00 1.00000000000 BIT_MASK 0x1 FORMAT "%13.11" ECU_ADDRESS 0x70000990 /end MEASUREMENT
/begin MEASUREMENT EnvT_bActvPRC "Bit: Physical value range check of the EnvT active" UBYTE B_TRUE 1 100 0.00 1.00000000000 BIT_MASK 0x1 FORMAT "%13.11" ECU_ADDRESS 0x7000098F /end MEASUREMENT
/begin MEASUREMENT EnvT_bActvSens "Bit: Sensor of the EnvT available and to be used for EnvT" UBYTE B_TRUE 1 100 0.00 1.00000000000 BIT_MASK 0x1 FORMAT "%13.11" ECU_ADDRESS 0x7000098E /end MEASUREMENT
/begin MEASUREMENT EnvT_bActvSensADC "ADC sensor is present und used in EnvT" UBYTE B_TRUE 1 100 0.00 1.00000000000 BIT_MASK 0x1 FORMAT "%13.11" ECU_ADDRESS 0x7000098D /end MEASUREMENT
/begin MEASUREMENT EnvT_bActvSensCAN "Bit: CAN sensor of the EnvT available and to be used for EnvT" UBYTE B_TRUE 1 100 0.00 1.00000000000 BIT_MASK 0x1 FORMAT "%13.11" ECU_ADDRESS 0x7000098C /end MEASUREMENT
/begin MEASUREMENT EnvT_bActvSensMod "Bit: Activation of the sensor based EnvT model" UBYTE B_TRUE 1 100 0.00 1.00000000000 BIT_MASK 0x1 FORMAT "%13.11" ECU_ADDRESS 0x7000098B /end MEASUREMENT
/begin MEASUREMENT EnvT_bModCS "Bit: cold start for EnvT-Modelling detected" UBYTE B_TRUE 1 100 0.00 1.00000000000 BIT_MASK 0x1 FORMAT "%13.11" ECU_ADDRESS 0x7000098A /end MEASUREMENT
/begin MEASUREMENT EnvT_bModHotDet "Bit: Detection that engine is hot in EnvT-Modelling" UBYTE B_TRUE 1 100 0.00 1.00000000000 BIT_MASK 0x1 FORMAT "%13.11" ECU_ADDRESS 0x700002BB /end MEASUREMENT
/begin MEASUREMENT EnvT_bModPrms "Bit: Release of EnvT-Modelling within EnvT" UBYTE B_TRUE 1 100 0.00 1.00000000000 BIT_MASK 0x1 FORMAT "%13.11" ECU_ADDRESS 0x700002BA /end MEASUREMENT
/begin MEASUREMENT EnvT_bModRels "Bit: Release of EnvT-Modelling within EnvT" UBYTE B_TRUE 1 100 0.00 1.00000000000 BIT_MASK 0x1 FORMAT "%13.11" ECU_ADDRESS 0x700002B9 /end MEASUREMENT
/begin MEASUREMENT EnvT_bModSty "Bit: Condition fullfilled for model release" UBYTE B_TRUE 1 100 0.00 1.00000000000 BIT_MASK 0x1 FORMAT "%13.11" ECU_ADDRESS 0x700002B8 /end MEASUREMENT
/begin MEASUREMENT EnvT_bModStyCnd "Bit: Condition fullfilled for model release" UBYTE B_TRUE 1 100 0.00 1.00000000000 BIT_MASK 0x1 FORMAT "%13.11" ECU_ADDRESS 0x700002B7 /end MEASUREMENT
/begin MEASUREMENT EnvT_bModWrm "Bit: Condition engine warm" UBYTE B_TRUE 1 100 0.00 1.00000000000 BIT_MASK 0x1 FORMAT "%13.11" ECU_ADDRESS 0x700002B6 /end MEASUREMENT
/begin MEASUREMENT EnvT_bPrimModBas "Validity the basis value (intake air temperature) for determination of the primary EnvT-Model" UBYTE B_TRUE 1 100 0.00 1.00000000000 BIT_MASK 0x1 FORMAT "%13.11" ECU_ADDRESS 0x700002B5 /end MEASUREMENT
/begin MEASUREMENT EnvT_bPrimModBasMin "Validity the basis value from Min-Selection of intake air temperature for determination of the primary EnvT-Model" UBYTE B_TRUE 1 100 0.00 1.00000000000 BIT_MASK 0x1 FORMAT "%13.11" ECU_ADDRESS 0x700002B4 /end MEASUREMENT
/begin MEASUREMENT EnvT_bTSensFrz "Condition valid sensor value present" UBYTE B_TRUE 1 100 0.00 1.00000000000 BIT_MASK 0x1 FORMAT "%13.11" ECU_ADDRESS 0x700002BE /end MEASUREMENT
/begin MEASUREMENT EnvT_bTSensFrznVal "condition: back up valid sensor value available" UBYTE B_TRUE 1 100 0.00 1.00000000000 BIT_MASK 0x1 FORMAT "%13.11" ECU_ADDRESS 0x700002BD /end MEASUREMENT
/begin MEASUREMENT EnvT_bTSensIntrLstVal "Condition replacement value for ambient temperature without CAN communication" UBYTE B_TRUE 1 100 0.00 1.00000000000 BIT_MASK 0x1 FORMAT "%13.11" ECU_ADDRESS 0x60036DCF /end MEASUREMENT
/begin MEASUREMENT EnvT_bTTiCmu "Condition of substitute value for ambient temperature of CAN communication" UBYTE B_TRUE 1 100 0.00 1.00000000000 BIT_MASK 0x1 FORMAT "%13.11" ECU_ADDRESS 0x700002BC /end MEASUREMENT
/begin MEASUREMENT EnvT_mAirAcmThdCrvVal "Air Mass threshold for Ambient Temperature release from EnvT_mAirAcmThdMdlRels_T" SWORD AirMassKg 1 100 -327.6800 327.6700 FORMAT "%8.4" ECU_ADDRESS 0x60007160 /end MEASUREMENT
/begin MEASUREMENT EnvT_mAirAcmThdMdlRels "Threshold for the Accumulated Air mass to release the Environment Temperature model" SWORD AirMassKg 1 100 -327.6800 327.6700 FORMAT "%8.4" ECU_ADDRESS 0x6000715E /end MEASUREMENT
/begin MEASUREMENT EnvT_mAirAcmThdOldVal "Previous value from the curve EnvT_mAirAcmThdMdlRels_T" SWORD AirMassKg 1 100 -327.6800 327.6700 FORMAT "%8.4" ECU_ADDRESS 0x6000715C /end MEASUREMENT
/begin MEASUREMENT EnvT_mAirAcmThdVal "Limited threshold for the accumulated Air mass" SWORD AirMassKg 1 100 -327.6800 327.6700 FORMAT "%8.4" ECU_ADDRESS 0x6000715A /end MEASUREMENT
/begin MEASUREMENT EnvT_mAirMod "Air mass to determine the EnvT-modelling" SWORD AirMassKg 1 100 -327.6800 327.6700 FORMAT "%8.4" ECU_ADDRESS 0x60007158 /end MEASUREMENT
/begin MEASUREMENT EnvT_mAirModInt "Air mass to determine the EnvT-modelling" SLONG AirMassPerTime 1 100 -214748364.800 214748364.700 FORMAT "%13.3" ECU_ADDRESS 0x50001760 /end MEASUREMENT
/begin MEASUREMENT EnvT_mfAirCylStyMod "Copy of AirMod_mfAirCyl for Ambient Temperature steady state model" SWORD AirMassPerTime 1 100 -3276.800 3276.700 FORMAT "%8.3" ECU_ADDRESS 0x60007156 /end MEASUREMENT
/begin MEASUREMENT EnvT_nEngStyMod "Copy of Epm_nEng for Ambient Temperature Model" SWORD EngN 1 100 -16384.00 16383.50 FORMAT "%8.2" ECU_ADDRESS 0x60007154 /end MEASUREMENT
/begin MEASUREMENT EnvT_stEepReadMdl "EEP Read status" UBYTE OneToOne 1 100 0.00 255.0 FORMAT "%5.1" ECU_ADDRESS 0x6000B191 /end MEASUREMENT
/begin MEASUREMENT EnvT_stSigT "Status to indicate signal quality of sensor value" UBYTE OneToOne 1 100 0.00 255.0 FORMAT "%5.1" ECU_ADDRESS 0x6000EFA5 /end MEASUREMENT
/begin MEASUREMENT EnvT_stTPrimMod "state of primary envt-model" UBYTE OneToOne 1 100 0.00 255.0 FORMAT "%5.1" ECU_ADDRESS 0x6000B190 /end MEASUREMENT
/begin MEASUREMENT EnvT_stTReplMod "state of envt-model for replacement" UBYTE OneToOne 1 100 0.00 255.0 FORMAT "%5.1" ECU_ADDRESS 0x6000EFA4 /end MEASUREMENT
/begin MEASUREMENT EnvT_stTReplModIntr "state of envt-model for replacement internal" UBYTE OneToOne 1 100 0.00 255.0 FORMAT "%5.1" ECU_ADDRESS 0x6000B195 /end MEASUREMENT
/begin MEASUREMENT EnvT_stTReplModLoc "state of envt-model for replacement" UBYTE OneToOne 1 100 0.00 255.0 FORMAT "%5.1" ECU_ADDRESS 0x6000B18F /end MEASUREMENT
/begin MEASUREMENT EnvT_stTSensIntr "Status of the sensor available via CAN or ADC" UBYTE OneToOne 1 100 0.00 255.0 FORMAT "%5.1" ECU_ADDRESS 0x6000B194 /end MEASUREMENT
/begin MEASUREMENT EnvT_stTSensModIntr "Internal status of the sensor based model" UBYTE OneToOne 1 100 0.00 255.0 FORMAT "%5.1" ECU_ADDRESS 0x6000B193 /end MEASUREMENT
/begin MEASUREMENT EnvT_swtTSrcSel "Status of selection sensor" UBYTE OneToOne 1 100 0.00 255.0 FORMAT "%5.1" ECU_ADDRESS 0x6000B192 /end MEASUREMENT
/begin MEASUREMENT EnvT_t "Environment temperature signal (with replacement reaction in case of sensor error)" SWORD Temp_Cels 1 100 -3549.940 3003.560 FORMAT "%8.3" ECU_ADDRESS 0x60008992 /end MEASUREMENT
/begin MEASUREMENT EnvT_tCACRepl "Replacement value of the ambient temperature without CAN communication" SWORD Temp_Cels 1 100 -3549.940 3003.560 FORMAT "%8.3" ECU_ADDRESS 0x6000716A /end MEASUREMENT
/begin MEASUREMENT EnvT_tDifTIntkTEnvMdl "Difference between the Intake Temperature and the modelled Ambient Temperature" SWORD Temp_Cels 1 100 -3549.940 3003.560 FORMAT "%8.3" ECU_ADDRESS 0x60007152 /end MEASUREMENT
/begin MEASUREMENT EnvT_tiModWrmCntr "Time, the engine is in state warm" UWORD t_q1 1 100 0.00 65535.00 FORMAT "%8.2" ECU_ADDRESS 0x60007150 /end MEASUREMENT
/begin MEASUREMENT EnvT_tMdl2 "Ambient Temperature Model value for Oil deterioration system" SWORD Temp_Cels 1 100 -3549.940 3003.560 FORMAT "%8.3" ECU_ADDRESS 0x60008990 /end MEASUREMENT
/begin MEASUREMENT EnvT_tModCS "EnvT-Modelling in Cold start" SWORD Temp_Cels 1 100 -3549.940 3003.560 FORMAT "%8.3" ECU_ADDRESS 0x6000714E /end MEASUREMENT
/begin MEASUREMENT EnvT_tModHeatgIndcr "Auxillary variable to determine the offset between intake air temperature and EnvT" SWORD Temp_Cels 1 100 -3549.940 3003.560 FORMAT "%8.3" ECU_ADDRESS 0x6000714C /end MEASUREMENT
/begin MEASUREMENT EnvT_tModHeatgIndcrFlt "Offset between intake air temperature and EnvT (filtered)" SWORD Temp_Cels 1 100 -3549.940 3003.560 FORMAT "%8.3" ECU_ADDRESS 0x6000714A /end MEASUREMENT
/begin MEASUREMENT EnvT_tModHeatingIndcr "Offset between intake air temperature and EnvT" SWORD Temp_Cels 1 100 -3549.940 3003.560 FORMAT "%8.3" ECU_ADDRESS 0x60007148 /end MEASUREMENT
/begin MEASUREMENT EnvT_tPrimMod "Value of the primary model of the EnvT" SWORD Temp_Cels 1 100 -3549.940 3003.560 FORMAT "%8.3" ECU_ADDRESS 0x600390BA /end MEASUREMENT
/begin MEASUREMENT EnvT_tPrimModBas "value of the base (intake air temperature) for determination of the primary EnvT-Model" SWORD Temp_Cels 1 100 -3549.940 3003.560 FORMAT "%8.3" ECU_ADDRESS 0x60007146 /end MEASUREMENT
/begin MEASUREMENT EnvT_tPrimModBasMin "minimal base value (intake air temperature) for determination the primary EnvT-Model" SWORD Temp_Cels 1 100 -3549.940 3003.560 FORMAT "%8.3" ECU_ADDRESS 0x60007144 /end MEASUREMENT
/begin MEASUREMENT EnvT_tReplMod "Value of the EnvT-Model for replacement" SWORD Temp_Cels 1 100 -3549.940 3003.560 FORMAT "%8.3" ECU_ADDRESS 0x6000898C /end MEASUREMENT
/begin MEASUREMENT EnvT_tReplModIntr "Internal value of the environment temperature model for a substitute value" SWORD Temp_Cels 1 100 -3549.940 3003.560 FORMAT "%8.3" ECU_ADDRESS 0x60007168 /end MEASUREMENT
/begin MEASUREMENT EnvT_tReplModLoc "Value of the EnvT-Model for replacement" SWORD Temp_Cels 1 100 -3549.940 3003.560 FORMAT "%8.3" ECU_ADDRESS 0x60007142 /end MEASUREMENT
/begin MEASUREMENT EnvT_tSensFrz "sensor value of the ambient temperature maintained" SWORD Temp_Cels 1 100 -3549.940 3003.560 FORMAT "%8.3" ECU_ADDRESS 0x60007166 /end MEASUREMENT
/begin MEASUREMENT EnvT_tSensIntr "Internal sensor value of the ambient temperature" SWORD Temp_Cels 1 100 -3549.940 3003.560 FORMAT "%8.3" ECU_ADDRESS 0x60007164 /end MEASUREMENT
/begin MEASUREMENT EnvT_tSensIntrLstVal "Last valid sensor value of the environment temperature" SWORD Temp_Cels 1 100 -3549.940 3003.560 FORMAT "%8.3" ECU_ADDRESS 0x600390BC /end MEASUREMENT
/begin MEASUREMENT EnvT_tSensLstVal "Message to update stored ambient temperature value" SWORD Temp_Cels 1 100 -3549.940 3003.560 FORMAT "%8.3" ECU_ADDRESS 0x6000898A /end MEASUREMENT
/begin MEASUREMENT EnvT_tSensModIntr "Internal copy of the sensor based modeling of the EnvT" SWORD Temp_Cels 1 100 -3549.940 3003.560 FORMAT "%8.3" ECU_ADDRESS 0x60007162 /end MEASUREMENT
/begin MEASUREMENT EnvT_tSigVal "Environment temperature value for the tester" UBYTE temp_q1p0_o40_degC 1 100 -40.0 215.0 FORMAT "%5.1" ECU_ADDRESS 0x6000EFA3 /end MEASUREMENT
/begin MEASUREMENT EnvT_tStyMod "Value of the steady model of the EnvT" SWORD Temp_Cels 1 100 -3549.940 3003.560 FORMAT "%8.3" ECU_ADDRESS 0x60007140 /end MEASUREMENT
/begin MEASUREMENT EnvT_t_Sq "10) Signal Quality of Environment Temperature." UBYTE SigQly_COMPU_VERB 1 100 0.00 15.0000000000 FORMAT "%13.10" ECU_ADDRESS 0x6000EFA2 /end MEASUREMENT
/begin MEASUREMENT EnvT_vVehStyMod "Copy of VehV_v for Ambient Temperature model" SWORD Vel 1 100 -327.6800 327.6700 FORMAT "%8.4" ECU_ADDRESS 0x6000713E /end MEASUREMENT
/begin MEASUREMENT EpmBCa_ctInjSer "current number of testinjections done in series" UBYTE OneToOne 1 100 0.00 255.0 FORMAT "%5.1" ECU_ADDRESS 0x6000B18D /end MEASUREMENT
/begin MEASUREMENT EpmBCa_ctTstInj "number of testinjections since start of backup-camshaft" UWORD OneToOne 1 100 0.00 65535.00 FORMAT "%8.2" ECU_ADDRESS 0x6000713C /end MEASUREMENT
/begin MEASUREMENT EpmBCa_CurrCyl "current cylinder for which the factor of the segment-times should be calculated" UBYTE OneToOne 1 100 0.00 255.0 FORMAT "%5.1" ECU_ADDRESS 0x6000B18C /end MEASUREMENT
/begin MEASUREMENT EpmBCa_facTimes_mp "Factor of the segment-times belonging to the last cylinder in EpmBCa_CurrCyl" SWORD EpmBCa_FacTstInj 1 100 -32.76800 32.76700 FORMAT "%8.5" ECU_ADDRESS 0x70009D22 /end MEASUREMENT
/begin MEASUREMENT EpmBCa_phiSegDst "Distance between the two segments for engine-speed-acceleration detection" SWORD AngleCrS 1 100 -720.0000 719.9780 FORMAT "%8.4" ECU_ADDRESS 0x6000713A /end MEASUREMENT
/begin MEASUREMENT EpmBCa_stInjMask "Fade-out mask of injection for backup mode wo camshaft" UBYTE OneToOne 1 100 0.00 255.0 FORMAT "%5.1" ECU_ADDRESS 0x6000F850 /end MEASUREMENT
/begin MEASUREMENT EpmBCa_stTstInj "current state of statemachine EpmBCa_TstInj" UBYTE EpmBCa_stTstInj_State_t 1 100 0.00 5.00000000000 FORMAT "%13.11" ECU_ADDRESS 0x6000B18B /end MEASUREMENT
/begin MEASUREMENT EpmBCa_stTstInjRslt_mp "Result-Parameter of function EpmBCa_TstInj for Epm_OpMode" UBYTE OneToOne 1 100 0.00 255.0 FORMAT "%5.1" ECU_ADDRESS 0x70009FB9 /end MEASUREMENT
/begin MEASUREMENT EpmBCa_tiSegOld_mp "Segment-time of old segment in us" SLONG OneToOne_us 1 100 -2147483648.00 2147483647.00 FORMAT "%13.2" ECU_ADDRESS 0x70009BD0 /end MEASUREMENT
/begin MEASUREMENT EpmBCa_tiSeg_mp "Segment-time of new segment in us" SLONG OneToOne_us 1 100 -2147483648.00 2147483647.00 FORMAT "%13.2" ECU_ADDRESS 0x70009BCC /end MEASUREMENT
/begin MEASUREMENT EpmBCr_agCasEdge "Angle clock value captured at camshaft edge event in backup crankshaft mode" ULONG OneToOne 1 100 0.00 4294967295.00 FORMAT "%13.2" ECU_ADDRESS 0x60002B9C /end MEASUREMENT
/begin MEASUREMENT EpmBCr_agCurr "Current Angle clock value for the detection of loss of camshaft signal in backup crankshaft mode" ULONG OneToOne 1 100 0.00 4294967295.00 FORMAT "%13.2" ECU_ADDRESS 0x60002B98 /end MEASUREMENT
/begin MEASUREMENT EpmBCr_ctCaSRev "counter for camshaft-revolutions without plausibility" UBYTE OneToOne 1 100 0.00 255.0 FORMAT "%5.1" ECU_ADDRESS 0x6000B18A /end MEASUREMENT
/begin MEASUREMENT EpmBCr_ctEdge "Edge counter during the backup crankshaft" UBYTE OneToOne 1 100 0.00 255.0 FORMAT "%5.1" ECU_ADDRESS 0x6000B189 /end MEASUREMENT
/begin MEASUREMENT EpmBCr_ctEdgeRefTabIdx "pointer to the angle in the cas-ref-tab of the next edge on the CaS" UBYTE OneToOne 1 100 0.00 255.0 FORMAT "%5.1" ARRAY_SIZE 1 ECU_ADDRESS 0x6000B180 /end MEASUREMENT
/begin MEASUREMENT EpmBCr_ctPttMtchFail "Counter for tolerated (as unprecise) segment times" UBYTE OneToOne 1 100 0.00 255.0 FORMAT "%5.1" ECU_ADDRESS 0x6000095C /end MEASUREMENT
/begin MEASUREMENT EpmBCr_ctPttMtchFailEdge "Counter for CaS edge when backup mode is in tolerance state" UBYTE OneToOne 1 100 0.00 255.0 FORMAT "%5.1" ECU_ADDRESS 0x6000095D /end MEASUREMENT
/begin MEASUREMENT EpmBCr_eveIdPriCamShft "Indicates event id for Primary camshaft edge event" UWORD OneToOne 1 100 0.00 65535.00 FORMAT "%8.2" ECU_ADDRESS 0x60007134 /end MEASUREMENT
/begin MEASUREMENT EpmBCr_facPlaus "Factor used for the calculation of timeout angle to detect loss of camshaft signal in backup crankshaft mode" UBYTE OneToOne 1 100 0.00 255.0 FORMAT "%5.1" ECU_ADDRESS 0x6000B181 /end MEASUREMENT
/begin MEASUREMENT EpmBCr_flgStrtDirectAllwd "Indicator whether a direct activation (no error debounce of crankshaft sensor signal) of backupmode (wo crankshaft signal) is currently possible." UBYTE OneToOne 1 100 0.00 255.0 BIT_MASK 0x1 FORMAT "%5.1" ECU_ADDRESS 0x6001412A /end MEASUREMENT
/begin MEASUREMENT EpmBCr_idxPttSync "Index of pattern where synchronisation currently happens" UBYTE OneToOne 1 100 0.00 255.0 FORMAT "%5.1" ECU_ADDRESS 0x6000F8AD /end MEASUREMENT
/begin MEASUREMENT EpmBCr_lvlCaSCurr_mp "Camshaft current level information in Back-up mode" UBYTE OneToOne 1 100 0.00 255.0 FORMAT "%5.1" ECU_ADDRESS 0x70009FB8 /end MEASUREMENT
/begin MEASUREMENT EpmBCr_nEng "engine speed calculated during backup crankshaft" SWORD EngN 1 100 -16384.00 16383.50 FORMAT "%8.2" ECU_ADDRESS 0x6000712C /end MEASUREMENT
/begin MEASUREMENT EpmBCr_nrEdg2NxtSync_mp "Number of edges between current edge (at which synchronisation happened) and last sync mark." UBYTE OneToOne 1 100 0.00 255.0 FORMAT "%5.1" ECU_ADDRESS 0x70009FB7 /end MEASUREMENT
/begin MEASUREMENT EpmBCr_nrPttMtchAtIndx_mp "Index of edge where pattern has been recognized" UBYTE OneToOne 1 100 0.00 255.0 FORMAT "%5.1" ECU_ADDRESS 0x70009FB6 /end MEASUREMENT
/begin MEASUREMENT EpmBCr_numCtgryPttCur_mp "Number of pattern category based on CaS edge time stamps at the current edge" ULONG OneToOne 1 100 0.00 4294967295.00 FORMAT "%13.2" ECU_ADDRESS 0x70009AE8 /end MEASUREMENT
/begin MEASUREMENT EpmBCr_numCtgryPtt_mp "Camshaft pattern for each camshaft edge" ULONG OneToOne 1 100 0.00 4294967295.00 FORMAT "%13.2" ARRAY_SIZE 16 ECU_ADDRESS 0x70009B8C /end MEASUREMENT
/begin MEASUREMENT EpmBCr_numEdg2NxtEquiEdge_mp "Number of CaS edges between the current edge and the next equidistant edge" UBYTE OneToOne 1 100 0.00 255.0 FORMAT "%5.1" ECU_ADDRESS 0x70009FB5 /end MEASUREMENT
/begin MEASUREMENT EpmBcr_numEdgEqui "Number of equidistant edges on current camshaft flywheel, calculated by and for use in EpmBCr" UBYTE OneToOne 1 100 0.00 255.0 FORMAT "%5.1" ECU_ADDRESS 0x6000B188 /end MEASUREMENT
/begin MEASUREMENT EpmBcr_numPttPlaus "Number of required patterns (of ratios of segmentlengths) on the current camshaft flywheel, for being able to detect a unique position." UBYTE OneToOne 1 100 0.00 255.0 FORMAT "%5.1" ECU_ADDRESS 0x6000B187 /end MEASUREMENT
/begin MEASUREMENT EpmBcr_numSeg2Sync "Number of required segment timestamps to calculate a pattern of ratios to detect the position on the currently mounted camshaft flywheel" UBYTE OneToOne 1 100 0.00 255.0 FORMAT "%5.1" ECU_ADDRESS 0x6000B186 /end MEASUREMENT
/begin MEASUREMENT EpmBCr_numSegPtt "Number of required segments to determine a unique position" UBYTE OneToOne 1 100 0.00 255.0 FORMAT "%5.1" ECU_ADDRESS 0x6000B185 /end MEASUREMENT
/begin MEASUREMENT EpmBcr_numSyncMark "Number of synchro marks on the camshaft flywheel" UBYTE OneToOne 1 100 0.00 255.0 FORMAT "%5.1" ECU_ADDRESS 0x6000B184 /end MEASUREMENT
/begin MEASUREMENT EpmBCr_phiCaSPos "Position of the camshaft at equidistant edges" SWORD AngleCrS 1 100 -720.0000 719.9780 FORMAT "%8.4" ECU_ADDRESS 0x60007138 /end MEASUREMENT
/begin MEASUREMENT EpmBCr_phiCurrCaSEdge "position of current detected camshaft edge during backup crankshaft" SWORD AngleCrS 1 100 -720.0000 719.9780 FORMAT "%8.4" ARRAY_SIZE 1 ECU_ADDRESS 0x60007132 /end MEASUREMENT
/begin MEASUREMENT EpmBCr_phiLastCaSEdge "The last Camshaft edge per Camshaft" SWORD AngleCrS 1 100 -720.0000 719.9780 FORMAT "%8.4" ARRAY_SIZE 1 ECU_ADDRESS 0x60007130 /end MEASUREMENT
/begin MEASUREMENT EpmBCr_phiNxtCaSEdge "position of the next expected camshaft edge during backup crankshaft" SWORD AngleCrS 1 100 -720.0000 719.9780 FORMAT "%8.4" ECU_ADDRESS 0x6000712A /end MEASUREMENT
/begin MEASUREMENT EpmBCr_phiPos "engine postion at time of Interrupt at a segment-edge of the camshaft" SWORD AngleCrS 1 100 -720.0000 719.9780 FORMAT "%8.4" ECU_ADDRESS 0x60007128 /end MEASUREMENT
/begin MEASUREMENT EpmBCr_phiPtt_mp "Angle position of every camshaft edge where a pattern was assigned to" SWORD AngleCrS 1 100 -720.0000 719.9780 FORMAT "%8.4" ARRAY_SIZE 10 ECU_ADDRESS 0x70009D0E /end MEASUREMENT
/begin MEASUREMENT EpmBCr_phiSeg2Seg "distance between the segmentedges" SWORD AngleCrS 1 100 -720.0000 719.9780 FORMAT "%8.4" ECU_ADDRESS 0x60007136 /end MEASUREMENT
/begin MEASUREMENT EpmBCr_phiWaitNoSig "Timeout angle from a previous camshaft edge within which next camshaft edge is expected" SWORD AngleCrS 1 100 -720.0000 719.9780 FORMAT "%8.4" ECU_ADDRESS 0x6000712E /end MEASUREMENT
/begin MEASUREMENT EpmBCr_phiZero2Sync "Internal prototype size for defining the position Syncmark" SWORD OneToOne 1 100 -32768.00 32767.00 FORMAT "%8.2" ARRAY_SIZE 10 ECU_ADDRESS 0x50005544 /end MEASUREMENT
/begin MEASUREMENT EpmBCr_rSeg2SegCurr_mp "Ratio of the recent two segment lengths at the current camshaft edge in backup mode without crankshaft sensor" ULONG EPMBCR_FACRATIO 1 100 0.00 4294967.29500 FORMAT "%13.5" ECU_ADDRESS 0x70009B88 /end MEASUREMENT
/begin MEASUREMENT EpmBCr_rSeg2Seg_mpA "Ratio of the recent two segment lengths at all camshaft edges in backup mode without crankshaft sensor" ULONG EPMBCR_FACRATIO 1 100 0.00 4294967.29500 FORMAT "%13.5" ARRAY_SIZE 16 ECU_ADDRESS 0x70009B48 /end MEASUREMENT
/begin MEASUREMENT EpmBCr_stDetailed_mp "Detailed status of backup mode without crankshaft" UBYTE EpmBCr_Plaus_StatusDetails_CM 1 100 0.00 8.00000000000 FORMAT "%13.11" ECU_ADDRESS 0x70009FB4 /end MEASUREMENT
/begin MEASUREMENT EpmBCr_stDSMRdy "DSM init state used by the FC" UBYTE OneToOne 1 100 0.00 255.0 BIT_MASK 0x1 FORMAT "%5.1" ECU_ADDRESS 0x7000302E /end MEASUREMENT
/begin MEASUREMENT EpmBCr_stIniPttFail "Status to display whether initialization of EpmBCr_Plaus has possibly failed" UBYTE OneToOne 1 100 0.00 255.0 FORMAT "%5.1" ECU_ADDRESS 0x6000B183 /end MEASUREMENT
/begin MEASUREMENT EpmBCr_stOpModeOld "operation Mode Old" UBYTE Epm_stOpMode_State_t 1 100 1.0000000000 60.0000000000 FORMAT "%13.10" ECU_ADDRESS 0x7000545B /end MEASUREMENT
/begin MEASUREMENT EpmBCr_stPlaus "state of plausibilisation of the camshaft-signal during backup crankshaft" UBYTE EpmBCr_stPlaus_State 1 100 0.00 2.00000000000 FORMAT "%13.11" ARRAY_SIZE 1 ECU_ADDRESS 0x6000B182 /end MEASUREMENT
/begin MEASUREMENT EpmBCr_stPos "state of position-detection during backup crankshaft" UBYTE EpmBCr_stPos_State 1 100 0.00 1.00000000000 FORMAT "%13.11" ECU_ADDRESS 0x6000B17F /end MEASUREMENT
/begin MEASUREMENT EpmBCr_stPttCurrIsSync_mp "Status that indicates whether the edge where syncronisation happened is a sync mark" UBYTE OneToOne 1 100 0.00 255.0 FORMAT "%5.1" ECU_ADDRESS 0x70009FB3 /end MEASUREMENT
/begin MEASUREMENT EpmBCr_stPttSync_mp "Status measurement which indicates whether a certain camshaft edge is a sync mark." UBYTE OneToOne 1 100 0.00 255.0 FORMAT "%5.1" ARRAY_SIZE 10 ECU_ADDRESS 0x70009FA9 /end MEASUREMENT
/begin MEASUREMENT EpmBCr_swtUpdEdge_mp "Indicates whether in backup mode without crankshaft, calculation of engine speed and angle clock frequency is done on all camshaft edges or on equidistant edges, only" UBYTE EpmBCr_swtUpdEdge_CM 1 100 0.00 1.00000000000 FORMAT "%13.11" ECU_ADDRESS 0x70009FA8 /end MEASUREMENT
/begin MEASUREMENT EpmBCr_tiCaSEdg_mp "Measurement array which contains the current camshaft edge time stamps." SLONG OneToOne_us 1 100 -2147483648.00 2147483647.00 FORMAT "%13.2" ARRAY_SIZE 7 ECU_ADDRESS 0x70009B2C /end MEASUREMENT
/begin MEASUREMENT EpmBCr_tiCaSSegDur_mp "Measurement array which contains the current camshaft segment duration times plus the edge counter" SLONG OneToOne_us 1 100 -2147483648.00 2147483647.00 FORMAT "%13.2" ARRAY_SIZE 16 ECU_ADDRESS 0x70009AEC /end MEASUREMENT
/begin MEASUREMENT EpmBCr_tiIncPer "Period-time of a simulated crankshaft-increment" SLONG OneToOne 1 100 -2147483648.00 2147483647.00 FORMAT "%13.2" ECU_ADDRESS 0x60002B94 /end MEASUREMENT
/begin MEASUREMENT EpmBCr_tiSeg "time between 2 segment-edges (time during the angle EpmBCr_phiSeg2Seg)" SLONG OneToOne_us 1 100 -2147483648.00 2147483647.00 FORMAT "%13.2" ECU_ADDRESS 0x60002BA0 /end MEASUREMENT
/begin MEASUREMENT EpmCaS_agCorrnStat "static corrections of the camshaft position in relation to the calibrated reference position (Calibration array for the Encoded series of camshaft segments, Calibration array for the camshaft segments length)" SWORD AngleCrS 1 100 -720.0000 719.9780 FORMAT "%8.4" ARRAY_SIZE 1 ECU_ADDRESS 0x60013380 /end MEASUREMENT
/begin MEASUREMENT EpmCaS_allCaSEdges "8 bit Camshaft edge counter for all configured camshaft signals" UBYTE OneToOne 1 100 0.00 255.0 FORMAT "%5.1" ARRAY_SIZE 1 ECU_ADDRESS 0x6000F84F /end MEASUREMENT
/begin MEASUREMENT EpmCaS_bActivatePatmat "Bit to activate the camshaft pattern matching inside EpmSyn_CaSPos from the camshaft diagnosis" UBYTE OneToOne 1 100 0.00 255.0 FORMAT "%5.1" ARRAY_SIZE 1 ECU_ADDRESS 0x6000B17A /end MEASUREMENT
/begin MEASUREMENT EpmCaS_bCaSDiagflgClr "Request of FCM-clear for DFC_EpmCaS" UBYTE OneToOne 1 100 0.00 255.0 BIT_MASK 0x1 FORMAT "%5.1" ECU_ADDRESS 0x50005FA8 /end MEASUREMENT
/begin MEASUREMENT EpmCaS_bCaSEdgeTout "Edges timeout occured on specific camshaft" UBYTE OneToOne 1 100 0.00 255.0 FORMAT "%5.1" ARRAY_SIZE 1 ECU_ADDRESS 0x6000B16C /end MEASUREMENT
/begin MEASUREMENT EpmCaS_bOfsErrflgClr "Tester demand for clearing for DFC_EpmCaSOfsErr" UBYTE OneToOne 1 100 0.00 255.0 BIT_MASK 0x1 FORMAT "%5.1" ECU_ADDRESS 0x6000B174 /end MEASUREMENT
/begin MEASUREMENT EpmCaS_CASI1ctEdge10msU8 "8 bit edge counter for camshaft input signal 1" UBYTE OneToOne 1 100 0.00 255.0 FORMAT "%5.1" ECU_ADDRESS 0x70005493 /end MEASUREMENT
/begin MEASUREMENT EpmCaS_cntrAdapPostDrvLveOld "internal counter for the postdrive leaving event" UBYTE OneToOne 1 100 0.00 255.0 FORMAT "%5.1" ECU_ADDRESS 0x600008B8 /end MEASUREMENT
/begin MEASUREMENT EpmCaS_cntrDiagPostDrvLeave "Local drive cycle counter, which is incremented, when system state SyC_PostDrive is left." UBYTE OneToOne 1 100 0.00 255.0 FORMAT "%5.1" ECU_ADDRESS 0x50005FA9 /end MEASUREMENT
/begin MEASUREMENT EpmCaS_cntrEdgeLstCyc "Counter of the number of camshaft edges in the most recent complete camshaft revolution" UWORD OneToOne 1 100 0.00 65535.00 FORMAT "%8.2" ARRAY_SIZE 1 ECU_ADDRESS 0x70005294 /end MEASUREMENT
/begin MEASUREMENT EpmCaS_cntrNoSigLvl "CaS level counter - active in NoSig diagnosis" SWORD OneToOne 1 100 -32768.00 32767.00 FORMAT "%8.2" ARRAY_SIZE 1 ECU_ADDRESS 0x60007120 /end MEASUREMENT
/begin MEASUREMENT EpmCaS_cntrOfsEdgeLst "Number of camshaft edges at last call" SWORD OneToOne 1 100 -32768.00 32767.00 FORMAT "%8.2" ARRAY_SIZE 1 ECU_ADDRESS 0x60007112 /end MEASUREMENT
/begin MEASUREMENT EpmCaS_ctCaSEdgeLast "number of edges on the camshaft since engine was started or the buffer was initialized" UWORD OneToOne 1 100 0.00 65535.00 FORMAT "%8.2" ARRAY_SIZE 1 ECU_ADDRESS 0x600094C2 /end MEASUREMENT
/begin MEASUREMENT EpmCaS_ctEdgeEquid "Offset of last equidistant camshaft edge in EpmSyn_ctEdgeMapEquid" SBYTE OneToOne 1 100 -128.0 127.0 FORMAT "%5.1" ARRAY_SIZE 1 ECU_ADDRESS 0x6000F8AB /end MEASUREMENT
/begin MEASUREMENT EpmCaS_ctEdgeLst "Number of camshaft edges at last call" SWORD OneToOne 1 100 -32768.00 32767.00 FORMAT "%8.2" ARRAY_SIZE 1 ECU_ADDRESS 0x50005558 /end MEASUREMENT
/begin MEASUREMENT EpmCaS_ctErrSig "Debouncecounter for errors during patternmatching" UWORD CrSRev2CrSInc 1 100 0.00 1092.250 FORMAT "%8.3" ARRAY_SIZE 1 ECU_ADDRESS 0x60007118 /end MEASUREMENT
/begin MEASUREMENT EpmCaS_ctMeasEdgeLstI1 "Number of camshaft edges in the buffer of camshaft I1 at last call" SWORD OneToOne 1 100 -32768.00 32767.00 FORMAT "%8.2" ECU_ADDRESS 0x60013382 /end MEASUREMENT
/begin MEASUREMENT EpmCaS_ctNoSig "debouncing counter for no signal" UWORD CrSRev2CrSInc 1 100 0.00 1092.250 FORMAT "%8.3" ARRAY_SIZE 1 ECU_ADDRESS 0x60007116 /end MEASUREMENT
/begin MEASUREMENT EpmCaS_ctOfsCrSRev "Cam-shaft revolution counter of the cam-shaft offset diagnosis" UWORD OneToOne 1 100 0.00 65535.00 FORMAT "%8.2" ECU_ADDRESS 0x60007114 /end MEASUREMENT
/begin MEASUREMENT EpmCaS_ctOfsErr "Debounce counter used for healing \ setting of DFC_EpmCaSI1OfsErr" UBYTE OneToOne 1 100 0.00 255.0 FORMAT "%5.1" ARRAY_SIZE 1 ECU_ADDRESS 0x6000B173 /end MEASUREMENT
/begin MEASUREMENT EpmCaS_ctRevNoSig "Debouncecounter for nosig-error of camshaft" UWORD RevCnt 1 100 0.00 4095.938 FORMAT "%8.3" ARRAY_SIZE 1 ECU_ADDRESS 0x6000711E /end MEASUREMENT
/begin MEASUREMENT EpmCaS_ctRevSig "Revolution counter for debouncing camshaft error" UWORD RevCnt 1 100 0.00 4095.938 FORMAT "%8.3" ARRAY_SIZE 1 ECU_ADDRESS 0x5000555A /end MEASUREMENT
/begin MEASUREMENT EpmCaS_ctSigOk "Debouncecounter for healing camshaft-error" UWORD CrSRev2CrSInc 1 100 0.00 1092.250 FORMAT "%8.3" ARRAY_SIZE 1 ECU_ADDRESS 0x5000555C /end MEASUREMENT
/begin MEASUREMENT EpmCaS_ctTriesAdap "Number of adaption attempts" UWORD OneToOne 1 100 0.00 65535.00 FORMAT "%8.2" ARRAY_SIZE 1 ECU_ADDRESS 0x60007126 /end MEASUREMENT
/begin MEASUREMENT EpmCaS_flgCaSAdapflgClr "status for reset request by testinterface" UBYTE OneToOne 1 100 0.00 255.0 BIT_MASK 0x1 FORMAT "%5.1" ECU_ADDRESS 0x600008B9 /end MEASUREMENT
/begin MEASUREMENT EpmCaS_flgCaSRefAdapOld "old value of external request of reference adaptation" UBYTE OneToOne 1 100 0.00 255.0 BIT_MASK 0x1 FORMAT "%5.1" ECU_ADDRESS 0x600008BA /end MEASUREMENT
/begin MEASUREMENT EpmCaS_flgEEPReadSuc "flag to notify a successful eeprom reading" UBYTE OneToOne 1 100 0.00 255.0 BIT_MASK 0x1 FORMAT "%5.1" ECU_ADDRESS 0x600008BB /end MEASUREMENT
/begin MEASUREMENT EpmCaS_flgInhbnAdpnNoRefAdpnAvl "flag to notify the fine adaption should not be executed because no reference adaption values available" UBYTE OneToOne 1 100 0.00 255.0 FORMAT "%5.1" ARRAY_SIZE 1 ECU_ADDRESS 0x6000B17B /end MEASUREMENT
/begin MEASUREMENT EpmCaS_flgRefAdapExternReq "internal statusbit to notify external request for reference adaption was triggered" UBYTE OneToOne 1 100 0.00 255.0 BIT_MASK 0x1 FORMAT "%5.1" ECU_ADDRESS 0x600008BC /end MEASUREMENT
/begin MEASUREMENT EpmCaS_flgResetAfterErr "rest adaptation after activating DFC" UBYTE OneToOne 1 100 0.00 255.0 FORMAT "%5.1" ARRAY_SIZE 1 ECU_ADDRESS 0x600008BD /end MEASUREMENT
/begin MEASUREMENT EpmCaS_flgSwtSnglEdgeTolInt "internal Switch for activation of the single edge tolerance of the CTEDGE functionality for systems with variable camshaft (is set during SyncIni to EpmCaS_flgSwtSnglEdgeTol_C)" UBYTE OneToOne 1 100 0.00 255.0 FORMAT "%5.1" ECU_ADDRESS 0x50005FAA /end MEASUREMENT
/begin MEASUREMENT EpmCaS_nCaS_mp "camshaft spedd based on one camshaft rotation" SWORD EngNCaS 1 100 -8192.000 8191.750 FORMAT "%8.3" ECU_ADDRESS 0x70009CF6 /end MEASUREMENT
/begin MEASUREMENT EpmCaS_nEng "engine speed based on a camshaft-revolution" SWORD EngN 1 100 -16384.00 16383.50 FORMAT "%8.2" ECU_ADDRESS 0x60013EB8 /end MEASUREMENT
/begin MEASUREMENT EpmCaS_numCurrEdge "Number of counted camshaft edges in the actualcamshaft revolution" UWORD OneToOne 1 100 0.00 65535.00 FORMAT "%8.2" ARRAY_SIZE 1 ECU_ADDRESS 0x5000555E /end MEASUREMENT
/begin MEASUREMENT EpmCaS_numEdgeRefAdpn "Number of camshaft edges used for first reference adaptation" UBYTE OneToOne 1 100 0.00 255.0 FORMAT "%5.1" ARRAY_SIZE 1 ECU_ADDRESS 0x6000B17E /end MEASUREMENT
/begin MEASUREMENT EpmCaS_numEquidEdg "Number of calibrated equidistant edges over a camshaft rotation" UBYTE OneToOne 1 100 0.00 255.0 FORMAT "%5.1" ARRAY_SIZE 1 ECU_ADDRESS 0x6000F84E /end MEASUREMENT
/begin MEASUREMENT EpmCaS_numErrSigDefInt "internal Limit of the debounce counter for recognizing a defect when camshaft disturbance occurs." UWORD CrSRev2CrSInc 1 100 0.00 1092.250 FORMAT "%8.3" ECU_ADDRESS 0x6000711C /end MEASUREMENT
/begin MEASUREMENT EpmCaS_numErrSigOkInt "internal Limit of the debounce counter for healing a recognized camshaft disturbance (is set during SyncIni to EpmCaS_numErrSigOk_C)" UWORD CrSRev2CrSInc 1 100 0.00 1092.250 FORMAT "%8.3" ECU_ADDRESS 0x50005560 /end MEASUREMENT
/begin MEASUREMENT EpmCaS_numLosEquidEdg_mp "Number of lost equidistant edges" UBYTE OneToOne 1 100 0.00 255.0 FORMAT "%5.1" ARRAY_SIZE 1 ECU_ADDRESS 0x70009FA7 /end MEASUREMENT
/begin MEASUREMENT EpmCaS_numMplPatEquidEdg_mp "Number of multiple patterns with equidistant edges" UBYTE OneToOne 1 100 0.00 255.0 FORMAT "%5.1" ARRAY_SIZE 1 ECU_ADDRESS 0x70009FA6 /end MEASUREMENT
/begin MEASUREMENT EpmCaS_numNoSigDefInt "internal Limit for debounce counter to recognize the loss of a camshaft signal (is set during SyncIni to EpmCaS_numNoSigDef_C)" UWORD CrSRev2CrSInc 1 100 0.00 1092.250 FORMAT "%8.3" ECU_ADDRESS 0x6000711A /end MEASUREMENT
/begin MEASUREMENT EpmCaS_numPriCamShft "Primary camshaft which is used to calculate the engine speed from camshaft and to support backup mode" UBYTE OneToOne 1 100 0.00 255.0 FORMAT "%5.1" ECU_ADDRESS 0x7000545C /end MEASUREMENT
/begin MEASUREMENT EpmCaS_numRawValueI1 "Index of the latest valid element in the array of the camshaft raw values I1" SBYTE OneToOne 1 100 -128.0 127.0 FORMAT "%5.1" ECU_ADDRESS 0x600140B4 /end MEASUREMENT
/begin MEASUREMENT EpmCaS_numSegSerLst "Number of calibrated camshaft segments minus one" UBYTE OneToOne 1 100 0.00 255.0 FORMAT "%5.1" ARRAY_SIZE 1 ECU_ADDRESS 0x600109E6 /end MEASUREMENT
/begin MEASUREMENT EpmCaS_numValidTime "Number of valid time entries in the buffer of primary camshaft" UBYTE OneToOne 1 100 0.00 255.0 FORMAT "%5.1" ECU_ADDRESS 0x70005494 /end MEASUREMENT
/begin MEASUREMENT EpmCaS_numVldEquidEdg_mp "Number of valid equidistant edges which have been found" UBYTE OneToOne 1 100 0.00 255.0 FORMAT "%5.1" ARRAY_SIZE 1 ECU_ADDRESS 0x70009FA5 /end MEASUREMENT
/begin MEASUREMENT EpmCaS_OfsAvrgBuf "Buffer for Averaging filter for the Cas Offset" SLONG AngleCrS 1 100 -47185920.0000 47185919.9780 FORMAT "%13.4" ARRAY_SIZE 1 ECU_ADDRESS 0x60005740 /end MEASUREMENT
/begin MEASUREMENT EpmCaS_phiAdapRefPos "Current fine adaption reference positions" SWORD AngleCrS 1 100 -720.0000 719.9780 FORMAT "%8.4" ARRAY_SIZE 10 ECU_ADDRESS 0x600388EC /end MEASUREMENT
/begin MEASUREMENT EpmCaS_phiAdapRefPosI1 "adapted reference-positions of inlet-camshaft" SWORD AngleCrS 1 100 -720.0000 719.9780 FORMAT "%8.4" ARRAY_SIZE 10 ECU_ADDRESS 0x50005CE0 /end MEASUREMENT
/begin MEASUREMENT EpmCaS_phiCaSOfs "camshaft offset sincereference adaption" SWORD AngleCrS 1 100 -720.0000 719.9780 FORMAT "%8.4" ARRAY_SIZE 1 ECU_ADDRESS 0x60013EBA /end MEASUREMENT
/begin MEASUREMENT EpmCaS_phiCaSOfsAvg "average value of camshaft offset" SLONG AngleCrS 1 100 -47185920.0000 47185919.9780 FORMAT "%13.4" ARRAY_SIZE 1 ECU_ADDRESS 0x50004EB4 /end MEASUREMENT
/begin MEASUREMENT EpmCaS_phiCor "Correction angle of the camshaft for engine speed and temperature" SWORD AngleCrS 1 100 -720.0000 719.9780 FORMAT "%8.4" ARRAY_SIZE 1 ECU_ADDRESS 0x6000951E /end MEASUREMENT
/begin MEASUREMENT EpmCaS_phiDiffAvrg "Average offset of all equidistant camshaft edges" SWORD AngleCrS 1 100 -720.0000 719.9780 FORMAT "%8.4" ARRAY_SIZE 1 ECU_ADDRESS 0x60007124 /end MEASUREMENT
/begin MEASUREMENT EpmCaS_phiDiffAvrgLim "Neutral point offset in degree CrS for the camshaft offset diagnosis, caused by tolerance of the installation position." SWORD AngleCrS 1 100 -720.0000 719.9780 FORMAT "%8.4" ARRAY_SIZE 1 ECU_ADDRESS 0x6000951C /end MEASUREMENT
/begin MEASUREMENT EpmCaS_phiDiffCal2Adap "difference between calibrated and adapted camshaft edges" SWORD AngleCrS 1 100 -720.0000 719.9780 FORMAT "%8.4" ARRAY_SIZE 10 ECU_ADDRESS 0x50005AB8 /end MEASUREMENT
/begin MEASUREMENT EpmCaS_phiDiffCal2AdapEqAvg "Average difference between calibrated and adapted positions of equidistant camshaft edges" SWORD AngleCrS 1 100 -720.0000 719.9780 FORMAT "%8.4" ARRAY_SIZE 1 ECU_ADDRESS 0x60007122 /end MEASUREMENT
/begin MEASUREMENT EpmCaS_phiDiffLim "limited difference of actual camshaft position to reference position" SWORD AngleCrS 1 100 -720.0000 719.9780 FORMAT "%8.4" ARRAY_SIZE 1 ECU_ADDRESS 0x60009518 /end MEASUREMENT
/begin MEASUREMENT EpmCaS_phiDiffLimSecLst "limited difference of actual secondlast camshaft position to reference position" SWORD AngleCrS 1 100 -720.0000 719.9780 FORMAT "%8.4" ARRAY_SIZE 1 ECU_ADDRESS 0x6000951A /end MEASUREMENT
/begin MEASUREMENT EpmCaS_phiDiffSum "Summed up differences between calibrated and measured reference position" SLONG AngleCrS 1 100 -47185920.0000 47185919.9780 FORMAT "%13.4" ARRAY_SIZE 10 ECU_ADDRESS 0x50002E38 /end MEASUREMENT
/begin MEASUREMENT EpmCaS_phiDstEquidEdg "Angle between the calibrated equidistant edges in crankshaft degree" SWORD AngleCrS 1 100 -720.0000 719.9780 FORMAT "%8.4" ARRAY_SIZE 1 ECU_ADDRESS 0x60009516 /end MEASUREMENT
/begin MEASUREMENT EpmCaS_phiEdge "angle of camshaft edge" SWORD AngleCrS 1 100 -720.0000 719.9780 FORMAT "%8.4" ARRAY_SIZE 1 ECU_ADDRESS 0x7000537A /end MEASUREMENT
/begin MEASUREMENT EpmCaS_phiEdgeAvrg "Averaged deviation of calibrated to the measured reference position" SWORD AngleCrS 1 100 -720.0000 719.9780 FORMAT "%8.4" ARRAY_SIZE 10 ECU_ADDRESS 0x50005ACC /end MEASUREMENT
/begin MEASUREMENT EpmCaS_phiEdgeDvt_mp "difference between the deviation of the edge No. EpmCaS_numEdgeFltAvrg_C and the current edge to the average camshaft position" SWORD AngleCrS 1 100 -720.0000 719.9780 FORMAT "%8.4" ARRAY_SIZE 1 ECU_ADDRESS 0x70009CF4 /end MEASUREMENT
/begin MEASUREMENT EpmCaS_phiFirstAdapRefPos "reference adapted positions of the camshaft edges" SWORD AngleCrS 1 100 -720.0000 719.9780 FORMAT "%8.4" ARRAY_SIZE 10 ECU_ADDRESS 0x50005AE0 /end MEASUREMENT
/begin MEASUREMENT EpmCaS_phiLosEquidEdg_mp "Angle of the equidistant edge which is lost in crankshaft degree" SWORD AngleCrS 1 100 -720.0000 719.9780 FORMAT "%8.4" ARRAY_SIZE 1 ECU_ADDRESS 0x70009CF8 /end MEASUREMENT
/begin MEASUREMENT EpmCaS_phiMntErrMax "Upper limit of the tolerated angle difference of the installation position of the camshaft" SWORD AngleCrS 1 100 -720.0000 719.9780 FORMAT "%8.4" ECU_ADDRESS 0x60007110 /end MEASUREMENT
/begin MEASUREMENT EpmCaS_phiMntErrMin "Lower limit of the tolerated angle difference of the installation position of the camshaft" SWORD AngleCrS 1 100 -720.0000 719.9780 FORMAT "%8.4" ECU_ADDRESS 0x6000710E /end MEASUREMENT
/begin MEASUREMENT EpmCaS_phiOfsAvrgUnflt "mean value of the relative camshaft edge adaption values, exhaust bank 1" SWORD AngleCrS 1 100 -720.0000 719.9780 FORMAT "%8.4" ARRAY_SIZE 1 ECU_ADDRESS 0x60009514 /end MEASUREMENT
/begin MEASUREMENT EpmCaS_phiOfsCorr "filtered vaule of camshaft offset" SWORD AngleCrS 1 100 -720.0000 719.9780 FORMAT "%8.4" ARRAY_SIZE 1 ECU_ADDRESS 0x60009512 /end MEASUREMENT
/begin MEASUREMENT EpmCaS_phiOfsTolc "Tolerance applied to real position of the equidistant edges and calibrated equidistant edges" SWORD AngleCrS 1 100 -720.0000 719.9780 FORMAT "%8.4" ARRAY_SIZE 1 ECU_ADDRESS 0x60009510 /end MEASUREMENT
/begin MEASUREMENT EpmCaS_phiRawValueI1_mp "Array with the raw values of the edge positions of the camshaft I1" SWORD AngleCrS 1 100 -720.0000 719.9780 FORMAT "%8.4" ARRAY_SIZE 10 ECU_ADDRESS 0x70009CFA /end MEASUREMENT
/begin MEASUREMENT EpmCaS_phiRefPos "calibrated positions for camshaft edges" SWORD AngleCrS 1 100 -720.0000 719.9780 FORMAT "%8.4" ARRAY_SIZE 10 ECU_ADDRESS 0x50005B1C /end MEASUREMENT
/begin MEASUREMENT EpmCaS_phiRefPosEquiEdg "Reference position of the equidistant edges" SWORD AngleCrS 1 100 -720.0000 719.9780 FORMAT "%8.4" ARRAY_SIZE 10 ECU_ADDRESS 0x50005B08 /end MEASUREMENT
/begin MEASUREMENT EpmCaS_phiSegAdapRefPos "positions for camshaft edges calculated by the segment lenght adaptation" SWORD AngleCrS 1 100 -720.0000 719.9780 FORMAT "%8.4" ARRAY_SIZE 10 ECU_ADDRESS 0x50005AF4 /end MEASUREMENT
/begin MEASUREMENT EpmCaS_phiSegLenTolc "Tolerance applied to the length of equidistant camshaft segments" SWORD AngleCrS 1 100 -720.0000 719.9780 FORMAT "%8.4" ARRAY_SIZE 1 ECU_ADDRESS 0x6000950E /end MEASUREMENT
/begin MEASUREMENT EpmCaS_phiTempCor "Angle correction value for each camshaft depending on temperature" SWORD AngleCrS 1 100 -720.0000 719.9780 FORMAT "%8.4" ARRAY_SIZE 1 ECU_ADDRESS 0x60013EBC /end MEASUREMENT
/begin MEASUREMENT EpmCaS_phiTempCorEng "Temperature correction factor for engine characteristics" SWORD AngleCrS 1 100 -720.0000 719.9780 FORMAT "%8.4" ARRAY_SIZE 1 ECU_ADDRESS 0x6000950C /end MEASUREMENT
/begin MEASUREMENT EpmCaS_stAdap "status of the camshaftadaption" UBYTE EpmCaS_stAdap_State 1 100 0.00 4.00000000000 FORMAT "%13.11" ARRAY_SIZE 1 ECU_ADDRESS 0x600388EA /end MEASUREMENT
/begin MEASUREMENT EpmCaS_stAdapErr "error of the camshaft adaption which occured during adaption or test" UBYTE OneToOne 1 100 0.00 255.0 FORMAT "%5.1" ARRAY_SIZE 1 ECU_ADDRESS 0x6000B17C /end MEASUREMENT
/begin MEASUREMENT EpmCaS_stAgPhaShiftFltActv_mp "Status of camshaft shift angle filter (0=deactivated; 1=activated)" UBYTE OneToOne 1 100 0.00 255.0 FORMAT "%5.1" ARRAY_SIZE 1 ECU_ADDRESS 0x70009FA4 /end MEASUREMENT
/begin MEASUREMENT EpmCaS_stAgPhaShiftSecToLst_mp "state of phase shift for second last equistant camshaft edge" UBYTE EpmCaS_stAgPhaShift_t 1 100 0.00 3.00000000000 FORMAT "%13.11" ARRAY_SIZE 1 ECU_ADDRESS 0x70009FA3 /end MEASUREMENT
/begin MEASUREMENT EpmCaS_stAgPhaShift_mp "state of the camshaft angle calulation" UBYTE EpmCaS_stAgPhaShift_t 1 100 0.00 3.00000000000 FORMAT "%13.11" ARRAY_SIZE 1 ECU_ADDRESS 0x70009FA2 /end MEASUREMENT
/begin MEASUREMENT EpmCaS_stCaSLvl "Level at input during transition to the NoSig state" UBYTE OneToOne 1 100 0.00 255.0 FORMAT "%5.1" ARRAY_SIZE 1 ECU_ADDRESS 0x6000B179 /end MEASUREMENT
/begin MEASUREMENT EpmCaS_stDiag "State of the camshaft diagnosis" UBYTE EpmCaS_stDiag_t 1 100 0.00 4.00000000000 FORMAT "%13.11" ARRAY_SIZE 1 ECU_ADDRESS 0x6000B176 /end MEASUREMENT
/begin MEASUREMENT EpmCaS_stDiagErr "current state of camshaft-diagnosis" UBYTE EpmCaS_stDiagErr_t 1 100 0.00 3.00000000000 FORMAT "%13.11" ARRAY_SIZE 1 ECU_ADDRESS 0x6000B175 /end MEASUREMENT
/begin MEASUREMENT EpmCaS_stDiagErrChgd "State of diagnosis has changed, therefore reporting to DSM active for this cycle" UBYTE OneToOne 1 100 0.00 255.0 BIT_MASK 0x1 FORMAT "%5.1" ECU_ADDRESS 0x50005FAB /end MEASUREMENT
/begin MEASUREMENT EpmCaS_stDiagModeInt "internal state to disable the camshaft diagnosis in EPM_MODE_OK if a camshaft fault is already detected. (is set during SyncIni to EpmCaS_stDiagMode_C)" UBYTE OneToOne 1 100 0.00 255.0 FORMAT "%5.1" ECU_ADDRESS 0x50005FAC /end MEASUREMENT
/begin MEASUREMENT EpmCaS_stDiagStopCdn "State diagnosis stop after detection of an error" UBYTE OneToOne 1 100 0.00 255.0 BIT_MASK 0x1 FORMAT "%5.1" ECU_ADDRESS 0x6000B178 /end MEASUREMENT
/begin MEASUREMENT EpmCaS_stDSMRdyAdap "DSM init state used by the FC" UBYTE OneToOne 1 100 0.00 255.0 BIT_MASK 0x1 FORMAT "%5.1" ECU_ADDRESS 0x600008BE /end MEASUREMENT
/begin MEASUREMENT EpmCaS_stDSMRdyDiag "DSM init state used by the FC" UBYTE OneToOne 1 100 0.00 255.0 BIT_MASK 0x1 FORMAT "%5.1" ECU_ADDRESS 0x50000953 /end MEASUREMENT
/begin MEASUREMENT EpmCaS_stDSMRdyOfsDiag "DSM init state used by the FC" UBYTE OneToOne 1 100 0.00 255.0 BIT_MASK 0x1 FORMAT "%5.1" ECU_ADDRESS 0x600008BF /end MEASUREMENT
/begin MEASUREMENT EpmCaS_stDSMRdySeg "DSM init state used by the FC" UBYTE OneToOne 1 100 0.00 255.0 BIT_MASK 0x1 FORMAT "%5.1" ECU_ADDRESS 0x6000B16F /end MEASUREMENT
/begin MEASUREMENT EpmCaS_stMeasCllsn "is set to TRUE if the call of the measuring function collides between the n-sync and the 10ms task" UBYTE OneToOne 1 100 0.00 255.0 BIT_MASK 0x1 FORMAT "%5.1" ECU_ADDRESS 0x7000545D /end MEASUREMENT
/begin MEASUREMENT EpmCaS_stMeasUnLckd "Semaphore to inhibit a parallel call of the measuring function" UBYTE OneToOne 1 100 0.00 255.0 BIT_MASK 0x1 FORMAT "%5.1" ECU_ADDRESS 0x600140B5 /end MEASUREMENT
/begin MEASUREMENT EpmCaS_stNEng "State of the camshaft engine speed" UBYTE OneToOne 1 100 0.00 255.0 FORMAT "%5.1" ECU_ADDRESS 0x6000F84D /end MEASUREMENT
/begin MEASUREMENT EpmCaS_stOffsCalcn "Status of Camshaft Offset calculated in the current task cycle" UBYTE OneToOne 1 100 0.00 255.0 FORMAT "%5.1" ARRAY_SIZE 1 ECU_ADDRESS 0x6000F84C /end MEASUREMENT
/begin MEASUREMENT EpmCaS_stOfs "state of camshaft offset calculation" UBYTE EpmCas_stOfs_State 1 100 0.00 1.00000000000 FORMAT "%13.11" ARRAY_SIZE 1 ECU_ADDRESS 0x6000B172 /end MEASUREMENT
/begin MEASUREMENT EpmCaS_stOfsAvrgUnflt "status of unfiltered angular displacement of the camshaft" UBYTE OneToOne 1 100 0.00 255.0 FORMAT "%5.1" ARRAY_SIZE 1 ECU_ADDRESS 0x6000F84B /end MEASUREMENT
/begin MEASUREMENT EpmCaS_stOfsErr "error state of camshaft offset diagnosis" UBYTE EpmCaS_stOfsErr_Val 1 100 0.00 5.00000000000 FORMAT "%13.11" ARRAY_SIZE 1 ECU_ADDRESS 0x6000B171 /end MEASUREMENT
/begin MEASUREMENT EpmCaS_stPhaAdpn_mp "state of the adaption" UBYTE EpmCaS_stAdap_State 1 100 0.00 4.00000000000 FORMAT "%13.11" ARRAY_SIZE 1 ECU_ADDRESS 0x70009FA1 /end MEASUREMENT
/begin MEASUREMENT EpmCaS_stPhaRefAdpn_mp "state of the reference adaption" UBYTE EpmCaS_stAdap_State 1 100 0.00 4.00000000000 FORMAT "%13.11" ARRAY_SIZE 1 ECU_ADDRESS 0x70009FA0 /end MEASUREMENT
/begin MEASUREMENT EpmCaS_stphiDiffLim "state value for the calculation of the camshaft angle" UBYTE EpmCaS_stphiDiffLim_t 1 100 0.00 8.00000000000 FORMAT "%13.11" ARRAY_SIZE 1 ECU_ADDRESS 0x6000F849 /end MEASUREMENT
/begin MEASUREMENT EpmCaS_stphiDiffLimSecLst "state value for the calculation of the camshaft second last equidistant edge angle" UBYTE EpmCaS_stphiDiffLim_t 1 100 0.00 8.00000000000 FORMAT "%13.11" ARRAY_SIZE 1 ECU_ADDRESS 0x6000F84A /end MEASUREMENT
/begin MEASUREMENT EpmCaS_stPosValid "state if valid camshaft position was found or not" UBYTE OneToOne 1 100 0.00 255.0 FORMAT "%5.1" ARRAY_SIZE 1 ECU_ADDRESS 0x6000B16E /end MEASUREMENT
/begin MEASUREMENT EpmCaS_stRefAdap "States of the reference adaptation." UBYTE EpmCaS_stRefAdap_State 1 100 0.00 4.00000000000 FORMAT "%13.11" ARRAY_SIZE 1 ECU_ADDRESS 0x600109DF /end MEASUREMENT
/begin MEASUREMENT EpmCaS_stRefLevBefEquidEdg "Reference signal level before the equidistant edge" UBYTE OneToOne 1 100 0.00 255.0 FORMAT "%5.1" ARRAY_SIZE 10 ECU_ADDRESS 0x50005FD2 /end MEASUREMENT
/begin MEASUREMENT EpmCaS_stRstAdap "locale request for reinitialization of locale variables" UBYTE OneToOne 1 100 0.00 255.0 BIT_MASK 0x1 FORMAT "%5.1" ECU_ADDRESS 0x600008C0 /end MEASUREMENT
/begin MEASUREMENT EpmCaS_stRstDiag "locale request for reinitialization of locale variables" UBYTE OneToOne 1 100 0.00 255.0 BIT_MASK 0x1 FORMAT "%5.1" ECU_ADDRESS 0x50000954 /end MEASUREMENT
/begin MEASUREMENT EpmCaS_stRstOfsDiag "locale request for reinitialization of locale variables" UBYTE OneToOne 1 100 0.00 255.0 BIT_MASK 0x1 FORMAT "%5.1" ECU_ADDRESS 0x600008C1 /end MEASUREMENT
/begin MEASUREMENT EpmCaS_stRstSeg "locale request for reinitialization of locale variables" UBYTE OneToOne 1 100 0.00 255.0 BIT_MASK 0x1 FORMAT "%5.1" ECU_ADDRESS 0x600008C2 /end MEASUREMENT
/begin MEASUREMENT EpmCaS_stSegFault "Error state over one camshaft revolution" UBYTE OneToOne 1 100 0.00 255.0 FORMAT "%5.1" ARRAY_SIZE 1 ECU_ADDRESS 0x6000B177 /end MEASUREMENT
/begin MEASUREMENT EpmCaS_stSnsrDeActvn "Status of deactivation of the configured camshaft" UBYTE OneToOne 1 100 0.00 255.0 FORMAT "%5.1" ARRAY_SIZE 1 ECU_ADDRESS 0x6000B16D /end MEASUREMENT
/begin MEASUREMENT EpmCaS_swtForceRefAdapOld "State of EpmCaS_swtForceRefAdap_C during the last calculation" UBYTE OneToOne 1 100 0.00 255.0 FORMAT "%5.1" ECU_ADDRESS 0x6000B17D /end MEASUREMENT
/begin MEASUREMENT EpmCaS_tAgSnsrCorr "Selection of temperature for camshaft angle correction" SWORD Temp_Cels 1 100 -3549.940 3003.560 FORMAT "%8.3" ECU_ADDRESS 0x6000710C /end MEASUREMENT
/begin MEASUREMENT EpmCaS_tiDifAgPhaLstEdge_mp "time stamp for the last camshaft edge" SLONG OneToOne_us 1 100 -2147483648.00 2147483647.00 FORMAT "%13.2" ARRAY_SIZE 1 ECU_ADDRESS 0x70009AE4 /end MEASUREMENT
/begin MEASUREMENT EpmCaS_tiDifAgPhaLstTwoEdges_mp "time stamp for the camshaft edge before last" SLONG OneToOne_us 1 100 -2147483648.00 2147483647.00 FORMAT "%13.2" ARRAY_SIZE 1 ECU_ADDRESS 0x70009AE0 /end MEASUREMENT
/begin MEASUREMENT EpmCaS_tiEdge "time of camshaft edge" SLONG Per_Dur 1 100 -2147483648.00 2147483647.00 FORMAT "%13.2" ARRAY_SIZE 1 ECU_ADDRESS 0x70005228 /end MEASUREMENT
/begin MEASUREMENT EpmCaS_tiNEngRstTimer "reset timer" SLONG Time_ms 1 100 -21474836480.0 21474836470.0 FORMAT "%13.1" ECU_ADDRESS 0x600125F0 /end MEASUREMENT
/begin MEASUREMENT EpmCrS_bCrSDiagflgClr "Request of FCM-clear for DFC_EpmCrS" UBYTE OneToOne 1 100 0.00 255.0 FORMAT "%5.1" ECU_ADDRESS 0x6000B16B /end MEASUREMENT
/begin MEASUREMENT EpmCrS_bDisturb "Condition that a signal disturbance has occured" UBYTE OneToOne 1 100 0.00 255.0 FORMAT "%5.1" ECU_ADDRESS 0x6000B16A /end MEASUREMENT
/begin MEASUREMENT EpmCrS_bEnableCrSCaS "Crankshaft diagnosis - enable condition to check any signal missing" UBYTE B_TRUE 1 100 0.00 1.00000000000 FORMAT "%13.11" ECU_ADDRESS 0x6000B169 /end MEASUREMENT
/begin MEASUREMENT EpmCrS_bEnableDisturb "Crankshaft diagnosis - enable condition to check any signal disturbance" UBYTE OneToOne 1 100 0.00 255.0 FORMAT "%5.1" ECU_ADDRESS 0x6000B168 /end MEASUREMENT
/begin MEASUREMENT EpmCrS_bEnablePosDGI "Crankshaft diagnosis - enable condition to check the DGI position" UBYTE OneToOne 1 100 0.00 255.0 FORMAT "%5.1" ECU_ADDRESS 0x6000B167 /end MEASUREMENT
/begin MEASUREMENT EpmCrS_bEnableRRDGI "Crankshaft diagnosis - enable condition to check any implausible reverse pulse of DGI" UBYTE OneToOne 1 100 0.00 255.0 FORMAT "%5.1" ECU_ADDRESS 0x6000B166 /end MEASUREMENT
/begin MEASUREMENT EpmCrS_bRRNPlErr "Implausible reverse pulse of DGI was detected" UBYTE OneToOne 1 100 0.00 255.0 FORMAT "%5.1" ECU_ADDRESS 0x6000B165 /end MEASUREMENT
/begin MEASUREMENT EpmCrS_ctAgClkDeltaCrsv_mp "Number of angle differences above the permitted maximum angle" UBYTE OneToOne 1 100 0.00 255.0 FORMAT "%5.1" ECU_ADDRESS 0x70009F9E /end MEASUREMENT
/begin MEASUREMENT EpmCrS_ctCaSEdgeStart "start value of camshaft edges" SWORD OneToOne 1 100 -32768.00 32767.00 FORMAT "%8.2" ECU_ADDRESS 0x6000710A /end MEASUREMENT
/begin MEASUREMENT EpmCrS_ctCaSRev "debounce counter no crankshaft signal" SWORD OneToOne 1 100 -32768.00 32767.00 FORMAT "%8.2" ECU_ADDRESS 0x60009156 /end MEASUREMENT
/begin MEASUREMENT EpmCrS_ctErrSig "debounce counter wrong crankshaft signal" SWORD OneToOne 1 100 -32768.00 32767.00 FORMAT "%8.2" ECU_ADDRESS 0x600070FC /end MEASUREMENT
/begin MEASUREMENT EpmCrS_ctInc "crankshaft teeth counter" UBYTE OneToOne 1 100 0.00 255.0 FORMAT "%5.1" ECU_ADDRESS 0x5000600C /end MEASUREMENT
/begin MEASUREMENT EpmCrS_ctPosDGI "debounce counter of wrong synchronization from (DGI) stop position with too big angle difference" SWORD OneToOne 1 100 -32768.00 32767.00 FORMAT "%8.2" ECU_ADDRESS 0x60007108 /end MEASUREMENT
/begin MEASUREMENT EpmCrS_ctRange "counter for selecting speed limits in dynamic plausibilisation" UBYTE OneToOne 1 100 0.00 255.0 FORMAT "%5.1" ECU_ADDRESS 0x6000B156 /end MEASUREMENT
/begin MEASUREMENT EpmCrS_ctReSyncAgClkDeltaTot "counter for the total number of re-synchronisations" UBYTE OneToOne 1 100 0.00 255.0 FORMAT "%5.1" ECU_ADDRESS 0x6003890C /end MEASUREMENT
/begin MEASUREMENT EpmCrS_ctReSyncAgClkDeltaTot_mp "Number of released re-synchronizations over all driving cycles" UBYTE OneToOne 1 100 0.00 255.0 FORMAT "%5.1" ECU_ADDRESS 0x70009F9D /end MEASUREMENT
/begin MEASUREMENT EpmCrS_ctReSyncAgClkDelta_mp "Number of released re-synchronizations in the current driving cycle" UBYTE OneToOne 1 100 0.00 255.0 FORMAT "%5.1" ECU_ADDRESS 0x70009F9C /end MEASUREMENT
/begin MEASUREMENT EpmCrS_ctRev "Revolution counter for CrS diagnosis" UWORD OneToOne 1 100 0.00 65535.00 FORMAT "%8.2" ECU_ADDRESS 0x60007106 /end MEASUREMENT
/begin MEASUREMENT EpmCrS_ctRev20msLim_mp "counter of crankshaft revolutions in 20ms limited" SBYTE OneToOne 1 100 -128.0 127.0 FORMAT "%5.1" ECU_ADDRESS 0x70009F9F /end MEASUREMENT
/begin MEASUREMENT EpmCrS_ctRevCnt "crankshaft revolution counter" UWORD RevCnt 1 100 0.00 4095.938 FORMAT "%8.3" ECU_ADDRESS 0x50005562 /end MEASUREMENT
/begin MEASUREMENT EpmCrS_ctRevIni "crankshaft revolutions since synchronisation" SWORD OneToOne 1 100 -32768.00 32767.00 FORMAT "%8.2" ECU_ADDRESS 0x6000950A /end MEASUREMENT
/begin MEASUREMENT EpmCrS_ctRevStrt "crankshaft revolution since switch off start BIT" SWORD OneToOne 1 100 -32768.00 32767.00 FORMAT "%8.2" ECU_ADDRESS 0x60013EBE /end MEASUREMENT
/begin MEASUREMENT EpmCrS_ctRevStrtExtd "crankshaft revolution since switch off start BIT" SLONG OneToOne 1 100 -2147483648.00 2147483647.00 FORMAT "%13.2" ECU_ADDRESS 0x50004EB8 /end MEASUREMENT
/begin MEASUREMENT EpmCrS_ctRevWaitDiag "healing debounce counter wrong crankshaft signal" SWORD OneToOne 1 100 -32768.00 32767.00 FORMAT "%8.2" ECU_ADDRESS 0x60007104 /end MEASUREMENT
/begin MEASUREMENT EpmCrS_ctRevWaitDiagSyncIni "Handshaking information between HCrS and diagnosis - healing counter of DFC_EpmCrSErrSig" SWORD OneToOne 1 100 -32768.00 32767.00 FORMAT "%8.2" ECU_ADDRESS 0x60007102 /end MEASUREMENT
/begin MEASUREMENT EpmCrS_ctRRNotPlaus "number of implausible DGI reverse impulses since ECU was switched on" SLONG OneToOne 1 100 -2147483648.00 2147483647.00 FORMAT "%13.2" ECU_ADDRESS 0x50001764 /end MEASUREMENT
/begin MEASUREMENT EpmCrS_ctSumRRNotPlaus "number of implausible DGI reverse impulses over the lifetime" SLONG OneToOne 1 100 -2147483648.00 2147483647.00 FORMAT "%13.2" ECU_ADDRESS 0x60038908 /end MEASUREMENT
/begin MEASUREMENT EpmCrS_dnEngFltSyncIni "Engine speed gradient at SyncIni" SWORD EngNGrd 1 100 -16384.00 16383.50 FORMAT "%8.2" ECU_ADDRESS 0x60007100 /end MEASUREMENT
/begin MEASUREMENT EpmCrS_idxBuf_mp "Bufferindex of the crank edge elemets, at which the synchro was triggered" SWORD OneToOne 1 100 -32768.00 32767.00 FORMAT "%8.2" ECU_ADDRESS 0x70009CF0 /end MEASUREMENT
/begin MEASUREMENT EpmCrS_nRRNotPlaus "engine speed of the last unplausible DGI reverse pulse" SWORD EngN 1 100 -16384.00 16383.50 FORMAT "%8.2" ECU_ADDRESS 0x600070FE /end MEASUREMENT
/begin MEASUREMENT EpmCrS_numIncPerSeg "The number of crankshaft teeth in the cylinder-segment EpmCrS_phiSeg" UWORD OneToOne 1 100 0.00 65535.00 FORMAT "%8.2" ECU_ADDRESS 0x60013EC2 /end MEASUREMENT
/begin MEASUREMENT EpmCrS_numNewInc_mp "TTMeasure - number of new tooth times since last interrupt" UBYTE OneToOne 1 100 0.00 255.0 FORMAT "%5.1" ECU_ADDRESS 0x70009F9B /end MEASUREMENT
/begin MEASUREMENT EpmCrS_numSeg "counter of part segments" UBYTE OneToOne 1 100 0.00 255.0 FORMAT "%5.1" ECU_ADDRESS 0x5000600D /end MEASUREMENT
/begin MEASUREMENT EpmCrS_numTiIncPerAvrg "Number of teeth for average tooth time calculation" UBYTE OneToOne 1 100 0.00 255.0 FORMAT "%5.1" ECU_ADDRESS 0x50005FAD /end MEASUREMENT
/begin MEASUREMENT EpmCrS_numTiIncPerAvrg_mp "current number of crankshaft teeth to calculate average of tooth time" ULONG OneToOne 1 100 0.00 4294967295.00 FORMAT "%13.2" ECU_ADDRESS 0x70009ADC /end MEASUREMENT
/begin MEASUREMENT EpmCrS_phiAgClk "Relative angle of the engine position provided by the angle clock" SWORD AngleCrS 1 100 -720.0000 719.9780 FORMAT "%8.4" ECU_ADDRESS 0x50005CF6 /end MEASUREMENT
/begin MEASUREMENT EpmCrS_phiAgClkDelta_mp "Angle difference between the relative angle of the angle clock and the relative angle provided by the tooth counter" SWORD AngleCrS 1 100 -720.0000 719.9780 FORMAT "%8.4" ECU_ADDRESS 0x70009CF2 /end MEASUREMENT
/begin MEASUREMENT EpmCrS_phiIgnInc "crankshaft angle faded out due to debouncing, during start" SWORD AngleCrS 1 100 -720.0000 719.9780 FORMAT "%8.4" ECU_ADDRESS 0x600070FA /end MEASUREMENT
/begin MEASUREMENT EpmCrS_phiInc "Relative angle of the engine position provided by the tooth counter" SWORD AngleCrS 1 100 -720.0000 719.9780 FORMAT "%8.4" ECU_ADDRESS 0x50005CF8 /end MEASUREMENT
/begin MEASUREMENT EpmCrS_phiIntSeg "endposition of the current halfsegment" SWORD AngleCrS 1 100 -720.0000 719.9780 FORMAT "%8.4" ECU_ADDRESS 0x7000537C /end MEASUREMENT
/begin MEASUREMENT EpmCrS_phiSeg "Cylinder segment length" SWORD AngleCrS 1 100 -720.0000 719.9780 FORMAT "%8.4" ECU_ADDRESS 0x60013EC6 /end MEASUREMENT
/begin MEASUREMENT EpmCrS_phiSegHiRes "Segment for calculating EpmCrS_tiSegHiRes" SLONG RBPtCel_ag_1p373291em3_1 1 100 -2949120.00000 2949119.99863 FORMAT "%13.5" ECU_ADDRESS 0x50004EBC /end MEASUREMENT
/begin MEASUREMENT EpmCrS_stChgDGI "Status of DFC_EpmCrSDGI has changed: Report to DSM still not finished" UBYTE OneToOne 1 100 0.00 255.0 FORMAT "%5.1" ECU_ADDRESS 0x6000B164 /end MEASUREMENT
/begin MEASUREMENT EpmCrS_stDGIDiagStop "Stop the healing of DFC_EpmCrSDGI" UBYTE OneToOne 1 100 0.00 255.0 FORMAT "%5.1" ECU_ADDRESS 0x6000B163 /end MEASUREMENT
/begin MEASUREMENT EpmCrS_stDiag "state of crankshaft signal diagnosis" UBYTE EpmCrS_Diag_State 1 100 0.00 3.00000000000 FORMAT "%13.11" ECU_ADDRESS 0x6000F848 /end MEASUREMENT
/begin MEASUREMENT EpmCrS_stDiagDGI "current state of error DGI by glitches" UBYTE EpmCrS_DiagResult_State 1 100 0.00 4.00000000000 FORMAT "%13.11" ECU_ADDRESS 0x6000B162 /end MEASUREMENT
/begin MEASUREMENT EpmCrS_stDiagErrSig "current state of error wrong crankshaft signal" UBYTE EpmCrS_DiagResult_State 1 100 0.00 4.00000000000 FORMAT "%13.11" ECU_ADDRESS 0x6000B15C /end MEASUREMENT
/begin MEASUREMENT EpmCrS_stDiagNoSig "current state of error NoSig" UBYTE EpmCrS_DiagResult_State 1 100 0.00 4.00000000000 FORMAT "%13.11" ECU_ADDRESS 0x6000B15B /end MEASUREMENT
/begin MEASUREMENT EpmCrS_stDiagPosDGI "current state of error DGI by engine start position" UBYTE EpmCrS_DiagResult_State 1 100 0.00 4.00000000000 FORMAT "%13.11" ECU_ADDRESS 0x6000B15A /end MEASUREMENT
/begin MEASUREMENT EpmCrS_stDiagPulseDGI "State of DGI pulse length diagnosis" UBYTE EpmCrS_DiagResult_State 1 100 0.00 4.00000000000 FORMAT "%13.11" ECU_ADDRESS 0x6000B159 /end MEASUREMENT
/begin MEASUREMENT EpmCrS_stDiagRRDGI "state of diagnosis of unplausible DGI reverse pulses" UBYTE EpmCrS_DiagResult_State 1 100 0.00 4.00000000000 FORMAT "%13.11" ECU_ADDRESS 0x6000B161 /end MEASUREMENT
/begin MEASUREMENT EpmCrS_stEnaAgClkPlausChk "Indicates the status of angle plausibility check, enableddisabled TRUE = Angle plausibility check enabled from next Syncpre task, FALSE = Angle plausibility check disabled from next Syncpre task." UBYTE OneToOne 1 100 0.00 255.0 BIT_MASK 0x1 FORMAT "%5.1" ECU_ADDRESS 0x50005FAE /end MEASUREMENT
/begin MEASUREMENT EpmCrS_stErrSigDiagStop "Stop the healing of DFC_EpmCrSErrSig" UBYTE OneToOne 1 100 0.00 255.0 FORMAT "%5.1" ECU_ADDRESS 0x6000B158 /end MEASUREMENT
/begin MEASUREMENT EpmCrS_stHiEngSpd "Status of Crankshaft Hybrid sensor in DG operating speed range" UBYTE OneToOne 1 100 0.00 255.0 BIT_MASK 0x1 FORMAT "%5.1" ECU_ADDRESS 0x6000B155 /end MEASUREMENT
/begin MEASUREMENT EpmCrS_stNoSigDiagStop "Stop the healing of DFC_EpmCrSNoSig" UBYTE OneToOne 1 100 0.00 255.0 FORMAT "%5.1" ECU_ADDRESS 0x6000B157 /end MEASUREMENT
/begin MEASUREMENT EpmCrS_stRotDir "Rotation direction based on DGI sensor (0 - Forward, 1- Reverse)" UBYTE EpmHCrS_stRotDir_t 1 100 0.00 3.00000000000 FORMAT "%13.11" ECU_ADDRESS 0x5000600E /end MEASUREMENT
/begin MEASUREMENT EpmCrS_stRstDiag "locale request for reinitialization of locale variables" UBYTE OneToOne 1 100 0.00 255.0 BIT_MASK 0x1 FORMAT "%5.1" ECU_ADDRESS 0x600008C3 /end MEASUREMENT
/begin MEASUREMENT EpmCrS_stSigDiagSrc "reason of cranksahft error" UWORD OneToOne 1 100 0.00 65535.00 FORMAT "%8.2" ECU_ADDRESS 0x60013386 /end MEASUREMENT
/begin MEASUREMENT EpmCrS_stSigMode "state of crankshaft signal evaluation" UBYTE EpmHCrS_stSigMode_State_t 1 100 0.00 9.00000000000 FORMAT "%13.11" ECU_ADDRESS 0x5000600F /end MEASUREMENT
/begin MEASUREMENT EpmCrS_swtRstDGI "Switch for resetting DFC_EpmCrSDGI" UBYTE OneToOne 1 100 0.00 255.0 FORMAT "%5.1" ECU_ADDRESS 0x6000B160 /end MEASUREMENT
/begin MEASUREMENT EpmCrS_swtRstErrSig "Switch for resetting DFC_EpmCrSErrSig" UBYTE OneToOne 1 100 0.00 255.0 FORMAT "%5.1" ECU_ADDRESS 0x6000B15F /end MEASUREMENT
/begin MEASUREMENT EpmCrS_swtRstNoSig "Switch for resetting DFC_EpmCrSNoSig" UBYTE OneToOne 1 100 0.00 255.0 FORMAT "%5.1" ECU_ADDRESS 0x6000B15E /end MEASUREMENT
/begin MEASUREMENT EpmCrS_swtRstRRNotPlaus "Switch for resetting of DFC_EpmCrSDGIRRNotPlaus" UBYTE OneToOne 1 100 0.00 255.0 BIT_MASK 0x1 FORMAT "%5.1" ECU_ADDRESS 0x6000B15D /end MEASUREMENT
/begin MEASUREMENT EpmCrS_swtSnsrTyp "Type of Crankshaft Hybrid sensor" UBYTE EpmCrS_swtSnsrTyp_State_t 1 100 0.00 2.00000000000 FORMAT "%13.11" ECU_ADDRESS 0x6000B154 /end MEASUREMENT
/begin MEASUREMENT EpmCrS_tiDgiPlsFwdAvrg "Average forward pulse width of the DGI sensor (over a segment)" ULONG OneToOne 1 100 0.00 4294967295.00 FORMAT "%13.2" ECU_ADDRESS 0x7000522C /end MEASUREMENT
/begin MEASUREMENT EpmCrS_tiDgiPlsFwdMax "Maximum forward pulse width of the DGI sensor (over a driving cycle)" ULONG OneToOne 1 100 0.00 4294967295.00 FORMAT "%13.2" ECU_ADDRESS 0x70005230 /end MEASUREMENT
/begin MEASUREMENT EpmCrS_tiDgiPlsFwdMin "Minimum forward pulse width of the DGI sensor (over a driving cycle)" ULONG OneToOne 1 100 0.00 4294967295.00 FORMAT "%13.2" ECU_ADDRESS 0x70005234 /end MEASUREMENT
/begin MEASUREMENT EpmCrS_tiDgiPlsRvsAvrg "Average reverse pulse width of the DGI sensor (over a segment)" ULONG OneToOne 1 100 0.00 4294967295.00 FORMAT "%13.2" ECU_ADDRESS 0x70005238 /end MEASUREMENT
/begin MEASUREMENT EpmCrS_tiDgiPlsRvsMax "Maximum reverse pulse width of the DGI sensor (over a driving cycle)" ULONG OneToOne 1 100 0.00 4294967295.00 FORMAT "%13.2" ECU_ADDRESS 0x7000523C /end MEASUREMENT
/begin MEASUREMENT EpmCrS_tiDgiPlsRvsMin "Minimum reverse pulse width of the DGI sensor (over a driving cycle)" ULONG OneToOne 1 100 0.00 4294967295.00 FORMAT "%13.2" ECU_ADDRESS 0x70005240 /end MEASUREMENT
/begin MEASUREMENT EpmCrS_tiIncPer "current tooth-time on crankshaft" SLONG GptaClc6_ti_COMPU 1 100 -858993459.200 858993458.800 FORMAT "%13.3" ECU_ADDRESS 0x70005244 /end MEASUREMENT
/begin MEASUREMENT EpmCrS_tiInc_mp "TTMeasure - CrS-tooth times since last interrupt" SLONG Time_ns_to_us 1 100 -2147483.64800 2147483.64700 FORMAT "%13.5" ARRAY_SIZE 30 ECU_ADDRESS 0x70009A64 /end MEASUREMENT
/begin MEASUREMENT EpmCrS_tiSeg "cylinder segment time" SLONG Per_Dur 1 100 -2147483648.00 2147483647.00 FORMAT "%13.2" ECU_ADDRESS 0x70005248 /end MEASUREMENT
/begin MEASUREMENT EpmCrS_tiSegCurr "half cylinder segment time" SLONG Per_Dur 1 100 -2147483648.00 2147483647.00 FORMAT "%13.2" ECU_ADDRESS 0x50004EC0 /end MEASUREMENT
/begin MEASUREMENT EpmCrS_tiSegHiRes "Crank segment time calculation with resolution with 50 ns" SLONG RBPtCel_ti_50p0_1 1 100 -107374182400. 107374182350. FORMAT "%13.0" ECU_ADDRESS 0x50004EC4 /end MEASUREMENT
/begin MEASUREMENT EpmErr_ctErrInfoAryFree "Index of next, free entry in control buffer structure" UWORD OneToOne 1 100 0.00 65535.00 FORMAT "%8.2" ECU_ADDRESS 0x600070F8 /end MEASUREMENT
/begin MEASUREMENT EpmErr_TraceCoreId "Core-Id on which the error was seen" ULONG OneToOne 1 100 0.00 4294967295.00 FORMAT "%13.2" ARRAY_SIZE 5 ECU_ADDRESS 0x50001770 /end MEASUREMENT
/begin MEASUREMENT EpmErr_TraceErrClass "Error-class of error" UBYTE EpmErr_ErrClass_t 1 100 0.00 4.00000000000 FORMAT "%13.11" ARRAY_SIZE 5 ECU_ADDRESS 0x6000B14F /end MEASUREMENT
/begin MEASUREMENT EpmErr_TraceErrId "Error number" UBYTE OneToOne 1 100 0.00 255.0 FORMAT "%5.1" ARRAY_SIZE 5 ECU_ADDRESS 0x6000B14A /end MEASUREMENT
/begin MEASUREMENT EpmErr_TraceErrInfo1 "additional information part 1" ULONG OneToOne 1 100 0.00 4294967295.00 FORMAT "%13.2" ARRAY_SIZE 5 ECU_ADDRESS 0x50001784 /end MEASUREMENT
/begin MEASUREMENT EpmErr_TraceErrInfo2 "additional information part 2" ULONG OneToOne 1 100 0.00 4294967295.00 FORMAT "%13.2" ARRAY_SIZE 5 ECU_ADDRESS 0x50001798 /end MEASUREMENT
/begin MEASUREMENT EpmErr_TraceErrInfo3 "additional information part 3" ULONG OneToOne 1 100 0.00 4294967295.00 FORMAT "%13.2" ARRAY_SIZE 5 ECU_ADDRESS 0x500017AC /end MEASUREMENT
/begin MEASUREMENT EpmErr_TraceErrInfo4 "additional information part 4" ULONG OneToOne 1 100 0.00 4294967295.00 FORMAT "%13.2" ARRAY_SIZE 5 ECU_ADDRESS 0x500017C0 /end MEASUREMENT
/begin MEASUREMENT EpmErr_TraceErrorReaction "Error Reaction" ULONG EpmErr_ErrClass_t 1 100 0.00 4.00000000000 FORMAT "%13.11" ARRAY_SIZE 5 ECU_ADDRESS 0x500017D4 /end MEASUREMENT
/begin MEASUREMENT EpmErr_TraceModId "Module-Id of the error handler calling software part" UBYTE Epm_ModId_t 1 100 0.00 80.0000000000 FORMAT "%13.10" ARRAY_SIZE 5 ECU_ADDRESS 0x6000B145 /end MEASUREMENT
/begin MEASUREMENT EpmErr_TraceStatus "error status information byte" UBYTE OneToOne 1 100 0.00 255.0 FORMAT "%5.1" ARRAY_SIZE 5 ECU_ADDRESS 0x6000B140 /end MEASUREMENT
/begin MEASUREMENT EpmErr_TraceTimeStamp "error occurence time stamp" ULONG t_q0p01_us 1 100 0.00 42949672.9500 FORMAT "%13.4" ARRAY_SIZE 5 ECU_ADDRESS 0x500017E8 /end MEASUREMENT
/begin MEASUREMENT EpmHAgClk_AddTick "Increment distribution of additional ticks of angle clock" UBYTE OneToOne 1 100 0.00 255.0 FORMAT "%5.1" ARRAY_SIZE 8 ECU_ADDRESS 0x6000B138 /end MEASUREMENT
/begin MEASUREMENT EpmHAgClk_agPosnTrigEve "Angle stamp of the current activiation event" SWORD AngleCrS 1 100 -720.0000 719.9780 FORMAT "%8.4" ECU_ADDRESS 0x6000059A /end MEASUREMENT
/begin MEASUREMENT EpmHAgClk_Gen_AgCntRaw_mp "Current angle clock value in 24-bit, read in 1ms task" ULONG AngleCrS 1 100 0.00 94371839.9781 FORMAT "%13.4" ECU_ADDRESS 0x70009A60 /end MEASUREMENT
/begin MEASUREMENT EpmHAgClk_Gen_AgCnt_mp "Current angle clock value limited to one working cycle (720), read in 1ms task" SWORD AngleCrS 1 100 -720.0000 719.9780 FORMAT "%8.4" ECU_ADDRESS 0x70009CEE /end MEASUREMENT
/begin MEASUREMENT EpmHAgClk_numAgClkFrq "Control parameter for extremal values of angle clock speed" UBYTE EpmHAgClk_AgClkFrq_t 1 100 0.00 3.00000000000 FORMAT "%13.11" ECU_ADDRESS 0x7000545E /end MEASUREMENT
/begin MEASUREMENT EpmHAgClk_numAgClkMode "Actual correction mode of angle clock" UBYTE EpmHAgClk_AgClkMode_t 1 100 0.00 3.00000000000 FORMAT "%13.11" ECU_ADDRESS 0x600140B6 /end MEASUREMENT
/begin MEASUREMENT EpmHAgClk_numAgClkState "Actual activation state of angle clock" UBYTE EpmHAgClk_AgClkState_t 1 100 0.00 1.00000000000 FORMAT "%13.11" ECU_ADDRESS 0x50005FB0 /end MEASUREMENT
/begin MEASUREMENT EpmHAgClk_numAgTicksPerInc "Nominal tick number of angle clock per increment" UWORD OneToOne 1 100 0.00 65535.00 FORMAT "%8.2" ECU_ADDRESS 0x60013388 /end MEASUREMENT
/begin MEASUREMENT EpmHAgClk_numMissTick "Number of missing micro ticks not generated until synchronisation gap" SWORD OneToOne 1 100 -32768.00 32767.00 FORMAT "%8.2" ECU_ADDRESS 0x600070F6 /end MEASUREMENT
/begin MEASUREMENT EpmHAgClk_stAPTSyn "Status: DPLL synchronous at hardware profile (ADT_T)" UBYTE OneToOne 1 100 0.00 255.0 BIT_MASK 0x1 FORMAT "%5.1" ECU_ADDRESS 0x6000B137 /end MEASUREMENT
/begin MEASUREMENT EpmHAgClk_tiIncPerBas "Nominal increment duration for setting of angle clock speed" SLONG OneToOne 1 100 -2147483648.00 2147483647.00 FORMAT "%13.2" ECU_ADDRESS 0x70005148 /end MEASUREMENT
/begin MEASUREMENT EpmHAgClk_tiMinPer "Minimum increment duration (according to maximum engine speed)" SLONG OneToOne 1 100 -2147483648.00 2147483647.00 FORMAT "%13.2" ECU_ADDRESS 0x500017FC /end MEASUREMENT
/begin MEASUREMENT Epm_Reset_RSTDetected_u32 "marker for power on detected" ULONG OneToOne 1 100 0.00 4294967295.00 FORMAT "%13.2" ECU_ADDRESS 0x600340D8 /end MEASUREMENT
/begin MEASUREMENT fho_msg "Altitude correction factor" UBYTE fak_ub_b4 1 100 0.00 3.984 FORMAT "%5.3" ECU_ADDRESS 0x60014164 /end MEASUREMENT
/begin MEASUREMENT frhol_w_msg "Factor: air density f(intake air temp., altitude), 16-bit" UWORD fak_uw_b2 1 100 0.00 1.999969 FORMAT "%8.6" ECU_ADDRESS 0x60014012 /end MEASUREMENT
/begin MEASUREMENT MoXTqPtd_tqInrDes "permitted torque without offset" SWORD md_q0p1 1 100 -3276.800 3276.700 FORMAT "%8.3" ECU_ADDRESS 0x60007196 /end MEASUREMENT
/begin MEASUREMENT MoXTrqPtd_facTqErrSum "error sum of the weighted deviation from the permitted torque" UWORD rel_q0p00195_pc_s 1 100 0.00 127.9980 FORMAT "%8.4" ECU_ADDRESS 0x60007194 /end MEASUREMENT
/begin MEASUREMENT MoXTrqPtd_flgEngLimActvd "activation condition for the consideration of the permitted torques in the torque coordination" UBYTE B_TRUE 1 100 0.00 1.00000000000 BIT_MASK 0x1 FORMAT "%13.11" ECU_ADDRESS 0x6000B199 /end MEASUREMENT
/begin MEASUREMENT MoXTrqPtd_flgEngLimDeactv_MP "torque limitation with the permitted torques inactiv in the torque coordination" UBYTE B_TRUE 1 100 0.00 1.00000000000 BIT_MASK 0x1 FORMAT "%13.11" ECU_ADDRESS 0x7000A2B6 /end MEASUREMENT
/begin MEASUREMENT MoXTrqPtd_flgPtdFltEngLimLeadDeactv_MP "torque limitation with the permitted torque inactiv on the lead path" UBYTE B_TRUE 1 100 0.00 1.00000000000 BIT_MASK 0x1 FORMAT "%13.11" ECU_ADDRESS 0x7000A2B5 /end MEASUREMENT
/begin MEASUREMENT MoXTrqPtd_flgPtdFltEngLimSetDeactv_MP "torque limitation with the permitted torque inactiv on the set path" UBYTE B_TRUE 1 100 0.00 1.00000000000 BIT_MASK 0x1 FORMAT "%13.11" ECU_ADDRESS 0x7000A2B4 /end MEASUREMENT
/begin MEASUREMENT MoXTrqPtd_tqInrPtd "permitted torque without offset" SWORD md_q0p1 1 100 -3276.800 3276.700 FORMAT "%8.3" ECU_ADDRESS 0x60007192 /end MEASUREMENT
/begin MEASUREMENT MoXTrqPtd_tqInrPtdFildLvl2 "filtered maximal permitted inner torque (corresponding level 2)" SWORD md_q0p1 1 100 -3276.800 3276.700 FORMAT "%8.3" ECU_ADDRESS 0x60007190 /end MEASUREMENT
/begin MEASUREMENT MoXTrqPtd_tqInrPtdOfsLvl2 "inner permissible torque L2 with offset in extended monitoring" SWORD md_q0p1 1 100 -3276.800 3276.700 FORMAT "%8.3" ECU_ADDRESS 0x6000718E /end MEASUREMENT
/begin MEASUREMENT MoXTrqPtd_tqOffsLvl2_MP "overall torque offset combustion and electrical engine appropiate L2" SWORD Trq 1 100 -3276.800 3276.700 FORMAT "%8.3" ECU_ADDRESS 0x7000A2B2 /end MEASUREMENT
/begin MEASUREMENT MoX_tqInrDesPtdOfs "inner permitted torque with offset for Set-path" SWORD md_q0p1 1 100 -3276.800 3276.700 FORMAT "%8.3" ECU_ADDRESS 0x6000718C /end MEASUREMENT
/begin MEASUREMENT MoX_trqInrDesPtd "Inner permitted torque without LLR and Compensation" SWORD md_q0p1 1 100 -3276.800 3276.700 FORMAT "%8.3" ECU_ADDRESS 0x6000718A /end MEASUREMENT
/begin MEASUREMENT MoX_trqInrLead "inner permissible torque lead path non filtered" SWORD md_q0p1 1 100 -3276.800 3276.700 FORMAT "%8.3" ECU_ADDRESS 0x60007188 /end MEASUREMENT
/begin MEASUREMENT MoX_trqInrLeadPtd "inner permissible torque lead path without idle speed control torque and compensation non filtered" SWORD md_q0p1 1 100 -3276.800 3276.700 FORMAT "%8.3" ECU_ADDRESS 0x60007186 /end MEASUREMENT
/begin MEASUREMENT MoX_trqInrLeadWoResv "inner permissible torque lead path without reserve non filtered" SWORD md_q0p1 1 100 -3276.800 3276.700 FORMAT "%8.3" ECU_ADDRESS 0x60007184 /end MEASUREMENT
/begin MEASUREMENT MoX_trqInrLeadWoResvFlt "inner permissible torque lead path without reserve filtered+compensation" SWORD md_q0p1 1 100 -3276.800 3276.700 FORMAT "%8.3" ECU_ADDRESS 0x60007182 /end MEASUREMENT
/begin MEASUREMENT MoX_trqInrPtdLead "inner permissible torque lead path filtered" SWORD md_q0p1 1 100 -3276.800 3276.700 FORMAT "%8.3" ECU_ADDRESS 0x60007180 /end MEASUREMENT
/begin MEASUREMENT MoX_trqInrPtdLeadWoResv "inner permissible torque lead path without reserve filtered" SWORD md_q0p1 1 100 -3276.800 3276.700 FORMAT "%8.3" ECU_ADDRESS 0x6000717E /end MEASUREMENT
/begin MEASUREMENT MoX_trqInrPtdSet "inner permissible torque set path filtered" SWORD md_q0p1 1 100 -3276.800 3276.700 FORMAT "%8.3" ECU_ADDRESS 0x6000717C /end MEASUREMENT
/begin MEASUREMENT MoX_trqInrSet "inner permissible torque set path non filtered" SWORD md_q0p1 1 100 -3276.800 3276.700 FORMAT "%8.3" ECU_ADDRESS 0x6000717A /end MEASUREMENT
/begin MEASUREMENT MoX_trqOfs "offset for maximum permissible torque" SWORD md_q0p1 1 100 -3276.800 3276.700 FORMAT "%8.3" ECU_ADDRESS 0x60007178 /end MEASUREMENT
/begin MEASUREMENT MoX_trqSpdGovFlt "Idle control torque in extended monitoring" SWORD md_q0p1 1 100 -3276.800 3276.700 FORMAT "%8.3" ECU_ADDRESS 0x60009028 /end MEASUREMENT
/begin MEASUREMENT MoX_trqSpdGovLead "idle speed control lead torque" SWORD md_q0p1 1 100 -3276.800 3276.700 FORMAT "%8.3" ECU_ADDRESS 0x60009026 /end MEASUREMENT
/begin MEASUREMENT MoX_trqSpdGovPtd "idle speed control permitted torque in the extended monitoring" UBYTE md_q1p6 1 100 0.00 408.0 FORMAT "%5.1" ECU_ADDRESS 0x6000B198 /end MEASUREMENT
/begin MEASUREMENT MoX_trqSpdGovSet "idle speed control set torque in the extended monitoring" SWORD md_q0p1 1 100 -3276.800 3276.700 FORMAT "%8.3" ECU_ADDRESS 0x60009024 /end MEASUREMENT
/begin MEASUREMENT MoX_trqVehDesPtd "permissible torque vehicle set path in the extended monitoring" SWORD md_q0p1 1 100 -3276.800 3276.700 FORMAT "%8.3" ECU_ADDRESS 0x60007176 /end MEASUREMENT
/begin MEASUREMENT MoX_trqVehLeadPtd "permissible torque vehicle lead path in the extended monitoring" SWORD md_q0p1 1 100 -3276.800 3276.700 FORMAT "%8.3" ECU_ADDRESS 0x60007174 /end MEASUREMENT
/begin MEASUREMENT PEnv_ctDrvEnter "drive state counter" UBYTE OneToOne 1 100 0.00 255.0 FORMAT "%5.1" ECU_ADDRESS 0x6000B197 /end MEASUREMENT
/begin MEASUREMENT PEnv_ctPostDrvLeave "post drive state counter" UBYTE OneToOne 1 100 0.00 255.0 FORMAT "%5.1" ECU_ADDRESS 0x6000B196 /end MEASUREMENT
/begin MEASUREMENT PEnv_dataDigSnsr "Digital raw data from ambient pressure sensor" ULONG OneToOne 1 100 0.00 4294967295.00 FORMAT "%13.2" ECU_ADDRESS 0x60002BA8 /end MEASUREMENT
/begin MEASUREMENT PEnv_DD_ctPostDrvLeave "Local drive cycle counter which is incremented when system state SyC_PostDrive is left" UWORD OneToOne 1 100 0.00 256.0000 FORMAT "%8.4" ECU_ADDRESS 0x60007172 /end MEASUREMENT
/begin MEASUREMENT PEnv_dpAirFilThr "pressure loss at air filter depending on air mass flow" UWORD p_q0p078 1 100 0.00 5119.922 FORMAT "%8.3" ECU_ADDRESS 0x50005DB8 /end MEASUREMENT
/begin MEASUREMENT PEnv_facCorrAlti "Altitude correction factor" UWORD fak_uw_b4 1 100 0.00 3.999939 FORMAT "%8.6" ECU_ADDRESS 0x50005DBA /end MEASUREMENT
/begin MEASUREMENT PEnv_flgBndMdlRngVld "Healing of continuity check with additional value" UBYTE B_TRUE 1 100 0.00 1.00000000000 BIT_MASK 0x1 FORMAT "%13.11" ECU_ADDRESS 0x700007C7 /end MEASUREMENT
/begin MEASUREMENT PEnv_flgBndMdlVirtVld "Condition threshold modells for ambient pressure valid virtuelly" UBYTE B_TRUE 1 100 0.00 1.00000000000 BIT_MASK 0x1 FORMAT "%13.11" ECU_ADDRESS 0x700007C6 /end MEASUREMENT
/begin MEASUREMENT PEnv_flgBndMdlVld "Condition threshold modells for ambient pressure valid" UBYTE B_TRUE 1 100 0.00 1.00000000000 BIT_MASK 0x1 FORMAT "%13.11" ECU_ADDRESS 0x700007C5 /end MEASUREMENT
/begin MEASUREMENT PEnv_flgCcLdcCmpl "Cycle flag ambient pressure from current driving cycle adopted" UBYTE B_TRUE 1 100 0.00 1.00000000000 BIT_MASK 0x1 FORMAT "%13.11" ECU_ADDRESS 0x700007C4 /end MEASUREMENT
/begin MEASUREMENT PEnv_flgCcLdcDiagCmpl "zyklus flag for diagnosis by comparing actual and last driving cycle ambient pressure" UBYTE B_TRUE 1 100 0.00 1.00000000000 BIT_MASK 0x1 FORMAT "%13.11" ECU_ADDRESS 0x700002C4 /end MEASUREMENT
/begin MEASUREMENT PEnv_flgCcLdcInvld "Condition: Fault suspicion from continuity check between the drives" UBYTE B_TRUE 1 100 0.00 1.00000000000 BIT_MASK 0x1 FORMAT "%13.11" ECU_ADDRESS 0x700002C3 /end MEASUREMENT
/begin MEASUREMENT PEnv_flgCcLdcVld "Condition: Healing from continuity check between the drives" UBYTE B_TRUE 1 100 0.00 1.00000000000 BIT_MASK 0x1 FORMAT "%13.11" ECU_ADDRESS 0x700002C2 /end MEASUREMENT
/begin MEASUREMENT PEnv_flgCcMaxInvld "Condition discontinuity ambient air pressure downwards" UBYTE B_TRUE 1 100 0.00 1.00000000000 BIT_MASK 0x1 FORMAT "%13.11" ECU_ADDRESS 0x700007C3 /end MEASUREMENT
/begin MEASUREMENT PEnv_flgCcMinInvld "Condition discontinuity ambient air pressure upwards" UBYTE B_TRUE 1 100 0.00 1.00000000000 BIT_MASK 0x1 FORMAT "%13.11" ECU_ADDRESS 0x700007C2 /end MEASUREMENT
/begin MEASUREMENT PEnv_flgCcVld "Condition: Healing from continuity check while driving" UBYTE B_TRUE 1 100 0.00 1.00000000000 BIT_MASK 0x1 FORMAT "%13.11" ECU_ADDRESS 0x700007C1 /end MEASUREMENT
/begin MEASUREMENT PEnv_flgDeadLockPrevn "Condition deadlock threshold modells for ambient pressure valid" UBYTE B_TRUE 1 100 0.00 1.00000000000 BIT_MASK 0x1 FORMAT "%13.11" ECU_ADDRESS 0x700007C0 /end MEASUREMENT
/begin MEASUREMENT PEnv_flgDsmClrTrig "Trigger flag to clear diagnosis relevant elements" UBYTE B_TRUE 1 100 0.00 1.00000000000 BIT_MASK 0x1 FORMAT "%13.11" ECU_ADDRESS 0x700002C7 /end MEASUREMENT
/begin MEASUREMENT PEnv_flgErrSuspcCc "Condition: Error suspision from contionious check" UBYTE B_TRUE 1 100 0.00 1.00000000000 BIT_MASK 0x1 FORMAT "%13.11" ECU_ADDRESS 0x60036E04 /end MEASUREMENT
/begin MEASUREMENT PEnv_flgGetData "Status bit valid data received form digital ambient pressure sensor" UBYTE B_TRUE 1 100 0.00 1.00000000000 BIT_MASK 0x1 FORMAT "%13.11" ECU_ADDRESS 0x700002C6 /end MEASUREMENT
/begin MEASUREMENT PEnv_flgHealSuspcCc "Condition: Healing of error suspision from contionious check" UBYTE B_TRUE 1 100 0.00 1.00000000000 BIT_MASK 0x1 FORMAT "%13.11" ECU_ADDRESS 0x700007BF /end MEASUREMENT
/begin MEASUREMENT PEnv_flgInctRatCmpl "condition numerator complete for rationality diagnostic of ambient pressure sensor" UBYTE B_TRUE 1 100 0.00 1.00000000000 BIT_MASK 0x1 FORMAT "%13.11" ECU_ADDRESS 0x700002C1 /end MEASUREMENT
/begin MEASUREMENT PEnv_flgPBal "Condition: pressure balance for replacement value by referenece sensor" UBYTE B_TRUE 1 100 0.00 1.00000000000 BIT_MASK 0x1 FORMAT "%13.11" ECU_ADDRESS 0x60036DD1 /end MEASUREMENT
/begin MEASUREMENT PEnv_flgPLdcVld "ambient pressure from last driving cycle valid" UBYTE B_TRUE 1 100 0.00 1.00000000000 BIT_MASK 0x1 FORMAT "%13.11" ECU_ADDRESS 0x60036E03 /end MEASUREMENT
/begin MEASUREMENT PEnv_flgPMdlVld "condition: modelled ambient pressure valid" UBYTE B_TRUE 1 100 0.00 1.00000000000 BIT_MASK 0x1 FORMAT "%13.11" ECU_ADDRESS 0x60036DD0 /end MEASUREMENT
/begin MEASUREMENT PEnv_flgPMeasdVld "condition: ambient pressure from sensor valid" UBYTE B_TRUE 1 100 0.00 1.00000000000 BIT_MASK 0x1 FORMAT "%13.11" ECU_ADDRESS 0x700007BE /end MEASUREMENT
/begin MEASUREMENT PEnv_flgPPlaus "status indicates the signal is plausible" UBYTE B_TRUE 1 100 0.00 1.00000000000 BIT_MASK 0x1 FORMAT "%13.11" ECU_ADDRESS 0x700007BD /end MEASUREMENT
/begin MEASUREMENT PEnv_flgPRawVld "Validity flag for the raw ambient pressure sensor" UBYTE B_TRUE 1 100 0.00 1.00000000000 BIT_MASK 0x1 FORMAT "%13.11" ECU_ADDRESS 0x6000F0DC /end MEASUREMENT
/begin MEASUREMENT PEnv_flgPRawVldDiag "Condition ambient pressure sensor valid delayed" UBYTE B_TRUE 1 100 0.00 1.00000000000 BIT_MASK 0x1 FORMAT "%13.11" ECU_ADDRESS 0x700002C0 /end MEASUREMENT
/begin MEASUREMENT PEnv_flgPVld "condition: ambient pressure valid" UBYTE B_TRUE 1 100 0.00 1.00000000000 BIT_MASK 0x1 FORMAT "%13.11" ECU_ADDRESS 0x700007BC /end MEASUREMENT
/begin MEASUREMENT PEnv_flgRngChkMaxInvld "Error condition max from physical range check" UBYTE B_TRUE 1 100 0.00 1.00000000000 BIT_MASK 0x1 FORMAT "%13.11" ECU_ADDRESS 0x700007BB /end MEASUREMENT
/begin MEASUREMENT PEnv_flgRngChkMaxVld "Healing condition max from physical range check" UBYTE B_TRUE 1 100 0.00 1.00000000000 BIT_MASK 0x1 FORMAT "%13.11" ECU_ADDRESS 0x700007BA /end MEASUREMENT
/begin MEASUREMENT PEnv_flgRngChkMinInvld "Error condition min from physical range check" UBYTE B_TRUE 1 100 0.00 1.00000000000 BIT_MASK 0x1 FORMAT "%13.11" ECU_ADDRESS 0x700007B9 /end MEASUREMENT
/begin MEASUREMENT PEnv_flgRngChkMinVld "Healing condition min from physical range check" UBYTE B_TRUE 1 100 0.00 1.00000000000 BIT_MASK 0x1 FORMAT "%13.11" ECU_ADDRESS 0x700007B8 /end MEASUREMENT
/begin MEASUREMENT PEnv_flgSnsrBootRdy "Status of Sensor readiness" UBYTE B_TRUE 1 100 0.00 1.00000000000 BIT_MASK 0x1 FORMAT "%13.11" ECU_ADDRESS 0x700007B7 /end MEASUREMENT
/begin MEASUREMENT PEnv_flgSnsrPlausInvld "status plausible error information from digital ambient air pressure sensor" UBYTE B_TRUE 1 100 0.00 1.00000000000 BIT_MASK 0x1 FORMAT "%13.11" ECU_ADDRESS 0x700007B6 /end MEASUREMENT
/begin MEASUREMENT PEnv_flgSnsrRst "Sensor reset has been triggered" UBYTE B_TRUE 1 100 0.00 1.00000000000 BIT_MASK 0x1 FORMAT "%13.11" ECU_ADDRESS 0x700007B5 /end MEASUREMENT
/begin MEASUREMENT PEnv_flgUseIniAftStrtEnd "condition for valid ambient pressure model based on manifold pressure" UBYTE B_TRUE 1 100 0.00 1.00000000000 BIT_MASK 0x1 FORMAT "%13.11" ECU_ADDRESS 0x700002C5 /end MEASUREMENT
/begin MEASUREMENT PEnv_p "Ambient pressure" UWORD p_q0p039 1 100 0.00 2559.961 FORMAT "%8.3" ECU_ADDRESS 0x50005DBE /end MEASUREMENT
/begin MEASUREMENT PEnv_pBndMdlMax "maximum modelled ambient pressure" UWORD p_q0p039 1 100 0.00 2559.961 FORMAT "%8.3" ECU_ADDRESS 0x600085AC /end MEASUREMENT
/begin MEASUREMENT PEnv_pBndMdlMin "minimal modelled ambient pressure" UWORD p_q0p039 1 100 0.00 2559.961 FORMAT "%8.3" ECU_ADDRESS 0x600085AA /end MEASUREMENT
/begin MEASUREMENT PEnv_pCurrDrvCyc "electr. valid ambient pressure from actual driving cycle" UWORD p_q0p039 1 100 0.00 2559.961 FORMAT "%8.3" ECU_ADDRESS 0x60007170 /end MEASUREMENT
/begin MEASUREMENT PEnv_pDly "delayed ambient pressure" UWORD p_q0p039 1 100 0.00 2559.961 FORMAT "%8.3" ECU_ADDRESS 0x6000716E /end MEASUREMENT
/begin MEASUREMENT PEnv_pLdc "ambient pressure from last driving cycle" UWORD p_q0p039 1 100 0.00 2559.961 FORMAT "%8.3" ECU_ADDRESS 0x60039582 /end MEASUREMENT
/begin MEASUREMENT PEnv_pMdl "Ambient pressure from model" UWORD p_q0p039 1 100 0.00 2559.961 FORMAT "%8.3" ECU_ADDRESS 0x600085A8 /end MEASUREMENT
/begin MEASUREMENT PEnv_pMeas "Ambient pressure measured" UWORD p_q0p039 1 100 0.00 2559.961 FORMAT "%8.3" ECU_ADDRESS 0x600085A6 /end MEASUREMENT
/begin MEASUREMENT PEnv_pRaw "ambient air pressure raw value measured" UWORD p_q0p039 1 100 0.00 2559.961 FORMAT "%8.3" ECU_ADDRESS 0x50005DC0 /end MEASUREMENT
/begin MEASUREMENT PEnv_pRawFild "filtered ambient pressure" UWORD p_q0p039 1 100 0.00 2559.961 FORMAT "%8.3" ECU_ADDRESS 0x6000716C /end MEASUREMENT
/begin MEASUREMENT PEnv_stErrMsgSens "bit coded error information from digital ambient air pressure sensor" ULONG OneToOne 1 100 0.00 4294967295.00 FORMAT "%13.2" ECU_ADDRESS 0x60002BA4 /end MEASUREMENT
/begin MEASUREMENT PEnv_stSigP "Signalstatus ambient pressure" UBYTE OneToOne 1 100 0.00 255.0 FORMAT "%5.1" ECU_ADDRESS 0x6000EF2D /end MEASUREMENT
/begin MEASUREMENT pum_w_msg "Ambient pressure from model" UWORD p_q0p039 1 100 0.00 2559.961 FORMAT "%8.3" ECU_ADDRESS 0x6003956E /end MEASUREMENT
/begin MEASUREMENT pur_w_msg "Ambient pressure from sensor" UWORD p_q0p039 1 100 0.00 2559.961 FORMAT "%8.3" ECU_ADDRESS 0x600084E0 /end MEASUREMENT
/begin MEASUREMENT pu_msg "Ambient pressure" UBYTE p_ub_q5 1 100 0.00 1275. FORMAT "%5.0" ECU_ADDRESS 0x60014174 /end MEASUREMENT
/begin MEASUREMENT tumgk_w_msg "Ambient air temperature, output in Grad C, calc. in Kelvin" UWORD temp_q0p0234_o273 1 100 -273.150 1262.827 FORMAT "%8.3" ECU_ADDRESS 0x600084B0 /end MEASUREMENT
/begin MEASUREMENT tumg_msg "ambient air temperature" UBYTE temp_ub_q0p75_o48 1 100 -48.0 143.3 FORMAT "%5.1" ECU_ADDRESS 0x60014175 /end MEASUREMENT
/begin MEASUREMENT tumm_msg "modeled ambient (air) temperature" UBYTE temp_ub_q0p75_o48 1 100 -48.0 143.3 FORMAT "%5.1" ECU_ADDRESS 0x6000EEC6 /end MEASUREMENT
/begin MEASUREMENT tum_msg "ambient (air) temperature" UBYTE temp_ub_q0p75_o48 1 100 -48.0 143.3 FORMAT "%5.1" ECU_ADDRESS 0x6000EEC7 /end MEASUREMENT
/begin FUNCTION EngTrqPtd_Co "62.2.0    Extended Monitoring: Maximum permitted engine torque"
 /begin DEF_CHARACTERISTIC EngTrqPtd_facSpdGovMax_CUR EngTrqPtd_nSpdGovPtd_C EngTrqPtd_trqResvMax_CUR EngTrqPtd_trqSpdGOfsPtd_CUR MoXTrqPtd_facTqErrMax_C MoXTrqPtd_facTqErrMin_C MoXTrqPtd_facTqErrSumActvn_C MoXTrqPtd_facTqErrSumDeactvn_C MoXTrqPtd_flgEngLimActvdMnl_C MoXTrqPtd_tiDelRatTqPtdLvl2_C MoXTrqPtd_tiEngLimDeactv_C MoXTrqPtd_tiExtIntDeactv_C MoXTrqPtd_tiFltRatTqPtdLvl2_C MoXTrqPtd_tqInrPtdSetDeactvn_C MoXTrqPtd_tqOffsLvl2_M MoXTrqPtd_tqPtdFltTqLimLeadOffs_C MoXTrqPtd_tqPtdFltTqLimSetOffs_C MoX_ctTrqCmpEngLimActvn_C MoX_rTrqPtdFltWgh_CUR MoX_tiEvacIntMan_C MoX_tiFltDash_C MoX_trqInrMaxStrt_C MoX_trqNorm_C MoX_trqOfs_MAP /end DEF_CHARACTERISTIC
 /begin REF_CHARACTERISTIC Mo_trqIdcMax_C /end REF_CHARACTERISTIC
 /begin IN_MEASUREMENT EngDem_trqInrLimCtOff Epm_nEng Epm_nEngLRes LIGov_nDiff MoExe_ctCyc MoFESpd_nEng MoFETC_stTstMsg MoFExtInt_stTSCPtdMsg MoFTrqLim_tqInrMinWoCtOffMsg MoFTrqLos_tqLosTotMsg MoFTrqPtd_tqCompMsg MoFTrqPtd_tqInrPtdMsg MoF_ctTrqCmp MoF_rTrqInrAct MoF_trqLosMsg MoX_bSyncLos_msg PhyMod_etaIgnBsAvrg PhyMod_etaIgnMin PthLead_trqInrNoMon PthLead_trqResv PthSet_trqInrIABef PthSet_trqInrLim RngMod_trqInrBs RngMod_trqLos SpdGov_trqFlt SpdGov_trqLead SpdGov_trqSet SyC_stSub ThrVlv_flgLimpModeB1 ThrVlv_flgReqFuCutOffB1 Tra_trqLeadMin /end IN_MEASUREMENT
 /begin OUT_MEASUREMENT EngTrqPtd_trqLead EngTrqPtd_trqLeadWoResv EngTrqPtd_trqSet EngTrqPtd_trqSetWoTraIntv MoX_trqSpdGovFlt MoX_trqSpdGovLead MoX_trqSpdGovSet /end OUT_MEASUREMENT
 /begin LOC_MEASUREMENT MoXTqPtd_tqInrDes MoXTrqPtd_facTqErrSum MoXTrqPtd_flgEngLimActvd MoXTrqPtd_flgEngLimDeactv_MP MoXTrqPtd_flgPtdFltEngLimLeadDeactv_MP MoXTrqPtd_flgPtdFltEngLimSetDeactv_MP MoXTrqPtd_tqInrPtd MoXTrqPtd_tqInrPtdFildLvl2 MoXTrqPtd_tqInrPtdOfsLvl2 MoXTrqPtd_tqOffsLvl2_MP MoX_tqInrDesPtdOfs MoX_trqInrDesPtd MoX_trqInrLead MoX_trqInrLeadPtd MoX_trqInrLeadWoResv MoX_trqInrLeadWoResvFlt MoX_trqInrPtdLead MoX_trqInrPtdLeadWoResv MoX_trqInrPtdSet MoX_trqInrSet MoX_trqOfs MoX_trqSpdGovPtd MoX_trqVehDesPtd MoX_trqVehLeadPtd /end LOC_MEASUREMENT
 FUNCTION_VERSION "62.2.0" /end FUNCTION
/begin FUNCTION EnvP_DD "24.12.0   Environment pressure sensor (device driver)"
 /begin DEF_CHARACTERISTIC PEnv_facCnvnSlopDig_C PEnv_flgDiSnsrPlaus_C PEnv_flgErrStEna_C PEnv_pCnvnOffs_C PEnv_stSensErrVal_C PEnv_tiDebSnsrPlaus_C PEnv_tiDrvDly_C PEnv_tiSnsrBootDly_C /end DEF_CHARACTERISTIC
 /begin IN_MEASUREMENT DSM_TripChgFinshd SyC_ctPostDrvLeave SyC_stSub /end IN_MEASUREMENT
 /begin OUT_MEASUREMENT B_purg_msg PEnv_flgPRawVld PEnv_flgSnsrBootRdy PEnv_flgSnsrPlausInvld PEnv_flgSnsrRst PEnv_pRaw pur_w_msg /end OUT_MEASUREMENT
 /begin LOC_MEASUREMENT PEnv_dataDigSnsr PEnv_DD_ctPostDrvLeave PEnv_flgDsmClrTrig PEnv_flgGetData PEnv_stErrMsgSens /end LOC_MEASUREMENT
 FUNCTION_VERSION "24.12.0" /end FUNCTION
/begin FUNCTION EnvP_VD "26.15.0   Environment pressure sensor (virtual device)"
 /begin DEF_CHARACTERISTIC PEnv_pAirFil_T PEnv_pDft_C PEnv_pDifEnvIntkVUsIniMax_C PEnv_pDifEnvIntkVUsIniMin_C PEnv_pDifEnvIntkVUsMax_C PEnv_pDifEnvIntkVUsMin_C PEnv_pMdlMaxThd_C PEnv_ratUnthrMdlTolr_C PEnv_swtCodVd_C PEnv_tiDlyEnagMdl_C PEnv_tiDlyHealIntkVUs_C PEnv_tiDlyTilPBal PEnv_tiPLT_C PEnv_tiStrtReplVld_C /end DEF_CHARACTERISTIC
 /begin REF_CHARACTERISTIC PEnv_pPlausThdMax_C PEnv_pPlausThdMin_C /end REF_CHARACTERISTIC
 /begin IN_MEASUREMENT AirDvP_pEnvOffs B_psini_msg B_psrgg_msg B_psrrg_msg Eep_EnvRamHist Eep_EnvRamInvld Epm_nEng fiuewdk_w_msg ftu_msg msdk_w_msg PEnv_flgCcLdcCmpl PEnv_flgErrSuspcCc PEnv_flgPPlaus PEnv_pRaw PIntkVUs_pRaw PIntkVUs_pRawIni SyC_ctDrvEnter SyC_ctPostDrvLeave SyC_stSub ThrVlv_ratActPosnB1 tnsez_w_msg wdkugd_w_msg /end IN_MEASUREMENT
 /begin OUT_MEASUREMENT B_pug_msg fho_msg frhol_w_msg PEnv_dpAirFilThr PEnv_facCorrAlti PEnv_flgBndMdlVirtVld PEnv_flgBndMdlVld PEnv_flgDeadLockPrevn PEnv_flgPLdcVld PEnv_flgPMeasdVld PEnv_flgPVld PEnv_p PEnv_pBndMdlMax PEnv_pBndMdlMin PEnv_pLdc PEnv_pMdl PEnv_pMeas PEnv_stSigP pum_w_msg pu_msg /end OUT_MEASUREMENT
 /begin LOC_MEASUREMENT PEnv_ctDrvEnter PEnv_ctPostDrvLeave PEnv_flgPBal PEnv_flgPMdlVld PEnv_flgUseIniAftStrtEnd /end LOC_MEASUREMENT
 FUNCTION_VERSION "26.15.0" /end FUNCTION
/begin FUNCTION EnvP_VDDiag "2.11.0    Plausibility diagnosis of environmental pressure sensor"
 /begin DEF_CHARACTERISTIC PEnv_pDifJmpMax_C PEnv_pDifLdcMax_C PEnv_pMaxSnsrTolr_C PEnv_pPlausThdMax_C PEnv_pPlausThdMin_C PEnv_swtCodDiag_C PEnv_tiCcLT_C PEnv_tiDlyRawVld_C SF_PU /end DEF_CHARACTERISTIC
 /begin REF_CHARACTERISTIC PEnv_tiStrtReplVld_C /end REF_CHARACTERISTIC
 /begin IN_MEASUREMENT DSM_TripChgFinshd PEnv_flgBndMdlVirtVld PEnv_flgBndMdlVld PEnv_flgDeadLockPrevn PEnv_flgPLdcVld PEnv_flgPRawVld PEnv_flgSnsrPlausInvld PEnv_flgSnsrRst PEnv_pBndMdlMax PEnv_pBndMdlMin PEnv_pLdc PEnv_pRaw SyC_stSub tnsez_w_msg /end IN_MEASUREMENT
 /begin OUT_MEASUREMENT B_pugg_msg PEnv_flgBndMdlRngVld PEnv_flgCcLdcCmpl PEnv_flgCcMaxInvld PEnv_flgCcMinInvld PEnv_flgCcVld PEnv_flgErrSuspcCc PEnv_flgHealSuspcCc PEnv_flgPPlaus PEnv_flgRngChkMaxInvld PEnv_flgRngChkMaxVld PEnv_flgRngChkMinInvld PEnv_flgRngChkMinVld /end OUT_MEASUREMENT
 /begin LOC_MEASUREMENT PEnv_flgCcLdcDiagCmpl PEnv_flgCcLdcInvld PEnv_flgCcLdcVld PEnv_flgInctRatCmpl PEnv_flgPRawVldDiag PEnv_pCurrDrvCyc PEnv_pDly PEnv_pRawFild /end LOC_MEASUREMENT
 FUNCTION_VERSION "2.11.0" /end FUNCTION
/begin FUNCTION EnvT_IfAdpr "1.12.0    Interface adapter of package Environment Temperature" /begin DEF_CHARACTERISTIC EnvT_IfAdprConf_CW TDGTUMTRIG TUMTAI /end DEF_CHARACTERISTIC /begin IN_MEASUREMENT EnvT_bActvSens EnvT_stTReplMod EnvT_t EnvT_tReplMod /end IN_MEASUREMENT
 /begin OUT_MEASUREMENT B_gtumg_msg B_trigcomp_msg B_tumgg_msg B_tummg_msg B_tumnpl_msg tumgk_w_msg tumg_msg tumm_msg tum_msg /end OUT_MEASUREMENT
 /begin LOC_MEASUREMENT B_tumgg_envtifloc /end LOC_MEASUREMENT
 FUNCTION_VERSION "1.12.0" /end FUNCTION
/begin FUNCTION EnvT_VD "7.12.0    Environment Temperature Virtual Device"
 /begin DEF_CHARACTERISTIC EnvT_stDfl_C EnvT_swtCfg_CW EnvT_swtStSensMod_CW EnvT_tCACDsCmuMax_C EnvT_tCACDsCmuMin_C EnvT_tiDelSensMeas_C EnvT_tIntkCac_C EnvT_tSigValMax_C EnvT_tVDDfl_C /end DEF_CHARACTERISTIC
 /begin IN_MEASUREMENT Eep_EnvRamHist Eep_EnvRamInvld EnvT_stTReplMod EnvT_tReplMod /end IN_MEASUREMENT
 /begin OUT_MEASUREMENT EnvT_bActvCSC EnvT_bActvDfl EnvT_bActvMBC EnvT_bActvPRC EnvT_bActvSens EnvT_bActvSensADC EnvT_bActvSensCAN EnvT_bActvSensMod EnvT_stSigT EnvT_t EnvT_tSensLstVal EnvT_tSigVal EnvT_t_Sq /end OUT_MEASUREMENT
 /begin LOC_MEASUREMENT EnvT_bTSensFrz EnvT_bTSensFrznVal EnvT_bTSensIntrLstVal EnvT_bTTiCmu EnvT_stTReplModIntr EnvT_stTSensIntr EnvT_stTSensModIntr EnvT_swtTSrcSel EnvT_tCACRepl EnvT_tReplModIntr EnvT_tSensFrz EnvT_tSensIntr EnvT_tSensIntrLstVal EnvT_tSensModIntr /end LOC_MEASUREMENT
 FUNCTION_VERSION "7.12.0" /end FUNCTION
/begin FUNCTION EnvT_VdMdl2 "1.2.0     Virtual Device Ambient Temperature Model Calculation for Oil deterioration system"
 /begin DEF_CHARACTERISTIC EnvT_tCEngDsTMax_C EnvT_tIntkAirCorrnMdl_C EnvT_tIntkSnsr_C EnvT_vVehMinMdl_C /end DEF_CHARACTERISTIC
 /begin IN_MEASUREMENT CEngDsT_t IntkAirT_tAirFltDs IntkAirT_tIntkMnfld IntkAirT_tThrVlvUs OilSwmpT_flgFinshd OilSwmpT_flgInit VehV_v /end IN_MEASUREMENT
 /begin OUT_MEASUREMENT EnvT_tMdl2 /end OUT_MEASUREMENT
 /begin LOC_MEASUREMENT EnvT_stEepReadMdl /end LOC_MEASUREMENT
 FUNCTION_VERSION "1.2.0" /end FUNCTION
/begin FUNCTION EnvT_VDMod "1.13.0    VirtualDevice Ambient Temperature Model Calculation"
 /begin DEF_CHARACTERISTIC EnvT_dmAFSMax_CUR EnvT_dmAFSMinMod_CUR EnvT_drLPPrimModMax_C EnvT_drLPPrimModMin_C EnvT_dtCEngDsIntkAirMax_C EnvT_dtCEngDsPrimModBas_C EnvT_mAirAcmMinThdOffs_C EnvT_mAirAcmThdMdlRels_T EnvT_mAirModMinHot_C EnvT_mAirModMin_C EnvT_maskAirFltDsSq_C EnvT_maskCEngDsTSq_C EnvT_maskIntkMnfldSq_C EnvT_stModDfl_C EnvT_tCEngDsHotDet_C EnvT_tCEngDsMaxIniPrimMod_C EnvT_tCEngDsMaxPrimMod_C EnvT_tCEngDsMinPrimMod_C EnvT_tCEngDsPrimModCS_C EnvT_tCEngDsWarmPrimMod_C EnvT_tDifTCEngDsStrtVal_C EnvT_tiEngOffPrimModCS_C EnvT_tiModHeatingIndcr_C EnvT_tiModStyCnd_C EnvT_tiModWrmCntrMin_C EnvT_tIntkAirMaxPrimMod_C EnvT_tIntkAirMinPrimMod_C EnvT_tIntkDfl_C EnvT_tiPrimModEngRotDeb_C EnvT_tiPrimModEngRotFall_C EnvT_tiPrimModIdleHotDet_C EnvT_tModHeatingIndcr_MAP EnvT_tPrimModBasHotDetHi_C EnvT_tPrimModBasHotDetLo_C EnvT_tPrimModDfl_C EnvT_tValMax_C EnvT_VDMod2_CW EnvT_VDMod3_CW EnvT_VDModSnsrSel_CW EnvT_VDMod_CW EnvT_vVehMinMod_C /end DEF_CHARACTERISTIC
 /begin IN_MEASUREMENT AirMod_mfAirCyl CEngDsT_flgSnsrVldStrt CEngDsT_t CEngDsT_tStrt CEngDsT_t_Sq CoVMD_flgIdleDrv drlp_w_msg Eep_EnvRamHist Eep_EnvRamInvld Epm_nEng IntkAirT_tAirFltDs IntkAirT_tAirFltDs_Sq IntkAirT_tIntkMnfld IntkAirT_tIntkMnfld_Sq PthSet_bOvrRun TiEngOff_bEngRot TiEngOff_stTi TiEngOff_ti VehV_v /end IN_MEASUREMENT
 /begin OUT_MEASUREMENT EnvT_bModCS EnvT_stTReplMod EnvT_tReplMod /end OUT_MEASUREMENT
 /begin LOC_MEASUREMENT EnvT_bModHotDet EnvT_bModPrms EnvT_bModRels EnvT_bModSty EnvT_bModStyCnd EnvT_bModWrm EnvT_bPrimModBas EnvT_bPrimModBasMin EnvT_mAirAcmThdCrvVal EnvT_mAirAcmThdMdlRels EnvT_mAirAcmThdOldVal EnvT_mAirAcmThdVal EnvT_mAirMod EnvT_mAirModInt EnvT_mfAirCylStyMod EnvT_nEngStyMod EnvT_stTPrimMod EnvT_stTReplModLoc EnvT_tDifTIntkTEnvMdl EnvT_tiModWrmCntr EnvT_tModCS EnvT_tModHeatgIndcr EnvT_tModHeatgIndcrFlt EnvT_tModHeatingIndcr EnvT_tPrimMod EnvT_tPrimModBas EnvT_tPrimModBasMin EnvT_tReplModLoc EnvT_tStyMod EnvT_vVehStyMod /end LOC_MEASUREMENT
 FUNCTION_VERSION "1.13.0" /end FUNCTION
/begin FUNCTION EPBECU_EPB "4.5.0     Signal processing for frames from EPB ECU"
 /begin DEF_CHARACTERISTIC Com_ctCRingEPB_C Com_dEPBMaxDiff_C Com_dEPBMaxPer_C Com_numCsumEPB_C /end DEF_CHARACTERISTIC
 /begin IN_MEASUREMENT Com_ctCRingEPB Com_numCsumEPB Com_rClthStk Com_stClthPedlFailDet Com_stClthStkFailInfo Com_stFrmRxEna Com_stMon Com_uCPS1VoltEPB Com_uCPS2VoltEPB SyC_ctPostDrvLeave T15_st /end IN_MEASUREMENT
 /begin OUT_MEASUREMENT Com_stRxEPB /end OUT_MEASUREMENT
 /begin LOC_MEASUREMENT Com_ctReIni10msEPB /end LOC_MEASUREMENT
 FUNCTION_VERSION "4.5.0" /end FUNCTION
/begin FUNCTION EpmBCa_TstInj "1.32.0_1.0.1Backup Camshaft"
 /begin DEF_CHARACTERISTIC EpmBCa_facSegTimeAcc_CUR EpmBCa_facSegTimeConstHigh_C EpmBCa_facSegTimeConstLow_C EpmBCa_nTstInjMax_C EpmBCa_numInjSer_C EpmBCa_numTstInjMax_C EpmBCa_phiSegEndOld_C EpmBCa_phiSegLen_C /end DEF_CHARACTERISTIC
 /begin IN_MEASUREMENT EpmSyn_phiInt Epm_ctCyl Epm_nEng Epm_numCyl Epm_phiCyl Epm_phiDiffTDC /end IN_MEASUREMENT
 /begin OUT_MEASUREMENT EpmBCa_stInjMask /end OUT_MEASUREMENT
 /begin LOC_MEASUREMENT EpmBCa_ctInjSer EpmBCa_ctTstInj EpmBCa_CurrCyl EpmBCa_facTimes_mp EpmBCa_phiSegDst EpmBCa_stTstInj EpmBCa_stTstInjRslt_mp EpmBCa_tiSegOld_mp EpmBCa_tiSeg_mp /end LOC_MEASUREMENT
 FUNCTION_VERSION "1.32.0_1.0.1" /end FUNCTION
/begin FUNCTION EpmBCr_IntrCo "101.9.7   Backup crankshaft interrupt coordination" /begin DEF_CHARACTERISTIC EpmBCr_swtEnable_C EpmBCr_tEna_C /end DEF_CHARACTERISTIC /begin REF_CHARACTERISTIC EpmCrS_dnEngMax_C EpmCrS_nDiagOff_C /end REF_CHARACTERISTIC
 /begin IN_MEASUREMENT DSM_TripChgFinshd EpmCaS_nEng EpmCaS_stNEng EpmCrS_stDiagErrSig EpmCrS_stDiagNoSig EpmCrS_stErrSigDiagStop EpmCrS_stNoSigDiagStop EpmIf_tCoolant Epm_dnEngFlt Epm_nEng Epm_stOpMode SyC_stSub T15_st /end IN_MEASUREMENT
 /begin OUT_MEASUREMENT EpmBCr_flgStrtDirectAllwd /end OUT_MEASUREMENT
 /begin LOC_MEASUREMENT EpmBCr_stDSMRdy /end LOC_MEASUREMENT
 FUNCTION_VERSION "101.9.7" /end FUNCTION
/begin FUNCTION EpmBCr_Plaus "101.6.4   Backup Crankshaft: Plausibilisation of camshaft signal pattern"
 /begin DEF_CHARACTERISTIC EpmBCr_nEngPttFailTol_C EpmBCr_nrPttMtchFailMaxEve_C EpmBCr_rSegLimLowr_C EpmBCr_rSegLimUppr_C EpmBCr_swtUpdEdge_C /end DEF_CHARACTERISTIC
 /begin IN_MEASUREMENT EpmBCr_phiZero2Sync EpmCaS_numPriCamShft EpmCaS_numSegSerLst EpmCaS_phiRefPos EpmCaS_stAdap Epm_nEng /end IN_MEASUREMENT
 /begin OUT_MEASUREMENT EpmBCr_phiSeg2Seg EpmBCr_tiSeg /end OUT_MEASUREMENT
 /begin LOC_MEASUREMENT EpmBCr_ctCaSRev EpmBCr_ctEdge EpmBCr_ctPttMtchFail EpmBCr_ctPttMtchFailEdge EpmBCr_idxPttSync EpmBCr_lvlCaSCurr_mp EpmBCr_nrEdg2NxtSync_mp EpmBCr_nrPttMtchAtIndx_mp EpmBCr_numCtgryPttCur_mp EpmBCr_numCtgryPtt_mp EpmBCr_numEdg2NxtEquiEdge_mp EpmBcr_numEdgEqui EpmBcr_numPttPlaus EpmBcr_numSeg2Sync EpmBCr_numSegPtt EpmBcr_numSyncMark EpmBCr_phiCaSPos EpmBCr_phiPtt_mp EpmBCr_rSeg2SegCurr_mp EpmBCr_rSeg2Seg_mpA EpmBCr_stDetailed_mp EpmBCr_stIniPttFail EpmBCr_stPlaus EpmBCr_stPttCurrIsSync_mp EpmBCr_stPttSync_mp EpmBCr_swtUpdEdge_mp EpmBCr_tiCaSEdg_mp EpmBCr_tiCaSSegDur_mp /end LOC_MEASUREMENT
 FUNCTION_VERSION "101.6.4" /end FUNCTION
/begin FUNCTION EpmBCr_Pos "101.9.4   Backup Crankshaft: Engine Position" /begin DEF_CHARACTERISTIC EpmBCr_facEngSpdRange_CUR /end DEF_CHARACTERISTIC
 /begin IN_MEASUREMENT EpmBCr_phiSeg2Seg EpmBCr_tiSeg EpmCaS_numPriCamShft EpmCaS_numSegSerLst EpmCaS_phiRefPos EpmCaS_stAdap EpmSeq_eveId EpmSeq_phiEve EpmSyn_phiOffs Epm_stOpMode /end IN_MEASUREMENT
 /begin OUT_MEASUREMENT EpmBCr_ctEdgeRefTabIdx EpmBCr_nEng EpmBCr_phiNxtCaSEdge EpmBCr_phiPos EpmBCr_phiZero2Sync EpmBCr_stPos EpmBCr_tiIncPer /end OUT_MEASUREMENT
 /begin LOC_MEASUREMENT EpmBCr_agCasEdge EpmBCr_agCurr EpmBCr_eveIdPriCamShft EpmBCr_facPlaus EpmBCr_phiCurrCaSEdge EpmBCr_phiLastCaSEdge EpmBCr_phiWaitNoSig EpmBCr_stOpModeOld /end LOC_MEASUREMENT
 FUNCTION_VERSION "101.9.4" /end FUNCTION
/begin FUNCTION EpmCaS_Adap "101.24.0_1.0.1adaption of the camchaft-edges"
 /begin DEF_CHARACTERISTIC EpmCaS_facAdapFil_C EpmCaS_nrMaxTryAdpn_C EpmCaS_numEdgeRefAdpn_C EpmCaS_phiAdpClb_CA EpmCaS_phiDiffAdapMax_C EpmCaS_phiDiffLim_C EpmCaS_phiDiffRefAdapMax_C EpmCaS_phiMntMax_C EpmCaS_refAdapFac_C EpmCaS_swtAdap_C EpmCaS_swtAdpClb_C EpmCaS_swtForceRefAdap_C /end DEF_CHARACTERISTIC
 /begin IN_MEASUREMENT DSM_TripChgFinshd Eep_EnvRamInvld EpmCaS_numSegSerLst EpmCaS_phiRefPos EpmCaS_phiTempCorEng EpmCaS_stSnsrDeActvn EpmSyn_ctEdgeWcyOfs GEVCtl_flgReqRefAdpn GEVCtl_flgReqRefAdpnIntk SyC_ctPostDrvLeave SyC_stSub /end IN_MEASUREMENT
 /begin OUT_MEASUREMENT EpmCaS_agCorrnStat EpmCaS_phiAdapRefPos EpmCaS_phiAdapRefPosI1 EpmCaS_phiCaSOfs EpmCaS_phiDiffAvrg EpmCaS_phiDiffAvrgLim EpmCaS_phiDiffCal2AdapEqAvg EpmCaS_stAdap EpmCaS_stAdapErr EpmCaS_stRefAdap /end OUT_MEASUREMENT
 /begin LOC_MEASUREMENT EpmCaS_cntrAdapPostDrvLveOld EpmCaS_ctTriesAdap EpmCaS_flgCaSAdapflgClr EpmCaS_flgCaSRefAdapOld EpmCaS_flgEEPReadSuc EpmCaS_flgInhbnAdpnNoRefAdpnAvl EpmCaS_flgRefAdapExternReq EpmCaS_flgResetAfterErr EpmCaS_numEdgeRefAdpn EpmCaS_phiDiffCal2Adap EpmCaS_phiDiffSum EpmCaS_phiEdgeAvrg EpmCaS_phiFirstAdapRefPos EpmCaS_phiSegAdapRefPos EpmCaS_stDSMRdyAdap EpmCaS_stRstAdap EpmCaS_swtForceRefAdapOld /end LOC_MEASUREMENT
 FUNCTION_VERSION "101.24.0_1.0.1" /end FUNCTION
/begin FUNCTION EpmCaS_Diag "101.10.0  Diagnosis Camshaft Signal"
 /begin DEF_CHARACTERISTIC EpmCaS_flgSwtSnglEdgeTol_C EpmCaS_numErrSigDef_C EpmCaS_numErrSigOk_C EpmCaS_numNoSigDef_C EpmCaS_stDiagMode_C /end DEF_CHARACTERISTIC
 /begin IN_MEASUREMENT DSM_TripChgFinshd EpmCaS_numSegSerLst EpmCaS_stSnsrDeActvn EpmCrS_stSigMode EpmRRS_bEngSwOff EpmSyn_stCaSPos Epm_stOpMode SyC_ctPostDrvLeave SyC_stSub /end IN_MEASUREMENT
 /begin OUT_MEASUREMENT EpmCaS_ctErrSig EpmCaS_ctNoSig EpmCaS_stDiag EpmCaS_stDiagErr /end OUT_MEASUREMENT
 /begin LOC_MEASUREMENT EpmCaS_bActivatePatmat EpmCaS_bCaSDiagflgClr EpmCaS_cntrDiagPostDrvLeave EpmCaS_cntrEdgeLstCyc EpmCaS_cntrNoSigLvl EpmCaS_ctEdgeLst EpmCaS_ctRevNoSig EpmCaS_ctRevSig EpmCaS_ctSigOk EpmCaS_flgSwtSnglEdgeTolInt EpmCaS_numCurrEdge EpmCaS_numErrSigDefInt EpmCaS_numErrSigOkInt EpmCaS_numNoSigDefInt EpmCaS_stCaSLvl EpmCaS_stDiagErrChgd EpmCaS_stDiagModeInt EpmCaS_stDiagStopCdn EpmCaS_stDSMRdyDiag EpmCaS_stRstDiag EpmCaS_stSegFault /end LOC_MEASUREMENT
 FUNCTION_VERSION "101.10.0" /end FUNCTION
/begin FUNCTION EpmCaS_Meas "101.5.4   Epm Camshaft Measurement" /begin DEF_CHARACTERISTIC EpmCaS_swtMeasCaS_C /end DEF_CHARACTERISTIC /begin IN_MEASUREMENT EpmCaS_numSegSerLst EpmCrS_stSigMode Epm_stOpMode /end IN_MEASUREMENT
 /begin LOC_MEASUREMENT EpmCaS_ctMeasEdgeLstI1 EpmCaS_numRawValueI1 EpmCaS_phiRawValueI1_mp EpmCaS_stMeasCllsn EpmCaS_stMeasUnLckd /end LOC_MEASUREMENT
 FUNCTION_VERSION "101.5.4" /end FUNCTION
/begin FUNCTION EpmCaS_OfsDiag "101.12.1  offset diagnosis"
 /begin DEF_CHARACTERISTIC EpmCaS_numOfsErr_C EpmCaS_phiMntErrMax_C EpmCaS_phiMntErrMin_C EpmCaS_phiOfsMax_C EpmCaS_phiOfsMin_C EpmCas_stDirOfsAvrgUnflt_C EpmCaS_stOfsDiagMode_C EpmCaS_tiOfsPT1_C /end DEF_CHARACTERISTIC
 /begin REF_CHARACTERISTIC EpmCaS_phiSegOfs_CA EpmSyn_dCaSSegMsk_C /end REF_CHARACTERISTIC
 /begin IN_MEASUREMENT AirSys_bCaSEdgAdapIntk DSM_TripChgFinshd EpmCaS_ctErrSig EpmCaS_ctNoSig EpmCaS_numSegSerLst EpmCaS_phiDiffAvrgLim EpmCaS_phiTempCorEng EpmCaS_stSnsrDeActvn EpmRRS_bEngSwOff Epm_stOpMode Epm_stSupressIni SyC_ctPostDrvLeave SyC_stSub /end IN_MEASUREMENT
 /begin OUT_MEASUREMENT EpmCaS_cntrOfsEdgeLst EpmCaS_phiCaSOfsAvg EpmCaS_phiMntErrMax EpmCaS_phiMntErrMin EpmCaS_phiOfsAvrgUnflt EpmCaS_phiOfsCorr EpmCaS_stOfs EpmCaS_stOfsAvrgUnflt EpmCaS_stOfsErr /end OUT_MEASUREMENT
 /begin LOC_MEASUREMENT EpmCaS_bOfsErrflgClr EpmCaS_ctOfsCrSRev EpmCaS_ctOfsErr EpmCaS_numEquidEdg EpmCaS_numLosEquidEdg_mp EpmCaS_numMplPatEquidEdg_mp EpmCaS_numVldEquidEdg_mp EpmCaS_OfsAvrgBuf EpmCaS_phiDstEquidEdg EpmCaS_phiLosEquidEdg_mp EpmCaS_phiOfsTolc EpmCaS_phiRefPosEquiEdg EpmCaS_phiSegLenTolc EpmCaS_stDSMRdyOfsDiag EpmCaS_stOffsCalcn EpmCaS_stRefLevBefEquidEdg EpmCaS_stRstOfsDiag /end LOC_MEASUREMENT
 FUNCTION_VERSION "101.12.1" /end FUNCTION
/begin FUNCTION EpmCaS_Seg "101.14.0  Calculation of CaS segment time and angle diffrence to reference position"
 /begin DEF_CHARACTERISTIC EpmCaS_dSegSeries_CA EpmCaS_facPlausHigh_GCUR EpmCaS_facPlausLow_GCUR EpmCaS_facPlaus_DST EpmCaS_nMaxCaSSigInvld_C EpmCaS_nMaxCaSSigVld_C EpmCaS_nMinCaSSigInvld_C EpmCaS_nMinCaSSigVld_C EpmCaS_numEdgeFltAvrg_CA EpmCaS_numPriCamSel_C EpmCaS_numSegSerLst_C EpmCaS_phiEdgeDvtMax_CA EpmCaS_phiLoLimIn_C EpmCaS_phiNCorI1_CUR EpmCaS_phiSegLenTol_CA EpmCaS_phiSegLen_CA EpmCaS_phiSegOfs_CA EpmCaS_phiTempCor05_DST EpmCaS_phiTempCorEngI1_CUR EpmCaS_phiTempCorI1_GCUR EpmCaS_phiUpLimIn_C EpmCaS_stActEdge_C EpmCaS_stMinSyncCaSAg_C EpmCaS_swtSegTSel_C EpmCaS_swtSeg_C EpmCaS_tiGlitchFilter_C EpmCaS_tiTimeout_C EpmCaS_tRefCal_C /end DEF_CHARACTERISTIC
 /begin IN_MEASUREMENT DSM_TripChgFinshd EpmCaS_phiCaSOfs EpmCaS_stAdap EpmCrS_stSigMode EpmIf_tCoolant EpmIf_tOil EpmSyn_stCaSPos Epm_nEng Epm_stSupressIni Epm_stSync SyC_ctPostDrvLeave SyC_stSub /end IN_MEASUREMENT
 /begin OUT_MEASUREMENT EpmCaS_allCaSEdges EpmCaS_bCaSEdgeTout EpmCaS_CASI1ctEdge10msU8 EpmCaS_ctCaSEdgeLast EpmCaS_ctEdgeEquid EpmCaS_nEng EpmCaS_numPriCamShft EpmCaS_numSegSerLst EpmCaS_numValidTime EpmCaS_phiCor EpmCaS_phiDiffLim EpmCaS_phiDiffLimSecLst EpmCaS_phiEdge EpmCaS_phiRefPos EpmCaS_phiTempCor EpmCaS_phiTempCorEng EpmCaS_stNEng EpmCaS_stphiDiffLim EpmCaS_stphiDiffLimSecLst EpmCaS_stSnsrDeActvn EpmCaS_tiEdge /end OUT_MEASUREMENT
 /begin LOC_MEASUREMENT EpmCaS_nCaS_mp EpmCaS_phiEdgeDvt_mp EpmCaS_stAgPhaShiftFltActv_mp EpmCaS_stAgPhaShiftSecToLst_mp EpmCaS_stAgPhaShift_mp EpmCaS_stDSMRdySeg EpmCaS_stPhaAdpn_mp EpmCaS_stPhaRefAdpn_mp EpmCaS_stPosValid EpmCaS_stRstSeg EpmCaS_tAgSnsrCorr EpmCaS_tiDifAgPhaLstEdge_mp EpmCaS_tiDifAgPhaLstTwoEdges_mp EpmCaS_tiNEngRstTimer /end LOC_MEASUREMENT
 FUNCTION_VERSION "101.14.0" /end FUNCTION
/begin FUNCTION EpmCrS_Diag "103.33.0_1.1.0Diagnosis of crankhaft signal"
 /begin DEF_CHARACTERISTIC EpmCrS_dnEngMax_C EpmCrS_nDiagOff_C EpmCrS_nDiagOn_C EpmCrS_nMaxDGIPlaus_C EpmCrS_numErrSigIncDef_C EpmCrS_numErrSigIncOK_C EpmCrS_numErrSigMaxDef_C EpmCrS_numErrSigMinOK_C EpmCrS_numNoSigDef_C EpmCrS_numPosDGIInc_C EpmCrS_numPosDGIMax_C EpmCrS_numRRNotPlausInc_C EpmCrS_numRRNotPlausMax_C EpmCrS_phiDiffDGI_C EpmCrS_stDiagT50Reset_C EpmCrS_swtEnableDiag_C EpmCrS_swtRstDGIRRNotPlaus_C EpmCrS_swtRstDiag_C EpmCrS_VehV_v_Max_C EpmCrS_VehV_v_Min_C /end DEF_CHARACTERISTIC
 /begin REF_CHARACTERISTIC EpmBCr_swtEnable_C /end REF_CHARACTERISTIC
 /begin IN_MEASUREMENT CoEng_stMai EpmCaS_nEng EpmCaS_numPriCamShft EpmCaS_numSegSerLst EpmCaS_stNEng EpmCrS_stSigMode EpmHCrS_cntrEdge EpmHCrS_cntrErr EpmHCrS_ctIncRvs EpmHCrS_stSigErr Epm_dnEngFlt Epm_nEng10ms Epm_nEngTooth10ms Epm_stOpMode Epm_stSupressIni Strt_stStaActv SyC_ctPostDrvLeave T15_st VehV_v /end IN_MEASUREMENT
 /begin OUT_MEASUREMENT EpmCrS_ctCaSRev EpmCrS_ctErrSig EpmCrS_stDiag EpmCrS_stDiagErrSig EpmCrS_stDiagNoSig EpmCrS_stDiagPosDGI EpmCrS_stDiagPulseDGI EpmCrS_stErrSigDiagStop EpmCrS_stNoSigDiagStop EpmCrS_stSigDiagSrc /end OUT_MEASUREMENT
 /begin LOC_MEASUREMENT EpmCrS_bCrSDiagflgClr EpmCrS_bDisturb EpmCrS_bEnableCrSCaS EpmCrS_bEnableDisturb EpmCrS_bEnablePosDGI EpmCrS_bEnableRRDGI EpmCrS_bRRNPlErr EpmCrS_ctCaSEdgeStart EpmCrS_ctPosDGI EpmCrS_ctRev EpmCrS_ctRev20msLim_mp EpmCrS_ctRevWaitDiag EpmCrS_ctRevWaitDiagSyncIni EpmCrS_ctRRNotPlaus EpmCrS_ctSumRRNotPlaus EpmCrS_dnEngFltSyncIni EpmCrS_nRRNotPlaus EpmCrS_stChgDGI EpmCrS_stDGIDiagStop EpmCrS_stDiagDGI EpmCrS_stDiagRRDGI EpmCrS_stRstDiag EpmCrS_swtRstDGI EpmCrS_swtRstErrSig EpmCrS_swtRstNoSig EpmCrS_swtRstRRNotPlaus /end LOC_MEASUREMENT
 FUNCTION_VERSION "103.33.0_1.1.0" /end FUNCTION
/begin FUNCTION EpmCrS_Plaus "101.11.1  dynamic plausibility of crankshaft-signal"
 /begin DEF_CHARACTERISTIC EpmCrS_facGapCrit1_C EpmCrS_facGapCrit2_C EpmCrS_facGapPlausHigh_CA EpmCrS_facIncPlausHigh_CA EpmCrS_facIncPlausLow_CA EpmCrS_facIncPlsFwdTolc_C EpmCrS_facIncPlsRevTolc_C EpmCrS_nMaxInc_C EpmCrS_nThreshRange_CA EpmCrS_nTiIncPerAvrg_CA EpmCrS_numAgClkDeltaCrsvMax_C EpmCrS_numIgnInc_C EpmCrS_numIncTiAvrgPlaus_C EpmCrS_numTiIncPerAvrg_CA EpmCrS_phiAgClkDeltaMax_C EpmCrS_stClrCntReSyncAgClkDeltaTot_C EpmCrS_swtSnsrTyp_C EpmCrS_tiGlitchFilterActv_CA EpmCrS_tiGlitchFilterInActv_CA EpmCrS_tiIgnSig_C EpmCrS_tiPlsFwd_C EpmCrS_tiPlsRvs_C /end DEF_CHARACTERISTIC
 /begin IN_MEASUREMENT BattU_u EpmCrS_phiAgClk EpmCrS_phiInc EpmCrS_stRotDir EpmCrS_stSigMode EpmHCrS_ctIncPos EpmHCrS_stSigMode Epm_nEng Epm_stOpMode /end IN_MEASUREMENT
 /begin OUT_MEASUREMENT EpmCrS_numTiIncPerAvrg EpmCrS_phiIgnInc EpmCrS_stHiEngSpd EpmCrS_swtSnsrTyp EpmCrS_tiIncPer /end OUT_MEASUREMENT
 /begin LOC_MEASUREMENT EpmCrS_ctAgClkDeltaCrsv_mp EpmCrS_ctRange EpmCrS_ctReSyncAgClkDeltaTot EpmCrS_ctReSyncAgClkDeltaTot_mp EpmCrS_ctReSyncAgClkDelta_mp EpmCrS_numTiIncPerAvrg_mp EpmCrS_phiAgClkDelta_mp EpmCrS_stEnaAgClkPlausChk /end LOC_MEASUREMENT
 FUNCTION_VERSION "101.11.1" /end FUNCTION
/begin FUNCTION EpmCrS_RevCnt "101.4.3   calculation of the crankshaft-revolutioncounter"
 /begin IN_MEASUREMENT CoEng_stMai EpmCrS_numSeg EpmCrS_stSigMode EpmSeq_numInt Epm_nEng Epm_stOpMode Epm_stSync /end IN_MEASUREMENT
 /begin OUT_MEASUREMENT EpmCrS_ctRevIni EpmCrS_ctRevStrt EpmCrS_ctRevStrtExtd /end OUT_MEASUREMENT
 /begin LOC_MEASUREMENT EpmCrS_ctRevCnt /end LOC_MEASUREMENT
 FUNCTION_VERSION "101.4.3" /end FUNCTION
/begin FUNCTION EpmCrS_Seg "101.17.0  calculation of crankshaft-segmenttimes" /begin DEF_CHARACTERISTIC EpmCrS_stTTMeasure_C EpmCrS_swtMeasActvnS1_C /end DEF_CHARACTERISTIC /begin REF_CHARACTERISTIC EpmSeq_phiInt_CA EpmSeq_swtInt_C /end REF_CHARACTERISTIC
 /begin IN_MEASUREMENT EpmHCrS_ctGapRef EpmHCrS_numIncGap_Var EpmHCrS_stRotDir EpmHCrS_stSigMode EpmHCrS_tiPerTn EpmHCrS_tiPerTn_1 EpmSeq_eveId EpmSeq_numInt EpmSeq_tiEve EpmSyn_phiInt Epm_ctCyl Epm_numCyl Epm_stOpMode Epm_stSupressIni /end IN_MEASUREMENT
 /begin OUT_MEASUREMENT EpmCrS_ctInc EpmCrS_numIncPerSeg EpmCrS_numSeg EpmCrS_phiAgClk EpmCrS_phiInc EpmCrS_phiIntSeg EpmCrS_phiSeg EpmCrS_phiSegHiRes EpmCrS_stRotDir EpmCrS_stSigMode EpmCrS_tiDgiPlsFwdAvrg EpmCrS_tiDgiPlsFwdMax EpmCrS_tiDgiPlsFwdMin EpmCrS_tiDgiPlsRvsAvrg EpmCrS_tiDgiPlsRvsMax EpmCrS_tiDgiPlsRvsMin EpmCrS_tiSeg EpmCrS_tiSegCurr EpmCrS_tiSegHiRes /end OUT_MEASUREMENT
 /begin LOC_MEASUREMENT EpmCrS_idxBuf_mp EpmCrS_numNewInc_mp EpmCrS_tiInc_mp /end LOC_MEASUREMENT
 FUNCTION_VERSION "101.17.0" /end FUNCTION
/begin FUNCTION EpmErr_Trace "101.3.1   Error Tracing"
 /begin LOC_MEASUREMENT EpmErr_ctErrInfoAryFree EpmErr_TraceCoreId EpmErr_TraceErrClass EpmErr_TraceErrId EpmErr_TraceErrInfo1 EpmErr_TraceErrInfo2 EpmErr_TraceErrInfo3 EpmErr_TraceErrInfo4 EpmErr_TraceErrorReaction EpmErr_TraceModId EpmErr_TraceStatus EpmErr_TraceTimeStamp Epm_Reset_RSTDetected_u32 /end LOC_MEASUREMENT
 FUNCTION_VERSION "101.3.1" /end FUNCTION
/begin FUNCTION EpmHAgClk_Gen "101.25.0  Controls the Digital Phase Locked Loop (DPLL) and generates the Angle Clock for the System" /begin DEF_CHARACTERISTIC EpmHAgClk_numAddTick_CA /end DEF_CHARACTERISTIC
 /begin IN_MEASUREMENT EpmCaS_numPriCamShft EpmHCrS_agActvEdge EpmHCrS_ctIncStrt EpmHCrS_ctRealGapPos EpmHCrS_numGapWcy EpmHCrS_numGap_Var EpmHCrS_numIncGapMiss EpmHCrS_numIncGap_Var EpmHCrS_numIncReal EpmHCrS_numIncRealWcy EpmHCrS_numInc_Var EpmHCrS_stActEdge EpmHCrS_stGapSubState EpmHCrS_stOneAftGap EpmHCrS_stRotDir EpmHCrS_tiActv2ActvEdge Epm_SensTypCrS /end IN_MEASUREMENT
 /begin OUT_MEASUREMENT EpmHAgClk_numAgTicksPerInc EpmHAgClk_tiIncPerBas EpmHAgClk_tiMinPer /end OUT_MEASUREMENT
 /begin LOC_MEASUREMENT EpmHAgClk_AddTick EpmHAgClk_Gen_AgCntRaw_mp EpmHAgClk_Gen_AgCnt_mp EpmHAgClk_numAgClkFrq EpmHAgClk_numAgClkMode EpmHAgClk_numAgClkState EpmHAgClk_numMissTick EpmHAgClk_stAPTSyn /end LOC_MEASUREMENT
 FUNCTION_VERSION "101.25.0" /end FUNCTION
/begin FUNCTION EpmHAgClk_TrigEve "101.2.3   Handles the Triggering of Events for the system based on the Angle clock" /begin LOC_MEASUREMENT EpmHAgClk_agPosnTrigEve /end LOC_MEASUREMENT FUNCTION_VERSION "101.2.3" /end FUNCTION
/begin COMPU_METHOD AirMassKg "" RAT_FUNC "%6.4" "Kg" COEFFS 0 100 0 0 0 1 /end COMPU_METHOD
/begin COMPU_METHOD AirMassPerTime "" RAT_FUNC "%6.3" "Kg/h" COEFFS 0 10 0 0 0 1 /end COMPU_METHOD
/begin COMPU_METHOD AngleCrS "" RAT_FUNC "%6.4" "deg CrS" COEFFS 0 45.5111111111 0 0 0 1 /end COMPU_METHOD
/begin COMPU_METHOD B_TRUE "" TAB_VERB "%6.3" "" COMPU_TAB_REF B_TRUE /end COMPU_METHOD
/begin COMPU_VTAB B_TRUE "" TAB_VERB 2 0 "FALSE" 1 "TRUE" /end COMPU_VTAB
/begin COMPU_METHOD CrSRev2CrSInc "" RAT_FUNC "%6.4" "-" COEFFS 0 60 0 0 0 1 /end COMPU_METHOD
/begin COMPU_METHOD dez "" RAT_FUNC "%6.2" "" COEFFS 0 1 0 0 0 1 /end COMPU_METHOD
/begin COMPU_METHOD dfp_verbal "" TAB_VERB "%6.3" "-" COMPU_TAB_REF dfp_verbal /end COMPU_METHOD
/begin COMPU_VTAB dfp_verbal "" TAB_VERB 83 0 "DFP_AAA" 1 "DFP_AAV" 2 "DFP_AAVE" 3 "DFP_AGRE" 4 "DFP_AGRS" 5 "DFP_DHFHD" 6 "DFP_DK" 7 "DFP_DK1P" 8 "DFP_DK2P" 9 "DFP_DKVS" 10 "DFP_DSKV" 11 "DFP_DSKVR" 12 "DFP_DSKVS" 13 "DFP_DSS" 14 "DFP_DSU" 15 "DFP_DVEE" 16 "DFP_DVEF" 17 "DFP_DVEFO" 18 "DFP_DVEL" 19 "DFP_DVEN" 20 "DFP_DVER" 21 "DFP_DVEU" 22 "DFP_DVEUB" 23 "DFP_DVEUW" 24 "DFP_DYLSU" 25 "DFP_ENWCS" 26 "DFP_ENWS" 27 "DFP_ENWSE" 28 "DFP_EONV" 29 "DFP_FP1P" 30 "DFP_FP2P" 31 "DFP_FRA" 32 "DFP_FST" 33 "DFP_FSTE" 34 "DFP_FSTR" 35 "DFP_FTDLA" 36 "DFP_HDR" 37 "DFP_HDRKH" 38 "DFP_HDRPL" 39 "DFP_HFM" 40 "DFP_HSH" 41 "DFP_HSHE" 42 "DFP_KAT" 43 "DFP_KPE" 44 "DFP_KS1" 45 "DFP_LLRH" 46 "DFP_LLRKH" 47 "DFP_LM" 48 "DFP_LSH" 49 "DFP_LZSR" 50 "DFP_MD" 51 "DFP_NWS" 52 "DFP_NWSE" 53 "DFP_ORA" 54 "DFP_PLLSU" 55 "DFP_PSR" 56 "DFP_PSR1" 57 "DFP_PSRB" 58 "DFP_PSRE" 59 "DFP_PSRP" 60 "DFP_PU" 61 "DFP_PUE" 62 "DFP_PUPL" 63 "DFP_PUR" 64 "DFP_STHDR" 65 "DFP_TA" 66 "DFP_TANKL" 67 "DFP_TANLCS" 68 "DFP_TANLPRC" 69 "DFP_TANLR" 70 "DFP_TASRCS" 71 "DFP_TASRE" 72 "DFP_TASRPRC" 73 "DFP_TASRR" 74 "DFP_TESF" 75 "DFP_TESG" 76 "DFP_TM" 77 "DFP_TMCS" 78 "DFP_TME" 79 "DFP_TMP" 80 "DFP_UB" 81 "DFP_VFZ" 82 "DFP_ZZZ" DEFAULT_VALUE "---" /end COMPU_VTAB
/begin COMPU_METHOD EngN "" RAT_FUNC "%6.3" "rpm" COEFFS 0 2 0 0 0 1 /end COMPU_METHOD
/begin COMPU_METHOD EngN2tiIncPer "" RAT_FUNC "%8.0" "rpm" COEFFS 0 0 1 0 4.0000002e-007 0 /end COMPU_METHOD
/begin COMPU_METHOD EngNCaS "" RAT_FUNC "%6.3" "CaSrpm" COEFFS 0 4 0 0 0 1 /end COMPU_METHOD
/begin COMPU_METHOD EngNGrd "" RAT_FUNC "%6.3" "rpm/s" COEFFS 0 2 0 0 0 1 /end COMPU_METHOD
/begin COMPU_METHOD EngN_LRes "" RAT_FUNC "%6.1" "rpm" COEFFS 0 0.025 0 0 0 1 /end COMPU_METHOD
/begin COMPU_METHOD EpmBCa_FacTstInj "" RAT_FUNC "%6.5" "-" COEFFS 0 1000 0 0 0 1 /end COMPU_METHOD
/begin COMPU_METHOD EpmBCa_stTstInj_State_t "" TAB_VERB "%6.3" "" COMPU_TAB_REF EpmBCa_stTstInj_State_t /end COMPU_METHOD
/begin COMPU_VTAB EpmBCa_stTstInj_State_t "" TAB_VERB 6 0 "EPMBCA_STVOID" 1 "EPMBCA_STINJ" 2 "EPMBCA_STWAITCALC" 3 "EPMBCA_STCALC" 4 "EPMBCA_STNOSYNC" 5 "EPMBCA_STSYNC" /end COMPU_VTAB
/begin COMPU_METHOD EPMBCR_FACRATIO "" RAT_FUNC "%6.5" "" COEFFS 0 1000 0 0 0 1 /end COMPU_METHOD
/begin COMPU_METHOD EpmBCr_Plaus_StatusDetails_CM "" TAB_VERB "%6.3" "" COMPU_TAB_REF EpmBCr_Plaus_StatusDetails_CM /end COMPU_METHOD
/begin COMPU_VTAB EpmBCr_Plaus_StatusDetails_CM "" TAB_VERB 9 0 "INIT" 1 "PTTSEARCHDONE" 2 "BUFREADFAIL" 3 "SYNCREACHED" 4 "SYNCFAILNOPTTMATCH" 5 "SYNCLOSTPTTDIDNOTMATCH" 6 "SYNCKEPTONEQUIEDGE" 7 "SYNCKEPTONSEGEDGE" 8 "SYNCLOSSTOLERATE" /end COMPU_VTAB
/begin COMPU_METHOD EpmBCr_stPlaus_State "" TAB_VERB "%6.3" "" COMPU_TAB_REF EpmBCr_stPlaus_State /end COMPU_METHOD
/begin COMPU_VTAB EpmBCr_stPlaus_State "" TAB_VERB 3 0 "EPMBCR_NOSYNC" 1 "EPMBCR_SYNC" 2 "EPMBCR_SYNCTOL" /end COMPU_VTAB
/begin COMPU_METHOD EpmBCr_stPos_State "" TAB_VERB "%6.3" "" COMPU_TAB_REF EpmBCr_stPos_State /end COMPU_METHOD
/begin COMPU_VTAB EpmBCr_stPos_State "" TAB_VERB 2 0 "EPMBCR_STPOS_NOPOS" 1 "EPMBCR_STPOS_POSFOUND" /end COMPU_VTAB
/begin COMPU_METHOD EpmBCr_swtUpdEdge_CM "" TAB_VERB "%6.3" "" COMPU_TAB_REF EpmBCr_swtUpdEdge_CM /end COMPU_METHOD
/begin COMPU_VTAB EpmBCr_swtUpdEdge_CM "" TAB_VERB 2 0 "UpdateEveryEdge" 1 "UpdateEquiEdge" /end COMPU_VTAB
/begin COMPU_METHOD EpmCaS_Fac_Adap "" RAT_FUNC "%6.5" "-" COEFFS 0 1000 0 0 0 1 /end COMPU_METHOD
/begin COMPU_METHOD EpmCaS_Fac_Plaus "" RAT_FUNC "%6.5" "-" COEFFS 0 1000 0 0 0 1 /end COMPU_METHOD
/begin COMPU_METHOD EpmCaS_stAdap_State "" TAB_VERB "%6.3" "" COMPU_TAB_REF EpmCaS_stAdap_State /end COMPU_METHOD
/begin COMPU_VTAB EpmCaS_stAdap_State "" TAB_VERB 5 0 "EPMCAS_STNOADAP" 1 "EPMCAS_STERRADAP" 2 "EPMCAS_STADAP" 3 "EPMCAS_STADAPSTOP" 4 "EPMCAS_STFULLADAP" /end COMPU_VTAB
/begin COMPU_METHOD EpmCaS_stAgPhaShift_t "" TAB_VERB "%6.3" "" COMPU_TAB_REF EpmCaS_stAgPhaShift_t /end COMPU_METHOD
/begin COMPU_VTAB EpmCaS_stAgPhaShift_t "" TAB_VERB 4 0 "EPMCAS_STAGINVALID" 1 "EPMCAS_STAGFROZEN" 2 "EPMCAS_STAGLIMITED" 3 "EPMCAS_STAGVALID" /end COMPU_VTAB
/begin COMPU_METHOD EpmCaS_stDiagErr_t "" TAB_VERB "%6.3" "" COMPU_TAB_REF EpmCaS_stDiagErr_t /end COMPU_METHOD
/begin COMPU_VTAB EpmCaS_stDiagErr_t "" TAB_VERB 4 0 "EPMCAS_DIAG_AMBI" 1 "EPMCAS_DIAG_OK" 2 "EPMCAS_DIAG_NOSIG" 3 "EPMCAS_DIAG_ERRSIG" /end COMPU_VTAB
/begin COMPU_METHOD EpmCaS_stDiag_t "" TAB_VERB "%6.3" "" COMPU_TAB_REF EpmCaS_stDiag_t /end COMPU_METHOD
/begin COMPU_VTAB EpmCaS_stDiag_t "" TAB_VERB 5 0 "EPMCAS_DIAG_OFF" 1 "EPMCAS_DIAG_PATMAT" 2 "EPMCAS_DIAG_CTEDGE" 3 "EPMCAS_DIAG_NO_SIG" 4 "EPMCAS_DIAG_STOP" /end COMPU_VTAB
/begin COMPU_METHOD EpmCaS_stOfsErr_Val "" TAB_VERB "%6.3" "" COMPU_TAB_REF EpmCaS_stOfsErr_Val /end COMPU_METHOD
/begin COMPU_VTAB EpmCaS_stOfsErr_Val "" TAB_VERB 6 0 "EPMCAS_OFS_AMBI" 1 "EPMCAS_OFS_NOEQUI_EDGE" 2 "EPMCAS_OFS_LOWEQUI_EDGE" 3 "EPMCAS_OFS_NOREFPOS" 4 "EPMCAS_OFS_EXCEED" 5 "EPMCAS_OFS_OK" /end COMPU_VTAB
/begin COMPU_METHOD EpmCas_stOfs_State "" TAB_VERB "%6.3" "" COMPU_TAB_REF EpmCas_stOfs_State /end COMPU_METHOD
/begin COMPU_VTAB EpmCas_stOfs_State "" TAB_VERB 2 0 "EPMCAS_OFS_WAITSEG" 1 "EPMCAS_OFS_SEGCALC" /end COMPU_VTAB
/begin COMPU_METHOD EpmCaS_stphiDiffLim_t "" TAB_VERB "%6.3" "" COMPU_TAB_REF EpmCaS_stphiDiffLim_t /end COMPU_METHOD
/begin COMPU_VTAB EpmCaS_stphiDiffLim_t "" TAB_VERB 8 0 "RET_OK" 1 "RET_SYNADP" 2 "RET_PERM" 3 "RET_PREP" 4 "RET_GETLST" 5 "RET_GETCUR" 6 "RET_NOVALIDEDGE" 8 "RET_MECHLIM" /end COMPU_VTAB
/begin COMPU_METHOD EpmCaS_stRefAdap_State "" TAB_VERB "%6.3" "" COMPU_TAB_REF EpmCaS_stRefAdap_State /end COMPU_METHOD
/begin COMPU_VTAB EpmCaS_stRefAdap_State "" TAB_VERB 5 0 "EPMCAS_NOREQREFADAP" 1 "EPMCAS_REQREFADAP" 2 "EPMCAS_REFADAPWRITE" 3 "EPMCAS_REFADAPSTOP" 4 "EPMCAS_REFADAPERR" /end COMPU_VTAB
/begin COMPU_METHOD EpmCrS_DiagResult_State "" TAB_VERB "%6.3" "" COMPU_TAB_REF EpmCrS_DiagResult_State /end COMPU_METHOD
/begin COMPU_VTAB EpmCrS_DiagResult_State "" TAB_VERB 5 0 "EPMCRS_DIAG_PENDING" 1 "EPMCRS_DIAG_DEBHEAL" 2 "EPMCRS_DIAG_HEAL" 3 "EPMCRS_DIAG_DEBSET" 4 "EPMCRS_DIAG_SET" /end COMPU_VTAB
/begin COMPU_METHOD EpmCrS_Diag_State "" TAB_VERB "%6.3" "" COMPU_TAB_REF EpmCrS_Diag_State /end COMPU_METHOD
/begin COMPU_VTAB EpmCrS_Diag_State "" TAB_VERB 4 0 "EPMCRS_DIAG_OFF" 1 "EPMCRS_DIAG_ON" 2 "EPMCRS_DIAG_FRZ" 3 "EPMCRS_DIAG_INIT" /end COMPU_VTAB
/begin COMPU_METHOD EpmCrS_swtSnsrTyp_State_t "" TAB_VERB "%6.3" "" COMPU_TAB_REF EpmCrS_swtSnsrTyp_State_t /end COMPU_METHOD
/begin COMPU_VTAB EpmCrS_swtSnsrTyp_State_t "" TAB_VERB 3 0 "DG_DGI_TYPEA" 1 "DG_DGI_TYPEB" 2 "DG_TYPEC" /end COMPU_VTAB
/begin COMPU_METHOD EpmErr_ErrClass_t "" TAB_VERB "%6.3" "" COMPU_TAB_REF EpmErr_ErrClass_t /end COMPU_METHOD
/begin COMPU_VTAB EpmErr_ErrClass_t "" TAB_VERB 5 0 "EPMERR_NO_ERR_E" 1 "EPMERR_RPRT_E" 2 "EPMERR_RESYNC_E" 3 "EPMERR_INTERR_E" 4 "EPMERR_RSTRT_E" /end COMPU_VTAB
/begin COMPU_METHOD EpmHAgClk_AgClkFrq_t "" TAB_VERB "%6.3" "" COMPU_TAB_REF EpmHAgClk_AgClkFrq_t /end COMPU_METHOD
/begin COMPU_VTAB EpmHAgClk_AgClkFrq_t "" TAB_VERB 4 0 "AGCLK_FRQ_NORMAL" 1 "AGCLK_FRQ_HIGH" 2 "AGCLK_FRQ_LOW" 3 "AGCLK_FRQ_ZERO" /end COMPU_VTAB
/begin COMPU_METHOD EpmHAgClk_AgClkMode_t "" TAB_VERB "%6.3" "" COMPU_TAB_REF EpmHAgClk_AgClkMode_t /end COMPU_METHOD
/begin COMPU_VTAB EpmHAgClk_AgClkMode_t "" TAB_VERB 4 0 "AUTOMATICEND_MODE" 1 "CONTINUOUS_MODE" 2 "MIXED_MODE" 3 "EMERGENCY_MODE" /end COMPU_VTAB
/begin COMPU_METHOD EpmHAgClk_AgClkState_t "" TAB_VERB "%6.3" "" COMPU_TAB_REF EpmHAgClk_AgClkState_t /end COMPU_METHOD
/begin COMPU_VTAB EpmHAgClk_AgClkState_t "" TAB_VERB 2 0 "AGCLK_STOPPED" 1 "AGCLK_RUNNING" /end COMPU_VTAB
/begin COMPU_METHOD EpmHCrS_stRotDir_t "" TAB_VERB "%6.3" "" COMPU_TAB_REF EpmHCrS_stRotDir_t /end COMPU_METHOD
/begin COMPU_VTAB EpmHCrS_stRotDir_t "" TAB_VERB 4 0 "EPMHCRS_ROT_AMB" 1 "EPMHCRS_ROT_FWD" 2 "EPMHCRS_ROT_RVS" 3 "EPMHCRS_ROT_STOP" /end COMPU_VTAB
/begin COMPU_METHOD EpmHCrS_stSigMode_State_t "" TAB_VERB "%6.3" "" COMPU_TAB_REF EpmHCrS_stSigMode_State_t /end COMPU_METHOD
/begin COMPU_VTAB EpmHCrS_stSigMode_State_t "" TAB_VERB 10 0 "EPMHCRS_HALT" 1 "EPMHCRS_WAITSIG" 2 "EPMHCRS_IGNTIME" 3 "EPMHCRS_DEBEDGE" 4 "EPMHCRS_WAITGAP" 5 "EPMHCRS_VERIFYGAP" 6 "EPMHCRS_AMBIGAP_E" 7 "EPMHCRS_KEEPDGISYNC" 8 "EPMHCRS_GAPFOUND" 9 "EPMHCRS_DISABLNEWSYNC" /end COMPU_VTAB
/begin COMPU_METHOD EpmIf_swtTSel_VERB "" TAB_VERB "%6.3" "" COMPU_TAB_REF EpmIf_swtTSel_VERB /end COMPU_METHOD
/begin COMPU_VTAB EpmIf_swtTSel_VERB "" TAB_VERB 2 0 "Engine temp" 1 "Oil temp" /end COMPU_VTAB
/begin COMPU_METHOD EPM_FAC_PLAUS "" RAT_FUNC "%6.4" "-" COEFFS 0 16 0 0 0 1 /end COMPU_METHOD
/begin COMPU_METHOD Epm_ModId_t "" TAB_VERB "%6.3" "" COMPU_TAB_REF Epm_ModId_t /end COMPU_METHOD
/begin COMPU_VTAB Epm_ModId_t "" TAB_VERB 81 0 "EMPTY_ID" 1 "EPM_INI_ID" 2 "EPM_OPMODE_ID" 3 "EPM_SPD_ID" 4 "ENGDA_NENGREV_ID" 5 "EPM_AXISPOINTS_ID" 6 "EPM_HE_ID" 7 "EPM_OUT_ID" 8 "EPM_SPDGRD_ID" 9 "EPM_SPDOUT_ID" 10 "EPM_SPDPLAUS_ID" 11 "EPM_SWADP_ID" 12 "EPM_TRACE_ID" 13 "ENGSPD_DD_ID" 14 "HT2KTTD_ID" 15 "EPMBCA_TSTINJ_ID" 16 "EPMBCR_DYN_ID" 17 "EPMBCR_INTRCO_ID" 18 "EPMBCR_PLAUS_ID" 19 "EPMBCR_POS_ID" 20 "EPMCAS_ADAP_ID" 21 "EPMCAS_DIAG_ID" 22 "EPMCAS_MEAS_ID" 23 "EPMCAS_MON_ID" 24 "EPMCAS_OFSDIAG_ID" 25 "EPMCAS_OUT_ID" 26 "EPMCAS_SEG_ID" 27 "EPMCRS_DIAG_ID" 28 "EPMCRS_DIAGSYNCLOST_ID" 29 "EPMCRS_DIAGSYNCINJLOST_ID" 30 "EPMCRS_MON_ID" 31 "EPMCRS_PLAUS_ID" 32 "EPMCRS_REVCNT_ID" 33 "EPMCRS_SEG_ID" 34 "EPM_CUSTADP_ID" 35 "EPMERR_TRACE_ID" 36 "EPMERT_SEG_ID" 37 "EPMRRS_AGDETECT_ID" 38 "EPMRRS_PREDICT_ID" 39 "EPMRRS_STALLDETECT_ID" 40 "EPMRRS_STOPDETECT_ID" 41 "EPMSEQ_EVEHNDLR_ID" 42 "EPMSEQ_STATEMN_ID" 43 "EPMSPC_DIAGCAS_ID" 44 "EPMSPC_DIAGCRS_ID" 45 "EPMSRV_LIB_ID" 46 "EPMSYN_CAMSFTPST_ID" 47 "EPMSYN_CASPOS_ID" 48 "EPMSYN_CO_ID" 49 "EPMSYN_CPP_ID" 50 "EPMSYN_CRKSFTPAT_ID" 51 "EPMSYN_CRKSFTTOOTHT_ID" 52 "EPMSYN_CRSPOS_ID" 53 "EPMSYN_DBLLGN_ID" 54 "EPMSYN_INJRLS_ID" 55 "EPMSYN_INTKMNFLDP_ID" 56 "EPMSYN_TESTINJ_ID" 57 "EPMTDC_ADAP_ID" 58 "EPMTDC_CTL_ID" 59 "EPMHWE_FIL_ID" 60 "EPMHWE_INI_ID" 61 "EPMHWE_SRV_ID" 62 "EPMHAGCLK_GEN_ID" 63 "EPMHAGCLK_TRIGEVE_ID" 64 "EPMHCAS_DELAY_ID" 65 "EPMHCAS_INTERFACE_ID" 66 "EPMHCAS_SIGBUF_ID" 67 "EPMHCAS_SIGEVAL_ID" 68 "EPMHCRS_DIREVLN_ID" 69 "EPMHCRS_DYNPLAUS_ID" 70 "EPMHCRS_INTERFACE_ID" 71 "EPMHCRS_SAMPLING_ID" 72 "EPMHCRS_SIGBUF_ID" 73 "EPMHCRS_SIGEVAL_ID" 74 "EPMHCRS_STMAC_ID" 75 "EPMHERT_SIGBUF_ID" 76 "EPMHERT_SIGEVAL_ID" 77 "EPMHINT_INTGEN_ID" 78 "EPMHSPC_CHECK_ID" 79 "EPMHAGCLK_TRIG_ID" 80 "EPMHCRS_INTHNDLR_ID" /end COMPU_VTAB
/begin COMPU_METHOD Epm_stOpMode_State_t "" TAB_VERB "%6.3" "" COMPU_TAB_REF Epm_stOpMode_State_t /end COMPU_METHOD
/begin COMPU_VTAB Epm_stOpMode_State_t "" TAB_VERB 8 1 "EPM_MODE_WAIT" 5 "EPM_MODE_LOCKRESYNC" 20 "EPM_MODE_ALE" 33 "EPM_MODE_VERIFY" 36 "EPM_MODE_VERIFY_EXT" 38 "EPM_MODE_BACKUP_CAS" 48 "EPM_MODE_OK" 60 "EPM_MODE_BACKUP_CRS" /end COMPU_VTAB
/begin COMPU_METHOD Fact "" RAT_FUNC "%6.5" "-" COEFFS 0 8192 0 0 0 1 /end COMPU_METHOD
/begin COMPU_METHOD fak_ub_b4 "" RAT_FUNC "%6.4" "-" COEFFS 0 256 0 0 0 4 /end COMPU_METHOD
/begin COMPU_METHOD fak_uw_b1 "" RAT_FUNC "%7.6" "-" COEFFS 0 65536 0 0 0 1 /end COMPU_METHOD
/begin COMPU_METHOD fak_uw_b2 "" RAT_FUNC "%7.6" "-" COEFFS 0 65536 0 0 0 2 /end COMPU_METHOD
/begin COMPU_METHOD fak_uw_b4 "" RAT_FUNC "%7.6" "-" COEFFS 0 65536 0 0 0 4 /end COMPU_METHOD
/begin COMPU_METHOD GptaClc0_ti_COMPU "" RAT_FUNC "%6.4" "us" COEFFS 0 20 0 0 0 1 /end COMPU_METHOD
/begin COMPU_METHOD GptaClc6_ti_COMPU "" RAT_FUNC "%6.3" "us" COEFFS 0 2.5 0 0 0 1 /end COMPU_METHOD
/begin COMPU_METHOD IGCTL_DFCIAKNKPROTN_SC_Compu "" TAB_VERB "%6.3" "" COMPU_TAB_REF IGCTL_DFCIAKNKPROTN_SC_Compu /end COMPU_METHOD
/begin COMPU_VTAB IGCTL_DFCIAKNKPROTN_SC_Compu "" TAB_VERB 2 0 "0" 1 "1" /end COMPU_VTAB
/begin COMPU_METHOD IGCTL_IAATS_SC_Compu "" TAB_VERB "%6.3" "" COMPU_TAB_REF IGCTL_IAATS_SC_Compu /end COMPU_METHOD
/begin COMPU_VTAB IGCTL_IAATS_SC_Compu "" TAB_VERB 2 0 "False" 1 "True" /end COMPU_VTAB
/begin COMPU_METHOD IGCTL_IAMDLEGR_SC_Compu "" TAB_VERB "%6.3" "" COMPU_TAB_REF IGCTL_IAMDLEGR_SC_Compu /end COMPU_METHOD
/begin COMPU_VTAB IGCTL_IAMDLEGR_SC_Compu "" TAB_VERB 2 0 "IAMDLEGR_CNVTNL" 1 "IAMDLEGR_ADV" /end COMPU_VTAB
/begin COMPU_METHOD IGCTL_VAR_SY_Compu "" TAB_VERB "%6.3" "" COMPU_TAB_REF IGCTL_VAR_SY_Compu /end COMPU_METHOD
/begin COMPU_VTAB IGCTL_VAR_SY_Compu "" TAB_VERB 44 1 "DAI" 3 "VWW" 4 "POR" 5 "AUD" 6 "OPE" 9 "FIA" 11 "BMW" 14 "PSA" 15 "REN" 17 "ALF" 18 "SAB" 19 "VOL" 20 "NIS" 21 "GMU" 22 "FOR" 26 "IMJ" 51 "SEA" 53 "CHR" 54 "JAG" 55 "ROL" 69 "FER" 72 "TOY" 123 "MIT" 147 "HYU" 159 "HON" 160 "MAZ" 183 "CU" 190 "LRG" 204 "VVW" 214 "AVT" 242 "Iveco" 243 "DMC" 248 "SUZ" 267 "SSANGYONG" 270 "KEF" 289 "AMG" 308 "TAT" 319 "MVM" 385 "UAES" 590 "Scania" 828 "RBCD" 999 "ALL" 2887 "Nonox" 9454 "Fuso" /end COMPU_VTAB
/begin COMPU_METHOD IGNARCDURMONI_SY_Compu "" TAB_VERB "%6.3" "" COMPU_TAB_REF IGNARCDURMONI_SY_Compu /end COMPU_METHOD
/begin COMPU_VTAB IGNARCDURMONI_SY_Compu "" TAB_VERB 2 0 "Spark Duration Diagnosis Ignition Output inactive" 1 "Spark Duration Diagnosis Ignition Output active" /end COMPU_VTAB
/begin COMPU_METHOD IGNCLMPVLTGDURMON_SC_Compu "" TAB_VERB "%6.3" "" COMPU_TAB_REF IGNCLMPVLTGDURMON_SC_Compu /end COMPU_METHOD
/begin COMPU_VTAB IGNCLMPVLTGDURMON_SC_Compu "" TAB_VERB 2 0 "False" 1 "True" /end COMPU_VTAB
/begin COMPU_METHOD IGNCLPS_BENCHERR_SC_Compu "" TAB_VERB "%6.3" "" COMPU_TAB_REF IGNCLPS_BENCHERR_SC_Compu /end COMPU_METHOD
/begin COMPU_VTAB IGNCLPS_BENCHERR_SC_Compu "" TAB_VERB 3 0 "No bench error (default)" 1 "One bench" 2 "Two benches" /end COMPU_VTAB
/begin COMPU_METHOD IGNCLPS_STADIAENBL_SY_Compu "" TAB_VERB "%6.3" "" COMPU_TAB_REF IGNCLPS_STADIAENBL_SY_Compu /end COMPU_METHOD
/begin COMPU_VTAB IGNCLPS_STADIAENBL_SY_Compu "" TAB_VERB 2 0 "Disable" 1 "Enable" /end COMPU_VTAB
/begin COMPU_METHOD IGNCL_CLCRNTMON_SY_Compu "" TAB_VERB "%6.3" "" COMPU_TAB_REF IGNCL_CLCRNTMON_SY_Compu /end COMPU_METHOD
/begin COMPU_VTAB IGNCL_CLCRNTMON_SY_Compu "" TAB_VERB 4 0 "Inactive(default)" 1 "Active_ADC" 2 "Active_DSADC" 3 "Active_DSADC_cont" /end COMPU_VTAB
/begin COMPU_METHOD IGNCL_INTTEST_SC_Compu "" RAT_FUNC "%6.2" "" COEFFS 0 1 0 0 0 1 /end COMPU_METHOD
/begin COMPU_METHOD IGNCL_QAG_SY_Compu "" TAB_VERB "%6.3" "" COMPU_TAB_REF IGNCL_QAG_SY_Compu /end COMPU_METHOD
/begin COMPU_VTAB IGNCL_QAG_SY_Compu "" TAB_VERB 2 1 "0.75 GradKW" 2 "0.10 GradKW" /end COMPU_VTAB
/begin COMPU_METHOD IGNCL_SPCLCOILDIAG_SC_Compu "" TAB_VERB "%6.3" "" COMPU_TAB_REF IGNCL_SPCLCOILDIAG_SC_Compu /end COMPU_METHOD
/begin COMPU_VTAB IGNCL_SPCLCOILDIAG_SC_Compu "" TAB_VERB 2 0 "COILDIAG_DISABLED" 1 "SPCLFBCKT_ENABLED" /end COMPU_VTAB
/begin COMPU_METHOD IGNCL_SYNCSDL_SC_Compu "" TAB_VERB "%6.3" "" COMPU_TAB_REF IGNCL_SYNCSDL_SC_Compu /end COMPU_METHOD
/begin COMPU_VTAB IGNCL_SYNCSDL_SC_Compu "" TAB_VERB 4 0 "0" 1 "1" 2 "2" 3 "3" /end COMPU_VTAB
/begin COMPU_METHOD IGNCL_VAR_SY_Compu "" TAB_VERB "%6.3" "" COMPU_TAB_REF IGNCL_VAR_SY_Compu /end COMPU_METHOD
/begin COMPU_VTAB IGNCL_VAR_SY_Compu "" TAB_VERB 46 1 "DAI" 3 "VWW" 4 "POR" 5 "AUD" 6 "OPE" 9 "FIA" 11 "BMW" 14 "PSA" 15 "REN" 17 "ALF" 18 "SAB" 19 "VOL" 20 "NIS" 21 "GMU" 22 "FOR" 26 "IMJ" 51 "SEA" 53 "CHR" 54 "JAG" 55 "ROL" 69 "FER" 72 "TOY" 123 "MIT" 147 "HYU" 159 "HON" 160 "MAZ" 183 "CU" 190 "LRG" 204 "VVW" 214 "AVT" 242 "Iveco" 243 "DMC" 248 "SUZ" 267 "SSANGYONG" 268 "BRP-Rotax" 270 "KEF" 289 "AMG" 308 "TAT" 319 "MVM" 385 "UAES" 590 "Scania" 828 "RBCD" 999 "ALL" 2887 "Nonox" 9364 "Enfield" 9454 "Fuso" /end COMPU_VTAB
/begin COMPU_METHOD IGNFADEOUTPREIGN_SC_Compu "" TAB_VERB "%6.3" "" COMPU_TAB_REF IGNFADEOUTPREIGN_SC_Compu /end COMPU_METHOD
/begin COMPU_VTAB IGNFADEOUTPREIGN_SC_Compu "" TAB_VERB 2 0 "False" 1 "True" /end COMPU_VTAB
/begin COMPU_METHOD IGNMDLRRI_SC_Compu "" TAB_VERB "%6.3" "" COMPU_TAB_REF IGNMDLRRI_SC_Compu /end COMPU_METHOD
/begin COMPU_VTAB IGNMDLRRI_SC_Compu "" TAB_VERB 3 0 "NONE" 1 "STANDARD" 2 "ENHANCED" /end COMPU_VTAB
/begin COMPU_METHOD IKCTL_CONTNSADPN_SC_Compu "" TAB_VERB "%6.3" "" COMPU_TAB_REF IKCTL_CONTNSADPN_SC_Compu /end COMPU_METHOD
/begin COMPU_VTAB IKCTL_CONTNSADPN_SC_Compu "" TAB_VERB 2 0 "False" 1 "True" /end COMPU_VTAB
/begin COMPU_METHOD IKCTL_DIDYNDETN_SC_Compu "" TAB_VERB "%6.3" "" COMPU_TAB_REF IKCTL_DIDYNDETN_SC_Compu /end COMPU_METHOD
/begin COMPU_VTAB IKCTL_DIDYNDETN_SC_Compu "" TAB_VERB 2 0 "disable_not_active" 1 "disable_active" /end COMPU_VTAB
/begin COMPU_METHOD IKCTL_IACORRMEASWINBEGIN_SC_Compu "" TAB_VERB "%6.3" "" COMPU_TAB_REF IKCTL_IACORRMEASWINBEGIN_SC_Compu /end COMPU_METHOD
/begin COMPU_VTAB IKCTL_IACORRMEASWINBEGIN_SC_Compu "" TAB_VERB 4 0 "default_calculation" 1 "calculation_with_basis_ignition_angle" 2 "calculation_with_preventive_offset" 3 "calculation_with_dzwwl" /end COMPU_VTAB
/begin COMPU_METHOD IKCTL_IAERLY_SC_Compu "" TAB_VERB "%6.3" "" COMPU_TAB_REF IKCTL_IAERLY_SC_Compu /end COMPU_METHOD
/begin COMPU_VTAB IKCTL_IAERLY_SC_Compu "" TAB_VERB 2 0 "DISABLED" 1 "ENABLED" /end COMPU_VTAB
/begin COMPU_METHOD IKCTL_SFTYIGNRTD_SC_Compu "" TAB_VERB "%6.3" "" COMPU_TAB_REF IKCTL_SFTYIGNRTD_SC_Compu /end COMPU_METHOD
/begin COMPU_VTAB IKCTL_SFTYIGNRTD_SC_Compu "" TAB_VERB 2 0 "False" 1 "True" /end COMPU_VTAB
/begin COMPU_METHOD IKCTL_TSNSR_SC_Compu "" TAB_VERB "%6.3" "" COMPU_TAB_REF IKCTL_TSNSR_SC_Compu /end COMPU_METHOD
/begin COMPU_VTAB IKCTL_TSNSR_SC_Compu "" TAB_VERB 2 0 "CEngDsT_t" 1 "CHdT_t" /end COMPU_VTAB
/begin COMPU_METHOD IKCTL_VAR_SY_Compu "" TAB_VERB "%6.3" "" COMPU_TAB_REF IKCTL_VAR_SY_Compu /end COMPU_METHOD
/begin COMPU_VTAB IKCTL_VAR_SY_Compu "" TAB_VERB 44 1 "DAI" 3 "VWW" 4 "POR" 5 "AUD" 6 "OPE" 9 "FIA" 11 "BMW" 14 "PSA" 15 "REN" 17 "ALF" 18 "SAB" 19 "VOL" 20 "NIS" 21 "GMU" 22 "FOR" 26 "IMJ" 51 "SEA" 53 "CHR" 54 "JAG" 55 "ROL" 69 "FER" 72 "TOY" 123 "MIT" 147 "HYU" 159 "HON" 160 "MAZ" 183 "CU" 190 "LRG" 204 "VVW" 214 "AVT" 242 "Iveco" 243 "DMC" 248 "SUZ" 267 "SSANGYONG" 270 "KEF" 289 "AMG" 308 "TAT" 319 "MVM" 385 "UAES" 590 "Scania" 828 "RBCD" 999 "ALL" 2887 "Nonox" 9454 "Fuso" /end COMPU_VTAB
/begin COMPU_METHOD INDPDTSMALLQNTYADPN_SC_Compu "" TAB_VERB "%6.3" "" COMPU_TAB_REF INDPDTSMALLQNTYADPN_SC_Compu /end COMPU_METHOD
/begin COMPU_VTAB INDPDTSMALLQNTYADPN_SC_Compu "" TAB_VERB 2 0 "False" 1 "True" /end COMPU_VTAB
/begin COMPU_METHOD INHBFPCOILLVLMEAS_SC_Compu "" TAB_VERB "%6.3" "" COMPU_TAB_REF INHBFPCOILLVLMEAS_SC_Compu /end COMPU_METHOD
/begin COMPU_VTAB INHBFPCOILLVLMEAS_SC_Compu "" TAB_VERB 2 0 "False" 1 "True" /end COMPU_VTAB
/begin COMPU_METHOD INJCRV_INJMASSPIIFACT_SY_Compu "" RAT_FUNC "%6.2" "" COEFFS 0 1 0 0 0 1 /end COMPU_METHOD
/begin COMPU_METHOD INJGDI_NUMPRESCIR_SY_Compu "" TAB_VERB "%6.3" "" COMPU_TAB_REF INJGDI_NUMPRESCIR_SY_Compu /end COMPU_METHOD
/begin COMPU_VTAB INJGDI_NUMPRESCIR_SY_Compu "" TAB_VERB 3 0 "No_Pres_Cir" 1 "One_Pres_Cir" 2 "Two_Pres_Cir" /end COMPU_VTAB
/begin COMPU_METHOD INJLIMNHEV_SC_Compu "" TAB_VERB "%6.3" "" COMPU_TAB_REF INJLIMNHEV_SC_Compu /end COMPU_METHOD
/begin COMPU_VTAB INJLIMNHEV_SC_Compu "" TAB_VERB 2 0 "False" 1 "True" /end COMPU_VTAB
/begin COMPU_METHOD InjMassCyc "" RAT_FUNC "%6.4" "mg/cyc" COEFFS 0 100 0 0 0 1 /end COMPU_METHOD
/begin COMPU_METHOD InjMassInj "" RAT_FUNC "%6.4" "mg/inj" COEFFS 0 100 0 0 0 1 /end COMPU_METHOD
/begin COMPU_METHOD InjMassPerTimeHi "" RAT_FUNC "%7.6" "Kg/h" COEFFS 0 10000 0 0 0 1 /end COMPU_METHOD
/begin COMPU_METHOD InjMs_q0p1_COMPU "" RAT_FUNC "%6.3" "mg/hub" COEFFS 0 10 0 0 0 1 /end COMPU_METHOD
/begin COMPU_METHOD InjMs_q0p2_COMPU "" RAT_FUNC "%6.3" "mg/hub" COEFFS 0 5 0 0 0 1 /end COMPU_METHOD
/begin COMPU_METHOD INJNGT_MODE_SC_Compu "" TAB_VERB "%6.3" "" COMPU_TAB_REF INJNGT_MODE_SC_Compu /end COMPU_METHOD
/begin COMPU_VTAB INJNGT_MODE_SC_Compu "" TAB_VERB 3 0 "INJNGT_0_DEG" 1 "INJNGT_360_DEG" 2 "INJNGT_720_DEG" /end COMPU_VTAB
/begin COMPU_METHOD InjQnt "" RAT_FUNC "%6.3" "mm^3/hub" COEFFS 0 10 0 0 0 1 /end COMPU_METHOD
/begin COMPU_METHOD InjQntInj "" RAT_FUNC "%6.4" "mm^3/inj" COEFFS 0 100 0 0 0 1 /end COMPU_METHOD
/begin COMPU_METHOD INJSYG_CYLINDCORRNTSTR_SC_Compu "" TAB_VERB "%6.3" "" COMPU_TAB_REF INJSYG_CYLINDCORRNTSTR_SC_Compu /end COMPU_METHOD
/begin COMPU_VTAB INJSYG_CYLINDCORRNTSTR_SC_Compu "" TAB_VERB 2 0 "False" 1 "True" /end COMPU_VTAB
/begin COMPU_METHOD INJSYG_GDIPFITICONGDI_SC_Compu "" TAB_VERB "%6.3" "" COMPU_TAB_REF INJSYG_GDIPFITICONGDI_SC_Compu /end COMPU_METHOD
/begin COMPU_VTAB INJSYG_GDIPFITICONGDI_SC_Compu "" TAB_VERB 2 0 "False" 1 "True" /end COMPU_VTAB
/begin COMPU_METHOD INJSYG_INJRFLOWADPN_SC_Compu "" TAB_VERB "%6.3" "" COMPU_TAB_REF INJSYG_INJRFLOWADPN_SC_Compu /end COMPU_METHOD
/begin COMPU_VTAB INJSYG_INJRFLOWADPN_SC_Compu "" TAB_VERB 3 0 "NO_ADPN" 1 "BASC_ADPN" 2 "DIAG_BASC_ADPN" /end COMPU_VTAB
/begin COMPU_METHOD INJSYG_INJTMNGSTB_SC_Compu "" TAB_VERB "%6.3" "" COMPU_TAB_REF INJSYG_INJTMNGSTB_SC_Compu /end COMPU_METHOD
/begin COMPU_VTAB INJSYG_INJTMNGSTB_SC_Compu "" TAB_VERB 2 0 "False" 1 "True" /end COMPU_VTAB
/begin COMPU_METHOD INJSYG_MAXSIZETIINJNLNR_SC_Compu "" RAT_FUNC "%6.2" "" COEFFS 0 1 0 0 0 1 /end COMPU_METHOD
/begin COMPU_METHOD INJSYG_MAXSIZETIINJOPEN_SC_Compu "" RAT_FUNC "%6.2" "" COEFFS 0 1 0 0 0 1 /end COMPU_METHOD
/begin COMPU_METHOD INJSYG_MIXCOREXTN_SC_Compu "" TAB_VERB "%6.3" "" COMPU_TAB_REF INJSYG_MIXCOREXTN_SC_Compu /end COMPU_METHOD
/begin COMPU_VTAB INJSYG_MIXCOREXTN_SC_Compu "" TAB_VERB 2 0 "False" 1 "True" /end COMPU_VTAB
/begin COMPU_METHOD INJSYG_SMLQNTYADPN_SC_Compu "" TAB_VERB "%6.3" "" COMPU_TAB_REF INJSYG_SMLQNTYADPN_SC_Compu /end COMPU_METHOD
/begin COMPU_VTAB INJSYG_SMLQNTYADPN_SC_Compu "" TAB_VERB 2 0 "False" 1 "True" /end COMPU_VTAB
/begin COMPU_METHOD INJSYG_TFRKATS_SC_Compu "" TAB_VERB "%6.3" "" COMPU_TAB_REF INJSYG_TFRKATS_SC_Compu /end COMPU_METHOD
/begin COMPU_VTAB INJSYG_TFRKATS_SC_Compu "" TAB_VERB 2 0 "0" 1 "1" /end COMPU_VTAB
/begin COMPU_METHOD INJSYG_TINJVLV_SC_Compu "" TAB_VERB "%6.3" "" COMPU_TAB_REF INJSYG_TINJVLV_SC_Compu /end COMPU_METHOD
/begin COMPU_VTAB INJSYG_TINJVLV_SC_Compu "" TAB_VERB 2 0 "0" 1 "1" /end COMPU_VTAB
/begin COMPU_METHOD INJSYG_TMNGDIAGTYP_SC_Compu "" TAB_VERB "%6.3" "" COMPU_TAB_REF INJSYG_TMNGDIAGTYP_SC_Compu /end COMPU_METHOD
/begin COMPU_VTAB INJSYG_TMNGDIAGTYP_SC_Compu "" TAB_VERB 2 0 "0" 1 "1" /end COMPU_VTAB
/begin COMPU_METHOD INJSYG_VAR_SY_Compu "" TAB_VERB "%6.3" "" COMPU_TAB_REF INJSYG_VAR_SY_Compu /end COMPU_METHOD
/begin COMPU_VTAB INJSYG_VAR_SY_Compu "" TAB_VERB 46 1 "DAI" 3 "VWW" 4 "POR" 5 "AUD" 6 "OPE" 9 "FIA" 11 "BMW" 14 "PSA" 15 "REN" 17 "ALF" 18 "SAB" 19 "VOL" 20 "NIS" 21 "GMU" 22 "FOR" 26 "IMJ" 51 "SEA" 53 "CHR" 54 "JAG" 55 "ROL" 69 "FER" 72 "TOY" 123 "MIT" 147 "HYU" 159 "HON" 160 "MAZ" 183 "CU" 190 "LRG" 204 "VVW" 214 "AVT" 242 "Iveco" 243 "DMC" 248 "SUZ" 267 "SSANGYONG" 270 "KEF" 289 "AMG" 308 "TAT" 319 "MVM" 385 "UAES" 425 "Polaris" 590 "Scania" 828 "RBCD" 999 "ALL" 2887 "Nonox" 9397 "KHI" 9454 "Fuso" /end COMPU_VTAB
/begin COMPU_METHOD INJSYS_COORRINJMODVRNT_SC_Compu "" TAB_VERB "%6.3" "" COMPU_TAB_REF INJSYS_COORRINJMODVRNT_SC_Compu /end COMPU_METHOD
/begin COMPU_VTAB INJSYS_COORRINJMODVRNT_SC_Compu "" TAB_VERB 3 0 "No_CoorrInjMod" 1 "CoorrInjMod_Variant_1" 2 "CoorrInjMod_Variant_2" /end COMPU_VTAB
/begin COMPU_METHOD INJSYS_FUFILLGINJTICALCN_SC_Compu "" TAB_VERB "%6.3" "" COMPU_TAB_REF INJSYS_FUFILLGINJTICALCN_SC_Compu /end COMPU_METHOD
/begin COMPU_VTAB INJSYS_FUFILLGINJTICALCN_SC_Compu "" TAB_VERB 3 0 "0" 1 "1" 2 "2" /end COMPU_VTAB
/begin COMPU_METHOD INJSYS_INJAGADPN_SC_Compu "" TAB_VERB "%6.3" "" COMPU_TAB_REF INJSYS_INJAGADPN_SC_Compu /end COMPU_METHOD
/begin COMPU_VTAB INJSYS_INJAGADPN_SC_Compu "" TAB_VERB 2 0 "0" 1 "1" /end COMPU_VTAB
/begin COMPU_METHOD INJSYS_INJMODCOR_SY_Compu "" TAB_VERB "%6.3" "" COMPU_TAB_REF INJSYS_INJMODCOR_SY_Compu /end COMPU_METHOD
/begin COMPU_VTAB INJSYS_INJMODCOR_SY_Compu "" TAB_VERB 2 0 "False" 1 "True" /end COMPU_VTAB
/begin COMPU_METHOD INJSYS_INJRLEAKFCO_SC_Compu "" TAB_VERB "%6.3" "" COMPU_TAB_REF INJSYS_INJRLEAKFCO_SC_Compu /end COMPU_METHOD
/begin COMPU_VTAB INJSYS_INJRLEAKFCO_SC_Compu "" TAB_VERB 2 0 "False" 1 "True" /end COMPU_VTAB
/begin COMPU_METHOD INJSYS_INJTMNGVRNT_SC_Compu "" TAB_VERB "%6.3" "" COMPU_TAB_REF INJSYS_INJTMNGVRNT_SC_Compu /end COMPU_METHOD
/begin COMPU_VTAB INJSYS_INJTMNGVRNT_SC_Compu "" TAB_VERB 2 0 "InjTiming_Variant_1" 1 "InjTiming_Variant_2" /end COMPU_VTAB
/begin COMPU_METHOD INJSYS_POI1SETPOINT_SY_Compu "" RAT_FUNC "%6.2" "" COEFFS 0 1 0 0 0 1 /end COMPU_METHOD
/begin COMPU_METHOD INJSYS_POI2SETPOINT_SY_Compu "" RAT_FUNC "%6.2" "" COEFFS 0 1 0 0 0 1 /end COMPU_METHOD
/begin COMPU_METHOD INJSYS_POI3SETPOINT_SY_Compu "" RAT_FUNC "%6.2" "" COEFFS 0 1 0 0 0 1 /end COMPU_METHOD
/begin COMPU_METHOD INJSYS_RAILLEAKTST_SY_Compu "" TAB_VERB "%6.3" "" COMPU_TAB_REF INJSYS_RAILLEAKTST_SY_Compu /end COMPU_METHOD
/begin COMPU_VTAB INJSYS_RAILLEAKTST_SY_Compu "" TAB_VERB 2 0 "False" 1 "True" /end COMPU_VTAB
/begin COMPU_METHOD INJSYS_TWNINJR_SC_Compu "" TAB_VERB "%6.3" "" COMPU_TAB_REF INJSYS_TWNINJR_SC_Compu /end COMPU_METHOD
/begin COMPU_VTAB INJSYS_TWNINJR_SC_Compu "" TAB_VERB 2 0 "False" 1 "True" /end COMPU_VTAB
/begin COMPU_METHOD INJSYS_TWOSTEPINJ_SC_Compu "" TAB_VERB "%6.3" "" COMPU_TAB_REF INJSYS_TWOSTEPINJ_SC_Compu /end COMPU_METHOD
/begin COMPU_VTAB INJSYS_TWOSTEPINJ_SC_Compu "" TAB_VERB 2 0 "False" 1 "True" /end COMPU_VTAB
/begin COMPU_METHOD md_q0p1 "" RAT_FUNC "%6.3" "Nm" COEFFS 0 10 0 0 0 1 /end COMPU_METHOD
/begin COMPU_METHOD md_q1p6 "" RAT_FUNC "%6.2" "Nm" COEFFS 0 10 0 0 0 16 /end COMPU_METHOD
/begin COMPU_METHOD m_uw_b6553p5 "" RAT_FUNC "%6.3" "kg/h" COEFFS 0 1 0 0 0 0.1 /end COMPU_METHOD
/begin COMPU_METHOD nmot_q40 "" RAT_FUNC "%6.1" "1/min" COEFFS 0 1 0 0 0 40 /end COMPU_METHOD
/begin COMPU_METHOD OneToOne "" RAT_FUNC "%6.2" "-" COEFFS 0 1 0 0 0 1 /end COMPU_METHOD
/begin COMPU_METHOD OneToOne_ms "" RAT_FUNC "%6.2" "ms" COEFFS 0 1 0 0 0 1 /end COMPU_METHOD
/begin COMPU_METHOD OneToOne_us "" RAT_FUNC "%6.2" "us" COEFFS 0 1 0 0 0 1 /end COMPU_METHOD
/begin COMPU_METHOD Per_Dur "" RAT_FUNC "%6.2" "usec" COEFFS 0 1 0 0 0 1 /end COMPU_METHOD
/begin COMPU_METHOD Prc "" RAT_FUNC "%6.4" "%" COEFFS 0 81.92 0 0 0 1 /end COMPU_METHOD
/begin COMPU_METHOD p_q0p039 "" RAT_FUNC "%6.4" "hPa" COEFFS 0 256 0 0 0 10 /end COMPU_METHOD
/begin COMPU_METHOD p_q0p078 "" RAT_FUNC "%6.4" "hPa" COEFFS 0 64 0 0 0 5 /end COMPU_METHOD
/begin COMPU_METHOD p_ub_q5 "" RAT_FUNC "%6.2" "hPa" COEFFS 0 1 0 0 0 5 /end COMPU_METHOD
/begin COMPU_METHOD RBPtCel_ag_1p373291em3_1 "" RAT_FUNC "%6.4" "degCrS" COEFFS 0 7281777777776 0 0 0 10000000000 /end COMPU_METHOD
/begin COMPU_METHOD RBPtCel_ti_50p0_1 "" RAT_FUNC "%6.1" "ns" COEFFS 0 1 0 0 0 50 /end COMPU_METHOD
/begin COMPU_METHOD rel_q0p00195_pc_s "" RAT_FUNC "%6.4" "%*s" COEFFS 0 65536 0 0 0 128 /end COMPU_METHOD
/begin COMPU_METHOD rel_q0p39 "" RAT_FUNC "%6.3" "%" COEFFS 0 256 0 0 0 100 /end COMPU_METHOD
/begin COMPU_METHOD rel_sw_q0p0234 "" RAT_FUNC "%6.4" "%/seg" COEFFS 0 32 0 0 0 0.75 /end COMPU_METHOD
/begin COMPU_METHOD rel_uw_b100 "" RAT_FUNC "%6.4" "%" COEFFS 0 65536 0 0 0 100 /end COMPU_METHOD
/begin COMPU_METHOD RevCnt "" RAT_FUNC "%6.4" "-" COEFFS 0 16 0 0 0 1 /end COMPU_METHOD
/begin COMPU_METHOD SigQly_COMPU_VERB "" TAB_VERB "%6.3" "" COMPU_TAB_REF SigQly_COMPU_VERB /end COMPU_METHOD
/begin COMPU_VTAB SigQly_COMPU_VERB "" TAB_VERB 16 0 "SIGQLY_NOTCALC" 1 "SIGQLY_INIT" 2 "SIGQLY_OK" 3 "SIGQLY_MODEL" 4 "SIGQLY_REPLACEMENT" 5 "SIGQLY_FROZEN" 6 "SIGQLY_INVALID" 7 "SIGQLY_RESERVED_7" 8 "SIGQLY_RESERVED_8" 9 "SIGQLY_RESERVED_9" 10 "SIGQLY_RESERVED_10" 11 "SIGQLY_RESERVED_11" 12 "SIGQLY_RESERVED_12" 13 "SIGQLY_RESERVED_13" 14 "SIGQLY_RESERVED_14" 15 "SIGQLY_RESERVED_15" /end COMPU_VTAB
/begin COMPU_METHOD t100msxs_uw_b6553p5 "" RAT_FUNC "%6.3" "s" COEFFS 0 1 0 0 0 0.1 /end COMPU_METHOD
/begin COMPU_METHOD Temp_Cels "" RAT_FUNC "%6.1" "deg C" COEFFS 0 10 2731.4 0 0 1 /end COMPU_METHOD
/begin COMPU_METHOD temp_q0p0234_o273 "" RAT_FUNC "%6.1" "Grad C" COEFFS 0 1 273.15 0 0 0.0234375 /end COMPU_METHOD
/begin COMPU_METHOD temp_q1p0_o40_degC "" RAT_FUNC "%6.2" "Grad" COEFFS 0 1 40 0 0 1 /end COMPU_METHOD
/begin COMPU_METHOD temp_ub_q0p75_o48 "" RAT_FUNC "%6.2" "Grad C" COEFFS 0 1 48 0 0 0.75 /end COMPU_METHOD
/begin COMPU_METHOD TimeDelay_ms "" RAT_FUNC "%13.2" "ms" COEFFS 0 0 1 0 2.3283064365387e-007 0 /end COMPU_METHOD
/begin COMPU_METHOD TimeDelay_s "" RAT_FUNC "%6.1" "s" COEFFS 0 0 1 0 0.00023283064365387 0 /end COMPU_METHOD
/begin COMPU_METHOD Time_Dt "" RAT_FUNC "%9.8" "s" COEFFS 0 1000000 0 0 0 1 /end COMPU_METHOD
/begin COMPU_METHOD Time_ms "" RAT_FUNC "%6.1" "ms" COEFFS 0 0.1 0 0 0 1 /end COMPU_METHOD
/begin COMPU_METHOD Time_ns_to_us "" RAT_FUNC "%6.5" "us" COEFFS 0 1000 0 0 0 1 /end COMPU_METHOD
/begin COMPU_METHOD Time_sec_q1_COMPU "" RAT_FUNC "%6.2" "s" COEFFS 0 1 0 0 0 1 /end COMPU_METHOD
/begin COMPU_METHOD Trq "" RAT_FUNC "%6.3" "Nm" COEFFS 0 10 0 0 0 1 /end COMPU_METHOD
/begin COMPU_METHOD t_q0p01 "" RAT_FUNC "%6.4" "s" COEFFS 0 100 0 0 0 1 /end COMPU_METHOD
/begin COMPU_METHOD t_q0p01_us "" RAT_FUNC "%6.4" "us" COEFFS 0 100 0 0 0 1 /end COMPU_METHOD
/begin COMPU_METHOD t_q0p04 "" RAT_FUNC "%6.4" "s" COEFFS 0 100 0 0 0 4 /end COMPU_METHOD
/begin COMPU_METHOD t_q0p1 "" RAT_FUNC "%6.3" "s" COEFFS 0 10 0 0 0 1 /end COMPU_METHOD
/begin COMPU_METHOD t_q1 "" RAT_FUNC "%6.2" "s" COEFFS 0 1 0 0 0 1 /end COMPU_METHOD
/begin COMPU_METHOD Vel "" RAT_FUNC "%6.4" "km/h" COEFFS 0 100 0 0 0 1 /end COMPU_METHOD
/begin COMPU_METHOD zk40msxs_uw_b2621p4 "" RAT_FUNC "%6.1" "s" COEFFS 0 0 65535 0 25 0 /end COMPU_METHOD
/*********** End of merged RECORD_LAYOUT blocks ***********/
/begin RECORD_LAYOUT Axis_Xs16 NO_AXIS_PTS_X 1 SWORD AXIS_PTS_X 2 SWORD INDEX_INCR DIRECT /end RECORD_LAYOUT
/begin RECORD_LAYOUT CurG_Ws16 FNC_VALUES 1 SWORD COLUMN_DIR DIRECT /end RECORD_LAYOUT
/begin RECORD_LAYOUT Cur_Xs16Ws16 NO_AXIS_PTS_X 1 SWORD AXIS_PTS_X 2 SWORD INDEX_INCR DIRECT FNC_VALUES 3 SWORD COLUMN_DIR DIRECT /end RECORD_LAYOUT
/begin RECORD_LAYOUT RB_Curve_S16_S16 NO_AXIS_PTS_X 1 SWORD AXIS_PTS_X 2 SWORD INDEX_INCR DIRECT FNC_VALUES 3 SWORD COLUMN_DIR DIRECT /end RECORD_LAYOUT
/begin RECORD_LAYOUT RB_Curve_S16_U16_Static NO_AXIS_PTS_X 1 SWORD AXIS_PTS_X 2 SWORD INDEX_INCR DIRECT FNC_VALUES 3 UWORD COLUMN_DIR DIRECT STATIC_RECORD_LAYOUT /end RECORD_LAYOUT
/begin RECORD_LAYOUT RB_Curve_U8_S16_Static NO_AXIS_PTS_X 1 UBYTE AXIS_PTS_X 2 UBYTE INDEX_INCR DIRECT FNC_VALUES 3 SWORD COLUMN_DIR DIRECT STATIC_RECORD_LAYOUT /end RECORD_LAYOUT
/begin RECORD_LAYOUT RB_Curve_U8_U8 NO_AXIS_PTS_X 1 UBYTE AXIS_PTS_X 2 UBYTE INDEX_INCR DIRECT FNC_VALUES 3 UBYTE COLUMN_DIR DIRECT /end RECORD_LAYOUT
/begin RECORD_LAYOUT RB_Map_S16S16_S16 NO_AXIS_PTS_X 1 SWORD NO_AXIS_PTS_Y 2 SWORD AXIS_PTS_X 3 SWORD INDEX_INCR DIRECT AXIS_PTS_Y 4 SWORD INDEX_INCR DIRECT FNC_VALUES 5 SWORD COLUMN_DIR DIRECT /end RECORD_LAYOUT
/begin RECORD_LAYOUT RB_Map_U8S16_S16 NO_AXIS_PTS_X 1 UBYTE NO_AXIS_PTS_Y 2 UBYTE AXIS_PTS_X 3 UBYTE INDEX_INCR DIRECT AXIS_PTS_Y 4 SWORD INDEX_INCR DIRECT FNC_VALUES 5 SWORD ROW_DIR DIRECT /end RECORD_LAYOUT
/begin RECORD_LAYOUT RB_ValA_Wu16 FNC_VALUES 1 UWORD COLUMN_DIR DIRECT /end RECORD_LAYOUT
/begin RECORD_LAYOUT RB_Val_Ws16 FNC_VALUES 1 SWORD COLUMN_DIR DIRECT /end RECORD_LAYOUT
/begin RECORD_LAYOUT RB_Val_Ws32 FNC_VALUES 1 SLONG COLUMN_DIR DIRECT /end RECORD_LAYOUT
/begin RECORD_LAYOUT RB_Val_Wu16 FNC_VALUES 1 UWORD COLUMN_DIR DIRECT /end RECORD_LAYOUT
/begin RECORD_LAYOUT RB_Val_Wu32 FNC_VALUES 1 ULONG COLUMN_DIR DIRECT /end RECORD_LAYOUT
/begin RECORD_LAYOUT RB_Val_Wu8 FNC_VALUES 1 UBYTE COLUMN_DIR DIRECT /end RECORD_LAYOUT
/begin RECORD_LAYOUT ValA_Ws16 FNC_VALUES 1 SWORD COLUMN_DIR DIRECT /end RECORD_LAYOUT
/begin RECORD_LAYOUT ValA_Ws32 FNC_VALUES 1 SLONG COLUMN_DIR DIRECT /end RECORD_LAYOUT
/begin RECORD_LAYOUT ValA_Wu8 FNC_VALUES 1 UBYTE COLUMN_DIR DIRECT /end RECORD_LAYOUT
/begin RECORD_LAYOUT Val_Ws16 FNC_VALUES 1 SWORD COLUMN_DIR DIRECT /end RECORD_LAYOUT
/begin RECORD_LAYOUT Val_Ws32 FNC_VALUES 1 SLONG COLUMN_DIR DIRECT /end RECORD_LAYOUT
/begin RECORD_LAYOUT Val_Wu16 FNC_VALUES 1 UWORD COLUMN_DIR DIRECT /end RECORD_LAYOUT
/begin RECORD_LAYOUT Val_Wu32 FNC_VALUES 1 ULONG COLUMN_DIR DIRECT /end RECORD_LAYOUT
/begin RECORD_LAYOUT Val_Wu8 FNC_VALUES 1 UBYTE COLUMN_DIR DIRECT /end RECORD_LAYOUT
/end MODULE
/end PROJECT
