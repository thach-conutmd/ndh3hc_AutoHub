ASAP2_VERSION 1 60
/begin PROJECT MG1CS022 "MG1CS022"
/begin HEADER "" VERSION "MG1CS022_62XSC_V037_TPROT" PROJECT_NO MG1CS022 /end HEADER
/begin MODULE DIM ""
/begin MOD_COMMON "" BYTE_ORDER MSB_LAST ALIGNMENT_BYTE 1 ALIGNMENT_WORD 2 ALIGNMENT_LONG 4 ALIGNMENT_INT64 4 ALIGNMENT_FLOAT32_IEEE 4 ALIGNMENT_FLOAT64_IEEE 4 DATA_SIZE 32 /end MOD_COMMON
/begin CHARACTERISTIC UEGO_cndAprvdUp0Corrn_C "Correction Factor for Up0 dependency" VALUE 0x805818EC RB_Val_Wu16 0.01092250 g_q1p6667Em7_S 0.00 0.01092250 FORMAT "%10.8" /end CHARACTERISTIC
/begin CHARACTERISTIC UEGO_cntrCpCalc_C "Calibration indicating the number of CJ135 measurement cycles used for the learning." VALUE 0x805818EE RB_Val_Wu8 255.0 OneToOne 0.00 255.0 FORMAT "%5.1" /end CHARACTERISTIC
/begin CHARACTERISTIC UEGO_cpCamgGainIni_C "Peak filter gain for Camg calculation" VALUE 0x805818F0 RB_Val_Wu16 0.000006553500 q1Em10_F 0.00 0.000006553500 FORMAT "%14.12" /end CHARACTERISTIC
/begin CHARACTERISTIC UEGO_cpCamgIni_C "UEGO Camg Initial value" VALUE 0x805818F2 RB_Val_Wu16 0.000006553500 q1Em10_F 0.00 0.000006553500 FORMAT "%14.12" /end CHARACTERISTIC
/begin CHARACTERISTIC UEGO_cpCigGainIni_C "Peak filter gain for Cig calculation" VALUE 0x805818F4 RB_Val_Wu16 0.000006553500 q1Em10_F 0.00 0.000006553500 FORMAT "%14.12" /end CHARACTERISTIC
/begin CHARACTERISTIC UEGO_cpCigIni_C "UEGO Cig Initial value" VALUE 0x805818F6 RB_Val_Wu16 0.000006553500 q1Em10_F 0.00 0.000006553500 FORMAT "%14.12" /end CHARACTERISTIC
/begin CHARACTERISTIC UEGO_egyHeatrMax_C "Heater max energy limit" VALUE 0x805819D0 RB_Val_Wu32 1220.00000000 q_q6p1035Em5_J 0.00 1220.00000000 FORMAT "%13.8" EXTENDED_LIMITS 0.00 262143.999939 /end CHARACTERISTIC
/begin CHARACTERISTIC UEGO_egyOverHeatgProtnMinThd_C "Minimum Energy threshold for over heating protection" VALUE 0x805819D4 RB_Val_Wu32 1220.00000000 q_q6p1035Em5_J 0.00 1220.00000000 FORMAT "%13.8" EXTENDED_LIMITS 0.00 262143.999939 /end CHARACTERISTIC
/begin CHARACTERISTIC UEGO_egySnsrMdlAmbT_C "energy with the threshold for room temperature" VALUE 0x805819D8 RB_Val_Wu32 1220.00000000 q_q6p1035Em5_J 0.00 1220.00000000 FORMAT "%13.8" EXTENDED_LIMITS 0.00 262143.999939 /end CHARACTERISTIC
/begin CHARACTERISTIC UEGO_egySnsrMdlHeatgUpFinshd_C "energy threshold for curve phase heating temparature" VALUE 0x805819DC RB_Val_Wu32 1220.00000000 q_q6p1035Em5_J 0.00 1220.00000000 FORMAT "%13.8" EXTENDED_LIMITS 0.00 262143.999939 /end CHARACTERISTIC
/begin CHARACTERISTIC UEGO_egySnsrMdlHotThd_C "Energy threshhold for the release of flgSnsrMdlHot" VALUE 0x805819E0 RB_Val_Wu32 1220.00000000 q_q6p1035Em5_J 0.00 1220.00000000 FORMAT "%13.8" EXTENDED_LIMITS 0.00 262143.999939 /end CHARACTERISTIC
/begin CHARACTERISTIC UEGO_facCorKIA11P_CUR "Correction curve KIA11P" CURVE 0x805818F8 RB_Curve_U16_U16 1.999939 fak_uw_b2 0.000031 1.999969 FORMAT "%8.6" EXTENDED_LIMITS 0.00 1.999969
 /begin AXIS_DESCR STD_AXIS NO_INPUT_QUANTITY q1Em10_F 4 0.00 0.000006553500 FORMAT "%14.12" DEPOSIT ABSOLUTE /end AXIS_DESCR
/end CHARACTERISTIC
/begin CHARACTERISTIC UEGO_facCorKIA12P_CUR "Correction curve KIA12P" CURVE 0x8058190A RB_Curve_U16_U16 1.999939 fak_uw_b2 0.000031 1.999969 FORMAT "%8.6" EXTENDED_LIMITS 0.00 1.999969
 /begin AXIS_DESCR STD_AXIS NO_INPUT_QUANTITY q1Em10_F 4 0.00 0.000006553500 FORMAT "%14.12" DEPOSIT ABSOLUTE /end AXIS_DESCR
/end CHARACTERISTIC
/begin CHARACTERISTIC UEGO_facCorKIA21P_CUR "Correction curve KIA21P" CURVE 0x8058191C RB_Curve_U16_U16 1.999939 fak_uw_b2 0.000031 1.999969 FORMAT "%8.6" EXTENDED_LIMITS 0.00 1.999969
 /begin AXIS_DESCR STD_AXIS NO_INPUT_QUANTITY q1Em10_F 4 0.00 0.000006553500 FORMAT "%14.12" DEPOSIT ABSOLUTE /end AXIS_DESCR
/end CHARACTERISTIC
/begin CHARACTERISTIC UEGO_facCorKIA22P_CUR "Correction curve KIA22P" CURVE 0x8058192E RB_Curve_U16_U16 1.999939 fak_uw_b2 0.000031 1.999969 FORMAT "%8.6" EXTENDED_LIMITS 0.00 1.999969
 /begin AXIS_DESCR STD_AXIS NO_INPUT_QUANTITY q1Em10_F 4 0.00 0.000006553500 FORMAT "%14.12" DEPOSIT ABSOLUTE /end AXIS_DESCR
/end CHARACTERISTIC
/begin CHARACTERISTIC UEGO_facCorKIV1P_CUR "Correction curve KIV1P" CURVE 0x80581940 RB_Curve_U16_U16 1.999939 fak_uw_b2 0.000031 1.999969 FORMAT "%8.6" EXTENDED_LIMITS 0.00 1.999969
 /begin AXIS_DESCR STD_AXIS NO_INPUT_QUANTITY q1Em10_F 4 0.00 0.000006553500 FORMAT "%14.12" DEPOSIT ABSOLUTE /end AXIS_DESCR
/end CHARACTERISTIC
/begin CHARACTERISTIC UEGO_facDeltaUiFltConst_C "Filter constant for Ui measurement" VALUE 0x80581952 RB_Val_Wu16 0.9999695 fak_uw_b1 0.0000153 0.9999847 FORMAT "%9.7" EXTENDED_LIMITS 0.00 0.9999847 /end CHARACTERISTIC
/begin CHARACTERISTIC UEGO_facDeltaUiFltVldConst_C "Filter constant for validity of Ui measurement" VALUE 0x80581954 RB_Val_Wu16 0.9999847 fak_uw_b1 0.00 0.9999847 FORMAT "%9.7" /end CHARACTERISTIC
/begin CHARACTERISTIC UEGO_facEgyOverHeatgProtn_C "Factor thershold for over heating protection" VALUE 0x805819E4 RB_Val_Wu16 2.031585 fak_q0p000031 0.00 2.031585 FORMAT "%8.6" /end CHARACTERISTIC
/begin CHARACTERISTIC UEGO_facEgyRHeatr_C "Conversion factor LSU heat energy to heater resistance" VALUE 0x805819E6 RB_Val_Wu16 0.1249981 q1p907Em6_Ohm_DIV_J 0.00 0.1249981 FORMAT "%9.7" /end CHARACTERISTIC
/begin CHARACTERISTIC UEGO_facRCeramicFilCon_C "Filtering constant for ceramic resistance" VALUE 0x80581A02 RB_Val_Wu16 0.9999695 fak_uw_b1 0.0000153 0.9999847 FORMAT "%9.7" EXTENDED_LIMITS 0.00 0.9999847 /end CHARACTERISTIC
/begin CHARACTERISTIC UEGO_facRCeramicQuoFilCon_C "Filtering factor for filtering of resistances ratios" VALUE 0x80581A04 RB_Val_Wu16 0.9999695 fak_uw_b1 0.0000153 0.9999847 FORMAT "%9.7" EXTENDED_LIMITS 0.00 0.9999847 /end CHARACTERISTIC
/begin CHARACTERISTIC UEGO_facRCeramicVldyEvln_C "Factor to determin when the filtered value will be valid" VALUE 0x80581A06 RB_Val_Wu16 0.9999695 fak_uw_b1 0.0000153 0.9999847 FORMAT "%9.7" EXTENDED_LIMITS 0.00 0.9999847 /end CHARACTERISTIC
/begin CHARACTERISTIC UEGO_facUgiCorrn_C "Correction factor applied to Ugi voltage for Ugi-based reverse charge correction current calculation" VALUE 0x80581956 RB_Val_Ws16 0.000006553500 Fact10 -0.000003276800 0.000003276700 FORMAT "%14.12" /end CHARACTERISTIC
/begin CHARACTERISTIC UEGO_facUguxCorrn_T "Correction factor based on time constant applied to UguiUgua voltage to compensate for the loss during ADC integration." CURVE 0x80581958 RB_Curve_U16_U16 1.999969 fak_uw_b2 0.00 1.999969 FORMAT "%8.6"
 /begin AXIS_DESCR STD_AXIS NO_INPUT_QUANTITY t_q0p000001_s 6 0.00 0.06553500 FORMAT "%10.8" DEPOSIT ABSOLUTE /end AXIS_DESCR
/end CHARACTERISTIC
/begin CHARACTERISTIC UEGO_facUgxCorrn_T "ADC correction factor based on time constant applied to UgiUga voltage during C-learning" CURVE 0x80581972 RB_Curve_U16_U16 1.999969 fak_uw_b2 0.00 1.999969 FORMAT "%8.6"
 /begin AXIS_DESCR STD_AXIS NO_INPUT_QUANTITY t_q0p000001_s 6 0.00 0.06553500 FORMAT "%10.8" DEPOSIT ABSOLUTE /end AXIS_DESCR
/end CHARACTERISTIC
/begin CHARACTERISTIC UEGO_iIPmpRvsChrgCorrnOffsTM1Lean_C "Correction factor Offset TM1 Lean" VALUE 0x8058198C RB_Val_Ws16 0.04369000 i_q6p6667Em7_A -0.02184533 0.02184467 FORMAT "%10.8" /end CHARACTERISTIC
/begin CHARACTERISTIC UEGO_iIPmpRvsChrgCorrnOffsTM1Rich_C "Correction factor Offset TM1 Rich" VALUE 0x8058198E RB_Val_Ws16 0.04369000 i_q6p6667Em7_A -0.02184533 0.02184467 FORMAT "%10.8" /end CHARACTERISTIC
/begin CHARACTERISTIC UEGO_iIPmpRvsChrgCorrnOffsTM2Lean_C "Correction factor Offset TM2 Lean" VALUE 0x80581990 RB_Val_Ws16 0.04369000 i_q6p6667Em7_A -0.02184533 0.02184467 FORMAT "%10.8" /end CHARACTERISTIC
/begin CHARACTERISTIC UEGO_iIPmpRvsChrgCorrnOffsTM2Rich_C "Correction factor Offset TM2 Rich" VALUE 0x80581992 RB_Val_Ws16 0.04369000 i_q6p6667Em7_A -0.02184533 0.02184467 FORMAT "%10.8" /end CHARACTERISTIC
/begin CHARACTERISTIC UEGO_iIPmpRvsChrgCorrnTM1Lean_C "Correction factor Slope TM1 Lean" VALUE 0x80581994 RB_Val_Ws16 0.04369000 i_q6p6667Em7_A -0.02184533 0.02184467 FORMAT "%10.8" /end CHARACTERISTIC
/begin CHARACTERISTIC UEGO_iIPmpRvsChrgCorrnTM1Rich_C "Correction factor Slope TM1 Rich" VALUE 0x80581996 RB_Val_Ws16 0.04369000 i_q6p6667Em7_A -0.02184533 0.02184467 FORMAT "%10.8" /end CHARACTERISTIC
/begin CHARACTERISTIC UEGO_iIPmpRvsChrgCorrnTM2Lean_C "Correction factor Slope TM2 Lean" VALUE 0x80581998 RB_Val_Ws16 0.04369000 i_q6p6667Em7_A -0.02184533 0.02184467 FORMAT "%10.8" /end CHARACTERISTIC
/begin CHARACTERISTIC UEGO_iIPmpRvsChrgCorrnTM2Rich_C "Correction factor Slope TM2 Rich" VALUE 0x8058199A RB_Val_Ws16 0.04369000 i_q6p6667Em7_A -0.02184533 0.02184467 FORMAT "%10.8" /end CHARACTERISTIC
/begin CHARACTERISTIC UEGO_iIsqDesCMeas_C "Desired ISQ current amplitude for C-learning" VALUE 0x8058199C RB_Val_Wu16 0.02000000 i_q6p6667Em7_A 0.00 0.02000000 FORMAT "%10.8" EXTENDED_LIMITS 0.00 0.04369000 /end CHARACTERISTIC
/begin CHARACTERISTIC UEGO_nrRvsChrgCMeasOffs_C "Set value of CJ135 register PATTERN for C-learning" VALUE 0x8058199E RB_Val_Ws16 12024.00 OneToOne -6012.000 6012.000 FORMAT "%8.3" EXTENDED_LIMITS -32768.00 32767.00 /end CHARACTERISTIC
/begin CHARACTERISTIC UEGO_nrRvsChrgUiMeasOffs_C "Set value of CJ135 register PATTERN for Ui-learning" VALUE 0x805819A0 RB_Val_Ws16 12024.00 OneToOne -6012.000 6012.000 FORMAT "%8.3" EXTENDED_LIMITS -32768.00 32767.00 /end CHARACTERISTIC
/begin CHARACTERISTIC UEGO_numRegIpsmRvsChrg_C "Set value CJ135 registerpart IPSM" VALUE 0x805819A2 RB_Val_Wu8 255.0 dez 0.00 255.0 FORMAT "%5.1" /end CHARACTERISTIC
/begin CHARACTERISTIC UEGO_numRegPatCMeas_C "Set value CJ135 registerpart PATTERN for C-learning" VALUE 0x805819A4 RB_Val_Wu16 32767.00 dez 0.00 32767.00 FORMAT "%8.2" EXTENDED_LIMITS 0.00 65535.00 /end CHARACTERISTIC
/begin CHARACTERISTIC UEGO_numRegPatUiMeas_C "Set value CJ135 registerpart PATTERN for Ui-learning" VALUE 0x805819A6 RB_Val_Wu16 32767.00 dez 0.00 32767.00 FORMAT "%8.2" EXTENDED_LIMITS 0.00 65535.00 /end CHARACTERISTIC
/begin CHARACTERISTIC UEGO_pwrLossSnsrMax_C "maximum power loss of sensor element when sensor is cold" VALUE 0x805819E8 RB_Val_Wu16 159.9976 leist_q0p00244 0.00 159.9976 FORMAT "%8.4" /end CHARACTERISTIC
/begin CHARACTERISTIC UEGO_pwrLossSnsr_C "Powerloss of the sensorelement" VALUE 0x805819EA RB_Val_Wu16 159.9976 leist_q0p00244 0.00 159.9976 FORMAT "%8.4" /end CHARACTERISTIC
/begin CHARACTERISTIC UEGO_ratIPmpLearnUiLeanMin_C "Duty cycle threshold for Ui lean learning" VALUE 0x805819A8 RB_Val_Ws16 7.872072 fak_q1p201Em4 -3.936096 3.935976 FORMAT "%8.6" /end CHARACTERISTIC
/begin CHARACTERISTIC UEGO_ratIPmpLearnUiRichMax_C "Duty cycle threshold for Ui rich learning" VALUE 0x805819AA RB_Val_Ws16 7.872072 fak_q1p201Em4 -3.936096 3.935976 FORMAT "%8.6" /end CHARACTERISTIC
/begin CHARACTERISTIC UEGO_ratIPmpLearnUiStdMax_C "Upper Duty cycle threshold for Ui standard learning" VALUE 0x805819AC RB_Val_Ws16 7.872072 fak_q1p201Em4 -3.936096 3.935976 FORMAT "%8.6" /end CHARACTERISTIC
/begin CHARACTERISTIC UEGO_ratIPmpLearnUiStdMin_C "Lower Duty cycle threshold for Ui standard learning" VALUE 0x805819AE RB_Val_Ws16 7.872072 fak_q1p201Em4 -3.936096 3.935976 FORMAT "%8.6" /end CHARACTERISTIC
/begin CHARACTERISTIC UEGO_rHeatrMax_C "Maximum LSU heater resistance at operational temperature" VALUE 0x805819EC RB_Val_Wu16 63.99902 r_q9p765625Em4_Ohm 0.00 63.99902 FORMAT "%8.5" /end CHARACTERISTIC
/begin CHARACTERISTIC UEGO_rHeatrMin_C "Minimum LSU heater resistance at operational temperature" VALUE 0x805819EE RB_Val_Wu16 63.99902 r_q9p765625Em4_Ohm 0.00 63.99902 FORMAT "%8.5" /end CHARACTERISTIC
/begin CHARACTERISTIC UEGO_rLossHeatrPSMdl_C "Line resistance of the heater path" VALUE 0x805819F0 RB_Val_Wu16 63.99902 r_q9p765625Em4_Ohm 0.00 63.99902 FORMAT "%8.5" /end CHARACTERISTIC
/begin CHARACTERISTIC UEGO_rLossHeatrPS_C "Loss resistance in LSU heater circuit" VALUE 0x805819F2 RB_Val_Wu16 63.99902 r_q9p765625Em4_Ohm 0.00 63.99902 FORMAT "%8.5" /end CHARACTERISTIC
/begin CHARACTERISTIC UEGO_RNernstDeltaMax_C "" VALUE 0x80581802 RB_Val_Wu16 3276.700 r_q0p1_Ohm 0.00 3276.700 FORMAT "%8.3" EXTENDED_LIMITS 0.00 6553.500 /end CHARACTERISTIC
/begin CHARACTERISTIC UEGO_RPmpDeltaMax_C "" VALUE 0x8058184C RB_Val_Wu16 6553.500 r_q0p1_Ohm 0.00 6553.500 FORMAT "%8.3" /end CHARACTERISTIC
/begin CHARACTERISTIC UEGO_RPmpPlsOperDeltaMax_c "filter parameter" VALUE 0x80581894 RB_Val_Wu16 6553.500 r_q0p1_Ohm 0.00 6553.500 FORMAT "%8.3" /end CHARACTERISTIC
/begin CHARACTERISTIC UEGO_rRFe_C "Ohmscher Widerstand der EMV-Feritte an den SG-Pins APE RE IPE MES." VALUE 0x8058184E RB_Val_Wu8 25.50 r_q0p1_Ohm 0.00 25.50 FORMAT "%5.2" /end CHARACTERISTIC
/begin CHARACTERISTIC UEGO_rRNernstCrvtCorrnNorm_T "Curve for correction of Nernst-Cell resistance depending on pump current Ip. Used in Normal-Mode with activated pump current Ip" CURVE 0x80581804 RB_Curve_U16_S16_Static 6553.500 r_q0p1_Ohm -3276.800 3276.700 FORMAT "%8.3"
 /begin AXIS_DESCR STD_AXIS NO_INPUT_QUANTITY r_q0p1_Ohm 8 0.00 6553.500 FORMAT "%8.3" DEPOSIT ABSOLUTE /end AXIS_DESCR
/end CHARACTERISTIC
/begin CHARACTERISTIC UEGO_rRNernstCrvtCorrnWrmUp_T "Curve for correction of Nernst-Cell resistance depending on pump current Ip. Used in WarmUp-Mode with deactivated pump current Ip" CURVE 0x80581826 RB_Curve_U16_S16_Static 6553.500 r_q0p1_Ohm -3276.800 3276.700 FORMAT "%8.3"
 /begin AXIS_DESCR STD_AXIS NO_INPUT_QUANTITY r_q0p1_Ohm 8 0.00 6553.500 FORMAT "%8.3" DEPOSIT ABSOLUTE /end AXIS_DESCR
/end CHARACTERISTIC
/begin CHARACTERISTIC UEGO_rRPmpCrvtCorrnSwtOn_T "correction map RPmp (Ria) = f(Ri) during switch on mode" CURVE 0x80581850 RB_Curve_U16_S16_Static 6553.500 r_q0p1_Ohm -3276.800 3276.700 FORMAT "%8.3"
 /begin AXIS_DESCR STD_AXIS NO_INPUT_QUANTITY r_q0p1_Ohm 8 0.00 6553.500 FORMAT "%8.3" DEPOSIT ABSOLUTE /end AXIS_DESCR
/end CHARACTERISTIC
/begin CHARACTERISTIC UEGO_rRPmpCrvtCorrnWrmUp_T "correction map RPmp (Ria) = f(Ri) during warm up mode" CURVE 0x80581872 RB_Curve_U16_S16_Static 6553.500 r_q0p1_Ohm -3276.800 3276.700 FORMAT "%8.3"
 /begin AXIS_DESCR STD_AXIS NO_INPUT_QUANTITY r_q0p1_Ohm 8 0.00 6553.500 FORMAT "%8.3" DEPOSIT ABSOLUTE /end AXIS_DESCR
/end CHARACTERISTIC
/begin CHARACTERISTIC UEGO_rRPmpPlsOperCorrnIp_T "Ip correction of resistance values" CURVE 0x80581896 RB_Curve_S16_S16 6553.500 r_q0p1_Ohm -3276.800 3276.700 FORMAT "%8.3"
 /begin AXIS_DESCR STD_AXIS NO_INPUT_QUANTITY i_q6p6667Em7_A 20 -0.02184533 0.02184467 FORMAT "%10.8" DEPOSIT ABSOLUTE /end AXIS_DESCR
/end CHARACTERISTIC
/begin CHARACTERISTIC UEGO_rRPmpThdCpCalcn_C "Maximum threshold of pump cell inner resistance up to which C-learning is carried out" VALUE 0x805819B0 RB_Val_Wu16 6553.500 r_q0p1_Ohm 0.00 6553.500 FORMAT "%8.3" /end CHARACTERISTIC
/begin CHARACTERISTIC UEGO_rSnsrWrm_C "Resistance temperature where the sensor is warm enough to calculate the sensor resistance without ASIC MK clamping." VALUE 0x80581A00 RB_Val_Wu16 6553.500 r_q0p1_Ohm 0.00 6553.500 FORMAT "%8.3" /end CHARACTERISTIC
/begin CHARACTERISTIC UEGO_SnsrS1B1_I.idxTyp_C "Class instance of function UEGO_Snsr for Sensor 1 Bank 1 / Calibration sensor type" VALUE 0x805819CC RB_Val_Wu8 255.0 dez 0.00 255.0 FORMAT "%5.1" /end CHARACTERISTIC
/begin CHARACTERISTIC UEGO_stRNernst_C "" VALUE 0x80581848 RB_Val_Wu8 255.0 dez 0.00 255.0 FORMAT "%5.1" /end CHARACTERISTIC
/begin CHARACTERISTIC UEGO_stRPmpPlsOper_C "Codeword for feature activation inner resistance of pump cell" VALUE 0x805818E8 RB_Val_Wu8 255.0 OneToOne 0.00 255.0 FORMAT "%5.1" /end CHARACTERISTIC
/begin CHARACTERISTIC UEGO_stRPmp_C "Code word for Function UEGO_RPmp" VALUE 0x8058184A RB_Val_Wu8 255.0 OneToOne 0.00 255.0 FORMAT "%5.1" /end CHARACTERISTIC
/begin CHARACTERISTIC UEGO_stRvsChrgHiPrcsnBitMask_C "Bit mask for quality determination" VALUE 0x805819B2 RB_Val_Wu8 255.0 OneToOne 0.00 255.0 FORMAT "%5.1" /end CHARACTERISTIC
/begin CHARACTERISTIC UEGO_stRvsChrgVldBitMask_C "Bit mask for validity determination" VALUE 0x805819B3 RB_Val_Wu8 255.0 OneToOne 0.00 255.0 FORMAT "%5.1" /end CHARACTERISTIC
/begin CHARACTERISTIC UEGO_stRvsChrg_C "Bit status for feature activation of Reverse Charge Correction" VALUE 0x805819B4 RB_Val_Wu16 65535.00 OneToOne 0.00 65535.00 FORMAT "%8.2" /end CHARACTERISTIC
/begin CHARACTERISTIC UEGO_stSnsrMdlHot_C "Status bit mask for sensor model hot" VALUE 0x805819F4 RB_Val_Wu8 255.0 dez 0.00 255.0 FORMAT "%5.1" /end CHARACTERISTIC
/begin CHARACTERISTIC UEGO_stSwtTCeramicEnf_C "Switch to enforce certain input values for calculation" VALUE 0x80581A08 RB_Val_Wu8 255.0 OneToOne 0.00 255.0 FORMAT "%5.1" /end CHARACTERISTIC
/begin CHARACTERISTIC UEGO_tCeramicDeRvsChrg_C "Temperature Window for Reverse Charge Correction adaptation" VALUE 0x805819B6 RB_Val_Ws16 1535.977 temp_q0p0234 -768.0000 767.9766 FORMAT "%8.4" /end CHARACTERISTIC
/begin CHARACTERISTIC UEGO_tDeltaEgyLim_C "the delta temperature deviation" VALUE 0x805819F6 RB_Val_Wu16 1535.977 temp_q0p0234_o273 -273.150 1262.827 FORMAT "%8.3" /end CHARACTERISTIC
/begin CHARACTERISTIC UEGO_tiDlyEngStop_C "delay if the engine off time is not reseted synchoneouse with the engine stop" VALUE 0x805819FC RB_Val_Wu8 5.100 t_q0p02 0.00 5.100 FORMAT "%5.3" /end CHARACTERISTIC
/begin CHARACTERISTIC UEGO_tiMaxPwrLossExp_C "Maximal time until sensor is considered as not completely cold" VALUE 0x805819F8 RB_Val_Wu16 1000.000 t_q0p02 0.00 1000.000 FORMAT "%8.3" EXTENDED_LIMITS 0.00 1310.700 /end CHARACTERISTIC
/begin CHARACTERISTIC UEGO_tiMeasIPmpTM2Min_C "Special COrrection for TM2" VALUE 0x805819B8 RB_Val_Wu16 0.06553500 t_q0p000001_s 0.00 0.06553500 FORMAT "%10.8" /end CHARACTERISTIC
/begin CHARACTERISTIC UEGO_tiRCeramicVldyTurnOffDly_C "Turn off delay time for resetting the ceramic resistance" VALUE 0x80581A0A RB_Val_Wu16 327.6750 t_q0p005 0.00 327.6750 FORMAT "%8.4" /end CHARACTERISTIC
/begin CHARACTERISTIC UEGO_tiUi21MeasPosn_C "UEGO measurement position of Ui21 measurement" VALUE 0x805819BA RB_Val_Wu16 0.06553500 t_q0p000001_s 0.00 0.06553500 FORMAT "%10.8" /end CHARACTERISTIC
/begin CHARACTERISTIC UEGO_tRCeramic_T "Curve for calculating ceramics temperature out of ceramics resistance" CURVE 0x80581A0C RB_Curve_U16_U16 1535.977 temp_q0p0234_o273 -273.150 1262.827 FORMAT "%8.3"
 /begin AXIS_DESCR STD_AXIS NO_INPUT_QUANTITY r_q0p1_Ohm 22 0.00 6553.500 FORMAT "%8.3" DEPOSIT ABSOLUTE /end AXIS_DESCR
/end CHARACTERISTIC
/begin CHARACTERISTIC UEGO_tSnsrHotThd_C "Temperature threshold, which defines a hot sensor, resulting in DSQTCtrl and enabling of OL diagnosis." VALUE 0x805819FA RB_Val_Wu16 1535.977 temp_q0p0234_o273 -273.150 1262.827 FORMAT "%8.3" /end CHARACTERISTIC
/begin CHARACTERISTIC UEGO_TstrClassS1B1_I.stTstrCtl_C "Class tester release for lambda sensor 1 bank 1 / status, codeword for tester control" VALUE 0x80581A6C RB_Val_Wu8 255.0 dez 0.00 255.0 FORMAT "%5.1" /end CHARACTERISTIC
/begin CHARACTERISTIC UEGO_uDeltaUi22Ini_C "Initial value for Ui22 delta correction" VALUE 0x805819BC RB_Val_Ws16 20.97120 spg_q3p2Em4_V -10.48576 10.48544 FORMAT "%8.5" /end CHARACTERISTIC
/begin CHARACTERISTIC UEGO_uDeltaUi23Ini_C "Initial value for Ui23 delta correction" VALUE 0x805819BE RB_Val_Ws16 20.97120 spg_q3p2Em4_V -10.48576 10.48544 FORMAT "%8.5" /end CHARACTERISTIC
/begin CHARACTERISTIC UEGO_uDeltaUi24Ini_C "Initial value for Ui24 delta correction" VALUE 0x805819C0 RB_Val_Ws16 20.97120 spg_q3p2Em4_V -10.48576 10.48544 FORMAT "%8.5" /end CHARACTERISTIC
/begin CHARACTERISTIC UEGO_uDetrmtMinThd_C "Minimum threshold for determinant above which C-learning is done" VALUE 0x805819C4 RB_Val_Ws32 439.804651008 ASCET_10_RvsChrg -219.902325555 219.902325453 FORMAT "%13.9" /end CHARACTERISTIC
/begin MEASUREMENT UEGO_EngRunngDlyEFNM_I.oldSignal "Determination of a falling edge of flgEngRunng / memory to detect falling edge" UBYTE B_TRUE 1 100 0.00 1.00000000000 BIT_MASK 0x1 FORMAT "%13.11" ECU_ADDRESS 0x6000AD52 /end MEASUREMENT
/begin MEASUREMENT UEGO_facRNernstRPmpPlsOperS1B1 "Ratio of Nernstcell resistance to Pumpcell resistance" UWORD fak_q0p000244 1 100 0.00 15.99976 FORMAT "%8.5" ECU_ADDRESS 0x60008B70 /end MEASUREMENT
/begin MEASUREMENT UEGO_facRNernstRPmpS1B1 "Ratio of Nernstcell resistance to Pumpcell resistance" UWORD fak_q0p000244 1 100 0.00 15.99976 FORMAT "%8.5" ECU_ADDRESS 0x60008B6E /end MEASUREMENT
/begin MEASUREMENT UEGO_flgDeltaUnVldS1B1 "Valid flag of delta Un0 calculation in timing mode 1 and 2Lean or 2rich for calculation of inner resistance of nernst cell sensor 1 bank 1" UBYTE B_TRUE 1 100 0.00 1.00000000000 BIT_MASK 0x1 FORMAT "%13.11" ECU_ADDRESS 0x70000740 /end MEASUREMENT
/begin MEASUREMENT UEGO_flgRCeramicVldS1B1 "Validity of chosen ceramics resistance" UBYTE B_TRUE 1 100 0.00 1.00000000000 BIT_MASK 0x1 FORMAT "%13.11" ECU_ADDRESS 0x70000702 /end MEASUREMENT
/begin MEASUREMENT UEGO_flgRCmpPrsntS1B1 "Indication, if mounted Sensor has compensation resistor. Sensor 1 Bank 1" UBYTE B_TRUE 1 100 0.00 1.00000000000 BIT_MASK 0x1 FORMAT "%13.11" ECU_ADDRESS 0x70000701 /end MEASUREMENT
/begin MEASUREMENT UEGO_flgRNernstDiagVldS1B1 "diagnosis nernst cell resistance validity flag" UBYTE B_TRUE 1 100 0.00 1.00000000000 BIT_MASK 0x1 FORMAT "%13.11" ECU_ADDRESS 0x700006FE /end MEASUREMENT
/begin MEASUREMENT UEGO_flgRNernstHiPrcsnS1B1 "Flag inner resistance of nernst cell with high precision" UBYTE B_TRUE 1 100 0.00 1.00000000000 BIT_MASK 0x1 FORMAT "%13.11" ECU_ADDRESS 0x700006FD /end MEASUREMENT
/begin MEASUREMENT UEGO_flgRNernstRPmpPlsOperVldS1B1 "Validity of ratio of Nernstcell resistance to Pumpcell resistance" UBYTE B_TRUE 1 100 0.00 1.00000000000 BIT_MASK 0x1 FORMAT "%13.11" ECU_ADDRESS 0x700006FC /end MEASUREMENT
/begin MEASUREMENT UEGO_flgRNernstRPmpVldS1B1 "Validity of ratio of Nernstcell resistance to Pumpcell resistance" UBYTE B_TRUE 1 100 0.00 1.00000000000 BIT_MASK 0x1 FORMAT "%13.11" ECU_ADDRESS 0x700006FB /end MEASUREMENT
/begin MEASUREMENT UEGO_flgRNernstVldS1B1 "Valid flag of inner resistance of nernst cell sensor 1 bank 1" UBYTE B_TRUE 1 100 0.00 1.00000000000 BIT_MASK 0x1 FORMAT "%13.11" ECU_ADDRESS 0x700006FA /end MEASUREMENT
/begin MEASUREMENT UEGO_flgRPmpDiagVldS1B1 "Validity of inner resistance of pump cell sensor 1 bank 1" UBYTE B_TRUE 1 100 0.00 1.00000000000 BIT_MASK 0x1 FORMAT "%13.11" ECU_ADDRESS 0x700006F8 /end MEASUREMENT
/begin MEASUREMENT UEGO_flgRPmpHiPrcsnS1B1 "flag inner resistance of pump cell with high precision" UBYTE B_TRUE 1 100 0.00 1.00000000000 BIT_MASK 0x1 FORMAT "%13.11" ECU_ADDRESS 0x700006F7 /end MEASUREMENT
/begin MEASUREMENT UEGO_flgRPmpPlsOperDiagVldS1B1 "validity of inner resistance value of pum cell in pluse operation mode" UBYTE B_TRUE 1 100 0.00 1.00000000000 BIT_MASK 0x1 FORMAT "%13.11" ECU_ADDRESS 0x700006F6 /end MEASUREMENT
/begin MEASUREMENT UEGO_flgRPmpPlsOperHiPrcsnS1B1 "Inner resistance of pump cell in pulsed operation has high precision" UBYTE B_TRUE 1 100 0.00 1.00000000000 BIT_MASK 0x1 FORMAT "%13.11" ECU_ADDRESS 0x700006F5 /end MEASUREMENT
/begin MEASUREMENT UEGO_flgRPmpPlsOperVldS1B1 "flag inner resistance of pump cell in pulse operation calculated" UBYTE B_TRUE 1 100 0.00 1.00000000000 BIT_MASK 0x1 FORMAT "%13.11" ECU_ADDRESS 0x700006F4 /end MEASUREMENT
/begin MEASUREMENT UEGO_flgRPmpVldS1B1 "Validity of inner resistance of pump cell sensor 1 bank 1" UBYTE B_TRUE 1 100 0.00 1.00000000000 BIT_MASK 0x1 FORMAT "%13.11" ECU_ADDRESS 0x700006F3 /end MEASUREMENT
/begin MEASUREMENT UEGO_flgRvsChrgHiPrcsnS1B1 "UEGO Sensor 1 Bank 1 Reverse Charge Correction Quality information" UBYTE B_TRUE 1 100 0.00 1.00000000000 BIT_MASK 0x1 FORMAT "%13.11" ECU_ADDRESS 0x700006E9 /end MEASUREMENT
/begin MEASUREMENT UEGO_flgRvsChrgVldS1B1 "UEGO Sensor 1 Bank 1 Reverse Charge Correction Validity" UBYTE B_TRUE 1 100 0.00 1.00000000000 BIT_MASK 0x1 FORMAT "%13.11" ECU_ADDRESS 0x700006E8 /end MEASUREMENT
/begin MEASUREMENT UEGO_flgSnglCellS1B1 "Flag single cell lambda sensor, Sensor1 Bank1" UBYTE B_TRUE 1 100 0.00 1.00000000000 BIT_MASK 0x1 FORMAT "%13.11" ECU_ADDRESS 0x700006E7 /end MEASUREMENT
/begin MEASUREMENT UEGO_flgSnsrMdlAmbTS1B1 "Information if sensortemperature is above roomtemperatur for sensor 1 bank 1" UBYTE B_TRUE 1 100 0.00 1.00000000000 BIT_MASK 0x1 FORMAT "%13.11" ECU_ADDRESS 0x6000F06B /end MEASUREMENT
/begin MEASUREMENT UEGO_flgSnsrMdlHeatgUpFinshdS1B1 "modelled curve phase heating temparature reached during warm start for sensor 1 bank 1" UBYTE B_TRUE 1 100 0.00 1.00000000000 BIT_MASK 0x1 FORMAT "%13.11" ECU_ADDRESS 0x6000F06A /end MEASUREMENT
/begin MEASUREMENT UEGO_flgSnsrMdlHotS1B1 "Condition lambda sensor would be hot, Sensor1 Bank1" UBYTE B_TRUE 1 100 0.00 1.00000000000 BIT_MASK 0x1 FORMAT "%13.11" ECU_ADDRESS 0x6000F069 /end MEASUREMENT
/begin MEASUREMENT UEGO_flgSnsrMdlOverHeatgProtnS1B1 "Request for overheating protection, Sensor 1 Bank 1" UBYTE B_TRUE 1 100 0.00 1.00000000000 BIT_MASK 0x1 FORMAT "%13.11" ECU_ADDRESS 0x6000F068 /end MEASUREMENT
/begin MEASUREMENT UEGO_flgSnsrSuprtdS1B1 "Indication, if mounted Sensor is supported by software for Sensor 1 Bank 1" UBYTE B_TRUE 1 100 0.00 1.00000000000 BIT_MASK 0x1 FORMAT "%13.11" ECU_ADDRESS 0x700006E6 /end MEASUREMENT
/begin MEASUREMENT UEGO_flgTCeramicHiPrcsnS1B1 "Flag ceramic temperature is high precision" UBYTE B_TRUE 1 100 0.00 1.00000000000 BIT_MASK 0x1 FORMAT "%13.11" ECU_ADDRESS 0x700006E5 /end MEASUREMENT
/begin MEASUREMENT UEGO_flgTCeramicVldS1B1 "Validity of ceramic temperature sensor 1 bank 1" UBYTE B_TRUE 1 100 0.00 1.00000000000 BIT_MASK 0x1 FORMAT "%13.11" ECU_ADDRESS 0x700006E4 /end MEASUREMENT
/begin MEASUREMENT UEGO_flgTiEcuOffVld "Validity of the ECU off time UEGO_tiEcuOff" UBYTE B_TRUE 1 100 0.00 1.00000000000 BIT_MASK 0x1 FORMAT "%13.11" ECU_ADDRESS 0x6000F066 /end MEASUREMENT
/begin MEASUREMENT UEGO_flgTiEcuOffVldTmp "Validity of the ECU off time UEGO_tiEcuOff" UBYTE B_TRUE 1 100 0.00 1.00000000000 BIT_MASK 0x1 FORMAT "%13.11" ECU_ADDRESS 0x6000AD54 /end MEASUREMENT
/begin MEASUREMENT UEGO_flgTiEngOffVld "validity of the engine of time UEGO_tiEngOff" UBYTE B_TRUE 1 100 0.00 1.00000000000 BIT_MASK 0x1 FORMAT "%13.11" ECU_ADDRESS 0x6000F065 /end MEASUREMENT
/begin MEASUREMENT UEGO_flgTiHeatrOffVldS1B1 "Validity flag of tiHeatrOffS1B1" UBYTE B_TRUE 1 100 0.00 1.00000000000 BIT_MASK 0x1 FORMAT "%13.11" ECU_ADDRESS 0x6000F064 /end MEASUREMENT
/begin MEASUREMENT UEGO_flgTstrRelsS1B1 "Release heater control through Tester (ATS, Shorttrip, Calibration or Servicetester) for Sensor 1 Bank 1" UBYTE B_TRUE 1 100 0.00 1.00000000000 BIT_MASK 0x1 FORMAT "%13.11" ECU_ADDRESS 0x700006E0 /end MEASUREMENT
/begin MEASUREMENT UEGO_flgUHeatrVld "Gültigkeitsflag der Heizer-Versorgungsspannung der Lambda-Sonde" UBYTE B_TRUE 1 100 0.00 1.00000000000 BIT_MASK 0x1 FORMAT "%13.11" ECU_ADDRESS 0x6000F063 /end MEASUREMENT
/begin MEASUREMENT UEGO_idxTypS1B1 "sensor type sensor 1 bank 1" UBYTE UEGO_SNSRType_COMPU_VERB 1 100 0.00 22.0000000000 FORMAT "%13.10" ECU_ADDRESS 0x6000EF1C /end MEASUREMENT
/begin MEASUREMENT UEGO_iRvsChrgAryS1B1 "UEGO Sensor 1 Bank 1 Reverse Charge Correction Array" SWORD i_q6p6667Em7_A 1 100 -0.02184533 0.02184467 FORMAT "%10.8" ARRAY_SIZE 15 ECU_ADDRESS 0x60008E46 /end MEASUREMENT
/begin MEASUREMENT UEGO_rCeramicS1B1 "selected sensor resistance for temperature calculation sensor 1 bank 1" UWORD r_q0p1_Ohm 1 100 0.00 6553.500 FORMAT "%8.3" ECU_ADDRESS 0x60008B64 /end MEASUREMENT
/begin MEASUREMENT UEGO_RNernstEvlnS1B1_I.flgDeltaUnVld "Class instance of the functional class of FC UEGO_RNernst for sensor 1 bank 1 / Valid flag of delta Un0 calculation in timing mode 1 and 2Lean or 2rich for calculation of inner resistance of nernst cell sensor 1 bank 1" UBYTE B_TRUE 1 100 0.00 1.00000000000 BIT_MASK 0x1 FORMAT "%13.11" ECU_ADDRESS 0x60002018 /end MEASUREMENT
/begin MEASUREMENT UEGO_RNernstEvlnS1B1_I.flgIsqrNernstSmall "Class instance of the functional class of FC UEGO_RNernst for sensor 1 bank 1 / Isqr Nernst value to small for resistance calculation - resistance will be set to maximum" UBYTE B_TRUE 1 100 0.00 1.00000000000 BIT_MASK 0x1 FORMAT "%13.11" ECU_ADDRESS 0x60002019 /end MEASUREMENT
/begin MEASUREMENT UEGO_RNernstEvlnS1B1_I.flgRNernstDiagFildVld "Class instance of the functional class of FC UEGO_RNernst for sensor 1 bank 1 / Resistance for diagnosis path valid" UBYTE B_TRUE 1 100 0.00 1.00000000000 BIT_MASK 0x1 FORMAT "%13.11" ECU_ADDRESS 0x6000201A /end MEASUREMENT
/begin MEASUREMENT UEGO_RNernstEvlnS1B1_I.flgRNernstDiagVld "Class instance of the functional class of FC UEGO_RNernst for sensor 1 bank 1 / diagnosis nernst cell resistance validity flag" UBYTE B_TRUE 1 100 0.00 1.00000000000 BIT_MASK 0x1 FORMAT "%13.11" ECU_ADDRESS 0x6000201B /end MEASUREMENT
/begin MEASUREMENT UEGO_RNernstEvlnS1B1_I.flgRNernstFildVld "Class instance of the functional class of FC UEGO_RNernst for sensor 1 bank 1 / Nernst cell resistance valid flag" UBYTE B_TRUE 1 100 0.00 1.00000000000 BIT_MASK 0x1 FORMAT "%13.11" ECU_ADDRESS 0x6000201C /end MEASUREMENT
/begin MEASUREMENT UEGO_RNernstEvlnS1B1_I.flgRNernstHiPrcsn "Class instance of the functional class of FC UEGO_RNernst for sensor 1 bank 1 / Flag inner resistance of nernst cell with high precision" UBYTE B_TRUE 1 100 0.00 1.00000000000 BIT_MASK 0x1 FORMAT "%13.11" ECU_ADDRESS 0x6000201D /end MEASUREMENT
/begin MEASUREMENT UEGO_RNernstEvlnS1B1_I.flgRNernstVld "Class instance of the functional class of FC UEGO_RNernst for sensor 1 bank 1 / Nernst cell resistance valid flag" UBYTE B_TRUE 1 100 0.00 1.00000000000 BIT_MASK 0x1 FORMAT "%13.11" ECU_ADDRESS 0x6000201E /end MEASUREMENT
/begin MEASUREMENT UEGO_RNernstEvlnS1B1_I.isqrNernst "Class instance of the functional class of FC UEGO_RNernst for sensor 1 bank 1 / Current used for resistance evaluation" SWORD i_q6p667Em8_A 1 100 -0.002184533 0.002184467 FORMAT "%11.9" ECU_ADDRESS 0x60002020 /end MEASUREMENT
/begin MEASUREMENT UEGO_RNernstEvlnS1B1_I.isqrNernstDiag "Class instance of the functional class of FC UEGO_RNernst for sensor 1 bank 1 / Current at nernst for diagnosis" SWORD i_q6p667Em8_A 1 100 -0.002184533 0.002184467 FORMAT "%11.9" ECU_ADDRESS 0x60002022 /end MEASUREMENT
/begin MEASUREMENT UEGO_RNernstEvlnS1B1_I.nrModInt "Class instance of the functional class of FC UEGO_RNernst for sensor 1 bank 1 / Internal mode of inner resistance of nernst cell" UBYTE RNERNST_COMPU_VERB 1 100 0.00 24.0000000000 FORMAT "%13.10" ECU_ADDRESS 0x60002024 /end MEASUREMENT
/begin MEASUREMENT UEGO_RNernstEvlnS1B1_I.rRNernst "Class instance of the functional class of FC UEGO_RNernst for sensor 1 bank 1 / Inner resistance of nernst cell" UWORD r_q0p1_Ohm 1 100 0.00 6553.500 FORMAT "%8.3" ECU_ADDRESS 0x60002026 /end MEASUREMENT
/begin MEASUREMENT UEGO_RNernstEvlnS1B1_I.rRNernstDiag "Class instance of the functional class of FC UEGO_RNernst for sensor 1 bank 1 / diagnosis nernst cell resistance" UWORD r_q0p1_Ohm 1 100 0.00 6553.500 FORMAT "%8.3" ECU_ADDRESS 0x60002028 /end MEASUREMENT
/begin MEASUREMENT UEGO_RNernstEvlnS1B1_I.rRNernstDiagFild "Class instance of the functional class of FC UEGO_RNernst for sensor 1 bank 1 / diagnosis nernst cell resistance filtered" UWORD r_q0p1_Ohm 1 100 0.00 6553.500 FORMAT "%8.3" ECU_ADDRESS 0x6000202A /end MEASUREMENT
/begin MEASUREMENT UEGO_RNernstEvlnS1B1_I.rRNernstDiagFildAry "Class instance of the functional class of FC UEGO_RNernst for sensor 1 bank 1 / diagnosis nernst cell resistance filtered array" UWORD r_q0p1_Ohm 1 100 0.00 6553.500 FORMAT "%8.3" ARRAY_SIZE 5 ECU_ADDRESS 0x6000202C /end MEASUREMENT
/begin MEASUREMENT UEGO_RNernstEvlnS1B1_I.rRNernstDiagOld "Class instance of the functional class of FC UEGO_RNernst for sensor 1 bank 1 / diagnosis nernst cell resistance filtered array" UWORD r_q0p1_Ohm 1 100 0.00 6553.500 FORMAT "%8.3" ECU_ADDRESS 0x60002036 /end MEASUREMENT
/begin MEASUREMENT UEGO_RNernstEvlnS1B1_I.rRNernstFild "Class instance of the functional class of FC UEGO_RNernst for sensor 1 bank 1 / Filtered inner resistance of nernst cell" UWORD r_q0p1_Ohm 1 100 0.00 6553.500 FORMAT "%8.3" ECU_ADDRESS 0x60002038 /end MEASUREMENT
/begin MEASUREMENT UEGO_RNernstEvlnS1B1_I.rRNernstRawAry "Class instance of the functional class of FC UEGO_RNernst for sensor 1 bank 1 / Raw value inner resistance of nernst cell" UWORD r_q0p1_Ohm 1 100 0.00 6553.500 FORMAT "%8.3" ARRAY_SIZE 5 ECU_ADDRESS 0x6000203A /end MEASUREMENT
/begin MEASUREMENT UEGO_RNernstEvlnS1B1_I.rRNernstRawDiagAry "Class instance of the functional class of FC UEGO_RNernst for sensor 1 bank 1 / Raw nernst resistance array for diagnosis" UWORD r_q0p1_Ohm 1 100 0.00 6553.500 FORMAT "%8.3" ARRAY_SIZE 5 ECU_ADDRESS 0x60002044 /end MEASUREMENT
/begin MEASUREMENT UEGO_RNernstEvlnS1B1_I.stDeltaUnRawAryVld "Class instance of the functional class of FC UEGO_RNernst for sensor 1 bank 1 / Status of voltage delta Un0 calculation in timing mode 1 and 2Lean or 2rich for calculation of inner resistance of nernst cell" UWORD dez 1 100 0.00 65535.00 FORMAT "%8.2" ECU_ADDRESS 0x6000204E /end MEASUREMENT
/begin MEASUREMENT UEGO_RNernstEvlnS1B1_I.stRNernstRawAryVld "Class instance of the functional class of FC UEGO_RNernst for sensor 1 bank 1 / Nernst cell resistance valid status" UWORD dez 1 100 0.00 65535.00 FORMAT "%8.2" ECU_ADDRESS 0x60002050 /end MEASUREMENT
/begin MEASUREMENT UEGO_RNernstEvlnS1B1_I.uDeltaUn "Class instance of the functional class of FC UEGO_RNernst for sensor 1 bank 1 / Voltage Delta Un of inner resistance of nernst cell" SWORD spg_q3p2Em4_V 1 100 -10.48576 10.48544 FORMAT "%8.5" ECU_ADDRESS 0x60002052 /end MEASUREMENT
/begin MEASUREMENT UEGO_RNernstEvlnS1B1_I.uDeltaUnRawAry "Class instance of the functional class of FC UEGO_RNernst for sensor 1 bank 1 / Raw value of the voltage delta Un calculation in timing mode 1 and 2Lean or 2rich for calculation of inner resistance of nernst cell" SWORD spg_q3p2Em4_V 1 100 -10.48576 10.48544 FORMAT "%8.5" ARRAY_SIZE 5 ECU_ADDRESS 0x60002054 /end MEASUREMENT
/begin MEASUREMENT UEGO_RNernstEvlnS1B1_I.uNernst "Class instance of the functional class of FC UEGO_RNernst for sensor 1 bank 1 / nernst voltage for nernst cell resistant calculation" ULONG spg_q3p2Em4_V 1 100 0.00 687194.767040 FORMAT "%13.6" ECU_ADDRESS 0x60002060 /end MEASUREMENT
/begin MEASUREMENT UEGO_RNernstEvlnS1B1_I.UEGO_RNernstEvlnPeakFilClass.flgFilStrtd "Class instance of the functional class of FC UEGO_RNernst for sensor 1 bank 1 / filter class / filter start flag" UBYTE B_TRUE 1 100 0.00 1.00000000000 BIT_MASK 0x1 FORMAT "%13.11" ECU_ADDRESS 0x60002064 /end MEASUREMENT
/begin MEASUREMENT UEGO_RNernstEvlnS1B1_I.UEGO_RNernstEvlnPeakFilClass.rDeltaInOutpMax "Class instance of the functional class of FC UEGO_RNernst for sensor 1 bank 1 / filter class / maximum filter delta value" SWORD r_q0p1_Ohm 1 100 -3276.800 3276.700 FORMAT "%8.3" ECU_ADDRESS 0x60002066 /end MEASUREMENT
/begin MEASUREMENT UEGO_RPmpCtrlS1B1_I.flgUria "Class instance of the functional class of FC UEGO_RPmp for Bank 1 Sensor 1 / status of the Uria flag of ASIC" UBYTE B_TRUE 1 100 0.00 1.00000000000 BIT_MASK 0x1 FORMAT "%13.11" ECU_ADDRESS 0x600065EA /end MEASUREMENT
/begin MEASUREMENT UEGO_RPmpCtrlS1B1_I.flgUriaAcptd "Class instance of the functional class of FC UEGO_RPmp for Bank 1 Sensor 1 / transmission status of the Uria flag to ASIC" UBYTE B_TRUE 1 100 0.00 1.00000000000 BIT_MASK 0x1 FORMAT "%13.11" ECU_ADDRESS 0x600065EB /end MEASUREMENT
/begin MEASUREMENT UEGO_RPmpCtrlS1B1_I.nrModIntCtrl "Class instance of the functional class of FC UEGO_RPmp for Bank 1 Sensor 1 / Internal mode of inner resistance calculation of pump cell" UBYTE UEGO_RPmpModIntCtrl_COMPU_VERB 1 100 0.00 6.00000000000 FORMAT "%13.11" ECU_ADDRESS 0x600065EC /end MEASUREMENT
/begin MEASUREMENT UEGO_RPmpEvlnS1B1_I.flgRPmpDiagFildVld "Class instance of the functional class of FC UEGO_RPmp for Bank 1 Sensor 1 / Validity flag of Rpmp diagnosis filtered" UBYTE B_TRUE 1 100 0.00 1.00000000000 BIT_MASK 0x1 FORMAT "%13.11" ECU_ADDRESS 0x600065CA /end MEASUREMENT
/begin MEASUREMENT UEGO_RPmpEvlnS1B1_I.flgRPmpDiagVld "Class instance of the functional class of FC UEGO_RPmp for Bank 1 Sensor 1 / Validity of inner resistance of pump cell sensor 1 bank 1" UBYTE B_TRUE 1 100 0.00 1.00000000000 BIT_MASK 0x1 FORMAT "%13.11" ECU_ADDRESS 0x600065CB /end MEASUREMENT
/begin MEASUREMENT UEGO_RPmpEvlnS1B1_I.flgRPmpFildVld "Class instance of the functional class of FC UEGO_RPmp for Bank 1 Sensor 1 / Validity flag of Rpmp filtered" UBYTE B_TRUE 1 100 0.00 1.00000000000 BIT_MASK 0x1 FORMAT "%13.11" ECU_ADDRESS 0x600065CC /end MEASUREMENT
/begin MEASUREMENT UEGO_RPmpEvlnS1B1_I.flgRPmpHiPrcsn "Class instance of the functional class of FC UEGO_RPmp for Bank 1 Sensor 1 / flag inner resistance of pump cell with high precision" UBYTE B_TRUE 1 100 0.00 1.00000000000 BIT_MASK 0x1 FORMAT "%13.11" ECU_ADDRESS 0x600065CD /end MEASUREMENT
/begin MEASUREMENT UEGO_RPmpEvlnS1B1_I.flgRPmpVld "Class instance of the functional class of FC UEGO_RPmp for Bank 1 Sensor 1 / Validity of inner resistance of pump cell sensor 1 bank 1" UBYTE B_TRUE 1 100 0.00 1.00000000000 BIT_MASK 0x1 FORMAT "%13.11" ECU_ADDRESS 0x600065CE /end MEASUREMENT
/begin MEASUREMENT UEGO_RPmpEvlnS1B1_I.isqrPmp "Class instance of the functional class of FC UEGO_RPmp for Bank 1 Sensor 1 / reference pump current" SWORD i_q6p667Em8_A 1 100 -0.002184533 0.002184467 FORMAT "%11.9" ECU_ADDRESS 0x600065D0 /end MEASUREMENT
/begin MEASUREMENT UEGO_RPmpEvlnS1B1_I.isqrPmpDiag "Class instance of the functional class of FC UEGO_RPmp for Bank 1 Sensor 1 / Current at pump cell for diagnosis" SWORD i_q6p667Em8_A 1 100 -0.002184533 0.002184467 FORMAT "%11.9" ECU_ADDRESS 0x600065D2 /end MEASUREMENT
/begin MEASUREMENT UEGO_RPmpEvlnS1B1_I.nrModIntEvln "Class instance of the functional class of FC UEGO_RPmp for Bank 1 Sensor 1 / Internal mode of inner resistance calculation of pump cell" UBYTE UEGO_RPmpModIntEvln_COMPU_VERB 1 100 0.00 11.0000000000 FORMAT "%13.10" ECU_ADDRESS 0x600065D4 /end MEASUREMENT
/begin MEASUREMENT UEGO_RPmpEvlnS1B1_I.rRPmp "Class instance of the functional class of FC UEGO_RPmp for Bank 1 Sensor 1 / Inner resistance of pump cell" UWORD r_q0p1_Ohm 1 100 0.00 6553.500 FORMAT "%8.3" ECU_ADDRESS 0x600065D6 /end MEASUREMENT
/begin MEASUREMENT UEGO_RPmpEvlnS1B1_I.rRPmpDiag "Class instance of the functional class of FC UEGO_RPmp for Bank 1 Sensor 1 / Inner resistance of pump cell" UWORD r_q0p1_Ohm 1 100 0.00 6553.500 FORMAT "%8.3" ECU_ADDRESS 0x600065D8 /end MEASUREMENT
/begin MEASUREMENT UEGO_RPmpEvlnS1B1_I.rRPmpDiagFild "Class instance of the functional class of FC UEGO_RPmp for Bank 1 Sensor 1 / Filtered inner resistance of pump cell" UWORD r_q0p1_Ohm 1 100 0.00 6553.500 FORMAT "%8.3" ECU_ADDRESS 0x600065DA /end MEASUREMENT
/begin MEASUREMENT UEGO_RPmpEvlnS1B1_I.rRPmpDiagRaw "Class instance of the functional class of FC UEGO_RPmp for Bank 1 Sensor 1 / Raw values of inner resistance of pump cell" UWORD r_q0p1_Ohm 1 100 0.00 6553.500 FORMAT "%8.3" ECU_ADDRESS 0x600065DC /end MEASUREMENT
/begin MEASUREMENT UEGO_RPmpEvlnS1B1_I.rRPmpFild "Class instance of the functional class of FC UEGO_RPmp for Bank 1 Sensor 1 / Filtered inner resistance of pump cell" UWORD r_q0p1_Ohm 1 100 0.00 6553.500 FORMAT "%8.3" ECU_ADDRESS 0x600065DE /end MEASUREMENT
/begin MEASUREMENT UEGO_RPmpEvlnS1B1_I.rRPmpRaw "Class instance of the functional class of FC UEGO_RPmp for Bank 1 Sensor 1 / Raw value of inner resistance of pump cell" UWORD r_q0p1_Ohm 1 100 0.00 6553.500 FORMAT "%8.3" ECU_ADDRESS 0x600065E0 /end MEASUREMENT
/begin MEASUREMENT UEGO_RPmpEvlnS1B1_I.stRPmpRawAryClcd "Class instance of the functional class of FC UEGO_RPmp for Bank 1 Sensor 1 / Pump cell resistance validity status" UBYTE OneToOne 1 100 0.00 255.0 FORMAT "%5.1" ECU_ADDRESS 0x600065E2 /end MEASUREMENT
/begin MEASUREMENT UEGO_RPmpEvlnS1B1_I.uPmp "Class instance of the functional class of FC UEGO_RPmp for Bank 1 Sensor 1 / pump cell voltage" UWORD spg_q3p2Em4_V 1 100 0.00 10.48544 FORMAT "%8.5" ECU_ADDRESS 0x600065E4 /end MEASUREMENT
/begin MEASUREMENT UEGO_RPmpEvlnS1B1_I.UEGO_RPmpEvlnPeakFilClass.flgFilStrtd "Class instance of the functional class of FC UEGO_RPmp for Bank 1 Sensor 1 / Peak filter / trigger to start peak filter" UBYTE B_TRUE 1 100 0.00 1.00000000000 BIT_MASK 0x1 FORMAT "%13.11" ECU_ADDRESS 0x600065E6 /end MEASUREMENT
/begin MEASUREMENT UEGO_RPmpEvlnS1B1_I.UEGO_RPmpEvlnPeakFilClass.rDeltaInOutpMax "Class instance of the functional class of FC UEGO_RPmp for Bank 1 Sensor 1 / Peak filter / Start value of Peak filter" SWORD r_q0p1_Ohm 1 100 -3276.800 3276.700 FORMAT "%8.3" ECU_ADDRESS 0x600065E8 /end MEASUREMENT
/begin MEASUREMENT UEGO_RPmpPlsOperS1B1_I.flgRPmpPlsOperDiagVld "Class instance of the functional class of FC UEGO_RPmpPlsOper for Bank 1 Sensor 1 / validity of resistance value for diagnose" UBYTE B_TRUE 1 100 0.00 1.00000000000 BIT_MASK 0x1 FORMAT "%13.11" ECU_ADDRESS 0x60006566 /end MEASUREMENT
/begin MEASUREMENT UEGO_RPmpPlsOperS1B1_I.flgRPmpPlsOperFildLoPrcsn "Class instance of the functional class of FC UEGO_RPmpPlsOper for Bank 1 Sensor 1 / Low precision of filtered resistance value" UBYTE B_TRUE 1 100 0.00 1.00000000000 BIT_MASK 0x1 FORMAT "%13.11" ECU_ADDRESS 0x60006567 /end MEASUREMENT
/begin MEASUREMENT UEGO_RPmpPlsOperS1B1_I.flgRPmpPlsOperFildVld "Class instance of the functional class of FC UEGO_RPmpPlsOper for Bank 1 Sensor 1 / Validity of filtered resistance value" UBYTE B_TRUE 1 100 0.00 1.00000000000 BIT_MASK 0x1 FORMAT "%13.11" ECU_ADDRESS 0x60006568 /end MEASUREMENT
/begin MEASUREMENT UEGO_RPmpPlsOperS1B1_I.flgRPmpPlsOperHiPrcsn "Class instance of the functional class of FC UEGO_RPmpPlsOper for Bank 1 Sensor 1 / High precision of filtered resistance value" UBYTE B_TRUE 1 100 0.00 1.00000000000 BIT_MASK 0x1 FORMAT "%13.11" ECU_ADDRESS 0x60006569 /end MEASUREMENT
/begin MEASUREMENT UEGO_RPmpPlsOperS1B1_I.flgRPmpPlsOperVld "Class instance of the functional class of FC UEGO_RPmpPlsOper for Bank 1 Sensor 1 / Validity condition inner resistance of pump cell in pulse operation" UBYTE B_TRUE 1 100 0.00 1.00000000000 BIT_MASK 0x1 FORMAT "%13.11" ECU_ADDRESS 0x6000656A /end MEASUREMENT
/begin MEASUREMENT UEGO_RPmpPlsOperS1B1_I.nrModInt "Class instance of the functional class of FC UEGO_RPmpPlsOper for Bank 1 Sensor 1 / internal Mode" UBYTE RPMPPLSOPER_COMPU_VERB 1 100 1.0000000000 32.0000000000 FORMAT "%13.10" ECU_ADDRESS 0x6000656B /end MEASUREMENT
/begin MEASUREMENT UEGO_RPmpPlsOperS1B1_I.nrURPmpPlsOper "Class instance of the functional class of FC UEGO_RPmpPlsOper for Bank 1 Sensor 1 / number of voltage measurements" UBYTE dez 1 100 0.00 255.0 FORMAT "%5.1" ECU_ADDRESS 0x6000656C /end MEASUREMENT
/begin MEASUREMENT UEGO_RPmpPlsOperS1B1_I.rRPmpPlsOper "Class instance of the functional class of FC UEGO_RPmpPlsOper for Bank 1 Sensor 1 / Inner resistance of pump cell in pulse operation" UWORD r_q0p1_Ohm 1 100 0.00 6553.500 FORMAT "%8.3" ECU_ADDRESS 0x6000656E /end MEASUREMENT
/begin MEASUREMENT UEGO_RPmpPlsOperS1B1_I.rRPmpPlsOperDiag "Class instance of the functional class of FC UEGO_RPmpPlsOper for Bank 1 Sensor 1 / resistance value for diagnose" UWORD r_q0p1_Ohm 1 100 0.00 6553.500 FORMAT "%8.3" ECU_ADDRESS 0x60006570 /end MEASUREMENT
/begin MEASUREMENT UEGO_RPmpPlsOperS1B1_I.rRPmpPlsOperDiagFild "Class instance of the functional class of FC UEGO_RPmpPlsOper for Bank 1 Sensor 1 / resistance value for diagnosefiltered" UWORD r_q0p1_Ohm 1 100 0.00 6553.500 FORMAT "%8.3" ECU_ADDRESS 0x60006572 /end MEASUREMENT
/begin MEASUREMENT UEGO_RPmpPlsOperS1B1_I.rRPmpPlsOperDiagFildAry "Class instance of the functional class of FC UEGO_RPmpPlsOper for Bank 1 Sensor 1 / resistance value for diagnose filtered array" UWORD r_q0p1_Ohm 1 100 0.00 6553.500 FORMAT "%8.3" ARRAY_SIZE 8 ECU_ADDRESS 0x60006574 /end MEASUREMENT
/begin MEASUREMENT UEGO_RPmpPlsOperS1B1_I.rRPmpPlsOperDiagFildOld "Class instance of the functional class of FC UEGO_RPmpPlsOper for Bank 1 Sensor 1 / old resistance value for diagnose filtered array" UWORD r_q0p1_Ohm 1 100 0.00 6553.500 FORMAT "%8.3" ECU_ADDRESS 0x60006584 /end MEASUREMENT
/begin MEASUREMENT UEGO_RPmpPlsOperS1B1_I.rRPmpPlsOperDiagRawAry "Class instance of the functional class of FC UEGO_RPmpPlsOper for Bank 1 Sensor 1 / resistance value for diagnose array" UWORD r_q0p1_Ohm 1 100 0.00 6553.500 FORMAT "%8.3" ARRAY_SIZE 8 ECU_ADDRESS 0x60006586 /end MEASUREMENT
/begin MEASUREMENT UEGO_RPmpPlsOperS1B1_I.rRPmpPlsOperFild "Class instance of the functional class of FC UEGO_RPmpPlsOper for Bank 1 Sensor 1 / filtered inner resistance of pump cell in pulse operation" UWORD r_q0p1_Ohm 1 100 0.00 6553.500 FORMAT "%8.3" ECU_ADDRESS 0x60006596 /end MEASUREMENT
/begin MEASUREMENT UEGO_RPmpPlsOperS1B1_I.rRPmpPlsOperRawAry "Class instance of the functional class of FC UEGO_RPmpPlsOper for Bank 1 Sensor 1 / raw resistance array" UWORD r_q0p1_Ohm 1 100 0.00 6553.500 FORMAT "%8.3" ARRAY_SIZE 8 ECU_ADDRESS 0x60006598 /end MEASUREMENT
/begin MEASUREMENT UEGO_RPmpPlsOperS1B1_I.stRPmpPlsOperRawAryVld "Class instance of the functional class of FC UEGO_RPmpPlsOper for Bank 1 Sensor 1 / validity of raw resistance array" UWORD dez 1 100 0.00 65535.00 FORMAT "%8.2" ECU_ADDRESS 0x600065A8 /end MEASUREMENT
/begin MEASUREMENT UEGO_RPmpPlsOperS1B1_I.stRPmpPlsOperRawLoPrcsnAry "Class instance of the functional class of FC UEGO_RPmpPlsOper for Bank 1 Sensor 1 / Low precision of raw resistance array" UWORD dez 1 100 0.00 65535.00 FORMAT "%8.2" ECU_ADDRESS 0x600065AA /end MEASUREMENT
/begin MEASUREMENT UEGO_RPmpPlsOperS1B1_I.stURPmpPlsOperAryPrsnt "Class instance of the functional class of FC UEGO_RPmpPlsOper for Bank 1 Sensor 1 / existing values in voltage array" UWORD dez 1 100 0.00 65535.00 FORMAT "%8.2" ECU_ADDRESS 0x600065AC /end MEASUREMENT
/begin MEASUREMENT UEGO_RPmpPlsOperS1B1_I.stURPmpPlsOperLoPrcsnAry "Class instance of the functional class of FC UEGO_RPmpPlsOper for Bank 1 Sensor 1 / low precision values in voltage array" UWORD dez 1 100 0.00 65535.00 FORMAT "%8.2" ECU_ADDRESS 0x600065AE /end MEASUREMENT
/begin MEASUREMENT UEGO_RPmpPlsOperS1B1_I.uU1RPmpPlsOperAry "Class instance of the functional class of FC UEGO_RPmpPlsOper for Bank 1 Sensor 1 / first voltage" SWORD spg_q3p2Em4_V 1 100 -10.48576 10.48544 FORMAT "%8.5" ARRAY_SIZE 5 ECU_ADDRESS 0x600065B0 /end MEASUREMENT
/begin MEASUREMENT UEGO_RPmpPlsOperS1B1_I.uU2RPmpPlsOperAry "Class instance of the functional class of FC UEGO_RPmpPlsOper for Bank 1 Sensor 1 / seconde voltage" SWORD spg_q3p2Em4_V 1 100 -10.48576 10.48544 FORMAT "%8.5" ARRAY_SIZE 5 ECU_ADDRESS 0x600065BA /end MEASUREMENT
/begin MEASUREMENT UEGO_RPmpPlsOperS1B1_I.uURPmp "Class instance of the functional class of FC UEGO_RPmpPlsOper for Bank 1 Sensor 1 / resulting voltage" UWORD spg_q3p2Em4_V 1 100 0.00 10.48544 FORMAT "%8.5" ECU_ADDRESS 0x600065C4 /end MEASUREMENT
/begin MEASUREMENT UEGO_RPmpPlsOperS1B1_I.UEGO_RPmpPlsOpertEvlnPeakFilClass.flgFilStrtd "Class instance of the functional class of FC UEGO_RPmpPlsOper for Bank 1 Sensor 1 / peak filter / filter parameter" UBYTE B_TRUE 1 100 0.00 1.00000000000 BIT_MASK 0x1 FORMAT "%13.11" ECU_ADDRESS 0x600065C6 /end MEASUREMENT
/begin MEASUREMENT UEGO_RPmpPlsOperS1B1_I.UEGO_RPmpPlsOpertEvlnPeakFilClass.rDeltaInOutpMax "Class instance of the functional class of FC UEGO_RPmpPlsOper for Bank 1 Sensor 1 / peak filter / filter parameter" SWORD r_q0p1_Ohm 1 100 -3276.800 3276.700 FORMAT "%8.3" ECU_ADDRESS 0x600065C8 /end MEASUREMENT
/begin MEASUREMENT UEGO_rRNernstDiagS1B1 "diagnosis nernst cell resistance sensor 1 bank 1" UWORD r_q0p1_Ohm 1 100 0.00 6553.500 FORMAT "%8.3" ECU_ADDRESS 0x60008B60 /end MEASUREMENT
/begin MEASUREMENT UEGO_rRNernstS1B1 "Inner resistance of nernst cell sensor 1 bank 1" UWORD r_q0p1_Ohm 1 100 0.00 6553.500 FORMAT "%8.3" ECU_ADDRESS 0x60008B5E /end MEASUREMENT
/begin MEASUREMENT UEGO_rRPmpDiagS1B1 "Inner resistance of pump cell sensor 1 bank 1" UWORD r_q0p1_Ohm 1 100 0.00 6553.500 FORMAT "%8.3" ECU_ADDRESS 0x60008B5A /end MEASUREMENT
/begin MEASUREMENT UEGO_rRPmpPlsOperDiagS1B1 "inner resistance value of pum cell in pluse operation mode" UWORD r_q0p1_Ohm 1 100 0.00 6553.500 FORMAT "%8.3" ECU_ADDRESS 0x60008B58 /end MEASUREMENT
/begin MEASUREMENT UEGO_rRPmpPlsOperS1B1 "Inner resistance of pump cell in pulse operation" UWORD r_q0p1_Ohm 1 100 0.00 6553.500 FORMAT "%8.3" ECU_ADDRESS 0x60008B56 /end MEASUREMENT
/begin MEASUREMENT UEGO_rRPmpS1B1 "Inner resistance of pump cell sensor 1 bank 1" UWORD r_q0p1_Ohm 1 100 0.00 6553.500 FORMAT "%8.3" ECU_ADDRESS 0x60008B54 /end MEASUREMENT
/begin MEASUREMENT UEGO_RvsChrgS1B1_I.cntrCpCalc "UEGO Sensor 1 Bank 1 Reverse Charge Correction Functional Class Instance / Counter position for C-learning array. This indicates the number of times C-learning was carried once steered mode was activated." UBYTE OneToOne 1 100 0.00 255.0 FORMAT "%5.1" ECU_ADDRESS 0x60001EE0 /end MEASUREMENT
/begin MEASUREMENT UEGO_RvsChrgS1B1_I.cpCamg "UEGO Sensor 1 Bank 1 Reverse Charge Correction Functional Class Instance / Camg Capacity" UWORD q1Em10_F 1 100 0.00 0.000006553500 FORMAT "%14.12" ECU_ADDRESS 0x60038A80 /end MEASUREMENT
/begin MEASUREMENT UEGO_RvsChrgS1B1_I.cpCamgRaw "UEGO Sensor 1 Bank 1 Reverse Charge Correction Functional Class Instance / Camg Capacity Raw Value" UWORD q1Em10_F 1 100 0.00 0.000006553500 FORMAT "%14.12" ECU_ADDRESS 0x60001EE2 /end MEASUREMENT
/begin MEASUREMENT UEGO_RvsChrgS1B1_I.cpCig "UEGO Sensor 1 Bank 1 Reverse Charge Correction Functional Class Instance / Cig Capacity" UWORD q1Em10_F 1 100 0.00 0.000006553500 FORMAT "%14.12" ECU_ADDRESS 0x60038A82 /end MEASUREMENT
/begin MEASUREMENT UEGO_RvsChrgS1B1_I.cpCigRaw "UEGO Sensor 1 Bank 1 Reverse Charge Correction Functional Class Instance / Cig Capacity Raw Value" UWORD q1Em10_F 1 100 0.00 0.000006553500 FORMAT "%14.12" ECU_ADDRESS 0x60001EE4 /end MEASUREMENT
/begin MEASUREMENT UEGO_RvsChrgS1B1_I.cpCorrnRaw "UEGO Sensor 1 Bank 1 Reverse Charge Correction Functional Class Instance / Correction for capacitance calculation based on tau" FLOAT32_IEEE OneToOne 1 100 -2147483648.000 2147483647.000 FORMAT "%13.3" ECU_ADDRESS 0x60001EE8 /end MEASUREMENT
/begin MEASUREMENT UEGO_RvsChrgS1B1_I.cpCpAvrg "UEGO Sensor 1 Bank 1 Reverse Charge Correction Functional Class Instance / Ground related capacities average value" UWORD q1Em10_F 1 100 0.00 0.000006553500 FORMAT "%14.12" ECU_ADDRESS 0x60001EEC /end MEASUREMENT
/begin MEASUREMENT UEGO_RvsChrgS1B1_I.cpCpRawSum "UEGO Sensor 1 Bank 1 Reverse Charge Correction Functional Class Instance / Sum of capacitances at APE, IPE and MES (if present)" UWORD q1Em10_F 1 100 0.00 0.000006553500 FORMAT "%14.12" ECU_ADDRESS 0x60001EEE /end MEASUREMENT
/begin MEASUREMENT UEGO_RvsChrgS1B1_I.dugiZ2 "UEGO Sensor 1 Bank 1 Reverse Charge Correction Functional Class Instance / UEGO Delta voltage of UgiZ2" SWORD spg_q3p2Em4_V 1 100 -10.48576 10.48544 FORMAT "%8.5" ECU_ADDRESS 0x60001EF0 /end MEASUREMENT
/begin MEASUREMENT UEGO_RvsChrgS1B1_I.flgCpAdpnIni "UEGO Sensor 1 Bank 1 Reverse Charge Correction Functional Class Instance / Cp Adaptation initialized" UBYTE B_TRUE 1 100 0.00 1.00000000000 BIT_MASK 0x1 FORMAT "%13.11" ECU_ADDRESS 0x60001EF2 /end MEASUREMENT
/begin MEASUREMENT UEGO_RvsChrgS1B1_I.flgCpAdpnRels "UEGO Sensor 1 Bank 1 Reverse Charge Correction Functional Class Instance / Release condition for capacitance learning" UBYTE B_TRUE 1 100 0.00 1.00000000000 BIT_MASK 0x1 FORMAT "%13.11" ECU_ADDRESS 0x60001EF3 /end MEASUREMENT
/begin MEASUREMENT UEGO_RvsChrgS1B1_I.flgCpAdpnVld "UEGO Sensor 1 Bank 1 Reverse Charge Correction Functional Class Instance / Cp Adaptation valid" UBYTE B_TRUE 1 100 0.00 1.00000000000 BIT_MASK 0x1 FORMAT "%13.11" ECU_ADDRESS 0x60001EF4 /end MEASUREMENT
/begin MEASUREMENT UEGO_RvsChrgS1B1_I.flgCpLrngFinshd "UEGO Sensor 1 Bank 1 Reverse Charge Correction Functional Class Instance / Capacitance learning completion status" UBYTE B_TRUE 1 100 0.00 1.00000000000 BIT_MASK 0x1 FORMAT "%13.11" ECU_ADDRESS 0x60038A84 /end MEASUREMENT
/begin MEASUREMENT UEGO_RvsChrgS1B1_I.flgCpModeRequest "UEGO Sensor 1 Bank 1 Reverse Charge Correction Functional Class Instance / Cp Adaptation requested" UBYTE B_TRUE 1 100 0.00 1.00000000000 BIT_MASK 0x1 FORMAT "%13.11" ECU_ADDRESS 0x60001EF5 /end MEASUREMENT
/begin MEASUREMENT UEGO_RvsChrgS1B1_I.flgDUgiZ2Vld "UEGO Sensor 1 Bank 1 Reverse Charge Correction Functional Class Instance / UEGO Validity flag for UgiZ2" UBYTE B_TRUE 1 100 0.00 1.00000000000 BIT_MASK 0x1 FORMAT "%13.11" ECU_ADDRESS 0x60001EF6 /end MEASUREMENT
/begin MEASUREMENT UEGO_RvsChrgS1B1_I.flgDepCamgVld "UEGO Sensor 1 Bank 1 Reverse Charge Correction Functional Class Instance / Validity flag for Camg based correction current" UBYTE B_TRUE 1 100 0.00 1.00000000000 BIT_MASK 0x1 FORMAT "%13.11" ECU_ADDRESS 0x60001EF7 /end MEASUREMENT
/begin MEASUREMENT UEGO_RvsChrgS1B1_I.flgDepCigVld "UEGO Sensor 1 Bank 1 Reverse Charge Correction Functional Class Instance / Validity flag for Cig based correction current" UBYTE B_TRUE 1 100 0.00 1.00000000000 BIT_MASK 0x1 FORMAT "%13.11" ECU_ADDRESS 0x60001EF8 /end MEASUREMENT
/begin MEASUREMENT UEGO_RvsChrgS1B1_I.flgDepUgiVld "UEGO Sensor 1 Bank 1 Reverse Charge Correction Functional Class Instance / Validity flag for Ugi based correction current" UBYTE B_TRUE 1 100 0.00 1.00000000000 BIT_MASK 0x1 FORMAT "%13.11" ECU_ADDRESS 0x60001EF9 /end MEASUREMENT
/begin MEASUREMENT UEGO_RvsChrgS1B1_I.flgDepUp0Vld "UEGO Sensor 1 Bank 1 Reverse Charge Correction Functional Class Instance / Validity flag for Up0 based correction current calculation" UBYTE B_TRUE 1 100 0.00 1.00000000000 BIT_MASK 0x1 FORMAT "%13.11" ECU_ADDRESS 0x60001EFA /end MEASUREMENT
/begin MEASUREMENT UEGO_RvsChrgS1B1_I.flgDetrmtVld "UEGO Sensor 1 Bank 1 Reverse Charge Correction Functional Class Instance / Validity flag for determinant used for capacitance learning" UBYTE B_TRUE 1 100 0.00 1.00000000000 BIT_MASK 0x1 FORMAT "%13.11" ECU_ADDRESS 0x60001EFB /end MEASUREMENT
/begin MEASUREMENT UEGO_RvsChrgS1B1_I.flgRatIPmpPckVld "UEGO Sensor 1 Bank 1 Reverse Charge Correction Functional Class Instance / Pump Current Duty cycle package valid" UBYTE B_TRUE 1 100 0.00 1.00000000000 BIT_MASK 0x1 FORMAT "%13.11" ECU_ADDRESS 0x60001EFC /end MEASUREMENT
/begin MEASUREMENT UEGO_RvsChrgS1B1_I.flgRvsChrgHiPrcns "UEGO Sensor 1 Bank 1 Reverse Charge Correction Functional Class Instance / Reverse Charge Correction with high quality" UBYTE B_TRUE 1 100 0.00 1.00000000000 BIT_MASK 0x1 FORMAT "%13.11" ECU_ADDRESS 0x60001EFD /end MEASUREMENT
/begin MEASUREMENT UEGO_RvsChrgS1B1_I.flgRvsChrgVld "UEGO Sensor 1 Bank 1 Reverse Charge Correction Functional Class Instance / Reverse Charge Correction valid" UBYTE B_TRUE 1 100 0.00 1.00000000000 BIT_MASK 0x1 FORMAT "%13.11" ECU_ADDRESS 0x60001EFE /end MEASUREMENT
/begin MEASUREMENT UEGO_RvsChrgS1B1_I.flgTM2Rich "UEGO Sensor 1 Bank 1 Reverse Charge Correction Functional Class Instance / Status of timing mode 2 rich of CJ135" UBYTE B_TRUE 1 100 0.00 1.00000000000 BIT_MASK 0x1 FORMAT "%13.11" ECU_ADDRESS 0x60001EFF /end MEASUREMENT
/begin MEASUREMENT UEGO_RvsChrgS1B1_I.flgUa2Z2Vld "UEGO Sensor 1 Bank 1 Reverse Charge Correction Functional Class Instance / Validity Flag for currently used Ua2 value" UBYTE B_TRUE 1 100 0.00 1.00000000000 BIT_MASK 0x1 FORMAT "%13.11" ECU_ADDRESS 0x60001F00 /end MEASUREMENT
/begin MEASUREMENT UEGO_RvsChrgS1B1_I.flgUi21Z2Vld "UEGO Sensor 1 Bank 1 Reverse Charge Correction Functional Class Instance / Validity Flag for currently used Ui21 value" UBYTE B_TRUE 1 100 0.00 1.00000000000 BIT_MASK 0x1 FORMAT "%13.11" ECU_ADDRESS 0x60001F01 /end MEASUREMENT
/begin MEASUREMENT UEGO_RvsChrgS1B1_I.flgUiAdpnIni "UEGO Sensor 1 Bank 1 Reverse Charge Correction Functional Class Instance / Ui Adaptation initialized" UBYTE B_TRUE 1 100 0.00 1.00000000000 BIT_MASK 0x1 FORMAT "%13.11" ECU_ADDRESS 0x60001F02 /end MEASUREMENT
/begin MEASUREMENT UEGO_RvsChrgS1B1_I.flgUiAdpnRels "UEGO Sensor 1 Bank 1 Reverse Charge Correction Functional Class Instance / Release condition for performing Ui learning" UBYTE B_TRUE 1 100 0.00 1.00000000000 BIT_MASK 0x1 FORMAT "%13.11" ECU_ADDRESS 0x60001F03 /end MEASUREMENT
/begin MEASUREMENT UEGO_RvsChrgS1B1_I.flgUiAdpnRequest "UEGO Sensor 1 Bank 1 Reverse Charge Correction Functional Class Instance / Ui Adaptation needed" UBYTE B_TRUE 1 100 0.00 1.00000000000 BIT_MASK 0x1 FORMAT "%13.11" ECU_ADDRESS 0x60001F04 /end MEASUREMENT
/begin MEASUREMENT UEGO_RvsChrgS1B1_I.flgUiCurrAdpnVld "UEGO Sensor 1 Bank 1 Reverse Charge Correction Functional Class Instance / Ui Adaptation currently valid" UBYTE B_TRUE 1 100 0.00 1.00000000000 BIT_MASK 0x1 FORMAT "%13.11" ECU_ADDRESS 0x60001F05 /end MEASUREMENT
/begin MEASUREMENT UEGO_RvsChrgS1B1_I.flgUiLeanAdpnVld "UEGO Sensor 1 Bank 1 Reverse Charge Correction Functional Class Instance / Ui Adaptation in lean conditions valid" UBYTE B_TRUE 1 100 0.00 1.00000000000 BIT_MASK 0x1 FORMAT "%13.11" ECU_ADDRESS 0x60001F06 /end MEASUREMENT
/begin MEASUREMENT UEGO_RvsChrgS1B1_I.flgUiModeRequest "UEGO Sensor 1 Bank 1 Reverse Charge Correction Functional Class Instance / Ui Adaptation requested" UBYTE B_TRUE 1 100 0.00 1.00000000000 BIT_MASK 0x1 FORMAT "%13.11" ECU_ADDRESS 0x60001F07 /end MEASUREMENT
/begin MEASUREMENT UEGO_RvsChrgS1B1_I.flgUiRichAdpnVld "UEGO Sensor 1 Bank 1 Reverse Charge Correction Functional Class Instance / Ui Adaptation in rich conditions valid" UBYTE B_TRUE 1 100 0.00 1.00000000000 BIT_MASK 0x1 FORMAT "%13.11" ECU_ADDRESS 0x60001F08 /end MEASUREMENT
/begin MEASUREMENT UEGO_RvsChrgS1B1_I.flgUiStdAdpnVld "UEGO Sensor 1 Bank 1 Reverse Charge Correction Functional Class Instance / Ui Adaptation in standard conditions valid" UBYTE B_TRUE 1 100 0.00 1.00000000000 BIT_MASK 0x1 FORMAT "%13.11" ECU_ADDRESS 0x60001F09 /end MEASUREMENT
/begin MEASUREMENT UEGO_RvsChrgS1B1_I.flgUp0Vld "UEGO Sensor 1 Bank 1 Reverse Charge Correction Functional Class Instance / Validity Flag for currently used Up0 value" UBYTE B_TRUE 1 100 0.00 1.00000000000 BIT_MASK 0x1 FORMAT "%13.11" ECU_ADDRESS 0x60001F0A /end MEASUREMENT
/begin MEASUREMENT UEGO_RvsChrgS1B1_I.iDepCamg "UEGO Sensor 1 Bank 1 Reverse Charge Correction Functional Class Instance / Camg based correction current" SWORD i_q6p6667Em7_A 1 100 -0.02184533 0.02184467 FORMAT "%10.8" ECU_ADDRESS 0x60001F0C /end MEASUREMENT
/begin MEASUREMENT UEGO_RvsChrgS1B1_I.iDepCig "UEGO Sensor 1 Bank 1 Reverse Charge Correction Functional Class Instance / Cig based correction current" SWORD i_q6p6667Em7_A 1 100 -0.02184533 0.02184467 FORMAT "%10.8" ECU_ADDRESS 0x60001F0E /end MEASUREMENT
/begin MEASUREMENT UEGO_RvsChrgS1B1_I.iDepRatIPmp "UEGO Sensor 1 Bank 1 Reverse Charge Correction Functional Class Instance / Pump current based correction current" SWORD i_q6p6667Em7_A 1 100 -0.02184533 0.02184467 FORMAT "%10.8" ECU_ADDRESS 0x60001F10 /end MEASUREMENT
/begin MEASUREMENT UEGO_RvsChrgS1B1_I.iDepUgi "UEGO Sensor 1 Bank 1 Reverse Charge Correction Functional Class Instance / Ugi based correction current" SWORD i_q6p6667Em7_A 1 100 -0.02184533 0.02184467 FORMAT "%10.8" ECU_ADDRESS 0x60001F12 /end MEASUREMENT
/begin MEASUREMENT UEGO_RvsChrgS1B1_I.iDepUp0 "UEGO Sensor 1 Bank 1 Reverse Charge Correction Functional Class Instance / Up0 based correction current" SWORD i_q6p6667Em7_A 1 100 -0.02184533 0.02184467 FORMAT "%10.8" ECU_ADDRESS 0x60001F14 /end MEASUREMENT
/begin MEASUREMENT UEGO_RvsChrgS1B1_I.nrModUi "UEGO Sensor 1 Bank 1 Reverse Charge Correction Functional Class Instance / Ui Mode for Correction" UBYTE UEGO_RvsChrgModInt_COMPU_VERB 1 100 0.00 5.00000000000 FORMAT "%13.11" ECU_ADDRESS 0x60001F16 /end MEASUREMENT
/begin MEASUREMENT UEGO_RvsChrgS1B1_I.nrModUiInt "UEGO Sensor 1 Bank 1 Reverse Charge Correction Functional Class Instance / Ui Mode internally for Request" UBYTE UEGO_RvsChrgModInt_COMPU_VERB 1 100 0.00 5.00000000000 FORMAT "%13.11" ECU_ADDRESS 0x60001F17 /end MEASUREMENT
/begin MEASUREMENT UEGO_RvsChrgS1B1_I.qC1 "UEGO Sensor 1 Bank 1 Reverse Charge Correction Functional Class Instance / qC1 Intermediate Result" FLOAT32_IEEE OneToOne 1 100 -2147483648.000 2147483647.000 FORMAT "%13.3" ECU_ADDRESS 0x60001F18 /end MEASUREMENT
/begin MEASUREMENT UEGO_RvsChrgS1B1_I.qC1CncptNew "UEGO Sensor 1 Bank 1 Reverse Charge Correction Functional Class Instance / Charge stored in EMC capacitor calculated as per new C-learning algorithm" FLOAT32_IEEE OneToOne 1 100 -2147483648.000 2147483647.000 FORMAT "%13.3" ECU_ADDRESS 0x60001F1C /end MEASUREMENT
/begin MEASUREMENT UEGO_RvsChrgS1B1_I.qC1CncptOld "UEGO Sensor 1 Bank 1 Reverse Charge Correction Functional Class Instance / Charge stored in EMC capacitor calculated as per old C-learning algorithm" FLOAT32_IEEE OneToOne 1 100 -2147483648.000 2147483647.000 FORMAT "%13.3" ECU_ADDRESS 0x60001F20 /end MEASUREMENT
/begin MEASUREMENT UEGO_RvsChrgS1B1_I.qC2 "UEGO Sensor 1 Bank 1 Reverse Charge Correction Functional Class Instance / qC2 Intermediate Result" FLOAT32_IEEE OneToOne 1 100 -2147483648.000 2147483647.000 FORMAT "%13.3" ECU_ADDRESS 0x60001F24 /end MEASUREMENT
/begin MEASUREMENT UEGO_RvsChrgS1B1_I.qC2CncptNew "UEGO Sensor 1 Bank 1 Reverse Charge Correction Functional Class Instance / Charge stored in EMC capacitor calculated as per new C-learning algorithm" FLOAT32_IEEE OneToOne 1 100 -2147483648.000 2147483647.000 FORMAT "%13.3" ECU_ADDRESS 0x60001F28 /end MEASUREMENT
/begin MEASUREMENT UEGO_RvsChrgS1B1_I.qC2CncptOld "UEGO Sensor 1 Bank 1 Reverse Charge Correction Functional Class Instance / Charge stored in EMC capacitor calculated as per old C-learning algorithm" FLOAT32_IEEE OneToOne 1 100 -2147483648.000 2147483647.000 FORMAT "%13.3" ECU_ADDRESS 0x60001F2C /end MEASUREMENT
/begin MEASUREMENT UEGO_RvsChrgS1B1_I.qUgaCorrn "UEGO Sensor 1 Bank 1 Reverse Charge Correction Functional Class Instance / Uga based correction in charge quantity applied during C-learning" FLOAT32_IEEE OneToOne 1 100 -2147483648.000 2147483647.000 FORMAT "%13.3" ECU_ADDRESS 0x60001F30 /end MEASUREMENT
/begin MEASUREMENT UEGO_RvsChrgS1B1_I.qUgiCorrn "UEGO Sensor 1 Bank 1 Reverse Charge Correction Functional Class Instance / Ugi based correction in charge quantity" FLOAT32_IEEE OneToOne 1 100 -2147483648.000 2147483647.000 FORMAT "%13.3" ECU_ADDRESS 0x60001F34 /end MEASUREMENT
/begin MEASUREMENT UEGO_RvsChrgS1B1_I.ratIPmpAvrg "UEGO Sensor 1 Bank 1 Reverse Charge Correction Functional Class Instance / Pump Current Duty cycle package average" SLONG fak_q1p201Em4 1 100 -3.93609609610 3.93597597598 FORMAT "%13.11" ECU_ADDRESS 0x60001F38 /end MEASUREMENT
/begin MEASUREMENT UEGO_RvsChrgS1B1_I.stIntVld "UEGO Sensor 1 Bank 1 Reverse Charge Correction Functional Class Instance / Internal Validtity State" UBYTE OneToOne 1 100 0.00 255.0 FORMAT "%5.1" ECU_ADDRESS 0x60001F3C /end MEASUREMENT
/begin MEASUREMENT UEGO_RvsChrgS1B1_I.stRvsChrgHiPrcns "UEGO Sensor 1 Bank 1 Reverse Charge Correction Functional Class Instance / Reverse Charge Correction Quality State" UWORD dez 1 100 0.00 65535.00 FORMAT "%8.2" ECU_ADDRESS 0x60001F3E /end MEASUREMENT
/begin MEASUREMENT UEGO_RvsChrgS1B1_I.stRvsChrgVld "UEGO Sensor 1 Bank 1 Reverse Charge Correction Functional Class Instance / Reverse Charge Correction Validity State" UWORD dez 1 100 0.00 65535.00 FORMAT "%8.2" ECU_ADDRESS 0x60001F40 /end MEASUREMENT
/begin MEASUREMENT UEGO_RvsChrgS1B1_I.stTM "UEGO Sensor 1 Bank 1 Reverse Charge Correction Functional Class Instance / Timing mode of CJ135" UBYTE OneToOne 1 100 0.00 255.0 FORMAT "%5.1" ARRAY_SIZE 15 ECU_ADDRESS 0x60001F42 /end MEASUREMENT
/begin MEASUREMENT UEGO_RvsChrgS1B1_I.tiTau "UEGO Sensor 1 Bank 1 Reverse Charge Correction Functional Class Instance / Calcuated tau" FLOAT32_IEEE OneToOne 1 100 -2147483648.000 2147483647.000 FORMAT "%13.3" ECU_ADDRESS 0x60001F54 /end MEASUREMENT
/begin MEASUREMENT UEGO_RvsChrgS1B1_I.uDeltaApeZ1 "UEGO Sensor 1 Bank 1 Reverse Charge Correction Functional Class Instance / Delta Ape during Z0, Z1 transition" SWORD spg_q3p2Em4_V 1 100 -10.48576 10.48544 FORMAT "%8.5" ECU_ADDRESS 0x60001F58 /end MEASUREMENT
/begin MEASUREMENT UEGO_RvsChrgS1B1_I.uDeltaApeZ2 "UEGO Sensor 1 Bank 1 Reverse Charge Correction Functional Class Instance / Delta Ape during Z0, Z2 transition" SWORD spg_q3p2Em4_V 1 100 -10.48576 10.48544 FORMAT "%8.5" ECU_ADDRESS 0x60001F5A /end MEASUREMENT
/begin MEASUREMENT UEGO_RvsChrgS1B1_I.uDeltaIpeZ1 "UEGO Sensor 1 Bank 1 Reverse Charge Correction Functional Class Instance / Delta Ipe during Z0, Z1 transition" SWORD spg_q3p2Em4_V 1 100 -10.48576 10.48544 FORMAT "%8.5" ECU_ADDRESS 0x60001F5C /end MEASUREMENT
/begin MEASUREMENT UEGO_RvsChrgS1B1_I.uDeltaIpeZ2 "UEGO Sensor 1 Bank 1 Reverse Charge Correction Functional Class Instance / Delta Ipe during Z0, Z2 transition" SWORD spg_q3p2Em4_V 1 100 -10.48576 10.48544 FORMAT "%8.5" ECU_ADDRESS 0x60001F5E /end MEASUREMENT
/begin MEASUREMENT UEGO_RvsChrgS1B1_I.uDeltaUga "UEGO Sensor 1 Bank 1 Reverse Charge Correction Functional Class Instance / Delta Uga value used for capacitance learning" SLONG spg_q3p2Em4_V 1 100 -687194.767360 687194.767040 FORMAT "%13.6" ECU_ADDRESS 0x60001F60 /end MEASUREMENT
/begin MEASUREMENT UEGO_RvsChrgS1B1_I.uDeltaUgi "UEGO Sensor 1 Bank 1 Reverse Charge Correction Functional Class Instance / Delta Ugi value used for capacitance learning" SLONG spg_q3p2Em4_V 1 100 -687194.767360 687194.767040 FORMAT "%13.6" ECU_ADDRESS 0x60001F64 /end MEASUREMENT
/begin MEASUREMENT UEGO_RvsChrgS1B1_I.uDeltaUi22Lean "UEGO Sensor 1 Bank 1 Reverse Charge Correction Functional Class Instance / Adaptation Value for Ui22 in lean conditions" SWORD spg_q3p2Em4_V 1 100 -10.48576 10.48544 FORMAT "%8.5" ECU_ADDRESS 0x60038A86 /end MEASUREMENT
/begin MEASUREMENT UEGO_RvsChrgS1B1_I.uDeltaUi22Rich "UEGO Sensor 1 Bank 1 Reverse Charge Correction Functional Class Instance / Adaptation Value for Ui22 in rich conditions" SWORD spg_q3p2Em4_V 1 100 -10.48576 10.48544 FORMAT "%8.5" ECU_ADDRESS 0x60038A88 /end MEASUREMENT
/begin MEASUREMENT UEGO_RvsChrgS1B1_I.uDeltaUi22Std "UEGO Sensor 1 Bank 1 Reverse Charge Correction Functional Class Instance / Adaptation Value for Ui22 in standard conditions" SWORD spg_q3p2Em4_V 1 100 -10.48576 10.48544 FORMAT "%8.5" ECU_ADDRESS 0x60038A8A /end MEASUREMENT
/begin MEASUREMENT UEGO_RvsChrgS1B1_I.uDeltaUi23Lean "UEGO Sensor 1 Bank 1 Reverse Charge Correction Functional Class Instance / Adaptation Value for Ui23 in lean conditions" SWORD spg_q3p2Em4_V 1 100 -10.48576 10.48544 FORMAT "%8.5" ECU_ADDRESS 0x60038A8C /end MEASUREMENT
/begin MEASUREMENT UEGO_RvsChrgS1B1_I.uDeltaUi23Rich "UEGO Sensor 1 Bank 1 Reverse Charge Correction Functional Class Instance / Adaptation Value for Ui23 in rich conditions" SWORD spg_q3p2Em4_V 1 100 -10.48576 10.48544 FORMAT "%8.5" ECU_ADDRESS 0x60038A8E /end MEASUREMENT
/begin MEASUREMENT UEGO_RvsChrgS1B1_I.uDeltaUi23Std "UEGO Sensor 1 Bank 1 Reverse Charge Correction Functional Class Instance / Adaptation Value for Ui23 in standard conditions" SWORD spg_q3p2Em4_V 1 100 -10.48576 10.48544 FORMAT "%8.5" ECU_ADDRESS 0x60038A90 /end MEASUREMENT
/begin MEASUREMENT UEGO_RvsChrgS1B1_I.uDeltaUi24Lean "UEGO Sensor 1 Bank 1 Reverse Charge Correction Functional Class Instance / Adaptation Value for Ui24 in lean conditions" SWORD spg_q3p2Em4_V 1 100 -10.48576 10.48544 FORMAT "%8.5" ECU_ADDRESS 0x60038A92 /end MEASUREMENT
/begin MEASUREMENT UEGO_RvsChrgS1B1_I.uDeltaUi24Rich "UEGO Sensor 1 Bank 1 Reverse Charge Correction Functional Class Instance / Adaptation Value for Ui24 in rich conditions" SWORD spg_q3p2Em4_V 1 100 -10.48576 10.48544 FORMAT "%8.5" ECU_ADDRESS 0x60038A94 /end MEASUREMENT
/begin MEASUREMENT UEGO_RvsChrgS1B1_I.uDeltaUi24Std "UEGO Sensor 1 Bank 1 Reverse Charge Correction Functional Class Instance / Adaptation Value for Ui24 in standard conditions" SWORD spg_q3p2Em4_V 1 100 -10.48576 10.48544 FORMAT "%8.5" ECU_ADDRESS 0x60038A96 /end MEASUREMENT
/begin MEASUREMENT UEGO_RvsChrgS1B1_I.uDetrmt "UEGO Sensor 1 Bank 1 Reverse Charge Correction Functional Class Instance / Determinant for capacitance learning" FLOAT32_IEEE OneToOne 1 100 -2147483648.000 2147483647.000 FORMAT "%13.3" ECU_ADDRESS 0x60001F68 /end MEASUREMENT
/begin MEASUREMENT UEGO_RvsChrgS1B1_I.uUi21 "UEGO Sensor 1 Bank 1 Reverse Charge Correction Functional Class Instance / Ui21 voltage used for Ui learning" SWORD spg_q3p2Em4_V 1 100 -10.48576 10.48544 FORMAT "%8.5" ECU_ADDRESS 0x60001F6C /end MEASUREMENT
/begin MEASUREMENT UEGO_RvsChrgS1B1_I.uUi21Measd "UEGO Sensor 1 Bank 1 Reverse Charge Correction Functional Class Instance / UEGO calculated Ui21" SWORD spg_q3p2Em4_V 1 100 -10.48576 10.48544 FORMAT "%8.5" ECU_ADDRESS 0x60001F6E /end MEASUREMENT
/begin MEASUREMENT UEGO_RvsChrgS1B1_I.uUi21Z2 "UEGO Sensor 1 Bank 1 Reverse Charge Correction Functional Class Instance / Ui21 voltage in Z2 pulse" SWORD spg_q3p2Em4_V 1 100 -10.48576 10.48544 FORMAT "%8.5" ECU_ADDRESS 0x60001F70 /end MEASUREMENT
/begin MEASUREMENT UEGO_RvsChrgS1B1_I.ua2Z2 "UEGO Sensor 1 Bank 1 Reverse Charge Correction Functional Class Instance / Currently used Ua2 value" SWORD spg_q3p2Em4_V 1 100 -10.48576 10.48544 FORMAT "%8.5" ECU_ADDRESS 0x60001F72 /end MEASUREMENT
/begin MEASUREMENT UEGO_RvsChrgS1B1_I.up0 "UEGO Sensor 1 Bank 1 Reverse Charge Correction Functional Class Instance / Currently used Up0 value" SWORD spg_q3p2Em4_V 1 100 -10.48576 10.48544 FORMAT "%8.5" ECU_ADDRESS 0x60001F74 /end MEASUREMENT
/begin MEASUREMENT UEGO_RvsChrgS1B1_I.UEGO_RvsChrgEvlnCamgPeakFilter_I.cpCamgDelta "UEGO Sensor 1 Bank 1 Reverse Charge Correction Functional Class Instance / Peak filter class for Camg calculation / Difference between old and new Camg calculation" SWORD q1Em10_F 1 100 -0.000003276800 0.000003276700 FORMAT "%14.12" ECU_ADDRESS 0x60001F76 /end MEASUREMENT
/begin MEASUREMENT UEGO_RvsChrgS1B1_I.UEGO_RvsChrgEvlnCamgPeakFilter_I.cpCamgFilOutp "UEGO Sensor 1 Bank 1 Reverse Charge Correction Functional Class Instance / Peak filter class for Camg calculation / Peak filter output of Camg" UWORD q1Em10_F 1 100 0.00 0.000006553500 FORMAT "%14.12" ECU_ADDRESS 0x60001F78 /end MEASUREMENT
/begin MEASUREMENT UEGO_RvsChrgS1B1_I.UEGO_RvsChrgEvlnCamgPeakFilter_I.cpCamgGain "UEGO Sensor 1 Bank 1 Reverse Charge Correction Functional Class Instance / Peak filter class for Camg calculation / Peak filter gain for Camg calculation" SWORD q1Em10_F 1 100 -0.000003276800 0.000003276700 FORMAT "%14.12" ECU_ADDRESS 0x60001F7A /end MEASUREMENT
/begin MEASUREMENT UEGO_RvsChrgS1B1_I.UEGO_RvsChrgEvlnCamgPeakFilter_I.flgCamgFilgStrtd "UEGO Sensor 1 Bank 1 Reverse Charge Correction Functional Class Instance / Peak filter class for Camg calculation / Camg peak filter started" UBYTE B_TRUE 1 100 0.00 1.00000000000 BIT_MASK 0x1 FORMAT "%13.11" ECU_ADDRESS 0x60001F7C /end MEASUREMENT
/begin MEASUREMENT UEGO_RvsChrgS1B1_I.UEGO_RvsChrgEvlnCigPeakFilter_I.cpCigDelta "UEGO Sensor 1 Bank 1 Reverse Charge Correction Functional Class Instance / eak filter class for Cig calculation / Difference between old and new Cig calculation" SWORD q1Em10_F 1 100 -0.000003276800 0.000003276700 FORMAT "%14.12" ECU_ADDRESS 0x60001F7E /end MEASUREMENT
/begin MEASUREMENT UEGO_RvsChrgS1B1_I.UEGO_RvsChrgEvlnCigPeakFilter_I.cpCigFilOutp "UEGO Sensor 1 Bank 1 Reverse Charge Correction Functional Class Instance / eak filter class for Cig calculation / Peak filter output of Cig" UWORD q1Em10_F 1 100 0.00 0.000006553500 FORMAT "%14.12" ECU_ADDRESS 0x60001F80 /end MEASUREMENT
/begin MEASUREMENT UEGO_RvsChrgS1B1_I.UEGO_RvsChrgEvlnCigPeakFilter_I.cpCigGain "UEGO Sensor 1 Bank 1 Reverse Charge Correction Functional Class Instance / eak filter class for Cig calculation / Peak filter gain for Cig calculation" SWORD q1Em10_F 1 100 -0.000003276800 0.000003276700 FORMAT "%14.12" ECU_ADDRESS 0x60001F82 /end MEASUREMENT
/begin MEASUREMENT UEGO_RvsChrgS1B1_I.UEGO_RvsChrgEvlnCigPeakFilter_I.flgCigFilgStrtd "UEGO Sensor 1 Bank 1 Reverse Charge Correction Functional Class Instance / eak filter class for Cig calculation / Cig peak filter started" UBYTE B_TRUE 1 100 0.00 1.00000000000 BIT_MASK 0x1 FORMAT "%13.11" ECU_ADDRESS 0x60001F84 /end MEASUREMENT
/begin MEASUREMENT UEGO_RvsChrgS1B1_I.uDeltaUi22LeanDL_I.flgFilVldy "UEGO Sensor 1 Bank 1 Reverse Charge Correction Functional Class Instance / Filtered Value for Ui22 in lean conditions / Validity Flag." UBYTE B_TRUE 1 100 0.00 1.00000000000 BIT_MASK 0x1 FORMAT "%13.11" ECU_ADDRESS 0x60001F88 /end MEASUREMENT
/begin MEASUREMENT UEGO_RvsChrgS1B1_I.uDeltaUi22LeanDL_I.nrSampleCurr "UEGO Sensor 1 Bank 1 Reverse Charge Correction Functional Class Instance / Filtered Value for Ui22 in lean conditions / Current sample count." UWORD OneToOne 1 100 0.00 65535.00 FORMAT "%8.2" ECU_ADDRESS 0x60001F8A /end MEASUREMENT
/begin MEASUREMENT UEGO_RvsChrgS1B1_I.uDeltaUi22LeanDL_I.nrSampleRef "UEGO Sensor 1 Bank 1 Reverse Charge Correction Functional Class Instance / Filtered Value for Ui22 in lean conditions / Reciprocal of Filter time constant." ULONG fak_uw_b2 1 100 0.00 131071.999969 FORMAT "%13.6" ECU_ADDRESS 0x60001F8C /end MEASUREMENT
/begin MEASUREMENT UEGO_RvsChrgS1B1_I.uDeltaUi22LeanDL_I.nrSampleThd "UEGO Sensor 1 Bank 1 Reverse Charge Correction Functional Class Instance / Filtered Value for Ui22 in lean conditions / Total number of samples." UWORD OneToOne 1 100 1.00 65535.00 FORMAT "%8.2" ECU_ADDRESS 0x60001F90 /end MEASUREMENT
/begin MEASUREMENT UEGO_RvsChrgS1B1_I.uDeltaUi22LeanDL_I.EvlnFil_DL_I.memory "UEGO Sensor 1 Bank 1 Reverse Charge Correction Functional Class Instance / Filtered Value for Ui22 in lean conditions / Filter functionality with delayed validity. / current lowpass value" SLONG spg_q4p883Em9_V 1 100 -10.4857600000 10.4857599951 FORMAT "%13.10" ECU_ADDRESS 0x60001F94 /end MEASUREMENT
/begin MEASUREMENT UEGO_RvsChrgS1B1_I.uDeltaUi22RichDL_I.flgFilVldy "UEGO Sensor 1 Bank 1 Reverse Charge Correction Functional Class Instance / Filtered Value for Ui22 in rich conditions / Validity Flag." UBYTE B_TRUE 1 100 0.00 1.00000000000 BIT_MASK 0x1 FORMAT "%13.11" ECU_ADDRESS 0x60001F98 /end MEASUREMENT
/begin MEASUREMENT UEGO_RvsChrgS1B1_I.uDeltaUi22RichDL_I.nrSampleCurr "UEGO Sensor 1 Bank 1 Reverse Charge Correction Functional Class Instance / Filtered Value for Ui22 in rich conditions / Current sample count." UWORD OneToOne 1 100 0.00 65535.00 FORMAT "%8.2" ECU_ADDRESS 0x60001F9A /end MEASUREMENT
/begin MEASUREMENT UEGO_RvsChrgS1B1_I.uDeltaUi22RichDL_I.nrSampleRef "UEGO Sensor 1 Bank 1 Reverse Charge Correction Functional Class Instance / Filtered Value for Ui22 in rich conditions / Reciprocal of Filter time constant." ULONG fak_uw_b2 1 100 0.00 131071.999969 FORMAT "%13.6" ECU_ADDRESS 0x60001F9C /end MEASUREMENT
/begin MEASUREMENT UEGO_RvsChrgS1B1_I.uDeltaUi22RichDL_I.nrSampleThd "UEGO Sensor 1 Bank 1 Reverse Charge Correction Functional Class Instance / Filtered Value for Ui22 in rich conditions / Total number of samples." UWORD OneToOne 1 100 1.00 65535.00 FORMAT "%8.2" ECU_ADDRESS 0x60001FA0 /end MEASUREMENT
/begin MEASUREMENT UEGO_RvsChrgS1B1_I.uDeltaUi22RichDL_I.EvlnFil_DL_I.memory "UEGO Sensor 1 Bank 1 Reverse Charge Correction Functional Class Instance / Filtered Value for Ui22 in rich conditions / Filter functionality with delayed validity. / current lowpass value" SLONG spg_q4p883Em9_V 1 100 -10.4857600000 10.4857599951 FORMAT "%13.10" ECU_ADDRESS 0x60001FA4 /end MEASUREMENT
/begin MEASUREMENT UEGO_RvsChrgS1B1_I.uDeltaUi22StdDL_I.flgFilVldy "UEGO Sensor 1 Bank 1 Reverse Charge Correction Functional Class Instance / Filtered Value for Ui22 in standard conditions / Validity Flag." UBYTE B_TRUE 1 100 0.00 1.00000000000 BIT_MASK 0x1 FORMAT "%13.11" ECU_ADDRESS 0x60001FA8 /end MEASUREMENT
/begin MEASUREMENT UEGO_RvsChrgS1B1_I.uDeltaUi22StdDL_I.nrSampleCurr "UEGO Sensor 1 Bank 1 Reverse Charge Correction Functional Class Instance / Filtered Value for Ui22 in standard conditions / Current sample count." UWORD OneToOne 1 100 0.00 65535.00 FORMAT "%8.2" ECU_ADDRESS 0x60001FAA /end MEASUREMENT
/begin MEASUREMENT UEGO_RvsChrgS1B1_I.uDeltaUi22StdDL_I.nrSampleRef "UEGO Sensor 1 Bank 1 Reverse Charge Correction Functional Class Instance / Filtered Value for Ui22 in standard conditions / Reciprocal of Filter time constant." ULONG fak_uw_b2 1 100 0.00 131071.999969 FORMAT "%13.6" ECU_ADDRESS 0x60001FAC /end MEASUREMENT
/begin MEASUREMENT UEGO_RvsChrgS1B1_I.uDeltaUi22StdDL_I.nrSampleThd "UEGO Sensor 1 Bank 1 Reverse Charge Correction Functional Class Instance / Filtered Value for Ui22 in standard conditions / Total number of samples." UWORD OneToOne 1 100 1.00 65535.00 FORMAT "%8.2" ECU_ADDRESS 0x60001FB0 /end MEASUREMENT
/begin MEASUREMENT UEGO_RvsChrgS1B1_I.uDeltaUi22StdDL_I.EvlnFil_DL_I.memory "UEGO Sensor 1 Bank 1 Reverse Charge Correction Functional Class Instance / Filtered Value for Ui22 in standard conditions / Filter functionality with delayed validity. / current lowpass value" SLONG spg_q4p883Em9_V 1 100 -10.4857600000 10.4857599951 FORMAT "%13.10" ECU_ADDRESS 0x60001FB4 /end MEASUREMENT
/begin MEASUREMENT UEGO_RvsChrgS1B1_I.uDeltaUi23LeanDL_I.flgFilVldy "UEGO Sensor 1 Bank 1 Reverse Charge Correction Functional Class Instance / Filtered Value for Ui23 in lean conditions / Validity Flag." UBYTE B_TRUE 1 100 0.00 1.00000000000 BIT_MASK 0x1 FORMAT "%13.11" ECU_ADDRESS 0x60001FB8 /end MEASUREMENT
/begin MEASUREMENT UEGO_RvsChrgS1B1_I.uDeltaUi23LeanDL_I.nrSampleCurr "UEGO Sensor 1 Bank 1 Reverse Charge Correction Functional Class Instance / Filtered Value for Ui23 in lean conditions / Current sample count." UWORD OneToOne 1 100 0.00 65535.00 FORMAT "%8.2" ECU_ADDRESS 0x60001FBA /end MEASUREMENT
/begin MEASUREMENT UEGO_RvsChrgS1B1_I.uDeltaUi23LeanDL_I.nrSampleRef "UEGO Sensor 1 Bank 1 Reverse Charge Correction Functional Class Instance / Filtered Value for Ui23 in lean conditions / Reciprocal of Filter time constant." ULONG fak_uw_b2 1 100 0.00 131071.999969 FORMAT "%13.6" ECU_ADDRESS 0x60001FBC /end MEASUREMENT
/begin MEASUREMENT UEGO_RvsChrgS1B1_I.uDeltaUi23LeanDL_I.nrSampleThd "UEGO Sensor 1 Bank 1 Reverse Charge Correction Functional Class Instance / Filtered Value for Ui23 in lean conditions / Total number of samples." UWORD OneToOne 1 100 1.00 65535.00 FORMAT "%8.2" ECU_ADDRESS 0x60001FC0 /end MEASUREMENT
/begin MEASUREMENT UEGO_RvsChrgS1B1_I.uDeltaUi23LeanDL_I.EvlnFil_DL_I.memory "UEGO Sensor 1 Bank 1 Reverse Charge Correction Functional Class Instance / Filtered Value for Ui23 in lean conditions / Filter functionality with delayed validity. / current lowpass value" SLONG spg_q4p883Em9_V 1 100 -10.4857600000 10.4857599951 FORMAT "%13.10" ECU_ADDRESS 0x60001FC4 /end MEASUREMENT
/begin MEASUREMENT UEGO_RvsChrgS1B1_I.uDeltaUi23RichDL_I.flgFilVldy "UEGO Sensor 1 Bank 1 Reverse Charge Correction Functional Class Instance / Filtered Value for Ui23 in rich conditions / Validity Flag." UBYTE B_TRUE 1 100 0.00 1.00000000000 BIT_MASK 0x1 FORMAT "%13.11" ECU_ADDRESS 0x60001FC8 /end MEASUREMENT
/begin MEASUREMENT UEGO_RvsChrgS1B1_I.uDeltaUi23RichDL_I.nrSampleCurr "UEGO Sensor 1 Bank 1 Reverse Charge Correction Functional Class Instance / Filtered Value for Ui23 in rich conditions / Current sample count." UWORD OneToOne 1 100 0.00 65535.00 FORMAT "%8.2" ECU_ADDRESS 0x60001FCA /end MEASUREMENT
/begin MEASUREMENT UEGO_RvsChrgS1B1_I.uDeltaUi23RichDL_I.nrSampleRef "UEGO Sensor 1 Bank 1 Reverse Charge Correction Functional Class Instance / Filtered Value for Ui23 in rich conditions / Reciprocal of Filter time constant." ULONG fak_uw_b2 1 100 0.00 131071.999969 FORMAT "%13.6" ECU_ADDRESS 0x60001FCC /end MEASUREMENT
/begin MEASUREMENT UEGO_RvsChrgS1B1_I.uDeltaUi23RichDL_I.nrSampleThd "UEGO Sensor 1 Bank 1 Reverse Charge Correction Functional Class Instance / Filtered Value for Ui23 in rich conditions / Total number of samples." UWORD OneToOne 1 100 1.00 65535.00 FORMAT "%8.2" ECU_ADDRESS 0x60001FD0 /end MEASUREMENT
/begin MEASUREMENT UEGO_RvsChrgS1B1_I.uDeltaUi23RichDL_I.EvlnFil_DL_I.memory "UEGO Sensor 1 Bank 1 Reverse Charge Correction Functional Class Instance / Filtered Value for Ui23 in rich conditions / Filter functionality with delayed validity. / current lowpass value" SLONG spg_q4p883Em9_V 1 100 -10.4857600000 10.4857599951 FORMAT "%13.10" ECU_ADDRESS 0x60001FD4 /end MEASUREMENT
/begin MEASUREMENT UEGO_RvsChrgS1B1_I.uDeltaUi23StdDL_I.flgFilVldy "UEGO Sensor 1 Bank 1 Reverse Charge Correction Functional Class Instance / Filtered Value for Ui23 in standard conditions / Validity Flag." UBYTE B_TRUE 1 100 0.00 1.00000000000 BIT_MASK 0x1 FORMAT "%13.11" ECU_ADDRESS 0x60001FD8 /end MEASUREMENT
/begin MEASUREMENT UEGO_RvsChrgS1B1_I.uDeltaUi23StdDL_I.nrSampleCurr "UEGO Sensor 1 Bank 1 Reverse Charge Correction Functional Class Instance / Filtered Value for Ui23 in standard conditions / Current sample count." UWORD OneToOne 1 100 0.00 65535.00 FORMAT "%8.2" ECU_ADDRESS 0x60001FDA /end MEASUREMENT
/begin MEASUREMENT UEGO_RvsChrgS1B1_I.uDeltaUi23StdDL_I.nrSampleRef "UEGO Sensor 1 Bank 1 Reverse Charge Correction Functional Class Instance / Filtered Value for Ui23 in standard conditions / Reciprocal of Filter time constant." ULONG fak_uw_b2 1 100 0.00 131071.999969 FORMAT "%13.6" ECU_ADDRESS 0x60001FDC /end MEASUREMENT
/begin MEASUREMENT UEGO_RvsChrgS1B1_I.uDeltaUi23StdDL_I.nrSampleThd "UEGO Sensor 1 Bank 1 Reverse Charge Correction Functional Class Instance / Filtered Value for Ui23 in standard conditions / Total number of samples." UWORD OneToOne 1 100 1.00 65535.00 FORMAT "%8.2" ECU_ADDRESS 0x60001FE0 /end MEASUREMENT
/begin MEASUREMENT UEGO_RvsChrgS1B1_I.uDeltaUi23StdDL_I.EvlnFil_DL_I.memory "UEGO Sensor 1 Bank 1 Reverse Charge Correction Functional Class Instance / Filtered Value for Ui23 in standard conditions / Filter functionality with delayed validity. / current lowpass value" SLONG spg_q4p883Em9_V 1 100 -10.4857600000 10.4857599951 FORMAT "%13.10" ECU_ADDRESS 0x60001FE4 /end MEASUREMENT
/begin MEASUREMENT UEGO_RvsChrgS1B1_I.uDeltaUi24LeanDL_I.flgFilVldy "UEGO Sensor 1 Bank 1 Reverse Charge Correction Functional Class Instance / Filtered Value for Ui24 in lean conditions / Validity Flag." UBYTE B_TRUE 1 100 0.00 1.00000000000 BIT_MASK 0x1 FORMAT "%13.11" ECU_ADDRESS 0x60001FE8 /end MEASUREMENT
/begin MEASUREMENT UEGO_RvsChrgS1B1_I.uDeltaUi24LeanDL_I.nrSampleCurr "UEGO Sensor 1 Bank 1 Reverse Charge Correction Functional Class Instance / Filtered Value for Ui24 in lean conditions / Current sample count." UWORD OneToOne 1 100 0.00 65535.00 FORMAT "%8.2" ECU_ADDRESS 0x60001FEA /end MEASUREMENT
/begin MEASUREMENT UEGO_RvsChrgS1B1_I.uDeltaUi24LeanDL_I.nrSampleRef "UEGO Sensor 1 Bank 1 Reverse Charge Correction Functional Class Instance / Filtered Value for Ui24 in lean conditions / Reciprocal of Filter time constant." ULONG fak_uw_b2 1 100 0.00 131071.999969 FORMAT "%13.6" ECU_ADDRESS 0x60001FEC /end MEASUREMENT
/begin MEASUREMENT UEGO_RvsChrgS1B1_I.uDeltaUi24LeanDL_I.nrSampleThd "UEGO Sensor 1 Bank 1 Reverse Charge Correction Functional Class Instance / Filtered Value for Ui24 in lean conditions / Total number of samples." UWORD OneToOne 1 100 1.00 65535.00 FORMAT "%8.2" ECU_ADDRESS 0x60001FF0 /end MEASUREMENT
/begin MEASUREMENT UEGO_RvsChrgS1B1_I.uDeltaUi24LeanDL_I.EvlnFil_DL_I.memory "UEGO Sensor 1 Bank 1 Reverse Charge Correction Functional Class Instance / Filtered Value for Ui24 in lean conditions / Filter functionality with delayed validity. / current lowpass value" SLONG spg_q4p883Em9_V 1 100 -10.4857600000 10.4857599951 FORMAT "%13.10" ECU_ADDRESS 0x60001FF4 /end MEASUREMENT
/begin MEASUREMENT UEGO_RvsChrgS1B1_I.uDeltaUi24RichDL_I.flgFilVldy "UEGO Sensor 1 Bank 1 Reverse Charge Correction Functional Class Instance / Filtered Value for Ui24 in rich conditions / Validity Flag." UBYTE B_TRUE 1 100 0.00 1.00000000000 BIT_MASK 0x1 FORMAT "%13.11" ECU_ADDRESS 0x60001FF8 /end MEASUREMENT
/begin MEASUREMENT UEGO_RvsChrgS1B1_I.uDeltaUi24RichDL_I.nrSampleCurr "UEGO Sensor 1 Bank 1 Reverse Charge Correction Functional Class Instance / Filtered Value for Ui24 in rich conditions / Current sample count." UWORD OneToOne 1 100 0.00 65535.00 FORMAT "%8.2" ECU_ADDRESS 0x60001FFA /end MEASUREMENT
/begin MEASUREMENT UEGO_RvsChrgS1B1_I.uDeltaUi24RichDL_I.nrSampleRef "UEGO Sensor 1 Bank 1 Reverse Charge Correction Functional Class Instance / Filtered Value for Ui24 in rich conditions / Reciprocal of Filter time constant." ULONG fak_uw_b2 1 100 0.00 131071.999969 FORMAT "%13.6" ECU_ADDRESS 0x60001FFC /end MEASUREMENT
/begin MEASUREMENT UEGO_RvsChrgS1B1_I.uDeltaUi24RichDL_I.nrSampleThd "UEGO Sensor 1 Bank 1 Reverse Charge Correction Functional Class Instance / Filtered Value for Ui24 in rich conditions / Total number of samples." UWORD OneToOne 1 100 1.00 65535.00 FORMAT "%8.2" ECU_ADDRESS 0x60002000 /end MEASUREMENT
/begin MEASUREMENT UEGO_RvsChrgS1B1_I.uDeltaUi24RichDL_I.EvlnFil_DL_I.memory "UEGO Sensor 1 Bank 1 Reverse Charge Correction Functional Class Instance / Filtered Value for Ui24 in rich conditions / Filter functionality with delayed validity. / current lowpass value" SLONG spg_q4p883Em9_V 1 100 -10.4857600000 10.4857599951 FORMAT "%13.10" ECU_ADDRESS 0x60002004 /end MEASUREMENT
/begin MEASUREMENT UEGO_RvsChrgS1B1_I.uDeltaUi24StdDL_I.flgFilVldy "UEGO Sensor 1 Bank 1 Reverse Charge Correction Functional Class Instance / Filtered Value for Ui24 in standard conditions / Validity Flag." UBYTE B_TRUE 1 100 0.00 1.00000000000 BIT_MASK 0x1 FORMAT "%13.11" ECU_ADDRESS 0x60002008 /end MEASUREMENT
/begin MEASUREMENT UEGO_RvsChrgS1B1_I.uDeltaUi24StdDL_I.nrSampleCurr "UEGO Sensor 1 Bank 1 Reverse Charge Correction Functional Class Instance / Filtered Value for Ui24 in standard conditions / Current sample count." UWORD OneToOne 1 100 0.00 65535.00 FORMAT "%8.2" ECU_ADDRESS 0x6000200A /end MEASUREMENT
/begin MEASUREMENT UEGO_RvsChrgS1B1_I.uDeltaUi24StdDL_I.nrSampleRef "UEGO Sensor 1 Bank 1 Reverse Charge Correction Functional Class Instance / Filtered Value for Ui24 in standard conditions / Reciprocal of Filter time constant." ULONG fak_uw_b2 1 100 0.00 131071.999969 FORMAT "%13.6" ECU_ADDRESS 0x6000200C /end MEASUREMENT
/begin MEASUREMENT UEGO_RvsChrgS1B1_I.uDeltaUi24StdDL_I.nrSampleThd "UEGO Sensor 1 Bank 1 Reverse Charge Correction Functional Class Instance / Filtered Value for Ui24 in standard conditions / Total number of samples." UWORD OneToOne 1 100 1.00 65535.00 FORMAT "%8.2" ECU_ADDRESS 0x60002010 /end MEASUREMENT
/begin MEASUREMENT UEGO_RvsChrgS1B1_I.uDeltaUi24StdDL_I.EvlnFil_DL_I.memory "UEGO Sensor 1 Bank 1 Reverse Charge Correction Functional Class Instance / Filtered Value for Ui24 in standard conditions / Filter functionality with delayed validity. / current lowpass value" SLONG spg_q4p883Em9_V 1 100 -10.4857600000 10.4857599951 FORMAT "%13.10" ECU_ADDRESS 0x60002014 /end MEASUREMENT
/begin MEASUREMENT UEGO_SnsrMdlHotS1B1_I.cntrReiniProc20msec "Calculation if sensor is hot or cold / Counter for recognition of a broken afterrun" UBYTE OneToOne 1 100 0.00 255.0 FORMAT "%5.1" ECU_ADDRESS 0x60001EAC /end MEASUREMENT
/begin MEASUREMENT UEGO_SnsrMdlHotS1B1_I.egyHeatr "Calculation if sensor is hot or cold / Heater energy put into the sensor" ULONG q_q6p1035Em5_J 1 100 0.00 1220.00000000 FORMAT "%13.8" ECU_ADDRESS 0x60038A78 /end MEASUREMENT
/begin MEASUREMENT UEGO_SnsrMdlHotS1B1_I.egyOverHeatgProtnThd "Calculation if sensor is hot or cold / overheating protection energy threshold" ULONG q_q6p1035Em5_J 1 100 0.00 1220.00000000 FORMAT "%13.8" ECU_ADDRESS 0x60001EB0 /end MEASUREMENT
/begin MEASUREMENT UEGO_SnsrMdlHotS1B1_I.envRamOk "Calculation if sensor is hot or cold / No fault in non-volatile memory" UBYTE B_TRUE 1 100 0.00 1.00000000000 BIT_MASK 0x1 FORMAT "%13.11" ECU_ADDRESS 0x60001EB4 /end MEASUREMENT
/begin MEASUREMENT UEGO_SnsrMdlHotS1B1_I.facEgyLoss "Calculation if sensor is hot or cold / Factor for energy loss after initialisation" UWORD fak_q0p001 1 100 0.00 65.53500 FORMAT "%8.5" ECU_ADDRESS 0x60001EB6 /end MEASUREMENT
/begin MEASUREMENT UEGO_SnsrMdlHotS1B1_I.facPwrLoss "Calculation if sensor is hot or cold / Factor for power loss" UWORD t_q0p0001_s 1 100 0.00 6.553500 FORMAT "%8.6" ECU_ADDRESS 0x60001EB8 /end MEASUREMENT
/begin MEASUREMENT UEGO_SnsrMdlHotS1B1_I.flgHeatgActv "Calculation if sensor is hot or cold / sensor heating is active" UBYTE B_TRUE 1 100 0.00 1.00000000000 BIT_MASK 0x1 FORMAT "%13.11" ECU_ADDRESS 0x60001EBA /end MEASUREMENT
/begin MEASUREMENT UEGO_SnsrMdlHotS1B1_I.flgIniEgyHeatr "Calculation if sensor is hot or cold / Flag to intialise the energy of heater" UBYTE B_TRUE 1 100 0.00 1.00000000000 BIT_MASK 0x1 FORMAT "%13.11" ECU_ADDRESS 0x600365B2 /end MEASUREMENT
/begin MEASUREMENT UEGO_SnsrMdlHotS1B1_I.flgIniProtdFinshd "Calculation if sensor is hot or cold / Initialisation flag Protected Ram" UBYTE B_TRUE 1 100 0.00 1.00000000000 BIT_MASK 0x1 FORMAT "%13.11" ECU_ADDRESS 0x600365B3 /end MEASUREMENT
/begin MEASUREMENT UEGO_SnsrMdlHotS1B1_I.flgSnsrMdlAmbT "Calculation if sensor is hot or cold / Information if sensor temperature is above room temperatur" UBYTE B_TRUE 1 100 0.00 1.00000000000 BIT_MASK 0x1 FORMAT "%13.11" ECU_ADDRESS 0x60001EBB /end MEASUREMENT
/begin MEASUREMENT UEGO_SnsrMdlHotS1B1_I.flgSnsrMdlHeatgUpFinshd "Calculation if sensor is hot or cold / modelled curve phase heating temparature reached for warm start" UBYTE B_TRUE 1 100 0.00 1.00000000000 BIT_MASK 0x1 FORMAT "%13.11" ECU_ADDRESS 0x60001EBC /end MEASUREMENT
/begin MEASUREMENT UEGO_SnsrMdlHotS1B1_I.flgSnsrMdlHot "Calculation if sensor is hot or cold / Condition lambda sensor would be hot" UBYTE B_TRUE 1 100 0.00 1.00000000000 BIT_MASK 0x1 FORMAT "%13.11" ECU_ADDRESS 0x60001EBD /end MEASUREMENT
/begin MEASUREMENT UEGO_SnsrMdlHotS1B1_I.flgSnsrMdlOverHeatgProtn "Calculation if sensor is hot or cold / request for overheating protection" UBYTE B_TRUE 1 100 0.00 1.00000000000 BIT_MASK 0x1 FORMAT "%13.11" ECU_ADDRESS 0x60001EBE /end MEASUREMENT
/begin MEASUREMENT UEGO_SnsrMdlHotS1B1_I.flgtiHeatrOffVld "Calculation if sensor is hot or cold / Validity flag for heater off time" UBYTE B_TRUE 1 100 0.00 1.00000000000 BIT_MASK 0x1 FORMAT "%13.11" ECU_ADDRESS 0x600365B4 /end MEASUREMENT
/begin MEASUREMENT UEGO_SnsrMdlHotS1B1_I.flgtioffvld "Calculation if sensor is hot or cold / Validity Flag of the heater of time" UBYTE B_TRUE 1 100 0.00 1.00000000000 BIT_MASK 0x1 FORMAT "%13.11" ECU_ADDRESS 0x60001EBF /end MEASUREMENT
/begin MEASUREMENT UEGO_SnsrMdlHotS1B1_I.pwrHeatr "Calculation if sensor is hot or cold / Heating power" UWORD leist_q0p00244 1 100 0.00 159.9976 FORMAT "%8.4" ECU_ADDRESS 0x60001EC0 /end MEASUREMENT
/begin MEASUREMENT UEGO_SnsrMdlHotS1B1_I.pwrLossSnsr "Calculation if sensor is hot or cold / Powerloss for energy calculation" UWORD leist_q0p00244 1 100 0.00 159.9976 FORMAT "%8.4" ECU_ADDRESS 0x60001EC2 /end MEASUREMENT
/begin MEASUREMENT UEGO_SnsrMdlHotS1B1_I.rHeatr "Calculation if sensor is hot or cold / heater resistor" UWORD r_q9p765625Em4_Ohm 1 100 0.00 63.99902 FORMAT "%8.5" ECU_ADDRESS 0x60001EC4 /end MEASUREMENT
/begin MEASUREMENT UEGO_SnsrMdlHotS1B1_I.tiHeatrOff "Calculation if sensor is hot or cold / heater off time" ULONG t_q0p02 1 100 0.00 85899345.9000 FORMAT "%13.4" ECU_ADDRESS 0x60038A7C /end MEASUREMENT
/begin MEASUREMENT UEGO_SnsrMdlHotS1B1_I.tiOff "Calculation if sensor is hot or cold / Off timer" ULONG t_q0p02 1 100 0.00 85899345.9000 FORMAT "%13.4" ECU_ADDRESS 0x60001EC8 /end MEASUREMENT
/begin MEASUREMENT UEGO_SnsrMdlHotS1B1_I.uHeatr "Calculation if sensor is hot or cold / Voltage drop over heater resistance" UWORD spg_q0p005 1 100 0.00 327.6750 FORMAT "%8.4" ECU_ADDRESS 0x600365B6 /end MEASUREMENT
/begin MEASUREMENT UEGO_SnsrMdlHotS1B1_I.uHeatrMdl "Calculation if sensor is hot or cold / model heater voltage" UWORD spg_q0p005 1 100 0.00 327.6750 FORMAT "%8.4" ECU_ADDRESS 0x600365B8 /end MEASUREMENT
/begin MEASUREMENT UEGO_SnsrMdlHotS1B1_I.UEGO_SnsrMdlHotEgyIninClass.facExpEgyLoss "Calculation if sensor is hot or cold / Class for calculation of energy loss during ECU off time / Expansion factor for Taylor expansion" FLOAT32_IEEE OneToOne 1 100 0.00 1.00000000E+037 FORMAT "%13.3" ECU_ADDRESS 0x60001ED0 /end MEASUREMENT
/begin MEASUREMENT UEGO_SnsrMdlHotS1B1_I.UEGO_SnsrTMdlflgHeatgOnERNM_I.oldSignal "Calculation if sensor is hot or cold / flag set when edge raising of heating On detected / value of input signal last calculation" UBYTE B_TRUE 1 100 0.00 1.00000000000 BIT_MASK 0x1 FORMAT "%13.11" ECU_ADDRESS 0x60001ED4 /end MEASUREMENT
/begin MEASUREMENT UEGO_SnsrS1B1_I.flgRCmpPrsnt "Class instance of function UEGO_Snsr for Sensor 1 Bank 1 / Indication, if mounted Sensor has compensation resistor." UBYTE B_TRUE 1 100 0.00 1.00000000000 BIT_MASK 0x1 FORMAT "%13.11" ECU_ADDRESS 0x60006562 /end MEASUREMENT
/begin MEASUREMENT UEGO_SnsrS1B1_I.flgSnglCell "Class instance of function UEGO_Snsr for Sensor 1 Bank 1 / Flag single cell lambda sensor" UBYTE B_TRUE 1 100 0.00 1.00000000000 BIT_MASK 0x1 FORMAT "%13.11" ECU_ADDRESS 0x60006563 /end MEASUREMENT
/begin MEASUREMENT UEGO_SnsrS1B1_I.flgSnsrSuprtd "Class instance of function UEGO_Snsr for Sensor 1 Bank 1 / Indication, if mounted Sensor is supported by SW" UBYTE B_TRUE 1 100 0.00 1.00000000000 BIT_MASK 0x1 FORMAT "%13.11" ECU_ADDRESS 0x60006564 /end MEASUREMENT
/begin MEASUREMENT UEGO_SnsrS1B1_I.idxTyp "Class instance of function UEGO_Snsr for Sensor 1 Bank 1 / Sensor type" UBYTE UEGO_SNSRType_COMPU_VERB 1 100 0.00 22.0000000000 FORMAT "%13.10" ECU_ADDRESS 0x60006565 /end MEASUREMENT
/begin MEASUREMENT UEGO_stTiEngOff "Validity state of engine off time" UBYTE OneToOne 1 100 0.00 255.0 FORMAT "%5.1" ECU_ADDRESS 0x6000AD53 /end MEASUREMENT
/begin MEASUREMENT UEGO_TCeramicEvlnS1B1_I.facRNernstRPmp "Class: Evaluation Path of ceramic temperature / Ratio of Nernstcell resistance to Pumpcell resistance" UWORD fak_q0p000244 1 100 0.00 15.99976 FORMAT "%8.5" ECU_ADDRESS 0x60001E60 /end MEASUREMENT
/begin MEASUREMENT UEGO_TCeramicEvlnS1B1_I.facRNernstRPmpPlsOper "Class: Evaluation Path of ceramic temperature / Ratio of Nernstcell resistance to Pumpcell resistance" UWORD fak_q0p000244 1 100 0.00 15.99976 FORMAT "%8.5" ECU_ADDRESS 0x60001E62 /end MEASUREMENT
/begin MEASUREMENT UEGO_TCeramicEvlnS1B1_I.flgRCeramicFilVld "Class: Evaluation Path of ceramic temperature / flag for validity for filtered ceramic resistance" UBYTE B_TRUE 1 100 0.00 1.00000000000 BIT_MASK 0x1 FORMAT "%13.11" ECU_ADDRESS 0x60001E64 /end MEASUREMENT
/begin MEASUREMENT UEGO_TCeramicEvlnS1B1_I.flgRCeramicRawHiPrcsn "Class: Evaluation Path of ceramic temperature / Flag inner resistance of sensor ceramic with raw high precision" UBYTE B_TRUE 1 100 0.00 1.00000000000 BIT_MASK 0x1 FORMAT "%13.11" ECU_ADDRESS 0x60001E65 /end MEASUREMENT
/begin MEASUREMENT UEGO_TCeramicEvlnS1B1_I.flgRCeramicRawVld "Class: Evaluation Path of ceramic temperature / flag for raw ceramic resistance validity" UBYTE B_TRUE 1 100 0.00 1.00000000000 BIT_MASK 0x1 FORMAT "%13.11" ECU_ADDRESS 0x60001E66 /end MEASUREMENT
/begin MEASUREMENT UEGO_TCeramicEvlnS1B1_I.flgRCeramicVld "Class: Evaluation Path of ceramic temperature / Valid flag of inner resistance of semspr ceramic" UBYTE B_TRUE 1 100 0.00 1.00000000000 BIT_MASK 0x1 FORMAT "%13.11" ECU_ADDRESS 0x60001E67 /end MEASUREMENT
/begin MEASUREMENT UEGO_TCeramicEvlnS1B1_I.flgRNernstRPmpPlsOperVld "Class: Evaluation Path of ceramic temperature / Validity of ratio of Nernstcell resistance to Pumpcell resistance" UBYTE B_TRUE 1 100 0.00 1.00000000000 BIT_MASK 0x1 FORMAT "%13.11" ECU_ADDRESS 0x60001E68 /end MEASUREMENT
/begin MEASUREMENT UEGO_TCeramicEvlnS1B1_I.flgRNernstRPmpVld "Class: Evaluation Path of ceramic temperature / Validity of ratio of Nernstcell resistance to Pumpcell resistance" UBYTE B_TRUE 1 100 0.00 1.00000000000 BIT_MASK 0x1 FORMAT "%13.11" ECU_ADDRESS 0x60001E69 /end MEASUREMENT
/begin MEASUREMENT UEGO_TCeramicEvlnS1B1_I.flgTCeramicHiPrcsn "Class: Evaluation Path of ceramic temperature / Flag temperature of sensor ceramic with high precision" UBYTE B_TRUE 1 100 0.00 1.00000000000 BIT_MASK 0x1 FORMAT "%13.11" ECU_ADDRESS 0x60001E6A /end MEASUREMENT
/begin MEASUREMENT UEGO_TCeramicEvlnS1B1_I.flgTCeramicLimIni "Class: Evaluation Path of ceramic temperature / condition ceramic temperatur limit initialization" UBYTE B_TRUE 1 100 0.00 1.00000000000 BIT_MASK 0x1 FORMAT "%13.11" ECU_ADDRESS 0x60001E6B /end MEASUREMENT
/begin MEASUREMENT UEGO_TCeramicEvlnS1B1_I.flgTCeramicVld "Class: Evaluation Path of ceramic temperature / validiti bit for ceramic temperature" UBYTE B_TRUE 1 100 0.00 1.00000000000 BIT_MASK 0x1 FORMAT "%13.11" ECU_ADDRESS 0x60001E6C /end MEASUREMENT
/begin MEASUREMENT UEGO_TCeramicEvlnS1B1_I.nrModInt "Class: Evaluation Path of ceramic temperature / internal Mode" UBYTE UEGO_TCeramicModInt_COMPU_VERB 1 100 0.00 7.00000000000 FORMAT "%13.11" ECU_ADDRESS 0x60001E6D /end MEASUREMENT
/begin MEASUREMENT UEGO_TCeramicEvlnS1B1_I.rCeramic "Class: Evaluation Path of ceramic temperature / ceramic resistanc" UWORD r_q0p1_Ohm 1 100 0.00 6553.500 FORMAT "%8.3" ECU_ADDRESS 0x60001E6E /end MEASUREMENT
/begin MEASUREMENT UEGO_TCeramicEvlnS1B1_I.rCeramicRaw "Class: Evaluation Path of ceramic temperature / raw ceramic resistance value before filtering" UWORD r_q0p1_Ohm 1 100 0.00 6553.500 FORMAT "%8.3" ECU_ADDRESS 0x60001E70 /end MEASUREMENT
/begin MEASUREMENT UEGO_TCeramicEvlnS1B1_I.tCeramic "Class: Evaluation Path of ceramic temperature / ceramic temperature" UWORD temp_q0p0234_o273 1 100 -273.150 1262.827 FORMAT "%8.3" ECU_ADDRESS 0x60001E72 /end MEASUREMENT
/begin MEASUREMENT UEGO_TCeramicEvlnS1B1_I.tCeramicMax "Class: Evaluation Path of ceramic temperature / Ceramic temperature max" UWORD temp_q0p0234_o273 1 100 -273.150 1262.827 FORMAT "%8.3" ECU_ADDRESS 0x60001E74 /end MEASUREMENT
/begin MEASUREMENT UEGO_TCeramicEvlnS1B1_I.tCeramicMin "Class: Evaluation Path of ceramic temperature / ceramic temperatur min" UWORD temp_q0p0234_o273 1 100 -273.150 1262.827 FORMAT "%8.3" ECU_ADDRESS 0x60001E76 /end MEASUREMENT
/begin MEASUREMENT UEGO_TCeramicEvlnS1B1_I.UEGO_facRNernstRPmpEvlnFilDlydVldy_I.flgFilVldy "Class: Evaluation Path of ceramic temperature / factor for the delay of the RNernstRPmp validity flag / Validity Flag." UBYTE B_TRUE 1 100 0.00 1.00000000000 BIT_MASK 0x1 FORMAT "%13.11" ECU_ADDRESS 0x60001E78 /end MEASUREMENT
/begin MEASUREMENT UEGO_TCeramicEvlnS1B1_I.UEGO_facRNernstRPmpEvlnFilDlydVldy_I.nrSampleCurr "Class: Evaluation Path of ceramic temperature / factor for the delay of the RNernstRPmp validity flag / Current sample count." UWORD OneToOne 1 100 0.00 65535.00 FORMAT "%8.2" ECU_ADDRESS 0x60001E7A /end MEASUREMENT
/begin MEASUREMENT UEGO_TCeramicEvlnS1B1_I.UEGO_facRNernstRPmpEvlnFilDlydVldy_I.nrSampleRef "Class: Evaluation Path of ceramic temperature / factor for the delay of the RNernstRPmp validity flag / Reciprocal of Filter time constant." ULONG fak_uw_b2 1 100 0.00 131071.999969 FORMAT "%13.6" ECU_ADDRESS 0x60001E7C /end MEASUREMENT
/begin MEASUREMENT UEGO_TCeramicEvlnS1B1_I.UEGO_facRNernstRPmpEvlnFilDlydVldy_I.nrSampleThd "Class: Evaluation Path of ceramic temperature / factor for the delay of the RNernstRPmp validity flag / Total number of samples." UWORD OneToOne 1 100 1.00 65535.00 FORMAT "%8.2" ECU_ADDRESS 0x60001E80 /end MEASUREMENT
/begin MEASUREMENT UEGO_TCeramicEvlnS1B1_I.UEGO_facRNernstRPmpEvlnFilDlydVldy_I.EvlnFil_DL_I.memory "Class: Evaluation Path of ceramic temperature / factor for the delay of the RNernstRPmp validity flag / Filter functionality with delayed validity. / current lowpass value" ULONG fak_q3p72529Em9 1 100 0.00 15.9999999963 FORMAT "%13.10" ECU_ADDRESS 0x60001E84 /end MEASUREMENT
/begin MEASUREMENT UEGO_TCeramicEvlnS1B1_I.UEGO_facRNernstRPmpPlsOperEvlnFilDlydVldy_I.flgFilVldy "Class: Evaluation Path of ceramic temperature / factor for the delay of the RNernstRPmpPlsOper validity flag / Validity Flag." UBYTE B_TRUE 1 100 0.00 1.00000000000 BIT_MASK 0x1 FORMAT "%13.11" ECU_ADDRESS 0x60001E88 /end MEASUREMENT
/begin MEASUREMENT UEGO_TCeramicEvlnS1B1_I.UEGO_facRNernstRPmpPlsOperEvlnFilDlydVldy_I.nrSampleCurr "Class: Evaluation Path of ceramic temperature / factor for the delay of the RNernstRPmpPlsOper validity flag / Current sample count." UWORD OneToOne 1 100 0.00 65535.00 FORMAT "%8.2" ECU_ADDRESS 0x60001E8A /end MEASUREMENT
/begin MEASUREMENT UEGO_TCeramicEvlnS1B1_I.UEGO_facRNernstRPmpPlsOperEvlnFilDlydVldy_I.nrSampleRef "Class: Evaluation Path of ceramic temperature / factor for the delay of the RNernstRPmpPlsOper validity flag / Reciprocal of Filter time constant." ULONG fak_uw_b2 1 100 0.00 131071.999969 FORMAT "%13.6" ECU_ADDRESS 0x60001E8C /end MEASUREMENT
/begin MEASUREMENT UEGO_TCeramicEvlnS1B1_I.UEGO_facRNernstRPmpPlsOperEvlnFilDlydVldy_I.nrSampleThd "Class: Evaluation Path of ceramic temperature / factor for the delay of the RNernstRPmpPlsOper validity flag / Total number of samples." UWORD OneToOne 1 100 1.00 65535.00 FORMAT "%8.2" ECU_ADDRESS 0x60001E90 /end MEASUREMENT
/begin MEASUREMENT UEGO_TCeramicEvlnS1B1_I.UEGO_facRNernstRPmpPlsOperEvlnFilDlydVldy_I.EvlnFil_DL_I.memory "Class: Evaluation Path of ceramic temperature / factor for the delay of the RNernstRPmpPlsOper validity flag / Filter functionality with delayed validity. / current lowpass value" ULONG fak_q3p72529Em9 1 100 0.00 15.9999999963 FORMAT "%13.10" ECU_ADDRESS 0x60001E94 /end MEASUREMENT
/begin MEASUREMENT UEGO_TCeramicEvlnS1B1_I.UEGO_uEvlnFilRCeramicDlydVldy_I.flgFilVldy "Class: Evaluation Path of ceramic temperature / Filter instance for filtering the ceramic resistance / Validity Flag." UBYTE B_TRUE 1 100 0.00 1.00000000000 BIT_MASK 0x1 FORMAT "%13.11" ECU_ADDRESS 0x60001E98 /end MEASUREMENT
/begin MEASUREMENT UEGO_TCeramicEvlnS1B1_I.UEGO_uEvlnFilRCeramicDlydVldy_I.nrSampleCurr "Class: Evaluation Path of ceramic temperature / Filter instance for filtering the ceramic resistance / Current sample count." UWORD OneToOne 1 100 0.00 65535.00 FORMAT "%8.2" ECU_ADDRESS 0x60001E9A /end MEASUREMENT
/begin MEASUREMENT UEGO_TCeramicEvlnS1B1_I.UEGO_uEvlnFilRCeramicDlydVldy_I.nrSampleRef "Class: Evaluation Path of ceramic temperature / Filter instance for filtering the ceramic resistance / Reciprocal of Filter time constant." ULONG fak_uw_b2 1 100 0.00 131071.999969 FORMAT "%13.6" ECU_ADDRESS 0x60001E9C /end MEASUREMENT
/begin MEASUREMENT UEGO_TCeramicEvlnS1B1_I.UEGO_uEvlnFilRCeramicDlydVldy_I.nrSampleThd "Class: Evaluation Path of ceramic temperature / Filter instance for filtering the ceramic resistance / Total number of samples." UWORD OneToOne 1 100 0.00 65535.00 FORMAT "%8.2" ECU_ADDRESS 0x60001EA0 /end MEASUREMENT
/begin MEASUREMENT UEGO_TCeramicEvlnS1B1_I.UEGO_uEvlnFilRCeramicDlydVldy_I.EvlnFil_DL_I.memory "Class: Evaluation Path of ceramic temperature / Filter instance for filtering the ceramic resistance / Filter functionality with delayed validity. / current lowpass value" ULONG r_q1p5259Em6_Ohm 1 100 0.00 6553.59999847 FORMAT "%13.8" ECU_ADDRESS 0x60001EA4 /end MEASUREMENT
/begin MEASUREMENT UEGO_TCeramicEvlnS1B1_I.flgRCeramicVldyTOFFVNM_I.time "Class: Evaluation Path of ceramic temperature / Turn off delay instance for resetting of the ceramic resistance / delay time" UWORD t_q0p005 1 100 0.00 327.6750 FORMAT "%8.4" ECU_ADDRESS 0x60001EA8 /end MEASUREMENT
/begin MEASUREMENT UEGO_tCeramicS1B1 "Ceramic temperature sensor 1 bank 1" UWORD temp_q0p0234_o273 1 100 -273.150 1262.827 FORMAT "%8.3" ECU_ADDRESS 0x60008B42 /end MEASUREMENT
/begin MEASUREMENT UEGO_tiEcuOff "ECU off time" SLONG Time_sec_q1_COMPU 1 100 -2147483648.00 2147483647.00 FORMAT "%13.2" ECU_ADDRESS 0x60003938 /end MEASUREMENT
/begin MEASUREMENT UEGO_tiEcuOffTmp "Time Stamp of ECU off time" SLONG Time_sec_q1_COMPU 1 100 -2147483648.00 2147483647.00 FORMAT "%13.2" ECU_ADDRESS 0x60001EDC /end MEASUREMENT
/begin MEASUREMENT UEGO_tiEngOff "enigine off time" SLONG t_q1 1 100 -2147483648.00 2147483647.00 FORMAT "%13.2" ECU_ADDRESS 0x60003934 /end MEASUREMENT
/begin MEASUREMENT UEGO_tiEngOffTmp "Time Stamp of engine off time" SLONG Time_sec_q1_COMPU 1 100 -2147483648.00 2147483647.00 FORMAT "%13.2" ECU_ADDRESS 0x60001ED8 /end MEASUREMENT
/begin MEASUREMENT UEGO_TiEngOffTOFFVNM_I.time "Turn off delay, if flgEngRunng changed from true to false / delay time" UBYTE t_q0p02 1 100 0.00 5.100 FORMAT "%5.3" ECU_ADDRESS 0x6000AD51 /end MEASUREMENT
/begin MEASUREMENT UEGO_tiHeatrOffS1B1 "Heater off time S1B1" ULONG t_q0p02 1 100 0.00 85899345.9000 FORMAT "%13.4" ECU_ADDRESS 0x60003880 /end MEASUREMENT
/begin MEASUREMENT UEGO_TstrClassS1B1_I.flgHeatrRelsATS "Class tester release for lambda sensor 1 bank 1 / Release heater control through ATS" UBYTE B_TRUE 1 100 0.00 1.00000000000 BIT_MASK 0x1 FORMAT "%13.11" ECU_ADDRESS 0x6000655C /end MEASUREMENT
/begin MEASUREMENT UEGO_TstrClassS1B1_I.flgTstrRels "Class tester release for lambda sensor 1 bank 1 / Release heater control through Tester (ATS, Shorttrip, Calibration or Servicetester)" UBYTE B_TRUE 1 100 0.00 1.00000000000 BIT_MASK 0x1 FORMAT "%13.11" ECU_ADDRESS 0x6000655D /end MEASUREMENT
/begin MEASUREMENT UEGO_TstrClassS1B1_I.bHtrActvPrevStrtER_I.buffer "Class tester release for lambda sensor 1 bank 1 / rising edge for precious heating / rising edge detected" UBYTE B_TRUE 1 100 0.00 1.00000000000 BIT_MASK 0x1 FORMAT "%13.11" ECU_ADDRESS 0x6000655E /end MEASUREMENT
/begin MEASUREMENT UEGO_TstrClassS1B1_I.bHtrActvPrevStrtER_I.oldSignal "Class tester release for lambda sensor 1 bank 1 / rising edge for precious heating / flag rising edge" UBYTE B_TRUE 1 100 0.00 1.00000000000 BIT_MASK 0x1 FORMAT "%13.11" ECU_ADDRESS 0x6000655F /end MEASUREMENT
/begin MEASUREMENT UEGO_TstrClassS1B1_I.bHtrActvPrevStrtFF_I.status "Class tester release for lambda sensor 1 bank 1 / flip flop for previous heating / current value of RS-FF" UBYTE B_TRUE 1 100 0.00 1.00000000000 BIT_MASK 0x1 FORMAT "%13.11" ECU_ADDRESS 0x60006560 /end MEASUREMENT
/begin MEASUREMENT UEGO_uDeltaUnS1B1 "uDelta Un of sensor instance" SWORD spg_q3p2Em4_V 1 100 -10.48576 10.48544 FORMAT "%8.5" ECU_ADDRESS 0x60008E34 /end MEASUREMENT
/begin MEASUREMENT UEGO_uHeatrS1B1 "Heater voltage S1B1" UWORD spg_q0p005 1 100 0.00 327.6750 FORMAT "%8.4" ECU_ADDRESS 0x60008B3E /end MEASUREMENT
/begin FUNCTION UEGO_RNernst "1.18.0    UEGO ASIC Inner Resistance of Nernst Cell"
 /begin DEF_CHARACTERISTIC UEGO_RNernstDeltaMax_C UEGO_rRNernstCrvtCorrnNorm_T UEGO_rRNernstCrvtCorrnWrmUp_T UEGO_stRNernst_C /end DEF_CHARACTERISTIC
 /begin REF_CHARACTERISTIC UEGO_rRFe_C /end REF_CHARACTERISTIC
 /begin IN_MEASUREMENT UEGO_DataSplyClsS1B1_I.flgCj135An UEGO_DataSplyClsS1B1_I.flgDACOff UEGO_DataSplyClsS1B1_I.flgErrSpiRamRet UEGO_DataSplyClsS1B1_I.flgFKal1Vld UEGO_DataSplyClsS1B1_I.flgFKal2Vld UEGO_DataSplyClsS1B1_I.flgFKal3Vld UEGO_DataSplyClsS1B1_I.flgIPmpActvd UEGO_DataSplyClsS1B1_I.flgISQrA UEGO_DataSplyClsS1B1_I.flgISQrE UEGO_DataSplyClsS1B1_I.flgLCURR UEGO_DataSplyClsS1B1_I.flgLNMeas UEGO_DataSplyClsS1B1_I.flgLPMeas UEGO_DataSplyClsS1B1_I.flgLoupeCAL UEGO_DataSplyClsS1B1_I.flgLoupeG0 UEGO_DataSplyClsS1B1_I.flgLstPckAbort UEGO_DataSplyClsS1B1_I.flgMKA UEGO_DataSplyClsS1B1_I.flgMKE UEGO_DataSplyClsS1B1_I.flgNewIPmpDacPckAry UEGO_DataSplyClsS1B1_I.flgNewIPmpOK UEGO_DataSplyClsS1B1_I.flgNewIPmpPckAry UEGO_DataSplyClsS1B1_I.flgNewIPmpTM UEGO_DataSplyClsS1B1_I.flgNewPck UEGO_DataSplyClsS1B1_I.flgNewPckCstnc UEGO_DataSplyClsS1B1_I.flgNewPckMiss UEGO_DataSplyClsS1B1_I.flgNewPckVld UEGO_DataSplyClsS1B1_I.flgNewTiPck UEGO_DataSplyClsS1B1_I.flgNewURmVG4MeasAryVld UEGO_DataSplyClsS1B1_I.flgNewUa2Pck UEGO_DataSplyClsS1B1_I.flgNewUa31Pck UEGO_DataSplyClsS1B1_I.flgNewUa32Pck UEGO_DataSplyClsS1B1_I.flgNewUa33Pck UEGO_DataSplyClsS1B1_I.flgNewUamPck UEGO_DataSplyClsS1B1_I.flgNewUapePck UEGO_DataSplyClsS1B1_I.flgNewUcalMaxPck UEGO_DataSplyClsS1B1_I.flgNewUcalPck UEGO_DataSplyClsS1B1_I.flgNewUg0Pck UEGO_DataSplyClsS1B1_I.flgNewUg0PckAry UEGO_DataSplyClsS1B1_I.flgNewUg0aPck UEGO_DataSplyClsS1B1_I.flgNewUg0ePck UEGO_DataSplyClsS1B1_I.flgNewUg0iPck UEGO_DataSplyClsS1B1_I.flgNewUg0iPckAry UEGO_DataSplyClsS1B1_I.flgNewUg0iaiPck UEGO_DataSplyClsS1B1_I.flgNewUg0ieiPck UEGO_DataSplyClsS1B1_I.flgNewUg0ix7PckAry UEGO_DataSplyClsS1B1_I.flgNewUg0ix9PckAry UEGO_DataSplyClsS1B1_I.flgNewUg0ixPckAry UEGO_DataSplyClsS1B1_I.flgNewUg0mPck UEGO_DataSplyClsS1B1_I.flgNewUgaPck UEGO_DataSplyClsS1B1_I.flgNewUgiPckAry UEGO_DataSplyClsS1B1_I.flgNewUgkAvrgPck UEGO_DataSplyClsS1B1_I.flgNewUguaPck UEGO_DataSplyClsS1B1_I.flgNewUguaZ2Pck UEGO_DataSplyClsS1B1_I.flgNewUguiPck UEGO_DataSplyClsS1B1_I.flgNewUguiZ1Pck UEGO_DataSplyClsS1B1_I.flgNewUi21PckAry UEGO_DataSplyClsS1B1_I.flgNewUi22Pck UEGO_DataSplyClsS1B1_I.flgNewUi23Pck UEGO_DataSplyClsS1B1_I.flgNewUi24Pck UEGO_DataSplyClsS1B1_I.flgNewUi4Pck UEGO_DataSplyClsS1B1_I.flgNewUi4Z2Pck UEGO_DataSplyClsS1B1_I.flgNewUigPckAry UEGO_DataSplyClsS1B1_I.flgNewUigmkPckAry UEGO_DataSplyClsS1B1_I.flgNewUipcalAvrgPck UEGO_DataSplyClsS1B1_I.flgNewUn0Pck UEGO_DataSplyClsS1B1_I.flgNewUn0Pck4Ary UEGO_DataSplyClsS1B1_I.flgNewUn0Pck5Ary UEGO_DataSplyClsS1B1_I.flgNewUn0PckAry UEGO_DataSplyClsS1B1_I.flgNewUnPckAry UEGO_DataSplyClsS1B1_I.flgNewUnSetPck UEGO_DataSplyClsS1B1_I.flgNewUnx3PckAry UEGO_DataSplyClsS1B1_I.flgNewUnx4PckAry UEGO_DataSplyClsS1B1_I.flgNewUp0Pck UEGO_DataSplyClsS1B1_I.flgNewUp0Pck4 UEGO_DataSplyClsS1B1_I.flgNewUp0Pck5Ary UEGO_DataSplyClsS1B1_I.flgNewUp0PckAry UEGO_DataSplyClsS1B1_I.flgNewUpPckAry UEGO_DataSplyClsS1B1_I.flgNewUpx3PckAry UEGO_DataSplyClsS1B1_I.flgNewUpx4PckAry UEGO_DataSplyClsS1B1_I.flgNewUriaPckVld UEGO_DataSplyClsS1B1_I.flgNewUriePckAry UEGO_DataSplyClsS1B1_I.flgNewUx6PckAry UEGO_DataSplyClsS1B1_I.flgNewUx7PckAry UEGO_DataSplyClsS1B1_I.flgNewUx8PckAry UEGO_DataSplyClsS1B1_I.flgNewUx9PckAry UEGO_DataSplyClsS1B1_I.flgNewUxPckAry UEGO_DataSplyClsS1B1_I.flgReStable UEGO_DataSplyClsS1B1_I.flgSngCell UEGO_DataSplyClsS1B1_I.flgUical0Vld UEGO_DataSplyClsS1B1_I.flgUicalVld UEGO_DataSplyClsS1B1_I.flgUoffipe1Vld UEGO_DataSplyClsS1B1_I.flgUoffipe2Vld UEGO_DataSplyClsS1B1_I.flgUoffipe3Vld UEGO_DataSplyClsS1B1_I.flgUoffvcc1Vld UEGO_DataSplyClsS1B1_I.flgUoffvcc2Vld UEGO_DataSplyClsS1B1_I.flgUoffvcc3Vld UEGO_DataSplyClsS1B1_I.flgUriaMeas UEGO_DataSplyClsS1B1_I.nrIPmpDacPckAry UEGO_DataSplyClsS1B1_I.nrIpPckAry UEGO_DataSplyClsS1B1_I.nrModeMeas UEGO_DataSplyClsS1B1_I.nrRamFailPosn UEGO_DataSplyClsS1B1_I.nrRamMod UEGO_DataSplyClsS1B1_I.nrRamRegMod UEGO_DataSplyClsS1B1_I.nrRamSts1 UEGO_DataSplyClsS1B1_I.nrRamSts2 UEGO_DataSplyClsS1B1_I.nrRamSts3 UEGO_DataSplyClsS1B1_I.nrURmVG4PckAry UEGO_DataSplyClsS1B1_I.nrUa2PckAry UEGO_DataSplyClsS1B1_I.nrUcalMaxCorrd UEGO_DataSplyClsS1B1_I.nrUg0PckAry UEGO_DataSplyClsS1B1_I.nrUg0iPckAry UEGO_DataSplyClsS1B1_I.nrUg0ix7PckAry UEGO_DataSplyClsS1B1_I.nrUg0ix9PckAry UEGO_DataSplyClsS1B1_I.nrUg0ixPckAry UEGO_DataSplyClsS1B1_I.nrUgaPckAry UEGO_DataSplyClsS1B1_I.nrUgiPckAry UEGO_DataSplyClsS1B1_I.nrUi21PckAry UEGO_DataSplyClsS1B1_I.nrUical0PckCorrd UEGO_DataSplyClsS1B1_I.nrUicalPckCorrd UEGO_DataSplyClsS1B1_I.nrUigPckAry UEGO_DataSplyClsS1B1_I.nrUigmkPckAry UEGO_DataSplyClsS1B1_I.nrUn0Pck4Ary UEGO_DataSplyClsS1B1_I.nrUn0Pck5Ary UEGO_DataSplyClsS1B1_I.nrUn0PckAry UEGO_DataSplyClsS1B1_I.nrUnPckAry UEGO_DataSplyClsS1B1_I.nrUnx3PckAry UEGO_DataSplyClsS1B1_I.nrUnx4PckAry UEGO_DataSplyClsS1B1_I.nrUoffipe1 UEGO_DataSplyClsS1B1_I.nrUoffipe2 UEGO_DataSplyClsS1B1_I.nrUoffipe3 UEGO_DataSplyClsS1B1_I.nrUoffvcc1 UEGO_DataSplyClsS1B1_I.nrUoffvcc2 UEGO_DataSplyClsS1B1_I.nrUoffvcc3 UEGO_DataSplyClsS1B1_I.nrUp0Pck5Ary UEGO_DataSplyClsS1B1_I.nrUp0PckAry UEGO_DataSplyClsS1B1_I.nrUpPckAry UEGO_DataSplyClsS1B1_I.nrUpx3PckAry UEGO_DataSplyClsS1B1_I.nrUpx4PckAry UEGO_DataSplyClsS1B1_I.nrUriePckAry UEGO_DataSplyClsS1B1_I.nrUx6PckAry UEGO_DataSplyClsS1B1_I.nrUx7PckAry UEGO_DataSplyClsS1B1_I.nrUx8PckAry UEGO_DataSplyClsS1B1_I.nrUx9PckAry UEGO_DataSplyClsS1B1_I.nrUxPckAry UEGO_DataSplyClsS1B1_I.stIPmpOK UEGO_DataSplyClsS1B1_I.stIPmpTM UEGO_DataSplyClsS1B1_I.stIPmpTM2L UEGO_DataSplyClsS1B1_I.stIPmpTM2R UEGO_DataSplyClsS1B1_I.stLsmRetValMod UEGO_DataSplyClsS1B1_I.stMKMeas UEGO_DataSplyClsS1B1_I.stOFFMeas UEGO_DataSplyClsS1B1_I.stOPTMeas UEGO_DataSplyClsS1B1_I.stREFMeas UEGO_DataSplyClsS1B1_I.stUa2PckAry UEGO_DataSplyClsS1B1_I.stUa2Z1PckAry UEGO_DataSplyClsS1B1_I.stUg0iPckAry UEGO_DataSplyClsS1B1_I.stUg0ix7IActvPckAry UEGO_DataSplyClsS1B1_I.stUg0ix7PmpIActvPckAry UEGO_DataSplyClsS1B1_I.stUg0ix9IActvPckAry UEGO_DataSplyClsS1B1_I.stUg0ix9PmpIActvPckAry UEGO_DataSplyClsS1B1_I.stUg0ixIActvPckAry UEGO_DataSplyClsS1B1_I.stUg0ixPmpIActvPckAry UEGO_DataSplyClsS1B1_I.stUi21PckAry UEGO_DataSplyClsS1B1_I.stUi21Z1PckAry UEGO_DataSplyClsS1B1_I.stUigmkNernstIActvPckAry UEGO_DataSplyClsS1B1_I.stUigmkPmpIActvPckAry UEGO_DataSplyClsS1B1_I.stUn0PckAry UEGO_DataSplyClsS1B1_I.stUn0Z2PckAry UEGO_DataSplyClsS1B1_I.stUnPckAry UEGO_DataSplyClsS1B1_I.stUnx3IActvAcrsNernstCellPckAry UEGO_DataSplyClsS1B1_I.stUnx3IActvAcrsPmpCellPckAry UEGO_DataSplyClsS1B1_I.stUnx4IActvAcrsNernstCellPckAry UEGO_DataSplyClsS1B1_I.stUnx4IActvAcrsPmpCellPckAry UEGO_DataSplyClsS1B1_I.stUp0PckAry UEGO_DataSplyClsS1B1_I.stUp0Z2PckAry UEGO_DataSplyClsS1B1_I.stUpPckAry UEGO_DataSplyClsS1B1_I.stUpZ2PckAry UEGO_DataSplyClsS1B1_I.stUpx3IActvAcrsNernstCellPckAry UEGO_DataSplyClsS1B1_I.stUpx3IActvAcrsPmpCellPckAry UEGO_DataSplyClsS1B1_I.stUpx4IActvAcrsNernstCellPckAry UEGO_DataSplyClsS1B1_I.stUpx4IActvAcrsPmpCellPckAry UEGO_DataSplyClsS1B1_I.stUriePckAry UEGO_DataSplyClsS1B1_I.stUx6IActvPckAry UEGO_DataSplyClsS1B1_I.stUx6MeasAcrsPmpCellPckAry UEGO_DataSplyClsS1B1_I.stUx7IActvPckAry UEGO_DataSplyClsS1B1_I.stUx7MeasAcrsPmpCellPckAry UEGO_DataSplyClsS1B1_I.stUx8IActvPckAry UEGO_DataSplyClsS1B1_I.stUx8MeasAcrsPmpCellPckAry UEGO_DataSplyClsS1B1_I.stUx9IActvPckAry UEGO_DataSplyClsS1B1_I.stUx9MeasAcrsPmpCellPckAry UEGO_DataSplyClsS1B1_I.stUxIActvPckAry UEGO_DataSplyClsS1B1_I.stUxMeasAcrsPmpCell UEGO_DataSplyClsS1B1_I.tiUEGOPck UEGO_DataSplyClsS1B1_I.uFkal1 UEGO_DataSplyClsS1B1_I.uFkal2 UEGO_DataSplyClsS1B1_I.uFkal3 UEGO_DataSplyClsS1B1_I.uUCalPck UEGO_DataSplyClsS1B1_I.uUa31Pck UEGO_DataSplyClsS1B1_I.uUa32Pck UEGO_DataSplyClsS1B1_I.uUa33Pck UEGO_DataSplyClsS1B1_I.uUamPck UEGO_DataSplyClsS1B1_I.uUapePck UEGO_DataSplyClsS1B1_I.uUcalMaxPck UEGO_DataSplyClsS1B1_I.uUg0Pck UEGO_DataSplyClsS1B1_I.uUg0aPck UEGO_DataSplyClsS1B1_I.uUg0ePck UEGO_DataSplyClsS1B1_I.uUg0iPck UEGO_DataSplyClsS1B1_I.uUg0iaiPck UEGO_DataSplyClsS1B1_I.uUg0ieiPck UEGO_DataSplyClsS1B1_I.uUg0mPck UEGO_DataSplyClsS1B1_I.uUgkAvrgPck UEGO_DataSplyClsS1B1_I.uUguaPck UEGO_DataSplyClsS1B1_I.uUguaZ2Pck UEGO_DataSplyClsS1B1_I.uUguiPck UEGO_DataSplyClsS1B1_I.uUguiZ1Pck UEGO_DataSplyClsS1B1_I.uUi22Pck UEGO_DataSplyClsS1B1_I.uUi23Pck UEGO_DataSplyClsS1B1_I.uUi24Pck UEGO_DataSplyClsS1B1_I.uUi4Pck UEGO_DataSplyClsS1B1_I.uUi4Z2Pck UEGO_DataSplyClsS1B1_I.uUipcalAvrgPck UEGO_DataSplyClsS1B1_I.uUn0Pck UEGO_DataSplyClsS1B1_I.uUnSet UEGO_DataSplyClsS1B1_I.uUp0Pck UEGO_DataSplyClsS1B1_I.uUp0Pck4 UEGO_DataSplyClsS1B1_I.uUriaPck UEGO_DataSplyClsS1B1_I.uVCC1Corrd UEGO_DataSplyClsS1B1_I.uVCC3Ref UEGO_flgCJ135AnS1B1 UEGO_flgDiagSigWireOlRstS1B1 UEGO_flgIsqrMeasVldS1B1 UEGO_flgSysSuprtdS1B1 UEGO_iIsqrMeasS1B1 UEGO_iOffsIsqrNernstS1B1 UEGO_RegGetPrmS1B1_I.flgDlyBlcknNxtPckVld UEGO_RegGetPrmS1B1_I.flgDlyBlcknVld UEGO_RegGetPrmS1B1_I.flgDspDiagDis UEGO_RegGetPrmS1B1_I.flgDspDiagDisNxtPck UEGO_RegGetPrmS1B1_I.flgDspDiagDisNxtPckVld UEGO_RegGetPrmS1B1_I.flgDspDiagDisVld UEGO_RegGetPrmS1B1_I.flgEnSpA UEGO_RegGetPrmS1B1_I.flgEnSpAVld UEGO_RegGetPrmS1B1_I.flgEnSpE UEGO_RegGetPrmS1B1_I.flgEnSpEVld UEGO_RegGetPrmS1B1_I.flgEnSpNxtPckVld UEGO_RegGetPrmS1B1_I.flgEnSpVld UEGO_RegGetPrmS1B1_I.flgIPmpBlcknNxtPckVld UEGO_RegGetPrmS1B1_I.flgIPmpBlcknVld UEGO_RegGetPrmS1B1_I.flgIPmpLimnHiVld UEGO_RegGetPrmS1B1_I.flgIPmpLimnLoVld UEGO_RegGetPrmS1B1_I.flgIPmpRst UEGO_RegGetPrmS1B1_I.flgIPmpRstNxtPck UEGO_RegGetPrmS1B1_I.flgIPmpRstNxtPckVld UEGO_RegGetPrmS1B1_I.flgIPmpRstVld UEGO_RegGetPrmS1B1_I.flgIPmpSm UEGO_RegGetPrmS1B1_I.flgIPmpSmNxtPck UEGO_RegGetPrmS1B1_I.flgIPmpSmNxtPckVld UEGO_RegGetPrmS1B1_I.flgIPmpSmVld UEGO_RegGetPrmS1B1_I.flgLCal UEGO_RegGetPrmS1B1_I.flgLCalVld UEGO_RegGetPrmS1B1_I.flgLCurr UEGO_RegGetPrmS1B1_I.flgLCurrVld UEGO_RegGetPrmS1B1_I.flgLDAC UEGO_RegGetPrmS1B1_I.flgLDACConf UEGO_RegGetPrmS1B1_I.flgLDACConfVld UEGO_RegGetPrmS1B1_I.flgLDACVld UEGO_RegGetPrmS1B1_I.flgLG0 UEGO_RegGetPrmS1B1_I.flgLG0Vld UEGO_RegGetPrmS1B1_I.flgLN UEGO_RegGetPrmS1B1_I.flgLNNxtPck UEGO_RegGetPrmS1B1_I.flgLNNxtPckVld UEGO_RegGetPrmS1B1_I.flgLNVld UEGO_RegGetPrmS1B1_I.flgLP UEGO_RegGetPrmS1B1_I.flgLPNxtPck UEGO_RegGetPrmS1B1_I.flgLPNxtPckVld UEGO_RegGetPrmS1B1_I.flgLPVld UEGO_RegGetPrmS1B1_I.flgMKA UEGO_RegGetPrmS1B1_I.flgMKAVld UEGO_RegGetPrmS1B1_I.flgMKE UEGO_RegGetPrmS1B1_I.flgMKEVld UEGO_RegGetPrmS1B1_I.flgMKNxtPckVld UEGO_RegGetPrmS1B1_I.flgMKVld UEGO_RegGetPrmS1B1_I.flgN3MeasActvNxtPck UEGO_RegGetPrmS1B1_I.flgN3MeasActvNxtPckVld UEGO_RegGetPrmS1B1_I.flgOFFNxtPckVld UEGO_RegGetPrmS1B1_I.flgOFFVld UEGO_RegGetPrmS1B1_I.flgOPTNxtPckVld UEGO_RegGetPrmS1B1_I.flgOPTVld UEGO_RegGetPrmS1B1_I.flgPatNxtPckVld UEGO_RegGetPrmS1B1_I.flgPatVld UEGO_RegGetPrmS1B1_I.flgRCmpHeatrEdgeShiftAllwd UEGO_RegGetPrmS1B1_I.flgRCmpHeatrEdgeShiftAllwdNxtPck UEGO_RegGetPrmS1B1_I.flgRCmpHeatrEdgeShiftAllwdNxtPckVld UEGO_RegGetPrmS1B1_I.flgRCmpHeatrEdgeShiftAllwdVld UEGO_RegGetPrmS1B1_I.flgReStab UEGO_RegGetPrmS1B1_I.flgReStabVld UEGO_RegGetPrmS1B1_I.flgRefNxtPckVld UEGO_RegGetPrmS1B1_I.flgRefPatChng UEGO_RegGetPrmS1B1_I.flgRefPatNxtPckVld UEGO_RegGetPrmS1B1_I.flgRefPatVld UEGO_RegGetPrmS1B1_I.flgRefVld UEGO_RegGetPrmS1B1_I.flgRegIPmpSetNxtPckVld UEGO_RegGetPrmS1B1_I.flgRegIPmpSetVld UEGO_RegGetPrmS1B1_I.flgRegIpoffChng UEGO_RegGetPrmS1B1_I.flgRegIpoffNxtPckVld UEGO_RegGetPrmS1B1_I.flgRegIpoffVld UEGO_RegGetPrmS1B1_I.flgRegModNxtPckVld UEGO_RegGetPrmS1B1_I.flgRegModVld UEGO_RegGetPrmS1B1_I.flgRegPartModNxtPckVld UEGO_RegGetPrmS1B1_I.flgRegPartModVld UEGO_RegGetPrmS1B1_I.flgRegUnsetNxtPckVld UEGO_RegGetPrmS1B1_I.flgRiaPatChng UEGO_RegGetPrmS1B1_I.flgRiaPatVld UEGO_RegGetPrmS1B1_I.flgRipVld UEGO_RegGetPrmS1B1_I.flgSngCell UEGO_RegGetPrmS1B1_I.flgSngCellVld UEGO_RegGetPrmS1B1_I.flgSteerPatChng UEGO_RegGetPrmS1B1_I.flgSteerPatNxtPckVld UEGO_RegGetPrmS1B1_I.flgSteerPatVld UEGO_RegGetPrmS1B1_I.flgSubModMeasNxtPckVld UEGO_RegGetPrmS1B1_I.flgSubModMeasVld UEGO_RegGetPrmS1B1_I.flgSwVirtGnd UEGO_RegGetPrmS1B1_I.flgSwVirtGndVld UEGO_RegGetPrmS1B1_I.flgTrimSqChng UEGO_RegGetPrmS1B1_I.flgTrimSqrCalChng UEGO_RegGetPrmS1B1_I.flgTrimSqrChng UEGO_RegGetPrmS1B1_I.flgTrmNxtPckVld UEGO_RegGetPrmS1B1_I.flgTrmSqCalOffSet UEGO_RegGetPrmS1B1_I.flgTrmSqCalVld UEGO_RegGetPrmS1B1_I.flgTrmSqOffSet UEGO_RegGetPrmS1B1_I.flgTrmSqOffSetVld UEGO_RegGetPrmS1B1_I.flgTrmSqVld UEGO_RegGetPrmS1B1_I.flgTrmSqrCalOffSet UEGO_RegGetPrmS1B1_I.flgTrmSqrCalVld UEGO_RegGetPrmS1B1_I.flgTrmSqrOffSet UEGO_RegGetPrmS1B1_I.flgTrmSqrOffSetVld UEGO_RegGetPrmS1B1_I.flgTrmSqrVld UEGO_RegGetPrmS1B1_I.flgUnsetVld UEGO_RegGetPrmS1B1_I.flgUp0LeanNxtPckVld UEGO_RegGetPrmS1B1_I.flgUp0LeanVld UEGO_RegGetPrmS1B1_I.flgUp0RichNxtPckVld UEGO_RegGetPrmS1B1_I.flgUp0RichVld UEGO_RegGetPrmS1B1_I.flgUria UEGO_RegGetPrmS1B1_I.flgUriaNxtPck UEGO_RegGetPrmS1B1_I.flgUriaNxtPckVld UEGO_RegGetPrmS1B1_I.flgUriaVld UEGO_RegGetPrmS1B1_I.flgV1BF2NxtPckVld UEGO_RegGetPrmS1B1_I.flgV1BF2Vld UEGO_RegGetPrmS1B1_I.flgV1BF3NxtPckVld UEGO_RegGetPrmS1B1_I.flgV1BIT1 UEGO_RegGetPrmS1B1_I.flgV1BIT1NxtPck UEGO_RegGetPrmS1B1_I.flgV1BIT1NxtPckVld UEGO_RegGetPrmS1B1_I.flgV1BIT1Vld UEGO_RegGetPrmS1B1_I.flgV1BIT2 UEGO_RegGetPrmS1B1_I.flgV1BIT2NxtPck UEGO_RegGetPrmS1B1_I.flgV1BIT2NxtPckVld UEGO_RegGetPrmS1B1_I.flgV1BIT2Vld UEGO_RegGetPrmS1B1_I.flgV1BIT5 UEGO_RegGetPrmS1B1_I.flgV1BIT5NxtPck UEGO_RegGetPrmS1B1_I.flgV1BIT5NxtPckVld UEGO_RegGetPrmS1B1_I.flgV1BIT5Vld UEGO_RegGetPrmS1B1_I.flgWtrEleclyActv UEGO_RegGetPrmS1B1_I.flgWtrEleclyActvNxtPck UEGO_RegGetPrmS1B1_I.flgWtrEleclyActvNxtPckVld UEGO_RegGetPrmS1B1_I.flgWtrEleclyActvVld UEGO_RegGetPrmS1B1_I.flgZIsqrA UEGO_RegGetPrmS1B1_I.flgZIsqrAVld UEGO_RegGetPrmS1B1_I.flgZIsqrE UEGO_RegGetPrmS1B1_I.flgZIsqrEVld UEGO_RegGetPrmS1B1_I.nrIPmpBlcknNxtPck UEGO_RegGetPrmS1B1_I.nrIPmpLimnHi UEGO_RegGetPrmS1B1_I.nrIPmpLimnLo UEGO_RegGetPrmS1B1_I.nrPmpBlckn UEGO_RegGetPrmS1B1_I.nrRefPatNxtPck UEGO_RegGetPrmS1B1_I.nrRegIPmpSet UEGO_RegGetPrmS1B1_I.nrRegIPmpSetNxtPck UEGO_RegGetPrmS1B1_I.nrRegIpoff UEGO_RegGetPrmS1B1_I.nrRegMod UEGO_RegGetPrmS1B1_I.nrRegModNxtPck UEGO_RegGetPrmS1B1_I.nrRegPartMod UEGO_RegGetPrmS1B1_I.nrRegPartModNxtPck UEGO_RegGetPrmS1B1_I.nrRegTrmNxtPck UEGO_RegGetPrmS1B1_I.nrRegTrmSqNxtPck UEGO_RegGetPrmS1B1_I.nrRegTrmSqrNxtPck UEGO_RegGetPrmS1B1_I.nrRip UEGO_RegGetPrmS1B1_I.nrSteerPatNxtPck UEGO_RegGetPrmS1B1_I.nrSubModMeas UEGO_RegGetPrmS1B1_I.nrSubModMeasNxtPck UEGO_RegGetPrmS1B1_I.nrTrmSq UEGO_RegGetPrmS1B1_I.nrTrmSqCal UEGO_RegGetPrmS1B1_I.nrTrmSqr UEGO_RegGetPrmS1B1_I.nrTrmSqrCal UEGO_RegGetPrmS1B1_I.nrUnset UEGO_RegGetPrmS1B1_I.nrUnsetNxtPck UEGO_RegGetPrmS1B1_I.nrUp0Lean UEGO_RegGetPrmS1B1_I.nrUp0LeanNxtPck UEGO_RegGetPrmS1B1_I.nrUp0Rich UEGO_RegGetPrmS1B1_I.nrUp0RichNxtPck UEGO_RegGetPrmS1B1_I.stDlyBlckn UEGO_RegGetPrmS1B1_I.stDlyBlcknNxtPck UEGO_RegGetPrmS1B1_I.stEnSp UEGO_RegGetPrmS1B1_I.stEnSpNxtPck UEGO_RegGetPrmS1B1_I.stMK UEGO_RegGetPrmS1B1_I.stMKNxtPck UEGO_RegGetPrmS1B1_I.stOFF UEGO_RegGetPrmS1B1_I.stOFFNxtPck UEGO_RegGetPrmS1B1_I.stOPT UEGO_RegGetPrmS1B1_I.stOPTNxtPck UEGO_RegGetPrmS1B1_I.stPat UEGO_RegGetPrmS1B1_I.stPatNxtPck UEGO_RegGetPrmS1B1_I.stRef UEGO_RegGetPrmS1B1_I.stRefNxtPck UEGO_RegGetPrmS1B1_I.stRefPat UEGO_RegGetPrmS1B1_I.stRegIpoffNxtPck UEGO_RegGetPrmS1B1_I.stRiaPat UEGO_RegGetPrmS1B1_I.stSteerPat UEGO_RegGetPrmS1B1_I.stV1BF2 UEGO_RegGetPrmS1B1_I.stV1BF2NxtPck UEGO_RegGetPrmS1B1_I.stV1BF3NxtPck UEGO_stIsqrNernstS1B1 UEGO_uUn0PckAryS1B1 UEGO_uUriePckAryS1B1 /end IN_MEASUREMENT
 /begin OUT_MEASUREMENT UEGO_flgDeltaUnVldS1B1 UEGO_flgRNernstDiagVldS1B1 UEGO_flgRNernstHiPrcsnS1B1 UEGO_flgRNernstVldS1B1 UEGO_rRNernstDiagS1B1 UEGO_rRNernstS1B1 UEGO_uDeltaUnS1B1 /end OUT_MEASUREMENT
 /begin LOC_MEASUREMENT UEGO_RNernstEvlnS1B1_I.flgDeltaUnVld UEGO_RNernstEvlnS1B1_I.flgIsqrNernstSmall UEGO_RNernstEvlnS1B1_I.flgRNernstDiagFildVld UEGO_RNernstEvlnS1B1_I.flgRNernstDiagVld UEGO_RNernstEvlnS1B1_I.flgRNernstFildVld UEGO_RNernstEvlnS1B1_I.flgRNernstHiPrcsn UEGO_RNernstEvlnS1B1_I.flgRNernstVld UEGO_RNernstEvlnS1B1_I.isqrNernst UEGO_RNernstEvlnS1B1_I.isqrNernstDiag UEGO_RNernstEvlnS1B1_I.nrModInt UEGO_RNernstEvlnS1B1_I.rRNernst UEGO_RNernstEvlnS1B1_I.rRNernstDiag UEGO_RNernstEvlnS1B1_I.rRNernstDiagFild UEGO_RNernstEvlnS1B1_I.rRNernstDiagFildAry UEGO_RNernstEvlnS1B1_I.rRNernstDiagOld UEGO_RNernstEvlnS1B1_I.rRNernstFild UEGO_RNernstEvlnS1B1_I.rRNernstRawAry UEGO_RNernstEvlnS1B1_I.rRNernstRawDiagAry UEGO_RNernstEvlnS1B1_I.stDeltaUnRawAryVld UEGO_RNernstEvlnS1B1_I.stRNernstRawAryVld UEGO_RNernstEvlnS1B1_I.uDeltaUn UEGO_RNernstEvlnS1B1_I.uDeltaUnRawAry UEGO_RNernstEvlnS1B1_I.uNernst UEGO_RNernstEvlnS1B1_I.UEGO_RNernstEvlnPeakFilClass.flgFilStrtd UEGO_RNernstEvlnS1B1_I.UEGO_RNernstEvlnPeakFilClass.rDeltaInOutpMax /end LOC_MEASUREMENT
 FUNCTION_VERSION "1.18.0" /end FUNCTION
/begin FUNCTION UEGO_RPmp "1.20.0    UEGO ASIC Inner Resistance of Pump Cell"
 /begin DEF_CHARACTERISTIC UEGO_stRPmp_C UEGO_RPmpDeltaMax_C UEGO_rRFe_C UEGO_rRPmpCrvtCorrnSwtOn_T UEGO_rRPmpCrvtCorrnWrmUp_T /end DEF_CHARACTERISTIC
 /begin IN_MEASUREMENT UEGO_DataSplyClsS1B1_I.flgCj135An UEGO_DataSplyClsS1B1_I.flgDACOff UEGO_DataSplyClsS1B1_I.flgErrSpiRamRet UEGO_DataSplyClsS1B1_I.flgFKal1Vld UEGO_DataSplyClsS1B1_I.flgFKal2Vld UEGO_DataSplyClsS1B1_I.flgFKal3Vld UEGO_DataSplyClsS1B1_I.flgIPmpActvd UEGO_DataSplyClsS1B1_I.flgISQrA UEGO_DataSplyClsS1B1_I.flgISQrE UEGO_DataSplyClsS1B1_I.flgLCURR UEGO_DataSplyClsS1B1_I.flgLNMeas UEGO_DataSplyClsS1B1_I.flgLPMeas UEGO_DataSplyClsS1B1_I.flgLoupeCAL UEGO_DataSplyClsS1B1_I.flgLoupeG0 UEGO_DataSplyClsS1B1_I.flgLstPckAbort UEGO_DataSplyClsS1B1_I.flgMKA UEGO_DataSplyClsS1B1_I.flgMKE UEGO_DataSplyClsS1B1_I.flgNewIPmpDacPckAry UEGO_DataSplyClsS1B1_I.flgNewIPmpOK UEGO_DataSplyClsS1B1_I.flgNewIPmpPckAry UEGO_DataSplyClsS1B1_I.flgNewIPmpTM UEGO_DataSplyClsS1B1_I.flgNewPck UEGO_DataSplyClsS1B1_I.flgNewPckCstnc UEGO_DataSplyClsS1B1_I.flgNewPckMiss UEGO_DataSplyClsS1B1_I.flgNewPckVld UEGO_DataSplyClsS1B1_I.flgNewTiPck UEGO_DataSplyClsS1B1_I.flgNewURmVG4MeasAryVld UEGO_DataSplyClsS1B1_I.flgNewUa2Pck UEGO_DataSplyClsS1B1_I.flgNewUa31Pck UEGO_DataSplyClsS1B1_I.flgNewUa32Pck UEGO_DataSplyClsS1B1_I.flgNewUa33Pck UEGO_DataSplyClsS1B1_I.flgNewUamPck UEGO_DataSplyClsS1B1_I.flgNewUapePck UEGO_DataSplyClsS1B1_I.flgNewUcalMaxPck UEGO_DataSplyClsS1B1_I.flgNewUcalPck UEGO_DataSplyClsS1B1_I.flgNewUg0Pck UEGO_DataSplyClsS1B1_I.flgNewUg0PckAry UEGO_DataSplyClsS1B1_I.flgNewUg0aPck UEGO_DataSplyClsS1B1_I.flgNewUg0ePck UEGO_DataSplyClsS1B1_I.flgNewUg0iPck UEGO_DataSplyClsS1B1_I.flgNewUg0iPckAry UEGO_DataSplyClsS1B1_I.flgNewUg0iaiPck UEGO_DataSplyClsS1B1_I.flgNewUg0ieiPck UEGO_DataSplyClsS1B1_I.flgNewUg0ix7PckAry UEGO_DataSplyClsS1B1_I.flgNewUg0ix9PckAry UEGO_DataSplyClsS1B1_I.flgNewUg0ixPckAry UEGO_DataSplyClsS1B1_I.flgNewUg0mPck UEGO_DataSplyClsS1B1_I.flgNewUgaPck UEGO_DataSplyClsS1B1_I.flgNewUgiPckAry UEGO_DataSplyClsS1B1_I.flgNewUgkAvrgPck UEGO_DataSplyClsS1B1_I.flgNewUguaPck UEGO_DataSplyClsS1B1_I.flgNewUguaZ2Pck UEGO_DataSplyClsS1B1_I.flgNewUguiPck UEGO_DataSplyClsS1B1_I.flgNewUguiZ1Pck UEGO_DataSplyClsS1B1_I.flgNewUi21PckAry UEGO_DataSplyClsS1B1_I.flgNewUi22Pck UEGO_DataSplyClsS1B1_I.flgNewUi23Pck UEGO_DataSplyClsS1B1_I.flgNewUi24Pck UEGO_DataSplyClsS1B1_I.flgNewUi4Pck UEGO_DataSplyClsS1B1_I.flgNewUi4Z2Pck UEGO_DataSplyClsS1B1_I.flgNewUigPckAry UEGO_DataSplyClsS1B1_I.flgNewUigmkPckAry UEGO_DataSplyClsS1B1_I.flgNewUipcalAvrgPck UEGO_DataSplyClsS1B1_I.flgNewUn0Pck UEGO_DataSplyClsS1B1_I.flgNewUn0Pck4Ary UEGO_DataSplyClsS1B1_I.flgNewUn0Pck5Ary UEGO_DataSplyClsS1B1_I.flgNewUn0PckAry UEGO_DataSplyClsS1B1_I.flgNewUnPckAry UEGO_DataSplyClsS1B1_I.flgNewUnSetPck UEGO_DataSplyClsS1B1_I.flgNewUnx3PckAry UEGO_DataSplyClsS1B1_I.flgNewUnx4PckAry UEGO_DataSplyClsS1B1_I.flgNewUp0Pck UEGO_DataSplyClsS1B1_I.flgNewUp0Pck4 UEGO_DataSplyClsS1B1_I.flgNewUp0Pck5Ary UEGO_DataSplyClsS1B1_I.flgNewUp0PckAry UEGO_DataSplyClsS1B1_I.flgNewUpPckAry UEGO_DataSplyClsS1B1_I.flgNewUpx3PckAry UEGO_DataSplyClsS1B1_I.flgNewUpx4PckAry UEGO_DataSplyClsS1B1_I.flgNewUriaPckVld UEGO_DataSplyClsS1B1_I.flgNewUriePckAry UEGO_DataSplyClsS1B1_I.flgNewUx6PckAry UEGO_DataSplyClsS1B1_I.flgNewUx7PckAry UEGO_DataSplyClsS1B1_I.flgNewUx8PckAry UEGO_DataSplyClsS1B1_I.flgNewUx9PckAry UEGO_DataSplyClsS1B1_I.flgNewUxPckAry UEGO_DataSplyClsS1B1_I.flgReStable UEGO_DataSplyClsS1B1_I.flgSngCell UEGO_DataSplyClsS1B1_I.flgUical0Vld UEGO_DataSplyClsS1B1_I.flgUicalVld UEGO_DataSplyClsS1B1_I.flgUoffipe1Vld UEGO_DataSplyClsS1B1_I.flgUoffipe2Vld UEGO_DataSplyClsS1B1_I.flgUoffipe3Vld UEGO_DataSplyClsS1B1_I.flgUoffvcc1Vld UEGO_DataSplyClsS1B1_I.flgUoffvcc2Vld UEGO_DataSplyClsS1B1_I.flgUoffvcc3Vld UEGO_DataSplyClsS1B1_I.flgUriaMeas UEGO_DataSplyClsS1B1_I.nrIPmpDacPckAry UEGO_DataSplyClsS1B1_I.nrIpPckAry UEGO_DataSplyClsS1B1_I.nrModeMeas UEGO_DataSplyClsS1B1_I.nrRamFailPosn UEGO_DataSplyClsS1B1_I.nrRamMod UEGO_DataSplyClsS1B1_I.nrRamRegMod UEGO_DataSplyClsS1B1_I.nrRamSts1 UEGO_DataSplyClsS1B1_I.nrRamSts2 UEGO_DataSplyClsS1B1_I.nrRamSts3 UEGO_DataSplyClsS1B1_I.nrURmVG4PckAry UEGO_DataSplyClsS1B1_I.nrUa2PckAry UEGO_DataSplyClsS1B1_I.nrUcalMaxCorrd UEGO_DataSplyClsS1B1_I.nrUg0PckAry UEGO_DataSplyClsS1B1_I.nrUg0iPckAry UEGO_DataSplyClsS1B1_I.nrUg0ix7PckAry UEGO_DataSplyClsS1B1_I.nrUg0ix9PckAry UEGO_DataSplyClsS1B1_I.nrUg0ixPckAry UEGO_DataSplyClsS1B1_I.nrUgaPckAry UEGO_DataSplyClsS1B1_I.nrUgiPckAry UEGO_DataSplyClsS1B1_I.nrUi21PckAry UEGO_DataSplyClsS1B1_I.nrUical0PckCorrd UEGO_DataSplyClsS1B1_I.nrUicalPckCorrd UEGO_DataSplyClsS1B1_I.nrUigPckAry UEGO_DataSplyClsS1B1_I.nrUigmkPckAry UEGO_DataSplyClsS1B1_I.nrUn0Pck4Ary UEGO_DataSplyClsS1B1_I.nrUn0Pck5Ary UEGO_DataSplyClsS1B1_I.nrUn0PckAry UEGO_DataSplyClsS1B1_I.nrUnPckAry UEGO_DataSplyClsS1B1_I.nrUnx3PckAry UEGO_DataSplyClsS1B1_I.nrUnx4PckAry UEGO_DataSplyClsS1B1_I.nrUoffipe1 UEGO_DataSplyClsS1B1_I.nrUoffipe2 UEGO_DataSplyClsS1B1_I.nrUoffipe3 UEGO_DataSplyClsS1B1_I.nrUoffvcc1 UEGO_DataSplyClsS1B1_I.nrUoffvcc2 UEGO_DataSplyClsS1B1_I.nrUoffvcc3 UEGO_DataSplyClsS1B1_I.nrUp0Pck5Ary UEGO_DataSplyClsS1B1_I.nrUp0PckAry UEGO_DataSplyClsS1B1_I.nrUpPckAry UEGO_DataSplyClsS1B1_I.nrUpx3PckAry UEGO_DataSplyClsS1B1_I.nrUpx4PckAry UEGO_DataSplyClsS1B1_I.nrUriePckAry UEGO_DataSplyClsS1B1_I.nrUx6PckAry UEGO_DataSplyClsS1B1_I.nrUx7PckAry UEGO_DataSplyClsS1B1_I.nrUx8PckAry UEGO_DataSplyClsS1B1_I.nrUx9PckAry UEGO_DataSplyClsS1B1_I.nrUxPckAry UEGO_DataSplyClsS1B1_I.stIPmpOK UEGO_DataSplyClsS1B1_I.stIPmpTM UEGO_DataSplyClsS1B1_I.stIPmpTM2L UEGO_DataSplyClsS1B1_I.stIPmpTM2R UEGO_DataSplyClsS1B1_I.stLsmRetValMod UEGO_DataSplyClsS1B1_I.stMKMeas UEGO_DataSplyClsS1B1_I.stOFFMeas UEGO_DataSplyClsS1B1_I.stOPTMeas UEGO_DataSplyClsS1B1_I.stREFMeas UEGO_DataSplyClsS1B1_I.stUa2PckAry UEGO_DataSplyClsS1B1_I.stUa2Z1PckAry UEGO_DataSplyClsS1B1_I.stUg0iPckAry UEGO_DataSplyClsS1B1_I.stUg0ix7IActvPckAry UEGO_DataSplyClsS1B1_I.stUg0ix7PmpIActvPckAry UEGO_DataSplyClsS1B1_I.stUg0ix9IActvPckAry UEGO_DataSplyClsS1B1_I.stUg0ix9PmpIActvPckAry UEGO_DataSplyClsS1B1_I.stUg0ixIActvPckAry UEGO_DataSplyClsS1B1_I.stUg0ixPmpIActvPckAry UEGO_DataSplyClsS1B1_I.stUi21PckAry UEGO_DataSplyClsS1B1_I.stUi21Z1PckAry UEGO_DataSplyClsS1B1_I.stUigmkNernstIActvPckAry UEGO_DataSplyClsS1B1_I.stUigmkPmpIActvPckAry UEGO_DataSplyClsS1B1_I.stUn0PckAry UEGO_DataSplyClsS1B1_I.stUn0Z2PckAry UEGO_DataSplyClsS1B1_I.stUnPckAry UEGO_DataSplyClsS1B1_I.stUnx3IActvAcrsNernstCellPckAry UEGO_DataSplyClsS1B1_I.stUnx3IActvAcrsPmpCellPckAry UEGO_DataSplyClsS1B1_I.stUnx4IActvAcrsNernstCellPckAry UEGO_DataSplyClsS1B1_I.stUnx4IActvAcrsPmpCellPckAry UEGO_DataSplyClsS1B1_I.stUp0PckAry UEGO_DataSplyClsS1B1_I.stUp0Z2PckAry UEGO_DataSplyClsS1B1_I.stUpPckAry UEGO_DataSplyClsS1B1_I.stUpZ2PckAry UEGO_DataSplyClsS1B1_I.stUpx3IActvAcrsNernstCellPckAry UEGO_DataSplyClsS1B1_I.stUpx3IActvAcrsPmpCellPckAry UEGO_DataSplyClsS1B1_I.stUpx4IActvAcrsNernstCellPckAry UEGO_DataSplyClsS1B1_I.stUpx4IActvAcrsPmpCellPckAry UEGO_DataSplyClsS1B1_I.stUriePckAry UEGO_DataSplyClsS1B1_I.stUx6IActvPckAry UEGO_DataSplyClsS1B1_I.stUx6MeasAcrsPmpCellPckAry UEGO_DataSplyClsS1B1_I.stUx7IActvPckAry UEGO_DataSplyClsS1B1_I.stUx7MeasAcrsPmpCellPckAry UEGO_DataSplyClsS1B1_I.stUx8IActvPckAry UEGO_DataSplyClsS1B1_I.stUx8MeasAcrsPmpCellPckAry UEGO_DataSplyClsS1B1_I.stUx9IActvPckAry UEGO_DataSplyClsS1B1_I.stUx9MeasAcrsPmpCellPckAry UEGO_DataSplyClsS1B1_I.stUxIActvPckAry UEGO_DataSplyClsS1B1_I.stUxMeasAcrsPmpCell UEGO_DataSplyClsS1B1_I.tiUEGOPck UEGO_DataSplyClsS1B1_I.uFkal1 UEGO_DataSplyClsS1B1_I.uFkal2 UEGO_DataSplyClsS1B1_I.uFkal3 UEGO_DataSplyClsS1B1_I.uUCalPck UEGO_DataSplyClsS1B1_I.uUa31Pck UEGO_DataSplyClsS1B1_I.uUa32Pck UEGO_DataSplyClsS1B1_I.uUa33Pck UEGO_DataSplyClsS1B1_I.uUamPck UEGO_DataSplyClsS1B1_I.uUapePck UEGO_DataSplyClsS1B1_I.uUcalMaxPck UEGO_DataSplyClsS1B1_I.uUg0Pck UEGO_DataSplyClsS1B1_I.uUg0aPck UEGO_DataSplyClsS1B1_I.uUg0ePck UEGO_DataSplyClsS1B1_I.uUg0iPck UEGO_DataSplyClsS1B1_I.uUg0iaiPck UEGO_DataSplyClsS1B1_I.uUg0ieiPck UEGO_DataSplyClsS1B1_I.uUg0mPck UEGO_DataSplyClsS1B1_I.uUgkAvrgPck UEGO_DataSplyClsS1B1_I.uUguaPck UEGO_DataSplyClsS1B1_I.uUguaZ2Pck UEGO_DataSplyClsS1B1_I.uUguiPck UEGO_DataSplyClsS1B1_I.uUguiZ1Pck UEGO_DataSplyClsS1B1_I.uUi22Pck UEGO_DataSplyClsS1B1_I.uUi23Pck UEGO_DataSplyClsS1B1_I.uUi24Pck UEGO_DataSplyClsS1B1_I.uUi4Pck UEGO_DataSplyClsS1B1_I.uUi4Z2Pck UEGO_DataSplyClsS1B1_I.uUipcalAvrgPck UEGO_DataSplyClsS1B1_I.uUn0Pck UEGO_DataSplyClsS1B1_I.uUnSet UEGO_DataSplyClsS1B1_I.uUp0Pck UEGO_DataSplyClsS1B1_I.uUp0Pck4 UEGO_DataSplyClsS1B1_I.uUriaPck UEGO_DataSplyClsS1B1_I.uVCC1Corrd UEGO_DataSplyClsS1B1_I.uVCC3Ref UEGO_flgCJ135AnS1B1 UEGO_flgDiagSigWireOlRstS1B1 UEGO_flgIsqrMeasVldS1B1 UEGO_flgSnglCellS1B1 UEGO_flgSysSuprtdS1B1 UEGO_iIsqrDesS1B1 UEGO_iIsqrMeasS1B1 UEGO_iOffsIsqrPmpS1B1 UEGO_RegSetS1B1_I.cntrRegSet UEGO_RegSetS1B1_I.flgCJ135An UEGO_RegSetS1B1_I.flgConvVld UEGO_RegSetS1B1_I.flgIPmpDes UEGO_RegSetS1B1_I.flgIPmpPhyRels UEGO_RegSetS1B1_I.flgIniFinshd UEGO_RegSetS1B1_I.flgLoupeCURRDes UEGO_RegSetS1B1_I.flgLoupeDACDes UEGO_RegSetS1B1_I.flgLoupeNDes UEGO_RegSetS1B1_I.flgLoupePDes UEGO_RegSetS1B1_I.flgNewReq UEGO_RegSetS1B1_I.flgRegSetSt UEGO_RegSetS1B1_I.flgRegSetStVld UEGO_RegSetS1B1_I.flgReqAcptd UEGO_RegSetS1B1_I.flgSetRegOk UEGO_RegSetS1B1_I.flgTakeDataOk UEGO_RegSetS1B1_I.idxChp UEGO_RegSetS1B1_I.nrIdleSubMode UEGO_RegSetS1B1_I.nrModDes UEGO_RegSetS1B1_I.nrNormSubMode UEGO_RegSetS1B1_I.nrRegSet UEGO_RegSetS1B1_I.nrSubModDes UEGO_RegSetS1B1_I.nrSwtOnSubMode UEGO_RegSetS1B1_I.nrTrmSq UEGO_RegSetS1B1_I.nrWrmUpSubMode UEGO_RegSetS1B1_I.stRegSet UEGO_RegSetS1B1_I.stRegSetVld UEGO_RegSetS1B1_I.tmpVar UEGO_stIsqrPmpS1B1 UEGO_uUn0PckAryS1B1 UEGO_uUp0PckAryS1B1 /end IN_MEASUREMENT
 /begin OUT_MEASUREMENT UEGO_flgRPmpDiagVldS1B1 UEGO_flgRPmpHiPrcsnS1B1 UEGO_flgRPmpVldS1B1 UEGO_rRPmpDiagS1B1 UEGO_rRPmpS1B1 /end OUT_MEASUREMENT
 /begin LOC_MEASUREMENT UEGO_RPmpCtrlS1B1_I.flgUria UEGO_RPmpCtrlS1B1_I.flgUriaAcptd UEGO_RPmpCtrlS1B1_I.nrModIntCtrl UEGO_RPmpEvlnS1B1_I.flgRPmpDiagFildVld UEGO_RPmpEvlnS1B1_I.flgRPmpDiagVld UEGO_RPmpEvlnS1B1_I.flgRPmpFildVld UEGO_RPmpEvlnS1B1_I.flgRPmpHiPrcsn UEGO_RPmpEvlnS1B1_I.flgRPmpVld UEGO_RPmpEvlnS1B1_I.isqrPmp UEGO_RPmpEvlnS1B1_I.isqrPmpDiag UEGO_RPmpEvlnS1B1_I.nrModIntEvln UEGO_RPmpEvlnS1B1_I.rRPmp UEGO_RPmpEvlnS1B1_I.rRPmpDiag UEGO_RPmpEvlnS1B1_I.rRPmpDiagFild UEGO_RPmpEvlnS1B1_I.rRPmpDiagRaw UEGO_RPmpEvlnS1B1_I.rRPmpFild UEGO_RPmpEvlnS1B1_I.rRPmpRaw UEGO_RPmpEvlnS1B1_I.stRPmpRawAryClcd UEGO_RPmpEvlnS1B1_I.uPmp UEGO_RPmpEvlnS1B1_I.UEGO_RPmpEvlnPeakFilClass.flgFilStrtd UEGO_RPmpEvlnS1B1_I.UEGO_RPmpEvlnPeakFilClass.rDeltaInOutpMax /end LOC_MEASUREMENT
 FUNCTION_VERSION "1.20.0" /end FUNCTION
/begin FUNCTION UEGO_RPmpPlsOper "1.15.0    UEGO ASIC Inner Resistance of Pump Cell in Pulse operation"
 /begin DEF_CHARACTERISTIC UEGO_RPmpPlsOperDeltaMax_c UEGO_rRPmpPlsOperCorrnIp_T UEGO_stRPmpPlsOper_C /end DEF_CHARACTERISTIC
 /begin REF_CHARACTERISTIC UEGO_rRFe_C /end REF_CHARACTERISTIC
 /begin IN_MEASUREMENT UEGO_DataSplyClsS1B1_I.flgCj135An UEGO_DataSplyClsS1B1_I.flgDACOff UEGO_DataSplyClsS1B1_I.flgErrSpiRamRet UEGO_DataSplyClsS1B1_I.flgFKal1Vld UEGO_DataSplyClsS1B1_I.flgFKal2Vld UEGO_DataSplyClsS1B1_I.flgFKal3Vld UEGO_DataSplyClsS1B1_I.flgIPmpActvd UEGO_DataSplyClsS1B1_I.flgISQrA UEGO_DataSplyClsS1B1_I.flgISQrE UEGO_DataSplyClsS1B1_I.flgLCURR UEGO_DataSplyClsS1B1_I.flgLNMeas UEGO_DataSplyClsS1B1_I.flgLPMeas UEGO_DataSplyClsS1B1_I.flgLoupeCAL UEGO_DataSplyClsS1B1_I.flgLoupeG0 UEGO_DataSplyClsS1B1_I.flgLstPckAbort UEGO_DataSplyClsS1B1_I.flgMKA UEGO_DataSplyClsS1B1_I.flgMKE UEGO_DataSplyClsS1B1_I.flgNewIPmpDacPckAry UEGO_DataSplyClsS1B1_I.flgNewIPmpOK UEGO_DataSplyClsS1B1_I.flgNewIPmpPckAry UEGO_DataSplyClsS1B1_I.flgNewIPmpTM UEGO_DataSplyClsS1B1_I.flgNewPck UEGO_DataSplyClsS1B1_I.flgNewPckCstnc UEGO_DataSplyClsS1B1_I.flgNewPckMiss UEGO_DataSplyClsS1B1_I.flgNewPckVld UEGO_DataSplyClsS1B1_I.flgNewTiPck UEGO_DataSplyClsS1B1_I.flgNewURmVG4MeasAryVld UEGO_DataSplyClsS1B1_I.flgNewUa2Pck UEGO_DataSplyClsS1B1_I.flgNewUa31Pck UEGO_DataSplyClsS1B1_I.flgNewUa32Pck UEGO_DataSplyClsS1B1_I.flgNewUa33Pck UEGO_DataSplyClsS1B1_I.flgNewUamPck UEGO_DataSplyClsS1B1_I.flgNewUapePck UEGO_DataSplyClsS1B1_I.flgNewUcalMaxPck UEGO_DataSplyClsS1B1_I.flgNewUcalPck UEGO_DataSplyClsS1B1_I.flgNewUg0Pck UEGO_DataSplyClsS1B1_I.flgNewUg0PckAry UEGO_DataSplyClsS1B1_I.flgNewUg0aPck UEGO_DataSplyClsS1B1_I.flgNewUg0ePck UEGO_DataSplyClsS1B1_I.flgNewUg0iPck UEGO_DataSplyClsS1B1_I.flgNewUg0iPckAry UEGO_DataSplyClsS1B1_I.flgNewUg0iaiPck UEGO_DataSplyClsS1B1_I.flgNewUg0ieiPck UEGO_DataSplyClsS1B1_I.flgNewUg0ix7PckAry UEGO_DataSplyClsS1B1_I.flgNewUg0ix9PckAry UEGO_DataSplyClsS1B1_I.flgNewUg0ixPckAry UEGO_DataSplyClsS1B1_I.flgNewUg0mPck UEGO_DataSplyClsS1B1_I.flgNewUgaPck UEGO_DataSplyClsS1B1_I.flgNewUgiPckAry UEGO_DataSplyClsS1B1_I.flgNewUgkAvrgPck UEGO_DataSplyClsS1B1_I.flgNewUguaPck UEGO_DataSplyClsS1B1_I.flgNewUguaZ2Pck UEGO_DataSplyClsS1B1_I.flgNewUguiPck UEGO_DataSplyClsS1B1_I.flgNewUguiZ1Pck UEGO_DataSplyClsS1B1_I.flgNewUi21PckAry UEGO_DataSplyClsS1B1_I.flgNewUi22Pck UEGO_DataSplyClsS1B1_I.flgNewUi23Pck UEGO_DataSplyClsS1B1_I.flgNewUi24Pck UEGO_DataSplyClsS1B1_I.flgNewUi4Pck UEGO_DataSplyClsS1B1_I.flgNewUi4Z2Pck UEGO_DataSplyClsS1B1_I.flgNewUigPckAry UEGO_DataSplyClsS1B1_I.flgNewUigmkPckAry UEGO_DataSplyClsS1B1_I.flgNewUipcalAvrgPck UEGO_DataSplyClsS1B1_I.flgNewUn0Pck UEGO_DataSplyClsS1B1_I.flgNewUn0Pck4Ary UEGO_DataSplyClsS1B1_I.flgNewUn0Pck5Ary UEGO_DataSplyClsS1B1_I.flgNewUn0PckAry UEGO_DataSplyClsS1B1_I.flgNewUnPckAry UEGO_DataSplyClsS1B1_I.flgNewUnSetPck UEGO_DataSplyClsS1B1_I.flgNewUnx3PckAry UEGO_DataSplyClsS1B1_I.flgNewUnx4PckAry UEGO_DataSplyClsS1B1_I.flgNewUp0Pck UEGO_DataSplyClsS1B1_I.flgNewUp0Pck4 UEGO_DataSplyClsS1B1_I.flgNewUp0Pck5Ary UEGO_DataSplyClsS1B1_I.flgNewUp0PckAry UEGO_DataSplyClsS1B1_I.flgNewUpPckAry UEGO_DataSplyClsS1B1_I.flgNewUpx3PckAry UEGO_DataSplyClsS1B1_I.flgNewUpx4PckAry UEGO_DataSplyClsS1B1_I.flgNewUriaPckVld UEGO_DataSplyClsS1B1_I.flgNewUriePckAry UEGO_DataSplyClsS1B1_I.flgNewUx6PckAry UEGO_DataSplyClsS1B1_I.flgNewUx7PckAry UEGO_DataSplyClsS1B1_I.flgNewUx8PckAry UEGO_DataSplyClsS1B1_I.flgNewUx9PckAry UEGO_DataSplyClsS1B1_I.flgNewUxPckAry UEGO_DataSplyClsS1B1_I.flgReStable UEGO_DataSplyClsS1B1_I.flgSngCell UEGO_DataSplyClsS1B1_I.flgUical0Vld UEGO_DataSplyClsS1B1_I.flgUicalVld UEGO_DataSplyClsS1B1_I.flgUoffipe1Vld UEGO_DataSplyClsS1B1_I.flgUoffipe2Vld UEGO_DataSplyClsS1B1_I.flgUoffipe3Vld UEGO_DataSplyClsS1B1_I.flgUoffvcc1Vld UEGO_DataSplyClsS1B1_I.flgUoffvcc2Vld UEGO_DataSplyClsS1B1_I.flgUoffvcc3Vld UEGO_DataSplyClsS1B1_I.flgUriaMeas UEGO_DataSplyClsS1B1_I.nrIPmpDacPckAry UEGO_DataSplyClsS1B1_I.nrIpPckAry UEGO_DataSplyClsS1B1_I.nrModeMeas UEGO_DataSplyClsS1B1_I.nrRamFailPosn UEGO_DataSplyClsS1B1_I.nrRamMod UEGO_DataSplyClsS1B1_I.nrRamRegMod UEGO_DataSplyClsS1B1_I.nrRamSts1 UEGO_DataSplyClsS1B1_I.nrRamSts2 UEGO_DataSplyClsS1B1_I.nrRamSts3 UEGO_DataSplyClsS1B1_I.nrURmVG4PckAry UEGO_DataSplyClsS1B1_I.nrUa2PckAry UEGO_DataSplyClsS1B1_I.nrUcalMaxCorrd UEGO_DataSplyClsS1B1_I.nrUg0PckAry UEGO_DataSplyClsS1B1_I.nrUg0iPckAry UEGO_DataSplyClsS1B1_I.nrUg0ix7PckAry UEGO_DataSplyClsS1B1_I.nrUg0ix9PckAry UEGO_DataSplyClsS1B1_I.nrUg0ixPckAry UEGO_DataSplyClsS1B1_I.nrUgaPckAry UEGO_DataSplyClsS1B1_I.nrUgiPckAry UEGO_DataSplyClsS1B1_I.nrUi21PckAry UEGO_DataSplyClsS1B1_I.nrUical0PckCorrd UEGO_DataSplyClsS1B1_I.nrUicalPckCorrd UEGO_DataSplyClsS1B1_I.nrUigPckAry UEGO_DataSplyClsS1B1_I.nrUigmkPckAry UEGO_DataSplyClsS1B1_I.nrUn0Pck4Ary UEGO_DataSplyClsS1B1_I.nrUn0Pck5Ary UEGO_DataSplyClsS1B1_I.nrUn0PckAry UEGO_DataSplyClsS1B1_I.nrUnPckAry UEGO_DataSplyClsS1B1_I.nrUnx3PckAry UEGO_DataSplyClsS1B1_I.nrUnx4PckAry UEGO_DataSplyClsS1B1_I.nrUoffipe1 UEGO_DataSplyClsS1B1_I.nrUoffipe2 UEGO_DataSplyClsS1B1_I.nrUoffipe3 UEGO_DataSplyClsS1B1_I.nrUoffvcc1 UEGO_DataSplyClsS1B1_I.nrUoffvcc2 UEGO_DataSplyClsS1B1_I.nrUoffvcc3 UEGO_DataSplyClsS1B1_I.nrUp0Pck5Ary UEGO_DataSplyClsS1B1_I.nrUp0PckAry UEGO_DataSplyClsS1B1_I.nrUpPckAry UEGO_DataSplyClsS1B1_I.nrUpx3PckAry UEGO_DataSplyClsS1B1_I.nrUpx4PckAry UEGO_DataSplyClsS1B1_I.nrUriePckAry UEGO_DataSplyClsS1B1_I.nrUx6PckAry UEGO_DataSplyClsS1B1_I.nrUx7PckAry UEGO_DataSplyClsS1B1_I.nrUx8PckAry UEGO_DataSplyClsS1B1_I.nrUx9PckAry UEGO_DataSplyClsS1B1_I.nrUxPckAry UEGO_DataSplyClsS1B1_I.stIPmpOK UEGO_DataSplyClsS1B1_I.stIPmpTM UEGO_DataSplyClsS1B1_I.stIPmpTM2L UEGO_DataSplyClsS1B1_I.stIPmpTM2R UEGO_DataSplyClsS1B1_I.stLsmRetValMod UEGO_DataSplyClsS1B1_I.stMKMeas UEGO_DataSplyClsS1B1_I.stOFFMeas UEGO_DataSplyClsS1B1_I.stOPTMeas UEGO_DataSplyClsS1B1_I.stREFMeas UEGO_DataSplyClsS1B1_I.stUa2PckAry UEGO_DataSplyClsS1B1_I.stUa2Z1PckAry UEGO_DataSplyClsS1B1_I.stUg0iPckAry UEGO_DataSplyClsS1B1_I.stUg0ix7IActvPckAry UEGO_DataSplyClsS1B1_I.stUg0ix7PmpIActvPckAry UEGO_DataSplyClsS1B1_I.stUg0ix9IActvPckAry UEGO_DataSplyClsS1B1_I.stUg0ix9PmpIActvPckAry UEGO_DataSplyClsS1B1_I.stUg0ixIActvPckAry UEGO_DataSplyClsS1B1_I.stUg0ixPmpIActvPckAry UEGO_DataSplyClsS1B1_I.stUi21PckAry UEGO_DataSplyClsS1B1_I.stUi21Z1PckAry UEGO_DataSplyClsS1B1_I.stUigmkNernstIActvPckAry UEGO_DataSplyClsS1B1_I.stUigmkPmpIActvPckAry UEGO_DataSplyClsS1B1_I.stUn0PckAry UEGO_DataSplyClsS1B1_I.stUn0Z2PckAry UEGO_DataSplyClsS1B1_I.stUnPckAry UEGO_DataSplyClsS1B1_I.stUnx3IActvAcrsNernstCellPckAry UEGO_DataSplyClsS1B1_I.stUnx3IActvAcrsPmpCellPckAry UEGO_DataSplyClsS1B1_I.stUnx4IActvAcrsNernstCellPckAry UEGO_DataSplyClsS1B1_I.stUnx4IActvAcrsPmpCellPckAry UEGO_DataSplyClsS1B1_I.stUp0PckAry UEGO_DataSplyClsS1B1_I.stUp0Z2PckAry UEGO_DataSplyClsS1B1_I.stUpPckAry UEGO_DataSplyClsS1B1_I.stUpZ2PckAry UEGO_DataSplyClsS1B1_I.stUpx3IActvAcrsNernstCellPckAry UEGO_DataSplyClsS1B1_I.stUpx3IActvAcrsPmpCellPckAry UEGO_DataSplyClsS1B1_I.stUpx4IActvAcrsNernstCellPckAry UEGO_DataSplyClsS1B1_I.stUpx4IActvAcrsPmpCellPckAry UEGO_DataSplyClsS1B1_I.stUriePckAry UEGO_DataSplyClsS1B1_I.stUx6IActvPckAry UEGO_DataSplyClsS1B1_I.stUx6MeasAcrsPmpCellPckAry UEGO_DataSplyClsS1B1_I.stUx7IActvPckAry UEGO_DataSplyClsS1B1_I.stUx7MeasAcrsPmpCellPckAry UEGO_DataSplyClsS1B1_I.stUx8IActvPckAry UEGO_DataSplyClsS1B1_I.stUx8MeasAcrsPmpCellPckAry UEGO_DataSplyClsS1B1_I.stUx9IActvPckAry UEGO_DataSplyClsS1B1_I.stUx9MeasAcrsPmpCellPckAry UEGO_DataSplyClsS1B1_I.stUxIActvPckAry UEGO_DataSplyClsS1B1_I.stUxMeasAcrsPmpCell UEGO_DataSplyClsS1B1_I.tiUEGOPck UEGO_DataSplyClsS1B1_I.uFkal1 UEGO_DataSplyClsS1B1_I.uFkal2 UEGO_DataSplyClsS1B1_I.uFkal3 UEGO_DataSplyClsS1B1_I.uUCalPck UEGO_DataSplyClsS1B1_I.uUa31Pck UEGO_DataSplyClsS1B1_I.uUa32Pck UEGO_DataSplyClsS1B1_I.uUa33Pck UEGO_DataSplyClsS1B1_I.uUamPck UEGO_DataSplyClsS1B1_I.uUapePck UEGO_DataSplyClsS1B1_I.uUcalMaxPck UEGO_DataSplyClsS1B1_I.uUg0Pck UEGO_DataSplyClsS1B1_I.uUg0aPck UEGO_DataSplyClsS1B1_I.uUg0ePck UEGO_DataSplyClsS1B1_I.uUg0iPck UEGO_DataSplyClsS1B1_I.uUg0iaiPck UEGO_DataSplyClsS1B1_I.uUg0ieiPck UEGO_DataSplyClsS1B1_I.uUg0mPck UEGO_DataSplyClsS1B1_I.uUgkAvrgPck UEGO_DataSplyClsS1B1_I.uUguaPck UEGO_DataSplyClsS1B1_I.uUguaZ2Pck UEGO_DataSplyClsS1B1_I.uUguiPck UEGO_DataSplyClsS1B1_I.uUguiZ1Pck UEGO_DataSplyClsS1B1_I.uUi22Pck UEGO_DataSplyClsS1B1_I.uUi23Pck UEGO_DataSplyClsS1B1_I.uUi24Pck UEGO_DataSplyClsS1B1_I.uUi4Pck UEGO_DataSplyClsS1B1_I.uUi4Z2Pck UEGO_DataSplyClsS1B1_I.uUipcalAvrgPck UEGO_DataSplyClsS1B1_I.uUn0Pck UEGO_DataSplyClsS1B1_I.uUnSet UEGO_DataSplyClsS1B1_I.uUp0Pck UEGO_DataSplyClsS1B1_I.uUp0Pck4 UEGO_DataSplyClsS1B1_I.uUriaPck UEGO_DataSplyClsS1B1_I.uVCC1Corrd UEGO_DataSplyClsS1B1_I.uVCC3Ref UEGO_flgCJ135AnS1B1 UEGO_flgDiagSigWireOlRstS1B1 UEGO_flgIPmpSegVldS1B1 UEGO_flgIsqMeasVldS1B1 UEGO_flgSnglCellS1B1 UEGO_flgSysSuprtdS1B1 UEGO_iIPmpSegS1B1 UEGO_iIsqMeasRawS1B1 UEGO_iIsqMeasS1B1 UEGO_uUa2PckAryS1B1 UEGO_uUi21PckAryS1B1 UEGO_uUn0PckAryS1B1 UEGO_uUp0PckAryS1B1 UEGO_uUpPckAryS1B1 /end IN_MEASUREMENT
 /begin OUT_MEASUREMENT UEGO_flgRPmpPlsOperDiagVldS1B1 UEGO_flgRPmpPlsOperHiPrcsnS1B1 UEGO_flgRPmpPlsOperVldS1B1 UEGO_rRPmpPlsOperDiagS1B1 UEGO_rRPmpPlsOperS1B1 /end OUT_MEASUREMENT
 /begin LOC_MEASUREMENT UEGO_RPmpPlsOperS1B1_I.flgRPmpPlsOperDiagVld UEGO_RPmpPlsOperS1B1_I.flgRPmpPlsOperFildLoPrcsn UEGO_RPmpPlsOperS1B1_I.flgRPmpPlsOperFildVld UEGO_RPmpPlsOperS1B1_I.flgRPmpPlsOperHiPrcsn UEGO_RPmpPlsOperS1B1_I.flgRPmpPlsOperVld UEGO_RPmpPlsOperS1B1_I.nrModInt UEGO_RPmpPlsOperS1B1_I.nrURPmpPlsOper UEGO_RPmpPlsOperS1B1_I.rRPmpPlsOper UEGO_RPmpPlsOperS1B1_I.rRPmpPlsOperDiag UEGO_RPmpPlsOperS1B1_I.rRPmpPlsOperDiagFild UEGO_RPmpPlsOperS1B1_I.rRPmpPlsOperDiagFildAry UEGO_RPmpPlsOperS1B1_I.rRPmpPlsOperDiagFildOld UEGO_RPmpPlsOperS1B1_I.rRPmpPlsOperDiagRawAry UEGO_RPmpPlsOperS1B1_I.rRPmpPlsOperFild UEGO_RPmpPlsOperS1B1_I.rRPmpPlsOperRawAry UEGO_RPmpPlsOperS1B1_I.stRPmpPlsOperRawAryVld UEGO_RPmpPlsOperS1B1_I.stRPmpPlsOperRawLoPrcsnAry UEGO_RPmpPlsOperS1B1_I.stURPmpPlsOperAryPrsnt UEGO_RPmpPlsOperS1B1_I.stURPmpPlsOperLoPrcsnAry UEGO_RPmpPlsOperS1B1_I.uU1RPmpPlsOperAry UEGO_RPmpPlsOperS1B1_I.uU2RPmpPlsOperAry UEGO_RPmpPlsOperS1B1_I.uURPmp UEGO_RPmpPlsOperS1B1_I.UEGO_RPmpPlsOpertEvlnPeakFilClass.flgFilStrtd UEGO_RPmpPlsOperS1B1_I.UEGO_RPmpPlsOpertEvlnPeakFilClass.rDeltaInOutpMax /end LOC_MEASUREMENT
 FUNCTION_VERSION "1.15.0" /end FUNCTION
/begin FUNCTION UEGO_RvsChrg "1.6.0     UEGO Reverse Charge Determination"
 /begin DEF_CHARACTERISTIC UEGO_cndAprvdUp0Corrn_C UEGO_cntrCpCalc_C UEGO_cpCamgGainIni_C UEGO_cpCamgIni_C UEGO_cpCigGainIni_C UEGO_cpCigIni_C UEGO_facCorKIA11P_CUR UEGO_facCorKIA12P_CUR UEGO_facCorKIA21P_CUR UEGO_facCorKIA22P_CUR UEGO_facCorKIV1P_CUR UEGO_facDeltaUiFltConst_C UEGO_facDeltaUiFltVldConst_C UEGO_facUgiCorrn_C UEGO_facUguxCorrn_T UEGO_facUgxCorrn_T UEGO_iIPmpRvsChrgCorrnOffsTM1Lean_C UEGO_iIPmpRvsChrgCorrnOffsTM1Rich_C UEGO_iIPmpRvsChrgCorrnOffsTM2Lean_C UEGO_iIPmpRvsChrgCorrnOffsTM2Rich_C UEGO_iIPmpRvsChrgCorrnTM1Lean_C UEGO_iIPmpRvsChrgCorrnTM1Rich_C UEGO_iIPmpRvsChrgCorrnTM2Lean_C UEGO_iIPmpRvsChrgCorrnTM2Rich_C UEGO_iIsqDesCMeas_C UEGO_nrRvsChrgCMeasOffs_C UEGO_nrRvsChrgUiMeasOffs_C UEGO_numRegIpsmRvsChrg_C UEGO_numRegPatCMeas_C UEGO_numRegPatUiMeas_C UEGO_ratIPmpLearnUiLeanMin_C UEGO_ratIPmpLearnUiRichMax_C UEGO_ratIPmpLearnUiStdMax_C UEGO_ratIPmpLearnUiStdMin_C UEGO_rRPmpThdCpCalcn_C UEGO_stRvsChrgHiPrcsnBitMask_C UEGO_stRvsChrgVldBitMask_C UEGO_stRvsChrg_C UEGO_tCeramicDeRvsChrg_C UEGO_tiMeasIPmpTM2Min_C UEGO_tiUi21MeasPosn_C UEGO_uDeltaUi22Ini_C UEGO_uDeltaUi23Ini_C UEGO_uDeltaUi24Ini_C UEGO_uDetrmtMinThd_C /end DEF_CHARACTERISTIC
 /begin REF_CHARACTERISTIC UEGO_resRGnd_C UEGO_tCeramicHeatrSp_C /end REF_CHARACTERISTIC
 /begin IN_MEASUREMENT Eep_EnvRamInvld UEGO_DataSplyClsS1B1_I.flgCj135An UEGO_DataSplyClsS1B1_I.flgDACOff UEGO_DataSplyClsS1B1_I.flgErrSpiRamRet UEGO_DataSplyClsS1B1_I.flgFKal1Vld UEGO_DataSplyClsS1B1_I.flgFKal2Vld UEGO_DataSplyClsS1B1_I.flgFKal3Vld UEGO_DataSplyClsS1B1_I.flgIPmpActvd UEGO_DataSplyClsS1B1_I.flgISQrA UEGO_DataSplyClsS1B1_I.flgISQrE UEGO_DataSplyClsS1B1_I.flgLCURR UEGO_DataSplyClsS1B1_I.flgLNMeas UEGO_DataSplyClsS1B1_I.flgLPMeas UEGO_DataSplyClsS1B1_I.flgLoupeCAL UEGO_DataSplyClsS1B1_I.flgLoupeG0 UEGO_DataSplyClsS1B1_I.flgLstPckAbort UEGO_DataSplyClsS1B1_I.flgMKA UEGO_DataSplyClsS1B1_I.flgMKE UEGO_DataSplyClsS1B1_I.flgNewIPmpDacPckAry UEGO_DataSplyClsS1B1_I.flgNewIPmpOK UEGO_DataSplyClsS1B1_I.flgNewIPmpPckAry UEGO_DataSplyClsS1B1_I.flgNewIPmpTM UEGO_DataSplyClsS1B1_I.flgNewPck UEGO_DataSplyClsS1B1_I.flgNewPckCstnc UEGO_DataSplyClsS1B1_I.flgNewPckMiss UEGO_DataSplyClsS1B1_I.flgNewPckVld UEGO_DataSplyClsS1B1_I.flgNewTiPck UEGO_DataSplyClsS1B1_I.flgNewURmVG4MeasAryVld UEGO_DataSplyClsS1B1_I.flgNewUa2Pck UEGO_DataSplyClsS1B1_I.flgNewUa31Pck UEGO_DataSplyClsS1B1_I.flgNewUa32Pck UEGO_DataSplyClsS1B1_I.flgNewUa33Pck UEGO_DataSplyClsS1B1_I.flgNewUamPck UEGO_DataSplyClsS1B1_I.flgNewUapePck UEGO_DataSplyClsS1B1_I.flgNewUcalMaxPck UEGO_DataSplyClsS1B1_I.flgNewUcalPck UEGO_DataSplyClsS1B1_I.flgNewUg0Pck UEGO_DataSplyClsS1B1_I.flgNewUg0PckAry UEGO_DataSplyClsS1B1_I.flgNewUg0aPck UEGO_DataSplyClsS1B1_I.flgNewUg0ePck UEGO_DataSplyClsS1B1_I.flgNewUg0iPck UEGO_DataSplyClsS1B1_I.flgNewUg0iPckAry UEGO_DataSplyClsS1B1_I.flgNewUg0iaiPck UEGO_DataSplyClsS1B1_I.flgNewUg0ieiPck UEGO_DataSplyClsS1B1_I.flgNewUg0ix7PckAry UEGO_DataSplyClsS1B1_I.flgNewUg0ix9PckAry UEGO_DataSplyClsS1B1_I.flgNewUg0ixPckAry UEGO_DataSplyClsS1B1_I.flgNewUg0mPck UEGO_DataSplyClsS1B1_I.flgNewUgaPck UEGO_DataSplyClsS1B1_I.flgNewUgiPckAry UEGO_DataSplyClsS1B1_I.flgNewUgkAvrgPck UEGO_DataSplyClsS1B1_I.flgNewUguaPck UEGO_DataSplyClsS1B1_I.flgNewUguaZ2Pck UEGO_DataSplyClsS1B1_I.flgNewUguiPck UEGO_DataSplyClsS1B1_I.flgNewUguiZ1Pck UEGO_DataSplyClsS1B1_I.flgNewUi21PckAry UEGO_DataSplyClsS1B1_I.flgNewUi22Pck UEGO_DataSplyClsS1B1_I.flgNewUi23Pck UEGO_DataSplyClsS1B1_I.flgNewUi24Pck UEGO_DataSplyClsS1B1_I.flgNewUi4Pck UEGO_DataSplyClsS1B1_I.flgNewUi4Z2Pck UEGO_DataSplyClsS1B1_I.flgNewUigPckAry UEGO_DataSplyClsS1B1_I.flgNewUigmkPckAry UEGO_DataSplyClsS1B1_I.flgNewUipcalAvrgPck UEGO_DataSplyClsS1B1_I.flgNewUn0Pck UEGO_DataSplyClsS1B1_I.flgNewUn0Pck4Ary UEGO_DataSplyClsS1B1_I.flgNewUn0Pck5Ary UEGO_DataSplyClsS1B1_I.flgNewUn0PckAry UEGO_DataSplyClsS1B1_I.flgNewUnPckAry UEGO_DataSplyClsS1B1_I.flgNewUnSetPck UEGO_DataSplyClsS1B1_I.flgNewUnx3PckAry UEGO_DataSplyClsS1B1_I.flgNewUnx4PckAry UEGO_DataSplyClsS1B1_I.flgNewUp0Pck UEGO_DataSplyClsS1B1_I.flgNewUp0Pck4 UEGO_DataSplyClsS1B1_I.flgNewUp0Pck5Ary UEGO_DataSplyClsS1B1_I.flgNewUp0PckAry UEGO_DataSplyClsS1B1_I.flgNewUpPckAry UEGO_DataSplyClsS1B1_I.flgNewUpx3PckAry UEGO_DataSplyClsS1B1_I.flgNewUpx4PckAry UEGO_DataSplyClsS1B1_I.flgNewUriaPckVld UEGO_DataSplyClsS1B1_I.flgNewUriePckAry UEGO_DataSplyClsS1B1_I.flgNewUx6PckAry UEGO_DataSplyClsS1B1_I.flgNewUx7PckAry UEGO_DataSplyClsS1B1_I.flgNewUx8PckAry UEGO_DataSplyClsS1B1_I.flgNewUx9PckAry UEGO_DataSplyClsS1B1_I.flgNewUxPckAry UEGO_DataSplyClsS1B1_I.flgReStable UEGO_DataSplyClsS1B1_I.flgSngCell UEGO_DataSplyClsS1B1_I.flgUical0Vld UEGO_DataSplyClsS1B1_I.flgUicalVld UEGO_DataSplyClsS1B1_I.flgUoffipe1Vld UEGO_DataSplyClsS1B1_I.flgUoffipe2Vld UEGO_DataSplyClsS1B1_I.flgUoffipe3Vld UEGO_DataSplyClsS1B1_I.flgUoffvcc1Vld UEGO_DataSplyClsS1B1_I.flgUoffvcc2Vld UEGO_DataSplyClsS1B1_I.flgUoffvcc3Vld UEGO_DataSplyClsS1B1_I.flgUriaMeas UEGO_DataSplyClsS1B1_I.nrIPmpDacPckAry UEGO_DataSplyClsS1B1_I.nrIpPckAry UEGO_DataSplyClsS1B1_I.nrModeMeas UEGO_DataSplyClsS1B1_I.nrRamFailPosn UEGO_DataSplyClsS1B1_I.nrRamMod UEGO_DataSplyClsS1B1_I.nrRamRegMod UEGO_DataSplyClsS1B1_I.nrRamSts1 UEGO_DataSplyClsS1B1_I.nrRamSts2 UEGO_DataSplyClsS1B1_I.nrRamSts3 UEGO_DataSplyClsS1B1_I.nrURmVG4PckAry UEGO_DataSplyClsS1B1_I.nrUa2PckAry UEGO_DataSplyClsS1B1_I.nrUcalMaxCorrd UEGO_DataSplyClsS1B1_I.nrUg0PckAry UEGO_DataSplyClsS1B1_I.nrUg0iPckAry UEGO_DataSplyClsS1B1_I.nrUg0ix7PckAry UEGO_DataSplyClsS1B1_I.nrUg0ix9PckAry UEGO_DataSplyClsS1B1_I.nrUg0ixPckAry UEGO_DataSplyClsS1B1_I.nrUgaPckAry UEGO_DataSplyClsS1B1_I.nrUgiPckAry UEGO_DataSplyClsS1B1_I.nrUi21PckAry UEGO_DataSplyClsS1B1_I.nrUical0PckCorrd UEGO_DataSplyClsS1B1_I.nrUicalPckCorrd UEGO_DataSplyClsS1B1_I.nrUigPckAry UEGO_DataSplyClsS1B1_I.nrUigmkPckAry UEGO_DataSplyClsS1B1_I.nrUn0Pck4Ary UEGO_DataSplyClsS1B1_I.nrUn0Pck5Ary UEGO_DataSplyClsS1B1_I.nrUn0PckAry UEGO_DataSplyClsS1B1_I.nrUnPckAry UEGO_DataSplyClsS1B1_I.nrUnx3PckAry UEGO_DataSplyClsS1B1_I.nrUnx4PckAry UEGO_DataSplyClsS1B1_I.nrUoffipe1 UEGO_DataSplyClsS1B1_I.nrUoffipe2 UEGO_DataSplyClsS1B1_I.nrUoffipe3 UEGO_DataSplyClsS1B1_I.nrUoffvcc1 UEGO_DataSplyClsS1B1_I.nrUoffvcc2 UEGO_DataSplyClsS1B1_I.nrUoffvcc3 UEGO_DataSplyClsS1B1_I.nrUp0Pck5Ary UEGO_DataSplyClsS1B1_I.nrUp0PckAry UEGO_DataSplyClsS1B1_I.nrUpPckAry UEGO_DataSplyClsS1B1_I.nrUpx3PckAry UEGO_DataSplyClsS1B1_I.nrUpx4PckAry UEGO_DataSplyClsS1B1_I.nrUriePckAry UEGO_DataSplyClsS1B1_I.nrUx6PckAry UEGO_DataSplyClsS1B1_I.nrUx7PckAry UEGO_DataSplyClsS1B1_I.nrUx8PckAry UEGO_DataSplyClsS1B1_I.nrUx9PckAry UEGO_DataSplyClsS1B1_I.nrUxPckAry UEGO_DataSplyClsS1B1_I.stIPmpOK UEGO_DataSplyClsS1B1_I.stIPmpTM UEGO_DataSplyClsS1B1_I.stIPmpTM2L UEGO_DataSplyClsS1B1_I.stIPmpTM2R UEGO_DataSplyClsS1B1_I.stLsmRetValMod UEGO_DataSplyClsS1B1_I.stMKMeas UEGO_DataSplyClsS1B1_I.stOFFMeas UEGO_DataSplyClsS1B1_I.stOPTMeas UEGO_DataSplyClsS1B1_I.stREFMeas UEGO_DataSplyClsS1B1_I.stUa2PckAry UEGO_DataSplyClsS1B1_I.stUa2Z1PckAry UEGO_DataSplyClsS1B1_I.stUg0iPckAry UEGO_DataSplyClsS1B1_I.stUg0ix7IActvPckAry UEGO_DataSplyClsS1B1_I.stUg0ix7PmpIActvPckAry UEGO_DataSplyClsS1B1_I.stUg0ix9IActvPckAry UEGO_DataSplyClsS1B1_I.stUg0ix9PmpIActvPckAry UEGO_DataSplyClsS1B1_I.stUg0ixIActvPckAry UEGO_DataSplyClsS1B1_I.stUg0ixPmpIActvPckAry UEGO_DataSplyClsS1B1_I.stUi21PckAry UEGO_DataSplyClsS1B1_I.stUi21Z1PckAry UEGO_DataSplyClsS1B1_I.stUigmkNernstIActvPckAry UEGO_DataSplyClsS1B1_I.stUigmkPmpIActvPckAry UEGO_DataSplyClsS1B1_I.stUn0PckAry UEGO_DataSplyClsS1B1_I.stUn0Z2PckAry UEGO_DataSplyClsS1B1_I.stUnPckAry UEGO_DataSplyClsS1B1_I.stUnx3IActvAcrsNernstCellPckAry UEGO_DataSplyClsS1B1_I.stUnx3IActvAcrsPmpCellPckAry UEGO_DataSplyClsS1B1_I.stUnx4IActvAcrsNernstCellPckAry UEGO_DataSplyClsS1B1_I.stUnx4IActvAcrsPmpCellPckAry UEGO_DataSplyClsS1B1_I.stUp0PckAry UEGO_DataSplyClsS1B1_I.stUp0Z2PckAry UEGO_DataSplyClsS1B1_I.stUpPckAry UEGO_DataSplyClsS1B1_I.stUpZ2PckAry UEGO_DataSplyClsS1B1_I.stUpx3IActvAcrsNernstCellPckAry UEGO_DataSplyClsS1B1_I.stUpx3IActvAcrsPmpCellPckAry UEGO_DataSplyClsS1B1_I.stUpx4IActvAcrsNernstCellPckAry UEGO_DataSplyClsS1B1_I.stUpx4IActvAcrsPmpCellPckAry UEGO_DataSplyClsS1B1_I.stUriePckAry UEGO_DataSplyClsS1B1_I.stUx6IActvPckAry UEGO_DataSplyClsS1B1_I.stUx6MeasAcrsPmpCellPckAry UEGO_DataSplyClsS1B1_I.stUx7IActvPckAry UEGO_DataSplyClsS1B1_I.stUx7MeasAcrsPmpCellPckAry UEGO_DataSplyClsS1B1_I.stUx8IActvPckAry UEGO_DataSplyClsS1B1_I.stUx8MeasAcrsPmpCellPckAry UEGO_DataSplyClsS1B1_I.stUx9IActvPckAry UEGO_DataSplyClsS1B1_I.stUx9MeasAcrsPmpCellPckAry UEGO_DataSplyClsS1B1_I.stUxIActvPckAry UEGO_DataSplyClsS1B1_I.stUxMeasAcrsPmpCell UEGO_DataSplyClsS1B1_I.tiUEGOPck UEGO_DataSplyClsS1B1_I.uFkal1 UEGO_DataSplyClsS1B1_I.uFkal2 UEGO_DataSplyClsS1B1_I.uFkal3 UEGO_DataSplyClsS1B1_I.uUCalPck UEGO_DataSplyClsS1B1_I.uUa31Pck UEGO_DataSplyClsS1B1_I.uUa32Pck UEGO_DataSplyClsS1B1_I.uUa33Pck UEGO_DataSplyClsS1B1_I.uUamPck UEGO_DataSplyClsS1B1_I.uUapePck UEGO_DataSplyClsS1B1_I.uUcalMaxPck UEGO_DataSplyClsS1B1_I.uUg0Pck UEGO_DataSplyClsS1B1_I.uUg0aPck UEGO_DataSplyClsS1B1_I.uUg0ePck UEGO_DataSplyClsS1B1_I.uUg0iPck UEGO_DataSplyClsS1B1_I.uUg0iaiPck UEGO_DataSplyClsS1B1_I.uUg0ieiPck UEGO_DataSplyClsS1B1_I.uUg0mPck UEGO_DataSplyClsS1B1_I.uUgkAvrgPck UEGO_DataSplyClsS1B1_I.uUguaPck UEGO_DataSplyClsS1B1_I.uUguaZ2Pck UEGO_DataSplyClsS1B1_I.uUguiPck UEGO_DataSplyClsS1B1_I.uUguiZ1Pck UEGO_DataSplyClsS1B1_I.uUi22Pck UEGO_DataSplyClsS1B1_I.uUi23Pck UEGO_DataSplyClsS1B1_I.uUi24Pck UEGO_DataSplyClsS1B1_I.uUi4Pck UEGO_DataSplyClsS1B1_I.uUi4Z2Pck UEGO_DataSplyClsS1B1_I.uUipcalAvrgPck UEGO_DataSplyClsS1B1_I.uUn0Pck UEGO_DataSplyClsS1B1_I.uUnSet UEGO_DataSplyClsS1B1_I.uUp0Pck UEGO_DataSplyClsS1B1_I.uUp0Pck4 UEGO_DataSplyClsS1B1_I.uUriaPck UEGO_DataSplyClsS1B1_I.uVCC1Corrd UEGO_DataSplyClsS1B1_I.uVCC3Ref UEGO_flgCJ135AnS1B1 UEGO_flgRPmpPlsOperVldS1B1 UEGO_flgSysSuprtdS1B1 UEGO_flgTCeramicVldS1B1 UEGO_flgUNernstInRngS1B1 UEGO_ratIPmpRawS1B1 UEGO_RegGetPrmS1B1_I.flgDlyBlcknNxtPckVld UEGO_RegGetPrmS1B1_I.flgDlyBlcknVld UEGO_RegGetPrmS1B1_I.flgDspDiagDis UEGO_RegGetPrmS1B1_I.flgDspDiagDisNxtPck UEGO_RegGetPrmS1B1_I.flgDspDiagDisNxtPckVld UEGO_RegGetPrmS1B1_I.flgDspDiagDisVld UEGO_RegGetPrmS1B1_I.flgEnSpA UEGO_RegGetPrmS1B1_I.flgEnSpAVld UEGO_RegGetPrmS1B1_I.flgEnSpE UEGO_RegGetPrmS1B1_I.flgEnSpEVld UEGO_RegGetPrmS1B1_I.flgEnSpNxtPckVld UEGO_RegGetPrmS1B1_I.flgEnSpVld UEGO_RegGetPrmS1B1_I.flgIPmpBlcknNxtPckVld UEGO_RegGetPrmS1B1_I.flgIPmpBlcknVld UEGO_RegGetPrmS1B1_I.flgIPmpLimnHiVld UEGO_RegGetPrmS1B1_I.flgIPmpLimnLoVld UEGO_RegGetPrmS1B1_I.flgIPmpRst UEGO_RegGetPrmS1B1_I.flgIPmpRstNxtPck UEGO_RegGetPrmS1B1_I.flgIPmpRstNxtPckVld UEGO_RegGetPrmS1B1_I.flgIPmpRstVld UEGO_RegGetPrmS1B1_I.flgIPmpSm UEGO_RegGetPrmS1B1_I.flgIPmpSmNxtPck UEGO_RegGetPrmS1B1_I.flgIPmpSmNxtPckVld UEGO_RegGetPrmS1B1_I.flgIPmpSmVld UEGO_RegGetPrmS1B1_I.flgLCal UEGO_RegGetPrmS1B1_I.flgLCalVld UEGO_RegGetPrmS1B1_I.flgLCurr UEGO_RegGetPrmS1B1_I.flgLCurrVld UEGO_RegGetPrmS1B1_I.flgLDAC UEGO_RegGetPrmS1B1_I.flgLDACConf UEGO_RegGetPrmS1B1_I.flgLDACConfVld UEGO_RegGetPrmS1B1_I.flgLDACVld UEGO_RegGetPrmS1B1_I.flgLG0 UEGO_RegGetPrmS1B1_I.flgLG0Vld UEGO_RegGetPrmS1B1_I.flgLN UEGO_RegGetPrmS1B1_I.flgLNNxtPck UEGO_RegGetPrmS1B1_I.flgLNNxtPckVld UEGO_RegGetPrmS1B1_I.flgLNVld UEGO_RegGetPrmS1B1_I.flgLP UEGO_RegGetPrmS1B1_I.flgLPNxtPck UEGO_RegGetPrmS1B1_I.flgLPNxtPckVld UEGO_RegGetPrmS1B1_I.flgLPVld UEGO_RegGetPrmS1B1_I.flgMKA UEGO_RegGetPrmS1B1_I.flgMKAVld UEGO_RegGetPrmS1B1_I.flgMKE UEGO_RegGetPrmS1B1_I.flgMKEVld UEGO_RegGetPrmS1B1_I.flgMKNxtPckVld UEGO_RegGetPrmS1B1_I.flgMKVld UEGO_RegGetPrmS1B1_I.flgN3MeasActvNxtPck UEGO_RegGetPrmS1B1_I.flgN3MeasActvNxtPckVld UEGO_RegGetPrmS1B1_I.flgOFFNxtPckVld UEGO_RegGetPrmS1B1_I.flgOFFVld UEGO_RegGetPrmS1B1_I.flgOPTNxtPckVld UEGO_RegGetPrmS1B1_I.flgOPTVld UEGO_RegGetPrmS1B1_I.flgPatNxtPckVld UEGO_RegGetPrmS1B1_I.flgPatVld UEGO_RegGetPrmS1B1_I.flgRCmpHeatrEdgeShiftAllwd UEGO_RegGetPrmS1B1_I.flgRCmpHeatrEdgeShiftAllwdNxtPck UEGO_RegGetPrmS1B1_I.flgRCmpHeatrEdgeShiftAllwdNxtPckVld UEGO_RegGetPrmS1B1_I.flgRCmpHeatrEdgeShiftAllwdVld UEGO_RegGetPrmS1B1_I.flgReStab UEGO_RegGetPrmS1B1_I.flgReStabVld UEGO_RegGetPrmS1B1_I.flgRefNxtPckVld UEGO_RegGetPrmS1B1_I.flgRefPatChng UEGO_RegGetPrmS1B1_I.flgRefPatNxtPckVld UEGO_RegGetPrmS1B1_I.flgRefPatVld UEGO_RegGetPrmS1B1_I.flgRefVld UEGO_RegGetPrmS1B1_I.flgRegIPmpSetNxtPckVld UEGO_RegGetPrmS1B1_I.flgRegIPmpSetVld UEGO_RegGetPrmS1B1_I.flgRegIpoffChng UEGO_RegGetPrmS1B1_I.flgRegIpoffNxtPckVld UEGO_RegGetPrmS1B1_I.flgRegIpoffVld UEGO_RegGetPrmS1B1_I.flgRegModNxtPckVld UEGO_RegGetPrmS1B1_I.flgRegModVld UEGO_RegGetPrmS1B1_I.flgRegPartModNxtPckVld UEGO_RegGetPrmS1B1_I.flgRegPartModVld UEGO_RegGetPrmS1B1_I.flgRegUnsetNxtPckVld UEGO_RegGetPrmS1B1_I.flgRiaPatChng UEGO_RegGetPrmS1B1_I.flgRiaPatVld UEGO_RegGetPrmS1B1_I.flgRipVld UEGO_RegGetPrmS1B1_I.flgSngCell UEGO_RegGetPrmS1B1_I.flgSngCellVld UEGO_RegGetPrmS1B1_I.flgSteerPatChng UEGO_RegGetPrmS1B1_I.flgSteerPatNxtPckVld UEGO_RegGetPrmS1B1_I.flgSteerPatVld UEGO_RegGetPrmS1B1_I.flgSubModMeasNxtPckVld UEGO_RegGetPrmS1B1_I.flgSubModMeasVld UEGO_RegGetPrmS1B1_I.flgSwVirtGnd UEGO_RegGetPrmS1B1_I.flgSwVirtGndVld UEGO_RegGetPrmS1B1_I.flgTrimSqChng UEGO_RegGetPrmS1B1_I.flgTrimSqrCalChng UEGO_RegGetPrmS1B1_I.flgTrimSqrChng UEGO_RegGetPrmS1B1_I.flgTrmNxtPckVld UEGO_RegGetPrmS1B1_I.flgTrmSqCalOffSet UEGO_RegGetPrmS1B1_I.flgTrmSqCalVld UEGO_RegGetPrmS1B1_I.flgTrmSqOffSet UEGO_RegGetPrmS1B1_I.flgTrmSqOffSetVld UEGO_RegGetPrmS1B1_I.flgTrmSqVld UEGO_RegGetPrmS1B1_I.flgTrmSqrCalOffSet UEGO_RegGetPrmS1B1_I.flgTrmSqrCalVld UEGO_RegGetPrmS1B1_I.flgTrmSqrOffSet UEGO_RegGetPrmS1B1_I.flgTrmSqrOffSetVld UEGO_RegGetPrmS1B1_I.flgTrmSqrVld UEGO_RegGetPrmS1B1_I.flgUnsetVld UEGO_RegGetPrmS1B1_I.flgUp0LeanNxtPckVld UEGO_RegGetPrmS1B1_I.flgUp0LeanVld UEGO_RegGetPrmS1B1_I.flgUp0RichNxtPckVld UEGO_RegGetPrmS1B1_I.flgUp0RichVld UEGO_RegGetPrmS1B1_I.flgUria UEGO_RegGetPrmS1B1_I.flgUriaNxtPck UEGO_RegGetPrmS1B1_I.flgUriaNxtPckVld UEGO_RegGetPrmS1B1_I.flgUriaVld UEGO_RegGetPrmS1B1_I.flgV1BF2NxtPckVld UEGO_RegGetPrmS1B1_I.flgV1BF2Vld UEGO_RegGetPrmS1B1_I.flgV1BF3NxtPckVld UEGO_RegGetPrmS1B1_I.flgV1BIT1 UEGO_RegGetPrmS1B1_I.flgV1BIT1NxtPck UEGO_RegGetPrmS1B1_I.flgV1BIT1NxtPckVld UEGO_RegGetPrmS1B1_I.flgV1BIT1Vld UEGO_RegGetPrmS1B1_I.flgV1BIT2 UEGO_RegGetPrmS1B1_I.flgV1BIT2NxtPck UEGO_RegGetPrmS1B1_I.flgV1BIT2NxtPckVld UEGO_RegGetPrmS1B1_I.flgV1BIT2Vld UEGO_RegGetPrmS1B1_I.flgV1BIT5 UEGO_RegGetPrmS1B1_I.flgV1BIT5NxtPck UEGO_RegGetPrmS1B1_I.flgV1BIT5NxtPckVld UEGO_RegGetPrmS1B1_I.flgV1BIT5Vld UEGO_RegGetPrmS1B1_I.flgWtrEleclyActv UEGO_RegGetPrmS1B1_I.flgWtrEleclyActvNxtPck UEGO_RegGetPrmS1B1_I.flgWtrEleclyActvNxtPckVld UEGO_RegGetPrmS1B1_I.flgWtrEleclyActvVld UEGO_RegGetPrmS1B1_I.flgZIsqrA UEGO_RegGetPrmS1B1_I.flgZIsqrAVld UEGO_RegGetPrmS1B1_I.flgZIsqrE UEGO_RegGetPrmS1B1_I.flgZIsqrEVld UEGO_RegGetPrmS1B1_I.nrIPmpBlcknNxtPck UEGO_RegGetPrmS1B1_I.nrIPmpLimnHi UEGO_RegGetPrmS1B1_I.nrIPmpLimnLo UEGO_RegGetPrmS1B1_I.nrPmpBlckn UEGO_RegGetPrmS1B1_I.nrRefPatNxtPck UEGO_RegGetPrmS1B1_I.nrRegIPmpSet UEGO_RegGetPrmS1B1_I.nrRegIPmpSetNxtPck UEGO_RegGetPrmS1B1_I.nrRegIpoff UEGO_RegGetPrmS1B1_I.nrRegMod UEGO_RegGetPrmS1B1_I.nrRegModNxtPck UEGO_RegGetPrmS1B1_I.nrRegPartMod UEGO_RegGetPrmS1B1_I.nrRegPartModNxtPck UEGO_RegGetPrmS1B1_I.nrRegTrmNxtPck UEGO_RegGetPrmS1B1_I.nrRegTrmSqNxtPck UEGO_RegGetPrmS1B1_I.nrRegTrmSqrNxtPck UEGO_RegGetPrmS1B1_I.nrRip UEGO_RegGetPrmS1B1_I.nrSteerPatNxtPck UEGO_RegGetPrmS1B1_I.nrSubModMeas UEGO_RegGetPrmS1B1_I.nrSubModMeasNxtPck UEGO_RegGetPrmS1B1_I.nrTrmSq UEGO_RegGetPrmS1B1_I.nrTrmSqCal UEGO_RegGetPrmS1B1_I.nrTrmSqr UEGO_RegGetPrmS1B1_I.nrTrmSqrCal UEGO_RegGetPrmS1B1_I.nrUnset UEGO_RegGetPrmS1B1_I.nrUnsetNxtPck UEGO_RegGetPrmS1B1_I.nrUp0Lean UEGO_RegGetPrmS1B1_I.nrUp0LeanNxtPck UEGO_RegGetPrmS1B1_I.nrUp0Rich UEGO_RegGetPrmS1B1_I.nrUp0RichNxtPck UEGO_RegGetPrmS1B1_I.stDlyBlckn UEGO_RegGetPrmS1B1_I.stDlyBlcknNxtPck UEGO_RegGetPrmS1B1_I.stEnSp UEGO_RegGetPrmS1B1_I.stEnSpNxtPck UEGO_RegGetPrmS1B1_I.stMK UEGO_RegGetPrmS1B1_I.stMKNxtPck UEGO_RegGetPrmS1B1_I.stOFF UEGO_RegGetPrmS1B1_I.stOFFNxtPck UEGO_RegGetPrmS1B1_I.stOPT UEGO_RegGetPrmS1B1_I.stOPTNxtPck UEGO_RegGetPrmS1B1_I.stPat UEGO_RegGetPrmS1B1_I.stPatNxtPck UEGO_RegGetPrmS1B1_I.stRef UEGO_RegGetPrmS1B1_I.stRefNxtPck UEGO_RegGetPrmS1B1_I.stRefPat UEGO_RegGetPrmS1B1_I.stRegIpoffNxtPck UEGO_RegGetPrmS1B1_I.stRiaPat UEGO_RegGetPrmS1B1_I.stSteerPat UEGO_RegGetPrmS1B1_I.stV1BF2 UEGO_RegGetPrmS1B1_I.stV1BF2NxtPck UEGO_RegGetPrmS1B1_I.stV1BF3NxtPck UEGO_RegSetS1B1_I.cntrRegSet UEGO_RegSetS1B1_I.flgCJ135An UEGO_RegSetS1B1_I.flgConvVld UEGO_RegSetS1B1_I.flgIPmpDes UEGO_RegSetS1B1_I.flgIPmpPhyRels UEGO_RegSetS1B1_I.flgIniFinshd UEGO_RegSetS1B1_I.flgLoupeCURRDes UEGO_RegSetS1B1_I.flgLoupeDACDes UEGO_RegSetS1B1_I.flgLoupeNDes UEGO_RegSetS1B1_I.flgLoupePDes UEGO_RegSetS1B1_I.flgNewReq UEGO_RegSetS1B1_I.flgRegSetSt UEGO_RegSetS1B1_I.flgRegSetStVld UEGO_RegSetS1B1_I.flgReqAcptd UEGO_RegSetS1B1_I.flgSetRegOk UEGO_RegSetS1B1_I.flgTakeDataOk UEGO_RegSetS1B1_I.idxChp UEGO_RegSetS1B1_I.nrIdleSubMode UEGO_RegSetS1B1_I.nrModDes UEGO_RegSetS1B1_I.nrNormSubMode UEGO_RegSetS1B1_I.nrRegSet UEGO_RegSetS1B1_I.nrSubModDes UEGO_RegSetS1B1_I.nrSwtOnSubMode UEGO_RegSetS1B1_I.nrTrmSq UEGO_RegSetS1B1_I.nrWrmUpSubMode UEGO_RegSetS1B1_I.stRegSet UEGO_RegSetS1B1_I.stRegSetVld UEGO_RegSetS1B1_I.tmpVar UEGO_rRPmpPlsOperS1B1 UEGO_tCeramicS1B1 UEGO_uUa2PckAryS1B1 UEGO_uUgaPckAryS1B1 UEGO_uUgiPckAryS1B1 UEGO_uUi21PckAryS1B1 UEGO_uUp0PckAryS1B1 UEGO_uUpPckAryS1B1 UEGO_uVCC3RefS1B1 /end IN_MEASUREMENT
 /begin OUT_MEASUREMENT UEGO_flgRvsChrgHiPrcsnS1B1 UEGO_flgRvsChrgVldS1B1 UEGO_iRvsChrgAryS1B1 /end OUT_MEASUREMENT
 /begin LOC_MEASUREMENT UEGO_RvsChrgS1B1_I.cntrCpCalc UEGO_RvsChrgS1B1_I.cpCamg UEGO_RvsChrgS1B1_I.cpCamgRaw UEGO_RvsChrgS1B1_I.cpCig UEGO_RvsChrgS1B1_I.cpCigRaw UEGO_RvsChrgS1B1_I.cpCorrnRaw UEGO_RvsChrgS1B1_I.cpCpAvrg UEGO_RvsChrgS1B1_I.cpCpRawSum UEGO_RvsChrgS1B1_I.dugiZ2 UEGO_RvsChrgS1B1_I.flgCpAdpnIni UEGO_RvsChrgS1B1_I.flgCpAdpnRels UEGO_RvsChrgS1B1_I.flgCpAdpnVld UEGO_RvsChrgS1B1_I.flgCpLrngFinshd UEGO_RvsChrgS1B1_I.flgCpModeRequest UEGO_RvsChrgS1B1_I.flgDUgiZ2Vld UEGO_RvsChrgS1B1_I.flgDepCamgVld UEGO_RvsChrgS1B1_I.flgDepCigVld UEGO_RvsChrgS1B1_I.flgDepUgiVld UEGO_RvsChrgS1B1_I.flgDepUp0Vld UEGO_RvsChrgS1B1_I.flgDetrmtVld UEGO_RvsChrgS1B1_I.flgRatIPmpPckVld UEGO_RvsChrgS1B1_I.flgRvsChrgHiPrcns UEGO_RvsChrgS1B1_I.flgRvsChrgVld UEGO_RvsChrgS1B1_I.flgTM2Rich UEGO_RvsChrgS1B1_I.flgUa2Z2Vld UEGO_RvsChrgS1B1_I.flgUi21Z2Vld UEGO_RvsChrgS1B1_I.flgUiAdpnIni UEGO_RvsChrgS1B1_I.flgUiAdpnRels UEGO_RvsChrgS1B1_I.flgUiAdpnRequest UEGO_RvsChrgS1B1_I.flgUiCurrAdpnVld UEGO_RvsChrgS1B1_I.flgUiLeanAdpnVld UEGO_RvsChrgS1B1_I.flgUiModeRequest UEGO_RvsChrgS1B1_I.flgUiRichAdpnVld UEGO_RvsChrgS1B1_I.flgUiStdAdpnVld UEGO_RvsChrgS1B1_I.flgUp0Vld UEGO_RvsChrgS1B1_I.iDepCamg UEGO_RvsChrgS1B1_I.iDepCig UEGO_RvsChrgS1B1_I.iDepRatIPmp UEGO_RvsChrgS1B1_I.iDepUgi UEGO_RvsChrgS1B1_I.iDepUp0 UEGO_RvsChrgS1B1_I.nrModUi UEGO_RvsChrgS1B1_I.nrModUiInt UEGO_RvsChrgS1B1_I.qC1 UEGO_RvsChrgS1B1_I.qC1CncptNew UEGO_RvsChrgS1B1_I.qC1CncptOld UEGO_RvsChrgS1B1_I.qC2 UEGO_RvsChrgS1B1_I.qC2CncptNew UEGO_RvsChrgS1B1_I.qC2CncptOld UEGO_RvsChrgS1B1_I.qUgaCorrn UEGO_RvsChrgS1B1_I.qUgiCorrn UEGO_RvsChrgS1B1_I.ratIPmpAvrg UEGO_RvsChrgS1B1_I.stIntVld UEGO_RvsChrgS1B1_I.stRvsChrgHiPrcns UEGO_RvsChrgS1B1_I.stRvsChrgVld UEGO_RvsChrgS1B1_I.stTM UEGO_RvsChrgS1B1_I.tiTau UEGO_RvsChrgS1B1_I.uDeltaApeZ1 UEGO_RvsChrgS1B1_I.uDeltaApeZ2 UEGO_RvsChrgS1B1_I.uDeltaIpeZ1 UEGO_RvsChrgS1B1_I.uDeltaIpeZ2 UEGO_RvsChrgS1B1_I.uDeltaUga UEGO_RvsChrgS1B1_I.uDeltaUgi UEGO_RvsChrgS1B1_I.uDeltaUi22Lean UEGO_RvsChrgS1B1_I.uDeltaUi22Rich UEGO_RvsChrgS1B1_I.uDeltaUi22Std UEGO_RvsChrgS1B1_I.uDeltaUi23Lean UEGO_RvsChrgS1B1_I.uDeltaUi23Rich UEGO_RvsChrgS1B1_I.uDeltaUi23Std UEGO_RvsChrgS1B1_I.uDeltaUi24Lean UEGO_RvsChrgS1B1_I.uDeltaUi24Rich UEGO_RvsChrgS1B1_I.uDeltaUi24Std UEGO_RvsChrgS1B1_I.uDetrmt UEGO_RvsChrgS1B1_I.uUi21 UEGO_RvsChrgS1B1_I.uUi21Measd UEGO_RvsChrgS1B1_I.uUi21Z2 UEGO_RvsChrgS1B1_I.ua2Z2 UEGO_RvsChrgS1B1_I.up0 UEGO_RvsChrgS1B1_I.UEGO_RvsChrgEvlnCamgPeakFilter_I.cpCamgDelta UEGO_RvsChrgS1B1_I.UEGO_RvsChrgEvlnCamgPeakFilter_I.cpCamgFilOutp UEGO_RvsChrgS1B1_I.UEGO_RvsChrgEvlnCamgPeakFilter_I.cpCamgGain UEGO_RvsChrgS1B1_I.UEGO_RvsChrgEvlnCamgPeakFilter_I.flgCamgFilgStrtd UEGO_RvsChrgS1B1_I.UEGO_RvsChrgEvlnCigPeakFilter_I.cpCigDelta UEGO_RvsChrgS1B1_I.UEGO_RvsChrgEvlnCigPeakFilter_I.cpCigFilOutp UEGO_RvsChrgS1B1_I.UEGO_RvsChrgEvlnCigPeakFilter_I.cpCigGain UEGO_RvsChrgS1B1_I.UEGO_RvsChrgEvlnCigPeakFilter_I.flgCigFilgStrtd UEGO_RvsChrgS1B1_I.uDeltaUi22LeanDL_I.flgFilVldy UEGO_RvsChrgS1B1_I.uDeltaUi22LeanDL_I.nrSampleCurr UEGO_RvsChrgS1B1_I.uDeltaUi22LeanDL_I.nrSampleRef UEGO_RvsChrgS1B1_I.uDeltaUi22LeanDL_I.nrSampleThd UEGO_RvsChrgS1B1_I.uDeltaUi22LeanDL_I.EvlnFil_DL_I.memory UEGO_RvsChrgS1B1_I.uDeltaUi22RichDL_I.flgFilVldy UEGO_RvsChrgS1B1_I.uDeltaUi22RichDL_I.nrSampleCurr UEGO_RvsChrgS1B1_I.uDeltaUi22RichDL_I.nrSampleRef UEGO_RvsChrgS1B1_I.uDeltaUi22RichDL_I.nrSampleThd UEGO_RvsChrgS1B1_I.uDeltaUi22RichDL_I.EvlnFil_DL_I.memory UEGO_RvsChrgS1B1_I.uDeltaUi22StdDL_I.flgFilVldy UEGO_RvsChrgS1B1_I.uDeltaUi22StdDL_I.nrSampleCurr UEGO_RvsChrgS1B1_I.uDeltaUi22StdDL_I.nrSampleRef UEGO_RvsChrgS1B1_I.uDeltaUi22StdDL_I.nrSampleThd UEGO_RvsChrgS1B1_I.uDeltaUi22StdDL_I.EvlnFil_DL_I.memory UEGO_RvsChrgS1B1_I.uDeltaUi23LeanDL_I.flgFilVldy UEGO_RvsChrgS1B1_I.uDeltaUi23LeanDL_I.nrSampleCurr UEGO_RvsChrgS1B1_I.uDeltaUi23LeanDL_I.nrSampleRef UEGO_RvsChrgS1B1_I.uDeltaUi23LeanDL_I.nrSampleThd UEGO_RvsChrgS1B1_I.uDeltaUi23LeanDL_I.EvlnFil_DL_I.memory UEGO_RvsChrgS1B1_I.uDeltaUi23RichDL_I.flgFilVldy UEGO_RvsChrgS1B1_I.uDeltaUi23RichDL_I.nrSampleCurr UEGO_RvsChrgS1B1_I.uDeltaUi23RichDL_I.nrSampleRef UEGO_RvsChrgS1B1_I.uDeltaUi23RichDL_I.nrSampleThd UEGO_RvsChrgS1B1_I.uDeltaUi23RichDL_I.EvlnFil_DL_I.memory UEGO_RvsChrgS1B1_I.uDeltaUi23StdDL_I.flgFilVldy UEGO_RvsChrgS1B1_I.uDeltaUi23StdDL_I.nrSampleCurr UEGO_RvsChrgS1B1_I.uDeltaUi23StdDL_I.nrSampleRef UEGO_RvsChrgS1B1_I.uDeltaUi23StdDL_I.nrSampleThd UEGO_RvsChrgS1B1_I.uDeltaUi23StdDL_I.EvlnFil_DL_I.memory UEGO_RvsChrgS1B1_I.uDeltaUi24LeanDL_I.flgFilVldy UEGO_RvsChrgS1B1_I.uDeltaUi24LeanDL_I.nrSampleCurr UEGO_RvsChrgS1B1_I.uDeltaUi24LeanDL_I.nrSampleRef UEGO_RvsChrgS1B1_I.uDeltaUi24LeanDL_I.nrSampleThd UEGO_RvsChrgS1B1_I.uDeltaUi24LeanDL_I.EvlnFil_DL_I.memory UEGO_RvsChrgS1B1_I.uDeltaUi24RichDL_I.flgFilVldy UEGO_RvsChrgS1B1_I.uDeltaUi24RichDL_I.nrSampleCurr UEGO_RvsChrgS1B1_I.uDeltaUi24RichDL_I.nrSampleRef UEGO_RvsChrgS1B1_I.uDeltaUi24RichDL_I.nrSampleThd UEGO_RvsChrgS1B1_I.uDeltaUi24RichDL_I.EvlnFil_DL_I.memory UEGO_RvsChrgS1B1_I.uDeltaUi24StdDL_I.flgFilVldy UEGO_RvsChrgS1B1_I.uDeltaUi24StdDL_I.nrSampleCurr UEGO_RvsChrgS1B1_I.uDeltaUi24StdDL_I.nrSampleRef UEGO_RvsChrgS1B1_I.uDeltaUi24StdDL_I.nrSampleThd UEGO_RvsChrgS1B1_I.uDeltaUi24StdDL_I.EvlnFil_DL_I.memory /end LOC_MEASUREMENT
 FUNCTION_VERSION "1.6.0" /end FUNCTION
/begin FUNCTION UEGO_Snsr "1.8.0     Initializes sensor parameters" /begin DEF_CHARACTERISTIC UEGO_SnsrS1B1_I.idxTyp_C /end DEF_CHARACTERISTIC
 /begin OUT_MEASUREMENT UEGO_flgRCmpPrsntS1B1 UEGO_flgSnglCellS1B1 UEGO_flgSnsrSuprtdS1B1 UEGO_idxTypS1B1 /end OUT_MEASUREMENT
 /begin LOC_MEASUREMENT UEGO_SnsrS1B1_I.flgRCmpPrsnt UEGO_SnsrS1B1_I.flgSnglCell UEGO_SnsrS1B1_I.flgSnsrSuprtd UEGO_SnsrS1B1_I.idxTyp /end LOC_MEASUREMENT
 FUNCTION_VERSION "1.8.0" /end FUNCTION
/begin FUNCTION UEGO_SnsrTMdl "1.30.0_1.1.0Temperature Model for Lambda Sensors"
 /begin DEF_CHARACTERISTIC UEGO_egyHeatrMax_C UEGO_egyOverHeatgProtnMinThd_C UEGO_egySnsrMdlAmbT_C UEGO_egySnsrMdlHeatgUpFinshd_C UEGO_egySnsrMdlHotThd_C UEGO_facEgyOverHeatgProtn_C UEGO_facEgyRHeatr_C UEGO_pwrLossSnsrMax_C UEGO_pwrLossSnsr_C UEGO_rHeatrMax_C UEGO_rHeatrMin_C UEGO_rLossHeatrPSMdl_C UEGO_rLossHeatrPS_C UEGO_stSnsrMdlHot_C UEGO_tDeltaEgyLim_C UEGO_tiMaxPwrLossExp_C UEGO_tSnsrHotThd_C UEGO_tiDlyEngStop_C /end DEF_CHARACTERISTIC
 /begin REF_CHARACTERISTIC UEGO_tCeramicHeatrSp_C /end REF_CHARACTERISTIC
 /begin IN_MEASUREMENT BattU_u Eep_EnvRamHist Eep_EnvRamInvld SyC_ctPostDrvLeave SyC_stVldTiEcuOff SyC_tiEcuOff TiOff_stTiStrtEndOff TiOff_tiStrtEndOff UEGO_flgEngRunng UEGO_flgHeatgOffS1B1 UEGO_flgHeatrCtrldModActvS1B1 UEGO_flgSysSuprtdS1B1 UEGO_flgTCeramicVldS1B1 UEGO_ratHeatrSnsrActS1B1 UEGO_tCeramicS1B1 /end IN_MEASUREMENT
 /begin OUT_MEASUREMENT UEGO_flgSnsrMdlAmbTS1B1 UEGO_flgSnsrMdlHeatgUpFinshdS1B1 UEGO_flgSnsrMdlHotS1B1 UEGO_flgSnsrMdlOverHeatgProtnS1B1 UEGO_flgTiEcuOffVld UEGO_flgTiEngOffVld UEGO_flgTiHeatrOffVldS1B1 UEGO_flgUHeatrVld UEGO_tiEcuOff UEGO_tiEngOff UEGO_tiHeatrOffS1B1 UEGO_uHeatrS1B1 /end OUT_MEASUREMENT
 /begin LOC_MEASUREMENT UEGO_EngRunngDlyEFNM_I.oldSignal UEGO_flgTiEcuOffVldTmp UEGO_SnsrMdlHotS1B1_I.cntrReiniProc20msec UEGO_SnsrMdlHotS1B1_I.egyHeatr UEGO_SnsrMdlHotS1B1_I.egyOverHeatgProtnThd UEGO_SnsrMdlHotS1B1_I.envRamOk UEGO_SnsrMdlHotS1B1_I.facEgyLoss UEGO_SnsrMdlHotS1B1_I.facPwrLoss UEGO_SnsrMdlHotS1B1_I.flgHeatgActv UEGO_SnsrMdlHotS1B1_I.flgIniEgyHeatr UEGO_SnsrMdlHotS1B1_I.flgIniProtdFinshd UEGO_SnsrMdlHotS1B1_I.flgSnsrMdlAmbT UEGO_SnsrMdlHotS1B1_I.flgSnsrMdlHeatgUpFinshd UEGO_SnsrMdlHotS1B1_I.flgSnsrMdlHot UEGO_SnsrMdlHotS1B1_I.flgSnsrMdlOverHeatgProtn UEGO_SnsrMdlHotS1B1_I.flgtiHeatrOffVld UEGO_SnsrMdlHotS1B1_I.flgtioffvld UEGO_SnsrMdlHotS1B1_I.pwrHeatr UEGO_SnsrMdlHotS1B1_I.pwrLossSnsr UEGO_SnsrMdlHotS1B1_I.rHeatr UEGO_SnsrMdlHotS1B1_I.tiHeatrOff UEGO_SnsrMdlHotS1B1_I.tiOff UEGO_SnsrMdlHotS1B1_I.uHeatr UEGO_SnsrMdlHotS1B1_I.uHeatrMdl UEGO_SnsrMdlHotS1B1_I.UEGO_SnsrMdlHotEgyIninClass.facExpEgyLoss UEGO_SnsrMdlHotS1B1_I.UEGO_SnsrTMdlflgHeatgOnERNM_I.oldSignal UEGO_stTiEngOff UEGO_tiEcuOffTmp UEGO_tiEngOffTmp UEGO_TiEngOffTOFFVNM_I.time /end LOC_MEASUREMENT
 FUNCTION_VERSION "1.30.0_1.1.0" /end FUNCTION
/begin FUNCTION UEGO_TCeramic "1.17.1    UEGO ASIC ceramic temperature"
 /begin DEF_CHARACTERISTIC UEGO_rSnsrWrm_C UEGO_facRCeramicFilCon_C UEGO_facRCeramicQuoFilCon_C UEGO_facRCeramicVldyEvln_C UEGO_stSwtTCeramicEnf_C UEGO_tiRCeramicVldyTurnOffDly_C UEGO_tRCeramic_T /end DEF_CHARACTERISTIC
 /begin IN_MEASUREMENT UEGO_DataSplyClsS1B1_I.flgCj135An UEGO_DataSplyClsS1B1_I.flgDACOff UEGO_DataSplyClsS1B1_I.flgErrSpiRamRet UEGO_DataSplyClsS1B1_I.flgFKal1Vld UEGO_DataSplyClsS1B1_I.flgFKal2Vld UEGO_DataSplyClsS1B1_I.flgFKal3Vld UEGO_DataSplyClsS1B1_I.flgIPmpActvd UEGO_DataSplyClsS1B1_I.flgISQrA UEGO_DataSplyClsS1B1_I.flgISQrE UEGO_DataSplyClsS1B1_I.flgLCURR UEGO_DataSplyClsS1B1_I.flgLNMeas UEGO_DataSplyClsS1B1_I.flgLPMeas UEGO_DataSplyClsS1B1_I.flgLoupeCAL UEGO_DataSplyClsS1B1_I.flgLoupeG0 UEGO_DataSplyClsS1B1_I.flgLstPckAbort UEGO_DataSplyClsS1B1_I.flgMKA UEGO_DataSplyClsS1B1_I.flgMKE UEGO_DataSplyClsS1B1_I.flgNewIPmpDacPckAry UEGO_DataSplyClsS1B1_I.flgNewIPmpOK UEGO_DataSplyClsS1B1_I.flgNewIPmpPckAry UEGO_DataSplyClsS1B1_I.flgNewIPmpTM UEGO_DataSplyClsS1B1_I.flgNewPck UEGO_DataSplyClsS1B1_I.flgNewPckCstnc UEGO_DataSplyClsS1B1_I.flgNewPckMiss UEGO_DataSplyClsS1B1_I.flgNewPckVld UEGO_DataSplyClsS1B1_I.flgNewTiPck UEGO_DataSplyClsS1B1_I.flgNewURmVG4MeasAryVld UEGO_DataSplyClsS1B1_I.flgNewUa2Pck UEGO_DataSplyClsS1B1_I.flgNewUa31Pck UEGO_DataSplyClsS1B1_I.flgNewUa32Pck UEGO_DataSplyClsS1B1_I.flgNewUa33Pck UEGO_DataSplyClsS1B1_I.flgNewUamPck UEGO_DataSplyClsS1B1_I.flgNewUapePck UEGO_DataSplyClsS1B1_I.flgNewUcalMaxPck UEGO_DataSplyClsS1B1_I.flgNewUcalPck UEGO_DataSplyClsS1B1_I.flgNewUg0Pck UEGO_DataSplyClsS1B1_I.flgNewUg0PckAry UEGO_DataSplyClsS1B1_I.flgNewUg0aPck UEGO_DataSplyClsS1B1_I.flgNewUg0ePck UEGO_DataSplyClsS1B1_I.flgNewUg0iPck UEGO_DataSplyClsS1B1_I.flgNewUg0iPckAry UEGO_DataSplyClsS1B1_I.flgNewUg0iaiPck UEGO_DataSplyClsS1B1_I.flgNewUg0ieiPck UEGO_DataSplyClsS1B1_I.flgNewUg0ix7PckAry UEGO_DataSplyClsS1B1_I.flgNewUg0ix9PckAry UEGO_DataSplyClsS1B1_I.flgNewUg0ixPckAry UEGO_DataSplyClsS1B1_I.flgNewUg0mPck UEGO_DataSplyClsS1B1_I.flgNewUgaPck UEGO_DataSplyClsS1B1_I.flgNewUgiPckAry UEGO_DataSplyClsS1B1_I.flgNewUgkAvrgPck UEGO_DataSplyClsS1B1_I.flgNewUguaPck UEGO_DataSplyClsS1B1_I.flgNewUguaZ2Pck UEGO_DataSplyClsS1B1_I.flgNewUguiPck UEGO_DataSplyClsS1B1_I.flgNewUguiZ1Pck UEGO_DataSplyClsS1B1_I.flgNewUi21PckAry UEGO_DataSplyClsS1B1_I.flgNewUi22Pck UEGO_DataSplyClsS1B1_I.flgNewUi23Pck UEGO_DataSplyClsS1B1_I.flgNewUi24Pck UEGO_DataSplyClsS1B1_I.flgNewUi4Pck UEGO_DataSplyClsS1B1_I.flgNewUi4Z2Pck UEGO_DataSplyClsS1B1_I.flgNewUigPckAry UEGO_DataSplyClsS1B1_I.flgNewUigmkPckAry UEGO_DataSplyClsS1B1_I.flgNewUipcalAvrgPck UEGO_DataSplyClsS1B1_I.flgNewUn0Pck UEGO_DataSplyClsS1B1_I.flgNewUn0Pck4Ary UEGO_DataSplyClsS1B1_I.flgNewUn0Pck5Ary UEGO_DataSplyClsS1B1_I.flgNewUn0PckAry UEGO_DataSplyClsS1B1_I.flgNewUnPckAry UEGO_DataSplyClsS1B1_I.flgNewUnSetPck UEGO_DataSplyClsS1B1_I.flgNewUnx3PckAry UEGO_DataSplyClsS1B1_I.flgNewUnx4PckAry UEGO_DataSplyClsS1B1_I.flgNewUp0Pck UEGO_DataSplyClsS1B1_I.flgNewUp0Pck4 UEGO_DataSplyClsS1B1_I.flgNewUp0Pck5Ary UEGO_DataSplyClsS1B1_I.flgNewUp0PckAry UEGO_DataSplyClsS1B1_I.flgNewUpPckAry UEGO_DataSplyClsS1B1_I.flgNewUpx3PckAry UEGO_DataSplyClsS1B1_I.flgNewUpx4PckAry UEGO_DataSplyClsS1B1_I.flgNewUriaPckVld UEGO_DataSplyClsS1B1_I.flgNewUriePckAry UEGO_DataSplyClsS1B1_I.flgNewUx6PckAry UEGO_DataSplyClsS1B1_I.flgNewUx7PckAry UEGO_DataSplyClsS1B1_I.flgNewUx8PckAry UEGO_DataSplyClsS1B1_I.flgNewUx9PckAry UEGO_DataSplyClsS1B1_I.flgNewUxPckAry UEGO_DataSplyClsS1B1_I.flgReStable UEGO_DataSplyClsS1B1_I.flgSngCell UEGO_DataSplyClsS1B1_I.flgUical0Vld UEGO_DataSplyClsS1B1_I.flgUicalVld UEGO_DataSplyClsS1B1_I.flgUoffipe1Vld UEGO_DataSplyClsS1B1_I.flgUoffipe2Vld UEGO_DataSplyClsS1B1_I.flgUoffipe3Vld UEGO_DataSplyClsS1B1_I.flgUoffvcc1Vld UEGO_DataSplyClsS1B1_I.flgUoffvcc2Vld UEGO_DataSplyClsS1B1_I.flgUoffvcc3Vld UEGO_DataSplyClsS1B1_I.flgUriaMeas UEGO_DataSplyClsS1B1_I.nrIPmpDacPckAry UEGO_DataSplyClsS1B1_I.nrIpPckAry UEGO_DataSplyClsS1B1_I.nrModeMeas UEGO_DataSplyClsS1B1_I.nrRamFailPosn UEGO_DataSplyClsS1B1_I.nrRamMod UEGO_DataSplyClsS1B1_I.nrRamRegMod UEGO_DataSplyClsS1B1_I.nrRamSts1 UEGO_DataSplyClsS1B1_I.nrRamSts2 UEGO_DataSplyClsS1B1_I.nrRamSts3 UEGO_DataSplyClsS1B1_I.nrURmVG4PckAry UEGO_DataSplyClsS1B1_I.nrUa2PckAry UEGO_DataSplyClsS1B1_I.nrUcalMaxCorrd UEGO_DataSplyClsS1B1_I.nrUg0PckAry UEGO_DataSplyClsS1B1_I.nrUg0iPckAry UEGO_DataSplyClsS1B1_I.nrUg0ix7PckAry UEGO_DataSplyClsS1B1_I.nrUg0ix9PckAry UEGO_DataSplyClsS1B1_I.nrUg0ixPckAry UEGO_DataSplyClsS1B1_I.nrUgaPckAry UEGO_DataSplyClsS1B1_I.nrUgiPckAry UEGO_DataSplyClsS1B1_I.nrUi21PckAry UEGO_DataSplyClsS1B1_I.nrUical0PckCorrd UEGO_DataSplyClsS1B1_I.nrUicalPckCorrd UEGO_DataSplyClsS1B1_I.nrUigPckAry UEGO_DataSplyClsS1B1_I.nrUigmkPckAry UEGO_DataSplyClsS1B1_I.nrUn0Pck4Ary UEGO_DataSplyClsS1B1_I.nrUn0Pck5Ary UEGO_DataSplyClsS1B1_I.nrUn0PckAry UEGO_DataSplyClsS1B1_I.nrUnPckAry UEGO_DataSplyClsS1B1_I.nrUnx3PckAry UEGO_DataSplyClsS1B1_I.nrUnx4PckAry UEGO_DataSplyClsS1B1_I.nrUoffipe1 UEGO_DataSplyClsS1B1_I.nrUoffipe2 UEGO_DataSplyClsS1B1_I.nrUoffipe3 UEGO_DataSplyClsS1B1_I.nrUoffvcc1 UEGO_DataSplyClsS1B1_I.nrUoffvcc2 UEGO_DataSplyClsS1B1_I.nrUoffvcc3 UEGO_DataSplyClsS1B1_I.nrUp0Pck5Ary UEGO_DataSplyClsS1B1_I.nrUp0PckAry UEGO_DataSplyClsS1B1_I.nrUpPckAry UEGO_DataSplyClsS1B1_I.nrUpx3PckAry UEGO_DataSplyClsS1B1_I.nrUpx4PckAry UEGO_DataSplyClsS1B1_I.nrUriePckAry UEGO_DataSplyClsS1B1_I.nrUx6PckAry UEGO_DataSplyClsS1B1_I.nrUx7PckAry UEGO_DataSplyClsS1B1_I.nrUx8PckAry UEGO_DataSplyClsS1B1_I.nrUx9PckAry UEGO_DataSplyClsS1B1_I.nrUxPckAry UEGO_DataSplyClsS1B1_I.stIPmpOK UEGO_DataSplyClsS1B1_I.stIPmpTM UEGO_DataSplyClsS1B1_I.stIPmpTM2L UEGO_DataSplyClsS1B1_I.stIPmpTM2R UEGO_DataSplyClsS1B1_I.stLsmRetValMod UEGO_DataSplyClsS1B1_I.stMKMeas UEGO_DataSplyClsS1B1_I.stOFFMeas UEGO_DataSplyClsS1B1_I.stOPTMeas UEGO_DataSplyClsS1B1_I.stREFMeas UEGO_DataSplyClsS1B1_I.stUa2PckAry UEGO_DataSplyClsS1B1_I.stUa2Z1PckAry UEGO_DataSplyClsS1B1_I.stUg0iPckAry UEGO_DataSplyClsS1B1_I.stUg0ix7IActvPckAry UEGO_DataSplyClsS1B1_I.stUg0ix7PmpIActvPckAry UEGO_DataSplyClsS1B1_I.stUg0ix9IActvPckAry UEGO_DataSplyClsS1B1_I.stUg0ix9PmpIActvPckAry UEGO_DataSplyClsS1B1_I.stUg0ixIActvPckAry UEGO_DataSplyClsS1B1_I.stUg0ixPmpIActvPckAry UEGO_DataSplyClsS1B1_I.stUi21PckAry UEGO_DataSplyClsS1B1_I.stUi21Z1PckAry UEGO_DataSplyClsS1B1_I.stUigmkNernstIActvPckAry UEGO_DataSplyClsS1B1_I.stUigmkPmpIActvPckAry UEGO_DataSplyClsS1B1_I.stUn0PckAry UEGO_DataSplyClsS1B1_I.stUn0Z2PckAry UEGO_DataSplyClsS1B1_I.stUnPckAry UEGO_DataSplyClsS1B1_I.stUnx3IActvAcrsNernstCellPckAry UEGO_DataSplyClsS1B1_I.stUnx3IActvAcrsPmpCellPckAry UEGO_DataSplyClsS1B1_I.stUnx4IActvAcrsNernstCellPckAry UEGO_DataSplyClsS1B1_I.stUnx4IActvAcrsPmpCellPckAry UEGO_DataSplyClsS1B1_I.stUp0PckAry UEGO_DataSplyClsS1B1_I.stUp0Z2PckAry UEGO_DataSplyClsS1B1_I.stUpPckAry UEGO_DataSplyClsS1B1_I.stUpZ2PckAry UEGO_DataSplyClsS1B1_I.stUpx3IActvAcrsNernstCellPckAry UEGO_DataSplyClsS1B1_I.stUpx3IActvAcrsPmpCellPckAry UEGO_DataSplyClsS1B1_I.stUpx4IActvAcrsNernstCellPckAry UEGO_DataSplyClsS1B1_I.stUpx4IActvAcrsPmpCellPckAry UEGO_DataSplyClsS1B1_I.stUriePckAry UEGO_DataSplyClsS1B1_I.stUx6IActvPckAry UEGO_DataSplyClsS1B1_I.stUx6MeasAcrsPmpCellPckAry UEGO_DataSplyClsS1B1_I.stUx7IActvPckAry UEGO_DataSplyClsS1B1_I.stUx7MeasAcrsPmpCellPckAry UEGO_DataSplyClsS1B1_I.stUx8IActvPckAry UEGO_DataSplyClsS1B1_I.stUx8MeasAcrsPmpCellPckAry UEGO_DataSplyClsS1B1_I.stUx9IActvPckAry UEGO_DataSplyClsS1B1_I.stUx9MeasAcrsPmpCellPckAry UEGO_DataSplyClsS1B1_I.stUxIActvPckAry UEGO_DataSplyClsS1B1_I.stUxMeasAcrsPmpCell UEGO_DataSplyClsS1B1_I.tiUEGOPck UEGO_DataSplyClsS1B1_I.uFkal1 UEGO_DataSplyClsS1B1_I.uFkal2 UEGO_DataSplyClsS1B1_I.uFkal3 UEGO_DataSplyClsS1B1_I.uUCalPck UEGO_DataSplyClsS1B1_I.uUa31Pck UEGO_DataSplyClsS1B1_I.uUa32Pck UEGO_DataSplyClsS1B1_I.uUa33Pck UEGO_DataSplyClsS1B1_I.uUamPck UEGO_DataSplyClsS1B1_I.uUapePck UEGO_DataSplyClsS1B1_I.uUcalMaxPck UEGO_DataSplyClsS1B1_I.uUg0Pck UEGO_DataSplyClsS1B1_I.uUg0aPck UEGO_DataSplyClsS1B1_I.uUg0ePck UEGO_DataSplyClsS1B1_I.uUg0iPck UEGO_DataSplyClsS1B1_I.uUg0iaiPck UEGO_DataSplyClsS1B1_I.uUg0ieiPck UEGO_DataSplyClsS1B1_I.uUg0mPck UEGO_DataSplyClsS1B1_I.uUgkAvrgPck UEGO_DataSplyClsS1B1_I.uUguaPck UEGO_DataSplyClsS1B1_I.uUguaZ2Pck UEGO_DataSplyClsS1B1_I.uUguiPck UEGO_DataSplyClsS1B1_I.uUguiZ1Pck UEGO_DataSplyClsS1B1_I.uUi22Pck UEGO_DataSplyClsS1B1_I.uUi23Pck UEGO_DataSplyClsS1B1_I.uUi24Pck UEGO_DataSplyClsS1B1_I.uUi4Pck UEGO_DataSplyClsS1B1_I.uUi4Z2Pck UEGO_DataSplyClsS1B1_I.uUipcalAvrgPck UEGO_DataSplyClsS1B1_I.uUn0Pck UEGO_DataSplyClsS1B1_I.uUnSet UEGO_DataSplyClsS1B1_I.uUp0Pck UEGO_DataSplyClsS1B1_I.uUp0Pck4 UEGO_DataSplyClsS1B1_I.uUriaPck UEGO_DataSplyClsS1B1_I.uVCC1Corrd UEGO_DataSplyClsS1B1_I.uVCC3Ref UEGO_flgDiagSigWireOlRstS1B1 UEGO_flgRNernstHiPrcsnS1B1 UEGO_flgRNernstVldS1B1 UEGO_flgRPmpHiPrcsnS1B1 UEGO_flgRPmpPlsOperHiPrcsnS1B1 UEGO_flgRPmpPlsOperVldS1B1 UEGO_flgRPmpVldS1B1 UEGO_flgSnglCellS1B1 UEGO_flgSysSuprtdS1B1 UEGO_RegSetS1B1_I.cntrRegSet UEGO_RegSetS1B1_I.flgCJ135An UEGO_RegSetS1B1_I.flgConvVld UEGO_RegSetS1B1_I.flgIPmpDes UEGO_RegSetS1B1_I.flgIPmpPhyRels UEGO_RegSetS1B1_I.flgIniFinshd UEGO_RegSetS1B1_I.flgLoupeCURRDes UEGO_RegSetS1B1_I.flgLoupeDACDes UEGO_RegSetS1B1_I.flgLoupeNDes UEGO_RegSetS1B1_I.flgLoupePDes UEGO_RegSetS1B1_I.flgNewReq UEGO_RegSetS1B1_I.flgRegSetSt UEGO_RegSetS1B1_I.flgRegSetStVld UEGO_RegSetS1B1_I.flgReqAcptd UEGO_RegSetS1B1_I.flgSetRegOk UEGO_RegSetS1B1_I.flgTakeDataOk UEGO_RegSetS1B1_I.idxChp UEGO_RegSetS1B1_I.nrIdleSubMode UEGO_RegSetS1B1_I.nrModDes UEGO_RegSetS1B1_I.nrNormSubMode UEGO_RegSetS1B1_I.nrRegSet UEGO_RegSetS1B1_I.nrSubModDes UEGO_RegSetS1B1_I.nrSwtOnSubMode UEGO_RegSetS1B1_I.nrTrmSq UEGO_RegSetS1B1_I.nrWrmUpSubMode UEGO_RegSetS1B1_I.stRegSet UEGO_RegSetS1B1_I.stRegSetVld UEGO_RegSetS1B1_I.tmpVar UEGO_rRNernstS1B1 UEGO_rRPmpPlsOperS1B1 UEGO_rRPmpS1B1 /end IN_MEASUREMENT
 /begin OUT_MEASUREMENT UEGO_facRNernstRPmpPlsOperS1B1 UEGO_facRNernstRPmpS1B1 UEGO_flgRCeramicVldS1B1 UEGO_flgRNernstRPmpPlsOperVldS1B1 UEGO_flgRNernstRPmpVldS1B1 UEGO_flgTCeramicHiPrcsnS1B1 UEGO_flgTCeramicVldS1B1 UEGO_rCeramicS1B1 UEGO_tCeramicS1B1 /end OUT_MEASUREMENT
 /begin LOC_MEASUREMENT UEGO_TCeramicEvlnS1B1_I.facRNernstRPmp UEGO_TCeramicEvlnS1B1_I.facRNernstRPmpPlsOper UEGO_TCeramicEvlnS1B1_I.flgRCeramicFilVld UEGO_TCeramicEvlnS1B1_I.flgRCeramicRawHiPrcsn UEGO_TCeramicEvlnS1B1_I.flgRCeramicRawVld UEGO_TCeramicEvlnS1B1_I.flgRCeramicVld UEGO_TCeramicEvlnS1B1_I.flgRNernstRPmpPlsOperVld UEGO_TCeramicEvlnS1B1_I.flgRNernstRPmpVld UEGO_TCeramicEvlnS1B1_I.flgTCeramicHiPrcsn UEGO_TCeramicEvlnS1B1_I.flgTCeramicLimIni UEGO_TCeramicEvlnS1B1_I.flgTCeramicVld UEGO_TCeramicEvlnS1B1_I.nrModInt UEGO_TCeramicEvlnS1B1_I.rCeramic UEGO_TCeramicEvlnS1B1_I.rCeramicRaw UEGO_TCeramicEvlnS1B1_I.tCeramic UEGO_TCeramicEvlnS1B1_I.tCeramicMax UEGO_TCeramicEvlnS1B1_I.tCeramicMin UEGO_TCeramicEvlnS1B1_I.UEGO_facRNernstRPmpEvlnFilDlydVldy_I.flgFilVldy UEGO_TCeramicEvlnS1B1_I.UEGO_facRNernstRPmpEvlnFilDlydVldy_I.nrSampleCurr UEGO_TCeramicEvlnS1B1_I.UEGO_facRNernstRPmpEvlnFilDlydVldy_I.nrSampleRef UEGO_TCeramicEvlnS1B1_I.UEGO_facRNernstRPmpEvlnFilDlydVldy_I.nrSampleThd UEGO_TCeramicEvlnS1B1_I.UEGO_facRNernstRPmpEvlnFilDlydVldy_I.EvlnFil_DL_I.memory UEGO_TCeramicEvlnS1B1_I.UEGO_facRNernstRPmpPlsOperEvlnFilDlydVldy_I.flgFilVldy UEGO_TCeramicEvlnS1B1_I.UEGO_facRNernstRPmpPlsOperEvlnFilDlydVldy_I.nrSampleCurr UEGO_TCeramicEvlnS1B1_I.UEGO_facRNernstRPmpPlsOperEvlnFilDlydVldy_I.nrSampleRef UEGO_TCeramicEvlnS1B1_I.UEGO_facRNernstRPmpPlsOperEvlnFilDlydVldy_I.nrSampleThd UEGO_TCeramicEvlnS1B1_I.UEGO_facRNernstRPmpPlsOperEvlnFilDlydVldy_I.EvlnFil_DL_I.memory UEGO_TCeramicEvlnS1B1_I.UEGO_uEvlnFilRCeramicDlydVldy_I.flgFilVldy UEGO_TCeramicEvlnS1B1_I.UEGO_uEvlnFilRCeramicDlydVldy_I.nrSampleCurr UEGO_TCeramicEvlnS1B1_I.UEGO_uEvlnFilRCeramicDlydVldy_I.nrSampleRef UEGO_TCeramicEvlnS1B1_I.UEGO_uEvlnFilRCeramicDlydVldy_I.nrSampleThd UEGO_TCeramicEvlnS1B1_I.UEGO_uEvlnFilRCeramicDlydVldy_I.EvlnFil_DL_I.memory UEGO_TCeramicEvlnS1B1_I.flgRCeramicVldyTOFFVNM_I.time /end LOC_MEASUREMENT
 FUNCTION_VERSION "1.17.1" /end FUNCTION
/begin FUNCTION UEGO_Tstr "1.13.0    Tester releases for UEGO functions" /begin DEF_CHARACTERISTIC UEGO_TstrClassS1B1_I.stTstrCtl_C /end DEF_CHARACTERISTIC /begin IN_MEASUREMENT UEGO_flgSysSuprtdS1B1 /end IN_MEASUREMENT /begin OUT_MEASUREMENT UEGO_flgTstrRelsS1B1 /end OUT_MEASUREMENT
 /begin LOC_MEASUREMENT UEGO_TstrClassS1B1_I.flgHeatrRelsATS UEGO_TstrClassS1B1_I.flgTstrRels UEGO_TstrClassS1B1_I.bHtrActvPrevStrtER_I.buffer UEGO_TstrClassS1B1_I.bHtrActvPrevStrtER_I.oldSignal UEGO_TstrClassS1B1_I.bHtrActvPrevStrtFF_I.status /end LOC_MEASUREMENT
 FUNCTION_VERSION "1.13.0" /end FUNCTION
/begin COMPU_METHOD ASCET_10_RvsChrg "" RAT_FUNC "%9.8" "" COEFFS 0 1073741824 0 0 0 109.9511627776 /end COMPU_METHOD
/begin COMPU_METHOD B_TRUE "" TAB_VERB "%6.3" "" COMPU_TAB_REF B_TRUE /end COMPU_METHOD
/begin COMPU_VTAB B_TRUE "" TAB_VERB 2 0 "FALSE" 1 "TRUE" /end COMPU_VTAB
/begin COMPU_METHOD dez "" RAT_FUNC "%6.2" "" COEFFS 0 1 0 0 0 1 /end COMPU_METHOD
/begin COMPU_METHOD Fact10 "" RAT_FUNC "%13.12" "-" COEFFS 0 10000000000 0 0 0 1 /end COMPU_METHOD
/begin COMPU_METHOD fak_q0p000031 "" RAT_FUNC "%7.6" "" COEFFS 0 1 0 0 0 3.1e-005 /end COMPU_METHOD
/begin COMPU_METHOD fak_q0p000244 "" RAT_FUNC "%6.5" "-" COEFFS 0 65536 0 0 0 16 /end COMPU_METHOD
/begin COMPU_METHOD fak_q0p001 "" RAT_FUNC "%6.5" "-" COEFFS 0 1000 0 0 0 1 /end COMPU_METHOD
/begin COMPU_METHOD fak_q1p201Em4 "" RAT_FUNC "%6.5" "-" COEFFS 0 8325 0 0 0 1 /end COMPU_METHOD
/begin COMPU_METHOD fak_q3p72529Em9 "" RAT_FUNC "%11.10" "" COEFFS 0 268435456 0 0 0 1 /end COMPU_METHOD
/begin COMPU_METHOD fak_uw_b1 "" RAT_FUNC "%7.6" "-" COEFFS 0 65536 0 0 0 1 /end COMPU_METHOD
/begin COMPU_METHOD fak_uw_b2 "" RAT_FUNC "%7.6" "-" COEFFS 0 65536 0 0 0 2 /end COMPU_METHOD
/begin COMPU_METHOD g_q1p6667Em7_S "" RAT_FUNC "%9.8" "s" COEFFS 0 6000000 0 0 0 1 /end COMPU_METHOD
/begin COMPU_METHOD i_q6p6667Em7_A "" RAT_FUNC "%9.8" "A" COEFFS 0 1500000 0 0 0 1 /end COMPU_METHOD
/begin COMPU_METHOD i_q6p667Em8_A "" RAT_FUNC "%10.9" "A" COEFFS 0 15000000 0 0 0 1 /end COMPU_METHOD
/begin COMPU_METHOD leist_q0p00244 "" RAT_FUNC "%6.4" "W" COEFFS 0 4096 0 0 0 10 /end COMPU_METHOD
/begin COMPU_METHOD OneToOne "" RAT_FUNC "%6.2" "-" COEFFS 0 1 0 0 0 1 /end COMPU_METHOD
/begin COMPU_METHOD q1Em10_F "" RAT_FUNC "%13.12" "F" COEFFS 0 100000 0 0 0 1e-005 /end COMPU_METHOD
/begin COMPU_METHOD q1p907Em6_Ohm_DIV_J "" RAT_FUNC "%8.7" "Ohm/J" COEFFS 0 524288 0 0 0 1 /end COMPU_METHOD
/begin COMPU_METHOD q_q6p1035Em5_J "" RAT_FUNC "%7.6" "J" COEFFS 0 65536 0 0 0 4 /end COMPU_METHOD
/begin COMPU_METHOD RNERNST_COMPU_VERB "" TAB_VERB "%6.3" "" COMPU_TAB_REF RNERNST_COMPU_VERB /end COMPU_METHOD
/begin COMPU_VTAB RNERNST_COMPU_VERB "" TAB_VERB 12 0 "RNERNST_RST0" 1 "RNERNST_RST1" 2 "RNERNST_RST2" 3 "RNERNST_RST3" 4 "RNERNST_RST4" 5 "RNERNST_RST5" 6 "RNERNST_RST6" 20 "RNERNST_SWTON" 21 "RNERNST_WRMUP" 22 "RNERNST_NORM" 23 "RNERNST_RAWVALCALC" 24 "RNERNST_RAWVALFIL" /end COMPU_VTAB
/begin COMPU_METHOD RPMPPLSOPER_COMPU_VERB "" TAB_VERB "%6.3" "" COMPU_TAB_REF RPMPPLSOPER_COMPU_VERB /end COMPU_METHOD
/begin COMPU_VTAB RPMPPLSOPER_COMPU_VERB "" TAB_VERB 4 1 "RPMPPLSOPER_RST_PCK_MISS" 31 "RPMPPLSOPER_NORM3FIRSTPLS" 32 "RPMPPLSOPER_NORM3SECPLS" 2 "RPMPPLSOPER_RST_ACTVN" /end COMPU_VTAB
/begin COMPU_METHOD r_q0p1_Ohm "" RAT_FUNC "%6.3" "Ohm" COEFFS 0 10 0 0 0 1 /end COMPU_METHOD
/begin COMPU_METHOD r_q1p5259Em6_Ohm "" RAT_FUNC "%8.7" "Ohm" COEFFS 0 655360 0 0 0 1 /end COMPU_METHOD
/begin COMPU_METHOD r_q9p765625Em4_Ohm "" RAT_FUNC "%6.5" "Ohm" COEFFS 0 65536 0 0 0 64 /end COMPU_METHOD
/begin COMPU_METHOD spg_q0p005 "" RAT_FUNC "%6.4" "V" COEFFS 0 1 0 0 0 0.005 /end COMPU_METHOD
/begin COMPU_METHOD spg_q3p2Em4_V "" RAT_FUNC "%6.5" "V" COEFFS 0 32768 0 0 0 10.48576 /end COMPU_METHOD
/begin COMPU_METHOD spg_q4p883Em9_V "" RAT_FUNC "%11.10" "V" COEFFS 0 204800000 0 0 0 1 /end COMPU_METHOD
/begin COMPU_METHOD temp_q0p0234 "" RAT_FUNC "%6.4" "K" COEFFS 0 256 0 0 0 6 /end COMPU_METHOD
/begin COMPU_METHOD temp_q0p0234_o273 "" RAT_FUNC "%6.1" "Grad C" COEFFS 0 1 273.15 0 0 0.0234375 /end COMPU_METHOD
/begin COMPU_METHOD Time_sec_q1_COMPU "" RAT_FUNC "%6.2" "s" COEFFS 0 1 0 0 0 1 /end COMPU_METHOD
/begin COMPU_METHOD t_q0p000001_s "" RAT_FUNC "%9.8" "s" COEFFS 0 1000000 0 0 0 1 /end COMPU_METHOD
/begin COMPU_METHOD t_q0p0001_s "" RAT_FUNC "%7.6" "s" COEFFS 0 10000 0 0 0 1 /end COMPU_METHOD
/begin COMPU_METHOD t_q0p005 "" RAT_FUNC "%6.4" "s" COEFFS 0 1000 0 0 0 5 /end COMPU_METHOD
/begin COMPU_METHOD t_q0p02 "" RAT_FUNC "%6.4" "s" COEFFS 0 100 0 0 0 2 /end COMPU_METHOD
/begin COMPU_METHOD t_q1 "" RAT_FUNC "%6.2" "s" COEFFS 0 1 0 0 0 1 /end COMPU_METHOD
/begin COMPU_METHOD UEGO_RPmpModIntCtrl_COMPU_VERB "" TAB_VERB "%6.3" "" COMPU_TAB_REF UEGO_RPmpModIntCtrl_COMPU_VERB /end COMPU_METHOD
/begin COMPU_VTAB UEGO_RPmpModIntCtrl_COMPU_VERB "" TAB_VERB 7 0 "UEGO_RPMPNORMALURIAON" 1 "UEGO_RPMPNORMALURIAOFF" 2 "UEGO_RPMPSWTONURIAON" 3 "UEGO_RPMPSWTONURIAOFF" 4 "UEGO_RPMPWRMUPURIAON" 5 "UEGO_RPMPIDLEURIAOFF" 6 "UEGO_RPMPDIAGURIAOFF" /end COMPU_VTAB
/begin COMPU_METHOD UEGO_RPmpModIntEvln_COMPU_VERB "" TAB_VERB "%6.3" "" COMPU_TAB_REF UEGO_RPmpModIntEvln_COMPU_VERB /end COMPU_METHOD
/begin COMPU_VTAB UEGO_RPmpModIntEvln_COMPU_VERB "" TAB_VERB 12 0 "UEGO_RPMPPCKMISS" 1 "UEGO_RPMPWRMUP" 2 "UEGO_RPMPWRMUPINVALID" 3 "UEGO_RPMPINVALID" 4 "UEGO_RPMPSWTON" 5 "UEGO_RPMPSWTONISQRINVALID" 6 "UEGO_RPMPISQR2LOW" 7 "UEGO_RPMPDISABLED" 8 "UEGO_RPMPNORMALINVALID" 9 "UEGO_RPMPNORMAL" 10 "UEGO_RPMPSWTONINVALID" 11 "UEGO_RPMPISQRINVALID" /end COMPU_VTAB
/begin COMPU_METHOD UEGO_RvsChrgModInt_COMPU_VERB "" TAB_VERB "%6.3" "" COMPU_TAB_REF UEGO_RvsChrgModInt_COMPU_VERB /end COMPU_METHOD
/begin COMPU_VTAB UEGO_RvsChrgModInt_COMPU_VERB "" TAB_VERB 6 0 "UEGO_RvsChrgUi_Default" 1 "UEGO_RvsChrgUi_Std_Learn" 2 "UEGO_RvsChrgUi_Lean_Learn" 3 "UEGO_RvsChrgUi_Rich_Learn" 4 "UEGO_RvsChrgUi_Lean_NoLearn" 5 "UEGO_RvsChrgUi_Rich_NoLearn" /end COMPU_VTAB
/begin COMPU_METHOD UEGO_SNSRType_COMPU_VERB "" TAB_VERB "%6.3" "" COMPU_TAB_REF UEGO_SNSRType_COMPU_VERB /end COMPU_METHOD
/begin COMPU_VTAB UEGO_SNSRType_COMPU_VERB "" TAB_VERB 12 0 "Sensor not supported" 1 "LSU4.9 or LSU4.9TSP" 2 "LSU_ADV" 3 "LSU 5.1" 4 "LSU 5.2" 10 "NTKU2 or NTKU2.1 with RCmp" 11 "NTKU2 No RCmp" 12 "NTKU3 with RCmp" 13 "NTKU3 No RCmp" 20 "Denso Plus5.1" 21 "Denso Plus6.1" 22 "Denso Plus6.F" /end COMPU_VTAB
/begin COMPU_METHOD UEGO_TCeramicModInt_COMPU_VERB "" TAB_VERB "%6.3" "" COMPU_TAB_REF UEGO_TCeramicModInt_COMPU_VERB /end COMPU_METHOD
/begin COMPU_VTAB UEGO_TCeramicModInt_COMPU_VERB "" TAB_VERB 8 0 "UEGO_TCERAMICPCKMISS" 1 "UEGO_RPMPPLSOPERENFACTV" 2 "UEGO_RNERNSTENFACTV" 3 "UEGO_RPMPENFACTV" 4 "UEGO_RPMPPLSOPERACTV" 5 "UEGO_RNERNSTACTV" 6 "UEGO_RPMPACTV" 7 "UEGO_NO_EVAL" /end COMPU_VTAB
/begin COMPU_METHOD USESTRTSYNCINTRPTCFG_SC_Compu "" TAB_VERB "%6.3" "" COMPU_TAB_REF USESTRTSYNCINTRPTCFG_SC_Compu /end COMPU_METHOD
/begin COMPU_VTAB USESTRTSYNCINTRPTCFG_SC_Compu "" TAB_VERB 2 0 "disabled" 1 "enabled" /end COMPU_VTAB
/begin COMPU_METHOD USGOFFTIGENNIF_SC_Compu "" TAB_VERB "%6.3" "" COMPU_TAB_REF USGOFFTIGENNIF_SC_Compu /end COMPU_METHOD
/begin COMPU_VTAB USGOFFTIGENNIF_SC_Compu "" TAB_VERB 2 1 "IF_GEN1" 2 "IF_GEN2" /end COMPU_VTAB
/begin COMPU_METHOD VARCOD_SY_Compu "" TAB_VERB "%6.3" "" COMPU_TAB_REF VARCOD_SY_Compu /end COMPU_METHOD
/begin COMPU_VTAB VARCOD_SY_Compu "" TAB_VERB 4 0 "VARCOD_NO" 1 "VARCOD_LONG" 2 "VARCOD_SHORT" 3 "VARCOD_CONCERN" /end COMPU_VTAB
/begin COMPU_METHOD VCRTYP_SC_Compu "" TAB_VERB "%6.3" "" COMPU_TAB_REF VCRTYP_SC_Compu /end COMPU_METHOD
/begin COMPU_VTAB VCRTYP_SC_Compu "" TAB_VERB 2 0 "Fixed" 1 "Continuous" /end COMPU_VTAB
/begin COMPU_METHOD VEHDEV_APPPIDENA_SC_Compu "" TAB_VERB "%6.3" "" COMPU_TAB_REF VEHDEV_APPPIDENA_SC_Compu /end COMPU_METHOD
/begin COMPU_VTAB VEHDEV_APPPIDENA_SC_Compu "" TAB_VERB 2 0 "False" 1 "True" /end COMPU_VTAB
/begin COMPU_METHOD VEHDEV_HNDBRKENA_SC_Compu "" TAB_VERB "%6.3" "" COMPU_TAB_REF VEHDEV_HNDBRKENA_SC_Compu /end COMPU_METHOD
/begin COMPU_VTAB VEHDEV_HNDBRKENA_SC_Compu "" TAB_VERB 2 0 "False" 1 "True" /end COMPU_VTAB
/begin COMPU_METHOD VEHDEV_HNDBRKLAMPENA_SC_Compu "" TAB_VERB "%6.3" "" COMPU_TAB_REF VEHDEV_HNDBRKLAMPENA_SC_Compu /end COMPU_METHOD
/begin COMPU_VTAB VEHDEV_HNDBRKLAMPENA_SC_Compu "" TAB_VERB 2 0 "False" 1 "True" /end COMPU_VTAB
/begin COMPU_METHOD VEHDEV_VAR_SY_Compu "" TAB_VERB "%6.3" "" COMPU_TAB_REF VEHDEV_VAR_SY_Compu /end COMPU_METHOD
/begin COMPU_VTAB VEHDEV_VAR_SY_Compu "" TAB_VERB 47 1 "DAI" 3 "VWW" 4 "POR" 5 "AUD" 6 "OPE" 9 "FIA" 11 "BMW" 14 "PSA" 15 "REN" 17 "ALF" 18 "SAB" 19 "VOL" 20 "NIS" 21 "GMU" 22 "FOR" 26 "IMJ" 36 "MAN" 51 "SEA" 53 "CHR" 54 "JAG" 55 "ROL" 69 "FER" 72 "TOY" 123 "MIT" 147 "HYU" 159 "HON" 160 "MAZ" 183 "CU" 190 "LRG" 204 "VVW" 214 "AVT" 226 "YUCHAI_OHW" 242 "Iveco" 243 "DMC" 248 "SUZ" 267 "SSANGYONG" 270 "KEF" 289 "AMG" 308 "TAT" 319 "MVM" 385 "UAES" 590 "Scania" 828 "RBCD" 973 "YANMAR" 999 "ALL" 2887 "Nonox" 9454 "Fuso" /end COMPU_VTAB
/begin COMPU_METHOD VEHFDE_NRCNDTRIG_SC_Compu "" RAT_FUNC "%6.2" "" COEFFS 0 1 0 0 0 1 /end COMPU_METHOD
/begin COMPU_METHOD VEHFDE_NRCNVTNLDISTBN_SC_Compu "" RAT_FUNC "%6.2" "" COEFFS 0 1 0 0 0 1 /end COMPU_METHOD
/begin COMPU_METHOD VEHFDE_NREXTTRIG_SC_Compu "" RAT_FUNC "%6.2" "" COEFFS 0 1 0 0 0 1 /end COMPU_METHOD
/begin COMPU_METHOD VEHFDE_NRFREETRIG_SC_Compu "" RAT_FUNC "%6.2" "" COEFFS 0 1 0 0 0 1 /end COMPU_METHOD
/begin COMPU_METHOD VEHFDE_NRINDCLASS_SC_Compu "" RAT_FUNC "%6.2" "" COEFFS 0 1 0 0 0 1 /end COMPU_METHOD
/begin COMPU_METHOD VEHFDE_NRMILGTRIG_SC_Compu "" RAT_FUNC "%6.2" "" COEFFS 0 1 0 0 0 1 /end COMPU_METHOD
/begin COMPU_METHOD VEHFDE_NRSNGVALSTC_SC_Compu "" RAT_FUNC "%6.2" "" COEFFS 0 1 0 0 0 1 /end COMPU_METHOD
/begin COMPU_METHOD VEHFDE_NRSTC_SC_Compu "" RAT_FUNC "%6.2" "" COEFFS 0 1 0 0 0 1 /end COMPU_METHOD
/begin COMPU_METHOD VEHFDE_NRVALCHGTRIG_SC_Compu "" RAT_FUNC "%6.2" "" COEFFS 0 1 0 0 0 1 /end COMPU_METHOD
/begin COMPU_METHOD VEHSTC_ECOLAMPACTV_SC_Compu "" TAB_VERB "%6.3" "" COMPU_TAB_REF VEHSTC_ECOLAMPACTV_SC_Compu /end COMPU_METHOD
/begin COMPU_VTAB VEHSTC_ECOLAMPACTV_SC_Compu "" TAB_VERB 2 0 "False" 1 "True" /end COMPU_VTAB
/begin COMPU_METHOD VEHTYPSELN_SC_Compu "" TAB_VERB "%6.3" "" COMPU_TAB_REF VEHTYPSELN_SC_Compu /end COMPU_METHOD
/begin COMPU_VTAB VEHTYPSELN_SC_Compu "" TAB_VERB 4 0 "PV" 1 "CV" 2 "OHW" 3 "LCV" /end COMPU_VTAB
/begin COMPU_METHOD VEHTYP_SC_Compu "" TAB_VERB "%6.3" "" COMPU_TAB_REF VEHTYP_SC_Compu /end COMPU_METHOD
/begin COMPU_VTAB VEHTYP_SC_Compu "" TAB_VERB 2 1 "Two_Wheeler" 2 "Four_Wheeler" /end COMPU_VTAB
/begin RECORD_LAYOUT RB_Curve_S16_S16 NO_AXIS_PTS_X 1 SWORD AXIS_PTS_X 2 SWORD INDEX_INCR DIRECT FNC_VALUES 3 SWORD COLUMN_DIR DIRECT /end RECORD_LAYOUT
/begin RECORD_LAYOUT RB_Curve_U16_S16_Static NO_AXIS_PTS_X 1 UWORD AXIS_PTS_X 2 UWORD INDEX_INCR DIRECT FNC_VALUES 3 SWORD COLUMN_DIR DIRECT STATIC_RECORD_LAYOUT /end RECORD_LAYOUT
/begin RECORD_LAYOUT RB_Curve_U16_U16 NO_AXIS_PTS_X 1 UWORD AXIS_PTS_X 2 UWORD INDEX_INCR DIRECT FNC_VALUES 3 UWORD COLUMN_DIR DIRECT /end RECORD_LAYOUT
/begin RECORD_LAYOUT RB_Val_Ws16 FNC_VALUES 1 SWORD COLUMN_DIR DIRECT /end RECORD_LAYOUT
/begin RECORD_LAYOUT RB_Val_Ws32 FNC_VALUES 1 SLONG COLUMN_DIR DIRECT /end RECORD_LAYOUT
/begin RECORD_LAYOUT RB_Val_Wu16 FNC_VALUES 1 UWORD COLUMN_DIR DIRECT /end RECORD_LAYOUT
/begin RECORD_LAYOUT RB_Val_Wu32 FNC_VALUES 1 ULONG COLUMN_DIR DIRECT /end RECORD_LAYOUT
/begin RECORD_LAYOUT RB_Val_Wu8 FNC_VALUES 1 UBYTE COLUMN_DIR DIRECT /end RECORD_LAYOUT
/end MODULE
/end PROJECT
