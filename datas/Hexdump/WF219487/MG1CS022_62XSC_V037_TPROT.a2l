ASAP2_VERSION 1 60
/begin PROJECT MG1CS022 "MG1CS022"
/begin HEADER "" VERSION "MG1CS022_62XSC_V037_TPROT" PROJECT_NO MG1CS022 /end HEADER
/begin MODULE DIM ""
/begin MOD_COMMON "" BYTE_ORDER MSB_LAST ALIGNMENT_BYTE 1 ALIGNMENT_WORD 2 ALIGNMENT_LONG 4 ALIGNMENT_INT64 4 ALIGNMENT_FLOAT32_IEEE 4 ALIGNMENT_FLOAT64_IEEE 4 DATA_SIZE 32 /end MOD_COMMON
/begin MEASUREMENT DFC_b.TSC_ThrVlvRetSprgSprdB1 "Bit encoding / Ok-Tested Since Clear bit for check DFC_ThrVlvRetSprgSprdB1" UBYTE DFC_OneToOne 1 100 0.00 1.000 BIT_MASK 0x20 FORMAT "%5.3" ECU_ADDRESS 0x60037235 /end MEASUREMENT
/begin MEASUREMENT DFC_b.TSC_ThrVlvRetSprgTwnB1 "Bit encoding / Ok-Tested Since Clear bit for check DFC_ThrVlvRetSprgTwnB1" UBYTE DFC_OneToOne 1 100 0.00 1.000 BIT_MASK 0x20 FORMAT "%5.3" ECU_ADDRESS 0x60037236 /end MEASUREMENT
/begin MEASUREMENT DFC_b.TSC_ThrVlvSens1MaxB1 "Bit encoding / Ok-Tested Since Clear bit for check DFC_ThrVlvSens1MaxB1" UBYTE DFC_OneToOne 1 100 0.00 1.000 BIT_MASK 0x20 FORMAT "%5.3" ECU_ADDRESS 0x60037237 /end MEASUREMENT
/begin MEASUREMENT DFC_b.TSC_ThrVlvSens1NplB1 "Bit encoding / Ok-Tested Since Clear bit for check DFC_ThrVlvSens1NplB1" UBYTE DFC_OneToOne 1 100 0.00 1.000 BIT_MASK 0x20 FORMAT "%5.3" ECU_ADDRESS 0x60037238 /end MEASUREMENT
/begin MEASUREMENT DFC_b.TSC_ThrVlvSens2MaxB1 "Bit encoding / Ok-Tested Since Clear bit for check DFC_ThrVlvSens2MaxB1" UBYTE DFC_OneToOne 1 100 0.00 1.000 BIT_MASK 0x20 FORMAT "%5.3" ECU_ADDRESS 0x60037239 /end MEASUREMENT
/begin MEASUREMENT DFC_b.TSC_ThrVlvSens2MinB1 "Bit encoding / Ok-Tested Since Clear bit for check DFC_ThrVlvSens2MinB1" UBYTE DFC_OneToOne 1 100 0.00 1.000 BIT_MASK 0x20 FORMAT "%5.3" ECU_ADDRESS 0x6003723A /end MEASUREMENT
/begin MEASUREMENT DFC_b.TSC_ThrVlvSens2NplB1 "Bit encoding / Ok-Tested Since Clear bit for check DFC_ThrVlvSens2NplB1" UBYTE DFC_OneToOne 1 100 0.00 1.000 BIT_MASK 0x20 FORMAT "%5.3" ECU_ADDRESS 0x6003723B /end MEASUREMENT
/begin MEASUREMENT DFC_b.TSC_ThrVlvShoCircB1 "Bit encoding / Ok-Tested Since Clear bit for check DFC_ThrVlvShoCircB1" UBYTE DFC_OneToOne 1 100 0.00 1.000 BIT_MASK 0x20 FORMAT "%5.3" ECU_ADDRESS 0x6003723C /end MEASUREMENT
/begin MEASUREMENT DFC_b.TSC_ThrVlvSpiErrB1 "Bit encoding / Ok-Tested Since Clear bit for check DFC_ThrVlvSpiErrB1" UBYTE DFC_OneToOne 1 100 0.00 1.000 BIT_MASK 0x20 FORMAT "%5.3" ECU_ADDRESS 0x6003723D /end MEASUREMENT
/begin MEASUREMENT DFC_b.TSC_ThrvlvSens1MinB1 "Bit encoding / Ok-Tested Since Clear bit for check DFC_ThrvlvSens1MinB1" UBYTE DFC_OneToOne 1 100 0.00 1.000 BIT_MASK 0x20 FORMAT "%5.3" ECU_ADDRESS 0x6003723E /end MEASUREMENT
/begin MEASUREMENT DFC_b.TSC_TiOffTBasdChkFast "Bit encoding / Ok-Tested Since Clear bit for check DFC_TiOffTBasdChkFast" UBYTE DFC_OneToOne 1 100 0.00 1.000 BIT_MASK 0x20 FORMAT "%5.3" ECU_ADDRESS 0x6003723F /end MEASUREMENT
/begin MEASUREMENT DFC_b.TSC_TiOffTBasdChkSlow "Bit encoding / Ok-Tested Since Clear bit for check DFC_TiOffTBasdChkSlow" UBYTE DFC_OneToOne 1 100 0.00 1.000 BIT_MASK 0x20 FORMAT "%5.3" ECU_ADDRESS 0x60037240 /end MEASUREMENT
/begin MEASUREMENT DFC_b.TSC_UEGOSnsrMntdS1B1 "Bit encoding / Ok-Tested Since Clear bit for check DFC_UEGOSnsrMntdS1B1" UBYTE DFC_OneToOne 1 100 0.00 1.000 BIT_MASK 0x20 FORMAT "%5.3" ECU_ADDRESS 0x60037241 /end MEASUREMENT
/begin MEASUREMENT DFC_b.TSC_VehVSig "Bit encoding / Ok-Tested Since Clear bit for check DFC_VehVSig" UBYTE DFC_OneToOne 1 100 0.00 1.000 BIT_MASK 0x20 FORMAT "%5.3" ECU_ADDRESS 0x60037242 /end MEASUREMENT
/begin MEASUREMENT DFC_b.TSC_VlvLftFbSwtIntk11SpclFail "Bit encoding / Ok-Tested Since Clear bit for check DFC_VlvLftFbSwtIntk11SpclFail" UBYTE DFC_OneToOne 1 100 0.00 1.000 BIT_MASK 0x20 FORMAT "%5.3" ECU_ADDRESS 0x60037243 /end MEASUREMENT
/begin MEASUREMENT DFC_b.TSC_VlvLftFbSwtIntk11StdFail "Bit encoding / Ok-Tested Since Clear bit for check DFC_VlvLftFbSwtIntk11StdFail" UBYTE DFC_OneToOne 1 100 0.00 1.000 BIT_MASK 0x20 FORMAT "%5.3" ECU_ADDRESS 0x60037244 /end MEASUREMENT
/begin MEASUREMENT DFC_st.DFC_Unused "Status of DFC / " UBYTE DFC_OneToOne 1 100 0.00 255.0 FORMAT "%5.1" ECU_ADDRESS 0x60036EBA /end MEASUREMENT
/begin MEASUREMENT DFC_st.DFC_AAVEmax "Status of DFC / Status of diagnostic fault check DFC_AAVEmax" UBYTE DFC_OneToOne 1 100 0.00 255.0 FORMAT "%5.1" ECU_ADDRESS 0x60036EBB /end MEASUREMENT
/begin MEASUREMENT DFC_st.DFC_AAVEmin "Status of DFC / Status of diagnostic fault check DFC_AAVEmin" UBYTE DFC_OneToOne 1 100 0.00 255.0 FORMAT "%5.1" ECU_ADDRESS 0x60036EBC /end MEASUREMENT
/begin MEASUREMENT DFC_st.DFC_AAVEsig "Status of DFC / Status of diagnostic fault check DFC_AAVEsig" UBYTE DFC_OneToOne 1 100 0.00 255.0 FORMAT "%5.1" ECU_ADDRESS 0x60036EBD /end MEASUREMENT
/begin MEASUREMENT DFC_st.DFC_AltIOACGFailr "Status of DFC / Status of diagnostic fault check DFC_AltIOACGFailr" UBYTE DFC_OneToOne 1 100 0.00 255.0 FORMAT "%5.1" ECU_ADDRESS 0x60036EBE /end MEASUREMENT
/begin MEASUREMENT DFC_st.DFC_AltIOACGHiVltg "Status of DFC / Status of diagnostic fault check DFC_AltIOACGHiVltg" UBYTE DFC_OneToOne 1 100 0.00 255.0 FORMAT "%5.1" ECU_ADDRESS 0x60036EBF /end MEASUREMENT
/begin MEASUREMENT DFC_st.DFC_AltIOACGLoVltg "Status of DFC / Status of diagnostic fault check DFC_AltIOACGLoVltg" UBYTE DFC_OneToOne 1 100 0.00 255.0 FORMAT "%5.1" ECU_ADDRESS 0x60036EC0 /end MEASUREMENT
/begin MEASUREMENT DFC_st.DFC_AltIOACGTHi "Status of DFC / Status of diagnostic fault check DFC_AltIOACGTHi" UBYTE DFC_OneToOne 1 100 0.00 255.0 FORMAT "%5.1" ECU_ADDRESS 0x60036EC1 /end MEASUREMENT
/begin MEASUREMENT DFC_st.DFC_AltIODConnACG "Status of DFC / Status of diagnostic fault check DFC_AltIODConnACG" UBYTE DFC_OneToOne 1 100 0.00 255.0 FORMAT "%5.1" ECU_ADDRESS 0x60036EC2 /end MEASUREMENT
/begin MEASUREMENT DFC_st.DFC_BGOELWAF "Status of DFC / Status of diagnostic fault check DFC_BGOELWAF" UBYTE DFC_OneToOne 1 100 0.00 255.0 FORMAT "%5.1" ECU_ADDRESS 0x60036EC3 /end MEASUREMENT
/begin MEASUREMENT DFC_st.DFC_BattUHiFailr "Status of DFC / Status of diagnostic fault check DFC_BattUHiFailr" UBYTE DFC_OneToOne 1 100 0.00 255.0 FORMAT "%5.1" ECU_ADDRESS 0x60036EC4 /end MEASUREMENT
/begin MEASUREMENT DFC_st.DFC_BattULoFailr "Status of DFC / Status of diagnostic fault check DFC_BattULoFailr" UBYTE DFC_OneToOne 1 100 0.00 255.0 FORMAT "%5.1" ECU_ADDRESS 0x60036EC5 /end MEASUREMENT
/begin MEASUREMENT DFC_st.DFC_BrkBstPDriftHiErr "Status of DFC / Status of diagnostic fault check DFC_BrkBstPDriftHiErr" UBYTE DFC_OneToOne 1 100 0.00 255.0 FORMAT "%5.1" ECU_ADDRESS 0x60036EC6 /end MEASUREMENT
/begin MEASUREMENT DFC_st.DFC_BrkBstPDriftLoErr "Status of DFC / Status of diagnostic fault check DFC_BrkBstPDriftLoErr" UBYTE DFC_OneToOne 1 100 0.00 255.0 FORMAT "%5.1" ECU_ADDRESS 0x60036EC7 /end MEASUREMENT
/begin MEASUREMENT DFC_st.DFC_BrkBstPSnsrStuck "Status of DFC / Status of diagnostic fault check DFC_BrkBstPSnsrStuck" UBYTE DFC_OneToOne 1 100 0.00 255.0 FORMAT "%5.1" ECU_ADDRESS 0x60036EC8 /end MEASUREMENT
/begin MEASUREMENT DFC_st.DFC_BrkMnSwtContOn "Status of DFC / Status of diagnostic fault check DFC_BrkMnSwtContOn" UBYTE DFC_OneToOne 1 100 0.00 255.0 FORMAT "%5.1" ECU_ADDRESS 0x60036EC9 /end MEASUREMENT
/begin MEASUREMENT DFC_st.DFC_BrkMnSwtNotStp "Status of DFC / Status of diagnostic fault check DFC_BrkMnSwtNotStp" UBYTE DFC_OneToOne 1 100 0.00 255.0 FORMAT "%5.1" ECU_ADDRESS 0x60036ECA /end MEASUREMENT
/begin MEASUREMENT DFC_st.DFC_BrkNpl "Status of DFC / Status of diagnostic fault check DFC_BrkNpl" UBYTE DFC_OneToOne 1 100 0.00 255.0 FORMAT "%5.1" ECU_ADDRESS 0x60036ECB /end MEASUREMENT
/begin MEASUREMENT DFC_st.DFC_BrkRdntSwtContOn "Status of DFC / Status of diagnostic fault check DFC_BrkRdntSwtContOn" UBYTE DFC_OneToOne 1 100 0.00 255.0 FORMAT "%5.1" ECU_ADDRESS 0x60036ECC /end MEASUREMENT
/begin MEASUREMENT DFC_st.DFC_BrkRdntSwtNotStp "Status of DFC / Status of diagnostic fault check DFC_BrkRdntSwtNotStp" UBYTE DFC_OneToOne 1 100 0.00 255.0 FORMAT "%5.1" ECU_ADDRESS 0x60036ECD /end MEASUREMENT
/begin MEASUREMENT DFC_st.DFC_Clth3ONStuck "Status of DFC / Status of diagnostic fault check DFC_Clth3ONStuck" UBYTE DFC_OneToOne 1 100 0.00 255.0 FORMAT "%5.1" ECU_ADDRESS 0x60036ECE /end MEASUREMENT
/begin MEASUREMENT DFC_st.DFC_Clth4OFFStuck "Status of DFC / Status of diagnostic fault check DFC_Clth4OFFStuck" UBYTE DFC_OneToOne 1 100 0.00 255.0 FORMAT "%5.1" ECU_ADDRESS 0x60036ECF /end MEASUREMENT
/begin MEASUREMENT DFC_st.DFC_ClthOFFStuck "Status of DFC / Status of diagnostic fault check DFC_ClthOFFStuck" UBYTE DFC_OneToOne 1 100 0.00 255.0 FORMAT "%5.1" ECU_ADDRESS 0x60036ED0 /end MEASUREMENT
/begin MEASUREMENT DFC_st.DFC_ClthONStuck "Status of DFC / Status of diagnostic fault check DFC_ClthONStuck" UBYTE DFC_OneToOne 1 100 0.00 255.0 FORMAT "%5.1" ECU_ADDRESS 0x60036ED1 /end MEASUREMENT
/begin MEASUREMENT DFC_st.DFC_ClthStkFailInfo "Status of DFC / Status of diagnostic fault check DFC_ClthStkFailInfo" UBYTE DFC_OneToOne 1 100 0.00 255.0 FORMAT "%5.1" ECU_ADDRESS 0x60036ED2 /end MEASUREMENT
/begin MEASUREMENT DFC_st.DFC_ComACFailInfo "Status of DFC / Status of diagnostic fault check DFC_ComACFailInfo" UBYTE DFC_OneToOne 1 100 0.00 255.0 FORMAT "%5.1" ECU_ADDRESS 0x60036ED3 /end MEASUREMENT
/begin MEASUREMENT DFC_st.DFC_ComATFTValErr "Status of DFC / Status of diagnostic fault check DFC_ComATFTValErr" UBYTE DFC_OneToOne 1 100 0.00 255.0 FORMAT "%5.1" ECU_ADDRESS 0x60036ED4 /end MEASUREMENT
/begin MEASUREMENT DFC_st.DFC_ComATMILReq "Status of DFC / Status of diagnostic fault check DFC_ComATMILReq" UBYTE DFC_OneToOne 1 100 0.00 255.0 FORMAT "%5.1" ECU_ADDRESS 0x60036ED5 /end MEASUREMENT
/begin MEASUREMENT DFC_st.DFC_ComAYCAChksum "Status of DFC / Status of diagnostic fault check DFC_ComAYCAChksum" UBYTE DFC_OneToOne 1 100 0.00 255.0 FORMAT "%5.1" ECU_ADDRESS 0x60036ED6 /end MEASUREMENT
/begin MEASUREMENT DFC_st.DFC_ComAYCARingCnt "Status of DFC / Status of diagnostic fault check DFC_ComAYCARingCnt" UBYTE DFC_OneToOne 1 100 0.00 255.0 FORMAT "%5.1" ECU_ADDRESS 0x60036ED7 /end MEASUREMENT
/begin MEASUREMENT DFC_st.DFC_ComAYCATOut "Status of DFC / Status of diagnostic fault check DFC_ComAYCATOut" UBYTE DFC_OneToOne 1 100 0.00 255.0 FORMAT "%5.1" ECU_ADDRESS 0x60036ED8 /end MEASUREMENT
/begin MEASUREMENT DFC_st.DFC_ComAYCDChkSum "Status of DFC / Status of diagnostic fault check DFC_ComAYCDChkSum" UBYTE DFC_OneToOne 1 100 0.00 255.0 FORMAT "%5.1" ECU_ADDRESS 0x60036ED9 /end MEASUREMENT
/begin MEASUREMENT DFC_st.DFC_ComAYCDTOut "Status of DFC / Status of diagnostic fault check DFC_ComAYCDTOut" UBYTE DFC_OneToOne 1 100 0.00 255.0 FORMAT "%5.1" ECU_ADDRESS 0x60036EDA /end MEASUREMENT
/begin MEASUREMENT DFC_st.DFC_ComAYCFChksum "Status of DFC / Status of diagnostic fault check DFC_ComAYCFChksum" UBYTE DFC_OneToOne 1 100 0.00 255.0 FORMAT "%5.1" ECU_ADDRESS 0x60036EDB /end MEASUREMENT
/begin MEASUREMENT DFC_st.DFC_ComAYCFRingCnt "Status of DFC / Status of diagnostic fault check DFC_ComAYCFRingCnt" UBYTE DFC_OneToOne 1 100 0.00 255.0 FORMAT "%5.1" ECU_ADDRESS 0x60036EDC /end MEASUREMENT
/begin MEASUREMENT DFC_st.DFC_ComAYCFTOut "Status of DFC / Status of diagnostic fault check DFC_ComAYCFTOut" UBYTE DFC_OneToOne 1 100 0.00 255.0 FORMAT "%5.1" ECU_ADDRESS 0x60036EDD /end MEASUREMENT
/begin MEASUREMENT DFC_st.DFC_ComAYCGChksum "Status of DFC / Status of diagnostic fault check DFC_ComAYCGChksum" UBYTE DFC_OneToOne 1 100 0.00 255.0 FORMAT "%5.1" ECU_ADDRESS 0x60036EDE /end MEASUREMENT
/begin MEASUREMENT DFC_st.DFC_ComAYCGRingCnt "Status of DFC / Status of diagnostic fault check DFC_ComAYCGRingCnt" UBYTE DFC_OneToOne 1 100 0.00 255.0 FORMAT "%5.1" ECU_ADDRESS 0x60036EDF /end MEASUREMENT
/begin MEASUREMENT DFC_st.DFC_ComAYCGTOut "Status of DFC / Status of diagnostic fault check DFC_ComAYCGTOut" UBYTE DFC_OneToOne 1 100 0.00 255.0 FORMAT "%5.1" ECU_ADDRESS 0x60036EE0 /end MEASUREMENT
/begin MEASUREMENT DFC_st.DFC_ComAYCIChkSum "Status of DFC / Status of diagnostic fault check DFC_ComAYCIChkSum" UBYTE DFC_OneToOne 1 100 0.00 255.0 FORMAT "%5.1" ECU_ADDRESS 0x60036EE1 /end MEASUREMENT
/begin MEASUREMENT DFC_st.DFC_ComAYCIRingCnt "Status of DFC / Status of diagnostic fault check DFC_ComAYCIRingCnt" UBYTE DFC_OneToOne 1 100 0.00 255.0 FORMAT "%5.1" ECU_ADDRESS 0x60036EE2 /end MEASUREMENT
/begin MEASUREMENT DFC_st.DFC_ComAYCITOut "Status of DFC / Status of diagnostic fault check DFC_ComAYCITOut" UBYTE DFC_OneToOne 1 100 0.00 255.0 FORMAT "%5.1" ECU_ADDRESS 0x60036EE3 /end MEASUREMENT
/begin MEASUREMENT DFC_st.DFC_ComBCM1ChkSum "Status of DFC / Status of diagnostic fault check DFC_ComBCM1ChkSum" UBYTE DFC_OneToOne 1 100 0.00 255.0 FORMAT "%5.1" ECU_ADDRESS 0x60036EE4 /end MEASUREMENT
/begin MEASUREMENT DFC_st.DFC_ComBCM1RingCnt "Status of DFC / Status of diagnostic fault check DFC_ComBCM1RingCnt" UBYTE DFC_OneToOne 1 100 0.00 255.0 FORMAT "%5.1" ECU_ADDRESS 0x60036EE5 /end MEASUREMENT
/begin MEASUREMENT DFC_st.DFC_ComBCM1TOut "Status of DFC / Status of diagnostic fault check DFC_ComBCM1TOut" UBYTE DFC_OneToOne 1 100 0.00 255.0 FORMAT "%5.1" ECU_ADDRESS 0x60036EE6 /end MEASUREMENT
/begin MEASUREMENT DFC_st.DFC_ComCANABusOffErr "Status of DFC / Status of diagnostic fault check DFC_ComCANABusOffErr" UBYTE DFC_OneToOne 1 100 0.00 255.0 FORMAT "%5.1" ECU_ADDRESS 0x60036EE7 /end MEASUREMENT
/begin MEASUREMENT DFC_st.DFC_ComCANBBusOffErr "Status of DFC / Status of diagnostic fault check DFC_ComCANBBusOffErr" UBYTE DFC_OneToOne 1 100 0.00 255.0 FORMAT "%5.1" ECU_ADDRESS 0x60036EE8 /end MEASUREMENT
/begin MEASUREMENT DFC_st.DFC_ComCANCBusOffErr "Status of DFC / Status of diagnostic fault check DFC_ComCANCBusOffErr" UBYTE DFC_OneToOne 1 100 0.00 255.0 FORMAT "%5.1" ECU_ADDRESS 0x60036EE9 /end MEASUREMENT
/begin MEASUREMENT DFC_st.DFC_ComCGW1ChkSum "Status of DFC / Status of diagnostic fault check DFC_ComCGW1ChkSum" UBYTE DFC_OneToOne 1 100 0.00 255.0 FORMAT "%5.1" ECU_ADDRESS 0x60036EEA /end MEASUREMENT
/begin MEASUREMENT DFC_st.DFC_ComCGW1RingCnt "Status of DFC / Status of diagnostic fault check DFC_ComCGW1RingCnt" UBYTE DFC_OneToOne 1 100 0.00 255.0 FORMAT "%5.1" ECU_ADDRESS 0x60036EEB /end MEASUREMENT
/begin MEASUREMENT DFC_st.DFC_ComCGW1TOut "Status of DFC / Status of diagnostic fault check DFC_ComCGW1TOut" UBYTE DFC_OneToOne 1 100 0.00 255.0 FORMAT "%5.1" ECU_ADDRESS 0x60036EEC /end MEASUREMENT
/begin MEASUREMENT DFC_st.DFC_ComConvBoostErr "Status of DFC / Status of diagnostic fault check DFC_ComConvBoostErr" UBYTE DFC_OneToOne 1 100 0.00 255.0 FORMAT "%5.1" ECU_ADDRESS 0x60036EED /end MEASUREMENT
/begin MEASUREMENT DFC_st.DFC_ComConvSlipErr "Status of DFC / Status of diagnostic fault check DFC_ComConvSlipErr" UBYTE DFC_OneToOne 1 100 0.00 255.0 FORMAT "%5.1" ECU_ADDRESS 0x60036EEE /end MEASUREMENT
/begin MEASUREMENT DFC_st.DFC_ComDCDCPrfmncErr "Status of DFC / Status of diagnostic fault check DFC_ComDCDCPrfmncErr" UBYTE DFC_OneToOne 1 100 0.00 255.0 FORMAT "%5.1" ECU_ADDRESS 0x60036EEF /end MEASUREMENT
/begin MEASUREMENT DFC_st.DFC_ComDCDCTempWarn "Status of DFC / Status of diagnostic fault check DFC_ComDCDCTempWarn" UBYTE DFC_OneToOne 1 100 0.00 255.0 FORMAT "%5.1" ECU_ADDRESS 0x60036EF0 /end MEASUREMENT
/begin MEASUREMENT DFC_st.DFC_ComEAT10Chksum "Status of DFC / Status of diagnostic fault check DFC_ComEAT10Chksum" UBYTE DFC_OneToOne 1 100 0.00 255.0 FORMAT "%5.1" ECU_ADDRESS 0x60036EF1 /end MEASUREMENT
/begin MEASUREMENT DFC_st.DFC_ComEAT10RingCnt "Status of DFC / Status of diagnostic fault check DFC_ComEAT10RingCnt" UBYTE DFC_OneToOne 1 100 0.00 255.0 FORMAT "%5.1" ECU_ADDRESS 0x60036EF2 /end MEASUREMENT
/begin MEASUREMENT DFC_st.DFC_ComEAT10TOut "Status of DFC / Status of diagnostic fault check DFC_ComEAT10TOut" UBYTE DFC_OneToOne 1 100 0.00 255.0 FORMAT "%5.1" ECU_ADDRESS 0x60036EF3 /end MEASUREMENT
/begin MEASUREMENT DFC_st.DFC_ComEAT11ChkSum "Status of DFC / Status of diagnostic fault check DFC_ComEAT11ChkSum" UBYTE DFC_OneToOne 1 100 0.00 255.0 FORMAT "%5.1" ECU_ADDRESS 0x60036EF4 /end MEASUREMENT
/begin MEASUREMENT DFC_st.DFC_ComEAT11RingCnt "Status of DFC / Status of diagnostic fault check DFC_ComEAT11RingCnt" UBYTE DFC_OneToOne 1 100 0.00 255.0 FORMAT "%5.1" ECU_ADDRESS 0x60036EF5 /end MEASUREMENT
/begin MEASUREMENT DFC_st.DFC_ComEAT11TOut "Status of DFC / Status of diagnostic fault check DFC_ComEAT11TOut" UBYTE DFC_OneToOne 1 100 0.00 255.0 FORMAT "%5.1" ECU_ADDRESS 0x60036EF6 /end MEASUREMENT
/begin MEASUREMENT DFC_st.DFC_ComEAT12ChkSum "Status of DFC / Status of diagnostic fault check DFC_ComEAT12ChkSum" UBYTE DFC_OneToOne 1 100 0.00 255.0 FORMAT "%5.1" ECU_ADDRESS 0x60036EF7 /end MEASUREMENT
/begin MEASUREMENT DFC_st.DFC_ComEAT12RingCnt "Status of DFC / Status of diagnostic fault check DFC_ComEAT12RingCnt" UBYTE DFC_OneToOne 1 100 0.00 255.0 FORMAT "%5.1" ECU_ADDRESS 0x60036EF8 /end MEASUREMENT
/begin MEASUREMENT DFC_st.DFC_ComEAT12TOut "Status of DFC / Status of diagnostic fault check DFC_ComEAT12TOut" UBYTE DFC_OneToOne 1 100 0.00 255.0 FORMAT "%5.1" ECU_ADDRESS 0x60036EF9 /end MEASUREMENT
/begin MEASUREMENT DFC_st.DFC_ComEAT13ChkSum "Status of DFC / Status of diagnostic fault check DFC_ComEAT13ChkSum" UBYTE DFC_OneToOne 1 100 0.00 255.0 FORMAT "%5.1" ECU_ADDRESS 0x60036EFA /end MEASUREMENT
/begin MEASUREMENT DFC_st.DFC_ComEAT13RingCnt "Status of DFC / Status of diagnostic fault check DFC_ComEAT13RingCnt" UBYTE DFC_OneToOne 1 100 0.00 255.0 FORMAT "%5.1" ECU_ADDRESS 0x60036EFB /end MEASUREMENT
/begin MEASUREMENT DFC_st.DFC_ComEAT13TOut "Status of DFC / Status of diagnostic fault check DFC_ComEAT13TOut" UBYTE DFC_OneToOne 1 100 0.00 255.0 FORMAT "%5.1" ECU_ADDRESS 0x60036EFC /end MEASUREMENT
/begin MEASUREMENT DFC_st.DFC_ComEAT1Chksum "Status of DFC / Status of diagnostic fault check DFC_ComEAT1Chksum" UBYTE DFC_OneToOne 1 100 0.00 255.0 FORMAT "%5.1" ECU_ADDRESS 0x60036EFD /end MEASUREMENT
/begin MEASUREMENT DFC_st.DFC_ComEAT1RingCnt "Status of DFC / Status of diagnostic fault check DFC_ComEAT1RingCnt" UBYTE DFC_OneToOne 1 100 0.00 255.0 FORMAT "%5.1" ECU_ADDRESS 0x60036EFE /end MEASUREMENT
/begin MEASUREMENT DFC_st.DFC_ComEAT1TOut "Status of DFC / Status of diagnostic fault check DFC_ComEAT1TOut" UBYTE DFC_OneToOne 1 100 0.00 255.0 FORMAT "%5.1" ECU_ADDRESS 0x60036EFF /end MEASUREMENT
/begin MEASUREMENT DFC_st.DFC_ComEAT2ChkSum "Status of DFC / Status of diagnostic fault check DFC_ComEAT2ChkSum" UBYTE DFC_OneToOne 1 100 0.00 255.0 FORMAT "%5.1" ECU_ADDRESS 0x60036F00 /end MEASUREMENT
/begin MEASUREMENT DFC_st.DFC_ComEAT2RingCnt "Status of DFC / Status of diagnostic fault check DFC_ComEAT2RingCnt" UBYTE DFC_OneToOne 1 100 0.00 255.0 FORMAT "%5.1" ECU_ADDRESS 0x60036F01 /end MEASUREMENT
/begin MEASUREMENT DFC_st.DFC_ComEAT2TOut "Status of DFC / Status of diagnostic fault check DFC_ComEAT2TOut" UBYTE DFC_OneToOne 1 100 0.00 255.0 FORMAT "%5.1" ECU_ADDRESS 0x60036F02 /end MEASUREMENT
/begin MEASUREMENT DFC_st.DFC_ComEAT4ChkSum "Status of DFC / Status of diagnostic fault check DFC_ComEAT4ChkSum" UBYTE DFC_OneToOne 1 100 0.00 255.0 FORMAT "%5.1" ECU_ADDRESS 0x60036F03 /end MEASUREMENT
/begin MEASUREMENT DFC_st.DFC_ComEAT4RingCnt "Status of DFC / Status of diagnostic fault check DFC_ComEAT4RingCnt" UBYTE DFC_OneToOne 1 100 0.00 255.0 FORMAT "%5.1" ECU_ADDRESS 0x60036F04 /end MEASUREMENT
/begin MEASUREMENT DFC_st.DFC_ComEAT4TOut "Status of DFC / Status of diagnostic fault check DFC_ComEAT4TOut" UBYTE DFC_OneToOne 1 100 0.00 255.0 FORMAT "%5.1" ECU_ADDRESS 0x60036F05 /end MEASUREMENT
/begin MEASUREMENT DFC_st.DFC_ComEAT6Chksum "Status of DFC / Status of diagnostic fault check DFC_ComEAT6Chksum" UBYTE DFC_OneToOne 1 100 0.00 255.0 FORMAT "%5.1" ECU_ADDRESS 0x60036F06 /end MEASUREMENT
/begin MEASUREMENT DFC_st.DFC_ComEAT6RingCnt "Status of DFC / Status of diagnostic fault check DFC_ComEAT6RingCnt" UBYTE DFC_OneToOne 1 100 0.00 255.0 FORMAT "%5.1" ECU_ADDRESS 0x60036F07 /end MEASUREMENT
/begin MEASUREMENT DFC_st.DFC_ComEAT6TOut "Status of DFC / Status of diagnostic fault check DFC_ComEAT6TOut" UBYTE DFC_OneToOne 1 100 0.00 255.0 FORMAT "%5.1" ECU_ADDRESS 0x60036F08 /end MEASUREMENT
/begin MEASUREMENT DFC_st.DFC_ComEAT7Chksum "Status of DFC / Status of diagnostic fault check DFC_ComEAT7Chksum" UBYTE DFC_OneToOne 1 100 0.00 255.0 FORMAT "%5.1" ECU_ADDRESS 0x60036F09 /end MEASUREMENT
/begin MEASUREMENT DFC_st.DFC_ComEAT7RingCnt "Status of DFC / Status of diagnostic fault check DFC_ComEAT7RingCnt" UBYTE DFC_OneToOne 1 100 0.00 255.0 FORMAT "%5.1" ECU_ADDRESS 0x60036F0A /end MEASUREMENT
/begin MEASUREMENT DFC_st.DFC_ComEAT7TOut "Status of DFC / Status of diagnostic fault check DFC_ComEAT7TOut" UBYTE DFC_OneToOne 1 100 0.00 255.0 FORMAT "%5.1" ECU_ADDRESS 0x60036F0B /end MEASUREMENT
/begin MEASUREMENT DFC_st.DFC_ComEAT8Chksum "Status of DFC / Status of diagnostic fault check DFC_ComEAT8Chksum" UBYTE DFC_OneToOne 1 100 0.00 255.0 FORMAT "%5.1" ECU_ADDRESS 0x60036F0C /end MEASUREMENT
/begin MEASUREMENT DFC_st.DFC_ComEAT8RingCnt "Status of DFC / Status of diagnostic fault check DFC_ComEAT8RingCnt" UBYTE DFC_OneToOne 1 100 0.00 255.0 FORMAT "%5.1" ECU_ADDRESS 0x60036F0D /end MEASUREMENT
/begin MEASUREMENT DFC_st.DFC_ComEAT8TOut "Status of DFC / Status of diagnostic fault check DFC_ComEAT8TOut" UBYTE DFC_OneToOne 1 100 0.00 255.0 FORMAT "%5.1" ECU_ADDRESS 0x60036F0E /end MEASUREMENT
/begin MEASUREMENT DFC_st.DFC_ComEATAChksum "Status of DFC / Status of diagnostic fault check DFC_ComEATAChksum" UBYTE DFC_OneToOne 1 100 0.00 255.0 FORMAT "%5.1" ECU_ADDRESS 0x60036F0F /end MEASUREMENT
/begin MEASUREMENT DFC_st.DFC_ComEATARingCnt "Status of DFC / Status of diagnostic fault check DFC_ComEATARingCnt" UBYTE DFC_OneToOne 1 100 0.00 255.0 FORMAT "%5.1" ECU_ADDRESS 0x60036F10 /end MEASUREMENT
/begin MEASUREMENT DFC_st.DFC_ComEATATOut "Status of DFC / Status of diagnostic fault check DFC_ComEATATOut" UBYTE DFC_OneToOne 1 100 0.00 255.0 FORMAT "%5.1" ECU_ADDRESS 0x60036F11 /end MEASUREMENT
/begin MEASUREMENT DFC_st.DFC_ComEATBChkSum "Status of DFC / Status of diagnostic fault check DFC_ComEATBChkSum" UBYTE DFC_OneToOne 1 100 0.00 255.0 FORMAT "%5.1" ECU_ADDRESS 0x60036F12 /end MEASUREMENT
/begin MEASUREMENT DFC_st.DFC_ComEATBRingCnt "Status of DFC / Status of diagnostic fault check DFC_ComEATBRingCnt" UBYTE DFC_OneToOne 1 100 0.00 255.0 FORMAT "%5.1" ECU_ADDRESS 0x60036F13 /end MEASUREMENT
/begin MEASUREMENT DFC_st.DFC_ComEATBTOut "Status of DFC / Status of diagnostic fault check DFC_ComEATBTOut" UBYTE DFC_OneToOne 1 100 0.00 255.0 FORMAT "%5.1" ECU_ADDRESS 0x60036F14 /end MEASUREMENT
/begin MEASUREMENT DFC_st.DFC_ComEATCChksum "Status of DFC / Status of diagnostic fault check DFC_ComEATCChksum" UBYTE DFC_OneToOne 1 100 0.00 255.0 FORMAT "%5.1" ECU_ADDRESS 0x60036F15 /end MEASUREMENT
/begin MEASUREMENT DFC_st.DFC_ComEATCRingCnt "Status of DFC / Status of diagnostic fault check DFC_ComEATCRingCnt" UBYTE DFC_OneToOne 1 100 0.00 255.0 FORMAT "%5.1" ECU_ADDRESS 0x60036F16 /end MEASUREMENT
/begin MEASUREMENT DFC_st.DFC_ComEATCTOut "Status of DFC / Status of diagnostic fault check DFC_ComEATCTOut" UBYTE DFC_OneToOne 1 100 0.00 255.0 FORMAT "%5.1" ECU_ADDRESS 0x60036F17 /end MEASUREMENT
/begin MEASUREMENT DFC_st.DFC_ComEPBBChkSum "Status of DFC / Status of diagnostic fault check DFC_ComEPBBChkSum" UBYTE DFC_OneToOne 1 100 0.00 255.0 FORMAT "%5.1" ECU_ADDRESS 0x60036F18 /end MEASUREMENT
/begin MEASUREMENT DFC_st.DFC_ComEPBBRingCnt "Status of DFC / Status of diagnostic fault check DFC_ComEPBBRingCnt" UBYTE DFC_OneToOne 1 100 0.00 255.0 FORMAT "%5.1" ECU_ADDRESS 0x60036F19 /end MEASUREMENT
/begin MEASUREMENT DFC_st.DFC_ComEPBBTOut "Status of DFC / Status of diagnostic fault check DFC_ComEPBBTOut" UBYTE DFC_OneToOne 1 100 0.00 255.0 FORMAT "%5.1" ECU_ADDRESS 0x60036F1A /end MEASUREMENT
/begin MEASUREMENT DFC_st.DFC_ComEPBChksum "Status of DFC / Status of diagnostic fault check DFC_ComEPBChksum" UBYTE DFC_OneToOne 1 100 0.00 255.0 FORMAT "%5.1" ECU_ADDRESS 0x60036F1B /end MEASUREMENT
/begin MEASUREMENT DFC_st.DFC_ComEPBTOut "Status of DFC / Status of diagnostic fault check DFC_ComEPBTOut" UBYTE DFC_OneToOne 1 100 0.00 255.0 FORMAT "%5.1" ECU_ADDRESS 0x60036F1C /end MEASUREMENT
/begin MEASUREMENT DFC_st.DFC_ComEPBctRing "Status of DFC / Status of diagnostic fault check DFC_ComEPBctRing" UBYTE DFC_OneToOne 1 100 0.00 255.0 FORMAT "%5.1" ECU_ADDRESS 0x60036F1D /end MEASUREMENT
/begin MEASUREMENT DFC_st.DFC_ComEPS1Chksum "Status of DFC / Status of diagnostic fault check DFC_ComEPS1Chksum" UBYTE DFC_OneToOne 1 100 0.00 255.0 FORMAT "%5.1" ECU_ADDRESS 0x60036F1E /end MEASUREMENT
/begin MEASUREMENT DFC_st.DFC_ComEPS1RingCnt "Status of DFC / Status of diagnostic fault check DFC_ComEPS1RingCnt" UBYTE DFC_OneToOne 1 100 0.00 255.0 FORMAT "%5.1" ECU_ADDRESS 0x60036F1F /end MEASUREMENT
/begin MEASUREMENT DFC_st.DFC_ComEPS1TOut "Status of DFC / Status of diagnostic fault check DFC_ComEPS1TOut" UBYTE DFC_OneToOne 1 100 0.00 255.0 FORMAT "%5.1" ECU_ADDRESS 0x60036F20 /end MEASUREMENT
/begin MEASUREMENT DFC_st.DFC_ComEngCanRxErr "Status of DFC / Status of diagnostic fault check DFC_ComEngCanRxErr" UBYTE DFC_OneToOne 1 100 0.00 255.0 FORMAT "%5.1" ECU_ADDRESS 0x60036F21 /end MEASUREMENT
/begin MEASUREMENT DFC_st.DFC_ComGrvySnsrErr "Status of DFC / Status of diagnostic fault check DFC_ComGrvySnsrErr" UBYTE DFC_OneToOne 1 100 0.00 255.0 FORMAT "%5.1" ECU_ADDRESS 0x60036F22 /end MEASUREMENT
/begin MEASUREMENT DFC_st.DFC_ComGwIMG1ChkSum "Status of DFC / Status of diagnostic fault check DFC_ComGwIMG1ChkSum" UBYTE DFC_OneToOne 1 100 0.00 255.0 FORMAT "%5.1" ECU_ADDRESS 0x60036F23 /end MEASUREMENT
/begin MEASUREMENT DFC_st.DFC_ComGwIMG1RingCnt "Status of DFC / Status of diagnostic fault check DFC_ComGwIMG1RingCnt" UBYTE DFC_OneToOne 1 100 0.00 255.0 FORMAT "%5.1" ECU_ADDRESS 0x60036F24 /end MEASUREMENT
/begin MEASUREMENT DFC_st.DFC_ComGwIMG1TOut "Status of DFC / Status of diagnostic fault check DFC_ComGwIMG1TOut" UBYTE DFC_OneToOne 1 100 0.00 255.0 FORMAT "%5.1" ECU_ADDRESS 0x60036F25 /end MEASUREMENT
/begin MEASUREMENT DFC_st.DFC_ComGwIMG3ChkSum "Status of DFC / Status of diagnostic fault check DFC_ComGwIMG3ChkSum" UBYTE DFC_OneToOne 1 100 0.00 255.0 FORMAT "%5.1" ECU_ADDRESS 0x60036F26 /end MEASUREMENT
/begin MEASUREMENT DFC_st.DFC_ComGwIMG3RingCnt "Status of DFC / Status of diagnostic fault check DFC_ComGwIMG3RingCnt" UBYTE DFC_OneToOne 1 100 0.00 255.0 FORMAT "%5.1" ECU_ADDRESS 0x60036F27 /end MEASUREMENT
/begin MEASUREMENT DFC_st.DFC_ComGwIMG3TOut "Status of DFC / Status of diagnostic fault check DFC_ComGwIMG3TOut" UBYTE DFC_OneToOne 1 100 0.00 255.0 FORMAT "%5.1" ECU_ADDRESS 0x60036F28 /end MEASUREMENT
/begin MEASUREMENT DFC_st.DFC_ComGwIMG4ChkSum "Status of DFC / Status of diagnostic fault check DFC_ComGwIMG4ChkSum" UBYTE DFC_OneToOne 1 100 0.00 255.0 FORMAT "%5.1" ECU_ADDRESS 0x60036F29 /end MEASUREMENT
/begin MEASUREMENT DFC_st.DFC_ComGwIMG4RingCnt "Status of DFC / Status of diagnostic fault check DFC_ComGwIMG4RingCnt" UBYTE DFC_OneToOne 1 100 0.00 255.0 FORMAT "%5.1" ECU_ADDRESS 0x60036F2A /end MEASUREMENT
/begin MEASUREMENT DFC_st.DFC_ComGwIMG4TOut "Status of DFC / Status of diagnostic fault check DFC_ComGwIMG4TOut" UBYTE DFC_OneToOne 1 100 0.00 255.0 FORMAT "%5.1" ECU_ADDRESS 0x60036F2B /end MEASUREMENT
/begin MEASUREMENT DFC_st.DFC_ComGwIMG5ChkSum "Status of DFC / Status of diagnostic fault check DFC_ComGwIMG5ChkSum" UBYTE DFC_OneToOne 1 100 0.00 255.0 FORMAT "%5.1" ECU_ADDRESS 0x60036F2C /end MEASUREMENT
/begin MEASUREMENT DFC_st.DFC_ComGwIMG5RingCnt "Status of DFC / Status of diagnostic fault check DFC_ComGwIMG5RingCnt" UBYTE DFC_OneToOne 1 100 0.00 255.0 FORMAT "%5.1" ECU_ADDRESS 0x60036F2D /end MEASUREMENT
/begin MEASUREMENT DFC_st.DFC_ComGwIMG5TOut "Status of DFC / Status of diagnostic fault check DFC_ComGwIMG5TOut" UBYTE DFC_OneToOne 1 100 0.00 255.0 FORMAT "%5.1" ECU_ADDRESS 0x60036F2E /end MEASUREMENT
/begin MEASUREMENT DFC_st.DFC_ComGwIMG6ChkSum "Status of DFC / Status of diagnostic fault check DFC_ComGwIMG6ChkSum" UBYTE DFC_OneToOne 1 100 0.00 255.0 FORMAT "%5.1" ECU_ADDRESS 0x60036F2F /end MEASUREMENT
/begin MEASUREMENT DFC_st.DFC_ComGwIMG6RingCnt "Status of DFC / Status of diagnostic fault check DFC_ComGwIMG6RingCnt" UBYTE DFC_OneToOne 1 100 0.00 255.0 FORMAT "%5.1" ECU_ADDRESS 0x60036F30 /end MEASUREMENT
/begin MEASUREMENT DFC_st.DFC_ComGwIMG6TOut "Status of DFC / Status of diagnostic fault check DFC_ComGwIMG6TOut" UBYTE DFC_OneToOne 1 100 0.00 255.0 FORMAT "%5.1" ECU_ADDRESS 0x60036F31 /end MEASUREMENT
/begin MEASUREMENT DFC_st.DFC_ComIDASBChksum "Status of DFC / Status of diagnostic fault check DFC_ComIDASBChksum" UBYTE DFC_OneToOne 1 100 0.00 255.0 FORMAT "%5.1" ECU_ADDRESS 0x60036F32 /end MEASUREMENT
/begin MEASUREMENT DFC_st.DFC_ComIDASBRingCnt "Status of DFC / Status of diagnostic fault check DFC_ComIDASBRingCnt" UBYTE DFC_OneToOne 1 100 0.00 255.0 FORMAT "%5.1" ECU_ADDRESS 0x60036F33 /end MEASUREMENT
/begin MEASUREMENT DFC_st.DFC_ComIDASBTOut "Status of DFC / Status of diagnostic fault check DFC_ComIDASBTOut" UBYTE DFC_OneToOne 1 100 0.00 255.0 FORMAT "%5.1" ECU_ADDRESS 0x60036F34 /end MEASUREMENT
/begin MEASUREMENT DFC_st.DFC_ComIMGMILReq "Status of DFC / Status of diagnostic fault check DFC_ComIMGMILReq" UBYTE DFC_OneToOne 1 100 0.00 255.0 FORMAT "%5.1" ECU_ADDRESS 0x60036F35 /end MEASUREMENT
/begin MEASUREMENT DFC_st.DFC_ComISSPrms "Status of DFC / Status of diagnostic fault check DFC_ComISSPrms" UBYTE DFC_OneToOne 1 100 0.00 255.0 FORMAT "%5.1" ECU_ADDRESS 0x60036F36 /end MEASUREMENT
/begin MEASUREMENT DFC_st.DFC_ComMETAChksum "Status of DFC / Status of diagnostic fault check DFC_ComMETAChksum" UBYTE DFC_OneToOne 1 100 0.00 255.0 FORMAT "%5.1" ECU_ADDRESS 0x60036F37 /end MEASUREMENT
/begin MEASUREMENT DFC_st.DFC_ComMETAChksumPstDrv "Status of DFC / Status of diagnostic fault check DFC_ComMETAChksumPstDrv" UBYTE DFC_OneToOne 1 100 0.00 255.0 FORMAT "%5.1" ECU_ADDRESS 0x60036F38 /end MEASUREMENT
/begin MEASUREMENT DFC_st.DFC_ComMETARingCnt "Status of DFC / Status of diagnostic fault check DFC_ComMETARingCnt" UBYTE DFC_OneToOne 1 100 0.00 255.0 FORMAT "%5.1" ECU_ADDRESS 0x60036F39 /end MEASUREMENT
/begin MEASUREMENT DFC_st.DFC_ComMETARingCntPstDrv "Status of DFC / Status of diagnostic fault check DFC_ComMETARingCntPstDrv" UBYTE DFC_OneToOne 1 100 0.00 255.0 FORMAT "%5.1" ECU_ADDRESS 0x60036F3A /end MEASUREMENT
/begin MEASUREMENT DFC_st.DFC_ComMETATOut "Status of DFC / Status of diagnostic fault check DFC_ComMETATOut" UBYTE DFC_OneToOne 1 100 0.00 255.0 FORMAT "%5.1" ECU_ADDRESS 0x60036F3B /end MEASUREMENT
/begin MEASUREMENT DFC_st.DFC_ComMETATOutPstDrv "Status of DFC / Status of diagnostic fault check DFC_ComMETATOutPstDrv" UBYTE DFC_OneToOne 1 100 0.00 255.0 FORMAT "%5.1" ECU_ADDRESS 0x60036F3C /end MEASUREMENT
/begin MEASUREMENT DFC_st.DFC_ComMETCChksum "Status of DFC / Status of diagnostic fault check DFC_ComMETCChksum" UBYTE DFC_OneToOne 1 100 0.00 255.0 FORMAT "%5.1" ECU_ADDRESS 0x60036F3D /end MEASUREMENT
/begin MEASUREMENT DFC_st.DFC_ComMETCRingCnt "Status of DFC / Status of diagnostic fault check DFC_ComMETCRingCnt" UBYTE DFC_OneToOne 1 100 0.00 255.0 FORMAT "%5.1" ECU_ADDRESS 0x60036F3E /end MEASUREMENT
/begin MEASUREMENT DFC_st.DFC_ComMETCTOut "Status of DFC / Status of diagnostic fault check DFC_ComMETCTOut" UBYTE DFC_OneToOne 1 100 0.00 255.0 FORMAT "%5.1" ECU_ADDRESS 0x60036F3F /end MEASUREMENT
/begin MEASUREMENT DFC_st.DFC_ComMETDChksum "Status of DFC / Status of diagnostic fault check DFC_ComMETDChksum" UBYTE DFC_OneToOne 1 100 0.00 255.0 FORMAT "%5.1" ECU_ADDRESS 0x60036F40 /end MEASUREMENT
/begin MEASUREMENT DFC_st.DFC_ComMETDRingCnt "Status of DFC / Status of diagnostic fault check DFC_ComMETDRingCnt" UBYTE DFC_OneToOne 1 100 0.00 255.0 FORMAT "%5.1" ECU_ADDRESS 0x60036F41 /end MEASUREMENT
/begin MEASUREMENT DFC_st.DFC_ComMETDTOut "Status of DFC / Status of diagnostic fault check DFC_ComMETDTOut" UBYTE DFC_OneToOne 1 100 0.00 255.0 FORMAT "%5.1" ECU_ADDRESS 0x60036F42 /end MEASUREMENT
/begin MEASUREMENT DFC_st.DFC_ComMETE2Chksum "Status of DFC / Status of diagnostic fault check DFC_ComMETE2Chksum" UBYTE DFC_OneToOne 1 100 0.00 255.0 FORMAT "%5.1" ECU_ADDRESS 0x60036F43 /end MEASUREMENT
/begin MEASUREMENT DFC_st.DFC_ComMETE2RingCnt "Status of DFC / Status of diagnostic fault check DFC_ComMETE2RingCnt" UBYTE DFC_OneToOne 1 100 0.00 255.0 FORMAT "%5.1" ECU_ADDRESS 0x60036F44 /end MEASUREMENT
/begin MEASUREMENT DFC_st.DFC_ComMETE2TOut "Status of DFC / Status of diagnostic fault check DFC_ComMETE2TOut" UBYTE DFC_OneToOne 1 100 0.00 255.0 FORMAT "%5.1" ECU_ADDRESS 0x60036F45 /end MEASUREMENT
/begin MEASUREMENT DFC_st.DFC_ComMETFChksum "Status of DFC / Status of diagnostic fault check DFC_ComMETFChksum" UBYTE DFC_OneToOne 1 100 0.00 255.0 FORMAT "%5.1" ECU_ADDRESS 0x60036F46 /end MEASUREMENT
/begin MEASUREMENT DFC_st.DFC_ComMETFRingCnt "Status of DFC / Status of diagnostic fault check DFC_ComMETFRingCnt" UBYTE DFC_OneToOne 1 100 0.00 255.0 FORMAT "%5.1" ECU_ADDRESS 0x60036F47 /end MEASUREMENT
/begin MEASUREMENT DFC_st.DFC_ComMETFTOut "Status of DFC / Status of diagnostic fault check DFC_ComMETFTOut" UBYTE DFC_OneToOne 1 100 0.00 255.0 FORMAT "%5.1" ECU_ADDRESS 0x60036F48 /end MEASUREMENT
/begin MEASUREMENT DFC_st.DFC_ComMETGChksum "Status of DFC / Status of diagnostic fault check DFC_ComMETGChksum" UBYTE DFC_OneToOne 1 100 0.00 255.0 FORMAT "%5.1" ECU_ADDRESS 0x60036F49 /end MEASUREMENT
/begin MEASUREMENT DFC_st.DFC_ComMETGRingCnt "Status of DFC / Status of diagnostic fault check DFC_ComMETGRingCnt" UBYTE DFC_OneToOne 1 100 0.00 255.0 FORMAT "%5.1" ECU_ADDRESS 0x60036F4A /end MEASUREMENT
/begin MEASUREMENT DFC_st.DFC_ComMETGTOut "Status of DFC / Status of diagnostic fault check DFC_ComMETGTOut" UBYTE DFC_OneToOne 1 100 0.00 255.0 FORMAT "%5.1" ECU_ADDRESS 0x60036F4B /end MEASUREMENT
/begin MEASUREMENT DFC_st.DFC_ComMETH2Chksum "Status of DFC / Status of diagnostic fault check DFC_ComMETH2Chksum" UBYTE DFC_OneToOne 1 100 0.00 255.0 FORMAT "%5.1" ECU_ADDRESS 0x60036F4C /end MEASUREMENT
/begin MEASUREMENT DFC_st.DFC_ComMETH2RingCnt "Status of DFC / Status of diagnostic fault check DFC_ComMETH2RingCnt" UBYTE DFC_OneToOne 1 100 0.00 255.0 FORMAT "%5.1" ECU_ADDRESS 0x60036F4D /end MEASUREMENT
/begin MEASUREMENT DFC_st.DFC_ComMETH2TOut "Status of DFC / Status of diagnostic fault check DFC_ComMETH2TOut" UBYTE DFC_OneToOne 1 100 0.00 255.0 FORMAT "%5.1" ECU_ADDRESS 0x60036F4E /end MEASUREMENT
/begin MEASUREMENT DFC_st.DFC_ComMETHChksum "Status of DFC / Status of diagnostic fault check DFC_ComMETHChksum" UBYTE DFC_OneToOne 1 100 0.00 255.0 FORMAT "%5.1" ECU_ADDRESS 0x60036F4F /end MEASUREMENT
/begin MEASUREMENT DFC_st.DFC_ComMETHRingCnt "Status of DFC / Status of diagnostic fault check DFC_ComMETHRingCnt" UBYTE DFC_OneToOne 1 100 0.00 255.0 FORMAT "%5.1" ECU_ADDRESS 0x60036F50 /end MEASUREMENT
/begin MEASUREMENT DFC_st.DFC_ComMETHTOut "Status of DFC / Status of diagnostic fault check DFC_ComMETHTOut" UBYTE DFC_OneToOne 1 100 0.00 255.0 FORMAT "%5.1" ECU_ADDRESS 0x60036F51 /end MEASUREMENT
/begin MEASUREMENT DFC_st.DFC_ComMETIChksum "Status of DFC / Status of diagnostic fault check DFC_ComMETIChksum" UBYTE DFC_OneToOne 1 100 0.00 255.0 FORMAT "%5.1" ECU_ADDRESS 0x60036F52 /end MEASUREMENT
/begin MEASUREMENT DFC_st.DFC_ComMETIRingCnt "Status of DFC / Status of diagnostic fault check DFC_ComMETIRingCnt" UBYTE DFC_OneToOne 1 100 0.00 255.0 FORMAT "%5.1" ECU_ADDRESS 0x60036F53 /end MEASUREMENT
/begin MEASUREMENT DFC_st.DFC_ComMETITOut "Status of DFC / Status of diagnostic fault check DFC_ComMETITOut" UBYTE DFC_OneToOne 1 100 0.00 255.0 FORMAT "%5.1" ECU_ADDRESS 0x60036F54 /end MEASUREMENT
/begin MEASUREMENT DFC_st.DFC_ComMETKChksum "Status of DFC / Status of diagnostic fault check DFC_ComMETKChksum" UBYTE DFC_OneToOne 1 100 0.00 255.0 FORMAT "%5.1" ECU_ADDRESS 0x60036F55 /end MEASUREMENT
/begin MEASUREMENT DFC_st.DFC_ComMETKRingCnt "Status of DFC / Status of diagnostic fault check DFC_ComMETKRingCnt" UBYTE DFC_OneToOne 1 100 0.00 255.0 FORMAT "%5.1" ECU_ADDRESS 0x60036F56 /end MEASUREMENT
/begin MEASUREMENT DFC_st.DFC_ComMETKTOut "Status of DFC / Status of diagnostic fault check DFC_ComMETKTOut" UBYTE DFC_OneToOne 1 100 0.00 255.0 FORMAT "%5.1" ECU_ADDRESS 0x60036F57 /end MEASUREMENT
/begin MEASUREMENT DFC_st.DFC_ComMETLChksum "Status of DFC / Status of diagnostic fault check DFC_ComMETLChksum" UBYTE DFC_OneToOne 1 100 0.00 255.0 FORMAT "%5.1" ECU_ADDRESS 0x60036F58 /end MEASUREMENT
/begin MEASUREMENT DFC_st.DFC_ComMETLRingCnt "Status of DFC / Status of diagnostic fault check DFC_ComMETLRingCnt" UBYTE DFC_OneToOne 1 100 0.00 255.0 FORMAT "%5.1" ECU_ADDRESS 0x60036F59 /end MEASUREMENT
/begin MEASUREMENT DFC_st.DFC_ComMETLTOut "Status of DFC / Status of diagnostic fault check DFC_ComMETLTOut" UBYTE DFC_OneToOne 1 100 0.00 255.0 FORMAT "%5.1" ECU_ADDRESS 0x60036F5A /end MEASUREMENT
/begin MEASUREMENT DFC_st.DFC_ComMETMChksum "Status of DFC / Status of diagnostic fault check DFC_ComMETMChksum" UBYTE DFC_OneToOne 1 100 0.00 255.0 FORMAT "%5.1" ECU_ADDRESS 0x60036F5B /end MEASUREMENT
/begin MEASUREMENT DFC_st.DFC_ComMETMRingCnt "Status of DFC / Status of diagnostic fault check DFC_ComMETMRingCnt" UBYTE DFC_OneToOne 1 100 0.00 255.0 FORMAT "%5.1" ECU_ADDRESS 0x60036F5C /end MEASUREMENT
/begin MEASUREMENT DFC_st.DFC_ComMETMTOut "Status of DFC / Status of diagnostic fault check DFC_ComMETMTOut" UBYTE DFC_OneToOne 1 100 0.00 255.0 FORMAT "%5.1" ECU_ADDRESS 0x60036F5D /end MEASUREMENT
/begin MEASUREMENT DFC_st.DFC_ComMETNChksum "Status of DFC / Status of diagnostic fault check DFC_ComMETNChksum" UBYTE DFC_OneToOne 1 100 0.00 255.0 FORMAT "%5.1" ECU_ADDRESS 0x60036F5E /end MEASUREMENT
/begin MEASUREMENT DFC_st.DFC_ComMETNRingCnt "Status of DFC / Status of diagnostic fault check DFC_ComMETNRingCnt" UBYTE DFC_OneToOne 1 100 0.00 255.0 FORMAT "%5.1" ECU_ADDRESS 0x60036F5F /end MEASUREMENT
/begin MEASUREMENT DFC_st.DFC_ComMETNTOut "Status of DFC / Status of diagnostic fault check DFC_ComMETNTOut" UBYTE DFC_OneToOne 1 100 0.00 255.0 FORMAT "%5.1" ECU_ADDRESS 0x60036F60 /end MEASUREMENT
/begin MEASUREMENT DFC_st.DFC_ComMtrCom "Status of DFC / Status of diagnostic fault check DFC_ComMtrCom" UBYTE DFC_OneToOne 1 100 0.00 255.0 FORMAT "%5.1" ECU_ADDRESS 0x60036F61 /end MEASUREMENT
/begin MEASUREMENT DFC_st.DFC_ComPCUChkSum "Status of DFC / Status of diagnostic fault check DFC_ComPCUChkSum" UBYTE DFC_OneToOne 1 100 0.00 255.0 FORMAT "%5.1" ECU_ADDRESS 0x60036F62 /end MEASUREMENT
/begin MEASUREMENT DFC_st.DFC_ComPCURingCnt "Status of DFC / Status of diagnostic fault check DFC_ComPCURingCnt" UBYTE DFC_OneToOne 1 100 0.00 255.0 FORMAT "%5.1" ECU_ADDRESS 0x60036F63 /end MEASUREMENT
/begin MEASUREMENT DFC_st.DFC_ComPCUTOut "Status of DFC / Status of diagnostic fault check DFC_ComPCUTOut" UBYTE DFC_OneToOne 1 100 0.00 255.0 FORMAT "%5.1" ECU_ADDRESS 0x60036F64 /end MEASUREMENT
/begin MEASUREMENT DFC_st.DFC_ComSRSAChksum "Status of DFC / Status of diagnostic fault check DFC_ComSRSAChksum" UBYTE DFC_OneToOne 1 100 0.00 255.0 FORMAT "%5.1" ECU_ADDRESS 0x60036F65 /end MEASUREMENT
/begin MEASUREMENT DFC_st.DFC_ComSRSARingCnt "Status of DFC / Status of diagnostic fault check DFC_ComSRSARingCnt" UBYTE DFC_OneToOne 1 100 0.00 255.0 FORMAT "%5.1" ECU_ADDRESS 0x60036F66 /end MEASUREMENT
/begin MEASUREMENT DFC_st.DFC_ComSRSATOut "Status of DFC / Status of diagnostic fault check DFC_ComSRSATOut" UBYTE DFC_OneToOne 1 100 0.00 255.0 FORMAT "%5.1" ECU_ADDRESS 0x60036F67 /end MEASUREMENT
/begin MEASUREMENT DFC_st.DFC_ComSRSBChksum "Status of DFC / Status of diagnostic fault check DFC_ComSRSBChksum" UBYTE DFC_OneToOne 1 100 0.00 255.0 FORMAT "%5.1" ECU_ADDRESS 0x60036F68 /end MEASUREMENT
/begin MEASUREMENT DFC_st.DFC_ComSRSBRingCnt "Status of DFC / Status of diagnostic fault check DFC_ComSRSBRingCnt" UBYTE DFC_OneToOne 1 100 0.00 255.0 FORMAT "%5.1" ECU_ADDRESS 0x60036F69 /end MEASUREMENT
/begin MEASUREMENT DFC_st.DFC_ComSRSBTOut "Status of DFC / Status of diagnostic fault check DFC_ComSRSBTOut" UBYTE DFC_OneToOne 1 100 0.00 255.0 FORMAT "%5.1" ECU_ADDRESS 0x60036F6A /end MEASUREMENT
/begin MEASUREMENT DFC_st.DFC_ComSRSChksum "Status of DFC / Status of diagnostic fault check DFC_ComSRSChksum" UBYTE DFC_OneToOne 1 100 0.00 255.0 FORMAT "%5.1" ECU_ADDRESS 0x60036F6B /end MEASUREMENT
/begin MEASUREMENT DFC_st.DFC_ComSRSErr "Status of DFC / Status of diagnostic fault check DFC_ComSRSErr" UBYTE DFC_OneToOne 1 100 0.00 255.0 FORMAT "%5.1" ECU_ADDRESS 0x60036F6C /end MEASUREMENT
/begin MEASUREMENT DFC_st.DFC_ComSRSRingCnt "Status of DFC / Status of diagnostic fault check DFC_ComSRSRingCnt" UBYTE DFC_OneToOne 1 100 0.00 255.0 FORMAT "%5.1" ECU_ADDRESS 0x60036F6D /end MEASUREMENT
/begin MEASUREMENT DFC_st.DFC_ComSRSTOut "Status of DFC / Status of diagnostic fault check DFC_ComSRSTOut" UBYTE DFC_OneToOne 1 100 0.00 255.0 FORMAT "%5.1" ECU_ADDRESS 0x60036F6E /end MEASUREMENT
/begin MEASUREMENT DFC_st.DFC_ComVehSpdPndFltTCU "Status of DFC / Status of diagnostic fault check DFC_ComVehSpdPndFltTCU" UBYTE DFC_OneToOne 1 100 0.00 255.0 FORMAT "%5.1" ECU_ADDRESS 0x60036F6F /end MEASUREMENT
/begin MEASUREMENT DFC_st.DFC_EbsChartcCurrErr "Status of DFC / Status of diagnostic fault check DFC_EbsChartcCurrErr" UBYTE DFC_OneToOne 1 100 0.00 255.0 FORMAT "%5.1" ECU_ADDRESS 0x60036F70 /end MEASUREMENT
/begin MEASUREMENT DFC_st.DFC_EbsSelfDiagErr "Status of DFC / Status of diagnostic fault check DFC_EbsSelfDiagErr" UBYTE DFC_OneToOne 1 100 0.00 255.0 FORMAT "%5.1" ECU_ADDRESS 0x60036F71 /end MEASUREMENT
/begin MEASUREMENT DFC_st.DFC_GEVlvPhaCsersIntkB1 "Status of DFC / Status of diagnostic fault check DFC_GEVlvPhaCsersIntkB1" UBYTE DFC_OneToOne 1 100 0.00 255.0 FORMAT "%5.1" ECU_ADDRESS 0x60036F72 /end MEASUREMENT
/begin MEASUREMENT DFC_st.DFC_GEVlvPhaPsOpenLoadIntkB1 "Status of DFC / Status of diagnostic fault check DFC_GEVlvPhaPsOpenLoadIntkB1" UBYTE DFC_OneToOne 1 100 0.00 255.0 FORMAT "%5.1" ECU_ADDRESS 0x60036F73 /end MEASUREMENT
/begin MEASUREMENT DFC_st.DFC_GEVlvPhaPsShoToBattIntkB1 "Status of DFC / Status of diagnostic fault check DFC_GEVlvPhaPsShoToBattIntkB1" UBYTE DFC_OneToOne 1 100 0.00 255.0 FORMAT "%5.1" ECU_ADDRESS 0x60036F74 /end MEASUREMENT
/begin MEASUREMENT DFC_st.DFC_GEVlvPhaPsShoToGndIntkB1 "Status of DFC / Status of diagnostic fault check DFC_GEVlvPhaPsShoToGndIntkB1" UBYTE DFC_OneToOne 1 100 0.00 255.0 FORMAT "%5.1" ECU_ADDRESS 0x60036F75 /end MEASUREMENT
/begin MEASUREMENT DFC_st.DFC_GbxCANDigPlausErr "Status of DFC / Status of diagnostic fault check DFC_GbxCANDigPlausErr" UBYTE DFC_OneToOne 1 100 0.00 255.0 FORMAT "%5.1" ECU_ADDRESS 0x60036F76 /end MEASUREMENT
/begin MEASUREMENT DFC_st.DFC_GbxNPos1SRCMax "Status of DFC / Status of diagnostic fault check DFC_GbxNPos1SRCMax" UBYTE DFC_OneToOne 1 100 0.00 255.0 FORMAT "%5.1" ECU_ADDRESS 0x60036F77 /end MEASUREMENT
/begin MEASUREMENT DFC_st.DFC_GbxNPos1SRCMin "Status of DFC / Status of diagnostic fault check DFC_GbxNPos1SRCMin" UBYTE DFC_OneToOne 1 100 0.00 255.0 FORMAT "%5.1" ECU_ADDRESS 0x60036F78 /end MEASUREMENT
/begin MEASUREMENT DFC_st.DFC_GbxNPos2SRCMax "Status of DFC / Status of diagnostic fault check DFC_GbxNPos2SRCMax" UBYTE DFC_OneToOne 1 100 0.00 255.0 FORMAT "%5.1" ECU_ADDRESS 0x60036F79 /end MEASUREMENT
/begin MEASUREMENT DFC_st.DFC_GbxNPos2SRCMin "Status of DFC / Status of diagnostic fault check DFC_GbxNPos2SRCMin" UBYTE DFC_OneToOne 1 100 0.00 255.0 FORMAT "%5.1" ECU_ADDRESS 0x60036F7A /end MEASUREMENT
/begin MEASUREMENT DFC_st.DFC_GbxNPosAlvChk "Status of DFC / Status of diagnostic fault check DFC_GbxNPosAlvChk" UBYTE DFC_OneToOne 1 100 0.00 255.0 FORMAT "%5.1" ECU_ADDRESS 0x60036F7B /end MEASUREMENT
/begin MEASUREMENT DFC_st.DFC_GbxNPosSyncErr "Status of DFC / Status of diagnostic fault check DFC_GbxNPosSyncErr" UBYTE DFC_OneToOne 1 100 0.00 255.0 FORMAT "%5.1" ECU_ADDRESS 0x60036F7C /end MEASUREMENT
/begin MEASUREMENT DFC_st.DFC_HEGOS2B1HtrPsMax "Status of DFC / Status of diagnostic fault check DFC_HEGOS2B1HtrPsMax" UBYTE DFC_OneToOne 1 100 0.00 255.0 FORMAT "%5.1" ECU_ADDRESS 0x60036F7D /end MEASUREMENT
/begin MEASUREMENT DFC_st.DFC_HEGOS2B1HtrPsMin "Status of DFC / Status of diagnostic fault check DFC_HEGOS2B1HtrPsMin" UBYTE DFC_OneToOne 1 100 0.00 255.0 FORMAT "%5.1" ECU_ADDRESS 0x60036F7E /end MEASUREMENT
/begin MEASUREMENT DFC_st.DFC_HEGOS2B1HtrPsSig "Status of DFC / Status of diagnostic fault check DFC_HEGOS2B1HtrPsSig" UBYTE DFC_OneToOne 1 100 0.00 255.0 FORMAT "%5.1" ECU_ADDRESS 0x60036F7F /end MEASUREMENT
/begin MEASUREMENT DFC_st.DFC_LinCSErrACG "Status of DFC / Status of diagnostic fault check DFC_LinCSErrACG" UBYTE DFC_OneToOne 1 100 0.00 255.0 FORMAT "%5.1" ECU_ADDRESS 0x60036F80 /end MEASUREMENT
/begin MEASUREMENT DFC_st.DFC_LinCSErrAEV "Status of DFC / Status of diagnostic fault check DFC_LinCSErrAEV" UBYTE DFC_OneToOne 1 100 0.00 255.0 FORMAT "%5.1" ECU_ADDRESS 0x60036F81 /end MEASUREMENT
/begin MEASUREMENT DFC_st.DFC_LinCSErrDCDC "Status of DFC / Status of diagnostic fault check DFC_LinCSErrDCDC" UBYTE DFC_OneToOne 1 100 0.00 255.0 FORMAT "%5.1" ECU_ADDRESS 0x60036F82 /end MEASUREMENT
/begin MEASUREMENT DFC_st.DFC_LinCSErrEBS "Status of DFC / Status of diagnostic fault check DFC_LinCSErrEBS" UBYTE DFC_OneToOne 1 100 0.00 255.0 FORMAT "%5.1" ECU_ADDRESS 0x60036F83 /end MEASUREMENT
/begin MEASUREMENT DFC_st.DFC_LinHdrTimeoutErrACG "Status of DFC / Status of diagnostic fault check DFC_LinHdrTimeoutErrACG" UBYTE DFC_OneToOne 1 100 0.00 255.0 FORMAT "%5.1" ECU_ADDRESS 0x60036F84 /end MEASUREMENT
/begin MEASUREMENT DFC_st.DFC_LinHdrTimeoutErrAEV "Status of DFC / Status of diagnostic fault check DFC_LinHdrTimeoutErrAEV" UBYTE DFC_OneToOne 1 100 0.00 255.0 FORMAT "%5.1" ECU_ADDRESS 0x60036F85 /end MEASUREMENT
/begin MEASUREMENT DFC_st.DFC_LinHdrTimeoutErrDCDC "Status of DFC / Status of diagnostic fault check DFC_LinHdrTimeoutErrDCDC" UBYTE DFC_OneToOne 1 100 0.00 255.0 FORMAT "%5.1" ECU_ADDRESS 0x60036F86 /end MEASUREMENT
/begin MEASUREMENT DFC_st.DFC_LinHdrTimeoutErrEBS "Status of DFC / Status of diagnostic fault check DFC_LinHdrTimeoutErrEBS" UBYTE DFC_OneToOne 1 100 0.00 255.0 FORMAT "%5.1" ECU_ADDRESS 0x60036F87 /end MEASUREMENT
/begin MEASUREMENT DFC_st.DFC_LinMsgTimeoutErrACG "Status of DFC / Status of diagnostic fault check DFC_LinMsgTimeoutErrACG" UBYTE DFC_OneToOne 1 100 0.00 255.0 FORMAT "%5.1" ECU_ADDRESS 0x60036F88 /end MEASUREMENT
/begin MEASUREMENT DFC_st.DFC_LinMsgTimeoutErrAEV "Status of DFC / Status of diagnostic fault check DFC_LinMsgTimeoutErrAEV" UBYTE DFC_OneToOne 1 100 0.00 255.0 FORMAT "%5.1" ECU_ADDRESS 0x60036F89 /end MEASUREMENT
/begin MEASUREMENT DFC_st.DFC_LinMsgTimeoutErrDCDC "Status of DFC / Status of diagnostic fault check DFC_LinMsgTimeoutErrDCDC" UBYTE DFC_OneToOne 1 100 0.00 255.0 FORMAT "%5.1" ECU_ADDRESS 0x60036F8A /end MEASUREMENT
/begin MEASUREMENT DFC_st.DFC_LinMsgTimeoutErrEBS "Status of DFC / Status of diagnostic fault check DFC_LinMsgTimeoutErrEBS" UBYTE DFC_OneToOne 1 100 0.00 255.0 FORMAT "%5.1" ECU_ADDRESS 0x60036F8B /end MEASUREMENT
/begin MEASUREMENT DFC_st.DFC_LinNoStrtComErr "Status of DFC / Status of diagnostic fault check DFC_LinNoStrtComErr" UBYTE DFC_OneToOne 1 100 0.00 255.0 FORMAT "%5.1" ECU_ADDRESS 0x60036F8C /end MEASUREMENT
/begin MEASUREMENT DFC_st.DFC_LowPresOilP "Status of DFC / Status of diagnostic fault check DFC_LowPresOilP" UBYTE DFC_OneToOne 1 100 0.00 255.0 FORMAT "%5.1" ECU_ADDRESS 0x60036F8D /end MEASUREMENT
/begin MEASUREMENT DFC_st.DFC_MisfDetVWhlFrntLeOORHi "Status of DFC / Status of diagnostic fault check DFC_MisfDetVWhlFrntLeOORHi" UBYTE DFC_OneToOne 1 100 0.00 255.0 FORMAT "%5.1" ECU_ADDRESS 0x60036F8E /end MEASUREMENT
/begin MEASUREMENT DFC_st.DFC_MisfDetVWhlFrntLeRatyHi "Status of DFC / Status of diagnostic fault check DFC_MisfDetVWhlFrntLeRatyHi" UBYTE DFC_OneToOne 1 100 0.00 255.0 FORMAT "%5.1" ECU_ADDRESS 0x60036F8F /end MEASUREMENT
/begin MEASUREMENT DFC_st.DFC_MisfDetVWhlFrntLeRatyLo "Status of DFC / Status of diagnostic fault check DFC_MisfDetVWhlFrntLeRatyLo" UBYTE DFC_OneToOne 1 100 0.00 255.0 FORMAT "%5.1" ECU_ADDRESS 0x60036F90 /end MEASUREMENT
/begin MEASUREMENT DFC_st.DFC_MisfDetVWhlFrntLeStuck "Status of DFC / Status of diagnostic fault check DFC_MisfDetVWhlFrntLeStuck" UBYTE DFC_OneToOne 1 100 0.00 255.0 FORMAT "%5.1" ECU_ADDRESS 0x60036F91 /end MEASUREMENT
/begin MEASUREMENT DFC_st.DFC_MisfDetVWhlFrntRiOORHi "Status of DFC / Status of diagnostic fault check DFC_MisfDetVWhlFrntRiOORHi" UBYTE DFC_OneToOne 1 100 0.00 255.0 FORMAT "%5.1" ECU_ADDRESS 0x60036F92 /end MEASUREMENT
/begin MEASUREMENT DFC_st.DFC_MisfDetVWhlFrntRiRatyHi "Status of DFC / Status of diagnostic fault check DFC_MisfDetVWhlFrntRiRatyHi" UBYTE DFC_OneToOne 1 100 0.00 255.0 FORMAT "%5.1" ECU_ADDRESS 0x60036F93 /end MEASUREMENT
/begin MEASUREMENT DFC_st.DFC_MisfDetVWhlFrntRiRatyLo "Status of DFC / Status of diagnostic fault check DFC_MisfDetVWhlFrntRiRatyLo" UBYTE DFC_OneToOne 1 100 0.00 255.0 FORMAT "%5.1" ECU_ADDRESS 0x60036F94 /end MEASUREMENT
/begin MEASUREMENT DFC_st.DFC_MisfDetVWhlFrntRiStuck "Status of DFC / Status of diagnostic fault check DFC_MisfDetVWhlFrntRiStuck" UBYTE DFC_OneToOne 1 100 0.00 255.0 FORMAT "%5.1" ECU_ADDRESS 0x60036F95 /end MEASUREMENT
/begin MEASUREMENT DFC_st.DFC_MisfDetVWhlReLeOORHi "Status of DFC / Status of diagnostic fault check DFC_MisfDetVWhlReLeOORHi" UBYTE DFC_OneToOne 1 100 0.00 255.0 FORMAT "%5.1" ECU_ADDRESS 0x60036F96 /end MEASUREMENT
/begin MEASUREMENT DFC_st.DFC_MisfDetVWhlReLeRatyHi "Status of DFC / Status of diagnostic fault check DFC_MisfDetVWhlReLeRatyHi" UBYTE DFC_OneToOne 1 100 0.00 255.0 FORMAT "%5.1" ECU_ADDRESS 0x60036F97 /end MEASUREMENT
/begin MEASUREMENT DFC_st.DFC_MisfDetVWhlReLeRatyLo "Status of DFC / Status of diagnostic fault check DFC_MisfDetVWhlReLeRatyLo" UBYTE DFC_OneToOne 1 100 0.00 255.0 FORMAT "%5.1" ECU_ADDRESS 0x60036F98 /end MEASUREMENT
/begin MEASUREMENT DFC_st.DFC_MisfDetVWhlReLeStuck "Status of DFC / Status of diagnostic fault check DFC_MisfDetVWhlReLeStuck" UBYTE DFC_OneToOne 1 100 0.00 255.0 FORMAT "%5.1" ECU_ADDRESS 0x60036F99 /end MEASUREMENT
/begin MEASUREMENT DFC_st.DFC_MisfDetVWhlReRiOORHi "Status of DFC / Status of diagnostic fault check DFC_MisfDetVWhlReRiOORHi" UBYTE DFC_OneToOne 1 100 0.00 255.0 FORMAT "%5.1" ECU_ADDRESS 0x60036F9A /end MEASUREMENT
/begin MEASUREMENT DFC_st.DFC_MisfDetVWhlReRiRatyHi "Status of DFC / Status of diagnostic fault check DFC_MisfDetVWhlReRiRatyHi" UBYTE DFC_OneToOne 1 100 0.00 255.0 FORMAT "%5.1" ECU_ADDRESS 0x60036F9B /end MEASUREMENT
/begin MEASUREMENT DFC_st.DFC_MisfDetVWhlReRiRatyLo "Status of DFC / Status of diagnostic fault check DFC_MisfDetVWhlReRiRatyLo" UBYTE DFC_OneToOne 1 100 0.00 255.0 FORMAT "%5.1" ECU_ADDRESS 0x60036F9C /end MEASUREMENT
/begin MEASUREMENT DFC_st.DFC_MisfDetVWhlReRiStuck "Status of DFC / Status of diagnostic fault check DFC_MisfDetVWhlReRiStuck" UBYTE DFC_OneToOne 1 100 0.00 255.0 FORMAT "%5.1" ECU_ADDRESS 0x60036F9D /end MEASUREMENT
/begin MEASUREMENT DFC_st.DFC_MisfDetdVWhlFrntLePlaus "Status of DFC / Status of diagnostic fault check DFC_MisfDetdVWhlFrntLePlaus" UBYTE DFC_OneToOne 1 100 0.00 255.0 FORMAT "%5.1" ECU_ADDRESS 0x60036F9E /end MEASUREMENT
/begin MEASUREMENT DFC_st.DFC_MisfDetdVWhlFrntRiPlaus "Status of DFC / Status of diagnostic fault check DFC_MisfDetdVWhlFrntRiPlaus" UBYTE DFC_OneToOne 1 100 0.00 255.0 FORMAT "%5.1" ECU_ADDRESS 0x60036F9F /end MEASUREMENT
/begin MEASUREMENT DFC_st.DFC_MisfDetdVWhlReLePlaus "Status of DFC / Status of diagnostic fault check DFC_MisfDetdVWhlReLePlaus" UBYTE DFC_OneToOne 1 100 0.00 255.0 FORMAT "%5.1" ECU_ADDRESS 0x60036FA0 /end MEASUREMENT
/begin MEASUREMENT DFC_st.DFC_MisfDetdVWhlReRiPlaus "Status of DFC / Status of diagnostic fault check DFC_MisfDetdVWhlReRiPlaus" UBYTE DFC_OneToOne 1 100 0.00 255.0 FORMAT "%5.1" ECU_ADDRESS 0x60036FA1 /end MEASUREMENT
/begin MEASUREMENT DFC_st.DFC_PEnvSigRngMax "Status of DFC / Status of diagnostic fault check DFC_PEnvSigRngMax" UBYTE DFC_OneToOne 1 100 0.00 255.0 FORMAT "%5.1" ECU_ADDRESS 0x60036FA2 /end MEASUREMENT
/begin MEASUREMENT DFC_st.DFC_PEnvSigRngMin "Status of DFC / Status of diagnostic fault check DFC_PEnvSigRngMin" UBYTE DFC_OneToOne 1 100 0.00 255.0 FORMAT "%5.1" ECU_ADDRESS 0x60036FA3 /end MEASUREMENT
/begin MEASUREMENT DFC_st.DFC_StmFault "Status of DFC / Status of diagnostic fault check DFC_StmFault" UBYTE DFC_OneToOne 1 100 0.00 255.0 FORMAT "%5.1" ECU_ADDRESS 0x60036FA4 /end MEASUREMENT
/begin MEASUREMENT DFC_st.DFC_StrtCtOffPth "Status of DFC / Status of diagnostic fault check DFC_StrtCtOffPth" UBYTE DFC_OneToOne 1 100 0.00 255.0 FORMAT "%5.1" ECU_ADDRESS 0x60036FA5 /end MEASUREMENT
/begin MEASUREMENT DFC_st.DFC_StrtCtlErr "Status of DFC / Status of diagnostic fault check DFC_StrtCtlErr" UBYTE DFC_OneToOne 1 100 0.00 255.0 FORMAT "%5.1" ECU_ADDRESS 0x60036FA6 /end MEASUREMENT
/begin MEASUREMENT DFC_st.DFC_StrtFault "Status of DFC / Status of diagnostic fault check DFC_StrtFault" UBYTE DFC_OneToOne 1 100 0.00 255.0 FORMAT "%5.1" ECU_ADDRESS 0x60036FA7 /end MEASUREMENT
/begin MEASUREMENT DFC_st.DFC_StrtLckJudg1 "Status of DFC / Status of diagnostic fault check DFC_StrtLckJudg1" UBYTE DFC_OneToOne 1 100 0.00 255.0 FORMAT "%5.1" ECU_ADDRESS 0x60036FA8 /end MEASUREMENT
/begin MEASUREMENT DFC_st.DFC_StrtLckJudg2 "Status of DFC / Status of diagnostic fault check DFC_StrtLckJudg2" UBYTE DFC_OneToOne 1 100 0.00 255.0 FORMAT "%5.1" ECU_ADDRESS 0x60036FA9 /end MEASUREMENT
/begin MEASUREMENT DFC_st.DFC_StrtOL "Status of DFC / Status of diagnostic fault check DFC_StrtOL" UBYTE DFC_OneToOne 1 100 0.00 255.0 FORMAT "%5.1" ECU_ADDRESS 0x60036FAA /end MEASUREMENT
/begin MEASUREMENT DFC_st.DFC_StrtOL2 "Status of DFC / Status of diagnostic fault check DFC_StrtOL2" UBYTE DFC_OneToOne 1 100 0.00 255.0 FORMAT "%5.1" ECU_ADDRESS 0x60036FAB /end MEASUREMENT
/begin MEASUREMENT DFC_st.DFC_StrtSCB "Status of DFC / Status of diagnostic fault check DFC_StrtSCB" UBYTE DFC_OneToOne 1 100 0.00 255.0 FORMAT "%5.1" ECU_ADDRESS 0x60036FAC /end MEASUREMENT
/begin MEASUREMENT DFC_st.DFC_StrtSCB2 "Status of DFC / Status of diagnostic fault check DFC_StrtSCB2" UBYTE DFC_OneToOne 1 100 0.00 255.0 FORMAT "%5.1" ECU_ADDRESS 0x60036FAD /end MEASUREMENT
/begin MEASUREMENT DFC_st.DFC_StrtSCG "Status of DFC / Status of diagnostic fault check DFC_StrtSCG" UBYTE DFC_OneToOne 1 100 0.00 255.0 FORMAT "%5.1" ECU_ADDRESS 0x60036FAE /end MEASUREMENT
/begin MEASUREMENT DFC_st.DFC_StrtSCG2 "Status of DFC / Status of diagnostic fault check DFC_StrtSCG2" UBYTE DFC_OneToOne 1 100 0.00 255.0 FORMAT "%5.1" ECU_ADDRESS 0x60036FAF /end MEASUREMENT
/begin MEASUREMENT DFC_st.DFC_StrtStkRly1 "Status of DFC / Status of diagnostic fault check DFC_StrtStkRly1" UBYTE DFC_OneToOne 1 100 0.00 255.0 FORMAT "%5.1" ECU_ADDRESS 0x60036FB0 /end MEASUREMENT
/begin MEASUREMENT DFC_st.DFC_StrtStkRly2 "Status of DFC / Status of diagnostic fault check DFC_StrtStkRly2" UBYTE DFC_OneToOne 1 100 0.00 255.0 FORMAT "%5.1" ECU_ADDRESS 0x60036FB1 /end MEASUREMENT
/begin MEASUREMENT DFC_st.DFC_TEVEmax "Status of DFC / Status of diagnostic fault check DFC_TEVEmax" UBYTE DFC_OneToOne 1 100 0.00 255.0 FORMAT "%5.1" ECU_ADDRESS 0x60036FB2 /end MEASUREMENT
/begin MEASUREMENT DFC_st.DFC_TEVEmin "Status of DFC / Status of diagnostic fault check DFC_TEVEmin" UBYTE DFC_OneToOne 1 100 0.00 255.0 FORMAT "%5.1" ECU_ADDRESS 0x60036FB3 /end MEASUREMENT
/begin MEASUREMENT DFC_st.DFC_TEVEsig "Status of DFC / Status of diagnostic fault check DFC_TEVEsig" UBYTE DFC_OneToOne 1 100 0.00 255.0 FORMAT "%5.1" ECU_ADDRESS 0x60036FB4 /end MEASUREMENT
/begin MEASUREMENT DFC_st.DFC_UegoHeatrPrfmncLoS1B1 "Status of DFC / Status of diagnostic fault check DFC_UegoHeatrPrfmncLoS1B1" UBYTE DFC_OneToOne 1 100 0.00 255.0 FORMAT "%5.1" ECU_ADDRESS 0x60036FB5 /end MEASUREMENT
/begin MEASUREMENT DFC_st.DFC_VehVAllPlaus "Status of DFC / Status of diagnostic fault check DFC_VehVAllPlaus" UBYTE DFC_OneToOne 1 100 0.00 255.0 FORMAT "%5.1" ECU_ADDRESS 0x60036FB6 /end MEASUREMENT
/begin MEASUREMENT DFC_st.DFC_VehVNCSnsrElecFailr "Status of DFC / Status of diagnostic fault check DFC_VehVNCSnsrElecFailr" UBYTE DFC_OneToOne 1 100 0.00 255.0 FORMAT "%5.1" ECU_ADDRESS 0x60036FB7 /end MEASUREMENT
/begin MEASUREMENT DFC_st.DFC_VehVPlausCan "Status of DFC / Status of diagnostic fault check DFC_VehVPlausCan" UBYTE DFC_OneToOne 1 100 0.00 255.0 FORMAT "%5.1" ECU_ADDRESS 0x60036FB8 /end MEASUREMENT
/begin MEASUREMENT DFC_st.DFC_VehVPlausFco "Status of DFC / Status of diagnostic fault check DFC_VehVPlausFco" UBYTE DFC_OneToOne 1 100 0.00 255.0 FORMAT "%5.1" ECU_ADDRESS 0x60036FB9 /end MEASUREMENT
/begin MEASUREMENT DFC_st.DFC_VehVPlausPwr "Status of DFC / Status of diagnostic fault check DFC_VehVPlausPwr" UBYTE DFC_OneToOne 1 100 0.00 255.0 FORMAT "%5.1" ECU_ADDRESS 0x60036FBA /end MEASUREMENT
/begin MEASUREMENT DFC_st.DFC_VehVPlausV2N "Status of DFC / Status of diagnostic fault check DFC_VehVPlausV2N" UBYTE DFC_OneToOne 1 100 0.00 255.0 FORMAT "%5.1" ECU_ADDRESS 0x60036FBB /end MEASUREMENT
/begin MEASUREMENT DFC_st.DFC_VehVSpdSnsrAElecFailr "Status of DFC / Status of diagnostic fault check DFC_VehVSpdSnsrAElecFailr" UBYTE DFC_OneToOne 1 100 0.00 255.0 FORMAT "%5.1" ECU_ADDRESS 0x60036FBC /end MEASUREMENT
/begin MEASUREMENT DFC_st.DFC_VehVSpdSnsrBElecFailr "Status of DFC / Status of diagnostic fault check DFC_VehVSpdSnsrBElecFailr" UBYTE DFC_OneToOne 1 100 0.00 255.0 FORMAT "%5.1" ECU_ADDRESS 0x60036FBD /end MEASUREMENT
/begin MEASUREMENT DFC_st.DFC_ClthMax "Status of DFC / Status of diagnostic fault check DFC_ClthMax" UBYTE DFC_OneToOne 1 100 0.00 255.0 FORMAT "%5.1" ECU_ADDRESS 0x60036FBE /end MEASUREMENT
/begin MEASUREMENT DFC_st.DFC_IgnClPs_DevComErr "Status of DFC / Status of diagnostic fault check DFC_IgnClPs_DevComErr" UBYTE DFC_OneToOne 1 100 0.00 255.0 FORMAT "%5.1" ECU_ADDRESS 0x60036FBF /end MEASUREMENT
/begin MEASUREMENT DFC_st.DFC_IgnClPs_LineOl_0 "Status of DFC / Status of diagnostic fault check DFC_IgnClPs_LineOl_0" UBYTE DFC_OneToOne 1 100 0.00 255.0 FORMAT "%5.1" ECU_ADDRESS 0x60036FC0 /end MEASUREMENT
/begin MEASUREMENT DFC_st.DFC_IgnClPs_LineOl_1 "Status of DFC / Status of diagnostic fault check DFC_IgnClPs_LineOl_1" UBYTE DFC_OneToOne 1 100 0.00 255.0 FORMAT "%5.1" ECU_ADDRESS 0x60036FC1 /end MEASUREMENT
/begin MEASUREMENT DFC_st.DFC_IgnClPs_LineOl_2 "Status of DFC / Status of diagnostic fault check DFC_IgnClPs_LineOl_2" UBYTE DFC_OneToOne 1 100 0.00 255.0 FORMAT "%5.1" ECU_ADDRESS 0x60036FC2 /end MEASUREMENT
/begin MEASUREMENT DFC_st.DFC_IgnClPs_LineOl_3 "Status of DFC / Status of diagnostic fault check DFC_IgnClPs_LineOl_3" UBYTE DFC_OneToOne 1 100 0.00 255.0 FORMAT "%5.1" ECU_ADDRESS 0x60036FC3 /end MEASUREMENT
/begin MEASUREMENT DFC_st.DFC_IgnClPs_LineScb_0 "Status of DFC / Status of diagnostic fault check DFC_IgnClPs_LineScb_0" UBYTE DFC_OneToOne 1 100 0.00 255.0 FORMAT "%5.1" ECU_ADDRESS 0x60036FC4 /end MEASUREMENT
/begin MEASUREMENT DFC_st.DFC_IgnClPs_LineScb_1 "Status of DFC / Status of diagnostic fault check DFC_IgnClPs_LineScb_1" UBYTE DFC_OneToOne 1 100 0.00 255.0 FORMAT "%5.1" ECU_ADDRESS 0x60036FC5 /end MEASUREMENT
/begin MEASUREMENT DFC_st.DFC_IgnClPs_LineScb_2 "Status of DFC / Status of diagnostic fault check DFC_IgnClPs_LineScb_2" UBYTE DFC_OneToOne 1 100 0.00 255.0 FORMAT "%5.1" ECU_ADDRESS 0x60036FC6 /end MEASUREMENT
/begin MEASUREMENT DFC_st.DFC_IgnClPs_LineScb_3 "Status of DFC / Status of diagnostic fault check DFC_IgnClPs_LineScb_3" UBYTE DFC_OneToOne 1 100 0.00 255.0 FORMAT "%5.1" ECU_ADDRESS 0x60036FC7 /end MEASUREMENT
/begin MEASUREMENT DFC_st.DFC_IgnClPs_LineScg_0 "Status of DFC / Status of diagnostic fault check DFC_IgnClPs_LineScg_0" UBYTE DFC_OneToOne 1 100 0.00 255.0 FORMAT "%5.1" ECU_ADDRESS 0x60036FC8 /end MEASUREMENT
/begin MEASUREMENT DFC_st.DFC_IgnClPs_LineScg_1 "Status of DFC / Status of diagnostic fault check DFC_IgnClPs_LineScg_1" UBYTE DFC_OneToOne 1 100 0.00 255.0 FORMAT "%5.1" ECU_ADDRESS 0x60036FC9 /end MEASUREMENT
/begin MEASUREMENT DFC_st.DFC_IgnClPs_LineScg_2 "Status of DFC / Status of diagnostic fault check DFC_IgnClPs_LineScg_2" UBYTE DFC_OneToOne 1 100 0.00 255.0 FORMAT "%5.1" ECU_ADDRESS 0x60036FCA /end MEASUREMENT
/begin MEASUREMENT DFC_st.DFC_IgnClPs_LineScg_3 "Status of DFC / Status of diagnostic fault check DFC_IgnClPs_LineScg_3" UBYTE DFC_OneToOne 1 100 0.00 255.0 FORMAT "%5.1" ECU_ADDRESS 0x60036FCB /end MEASUREMENT
/begin MEASUREMENT DFC_st.DFC_KRVEKOEVAB "Status of DFC / Status of diagnostic fault check DFC_KRVEKOEVAB" UBYTE DFC_OneToOne 1 100 0.00 255.0 FORMAT "%5.1" ECU_ADDRESS 0x60036FCC /end MEASUREMENT
/begin MEASUREMENT DFC_st.DFC_KRVEKOEVAB0 "Status of DFC / Status of diagnostic fault check DFC_KRVEKOEVAB0" UBYTE DFC_OneToOne 1 100 0.00 255.0 FORMAT "%5.1" ECU_ADDRESS 0x60036FCD /end MEASUREMENT
/begin MEASUREMENT DFC_st.DFC_KRVEKOEVAB1 "Status of DFC / Status of diagnostic fault check DFC_KRVEKOEVAB1" UBYTE DFC_OneToOne 1 100 0.00 255.0 FORMAT "%5.1" ECU_ADDRESS 0x60036FCE /end MEASUREMENT
/begin MEASUREMENT DFC_st.DFC_KRVEKOEVAB2 "Status of DFC / Status of diagnostic fault check DFC_KRVEKOEVAB2" UBYTE DFC_OneToOne 1 100 0.00 255.0 FORMAT "%5.1" ECU_ADDRESS 0x60036FCF /end MEASUREMENT
/begin MEASUREMENT DFC_st.DFC_KRVEKOEVAB3 "Status of DFC / Status of diagnostic fault check DFC_KRVEKOEVAB3" UBYTE DFC_OneToOne 1 100 0.00 255.0 FORMAT "%5.1" ECU_ADDRESS 0x60036FD0 /end MEASUREMENT
/begin MEASUREMENT DFC_st.DFC_UegoSigEcuAsicS1B1 "Status of DFC / Status of diagnostic fault check DFC_UegoSigEcuAsicS1B1" UBYTE DFC_OneToOne 1 100 0.00 255.0 FORMAT "%5.1" ECU_ADDRESS 0x60036FD1 /end MEASUREMENT
/begin MEASUREMENT DFC_st.DFC_UegoSigEcuComS1B1 "Status of DFC / Status of diagnostic fault check DFC_UegoSigEcuComS1B1" UBYTE DFC_OneToOne 1 100 0.00 255.0 FORMAT "%5.1" ECU_ADDRESS 0x60036FD2 /end MEASUREMENT
/begin MEASUREMENT DFC_st.DFC_UegoSigSnsrS1B1 "Status of DFC / Status of diagnostic fault check DFC_UegoSigSnsrS1B1" UBYTE DFC_OneToOne 1 100 0.00 255.0 FORMAT "%5.1" ECU_ADDRESS 0x60036FD3 /end MEASUREMENT
/begin MEASUREMENT DFC_st.DFC_UegoSigWireOlApesS1B1 "Status of DFC / Status of diagnostic fault check DFC_UegoSigWireOlApesS1B1" UBYTE DFC_OneToOne 1 100 0.00 255.0 FORMAT "%5.1" ECU_ADDRESS 0x60036FD4 /end MEASUREMENT
/begin MEASUREMENT DFC_st.DFC_UegoSigWireOlIpeS1B1 "Status of DFC / Status of diagnostic fault check DFC_UegoSigWireOlIpeS1B1" UBYTE DFC_OneToOne 1 100 0.00 255.0 FORMAT "%5.1" ECU_ADDRESS 0x60036FD5 /end MEASUREMENT
/begin MEASUREMENT DFC_st.DFC_UegoSigWireOlReS1B1 "Status of DFC / Status of diagnostic fault check DFC_UegoSigWireOlReS1B1" UBYTE DFC_OneToOne 1 100 0.00 255.0 FORMAT "%5.1" ECU_ADDRESS 0x60036FD6 /end MEASUREMENT
/begin MEASUREMENT DFC_st.DFC_UegoSigWireRCmpS1B1 "Status of DFC / Status of diagnostic fault check DFC_UegoSigWireRCmpS1B1" UBYTE DFC_OneToOne 1 100 0.00 255.0 FORMAT "%5.1" ECU_ADDRESS 0x60036FD7 /end MEASUREMENT
/begin MEASUREMENT DFC_st.DFC_UegoSigWireScbS1B1 "Status of DFC / Status of diagnostic fault check DFC_UegoSigWireScbS1B1" UBYTE DFC_OneToOne 1 100 0.00 255.0 FORMAT "%5.1" ECU_ADDRESS 0x60036FD8 /end MEASUREMENT
/begin MEASUREMENT DFC_st.DFC_UegoSigWireScgS1B1 "Status of DFC / Status of diagnostic fault check DFC_UegoSigWireScgS1B1" UBYTE DFC_OneToOne 1 100 0.00 255.0 FORMAT "%5.1" ECU_ADDRESS 0x60036FD9 /end MEASUREMENT
/begin MEASUREMENT DFC_st.DFC_AfsPhyRngHiB1 "Status of DFC / Status of diagnostic fault check DFC_AfsPhyRngHiB1" UBYTE DFC_OneToOne 1 100 0.00 255.0 FORMAT "%5.1" ECU_ADDRESS 0x60036FDA /end MEASUREMENT
/begin MEASUREMENT DFC_st.DFC_AfsPhyRngLoB1 "Status of DFC / Status of diagnostic fault check DFC_AfsPhyRngLoB1" UBYTE DFC_OneToOne 1 100 0.00 255.0 FORMAT "%5.1" ECU_ADDRESS 0x60036FDB /end MEASUREMENT
/begin MEASUREMENT DFC_st.DFC_AirCCmprOL "Status of DFC / Status of diagnostic fault check DFC_AirCCmprOL" UBYTE DFC_OneToOne 1 100 0.00 255.0 FORMAT "%5.1" ECU_ADDRESS 0x60036FDC /end MEASUREMENT
/begin MEASUREMENT DFC_st.DFC_AirCCmprOvrTemp "Status of DFC / Status of diagnostic fault check DFC_AirCCmprOvrTemp" UBYTE DFC_OneToOne 1 100 0.00 255.0 FORMAT "%5.1" ECU_ADDRESS 0x60036FDD /end MEASUREMENT
/begin MEASUREMENT DFC_st.DFC_AirCCmprSCB "Status of DFC / Status of diagnostic fault check DFC_AirCCmprSCB" UBYTE DFC_OneToOne 1 100 0.00 255.0 FORMAT "%5.1" ECU_ADDRESS 0x60036FDE /end MEASUREMENT
/begin MEASUREMENT DFC_st.DFC_AirCCmprSCG "Status of DFC / Status of diagnostic fault check DFC_AirCCmprSCG" UBYTE DFC_OneToOne 1 100 0.00 255.0 FORMAT "%5.1" ECU_ADDRESS 0x60036FDF /end MEASUREMENT
/begin MEASUREMENT DFC_st.DFC_AltErr "Status of DFC / Status of diagnostic fault check DFC_AltErr" UBYTE DFC_OneToOne 1 100 0.00 255.0 FORMAT "%5.1" ECU_ADDRESS 0x60036FE0 /end MEASUREMENT
/begin MEASUREMENT DFC_st.DFC_BattUSRCMax "Status of DFC / Status of diagnostic fault check DFC_BattUSRCMax" UBYTE DFC_OneToOne 1 100 0.00 255.0 FORMAT "%5.1" ECU_ADDRESS 0x60036FE1 /end MEASUREMENT
/begin MEASUREMENT DFC_st.DFC_BattUSRCMin "Status of DFC / Status of diagnostic fault check DFC_BattUSRCMin" UBYTE DFC_OneToOne 1 100 0.00 255.0 FORMAT "%5.1" ECU_ADDRESS 0x60036FE2 /end MEASUREMENT
/begin MEASUREMENT DFC_st.DFC_ComChksTCU1 "Status of DFC / Status of diagnostic fault check DFC_ComChksTCU1" UBYTE DFC_OneToOne 1 100 0.00 255.0 FORMAT "%5.1" ECU_ADDRESS 0x60036FE3 /end MEASUREMENT
/begin MEASUREMENT DFC_st.DFC_ComChksTCU11 "Status of DFC / Status of diagnostic fault check DFC_ComChksTCU11" UBYTE DFC_OneToOne 1 100 0.00 255.0 FORMAT "%5.1" ECU_ADDRESS 0x60036FE4 /end MEASUREMENT
/begin MEASUREMENT DFC_st.DFC_ComChksTCU12 "Status of DFC / Status of diagnostic fault check DFC_ComChksTCU12" UBYTE DFC_OneToOne 1 100 0.00 255.0 FORMAT "%5.1" ECU_ADDRESS 0x60036FE5 /end MEASUREMENT
/begin MEASUREMENT DFC_st.DFC_ComChksTCU13 "Status of DFC / Status of diagnostic fault check DFC_ComChksTCU13" UBYTE DFC_OneToOne 1 100 0.00 255.0 FORMAT "%5.1" ECU_ADDRESS 0x60036FE6 /end MEASUREMENT
/begin MEASUREMENT DFC_st.DFC_ComChksTCU2 "Status of DFC / Status of diagnostic fault check DFC_ComChksTCU2" UBYTE DFC_OneToOne 1 100 0.00 255.0 FORMAT "%5.1" ECU_ADDRESS 0x60036FE7 /end MEASUREMENT
/begin MEASUREMENT DFC_st.DFC_ComChksTCU3 "Status of DFC / Status of diagnostic fault check DFC_ComChksTCU3" UBYTE DFC_OneToOne 1 100 0.00 255.0 FORMAT "%5.1" ECU_ADDRESS 0x60036FE8 /end MEASUREMENT
/begin MEASUREMENT DFC_st.DFC_ComChksTCU4 "Status of DFC / Status of diagnostic fault check DFC_ComChksTCU4" UBYTE DFC_OneToOne 1 100 0.00 255.0 FORMAT "%5.1" ECU_ADDRESS 0x60036FE9 /end MEASUREMENT
/begin MEASUREMENT DFC_st.DFC_ComCntTCU1 "Status of DFC / Status of diagnostic fault check DFC_ComCntTCU1" UBYTE DFC_OneToOne 1 100 0.00 255.0 FORMAT "%5.1" ECU_ADDRESS 0x60036FEA /end MEASUREMENT
/begin MEASUREMENT DFC_st.DFC_ComCntTCU11 "Status of DFC / Status of diagnostic fault check DFC_ComCntTCU11" UBYTE DFC_OneToOne 1 100 0.00 255.0 FORMAT "%5.1" ECU_ADDRESS 0x60036FEB /end MEASUREMENT
/begin MEASUREMENT DFC_st.DFC_ComCntTCU12 "Status of DFC / Status of diagnostic fault check DFC_ComCntTCU12" UBYTE DFC_OneToOne 1 100 0.00 255.0 FORMAT "%5.1" ECU_ADDRESS 0x60036FEC /end MEASUREMENT
/begin MEASUREMENT DFC_st.DFC_ComCntTCU13 "Status of DFC / Status of diagnostic fault check DFC_ComCntTCU13" UBYTE DFC_OneToOne 1 100 0.00 255.0 FORMAT "%5.1" ECU_ADDRESS 0x60036FED /end MEASUREMENT
/begin MEASUREMENT DFC_st.DFC_ComCntTCU2 "Status of DFC / Status of diagnostic fault check DFC_ComCntTCU2" UBYTE DFC_OneToOne 1 100 0.00 255.0 FORMAT "%5.1" ECU_ADDRESS 0x60036FEE /end MEASUREMENT
/begin MEASUREMENT DFC_st.DFC_ComCntTCU3 "Status of DFC / Status of diagnostic fault check DFC_ComCntTCU3" UBYTE DFC_OneToOne 1 100 0.00 255.0 FORMAT "%5.1" ECU_ADDRESS 0x60036FEF /end MEASUREMENT
/begin MEASUREMENT DFC_st.DFC_ComCntTCU4 "Status of DFC / Status of diagnostic fault check DFC_ComCntTCU4" UBYTE DFC_OneToOne 1 100 0.00 255.0 FORMAT "%5.1" ECU_ADDRESS 0x60036FF0 /end MEASUREMENT
/begin MEASUREMENT DFC_st.DFC_ComTOutTCU01 "Status of DFC / Status of diagnostic fault check DFC_ComTOutTCU01" UBYTE DFC_OneToOne 1 100 0.00 255.0 FORMAT "%5.1" ECU_ADDRESS 0x60036FF1 /end MEASUREMENT
/begin MEASUREMENT DFC_st.DFC_ComTOutTCU02 "Status of DFC / Status of diagnostic fault check DFC_ComTOutTCU02" UBYTE DFC_OneToOne 1 100 0.00 255.0 FORMAT "%5.1" ECU_ADDRESS 0x60036FF2 /end MEASUREMENT
/begin MEASUREMENT DFC_st.DFC_ComTOutTCU1 "Status of DFC / Status of diagnostic fault check DFC_ComTOutTCU1" UBYTE DFC_OneToOne 1 100 0.00 255.0 FORMAT "%5.1" ECU_ADDRESS 0x60036FF3 /end MEASUREMENT
/begin MEASUREMENT DFC_st.DFC_ComTOutTCU11 "Status of DFC / Status of diagnostic fault check DFC_ComTOutTCU11" UBYTE DFC_OneToOne 1 100 0.00 255.0 FORMAT "%5.1" ECU_ADDRESS 0x60036FF4 /end MEASUREMENT
/begin MEASUREMENT DFC_st.DFC_ComTOutTCU12 "Status of DFC / Status of diagnostic fault check DFC_ComTOutTCU12" UBYTE DFC_OneToOne 1 100 0.00 255.0 FORMAT "%5.1" ECU_ADDRESS 0x60036FF5 /end MEASUREMENT
/begin MEASUREMENT DFC_st.DFC_ComTOutTCU13 "Status of DFC / Status of diagnostic fault check DFC_ComTOutTCU13" UBYTE DFC_OneToOne 1 100 0.00 255.0 FORMAT "%5.1" ECU_ADDRESS 0x60036FF6 /end MEASUREMENT
/begin MEASUREMENT DFC_st.DFC_ComTOutTCU14 "Status of DFC / Status of diagnostic fault check DFC_ComTOutTCU14" UBYTE DFC_OneToOne 1 100 0.00 255.0 FORMAT "%5.1" ECU_ADDRESS 0x60036FF7 /end MEASUREMENT
/begin MEASUREMENT DFC_st.DFC_ComTOutTCU2 "Status of DFC / Status of diagnostic fault check DFC_ComTOutTCU2" UBYTE DFC_OneToOne 1 100 0.00 255.0 FORMAT "%5.1" ECU_ADDRESS 0x60036FF8 /end MEASUREMENT
/begin MEASUREMENT DFC_st.DFC_ComTOutTCU3 "Status of DFC / Status of diagnostic fault check DFC_ComTOutTCU3" UBYTE DFC_OneToOne 1 100 0.00 255.0 FORMAT "%5.1" ECU_ADDRESS 0x60036FF9 /end MEASUREMENT
/begin MEASUREMENT DFC_st.DFC_ComTOutTCU4 "Status of DFC / Status of diagnostic fault check DFC_ComTOutTCU4" UBYTE DFC_OneToOne 1 100 0.00 255.0 FORMAT "%5.1" ECU_ADDRESS 0x60036FFA /end MEASUREMENT
/begin MEASUREMENT DFC_st.DFC_DevLibBattUHi "Status of DFC / Status of diagnostic fault check DFC_DevLibBattUHi" UBYTE DFC_OneToOne 1 100 0.00 255.0 FORMAT "%5.1" ECU_ADDRESS 0x60036FFB /end MEASUREMENT
/begin MEASUREMENT DFC_st.DFC_DevLibBattULo "Status of DFC / Status of diagnostic fault check DFC_DevLibBattULo" UBYTE DFC_OneToOne 1 100 0.00 255.0 FORMAT "%5.1" ECU_ADDRESS 0x60036FFC /end MEASUREMENT
/begin MEASUREMENT DFC_st.DFC_EGRVlvFailSafeActv "Status of DFC / Status of diagnostic fault check DFC_EGRVlvFailSafeActv" UBYTE DFC_OneToOne 1 100 0.00 255.0 FORMAT "%5.1" ECU_ADDRESS 0x60036FFD /end MEASUREMENT
/begin MEASUREMENT DFC_st.DFC_EGRVlvGovDvtCld "Status of DFC / Status of diagnostic fault check DFC_EGRVlvGovDvtCld" UBYTE DFC_OneToOne 1 100 0.00 255.0 FORMAT "%5.1" ECU_ADDRESS 0x60036FFE /end MEASUREMENT
/begin MEASUREMENT DFC_st.DFC_EGRVlvPhysSRCMax "Status of DFC / Status of diagnostic fault check DFC_EGRVlvPhysSRCMax" UBYTE DFC_OneToOne 1 100 0.00 255.0 FORMAT "%5.1" ECU_ADDRESS 0x60036FFF /end MEASUREMENT
/begin MEASUREMENT DFC_st.DFC_EGRVlvPhysSRCMin "Status of DFC / Status of diagnostic fault check DFC_EGRVlvPhysSRCMin" UBYTE DFC_OneToOne 1 100 0.00 255.0 FORMAT "%5.1" ECU_ADDRESS 0x60037000 /end MEASUREMENT
/begin MEASUREMENT DFC_st.DFC_FanDIOOL_0 "Status of DFC / Status of diagnostic fault check DFC_FanDIOOL_0" UBYTE DFC_OneToOne 1 100 0.00 255.0 FORMAT "%5.1" ECU_ADDRESS 0x60037001 /end MEASUREMENT
/begin MEASUREMENT DFC_st.DFC_FanDIOOL_1 "Status of DFC / Status of diagnostic fault check DFC_FanDIOOL_1" UBYTE DFC_OneToOne 1 100 0.00 255.0 FORMAT "%5.1" ECU_ADDRESS 0x60037002 /end MEASUREMENT
/begin MEASUREMENT DFC_st.DFC_FanDIOOvrTemp_0 "Status of DFC / Status of diagnostic fault check DFC_FanDIOOvrTemp_0" UBYTE DFC_OneToOne 1 100 0.00 255.0 FORMAT "%5.1" ECU_ADDRESS 0x60037003 /end MEASUREMENT
/begin MEASUREMENT DFC_st.DFC_FanDIOOvrTemp_1 "Status of DFC / Status of diagnostic fault check DFC_FanDIOOvrTemp_1" UBYTE DFC_OneToOne 1 100 0.00 255.0 FORMAT "%5.1" ECU_ADDRESS 0x60037004 /end MEASUREMENT
/begin MEASUREMENT DFC_st.DFC_FanDIOSCB_0 "Status of DFC / Status of diagnostic fault check DFC_FanDIOSCB_0" UBYTE DFC_OneToOne 1 100 0.00 255.0 FORMAT "%5.1" ECU_ADDRESS 0x60037005 /end MEASUREMENT
/begin MEASUREMENT DFC_st.DFC_FanDIOSCB_1 "Status of DFC / Status of diagnostic fault check DFC_FanDIOSCB_1" UBYTE DFC_OneToOne 1 100 0.00 255.0 FORMAT "%5.1" ECU_ADDRESS 0x60037006 /end MEASUREMENT
/begin MEASUREMENT DFC_st.DFC_FanDIOSCG_0 "Status of DFC / Status of diagnostic fault check DFC_FanDIOSCG_0" UBYTE DFC_OneToOne 1 100 0.00 255.0 FORMAT "%5.1" ECU_ADDRESS 0x60037007 /end MEASUREMENT
/begin MEASUREMENT DFC_st.DFC_FanDIOSCG_1 "Status of DFC / Status of diagnostic fault check DFC_FanDIOSCG_1" UBYTE DFC_OneToOne 1 100 0.00 255.0 FORMAT "%5.1" ECU_ADDRESS 0x60037008 /end MEASUREMENT
/begin MEASUREMENT DFC_st.DFC_MRlyDcOL "Status of DFC / Status of diagnostic fault check DFC_MRlyDcOL" UBYTE DFC_OneToOne 1 100 0.00 255.0 FORMAT "%5.1" ECU_ADDRESS 0x60037009 /end MEASUREMENT
/begin MEASUREMENT DFC_st.DFC_MRlyDcSCB "Status of DFC / Status of diagnostic fault check DFC_MRlyDcSCB" UBYTE DFC_OneToOne 1 100 0.00 255.0 FORMAT "%5.1" ECU_ADDRESS 0x6003700A /end MEASUREMENT
/begin MEASUREMENT DFC_st.DFC_MRlyDcSCG "Status of DFC / Status of diagnostic fault check DFC_MRlyDcSCG" UBYTE DFC_OneToOne 1 100 0.00 255.0 FORMAT "%5.1" ECU_ADDRESS 0x6003700B /end MEASUREMENT
/begin MEASUREMENT DFC_st.DFC_PSPOL "Status of DFC / Status of diagnostic fault check DFC_PSPOL" UBYTE DFC_OneToOne 1 100 0.00 255.0 FORMAT "%5.1" ECU_ADDRESS 0x6003700C /end MEASUREMENT
/begin MEASUREMENT DFC_st.DFC_PSPOvrTemp "Status of DFC / Status of diagnostic fault check DFC_PSPOvrTemp" UBYTE DFC_OneToOne 1 100 0.00 255.0 FORMAT "%5.1" ECU_ADDRESS 0x6003700D /end MEASUREMENT
/begin MEASUREMENT DFC_st.DFC_PSPSCB "Status of DFC / Status of diagnostic fault check DFC_PSPSCB" UBYTE DFC_OneToOne 1 100 0.00 255.0 FORMAT "%5.1" ECU_ADDRESS 0x6003700E /end MEASUREMENT
/begin MEASUREMENT DFC_st.DFC_PSPSCG "Status of DFC / Status of diagnostic fault check DFC_PSPSCG" UBYTE DFC_OneToOne 1 100 0.00 255.0 FORMAT "%5.1" ECU_ADDRESS 0x6003700F /end MEASUREMENT
/begin MEASUREMENT DFC_st.DFC_T50Err "Status of DFC / Status of diagnostic fault check DFC_T50Err" UBYTE DFC_OneToOne 1 100 0.00 255.0 FORMAT "%5.1" ECU_ADDRESS 0x60037010 /end MEASUREMENT
/begin MEASUREMENT DFC_st.DFC_ThrVlvLoBattB1 "Status of DFC / Status of diagnostic fault check DFC_ThrVlvLoBattB1" UBYTE DFC_OneToOne 1 100 0.00 255.0 FORMAT "%5.1" ECU_ADDRESS 0x60037011 /end MEASUREMENT
/begin MEASUREMENT DFC_st.DFC_UegoSigOperPlausS1B1 "Status of DFC / Status of diagnostic fault check DFC_UegoSigOperPlausS1B1" UBYTE DFC_OneToOne 1 100 0.00 255.0 FORMAT "%5.1" ECU_ADDRESS 0x60037012 /end MEASUREMENT
/begin MEASUREMENT DFC_st.DFC_VehVPhysRngHi "Status of DFC / Status of diagnostic fault check DFC_VehVPhysRngHi" UBYTE DFC_OneToOne 1 100 0.00 255.0 FORMAT "%5.1" ECU_ADDRESS 0x60037013 /end MEASUREMENT
/begin MEASUREMENT DFC_st.DFC_VehVSclOutOL "Status of DFC / Status of diagnostic fault check DFC_VehVSclOutOL" UBYTE DFC_OneToOne 1 100 0.00 255.0 FORMAT "%5.1" ECU_ADDRESS 0x60037014 /end MEASUREMENT
/begin MEASUREMENT DFC_st.DFC_VehVSclOutOT "Status of DFC / Status of diagnostic fault check DFC_VehVSclOutOT" UBYTE DFC_OneToOne 1 100 0.00 255.0 FORMAT "%5.1" ECU_ADDRESS 0x60037015 /end MEASUREMENT
/begin MEASUREMENT DFC_st.DFC_VehVSclOutSCB "Status of DFC / Status of diagnostic fault check DFC_VehVSclOutSCB" UBYTE DFC_OneToOne 1 100 0.00 255.0 FORMAT "%5.1" ECU_ADDRESS 0x60037016 /end MEASUREMENT
/begin MEASUREMENT DFC_st.DFC_VehVSclOutSCG "Status of DFC / Status of diagnostic fault check DFC_VehVSclOutSCG" UBYTE DFC_OneToOne 1 100 0.00 255.0 FORMAT "%5.1" ECU_ADDRESS 0x60037017 /end MEASUREMENT
/begin MEASUREMENT DFC_st.DFC_VehVSigFL "Status of DFC / Status of diagnostic fault check DFC_VehVSigFL" UBYTE DFC_OneToOne 1 100 0.00 255.0 FORMAT "%5.1" ECU_ADDRESS 0x60037018 /end MEASUREMENT
/begin MEASUREMENT DFC_st.DFC_VehVSigFR "Status of DFC / Status of diagnostic fault check DFC_VehVSigFR" UBYTE DFC_OneToOne 1 100 0.00 255.0 FORMAT "%5.1" ECU_ADDRESS 0x60037019 /end MEASUREMENT
/begin MEASUREMENT DFC_st.DFC_VehVSigRL "Status of DFC / Status of diagnostic fault check DFC_VehVSigRL" UBYTE DFC_OneToOne 1 100 0.00 255.0 FORMAT "%5.1" ECU_ADDRESS 0x6003701A /end MEASUREMENT
/begin MEASUREMENT DFC_st.DFC_VehVSigRR "Status of DFC / Status of diagnostic fault check DFC_VehVSigRR" UBYTE DFC_OneToOne 1 100 0.00 255.0 FORMAT "%5.1" ECU_ADDRESS 0x6003701B /end MEASUREMENT
/begin MEASUREMENT DFC_st.DFC_VehVSnsrARngHi "Status of DFC / Status of diagnostic fault check DFC_VehVSnsrARngHi" UBYTE DFC_OneToOne 1 100 0.00 255.0 FORMAT "%5.1" ECU_ADDRESS 0x6003701C /end MEASUREMENT
/begin MEASUREMENT DFC_st.DFC_VehVSnsrBRngHi "Status of DFC / Status of diagnostic fault check DFC_VehVSnsrBRngHi" UBYTE DFC_OneToOne 1 100 0.00 255.0 FORMAT "%5.1" ECU_ADDRESS 0x6003701D /end MEASUREMENT
/begin MEASUREMENT DFC_st.DFC_VehVSpdRtyDiag "Status of DFC / Status of diagnostic fault check DFC_VehVSpdRtyDiag" UBYTE DFC_OneToOne 1 100 0.00 255.0 FORMAT "%5.1" ECU_ADDRESS 0x6003701E /end MEASUREMENT
/begin MEASUREMENT DFC_st.DFC_DHFHD "Status of DFC / Status of diagnostic fault check DFC_DHFHD" UBYTE DFC_OneToOne 1 100 0.00 255.0 FORMAT "%5.1" ECU_ADDRESS 0x6003701F /end MEASUREMENT
/begin MEASUREMENT DFC_st.DFC_InjVlv_DI_DcDc "Status of DFC / Status of diagnostic fault check DFC_InjVlv_DI_DcDc" UBYTE DFC_OneToOne 1 100 0.00 255.0 FORMAT "%5.1" ECU_ADDRESS 0x60037020 /end MEASUREMENT
/begin MEASUREMENT DFC_st.DFC_InjVlv_DI_NoLd_0 "Status of DFC / Status of diagnostic fault check DFC_InjVlv_DI_NoLd_0" UBYTE DFC_OneToOne 1 100 0.00 255.0 FORMAT "%5.1" ECU_ADDRESS 0x60037021 /end MEASUREMENT
/begin MEASUREMENT DFC_st.DFC_InjVlv_DI_NoLd_1 "Status of DFC / Status of diagnostic fault check DFC_InjVlv_DI_NoLd_1" UBYTE DFC_OneToOne 1 100 0.00 255.0 FORMAT "%5.1" ECU_ADDRESS 0x60037022 /end MEASUREMENT
/begin MEASUREMENT DFC_st.DFC_InjVlv_DI_NoLd_2 "Status of DFC / Status of diagnostic fault check DFC_InjVlv_DI_NoLd_2" UBYTE DFC_OneToOne 1 100 0.00 255.0 FORMAT "%5.1" ECU_ADDRESS 0x60037023 /end MEASUREMENT
/begin MEASUREMENT DFC_st.DFC_InjVlv_DI_NoLd_3 "Status of DFC / Status of diagnostic fault check DFC_InjVlv_DI_NoLd_3" UBYTE DFC_OneToOne 1 100 0.00 255.0 FORMAT "%5.1" ECU_ADDRESS 0x60037024 /end MEASUREMENT
/begin MEASUREMENT DFC_st.DFC_InjVlv_DI_ScBnk_0 "Status of DFC / Status of diagnostic fault check DFC_InjVlv_DI_ScBnk_0" UBYTE DFC_OneToOne 1 100 0.00 255.0 FORMAT "%5.1" ECU_ADDRESS 0x60037025 /end MEASUREMENT
/begin MEASUREMENT DFC_st.DFC_InjVlv_DI_ScBnk_1 "Status of DFC / Status of diagnostic fault check DFC_InjVlv_DI_ScBnk_1" UBYTE DFC_OneToOne 1 100 0.00 255.0 FORMAT "%5.1" ECU_ADDRESS 0x60037026 /end MEASUREMENT
/begin MEASUREMENT DFC_st.DFC_InjVlv_DI_ScBnk_2 "Status of DFC / Status of diagnostic fault check DFC_InjVlv_DI_ScBnk_2" UBYTE DFC_OneToOne 1 100 0.00 255.0 FORMAT "%5.1" ECU_ADDRESS 0x60037027 /end MEASUREMENT
/begin MEASUREMENT DFC_st.DFC_InjVlv_DI_ScBnk_3 "Status of DFC / Status of diagnostic fault check DFC_InjVlv_DI_ScBnk_3" UBYTE DFC_OneToOne 1 100 0.00 255.0 FORMAT "%5.1" ECU_ADDRESS 0x60037028 /end MEASUREMENT
/begin MEASUREMENT DFC_st.DFC_InjVlv_DI_ScCyl_0 "Status of DFC / Status of diagnostic fault check DFC_InjVlv_DI_ScCyl_0" UBYTE DFC_OneToOne 1 100 0.00 255.0 FORMAT "%5.1" ECU_ADDRESS 0x60037029 /end MEASUREMENT
/begin MEASUREMENT DFC_st.DFC_InjVlv_DI_ScCyl_1 "Status of DFC / Status of diagnostic fault check DFC_InjVlv_DI_ScCyl_1" UBYTE DFC_OneToOne 1 100 0.00 255.0 FORMAT "%5.1" ECU_ADDRESS 0x6003702A /end MEASUREMENT
/begin MEASUREMENT DFC_st.DFC_InjVlv_DI_ScCyl_2 "Status of DFC / Status of diagnostic fault check DFC_InjVlv_DI_ScCyl_2" UBYTE DFC_OneToOne 1 100 0.00 255.0 FORMAT "%5.1" ECU_ADDRESS 0x6003702B /end MEASUREMENT
/begin MEASUREMENT DFC_st.DFC_InjVlv_DI_ScCyl_3 "Status of DFC / Status of diagnostic fault check DFC_InjVlv_DI_ScCyl_3" UBYTE DFC_OneToOne 1 100 0.00 255.0 FORMAT "%5.1" ECU_ADDRESS 0x6003702C /end MEASUREMENT
/begin MEASUREMENT DFC_st.DFC_InjVlv_DI_ScHsLs_0 "Status of DFC / Status of diagnostic fault check DFC_InjVlv_DI_ScHsLs_0" UBYTE DFC_OneToOne 1 100 0.00 255.0 FORMAT "%5.1" ECU_ADDRESS 0x6003702D /end MEASUREMENT
/begin MEASUREMENT DFC_st.DFC_InjVlv_DI_ScHsLs_1 "Status of DFC / Status of diagnostic fault check DFC_InjVlv_DI_ScHsLs_1" UBYTE DFC_OneToOne 1 100 0.00 255.0 FORMAT "%5.1" ECU_ADDRESS 0x6003702E /end MEASUREMENT
/begin MEASUREMENT DFC_st.DFC_InjVlv_DI_ScHsLs_2 "Status of DFC / Status of diagnostic fault check DFC_InjVlv_DI_ScHsLs_2" UBYTE DFC_OneToOne 1 100 0.00 255.0 FORMAT "%5.1" ECU_ADDRESS 0x6003702F /end MEASUREMENT
/begin MEASUREMENT DFC_st.DFC_InjVlv_DI_ScHsLs_3 "Status of DFC / Status of diagnostic fault check DFC_InjVlv_DI_ScHsLs_3" UBYTE DFC_OneToOne 1 100 0.00 255.0 FORMAT "%5.1" ECU_ADDRESS 0x60037030 /end MEASUREMENT
/begin MEASUREMENT DFC_st.DFC_MfPsDiaOpenLoad1 "Status of DFC / Status of diagnostic fault check DFC_MfPsDiaOpenLoad1" UBYTE DFC_OneToOne 1 100 0.00 255.0 FORMAT "%5.1" ECU_ADDRESS 0x60037031 /end MEASUREMENT
/begin MEASUREMENT DFC_st.DFC_MfPsDiaScHiS1 "Status of DFC / Status of diagnostic fault check DFC_MfPsDiaScHiS1" UBYTE DFC_OneToOne 1 100 0.00 255.0 FORMAT "%5.1" ECU_ADDRESS 0x60037032 /end MEASUREMENT
/begin MEASUREMENT DFC_st.DFC_MfPsDiaScHiSLowS1 "Status of DFC / Status of diagnostic fault check DFC_MfPsDiaScHiSLowS1" UBYTE DFC_OneToOne 1 100 0.00 255.0 FORMAT "%5.1" ECU_ADDRESS 0x60037033 /end MEASUREMENT
/begin MEASUREMENT DFC_st.DFC_MfPsDiaScLowS1 "Status of DFC / Status of diagnostic fault check DFC_MfPsDiaScLowS1" UBYTE DFC_OneToOne 1 100 0.00 255.0 FORMAT "%5.1" ECU_ADDRESS 0x60037034 /end MEASUREMENT
/begin MEASUREMENT DFC_st.DFC_ACEvpTPhysRngHi "Status of DFC / Status of diagnostic fault check DFC_ACEvpTPhysRngHi" UBYTE DFC_OneToOne 1 100 0.00 255.0 FORMAT "%5.1" ECU_ADDRESS 0x60037035 /end MEASUREMENT
/begin MEASUREMENT DFC_st.DFC_ACEvpTPhysRngLo "Status of DFC / Status of diagnostic fault check DFC_ACEvpTPhysRngLo" UBYTE DFC_OneToOne 1 100 0.00 255.0 FORMAT "%5.1" ECU_ADDRESS 0x60037036 /end MEASUREMENT
/begin MEASUREMENT DFC_st.DFC_ACEvpTSRCMax "Status of DFC / Status of diagnostic fault check DFC_ACEvpTSRCMax" UBYTE DFC_OneToOne 1 100 0.00 255.0 FORMAT "%5.1" ECU_ADDRESS 0x60037037 /end MEASUREMENT
/begin MEASUREMENT DFC_st.DFC_ACEvpTSRCMin "Status of DFC / Status of diagnostic fault check DFC_ACEvpTSRCMin" UBYTE DFC_OneToOne 1 100 0.00 255.0 FORMAT "%5.1" ECU_ADDRESS 0x60037038 /end MEASUREMENT
/begin MEASUREMENT DFC_st.DFC_AfsRawSigRngHiB1 "Status of DFC / Status of diagnostic fault check DFC_AfsRawSigRngHiB1" UBYTE DFC_OneToOne 1 100 0.00 255.0 FORMAT "%5.1" ECU_ADDRESS 0x60037039 /end MEASUREMENT
/begin MEASUREMENT DFC_st.DFC_AfsRawSigRngLoB1 "Status of DFC / Status of diagnostic fault check DFC_AfsRawSigRngLoB1" UBYTE DFC_OneToOne 1 100 0.00 255.0 FORMAT "%5.1" ECU_ADDRESS 0x6003703A /end MEASUREMENT
/begin MEASUREMENT DFC_st.DFC_AfsSnsrErrB1 "Status of DFC / Status of diagnostic fault check DFC_AfsSnsrErrB1" UBYTE DFC_OneToOne 1 100 0.00 255.0 FORMAT "%5.1" ECU_ADDRESS 0x6003703B /end MEASUREMENT
/begin MEASUREMENT DFC_st.DFC_AirCClntPAnaSRCMax "Status of DFC / Status of diagnostic fault check DFC_AirCClntPAnaSRCMax" UBYTE DFC_OneToOne 1 100 0.00 255.0 FORMAT "%5.1" ECU_ADDRESS 0x6003703C /end MEASUREMENT
/begin MEASUREMENT DFC_st.DFC_AirCClntPAnaSRCMin "Status of DFC / Status of diagnostic fault check DFC_AirCClntPAnaSRCMin" UBYTE DFC_OneToOne 1 100 0.00 255.0 FORMAT "%5.1" ECU_ADDRESS 0x6003703D /end MEASUREMENT
/begin MEASUREMENT DFC_st.DFC_AirCSwtNpl "Status of DFC / Status of diagnostic fault check DFC_AirCSwtNpl" UBYTE DFC_OneToOne 1 100 0.00 255.0 FORMAT "%5.1" ECU_ADDRESS 0x6003703E /end MEASUREMENT
/begin MEASUREMENT DFC_st.DFC_AirCSwtSig "Status of DFC / Status of diagnostic fault check DFC_AirCSwtSig" UBYTE DFC_OneToOne 1 100 0.00 255.0 FORMAT "%5.1" ECU_ADDRESS 0x6003703F /end MEASUREMENT
/begin MEASUREMENT DFC_st.DFC_Brk "Status of DFC / Status of diagnostic fault check DFC_Brk" UBYTE DFC_OneToOne 1 100 0.00 255.0 FORMAT "%5.1" ECU_ADDRESS 0x60037040 /end MEASUREMENT
/begin MEASUREMENT DFC_st.DFC_BrkBstSensSCB "Status of DFC / Status of diagnostic fault check DFC_BrkBstSensSCB" UBYTE DFC_OneToOne 1 100 0.00 255.0 FORMAT "%5.1" ECU_ADDRESS 0x60037041 /end MEASUREMENT
/begin MEASUREMENT DFC_st.DFC_BrkBstSensSCG "Status of DFC / Status of diagnostic fault check DFC_BrkBstSensSCG" UBYTE DFC_OneToOne 1 100 0.00 255.0 FORMAT "%5.1" ECU_ADDRESS 0x60037042 /end MEASUREMENT
/begin MEASUREMENT DFC_st.DFC_BrkSig "Status of DFC / Status of diagnostic fault check DFC_BrkSig" UBYTE DFC_OneToOne 1 100 0.00 255.0 FORMAT "%5.1" ECU_ADDRESS 0x60037043 /end MEASUREMENT
/begin MEASUREMENT DFC_st.DFC_ClthSig "Status of DFC / Status of diagnostic fault check DFC_ClthSig" UBYTE DFC_OneToOne 1 100 0.00 255.0 FORMAT "%5.1" ECU_ADDRESS 0x60037044 /end MEASUREMENT
/begin MEASUREMENT DFC_st.DFC_EGRVlvCurrLim "Status of DFC / Status of diagnostic fault check DFC_EGRVlvCurrLim" UBYTE DFC_OneToOne 1 100 0.00 255.0 FORMAT "%5.1" ECU_ADDRESS 0x60037045 /end MEASUREMENT
/begin MEASUREMENT DFC_st.DFC_EGRVlvOL "Status of DFC / Status of diagnostic fault check DFC_EGRVlvOL" UBYTE DFC_OneToOne 1 100 0.00 255.0 FORMAT "%5.1" ECU_ADDRESS 0x60037046 /end MEASUREMENT
/begin MEASUREMENT DFC_st.DFC_EGRVlvOvrTemp "Status of DFC / Status of diagnostic fault check DFC_EGRVlvOvrTemp" UBYTE DFC_OneToOne 1 100 0.00 255.0 FORMAT "%5.1" ECU_ADDRESS 0x60037047 /end MEASUREMENT
/begin MEASUREMENT DFC_st.DFC_EGRVlvSCB "Status of DFC / Status of diagnostic fault check DFC_EGRVlvSCB" UBYTE DFC_OneToOne 1 100 0.00 255.0 FORMAT "%5.1" ECU_ADDRESS 0x60037048 /end MEASUREMENT
/begin MEASUREMENT DFC_st.DFC_EGRVlvSCG "Status of DFC / Status of diagnostic fault check DFC_EGRVlvSCG" UBYTE DFC_OneToOne 1 100 0.00 255.0 FORMAT "%5.1" ECU_ADDRESS 0x60037049 /end MEASUREMENT
/begin MEASUREMENT DFC_st.DFC_EGRVlvSRCMax "Status of DFC / Status of diagnostic fault check DFC_EGRVlvSRCMax" UBYTE DFC_OneToOne 1 100 0.00 255.0 FORMAT "%5.1" ECU_ADDRESS 0x6003704A /end MEASUREMENT
/begin MEASUREMENT DFC_st.DFC_EGRVlvSRCMin "Status of DFC / Status of diagnostic fault check DFC_EGRVlvSRCMin" UBYTE DFC_OneToOne 1 100 0.00 255.0 FORMAT "%5.1" ECU_ADDRESS 0x6003704B /end MEASUREMENT
/begin MEASUREMENT DFC_st.DFC_HLSDemOvhtEngLim "Status of DFC / Status of diagnostic fault check DFC_HLSDemOvhtEngLim" UBYTE DFC_OneToOne 1 100 0.00 255.0 FORMAT "%5.1" ECU_ADDRESS 0x6003704C /end MEASUREMENT
/begin MEASUREMENT DFC_st.DFC_OilPSwmpSRCMax "Status of DFC / Status of diagnostic fault check DFC_OilPSwmpSRCMax" UBYTE DFC_OneToOne 1 100 0.00 255.0 FORMAT "%5.1" ECU_ADDRESS 0x6003704D /end MEASUREMENT
/begin MEASUREMENT DFC_st.DFC_OilPSwmpSRCMin "Status of DFC / Status of diagnostic fault check DFC_OilPSwmpSRCMin" UBYTE DFC_OneToOne 1 100 0.00 255.0 FORMAT "%5.1" ECU_ADDRESS 0x6003704E /end MEASUREMENT
/begin MEASUREMENT DFC_st.DFC_PIntkVUsLineHiB1 "Status of DFC / Status of diagnostic fault check DFC_PIntkVUsLineHiB1" UBYTE DFC_OneToOne 1 100 0.00 255.0 FORMAT "%5.1" ECU_ADDRESS 0x6003704F /end MEASUREMENT
/begin MEASUREMENT DFC_st.DFC_PIntkVUsLineLoB1 "Status of DFC / Status of diagnostic fault check DFC_PIntkVUsLineLoB1" UBYTE DFC_OneToOne 1 100 0.00 255.0 FORMAT "%5.1" ECU_ADDRESS 0x60037050 /end MEASUREMENT
/begin MEASUREMENT DFC_st.DFC_VehVPhysRngLo "Status of DFC / Status of diagnostic fault check DFC_VehVPhysRngLo" UBYTE DFC_OneToOne 1 100 0.00 255.0 FORMAT "%5.1" ECU_ADDRESS 0x60037051 /end MEASUREMENT
/begin MEASUREMENT DFC_st.DFC_VehVSigCan "Status of DFC / Status of diagnostic fault check DFC_VehVSigCan" UBYTE DFC_OneToOne 1 100 0.00 255.0 FORMAT "%5.1" ECU_ADDRESS 0x60037052 /end MEASUREMENT
/begin MEASUREMENT DFC_st.DFC_VehVSigCanSafe "Status of DFC / Status of diagnostic fault check DFC_VehVSigCanSafe" UBYTE DFC_OneToOne 1 100 0.00 255.0 FORMAT "%5.1" ECU_ADDRESS 0x60037053 /end MEASUREMENT
/begin MEASUREMENT DFC_st.DFC_VlvLftFbOilPSnsrIntk11SRCMax "Status of DFC / Status of diagnostic fault check DFC_VlvLftFbOilPSnsrIntk11SRCMax" UBYTE DFC_OneToOne 1 100 0.00 255.0 FORMAT "%5.1" ECU_ADDRESS 0x60037054 /end MEASUREMENT
/begin MEASUREMENT DFC_st.DFC_VlvLftFbOilPSnsrIntk11SRCMin "Status of DFC / Status of diagnostic fault check DFC_VlvLftFbOilPSnsrIntk11SRCMin" UBYTE DFC_OneToOne 1 100 0.00 255.0 FORMAT "%5.1" ECU_ADDRESS 0x60037055 /end MEASUREMENT
/begin MEASUREMENT DFC_st.DFC_ClthNpl "Status of DFC / Status of diagnostic fault check DFC_ClthNpl" UBYTE DFC_OneToOne 1 100 0.00 255.0 FORMAT "%5.1" ECU_ADDRESS 0x60037056 /end MEASUREMENT
/begin MEASUREMENT DFC_st.DFC_GbxPNPosnDrvCdn "Status of DFC / Status of diagnostic fault check DFC_GbxPNPosnDrvCdn" UBYTE DFC_OneToOne 1 100 0.00 255.0 FORMAT "%5.1" ECU_ADDRESS 0x60037057 /end MEASUREMENT
/begin MEASUREMENT DFC_st.DFC_GbxPNPosnPlausy "Status of DFC / Status of diagnostic fault check DFC_GbxPNPosnPlausy" UBYTE DFC_OneToOne 1 100 0.00 255.0 FORMAT "%5.1" ECU_ADDRESS 0x60037058 /end MEASUREMENT
/begin MEASUREMENT DFC_st.DFC_AfsSigErrLineHiB1 "Status of DFC / Status of diagnostic fault check DFC_AfsSigErrLineHiB1" UBYTE DFC_OneToOne 1 100 0.00 255.0 FORMAT "%5.1" ECU_ADDRESS 0x60037059 /end MEASUREMENT
/begin MEASUREMENT DFC_st.DFC_AfsSigErrLineLoB1 "Status of DFC / Status of diagnostic fault check DFC_AfsSigErrLineLoB1" UBYTE DFC_OneToOne 1 100 0.00 255.0 FORMAT "%5.1" ECU_ADDRESS 0x6003705A /end MEASUREMENT
/begin MEASUREMENT DFC_st.DFC_PEnvCcMax "Status of DFC / Status of diagnostic fault check DFC_PEnvCcMax" UBYTE DFC_OneToOne 1 100 0.00 255.0 FORMAT "%5.1" ECU_ADDRESS 0x6003705B /end MEASUREMENT
/begin MEASUREMENT DFC_st.DFC_PEnvCcMin "Status of DFC / Status of diagnostic fault check DFC_PEnvCcMin" UBYTE DFC_OneToOne 1 100 0.00 255.0 FORMAT "%5.1" ECU_ADDRESS 0x6003705C /end MEASUREMENT
/begin MEASUREMENT DFC_st.DFC_PEnvRngChkMax "Status of DFC / Status of diagnostic fault check DFC_PEnvRngChkMax" UBYTE DFC_OneToOne 1 100 0.00 255.0 FORMAT "%5.1" ECU_ADDRESS 0x6003705D /end MEASUREMENT
/begin MEASUREMENT DFC_st.DFC_PEnvRngChkMin "Status of DFC / Status of diagnostic fault check DFC_PEnvRngChkMin" UBYTE DFC_OneToOne 1 100 0.00 255.0 FORMAT "%5.1" ECU_ADDRESS 0x6003705E /end MEASUREMENT
/begin MEASUREMENT DFC_st.DFC_PEnvSnsrPlaus "Status of DFC / Status of diagnostic fault check DFC_PEnvSnsrPlaus" UBYTE DFC_OneToOne 1 100 0.00 255.0 FORMAT "%5.1" ECU_ADDRESS 0x6003705F /end MEASUREMENT
/begin MEASUREMENT DFC_st.DFC_UEGOHeatrRlyPsOLS1B1 "Status of DFC / Status of diagnostic fault check DFC_UEGOHeatrRlyPsOLS1B1" UBYTE DFC_OneToOne 1 100 0.00 255.0 FORMAT "%5.1" ECU_ADDRESS 0x60037060 /end MEASUREMENT
/begin MEASUREMENT DFC_st.DFC_UEGOHeatrRlyPsSCBS1B1 "Status of DFC / Status of diagnostic fault check DFC_UEGOHeatrRlyPsSCBS1B1" UBYTE DFC_OneToOne 1 100 0.00 255.0 FORMAT "%5.1" ECU_ADDRESS 0x60037061 /end MEASUREMENT
/begin MEASUREMENT DFC_st.DFC_UEGOHeatrRlyPsSCGS1B1 "Status of DFC / Status of diagnostic fault check DFC_UEGOHeatrRlyPsSCGS1B1" UBYTE DFC_OneToOne 1 100 0.00 255.0 FORMAT "%5.1" ECU_ADDRESS 0x60037062 /end MEASUREMENT
/begin MEASUREMENT DFC_st.DFC_UegoHeatrWireOlS1B1 "Status of DFC / Status of diagnostic fault check DFC_UegoHeatrWireOlS1B1" UBYTE DFC_OneToOne 1 100 0.00 255.0 FORMAT "%5.1" ECU_ADDRESS 0x60037063 /end MEASUREMENT
/begin MEASUREMENT DFC_st.DFC_UegoHeatrWireScbS1B1 "Status of DFC / Status of diagnostic fault check DFC_UegoHeatrWireScbS1B1" UBYTE DFC_OneToOne 1 100 0.00 255.0 FORMAT "%5.1" ECU_ADDRESS 0x60037064 /end MEASUREMENT
/begin MEASUREMENT DFC_st.DFC_UegoHeatrWireScgS1B1 "Status of DFC / Status of diagnostic fault check DFC_UegoHeatrWireScgS1B1" UBYTE DFC_OneToOne 1 100 0.00 255.0 FORMAT "%5.1" ECU_ADDRESS 0x60037065 /end MEASUREMENT
/begin MEASUREMENT DFC_st.DFC_KnDetSens1PortAMax "Status of DFC / Status of diagnostic fault check DFC_KnDetSens1PortAMax" UBYTE DFC_OneToOne 1 100 0.00 255.0 FORMAT "%5.1" ECU_ADDRESS 0x60037066 /end MEASUREMENT
/begin MEASUREMENT DFC_st.DFC_KnDetSens1PortAMin "Status of DFC / Status of diagnostic fault check DFC_KnDetSens1PortAMin" UBYTE DFC_OneToOne 1 100 0.00 255.0 FORMAT "%5.1" ECU_ADDRESS 0x60037067 /end MEASUREMENT
/begin MEASUREMENT DFC_st.DFC_KnDetSens1PortBMax "Status of DFC / Status of diagnostic fault check DFC_KnDetSens1PortBMax" UBYTE DFC_OneToOne 1 100 0.00 255.0 FORMAT "%5.1" ECU_ADDRESS 0x60037068 /end MEASUREMENT
/begin MEASUREMENT DFC_st.DFC_KnDetSens1PortBMin "Status of DFC / Status of diagnostic fault check DFC_KnDetSens1PortBMin" UBYTE DFC_OneToOne 1 100 0.00 255.0 FORMAT "%5.1" ECU_ADDRESS 0x60037069 /end MEASUREMENT
/begin MEASUREMENT DFC_st.DFC_Clth2ONStuck "Status of DFC / Status of diagnostic fault check DFC_Clth2ONStuck" UBYTE DFC_OneToOne 1 100 0.00 255.0 FORMAT "%5.1" ECU_ADDRESS 0x6003706A /end MEASUREMENT
/begin MEASUREMENT DFC_st.DFC_Clth2ONStuckLdc "Status of DFC / Status of diagnostic fault check DFC_Clth2ONStuckLdc" UBYTE DFC_OneToOne 1 100 0.00 255.0 FORMAT "%5.1" ECU_ADDRESS 0x6003706B /end MEASUREMENT
/begin MEASUREMENT DFC_st.DFC_Clth3ONStuckLdc "Status of DFC / Status of diagnostic fault check DFC_Clth3ONStuckLdc" UBYTE DFC_OneToOne 1 100 0.00 255.0 FORMAT "%5.1" ECU_ADDRESS 0x6003706C /end MEASUREMENT
/begin MEASUREMENT DFC_st.DFC_Clth3ONStuckPostDrv "Status of DFC / Status of diagnostic fault check DFC_Clth3ONStuckPostDrv" UBYTE DFC_OneToOne 1 100 0.00 255.0 FORMAT "%5.1" ECU_ADDRESS 0x6003706D /end MEASUREMENT
/begin MEASUREMENT DFC_st.DFC_Clth4ONStuck "Status of DFC / Status of diagnostic fault check DFC_Clth4ONStuck" UBYTE DFC_OneToOne 1 100 0.00 255.0 FORMAT "%5.1" ECU_ADDRESS 0x6003706E /end MEASUREMENT
/begin MEASUREMENT DFC_st.DFC_Clth4ONStuckLdc "Status of DFC / Status of diagnostic fault check DFC_Clth4ONStuckLdc" UBYTE DFC_OneToOne 1 100 0.00 255.0 FORMAT "%5.1" ECU_ADDRESS 0x6003706F /end MEASUREMENT
/begin MEASUREMENT DFC_st.DFC_ComBCMUnit "Status of DFC / Status of diagnostic fault check DFC_ComBCMUnit" UBYTE DFC_OneToOne 1 100 0.00 255.0 FORMAT "%5.1" ECU_ADDRESS 0x60037070 /end MEASUREMENT
/begin MEASUREMENT DFC_st.DFC_ComDLCTCU01 "Status of DFC / Status of diagnostic fault check DFC_ComDLCTCU01" UBYTE DFC_OneToOne 1 100 0.00 255.0 FORMAT "%5.1" ECU_ADDRESS 0x60037071 /end MEASUREMENT
/begin MEASUREMENT DFC_st.DFC_ComDLCTCU02 "Status of DFC / Status of diagnostic fault check DFC_ComDLCTCU02" UBYTE DFC_OneToOne 1 100 0.00 255.0 FORMAT "%5.1" ECU_ADDRESS 0x60037072 /end MEASUREMENT
/begin MEASUREMENT DFC_st.DFC_ComDLCTCU1 "Status of DFC / Status of diagnostic fault check DFC_ComDLCTCU1" UBYTE DFC_OneToOne 1 100 0.00 255.0 FORMAT "%5.1" ECU_ADDRESS 0x60037073 /end MEASUREMENT
/begin MEASUREMENT DFC_st.DFC_ComDLCTCU11 "Status of DFC / Status of diagnostic fault check DFC_ComDLCTCU11" UBYTE DFC_OneToOne 1 100 0.00 255.0 FORMAT "%5.1" ECU_ADDRESS 0x60037074 /end MEASUREMENT
/begin MEASUREMENT DFC_st.DFC_ComDLCTCU12 "Status of DFC / Status of diagnostic fault check DFC_ComDLCTCU12" UBYTE DFC_OneToOne 1 100 0.00 255.0 FORMAT "%5.1" ECU_ADDRESS 0x60037075 /end MEASUREMENT
/begin MEASUREMENT DFC_st.DFC_ComDLCTCU13 "Status of DFC / Status of diagnostic fault check DFC_ComDLCTCU13" UBYTE DFC_OneToOne 1 100 0.00 255.0 FORMAT "%5.1" ECU_ADDRESS 0x60037076 /end MEASUREMENT
/begin MEASUREMENT DFC_st.DFC_ComDLCTCU14 "Status of DFC / Status of diagnostic fault check DFC_ComDLCTCU14" UBYTE DFC_OneToOne 1 100 0.00 255.0 FORMAT "%5.1" ECU_ADDRESS 0x60037077 /end MEASUREMENT
/begin MEASUREMENT DFC_st.DFC_ComDLCTCU2 "Status of DFC / Status of diagnostic fault check DFC_ComDLCTCU2" UBYTE DFC_OneToOne 1 100 0.00 255.0 FORMAT "%5.1" ECU_ADDRESS 0x60037078 /end MEASUREMENT
/begin MEASUREMENT DFC_st.DFC_ComDLCTCU3 "Status of DFC / Status of diagnostic fault check DFC_ComDLCTCU3" UBYTE DFC_OneToOne 1 100 0.00 255.0 FORMAT "%5.1" ECU_ADDRESS 0x60037079 /end MEASUREMENT
/begin MEASUREMENT DFC_st.DFC_ComDLCTCU4 "Status of DFC / Status of diagnostic fault check DFC_ComDLCTCU4" UBYTE DFC_OneToOne 1 100 0.00 255.0 FORMAT "%5.1" ECU_ADDRESS 0x6003707A /end MEASUREMENT
/begin MEASUREMENT DFC_st.DFC_ComEPSUnit "Status of DFC / Status of diagnostic fault check DFC_ComEPSUnit" UBYTE DFC_OneToOne 1 100 0.00 255.0 FORMAT "%5.1" ECU_ADDRESS 0x6003707B /end MEASUREMENT
/begin MEASUREMENT DFC_st.DFC_ComIDASBUnit "Status of DFC / Status of diagnostic fault check DFC_ComIDASBUnit" UBYTE DFC_OneToOne 1 100 0.00 255.0 FORMAT "%5.1" ECU_ADDRESS 0x6003707C /end MEASUREMENT
/begin MEASUREMENT DFC_st.DFC_ComIMGUnit "Status of DFC / Status of diagnostic fault check DFC_ComIMGUnit" UBYTE DFC_OneToOne 1 100 0.00 255.0 FORMAT "%5.1" ECU_ADDRESS 0x6003707D /end MEASUREMENT
/begin MEASUREMENT DFC_st.DFC_ComMETUnit "Status of DFC / Status of diagnostic fault check DFC_ComMETUnit" UBYTE DFC_OneToOne 1 100 0.00 255.0 FORMAT "%5.1" ECU_ADDRESS 0x6003707E /end MEASUREMENT
/begin MEASUREMENT DFC_st.DFC_ComSRSUnit "Status of DFC / Status of diagnostic fault check DFC_ComSRSUnit" UBYTE DFC_OneToOne 1 100 0.00 255.0 FORMAT "%5.1" ECU_ADDRESS 0x6003707F /end MEASUREMENT
/begin MEASUREMENT DFC_st.DFC_ComVSAUnit "Status of DFC / Status of diagnostic fault check DFC_ComVSAUnit" UBYTE DFC_OneToOne 1 100 0.00 255.0 FORMAT "%5.1" ECU_ADDRESS 0x60037080 /end MEASUREMENT
/begin MEASUREMENT DFC_st.DFC_EbsSocFlt "Status of DFC / Status of diagnostic fault check DFC_EbsSocFlt" UBYTE DFC_OneToOne 1 100 0.00 255.0 FORMAT "%5.1" ECU_ADDRESS 0x60037081 /end MEASUREMENT
/begin MEASUREMENT DFC_st.DFC_I14229VINErr "Status of DFC / Status of diagnostic fault check DFC_I14229VINErr" UBYTE DFC_OneToOne 1 100 0.00 255.0 FORMAT "%5.1" ECU_ADDRESS 0x60037082 /end MEASUREMENT
/begin MEASUREMENT DFC_st.DFC_InjCatHeatgErr "Status of DFC / Status of diagnostic fault check DFC_InjCatHeatgErr" UBYTE DFC_OneToOne 1 100 0.00 255.0 FORMAT "%5.1" ECU_ADDRESS 0x60037083 /end MEASUREMENT
/begin MEASUREMENT DFC_st.DFC_InjSysMulInjDiagErr "Status of DFC / Status of diagnostic fault check DFC_InjSysMulInjDiagErr" UBYTE DFC_OneToOne 1 100 0.00 255.0 FORMAT "%5.1" ECU_ADDRESS 0x60037084 /end MEASUREMENT
/begin MEASUREMENT DFC_st.DFC_LLRHmax "Status of DFC / Status of diagnostic fault check DFC_LLRHmax" UBYTE DFC_OneToOne 1 100 0.00 255.0 FORMAT "%5.1" ECU_ADDRESS 0x60037085 /end MEASUREMENT
/begin MEASUREMENT DFC_st.DFC_LLRHmin "Status of DFC / Status of diagnostic fault check DFC_LLRHmin" UBYTE DFC_OneToOne 1 100 0.00 255.0 FORMAT "%5.1" ECU_ADDRESS 0x60037086 /end MEASUREMENT
/begin MEASUREMENT DFC_st.DFC_LLRHnpl "Status of DFC / Status of diagnostic fault check DFC_LLRHnpl" UBYTE DFC_OneToOne 1 100 0.00 255.0 FORMAT "%5.1" ECU_ADDRESS 0x60037087 /end MEASUREMENT
/begin MEASUREMENT DFC_st.DFC_LLRKHmax "Status of DFC / Status of diagnostic fault check DFC_LLRKHmax" UBYTE DFC_OneToOne 1 100 0.00 255.0 FORMAT "%5.1" ECU_ADDRESS 0x60037088 /end MEASUREMENT
/begin MEASUREMENT DFC_st.DFC_LLRKHmin "Status of DFC / Status of diagnostic fault check DFC_LLRKHmin" UBYTE DFC_OneToOne 1 100 0.00 255.0 FORMAT "%5.1" ECU_ADDRESS 0x60037089 /end MEASUREMENT
/begin MEASUREMENT DFC_st.DFC_LLRKHnpl "Status of DFC / Status of diagnostic fault check DFC_LLRKHnpl" UBYTE DFC_OneToOne 1 100 0.00 255.0 FORMAT "%5.1" ECU_ADDRESS 0x6003708A /end MEASUREMENT
/begin MEASUREMENT DFC_st.DFC_LinACGUnit "Status of DFC / Status of diagnostic fault check DFC_LinACGUnit" UBYTE DFC_OneToOne 1 100 0.00 255.0 FORMAT "%5.1" ECU_ADDRESS 0x6003708B /end MEASUREMENT
/begin MEASUREMENT DFC_st.DFC_LinAEVUnit "Status of DFC / Status of diagnostic fault check DFC_LinAEVUnit" UBYTE DFC_OneToOne 1 100 0.00 255.0 FORMAT "%5.1" ECU_ADDRESS 0x6003708C /end MEASUREMENT
/begin MEASUREMENT DFC_st.DFC_LinEBSUnit "Status of DFC / Status of diagnostic fault check DFC_LinEBSUnit" UBYTE DFC_OneToOne 1 100 0.00 255.0 FORMAT "%5.1" ECU_ADDRESS 0x6003708D /end MEASUREMENT
/begin MEASUREMENT DFC_st.DFC_RoughRoad "Status of DFC / Status of diagnostic fault check DFC_RoughRoad" UBYTE DFC_OneToOne 1 100 0.00 255.0 FORMAT "%5.1" ECU_ADDRESS 0x6003708E /end MEASUREMENT
/begin MEASUREMENT DFC_st.DFC_SiaEEPRdErr "Status of DFC / Status of diagnostic fault check DFC_SiaEEPRdErr" UBYTE DFC_OneToOne 1 100 0.00 255.0 FORMAT "%5.1" ECU_ADDRESS 0x6003708F /end MEASUREMENT
/begin MEASUREMENT DFC_st.DFC_SiaEEPWrngCod "Status of DFC / Status of diagnostic fault check DFC_SiaEEPWrngCod" UBYTE DFC_OneToOne 1 100 0.00 255.0 FORMAT "%5.1" ECU_ADDRESS 0x60037090 /end MEASUREMENT
/begin MEASUREMENT DFC_st.DFC_UegoHeatrStrtS1B1 "Status of DFC / Status of diagnostic fault check DFC_UegoHeatrStrtS1B1" UBYTE DFC_OneToOne 1 100 0.00 255.0 FORMAT "%5.1" ECU_ADDRESS 0x60037091 /end MEASUREMENT
/begin MEASUREMENT DFC_st.DFC_BusDiagCANAPPLBusOff "Status of DFC / Status of diagnostic fault check DFC_BusDiagCANAPPLBusOff" UBYTE DFC_OneToOne 1 100 0.00 255.0 FORMAT "%5.1" ECU_ADDRESS 0x60037092 /end MEASUREMENT
/begin MEASUREMENT DFC_st.DFC_BusDiagCANCANCBusOff "Status of DFC / Status of diagnostic fault check DFC_BusDiagCANCANCBusOff" UBYTE DFC_OneToOne 1 100 0.00 255.0 FORMAT "%5.1" ECU_ADDRESS 0x60037093 /end MEASUREMENT
/begin MEASUREMENT DFC_st.DFC_BusDiagCANVEHICLEBusOff "Status of DFC / Status of diagnostic fault check DFC_BusDiagCANVEHICLEBusOff" UBYTE DFC_OneToOne 1 100 0.00 255.0 FORMAT "%5.1" ECU_ADDRESS 0x60037094 /end MEASUREMENT
/begin MEASUREMENT DFC_st.DFC_RBA_IODIAGPWR_rba_IoExtCy329_SignalVltSply_0 "Status of DFC / Status of diagnostic fault check DFC_RBA_IODIAGPWR_rba_IoExtCy329_SignalVltSply_0" UBYTE DFC_OneToOne 1 100 0.00 255.0 FORMAT "%5.1" ECU_ADDRESS 0x60037095 /end MEASUREMENT
/begin MEASUREMENT DFC_st.DFC_RBA_IODIAGPWR_rba_IoExtCy329_SignalVltSply_0OT "Status of DFC / Status of diagnostic fault check DFC_RBA_IODIAGPWR_rba_IoExtCy329_SignalVltSply_0OT" UBYTE DFC_OneToOne 1 100 0.00 255.0 FORMAT "%5.1" ECU_ADDRESS 0x60037096 /end MEASUREMENT
/begin MEASUREMENT DFC_st.DFC_RBA_IODIAGPWR_rba_IoExtCy329_SignalVltSply_0OV "Status of DFC / Status of diagnostic fault check DFC_RBA_IODIAGPWR_rba_IoExtCy329_SignalVltSply_0OV" UBYTE DFC_OneToOne 1 100 0.00 255.0 FORMAT "%5.1" ECU_ADDRESS 0x60037097 /end MEASUREMENT
/begin MEASUREMENT DFC_st.DFC_RBA_IODIAGPWR_rba_IoExtCy329_SignalVltSply_0SCG "Status of DFC / Status of diagnostic fault check DFC_RBA_IODIAGPWR_rba_IoExtCy329_SignalVltSply_0SCG" UBYTE DFC_OneToOne 1 100 0.00 255.0 FORMAT "%5.1" ECU_ADDRESS 0x60037098 /end MEASUREMENT
/begin MEASUREMENT DFC_st.DFC_RBA_IODIAGPWR_rba_IoExtCy329_SignalVltSply_0UV "Status of DFC / Status of diagnostic fault check DFC_RBA_IODIAGPWR_rba_IoExtCy329_SignalVltSply_0UV" UBYTE DFC_OneToOne 1 100 0.00 255.0 FORMAT "%5.1" ECU_ADDRESS 0x60037099 /end MEASUREMENT
/begin MEASUREMENT DFC_st.DFC_RBA_IODIAGPWR_rba_IoExtCy329_SignalVltSply_1 "Status of DFC / Status of diagnostic fault check DFC_RBA_IODIAGPWR_rba_IoExtCy329_SignalVltSply_1" UBYTE DFC_OneToOne 1 100 0.00 255.0 FORMAT "%5.1" ECU_ADDRESS 0x6003709A /end MEASUREMENT
/begin MEASUREMENT DFC_st.DFC_RBA_IODIAGPWR_rba_IoExtCy329_SignalVltSply_1OT "Status of DFC / Status of diagnostic fault check DFC_RBA_IODIAGPWR_rba_IoExtCy329_SignalVltSply_1OT" UBYTE DFC_OneToOne 1 100 0.00 255.0 FORMAT "%5.1" ECU_ADDRESS 0x6003709B /end MEASUREMENT
/begin MEASUREMENT DFC_st.DFC_RBA_IODIAGPWR_rba_IoExtCy329_SignalVltSply_1OV "Status of DFC / Status of diagnostic fault check DFC_RBA_IODIAGPWR_rba_IoExtCy329_SignalVltSply_1OV" UBYTE DFC_OneToOne 1 100 0.00 255.0 FORMAT "%5.1" ECU_ADDRESS 0x6003709C /end MEASUREMENT
/begin MEASUREMENT DFC_st.DFC_RBA_IODIAGPWR_rba_IoExtCy329_SignalVltSply_1SCG "Status of DFC / Status of diagnostic fault check DFC_RBA_IODIAGPWR_rba_IoExtCy329_SignalVltSply_1SCG" UBYTE DFC_OneToOne 1 100 0.00 255.0 FORMAT "%5.1" ECU_ADDRESS 0x6003709D /end MEASUREMENT
/begin MEASUREMENT DFC_st.DFC_RBA_IODIAGPWR_rba_IoExtCy329_SignalVltSply_1UV "Status of DFC / Status of diagnostic fault check DFC_RBA_IODIAGPWR_rba_IoExtCy329_SignalVltSply_1UV" UBYTE DFC_OneToOne 1 100 0.00 255.0 FORMAT "%5.1" ECU_ADDRESS 0x6003709E /end MEASUREMENT
/begin MEASUREMENT DFC_st.DFC_RBA_IODIAGPWR_rba_IoExtCy329_SignalVltSply_2 "Status of DFC / Status of diagnostic fault check DFC_RBA_IODIAGPWR_rba_IoExtCy329_SignalVltSply_2" UBYTE DFC_OneToOne 1 100 0.00 255.0 FORMAT "%5.1" ECU_ADDRESS 0x6003709F /end MEASUREMENT
/begin MEASUREMENT DFC_st.DFC_RBA_IODIAGPWR_rba_IoExtCy329_SignalVltSply_2OT "Status of DFC / Status of diagnostic fault check DFC_RBA_IODIAGPWR_rba_IoExtCy329_SignalVltSply_2OT" UBYTE DFC_OneToOne 1 100 0.00 255.0 FORMAT "%5.1" ECU_ADDRESS 0x600370A0 /end MEASUREMENT
/begin MEASUREMENT DFC_st.DFC_RBA_IODIAGPWR_rba_IoExtCy329_SignalVltSply_2OV "Status of DFC / Status of diagnostic fault check DFC_RBA_IODIAGPWR_rba_IoExtCy329_SignalVltSply_2OV" UBYTE DFC_OneToOne 1 100 0.00 255.0 FORMAT "%5.1" ECU_ADDRESS 0x600370A1 /end MEASUREMENT
/begin MEASUREMENT DFC_st.DFC_RBA_IODIAGPWR_rba_IoExtCy329_SignalVltSply_2SCG "Status of DFC / Status of diagnostic fault check DFC_RBA_IODIAGPWR_rba_IoExtCy329_SignalVltSply_2SCG" UBYTE DFC_OneToOne 1 100 0.00 255.0 FORMAT "%5.1" ECU_ADDRESS 0x600370A2 /end MEASUREMENT
/begin MEASUREMENT DFC_st.DFC_RBA_IODIAGPWR_rba_IoExtCy329_SignalVltSply_2UV "Status of DFC / Status of diagnostic fault check DFC_RBA_IODIAGPWR_rba_IoExtCy329_SignalVltSply_2UV" UBYTE DFC_OneToOne 1 100 0.00 255.0 FORMAT "%5.1" ECU_ADDRESS 0x600370A3 /end MEASUREMENT
/begin MEASUREMENT DFC_st.DFC_CAN_E_TIMEOUT "Status of DFC / Status of diagnostic fault check DFC_CAN_E_TIMEOUT" UBYTE DFC_OneToOne 1 100 0.00 255.0 FORMAT "%5.1" ECU_ADDRESS 0x600370A4 /end MEASUREMENT
/begin MEASUREMENT DFC_st.DFC_LIN_E_TIMEOUT "Status of DFC / Status of diagnostic fault check DFC_LIN_E_TIMEOUT" UBYTE DFC_OneToOne 1 100 0.00 255.0 FORMAT "%5.1" ECU_ADDRESS 0x600370A5 /end MEASUREMENT
/begin MEASUREMENT DFC_st.DFC_MRlyOL "Status of DFC / Status of diagnostic fault check DFC_MRlyOL" UBYTE DFC_OneToOne 1 100 0.00 255.0 FORMAT "%5.1" ECU_ADDRESS 0x600370A6 /end MEASUREMENT
/begin MEASUREMENT DFC_st.DFC_MRlySCB "Status of DFC / Status of diagnostic fault check DFC_MRlySCB" UBYTE DFC_OneToOne 1 100 0.00 255.0 FORMAT "%5.1" ECU_ADDRESS 0x600370A7 /end MEASUREMENT
/begin MEASUREMENT DFC_st.DFC_MRlySCG "Status of DFC / Status of diagnostic fault check DFC_MRlySCG" UBYTE DFC_OneToOne 1 100 0.00 255.0 FORMAT "%5.1" ECU_ADDRESS 0x600370A8 /end MEASUREMENT
/begin MEASUREMENT DFC_st.DFC_rba_MultiStackTrace_Threshold "Status of DFC / Status of diagnostic fault check DFC_rba_MultiStackTrace_Threshold" UBYTE DFC_OneToOne 1 100 0.00 255.0 FORMAT "%5.1" ECU_ADDRESS 0x600370A9 /end MEASUREMENT
/begin MEASUREMENT DFC_st.DFC_BSWM_E_ACTION_FAILED "Status of DFC / Status of diagnostic fault check DFC_BSWM_E_ACTION_FAILED" UBYTE DFC_OneToOne 1 100 0.00 255.0 FORMAT "%5.1" ECU_ADDRESS 0x600370AA /end MEASUREMENT
/begin MEASUREMENT DFC_st.DFC_BSWM_E_INTRPTQUEUE_FULL "Status of DFC / Status of diagnostic fault check DFC_BSWM_E_INTRPTQUEUE_FULL" UBYTE DFC_OneToOne 1 100 0.00 255.0 FORMAT "%5.1" ECU_ADDRESS 0x600370AB /end MEASUREMENT
/begin MEASUREMENT DFC_st.DFC_RBA_IOEXTLIB_KEEPALIVE_DRV "Status of DFC / Status of diagnostic fault check DFC_RBA_IOEXTLIB_KEEPALIVE_DRV" UBYTE DFC_OneToOne 1 100 0.00 255.0 FORMAT "%5.1" ECU_ADDRESS 0x600370AC /end MEASUREMENT
/begin MEASUREMENT DFC_st.DFC_RBA_IOEXTLIB_KEEPALIVE_INI "Status of DFC / Status of diagnostic fault check DFC_RBA_IOEXTLIB_KEEPALIVE_INI" UBYTE DFC_OneToOne 1 100 0.00 255.0 FORMAT "%5.1" ECU_ADDRESS 0x600370AD /end MEASUREMENT
/begin MEASUREMENT DFC_st.DFC_rba_IoSigRtc_StopCounter "Status of DFC / Status of diagnostic fault check DFC_rba_IoSigRtc_StopCounter" UBYTE DFC_OneToOne 1 100 0.00 255.0 FORMAT "%5.1" ECU_ADDRESS 0x600370AE /end MEASUREMENT
/begin MEASUREMENT DFC_st.DFC_rba_MRly_Diag_Stk_Event "Status of DFC / Status of diagnostic fault check DFC_rba_MRly_Diag_Stk_Event" UBYTE DFC_OneToOne 1 100 0.00 255.0 FORMAT "%5.1" ECU_ADDRESS 0x600370AF /end MEASUREMENT
/begin MEASUREMENT DFC_st.DFC_rba_MemDiag_MemReadErr "Status of DFC / Status of diagnostic fault check DFC_rba_MemDiag_MemReadErr" UBYTE DFC_OneToOne 1 100 0.00 255.0 FORMAT "%5.1" ECU_ADDRESS 0x600370B0 /end MEASUREMENT
/begin MEASUREMENT DFC_st.DFC_rba_MemDiag_MemWrErr "Status of DFC / Status of diagnostic fault check DFC_rba_MemDiag_MemWrErr" UBYTE DFC_OneToOne 1 100 0.00 255.0 FORMAT "%5.1" ECU_ADDRESS 0x600370B1 /end MEASUREMENT
/begin MEASUREMENT DFC_st.DFC_rba_SyC_IrrSwOffTrigEngRun_Event "Status of DFC / Status of diagnostic fault check DFC_rba_SyC_IrrSwOffTrigEngRun_Event" UBYTE DFC_OneToOne 1 100 0.00 255.0 FORMAT "%5.1" ECU_ADDRESS 0x600370B2 /end MEASUREMENT
/begin MEASUREMENT DFC_st.DFC_rba_T15_Diag_ComInVld_Event "Status of DFC / Status of diagnostic fault check DFC_rba_T15_Diag_ComInVld_Event" UBYTE DFC_OneToOne 1 100 0.00 255.0 FORMAT "%5.1" ECU_ADDRESS 0x600370B3 /end MEASUREMENT
/begin MEASUREMENT DFC_st.DFC_rba_T15_Diag_ComOff_HwOn_Event "Status of DFC / Status of diagnostic fault check DFC_rba_T15_Diag_ComOff_HwOn_Event" UBYTE DFC_OneToOne 1 100 0.00 255.0 FORMAT "%5.1" ECU_ADDRESS 0x600370B4 /end MEASUREMENT
/begin MEASUREMENT DFC_st.DFC_rba_T15_Diag_ComOn_HwOff_Event "Status of DFC / Status of diagnostic fault check DFC_rba_T15_Diag_ComOn_HwOff_Event" UBYTE DFC_OneToOne 1 100 0.00 255.0 FORMAT "%5.1" ECU_ADDRESS 0x600370B5 /end MEASUREMENT
/begin MEASUREMENT DFC_st.DFC_AAVmin "Status of DFC / Status of diagnostic fault check DFC_AAVmin" UBYTE DFC_OneToOne 1 100 0.00 255.0 FORMAT "%5.1" ECU_ADDRESS 0x600370B6 /end MEASUREMENT
/begin MEASUREMENT DFC_st.DFC_AGRSUS "Status of DFC / Status of diagnostic fault check DFC_AGRSUS" UBYTE DFC_OneToOne 1 100 0.00 255.0 FORMAT "%5.1" ECU_ADDRESS 0x600370B7 /end MEASUREMENT
/begin MEASUREMENT DFC_st.DFC_AfsPlausDiagHi "Status of DFC / Status of diagnostic fault check DFC_AfsPlausDiagHi" UBYTE DFC_OneToOne 1 100 0.00 255.0 FORMAT "%5.1" ECU_ADDRESS 0x600370B8 /end MEASUREMENT
/begin MEASUREMENT DFC_st.DFC_AfsPlausDiagLo "Status of DFC / Status of diagnostic fault check DFC_AfsPlausDiagLo" UBYTE DFC_OneToOne 1 100 0.00 255.0 FORMAT "%5.1" ECU_ADDRESS 0x600370B9 /end MEASUREMENT
/begin MEASUREMENT DFC_st.DFC_AfsVrntDiagErrB1 "Status of DFC / Status of diagnostic fault check DFC_AfsVrntDiagErrB1" UBYTE DFC_OneToOne 1 100 0.00 255.0 FORMAT "%5.1" ECU_ADDRESS 0x600370BA /end MEASUREMENT
/begin MEASUREMENT DFC_st.DFC_AppAllSnsrDfct "Status of DFC / Status of diagnostic fault check DFC_AppAllSnsrDfct" UBYTE DFC_OneToOne 1 100 0.00 255.0 FORMAT "%5.1" ECU_ADDRESS 0x600370BB /end MEASUREMENT
/begin MEASUREMENT DFC_st.DFC_BBKRnldg "Status of DFC / Status of diagnostic fault check DFC_BBKRnldg" UBYTE DFC_OneToOne 1 100 0.00 255.0 FORMAT "%5.1" ECU_ADDRESS 0x600370BC /end MEASUREMENT
/begin MEASUREMENT DFC_st.DFC_BBKRsyne "Status of DFC / Status of diagnostic fault check DFC_BBKRsyne" UBYTE DFC_OneToOne 1 100 0.00 255.0 FORMAT "%5.1" ECU_ADDRESS 0x600370BD /end MEASUREMENT
/begin MEASUREMENT DFC_st.DFC_BattUStdbyDiaOL "Status of DFC / Status of diagnostic fault check DFC_BattUStdbyDiaOL" UBYTE DFC_OneToOne 1 100 0.00 255.0 FORMAT "%5.1" ECU_ADDRESS 0x600370BE /end MEASUREMENT
/begin MEASUREMENT DFC_st.DFC_BigLeakIntkMnfldEmiInfl "Status of DFC / Status of diagnostic fault check DFC_BigLeakIntkMnfldEmiInfl" UBYTE DFC_OneToOne 1 100 0.00 255.0 FORMAT "%5.1" ECU_ADDRESS 0x600370BF /end MEASUREMENT
/begin MEASUREMENT DFC_st.DFC_BlkdLineTank "Status of DFC / Status of diagnostic fault check DFC_BlkdLineTank" UBYTE DFC_OneToOne 1 100 0.00 255.0 FORMAT "%5.1" ECU_ADDRESS 0x600370C0 /end MEASUREMENT
/begin MEASUREMENT DFC_st.DFC_BrkMnSwtContOnWarnLmp "Status of DFC / Status of diagnostic fault check DFC_BrkMnSwtContOnWarnLmp" UBYTE DFC_OneToOne 1 100 0.00 255.0 FORMAT "%5.1" ECU_ADDRESS 0x600370C1 /end MEASUREMENT
/begin MEASUREMENT DFC_st.DFC_BrkMnSwtNotStpWarnLmp "Status of DFC / Status of diagnostic fault check DFC_BrkMnSwtNotStpWarnLmp" UBYTE DFC_OneToOne 1 100 0.00 255.0 FORMAT "%5.1" ECU_ADDRESS 0x600370C2 /end MEASUREMENT
/begin MEASUREMENT DFC_st.DFC_BrkRdntSwtContOnWarnLmp "Status of DFC / Status of diagnostic fault check DFC_BrkRdntSwtContOnWarnLmp" UBYTE DFC_OneToOne 1 100 0.00 255.0 FORMAT "%5.1" ECU_ADDRESS 0x600370C3 /end MEASUREMENT
/begin MEASUREMENT DFC_st.DFC_BrkRdntSwtNotStpWarnLmp "Status of DFC / Status of diagnostic fault check DFC_BrkRdntSwtNotStpWarnLmp" UBYTE DFC_OneToOne 1 100 0.00 255.0 FORMAT "%5.1" ECU_ADDRESS 0x600370C4 /end MEASUREMENT
/begin MEASUREMENT DFC_st.DFC_CEngDsTColdStrtMax "Status of DFC / Status of diagnostic fault check DFC_CEngDsTColdStrtMax" UBYTE DFC_OneToOne 1 100 0.00 255.0 FORMAT "%5.1" ECU_ADDRESS 0x600370C5 /end MEASUREMENT
/begin MEASUREMENT DFC_st.DFC_CEngDsTColdStrtMin "Status of DFC / Status of diagnostic fault check DFC_CEngDsTColdStrtMin" UBYTE DFC_OneToOne 1 100 0.00 255.0 FORMAT "%5.1" ECU_ADDRESS 0x600370C6 /end MEASUREMENT
/begin MEASUREMENT DFC_st.DFC_CEngDsTImps "Status of DFC / Status of diagnostic fault check DFC_CEngDsTImps" UBYTE DFC_OneToOne 1 100 0.00 255.0 FORMAT "%5.1" ECU_ADDRESS 0x600370C7 /end MEASUREMENT
/begin MEASUREMENT DFC_st.DFC_CEngDsTPlausHSC "Status of DFC / Status of diagnostic fault check DFC_CEngDsTPlausHSC" UBYTE DFC_OneToOne 1 100 0.00 255.0 FORMAT "%5.1" ECU_ADDRESS 0x600370C8 /end MEASUREMENT
/begin MEASUREMENT DFC_st.DFC_CEngDsTPlausLSC "Status of DFC / Status of diagnostic fault check DFC_CEngDsTPlausLSC" UBYTE DFC_OneToOne 1 100 0.00 255.0 FORMAT "%5.1" ECU_ADDRESS 0x600370C9 /end MEASUREMENT
/begin MEASUREMENT DFC_st.DFC_CEngDsTPlausSTC "Status of DFC / Status of diagnostic fault check DFC_CEngDsTPlausSTC" UBYTE DFC_OneToOne 1 100 0.00 255.0 FORMAT "%5.1" ECU_ADDRESS 0x600370CA /end MEASUREMENT
/begin MEASUREMENT DFC_st.DFC_CEngDsTSRCMax "Status of DFC / Status of diagnostic fault check DFC_CEngDsTSRCMax" UBYTE DFC_OneToOne 1 100 0.00 255.0 FORMAT "%5.1" ECU_ADDRESS 0x600370CB /end MEASUREMENT
/begin MEASUREMENT DFC_st.DFC_CEngDsTSRCMin "Status of DFC / Status of diagnostic fault check DFC_CEngDsTSRCMin" UBYTE DFC_OneToOne 1 100 0.00 255.0 FORMAT "%5.1" ECU_ADDRESS 0x600370CC /end MEASUREMENT
/begin MEASUREMENT DFC_st.DFC_CEngDsTSig "Status of DFC / Status of diagnostic fault check DFC_CEngDsTSig" UBYTE DFC_OneToOne 1 100 0.00 255.0 FORMAT "%5.1" ECU_ADDRESS 0x600370CD /end MEASUREMENT
/begin MEASUREMENT DFC_st.DFC_CEngUsTColdStrtMax "Status of DFC / Status of diagnostic fault check DFC_CEngUsTColdStrtMax" UBYTE DFC_OneToOne 1 100 0.00 255.0 FORMAT "%5.1" ECU_ADDRESS 0x600370CE /end MEASUREMENT
/begin MEASUREMENT DFC_st.DFC_CEngUsTColdStrtMin "Status of DFC / Status of diagnostic fault check DFC_CEngUsTColdStrtMin" UBYTE DFC_OneToOne 1 100 0.00 255.0 FORMAT "%5.1" ECU_ADDRESS 0x600370CF /end MEASUREMENT
/begin MEASUREMENT DFC_st.DFC_CEngUsTLooseCnctn "Status of DFC / Status of diagnostic fault check DFC_CEngUsTLooseCnctn" UBYTE DFC_OneToOne 1 100 0.00 255.0 FORMAT "%5.1" ECU_ADDRESS 0x600370D0 /end MEASUREMENT
/begin MEASUREMENT DFC_st.DFC_CEngUsTSRCMax "Status of DFC / Status of diagnostic fault check DFC_CEngUsTSRCMax" UBYTE DFC_OneToOne 1 100 0.00 255.0 FORMAT "%5.1" ECU_ADDRESS 0x600370D1 /end MEASUREMENT
/begin MEASUREMENT DFC_st.DFC_CEngUsTSRCMin "Status of DFC / Status of diagnostic fault check DFC_CEngUsTSRCMin" UBYTE DFC_OneToOne 1 100 0.00 255.0 FORMAT "%5.1" ECU_ADDRESS 0x600370D2 /end MEASUREMENT
/begin MEASUREMENT DFC_st.DFC_ComDCDCACCFailr "Status of DFC / Status of diagnostic fault check DFC_ComDCDCACCFailr" UBYTE DFC_OneToOne 1 100 0.00 255.0 FORMAT "%5.1" ECU_ADDRESS 0x600370D3 /end MEASUREMENT
/begin MEASUREMENT DFC_st.DFC_DCDCFltDet "Status of DFC / Status of diagnostic fault check DFC_DCDCFltDet" UBYTE DFC_OneToOne 1 100 0.00 255.0 FORMAT "%5.1" ECU_ADDRESS 0x600370D4 /end MEASUREMENT
/begin MEASUREMENT DFC_st.DFC_DKRSA "Status of DFC / Status of diagnostic fault check DFC_DKRSA" UBYTE DFC_OneToOne 1 100 0.00 255.0 FORMAT "%5.1" ECU_ADDRESS 0x600370D5 /end MEASUREMENT
/begin MEASUREMENT DFC_st.DFC_DKVSmax "Status of DFC / Status of diagnostic fault check DFC_DKVSmax" UBYTE DFC_OneToOne 1 100 0.00 255.0 FORMAT "%5.1" ECU_ADDRESS 0x600370D6 /end MEASUREMENT
/begin MEASUREMENT DFC_st.DFC_DKnpl "Status of DFC / Status of diagnostic fault check DFC_DKnpl" UBYTE DFC_OneToOne 1 100 0.00 255.0 FORMAT "%5.1" ECU_ADDRESS 0x600370D7 /end MEASUREMENT
/begin MEASUREMENT DFC_st.DFC_DSKVRmax "Status of DFC / Status of diagnostic fault check DFC_DSKVRmax" UBYTE DFC_OneToOne 1 100 0.00 255.0 FORMAT "%5.1" ECU_ADDRESS 0x600370D8 /end MEASUREMENT
/begin MEASUREMENT DFC_st.DFC_DSKVRmin "Status of DFC / Status of diagnostic fault check DFC_DSKVRmin" UBYTE DFC_OneToOne 1 100 0.00 255.0 FORMAT "%5.1" ECU_ADDRESS 0x600370D9 /end MEASUREMENT
/begin MEASUREMENT DFC_st.DFC_DSKVRnpl "Status of DFC / Status of diagnostic fault check DFC_DSKVRnpl" UBYTE DFC_OneToOne 1 100 0.00 255.0 FORMAT "%5.1" ECU_ADDRESS 0x600370DA /end MEASUREMENT
/begin MEASUREMENT DFC_st.DFC_DSKVRsig "Status of DFC / Status of diagnostic fault check DFC_DSKVRsig" UBYTE DFC_OneToOne 1 100 0.00 255.0 FORMAT "%5.1" ECU_ADDRESS 0x600370DB /end MEASUREMENT
/begin MEASUREMENT DFC_st.DFC_DSKVSsig "Status of DFC / Status of diagnostic fault check DFC_DSKVSsig" UBYTE DFC_OneToOne 1 100 0.00 255.0 FORMAT "%5.1" ECU_ADDRESS 0x600370DC /end MEASUREMENT
/begin MEASUREMENT DFC_st.DFC_DSSmax "Status of DFC / Status of diagnostic fault check DFC_DSSmax" UBYTE DFC_OneToOne 1 100 0.00 255.0 FORMAT "%5.1" ECU_ADDRESS 0x600370DD /end MEASUREMENT
/begin MEASUREMENT DFC_st.DFC_DSTDmax "Status of DFC / Status of diagnostic fault check DFC_DSTDmax" UBYTE DFC_OneToOne 1 100 0.00 255.0 FORMAT "%5.1" ECU_ADDRESS 0x600370DE /end MEASUREMENT
/begin MEASUREMENT DFC_st.DFC_DSTEmax "Status of DFC / Status of diagnostic fault check DFC_DSTEmax" UBYTE DFC_OneToOne 1 100 0.00 255.0 FORMAT "%5.1" ECU_ADDRESS 0x600370DF /end MEASUREMENT
/begin MEASUREMENT DFC_st.DFC_DSTEmin "Status of DFC / Status of diagnostic fault check DFC_DSTEmin" UBYTE DFC_OneToOne 1 100 0.00 255.0 FORMAT "%5.1" ECU_ADDRESS 0x600370E0 /end MEASUREMENT
/begin MEASUREMENT DFC_st.DFC_DSTOFmax "Status of DFC / Status of diagnostic fault check DFC_DSTOFmax" UBYTE DFC_OneToOne 1 100 0.00 255.0 FORMAT "%5.1" ECU_ADDRESS 0x600370E1 /end MEASUREMENT
/begin MEASUREMENT DFC_st.DFC_DSTRmax "Status of DFC / Status of diagnostic fault check DFC_DSTRmax" UBYTE DFC_OneToOne 1 100 0.00 255.0 FORMAT "%5.1" ECU_ADDRESS 0x600370E2 /end MEASUREMENT
/begin MEASUREMENT DFC_st.DFC_DSTRmin "Status of DFC / Status of diagnostic fault check DFC_DSTRmin" UBYTE DFC_OneToOne 1 100 0.00 255.0 FORMAT "%5.1" ECU_ADDRESS 0x600370E3 /end MEASUREMENT
/begin MEASUREMENT DFC_st.DFC_DSTRnpl "Status of DFC / Status of diagnostic fault check DFC_DSTRnpl" UBYTE DFC_OneToOne 1 100 0.00 255.0 FORMAT "%5.1" ECU_ADDRESS 0x600370E4 /end MEASUREMENT
/begin MEASUREMENT DFC_st.DFC_DSTRsig "Status of DFC / Status of diagnostic fault check DFC_DSTRsig" UBYTE DFC_OneToOne 1 100 0.00 255.0 FORMAT "%5.1" ECU_ADDRESS 0x600370E5 /end MEASUREMENT
/begin MEASUREMENT DFC_st.DFC_DSTTI "Status of DFC / Status of diagnostic fault check DFC_DSTTI" UBYTE DFC_OneToOne 1 100 0.00 255.0 FORMAT "%5.1" ECU_ADDRESS 0x600370E6 /end MEASUREMENT
/begin MEASUREMENT DFC_st.DFC_DSUmax "Status of DFC / Status of diagnostic fault check DFC_DSUmax" UBYTE DFC_OneToOne 1 100 0.00 255.0 FORMAT "%5.1" ECU_ADDRESS 0x600370E7 /end MEASUREMENT
/begin MEASUREMENT DFC_st.DFC_DiagCpv1DteskLoLoadStuckClsd "Status of DFC / Status of diagnostic fault check DFC_DiagCpv1DteskLoLoadStuckClsd" UBYTE DFC_OneToOne 1 100 0.00 255.0 FORMAT "%5.1" ECU_ADDRESS 0x600370E8 /end MEASUREMENT
/begin MEASUREMENT DFC_st.DFC_DiagCpv1DteskLoLoadStuckOpen "Status of DFC / Status of diagnostic fault check DFC_DiagCpv1DteskLoLoadStuckOpen" UBYTE DFC_OneToOne 1 100 0.00 255.0 FORMAT "%5.1" ECU_ADDRESS 0x600370E9 /end MEASUREMENT
/begin MEASUREMENT DFC_st.DFC_EGRVlvDrftClsd "Status of DFC / Status of diagnostic fault check DFC_EGRVlvDrftClsd" UBYTE DFC_OneToOne 1 100 0.00 255.0 FORMAT "%5.1" ECU_ADDRESS 0x600370EA /end MEASUREMENT
/begin MEASUREMENT DFC_st.DFC_EGRVlvDrftOpn "Status of DFC / Status of diagnostic fault check DFC_EGRVlvDrftOpn" UBYTE DFC_OneToOne 1 100 0.00 255.0 FORMAT "%5.1" ECU_ADDRESS 0x600370EB /end MEASUREMENT
/begin MEASUREMENT DFC_st.DFC_EGRVlvJamVlvClsd "Status of DFC / Status of diagnostic fault check DFC_EGRVlvJamVlvClsd" UBYTE DFC_OneToOne 1 100 0.00 255.0 FORMAT "%5.1" ECU_ADDRESS 0x600370EC /end MEASUREMENT
/begin MEASUREMENT DFC_st.DFC_EGRVlvJamVlvOpn "Status of DFC / Status of diagnostic fault check DFC_EGRVlvJamVlvOpn" UBYTE DFC_OneToOne 1 100 0.00 255.0 FORMAT "%5.1" ECU_ADDRESS 0x600370ED /end MEASUREMENT
/begin MEASUREMENT DFC_st.DFC_EGRVlvSprgBrk "Status of DFC / Status of diagnostic fault check DFC_EGRVlvSprgBrk" UBYTE DFC_OneToOne 1 100 0.00 255.0 FORMAT "%5.1" ECU_ADDRESS 0x600370EE /end MEASUREMENT
/begin MEASUREMENT DFC_st.DFC_EGRVlvTempMdlEEPErr "Status of DFC / Status of diagnostic fault check DFC_EGRVlvTempMdlEEPErr" UBYTE DFC_OneToOne 1 100 0.00 255.0 FORMAT "%5.1" ECU_ADDRESS 0x600370EF /end MEASUREMENT
/begin MEASUREMENT DFC_st.DFC_EGRVlvTmpErr "Status of DFC / Status of diagnostic fault check DFC_EGRVlvTmpErr" UBYTE DFC_OneToOne 1 100 0.00 255.0 FORMAT "%5.1" ECU_ADDRESS 0x600370F0 /end MEASUREMENT
/begin MEASUREMENT DFC_st.DFC_EGSDUS2B1LtrDly "Status of DFC / Status of diagnostic fault check DFC_EGSDUS2B1LtrDly" UBYTE DFC_OneToOne 1 100 0.00 255.0 FORMAT "%5.1" ECU_ADDRESS 0x600370F1 /end MEASUREMENT
/begin MEASUREMENT DFC_st.DFC_EGSDUS2B1LtrPT1 "Status of DFC / Status of diagnostic fault check DFC_EGSDUS2B1LtrPT1" UBYTE DFC_OneToOne 1 100 0.00 255.0 FORMAT "%5.1" ECU_ADDRESS 0x600370F2 /end MEASUREMENT
/begin MEASUREMENT DFC_st.DFC_EGSDUS2B1RtlDly "Status of DFC / Status of diagnostic fault check DFC_EGSDUS2B1RtlDly" UBYTE DFC_OneToOne 1 100 0.00 255.0 FORMAT "%5.1" ECU_ADDRESS 0x600370F3 /end MEASUREMENT
/begin MEASUREMENT DFC_st.DFC_EGSDUS2B1RtlPT1 "Status of DFC / Status of diagnostic fault check DFC_EGSDUS2B1RtlPT1" UBYTE DFC_OneToOne 1 100 0.00 255.0 FORMAT "%5.1" ECU_ADDRESS 0x600370F4 /end MEASUREMENT
/begin MEASUREMENT DFC_st.DFC_EGSDUS2B1TarLean "Status of DFC / Status of diagnostic fault check DFC_EGSDUS2B1TarLean" UBYTE DFC_OneToOne 1 100 0.00 255.0 FORMAT "%5.1" ECU_ADDRESS 0x600370F5 /end MEASUREMENT
/begin MEASUREMENT DFC_st.DFC_EGSDUS2B1TarRich "Status of DFC / Status of diagnostic fault check DFC_EGSDUS2B1TarRich" UBYTE DFC_OneToOne 1 100 0.00 255.0 FORMAT "%5.1" ECU_ADDRESS 0x600370F6 /end MEASUREMENT
/begin MEASUREMENT DFC_st.DFC_EONVmax "Status of DFC / Status of diagnostic fault check DFC_EONVmax" UBYTE DFC_OneToOne 1 100 0.00 255.0 FORMAT "%5.1" ECU_ADDRESS 0x600370F7 /end MEASUREMENT
/begin MEASUREMENT DFC_st.DFC_ETAKHLmax "Status of DFC / Status of diagnostic fault check DFC_ETAKHLmax" UBYTE DFC_OneToOne 1 100 0.00 255.0 FORMAT "%5.1" ECU_ADDRESS 0x600370F8 /end MEASUREMENT
/begin MEASUREMENT DFC_st.DFC_ETAKHTmax "Status of DFC / Status of diagnostic fault check DFC_ETAKHTmax" UBYTE DFC_OneToOne 1 100 0.00 255.0 FORMAT "%5.1" ECU_ADDRESS 0x600370F9 /end MEASUREMENT
/begin MEASUREMENT DFC_st.DFC_ETHSEmax "Status of DFC / Status of diagnostic fault check DFC_ETHSEmax" UBYTE DFC_OneToOne 1 100 0.00 255.0 FORMAT "%5.1" ECU_ADDRESS 0x600370FA /end MEASUREMENT
/begin MEASUREMENT DFC_st.DFC_ETHSEmin "Status of DFC / Status of diagnostic fault check DFC_ETHSEmin" UBYTE DFC_OneToOne 1 100 0.00 255.0 FORMAT "%5.1" ECU_ADDRESS 0x600370FB /end MEASUREMENT
/begin MEASUREMENT DFC_st.DFC_ETHSFmax "Status of DFC / Status of diagnostic fault check DFC_ETHSFmax" UBYTE DFC_OneToOne 1 100 0.00 255.0 FORMAT "%5.1" ECU_ADDRESS 0x600370FC /end MEASUREMENT
/begin MEASUREMENT DFC_st.DFC_ETHSFmin "Status of DFC / Status of diagnostic fault check DFC_ETHSFmin" UBYTE DFC_OneToOne 1 100 0.00 255.0 FORMAT "%5.1" ECU_ADDRESS 0x600370FD /end MEASUREMENT
/begin MEASUREMENT DFC_st.DFC_ETHSFsig "Status of DFC / Status of diagnostic fault check DFC_ETHSFsig" UBYTE DFC_OneToOne 1 100 0.00 255.0 FORMAT "%5.1" ECU_ADDRESS 0x600370FE /end MEASUREMENT
/begin MEASUREMENT DFC_st.DFC_ETHSNPWmax "Status of DFC / Status of diagnostic fault check DFC_ETHSNPWmax" UBYTE DFC_OneToOne 1 100 0.00 255.0 FORMAT "%5.1" ECU_ADDRESS 0x600370FF /end MEASUREMENT
/begin MEASUREMENT DFC_st.DFC_ETHSNPWmin "Status of DFC / Status of diagnostic fault check DFC_ETHSNPWmin" UBYTE DFC_OneToOne 1 100 0.00 255.0 FORMAT "%5.1" ECU_ADDRESS 0x60037100 /end MEASUREMENT
/begin MEASUREMENT DFC_st.DFC_ETHSNPWsig "Status of DFC / Status of diagnostic fault check DFC_ETHSNPWsig" UBYTE DFC_OneToOne 1 100 0.00 255.0 FORMAT "%5.1" ECU_ADDRESS 0x60037101 /end MEASUREMENT
/begin MEASUREMENT DFC_st.DFC_ETHSPLnpl "Status of DFC / Status of diagnostic fault check DFC_ETHSPLnpl" UBYTE DFC_OneToOne 1 100 0.00 255.0 FORMAT "%5.1" ECU_ADDRESS 0x60037102 /end MEASUREMENT
/begin MEASUREMENT DFC_st.DFC_ETHSTPLnpl "Status of DFC / Status of diagnostic fault check DFC_ETHSTPLnpl" UBYTE DFC_OneToOne 1 100 0.00 255.0 FORMAT "%5.1" ECU_ADDRESS 0x60037103 /end MEASUREMENT
/begin MEASUREMENT DFC_st.DFC_EngICO "Status of DFC / Status of diagnostic fault check DFC_EngICO" UBYTE DFC_OneToOne 1 100 0.00 255.0 FORMAT "%5.1" ECU_ADDRESS 0x60037104 /end MEASUREMENT
/begin MEASUREMENT DFC_st.DFC_EngPrtOvrSpdMon "Status of DFC / Status of diagnostic fault check DFC_EngPrtOvrSpdMon" UBYTE DFC_OneToOne 1 100 0.00 255.0 FORMAT "%5.1" ECU_ADDRESS 0x60037105 /end MEASUREMENT
/begin MEASUREMENT DFC_st.DFC_EpmCaSI1ErrSig "Status of DFC / Status of diagnostic fault check DFC_EpmCaSI1ErrSig" UBYTE DFC_OneToOne 1 100 0.00 255.0 FORMAT "%5.1" ECU_ADDRESS 0x60037106 /end MEASUREMENT
/begin MEASUREMENT DFC_st.DFC_EpmCaSI1MntErr "Status of DFC / Status of diagnostic fault check DFC_EpmCaSI1MntErr" UBYTE DFC_OneToOne 1 100 0.00 255.0 FORMAT "%5.1" ECU_ADDRESS 0x60037107 /end MEASUREMENT
/begin MEASUREMENT DFC_st.DFC_EpmCaSI1NoSigMax "Status of DFC / Status of diagnostic fault check DFC_EpmCaSI1NoSigMax" UBYTE DFC_OneToOne 1 100 0.00 255.0 FORMAT "%5.1" ECU_ADDRESS 0x60037108 /end MEASUREMENT
/begin MEASUREMENT DFC_st.DFC_EpmCaSI1NoSigMin "Status of DFC / Status of diagnostic fault check DFC_EpmCaSI1NoSigMin" UBYTE DFC_OneToOne 1 100 0.00 255.0 FORMAT "%5.1" ECU_ADDRESS 0x60037109 /end MEASUREMENT
/begin MEASUREMENT DFC_st.DFC_EpmCaSI1OfsErr "Status of DFC / Status of diagnostic fault check DFC_EpmCaSI1OfsErr" UBYTE DFC_OneToOne 1 100 0.00 255.0 FORMAT "%5.1" ECU_ADDRESS 0x6003710A /end MEASUREMENT
/begin MEASUREMENT DFC_st.DFC_EpmCrSDGI "Status of DFC / Status of diagnostic fault check DFC_EpmCrSDGI" UBYTE DFC_OneToOne 1 100 0.00 255.0 FORMAT "%5.1" ECU_ADDRESS 0x6003710B /end MEASUREMENT
/begin MEASUREMENT DFC_st.DFC_EpmCrSErrSig "Status of DFC / Status of diagnostic fault check DFC_EpmCrSErrSig" UBYTE DFC_OneToOne 1 100 0.00 255.0 FORMAT "%5.1" ECU_ADDRESS 0x6003710C /end MEASUREMENT
/begin MEASUREMENT DFC_st.DFC_EpmCrSNoSig "Status of DFC / Status of diagnostic fault check DFC_EpmCrSNoSig" UBYTE DFC_OneToOne 1 100 0.00 255.0 FORMAT "%5.1" ECU_ADDRESS 0x6003710D /end MEASUREMENT
/begin MEASUREMENT DFC_st.DFC_EtaEngIdleNonCsers "Status of DFC / Status of diagnostic fault check DFC_EtaEngIdleNonCsers" UBYTE DFC_OneToOne 1 100 0.00 255.0 FORMAT "%5.1" ECU_ADDRESS 0x6003710E /end MEASUREMENT
/begin MEASUREMENT DFC_st.DFC_EtaEngPtlNonCsers "Status of DFC / Status of diagnostic fault check DFC_EtaEngPtlNonCsers" UBYTE DFC_OneToOne 1 100 0.00 255.0 FORMAT "%5.1" ECU_ADDRESS 0x6003710F /end MEASUREMENT
/begin MEASUREMENT DFC_st.DFC_FRAmax "Status of DFC / Status of diagnostic fault check DFC_FRAmax" UBYTE DFC_OneToOne 1 100 0.00 255.0 FORMAT "%5.1" ECU_ADDRESS 0x60037110 /end MEASUREMENT
/begin MEASUREMENT DFC_st.DFC_FRAmin "Status of DFC / Status of diagnostic fault check DFC_FRAmin" UBYTE DFC_OneToOne 1 100 0.00 255.0 FORMAT "%5.1" ECU_ADDRESS 0x60037111 /end MEASUREMENT
/begin MEASUREMENT DFC_st.DFC_FSTEmax "Status of DFC / Status of diagnostic fault check DFC_FSTEmax" UBYTE DFC_OneToOne 1 100 0.00 255.0 FORMAT "%5.1" ECU_ADDRESS 0x60037112 /end MEASUREMENT
/begin MEASUREMENT DFC_st.DFC_FSTEmin "Status of DFC / Status of diagnostic fault check DFC_FSTEmin" UBYTE DFC_OneToOne 1 100 0.00 255.0 FORMAT "%5.1" ECU_ADDRESS 0x60037113 /end MEASUREMENT
/begin MEASUREMENT DFC_st.DFC_FSTRmax "Status of DFC / Status of diagnostic fault check DFC_FSTRmax" UBYTE DFC_OneToOne 1 100 0.00 255.0 FORMAT "%5.1" ECU_ADDRESS 0x60037114 /end MEASUREMENT
/begin MEASUREMENT DFC_st.DFC_FSTRmin "Status of DFC / Status of diagnostic fault check DFC_FSTRmin" UBYTE DFC_OneToOne 1 100 0.00 255.0 FORMAT "%5.1" ECU_ADDRESS 0x60037115 /end MEASUREMENT
/begin MEASUREMENT DFC_st.DFC_FSTRnpl "Status of DFC / Status of diagnostic fault check DFC_FSTRnpl" UBYTE DFC_OneToOne 1 100 0.00 255.0 FORMAT "%5.1" ECU_ADDRESS 0x60037116 /end MEASUREMENT
/begin MEASUREMENT DFC_st.DFC_FSTmax "Status of DFC / Status of diagnostic fault check DFC_FSTmax" UBYTE DFC_OneToOne 1 100 0.00 255.0 FORMAT "%5.1" ECU_ADDRESS 0x60037117 /end MEASUREMENT
/begin MEASUREMENT DFC_st.DFC_FTDLAmax "Status of DFC / Status of diagnostic fault check DFC_FTDLAmax" UBYTE DFC_OneToOne 1 100 0.00 255.0 FORMAT "%5.1" ECU_ADDRESS 0x60037118 /end MEASUREMENT
/begin MEASUREMENT DFC_st.DFC_FTDLAmin "Status of DFC / Status of diagnostic fault check DFC_FTDLAmin" UBYTE DFC_OneToOne 1 100 0.00 255.0 FORMAT "%5.1" ECU_ADDRESS 0x60037119 /end MEASUREMENT
/begin MEASUREMENT DFC_st.DFC_FuPHiSnsrEleclmax "Status of DFC / Status of diagnostic fault check DFC_FuPHiSnsrEleclmax" UBYTE DFC_OneToOne 1 100 0.00 255.0 FORMAT "%5.1" ECU_ADDRESS 0x6003711A /end MEASUREMENT
/begin MEASUREMENT DFC_st.DFC_FuPHiSnsrEleclmin "Status of DFC / Status of diagnostic fault check DFC_FuPHiSnsrEleclmin" UBYTE DFC_OneToOne 1 100 0.00 255.0 FORMAT "%5.1" ECU_ADDRESS 0x6003711B /end MEASUREMENT
/begin MEASUREMENT DFC_st.DFC_FuPHiSnsrEleclnpl "Status of DFC / Status of diagnostic fault check DFC_FuPHiSnsrEleclnpl" UBYTE DFC_OneToOne 1 100 0.00 255.0 FORMAT "%5.1" ECU_ADDRESS 0x6003711C /end MEASUREMENT
/begin MEASUREMENT DFC_st.DFC_FuPHiSnsrURngMax "Status of DFC / Status of diagnostic fault check DFC_FuPHiSnsrURngMax" UBYTE DFC_OneToOne 1 100 0.00 255.0 FORMAT "%5.1" ECU_ADDRESS 0x6003711D /end MEASUREMENT
/begin MEASUREMENT DFC_st.DFC_FuPHiSnsrURngMin "Status of DFC / Status of diagnostic fault check DFC_FuPHiSnsrURngMin" UBYTE DFC_OneToOne 1 100 0.00 255.0 FORMAT "%5.1" ECU_ADDRESS 0x6003711E /end MEASUREMENT
/begin MEASUREMENT DFC_st.DFC_FuSnsrPhyRngMaxErr "Status of DFC / Status of diagnostic fault check DFC_FuSnsrPhyRngMaxErr" UBYTE DFC_OneToOne 1 100 0.00 255.0 FORMAT "%5.1" ECU_ADDRESS 0x6003711F /end MEASUREMENT
/begin MEASUREMENT DFC_st.DFC_FuSnsrPhyRngMinErr "Status of DFC / Status of diagnostic fault check DFC_FuSnsrPhyRngMinErr" UBYTE DFC_OneToOne 1 100 0.00 255.0 FORMAT "%5.1" ECU_ADDRESS 0x60037120 /end MEASUREMENT
/begin MEASUREMENT DFC_st.DFC_GEVlvLockPinDiagIntkB1 "Status of DFC / Status of diagnostic fault check DFC_GEVlvLockPinDiagIntkB1" UBYTE DFC_OneToOne 1 100 0.00 255.0 FORMAT "%5.1" ECU_ADDRESS 0x60037121 /end MEASUREMENT
/begin MEASUREMENT DFC_st.DFC_GEVlvPhaSlowIntkB1 "Status of DFC / Status of diagnostic fault check DFC_GEVlvPhaSlowIntkB1" UBYTE DFC_OneToOne 1 100 0.00 255.0 FORMAT "%5.1" ECU_ADDRESS 0x60037122 /end MEASUREMENT
/begin MEASUREMENT DFC_st.DFC_GEVlvPhaTargIntkB1 "Status of DFC / Status of diagnostic fault check DFC_GEVlvPhaTargIntkB1" UBYTE DFC_OneToOne 1 100 0.00 255.0 FORMAT "%5.1" ECU_ADDRESS 0x60037123 /end MEASUREMENT
/begin MEASUREMENT DFC_st.DFC_GbxRvsSwtStk "Status of DFC / Status of diagnostic fault check DFC_GbxRvsSwtStk" UBYTE DFC_OneToOne 1 100 0.00 255.0 FORMAT "%5.1" ECU_ADDRESS 0x60037124 /end MEASUREMENT
/begin MEASUREMENT DFC_st.DFC_HDRKHmax "Status of DFC / Status of diagnostic fault check DFC_HDRKHmax" UBYTE DFC_OneToOne 1 100 0.00 255.0 FORMAT "%5.1" ECU_ADDRESS 0x60037125 /end MEASUREMENT
/begin MEASUREMENT DFC_st.DFC_HDRKHmin "Status of DFC / Status of diagnostic fault check DFC_HDRKHmin" UBYTE DFC_OneToOne 1 100 0.00 255.0 FORMAT "%5.1" ECU_ADDRESS 0x60037126 /end MEASUREMENT
/begin MEASUREMENT DFC_st.DFC_HDRPLmax "Status of DFC / Status of diagnostic fault check DFC_HDRPLmax" UBYTE DFC_OneToOne 1 100 0.00 255.0 FORMAT "%5.1" ECU_ADDRESS 0x60037127 /end MEASUREMENT
/begin MEASUREMENT DFC_st.DFC_HDRPLmin "Status of DFC / Status of diagnostic fault check DFC_HDRPLmin" UBYTE DFC_OneToOne 1 100 0.00 255.0 FORMAT "%5.1" ECU_ADDRESS 0x60037128 /end MEASUREMENT
/begin MEASUREMENT DFC_st.DFC_HDRmax "Status of DFC / Status of diagnostic fault check DFC_HDRmax" UBYTE DFC_OneToOne 1 100 0.00 255.0 FORMAT "%5.1" ECU_ADDRESS 0x60037129 /end MEASUREMENT
/begin MEASUREMENT DFC_st.DFC_HDRmin "Status of DFC / Status of diagnostic fault check DFC_HDRmin" UBYTE DFC_OneToOne 1 100 0.00 255.0 FORMAT "%5.1" ECU_ADDRESS 0x6003712A /end MEASUREMENT
/begin MEASUREMENT DFC_st.DFC_HEGOS2B1ElecMax "Status of DFC / Status of diagnostic fault check DFC_HEGOS2B1ElecMax" UBYTE DFC_OneToOne 1 100 0.00 255.0 FORMAT "%5.1" ECU_ADDRESS 0x6003712B /end MEASUREMENT
/begin MEASUREMENT DFC_st.DFC_HEGOS2B1ElecMin "Status of DFC / Status of diagnostic fault check DFC_HEGOS2B1ElecMin" UBYTE DFC_OneToOne 1 100 0.00 255.0 FORMAT "%5.1" ECU_ADDRESS 0x6003712C /end MEASUREMENT
/begin MEASUREMENT DFC_st.DFC_HEGOS2B1ElecSig "Status of DFC / Status of diagnostic fault check DFC_HEGOS2B1ElecSig" UBYTE DFC_OneToOne 1 100 0.00 255.0 FORMAT "%5.1" ECU_ADDRESS 0x6003712D /end MEASUREMENT
/begin MEASUREMENT DFC_st.DFC_HEGOS2B1HtgNpl "Status of DFC / Status of diagnostic fault check DFC_HEGOS2B1HtgNpl" UBYTE DFC_OneToOne 1 100 0.00 255.0 FORMAT "%5.1" ECU_ADDRESS 0x6003712E /end MEASUREMENT
/begin MEASUREMENT DFC_st.DFC_HEV00max "Status of DFC / Status of diagnostic fault check DFC_HEV00max" UBYTE DFC_OneToOne 1 100 0.00 255.0 FORMAT "%5.1" ECU_ADDRESS 0x6003712F /end MEASUREMENT
/begin MEASUREMENT DFC_st.DFC_HEV01max "Status of DFC / Status of diagnostic fault check DFC_HEV01max" UBYTE DFC_OneToOne 1 100 0.00 255.0 FORMAT "%5.1" ECU_ADDRESS 0x60037130 /end MEASUREMENT
/begin MEASUREMENT DFC_st.DFC_HEV02max "Status of DFC / Status of diagnostic fault check DFC_HEV02max" UBYTE DFC_OneToOne 1 100 0.00 255.0 FORMAT "%5.1" ECU_ADDRESS 0x60037131 /end MEASUREMENT
/begin MEASUREMENT DFC_st.DFC_HEV03max "Status of DFC / Status of diagnostic fault check DFC_HEV03max" UBYTE DFC_OneToOne 1 100 0.00 255.0 FORMAT "%5.1" ECU_ADDRESS 0x60037132 /end MEASUREMENT
/begin MEASUREMENT DFC_st.DFC_HEVE0max "Status of DFC / Status of diagnostic fault check DFC_HEVE0max" UBYTE DFC_OneToOne 1 100 0.00 255.0 FORMAT "%5.1" ECU_ADDRESS 0x60037133 /end MEASUREMENT
/begin MEASUREMENT DFC_st.DFC_HEVE1max "Status of DFC / Status of diagnostic fault check DFC_HEVE1max" UBYTE DFC_OneToOne 1 100 0.00 255.0 FORMAT "%5.1" ECU_ADDRESS 0x60037134 /end MEASUREMENT
/begin MEASUREMENT DFC_st.DFC_HFMmax "Status of DFC / Status of diagnostic fault check DFC_HFMmax" UBYTE DFC_OneToOne 1 100 0.00 255.0 FORMAT "%5.1" ECU_ADDRESS 0x60037135 /end MEASUREMENT
/begin MEASUREMENT DFC_st.DFC_HiPSysHiPMaxLimExcdd "Status of DFC / Status of diagnostic fault check DFC_HiPSysHiPMaxLimExcdd" UBYTE DFC_OneToOne 1 100 0.00 255.0 FORMAT "%5.1" ECU_ADDRESS 0x60037136 /end MEASUREMENT
/begin MEASUREMENT DFC_st.DFC_IVGdiCtlCvoErrMax_0 "Status of DFC / Status of diagnostic fault check DFC_IVGdiCtlCvoErrMax_0" UBYTE DFC_OneToOne 1 100 0.00 255.0 FORMAT "%5.1" ECU_ADDRESS 0x60037137 /end MEASUREMENT
/begin MEASUREMENT DFC_st.DFC_IVGdiCtlCvoErrMax_1 "Status of DFC / Status of diagnostic fault check DFC_IVGdiCtlCvoErrMax_1" UBYTE DFC_OneToOne 1 100 0.00 255.0 FORMAT "%5.1" ECU_ADDRESS 0x60037138 /end MEASUREMENT
/begin MEASUREMENT DFC_st.DFC_IVGdiCtlCvoErrMax_2 "Status of DFC / Status of diagnostic fault check DFC_IVGdiCtlCvoErrMax_2" UBYTE DFC_OneToOne 1 100 0.00 255.0 FORMAT "%5.1" ECU_ADDRESS 0x60037139 /end MEASUREMENT
/begin MEASUREMENT DFC_st.DFC_IVGdiCtlCvoErrMax_3 "Status of DFC / Status of diagnostic fault check DFC_IVGdiCtlCvoErrMax_3" UBYTE DFC_OneToOne 1 100 0.00 255.0 FORMAT "%5.1" ECU_ADDRESS 0x6003713A /end MEASUREMENT
/begin MEASUREMENT DFC_st.DFC_IVGdiCtlCvoErrMin_0 "Status of DFC / Status of diagnostic fault check DFC_IVGdiCtlCvoErrMin_0" UBYTE DFC_OneToOne 1 100 0.00 255.0 FORMAT "%5.1" ECU_ADDRESS 0x6003713B /end MEASUREMENT
/begin MEASUREMENT DFC_st.DFC_IVGdiCtlCvoErrMin_1 "Status of DFC / Status of diagnostic fault check DFC_IVGdiCtlCvoErrMin_1" UBYTE DFC_OneToOne 1 100 0.00 255.0 FORMAT "%5.1" ECU_ADDRESS 0x6003713C /end MEASUREMENT
/begin MEASUREMENT DFC_st.DFC_IVGdiCtlCvoErrMin_2 "Status of DFC / Status of diagnostic fault check DFC_IVGdiCtlCvoErrMin_2" UBYTE DFC_OneToOne 1 100 0.00 255.0 FORMAT "%5.1" ECU_ADDRESS 0x6003713D /end MEASUREMENT
/begin MEASUREMENT DFC_st.DFC_IVGdiCtlCvoErrMin_3 "Status of DFC / Status of diagnostic fault check DFC_IVGdiCtlCvoErrMin_3" UBYTE DFC_OneToOne 1 100 0.00 255.0 FORMAT "%5.1" ECU_ADDRESS 0x6003713E /end MEASUREMENT
/begin MEASUREMENT DFC_st.DFC_IVGdiCtlCvoErrMinMax "Status of DFC / Status of diagnostic fault check DFC_IVGdiCtlCvoErrMinMax" UBYTE DFC_OneToOne 1 100 0.00 255.0 FORMAT "%5.1" ECU_ADDRESS 0x6003713F /end MEASUREMENT
/begin MEASUREMENT DFC_st.DFC_IVGdiCtlCvoSigPlausErrSmrCdn "Status of DFC / Status of diagnostic fault check DFC_IVGdiCtlCvoSigPlausErrSmrCdn" UBYTE DFC_OneToOne 1 100 0.00 255.0 FORMAT "%5.1" ECU_ADDRESS 0x60037140 /end MEASUREMENT
/begin MEASUREMENT DFC_st.DFC_IVGdiCtl_CvoErr "Status of DFC / Status of diagnostic fault check DFC_IVGdiCtl_CvoErr" UBYTE DFC_OneToOne 1 100 0.00 255.0 FORMAT "%5.1" ECU_ADDRESS 0x60037141 /end MEASUREMENT
/begin MEASUREMENT DFC_st.DFC_IVGdiCtl_CvoSigPlaus_0 "Status of DFC / Status of diagnostic fault check DFC_IVGdiCtl_CvoSigPlaus_0" UBYTE DFC_OneToOne 1 100 0.00 255.0 FORMAT "%5.1" ECU_ADDRESS 0x60037142 /end MEASUREMENT
/begin MEASUREMENT DFC_st.DFC_IVGdiCtl_CvoSigPlaus_1 "Status of DFC / Status of diagnostic fault check DFC_IVGdiCtl_CvoSigPlaus_1" UBYTE DFC_OneToOne 1 100 0.00 255.0 FORMAT "%5.1" ECU_ADDRESS 0x60037143 /end MEASUREMENT
/begin MEASUREMENT DFC_st.DFC_IVGdiCtl_CvoSigPlaus_2 "Status of DFC / Status of diagnostic fault check DFC_IVGdiCtl_CvoSigPlaus_2" UBYTE DFC_OneToOne 1 100 0.00 255.0 FORMAT "%5.1" ECU_ADDRESS 0x60037144 /end MEASUREMENT
/begin MEASUREMENT DFC_st.DFC_IVGdiCtl_CvoSigPlaus_3 "Status of DFC / Status of diagnostic fault check DFC_IVGdiCtl_CvoSigPlaus_3" UBYTE DFC_OneToOne 1 100 0.00 255.0 FORMAT "%5.1" ECU_ADDRESS 0x60037145 /end MEASUREMENT
/begin MEASUREMENT DFC_st.DFC_IntkAirTAirFltDsCrssMax "Status of DFC / Status of diagnostic fault check DFC_IntkAirTAirFltDsCrssMax" UBYTE DFC_OneToOne 1 100 0.00 255.0 FORMAT "%5.1" ECU_ADDRESS 0x60037146 /end MEASUREMENT
/begin MEASUREMENT DFC_st.DFC_IntkAirTAirFltDsCrssMin "Status of DFC / Status of diagnostic fault check DFC_IntkAirTAirFltDsCrssMin" UBYTE DFC_OneToOne 1 100 0.00 255.0 FORMAT "%5.1" ECU_ADDRESS 0x60037147 /end MEASUREMENT
/begin MEASUREMENT DFC_st.DFC_IntkAirTAirFltDsHSCMax "Status of DFC / Status of diagnostic fault check DFC_IntkAirTAirFltDsHSCMax" UBYTE DFC_OneToOne 1 100 0.00 255.0 FORMAT "%5.1" ECU_ADDRESS 0x60037148 /end MEASUREMENT
/begin MEASUREMENT DFC_st.DFC_IntkAirTAirFltDsImps "Status of DFC / Status of diagnostic fault check DFC_IntkAirTAirFltDsImps" UBYTE DFC_OneToOne 1 100 0.00 255.0 FORMAT "%5.1" ECU_ADDRESS 0x60037149 /end MEASUREMENT
/begin MEASUREMENT DFC_st.DFC_IntkAirTAirFltDsPRCMax "Status of DFC / Status of diagnostic fault check DFC_IntkAirTAirFltDsPRCMax" UBYTE DFC_OneToOne 1 100 0.00 255.0 FORMAT "%5.1" ECU_ADDRESS 0x6003714A /end MEASUREMENT
/begin MEASUREMENT DFC_st.DFC_IntkAirTAirFltDsPRCMin "Status of DFC / Status of diagnostic fault check DFC_IntkAirTAirFltDsPRCMin" UBYTE DFC_OneToOne 1 100 0.00 255.0 FORMAT "%5.1" ECU_ADDRESS 0x6003714B /end MEASUREMENT
/begin MEASUREMENT DFC_st.DFC_IntkAirTAirFltDsSRCMax "Status of DFC / Status of diagnostic fault check DFC_IntkAirTAirFltDsSRCMax" UBYTE DFC_OneToOne 1 100 0.00 255.0 FORMAT "%5.1" ECU_ADDRESS 0x6003714C /end MEASUREMENT
/begin MEASUREMENT DFC_st.DFC_IntkAirTAirFltDsSRCMin "Status of DFC / Status of diagnostic fault check DFC_IntkAirTAirFltDsSRCMin" UBYTE DFC_OneToOne 1 100 0.00 255.0 FORMAT "%5.1" ECU_ADDRESS 0x6003714D /end MEASUREMENT
/begin MEASUREMENT DFC_st.DFC_IntkAirTAirFltDsSTC "Status of DFC / Status of diagnostic fault check DFC_IntkAirTAirFltDsSTC" UBYTE DFC_OneToOne 1 100 0.00 255.0 FORMAT "%5.1" ECU_ADDRESS 0x6003714E /end MEASUREMENT
/begin MEASUREMENT DFC_st.DFC_IntkAirTIntkMnfldCrssMax "Status of DFC / Status of diagnostic fault check DFC_IntkAirTIntkMnfldCrssMax" UBYTE DFC_OneToOne 1 100 0.00 255.0 FORMAT "%5.1" ECU_ADDRESS 0x6003714F /end MEASUREMENT
/begin MEASUREMENT DFC_st.DFC_IntkAirTIntkMnfldCrssMin "Status of DFC / Status of diagnostic fault check DFC_IntkAirTIntkMnfldCrssMin" UBYTE DFC_OneToOne 1 100 0.00 255.0 FORMAT "%5.1" ECU_ADDRESS 0x60037150 /end MEASUREMENT
/begin MEASUREMENT DFC_st.DFC_IntkAirTIntkMnfldHSCMax "Status of DFC / Status of diagnostic fault check DFC_IntkAirTIntkMnfldHSCMax" UBYTE DFC_OneToOne 1 100 0.00 255.0 FORMAT "%5.1" ECU_ADDRESS 0x60037151 /end MEASUREMENT
/begin MEASUREMENT DFC_st.DFC_IntkAirTIntkMnfldImps "Status of DFC / Status of diagnostic fault check DFC_IntkAirTIntkMnfldImps" UBYTE DFC_OneToOne 1 100 0.00 255.0 FORMAT "%5.1" ECU_ADDRESS 0x60037152 /end MEASUREMENT
/begin MEASUREMENT DFC_st.DFC_IntkAirTIntkMnfldPRCMax "Status of DFC / Status of diagnostic fault check DFC_IntkAirTIntkMnfldPRCMax" UBYTE DFC_OneToOne 1 100 0.00 255.0 FORMAT "%5.1" ECU_ADDRESS 0x60037153 /end MEASUREMENT
/begin MEASUREMENT DFC_st.DFC_IntkAirTIntkMnfldPRCMin "Status of DFC / Status of diagnostic fault check DFC_IntkAirTIntkMnfldPRCMin" UBYTE DFC_OneToOne 1 100 0.00 255.0 FORMAT "%5.1" ECU_ADDRESS 0x60037154 /end MEASUREMENT
/begin MEASUREMENT DFC_st.DFC_IntkAirTIntkMnfldSRCMax "Status of DFC / Status of diagnostic fault check DFC_IntkAirTIntkMnfldSRCMax" UBYTE DFC_OneToOne 1 100 0.00 255.0 FORMAT "%5.1" ECU_ADDRESS 0x60037155 /end MEASUREMENT
/begin MEASUREMENT DFC_st.DFC_IntkAirTIntkMnfldSRCMin "Status of DFC / Status of diagnostic fault check DFC_IntkAirTIntkMnfldSRCMin" UBYTE DFC_OneToOne 1 100 0.00 255.0 FORMAT "%5.1" ECU_ADDRESS 0x60037156 /end MEASUREMENT
/begin MEASUREMENT DFC_st.DFC_IntkAirTIntkMnfldSTC "Status of DFC / Status of diagnostic fault check DFC_IntkAirTIntkMnfldSTC" UBYTE DFC_OneToOne 1 100 0.00 255.0 FORMAT "%5.1" ECU_ADDRESS 0x60037157 /end MEASUREMENT
/begin MEASUREMENT DFC_st.DFC_KRREGRLMX "Status of DFC / Status of diagnostic fault check DFC_KRREGRLMX" UBYTE DFC_OneToOne 1 100 0.00 255.0 FORMAT "%5.1" ECU_ADDRESS 0x60037158 /end MEASUREMENT
/begin MEASUREMENT DFC_st.DFC_KRVEKOCVLCI "Status of DFC / Status of diagnostic fault check DFC_KRVEKOCVLCI" UBYTE DFC_OneToOne 1 100 0.00 255.0 FORMAT "%5.1" ECU_ADDRESS 0x60037159 /end MEASUREMENT
/begin MEASUREMENT DFC_st.DFC_KRVEKOENCHMT "Status of DFC / Status of diagnostic fault check DFC_KRVEKOENCHMT" UBYTE DFC_OneToOne 1 100 0.00 255.0 FORMAT "%5.1" ECU_ADDRESS 0x6003715A /end MEASUREMENT
/begin MEASUREMENT DFC_st.DFC_KRVEKOENCHMT0 "Status of DFC / Status of diagnostic fault check DFC_KRVEKOENCHMT0" UBYTE DFC_OneToOne 1 100 0.00 255.0 FORMAT "%5.1" ECU_ADDRESS 0x6003715B /end MEASUREMENT
/begin MEASUREMENT DFC_st.DFC_KRVEKOENCHMT1 "Status of DFC / Status of diagnostic fault check DFC_KRVEKOENCHMT1" UBYTE DFC_OneToOne 1 100 0.00 255.0 FORMAT "%5.1" ECU_ADDRESS 0x6003715C /end MEASUREMENT
/begin MEASUREMENT DFC_st.DFC_KRVEKOENCHMT2 "Status of DFC / Status of diagnostic fault check DFC_KRVEKOENCHMT2" UBYTE DFC_OneToOne 1 100 0.00 255.0 FORMAT "%5.1" ECU_ADDRESS 0x6003715D /end MEASUREMENT
/begin MEASUREMENT DFC_st.DFC_KRVEKOENCHMT3 "Status of DFC / Status of diagnostic fault check DFC_KRVEKOENCHMT3" UBYTE DFC_OneToOne 1 100 0.00 255.0 FORMAT "%5.1" ECU_ADDRESS 0x6003715E /end MEASUREMENT
/begin MEASUREMENT DFC_st.DFC_KRVEKOENCHMT4 "Status of DFC / Status of diagnostic fault check DFC_KRVEKOENCHMT4" UBYTE DFC_OneToOne 1 100 0.00 255.0 FORMAT "%5.1" ECU_ADDRESS 0x6003715F /end MEASUREMENT
/begin MEASUREMENT DFC_st.DFC_KRVEKOENCHMT5 "Status of DFC / Status of diagnostic fault check DFC_KRVEKOENCHMT5" UBYTE DFC_OneToOne 1 100 0.00 255.0 FORMAT "%5.1" ECU_ADDRESS 0x60037160 /end MEASUREMENT
/begin MEASUREMENT DFC_st.DFC_KRVEKOENCHMT6 "Status of DFC / Status of diagnostic fault check DFC_KRVEKOENCHMT6" UBYTE DFC_OneToOne 1 100 0.00 255.0 FORMAT "%5.1" ECU_ADDRESS 0x60037161 /end MEASUREMENT
/begin MEASUREMENT DFC_st.DFC_KRVEKOENCHMT7 "Status of DFC / Status of diagnostic fault check DFC_KRVEKOENCHMT7" UBYTE DFC_OneToOne 1 100 0.00 255.0 FORMAT "%5.1" ECU_ADDRESS 0x60037162 /end MEASUREMENT
/begin MEASUREMENT DFC_st.DFC_KRVEKORLMX "Status of DFC / Status of diagnostic fault check DFC_KRVEKORLMX" UBYTE DFC_OneToOne 1 100 0.00 255.0 FORMAT "%5.1" ECU_ADDRESS 0x60037163 /end MEASUREMENT
/begin MEASUREMENT DFC_st.DFC_KRVEKORLMXL "Status of DFC / Status of diagnostic fault check DFC_KRVEKORLMXL" UBYTE DFC_OneToOne 1 100 0.00 255.0 FORMAT "%5.1" ECU_ADDRESS 0x60037164 /end MEASUREMENT
/begin MEASUREMENT DFC_st.DFC_KS1max "Status of DFC / Status of diagnostic fault check DFC_KS1max" UBYTE DFC_OneToOne 1 100 0.00 255.0 FORMAT "%5.1" ECU_ADDRESS 0x60037165 /end MEASUREMENT
/begin MEASUREMENT DFC_st.DFC_KS1min "Status of DFC / Status of diagnostic fault check DFC_KS1min" UBYTE DFC_OneToOne 1 100 0.00 255.0 FORMAT "%5.1" ECU_ADDRESS 0x60037166 /end MEASUREMENT
/begin MEASUREMENT DFC_st.DFC_LMmax "Status of DFC / Status of diagnostic fault check DFC_LMmax" UBYTE DFC_OneToOne 1 100 0.00 255.0 FORMAT "%5.1" ECU_ADDRESS 0x60037167 /end MEASUREMENT
/begin MEASUREMENT DFC_st.DFC_LZSRnpl "Status of DFC / Status of diagnostic fault check DFC_LZSRnpl" UBYTE DFC_OneToOne 1 100 0.00 255.0 FORMAT "%5.1" ECU_ADDRESS 0x60037168 /end MEASUREMENT
/begin MEASUREMENT DFC_st.DFC_LamDynDiagS1B1 "Status of DFC / Status of diagnostic fault check DFC_LamDynDiagS1B1" UBYTE DFC_OneToOne 1 100 0.00 255.0 FORMAT "%5.1" ECU_ADDRESS 0x60037169 /end MEASUREMENT
/begin MEASUREMENT DFC_st.DFC_LeakIntkMnfldEmiInfl "Status of DFC / Status of diagnostic fault check DFC_LeakIntkMnfldEmiInfl" UBYTE DFC_OneToOne 1 100 0.00 255.0 FORMAT "%5.1" ECU_ADDRESS 0x6003716A /end MEASUREMENT
/begin MEASUREMENT DFC_st.DFC_LinFrameErrDCDC "Status of DFC / Status of diagnostic fault check DFC_LinFrameErrDCDC" UBYTE DFC_OneToOne 1 100 0.00 255.0 FORMAT "%5.1" ECU_ADDRESS 0x6003716B /end MEASUREMENT
/begin MEASUREMENT DFC_st.DFC_LinOverrunErrDCDC "Status of DFC / Status of diagnostic fault check DFC_LinOverrunErrDCDC" UBYTE DFC_OneToOne 1 100 0.00 255.0 FORMAT "%5.1" ECU_ADDRESS 0x6003716C /end MEASUREMENT
/begin MEASUREMENT DFC_st.DFC_MD00max "Status of DFC / Status of diagnostic fault check DFC_MD00max" UBYTE DFC_OneToOne 1 100 0.00 255.0 FORMAT "%5.1" ECU_ADDRESS 0x6003716D /end MEASUREMENT
/begin MEASUREMENT DFC_st.DFC_MDBmax "Status of DFC / Status of diagnostic fault check DFC_MDBmax" UBYTE DFC_OneToOne 1 100 0.00 255.0 FORMAT "%5.1" ECU_ADDRESS 0x6003716E /end MEASUREMENT
/begin MEASUREMENT DFC_st.DFC_MDCat "Status of DFC / Status of diagnostic fault check DFC_MDCat" UBYTE DFC_OneToOne 1 100 0.00 255.0 FORMAT "%5.1" ECU_ADDRESS 0x6003716F /end MEASUREMENT
/begin MEASUREMENT DFC_st.DFC_MDCatCrit "Status of DFC / Status of diagnostic fault check DFC_MDCatCrit" UBYTE DFC_OneToOne 1 100 0.00 255.0 FORMAT "%5.1" ECU_ADDRESS 0x60037170 /end MEASUREMENT
/begin MEASUREMENT DFC_st.DFC_MDCatCurr "Status of DFC / Status of diagnostic fault check DFC_MDCatCurr" UBYTE DFC_OneToOne 1 100 0.00 255.0 FORMAT "%5.1" ECU_ADDRESS 0x60037171 /end MEASUREMENT
/begin MEASUREMENT DFC_st.DFC_MDCyl_0 "Status of DFC / Status of diagnostic fault check DFC_MDCyl_0" UBYTE DFC_OneToOne 1 100 0.00 255.0 FORMAT "%5.1" ECU_ADDRESS 0x60037172 /end MEASUREMENT
/begin MEASUREMENT DFC_st.DFC_MDCyl_1 "Status of DFC / Status of diagnostic fault check DFC_MDCyl_1" UBYTE DFC_OneToOne 1 100 0.00 255.0 FORMAT "%5.1" ECU_ADDRESS 0x60037173 /end MEASUREMENT
/begin MEASUREMENT DFC_st.DFC_MDCyl_2 "Status of DFC / Status of diagnostic fault check DFC_MDCyl_2" UBYTE DFC_OneToOne 1 100 0.00 255.0 FORMAT "%5.1" ECU_ADDRESS 0x60037174 /end MEASUREMENT
/begin MEASUREMENT DFC_st.DFC_MDCyl_3 "Status of DFC / Status of diagnostic fault check DFC_MDCyl_3" UBYTE DFC_OneToOne 1 100 0.00 255.0 FORMAT "%5.1" ECU_ADDRESS 0x60037175 /end MEASUREMENT
/begin MEASUREMENT DFC_st.DFC_MDEmi "Status of DFC / Status of diagnostic fault check DFC_MDEmi" UBYTE DFC_OneToOne 1 100 0.00 255.0 FORMAT "%5.1" ECU_ADDRESS 0x60037176 /end MEASUREMENT
/begin MEASUREMENT DFC_st.DFC_MDEmiStrt "Status of DFC / Status of diagnostic fault check DFC_MDEmiStrt" UBYTE DFC_OneToOne 1 100 0.00 255.0 FORMAT "%5.1" ECU_ADDRESS 0x60037177 /end MEASUREMENT
/begin MEASUREMENT DFC_st.DFC_MDFco "Status of DFC / Status of diagnostic fault check DFC_MDFco" UBYTE DFC_OneToOne 1 100 0.00 255.0 FORMAT "%5.1" ECU_ADDRESS 0x60037178 /end MEASUREMENT
/begin MEASUREMENT DFC_st.DFC_MDMpl "Status of DFC / Status of diagnostic fault check DFC_MDMpl" UBYTE DFC_OneToOne 1 100 0.00 255.0 FORMAT "%5.1" ECU_ADDRESS 0x60037179 /end MEASUREMENT
/begin MEASUREMENT DFC_st.DFC_MDSegTiAdpn "Status of DFC / Status of diagnostic fault check DFC_MDSegTiAdpn" UBYTE DFC_OneToOne 1 100 0.00 255.0 FORMAT "%5.1" ECU_ADDRESS 0x6003717A /end MEASUREMENT
/begin MEASUREMENT DFC_st.DFC_MDmax "Status of DFC / Status of diagnostic fault check DFC_MDmax" UBYTE DFC_OneToOne 1 100 0.00 255.0 FORMAT "%5.1" ECU_ADDRESS 0x6003717B /end MEASUREMENT
/begin MEASUREMENT DFC_st.DFC_MFuOilMax "Status of DFC / Status of diagnostic fault check DFC_MFuOilMax" UBYTE DFC_OneToOne 1 100 0.00 255.0 FORMAT "%5.1" ECU_ADDRESS 0x6003717C /end MEASUREMENT
/begin MEASUREMENT DFC_st.DFC_MOXEMM_SMU_ALM0_0 "Status of DFC / Status of diagnostic fault check DFC_MOXEMM_SMU_ALM0_0" UBYTE DFC_OneToOne 1 100 0.00 255.0 FORMAT "%5.1" ECU_ADDRESS 0x6003717D /end MEASUREMENT
/begin MEASUREMENT DFC_st.DFC_MOXEMM_SMU_ALM0_1 "Status of DFC / Status of diagnostic fault check DFC_MOXEMM_SMU_ALM0_1" UBYTE DFC_OneToOne 1 100 0.00 255.0 FORMAT "%5.1" ECU_ADDRESS 0x6003717E /end MEASUREMENT
/begin MEASUREMENT DFC_st.DFC_MOXEMM_SMU_ALM0_10 "Status of DFC / Status of diagnostic fault check DFC_MOXEMM_SMU_ALM0_10" UBYTE DFC_OneToOne 1 100 0.00 255.0 FORMAT "%5.1" ECU_ADDRESS 0x6003717F /end MEASUREMENT
/begin MEASUREMENT DFC_st.DFC_MOXEMM_SMU_ALM0_11 "Status of DFC / Status of diagnostic fault check DFC_MOXEMM_SMU_ALM0_11" UBYTE DFC_OneToOne 1 100 0.00 255.0 FORMAT "%5.1" ECU_ADDRESS 0x60037180 /end MEASUREMENT
/begin MEASUREMENT DFC_st.DFC_MOXEMM_SMU_ALM0_13 "Status of DFC / Status of diagnostic fault check DFC_MOXEMM_SMU_ALM0_13" UBYTE DFC_OneToOne 1 100 0.00 255.0 FORMAT "%5.1" ECU_ADDRESS 0x60037181 /end MEASUREMENT
/begin MEASUREMENT DFC_st.DFC_MOXEMM_SMU_ALM0_14 "Status of DFC / Status of diagnostic fault check DFC_MOXEMM_SMU_ALM0_14" UBYTE DFC_OneToOne 1 100 0.00 255.0 FORMAT "%5.1" ECU_ADDRESS 0x60037182 /end MEASUREMENT
/begin MEASUREMENT DFC_st.DFC_MOXEMM_SMU_ALM0_2 "Status of DFC / Status of diagnostic fault check DFC_MOXEMM_SMU_ALM0_2" UBYTE DFC_OneToOne 1 100 0.00 255.0 FORMAT "%5.1" ECU_ADDRESS 0x60037183 /end MEASUREMENT
/begin MEASUREMENT DFC_st.DFC_MOXEMM_SMU_ALM0_22 "Status of DFC / Status of diagnostic fault check DFC_MOXEMM_SMU_ALM0_22" UBYTE DFC_OneToOne 1 100 0.00 255.0 FORMAT "%5.1" ECU_ADDRESS 0x60037184 /end MEASUREMENT
/begin MEASUREMENT DFC_st.DFC_MOXEMM_SMU_ALM0_23 "Status of DFC / Status of diagnostic fault check DFC_MOXEMM_SMU_ALM0_23" UBYTE DFC_OneToOne 1 100 0.00 255.0 FORMAT "%5.1" ECU_ADDRESS 0x60037185 /end MEASUREMENT
/begin MEASUREMENT DFC_st.DFC_MOXEMM_SMU_ALM0_4 "Status of DFC / Status of diagnostic fault check DFC_MOXEMM_SMU_ALM0_4" UBYTE DFC_OneToOne 1 100 0.00 255.0 FORMAT "%5.1" ECU_ADDRESS 0x60037186 /end MEASUREMENT
/begin MEASUREMENT DFC_st.DFC_MOXEMM_SMU_ALM0_5 "Status of DFC / Status of diagnostic fault check DFC_MOXEMM_SMU_ALM0_5" UBYTE DFC_OneToOne 1 100 0.00 255.0 FORMAT "%5.1" ECU_ADDRESS 0x60037187 /end MEASUREMENT
/begin MEASUREMENT DFC_st.DFC_MOXEMM_SMU_ALM0_7 "Status of DFC / Status of diagnostic fault check DFC_MOXEMM_SMU_ALM0_7" UBYTE DFC_OneToOne 1 100 0.00 255.0 FORMAT "%5.1" ECU_ADDRESS 0x60037188 /end MEASUREMENT
/begin MEASUREMENT DFC_st.DFC_MOXEMM_SMU_ALM0_8 "Status of DFC / Status of diagnostic fault check DFC_MOXEMM_SMU_ALM0_8" UBYTE DFC_OneToOne 1 100 0.00 255.0 FORMAT "%5.1" ECU_ADDRESS 0x60037189 /end MEASUREMENT
/begin MEASUREMENT DFC_st.DFC_MOXEMM_SMU_ALM10_16 "Status of DFC / Status of diagnostic fault check DFC_MOXEMM_SMU_ALM10_16" UBYTE DFC_OneToOne 1 100 0.00 255.0 FORMAT "%5.1" ECU_ADDRESS 0x6003718A /end MEASUREMENT
/begin MEASUREMENT DFC_st.DFC_MOXEMM_SMU_ALM10_17 "Status of DFC / Status of diagnostic fault check DFC_MOXEMM_SMU_ALM10_17" UBYTE DFC_OneToOne 1 100 0.00 255.0 FORMAT "%5.1" ECU_ADDRESS 0x6003718B /end MEASUREMENT
/begin MEASUREMENT DFC_st.DFC_MOXEMM_SMU_ALM10_21 "Status of DFC / Status of diagnostic fault check DFC_MOXEMM_SMU_ALM10_21" UBYTE DFC_OneToOne 1 100 0.00 255.0 FORMAT "%5.1" ECU_ADDRESS 0x6003718C /end MEASUREMENT
/begin MEASUREMENT DFC_st.DFC_MOXEMM_SMU_ALM11_0 "Status of DFC / Status of diagnostic fault check DFC_MOXEMM_SMU_ALM11_0" UBYTE DFC_OneToOne 1 100 0.00 255.0 FORMAT "%5.1" ECU_ADDRESS 0x6003718D /end MEASUREMENT
/begin MEASUREMENT DFC_st.DFC_MOXEMM_SMU_ALM11_1 "Status of DFC / Status of diagnostic fault check DFC_MOXEMM_SMU_ALM11_1" UBYTE DFC_OneToOne 1 100 0.00 255.0 FORMAT "%5.1" ECU_ADDRESS 0x6003718E /end MEASUREMENT
/begin MEASUREMENT DFC_st.DFC_MOXEMM_SMU_ALM11_2 "Status of DFC / Status of diagnostic fault check DFC_MOXEMM_SMU_ALM11_2" UBYTE DFC_OneToOne 1 100 0.00 255.0 FORMAT "%5.1" ECU_ADDRESS 0x6003718F /end MEASUREMENT
/begin MEASUREMENT DFC_st.DFC_MOXEMM_SMU_ALM11_3 "Status of DFC / Status of diagnostic fault check DFC_MOXEMM_SMU_ALM11_3" UBYTE DFC_OneToOne 1 100 0.00 255.0 FORMAT "%5.1" ECU_ADDRESS 0x60037190 /end MEASUREMENT
/begin MEASUREMENT DFC_st.DFC_MOXEMM_SMU_ALM11_4 "Status of DFC / Status of diagnostic fault check DFC_MOXEMM_SMU_ALM11_4" UBYTE DFC_OneToOne 1 100 0.00 255.0 FORMAT "%5.1" ECU_ADDRESS 0x60037191 /end MEASUREMENT
/begin MEASUREMENT DFC_st.DFC_MOXEMM_SMU_ALM11_5 "Status of DFC / Status of diagnostic fault check DFC_MOXEMM_SMU_ALM11_5" UBYTE DFC_OneToOne 1 100 0.00 255.0 FORMAT "%5.1" ECU_ADDRESS 0x60037192 /end MEASUREMENT
/begin MEASUREMENT DFC_st.DFC_MOXEMM_SMU_ALM11_8 "Status of DFC / Status of diagnostic fault check DFC_MOXEMM_SMU_ALM11_8" UBYTE DFC_OneToOne 1 100 0.00 255.0 FORMAT "%5.1" ECU_ADDRESS 0x60037193 /end MEASUREMENT
/begin MEASUREMENT DFC_st.DFC_MOXEMM_SMU_ALM11_9 "Status of DFC / Status of diagnostic fault check DFC_MOXEMM_SMU_ALM11_9" UBYTE DFC_OneToOne 1 100 0.00 255.0 FORMAT "%5.1" ECU_ADDRESS 0x60037194 /end MEASUREMENT
/begin MEASUREMENT DFC_st.DFC_MOXEMM_SMU_ALM1_0 "Status of DFC / Status of diagnostic fault check DFC_MOXEMM_SMU_ALM1_0" UBYTE DFC_OneToOne 1 100 0.00 255.0 FORMAT "%5.1" ECU_ADDRESS 0x60037195 /end MEASUREMENT
/begin MEASUREMENT DFC_st.DFC_MOXEMM_SMU_ALM1_1 "Status of DFC / Status of diagnostic fault check DFC_MOXEMM_SMU_ALM1_1" UBYTE DFC_OneToOne 1 100 0.00 255.0 FORMAT "%5.1" ECU_ADDRESS 0x60037196 /end MEASUREMENT
/begin MEASUREMENT DFC_st.DFC_MOXEMM_SMU_ALM1_10 "Status of DFC / Status of diagnostic fault check DFC_MOXEMM_SMU_ALM1_10" UBYTE DFC_OneToOne 1 100 0.00 255.0 FORMAT "%5.1" ECU_ADDRESS 0x60037197 /end MEASUREMENT
/begin MEASUREMENT DFC_st.DFC_MOXEMM_SMU_ALM1_11 "Status of DFC / Status of diagnostic fault check DFC_MOXEMM_SMU_ALM1_11" UBYTE DFC_OneToOne 1 100 0.00 255.0 FORMAT "%5.1" ECU_ADDRESS 0x60037198 /end MEASUREMENT
/begin MEASUREMENT DFC_st.DFC_MOXEMM_SMU_ALM1_13 "Status of DFC / Status of diagnostic fault check DFC_MOXEMM_SMU_ALM1_13" UBYTE DFC_OneToOne 1 100 0.00 255.0 FORMAT "%5.1" ECU_ADDRESS 0x60037199 /end MEASUREMENT
/begin MEASUREMENT DFC_st.DFC_MOXEMM_SMU_ALM1_14 "Status of DFC / Status of diagnostic fault check DFC_MOXEMM_SMU_ALM1_14" UBYTE DFC_OneToOne 1 100 0.00 255.0 FORMAT "%5.1" ECU_ADDRESS 0x6003719A /end MEASUREMENT
/begin MEASUREMENT DFC_st.DFC_MOXEMM_SMU_ALM1_2 "Status of DFC / Status of diagnostic fault check DFC_MOXEMM_SMU_ALM1_2" UBYTE DFC_OneToOne 1 100 0.00 255.0 FORMAT "%5.1" ECU_ADDRESS 0x6003719B /end MEASUREMENT
/begin MEASUREMENT DFC_st.DFC_MOXEMM_SMU_ALM1_22 "Status of DFC / Status of diagnostic fault check DFC_MOXEMM_SMU_ALM1_22" UBYTE DFC_OneToOne 1 100 0.00 255.0 FORMAT "%5.1" ECU_ADDRESS 0x6003719C /end MEASUREMENT
/begin MEASUREMENT DFC_st.DFC_MOXEMM_SMU_ALM1_23 "Status of DFC / Status of diagnostic fault check DFC_MOXEMM_SMU_ALM1_23" UBYTE DFC_OneToOne 1 100 0.00 255.0 FORMAT "%5.1" ECU_ADDRESS 0x6003719D /end MEASUREMENT
/begin MEASUREMENT DFC_st.DFC_MOXEMM_SMU_ALM1_4 "Status of DFC / Status of diagnostic fault check DFC_MOXEMM_SMU_ALM1_4" UBYTE DFC_OneToOne 1 100 0.00 255.0 FORMAT "%5.1" ECU_ADDRESS 0x6003719E /end MEASUREMENT
/begin MEASUREMENT DFC_st.DFC_MOXEMM_SMU_ALM1_5 "Status of DFC / Status of diagnostic fault check DFC_MOXEMM_SMU_ALM1_5" UBYTE DFC_OneToOne 1 100 0.00 255.0 FORMAT "%5.1" ECU_ADDRESS 0x6003719F /end MEASUREMENT
/begin MEASUREMENT DFC_st.DFC_MOXEMM_SMU_ALM1_7 "Status of DFC / Status of diagnostic fault check DFC_MOXEMM_SMU_ALM1_7" UBYTE DFC_OneToOne 1 100 0.00 255.0 FORMAT "%5.1" ECU_ADDRESS 0x600371A0 /end MEASUREMENT
/begin MEASUREMENT DFC_st.DFC_MOXEMM_SMU_ALM1_8 "Status of DFC / Status of diagnostic fault check DFC_MOXEMM_SMU_ALM1_8" UBYTE DFC_OneToOne 1 100 0.00 255.0 FORMAT "%5.1" ECU_ADDRESS 0x600371A1 /end MEASUREMENT
/begin MEASUREMENT DFC_st.DFC_MOXEMM_SMU_ALM21_0 "Status of DFC / Status of diagnostic fault check DFC_MOXEMM_SMU_ALM21_0" UBYTE DFC_OneToOne 1 100 0.00 255.0 FORMAT "%5.1" ECU_ADDRESS 0x600371A2 /end MEASUREMENT
/begin MEASUREMENT DFC_st.DFC_MOXEMM_SMU_ALM21_16 "Status of DFC / Status of diagnostic fault check DFC_MOXEMM_SMU_ALM21_16" UBYTE DFC_OneToOne 1 100 0.00 255.0 FORMAT "%5.1" ECU_ADDRESS 0x600371A3 /end MEASUREMENT
/begin MEASUREMENT DFC_st.DFC_MOXEMM_SMU_ALM21_3 "Status of DFC / Status of diagnostic fault check DFC_MOXEMM_SMU_ALM21_3" UBYTE DFC_OneToOne 1 100 0.00 255.0 FORMAT "%5.1" ECU_ADDRESS 0x600371A4 /end MEASUREMENT
/begin MEASUREMENT DFC_st.DFC_MOXEMM_SMU_ALM2_1 "Status of DFC / Status of diagnostic fault check DFC_MOXEMM_SMU_ALM2_1" UBYTE DFC_OneToOne 1 100 0.00 255.0 FORMAT "%5.1" ECU_ADDRESS 0x600371A5 /end MEASUREMENT
/begin MEASUREMENT DFC_st.DFC_MOXEMM_SMU_ALM2_10 "Status of DFC / Status of diagnostic fault check DFC_MOXEMM_SMU_ALM2_10" UBYTE DFC_OneToOne 1 100 0.00 255.0 FORMAT "%5.1" ECU_ADDRESS 0x600371A6 /end MEASUREMENT
/begin MEASUREMENT DFC_st.DFC_MOXEMM_SMU_ALM2_11 "Status of DFC / Status of diagnostic fault check DFC_MOXEMM_SMU_ALM2_11" UBYTE DFC_OneToOne 1 100 0.00 255.0 FORMAT "%5.1" ECU_ADDRESS 0x600371A7 /end MEASUREMENT
/begin MEASUREMENT DFC_st.DFC_MOXEMM_SMU_ALM2_13 "Status of DFC / Status of diagnostic fault check DFC_MOXEMM_SMU_ALM2_13" UBYTE DFC_OneToOne 1 100 0.00 255.0 FORMAT "%5.1" ECU_ADDRESS 0x600371A8 /end MEASUREMENT
/begin MEASUREMENT DFC_st.DFC_MOXEMM_SMU_ALM2_14 "Status of DFC / Status of diagnostic fault check DFC_MOXEMM_SMU_ALM2_14" UBYTE DFC_OneToOne 1 100 0.00 255.0 FORMAT "%5.1" ECU_ADDRESS 0x600371A9 /end MEASUREMENT
/begin MEASUREMENT DFC_st.DFC_MOXEMM_SMU_ALM2_22 "Status of DFC / Status of diagnostic fault check DFC_MOXEMM_SMU_ALM2_22" UBYTE DFC_OneToOne 1 100 0.00 255.0 FORMAT "%5.1" ECU_ADDRESS 0x600371AA /end MEASUREMENT
/begin MEASUREMENT DFC_st.DFC_MOXEMM_SMU_ALM2_23 "Status of DFC / Status of diagnostic fault check DFC_MOXEMM_SMU_ALM2_23" UBYTE DFC_OneToOne 1 100 0.00 255.0 FORMAT "%5.1" ECU_ADDRESS 0x600371AB /end MEASUREMENT
/begin MEASUREMENT DFC_st.DFC_MOXEMM_SMU_ALM2_4 "Status of DFC / Status of diagnostic fault check DFC_MOXEMM_SMU_ALM2_4" UBYTE DFC_OneToOne 1 100 0.00 255.0 FORMAT "%5.1" ECU_ADDRESS 0x600371AC /end MEASUREMENT
/begin MEASUREMENT DFC_st.DFC_MOXEMM_SMU_ALM2_5 "Status of DFC / Status of diagnostic fault check DFC_MOXEMM_SMU_ALM2_5" UBYTE DFC_OneToOne 1 100 0.00 255.0 FORMAT "%5.1" ECU_ADDRESS 0x600371AD /end MEASUREMENT
/begin MEASUREMENT DFC_st.DFC_MOXEMM_SMU_ALM2_7 "Status of DFC / Status of diagnostic fault check DFC_MOXEMM_SMU_ALM2_7" UBYTE DFC_OneToOne 1 100 0.00 255.0 FORMAT "%5.1" ECU_ADDRESS 0x600371AE /end MEASUREMENT
/begin MEASUREMENT DFC_st.DFC_MOXEMM_SMU_ALM2_8 "Status of DFC / Status of diagnostic fault check DFC_MOXEMM_SMU_ALM2_8" UBYTE DFC_OneToOne 1 100 0.00 255.0 FORMAT "%5.1" ECU_ADDRESS 0x600371AF /end MEASUREMENT
/begin MEASUREMENT DFC_st.DFC_MOXEMM_SMU_ALM6_0 "Status of DFC / Status of diagnostic fault check DFC_MOXEMM_SMU_ALM6_0" UBYTE DFC_OneToOne 1 100 0.00 255.0 FORMAT "%5.1" ECU_ADDRESS 0x600371B0 /end MEASUREMENT
/begin MEASUREMENT DFC_st.DFC_MOXEMM_SMU_ALM6_11 "Status of DFC / Status of diagnostic fault check DFC_MOXEMM_SMU_ALM6_11" UBYTE DFC_OneToOne 1 100 0.00 255.0 FORMAT "%5.1" ECU_ADDRESS 0x600371B1 /end MEASUREMENT
/begin MEASUREMENT DFC_st.DFC_MOXEMM_SMU_ALM6_12 "Status of DFC / Status of diagnostic fault check DFC_MOXEMM_SMU_ALM6_12" UBYTE DFC_OneToOne 1 100 0.00 255.0 FORMAT "%5.1" ECU_ADDRESS 0x600371B2 /end MEASUREMENT
/begin MEASUREMENT DFC_st.DFC_MOXEMM_SMU_ALM6_14 "Status of DFC / Status of diagnostic fault check DFC_MOXEMM_SMU_ALM6_14" UBYTE DFC_OneToOne 1 100 0.00 255.0 FORMAT "%5.1" ECU_ADDRESS 0x600371B3 /end MEASUREMENT
/begin MEASUREMENT DFC_st.DFC_MOXEMM_SMU_ALM6_15 "Status of DFC / Status of diagnostic fault check DFC_MOXEMM_SMU_ALM6_15" UBYTE DFC_OneToOne 1 100 0.00 255.0 FORMAT "%5.1" ECU_ADDRESS 0x600371B4 /end MEASUREMENT
/begin MEASUREMENT DFC_st.DFC_MOXEMM_SMU_ALM6_17 "Status of DFC / Status of diagnostic fault check DFC_MOXEMM_SMU_ALM6_17" UBYTE DFC_OneToOne 1 100 0.00 255.0 FORMAT "%5.1" ECU_ADDRESS 0x600371B5 /end MEASUREMENT
/begin MEASUREMENT DFC_st.DFC_MOXEMM_SMU_ALM6_18 "Status of DFC / Status of diagnostic fault check DFC_MOXEMM_SMU_ALM6_18" UBYTE DFC_OneToOne 1 100 0.00 255.0 FORMAT "%5.1" ECU_ADDRESS 0x600371B6 /end MEASUREMENT
/begin MEASUREMENT DFC_st.DFC_MOXEMM_SMU_ALM6_20 "Status of DFC / Status of diagnostic fault check DFC_MOXEMM_SMU_ALM6_20" UBYTE DFC_OneToOne 1 100 0.00 255.0 FORMAT "%5.1" ECU_ADDRESS 0x600371B7 /end MEASUREMENT
/begin MEASUREMENT DFC_st.DFC_MOXEMM_SMU_ALM6_21 "Status of DFC / Status of diagnostic fault check DFC_MOXEMM_SMU_ALM6_21" UBYTE DFC_OneToOne 1 100 0.00 255.0 FORMAT "%5.1" ECU_ADDRESS 0x600371B8 /end MEASUREMENT
/begin MEASUREMENT DFC_st.DFC_MOXEMM_SMU_ALM6_25 "Status of DFC / Status of diagnostic fault check DFC_MOXEMM_SMU_ALM6_25" UBYTE DFC_OneToOne 1 100 0.00 255.0 FORMAT "%5.1" ECU_ADDRESS 0x600371B9 /end MEASUREMENT
/begin MEASUREMENT DFC_st.DFC_MOXEMM_SMU_ALM6_4 "Status of DFC / Status of diagnostic fault check DFC_MOXEMM_SMU_ALM6_4" UBYTE DFC_OneToOne 1 100 0.00 255.0 FORMAT "%5.1" ECU_ADDRESS 0x600371BA /end MEASUREMENT
/begin MEASUREMENT DFC_st.DFC_MOXEMM_SMU_ALM6_5 "Status of DFC / Status of diagnostic fault check DFC_MOXEMM_SMU_ALM6_5" UBYTE DFC_OneToOne 1 100 0.00 255.0 FORMAT "%5.1" ECU_ADDRESS 0x600371BB /end MEASUREMENT
/begin MEASUREMENT DFC_st.DFC_MOXEMM_SMU_ALM6_7 "Status of DFC / Status of diagnostic fault check DFC_MOXEMM_SMU_ALM6_7" UBYTE DFC_OneToOne 1 100 0.00 255.0 FORMAT "%5.1" ECU_ADDRESS 0x600371BC /end MEASUREMENT
/begin MEASUREMENT DFC_st.DFC_MOXEMM_SMU_ALM6_8 "Status of DFC / Status of diagnostic fault check DFC_MOXEMM_SMU_ALM6_8" UBYTE DFC_OneToOne 1 100 0.00 255.0 FORMAT "%5.1" ECU_ADDRESS 0x600371BD /end MEASUREMENT
/begin MEASUREMENT DFC_st.DFC_MOXEMM_SMU_ALM7_1 "Status of DFC / Status of diagnostic fault check DFC_MOXEMM_SMU_ALM7_1" UBYTE DFC_OneToOne 1 100 0.00 255.0 FORMAT "%5.1" ECU_ADDRESS 0x600371BE /end MEASUREMENT
/begin MEASUREMENT DFC_st.DFC_MOXEMM_SMU_ALM7_12 "Status of DFC / Status of diagnostic fault check DFC_MOXEMM_SMU_ALM7_12" UBYTE DFC_OneToOne 1 100 0.00 255.0 FORMAT "%5.1" ECU_ADDRESS 0x600371BF /end MEASUREMENT
/begin MEASUREMENT DFC_st.DFC_MOXEMM_SMU_ALM7_13 "Status of DFC / Status of diagnostic fault check DFC_MOXEMM_SMU_ALM7_13" UBYTE DFC_OneToOne 1 100 0.00 255.0 FORMAT "%5.1" ECU_ADDRESS 0x600371C0 /end MEASUREMENT
/begin MEASUREMENT DFC_st.DFC_MOXEMM_SMU_ALM7_14 "Status of DFC / Status of diagnostic fault check DFC_MOXEMM_SMU_ALM7_14" UBYTE DFC_OneToOne 1 100 0.00 255.0 FORMAT "%5.1" ECU_ADDRESS 0x600371C1 /end MEASUREMENT
/begin MEASUREMENT DFC_st.DFC_MOXEMM_SMU_ALM7_15 "Status of DFC / Status of diagnostic fault check DFC_MOXEMM_SMU_ALM7_15" UBYTE DFC_OneToOne 1 100 0.00 255.0 FORMAT "%5.1" ECU_ADDRESS 0x600371C2 /end MEASUREMENT
/begin MEASUREMENT DFC_st.DFC_MOXEMM_SMU_ALM7_16 "Status of DFC / Status of diagnostic fault check DFC_MOXEMM_SMU_ALM7_16" UBYTE DFC_OneToOne 1 100 0.00 255.0 FORMAT "%5.1" ECU_ADDRESS 0x600371C3 /end MEASUREMENT
/begin MEASUREMENT DFC_st.DFC_MOXEMM_SMU_ALM7_17 "Status of DFC / Status of diagnostic fault check DFC_MOXEMM_SMU_ALM7_17" UBYTE DFC_OneToOne 1 100 0.00 255.0 FORMAT "%5.1" ECU_ADDRESS 0x600371C4 /end MEASUREMENT
/begin MEASUREMENT DFC_st.DFC_MOXEMM_SMU_ALM7_2 "Status of DFC / Status of diagnostic fault check DFC_MOXEMM_SMU_ALM7_2" UBYTE DFC_OneToOne 1 100 0.00 255.0 FORMAT "%5.1" ECU_ADDRESS 0x600371C5 /end MEASUREMENT
/begin MEASUREMENT DFC_st.DFC_MOXEMM_SMU_ALM7_20 "Status of DFC / Status of diagnostic fault check DFC_MOXEMM_SMU_ALM7_20" UBYTE DFC_OneToOne 1 100 0.00 255.0 FORMAT "%5.1" ECU_ADDRESS 0x600371C6 /end MEASUREMENT
/begin MEASUREMENT DFC_st.DFC_MOXEMM_SMU_ALM7_25 "Status of DFC / Status of diagnostic fault check DFC_MOXEMM_SMU_ALM7_25" UBYTE DFC_OneToOne 1 100 0.00 255.0 FORMAT "%5.1" ECU_ADDRESS 0x600371C7 /end MEASUREMENT
/begin MEASUREMENT DFC_st.DFC_MOXEMM_SMU_ALM7_26 "Status of DFC / Status of diagnostic fault check DFC_MOXEMM_SMU_ALM7_26" UBYTE DFC_OneToOne 1 100 0.00 255.0 FORMAT "%5.1" ECU_ADDRESS 0x600371C8 /end MEASUREMENT
/begin MEASUREMENT DFC_st.DFC_MOXEMM_SMU_ALM7_28 "Status of DFC / Status of diagnostic fault check DFC_MOXEMM_SMU_ALM7_28" UBYTE DFC_OneToOne 1 100 0.00 255.0 FORMAT "%5.1" ECU_ADDRESS 0x600371C9 /end MEASUREMENT
/begin MEASUREMENT DFC_st.DFC_MOXEMM_SMU_ALM7_29 "Status of DFC / Status of diagnostic fault check DFC_MOXEMM_SMU_ALM7_29" UBYTE DFC_OneToOne 1 100 0.00 255.0 FORMAT "%5.1" ECU_ADDRESS 0x600371CA /end MEASUREMENT
/begin MEASUREMENT DFC_st.DFC_MOXEMM_SMU_ALM7_30 "Status of DFC / Status of diagnostic fault check DFC_MOXEMM_SMU_ALM7_30" UBYTE DFC_OneToOne 1 100 0.00 255.0 FORMAT "%5.1" ECU_ADDRESS 0x600371CB /end MEASUREMENT
/begin MEASUREMENT DFC_st.DFC_MOXEMM_SMU_ALM7_31 "Status of DFC / Status of diagnostic fault check DFC_MOXEMM_SMU_ALM7_31" UBYTE DFC_OneToOne 1 100 0.00 255.0 FORMAT "%5.1" ECU_ADDRESS 0x600371CC /end MEASUREMENT
/begin MEASUREMENT DFC_st.DFC_MOXEMM_SMU_ALM8_0 "Status of DFC / Status of diagnostic fault check DFC_MOXEMM_SMU_ALM8_0" UBYTE DFC_OneToOne 1 100 0.00 255.0 FORMAT "%5.1" ECU_ADDRESS 0x600371CD /end MEASUREMENT
/begin MEASUREMENT DFC_st.DFC_MOXEMM_SMU_ALM8_1 "Status of DFC / Status of diagnostic fault check DFC_MOXEMM_SMU_ALM8_1" UBYTE DFC_OneToOne 1 100 0.00 255.0 FORMAT "%5.1" ECU_ADDRESS 0x600371CE /end MEASUREMENT
/begin MEASUREMENT DFC_st.DFC_MOXEMM_SMU_ALM8_10 "Status of DFC / Status of diagnostic fault check DFC_MOXEMM_SMU_ALM8_10" UBYTE DFC_OneToOne 1 100 0.00 255.0 FORMAT "%5.1" ECU_ADDRESS 0x600371CF /end MEASUREMENT
/begin MEASUREMENT DFC_st.DFC_MOXEMM_SMU_ALM8_11 "Status of DFC / Status of diagnostic fault check DFC_MOXEMM_SMU_ALM8_11" UBYTE DFC_OneToOne 1 100 0.00 255.0 FORMAT "%5.1" ECU_ADDRESS 0x600371D0 /end MEASUREMENT
/begin MEASUREMENT DFC_st.DFC_MOXEMM_SMU_ALM8_12 "Status of DFC / Status of diagnostic fault check DFC_MOXEMM_SMU_ALM8_12" UBYTE DFC_OneToOne 1 100 0.00 255.0 FORMAT "%5.1" ECU_ADDRESS 0x600371D1 /end MEASUREMENT
/begin MEASUREMENT DFC_st.DFC_MOXEMM_SMU_ALM8_16 "Status of DFC / Status of diagnostic fault check DFC_MOXEMM_SMU_ALM8_16" UBYTE DFC_OneToOne 1 100 0.00 255.0 FORMAT "%5.1" ECU_ADDRESS 0x600371D2 /end MEASUREMENT
/begin MEASUREMENT DFC_st.DFC_MOXEMM_SMU_ALM8_18 "Status of DFC / Status of diagnostic fault check DFC_MOXEMM_SMU_ALM8_18" UBYTE DFC_OneToOne 1 100 0.00 255.0 FORMAT "%5.1" ECU_ADDRESS 0x600371D3 /end MEASUREMENT
/begin MEASUREMENT DFC_st.DFC_MOXEMM_SMU_ALM8_2 "Status of DFC / Status of diagnostic fault check DFC_MOXEMM_SMU_ALM8_2" UBYTE DFC_OneToOne 1 100 0.00 255.0 FORMAT "%5.1" ECU_ADDRESS 0x600371D4 /end MEASUREMENT
/begin MEASUREMENT DFC_st.DFC_MOXEMM_SMU_ALM8_3 "Status of DFC / Status of diagnostic fault check DFC_MOXEMM_SMU_ALM8_3" UBYTE DFC_OneToOne 1 100 0.00 255.0 FORMAT "%5.1" ECU_ADDRESS 0x600371D5 /end MEASUREMENT
/begin MEASUREMENT DFC_st.DFC_MOXEMM_SMU_ALM8_31 "Status of DFC / Status of diagnostic fault check DFC_MOXEMM_SMU_ALM8_31" UBYTE DFC_OneToOne 1 100 0.00 255.0 FORMAT "%5.1" ECU_ADDRESS 0x600371D6 /end MEASUREMENT
/begin MEASUREMENT DFC_st.DFC_MOXEMM_SMU_ALM8_4 "Status of DFC / Status of diagnostic fault check DFC_MOXEMM_SMU_ALM8_4" UBYTE DFC_OneToOne 1 100 0.00 255.0 FORMAT "%5.1" ECU_ADDRESS 0x600371D7 /end MEASUREMENT
/begin MEASUREMENT DFC_st.DFC_MOXEMM_SMU_ALM9_0 "Status of DFC / Status of diagnostic fault check DFC_MOXEMM_SMU_ALM9_0" UBYTE DFC_OneToOne 1 100 0.00 255.0 FORMAT "%5.1" ECU_ADDRESS 0x600371D8 /end MEASUREMENT
/begin MEASUREMENT DFC_st.DFC_MOXEMM_SMU_ALM9_15 "Status of DFC / Status of diagnostic fault check DFC_MOXEMM_SMU_ALM9_15" UBYTE DFC_OneToOne 1 100 0.00 255.0 FORMAT "%5.1" ECU_ADDRESS 0x600371D9 /end MEASUREMENT
/begin MEASUREMENT DFC_st.DFC_MOXEMM_SMU_ALM9_3 "Status of DFC / Status of diagnostic fault check DFC_MOXEMM_SMU_ALM9_3" UBYTE DFC_OneToOne 1 100 0.00 255.0 FORMAT "%5.1" ECU_ADDRESS 0x600371DA /end MEASUREMENT
/begin MEASUREMENT DFC_st.DFC_MoCADCNTP "Status of DFC / Status of diagnostic fault check DFC_MoCADCNTP" UBYTE DFC_OneToOne 1 100 0.00 255.0 FORMAT "%5.1" ECU_ADDRESS 0x600371DB /end MEASUREMENT
/begin MEASUREMENT DFC_st.DFC_MoCADCTst "Status of DFC / Status of diagnostic fault check DFC_MoCADCTst" UBYTE DFC_OneToOne 1 100 0.00 255.0 FORMAT "%5.1" ECU_ADDRESS 0x600371DC /end MEASUREMENT
/begin MEASUREMENT DFC_st.DFC_MoCSOPICO "Status of DFC / Status of diagnostic fault check DFC_MoCSOPICO" UBYTE DFC_OneToOne 1 100 0.00 255.0 FORMAT "%5.1" ECU_ADDRESS 0x600371DD /end MEASUREMENT
/begin MEASUREMENT DFC_st.DFC_MoFAPP "Status of DFC / Status of diagnostic fault check DFC_MoFAPP" UBYTE DFC_OneToOne 1 100 0.00 255.0 FORMAT "%5.1" ECU_ADDRESS 0x600371DE /end MEASUREMENT
/begin MEASUREMENT DFC_st.DFC_MoFAirFilgPrdc "Status of DFC / Status of diagnostic fault check DFC_MoFAirFilgPrdc" UBYTE DFC_OneToOne 1 100 0.00 255.0 FORMAT "%5.1" ECU_ADDRESS 0x600371DF /end MEASUREMENT
/begin MEASUREMENT DFC_st.DFC_MoFAirFlCtOffGdi "Status of DFC / Status of diagnostic fault check DFC_MoFAirFlCtOffGdi" UBYTE DFC_OneToOne 1 100 0.00 255.0 FORMAT "%5.1" ECU_ADDRESS 0x600371E0 /end MEASUREMENT
/begin MEASUREMENT DFC_st.DFC_MoFAirFlCylGdi "Status of DFC / Status of diagnostic fault check DFC_MoFAirFlCylGdi" UBYTE DFC_OneToOne 1 100 0.00 255.0 FORMAT "%5.1" ECU_ADDRESS 0x600371E1 /end MEASUREMENT
/begin MEASUREMENT DFC_st.DFC_MoFAirFlFF "Status of DFC / Status of diagnostic fault check DFC_MoFAirFlFF" UBYTE DFC_OneToOne 1 100 0.00 255.0 FORMAT "%5.1" ECU_ADDRESS 0x600371E2 /end MEASUREMENT
/begin MEASUREMENT DFC_st.DFC_MoFAirFlIn "Status of DFC / Status of diagnostic fault check DFC_MoFAirFlIn" UBYTE DFC_OneToOne 1 100 0.00 255.0 FORMAT "%5.1" ECU_ADDRESS 0x600371E3 /end MEASUREMENT
/begin MEASUREMENT DFC_st.DFC_MoFAirFlMixCtlGdiChkAirFl "Status of DFC / Status of diagnostic fault check DFC_MoFAirFlMixCtlGdiChkAirFl" UBYTE DFC_OneToOne 1 100 0.00 255.0 FORMAT "%5.1" ECU_ADDRESS 0x600371E4 /end MEASUREMENT
/begin MEASUREMENT DFC_st.DFC_MoFAirFlMixCtlGdiChkCtrl "Status of DFC / Status of diagnostic fault check DFC_MoFAirFlMixCtlGdiChkCtrl" UBYTE DFC_OneToOne 1 100 0.00 255.0 FORMAT "%5.1" ECU_ADDRESS 0x600371E5 /end MEASUREMENT
/begin MEASUREMENT DFC_st.DFC_MoFAirFlMode "Status of DFC / Status of diagnostic fault check DFC_MoFAirFlMode" UBYTE DFC_OneToOne 1 100 0.00 255.0 FORMAT "%5.1" ECU_ADDRESS 0x600371E6 /end MEASUREMENT
/begin MEASUREMENT DFC_st.DFC_MoFESpd "Status of DFC / Status of diagnostic fault check DFC_MoFESpd" UBYTE DFC_OneToOne 1 100 0.00 255.0 FORMAT "%5.1" ECU_ADDRESS 0x600371E7 /end MEASUREMENT
/begin MEASUREMENT DFC_st.DFC_MoFIACo "Status of DFC / Status of diagnostic fault check DFC_MoFIACo" UBYTE DFC_OneToOne 1 100 0.00 255.0 FORMAT "%5.1" ECU_ADDRESS 0x600371E8 /end MEASUREMENT
/begin MEASUREMENT DFC_st.DFC_MoFICOL1 "Status of DFC / Status of diagnostic fault check DFC_MoFICOL1" UBYTE DFC_OneToOne 1 100 0.00 255.0 FORMAT "%5.1" ECU_ADDRESS 0x600371E9 /end MEASUREMENT
/begin MEASUREMENT DFC_st.DFC_MoFICOL2 "Status of DFC / Status of diagnostic fault check DFC_MoFICOL2" UBYTE DFC_OneToOne 1 100 0.00 255.0 FORMAT "%5.1" ECU_ADDRESS 0x600371EA /end MEASUREMENT
/begin MEASUREMENT DFC_st.DFC_MoFStrt "Status of DFC / Status of diagnostic fault check DFC_MoFStrt" UBYTE DFC_OneToOne 1 100 0.00 255.0 FORMAT "%5.1" ECU_ADDRESS 0x600371EB /end MEASUREMENT
/begin MEASUREMENT DFC_st.DFC_MoFTrqCmp "Status of DFC / Status of diagnostic fault check DFC_MoFTrqCmp" UBYTE DFC_OneToOne 1 100 0.00 255.0 FORMAT "%5.1" ECU_ADDRESS 0x600371EC /end MEASUREMENT
/begin MEASUREMENT DFC_st.DFC_MoFTrqCmpMax "Status of DFC / Status of diagnostic fault check DFC_MoFTrqCmpMax" UBYTE DFC_OneToOne 1 100 0.00 255.0 FORMAT "%5.1" ECU_ADDRESS 0x600371ED /end MEASUREMENT
/begin MEASUREMENT DFC_st.DFC_MoFTrqCmpMin "Status of DFC / Status of diagnostic fault check DFC_MoFTrqCmpMin" UBYTE DFC_OneToOne 1 100 0.00 255.0 FORMAT "%5.1" ECU_ADDRESS 0x600371EE /end MEASUREMENT
/begin MEASUREMENT DFC_st.DFC_MoFVarPostBldSel "Status of DFC / Status of diagnostic fault check DFC_MoFVarPostBldSel" UBYTE DFC_OneToOne 1 100 0.00 255.0 FORMAT "%5.1" ECU_ADDRESS 0x600371EF /end MEASUREMENT
/begin MEASUREMENT DFC_st.DFC_MoXEMMHwLTMCUFW "Status of DFC / Status of diagnostic fault check DFC_MoXEMMHwLTMCUFW" UBYTE DFC_OneToOne 1 100 0.00 255.0 FORMAT "%5.1" ECU_ADDRESS 0x600371F0 /end MEASUREMENT
/begin MEASUREMENT DFC_st.DFC_MoXEMMHwLTMonBIST "Status of DFC / Status of diagnostic fault check DFC_MoXEMMHwLTMonBIST" UBYTE DFC_OneToOne 1 100 0.00 255.0 FORMAT "%5.1" ECU_ADDRESS 0x600371F1 /end MEASUREMENT
/begin MEASUREMENT DFC_st.DFC_MoXEMMHwLTRegMonTest "Status of DFC / Status of diagnostic fault check DFC_MoXEMMHwLTRegMonTest" UBYTE DFC_OneToOne 1 100 0.00 255.0 FORMAT "%5.1" ECU_ADDRESS 0x600371F2 /end MEASUREMENT
/begin MEASUREMENT DFC_st.DFC_MoXEMMHwLTStbySMUAlvTest "Status of DFC / Status of diagnostic fault check DFC_MoXEMMHwLTStbySMUAlvTest" UBYTE DFC_OneToOne 1 100 0.00 255.0 FORMAT "%5.1" ECU_ADDRESS 0x600371F3 /end MEASUREMENT
/begin MEASUREMENT DFC_st.DFC_MoXEMMHwLTTempSens "Status of DFC / Status of diagnostic fault check DFC_MoXEMMHwLTTempSens" UBYTE DFC_OneToOne 1 100 0.00 255.0 FORMAT "%5.1" ECU_ADDRESS 0x600371F4 /end MEASUREMENT
/begin MEASUREMENT DFC_st.DFC_MoXEMMHwLTUCBCfg "Status of DFC / Status of diagnostic fault check DFC_MoXEMMHwLTUCBCfg" UBYTE DFC_OneToOne 1 100 0.00 255.0 FORMAT "%5.1" ECU_ADDRESS 0x600371F5 /end MEASUREMENT
/begin MEASUREMENT DFC_st.DFC_NWSEmax "Status of DFC / Status of diagnostic fault check DFC_NWSEmax" UBYTE DFC_OneToOne 1 100 0.00 255.0 FORMAT "%5.1" ECU_ADDRESS 0x600371F6 /end MEASUREMENT
/begin MEASUREMENT DFC_st.DFC_NWSmax "Status of DFC / Status of diagnostic fault check DFC_NWSmax" UBYTE DFC_OneToOne 1 100 0.00 255.0 FORMAT "%5.1" ECU_ADDRESS 0x600371F7 /end MEASUREMENT
/begin MEASUREMENT DFC_st.DFC_OCWDAABEActv "Status of DFC / Status of diagnostic fault check DFC_OCWDAABEActv" UBYTE DFC_OneToOne 1 100 0.00 255.0 FORMAT "%5.1" ECU_ADDRESS 0x600371F8 /end MEASUREMENT
/begin MEASUREMENT DFC_st.DFC_OCWDACom "Status of DFC / Status of diagnostic fault check DFC_OCWDACom" UBYTE DFC_OneToOne 1 100 0.00 255.0 FORMAT "%5.1" ECU_ADDRESS 0x600371F9 /end MEASUREMENT
/begin MEASUREMENT DFC_st.DFC_OCWDAErrPin "Status of DFC / Status of diagnostic fault check DFC_OCWDAErrPin" UBYTE DFC_OneToOne 1 100 0.00 255.0 FORMAT "%5.1" ECU_ADDRESS 0x600371FA /end MEASUREMENT
/begin MEASUREMENT DFC_st.DFC_OCWDAOvrVltg "Status of DFC / Status of diagnostic fault check DFC_OCWDAOvrVltg" UBYTE DFC_OneToOne 1 100 0.00 255.0 FORMAT "%5.1" ECU_ADDRESS 0x600371FB /end MEASUREMENT
/begin MEASUREMENT DFC_st.DFC_ORAmax "Status of DFC / Status of diagnostic fault check DFC_ORAmax" UBYTE DFC_OneToOne 1 100 0.00 255.0 FORMAT "%5.1" ECU_ADDRESS 0x600371FC /end MEASUREMENT
/begin FUNCTION DFC "30000.33.0_1.1.0Diagnostic Fault Check"
 /begin OUT_MEASUREMENT DFC_b.TSC_ThrVlvRetSprgSprdB1 DFC_b.TSC_ThrVlvRetSprgTwnB1 DFC_b.TSC_ThrVlvSens1MaxB1 DFC_b.TSC_ThrVlvSens1NplB1 DFC_b.TSC_ThrVlvSens2MaxB1 DFC_b.TSC_ThrVlvSens2MinB1 DFC_b.TSC_ThrVlvSens2NplB1 DFC_b.TSC_ThrVlvShoCircB1 DFC_b.TSC_ThrVlvSpiErrB1 DFC_b.TSC_ThrvlvSens1MinB1 DFC_b.TSC_TiOffTBasdChkFast DFC_b.TSC_TiOffTBasdChkSlow DFC_b.TSC_UEGOSnsrMntdS1B1 DFC_b.TSC_VehVSig DFC_b.TSC_VlvLftFbSwtIntk11SpclFail DFC_b.TSC_VlvLftFbSwtIntk11StdFail DFC_st.DFC_Unused DFC_st.DFC_AAVEmax DFC_st.DFC_AAVEmin DFC_st.DFC_AAVEsig DFC_st.DFC_AltIOACGFailr DFC_st.DFC_AltIOACGHiVltg DFC_st.DFC_AltIOACGLoVltg DFC_st.DFC_AltIOACGTHi DFC_st.DFC_AltIODConnACG DFC_st.DFC_BGOELWAF DFC_st.DFC_BattUHiFailr DFC_st.DFC_BattULoFailr DFC_st.DFC_BrkBstPDriftHiErr DFC_st.DFC_BrkBstPDriftLoErr DFC_st.DFC_BrkBstPSnsrStuck DFC_st.DFC_BrkMnSwtContOn DFC_st.DFC_BrkMnSwtNotStp DFC_st.DFC_BrkNpl DFC_st.DFC_BrkRdntSwtContOn DFC_st.DFC_BrkRdntSwtNotStp DFC_st.DFC_Clth3ONStuck DFC_st.DFC_Clth4OFFStuck DFC_st.DFC_ClthOFFStuck DFC_st.DFC_ClthONStuck DFC_st.DFC_ClthStkFailInfo DFC_st.DFC_ComACFailInfo DFC_st.DFC_ComATFTValErr DFC_st.DFC_ComATMILReq DFC_st.DFC_ComAYCAChksum DFC_st.DFC_ComAYCARingCnt DFC_st.DFC_ComAYCATOut DFC_st.DFC_ComAYCDChkSum DFC_st.DFC_ComAYCDTOut DFC_st.DFC_ComAYCFChksum DFC_st.DFC_ComAYCFRingCnt DFC_st.DFC_ComAYCFTOut DFC_st.DFC_ComAYCGChksum DFC_st.DFC_ComAYCGRingCnt DFC_st.DFC_ComAYCGTOut DFC_st.DFC_ComAYCIChkSum DFC_st.DFC_ComAYCIRingCnt DFC_st.DFC_ComAYCITOut DFC_st.DFC_ComBCM1ChkSum DFC_st.DFC_ComBCM1RingCnt DFC_st.DFC_ComBCM1TOut DFC_st.DFC_ComCANABusOffErr DFC_st.DFC_ComCANBBusOffErr DFC_st.DFC_ComCANCBusOffErr DFC_st.DFC_ComCGW1ChkSum DFC_st.DFC_ComCGW1RingCnt DFC_st.DFC_ComCGW1TOut DFC_st.DFC_ComConvBoostErr DFC_st.DFC_ComConvSlipErr DFC_st.DFC_ComDCDCPrfmncErr DFC_st.DFC_ComDCDCTempWarn DFC_st.DFC_ComEAT10Chksum DFC_st.DFC_ComEAT10RingCnt DFC_st.DFC_ComEAT10TOut DFC_st.DFC_ComEAT11ChkSum DFC_st.DFC_ComEAT11RingCnt DFC_st.DFC_ComEAT11TOut DFC_st.DFC_ComEAT12ChkSum DFC_st.DFC_ComEAT12RingCnt DFC_st.DFC_ComEAT12TOut DFC_st.DFC_ComEAT13ChkSum DFC_st.DFC_ComEAT13RingCnt DFC_st.DFC_ComEAT13TOut DFC_st.DFC_ComEAT1Chksum DFC_st.DFC_ComEAT1RingCnt DFC_st.DFC_ComEAT1TOut DFC_st.DFC_ComEAT2ChkSum DFC_st.DFC_ComEAT2RingCnt DFC_st.DFC_ComEAT2TOut DFC_st.DFC_ComEAT4ChkSum DFC_st.DFC_ComEAT4RingCnt DFC_st.DFC_ComEAT4TOut DFC_st.DFC_ComEAT6Chksum DFC_st.DFC_ComEAT6RingCnt DFC_st.DFC_ComEAT6TOut DFC_st.DFC_ComEAT7Chksum DFC_st.DFC_ComEAT7RingCnt DFC_st.DFC_ComEAT7TOut DFC_st.DFC_ComEAT8Chksum DFC_st.DFC_ComEAT8RingCnt DFC_st.DFC_ComEAT8TOut DFC_st.DFC_ComEATAChksum DFC_st.DFC_ComEATARingCnt DFC_st.DFC_ComEATATOut DFC_st.DFC_ComEATBChkSum DFC_st.DFC_ComEATBRingCnt DFC_st.DFC_ComEATBTOut DFC_st.DFC_ComEATCChksum DFC_st.DFC_ComEATCRingCnt DFC_st.DFC_ComEATCTOut DFC_st.DFC_ComEPBBChkSum DFC_st.DFC_ComEPBBRingCnt DFC_st.DFC_ComEPBBTOut DFC_st.DFC_ComEPBChksum DFC_st.DFC_ComEPBTOut DFC_st.DFC_ComEPBctRing DFC_st.DFC_ComEPS1Chksum DFC_st.DFC_ComEPS1RingCnt DFC_st.DFC_ComEPS1TOut DFC_st.DFC_ComEngCanRxErr DFC_st.DFC_ComGrvySnsrErr DFC_st.DFC_ComGwIMG1ChkSum DFC_st.DFC_ComGwIMG1RingCnt DFC_st.DFC_ComGwIMG1TOut DFC_st.DFC_ComGwIMG3ChkSum DFC_st.DFC_ComGwIMG3RingCnt DFC_st.DFC_ComGwIMG3TOut DFC_st.DFC_ComGwIMG4ChkSum DFC_st.DFC_ComGwIMG4RingCnt DFC_st.DFC_ComGwIMG4TOut DFC_st.DFC_ComGwIMG5ChkSum DFC_st.DFC_ComGwIMG5RingCnt DFC_st.DFC_ComGwIMG5TOut DFC_st.DFC_ComGwIMG6ChkSum DFC_st.DFC_ComGwIMG6RingCnt DFC_st.DFC_ComGwIMG6TOut DFC_st.DFC_ComIDASBChksum DFC_st.DFC_ComIDASBRingCnt DFC_st.DFC_ComIDASBTOut DFC_st.DFC_ComIMGMILReq DFC_st.DFC_ComISSPrms DFC_st.DFC_ComMETAChksum DFC_st.DFC_ComMETAChksumPstDrv DFC_st.DFC_ComMETARingCnt DFC_st.DFC_ComMETARingCntPstDrv DFC_st.DFC_ComMETATOut DFC_st.DFC_ComMETATOutPstDrv DFC_st.DFC_ComMETCChksum DFC_st.DFC_ComMETCRingCnt DFC_st.DFC_ComMETCTOut DFC_st.DFC_ComMETDChksum DFC_st.DFC_ComMETDRingCnt DFC_st.DFC_ComMETDTOut DFC_st.DFC_ComMETE2Chksum DFC_st.DFC_ComMETE2RingCnt DFC_st.DFC_ComMETE2TOut DFC_st.DFC_ComMETFChksum DFC_st.DFC_ComMETFRingCnt DFC_st.DFC_ComMETFTOut DFC_st.DFC_ComMETGChksum DFC_st.DFC_ComMETGRingCnt DFC_st.DFC_ComMETGTOut DFC_st.DFC_ComMETH2Chksum DFC_st.DFC_ComMETH2RingCnt DFC_st.DFC_ComMETH2TOut DFC_st.DFC_ComMETHChksum DFC_st.DFC_ComMETHRingCnt DFC_st.DFC_ComMETHTOut DFC_st.DFC_ComMETIChksum DFC_st.DFC_ComMETIRingCnt DFC_st.DFC_ComMETITOut DFC_st.DFC_ComMETKChksum DFC_st.DFC_ComMETKRingCnt DFC_st.DFC_ComMETKTOut DFC_st.DFC_ComMETLChksum DFC_st.DFC_ComMETLRingCnt DFC_st.DFC_ComMETLTOut DFC_st.DFC_ComMETMChksum DFC_st.DFC_ComMETMRingCnt DFC_st.DFC_ComMETMTOut DFC_st.DFC_ComMETNChksum DFC_st.DFC_ComMETNRingCnt DFC_st.DFC_ComMETNTOut DFC_st.DFC_ComMtrCom DFC_st.DFC_ComPCUChkSum DFC_st.DFC_ComPCURingCnt DFC_st.DFC_ComPCUTOut DFC_st.DFC_ComSRSAChksum DFC_st.DFC_ComSRSARingCnt DFC_st.DFC_ComSRSATOut DFC_st.DFC_ComSRSBChksum DFC_st.DFC_ComSRSBRingCnt DFC_st.DFC_ComSRSBTOut DFC_st.DFC_ComSRSChksum DFC_st.DFC_ComSRSErr DFC_st.DFC_ComSRSRingCnt DFC_st.DFC_ComSRSTOut DFC_st.DFC_ComVehSpdPndFltTCU DFC_st.DFC_EbsChartcCurrErr DFC_st.DFC_EbsSelfDiagErr DFC_st.DFC_GEVlvPhaCsersIntkB1 DFC_st.DFC_GEVlvPhaPsOpenLoadIntkB1 DFC_st.DFC_GEVlvPhaPsShoToBattIntkB1 DFC_st.DFC_GEVlvPhaPsShoToGndIntkB1 DFC_st.DFC_GbxCANDigPlausErr DFC_st.DFC_GbxNPos1SRCMax DFC_st.DFC_GbxNPos1SRCMin DFC_st.DFC_GbxNPos2SRCMax DFC_st.DFC_GbxNPos2SRCMin DFC_st.DFC_GbxNPosAlvChk DFC_st.DFC_GbxNPosSyncErr DFC_st.DFC_HEGOS2B1HtrPsMax DFC_st.DFC_HEGOS2B1HtrPsMin DFC_st.DFC_HEGOS2B1HtrPsSig DFC_st.DFC_LinCSErrACG DFC_st.DFC_LinCSErrAEV DFC_st.DFC_LinCSErrDCDC DFC_st.DFC_LinCSErrEBS DFC_st.DFC_LinHdrTimeoutErrACG DFC_st.DFC_LinHdrTimeoutErrAEV DFC_st.DFC_LinHdrTimeoutErrDCDC DFC_st.DFC_LinHdrTimeoutErrEBS DFC_st.DFC_LinMsgTimeoutErrACG DFC_st.DFC_LinMsgTimeoutErrAEV DFC_st.DFC_LinMsgTimeoutErrDCDC DFC_st.DFC_LinMsgTimeoutErrEBS DFC_st.DFC_LinNoStrtComErr DFC_st.DFC_LowPresOilP DFC_st.DFC_MisfDetVWhlFrntLeOORHi DFC_st.DFC_MisfDetVWhlFrntLeRatyHi DFC_st.DFC_MisfDetVWhlFrntLeRatyLo DFC_st.DFC_MisfDetVWhlFrntLeStuck DFC_st.DFC_MisfDetVWhlFrntRiOORHi DFC_st.DFC_MisfDetVWhlFrntRiRatyHi DFC_st.DFC_MisfDetVWhlFrntRiRatyLo DFC_st.DFC_MisfDetVWhlFrntRiStuck DFC_st.DFC_MisfDetVWhlReLeOORHi DFC_st.DFC_MisfDetVWhlReLeRatyHi DFC_st.DFC_MisfDetVWhlReLeRatyLo DFC_st.DFC_MisfDetVWhlReLeStuck DFC_st.DFC_MisfDetVWhlReRiOORHi DFC_st.DFC_MisfDetVWhlReRiRatyHi DFC_st.DFC_MisfDetVWhlReRiRatyLo DFC_st.DFC_MisfDetVWhlReRiStuck DFC_st.DFC_MisfDetdVWhlFrntLePlaus DFC_st.DFC_MisfDetdVWhlFrntRiPlaus DFC_st.DFC_MisfDetdVWhlReLePlaus DFC_st.DFC_MisfDetdVWhlReRiPlaus DFC_st.DFC_PEnvSigRngMax DFC_st.DFC_PEnvSigRngMin DFC_st.DFC_StmFault DFC_st.DFC_StrtCtOffPth DFC_st.DFC_StrtCtlErr DFC_st.DFC_StrtFault DFC_st.DFC_StrtLckJudg1 DFC_st.DFC_StrtLckJudg2 DFC_st.DFC_StrtOL DFC_st.DFC_StrtOL2 DFC_st.DFC_StrtSCB DFC_st.DFC_StrtSCB2 DFC_st.DFC_StrtSCG DFC_st.DFC_StrtSCG2 DFC_st.DFC_StrtStkRly1 DFC_st.DFC_StrtStkRly2 DFC_st.DFC_TEVEmax DFC_st.DFC_TEVEmin DFC_st.DFC_TEVEsig DFC_st.DFC_UegoHeatrPrfmncLoS1B1 DFC_st.DFC_VehVAllPlaus DFC_st.DFC_VehVNCSnsrElecFailr DFC_st.DFC_VehVPlausCan DFC_st.DFC_VehVPlausFco DFC_st.DFC_VehVPlausPwr DFC_st.DFC_VehVPlausV2N DFC_st.DFC_VehVSpdSnsrAElecFailr DFC_st.DFC_VehVSpdSnsrBElecFailr DFC_st.DFC_ClthMax DFC_st.DFC_IgnClPs_DevComErr DFC_st.DFC_IgnClPs_LineOl_0 DFC_st.DFC_IgnClPs_LineOl_1 DFC_st.DFC_IgnClPs_LineOl_2 DFC_st.DFC_IgnClPs_LineOl_3 DFC_st.DFC_IgnClPs_LineScb_0 DFC_st.DFC_IgnClPs_LineScb_1 DFC_st.DFC_IgnClPs_LineScb_2 DFC_st.DFC_IgnClPs_LineScb_3 DFC_st.DFC_IgnClPs_LineScg_0 DFC_st.DFC_IgnClPs_LineScg_1 DFC_st.DFC_IgnClPs_LineScg_2 DFC_st.DFC_IgnClPs_LineScg_3 DFC_st.DFC_KRVEKOEVAB DFC_st.DFC_KRVEKOEVAB0 DFC_st.DFC_KRVEKOEVAB1 DFC_st.DFC_KRVEKOEVAB2 DFC_st.DFC_KRVEKOEVAB3 DFC_st.DFC_UegoSigEcuAsicS1B1 DFC_st.DFC_UegoSigEcuComS1B1 DFC_st.DFC_UegoSigSnsrS1B1 DFC_st.DFC_UegoSigWireOlApesS1B1 DFC_st.DFC_UegoSigWireOlIpeS1B1 DFC_st.DFC_UegoSigWireOlReS1B1 DFC_st.DFC_UegoSigWireRCmpS1B1 DFC_st.DFC_UegoSigWireScbS1B1 DFC_st.DFC_UegoSigWireScgS1B1 DFC_st.DFC_AfsPhyRngHiB1 DFC_st.DFC_AfsPhyRngLoB1 DFC_st.DFC_AirCCmprOL DFC_st.DFC_AirCCmprOvrTemp DFC_st.DFC_AirCCmprSCB DFC_st.DFC_AirCCmprSCG DFC_st.DFC_AltErr DFC_st.DFC_BattUSRCMax DFC_st.DFC_BattUSRCMin DFC_st.DFC_ComChksTCU1 DFC_st.DFC_ComChksTCU11 DFC_st.DFC_ComChksTCU12 DFC_st.DFC_ComChksTCU13 DFC_st.DFC_ComChksTCU2 DFC_st.DFC_ComChksTCU3 DFC_st.DFC_ComChksTCU4 DFC_st.DFC_ComCntTCU1 DFC_st.DFC_ComCntTCU11 DFC_st.DFC_ComCntTCU12 DFC_st.DFC_ComCntTCU13 DFC_st.DFC_ComCntTCU2 DFC_st.DFC_ComCntTCU3 DFC_st.DFC_ComCntTCU4 DFC_st.DFC_ComTOutTCU01 DFC_st.DFC_ComTOutTCU02 DFC_st.DFC_ComTOutTCU1 DFC_st.DFC_ComTOutTCU11 DFC_st.DFC_ComTOutTCU12 DFC_st.DFC_ComTOutTCU13 DFC_st.DFC_ComTOutTCU14 DFC_st.DFC_ComTOutTCU2 DFC_st.DFC_ComTOutTCU3 DFC_st.DFC_ComTOutTCU4 DFC_st.DFC_DevLibBattUHi DFC_st.DFC_DevLibBattULo DFC_st.DFC_EGRVlvFailSafeActv DFC_st.DFC_EGRVlvGovDvtCld DFC_st.DFC_EGRVlvPhysSRCMax DFC_st.DFC_EGRVlvPhysSRCMin DFC_st.DFC_FanDIOOL_0 DFC_st.DFC_FanDIOOL_1 DFC_st.DFC_FanDIOOvrTemp_0 DFC_st.DFC_FanDIOOvrTemp_1 DFC_st.DFC_FanDIOSCB_0 DFC_st.DFC_FanDIOSCB_1 DFC_st.DFC_FanDIOSCG_0 DFC_st.DFC_FanDIOSCG_1 DFC_st.DFC_MRlyDcOL DFC_st.DFC_MRlyDcSCB DFC_st.DFC_MRlyDcSCG DFC_st.DFC_PSPOL DFC_st.DFC_PSPOvrTemp DFC_st.DFC_PSPSCB DFC_st.DFC_PSPSCG DFC_st.DFC_T50Err DFC_st.DFC_ThrVlvLoBattB1 DFC_st.DFC_UegoSigOperPlausS1B1 DFC_st.DFC_VehVPhysRngHi DFC_st.DFC_VehVSclOutOL DFC_st.DFC_VehVSclOutOT DFC_st.DFC_VehVSclOutSCB DFC_st.DFC_VehVSclOutSCG DFC_st.DFC_VehVSigFL DFC_st.DFC_VehVSigFR DFC_st.DFC_VehVSigRL DFC_st.DFC_VehVSigRR DFC_st.DFC_VehVSnsrARngHi DFC_st.DFC_VehVSnsrBRngHi DFC_st.DFC_VehVSpdRtyDiag DFC_st.DFC_DHFHD DFC_st.DFC_InjVlv_DI_DcDc DFC_st.DFC_InjVlv_DI_NoLd_0 DFC_st.DFC_InjVlv_DI_NoLd_1 DFC_st.DFC_InjVlv_DI_NoLd_2 DFC_st.DFC_InjVlv_DI_NoLd_3 DFC_st.DFC_InjVlv_DI_ScBnk_0 DFC_st.DFC_InjVlv_DI_ScBnk_1 DFC_st.DFC_InjVlv_DI_ScBnk_2 DFC_st.DFC_InjVlv_DI_ScBnk_3 DFC_st.DFC_InjVlv_DI_ScCyl_0 DFC_st.DFC_InjVlv_DI_ScCyl_1 DFC_st.DFC_InjVlv_DI_ScCyl_2 DFC_st.DFC_InjVlv_DI_ScCyl_3 DFC_st.DFC_InjVlv_DI_ScHsLs_0 DFC_st.DFC_InjVlv_DI_ScHsLs_1 DFC_st.DFC_InjVlv_DI_ScHsLs_2 DFC_st.DFC_InjVlv_DI_ScHsLs_3 DFC_st.DFC_MfPsDiaOpenLoad1 DFC_st.DFC_MfPsDiaScHiS1 DFC_st.DFC_MfPsDiaScHiSLowS1 DFC_st.DFC_MfPsDiaScLowS1 DFC_st.DFC_ACEvpTPhysRngHi DFC_st.DFC_ACEvpTPhysRngLo DFC_st.DFC_ACEvpTSRCMax DFC_st.DFC_ACEvpTSRCMin DFC_st.DFC_AfsRawSigRngHiB1 DFC_st.DFC_AfsRawSigRngLoB1 DFC_st.DFC_AfsSnsrErrB1 DFC_st.DFC_AirCClntPAnaSRCMax DFC_st.DFC_AirCClntPAnaSRCMin DFC_st.DFC_AirCSwtNpl DFC_st.DFC_AirCSwtSig DFC_st.DFC_Brk DFC_st.DFC_BrkBstSensSCB DFC_st.DFC_BrkBstSensSCG DFC_st.DFC_BrkSig DFC_st.DFC_ClthSig DFC_st.DFC_EGRVlvCurrLim DFC_st.DFC_EGRVlvOL DFC_st.DFC_EGRVlvOvrTemp DFC_st.DFC_EGRVlvSCB DFC_st.DFC_EGRVlvSCG DFC_st.DFC_EGRVlvSRCMax DFC_st.DFC_EGRVlvSRCMin DFC_st.DFC_HLSDemOvhtEngLim DFC_st.DFC_OilPSwmpSRCMax DFC_st.DFC_OilPSwmpSRCMin DFC_st.DFC_PIntkVUsLineHiB1 DFC_st.DFC_PIntkVUsLineLoB1 DFC_st.DFC_VehVPhysRngLo DFC_st.DFC_VehVSigCan DFC_st.DFC_VehVSigCanSafe DFC_st.DFC_VlvLftFbOilPSnsrIntk11SRCMax DFC_st.DFC_VlvLftFbOilPSnsrIntk11SRCMin DFC_st.DFC_ClthNpl DFC_st.DFC_GbxPNPosnDrvCdn DFC_st.DFC_GbxPNPosnPlausy DFC_st.DFC_AfsSigErrLineHiB1 DFC_st.DFC_AfsSigErrLineLoB1 DFC_st.DFC_PEnvCcMax DFC_st.DFC_PEnvCcMin DFC_st.DFC_PEnvRngChkMax DFC_st.DFC_PEnvRngChkMin DFC_st.DFC_PEnvSnsrPlaus DFC_st.DFC_UEGOHeatrRlyPsOLS1B1 DFC_st.DFC_UEGOHeatrRlyPsSCBS1B1 DFC_st.DFC_UEGOHeatrRlyPsSCGS1B1 DFC_st.DFC_UegoHeatrWireOlS1B1 DFC_st.DFC_UegoHeatrWireScbS1B1 DFC_st.DFC_UegoHeatrWireScgS1B1 DFC_st.DFC_KnDetSens1PortAMax DFC_st.DFC_KnDetSens1PortAMin DFC_st.DFC_KnDetSens1PortBMax DFC_st.DFC_KnDetSens1PortBMin DFC_st.DFC_Clth2ONStuck DFC_st.DFC_Clth2ONStuckLdc DFC_st.DFC_Clth3ONStuckLdc DFC_st.DFC_Clth3ONStuckPostDrv DFC_st.DFC_Clth4ONStuck DFC_st.DFC_Clth4ONStuckLdc DFC_st.DFC_ComBCMUnit DFC_st.DFC_ComDLCTCU01 DFC_st.DFC_ComDLCTCU02 DFC_st.DFC_ComDLCTCU1 DFC_st.DFC_ComDLCTCU11 DFC_st.DFC_ComDLCTCU12 DFC_st.DFC_ComDLCTCU13 DFC_st.DFC_ComDLCTCU14 DFC_st.DFC_ComDLCTCU2 DFC_st.DFC_ComDLCTCU3 DFC_st.DFC_ComDLCTCU4 DFC_st.DFC_ComEPSUnit DFC_st.DFC_ComIDASBUnit DFC_st.DFC_ComIMGUnit DFC_st.DFC_ComMETUnit DFC_st.DFC_ComSRSUnit DFC_st.DFC_ComVSAUnit DFC_st.DFC_EbsSocFlt DFC_st.DFC_I14229VINErr DFC_st.DFC_InjCatHeatgErr DFC_st.DFC_InjSysMulInjDiagErr DFC_st.DFC_LLRHmax DFC_st.DFC_LLRHmin DFC_st.DFC_LLRHnpl DFC_st.DFC_LLRKHmax DFC_st.DFC_LLRKHmin DFC_st.DFC_LLRKHnpl DFC_st.DFC_LinACGUnit DFC_st.DFC_LinAEVUnit DFC_st.DFC_LinEBSUnit DFC_st.DFC_RoughRoad DFC_st.DFC_SiaEEPRdErr DFC_st.DFC_SiaEEPWrngCod DFC_st.DFC_UegoHeatrStrtS1B1 DFC_st.DFC_BusDiagCANAPPLBusOff DFC_st.DFC_BusDiagCANCANCBusOff DFC_st.DFC_BusDiagCANVEHICLEBusOff DFC_st.DFC_RBA_IODIAGPWR_rba_IoExtCy329_SignalVltSply_0 DFC_st.DFC_RBA_IODIAGPWR_rba_IoExtCy329_SignalVltSply_0OT DFC_st.DFC_RBA_IODIAGPWR_rba_IoExtCy329_SignalVltSply_0OV DFC_st.DFC_RBA_IODIAGPWR_rba_IoExtCy329_SignalVltSply_0SCG DFC_st.DFC_RBA_IODIAGPWR_rba_IoExtCy329_SignalVltSply_0UV DFC_st.DFC_RBA_IODIAGPWR_rba_IoExtCy329_SignalVltSply_1 DFC_st.DFC_RBA_IODIAGPWR_rba_IoExtCy329_SignalVltSply_1OT DFC_st.DFC_RBA_IODIAGPWR_rba_IoExtCy329_SignalVltSply_1OV DFC_st.DFC_RBA_IODIAGPWR_rba_IoExtCy329_SignalVltSply_1SCG DFC_st.DFC_RBA_IODIAGPWR_rba_IoExtCy329_SignalVltSply_1UV DFC_st.DFC_RBA_IODIAGPWR_rba_IoExtCy329_SignalVltSply_2 DFC_st.DFC_RBA_IODIAGPWR_rba_IoExtCy329_SignalVltSply_2OT DFC_st.DFC_RBA_IODIAGPWR_rba_IoExtCy329_SignalVltSply_2OV DFC_st.DFC_RBA_IODIAGPWR_rba_IoExtCy329_SignalVltSply_2SCG DFC_st.DFC_RBA_IODIAGPWR_rba_IoExtCy329_SignalVltSply_2UV DFC_st.DFC_CAN_E_TIMEOUT DFC_st.DFC_LIN_E_TIMEOUT DFC_st.DFC_MRlyOL DFC_st.DFC_MRlySCB DFC_st.DFC_MRlySCG DFC_st.DFC_rba_MultiStackTrace_Threshold DFC_st.DFC_BSWM_E_ACTION_FAILED DFC_st.DFC_BSWM_E_INTRPTQUEUE_FULL DFC_st.DFC_RBA_IOEXTLIB_KEEPALIVE_DRV DFC_st.DFC_RBA_IOEXTLIB_KEEPALIVE_INI DFC_st.DFC_rba_IoSigRtc_StopCounter DFC_st.DFC_rba_MRly_Diag_Stk_Event DFC_st.DFC_rba_MemDiag_MemReadErr DFC_st.DFC_rba_MemDiag_MemWrErr DFC_st.DFC_rba_SyC_IrrSwOffTrigEngRun_Event DFC_st.DFC_rba_T15_Diag_ComInVld_Event DFC_st.DFC_rba_T15_Diag_ComOff_HwOn_Event DFC_st.DFC_rba_T15_Diag_ComOn_HwOff_Event DFC_st.DFC_AAVmin DFC_st.DFC_AGRSUS DFC_st.DFC_AfsPlausDiagHi DFC_st.DFC_AfsPlausDiagLo DFC_st.DFC_AfsVrntDiagErrB1 DFC_st.DFC_AppAllSnsrDfct DFC_st.DFC_BBKRnldg DFC_st.DFC_BBKRsyne DFC_st.DFC_BattUStdbyDiaOL DFC_st.DFC_BigLeakIntkMnfldEmiInfl DFC_st.DFC_BlkdLineTank DFC_st.DFC_BrkMnSwtContOnWarnLmp DFC_st.DFC_BrkMnSwtNotStpWarnLmp DFC_st.DFC_BrkRdntSwtContOnWarnLmp DFC_st.DFC_BrkRdntSwtNotStpWarnLmp DFC_st.DFC_CEngDsTColdStrtMax DFC_st.DFC_CEngDsTColdStrtMin DFC_st.DFC_CEngDsTImps DFC_st.DFC_CEngDsTPlausHSC DFC_st.DFC_CEngDsTPlausLSC DFC_st.DFC_CEngDsTPlausSTC DFC_st.DFC_CEngDsTSRCMax DFC_st.DFC_CEngDsTSRCMin DFC_st.DFC_CEngDsTSig DFC_st.DFC_CEngUsTColdStrtMax DFC_st.DFC_CEngUsTColdStrtMin DFC_st.DFC_CEngUsTLooseCnctn DFC_st.DFC_CEngUsTSRCMax DFC_st.DFC_CEngUsTSRCMin DFC_st.DFC_ComDCDCACCFailr DFC_st.DFC_DCDCFltDet DFC_st.DFC_DKRSA DFC_st.DFC_DKVSmax DFC_st.DFC_DKnpl DFC_st.DFC_DSKVRmax DFC_st.DFC_DSKVRmin DFC_st.DFC_DSKVRnpl DFC_st.DFC_DSKVRsig DFC_st.DFC_DSKVSsig DFC_st.DFC_DSSmax DFC_st.DFC_DSTDmax DFC_st.DFC_DSTEmax DFC_st.DFC_DSTEmin DFC_st.DFC_DSTOFmax DFC_st.DFC_DSTRmax DFC_st.DFC_DSTRmin DFC_st.DFC_DSTRnpl DFC_st.DFC_DSTRsig DFC_st.DFC_DSTTI DFC_st.DFC_DSUmax DFC_st.DFC_DiagCpv1DteskLoLoadStuckClsd DFC_st.DFC_DiagCpv1DteskLoLoadStuckOpen DFC_st.DFC_EGRVlvDrftClsd DFC_st.DFC_EGRVlvDrftOpn DFC_st.DFC_EGRVlvJamVlvClsd DFC_st.DFC_EGRVlvJamVlvOpn DFC_st.DFC_EGRVlvSprgBrk DFC_st.DFC_EGRVlvTempMdlEEPErr DFC_st.DFC_EGRVlvTmpErr DFC_st.DFC_EGSDUS2B1LtrDly DFC_st.DFC_EGSDUS2B1LtrPT1 DFC_st.DFC_EGSDUS2B1RtlDly DFC_st.DFC_EGSDUS2B1RtlPT1 DFC_st.DFC_EGSDUS2B1TarLean DFC_st.DFC_EGSDUS2B1TarRich DFC_st.DFC_EONVmax DFC_st.DFC_ETAKHLmax DFC_st.DFC_ETAKHTmax DFC_st.DFC_ETHSEmax DFC_st.DFC_ETHSEmin DFC_st.DFC_ETHSFmax DFC_st.DFC_ETHSFmin DFC_st.DFC_ETHSFsig DFC_st.DFC_ETHSNPWmax DFC_st.DFC_ETHSNPWmin DFC_st.DFC_ETHSNPWsig DFC_st.DFC_ETHSPLnpl DFC_st.DFC_ETHSTPLnpl DFC_st.DFC_EngICO DFC_st.DFC_EngPrtOvrSpdMon DFC_st.DFC_EpmCaSI1ErrSig DFC_st.DFC_EpmCaSI1MntErr DFC_st.DFC_EpmCaSI1NoSigMax DFC_st.DFC_EpmCaSI1NoSigMin DFC_st.DFC_EpmCaSI1OfsErr DFC_st.DFC_EpmCrSDGI DFC_st.DFC_EpmCrSErrSig DFC_st.DFC_EpmCrSNoSig DFC_st.DFC_EtaEngIdleNonCsers DFC_st.DFC_EtaEngPtlNonCsers DFC_st.DFC_FRAmax DFC_st.DFC_FRAmin DFC_st.DFC_FSTEmax DFC_st.DFC_FSTEmin DFC_st.DFC_FSTRmax DFC_st.DFC_FSTRmin DFC_st.DFC_FSTRnpl DFC_st.DFC_FSTmax DFC_st.DFC_FTDLAmax DFC_st.DFC_FTDLAmin DFC_st.DFC_FuPHiSnsrEleclmax DFC_st.DFC_FuPHiSnsrEleclmin DFC_st.DFC_FuPHiSnsrEleclnpl DFC_st.DFC_FuPHiSnsrURngMax DFC_st.DFC_FuPHiSnsrURngMin DFC_st.DFC_FuSnsrPhyRngMaxErr DFC_st.DFC_FuSnsrPhyRngMinErr DFC_st.DFC_GEVlvLockPinDiagIntkB1 DFC_st.DFC_GEVlvPhaSlowIntkB1 DFC_st.DFC_GEVlvPhaTargIntkB1 DFC_st.DFC_GbxRvsSwtStk DFC_st.DFC_HDRKHmax DFC_st.DFC_HDRKHmin DFC_st.DFC_HDRPLmax DFC_st.DFC_HDRPLmin DFC_st.DFC_HDRmax DFC_st.DFC_HDRmin DFC_st.DFC_HEGOS2B1ElecMax DFC_st.DFC_HEGOS2B1ElecMin DFC_st.DFC_HEGOS2B1ElecSig DFC_st.DFC_HEGOS2B1HtgNpl DFC_st.DFC_HEV00max DFC_st.DFC_HEV01max DFC_st.DFC_HEV02max DFC_st.DFC_HEV03max DFC_st.DFC_HEVE0max DFC_st.DFC_HEVE1max DFC_st.DFC_HFMmax DFC_st.DFC_HiPSysHiPMaxLimExcdd DFC_st.DFC_IVGdiCtlCvoErrMax_0 DFC_st.DFC_IVGdiCtlCvoErrMax_1 DFC_st.DFC_IVGdiCtlCvoErrMax_2 DFC_st.DFC_IVGdiCtlCvoErrMax_3 DFC_st.DFC_IVGdiCtlCvoErrMin_0 DFC_st.DFC_IVGdiCtlCvoErrMin_1 DFC_st.DFC_IVGdiCtlCvoErrMin_2 DFC_st.DFC_IVGdiCtlCvoErrMin_3 DFC_st.DFC_IVGdiCtlCvoErrMinMax DFC_st.DFC_IVGdiCtlCvoSigPlausErrSmrCdn DFC_st.DFC_IVGdiCtl_CvoErr DFC_st.DFC_IVGdiCtl_CvoSigPlaus_0 DFC_st.DFC_IVGdiCtl_CvoSigPlaus_1 DFC_st.DFC_IVGdiCtl_CvoSigPlaus_2 DFC_st.DFC_IVGdiCtl_CvoSigPlaus_3 DFC_st.DFC_IntkAirTAirFltDsCrssMax DFC_st.DFC_IntkAirTAirFltDsCrssMin DFC_st.DFC_IntkAirTAirFltDsHSCMax DFC_st.DFC_IntkAirTAirFltDsImps DFC_st.DFC_IntkAirTAirFltDsPRCMax DFC_st.DFC_IntkAirTAirFltDsPRCMin DFC_st.DFC_IntkAirTAirFltDsSRCMax DFC_st.DFC_IntkAirTAirFltDsSRCMin DFC_st.DFC_IntkAirTAirFltDsSTC DFC_st.DFC_IntkAirTIntkMnfldCrssMax DFC_st.DFC_IntkAirTIntkMnfldCrssMin DFC_st.DFC_IntkAirTIntkMnfldHSCMax DFC_st.DFC_IntkAirTIntkMnfldImps DFC_st.DFC_IntkAirTIntkMnfldPRCMax DFC_st.DFC_IntkAirTIntkMnfldPRCMin DFC_st.DFC_IntkAirTIntkMnfldSRCMax DFC_st.DFC_IntkAirTIntkMnfldSRCMin DFC_st.DFC_IntkAirTIntkMnfldSTC DFC_st.DFC_KRREGRLMX DFC_st.DFC_KRVEKOCVLCI DFC_st.DFC_KRVEKOENCHMT DFC_st.DFC_KRVEKOENCHMT0 DFC_st.DFC_KRVEKOENCHMT1 DFC_st.DFC_KRVEKOENCHMT2 DFC_st.DFC_KRVEKOENCHMT3 DFC_st.DFC_KRVEKOENCHMT4 DFC_st.DFC_KRVEKOENCHMT5 DFC_st.DFC_KRVEKOENCHMT6 DFC_st.DFC_KRVEKOENCHMT7 DFC_st.DFC_KRVEKORLMX DFC_st.DFC_KRVEKORLMXL DFC_st.DFC_KS1max DFC_st.DFC_KS1min DFC_st.DFC_LMmax DFC_st.DFC_LZSRnpl DFC_st.DFC_LamDynDiagS1B1 DFC_st.DFC_LeakIntkMnfldEmiInfl DFC_st.DFC_LinFrameErrDCDC DFC_st.DFC_LinOverrunErrDCDC DFC_st.DFC_MD00max DFC_st.DFC_MDBmax DFC_st.DFC_MDCat DFC_st.DFC_MDCatCrit DFC_st.DFC_MDCatCurr DFC_st.DFC_MDCyl_0 DFC_st.DFC_MDCyl_1 DFC_st.DFC_MDCyl_2 DFC_st.DFC_MDCyl_3 DFC_st.DFC_MDEmi DFC_st.DFC_MDEmiStrt DFC_st.DFC_MDFco DFC_st.DFC_MDMpl DFC_st.DFC_MDSegTiAdpn DFC_st.DFC_MDmax DFC_st.DFC_MFuOilMax DFC_st.DFC_MOXEMM_SMU_ALM0_0 DFC_st.DFC_MOXEMM_SMU_ALM0_1 DFC_st.DFC_MOXEMM_SMU_ALM0_10 DFC_st.DFC_MOXEMM_SMU_ALM0_11 DFC_st.DFC_MOXEMM_SMU_ALM0_13 DFC_st.DFC_MOXEMM_SMU_ALM0_14 DFC_st.DFC_MOXEMM_SMU_ALM0_2 DFC_st.DFC_MOXEMM_SMU_ALM0_22 DFC_st.DFC_MOXEMM_SMU_ALM0_23 DFC_st.DFC_MOXEMM_SMU_ALM0_4 DFC_st.DFC_MOXEMM_SMU_ALM0_5 DFC_st.DFC_MOXEMM_SMU_ALM0_7 DFC_st.DFC_MOXEMM_SMU_ALM0_8 DFC_st.DFC_MOXEMM_SMU_ALM10_16 DFC_st.DFC_MOXEMM_SMU_ALM10_17 DFC_st.DFC_MOXEMM_SMU_ALM10_21 DFC_st.DFC_MOXEMM_SMU_ALM11_0 DFC_st.DFC_MOXEMM_SMU_ALM11_1 DFC_st.DFC_MOXEMM_SMU_ALM11_2 DFC_st.DFC_MOXEMM_SMU_ALM11_3 DFC_st.DFC_MOXEMM_SMU_ALM11_4 DFC_st.DFC_MOXEMM_SMU_ALM11_5 DFC_st.DFC_MOXEMM_SMU_ALM11_8 DFC_st.DFC_MOXEMM_SMU_ALM11_9 DFC_st.DFC_MOXEMM_SMU_ALM1_0 DFC_st.DFC_MOXEMM_SMU_ALM1_1 DFC_st.DFC_MOXEMM_SMU_ALM1_10 DFC_st.DFC_MOXEMM_SMU_ALM1_11 DFC_st.DFC_MOXEMM_SMU_ALM1_13 DFC_st.DFC_MOXEMM_SMU_ALM1_14 DFC_st.DFC_MOXEMM_SMU_ALM1_2 DFC_st.DFC_MOXEMM_SMU_ALM1_22 DFC_st.DFC_MOXEMM_SMU_ALM1_23 DFC_st.DFC_MOXEMM_SMU_ALM1_4 DFC_st.DFC_MOXEMM_SMU_ALM1_5 DFC_st.DFC_MOXEMM_SMU_ALM1_7 DFC_st.DFC_MOXEMM_SMU_ALM1_8 DFC_st.DFC_MOXEMM_SMU_ALM21_0 DFC_st.DFC_MOXEMM_SMU_ALM21_16 DFC_st.DFC_MOXEMM_SMU_ALM21_3 DFC_st.DFC_MOXEMM_SMU_ALM2_1 DFC_st.DFC_MOXEMM_SMU_ALM2_10 DFC_st.DFC_MOXEMM_SMU_ALM2_11 DFC_st.DFC_MOXEMM_SMU_ALM2_13 DFC_st.DFC_MOXEMM_SMU_ALM2_14 DFC_st.DFC_MOXEMM_SMU_ALM2_22 DFC_st.DFC_MOXEMM_SMU_ALM2_23 DFC_st.DFC_MOXEMM_SMU_ALM2_4 DFC_st.DFC_MOXEMM_SMU_ALM2_5 DFC_st.DFC_MOXEMM_SMU_ALM2_7 DFC_st.DFC_MOXEMM_SMU_ALM2_8 DFC_st.DFC_MOXEMM_SMU_ALM6_0 DFC_st.DFC_MOXEMM_SMU_ALM6_11 DFC_st.DFC_MOXEMM_SMU_ALM6_12 DFC_st.DFC_MOXEMM_SMU_ALM6_14 DFC_st.DFC_MOXEMM_SMU_ALM6_15 DFC_st.DFC_MOXEMM_SMU_ALM6_17 DFC_st.DFC_MOXEMM_SMU_ALM6_18 DFC_st.DFC_MOXEMM_SMU_ALM6_20 DFC_st.DFC_MOXEMM_SMU_ALM6_21 DFC_st.DFC_MOXEMM_SMU_ALM6_25 DFC_st.DFC_MOXEMM_SMU_ALM6_4 DFC_st.DFC_MOXEMM_SMU_ALM6_5 DFC_st.DFC_MOXEMM_SMU_ALM6_7 DFC_st.DFC_MOXEMM_SMU_ALM6_8 DFC_st.DFC_MOXEMM_SMU_ALM7_1 DFC_st.DFC_MOXEMM_SMU_ALM7_12 DFC_st.DFC_MOXEMM_SMU_ALM7_13 DFC_st.DFC_MOXEMM_SMU_ALM7_14 DFC_st.DFC_MOXEMM_SMU_ALM7_15 DFC_st.DFC_MOXEMM_SMU_ALM7_16 DFC_st.DFC_MOXEMM_SMU_ALM7_17 DFC_st.DFC_MOXEMM_SMU_ALM7_2 DFC_st.DFC_MOXEMM_SMU_ALM7_20 DFC_st.DFC_MOXEMM_SMU_ALM7_25 DFC_st.DFC_MOXEMM_SMU_ALM7_26 DFC_st.DFC_MOXEMM_SMU_ALM7_28 DFC_st.DFC_MOXEMM_SMU_ALM7_29 DFC_st.DFC_MOXEMM_SMU_ALM7_30 DFC_st.DFC_MOXEMM_SMU_ALM7_31 DFC_st.DFC_MOXEMM_SMU_ALM8_0 DFC_st.DFC_MOXEMM_SMU_ALM8_1 DFC_st.DFC_MOXEMM_SMU_ALM8_10 DFC_st.DFC_MOXEMM_SMU_ALM8_11 DFC_st.DFC_MOXEMM_SMU_ALM8_12 DFC_st.DFC_MOXEMM_SMU_ALM8_16 DFC_st.DFC_MOXEMM_SMU_ALM8_18 DFC_st.DFC_MOXEMM_SMU_ALM8_2 DFC_st.DFC_MOXEMM_SMU_ALM8_3 DFC_st.DFC_MOXEMM_SMU_ALM8_31 DFC_st.DFC_MOXEMM_SMU_ALM8_4 DFC_st.DFC_MOXEMM_SMU_ALM9_0 DFC_st.DFC_MOXEMM_SMU_ALM9_15 DFC_st.DFC_MOXEMM_SMU_ALM9_3 DFC_st.DFC_MoCADCNTP DFC_st.DFC_MoCADCTst DFC_st.DFC_MoCSOPICO DFC_st.DFC_MoFAPP DFC_st.DFC_MoFAirFilgPrdc DFC_st.DFC_MoFAirFlCtOffGdi DFC_st.DFC_MoFAirFlCylGdi DFC_st.DFC_MoFAirFlFF DFC_st.DFC_MoFAirFlIn DFC_st.DFC_MoFAirFlMixCtlGdiChkAirFl DFC_st.DFC_MoFAirFlMixCtlGdiChkCtrl DFC_st.DFC_MoFAirFlMode DFC_st.DFC_MoFESpd DFC_st.DFC_MoFIACo DFC_st.DFC_MoFICOL1 DFC_st.DFC_MoFICOL2 DFC_st.DFC_MoFStrt DFC_st.DFC_MoFTrqCmp DFC_st.DFC_MoFTrqCmpMax DFC_st.DFC_MoFTrqCmpMin DFC_st.DFC_MoFVarPostBldSel DFC_st.DFC_MoXEMMHwLTMCUFW DFC_st.DFC_MoXEMMHwLTMonBIST DFC_st.DFC_MoXEMMHwLTRegMonTest DFC_st.DFC_MoXEMMHwLTStbySMUAlvTest DFC_st.DFC_MoXEMMHwLTTempSens DFC_st.DFC_MoXEMMHwLTUCBCfg DFC_st.DFC_NWSEmax DFC_st.DFC_NWSmax DFC_st.DFC_OCWDAABEActv DFC_st.DFC_OCWDACom DFC_st.DFC_OCWDAErrPin DFC_st.DFC_OCWDAOvrVltg DFC_st.DFC_ORAmax /end OUT_MEASUREMENT
 FUNCTION_VERSION "30000.33.0_1.1.0" /end FUNCTION
/begin COMPU_METHOD DFC_OneToOne "" RAT_FUNC "%6.2" "-" COEFFS 0 1 0 0 0 1 /end COMPU_METHOD
/end MODULE
/end PROJECT
