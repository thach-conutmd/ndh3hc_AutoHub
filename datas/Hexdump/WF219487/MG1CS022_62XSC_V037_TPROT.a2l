ASAP2_VERSION 1 60
/begin PROJECT MG1CS022 "MG1CS022"
/begin HEADER "" VERSION "MG1CS022_62XSC_V037_TPROT" PROJECT_NO MG1CS022 /end HEADER
/begin MODULE DIM ""
/begin MOD_COMMON "" BYTE_ORDER MSB_LAST ALIGNMENT_BYTE 1 ALIGNMENT_WORD 2 ALIGNMENT_LONG 4 ALIGNMENT_INT64 4 ALIGNMENT_FLOAT32_IEEE 4 ALIGNMENT_FLOAT64_IEEE 4 DATA_SIZE 32 /end MOD_COMMON
/begin CHARACTERISTIC Com_stConvTrgLftMDA_CUR "Curve to calculate EGR intervention value based on target lift value from tester request" CURVE 0x8058AED0 Cur_Xs16Ws16 100.0000 Prc 0.00 100.0000 FORMAT "%8.4" EXTENDED_LIMITS -400.0000 399.9878
 /begin AXIS_DESCR STD_AXIS Com_lEGRCtlStMDA Length_0_01mm 6 0.00 5.000000 FORMAT "%8.6" EXTENDED_LIMITS -327.6800 327.6700 DEPOSIT ABSOLUTE /end AXIS_DESCR
/end CHARACTERISTIC
/begin CHARACTERISTIC CWDDHFHD "Codeword pressure lost detection function" VALUE 0x8053A7A4 RB_Val_Wu8 255.0 OneToOne 0.00 255.0 FORMAT "%5.1" /end CHARACTERISTIC
/begin CHARACTERISTIC DDHFHD_pDrpAllwd_T "characteristic curve for permitted pressure loss" CURVE 0x8053A7A6 RB_Curve_U16_U16 131.0700 RBPtCel_p_0p002_1 0.00 131.0700 FORMAT "%8.4"
 /begin AXIS_DESCR STD_AXIS iniPRail RBPtCel_p_0p002_1 6 0.00 131.0700 FORMAT "%8.4" DEPOSIT ABSOLUTE /end AXIS_DESCR
/end CHARACTERISTIC
/begin CHARACTERISTIC DDHFHD_pMaxHldFctRels_C "maximum pressure to enable pressure hold func.diagnosis" VALUE 0x8053A7C0 RB_Val_Wu16 131.0700 RBPtCel_p_0p002_1 0.00 131.0700 FORMAT "%8.4" /end CHARACTERISTIC
/begin CHARACTERISTIC DDHFHD_pMinHldFctRels_C "minimum pressure to enable pressure hold func diagnosis" VALUE 0x8053A7C2 RB_Val_Wu16 131.0700 RBPtCel_p_0p002_1 0.00 131.0700 FORMAT "%8.4" /end CHARACTERISTIC
/begin CHARACTERISTIC DDHFHD_pSysMin_C "System minumum pressure" VALUE 0x8053A7C4 RB_Val_Wu16 131.0700 RBPtCel_p_0p002_1 0.00 131.0700 FORMAT "%8.4" /end CHARACTERISTIC
/begin CHARACTERISTIC DDHFHD_pThresEngOff_C "pressure threshold at engine shut off" VALUE 0x8053A7C6 RB_Val_Wu16 131.0700 RBPtCel_p_0p002_1 0.00 131.0700 FORMAT "%8.4" /end CHARACTERISTIC
/begin CHARACTERISTIC DDRC_DurDeb.AFS_tiPhyRngChkHiDebOk_C "debouncing parameter / Duration of healing debouncing for check DFC_AfsPhyRngHiB1" VALUE 0x804D8700 Val_Wu16 655350.0 DDRCTime_ms 0.00 655350.0 FORMAT "%8.1" /end CHARACTERISTIC
/begin CHARACTERISTIC DDRC_DurDeb.AFS_tiPhyRngChkHiDebDef_C "debouncing parameter / Duration of defect debouncing for check DFC_AfsPhyRngHiB1" VALUE 0x804D8702 Val_Wu16 655350.0 DDRCTime_ms 0.00 655350.0 FORMAT "%8.1" /end CHARACTERISTIC
/begin CHARACTERISTIC DDRC_DurDeb.AFS_tiPhyRngChkLoDebOk_C "debouncing parameter / Duration of healing debouncing for check DFC_AfsPhyRngLoB1" VALUE 0x804D8704 Val_Wu16 655350.0 DDRCTime_ms 0.00 655350.0 FORMAT "%8.1" /end CHARACTERISTIC
/begin CHARACTERISTIC DDRC_DurDeb.AFS_tiPhyRngChkLoDebDef_C "debouncing parameter / Duration of defect debouncing for check DFC_AfsPhyRngLoB1" VALUE 0x804D8706 Val_Wu16 655350.0 DDRCTime_ms 0.00 655350.0 FORMAT "%8.1" /end CHARACTERISTIC
/begin CHARACTERISTIC DDRC_DurDeb.AirC_tiCmprOLDebOk_C "debouncing parameter / Duration of healing debouncing for check DFC_AirCCmprOL" VALUE 0x804D8708 Val_Wu16 655350.0 DDRCTime_ms 0.00 655350.0 FORMAT "%8.1" /end CHARACTERISTIC
/begin CHARACTERISTIC DDRC_DurDeb.AirC_tiCmprOLDebDef_C "debouncing parameter / Duration of defect debouncing for check DFC_AirCCmprOL" VALUE 0x804D870A Val_Wu16 655350.0 DDRCTime_ms 0.00 655350.0 FORMAT "%8.1" /end CHARACTERISTIC
/begin CHARACTERISTIC DDRC_DurDeb.AirC_tiCmprOvrTempDebOk_C "debouncing parameter / Duration of healing debouncing for check DFC_AirCCmprOvrTemp" VALUE 0x804D870C Val_Wu16 655350.0 DDRCTime_ms 0.00 655350.0 FORMAT "%8.1" /end CHARACTERISTIC
/begin CHARACTERISTIC DDRC_DurDeb.AirC_tiCmprOvrTempDebDef_C "debouncing parameter / Duration of defect debouncing for check DFC_AirCCmprOvrTemp" VALUE 0x804D870E Val_Wu16 655350.0 DDRCTime_ms 0.00 655350.0 FORMAT "%8.1" /end CHARACTERISTIC
/begin CHARACTERISTIC DDRC_DurDeb.AirC_tiCmprSCBDebOk_C "debouncing parameter / Duration of healing debouncing for check DFC_AirCCmprSCB" VALUE 0x804D8710 Val_Wu16 655350.0 DDRCTime_ms 0.00 655350.0 FORMAT "%8.1" /end CHARACTERISTIC
/begin CHARACTERISTIC DDRC_DurDeb.AirC_tiCmprSCBDebDef_C "debouncing parameter / Duration of defect debouncing for check DFC_AirCCmprSCB" VALUE 0x804D8712 Val_Wu16 655350.0 DDRCTime_ms 0.00 655350.0 FORMAT "%8.1" /end CHARACTERISTIC
/begin CHARACTERISTIC DDRC_DurDeb.AirC_tiCmprSCGDebOk_C "debouncing parameter / Duration of healing debouncing for check DFC_AirCCmprSCG" VALUE 0x804D8714 Val_Wu16 655350.0 DDRCTime_ms 0.00 655350.0 FORMAT "%8.1" /end CHARACTERISTIC
/begin CHARACTERISTIC DDRC_DurDeb.AirC_tiCmprSCGDebDef_C "debouncing parameter / Duration of defect debouncing for check DFC_AirCCmprSCG" VALUE 0x804D8716 Val_Wu16 655350.0 DDRCTime_ms 0.00 655350.0 FORMAT "%8.1" /end CHARACTERISTIC
/begin CHARACTERISTIC DDRC_DurDeb.Alt_tiErrDebOk_C "debouncing parameter / Duration of healing debouncing for check DFC_AltErr" VALUE 0x804D8718 Val_Wu16 655350.0 DDRCTime_ms 0.00 655350.0 FORMAT "%8.1" /end CHARACTERISTIC
/begin CHARACTERISTIC DDRC_DurDeb.Alt_tiErrDebDef_C "debouncing parameter / Duration of defect debouncing for check DFC_AltErr" VALUE 0x804D871A Val_Wu16 655350.0 DDRCTime_ms 0.00 655350.0 FORMAT "%8.1" /end CHARACTERISTIC
/begin CHARACTERISTIC DDRC_DurDeb.BattU_tiMaxDebOk_C "debouncing parameter / Duration of healing debouncing for check DFC_BattUSRCMax" VALUE 0x804D871C Val_Wu16 655350.0 DDRCTime_ms 0.00 655350.0 FORMAT "%8.1" /end CHARACTERISTIC
/begin CHARACTERISTIC DDRC_DurDeb.BattU_tiMaxDebDef_C "debouncing parameter / Duration of defect debouncing for check DFC_BattUSRCMax" VALUE 0x804D871E Val_Wu16 655350.0 DDRCTime_ms 0.00 655350.0 FORMAT "%8.1" /end CHARACTERISTIC
/begin CHARACTERISTIC DDRC_DurDeb.BattU_tiMinDebOk_C "debouncing parameter / Duration of healing debouncing for check DFC_BattUSRCMin" VALUE 0x804D8720 Val_Wu16 655350.0 DDRCTime_ms 0.00 655350.0 FORMAT "%8.1" /end CHARACTERISTIC
/begin CHARACTERISTIC DDRC_DurDeb.BattU_tiMinDebDef_C "debouncing parameter / Duration of defect debouncing for check DFC_BattUSRCMin" VALUE 0x804D8722 Val_Wu16 655350.0 DDRCTime_ms 0.00 655350.0 FORMAT "%8.1" /end CHARACTERISTIC
/begin CHARACTERISTIC DDRC_DurDeb.Com_tiChksTCU1DebOk_C "debouncing parameter / Duration of healing debouncing for check DFC_ComChksTCU1" VALUE 0x804D8724 Val_Wu16 655350.0 DDRCTime_ms 0.00 655350.0 FORMAT "%8.1" /end CHARACTERISTIC
/begin CHARACTERISTIC DDRC_DurDeb.Com_tiChksTCU1DebDef_C "debouncing parameter / Duration of defect debouncing for check DFC_ComChksTCU1" VALUE 0x804D8726 Val_Wu16 655350.0 DDRCTime_ms 0.00 655350.0 FORMAT "%8.1" /end CHARACTERISTIC
/begin CHARACTERISTIC DDRC_DurDeb.Com_tiChksTCU11DebOk_C "debouncing parameter / Duration of healing debouncing for check DFC_ComChksTCU11" VALUE 0x804D8728 Val_Wu16 655350.0 DDRCTime_ms 0.00 655350.0 FORMAT "%8.1" /end CHARACTERISTIC
/begin CHARACTERISTIC DDRC_DurDeb.Com_tiChksTCU11DebDef_C "debouncing parameter / Duration of defect debouncing for check DFC_ComChksTCU11" VALUE 0x804D872A Val_Wu16 655350.0 DDRCTime_ms 0.00 655350.0 FORMAT "%8.1" /end CHARACTERISTIC
/begin CHARACTERISTIC DDRC_DurDeb.Com_tiChksTCU12DebOk_C "debouncing parameter / Duration of healing debouncing for check DFC_ComChksTCU12" VALUE 0x804D872C Val_Wu16 655350.0 DDRCTime_ms 0.00 655350.0 FORMAT "%8.1" /end CHARACTERISTIC
/begin CHARACTERISTIC DDRC_DurDeb.Com_tiChksTCU12DebDef_C "debouncing parameter / Duration of defect debouncing for check DFC_ComChksTCU12" VALUE 0x804D872E Val_Wu16 655350.0 DDRCTime_ms 0.00 655350.0 FORMAT "%8.1" /end CHARACTERISTIC
/begin CHARACTERISTIC DDRC_DurDeb.Com_tiChksTCU13DebOk_C "debouncing parameter / Duration of healing debouncing for check DFC_ComChksTCU13" VALUE 0x804D8730 Val_Wu16 655350.0 DDRCTime_ms 0.00 655350.0 FORMAT "%8.1" /end CHARACTERISTIC
/begin CHARACTERISTIC DDRC_DurDeb.Com_tiChksTCU13DebDef_C "debouncing parameter / Duration of defect debouncing for check DFC_ComChksTCU13" VALUE 0x804D8732 Val_Wu16 655350.0 DDRCTime_ms 0.00 655350.0 FORMAT "%8.1" /end CHARACTERISTIC
/begin CHARACTERISTIC DDRC_DurDeb.Com_tiChksTCU2DebOk_C "debouncing parameter / Duration of healing debouncing for check DFC_ComChksTCU2" VALUE 0x804D8734 Val_Wu16 655350.0 DDRCTime_ms 0.00 655350.0 FORMAT "%8.1" /end CHARACTERISTIC
/begin CHARACTERISTIC DDRC_DurDeb.Com_tiChksTCU2DebDef_C "debouncing parameter / Duration of defect debouncing for check DFC_ComChksTCU2" VALUE 0x804D8736 Val_Wu16 655350.0 DDRCTime_ms 0.00 655350.0 FORMAT "%8.1" /end CHARACTERISTIC
/begin CHARACTERISTIC DDRC_DurDeb.Com_tiChksTCU3DebOk_C "debouncing parameter / Duration of healing debouncing for check DFC_ComChksTCU3" VALUE 0x804D8738 Val_Wu16 655350.0 DDRCTime_ms 0.00 655350.0 FORMAT "%8.1" /end CHARACTERISTIC
/begin CHARACTERISTIC DDRC_DurDeb.Com_tiChksTCU3DebDef_C "debouncing parameter / Duration of defect debouncing for check DFC_ComChksTCU3" VALUE 0x804D873A Val_Wu16 655350.0 DDRCTime_ms 0.00 655350.0 FORMAT "%8.1" /end CHARACTERISTIC
/begin CHARACTERISTIC DDRC_DurDeb.Com_tiChksTCU4DebOk_C "debouncing parameter / Duration of healing debouncing for check DFC_ComChksTCU4" VALUE 0x804D873C Val_Wu16 655350.0 DDRCTime_ms 0.00 655350.0 FORMAT "%8.1" /end CHARACTERISTIC
/begin CHARACTERISTIC DDRC_DurDeb.Com_tiChksTCU4DebDef_C "debouncing parameter / Duration of defect debouncing for check DFC_ComChksTCU4" VALUE 0x804D873E Val_Wu16 655350.0 DDRCTime_ms 0.00 655350.0 FORMAT "%8.1" /end CHARACTERISTIC
/begin CHARACTERISTIC DDRC_DurDeb.Com_tiCntTCU1DebOk_C "debouncing parameter / Duration of healing debouncing for check DFC_ComCntTCU1" VALUE 0x804D8740 Val_Wu16 655350.0 DDRCTime_ms 0.00 655350.0 FORMAT "%8.1" /end CHARACTERISTIC
/begin CHARACTERISTIC I14229iocbi_agPHAACTRINTK1_C "Calibration for Intake Camshaft Phase SDA test data" VALUE 0x8058AEEA Val_Ws16 1023.984 kw_q0p0156 -512.0000 511.9844 FORMAT "%8.4" /end CHARACTERISTIC
/begin CHARACTERISTIC I14229iocbi_agPHAACTRINTK2_C "Calibration for Intake Camshaft Phase SDA test data" VALUE 0x8058AEEC Val_Ws16 1023.984 kw_q0p0156 -512.0000 511.9844 FORMAT "%8.4" /end CHARACTERISTIC
/begin CHARACTERISTIC I14229iocbi_agPHAACTRINTK3_C "Calibration for Intake Camshaft Phase SDA test data" VALUE 0x8058AEEE Val_Ws16 1023.984 kw_q0p0156 -512.0000 511.9844 FORMAT "%8.4" /end CHARACTERISTIC
/begin CHARACTERISTIC I14229iocbi_agPHAACTROUTL1_C "Calibration for Outlet Camshaft Phase SDA test data" VALUE 0x8058AEF0 Val_Ws16 1023.984 kw_q0p0156 -512.0000 511.9844 FORMAT "%8.4" /end CHARACTERISTIC
/begin CHARACTERISTIC I14229iocbi_agPHAACTROUTL2_C "Calibration for Outlet Camshaft Phase SDA test data" VALUE 0x8058AEF2 Val_Ws16 1023.984 kw_q0p0156 -512.0000 511.9844 FORMAT "%8.4" /end CHARACTERISTIC
/begin CHARACTERISTIC I14229iocbi_agPHAACTROUTL3_C "Calibration for Outlet Camshaft Phase SDA test data" VALUE 0x8058AEF4 Val_Ws16 1023.984 kw_q0p0156 -512.0000 511.9844 FORMAT "%8.4" /end CHARACTERISTIC
/begin CHARACTERISTIC I14229iocbi_nCP_C "Input output request calibration for capacity factor" VALUE 0x8058AEF6 Val_Ws16 32767.50 EngN -16384.00 16383.50 FORMAT "%8.2" /end CHARACTERISTIC
/begin CHARACTERISTIC I14229iocbi_nHiRpmColdStrtFlPmp_C "Calibration for High rpm at cold start condition at fuel bleeding for replacement of fuel injector" VALUE 0x8053AE1E RB_Val_Ws16 32767.50 EngN -16384.00 16383.50 FORMAT "%8.2" /end CHARACTERISTIC
/begin CHARACTERISTIC I14229iocbi_nInjRateAmnt_C "Calibration value to check engine speed for Rate of Injection Amount SDA" VALUE 0x8058AEF8 Val_Ws16 32767.50 EngN -16384.00 16383.50 FORMAT "%8.2" /end CHARACTERISTIC
/begin CHARACTERISTIC I14229iocbi_nInjVlvCyl_C "input output request calibration for injector valve cylinder factor" VALUE 0x8058AEFA Val_Ws16 32767.50 EngN -16384.00 16383.50 FORMAT "%8.2" /end CHARACTERISTIC
/begin CHARACTERISTIC I14229iocbi_nInjVlv_C "input output request calibration for injector valve factor" VALUE 0x8058AEFC Val_Ws16 32767.50 EngN -16384.00 16383.50 FORMAT "%8.2" /end CHARACTERISTIC
/begin CHARACTERISTIC I14229iocbi_nOilPCtrlHi1_C "Upper engine speed limit for test start" VALUE 0x8058AEFE Val_Ws16 32767.50 EngN -16384.00 16383.50 FORMAT "%8.2" /end CHARACTERISTIC
/begin CHARACTERISTIC I14229iocbi_nOilPCtrlHi2_C "Upper engine speed limit for test stop" VALUE 0x8058AF00 Val_Ws16 32767.50 EngN -16384.00 16383.50 FORMAT "%8.2" /end CHARACTERISTIC
/begin CHARACTERISTIC I14229iocbi_nOilPCtrlLo1_C "Lower engine speed limit for test start" VALUE 0x8058AF02 Val_Ws16 32767.50 EngN -16384.00 16383.50 FORMAT "%8.2" /end CHARACTERISTIC
/begin CHARACTERISTIC I14229iocbi_nOilPCtrlLo2_C "Lower engine speed limit for test stop" VALUE 0x8058AF04 Val_Ws16 32767.50 EngN -16384.00 16383.50 FORMAT "%8.2" /end CHARACTERISTIC
/begin CHARACTERISTIC I14229iocbi_nRvsLck_C "Calibration value for checking engine speed for Reverse Lock." VALUE 0x8058AF06 Val_Ws16 32767.50 EngN -16384.00 16383.50 FORMAT "%8.2" /end CHARACTERISTIC
/begin CHARACTERISTIC I14229iocbi_nSDAOilPCtrl_C "Parameter to check engine speed for oil valve control" VALUE 0x8058AF08 Val_Ws16 32767.50 EngN -16384.00 16383.50 FORMAT "%8.2" /end CHARACTERISTIC
/begin CHARACTERISTIC I14229iocbi_nTrbCh_C "Parameter to check engine speed condition using for Turbor Charge Bank SDA tset" VALUE 0x8058AF0A Val_Ws16 32767.50 EngN -16384.00 16383.50 FORMAT "%8.2" /end CHARACTERISTIC
/begin CHARACTERISTIC I14229iocbi_numAirCCmpr_C "air compressor calibration" VALUE 0x804D86F8 Val_Wu16 65535.00 OneToOne 0.00 65535.00 FORMAT "%8.2" /end CHARACTERISTIC
/begin CHARACTERISTIC I14229iocbi_numAPP_C "Number corresponding to Accelerator pedal position sensor" VALUE 0x804D86F6 Val_Wu16 65535.00 OneToOne 0.00 65535.00 FORMAT "%8.2" /end CHARACTERISTIC
/begin CHARACTERISTIC I14229iocbi_numCP_C "capacity number" VALUE 0x804D86F4 Val_Wu16 65535.00 OneToOne 0.00 65535.00 FORMAT "%8.2" /end CHARACTERISTIC
/begin CHARACTERISTIC I14229iocbi_numDuv_C "Maximum number of Operation modes allowed for Air Bypass Solenoid Valve FST mode" VALUE 0x804D86F2 Val_Wu16 65535.00 OneToOne 0.00 65535.00 FORMAT "%8.2" /end CHARACTERISTIC
/begin CHARACTERISTIC I14229iocbi_numEGRVlv_C "Maximum number of Operation modes allowed for this SFT mode( EGR Valve SDA)" VALUE 0x804D86F0 Val_Wu16 65535.00 OneToOne 0.00 65535.00 FORMAT "%8.2" /end CHARACTERISTIC
/begin CHARACTERISTIC I14229iocbi_numEVAP_C "Maximum number of Operation modes allowed for SDA EVAP control" VALUE 0x804D86EE Val_Wu16 65535.00 OneToOne 0.00 65535.00 FORMAT "%8.2" /end CHARACTERISTIC
/begin CHARACTERISTIC I14229iocbi_numFanDig_C "digital fan number" VALUE 0x804D86EC Val_Wu16 65535.00 OneToOne 0.00 65535.00 FORMAT "%8.2" /end CHARACTERISTIC
/begin CHARACTERISTIC I14229iocbi_numFlPmp_C "number of fuel number" VALUE 0x804D86EA Val_Wu16 65535.00 OneToOne 0.00 65535.00 FORMAT "%8.2" /end CHARACTERISTIC
/begin CHARACTERISTIC I14229iocbi_numInjRateAmnt_C "Calibration value to check maximum ControlState value for Rate of Injection Amount SDA" VALUE 0x804D86E8 Val_Wu16 65535.00 OneToOne 0.00 65535.00 FORMAT "%8.2" /end CHARACTERISTIC
/begin CHARACTERISTIC I14229iocbi_numInjTstFlg1_C "Injector tester flag" VALUE 0x804D86E6 Val_Wu16 65535.00 OneToOne 0.00 65535.00 FORMAT "%8.2" /end CHARACTERISTIC
/begin CHARACTERISTIC I14229iocbi_numInjTstFlg_C "injector tester flag" VALUE 0x804D86E4 Val_Wu16 65535.00 OneToOne 0.00 65535.00 FORMAT "%8.2" /end CHARACTERISTIC
/begin CHARACTERISTIC I14229iocbi_numMDAAltIO_C "Alternator input output value" VALUE 0x804D86E2 Val_Wu16 65535.00 OneToOne 0.00 65535.00 FORMAT "%8.2" /end CHARACTERISTIC
/begin CHARACTERISTIC I14229iocbi_numMDACP_C "Maximum number of Operation modes allowed for Canister Purge Valve MDA FST mode" VALUE 0x804D86E0 Val_Wu16 65535.00 OneToOne 0.00 65535.00 FORMAT "%8.2" /end CHARACTERISTIC
/begin CHARACTERISTIC I14229iocbi_numMDADuv_C "Maximum number of Operation modes allowed for Air Bypass Solenoid Valve MDA test FST mode" VALUE 0x804D86DE Val_Wu16 65535.00 OneToOne 0.00 65535.00 FORMAT "%8.2" /end CHARACTERISTIC
/begin CHARACTERISTIC I14229iocbi_numMDAEGRVlv_C "Maximum number of Operation modes allowed for this SFT mode( EGR Valve MDA)" VALUE 0x804D86DC Val_Wu16 65535.00 OneToOne 0.00 65535.00 FORMAT "%8.2" /end CHARACTERISTIC
/begin CHARACTERISTIC I14229iocbi_numMDAFanDig_C "Digital value corresponding to cooling fan" VALUE 0x804D86DA Val_Wu16 65535.00 OneToOne 0.00 65535.00 FORMAT "%8.2" /end CHARACTERISTIC
/begin CHARACTERISTIC I14229iocbi_numMDAICEWP_C "Maximum number of Operation modes allowed for water charge air cooler EWP control MDA" VALUE 0x804D86D8 Val_Wu16 65535.00 OneToOne 0.00 65535.00 FORMAT "%8.2" /end CHARACTERISTIC
/begin CHARACTERISTIC I14229iocbi_numMDAVlvLft_C "Maximum number of Operation modes allowed for Valve Lift MDA test FST mode" VALUE 0x804D86D6 Val_Wu16 65535.00 OneToOne 0.00 65535.00 FORMAT "%8.2" /end CHARACTERISTIC
/begin CHARACTERISTIC I14229iocbi_numOilPCtrl_C "Max value of control state allowed for DID0x0122" VALUE 0x804D86D4 Val_Wu16 65535.00 OneToOne 0.00 65535.00 FORMAT "%8.2" /end CHARACTERISTIC
/begin CHARACTERISTIC I14229iocbi_numPHAACTRINTK_C "Maximum number of Operation modes allowed for Intake Camshaft Phase SDA test FST mode" VALUE 0x804D86D2 Val_Wu16 65535.00 OneToOne 0.00 65535.00 FORMAT "%8.2" /end CHARACTERISTIC
/begin CHARACTERISTIC I14229iocbi_numPHAACTROUTL_C "Maximum number of Operation modes allowed for Outlet Camshaft Phase SDA test FST mode" VALUE 0x804D86D0 Val_Wu16 65535.00 OneToOne 0.00 65535.00 FORMAT "%8.2" /end CHARACTERISTIC
/begin CHARACTERISTIC I14229iocbi_numRvsLck_C "Maximum number of modes alllowed for Reverse Lock" VALUE 0x804D86CE Val_Wu16 65535.00 OneToOne 0.00 65535.00 FORMAT "%8.2" /end CHARACTERISTIC
/begin CHARACTERISTIC I14229iocbi_numSDAICEWP_C "Maximum number of Operation modes allowed for this water charge air cooler ICEWP SDA" VALUE 0x804D86CC Val_Wu16 65535.00 OneToOne 0.00 65535.00 FORMAT "%8.2" /end CHARACTERISTIC
/begin CHARACTERISTIC I14229iocbi_numSDAOilPCtrl_C "Parameter for control state number for oil Valve control SDA" VALUE 0x804D86CA Val_Wu16 65535.00 OneToOne 0.00 65535.00 FORMAT "%8.2" /end CHARACTERISTIC
/begin CHARACTERISTIC I14229iocbi_numThrVlv_C "Maximum operation mode number for ThrVlv SFT" VALUE 0x804D86C8 Val_Wu16 65535.00 OneToOne 0.00 65535.00 FORMAT "%8.2" /end CHARACTERISTIC
/begin CHARACTERISTIC I14229iocbi_numTrbCh_C "Maximum operation mode number for TrbCh SFT" VALUE 0x804D86C6 Val_Wu16 65535.00 OneToOne 0.00 65535.00 FORMAT "%8.2" /end CHARACTERISTIC
/begin CHARACTERISTIC I14229iocbi_numVentShtVlv_C "Number of supported control state of 0x0139" VALUE 0x804D86C4 Val_Wu16 65535.00 OneToOne 0.00 65535.00 FORMAT "%8.2" /end CHARACTERISTIC
/begin CHARACTERISTIC I14229iocbi_numVlvLft_C "Valve lift value" VALUE 0x804D86C2 Val_Wu16 65535.00 OneToOne 0.00 65535.00 FORMAT "%8.2" /end CHARACTERISTIC
/begin CHARACTERISTIC I14229iocbi_nVlvLftHi_C "Upper limit for valve lift value" VALUE 0x8058AF0C Val_Ws16 32767.50 EngN -16384.00 16383.50 FORMAT "%8.2" /end CHARACTERISTIC
/begin CHARACTERISTIC I14229iocbi_nVlvLftLo_C "Lower limit for valve lift value" VALUE 0x8058AF0E Val_Ws16 32767.50 EngN -16384.00 16383.50 FORMAT "%8.2" /end CHARACTERISTIC
/begin CHARACTERISTIC I14229iocbi_pFuTankPMaxEVAP_C "Maximum Fuel Tank Pressure condition for SDA EVAP control" VALUE 0x8058AF10 Val_Ws16 79.99878 p_q0p00122 -40.00000 39.99878 FORMAT "%8.5" /end CHARACTERISTIC
/begin CHARACTERISTIC I14229iocbi_pFuTankPMinEVAP_C "Minimum Fuel Tank Pressure condition for SDA EVAP control" VALUE 0x8058AF14 Val_Ws32 5242879.99878 p_q0p00122 -2621440.00000 2621439.99878 FORMAT "%13.5" /end CHARACTERISTIC
/begin CHARACTERISTIC I14229iocbi_pInjRateAmnt_C "Calibration value to check intake air pressure for Rate of Injection Amount SDA" VALUE 0x8058AF18 Val_Wu16 1920.134 p_uw_q0p039_mmHg 0.00 1920.134 FORMAT "%8.3" /end CHARACTERISTIC
/begin CHARACTERISTIC I14229iocbi_rDuv1_C "Parameter to control the opening of Air Bypass Solenoid Valve SDA test" VALUE 0x8058AF1A Val_Wu16 99.99847 rel_uw_b100 0.00 99.99847 FORMAT "%8.5" /end CHARACTERISTIC
/begin CHARACTERISTIC I14229iocbi_rDuv2_C "Parameter to control the opening of Air Bypass Solenoid Valve SDA test" VALUE 0x8058AF1C Val_Wu16 99.99847 rel_uw_b100 0.00 99.99847 FORMAT "%8.5" /end CHARACTERISTIC
/begin CHARACTERISTIC I14229iocbi_rMDADuv1_C "Parameter to control the opening of Air Bypass Solenoid Valve MDA test" VALUE 0x8058AF1E Val_Wu16 99.99847 rel_uw_b100 0.00 99.99847 FORMAT "%8.5" /end CHARACTERISTIC
/begin CHARACTERISTIC I14229iocbi_rMDADuv2_C "Parameter to control the opening of Air Bypass Solenoid Valve MDA test" VALUE 0x8058AF20 Val_Wu16 99.99847 rel_uw_b100 0.00 99.99847 FORMAT "%8.5" /end CHARACTERISTIC
/begin CHARACTERISTIC I14229iocbi_rPCSdutyCond_C "PCS duty condition for SDA EVAP control" VALUE 0x8058AF22 Val_Wu8 99.61 rel_q0p39 0.00 99.61 FORMAT "%5.2" /end CHARACTERISTIC
/begin CHARACTERISTIC I14229iocbi_rTrbChCls_C "Parameter to control the closing of Turbor Charge Bank 1 SDA test" VALUE 0x8058AF24 Val_Ws16 511.9922 rel_q0p0078125 -256.0000 255.9922 FORMAT "%8.4" /end CHARACTERISTIC
/begin CHARACTERISTIC I14229iocbi_rTrbChOpen_C "Parameter to control the opening of Turbor Charge Bank 1 SDA test" VALUE 0x8058AF26 Val_Ws16 511.9922 rel_q0p0078125 -256.0000 255.9922 FORMAT "%8.4" /end CHARACTERISTIC
/begin CHARACTERISTIC I14229iocbi_stVentShtVlv0_C "Control state Calibration 0 for Vent Shut Valve 0x0139" VALUE 0x8058AF28 Val_Wu8 255.0 OneToOne 0.00 255.0 FORMAT "%5.1" /end CHARACTERISTIC
/begin CHARACTERISTIC I14229iocbi_stVentShtVlv1_C "Control state Calibration 0 for Vent Shut Valve 0x0139" VALUE 0x8058AF29 Val_Wu8 255.0 OneToOne 0.00 255.0 FORMAT "%5.1" /end CHARACTERISTIC
/begin CHARACTERISTIC I14229iocbi_tEGRVlvHi_C "Upper limit of temperature condition check for EGR valve lift" VALUE 0x8058AF2A Val_Ws16 6553.500 Temp_Cels -3549.940 3003.560 FORMAT "%8.3" /end CHARACTERISTIC
/begin CHARACTERISTIC I14229iocbi_tEGRVlvLo_C "Lower limit of temperature condition check for EGR valve lift" VALUE 0x8058AF2C Val_Ws16 6553.500 Temp_Cels -3549.940 3003.560 FORMAT "%8.3" /end CHARACTERISTIC
/begin CHARACTERISTIC I14229iocbi_tFanDig_C "Digital fan temperature" VALUE 0x8058AF2E Val_Ws16 6553.500 Temp_Cels -3549.940 3003.560 FORMAT "%8.3" /end CHARACTERISTIC
/begin CHARACTERISTIC I14229iocbi_tInjRateAmntHi_C "Calibration value to check engine coolant temperature for Rate of Injection Amount SDA" VALUE 0x8058AF30 RB_Val_Ws16 6553.500 Temp_Cels -3549.940 3003.560 FORMAT "%8.3" /end CHARACTERISTIC
/begin CHARACTERISTIC I14229iocbi_tInjRateAmntLo_C "Calibration value to check engine coolant temperature for Rate of Injection Amount SDA" VALUE 0x8058AF32 Val_Ws16 6553.500 Temp_Cels -3549.940 3003.560 FORMAT "%8.3" /end CHARACTERISTIC
/begin CHARACTERISTIC I14229iocbi_tInjTstCylHi_C "Upper limit of injector tester cylinder temperature" VALUE 0x8058AF34 Val_Ws16 6553.500 Temp_Cels -3549.940 3003.560 FORMAT "%8.3" /end CHARACTERISTIC
/begin CHARACTERISTIC I14229iocbi_tInjTstCylLo_C "Lower limit of injector tester cylinder temperature" VALUE 0x8058AF36 Val_Ws16 6553.500 Temp_Cels -3549.940 3003.560 FORMAT "%8.3" /end CHARACTERISTIC
/begin CHARACTERISTIC I14229iocbi_tOilPCtrlHi_C "Upper coolant temp limit" VALUE 0x8058AF38 Val_Ws16 6553.500 Temp_Cels -3549.940 3003.560 FORMAT "%8.3" /end CHARACTERISTIC
/begin CHARACTERISTIC I14229iocbi_tOilPCtrlLo_C "Lower coolant temp limit" VALUE 0x8058AF3A Val_Ws16 6553.500 Temp_Cels -3549.940 3003.560 FORMAT "%8.3" /end CHARACTERISTIC
/begin CHARACTERISTIC I14229iocbi_tPHAACTRINTKHi_C "Upper limit of Intake Camshaft Phase SDA temperature" VALUE 0x8058AF3C Val_Ws16 6553.500 Temp_Cels -3549.940 3003.560 FORMAT "%8.3" /end CHARACTERISTIC
/begin CHARACTERISTIC I14229iocbi_tPHAACTRINTKLo_C "Lower limit of Intake Camshaft Phase SDA temperature" VALUE 0x8058AF3E Val_Ws16 6553.500 Temp_Cels -3549.940 3003.560 FORMAT "%8.3" /end CHARACTERISTIC
/begin CHARACTERISTIC I14229iocbi_tPHAACTROUTLHi_C "Upper limit of Outlet Camshaft Phase SDA temperature" VALUE 0x8058AF40 Val_Ws16 6553.500 Temp_Cels -3549.940 3003.560 FORMAT "%8.3" /end CHARACTERISTIC
/begin CHARACTERISTIC I14229iocbi_tPHAACTROUTLLo_C "Lower limit of Outlet Camshaft Phase SDA temperature" VALUE 0x8058AF42 Val_Ws16 6553.500 Temp_Cels -3549.940 3003.560 FORMAT "%8.3" /end CHARACTERISTIC
/begin CHARACTERISTIC I14229iocbi_tSDAOilPCtrlHi_C "Parameter for engine coolant temperature (upper limit) check for oil valve control SDA" VALUE 0x8058AF44 Val_Ws16 6553.500 Temp_Cels -3549.940 3003.560 FORMAT "%8.3" /end CHARACTERISTIC
/begin CHARACTERISTIC I14229iocbi_tSDAOilPCtrlLo_C "Parameter for engine coolant temperature (lower limit) check for oil valve control SDA" VALUE 0x8058AF46 Val_Ws16 6553.500 Temp_Cels -3549.940 3003.560 FORMAT "%8.3" /end CHARACTERISTIC
/begin CHARACTERISTIC I14229iocbi_tSDAOilT_C "Parameter for Oil temperature check for oil valve control SDA" VALUE 0x8058AF48 Val_Ws16 6553.500 Temp_Cels -3549.940 3003.560 FORMAT "%8.3" /end CHARACTERISTIC
/begin CHARACTERISTIC I14229iocbi_tVlvLft_C "valve lift temperature." VALUE 0x8058AF4A Val_Ws16 6553.500 Temp_Cels -3549.940 3003.560 FORMAT "%8.3" /end CHARACTERISTIC
/begin CHARACTERISTIC I14229iocbi_uAirCCmpr_C "Air compressor voltage" VALUE 0x8058AF4C Val_Ws16 1310700. Volt_Batt -655360.0 655340.0 FORMAT "%8.1" /end CHARACTERISTIC
/begin CHARACTERISTIC I14229iocbi_uCPRun_C "Canister Purge Valve calibration for Power voltage check when engine is running" VALUE 0x8058AF4E Val_Ws16 1310700. Volt_Batt -655360.0 655340.0 FORMAT "%8.1" /end CHARACTERISTIC
/begin CHARACTERISTIC I14229iocbi_uCP_C "Capacity voltage" VALUE 0x8058AF50 Val_Ws16 1310700. Volt_Batt -655360.0 655340.0 FORMAT "%8.1" /end CHARACTERISTIC
/begin CHARACTERISTIC I14229iocbi_uDuvRun_C "Air Bypass Solenoid Valve running voltage SDA test" VALUE 0x8058AF52 Val_Ws16 1310700. Volt_Batt -655360.0 655340.0 FORMAT "%8.1" /end CHARACTERISTIC
/begin CHARACTERISTIC I14229iocbi_uDuv_C "Voltage coresponding to Air Bypass Solenoid Valve" VALUE 0x8058AF54 Val_Ws16 1310700. Volt_Batt -655360.0 655340.0 FORMAT "%8.1" /end CHARACTERISTIC
/begin CHARACTERISTIC I14229iocbi_uEGRVlv_C "Parameter for battery voltage check for EGR valve SDA" VALUE 0x8058AF56 Val_Ws16 1310700. Volt_Batt -655360.0 655340.0 FORMAT "%8.1" /end CHARACTERISTIC
/begin CHARACTERISTIC I14229iocbi_uEVAP_C "Battery Voltage condition for SDA EVAP control" VALUE 0x8058AF58 Val_Ws16 1310700. Volt_Batt -655360.0 655340.0 FORMAT "%8.1" /end CHARACTERISTIC
/begin CHARACTERISTIC I14229iocbi_uFanDigRun_C "Digital voltage of fan running" VALUE 0x8058AF5A Val_Ws16 1310700. Volt_Batt -655360.0 655340.0 FORMAT "%8.1" /end CHARACTERISTIC
/begin CHARACTERISTIC I14229iocbi_uFanDigStl_C "Digital voltage of fan running" VALUE 0x8058AF5C Val_Ws16 1310700. Volt_Batt -655360.0 655340.0 FORMAT "%8.1" /end CHARACTERISTIC
/begin CHARACTERISTIC I14229iocbi_uFlPmpRun_C "Fuel pump running voltage" VALUE 0x8058AF5E Val_Ws16 1310700. Volt_Batt -655360.0 655340.0 FORMAT "%8.1" /end CHARACTERISTIC
/begin CHARACTERISTIC I14229iocbi_uFlPmpStl_C "voltage coresponding to fuel pump" VALUE 0x8058AF60 Val_Ws16 1310700. Volt_Batt -655360.0 655340.0 FORMAT "%8.1" /end CHARACTERISTIC
/begin CHARACTERISTIC I14229iocbi_uInjRateAmntRun_C "Calibration value to check battery voltage for Rate of Injection Amount SDA" VALUE 0x8058AF62 Val_Ws16 1310700. Volt_Batt -655360.0 655340.0 FORMAT "%8.1" /end CHARACTERISTIC
/begin CHARACTERISTIC I14229iocbi_uInjRateAmnt_C "Calibration value to check battery voltage for Rate of Injection Amount SDA" VALUE 0x8058AF64 Val_Ws16 1310700. Volt_Batt -655360.0 655340.0 FORMAT "%8.1" /end CHARACTERISTIC
/begin CHARACTERISTIC I14229iocbi_uInjTstRun_C "voltage corresponding to injector test run" VALUE 0x8058AF66 Val_Ws16 1310700. Volt_Batt -655360.0 655340.0 FORMAT "%8.1" /end CHARACTERISTIC
/begin CHARACTERISTIC I14229iocbi_uInjTstStl_C "voltage corresponding to injector test stall" VALUE 0x8058AF68 Val_Ws16 1310700. Volt_Batt -655360.0 655340.0 FORMAT "%8.1" /end CHARACTERISTIC
/begin CHARACTERISTIC I14229iocbi_uMDACPRun_C "Canister Purge Valve runing Voltage" VALUE 0x8058AF6A Val_Ws16 1310700. Volt_Batt -655360.0 655340.0 FORMAT "%8.1" /end CHARACTERISTIC
/begin CHARACTERISTIC I14229iocbi_uMDACP_C "Voltage coresponding to Air Bypass Solenoid Valve MDA test" VALUE 0x8058AF6C Val_Ws16 1310700. Volt_Batt -655360.0 655340.0 FORMAT "%8.1" /end CHARACTERISTIC
/begin CHARACTERISTIC I14229iocbi_uMDADuvRun_C "Air Bypass Solenoid Valve running voltage MDA test" VALUE 0x8058AF6E Val_Ws16 1310700. Volt_Batt -655360.0 655340.0 FORMAT "%8.1" /end CHARACTERISTIC
/begin CHARACTERISTIC I14229iocbi_uMDADuv_C "Voltage coresponding to Air Bypass Solenoid Valve MDA test" VALUE 0x8058AF70 Val_Ws16 1310700. Volt_Batt -655360.0 655340.0 FORMAT "%8.1" /end CHARACTERISTIC
/begin CHARACTERISTIC I14229iocbi_uOilPCtrl_C "Battery voltage limit" VALUE 0x8058AF72 Val_Ws16 1310700. Volt_Batt -655360.0 655340.0 FORMAT "%8.1" /end CHARACTERISTIC
/begin CHARACTERISTIC I14229iocbi_uPHAACTRINTKRun_C "Parameter to check power voltage condition using for for Intake Camshaft Phase SDA test when engine is running" VALUE 0x8058AF74 Val_Ws16 1310700. Volt_Batt -655360.0 655340.0 FORMAT "%8.1" /end CHARACTERISTIC
/begin CHARACTERISTIC I14229iocbi_uPHAACTRINTKStl_C "Parameter to check power voltage condition using for for Intake Camshaft Phase SDA test when engine is not running" VALUE 0x8058AF76 Val_Ws16 1310700. Volt_Batt -655360.0 655340.0 FORMAT "%8.1" /end CHARACTERISTIC
/begin CHARACTERISTIC I14229iocbi_uPHAACTROUTL_C "Parameter to check power voltage condition using for for Outlet Camshaft Phase SDA test" VALUE 0x8058AF78 Val_Ws16 1310700. Volt_Batt -655360.0 655340.0 FORMAT "%8.1" /end CHARACTERISTIC
/begin CHARACTERISTIC I14229iocbi_uSDAOilPCtrl_C "Parameter to check battery voltage for oil valve control SDA" VALUE 0x8058AF7A Val_Ws16 1310700. Volt_Batt -655360.0 655340.0 FORMAT "%8.1" /end CHARACTERISTIC
/begin CHARACTERISTIC I14229iocbi_uThrVlv_C "voltage corresponding to throttle valve" VALUE 0x8058AF7C Val_Ws16 1310700. Volt_Batt -655360.0 655340.0 FORMAT "%8.1" /end CHARACTERISTIC
/begin CHARACTERISTIC I14229iocbi_uTrbCh_C "voltage coresponding to Turbor Charge bank 1" VALUE 0x8058AF7E Val_Ws16 1310700. Volt_Batt -655360.0 655340.0 FORMAT "%8.1" /end CHARACTERISTIC
/begin CHARACTERISTIC I14229iocbi_uVentShtVlv_C "Battery Voltage condition Calibration for Vent Shut Valve 0x0139" VALUE 0x8058AF80 Val_Ws16 1310700. Volt_Batt -655360.0 655340.0 FORMAT "%8.1" /end CHARACTERISTIC
/begin CHARACTERISTIC I14229iocbi_uVlvLftRun_C "voltage corresponding to valve lift run" VALUE 0x8058AF82 Val_Ws16 1310700. Volt_Batt -655360.0 655340.0 FORMAT "%8.1" /end CHARACTERISTIC
/begin CHARACTERISTIC I14229iocbi_uVlvLftStl_C "voltage corresponding to valve lift stall" VALUE 0x8058AF84 Val_Ws16 1310700. Volt_Batt -655360.0 655340.0 FORMAT "%8.1" /end CHARACTERISTIC
/begin CHARACTERISTIC I14229iocbi_vAPP_C "Velocity corresponding to Accelerator pedal position sensor" VALUE 0x8058AF86 Val_Ws16 655.3500 Vel -327.6800 327.6700 FORMAT "%8.4" /end CHARACTERISTIC
/begin CHARACTERISTIC I14229iocbi_vRvsLck_C "Calibration value for checking vehicle speed for Reverse Lock." VALUE 0x8058AF88 Val_Ws16 655.3500 Vel -327.6800 327.6700 FORMAT "%8.4" /end CHARACTERISTIC
/begin CHARACTERISTIC I14229_AirCCmpr_stMsk_CA "air compressor status mask" VAL_BLK 0x804D86BE ValA_Wu16 65535.00 OneToOne 0.00 65535.00 FORMAT "%8.2" NUMBER 2 /end CHARACTERISTIC
/begin CHARACTERISTIC I14229_AltIO_stMskMDA_CA "alternator input output mask" VAL_BLK 0x804D86BA ValA_Wu16 65535.00 OneToOne 0.00 65535.00 FORMAT "%8.2" NUMBER 2 /end CHARACTERISTIC
/begin CHARACTERISTIC I14229_APP_stMskMDA_CA "mask for Accped postion sensor Mda" VAL_BLK 0x804D86B6 ValA_Wu16 65535.00 OneToOne 0.00 65535.00 FORMAT "%8.2" NUMBER 2 /end CHARACTERISTIC
/begin CHARACTERISTIC I14229_CP_stMskMDA_CA "Condition check Mask Canister Purge Valve MDA Test" VAL_BLK 0x804D86B2 ValA_Wu16 65535.00 OneToOne 0.00 65535.00 FORMAT "%8.2" NUMBER 2 /end CHARACTERISTIC
/begin CHARACTERISTIC I14229_CP_stMsk_CA "capacity status mask" VAL_BLK 0x804D86AE ValA_Wu16 65535.00 OneToOne 0.00 65535.00 FORMAT "%8.2" NUMBER 2 /end CHARACTERISTIC
/begin CHARACTERISTIC I14229_ctTxWaitRepDTC_C "Calibration for run time optimization for sub function 02 of RDTC service" VALUE 0x8058AFA0 RB_Val_Wu16 65535.00 OneToOne 0.00 65535.00 FORMAT "%8.2" /end CHARACTERISTIC
/begin CHARACTERISTIC I14229_ctTxWaitSuppDTC_C "Calibration for run time optimization for sub function 0A of RDTC service" VALUE 0x8058AFA2 RB_Val_Wu16 65535.00 OneToOne 0.00 65535.00 FORMAT "%8.2" /end CHARACTERISTIC
/begin CHARACTERISTIC I14229_ctWaitNumDTC_C "Calibration for run time optimization for sub function 01 of RDTC service" VALUE 0x8058AFA4 RB_Val_Wu16 65535.00 OneToOne 0.00 65535.00 FORMAT "%8.2" /end CHARACTERISTIC
/begin CHARACTERISTIC I14229_ctWaitRepDTC_C "Calibration for run time optimization for sub function 02 of RDTC service" VALUE 0x8058AFA6 RB_Val_Wu16 65535.00 OneToOne 0.00 65535.00 FORMAT "%8.2" /end CHARACTERISTIC
/begin CHARACTERISTIC I14229_ctWaitSuppDTC_C "Calibration for run time optimization for sub function 0A of RDTC service" VALUE 0x8058AFA8 RB_Val_Wu16 65535.00 OneToOne 0.00 65535.00 FORMAT "%8.2" /end CHARACTERISTIC
/begin CHARACTERISTIC I14229_dRMBAEna_C "RMBA service enable" VALUE 0x8053AE32 RB_Val_Wu8 255.0 OneToOne 0.00 255.0 FORMAT "%5.1" /end CHARACTERISTIC
/begin CHARACTERISTIC I14229_Duv_stMskMDA_CA "Condition check Mask for Air Bypass Solenoid Valve MDA Test" VAL_BLK 0x804D86AA ValA_Wu16 65535.00 OneToOne 0.00 65535.00 FORMAT "%8.2" NUMBER 2 /end CHARACTERISTIC
/begin CHARACTERISTIC I14229_Duv_stMsk_CA "Condition check Mask for Air Bypass Solenoid Valve SDA Test" VAL_BLK 0x804D86A6 ValA_Wu16 65535.00 OneToOne 0.00 65535.00 FORMAT "%8.2" NUMBER 2 /end CHARACTERISTIC
/begin CHARACTERISTIC I14229_EGRVlv_stMskMDA_CA "Application to Mask the condition check for EGR valve MDA" VAL_BLK 0x804D86A2 ValA_Wu16 65535.00 OneToOne 0.00 65535.00 FORMAT "%8.2" NUMBER 2 /end CHARACTERISTIC
/begin CHARACTERISTIC I14229_EGRVlv_stMsk_CA "Application to Mask the condition check for EGR valve SDA" VAL_BLK 0x804D869E ValA_Wu16 65535.00 OneToOne 0.00 65535.00 FORMAT "%8.2" NUMBER 2 /end CHARACTERISTIC
/begin CHARACTERISTIC I14229_EVAP_stMsk_CA "Application to Mask the condition check fro SDA EVAP control" VAL_BLK 0x804D869A ValA_Wu16 65535.00 OneToOne 0.00 65535.00 FORMAT "%8.2" NUMBER 2 /end CHARACTERISTIC
/begin CHARACTERISTIC I14229_FanDig_stMskMDA_CA "Digital fan status mask (MDA)" VAL_BLK 0x804D8696 ValA_Wu16 65535.00 OneToOne 0.00 65535.00 FORMAT "%8.2" NUMBER 2 /end CHARACTERISTIC
/begin CHARACTERISTIC I14229_FanDig_stMsk_CA "digital fan status mask calibration array." VAL_BLK 0x804D8692 ValA_Wu16 65535.00 OneToOne 0.00 65535.00 FORMAT "%8.2" NUMBER 2 /end CHARACTERISTIC
/begin CHARACTERISTIC I14229_FlPmp_stMsk_CA "Fuel pump status mask calibration array." VAL_BLK 0x804D868E ValA_Wu16 65535.00 OneToOne 0.00 65535.00 FORMAT "%8.2" NUMBER 2 /end CHARACTERISTIC
/begin CHARACTERISTIC I14229_iACCompCmprSol_C "Calibration value for checking the compressor volume control current" VALUE 0x8053AE22 RB_Val_Wu16 65535.00 i_q1_mA 0.00 65535.00 FORMAT "%8.2" /end CHARACTERISTIC
/begin CHARACTERISTIC I14229_ICEWP_stMskMDA_CA "Application to Mask the condition check for water charge air cooler EWP control SDA" VAL_BLK 0x804D868A ValA_Wu16 65535.00 OneToOne 0.00 65535.00 FORMAT "%8.2" NUMBER 2 /end CHARACTERISTIC
/begin CHARACTERISTIC I14229_ICEWP_stMsk_CA "Application to Mask the condition check for water charge air cooler EWP control MDA" VAL_BLK 0x804D8686 ValA_Wu16 65535.00 OneToOne 0.00 65535.00 FORMAT "%8.2" NUMBER 2 /end CHARACTERISTIC
/begin CHARACTERISTIC I14229_InjRateAmnt_stMsk_CA "Calibration value to mask the condition checking for Rate of Injection Amount SDA" VAL_BLK 0x804D8682 ValA_Wu16 65535.00 OneToOne 0.00 65535.00 FORMAT "%8.2" NUMBER 2 /end CHARACTERISTIC
/begin CHARACTERISTIC I14229_InjTst1_stMsk_CA "Calibration mask for Injector tester service" VAL_BLK 0x804D867E ValA_Wu16 65535.00 OneToOne 0.00 65535.00 FORMAT "%8.2" NUMBER 2 /end CHARACTERISTIC
/begin CHARACTERISTIC I14229_InjTst_stMsk_CA "Injector tester status mask calibration array." VAL_BLK 0x804D867A ValA_Wu16 65535.00 OneToOne 0.00 65535.00 FORMAT "%8.2" NUMBER 2 /end CHARACTERISTIC
/begin CHARACTERISTIC I14229_nACSafHysHi_C "Calibration of upper safety limit of AC hysterisis" VALUE 0x8053AE24 RB_Val_Ws16 32767.50 EngN -16384.00 16383.50 FORMAT "%8.2" /end CHARACTERISTIC
/begin CHARACTERISTIC I14229_nACSafHysLo_C "Calibration of lower safety limit of AC hysterisis" VALUE 0x8053AE26 RB_Val_Ws16 32767.50 EngN -16384.00 16383.50 FORMAT "%8.2" /end CHARACTERISTIC
/begin CHARACTERISTIC I14229_nEngHysHi_C "Calibration of upper lmit of engine speed hysterisis" VALUE 0x8053AE28 RB_Val_Ws16 32767.50 EngN -16384.00 16383.50 FORMAT "%8.2" /end CHARACTERISTIC
/begin CHARACTERISTIC I14229_nEngHysLo_C "Calibration of lower limit engine speed hysterisis" VALUE 0x8053AE2A RB_Val_Ws16 32767.50 EngN -16384.00 16383.50 FORMAT "%8.2" /end CHARACTERISTIC
/begin CHARACTERISTIC I14229_nHpFlInjCdnIdlHi_C "Calibration high hysteresis value for checking engine speed" VALUE 0x8058AFAC Val_Ws16 32767.50 EngN -16384.00 16383.50 FORMAT "%8.2" /end CHARACTERISTIC
/begin CHARACTERISTIC I14229_nHpFlInjCdnIdlLo_C "Calibration value for checking engine speed" VALUE 0x8058AFAE Val_Ws16 32767.50 EngN -16384.00 16383.50 FORMAT "%8.2" /end CHARACTERISTIC
/begin CHARACTERISTIC I14229_nrABSFailCnclMax_C "Max possible number of ABS fail safe action" VALUE 0x8053AE2C RB_Val_Wu8 255.0 OneToOne 0.00 255.0 FORMAT "%5.1" /end CHARACTERISTIC
/begin CHARACTERISTIC I14229_nrABSFailCnclSubs_C "Replacement value of possible number of ABS fail safe action cancel execution in case of EEPROM error" VALUE 0x8053AE2D RB_Val_Wu8 255.0 OneToOne 0.00 255.0 FORMAT "%5.1" /end CHARACTERISTIC
/begin CHARACTERISTIC I14229_OilCtlSt0_C "Control state value for DID 0x0122" VALUE 0x8058AF8A Val_Wu8 255.0 OneToOne 0.00 255.0 FORMAT "%5.1" /end CHARACTERISTIC
/begin CHARACTERISTIC I14229_OilCtlSt1_C "Control state value for DID 0x0122" VALUE 0x8058AF8B Val_Wu8 255.0 OneToOne 0.00 255.0 FORMAT "%5.1" /end CHARACTERISTIC
/begin CHARACTERISTIC I14229_OilPCtrl_stMskMDA_CA "Prelim check mask for DID 0x0122" VAL_BLK 0x804D8676 ValA_Wu16 65535.00 OneToOne 0.00 65535.00 FORMAT "%8.2" NUMBER 2 /end CHARACTERISTIC
/begin CHARACTERISTIC I14229_OilPCtrl_stMsk_CA "parameter to mask the permission checks for oil valve control SDA" VAL_BLK 0x804D8672 ValA_Wu16 65535.00 OneToOne 0.00 65535.00 FORMAT "%8.2" NUMBER 2 /end CHARACTERISTIC
/begin CHARACTERISTIC I14229_PHAACTRINTK_stMsk_CA "Condition check Mask for Intake Camshaft Phase SDA Test" VAL_BLK 0x804D866E ValA_Wu16 65535.00 OneToOne 0.00 65535.00 FORMAT "%8.2" NUMBER 2 /end CHARACTERISTIC
/begin CHARACTERISTIC I14229_PHAACTROUTL_stMsk_CA "Condition check Mask for Outlet Camshaft Phase SDA Test" VAL_BLK 0x804D866A ValA_Wu16 65535.00 OneToOne 0.00 65535.00 FORMAT "%8.2" NUMBER 2 /end CHARACTERISTIC
/begin CHARACTERISTIC I14229_rAppLETThd_C "Acceleration pedal sensor value for checking condition of APP test." VALUE 0x8053AE20 Val_Ws16 799.9878 Prc -400.0000 399.9878 FORMAT "%8.4" /end CHARACTERISTIC
/begin CHARACTERISTIC I14229_ratCoolg_C "Duty for AirVent" VALUE 0x80505A3C KwWU16 99.99847 rel_uw_b100 0.00 99.99847 FORMAT "%8.5" /end CHARACTERISTIC
/begin CHARACTERISTIC I14229_RvsLck_stMskMDA_CA "Condition check mask for Reverse Lock" VAL_BLK 0x804D8666 ValA_Wu16 65535.00 OneToOne 0.00 65535.00 FORMAT "%8.2" NUMBER 2 /end CHARACTERISTIC
/begin CHARACTERISTIC I14229_stACCompDeActvReqSubs_C "Alternating current comparision deactiavtion request substitute calibration" VALUE 0x8053AE2E RB_Val_Wu8 255.0 OneToOne 0.00 255.0 FORMAT "%5.1" /end CHARACTERISTIC
/begin CHARACTERISTIC I14229_stCACPmpRlyOFF_C "CAC pump relay off status" VALUE 0x8058AF8C Val_Wu8 255.0 OneToOne 0.00 255.0 FORMAT "%5.1" /end CHARACTERISTIC
/begin CHARACTERISTIC I14229_stCACPmpRlyON_C "CAC pump relay on status" VALUE 0x8058AF8D Val_Wu8 255.0 OneToOne 0.00 255.0 FORMAT "%5.1" /end CHARACTERISTIC
/begin CHARACTERISTIC I14229_stEVAPSwt_C "Enable or Disable calibration for RID0229" VALUE 0x8053AE2F RB_Val_Wboolean 255.0 OneToOne 0.00 255.0 FORMAT "%5.1" /end CHARACTERISTIC
/begin CHARACTERISTIC I14229_stIOCBIMskSuprtMDA_C "input output mask support (MDA)" VALUE 0x8058AF90 Val_Wu32 4294967295.00 OneToOne 0.00 4294967295.00 FORMAT "%13.2" /end CHARACTERISTIC
/begin CHARACTERISTIC I14229_stIOCBIMskSuprtSDA_C "Bit mask for SFT of individual devices" VALUE 0x8058AF94 Val_Wu32 4294967295.00 OneToOne 0.00 4294967295.00 FORMAT "%13.2" /end CHARACTERISTIC
/begin CHARACTERISTIC I14229_stOilFlowComplSubs_C "Calibration corresponding to Status of oil flow completion sustitute" VALUE 0x8053AE30 RB_Val_Wu8 255.0 OneToOne 0.00 255.0 FORMAT "%5.1" /end CHARACTERISTIC
/begin CHARACTERISTIC I14229_stRMBADFlashBlkEna_C "EEPROM block reading enable calibration" VALUE 0x8058AFBA RB_Val_Wu8 255.0 OneToOne 0.00 255.0 FORMAT "%5.1" /end CHARACTERISTIC
/begin CHARACTERISTIC I14229_stRMBADS0BlkEna_C "DS0 block reading enable calibration" VALUE 0x8053AE33 RB_Val_Wu8 255.0 OneToOne 0.00 255.0 FORMAT "%5.1" /end CHARACTERISTIC
/begin CHARACTERISTIC I14229_stRMBASecuEna_C "parameter to enable Security check condition" VALUE 0x8053AE34 RB_Val_Wu8 255.0 OneToOne 0.00 255.0 FORMAT "%5.1" /end CHARACTERISTIC
/begin CHARACTERISTIC I14229_swtDTCLowByte_C "Calibration corresponding to low byte information for DTC switch." VALUE 0x8058AFAA RB_Val_Wu8 255.0 OneToOne 0.00 255.0 FORMAT "%5.1" /end CHARACTERISTIC
/begin CHARACTERISTIC I14229_tHpFlInjCdnIdlHi_C "Calibration of upper value for checking coolant temperature" VALUE 0x8058AFB0 Val_Ws16 6553.500 Temp_Cels -3549.940 3003.560 FORMAT "%8.3" /end CHARACTERISTIC
/begin CHARACTERISTIC I14229_tHpFlInjCdnIdlLo_C "Calibration of lower value for checking coolant temperature" VALUE 0x8058AFB2 Val_Ws16 6553.500 Temp_Cels -3549.940 3003.560 FORMAT "%8.3" /end CHARACTERISTIC
/begin CHARACTERISTIC I14229_ThrVlv_stMsk_CA "Engine condition check Mask for Line End Tester and Service Tool. ( ThrVlv SFT)" VAL_BLK 0x804D8662 ValA_Wu16 65535.00 OneToOne 0.00 65535.00 FORMAT "%8.2" NUMBER 2 /end CHARACTERISTIC
/begin CHARACTERISTIC I14229_tiOilFlowComplSubs_C "Calibration corresponding to oil flow completion sustitute time" VALUE 0x8053AE31 RB_Val_Wu8 255.0 Time_sec_q1_COMPU 0.00 255.0 FORMAT "%5.1" /end CHARACTERISTIC
/begin CHARACTERISTIC I14229_tiThrVlvMax_C "Maximum duration of throttle valve SFT" VALUE 0x8058AF98 Val_Ws16 655.3500 Time_s -327.6800 327.6700 FORMAT "%8.4" /end CHARACTERISTIC
/begin CHARACTERISTIC I14229_TrbCh_stMsk_CA "Engine condition check Mask for Line End Tester and Service Tool. ( TrbCh SFT)" VAL_BLK 0x804D865E ValA_Wu16 65535.00 OneToOne 0.00 65535.00 FORMAT "%8.2" NUMBER 2 /end CHARACTERISTIC
/begin CHARACTERISTIC I14229_uHpFlInjCdnIdl_C "Calibration of lower value for checking battery voltage" VALUE 0x8058AFB4 Val_Ws16 1310700. Volt_Batt -655360.0 655340.0 FORMAT "%8.1" /end CHARACTERISTIC
/begin CHARACTERISTIC I14229_VentShtVlv_stMsk_CA "Offline calibration array for Vent Shut Valve" VAL_BLK 0x804D865A ValA_Wu16 65535.00 OneToOne 0.00 65535.00 FORMAT "%8.2" NUMBER 2 /end CHARACTERISTIC
/begin CHARACTERISTIC I14229_vHpFlInjCdnIdl_C "Calibration of lower value for checking vehicle speed" VALUE 0x8058AFB6 Val_Ws16 655.3500 Vel -327.6800 327.6700 FORMAT "%8.4" /end CHARACTERISTIC
/begin CHARACTERISTIC I14229_VlvLft_stMskMDA_CA "valve lift status mask (MDA)" VAL_BLK 0x804D8656 ValA_Wu16 65535.00 OneToOne 0.00 65535.00 FORMAT "%8.2" NUMBER 2 /end CHARACTERISTIC
/begin CHARACTERISTIC I14229_VlvLft_stMsk_CA "valve lift status mask" VAL_BLK 0x804D8652 ValA_Wu16 65535.00 OneToOne 0.00 65535.00 FORMAT "%8.2" NUMBER 2 /end CHARACTERISTIC
/begin CHARACTERISTIC I14229_vRCCrCtl_C "Vehicle speed check limit" VALUE 0x8058AFB8 Val_Ws16 655.3500 Vel -327.6800 327.6700 FORMAT "%8.4" /end CHARACTERISTIC
/begin CHARACTERISTIC I14229_wACT_C "Caibration limit to decide throttle valve is open or close" VALUE 0x8058AF9A Val_Wu16 100.0000 relPED_q0p00153 0.00 100.0000 FORMAT "%8.4" /end CHARACTERISTIC
/begin CHARACTERISTIC I14229_wFlPmp_C "Caibration corresponding to fuel pump signal" VALUE 0x8058AF9C Val_Wu16 100.0000 relPED_q0p00153 0.00 100.0000 FORMAT "%8.4" /end CHARACTERISTIC
/begin CHARACTERISTIC I14229_wRvsLck_C "Calibration value for checking Accel pedal position" VALUE 0x8058AF9E Val_Wu16 100.0000 relPED_q0p00153 0.00 100.0000 FORMAT "%8.4" /end CHARACTERISTIC
/begin CHARACTERISTIC TDDHFCMP "Delay time to get compare value of rail pressure" VALUE 0x8053A7C8 RB_Val_Wu16 6553.500 t_q0p1 0.00 6553.500 FORMAT "%8.3" /end CHARACTERISTIC
/begin CHARACTERISTIC TDDHFCMPNL "Delay time to get compare value of rail pressure during postdrive" VALUE 0x8053A7CA RB_Val_Wu16 6553.500 t_q0p1 0.00 6553.500 FORMAT "%8.3" /end CHARACTERISTIC
/begin CHARACTERISTIC TDDHFMXSTP "Time within diagnosis is valid" VALUE 0x8053A7CC RB_Val_Wu16 65535.00 t_q1 0.00 65535.00 FORMAT "%8.2" /end CHARACTERISTIC
/begin CHARACTERISTIC TDHFBNMN "Debounce no rotation" VALUE 0x8053A7CE RB_Val_Wu16 6553.500 t_q0p1 0.00 6553.500 FORMAT "%8.3" /end CHARACTERISTIC
/begin CHARACTERISTIC TDHFNLBNMN "time to wait till engine cooling is completed" VALUE 0x8053A7D0 RB_Val_Wu16 6553.500 t_q0p1 0.00 6553.500 FORMAT "%8.3" /end CHARACTERISTIC
/begin CHARACTERISTIC TMOTDHFENA "temperature threshold to enable pressure hold diagnosis" VALUE 0x8053A7D2 RB_Val_Wu8 191.3 temp_ub_q0p75_o48 -48.0 143.3 FORMAT "%5.1" /end CHARACTERISTIC
/begin CHARACTERISTIC TOLDIFFTKL "Factor to consider engine hot soak for allowed pressure drop" CURVE 0x8053A7D3 RB_Curve_U8_U8 15.94 fak_ub_b16 0.00 15.94 FORMAT "%5.2"
 /begin AXIS_DESCR STD_AXIS tdiffengfl temp_ub_q0p75_o48 5 -48.0 143.3 FORMAT "%5.1" DEPOSIT ABSOLUTE /end AXIS_DESCR
/end CHARACTERISTIC
/begin CHARACTERISTIC TOLRTDHFKL "characteristic curve influence of fuel temperature for allowed pressure drop" CURVE 0x8053A7DE RB_Curve_U8_U8 15.94 fak_ub_b16 0.00 15.94 FORMAT "%5.2"
 /begin AXIS_DESCR STD_AXIS HiPSys_tFuHiPDDHFHD temp_ub_q0p75_o48 5 -48.0 143.3 FORMAT "%5.1" DEPOSIT ABSOLUTE /end AXIS_DESCR
/end CHARACTERISTIC
/begin MEASUREMENT B_ddhfhdtst_loc "Condition pressure drop diagnosis has been checked once" UBYTE B_TRUE 1 100 0.00 1.00000000000 BIT_MASK 0x1 FORMAT "%13.11" ECU_ADDRESS 0x60000118 /end MEASUREMENT
/begin MEASUREMENT B_dhfena "Condition enable pressure hold func." UBYTE B_TRUE 1 100 0.00 1.00000000000 BIT_MASK 0x1 FORMAT "%13.11" ECU_ADDRESS 0x60000117 /end MEASUREMENT
/begin MEASUREMENT B_dhfenast "condition for check min. pressure" UBYTE B_TRUE 1 100 0.00 1.00000000000 BIT_MASK 0x1 FORMAT "%13.11" ECU_ADDRESS 0x60000116 /end MEASUREMENT
/begin MEASUREMENT B_dhferhea "Condition for error or healing" UBYTE B_TRUE 1 100 0.00 1.00000000000 BIT_MASK 0x1 FORMAT "%13.11" ECU_ADDRESS 0x60000115 /end MEASUREMENT
/begin MEASUREMENT B_healafterun_loc "Condition pressure drop diagnosis has been checked once in afterun" UBYTE B_TRUE 1 100 0.00 1.00000000000 BIT_MASK 0x1 FORMAT "%13.11" ECU_ADDRESS 0x60000114 /end MEASUREMENT
/begin MEASUREMENT B_strtstopena "Condition pressure drop diagnosis is acitvated for startstop cycle" UBYTE B_TRUE 1 100 0.00 1.00000000000 BIT_MASK 0x1 FORMAT "%13.11" ECU_ADDRESS 0x60000113 /end MEASUREMENT
/begin MEASUREMENT Com_lEGRCtlStMDA "EGR lift value from Tester request" SWORD Length_0_01mm 1 100 -327.6800 327.6700 FORMAT "%8.4" ECU_ADDRESS 0x600095BC /end MEASUREMENT
/begin MEASUREMENT Com_rEGRIntValMDA "ATS intervention value for ATS actuator" SWORD Prc 1 100 -400.0000 399.9878 FORMAT "%8.4" ECU_ADDRESS 0x600095BA /end MEASUREMENT
/begin MEASUREMENT DcmAppl_flgAuthentPassd "check Status of Authentication service" UBYTE B_TRUE 1 100 0.00 1.00000000000 FORMAT "%13.11" ECU_ADDRESS 0x6000E828 /end MEASUREMENT
/begin MEASUREMENT DcmDspUds_flgAuthentRejctd "Authentication rejected state" UBYTE B_TRUE 1 100 0.00 1.00000000000 BIT_MASK 0x1 FORMAT "%13.11" ECU_ADDRESS 0x6000E827 /end MEASUREMENT
/begin MEASUREMENT DcmDspUds_flgSessionKeyRegstSt "Determination of session key registration status" UBYTE B_TRUE 1 100 0.00 1.00000000000 BIT_MASK 0x1 FORMAT "%13.11" ECU_ADDRESS 0x6000E826 /end MEASUREMENT
/begin MEASUREMENT ddhfhd_debRepCheck "dfc check in drop diagnosis" ULONG OneToOne 1 100 0.00 4294967295.00 FORMAT "%13.2" ECU_ADDRESS 0x6000106C /end MEASUREMENT
/begin MEASUREMENT DDRC_St.DFC_AAVEmax "Debouncing counters / Debounce Timer or Event counter for check DFC_AAVEmax" ULONG DFC_OneToOne 1 100 0.00 536870911.000 BIT_MASK 0x1fffffff FORMAT "%13.3" ECU_ADDRESS 0x60012A64 /end MEASUREMENT
/begin MEASUREMENT DDRC_St.DFC_AAVEmin "Debouncing counters / Debounce Timer or Event counter for check DFC_AAVEmin" ULONG DFC_OneToOne 1 100 0.00 536870911.000 BIT_MASK 0x1fffffff FORMAT "%13.3" ECU_ADDRESS 0x60012A68 /end MEASUREMENT
/begin MEASUREMENT DDRC_St.DFC_AAVEsig "Debouncing counters / Debounce Timer or Event counter for check DFC_AAVEsig" ULONG DFC_OneToOne 1 100 0.00 536870911.000 BIT_MASK 0x1fffffff FORMAT "%13.3" ECU_ADDRESS 0x60012A6C /end MEASUREMENT
/begin MEASUREMENT DDRC_St.DFC_AltIOACGFailr "Debouncing counters / Debounce Timer or Event counter for check DFC_AltIOACGFailr" ULONG DFC_OneToOne 1 100 0.00 536870911.000 BIT_MASK 0x1fffffff FORMAT "%13.3" ECU_ADDRESS 0x60012A70 /end MEASUREMENT
/begin MEASUREMENT DDRC_St.DFC_AltIOACGHiVltg "Debouncing counters / Debounce Timer or Event counter for check DFC_AltIOACGHiVltg" ULONG DFC_OneToOne 1 100 0.00 536870911.000 BIT_MASK 0x1fffffff FORMAT "%13.3" ECU_ADDRESS 0x60012A74 /end MEASUREMENT
/begin MEASUREMENT DDRC_St.DFC_AltIOACGLoVltg "Debouncing counters / Debounce Timer or Event counter for check DFC_AltIOACGLoVltg" ULONG DFC_OneToOne 1 100 0.00 536870911.000 BIT_MASK 0x1fffffff FORMAT "%13.3" ECU_ADDRESS 0x60012A78 /end MEASUREMENT
/begin MEASUREMENT DDRC_St.DFC_AltIOACGTHi "Debouncing counters / Debounce Timer or Event counter for check DFC_AltIOACGTHi" ULONG DFC_OneToOne 1 100 0.00 536870911.000 BIT_MASK 0x1fffffff FORMAT "%13.3" ECU_ADDRESS 0x60012A7C /end MEASUREMENT
/begin MEASUREMENT DDRC_St.DFC_AltIODConnACG "Debouncing counters / Debounce Timer or Event counter for check DFC_AltIODConnACG" ULONG DFC_OneToOne 1 100 0.00 536870911.000 BIT_MASK 0x1fffffff FORMAT "%13.3" ECU_ADDRESS 0x60012A80 /end MEASUREMENT
/begin MEASUREMENT DDRC_St.DFC_BGOELWAF "Debouncing counters / Debounce Timer or Event counter for check DFC_BGOELWAF" ULONG DFC_OneToOne 1 100 0.00 536870911.000 BIT_MASK 0x1fffffff FORMAT "%13.3" ECU_ADDRESS 0x60012A84 /end MEASUREMENT
/begin MEASUREMENT DDRC_St.DFC_BattUHiFailr "Debouncing counters / Debounce Timer or Event counter for check DFC_BattUHiFailr" ULONG DFC_OneToOne 1 100 0.00 536870911.000 BIT_MASK 0x1fffffff FORMAT "%13.3" ECU_ADDRESS 0x60012A88 /end MEASUREMENT
/begin MEASUREMENT DDRC_St.DFC_BattULoFailr "Debouncing counters / Debounce Timer or Event counter for check DFC_BattULoFailr" ULONG DFC_OneToOne 1 100 0.00 536870911.000 BIT_MASK 0x1fffffff FORMAT "%13.3" ECU_ADDRESS 0x60012A8C /end MEASUREMENT
/begin MEASUREMENT DDRC_St.DFC_BrkBstPDriftHiErr "Debouncing counters / Debounce Timer or Event counter for check DFC_BrkBstPDriftHiErr" ULONG DFC_OneToOne 1 100 0.00 536870911.000 BIT_MASK 0x1fffffff FORMAT "%13.3" ECU_ADDRESS 0x60012A90 /end MEASUREMENT
/begin MEASUREMENT DDRC_St.DFC_BrkBstPDriftLoErr "Debouncing counters / Debounce Timer or Event counter for check DFC_BrkBstPDriftLoErr" ULONG DFC_OneToOne 1 100 0.00 536870911.000 BIT_MASK 0x1fffffff FORMAT "%13.3" ECU_ADDRESS 0x60012A94 /end MEASUREMENT
/begin MEASUREMENT DDRC_St.DFC_BrkBstPSnsrStuck "Debouncing counters / Debounce Timer or Event counter for check DFC_BrkBstPSnsrStuck" ULONG DFC_OneToOne 1 100 0.00 536870911.000 BIT_MASK 0x1fffffff FORMAT "%13.3" ECU_ADDRESS 0x60012A98 /end MEASUREMENT
/begin MEASUREMENT DDRC_St.DFC_BrkMnSwtContOn "Debouncing counters / Debounce Timer or Event counter for check DFC_BrkMnSwtContOn" ULONG DFC_OneToOne 1 100 0.00 536870911.000 BIT_MASK 0x1fffffff FORMAT "%13.3" ECU_ADDRESS 0x60012A9C /end MEASUREMENT
/begin MEASUREMENT DDRC_St.DFC_BrkMnSwtNotStp "Debouncing counters / Debounce Timer or Event counter for check DFC_BrkMnSwtNotStp" ULONG DFC_OneToOne 1 100 0.00 536870911.000 BIT_MASK 0x1fffffff FORMAT "%13.3" ECU_ADDRESS 0x60012AA0 /end MEASUREMENT
/begin MEASUREMENT DDRC_St.DFC_BrkNpl "Debouncing counters / Debounce Timer or Event counter for check DFC_BrkNpl" ULONG DFC_OneToOne 1 100 0.00 536870911.000 BIT_MASK 0x1fffffff FORMAT "%13.3" ECU_ADDRESS 0x60012AA4 /end MEASUREMENT
/begin MEASUREMENT DDRC_St.DFC_BrkRdntSwtContOn "Debouncing counters / Debounce Timer or Event counter for check DFC_BrkRdntSwtContOn" ULONG DFC_OneToOne 1 100 0.00 536870911.000 BIT_MASK 0x1fffffff FORMAT "%13.3" ECU_ADDRESS 0x60012AA8 /end MEASUREMENT
/begin MEASUREMENT DDRC_St.DFC_BrkRdntSwtNotStp "Debouncing counters / Debounce Timer or Event counter for check DFC_BrkRdntSwtNotStp" ULONG DFC_OneToOne 1 100 0.00 536870911.000 BIT_MASK 0x1fffffff FORMAT "%13.3" ECU_ADDRESS 0x60012AAC /end MEASUREMENT
/begin MEASUREMENT DDRC_St.DFC_Clth3ONStuck "Debouncing counters / Debounce Timer or Event counter for check DFC_Clth3ONStuck" ULONG DFC_OneToOne 1 100 0.00 536870911.000 BIT_MASK 0x1fffffff FORMAT "%13.3" ECU_ADDRESS 0x60012AB0 /end MEASUREMENT
/begin MEASUREMENT DDRC_St.DFC_Clth4OFFStuck "Debouncing counters / Debounce Timer or Event counter for check DFC_Clth4OFFStuck" ULONG DFC_OneToOne 1 100 0.00 536870911.000 BIT_MASK 0x1fffffff FORMAT "%13.3" ECU_ADDRESS 0x60012AB4 /end MEASUREMENT
/begin MEASUREMENT DDRC_St.DFC_ClthOFFStuck "Debouncing counters / Debounce Timer or Event counter for check DFC_ClthOFFStuck" ULONG DFC_OneToOne 1 100 0.00 536870911.000 BIT_MASK 0x1fffffff FORMAT "%13.3" ECU_ADDRESS 0x60012AB8 /end MEASUREMENT
/begin MEASUREMENT DDRC_St.DFC_ClthONStuck "Debouncing counters / Debounce Timer or Event counter for check DFC_ClthONStuck" ULONG DFC_OneToOne 1 100 0.00 536870911.000 BIT_MASK 0x1fffffff FORMAT "%13.3" ECU_ADDRESS 0x60012ABC /end MEASUREMENT
/begin MEASUREMENT DDRC_St.DFC_ClthStkFailInfo "Debouncing counters / Debounce Timer or Event counter for check DFC_ClthStkFailInfo" ULONG DFC_OneToOne 1 100 0.00 536870911.000 BIT_MASK 0x1fffffff FORMAT "%13.3" ECU_ADDRESS 0x60012AC0 /end MEASUREMENT
/begin MEASUREMENT DDRC_St.DFC_ComACFailInfo "Debouncing counters / Debounce Timer or Event counter for check DFC_ComACFailInfo" ULONG DFC_OneToOne 1 100 0.00 536870911.000 BIT_MASK 0x1fffffff FORMAT "%13.3" ECU_ADDRESS 0x60012AC4 /end MEASUREMENT
/begin MEASUREMENT DDRC_St.DFC_ComATFTValErr "Debouncing counters / Debounce Timer or Event counter for check DFC_ComATFTValErr" ULONG DFC_OneToOne 1 100 0.00 536870911.000 BIT_MASK 0x1fffffff FORMAT "%13.3" ECU_ADDRESS 0x60012AC8 /end MEASUREMENT
/begin MEASUREMENT DDRC_St.DFC_ComATMILReq "Debouncing counters / Debounce Timer or Event counter for check DFC_ComATMILReq" ULONG DFC_OneToOne 1 100 0.00 536870911.000 BIT_MASK 0x1fffffff FORMAT "%13.3" ECU_ADDRESS 0x60012ACC /end MEASUREMENT
/begin MEASUREMENT DDRC_St.DFC_ComAYCAChksum "Debouncing counters / Debounce Timer or Event counter for check DFC_ComAYCAChksum" ULONG DFC_OneToOne 1 100 0.00 536870911.000 BIT_MASK 0x1fffffff FORMAT "%13.3" ECU_ADDRESS 0x60012AD0 /end MEASUREMENT
/begin MEASUREMENT DDRC_St.DFC_ComAYCARingCnt "Debouncing counters / Debounce Timer or Event counter for check DFC_ComAYCARingCnt" ULONG DFC_OneToOne 1 100 0.00 536870911.000 BIT_MASK 0x1fffffff FORMAT "%13.3" ECU_ADDRESS 0x60012AD4 /end MEASUREMENT
/begin MEASUREMENT DDRC_St.DFC_ComAYCATOut "Debouncing counters / Debounce Timer or Event counter for check DFC_ComAYCATOut" ULONG DFC_OneToOne 1 100 0.00 536870911.000 BIT_MASK 0x1fffffff FORMAT "%13.3" ECU_ADDRESS 0x60012AD8 /end MEASUREMENT
/begin MEASUREMENT DDRC_St.DFC_ComAYCDChkSum "Debouncing counters / Debounce Timer or Event counter for check DFC_ComAYCDChkSum" ULONG DFC_OneToOne 1 100 0.00 536870911.000 BIT_MASK 0x1fffffff FORMAT "%13.3" ECU_ADDRESS 0x60012ADC /end MEASUREMENT
/begin MEASUREMENT DDRC_St.DFC_ComAYCDTOut "Debouncing counters / Debounce Timer or Event counter for check DFC_ComAYCDTOut" ULONG DFC_OneToOne 1 100 0.00 536870911.000 BIT_MASK 0x1fffffff FORMAT "%13.3" ECU_ADDRESS 0x60012AE0 /end MEASUREMENT
/begin MEASUREMENT DDRC_St.DFC_ComAYCFChksum "Debouncing counters / Debounce Timer or Event counter for check DFC_ComAYCFChksum" ULONG DFC_OneToOne 1 100 0.00 536870911.000 BIT_MASK 0x1fffffff FORMAT "%13.3" ECU_ADDRESS 0x60012AE4 /end MEASUREMENT
/begin MEASUREMENT DDRC_St.DFC_ComAYCFRingCnt "Debouncing counters / Debounce Timer or Event counter for check DFC_ComAYCFRingCnt" ULONG DFC_OneToOne 1 100 0.00 536870911.000 BIT_MASK 0x1fffffff FORMAT "%13.3" ECU_ADDRESS 0x60012AE8 /end MEASUREMENT
/begin MEASUREMENT DDRC_St.DFC_ComAYCFTOut "Debouncing counters / Debounce Timer or Event counter for check DFC_ComAYCFTOut" ULONG DFC_OneToOne 1 100 0.00 536870911.000 BIT_MASK 0x1fffffff FORMAT "%13.3" ECU_ADDRESS 0x60012AEC /end MEASUREMENT
/begin MEASUREMENT DDRC_St.DFC_ComAYCGChksum "Debouncing counters / Debounce Timer or Event counter for check DFC_ComAYCGChksum" ULONG DFC_OneToOne 1 100 0.00 536870911.000 BIT_MASK 0x1fffffff FORMAT "%13.3" ECU_ADDRESS 0x60012AF0 /end MEASUREMENT
/begin MEASUREMENT DDRC_St.DFC_ComAYCGRingCnt "Debouncing counters / Debounce Timer or Event counter for check DFC_ComAYCGRingCnt" ULONG DFC_OneToOne 1 100 0.00 536870911.000 BIT_MASK 0x1fffffff FORMAT "%13.3" ECU_ADDRESS 0x60012AF4 /end MEASUREMENT
/begin MEASUREMENT DDRC_St.DFC_ComAYCGTOut "Debouncing counters / Debounce Timer or Event counter for check DFC_ComAYCGTOut" ULONG DFC_OneToOne 1 100 0.00 536870911.000 BIT_MASK 0x1fffffff FORMAT "%13.3" ECU_ADDRESS 0x60012AF8 /end MEASUREMENT
/begin MEASUREMENT DDRC_St.DFC_ComAYCIChkSum "Debouncing counters / Debounce Timer or Event counter for check DFC_ComAYCIChkSum" ULONG DFC_OneToOne 1 100 0.00 536870911.000 BIT_MASK 0x1fffffff FORMAT "%13.3" ECU_ADDRESS 0x60012AFC /end MEASUREMENT
/begin MEASUREMENT DDRC_St.DFC_ComAYCIRingCnt "Debouncing counters / Debounce Timer or Event counter for check DFC_ComAYCIRingCnt" ULONG DFC_OneToOne 1 100 0.00 536870911.000 BIT_MASK 0x1fffffff FORMAT "%13.3" ECU_ADDRESS 0x60012B00 /end MEASUREMENT
/begin MEASUREMENT DDRC_St.DFC_ComAYCITOut "Debouncing counters / Debounce Timer or Event counter for check DFC_ComAYCITOut" ULONG DFC_OneToOne 1 100 0.00 536870911.000 BIT_MASK 0x1fffffff FORMAT "%13.3" ECU_ADDRESS 0x60012B04 /end MEASUREMENT
/begin MEASUREMENT DDRC_St.DFC_ComBCM1ChkSum "Debouncing counters / Debounce Timer or Event counter for check DFC_ComBCM1ChkSum" ULONG DFC_OneToOne 1 100 0.00 536870911.000 BIT_MASK 0x1fffffff FORMAT "%13.3" ECU_ADDRESS 0x60012B08 /end MEASUREMENT
/begin MEASUREMENT DDRC_St.DFC_ComBCM1RingCnt "Debouncing counters / Debounce Timer or Event counter for check DFC_ComBCM1RingCnt" ULONG DFC_OneToOne 1 100 0.00 536870911.000 BIT_MASK 0x1fffffff FORMAT "%13.3" ECU_ADDRESS 0x60012B0C /end MEASUREMENT
/begin MEASUREMENT DDRC_St.DFC_ComBCM1TOut "Debouncing counters / Debounce Timer or Event counter for check DFC_ComBCM1TOut" ULONG DFC_OneToOne 1 100 0.00 536870911.000 BIT_MASK 0x1fffffff FORMAT "%13.3" ECU_ADDRESS 0x60012B10 /end MEASUREMENT
/begin MEASUREMENT DDRC_St.DFC_ComCANABusOffErr "Debouncing counters / Debounce Timer or Event counter for check DFC_ComCANABusOffErr" ULONG DFC_OneToOne 1 100 0.00 536870911.000 BIT_MASK 0x1fffffff FORMAT "%13.3" ECU_ADDRESS 0x60012B14 /end MEASUREMENT
/begin MEASUREMENT DDRC_St.DFC_ComCANBBusOffErr "Debouncing counters / Debounce Timer or Event counter for check DFC_ComCANBBusOffErr" ULONG DFC_OneToOne 1 100 0.00 536870911.000 BIT_MASK 0x1fffffff FORMAT "%13.3" ECU_ADDRESS 0x60012B18 /end MEASUREMENT
/begin MEASUREMENT DDRC_St.DFC_ComCANCBusOffErr "Debouncing counters / Debounce Timer or Event counter for check DFC_ComCANCBusOffErr" ULONG DFC_OneToOne 1 100 0.00 536870911.000 BIT_MASK 0x1fffffff FORMAT "%13.3" ECU_ADDRESS 0x60012B1C /end MEASUREMENT
/begin MEASUREMENT DDRC_St.DFC_ComCGW1ChkSum "Debouncing counters / Debounce Timer or Event counter for check DFC_ComCGW1ChkSum" ULONG DFC_OneToOne 1 100 0.00 536870911.000 BIT_MASK 0x1fffffff FORMAT "%13.3" ECU_ADDRESS 0x60012B20 /end MEASUREMENT
/begin MEASUREMENT DDRC_St.DFC_ComCGW1RingCnt "Debouncing counters / Debounce Timer or Event counter for check DFC_ComCGW1RingCnt" ULONG DFC_OneToOne 1 100 0.00 536870911.000 BIT_MASK 0x1fffffff FORMAT "%13.3" ECU_ADDRESS 0x60012B24 /end MEASUREMENT
/begin MEASUREMENT DDRC_St.DFC_ComCGW1TOut "Debouncing counters / Debounce Timer or Event counter for check DFC_ComCGW1TOut" ULONG DFC_OneToOne 1 100 0.00 536870911.000 BIT_MASK 0x1fffffff FORMAT "%13.3" ECU_ADDRESS 0x60012B28 /end MEASUREMENT
/begin MEASUREMENT DDRC_St.DFC_ComConvBoostErr "Debouncing counters / Debounce Timer or Event counter for check DFC_ComConvBoostErr" ULONG DFC_OneToOne 1 100 0.00 536870911.000 BIT_MASK 0x1fffffff FORMAT "%13.3" ECU_ADDRESS 0x60012B2C /end MEASUREMENT
/begin MEASUREMENT DDRC_St.DFC_ComConvSlipErr "Debouncing counters / Debounce Timer or Event counter for check DFC_ComConvSlipErr" ULONG DFC_OneToOne 1 100 0.00 536870911.000 BIT_MASK 0x1fffffff FORMAT "%13.3" ECU_ADDRESS 0x60012B30 /end MEASUREMENT
/begin MEASUREMENT DDRC_St.DFC_ComDCDCPrfmncErr "Debouncing counters / Debounce Timer or Event counter for check DFC_ComDCDCPrfmncErr" ULONG DFC_OneToOne 1 100 0.00 536870911.000 BIT_MASK 0x1fffffff FORMAT "%13.3" ECU_ADDRESS 0x60012B34 /end MEASUREMENT
/begin MEASUREMENT DDRC_St.DFC_ComDCDCTempWarn "Debouncing counters / Debounce Timer or Event counter for check DFC_ComDCDCTempWarn" ULONG DFC_OneToOne 1 100 0.00 536870911.000 BIT_MASK 0x1fffffff FORMAT "%13.3" ECU_ADDRESS 0x60012B38 /end MEASUREMENT
/begin MEASUREMENT DDRC_St.DFC_ComEAT10Chksum "Debouncing counters / Debounce Timer or Event counter for check DFC_ComEAT10Chksum" ULONG DFC_OneToOne 1 100 0.00 536870911.000 BIT_MASK 0x1fffffff FORMAT "%13.3" ECU_ADDRESS 0x60012B3C /end MEASUREMENT
/begin MEASUREMENT DDRC_St.DFC_ComEAT10RingCnt "Debouncing counters / Debounce Timer or Event counter for check DFC_ComEAT10RingCnt" ULONG DFC_OneToOne 1 100 0.00 536870911.000 BIT_MASK 0x1fffffff FORMAT "%13.3" ECU_ADDRESS 0x60012B40 /end MEASUREMENT
/begin MEASUREMENT DDRC_St.DFC_ComEAT10TOut "Debouncing counters / Debounce Timer or Event counter for check DFC_ComEAT10TOut" ULONG DFC_OneToOne 1 100 0.00 536870911.000 BIT_MASK 0x1fffffff FORMAT "%13.3" ECU_ADDRESS 0x60012B44 /end MEASUREMENT
/begin MEASUREMENT DDRC_St.DFC_ComEAT11ChkSum "Debouncing counters / Debounce Timer or Event counter for check DFC_ComEAT11ChkSum" ULONG DFC_OneToOne 1 100 0.00 536870911.000 BIT_MASK 0x1fffffff FORMAT "%13.3" ECU_ADDRESS 0x60012B48 /end MEASUREMENT
/begin MEASUREMENT DDRC_St.DFC_ComEAT11RingCnt "Debouncing counters / Debounce Timer or Event counter for check DFC_ComEAT11RingCnt" ULONG DFC_OneToOne 1 100 0.00 536870911.000 BIT_MASK 0x1fffffff FORMAT "%13.3" ECU_ADDRESS 0x60012B4C /end MEASUREMENT
/begin MEASUREMENT DDRC_St.DFC_ComEAT11TOut "Debouncing counters / Debounce Timer or Event counter for check DFC_ComEAT11TOut" ULONG DFC_OneToOne 1 100 0.00 536870911.000 BIT_MASK 0x1fffffff FORMAT "%13.3" ECU_ADDRESS 0x60012B50 /end MEASUREMENT
/begin MEASUREMENT DDRC_St.DFC_ComEAT12ChkSum "Debouncing counters / Debounce Timer or Event counter for check DFC_ComEAT12ChkSum" ULONG DFC_OneToOne 1 100 0.00 536870911.000 BIT_MASK 0x1fffffff FORMAT "%13.3" ECU_ADDRESS 0x60012B54 /end MEASUREMENT
/begin MEASUREMENT DDRC_St.DFC_ComEAT12RingCnt "Debouncing counters / Debounce Timer or Event counter for check DFC_ComEAT12RingCnt" ULONG DFC_OneToOne 1 100 0.00 536870911.000 BIT_MASK 0x1fffffff FORMAT "%13.3" ECU_ADDRESS 0x60012B58 /end MEASUREMENT
/begin MEASUREMENT DDRC_St.DFC_ComEAT12TOut "Debouncing counters / Debounce Timer or Event counter for check DFC_ComEAT12TOut" ULONG DFC_OneToOne 1 100 0.00 536870911.000 BIT_MASK 0x1fffffff FORMAT "%13.3" ECU_ADDRESS 0x60012B5C /end MEASUREMENT
/begin MEASUREMENT DDRC_St.DFC_ComEAT13ChkSum "Debouncing counters / Debounce Timer or Event counter for check DFC_ComEAT13ChkSum" ULONG DFC_OneToOne 1 100 0.00 536870911.000 BIT_MASK 0x1fffffff FORMAT "%13.3" ECU_ADDRESS 0x60012B60 /end MEASUREMENT
/begin MEASUREMENT DDRC_St.DFC_ComEAT13RingCnt "Debouncing counters / Debounce Timer or Event counter for check DFC_ComEAT13RingCnt" ULONG DFC_OneToOne 1 100 0.00 536870911.000 BIT_MASK 0x1fffffff FORMAT "%13.3" ECU_ADDRESS 0x60012B64 /end MEASUREMENT
/begin MEASUREMENT DDRC_St.DFC_ComEAT13TOut "Debouncing counters / Debounce Timer or Event counter for check DFC_ComEAT13TOut" ULONG DFC_OneToOne 1 100 0.00 536870911.000 BIT_MASK 0x1fffffff FORMAT "%13.3" ECU_ADDRESS 0x60012B68 /end MEASUREMENT
/begin MEASUREMENT DDRC_St.DFC_ComEAT1Chksum "Debouncing counters / Debounce Timer or Event counter for check DFC_ComEAT1Chksum" ULONG DFC_OneToOne 1 100 0.00 536870911.000 BIT_MASK 0x1fffffff FORMAT "%13.3" ECU_ADDRESS 0x60012B6C /end MEASUREMENT
/begin MEASUREMENT DDRC_St.DFC_ComEAT1RingCnt "Debouncing counters / Debounce Timer or Event counter for check DFC_ComEAT1RingCnt" ULONG DFC_OneToOne 1 100 0.00 536870911.000 BIT_MASK 0x1fffffff FORMAT "%13.3" ECU_ADDRESS 0x60012B70 /end MEASUREMENT
/begin MEASUREMENT DDRC_St.DFC_ComEAT1TOut "Debouncing counters / Debounce Timer or Event counter for check DFC_ComEAT1TOut" ULONG DFC_OneToOne 1 100 0.00 536870911.000 BIT_MASK 0x1fffffff FORMAT "%13.3" ECU_ADDRESS 0x60012B74 /end MEASUREMENT
/begin MEASUREMENT DDRC_St.DFC_ComEAT2ChkSum "Debouncing counters / Debounce Timer or Event counter for check DFC_ComEAT2ChkSum" ULONG DFC_OneToOne 1 100 0.00 536870911.000 BIT_MASK 0x1fffffff FORMAT "%13.3" ECU_ADDRESS 0x60012B78 /end MEASUREMENT
/begin MEASUREMENT DDRC_St.DFC_ComEAT2RingCnt "Debouncing counters / Debounce Timer or Event counter for check DFC_ComEAT2RingCnt" ULONG DFC_OneToOne 1 100 0.00 536870911.000 BIT_MASK 0x1fffffff FORMAT "%13.3" ECU_ADDRESS 0x60012B7C /end MEASUREMENT
/begin MEASUREMENT DDRC_St.DFC_ComEAT2TOut "Debouncing counters / Debounce Timer or Event counter for check DFC_ComEAT2TOut" ULONG DFC_OneToOne 1 100 0.00 536870911.000 BIT_MASK 0x1fffffff FORMAT "%13.3" ECU_ADDRESS 0x60012B80 /end MEASUREMENT
/begin MEASUREMENT DDRC_St.DFC_ComEAT4ChkSum "Debouncing counters / Debounce Timer or Event counter for check DFC_ComEAT4ChkSum" ULONG DFC_OneToOne 1 100 0.00 536870911.000 BIT_MASK 0x1fffffff FORMAT "%13.3" ECU_ADDRESS 0x60012B84 /end MEASUREMENT
/begin MEASUREMENT DDRC_St.DFC_ComEAT4RingCnt "Debouncing counters / Debounce Timer or Event counter for check DFC_ComEAT4RingCnt" ULONG DFC_OneToOne 1 100 0.00 536870911.000 BIT_MASK 0x1fffffff FORMAT "%13.3" ECU_ADDRESS 0x60012B88 /end MEASUREMENT
/begin MEASUREMENT DDRC_St.DFC_ComEAT4TOut "Debouncing counters / Debounce Timer or Event counter for check DFC_ComEAT4TOut" ULONG DFC_OneToOne 1 100 0.00 536870911.000 BIT_MASK 0x1fffffff FORMAT "%13.3" ECU_ADDRESS 0x60012B8C /end MEASUREMENT
/begin MEASUREMENT DDRC_St.DFC_ComEAT6Chksum "Debouncing counters / Debounce Timer or Event counter for check DFC_ComEAT6Chksum" ULONG DFC_OneToOne 1 100 0.00 536870911.000 BIT_MASK 0x1fffffff FORMAT "%13.3" ECU_ADDRESS 0x60012B90 /end MEASUREMENT
/begin MEASUREMENT DDRC_St.DFC_ComEAT6RingCnt "Debouncing counters / Debounce Timer or Event counter for check DFC_ComEAT6RingCnt" ULONG DFC_OneToOne 1 100 0.00 536870911.000 BIT_MASK 0x1fffffff FORMAT "%13.3" ECU_ADDRESS 0x60012B94 /end MEASUREMENT
/begin MEASUREMENT DDRC_St.DFC_ComEAT6TOut "Debouncing counters / Debounce Timer or Event counter for check DFC_ComEAT6TOut" ULONG DFC_OneToOne 1 100 0.00 536870911.000 BIT_MASK 0x1fffffff FORMAT "%13.3" ECU_ADDRESS 0x60012B98 /end MEASUREMENT
/begin MEASUREMENT DDRC_St.DFC_ComEAT7Chksum "Debouncing counters / Debounce Timer or Event counter for check DFC_ComEAT7Chksum" ULONG DFC_OneToOne 1 100 0.00 536870911.000 BIT_MASK 0x1fffffff FORMAT "%13.3" ECU_ADDRESS 0x60012B9C /end MEASUREMENT
/begin MEASUREMENT DDRC_St.DFC_ComEAT7RingCnt "Debouncing counters / Debounce Timer or Event counter for check DFC_ComEAT7RingCnt" ULONG DFC_OneToOne 1 100 0.00 536870911.000 BIT_MASK 0x1fffffff FORMAT "%13.3" ECU_ADDRESS 0x60012BA0 /end MEASUREMENT
/begin MEASUREMENT DDRC_St.DFC_ComEAT7TOut "Debouncing counters / Debounce Timer or Event counter for check DFC_ComEAT7TOut" ULONG DFC_OneToOne 1 100 0.00 536870911.000 BIT_MASK 0x1fffffff FORMAT "%13.3" ECU_ADDRESS 0x60012BA4 /end MEASUREMENT
/begin MEASUREMENT DDRC_St.DFC_ComEAT8Chksum "Debouncing counters / Debounce Timer or Event counter for check DFC_ComEAT8Chksum" ULONG DFC_OneToOne 1 100 0.00 536870911.000 BIT_MASK 0x1fffffff FORMAT "%13.3" ECU_ADDRESS 0x60012BA8 /end MEASUREMENT
/begin MEASUREMENT DDRC_St.DFC_ComEAT8RingCnt "Debouncing counters / Debounce Timer or Event counter for check DFC_ComEAT8RingCnt" ULONG DFC_OneToOne 1 100 0.00 536870911.000 BIT_MASK 0x1fffffff FORMAT "%13.3" ECU_ADDRESS 0x60012BAC /end MEASUREMENT
/begin MEASUREMENT DDRC_St.DFC_ComEAT8TOut "Debouncing counters / Debounce Timer or Event counter for check DFC_ComEAT8TOut" ULONG DFC_OneToOne 1 100 0.00 536870911.000 BIT_MASK 0x1fffffff FORMAT "%13.3" ECU_ADDRESS 0x60012BB0 /end MEASUREMENT
/begin MEASUREMENT DDRC_St.DFC_ComEATAChksum "Debouncing counters / Debounce Timer or Event counter for check DFC_ComEATAChksum" ULONG DFC_OneToOne 1 100 0.00 536870911.000 BIT_MASK 0x1fffffff FORMAT "%13.3" ECU_ADDRESS 0x60012BB4 /end MEASUREMENT
/begin MEASUREMENT DDRC_St.DFC_ComEATARingCnt "Debouncing counters / Debounce Timer or Event counter for check DFC_ComEATARingCnt" ULONG DFC_OneToOne 1 100 0.00 536870911.000 BIT_MASK 0x1fffffff FORMAT "%13.3" ECU_ADDRESS 0x60012BB8 /end MEASUREMENT
/begin MEASUREMENT DDRC_St.DFC_ComEATATOut "Debouncing counters / Debounce Timer or Event counter for check DFC_ComEATATOut" ULONG DFC_OneToOne 1 100 0.00 536870911.000 BIT_MASK 0x1fffffff FORMAT "%13.3" ECU_ADDRESS 0x60012BBC /end MEASUREMENT
/begin MEASUREMENT DDRC_St.DFC_ComEATBChkSum "Debouncing counters / Debounce Timer or Event counter for check DFC_ComEATBChkSum" ULONG DFC_OneToOne 1 100 0.00 536870911.000 BIT_MASK 0x1fffffff FORMAT "%13.3" ECU_ADDRESS 0x60012BC0 /end MEASUREMENT
/begin MEASUREMENT DDRC_St.DFC_ComEATBRingCnt "Debouncing counters / Debounce Timer or Event counter for check DFC_ComEATBRingCnt" ULONG DFC_OneToOne 1 100 0.00 536870911.000 BIT_MASK 0x1fffffff FORMAT "%13.3" ECU_ADDRESS 0x60012BC4 /end MEASUREMENT
/begin MEASUREMENT DDRC_St.DFC_ComEATBTOut "Debouncing counters / Debounce Timer or Event counter for check DFC_ComEATBTOut" ULONG DFC_OneToOne 1 100 0.00 536870911.000 BIT_MASK 0x1fffffff FORMAT "%13.3" ECU_ADDRESS 0x60012BC8 /end MEASUREMENT
/begin MEASUREMENT DDRC_St.DFC_ComEATCChksum "Debouncing counters / Debounce Timer or Event counter for check DFC_ComEATCChksum" ULONG DFC_OneToOne 1 100 0.00 536870911.000 BIT_MASK 0x1fffffff FORMAT "%13.3" ECU_ADDRESS 0x60012BCC /end MEASUREMENT
/begin MEASUREMENT DDRC_St.DFC_ComEATCRingCnt "Debouncing counters / Debounce Timer or Event counter for check DFC_ComEATCRingCnt" ULONG DFC_OneToOne 1 100 0.00 536870911.000 BIT_MASK 0x1fffffff FORMAT "%13.3" ECU_ADDRESS 0x60012BD0 /end MEASUREMENT
/begin MEASUREMENT DDRC_St.DFC_ComEATCTOut "Debouncing counters / Debounce Timer or Event counter for check DFC_ComEATCTOut" ULONG DFC_OneToOne 1 100 0.00 536870911.000 BIT_MASK 0x1fffffff FORMAT "%13.3" ECU_ADDRESS 0x60012BD4 /end MEASUREMENT
/begin MEASUREMENT DDRC_St.DFC_ComEPBBChkSum "Debouncing counters / Debounce Timer or Event counter for check DFC_ComEPBBChkSum" ULONG DFC_OneToOne 1 100 0.00 536870911.000 BIT_MASK 0x1fffffff FORMAT "%13.3" ECU_ADDRESS 0x60012BD8 /end MEASUREMENT
/begin MEASUREMENT DDRC_St.DFC_ComEPBBRingCnt "Debouncing counters / Debounce Timer or Event counter for check DFC_ComEPBBRingCnt" ULONG DFC_OneToOne 1 100 0.00 536870911.000 BIT_MASK 0x1fffffff FORMAT "%13.3" ECU_ADDRESS 0x60012BDC /end MEASUREMENT
/begin MEASUREMENT DDRC_St.DFC_ComEPBBTOut "Debouncing counters / Debounce Timer or Event counter for check DFC_ComEPBBTOut" ULONG DFC_OneToOne 1 100 0.00 536870911.000 BIT_MASK 0x1fffffff FORMAT "%13.3" ECU_ADDRESS 0x60012BE0 /end MEASUREMENT
/begin MEASUREMENT DDRC_St.DFC_ComEPBChksum "Debouncing counters / Debounce Timer or Event counter for check DFC_ComEPBChksum" ULONG DFC_OneToOne 1 100 0.00 536870911.000 BIT_MASK 0x1fffffff FORMAT "%13.3" ECU_ADDRESS 0x60012BE4 /end MEASUREMENT
/begin MEASUREMENT DDRC_St.DFC_ComEPBTOut "Debouncing counters / Debounce Timer or Event counter for check DFC_ComEPBTOut" ULONG DFC_OneToOne 1 100 0.00 536870911.000 BIT_MASK 0x1fffffff FORMAT "%13.3" ECU_ADDRESS 0x60012BE8 /end MEASUREMENT
/begin MEASUREMENT DDRC_St.DFC_ComEPBctRing "Debouncing counters / Debounce Timer or Event counter for check DFC_ComEPBctRing" ULONG DFC_OneToOne 1 100 0.00 536870911.000 BIT_MASK 0x1fffffff FORMAT "%13.3" ECU_ADDRESS 0x60012BEC /end MEASUREMENT
/begin MEASUREMENT DDRC_St.DFC_ComEPS1Chksum "Debouncing counters / Debounce Timer or Event counter for check DFC_ComEPS1Chksum" ULONG DFC_OneToOne 1 100 0.00 536870911.000 BIT_MASK 0x1fffffff FORMAT "%13.3" ECU_ADDRESS 0x60012BF0 /end MEASUREMENT
/begin MEASUREMENT DDRC_St.DFC_ComEPS1RingCnt "Debouncing counters / Debounce Timer or Event counter for check DFC_ComEPS1RingCnt" ULONG DFC_OneToOne 1 100 0.00 536870911.000 BIT_MASK 0x1fffffff FORMAT "%13.3" ECU_ADDRESS 0x60012BF4 /end MEASUREMENT
/begin MEASUREMENT DDRC_St.DFC_ComEPS1TOut "Debouncing counters / Debounce Timer or Event counter for check DFC_ComEPS1TOut" ULONG DFC_OneToOne 1 100 0.00 536870911.000 BIT_MASK 0x1fffffff FORMAT "%13.3" ECU_ADDRESS 0x60012BF8 /end MEASUREMENT
/begin MEASUREMENT DDRC_St.DFC_ComEngCanRxErr "Debouncing counters / Debounce Timer or Event counter for check DFC_ComEngCanRxErr" ULONG DFC_OneToOne 1 100 0.00 536870911.000 BIT_MASK 0x1fffffff FORMAT "%13.3" ECU_ADDRESS 0x60012BFC /end MEASUREMENT
/begin MEASUREMENT DDRC_St.DFC_ComGrvySnsrErr "Debouncing counters / Debounce Timer or Event counter for check DFC_ComGrvySnsrErr" ULONG DFC_OneToOne 1 100 0.00 536870911.000 BIT_MASK 0x1fffffff FORMAT "%13.3" ECU_ADDRESS 0x60012C00 /end MEASUREMENT
/begin MEASUREMENT DDRC_St.DFC_ComGwIMG1ChkSum "Debouncing counters / Debounce Timer or Event counter for check DFC_ComGwIMG1ChkSum" ULONG DFC_OneToOne 1 100 0.00 536870911.000 BIT_MASK 0x1fffffff FORMAT "%13.3" ECU_ADDRESS 0x60012C04 /end MEASUREMENT
/begin MEASUREMENT DDRC_St.DFC_ComGwIMG1RingCnt "Debouncing counters / Debounce Timer or Event counter for check DFC_ComGwIMG1RingCnt" ULONG DFC_OneToOne 1 100 0.00 536870911.000 BIT_MASK 0x1fffffff FORMAT "%13.3" ECU_ADDRESS 0x60012C08 /end MEASUREMENT
/begin MEASUREMENT DDRC_St.DFC_ComGwIMG1TOut "Debouncing counters / Debounce Timer or Event counter for check DFC_ComGwIMG1TOut" ULONG DFC_OneToOne 1 100 0.00 536870911.000 BIT_MASK 0x1fffffff FORMAT "%13.3" ECU_ADDRESS 0x60012C0C /end MEASUREMENT
/begin MEASUREMENT DDRC_St.DFC_ComGwIMG3ChkSum "Debouncing counters / Debounce Timer or Event counter for check DFC_ComGwIMG3ChkSum" ULONG DFC_OneToOne 1 100 0.00 536870911.000 BIT_MASK 0x1fffffff FORMAT "%13.3" ECU_ADDRESS 0x60012C10 /end MEASUREMENT
/begin MEASUREMENT DDRC_St.DFC_ComGwIMG3RingCnt "Debouncing counters / Debounce Timer or Event counter for check DFC_ComGwIMG3RingCnt" ULONG DFC_OneToOne 1 100 0.00 536870911.000 BIT_MASK 0x1fffffff FORMAT "%13.3" ECU_ADDRESS 0x60012C14 /end MEASUREMENT
/begin MEASUREMENT DDRC_St.DFC_ComGwIMG3TOut "Debouncing counters / Debounce Timer or Event counter for check DFC_ComGwIMG3TOut" ULONG DFC_OneToOne 1 100 0.00 536870911.000 BIT_MASK 0x1fffffff FORMAT "%13.3" ECU_ADDRESS 0x60012C18 /end MEASUREMENT
/begin MEASUREMENT DDRC_St.DFC_ComGwIMG4ChkSum "Debouncing counters / Debounce Timer or Event counter for check DFC_ComGwIMG4ChkSum" ULONG DFC_OneToOne 1 100 0.00 536870911.000 BIT_MASK 0x1fffffff FORMAT "%13.3" ECU_ADDRESS 0x60012C1C /end MEASUREMENT
/begin MEASUREMENT DDRC_St.DFC_ComGwIMG4RingCnt "Debouncing counters / Debounce Timer or Event counter for check DFC_ComGwIMG4RingCnt" ULONG DFC_OneToOne 1 100 0.00 536870911.000 BIT_MASK 0x1fffffff FORMAT "%13.3" ECU_ADDRESS 0x60012C20 /end MEASUREMENT
/begin MEASUREMENT DDRC_St.DFC_ComGwIMG4TOut "Debouncing counters / Debounce Timer or Event counter for check DFC_ComGwIMG4TOut" ULONG DFC_OneToOne 1 100 0.00 536870911.000 BIT_MASK 0x1fffffff FORMAT "%13.3" ECU_ADDRESS 0x60012C24 /end MEASUREMENT
/begin MEASUREMENT DDRC_St.DFC_ComGwIMG5ChkSum "Debouncing counters / Debounce Timer or Event counter for check DFC_ComGwIMG5ChkSum" ULONG DFC_OneToOne 1 100 0.00 536870911.000 BIT_MASK 0x1fffffff FORMAT "%13.3" ECU_ADDRESS 0x60012C28 /end MEASUREMENT
/begin MEASUREMENT DDRC_St.DFC_ComGwIMG5RingCnt "Debouncing counters / Debounce Timer or Event counter for check DFC_ComGwIMG5RingCnt" ULONG DFC_OneToOne 1 100 0.00 536870911.000 BIT_MASK 0x1fffffff FORMAT "%13.3" ECU_ADDRESS 0x60012C2C /end MEASUREMENT
/begin MEASUREMENT DDRC_St.DFC_ComGwIMG5TOut "Debouncing counters / Debounce Timer or Event counter for check DFC_ComGwIMG5TOut" ULONG DFC_OneToOne 1 100 0.00 536870911.000 BIT_MASK 0x1fffffff FORMAT "%13.3" ECU_ADDRESS 0x60012C30 /end MEASUREMENT
/begin MEASUREMENT DDRC_St.DFC_ComGwIMG6ChkSum "Debouncing counters / Debounce Timer or Event counter for check DFC_ComGwIMG6ChkSum" ULONG DFC_OneToOne 1 100 0.00 536870911.000 BIT_MASK 0x1fffffff FORMAT "%13.3" ECU_ADDRESS 0x60012C34 /end MEASUREMENT
/begin MEASUREMENT DDRC_St.DFC_ComGwIMG6RingCnt "Debouncing counters / Debounce Timer or Event counter for check DFC_ComGwIMG6RingCnt" ULONG DFC_OneToOne 1 100 0.00 536870911.000 BIT_MASK 0x1fffffff FORMAT "%13.3" ECU_ADDRESS 0x60012C38 /end MEASUREMENT
/begin MEASUREMENT DDRC_St.DFC_ComGwIMG6TOut "Debouncing counters / Debounce Timer or Event counter for check DFC_ComGwIMG6TOut" ULONG DFC_OneToOne 1 100 0.00 536870911.000 BIT_MASK 0x1fffffff FORMAT "%13.3" ECU_ADDRESS 0x60012C3C /end MEASUREMENT
/begin MEASUREMENT DDRC_St.DFC_ComIDASBChksum "Debouncing counters / Debounce Timer or Event counter for check DFC_ComIDASBChksum" ULONG DFC_OneToOne 1 100 0.00 536870911.000 BIT_MASK 0x1fffffff FORMAT "%13.3" ECU_ADDRESS 0x60012C40 /end MEASUREMENT
/begin MEASUREMENT DDRC_St.DFC_ComIDASBRingCnt "Debouncing counters / Debounce Timer or Event counter for check DFC_ComIDASBRingCnt" ULONG DFC_OneToOne 1 100 0.00 536870911.000 BIT_MASK 0x1fffffff FORMAT "%13.3" ECU_ADDRESS 0x60012C44 /end MEASUREMENT
/begin MEASUREMENT DDRC_St.DFC_ComIDASBTOut "Debouncing counters / Debounce Timer or Event counter for check DFC_ComIDASBTOut" ULONG DFC_OneToOne 1 100 0.00 536870911.000 BIT_MASK 0x1fffffff FORMAT "%13.3" ECU_ADDRESS 0x60012C48 /end MEASUREMENT
/begin MEASUREMENT DDRC_St.DFC_ComIMGMILReq "Debouncing counters / Debounce Timer or Event counter for check DFC_ComIMGMILReq" ULONG DFC_OneToOne 1 100 0.00 536870911.000 BIT_MASK 0x1fffffff FORMAT "%13.3" ECU_ADDRESS 0x60012C4C /end MEASUREMENT
/begin MEASUREMENT DDRC_St.DFC_ComISSPrms "Debouncing counters / Debounce Timer or Event counter for check DFC_ComISSPrms" ULONG DFC_OneToOne 1 100 0.00 536870911.000 BIT_MASK 0x1fffffff FORMAT "%13.3" ECU_ADDRESS 0x60012C50 /end MEASUREMENT
/begin MEASUREMENT DDRC_St.DFC_ComMETAChksum "Debouncing counters / Debounce Timer or Event counter for check DFC_ComMETAChksum" ULONG DFC_OneToOne 1 100 0.00 536870911.000 BIT_MASK 0x1fffffff FORMAT "%13.3" ECU_ADDRESS 0x60012C54 /end MEASUREMENT
/begin MEASUREMENT DDRC_St.DFC_ComMETAChksumPstDrv "Debouncing counters / Debounce Timer or Event counter for check DFC_ComMETAChksumPstDrv" ULONG DFC_OneToOne 1 100 0.00 536870911.000 BIT_MASK 0x1fffffff FORMAT "%13.3" ECU_ADDRESS 0x60012C58 /end MEASUREMENT
/begin MEASUREMENT DDRC_St.DFC_ComMETARingCnt "Debouncing counters / Debounce Timer or Event counter for check DFC_ComMETARingCnt" ULONG DFC_OneToOne 1 100 0.00 536870911.000 BIT_MASK 0x1fffffff FORMAT "%13.3" ECU_ADDRESS 0x60012C5C /end MEASUREMENT
/begin MEASUREMENT DDRC_St.DFC_ComMETARingCntPstDrv "Debouncing counters / Debounce Timer or Event counter for check DFC_ComMETARingCntPstDrv" ULONG DFC_OneToOne 1 100 0.00 536870911.000 BIT_MASK 0x1fffffff FORMAT "%13.3" ECU_ADDRESS 0x60012C60 /end MEASUREMENT
/begin MEASUREMENT DDRC_St.DFC_ComMETATOut "Debouncing counters / Debounce Timer or Event counter for check DFC_ComMETATOut" ULONG DFC_OneToOne 1 100 0.00 536870911.000 BIT_MASK 0x1fffffff FORMAT "%13.3" ECU_ADDRESS 0x60012C64 /end MEASUREMENT
/begin MEASUREMENT DDRC_St.DFC_ComMETATOutPstDrv "Debouncing counters / Debounce Timer or Event counter for check DFC_ComMETATOutPstDrv" ULONG DFC_OneToOne 1 100 0.00 536870911.000 BIT_MASK 0x1fffffff FORMAT "%13.3" ECU_ADDRESS 0x60012C68 /end MEASUREMENT
/begin MEASUREMENT DDRC_St.DFC_ComMETCChksum "Debouncing counters / Debounce Timer or Event counter for check DFC_ComMETCChksum" ULONG DFC_OneToOne 1 100 0.00 536870911.000 BIT_MASK 0x1fffffff FORMAT "%13.3" ECU_ADDRESS 0x60012C6C /end MEASUREMENT
/begin MEASUREMENT DDRC_St.DFC_ComMETCRingCnt "Debouncing counters / Debounce Timer or Event counter for check DFC_ComMETCRingCnt" ULONG DFC_OneToOne 1 100 0.00 536870911.000 BIT_MASK 0x1fffffff FORMAT "%13.3" ECU_ADDRESS 0x60012C70 /end MEASUREMENT
/begin MEASUREMENT DDRC_St.DFC_ComMETCTOut "Debouncing counters / Debounce Timer or Event counter for check DFC_ComMETCTOut" ULONG DFC_OneToOne 1 100 0.00 536870911.000 BIT_MASK 0x1fffffff FORMAT "%13.3" ECU_ADDRESS 0x60012C74 /end MEASUREMENT
/begin MEASUREMENT DDRC_St.DFC_ComMETDChksum "Debouncing counters / Debounce Timer or Event counter for check DFC_ComMETDChksum" ULONG DFC_OneToOne 1 100 0.00 536870911.000 BIT_MASK 0x1fffffff FORMAT "%13.3" ECU_ADDRESS 0x60012C78 /end MEASUREMENT
/begin MEASUREMENT DDRC_St.DFC_ComMETDRingCnt "Debouncing counters / Debounce Timer or Event counter for check DFC_ComMETDRingCnt" ULONG DFC_OneToOne 1 100 0.00 536870911.000 BIT_MASK 0x1fffffff FORMAT "%13.3" ECU_ADDRESS 0x60012C7C /end MEASUREMENT
/begin MEASUREMENT DDRC_St.DFC_ComMETDTOut "Debouncing counters / Debounce Timer or Event counter for check DFC_ComMETDTOut" ULONG DFC_OneToOne 1 100 0.00 536870911.000 BIT_MASK 0x1fffffff FORMAT "%13.3" ECU_ADDRESS 0x60012C80 /end MEASUREMENT
/begin MEASUREMENT DDRC_St.DFC_ComMETE2Chksum "Debouncing counters / Debounce Timer or Event counter for check DFC_ComMETE2Chksum" ULONG DFC_OneToOne 1 100 0.00 536870911.000 BIT_MASK 0x1fffffff FORMAT "%13.3" ECU_ADDRESS 0x60012C84 /end MEASUREMENT
/begin MEASUREMENT DDRC_St.DFC_ComMETE2RingCnt "Debouncing counters / Debounce Timer or Event counter for check DFC_ComMETE2RingCnt" ULONG DFC_OneToOne 1 100 0.00 536870911.000 BIT_MASK 0x1fffffff FORMAT "%13.3" ECU_ADDRESS 0x60012C88 /end MEASUREMENT
/begin MEASUREMENT DDRC_St.DFC_ComMETE2TOut "Debouncing counters / Debounce Timer or Event counter for check DFC_ComMETE2TOut" ULONG DFC_OneToOne 1 100 0.00 536870911.000 BIT_MASK 0x1fffffff FORMAT "%13.3" ECU_ADDRESS 0x60012C8C /end MEASUREMENT
/begin MEASUREMENT DDRC_St.DFC_ComMETFChksum "Debouncing counters / Debounce Timer or Event counter for check DFC_ComMETFChksum" ULONG DFC_OneToOne 1 100 0.00 536870911.000 BIT_MASK 0x1fffffff FORMAT "%13.3" ECU_ADDRESS 0x60012C90 /end MEASUREMENT
/begin MEASUREMENT DDRC_St.DFC_ComMETFRingCnt "Debouncing counters / Debounce Timer or Event counter for check DFC_ComMETFRingCnt" ULONG DFC_OneToOne 1 100 0.00 536870911.000 BIT_MASK 0x1fffffff FORMAT "%13.3" ECU_ADDRESS 0x60012C94 /end MEASUREMENT
/begin MEASUREMENT DDRC_St.DFC_ComMETFTOut "Debouncing counters / Debounce Timer or Event counter for check DFC_ComMETFTOut" ULONG DFC_OneToOne 1 100 0.00 536870911.000 BIT_MASK 0x1fffffff FORMAT "%13.3" ECU_ADDRESS 0x60012C98 /end MEASUREMENT
/begin MEASUREMENT DDRC_St.DFC_ComMETGChksum "Debouncing counters / Debounce Timer or Event counter for check DFC_ComMETGChksum" ULONG DFC_OneToOne 1 100 0.00 536870911.000 BIT_MASK 0x1fffffff FORMAT "%13.3" ECU_ADDRESS 0x60012C9C /end MEASUREMENT
/begin MEASUREMENT DDRC_St.DFC_ComMETGRingCnt "Debouncing counters / Debounce Timer or Event counter for check DFC_ComMETGRingCnt" ULONG DFC_OneToOne 1 100 0.00 536870911.000 BIT_MASK 0x1fffffff FORMAT "%13.3" ECU_ADDRESS 0x60012CA0 /end MEASUREMENT
/begin MEASUREMENT DDRC_St.DFC_ComMETGTOut "Debouncing counters / Debounce Timer or Event counter for check DFC_ComMETGTOut" ULONG DFC_OneToOne 1 100 0.00 536870911.000 BIT_MASK 0x1fffffff FORMAT "%13.3" ECU_ADDRESS 0x60012CA4 /end MEASUREMENT
/begin MEASUREMENT DDRC_St.DFC_ComMETH2Chksum "Debouncing counters / Debounce Timer or Event counter for check DFC_ComMETH2Chksum" ULONG DFC_OneToOne 1 100 0.00 536870911.000 BIT_MASK 0x1fffffff FORMAT "%13.3" ECU_ADDRESS 0x60012CA8 /end MEASUREMENT
/begin MEASUREMENT DDRC_St.DFC_ComMETH2RingCnt "Debouncing counters / Debounce Timer or Event counter for check DFC_ComMETH2RingCnt" ULONG DFC_OneToOne 1 100 0.00 536870911.000 BIT_MASK 0x1fffffff FORMAT "%13.3" ECU_ADDRESS 0x60012CAC /end MEASUREMENT
/begin MEASUREMENT DDRC_St.DFC_ComMETH2TOut "Debouncing counters / Debounce Timer or Event counter for check DFC_ComMETH2TOut" ULONG DFC_OneToOne 1 100 0.00 536870911.000 BIT_MASK 0x1fffffff FORMAT "%13.3" ECU_ADDRESS 0x60012CB0 /end MEASUREMENT
/begin MEASUREMENT DDRC_St.DFC_ComMETHChksum "Debouncing counters / Debounce Timer or Event counter for check DFC_ComMETHChksum" ULONG DFC_OneToOne 1 100 0.00 536870911.000 BIT_MASK 0x1fffffff FORMAT "%13.3" ECU_ADDRESS 0x60012CB4 /end MEASUREMENT
/begin MEASUREMENT DDRC_St.DFC_ComMETHRingCnt "Debouncing counters / Debounce Timer or Event counter for check DFC_ComMETHRingCnt" ULONG DFC_OneToOne 1 100 0.00 536870911.000 BIT_MASK 0x1fffffff FORMAT "%13.3" ECU_ADDRESS 0x60012CB8 /end MEASUREMENT
/begin MEASUREMENT DDRC_St.DFC_ComMETHTOut "Debouncing counters / Debounce Timer or Event counter for check DFC_ComMETHTOut" ULONG DFC_OneToOne 1 100 0.00 536870911.000 BIT_MASK 0x1fffffff FORMAT "%13.3" ECU_ADDRESS 0x60012CBC /end MEASUREMENT
/begin MEASUREMENT DDRC_St.DFC_ComMETIChksum "Debouncing counters / Debounce Timer or Event counter for check DFC_ComMETIChksum" ULONG DFC_OneToOne 1 100 0.00 536870911.000 BIT_MASK 0x1fffffff FORMAT "%13.3" ECU_ADDRESS 0x60012CC0 /end MEASUREMENT
/begin MEASUREMENT DDRC_St.DFC_ComMETIRingCnt "Debouncing counters / Debounce Timer or Event counter for check DFC_ComMETIRingCnt" ULONG DFC_OneToOne 1 100 0.00 536870911.000 BIT_MASK 0x1fffffff FORMAT "%13.3" ECU_ADDRESS 0x60012CC4 /end MEASUREMENT
/begin MEASUREMENT DDRC_St.DFC_ComMETITOut "Debouncing counters / Debounce Timer or Event counter for check DFC_ComMETITOut" ULONG DFC_OneToOne 1 100 0.00 536870911.000 BIT_MASK 0x1fffffff FORMAT "%13.3" ECU_ADDRESS 0x60012CC8 /end MEASUREMENT
/begin MEASUREMENT DDRC_St.DFC_ComMETKChksum "Debouncing counters / Debounce Timer or Event counter for check DFC_ComMETKChksum" ULONG DFC_OneToOne 1 100 0.00 536870911.000 BIT_MASK 0x1fffffff FORMAT "%13.3" ECU_ADDRESS 0x60012CCC /end MEASUREMENT
/begin MEASUREMENT DDRC_St.DFC_ComMETKRingCnt "Debouncing counters / Debounce Timer or Event counter for check DFC_ComMETKRingCnt" ULONG DFC_OneToOne 1 100 0.00 536870911.000 BIT_MASK 0x1fffffff FORMAT "%13.3" ECU_ADDRESS 0x60012CD0 /end MEASUREMENT
/begin MEASUREMENT DDRC_St.DFC_ComMETKTOut "Debouncing counters / Debounce Timer or Event counter for check DFC_ComMETKTOut" ULONG DFC_OneToOne 1 100 0.00 536870911.000 BIT_MASK 0x1fffffff FORMAT "%13.3" ECU_ADDRESS 0x60012CD4 /end MEASUREMENT
/begin MEASUREMENT DDRC_St.DFC_ComMETLChksum "Debouncing counters / Debounce Timer or Event counter for check DFC_ComMETLChksum" ULONG DFC_OneToOne 1 100 0.00 536870911.000 BIT_MASK 0x1fffffff FORMAT "%13.3" ECU_ADDRESS 0x60012CD8 /end MEASUREMENT
/begin MEASUREMENT DDRC_St.DFC_ComMETLRingCnt "Debouncing counters / Debounce Timer or Event counter for check DFC_ComMETLRingCnt" ULONG DFC_OneToOne 1 100 0.00 536870911.000 BIT_MASK 0x1fffffff FORMAT "%13.3" ECU_ADDRESS 0x60012CDC /end MEASUREMENT
/begin MEASUREMENT DDRC_St.DFC_ComMETLTOut "Debouncing counters / Debounce Timer or Event counter for check DFC_ComMETLTOut" ULONG DFC_OneToOne 1 100 0.00 536870911.000 BIT_MASK 0x1fffffff FORMAT "%13.3" ECU_ADDRESS 0x60012CE0 /end MEASUREMENT
/begin MEASUREMENT DDRC_St.DFC_ComMETMChksum "Debouncing counters / Debounce Timer or Event counter for check DFC_ComMETMChksum" ULONG DFC_OneToOne 1 100 0.00 536870911.000 BIT_MASK 0x1fffffff FORMAT "%13.3" ECU_ADDRESS 0x60012CE4 /end MEASUREMENT
/begin MEASUREMENT DDRC_St.DFC_ComMETMRingCnt "Debouncing counters / Debounce Timer or Event counter for check DFC_ComMETMRingCnt" ULONG DFC_OneToOne 1 100 0.00 536870911.000 BIT_MASK 0x1fffffff FORMAT "%13.3" ECU_ADDRESS 0x60012CE8 /end MEASUREMENT
/begin MEASUREMENT DDRC_St.DFC_ComMETMTOut "Debouncing counters / Debounce Timer or Event counter for check DFC_ComMETMTOut" ULONG DFC_OneToOne 1 100 0.00 536870911.000 BIT_MASK 0x1fffffff FORMAT "%13.3" ECU_ADDRESS 0x60012CEC /end MEASUREMENT
/begin MEASUREMENT DDRC_St.DFC_ComMETNChksum "Debouncing counters / Debounce Timer or Event counter for check DFC_ComMETNChksum" ULONG DFC_OneToOne 1 100 0.00 536870911.000 BIT_MASK 0x1fffffff FORMAT "%13.3" ECU_ADDRESS 0x60012CF0 /end MEASUREMENT
/begin MEASUREMENT DDRC_St.DFC_ComMETNRingCnt "Debouncing counters / Debounce Timer or Event counter for check DFC_ComMETNRingCnt" ULONG DFC_OneToOne 1 100 0.00 536870911.000 BIT_MASK 0x1fffffff FORMAT "%13.3" ECU_ADDRESS 0x60012CF4 /end MEASUREMENT
/begin MEASUREMENT DDRC_St.DFC_ComMETNTOut "Debouncing counters / Debounce Timer or Event counter for check DFC_ComMETNTOut" ULONG DFC_OneToOne 1 100 0.00 536870911.000 BIT_MASK 0x1fffffff FORMAT "%13.3" ECU_ADDRESS 0x60012CF8 /end MEASUREMENT
/begin MEASUREMENT DDRC_St.DFC_ComMtrCom "Debouncing counters / Debounce Timer or Event counter for check DFC_ComMtrCom" ULONG DFC_OneToOne 1 100 0.00 536870911.000 BIT_MASK 0x1fffffff FORMAT "%13.3" ECU_ADDRESS 0x60012CFC /end MEASUREMENT
/begin MEASUREMENT DDRC_St.DFC_ComPCUChkSum "Debouncing counters / Debounce Timer or Event counter for check DFC_ComPCUChkSum" ULONG DFC_OneToOne 1 100 0.00 536870911.000 BIT_MASK 0x1fffffff FORMAT "%13.3" ECU_ADDRESS 0x60012D00 /end MEASUREMENT
/begin MEASUREMENT DDRC_St.DFC_ComPCURingCnt "Debouncing counters / Debounce Timer or Event counter for check DFC_ComPCURingCnt" ULONG DFC_OneToOne 1 100 0.00 536870911.000 BIT_MASK 0x1fffffff FORMAT "%13.3" ECU_ADDRESS 0x60012D04 /end MEASUREMENT
/begin MEASUREMENT DDRC_St.DFC_ComPCUTOut "Debouncing counters / Debounce Timer or Event counter for check DFC_ComPCUTOut" ULONG DFC_OneToOne 1 100 0.00 536870911.000 BIT_MASK 0x1fffffff FORMAT "%13.3" ECU_ADDRESS 0x60012D08 /end MEASUREMENT
/begin MEASUREMENT DDRC_St.DFC_ComSRSAChksum "Debouncing counters / Debounce Timer or Event counter for check DFC_ComSRSAChksum" ULONG DFC_OneToOne 1 100 0.00 536870911.000 BIT_MASK 0x1fffffff FORMAT "%13.3" ECU_ADDRESS 0x60012D0C /end MEASUREMENT
/begin MEASUREMENT DDRC_St.DFC_ComSRSARingCnt "Debouncing counters / Debounce Timer or Event counter for check DFC_ComSRSARingCnt" ULONG DFC_OneToOne 1 100 0.00 536870911.000 BIT_MASK 0x1fffffff FORMAT "%13.3" ECU_ADDRESS 0x60012D10 /end MEASUREMENT
/begin MEASUREMENT DDRC_St.DFC_ComSRSATOut "Debouncing counters / Debounce Timer or Event counter for check DFC_ComSRSATOut" ULONG DFC_OneToOne 1 100 0.00 536870911.000 BIT_MASK 0x1fffffff FORMAT "%13.3" ECU_ADDRESS 0x60012D14 /end MEASUREMENT
/begin MEASUREMENT DDRC_St.DFC_ComSRSBChksum "Debouncing counters / Debounce Timer or Event counter for check DFC_ComSRSBChksum" ULONG DFC_OneToOne 1 100 0.00 536870911.000 BIT_MASK 0x1fffffff FORMAT "%13.3" ECU_ADDRESS 0x60012D18 /end MEASUREMENT
/begin MEASUREMENT DDRC_St.DFC_ComSRSBRingCnt "Debouncing counters / Debounce Timer or Event counter for check DFC_ComSRSBRingCnt" ULONG DFC_OneToOne 1 100 0.00 536870911.000 BIT_MASK 0x1fffffff FORMAT "%13.3" ECU_ADDRESS 0x60012D1C /end MEASUREMENT
/begin MEASUREMENT DDRC_St.DFC_ComSRSBTOut "Debouncing counters / Debounce Timer or Event counter for check DFC_ComSRSBTOut" ULONG DFC_OneToOne 1 100 0.00 536870911.000 BIT_MASK 0x1fffffff FORMAT "%13.3" ECU_ADDRESS 0x60012D20 /end MEASUREMENT
/begin MEASUREMENT DDRC_St.DFC_ComSRSChksum "Debouncing counters / Debounce Timer or Event counter for check DFC_ComSRSChksum" ULONG DFC_OneToOne 1 100 0.00 536870911.000 BIT_MASK 0x1fffffff FORMAT "%13.3" ECU_ADDRESS 0x60012D24 /end MEASUREMENT
/begin MEASUREMENT DDRC_St.DFC_ComSRSErr "Debouncing counters / Debounce Timer or Event counter for check DFC_ComSRSErr" ULONG DFC_OneToOne 1 100 0.00 536870911.000 BIT_MASK 0x1fffffff FORMAT "%13.3" ECU_ADDRESS 0x60012D28 /end MEASUREMENT
/begin MEASUREMENT DDRC_St.DFC_ComSRSRingCnt "Debouncing counters / Debounce Timer or Event counter for check DFC_ComSRSRingCnt" ULONG DFC_OneToOne 1 100 0.00 536870911.000 BIT_MASK 0x1fffffff FORMAT "%13.3" ECU_ADDRESS 0x60012D2C /end MEASUREMENT
/begin MEASUREMENT DDRC_St.DFC_ComSRSTOut "Debouncing counters / Debounce Timer or Event counter for check DFC_ComSRSTOut" ULONG DFC_OneToOne 1 100 0.00 536870911.000 BIT_MASK 0x1fffffff FORMAT "%13.3" ECU_ADDRESS 0x60012D30 /end MEASUREMENT
/begin MEASUREMENT DDRC_St.DFC_ComVehSpdPndFltTCU "Debouncing counters / Debounce Timer or Event counter for check DFC_ComVehSpdPndFltTCU" ULONG DFC_OneToOne 1 100 0.00 536870911.000 BIT_MASK 0x1fffffff FORMAT "%13.3" ECU_ADDRESS 0x60012D34 /end MEASUREMENT
/begin MEASUREMENT DDRC_St.DFC_EbsChartcCurrErr "Debouncing counters / Debounce Timer or Event counter for check DFC_EbsChartcCurrErr" ULONG DFC_OneToOne 1 100 0.00 536870911.000 BIT_MASK 0x1fffffff FORMAT "%13.3" ECU_ADDRESS 0x60012D38 /end MEASUREMENT
/begin MEASUREMENT DDRC_St.DFC_EbsSelfDiagErr "Debouncing counters / Debounce Timer or Event counter for check DFC_EbsSelfDiagErr" ULONG DFC_OneToOne 1 100 0.00 536870911.000 BIT_MASK 0x1fffffff FORMAT "%13.3" ECU_ADDRESS 0x60012D3C /end MEASUREMENT
/begin MEASUREMENT DDRC_St.DFC_GEVlvPhaCsersIntkB1 "Debouncing counters / Debounce Timer or Event counter for check DFC_GEVlvPhaCsersIntkB1" ULONG DFC_OneToOne 1 100 0.00 536870911.000 BIT_MASK 0x1fffffff FORMAT "%13.3" ECU_ADDRESS 0x60012D40 /end MEASUREMENT
/begin MEASUREMENT DDRC_St.DFC_GEVlvPhaPsOpenLoadIntkB1 "Debouncing counters / Debounce Timer or Event counter for check DFC_GEVlvPhaPsOpenLoadIntkB1" ULONG DFC_OneToOne 1 100 0.00 536870911.000 BIT_MASK 0x1fffffff FORMAT "%13.3" ECU_ADDRESS 0x60012D44 /end MEASUREMENT
/begin MEASUREMENT DDRC_St.DFC_GEVlvPhaPsShoToBattIntkB1 "Debouncing counters / Debounce Timer or Event counter for check DFC_GEVlvPhaPsShoToBattIntkB1" ULONG DFC_OneToOne 1 100 0.00 536870911.000 BIT_MASK 0x1fffffff FORMAT "%13.3" ECU_ADDRESS 0x60012D48 /end MEASUREMENT
/begin MEASUREMENT DDRC_St.DFC_GEVlvPhaPsShoToGndIntkB1 "Debouncing counters / Debounce Timer or Event counter for check DFC_GEVlvPhaPsShoToGndIntkB1" ULONG DFC_OneToOne 1 100 0.00 536870911.000 BIT_MASK 0x1fffffff FORMAT "%13.3" ECU_ADDRESS 0x60012D4C /end MEASUREMENT
/begin MEASUREMENT DDRC_St.DFC_GbxCANDigPlausErr "Debouncing counters / Debounce Timer or Event counter for check DFC_GbxCANDigPlausErr" ULONG DFC_OneToOne 1 100 0.00 536870911.000 BIT_MASK 0x1fffffff FORMAT "%13.3" ECU_ADDRESS 0x60012D50 /end MEASUREMENT
/begin MEASUREMENT DDRC_St.DFC_GbxNPos1SRCMax "Debouncing counters / Debounce Timer or Event counter for check DFC_GbxNPos1SRCMax" ULONG DFC_OneToOne 1 100 0.00 536870911.000 BIT_MASK 0x1fffffff FORMAT "%13.3" ECU_ADDRESS 0x60012D54 /end MEASUREMENT
/begin MEASUREMENT DDRC_St.DFC_GbxNPos1SRCMin "Debouncing counters / Debounce Timer or Event counter for check DFC_GbxNPos1SRCMin" ULONG DFC_OneToOne 1 100 0.00 536870911.000 BIT_MASK 0x1fffffff FORMAT "%13.3" ECU_ADDRESS 0x60012D58 /end MEASUREMENT
/begin MEASUREMENT DDRC_St.DFC_GbxNPos2SRCMax "Debouncing counters / Debounce Timer or Event counter for check DFC_GbxNPos2SRCMax" ULONG DFC_OneToOne 1 100 0.00 536870911.000 BIT_MASK 0x1fffffff FORMAT "%13.3" ECU_ADDRESS 0x60012D5C /end MEASUREMENT
/begin MEASUREMENT DDRC_St.DFC_GbxNPos2SRCMin "Debouncing counters / Debounce Timer or Event counter for check DFC_GbxNPos2SRCMin" ULONG DFC_OneToOne 1 100 0.00 536870911.000 BIT_MASK 0x1fffffff FORMAT "%13.3" ECU_ADDRESS 0x60012D60 /end MEASUREMENT
/begin MEASUREMENT DDRC_St.DFC_GbxNPosAlvChk "Debouncing counters / Debounce Timer or Event counter for check DFC_GbxNPosAlvChk" ULONG DFC_OneToOne 1 100 0.00 536870911.000 BIT_MASK 0x1fffffff FORMAT "%13.3" ECU_ADDRESS 0x60012D64 /end MEASUREMENT
/begin MEASUREMENT DDRC_St.DFC_GbxNPosSyncErr "Debouncing counters / Debounce Timer or Event counter for check DFC_GbxNPosSyncErr" ULONG DFC_OneToOne 1 100 0.00 536870911.000 BIT_MASK 0x1fffffff FORMAT "%13.3" ECU_ADDRESS 0x60012D68 /end MEASUREMENT
/begin MEASUREMENT DDRC_St.DFC_HEGOS2B1HtrPsMax "Debouncing counters / Debounce Timer or Event counter for check DFC_HEGOS2B1HtrPsMax" ULONG DFC_OneToOne 1 100 0.00 536870911.000 BIT_MASK 0x1fffffff FORMAT "%13.3" ECU_ADDRESS 0x60012D6C /end MEASUREMENT
/begin MEASUREMENT DDRC_St.DFC_HEGOS2B1HtrPsMin "Debouncing counters / Debounce Timer or Event counter for check DFC_HEGOS2B1HtrPsMin" ULONG DFC_OneToOne 1 100 0.00 536870911.000 BIT_MASK 0x1fffffff FORMAT "%13.3" ECU_ADDRESS 0x60012D70 /end MEASUREMENT
/begin MEASUREMENT DDRC_St.DFC_HEGOS2B1HtrPsSig "Debouncing counters / Debounce Timer or Event counter for check DFC_HEGOS2B1HtrPsSig" ULONG DFC_OneToOne 1 100 0.00 536870911.000 BIT_MASK 0x1fffffff FORMAT "%13.3" ECU_ADDRESS 0x60012D74 /end MEASUREMENT
/begin MEASUREMENT DDRC_St.DFC_LinCSErrACG "Debouncing counters / Debounce Timer or Event counter for check DFC_LinCSErrACG" ULONG DFC_OneToOne 1 100 0.00 536870911.000 BIT_MASK 0x1fffffff FORMAT "%13.3" ECU_ADDRESS 0x60012D78 /end MEASUREMENT
/begin MEASUREMENT DDRC_St.DFC_LinCSErrAEV "Debouncing counters / Debounce Timer or Event counter for check DFC_LinCSErrAEV" ULONG DFC_OneToOne 1 100 0.00 536870911.000 BIT_MASK 0x1fffffff FORMAT "%13.3" ECU_ADDRESS 0x60012D7C /end MEASUREMENT
/begin MEASUREMENT DDRC_St.DFC_LinCSErrDCDC "Debouncing counters / Debounce Timer or Event counter for check DFC_LinCSErrDCDC" ULONG DFC_OneToOne 1 100 0.00 536870911.000 BIT_MASK 0x1fffffff FORMAT "%13.3" ECU_ADDRESS 0x60012D80 /end MEASUREMENT
/begin MEASUREMENT DDRC_St.DFC_LinCSErrEBS "Debouncing counters / Debounce Timer or Event counter for check DFC_LinCSErrEBS" ULONG DFC_OneToOne 1 100 0.00 536870911.000 BIT_MASK 0x1fffffff FORMAT "%13.3" ECU_ADDRESS 0x60012D84 /end MEASUREMENT
/begin MEASUREMENT DDRC_St.DFC_LinHdrTimeoutErrACG "Debouncing counters / Debounce Timer or Event counter for check DFC_LinHdrTimeoutErrACG" ULONG DFC_OneToOne 1 100 0.00 536870911.000 BIT_MASK 0x1fffffff FORMAT "%13.3" ECU_ADDRESS 0x60012D88 /end MEASUREMENT
/begin MEASUREMENT DDRC_St.DFC_LinHdrTimeoutErrAEV "Debouncing counters / Debounce Timer or Event counter for check DFC_LinHdrTimeoutErrAEV" ULONG DFC_OneToOne 1 100 0.00 536870911.000 BIT_MASK 0x1fffffff FORMAT "%13.3" ECU_ADDRESS 0x60012D8C /end MEASUREMENT
/begin MEASUREMENT DDRC_St.DFC_LinHdrTimeoutErrDCDC "Debouncing counters / Debounce Timer or Event counter for check DFC_LinHdrTimeoutErrDCDC" ULONG DFC_OneToOne 1 100 0.00 536870911.000 BIT_MASK 0x1fffffff FORMAT "%13.3" ECU_ADDRESS 0x60012D90 /end MEASUREMENT
/begin MEASUREMENT DDRC_St.DFC_LinHdrTimeoutErrEBS "Debouncing counters / Debounce Timer or Event counter for check DFC_LinHdrTimeoutErrEBS" ULONG DFC_OneToOne 1 100 0.00 536870911.000 BIT_MASK 0x1fffffff FORMAT "%13.3" ECU_ADDRESS 0x60012D94 /end MEASUREMENT
/begin MEASUREMENT DDRC_St.DFC_LinMsgTimeoutErrACG "Debouncing counters / Debounce Timer or Event counter for check DFC_LinMsgTimeoutErrACG" ULONG DFC_OneToOne 1 100 0.00 536870911.000 BIT_MASK 0x1fffffff FORMAT "%13.3" ECU_ADDRESS 0x60012D98 /end MEASUREMENT
/begin MEASUREMENT DDRC_St.DFC_LinMsgTimeoutErrAEV "Debouncing counters / Debounce Timer or Event counter for check DFC_LinMsgTimeoutErrAEV" ULONG DFC_OneToOne 1 100 0.00 536870911.000 BIT_MASK 0x1fffffff FORMAT "%13.3" ECU_ADDRESS 0x60012D9C /end MEASUREMENT
/begin MEASUREMENT DDRC_St.DFC_LinMsgTimeoutErrDCDC "Debouncing counters / Debounce Timer or Event counter for check DFC_LinMsgTimeoutErrDCDC" ULONG DFC_OneToOne 1 100 0.00 536870911.000 BIT_MASK 0x1fffffff FORMAT "%13.3" ECU_ADDRESS 0x60012DA0 /end MEASUREMENT
/begin MEASUREMENT DDRC_St.DFC_LinMsgTimeoutErrEBS "Debouncing counters / Debounce Timer or Event counter for check DFC_LinMsgTimeoutErrEBS" ULONG DFC_OneToOne 1 100 0.00 536870911.000 BIT_MASK 0x1fffffff FORMAT "%13.3" ECU_ADDRESS 0x60012DA4 /end MEASUREMENT
/begin MEASUREMENT DDRC_St.DFC_LinNoStrtComErr "Debouncing counters / Debounce Timer or Event counter for check DFC_LinNoStrtComErr" ULONG DFC_OneToOne 1 100 0.00 536870911.000 BIT_MASK 0x1fffffff FORMAT "%13.3" ECU_ADDRESS 0x60012DA8 /end MEASUREMENT
/begin MEASUREMENT DDRC_St.DFC_LowPresOilP "Debouncing counters / Debounce Timer or Event counter for check DFC_LowPresOilP" ULONG DFC_OneToOne 1 100 0.00 536870911.000 BIT_MASK 0x1fffffff FORMAT "%13.3" ECU_ADDRESS 0x60012DAC /end MEASUREMENT
/begin MEASUREMENT DDRC_St.DFC_MisfDetVWhlFrntLeOORHi "Debouncing counters / Debounce Timer or Event counter for check DFC_MisfDetVWhlFrntLeOORHi" ULONG DFC_OneToOne 1 100 0.00 536870911.000 BIT_MASK 0x1fffffff FORMAT "%13.3" ECU_ADDRESS 0x60012DB0 /end MEASUREMENT
/begin MEASUREMENT DDRC_St.DFC_MisfDetVWhlFrntLeRatyHi "Debouncing counters / Debounce Timer or Event counter for check DFC_MisfDetVWhlFrntLeRatyHi" ULONG DFC_OneToOne 1 100 0.00 536870911.000 BIT_MASK 0x1fffffff FORMAT "%13.3" ECU_ADDRESS 0x60012DB4 /end MEASUREMENT
/begin MEASUREMENT DDRC_St.DFC_MisfDetVWhlFrntLeRatyLo "Debouncing counters / Debounce Timer or Event counter for check DFC_MisfDetVWhlFrntLeRatyLo" ULONG DFC_OneToOne 1 100 0.00 536870911.000 BIT_MASK 0x1fffffff FORMAT "%13.3" ECU_ADDRESS 0x60012DB8 /end MEASUREMENT
/begin MEASUREMENT DDRC_St.DFC_MisfDetVWhlFrntLeStuck "Debouncing counters / Debounce Timer or Event counter for check DFC_MisfDetVWhlFrntLeStuck" ULONG DFC_OneToOne 1 100 0.00 536870911.000 BIT_MASK 0x1fffffff FORMAT "%13.3" ECU_ADDRESS 0x60012DBC /end MEASUREMENT
/begin MEASUREMENT DDRC_St.DFC_MisfDetVWhlFrntRiOORHi "Debouncing counters / Debounce Timer or Event counter for check DFC_MisfDetVWhlFrntRiOORHi" ULONG DFC_OneToOne 1 100 0.00 536870911.000 BIT_MASK 0x1fffffff FORMAT "%13.3" ECU_ADDRESS 0x60012DC0 /end MEASUREMENT
/begin MEASUREMENT DDRC_St.DFC_MisfDetVWhlFrntRiRatyHi "Debouncing counters / Debounce Timer or Event counter for check DFC_MisfDetVWhlFrntRiRatyHi" ULONG DFC_OneToOne 1 100 0.00 536870911.000 BIT_MASK 0x1fffffff FORMAT "%13.3" ECU_ADDRESS 0x60012DC4 /end MEASUREMENT
/begin MEASUREMENT DDRC_St.DFC_MisfDetVWhlFrntRiRatyLo "Debouncing counters / Debounce Timer or Event counter for check DFC_MisfDetVWhlFrntRiRatyLo" ULONG DFC_OneToOne 1 100 0.00 536870911.000 BIT_MASK 0x1fffffff FORMAT "%13.3" ECU_ADDRESS 0x60012DC8 /end MEASUREMENT
/begin MEASUREMENT DDRC_St.DFC_MisfDetVWhlFrntRiStuck "Debouncing counters / Debounce Timer or Event counter for check DFC_MisfDetVWhlFrntRiStuck" ULONG DFC_OneToOne 1 100 0.00 536870911.000 BIT_MASK 0x1fffffff FORMAT "%13.3" ECU_ADDRESS 0x60012DCC /end MEASUREMENT
/begin MEASUREMENT DDRC_St.DFC_MisfDetVWhlReLeOORHi "Debouncing counters / Debounce Timer or Event counter for check DFC_MisfDetVWhlReLeOORHi" ULONG DFC_OneToOne 1 100 0.00 536870911.000 BIT_MASK 0x1fffffff FORMAT "%13.3" ECU_ADDRESS 0x60012DD0 /end MEASUREMENT
/begin MEASUREMENT DDRC_St.DFC_MisfDetVWhlReLeRatyHi "Debouncing counters / Debounce Timer or Event counter for check DFC_MisfDetVWhlReLeRatyHi" ULONG DFC_OneToOne 1 100 0.00 536870911.000 BIT_MASK 0x1fffffff FORMAT "%13.3" ECU_ADDRESS 0x60012DD4 /end MEASUREMENT
/begin MEASUREMENT DDRC_St.DFC_MisfDetVWhlReLeRatyLo "Debouncing counters / Debounce Timer or Event counter for check DFC_MisfDetVWhlReLeRatyLo" ULONG DFC_OneToOne 1 100 0.00 536870911.000 BIT_MASK 0x1fffffff FORMAT "%13.3" ECU_ADDRESS 0x60012DD8 /end MEASUREMENT
/begin MEASUREMENT DDRC_St.DFC_MisfDetVWhlReLeStuck "Debouncing counters / Debounce Timer or Event counter for check DFC_MisfDetVWhlReLeStuck" ULONG DFC_OneToOne 1 100 0.00 536870911.000 BIT_MASK 0x1fffffff FORMAT "%13.3" ECU_ADDRESS 0x60012DDC /end MEASUREMENT
/begin MEASUREMENT DDRC_St.DFC_MisfDetVWhlReRiOORHi "Debouncing counters / Debounce Timer or Event counter for check DFC_MisfDetVWhlReRiOORHi" ULONG DFC_OneToOne 1 100 0.00 536870911.000 BIT_MASK 0x1fffffff FORMAT "%13.3" ECU_ADDRESS 0x60012DE0 /end MEASUREMENT
/begin MEASUREMENT DDRC_St.DFC_MisfDetVWhlReRiRatyHi "Debouncing counters / Debounce Timer or Event counter for check DFC_MisfDetVWhlReRiRatyHi" ULONG DFC_OneToOne 1 100 0.00 536870911.000 BIT_MASK 0x1fffffff FORMAT "%13.3" ECU_ADDRESS 0x60012DE4 /end MEASUREMENT
/begin MEASUREMENT DDRC_St.DFC_MisfDetVWhlReRiRatyLo "Debouncing counters / Debounce Timer or Event counter for check DFC_MisfDetVWhlReRiRatyLo" ULONG DFC_OneToOne 1 100 0.00 536870911.000 BIT_MASK 0x1fffffff FORMAT "%13.3" ECU_ADDRESS 0x60012DE8 /end MEASUREMENT
/begin MEASUREMENT DDRC_St.DFC_MisfDetVWhlReRiStuck "Debouncing counters / Debounce Timer or Event counter for check DFC_MisfDetVWhlReRiStuck" ULONG DFC_OneToOne 1 100 0.00 536870911.000 BIT_MASK 0x1fffffff FORMAT "%13.3" ECU_ADDRESS 0x60012DEC /end MEASUREMENT
/begin MEASUREMENT DDRC_St.DFC_MisfDetdVWhlFrntLePlaus "Debouncing counters / Debounce Timer or Event counter for check DFC_MisfDetdVWhlFrntLePlaus" ULONG DFC_OneToOne 1 100 0.00 536870911.000 BIT_MASK 0x1fffffff FORMAT "%13.3" ECU_ADDRESS 0x60012DF0 /end MEASUREMENT
/begin MEASUREMENT DDRC_St.DFC_MisfDetdVWhlFrntRiPlaus "Debouncing counters / Debounce Timer or Event counter for check DFC_MisfDetdVWhlFrntRiPlaus" ULONG DFC_OneToOne 1 100 0.00 536870911.000 BIT_MASK 0x1fffffff FORMAT "%13.3" ECU_ADDRESS 0x60012DF4 /end MEASUREMENT
/begin MEASUREMENT DDRC_St.DFC_MisfDetdVWhlReLePlaus "Debouncing counters / Debounce Timer or Event counter for check DFC_MisfDetdVWhlReLePlaus" ULONG DFC_OneToOne 1 100 0.00 536870911.000 BIT_MASK 0x1fffffff FORMAT "%13.3" ECU_ADDRESS 0x60012DF8 /end MEASUREMENT
/begin MEASUREMENT DDRC_St.DFC_MisfDetdVWhlReRiPlaus "Debouncing counters / Debounce Timer or Event counter for check DFC_MisfDetdVWhlReRiPlaus" ULONG DFC_OneToOne 1 100 0.00 536870911.000 BIT_MASK 0x1fffffff FORMAT "%13.3" ECU_ADDRESS 0x60012DFC /end MEASUREMENT
/begin MEASUREMENT DDRC_St.DFC_PEnvSigRngMax "Debouncing counters / Debounce Timer or Event counter for check DFC_PEnvSigRngMax" ULONG DFC_OneToOne 1 100 0.00 536870911.000 BIT_MASK 0x1fffffff FORMAT "%13.3" ECU_ADDRESS 0x60012E00 /end MEASUREMENT
/begin MEASUREMENT DDRC_St.DFC_PEnvSigRngMin "Debouncing counters / Debounce Timer or Event counter for check DFC_PEnvSigRngMin" ULONG DFC_OneToOne 1 100 0.00 536870911.000 BIT_MASK 0x1fffffff FORMAT "%13.3" ECU_ADDRESS 0x60012E04 /end MEASUREMENT
/begin MEASUREMENT DDRC_St.DFC_StmFault "Debouncing counters / Debounce Timer or Event counter for check DFC_StmFault" ULONG DFC_OneToOne 1 100 0.00 536870911.000 BIT_MASK 0x1fffffff FORMAT "%13.3" ECU_ADDRESS 0x60012E08 /end MEASUREMENT
/begin MEASUREMENT DDRC_St.DFC_StrtCtOffPth "Debouncing counters / Debounce Timer or Event counter for check DFC_StrtCtOffPth" ULONG DFC_OneToOne 1 100 0.00 536870911.000 BIT_MASK 0x1fffffff FORMAT "%13.3" ECU_ADDRESS 0x60012E0C /end MEASUREMENT
/begin MEASUREMENT DDRC_St.DFC_StrtCtlErr "Debouncing counters / Debounce Timer or Event counter for check DFC_StrtCtlErr" ULONG DFC_OneToOne 1 100 0.00 536870911.000 BIT_MASK 0x1fffffff FORMAT "%13.3" ECU_ADDRESS 0x60012E10 /end MEASUREMENT
/begin MEASUREMENT DDRC_St.DFC_StrtFault "Debouncing counters / Debounce Timer or Event counter for check DFC_StrtFault" ULONG DFC_OneToOne 1 100 0.00 536870911.000 BIT_MASK 0x1fffffff FORMAT "%13.3" ECU_ADDRESS 0x60012E14 /end MEASUREMENT
/begin MEASUREMENT DDRC_St.DFC_StrtLckJudg1 "Debouncing counters / Debounce Timer or Event counter for check DFC_StrtLckJudg1" ULONG DFC_OneToOne 1 100 0.00 536870911.000 BIT_MASK 0x1fffffff FORMAT "%13.3" ECU_ADDRESS 0x60012E18 /end MEASUREMENT
/begin MEASUREMENT DDRC_St.DFC_StrtLckJudg2 "Debouncing counters / Debounce Timer or Event counter for check DFC_StrtLckJudg2" ULONG DFC_OneToOne 1 100 0.00 536870911.000 BIT_MASK 0x1fffffff FORMAT "%13.3" ECU_ADDRESS 0x60012E1C /end MEASUREMENT
/begin MEASUREMENT DDRC_St.DFC_StrtOL "Debouncing counters / Debounce Timer or Event counter for check DFC_StrtOL" ULONG DFC_OneToOne 1 100 0.00 536870911.000 BIT_MASK 0x1fffffff FORMAT "%13.3" ECU_ADDRESS 0x60012E20 /end MEASUREMENT
/begin MEASUREMENT DDRC_St.DFC_StrtOL2 "Debouncing counters / Debounce Timer or Event counter for check DFC_StrtOL2" ULONG DFC_OneToOne 1 100 0.00 536870911.000 BIT_MASK 0x1fffffff FORMAT "%13.3" ECU_ADDRESS 0x60012E24 /end MEASUREMENT
/begin MEASUREMENT DDRC_St.DFC_StrtSCB "Debouncing counters / Debounce Timer or Event counter for check DFC_StrtSCB" ULONG DFC_OneToOne 1 100 0.00 536870911.000 BIT_MASK 0x1fffffff FORMAT "%13.3" ECU_ADDRESS 0x60012E28 /end MEASUREMENT
/begin MEASUREMENT DDRC_St.DFC_StrtSCB2 "Debouncing counters / Debounce Timer or Event counter for check DFC_StrtSCB2" ULONG DFC_OneToOne 1 100 0.00 536870911.000 BIT_MASK 0x1fffffff FORMAT "%13.3" ECU_ADDRESS 0x60012E2C /end MEASUREMENT
/begin MEASUREMENT DDRC_St.DFC_StrtSCG "Debouncing counters / Debounce Timer or Event counter for check DFC_StrtSCG" ULONG DFC_OneToOne 1 100 0.00 536870911.000 BIT_MASK 0x1fffffff FORMAT "%13.3" ECU_ADDRESS 0x60012E30 /end MEASUREMENT
/begin MEASUREMENT DDRC_St.DFC_StrtSCG2 "Debouncing counters / Debounce Timer or Event counter for check DFC_StrtSCG2" ULONG DFC_OneToOne 1 100 0.00 536870911.000 BIT_MASK 0x1fffffff FORMAT "%13.3" ECU_ADDRESS 0x60012E34 /end MEASUREMENT
/begin MEASUREMENT DDRC_St.DFC_StrtStkRly1 "Debouncing counters / Debounce Timer or Event counter for check DFC_StrtStkRly1" ULONG DFC_OneToOne 1 100 0.00 536870911.000 BIT_MASK 0x1fffffff FORMAT "%13.3" ECU_ADDRESS 0x60012E38 /end MEASUREMENT
/begin MEASUREMENT DDRC_St.DFC_StrtStkRly2 "Debouncing counters / Debounce Timer or Event counter for check DFC_StrtStkRly2" ULONG DFC_OneToOne 1 100 0.00 536870911.000 BIT_MASK 0x1fffffff FORMAT "%13.3" ECU_ADDRESS 0x60012E3C /end MEASUREMENT
/begin MEASUREMENT DDRC_St.DFC_TEVEmax "Debouncing counters / Debounce Timer or Event counter for check DFC_TEVEmax" ULONG DFC_OneToOne 1 100 0.00 536870911.000 BIT_MASK 0x1fffffff FORMAT "%13.3" ECU_ADDRESS 0x60012E40 /end MEASUREMENT
/begin MEASUREMENT DDRC_St.DFC_TEVEmin "Debouncing counters / Debounce Timer or Event counter for check DFC_TEVEmin" ULONG DFC_OneToOne 1 100 0.00 536870911.000 BIT_MASK 0x1fffffff FORMAT "%13.3" ECU_ADDRESS 0x60012E44 /end MEASUREMENT
/begin MEASUREMENT DDRC_St.DFC_TEVEsig "Debouncing counters / Debounce Timer or Event counter for check DFC_TEVEsig" ULONG DFC_OneToOne 1 100 0.00 536870911.000 BIT_MASK 0x1fffffff FORMAT "%13.3" ECU_ADDRESS 0x60012E48 /end MEASUREMENT
/begin MEASUREMENT DDRC_St.DFC_UegoHeatrPrfmncLoS1B1 "Debouncing counters / Debounce Timer or Event counter for check DFC_UegoHeatrPrfmncLoS1B1" ULONG DFC_OneToOne 1 100 0.00 536870911.000 BIT_MASK 0x1fffffff FORMAT "%13.3" ECU_ADDRESS 0x60012E4C /end MEASUREMENT
/begin MEASUREMENT DDRC_St.DFC_VehVAllPlaus "Debouncing counters / Debounce Timer or Event counter for check DFC_VehVAllPlaus" ULONG DFC_OneToOne 1 100 0.00 536870911.000 BIT_MASK 0x1fffffff FORMAT "%13.3" ECU_ADDRESS 0x60012E50 /end MEASUREMENT
/begin MEASUREMENT DDRC_St.DFC_VehVNCSnsrElecFailr "Debouncing counters / Debounce Timer or Event counter for check DFC_VehVNCSnsrElecFailr" ULONG DFC_OneToOne 1 100 0.00 536870911.000 BIT_MASK 0x1fffffff FORMAT "%13.3" ECU_ADDRESS 0x60012E54 /end MEASUREMENT
/begin MEASUREMENT DDRC_St.DFC_VehVPlausCan "Debouncing counters / Debounce Timer or Event counter for check DFC_VehVPlausCan" ULONG DFC_OneToOne 1 100 0.00 536870911.000 BIT_MASK 0x1fffffff FORMAT "%13.3" ECU_ADDRESS 0x60012E58 /end MEASUREMENT
/begin MEASUREMENT DDRC_St.DFC_VehVPlausFco "Debouncing counters / Debounce Timer or Event counter for check DFC_VehVPlausFco" ULONG DFC_OneToOne 1 100 0.00 536870911.000 BIT_MASK 0x1fffffff FORMAT "%13.3" ECU_ADDRESS 0x60012E5C /end MEASUREMENT
/begin MEASUREMENT DDRC_St.DFC_VehVPlausPwr "Debouncing counters / Debounce Timer or Event counter for check DFC_VehVPlausPwr" ULONG DFC_OneToOne 1 100 0.00 536870911.000 BIT_MASK 0x1fffffff FORMAT "%13.3" ECU_ADDRESS 0x60012E60 /end MEASUREMENT
/begin MEASUREMENT DDRC_St.DFC_VehVPlausV2N "Debouncing counters / Debounce Timer or Event counter for check DFC_VehVPlausV2N" ULONG DFC_OneToOne 1 100 0.00 536870911.000 BIT_MASK 0x1fffffff FORMAT "%13.3" ECU_ADDRESS 0x60012E64 /end MEASUREMENT
/begin MEASUREMENT DDRC_St.DFC_VehVSpdSnsrAElecFailr "Debouncing counters / Debounce Timer or Event counter for check DFC_VehVSpdSnsrAElecFailr" ULONG DFC_OneToOne 1 100 0.00 536870911.000 BIT_MASK 0x1fffffff FORMAT "%13.3" ECU_ADDRESS 0x60012E68 /end MEASUREMENT
/begin MEASUREMENT DDRC_St.DFC_VehVSpdSnsrBElecFailr "Debouncing counters / Debounce Timer or Event counter for check DFC_VehVSpdSnsrBElecFailr" ULONG DFC_OneToOne 1 100 0.00 536870911.000 BIT_MASK 0x1fffffff FORMAT "%13.3" ECU_ADDRESS 0x60012E6C /end MEASUREMENT
/begin MEASUREMENT DDRC_St.DFC_ClthMax "Debouncing counters / Debounce Timer or Event counter for check DFC_ClthMax" ULONG DFC_OneToOne 1 100 0.00 536870911.000 BIT_MASK 0x1fffffff FORMAT "%13.3" ECU_ADDRESS 0x60012E70 /end MEASUREMENT
/begin MEASUREMENT DDRC_St.DFC_IgnClPs_DevComErr "Debouncing counters / Debounce Timer or Event counter for check DFC_IgnClPs_DevComErr" ULONG DFC_OneToOne 1 100 0.00 536870911.000 BIT_MASK 0x1fffffff FORMAT "%13.3" ECU_ADDRESS 0x60012E74 /end MEASUREMENT
/begin MEASUREMENT DDRC_St.DFC_IgnClPs_LineOl_0 "Debouncing counters / Debounce Timer or Event counter for check DFC_IgnClPs_LineOl_0" ULONG DFC_OneToOne 1 100 0.00 536870911.000 BIT_MASK 0x1fffffff FORMAT "%13.3" ECU_ADDRESS 0x60012E78 /end MEASUREMENT
/begin MEASUREMENT DDRC_St.DFC_IgnClPs_LineOl_1 "Debouncing counters / Debounce Timer or Event counter for check DFC_IgnClPs_LineOl_1" ULONG DFC_OneToOne 1 100 0.00 536870911.000 BIT_MASK 0x1fffffff FORMAT "%13.3" ECU_ADDRESS 0x60012E7C /end MEASUREMENT
/begin MEASUREMENT DDRC_St.DFC_IgnClPs_LineOl_2 "Debouncing counters / Debounce Timer or Event counter for check DFC_IgnClPs_LineOl_2" ULONG DFC_OneToOne 1 100 0.00 536870911.000 BIT_MASK 0x1fffffff FORMAT "%13.3" ECU_ADDRESS 0x60012E80 /end MEASUREMENT
/begin MEASUREMENT DDRC_St.DFC_IgnClPs_LineOl_3 "Debouncing counters / Debounce Timer or Event counter for check DFC_IgnClPs_LineOl_3" ULONG DFC_OneToOne 1 100 0.00 536870911.000 BIT_MASK 0x1fffffff FORMAT "%13.3" ECU_ADDRESS 0x60012E84 /end MEASUREMENT
/begin MEASUREMENT DDRC_St.DFC_IgnClPs_LineScb_0 "Debouncing counters / Debounce Timer or Event counter for check DFC_IgnClPs_LineScb_0" ULONG DFC_OneToOne 1 100 0.00 536870911.000 BIT_MASK 0x1fffffff FORMAT "%13.3" ECU_ADDRESS 0x60012E88 /end MEASUREMENT
/begin MEASUREMENT DDRC_St.DFC_IgnClPs_LineScb_1 "Debouncing counters / Debounce Timer or Event counter for check DFC_IgnClPs_LineScb_1" ULONG DFC_OneToOne 1 100 0.00 536870911.000 BIT_MASK 0x1fffffff FORMAT "%13.3" ECU_ADDRESS 0x60012E8C /end MEASUREMENT
/begin MEASUREMENT DDRC_St.DFC_IgnClPs_LineScb_2 "Debouncing counters / Debounce Timer or Event counter for check DFC_IgnClPs_LineScb_2" ULONG DFC_OneToOne 1 100 0.00 536870911.000 BIT_MASK 0x1fffffff FORMAT "%13.3" ECU_ADDRESS 0x60012E90 /end MEASUREMENT
/begin MEASUREMENT DDRC_St.DFC_IgnClPs_LineScb_3 "Debouncing counters / Debounce Timer or Event counter for check DFC_IgnClPs_LineScb_3" ULONG DFC_OneToOne 1 100 0.00 536870911.000 BIT_MASK 0x1fffffff FORMAT "%13.3" ECU_ADDRESS 0x60012E94 /end MEASUREMENT
/begin MEASUREMENT DDRC_St.DFC_IgnClPs_LineScg_0 "Debouncing counters / Debounce Timer or Event counter for check DFC_IgnClPs_LineScg_0" ULONG DFC_OneToOne 1 100 0.00 536870911.000 BIT_MASK 0x1fffffff FORMAT "%13.3" ECU_ADDRESS 0x60012E98 /end MEASUREMENT
/begin MEASUREMENT DDRC_St.DFC_IgnClPs_LineScg_1 "Debouncing counters / Debounce Timer or Event counter for check DFC_IgnClPs_LineScg_1" ULONG DFC_OneToOne 1 100 0.00 536870911.000 BIT_MASK 0x1fffffff FORMAT "%13.3" ECU_ADDRESS 0x60012E9C /end MEASUREMENT
/begin MEASUREMENT DDRC_St.DFC_IgnClPs_LineScg_2 "Debouncing counters / Debounce Timer or Event counter for check DFC_IgnClPs_LineScg_2" ULONG DFC_OneToOne 1 100 0.00 536870911.000 BIT_MASK 0x1fffffff FORMAT "%13.3" ECU_ADDRESS 0x60012EA0 /end MEASUREMENT
/begin MEASUREMENT DDRC_St.DFC_IgnClPs_LineScg_3 "Debouncing counters / Debounce Timer or Event counter for check DFC_IgnClPs_LineScg_3" ULONG DFC_OneToOne 1 100 0.00 536870911.000 BIT_MASK 0x1fffffff FORMAT "%13.3" ECU_ADDRESS 0x60012EA4 /end MEASUREMENT
/begin MEASUREMENT DDRC_St.DFC_KRVEKOEVAB "Debouncing counters / Debounce Timer or Event counter for check DFC_KRVEKOEVAB" ULONG DFC_OneToOne 1 100 0.00 536870911.000 BIT_MASK 0x1fffffff FORMAT "%13.3" ECU_ADDRESS 0x60012EA8 /end MEASUREMENT
/begin MEASUREMENT DDRC_St.DFC_KRVEKOEVAB0 "Debouncing counters / Debounce Timer or Event counter for check DFC_KRVEKOEVAB0" ULONG DFC_OneToOne 1 100 0.00 536870911.000 BIT_MASK 0x1fffffff FORMAT "%13.3" ECU_ADDRESS 0x60012EAC /end MEASUREMENT
/begin MEASUREMENT DDRC_St.DFC_KRVEKOEVAB1 "Debouncing counters / Debounce Timer or Event counter for check DFC_KRVEKOEVAB1" ULONG DFC_OneToOne 1 100 0.00 536870911.000 BIT_MASK 0x1fffffff FORMAT "%13.3" ECU_ADDRESS 0x60012EB0 /end MEASUREMENT
/begin MEASUREMENT DDRC_St.DFC_KRVEKOEVAB2 "Debouncing counters / Debounce Timer or Event counter for check DFC_KRVEKOEVAB2" ULONG DFC_OneToOne 1 100 0.00 536870911.000 BIT_MASK 0x1fffffff FORMAT "%13.3" ECU_ADDRESS 0x60012EB4 /end MEASUREMENT
/begin MEASUREMENT DDRC_St.DFC_KRVEKOEVAB3 "Debouncing counters / Debounce Timer or Event counter for check DFC_KRVEKOEVAB3" ULONG DFC_OneToOne 1 100 0.00 536870911.000 BIT_MASK 0x1fffffff FORMAT "%13.3" ECU_ADDRESS 0x60012EB8 /end MEASUREMENT
/begin MEASUREMENT DDRC_St.DFC_UegoSigEcuAsicS1B1 "Debouncing counters / Debounce Timer or Event counter for check DFC_UegoSigEcuAsicS1B1" ULONG DFC_OneToOne 1 100 0.00 536870911.000 BIT_MASK 0x1fffffff FORMAT "%13.3" ECU_ADDRESS 0x60012EBC /end MEASUREMENT
/begin MEASUREMENT DDRC_St.DFC_UegoSigEcuComS1B1 "Debouncing counters / Debounce Timer or Event counter for check DFC_UegoSigEcuComS1B1" ULONG DFC_OneToOne 1 100 0.00 536870911.000 BIT_MASK 0x1fffffff FORMAT "%13.3" ECU_ADDRESS 0x60012EC0 /end MEASUREMENT
/begin MEASUREMENT DDRC_St.DFC_UegoSigSnsrS1B1 "Debouncing counters / Debounce Timer or Event counter for check DFC_UegoSigSnsrS1B1" ULONG DFC_OneToOne 1 100 0.00 536870911.000 BIT_MASK 0x1fffffff FORMAT "%13.3" ECU_ADDRESS 0x60012EC4 /end MEASUREMENT
/begin MEASUREMENT DDRC_St.DFC_UegoSigWireOlApesS1B1 "Debouncing counters / Debounce Timer or Event counter for check DFC_UegoSigWireOlApesS1B1" ULONG DFC_OneToOne 1 100 0.00 536870911.000 BIT_MASK 0x1fffffff FORMAT "%13.3" ECU_ADDRESS 0x60012EC8 /end MEASUREMENT
/begin MEASUREMENT DDRC_St.DFC_UegoSigWireOlIpeS1B1 "Debouncing counters / Debounce Timer or Event counter for check DFC_UegoSigWireOlIpeS1B1" ULONG DFC_OneToOne 1 100 0.00 536870911.000 BIT_MASK 0x1fffffff FORMAT "%13.3" ECU_ADDRESS 0x60012ECC /end MEASUREMENT
/begin MEASUREMENT DDRC_St.DFC_UegoSigWireOlReS1B1 "Debouncing counters / Debounce Timer or Event counter for check DFC_UegoSigWireOlReS1B1" ULONG DFC_OneToOne 1 100 0.00 536870911.000 BIT_MASK 0x1fffffff FORMAT "%13.3" ECU_ADDRESS 0x60012ED0 /end MEASUREMENT
/begin MEASUREMENT DDRC_St.DFC_UegoSigWireRCmpS1B1 "Debouncing counters / Debounce Timer or Event counter for check DFC_UegoSigWireRCmpS1B1" ULONG DFC_OneToOne 1 100 0.00 536870911.000 BIT_MASK 0x1fffffff FORMAT "%13.3" ECU_ADDRESS 0x60012ED4 /end MEASUREMENT
/begin MEASUREMENT DDRC_St.DFC_UegoSigWireScbS1B1 "Debouncing counters / Debounce Timer or Event counter for check DFC_UegoSigWireScbS1B1" ULONG DFC_OneToOne 1 100 0.00 536870911.000 BIT_MASK 0x1fffffff FORMAT "%13.3" ECU_ADDRESS 0x60012ED8 /end MEASUREMENT
/begin MEASUREMENT DDRC_St.DFC_UegoSigWireScgS1B1 "Debouncing counters / Debounce Timer or Event counter for check DFC_UegoSigWireScgS1B1" ULONG DFC_OneToOne 1 100 0.00 536870911.000 BIT_MASK 0x1fffffff FORMAT "%13.3" ECU_ADDRESS 0x60012EDC /end MEASUREMENT
/begin MEASUREMENT DDRC_St.DFC_AfsPhyRngHiB1 "Debouncing counters / Debounce Timer or Event counter for check DFC_AfsPhyRngHiB1" ULONG DFC_OneToOne 1 100 0.00 536870911.000 BIT_MASK 0x1fffffff FORMAT "%13.3" ECU_ADDRESS 0x60012EE0 /end MEASUREMENT
/begin MEASUREMENT DDRC_St.DFC_AfsPhyRngLoB1 "Debouncing counters / Debounce Timer or Event counter for check DFC_AfsPhyRngLoB1" ULONG DFC_OneToOne 1 100 0.00 536870911.000 BIT_MASK 0x1fffffff FORMAT "%13.3" ECU_ADDRESS 0x60012EE4 /end MEASUREMENT
/begin MEASUREMENT DDRC_St.DFC_AirCCmprOL "Debouncing counters / Debounce Timer or Event counter for check DFC_AirCCmprOL" ULONG DFC_OneToOne 1 100 0.00 536870911.000 BIT_MASK 0x1fffffff FORMAT "%13.3" ECU_ADDRESS 0x60012EE8 /end MEASUREMENT
/begin MEASUREMENT DDRC_St.DFC_AirCCmprOvrTemp "Debouncing counters / Debounce Timer or Event counter for check DFC_AirCCmprOvrTemp" ULONG DFC_OneToOne 1 100 0.00 536870911.000 BIT_MASK 0x1fffffff FORMAT "%13.3" ECU_ADDRESS 0x60012EEC /end MEASUREMENT
/begin MEASUREMENT DDRC_St.DFC_AirCCmprSCB "Debouncing counters / Debounce Timer or Event counter for check DFC_AirCCmprSCB" ULONG DFC_OneToOne 1 100 0.00 536870911.000 BIT_MASK 0x1fffffff FORMAT "%13.3" ECU_ADDRESS 0x60012EF0 /end MEASUREMENT
/begin MEASUREMENT DDRC_St.DFC_AirCCmprSCG "Debouncing counters / Debounce Timer or Event counter for check DFC_AirCCmprSCG" ULONG DFC_OneToOne 1 100 0.00 536870911.000 BIT_MASK 0x1fffffff FORMAT "%13.3" ECU_ADDRESS 0x60012EF4 /end MEASUREMENT
/begin MEASUREMENT DDRC_St.DFC_AltErr "Debouncing counters / Debounce Timer or Event counter for check DFC_AltErr" ULONG DFC_OneToOne 1 100 0.00 536870911.000 BIT_MASK 0x1fffffff FORMAT "%13.3" ECU_ADDRESS 0x60012EF8 /end MEASUREMENT
/begin MEASUREMENT DDRC_St.DFC_BattUSRCMax "Debouncing counters / Debounce Timer or Event counter for check DFC_BattUSRCMax" ULONG DFC_OneToOne 1 100 0.00 536870911.000 BIT_MASK 0x1fffffff FORMAT "%13.3" ECU_ADDRESS 0x60012EFC /end MEASUREMENT
/begin MEASUREMENT DDRC_St.DFC_BattUSRCMin "Debouncing counters / Debounce Timer or Event counter for check DFC_BattUSRCMin" ULONG DFC_OneToOne 1 100 0.00 536870911.000 BIT_MASK 0x1fffffff FORMAT "%13.3" ECU_ADDRESS 0x60012F00 /end MEASUREMENT
/begin MEASUREMENT DDRC_St.DFC_ComChksTCU1 "Debouncing counters / Debounce Timer or Event counter for check DFC_ComChksTCU1" ULONG DFC_OneToOne 1 100 0.00 536870911.000 BIT_MASK 0x1fffffff FORMAT "%13.3" ECU_ADDRESS 0x60012F04 /end MEASUREMENT
/begin MEASUREMENT DDRC_St.DFC_ComChksTCU11 "Debouncing counters / Debounce Timer or Event counter for check DFC_ComChksTCU11" ULONG DFC_OneToOne 1 100 0.00 536870911.000 BIT_MASK 0x1fffffff FORMAT "%13.3" ECU_ADDRESS 0x60012F08 /end MEASUREMENT
/begin MEASUREMENT DDRC_St.DFC_ComChksTCU12 "Debouncing counters / Debounce Timer or Event counter for check DFC_ComChksTCU12" ULONG DFC_OneToOne 1 100 0.00 536870911.000 BIT_MASK 0x1fffffff FORMAT "%13.3" ECU_ADDRESS 0x60012F0C /end MEASUREMENT
/begin MEASUREMENT DDRC_St.DFC_ComChksTCU13 "Debouncing counters / Debounce Timer or Event counter for check DFC_ComChksTCU13" ULONG DFC_OneToOne 1 100 0.00 536870911.000 BIT_MASK 0x1fffffff FORMAT "%13.3" ECU_ADDRESS 0x60012F10 /end MEASUREMENT
/begin MEASUREMENT DDRC_St.DFC_ComChksTCU2 "Debouncing counters / Debounce Timer or Event counter for check DFC_ComChksTCU2" ULONG DFC_OneToOne 1 100 0.00 536870911.000 BIT_MASK 0x1fffffff FORMAT "%13.3" ECU_ADDRESS 0x60012F14 /end MEASUREMENT
/begin MEASUREMENT DDRC_St.DFC_ComChksTCU3 "Debouncing counters / Debounce Timer or Event counter for check DFC_ComChksTCU3" ULONG DFC_OneToOne 1 100 0.00 536870911.000 BIT_MASK 0x1fffffff FORMAT "%13.3" ECU_ADDRESS 0x60012F18 /end MEASUREMENT
/begin MEASUREMENT DDRC_St.DFC_ComChksTCU4 "Debouncing counters / Debounce Timer or Event counter for check DFC_ComChksTCU4" ULONG DFC_OneToOne 1 100 0.00 536870911.000 BIT_MASK 0x1fffffff FORMAT "%13.3" ECU_ADDRESS 0x60012F1C /end MEASUREMENT
/begin MEASUREMENT DDRC_St.DFC_ComCntTCU1 "Debouncing counters / Debounce Timer or Event counter for check DFC_ComCntTCU1" ULONG DFC_OneToOne 1 100 0.00 536870911.000 BIT_MASK 0x1fffffff FORMAT "%13.3" ECU_ADDRESS 0x60012F20 /end MEASUREMENT
/begin MEASUREMENT DDRC_St.DFC_ComCntTCU11 "Debouncing counters / Debounce Timer or Event counter for check DFC_ComCntTCU11" ULONG DFC_OneToOne 1 100 0.00 536870911.000 BIT_MASK 0x1fffffff FORMAT "%13.3" ECU_ADDRESS 0x60012F24 /end MEASUREMENT
/begin MEASUREMENT DDRC_St.DFC_ComCntTCU12 "Debouncing counters / Debounce Timer or Event counter for check DFC_ComCntTCU12" ULONG DFC_OneToOne 1 100 0.00 536870911.000 BIT_MASK 0x1fffffff FORMAT "%13.3" ECU_ADDRESS 0x60012F28 /end MEASUREMENT
/begin MEASUREMENT DDRC_St.DFC_ComCntTCU13 "Debouncing counters / Debounce Timer or Event counter for check DFC_ComCntTCU13" ULONG DFC_OneToOne 1 100 0.00 536870911.000 BIT_MASK 0x1fffffff FORMAT "%13.3" ECU_ADDRESS 0x60012F2C /end MEASUREMENT
/begin MEASUREMENT DDRC_St.DFC_ComCntTCU2 "Debouncing counters / Debounce Timer or Event counter for check DFC_ComCntTCU2" ULONG DFC_OneToOne 1 100 0.00 536870911.000 BIT_MASK 0x1fffffff FORMAT "%13.3" ECU_ADDRESS 0x60012F30 /end MEASUREMENT
/begin MEASUREMENT DDRC_St.DFC_ComCntTCU3 "Debouncing counters / Debounce Timer or Event counter for check DFC_ComCntTCU3" ULONG DFC_OneToOne 1 100 0.00 536870911.000 BIT_MASK 0x1fffffff FORMAT "%13.3" ECU_ADDRESS 0x60012F34 /end MEASUREMENT
/begin MEASUREMENT DDRC_St.DFC_ComCntTCU4 "Debouncing counters / Debounce Timer or Event counter for check DFC_ComCntTCU4" ULONG DFC_OneToOne 1 100 0.00 536870911.000 BIT_MASK 0x1fffffff FORMAT "%13.3" ECU_ADDRESS 0x60012F38 /end MEASUREMENT
/begin MEASUREMENT DDRC_St.DFC_ComTOutTCU01 "Debouncing counters / Debounce Timer or Event counter for check DFC_ComTOutTCU01" ULONG DFC_OneToOne 1 100 0.00 536870911.000 BIT_MASK 0x1fffffff FORMAT "%13.3" ECU_ADDRESS 0x60012F3C /end MEASUREMENT
/begin MEASUREMENT DDRC_St.DFC_ComTOutTCU02 "Debouncing counters / Debounce Timer or Event counter for check DFC_ComTOutTCU02" ULONG DFC_OneToOne 1 100 0.00 536870911.000 BIT_MASK 0x1fffffff FORMAT "%13.3" ECU_ADDRESS 0x60012F40 /end MEASUREMENT
/begin MEASUREMENT DDRC_St.DFC_ComTOutTCU1 "Debouncing counters / Debounce Timer or Event counter for check DFC_ComTOutTCU1" ULONG DFC_OneToOne 1 100 0.00 536870911.000 BIT_MASK 0x1fffffff FORMAT "%13.3" ECU_ADDRESS 0x60012F44 /end MEASUREMENT
/begin MEASUREMENT DDRC_St.DFC_ComTOutTCU11 "Debouncing counters / Debounce Timer or Event counter for check DFC_ComTOutTCU11" ULONG DFC_OneToOne 1 100 0.00 536870911.000 BIT_MASK 0x1fffffff FORMAT "%13.3" ECU_ADDRESS 0x60012F48 /end MEASUREMENT
/begin MEASUREMENT DDRC_St.DFC_ComTOutTCU12 "Debouncing counters / Debounce Timer or Event counter for check DFC_ComTOutTCU12" ULONG DFC_OneToOne 1 100 0.00 536870911.000 BIT_MASK 0x1fffffff FORMAT "%13.3" ECU_ADDRESS 0x60012F4C /end MEASUREMENT
/begin MEASUREMENT DDRC_St.DFC_ComTOutTCU13 "Debouncing counters / Debounce Timer or Event counter for check DFC_ComTOutTCU13" ULONG DFC_OneToOne 1 100 0.00 536870911.000 BIT_MASK 0x1fffffff FORMAT "%13.3" ECU_ADDRESS 0x60012F50 /end MEASUREMENT
/begin MEASUREMENT DDRC_St.DFC_ComTOutTCU14 "Debouncing counters / Debounce Timer or Event counter for check DFC_ComTOutTCU14" ULONG DFC_OneToOne 1 100 0.00 536870911.000 BIT_MASK 0x1fffffff FORMAT "%13.3" ECU_ADDRESS 0x60012F54 /end MEASUREMENT
/begin MEASUREMENT DDRC_St.DFC_ComTOutTCU2 "Debouncing counters / Debounce Timer or Event counter for check DFC_ComTOutTCU2" ULONG DFC_OneToOne 1 100 0.00 536870911.000 BIT_MASK 0x1fffffff FORMAT "%13.3" ECU_ADDRESS 0x60012F58 /end MEASUREMENT
/begin MEASUREMENT DDRC_St.DFC_ComTOutTCU3 "Debouncing counters / Debounce Timer or Event counter for check DFC_ComTOutTCU3" ULONG DFC_OneToOne 1 100 0.00 536870911.000 BIT_MASK 0x1fffffff FORMAT "%13.3" ECU_ADDRESS 0x60012F5C /end MEASUREMENT
/begin MEASUREMENT DDRC_St.DFC_ComTOutTCU4 "Debouncing counters / Debounce Timer or Event counter for check DFC_ComTOutTCU4" ULONG DFC_OneToOne 1 100 0.00 536870911.000 BIT_MASK 0x1fffffff FORMAT "%13.3" ECU_ADDRESS 0x60012F60 /end MEASUREMENT
/begin MEASUREMENT DDRC_St.DFC_DevLibBattUHi "Debouncing counters / Debounce Timer or Event counter for check DFC_DevLibBattUHi" ULONG DFC_OneToOne 1 100 0.00 536870911.000 BIT_MASK 0x1fffffff FORMAT "%13.3" ECU_ADDRESS 0x60012F64 /end MEASUREMENT
/begin MEASUREMENT DDRC_St.DFC_DevLibBattULo "Debouncing counters / Debounce Timer or Event counter for check DFC_DevLibBattULo" ULONG DFC_OneToOne 1 100 0.00 536870911.000 BIT_MASK 0x1fffffff FORMAT "%13.3" ECU_ADDRESS 0x60012F68 /end MEASUREMENT
/begin MEASUREMENT DDRC_St.DFC_EGRVlvFailSafeActv "Debouncing counters / Debounce Timer or Event counter for check DFC_EGRVlvFailSafeActv" ULONG DFC_OneToOne 1 100 0.00 536870911.000 BIT_MASK 0x1fffffff FORMAT "%13.3" ECU_ADDRESS 0x60012F6C /end MEASUREMENT
/begin MEASUREMENT DDRC_St.DFC_EGRVlvGovDvtCld "Debouncing counters / Debounce Timer or Event counter for check DFC_EGRVlvGovDvtCld" ULONG DFC_OneToOne 1 100 0.00 536870911.000 BIT_MASK 0x1fffffff FORMAT "%13.3" ECU_ADDRESS 0x60012F70 /end MEASUREMENT
/begin MEASUREMENT DDRC_St.DFC_EGRVlvPhysSRCMax "Debouncing counters / Debounce Timer or Event counter for check DFC_EGRVlvPhysSRCMax" ULONG DFC_OneToOne 1 100 0.00 536870911.000 BIT_MASK 0x1fffffff FORMAT "%13.3" ECU_ADDRESS 0x60012F74 /end MEASUREMENT
/begin MEASUREMENT DDRC_St.DFC_EGRVlvPhysSRCMin "Debouncing counters / Debounce Timer or Event counter for check DFC_EGRVlvPhysSRCMin" ULONG DFC_OneToOne 1 100 0.00 536870911.000 BIT_MASK 0x1fffffff FORMAT "%13.3" ECU_ADDRESS 0x60012F78 /end MEASUREMENT
/begin MEASUREMENT DDRC_St.DFC_FanDIOOL_0 "Debouncing counters / Debounce Timer or Event counter for check DFC_FanDIOOL_0" ULONG DFC_OneToOne 1 100 0.00 536870911.000 BIT_MASK 0x1fffffff FORMAT "%13.3" ECU_ADDRESS 0x60012F7C /end MEASUREMENT
/begin MEASUREMENT DDRC_St.DFC_FanDIOOL_1 "Debouncing counters / Debounce Timer or Event counter for check DFC_FanDIOOL_1" ULONG DFC_OneToOne 1 100 0.00 536870911.000 BIT_MASK 0x1fffffff FORMAT "%13.3" ECU_ADDRESS 0x60012F80 /end MEASUREMENT
/begin MEASUREMENT DDRC_St.DFC_FanDIOOvrTemp_0 "Debouncing counters / Debounce Timer or Event counter for check DFC_FanDIOOvrTemp_0" ULONG DFC_OneToOne 1 100 0.00 536870911.000 BIT_MASK 0x1fffffff FORMAT "%13.3" ECU_ADDRESS 0x60012F84 /end MEASUREMENT
/begin MEASUREMENT DDRC_St.DFC_FanDIOOvrTemp_1 "Debouncing counters / Debounce Timer or Event counter for check DFC_FanDIOOvrTemp_1" ULONG DFC_OneToOne 1 100 0.00 536870911.000 BIT_MASK 0x1fffffff FORMAT "%13.3" ECU_ADDRESS 0x60012F88 /end MEASUREMENT
/begin MEASUREMENT DDRC_St.DFC_FanDIOSCB_0 "Debouncing counters / Debounce Timer or Event counter for check DFC_FanDIOSCB_0" ULONG DFC_OneToOne 1 100 0.00 536870911.000 BIT_MASK 0x1fffffff FORMAT "%13.3" ECU_ADDRESS 0x60012F8C /end MEASUREMENT
/begin MEASUREMENT DDRC_St.DFC_FanDIOSCB_1 "Debouncing counters / Debounce Timer or Event counter for check DFC_FanDIOSCB_1" ULONG DFC_OneToOne 1 100 0.00 536870911.000 BIT_MASK 0x1fffffff FORMAT "%13.3" ECU_ADDRESS 0x60012F90 /end MEASUREMENT
/begin MEASUREMENT DDRC_St.DFC_FanDIOSCG_0 "Debouncing counters / Debounce Timer or Event counter for check DFC_FanDIOSCG_0" ULONG DFC_OneToOne 1 100 0.00 536870911.000 BIT_MASK 0x1fffffff FORMAT "%13.3" ECU_ADDRESS 0x60012F94 /end MEASUREMENT
/begin MEASUREMENT DDRC_St.DFC_FanDIOSCG_1 "Debouncing counters / Debounce Timer or Event counter for check DFC_FanDIOSCG_1" ULONG DFC_OneToOne 1 100 0.00 536870911.000 BIT_MASK 0x1fffffff FORMAT "%13.3" ECU_ADDRESS 0x60012F98 /end MEASUREMENT
/begin MEASUREMENT DDRC_St.DFC_MRlyDcOL "Debouncing counters / Debounce Timer or Event counter for check DFC_MRlyDcOL" ULONG DFC_OneToOne 1 100 0.00 536870911.000 BIT_MASK 0x1fffffff FORMAT "%13.3" ECU_ADDRESS 0x60012F9C /end MEASUREMENT
/begin MEASUREMENT DDRC_St.DFC_MRlyDcSCB "Debouncing counters / Debounce Timer or Event counter for check DFC_MRlyDcSCB" ULONG DFC_OneToOne 1 100 0.00 536870911.000 BIT_MASK 0x1fffffff FORMAT "%13.3" ECU_ADDRESS 0x60012FA0 /end MEASUREMENT
/begin MEASUREMENT DDRC_St.DFC_MRlyDcSCG "Debouncing counters / Debounce Timer or Event counter for check DFC_MRlyDcSCG" ULONG DFC_OneToOne 1 100 0.00 536870911.000 BIT_MASK 0x1fffffff FORMAT "%13.3" ECU_ADDRESS 0x60012FA4 /end MEASUREMENT
/begin MEASUREMENT DDRC_St.DFC_PSPOL "Debouncing counters / Debounce Timer or Event counter for check DFC_PSPOL" ULONG DFC_OneToOne 1 100 0.00 536870911.000 BIT_MASK 0x1fffffff FORMAT "%13.3" ECU_ADDRESS 0x60012FA8 /end MEASUREMENT
/begin MEASUREMENT DDRC_St.DFC_PSPOvrTemp "Debouncing counters / Debounce Timer or Event counter for check DFC_PSPOvrTemp" ULONG DFC_OneToOne 1 100 0.00 536870911.000 BIT_MASK 0x1fffffff FORMAT "%13.3" ECU_ADDRESS 0x60012FAC /end MEASUREMENT
/begin MEASUREMENT DDRC_St.DFC_PSPSCB "Debouncing counters / Debounce Timer or Event counter for check DFC_PSPSCB" ULONG DFC_OneToOne 1 100 0.00 536870911.000 BIT_MASK 0x1fffffff FORMAT "%13.3" ECU_ADDRESS 0x60012FB0 /end MEASUREMENT
/begin MEASUREMENT DDRC_St.DFC_PSPSCG "Debouncing counters / Debounce Timer or Event counter for check DFC_PSPSCG" ULONG DFC_OneToOne 1 100 0.00 536870911.000 BIT_MASK 0x1fffffff FORMAT "%13.3" ECU_ADDRESS 0x60012FB4 /end MEASUREMENT
/begin MEASUREMENT DDRC_St.DFC_T50Err "Debouncing counters / Debounce Timer or Event counter for check DFC_T50Err" ULONG DFC_OneToOne 1 100 0.00 536870911.000 BIT_MASK 0x1fffffff FORMAT "%13.3" ECU_ADDRESS 0x60012FB8 /end MEASUREMENT
/begin MEASUREMENT DDRC_St.DFC_ThrVlvLoBattB1 "Debouncing counters / Debounce Timer or Event counter for check DFC_ThrVlvLoBattB1" ULONG DFC_OneToOne 1 100 0.00 536870911.000 BIT_MASK 0x1fffffff FORMAT "%13.3" ECU_ADDRESS 0x60012FBC /end MEASUREMENT
/begin MEASUREMENT DDRC_St.DFC_UegoSigOperPlausS1B1 "Debouncing counters / Debounce Timer or Event counter for check DFC_UegoSigOperPlausS1B1" ULONG DFC_OneToOne 1 100 0.00 536870911.000 BIT_MASK 0x1fffffff FORMAT "%13.3" ECU_ADDRESS 0x60012FC0 /end MEASUREMENT
/begin MEASUREMENT DDRC_St.DFC_VehVPhysRngHi "Debouncing counters / Debounce Timer or Event counter for check DFC_VehVPhysRngHi" ULONG DFC_OneToOne 1 100 0.00 536870911.000 BIT_MASK 0x1fffffff FORMAT "%13.3" ECU_ADDRESS 0x60012FC4 /end MEASUREMENT
/begin MEASUREMENT DDRC_St.DFC_VehVSclOutOL "Debouncing counters / Debounce Timer or Event counter for check DFC_VehVSclOutOL" ULONG DFC_OneToOne 1 100 0.00 536870911.000 BIT_MASK 0x1fffffff FORMAT "%13.3" ECU_ADDRESS 0x60012FC8 /end MEASUREMENT
/begin MEASUREMENT DDRC_St.DFC_VehVSclOutOT "Debouncing counters / Debounce Timer or Event counter for check DFC_VehVSclOutOT" ULONG DFC_OneToOne 1 100 0.00 536870911.000 BIT_MASK 0x1fffffff FORMAT "%13.3" ECU_ADDRESS 0x60012FCC /end MEASUREMENT
/begin MEASUREMENT DDRC_St.DFC_VehVSclOutSCB "Debouncing counters / Debounce Timer or Event counter for check DFC_VehVSclOutSCB" ULONG DFC_OneToOne 1 100 0.00 536870911.000 BIT_MASK 0x1fffffff FORMAT "%13.3" ECU_ADDRESS 0x60012FD0 /end MEASUREMENT
/begin MEASUREMENT DDRC_St.DFC_VehVSclOutSCG "Debouncing counters / Debounce Timer or Event counter for check DFC_VehVSclOutSCG" ULONG DFC_OneToOne 1 100 0.00 536870911.000 BIT_MASK 0x1fffffff FORMAT "%13.3" ECU_ADDRESS 0x60012FD4 /end MEASUREMENT
/begin MEASUREMENT DDRC_St.DFC_VehVSigFL "Debouncing counters / Debounce Timer or Event counter for check DFC_VehVSigFL" ULONG DFC_OneToOne 1 100 0.00 536870911.000 BIT_MASK 0x1fffffff FORMAT "%13.3" ECU_ADDRESS 0x60012FD8 /end MEASUREMENT
/begin MEASUREMENT DDRC_St.DFC_VehVSigFR "Debouncing counters / Debounce Timer or Event counter for check DFC_VehVSigFR" ULONG DFC_OneToOne 1 100 0.00 536870911.000 BIT_MASK 0x1fffffff FORMAT "%13.3" ECU_ADDRESS 0x60012FDC /end MEASUREMENT
/begin MEASUREMENT DDRC_St.DFC_VehVSigRL "Debouncing counters / Debounce Timer or Event counter for check DFC_VehVSigRL" ULONG DFC_OneToOne 1 100 0.00 536870911.000 BIT_MASK 0x1fffffff FORMAT "%13.3" ECU_ADDRESS 0x60012FE0 /end MEASUREMENT
/begin MEASUREMENT DDRC_St.DFC_VehVSigRR "Debouncing counters / Debounce Timer or Event counter for check DFC_VehVSigRR" ULONG DFC_OneToOne 1 100 0.00 536870911.000 BIT_MASK 0x1fffffff FORMAT "%13.3" ECU_ADDRESS 0x60012FE4 /end MEASUREMENT
/begin MEASUREMENT DDRC_St.DFC_VehVSnsrARngHi "Debouncing counters / Debounce Timer or Event counter for check DFC_VehVSnsrARngHi" ULONG DFC_OneToOne 1 100 0.00 536870911.000 BIT_MASK 0x1fffffff FORMAT "%13.3" ECU_ADDRESS 0x60012FE8 /end MEASUREMENT
/begin MEASUREMENT DDRC_St.DFC_VehVSnsrBRngHi "Debouncing counters / Debounce Timer or Event counter for check DFC_VehVSnsrBRngHi" ULONG DFC_OneToOne 1 100 0.00 536870911.000 BIT_MASK 0x1fffffff FORMAT "%13.3" ECU_ADDRESS 0x60012FEC /end MEASUREMENT
/begin MEASUREMENT DDRC_St.DFC_VehVSpdRtyDiag "Debouncing counters / Debounce Timer or Event counter for check DFC_VehVSpdRtyDiag" ULONG DFC_OneToOne 1 100 0.00 536870911.000 BIT_MASK 0x1fffffff FORMAT "%13.3" ECU_ADDRESS 0x60012FF0 /end MEASUREMENT
/begin MEASUREMENT DDRC_St.DFC_DHFHD "Debouncing counters / Debounce Timer or Event counter for check DFC_DHFHD" ULONG DFC_OneToOne 1 100 0.00 536870911.000 BIT_MASK 0x1fffffff FORMAT "%13.3" ECU_ADDRESS 0x60012FF4 /end MEASUREMENT
/begin MEASUREMENT DDRC_St.DFC_InjVlv_DI_DcDc "Debouncing counters / Debounce Timer or Event counter for check DFC_InjVlv_DI_DcDc" ULONG DFC_OneToOne 1 100 0.00 536870911.000 BIT_MASK 0x1fffffff FORMAT "%13.3" ECU_ADDRESS 0x60012FF8 /end MEASUREMENT
/begin MEASUREMENT DDRC_St.DFC_InjVlv_DI_NoLd_0 "Debouncing counters / Debounce Timer or Event counter for check DFC_InjVlv_DI_NoLd_0" ULONG DFC_OneToOne 1 100 0.00 536870911.000 BIT_MASK 0x1fffffff FORMAT "%13.3" ECU_ADDRESS 0x60012FFC /end MEASUREMENT
/begin MEASUREMENT DDRC_St.DFC_InjVlv_DI_NoLd_1 "Debouncing counters / Debounce Timer or Event counter for check DFC_InjVlv_DI_NoLd_1" ULONG DFC_OneToOne 1 100 0.00 536870911.000 BIT_MASK 0x1fffffff FORMAT "%13.3" ECU_ADDRESS 0x60013000 /end MEASUREMENT
/begin MEASUREMENT DDRC_St.DFC_InjVlv_DI_NoLd_2 "Debouncing counters / Debounce Timer or Event counter for check DFC_InjVlv_DI_NoLd_2" ULONG DFC_OneToOne 1 100 0.00 536870911.000 BIT_MASK 0x1fffffff FORMAT "%13.3" ECU_ADDRESS 0x60013004 /end MEASUREMENT
/begin MEASUREMENT DDRC_St.DFC_InjVlv_DI_NoLd_3 "Debouncing counters / Debounce Timer or Event counter for check DFC_InjVlv_DI_NoLd_3" ULONG DFC_OneToOne 1 100 0.00 536870911.000 BIT_MASK 0x1fffffff FORMAT "%13.3" ECU_ADDRESS 0x60013008 /end MEASUREMENT
/begin MEASUREMENT DDRC_St.DFC_InjVlv_DI_ScBnk_0 "Debouncing counters / Debounce Timer or Event counter for check DFC_InjVlv_DI_ScBnk_0" ULONG DFC_OneToOne 1 100 0.00 536870911.000 BIT_MASK 0x1fffffff FORMAT "%13.3" ECU_ADDRESS 0x6001300C /end MEASUREMENT
/begin MEASUREMENT DDRC_St.DFC_InjVlv_DI_ScBnk_1 "Debouncing counters / Debounce Timer or Event counter for check DFC_InjVlv_DI_ScBnk_1" ULONG DFC_OneToOne 1 100 0.00 536870911.000 BIT_MASK 0x1fffffff FORMAT "%13.3" ECU_ADDRESS 0x60013010 /end MEASUREMENT
/begin MEASUREMENT DDRC_St.DFC_InjVlv_DI_ScBnk_2 "Debouncing counters / Debounce Timer or Event counter for check DFC_InjVlv_DI_ScBnk_2" ULONG DFC_OneToOne 1 100 0.00 536870911.000 BIT_MASK 0x1fffffff FORMAT "%13.3" ECU_ADDRESS 0x60013014 /end MEASUREMENT
/begin MEASUREMENT DDRC_St.DFC_InjVlv_DI_ScBnk_3 "Debouncing counters / Debounce Timer or Event counter for check DFC_InjVlv_DI_ScBnk_3" ULONG DFC_OneToOne 1 100 0.00 536870911.000 BIT_MASK 0x1fffffff FORMAT "%13.3" ECU_ADDRESS 0x60013018 /end MEASUREMENT
/begin MEASUREMENT DDRC_St.DFC_InjVlv_DI_ScCyl_0 "Debouncing counters / Debounce Timer or Event counter for check DFC_InjVlv_DI_ScCyl_0" ULONG DFC_OneToOne 1 100 0.00 536870911.000 BIT_MASK 0x1fffffff FORMAT "%13.3" ECU_ADDRESS 0x6001301C /end MEASUREMENT
/begin MEASUREMENT DDRC_St.DFC_InjVlv_DI_ScCyl_1 "Debouncing counters / Debounce Timer or Event counter for check DFC_InjVlv_DI_ScCyl_1" ULONG DFC_OneToOne 1 100 0.00 536870911.000 BIT_MASK 0x1fffffff FORMAT "%13.3" ECU_ADDRESS 0x60013020 /end MEASUREMENT
/begin MEASUREMENT DDRC_St.DFC_InjVlv_DI_ScCyl_2 "Debouncing counters / Debounce Timer or Event counter for check DFC_InjVlv_DI_ScCyl_2" ULONG DFC_OneToOne 1 100 0.00 536870911.000 BIT_MASK 0x1fffffff FORMAT "%13.3" ECU_ADDRESS 0x60013024 /end MEASUREMENT
/begin MEASUREMENT DDRC_St.DFC_InjVlv_DI_ScCyl_3 "Debouncing counters / Debounce Timer or Event counter for check DFC_InjVlv_DI_ScCyl_3" ULONG DFC_OneToOne 1 100 0.00 536870911.000 BIT_MASK 0x1fffffff FORMAT "%13.3" ECU_ADDRESS 0x60013028 /end MEASUREMENT
/begin MEASUREMENT DDRC_St.DFC_InjVlv_DI_ScHsLs_0 "Debouncing counters / Debounce Timer or Event counter for check DFC_InjVlv_DI_ScHsLs_0" ULONG DFC_OneToOne 1 100 0.00 536870911.000 BIT_MASK 0x1fffffff FORMAT "%13.3" ECU_ADDRESS 0x6001302C /end MEASUREMENT
/begin MEASUREMENT DDRC_St.DFC_InjVlv_DI_ScHsLs_1 "Debouncing counters / Debounce Timer or Event counter for check DFC_InjVlv_DI_ScHsLs_1" ULONG DFC_OneToOne 1 100 0.00 536870911.000 BIT_MASK 0x1fffffff FORMAT "%13.3" ECU_ADDRESS 0x60013030 /end MEASUREMENT
/begin MEASUREMENT DDRC_St.DFC_InjVlv_DI_ScHsLs_2 "Debouncing counters / Debounce Timer or Event counter for check DFC_InjVlv_DI_ScHsLs_2" ULONG DFC_OneToOne 1 100 0.00 536870911.000 BIT_MASK 0x1fffffff FORMAT "%13.3" ECU_ADDRESS 0x60013034 /end MEASUREMENT
/begin MEASUREMENT DDRC_St.DFC_InjVlv_DI_ScHsLs_3 "Debouncing counters / Debounce Timer or Event counter for check DFC_InjVlv_DI_ScHsLs_3" ULONG DFC_OneToOne 1 100 0.00 536870911.000 BIT_MASK 0x1fffffff FORMAT "%13.3" ECU_ADDRESS 0x60013038 /end MEASUREMENT
/begin MEASUREMENT DDRC_St.DFC_MfPsDiaOpenLoad1 "Debouncing counters / Debounce Timer or Event counter for check DFC_MfPsDiaOpenLoad1" ULONG DFC_OneToOne 1 100 0.00 536870911.000 BIT_MASK 0x1fffffff FORMAT "%13.3" ECU_ADDRESS 0x6001303C /end MEASUREMENT
/begin MEASUREMENT DDRC_St.DFC_MfPsDiaScHiS1 "Debouncing counters / Debounce Timer or Event counter for check DFC_MfPsDiaScHiS1" ULONG DFC_OneToOne 1 100 0.00 536870911.000 BIT_MASK 0x1fffffff FORMAT "%13.3" ECU_ADDRESS 0x60013040 /end MEASUREMENT
/begin MEASUREMENT DDRC_St.DFC_MfPsDiaScHiSLowS1 "Debouncing counters / Debounce Timer or Event counter for check DFC_MfPsDiaScHiSLowS1" ULONG DFC_OneToOne 1 100 0.00 536870911.000 BIT_MASK 0x1fffffff FORMAT "%13.3" ECU_ADDRESS 0x60013044 /end MEASUREMENT
/begin MEASUREMENT DDRC_St.DFC_MfPsDiaScLowS1 "Debouncing counters / Debounce Timer or Event counter for check DFC_MfPsDiaScLowS1" ULONG DFC_OneToOne 1 100 0.00 536870911.000 BIT_MASK 0x1fffffff FORMAT "%13.3" ECU_ADDRESS 0x60013048 /end MEASUREMENT
/begin MEASUREMENT DDRC_St.DFC_ACEvpTPhysRngHi "Debouncing counters / Debounce Timer or Event counter for check DFC_ACEvpTPhysRngHi" UWORD DFC_OneToOne 1 100 0.00 8191.000 BIT_MASK 0x1fff FORMAT "%8.3" ECU_ADDRESS 0x6001349E /end MEASUREMENT
/begin MEASUREMENT DDRC_St.DFC_ACEvpTPhysRngLo "Debouncing counters / Debounce Timer or Event counter for check DFC_ACEvpTPhysRngLo" UWORD DFC_OneToOne 1 100 0.00 8191.000 BIT_MASK 0x1fff FORMAT "%8.3" ECU_ADDRESS 0x600134A0 /end MEASUREMENT
/begin MEASUREMENT DDRC_St.DFC_ACEvpTSRCMax "Debouncing counters / Debounce Timer or Event counter for check DFC_ACEvpTSRCMax" UWORD DFC_OneToOne 1 100 0.00 8191.000 BIT_MASK 0x1fff FORMAT "%8.3" ECU_ADDRESS 0x600134A2 /end MEASUREMENT
/begin MEASUREMENT DDRC_St.DFC_ACEvpTSRCMin "Debouncing counters / Debounce Timer or Event counter for check DFC_ACEvpTSRCMin" UWORD DFC_OneToOne 1 100 0.00 8191.000 BIT_MASK 0x1fff FORMAT "%8.3" ECU_ADDRESS 0x600134A4 /end MEASUREMENT
/begin MEASUREMENT DDRC_St.DFC_AfsRawSigRngHiB1 "Debouncing counters / Debounce Timer or Event counter for check DFC_AfsRawSigRngHiB1" UWORD DFC_OneToOne 1 100 0.00 8191.000 BIT_MASK 0x1fff FORMAT "%8.3" ECU_ADDRESS 0x600134A6 /end MEASUREMENT
/begin MEASUREMENT DDRC_St.DFC_AfsRawSigRngLoB1 "Debouncing counters / Debounce Timer or Event counter for check DFC_AfsRawSigRngLoB1" UWORD DFC_OneToOne 1 100 0.00 8191.000 BIT_MASK 0x1fff FORMAT "%8.3" ECU_ADDRESS 0x600134A8 /end MEASUREMENT
/begin MEASUREMENT DDRC_St.DFC_AfsSnsrErrB1 "Debouncing counters / Debounce Timer or Event counter for check DFC_AfsSnsrErrB1" UWORD DFC_OneToOne 1 100 0.00 8191.000 BIT_MASK 0x1fff FORMAT "%8.3" ECU_ADDRESS 0x600134AA /end MEASUREMENT
/begin MEASUREMENT DDRC_St.DFC_AirCClntPAnaSRCMax "Debouncing counters / Debounce Timer or Event counter for check DFC_AirCClntPAnaSRCMax" UWORD DFC_OneToOne 1 100 0.00 8191.000 BIT_MASK 0x1fff FORMAT "%8.3" ECU_ADDRESS 0x600134AC /end MEASUREMENT
/begin MEASUREMENT DDRC_St.DFC_AirCClntPAnaSRCMin "Debouncing counters / Debounce Timer or Event counter for check DFC_AirCClntPAnaSRCMin" UWORD DFC_OneToOne 1 100 0.00 8191.000 BIT_MASK 0x1fff FORMAT "%8.3" ECU_ADDRESS 0x600134AE /end MEASUREMENT
/begin MEASUREMENT DDRC_St.DFC_AirCSwtNpl "Debouncing counters / Debounce Timer or Event counter for check DFC_AirCSwtNpl" UWORD DFC_OneToOne 1 100 0.00 8191.000 BIT_MASK 0x1fff FORMAT "%8.3" ECU_ADDRESS 0x600134B0 /end MEASUREMENT
/begin MEASUREMENT DDRC_St.DFC_AirCSwtSig "Debouncing counters / Debounce Timer or Event counter for check DFC_AirCSwtSig" UWORD DFC_OneToOne 1 100 0.00 8191.000 BIT_MASK 0x1fff FORMAT "%8.3" ECU_ADDRESS 0x600134B2 /end MEASUREMENT
/begin MEASUREMENT DDRC_St.DFC_Brk "Debouncing counters / Debounce Timer or Event counter for check DFC_Brk" UWORD DFC_OneToOne 1 100 0.00 8191.000 BIT_MASK 0x1fff FORMAT "%8.3" ECU_ADDRESS 0x600134B4 /end MEASUREMENT
/begin MEASUREMENT DDRC_St.DFC_BrkBstSensSCB "Debouncing counters / Debounce Timer or Event counter for check DFC_BrkBstSensSCB" UWORD DFC_OneToOne 1 100 0.00 8191.000 BIT_MASK 0x1fff FORMAT "%8.3" ECU_ADDRESS 0x600134B6 /end MEASUREMENT
/begin MEASUREMENT DDRC_St.DFC_BrkBstSensSCG "Debouncing counters / Debounce Timer or Event counter for check DFC_BrkBstSensSCG" UWORD DFC_OneToOne 1 100 0.00 8191.000 BIT_MASK 0x1fff FORMAT "%8.3" ECU_ADDRESS 0x600134B8 /end MEASUREMENT
/begin MEASUREMENT DDRC_St.DFC_BrkSig "Debouncing counters / Debounce Timer or Event counter for check DFC_BrkSig" UWORD DFC_OneToOne 1 100 0.00 8191.000 BIT_MASK 0x1fff FORMAT "%8.3" ECU_ADDRESS 0x600134BA /end MEASUREMENT
/begin MEASUREMENT DDRC_St.DFC_ClthSig "Debouncing counters / Debounce Timer or Event counter for check DFC_ClthSig" UWORD DFC_OneToOne 1 100 0.00 8191.000 BIT_MASK 0x1fff FORMAT "%8.3" ECU_ADDRESS 0x600134BC /end MEASUREMENT
/begin MEASUREMENT DDRC_St.DFC_EGRVlvCurrLim "Debouncing counters / Debounce Timer or Event counter for check DFC_EGRVlvCurrLim" UWORD DFC_OneToOne 1 100 0.00 8191.000 BIT_MASK 0x1fff FORMAT "%8.3" ECU_ADDRESS 0x600134BE /end MEASUREMENT
/begin MEASUREMENT DDRC_St.DFC_EGRVlvOL "Debouncing counters / Debounce Timer or Event counter for check DFC_EGRVlvOL" UWORD DFC_OneToOne 1 100 0.00 8191.000 BIT_MASK 0x1fff FORMAT "%8.3" ECU_ADDRESS 0x600134C0 /end MEASUREMENT
/begin MEASUREMENT DDRC_St.DFC_EGRVlvOvrTemp "Debouncing counters / Debounce Timer or Event counter for check DFC_EGRVlvOvrTemp" UWORD DFC_OneToOne 1 100 0.00 8191.000 BIT_MASK 0x1fff FORMAT "%8.3" ECU_ADDRESS 0x600134C2 /end MEASUREMENT
/begin MEASUREMENT DDRC_St.DFC_EGRVlvSCB "Debouncing counters / Debounce Timer or Event counter for check DFC_EGRVlvSCB" UWORD DFC_OneToOne 1 100 0.00 8191.000 BIT_MASK 0x1fff FORMAT "%8.3" ECU_ADDRESS 0x600134C4 /end MEASUREMENT
/begin MEASUREMENT DDRC_St.DFC_EGRVlvSCG "Debouncing counters / Debounce Timer or Event counter for check DFC_EGRVlvSCG" UWORD DFC_OneToOne 1 100 0.00 8191.000 BIT_MASK 0x1fff FORMAT "%8.3" ECU_ADDRESS 0x600134C6 /end MEASUREMENT
/begin MEASUREMENT DDRC_St.DFC_EGRVlvSRCMax "Debouncing counters / Debounce Timer or Event counter for check DFC_EGRVlvSRCMax" UWORD DFC_OneToOne 1 100 0.00 8191.000 BIT_MASK 0x1fff FORMAT "%8.3" ECU_ADDRESS 0x600134C8 /end MEASUREMENT
/begin MEASUREMENT DDRC_St.DFC_EGRVlvSRCMin "Debouncing counters / Debounce Timer or Event counter for check DFC_EGRVlvSRCMin" UWORD DFC_OneToOne 1 100 0.00 8191.000 BIT_MASK 0x1fff FORMAT "%8.3" ECU_ADDRESS 0x600134CA /end MEASUREMENT
/begin MEASUREMENT DDRC_St.DFC_HLSDemOvhtEngLim "Debouncing counters / Debounce Timer or Event counter for check DFC_HLSDemOvhtEngLim" UWORD DFC_OneToOne 1 100 0.00 8191.000 BIT_MASK 0x1fff FORMAT "%8.3" ECU_ADDRESS 0x600134CC /end MEASUREMENT
/begin MEASUREMENT DDRC_St.DFC_OilPSwmpSRCMax "Debouncing counters / Debounce Timer or Event counter for check DFC_OilPSwmpSRCMax" UWORD DFC_OneToOne 1 100 0.00 8191.000 BIT_MASK 0x1fff FORMAT "%8.3" ECU_ADDRESS 0x600134CE /end MEASUREMENT
/begin MEASUREMENT DDRC_St.DFC_OilPSwmpSRCMin "Debouncing counters / Debounce Timer or Event counter for check DFC_OilPSwmpSRCMin" UWORD DFC_OneToOne 1 100 0.00 8191.000 BIT_MASK 0x1fff FORMAT "%8.3" ECU_ADDRESS 0x600134D0 /end MEASUREMENT
/begin MEASUREMENT DDRC_St.DFC_PIntkVUsLineHiB1 "Debouncing counters / Debounce Timer or Event counter for check DFC_PIntkVUsLineHiB1" UWORD DFC_OneToOne 1 100 0.00 8191.000 BIT_MASK 0x1fff FORMAT "%8.3" ECU_ADDRESS 0x600134D2 /end MEASUREMENT
/begin MEASUREMENT DDRC_St.DFC_PIntkVUsLineLoB1 "Debouncing counters / Debounce Timer or Event counter for check DFC_PIntkVUsLineLoB1" UWORD DFC_OneToOne 1 100 0.00 8191.000 BIT_MASK 0x1fff FORMAT "%8.3" ECU_ADDRESS 0x600134D4 /end MEASUREMENT
/begin MEASUREMENT DDRC_St.DFC_VehVPhysRngLo "Debouncing counters / Debounce Timer or Event counter for check DFC_VehVPhysRngLo" UWORD DFC_OneToOne 1 100 0.00 8191.000 BIT_MASK 0x1fff FORMAT "%8.3" ECU_ADDRESS 0x600134D6 /end MEASUREMENT
/begin MEASUREMENT DDRC_St.DFC_VehVSigCan "Debouncing counters / Debounce Timer or Event counter for check DFC_VehVSigCan" UWORD DFC_OneToOne 1 100 0.00 8191.000 BIT_MASK 0x1fff FORMAT "%8.3" ECU_ADDRESS 0x600134D8 /end MEASUREMENT
/begin MEASUREMENT DDRC_St.DFC_VehVSigCanSafe "Debouncing counters / Debounce Timer or Event counter for check DFC_VehVSigCanSafe" UWORD DFC_OneToOne 1 100 0.00 8191.000 BIT_MASK 0x1fff FORMAT "%8.3" ECU_ADDRESS 0x600134DA /end MEASUREMENT
/begin MEASUREMENT DDRC_St.DFC_VlvLftFbOilPSnsrIntk11SRCMax "Debouncing counters / Debounce Timer or Event counter for check DFC_VlvLftFbOilPSnsrIntk11SRCMax" UWORD DFC_OneToOne 1 100 0.00 8191.000 BIT_MASK 0x1fff FORMAT "%8.3" ECU_ADDRESS 0x600134DC /end MEASUREMENT
/begin MEASUREMENT DDRC_St.DFC_VlvLftFbOilPSnsrIntk11SRCMin "Debouncing counters / Debounce Timer or Event counter for check DFC_VlvLftFbOilPSnsrIntk11SRCMin" UWORD DFC_OneToOne 1 100 0.00 8191.000 BIT_MASK 0x1fff FORMAT "%8.3" ECU_ADDRESS 0x600134DE /end MEASUREMENT
/begin MEASUREMENT DDRC_St.DFC_ClthNpl "Debouncing counters / Debounce Timer or Event counter for check DFC_ClthNpl" UWORD DFC_OneToOne 1 100 0.00 8191.000 BIT_MASK 0x1fff FORMAT "%8.3" ECU_ADDRESS 0x600134E0 /end MEASUREMENT
/begin MEASUREMENT DDRC_St.DFC_GbxPNPosnDrvCdn "Debouncing counters / Debounce Timer or Event counter for check DFC_GbxPNPosnDrvCdn" UWORD DFC_OneToOne 1 100 0.00 8191.000 BIT_MASK 0x1fff FORMAT "%8.3" ECU_ADDRESS 0x600134E2 /end MEASUREMENT
/begin MEASUREMENT DDRC_St.DFC_GbxPNPosnPlausy "Debouncing counters / Debounce Timer or Event counter for check DFC_GbxPNPosnPlausy" UWORD DFC_OneToOne 1 100 0.00 8191.000 BIT_MASK 0x1fff FORMAT "%8.3" ECU_ADDRESS 0x600134E4 /end MEASUREMENT
/begin MEASUREMENT DDRC_St.DFC_AfsSigErrLineHiB1 "Debouncing counters / Debounce Timer or Event counter for check DFC_AfsSigErrLineHiB1" UWORD DFC_OneToOne 1 100 0.00 8191.000 BIT_MASK 0x1fff FORMAT "%8.3" ECU_ADDRESS 0x600134E6 /end MEASUREMENT
/begin MEASUREMENT DDRC_St.DFC_AfsSigErrLineLoB1 "Debouncing counters / Debounce Timer or Event counter for check DFC_AfsSigErrLineLoB1" UWORD DFC_OneToOne 1 100 0.00 8191.000 BIT_MASK 0x1fff FORMAT "%8.3" ECU_ADDRESS 0x600134E8 /end MEASUREMENT
/begin MEASUREMENT DDRC_St.DFC_PEnvCcMax "Debouncing counters / Debounce Timer or Event counter for check DFC_PEnvCcMax" UWORD DFC_OneToOne 1 100 0.00 8191.000 BIT_MASK 0x1fff FORMAT "%8.3" ECU_ADDRESS 0x600134EA /end MEASUREMENT
/begin MEASUREMENT DDRC_St.DFC_PEnvCcMin "Debouncing counters / Debounce Timer or Event counter for check DFC_PEnvCcMin" UWORD DFC_OneToOne 1 100 0.00 8191.000 BIT_MASK 0x1fff FORMAT "%8.3" ECU_ADDRESS 0x600134EC /end MEASUREMENT
/begin MEASUREMENT DDRC_St.DFC_PEnvRngChkMax "Debouncing counters / Debounce Timer or Event counter for check DFC_PEnvRngChkMax" UWORD DFC_OneToOne 1 100 0.00 8191.000 BIT_MASK 0x1fff FORMAT "%8.3" ECU_ADDRESS 0x600134EE /end MEASUREMENT
/begin MEASUREMENT DDRC_St.DFC_PEnvRngChkMin "Debouncing counters / Debounce Timer or Event counter for check DFC_PEnvRngChkMin" UWORD DFC_OneToOne 1 100 0.00 8191.000 BIT_MASK 0x1fff FORMAT "%8.3" ECU_ADDRESS 0x600134F0 /end MEASUREMENT
/begin MEASUREMENT DDRC_St.DFC_PEnvSnsrPlaus "Debouncing counters / Debounce Timer or Event counter for check DFC_PEnvSnsrPlaus" UWORD DFC_OneToOne 1 100 0.00 8191.000 BIT_MASK 0x1fff FORMAT "%8.3" ECU_ADDRESS 0x600134F2 /end MEASUREMENT
/begin MEASUREMENT DDRC_St.DFC_UEGOHeatrRlyPsOLS1B1 "Debouncing counters / Debounce Timer or Event counter for check DFC_UEGOHeatrRlyPsOLS1B1" UWORD DFC_OneToOne 1 100 0.00 8191.000 BIT_MASK 0x1fff FORMAT "%8.3" ECU_ADDRESS 0x600134F4 /end MEASUREMENT
/begin MEASUREMENT DDRC_St.DFC_UEGOHeatrRlyPsSCBS1B1 "Debouncing counters / Debounce Timer or Event counter for check DFC_UEGOHeatrRlyPsSCBS1B1" UWORD DFC_OneToOne 1 100 0.00 8191.000 BIT_MASK 0x1fff FORMAT "%8.3" ECU_ADDRESS 0x600134F6 /end MEASUREMENT
/begin MEASUREMENT DDRC_St.DFC_UEGOHeatrRlyPsSCGS1B1 "Debouncing counters / Debounce Timer or Event counter for check DFC_UEGOHeatrRlyPsSCGS1B1" UWORD DFC_OneToOne 1 100 0.00 8191.000 BIT_MASK 0x1fff FORMAT "%8.3" ECU_ADDRESS 0x600134F8 /end MEASUREMENT
/begin MEASUREMENT DDRC_St.DFC_UegoHeatrWireOlS1B1 "Debouncing counters / Debounce Timer or Event counter for check DFC_UegoHeatrWireOlS1B1" UWORD DFC_OneToOne 1 100 0.00 8191.000 BIT_MASK 0x1fff FORMAT "%8.3" ECU_ADDRESS 0x600134FA /end MEASUREMENT
/begin MEASUREMENT DDRC_St.DFC_UegoHeatrWireScbS1B1 "Debouncing counters / Debounce Timer or Event counter for check DFC_UegoHeatrWireScbS1B1" UWORD DFC_OneToOne 1 100 0.00 8191.000 BIT_MASK 0x1fff FORMAT "%8.3" ECU_ADDRESS 0x600134FC /end MEASUREMENT
/begin MEASUREMENT DDRC_St.DFC_UegoHeatrWireScgS1B1 "Debouncing counters / Debounce Timer or Event counter for check DFC_UegoHeatrWireScgS1B1" UWORD DFC_OneToOne 1 100 0.00 8191.000 BIT_MASK 0x1fff FORMAT "%8.3" ECU_ADDRESS 0x600134FE /end MEASUREMENT
/begin MEASUREMENT DDRC_St.DFC_KnDetSens1PortAMax "Debouncing counters / Debounce Timer or Event counter for check DFC_KnDetSens1PortAMax" UWORD DFC_OneToOne 1 100 0.00 8191.000 BIT_MASK 0x1fff FORMAT "%8.3" ECU_ADDRESS 0x60013500 /end MEASUREMENT
/begin MEASUREMENT DDRC_St.DFC_KnDetSens1PortAMin "Debouncing counters / Debounce Timer or Event counter for check DFC_KnDetSens1PortAMin" UWORD DFC_OneToOne 1 100 0.00 8191.000 BIT_MASK 0x1fff FORMAT "%8.3" ECU_ADDRESS 0x60013502 /end MEASUREMENT
/begin MEASUREMENT DDRC_St.DFC_KnDetSens1PortBMax "Debouncing counters / Debounce Timer or Event counter for check DFC_KnDetSens1PortBMax" UWORD DFC_OneToOne 1 100 0.00 8191.000 BIT_MASK 0x1fff FORMAT "%8.3" ECU_ADDRESS 0x60013504 /end MEASUREMENT
/begin MEASUREMENT DDRC_St.DFC_KnDetSens1PortBMin "Debouncing counters / Debounce Timer or Event counter for check DFC_KnDetSens1PortBMin" UWORD DFC_OneToOne 1 100 0.00 8191.000 BIT_MASK 0x1fff FORMAT "%8.3" ECU_ADDRESS 0x60013506 /end MEASUREMENT
/begin MEASUREMENT DSM_xTabVersion "DSM version indentification signature" UWORD DFC_OneToOne 1 100 0.00 65535.00 FORMAT "%8.2" ECU_ADDRESS 0x6000A3C4 /end MEASUREMENT
/begin MEASUREMENT HiPSys_tFuHiPDDHFHD "fuel temperature in the high pressure system" UBYTE temp_ub_q0p75_o48 1 100 -48.0 143.3 FORMAT "%5.1" ECU_ADDRESS 0x6000106A /end MEASUREMENT
/begin MEASUREMENT I14229AirCCmpr_stVal "Status information for AC Compressor Device Driver SDA test" UWORD OneToOne 1 100 0.00 65535.00 FORMAT "%8.2" ECU_ADDRESS 0x600094AE /end MEASUREMENT
/begin MEASUREMENT I14229CP_stVal "Status information for Canister Purge Valve SDA test" UWORD OneToOne 1 100 0.00 65535.00 FORMAT "%8.2" ECU_ADDRESS 0x600094AC /end MEASUREMENT
/begin MEASUREMENT I14229Duv_stVal "status information for Air Bypass Solenoid Valve control SDA test" UWORD OneToOne 1 100 0.00 65535.00 FORMAT "%8.2" ECU_ADDRESS 0x600094AA /end MEASUREMENT
/begin MEASUREMENT I14229EGRVlv_stVal "Status for EGR valve SDA" UWORD OneToOne 1 100 0.00 65535.00 FORMAT "%8.2" ECU_ADDRESS 0x600094A8 /end MEASUREMENT
/begin MEASUREMENT I14229FanDig_stVal "Status information for FAN control SDA test" UWORD OneToOne 1 100 0.00 65535.00 FORMAT "%8.2" ECU_ADDRESS 0x600094A6 /end MEASUREMENT
/begin MEASUREMENT I14229FlPmp_stVal "Status information for Fuel Pump ON or OFF (SDA)" UWORD OneToOne 1 100 0.00 65535.00 FORMAT "%8.2" ECU_ADDRESS 0x60007498 /end MEASUREMENT
/begin MEASUREMENT I14229ICEWP_stVal "Status for ATS test for water charge air cooler EWP control SDA" UWORD OneToOne 1 100 0.00 65535.00 FORMAT "%8.2" ECU_ADDRESS 0x60007496 /end MEASUREMENT
/begin MEASUREMENT I14229InjRateAmnt_stVal "Status value for Rate of Injection Amount Control" UWORD OneToOne 1 100 0.00 65535.00 FORMAT "%8.2" ECU_ADDRESS 0x600094A4 /end MEASUREMENT
/begin MEASUREMENT I14229InjTstFlg1_stVal "Status information for Injector power stage (Cut injection for each cylinder)SDA test" UWORD OneToOne 1 100 0.00 65535.00 FORMAT "%8.2" ECU_ADDRESS 0x600094A2 /end MEASUREMENT
/begin MEASUREMENT I14229InjTstFlg_stVal "Status information for Injector power stage (Cut injection for all cylinder)SDA test" UWORD OneToOne 1 100 0.00 65535.00 FORMAT "%8.2" ECU_ADDRESS 0x60007494 /end MEASUREMENT
/begin MEASUREMENT I14229iocbi_numActivMDA "currently active MDA mode" UWORD OneToOne 1 100 0.00 65535.00 FORMAT "%8.2" ECU_ADDRESS 0x60009470 /end MEASUREMENT
/begin MEASUREMENT I14229iocbi_numActivSFT "Number of the SFT mode active" ULONG OneToOne 1 100 0.00 4294967295.00 FORMAT "%13.2" ECU_ADDRESS 0x60003A60 /end MEASUREMENT
/begin MEASUREMENT I14229iocbi_numDID "Number of the IOBI DID" UWORD OneToOne 1 100 0.00 65535.00 FORMAT "%8.2" ECU_ADDRESS 0x6000946E /end MEASUREMENT
/begin MEASUREMENT I14229iocbi_numResp "Number of the IOBI DID for Byte 5,6" UWORD OneToOne 1 100 0.00 65535.00 FORMAT "%8.2" ECU_ADDRESS 0x6000946C /end MEASUREMENT
/begin MEASUREMENT I14229iocbi_numSt "Number of the IOBI State" UBYTE OneToOne 1 100 0.00 255.0 FORMAT "%5.1" ECU_ADDRESS 0x6000E82C /end MEASUREMENT
/begin MEASUREMENT I14229iocbi_stSFT "Status of the SFT Mode type ( LET or Service Tool)" UBYTE OneToOne 1 100 0.00 255.0 FORMAT "%5.1" ECU_ADDRESS 0x6000F82F /end MEASUREMENT
/begin MEASUREMENT I14229iocpMDA_numABV "Input output by Data Identifier" UWORD OneToOne 1 100 0.00 65535.00 FORMAT "%8.2" ECU_ADDRESS 0x6000946A /end MEASUREMENT
/begin MEASUREMENT I14229iocpMDA_numACGC "input output by Data identifier" UWORD OneToOne 1 100 0.00 65535.00 FORMAT "%8.2" ECU_ADDRESS 0x60009468 /end MEASUREMENT
/begin MEASUREMENT I14229iocpMDA_numAPS "input output by Data identifier" UWORD OneToOne 1 100 0.00 65535.00 FORMAT "%8.2" ECU_ADDRESS 0x60009466 /end MEASUREMENT
/begin MEASUREMENT I14229iocpMDA_numEGR "input output by data identifier" UWORD OneToOne 1 100 0.00 65535.00 FORMAT "%8.2" ECU_ADDRESS 0x60009464 /end MEASUREMENT
/begin MEASUREMENT I14229iocpMDA_numICEWP "Command value for MDA-ICEWP control" UWORD OneToOne 1 100 0.00 65535.00 FORMAT "%8.2" ECU_ADDRESS 0x60009462 /end MEASUREMENT
/begin MEASUREMENT I14229iocpMDA_numOilPCtrl "Current control state value for did 0x0122" UWORD OneToOne 1 100 0.00 65535.00 FORMAT "%8.2" ECU_ADDRESS 0x60009460 /end MEASUREMENT
/begin MEASUREMENT I14229iocpMDA_numPSC "Input output by Data Identifier" UWORD OneToOne 1 100 0.00 65535.00 FORMAT "%8.2" ECU_ADDRESS 0x6000945E /end MEASUREMENT
/begin MEASUREMENT I14229iocpMDA_numRFAN "input output by Data identifier" UWORD OneToOne 1 100 0.00 65535.00 FORMAT "%8.2" ECU_ADDRESS 0x6000945C /end MEASUREMENT
/begin MEASUREMENT I14229iocpMDA_numRvsLck "Input output by Data Identifier" UWORD OneToOne 1 100 0.00 65535.00 FORMAT "%8.2" ECU_ADDRESS 0x6000945A /end MEASUREMENT
/begin MEASUREMENT I14229iocpMDA_numVTEC "input output by Data identifier" UWORD OneToOne 1 100 0.00 65535.00 FORMAT "%8.2" ECU_ADDRESS 0x60009458 /end MEASUREMENT
/begin MEASUREMENT I14229iocpMDA_stABV "Status of request to make Air Bypass Solenoid Valve active through tester" UBYTE OneToOne 1 100 0.00 255.0 FORMAT "%5.1" ECU_ADDRESS 0x6000F82E /end MEASUREMENT
/begin MEASUREMENT I14229iocpMDA_stACGC "status of request to make Alternator Device Driver active through tester" UBYTE OneToOne 1 100 0.00 255.0 FORMAT "%5.1" ECU_ADDRESS 0x6000F82D /end MEASUREMENT
/begin MEASUREMENT I14229iocpMDA_stAPS "status of request to make Accel Pedal Sensor active through tester" UBYTE OneToOne 1 100 0.00 255.0 FORMAT "%5.1" ECU_ADDRESS 0x6000F82C /end MEASUREMENT
/begin MEASUREMENT I14229iocpMDA_stEGR "status of request to make EGR Valve active through tester" UBYTE OneToOne 1 100 0.00 255.0 FORMAT "%5.1" ECU_ADDRESS 0x6000E82B /end MEASUREMENT
/begin MEASUREMENT I14229iocpMDA_stICEWP "status for Water charge air cooler EWP control MDA request through tester" UBYTE OneToOne 1 100 0.00 255.0 FORMAT "%5.1" ECU_ADDRESS 0x6000E82A /end MEASUREMENT
/begin MEASUREMENT I14229iocpMDA_stOilPCtrl "test acvtive status for DID 0x0122" UBYTE OneToOne 1 100 0.00 255.0 FORMAT "%5.1" ECU_ADDRESS 0x6000F82B /end MEASUREMENT
/begin MEASUREMENT I14229iocpMDA_stPSC "Status of request to make Canister Purge Valve active through tester" UBYTE OneToOne 1 100 0.00 255.0 FORMAT "%5.1" ECU_ADDRESS 0x6000F82A /end MEASUREMENT
/begin MEASUREMENT I14229iocpMDA_stRFAN "status of request to make Fan Device Driver active through tester" UBYTE OneToOne 1 100 0.00 255.0 FORMAT "%5.1" ECU_ADDRESS 0x6000F829 /end MEASUREMENT
/begin MEASUREMENT I14229iocpMDA_stRvsLck "Status of request to control Reverse Lock" UBYTE OneToOne 1 100 0.00 255.0 FORMAT "%5.1" ECU_ADDRESS 0x6000F828 /end MEASUREMENT
/begin MEASUREMENT I14229iocpMDA_stVTEC "status of request to make Valve Lift Control active through tester" UBYTE OneToOne 1 100 0.00 255.0 FORMAT "%5.1" ECU_ADDRESS 0x6000F827 /end MEASUREMENT
/begin MEASUREMENT I14229iocpSDA_stEGR "Status message to check the bit position for condition check for SDA execution" UBYTE OneToOne 1 100 0.00 255.0 FORMAT "%5.1" ECU_ADDRESS 0x6000F826 /end MEASUREMENT
/begin MEASUREMENT I14229iocp_numCtlSt "input output by Data identifier" UWORD OneToOne 1 100 0.00 65535.00 FORMAT "%8.2" ECU_ADDRESS 0x60009456 /end MEASUREMENT
/begin MEASUREMENT I14229iocp_numEXE "input output by Data identifier" UWORD OneToOne 1 100 0.00 65535.00 FORMAT "%8.2" ECU_ADDRESS 0x60009454 /end MEASUREMENT
/begin MEASUREMENT I14229iocp_numREQ "input output by Data identifier" UWORD OneToOne 1 100 0.00 65535.00 FORMAT "%8.2" ECU_ADDRESS 0x60009452 /end MEASUREMENT
/begin MEASUREMENT I14229iocp_stAInjDAct "status of request to activate Injector power stage through tester" UBYTE OneToOne 1 100 0.00 255.0 FORMAT "%5.1" ECU_ADDRESS 0x60039484 /end MEASUREMENT
/begin MEASUREMENT I14229iocp_stSFTRJC "input output by Data identifier" UBYTE OneToOne 1 100 0.00 255.0 FORMAT "%5.1" ECU_ADDRESS 0x6000F825 /end MEASUREMENT
/begin MEASUREMENT I14229MDAAltIO_stVal "Status information for Alternator Device Driver( Alternator Generating Voltage Test)" UWORD OneToOne 1 100 0.00 65535.00 FORMAT "%8.2" ECU_ADDRESS 0x6000949E /end MEASUREMENT
/begin MEASUREMENT I14229MDAAPS_stVal "Status information for Accel Pedal Sensor (Change target throttle angle by tester)" UWORD OneToOne 1 100 0.00 65535.00 FORMAT "%8.2" ECU_ADDRESS 0x600094A0 /end MEASUREMENT
/begin MEASUREMENT I14229MDACP_stVal "Status information for Canister Purge Valve MDA test" UWORD OneToOne 1 100 0.00 65535.00 FORMAT "%8.2" ECU_ADDRESS 0x6000949C /end MEASUREMENT
/begin MEASUREMENT I14229MDADuv_stVal "Status information for Air Bypass Solenoid Valve MDA test" UWORD OneToOne 1 100 0.00 65535.00 FORMAT "%8.2" ECU_ADDRESS 0x6000949A /end MEASUREMENT
/begin MEASUREMENT I14229MDAEGRVlv_stVal "Status information for EGR valve MDA test" UWORD OneToOne 1 100 0.00 65535.00 FORMAT "%8.2" ECU_ADDRESS 0x60009498 /end MEASUREMENT
/begin MEASUREMENT I14229MDAFAN_stVal "Status information for FAN control MDA test" UWORD OneToOne 1 100 0.00 65535.00 FORMAT "%8.2" ECU_ADDRESS 0x60009496 /end MEASUREMENT
/begin MEASUREMENT I14229MDAICEWP_stVal "Status for ATS test for water charge air cooler EWP control MDA" UWORD OneToOne 1 100 0.00 65535.00 FORMAT "%8.2" ECU_ADDRESS 0x60009494 /end MEASUREMENT
/begin MEASUREMENT I14229MDAOilPCtrl_stVal "Test Status value for DID0x0122" UWORD OneToOne 1 100 0.00 65535.00 FORMAT "%8.2" ECU_ADDRESS 0x60009492 /end MEASUREMENT
/begin MEASUREMENT I14229MDARvsLck_stVal "Status information for Reverse Lock" UWORD OneToOne 1 100 0.00 65535.00 FORMAT "%8.2" ECU_ADDRESS 0x60009490 /end MEASUREMENT
/begin MEASUREMENT I14229MDAVTEC_stVal "Status information for Valve Lift Control (Make VTEC Solenoid ON or OFF) by MDA test" UWORD OneToOne 1 100 0.00 65535.00 FORMAT "%8.2" ECU_ADDRESS 0x6000948E /end MEASUREMENT
/begin MEASUREMENT I14229OilPCtrl_stVal "Status for ATS test for oil valve control SDA" UWORD OneToOne 1 100 0.00 65535.00 FORMAT "%8.2" ECU_ADDRESS 0x6000948C /end MEASUREMENT
/begin MEASUREMENT I14229PHAACTRINTK_stVal "Status information for Intake Camshaft Phase SDA test" UWORD OneToOne 1 100 0.00 65535.00 FORMAT "%8.2" ECU_ADDRESS 0x6000948A /end MEASUREMENT
/begin MEASUREMENT I14229PHAACTROUTL_stVal "Status information for Outlet Camshaft Phase SDA test" UWORD OneToOne 1 100 0.00 65535.00 FORMAT "%8.2" ECU_ADDRESS 0x60009488 /end MEASUREMENT
/begin MEASUREMENT I14229rcCrCtl_stLmp "Cruise Control Lamp on/off drive signal" UBYTE OneToOne 1 100 0.00 255.0 FORMAT "%5.1" ECU_ADDRESS 0x6000F3F3 /end MEASUREMENT
/begin MEASUREMENT I14229SDAEVAP_stVal "Status message of SDA EVAP control" UWORD OneToOne 1 100 0.00 65535.00 FORMAT "%8.2" ECU_ADDRESS 0x60009486 /end MEASUREMENT
/begin MEASUREMENT I14229ThrVlv_stVal "Status information for throttle valve MDA test" UWORD OneToOne 1 100 0.00 65535.00 FORMAT "%8.2" ECU_ADDRESS 0x60009484 /end MEASUREMENT
/begin MEASUREMENT I14229TrbCh_stVal "Status information for Turbor Charge Bank 1 SDA test" UWORD OneToOne 1 100 0.00 65535.00 FORMAT "%8.2" ECU_ADDRESS 0x60009482 /end MEASUREMENT
/begin MEASUREMENT I14229VentShtVlv_stVal "Status Value for Vent Shut Valve control" UWORD OneToOne 1 100 0.00 65535.00 FORMAT "%8.2" ECU_ADDRESS 0x60009480 /end MEASUREMENT
/begin MEASUREMENT I14229VlvLft_stVal "Status information for Throttle valve SDA test" UWORD OneToOne 1 100 0.00 65535.00 FORMAT "%8.2" ECU_ADDRESS 0x6000947E /end MEASUREMENT
/begin MEASUREMENT I14229_nrABSFailCncl "Possible number of ABS fail safe action canceller execution" UBYTE OneToOne 1 100 0.00 255.0 FORMAT "%5.1" ECU_ADDRESS 0x6000F40D /end MEASUREMENT
/begin MEASUREMENT I14229_stABSFailCnclActv "Status of ABS fail safe action activation" UBYTE OneToOne 1 100 0.00 255.0 FORMAT "%5.1" ECU_ADDRESS 0x6000F409 /end MEASUREMENT
/begin MEASUREMENT I14229_stABSFailCnclStart_mp "ABS fail safe action canceller start request flag" UBYTE OneToOne 1 100 0.00 255.0 FORMAT "%5.1" ECU_ADDRESS 0x7000A31D /end MEASUREMENT
/begin MEASUREMENT I14229_stABSFailCnclStop_mp "ABS fail safe action canceller stop request flag" UBYTE OneToOne 1 100 0.00 255.0 FORMAT "%5.1" ECU_ADDRESS 0x7000A31C /end MEASUREMENT
/begin MEASUREMENT I14229_stACCompDeActvOn "Status of A/C clutch operating Limit Action" UBYTE OneToOne 1 100 0.00 255.0 FORMAT "%5.1" ECU_ADDRESS 0x6000F408 /end MEASUREMENT
/begin MEASUREMENT I14229_stACCompDeActvReq "Status of A/C clutch operating Limit request from the Tester" UBYTE OneToOne 1 100 0.00 255.0 FORMAT "%5.1" ECU_ADDRESS 0x6000F407 /end MEASUREMENT
/begin MEASUREMENT I14229_stAirVent "AirVent test status" UBYTE OneToOne 1 100 0.00 255.0 FORMAT "%5.1" ECU_ADDRESS 0x6000F7C4 /end MEASUREMENT
/begin MEASUREMENT I14229_stEepStoreEepramRc "Status of programming learning values" UBYTE OneToOne 1 100 0.00 255.0 FORMAT "%5.1" ECU_ADDRESS 0x6000F83A /end MEASUREMENT
/begin MEASUREMENT I14229_stFlPmpReq "status of request to make puel pump ON through tester" UBYTE OneToOne 1 100 0.00 255.0 FORMAT "%5.1" ECU_ADDRESS 0x6000E829 /end MEASUREMENT
/begin MEASUREMENT I14229_stHpFlInjCdnIdl "Operation status of high pressure fuel injection routine" UBYTE OneToOne 1 100 0.00 255.0 FORMAT "%5.1" ECU_ADDRESS 0x6000F839 /end MEASUREMENT
/begin MEASUREMENT I14229_stIdlStopCdn "Idle stop condition relieve mode status flag" UBYTE OneToOne 1 100 0.00 255.0 FORMAT "%5.1" ECU_ADDRESS 0x6000EF64 /end MEASUREMENT
/begin MEASUREMENT I14229_stIdlStopPhd "Status of Idling stop prohibition mode request" UBYTE OneToOne 1 100 0.00 255.0 FORMAT "%5.1" ECU_ADDRESS 0x6000F838 /end MEASUREMENT
/begin MEASUREMENT I14229_stMDA "status of requested DID is an MDA request." UBYTE OneToOne 1 100 0.00 255.0 FORMAT "%5.1" ECU_ADDRESS 0x6000F837 /end MEASUREMENT
/begin MEASUREMENT I14229_stOilFlowCompl "Signal corresponding to Status of oil flow completion" UBYTE OneToOne 1 100 0.00 255.0 FORMAT "%5.1" ECU_ADDRESS 0x6000F3FE /end MEASUREMENT
/begin MEASUREMENT I14229_stSDA "status of requested DID is an SDA request." UBYTE OneToOne 1 100 0.00 255.0 FORMAT "%5.1" ECU_ADDRESS 0x6000F836 /end MEASUREMENT
/begin MEASUREMENT I14229_tiOilFlowCompl "Signal corresponding to oil flow completion time" UBYTE Time_sec_q1_COMPU 1 100 0.00 255.0 FORMAT "%5.1" ECU_ADDRESS 0x6000F3F7 /end MEASUREMENT
/begin MEASUREMENT iniPRail "saved initial presssure in rail" UWORD RBPtCel_p_0p002_1 1 100 0.00 131.0700 FORMAT "%8.4" ECU_ADDRESS 0x60001068 /end MEASUREMENT
/begin MEASUREMENT iniPRailEngOff "rail pressure at engine shut off" UWORD RBPtCel_p_0p002_1 1 100 0.00 131.0700 FORMAT "%8.4" ECU_ADDRESS 0x60001066 /end MEASUREMENT
/begin MEASUREMENT pDrpAllwd_loc "allowed pressure drop in stop phase in StopStart-mode" UWORD RBPtCel_p_0p002_1 1 100 0.00 131.0700 FORMAT "%8.4" ECU_ADDRESS 0x60001064 /end MEASUREMENT
/begin MEASUREMENT tdiffengfl "Temperature diffenrence of engine and fuel temperature" UBYTE temp_ub_q0p75_o48 1 100 -48.0 143.3 FORMAT "%5.1" ECU_ADDRESS 0x60001062 /end MEASUREMENT
/begin FUNCTION DcmDspUDS_IOCBI "1997.5.0  DCM UDS Input Output Control By Identifier"
 /begin DEF_CHARACTERISTIC Com_stConvTrgLftMDA_CUR I14229iocbi_agPHAACTRINTK1_C I14229iocbi_agPHAACTRINTK2_C I14229iocbi_agPHAACTRINTK3_C I14229iocbi_agPHAACTROUTL1_C I14229iocbi_agPHAACTROUTL2_C I14229iocbi_agPHAACTROUTL3_C I14229iocbi_nCP_C I14229iocbi_nHiRpmColdStrtFlPmp_C I14229iocbi_nInjRateAmnt_C I14229iocbi_nInjVlvCyl_C I14229iocbi_nInjVlv_C I14229iocbi_nOilPCtrlHi1_C I14229iocbi_nOilPCtrlHi2_C I14229iocbi_nOilPCtrlLo1_C I14229iocbi_nOilPCtrlLo2_C I14229iocbi_nRvsLck_C I14229iocbi_nSDAOilPCtrl_C I14229iocbi_nTrbCh_C I14229iocbi_numAirCCmpr_C I14229iocbi_numAPP_C I14229iocbi_numCP_C I14229iocbi_numDuv_C I14229iocbi_numEGRVlv_C I14229iocbi_numEVAP_C I14229iocbi_numFanDig_C I14229iocbi_numFlPmp_C I14229iocbi_numInjRateAmnt_C I14229iocbi_numInjTstFlg1_C I14229iocbi_numInjTstFlg_C I14229iocbi_numMDAAltIO_C I14229iocbi_numMDACP_C I14229iocbi_numMDADuv_C I14229iocbi_numMDAEGRVlv_C I14229iocbi_numMDAFanDig_C I14229iocbi_numMDAICEWP_C I14229iocbi_numMDAVlvLft_C I14229iocbi_numOilPCtrl_C I14229iocbi_numPHAACTRINTK_C I14229iocbi_numPHAACTROUTL_C I14229iocbi_numRvsLck_C I14229iocbi_numSDAICEWP_C I14229iocbi_numSDAOilPCtrl_C I14229iocbi_numThrVlv_C I14229iocbi_numTrbCh_C I14229iocbi_numVentShtVlv_C I14229iocbi_numVlvLft_C I14229iocbi_nVlvLftHi_C I14229iocbi_nVlvLftLo_C I14229iocbi_pFuTankPMaxEVAP_C I14229iocbi_pFuTankPMinEVAP_C I14229iocbi_pInjRateAmnt_C I14229iocbi_rDuv1_C I14229iocbi_rDuv2_C I14229iocbi_rMDADuv1_C I14229iocbi_rMDADuv2_C I14229iocbi_rPCSdutyCond_C I14229iocbi_rTrbChCls_C I14229iocbi_rTrbChOpen_C I14229iocbi_stVentShtVlv0_C I14229iocbi_stVentShtVlv1_C I14229iocbi_tEGRVlvHi_C I14229iocbi_tEGRVlvLo_C I14229iocbi_tFanDig_C I14229iocbi_tInjRateAmntHi_C I14229iocbi_tInjRateAmntLo_C I14229iocbi_tInjTstCylHi_C I14229iocbi_tInjTstCylLo_C I14229iocbi_tOilPCtrlHi_C I14229iocbi_tOilPCtrlLo_C I14229iocbi_tPHAACTRINTKHi_C I14229iocbi_tPHAACTRINTKLo_C I14229iocbi_tPHAACTROUTLHi_C I14229iocbi_tPHAACTROUTLLo_C I14229iocbi_tSDAOilPCtrlHi_C I14229iocbi_tSDAOilPCtrlLo_C I14229iocbi_tSDAOilT_C I14229iocbi_tVlvLft_C I14229iocbi_uAirCCmpr_C I14229iocbi_uCPRun_C I14229iocbi_uCP_C I14229iocbi_uDuvRun_C I14229iocbi_uDuv_C I14229iocbi_uEGRVlv_C I14229iocbi_uEVAP_C I14229iocbi_uFanDigRun_C I14229iocbi_uFanDigStl_C I14229iocbi_uFlPmpRun_C I14229iocbi_uFlPmpStl_C I14229iocbi_uInjRateAmntRun_C I14229iocbi_uInjRateAmnt_C I14229iocbi_uInjTstRun_C I14229iocbi_uInjTstStl_C I14229iocbi_uMDACPRun_C I14229iocbi_uMDACP_C I14229iocbi_uMDADuvRun_C I14229iocbi_uMDADuv_C I14229iocbi_uOilPCtrl_C I14229iocbi_uPHAACTRINTKRun_C I14229iocbi_uPHAACTRINTKStl_C I14229iocbi_uPHAACTROUTL_C I14229iocbi_uSDAOilPCtrl_C I14229iocbi_uThrVlv_C I14229iocbi_uTrbCh_C I14229iocbi_uVentShtVlv_C I14229iocbi_uVlvLftRun_C I14229iocbi_uVlvLftStl_C I14229iocbi_vAPP_C I14229iocbi_vRvsLck_C I14229_AirCCmpr_stMsk_CA I14229_AltIO_stMskMDA_CA I14229_APP_stMskMDA_CA I14229_CP_stMskMDA_CA I14229_CP_stMsk_CA I14229_Duv_stMskMDA_CA I14229_Duv_stMsk_CA I14229_EGRVlv_stMskMDA_CA I14229_EGRVlv_stMsk_CA I14229_EVAP_stMsk_CA I14229_FanDig_stMskMDA_CA I14229_FanDig_stMsk_CA I14229_FlPmp_stMsk_CA I14229_ICEWP_stMskMDA_CA I14229_ICEWP_stMsk_CA I14229_InjRateAmnt_stMsk_CA I14229_InjTst1_stMsk_CA I14229_InjTst_stMsk_CA I14229_OilCtlSt0_C I14229_OilCtlSt1_C I14229_OilPCtrl_stMskMDA_CA I14229_OilPCtrl_stMsk_CA I14229_PHAACTRINTK_stMsk_CA I14229_PHAACTROUTL_stMsk_CA I14229_rAppLETThd_C I14229_ratCoolg_C I14229_RvsLck_stMskMDA_CA I14229_stCACPmpRlyOFF_C I14229_stCACPmpRlyON_C I14229_stIOCBIMskSuprtMDA_C I14229_stIOCBIMskSuprtSDA_C I14229_ThrVlv_stMsk_CA I14229_tiThrVlvMax_C I14229_TrbCh_stMsk_CA I14229_VentShtVlv_stMsk_CA I14229_VlvLft_stMskMDA_CA I14229_VlvLft_stMsk_CA I14229_wACT_C I14229_wFlPmp_C I14229_wRvsLck_C /end DEF_CHARACTERISTIC
 /begin IN_MEASUREMENT AirC_stSwt APP_r APP_rAppPrev APP_stLETAbort BattU_u Brk_st CACPmp_uPlausyHiThd CACPmp_uPlausyLoThd CEngDsT_t Clth_st CoEng_st Com_stShftInNeutr Com_stShftInPark Epm_nEng Gbx_stNPos HLSDem_nSetPLo I14229_ps_w I14229_rPCSDuty I14229_stForceActvTmr I14229_stPHAACTRINTKTmr I14229_stPHAACTROUTLTmr MoFETC_flgMonDiagEnaPlausMsg ptek_w_msg PT_stTraType VehV_v wped_w /end IN_MEASUREMENT
 /begin OUT_MEASUREMENT Com_lEGRCtlStMDA Com_rEGRIntValMDA I14229AirCCmpr_stVal I14229CP_stVal I14229Duv_stVal I14229EGRVlv_stVal I14229FanDig_stVal I14229FlPmp_stVal I14229ICEWP_stVal I14229InjRateAmnt_stVal I14229InjTstFlg1_stVal I14229InjTstFlg_stVal I14229iocbi_numActivMDA I14229iocbi_numActivSFT I14229iocbi_numDID I14229iocbi_numResp I14229iocbi_numSt I14229iocbi_stSFT I14229iocpMDA_numABV I14229iocpMDA_numACGC I14229iocpMDA_numAPS I14229iocpMDA_numICEWP I14229iocpMDA_numOilPCtrl I14229iocpMDA_numPSC I14229iocpMDA_numRFAN I14229iocpMDA_numRvsLck I14229iocpMDA_numVTEC I14229iocpMDA_stABV I14229iocpMDA_stACGC I14229iocpMDA_stAPS I14229iocpMDA_stEGR I14229iocpMDA_stICEWP I14229iocpMDA_stOilPCtrl I14229iocpMDA_stPSC I14229iocpMDA_stRFAN I14229iocpMDA_stRvsLck I14229iocpMDA_stVTEC I14229iocpSDA_stEGR I14229iocp_numCtlSt I14229iocp_numEXE I14229iocp_numREQ I14229iocp_stAInjDAct I14229iocp_stSFTRJC I14229MDAAltIO_stVal I14229MDAAPS_stVal I14229MDACP_stVal I14229MDADuv_stVal I14229MDAEGRVlv_stVal I14229MDAFAN_stVal I14229MDAICEWP_stVal I14229MDAOilPCtrl_stVal I14229MDARvsLck_stVal I14229MDAVTEC_stVal I14229OilPCtrl_stVal I14229PHAACTRINTK_stVal I14229PHAACTROUTL_stVal I14229SDAEVAP_stVal I14229ThrVlv_stVal I14229TrbCh_stVal I14229VentShtVlv_stVal I14229VlvLft_stVal I14229_stAirVent I14229_stFlPmpReq I14229_stMDA I14229_stSDA /end OUT_MEASUREMENT
 /begin LOC_MEASUREMENT I14229iocpMDA_numEGR /end LOC_MEASUREMENT
 FUNCTION_VERSION "1997.5.0" /end FUNCTION
/begin FUNCTION DcmDspUDS_RDTC "1997.1.0  DCM UDS Read DTC Information"
 /begin DEF_CHARACTERISTIC I14229_ctTxWaitRepDTC_C I14229_ctTxWaitSuppDTC_C I14229_ctWaitNumDTC_C I14229_ctWaitRepDTC_C I14229_ctWaitSuppDTC_C I14229_swtDTCLowByte_C /end DEF_CHARACTERISTIC
 FUNCTION_VERSION "1997.1.0" /end FUNCTION
/begin FUNCTION DcmDspUDS_RID "1997.6.0  Configuration and Implementation of the Routines for the DCM UDS Service RoutineControl (RC)"
 /begin DEF_CHARACTERISTIC I14229_iACCompCmprSol_C I14229_nACSafHysHi_C I14229_nACSafHysLo_C I14229_nEngHysHi_C I14229_nEngHysLo_C I14229_nHpFlInjCdnIdlHi_C I14229_nHpFlInjCdnIdlLo_C I14229_nrABSFailCnclMax_C I14229_nrABSFailCnclSubs_C I14229_stACCompDeActvReqSubs_C I14229_stEVAPSwt_C I14229_stOilFlowComplSubs_C I14229_tHpFlInjCdnIdlHi_C I14229_tHpFlInjCdnIdlLo_C I14229_tiOilFlowComplSubs_C I14229_uHpFlInjCdnIdl_C I14229_vHpFlInjCdnIdl_C I14229_vRCCrCtl_C /end DEF_CHARACTERISTIC
 /begin IN_MEASUREMENT ACCI_aReq ACComp_flgVblDplCmprJdg ACComp_iCmprSol AirC_stPsCmpr BattU_u B_fatlde_msg B_fatlds_msg CEngDsT_t Com_stMisfDetLineEnd Com_stShftInNeutr Com_stShftInPark Epm_nEng I14229_stSuppRst PT_stTraType StSpSwt_stSelTyp T15_st VehV_v /end IN_MEASUREMENT
 /begin OUT_MEASUREMENT DcmAppl_flgAuthentPassd DcmDspUds_flgAuthentRejctd DcmDspUds_flgSessionKeyRegstSt I14229rcCrCtl_stLmp I14229_nrABSFailCncl I14229_stABSFailCnclActv I14229_stABSFailCnclStart_mp I14229_stABSFailCnclStop_mp I14229_stACCompDeActvOn I14229_stACCompDeActvReq I14229_stHpFlInjCdnIdl I14229_stIdlStopCdn I14229_stOilFlowCompl I14229_tiOilFlowCompl /end OUT_MEASUREMENT
 /begin LOC_MEASUREMENT I14229_stEepStoreEepramRc I14229_stIdlStopPhd /end LOC_MEASUREMENT
 FUNCTION_VERSION "1997.6.0" /end FUNCTION
/begin FUNCTION DcmDspUDS_RMBA "10.1.0_1.0.0DCM UDS Read Memory By Address"
 /begin DEF_CHARACTERISTIC I14229_dRMBAEna_C I14229_stRMBADFlashBlkEna_C I14229_stRMBADS0BlkEna_C I14229_stRMBASecuEna_C /end DEF_CHARACTERISTIC
 FUNCTION_VERSION "10.1.0_1.0.0" /end FUNCTION
/begin FUNCTION DDHFHD "51.7.0    Diagnose pressure drop high pressure system"
 /begin DEF_CHARACTERISTIC CWDDHFHD DDHFHD_pDrpAllwd_T DDHFHD_pMaxHldFctRels_C DDHFHD_pMinHldFctRels_C DDHFHD_pSysMin_C DDHFHD_pThresEngOff_C TDDHFCMP TDDHFCMPNL TDDHFMXSTP TDHFBNMN TDHFNLBNMN TMOTDHFENA TOLDIFFTKL TOLRTDHFKL /end DEF_CHARACTERISTIC
 /begin IN_MEASUREMENT CEngDsT_t EngStrt_bFrstStrtEnd Epm_stSpd FlSys_tFlHPSys FuPHi_pRail SyC_stSub tengsq1_w_msg /end IN_MEASUREMENT
 /begin LOC_MEASUREMENT B_ddhfhdtst_loc B_dhfena B_dhfenast B_dhferhea B_healafterun_loc B_strtstopena ddhfhd_debRepCheck HiPSys_tFuHiPDDHFHD iniPRail iniPRailEngOff pDrpAllwd_loc tdiffengfl /end LOC_MEASUREMENT
 FUNCTION_VERSION "51.7.0" /end FUNCTION
/begin FUNCTION DDRC "30000.21.1Diagnostic Debounce and Report of Check"
 /begin DEF_CHARACTERISTIC DDRC_DurDeb.AFS_tiPhyRngChkHiDebOk_C DDRC_DurDeb.AFS_tiPhyRngChkHiDebDef_C DDRC_DurDeb.AFS_tiPhyRngChkLoDebOk_C DDRC_DurDeb.AFS_tiPhyRngChkLoDebDef_C DDRC_DurDeb.AirC_tiCmprOLDebOk_C DDRC_DurDeb.AirC_tiCmprOLDebDef_C DDRC_DurDeb.AirC_tiCmprOvrTempDebOk_C DDRC_DurDeb.AirC_tiCmprOvrTempDebDef_C DDRC_DurDeb.AirC_tiCmprSCBDebOk_C DDRC_DurDeb.AirC_tiCmprSCBDebDef_C DDRC_DurDeb.AirC_tiCmprSCGDebOk_C DDRC_DurDeb.AirC_tiCmprSCGDebDef_C DDRC_DurDeb.Alt_tiErrDebOk_C DDRC_DurDeb.Alt_tiErrDebDef_C DDRC_DurDeb.BattU_tiMaxDebOk_C DDRC_DurDeb.BattU_tiMaxDebDef_C DDRC_DurDeb.BattU_tiMinDebOk_C DDRC_DurDeb.BattU_tiMinDebDef_C DDRC_DurDeb.Com_tiChksTCU1DebOk_C DDRC_DurDeb.Com_tiChksTCU1DebDef_C DDRC_DurDeb.Com_tiChksTCU11DebOk_C DDRC_DurDeb.Com_tiChksTCU11DebDef_C DDRC_DurDeb.Com_tiChksTCU12DebOk_C DDRC_DurDeb.Com_tiChksTCU12DebDef_C DDRC_DurDeb.Com_tiChksTCU13DebOk_C DDRC_DurDeb.Com_tiChksTCU13DebDef_C DDRC_DurDeb.Com_tiChksTCU2DebOk_C DDRC_DurDeb.Com_tiChksTCU2DebDef_C DDRC_DurDeb.Com_tiChksTCU3DebOk_C DDRC_DurDeb.Com_tiChksTCU3DebDef_C DDRC_DurDeb.Com_tiChksTCU4DebOk_C DDRC_DurDeb.Com_tiChksTCU4DebDef_C DDRC_DurDeb.Com_tiCntTCU1DebOk_C /end DEF_CHARACTERISTIC
 /begin IN_MEASUREMENT Dem_disableEventStatusUpdateGroup /end IN_MEASUREMENT
 /begin LOC_MEASUREMENT DDRC_St.DFC_AAVEmax DDRC_St.DFC_AAVEmin DDRC_St.DFC_AAVEsig DDRC_St.DFC_AltIOACGFailr DDRC_St.DFC_AltIOACGHiVltg DDRC_St.DFC_AltIOACGLoVltg DDRC_St.DFC_AltIOACGTHi DDRC_St.DFC_AltIODConnACG DDRC_St.DFC_BGOELWAF DDRC_St.DFC_BattUHiFailr DDRC_St.DFC_BattULoFailr DDRC_St.DFC_BrkBstPDriftHiErr DDRC_St.DFC_BrkBstPDriftLoErr DDRC_St.DFC_BrkBstPSnsrStuck DDRC_St.DFC_BrkMnSwtContOn DDRC_St.DFC_BrkMnSwtNotStp DDRC_St.DFC_BrkNpl DDRC_St.DFC_BrkRdntSwtContOn DDRC_St.DFC_BrkRdntSwtNotStp DDRC_St.DFC_Clth3ONStuck DDRC_St.DFC_Clth4OFFStuck DDRC_St.DFC_ClthOFFStuck DDRC_St.DFC_ClthONStuck DDRC_St.DFC_ClthStkFailInfo DDRC_St.DFC_ComACFailInfo DDRC_St.DFC_ComATFTValErr DDRC_St.DFC_ComATMILReq DDRC_St.DFC_ComAYCAChksum DDRC_St.DFC_ComAYCARingCnt DDRC_St.DFC_ComAYCATOut DDRC_St.DFC_ComAYCDChkSum DDRC_St.DFC_ComAYCDTOut DDRC_St.DFC_ComAYCFChksum DDRC_St.DFC_ComAYCFRingCnt DDRC_St.DFC_ComAYCFTOut DDRC_St.DFC_ComAYCGChksum DDRC_St.DFC_ComAYCGRingCnt DDRC_St.DFC_ComAYCGTOut DDRC_St.DFC_ComAYCIChkSum DDRC_St.DFC_ComAYCIRingCnt DDRC_St.DFC_ComAYCITOut DDRC_St.DFC_ComBCM1ChkSum DDRC_St.DFC_ComBCM1RingCnt DDRC_St.DFC_ComBCM1TOut DDRC_St.DFC_ComCANABusOffErr DDRC_St.DFC_ComCANBBusOffErr DDRC_St.DFC_ComCANCBusOffErr DDRC_St.DFC_ComCGW1ChkSum DDRC_St.DFC_ComCGW1RingCnt DDRC_St.DFC_ComCGW1TOut DDRC_St.DFC_ComConvBoostErr DDRC_St.DFC_ComConvSlipErr DDRC_St.DFC_ComDCDCPrfmncErr DDRC_St.DFC_ComDCDCTempWarn DDRC_St.DFC_ComEAT10Chksum DDRC_St.DFC_ComEAT10RingCnt DDRC_St.DFC_ComEAT10TOut DDRC_St.DFC_ComEAT11ChkSum DDRC_St.DFC_ComEAT11RingCnt DDRC_St.DFC_ComEAT11TOut DDRC_St.DFC_ComEAT12ChkSum DDRC_St.DFC_ComEAT12RingCnt DDRC_St.DFC_ComEAT12TOut DDRC_St.DFC_ComEAT13ChkSum DDRC_St.DFC_ComEAT13RingCnt DDRC_St.DFC_ComEAT13TOut DDRC_St.DFC_ComEAT1Chksum DDRC_St.DFC_ComEAT1RingCnt DDRC_St.DFC_ComEAT1TOut DDRC_St.DFC_ComEAT2ChkSum DDRC_St.DFC_ComEAT2RingCnt DDRC_St.DFC_ComEAT2TOut DDRC_St.DFC_ComEAT4ChkSum DDRC_St.DFC_ComEAT4RingCnt DDRC_St.DFC_ComEAT4TOut DDRC_St.DFC_ComEAT6Chksum DDRC_St.DFC_ComEAT6RingCnt DDRC_St.DFC_ComEAT6TOut DDRC_St.DFC_ComEAT7Chksum DDRC_St.DFC_ComEAT7RingCnt DDRC_St.DFC_ComEAT7TOut DDRC_St.DFC_ComEAT8Chksum DDRC_St.DFC_ComEAT8RingCnt DDRC_St.DFC_ComEAT8TOut DDRC_St.DFC_ComEATAChksum DDRC_St.DFC_ComEATARingCnt DDRC_St.DFC_ComEATATOut DDRC_St.DFC_ComEATBChkSum DDRC_St.DFC_ComEATBRingCnt DDRC_St.DFC_ComEATBTOut DDRC_St.DFC_ComEATCChksum DDRC_St.DFC_ComEATCRingCnt DDRC_St.DFC_ComEATCTOut DDRC_St.DFC_ComEPBBChkSum DDRC_St.DFC_ComEPBBRingCnt DDRC_St.DFC_ComEPBBTOut DDRC_St.DFC_ComEPBChksum DDRC_St.DFC_ComEPBTOut DDRC_St.DFC_ComEPBctRing DDRC_St.DFC_ComEPS1Chksum DDRC_St.DFC_ComEPS1RingCnt DDRC_St.DFC_ComEPS1TOut DDRC_St.DFC_ComEngCanRxErr DDRC_St.DFC_ComGrvySnsrErr DDRC_St.DFC_ComGwIMG1ChkSum DDRC_St.DFC_ComGwIMG1RingCnt DDRC_St.DFC_ComGwIMG1TOut DDRC_St.DFC_ComGwIMG3ChkSum DDRC_St.DFC_ComGwIMG3RingCnt DDRC_St.DFC_ComGwIMG3TOut DDRC_St.DFC_ComGwIMG4ChkSum DDRC_St.DFC_ComGwIMG4RingCnt DDRC_St.DFC_ComGwIMG4TOut DDRC_St.DFC_ComGwIMG5ChkSum DDRC_St.DFC_ComGwIMG5RingCnt DDRC_St.DFC_ComGwIMG5TOut DDRC_St.DFC_ComGwIMG6ChkSum DDRC_St.DFC_ComGwIMG6RingCnt DDRC_St.DFC_ComGwIMG6TOut DDRC_St.DFC_ComIDASBChksum DDRC_St.DFC_ComIDASBRingCnt DDRC_St.DFC_ComIDASBTOut DDRC_St.DFC_ComIMGMILReq DDRC_St.DFC_ComISSPrms DDRC_St.DFC_ComMETAChksum DDRC_St.DFC_ComMETAChksumPstDrv DDRC_St.DFC_ComMETARingCnt DDRC_St.DFC_ComMETARingCntPstDrv DDRC_St.DFC_ComMETATOut DDRC_St.DFC_ComMETATOutPstDrv DDRC_St.DFC_ComMETCChksum DDRC_St.DFC_ComMETCRingCnt DDRC_St.DFC_ComMETCTOut DDRC_St.DFC_ComMETDChksum DDRC_St.DFC_ComMETDRingCnt DDRC_St.DFC_ComMETDTOut DDRC_St.DFC_ComMETE2Chksum DDRC_St.DFC_ComMETE2RingCnt DDRC_St.DFC_ComMETE2TOut DDRC_St.DFC_ComMETFChksum DDRC_St.DFC_ComMETFRingCnt DDRC_St.DFC_ComMETFTOut DDRC_St.DFC_ComMETGChksum DDRC_St.DFC_ComMETGRingCnt DDRC_St.DFC_ComMETGTOut DDRC_St.DFC_ComMETH2Chksum DDRC_St.DFC_ComMETH2RingCnt DDRC_St.DFC_ComMETH2TOut DDRC_St.DFC_ComMETHChksum DDRC_St.DFC_ComMETHRingCnt DDRC_St.DFC_ComMETHTOut DDRC_St.DFC_ComMETIChksum DDRC_St.DFC_ComMETIRingCnt DDRC_St.DFC_ComMETITOut DDRC_St.DFC_ComMETKChksum DDRC_St.DFC_ComMETKRingCnt DDRC_St.DFC_ComMETKTOut DDRC_St.DFC_ComMETLChksum DDRC_St.DFC_ComMETLRingCnt DDRC_St.DFC_ComMETLTOut DDRC_St.DFC_ComMETMChksum DDRC_St.DFC_ComMETMRingCnt DDRC_St.DFC_ComMETMTOut DDRC_St.DFC_ComMETNChksum DDRC_St.DFC_ComMETNRingCnt DDRC_St.DFC_ComMETNTOut DDRC_St.DFC_ComMtrCom DDRC_St.DFC_ComPCUChkSum DDRC_St.DFC_ComPCURingCnt DDRC_St.DFC_ComPCUTOut DDRC_St.DFC_ComSRSAChksum DDRC_St.DFC_ComSRSARingCnt DDRC_St.DFC_ComSRSATOut DDRC_St.DFC_ComSRSBChksum DDRC_St.DFC_ComSRSBRingCnt DDRC_St.DFC_ComSRSBTOut DDRC_St.DFC_ComSRSChksum DDRC_St.DFC_ComSRSErr DDRC_St.DFC_ComSRSRingCnt DDRC_St.DFC_ComSRSTOut DDRC_St.DFC_ComVehSpdPndFltTCU DDRC_St.DFC_EbsChartcCurrErr DDRC_St.DFC_EbsSelfDiagErr DDRC_St.DFC_GEVlvPhaCsersIntkB1 DDRC_St.DFC_GEVlvPhaPsOpenLoadIntkB1 DDRC_St.DFC_GEVlvPhaPsShoToBattIntkB1 DDRC_St.DFC_GEVlvPhaPsShoToGndIntkB1 DDRC_St.DFC_GbxCANDigPlausErr DDRC_St.DFC_GbxNPos1SRCMax DDRC_St.DFC_GbxNPos1SRCMin DDRC_St.DFC_GbxNPos2SRCMax DDRC_St.DFC_GbxNPos2SRCMin DDRC_St.DFC_GbxNPosAlvChk DDRC_St.DFC_GbxNPosSyncErr DDRC_St.DFC_HEGOS2B1HtrPsMax DDRC_St.DFC_HEGOS2B1HtrPsMin DDRC_St.DFC_HEGOS2B1HtrPsSig DDRC_St.DFC_LinCSErrACG DDRC_St.DFC_LinCSErrAEV DDRC_St.DFC_LinCSErrDCDC DDRC_St.DFC_LinCSErrEBS DDRC_St.DFC_LinHdrTimeoutErrACG DDRC_St.DFC_LinHdrTimeoutErrAEV DDRC_St.DFC_LinHdrTimeoutErrDCDC DDRC_St.DFC_LinHdrTimeoutErrEBS DDRC_St.DFC_LinMsgTimeoutErrACG DDRC_St.DFC_LinMsgTimeoutErrAEV DDRC_St.DFC_LinMsgTimeoutErrDCDC DDRC_St.DFC_LinMsgTimeoutErrEBS DDRC_St.DFC_LinNoStrtComErr DDRC_St.DFC_LowPresOilP DDRC_St.DFC_MisfDetVWhlFrntLeOORHi DDRC_St.DFC_MisfDetVWhlFrntLeRatyHi DDRC_St.DFC_MisfDetVWhlFrntLeRatyLo DDRC_St.DFC_MisfDetVWhlFrntLeStuck DDRC_St.DFC_MisfDetVWhlFrntRiOORHi DDRC_St.DFC_MisfDetVWhlFrntRiRatyHi DDRC_St.DFC_MisfDetVWhlFrntRiRatyLo DDRC_St.DFC_MisfDetVWhlFrntRiStuck DDRC_St.DFC_MisfDetVWhlReLeOORHi DDRC_St.DFC_MisfDetVWhlReLeRatyHi DDRC_St.DFC_MisfDetVWhlReLeRatyLo DDRC_St.DFC_MisfDetVWhlReLeStuck DDRC_St.DFC_MisfDetVWhlReRiOORHi DDRC_St.DFC_MisfDetVWhlReRiRatyHi DDRC_St.DFC_MisfDetVWhlReRiRatyLo DDRC_St.DFC_MisfDetVWhlReRiStuck DDRC_St.DFC_MisfDetdVWhlFrntLePlaus DDRC_St.DFC_MisfDetdVWhlFrntRiPlaus DDRC_St.DFC_MisfDetdVWhlReLePlaus DDRC_St.DFC_MisfDetdVWhlReRiPlaus DDRC_St.DFC_PEnvSigRngMax DDRC_St.DFC_PEnvSigRngMin DDRC_St.DFC_StmFault DDRC_St.DFC_StrtCtOffPth DDRC_St.DFC_StrtCtlErr DDRC_St.DFC_StrtFault DDRC_St.DFC_StrtLckJudg1 DDRC_St.DFC_StrtLckJudg2 DDRC_St.DFC_StrtOL DDRC_St.DFC_StrtOL2 DDRC_St.DFC_StrtSCB DDRC_St.DFC_StrtSCB2 DDRC_St.DFC_StrtSCG DDRC_St.DFC_StrtSCG2 DDRC_St.DFC_StrtStkRly1 DDRC_St.DFC_StrtStkRly2 DDRC_St.DFC_TEVEmax DDRC_St.DFC_TEVEmin DDRC_St.DFC_TEVEsig DDRC_St.DFC_UegoHeatrPrfmncLoS1B1 DDRC_St.DFC_VehVAllPlaus DDRC_St.DFC_VehVNCSnsrElecFailr DDRC_St.DFC_VehVPlausCan DDRC_St.DFC_VehVPlausFco DDRC_St.DFC_VehVPlausPwr DDRC_St.DFC_VehVPlausV2N DDRC_St.DFC_VehVSpdSnsrAElecFailr DDRC_St.DFC_VehVSpdSnsrBElecFailr DDRC_St.DFC_ClthMax DDRC_St.DFC_IgnClPs_DevComErr DDRC_St.DFC_IgnClPs_LineOl_0 DDRC_St.DFC_IgnClPs_LineOl_1 DDRC_St.DFC_IgnClPs_LineOl_2 DDRC_St.DFC_IgnClPs_LineOl_3 DDRC_St.DFC_IgnClPs_LineScb_0 DDRC_St.DFC_IgnClPs_LineScb_1 DDRC_St.DFC_IgnClPs_LineScb_2 DDRC_St.DFC_IgnClPs_LineScb_3 DDRC_St.DFC_IgnClPs_LineScg_0 DDRC_St.DFC_IgnClPs_LineScg_1 DDRC_St.DFC_IgnClPs_LineScg_2 DDRC_St.DFC_IgnClPs_LineScg_3 DDRC_St.DFC_KRVEKOEVAB DDRC_St.DFC_KRVEKOEVAB0 DDRC_St.DFC_KRVEKOEVAB1 DDRC_St.DFC_KRVEKOEVAB2 DDRC_St.DFC_KRVEKOEVAB3 DDRC_St.DFC_UegoSigEcuAsicS1B1 DDRC_St.DFC_UegoSigEcuComS1B1 DDRC_St.DFC_UegoSigSnsrS1B1 DDRC_St.DFC_UegoSigWireOlApesS1B1 DDRC_St.DFC_UegoSigWireOlIpeS1B1 DDRC_St.DFC_UegoSigWireOlReS1B1 DDRC_St.DFC_UegoSigWireRCmpS1B1 DDRC_St.DFC_UegoSigWireScbS1B1 DDRC_St.DFC_UegoSigWireScgS1B1 DDRC_St.DFC_AfsPhyRngHiB1 DDRC_St.DFC_AfsPhyRngLoB1 DDRC_St.DFC_AirCCmprOL DDRC_St.DFC_AirCCmprOvrTemp DDRC_St.DFC_AirCCmprSCB DDRC_St.DFC_AirCCmprSCG DDRC_St.DFC_AltErr DDRC_St.DFC_BattUSRCMax DDRC_St.DFC_BattUSRCMin DDRC_St.DFC_ComChksTCU1 DDRC_St.DFC_ComChksTCU11 DDRC_St.DFC_ComChksTCU12 DDRC_St.DFC_ComChksTCU13 DDRC_St.DFC_ComChksTCU2 DDRC_St.DFC_ComChksTCU3 DDRC_St.DFC_ComChksTCU4 DDRC_St.DFC_ComCntTCU1 DDRC_St.DFC_ComCntTCU11 DDRC_St.DFC_ComCntTCU12 DDRC_St.DFC_ComCntTCU13 DDRC_St.DFC_ComCntTCU2 DDRC_St.DFC_ComCntTCU3 DDRC_St.DFC_ComCntTCU4 DDRC_St.DFC_ComTOutTCU01 DDRC_St.DFC_ComTOutTCU02 DDRC_St.DFC_ComTOutTCU1 DDRC_St.DFC_ComTOutTCU11 DDRC_St.DFC_ComTOutTCU12 DDRC_St.DFC_ComTOutTCU13 DDRC_St.DFC_ComTOutTCU14 DDRC_St.DFC_ComTOutTCU2 DDRC_St.DFC_ComTOutTCU3 DDRC_St.DFC_ComTOutTCU4 DDRC_St.DFC_DevLibBattUHi DDRC_St.DFC_DevLibBattULo DDRC_St.DFC_EGRVlvFailSafeActv DDRC_St.DFC_EGRVlvGovDvtCld DDRC_St.DFC_EGRVlvPhysSRCMax DDRC_St.DFC_EGRVlvPhysSRCMin DDRC_St.DFC_FanDIOOL_0 DDRC_St.DFC_FanDIOOL_1 DDRC_St.DFC_FanDIOOvrTemp_0 DDRC_St.DFC_FanDIOOvrTemp_1 DDRC_St.DFC_FanDIOSCB_0 DDRC_St.DFC_FanDIOSCB_1 DDRC_St.DFC_FanDIOSCG_0 DDRC_St.DFC_FanDIOSCG_1 DDRC_St.DFC_MRlyDcOL DDRC_St.DFC_MRlyDcSCB DDRC_St.DFC_MRlyDcSCG DDRC_St.DFC_PSPOL DDRC_St.DFC_PSPOvrTemp DDRC_St.DFC_PSPSCB DDRC_St.DFC_PSPSCG DDRC_St.DFC_T50Err DDRC_St.DFC_ThrVlvLoBattB1 DDRC_St.DFC_UegoSigOperPlausS1B1 DDRC_St.DFC_VehVPhysRngHi DDRC_St.DFC_VehVSclOutOL DDRC_St.DFC_VehVSclOutOT DDRC_St.DFC_VehVSclOutSCB DDRC_St.DFC_VehVSclOutSCG DDRC_St.DFC_VehVSigFL DDRC_St.DFC_VehVSigFR DDRC_St.DFC_VehVSigRL DDRC_St.DFC_VehVSigRR DDRC_St.DFC_VehVSnsrARngHi DDRC_St.DFC_VehVSnsrBRngHi DDRC_St.DFC_VehVSpdRtyDiag DDRC_St.DFC_DHFHD DDRC_St.DFC_InjVlv_DI_DcDc DDRC_St.DFC_InjVlv_DI_NoLd_0 DDRC_St.DFC_InjVlv_DI_NoLd_1 DDRC_St.DFC_InjVlv_DI_NoLd_2 DDRC_St.DFC_InjVlv_DI_NoLd_3 DDRC_St.DFC_InjVlv_DI_ScBnk_0 DDRC_St.DFC_InjVlv_DI_ScBnk_1 DDRC_St.DFC_InjVlv_DI_ScBnk_2 DDRC_St.DFC_InjVlv_DI_ScBnk_3 DDRC_St.DFC_InjVlv_DI_ScCyl_0 DDRC_St.DFC_InjVlv_DI_ScCyl_1 DDRC_St.DFC_InjVlv_DI_ScCyl_2 DDRC_St.DFC_InjVlv_DI_ScCyl_3 DDRC_St.DFC_InjVlv_DI_ScHsLs_0 DDRC_St.DFC_InjVlv_DI_ScHsLs_1 DDRC_St.DFC_InjVlv_DI_ScHsLs_2 DDRC_St.DFC_InjVlv_DI_ScHsLs_3 DDRC_St.DFC_MfPsDiaOpenLoad1 DDRC_St.DFC_MfPsDiaScHiS1 DDRC_St.DFC_MfPsDiaScHiSLowS1 DDRC_St.DFC_MfPsDiaScLowS1 DDRC_St.DFC_ACEvpTPhysRngHi DDRC_St.DFC_ACEvpTPhysRngLo DDRC_St.DFC_ACEvpTSRCMax DDRC_St.DFC_ACEvpTSRCMin DDRC_St.DFC_AfsRawSigRngHiB1 DDRC_St.DFC_AfsRawSigRngLoB1 DDRC_St.DFC_AfsSnsrErrB1 DDRC_St.DFC_AirCClntPAnaSRCMax DDRC_St.DFC_AirCClntPAnaSRCMin DDRC_St.DFC_AirCSwtNpl DDRC_St.DFC_AirCSwtSig DDRC_St.DFC_Brk DDRC_St.DFC_BrkBstSensSCB DDRC_St.DFC_BrkBstSensSCG DDRC_St.DFC_BrkSig DDRC_St.DFC_ClthSig DDRC_St.DFC_EGRVlvCurrLim DDRC_St.DFC_EGRVlvOL DDRC_St.DFC_EGRVlvOvrTemp DDRC_St.DFC_EGRVlvSCB DDRC_St.DFC_EGRVlvSCG DDRC_St.DFC_EGRVlvSRCMax DDRC_St.DFC_EGRVlvSRCMin DDRC_St.DFC_HLSDemOvhtEngLim DDRC_St.DFC_OilPSwmpSRCMax DDRC_St.DFC_OilPSwmpSRCMin DDRC_St.DFC_PIntkVUsLineHiB1 DDRC_St.DFC_PIntkVUsLineLoB1 DDRC_St.DFC_VehVPhysRngLo DDRC_St.DFC_VehVSigCan DDRC_St.DFC_VehVSigCanSafe DDRC_St.DFC_VlvLftFbOilPSnsrIntk11SRCMax DDRC_St.DFC_VlvLftFbOilPSnsrIntk11SRCMin DDRC_St.DFC_ClthNpl DDRC_St.DFC_GbxPNPosnDrvCdn DDRC_St.DFC_GbxPNPosnPlausy DDRC_St.DFC_AfsSigErrLineHiB1 DDRC_St.DFC_AfsSigErrLineLoB1 DDRC_St.DFC_PEnvCcMax DDRC_St.DFC_PEnvCcMin DDRC_St.DFC_PEnvRngChkMax DDRC_St.DFC_PEnvRngChkMin DDRC_St.DFC_PEnvSnsrPlaus DDRC_St.DFC_UEGOHeatrRlyPsOLS1B1 DDRC_St.DFC_UEGOHeatrRlyPsSCBS1B1 DDRC_St.DFC_UEGOHeatrRlyPsSCGS1B1 DDRC_St.DFC_UegoHeatrWireOlS1B1 DDRC_St.DFC_UegoHeatrWireScbS1B1 DDRC_St.DFC_UegoHeatrWireScgS1B1 DDRC_St.DFC_KnDetSens1PortAMax DDRC_St.DFC_KnDetSens1PortAMin DDRC_St.DFC_KnDetSens1PortBMax DDRC_St.DFC_KnDetSens1PortBMin DSM_xTabVersion /end LOC_MEASUREMENT
 FUNCTION_VERSION "30000.21.1" /end FUNCTION
/begin COMPU_METHOD B_TRUE "" TAB_VERB "%6.3" "" COMPU_TAB_REF B_TRUE /end COMPU_METHOD
/begin COMPU_VTAB B_TRUE "" TAB_VERB 2 0 "FALSE" 1 "TRUE" /end COMPU_VTAB
/begin COMPU_METHOD DDRCTime_ms "" RAT_FUNC "%6.1" "ms" COEFFS 0 1 0 0 0 10 /end COMPU_METHOD
/begin COMPU_METHOD DFC_OneToOne "" RAT_FUNC "%6.2" "-" COEFFS 0 1 0 0 0 1 /end COMPU_METHOD
/begin COMPU_METHOD EGSDIA_SNSRTYPES0B2_SC_Compu "" TAB_VERB "%6.3" "" COMPU_TAB_REF EGSDIA_SNSRTYPES0B2_SC_Compu /end COMPU_METHOD
/begin COMPU_VTAB EGSDIA_SNSRTYPES0B2_SC_Compu "" TAB_VERB 4 0 "NO_SENSOR" 1 "UEGO_SENSOR" 2 "NOX_SENSOR" 3 "HEGO_SENSOR" /end COMPU_VTAB
/begin COMPU_METHOD EGSDIA_SNSRTYPES1B1_SC_Compu "" TAB_VERB "%6.3" "" COMPU_TAB_REF EGSDIA_SNSRTYPES1B1_SC_Compu /end COMPU_METHOD
/begin COMPU_VTAB EGSDIA_SNSRTYPES1B1_SC_Compu "" TAB_VERB 4 0 "No_Sensor" 1 "UEGO_Sensor" 2 "NOx_Sensor" 3 "LSF_sensor" /end COMPU_VTAB
/begin COMPU_METHOD EGSDIA_SNSRTYPES1B2_SC_Compu "" TAB_VERB "%6.3" "" COMPU_TAB_REF EGSDIA_SNSRTYPES1B2_SC_Compu /end COMPU_METHOD
/begin COMPU_VTAB EGSDIA_SNSRTYPES1B2_SC_Compu "" TAB_VERB 4 0 "No_Sensor" 1 "UEGO_Sensor" 2 "NOx_Sensor" 3 "LSF_sensor" /end COMPU_VTAB
/begin COMPU_METHOD EGSDIA_SNSRTYPES2B1_SC_Compu "" TAB_VERB "%6.3" "" COMPU_TAB_REF EGSDIA_SNSRTYPES2B1_SC_Compu /end COMPU_METHOD
/begin COMPU_VTAB EGSDIA_SNSRTYPES2B1_SC_Compu "" TAB_VERB 4 0 "No_Sensor" 1 "UEGO_Sensor" 2 "NOx_Sensor" 3 "LSF_sensor" /end COMPU_VTAB
/begin COMPU_METHOD EGSDIA_SNSRTYPES2B2_SC_Compu "" TAB_VERB "%6.3" "" COMPU_TAB_REF EGSDIA_SNSRTYPES2B2_SC_Compu /end COMPU_METHOD
/begin COMPU_VTAB EGSDIA_SNSRTYPES2B2_SC_Compu "" TAB_VERB 4 0 "No_Sensor" 1 "UEGO_Sensor" 2 "NOx_Sensor" 3 "LSF_sensor" /end COMPU_VTAB
/begin COMPU_METHOD EGSDIA_SNSRTYPES3B1_SC_Compu "" TAB_VERB "%6.3" "" COMPU_TAB_REF EGSDIA_SNSRTYPES3B1_SC_Compu /end COMPU_METHOD
/begin COMPU_VTAB EGSDIA_SNSRTYPES3B1_SC_Compu "" TAB_VERB 4 0 "No_Sensor" 1 "UEGO_Sensor" 2 "NOx_Sensor" 3 "LSF_sensor" /end COMPU_VTAB
/begin COMPU_METHOD EGSDIA_SNSRTYPES3B2_SC_Compu "" TAB_VERB "%6.3" "" COMPU_TAB_REF EGSDIA_SNSRTYPES3B2_SC_Compu /end COMPU_METHOD
/begin COMPU_VTAB EGSDIA_SNSRTYPES3B2_SC_Compu "" TAB_VERB 4 0 "No_Sensor" 1 "UEGO_Sensor" 2 "NOx_Sensor" 3 "LSF_sensor" /end COMPU_VTAB
/begin COMPU_METHOD EGSDIA_SNSRTYPES4B1_SC_Compu "" TAB_VERB "%6.3" "" COMPU_TAB_REF EGSDIA_SNSRTYPES4B1_SC_Compu /end COMPU_METHOD
/begin COMPU_VTAB EGSDIA_SNSRTYPES4B1_SC_Compu "" TAB_VERB 4 0 "No_Sensor" 1 "UEGO_Sensor" 2 "NOx_Sensor" 3 "LSF_sensor" /end COMPU_VTAB
/begin COMPU_METHOD EGSDIA_SNSRTYPES6B1_SC_Compu "" TAB_VERB "%6.3" "" COMPU_TAB_REF EGSDIA_SNSRTYPES6B1_SC_Compu /end COMPU_METHOD
/begin COMPU_VTAB EGSDIA_SNSRTYPES6B1_SC_Compu "" TAB_VERB 4 0 "No_sensor" 1 "UEGO_sensor" 2 "NOx_sensor" 3 "LSF_sensor" /end COMPU_VTAB
/begin COMPU_METHOD EGSDIA_SNSRTYPSNSR1INTK1_SC_Compu "" TAB_VERB "%6.3" "" COMPU_TAB_REF EGSDIA_SNSRTYPSNSR1INTK1_SC_Compu /end COMPU_METHOD
/begin COMPU_VTAB EGSDIA_SNSRTYPSNSR1INTK1_SC_Compu "" TAB_VERB 4 0 "NO_O2Sensor" 1 "UEGOSensor" 2 "NOxSensor" 3 "LSFSensor" /end COMPU_VTAB
/begin COMPU_METHOD EGSDIA_STABNDIAGOPERPNT_SC_Compu "" TAB_VERB "%6.3" "" COMPU_TAB_REF EGSDIA_STABNDIAGOPERPNT_SC_Compu /end COMPU_METHOD
/begin COMPU_VTAB EGSDIA_STABNDIAGOPERPNT_SC_Compu "" TAB_VERB 2 0 "inactive" 1 "active" /end COMPU_VTAB
/begin COMPU_METHOD EGSDIA_SWTENAEXCHSNSRDIAG_SC_Compu "" TAB_VERB "%6.3" "" COMPU_TAB_REF EGSDIA_SWTENAEXCHSNSRDIAG_SC_Compu /end COMPU_METHOD
/begin COMPU_VTAB EGSDIA_SWTENAEXCHSNSRDIAG_SC_Compu "" TAB_VERB 2 0 "Deactivated" 1 "Activated" /end COMPU_VTAB
/begin COMPU_METHOD EngN "" RAT_FUNC "%6.3" "rpm" COEFFS 0 2 0 0 0 1 /end COMPU_METHOD
/begin COMPU_METHOD fak_ub_b16 "" RAT_FUNC "%6.4" "-" COEFFS 0 256 0 0 0 16 /end COMPU_METHOD
/begin COMPU_METHOD i_q1_mA "" RAT_FUNC "%6.2" "mA" COEFFS 0 1 0 0 0 1 /end COMPU_METHOD
/begin COMPU_METHOD kw_q0p0156 "" RAT_FUNC "%6.4" "Grad KW" COEFFS 0 64 0 0 0 1 /end COMPU_METHOD
/begin COMPU_METHOD Length_0_01mm "" RAT_FUNC "%6.4" "" COEFFS 0 100 0 0 0 1 /end COMPU_METHOD
/begin COMPU_METHOD OneToOne "" RAT_FUNC "%6.2" "-" COEFFS 0 1 0 0 0 1 /end COMPU_METHOD
/begin COMPU_METHOD Prc "" RAT_FUNC "%6.4" "%" COEFFS 0 81.92 0 0 0 1 /end COMPU_METHOD
/begin COMPU_METHOD p_q0p00122 "" RAT_FUNC "%6.4" "hPa" COEFFS 0 65536 0 0 0 80 /end COMPU_METHOD
/begin COMPU_METHOD p_uw_q0p039_mmHg "" RAT_FUNC "%6.4" "mmHg" COEFFS 0 256 0 0 0 7.500637 /end COMPU_METHOD
/begin COMPU_METHOD RBPtCel_p_0p002_1 "" RAT_FUNC "%6.4" "MPa" COEFFS 0 1000 0 0 0 2 /end COMPU_METHOD
/begin COMPU_METHOD relPED_q0p00153 "" RAT_FUNC "%6.4" "% PED" COEFFS 0 65535 0 0 0 100 /end COMPU_METHOD
/begin COMPU_METHOD rel_q0p0078125 "" RAT_FUNC "%6.4" "%" COEFFS 0 128 0 0 0 1 /end COMPU_METHOD
/begin COMPU_METHOD rel_q0p39 "" RAT_FUNC "%6.3" "%" COEFFS 0 256 0 0 0 100 /end COMPU_METHOD
/begin COMPU_METHOD rel_uw_b100 "" RAT_FUNC "%6.4" "%" COEFFS 0 65536 0 0 0 100 /end COMPU_METHOD
/begin COMPU_METHOD Temp_Cels "" RAT_FUNC "%6.1" "deg C" COEFFS 0 10 2731.4 0 0 1 /end COMPU_METHOD
/begin COMPU_METHOD temp_ub_q0p75_o48 "" RAT_FUNC "%6.2" "Grad C" COEFFS 0 1 48 0 0 0.75 /end COMPU_METHOD
/begin COMPU_METHOD Time_s "" RAT_FUNC "%6.4" "s" COEFFS 0 100 0 0 0 1 /end COMPU_METHOD
/begin COMPU_METHOD Time_sec_q1_COMPU "" RAT_FUNC "%6.2" "s" COEFFS 0 1 0 0 0 1 /end COMPU_METHOD
/begin COMPU_METHOD t_q0p1 "" RAT_FUNC "%6.3" "s" COEFFS 0 10 0 0 0 1 /end COMPU_METHOD
/begin COMPU_METHOD t_q1 "" RAT_FUNC "%6.2" "s" COEFFS 0 1 0 0 0 1 /end COMPU_METHOD
/begin COMPU_METHOD Vel "" RAT_FUNC "%6.4" "km/h" COEFFS 0 100 0 0 0 1 /end COMPU_METHOD
/begin COMPU_METHOD Volt_Batt "" RAT_FUNC "%6.1" "mV" COEFFS 0 0.05 0 0 0 1 /end COMPU_METHOD
/begin RECORD_LAYOUT Cur_Xs16Ws16 NO_AXIS_PTS_X 1 SWORD AXIS_PTS_X 2 SWORD INDEX_INCR DIRECT FNC_VALUES 3 SWORD COLUMN_DIR DIRECT /end RECORD_LAYOUT
/begin RECORD_LAYOUT KwWU16 FNC_VALUES 1 UWORD COLUMN_DIR DIRECT /end RECORD_LAYOUT
/begin RECORD_LAYOUT RB_Curve_U16_U16 NO_AXIS_PTS_X 1 UWORD AXIS_PTS_X 2 UWORD INDEX_INCR DIRECT FNC_VALUES 3 UWORD COLUMN_DIR DIRECT /end RECORD_LAYOUT
/begin RECORD_LAYOUT RB_Curve_U8_U8 NO_AXIS_PTS_X 1 UBYTE AXIS_PTS_X 2 UBYTE INDEX_INCR DIRECT FNC_VALUES 3 UBYTE COLUMN_DIR DIRECT /end RECORD_LAYOUT
/begin RECORD_LAYOUT RB_Val_Wboolean FNC_VALUES 1 UBYTE COLUMN_DIR DIRECT /end RECORD_LAYOUT
/begin RECORD_LAYOUT RB_Val_Ws16 FNC_VALUES 1 SWORD COLUMN_DIR DIRECT /end RECORD_LAYOUT
/begin RECORD_LAYOUT RB_Val_Wu16 FNC_VALUES 1 UWORD COLUMN_DIR DIRECT /end RECORD_LAYOUT
/begin RECORD_LAYOUT RB_Val_Wu8 FNC_VALUES 1 UBYTE COLUMN_DIR DIRECT /end RECORD_LAYOUT
/begin RECORD_LAYOUT ValA_Wu16 FNC_VALUES 1 UWORD COLUMN_DIR DIRECT /end RECORD_LAYOUT
/begin RECORD_LAYOUT Val_Ws16 FNC_VALUES 1 SWORD COLUMN_DIR DIRECT /end RECORD_LAYOUT
/begin RECORD_LAYOUT Val_Ws32 FNC_VALUES 1 SLONG COLUMN_DIR DIRECT /end RECORD_LAYOUT
/begin RECORD_LAYOUT Val_Wu16 FNC_VALUES 1 UWORD COLUMN_DIR DIRECT /end RECORD_LAYOUT
/begin RECORD_LAYOUT Val_Wu32 FNC_VALUES 1 ULONG COLUMN_DIR DIRECT /end RECORD_LAYOUT
/begin RECORD_LAYOUT Val_Wu8 FNC_VALUES 1 UBYTE COLUMN_DIR DIRECT /end RECORD_LAYOUT
/end MODULE
/end PROJECT
