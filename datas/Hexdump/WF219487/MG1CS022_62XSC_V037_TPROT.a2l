ASAP2_VERSION 1 60
/begin PROJECT MG1CS022 "MG1CS022"
/begin HEADER "" VERSION "MG1CS022_62XSC_V037_TPROT" PROJECT_NO MG1CS022 /end HEADER
/begin MODULE DIM ""
/begin MOD_COMMON "" BYTE_ORDER MSB_LAST ALIGNMENT_BYTE 1 ALIGNMENT_WORD 2 ALIGNMENT_LONG 4 ALIGNMENT_INT64 4 ALIGNMENT_FLOAT32_IEEE 4 ALIGNMENT_FLOAT64_IEEE 4 DATA_SIZE 32 /end MOD_COMMON
/begin CHARACTERISTIC DRIVE_Clear_Arbitrary_C "Switch to clear, measure or disable recording of data." VALUE 0x8058A9D2 Val_Wu8 2.00000000000 DRIVE_PRDS_CLEARSTORETYPE 0.00 2.00000000000 FORMAT "%13.11" /end CHARACTERISTIC
/begin CHARACTERISTIC DRIVE_Clear_BadEngStrt_C "Switch to clear, measure or disable recording of data." VALUE 0x8058A9D3 Val_Wu8 2.00000000000 DRIVE_PRDS_CLEARSTORETYPE 0.00 2.00000000000 FORMAT "%13.11" /end CHARACTERISTIC
/begin CHARACTERISTIC DRIVE_Clear_C "Calibration to clear the recorded data of the drive recorder" VALUE 0x8058A9D4 Val_Wu8 2.00000000000 DRIVE_PRDS_CLEARSTORETYPE 0.00 2.00000000000 FORMAT "%13.11" /end CHARACTERISTIC
/begin CHARACTERISTIC DRIVE_Clear_EngStal_C "Switch to clear, measure or disable recording of data." VALUE 0x8058A9D5 Val_Wu8 2.00000000000 DRIVE_PRDS_CLEARSTORETYPE 0.00 2.00000000000 FORMAT "%13.11" /end CHARACTERISTIC
/begin CHARACTERISTIC DRIVE_CurTrgMode_C "Current trigger mode sect by calibration(For testing)" VALUE 0x8058A9D6 Val_Wu8 2.00000000000 DRIVE_PRDS_TRGMODETYPE 0.00 2.00000000000 FORMAT "%13.11" /end CHARACTERISTIC
/begin CHARACTERISTIC DRIVE_numBadStrtDCTIDLst_CA "DCTID list for Bad Engine start measurement blocks" VAL_BLK 0x8058A9D8 ValA_Wu16 65535.00 OneToOne 0.00 65535.00 FORMAT "%8.2" NUMBER 6 /end CHARACTERISTIC
/begin CHARACTERISTIC DRIVE_numDCTIDLst_CA "DCTID of snapshot and singleshot record in drive recorder" VAL_BLK 0x8058A9E4 ValA_Wu16 65535.00 OneToOne 0.00 65535.00 FORMAT "%8.2" NUMBER 28 /end CHARACTERISTIC
/begin CHARACTERISTIC DRIVE_numEngStalDCTIDLst_CA "DCTID list for Engine stall measurement blocks" VAL_BLK 0x8058AA1C ValA_Wu16 65535.00 OneToOne 0.00 65535.00 FORMAT "%8.2" NUMBER 6 /end CHARACTERISTIC
/begin CHARACTERISTIC DRIVE_numSysId_C "System identifier for diesel ecu" VALUE 0x804D8650 Val_Wu8 1.000 OneToOne 0.00 1.000 FORMAT "%5.3" EXTENDED_LIMITS 0.00 255.0 /end CHARACTERISTIC
/begin CHARACTERISTIC DRIVE_PRDS_Bnk0Blk00_Sig_CA "Calibration array for bank 0 block 0 recording" VAL_BLK 0x8058AA28 ValA_Wu16 1168.00000000 Signals_IntSigNumVerb 0.00 1168.00000000 FORMAT "%13.8" NUMBER 8 /end CHARACTERISTIC
/begin CHARACTERISTIC DRIVE_PRDS_Bnk0Blk01_Sig_CA "Calibration array for bank 0 block 1 recording" VAL_BLK 0x8058AA38 ValA_Wu16 1168.00000000 Signals_IntSigNumVerb 0.00 1168.00000000 FORMAT "%13.8" NUMBER 35 /end CHARACTERISTIC
/begin CHARACTERISTIC DRIVE_PRDS_Bnk0Blk02_Sig_CA "Calibration array for bank 0 block 2 recording" VAL_BLK 0x8058AA7E ValA_Wu16 1168.00000000 Signals_IntSigNumVerb 0.00 1168.00000000 FORMAT "%13.8" NUMBER 9 /end CHARACTERISTIC
/begin CHARACTERISTIC DRIVE_PRDS_Bnk0Blk04_Sig_CA "Calibration array for bank 0 block 4 recording" VAL_BLK 0x8058AA90 ValA_Wu16 1168.00000000 Signals_IntSigNumVerb 0.00 1168.00000000 FORMAT "%13.8" NUMBER 10 /end CHARACTERISTIC
/begin CHARACTERISTIC DRIVE_PRDS_Bnk0Blk05_Sig_CA "Calibration array for bank 0 block 5 recording" VAL_BLK 0x8058AAA4 ValA_Wu16 1168.00000000 Signals_IntSigNumVerb 0.00 1168.00000000 FORMAT "%13.8" NUMBER 10 /end CHARACTERISTIC
/begin CHARACTERISTIC DRIVE_PRDS_Bnk0Blk06_Sig_CA "Calibration array for bank 0 block 6 recording" VAL_BLK 0x8058AAB8 ValA_Wu16 1168.00000000 Signals_IntSigNumVerb 0.00 1168.00000000 FORMAT "%13.8" NUMBER 41 /end CHARACTERISTIC
/begin CHARACTERISTIC DRIVE_PRDS_Bnk0Blk07_Sig_CA "Calibration array for bank 0 block 7 recording" VAL_BLK 0x8058AB0A ValA_Wu16 1168.00000000 Signals_IntSigNumVerb 0.00 1168.00000000 FORMAT "%13.8" NUMBER 12 /end CHARACTERISTIC
/begin CHARACTERISTIC DRIVE_PRDS_Bnk0Blk09_Sig_CA "Calibration array for bank 0 block 9 recording" VAL_BLK 0x8058AB22 ValA_Wu16 1168.00000000 Signals_IntSigNumVerb 0.00 1168.00000000 FORMAT "%13.8" NUMBER 11 /end CHARACTERISTIC
/begin CHARACTERISTIC DRIVE_PRDS_Bnk0Blk0a_Sig_CA "Calibration array for bank 0 block 10 recording" VAL_BLK 0x8058AB38 ValA_Wu16 1168.00000000 Signals_IntSigNumVerb 0.00 1168.00000000 FORMAT "%13.8" NUMBER 2 /end CHARACTERISTIC
/begin CHARACTERISTIC DRIVE_PRDS_Bnk0Blk0b_Sig_CA "Calibration array for bank 0 block 11 recording" VAL_BLK 0x8058AB3C ValA_Wu16 1168.00000000 Signals_IntSigNumVerb 0.00 1168.00000000 FORMAT "%13.8" NUMBER 6 /end CHARACTERISTIC
/begin CHARACTERISTIC DRIVE_PRDS_Bnk0Blk0c_Sig_CA "Calibration array for bank 0 block 12 recording" VAL_BLK 0x8058AB48 ValA_Wu16 1168.00000000 Signals_IntSigNumVerb 0.00 1168.00000000 FORMAT "%13.8" NUMBER 4 /end CHARACTERISTIC
/begin CHARACTERISTIC DRIVE_PRDS_Bnk0Blk0d_Sig_CA "Calibration array for bank 0 block 13 recording" VAL_BLK 0x8058AB50 ValA_Wu16 1168.00000000 Signals_IntSigNumVerb 0.00 1168.00000000 FORMAT "%13.8" NUMBER 8 /end CHARACTERISTIC
/begin CHARACTERISTIC DRIVE_PRDS_Bnk0Blk0e_Sig_CA "Calibration array for Bank 0 Block e recording" VAL_BLK 0x8058AB60 ValA_Wu16 1168.00000000 Signals_IntSigNumVerb 0.00 1168.00000000 FORMAT "%13.8" NUMBER 30 /end CHARACTERISTIC
/begin CHARACTERISTIC DRIVE_PRDS_Bnk0Blk0f_Sig_CA "Calibration array for Bank0 Block f recording" VAL_BLK 0x8058AB9C ValA_Wu16 1168.00000000 Signals_IntSigNumVerb 0.00 1168.00000000 FORMAT "%13.8" NUMBER 41 /end CHARACTERISTIC
/begin CHARACTERISTIC DRIVE_PRDS_Bnk0Blk10_Sig_CA "Calibration array for Bank0 Block 10 recording" VAL_BLK 0x8058ABEE ValA_Wu16 1168.00000000 Signals_IntSigNumVerb 0.00 1168.00000000 FORMAT "%13.8" NUMBER 42 /end CHARACTERISTIC
/begin CHARACTERISTIC DRIVE_PRDS_Bnk0Blk11_Sig_CA "Calibration array for Bank 0 Block 11 recording" VAL_BLK 0x8058AC42 ValA_Wu16 1168.00000000 Signals_IntSigNumVerb 0.00 1168.00000000 FORMAT "%13.8" NUMBER 42 /end CHARACTERISTIC
/begin CHARACTERISTIC DRIVE_PRDS_Bnk0Blk12_Sig_CA "Calibration array for Bank 0 Block 12 recording" VAL_BLK 0x8058AC96 ValA_Wu16 1168.00000000 Signals_IntSigNumVerb 0.00 1168.00000000 FORMAT "%13.8" NUMBER 42 /end CHARACTERISTIC
/begin CHARACTERISTIC DRIVE_PRDS_Bnk0Blk13_Sig_CA "Calibration array for Bank 0 Block 13 recording" VAL_BLK 0x8058ACEA ValA_Wu16 1168.00000000 Signals_IntSigNumVerb 0.00 1168.00000000 FORMAT "%13.8" NUMBER 42 /end CHARACTERISTIC
/begin CHARACTERISTIC DRIVE_PRDS_Bnk0Blk14_Sig_CA "Calibration array for Bank 0 Block 14 recording" VAL_BLK 0x8058AD3E ValA_Wu16 1168.00000000 Signals_IntSigNumVerb 0.00 1168.00000000 FORMAT "%13.8" NUMBER 4 /end CHARACTERISTIC
/begin CHARACTERISTIC DRIVE_PRDS_Bnk0Blk15_Sig_CA "Calibration array for Bank 0 Block 15 recording" VAL_BLK 0x8058AD46 ValA_Wu16 1168.00000000 Signals_IntSigNumVerb 0.00 1168.00000000 FORMAT "%13.8" NUMBER 29 /end CHARACTERISTIC
/begin CHARACTERISTIC DRIVE_PRDS_Bnk0Blk16_Sig_CA "Calibration array for Bank 0 Block 16 recording" VAL_BLK 0x8058AD80 ValA_Wu16 1168.00000000 Signals_IntSigNumVerb 0.00 1168.00000000 FORMAT "%13.8" NUMBER 1 /end CHARACTERISTIC
/begin CHARACTERISTIC DRIVE_PRDS_Bnk0Blk17_Sig_CA "Calibration array for Bank 0 Block 17 recording" VAL_BLK 0x8058AD82 ValA_Wu16 1168.00000000 Signals_IntSigNumVerb 0.00 1168.00000000 FORMAT "%13.8" NUMBER 10 /end CHARACTERISTIC
/begin CHARACTERISTIC DRIVE_PRDS_Bnk0Blk18_Sig_CA "Calibration array for Bank 0 Block 18 recording" VAL_BLK 0x8058AD96 ValA_Wu16 1168.00000000 Signals_IntSigNumVerb 0.00 1168.00000000 FORMAT "%13.8" NUMBER 2 /end CHARACTERISTIC
/begin CHARACTERISTIC DRIVE_PRDS_Bnk0Blk19_Sig_CA "Calibration array for Bank 0 Block 19 recording" VAL_BLK 0x8058AD9A ValA_Wu16 1168.00000000 Signals_IntSigNumVerb 0.00 1168.00000000 FORMAT "%13.8" NUMBER 2 /end CHARACTERISTIC
/begin CHARACTERISTIC DRIVE_PRDS_Bnk0Blk1a_Sig_CA "Calibration array for bank 0 block 1a recording" VAL_BLK 0x8058AD9E ValA_Wu16 1168.00000000 Signals_IntSigNumVerb 0.00 1168.00000000 FORMAT "%13.8" NUMBER 23 /end CHARACTERISTIC
/begin CHARACTERISTIC DRIVE_PRDS_Bnk0Blk1b_Sig_CA "Calibration array for bank 0 block 1b recording" VAL_BLK 0x8058ADCC ValA_Wu16 1168.00000000 Signals_IntSigNumVerb 0.00 1168.00000000 FORMAT "%13.8" NUMBER 2 /end CHARACTERISTIC
/begin CHARACTERISTIC DRIVE_PRDS_Bnk1Blk00_Sig_CA "Calibration array for bank 1 block 0 recording" VAL_BLK 0x8058ADD0 ValA_Wu16 1168.00000000 Signals_IntSigNumVerb 0.00 1168.00000000 FORMAT "%13.8" NUMBER 35 /end CHARACTERISTIC
/begin CHARACTERISTIC DRIVE_PRDS_Bnk1Blk02_Sig_CA "Calibration array for Bank 1 Block 02 recording" VAL_BLK 0x8058AE16 ValA_Wu16 1168.00000000 Signals_IntSigNumVerb 0.00 1168.00000000 FORMAT "%13.8" NUMBER 8 /end CHARACTERISTIC
/begin CHARACTERISTIC DRIVE_PRDS_Bnk1Blk03_Sig_CA "Calibration array for Bank 1 Block 03 recording" VAL_BLK 0x8058AE26 ValA_Wu16 1168.00000000 Signals_IntSigNumVerb 0.00 1168.00000000 FORMAT "%13.8" NUMBER 7 /end CHARACTERISTIC
/begin CHARACTERISTIC DRIVE_PRDS_Bnk1Blk04_Sig_CA "Calibration array for bank 1 block 4 recording" VAL_BLK 0x8058AE34 ValA_Wu16 1168.00000000 Signals_IntSigNumVerb 0.00 1168.00000000 FORMAT "%13.8" NUMBER 7 /end CHARACTERISTIC
/begin CHARACTERISTIC DRIVE_PRDS_Bnk1Blk05_Sig_CA "Calibration array for Bank 1 Block 05 recording" VAL_BLK 0x8058AE42 ValA_Wu16 1168.00000000 Signals_IntSigNumVerb 0.00 1168.00000000 FORMAT "%13.8" NUMBER 18 /end CHARACTERISTIC
/begin CHARACTERISTIC Drive_stClrData_Arbitrary_C "Calibration to decide drive recorder action in case of non volatile memory error" VALUE 0x8058AE66 Val_Wu8 1.000 OneToOne 0.00 1.000 FORMAT "%5.3" EXTENDED_LIMITS 0.00 255.0 /end CHARACTERISTIC
/begin CHARACTERISTIC Drive_stClrData_BadEngStrt_C "Calibration to decide drive recorder action in case of non volatile memory error" VALUE 0x8058AE67 Val_Wu8 1.000 OneToOne 0.00 1.000 FORMAT "%5.3" EXTENDED_LIMITS 0.00 255.0 /end CHARACTERISTIC
/begin CHARACTERISTIC Drive_stClrData_C "Calibration to enable clearing of drive recorder data in case of memory error" VALUE 0x8058AE68 Val_Wu8 1.000 OneToOne 0.00 1.000 FORMAT "%5.3" EXTENDED_LIMITS 0.00 255.0 /end CHARACTERISTIC
/begin CHARACTERISTIC Drive_stClrData_EngStal_C "Calibration to decide drive recorder action in case of non volatile memory error" VALUE 0x8058AE69 Val_Wu8 1.000 OneToOne 0.00 1.000 FORMAT "%5.3" EXTENDED_LIMITS 0.00 255.0 /end CHARACTERISTIC
/begin CHARACTERISTIC DRIVE_swtForcedRecCond_C "Calibration to controll recording condition in DRIVE recorder" VALUE 0x8058AE6A Val_Wu8 255.0 OneToOne 0.00 255.0 FORMAT "%5.1" /end CHARACTERISTIC
/begin CHARACTERISTIC DRIVE_swtForcedTrg_C "Calibration to control trigger condition in DRIVE recorder" VALUE 0x8058AE6B Val_Wu8 255.0 OneToOne 0.00 255.0 FORMAT "%5.1" /end CHARACTERISTIC
/begin CHARACTERISTIC DRIVE_swtNPos_C "Switch position" VALUE 0x8058AE6C Val_Wu8 1.000 OneToOne 0.00 1.000 FORMAT "%5.3" EXTENDED_LIMITS 0.00 255.0 /end CHARACTERISTIC
/begin CHARACTERISTIC DRIVE_tiEngStal_C "Delay timer after engine running" VALUE 0x8058AE6E Val_Wu16 25500.00 Time_ms 0.00 25500.00 FORMAT "%8.2" EXTENDED_LIMITS 0.00 655350.0 /end CHARACTERISTIC
/begin CHARACTERISTIC DRIVE_tiEngStrtBad_CUR "Bad engine start timer duration" CURVE 0x8058AE70 Cur_Xs16Ws16 327670.0 Time_ms 0.00 327670.0 FORMAT "%8.1" EXTENDED_LIMITS -327680.0 327670.0
 /begin AXIS_DESCR STD_AXIS CEngDsT_t Temp_Cels 10 -3549.940 3003.560 FORMAT "%8.3" DEPOSIT ABSOLUTE /end AXIS_DESCR
/end CHARACTERISTIC
/begin CHARACTERISTIC DRIVE_vEngStal_C "Minimum Vehicle speed condition for Engine stall to occur" VALUE 0x8058AE9A Val_Ws16 655.3500 Vel -327.6800 327.6700 FORMAT "%8.4" /end CHARACTERISTIC
/begin CHARACTERISTIC DSCHED_AsgnCheck.FID_AFRA_C "assigned Check / Assigned Check for scheduled FId FID_AFRA" VALUE 0x80503A40 Val_Wu16 906.000000000 DFC_Verb 0.00 906.000000000 FORMAT "%13.9" /end CHARACTERISTIC
/begin CHARACTERISTIC DSCHED_AsgnCheck.FID_AORA_C "assigned Check / Assigned Check for scheduled FId FID_AORA" VALUE 0x80503A42 Val_Wu16 906.000000000 DFC_Verb 0.00 906.000000000 FORMAT "%13.9" /end CHARACTERISTIC
/begin CHARACTERISTIC DSCHED_AsgnCheck.FID_ATEH_C "assigned Check / Assigned Check for scheduled FId FID_ATEH" VALUE 0x80503A44 Val_Wu16 906.000000000 DFC_Verb 0.00 906.000000000 FORMAT "%13.9" /end CHARACTERISTIC
/begin CHARACTERISTIC DSCHED_AsgnCheck.FID_ATEL_C "assigned Check / Assigned Check for scheduled FId FID_ATEL" VALUE 0x80503A46 Val_Wu16 906.000000000 DFC_Verb 0.00 906.000000000 FORMAT "%13.9" /end CHARACTERISTIC
/begin CHARACTERISTIC DSCHED_AsgnCheck.FID_ATEN_C "assigned Check / Assigned Check for scheduled FId FID_ATEN" VALUE 0x80503A48 Val_Wu16 906.000000000 DFC_Verb 0.00 906.000000000 FORMAT "%13.9" /end CHARACTERISTIC
/begin CHARACTERISTIC DSCHED_AsgnCheck.FID_ATLDI_C "assigned Check / Assigned Check for scheduled FId FID_ATLDI" VALUE 0x80503A4A Val_Wu16 906.000000000 DFC_Verb 0.00 906.000000000 FORMAT "%13.9" /end CHARACTERISTIC
/begin CHARACTERISTIC DSCHED_AsgnCheck.FID_ATLDO_C "assigned Check / Assigned Check for scheduled FId FID_ATLDO" VALUE 0x80503A4C Val_Wu16 906.000000000 DFC_Verb 0.00 906.000000000 FORMAT "%13.9" /end CHARACTERISTIC
/begin CHARACTERISTIC DSCHED_AsgnCheck.FID_BEONV_C "assigned Check / Assigned Check for scheduled FId FID_BEONV" VALUE 0x80503A4E Val_Wu16 906.000000000 DFC_Verb 0.00 906.000000000 FORMAT "%13.9" /end CHARACTERISTIC
/begin CHARACTERISTIC DSCHED_AsgnCheck.FId_EGSDCmnSeg1B1Parl_C "assigned Check / Assigned Check for scheduled FId FId_EGSDCmnSeg1B1Parl" VALUE 0x80503A50 Val_Wu16 906.000000000 DFC_Verb 0.00 906.000000000 FORMAT "%13.9" /end CHARACTERISTIC
/begin CHARACTERISTIC DSCHED_AsgnCheck.FID_BAGRA_C "assigned Check / Assigned Check for scheduled FId FID_BAGRA" VALUE 0x80503A52 Val_Wu16 906.000000000 DFC_Verb 0.00 906.000000000 FORMAT "%13.9" /end CHARACTERISTIC
/begin CHARACTERISTIC DSCHED_AsgnCheck.FID_BAGRASD_C "assigned Check / Assigned Check for scheduled FId FID_BAGRASD" VALUE 0x80503A54 Val_Wu16 906.000000000 DFC_Verb 0.00 906.000000000 FORMAT "%13.9" /end CHARACTERISTIC
/begin CHARACTERISTIC DSCHED_AsgnCheck.FID_BDSTOF_C "assigned Check / Assigned Check for scheduled FId FID_BDSTOF" VALUE 0x80503A56 Val_Wu16 906.000000000 DFC_Verb 0.00 906.000000000 FORMAT "%13.9" /end CHARACTERISTIC
/begin CHARACTERISTIC DSCHED_AsgnCheck.FID_BFVDFRM_C "assigned Check / Assigned Check for scheduled FId FID_BFVDFRM" VALUE 0x80503A58 Val_Wu16 906.000000000 DFC_Verb 0.00 906.000000000 FORMAT "%13.9" /end CHARACTERISTIC
/begin CHARACTERISTIC DSCHED_AsgnCheck.FID_BHOM_C "assigned Check / Assigned Check for scheduled FId FID_BHOM" VALUE 0x80503A5A Val_Wu16 906.000000000 DFC_Verb 0.00 906.000000000 FORMAT "%13.9" /end CHARACTERISTIC
/begin CHARACTERISTIC DSCHED_AsgnCheck.FID_BLLRH_C "assigned Check / Assigned Check for scheduled FId FID_BLLRH" VALUE 0x80503A5C Val_Wu16 906.000000000 DFC_Verb 0.00 906.000000000 FORMAT "%13.9" /end CHARACTERISTIC
/begin CHARACTERISTIC DSCHED_AsgnCheck.FID_BLLRKH_C "assigned Check / Assigned Check for scheduled FId FID_BLLRKH" VALUE 0x80503A5E Val_Wu16 906.000000000 DFC_Verb 0.00 906.000000000 FORMAT "%13.9" /end CHARACTERISTIC
/begin CHARACTERISTIC DSCHED_AsgnCheck.FID_BPLSU_C "assigned Check / Assigned Check for scheduled FId FID_BPLSU" VALUE 0x80503A60 Val_Wu16 906.000000000 DFC_Verb 0.00 906.000000000 FORMAT "%13.9" /end CHARACTERISTIC
/begin CHARACTERISTIC DSCHED_AsgnCheck.FID_FRAMBAVMB_C "assigned Check / Assigned Check for scheduled FId FID_FRAMBAVMB" VALUE 0x80503A62 Val_Wu16 906.000000000 DFC_Verb 0.00 906.000000000 FORMAT "%13.9" /end CHARACTERISTIC
/begin CHARACTERISTIC DSCHED_AsgnCheck.FId_CatHeatgColdStrtReq_C "assigned Check / Assigned Check for scheduled FId FId_CatHeatgColdStrtReq" VALUE 0x80503A64 Val_Wu16 906.000000000 DFC_Verb 0.00 906.000000000 FORMAT "%13.9" /end CHARACTERISTIC
/begin CHARACTERISTIC DSCHED_AsgnCheck.FId_CatHeatgWrmReq_C "assigned Check / Assigned Check for scheduled FId FId_CatHeatgWrmReq" VALUE 0x80503A66 Val_Wu16 906.000000000 DFC_Verb 0.00 906.000000000 FORMAT "%13.9" /end CHARACTERISTIC
/begin CHARACTERISTIC DSCHED_AsgnCheck.FId_DSMBDEPHSpOpMode_C "assigned Check / Assigned Check for scheduled FId FId_DSMBDEPHSpOpMode" VALUE 0x80503A68 Val_Wu16 906.000000000 DFC_Verb 0.00 906.000000000 FORMAT "%13.9" /end CHARACTERISTIC
/begin CHARACTERISTIC DSCHED_AsgnCheck.FId_EGRVlvCoord_C "assigned Check / Assigned Check for scheduled FId FId_EGRVlvCoord" VALUE 0x80503A6A Val_Wu16 906.000000000 DFC_Verb 0.00 906.000000000 FORMAT "%13.9" /end CHARACTERISTIC
/begin CHARACTERISTIC DSCHED_AsgnCheck.FId_EGSDO2FuTrmB1_C "assigned Check / Assigned Check for scheduled FId FId_EGSDO2FuTrmB1" VALUE 0x80503A6C Val_Wu16 906.000000000 DFC_Verb 0.00 906.000000000 FORMAT "%13.9" /end CHARACTERISTIC
/begin CHARACTERISTIC DSCHED_AsgnCheck.FId_EGSDO2SnsrMntdRelsS1B1_C "assigned Check / Assigned Check for scheduled FId FId_EGSDO2SnsrMntdRelsS1B1" VALUE 0x80503A6E Val_Wu16 906.000000000 DFC_Verb 0.00 906.000000000 FORMAT "%13.9" /end CHARACTERISTIC
/begin CHARACTERISTIC DSCHED_AsgnCheck.FId_EGSDO2_LamOffsFastS1B1_C "assigned Check / Assigned Check for scheduled FId FId_EGSDO2_LamOffsFastS1B1" VALUE 0x80503A70 Val_Wu16 906.000000000 DFC_Verb 0.00 906.000000000 FORMAT "%13.9" /end CHARACTERISTIC
/begin CHARACTERISTIC DSCHED_AsgnCheck.FId_MisfDetDnAdpnNv_C "assigned Check / Assigned Check for scheduled FId FId_MisfDetDnAdpnNv" VALUE 0x80503A72 Val_Wu16 906.000000000 DFC_Verb 0.00 906.000000000 FORMAT "%13.9" /end CHARACTERISTIC
/begin CHARACTERISTIC DSCHED_AsgnCheck.FId_bascadpncvo_C "assigned Check / Assigned Check for scheduled FId FId_bascadpncvo" VALUE 0x80503A74 Val_Wu16 906.000000000 DFC_Verb 0.00 906.000000000 FORMAT "%13.9" /end CHARACTERISTIC
/begin CHARACTERISTIC DSCHED_BsPrio.FID_AFRA_C "base priority / Base priority for scheduled FId FID_AFRA" VALUE 0x80503A76 Val_Wu16 8191.000 DFC_OneToOne 0.00 8191.000 FORMAT "%8.3" EXTENDED_LIMITS 0.00 65535.00 /end CHARACTERISTIC
/begin CHARACTERISTIC DSCHED_BsPrio.FID_AORA_C "base priority / Base priority for scheduled FId FID_AORA" VALUE 0x80503A78 Val_Wu16 8191.000 DFC_OneToOne 0.00 8191.000 FORMAT "%8.3" EXTENDED_LIMITS 0.00 65535.00 /end CHARACTERISTIC
/begin CHARACTERISTIC DSCHED_BsPrio.FID_ATEH_C "base priority / Base priority for scheduled FId FID_ATEH" VALUE 0x80503A7A Val_Wu16 8191.000 DFC_OneToOne 0.00 8191.000 FORMAT "%8.3" EXTENDED_LIMITS 0.00 65535.00 /end CHARACTERISTIC
/begin CHARACTERISTIC DSCHED_BsPrio.FID_ATEL_C "base priority / Base priority for scheduled FId FID_ATEL" VALUE 0x80503A7C Val_Wu16 8191.000 DFC_OneToOne 0.00 8191.000 FORMAT "%8.3" EXTENDED_LIMITS 0.00 65535.00 /end CHARACTERISTIC
/begin CHARACTERISTIC DSCHED_BsPrio.FID_ATEN_C "base priority / Base priority for scheduled FId FID_ATEN" VALUE 0x80503A7E Val_Wu16 8191.000 DFC_OneToOne 0.00 8191.000 FORMAT "%8.3" EXTENDED_LIMITS 0.00 65535.00 /end CHARACTERISTIC
/begin CHARACTERISTIC DSCHED_BsPrio.FID_ATLDI_C "base priority / Base priority for scheduled FId FID_ATLDI" VALUE 0x80503A80 Val_Wu16 8191.000 DFC_OneToOne 0.00 8191.000 FORMAT "%8.3" EXTENDED_LIMITS 0.00 65535.00 /end CHARACTERISTIC
/begin CHARACTERISTIC DSCHED_BsPrio.FID_ATLDO_C "base priority / Base priority for scheduled FId FID_ATLDO" VALUE 0x80503A82 Val_Wu16 8191.000 DFC_OneToOne 0.00 8191.000 FORMAT "%8.3" EXTENDED_LIMITS 0.00 65535.00 /end CHARACTERISTIC
/begin CHARACTERISTIC DSCHED_BsPrio.FID_BEONV_C "base priority / Base priority for scheduled FId FID_BEONV" VALUE 0x80503A84 Val_Wu16 8191.000 DFC_OneToOne 0.00 8191.000 FORMAT "%8.3" EXTENDED_LIMITS 0.00 65535.00 /end CHARACTERISTIC
/begin CHARACTERISTIC DSCHED_BsPrio.FId_EGSDCmnSeg1B1Parl_C "base priority / Base priority for scheduled FId FId_EGSDCmnSeg1B1Parl" VALUE 0x80503A86 Val_Wu16 8191.000 DFC_OneToOne 0.00 8191.000 FORMAT "%8.3" EXTENDED_LIMITS 0.00 65535.00 /end CHARACTERISTIC
/begin CHARACTERISTIC DSCHED_BsPrio.FID_BAGRA_C "base priority / Base priority for scheduled FId FID_BAGRA" VALUE 0x80503A88 Val_Wu16 8191.000 DFC_OneToOne 0.00 8191.000 FORMAT "%8.3" EXTENDED_LIMITS 0.00 65535.00 /end CHARACTERISTIC
/begin CHARACTERISTIC DSCHED_BsPrio.FID_BAGRASD_C "base priority / Base priority for scheduled FId FID_BAGRASD" VALUE 0x80503A8A Val_Wu16 8191.000 DFC_OneToOne 0.00 8191.000 FORMAT "%8.3" EXTENDED_LIMITS 0.00 65535.00 /end CHARACTERISTIC
/begin CHARACTERISTIC DSCHED_BsPrio.FID_BDSTOF_C "base priority / Base priority for scheduled FId FID_BDSTOF" VALUE 0x80503A8C Val_Wu16 8191.000 DFC_OneToOne 0.00 8191.000 FORMAT "%8.3" EXTENDED_LIMITS 0.00 65535.00 /end CHARACTERISTIC
/begin CHARACTERISTIC DSCHED_BsPrio.FID_BFVDFRM_C "base priority / Base priority for scheduled FId FID_BFVDFRM" VALUE 0x80503A8E Val_Wu16 8191.000 DFC_OneToOne 0.00 8191.000 FORMAT "%8.3" EXTENDED_LIMITS 0.00 65535.00 /end CHARACTERISTIC
/begin CHARACTERISTIC DSCHED_BsPrio.FID_BHOM_C "base priority / Base priority for scheduled FId FID_BHOM" VALUE 0x80503A90 Val_Wu16 8191.000 DFC_OneToOne 0.00 8191.000 FORMAT "%8.3" EXTENDED_LIMITS 0.00 65535.00 /end CHARACTERISTIC
/begin CHARACTERISTIC DSCHED_BsPrio.FID_BLLRH_C "base priority / Base priority for scheduled FId FID_BLLRH" VALUE 0x80503A92 Val_Wu16 8191.000 DFC_OneToOne 0.00 8191.000 FORMAT "%8.3" EXTENDED_LIMITS 0.00 65535.00 /end CHARACTERISTIC
/begin CHARACTERISTIC DSCHED_BsPrio.FID_BLLRKH_C "base priority / Base priority for scheduled FId FID_BLLRKH" VALUE 0x80503A94 Val_Wu16 8191.000 DFC_OneToOne 0.00 8191.000 FORMAT "%8.3" EXTENDED_LIMITS 0.00 65535.00 /end CHARACTERISTIC
/begin CHARACTERISTIC DSCHED_BsPrio.FID_BPLSU_C "base priority / Base priority for scheduled FId FID_BPLSU" VALUE 0x80503A96 Val_Wu16 8191.000 DFC_OneToOne 0.00 8191.000 FORMAT "%8.3" EXTENDED_LIMITS 0.00 65535.00 /end CHARACTERISTIC
/begin CHARACTERISTIC DSCHED_BsPrio.FID_FRAMBAVMB_C "base priority / Base priority for scheduled FId FID_FRAMBAVMB" VALUE 0x80503A98 Val_Wu16 8191.000 DFC_OneToOne 0.00 8191.000 FORMAT "%8.3" EXTENDED_LIMITS 0.00 65535.00 /end CHARACTERISTIC
/begin CHARACTERISTIC DSCHED_BsPrio.FId_CatHeatgColdStrtReq_C "base priority / Base priority for scheduled FId FId_CatHeatgColdStrtReq" VALUE 0x80503A9A Val_Wu16 8191.000 DFC_OneToOne 0.00 8191.000 FORMAT "%8.3" EXTENDED_LIMITS 0.00 65535.00 /end CHARACTERISTIC
/begin CHARACTERISTIC DSCHED_BsPrio.FId_CatHeatgWrmReq_C "base priority / Base priority for scheduled FId FId_CatHeatgWrmReq" VALUE 0x80503A9C Val_Wu16 8191.000 DFC_OneToOne 0.00 8191.000 FORMAT "%8.3" EXTENDED_LIMITS 0.00 65535.00 /end CHARACTERISTIC
/begin CHARACTERISTIC DSCHED_BsPrio.FId_DSMBDEPHSpOpMode_C "base priority / Base priority for scheduled FId FId_DSMBDEPHSpOpMode" VALUE 0x80503A9E Val_Wu16 8191.000 DFC_OneToOne 0.00 8191.000 FORMAT "%8.3" EXTENDED_LIMITS 0.00 65535.00 /end CHARACTERISTIC
/begin CHARACTERISTIC DSCHED_BsPrio.FId_EGRVlvCoord_C "base priority / Base priority for scheduled FId FId_EGRVlvCoord" VALUE 0x80503AA0 Val_Wu16 8191.000 DFC_OneToOne 0.00 8191.000 FORMAT "%8.3" EXTENDED_LIMITS 0.00 65535.00 /end CHARACTERISTIC
/begin CHARACTERISTIC DSCHED_BsPrio.FId_EGSDO2FuTrmB1_C "base priority / Base priority for scheduled FId FId_EGSDO2FuTrmB1" VALUE 0x80503AA2 Val_Wu16 8191.000 DFC_OneToOne 0.00 8191.000 FORMAT "%8.3" EXTENDED_LIMITS 0.00 65535.00 /end CHARACTERISTIC
/begin CHARACTERISTIC DSCHED_BsPrio.FId_EGSDO2SnsrMntdRelsS1B1_C "base priority / Base priority for scheduled FId FId_EGSDO2SnsrMntdRelsS1B1" VALUE 0x80503AA4 Val_Wu16 8191.000 DFC_OneToOne 0.00 8191.000 FORMAT "%8.3" EXTENDED_LIMITS 0.00 65535.00 /end CHARACTERISTIC
/begin CHARACTERISTIC DSCHED_BsPrio.FId_EGSDO2_LamOffsFastS1B1_C "base priority / Base priority for scheduled FId FId_EGSDO2_LamOffsFastS1B1" VALUE 0x80503AA6 Val_Wu16 8191.000 DFC_OneToOne 0.00 8191.000 FORMAT "%8.3" EXTENDED_LIMITS 0.00 65535.00 /end CHARACTERISTIC
/begin CHARACTERISTIC DSCHED_BsPrio.FId_MisfDetDnAdpnNv_C "base priority / Base priority for scheduled FId FId_MisfDetDnAdpnNv" VALUE 0x80503AA8 Val_Wu16 8191.000 DFC_OneToOne 0.00 8191.000 FORMAT "%8.3" EXTENDED_LIMITS 0.00 65535.00 /end CHARACTERISTIC
/begin CHARACTERISTIC DSCHED_BsPrio.FId_bascadpncvo_C "base priority / Base priority for scheduled FId FId_bascadpncvo" VALUE 0x80503AAA Val_Wu16 8191.000 DFC_OneToOne 0.00 8191.000 FORMAT "%8.3" EXTENDED_LIMITS 0.00 65535.00 /end CHARACTERISTIC
/begin CHARACTERISTIC DSCHED_FacPhys.FID_AFRA_C "weighting physical priority / Factor for physical Priority for scheduled FId FID_AFRA" VALUE 0x80503AAC Val_Wu8 255.0 DFC_OneToOne 0.00 255.0 FORMAT "%5.1" /end CHARACTERISTIC
/begin CHARACTERISTIC DSCHED_FacPhys.FID_AORA_C "weighting physical priority / Factor for physical Priority for scheduled FId FID_AORA" VALUE 0x80503AAD Val_Wu8 255.0 DFC_OneToOne 0.00 255.0 FORMAT "%5.1" /end CHARACTERISTIC
/begin CHARACTERISTIC DSCHED_FacPhys.FID_ATEH_C "weighting physical priority / Factor for physical Priority for scheduled FId FID_ATEH" VALUE 0x80503AAE Val_Wu8 255.0 DFC_OneToOne 0.00 255.0 FORMAT "%5.1" /end CHARACTERISTIC
/begin CHARACTERISTIC DSCHED_FacPhys.FID_ATEL_C "weighting physical priority / Factor for physical Priority for scheduled FId FID_ATEL" VALUE 0x80503AAF Val_Wu8 255.0 DFC_OneToOne 0.00 255.0 FORMAT "%5.1" /end CHARACTERISTIC
/begin CHARACTERISTIC DSCHED_FacPhys.FID_ATEN_C "weighting physical priority / Factor for physical Priority for scheduled FId FID_ATEN" VALUE 0x80503AB0 Val_Wu8 255.0 DFC_OneToOne 0.00 255.0 FORMAT "%5.1" /end CHARACTERISTIC
/begin CHARACTERISTIC DSCHED_FacPhys.FID_ATLDI_C "weighting physical priority / Factor for physical Priority for scheduled FId FID_ATLDI" VALUE 0x80503AB1 Val_Wu8 255.0 DFC_OneToOne 0.00 255.0 FORMAT "%5.1" /end CHARACTERISTIC
/begin CHARACTERISTIC DSCHED_FacPhys.FID_ATLDO_C "weighting physical priority / Factor for physical Priority for scheduled FId FID_ATLDO" VALUE 0x80503AB2 Val_Wu8 255.0 DFC_OneToOne 0.00 255.0 FORMAT "%5.1" /end CHARACTERISTIC
/begin CHARACTERISTIC DSCHED_FacPhys.FID_BEONV_C "weighting physical priority / Factor for physical Priority for scheduled FId FID_BEONV" VALUE 0x80503AB3 Val_Wu8 255.0 DFC_OneToOne 0.00 255.0 FORMAT "%5.1" /end CHARACTERISTIC
/begin CHARACTERISTIC DSCHED_FacPhys.FId_EGSDCmnSeg1B1Parl_C "weighting physical priority / Factor for physical Priority for scheduled FId FId_EGSDCmnSeg1B1Parl" VALUE 0x80503AB4 Val_Wu8 255.0 DFC_OneToOne 0.00 255.0 FORMAT "%5.1" /end CHARACTERISTIC
/begin CHARACTERISTIC DSCHED_FacPhys.FID_BAGRA_C "weighting physical priority / Factor for physical Priority for scheduled FId FID_BAGRA" VALUE 0x80503AB5 Val_Wu8 255.0 DFC_OneToOne 0.00 255.0 FORMAT "%5.1" /end CHARACTERISTIC
/begin CHARACTERISTIC DSCHED_FacPhys.FID_BAGRASD_C "weighting physical priority / Factor for physical Priority for scheduled FId FID_BAGRASD" VALUE 0x80503AB6 Val_Wu8 255.0 DFC_OneToOne 0.00 255.0 FORMAT "%5.1" /end CHARACTERISTIC
/begin CHARACTERISTIC DSCHED_FacPhys.FID_BDSTOF_C "weighting physical priority / Factor for physical Priority for scheduled FId FID_BDSTOF" VALUE 0x80503AB7 Val_Wu8 255.0 DFC_OneToOne 0.00 255.0 FORMAT "%5.1" /end CHARACTERISTIC
/begin CHARACTERISTIC DSCHED_FacPhys.FID_BFVDFRM_C "weighting physical priority / Factor for physical Priority for scheduled FId FID_BFVDFRM" VALUE 0x80503AB8 Val_Wu8 255.0 DFC_OneToOne 0.00 255.0 FORMAT "%5.1" /end CHARACTERISTIC
/begin CHARACTERISTIC DSCHED_FacPhys.FID_BHOM_C "weighting physical priority / Factor for physical Priority for scheduled FId FID_BHOM" VALUE 0x80503AB9 Val_Wu8 255.0 DFC_OneToOne 0.00 255.0 FORMAT "%5.1" /end CHARACTERISTIC
/begin CHARACTERISTIC DSCHED_FacPhys.FID_BLLRH_C "weighting physical priority / Factor for physical Priority for scheduled FId FID_BLLRH" VALUE 0x80503ABA Val_Wu8 255.0 DFC_OneToOne 0.00 255.0 FORMAT "%5.1" /end CHARACTERISTIC
/begin CHARACTERISTIC DSCHED_FacPhys.FID_BLLRKH_C "weighting physical priority / Factor for physical Priority for scheduled FId FID_BLLRKH" VALUE 0x80503ABB Val_Wu8 255.0 DFC_OneToOne 0.00 255.0 FORMAT "%5.1" /end CHARACTERISTIC
/begin CHARACTERISTIC DSCHED_FacPhys.FID_BPLSU_C "weighting physical priority / Factor for physical Priority for scheduled FId FID_BPLSU" VALUE 0x80503ABC Val_Wu8 255.0 DFC_OneToOne 0.00 255.0 FORMAT "%5.1" /end CHARACTERISTIC
/begin CHARACTERISTIC DSCHED_FacPhys.FID_FRAMBAVMB_C "weighting physical priority / Factor for physical Priority for scheduled FId FID_FRAMBAVMB" VALUE 0x80503ABD Val_Wu8 255.0 DFC_OneToOne 0.00 255.0 FORMAT "%5.1" /end CHARACTERISTIC
/begin CHARACTERISTIC DSCHED_FacPhys.FId_CatHeatgColdStrtReq_C "weighting physical priority / Factor for physical Priority for scheduled FId FId_CatHeatgColdStrtReq" VALUE 0x80503ABE Val_Wu8 255.0 DFC_OneToOne 0.00 255.0 FORMAT "%5.1" /end CHARACTERISTIC
/begin CHARACTERISTIC DSCHED_FacPhys.FId_CatHeatgWrmReq_C "weighting physical priority / Factor for physical Priority for scheduled FId FId_CatHeatgWrmReq" VALUE 0x80503ABF Val_Wu8 255.0 DFC_OneToOne 0.00 255.0 FORMAT "%5.1" /end CHARACTERISTIC
/begin CHARACTERISTIC DSCHED_FacPhys.FId_DSMBDEPHSpOpMode_C "weighting physical priority / Factor for physical Priority for scheduled FId FId_DSMBDEPHSpOpMode" VALUE 0x80503AC0 Val_Wu8 255.0 DFC_OneToOne 0.00 255.0 FORMAT "%5.1" /end CHARACTERISTIC
/begin CHARACTERISTIC DSCHED_FacPhys.FId_EGRVlvCoord_C "weighting physical priority / Factor for physical Priority for scheduled FId FId_EGRVlvCoord" VALUE 0x80503AC1 Val_Wu8 255.0 DFC_OneToOne 0.00 255.0 FORMAT "%5.1" /end CHARACTERISTIC
/begin CHARACTERISTIC DSCHED_FacPhys.FId_EGSDO2FuTrmB1_C "weighting physical priority / Factor for physical Priority for scheduled FId FId_EGSDO2FuTrmB1" VALUE 0x80503AC2 Val_Wu8 255.0 DFC_OneToOne 0.00 255.0 FORMAT "%5.1" /end CHARACTERISTIC
/begin CHARACTERISTIC DSCHED_FacPhys.FId_EGSDO2SnsrMntdRelsS1B1_C "weighting physical priority / Factor for physical Priority for scheduled FId FId_EGSDO2SnsrMntdRelsS1B1" VALUE 0x80503AC3 Val_Wu8 255.0 DFC_OneToOne 0.00 255.0 FORMAT "%5.1" /end CHARACTERISTIC
/begin CHARACTERISTIC DSCHED_FacPhys.FId_EGSDO2_LamOffsFastS1B1_C "weighting physical priority / Factor for physical Priority for scheduled FId FId_EGSDO2_LamOffsFastS1B1" VALUE 0x80503AC4 Val_Wu8 255.0 DFC_OneToOne 0.00 255.0 FORMAT "%5.1" /end CHARACTERISTIC
/begin CHARACTERISTIC DSCHED_FacPhys.FId_MisfDetDnAdpnNv_C "weighting physical priority / Factor for physical Priority for scheduled FId FId_MisfDetDnAdpnNv" VALUE 0x80503AC5 Val_Wu8 255.0 DFC_OneToOne 0.00 255.0 FORMAT "%5.1" /end CHARACTERISTIC
/begin CHARACTERISTIC DSCHED_FacPhys.FId_bascadpncvo_C "weighting physical priority / Factor for physical Priority for scheduled FId FId_bascadpncvo" VALUE 0x80503AC6 Val_Wu8 255.0 DFC_OneToOne 0.00 255.0 FORMAT "%5.1" /end CHARACTERISTIC
/begin CHARACTERISTIC DSCHED_JmpActvPrio.FID_AFRA_C "priority bonus while active / Jump Active Priority for scheduled FId FID_AFRA" VALUE 0x80503AC8 Val_Wu16 8191.000 DFC_OneToOne 0.00 8191.000 FORMAT "%8.3" EXTENDED_LIMITS 0.00 65535.00 /end CHARACTERISTIC
/begin CHARACTERISTIC DSCHED_JmpActvPrio.FID_AORA_C "priority bonus while active / Jump Active Priority for scheduled FId FID_AORA" VALUE 0x80503ACA Val_Wu16 8191.000 DFC_OneToOne 0.00 8191.000 FORMAT "%8.3" EXTENDED_LIMITS 0.00 65535.00 /end CHARACTERISTIC
/begin CHARACTERISTIC DSCHED_JmpActvPrio.FID_ATEH_C "priority bonus while active / Jump Active Priority for scheduled FId FID_ATEH" VALUE 0x80503ACC Val_Wu16 8191.000 DFC_OneToOne 0.00 8191.000 FORMAT "%8.3" EXTENDED_LIMITS 0.00 65535.00 /end CHARACTERISTIC
/begin CHARACTERISTIC DSCHED_JmpActvPrio.FID_ATEL_C "priority bonus while active / Jump Active Priority for scheduled FId FID_ATEL" VALUE 0x80503ACE Val_Wu16 8191.000 DFC_OneToOne 0.00 8191.000 FORMAT "%8.3" EXTENDED_LIMITS 0.00 65535.00 /end CHARACTERISTIC
/begin CHARACTERISTIC DSCHED_JmpActvPrio.FID_ATEN_C "priority bonus while active / Jump Active Priority for scheduled FId FID_ATEN" VALUE 0x80503AD0 Val_Wu16 8191.000 DFC_OneToOne 0.00 8191.000 FORMAT "%8.3" EXTENDED_LIMITS 0.00 65535.00 /end CHARACTERISTIC
/begin CHARACTERISTIC DSCHED_JmpActvPrio.FID_ATLDI_C "priority bonus while active / Jump Active Priority for scheduled FId FID_ATLDI" VALUE 0x80503AD2 Val_Wu16 8191.000 DFC_OneToOne 0.00 8191.000 FORMAT "%8.3" EXTENDED_LIMITS 0.00 65535.00 /end CHARACTERISTIC
/begin CHARACTERISTIC DSCHED_JmpActvPrio.FID_ATLDO_C "priority bonus while active / Jump Active Priority for scheduled FId FID_ATLDO" VALUE 0x80503AD4 Val_Wu16 8191.000 DFC_OneToOne 0.00 8191.000 FORMAT "%8.3" EXTENDED_LIMITS 0.00 65535.00 /end CHARACTERISTIC
/begin CHARACTERISTIC DSCHED_JmpActvPrio.FID_BEONV_C "priority bonus while active / Jump Active Priority for scheduled FId FID_BEONV" VALUE 0x80503AD6 Val_Wu16 8191.000 DFC_OneToOne 0.00 8191.000 FORMAT "%8.3" EXTENDED_LIMITS 0.00 65535.00 /end CHARACTERISTIC
/begin CHARACTERISTIC DSCHED_JmpActvPrio.FId_EGSDCmnSeg1B1Parl_C "priority bonus while active / Jump Active Priority for scheduled FId FId_EGSDCmnSeg1B1Parl" VALUE 0x80503AD8 Val_Wu16 8191.000 DFC_OneToOne 0.00 8191.000 FORMAT "%8.3" EXTENDED_LIMITS 0.00 65535.00 /end CHARACTERISTIC
/begin CHARACTERISTIC DSCHED_JmpActvPrio.FID_BAGRA_C "priority bonus while active / Jump Active Priority for scheduled FId FID_BAGRA" VALUE 0x80503ADA Val_Wu16 8191.000 DFC_OneToOne 0.00 8191.000 FORMAT "%8.3" EXTENDED_LIMITS 0.00 65535.00 /end CHARACTERISTIC
/begin CHARACTERISTIC DSCHED_JmpActvPrio.FID_BAGRASD_C "priority bonus while active / Jump Active Priority for scheduled FId FID_BAGRASD" VALUE 0x80503ADC Val_Wu16 8191.000 DFC_OneToOne 0.00 8191.000 FORMAT "%8.3" EXTENDED_LIMITS 0.00 65535.00 /end CHARACTERISTIC
/begin CHARACTERISTIC DSCHED_JmpActvPrio.FID_BDSTOF_C "priority bonus while active / Jump Active Priority for scheduled FId FID_BDSTOF" VALUE 0x80503ADE Val_Wu16 8191.000 DFC_OneToOne 0.00 8191.000 FORMAT "%8.3" EXTENDED_LIMITS 0.00 65535.00 /end CHARACTERISTIC
/begin CHARACTERISTIC DSCHED_JmpActvPrio.FID_BFVDFRM_C "priority bonus while active / Jump Active Priority for scheduled FId FID_BFVDFRM" VALUE 0x80503AE0 Val_Wu16 8191.000 DFC_OneToOne 0.00 8191.000 FORMAT "%8.3" EXTENDED_LIMITS 0.00 65535.00 /end CHARACTERISTIC
/begin CHARACTERISTIC DSCHED_JmpActvPrio.FID_BHOM_C "priority bonus while active / Jump Active Priority for scheduled FId FID_BHOM" VALUE 0x80503AE2 Val_Wu16 8191.000 DFC_OneToOne 0.00 8191.000 FORMAT "%8.3" EXTENDED_LIMITS 0.00 65535.00 /end CHARACTERISTIC
/begin CHARACTERISTIC DSCHED_JmpActvPrio.FID_BLLRH_C "priority bonus while active / Jump Active Priority for scheduled FId FID_BLLRH" VALUE 0x80503AE4 Val_Wu16 8191.000 DFC_OneToOne 0.00 8191.000 FORMAT "%8.3" EXTENDED_LIMITS 0.00 65535.00 /end CHARACTERISTIC
/begin CHARACTERISTIC DSCHED_JmpActvPrio.FID_BLLRKH_C "priority bonus while active / Jump Active Priority for scheduled FId FID_BLLRKH" VALUE 0x80503AE6 Val_Wu16 8191.000 DFC_OneToOne 0.00 8191.000 FORMAT "%8.3" EXTENDED_LIMITS 0.00 65535.00 /end CHARACTERISTIC
/begin CHARACTERISTIC DSCHED_JmpActvPrio.FID_BPLSU_C "priority bonus while active / Jump Active Priority for scheduled FId FID_BPLSU" VALUE 0x80503AE8 Val_Wu16 8191.000 DFC_OneToOne 0.00 8191.000 FORMAT "%8.3" EXTENDED_LIMITS 0.00 65535.00 /end CHARACTERISTIC
/begin CHARACTERISTIC DSCHED_JmpActvPrio.FID_FRAMBAVMB_C "priority bonus while active / Jump Active Priority for scheduled FId FID_FRAMBAVMB" VALUE 0x80503AEA Val_Wu16 8191.000 DFC_OneToOne 0.00 8191.000 FORMAT "%8.3" EXTENDED_LIMITS 0.00 65535.00 /end CHARACTERISTIC
/begin CHARACTERISTIC DSCHED_JmpActvPrio.FId_CatHeatgColdStrtReq_C "priority bonus while active / Jump Active Priority for scheduled FId FId_CatHeatgColdStrtReq" VALUE 0x80503AEC Val_Wu16 8191.000 DFC_OneToOne 0.00 8191.000 FORMAT "%8.3" EXTENDED_LIMITS 0.00 65535.00 /end CHARACTERISTIC
/begin CHARACTERISTIC DSCHED_JmpActvPrio.FId_CatHeatgWrmReq_C "priority bonus while active / Jump Active Priority for scheduled FId FId_CatHeatgWrmReq" VALUE 0x80503AEE Val_Wu16 8191.000 DFC_OneToOne 0.00 8191.000 FORMAT "%8.3" EXTENDED_LIMITS 0.00 65535.00 /end CHARACTERISTIC
/begin CHARACTERISTIC DSCHED_JmpActvPrio.FId_DSMBDEPHSpOpMode_C "priority bonus while active / Jump Active Priority for scheduled FId FId_DSMBDEPHSpOpMode" VALUE 0x80503AF0 Val_Wu16 8191.000 DFC_OneToOne 0.00 8191.000 FORMAT "%8.3" EXTENDED_LIMITS 0.00 65535.00 /end CHARACTERISTIC
/begin CHARACTERISTIC DSCHED_JmpActvPrio.FId_EGRVlvCoord_C "priority bonus while active / Jump Active Priority for scheduled FId FId_EGRVlvCoord" VALUE 0x80503AF2 Val_Wu16 8191.000 DFC_OneToOne 0.00 8191.000 FORMAT "%8.3" EXTENDED_LIMITS 0.00 65535.00 /end CHARACTERISTIC
/begin CHARACTERISTIC DSCHED_JmpActvPrio.FId_EGSDO2FuTrmB1_C "priority bonus while active / Jump Active Priority for scheduled FId FId_EGSDO2FuTrmB1" VALUE 0x80503AF4 Val_Wu16 8191.000 DFC_OneToOne 0.00 8191.000 FORMAT "%8.3" EXTENDED_LIMITS 0.00 65535.00 /end CHARACTERISTIC
/begin CHARACTERISTIC DSCHED_JmpActvPrio.FId_EGSDO2SnsrMntdRelsS1B1_C "priority bonus while active / Jump Active Priority for scheduled FId FId_EGSDO2SnsrMntdRelsS1B1" VALUE 0x80503AF6 Val_Wu16 8191.000 DFC_OneToOne 0.00 8191.000 FORMAT "%8.3" EXTENDED_LIMITS 0.00 65535.00 /end CHARACTERISTIC
/begin CHARACTERISTIC DSCHED_JmpActvPrio.FId_EGSDO2_LamOffsFastS1B1_C "priority bonus while active / Jump Active Priority for scheduled FId FId_EGSDO2_LamOffsFastS1B1" VALUE 0x80503AF8 Val_Wu16 8191.000 DFC_OneToOne 0.00 8191.000 FORMAT "%8.3" EXTENDED_LIMITS 0.00 65535.00 /end CHARACTERISTIC
/begin CHARACTERISTIC DSCHED_JmpActvPrio.FId_MisfDetDnAdpnNv_C "priority bonus while active / Jump Active Priority for scheduled FId FId_MisfDetDnAdpnNv" VALUE 0x80503AFA Val_Wu16 8191.000 DFC_OneToOne 0.00 8191.000 FORMAT "%8.3" EXTENDED_LIMITS 0.00 65535.00 /end CHARACTERISTIC
/begin CHARACTERISTIC DSCHED_JmpActvPrio.FId_bascadpncvo_C "priority bonus while active / Jump Active Priority for scheduled FId FId_bascadpncvo" VALUE 0x80503AFC Val_Wu16 8191.000 DFC_OneToOne 0.00 8191.000 FORMAT "%8.3" EXTENDED_LIMITS 0.00 65535.00 /end CHARACTERISTIC
/begin CHARACTERISTIC DSCHED_LimPrio.FID_AFRA_C "upper priority limit / Upper priority limit if rate calculation is disabled for scheduled FId FID_AFRA" VALUE 0x80503AFE Val_Wu16 8191.000 DFC_OneToOne 0.00 8191.000 FORMAT "%8.3" EXTENDED_LIMITS 0.00 65535.00 /end CHARACTERISTIC
/begin CHARACTERISTIC DSCHED_LimPrio.FID_AORA_C "upper priority limit / Upper priority limit if rate calculation is disabled for scheduled FId FID_AORA" VALUE 0x80503B00 Val_Wu16 8191.000 DFC_OneToOne 0.00 8191.000 FORMAT "%8.3" EXTENDED_LIMITS 0.00 65535.00 /end CHARACTERISTIC
/begin CHARACTERISTIC DSCHED_LimPrio.FID_ATEH_C "upper priority limit / Upper priority limit if rate calculation is disabled for scheduled FId FID_ATEH" VALUE 0x80503B02 Val_Wu16 8191.000 DFC_OneToOne 0.00 8191.000 FORMAT "%8.3" EXTENDED_LIMITS 0.00 65535.00 /end CHARACTERISTIC
/begin CHARACTERISTIC DSCHED_LimPrio.FID_ATEL_C "upper priority limit / Upper priority limit if rate calculation is disabled for scheduled FId FID_ATEL" VALUE 0x80503B04 Val_Wu16 8191.000 DFC_OneToOne 0.00 8191.000 FORMAT "%8.3" EXTENDED_LIMITS 0.00 65535.00 /end CHARACTERISTIC
/begin CHARACTERISTIC DSCHED_LimPrio.FID_ATEN_C "upper priority limit / Upper priority limit if rate calculation is disabled for scheduled FId FID_ATEN" VALUE 0x80503B06 Val_Wu16 8191.000 DFC_OneToOne 0.00 8191.000 FORMAT "%8.3" EXTENDED_LIMITS 0.00 65535.00 /end CHARACTERISTIC
/begin CHARACTERISTIC DSCHED_LimPrio.FID_ATLDI_C "upper priority limit / Upper priority limit if rate calculation is disabled for scheduled FId FID_ATLDI" VALUE 0x80503B08 Val_Wu16 8191.000 DFC_OneToOne 0.00 8191.000 FORMAT "%8.3" EXTENDED_LIMITS 0.00 65535.00 /end CHARACTERISTIC
/begin CHARACTERISTIC DSCHED_LimPrio.FID_ATLDO_C "upper priority limit / Upper priority limit if rate calculation is disabled for scheduled FId FID_ATLDO" VALUE 0x80503B0A Val_Wu16 8191.000 DFC_OneToOne 0.00 8191.000 FORMAT "%8.3" EXTENDED_LIMITS 0.00 65535.00 /end CHARACTERISTIC
/begin CHARACTERISTIC DSCHED_LimPrio.FID_BEONV_C "upper priority limit / Upper priority limit if rate calculation is disabled for scheduled FId FID_BEONV" VALUE 0x80503B0C Val_Wu16 8191.000 DFC_OneToOne 0.00 8191.000 FORMAT "%8.3" EXTENDED_LIMITS 0.00 65535.00 /end CHARACTERISTIC
/begin CHARACTERISTIC DSCHED_LimPrio.FId_EGSDCmnSeg1B1Parl_C "upper priority limit / Upper priority limit if rate calculation is disabled for scheduled FId FId_EGSDCmnSeg1B1Parl" VALUE 0x80503B0E Val_Wu16 8191.000 DFC_OneToOne 0.00 8191.000 FORMAT "%8.3" EXTENDED_LIMITS 0.00 65535.00 /end CHARACTERISTIC
/begin CHARACTERISTIC DSCHED_LimPrio.FID_BAGRA_C "upper priority limit / Upper priority limit if rate calculation is disabled for scheduled FId FID_BAGRA" VALUE 0x80503B10 Val_Wu16 8191.000 DFC_OneToOne 0.00 8191.000 FORMAT "%8.3" EXTENDED_LIMITS 0.00 65535.00 /end CHARACTERISTIC
/begin CHARACTERISTIC DSCHED_LimPrio.FID_BAGRASD_C "upper priority limit / Upper priority limit if rate calculation is disabled for scheduled FId FID_BAGRASD" VALUE 0x80503B12 Val_Wu16 8191.000 DFC_OneToOne 0.00 8191.000 FORMAT "%8.3" EXTENDED_LIMITS 0.00 65535.00 /end CHARACTERISTIC
/begin CHARACTERISTIC DSCHED_LimPrio.FID_BDSTOF_C "upper priority limit / Upper priority limit if rate calculation is disabled for scheduled FId FID_BDSTOF" VALUE 0x80503B14 Val_Wu16 8191.000 DFC_OneToOne 0.00 8191.000 FORMAT "%8.3" EXTENDED_LIMITS 0.00 65535.00 /end CHARACTERISTIC
/begin CHARACTERISTIC DSCHED_LimPrio.FID_BFVDFRM_C "upper priority limit / Upper priority limit if rate calculation is disabled for scheduled FId FID_BFVDFRM" VALUE 0x80503B16 Val_Wu16 8191.000 DFC_OneToOne 0.00 8191.000 FORMAT "%8.3" EXTENDED_LIMITS 0.00 65535.00 /end CHARACTERISTIC
/begin CHARACTERISTIC DSCHED_LimPrio.FID_BHOM_C "upper priority limit / Upper priority limit if rate calculation is disabled for scheduled FId FID_BHOM" VALUE 0x80503B18 Val_Wu16 8191.000 DFC_OneToOne 0.00 8191.000 FORMAT "%8.3" EXTENDED_LIMITS 0.00 65535.00 /end CHARACTERISTIC
/begin CHARACTERISTIC DSCHED_LimPrio.FID_BLLRH_C "upper priority limit / Upper priority limit if rate calculation is disabled for scheduled FId FID_BLLRH" VALUE 0x80503B1A Val_Wu16 8191.000 DFC_OneToOne 0.00 8191.000 FORMAT "%8.3" EXTENDED_LIMITS 0.00 65535.00 /end CHARACTERISTIC
/begin CHARACTERISTIC DSCHED_LimPrio.FID_BLLRKH_C "upper priority limit / Upper priority limit if rate calculation is disabled for scheduled FId FID_BLLRKH" VALUE 0x80503B1C Val_Wu16 8191.000 DFC_OneToOne 0.00 8191.000 FORMAT "%8.3" EXTENDED_LIMITS 0.00 65535.00 /end CHARACTERISTIC
/begin CHARACTERISTIC DSCHED_LimPrio.FID_BPLSU_C "upper priority limit / Upper priority limit if rate calculation is disabled for scheduled FId FID_BPLSU" VALUE 0x80503B1E Val_Wu16 8191.000 DFC_OneToOne 0.00 8191.000 FORMAT "%8.3" EXTENDED_LIMITS 0.00 65535.00 /end CHARACTERISTIC
/begin CHARACTERISTIC DSCHED_LimPrio.FID_FRAMBAVMB_C "upper priority limit / Upper priority limit if rate calculation is disabled for scheduled FId FID_FRAMBAVMB" VALUE 0x80503B20 Val_Wu16 8191.000 DFC_OneToOne 0.00 8191.000 FORMAT "%8.3" EXTENDED_LIMITS 0.00 65535.00 /end CHARACTERISTIC
/begin CHARACTERISTIC DSCHED_LimPrio.FId_CatHeatgColdStrtReq_C "upper priority limit / Upper priority limit if rate calculation is disabled for scheduled FId FId_CatHeatgColdStrtReq" VALUE 0x80503B22 Val_Wu16 8191.000 DFC_OneToOne 0.00 8191.000 FORMAT "%8.3" EXTENDED_LIMITS 0.00 65535.00 /end CHARACTERISTIC
/begin CHARACTERISTIC DSCHED_LimPrio.FId_CatHeatgWrmReq_C "upper priority limit / Upper priority limit if rate calculation is disabled for scheduled FId FId_CatHeatgWrmReq" VALUE 0x80503B24 Val_Wu16 8191.000 DFC_OneToOne 0.00 8191.000 FORMAT "%8.3" EXTENDED_LIMITS 0.00 65535.00 /end CHARACTERISTIC
/begin CHARACTERISTIC DSCHED_LimPrio.FId_DSMBDEPHSpOpMode_C "upper priority limit / Upper priority limit if rate calculation is disabled for scheduled FId FId_DSMBDEPHSpOpMode" VALUE 0x80503B26 Val_Wu16 8191.000 DFC_OneToOne 0.00 8191.000 FORMAT "%8.3" EXTENDED_LIMITS 0.00 65535.00 /end CHARACTERISTIC
/begin CHARACTERISTIC DSCHED_LimPrio.FId_EGRVlvCoord_C "upper priority limit / Upper priority limit if rate calculation is disabled for scheduled FId FId_EGRVlvCoord" VALUE 0x80503B28 Val_Wu16 8191.000 DFC_OneToOne 0.00 8191.000 FORMAT "%8.3" EXTENDED_LIMITS 0.00 65535.00 /end CHARACTERISTIC
/begin CHARACTERISTIC DSCHED_LimPrio.FId_EGSDO2FuTrmB1_C "upper priority limit / Upper priority limit if rate calculation is disabled for scheduled FId FId_EGSDO2FuTrmB1" VALUE 0x80503B2A Val_Wu16 8191.000 DFC_OneToOne 0.00 8191.000 FORMAT "%8.3" EXTENDED_LIMITS 0.00 65535.00 /end CHARACTERISTIC
/begin CHARACTERISTIC DSCHED_LimPrio.FId_EGSDO2SnsrMntdRelsS1B1_C "upper priority limit / Upper priority limit if rate calculation is disabled for scheduled FId FId_EGSDO2SnsrMntdRelsS1B1" VALUE 0x80503B2C Val_Wu16 8191.000 DFC_OneToOne 0.00 8191.000 FORMAT "%8.3" EXTENDED_LIMITS 0.00 65535.00 /end CHARACTERISTIC
/begin CHARACTERISTIC DSCHED_LimPrio.FId_EGSDO2_LamOffsFastS1B1_C "upper priority limit / Upper priority limit if rate calculation is disabled for scheduled FId FId_EGSDO2_LamOffsFastS1B1" VALUE 0x80503B2E Val_Wu16 8191.000 DFC_OneToOne 0.00 8191.000 FORMAT "%8.3" EXTENDED_LIMITS 0.00 65535.00 /end CHARACTERISTIC
/begin CHARACTERISTIC DSCHED_LimPrio.FId_MisfDetDnAdpnNv_C "upper priority limit / Upper priority limit if rate calculation is disabled for scheduled FId FId_MisfDetDnAdpnNv" VALUE 0x80503B30 Val_Wu16 8191.000 DFC_OneToOne 0.00 8191.000 FORMAT "%8.3" EXTENDED_LIMITS 0.00 65535.00 /end CHARACTERISTIC
/begin CHARACTERISTIC DSCHED_LimPrio.FId_bascadpncvo_C "upper priority limit / Upper priority limit if rate calculation is disabled for scheduled FId FId_bascadpncvo" VALUE 0x80503B32 Val_Wu16 8191.000 DFC_OneToOne 0.00 8191.000 FORMAT "%8.3" EXTENDED_LIMITS 0.00 65535.00 /end CHARACTERISTIC
/begin CHARACTERISTIC DSCHED_valOfsPrioOpMode_C "Jump Priority Operation Mode (additional priority if operation mode is compatible to possible operation modes)" VALUE 0x80503B34 Val_Wu16 8191.000 DINH_OneToOne 0.00 8191.000 FORMAT "%8.3" EXTENDED_LIMITS 0.00 65535.00 /end CHARACTERISTIC
/begin CHARACTERISTIC DSCHED_valOfsPrioTst_C "Increase Priority on not tested (additional priority if tested flag is not set)" VALUE 0x80503B36 Val_Wu16 8191.000 DINH_OneToOne 0.00 8191.000 FORMAT "%8.3" EXTENDED_LIMITS 0.00 65535.00 /end CHARACTERISTIC
/begin MEASUREMENT DRIVE_AobsFrqTmr "Frequency timer for arbitrary OBS judgement method" SLONG Time_s 1 100 -21474836.4800 21474836.4700 FORMAT "%13.4" ARRAY_SIZE 20 ECU_ADDRESS 0x60002FBC /end MEASUREMENT
/begin MEASUREMENT DRIVE_AobsTmrCnt "Display value for judgement methods" SLONG OneToOne 1 100 -2147483648.00 2147483647.00 FORMAT "%13.2" ARRAY_SIZE 20 ECU_ADDRESS 0x60002F6C /end MEASUREMENT
/begin MEASUREMENT DRIVE_AOBS_Mode "Mode of Arbitrary OBS" UBYTE DRIVE_AOBS_MODE 1 100 0.00 1.00000000000 FORMAT "%13.11" ECU_ADDRESS 0x60039405 /end MEASUREMENT
/begin MEASUREMENT DRIVE_AOBS_stPrmSet "Setting status of Arbitrary OBS parameters" UBYTE DRIVE_AOBS_stSet 1 100 0.00 1.00000000000 FORMAT "%13.11" ECU_ADDRESS 0x60039404 /end MEASUREMENT
/begin MEASUREMENT Drive_DSMFaults "Copy of DFC no. of DFES entries." UWORD OneToOne 1 100 0.00 65535.00 FORMAT "%8.2" ARRAY_SIZE 20 ECU_ADDRESS 0x600393DC /end MEASUREMENT
/begin MEASUREMENT DRIVE_FirstLayerResult "Status of First Layer expression result of Arbitrary OBS" UBYTE OneToOne 1 100 0.00 255.0 FORMAT "%5.1" ECU_ADDRESS 0x6000E7D4 /end MEASUREMENT
/begin MEASUREMENT Drive_idxDFC "DFC number of the OBD OBS frozen fault" ULONG OneToOne 1 100 0.00 4294967295.00 FORMAT "%13.2" ECU_ADDRESS 0x600393D8 /end MEASUREMENT
/begin MEASUREMENT DRIVE_numAOBSDCTIDLst_defined "DCTID List for service B8" UWORD OneToOne 1 100 0.00 65535.00 FORMAT "%8.2" ARRAY_SIZE 2 ECU_ADDRESS 0x600393D2 /end MEASUREMENT
/begin MEASUREMENT DRIVE_numAOBSDCTIDLst_record "DCTID List for service B9" UWORD OneToOne 1 100 0.00 65535.00 FORMAT "%8.2" ARRAY_SIZE 2 ECU_ADDRESS 0x600393CE /end MEASUREMENT
/begin MEASUREMENT DRIVE_numDTCFrz "DTC number for the corresponding DFC which caused the trigger" UWORD OneToOne 1 100 0.00 65535.00 FORMAT "%8.2" ECU_ADDRESS 0x60039626 /end MEASUREMENT
/begin MEASUREMENT Drive_numPCode "Array of PCode data for confirmed DTC faults" UWORD OneToOne 1 100 0.00 65535.00 FORMAT "%8.2" ARRAY_SIZE 20 ECU_ADDRESS 0x600393A6 /end MEASUREMENT
/begin MEASUREMENT DRIVE_PRDS_Bnk0Blk00_idx_NV "non volatile index storage for DRIVE recorder blocks" UWORD OneToOne 1 100 0.00 65535.00 FORMAT "%8.2" ARRAY_SIZE 2 ECU_ADDRESS 0x600393A2 /end MEASUREMENT
/begin MEASUREMENT DRIVE_PRDS_Bnk0Blk00_Rcrd_NV "DRIVE recorder non volatile record buffer" UBYTE OneToOne 1 100 0.00 255.0 FORMAT "%5.1" ARRAY_SIZE 600 ECU_ADDRESS 0x5001678B /end MEASUREMENT
/begin MEASUREMENT DRIVE_PRDS_Bnk0Blk01_idx_NV "non volatile index storage for DRIVE recorder blocks" UWORD OneToOne 1 100 0.00 65535.00 FORMAT "%8.2" ARRAY_SIZE 2 ECU_ADDRESS 0x6003939E /end MEASUREMENT
/begin MEASUREMENT DRIVE_PRDS_Bnk0Blk01_Rcrd_NV "DRIVE recorder non volatile record buffer" UBYTE OneToOne 1 100 0.00 255.0 FORMAT "%5.1" ARRAY_SIZE 2625 ECU_ADDRESS 0x50015D4A /end MEASUREMENT
/begin MEASUREMENT DRIVE_PRDS_Bnk0Blk02_idx_NV "non volatile index storage for DRIVE recorder blocks" UWORD OneToOne 1 100 0.00 65535.00 FORMAT "%8.2" ARRAY_SIZE 2 ECU_ADDRESS 0x6003939A /end MEASUREMENT
/begin MEASUREMENT DRIVE_PRDS_Bnk0Blk02_Rcrd_NV "DRIVE recorder non volatile record buffer" UBYTE OneToOne 1 100 0.00 255.0 FORMAT "%5.1" ARRAY_SIZE 675 ECU_ADDRESS 0x50015AA7 /end MEASUREMENT
/begin MEASUREMENT DRIVE_PRDS_Bnk0Blk04_idx_NV "non volatile index storage for DRIVE recorder blocks" UWORD OneToOne 1 100 0.00 65535.00 FORMAT "%8.2" ARRAY_SIZE 2 ECU_ADDRESS 0x60039396 /end MEASUREMENT
/begin MEASUREMENT DRIVE_PRDS_Bnk0Blk04_Rcrd_NV "DRIVE recorder non volatile record buffer" UBYTE OneToOne 1 100 0.00 255.0 FORMAT "%5.1" ARRAY_SIZE 750 ECU_ADDRESS 0x500157B9 /end MEASUREMENT
/begin MEASUREMENT DRIVE_PRDS_Bnk0Blk05_idx_NV "non volatile index storage for DRIVE recorder blocks" UWORD OneToOne 1 100 0.00 65535.00 FORMAT "%8.2" ARRAY_SIZE 2 ECU_ADDRESS 0x60039392 /end MEASUREMENT
/begin MEASUREMENT DRIVE_PRDS_Bnk0Blk05_Rcrd_NV "DRIVE recorder non volatile record buffer" UBYTE OneToOne 1 100 0.00 255.0 FORMAT "%5.1" ARRAY_SIZE 150 ECU_ADDRESS 0x50015723 /end MEASUREMENT
/begin MEASUREMENT DRIVE_PRDS_Bnk0Blk06_idx_NV "non volatile index storage for DRIVE recorder blocks" UWORD OneToOne 1 100 0.00 65535.00 FORMAT "%8.2" ARRAY_SIZE 2 ECU_ADDRESS 0x6003938E /end MEASUREMENT
/begin MEASUREMENT DRIVE_PRDS_Bnk0Blk06_Rcrd_NV "DRIVE recorder non volatile record buffer" UBYTE OneToOne 1 100 0.00 255.0 FORMAT "%5.1" ARRAY_SIZE 615 ECU_ADDRESS 0x500154BC /end MEASUREMENT
/begin MEASUREMENT DRIVE_PRDS_Bnk0Blk07_idx_NV "non volatile index storage for DRIVE recorder blocks" UWORD OneToOne 1 100 0.00 65535.00 FORMAT "%8.2" ARRAY_SIZE 2 ECU_ADDRESS 0x6003938A /end MEASUREMENT
/begin MEASUREMENT DRIVE_PRDS_Bnk0Blk07_Rcrd_NV "non volatile recording buffer for DRIVE blocks" UBYTE OneToOne 1 100 0.00 255.0 FORMAT "%5.1" ARRAY_SIZE 180 ECU_ADDRESS 0x50015408 /end MEASUREMENT
/begin MEASUREMENT DRIVE_PRDS_Bnk0Blk09_idx_NV "non volatile index storage for DRIVE recorder blocks" UWORD OneToOne 1 100 0.00 65535.00 FORMAT "%8.2" ARRAY_SIZE 2 ECU_ADDRESS 0x60039386 /end MEASUREMENT
/begin MEASUREMENT DRIVE_PRDS_Bnk0Blk09_Rcrd_NV "non volatile recording buffer for DRIVE blocks" UBYTE OneToOne 1 100 0.00 255.0 FORMAT "%5.1" ARRAY_SIZE 165 ECU_ADDRESS 0x50015363 /end MEASUREMENT
/begin MEASUREMENT DRIVE_PRDS_Bnk0Blk0a_idx_NV "non volatile index storage for DRIVE recorder blocks" UWORD OneToOne 1 100 0.00 65535.00 FORMAT "%8.2" ARRAY_SIZE 2 ECU_ADDRESS 0x60039382 /end MEASUREMENT
/begin MEASUREMENT DRIVE_PRDS_Bnk0Blk0a_Rcrd_NV "DRIVE recorder non volatile record buffer" UBYTE OneToOne 1 100 0.00 255.0 FORMAT "%5.1" ARRAY_SIZE 720 ECU_ADDRESS 0x50015093 /end MEASUREMENT
/begin MEASUREMENT DRIVE_PRDS_Bnk0Blk0b_idx_NV "non volatile index storage for DRIVE recorder blocks" UWORD OneToOne 1 100 0.00 65535.00 FORMAT "%8.2" ARRAY_SIZE 2 ECU_ADDRESS 0x6003937E /end MEASUREMENT
/begin MEASUREMENT DRIVE_PRDS_Bnk0Blk0b_Rcrd_NV "DRIVE recorder non volatile record buffer" UBYTE OneToOne 1 100 0.00 255.0 FORMAT "%5.1" ARRAY_SIZE 720 ECU_ADDRESS 0x50014DC3 /end MEASUREMENT
/begin MEASUREMENT DRIVE_PRDS_Bnk0Blk0c_idx_NV "non volatile index storage for DRIVE recorder blocks" UWORD OneToOne 1 100 0.00 65535.00 FORMAT "%8.2" ARRAY_SIZE 2 ECU_ADDRESS 0x6003937A /end MEASUREMENT
/begin MEASUREMENT DRIVE_PRDS_Bnk0Blk0c_Rcrd_NV "DRIVE recorder non volatile record buffer" UBYTE OneToOne 1 100 0.00 255.0 FORMAT "%5.1" ARRAY_SIZE 1440 ECU_ADDRESS 0x50014823 /end MEASUREMENT
/begin MEASUREMENT DRIVE_PRDS_Bnk0Blk0d_idx_NV "non volatile index storage for DRIVE recorder blocks" UWORD OneToOne 1 100 0.00 65535.00 FORMAT "%8.2" ARRAY_SIZE 2 ECU_ADDRESS 0x60039376 /end MEASUREMENT
/begin MEASUREMENT DRIVE_PRDS_Bnk0Blk0d_Rcrd_NV "DRIVE recorder non volatile record buffer" UBYTE OneToOne 1 100 0.00 255.0 FORMAT "%5.1" ARRAY_SIZE 960 ECU_ADDRESS 0x50014463 /end MEASUREMENT
/begin MEASUREMENT DRIVE_PRDS_Bnk0Blk0e_idx_NV "non volatile index storage for DRIVE recorder blocks" UWORD OneToOne 1 100 0.00 65535.00 FORMAT "%8.2" ARRAY_SIZE 2 ECU_ADDRESS 0x60039372 /end MEASUREMENT
/begin MEASUREMENT DRIVE_PRDS_Bnk0Blk0e_Rcrd_NV "DRIVE recorder non volatile record buffer" UBYTE OneToOne 1 100 0.00 255.0 FORMAT "%5.1" ARRAY_SIZE 30 ECU_ADDRESS 0x50014445 /end MEASUREMENT
/begin MEASUREMENT DRIVE_PRDS_Bnk0Blk0f_idx_NV "non volatile index storage for DRIVE recorder blocks" UWORD OneToOne 1 100 0.00 65535.00 FORMAT "%8.2" ARRAY_SIZE 2 ECU_ADDRESS 0x6003936E /end MEASUREMENT
/begin MEASUREMENT DRIVE_PRDS_Bnk0Blk0f_Rcrd_NV "DRIVE recorder non volatile record buffer" UBYTE OneToOne 1 100 0.00 255.0 FORMAT "%5.1" ARRAY_SIZE 41 ECU_ADDRESS 0x5001441C /end MEASUREMENT
/begin MEASUREMENT DRIVE_PRDS_Bnk0Blk10_idx_NV "non volatile index storage for DRIVE recorder blocks" UWORD OneToOne 1 100 0.00 65535.00 FORMAT "%8.2" ARRAY_SIZE 2 ECU_ADDRESS 0x6003936A /end MEASUREMENT
/begin MEASUREMENT DRIVE_PRDS_Bnk0Blk10_Rcrd_NV "DRIVE recorder non volatile record buffer" UBYTE OneToOne 1 100 0.00 255.0 FORMAT "%5.1" ARRAY_SIZE 42 ECU_ADDRESS 0x500143F2 /end MEASUREMENT
/begin MEASUREMENT DRIVE_PRDS_Bnk0Blk11_idx_NV "non volatile index storage for DRIVE recorder blocks" UWORD OneToOne 1 100 0.00 65535.00 FORMAT "%8.2" ARRAY_SIZE 2 ECU_ADDRESS 0x60039366 /end MEASUREMENT
/begin MEASUREMENT DRIVE_PRDS_Bnk0Blk11_Rcrd_NV "DRIVE recorder non volatile record buffer" UBYTE OneToOne 1 100 0.00 255.0 FORMAT "%5.1" ARRAY_SIZE 42 ECU_ADDRESS 0x500143C8 /end MEASUREMENT
/begin MEASUREMENT DRIVE_PRDS_Bnk0Blk12_idx_NV "non volatile index storage for DRIVE recorder blocks" UWORD OneToOne 1 100 0.00 65535.00 FORMAT "%8.2" ARRAY_SIZE 2 ECU_ADDRESS 0x60039362 /end MEASUREMENT
/begin MEASUREMENT DRIVE_PRDS_Bnk0Blk12_Rcrd_NV "DRIVE recorder non volatile record buffer" UBYTE OneToOne 1 100 0.00 255.0 FORMAT "%5.1" ARRAY_SIZE 42 ECU_ADDRESS 0x5001439E /end MEASUREMENT
/begin MEASUREMENT DRIVE_PRDS_Bnk0Blk13_idx_NV "non volatile index storage for DRIVE recorder blocks" UWORD OneToOne 1 100 0.00 65535.00 FORMAT "%8.2" ARRAY_SIZE 2 ECU_ADDRESS 0x6003935E /end MEASUREMENT
/begin MEASUREMENT DRIVE_PRDS_Bnk0Blk13_Rcrd_NV "DRIVE recorder non volatile record buffer" UBYTE OneToOne 1 100 0.00 255.0 FORMAT "%5.1" ARRAY_SIZE 42 ECU_ADDRESS 0x50014374 /end MEASUREMENT
/begin MEASUREMENT DRIVE_PRDS_Bnk0Blk14_idx_NV "non volatile index storage for DRIVE recorder blocks" UWORD OneToOne 1 100 0.00 65535.00 FORMAT "%8.2" ARRAY_SIZE 2 ECU_ADDRESS 0x6003935A /end MEASUREMENT
/begin MEASUREMENT DRIVE_PRDS_Bnk0Blk14_Rcrd_NV "DRIVE recorder non volatile record buffer" UBYTE OneToOne 1 100 0.00 255.0 FORMAT "%5.1" ARRAY_SIZE 4 ECU_ADDRESS 0x50014370 /end MEASUREMENT
/begin MEASUREMENT DRIVE_PRDS_Bnk0Blk15_idx_NV "non volatile index storage for DRIVE recorder blocks" UWORD OneToOne 1 100 0.00 65535.00 FORMAT "%8.2" ARRAY_SIZE 2 ECU_ADDRESS 0x60039356 /end MEASUREMENT
/begin MEASUREMENT DRIVE_PRDS_Bnk0Blk15_Rcrd_NV "DRIVE recorder non volatile record buffer" UBYTE OneToOne 1 100 0.00 255.0 FORMAT "%5.1" ARRAY_SIZE 29 ECU_ADDRESS 0x50014353 /end MEASUREMENT
/begin MEASUREMENT DRIVE_PRDS_Bnk0Blk16_idx_NV "non volatile index storage for DRIVE recorder blocks" UWORD OneToOne 1 100 0.00 65535.00 FORMAT "%8.2" ARRAY_SIZE 2 ECU_ADDRESS 0x60039352 /end MEASUREMENT
/begin MEASUREMENT DRIVE_PRDS_Bnk0Blk16_Rcrd_NV "DRIVE recorder non volatile record buffer" UBYTE OneToOne 1 100 0.00 255.0 FORMAT "%5.1" ARRAY_SIZE 150 ECU_ADDRESS 0x500142BD /end MEASUREMENT
/begin MEASUREMENT DRIVE_PRDS_Bnk0Blk17_idx_NV "non volatile index storage for DRIVE recorder blocks" UWORD OneToOne 1 100 0.00 65535.00 FORMAT "%8.2" ARRAY_SIZE 2 ECU_ADDRESS 0x6003934E /end MEASUREMENT
/begin MEASUREMENT DRIVE_PRDS_Bnk0Blk17_Rcrd_NV "DRIVE recorder non volatile record buffer" UBYTE OneToOne 1 100 0.00 255.0 FORMAT "%5.1" ARRAY_SIZE 750 ECU_ADDRESS 0x50013FCF /end MEASUREMENT
/begin MEASUREMENT DRIVE_PRDS_Bnk0Blk18_idx_NV "non volatile index storage for DRIVE recorder blocks" UWORD OneToOne 1 100 0.00 65535.00 FORMAT "%8.2" ARRAY_SIZE 2 ECU_ADDRESS 0x6003934A /end MEASUREMENT
/begin MEASUREMENT DRIVE_PRDS_Bnk0Blk18_Rcrd_NV "DRIVE recorder non volatile record buffer" UBYTE OneToOne 1 100 0.00 255.0 FORMAT "%5.1" ARRAY_SIZE 150 ECU_ADDRESS 0x50013F39 /end MEASUREMENT
/begin MEASUREMENT DRIVE_PRDS_Bnk0Blk19_idx_NV "non volatile index storage for DRIVE recorder blocks" UWORD OneToOne 1 100 0.00 65535.00 FORMAT "%8.2" ARRAY_SIZE 2 ECU_ADDRESS 0x60039346 /end MEASUREMENT
/begin MEASUREMENT DRIVE_PRDS_Bnk0Blk19_Rcrd_NV "DRIVE recorder non volatile record buffer" UBYTE OneToOne 1 100 0.00 255.0 FORMAT "%5.1" ARRAY_SIZE 30 ECU_ADDRESS 0x50013F1B /end MEASUREMENT
/begin MEASUREMENT DRIVE_PRDS_Bnk0Blk1a_idx_NV "non volatile index storage for DRIVE recorder blocks" UWORD OneToOne 1 100 0.00 65535.00 FORMAT "%8.2" ARRAY_SIZE 2 ECU_ADDRESS 0x60039342 /end MEASUREMENT
/begin MEASUREMENT DRIVE_PRDS_Bnk0Blk1a_Rcrd_NV "DRIVE recorder non volatile record buffer" UBYTE OneToOne 1 100 0.00 255.0 FORMAT "%5.1" ARRAY_SIZE 1725 ECU_ADDRESS 0x5001385E /end MEASUREMENT
/begin MEASUREMENT DRIVE_PRDS_Bnk0Blk1b_idx_NV "non volatile index storage for DRIVE recorder blocks" UWORD OneToOne 1 100 0.00 65535.00 FORMAT "%8.2" ARRAY_SIZE 2 ECU_ADDRESS 0x6003933E /end MEASUREMENT
/begin MEASUREMENT DRIVE_PRDS_Bnk0Blk1b_Rcrd_NV "DRIVE recorder non volatile record buffer" UBYTE OneToOne 1 100 0.00 255.0 FORMAT "%5.1" ARRAY_SIZE 720 ECU_ADDRESS 0x5001358E /end MEASUREMENT
/begin MEASUREMENT DRIVE_PRDS_Bnk1Blk00_idx "Index storage for DRIVE recorder blocks" UWORD OneToOne 1 100 0.00 65535.00 FORMAT "%8.2" ARRAY_SIZE 2 ECU_ADDRESS 0x60007386 /end MEASUREMENT
/begin MEASUREMENT DRIVE_PRDS_Bnk1Blk00_idx_NV "non volatile index storage for DRIVE recorder blocks" UWORD OneToOne 1 100 0.00 65535.00 FORMAT "%8.2" ARRAY_SIZE 2 ECU_ADDRESS 0x6003933A /end MEASUREMENT
/begin MEASUREMENT DRIVE_PRDS_Bnk1Blk00_Rcrd "Buffer for bank 1 block 0 recording" UBYTE OneToOne 1 100 0.00 255.0 FORMAT "%5.1" ARRAY_SIZE 3500 ECU_ADDRESS 0x6000DA28 /end MEASUREMENT
/begin MEASUREMENT DRIVE_PRDS_Bnk1Blk00_Rcrd_NV "DRIVE recorder non volatile record buffer" UBYTE OneToOne 1 100 0.00 255.0 FORMAT "%5.1" ARRAY_SIZE 3500 ECU_ADDRESS 0x500127E2 /end MEASUREMENT
/begin MEASUREMENT DRIVE_PRDS_Bnk1Blk02_idx "Index storage for DRIVE recorder blocks" UWORD OneToOne 1 100 0.00 65535.00 FORMAT "%8.2" ARRAY_SIZE 2 ECU_ADDRESS 0x60007382 /end MEASUREMENT
/begin MEASUREMENT DRIVE_PRDS_Bnk1Blk02_idx_NV "non volatile index storage for DRIVE recorder blocks" UWORD OneToOne 1 100 0.00 65535.00 FORMAT "%8.2" ARRAY_SIZE 2 ECU_ADDRESS 0x60039336 /end MEASUREMENT
/begin MEASUREMENT DRIVE_PRDS_Bnk1Blk02_Rcrd "DRIVE Recorder Buffer for Engine stall Bank 200 MSec sampling" UBYTE OneToOne 1 100 0.00 255.0 FORMAT "%5.1" ARRAY_SIZE 400 ECU_ADDRESS 0x6000D898 /end MEASUREMENT
/begin MEASUREMENT DRIVE_PRDS_Bnk1Blk02_Rcrd_NV "DRIVE recorder non volatile record buffer" UBYTE OneToOne 1 100 0.00 255.0 FORMAT "%5.1" ARRAY_SIZE 400 ECU_ADDRESS 0x50012652 /end MEASUREMENT
/begin MEASUREMENT DRIVE_PRDS_Bnk1Blk03_idx "Index storage for DRIVE recorder blocks" UWORD OneToOne 1 100 0.00 65535.00 FORMAT "%8.2" ARRAY_SIZE 2 ECU_ADDRESS 0x6000737E /end MEASUREMENT
/begin MEASUREMENT DRIVE_PRDS_Bnk1Blk03_idx_NV "non volatile index storage for DRIVE recorder blocks" UWORD OneToOne 1 100 0.00 65535.00 FORMAT "%8.2" ARRAY_SIZE 2 ECU_ADDRESS 0x60039332 /end MEASUREMENT
/begin MEASUREMENT DRIVE_PRDS_Bnk1Blk03_Rcrd "DRIVE Recorder Buffer for Engine Stall Bank 500 MSec sampling" UBYTE OneToOne 1 100 0.00 255.0 FORMAT "%5.1" ARRAY_SIZE 140 ECU_ADDRESS 0x6000D80C /end MEASUREMENT
/begin MEASUREMENT DRIVE_PRDS_Bnk1Blk03_Rcrd_NV "DRIVE recorder non volatile record buffer" UBYTE OneToOne 1 100 0.00 255.0 FORMAT "%5.1" ARRAY_SIZE 140 ECU_ADDRESS 0x500125C6 /end MEASUREMENT
/begin MEASUREMENT DRIVE_PRDS_Bnk1Blk04_idx "Index storage for DRIVE recorder blocks" UWORD OneToOne 1 100 0.00 65535.00 FORMAT "%8.2" ARRAY_SIZE 2 ECU_ADDRESS 0x6000737A /end MEASUREMENT
/begin MEASUREMENT DRIVE_PRDS_Bnk1Blk04_idx_NV "non volatile index storage for DRIVE recorder blocks" UWORD OneToOne 1 100 0.00 65535.00 FORMAT "%8.2" ARRAY_SIZE 2 ECU_ADDRESS 0x6003932E /end MEASUREMENT
/begin MEASUREMENT DRIVE_PRDS_Bnk1Blk04_Rcrd "Buffer for bank 1 block 4 recording" UBYTE OneToOne 1 100 0.00 255.0 FORMAT "%5.1" ARRAY_SIZE 70 ECU_ADDRESS 0x6000D7C6 /end MEASUREMENT
/begin MEASUREMENT DRIVE_PRDS_Bnk1Blk04_Rcrd_NV "DRIVE recorder non volatile record buffer" UBYTE OneToOne 1 100 0.00 255.0 FORMAT "%5.1" ARRAY_SIZE 70 ECU_ADDRESS 0x50012580 /end MEASUREMENT
/begin MEASUREMENT DRIVE_PRDS_Bnk1Blk05_idx "Index storage for DRIVE recorder blocks" UWORD OneToOne 1 100 0.00 65535.00 FORMAT "%8.2" ARRAY_SIZE 2 ECU_ADDRESS 0x60007376 /end MEASUREMENT
/begin MEASUREMENT DRIVE_PRDS_Bnk1Blk05_idx_NV "non volatile index storage for DRIVE recorder blocks" UWORD OneToOne 1 100 0.00 65535.00 FORMAT "%8.2" ARRAY_SIZE 2 ECU_ADDRESS 0x6003932A /end MEASUREMENT
/begin MEASUREMENT DRIVE_PRDS_Bnk1Blk05_Rcrd "DRIVE Recorder Buffer for Engine Stall Bank single shot" UBYTE OneToOne 1 100 0.00 255.0 FORMAT "%5.1" ARRAY_SIZE 18 ECU_ADDRESS 0x6000D7B4 /end MEASUREMENT
/begin MEASUREMENT DRIVE_PRDS_Bnk1Blk05_Rcrd_NV "DRIVE recorder non volatile record buffer" UBYTE OneToOne 1 100 0.00 255.0 FORMAT "%5.1" ARRAY_SIZE 18 ECU_ADDRESS 0x5001256E /end MEASUREMENT
/begin MEASUREMENT DRIVE_PRDS_Bnk2Blk00_idx "Index storage for DRIVE recorder blocks" UWORD OneToOne 1 100 0.00 65535.00 FORMAT "%8.2" ARRAY_SIZE 2 ECU_ADDRESS 0x60007372 /end MEASUREMENT
/begin MEASUREMENT DRIVE_PRDS_Bnk2Blk00_idx_NV "non volatile index storage for DRIVE recorder blocks" UWORD OneToOne 1 100 0.00 65535.00 FORMAT "%8.2" ARRAY_SIZE 2 ECU_ADDRESS 0x60039326 /end MEASUREMENT
/begin MEASUREMENT DRIVE_PRDS_Bnk2Blk00_Rcrd "Buffer for bank 2 block 0 recording" UBYTE OneToOne 1 100 0.00 255.0 FORMAT "%5.1" ARRAY_SIZE 3500 ECU_ADDRESS 0x6000CA08 /end MEASUREMENT
/begin MEASUREMENT DRIVE_PRDS_Bnk2Blk00_Rcrd_NV "DRIVE recorder non volatile record buffer" UBYTE OneToOne 1 100 0.00 255.0 FORMAT "%5.1" ARRAY_SIZE 3500 ECU_ADDRESS 0x500117C2 /end MEASUREMENT
/begin MEASUREMENT DRIVE_PRDS_Bnk2Blk02_idx "Index storage for DRIVE recorder blocks" UWORD OneToOne 1 100 0.00 65535.00 FORMAT "%8.2" ARRAY_SIZE 2 ECU_ADDRESS 0x6000736E /end MEASUREMENT
/begin MEASUREMENT DRIVE_PRDS_Bnk2Blk02_idx_NV "non volatile index storage for DRIVE recorder blocks" UWORD OneToOne 1 100 0.00 65535.00 FORMAT "%8.2" ARRAY_SIZE 2 ECU_ADDRESS 0x60039322 /end MEASUREMENT
/begin MEASUREMENT DRIVE_PRDS_Bnk2Blk02_Rcrd "Buffer for bank 2 block 2 recording" UBYTE OneToOne 1 100 0.00 255.0 FORMAT "%5.1" ARRAY_SIZE 400 ECU_ADDRESS 0x6000C878 /end MEASUREMENT
/begin MEASUREMENT DRIVE_PRDS_Bnk2Blk02_Rcrd_NV "DRIVE recorder non volatile record buffer" UBYTE OneToOne 1 100 0.00 255.0 FORMAT "%5.1" ARRAY_SIZE 400 ECU_ADDRESS 0x50011632 /end MEASUREMENT
/begin MEASUREMENT DRIVE_PRDS_Bnk2Blk03_idx "Index storage for DRIVE recorder blocks" UWORD OneToOne 1 100 0.00 65535.00 FORMAT "%8.2" ARRAY_SIZE 2 ECU_ADDRESS 0x6000736A /end MEASUREMENT
/begin MEASUREMENT DRIVE_PRDS_Bnk2Blk03_idx_NV "non volatile index storage for DRIVE recorder blocks" UWORD OneToOne 1 100 0.00 65535.00 FORMAT "%8.2" ARRAY_SIZE 2 ECU_ADDRESS 0x6003931E /end MEASUREMENT
/begin MEASUREMENT DRIVE_PRDS_Bnk2Blk03_Rcrd "Buffer for bank 2 block 3 recording" UBYTE OneToOne 1 100 0.00 255.0 FORMAT "%5.1" ARRAY_SIZE 140 ECU_ADDRESS 0x6000C7EC /end MEASUREMENT
/begin MEASUREMENT DRIVE_PRDS_Bnk2Blk03_Rcrd_NV "DRIVE recorder non volatile record buffer" UBYTE OneToOne 1 100 0.00 255.0 FORMAT "%5.1" ARRAY_SIZE 140 ECU_ADDRESS 0x500115A6 /end MEASUREMENT
/begin MEASUREMENT DRIVE_PRDS_Bnk2Blk04_idx "Index storage for DRIVE recorder blocks" UWORD OneToOne 1 100 0.00 65535.00 FORMAT "%8.2" ARRAY_SIZE 2 ECU_ADDRESS 0x60007366 /end MEASUREMENT
/begin MEASUREMENT DRIVE_PRDS_Bnk2Blk04_idx_NV "non volatile index storage for DRIVE recorder blocks" UWORD OneToOne 1 100 0.00 65535.00 FORMAT "%8.2" ARRAY_SIZE 2 ECU_ADDRESS 0x6003931A /end MEASUREMENT
/begin MEASUREMENT DRIVE_PRDS_Bnk2Blk04_Rcrd "Buffer for bank 2 block 4 recording" UBYTE OneToOne 1 100 0.00 255.0 FORMAT "%5.1" ARRAY_SIZE 70 ECU_ADDRESS 0x6000C7A6 /end MEASUREMENT
/begin MEASUREMENT DRIVE_PRDS_Bnk2Blk04_Rcrd_NV "DRIVE recorder non volatile record buffer" UBYTE OneToOne 1 100 0.00 255.0 FORMAT "%5.1" ARRAY_SIZE 70 ECU_ADDRESS 0x50011560 /end MEASUREMENT
/begin MEASUREMENT DRIVE_PRDS_Bnk2Blk05_idx "Index storage for DRIVE recorder blocks" UWORD OneToOne 1 100 0.00 65535.00 FORMAT "%8.2" ARRAY_SIZE 2 ECU_ADDRESS 0x60007362 /end MEASUREMENT
/begin MEASUREMENT DRIVE_PRDS_Bnk2Blk05_idx_NV "non volatile index storage for DRIVE recorder blocks" UWORD OneToOne 1 100 0.00 65535.00 FORMAT "%8.2" ARRAY_SIZE 2 ECU_ADDRESS 0x60039316 /end MEASUREMENT
/begin MEASUREMENT DRIVE_PRDS_Bnk2Blk05_Rcrd "DRIVE Recorder Buffer for BaD Engine start Bank 1000 MSec sampling" UBYTE OneToOne 1 100 0.00 255.0 FORMAT "%5.1" ARRAY_SIZE 18 ECU_ADDRESS 0x6000C794 /end MEASUREMENT
/begin MEASUREMENT DRIVE_PRDS_Bnk2Blk05_Rcrd_NV "DRIVE recorder non volatile record buffer" UBYTE OneToOne 1 100 0.00 255.0 FORMAT "%5.1" ARRAY_SIZE 18 ECU_ADDRESS 0x5001154E /end MEASUREMENT
/begin MEASUREMENT DRIVE_PRDS_Bnk3Blk00_idx "Index storage for DRIVE recorder blocks" UWORD OneToOne 1 100 0.00 65535.00 FORMAT "%8.2" ARRAY_SIZE 2 ECU_ADDRESS 0x6000735E /end MEASUREMENT
/begin MEASUREMENT DRIVE_PRDS_Bnk3Blk00_idx_NV "non volatile index storage for DRIVE recorder blocks" UWORD OneToOne 1 100 0.00 65535.00 FORMAT "%8.2" ARRAY_SIZE 2 ECU_ADDRESS 0x60039312 /end MEASUREMENT
/begin MEASUREMENT DRIVE_PRDS_Bnk3Blk00_Rcrd "Buffer for bank 3 block 0 recording" UBYTE OneToOne 1 100 0.00 255.0 FORMAT "%5.1" ARRAY_SIZE 5400 ECU_ADDRESS 0x6000B27C /end MEASUREMENT
/begin MEASUREMENT DRIVE_PRDS_Bnk3Blk00_Rcrd_NV "DRIVE recorder non volatile record buffer" UBYTE OneToOne 1 100 0.00 255.0 FORMAT "%5.1" ARRAY_SIZE 5400 ECU_ADDRESS 0x50010036 /end MEASUREMENT
/begin MEASUREMENT DRIVE_PRDS_Bnk3Blk00_RecMsk "Record mask for Bank 3 block 0" UBYTE OneToOne 1 100 0.00 255.0 FORMAT "%5.1" ARRAY_SIZE 54 ECU_ADDRESS 0x600392DC /end MEASUREMENT
/begin MEASUREMENT DRIVE_PRDS_Bnk3Blk00_Sig "Trouble shooting parameter array for bank 3 block 0 recording" UWORD Signals_IntSigNumVerb 1 100 0.00 1168.00000000 FORMAT "%13.8" ARRAY_SIZE 54 ECU_ADDRESS 0x60039270 /end MEASUREMENT
/begin MEASUREMENT DRIVE_PRDS_Bnk3Blk01_idx "Index storage for DRIVE recorder blocks" UWORD OneToOne 1 100 0.00 65535.00 FORMAT "%8.2" ARRAY_SIZE 2 ECU_ADDRESS 0x6000735A /end MEASUREMENT
/begin MEASUREMENT DRIVE_PRDS_Bnk3Blk01_idx_NV "non volatile index storage for DRIVE recorder blocks" UWORD OneToOne 1 100 0.00 65535.00 FORMAT "%8.2" ARRAY_SIZE 2 ECU_ADDRESS 0x6003926C /end MEASUREMENT
/begin MEASUREMENT DRIVE_PRDS_Bnk3Blk01_Rcrd "Buffer for bank 3 block 1 recording" UBYTE OneToOne 1 100 0.00 255.0 FORMAT "%5.1" ARRAY_SIZE 54 ECU_ADDRESS 0x6000B246 /end MEASUREMENT
/begin MEASUREMENT DRIVE_PRDS_Bnk3Blk01_Rcrd_NV "DRIVE recorder non volatile record buffer" UBYTE OneToOne 1 100 0.00 255.0 FORMAT "%5.1" ARRAY_SIZE 54 ECU_ADDRESS 0x50010000 /end MEASUREMENT
/begin MEASUREMENT DRIVE_PRDS_Bnk3Blk01_RecMsk "Record mask for Bank 3 block 1" UBYTE OneToOne 1 100 0.00 255.0 FORMAT "%5.1" ARRAY_SIZE 54 ECU_ADDRESS 0x60039236 /end MEASUREMENT
/begin MEASUREMENT DRIVE_PRDS_Bnk3Blk01_Sig "Trouble shooting parameter array for bank 3 block 1 recording" UWORD Signals_IntSigNumVerb 1 100 0.00 1168.00000000 FORMAT "%13.8" ARRAY_SIZE 54 ECU_ADDRESS 0x600391CA /end MEASUREMENT
/begin MEASUREMENT DRIVE_ScndLyrExpRes_raw "Old status of Second Layer expression result of Arbitrary OBS" UBYTE OneToOne 1 100 0.00 255.0 FORMAT "%5.1" ECU_ADDRESS 0x6000B245 /end MEASUREMENT
/begin MEASUREMENT DRIVE_SecondLayerExpMsk "Mask for second layer expression of Arbitrary OBS" UBYTE OneToOne 1 100 0.00 255.0 FORMAT "%5.1" ECU_ADDRESS 0x6000B244 /end MEASUREMENT
/begin MEASUREMENT DRIVE_SecondLayerExpResults "Status of Second Layer expression result of Arbitrary OBS" UBYTE OneToOne 1 100 0.00 255.0 FORMAT "%5.1" ECU_ADDRESS 0x6000B243 /end MEASUREMENT
/begin MEASUREMENT DRIVE_stAOBSTrg "Status of Arbitrary Trigger" UBYTE OneToOne 1 100 0.00 255.0 FORMAT "%5.1" ECU_ADDRESS 0x6000F87B /end MEASUREMENT
/begin MEASUREMENT DRIVE_stArbitraryTrgFrz "Status of trigger mode that caused freeze of drive recorder in Arbitrary OBS bank" UBYTE OneToOne 1 100 0.00 255.0 FORMAT "%5.1" ECU_ADDRESS 0x6000F87A /end MEASUREMENT
/begin MEASUREMENT DRIVE_stArbitraryTrg_mp "Arbitrary trigger measurement point" UBYTE OneToOne 1 100 0.00 255.0 FORMAT "%5.1" ECU_ADDRESS 0x70009FCB /end MEASUREMENT
/begin MEASUREMENT DRIVE_stBadEngStrt "Bad engine start detected flag" UBYTE OneToOne 1 100 0.00 255.0 FORMAT "%5.1" ECU_ADDRESS 0x6000F879 /end MEASUREMENT
/begin MEASUREMENT DRIVE_stBadStrtTrgFrz "Status of trigger mode that caused freeye of drive recorder in bad start bank" UBYTE OneToOne 1 100 0.00 255.0 FORMAT "%5.1" ECU_ADDRESS 0x6000F878 /end MEASUREMENT
/begin MEASUREMENT DRIVE_stCrLon "Cranking too long status" UBYTE OneToOne 1 100 0.00 255.0 FORMAT "%5.1" ECU_ADDRESS 0x6000F877 /end MEASUREMENT
/begin MEASUREMENT DRIVE_stCurTrgMode "Current trigger mode for drive recorder data" UBYTE DRIVE_PRDS_TRGMODETYPE 1 100 0.00 2.00000000000 FORMAT "%13.11" ECU_ADDRESS 0x6000F876 /end MEASUREMENT
/begin MEASUREMENT DRIVE_stEngNStrt "Cranking too long then engine not started status" UBYTE OneToOne 1 100 0.00 255.0 FORMAT "%5.1" ECU_ADDRESS 0x6000F875 /end MEASUREMENT
/begin MEASUREMENT DRIVE_stEngStalTrgFrz "Status of trigger mode that caused freeye of drive recorder in engine stall bank" UBYTE OneToOne 1 100 0.00 255.0 FORMAT "%5.1" ECU_ADDRESS 0x6000F874 /end MEASUREMENT
/begin MEASUREMENT DRIVE_stEngStalTrg_mp "Engine Stall trigger measurement point" UBYTE OneToOne 1 100 0.00 255.0 FORMAT "%5.1" ECU_ADDRESS 0x70009FCA /end MEASUREMENT
/begin MEASUREMENT DRIVE_stEngStrt "Engine started successfully flag" UBYTE OneToOne 1 100 0.00 255.0 FORMAT "%5.1" ECU_ADDRESS 0x600391C9 /end MEASUREMENT
/begin MEASUREMENT DRIVE_stHardToStrt "Status of trigger hard to start" UBYTE OneToOne 1 100 0.00 255.0 FORMAT "%5.1" ECU_ADDRESS 0x6000F873 /end MEASUREMENT
/begin MEASUREMENT DRIVE_stRingBuf_Arbitrary_mp "Status of Ring Buffer for Arbitrary OBS" UBYTE DRIVE_PRDS_BUFSTATTYPE 1 100 0.00 2.00000000000 FORMAT "%13.11" ECU_ADDRESS 0x70009FC9 /end MEASUREMENT
/begin MEASUREMENT DRIVE_stRingBuf_BadEngStrt_mp "Measurement point of the measurement buffer state." UBYTE DRIVE_PRDS_BUFSTATTYPE 1 100 0.00 2.00000000000 FORMAT "%13.11" ECU_ADDRESS 0x70009FC8 /end MEASUREMENT
/begin MEASUREMENT DRIVE_stRingBuf_EngStal_mp "Measurement point of the measurement buffer state." UBYTE DRIVE_PRDS_BUFSTATTYPE 1 100 0.00 2.00000000000 FORMAT "%13.11" ECU_ADDRESS 0x70009FC7 /end MEASUREMENT
/begin MEASUREMENT DRIVE_stRingBuf_mp "Status of the ring buffer for Drive recorder" UBYTE DRIVE_PRDS_BUFSTATTYPE 1 100 0.00 2.00000000000 FORMAT "%13.11" ECU_ADDRESS 0x70009FC6 /end MEASUREMENT
/begin MEASUREMENT DRIVE_stStalAftEngStrt "Engine stall just after engine started flag" UBYTE OneToOne 1 100 0.00 255.0 FORMAT "%5.1" ECU_ADDRESS 0x6000F872 /end MEASUREMENT
/begin MEASUREMENT DRIVE_stStalAftEngStrt_mp "Engine stall just after engine started measurement point" UBYTE OneToOne 1 100 0.00 255.0 FORMAT "%5.1" ECU_ADDRESS 0x70009FC5 /end MEASUREMENT
/begin MEASUREMENT DRIVE_stStore_Arbitrary_mp "Status of store for Arbitrary OBS" UBYTE DRIVE_PRDS_CLEARSTORETYPE 1 100 0.00 2.00000000000 FORMAT "%13.11" ECU_ADDRESS 0x70009FC4 /end MEASUREMENT
/begin MEASUREMENT DRIVE_stStore_BadEngStrt_mp "Measurement point of the buffer store state." UBYTE DRIVE_PRDS_CLEARSTORETYPE 1 100 0.00 2.00000000000 FORMAT "%13.11" ECU_ADDRESS 0x70009FC3 /end MEASUREMENT
/begin MEASUREMENT DRIVE_stStore_EngStal_mp "Measurement point of the buffer store state." UBYTE DRIVE_PRDS_CLEARSTORETYPE 1 100 0.00 2.00000000000 FORMAT "%13.11" ECU_ADDRESS 0x70009FC2 /end MEASUREMENT
/begin MEASUREMENT DRIVE_stStore_mp "Status of the ring buffer storage for Drive recorder" UBYTE DRIVE_PRDS_CLEARSTORETYPE 1 100 0.00 2.00000000000 FORMAT "%13.11" ECU_ADDRESS 0x70009FC1 /end MEASUREMENT
/begin MEASUREMENT DRIVE_stTimeLapse "status of time lapse of Arbitrary OBS" UBYTE OneToOne 1 100 0.00 255.0 FORMAT "%5.1" ARRAY_SIZE 20 ECU_ADDRESS 0x6000B22F /end MEASUREMENT
/begin MEASUREMENT DRIVE_stTrgSigFrz "Status of trigger mode that caused freeye of drive recorder in DTC trigger bank" UBYTE OneToOne 1 100 0.00 255.0 FORMAT "%5.1" ECU_ADDRESS 0x6000F871 /end MEASUREMENT
/begin MEASUREMENT DRIVE_ThirdLayerExpResults "Status of Third Layer expression result of Arbitrary OBS" UWORD OneToOne 1 100 0.00 65535.00 FORMAT "%8.2" ECU_ADDRESS 0x60007358 /end MEASUREMENT
/begin MEASUREMENT DRIVE_ThirdLayerExpResults_old "Bit coded results of third layer expressions in previous raster" UWORD OneToOne 1 100 0.00 65535.00 FORMAT "%8.2" ECU_ADDRESS 0x60007356 /end MEASUREMENT
/begin MEASUREMENT DRIVE_ThrdLyrCntrRes_raw "Old status of Third layer counter expression results" ULONG OneToOne 1 100 0.00 4294967295.00 FORMAT "%13.2" ECU_ADDRESS 0x60002F68 /end MEASUREMENT
/begin MEASUREMENT DRIVE_TriggerSignal "Current trigger signal for DTC bank" ULONG DRIVE_PRDS_TRIGGERCODETYPE 1 100 69649.00000 1044735.00000 FORMAT "%13.5" ECU_ADDRESS 0x60003A90 /end MEASUREMENT
/begin MEASUREMENT DRIVE_TriggerSignal_Arbitrary "Current trigger signal for Arbitrary OBS bank" ULONG DRIVE_PRDS_TRIGGERCODETYPE 1 100 69649.00000 1044735.00000 FORMAT "%13.5" ECU_ADDRESS 0x60003A8C /end MEASUREMENT
/begin MEASUREMENT DRIVE_TriggerSignal_BadEngStrt "Current trigger signal for bad engine start bank" ULONG DRIVE_PRDS_TRIGGERCODETYPE 1 100 69649.00000 1044735.00000 FORMAT "%13.5" ECU_ADDRESS 0x60003A88 /end MEASUREMENT
/begin MEASUREMENT DRIVE_TriggerSignal_EngStal "Current trigger signal for engine stall bank" ULONG DRIVE_PRDS_TRIGGERCODETYPE 1 100 69649.00000 1044735.00000 FORMAT "%13.5" ECU_ADDRESS 0x60003A84 /end MEASUREMENT
/begin MEASUREMENT DSCHED_DynPrio.FId_Unused "dynamic priority / " SWORD DFC_OneToOne 1 100 -32768.00 32767.00 FORMAT "%8.2" ECU_ADDRESS 0x50005A08 /end MEASUREMENT
/begin MEASUREMENT DSCHED_DynPrio.FID_AFRA "dynamic priority / Dynamic priority of scheduled function identifier FID_AFRA" SWORD DFC_OneToOne 1 100 -32768.00 32767.00 FORMAT "%8.2" ECU_ADDRESS 0x50005A0A /end MEASUREMENT
/begin MEASUREMENT DSCHED_DynPrio.FID_AORA "dynamic priority / Dynamic priority of scheduled function identifier FID_AORA" SWORD DFC_OneToOne 1 100 -32768.00 32767.00 FORMAT "%8.2" ECU_ADDRESS 0x50005A0C /end MEASUREMENT
/begin MEASUREMENT DSCHED_DynPrio.FID_ATEH "dynamic priority / Dynamic priority of scheduled function identifier FID_ATEH" SWORD DFC_OneToOne 1 100 -32768.00 32767.00 FORMAT "%8.2" ECU_ADDRESS 0x50005A0E /end MEASUREMENT
/begin MEASUREMENT DSCHED_DynPrio.FID_ATEL "dynamic priority / Dynamic priority of scheduled function identifier FID_ATEL" SWORD DFC_OneToOne 1 100 -32768.00 32767.00 FORMAT "%8.2" ECU_ADDRESS 0x50005A10 /end MEASUREMENT
/begin MEASUREMENT DSCHED_DynPrio.FID_ATEN "dynamic priority / Dynamic priority of scheduled function identifier FID_ATEN" SWORD DFC_OneToOne 1 100 -32768.00 32767.00 FORMAT "%8.2" ECU_ADDRESS 0x50005A12 /end MEASUREMENT
/begin MEASUREMENT DSCHED_DynPrio.FID_ATLDI "dynamic priority / Dynamic priority of scheduled function identifier FID_ATLDI" SWORD DFC_OneToOne 1 100 -32768.00 32767.00 FORMAT "%8.2" ECU_ADDRESS 0x50005A14 /end MEASUREMENT
/begin MEASUREMENT DSCHED_DynPrio.FID_ATLDO "dynamic priority / Dynamic priority of scheduled function identifier FID_ATLDO" SWORD DFC_OneToOne 1 100 -32768.00 32767.00 FORMAT "%8.2" ECU_ADDRESS 0x50005A16 /end MEASUREMENT
/begin MEASUREMENT DSCHED_DynPrio.FID_BEONV "dynamic priority / Dynamic priority of scheduled function identifier FID_BEONV" SWORD DFC_OneToOne 1 100 -32768.00 32767.00 FORMAT "%8.2" ECU_ADDRESS 0x50005A18 /end MEASUREMENT
/begin MEASUREMENT DSCHED_DynPrio.FId_EGSDCmnSeg1B1Parl "dynamic priority / Dynamic priority of scheduled function identifier FId_EGSDCmnSeg1B1Parl" SWORD DFC_OneToOne 1 100 -32768.00 32767.00 FORMAT "%8.2" ECU_ADDRESS 0x50005A1A /end MEASUREMENT
/begin MEASUREMENT DSCHED_DynPrio.FID_BAGRA "dynamic priority / Dynamic priority of scheduled function identifier FID_BAGRA" SWORD DFC_OneToOne 1 100 -32768.00 32767.00 FORMAT "%8.2" ECU_ADDRESS 0x50005A1C /end MEASUREMENT
/begin MEASUREMENT DSCHED_DynPrio.FID_BAGRASD "dynamic priority / Dynamic priority of scheduled function identifier FID_BAGRASD" SWORD DFC_OneToOne 1 100 -32768.00 32767.00 FORMAT "%8.2" ECU_ADDRESS 0x50005A1E /end MEASUREMENT
/begin MEASUREMENT DSCHED_DynPrio.FID_BDSTOF "dynamic priority / Dynamic priority of scheduled function identifier FID_BDSTOF" SWORD DFC_OneToOne 1 100 -32768.00 32767.00 FORMAT "%8.2" ECU_ADDRESS 0x50005A20 /end MEASUREMENT
/begin MEASUREMENT DSCHED_DynPrio.FID_BFVDFRM "dynamic priority / Dynamic priority of scheduled function identifier FID_BFVDFRM" SWORD DFC_OneToOne 1 100 -32768.00 32767.00 FORMAT "%8.2" ECU_ADDRESS 0x50005A22 /end MEASUREMENT
/begin MEASUREMENT DSCHED_DynPrio.FID_BHOM "dynamic priority / Dynamic priority of scheduled function identifier FID_BHOM" SWORD DFC_OneToOne 1 100 -32768.00 32767.00 FORMAT "%8.2" ECU_ADDRESS 0x50005A24 /end MEASUREMENT
/begin MEASUREMENT DSCHED_DynPrio.FID_BLLRH "dynamic priority / Dynamic priority of scheduled function identifier FID_BLLRH" SWORD DFC_OneToOne 1 100 -32768.00 32767.00 FORMAT "%8.2" ECU_ADDRESS 0x50005A26 /end MEASUREMENT
/begin MEASUREMENT DSCHED_DynPrio.FID_BLLRKH "dynamic priority / Dynamic priority of scheduled function identifier FID_BLLRKH" SWORD DFC_OneToOne 1 100 -32768.00 32767.00 FORMAT "%8.2" ECU_ADDRESS 0x50005A28 /end MEASUREMENT
/begin MEASUREMENT DSCHED_DynPrio.FID_BPLSU "dynamic priority / Dynamic priority of scheduled function identifier FID_BPLSU" SWORD DFC_OneToOne 1 100 -32768.00 32767.00 FORMAT "%8.2" ECU_ADDRESS 0x50005A2A /end MEASUREMENT
/begin MEASUREMENT DSCHED_DynPrio.FID_FRAMBAVMB "dynamic priority / Dynamic priority of scheduled function identifier FID_FRAMBAVMB" SWORD DFC_OneToOne 1 100 -32768.00 32767.00 FORMAT "%8.2" ECU_ADDRESS 0x50005A2C /end MEASUREMENT
/begin MEASUREMENT DSCHED_DynPrio.FId_CatHeatgColdStrtReq "dynamic priority / Dynamic priority of scheduled function identifier FId_CatHeatgColdStrtReq" SWORD DFC_OneToOne 1 100 -32768.00 32767.00 FORMAT "%8.2" ECU_ADDRESS 0x50005A2E /end MEASUREMENT
/begin MEASUREMENT DSCHED_DynPrio.FId_CatHeatgWrmReq "dynamic priority / Dynamic priority of scheduled function identifier FId_CatHeatgWrmReq" SWORD DFC_OneToOne 1 100 -32768.00 32767.00 FORMAT "%8.2" ECU_ADDRESS 0x50005A30 /end MEASUREMENT
/begin MEASUREMENT DSCHED_DynPrio.FId_DSMBDEPHSpOpMode "dynamic priority / Dynamic priority of scheduled function identifier FId_DSMBDEPHSpOpMode" SWORD DFC_OneToOne 1 100 -32768.00 32767.00 FORMAT "%8.2" ECU_ADDRESS 0x50005A32 /end MEASUREMENT
/begin MEASUREMENT DSCHED_DynPrio.FId_EGRVlvCoord "dynamic priority / Dynamic priority of scheduled function identifier FId_EGRVlvCoord" SWORD DFC_OneToOne 1 100 -32768.00 32767.00 FORMAT "%8.2" ECU_ADDRESS 0x50005A34 /end MEASUREMENT
/begin MEASUREMENT DSCHED_DynPrio.FId_EGSDO2FuTrmB1 "dynamic priority / Dynamic priority of scheduled function identifier FId_EGSDO2FuTrmB1" SWORD DFC_OneToOne 1 100 -32768.00 32767.00 FORMAT "%8.2" ECU_ADDRESS 0x50005A36 /end MEASUREMENT
/begin MEASUREMENT DSCHED_DynPrio.FId_EGSDO2SnsrMntdRelsS1B1 "dynamic priority / Dynamic priority of scheduled function identifier FId_EGSDO2SnsrMntdRelsS1B1" SWORD DFC_OneToOne 1 100 -32768.00 32767.00 FORMAT "%8.2" ECU_ADDRESS 0x50005A38 /end MEASUREMENT
/begin MEASUREMENT DSCHED_DynPrio.FId_EGSDO2_LamOffsFastS1B1 "dynamic priority / Dynamic priority of scheduled function identifier FId_EGSDO2_LamOffsFastS1B1" SWORD DFC_OneToOne 1 100 -32768.00 32767.00 FORMAT "%8.2" ECU_ADDRESS 0x50005A3A /end MEASUREMENT
/begin MEASUREMENT DSCHED_DynPrio.FId_MisfDetDnAdpnNv "dynamic priority / Dynamic priority of scheduled function identifier FId_MisfDetDnAdpnNv" SWORD DFC_OneToOne 1 100 -32768.00 32767.00 FORMAT "%8.2" ECU_ADDRESS 0x50005A3C /end MEASUREMENT
/begin MEASUREMENT DSCHED_DynPrio.FId_bascadpncvo "dynamic priority / Dynamic priority of scheduled function identifier FId_bascadpncvo" SWORD DFC_OneToOne 1 100 -32768.00 32767.00 FORMAT "%8.2" ECU_ADDRESS 0x50005A3E /end MEASUREMENT
/begin MEASUREMENT DSCHED_PhysPrio.FId_Unused "physical priority / " UBYTE DFC_OneToOne 1 100 0.00 255.0 FORMAT "%5.1" ECU_ADDRESS 0x6001016C /end MEASUREMENT
/begin MEASUREMENT DSCHED_PhysPrio.FID_AFRA "physical priority / Physical priority of scheduled function identifier FID_AFRA" UBYTE DFC_OneToOne 1 100 0.00 255.0 FORMAT "%5.1" ECU_ADDRESS 0x6001016D /end MEASUREMENT
/begin MEASUREMENT DSCHED_PhysPrio.FID_AORA "physical priority / Physical priority of scheduled function identifier FID_AORA" UBYTE DFC_OneToOne 1 100 0.00 255.0 FORMAT "%5.1" ECU_ADDRESS 0x6001016E /end MEASUREMENT
/begin MEASUREMENT DSCHED_PhysPrio.FID_ATEH "physical priority / Physical priority of scheduled function identifier FID_ATEH" UBYTE DFC_OneToOne 1 100 0.00 255.0 FORMAT "%5.1" ECU_ADDRESS 0x6001016F /end MEASUREMENT
/begin MEASUREMENT DSCHED_PhysPrio.FID_ATEL "physical priority / Physical priority of scheduled function identifier FID_ATEL" UBYTE DFC_OneToOne 1 100 0.00 255.0 FORMAT "%5.1" ECU_ADDRESS 0x60010170 /end MEASUREMENT
/begin MEASUREMENT DSCHED_PhysPrio.FID_ATEN "physical priority / Physical priority of scheduled function identifier FID_ATEN" UBYTE DFC_OneToOne 1 100 0.00 255.0 FORMAT "%5.1" ECU_ADDRESS 0x60010171 /end MEASUREMENT
/begin MEASUREMENT DSCHED_PhysPrio.FID_ATLDI "physical priority / Physical priority of scheduled function identifier FID_ATLDI" UBYTE DFC_OneToOne 1 100 0.00 255.0 FORMAT "%5.1" ECU_ADDRESS 0x60010172 /end MEASUREMENT
/begin MEASUREMENT DSCHED_PhysPrio.FID_ATLDO "physical priority / Physical priority of scheduled function identifier FID_ATLDO" UBYTE DFC_OneToOne 1 100 0.00 255.0 FORMAT "%5.1" ECU_ADDRESS 0x60010173 /end MEASUREMENT
/begin MEASUREMENT DSCHED_PhysPrio.FID_BEONV "physical priority / Physical priority of scheduled function identifier FID_BEONV" UBYTE DFC_OneToOne 1 100 0.00 255.0 FORMAT "%5.1" ECU_ADDRESS 0x60010174 /end MEASUREMENT
/begin MEASUREMENT DSCHED_PhysPrio.FId_EGSDCmnSeg1B1Parl "physical priority / Physical priority of scheduled function identifier FId_EGSDCmnSeg1B1Parl" UBYTE DFC_OneToOne 1 100 0.00 255.0 FORMAT "%5.1" ECU_ADDRESS 0x60010175 /end MEASUREMENT
/begin MEASUREMENT DSCHED_PhysPrio.FID_BAGRA "physical priority / Physical priority of scheduled function identifier FID_BAGRA" UBYTE DFC_OneToOne 1 100 0.00 255.0 FORMAT "%5.1" ECU_ADDRESS 0x60010176 /end MEASUREMENT
/begin MEASUREMENT DSCHED_PhysPrio.FID_BAGRASD "physical priority / Physical priority of scheduled function identifier FID_BAGRASD" UBYTE DFC_OneToOne 1 100 0.00 255.0 FORMAT "%5.1" ECU_ADDRESS 0x60010177 /end MEASUREMENT
/begin MEASUREMENT DSCHED_PhysPrio.FID_BDSTOF "physical priority / Physical priority of scheduled function identifier FID_BDSTOF" UBYTE DFC_OneToOne 1 100 0.00 255.0 FORMAT "%5.1" ECU_ADDRESS 0x60010178 /end MEASUREMENT
/begin MEASUREMENT DSCHED_PhysPrio.FID_BFVDFRM "physical priority / Physical priority of scheduled function identifier FID_BFVDFRM" UBYTE DFC_OneToOne 1 100 0.00 255.0 FORMAT "%5.1" ECU_ADDRESS 0x60010179 /end MEASUREMENT
/begin MEASUREMENT DSCHED_PhysPrio.FID_BHOM "physical priority / Physical priority of scheduled function identifier FID_BHOM" UBYTE DFC_OneToOne 1 100 0.00 255.0 FORMAT "%5.1" ECU_ADDRESS 0x6001017A /end MEASUREMENT
/begin MEASUREMENT DSCHED_PhysPrio.FID_BLLRH "physical priority / Physical priority of scheduled function identifier FID_BLLRH" UBYTE DFC_OneToOne 1 100 0.00 255.0 FORMAT "%5.1" ECU_ADDRESS 0x6001017B /end MEASUREMENT
/begin MEASUREMENT DSCHED_PhysPrio.FID_BLLRKH "physical priority / Physical priority of scheduled function identifier FID_BLLRKH" UBYTE DFC_OneToOne 1 100 0.00 255.0 FORMAT "%5.1" ECU_ADDRESS 0x6001017C /end MEASUREMENT
/begin MEASUREMENT DSCHED_PhysPrio.FID_BPLSU "physical priority / Physical priority of scheduled function identifier FID_BPLSU" UBYTE DFC_OneToOne 1 100 0.00 255.0 FORMAT "%5.1" ECU_ADDRESS 0x6001017D /end MEASUREMENT
/begin MEASUREMENT DSCHED_PhysPrio.FID_FRAMBAVMB "physical priority / Physical priority of scheduled function identifier FID_FRAMBAVMB" UBYTE DFC_OneToOne 1 100 0.00 255.0 FORMAT "%5.1" ECU_ADDRESS 0x6001017E /end MEASUREMENT
/begin MEASUREMENT DSCHED_PhysPrio.FId_CatHeatgColdStrtReq "physical priority / Physical priority of scheduled function identifier FId_CatHeatgColdStrtReq" UBYTE DFC_OneToOne 1 100 0.00 255.0 FORMAT "%5.1" ECU_ADDRESS 0x6001017F /end MEASUREMENT
/begin MEASUREMENT DSCHED_PhysPrio.FId_CatHeatgWrmReq "physical priority / Physical priority of scheduled function identifier FId_CatHeatgWrmReq" UBYTE DFC_OneToOne 1 100 0.00 255.0 FORMAT "%5.1" ECU_ADDRESS 0x60010180 /end MEASUREMENT
/begin MEASUREMENT DSCHED_PhysPrio.FId_DSMBDEPHSpOpMode "physical priority / Physical priority of scheduled function identifier FId_DSMBDEPHSpOpMode" UBYTE DFC_OneToOne 1 100 0.00 255.0 FORMAT "%5.1" ECU_ADDRESS 0x60010181 /end MEASUREMENT
/begin MEASUREMENT DSCHED_PhysPrio.FId_EGRVlvCoord "physical priority / Physical priority of scheduled function identifier FId_EGRVlvCoord" UBYTE DFC_OneToOne 1 100 0.00 255.0 FORMAT "%5.1" ECU_ADDRESS 0x60010182 /end MEASUREMENT
/begin MEASUREMENT DSCHED_PhysPrio.FId_EGSDO2FuTrmB1 "physical priority / Physical priority of scheduled function identifier FId_EGSDO2FuTrmB1" UBYTE DFC_OneToOne 1 100 0.00 255.0 FORMAT "%5.1" ECU_ADDRESS 0x60010183 /end MEASUREMENT
/begin MEASUREMENT DSCHED_PhysPrio.FId_EGSDO2SnsrMntdRelsS1B1 "physical priority / Physical priority of scheduled function identifier FId_EGSDO2SnsrMntdRelsS1B1" UBYTE DFC_OneToOne 1 100 0.00 255.0 FORMAT "%5.1" ECU_ADDRESS 0x60010184 /end MEASUREMENT
/begin MEASUREMENT DSCHED_PhysPrio.FId_EGSDO2_LamOffsFastS1B1 "physical priority / Physical priority of scheduled function identifier FId_EGSDO2_LamOffsFastS1B1" UBYTE DFC_OneToOne 1 100 0.00 255.0 FORMAT "%5.1" ECU_ADDRESS 0x60010185 /end MEASUREMENT
/begin MEASUREMENT DSCHED_PhysPrio.FId_MisfDetDnAdpnNv "physical priority / Physical priority of scheduled function identifier FId_MisfDetDnAdpnNv" UBYTE DFC_OneToOne 1 100 0.00 255.0 FORMAT "%5.1" ECU_ADDRESS 0x60010186 /end MEASUREMENT
/begin MEASUREMENT DSCHED_PhysPrio.FId_bascadpncvo "physical priority / Physical priority of scheduled function identifier FId_bascadpncvo" UBYTE DFC_OneToOne 1 100 0.00 255.0 FORMAT "%5.1" ECU_ADDRESS 0x60010187 /end MEASUREMENT
/begin MEASUREMENT DSCHED_VirtDynPrio.FId_Unused "virtual dynamic priority / " SWORD DFC_OneToOne 1 100 -32768.00 32767.00 FORMAT "%8.2" ECU_ADDRESS 0x6000977E /end MEASUREMENT
/begin MEASUREMENT DSCHED_VirtDynPrio.FID_AFRA "virtual dynamic priority / Virtual dynamic priority of scheduled function identifier FID_AFRA" SWORD DFC_OneToOne 1 100 -32768.00 32767.00 FORMAT "%8.2" ECU_ADDRESS 0x60009780 /end MEASUREMENT
/begin MEASUREMENT DSCHED_VirtDynPrio.FID_AORA "virtual dynamic priority / Virtual dynamic priority of scheduled function identifier FID_AORA" SWORD DFC_OneToOne 1 100 -32768.00 32767.00 FORMAT "%8.2" ECU_ADDRESS 0x60009782 /end MEASUREMENT
/begin MEASUREMENT DSCHED_VirtDynPrio.FID_ATEH "virtual dynamic priority / Virtual dynamic priority of scheduled function identifier FID_ATEH" SWORD DFC_OneToOne 1 100 -32768.00 32767.00 FORMAT "%8.2" ECU_ADDRESS 0x60009784 /end MEASUREMENT
/begin MEASUREMENT DSCHED_VirtDynPrio.FID_ATEL "virtual dynamic priority / Virtual dynamic priority of scheduled function identifier FID_ATEL" SWORD DFC_OneToOne 1 100 -32768.00 32767.00 FORMAT "%8.2" ECU_ADDRESS 0x60009786 /end MEASUREMENT
/begin MEASUREMENT DSCHED_VirtDynPrio.FID_ATEN "virtual dynamic priority / Virtual dynamic priority of scheduled function identifier FID_ATEN" SWORD DFC_OneToOne 1 100 -32768.00 32767.00 FORMAT "%8.2" ECU_ADDRESS 0x60009788 /end MEASUREMENT
/begin MEASUREMENT DSCHED_VirtDynPrio.FID_ATLDI "virtual dynamic priority / Virtual dynamic priority of scheduled function identifier FID_ATLDI" SWORD DFC_OneToOne 1 100 -32768.00 32767.00 FORMAT "%8.2" ECU_ADDRESS 0x6000978A /end MEASUREMENT
/begin MEASUREMENT DSCHED_VirtDynPrio.FID_ATLDO "virtual dynamic priority / Virtual dynamic priority of scheduled function identifier FID_ATLDO" SWORD DFC_OneToOne 1 100 -32768.00 32767.00 FORMAT "%8.2" ECU_ADDRESS 0x6000978C /end MEASUREMENT
/begin MEASUREMENT DSCHED_VirtDynPrio.FID_BEONV "virtual dynamic priority / Virtual dynamic priority of scheduled function identifier FID_BEONV" SWORD DFC_OneToOne 1 100 -32768.00 32767.00 FORMAT "%8.2" ECU_ADDRESS 0x6000978E /end MEASUREMENT
/begin MEASUREMENT DSCHED_VirtDynPrio.FId_EGSDCmnSeg1B1Parl "virtual dynamic priority / Virtual dynamic priority of scheduled function identifier FId_EGSDCmnSeg1B1Parl" SWORD DFC_OneToOne 1 100 -32768.00 32767.00 FORMAT "%8.2" ECU_ADDRESS 0x60009790 /end MEASUREMENT
/begin MEASUREMENT DSCHED_VirtDynPrio.FID_BAGRA "virtual dynamic priority / Virtual dynamic priority of scheduled function identifier FID_BAGRA" SWORD DFC_OneToOne 1 100 -32768.00 32767.00 FORMAT "%8.2" ECU_ADDRESS 0x60009792 /end MEASUREMENT
/begin MEASUREMENT DSCHED_VirtDynPrio.FID_BAGRASD "virtual dynamic priority / Virtual dynamic priority of scheduled function identifier FID_BAGRASD" SWORD DFC_OneToOne 1 100 -32768.00 32767.00 FORMAT "%8.2" ECU_ADDRESS 0x60009794 /end MEASUREMENT
/begin MEASUREMENT DSCHED_VirtDynPrio.FID_BDSTOF "virtual dynamic priority / Virtual dynamic priority of scheduled function identifier FID_BDSTOF" SWORD DFC_OneToOne 1 100 -32768.00 32767.00 FORMAT "%8.2" ECU_ADDRESS 0x60009796 /end MEASUREMENT
/begin MEASUREMENT DSCHED_VirtDynPrio.FID_BFVDFRM "virtual dynamic priority / Virtual dynamic priority of scheduled function identifier FID_BFVDFRM" SWORD DFC_OneToOne 1 100 -32768.00 32767.00 FORMAT "%8.2" ECU_ADDRESS 0x60009798 /end MEASUREMENT
/begin MEASUREMENT DSCHED_VirtDynPrio.FID_BHOM "virtual dynamic priority / Virtual dynamic priority of scheduled function identifier FID_BHOM" SWORD DFC_OneToOne 1 100 -32768.00 32767.00 FORMAT "%8.2" ECU_ADDRESS 0x6000979A /end MEASUREMENT
/begin MEASUREMENT DSCHED_VirtDynPrio.FID_BLLRH "virtual dynamic priority / Virtual dynamic priority of scheduled function identifier FID_BLLRH" SWORD DFC_OneToOne 1 100 -32768.00 32767.00 FORMAT "%8.2" ECU_ADDRESS 0x6000979C /end MEASUREMENT
/begin MEASUREMENT DSCHED_VirtDynPrio.FID_BLLRKH "virtual dynamic priority / Virtual dynamic priority of scheduled function identifier FID_BLLRKH" SWORD DFC_OneToOne 1 100 -32768.00 32767.00 FORMAT "%8.2" ECU_ADDRESS 0x6000979E /end MEASUREMENT
/begin MEASUREMENT DSCHED_VirtDynPrio.FID_BPLSU "virtual dynamic priority / Virtual dynamic priority of scheduled function identifier FID_BPLSU" SWORD DFC_OneToOne 1 100 -32768.00 32767.00 FORMAT "%8.2" ECU_ADDRESS 0x600097A0 /end MEASUREMENT
/begin MEASUREMENT DSCHED_VirtDynPrio.FID_FRAMBAVMB "virtual dynamic priority / Virtual dynamic priority of scheduled function identifier FID_FRAMBAVMB" SWORD DFC_OneToOne 1 100 -32768.00 32767.00 FORMAT "%8.2" ECU_ADDRESS 0x600097A2 /end MEASUREMENT
/begin MEASUREMENT DSCHED_VirtDynPrio.FId_CatHeatgColdStrtReq "virtual dynamic priority / Virtual dynamic priority of scheduled function identifier FId_CatHeatgColdStrtReq" SWORD DFC_OneToOne 1 100 -32768.00 32767.00 FORMAT "%8.2" ECU_ADDRESS 0x600097A4 /end MEASUREMENT
/begin MEASUREMENT DSCHED_VirtDynPrio.FId_CatHeatgWrmReq "virtual dynamic priority / Virtual dynamic priority of scheduled function identifier FId_CatHeatgWrmReq" SWORD DFC_OneToOne 1 100 -32768.00 32767.00 FORMAT "%8.2" ECU_ADDRESS 0x600097A6 /end MEASUREMENT
/begin MEASUREMENT DSCHED_VirtDynPrio.FId_DSMBDEPHSpOpMode "virtual dynamic priority / Virtual dynamic priority of scheduled function identifier FId_DSMBDEPHSpOpMode" SWORD DFC_OneToOne 1 100 -32768.00 32767.00 FORMAT "%8.2" ECU_ADDRESS 0x600097A8 /end MEASUREMENT
/begin MEASUREMENT DSCHED_VirtDynPrio.FId_EGRVlvCoord "virtual dynamic priority / Virtual dynamic priority of scheduled function identifier FId_EGRVlvCoord" SWORD DFC_OneToOne 1 100 -32768.00 32767.00 FORMAT "%8.2" ECU_ADDRESS 0x600097AA /end MEASUREMENT
/begin MEASUREMENT DSCHED_VirtDynPrio.FId_EGSDO2FuTrmB1 "virtual dynamic priority / Virtual dynamic priority of scheduled function identifier FId_EGSDO2FuTrmB1" SWORD DFC_OneToOne 1 100 -32768.00 32767.00 FORMAT "%8.2" ECU_ADDRESS 0x600097AC /end MEASUREMENT
/begin MEASUREMENT DSCHED_VirtDynPrio.FId_EGSDO2SnsrMntdRelsS1B1 "virtual dynamic priority / Virtual dynamic priority of scheduled function identifier FId_EGSDO2SnsrMntdRelsS1B1" SWORD DFC_OneToOne 1 100 -32768.00 32767.00 FORMAT "%8.2" ECU_ADDRESS 0x600097AE /end MEASUREMENT
/begin MEASUREMENT DSCHED_VirtDynPrio.FId_EGSDO2_LamOffsFastS1B1 "virtual dynamic priority / Virtual dynamic priority of scheduled function identifier FId_EGSDO2_LamOffsFastS1B1" SWORD DFC_OneToOne 1 100 -32768.00 32767.00 FORMAT "%8.2" ECU_ADDRESS 0x600097B0 /end MEASUREMENT
/begin MEASUREMENT DSCHED_VirtDynPrio.FId_MisfDetDnAdpnNv "virtual dynamic priority / Virtual dynamic priority of scheduled function identifier FId_MisfDetDnAdpnNv" SWORD DFC_OneToOne 1 100 -32768.00 32767.00 FORMAT "%8.2" ECU_ADDRESS 0x600097B2 /end MEASUREMENT
/begin MEASUREMENT DSCHED_VirtDynPrio.FId_bascadpncvo "virtual dynamic priority / Virtual dynamic priority of scheduled function identifier FId_bascadpncvo" SWORD DFC_OneToOne 1 100 -32768.00 32767.00 FORMAT "%8.2" ECU_ADDRESS 0x600097B4 /end MEASUREMENT
/begin MEASUREMENT DSCHED_VirtPhysPrio.FId_Unused "virtual physical priority / " UBYTE DFC_OneToOne 1 100 0.00 255.0 FORMAT "%5.1" ECU_ADDRESS 0x60010150 /end MEASUREMENT
/begin MEASUREMENT DSCHED_VirtPhysPrio.FID_AFRA "virtual physical priority / Virtual physical priority of scheduled function identifier FID_AFRA" UBYTE DFC_OneToOne 1 100 0.00 255.0 FORMAT "%5.1" ECU_ADDRESS 0x60010151 /end MEASUREMENT
/begin MEASUREMENT DSCHED_VirtPhysPrio.FID_AORA "virtual physical priority / Virtual physical priority of scheduled function identifier FID_AORA" UBYTE DFC_OneToOne 1 100 0.00 255.0 FORMAT "%5.1" ECU_ADDRESS 0x60010152 /end MEASUREMENT
/begin MEASUREMENT DSCHED_VirtPhysPrio.FID_ATEH "virtual physical priority / Virtual physical priority of scheduled function identifier FID_ATEH" UBYTE DFC_OneToOne 1 100 0.00 255.0 FORMAT "%5.1" ECU_ADDRESS 0x60010153 /end MEASUREMENT
/begin MEASUREMENT DSCHED_VirtPhysPrio.FID_ATEL "virtual physical priority / Virtual physical priority of scheduled function identifier FID_ATEL" UBYTE DFC_OneToOne 1 100 0.00 255.0 FORMAT "%5.1" ECU_ADDRESS 0x60010154 /end MEASUREMENT
/begin MEASUREMENT DSCHED_VirtPhysPrio.FID_ATEN "virtual physical priority / Virtual physical priority of scheduled function identifier FID_ATEN" UBYTE DFC_OneToOne 1 100 0.00 255.0 FORMAT "%5.1" ECU_ADDRESS 0x60010155 /end MEASUREMENT
/begin MEASUREMENT DSCHED_VirtPhysPrio.FID_ATLDI "virtual physical priority / Virtual physical priority of scheduled function identifier FID_ATLDI" UBYTE DFC_OneToOne 1 100 0.00 255.0 FORMAT "%5.1" ECU_ADDRESS 0x60010156 /end MEASUREMENT
/begin MEASUREMENT DSCHED_VirtPhysPrio.FID_ATLDO "virtual physical priority / Virtual physical priority of scheduled function identifier FID_ATLDO" UBYTE DFC_OneToOne 1 100 0.00 255.0 FORMAT "%5.1" ECU_ADDRESS 0x60010157 /end MEASUREMENT
/begin MEASUREMENT DSCHED_VirtPhysPrio.FID_BEONV "virtual physical priority / Virtual physical priority of scheduled function identifier FID_BEONV" UBYTE DFC_OneToOne 1 100 0.00 255.0 FORMAT "%5.1" ECU_ADDRESS 0x60010158 /end MEASUREMENT
/begin MEASUREMENT DSCHED_VirtPhysPrio.FId_EGSDCmnSeg1B1Parl "virtual physical priority / Virtual physical priority of scheduled function identifier FId_EGSDCmnSeg1B1Parl" UBYTE DFC_OneToOne 1 100 0.00 255.0 FORMAT "%5.1" ECU_ADDRESS 0x60010159 /end MEASUREMENT
/begin MEASUREMENT DSCHED_VirtPhysPrio.FID_BAGRA "virtual physical priority / Virtual physical priority of scheduled function identifier FID_BAGRA" UBYTE DFC_OneToOne 1 100 0.00 255.0 FORMAT "%5.1" ECU_ADDRESS 0x6001015A /end MEASUREMENT
/begin MEASUREMENT DSCHED_VirtPhysPrio.FID_BAGRASD "virtual physical priority / Virtual physical priority of scheduled function identifier FID_BAGRASD" UBYTE DFC_OneToOne 1 100 0.00 255.0 FORMAT "%5.1" ECU_ADDRESS 0x6001015B /end MEASUREMENT
/begin MEASUREMENT DSCHED_VirtPhysPrio.FID_BDSTOF "virtual physical priority / Virtual physical priority of scheduled function identifier FID_BDSTOF" UBYTE DFC_OneToOne 1 100 0.00 255.0 FORMAT "%5.1" ECU_ADDRESS 0x6001015C /end MEASUREMENT
/begin MEASUREMENT DSCHED_VirtPhysPrio.FID_BFVDFRM "virtual physical priority / Virtual physical priority of scheduled function identifier FID_BFVDFRM" UBYTE DFC_OneToOne 1 100 0.00 255.0 FORMAT "%5.1" ECU_ADDRESS 0x6001015D /end MEASUREMENT
/begin MEASUREMENT DSCHED_VirtPhysPrio.FID_BHOM "virtual physical priority / Virtual physical priority of scheduled function identifier FID_BHOM" UBYTE DFC_OneToOne 1 100 0.00 255.0 FORMAT "%5.1" ECU_ADDRESS 0x6001015E /end MEASUREMENT
/begin MEASUREMENT DSCHED_VirtPhysPrio.FID_BLLRH "virtual physical priority / Virtual physical priority of scheduled function identifier FID_BLLRH" UBYTE DFC_OneToOne 1 100 0.00 255.0 FORMAT "%5.1" ECU_ADDRESS 0x6001015F /end MEASUREMENT
/begin MEASUREMENT DSCHED_VirtPhysPrio.FID_BLLRKH "virtual physical priority / Virtual physical priority of scheduled function identifier FID_BLLRKH" UBYTE DFC_OneToOne 1 100 0.00 255.0 FORMAT "%5.1" ECU_ADDRESS 0x60010160 /end MEASUREMENT
/begin MEASUREMENT DSCHED_VirtPhysPrio.FID_BPLSU "virtual physical priority / Virtual physical priority of scheduled function identifier FID_BPLSU" UBYTE DFC_OneToOne 1 100 0.00 255.0 FORMAT "%5.1" ECU_ADDRESS 0x60010161 /end MEASUREMENT
/begin MEASUREMENT DSCHED_VirtPhysPrio.FID_FRAMBAVMB "virtual physical priority / Virtual physical priority of scheduled function identifier FID_FRAMBAVMB" UBYTE DFC_OneToOne 1 100 0.00 255.0 FORMAT "%5.1" ECU_ADDRESS 0x60010162 /end MEASUREMENT
/begin MEASUREMENT DSCHED_VirtPhysPrio.FId_CatHeatgColdStrtReq "virtual physical priority / Virtual physical priority of scheduled function identifier FId_CatHeatgColdStrtReq" UBYTE DFC_OneToOne 1 100 0.00 255.0 FORMAT "%5.1" ECU_ADDRESS 0x60010163 /end MEASUREMENT
/begin MEASUREMENT DSCHED_VirtPhysPrio.FId_CatHeatgWrmReq "virtual physical priority / Virtual physical priority of scheduled function identifier FId_CatHeatgWrmReq" UBYTE DFC_OneToOne 1 100 0.00 255.0 FORMAT "%5.1" ECU_ADDRESS 0x60010164 /end MEASUREMENT
/begin MEASUREMENT DSCHED_VirtPhysPrio.FId_DSMBDEPHSpOpMode "virtual physical priority / Virtual physical priority of scheduled function identifier FId_DSMBDEPHSpOpMode" UBYTE DFC_OneToOne 1 100 0.00 255.0 FORMAT "%5.1" ECU_ADDRESS 0x60010165 /end MEASUREMENT
/begin MEASUREMENT DSCHED_VirtPhysPrio.FId_EGRVlvCoord "virtual physical priority / Virtual physical priority of scheduled function identifier FId_EGRVlvCoord" UBYTE DFC_OneToOne 1 100 0.00 255.0 FORMAT "%5.1" ECU_ADDRESS 0x60010166 /end MEASUREMENT
/begin MEASUREMENT DSCHED_VirtPhysPrio.FId_EGSDO2FuTrmB1 "virtual physical priority / Virtual physical priority of scheduled function identifier FId_EGSDO2FuTrmB1" UBYTE DFC_OneToOne 1 100 0.00 255.0 FORMAT "%5.1" ECU_ADDRESS 0x60010167 /end MEASUREMENT
/begin MEASUREMENT DSCHED_VirtPhysPrio.FId_EGSDO2SnsrMntdRelsS1B1 "virtual physical priority / Virtual physical priority of scheduled function identifier FId_EGSDO2SnsrMntdRelsS1B1" UBYTE DFC_OneToOne 1 100 0.00 255.0 FORMAT "%5.1" ECU_ADDRESS 0x60010168 /end MEASUREMENT
/begin MEASUREMENT DSCHED_VirtPhysPrio.FId_EGSDO2_LamOffsFastS1B1 "virtual physical priority / Virtual physical priority of scheduled function identifier FId_EGSDO2_LamOffsFastS1B1" UBYTE DFC_OneToOne 1 100 0.00 255.0 FORMAT "%5.1" ECU_ADDRESS 0x60010169 /end MEASUREMENT
/begin MEASUREMENT DSCHED_VirtPhysPrio.FId_MisfDetDnAdpnNv "virtual physical priority / Virtual physical priority of scheduled function identifier FId_MisfDetDnAdpnNv" UBYTE DFC_OneToOne 1 100 0.00 255.0 FORMAT "%5.1" ECU_ADDRESS 0x6001016A /end MEASUREMENT
/begin MEASUREMENT DSCHED_VirtPhysPrio.FId_bascadpncvo "virtual physical priority / Virtual physical priority of scheduled function identifier FId_bascadpncvo" UBYTE DFC_OneToOne 1 100 0.00 255.0 FORMAT "%5.1" ECU_ADDRESS 0x6001016B /end MEASUREMENT
/begin FUNCTION DRIVE_PRDS "30014.2.0_1.1.0Diagnostic Recorder for Evaluation an Verification - Project Dataset"
 /begin DEF_CHARACTERISTIC DRIVE_Clear_Arbitrary_C DRIVE_Clear_BadEngStrt_C DRIVE_Clear_C DRIVE_Clear_EngStal_C DRIVE_CurTrgMode_C DRIVE_numBadStrtDCTIDLst_CA DRIVE_numDCTIDLst_CA DRIVE_numEngStalDCTIDLst_CA DRIVE_numSysId_C DRIVE_PRDS_Bnk0Blk00_Sig_CA DRIVE_PRDS_Bnk0Blk01_Sig_CA DRIVE_PRDS_Bnk0Blk02_Sig_CA DRIVE_PRDS_Bnk0Blk04_Sig_CA DRIVE_PRDS_Bnk0Blk05_Sig_CA DRIVE_PRDS_Bnk0Blk06_Sig_CA DRIVE_PRDS_Bnk0Blk07_Sig_CA DRIVE_PRDS_Bnk0Blk09_Sig_CA DRIVE_PRDS_Bnk0Blk0a_Sig_CA DRIVE_PRDS_Bnk0Blk0b_Sig_CA DRIVE_PRDS_Bnk0Blk0c_Sig_CA DRIVE_PRDS_Bnk0Blk0d_Sig_CA DRIVE_PRDS_Bnk0Blk0e_Sig_CA DRIVE_PRDS_Bnk0Blk0f_Sig_CA DRIVE_PRDS_Bnk0Blk10_Sig_CA DRIVE_PRDS_Bnk0Blk11_Sig_CA DRIVE_PRDS_Bnk0Blk12_Sig_CA DRIVE_PRDS_Bnk0Blk13_Sig_CA DRIVE_PRDS_Bnk0Blk14_Sig_CA DRIVE_PRDS_Bnk0Blk15_Sig_CA DRIVE_PRDS_Bnk0Blk16_Sig_CA DRIVE_PRDS_Bnk0Blk17_Sig_CA DRIVE_PRDS_Bnk0Blk18_Sig_CA DRIVE_PRDS_Bnk0Blk19_Sig_CA DRIVE_PRDS_Bnk0Blk1a_Sig_CA DRIVE_PRDS_Bnk0Blk1b_Sig_CA DRIVE_PRDS_Bnk1Blk00_Sig_CA DRIVE_PRDS_Bnk1Blk02_Sig_CA DRIVE_PRDS_Bnk1Blk03_Sig_CA DRIVE_PRDS_Bnk1Blk04_Sig_CA DRIVE_PRDS_Bnk1Blk05_Sig_CA Drive_stClrData_Arbitrary_C Drive_stClrData_BadEngStrt_C Drive_stClrData_C Drive_stClrData_EngStal_C DRIVE_swtForcedRecCond_C DRIVE_swtForcedTrg_C DRIVE_swtNPos_C DRIVE_tiEngStal_C DRIVE_tiEngStrtBad_CUR DRIVE_vEngStal_C /end DEF_CHARACTERISTIC
 /begin IN_MEASUREMENT CEngDsT_t Clth_st CoEng_st CoEng_stStalEngReas CoEng_tiNormal DSMAUX_stDsmClrActv DSM_TripChgFinshd EGSDCmn_stLamGenrParlB1 Epm_nEng Gbx_stNPos I14229_stSuppRst T15_st VehV_v /end IN_MEASUREMENT
 /begin OUT_MEASUREMENT DRIVE_numDTCFrz DRIVE_stAOBSTrg DRIVE_stBadEngStrt DRIVE_stCrLon DRIVE_stCurTrgMode DRIVE_stEngNStrt DRIVE_stHardToStrt DRIVE_stStalAftEngStrt /end OUT_MEASUREMENT
 /begin LOC_MEASUREMENT DRIVE_AobsFrqTmr DRIVE_AobsTmrCnt DRIVE_AOBS_Mode DRIVE_AOBS_stPrmSet Drive_DSMFaults DRIVE_FirstLayerResult Drive_idxDFC DRIVE_numAOBSDCTIDLst_defined DRIVE_numAOBSDCTIDLst_record Drive_numPCode DRIVE_PRDS_Bnk0Blk00_idx_NV DRIVE_PRDS_Bnk0Blk00_Rcrd_NV DRIVE_PRDS_Bnk0Blk01_idx_NV DRIVE_PRDS_Bnk0Blk01_Rcrd_NV DRIVE_PRDS_Bnk0Blk02_idx_NV DRIVE_PRDS_Bnk0Blk02_Rcrd_NV DRIVE_PRDS_Bnk0Blk04_idx_NV DRIVE_PRDS_Bnk0Blk04_Rcrd_NV DRIVE_PRDS_Bnk0Blk05_idx_NV DRIVE_PRDS_Bnk0Blk05_Rcrd_NV DRIVE_PRDS_Bnk0Blk06_idx_NV DRIVE_PRDS_Bnk0Blk06_Rcrd_NV DRIVE_PRDS_Bnk0Blk07_idx_NV DRIVE_PRDS_Bnk0Blk07_Rcrd_NV DRIVE_PRDS_Bnk0Blk09_idx_NV DRIVE_PRDS_Bnk0Blk09_Rcrd_NV DRIVE_PRDS_Bnk0Blk0a_idx_NV DRIVE_PRDS_Bnk0Blk0a_Rcrd_NV DRIVE_PRDS_Bnk0Blk0b_idx_NV DRIVE_PRDS_Bnk0Blk0b_Rcrd_NV DRIVE_PRDS_Bnk0Blk0c_idx_NV DRIVE_PRDS_Bnk0Blk0c_Rcrd_NV DRIVE_PRDS_Bnk0Blk0d_idx_NV DRIVE_PRDS_Bnk0Blk0d_Rcrd_NV DRIVE_PRDS_Bnk0Blk0e_idx_NV DRIVE_PRDS_Bnk0Blk0e_Rcrd_NV DRIVE_PRDS_Bnk0Blk0f_idx_NV DRIVE_PRDS_Bnk0Blk0f_Rcrd_NV DRIVE_PRDS_Bnk0Blk10_idx_NV DRIVE_PRDS_Bnk0Blk10_Rcrd_NV DRIVE_PRDS_Bnk0Blk11_idx_NV DRIVE_PRDS_Bnk0Blk11_Rcrd_NV DRIVE_PRDS_Bnk0Blk12_idx_NV DRIVE_PRDS_Bnk0Blk12_Rcrd_NV DRIVE_PRDS_Bnk0Blk13_idx_NV DRIVE_PRDS_Bnk0Blk13_Rcrd_NV DRIVE_PRDS_Bnk0Blk14_idx_NV DRIVE_PRDS_Bnk0Blk14_Rcrd_NV DRIVE_PRDS_Bnk0Blk15_idx_NV DRIVE_PRDS_Bnk0Blk15_Rcrd_NV DRIVE_PRDS_Bnk0Blk16_idx_NV DRIVE_PRDS_Bnk0Blk16_Rcrd_NV DRIVE_PRDS_Bnk0Blk17_idx_NV DRIVE_PRDS_Bnk0Blk17_Rcrd_NV DRIVE_PRDS_Bnk0Blk18_idx_NV DRIVE_PRDS_Bnk0Blk18_Rcrd_NV DRIVE_PRDS_Bnk0Blk19_idx_NV DRIVE_PRDS_Bnk0Blk19_Rcrd_NV DRIVE_PRDS_Bnk0Blk1a_idx_NV DRIVE_PRDS_Bnk0Blk1a_Rcrd_NV DRIVE_PRDS_Bnk0Blk1b_idx_NV DRIVE_PRDS_Bnk0Blk1b_Rcrd_NV DRIVE_PRDS_Bnk1Blk00_idx DRIVE_PRDS_Bnk1Blk00_idx_NV DRIVE_PRDS_Bnk1Blk00_Rcrd DRIVE_PRDS_Bnk1Blk00_Rcrd_NV DRIVE_PRDS_Bnk1Blk02_idx DRIVE_PRDS_Bnk1Blk02_idx_NV DRIVE_PRDS_Bnk1Blk02_Rcrd DRIVE_PRDS_Bnk1Blk02_Rcrd_NV DRIVE_PRDS_Bnk1Blk03_idx DRIVE_PRDS_Bnk1Blk03_idx_NV DRIVE_PRDS_Bnk1Blk03_Rcrd DRIVE_PRDS_Bnk1Blk03_Rcrd_NV DRIVE_PRDS_Bnk1Blk04_idx DRIVE_PRDS_Bnk1Blk04_idx_NV DRIVE_PRDS_Bnk1Blk04_Rcrd DRIVE_PRDS_Bnk1Blk04_Rcrd_NV DRIVE_PRDS_Bnk1Blk05_idx DRIVE_PRDS_Bnk1Blk05_idx_NV DRIVE_PRDS_Bnk1Blk05_Rcrd DRIVE_PRDS_Bnk1Blk05_Rcrd_NV DRIVE_PRDS_Bnk2Blk00_idx DRIVE_PRDS_Bnk2Blk00_idx_NV DRIVE_PRDS_Bnk2Blk00_Rcrd DRIVE_PRDS_Bnk2Blk00_Rcrd_NV DRIVE_PRDS_Bnk2Blk02_idx DRIVE_PRDS_Bnk2Blk02_idx_NV DRIVE_PRDS_Bnk2Blk02_Rcrd DRIVE_PRDS_Bnk2Blk02_Rcrd_NV DRIVE_PRDS_Bnk2Blk03_idx DRIVE_PRDS_Bnk2Blk03_idx_NV DRIVE_PRDS_Bnk2Blk03_Rcrd DRIVE_PRDS_Bnk2Blk03_Rcrd_NV DRIVE_PRDS_Bnk2Blk04_idx DRIVE_PRDS_Bnk2Blk04_idx_NV DRIVE_PRDS_Bnk2Blk04_Rcrd DRIVE_PRDS_Bnk2Blk04_Rcrd_NV DRIVE_PRDS_Bnk2Blk05_idx DRIVE_PRDS_Bnk2Blk05_idx_NV DRIVE_PRDS_Bnk2Blk05_Rcrd DRIVE_PRDS_Bnk2Blk05_Rcrd_NV DRIVE_PRDS_Bnk3Blk00_idx DRIVE_PRDS_Bnk3Blk00_idx_NV DRIVE_PRDS_Bnk3Blk00_Rcrd DRIVE_PRDS_Bnk3Blk00_Rcrd_NV DRIVE_PRDS_Bnk3Blk00_RecMsk DRIVE_PRDS_Bnk3Blk00_Sig DRIVE_PRDS_Bnk3Blk01_idx DRIVE_PRDS_Bnk3Blk01_idx_NV DRIVE_PRDS_Bnk3Blk01_Rcrd DRIVE_PRDS_Bnk3Blk01_Rcrd_NV DRIVE_PRDS_Bnk3Blk01_RecMsk DRIVE_PRDS_Bnk3Blk01_Sig DRIVE_ScndLyrExpRes_raw DRIVE_SecondLayerExpMsk DRIVE_SecondLayerExpResults DRIVE_stArbitraryTrgFrz DRIVE_stArbitraryTrg_mp DRIVE_stBadStrtTrgFrz DRIVE_stEngStalTrgFrz DRIVE_stEngStalTrg_mp DRIVE_stEngStrt DRIVE_stRingBuf_Arbitrary_mp DRIVE_stRingBuf_BadEngStrt_mp DRIVE_stRingBuf_EngStal_mp DRIVE_stRingBuf_mp DRIVE_stStalAftEngStrt_mp DRIVE_stStore_Arbitrary_mp DRIVE_stStore_BadEngStrt_mp DRIVE_stStore_EngStal_mp DRIVE_stStore_mp DRIVE_stTimeLapse DRIVE_stTrgSigFrz DRIVE_ThirdLayerExpResults DRIVE_ThirdLayerExpResults_old DRIVE_ThrdLyrCntrRes_raw DRIVE_TriggerSignal DRIVE_TriggerSignal_Arbitrary DRIVE_TriggerSignal_BadEngStrt DRIVE_TriggerSignal_EngStal /end LOC_MEASUREMENT
 FUNCTION_VERSION "30014.2.0_1.1.0" /end FUNCTION
/begin FUNCTION DSCHED_Cal "30000.2.0 Diagnostic Scheduler Calibration"
 /begin DEF_CHARACTERISTIC DSCHED_AsgnCheck.FID_AFRA_C DSCHED_AsgnCheck.FID_AORA_C DSCHED_AsgnCheck.FID_ATEH_C DSCHED_AsgnCheck.FID_ATEL_C DSCHED_AsgnCheck.FID_ATEN_C DSCHED_AsgnCheck.FID_ATLDI_C DSCHED_AsgnCheck.FID_ATLDO_C DSCHED_AsgnCheck.FID_BEONV_C DSCHED_AsgnCheck.FId_EGSDCmnSeg1B1Parl_C DSCHED_AsgnCheck.FID_BAGRA_C DSCHED_AsgnCheck.FID_BAGRASD_C DSCHED_AsgnCheck.FID_BDSTOF_C DSCHED_AsgnCheck.FID_BFVDFRM_C DSCHED_AsgnCheck.FID_BHOM_C DSCHED_AsgnCheck.FID_BLLRH_C DSCHED_AsgnCheck.FID_BLLRKH_C DSCHED_AsgnCheck.FID_BPLSU_C DSCHED_AsgnCheck.FID_FRAMBAVMB_C DSCHED_AsgnCheck.FId_CatHeatgColdStrtReq_C DSCHED_AsgnCheck.FId_CatHeatgWrmReq_C DSCHED_AsgnCheck.FId_DSMBDEPHSpOpMode_C DSCHED_AsgnCheck.FId_EGRVlvCoord_C DSCHED_AsgnCheck.FId_EGSDO2FuTrmB1_C DSCHED_AsgnCheck.FId_EGSDO2SnsrMntdRelsS1B1_C DSCHED_AsgnCheck.FId_EGSDO2_LamOffsFastS1B1_C DSCHED_AsgnCheck.FId_MisfDetDnAdpnNv_C DSCHED_AsgnCheck.FId_bascadpncvo_C DSCHED_BsPrio.FID_AFRA_C DSCHED_BsPrio.FID_AORA_C DSCHED_BsPrio.FID_ATEH_C DSCHED_BsPrio.FID_ATEL_C DSCHED_BsPrio.FID_ATEN_C DSCHED_BsPrio.FID_ATLDI_C DSCHED_BsPrio.FID_ATLDO_C DSCHED_BsPrio.FID_BEONV_C DSCHED_BsPrio.FId_EGSDCmnSeg1B1Parl_C DSCHED_BsPrio.FID_BAGRA_C DSCHED_BsPrio.FID_BAGRASD_C DSCHED_BsPrio.FID_BDSTOF_C DSCHED_BsPrio.FID_BFVDFRM_C DSCHED_BsPrio.FID_BHOM_C DSCHED_BsPrio.FID_BLLRH_C DSCHED_BsPrio.FID_BLLRKH_C DSCHED_BsPrio.FID_BPLSU_C DSCHED_BsPrio.FID_FRAMBAVMB_C DSCHED_BsPrio.FId_CatHeatgColdStrtReq_C DSCHED_BsPrio.FId_CatHeatgWrmReq_C DSCHED_BsPrio.FId_DSMBDEPHSpOpMode_C DSCHED_BsPrio.FId_EGRVlvCoord_C DSCHED_BsPrio.FId_EGSDO2FuTrmB1_C DSCHED_BsPrio.FId_EGSDO2SnsrMntdRelsS1B1_C DSCHED_BsPrio.FId_EGSDO2_LamOffsFastS1B1_C DSCHED_BsPrio.FId_MisfDetDnAdpnNv_C DSCHED_BsPrio.FId_bascadpncvo_C DSCHED_FacPhys.FID_AFRA_C DSCHED_FacPhys.FID_AORA_C DSCHED_FacPhys.FID_ATEH_C DSCHED_FacPhys.FID_ATEL_C DSCHED_FacPhys.FID_ATEN_C DSCHED_FacPhys.FID_ATLDI_C DSCHED_FacPhys.FID_ATLDO_C DSCHED_FacPhys.FID_BEONV_C DSCHED_FacPhys.FId_EGSDCmnSeg1B1Parl_C DSCHED_FacPhys.FID_BAGRA_C DSCHED_FacPhys.FID_BAGRASD_C DSCHED_FacPhys.FID_BDSTOF_C DSCHED_FacPhys.FID_BFVDFRM_C DSCHED_FacPhys.FID_BHOM_C DSCHED_FacPhys.FID_BLLRH_C DSCHED_FacPhys.FID_BLLRKH_C DSCHED_FacPhys.FID_BPLSU_C DSCHED_FacPhys.FID_FRAMBAVMB_C DSCHED_FacPhys.FId_CatHeatgColdStrtReq_C DSCHED_FacPhys.FId_CatHeatgWrmReq_C DSCHED_FacPhys.FId_DSMBDEPHSpOpMode_C DSCHED_FacPhys.FId_EGRVlvCoord_C DSCHED_FacPhys.FId_EGSDO2FuTrmB1_C DSCHED_FacPhys.FId_EGSDO2SnsrMntdRelsS1B1_C DSCHED_FacPhys.FId_EGSDO2_LamOffsFastS1B1_C DSCHED_FacPhys.FId_MisfDetDnAdpnNv_C DSCHED_FacPhys.FId_bascadpncvo_C DSCHED_JmpActvPrio.FID_AFRA_C DSCHED_JmpActvPrio.FID_AORA_C DSCHED_JmpActvPrio.FID_ATEH_C DSCHED_JmpActvPrio.FID_ATEL_C DSCHED_JmpActvPrio.FID_ATEN_C DSCHED_JmpActvPrio.FID_ATLDI_C DSCHED_JmpActvPrio.FID_ATLDO_C DSCHED_JmpActvPrio.FID_BEONV_C DSCHED_JmpActvPrio.FId_EGSDCmnSeg1B1Parl_C DSCHED_JmpActvPrio.FID_BAGRA_C DSCHED_JmpActvPrio.FID_BAGRASD_C DSCHED_JmpActvPrio.FID_BDSTOF_C DSCHED_JmpActvPrio.FID_BFVDFRM_C DSCHED_JmpActvPrio.FID_BHOM_C DSCHED_JmpActvPrio.FID_BLLRH_C DSCHED_JmpActvPrio.FID_BLLRKH_C DSCHED_JmpActvPrio.FID_BPLSU_C DSCHED_JmpActvPrio.FID_FRAMBAVMB_C DSCHED_JmpActvPrio.FId_CatHeatgColdStrtReq_C DSCHED_JmpActvPrio.FId_CatHeatgWrmReq_C DSCHED_JmpActvPrio.FId_DSMBDEPHSpOpMode_C DSCHED_JmpActvPrio.FId_EGRVlvCoord_C DSCHED_JmpActvPrio.FId_EGSDO2FuTrmB1_C DSCHED_JmpActvPrio.FId_EGSDO2SnsrMntdRelsS1B1_C DSCHED_JmpActvPrio.FId_EGSDO2_LamOffsFastS1B1_C DSCHED_JmpActvPrio.FId_MisfDetDnAdpnNv_C DSCHED_JmpActvPrio.FId_bascadpncvo_C DSCHED_LimPrio.FID_AFRA_C DSCHED_LimPrio.FID_AORA_C DSCHED_LimPrio.FID_ATEH_C DSCHED_LimPrio.FID_ATEL_C DSCHED_LimPrio.FID_ATEN_C DSCHED_LimPrio.FID_ATLDI_C DSCHED_LimPrio.FID_ATLDO_C DSCHED_LimPrio.FID_BEONV_C DSCHED_LimPrio.FId_EGSDCmnSeg1B1Parl_C DSCHED_LimPrio.FID_BAGRA_C DSCHED_LimPrio.FID_BAGRASD_C DSCHED_LimPrio.FID_BDSTOF_C DSCHED_LimPrio.FID_BFVDFRM_C DSCHED_LimPrio.FID_BHOM_C DSCHED_LimPrio.FID_BLLRH_C DSCHED_LimPrio.FID_BLLRKH_C DSCHED_LimPrio.FID_BPLSU_C DSCHED_LimPrio.FID_FRAMBAVMB_C DSCHED_LimPrio.FId_CatHeatgColdStrtReq_C DSCHED_LimPrio.FId_CatHeatgWrmReq_C DSCHED_LimPrio.FId_DSMBDEPHSpOpMode_C DSCHED_LimPrio.FId_EGRVlvCoord_C DSCHED_LimPrio.FId_EGSDO2FuTrmB1_C DSCHED_LimPrio.FId_EGSDO2SnsrMntdRelsS1B1_C DSCHED_LimPrio.FId_EGSDO2_LamOffsFastS1B1_C DSCHED_LimPrio.FId_MisfDetDnAdpnNv_C DSCHED_LimPrio.FId_bascadpncvo_C DSCHED_valOfsPrioOpMode_C DSCHED_valOfsPrioTst_C /end DEF_CHARACTERISTIC
 /begin OUT_MEASUREMENT DSCHED_DynPrio.FId_Unused DSCHED_DynPrio.FID_AFRA DSCHED_DynPrio.FID_AORA DSCHED_DynPrio.FID_ATEH DSCHED_DynPrio.FID_ATEL DSCHED_DynPrio.FID_ATEN DSCHED_DynPrio.FID_ATLDI DSCHED_DynPrio.FID_ATLDO DSCHED_DynPrio.FID_BEONV DSCHED_DynPrio.FId_EGSDCmnSeg1B1Parl DSCHED_DynPrio.FID_BAGRA DSCHED_DynPrio.FID_BAGRASD DSCHED_DynPrio.FID_BDSTOF DSCHED_DynPrio.FID_BFVDFRM DSCHED_DynPrio.FID_BHOM DSCHED_DynPrio.FID_BLLRH DSCHED_DynPrio.FID_BLLRKH DSCHED_DynPrio.FID_BPLSU DSCHED_DynPrio.FID_FRAMBAVMB DSCHED_DynPrio.FId_CatHeatgColdStrtReq DSCHED_DynPrio.FId_CatHeatgWrmReq DSCHED_DynPrio.FId_DSMBDEPHSpOpMode DSCHED_DynPrio.FId_EGRVlvCoord DSCHED_DynPrio.FId_EGSDO2FuTrmB1 DSCHED_DynPrio.FId_EGSDO2SnsrMntdRelsS1B1 DSCHED_DynPrio.FId_EGSDO2_LamOffsFastS1B1 DSCHED_DynPrio.FId_MisfDetDnAdpnNv DSCHED_DynPrio.FId_bascadpncvo DSCHED_PhysPrio.FId_Unused DSCHED_PhysPrio.FID_AFRA DSCHED_PhysPrio.FID_AORA DSCHED_PhysPrio.FID_ATEH DSCHED_PhysPrio.FID_ATEL DSCHED_PhysPrio.FID_ATEN DSCHED_PhysPrio.FID_ATLDI DSCHED_PhysPrio.FID_ATLDO DSCHED_PhysPrio.FID_BEONV DSCHED_PhysPrio.FId_EGSDCmnSeg1B1Parl DSCHED_PhysPrio.FID_BAGRA DSCHED_PhysPrio.FID_BAGRASD DSCHED_PhysPrio.FID_BDSTOF DSCHED_PhysPrio.FID_BFVDFRM DSCHED_PhysPrio.FID_BHOM DSCHED_PhysPrio.FID_BLLRH DSCHED_PhysPrio.FID_BLLRKH DSCHED_PhysPrio.FID_BPLSU DSCHED_PhysPrio.FID_FRAMBAVMB DSCHED_PhysPrio.FId_CatHeatgColdStrtReq DSCHED_PhysPrio.FId_CatHeatgWrmReq DSCHED_PhysPrio.FId_DSMBDEPHSpOpMode DSCHED_PhysPrio.FId_EGRVlvCoord DSCHED_PhysPrio.FId_EGSDO2FuTrmB1 DSCHED_PhysPrio.FId_EGSDO2SnsrMntdRelsS1B1 DSCHED_PhysPrio.FId_EGSDO2_LamOffsFastS1B1 DSCHED_PhysPrio.FId_MisfDetDnAdpnNv DSCHED_PhysPrio.FId_bascadpncvo DSCHED_VirtDynPrio.FId_Unused DSCHED_VirtDynPrio.FID_AFRA DSCHED_VirtDynPrio.FID_AORA DSCHED_VirtDynPrio.FID_ATEH DSCHED_VirtDynPrio.FID_ATEL DSCHED_VirtDynPrio.FID_ATEN DSCHED_VirtDynPrio.FID_ATLDI DSCHED_VirtDynPrio.FID_ATLDO DSCHED_VirtDynPrio.FID_BEONV DSCHED_VirtDynPrio.FId_EGSDCmnSeg1B1Parl DSCHED_VirtDynPrio.FID_BAGRA DSCHED_VirtDynPrio.FID_BAGRASD DSCHED_VirtDynPrio.FID_BDSTOF DSCHED_VirtDynPrio.FID_BFVDFRM DSCHED_VirtDynPrio.FID_BHOM DSCHED_VirtDynPrio.FID_BLLRH DSCHED_VirtDynPrio.FID_BLLRKH DSCHED_VirtDynPrio.FID_BPLSU DSCHED_VirtDynPrio.FID_FRAMBAVMB DSCHED_VirtDynPrio.FId_CatHeatgColdStrtReq DSCHED_VirtDynPrio.FId_CatHeatgWrmReq DSCHED_VirtDynPrio.FId_DSMBDEPHSpOpMode DSCHED_VirtDynPrio.FId_EGRVlvCoord DSCHED_VirtDynPrio.FId_EGSDO2FuTrmB1 DSCHED_VirtDynPrio.FId_EGSDO2SnsrMntdRelsS1B1 DSCHED_VirtDynPrio.FId_EGSDO2_LamOffsFastS1B1 DSCHED_VirtDynPrio.FId_MisfDetDnAdpnNv DSCHED_VirtDynPrio.FId_bascadpncvo DSCHED_VirtPhysPrio.FId_Unused DSCHED_VirtPhysPrio.FID_AFRA DSCHED_VirtPhysPrio.FID_AORA DSCHED_VirtPhysPrio.FID_ATEH DSCHED_VirtPhysPrio.FID_ATEL DSCHED_VirtPhysPrio.FID_ATEN DSCHED_VirtPhysPrio.FID_ATLDI DSCHED_VirtPhysPrio.FID_ATLDO DSCHED_VirtPhysPrio.FID_BEONV DSCHED_VirtPhysPrio.FId_EGSDCmnSeg1B1Parl DSCHED_VirtPhysPrio.FID_BAGRA DSCHED_VirtPhysPrio.FID_BAGRASD DSCHED_VirtPhysPrio.FID_BDSTOF DSCHED_VirtPhysPrio.FID_BFVDFRM DSCHED_VirtPhysPrio.FID_BHOM DSCHED_VirtPhysPrio.FID_BLLRH DSCHED_VirtPhysPrio.FID_BLLRKH DSCHED_VirtPhysPrio.FID_BPLSU DSCHED_VirtPhysPrio.FID_FRAMBAVMB DSCHED_VirtPhysPrio.FId_CatHeatgColdStrtReq DSCHED_VirtPhysPrio.FId_CatHeatgWrmReq DSCHED_VirtPhysPrio.FId_DSMBDEPHSpOpMode DSCHED_VirtPhysPrio.FId_EGRVlvCoord DSCHED_VirtPhysPrio.FId_EGSDO2FuTrmB1 DSCHED_VirtPhysPrio.FId_EGSDO2SnsrMntdRelsS1B1 DSCHED_VirtPhysPrio.FId_EGSDO2_LamOffsFastS1B1 DSCHED_VirtPhysPrio.FId_MisfDetDnAdpnNv DSCHED_VirtPhysPrio.FId_bascadpncvo /end OUT_MEASUREMENT
 FUNCTION_VERSION "30000.2.0" /end FUNCTION
/begin COMPU_METHOD DFC_OneToOne "" RAT_FUNC "%6.2" "-" COEFFS 0 1 0 0 0 1 /end COMPU_METHOD
/begin COMPU_METHOD DFC_Verb "" TAB_VERB "%6.3" "-" COMPU_TAB_REF DFC_Verb /end COMPU_METHOD
/begin COMPU_VTAB DFC_Verb "" TAB_VERB 907 0 "DFC_Unused" 1 "DFC_AAVEmax" 2 "DFC_AAVEmin" 3 "DFC_AAVEsig" 508 "DFC_AAVmin" 379 "DFC_ACEvpTPhysRngHi" 380 "DFC_ACEvpTPhysRngLo" 381 "DFC_ACEvpTSRCMax" 382 "DFC_ACEvpTSRCMin" 288 "DFC_AfsPhyRngHiB1" 289 "DFC_AfsPhyRngLoB1" 510 "DFC_AfsPlausDiagHi" 511 "DFC_AfsPlausDiagLo" 383 "DFC_AfsRawSigRngHiB1" 384 "DFC_AfsRawSigRngLoB1" 415 "DFC_AfsSigErrLineHiB1" 416 "DFC_AfsSigErrLineLoB1" 385 "DFC_AfsSnsrErrB1" 512 "DFC_AfsVrntDiagErrB1" 509 "DFC_AGRSUS" 386 "DFC_AirCClntPAnaSRCMax" 387 "DFC_AirCClntPAnaSRCMin" 290 "DFC_AirCCmprOL" 291 "DFC_AirCCmprOvrTemp" 292 "DFC_AirCCmprSCB" 293 "DFC_AirCCmprSCG" 388 "DFC_AirCSwtNpl" 389 "DFC_AirCSwtSig" 294 "DFC_AltErr" 4 "DFC_AltIOACGFailr" 5 "DFC_AltIOACGHiVltg" 6 "DFC_AltIOACGLoVltg" 7 "DFC_AltIOACGTHi" 8 "DFC_AltIODConnACG" 513 "DFC_AppAllSnsrDfct" 10 "DFC_BattUHiFailr" 11 "DFC_BattULoFailr" 295 "DFC_BattUSRCMax" 296 "DFC_BattUSRCMin" 516 "DFC_BattUStdbyDiaOL" 514 "DFC_BBKRnldg" 515 "DFC_BBKRsyne" 9 "DFC_BGOELWAF" 517 "DFC_BigLeakIntkMnfldEmiInfl" 518 "DFC_BlkdLineTank" 390 "DFC_Brk" 12 "DFC_BrkBstPDriftHiErr" 13 "DFC_BrkBstPDriftLoErr" 14 "DFC_BrkBstPSnsrStuck" 391 "DFC_BrkBstSensSCB" 392 "DFC_BrkBstSensSCG" 15 "DFC_BrkMnSwtContOn" 519 "DFC_BrkMnSwtContOnWarnLmp" 16 "DFC_BrkMnSwtNotStp" 520 "DFC_BrkMnSwtNotStpWarnLmp" 17 "DFC_BrkNpl" 18 "DFC_BrkRdntSwtContOn" 521 "DFC_BrkRdntSwtContOnWarnLmp" 19 "DFC_BrkRdntSwtNotStp" 522 "DFC_BrkRdntSwtNotStpWarnLmp" 393 "DFC_BrkSig" 496 "DFC_BSWM_E_ACTION_FAILED" 497 "DFC_BSWM_E_INTRPTQUEUE_FULL" 472 "DFC_BusDiagCANAPPLBusOff" 473 "DFC_BusDiagCANCANCBusOff" 474 "DFC_BusDiagCANVEHICLEBusOff" 490 "DFC_CAN_E_TIMEOUT" 523 "DFC_CEngDsTColdStrtMax" 524 "DFC_CEngDsTColdStrtMin" 525 "DFC_CEngDsTImps" 526 "DFC_CEngDsTPlausHSC" 527 "DFC_CEngDsTPlausLSC" 528 "DFC_CEngDsTPlausSTC" 531 "DFC_CEngDsTSig" 529 "DFC_CEngDsTSRCMax" 530 "DFC_CEngDsTSRCMin" 532 "DFC_CEngUsTColdStrtMax" 533 "DFC_CEngUsTColdStrtMin" 534 "DFC_CEngUsTLooseCnctn" 535 "DFC_CEngUsTSRCMax" 536 "DFC_CEngUsTSRCMin" 432 "DFC_Clth2ONStuck" 433 "DFC_Clth2ONStuckLdc" 20 "DFC_Clth3ONStuck" 434 "DFC_Clth3ONStuckLdc" 435 "DFC_Clth3ONStuckPostDrv" 21 "DFC_Clth4OFFStuck" 436 "DFC_Clth4ONStuck" 437 "DFC_Clth4ONStuckLdc" 260 "DFC_ClthMax" 412 "DFC_ClthNpl" 22 "DFC_ClthOFFStuck" 23 "DFC_ClthONStuck" 394 "DFC_ClthSig" 24 "DFC_ClthStkFailInfo" 25 "DFC_ComACFailInfo" 26 "DFC_ComATFTValErr" 27 "DFC_ComATMILReq" 28 "DFC_ComAYCAChksum" 29 "DFC_ComAYCARingCnt" 30 "DFC_ComAYCATOut" 31 "DFC_ComAYCDChkSum" 32 "DFC_ComAYCDTOut" 33 "DFC_ComAYCFChksum" 34 "DFC_ComAYCFRingCnt" 35 "DFC_ComAYCFTOut" 36 "DFC_ComAYCGChksum" 37 "DFC_ComAYCGRingCnt" 38 "DFC_ComAYCGTOut" 39 "DFC_ComAYCIChkSum" 40 "DFC_ComAYCIRingCnt" 41 "DFC_ComAYCITOut" 42 "DFC_ComBCM1ChkSum" 43 "DFC_ComBCM1RingCnt" 44 "DFC_ComBCM1TOut" 438 "DFC_ComBCMUnit" 45 "DFC_ComCANABusOffErr" 46 "DFC_ComCANBBusOffErr" 47 "DFC_ComCANCBusOffErr" 48 "DFC_ComCGW1ChkSum" 49 "DFC_ComCGW1RingCnt" 50 "DFC_ComCGW1TOut" 297 "DFC_ComChksTCU1" 298 "DFC_ComChksTCU11" 299 "DFC_ComChksTCU12" 300 "DFC_ComChksTCU13" 301 "DFC_ComChksTCU2" 302 "DFC_ComChksTCU3" 303 "DFC_ComChksTCU4" 304 "DFC_ComCntTCU1" 305 "DFC_ComCntTCU11" 306 "DFC_ComCntTCU12" 307 "DFC_ComCntTCU13" 308 "DFC_ComCntTCU2" 309 "DFC_ComCntTCU3" 310 "DFC_ComCntTCU4" 51 "DFC_ComConvBoostErr" 52 "DFC_ComConvSlipErr" 537 "DFC_ComDCDCACCFailr" 53 "DFC_ComDCDCPrfmncErr" 54 "DFC_ComDCDCTempWarn" 439 "DFC_ComDLCTCU01" 440 "DFC_ComDLCTCU02" 441 "DFC_ComDLCTCU1" 442 "DFC_ComDLCTCU11" 443 "DFC_ComDLCTCU12" 444 "DFC_ComDLCTCU13" 445 "DFC_ComDLCTCU14" 446 "DFC_ComDLCTCU2" 447 "DFC_ComDLCTCU3" 448 "DFC_ComDLCTCU4" 55 "DFC_ComEAT10Chksum" 56 "DFC_ComEAT10RingCnt" 57 "DFC_ComEAT10TOut" 58 "DFC_ComEAT11ChkSum" 59 "DFC_ComEAT11RingCnt" 60 "DFC_ComEAT11TOut" 61 "DFC_ComEAT12ChkSum" 62 "DFC_ComEAT12RingCnt" 63 "DFC_ComEAT12TOut" 64 "DFC_ComEAT13ChkSum" 65 "DFC_ComEAT13RingCnt" 66 "DFC_ComEAT13TOut" 67 "DFC_ComEAT1Chksum" 68 "DFC_ComEAT1RingCnt" 69 "DFC_ComEAT1TOut" 70 "DFC_ComEAT2ChkSum" 71 "DFC_ComEAT2RingCnt" 72 "DFC_ComEAT2TOut" 73 "DFC_ComEAT4ChkSum" 74 "DFC_ComEAT4RingCnt" 75 "DFC_ComEAT4TOut" 76 "DFC_ComEAT6Chksum" 77 "DFC_ComEAT6RingCnt" 78 "DFC_ComEAT6TOut" 79 "DFC_ComEAT7Chksum" 80 "DFC_ComEAT7RingCnt" 81 "DFC_ComEAT7TOut" 82 "DFC_ComEAT8Chksum" 83 "DFC_ComEAT8RingCnt" 84 "DFC_ComEAT8TOut" 85 "DFC_ComEATAChksum" 86 "DFC_ComEATARingCnt" 87 "DFC_ComEATATOut" 88 "DFC_ComEATBChkSum" 89 "DFC_ComEATBRingCnt" 90 "DFC_ComEATBTOut" 91 "DFC_ComEATCChksum" 92 "DFC_ComEATCRingCnt" 93 "DFC_ComEATCTOut" 103 "DFC_ComEngCanRxErr" 94 "DFC_ComEPBBChkSum" 95 "DFC_ComEPBBRingCnt" 96 "DFC_ComEPBBTOut" 97 "DFC_ComEPBChksum" 99 "DFC_ComEPBctRing" 98 "DFC_ComEPBTOut" 100 "DFC_ComEPS1Chksum" 101 "DFC_ComEPS1RingCnt" 102 "DFC_ComEPS1TOut" 449 "DFC_ComEPSUnit" 104 "DFC_ComGrvySnsrErr" 105 "DFC_ComGwIMG1ChkSum" 106 "DFC_ComGwIMG1RingCnt" 107 "DFC_ComGwIMG1TOut" 108 "DFC_ComGwIMG3ChkSum" 109 "DFC_ComGwIMG3RingCnt" 110 "DFC_ComGwIMG3TOut" 111 "DFC_ComGwIMG4ChkSum" 112 "DFC_ComGwIMG4RingCnt" 113 "DFC_ComGwIMG4TOut" 114 "DFC_ComGwIMG5ChkSum" 115 "DFC_ComGwIMG5RingCnt" 116 "DFC_ComGwIMG5TOut" 117 "DFC_ComGwIMG6ChkSum" 118 "DFC_ComGwIMG6RingCnt" 119 "DFC_ComGwIMG6TOut" 120 "DFC_ComIDASBChksum" 121 "DFC_ComIDASBRingCnt" 122 "DFC_ComIDASBTOut" 450 "DFC_ComIDASBUnit" 123 "DFC_ComIMGMILReq" 451 "DFC_ComIMGUnit" 124 "DFC_ComISSPrms" 125 "DFC_ComMETAChksum" 126 "DFC_ComMETAChksumPstDrv" 127 "DFC_ComMETARingCnt" 128 "DFC_ComMETARingCntPstDrv" 129 "DFC_ComMETATOut" 130 "DFC_ComMETATOutPstDrv" 131 "DFC_ComMETCChksum" 132 "DFC_ComMETCRingCnt" 133 "DFC_ComMETCTOut" 134 "DFC_ComMETDChksum" 135 "DFC_ComMETDRingCnt" 136 "DFC_ComMETDTOut" 137 "DFC_ComMETE2Chksum" 138 "DFC_ComMETE2RingCnt" 139 "DFC_ComMETE2TOut" 140 "DFC_ComMETFChksum" 141 "DFC_ComMETFRingCnt" 142 "DFC_ComMETFTOut" 143 "DFC_ComMETGChksum" 144 "DFC_ComMETGRingCnt" 145 "DFC_ComMETGTOut" 146 "DFC_ComMETH2Chksum" 147 "DFC_ComMETH2RingCnt" 148 "DFC_ComMETH2TOut" 149 "DFC_ComMETHChksum" 150 "DFC_ComMETHRingCnt" 151 "DFC_ComMETHTOut" 152 "DFC_ComMETIChksum" 153 "DFC_ComMETIRingCnt" 154 "DFC_ComMETITOut" 155 "DFC_ComMETKChksum" 156 "DFC_ComMETKRingCnt" 157 "DFC_ComMETKTOut" 158 "DFC_ComMETLChksum" 159 "DFC_ComMETLRingCnt" 160 "DFC_ComMETLTOut" 161 "DFC_ComMETMChksum" 162 "DFC_ComMETMRingCnt" 163 "DFC_ComMETMTOut" 164 "DFC_ComMETNChksum" 165 "DFC_ComMETNRingCnt" 166 "DFC_ComMETNTOut" 452 "DFC_ComMETUnit" 167 "DFC_ComMtrCom" 168 "DFC_ComPCUChkSum" 169 "DFC_ComPCURingCnt" 170 "DFC_ComPCUTOut" 171 "DFC_ComSRSAChksum" 172 "DFC_ComSRSARingCnt" 173 "DFC_ComSRSATOut" 174 "DFC_ComSRSBChksum" 175 "DFC_ComSRSBRingCnt" 176 "DFC_ComSRSBTOut" 177 "DFC_ComSRSChksum" 178 "DFC_ComSRSErr" 179 "DFC_ComSRSRingCnt" 180 "DFC_ComSRSTOut" 453 "DFC_ComSRSUnit" 311 "DFC_ComTOutTCU01" 312 "DFC_ComTOutTCU02" 313 "DFC_ComTOutTCU1" 314 "DFC_ComTOutTCU11" 315 "DFC_ComTOutTCU12" 316 "DFC_ComTOutTCU13" 317 "DFC_ComTOutTCU14" 318 "DFC_ComTOutTCU2" 319 "DFC_ComTOutTCU3" 320 "DFC_ComTOutTCU4" 181 "DFC_ComVehSpdPndFltTCU" 454 "DFC_ComVSAUnit" 538 "DFC_DCDCFltDet" 321 "DFC_DevLibBattUHi" 322 "DFC_DevLibBattULo" 357 "DFC_DHFHD" 558 "DFC_DiagCpv1DteskLoLoadStuckClsd" 559 "DFC_DiagCpv1DteskLoLoadStuckOpen" 541 "DFC_DKnpl" 539 "DFC_DKRSA" 540 "DFC_DKVSmax" 542 "DFC_DSKVRmax" 543 "DFC_DSKVRmin" 544 "DFC_DSKVRnpl" 545 "DFC_DSKVRsig" 546 "DFC_DSKVSsig" 547 "DFC_DSSmax" 548 "DFC_DSTDmax" 549 "DFC_DSTEmax" 550 "DFC_DSTEmin" 551 "DFC_DSTOFmax" 552 "DFC_DSTRmax" 553 "DFC_DSTRmin" 554 "DFC_DSTRnpl" 555 "DFC_DSTRsig" 556 "DFC_DSTTI" 557 "DFC_DSUmax" 182 "DFC_EbsChartcCurrErr" 183 "DFC_EbsSelfDiagErr" 455 "DFC_EbsSocFlt" 395 "DFC_EGRVlvCurrLim" 560 "DFC_EGRVlvDrftClsd" 561 "DFC_EGRVlvDrftOpn" 323 "DFC_EGRVlvFailSafeActv" 324 "DFC_EGRVlvGovDvtCld" 562 "DFC_EGRVlvJamVlvClsd" 563 "DFC_EGRVlvJamVlvOpn" 396 "DFC_EGRVlvOL" 397 "DFC_EGRVlvOvrTemp" 325 "DFC_EGRVlvPhysSRCMax" 326 "DFC_EGRVlvPhysSRCMin" 398 "DFC_EGRVlvSCB" 399 "DFC_EGRVlvSCG" 564 "DFC_EGRVlvSprgBrk" 400 "DFC_EGRVlvSRCMax" 401 "DFC_EGRVlvSRCMin" 565 "DFC_EGRVlvTempMdlEEPErr" 566 "DFC_EGRVlvTmpErr" 567 "DFC_EGSDUS2B1LtrDly" 568 "DFC_EGSDUS2B1LtrPT1" 569 "DFC_EGSDUS2B1RtlDly" 570 "DFC_EGSDUS2B1RtlPT1" 571 "DFC_EGSDUS2B1TarLean" 572 "DFC_EGSDUS2B1TarRich" 586 "DFC_EngICO" 587 "DFC_EngPrtOvrSpdMon" 573 "DFC_EONVmax" 588 "DFC_EpmCaSI1ErrSig" 589 "DFC_EpmCaSI1MntErr" 590 "DFC_EpmCaSI1NoSigMax" 591 "DFC_EpmCaSI1NoSigMin" 592 "DFC_EpmCaSI1OfsErr" 593 "DFC_EpmCrSDGI" 594 "DFC_EpmCrSErrSig" 595 "DFC_EpmCrSNoSig" 596 "DFC_EtaEngIdleNonCsers" 597 "DFC_EtaEngPtlNonCsers" 574 "DFC_ETAKHLmax" 575 "DFC_ETAKHTmax" 576 "DFC_ETHSEmax" 577 "DFC_ETHSEmin" 578 "DFC_ETHSFmax" 579 "DFC_ETHSFmin" 580 "DFC_ETHSFsig" 581 "DFC_ETHSNPWmax" 582 "DFC_ETHSNPWmin" 583 "DFC_ETHSNPWsig" 584 "DFC_ETHSPLnpl" 585 "DFC_ETHSTPLnpl" 327 "DFC_FanDIOOL_0" 328 "DFC_FanDIOOL_1" 329 "DFC_FanDIOOvrTemp_0" 330 "DFC_FanDIOOvrTemp_1" 331 "DFC_FanDIOSCB_0" 332 "DFC_FanDIOSCB_1" 333 "DFC_FanDIOSCG_0" 334 "DFC_FanDIOSCG_1" 598 "DFC_FRAmax" 599 "DFC_FRAmin" 600 "DFC_FSTEmax" 601 "DFC_FSTEmin" 605 "DFC_FSTmax" 602 "DFC_FSTRmax" 603 "DFC_FSTRmin" 604 "DFC_FSTRnpl" 606 "DFC_FTDLAmax" 607 "DFC_FTDLAmin" 608 "DFC_FuPHiSnsrEleclmax" 609 "DFC_FuPHiSnsrEleclmin" 610 "DFC_FuPHiSnsrEleclnpl" 611 "DFC_FuPHiSnsrURngMax" 612 "DFC_FuPHiSnsrURngMin" 613 "DFC_FuSnsrPhyRngMaxErr" 614 "DFC_FuSnsrPhyRngMinErr" 188 "DFC_GbxCANDigPlausErr" 189 "DFC_GbxNPos1SRCMax" 190 "DFC_GbxNPos1SRCMin" 191 "DFC_GbxNPos2SRCMax" 192 "DFC_GbxNPos2SRCMin" 193 "DFC_GbxNPosAlvChk" 194 "DFC_GbxNPosSyncErr" 413 "DFC_GbxPNPosnDrvCdn" 414 "DFC_GbxPNPosnPlausy" 618 "DFC_GbxRvsSwtStk" 615 "DFC_GEVlvLockPinDiagIntkB1" 184 "DFC_GEVlvPhaCsersIntkB1" 185 "DFC_GEVlvPhaPsOpenLoadIntkB1" 186 "DFC_GEVlvPhaPsShoToBattIntkB1" 187 "DFC_GEVlvPhaPsShoToGndIntkB1" 616 "DFC_GEVlvPhaSlowIntkB1" 617 "DFC_GEVlvPhaTargIntkB1" 619 "DFC_HDRKHmax" 620 "DFC_HDRKHmin" 623 "DFC_HDRmax" 624 "DFC_HDRmin" 621 "DFC_HDRPLmax" 622 "DFC_HDRPLmin" 625 "DFC_HEGOS2B1ElecMax" 626 "DFC_HEGOS2B1ElecMin" 627 "DFC_HEGOS2B1ElecSig" 628 "DFC_HEGOS2B1HtgNpl" 195 "DFC_HEGOS2B1HtrPsMax" 196 "DFC_HEGOS2B1HtrPsMin" 197 "DFC_HEGOS2B1HtrPsSig" 629 "DFC_HEV00max" 630 "DFC_HEV01max" 631 "DFC_HEV02max" 632 "DFC_HEV03max" 633 "DFC_HEVE0max" 634 "DFC_HEVE1max" 635 "DFC_HFMmax" 636 "DFC_HiPSysHiPMaxLimExcdd" 402 "DFC_HLSDemOvhtEngLim" 456 "DFC_I14229VINErr" 261 "DFC_IgnClPs_DevComErr" 262 "DFC_IgnClPs_LineOl_0" 263 "DFC_IgnClPs_LineOl_1" 264 "DFC_IgnClPs_LineOl_2" 265 "DFC_IgnClPs_LineOl_3" 266 "DFC_IgnClPs_LineScb_0" 267 "DFC_IgnClPs_LineScb_1" 268 "DFC_IgnClPs_LineScb_2" 269 "DFC_IgnClPs_LineScb_3" 270 "DFC_IgnClPs_LineScg_0" 271 "DFC_IgnClPs_LineScg_1" 272 "DFC_IgnClPs_LineScg_2" 273 "DFC_IgnClPs_LineScg_3" 457 "DFC_InjCatHeatgErr" 458 "DFC_InjSysMulInjDiagErr" 358 "DFC_InjVlv_DI_DcDc" 359 "DFC_InjVlv_DI_NoLd_0" 360 "DFC_InjVlv_DI_NoLd_1" 361 "DFC_InjVlv_DI_NoLd_2" 362 "DFC_InjVlv_DI_NoLd_3" 363 "DFC_InjVlv_DI_ScBnk_0" 364 "DFC_InjVlv_DI_ScBnk_1" 365 "DFC_InjVlv_DI_ScBnk_2" 366 "DFC_InjVlv_DI_ScBnk_3" 367 "DFC_InjVlv_DI_ScCyl_0" 368 "DFC_InjVlv_DI_ScCyl_1" 369 "DFC_InjVlv_DI_ScCyl_2" 370 "DFC_InjVlv_DI_ScCyl_3" 371 "DFC_InjVlv_DI_ScHsLs_0" 372 "DFC_InjVlv_DI_ScHsLs_1" 373 "DFC_InjVlv_DI_ScHsLs_2" 374 "DFC_InjVlv_DI_ScHsLs_3" 652 "DFC_IntkAirTAirFltDsCrssMax" 653 "DFC_IntkAirTAirFltDsCrssMin" 654 "DFC_IntkAirTAirFltDsHSCMax" 655 "DFC_IntkAirTAirFltDsImps" 656 "DFC_IntkAirTAirFltDsPRCMax" 657 "DFC_IntkAirTAirFltDsPRCMin" 658 "DFC_IntkAirTAirFltDsSRCMax" 659 "DFC_IntkAirTAirFltDsSRCMin" 660 "DFC_IntkAirTAirFltDsSTC" 661 "DFC_IntkAirTIntkMnfldCrssMax" 662 "DFC_IntkAirTIntkMnfldCrssMin" 663 "DFC_IntkAirTIntkMnfldHSCMax" 664 "DFC_IntkAirTIntkMnfldImps" 665 "DFC_IntkAirTIntkMnfldPRCMax" 666 "DFC_IntkAirTIntkMnfldPRCMin" 667 "DFC_IntkAirTIntkMnfldSRCMax" 668 "DFC_IntkAirTIntkMnfldSRCMin" 669 "DFC_IntkAirTIntkMnfldSTC" 647 "DFC_IVGdiCtl_CvoErr" 648 "DFC_IVGdiCtl_CvoSigPlaus_0" 649 "DFC_IVGdiCtl_CvoSigPlaus_1" 650 "DFC_IVGdiCtl_CvoSigPlaus_2" 651 "DFC_IVGdiCtl_CvoSigPlaus_3" 637 "DFC_IVGdiCtlCvoErrMax_0" 638 "DFC_IVGdiCtlCvoErrMax_1" 639 "DFC_IVGdiCtlCvoErrMax_2" 640 "DFC_IVGdiCtlCvoErrMax_3" 641 "DFC_IVGdiCtlCvoErrMin_0" 642 "DFC_IVGdiCtlCvoErrMin_1" 643 "DFC_IVGdiCtlCvoErrMin_2" 644 "DFC_IVGdiCtlCvoErrMin_3" 645 "DFC_IVGdiCtlCvoErrMinMax" 646 "DFC_IVGdiCtlCvoSigPlausErrSmrCdn" 428 "DFC_KnDetSens1PortAMax" 429 "DFC_KnDetSens1PortAMin" 430 "DFC_KnDetSens1PortBMax" 431 "DFC_KnDetSens1PortBMin" 670 "DFC_KRREGRLMX" 671 "DFC_KRVEKOCVLCI" 672 "DFC_KRVEKOENCHMT" 673 "DFC_KRVEKOENCHMT0" 674 "DFC_KRVEKOENCHMT1" 675 "DFC_KRVEKOENCHMT2" 676 "DFC_KRVEKOENCHMT3" 677 "DFC_KRVEKOENCHMT4" 678 "DFC_KRVEKOENCHMT5" 679 "DFC_KRVEKOENCHMT6" 680 "DFC_KRVEKOENCHMT7" 274 "DFC_KRVEKOEVAB" 275 "DFC_KRVEKOEVAB0" 276 "DFC_KRVEKOEVAB1" 277 "DFC_KRVEKOEVAB2" 278 "DFC_KRVEKOEVAB3" 681 "DFC_KRVEKORLMX" 682 "DFC_KRVEKORLMXL" 683 "DFC_KS1max" 684 "DFC_KS1min" 687 "DFC_LamDynDiagS1B1" 688 "DFC_LeakIntkMnfldEmiInfl" 491 "DFC_LIN_E_TIMEOUT" 465 "DFC_LinACGUnit" 466 "DFC_LinAEVUnit" 198 "DFC_LinCSErrACG" 199 "DFC_LinCSErrAEV" 200 "DFC_LinCSErrDCDC" 201 "DFC_LinCSErrEBS" 467 "DFC_LinEBSUnit" 689 "DFC_LinFrameErrDCDC" 202 "DFC_LinHdrTimeoutErrACG" 203 "DFC_LinHdrTimeoutErrAEV" 204 "DFC_LinHdrTimeoutErrDCDC" 205 "DFC_LinHdrTimeoutErrEBS" 206 "DFC_LinMsgTimeoutErrACG" 207 "DFC_LinMsgTimeoutErrAEV" 208 "DFC_LinMsgTimeoutErrDCDC" 209 "DFC_LinMsgTimeoutErrEBS" 210 "DFC_LinNoStrtComErr" 690 "DFC_LinOverrunErrDCDC" 459 "DFC_LLRHmax" 460 "DFC_LLRHmin" 461 "DFC_LLRHnpl" 462 "DFC_LLRKHmax" 463 "DFC_LLRKHmin" 464 "DFC_LLRKHnpl" 685 "DFC_LMmax" 211 "DFC_LowPresOilP" 686 "DFC_LZSRnpl" 691 "DFC_MD00max" 692 "DFC_MDBmax" 693 "DFC_MDCat" 694 "DFC_MDCatCrit" 695 "DFC_MDCatCurr" 696 "DFC_MDCyl_0" 697 "DFC_MDCyl_1" 698 "DFC_MDCyl_2" 699 "DFC_MDCyl_3" 700 "DFC_MDEmi" 701 "DFC_MDEmiStrt" 702 "DFC_MDFco" 705 "DFC_MDmax" 703 "DFC_MDMpl" 704 "DFC_MDSegTiAdpn" 375 "DFC_MfPsDiaOpenLoad1" 376 "DFC_MfPsDiaScHiS1" 377 "DFC_MfPsDiaScHiSLowS1" 378 "DFC_MfPsDiaScLowS1" 706 "DFC_MFuOilMax" 228 "DFC_MisfDetdVWhlFrntLePlaus" 229 "DFC_MisfDetdVWhlFrntRiPlaus" 230 "DFC_MisfDetdVWhlReLePlaus" 231 "DFC_MisfDetdVWhlReRiPlaus" 212 "DFC_MisfDetVWhlFrntLeOORHi" 213 "DFC_MisfDetVWhlFrntLeRatyHi" 214 "DFC_MisfDetVWhlFrntLeRatyLo" 215 "DFC_MisfDetVWhlFrntLeStuck" 216 "DFC_MisfDetVWhlFrntRiOORHi" 217 "DFC_MisfDetVWhlFrntRiRatyHi" 218 "DFC_MisfDetVWhlFrntRiRatyLo" 219 "DFC_MisfDetVWhlFrntRiStuck" 220 "DFC_MisfDetVWhlReLeOORHi" 221 "DFC_MisfDetVWhlReLeRatyHi" 222 "DFC_MisfDetVWhlReLeRatyLo" 223 "DFC_MisfDetVWhlReLeStuck" 224 "DFC_MisfDetVWhlReRiOORHi" 225 "DFC_MisfDetVWhlReRiRatyHi" 226 "DFC_MisfDetVWhlReRiRatyLo" 227 "DFC_MisfDetVWhlReRiStuck" 801 "DFC_MoCADCNTP" 802 "DFC_MoCADCTst" 803 "DFC_MoCSOPICO" 805 "DFC_MoFAirFilgPrdc" 806 "DFC_MoFAirFlCtOffGdi" 807 "DFC_MoFAirFlCylGdi" 808 "DFC_MoFAirFlFF" 809 "DFC_MoFAirFlIn" 810 "DFC_MoFAirFlMixCtlGdiChkAirFl" 811 "DFC_MoFAirFlMixCtlGdiChkCtrl" 812 "DFC_MoFAirFlMode" 804 "DFC_MoFAPP" 813 "DFC_MoFESpd" 814 "DFC_MoFIACo" 815 "DFC_MoFICOL1" 816 "DFC_MoFICOL2" 817 "DFC_MoFStrt" 818 "DFC_MoFTrqCmp" 819 "DFC_MoFTrqCmpMax" 820 "DFC_MoFTrqCmpMin" 821 "DFC_MoFVarPostBldSel" 707 "DFC_MOXEMM_SMU_ALM0_0" 708 "DFC_MOXEMM_SMU_ALM0_1" 709 "DFC_MOXEMM_SMU_ALM0_10" 710 "DFC_MOXEMM_SMU_ALM0_11" 711 "DFC_MOXEMM_SMU_ALM0_13" 712 "DFC_MOXEMM_SMU_ALM0_14" 713 "DFC_MOXEMM_SMU_ALM0_2" 714 "DFC_MOXEMM_SMU_ALM0_22" 715 "DFC_MOXEMM_SMU_ALM0_23" 716 "DFC_MOXEMM_SMU_ALM0_4" 717 "DFC_MOXEMM_SMU_ALM0_5" 718 "DFC_MOXEMM_SMU_ALM0_7" 719 "DFC_MOXEMM_SMU_ALM0_8" 720 "DFC_MOXEMM_SMU_ALM10_16" 721 "DFC_MOXEMM_SMU_ALM10_17" 722 "DFC_MOXEMM_SMU_ALM10_21" 723 "DFC_MOXEMM_SMU_ALM11_0" 724 "DFC_MOXEMM_SMU_ALM11_1" 725 "DFC_MOXEMM_SMU_ALM11_2" 726 "DFC_MOXEMM_SMU_ALM11_3" 727 "DFC_MOXEMM_SMU_ALM11_4" 728 "DFC_MOXEMM_SMU_ALM11_5" 729 "DFC_MOXEMM_SMU_ALM11_8" 730 "DFC_MOXEMM_SMU_ALM11_9" 731 "DFC_MOXEMM_SMU_ALM1_0" 732 "DFC_MOXEMM_SMU_ALM1_1" 733 "DFC_MOXEMM_SMU_ALM1_10" 734 "DFC_MOXEMM_SMU_ALM1_11" 735 "DFC_MOXEMM_SMU_ALM1_13" 736 "DFC_MOXEMM_SMU_ALM1_14" 737 "DFC_MOXEMM_SMU_ALM1_2" 738 "DFC_MOXEMM_SMU_ALM1_22" 739 "DFC_MOXEMM_SMU_ALM1_23" 740 "DFC_MOXEMM_SMU_ALM1_4" 741 "DFC_MOXEMM_SMU_ALM1_5" 742 "DFC_MOXEMM_SMU_ALM1_7" 743 "DFC_MOXEMM_SMU_ALM1_8" 744 "DFC_MOXEMM_SMU_ALM21_0" 745 "DFC_MOXEMM_SMU_ALM21_16" 746 "DFC_MOXEMM_SMU_ALM21_3" 747 "DFC_MOXEMM_SMU_ALM2_1" 748 "DFC_MOXEMM_SMU_ALM2_10" 749 "DFC_MOXEMM_SMU_ALM2_11" 750 "DFC_MOXEMM_SMU_ALM2_13" 751 "DFC_MOXEMM_SMU_ALM2_14" 752 "DFC_MOXEMM_SMU_ALM2_22" 753 "DFC_MOXEMM_SMU_ALM2_23" 754 "DFC_MOXEMM_SMU_ALM2_4" 755 "DFC_MOXEMM_SMU_ALM2_5" 756 "DFC_MOXEMM_SMU_ALM2_7" 757 "DFC_MOXEMM_SMU_ALM2_8" 758 "DFC_MOXEMM_SMU_ALM6_0" 759 "DFC_MOXEMM_SMU_ALM6_11" 760 "DFC_MOXEMM_SMU_ALM6_12" 761 "DFC_MOXEMM_SMU_ALM6_14" 762 "DFC_MOXEMM_SMU_ALM6_15" 763 "DFC_MOXEMM_SMU_ALM6_17" 764 "DFC_MOXEMM_SMU_ALM6_18" 765 "DFC_MOXEMM_SMU_ALM6_20" 766 "DFC_MOXEMM_SMU_ALM6_21" 767 "DFC_MOXEMM_SMU_ALM6_25" 768 "DFC_MOXEMM_SMU_ALM6_4" 769 "DFC_MOXEMM_SMU_ALM6_5" 770 "DFC_MOXEMM_SMU_ALM6_7" 771 "DFC_MOXEMM_SMU_ALM6_8" 772 "DFC_MOXEMM_SMU_ALM7_1" 773 "DFC_MOXEMM_SMU_ALM7_12" 774 "DFC_MOXEMM_SMU_ALM7_13" 775 "DFC_MOXEMM_SMU_ALM7_14" 776 "DFC_MOXEMM_SMU_ALM7_15" 777 "DFC_MOXEMM_SMU_ALM7_16" 778 "DFC_MOXEMM_SMU_ALM7_17" 779 "DFC_MOXEMM_SMU_ALM7_2" 780 "DFC_MOXEMM_SMU_ALM7_20" 781 "DFC_MOXEMM_SMU_ALM7_25" 782 "DFC_MOXEMM_SMU_ALM7_26" 783 "DFC_MOXEMM_SMU_ALM7_28" 784 "DFC_MOXEMM_SMU_ALM7_29" 785 "DFC_MOXEMM_SMU_ALM7_30" 786 "DFC_MOXEMM_SMU_ALM7_31" 787 "DFC_MOXEMM_SMU_ALM8_0" 788 "DFC_MOXEMM_SMU_ALM8_1" 789 "DFC_MOXEMM_SMU_ALM8_10" 790 "DFC_MOXEMM_SMU_ALM8_11" 791 "DFC_MOXEMM_SMU_ALM8_12" 792 "DFC_MOXEMM_SMU_ALM8_16" 793 "DFC_MOXEMM_SMU_ALM8_18" 794 "DFC_MOXEMM_SMU_ALM8_2" 795 "DFC_MOXEMM_SMU_ALM8_3" 796 "DFC_MOXEMM_SMU_ALM8_31" 797 "DFC_MOXEMM_SMU_ALM8_4" 798 "DFC_MOXEMM_SMU_ALM9_0" 799 "DFC_MOXEMM_SMU_ALM9_15" 800 "DFC_MOXEMM_SMU_ALM9_3" 822 "DFC_MoXEMMHwLTMCUFW" 823 "DFC_MoXEMMHwLTMonBIST" 824 "DFC_MoXEMMHwLTRegMonTest" 825 "DFC_MoXEMMHwLTStbySMUAlvTest" 826 "DFC_MoXEMMHwLTTempSens" 827 "DFC_MoXEMMHwLTUCBCfg" 335 "DFC_MRlyDcOL" 336 "DFC_MRlyDcSCB" 337 "DFC_MRlyDcSCG" 492 "DFC_MRlyOL" 493 "DFC_MRlySCB" 494 "DFC_MRlySCG" 828 "DFC_NWSEmax" 829 "DFC_NWSmax" 830 "DFC_OCWDAABEActv" 831 "DFC_OCWDACom" 832 "DFC_OCWDAErrPin" 833 "DFC_OCWDAOvrVltg" 836 "DFC_OilPPlaus" 403 "DFC_OilPSwmpSRCMax" 404 "DFC_OilPSwmpSRCMin" 834 "DFC_ORAmax" 835 "DFC_ORAmin" 847 "DFC_P_VSE11_OL" 848 "DFC_P_VSE11_SCB" 849 "DFC_P_VSE11_SCG" 417 "DFC_PEnvCcMax" 418 "DFC_PEnvCcMin" 419 "DFC_PEnvRngChkMax" 420 "DFC_PEnvRngChkMin" 232 "DFC_PEnvSigRngMax" 233 "DFC_PEnvSigRngMin" 421 "DFC_PEnvSnsrPlaus" 850 "DFC_PhyHighAPP1" 851 "DFC_PhyHighAPP2" 852 "DFC_PhyLowAPP1" 853 "DFC_PhyLowAPP2" 405 "DFC_PIntkVUsLineHiB1" 406 "DFC_PIntkVUsLineLoB1" 837 "DFC_PLLSUmax" 838 "DFC_PLLSUmin" 338 "DFC_PSPOL" 339 "DFC_PSPOvrTemp" 340 "DFC_PSPSCB" 341 "DFC_PSPSCG" 839 "DFC_PSR1max" 840 "DFC_PSRBmax" 841 "DFC_PSRBmin" 845 "DFC_PSRmax" 842 "DFC_PSRPmax" 843 "DFC_PSRPmin" 844 "DFC_PSRPsig" 846 "DFC_PUmax" 475 "DFC_RBA_IODIAGPWR_rba_IoExtCy329_SignalVltSply_0" 476 "DFC_RBA_IODIAGPWR_rba_IoExtCy329_SignalVltSply_0OT" 477 "DFC_RBA_IODIAGPWR_rba_IoExtCy329_SignalVltSply_0OV" 478 "DFC_RBA_IODIAGPWR_rba_IoExtCy329_SignalVltSply_0SCG" 479 "DFC_RBA_IODIAGPWR_rba_IoExtCy329_SignalVltSply_0UV" 480 "DFC_RBA_IODIAGPWR_rba_IoExtCy329_SignalVltSply_1" 481 "DFC_RBA_IODIAGPWR_rba_IoExtCy329_SignalVltSply_1OT" 482 "DFC_RBA_IODIAGPWR_rba_IoExtCy329_SignalVltSply_1OV" 483 "DFC_RBA_IODIAGPWR_rba_IoExtCy329_SignalVltSply_1SCG" 484 "DFC_RBA_IODIAGPWR_rba_IoExtCy329_SignalVltSply_1UV" 485 "DFC_RBA_IODIAGPWR_rba_IoExtCy329_SignalVltSply_2" 486 "DFC_RBA_IODIAGPWR_rba_IoExtCy329_SignalVltSply_2OT" 487 "DFC_RBA_IODIAGPWR_rba_IoExtCy329_SignalVltSply_2OV" 488 "DFC_RBA_IODIAGPWR_rba_IoExtCy329_SignalVltSply_2SCG" 489 "DFC_RBA_IODIAGPWR_rba_IoExtCy329_SignalVltSply_2UV" 498 "DFC_RBA_IOEXTLIB_KEEPALIVE_DRV" 499 "DFC_RBA_IOEXTLIB_KEEPALIVE_INI" 500 "DFC_rba_IoSigRtc_StopCounter" 502 "DFC_rba_MemDiag_MemReadErr" 503 "DFC_rba_MemDiag_MemWrErr" 501 "DFC_rba_MRly_Diag_Stk_Event" 495 "DFC_rba_MultiStackTrace_Threshold" 504 "DFC_rba_SyC_IrrSwOffTrigEngRun_Event" 505 "DFC_rba_T15_Diag_ComInVld_Event" 506 "DFC_rba_T15_Diag_ComOff_HwOn_Event" 507 "DFC_rba_T15_Diag_ComOn_HwOff_Event" 468 "DFC_RoughRoad" 469 "DFC_SiaEEPRdErr" 470 "DFC_SiaEEPWrngCod" 854 "DFC_SRCHighAPP1" 855 "DFC_SRCHighAPP2" 856 "DFC_SRCLowAPP1" 857 "DFC_SRCLowAPP2" 858 "DFC_SSpMon2" 859 "DFC_STHDRmax" 234 "DFC_StmFault" 236 "DFC_StrtCtlErr" 235 "DFC_StrtCtOffPth" 237 "DFC_StrtFault" 238 "DFC_StrtLckJudg1" 239 "DFC_StrtLckJudg2" 240 "DFC_StrtOL" 241 "DFC_StrtOL2" 242 "DFC_StrtSCB" 243 "DFC_StrtSCB2" 244 "DFC_StrtSCG" 245 "DFC_StrtSCG2" 246 "DFC_StrtStkRly1" 247 "DFC_StrtStkRly2" 860 "DFC_SWReset_0" 861 "DFC_SWReset_1" 862 "DFC_SWReset_2" 863 "DFC_SyncAPP" 342 "DFC_T50Err" 865 "DFC_TAmax_Dummy" 864 "DFC_TANKLnpl" 866 "DFC_TESFmax" 867 "DFC_TESGmax" 248 "DFC_TEVEmax" 249 "DFC_TEVEmin" 250 "DFC_TEVEsig" 875 "DFC_ThrVlvClsdPosnFirstOffsLrnImpoB1" 876 "DFC_ThrVlvClsdPosnOffsLrnImpoB1" 877 "DFC_ThrVlvClsdPosnOffsLrnMaxB1" 878 "DFC_ThrVlvClsdPosnOffsLrnMinB1" 879 "DFC_ThrVlvCtrlDeB1" 880 "DFC_ThrVlvDycB1" 881 "DFC_ThrVlvLimpAirPosnMaxAbsltDriftB1" 882 "DFC_ThrVlvLimpAirPosnMaxB1" 883 "DFC_ThrVlvLimpAirPosnMaxRelDriftB1" 884 "DFC_ThrVlvLimpAirPosnMinB1" 343 "DFC_ThrVlvLoBattB1" 885 "DFC_ThrVlvOpenLoadB1" 886 "DFC_ThrVlvOpenSprgB1" 887 "DFC_ThrVlvOpenSprgSprdB1" 888 "DFC_ThrVlvOpenSprgTwnB1" 889 "DFC_ThrVlvOverTB1" 890 "DFC_ThrVlvRetSprgB1" 891 "DFC_ThrVlvRetSprgSprdB1" 892 "DFC_ThrVlvRetSprgTwnB1" 893 "DFC_ThrVlvSens1MaxB1" 900 "DFC_ThrvlvSens1MinB1" 894 "DFC_ThrVlvSens1NplB1" 895 "DFC_ThrVlvSens2MaxB1" 896 "DFC_ThrVlvSens2MinB1" 897 "DFC_ThrVlvSens2NplB1" 898 "DFC_ThrVlvShoCircB1" 899 "DFC_ThrVlvSpiErrB1" 901 "DFC_TiOffTBasdChkFast" 902 "DFC_TiOffTBasdChkSlow" 868 "DFC_TKAEmax" 869 "DFC_TKAEmin" 870 "DFC_TKARmax" 871 "DFC_TKARnpl" 872 "DFC_TMmax_Dummy" 873 "DFC_TUMmax_Dummy" 874 "DFC_TWCDPriCatB1" 251 "DFC_UegoHeatrPrfmncLoS1B1" 422 "DFC_UEGOHeatrRlyPsOLS1B1" 423 "DFC_UEGOHeatrRlyPsSCBS1B1" 424 "DFC_UEGOHeatrRlyPsSCGS1B1" 471 "DFC_UegoHeatrStrtS1B1" 425 "DFC_UegoHeatrWireOlS1B1" 426 "DFC_UegoHeatrWireScbS1B1" 427 "DFC_UegoHeatrWireScgS1B1" 279 "DFC_UegoSigEcuAsicS1B1" 280 "DFC_UegoSigEcuComS1B1" 344 "DFC_UegoSigOperPlausS1B1" 281 "DFC_UegoSigSnsrS1B1" 282 "DFC_UegoSigWireOlApesS1B1" 283 "DFC_UegoSigWireOlIpeS1B1" 284 "DFC_UegoSigWireOlReS1B1" 285 "DFC_UegoSigWireRCmpS1B1" 286 "DFC_UegoSigWireScbS1B1" 287 "DFC_UegoSigWireScgS1B1" 903 "DFC_UEGOSnsrMntdS1B1" 252 "DFC_VehVAllPlaus" 253 "DFC_VehVNCSnsrElecFailr" 345 "DFC_VehVPhysRngHi" 407 "DFC_VehVPhysRngLo" 254 "DFC_VehVPlausCan" 255 "DFC_VehVPlausFco" 256 "DFC_VehVPlausPwr" 257 "DFC_VehVPlausV2N" 346 "DFC_VehVSclOutOL" 347 "DFC_VehVSclOutOT" 348 "DFC_VehVSclOutSCB" 349 "DFC_VehVSclOutSCG" 904 "DFC_VehVSig" 408 "DFC_VehVSigCan" 409 "DFC_VehVSigCanSafe" 350 "DFC_VehVSigFL" 351 "DFC_VehVSigFR" 352 "DFC_VehVSigRL" 353 "DFC_VehVSigRR" 354 "DFC_VehVSnsrARngHi" 355 "DFC_VehVSnsrBRngHi" 356 "DFC_VehVSpdRtyDiag" 258 "DFC_VehVSpdSnsrAElecFailr" 259 "DFC_VehVSpdSnsrBElecFailr" 410 "DFC_VlvLftFbOilPSnsrIntk11SRCMax" 411 "DFC_VlvLftFbOilPSnsrIntk11SRCMin" 905 "DFC_VlvLftFbSwtIntk11SpclFail" 906 "DFC_VlvLftFbSwtIntk11StdFail" DEFAULT_VALUE "---" /end COMPU_VTAB
/begin COMPU_METHOD DINH_OneToOne "" RAT_FUNC "%6.2" "-" COEFFS 0 1 0 0 0 1 /end COMPU_METHOD
/begin COMPU_METHOD DRIVE_AOBS_MODE "" TAB_VERB "%6.3" "" COMPU_TAB_REF DRIVE_AOBS_MODE /end COMPU_METHOD
/begin COMPU_VTAB DRIVE_AOBS_MODE "" TAB_VERB 2 0 "DRIVE_AOBS_DISABLE" 1 "DRIVE_AOBS_ENABLE" /end COMPU_VTAB
/begin COMPU_METHOD DRIVE_AOBS_stSet "" TAB_VERB "%6.3" "" COMPU_TAB_REF DRIVE_AOBS_stSet /end COMPU_METHOD
/begin COMPU_VTAB DRIVE_AOBS_stSet "" TAB_VERB 2 0 "DRIVE_AOBS_NOTSET" 1 "DRIVE_AOBS_SET" /end COMPU_VTAB
/begin COMPU_METHOD DRIVE_PRDS_BUFSTATTYPE "" TAB_VERB "%6.3" "" COMPU_TAB_REF DRIVE_PRDS_BUFSTATTYPE /end COMPU_METHOD
/begin COMPU_VTAB DRIVE_PRDS_BUFSTATTYPE "" TAB_VERB 3 0 "DRIVE_BUF_CLEAR" 1 "DRIVE_BUF_STOP" 2 "DRIVE_BUF_MEAS" /end COMPU_VTAB
/begin COMPU_METHOD DRIVE_PRDS_CLEARSTORETYPE "" TAB_VERB "%6.3" "" COMPU_TAB_REF DRIVE_PRDS_CLEARSTORETYPE /end COMPU_METHOD
/begin COMPU_VTAB DRIVE_PRDS_CLEARSTORETYPE "" TAB_VERB 3 0 "DRIVE_RETAIN_DATA" 1 "DRIVE_CLEAR_DATA" 2 "DRIVE_DISABLE_REC" /end COMPU_VTAB
/begin COMPU_METHOD DRIVE_PRDS_TRGMODETYPE "" TAB_VERB "%6.3" "" COMPU_TAB_REF DRIVE_PRDS_TRGMODETYPE /end COMPU_METHOD
/begin COMPU_VTAB DRIVE_PRDS_TRGMODETYPE "" TAB_VERB 3 0 "DRIVE_DIAG_DEV" 1 "DRIVE_DTC_STORE" 2 "DRIVE_ENG_STALL" /end COMPU_VTAB
/begin COMPU_METHOD DRIVE_PRDS_TRIGGERCODETYPE "" TAB_VERB "%6.3" "" COMPU_TAB_REF DRIVE_PRDS_TRIGGERCODETYPE /end COMPU_METHOD
/begin COMPU_VTAB DRIVE_PRDS_TRIGGERCODETYPE "" TAB_VERB 3 69649 "DRIVE_TRIGGER_ON" 1044735 "DRIVE_TRIGGER_OFF" 348245 "DRIVE_TRIGGER_DISABLE" /end COMPU_VTAB
/begin COMPU_METHOD EXHMGT_CATHEATGMEASCOORN_SC_Compu "" TAB_VERB "%6.3" "" COMPU_TAB_REF EXHMGT_CATHEATGMEASCOORN_SC_Compu /end COMPU_METHOD
/begin COMPU_VTAB EXHMGT_CATHEATGMEASCOORN_SC_Compu "" TAB_VERB 2 0 "False" 1 "True" /end COMPU_VTAB
/begin COMPU_METHOD EXHMGT_CMBENGDRVOFFDLYENA_SC_Compu "" TAB_VERB "%6.3" "" COMPU_TAB_REF EXHMGT_CMBENGDRVOFFDLYENA_SC_Compu /end COMPU_METHOD
/begin COMPU_VTAB EXHMGT_CMBENGDRVOFFDLYENA_SC_Compu "" TAB_VERB 2 0 "False" 1 "True" /end COMPU_VTAB
/begin COMPU_METHOD EXHMGT_COORNINDCCO_SC_Compu "" TAB_VERB "%6.3" "" COMPU_TAB_REF EXHMGT_COORNINDCCO_SC_Compu /end COMPU_METHOD
/begin COMPU_VTAB EXHMGT_COORNINDCCO_SC_Compu "" TAB_VERB 2 0 "False" 1 "True" /end COMPU_VTAB
/begin COMPU_METHOD EXHMGT_CORRNLAMCATHEATG_SC_Compu "" TAB_VERB "%6.3" "" COMPU_TAB_REF EXHMGT_CORRNLAMCATHEATG_SC_Compu /end COMPU_METHOD
/begin COMPU_VTAB EXHMGT_CORRNLAMCATHEATG_SC_Compu "" TAB_VERB 2 0 "False" 1 "True" /end COMPU_VTAB
/begin COMPU_METHOD EXHMGT_CORRNLAMSECAIRSYS_SC_Compu "" TAB_VERB "%6.3" "" COMPU_TAB_REF EXHMGT_CORRNLAMSECAIRSYS_SC_Compu /end COMPU_METHOD
/begin COMPU_VTAB EXHMGT_CORRNLAMSECAIRSYS_SC_Compu "" TAB_VERB 2 0 "False" 1 "True" /end COMPU_VTAB
/begin COMPU_METHOD OneToOne "" RAT_FUNC "%6.2" "-" COEFFS 0 1 0 0 0 1 /end COMPU_METHOD
/begin COMPU_METHOD Signals_IntSigNumVerb "" TAB_VERB "%6.3" "" COMPU_TAB_REF Signals_IntSigNumVerb /end COMPU_METHOD
/begin COMPU_VTAB Signals_IntSigNumVerb "" TAB_VERB 1169 0 "SIGNALS_Signals_Default" 1 "SIGNALS_APP_rUnFlt" 2 "SIGNALS_APP_r_sig" 3 "SIGNALS_APP_r_signal" 4 "SIGNALS_APP_uRaw1_signal" 5 "SIGNALS_APP_uRaw2_signal" 6 "SIGNALS_AbsLdCom8Bit_PID43h" 7 "SIGNALS_AccPed_tqMapBasd_BENG_signal" 8 "SIGNALS_AccPed_tqMapBasd_TRQB_signal" 9 "SIGNALS_ActMod_trqInr_signal" 10 "SIGNALS_AirC_uAnaRawClnt_signal" 11 "SIGNALS_Alt_iExctLim_signal" 12 "SIGNALS_Alt_rAltExct_signal" 13 "SIGNALS_Alt_uFinalDes_signal" 14 "SIGNALS_BattU_u" 15 "SIGNALS_BattU_uSens1_signal" 16 "SIGNALS_BattU_uSens2_s" 17 "SIGNALS_BattU_uSens_signal" 18 "SIGNALS_Batt_lMaxCnsChk_signal" 19 "SIGNALS_Batt_lMinCnsChk_signal" 20 "SIGNALS_Batt_qCnsChkAH_signal" 21 "SIGNALS_Brk_st" 22 "SIGNALS_Brk_stRed" 23 "SIGNALS_CEngDsT_uRaw_s" 24 "SIGNALS_CEngDsT_uRaw_signal" 25 "SIGNALS_CEngUsT_t_signal" 26 "SIGNALS_CEngUsT_uSnsr_s" 27 "SIGNALS_CoEng_tiCranking_signal" 28 "SIGNALS_CoVeh_trqAcs_s" 29 "SIGNALS_ComEBS_BattID_signal" 30 "SIGNALS_ComEBS_rBattSensCh_signal" 31 "SIGNALS_ComEBS_rBattStrat_signal" 32 "SIGNALS_ComEBS_uBattSens_signal" 33 "SIGNALS_ComEBS_uBattUCO_signal" 34 "SIGNALS_Com_iBattEBS_signal" 35 "SIGNALS_Com_lDst_signal" 36 "SIGNALS_Com_rMeasdBattREbs_signal" 37 "SIGNALS_Com_stI_signal" 38 "SIGNALS_Com_stT_signal" 39 "SIGNALS_Com_stU_signal" 40 "SIGNALS_Com_tBattEBS_signal" 41 "SIGNALS_Com_trqAYCFDes_signal" 42 "SIGNALS_Com_uPeak_signal" 43 "SIGNALS_CrCtl_stShutOffCode0_signal" 44 "SIGNALS_CrCtl_stShutOffCode1_signal" 45 "SIGNALS_CrCtl_stShutOffCode2_signal" 46 "SIGNALS_CrCtl_stShutOffCode3_signal" 47 "SIGNALS_CrCtl_stShutOffCode4_signal" 48 "SIGNALS_CrCtl_stShutOffCode5_signal" 49 "SIGNALS_CrCtl_stShutOffCode6_signal" 50 "SIGNALS_CrCtl_stShutOffCode7_signal" 51 "SIGNALS_CrCtl_stShutOffCode8_signal" 52 "SIGNALS_CrCtl_stShutOffCode9_signal" 53 "SIGNALS_DIUMPR_ctGenDenom_signal" 54 "SIGNALS_DIUMPR_ctIgn_signal" 55 "SIGNALS_DRIVE_numDTCFrz_s" 56 "SIGNALS_DRIVE_stCurTrgMode_signal" 57 "SIGNALS_DRIVE_stHardToStrt_s" 58 "SIGNALS_DSM_tiMICumCont" 59 "SIGNALS_DcmDspUDS_rdbi_2612Byte10_signal" 60 "SIGNALS_DcmDspUDS_rdbi_2612Byte11_signal" 61 "SIGNALS_DcmDspUDS_rdbi_fixed_signal" 62 "SIGNALS_DcmDspUDS_rdbi_reserved0_signal_s" 63 "SIGNALS_DcmDspUDS_rdbi_reserved0_signal_w_s" 64 "SIGNALS_DcmDspUDS_rdbi_reserved1_signal" 65 "SIGNALS_Dspl_stCrsSwtInfo_signal" 66 "SIGNALS_Ebs_qBliChrg_signal" 67 "SIGNALS_Ebs_qBliDchaTotDcyc_0_signal" 68 "SIGNALS_Ebs_qBliDchaTotDcyc_1_signal" 69 "SIGNALS_Ebs_qBliDchaTotDcyc_2_signal" 70 "SIGNALS_Ebs_qBliDchaTotDcyc_3_signal" 71 "SIGNALS_Ebs_qBliDchaTotDcyc_4_signal" 72 "SIGNALS_Ebs_qBliDcha_signal" 73 "SIGNALS_Ebs_stStbIEBSByt0_0_signal" 74 "SIGNALS_Ebs_stStbIEBSByt0_1_signal" 75 "SIGNALS_Ebs_stStbIEBSByt0_2_signal" 76 "SIGNALS_Ebs_stStbIEBSByt0_3_signal" 77 "SIGNALS_Ebs_stStbIEBSByt0_4_signal" 78 "SIGNALS_Ebs_stStbIEBSByt1_0_signal" 79 "SIGNALS_Ebs_stStbIEBSByt1_1_signal" 80 "SIGNALS_Ebs_stStbIEBSByt1_2_signal" 81 "SIGNALS_Ebs_stStbIEBSByt1_3_signal" 82 "SIGNALS_Ebs_stStbIEBSByt1_4_signal" 83 "SIGNALS_Ebs_stStbIEBSByt2_0_signal" 84 "SIGNALS_Ebs_stStbIEBSByt2_1_signal" 85 "SIGNALS_Ebs_stStbIEBSByt2_2_signal" 86 "SIGNALS_Ebs_stStbIEBSByt2_3_signal" 87 "SIGNALS_Ebs_stStbIEBSByt2_4_signal" 88 "SIGNALS_Ebs_stStbIEBSByt3_0_signal" 89 "SIGNALS_Ebs_stStbIEBSByt3_1_signal" 90 "SIGNALS_Ebs_stStbIEBSByt3_2_signal" 91 "SIGNALS_Ebs_stStbIEBSByt3_3_signal" 92 "SIGNALS_Ebs_stStbIEBSByt3_4_signal" 93 "SIGNALS_Ebs_stStbIEBSByt4_0_signal" 94 "SIGNALS_Ebs_stStbIEBSByt4_1_signal" 95 "SIGNALS_Ebs_stStbIEBSByt4_2_signal" 96 "SIGNALS_Ebs_stStbIEBSByt4_3_signal" 97 "SIGNALS_Ebs_stStbIEBSByt4_4_signal" 98 "SIGNALS_EngTrqPtd_trqLead_s" 99 "SIGNALS_EngTrqPtd_trqLead_signal" 100 "SIGNALS_EngTrqPtd_trqSet_s" 101 "SIGNALS_EngTrqPtd_trqSet_signal" 102 "SIGNALS_EpmCaS_ctErrSig_signal" 103 "SIGNALS_EpmCaS_ctNoSig_signal" 104 "SIGNALS_EpmCaS_phiDiffCal2AdapEqAvg_0" 105 "SIGNALS_EpmCaS_phiOfsCorr" 106 "SIGNALS_Epm_nEngAct" 107 "SIGNALS_Epm_nEngRaw_s" 108 "SIGNALS_Epm_nEngRaw_signal" 109 "SIGNALS_Epm_stOpMode" 110 "SIGNALS_Epm_stSync" 111 "SIGNALS_FuPHi_uHiResl_signal" 112 "SIGNALS_GEVlv_ratPhaIntkB1_signal" 113 "SIGNALS_GlbDa_lenTotDstDcycHiResl_signal" 114 "SIGNALS_HEGO_uS2B1Extd_s" 115 "SIGNALS_HEGO_uS2B1HiRes_signal" 116 "SIGNALS_I14229CoEng_tiNormalOBDPrevDcyc_s" 117 "SIGNALS_I14229EpmCaS_ctErrSig1_signal" 118 "SIGNALS_I14229EpmCaS_ctNoSig1_signal" 119 "SIGNALS_I14229GlbDa_lTotDstDCHiReslPrevDcyc_s" 120 "SIGNALS_I14229IntkAirT_tSnsrTstrMax_s" 121 "SIGNALS_I14229IntkAirT_tSnsrTstrMin_s" 122 "SIGNALS_I14229RDBI_nOvrSpd_signal" 123 "SIGNALS_I14229RDBI_tiOvrSpd_signal" 124 "SIGNALS_I14229_AirC_pAnaClnt_signal" 125 "SIGNALS_I14229_ElecLd_iEPSLoadOnly_signal" 126 "SIGNALS_I14229_EpmCaS_ctErrSig2_signal" 127 "SIGNALS_I14229_EpmCaS_ctNoSig2_signal" 128 "SIGNALS_I14229_EpmCrS_ctCaSRev_signal" 129 "SIGNALS_I14229_EpmCrS_ctErrSig_signal" 130 "SIGNALS_I14229_GEVCtl_agMaxAdpdIntk_signal" 131 "SIGNALS_I14229_Gbx_uAna1NPosRaw_signal" 132 "SIGNALS_I14229_Gbx_uAna2NPosRaw_signal" 133 "SIGNALS_I14229_ivzabg_w_signal" 134 "SIGNALS_I14229_lDst_signal" 135 "SIGNALS_I14229_nstat_signal" 136 "SIGNALS_I14229_numDTCFrzFrmHi_signal" 137 "SIGNALS_I14229_numDTCFrzFrmLo_signal" 138 "SIGNALS_I14229_numDTCFrzFrmMid_signal" 139 "SIGNALS_I14229_ps_w_signal" 140 "SIGNALS_I14229_rTrqPT_signal" 141 "SIGNALS_I14229_stTURBODV_signal" 142 "SIGNALS_I14229_tSnsrFild1_signal" 143 "SIGNALS_I14229_tiInj1On_signal" 144 "SIGNALS_I14229_tiOilFlowCompl_signal" 145 "SIGNALS_I14229_tiSia_signal" 146 "SIGNALS_I14229_tkaMax_s" 147 "SIGNALS_I14229_tkaMin_s" 148 "SIGNALS_I14229_tka_signal" 149 "SIGNALS_I14229_tmotMaxCurrDcyc_s" 150 "SIGNALS_I14229_tmotMaxPrevDcyc_s" 151 "SIGNALS_I14229_tmotMinCurrDcyc_s" 152 "SIGNALS_I14229_tmotMinPrevDcyc_s" 153 "SIGNALS_I14229_ubsq_signal" 154 "SIGNALS_I14229_umsrln_w_signal" 155 "SIGNALS_I14229_wdks_w_signal" 156 "SIGNALS_I14229_wped1_signal" 157 "SIGNALS_I14229_wped2_signal" 158 "SIGNALS_I14229_zwist_signal" 159 "SIGNALS_I14229iocpMDA_numABV_signal" 160 "SIGNALS_I14229iocpMDA_numACGC_signal" 161 "SIGNALS_I14229iocpMDA_numAPS_signal" 162 "SIGNALS_I14229iocpMDA_numPSC_signal" 163 "SIGNALS_I14229iocpMDA_numRFAN_signal" 164 "SIGNALS_I14229iocpMDA_numRvsLck_signal" 165 "SIGNALS_I14229iocpMDA_numVTEC_signal" 166 "SIGNALS_I14229iocp_numCtlSt_s" 167 "SIGNALS_I14229iocp_numEXE_signal" 168 "SIGNALS_I14229iocp_numREQ_s" 169 "SIGNALS_I14229iocp_stSFTRJC_s" 170 "SIGNALS_I15031_PID1Dh" 171 "SIGNALS_I15031_PID65Ah" 172 "SIGNALS_I15031_PID66Ah" 173 "SIGNALS_I15031_PID69Ah" 174 "SIGNALS_I15031_PID6AAh" 175 "SIGNALS_I15031_PID6BAh" 176 "SIGNALS_I15031_PID6CAh" 177 "SIGNALS_I15031_PID6DAh" 178 "SIGNALS_I15031_PID6EAh" 179 "SIGNALS_I15031_PID6FAh" 180 "SIGNALS_I15031_PID70Ah" 181 "SIGNALS_I15031_PID71Ah" 182 "SIGNALS_I15031_PID72Ah" 183 "SIGNALS_I15031_PID73Ah" 184 "SIGNALS_I15031_PID74Ah" 185 "SIGNALS_I15031_PID75Ah" 186 "SIGNALS_I15031_PID76Ah" 187 "SIGNALS_I15031_PID77Ah" 188 "SIGNALS_I15031_PID78Ah" 189 "SIGNALS_I15031_PID79Ah" 190 "SIGNALS_I15031_PID7AAh" 191 "SIGNALS_I15031_PID7BAh" 192 "SIGNALS_I15031_PID7CAh" 193 "SIGNALS_I15031_PID7FAh" 194 "SIGNALS_I15031_PID81Ah" 195 "SIGNALS_I15031_PID82Ah" 196 "SIGNALS_I15031_PID85Ah" 197 "SIGNALS_I15031_PID86Ah" 198 "SIGNALS_I15031_PID87Ah" 199 "SIGNALS_I15031_PID89Ah" 200 "SIGNALS_I15031_PID8AAh" 201 "SIGNALS_I15031_PID8FAh" 202 "SIGNALS_I15031_PID92Ah" 203 "SIGNALS_I15031_PID93Ah" 204 "SIGNALS_I15031_PID94Ah" 205 "SIGNALS_I15031_PID98Ah" 206 "SIGNALS_I15031_PID99Ah" 207 "SIGNALS_I15031_PID9CAh" 208 "SIGNALS_I15031_PIDA3Ah" 209 "SIGNALS_I15031_PIDA4Ah" 210 "SIGNALS_I15031_PIDA5Ah" 211 "SIGNALS_I15031_PIDA9Ah" 212 "SIGNALS_I15031_PIDACAh" 213 "SIGNALS_IKCtl_agKnkAvrg_s8_signal" 214 "SIGNALS_InjSys_volFuConsDrvCycCAN_s" 215 "SIGNALS_IntkAirT_tSnsr2_signal" 216 "SIGNALS_IntkAirT_uSnsr1Exprt_signal" 217 "SIGNALS_IntkAirT_uSnsr3CrssSwtLoc_s" 218 "SIGNALS_MoF_rTrqInrAct_s" 219 "SIGNALS_MoF_rTrqPtdFlt_s" 220 "SIGNALS_OBD_ITID_InjSys_volFuConsDrvgCycTstrSrv" 221 "SIGNALS_OilSwmpT_uSnsrRaw_s" 222 "SIGNALS_Oil_pSensPSwmp_signal" 223 "SIGNALS_Oil_uRawPSwmp_signal" 224 "SIGNALS_PID01h" 225 "SIGNALS_PID03h_0" 226 "SIGNALS_PID03h_1" 227 "SIGNALS_PID04h" 228 "SIGNALS_PID05h" 229 "SIGNALS_PID06h_0" 230 "SIGNALS_PID07h_0" 231 "SIGNALS_PID0Ch_Epm_nEng" 232 "SIGNALS_PID0D_VehV_vSens" 233 "SIGNALS_PID0Eh" 234 "SIGNALS_PID0Fh" 235 "SIGNALS_PID0bh_PIntkVUs_pRawObd" 236 "SIGNALS_PID10h" 237 "SIGNALS_PID11h_ThrVlv_ratActSens1AbsltB1_u8" 238 "SIGNALS_PID13h" 239 "SIGNALS_PID15h_0" 240 "SIGNALS_PID15h_1" 241 "SIGNALS_PID1Ch" 242 "SIGNALS_PID1Fh_TiScneEngStrt" 243 "SIGNALS_PID21h" 244 "SIGNALS_PID23h" 245 "SIGNALS_PID2Ch_EGRVlv_rCmdNrm" 246 "SIGNALS_PID2Dh_EGRVlv_rGovDvtNrm" 247 "SIGNALS_PID2Eh" 248 "SIGNALS_PID2Fh" 249 "SIGNALS_PID30h" 250 "SIGNALS_PID31h" 251 "SIGNALS_PID33h_PEnv_pRaw" 252 "SIGNALS_PID34h_0" 253 "SIGNALS_PID34h_1" 254 "SIGNALS_PID3Ch" 255 "SIGNALS_PID41h" 256 "SIGNALS_PID42_BattU_uSens" 257 "SIGNALS_PID43h" 258 "SIGNALS_PID44h" 259 "SIGNALS_PID45h_ThrVlv_ratActSens1RelB1_u8" 260 "SIGNALS_PID46h" 261 "SIGNALS_PID47h_ThrVlv_ratActSens2AbsltB1_u8" 262 "SIGNALS_PID49_APP_uRaw1unLim" 263 "SIGNALS_PID4A_APP_uRaw2unLim" 264 "SIGNALS_PID4Ch_wdks_msg" 265 "SIGNALS_PID4FAh" 266 "SIGNALS_PID4FBh" 267 "SIGNALS_PID4FCh" 268 "SIGNALS_PID4FDh" 269 "SIGNALS_PID50Ah" 270 "SIGNALS_PID50Bh" 271 "SIGNALS_PID50Ch" 272 "SIGNALS_PID50Dh" 273 "SIGNALS_PID51h_PID51_stFuTyp" 274 "SIGNALS_PID52h" 275 "SIGNALS_PID56h_0" 276 "SIGNALS_PID5A_APP_rOBDPID5A" 277 "SIGNALS_PID5Eh_InjSys_volEngFuCnsPerHr" 278 "SIGNALS_PID5Fh" 279 "SIGNALS_PID62h_TME_ratActEngPercTqPrmIdH62" 280 "SIGNALS_IntFloat_PID63h_TqEngRef" 281 "SIGNALS_PID67h_ects2sva_msg" 282 "SIGNALS_PID67h_ects2svb_msg" 283 "SIGNALS_PID67h_ects2svc_msg" 284 "SIGNALS_PID68h_iats2sva" 285 "SIGNALS_PID68h_iats2svb" 286 "SIGNALS_PID68h_iats2svc" 287 "SIGNALS_PID68h_iats2svd" 288 "SIGNALS_PID68h_iats2sve" 289 "SIGNALS_PID68h_iats2svf" 290 "SIGNALS_PID68h_iats2svg" 291 "SIGNALS_PID69h_EGRVlv_rActNrm" 292 "SIGNALS_PID69h_EGRVlv_rCmdNrm" 293 "SIGNALS_PID69h_EGRVlv_rGovDvtNrm" 294 "SIGNALS_PID7Fh_RTId_TotRt" 295 "SIGNALS_PID7Fh_RtId_TotIdleRt" 296 "SIGNALS_PID7Fh_RtId_TotPtoRt" 297 "SIGNALS_PID87h_PIntkVUs_pRawObd" 298 "SIGNALS_PID8BAh" 299 "SIGNALS_PID8CAh" 300 "SIGNALS_PID8Eh_TME_ratEngFricPercTqPrmIdH8E" 301 "SIGNALS_PID93BCh" 302 "SIGNALS_PID9AAh" 303 "SIGNALS_PID9Dh_InjSys_mfEngFuRate" 304 "SIGNALS_PID9Dh_InjSys_mfVehFuRate" 305 "SIGNALS_PID9FAh" 306 "SIGNALS_PIDA6h_lTotDst" 307 "SIGNALS_PID_FILLSIG_1BIT" 308 "SIGNALS_PID_FILLSIG_1BITNZ" 309 "SIGNALS_PID_FILLSIG_1BYTE" 310 "SIGNALS_PID_FILLSIG_1BYTENZ" 311 "SIGNALS_PID_FILLSIG_2BIT" 312 "SIGNALS_PID_FILLSIG_2BITNZ" 313 "SIGNALS_PID_FILLSIG_2BYTE" 314 "SIGNALS_PID_FILLSIG_2BYTENZ" 315 "SIGNALS_PID_FILLSIG_3BIT" 316 "SIGNALS_PID_FILLSIG_3BITNZ" 317 "SIGNALS_PID_FILLSIG_4BIT" 318 "SIGNALS_PID_FILLSIG_4BITNZ" 319 "SIGNALS_PID_FILLSIG_4BYTE" 320 "SIGNALS_PID_FILLSIG_4BYTENZ" 321 "SIGNALS_PID_FILLSIG_5BIT" 322 "SIGNALS_PID_FILLSIG_5BITNZ" 323 "SIGNALS_PID_FILLSIG_6BIT" 324 "SIGNALS_PID_FILLSIG_6BITNZ" 325 "SIGNALS_PID_FILLSIG_7BIT" 326 "SIGNALS_PID_FILLSIG_7BITNZ" 327 "SIGNALS_PIntkVUs_uRawUnFlt_signal" 328 "SIGNALS_PT_rGrip_signal" 329 "SIGNALS_PT_trqLos_signal" 330 "SIGNALS_PThrVlvUs_uRawB1_signal" 331 "SIGNALS_PthLead_trqInrNoMon_s" 332 "SIGNALS_PthLead_trqInrNoMon_signal" 333 "SIGNALS_PthSet_trqInrIABef_s" 334 "SIGNALS_PthSet_trqInrLtd_s" 335 "SIGNALS_RngMod_trqDiffAdap_signal" 336 "SIGNALS_RngMod_trqDiffAdap_signal_s" 337 "SIGNALS_RngMod_trqInrBs_s" 338 "SIGNALS_SIGNAL_GEVlv_agSumSpCsersDeIntkB1" 339 "SIGNALS_Strt_uStrtMonDia_signal" 340 "SIGNALS_TWCD_numMeasB1_s" 341 "SIGNALS_TWCD_rOSCAvrgPriB1_s" 342 "SIGNALS_TWCD_rOSCAvrgPriB1_signal" 343 "SIGNALS_ThrVlv_uRawSens1B1_signal" 344 "SIGNALS_ThrVlv_uRawSens2B1_signal" 345 "SIGNALS_TiEngOff_ti_s" 346 "SIGNALS_VehStc_lDstCityEco_signal" 347 "SIGNALS_VehStc_lDstCity_signal" 348 "SIGNALS_VehStc_lDstHighWayEco_signal" 349 "SIGNALS_VehStc_lDstHighWay_signal" 350 "SIGNALS_VehStc_numFuDiagRecA_0_s" 351 "SIGNALS_VehStc_numFuDiagRecA_10_s" 352 "SIGNALS_VehStc_numFuDiagRecA_11_s" 353 "SIGNALS_VehStc_numFuDiagRecA_12_s" 354 "SIGNALS_VehStc_numFuDiagRecA_13_s" 355 "SIGNALS_VehStc_numFuDiagRecA_14_s" 356 "SIGNALS_VehStc_numFuDiagRecA_15_s" 357 "SIGNALS_VehStc_numFuDiagRecA_16_s" 358 "SIGNALS_VehStc_numFuDiagRecA_17_s" 359 "SIGNALS_VehStc_numFuDiagRecA_18_s" 360 "SIGNALS_VehStc_numFuDiagRecA_19_s" 361 "SIGNALS_VehStc_numFuDiagRecA_1_s" 362 "SIGNALS_VehStc_numFuDiagRecA_20_s" 363 "SIGNALS_VehStc_numFuDiagRecA_2_s" 364 "SIGNALS_VehStc_numFuDiagRecA_3_s" 365 "SIGNALS_VehStc_numFuDiagRecA_4_s" 366 "SIGNALS_VehStc_numFuDiagRecA_5_s" 367 "SIGNALS_VehStc_numFuDiagRecA_6_s" 368 "SIGNALS_VehStc_numFuDiagRecA_7_s" 369 "SIGNALS_VehStc_numFuDiagRecA_8_s" 370 "SIGNALS_VehStc_numFuDiagRecA_9_s" 371 "SIGNALS_VehStc_numMisfDetnHiEctA_0_s" 372 "SIGNALS_VehStc_numMisfDetnHiEctA_10_s" 373 "SIGNALS_VehStc_numMisfDetnHiEctA_11_s" 374 "SIGNALS_VehStc_numMisfDetnHiEctA_12_s" 375 "SIGNALS_VehStc_numMisfDetnHiEctA_13_s" 376 "SIGNALS_VehStc_numMisfDetnHiEctA_14_s" 377 "SIGNALS_VehStc_numMisfDetnHiEctA_15_s" 378 "SIGNALS_VehStc_numMisfDetnHiEctA_16_s" 379 "SIGNALS_VehStc_numMisfDetnHiEctA_17_s" 380 "SIGNALS_VehStc_numMisfDetnHiEctA_18_s" 381 "SIGNALS_VehStc_numMisfDetnHiEctA_19_s" 382 "SIGNALS_VehStc_numMisfDetnHiEctA_1_s" 383 "SIGNALS_VehStc_numMisfDetnHiEctA_20_s" 384 "SIGNALS_VehStc_numMisfDetnHiEctA_2_s" 385 "SIGNALS_VehStc_numMisfDetnHiEctA_3_s" 386 "SIGNALS_VehStc_numMisfDetnHiEctA_4_s" 387 "SIGNALS_VehStc_numMisfDetnHiEctA_5_s" 388 "SIGNALS_VehStc_numMisfDetnHiEctA_6_s" 389 "SIGNALS_VehStc_numMisfDetnHiEctA_7_s" 390 "SIGNALS_VehStc_numMisfDetnHiEctA_8_s" 391 "SIGNALS_VehStc_numMisfDetnHiEctA_9_s" 392 "SIGNALS_VehStc_numMisfDetnLoEctA_0_s" 393 "SIGNALS_VehStc_numMisfDetnLoEctA_10_s" 394 "SIGNALS_VehStc_numMisfDetnLoEctA_11_s" 395 "SIGNALS_VehStc_numMisfDetnLoEctA_12_s" 396 "SIGNALS_VehStc_numMisfDetnLoEctA_13_s" 397 "SIGNALS_VehStc_numMisfDetnLoEctA_14_s" 398 "SIGNALS_VehStc_numMisfDetnLoEctA_15_s" 399 "SIGNALS_VehStc_numMisfDetnLoEctA_16_s" 400 "SIGNALS_VehStc_numMisfDetnLoEctA_17_s" 401 "SIGNALS_VehStc_numMisfDetnLoEctA_18_s" 402 "SIGNALS_VehStc_numMisfDetnLoEctA_19_s" 403 "SIGNALS_VehStc_numMisfDetnLoEctA_1_s" 404 "SIGNALS_VehStc_numMisfDetnLoEctA_20_s" 405 "SIGNALS_VehStc_numMisfDetnLoEctA_2_s" 406 "SIGNALS_VehStc_numMisfDetnLoEctA_3_s" 407 "SIGNALS_VehStc_numMisfDetnLoEctA_4_s" 408 "SIGNALS_VehStc_numMisfDetnLoEctA_5_s" 409 "SIGNALS_VehStc_numMisfDetnLoEctA_6_s" 410 "SIGNALS_VehStc_numMisfDetnLoEctA_7_s" 411 "SIGNALS_VehStc_numMisfDetnLoEctA_8_s" 412 "SIGNALS_VehStc_numMisfDetnLoEctA_9_s" 413 "SIGNALS_VehStc_numMisfDetnNormA_0_s" 414 "SIGNALS_VehStc_numMisfDetnNormA_10_s" 415 "SIGNALS_VehStc_numMisfDetnNormA_11_s" 416 "SIGNALS_VehStc_numMisfDetnNormA_12_s" 417 "SIGNALS_VehStc_numMisfDetnNormA_13_s" 418 "SIGNALS_VehStc_numMisfDetnNormA_14_s" 419 "SIGNALS_VehStc_numMisfDetnNormA_15_s" 420 "SIGNALS_VehStc_numMisfDetnNormA_16_s" 421 "SIGNALS_VehStc_numMisfDetnNormA_17_s" 422 "SIGNALS_VehStc_numMisfDetnNormA_18_s" 423 "SIGNALS_VehStc_numMisfDetnNormA_19_s" 424 "SIGNALS_VehStc_numMisfDetnNormA_1_s" 425 "SIGNALS_VehStc_numMisfDetnNormA_20_s" 426 "SIGNALS_VehStc_numMisfDetnNormA_2_s" 427 "SIGNALS_VehStc_numMisfDetnNormA_3_s" 428 "SIGNALS_VehStc_numMisfDetnNormA_4_s" 429 "SIGNALS_VehStc_numMisfDetnNormA_5_s" 430 "SIGNALS_VehStc_numMisfDetnNormA_6_s" 431 "SIGNALS_VehStc_numMisfDetnNormA_7_s" 432 "SIGNALS_VehStc_numMisfDetnNormA_8_s" 433 "SIGNALS_VehStc_numMisfDetnNormA_9_s" 434 "SIGNALS_VehStc_rDiagRsltB1A_0_s" 435 "SIGNALS_VehStc_rDiagRsltB1A_1_s" 436 "SIGNALS_VehStc_rDiagRsltB1A_2_s" 437 "SIGNALS_VehStc_rDiagRsltB1A_3_s" 438 "SIGNALS_VehStc_rDiagRsltB1A_4_s" 439 "SIGNALS_VehStc_tiRtCityEco_signal" 440 "SIGNALS_VehStc_tiRtCity_signal" 441 "SIGNALS_VehStc_tiRtHighWayEco_signal" 442 "SIGNALS_VehStc_tiRtHighWay_signal" 443 "SIGNALS_VehStc_tiRtStop_signal" 444 "SIGNALS_VehStc_volCnsCityDcyc_signal" 445 "SIGNALS_VehStc_volCnsCityEcoDcyc_signal" 446 "SIGNALS_VehStc_volCnsHighWayDcyc_signal" 447 "SIGNALS_VehStc_volCnsHighWayEcoDcyc_signal" 448 "SIGNALS_VehStc_volCnsStopDcyc_signal" 449 "SIGNALS_VehV_a" 450 "SIGNALS_VehV_v" 451 "SIGNALS_VehV_vSens_signal" 452 "SIGNALS_fra_w_msg_signal" 453 "SIGNALS_fra_w_s" 454 "SIGNALS_ftead_w_msg_s" 455 "SIGNALS_ftead_w_si" 456 "SIGNALS_ftead_w_signal" 457 "SIGNALS_i14229_agIntkB1GEVlv_2Byte_signal" 458 "SIGNALS_i14229_agIntkB1GEVlv_signal" 459 "SIGNALS_i14229_agSpIntkB1GevCtl_2Byte_signal" 460 "SIGNALS_i14229_agSpIntkB1GevCtl_signal" 461 "SIGNALS_lutskzyl_w_0_signal" 462 "SIGNALS_lutskzyl_w_1_signal" 463 "SIGNALS_lutskzyl_w_2_signal" 464 "SIGNALS_lutskzyl_w_3_signal" 465 "SIGNALS_lutskzyl_w_msg_0_signal" 466 "SIGNALS_mshfmst_w_signal" 467 "SIGNALS_ofmsndkh1_w_msg_signal" 468 "SIGNALS_ofmsndkh2_w_msg_signal" 469 "SIGNALS_prsoll_w_msg_s" 470 "SIGNALS_tateout_w_signal" 471 "SIGNALS_tatesoll_w_msg_signal" 472 "SIGNALS_thdev_msg_signal" 473 "SIGNALS_tmst_signal" 474 "SIGNALS_wkratst_signal" 475 "SIGNALS_PID83h_A_BitCombineSignal" 476 "SIGNALS_PID9Bh_A_BitCombineSignal" 477 "SIGNALS_PIDA1h_A_BitCombineSignal" 478 "SIGNALS_PIDA7h_A_BitCombineSignal" 479 "SIGNALS_PIDA8h_A_BitCombineSignal" 480 "SIGNALS_Virtual_DcmDspUDS_2600Byte06_signal" 481 "SIGNALS_Virtual_DcmDspUDS_2610Byte00_signal" 482 "SIGNALS_Virtual_DcmDspUDS_2610Byte01_signal" 483 "SIGNALS_Virtual_DcmDspUDS_2610Byte02_signal" 484 "SIGNALS_Virtual_DcmDspUDS_2610Byte03_signal" 485 "SIGNALS_Virtual_DcmDspUDS_2610Byte04_signal" 486 "SIGNALS_Virtual_DcmDspUDS_2610Byte05_signal" 487 "SIGNALS_Virtual_DcmDspUDS_2610Byte0D_signal" 488 "SIGNALS_Virtual_DcmDspUDS_2610Byte0F_signal" 489 "SIGNALS_Virtual_DcmDspUDS_2610Byte10_signal" 490 "SIGNALS_Virtual_DcmDspUDS_2610Byte1A_signal" 491 "SIGNALS_Virtual_DcmDspUDS_2610Byte1B_signal" 492 "SIGNALS_Virtual_DcmDspUDS_2610Byte1C_signal" 493 "SIGNALS_Virtual_DcmDspUDS_2610Byte1D_signal" 494 "SIGNALS_Virtual_DcmDspUDS_2610Byte1F_signal" 495 "SIGNALS_Virtual_DcmDspUDS_2610Byte20_signal" 496 "SIGNALS_Virtual_DcmDspUDS_2610Byte21_signal" 497 "SIGNALS_Virtual_DcmDspUDS_2610Byte22to23_signal" 498 "SIGNALS_Virtual_DcmDspUDS_2610Byte29_signal" 499 "SIGNALS_Virtual_DcmDspUDS_2610Byte2A_signal" 500 "SIGNALS_Virtual_DcmDspUDS_2611Byte00_signal" 501 "SIGNALS_Virtual_DcmDspUDS_2611Byte01_signal" 502 "SIGNALS_Virtual_DcmDspUDS_2611Byte02_signal" 503 "SIGNALS_Virtual_DcmDspUDS_2611Byte03_signal" 504 "SIGNALS_Virtual_DcmDspUDS_2611Byte04_signal" 505 "SIGNALS_Virtual_DcmDspUDS_2611Byte05_signal" 506 "SIGNALS_Virtual_DcmDspUDS_2611Byte06_07_signal" 507 "SIGNALS_Virtual_DcmDspUDS_2611Byte08to09_signal" 508 "SIGNALS_Virtual_DcmDspUDS_2611Byte0A_signal" 509 "SIGNALS_Virtual_DcmDspUDS_2611Byte0B_signal" 510 "SIGNALS_Virtual_DcmDspUDS_2611Byte0Cto0D_signal" 511 "SIGNALS_Virtual_DcmDspUDS_2611Byte0E_signal" 512 "SIGNALS_Virtual_DcmDspUDS_2611Byte2A_signal" 513 "SIGNALS_Virtual_DcmDspUDS_2611Byte2B_signal" 514 "SIGNALS_Virtual_DcmDspUDS_2611Byte30_signal" 515 "SIGNALS_Virtual_DcmDspUDS_2611Byte31_signal" 516 "SIGNALS_Virtual_DcmDspUDS_2611Byte32_signal" 517 "SIGNALS_Virtual_DcmDspUDS_2611Byte33_signal" 518 "SIGNALS_Virtual_DcmDspUDS_2612Byte00_signal" 519 "SIGNALS_Virtual_DcmDspUDS_2612Byte01_signal" 520 "SIGNALS_Virtual_DcmDspUDS_2612Byte02_signal" 521 "SIGNALS_Virtual_DcmDspUDS_2612Byte03_signal" 522 "SIGNALS_Virtual_DcmDspUDS_2612Byte04_signal" 523 "SIGNALS_Virtual_DcmDspUDS_2612Byte05_signal" 524 "SIGNALS_Virtual_DcmDspUDS_2612Byte0B_0C_signal" 525 "SIGNALS_Virtual_DcmDspUDS_2612Byte14_signal" 526 "SIGNALS_Virtual_DcmDspUDS_2612Byte15_signal" 527 "SIGNALS_Virtual_DcmDspUDS_2612Byte16_signal" 528 "SIGNALS_Virtual_DcmDspUDS_2612Byte17_signal" 529 "SIGNALS_Virtual_DcmDspUDS_2612Byte1F_signal" 530 "SIGNALS_Virtual_DcmDspUDS_2612Byte20_signal" 531 "SIGNALS_Virtual_DcmDspUDS_2612Byte2A_signal" 532 "SIGNALS_Virtual_DcmDspUDS_2612Byte2B_signal" 533 "SIGNALS_Virtual_DcmDspUDS_2613Byte00_signal" 534 "SIGNALS_Virtual_DcmDspUDS_2613Byte01_signal" 535 "SIGNALS_Virtual_DcmDspUDS_2613Byte02_signal" 536 "SIGNALS_Virtual_DcmDspUDS_2613Byte03_signal" 537 "SIGNALS_Virtual_DcmDspUDS_2613Byte04_signal" 538 "SIGNALS_Virtual_DcmDspUDS_2613Byte05_signal" 539 "SIGNALS_Virtual_DcmDspUDS_2613Byte08_signal" 540 "SIGNALS_Virtual_DcmDspUDS_2613Byte09_signal" 541 "SIGNALS_Virtual_DcmDspUDS_2615Byte00_signal" 542 "SIGNALS_Virtual_DcmDspUDS_2615Byte01_signal" 543 "SIGNALS_Virtual_DcmDspUDS_2615Byte02_signal" 544 "SIGNALS_Virtual_DcmDspUDS_2615Byte03_signal" 545 "SIGNALS_Virtual_DcmDspUDS_2615Byte04_signal" 546 "SIGNALS_Virtual_DcmDspUDS_2615Byte05_signal" 547 "SIGNALS_Virtual_DcmDspUDS_2615Byte10_signal" 548 "SIGNALS_Virtual_DcmDspUDS_2615Byte26_signal" 549 "SIGNALS_Virtual_DcmDspUDS_2615Byte27_signal" 550 "SIGNALS_Virtual_DcmDspUDS_2617Byte00_signal" 551 "SIGNALS_Virtual_DcmDspUDS_2617Byte01_signal" 552 "SIGNALS_Virtual_DcmDspUDS_2617Byte02_signal" 553 "SIGNALS_Virtual_DcmDspUDS_2617Byte03_signal" 554 "SIGNALS_Virtual_DcmDspUDS_2617Byte04_signal" 555 "SIGNALS_Virtual_DcmDspUDS_2617Byte05_signal" 556 "SIGNALS_Virtual_DcmDspUDS_261AByte00_signal" 557 "SIGNALS_Virtual_DcmDspUDS_261AByte01_signal" 558 "SIGNALS_Virtual_DcmDspUDS_261AByte02_signal" 559 "SIGNALS_Virtual_DcmDspUDS_261AByte03_signal" 560 "SIGNALS_Virtual_DcmDspUDS_261AByte04_signal" 561 "SIGNALS_Virtual_DcmDspUDS_261AByte05_signal" 562 "SIGNALS_Virtual_DcmDspUDS_261AByte07_signal" 563 "SIGNALS_Virtual_DcmDspUDS_261AByte0A_signal" 564 "SIGNALS_Virtual_DcmDspUDS_261AByte0B_signal" 565 "SIGNALS_Virtual_DcmDspUDS_261AByte0C_signal" 566 "SIGNALS_Virtual_DcmDspUDS_261AByte0D_signal" 567 "SIGNALS_Virtual_DcmDspUDS_261AByte0E_signal" 568 "SIGNALS_Virtual_DcmDspUDS_2620Byte00_signal" 569 "SIGNALS_Virtual_DcmDspUDS_2620Byte01_signal" 570 "SIGNALS_Virtual_DcmDspUDS_2620Byte02_signal" 571 "SIGNALS_Virtual_DcmDspUDS_2620Byte03_signal" 572 "SIGNALS_Virtual_DcmDspUDS_2620Byte04_signal" 573 "SIGNALS_Virtual_DcmDspUDS_2620Byte05_signal" 574 "SIGNALS_Virtual_DcmDspUDS_2621Byte00_signal" 575 "SIGNALS_Virtual_DcmDspUDS_2621Byte01_signal" 576 "SIGNALS_Virtual_DcmDspUDS_2621Byte02_signal" 577 "SIGNALS_Virtual_DcmDspUDS_2621Byte03_signal" 578 "SIGNALS_Virtual_DcmDspUDS_2621Byte04_signal" 579 "SIGNALS_Virtual_DcmDspUDS_2621Byte05_signal" 580 "SIGNALS_Virtual_DcmDspUDS_2622Byte00_signal" 581 "SIGNALS_Virtual_DcmDspUDS_2622Byte01_signal" 582 "SIGNALS_Virtual_DcmDspUDS_2622Byte02_signal" 583 "SIGNALS_Virtual_DcmDspUDS_2622Byte03_signal" 584 "SIGNALS_Virtual_DcmDspUDS_2622Byte04_signal" 585 "SIGNALS_Virtual_DcmDspUDS_2622Byte05_signal" 586 "SIGNALS_Virtual_DcmDspUDS_2623Byte00_signal" 587 "SIGNALS_Virtual_DcmDspUDS_2623Byte01_signal" 588 "SIGNALS_Virtual_DcmDspUDS_2623Byte02_signal" 589 "SIGNALS_Virtual_DcmDspUDS_2623Byte03_signal" 590 "SIGNALS_Virtual_DcmDspUDS_2623Byte04_signal" 591 "SIGNALS_Virtual_DcmDspUDS_2623Byte05_signal" 592 "SIGNALS_Virtual_DcmDspUDS_2625Byte00_signal" 593 "SIGNALS_Virtual_DcmDspUDS_2625Byte01_signal" 594 "SIGNALS_Virtual_DcmDspUDS_2625Byte02_signal" 595 "SIGNALS_Virtual_DcmDspUDS_2625Byte03_signal" 596 "SIGNALS_Virtual_DcmDspUDS_2625Byte04_signal" 597 "SIGNALS_Virtual_DcmDspUDS_2625Byte05_signal" 598 "SIGNALS_Virtual_DcmDspUDS_2627Byte00_signal" 599 "SIGNALS_Virtual_DcmDspUDS_2627Byte01_signal" 600 "SIGNALS_Virtual_DcmDspUDS_2627Byte02_signal" 601 "SIGNALS_Virtual_DcmDspUDS_2627Byte03_signal" 602 "SIGNALS_Virtual_DcmDspUDS_2627Byte04_signal" 603 "SIGNALS_Virtual_DcmDspUDS_2627Byte05_signal" 604 "SIGNALS_Virtual_DcmDspUDS_262AByte00_signal" 605 "SIGNALS_Virtual_DcmDspUDS_262AByte01_signal" 606 "SIGNALS_Virtual_DcmDspUDS_262AByte02_signal" 607 "SIGNALS_Virtual_DcmDspUDS_262AByte03_signal" 608 "SIGNALS_Virtual_DcmDspUDS_262AByte04_signal" 609 "SIGNALS_Virtual_DcmDspUDS_262AByte05_signal" 610 "SIGNALS_Virtual_DcmDspUDS_2660Byte0_signal" 611 "SIGNALS_Virtual_DcmDspUDS_2660Byte11to12_signal" 612 "SIGNALS_Virtual_DcmDspUDS_2660Byte13to14_signal" 613 "SIGNALS_Virtual_DcmDspUDS_2660Byte15_signal" 614 "SIGNALS_Virtual_DcmDspUDS_2660Byte16_signal" 615 "SIGNALS_Virtual_DcmDspUDS_2660Byte17_signal" 616 "SIGNALS_Virtual_DcmDspUDS_2660Byte18_signal" 617 "SIGNALS_Virtual_DcmDspUDS_2660Byte19_signal" 618 "SIGNALS_Virtual_DcmDspUDS_2660Byte1A_signal" 619 "SIGNALS_Virtual_DcmDspUDS_2660Byte1B_signal" 620 "SIGNALS_Virtual_DcmDspUDS_2660Byte1C_signal" 621 "SIGNALS_Virtual_DcmDspUDS_2660Byte1D_signal" 622 "SIGNALS_Virtual_DcmDspUDS_2660Byte1E_signal" 623 "SIGNALS_Virtual_DcmDspUDS_2660Byte1_signal" 624 "SIGNALS_Virtual_DcmDspUDS_2660Byte26to27_signal" 625 "SIGNALS_Virtual_DcmDspUDS_2660Byte2A_signal" 626 "SIGNALS_Virtual_DcmDspUDS_2660Byte2Eto2F_signal" 627 "SIGNALS_Virtual_DcmDspUDS_2660Byte2_signal" 628 "SIGNALS_Virtual_DcmDspUDS_2660Byte3_signal" 629 "SIGNALS_Virtual_DcmDspUDS_2660Byte4_signal" 630 "SIGNALS_Virtual_DcmDspUDS_2660Byte5_signal" 631 "SIGNALS_Virtual_DcmDspUDS_2660Byte6_signal" 632 "SIGNALS_Virtual_DcmDspUDS_2661Byte0A_signal" 633 "SIGNALS_Virtual_DcmDspUDS_2661Byte0B_signal" 634 "SIGNALS_Virtual_DcmDspUDS_2661Byte0C_signal" 635 "SIGNALS_Virtual_DcmDspUDS_2661Byte0D_signal" 636 "SIGNALS_Virtual_DcmDspUDS_2661Byte0E_signal" 637 "SIGNALS_Virtual_DcmDspUDS_2661Byte0F_signal" 638 "SIGNALS_Virtual_DcmDspUDS_2661Byte0_signal" 639 "SIGNALS_Virtual_DcmDspUDS_2661Byte1_signal" 640 "SIGNALS_Virtual_DcmDspUDS_2661Byte2D_signal" 641 "SIGNALS_Virtual_DcmDspUDS_2661Byte2E_signal" 642 "SIGNALS_Virtual_DcmDspUDS_2661Byte2F_signal" 643 "SIGNALS_Virtual_DcmDspUDS_2661Byte2_signal" 644 "SIGNALS_Virtual_DcmDspUDS_2661Byte30_signal" 645 "SIGNALS_Virtual_DcmDspUDS_2661Byte31_signal" 646 "SIGNALS_Virtual_DcmDspUDS_2661Byte32_signal" 647 "SIGNALS_Virtual_DcmDspUDS_2661Byte3_signal" 648 "SIGNALS_Virtual_DcmDspUDS_2661Byte4_signal" 649 "SIGNALS_Virtual_DcmDspUDS_2661Byte5_signal" 650 "SIGNALS_Virtual_DcmDspUDS_2661Byte6_signal" 651 "SIGNALS_Virtual_DcmDspUDS_2661Byte7_signal" 652 "SIGNALS_Virtual_DcmDspUDS_2661Byte8_signal" 653 "SIGNALS_Virtual_DcmDspUDS_2661Byte9_signal" 654 "SIGNALS_Virtual_DcmDspUDS_2662Byte0Cto0D_signal" 655 "SIGNALS_Virtual_DcmDspUDS_2662Byte0_signal" 656 "SIGNALS_Virtual_DcmDspUDS_2662Byte18_signal" 657 "SIGNALS_Virtual_DcmDspUDS_2662Byte19_signal" 658 "SIGNALS_Virtual_DcmDspUDS_2662Byte1_signal" 659 "SIGNALS_Virtual_DcmDspUDS_2662Byte2_signal" 660 "SIGNALS_Virtual_DcmDspUDS_2662Byte3_signal" 661 "SIGNALS_Virtual_DcmDspUDS_2662Byte4_signal" 662 "SIGNALS_Virtual_DcmDspUDS_2662Byte5_signal" 663 "SIGNALS_Virtual_DcmDspUDS_2663Byte0_signal" 664 "SIGNALS_Virtual_DcmDspUDS_2663Byte14Byte15_signal" 665 "SIGNALS_Virtual_DcmDspUDS_2663Byte16Byte17_signal" 666 "SIGNALS_Virtual_DcmDspUDS_2663Byte18Byte19_signal" 667 "SIGNALS_Virtual_DcmDspUDS_2663Byte1AByte1B_signal" 668 "SIGNALS_Virtual_DcmDspUDS_2663Byte1_signal" 669 "SIGNALS_Virtual_DcmDspUDS_2663Byte2_signal" 670 "SIGNALS_Virtual_DcmDspUDS_2663Byte3_signal" 671 "SIGNALS_Virtual_DcmDspUDS_2663Byte4_signal" 672 "SIGNALS_Virtual_DcmDspUDS_2663Byte5_signal" 673 "SIGNALS_Virtual_DcmDspUDS_2664Byte0_signal" 674 "SIGNALS_Virtual_DcmDspUDS_2664Byte1_signal" 675 "SIGNALS_Virtual_DcmDspUDS_2664Byte25_signal" 676 "SIGNALS_Virtual_DcmDspUDS_2664Byte26_signal" 677 "SIGNALS_Virtual_DcmDspUDS_2664Byte2_signal" 678 "SIGNALS_Virtual_DcmDspUDS_2664Byte3_signal" 679 "SIGNALS_Virtual_DcmDspUDS_2664Byte4_signal" 680 "SIGNALS_Virtual_DcmDspUDS_2664Byte5_signal" 681 "SIGNALS_Virtual_DcmDspUDS_2664Byte6_signal" 682 "SIGNALS_Virtual_DcmDspUDS_2664Byte7_signal" 683 "SIGNALS_Virtual_DcmDspUDS_2665Byte0_signal" 684 "SIGNALS_Virtual_DcmDspUDS_2665Byte1_signal" 685 "SIGNALS_Virtual_DcmDspUDS_2665Byte2_signal" 686 "SIGNALS_Virtual_DcmDspUDS_2665Byte3_signal" 687 "SIGNALS_Virtual_DcmDspUDS_2665Byte4_signal" 688 "SIGNALS_Virtual_DcmDspUDS_2665Byte5_signal" 689 "SIGNALS_Virtual_DcmDspUDS_2666Byte0_signal" 690 "SIGNALS_Virtual_DcmDspUDS_2666Byte1_signal" 691 "SIGNALS_Virtual_DcmDspUDS_2666Byte2_signal" 692 "SIGNALS_Virtual_DcmDspUDS_2666Byte3_signal" 693 "SIGNALS_Virtual_DcmDspUDS_2666Byte4_signal" 694 "SIGNALS_Virtual_DcmDspUDS_2666Byte5_signal" 695 "SIGNALS_Virtual_DcmDspUDS_2668Byte0_signal" 696 "SIGNALS_Virtual_DcmDspUDS_2668Byte1_signal" 697 "SIGNALS_Virtual_DcmDspUDS_2668Byte2_signal" 698 "SIGNALS_Virtual_DcmDspUDS_2668Byte3_signal" 699 "SIGNALS_Virtual_DcmDspUDS_2668Byte4_signal" 700 "SIGNALS_Virtual_DcmDspUDS_2668Byte5_signal" 701 "SIGNALS_Virtual_DcmDspUDS_266CByte0_signal" 702 "SIGNALS_Virtual_DcmDspUDS_266CByte1_signal" 703 "SIGNALS_Virtual_DcmDspUDS_266CByte26_signal" 704 "SIGNALS_Virtual_DcmDspUDS_266CByte27_signal" 705 "SIGNALS_Virtual_DcmDspUDS_266CByte2_signal" 706 "SIGNALS_Virtual_DcmDspUDS_266CByte3_signal" 707 "SIGNALS_Virtual_DcmDspUDS_266CByte4_signal" 708 "SIGNALS_Virtual_DcmDspUDS_266CByte5_signal" 709 "SIGNALS_Virtual_DcmDspUDS_266CByte6_signal" 710 "SIGNALS_Virtual_DcmDspUDS_266CByte7_signal" 711 "SIGNALS_Virtual_DcmDspUDS_266CByte8_signal" 712 "SIGNALS_Virtual_DcmDspUDS_266CByte9_signal" 713 "SIGNALS_Virtual_DcmDspUDS_266DByte0_signal" 714 "SIGNALS_Virtual_DcmDspUDS_266DByte1_signal" 715 "SIGNALS_Virtual_DcmDspUDS_266DByte2_signal" 716 "SIGNALS_Virtual_DcmDspUDS_266DByte3_signal" 717 "SIGNALS_Virtual_DcmDspUDS_266DByte4_signal" 718 "SIGNALS_Virtual_DcmDspUDS_266DByte5_signal" 719 "SIGNALS_Virtual_DcmDspUDS_266FByte0_signal" 720 "SIGNALS_Virtual_DcmDspUDS_266FByte1_signal" 721 "SIGNALS_Virtual_DcmDspUDS_266FByte2_signal" 722 "SIGNALS_Virtual_DcmDspUDS_266FByte3_signal" 723 "SIGNALS_Virtual_DcmDspUDS_2673Byte0A_signal" 724 "SIGNALS_Virtual_DcmDspUDS_2673Byte0B_signal" 725 "SIGNALS_Virtual_DcmDspUDS_2673Byte0_signal" 726 "SIGNALS_Virtual_DcmDspUDS_2673Byte12_signal" 727 "SIGNALS_Virtual_DcmDspUDS_2673Byte13_signal" 728 "SIGNALS_Virtual_DcmDspUDS_2673Byte16_signal" 729 "SIGNALS_Virtual_DcmDspUDS_2673Byte17_signal" 730 "SIGNALS_Virtual_DcmDspUDS_2673Byte1E_signal" 731 "SIGNALS_Virtual_DcmDspUDS_2673Byte1F_signal" 732 "SIGNALS_Virtual_DcmDspUDS_2673Byte1_signal" 733 "SIGNALS_Virtual_DcmDspUDS_2673Byte2_signal" 734 "SIGNALS_Virtual_DcmDspUDS_2673Byte3_signal" 735 "SIGNALS_Virtual_DcmDspUDS_2673Byte4_signal" 736 "SIGNALS_Virtual_DcmDspUDS_2673Byte5_signal" 737 "SIGNALS_Virtual_DcmDspUDS_2673Byte6_signal" 738 "SIGNALS_Virtual_DcmDspUDS_2673Byte7_signal" 739 "SIGNALS_Virtual_DcmDspUDS_2676Byte0_signal" 740 "SIGNALS_Virtual_DcmDspUDS_2676Byte1_signal" 741 "SIGNALS_Virtual_DcmDspUDS_2676Byte2E_signal" 742 "SIGNALS_Virtual_DcmDspUDS_2676Byte2F_signal" 743 "SIGNALS_Virtual_DcmDspUDS_2676Byte2_signal" 744 "SIGNALS_Virtual_DcmDspUDS_2676Byte3_signal" 745 "SIGNALS_Virtual_DcmDspUDS_2676Byte4_signal" 746 "SIGNALS_Virtual_DcmDspUDS_2676Byte5_signal" 747 "SIGNALS_Virtual_DcmDspUDS_2676Byte6_signal" 748 "SIGNALS_Virtual_DcmDspUDS_2676Byte7_signal" 749 "SIGNALS_Virtual_DcmDspUDS_267BByte0_signal" 750 "SIGNALS_Virtual_DcmDspUDS_267BByte1_signal" 751 "SIGNALS_Virtual_DcmDspUDS_267BByte2_signal" 752 "SIGNALS_Virtual_DcmDspUDS_267BByte3_signal" 753 "SIGNALS_Virtual_DcmDspUDS_267BByte4_signal" 754 "SIGNALS_Virtual_DcmDspUDS_267BByte5_signal" 755 "SIGNALS_Virtual_DcmDspUDS_267EByte0_signal" 756 "SIGNALS_Virtual_DcmDspUDS_267EByte1_signal" 757 "SIGNALS_Virtual_DcmDspUDS_267EByte22_signal" 758 "SIGNALS_Virtual_DcmDspUDS_267EByte2_signal" 759 "SIGNALS_Virtual_DcmDspUDS_2680Byte00_signal" 760 "SIGNALS_Virtual_DcmDspUDS_2680Byte01_signal" 761 "SIGNALS_Virtual_DcmDspUDS_2680Byte02_signal" 762 "SIGNALS_Virtual_DcmDspUDS_2680Byte03_signal" 763 "SIGNALS_Virtual_DcmDspUDS_2680Byte04_signal" 764 "SIGNALS_Virtual_DcmDspUDS_2680Byte05_signal" 765 "SIGNALS_Virtual_DcmDspUDS_2680Byte08_signal" 766 "SIGNALS_Virtual_DcmDspUDS_2680Byte09_signal" 767 "SIGNALS_Virtual_DcmDspUDS_2680Byte0E_signal" 768 "SIGNALS_Virtual_DcmDspUDS_2680Byte0F_signal" 769 "SIGNALS_Virtual_DcmDspUDS_2681Byte00_signal" 770 "SIGNALS_Virtual_DcmDspUDS_2681Byte01_signal" 771 "SIGNALS_Virtual_DcmDspUDS_2681Byte02_signal" 772 "SIGNALS_Virtual_DcmDspUDS_2681Byte03_signal" 773 "SIGNALS_Virtual_DcmDspUDS_2681Byte04_signal" 774 "SIGNALS_Virtual_DcmDspUDS_2681Byte05_signal" 775 "SIGNALS_Virtual_DcmDspUDS_2681Byte0F_signal" 776 "SIGNALS_Virtual_DcmDspUDS_2681Byte10_signal" 777 "SIGNALS_Virtual_DcmDspUDS_2681Byte13_signal" 778 "SIGNALS_Virtual_DcmDspUDS_2681Byte14_signal" 779 "SIGNALS_Virtual_DcmDspUDS_2681Byte1D_signal" 780 "SIGNALS_Virtual_DcmDspUDS_2681Byte1E_signal" 781 "SIGNALS_Virtual_DcmDspUDS_2682Byte00_signal" 782 "SIGNALS_Virtual_DcmDspUDS_2682Byte01_signal" 783 "SIGNALS_Virtual_DcmDspUDS_2682Byte02_signal" 784 "SIGNALS_Virtual_DcmDspUDS_2682Byte03_signal" 785 "SIGNALS_Virtual_DcmDspUDS_2682Byte04_signal" 786 "SIGNALS_Virtual_DcmDspUDS_2682Byte05_signal" 787 "SIGNALS_Virtual_DcmDspUDS_2682Byte06_07_signal" 788 "SIGNALS_Virtual_DcmDspUDS_2682Byte08_09_signal" 789 "SIGNALS_Virtual_DcmDspUDS_2682Byte0E_signal" 790 "SIGNALS_Virtual_DcmDspUDS_2682Byte11_12_signal" 791 "SIGNALS_Virtual_DcmDspUDS_2682Byte13_14_signal" 792 "SIGNALS_Virtual_DcmDspUDS_2682Byte15_16_signal" 793 "SIGNALS_Virtual_DcmDspUDS_2682Byte18_19_signal" 794 "SIGNALS_Virtual_DcmDspUDS_2682Byte1B_signal" 795 "SIGNALS_Virtual_DcmDspUDS_2682Byte1C_signal" 796 "SIGNALS_Virtual_DcmDspUDS_2683Byte00_signal" 797 "SIGNALS_Virtual_DcmDspUDS_2683Byte01_signal" 798 "SIGNALS_Virtual_DcmDspUDS_2683Byte02_signal" 799 "SIGNALS_Virtual_DcmDspUDS_2683Byte03_signal" 800 "SIGNALS_Virtual_DcmDspUDS_2683Byte04_signal" 801 "SIGNALS_Virtual_DcmDspUDS_2683Byte05_signal" 802 "SIGNALS_Virtual_DcmDspUDS_2684Byte00_signal" 803 "SIGNALS_Virtual_DcmDspUDS_2684Byte01_signal" 804 "SIGNALS_Virtual_DcmDspUDS_2684Byte02_signal" 805 "SIGNALS_Virtual_DcmDspUDS_2684Byte03_signal" 806 "SIGNALS_Virtual_DcmDspUDS_2684Byte04_signal" 807 "SIGNALS_Virtual_DcmDspUDS_2684Byte05_signal" 808 "SIGNALS_Virtual_DcmDspUDS_2688Byte00_signal" 809 "SIGNALS_Virtual_DcmDspUDS_2688Byte01_signal" 810 "SIGNALS_Virtual_DcmDspUDS_2688Byte02_signal" 811 "SIGNALS_Virtual_DcmDspUDS_2688Byte03_signal" 812 "SIGNALS_Virtual_DcmDspUDS_2688Byte04_signal" 813 "SIGNALS_Virtual_DcmDspUDS_2688Byte05_signal" 814 "SIGNALS_Virtual_DcmDspUDS_2689Byte00_signal" 815 "SIGNALS_Virtual_DcmDspUDS_2689Byte01_signal" 816 "SIGNALS_Virtual_DcmDspUDS_2689Byte02_signal" 817 "SIGNALS_Virtual_DcmDspUDS_2689Byte03_signal" 818 "SIGNALS_Virtual_DcmDspUDS_2689Byte04_signal" 819 "SIGNALS_Virtual_DcmDspUDS_2689Byte05_signal" 820 "SIGNALS_Virtual_DcmDspUDS_2689Byte06to09_signal" 821 "SIGNALS_Virtual_DcmDspUDS_2689Byte0Eto11_signal" 822 "SIGNALS_Virtual_DcmDspUDS_2689Byte12to15_signal" 823 "SIGNALS_Virtual_DcmDspUDS_2689Byte16to19_signal" 824 "SIGNALS_Virtual_DcmDspUDS_2689Byte1Ato1D_signal" 825 "SIGNALS_Virtual_DcmDspUDS_2689Byte1Eto21_signal" 826 "SIGNALS_Virtual_DcmDspUDS_2689Byte22to25_signal" 827 "SIGNALS_Virtual_DcmDspUDS_2689Byte26to29_signal" 828 "SIGNALS_Virtual_DcmDspUDS_2689Byte2Ato2D_signal" 829 "SIGNALS_Virtual_DcmDspUDS_2689Byte2Eto31_signal" 830 "SIGNALS_Virtual_DcmDspUDS_268BByte00_signal" 831 "SIGNALS_Virtual_DcmDspUDS_268BByte01_signal" 832 "SIGNALS_Virtual_DcmDspUDS_268BByte02_signal" 833 "SIGNALS_Virtual_DcmDspUDS_268BByte03_signal" 834 "SIGNALS_Virtual_DcmDspUDS_268BByte04_signal" 835 "SIGNALS_Virtual_DcmDspUDS_268BByte05_signal" 836 "SIGNALS_Virtual_DcmDspUDS_268BByte06_signal" 837 "SIGNALS_Virtual_DcmDspUDS_268BByte07_signal" 838 "SIGNALS_Virtual_DcmDspUDS_268BByte08_signal" 839 "SIGNALS_Virtual_DcmDspUDS_268BByte09_signal" 840 "SIGNALS_Virtual_DcmDspUDS_268BByte0A_signal" 841 "SIGNALS_Virtual_DcmDspUDS_268BByte0B_signal" 842 "SIGNALS_Virtual_DcmDspUDS_268BByte0C_signal" 843 "SIGNALS_Virtual_DcmDspUDS_268BByte0D_signal" 844 "SIGNALS_Virtual_DcmDspUDS_268CByte00_signal" 845 "SIGNALS_Virtual_DcmDspUDS_268CByte01_signal" 846 "SIGNALS_Virtual_DcmDspUDS_268CByte02_signal" 847 "SIGNALS_Virtual_DcmDspUDS_268CByte03_signal" 848 "SIGNALS_Virtual_DcmDspUDS_268CByte04_signal" 849 "SIGNALS_Virtual_DcmDspUDS_268CByte05_signal" 850 "SIGNALS_Virtual_DcmDspUDS_268CByte06_signal" 851 "SIGNALS_Virtual_DcmDspUDS_268CByte07_signal" 852 "SIGNALS_Virtual_DcmDspUDS_268CByte08_signal" 853 "SIGNALS_Virtual_DcmDspUDS_268CByte09_signal" 854 "SIGNALS_Virtual_DcmDspUDS_268CByte0A_signal" 855 "SIGNALS_Virtual_DcmDspUDS_268CByte2E_signal" 856 "SIGNALS_Virtual_DcmDspUDS_268CByte2F_signal" 857 "SIGNALS_Virtual_DcmDspUDS_268CByte30_signal" 858 "SIGNALS_Virtual_DcmDspUDS_268CByte31_signal" 859 "SIGNALS_Virtual_DcmDspUDS_268CByte32_signal" 860 "SIGNALS_Virtual_DcmDspUDS_268CByte33_signal" 861 "SIGNALS_Virtual_DcmDspUDS_268EByte00_signal" 862 "SIGNALS_Virtual_DcmDspUDS_268EByte01_signal" 863 "SIGNALS_Virtual_DcmDspUDS_268EByte02_signal" 864 "SIGNALS_Virtual_DcmDspUDS_268EByte03_signal" 865 "SIGNALS_Virtual_DcmDspUDS_268EByte04_signal" 866 "SIGNALS_Virtual_DcmDspUDS_268EByte05_signal" 867 "SIGNALS_Virtual_DcmDspUDS_268EByte08to09_signal" 868 "SIGNALS_Virtual_DcmDspUDS_268EByte0A_signal" 869 "SIGNALS_Virtual_DcmDspUDS_268EByte0B_signal" 870 "SIGNALS_Virtual_DcmDspUDS_268FByte00_signal" 871 "SIGNALS_Virtual_DcmDspUDS_268FByte01_signal" 872 "SIGNALS_Virtual_DcmDspUDS_268FByte02_signal" 873 "SIGNALS_Virtual_DcmDspUDS_268FByte03_signal" 874 "SIGNALS_Virtual_DcmDspUDS_268FByte04_signal" 875 "SIGNALS_Virtual_DcmDspUDS_268FByte05_signal" 876 "SIGNALS_Virtual_DcmDspUDS_268FByte0A_signal" 877 "SIGNALS_Virtual_DcmDspUDS_268FByte0B_signal" 878 "SIGNALS_Virtual_DcmDspUDS_268FByte16_17_signal" 879 "SIGNALS_Virtual_DcmDspUDS_268FByte18_19_signal" 880 "SIGNALS_Virtual_DcmDspUDS_268FByte1A_1B_signal" 881 "SIGNALS_Virtual_DcmDspUDS_2699Byte00_signal" 882 "SIGNALS_Virtual_DcmDspUDS_2699Byte01_signal" 883 "SIGNALS_Virtual_DcmDspUDS_2699Byte02_signal" 884 "SIGNALS_Virtual_DcmDspUDS_2699Byte03_signal" 885 "SIGNALS_Virtual_DcmDspUDS_2699Byte04_signal" 886 "SIGNALS_Virtual_DcmDspUDS_2699Byte05_signal" 887 "SIGNALS_Virtual_DcmDspUDS_2699Byte06_signal" 888 "SIGNALS_Virtual_DcmDspUDS_2699Byte07_signal" 889 "SIGNALS_Virtual_DcmDspUDS_2699Byte0B_0C_signal" 890 "SIGNALS_Virtual_DcmDspUDS_2699Byte16_signal" 891 "SIGNALS_Virtual_DcmDspUDS_2699Byte17_signal" 892 "SIGNALS_Virtual_DcmDspUDS_2699Byte26_27_signal" 893 "SIGNALS_Virtual_DcmDspUDS_2699Byte28_29_signal" 894 "SIGNALS_Virtual_DcmDspUDS_2699Byte2A_2B_signal" 895 "SIGNALS_Virtual_DcmDspUDS_2699Byte2E_signal" 896 "SIGNALS_Virtual_DcmDspUDS_2699Byte2F_30_signal" 897 "SIGNALS_Virtual_DcmDspUDS_269AByte00_signal" 898 "SIGNALS_Virtual_DcmDspUDS_269AByte01_signal" 899 "SIGNALS_Virtual_DcmDspUDS_269AByte02_signal" 900 "SIGNALS_Virtual_DcmDspUDS_269AByte03_signal" 901 "SIGNALS_Virtual_DcmDspUDS_269AByte04_signal" 902 "SIGNALS_Virtual_DcmDspUDS_269AByte05_signal" 903 "SIGNALS_Virtual_DcmDspUDS_269BByte00_signal" 904 "SIGNALS_Virtual_DcmDspUDS_269BByte01_signal" 905 "SIGNALS_Virtual_DcmDspUDS_269BByte02_signal" 906 "SIGNALS_Virtual_DcmDspUDS_269BByte03_signal" 907 "SIGNALS_Virtual_DcmDspUDS_269BByte04_signal" 908 "SIGNALS_Virtual_DcmDspUDS_269BByte05_signal" 909 "SIGNALS_Virtual_DcmDspUDS_269EByte00_signal" 910 "SIGNALS_Virtual_DcmDspUDS_269EByte01_signal" 911 "SIGNALS_Virtual_DcmDspUDS_269EByte02_signal" 912 "SIGNALS_Virtual_DcmDspUDS_269EByte03_signal" 913 "SIGNALS_Virtual_DcmDspUDS_269EByte04_signal" 914 "SIGNALS_Virtual_DcmDspUDS_269EByte05_signal" 915 "SIGNALS_Virtual_DcmDspUDS_26A0Byte00_signal" 916 "SIGNALS_Virtual_DcmDspUDS_26A0Byte01_signal" 917 "SIGNALS_Virtual_DcmDspUDS_26A0Byte02_signal" 918 "SIGNALS_Virtual_DcmDspUDS_26A0Byte03_signal" 919 "SIGNALS_Virtual_DcmDspUDS_26A0Byte04_signal" 920 "SIGNALS_Virtual_DcmDspUDS_26A0Byte05_signal" 921 "SIGNALS_Virtual_DcmDspUDS_26A0Byte06_signal" 922 "SIGNALS_Virtual_DcmDspUDS_26A0Byte07_signal" 923 "SIGNALS_Virtual_DcmDspUDS_26A0Byte08_signal" 924 "SIGNALS_Virtual_DcmDspUDS_26A0Byte09_signal" 925 "SIGNALS_Virtual_DcmDspUDS_26A0Byte0A_signal" 926 "SIGNALS_Virtual_DcmDspUDS_26A0Byte0B_signal" 927 "SIGNALS_Virtual_DcmDspUDS_26A0Byte0C_signal" 928 "SIGNALS_Virtual_DcmDspUDS_26A0Byte0D_signal" 929 "SIGNALS_Virtual_DcmDspUDS_26A0Byte0E_signal" 930 "SIGNALS_Virtual_DcmDspUDS_26A0Byte0F_signal" 931 "SIGNALS_Virtual_DcmDspUDS_26A0Byte10_signal" 932 "SIGNALS_Virtual_DcmDspUDS_26A0Byte11_signal" 933 "SIGNALS_Virtual_DcmDspUDS_26A0Byte12_signal" 934 "SIGNALS_Virtual_DcmDspUDS_26A0Byte13_signal" 935 "SIGNALS_Virtual_DcmDspUDS_26A0Byte14_signal" 936 "SIGNALS_Virtual_DcmDspUDS_26A0Byte15_signal" 937 "SIGNALS_Virtual_DcmDspUDS_26A0Byte16_signal" 938 "SIGNALS_Virtual_DcmDspUDS_26A0Byte17_signal" 939 "SIGNALS_Virtual_DcmDspUDS_26A0Byte18_signal" 940 "SIGNALS_Virtual_DcmDspUDS_26A0Byte19_signal" 941 "SIGNALS_Virtual_DcmDspUDS_26A0Byte1A_signal" 942 "SIGNALS_Virtual_DcmDspUDS_26A0Byte4E_signal" 943 "SIGNALS_Virtual_DcmDspUDS_26A0Byte52_53_signal" 944 "SIGNALS_Virtual_DcmDspUDS_26A0Byte54_55_signal" 945 "SIGNALS_Virtual_DcmDspUDS_26A0Byte56_57_signal" 946 "SIGNALS_Virtual_DcmDspUDS_26A0Byte66_signal" 947 "SIGNALS_Virtual_DcmDspUDS_26A0Byte67_signal" 948 "SIGNALS_Virtual_DcmDspUDS_26A0Byte68_signal" 949 "SIGNALS_Virtual_DcmDspUDS_26A0Byte69_signal" 950 "SIGNALS_Virtual_DcmDspUDS_26A0Byte6A_signal" 951 "SIGNALS_Virtual_DcmDspUDS_26A0Byte6B_signal" 952 "SIGNALS_Virtual_DcmDspUDS_26A0Byte6C_signal" 953 "SIGNALS_Virtual_DcmDspUDS_26A0Byte6D_signal" 954 "SIGNALS_Virtual_DcmDspUDS_26A0Byte7F_80_signal" 955 "SIGNALS_Virtual_DcmDspUDS_26A0Byte81_82_signal" 956 "SIGNALS_Virtual_DcmDspUDS_26A0Byte83_84_signal" 957 "SIGNALS_Virtual_DcmDspUDS_26A0Byte85_86_signal" 958 "SIGNALS_Virtual_DcmDspUDS_26A0Byte87_88_signal" 959 "SIGNALS_Virtual_DcmDspUDS_26A0Byte89_8A_signal" 960 "SIGNALS_Virtual_DcmDspUDS_26A0Byte8B_8C_signal" 961 "SIGNALS_Virtual_DcmDspUDS_26A0Byte8D_8E_signal" 962 "SIGNALS_Virtual_DcmDspUDS_26A0Byte8F_90_signal" 963 "SIGNALS_Virtual_DcmDspUDS_26A0Byte91_92_signal" 964 "SIGNALS_Virtual_DcmDspUDS_26A0Byte93_94_signal" 965 "SIGNALS_Virtual_DcmDspUDS_26A0Byte95_96_signal" 966 "SIGNALS_Virtual_DcmDspUDS_26A0Byte97_98_signal" 967 "SIGNALS_Virtual_DcmDspUDS_26A0Byte99_9A_signal" 968 "SIGNALS_Virtual_DcmDspUDS_26A0Byte9B_9C_signal" 969 "SIGNALS_Virtual_DcmDspUDS_26A0Byte9D_9E_signal" 970 "SIGNALS_Virtual_DcmDspUDS_26A0Byte9F_A0_signal" 971 "SIGNALS_Virtual_DcmDspUDS_26A0ByteA1_A2_signal" 972 "SIGNALS_Virtual_DcmDspUDS_26A0ByteA3_A4_signal" 973 "SIGNALS_Virtual_DcmDspUDS_26A0ByteA5_A6_signal" 974 "SIGNALS_Virtual_DcmDspUDS_26A0ByteA7_A8_signal" 975 "SIGNALS_Virtual_DcmDspUDS_26A0ByteA9_AA_signal" 976 "SIGNALS_Virtual_DcmDspUDS_26A0ByteAB_AC_signal" 977 "SIGNALS_Virtual_DcmDspUDS_26A0ByteAD_AE_signal" 978 "SIGNALS_Virtual_DcmDspUDS_26A0ByteAF_B0_signal" 979 "SIGNALS_Virtual_DcmDspUDS_26A0ByteB1_B2_signal" 980 "SIGNALS_Virtual_DcmDspUDS_26A0ByteB3_B4_signal" 981 "SIGNALS_Virtual_DcmDspUDS_26A0ByteB5_B6_signal" 982 "SIGNALS_Virtual_DcmDspUDS_26A0ByteB7_B8_signal" 983 "SIGNALS_Virtual_DcmDspUDS_26A0ByteB9_BA_signal" 984 "SIGNALS_Virtual_DcmDspUDS_26A0ByteBB_BC_signal" 985 "SIGNALS_Virtual_DcmDspUDS_26A0ByteBD_BE_signal" 986 "SIGNALS_Virtual_DcmDspUDS_26A0ByteBF_C0_signal" 987 "SIGNALS_Virtual_DcmDspUDS_26A0ByteC1_C2_signal" 988 "SIGNALS_Virtual_DcmDspUDS_26A0ByteC3_C4_signal" 989 "SIGNALS_Virtual_DcmDspUDS_26A0ByteC5_C6_signal" 990 "SIGNALS_Virtual_DcmDspUDS_26A0ByteC7_C8_signal" 991 "SIGNALS_Virtual_DcmDspUDS_26A0ByteC9_CA_signal" 992 "SIGNALS_Virtual_DcmDspUDS_26A0ByteCB_CC_signal" 993 "SIGNALS_Virtual_DcmDspUDS_26A0ByteCD_CE_signal" 994 "SIGNALS_Virtual_DcmDspUDS_26A0ByteCF_D0_signal" 995 "SIGNALS_Virtual_DcmDspUDS_26A0ByteD1_D2_signal" 996 "SIGNALS_Virtual_DcmDspUDS_26A0ByteD3_D4_signal" 997 "SIGNALS_Virtual_DcmDspUDS_26A0ByteD5_D6_signal" 998 "SIGNALS_Virtual_DcmDspUDS_26A0ByteD7_D8_signal" 999 "SIGNALS_Virtual_DcmDspUDS_26A0ByteD9_DA_signal" 1000 "SIGNALS_Virtual_DcmDspUDS_26A0ByteDB_DC_signal" 1001 "SIGNALS_Virtual_DcmDspUDS_26A0ByteDD_DE_signal" 1002 "SIGNALS_Virtual_DcmDspUDS_26A0ByteDF_E0_signal" 1003 "SIGNALS_Virtual_DcmDspUDS_26A0ByteE1_E2_signal" 1004 "SIGNALS_Virtual_DcmDspUDS_26A0ByteE3_E4_signal" 1005 "SIGNALS_Virtual_DcmDspUDS_26A0ByteE5_E6_signal" 1006 "SIGNALS_Virtual_DcmDspUDS_26A0ByteE7_E8_signal" 1007 "SIGNALS_Virtual_DcmDspUDS_26A0ByteE9_EA_signal" 1008 "SIGNALS_Virtual_DcmDspUDS_26A0ByteEB_EC_signal" 1009 "SIGNALS_Virtual_DcmDspUDS_26A0ByteED_EE_signal" 1010 "SIGNALS_Virtual_DcmDspUDS_26A0ByteEF_F0_signal" 1011 "SIGNALS_Virtual_DcmDspUDS_26A0ByteF1_F2_signal" 1012 "SIGNALS_Virtual_DcmDspUDS_26A1Byte00_signal" 1013 "SIGNALS_Virtual_DcmDspUDS_26A1Byte01_signal" 1014 "SIGNALS_Virtual_DcmDspUDS_26A1Byte02_signal" 1015 "SIGNALS_Virtual_DcmDspUDS_26A1Byte03_signal" 1016 "SIGNALS_Virtual_DcmDspUDS_26A1Byte04_signal" 1017 "SIGNALS_Virtual_DcmDspUDS_26A1Byte05_signal" 1018 "SIGNALS_Virtual_DcmDspUDS_26A1Byte06_signal" 1019 "SIGNALS_Virtual_DcmDspUDS_26A1Byte07_signal" 1020 "SIGNALS_Virtual_DcmDspUDS_26A1Byte08_signal" 1021 "SIGNALS_Virtual_DcmDspUDS_26A1Byte09_signal" 1022 "SIGNALS_Virtual_DcmDspUDS_26A1Byte0A_signal" 1023 "SIGNALS_Virtual_DcmDspUDS_26A1Byte0B_signal" 1024 "SIGNALS_Virtual_DcmDspUDS_26A1Byte0C_signal" 1025 "SIGNALS_Virtual_DcmDspUDS_26A1Byte0D_signal" 1026 "SIGNALS_Virtual_DcmDspUDS_26A1Byte0E_signal" 1027 "SIGNALS_Virtual_DcmDspUDS_26A1Byte0F_signal" 1028 "SIGNALS_Virtual_DcmDspUDS_26A1Byte10_signal" 1029 "SIGNALS_Virtual_DcmDspUDS_26A1Byte11_signal" 1030 "SIGNALS_Virtual_DcmDspUDS_26A1Byte12_signal" 1031 "SIGNALS_Virtual_DcmDspUDS_26A1Byte13_signal" 1032 "SIGNALS_Virtual_DcmDspUDS_26A1Byte14_signal" 1033 "SIGNALS_Virtual_DcmDspUDS_26A1Byte15_signal" 1034 "SIGNALS_Virtual_DcmDspUDS_26A1Byte16_signal" 1035 "SIGNALS_Virtual_DcmDspUDS_26A1Byte17_signal" 1036 "SIGNALS_Virtual_DcmDspUDS_26A1Byte18_signal" 1037 "SIGNALS_Virtual_DcmDspUDS_26A1Byte19_signal" 1038 "SIGNALS_Virtual_DcmDspUDS_26A1Byte1A_signal" 1039 "SIGNALS_Virtual_DcmDspUDS_26A1Byte1B_1C_signal" 1040 "SIGNALS_Virtual_DcmDspUDS_26A1Byte1D_1E_signal" 1041 "SIGNALS_Virtual_DcmDspUDS_26A1Byte1F_20_signal" 1042 "SIGNALS_Virtual_DcmDspUDS_26A1Byte21_22_signal" 1043 "SIGNALS_Virtual_DcmDspUDS_26A1Byte23_24_signal" 1044 "SIGNALS_Virtual_DcmDspUDS_26A1Byte25_signal" 1045 "SIGNALS_Virtual_DcmDspUDS_26A1Byte26_signal" 1046 "SIGNALS_Virtual_DcmDspUDS_26A1Byte27_signal" 1047 "SIGNALS_Virtual_DcmDspUDS_26A1Byte28_signal" 1048 "SIGNALS_Virtual_DcmDspUDS_26A1Byte29_signal" 1049 "SIGNALS_Virtual_DcmDspUDS_26A1Byte2A_signal" 1050 "SIGNALS_Virtual_DcmDspUDS_26A1Byte2B_signal" 1051 "SIGNALS_Virtual_DcmDspUDS_26A1Byte2C_signal" 1052 "SIGNALS_Virtual_DcmDspUDS_26A1Byte2D_signal" 1053 "SIGNALS_Virtual_DcmDspUDS_26A1Byte2E_signal" 1054 "SIGNALS_Virtual_DcmDspUDS_26A1Byte2F_signal" 1055 "SIGNALS_Virtual_DcmDspUDS_26A1Byte30_signal" 1056 "SIGNALS_Virtual_DcmDspUDS_26A1Byte31_signal" 1057 "SIGNALS_Virtual_DcmDspUDS_26A1Byte32_signal" 1058 "SIGNALS_Virtual_DcmDspUDS_26A1Byte33_signal" 1059 "SIGNALS_Virtual_DcmDspUDS_26A1Byte34_signal" 1060 "SIGNALS_Virtual_DcmDspUDS_26A1Byte35_signal" 1061 "SIGNALS_Virtual_DcmDspUDS_26A1Byte36_signal" 1062 "SIGNALS_Virtual_DcmDspUDS_26A1Byte37_signal" 1063 "SIGNALS_Virtual_DcmDspUDS_26A1Byte38_signal" 1064 "SIGNALS_Virtual_DcmDspUDS_26A1Byte39_signal" 1065 "SIGNALS_Virtual_DcmDspUDS_26A1Byte6F_70_signal" 1066 "SIGNALS_Virtual_DcmDspUDS_26A1Byte71_72_signal" 1067 "SIGNALS_Virtual_DcmDspUDS_26A1Byte73_74_signal" 1068 "SIGNALS_Virtual_DcmDspUDS_26A1Byte75_76_signal" 1069 "SIGNALS_Virtual_DcmDspUDS_26A1Byte77_78_signal" 1070 "SIGNALS_Virtual_DcmDspUDS_26A1Byte79_signal" 1071 "SIGNALS_Virtual_DcmDspUDS_26A1Byte7B_signal" 1072 "SIGNALS_Virtual_DcmDspUDS_26A2Byte00_signal" 1073 "SIGNALS_Virtual_DcmDspUDS_26A2Byte01_signal" 1074 "SIGNALS_Virtual_DcmDspUDS_26A2Byte02_signal" 1075 "SIGNALS_Virtual_DcmDspUDS_26A2Byte03_signal" 1076 "SIGNALS_Virtual_DcmDspUDS_26A2Byte04_signal" 1077 "SIGNALS_Virtual_DcmDspUDS_26A2Byte05_signal" 1078 "SIGNALS_Virtual_DcmDspUDS_26A2Byte12_13_signal" 1079 "SIGNALS_Virtual_DcmDspUDS_26A2Byte1C_signal" 1080 "SIGNALS_Virtual_DcmDspUDS_26A2Byte1D_signal" 1081 "SIGNALS_Virtual_DcmDspUDS_26A2Byte21_signal" 1082 "SIGNALS_Virtual_DcmDspUDS_26A2Byte22_signal" 1083 "SIGNALS_Virtual_DcmDspUDS_Acm_fzabgs_w_signal" 1084 "SIGNALS_Virtual_DcmDspUDS_DID_2613Byte2Eto2F_signal_VirtFunc_s" 1085 "SIGNALS_Virtual_DcmDspUDS_DID_261AByte08_signal" 1086 "SIGNALS_Virtual_DcmDspUDS_DID_261AByte09_signal" 1087 "SIGNALS_Virtual_DcmDspUDS_DID_E402Byte00_signal" 1088 "SIGNALS_Virtual_DcmDspUDS_DID_E402Byte01_signal" 1089 "SIGNALS_Virtual_DcmDspUDS_DID_E402Byte07to08_signal" 1090 "SIGNALS_Virtual_DcmDspUDS_DID_E402Byte10to11_signal" 1091 "SIGNALS_Virtual_DcmDspUDS_DID_E402Byte19to1A_signal" 1092 "SIGNALS_Virtual_DcmDspUDS_DID_E402Byte22to23_signal" 1093 "SIGNALS_Virtual_DcmDspUDS_DID_E402Byte2Bto2C_signal" 1094 "SIGNALS_Virtual_DcmDspUDS_DID_F110Byte0_3_signal" 1095 "SIGNALS_Virtual_DcmDspUDS_DID_F110Byte12_15_signal" 1096 "SIGNALS_Virtual_DcmDspUDS_DID_F110Byte16_signal" 1097 "SIGNALS_Virtual_DcmDspUDS_DID_F110Byte4_7_signal" 1098 "SIGNALS_Virtual_DcmDspUDS_DID_F110Byte8_11_signal" 1099 "SIGNALS_Virtual_DcmDspUDS_DID_F112Byte0_3_signal" 1100 "SIGNALS_Virtual_DcmDspUDS_DID_F112Byte12_15_signal" 1101 "SIGNALS_Virtual_DcmDspUDS_DID_F112Byte16_19_signal" 1102 "SIGNALS_Virtual_DcmDspUDS_DID_F112Byte20_23_signal" 1103 "SIGNALS_Virtual_DcmDspUDS_DID_F112Byte24_27_signal" 1104 "SIGNALS_Virtual_DcmDspUDS_DID_F112Byte28_29_signal" 1105 "SIGNALS_Virtual_DcmDspUDS_DID_F112Byte30_signal" 1106 "SIGNALS_Virtual_DcmDspUDS_DID_F112Byte4_7_signal" 1107 "SIGNALS_Virtual_DcmDspUDS_DID_F112Byte8_11_signal" 1108 "SIGNALS_Virtual_DcmDspUDS_E602Byte2_signal" 1109 "SIGNALS_Virtual_DcmDspUDS_F181Byte0_3_signal" 1110 "SIGNALS_Virtual_DcmDspUDS_F181Byte12_15_signal" 1111 "SIGNALS_Virtual_DcmDspUDS_F181Byte4_7_signal" 1112 "SIGNALS_Virtual_DcmDspUDS_F181Byte8_11_signal" 1113 "SIGNALS_Virtual_DcmDspUDS_fzabgs_w_signal" 1114 "SIGNALS_Virtual_DcmDspUDS_numReWrECUID1_signal" 1115 "SIGNALS_Virtual_DcmDspUDS_numReWrECUID2_signal" 1116 "SIGNALS_Virtual_I14229B9_0490_FrNo09_signal" 1117 "SIGNALS_Virtual_I14229B9_0490_FrNo10_signal" 1118 "SIGNALS_Virtual_I14229B9_04B1_FrNo16_signal" 1119 "SIGNALS_Virtual_I14229B9_04B1_FrNo17_signal" 1120 "SIGNALS_Virtual_I14229B9_04B1_FrNo20_signal" 1121 "SIGNALS_Virtual_I14229B9_04B1_FrNo21_signal" 1122 "SIGNALS_Virtual_I14229B9_04B1_FrNo22_signal" 1123 "SIGNALS_Virtual_I14229B9_04B1_FrNo23_signal" 1124 "SIGNALS_Virtual_I14229B9_04C2_FrNo2021_signal" 1125 "SIGNALS_Virtual_I14229B9_04D2_FrNo24_signal" 1126 "SIGNALS_Virtual_I14229B9_04D2_FrNo25_signal" 1127 "SIGNALS_Virtual_I14229B9_0520_FrNo15_signal" 1128 "SIGNALS_Virtual_I14229B9_0520_FrNo16_signal" 1129 "SIGNALS_Virtual_I14229B9_0523_FrNo42_signal" 1130 "SIGNALS_Virtual_I14229B9_0523_FrNo43_signal" 1131 "SIGNALS_Virtual_I14229B9_0524_FrNo09_signal" 1132 "SIGNALS_Virtual_I14229B9_0524_FrNo10_signal" 1133 "SIGNALS_Virtual_I14229B9_0550_FrNo09_signal" 1134 "SIGNALS_Virtual_I14229B9_0550_FrNo10_signal" 1135 "SIGNALS_Virtual_I14229B9_0553_FrNo13_signal" 1136 "SIGNALS_Virtual_I14229B9_0553_FrNo14_signal" 1137 "SIGNALS_Virtual_I14229B9_056A_FrNo8_signal" 1138 "SIGNALS_Virtual_I14229B9_056A_FrNo9_signal" 1139 "SIGNALS_Virtual_I14229B9_0588_FrNo15_signal" 1140 "SIGNALS_Virtual_I14229B9_0588_FrNo16_signal" 1141 "SIGNALS_Virtual_I14229B9_05A0_FrNo40_signal" 1142 "SIGNALS_Virtual_I14229B9_05A0_FrNo41_signal" 1143 "SIGNALS_Virtual_I14229B9_05B0_FrNo13_signal" 1144 "SIGNALS_Virtual_I14229B9_05B0_FrNo14_signal" 1145 "SIGNALS_Virtual_I14229B9_05C0_FrNo12_signal" 1146 "SIGNALS_Virtual_I14229B9_05C0_FrNo13_signal" 1147 "SIGNALS_Virtual_I14229B9_05E0_FrNo19_signal" 1148 "SIGNALS_Virtual_I14229B9_05E0_FrNo20_signal" 1149 "SIGNALS_Virtual_I14229B9_05E0_FrNo21_signal" 1150 "SIGNALS_Virtual_I14229B9_05E0_FrNo22_signal" 1151 "SIGNALS_Virtual_I14229B9_05E0_FrNo23_signal" 1152 "SIGNALS_Virtual_I14229B9_05E0_FrNo24_signal" 1153 "SIGNALS_Virtual_I14229B9_1208_FrNo34_signal" 1154 "SIGNALS_Virtual_I14229B9_1208_FrNo35_signal" 1155 "SIGNALS_Virtual_I14229B9_1208_FrNo36_signal" 1156 "SIGNALS_Virtual_I14229B9_1208_FrNo37_signal" 1157 "SIGNALS_Virtual_I14229B9_120A_FrNo09_signal" 1158 "SIGNALS_Virtual_I14229B9_120A_FrNo10_signal" 1159 "SIGNALS_Virtual_I14229B9_120B_FrNo09_signal" 1160 "SIGNALS_Virtual_I14229B9_120B_FrNo10_signal" 1161 "SIGNALS_Virtual_I14229_Com_aLgtG_signal" 1162 "SIGNALS_Virtual_I14229_pEngSrtMin_signal" 1163 "SIGNALS_Virtual_IKCtl_agAdpnCurr_s16_signal" 1164 "SIGNALS_Virtual_IKCtl_wIntgRef_au32_0__s" 1165 "SIGNALS_Virtual_PtCoornDyn_tqCluDes_signal" 1166 "SIGNALS_Virtual_PtCoornDyn_tqCluLeadTrsmIntv_signal" 1167 "SIGNALS_Virtual_Tra_numGear_signal" 1168 "SIGNALS_Virtual_i14229_agIntkB1GEVlvSig_signal" /end COMPU_VTAB
/begin COMPU_METHOD Temp_Cels "" RAT_FUNC "%6.1" "deg C" COEFFS 0 10 2731.4 0 0 1 /end COMPU_METHOD
/begin COMPU_METHOD Time_ms "" RAT_FUNC "%6.1" "ms" COEFFS 0 0.1 0 0 0 1 /end COMPU_METHOD
/begin COMPU_METHOD Time_s "" RAT_FUNC "%6.4" "s" COEFFS 0 100 0 0 0 1 /end COMPU_METHOD
/begin COMPU_METHOD Vel "" RAT_FUNC "%6.4" "km/h" COEFFS 0 100 0 0 0 1 /end COMPU_METHOD
/begin RECORD_LAYOUT Cur_Xs16Ws16 NO_AXIS_PTS_X 1 SWORD AXIS_PTS_X 2 SWORD INDEX_INCR DIRECT FNC_VALUES 3 SWORD COLUMN_DIR DIRECT /end RECORD_LAYOUT
/begin RECORD_LAYOUT ValA_Wu16 FNC_VALUES 1 UWORD COLUMN_DIR DIRECT /end RECORD_LAYOUT
/begin RECORD_LAYOUT Val_Ws16 FNC_VALUES 1 SWORD COLUMN_DIR DIRECT /end RECORD_LAYOUT
/begin RECORD_LAYOUT Val_Wu16 FNC_VALUES 1 UWORD COLUMN_DIR DIRECT /end RECORD_LAYOUT
/begin RECORD_LAYOUT Val_Wu8 FNC_VALUES 1 UBYTE COLUMN_DIR DIRECT /end RECORD_LAYOUT
/end MODULE
/end PROJECT
