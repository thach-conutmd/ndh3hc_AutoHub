ASAP2_VERSION 1 60
/begin PROJECT MG1CS022 "MG1CS022"
/begin HEADER "" VERSION "MG1CS022_62XSC_V037_TPROT" PROJECT_NO MG1CS022 /end HEADER
/begin MODULE DIM ""
/begin MOD_COMMON "" BYTE_ORDER MSB_LAST ALIGNMENT_BYTE 1 ALIGNMENT_WORD 2 ALIGNMENT_LONG 4 ALIGNMENT_INT64 4 ALIGNMENT_FLOAT32_IEEE 4 ALIGNMENT_FLOAT64_IEEE 4 DATA_SIZE 32 /end MOD_COMMON
/begin CHARACTERISTIC CWDLLR "Codeword for DLLR configuration" VALUE 0x8053AAD0 RB_Val_Wu8 255.0 dez 0.00 255.0 FORMAT "%5.1" /end CHARACTERISTIC
/begin CHARACTERISTIC CWDLLR2 "Codeword for DLLR configuration" VALUE 0x8053AAD1 RB_Val_Wu8 255.0 dez 0.00 255.0 FORMAT "%5.1" /end CHARACTERISTIC
/begin CHARACTERISTIC CWDPLETHS "Codeword Diagnosis Ethanolsensor" VALUE 0x8053AC9E RB_Val_Wu8 255.0 dez 0.00 255.0 FORMAT "%5.1" /end CHARACTERISTIC
/begin CHARACTERISTIC CWDPLTETHS "Codeword Diagnosis Temperature Ethanolsensor" VALUE 0x8053AD3A RB_Val_Wu8 255.0 dez 0.00 255.0 FORMAT "%5.1" /end CHARACTERISTIC
/begin CHARACTERISTIC DDPSRPSINI "Delta Intakemanifold pressure to ambient pressure during start" VALUE 0x8053ACFE RB_Val_Wu16 5119.922 p_q0p078 0.00 5119.922 FORMAT "%8.3" /end CHARACTERISTIC
/begin CHARACTERISTIC DDQFGDGMN "min. difference in the spreading of mixture factor for error suspicion for stuck-error ethanol sensor" VALUE 0x8053ACA0 RB_Val_Wu16 1.999969 fak_uw_b2 0.00 1.999969 FORMAT "%8.6" /end CHARACTERISTIC
/begin CHARACTERISTIC DFERDEGRMX "maximum delta between two consecutive ethanol sensor raw values" VALUE 0x8053ACA2 RB_Val_Wu16 1.999969 fak_uw_b2 0.00 1.999969 FORMAT "%8.6" /end CHARACTERISTIC
/begin CHARACTERISTIC DFETHDEDG "delta factor ethanol sensorvalue for detection ""refueling always the same blend""" VALUE 0x8053ACA4 RB_Val_Wu16 1.999969 fak_uw_b2 0.00 1.999969 FORMAT "%8.6" /end CHARACTERISTIC
/begin CHARACTERISTIC DFETHDEDKW "delta factor ethanol at injection valve for detection ""change of blend finished""" VALUE 0x8053ACA6 RB_Val_Wu16 1.999969 fak_uw_b2 0.00 1.999969 FORMAT "%8.6" /end CHARACTERISTIC
/begin CHARACTERISTIC DFETHDEDW "delta factor ethanol at injection valve for detection ""change of blend""" VALUE 0x8053ACA8 RB_Val_Wu16 1.999969 fak_uw_b2 0.00 1.999969 FORMAT "%8.6" /end CHARACTERISTIC
/begin CHARACTERISTIC DFETHREVKW "delta factor ethanol raw value to factor ethanol at injection valve for detection ""change of blend finished""" VALUE 0x8053ACAA RB_Val_Wu16 1.999969 fak_uw_b2 0.00 1.999969 FORMAT "%8.6" /end CHARACTERISTIC
/begin CHARACTERISTIC DFFFRDEMX "maximum delta mixture for enabling drift diagnosis ethanol sensor for ""refueling always the same blend"" initialized" VALUE 0x8053ACAC RB_Val_Wu16 1.999969 fak_uw_b2 0.00 1.999969 FORMAT "%8.6" /end CHARACTERISTIC
/begin CHARACTERISTIC DLLR_nDiagTestOfs_C "idle speed offset for the test off the idle speed diagnosis" VALUE 0x8053AAD2 RB_Val_Ws16 32767.50 nmot_sw_q0p5 -16384.00 16383.50 FORMAT "%8.2" /end CHARACTERISTIC
/begin CHARACTERISTIC DLLR_nDifActvnCSERS_C "threshold for the idle speed setpoint spread to activate the CSERS diagnosis" VALUE 0x8053AAD4 RB_Val_Ws16 32767.50 nmot_sw_q0p5 -16384.00 16383.50 FORMAT "%8.2" /end CHARACTERISTIC
/begin CHARACTERISTIC DLLR_nMnErrThdCatHeatgDrv_GT "Maximal speed deviation for detection of low speed during catalyst heating (driving state)" CURVE 0x8053AAD6 RB_CurveGroup_S8 1270. nmot_sb_q10 0.00 1270. FORMAT "%5.0" EXTENDED_LIMITS -1280. 1270.
 /begin AXIS_DESCR COM_AXIS CEngDsT_t Temp_Cels 8 -3549.940 3003.560 FORMAT "%8.3" AXIS_PTS_REF DLLR_tEng_Ax /end AXIS_DESCR
/end CHARACTERISTIC
/begin CHARACTERISTIC DLLR_nMnErrThdCatHeatg_GT "Maximal speed deviation for detection of low speed during catalyst heating" CURVE 0x8053AADE RB_CurveGroup_S8 1270. nmot_sb_q10 0.00 1270. FORMAT "%5.0" EXTENDED_LIMITS -1280. 1270.
 /begin AXIS_DESCR COM_AXIS CEngDsT_t Temp_Cels 8 -3549.940 3003.560 FORMAT "%8.3" AXIS_PTS_REF DLLR_tEng_Ax /end AXIS_DESCR
/end CHARACTERISTIC
/begin CHARACTERISTIC DLLR_nMxErrThdCatHeatgDrv_GT "Maximal speed deviation for detection of high speed during catalyst heating (driving state)" CURVE 0x8053AAE6 RB_CurveGroup_S8 1280. nmot_sb_q10 -1280. 0.00 FORMAT "%5.0" EXTENDED_LIMITS -1280. 1270.
 /begin AXIS_DESCR COM_AXIS CEngDsT_t Temp_Cels 8 -3549.940 3003.560 FORMAT "%8.3" AXIS_PTS_REF DLLR_tEng_Ax /end AXIS_DESCR
/end CHARACTERISTIC
/begin CHARACTERISTIC DLLR_nMxErrThdCatHeatg_GT "Maximal speed deviation for detection of high speed during catalyst heating" CURVE 0x8053AAEE RB_CurveGroup_S8 1280. nmot_sb_q10 -1280. 0.00 FORMAT "%5.0" EXTENDED_LIMITS -1280. 1270.
 /begin AXIS_DESCR COM_AXIS CEngDsT_t Temp_Cels 8 -3549.940 3003.560 FORMAT "%8.3" AXIS_PTS_REF DLLR_tEng_Ax /end AXIS_DESCR
/end CHARACTERISTIC
/begin CHARACTERISTIC DLLR_stDiagTest_CW "switch to activate improvments for the function test" VALUE 0x8053AAF6 RB_Val_Wu8 255.0 OneToOne 0.00 255.0 FORMAT "%5.1" /end CHARACTERISTIC
/begin AXIS_PTS DLLR_tEng_Ax "group axis points engine temperature" 0x8053AAF8 CEngDsT_t RB_Axis_S16 6553.500 Temp_Cels 8 -3549.940 3003.560 FORMAT "%8.3" DEPOSIT ABSOLUTE /end AXIS_PTS
/begin CHARACTERISTIC DLLR_ThdnPl_C "gradient based error threshold" VALUE 0x8053AB0A RB_Val_Wu16 16383.75 nmot_uw_q0p25 0.00 16383.75 FORMAT "%8.2" /end CHARACTERISTIC
/begin CHARACTERISTIC DNDLLRO "Maximal speed deviation (low speed) for diagnosis of idle speed control" VALUE 0x8053AB0C RB_Val_Ws8 1270. nmot_sb_q10 0.00 1270. FORMAT "%5.0" EXTENDED_LIMITS -1280. 1270. /end CHARACTERISTIC
/begin CHARACTERISTIC DNDLLROKH "Maximal speed deviation (low speed) for diagnosis of idle speed control during catalyst heating" VALUE 0x8053AB0D RB_Val_Ws8 1270. nmot_sb_q10 0.00 1270. FORMAT "%5.0" EXTENDED_LIMITS -1280. 1270. /end CHARACTERISTIC
/begin CHARACTERISTIC DNDLLRU "Maximal speed deviation (high speed) for diagnosis of idle speed control" VALUE 0x8053AB0E RB_Val_Ws8 1280. nmot_sb_q10 -1280. 0.00 FORMAT "%5.0" EXTENDED_LIMITS -1280. 1270. /end CHARACTERISTIC
/begin CHARACTERISTIC DNDLLRUKH "Maximal speed deviation (high speed) for diagnosis of idle speed control during catalyst heating" VALUE 0x8053AB0F RB_Val_Ws8 1280. nmot_sb_q10 -1280. 0.00 FORMAT "%5.0" EXTENDED_LIMITS -1280. 1270. /end CHARACTERISTIC
/begin CHARACTERISTIC DNMOTG "Nominal engine speed idling amplitude" VALUE 0x8053AB10 RB_Val_Ws16 8192.000 nmot_uw_q0p25 -8192.000 0.00 FORMAT "%8.3" EXTENDED_LIMITS -8192.000 8191.750 /end CHARACTERISTIC
/begin CHARACTERISTIC DOGov_dtrqDttme_C "deadtime/gradient time constant" VALUE 0x8053AB52 RB_Val_Wu8 4.000 dez 1.000 5.000 FORMAT "%5.3" EXTENDED_LIMITS 0.00 255.0 /end CHARACTERISTIC
/begin CHARACTERISTIC DOGov_dtrqThres_CUR "deadtimegradient threshold for detection drive off" CURVE 0x8053AB54 RB_Curve_S16_S16 6553.500 md_sw_q0p1 -3276.800 3276.700 FORMAT "%8.3"
 /begin AXIS_DESCR STD_AXIS DOGov_trqClth md_sw_q0p1 4 -3276.800 3276.700 FORMAT "%8.3" DEPOSIT ABSOLUTE /end AXIS_DESCR
/end CHARACTERISTIC
/begin CHARACTERISTIC DOGov_facFdbk_C "Feedback gain model speed deviation drive-off" VALUE 0x8053AB66 RB_Val_Wu8 1.000 q0p025_Nm_DIV_rpm 0.00 1.000 FORMAT "%5.3" EXTENDED_LIMITS 0.00 6.375 /end CHARACTERISTIC
/begin CHARACTERISTIC DOGov_facOvrSpd_C "Factor against overspeed" VALUE 0x8053AB67 RB_Val_Wu8 0.9961 fak_ub_b1 0.00 0.9961 /end CHARACTERISTIC
/begin CHARACTERISTIC DOGov_facRmpOff_GCUR "Factor for ramping at end of intervention" CURVE 0x8053AB68 RB_CurveGroup_U8 0.9961 fak_ub_b1 0.00 0.9961
 /begin AXIS_DESCR COM_AXIS APP_r Prc 3 -400.0000 399.9878 FORMAT "%8.4" AXIS_PTS_REF DOGov_rAPP_DST /end AXIS_DESCR
/end CHARACTERISTIC
/begin CHARACTERISTIC DoGov_facTqLead_M "Driveoff governor torque correction factor for lead path" MAP 0x8053AB6C RB_Map_S16S16_S16 4.000000 Fact4 0.00 4.000000 FORMAT "%8.6" EXTENDED_LIMITS -1638.400 1638.350
 /begin AXIS_DESCR STD_AXIS DOGov_nDiff EngN 5 -16384.00 16383.50 FORMAT "%8.2" DEPOSIT ABSOLUTE /end AXIS_DESCR
 /begin AXIS_DESCR STD_AXIS DOGov_dnEngFltLoc nmotg_sw_q0p39 5 -12800.16 12799.77 FORMAT "%8.2" DEPOSIT ABSOLUTE /end AXIS_DESCR
/end CHARACTERISTIC
/begin CHARACTERISTIC DOGov_facTqSet_M "Driveoff governor torque correction factor for set path" MAP 0x8053ABB6 RB_Map_S16S16_S16 4.000000 Fact4 0.00 4.000000 FORMAT "%8.6" EXTENDED_LIMITS -1638.400 1638.350
 /begin AXIS_DESCR STD_AXIS DOGov_nDifSyncn EngN 5 -16384.00 16383.50 FORMAT "%8.2" DEPOSIT ABSOLUTE /end AXIS_DESCR
 /begin AXIS_DESCR STD_AXIS DOGov_dnEngFltLocSyncn nmotg_sw_q0p39 5 -12800.16 12799.77 FORMAT "%8.2" DEPOSIT ABSOLUTE /end AXIS_DESCR
/end CHARACTERISTIC
/begin CHARACTERISTIC DOGov_flgSwtNGrdt_C "flag for filtered engine speed gradient selection switch" VALUE 0x8053AC00 RB_Val_Wboolean 1.00000000000 B_TRUE 0.00 1.00000000000 FORMAT "%13.11" /end CHARACTERISTIC
/begin CHARACTERISTIC DOGov_KClthPos_C "Filter constant of Clutch position average" VALUE 0x8053AC02 RB_Val_Wu16 0.9999847 fak_uw_b1 0.00 0.9999847 FORMAT "%9.7" /end CHARACTERISTIC
/begin CHARACTERISTIC DOGov_KiMod_CUR "integrator gain drive-off" CURVE 0x8053AC04 RB_Curve_S16_S16 499.9924 q7p62939Em3_rpm_DIV_Nm_s -250.0000 249.9924 FORMAT "%8.4"
 /begin AXIS_DESCR STD_AXIS PT_rTraV2N VelToN 2 -0.3276800 0.3276700 FORMAT "%9.7" DEPOSIT ABSOLUTE /end AXIS_DESCR
/end CHARACTERISTIC
/begin CHARACTERISTIC DOGov_KpLead_GCUR "drive-off torque for set path" CURVE 0x8053AC0E RB_CurveGroup_U8 0.7969 q0p003125_Nm_DIV_rpm 0.00 0.7969
 /begin AXIS_DESCR COM_AXIS APP_r Prc 3 -400.0000 399.9878 FORMAT "%8.4" AXIS_PTS_REF DOGov_rAPP_DST /end AXIS_DESCR
/end CHARACTERISTIC
/begin CHARACTERISTIC DOGov_Kp_GCUR "gain of drive off governor" CURVE 0x8053AC11 RB_CurveGroup_U8 0.7969 q0p003125_Nm_DIV_rpm 0.00 0.7969
 /begin AXIS_DESCR COM_AXIS APP_r Prc 3 -400.0000 399.9878 FORMAT "%8.4" AXIS_PTS_REF DOGov_rAPP_DST /end AXIS_DESCR
/end CHARACTERISTIC
/begin CHARACTERISTIC DOGov_nDiffThres_CUR "engine speed deviation drive-off support for drive off condition" CURVE 0x8053AC14 RB_Curve_S16_S16 32767.50 EngN -16384.00 16383.50 FORMAT "%8.2"
 /begin AXIS_DESCR STD_AXIS APP_r Prc 2 -400.0000 399.9878 FORMAT "%8.4" DEPOSIT ABSOLUTE /end AXIS_DESCR
/end CHARACTERISTIC
/begin CHARACTERISTIC DOGov_nEngMax_C "Maximal engine speed for calculation of drive-off model" VALUE 0x8053AC1E RB_Val_Ws16 32767.50 EngN -16384.00 16383.50 FORMAT "%8.2" /end CHARACTERISTIC
/begin CHARACTERISTIC DOGov_nOfsMaxAbs_GCUR "absolute maximum overspeed offset" CURVE 0x8053AC20 RB_CurveGroup_S16 16383.50 EngN 0.00 16383.50 FORMAT "%8.2" EXTENDED_LIMITS -16384.00 16383.50
 /begin AXIS_DESCR COM_AXIS APP_r Prc 3 -400.0000 399.9878 FORMAT "%8.4" AXIS_PTS_REF DOGov_rAPP_DST /end AXIS_DESCR
/end CHARACTERISTIC
/begin CHARACTERISTIC DOGov_nOfsMax_GCUR "relative maximum overspeed" CURVE 0x8053AC26 RB_CurveGroup_S16 16383.50 EngN 0.00 16383.50 FORMAT "%8.2" EXTENDED_LIMITS -16384.00 16383.50
 /begin AXIS_DESCR COM_AXIS DOGov_n EngN 4 -16384.00 16383.50 FORMAT "%8.2" AXIS_PTS_REF DOGov_n_DST /end AXIS_DESCR
/end CHARACTERISTIC
/begin CHARACTERISTIC DOGov_nOvrSpd_GCUR "absolute offset against overspeed" CURVE 0x8053AC2E RB_CurveGroup_S16 16383.50 EngN 0.00 16383.50 FORMAT "%8.2" EXTENDED_LIMITS -16384.00 16383.50
 /begin AXIS_DESCR COM_AXIS APP_r Prc 3 -400.0000 399.9878 FORMAT "%8.4" AXIS_PTS_REF DOGov_rAPP_DST /end AXIS_DESCR
/end CHARACTERISTIC
/begin CHARACTERISTIC DOGov_nUndrSpd_GCUR "reactivation for overshootfunction under engine speed" CURVE 0x8053AC34 RB_CurveGroup_S16 32767.50 EngN -16384.00 16383.50 FORMAT "%8.2"
 /begin AXIS_DESCR COM_AXIS APP_r Prc 3 -400.0000 399.9878 FORMAT "%8.4" AXIS_PTS_REF DOGov_rAPP_DST /end AXIS_DESCR
/end CHARACTERISTIC
/begin AXIS_PTS DOGov_n_DST "distribution for engine speed" 0x8053AC3A DOGov_n RB_Axis_S16 32767.50 EngN 4 -16384.00 16383.50 FORMAT "%8.2" DEPOSIT ABSOLUTE /end AXIS_PTS
/begin AXIS_PTS DOGov_rAPP_DST "distribution accelerator pedal" 0x8053AC44 APP_r RB_Axis_S16 799.9878 Prc 3 -400.0000 399.9878 FORMAT "%8.4" DEPOSIT ABSOLUTE /end AXIS_PTS
/begin CHARACTERISTIC DOGov_rClthAPP_CUR "Correction of the average value of the clutch position" CURVE 0x8053AC4C RB_Curve_S16_S16 799.9878 Prc -400.0000 399.9878 FORMAT "%8.4"
 /begin AXIS_DESCR STD_AXIS APP_r Prc 3 -400.0000 399.9878 FORMAT "%8.4" DEPOSIT ABSOLUTE /end AXIS_DESCR
/end CHARACTERISTIC
/begin CHARACTERISTIC DOGov_rClthDeactvMax_C "Difference of Clutch position from average for widening thresholds" VALUE 0x8053AC5A RB_Val_Ws16 799.9878 Prc -400.0000 399.9878 FORMAT "%8.4" /end CHARACTERISTIC
/begin CHARACTERISTIC DOGov_rClthMax_C "Upper threshold for the enlargement algorithm for the clutch position" VALUE 0x8053AC5C RB_Val_Ws16 799.9878 Prc -400.0000 399.9878 FORMAT "%8.4" /end CHARACTERISTIC
/begin CHARACTERISTIC DOGov_rClthMin_C "Lower threshold for the enlargement algorithm for the clutch position" VALUE 0x8053AC5E RB_Val_Ws16 799.9878 Prc -400.0000 399.9878 FORMAT "%8.4" /end CHARACTERISTIC
/begin CHARACTERISTIC DOGov_rClthStepDwn_C "Stepsize for narrowing the clutch thresholds" VALUE 0x8053AC60 RB_Val_Ws16 799.9878 Prc -400.0000 399.9878 FORMAT "%8.4" /end CHARACTERISTIC
/begin CHARACTERISTIC DOGov_rClthStepUp_C "Stepsize for widening the clutch thresholds" VALUE 0x8053AC62 RB_Val_Ws16 799.9878 Prc -400.0000 399.9878 FORMAT "%8.4" /end CHARACTERISTIC
/begin CHARACTERISTIC DOGov_stCfg2_CW "configuration label 2 of drive-off controll" VALUE 0x8053AC64 RB_Val_Wu8 255.0 dez 0.00 255.0 FORMAT "%5.1" /end CHARACTERISTIC
/begin CHARACTERISTIC DOGov_stCfg_CW "configuration label of drive-off controller" VALUE 0x8053AC65 RB_Val_Wu8 255.0 dez 0.00 255.0 FORMAT "%5.1" /end CHARACTERISTIC
/begin CHARACTERISTIC DOGov_tiAcsDT1_C "DT1 time constant for accessories" VALUE 0x8053AC66 RB_Val_Wu8 2.550 t_q0p01 0.00 2.550 FORMAT "%5.3" /end CHARACTERISTIC
/begin CHARACTERISTIC DOGov_tiActv_C "Maximum intervention time for drive off process" VALUE 0x8053AC68 RB_Val_Wu16 655.3500 t_q0p01 0.00 655.3500 FORMAT "%8.4" /end CHARACTERISTIC
/begin CHARACTERISTIC DOGov_tiResvActv_C "drive-off controller torque reserve activation time" VALUE 0x8053AC6A RB_Val_Wu8 2.550 t_q0p01 0.00 2.550 FORMAT "%5.3" /end CHARACTERISTIC
/begin CHARACTERISTIC DOGov_tiThresFlt_C "PT1 time constant for filtering actual torque" VALUE 0x8053AC6B RB_Val_Wu8 2.550 t_q0p01 0.00 2.550 FORMAT "%5.3" /end CHARACTERISTIC
/begin CHARACTERISTIC DOGov_trqClthThresCatHeatg_C "Threshold for drive-off detection when catalyst heating is active" VALUE 0x8053AC6C RB_Val_Ws16 6553.500 md_sw_q0p1 -3276.800 3276.700 FORMAT "%8.3" /end CHARACTERISTIC
/begin CHARACTERISTIC DOGov_trqClthThresUnsty_C "Threshold for drive-off detection unsteady" VALUE 0x8053AC6E RB_Val_Ws16 6553.500 md_sw_q0p1 -3276.800 3276.700 FORMAT "%8.3" /end CHARACTERISTIC
/begin CHARACTERISTIC DOGov_trqClthThres_C "Threshold for drive-off detection" VALUE 0x8053AC70 RB_Val_Ws16 6553.500 md_sw_q0p1 -3276.800 3276.700 FORMAT "%8.3" /end CHARACTERISTIC
/begin CHARACTERISTIC DOGov_trqDebLead_C "Threshold for Debounce level lead path" VALUE 0x8053AC72 RB_Val_Wu8 25.50 md_sw_q0p1 0.00 25.50 FORMAT "%5.2" /end CHARACTERISTIC
/begin CHARACTERISTIC DOGov_trqDebSet_C "Threshold for Debounce level set path" VALUE 0x8053AC73 RB_Val_Wu8 25.50 md_sw_q0p1 0.00 25.50 FORMAT "%5.2" /end CHARACTERISTIC
/begin CHARACTERISTIC DOGov_trqMaxMon_GMAP "absolute maximum torque for monitoring" MAP 0x8053AC74 RB_MapGroup_S16 3276.700 md_sw_q0p1 0.00 3276.700 FORMAT "%8.3" EXTENDED_LIMITS -3276.800 3276.700
 /begin AXIS_DESCR COM_AXIS DOGov_n EngN 4 -16384.00 16383.50 FORMAT "%8.2" AXIS_PTS_REF DOGov_n_DST /end AXIS_DESCR
 /begin AXIS_DESCR COM_AXIS APP_r Prc 3 -400.0000 399.9878 FORMAT "%8.4" AXIS_PTS_REF DOGov_rAPP_DST /end AXIS_DESCR
/end CHARACTERISTIC
/begin CHARACTERISTIC DOGov_trqResvMaxRmp_C "offset for fade out of maximal delta torque memory of drive-off controller" VALUE 0x8053AC8C RB_Val_Wu8 25.50 md_sw_q0p1 0.00 25.50 FORMAT "%5.2" /end CHARACTERISTIC
/begin CHARACTERISTIC DoGov_trqResvMin_GCUR "minimum for drive-off reserve" CURVE 0x8053AC8E RB_CurveGroup_U16 150.0000 md_sw_q0p1 0.00 150.0000 FORMAT "%8.4" EXTENDED_LIMITS 0.00 6553.500
 /begin AXIS_DESCR COM_AXIS APP_r Prc 3 -400.0000 399.9878 FORMAT "%8.4" AXIS_PTS_REF DOGov_rAPP_DST /end AXIS_DESCR
/end CHARACTERISTIC
/begin CHARACTERISTIC DOGov_trqResvOffRmp_C "offset for deramp of drive-off controller torque reserve" VALUE 0x8053AC94 RB_Val_Wu8 25.50 md_sw_q0p1 0.00 25.50 FORMAT "%5.2" /end CHARACTERISTIC
/begin CHARACTERISTIC DOGov_trqRmpOff_GCUR "gradient off switch-off ramp" CURVE 0x8053AC95 RB_CurveGroup_U8 25.50 md_sw_q0p1 0.00 25.50 FORMAT "%5.2"
 /begin AXIS_DESCR COM_AXIS APP_r Prc 3 -400.0000 399.9878 FORMAT "%8.4" AXIS_PTS_REF DOGov_rAPP_DST /end AXIS_DESCR
/end CHARACTERISTIC
/begin CHARACTERISTIC DOGov_trqThresSwtUnsty_C "activation threshold for instationary mode" VALUE 0x8053AC98 RB_Val_Ws16 327.6700 md_sw_q0p01 0.00 327.6700 FORMAT "%8.4" EXTENDED_LIMITS -327.6800 327.6700 /end CHARACTERISTIC
/begin CHARACTERISTIC DOGov_vMax_C "Vehicle speed threshold for deactivation drive-off support" VALUE 0x8053AC9A RB_Val_Ws16 655.3500 Vel -327.6800 327.6700 FORMAT "%8.4" /end CHARACTERISTIC
/begin CHARACTERISTIC DOGov_vMin_C "Vehicle speed threshold for activation drive-off support" VALUE 0x8053AC9C RB_Val_Ws16 655.3500 Vel -327.6800 327.6700 FORMAT "%8.4" /end CHARACTERISTIC
/begin CHARACTERISTIC DPSRM "Tolerance band in which healing can take place" VALUE 0x8053AD00 RB_Val_Wu8 1.992188 fak_ub_b2 0.00 1.992188 FORMAT "%8.6" /end CHARACTERISTIC
/begin CHARACTERISTIC DPSRMFA "Tolerance band in which healing can take place (function demand)" VALUE 0x8053AD01 RB_Val_Wu8 1.992188 fak_ub_b2 0.00 1.992188 FORMAT "%8.6" /end CHARACTERISTIC
/begin CHARACTERISTIC DPSRSVMN "lower limit for signal-variation-check" VALUE 0x8053AD02 RB_Val_Wu16 5119.922 p_q0p078 0.00 5119.922 FORMAT "%8.3" /end CHARACTERISTIC
/begin CHARACTERISTIC DPSWATCHINDEX "Index of the observed output stage (in case of diagnosis problem)" VALUE 0x8058A318 KwUb 255.0 dez 0.00 255.0 FORMAT "%5.1" /end CHARACTERISTIC
/begin CHARACTERISTIC DPTPSRMX "max tolerances of manifold pressure sensor" VALUE 0x8053AD04 RB_Val_Wu16 5119.922 p_q0p078 0.00 5119.922 FORMAT "%8.3" /end CHARACTERISTIC
/begin CHARACTERISTIC DPUPSINIMX "tolerances between psini_w and ambient pressure" VALUE 0x8053AD06 RB_Val_Wu16 2559.961 p_q0p039 0.00 2559.961 FORMAT "%8.3" /end CHARACTERISTIC
/begin CHARACTERISTIC DQFEDEGUMN "delta quotient factor ethanol at injection valve for healing stuck-error" VALUE 0x8053ACAE RB_Val_Wu16 1.999969 fak_uw_b2 0.00 1.999969 FORMAT "%8.6" /end CHARACTERISTIC
/begin CHARACTERISTIC DQFFDEDGMX "delta quotient ffuel_w for detection ethanolsensor drift error for ""refueling always the same blend""" VALUE 0x8053ACB0 RB_Val_Wu16 1.999969 fak_uw_b2 0.00 1.999969 FORMAT "%8.6" /end CHARACTERISTIC
/begin CHARACTERISTIC DQFGDEGUMN "error suspicion thresholf of mixture factor of mixture monitoring for stuck-check of ethanol sensor" VALUE 0x8053ACB2 RB_Val_Wu16 7.999878 fak_uw_b8 0.00 7.999878 FORMAT "%8.6" /end CHARACTERISTIC
/begin CHARACTERISTIC DQFRDEGUMX "delta quotient FRA for confirmation of error suspicion for stuck-error ethanol sensor" VALUE 0x8053ACB4 RB_Val_Wu16 1.999969 fak_uw_b2 0.00 1.999969 FORMAT "%8.6" /end CHARACTERISTIC
/begin CHARACTERISTIC DVDEGUMN "minimum delta fuel consumption since refueling stop for change of blend at injection valve" VALUE 0x8053ACB6 RB_Val_Wu16 255.9961 vol_q3p90625Em3_l 0.00 255.9961 FORMAT "%8.4" /end CHARACTERISTIC
/begin CHARACTERISTIC DVDEGUMX "maximum delta fuel consumption since refueling stop for change of blend at injection valve finished" VALUE 0x8053ACB8 RB_Val_Wu16 255.9961 vol_q3p90625Em3_l 0.00 255.9961 FORMAT "%8.4" /end CHARACTERISTIC
/begin CHARACTERISTIC DVDEGUMXMX "limit of maximum delta fuel consumption since refueling stop for change of blend at injection valve finished" VALUE 0x8053ACBA RB_Val_Wu16 255.9961 vol_q3p90625Em3_l 0.00 255.9961 FORMAT "%8.4" /end CHARACTERISTIC
/begin CHARACTERISTIC DVTDEDGDEB "delta consumption to debounce detection ""refueling always the same blend"" after change of blend" VALUE 0x8053ACBC RB_Val_Wu16 255.9961 vol_q3p90625Em3_l 0.00 255.9961 FORMAT "%8.4" /end CHARACTERISTIC
/begin CHARACTERISTIC FETHDER1MX "upper limit ethanol range 1 for drift diagnosis for ""refueling different blend""" VALUE 0x8053ACBE RB_Val_Wu16 1.999969 fak_uw_b2 0.00 1.999969 FORMAT "%8.6" /end CHARACTERISTIC
/begin CHARACTERISTIC FETHDER2MX "upper limit ethanol range 2 for drift diagnosis for ""refueling different blend""" VALUE 0x8053ACC0 RB_Val_Wu16 1.999969 fak_uw_b2 0.00 1.999969 FORMAT "%8.6" /end CHARACTERISTIC
/begin CHARACTERISTIC FETHDER3MX "upper limit ethanol range 3 for drift diagnosis for ""refueling different blend""" VALUE 0x8053ACC2 RB_Val_Wu16 1.999969 fak_uw_b2 0.00 1.999969 FORMAT "%8.6" /end CHARACTERISTIC
/begin CHARACTERISTIC FETHEDEKR "min. ethanol concentration for detection of sensor error via knock control" VALUE 0x8053ACC4 RB_Val_Wu16 1.999969 fak_uw_b2 0.00 1.999969 FORMAT "%8.6" /end CHARACTERISTIC
/begin CHARACTERISTIC FfPrm_stAmbTSnsrCfg_C "code word for configuration of ambient temperature sensor signal (originally defined in GGTUMG)" VALUE 0x8053AD3B RB_Val_Wu8 255.0 dez 0.00 255.0 FORMAT "%5.1" /end CHARACTERISTIC
/begin CHARACTERISTIC FHDLLR "altitude threshold for performing of ISC-actuator diagnosis" VALUE 0x8053AB12 RB_Val_Wu8 3.984 fak_ub_b4 0.00 3.984 FORMAT "%5.3" /end CHARACTERISTIC
/begin CHARACTERISTIC FRAMNDEHL "lower FRA threshold for healing plaus-error ethanol sensor" VALUE 0x8053ACC6 RB_Val_Wu16 1.999969 fak_uw_b2 0.00 1.999969 FORMAT "%8.6" /end CHARACTERISTIC
/begin CHARACTERISTIC FRAMXDEHL "upper FRA threshold for healing plaus-error ethanol sensor" VALUE 0x8053ACC8 RB_Val_Wu16 1.999969 fak_uw_b2 0.00 1.999969 FORMAT "%8.6" /end CHARACTERISTIC
/begin CHARACTERISTIC FRFGGUSTMN "minimum reference factor for mixture factor of mixture monitoring for stuck-check of ethanol sensor stable" VALUE 0x8053ACCA RB_Val_Wu16 0.9999847 fak_uw_b1 0.00 0.9999847 FORMAT "%9.7" /end CHARACTERISTIC
/begin CHARACTERISTIC KLDTESXTAB "max. delta temperature ethanolsensor to reference temperature (diagnosis threshold)" CURVE 0x8053AD3C RB_Curve_U16_U8_Static 191.3 temp_ub_q0p75_o48 -48.0 143.3 FORMAT "%5.1"
 /begin AXIS_DESCR STD_AXIS tiStrtEndOff Time_sec_q1_COMPU 4 0.00 65535.00 FORMAT "%8.2" DEPOSIT ABSOLUTE /end AXIS_DESCR
/end CHARACTERISTIC
/begin CHARACTERISTIC KLTDFRDEGU "filter time constant for mixture deviation for mixture monitoring for stuck-check of ethanol sensor" CURVE 0x8053ACCC RB_Curve_U16_U16 13107.00 t_q0p2 0.00 13107.00 FORMAT "%8.2"
 /begin AXIS_DESCR STD_AXIS dyrldegu_w fak_uw_b16 4 0.00 15.99976 FORMAT "%8.5" DEPOSIT ABSOLUTE /end AXIS_DESCR
/end CHARACTERISTIC
/begin CHARACTERISTIC LIGov_rChrgCylLosCH_CUR "intake gas threshold during catalyst heating for idle speed diagnosis ;dep. on accessory load" CURVE 0x8053AB14 RB_Curve_S16_S16 1535.977 rel_q0p02344 -768.0000 767.9766 FORMAT "%8.4"
 /begin AXIS_DESCR STD_AXIS RngMod_trqLos md_sw_q0p1 3 -3276.800 3276.700 FORMAT "%8.3" DEPOSIT ABSOLUTE /end AXIS_DESCR
/end CHARACTERISTIC
/begin CHARACTERISTIC LIGov_rChrgCylLos_CUR "intake gas threshold for idle speed diagnosis ;dep. on accessory load" CURVE 0x8053AB22 RB_Curve_S16_S16 1535.977 rel_q0p02344 -768.0000 767.9766 FORMAT "%8.4"
 /begin AXIS_DESCR STD_AXIS RngMod_trqLos md_sw_q0p1 3 -3276.800 3276.700 FORMAT "%8.3" DEPOSIT ABSOLUTE /end AXIS_DESCR
/end CHARACTERISTIC
/begin CHARACTERISTIC LIGov_stGlbDaExtTrqDemMsk_C "Bit mask to select desired external torque demands for release of idle speed diagnosis" VALUE 0x8053AB30 RB_Val_Wu16 65535.00 OneToOne 0.00 65535.00 FORMAT "%8.2" /end CHARACTERISTIC
/begin CHARACTERISTIC MFRADEDWDL "digital lowpass constant for filtering medium fra values over ethanol ranges" VALUE 0x8053ACDE RB_Val_Wu16 0.9999847 fak_uw_b1 0.00 0.9999847 FORMAT "%9.7" /end CHARACTERISTIC
/begin CHARACTERISTIC NFRASTDED "number of stable detection necessary after a fuel change until fra_w is adapted correctly" VALUE 0x8053ACE0 RB_Val_Wu8 254.0 dez 1.0 255.0 FORMAT "%5.1" EXTENDED_LIMITS 0.00 255.0 /end CHARACTERISTIC
/begin CHARACTERISTIC NMOTGNP "Engine speed amplitude error threshold for non-plausible error" VALUE 0x8053AB32 RB_Val_Wu16 16383.75 nmot_uw_q0p25 0.00 16383.75 FORMAT "%8.2" /end CHARACTERISTIC
/begin CHARACTERISTIC NMOTMNDDSS "under engine speed limit for initialization psini_w with psdss_w" VALUE 0x8053AD08 RB_Val_Ws16 32767.50 EngN -16384.00 16383.50 FORMAT "%8.2" /end CHARACTERISTIC
/begin CHARACTERISTIC NMOTSC "Difference of engine speed with stored value to determine the similar conditions window" VALUE 0x8053AACC RB_Val_Wu16 0.00 nmot_uw_q0p25 375.0000 375.0000 FORMAT "%8.4" EXTENDED_LIMITS 0.00 16383.75 /end CHARACTERISTIC
/begin CHARACTERISTIC NMOTZPLMN "Engine speed threshold for tested condition in rationality diagnosis" VALUE 0x8053AD0A RB_Val_Ws16 32767.50 EngN -16384.00 16383.50 FORMAT "%8.2" /end CHARACTERISTIC
/begin CHARACTERISTIC NPSRSVMN "engine speed limit for lower manifold pressure of signal variation check" VALUE 0x8053AD0C RB_Val_Ws16 32767.50 EngN -16384.00 16383.50 FORMAT "%8.2" /end CHARACTERISTIC
/begin CHARACTERISTIC NPSRSVMX "engine speed limit for upper manifold pressure of signal variation check" VALUE 0x8053AD0E RB_Val_Ws16 32767.50 EngN -16384.00 16383.50 FORMAT "%8.2" /end CHARACTERISTIC
/begin CHARACTERISTIC PSRMN "Lower pressure limit for range check" VALUE 0x8053AD10 RB_Val_Wu16 5119.922 p_q0p078 0.00 5119.922 FORMAT "%8.3" /end CHARACTERISTIC
/begin CHARACTERISTIC PSRMX "Upper pressure limit for range check" VALUE 0x8053AD12 RB_Val_Wu16 5119.922 p_q0p078 0.00 5119.922 FORMAT "%8.3" /end CHARACTERISTIC
/begin CHARACTERISTIC PthSet_stDia_CW "Code word for module DMBEG" VALUE 0x8053AB4C RB_Val_Wu8 255.0 dez 0.00 255.0 FORMAT "%5.1" /end CHARACTERISTIC
/begin CHARACTERISTIC PthSet_tiMonLimDiaErr_C "Debouncing time for diagnosis entry by monitoring level 1" VALUE 0x8053AB4E RB_Val_Wu16 65535.00 t_q1 0.00 65535.00 FORMAT "%8.2" /end CHARACTERISTIC
/begin CHARACTERISTIC PthSet_tiMonLimDiaHeal_C "Debouncing time for healing of diagnosis entry by monitoring level 1" VALUE 0x8053AB50 RB_Val_Wu16 65535.00 t_q1 0.00 65535.00 FORMAT "%8.2" /end CHARACTERISTIC
/begin CHARACTERISTIC PUPLPSRMN "min. ambient pressure for intake manifold pressure diagnosis" VALUE 0x8053AD14 RB_Val_Wu16 2559.961 p_q0p039 0.00 2559.961 FORMAT "%8.3" /end CHARACTERISTIC
/begin CHARACTERISTIC QFRADEDRMX "maximum quotient of medium FRA values over ethanol ranges for drift diagnosis for ""refueling different blend""" VALUE 0x8053ACE2 RB_Val_Wu16 1.999969 fak_uw_b2 0.00 1.999969 FORMAT "%8.6" /end CHARACTERISTIC
/begin CHARACTERISTIC RLRKADEGU "reference-rl for mixture factor of mixture monitoring for stuck-check of ethanol sensor" VALUE 0x8053ACE4 RB_Val_Wu16 1535.977 rel_uw_q0p0234 0.00 1535.977 FORMAT "%8.3" /end CHARACTERISTIC
/begin CHARACTERISTIC RMLSC "Difference of load with stored value to determine the similar conditions window" VALUE 0x8053AACE RB_Val_Wu8 0.00 fak_ub_b100 20.00 20.00 FORMAT "%5.2" EXTENDED_LIMITS 0.00 100.0 /end CHARACTERISTIC
/begin CHARACTERISTIC SF_PSR "Sum Fault PSR" VAL_BLK 0x8053AD16 RB_ValA_Wu16 82.0000000000 dfp_verbal 0.00 82.0000000000 FORMAT "%13.10" READ_ONLY NUMBER 3 /end CHARACTERISTIC
/begin CHARACTERISTIC SF_PSR1 "Sum Fault PSR 1st bank" VAL_BLK 0x8053AD1C RB_ValA_Wu16 82.0000000000 dfp_verbal 0.00 82.0000000000 FORMAT "%13.10" READ_ONLY NUMBER 5 /end CHARACTERISTIC
/begin CHARACTERISTIC TADLLR "intake air temperature threshold for ISC-actuator diagnosis" VALUE 0x8053AB34 RB_Val_Wu8 191.3 temp_ub_q0p75_o48 -48.0 143.3 FORMAT "%5.1" /end CHARACTERISTIC
/begin CHARACTERISTIC TBTKKL15M "minimum engine stop time (including idle phase before and after stop) for possible refueling" VALUE 0x8053ACE6 RB_Val_Wu16 13107.00 t_q0p2 0.00 13107.00 FORMAT "%8.2" /end CHARACTERISTIC
/begin CHARACTERISTIC TBTKSTOPM "minimum idle time for possible refueling" VALUE 0x8053ACE8 RB_Val_Wu16 13107.00 t_q0p2 0.00 13107.00 FORMAT "%8.2" /end CHARACTERISTIC
/begin CHARACTERISTIC TDEPSRB "Time delay for range diagnosis manifold pressure" VALUE 0x8053AD26 RB_Val_Wu8 25.50 t_q0p1 0.00 25.50 FORMAT "%5.2" /end CHARACTERISTIC
/begin CHARACTERISTIC TDEPSRP "Time delay for plausibility diagnosis manifold pressure" VALUE 0x8053AD27 RB_Val_Wu8 25.50 t_q0p1 0.00 25.50 FORMAT "%5.2" /end CHARACTERISTIC
/begin CHARACTERISTIC TDLKHNUM "Time delay for possible error detection during catalyst heating." VALUE 0x8053AB4A RB_Val_Wu8 51.00 t_q0p2 0.00 51.00 FORMAT "%5.2" /end CHARACTERISTIC
/begin CHARACTERISTIC TDLLFG1 "Time delay for setting the condition diagnosis of ISC-actuator" VALUE 0x8053AB35 RB_Val_Wu8 51.00 t200msxs_ub_b51 0.00 51.00 FORMAT "%5.2" /end CHARACTERISTIC
/begin CHARACTERISTIC TDLLFGKH "Time Constant: Physical release condition for DLLR catalyst heating." VALUE 0x8053AB36 RB_Val_Wu8 51.00 t200msxs_ub_b51 0.00 51.00 FORMAT "%5.2" /end CHARACTERISTIC
/begin CHARACTERISTIC TDLLRMN "Time delay before storing error of closed ISC-actuator" VALUE 0x8053AB37 RB_Val_Wu8 51.00 t200msxs_ub_b51 0.00 51.00 FORMAT "%5.2" /end CHARACTERISTIC
/begin CHARACTERISTIC TDLLRMNKH "Time delay before storing error of closed ISC-actuator during catalyst heating" VALUE 0x8053AB38 RB_Val_Wu8 51.00 t200msxs_ub_b51 0.00 51.00 FORMAT "%5.2" /end CHARACTERISTIC
/begin CHARACTERISTIC TDLLRMX "Time delay before storing the error ISC-actuator open" VALUE 0x8053AB39 RB_Val_Wu8 51.00 t200msxs_ub_b51 0.00 51.00 FORMAT "%5.2" /end CHARACTERISTIC
/begin CHARACTERISTIC TDLLRMXKH "Time delay before storing the error ISC-actuator open during catalyst heating" VALUE 0x8053AB3A RB_Val_Wu8 51.00 t200msxs_ub_b51 0.00 51.00 FORMAT "%5.2" /end CHARACTERISTIC
/begin CHARACTERISTIC TDLLRNF "Time delay before storing ISC-actuator with no error" VALUE 0x8053AB3B RB_Val_Wu8 51.00 t200msxs_ub_b51 0.00 51.00 FORMAT "%5.2" /end CHARACTERISTIC
/begin CHARACTERISTIC TDLLRNFKH "Time delay before storing ISC-actuator with no error during catalyst heating" VALUE 0x8053AB3C RB_Val_Wu8 51.00 t200msxs_ub_b51 0.00 51.00 FORMAT "%5.2" /end CHARACTERISTIC
/begin CHARACTERISTIC TDLLRNPL "Filter constant for the PT1 element in order to enable the gradient based error detection" VALUE 0x8053AB3E RB_Val_Wu16 3276.700 t_q0p05 0.050 3276.750 FORMAT "%8.3" EXTENDED_LIMITS 0.00 3276.750 /end CHARACTERISTIC
/begin CHARACTERISTIC TDLLRNUM "Time delay for possible error detection." VALUE 0x8053AB4B RB_Val_Wu8 51.00 t_q0p2 0.00 51.00 FORMAT "%5.2" /end CHARACTERISTIC
/begin CHARACTERISTIC TDLLRPL "Time delay before storing non-plausible idling engine speed error" VALUE 0x8053AB40 RB_Val_Wu8 51.00 t200msxs_ub_b51 0.00 51.00 FORMAT "%5.2" /end CHARACTERISTIC
/begin CHARACTERISTIC TDPSRRG "Time constant for delay of electric valid manifold pressure sensor" VALUE 0x8053AD28 RB_Val_Wu16 1310.700 t_q0p02 0.00 1310.700 FORMAT "%8.3" /end CHARACTERISTIC
/begin CHARACTERISTIC TDQRLDEGUA "filter time constant for ""delta rl-quotient from 1.0 decreasing"" for mixture monitoring for stuck-check of ethanol sensor" VALUE 0x8053ACEA RB_Val_Wu16 13106.999997 zk200msxs_uw_b13107p2 0.200003 13107.200000 FORMAT "%12.6" EXTENDED_LIMITS 0.20000305180 13107.200000 /end CHARACTERISTIC
/begin CHARACTERISTIC TDQRLDEGUS "filter time constant for ""delta rl-quotient from 1.0 increasing"" for mixture monitoring for stuck-check of ethanol sensor" VALUE 0x8053ACEC RB_Val_Wu16 13106.999997 zk200msxs_uw_b13107p2 0.200003 13107.200000 FORMAT "%12.6" EXTENDED_LIMITS 0.20000305180 13107.200000 /end CHARACTERISTIC
/begin CHARACTERISTIC TDTESRGMX "max. accepted delay time between freeze of referenze temperature and ethanol sensor temperature valid" VALUE 0x8053AD4A RB_Val_Wu8 51.00 t_q0p2 0.00 51.00 FORMAT "%5.2" /end CHARACTERISTIC
/begin CHARACTERISTIC TETHSMIN "lower limit of value range temperature signal ethanolsensor" VALUE 0x8053AD4B RB_Val_Wu8 191.3 temp_ub_q0p75_o48 -48.0 143.3 FORMAT "%5.1" /end CHARACTERISTIC
/begin CHARACTERISTIC TFGDGKWFAD "Timeconstant for damping old values of min./max. mixture factors before fuel change" VALUE 0x8053ACEE RB_Val_Wu16 13107.00 t_q0p2 0.00 13107.00 FORMAT "%8.2" /end CHARACTERISTIC
/begin CHARACTERISTIC TFRAVEDPLE "maximum fra_w-adaptation time until fuel mixture adaptation is in steady state in case of an error" VALUE 0x8053ACFC RB_Val_Wu16 13107.00 t_q0p2 0.00 13107.00 FORMAT "%8.2" /end CHARACTERISTIC
/begin CHARACTERISTIC THP "delay time failure heiling powerstage diagnosis" VALUE 0x8058A319 KwUb 25.00 t_q0p1 0.50 25.50 FORMAT "%5.2" EXTENDED_LIMITS 0.00 25.50 /end CHARACTERISTIC
/begin CHARACTERISTIC TMDLLRKHO "upper engine temperature threshold for engine speed diagnosis catalyst heating" VALUE 0x8053AB41 RB_Val_Wu8 191.3 temp_ub_q0p75_o48 -48.0 143.3 FORMAT "%5.1" /end CHARACTERISTIC
/begin CHARACTERISTIC TMDLLRKHU "lower engine temperature threshold for engine speed diagnosis catalyst heating" VALUE 0x8053AB42 RB_Val_Wu8 191.3 temp_ub_q0p75_o48 -48.0 143.3 FORMAT "%5.1" /end CHARACTERISTIC
/begin CHARACTERISTIC TMDLLRO "upper engine temperature threshold for idle speed actuator diagnosis" VALUE 0x8053AB43 RB_Val_Wu8 191.3 temp_ub_q0p75_o48 -48.0 143.3 FORMAT "%5.1" /end CHARACTERISTIC
/begin CHARACTERISTIC TMDLLRU "lower engine temperature threshold for idle speed actuator diagnosis" VALUE 0x8053AB44 RB_Val_Wu8 191.3 temp_ub_q0p75_o48 -48.0 143.3 FORMAT "%5.1" /end CHARACTERISTIC
/begin CHARACTERISTIC TMOTPSSVMN "engine temperature threshold at which manifold pressure sensor could be frozen" VALUE 0x8053AD2A RB_Val_Ws16 6553.500 Temp_Cels -3549.940 3003.560 FORMAT "%8.3" /end CHARACTERISTIC
/begin CHARACTERISTIC TMOTPSSVMX "engine temperature threshold for defrosted manifold pressure sensor" VALUE 0x8053AD2C RB_Val_Ws16 6553.500 Temp_Cels -3549.940 3003.560 FORMAT "%8.3" /end CHARACTERISTIC
/begin CHARACTERISTIC TNMNPSR "Time when ambient pressure in manifold" VALUE 0x8053AD2E RB_Val_Wu8 25.50 t_q0p1 0.00 25.50 FORMAT "%5.2" /end CHARACTERISTIC
/begin CHARACTERISTIC TNSTDLLR "Time delay until idle speed control diagnosis is activated" VALUE 0x8053AB46 RB_Val_Wu16 655.3500 t10msxs_uw_b655p35 0.00 655.3500 FORMAT "%8.4" /end CHARACTERISTIC
/begin CHARACTERISTIC TNSTSTKH "for the relase necessary time after end of start" VALUE 0x8053AB48 RB_Val_Wu16 655.3500 t10msxs_uw_b655p35 0.00 655.3500 FORMAT "%8.4" /end CHARACTERISTIC
/begin CHARACTERISTIC TPSINIG "time for valid psini after engine start" VALUE 0x8053AD30 RB_Val_Wu16 6553.500 t100msxs_uw_b6553p5 0.00 6553.500 FORMAT "%8.3" /end CHARACTERISTIC
/begin CHARACTERISTIC TPSRSVMN "min time for defrost manifold sensor at min temp" VALUE 0x8053AD32 RB_Val_Wu16 1310.700 t_q0p02 0.00 1310.700 FORMAT "%8.3" /end CHARACTERISTIC
/begin CHARACTERISTIC TPSRSVN "Time for operating point of signal-variation-check" VALUE 0x8053AD34 RB_Val_Wu16 1310.700 t_q0p02 0.00 1310.700 FORMAT "%8.3" /end CHARACTERISTIC
/begin CHARACTERISTIC TRLDEGU "filter time constant for rl-LP for mixture monitoring for stuck-check of ethanol sensor" VALUE 0x8053ACF0 RB_Val_Wu16 13106.999997 zk200msxs_uw_b13107p2 0.200003 13107.200000 FORMAT "%12.6" EXTENDED_LIMITS 0.20000305180 13107.200000 /end CHARACTERISTIC
/begin CHARACTERISTIC TVP "delay time failure verification powerstage diagnosis ME(D) 9" VALUE 0x8058A31A KwUb 25.00 t_q0p1 0.50 25.50 FORMAT "%5.2" EXTENDED_LIMITS 0.00 25.50 /end CHARACTERISTIC
/begin CHARACTERISTIC TVTENSKL15 "Delay time after ""ignition on"" when engine stop time is expected to be valid for calculation the condition ""possible refueling""" VALUE 0x8053ACF2 RB_Val_Wu16 13107.00 t_q0p2 0.00 13107.00 FORMAT "%8.2" /end CHARACTERISTIC
/begin CHARACTERISTIC TVTHDVALDIAG "delay time of multiplicative correction error for npl eth snsr error" VALUE 0x8053ACF4 RB_Val_Wu16 13107.00 t_q0p2 0.00 13107.00 FORMAT "%8.2" /end CHARACTERISTIC
/begin CHARACTERISTIC VFDVDEGUR "speed threshold for reset of mixture monitoring for stuck-check of ethanol sensor" VALUE 0x8053ACF6 RB_Val_Ws16 655.3500 Vel -327.6800 327.6700 FORMAT "%8.4" /end CHARACTERISTIC
/begin CHARACTERISTIC VKSDEDG "consumption interval for gradient of ethanol content" VALUE 0x8053ACF8 RB_Val_Wu16 1.999969 vol_q3p052Em5_l 0.00 1.999969 FORMAT "%8.6" /end CHARACTERISTIC
/begin CHARACTERISTIC VTOREGRAD "Offset of dead volume between Ethanol sensor and EV" VALUE 0x8053ACFA RB_Val_Wu16 1.279980 vol_q1p953Em5_l 0.00 1.279980 FORMAT "%8.6" /end CHARACTERISTIC
/begin CHARACTERISTIC WDKPSRSVMN "throttle blade angle limit for lower manifold pressure of signal var. check" VALUE 0x8053AD36 RB_Val_Ws16 511.9922 rel_q0p0078125 -256.0000 255.9922 FORMAT "%8.4" /end CHARACTERISTIC
/begin CHARACTERISTIC WDKPSRSVMX "throttle blade angle limit for upper manifold pressure of signal var. check" VALUE 0x8053AD38 RB_Val_Ws16 511.9922 rel_q0p0078125 -256.0000 255.9922 FORMAT "%8.4" /end CHARACTERISTIC
/begin MEASUREMENT B_btkstopm "refueling stop possible" UBYTE B_TRUE 1 100 0.00 1.00000000000 BIT_MASK 0x1 FORMAT "%13.11" ECU_ADDRESS 0x60036DDE /end MEASUREMENT
/begin MEASUREMENT B_clllrh "Condition: clear fault path idle speed control homogeneous" UBYTE B_TRUE 1 100 0.00 1.00000000000 BIT_MASK 0x1 FORMAT "%13.11" ECU_ADDRESS 0x6000E7FC /end MEASUREMENT
/begin MEASUREMENT B_clllrkh "Condition: clear fault path idle speed control catalyst heating" UBYTE B_TRUE 1 100 0.00 1.00000000000 BIT_MASK 0x1 FORMAT "%13.11" ECU_ADDRESS 0x6000E7FB /end MEASUREMENT
/begin MEASUREMENT B_dedginit "Diagnosis Ethanolsensor, drift diagnosis for ""refueling always the same blend"" initialized" UBYTE B_TRUE 1 100 0.00 1.00000000000 BIT_MASK 0x1 FORMAT "%13.11" ECU_ADDRESS 0x60036DDD /end MEASUREMENT
/begin MEASUREMENT B_degbstst "Diagnosis Ethanolsensor, refueling of the same blend between two FRA stable detections" UBYTE B_TRUE 1 100 0.00 1.00000000000 BIT_MASK 0x1 FORMAT "%13.11" ECU_ADDRESS 0x60036DDC /end MEASUREMENT
/begin MEASUREMENT B_degfeevk "Diagnosis Ethanolsensor, gradient of ethanol content at injection valve is small" UBYTE B_TRUE 1 100 0.00 1.00000000000 BIT_MASK 0x1 FORMAT "%13.11" ECU_ADDRESS 0x7000034D /end MEASUREMENT
/begin MEASUREMENT B_degferk "Diagnosis Ethanolsensor, gradient of ethanol content at sensor is small" UBYTE B_TRUE 1 100 0.00 1.00000000000 BIT_MASK 0x1 FORMAT "%13.11" ECU_ADDRESS 0x60036DDB /end MEASUREMENT
/begin MEASUREMENT B_deglbtk "Diagnosis Ethanolsensor, condition ""refueling always the same blend""" UBYTE B_TRUE 1 100 0.00 1.00000000000 BIT_MASK 0x1 FORMAT "%13.11" ECU_ADDRESS 0x60036DDA /end MEASUREMENT
/begin MEASUREMENT B_degueval_msg "Diagnosis Ethanolsensor, validation phase for mixture monitoring error suspicion" UBYTE B_TRUE 1 100 0.00 1.00000000000 BIT_MASK 0x1 FORMAT "%13.11" ECU_ADDRESS 0x60036E3D /end MEASUREMENT
/begin MEASUREMENT B_degugfv "Diagnosis Ethanolsensor, mixture monitoring error suspicion" UBYTE B_TRUE 1 100 0.00 1.00000000000 BIT_MASK 0x1 FORMAT "%13.11" ECU_ADDRESS 0x7000034C /end MEASUREMENT
/begin MEASUREMENT B_degusken "Diagnosis Ethanolsensor, mixture monitoring for stuck-error enabled" UBYTE B_TRUE 1 100 0.00 1.00000000000 BIT_MASK 0x1 FORMAT "%13.11" ECU_ADDRESS 0x60036DD9 /end MEASUREMENT
/begin MEASUREMENT B_deguskfv "Diagnosis Ethanolsensor, error suspicion mixture monitoring for stuck-error" UBYTE B_TRUE 1 100 0.00 1.00000000000 BIT_MASK 0x1 FORMAT "%13.11" ECU_ADDRESS 0x60036DD8 /end MEASUREMENT
/begin MEASUREMENT B_degusk_msg "Diagnosis Ethanolsensor, mixture monitoring window for stuck-error" UBYTE B_TRUE 1 100 0.00 1.00000000000 BIT_MASK 0x1 FORMAT "%13.11" ECU_ADDRESS 0x70000C16 /end MEASUREMENT
/begin MEASUREMENT B_dethsni_msg "Diagnosis Ethanolsensor, no inhibits pending" UBYTE B_TRUE 1 100 0.00 1.00000000000 BIT_MASK 0x1 FORMAT "%13.11" ECU_ADDRESS 0x70000C13 /end MEASUREMENT
/begin MEASUREMENT B_dewkev_msg "Diagnosis Ethanolsensor, change of fuel blend at injection valve" UBYTE B_TRUE 1 100 0.00 1.00000000000 BIT_MASK 0x1 FORMAT "%13.11" ECU_ADDRESS 0x60036E3C /end MEASUREMENT
/begin MEASUREMENT B_dfcframax "DFC FRAMAX exists" UBYTE B_TRUE 1 100 0.00 1.00000000000 BIT_MASK 0x1 FORMAT "%13.11" ECU_ADDRESS 0x70000368 /end MEASUREMENT
/begin MEASUREMENT B_dfcframin "DFC FRAMIN exists" UBYTE B_TRUE 1 100 0.00 1.00000000000 BIT_MASK 0x1 FORMAT "%13.11" ECU_ADDRESS 0x70000367 /end MEASUREMENT
/begin MEASUREMENT B_dfcoramax "DFC ORAMAX exists" UBYTE B_TRUE 1 100 0.00 1.00000000000 BIT_MASK 0x1 FORMAT "%13.11" ECU_ADDRESS 0x70000366 /end MEASUREMENT
/begin MEASUREMENT B_dfcoramin "DFC ORAMIN exists" UBYTE B_TRUE 1 100 0.00 1.00000000000 BIT_MASK 0x1 FORMAT "%13.11" ECU_ADDRESS 0x70000365 /end MEASUREMENT
/begin MEASUREMENT B_dkvsscr_msg "Requirement of Similar_Conditions DKVS" UBYTE B_TRUE 1 100 0.00 1.00000000000 BIT_MASK 0x1 FORMAT "%13.11" ECU_ADDRESS 0x70000C0B /end MEASUREMENT
/begin MEASUREMENT B_dllrakt_msg "Diagnosis idle speed is active" UBYTE B_TRUE 1 100 0.00 1.00000000000 BIT_MASK 0x1 FORMAT "%13.11" ECU_ADDRESS 0x70000C0A /end MEASUREMENT
/begin MEASUREMENT B_dllrebd "Condition physical prerequisites for DLLR release satisfied" UBYTE B_TRUE 1 100 0.00 1.00000000000 BIT_MASK 0x1 FORMAT "%13.11" ECU_ADDRESS 0x70000363 /end MEASUREMENT
/begin MEASUREMENT B_dllrfgw_msg "The specific, physical release conditions for warm diagnosis are fulfilled" UBYTE B_TRUE 1 100 0.00 1.00000000000 BIT_MASK 0x1 FORMAT "%13.11" ECU_ADDRESS 0x70000C08 /end MEASUREMENT
/begin MEASUREMENT B_dllrfg_msg "physical pre-condition DLLR (general)" UBYTE B_TRUE 1 100 0.00 1.00000000000 BIT_MASK 0x1 FORMAT "%13.11" ECU_ADDRESS 0x70000C09 /end MEASUREMENT
/begin MEASUREMENT B_dllrhon "DLLR was active in homogeous mode for a calibratable time duration" UBYTE B_TRUE 1 100 0.00 1.00000000000 BIT_MASK 0x1 FORMAT "%13.11" ECU_ADDRESS 0x70000354 /end MEASUREMENT
/begin MEASUREMENT B_dllrh_msg "DLLR in homogeous mode active" UBYTE B_TRUE 1 100 0.00 1.00000000000 BIT_MASK 0x1 FORMAT "%13.11" ECU_ADDRESS 0x70000C07 /end MEASUREMENT
/begin MEASUREMENT B_dllrkha_msg "physical release condition for DLLR catalyst heating" UBYTE B_TRUE 1 100 0.00 1.00000000000 BIT_MASK 0x1 FORMAT "%13.11" ECU_ADDRESS 0x70000C05 /end MEASUREMENT
/begin MEASUREMENT B_dllrkhon "DLLR during catalyst heating was active for a calibratable time duration" UBYTE B_TRUE 1 100 0.00 1.00000000000 BIT_MASK 0x1 FORMAT "%13.11" ECU_ADDRESS 0x70000353 /end MEASUREMENT
/begin MEASUREMENT B_dllrkh_msg "DLLR during catalyst heating active" UBYTE B_TRUE 1 100 0.00 1.00000000000 BIT_MASK 0x1 FORMAT "%13.11" ECU_ADDRESS 0x70000C06 /end MEASUREMENT
/begin MEASUREMENT B_dpsrsvmn "condition, stuck in range manifold pressure sensor" UBYTE B_TRUE 1 100 0.00 1.00000000000 BIT_MASK 0x1 FORMAT "%13.11" ECU_ADDRESS 0x6000E7E9 /end MEASUREMENT
/begin MEASUREMENT B_dtmxfrz "ethanol sensor, temperature signal diagnosis threshold freezed" UBYTE B_TRUE 1 100 0.00 1.00000000000 BIT_MASK 0x1 FORMAT "%13.11" ECU_ADDRESS 0x70000340 /end MEASUREMENT
/begin MEASUREMENT B_dtreffrz "ethanol sensor, delta temperature signal to referenze temperature freezed" UBYTE B_TRUE 1 100 0.00 1.00000000000 BIT_MASK 0x1 FORMAT "%13.11" ECU_ADDRESS 0x7000033F /end MEASUREMENT
/begin MEASUREMENT B_ededg "Ethanolsensor drift error for ""refueling always the same blend"" detected" UBYTE B_TRUE 1 100 0.00 1.00000000000 BIT_MASK 0x1 FORMAT "%13.11" ECU_ADDRESS 0x7000034B /end MEASUREMENT
/begin MEASUREMENT B_ededw "Ethanolsensor drift error for ""refueling different blend"" detected" UBYTE B_TRUE 1 100 0.00 1.00000000000 BIT_MASK 0x1 FORMAT "%13.11" ECU_ADDRESS 0x7000034A /end MEASUREMENT
/begin MEASUREMENT B_edegrad "Ethanolsensor gradient unplausible" UBYTE B_TRUE 1 100 0.00 1.00000000000 BIT_MASK 0x1 FORMAT "%13.11" ECU_ADDRESS 0x60036DD7 /end MEASUREMENT
/begin MEASUREMENT B_edeguskv "Ethanolsensor stuck-error detected by mixture monitoring, virtual" UBYTE B_TRUE 1 100 0.00 1.00000000000 BIT_MASK 0x1 FORMAT "%13.11" ECU_ADDRESS 0x70000342 /end MEASUREMENT
/begin MEASUREMENT B_edegusk_msg "Ethanolsensor stuck-error detected by mixture monitoring" UBYTE B_TRUE 1 100 0.00 1.00000000000 BIT_MASK 0x1 FORMAT "%13.11" ECU_ADDRESS 0x60036E33 /end MEASUREMENT
/begin MEASUREMENT B_edekr "Ethanolsensor error detected by knock control" UBYTE B_TRUE 1 100 0.00 1.00000000000 BIT_MASK 0x1 FORMAT "%13.11" ECU_ADDRESS 0x70000349 /end MEASUREMENT
/begin MEASUREMENT B_ednllrh "Debounced minimal error symptom idle speed control homogeneous" UBYTE B_TRUE 1 100 0.00 1.00000000000 BIT_MASK 0x1 FORMAT "%13.11" ECU_ADDRESS 0x70000362 /end MEASUREMENT
/begin MEASUREMENT B_ednllrkh "Debounced minimal error symptom idle speed control catalyst heating" UBYTE B_TRUE 1 100 0.00 1.00000000000 BIT_MASK 0x1 FORMAT "%13.11" ECU_ADDRESS 0x70000361 /end MEASUREMENT
/begin MEASUREMENT B_edpllrh "Debounced non-plausibel error symptom idle speed control homogeneous" UBYTE B_TRUE 1 100 0.00 1.00000000000 BIT_MASK 0x1 FORMAT "%13.11" ECU_ADDRESS 0x70000360 /end MEASUREMENT
/begin MEASUREMENT B_edpllrkh "Debounced non-plausibel symptom idle speed control catalyst heating" UBYTE B_TRUE 1 100 0.00 1.00000000000 BIT_MASK 0x1 FORMAT "%13.11" ECU_ADDRESS 0x7000035F /end MEASUREMENT
/begin MEASUREMENT B_edxllrh "Debounced maximal error symptom idle speed control homogeneous" UBYTE B_TRUE 1 100 0.00 1.00000000000 BIT_MASK 0x1 FORMAT "%13.11" ECU_ADDRESS 0x7000035E /end MEASUREMENT
/begin MEASUREMENT B_edxllrkh "Debounced maximal error symptom idle speed control catalyst heating" UBYTE B_TRUE 1 100 0.00 1.00000000000 BIT_MASK 0x1 FORMAT "%13.11" ECU_ADDRESS 0x7000035D /end MEASUREMENT
/begin MEASUREMENT B_engrotbm "Flag motor has rotated, for detection refueling possible" UBYTE B_TRUE 1 100 0.00 1.00000000000 BIT_MASK 0x1 FORMAT "%13.11" ECU_ADDRESS 0x70000348 /end MEASUREMENT
/begin MEASUREMENT B_eplpsr "not plausible error manifold pressure" UBYTE B_TRUE 1 100 0.00 1.00000000000 BIT_MASK 0x1 FORMAT "%13.11" ECU_ADDRESS 0x6000E7E8 /end MEASUREMENT
/begin MEASUREMENT B_epsrplmn_msg "Condition for min plausibilisation of manifold pressure not valid" UBYTE B_TRUE 1 100 0.00 1.00000000000 BIT_MASK 0x1 FORMAT "%13.11" ECU_ADDRESS 0x6000F268 /end MEASUREMENT
/begin MEASUREMENT B_epsrplmx_msg "Condition for max plausibilisation of manifold pressure not valid" UBYTE B_TRUE 1 100 0.00 1.00000000000 BIT_MASK 0x1 FORMAT "%13.11" ECU_ADDRESS 0x6000F267 /end MEASUREMENT
/begin MEASUREMENT B_epsrsv "Condition for failure from sensor signal variation-check" UBYTE B_TRUE 1 100 0.00 1.00000000000 BIT_MASK 0x1 FORMAT "%13.11" ECU_ADDRESS 0x6000E7E7 /end MEASUREMENT
/begin MEASUREMENT B_esmnllr_msg "Condition minimum engine speed error suspicion" UBYTE B_TRUE 1 100 0.00 1.00000000000 BIT_MASK 0x1 FORMAT "%13.11" ECU_ADDRESS 0x70000BE5 /end MEASUREMENT
/begin MEASUREMENT B_esmxllr_msg "Condition maximum engine speed error suspicion" UBYTE B_TRUE 1 100 0.00 1.00000000000 BIT_MASK 0x1 FORMAT "%13.11" ECU_ADDRESS 0x70000BE4 /end MEASUREMENT
/begin MEASUREMENT B_esnpllr "Condition non-plausibel engine speed error suspicion" UBYTE B_TRUE 1 100 0.00 1.00000000000 BIT_MASK 0x1 FORMAT "%13.11" ECU_ADDRESS 0x7000035C /end MEASUREMENT
/begin MEASUREMENT B_esnpllrg "Condition non-plausibel engine speed error suspicion diagnosed with gradient based method" UBYTE B_TRUE 1 100 0.00 1.00000000000 BIT_MASK 0x1 FORMAT "%13.11" ECU_ADDRESS 0x7000035B /end MEASUREMENT
/begin MEASUREMENT B_ethgg_msg "ethanol sensor, sensor value valid" UBYTE B_TRUE 1 100 0.00 1.00000000000 BIT_MASK 0x1 FORMAT "%13.11" ECU_ADDRESS 0x60036E32 /end MEASUREMENT
/begin MEASUREMENT B_ethrgold "ethanol sensor, old value electrical validity" UBYTE B_TRUE 1 100 0.00 1.00000000000 BIT_MASK 0x1 FORMAT "%13.11" ECU_ADDRESS 0x70000347 /end MEASUREMENT
/begin MEASUREMENT B_ethsnpl_msg "ethanol sensor, ethanol content implausible" UBYTE B_TRUE 1 100 0.00 1.00000000000 BIT_MASK 0x1 FORMAT "%13.11" ECU_ADDRESS 0x70000BDA /end MEASUREMENT
/begin MEASUREMENT B_ethsplh_msg "ethanol sensor, ethanol content plausible (healing)" UBYTE B_TRUE 1 100 0.00 1.00000000000 BIT_MASK 0x1 FORMAT "%13.11" ECU_ADDRESS 0x70000BD9 /end MEASUREMENT
/begin MEASUREMENT B_ethstnpl_msg "ethanol sensor, temperature signal implausible" UBYTE B_TRUE 1 100 0.00 1.00000000000 BIT_MASK 0x1 FORMAT "%13.11" ECU_ADDRESS 0x70000BD8 /end MEASUREMENT
/begin MEASUREMENT B_ethstplh_msg "ethanol sensor, temperature signal plausible (healing)" UBYTE B_TRUE 1 100 0.00 1.00000000000 BIT_MASK 0x1 FORMAT "%13.11" ECU_ADDRESS 0x70000BD7 /end MEASUREMENT
/begin MEASUREMENT B_fadssATS "replacement for B_fadss_msg" UBYTE B_TRUE 1 100 0.00 1.00000000000 BIT_MASK 0x1 FORMAT "%13.11" ECU_ADDRESS 0x6000E7E6 /end MEASUREMENT
/begin MEASUREMENT B_fdpsrb "Enable condition range diagnosis manifold pressure" UBYTE B_TRUE 1 100 0.00 1.00000000000 BIT_MASK 0x1 FORMAT "%13.11" ECU_ADDRESS 0x6000E7E5 /end MEASUREMENT
/begin MEASUREMENT B_fdpsrp "Enable condition plausibility diagnosis manifold pressure" UBYTE B_TRUE 1 100 0.00 1.00000000000 BIT_MASK 0x1 FORMAT "%13.11" ECU_ADDRESS 0x6000E7E4 /end MEASUREMENT
/begin MEASUREMENT B_fgdegukw "mixture factor of mixture monitoring while no fuel change is expected is stored" UBYTE B_TRUE 1 100 0.00 1.00000000000 BIT_MASK 0x1 FORMAT "%13.11" ECU_ADDRESS 0x60036DD6 /end MEASUREMENT
/begin MEASUREMENT B_fgdegust_mp "." UBYTE B_TRUE 1 100 0.00 1.00000000000 BIT_MASK 0x1 FORMAT "%13.11" ECU_ADDRESS 0x7000A316 /end MEASUREMENT
/begin MEASUREMENT B_fgdeguwm "mixture factor of mixture monitoring while fuel change is possible is stored" UBYTE B_TRUE 1 100 0.00 1.00000000000 BIT_MASK 0x1 FORMAT "%13.11" ECU_ADDRESS 0x60036DD5 /end MEASUREMENT
/begin MEASUREMENT B_fmnscr "Similar Conditions for FRA min requested" UBYTE B_TRUE 1 100 0.00 1.00000000000 BIT_MASK 0x1 FORMAT "%13.11" ECU_ADDRESS 0x60036DE2 /end MEASUREMENT
/begin MEASUREMENT B_fmxscr "Similar Conditions for FRA max requested" UBYTE B_TRUE 1 100 0.00 1.00000000000 BIT_MASK 0x1 FORMAT "%13.11" ECU_ADDRESS 0x60036DE1 /end MEASUREMENT
/begin MEASUREMENT B_fpsrplsv "Cond.: Release of model-based int.manifold press.diagnosis from icing detection" UBYTE B_TRUE 1 100 0.00 1.00000000000 BIT_MASK 0x1 FORMAT "%13.11" ECU_ADDRESS 0x60039407 /end MEASUREMENT
/begin MEASUREMENT B_frascr_msg "Condition : similar conditions for fra required" UBYTE B_TRUE 1 100 0.00 1.00000000000 BIT_MASK 0x1 FORMAT "%13.11" ECU_ADDRESS 0x70000BBE /end MEASUREMENT
/begin MEASUREMENT B_frasc_msg "Condition : similar conditions for fra fulfilled" UBYTE B_TRUE 1 100 0.00 1.00000000000 BIT_MASK 0x1 FORMAT "%13.11" ECU_ADDRESS 0x70000BBF /end MEASUREMENT
/begin MEASUREMENT B_frastabtmp "Variable holding B_frastab and (or) B_frastab_c in 2 ECU system" UBYTE B_TRUE 1 100 0.00 1.00000000000 BIT_MASK 0x1 FORMAT "%13.11" ECU_ADDRESS 0x70000346 /end MEASUREMENT
/begin MEASUREMENT B_fvdeths_msg "Error suspicion diagnosis ethanolsensor" UBYTE B_TRUE 1 100 0.00 1.00000000000 BIT_MASK 0x1 FORMAT "%13.11" ECU_ADDRESS 0x60036E28 /end MEASUREMENT
/begin MEASUREMENT B_gfraster_msg "edge rising on condition stable mixtute adaptation" UBYTE B_TRUE 1 100 0.00 1.00000000000 BIT_MASK 0x1 FORMAT "%13.11" ECU_ADDRESS 0x70000BB0 /end MEASUREMENT
/begin MEASUREMENT B_gfstnegu "." UBYTE B_TRUE 1 100 0.00 1.00000000000 BIT_MASK 0x1 FORMAT "%13.11" ECU_ADDRESS 0x70000341 /end MEASUREMENT
/begin MEASUREMENT B_heplpsr_msg "Condition for HEALING of plausibility-diagnosis manifold-pressure sensor" UBYTE B_TRUE 1 100 0.00 1.00000000000 BIT_MASK 0x1 FORMAT "%13.11" ECU_ADDRESS 0x6000EE99 /end MEASUREMENT
/begin MEASUREMENT B_hepsrmn "Condition healing range min" UBYTE B_TRUE 1 100 0.00 1.00000000000 BIT_MASK 0x1 FORMAT "%13.11" ECU_ADDRESS 0x6000E7E3 /end MEASUREMENT
/begin MEASUREMENT B_hepsrmx "Condition healing range max" UBYTE B_TRUE 1 100 0.00 1.00000000000 BIT_MASK 0x1 FORMAT "%13.11" ECU_ADDRESS 0x6000E7E2 /end MEASUREMENT
/begin MEASUREMENT B_hepsrsv "Condition Healing Signal Variation Check" UBYTE B_TRUE 1 100 0.00 1.00000000000 BIT_MASK 0x1 FORMAT "%13.11" ECU_ADDRESS 0x6000E7E1 /end MEASUREMENT
/begin MEASUREMENT B_hldllrh "Debounced plausibel result idle speed control diagnosis homogeneous" UBYTE B_TRUE 1 100 0.00 1.00000000000 BIT_MASK 0x1 FORMAT "%13.11" ECU_ADDRESS 0x7000035A /end MEASUREMENT
/begin MEASUREMENT B_hldllrkh "Debounced plausibel result idle speed control diagnosis catalyst heating" UBYTE B_TRUE 1 100 0.00 1.00000000000 BIT_MASK 0x1 FORMAT "%13.11" ECU_ADDRESS 0x70000359 /end MEASUREMENT
/begin MEASUREMENT B_inidplfe "Diagnosis Ethanolsensor initialized" UBYTE B_TRUE 1 100 0.00 1.00000000000 BIT_MASK 0x1 FORMAT "%13.11" ECU_ADDRESS 0x60036DD4 /end MEASUREMENT
/begin MEASUREMENT B_ncpsrc "Condition: increase In Use Monitoring Performance Ratio of FID-CPSRC" UBYTE B_TRUE 1 100 0.00 1.00000000000 BIT_MASK 0x1 FORMAT "%13.11" ECU_ADDRESS 0x6000E7D8 /end MEASUREMENT
/begin MEASUREMENT B_ncpsrr "Condition: increase In Use Monitoring Performance Ratio of FID-PSRR" UBYTE B_TRUE 1 100 0.00 1.00000000000 BIT_MASK 0x1 FORMAT "%13.11" ECU_ADDRESS 0x6000E7D7 /end MEASUREMENT
/begin MEASUREMENT B_nmnpsr "Condition engine stop in switch off task for a variable time" UBYTE B_TRUE 1 100 0.00 1.00000000000 BIT_MASK 0x1 FORMAT "%13.11" ECU_ADDRESS 0x60039406 /end MEASUREMENT
/begin MEASUREMENT B_omnscr "Similar Conditions for ORA min requested" UBYTE B_TRUE 1 100 0.00 1.00000000000 BIT_MASK 0x1 FORMAT "%13.11" ECU_ADDRESS 0x60036DE0 /end MEASUREMENT
/begin MEASUREMENT B_omxscr "Similar Conditions for ORA max requested" UBYTE B_TRUE 1 100 0.00 1.00000000000 BIT_MASK 0x1 FORMAT "%13.11" ECU_ADDRESS 0x60036DDF /end MEASUREMENT
/begin MEASUREMENT B_orascr_msg "Condition : similar conditions for ora required" UBYTE B_TRUE 1 100 0.00 1.00000000000 BIT_MASK 0x1 FORMAT "%13.11" ECU_ADDRESS 0x70000B4A /end MEASUREMENT
/begin MEASUREMENT B_orasc_msg "Condition : similar conditions for ora fulfilled" UBYTE B_TRUE 1 100 0.00 1.00000000000 BIT_MASK 0x1 FORMAT "%13.11" ECU_ADDRESS 0x70000B4B /end MEASUREMENT
/begin MEASUREMENT B_ostabzstmp "Variable holding B_ostabzs and (or) B_ostabzs_c in 2 ECU system" UBYTE B_TRUE 1 100 0.00 1.00000000000 BIT_MASK 0x1 FORMAT "%13.11" ECU_ADDRESS 0x70000345 /end MEASUREMENT
/begin MEASUREMENT B_psini_msg "condition for psini_w is initialized with psdss" UBYTE B_TRUE 1 100 0.00 1.00000000000 BIT_MASK 0x1 FORMAT "%13.11" ECU_ADDRESS 0x7000363E /end MEASUREMENT
/begin MEASUREMENT B_psrpl_msg "Status for intake air manifold pressure value plausible" UBYTE B_TRUE 1 100 0.00 1.00000000000 BIT_MASK 0x1 FORMAT "%13.11" ECU_ADDRESS 0x6000F22E /end MEASUREMENT
/begin MEASUREMENT B_psrrgmn_msg "Condition for lower range for sensor signal wobble check confirmed" UBYTE B_TRUE 1 100 0.00 1.00000000000 BIT_MASK 0x1 FORMAT "%13.11" ECU_ADDRESS 0x6000F22D /end MEASUREMENT
/begin MEASUREMENT B_psrrgmx_msg "Condition for upper range for sensor signal wobble check confirmed" UBYTE B_TRUE 1 100 0.00 1.00000000000 BIT_MASK 0x1 FORMAT "%13.11" ECU_ADDRESS 0x6000F22C /end MEASUREMENT
/begin MEASUREMENT B_psrrgtd "condition delayed electric valid of manifold pressure" UBYTE B_TRUE 1 100 0.00 1.00000000000 BIT_MASK 0x1 FORMAT "%13.11" ECU_ADDRESS 0x6000E7E0 /end MEASUREMENT
/begin MEASUREMENT B_psrsvmn "Condition for lower range for sensor signal variation check confirmed" UBYTE B_TRUE 1 100 0.00 1.00000000000 BIT_MASK 0x1 FORMAT "%13.11" ECU_ADDRESS 0x6000E7DF /end MEASUREMENT
/begin MEASUREMENT B_psrsvmni "Condition for lower range for sensor signal variation check confirmed (IUMPR)" UBYTE B_TRUE 1 100 0.00 1.00000000000 BIT_MASK 0x1 FORMAT "%13.11" ECU_ADDRESS 0x6000E7DE /end MEASUREMENT
/begin MEASUREMENT B_psrsvmx "Condition for upper range for sensor signal variation check confirmed" UBYTE B_TRUE 1 100 0.00 1.00000000000 BIT_MASK 0x1 FORMAT "%13.11" ECU_ADDRESS 0x6000E7DD /end MEASUREMENT
/begin MEASUREMENT B_psrsvmxi "Condition for upper range for sensor signal variation check confirmed (IUMPR)" UBYTE B_TRUE 1 100 0.00 1.00000000000 BIT_MASK 0x1 FORMAT "%13.11" ECU_ADDRESS 0x6000E7DC /end MEASUREMENT
/begin MEASUREMENT B_pybllr "physical readiness to run function idle speed control diagnosis" UBYTE B_TRUE 1 100 0.00 1.00000000000 BIT_MASK 0x1 FORMAT "%13.11" ECU_ADDRESS 0x70000358 /end MEASUREMENT
/begin MEASUREMENT B_pybllrkh "physical readiness to run function idle speed deviation catalyst heating" UBYTE B_TRUE 1 100 0.00 1.00000000000 BIT_MASK 0x1 FORMAT "%13.11" ECU_ADDRESS 0x70000357 /end MEASUREMENT
/begin MEASUREMENT B_refvples "Reset Error suspicion diagnosis ethanolsensor" UBYTE B_TRUE 1 100 0.00 1.00000000000 BIT_MASK 0x1 FORMAT "%13.11" ECU_ADDRESS 0x70000344 /end MEASUREMENT
/begin MEASUREMENT B_thigh "Condition sensor could not be iced, regarding temperature conditions" UBYTE B_TRUE 1 100 0.00 1.00000000000 BIT_MASK 0x1 FORMAT "%13.11" ECU_ADDRESS 0x6000E7DB /end MEASUREMENT
/begin MEASUREMENT B_vfzgdcy "condition vehicle has moved in the current driving cycle" UBYTE B_TRUE 1 100 0.00 1.00000000000 BIT_MASK 0x1 FORMAT "%13.11" ECU_ADDRESS 0x70000343 /end MEASUREMENT
/begin MEASUREMENT B_zpsrsv "zyklus flag for signal variation check" UBYTE B_TRUE 1 100 0.00 1.00000000000 BIT_MASK 0x1 FORMAT "%13.11" ECU_ADDRESS 0x6000E7DA /end MEASUREMENT
/begin MEASUREMENT dfedegusk_mp "measurement:delta quotient factor ethanol at injection valve for healing stuck-error" UWORD fak_uw_b2 1 100 0.00 1.999969 FORMAT "%8.6" ECU_ADDRESS 0x7000A314 /end MEASUREMENT
/begin MEASUREMENT dferdegr_mp "measurement:maximum delta between two consecutive ethanol sensor raw values" UWORD fak_uw_b2 1 100 0.00 1.999969 FORMAT "%8.6" ECU_ADDRESS 0x7000A312 /end MEASUREMENT
/begin MEASUREMENT dfethdedg_mp "measurement:delta factor ethanol sensorvalue for detection refueling always the same blend" UWORD fak_uw_b2 1 100 0.00 1.999969 FORMAT "%8.6" ECU_ADDRESS 0x7000A310 /end MEASUREMENT
/begin MEASUREMENT dfethdedw_mp "measurement:delta factor ethanol at injection valve for detection change of blend" UWORD fak_uw_b2 1 100 0.00 1.999969 FORMAT "%8.6" ECU_ADDRESS 0x7000A30E /end MEASUREMENT
/begin MEASUREMENT dfethrev_mp "measurement:delta factor ethanol raw value to factor ethanol at injection valve for detection change of blend finished" UWORD fak_uw_b2 1 100 0.00 1.999969 FORMAT "%8.6" ECU_ADDRESS 0x7000A30C /end MEASUREMENT
/begin MEASUREMENT dfffrdemx_mp "delta mixture for enabling drift diagnosis ethanol sensor for refueling always the same blend initialized" UWORD fak_uw_b2 1 100 0.00 1.999969 FORMAT "%8.6" ECU_ADDRESS 0x7000A30A /end MEASUREMENT
/begin MEASUREMENT DLLRIR_bActvDenomCatHeatg "DLLRIR Catalyst activation denomintor" UBYTE B_TRUE 1 100 0.00 1.00000000000 BIT_MASK 0x1 FORMAT "%13.11" ECU_ADDRESS 0x70000352 /end MEASUREMENT
/begin MEASUREMENT DLLRIR_bActvDenomHom "DLLRIR Catalyst activation denomintor" UBYTE B_TRUE 1 100 0.00 1.00000000000 BIT_MASK 0x1 FORMAT "%13.11" ECU_ADDRESS 0x70000351 /end MEASUREMENT
/begin MEASUREMENT DLLRIR_ctReIni "Local drive cycle counter for ReIni" UBYTE OneToOne 1 100 0.00 255.0 FORMAT "%5.1" ECU_ADDRESS 0x6000E7F2 /end MEASUREMENT
/begin MEASUREMENT DLLRIR_flgDfcHomTstd "DFC state condition for release numerator FID_BLLRH" UBYTE B_TRUE 1 100 0.00 1.00000000000 BIT_MASK 0x1 FORMAT "%13.11" ECU_ADDRESS 0x70000350 /end MEASUREMENT
/begin MEASUREMENT DLLRIR_flgDfcKhTstd "DFC state condition for release numerator FID_BLLRKH" UBYTE B_TRUE 1 100 0.00 1.00000000000 BIT_MASK 0x1 FORMAT "%13.11" ECU_ADDRESS 0x7000034F /end MEASUREMENT
/begin MEASUREMENT DLLRIR_flgReIniReq "ReIni for DLLRIR requested" UBYTE B_TRUE 1 100 0.00 1.00000000000 BIT_MASK 0x1 FORMAT "%13.11" ECU_ADDRESS 0x7000034E /end MEASUREMENT
/begin MEASUREMENT DLLRIR_tiDenomCatHeatg "elapsed time for which the CSERS denominator was activ in this driving cycle" UBYTE t_q0p2 1 100 0.00 51.00 FORMAT "%5.2" ECU_ADDRESS 0x6000E7F1 /end MEASUREMENT
/begin MEASUREMENT DLLRIR_tiDenomHom "elapsed time for which the homogen denominator was activ in this driving cycle" UBYTE t_q0p2 1 100 0.00 51.00 FORMAT "%5.2" ECU_ADDRESS 0x6000E7F0 /end MEASUREMENT
/begin MEASUREMENT DLLR_ctReIni "DLLR counter to track the Syc postdrive leave(POSTDRIVE to DRIVE state changes)" UBYTE OneToOne 1 100 0.00 255.0 FORMAT "%5.1" ECU_ADDRESS 0x6000E7FA /end MEASUREMENT
/begin MEASUREMENT DLLR_flgChrgThdMinDiag "Drive off detection for the underspeed diagnosis" UBYTE B_TRUE 1 100 0.00 1.00000000000 BIT_MASK 0x1 FORMAT "%13.11" ECU_ADDRESS 0x6000E7F9 /end MEASUREMENT
/begin MEASUREMENT DLLR_flgCSERSIdleDiagActvn "vehicle operation mode for the CSERS idle speed diagnosis" UBYTE B_TRUE 1 100 0.00 1.00000000000 BIT_MASK 0x1 FORMAT "%13.11" ECU_ADDRESS 0x6000E7F8 /end MEASUREMENT
/begin MEASUREMENT DLLR_flgGnrlActvn "generall release for the idle speed diagnosis" UBYTE B_TRUE 1 100 0.00 1.00000000000 BIT_MASK 0x1 FORMAT "%13.11" ECU_ADDRESS 0x6000E7F7 /end MEASUREMENT
/begin MEASUREMENT DLLR_flgNonCSERSIdleDiagActvn "vehicle operation mode for the standard idle speed diagnosis" UBYTE B_TRUE 1 100 0.00 1.00000000000 BIT_MASK 0x1 FORMAT "%13.11" ECU_ADDRESS 0x6000E7F6 /end MEASUREMENT
/begin MEASUREMENT DLLR_flgNoTqDmd "no torque demand active (enable condition DLLR)" UBYTE B_TRUE 1 100 0.00 1.00000000000 BIT_MASK 0x1 FORMAT "%13.11" ECU_ADDRESS 0x70000356 /end MEASUREMENT
/begin MEASUREMENT DLLR_flgTstrActv "test request active" UBYTE B_TRUE 1 100 0.00 1.00000000000 BIT_MASK 0x1 FORMAT "%13.11" ECU_ADDRESS 0x70000355 /end MEASUREMENT
/begin MEASUREMENT DLLR_flgVehVCond "Speed condition for DLLR release" UBYTE B_TRUE 1 100 0.00 1.00000000000 BIT_MASK 0x1 FORMAT "%13.11" ECU_ADDRESS 0x70000A56 /end MEASUREMENT
/begin MEASUREMENT DLLR_flgVomActvn "Vehicle operation mode spezific release for the idle speed diagnosis" UBYTE B_TRUE 1 100 0.00 1.00000000000 BIT_MASK 0x1 FORMAT "%13.11" ECU_ADDRESS 0x6000E7F5 /end MEASUREMENT
/begin MEASUREMENT DLLR_nDif "Current speed deviation for diagnosis of idle speed control" SWORD nmot_ub_q10 1 100 -327680.0 327670.0 FORMAT "%8.1" ECU_ADDRESS 0x600073E6 /end MEASUREMENT
/begin MEASUREMENT DLLR_nDifCatHeatg "Current speed deviation for diagnosis of idle speed control during catalyst heating" SWORD nmot_sw_q0p5 1 100 -16384.00 16383.50 FORMAT "%8.2" ECU_ADDRESS 0x600073E4 /end MEASUREMENT
/begin MEASUREMENT DLLR_nMnErrThd "Current maximal speed deviation for detection of low speed (min error)" SWORD nmot_ub_q10 1 100 -327680.0 327670.0 FORMAT "%8.1" ECU_ADDRESS 0x600073E2 /end MEASUREMENT
/begin MEASUREMENT DLLR_nMnThdCatHeatg "Current maximal speed deviation for detection of low speed during catalyst heating" SBYTE nmot_ub_q10 1 100 -1280. 1270. FORMAT "%5.0" ECU_ADDRESS 0x6000E7F4 /end MEASUREMENT
/begin MEASUREMENT DLLR_nmotold_w "Old engine speed for calculating the NPL diagnosis in the DLLR" UWORD nmot_uw_q0p25 1 100 0.00 16383.75 FORMAT "%8.2" ECU_ADDRESS 0x600073E0 /end MEASUREMENT
/begin MEASUREMENT DLLR_nMxErrThd "Current maximal speed deviation for detection of high speed (max error)" SWORD nmot_ub_q10 1 100 -327680.0 327670.0 FORMAT "%8.1" ECU_ADDRESS 0x600073DE /end MEASUREMENT
/begin MEASUREMENT DLLR_nMxThdCatHeatg "Current maximal speed deviation for detection of high speed during catalyst heating" SBYTE nmot_ub_q10 1 100 -1280. 1270. FORMAT "%5.0" ECU_ADDRESS 0x6000E7F3 /end MEASUREMENT
/begin MEASUREMENT DOGov_bActv "Condition drive-off controller with ignition intervention" UBYTE B_TRUE 1 100 0.00 1.00000000000 BIT_MASK 0x1 FORMAT "%13.11" ECU_ADDRESS 0x6000F14D /end MEASUREMENT
/begin MEASUREMENT DOGov_bActvCpl "Double storage for DOGov_bActv" UBYTE OneToOne 1 100 0.00 255.0 FORMAT "%5.1" ECU_ADDRESS 0x6000F467 /end MEASUREMENT
/begin MEASUREMENT DOGov_bCalc "Condition calculation of drive-off controller model" UBYTE B_TRUE 1 100 0.00 1.00000000000 BIT_MASK 0x1 FORMAT "%13.11" ECU_ADDRESS 0x6000E7EE /end MEASUREMENT
/begin MEASUREMENT DOGov_bGenRls "Condition general release of functionality drive-off support" UBYTE B_TRUE 1 100 0.00 1.00000000000 BIT_MASK 0x1 FORMAT "%13.11" ECU_ADDRESS 0x6000E7ED /end MEASUREMENT
/begin MEASUREMENT DOGov_bResv "Condition torque reserve request from drive-off support" UBYTE B_TRUE 1 100 0.00 1.00000000000 BIT_MASK 0x1 FORMAT "%13.11" ECU_ADDRESS 0x6000E7EC /end MEASUREMENT
/begin MEASUREMENT DOGov_dnEngFltLoc "Local for Epm_dnEngFlt used as an input to DoGov_facTqLead_M" SWORD nmotg_sw_q0p39 1 100 -12800.16 12799.77 FORMAT "%8.2" ECU_ADDRESS 0x600073D4 /end MEASUREMENT
/begin MEASUREMENT DOGov_dnEngFltLocSyncn "Local for Epm_dnEngFlt used as an input to DOGov_facTqSet_M" SWORD nmotg_sw_q0p39 1 100 -12800.16 12799.77 FORMAT "%8.2" ECU_ADDRESS 0x600073D2 /end MEASUREMENT
/begin MEASUREMENT DOGov_dtrqDttme "deadtime/gradient filter DOGov_trqClth" SWORD md_sw_q0p1 1 100 -3276.800 3276.700 FORMAT "%8.3" ECU_ADDRESS 0x600073D0 /end MEASUREMENT
/begin MEASUREMENT DOGov_facOvrSpd "Factor against overspeed" UBYTE fak_ub_b1 1 100 0.00 0.9961 ECU_ADDRESS 0x6000E7EB /end MEASUREMENT
/begin MEASUREMENT DOGov_n "engine speed in drive off governor" SWORD EngN 1 100 -16384.00 16383.50 FORMAT "%8.2" ECU_ADDRESS 0x600073CE /end MEASUREMENT
/begin MEASUREMENT DOGov_nDiff "engine speed deviation drive-off support" SWORD EngN 1 100 -16384.00 16383.50 FORMAT "%8.2" ECU_ADDRESS 0x600073CC /end MEASUREMENT
/begin MEASUREMENT DOGov_nDifSyncn "Engine speed(Sync) deviation drive-off support" SWORD EngN 1 100 -16384.00 16383.50 FORMAT "%8.2" ECU_ADDRESS 0x700030AA /end MEASUREMENT
/begin MEASUREMENT DOGov_nSetP "Enginge speed set point drive-off controller" SWORD EngN 1 100 -16384.00 16383.50 FORMAT "%8.2" ECU_ADDRESS 0x700030A8 /end MEASUREMENT
/begin MEASUREMENT DOGov_rClthPos "cluth position" SWORD Prc 1 100 -400.0000 399.9878 FORMAT "%8.4" ECU_ADDRESS 0x600073CA /end MEASUREMENT
/begin MEASUREMENT DOGov_rClthPosAvrg "average cluth position" SWORD Prc 1 100 -400.0000 399.9878 FORMAT "%8.4" ECU_ADDRESS 0x600395CC /end MEASUREMENT
/begin MEASUREMENT DOGov_rClthThresMax "upper clutch threshold for activation" SWORD Prc 1 100 0.00 125.0000 FORMAT "%8.4" ECU_ADDRESS 0x600073C8 /end MEASUREMENT
/begin MEASUREMENT DOGov_rClthThresMin "lower clutch threshold for activation" SWORD Prc 1 100 0.00 399.9878 FORMAT "%8.4" ECU_ADDRESS 0x600073C6 /end MEASUREMENT
/begin MEASUREMENT DoGov_tqLeadCorrn "Driveoff governor corrected torque in lead path" SWORD md_sw_q0p1 1 100 -3276.800 3276.700 FORMAT "%8.3" ECU_ADDRESS 0x600073C4 /end MEASUREMENT
/begin MEASUREMENT DoGov_tqLeadRaw "Driveoff governor raw torque in lead path" SWORD md_sw_q0p1 1 100 -3276.800 3276.700 FORMAT "%8.3" ECU_ADDRESS 0x600073C2 /end MEASUREMENT
/begin MEASUREMENT DoGov_tqSetCorrn "Driveoff governor corrected torque in set path" SWORD md_sw_q0p1 1 100 -3276.800 3276.700 FORMAT "%8.3" ECU_ADDRESS 0x600073C0 /end MEASUREMENT
/begin MEASUREMENT DoGov_tqSetRaw "Driveoff governor raw torque in set path" SWORD md_sw_q0p1 1 100 -3276.800 3276.700 FORMAT "%8.3" ECU_ADDRESS 0x600073BE /end MEASUREMENT
/begin MEASUREMENT DOGov_trqClth "Clutch torque for drive-off detection" SWORD md_sw_q0p1 1 100 -3276.800 3276.700 FORMAT "%8.3" ECU_ADDRESS 0x600073BC /end MEASUREMENT
/begin MEASUREMENT DOGov_trqClth_mp "modelled clutch torque for drive-off detection" SWORD md_sw_q0p1 1 100 -3276.800 3276.700 FORMAT "%8.3" ECU_ADDRESS 0x7000A31A /end MEASUREMENT
/begin MEASUREMENT DOGov_trqCompUnsty_mp "instationary compensation torque" SWORD md_sw_q0p01 1 100 -327.6800 327.6700 FORMAT "%8.4" ECU_ADDRESS 0x7000A318 /end MEASUREMENT
/begin MEASUREMENT DOGov_trqLead "drive-off torque for lead path" SWORD md_sw_q0p1 1 100 0.00 3276.700 FORMAT "%8.3" ECU_ADDRESS 0x600091F2 /end MEASUREMENT
/begin MEASUREMENT DOGov_trqMax "maximal delta torque drive-off controller" SWORD md_sw_q0p1 1 100 0.00 3276.700 FORMAT "%8.3" ECU_ADDRESS 0x600073BA /end MEASUREMENT
/begin MEASUREMENT DOGov_trqMin "minimal delta torque drive-off controller" SWORD md_sw_q0p1 1 100 0.00 3276.700 FORMAT "%8.3" ECU_ADDRESS 0x600073B8 /end MEASUREMENT
/begin MEASUREMENT DOGov_trqResv "torque reserve for drive-off controller" SWORD md_sw_q0p1 1 100 0.00 3276.700 FORMAT "%8.3" ECU_ADDRESS 0x600091F0 /end MEASUREMENT
/begin MEASUREMENT DOGov_trqSet "drive-off torque for set path" SWORD md_sw_q0p1 1 100 0.00 3276.700 FORMAT "%8.3" ECU_ADDRESS 0x70003C04 /end MEASUREMENT
/begin MEASUREMENT DPLETHSIR_ctReIni "Counter for implementation of ReIni task removal" UBYTE OneToOne 1 100 0.00 255.0 FORMAT "%5.1" ECU_ADDRESS 0x6000EFB8 /end MEASUREMENT
/begin MEASUREMENT DPLETHS_ctReIni "Counter for implementation of ReIni task removal in DPLETHS" UBYTE OneToOne 1 100 0.00 255.0 FORMAT "%5.1" ECU_ADDRESS 0x6000E7EA /end MEASUREMENT
/begin MEASUREMENT DPLTETHS_ctReIni "Counter for implementation of ReIni task removal in DPLTETHS" UWORD OneToOne 1 100 0.00 65535.00 FORMAT "%8.2" ECU_ADDRESS 0x6000738C /end MEASUREMENT
/begin MEASUREMENT dps_error "last read Pmd_GetErr() content of state OBSERVING" UWORD dez 1 100 0.00 65535.00 FORMAT "%8.2" ECU_ADDRESS 0x60000A78 /end MEASUREMENT
/begin MEASUREMENT dps_errStat "read Pmd_GetErr() content in state VERIFY or RECOVERY; this content is compared to dps_error" UWORD dez 1 100 0.00 65535.00 FORMAT "%8.2" ECU_ADDRESS 0x60000A72 /end MEASUREMENT
/begin MEASUREMENT dps_errStat_sum_rec "contains dps_errStat read during RECOVERY state" UWORD dez 1 100 0.00 65535.00 FORMAT "%8.2" ECU_ADDRESS 0x60000A74 /end MEASUREMENT
/begin MEASUREMENT dps_errStat_sum_ver "contains dps_errStat read during VERIFY state" UWORD dez 1 100 0.00 65535.00 FORMAT "%8.2" ECU_ADDRESS 0x60000A76 /end MEASUREMENT
/begin MEASUREMENT dps_index "Indicates which powerstage is being observed" UBYTE dez 1 100 0.00 255.0 FORMAT "%5.1" ECU_ADDRESS 0x60000A7E /end MEASUREMENT
/begin MEASUREMENT dps_recoveryTime "Timer Recovery" UBYTE t_q0p1 1 100 0.00 25.50 FORMAT "%5.2" ECU_ADDRESS 0x60000A7F /end MEASUREMENT
/begin MEASUREMENT dps_state "Index Statemachine" UBYTE dez 1 100 0.00 255.0 FORMAT "%5.1" ECU_ADDRESS 0x60000A80 /end MEASUREMENT
/begin MEASUREMENT dps_verifyTime "Timer Verify" UBYTE t_q0p1 1 100 0.00 25.50 FORMAT "%5.2" ECU_ADDRESS 0x60000A81 /end MEASUREMENT
/begin MEASUREMENT dqffdedg_mp "delta quotient ffuel_w for detection ethanolsensor drift error for refueling always the same blend" UWORD fak_uw_b2 1 100 0.00 1.999969 FORMAT "%8.6" ECU_ADDRESS 0x7000A308 /end MEASUREMENT
/begin MEASUREMENT dqfgdegukw_mp "spread mixture factor of mixture monitoring while no fuel change is expected" UWORD fak_uw_b2 1 100 0.00 1.999969 FORMAT "%8.6" ECU_ADDRESS 0x7000A306 /end MEASUREMENT
/begin MEASUREMENT dqfgdegusk_mp "mixture factor of mixture monitoring for stuck-check of ethanol sensor" UWORD fak_uw_b8 1 100 0.00 7.999878 FORMAT "%8.6" ECU_ADDRESS 0x7000A304 /end MEASUREMENT
/begin MEASUREMENT dqfgdeguwm_mp "spread mixture factor of mixture monitoring while fuel change is possible" UWORD fak_uw_b2 1 100 0.00 1.999969 FORMAT "%8.6" ECU_ADDRESS 0x7000A302 /end MEASUREMENT
/begin MEASUREMENT dqfrdegu_mp "measurement:delta quotient FRA for confirmation of error suspicion for stuck-error ethanol sensor" UWORD fak_uw_b2 1 100 0.00 1.999969 FORMAT "%8.6" ECU_ADDRESS 0x7000A300 /end MEASUREMENT
/begin MEASUREMENT dqrldegu_w "delta rl-quotient from 1.0 for mixture monitoring for stuck-check of ethanol sensor" UWORD fak_uw_b16 1 100 0.00 15.99976 FORMAT "%8.5" ECU_ADDRESS 0x600073B6 /end MEASUREMENT
/begin MEASUREMENT dtethsmx "max. delta temperature ethanolsensor to reference temperature (diagnosis threshold)" UBYTE temp_ub_q0p75_o48 1 100 -48.0 143.3 FORMAT "%5.1" ECU_ADDRESS 0x6000E7D6 /end MEASUREMENT
/begin MEASUREMENT dtethstref "Delta temperature ethanolsensor to reference temperature" UBYTE temp_ub_q0p75_o48 1 100 -48.0 143.3 FORMAT "%5.1" ECU_ADDRESS 0x6000E7D5 /end MEASUREMENT
/begin MEASUREMENT dvbstpm_w "delta fuel consumption since possible refueling stop" UWORD vol_q3p90625Em3_l 1 100 0.00 255.9961 FORMAT "%8.4" ECU_ADDRESS 0x6003942E /end MEASUREMENT
/begin MEASUREMENT dvdegumx_w "maximum delta fuel consumption since refueling stop for change of blend at injection valve finished" UWORD vol_q3p90625Em3_l 1 100 0.00 255.9961 FORMAT "%8.4" ECU_ADDRESS 0x6003942C /end MEASUREMENT
/begin MEASUREMENT dvtdedg_w "delta consumption to debounce detection ""refueling always the same blend"" after change of blend" UWORD vol_q3p90625Em3_l 1 100 0.00 255.9961 FORMAT "%8.4" ECU_ADDRESS 0x6003942A /end MEASUREMENT
/begin MEASUREMENT dyrldegu_w "rl-dynamic for mixture monitoring for stuck-check of ethanol sensor" UWORD fak_uw_b16 1 100 0.00 15.99976 FORMAT "%8.5" ECU_ADDRESS 0x600073B4 /end MEASUREMENT
/begin MEASUREMENT ethggcpl_msg "ethanol sensor, sensor value valid" UBYTE dez 1 100 0.00 255.0 FORMAT "%5.1" ECU_ADDRESS 0x6000EEF8 /end MEASUREMENT
/begin MEASUREMENT ETHSCP_DFRM_DPLETHS_LT_I.memory "Low pass filter for dfrmk_w in DPLETHS / current lowpass value" SLONG fak_q4p6566Em10 1 100 -1.000000000000000 0.999999999534339 FORMAT "%17.15" ECU_ADDRESS 0x60003018 /end MEASUREMENT
/begin MEASUREMENT ETHSCP_DQRLDEGU_LT_I.memory "Low pass filter for dqrldegu_w in DPLETHS / current lowpass value" ULONG fak_q3p72529Em9 1 100 0.00 15.9999999963 FORMAT "%13.10" ECU_ADDRESS 0x60003014 /end MEASUREMENT
/begin MEASUREMENT ETHSCP_FraaktvSW_I.timeCounter "Time window to verify if there is some error and release the condition to increment the IUMPR numerator. / expired time since start" UWORD t_q0p2 1 100 0.00 13107.00 FORMAT "%8.2" ECU_ADDRESS 0x6000739C /end MEASUREMENT
/begin MEASUREMENT ETHSCP_REFFGST_LT_I.memory "reference Low pass filter to decide frm_w filter run in DPLETHS / current lowpass value" ULONG fak_q2p3283Em10 1 100 0.00 0.999999999767 FORMAT "%14.12" ECU_ADDRESS 0x60003010 /end MEASUREMENT
/begin MEASUREMENT ETHSCP_RL_DPLETHS_LT_I.memory "Low pass filter for rl_w in DPLETHS / current lowpass value" ULONG rel_q3p576Em7 1 100 0.00 1535.99999964 FORMAT "%13.8" ECU_ADDRESS 0x6000300C /end MEASUREMENT
/begin MEASUREMENT fdpsrm_w "Factor difference of modeled manifold pressures" UWORD fak_uw_b2 1 100 0.00 1.999969 FORMAT "%8.6" ECU_ADDRESS 0x6000739A /end MEASUREMENT
/begin MEASUREMENT fedegusk_w "old value for delta quotient factor ethanol at injection valve for healing stuck-error" UWORD fak_uw_b2 1 100 0.00 1.999969 FORMAT "%8.6" ECU_ADDRESS 0x60039428 /end MEASUREMENT
/begin MEASUREMENT fethc_mp "corrected value of ethanol content with respect to predicted value in case of faulty mixture values" UWORD fak_uw_b2 1 100 0.00 1.999969 FORMAT "%8.6" ECU_ADDRESS 0x7000A2FE /end MEASUREMENT
/begin MEASUREMENT fethdedg_w "old value for delta factor ethanol sensorvalue for detection ""refueling always the same blend""" UWORD fak_uw_b2 1 100 0.00 1.999969 FORMAT "%8.6" ECU_ADDRESS 0x600073B2 /end MEASUREMENT
/begin MEASUREMENT fethdedw_w "old value for delta factor ethanol at injection valve for detection ""change of blend""" UWORD fak_uw_b2 1 100 0.00 1.999969 FORMAT "%8.6" ECU_ADDRESS 0x600073B0 /end MEASUREMENT
/begin MEASUREMENT fethrold_w "Old value of ethanol content interpolation factor, raw value from sensor" UWORD fak_uw_b2 1 100 0.00 1.999969 FORMAT "%8.6" ECU_ADDRESS 0x600073AE /end MEASUREMENT
/begin MEASUREMENT ffdedgo_w "old value for delta quotient ffuel_w for detection ethanolsensor drift error for ""refueling always the same blend""" UWORD fak_uw_b2 1 100 0.00 1.999969 FORMAT "%8.6" ECU_ADDRESS 0x60039426 /end MEASUREMENT
/begin MEASUREMENT fffrdemn_w "maximum mixture for drift diagnosis for ""refueling different blend""" UWORD fak_uw_b2 1 100 0.00 1.999969 FORMAT "%8.6" ECU_ADDRESS 0x60039424 /end MEASUREMENT
/begin MEASUREMENT fffrdemx_w "minimum mixture for drift diagnosis for ""refueling different blend""" UWORD fak_uw_b2 1 100 0.00 1.999969 FORMAT "%8.6" ECU_ADDRESS 0x60039422 /end MEASUREMENT
/begin MEASUREMENT fgdegusk_mp "mixture factor of mixture monitoring while fuel change is possible" UWORD fak_uw_b4 1 100 0.00 3.999939 FORMAT "%8.6" ECU_ADDRESS 0x7000A2FC /end MEASUREMENT
/begin MEASUREMENT fgdeguwm_w "mixture factor of mixture monitoring while fuel change is possible" UWORD fak_uw_b4 1 100 0.00 3.999939 FORMAT "%8.6" ECU_ADDRESS 0x600073AC /end MEASUREMENT
/begin MEASUREMENT fgdgkwmn_w "min. mixture factor of mixture monitoring while no fuel change is expected" UWORD fak_uw_b4 1 100 0.00 3.999939 FORMAT "%8.6" ECU_ADDRESS 0x60039420 /end MEASUREMENT
/begin MEASUREMENT fgdgkwmx_w "max. mixture factor of mixture monitoring while no fuel change is expected" UWORD fak_uw_b4 1 100 0.00 3.999939 FORMAT "%8.6" ECU_ADDRESS 0x6003941E /end MEASUREMENT
/begin MEASUREMENT fgdgwmmn_w "min. mixture factor of mixture monitoring while fuel change is possible" UWORD fak_uw_b4 1 100 0.00 3.999939 FORMAT "%8.6" ECU_ADDRESS 0x6003941C /end MEASUREMENT
/begin MEASUREMENT fgdgwmmx_w "max. mixture factor of mixture monitoring while fuel change is possible" UWORD fak_uw_b4 1 100 0.00 3.999939 FORMAT "%8.6" ECU_ADDRESS 0x6003941A /end MEASUREMENT
/begin MEASUREMENT FlMA_flgDSMClrDKVSSC "Condition clearing fault memory for function DKVSSC is active" UBYTE B_TRUE 1 100 0.00 1.00000000000 BIT_MASK 0x1 FORMAT "%13.11" ECU_ADDRESS 0x70000364 /end MEASUREMENT
/begin MEASUREMENT FlMA_flgIninFinshdSimrCdn "Initialization of the similar conditions calculation of the fuel mixture adaptation has finished" UBYTE B_TRUE 1 100 0.00 1.00000000000 BIT_MASK 0x1 FORMAT "%13.11" ECU_ADDRESS 0x70000933 /end MEASUREMENT
/begin MEASUREMENT FlMA_nEngSimrCdn "current engine speed" UWORD nmot_uw_q0p25 1 100 0.00 16383.75 FORMAT "%8.2" ECU_ADDRESS 0x600073EC /end MEASUREMENT
/begin MEASUREMENT FlMA_ratLoadSimrCdn "current load" UBYTE fak_ub_b100 1 100 0.00 100.0 FORMAT "%5.1" ECU_ADDRESS 0x6000E807 /end MEASUREMENT
/begin MEASUREMENT fmfgdegukw_mp "middle value mixture factor of mixture monitoring while no fuel change is expected" UWORD fak_uw_b4 1 100 0.00 3.999939 FORMAT "%8.6" ECU_ADDRESS 0x7000A2FA /end MEASUREMENT
/begin MEASUREMENT fradedr1_w "medium FRA value ethanol range 1 for drift diagnosis for ""refueling different blend""" UWORD fak_uw_b2 1 100 0.00 1.999969 FORMAT "%8.6" ECU_ADDRESS 0x60039418 /end MEASUREMENT
/begin MEASUREMENT fradedr2_w "medium FRA value ethanol range 2 for drift diagnosis for ""refueling different blend""" UWORD fak_uw_b2 1 100 0.00 1.999969 FORMAT "%8.6" ECU_ADDRESS 0x60039416 /end MEASUREMENT
/begin MEASUREMENT fradedr3_w "medium FRA value ethanol range 3 for drift diagnosis for ""refueling different blend""" UWORD fak_uw_b2 1 100 0.00 1.999969 FORMAT "%8.6" ECU_ADDRESS 0x60039414 /end MEASUREMENT
/begin MEASUREMENT fradedr4_w "medium FRA value ethanol range 4 for drift diagnosis for ""refueling different blend""" UWORD fak_uw_b2 1 100 0.00 1.999969 FORMAT "%8.6" ECU_ADDRESS 0x60039412 /end MEASUREMENT
/begin MEASUREMENT fraffcor_mp "calculated multiplicative mixture adaption value" UWORD fak_uw_b2 1 100 0.00 1.999969 FORMAT "%8.6" ECU_ADDRESS 0x7000A2F8 /end MEASUREMENT
/begin MEASUREMENT fraitmp_w "multiplicative correction of the mixture adaptation (temporary value)" UWORD fak_uw_b2 1 100 0.00 1.999969 FORMAT "%8.6" ECU_ADDRESS 0x600073AA /end MEASUREMENT
/begin MEASUREMENT framaxmil "FRAMAX is in state MIL ON" UBYTE dez 1 100 0.00 255.0 FORMAT "%5.1" ECU_ADDRESS 0x6000E806 /end MEASUREMENT
/begin MEASUREMENT framaxpend "FRAMAX is pending" UBYTE dez 1 100 0.00 255.0 FORMAT "%5.1" ECU_ADDRESS 0x6000E805 /end MEASUREMENT
/begin MEASUREMENT framinmil "FRAMIN is in state MIL ON" UBYTE dez 1 100 0.00 255.0 FORMAT "%5.1" ECU_ADDRESS 0x6000E804 /end MEASUREMENT
/begin MEASUREMENT framinpend "FRAMIN is pending" UBYTE dez 1 100 0.00 255.0 FORMAT "%5.1" ECU_ADDRESS 0x6000E803 /end MEASUREMENT
/begin MEASUREMENT frastgae_w "last stable FRA value" UWORD fak_uw_b2 1 100 0.00 1.999969 FORMAT "%8.6" ECU_ADDRESS 0x60039410 /end MEASUREMENT
/begin MEASUREMENT MDBmax_flgErrClr "Flag to indicate the error status of DFC_MDBmax" UBYTE B_TRUE 1 100 0.00 1.00000000000 BIT_MASK 0x1 FORMAT "%13.11" ECU_ADDRESS 0x6000E7EF /end MEASUREMENT
/begin MEASUREMENT nfrasc_w "engine speed reference value for similar conditions (FRA)" UWORD nmot_uw_q0p25 1 100 0.00 16383.75 FORMAT "%8.2" ECU_ADDRESS 0x600073EA /end MEASUREMENT
/begin MEASUREMENT nmotdifff_w "PT1 filtered squared engine speed gradient" UWORD nmot_uw_q0p25 1 100 0.00 16383.75 FORMAT "%8.2" ECU_ADDRESS 0x600073DC /end MEASUREMENT
/begin MEASUREMENT nmotdiff_w "Engine speed gradient" SWORD nmot_sw_q0p25 1 100 -8192.000 8191.750 FORMAT "%8.3" ECU_ADDRESS 0x600073DA /end MEASUREMENT
/begin MEASUREMENT nmotdifq_w_msg "Quadrat of engine speed gradient" UWORD nmot_uw_q0p25 1 100 0.00 16383.75 FORMAT "%8.2" ECU_ADDRESS 0x600084F0 /end MEASUREMENT
/begin MEASUREMENT nmotgneg "Negative engine speed amplitude" UWORD nmot_uw_q0p25 1 100 0.00 16383.75 FORMAT "%8.2" ECU_ADDRESS 0x600073D8 /end MEASUREMENT
/begin MEASUREMENT nmotgpos "Positive engine speed amplitude" UWORD nmot_uw_q0p25 1 100 0.00 16383.75 FORMAT "%8.2" ECU_ADDRESS 0x600073D6 /end MEASUREMENT
/begin MEASUREMENT norasc_w "engine speed reference value for similar conditions (ORA)" UWORD nmot_uw_q0p25 1 100 0.00 16383.75 FORMAT "%8.2" ECU_ADDRESS 0x600073E8 /end MEASUREMENT
/begin MEASUREMENT oracor_w "additive correction of the mixture adaptation (corrected)" SWORD rel_sw_b1536 1 100 -1536.000 1535.953 FORMAT "%8.3" ECU_ADDRESS 0x600073A8 /end MEASUREMENT
/begin MEASUREMENT oramaxmil "ORAMAX is in state MIL ON" UBYTE dez 1 100 0.00 255.0 FORMAT "%5.1" ECU_ADDRESS 0x6000E802 /end MEASUREMENT
/begin MEASUREMENT oramaxpend "ORAMAX is pending" UBYTE dez 1 100 0.00 255.0 FORMAT "%5.1" ECU_ADDRESS 0x6000E801 /end MEASUREMENT
/begin MEASUREMENT oraminmil "ORAMIN is in state MIL ON" UBYTE dez 1 100 0.00 255.0 FORMAT "%5.1" ECU_ADDRESS 0x6000E800 /end MEASUREMENT
/begin MEASUREMENT oraminpend "ORAMIN is pending" UBYTE dez 1 100 0.00 255.0 FORMAT "%5.1" ECU_ADDRESS 0x6000E7FF /end MEASUREMENT
/begin MEASUREMENT PIntkVUs_flgMdlPlausErrLoB1 "Error flag for model based plausibility check of intake manifold pressure(bank 1)." UBYTE B_TRUE 1 100 0.00 1.00000000000 BIT_MASK 0x1 FORMAT "%13.11" ECU_ADDRESS 0x6000E7D9 /end MEASUREMENT
/begin MEASUREMENT psrmmnf_w "minimum modeled manifold pressure filtered" UWORD p_q0p078 1 100 0.00 5119.922 FORMAT "%8.3" ECU_ADDRESS 0x60007398 /end MEASUREMENT
/begin MEASUREMENT psrmmxf_w "maximum modeled manifold pressure filtered" UWORD p_q0p078 1 100 0.00 5119.922 FORMAT "%8.3" ECU_ADDRESS 0x60007396 /end MEASUREMENT
/begin MEASUREMENT psrmn_w "min manifold pressure from sensor signal wobble check" UWORD p_q0p078 1 100 0.00 5119.922 FORMAT "%8.3" ECU_ADDRESS 0x60007394 /end MEASUREMENT
/begin MEASUREMENT psrmx_w "max manifold pressure from sensor signal wobble check" UWORD p_q0p078 1 100 0.00 5119.922 FORMAT "%8.3" ECU_ADDRESS 0x60007392 /end MEASUREMENT
/begin MEASUREMENT psrrmnf_w "minimum intake manifold pressure (absolute) not corrected filtered" UWORD p_q0p078 1 100 0.00 5119.922 FORMAT "%8.3" ECU_ADDRESS 0x60007390 /end MEASUREMENT
/begin MEASUREMENT psrrmxf_w "maximum intake manifold pressure (absolute) not corrected filtered" UWORD p_q0p078 1 100 0.00 5119.922 FORMAT "%8.3" ECU_ADDRESS 0x6000738E /end MEASUREMENT
/begin MEASUREMENT psrrtn_w_msg "intake manifold pressure (absolute) not corrected with min tolerances" UWORD p_q0p078 1 100 0.00 5119.922 FORMAT "%8.3" ECU_ADDRESS 0x60008AA4 /end MEASUREMENT
/begin MEASUREMENT psrrtx_w_msg "intake manifold pressure (absolute) not corrected with max tolerances" UWORD p_q0p078 1 100 0.00 5119.922 FORMAT "%8.3" ECU_ADDRESS 0x60008AA2 /end MEASUREMENT
/begin MEASUREMENT qfradedr_w "quotient of medium FRA values over ethanol ranges for drift diagnosis for ""refueling different blend""" UWORD fak_uw_b2 1 100 0.00 1.999969 FORMAT "%8.6" ECU_ADDRESS 0x600073A6 /end MEASUREMENT
/begin MEASUREMENT qfrastgu_w "quotient FRA after possible fuel change to before" UWORD fak_uw_b2 1 100 0.00 1.999969 FORMAT "%8.6" ECU_ADDRESS 0x6003940E /end MEASUREMENT
/begin MEASUREMENT qfrastst_w "quotient FRA from one stable detection to the next" UWORD fak_uw_b2 1 100 0.00 1.999969 FORMAT "%8.6" ECU_ADDRESS 0x6003940C /end MEASUREMENT
/begin MEASUREMENT rmlfrasc "rml reference value for similar conditions (FRA)" UBYTE fak_ub_b100 1 100 0.00 100.0 FORMAT "%5.1" ECU_ADDRESS 0x6000E7FE /end MEASUREMENT
/begin MEASUREMENT rmlorasc "rml reference value for similar conditions (ORA)" UBYTE fak_ub_b100 1 100 0.00 100.0 FORMAT "%5.1" ECU_ADDRESS 0x6000E7FD /end MEASUREMENT
/begin MEASUREMENT sdpleths_msg "status byte for DPLETHS" UBYTE dez 1 100 0.00 255.0 FORMAT "%5.1" ECU_ADDRESS 0x6000EED5 /end MEASUREMENT
/begin MEASUREMENT sdplteths_msg "status byte for DPLTETHS" UBYTE dez 1 100 0.00 255.0 FORMAT "%5.1" ECU_ADDRESS 0x6000EED4 /end MEASUREMENT
/begin MEASUREMENT tbtkm_mp "time of current vehicle stop for calculation of possible refueling" UWORD t_q0p2 1 100 0.00 13107.00 FORMAT "%8.2" ECU_ADDRESS 0x7000A2F6 /end MEASUREMENT
/begin MEASUREMENT tdfrdegu_mp "filter time constant for mixture deviation for mixture monitoring for stuck-check of ethanol sensor" UWORD t_q0p2 1 100 0.00 13107.00 FORMAT "%8.2" ECU_ADDRESS 0x7000A2F4 /end MEASUREMENT
/begin MEASUREMENT tiStrtEndOff "Local var off time based on start- end recognition" UWORD Time_sec_q1_COMPU 1 100 0.00 65535.00 FORMAT "%8.2" ECU_ADDRESS 0x6000738A /end MEASUREMENT
/begin MEASUREMENT tref_mp "Measurement point reference point in time" UBYTE temp_ub_q0p75_o48 1 100 -48.0 143.3 FORMAT "%5.1" ECU_ADDRESS 0x7000A2F3 /end MEASUREMENT
/begin MEASUREMENT tstbmlt_w "time of idle before engine stop for calculation of ""possible refueling""" UWORD t_q0p2 1 100 0.00 13107.00 FORMAT "%8.2" ECU_ADDRESS 0x600073A4 /end MEASUREMENT
/begin MEASUREMENT tstbtkm_w "time of current vehicle stop for calculation of ""possible refueling""" UWORD t_q0p2 1 100 0.00 13107.00 FORMAT "%8.2" ECU_ADDRESS 0x6003940A /end MEASUREMENT
/begin MEASUREMENT vdebregr_w "Interval consumption for ethanol sensor implausible gradient" UWORD vol_q3p906Em5_l 1 100 0.00 2.559961 FORMAT "%8.6" ECU_ADDRESS 0x60039408 /end MEASUREMENT
/begin MEASUREMENT vksdedg_w "consumption interval for gradient of ethanol content" UWORD vol_q3p052Em5_l 1 100 0.00 1.999969 FORMAT "%8.6" ECU_ADDRESS 0x600073A2 /end MEASUREMENT
/begin MEASUREMENT vtbstpm_w "old value for delta fuel consumption since possible refueling stop" SWORD vol_q7p8125Em3_l 1 100 -256.0000 255.9922 FORMAT "%8.4" ECU_ADDRESS 0x600073A0 /end MEASUREMENT
/begin MEASUREMENT vtdedgd_w "old value for delta consumption to debounce detection ""refueling always the same blend"" after change of blend" SWORD vol_q7p8125Em3_l 1 100 -256.0000 255.9922 FORMAT "%8.4" ECU_ADDRESS 0x6000739E /end MEASUREMENT
/begin FUNCTION DKVSSC "6.6.0     Release of MA-Error healing with Similar Conditions" /begin DEF_CHARACTERISTIC NMOTSC RMLSC /end DEF_CHARACTERISTIC
 /begin IN_MEASUREMENT B_cdkvssc_msg B_cdkvs_msg FlMA_flgDSMClrLRAEB FlMA_flgIninFinshdAckd FlMA_flgIninTrig /end IN_MEASUREMENT
 /begin OUT_MEASUREMENT B_dkvsscr_msg B_frascr_msg B_frasc_msg B_orascr_msg B_orasc_msg FlMA_flgIninFinshdSimrCdn /end OUT_MEASUREMENT
 /begin LOC_MEASUREMENT B_dfcframax B_dfcframin B_dfcoramax B_dfcoramin B_fmnscr B_fmxscr B_omnscr B_omxscr FlMA_flgDSMClrDKVSSC FlMA_nEngSimrCdn FlMA_ratLoadSimrCdn framaxmil framaxpend framinmil framinpend nfrasc_w norasc_w oramaxmil oramaxpend oraminmil oraminpend rmlfrasc rmlorasc /end LOC_MEASUREMENT
 FUNCTION_VERSION "6.6.0" /end FUNCTION
/begin FUNCTION DLLR "1.50.0    Diagnosis: idle speed control, recognising a blocked actuator"
 /begin DEF_CHARACTERISTIC CWDLLR CWDLLR2 DLLR_nDiagTestOfs_C DLLR_nDifActvnCSERS_C DLLR_nMnErrThdCatHeatgDrv_GT DLLR_nMnErrThdCatHeatg_GT DLLR_nMxErrThdCatHeatgDrv_GT DLLR_nMxErrThdCatHeatg_GT DLLR_stDiagTest_CW DLLR_tEng_Ax DLLR_ThdnPl_C DNDLLRO DNDLLROKH DNDLLRU DNDLLRUKH DNMOTG FHDLLR LIGov_rChrgCylLosCH_CUR LIGov_rChrgCylLos_CUR LIGov_stGlbDaExtTrqDemMsk_C NMOTGNP TADLLR TDLLFG1 TDLLFGKH TDLLRMN TDLLRMNKH TDLLRMX TDLLRMXKH TDLLRNF TDLLRNFKH TDLLRNPL TDLLRPL TMDLLRKHO TMDLLRKHU TMDLLRO TMDLLRU TNSTDLLR TNSTSTKH /end DEF_CHARACTERISTIC
 /begin IN_MEASUREMENT AirSys_rChrgCyl B_cdllrkh_msg B_cdllr_msg B_fs_msg B_khakt_msg CEngDsT_t DSM_TripChgFinshd EngStrt_bStrtEnd Epm_nEng Epm_stOpMode ExhMgT_flgCatHeatgCsers GlbDa_stTrqDem HLSDem_nMinWoCat HLSDem_nSetPLo nsolcat_msg PEnv_facCorrAlti PT_stTraType RngMod_trqLos SyC_ctPostDrvLeave SyC_stSub tans_msg ThrVlv_flgLimpModeB1 ThrVlv_flgReqFuCutOffB1 tnst_w_msg VehV_v /end IN_MEASUREMENT
 /begin OUT_MEASUREMENT B_dllrakt_msg B_dllrfgw_msg B_dllrfg_msg B_dllrh_msg B_dllrkha_msg B_dllrkh_msg B_esmnllr_msg B_esmxllr_msg DLLR_flgVehVCond nmotdifq_w_msg /end OUT_MEASUREMENT
 /begin LOC_MEASUREMENT B_clllrh B_clllrkh B_dllrebd B_ednllrh B_ednllrkh B_edpllrh B_edpllrkh B_edxllrh B_edxllrkh B_esnpllr B_esnpllrg B_hldllrh B_hldllrkh B_pybllr B_pybllrkh DLLR_ctReIni DLLR_flgChrgThdMinDiag DLLR_flgCSERSIdleDiagActvn DLLR_flgGnrlActvn DLLR_flgNonCSERSIdleDiagActvn DLLR_flgNoTqDmd DLLR_flgTstrActv DLLR_flgVomActvn DLLR_nDif DLLR_nDifCatHeatg DLLR_nMnErrThd DLLR_nMnThdCatHeatg DLLR_nmotold_w DLLR_nMxErrThd DLLR_nMxThdCatHeatg nmotdifff_w nmotdiff_w nmotgneg nmotgpos /end LOC_MEASUREMENT
 FUNCTION_VERSION "1.50.0" /end FUNCTION
/begin FUNCTION DLLRIR "1.26.0    IUMPR-functionality for DLLR" /begin DEF_CHARACTERISTIC TDLKHNUM TDLLRNUM /end DEF_CHARACTERISTIC /begin REF_CHARACTERISTIC LIGov_stGlbDaExtTrqDemMsk_C /end REF_CHARACTERISTIC
 /begin IN_MEASUREMENT B_cdllrkh_msg B_cdllr_msg B_dllrh_msg B_dllrkh_msg B_khakt_msg DLLR_flgVehVCond DSM_TripChgFinshd EngStrt_bStrtEnd ExhMgT_flgCatHeatgCsers GlbDa_stTrqDem HLSDem_nMinWoCat nsolcat_msg SyC_ctPostDrvLeave /end IN_MEASUREMENT
 /begin LOC_MEASUREMENT B_dllrhon B_dllrkhon DLLRIR_bActvDenomCatHeatg DLLRIR_bActvDenomHom DLLRIR_ctReIni DLLRIR_flgDfcHomTstd DLLRIR_flgDfcKhTstd DLLRIR_flgReIniReq DLLRIR_tiDenomCatHeatg DLLRIR_tiDenomHom /end LOC_MEASUREMENT
 FUNCTION_VERSION "1.26.0" /end FUNCTION
/begin FUNCTION DMBEG "2.10.0_159.0.0Diagnosis torque limitation level 1"
 /begin DEF_CHARACTERISTIC PthSet_stDia_CW PthSet_tiMonLimDiaErr_C PthSet_tiMonLimDiaHeal_C /end DEF_CHARACTERISTIC
 /begin IN_MEASUREMENT CoEng_stMai PthLead_stActvMonLim PthSet_stActvMonLim /end IN_MEASUREMENT
 /begin LOC_MEASUREMENT MDBmax_flgErrClr /end LOC_MEASUREMENT
 FUNCTION_VERSION "2.10.0_159.0.0" /end FUNCTION
/begin FUNCTION DOGov_TrqCalc "1.14.0    Controller-based Drive-Off Support"
 /begin DEF_CHARACTERISTIC DOGov_dtrqDttme_C DOGov_dtrqThres_CUR DOGov_facFdbk_C DOGov_facOvrSpd_C DOGov_facRmpOff_GCUR DoGov_facTqLead_M DOGov_facTqSet_M DOGov_flgSwtNGrdt_C DOGov_KClthPos_C DOGov_KiMod_CUR DOGov_KpLead_GCUR DOGov_Kp_GCUR DOGov_nDiffThres_CUR DOGov_nEngMax_C DOGov_nOfsMaxAbs_GCUR DOGov_nOfsMax_GCUR DOGov_nOvrSpd_GCUR DOGov_nUndrSpd_GCUR DOGov_n_DST DOGov_rAPP_DST DOGov_rClthAPP_CUR DOGov_rClthDeactvMax_C DOGov_rClthMax_C DOGov_rClthMin_C DOGov_rClthStepDwn_C DOGov_rClthStepUp_C DOGov_stCfg2_CW DOGov_stCfg_CW DOGov_tiAcsDT1_C DOGov_tiActv_C DOGov_tiResvActv_C DOGov_tiThresFlt_C DOGov_trqClthThresCatHeatg_C DOGov_trqClthThresUnsty_C DOGov_trqClthThres_C DOGov_trqDebLead_C DOGov_trqDebSet_C DOGov_trqMaxMon_GMAP DOGov_trqResvMaxRmp_C DoGov_trqResvMin_GCUR DOGov_trqResvOffRmp_C DOGov_trqRmpOff_GCUR DOGov_trqThresSwtUnsty_C DOGov_vMax_C DOGov_vMin_C /end DEF_CHARACTERISTIC
 /begin IN_MEASUREMENT ActMod_trqCrS APP_r Brk_st Clth_st CoETS_bIntvActvDes CoME_trqDesComp Com_rClthPos CoVeh_trqAcs EGSys_bCH Epm_dnEngAvgFlt Epm_dnEngFlt Epm_nEng Epm_nEng10ms HLSDem_nSetPLo LIGov_bEnblI PhyMod_trqDynEng PthSet_stOvrRun PT_rTraV2N PT_stTraType VehV_v /end IN_MEASUREMENT
 /begin OUT_MEASUREMENT DOGov_bActv DOGov_bActvCpl DOGov_rClthPosAvrg DOGov_trqLead DOGov_trqResv DOGov_trqSet /end OUT_MEASUREMENT
 /begin LOC_MEASUREMENT DOGov_bCalc DOGov_bGenRls DOGov_bResv DOGov_dnEngFltLoc DOGov_dnEngFltLocSyncn DOGov_dtrqDttme DOGov_facOvrSpd DOGov_n DOGov_nDiff DOGov_nDifSyncn DOGov_nSetP DOGov_rClthPos DOGov_rClthThresMax DOGov_rClthThresMin DoGov_tqLeadCorrn DoGov_tqLeadRaw DoGov_tqSetCorrn DoGov_tqSetRaw DOGov_trqClth DOGov_trqClth_mp DOGov_trqCompUnsty_mp DOGov_trqMax DOGov_trqMin /end LOC_MEASUREMENT
 FUNCTION_VERSION "1.14.0" /end FUNCTION
/begin FUNCTION DPLETHS "11.4.0    plausibility diagnosis ethanol sensor"
 /begin DEF_CHARACTERISTIC CWDPLETHS DDQFGDGMN DFERDEGRMX DFETHDEDG DFETHDEDKW DFETHDEDW DFETHREVKW DFFFRDEMX DQFEDEGUMN DQFFDEDGMX DQFGDEGUMN DQFRDEGUMX DVDEGUMN DVDEGUMX DVDEGUMXMX DVTDEDGDEB FETHDER1MX FETHDER2MX FETHDER3MX FETHEDEKR FRAMNDEHL FRAMXDEHL FRFGGUSTMN KLTDFRDEGU MFRADEDWDL NFRASTDED QFRADEDRMX RLRKADEGU TBTKKL15M TBTKSTOPM TDQRLDEGUA TDQRLDEGUS TFGDGKWFAD TRLDEGU TVTENSKL15 TVTHDVALDIAG VFDVDEGUR VKSDEDG VTOREGRAD /end DEF_CHARACTERISTIC
 /begin REF_CHARACTERISTIC ANZTILRA CWLRASTO FfPrm_facFuAdpnMax_C FfPrm_facFuAdpnMin_C FfPrm_stEna_C FRADN FRADX IMTEFVDFRM INITFRA TMFVDFRM VETHSEV /end REF_CHARACTERISTIC
 /begin IN_MEASUREMENT anztib_w_msg B_efra_msg B_ethevg_msg B_ethrg_msg B_fdgser_msg B_frastab_msg B_fstabzs_msg B_fvlra_msg B_lradp1mn_msg B_lradp1mx_msg B_lr_msg B_orastab_msg B_ostabzs_msg B_reqlra_msg B_te_msg CEngDsT_t dfrmk_w_msg DSM_TripChgFinshd Eep_EnvRamHist Eep_EnvRamInvld EngStrt_bStrtEnd Epm_stSpd fethev_w_msg fethr_w_msg FfPrm_facEthPredMax FfPrm_facEthPredMin FfPrm_facFuAdpn FfPrm_facFuAdpnInjr FfPrm_flgFuAdpnCorrn frai_w_msg IKCtl_flgKnkEna IKCtl_flgRtdtMax imsteini_msg InjSys_dvolFuInjr InjSys_volFuConsDrvCyc ora_w_msg rl_w_msg SyC_ctPostDrvLeave SyC_stSub tengszlst_msg tengsz_w_msg TiEngOff_bEngRot VehV_v /end IN_MEASUREMENT
 /begin OUT_MEASUREMENT B_degueval_msg B_degusk_msg B_dethsni_msg B_dewkev_msg B_edegusk_msg B_ethgg_msg B_ethsnpl_msg B_ethsplh_msg B_fvdeths_msg B_gfraster_msg ethggcpl_msg sdpleths_msg /end OUT_MEASUREMENT
 /begin LOC_MEASUREMENT B_btkstopm B_dedginit B_degbstst B_degfeevk B_degferk B_deglbtk B_degugfv B_degusken B_deguskfv B_ededg B_ededw B_edegrad B_edekr B_engrotbm B_ethrgold B_fgdegukw B_fgdegust_mp B_fgdeguwm B_frastabtmp B_inidplfe B_ostabzstmp B_refvples B_vfzgdcy dfedegusk_mp dferdegr_mp dfethdedg_mp dfethdedw_mp dfethrev_mp dfffrdemx_mp DPLETHS_ctReIni dqffdedg_mp dqfgdegukw_mp dqfgdegusk_mp dqfgdeguwm_mp dqfrdegu_mp dqrldegu_w dvbstpm_w dvdegumx_w dvtdedg_w dyrldegu_w ETHSCP_DFRM_DPLETHS_LT_I.memory ETHSCP_DQRLDEGU_LT_I.memory ETHSCP_REFFGST_LT_I.memory ETHSCP_RL_DPLETHS_LT_I.memory fedegusk_w fethc_mp fethdedg_w fethdedw_w fethrold_w ffdedgo_w fffrdemn_w fffrdemx_w fgdegusk_mp fgdeguwm_w fgdgkwmn_w fgdgkwmx_w fgdgwmmn_w fgdgwmmx_w fmfgdegukw_mp fradedr1_w fradedr2_w fradedr3_w fradedr4_w fraffcor_mp fraitmp_w frastgae_w oracor_w qfradedr_w qfrastgu_w qfrastst_w tbtkm_mp tdfrdegu_mp tstbmlt_w tstbtkm_w vdebregr_w vksdedg_w vtbstpm_w vtdedgd_w /end LOC_MEASUREMENT
 FUNCTION_VERSION "11.4.0" /end FUNCTION
/begin FUNCTION DPLETHSIR "11.3.0    plausibility diagnosis ethanol sensor IUMPR calculation" /begin DEF_CHARACTERISTIC TFRAVEDPLE /end DEF_CHARACTERISTIC /begin REF_CHARACTERISTIC CWDPLETHS FfPrm_stEna_C /end REF_CHARACTERISTIC
 /begin IN_MEASUREMENT B_balra_msg B_degusk_msg B_gfraster_msg B_ubfra_msg DSM_TripChgFinshd SyC_ctPostDrvLeave SyC_stSub /end IN_MEASUREMENT
 /begin LOC_MEASUREMENT B_edeguskv B_gfstnegu DPLETHSIR_ctReIni ETHSCP_FraaktvSW_I.timeCounter /end LOC_MEASUREMENT
 FUNCTION_VERSION "11.3.0" /end FUNCTION
/begin FUNCTION DPLPSR "10.22.0   Diagnosis plausibilisation manifold pressure sensor"
 /begin DEF_CHARACTERISTIC DDPSRPSINI DPSRM DPSRMFA DPSRSVMN DPTPSRMX DPUPSINIMX NMOTMNDDSS NMOTZPLMN NPSRSVMN NPSRSVMX PSRMN PSRMX PUPLPSRMN SF_PSR SF_PSR1 TDEPSRB TDEPSRP TDPSRRG TMOTPSSVMN TMOTPSSVMX TNMNPSR TPSINIG TPSRSVMN TPSRSVN WDKPSRSVMN WDKPSRSVMX /end DEF_CHARACTERISTIC
 /begin IN_MEASUREMENT B_psinirg_msg B_psrmnxg_msg B_psrmw_msg B_psrrg_msg CEngDsT_t CEngDsT_tStrtFrst DSM_TripChgFinshd Eep_EnvRamHist Eep_EnvRamInvld Epm_nEng Epm_stSpd ofpu_w_msg PEnv_p psini_w_msg psrmmn_w_msg psrmmx_w_msg psrr_w_msg SyC_stSub ThrVlv_flgReqFuCutOffB1 ThrVlv_flgSngSensErrSuspcB1 ThrVlv_ratActPosnB1 tnsez_w_msg /end IN_MEASUREMENT
 /begin OUT_MEASUREMENT B_epsrplmn_msg B_epsrplmx_msg B_heplpsr_msg B_psini_msg B_psrpl_msg B_psrrgmn_msg B_psrrgmx_msg psrrtn_w_msg psrrtx_w_msg /end OUT_MEASUREMENT
 /begin LOC_MEASUREMENT B_dpsrsvmn B_eplpsr B_epsrsv B_fadssATS B_fdpsrb B_fdpsrp B_fpsrplsv B_hepsrmn B_hepsrmx B_hepsrsv B_ncpsrc B_ncpsrr B_nmnpsr B_psrrgtd B_psrsvmn B_psrsvmni B_psrsvmx B_psrsvmxi B_thigh B_zpsrsv fdpsrm_w PIntkVUs_flgMdlPlausErrLoB1 psrmmnf_w psrmmxf_w psrmn_w psrmx_w psrrmnf_w psrrmxf_w /end LOC_MEASUREMENT
 FUNCTION_VERSION "10.22.0" /end FUNCTION
/begin FUNCTION DPLTETHS "11.6.0    plausibility diagnosis ethanol sensor"
 /begin DEF_CHARACTERISTIC CWDPLTETHS FfPrm_stAmbTSnsrCfg_C KLDTESXTAB TDTESRGMX TETHSMIN /end DEF_CHARACTERISTIC
 /begin REF_CHARACTERISTIC FfPrm_stEna_C /end REF_CHARACTERISTIC
 /begin IN_MEASUREMENT B_tethsrg_msg DIUMPR_stEvapDenCmpl DSM_TripChgFinshd EngStrt_bStrtEnd SyC_ctPostDrvLeave SyC_stSub TDev_flgColdStrtDiagFinshd TDev_tRefColdStrtChk teths_msg TiOff_tiStrtEndOff /end IN_MEASUREMENT
 /begin OUT_MEASUREMENT B_ethstnpl_msg B_ethstplh_msg sdplteths_msg /end OUT_MEASUREMENT
 /begin LOC_MEASUREMENT B_dtmxfrz B_dtreffrz DPLTETHS_ctReIni dtethsmx dtethstref tiStrtEndOff tref_mp /end LOC_MEASUREMENT
 FUNCTION_VERSION "11.6.0" /end FUNCTION
/begin FUNCTION DPS_Tmp "100.1.0   standard powerstage diagnosis" /begin DEF_CHARACTERISTIC DPSWATCHINDEX THP TVP /end DEF_CHARACTERISTIC /begin IN_MEASUREMENT B_PmdInit_msg /end IN_MEASUREMENT
 /begin LOC_MEASUREMENT dps_error dps_errStat dps_errStat_sum_rec dps_errStat_sum_ver dps_index dps_recoveryTime dps_state dps_verifyTime /end LOC_MEASUREMENT
 FUNCTION_VERSION "100.1.0" /end FUNCTION
/begin COMPU_METHOD B_TRUE "" TAB_VERB "%6.3" "" COMPU_TAB_REF B_TRUE /end COMPU_METHOD
/begin COMPU_VTAB B_TRUE "" TAB_VERB 2 0 "FALSE" 1 "TRUE" /end COMPU_VTAB
/begin COMPU_METHOD dez "" RAT_FUNC "%6.2" "" COEFFS 0 1 0 0 0 1 /end COMPU_METHOD
/begin COMPU_METHOD dfp_verbal "" TAB_VERB "%6.3" "-" COMPU_TAB_REF dfp_verbal /end COMPU_METHOD
/begin COMPU_VTAB dfp_verbal "" TAB_VERB 83 0 "DFP_AAA" 1 "DFP_AAV" 2 "DFP_AAVE" 3 "DFP_AGRE" 4 "DFP_AGRS" 5 "DFP_DHFHD" 6 "DFP_DK" 7 "DFP_DK1P" 8 "DFP_DK2P" 9 "DFP_DKVS" 10 "DFP_DSKV" 11 "DFP_DSKVR" 12 "DFP_DSKVS" 13 "DFP_DSS" 14 "DFP_DSU" 15 "DFP_DVEE" 16 "DFP_DVEF" 17 "DFP_DVEFO" 18 "DFP_DVEL" 19 "DFP_DVEN" 20 "DFP_DVER" 21 "DFP_DVEU" 22 "DFP_DVEUB" 23 "DFP_DVEUW" 24 "DFP_DYLSU" 25 "DFP_ENWCS" 26 "DFP_ENWS" 27 "DFP_ENWSE" 28 "DFP_EONV" 29 "DFP_FP1P" 30 "DFP_FP2P" 31 "DFP_FRA" 32 "DFP_FST" 33 "DFP_FSTE" 34 "DFP_FSTR" 35 "DFP_FTDLA" 36 "DFP_HDR" 37 "DFP_HDRKH" 38 "DFP_HDRPL" 39 "DFP_HFM" 40 "DFP_HSH" 41 "DFP_HSHE" 42 "DFP_KAT" 43 "DFP_KPE" 44 "DFP_KS1" 45 "DFP_LLRH" 46 "DFP_LLRKH" 47 "DFP_LM" 48 "DFP_LSH" 49 "DFP_LZSR" 50 "DFP_MD" 51 "DFP_NWS" 52 "DFP_NWSE" 53 "DFP_ORA" 54 "DFP_PLLSU" 55 "DFP_PSR" 56 "DFP_PSR1" 57 "DFP_PSRB" 58 "DFP_PSRE" 59 "DFP_PSRP" 60 "DFP_PU" 61 "DFP_PUE" 62 "DFP_PUPL" 63 "DFP_PUR" 64 "DFP_STHDR" 65 "DFP_TA" 66 "DFP_TANKL" 67 "DFP_TANLCS" 68 "DFP_TANLPRC" 69 "DFP_TANLR" 70 "DFP_TASRCS" 71 "DFP_TASRE" 72 "DFP_TASRPRC" 73 "DFP_TASRR" 74 "DFP_TESF" 75 "DFP_TESG" 76 "DFP_TM" 77 "DFP_TMCS" 78 "DFP_TME" 79 "DFP_TMP" 80 "DFP_UB" 81 "DFP_VFZ" 82 "DFP_ZZZ" DEFAULT_VALUE "---" /end COMPU_VTAB
/begin COMPU_METHOD EngN "" RAT_FUNC "%6.3" "rpm" COEFFS 0 2 0 0 0 1 /end COMPU_METHOD
/begin COMPU_METHOD EVAPSNSR_TPURGLINESTUCKCHK_SC_Compu "" TAB_VERB "%6.3" "" COMPU_TAB_REF EVAPSNSR_TPURGLINESTUCKCHK_SC_Compu /end COMPU_METHOD
/begin COMPU_VTAB EVAPSNSR_TPURGLINESTUCKCHK_SC_Compu "" TAB_VERB 3 0 "00_NO_STUCKCHK" 1 "01_STUCKCHK_DRGPTR" 2 "02_CODWORD" /end COMPU_VTAB
/begin COMPU_METHOD EVAPSNSR_TPURGLINE_SC_Compu "" TAB_VERB "%6.3" "" COMPU_TAB_REF EVAPSNSR_TPURGLINE_SC_Compu /end COMPU_METHOD
/begin COMPU_VTAB EVAPSNSR_TPURGLINE_SC_Compu "" TAB_VERB 3 0 "00_NO_SNSR" 1 "01_AI_SNSR" 2 "02_CODWORD" /end COMPU_VTAB
/begin COMPU_METHOD EVAPSNSR_VAR_SY_Compu "" TAB_VERB "%6.3" "" COMPU_TAB_REF EVAPSNSR_VAR_SY_Compu /end COMPU_METHOD
/begin COMPU_VTAB EVAPSNSR_VAR_SY_Compu "" TAB_VERB 58 0 "kein Kundenbezug" 1 "DAI" 3 "VWW" 4 "POR" 5 "AUD" 6 "OPE" 9 "FIA" 11 "BMW" 14 "PSA" 15 "REN" 17 "ALF" 18 "SAB" 19 "VOL" 20 "NIS" 21 "GMU" 22 "FOR" 26 "IMJ" 36 "MAN" 51 "SEA" 53 "CHR" 54 "JAG" 55 "ROL" 69 "FER" 72 "TOY" 73 "LAM" 123 "MIT" 147 "HYU" 159 "HON" 160 "MAZ" 183 "CU" 190 "LRG" 204 "VVW" 214 "AVT" 242 "Iveco" 243 "DMC" 248 "SUZ" 267 "SSANGYONG" 270 "KEF" 289 "AMG" 308 "TAT" 319 "MVM" 327 "OTOSAN" 328 "MM" 385 "UAES" 590 "Scania" 609 "Deutz" 720 "Greatwall" 745 "JMC Ford" 788 "Saic Motor" 828 "RBCD" 898 "MFTBC" 936 "Anhui_Quanchai" 944 "DOOSAN Infracore" 984 "FAW - Wuxi" 999 "ALL" 2887 "Nonox" 9454 "Fuso" 9707 "Hatz" /end COMPU_VTAB
/begin COMPU_METHOD EVAPSYSVAPPPIDA3_SC_Compu "" TAB_VERB "%6.3" "" COMPU_TAB_REF EVAPSYSVAPPPIDA3_SC_Compu /end COMPU_METHOD
/begin COMPU_VTAB EVAPSYSVAPPPIDA3_SC_Compu "" TAB_VERB 6 0 "0" 1 "1" 2 "2" 3 "3" 4 "4" 5 "5" /end COMPU_VTAB
/begin COMPU_METHOD EVREX_SY_Compu "" TAB_VERB "%6.3" "" COMPU_TAB_REF EVREX_SY_Compu /end COMPU_METHOD
/begin COMPU_VTAB EVREX_SY_Compu "" TAB_VERB 3 0 "EVREX_NO" 1 "EVREX_ECU" 2 "EVREX_VCU" /end COMPU_VTAB
/begin COMPU_METHOD EVTYP_SY_Compu "" TAB_VERB "%6.3" "" COMPU_TAB_REF EVTYP_SY_Compu /end COMPU_METHOD
/begin COMPU_VTAB EVTYP_SY_Compu "" TAB_VERB 2 0 "NOEV" 1 "EV" /end COMPU_VTAB
/begin COMPU_METHOD EWPECU_ACTV_SY_Compu "" TAB_VERB "%6.3" "" COMPU_TAB_REF EWPECU_ACTV_SY_Compu /end COMPU_METHOD
/begin COMPU_VTAB EWPECU_ACTV_SY_Compu "" TAB_VERB 2 0 "False" 1 "True" /end COMPU_VTAB
/begin COMPU_METHOD EXCLSNFCOMINAIR_SC_Compu "" TAB_VERB "%6.3" "" COMPU_TAB_REF EXCLSNFCOMINAIR_SC_Compu /end COMPU_METHOD
/begin COMPU_VTAB EXCLSNFCOMINAIR_SC_Compu "" TAB_VERB 2 0 "False" 1 "True" /end COMPU_VTAB
/begin COMPU_METHOD EXH2BNKACTVNTYPSEL_SC_Compu "" TAB_VERB "%6.3" "" COMPU_TAB_REF EXH2BNKACTVNTYPSEL_SC_Compu /end COMPU_METHOD
/begin COMPU_VTAB EXH2BNKACTVNTYPSEL_SC_Compu "" TAB_VERB 2 0 "False" 1 "True" /end COMPU_VTAB
/begin COMPU_METHOD EXHBNKNUM_SY_Compu "" RAT_FUNC "%6.2" "" COEFFS 0 1 0 0 0 1 /end COMPU_METHOD
/begin COMPU_METHOD EXHBRNR_SC_Compu "" TAB_VERB "%6.3" "" COMPU_TAB_REF EXHBRNR_SC_Compu /end COMPU_METHOD
/begin COMPU_VTAB EXHBRNR_SC_Compu "" TAB_VERB 3 0 "none" 1 "one_exhaust_burner" 2 "two_exhaust_burner" /end COMPU_VTAB
/begin COMPU_METHOD EXHCO_ACTVNINHBNFCO_SC_Compu "" TAB_VERB "%6.3" "" COMPU_TAB_REF EXHCO_ACTVNINHBNFCO_SC_Compu /end COMPU_METHOD
/begin COMPU_VTAB EXHCO_ACTVNINHBNFCO_SC_Compu "" TAB_VERB 2 0 "Deactivated" 1 "Activated" /end COMPU_VTAB
/begin COMPU_METHOD EXHDVT_TSNSRCFG_SC_Compu "" TAB_VERB "%6.3" "" COMPU_TAB_REF EXHDVT_TSNSRCFG_SC_Compu /end COMPU_METHOD
/begin COMPU_VTAB EXHDVT_TSNSRCFG_SC_Compu "" TAB_VERB 7 1 "ExhTSnsr_1" 2 "ExhTSnsr_2" 3 "ExhTSnsr_1_2" 4 "ExhTSnsr_3" 7 "ExhTSnsr_1_2_3" 8 "ExhTSnsr_4" 15 "ExhTSnsr_1_2_3_4" /end COMPU_VTAB
/begin COMPU_METHOD EXHDVT_YSPLITCFGEXHSYS_SC_Compu "" TAB_VERB "%6.3" "" COMPU_TAB_REF EXHDVT_YSPLITCFGEXHSYS_SC_Compu /end COMPU_METHOD
/begin COMPU_VTAB EXHDVT_YSPLITCFGEXHSYS_SC_Compu "" TAB_VERB 4 0 "No_YSplit" 1 "UpStream_YSplit" 2 "DownStream_YSplit" 3 "BothStream_YSpli" /end COMPU_VTAB
/begin COMPU_METHOD EXHFLP2_TYPAVL_SY_Compu "" TAB_VERB "%6.3" "" COMPU_TAB_REF EXHFLP2_TYPAVL_SY_Compu /end COMPU_METHOD
/begin COMPU_VTAB EXHFLP2_TYPAVL_SY_Compu "" TAB_VERB 2 0 "False" 1 "True" /end COMPU_VTAB
/begin COMPU_METHOD EXHFLP2_TYPTWINFLW_SY_Compu "" TAB_VERB "%6.3" "" COMPU_TAB_REF EXHFLP2_TYPTWINFLW_SY_Compu /end COMPU_METHOD
/begin COMPU_VTAB EXHFLP2_TYPTWINFLW_SY_Compu "" TAB_VERB 2 0 "False" 1 "True" /end COMPU_VTAB
/begin COMPU_METHOD EXHFLPLPI_TYPAVL_SC_Compu "" TAB_VERB "%6.3" "" COMPU_TAB_REF EXHFLPLPI_TYPAVL_SC_Compu /end COMPU_METHOD
/begin COMPU_VTAB EXHFLPLPI_TYPAVL_SC_Compu "" TAB_VERB 2 0 "False" 1 "True" /end COMPU_VTAB
/begin COMPU_METHOD EXHFLP_TYPAVLDELIBSTDACTR_SY_Compu "" TAB_VERB "%6.3" "" COMPU_TAB_REF EXHFLP_TYPAVLDELIBSTDACTR_SY_Compu /end COMPU_METHOD
/begin COMPU_VTAB EXHFLP_TYPAVLDELIBSTDACTR_SY_Compu "" TAB_VERB 2 0 "FALSE" 1 "TRUE" /end COMPU_VTAB
/begin COMPU_METHOD EXHFLP_TYPAVL_SY_Compu "" TAB_VERB "%6.3" "" COMPU_TAB_REF EXHFLP_TYPAVL_SY_Compu /end COMPU_METHOD
/begin COMPU_VTAB EXHFLP_TYPAVL_SY_Compu "" TAB_VERB 2 0 "FALSE" 1 "TRUE" /end COMPU_VTAB
/begin COMPU_METHOD EXHFLP_TYPTWINFLW_SY_Compu "" TAB_VERB "%6.3" "" COMPU_TAB_REF EXHFLP_TYPTWINFLW_SY_Compu /end COMPU_METHOD
/begin COMPU_VTAB EXHFLP_TYPTWINFLW_SY_Compu "" TAB_VERB 2 0 "0" 1 "1" /end COMPU_VTAB
/begin COMPU_METHOD EXHMGTTQINTLSTGY_SC_Compu "" TAB_VERB "%6.3" "" COMPU_TAB_REF EXHMGTTQINTLSTGY_SC_Compu /end COMPU_METHOD
/begin COMPU_VTAB EXHMGTTQINTLSTGY_SC_Compu "" TAB_VERB 2 0 "False" 1 "True" /end COMPU_VTAB
/begin COMPU_METHOD EXHMGT_ACTVCPTPROTNCOORR_SC_Compu "" TAB_VERB "%6.3" "" COMPU_TAB_REF EXHMGT_ACTVCPTPROTNCOORR_SC_Compu /end COMPU_METHOD
/begin COMPU_VTAB EXHMGT_ACTVCPTPROTNCOORR_SC_Compu "" TAB_VERB 2 0 "False" 1 "True" /end COMPU_VTAB
/begin COMPU_METHOD EXHMGT_ACTVNCPTPROTNAIRMFLOWREQ_SC_Compu "" TAB_VERB "%6.3" "" COMPU_TAB_REF EXHMGT_ACTVNCPTPROTNAIRMFLOWREQ_SC_Compu /end COMPU_METHOD
/begin COMPU_VTAB EXHMGT_ACTVNCPTPROTNAIRMFLOWREQ_SC_Compu "" TAB_VERB 2 0 "False" 1 "True" /end COMPU_VTAB
/begin COMPU_METHOD EXHMGT_ACTVNLIMNTQTCAT_SC_Compu "" TAB_VERB "%6.3" "" COMPU_TAB_REF EXHMGT_ACTVNLIMNTQTCAT_SC_Compu /end COMPU_METHOD
/begin COMPU_VTAB EXHMGT_ACTVNLIMNTQTCAT_SC_Compu "" TAB_VERB 2 0 "False" 1 "True" /end COMPU_VTAB
/begin COMPU_METHOD EXHMGT_CATHEATGENGSTREQACTV_SC_Compu "" TAB_VERB "%6.3" "" COMPU_TAB_REF EXHMGT_CATHEATGENGSTREQACTV_SC_Compu /end COMPU_METHOD
/begin COMPU_VTAB EXHMGT_CATHEATGENGSTREQACTV_SC_Compu "" TAB_VERB 2 0 "False" 1 "True" /end COMPU_VTAB
/begin COMPU_METHOD Fact4 "" RAT_FUNC "%6.4" "-" COEFFS 0 20 0 0 0 1 /end COMPU_METHOD
/begin COMPU_METHOD fak_q2p3283Em10 "" RAT_FUNC "%12.11" "-" COEFFS 0 4294967296 0 0 0 1 /end COMPU_METHOD
/begin COMPU_METHOD fak_q3p72529Em9 "" RAT_FUNC "%11.10" "" COEFFS 0 268435456 0 0 0 1 /end COMPU_METHOD
/begin COMPU_METHOD fak_q4p6566Em10 "" RAT_FUNC "%18.17" "" COEFFS 0 2147483648 0 0 0 1 /end COMPU_METHOD
/begin COMPU_METHOD fak_ub_b1 "" RAT_FUNC "%6.4" "-" COEFFS 0 256 0 0 0 1 /end COMPU_METHOD
/begin COMPU_METHOD fak_ub_b100 "" RAT_FUNC "%6.3" "" COEFFS 0 255 0 0 0 100 /end COMPU_METHOD
/begin COMPU_METHOD fak_ub_b2 "" RAT_FUNC "%8.5" "-" COEFFS 0 256 0 0 0 2 /end COMPU_METHOD
/begin COMPU_METHOD fak_ub_b4 "" RAT_FUNC "%6.4" "-" COEFFS 0 256 0 0 0 4 /end COMPU_METHOD
/begin COMPU_METHOD fak_uw_b1 "" RAT_FUNC "%7.6" "-" COEFFS 0 65536 0 0 0 1 /end COMPU_METHOD
/begin COMPU_METHOD fak_uw_b16 "" RAT_FUNC "%6.5" "-" COEFFS 0 65536 0 0 0 16 /end COMPU_METHOD
/begin COMPU_METHOD fak_uw_b2 "" RAT_FUNC "%7.6" "-" COEFFS 0 65536 0 0 0 2 /end COMPU_METHOD
/begin COMPU_METHOD fak_uw_b4 "" RAT_FUNC "%7.6" "-" COEFFS 0 65536 0 0 0 4 /end COMPU_METHOD
/begin COMPU_METHOD fak_uw_b8 "" RAT_FUNC "%6.5" "-" COEFFS 0 65536 0 0 0 8 /end COMPU_METHOD
/begin COMPU_METHOD md_sw_q0p01 "" RAT_FUNC "%6.4" "Nm" COEFFS 0 100 0 0 0 1 /end COMPU_METHOD
/begin COMPU_METHOD md_sw_q0p1 "" RAT_FUNC "%6.3" "Nm" COEFFS 0 10 0 0 0 1 /end COMPU_METHOD
/begin COMPU_METHOD nmotg_sw_q0p39 "" RAT_FUNC "%6.3" "1/min/s" COEFFS 0 1 0 0 0 0.39063 /end COMPU_METHOD
/begin COMPU_METHOD nmot_sb_q10 "" RAT_FUNC "%6.1" "1/min" COEFFS 0 1 0 0 0 10 /end COMPU_METHOD
/begin COMPU_METHOD nmot_sw_q0p25 "" RAT_FUNC "%6.3" "1/min" COEFFS 0 1 0 0 0 0.25 /end COMPU_METHOD
/begin COMPU_METHOD nmot_sw_q0p5 "" RAT_FUNC "%6.3" "1/min" COEFFS 0 2 0 0 0 1 /end COMPU_METHOD
/begin COMPU_METHOD nmot_ub_q10 "" RAT_FUNC "%6.1" "1/min" COEFFS 0 1 0 0 0 10 /end COMPU_METHOD
/begin COMPU_METHOD nmot_uw_q0p25 "" RAT_FUNC "%6.3" "1/min" COEFFS 0 1 0 0 0 0.25 /end COMPU_METHOD
/begin COMPU_METHOD OneToOne "" RAT_FUNC "%6.2" "-" COEFFS 0 1 0 0 0 1 /end COMPU_METHOD
/begin COMPU_METHOD Prc "" RAT_FUNC "%6.4" "%" COEFFS 0 81.92 0 0 0 1 /end COMPU_METHOD
/begin COMPU_METHOD p_q0p039 "" RAT_FUNC "%6.4" "hPa" COEFFS 0 256 0 0 0 10 /end COMPU_METHOD
/begin COMPU_METHOD p_q0p078 "" RAT_FUNC "%6.4" "hPa" COEFFS 0 64 0 0 0 5 /end COMPU_METHOD
/begin COMPU_METHOD q0p003125_Nm_DIV_rpm "" RAT_FUNC "%6.4" "Nm/rpm" COEFFS 0 320 0 0 0 1 /end COMPU_METHOD
/begin COMPU_METHOD q0p025_Nm_DIV_rpm "" RAT_FUNC "%6.4" "Nm/rpm" COEFFS 0 40 0 0 0 1 /end COMPU_METHOD
/begin COMPU_METHOD q7p62939Em3_rpm_DIV_Nm_s "" RAT_FUNC "%6.4" "rpm/(Nm*s)" COEFFS 0 65536 0 0 0 500 /end COMPU_METHOD
/begin COMPU_METHOD rel_q0p0078125 "" RAT_FUNC "%6.4" "%" COEFFS 0 128 0 0 0 1 /end COMPU_METHOD
/begin COMPU_METHOD rel_q0p02344 "" RAT_FUNC "%6.4" "%" COEFFS 0 32 0 0 0 0.75 /end COMPU_METHOD
/begin COMPU_METHOD rel_q3p576Em7 "" RAT_FUNC "%9.8" "%" COEFFS 0 8388608 0 0 0 3 /end COMPU_METHOD
/begin COMPU_METHOD rel_sw_b1536 "" RAT_FUNC "%6.4" "%" COEFFS 0 65536 0 0 0 3072 /end COMPU_METHOD
/begin COMPU_METHOD rel_uw_q0p0234 "" RAT_FUNC "%6.4" "%" COEFFS 0 32 0 0 0 0.75 /end COMPU_METHOD
/begin COMPU_METHOD t100msxs_uw_b6553p5 "" RAT_FUNC "%6.3" "s" COEFFS 0 1 0 0 0 0.1 /end COMPU_METHOD
/begin COMPU_METHOD t10msxs_uw_b655p35 "" RAT_FUNC "%6.4" "s" COEFFS 0 1 0 0 0 0.01 /end COMPU_METHOD
/begin COMPU_METHOD t200msxs_ub_b51 "" RAT_FUNC "%6.3" "s" COEFFS 0 1 0 0 0 0.2 /end COMPU_METHOD
/begin COMPU_METHOD Temp_Cels "" RAT_FUNC "%6.1" "deg C" COEFFS 0 10 2731.4 0 0 1 /end COMPU_METHOD
/begin COMPU_METHOD temp_ub_q0p75_o48 "" RAT_FUNC "%6.2" "Grad C" COEFFS 0 1 48 0 0 0.75 /end COMPU_METHOD
/begin COMPU_METHOD Time_sec_q1_COMPU "" RAT_FUNC "%6.2" "s" COEFFS 0 1 0 0 0 1 /end COMPU_METHOD
/begin COMPU_METHOD t_q0p01 "" RAT_FUNC "%6.4" "s" COEFFS 0 100 0 0 0 1 /end COMPU_METHOD
/begin COMPU_METHOD t_q0p02 "" RAT_FUNC "%6.4" "s" COEFFS 0 100 0 0 0 2 /end COMPU_METHOD
/begin COMPU_METHOD t_q0p05 "" RAT_FUNC "%6.4" "s" COEFFS 0 100 0 0 0 5 /end COMPU_METHOD
/begin COMPU_METHOD t_q0p1 "" RAT_FUNC "%6.3" "s" COEFFS 0 10 0 0 0 1 /end COMPU_METHOD
/begin COMPU_METHOD t_q0p2 "" RAT_FUNC "%6.3" "s" COEFFS 0 10 0 0 0 2 /end COMPU_METHOD
/begin COMPU_METHOD t_q1 "" RAT_FUNC "%6.2" "s" COEFFS 0 1 0 0 0 1 /end COMPU_METHOD
/begin COMPU_METHOD Vel "" RAT_FUNC "%6.4" "km/h" COEFFS 0 100 0 0 0 1 /end COMPU_METHOD
/begin COMPU_METHOD VelToN "" RAT_FUNC "%8.7" "(km/h)/rpm" COEFFS 0 100000 0 0 0 1 /end COMPU_METHOD
/begin COMPU_METHOD vol_q1p953Em5_l "" RAT_FUNC "%7.6" "l" COEFFS 0 51200 0 0 0 1 /end COMPU_METHOD
/begin COMPU_METHOD vol_q3p052Em5_l "" RAT_FUNC "%7.6" "L" COEFFS 0 65536 0 0 0 2 /end COMPU_METHOD
/begin COMPU_METHOD vol_q3p90625Em3_l "" RAT_FUNC "%6.4" "l" COEFFS 0 65536 0 0 0 256 /end COMPU_METHOD
/begin COMPU_METHOD vol_q3p906Em5_l "" RAT_FUNC "%7.6" "l" COEFFS 0 25600 0 0 0 1 /end COMPU_METHOD
/begin COMPU_METHOD vol_q7p8125Em3_l "" RAT_FUNC "%6.4" "l" COEFFS 0 128 0 0 0 1 /end COMPU_METHOD
/begin COMPU_METHOD zk200msxs_uw_b13107p2 "" RAT_FUNC "%6.0" "s" COEFFS 0 0 65536 0 5 0 /end COMPU_METHOD
/begin RECORD_LAYOUT KwUb FNC_VALUES 1 UBYTE COLUMN_DIR DIRECT /end RECORD_LAYOUT
/begin RECORD_LAYOUT RB_Axis_S16 NO_AXIS_PTS_X 1 SWORD AXIS_PTS_X 2 SWORD INDEX_INCR DIRECT /end RECORD_LAYOUT
/begin RECORD_LAYOUT RB_CurveGroup_S16 FNC_VALUES 1 SWORD COLUMN_DIR DIRECT /end RECORD_LAYOUT
/begin RECORD_LAYOUT RB_CurveGroup_S8 FNC_VALUES 1 SBYTE COLUMN_DIR DIRECT /end RECORD_LAYOUT
/begin RECORD_LAYOUT RB_CurveGroup_U16 FNC_VALUES 1 UWORD COLUMN_DIR DIRECT /end RECORD_LAYOUT
/begin RECORD_LAYOUT RB_CurveGroup_U8 FNC_VALUES 1 UBYTE COLUMN_DIR DIRECT /end RECORD_LAYOUT
/begin RECORD_LAYOUT RB_Curve_S16_S16 NO_AXIS_PTS_X 1 SWORD AXIS_PTS_X 2 SWORD INDEX_INCR DIRECT FNC_VALUES 3 SWORD COLUMN_DIR DIRECT /end RECORD_LAYOUT
/begin RECORD_LAYOUT RB_Curve_U16_U16 NO_AXIS_PTS_X 1 UWORD AXIS_PTS_X 2 UWORD INDEX_INCR DIRECT FNC_VALUES 3 UWORD COLUMN_DIR DIRECT /end RECORD_LAYOUT
/begin RECORD_LAYOUT RB_Curve_U16_U8_Static NO_AXIS_PTS_X 1 UWORD AXIS_PTS_X 2 UWORD INDEX_INCR DIRECT FNC_VALUES 3 UBYTE COLUMN_DIR DIRECT STATIC_RECORD_LAYOUT /end RECORD_LAYOUT
/begin RECORD_LAYOUT RB_MapGroup_S16 FNC_VALUES 1 SWORD COLUMN_DIR DIRECT /end RECORD_LAYOUT
/begin RECORD_LAYOUT RB_Map_S16S16_S16 NO_AXIS_PTS_X 1 SWORD NO_AXIS_PTS_Y 2 SWORD AXIS_PTS_X 3 SWORD INDEX_INCR DIRECT AXIS_PTS_Y 4 SWORD INDEX_INCR DIRECT FNC_VALUES 5 SWORD COLUMN_DIR DIRECT /end RECORD_LAYOUT
/begin RECORD_LAYOUT RB_ValA_Wu16 FNC_VALUES 1 UWORD COLUMN_DIR DIRECT /end RECORD_LAYOUT
/begin RECORD_LAYOUT RB_Val_Wboolean FNC_VALUES 1 UBYTE COLUMN_DIR DIRECT /end RECORD_LAYOUT
/begin RECORD_LAYOUT RB_Val_Ws16 FNC_VALUES 1 SWORD COLUMN_DIR DIRECT /end RECORD_LAYOUT
/begin RECORD_LAYOUT RB_Val_Ws8 FNC_VALUES 1 SBYTE COLUMN_DIR DIRECT /end RECORD_LAYOUT
/begin RECORD_LAYOUT RB_Val_Wu16 FNC_VALUES 1 UWORD COLUMN_DIR DIRECT /end RECORD_LAYOUT
/begin RECORD_LAYOUT RB_Val_Wu8 FNC_VALUES 1 UBYTE COLUMN_DIR DIRECT /end RECORD_LAYOUT
/end MODULE
/end PROJECT
