ASAP2_VERSION 1 60
/begin PROJECT MG1CS022 "MG1CS022"
/begin HEADER "" VERSION "MG1CS022_62XSC_V037_TPROT" PROJECT_NO MG1CS022 /end HEADER
/begin MODULE DIM ""
/begin MOD_COMMON "" BYTE_ORDER MSB_LAST ALIGNMENT_BYTE 1 ALIGNMENT_WORD 2 ALIGNMENT_LONG 4 ALIGNMENT_INT64 4 ALIGNMENT_FLOAT32_IEEE 4 ALIGNMENT_FLOAT64_IEEE 4 DATA_SIZE 32 /end MOD_COMMON
/begin MEASUREMENT ComM_ChannelStruct[0].ChannelState_e "ComM Channel structure[0]/" ULONG RB_RBA_Common_CentralElements_CompuMethods_Identical 1 100 0.0 4.E9 FORMAT "%5.0" ECU_ADDRESS 0x500063CC /end MEASUREMENT
/begin MEASUREMENT ComM_ChannelStruct[1].ChannelState_e "ComM Channel structure[1]/" ULONG RB_RBA_Common_CentralElements_CompuMethods_Identical 1 100 0.0 4.E9 FORMAT "%5.0" ECU_ADDRESS 0x500063E4 /end MEASUREMENT
/begin MEASUREMENT ComM_ChannelStruct[2].ChannelState_e "ComM Channel structure[2]/" ULONG RB_RBA_Common_CentralElements_CompuMethods_Identical 1 100 0.0 4.E9 FORMAT "%5.0" ECU_ADDRESS 0x500063FC /end MEASUREMENT
/begin MEASUREMENT ComM_ChannelStruct[3].ChannelState_e "ComM Channel structure[3]/" ULONG RB_RBA_Common_CentralElements_CompuMethods_Identical 1 100 0.0 4.E9 FORMAT "%5.0" ECU_ADDRESS 0x50006414 /end MEASUREMENT
/begin MEASUREMENT ComM_ChannelStruct[0].LightTimeoutCtr_u32 "ComM Channel structure[0]/" ULONG RB_RBA_Common_CentralElements_CompuMethods_Identical 1 100 0.0 4.E9 FORMAT "%5.0" ECU_ADDRESS 0x500063D0 /end MEASUREMENT
/begin MEASUREMENT ComM_ChannelStruct[1].LightTimeoutCtr_u32 "ComM Channel structure[1]/" ULONG RB_RBA_Common_CentralElements_CompuMethods_Identical 1 100 0.0 4.E9 FORMAT "%5.0" ECU_ADDRESS 0x500063E8 /end MEASUREMENT
/begin MEASUREMENT ComM_ChannelStruct[2].LightTimeoutCtr_u32 "ComM Channel structure[2]/" ULONG RB_RBA_Common_CentralElements_CompuMethods_Identical 1 100 0.0 4.E9 FORMAT "%5.0" ECU_ADDRESS 0x50006400 /end MEASUREMENT
/begin MEASUREMENT ComM_ChannelStruct[3].LightTimeoutCtr_u32 "ComM Channel structure[3]/" ULONG RB_RBA_Common_CentralElements_CompuMethods_Identical 1 100 0.0 4.E9 FORMAT "%5.0" ECU_ADDRESS 0x50006418 /end MEASUREMENT
/begin MEASUREMENT ComM_ChannelStruct[0].MinFullComTimeoutCtr_u16 "ComM Channel structure[0]/" UWORD RB_RBA_Common_CentralElements_CompuMethods_Identical 1 100 0.0 65535. FORMAT "%5.0" ECU_ADDRESS 0x500063D4 /end MEASUREMENT
/begin MEASUREMENT ComM_ChannelStruct[1].MinFullComTimeoutCtr_u16 "ComM Channel structure[1]/" UWORD RB_RBA_Common_CentralElements_CompuMethods_Identical 1 100 0.0 65535. FORMAT "%5.0" ECU_ADDRESS 0x500063EC /end MEASUREMENT
/begin MEASUREMENT ComM_ChannelStruct[2].MinFullComTimeoutCtr_u16 "ComM Channel structure[2]/" UWORD RB_RBA_Common_CentralElements_CompuMethods_Identical 1 100 0.0 65535. FORMAT "%5.0" ECU_ADDRESS 0x50006404 /end MEASUREMENT
/begin MEASUREMENT ComM_ChannelStruct[3].MinFullComTimeoutCtr_u16 "ComM Channel structure[3]/" UWORD RB_RBA_Common_CentralElements_CompuMethods_Identical 1 100 0.0 65535. FORMAT "%5.0" ECU_ADDRESS 0x5000641C /end MEASUREMENT
/begin MEASUREMENT ComM_ChannelStruct[0].UserRequestCtr_u16 "ComM Channel structure[0]/" UWORD RB_RBA_Common_CentralElements_CompuMethods_Identical 1 100 0.0 65535. FORMAT "%5.0" ECU_ADDRESS 0x500063D6 /end MEASUREMENT
/begin MEASUREMENT ComM_ChannelStruct[1].UserRequestCtr_u16 "ComM Channel structure[1]/" UWORD RB_RBA_Common_CentralElements_CompuMethods_Identical 1 100 0.0 65535. FORMAT "%5.0" ECU_ADDRESS 0x500063EE /end MEASUREMENT
/begin MEASUREMENT ComM_ChannelStruct[2].UserRequestCtr_u16 "ComM Channel structure[2]/" UWORD RB_RBA_Common_CentralElements_CompuMethods_Identical 1 100 0.0 65535. FORMAT "%5.0" ECU_ADDRESS 0x50006406 /end MEASUREMENT
/begin MEASUREMENT ComM_ChannelStruct[3].UserRequestCtr_u16 "ComM Channel structure[3]/" UWORD RB_RBA_Common_CentralElements_CompuMethods_Identical 1 100 0.0 65535. FORMAT "%5.0" ECU_ADDRESS 0x5000641E /end MEASUREMENT
/begin MEASUREMENT ComM_ChannelStruct[0].ChannelMode_u8 "ComM Channel structure[0]/" UBYTE RB_RBA_Common_CentralElements_CompuMethods_Identical 1 100 0.0 255. FORMAT "%5.0" ECU_ADDRESS 0x500063D8 /end MEASUREMENT
/begin MEASUREMENT ComM_ChannelStruct[1].ChannelMode_u8 "ComM Channel structure[1]/" UBYTE RB_RBA_Common_CentralElements_CompuMethods_Identical 1 100 0.0 255. FORMAT "%5.0" ECU_ADDRESS 0x500063F0 /end MEASUREMENT
/begin MEASUREMENT ComM_ChannelStruct[2].ChannelMode_u8 "ComM Channel structure[2]/" UBYTE RB_RBA_Common_CentralElements_CompuMethods_Identical 1 100 0.0 255. FORMAT "%5.0" ECU_ADDRESS 0x50006408 /end MEASUREMENT
/begin MEASUREMENT ComM_ChannelStruct[3].ChannelMode_u8 "ComM Channel structure[3]/" UBYTE RB_RBA_Common_CentralElements_CompuMethods_Identical 1 100 0.0 255. FORMAT "%5.0" ECU_ADDRESS 0x50006420 /end MEASUREMENT
/begin MEASUREMENT ComM_ChannelStruct[0].BusSmMode_u8 "ComM Channel structure[0]/" UBYTE RB_RBA_Common_CentralElements_CompuMethods_Identical 1 100 0.0 255. FORMAT "%5.0" ECU_ADDRESS 0x500063D9 /end MEASUREMENT
/begin MEASUREMENT ComM_ChannelStruct[1].BusSmMode_u8 "ComM Channel structure[1]/" UBYTE RB_RBA_Common_CentralElements_CompuMethods_Identical 1 100 0.0 255. FORMAT "%5.0" ECU_ADDRESS 0x500063F1 /end MEASUREMENT
/begin MEASUREMENT ComM_ChannelStruct[2].BusSmMode_u8 "ComM Channel structure[2]/" UBYTE RB_RBA_Common_CentralElements_CompuMethods_Identical 1 100 0.0 255. FORMAT "%5.0" ECU_ADDRESS 0x50006409 /end MEASUREMENT
/begin MEASUREMENT ComM_ChannelStruct[3].BusSmMode_u8 "ComM Channel structure[3]/" UBYTE RB_RBA_Common_CentralElements_CompuMethods_Identical 1 100 0.0 255. FORMAT "%5.0" ECU_ADDRESS 0x50006421 /end MEASUREMENT
/begin MEASUREMENT ComM_ChannelStruct[0].PassiveRequestState_u8 "ComM Channel structure[0]/" UBYTE RB_RBA_Common_CentralElements_CompuMethods_Identical 1 100 0.0 255. FORMAT "%5.0" ECU_ADDRESS 0x500063DA /end MEASUREMENT
/begin MEASUREMENT ComM_ChannelStruct[1].PassiveRequestState_u8 "ComM Channel structure[1]/" UBYTE RB_RBA_Common_CentralElements_CompuMethods_Identical 1 100 0.0 255. FORMAT "%5.0" ECU_ADDRESS 0x500063F2 /end MEASUREMENT
/begin MEASUREMENT ComM_ChannelStruct[2].PassiveRequestState_u8 "ComM Channel structure[2]/" UBYTE RB_RBA_Common_CentralElements_CompuMethods_Identical 1 100 0.0 255. FORMAT "%5.0" ECU_ADDRESS 0x5000640A /end MEASUREMENT
/begin MEASUREMENT ComM_ChannelStruct[3].PassiveRequestState_u8 "ComM Channel structure[3]/" UBYTE RB_RBA_Common_CentralElements_CompuMethods_Identical 1 100 0.0 255. FORMAT "%5.0" ECU_ADDRESS 0x50006422 /end MEASUREMENT
/begin MEASUREMENT ComM_ChannelStruct[0].PncRequestCtr_u8 "ComM Channel structure[0]/" UBYTE RB_RBA_Common_CentralElements_CompuMethods_Identical 1 100 0.0 255. FORMAT "%5.0" ECU_ADDRESS 0x500063DB /end MEASUREMENT
/begin MEASUREMENT ComM_ChannelStruct[1].PncRequestCtr_u8 "ComM Channel structure[1]/" UBYTE RB_RBA_Common_CentralElements_CompuMethods_Identical 1 100 0.0 255. FORMAT "%5.0" ECU_ADDRESS 0x500063F3 /end MEASUREMENT
/begin MEASUREMENT ComM_ChannelStruct[2].PncRequestCtr_u8 "ComM Channel structure[2]/" UBYTE RB_RBA_Common_CentralElements_CompuMethods_Identical 1 100 0.0 255. FORMAT "%5.0" ECU_ADDRESS 0x5000640B /end MEASUREMENT
/begin MEASUREMENT ComM_ChannelStruct[3].PncRequestCtr_u8 "ComM Channel structure[3]/" UBYTE RB_RBA_Common_CentralElements_CompuMethods_Identical 1 100 0.0 255. FORMAT "%5.0" ECU_ADDRESS 0x50006423 /end MEASUREMENT
/begin MEASUREMENT ComM_ChannelStruct[0].InhibitionReqStatus_u8 "ComM Channel structure[0]/" UBYTE RB_RBA_Common_CentralElements_CompuMethods_Identical 1 100 0.0 255. FORMAT "%5.0" ECU_ADDRESS 0x500063DC /end MEASUREMENT
/begin MEASUREMENT ComM_ChannelStruct[1].InhibitionReqStatus_u8 "ComM Channel structure[1]/" UBYTE RB_RBA_Common_CentralElements_CompuMethods_Identical 1 100 0.0 255. FORMAT "%5.0" ECU_ADDRESS 0x500063F4 /end MEASUREMENT
/begin MEASUREMENT ComM_ChannelStruct[2].InhibitionReqStatus_u8 "ComM Channel structure[2]/" UBYTE RB_RBA_Common_CentralElements_CompuMethods_Identical 1 100 0.0 255. FORMAT "%5.0" ECU_ADDRESS 0x5000640C /end MEASUREMENT
/begin MEASUREMENT ComM_ChannelStruct[3].InhibitionReqStatus_u8 "ComM Channel structure[3]/" UBYTE RB_RBA_Common_CentralElements_CompuMethods_Identical 1 100 0.0 255. FORMAT "%5.0" ECU_ADDRESS 0x50006424 /end MEASUREMENT
/begin MEASUREMENT ComM_ChannelStruct[0].NmNetworkRequestStatus_b "ComM Channel structure[0]/" UBYTE RB_RBA_Common_CentralElements_CompuMethods_Identical 1 100 0.0 255. FORMAT "%5.0" ECU_ADDRESS 0x500063DD /end MEASUREMENT
/begin MEASUREMENT ComM_ChannelStruct[1].NmNetworkRequestStatus_b "ComM Channel structure[1]/" UBYTE RB_RBA_Common_CentralElements_CompuMethods_Identical 1 100 0.0 255. FORMAT "%5.0" ECU_ADDRESS 0x500063F5 /end MEASUREMENT
/begin MEASUREMENT ComM_ChannelStruct[2].NmNetworkRequestStatus_b "ComM Channel structure[2]/" UBYTE RB_RBA_Common_CentralElements_CompuMethods_Identical 1 100 0.0 255. FORMAT "%5.0" ECU_ADDRESS 0x5000640D /end MEASUREMENT
/begin MEASUREMENT ComM_ChannelStruct[3].NmNetworkRequestStatus_b "ComM Channel structure[3]/" UBYTE RB_RBA_Common_CentralElements_CompuMethods_Identical 1 100 0.0 255. FORMAT "%5.0" ECU_ADDRESS 0x50006425 /end MEASUREMENT
/begin MEASUREMENT ComM_ChannelStruct[0].DiagnosticRequestState_b "ComM Channel structure[0]/" UBYTE RB_RBA_Common_CentralElements_CompuMethods_Identical 1 100 0.0 255. FORMAT "%5.0" ECU_ADDRESS 0x500063DE /end MEASUREMENT
/begin MEASUREMENT ComM_ChannelStruct[1].DiagnosticRequestState_b "ComM Channel structure[1]/" UBYTE RB_RBA_Common_CentralElements_CompuMethods_Identical 1 100 0.0 255. FORMAT "%5.0" ECU_ADDRESS 0x500063F6 /end MEASUREMENT
/begin MEASUREMENT ComM_ChannelStruct[2].DiagnosticRequestState_b "ComM Channel structure[2]/" UBYTE RB_RBA_Common_CentralElements_CompuMethods_Identical 1 100 0.0 255. FORMAT "%5.0" ECU_ADDRESS 0x5000640E /end MEASUREMENT
/begin MEASUREMENT ComM_ChannelStruct[3].DiagnosticRequestState_b "ComM Channel structure[3]/" UBYTE RB_RBA_Common_CentralElements_CompuMethods_Identical 1 100 0.0 255. FORMAT "%5.0" ECU_ADDRESS 0x50006426 /end MEASUREMENT
/begin MEASUREMENT ComM_ChannelStruct[0].CommunicationAllowed_b "ComM Channel structure[0]/" UBYTE RB_RBA_Common_CentralElements_CompuMethods_Identical 1 100 0.0 255. FORMAT "%5.0" ECU_ADDRESS 0x500063DF /end MEASUREMENT
/begin MEASUREMENT ComM_ChannelStruct[1].CommunicationAllowed_b "ComM Channel structure[1]/" UBYTE RB_RBA_Common_CentralElements_CompuMethods_Identical 1 100 0.0 255. FORMAT "%5.0" ECU_ADDRESS 0x500063F7 /end MEASUREMENT
/begin MEASUREMENT ComM_ChannelStruct[2].CommunicationAllowed_b "ComM Channel structure[2]/" UBYTE RB_RBA_Common_CentralElements_CompuMethods_Identical 1 100 0.0 255. FORMAT "%5.0" ECU_ADDRESS 0x5000640F /end MEASUREMENT
/begin MEASUREMENT ComM_ChannelStruct[3].CommunicationAllowed_b "ComM Channel structure[3]/" UBYTE RB_RBA_Common_CentralElements_CompuMethods_Identical 1 100 0.0 255. FORMAT "%5.0" ECU_ADDRESS 0x50006427 /end MEASUREMENT
/begin MEASUREMENT ComM_ChannelStruct[0].NmBusSleepIndicationStatus_b "ComM Channel structure[0]/" UBYTE RB_RBA_Common_CentralElements_CompuMethods_Identical 1 100 0.0 255. FORMAT "%5.0" ECU_ADDRESS 0x500063E0 /end MEASUREMENT
/begin MEASUREMENT ComM_ChannelStruct[1].NmBusSleepIndicationStatus_b "ComM Channel structure[1]/" UBYTE RB_RBA_Common_CentralElements_CompuMethods_Identical 1 100 0.0 255. FORMAT "%5.0" ECU_ADDRESS 0x500063F8 /end MEASUREMENT
/begin MEASUREMENT ComM_ChannelStruct[2].NmBusSleepIndicationStatus_b "ComM Channel structure[2]/" UBYTE RB_RBA_Common_CentralElements_CompuMethods_Identical 1 100 0.0 255. FORMAT "%5.0" ECU_ADDRESS 0x50006410 /end MEASUREMENT
/begin MEASUREMENT ComM_ChannelStruct[3].NmBusSleepIndicationStatus_b "ComM Channel structure[3]/" UBYTE RB_RBA_Common_CentralElements_CompuMethods_Identical 1 100 0.0 255. FORMAT "%5.0" ECU_ADDRESS 0x50006428 /end MEASUREMENT
/begin MEASUREMENT ComM_ChannelStruct[0].NmPrepareBusSleepIndicationStatus_b "ComM Channel structure[0]/" UBYTE RB_RBA_Common_CentralElements_CompuMethods_Identical 1 100 0.0 255. FORMAT "%5.0" ECU_ADDRESS 0x500063E1 /end MEASUREMENT
/begin MEASUREMENT ComM_ChannelStruct[1].NmPrepareBusSleepIndicationStatus_b "ComM Channel structure[1]/" UBYTE RB_RBA_Common_CentralElements_CompuMethods_Identical 1 100 0.0 255. FORMAT "%5.0" ECU_ADDRESS 0x500063F9 /end MEASUREMENT
/begin MEASUREMENT ComM_ChannelStruct[2].NmPrepareBusSleepIndicationStatus_b "ComM Channel structure[2]/" UBYTE RB_RBA_Common_CentralElements_CompuMethods_Identical 1 100 0.0 255. FORMAT "%5.0" ECU_ADDRESS 0x50006411 /end MEASUREMENT
/begin MEASUREMENT ComM_ChannelStruct[3].NmPrepareBusSleepIndicationStatus_b "ComM Channel structure[3]/" UBYTE RB_RBA_Common_CentralElements_CompuMethods_Identical 1 100 0.0 255. FORMAT "%5.0" ECU_ADDRESS 0x50006429 /end MEASUREMENT
/begin MEASUREMENT ComM_ChannelStruct[0].NmNetworkModeStatus_b "ComM Channel structure[0]/" UBYTE RB_RBA_Common_CentralElements_CompuMethods_Identical 1 100 0.0 255. FORMAT "%5.0" ECU_ADDRESS 0x500063E2 /end MEASUREMENT
/begin MEASUREMENT ComM_ChannelStruct[1].NmNetworkModeStatus_b "ComM Channel structure[1]/" UBYTE RB_RBA_Common_CentralElements_CompuMethods_Identical 1 100 0.0 255. FORMAT "%5.0" ECU_ADDRESS 0x500063FA /end MEASUREMENT
/begin MEASUREMENT ComM_ChannelStruct[2].NmNetworkModeStatus_b "ComM Channel structure[2]/" UBYTE RB_RBA_Common_CentralElements_CompuMethods_Identical 1 100 0.0 255. FORMAT "%5.0" ECU_ADDRESS 0x50006412 /end MEASUREMENT
/begin MEASUREMENT ComM_ChannelStruct[3].NmNetworkModeStatus_b "ComM Channel structure[3]/" UBYTE RB_RBA_Common_CentralElements_CompuMethods_Identical 1 100 0.0 255. FORMAT "%5.0" ECU_ADDRESS 0x5000642A /end MEASUREMENT
/begin MEASUREMENT ComM_UserStruct[0].WakeUpInhibitionCtr_u16 "ComM user structure[0]/" UWORD RB_RBA_Common_CentralElements_CompuMethods_Identical 1 100 0.0 65535. FORMAT "%5.0" ECU_ADDRESS 0x50006430 /end MEASUREMENT
/begin MEASUREMENT ComM_UserStruct[1].WakeUpInhibitionCtr_u16 "ComM user structure[1]/" UWORD RB_RBA_Common_CentralElements_CompuMethods_Identical 1 100 0.0 65535. FORMAT "%5.0" ECU_ADDRESS 0x5000643A /end MEASUREMENT
/begin MEASUREMENT ComM_UserStruct[2].WakeUpInhibitionCtr_u16 "ComM user structure[2]/" UWORD RB_RBA_Common_CentralElements_CompuMethods_Identical 1 100 0.0 65535. FORMAT "%5.0" ECU_ADDRESS 0x50006444 /end MEASUREMENT
/begin MEASUREMENT ComM_UserStruct[3].WakeUpInhibitionCtr_u16 "ComM user structure[3]/" UWORD RB_RBA_Common_CentralElements_CompuMethods_Identical 1 100 0.0 65535. FORMAT "%5.0" ECU_ADDRESS 0x5000644E /end MEASUREMENT
/begin MEASUREMENT ComM_UserStruct[4].WakeUpInhibitionCtr_u16 "ComM user structure[4]/" UWORD RB_RBA_Common_CentralElements_CompuMethods_Identical 1 100 0.0 65535. FORMAT "%5.0" ECU_ADDRESS 0x50006458 /end MEASUREMENT
/begin MEASUREMENT ComM_UserStruct[0].LimitToNoComCtr_u16 "ComM user structure[0]/" UWORD RB_RBA_Common_CentralElements_CompuMethods_Identical 1 100 0.0 65535. FORMAT "%5.0" ECU_ADDRESS 0x50006432 /end MEASUREMENT
/begin MEASUREMENT ComM_UserStruct[1].LimitToNoComCtr_u16 "ComM user structure[1]/" UWORD RB_RBA_Common_CentralElements_CompuMethods_Identical 1 100 0.0 65535. FORMAT "%5.0" ECU_ADDRESS 0x5000643C /end MEASUREMENT
/begin MEASUREMENT ComM_UserStruct[2].LimitToNoComCtr_u16 "ComM user structure[2]/" UWORD RB_RBA_Common_CentralElements_CompuMethods_Identical 1 100 0.0 65535. FORMAT "%5.0" ECU_ADDRESS 0x50006446 /end MEASUREMENT
/begin MEASUREMENT ComM_UserStruct[3].LimitToNoComCtr_u16 "ComM user structure[3]/" UWORD RB_RBA_Common_CentralElements_CompuMethods_Identical 1 100 0.0 65535. FORMAT "%5.0" ECU_ADDRESS 0x50006450 /end MEASUREMENT
/begin MEASUREMENT ComM_UserStruct[4].LimitToNoComCtr_u16 "ComM user structure[4]/" UWORD RB_RBA_Common_CentralElements_CompuMethods_Identical 1 100 0.0 65535. FORMAT "%5.0" ECU_ADDRESS 0x5000645A /end MEASUREMENT
/begin MEASUREMENT ComM_UserStruct[0].RequestedUserMode_u8 "ComM user structure[0]/" UBYTE RB_RBA_Common_CentralElements_CompuMethods_Identical 1 100 0.0 255. FORMAT "%5.0" ECU_ADDRESS 0x50006434 /end MEASUREMENT
/begin MEASUREMENT ComM_UserStruct[1].RequestedUserMode_u8 "ComM user structure[1]/" UBYTE RB_RBA_Common_CentralElements_CompuMethods_Identical 1 100 0.0 255. FORMAT "%5.0" ECU_ADDRESS 0x5000643E /end MEASUREMENT
/begin MEASUREMENT ComM_UserStruct[2].RequestedUserMode_u8 "ComM user structure[2]/" UBYTE RB_RBA_Common_CentralElements_CompuMethods_Identical 1 100 0.0 255. FORMAT "%5.0" ECU_ADDRESS 0x50006448 /end MEASUREMENT
/begin MEASUREMENT ComM_UserStruct[3].RequestedUserMode_u8 "ComM user structure[3]/" UBYTE RB_RBA_Common_CentralElements_CompuMethods_Identical 1 100 0.0 255. FORMAT "%5.0" ECU_ADDRESS 0x50006452 /end MEASUREMENT
/begin MEASUREMENT ComM_UserStruct[4].RequestedUserMode_u8 "ComM user structure[4]/" UBYTE RB_RBA_Common_CentralElements_CompuMethods_Identical 1 100 0.0 255. FORMAT "%5.0" ECU_ADDRESS 0x5000645C /end MEASUREMENT
/begin MEASUREMENT ComM_UserStruct[0].IndicatedUserMode_u8 "ComM user structure[0]/" UBYTE RB_RBA_Common_CentralElements_CompuMethods_Identical 1 100 0.0 255. FORMAT "%5.0" ECU_ADDRESS 0x50006435 /end MEASUREMENT
/begin MEASUREMENT ComM_UserStruct[1].IndicatedUserMode_u8 "ComM user structure[1]/" UBYTE RB_RBA_Common_CentralElements_CompuMethods_Identical 1 100 0.0 255. FORMAT "%5.0" ECU_ADDRESS 0x5000643F /end MEASUREMENT
/begin MEASUREMENT ComM_UserStruct[2].IndicatedUserMode_u8 "ComM user structure[2]/" UBYTE RB_RBA_Common_CentralElements_CompuMethods_Identical 1 100 0.0 255. FORMAT "%5.0" ECU_ADDRESS 0x50006449 /end MEASUREMENT
/begin MEASUREMENT ComM_UserStruct[3].IndicatedUserMode_u8 "ComM user structure[3]/" UBYTE RB_RBA_Common_CentralElements_CompuMethods_Identical 1 100 0.0 255. FORMAT "%5.0" ECU_ADDRESS 0x50006453 /end MEASUREMENT
/begin MEASUREMENT ComM_UserStruct[4].IndicatedUserMode_u8 "ComM user structure[4]/" UBYTE RB_RBA_Common_CentralElements_CompuMethods_Identical 1 100 0.0 255. FORMAT "%5.0" ECU_ADDRESS 0x5000645D /end MEASUREMENT
/begin MEASUREMENT ComM_UserStruct[0].numChannelsInFullCom_u8 "ComM user structure[0]/" UBYTE RB_RBA_Common_CentralElements_CompuMethods_Identical 1 100 0.0 255. FORMAT "%5.0" ECU_ADDRESS 0x50006436 /end MEASUREMENT
/begin MEASUREMENT ComM_UserStruct[1].numChannelsInFullCom_u8 "ComM user structure[1]/" UBYTE RB_RBA_Common_CentralElements_CompuMethods_Identical 1 100 0.0 255. FORMAT "%5.0" ECU_ADDRESS 0x50006440 /end MEASUREMENT
/begin MEASUREMENT ComM_UserStruct[2].numChannelsInFullCom_u8 "ComM user structure[2]/" UBYTE RB_RBA_Common_CentralElements_CompuMethods_Identical 1 100 0.0 255. FORMAT "%5.0" ECU_ADDRESS 0x5000644A /end MEASUREMENT
/begin MEASUREMENT ComM_UserStruct[3].numChannelsInFullCom_u8 "ComM user structure[3]/" UBYTE RB_RBA_Common_CentralElements_CompuMethods_Identical 1 100 0.0 255. FORMAT "%5.0" ECU_ADDRESS 0x50006454 /end MEASUREMENT
/begin MEASUREMENT ComM_UserStruct[4].numChannelsInFullCom_u8 "ComM user structure[4]/" UBYTE RB_RBA_Common_CentralElements_CompuMethods_Identical 1 100 0.0 255. FORMAT "%5.0" ECU_ADDRESS 0x5000645E /end MEASUREMENT
/begin MEASUREMENT ComM_UserStruct[0].numChannelsInSilentCom_u8 "ComM user structure[0]/" UBYTE RB_RBA_Common_CentralElements_CompuMethods_Identical 1 100 0.0 255. FORMAT "%5.0" ECU_ADDRESS 0x50006437 /end MEASUREMENT
/begin MEASUREMENT ComM_UserStruct[1].numChannelsInSilentCom_u8 "ComM user structure[1]/" UBYTE RB_RBA_Common_CentralElements_CompuMethods_Identical 1 100 0.0 255. FORMAT "%5.0" ECU_ADDRESS 0x50006441 /end MEASUREMENT
/begin MEASUREMENT ComM_UserStruct[2].numChannelsInSilentCom_u8 "ComM user structure[2]/" UBYTE RB_RBA_Common_CentralElements_CompuMethods_Identical 1 100 0.0 255. FORMAT "%5.0" ECU_ADDRESS 0x5000644B /end MEASUREMENT
/begin MEASUREMENT ComM_UserStruct[3].numChannelsInSilentCom_u8 "ComM user structure[3]/" UBYTE RB_RBA_Common_CentralElements_CompuMethods_Identical 1 100 0.0 255. FORMAT "%5.0" ECU_ADDRESS 0x50006455 /end MEASUREMENT
/begin MEASUREMENT ComM_UserStruct[4].numChannelsInSilentCom_u8 "ComM user structure[4]/" UBYTE RB_RBA_Common_CentralElements_CompuMethods_Identical 1 100 0.0 255. FORMAT "%5.0" ECU_ADDRESS 0x5000645F /end MEASUREMENT
/begin MEASUREMENT ComM_UserStruct[0].numChannelsInNoCom_u8 "ComM user structure[0]/" UBYTE RB_RBA_Common_CentralElements_CompuMethods_Identical 1 100 0.0 255. FORMAT "%5.0" ECU_ADDRESS 0x50006438 /end MEASUREMENT
/begin MEASUREMENT ComM_UserStruct[1].numChannelsInNoCom_u8 "ComM user structure[1]/" UBYTE RB_RBA_Common_CentralElements_CompuMethods_Identical 1 100 0.0 255. FORMAT "%5.0" ECU_ADDRESS 0x50006442 /end MEASUREMENT
/begin MEASUREMENT ComM_UserStruct[2].numChannelsInNoCom_u8 "ComM user structure[2]/" UBYTE RB_RBA_Common_CentralElements_CompuMethods_Identical 1 100 0.0 255. FORMAT "%5.0" ECU_ADDRESS 0x5000644C /end MEASUREMENT
/begin MEASUREMENT ComM_UserStruct[3].numChannelsInNoCom_u8 "ComM user structure[3]/" UBYTE RB_RBA_Common_CentralElements_CompuMethods_Identical 1 100 0.0 255. FORMAT "%5.0" ECU_ADDRESS 0x50006456 /end MEASUREMENT
/begin MEASUREMENT ComM_UserStruct[4].numChannelsInNoCom_u8 "ComM user structure[4]/" UBYTE RB_RBA_Common_CentralElements_CompuMethods_Identical 1 100 0.0 255. FORMAT "%5.0" ECU_ADDRESS 0x50006460 /end MEASUREMENT
/begin MEASUREMENT Fee_SecChngCnt_u32 "Current Sector Change Counter of the Flash EEPROM Emulation" ULONG RB_RBA_rba_MemLib_CompuMethods_Mem_Identical 1 100 0.0 1.7E7 FORMAT "%5.1" ECU_ADDRESS 0x60003B00 /end MEASUREMENT
/begin MEASUREMENT Lin_ChnlVar_MP[0].Status "Lin Channel context information which provides the status of individual frames[0]/" UBYTE AUTOSAR_Lin_CompuMethods_Lin_Enum_Status_type 1 100 0.0 10. FORMAT "%5.0" ECU_ADDRESS 0x60014192 /end MEASUREMENT
/begin MEASUREMENT Lin_ChnlVar_MP[0].Length "Lin Channel context information which provides the status of individual frames[0]/" UBYTE RB_RBA_Common_CentralElements_CompuMethods_Identical 1 100 0.0 255. FORMAT "%5.0" ECU_ADDRESS 0x60014193 /end MEASUREMENT
/begin MEASUREMENT Lin_ChnlVar_MP[0].CSmodel "Lin Channel context information which provides the status of individual frames[0]/" UBYTE AUTOSAR_Lin_CompuMethods_Lin_Enum_CheckSum_Type 1 100 0.0 1. FORMAT "%5.0" ECU_ADDRESS 0x60014194 /end MEASUREMENT
/begin MEASUREMENT Lin_ChnlVar_MP[0].GotoSleepCtr "Lin Channel context information which provides the status of individual frames[0]/" UBYTE AUTOSAR_Lin_CompuMethods_Lin_Enum_FrameRespType 1 100 0.0 3. FORMAT "%5.0" ECU_ADDRESS 0x60014197 /end MEASUREMENT
/begin MEASUREMENT Lin_ChnlVar_MP[0].FrameType "Lin Channel context information which provides the status of individual frames[0]/" UBYTE RB_RBA_Common_CentralElements_CompuMethods_Identical 1 100 0.0 255. FORMAT "%5.0" ECU_ADDRESS 0x60014195 /end MEASUREMENT
/begin MEASUREMENT Lin_ChnlVar_MP[0].FramePid "Lin Channel context information which provides the status of individual frames[0]/" UBYTE AUTOSAR_Lin_CompuMethods_Lin_Enum_ChannelStateType 1 100 0.0 7. FORMAT "%5.0" ECU_ADDRESS 0x60014198 /end MEASUREMENT
/begin MEASUREMENT Lin_ChnlVar_MP[0].ChannelState "Lin Channel context information which provides the status of individual frames[0]/" UBYTE RB_RBA_Common_CentralElements_CompuMethods_Identical 1 100 0.0 255. FORMAT "%5.0" ECU_ADDRESS 0x60014196 /end MEASUREMENT
/begin MEASUREMENT Lin_ChnlVar_MP[0].Lin_Buf_au8 "Lin Channel context information which provides the status of individual frames[0]/" UBYTE RB_RBA_Common_CentralElements_CompuMethods_Identical 1 100 0.0 255. FORMAT "%5.0" ARRAY_SIZE 8 ECU_ADDRESS 0x60014199 /end MEASUREMENT
/begin MEASUREMENT Lin_DrvFlags_MP "Lin driver state i.e TRUE (Iinitilased) FALSE (Uninitialised)" UBYTE RB_RBA_Common_CentralElements_CompuMethods_Identical 1 100 0.0 1. FORMAT "%5.0" ECU_ADDRESS 0x60000B66 /end MEASUREMENT
/begin MEASUREMENT LinIf_ChnlVar_as[0].ChannelStateFlag_u8 "Lin Interface channel status structure[0]/" UBYTE RB_RBA_Common_CentralElements_CompuMethods_Identical 1 100 0.0 255. FORMAT "%5.0" ECU_ADDRESS 0x500065A8 /end MEASUREMENT
/begin MEASUREMENT LinIf_ChnlVar_as[0].ChannelStatusFlags_u8 "Lin Interface channel status structure[0]/" UBYTE RB_RBA_Common_CentralElements_CompuMethods_Identical 1 100 0.0 255. FORMAT "%5.0" ECU_ADDRESS 0x500065A9 /end MEASUREMENT
/begin MEASUREMENT LinIf_ChnlVar_as[0].DelayCount_u8 "Lin Interface channel status structure[0]/" UBYTE RB_RBA_Common_CentralElements_CompuMethods_Identical 1 100 0.0 255. FORMAT "%5.0" ECU_ADDRESS 0x500065AA /end MEASUREMENT
/begin MEASUREMENT LinIf_ChnlVar_as[0].CurrentScheduleTable_u8 "Lin Interface channel status structure[0]/" UBYTE RB_RBA_Common_CentralElements_CompuMethods_Identical 1 100 0.0 255. FORMAT "%5.0" ECU_ADDRESS 0x500065AB /end MEASUREMENT
/begin MEASUREMENT LinIf_ChnlVar_as[0].CurrentIndex_u8 "Lin Interface channel status structure[0]/" UBYTE RB_RBA_Common_CentralElements_CompuMethods_Identical 1 100 0.0 255. FORMAT "%5.0" ECU_ADDRESS 0x500065AD /end MEASUREMENT
/begin MEASUREMENT LinIf_ChnlVar_as[0].SavedScheduleTable_u8 "Lin Interface channel status structure[0]/" UBYTE RB_RBA_Common_CentralElements_CompuMethods_Identical 1 100 0.0 255. FORMAT "%5.0" ECU_ADDRESS 0x500065AE /end MEASUREMENT
/begin MEASUREMENT LinIf_ChnlVar_as[0].SavedIndex_u8 "Lin Interface channel status structure[0]/" UBYTE RB_RBA_Common_CentralElements_CompuMethods_Identical 1 100 0.0 255. FORMAT "%5.0" ECU_ADDRESS 0x500065AF /end MEASUREMENT
/begin MEASUREMENT LinIf_ChnlVar_as[0].Temp_SpoFrmCount_u8 "Lin Interface channel status structure[0]/" UBYTE RB_RBA_Common_CentralElements_CompuMethods_Identical 1 100 0.0 255. FORMAT "%5.0" ECU_ADDRESS 0x500065B0 /end MEASUREMENT
/begin MEASUREMENT LinIf_ChnlVar_as[0].SpoETIndex_u8 "Lin Interface channel status structure[0]/" UBYTE RB_RBA_Common_CentralElements_CompuMethods_Identical 1 100 0.0 255. FORMAT "%5.0" ECU_ADDRESS 0x500065B1 /end MEASUREMENT
/begin MEASUREMENT LinIf_ChnlVar_as[0].Wakeup_u8 "Lin Interface channel status structure[0]/" UBYTE RB_RBA_Common_CentralElements_CompuMethods_Identical 1 100 0.0 255. FORMAT "%5.0" ECU_ADDRESS 0x500065B4 /end MEASUREMENT
/begin MEASUREMENT LinIf_ChnlVar_as[0].TransmitSRF_u8 "Lin Interface channel status structure[0]/" UBYTE RB_RBA_Common_CentralElements_CompuMethods_Identical 1 100 0.0 255. FORMAT "%5.0" ECU_ADDRESS 0x500065B7 /end MEASUREMENT
/begin MEASUREMENT LinIf_ChnlVar_as[0].SlpGetStatus_u8 "Lin Interface channel status structure[0]/" UBYTE RB_RBA_Common_CentralElements_CompuMethods_Identical 1 100 0.0 255. FORMAT "%5.0" ECU_ADDRESS 0x500065B8 /end MEASUREMENT
/begin MEASUREMENT LinIf_ChnlVar_as[0].NewScheduleTable_u8 "Lin Interface channel status structure[0]/" UBYTE RB_RBA_Common_CentralElements_CompuMethods_Identical 1 100 0.0 255. FORMAT "%5.0" ECU_ADDRESS 0x500065AC /end MEASUREMENT
/begin MEASUREMENT LinIf_ChnlVar_as[0].GotoSleepCtr "Lin Interface channel status structure[0]/" UBYTE RB_RBA_Common_CentralElements_CompuMethods_Identical 1 100 0.0 255. FORMAT "%5.0" ECU_ADDRESS 0x500065B3 /end MEASUREMENT
/begin MEASUREMENT LinIf_Status_u8 "Lin Interface status variable" UBYTE RB_RBA_Common_CentralElements_CompuMethods_Identical 1 100 0.0 255. FORMAT "%5.0" ECU_ADDRESS 0x600123DF /end MEASUREMENT
/begin MEASUREMENT LinSM_ModeRepeatReq_Max_u8 "Maximum Tries for Same Mode Request Possible in LinSM" UBYTE RB_RBA_Common_CentralElements_CompuMethods_Identical 1 100 0.0 255. FORMAT "%5.0" ECU_ADDRESS 0x6001045D /end MEASUREMENT
/begin MEASUREMENT LinSM_RamVar_ast[0].ChnlState "LinSM type variable[0]/" UBYTE AUTOSAR_LinSM_CompuMethods_LinSM_CompuMethod_OperationalMode 1 100 0.0 255. FORMAT "%5.0" ECU_ADDRESS 0x500065CC /end MEASUREMENT
/begin MEASUREMENT LinSM_RamVar_ast[0].TimeOutCounter "LinSM type variable[0]/" ULONG RB_RBA_Common_CentralElements_CompuMethods_Identical 1 100 0.0 4.E9 FORMAT "%5.0" ECU_ADDRESS 0x500065D0 /end MEASUREMENT
/begin MEASUREMENT LinSM_RamVar_ast[0].TimeoutFlag "LinSM type variable[0]/" UBYTE RB_RBA_Common_CentralElements_CompuMethods_Identical 1 100 0.0 255. FORMAT "%5.0" ECU_ADDRESS 0x500065D4 /end MEASUREMENT
/begin MEASUREMENT LinSM_RamVar_ast[0].StoredSchdTab "LinSM type variable[0]/" UBYTE RB_RBA_Common_CentralElements_CompuMethods_Identical 1 100 0.0 255. FORMAT "%5.0" ECU_ADDRESS 0x500065D5 /end MEASUREMENT
/begin MEASUREMENT LinSM_RamVar_ast[0].LinSm_SchdReq_E_NOT_OK "LinSM type variable[0]/" UBYTE RB_RBA_Common_CentralElements_CompuMethods_Identical 1 100 0.0 255. FORMAT "%5.0" ECU_ADDRESS 0x500065D6 /end MEASUREMENT
/begin MEASUREMENT LinSM_RamVar_ast[0].LinSm_Conf_Status "LinSM type variable[0]/" UBYTE RB_RBA_Common_CentralElements_CompuMethods_Identical 1 100 0.0 255. FORMAT "%5.0" ECU_ADDRESS 0x500065D7 /end MEASUREMENT
/begin MEASUREMENT LinSM_RamVar_ast[0].LinSm_Request_Status "LinSM type variable[0]/" UBYTE RB_RBA_Common_CentralElements_CompuMethods_Identical 1 100 0.0 255. FORMAT "%5.0" ECU_ADDRESS 0x500065D8 /end MEASUREMENT
/begin MEASUREMENT LinSM_RamVar_ast[0].LinSm_Sleep_Status "LinSM type variable[0]/" UBYTE RB_RBA_Common_CentralElements_CompuMethods_Identical 1 100 0.0 255. FORMAT "%5.0" ECU_ADDRESS 0x500065D9 /end MEASUREMENT
/begin MEASUREMENT LinSM_RamVar_ast[0].LinSmModReqRepMax "LinSM type variable[0]/" UBYTE RB_RBA_Common_CentralElements_CompuMethods_Identical 1 100 0.0 255. FORMAT "%5.0" ECU_ADDRESS 0x500065DA /end MEASUREMENT
/begin MEASUREMENT LinSM_State_en "State variable of LINSM" UBYTE RB_RBA_Common_CentralElements_CompuMethods_Identical 1 100 0.0 255. FORMAT "%5.0" ECU_ADDRESS 0x600123E8 /end MEASUREMENT
/begin MEASUREMENT PduR_State "State information of Pdur module" UBYTE RB_RBA_Common_CentralElements_CompuMethods_Identical 1 100 0.0 255. FORMAT "%5.0" ECU_ADDRESS 0x70005538 /end MEASUREMENT
/begin MEASUREMENT ComScl_Bdy_RawSignal_PCU_ALIVE_COUNTER_45B_u8 "NetworkSignal ComScl_Bdy_RawSignal_PCU_ALIVE_COUNTER_45B_u8" UBYTE RB_RBA_Common_CentralElements_CompuMethods_Identical 1 100 0.0 255. FORMAT "%10.0" ECU_ADDRESS 0x60010B9C /end MEASUREMENT
/begin MEASUREMENT ComScl_Bdy_RawSignal_PCU_CHECKSUM_45B_u8 "NetworkSignal ComScl_Bdy_RawSignal_PCU_CHECKSUM_45B_u8" UBYTE RB_RBA_Common_CentralElements_CompuMethods_Identical 1 100 0.0 255. FORMAT "%10.0" ECU_ADDRESS 0x60010B9B /end MEASUREMENT
/begin MEASUREMENT ComScl_Bdy_RawSignal_PCU_REM_ENG_START_b "NetworkSignal ComScl_Bdy_RawSignal_PCU_REM_ENG_START_b" UBYTE RB_RBA_Common_CentralElements_CompuMethods_Identical 1 100 0.0 255. FORMAT "%10.0" ECU_ADDRESS 0x60010B9A /end MEASUREMENT
/begin MEASUREMENT ComScl_Bdy_RawSignal_SRS_ALIVE_COUNTER_039_u8 "NetworkSignal ComScl_Bdy_RawSignal_SRS_ALIVE_COUNTER_039_u8" UBYTE RB_RBA_Common_CentralElements_CompuMethods_Identical 1 100 0.0 255. FORMAT "%10.0" ECU_ADDRESS 0x60010B89 /end MEASUREMENT
/begin MEASUREMENT ComScl_Bdy_RawSignal_SRS_ALIVE_COUNTER_094_u8 "NetworkSignal ComScl_Bdy_RawSignal_SRS_ALIVE_COUNTER_094_u8" UBYTE RB_RBA_Common_CentralElements_CompuMethods_Identical 1 100 0.0 255. FORMAT "%10.0" ECU_ADDRESS 0x60010B96 /end MEASUREMENT
/begin MEASUREMENT ComScl_Bdy_RawSignal_SRS_ALIVE_COUNTER_305_u8 "NetworkSignal ComScl_Bdy_RawSignal_SRS_ALIVE_COUNTER_305_u8" UBYTE RB_RBA_Common_CentralElements_CompuMethods_Identical 1 100 0.0 255. FORMAT "%10.0" ECU_ADDRESS 0x60010B99 /end MEASUREMENT
/begin MEASUREMENT ComScl_Bdy_RawSignal_SRS_CAL_LAT_G_b "NetworkSignal ComScl_Bdy_RawSignal_SRS_CAL_LAT_G_b" UBYTE RB_RBA_Common_CentralElements_CompuMethods_Identical 1 100 0.0 255. FORMAT "%10.0" ECU_ADDRESS 0x60010B95 /end MEASUREMENT
/begin MEASUREMENT ComScl_Bdy_RawSignal_SRS_CAL_LON_G_b "NetworkSignal ComScl_Bdy_RawSignal_SRS_CAL_LON_G_b" UBYTE RB_RBA_Common_CentralElements_CompuMethods_Identical 1 100 0.0 255. FORMAT "%10.0" ECU_ADDRESS 0x60010B94 /end MEASUREMENT
/begin MEASUREMENT ComScl_Bdy_RawSignal_SRS_CHECKSUM_039_u8 "NetworkSignal ComScl_Bdy_RawSignal_SRS_CHECKSUM_039_u8" UBYTE RB_RBA_Common_CentralElements_CompuMethods_Identical 1 100 0.0 255. FORMAT "%10.0" ECU_ADDRESS 0x60010B88 /end MEASUREMENT
/begin MEASUREMENT ComScl_Bdy_RawSignal_SRS_CHECKSUM_094_u8 "NetworkSignal ComScl_Bdy_RawSignal_SRS_CHECKSUM_094_u8" UBYTE RB_RBA_Common_CentralElements_CompuMethods_Identical 1 100 0.0 255. FORMAT "%10.0" ECU_ADDRESS 0x60010B93 /end MEASUREMENT
/begin MEASUREMENT ComScl_Bdy_RawSignal_SRS_CHECKSUM_305_u8 "NetworkSignal ComScl_Bdy_RawSignal_SRS_CHECKSUM_305_u8" UBYTE RB_RBA_Common_CentralElements_CompuMethods_Identical 1 100 0.0 255. FORMAT "%10.0" ECU_ADDRESS 0x60010B98 /end MEASUREMENT
/begin MEASUREMENT ComScl_Bdy_RawSignal_SRS_DR_BELT_STATUS_u8 "NetworkSignal ComScl_Bdy_RawSignal_SRS_DR_BELT_STATUS_u8" UBYTE RB_RBA_Common_CentralElements_CompuMethods_Identical 1 100 0.0 255. FORMAT "%10.0" ECU_ADDRESS 0x60010B97 /end MEASUREMENT
/begin MEASUREMENT ComScl_Bdy_RawSignal_SRS_HI_CDS_b "NetworkSignal ComScl_Bdy_RawSignal_SRS_HI_CDS_b" UBYTE RB_RBA_Common_CentralElements_CompuMethods_Identical 1 100 0.0 255. FORMAT "%10.0" ECU_ADDRESS 0x60010B87 /end MEASUREMENT
/begin MEASUREMENT ComScl_Bdy_RawSignal_SRS_LAT_G_u16 "NetworkSignal ComScl_Bdy_RawSignal_SRS_LAT_G_u16" UWORD RB_RBA_Common_CentralElements_CompuMethods_Identical 1 100 0.0 65535. FORMAT "%10.0" ECU_ADDRESS 0x6000A0B6 /end MEASUREMENT
/begin MEASUREMENT ComScl_Bdy_RawSignal_SRS_LON_G_u16 "NetworkSignal ComScl_Bdy_RawSignal_SRS_LON_G_u16" UWORD RB_RBA_Common_CentralElements_CompuMethods_Identical 1 100 0.0 65535. FORMAT "%10.0" ECU_ADDRESS 0x6000A0B4 /end MEASUREMENT
/begin MEASUREMENT ComScl_Bdy_RawSignal_SRS_P_ERR_LAT_G_b "NetworkSignal ComScl_Bdy_RawSignal_SRS_P_ERR_LAT_G_b" UBYTE RB_RBA_Common_CentralElements_CompuMethods_Identical 1 100 0.0 255. FORMAT "%10.0" ECU_ADDRESS 0x60010B92 /end MEASUREMENT
/begin MEASUREMENT ComScl_Bdy_RawSignal_SRS_P_ERR_LON_G_b "NetworkSignal ComScl_Bdy_RawSignal_SRS_P_ERR_LON_G_b" UBYTE RB_RBA_Common_CentralElements_CompuMethods_Identical 1 100 0.0 255. FORMAT "%10.0" ECU_ADDRESS 0x60010B91 /end MEASUREMENT
/begin MEASUREMENT ComScl_Bdy_RawSignal_SRS_P_ERR_YAW1_b "NetworkSignal ComScl_Bdy_RawSignal_SRS_P_ERR_YAW1_b" UBYTE RB_RBA_Common_CentralElements_CompuMethods_Identical 1 100 0.0 255. FORMAT "%10.0" ECU_ADDRESS 0x60010B90 /end MEASUREMENT
/begin MEASUREMENT ComScl_Bdy_RawSignal_SRS_SENSOR_ERR_MC_b "NetworkSignal ComScl_Bdy_RawSignal_SRS_SENSOR_ERR_MC_b" UBYTE RB_RBA_Common_CentralElements_CompuMethods_Identical 1 100 0.0 255. FORMAT "%10.0" ECU_ADDRESS 0x60010B8F /end MEASUREMENT
/begin MEASUREMENT ComScl_Bdy_RawSignal_SRS_SENSOR_START_UP_b "NetworkSignal ComScl_Bdy_RawSignal_SRS_SENSOR_START_UP_b" UBYTE RB_RBA_Common_CentralElements_CompuMethods_Identical 1 100 0.0 255. FORMAT "%10.0" ECU_ADDRESS 0x60010B8E /end MEASUREMENT
/begin MEASUREMENT ComScl_Bdy_RawSignal_SRS_SENSOR_STATE_IG_b "NetworkSignal ComScl_Bdy_RawSignal_SRS_SENSOR_STATE_IG_b" UBYTE RB_RBA_Common_CentralElements_CompuMethods_Identical 1 100 0.0 255. FORMAT "%10.0" ECU_ADDRESS 0x60010B8D /end MEASUREMENT
/begin MEASUREMENT ComScl_Bdy_RawSignal_SRS_T_ERR_LAT_G_b "NetworkSignal ComScl_Bdy_RawSignal_SRS_T_ERR_LAT_G_b" UBYTE RB_RBA_Common_CentralElements_CompuMethods_Identical 1 100 0.0 255. FORMAT "%10.0" ECU_ADDRESS 0x60010B8C /end MEASUREMENT
/begin MEASUREMENT ComScl_Bdy_RawSignal_SRS_T_ERR_LON_G_b "NetworkSignal ComScl_Bdy_RawSignal_SRS_T_ERR_LON_G_b" UBYTE RB_RBA_Common_CentralElements_CompuMethods_Identical 1 100 0.0 255. FORMAT "%10.0" ECU_ADDRESS 0x60010B8B /end MEASUREMENT
/begin MEASUREMENT ComScl_Bdy_RawSignal_SRS_T_ERR_YAW1_b "NetworkSignal ComScl_Bdy_RawSignal_SRS_T_ERR_YAW1_b" UBYTE RB_RBA_Common_CentralElements_CompuMethods_Identical 1 100 0.0 255. FORMAT "%10.0" ECU_ADDRESS 0x60010B8A /end MEASUREMENT
/begin MEASUREMENT ComScl_Bdy_RawSignal_SRS_YAW_1_u16 "NetworkSignal ComScl_Bdy_RawSignal_SRS_YAW_1_u16" UWORD RB_RBA_Common_CentralElements_CompuMethods_Identical 1 100 0.0 65535. FORMAT "%10.0" ECU_ADDRESS 0x6000A0B2 /end MEASUREMENT
/begin MEASUREMENT ComScl_Dspl_RawSignal_METER_AC_ACGUP_REQ_b "NetworkSignal ComScl_Dspl_RawSignal_METER_AC_ACGUP_REQ_b" UBYTE RB_RBA_Common_CentralElements_CompuMethods_Identical 1 100 0.0 255. FORMAT "%10.0" ECU_ADDRESS 0x60011126 /end MEASUREMENT
/begin MEASUREMENT ComScl_Dspl_RawSignal_METER_AC_FR_BLW_VF_u8 "NetworkSignal ComScl_Dspl_RawSignal_METER_AC_FR_BLW_VF_u8" UBYTE RB_RBA_Common_CentralElements_CompuMethods_Identical 1 100 0.0 255. FORMAT "%10.0" ECU_ADDRESS 0x60011121 /end MEASUREMENT
/begin MEASUREMENT ComScl_Dspl_RawSignal_METER_AC_HACCUT_NG_2_u8 "NetworkSignal ComScl_Dspl_RawSignal_METER_AC_HACCUT_NG_2_u8" UBYTE RB_RBA_Common_CentralElements_CompuMethods_Identical 1 100 0.0 255. FORMAT "%10.0" ECU_ADDRESS 0x60011131 /end MEASUREMENT
/begin MEASUREMENT ComScl_Dspl_RawSignal_METER_AC_HACCUT_NG_u8 "NetworkSignal ComScl_Dspl_RawSignal_METER_AC_HACCUT_NG_u8" UBYTE RB_RBA_Common_CentralElements_CompuMethods_Identical 1 100 0.0 255. FORMAT "%10.0" ECU_ADDRESS 0x60011137 /end MEASUREMENT
/begin MEASUREMENT ComScl_Dspl_RawSignal_METER_AC_OUTAIRTEMP01_u8 "NetworkSignal ComScl_Dspl_RawSignal_METER_AC_OUTAIRTEMP01_u8" UBYTE RB_RBA_Common_CentralElements_CompuMethods_Identical 1 100 0.0 255. FORMAT "%10.0" ECU_ADDRESS 0x60011125 /end MEASUREMENT
/begin MEASUREMENT ComScl_Dspl_RawSignal_METER_AC_PTC_STATUS_u8 "NetworkSignal ComScl_Dspl_RawSignal_METER_AC_PTC_STATUS_u8" UBYTE RB_RBA_Common_CentralElements_CompuMethods_Identical 1 100 0.0 255. FORMAT "%10.0" ECU_ADDRESS 0x60011124 /end MEASUREMENT
/begin MEASUREMENT ComScl_Dspl_RawSignal_METER_AC_RRDEF_b "NetworkSignal ComScl_Dspl_RawSignal_METER_AC_RRDEF_b" UBYTE RB_RBA_Common_CentralElements_CompuMethods_Identical 1 100 0.0 255. FORMAT "%10.0" ECU_ADDRESS 0x60011120 /end MEASUREMENT
/begin MEASUREMENT ComScl_Dspl_RawSignal_METER_AC_RR_BLW_VF_u8 "NetworkSignal ComScl_Dspl_RawSignal_METER_AC_RR_BLW_VF_u8" UBYTE RB_RBA_Common_CentralElements_CompuMethods_Identical 1 100 0.0 255. FORMAT "%10.0" ECU_ADDRESS 0x6001111F /end MEASUREMENT
/begin MEASUREMENT ComScl_Dspl_RawSignal_METER_AC_TEVATEMP05_u8 "NetworkSignal ComScl_Dspl_RawSignal_METER_AC_TEVATEMP05_u8" UBYTE RB_RBA_Common_CentralElements_CompuMethods_Identical 1 100 0.0 255. FORMAT "%10.0" ECU_ADDRESS 0x60011101 /end MEASUREMENT
/begin MEASUREMENT ComScl_Dspl_RawSignal_METER_AC_TYPE_ECON_b "NetworkSignal ComScl_Dspl_RawSignal_METER_AC_TYPE_ECON_b" UBYTE RB_RBA_Common_CentralElements_CompuMethods_Identical 1 100 0.0 255. FORMAT "%10.0" ECU_ADDRESS 0x60011144 /end MEASUREMENT
/begin MEASUREMENT ComScl_Dspl_RawSignal_METER_AC_VARI_u8 "NetworkSignal ComScl_Dspl_RawSignal_METER_AC_VARI_u8" UBYTE RB_RBA_Common_CentralElements_CompuMethods_Identical 1 100 0.0 255. FORMAT "%10.0" ECU_ADDRESS 0x6001111E /end MEASUREMENT
/begin MEASUREMENT ComScl_Dspl_RawSignal_METER_ALIVE_COUNTER_221_2_u8 "NetworkSignal ComScl_Dspl_RawSignal_METER_ALIVE_COUNTER_221_2_u8" UBYTE RB_RBA_Common_CentralElements_CompuMethods_Identical 1 100 0.0 255. FORMAT "%10.0" ECU_ADDRESS 0x6001114A /end MEASUREMENT
/begin MEASUREMENT ComScl_Dspl_RawSignal_METER_ALIVE_COUNTER_221_u8 "NetworkSignal ComScl_Dspl_RawSignal_METER_ALIVE_COUNTER_221_u8" UBYTE RB_RBA_Common_CentralElements_CompuMethods_Identical 1 100 0.0 255. FORMAT "%10.0" ECU_ADDRESS 0x60011150 /end MEASUREMENT
/begin MEASUREMENT ComScl_Dspl_RawSignal_METER_ALIVE_COUNTER_296_u8 "NetworkSignal ComScl_Dspl_RawSignal_METER_ALIVE_COUNTER_296_u8" UBYTE RB_RBA_Common_CentralElements_CompuMethods_Identical 1 100 0.0 255. FORMAT "%10.0" ECU_ADDRESS 0x60011109 /end MEASUREMENT
/begin MEASUREMENT ComScl_Dspl_RawSignal_METER_ALIVE_COUNTER_309_u8 "NetworkSignal ComScl_Dspl_RawSignal_METER_ALIVE_COUNTER_309_u8" UBYTE RB_RBA_Common_CentralElements_CompuMethods_Identical 1 100 0.0 255. FORMAT "%10.0" ECU_ADDRESS 0x6001113D /end MEASUREMENT
/begin MEASUREMENT ComScl_Dspl_RawSignal_METER_ALIVE_COUNTER_326_u8 "NetworkSignal ComScl_Dspl_RawSignal_METER_ALIVE_COUNTER_326_u8" UBYTE RB_RBA_Common_CentralElements_CompuMethods_Identical 1 100 0.0 255. FORMAT "%10.0" ECU_ADDRESS 0x6001115C /end MEASUREMENT
/begin MEASUREMENT ComScl_Dspl_RawSignal_METER_ALIVE_COUNTER_331_u8 "NetworkSignal ComScl_Dspl_RawSignal_METER_ALIVE_COUNTER_331_u8" UBYTE RB_RBA_Common_CentralElements_CompuMethods_Identical 1 100 0.0 255. FORMAT "%10.0" ECU_ADDRESS 0x60011100 /end MEASUREMENT
/begin MEASUREMENT ComScl_Dspl_RawSignal_METER_ALIVE_COUNTER_371_u8 "NetworkSignal ComScl_Dspl_RawSignal_METER_ALIVE_COUNTER_371_u8" UBYTE RB_RBA_Common_CentralElements_CompuMethods_Identical 1 100 0.0 255. FORMAT "%10.0" ECU_ADDRESS 0x6001112A /end MEASUREMENT
/begin MEASUREMENT ComScl_Dspl_RawSignal_METER_ALIVE_COUNTER_372_2_u8 "NetworkSignal ComScl_Dspl_RawSignal_METER_ALIVE_COUNTER_372_2_u8" UBYTE RB_RBA_Common_CentralElements_CompuMethods_Identical 1 100 0.0 255. FORMAT "%10.0" ECU_ADDRESS 0x60011130 /end MEASUREMENT
/begin MEASUREMENT ComScl_Dspl_RawSignal_METER_ALIVE_COUNTER_372_u8 "NetworkSignal ComScl_Dspl_RawSignal_METER_ALIVE_COUNTER_372_u8" UBYTE RB_RBA_Common_CentralElements_CompuMethods_Identical 1 100 0.0 255. FORMAT "%10.0" ECU_ADDRESS 0x60011136 /end MEASUREMENT
/begin MEASUREMENT ComScl_Dspl_RawSignal_METER_ALIVE_COUNTER_374_u8 "NetworkSignal ComScl_Dspl_RawSignal_METER_ALIVE_COUNTER_374_u8" UBYTE RB_RBA_Common_CentralElements_CompuMethods_Identical 1 100 0.0 255. FORMAT "%10.0" ECU_ADDRESS 0x60011156 /end MEASUREMENT
/begin MEASUREMENT ComScl_Dspl_RawSignal_METER_ALIVE_COUNTER_37B_u8 "NetworkSignal ComScl_Dspl_RawSignal_METER_ALIVE_COUNTER_37B_u8" UBYTE RB_RBA_Common_CentralElements_CompuMethods_Identical 1 100 0.0 255. FORMAT "%10.0" ECU_ADDRESS 0x6001111D /end MEASUREMENT
/begin MEASUREMENT ComScl_Dspl_RawSignal_METER_ALIVE_COUNTER_396_u8 "NetworkSignal ComScl_Dspl_RawSignal_METER_ALIVE_COUNTER_396_u8" UBYTE RB_RBA_Common_CentralElements_CompuMethods_Identical 1 100 0.0 255. FORMAT "%10.0" ECU_ADDRESS 0x60011143 /end MEASUREMENT
/begin MEASUREMENT ComScl_Dspl_RawSignal_METER_ALIVE_COUNTER_3A1_u8 "NetworkSignal ComScl_Dspl_RawSignal_METER_ALIVE_COUNTER_3A1_u8" UBYTE RB_RBA_Common_CentralElements_CompuMethods_Identical 1 100 0.0 255. FORMAT "%10.0" ECU_ADDRESS 0x60011105 /end MEASUREMENT
/begin MEASUREMENT ComScl_Dspl_RawSignal_METER_ALIVE_COUNTER_510_u8 "NetworkSignal ComScl_Dspl_RawSignal_METER_ALIVE_COUNTER_510_u8" UBYTE RB_RBA_Common_CentralElements_CompuMethods_Identical 1 100 0.0 255. FORMAT "%10.0" ECU_ADDRESS 0x60011123 /end MEASUREMENT
/begin MEASUREMENT ComScl_Dspl_RawSignal_METER_ALIVE_COUNTER_516_u8 "NetworkSignal ComScl_Dspl_RawSignal_METER_ALIVE_COUNTER_516_u8" UBYTE RB_RBA_Common_CentralElements_CompuMethods_Identical 1 100 0.0 255. FORMAT "%10.0" ECU_ADDRESS 0x60011112 /end MEASUREMENT
/begin MEASUREMENT ComScl_Dspl_RawSignal_METER_ASL_CAN_ERROR_b "NetworkSignal ComScl_Dspl_RawSignal_METER_ASL_CAN_ERROR_b" UBYTE RB_RBA_Common_CentralElements_CompuMethods_Identical 1 100 0.0 255. FORMAT "%10.0" ECU_ADDRESS 0x60011111 /end MEASUREMENT
/begin MEASUREMENT ComScl_Dspl_RawSignal_METER_BCAN_FAILCODE_BCAN_b "NetworkSignal ComScl_Dspl_RawSignal_METER_BCAN_FAILCODE_BCAN_b" UBYTE RB_RBA_Common_CentralElements_CompuMethods_Identical 1 100 0.0 255. FORMAT "%10.0" ECU_ADDRESS 0x60011110 /end MEASUREMENT
/begin MEASUREMENT ComScl_Dspl_RawSignal_METER_BCAN_FAILCODE_COMB_UNIT_b "NetworkSignal ComScl_Dspl_RawSignal_METER_BCAN_FAILCODE_COMB_UNIT_b" UBYTE RB_RBA_Common_CentralElements_CompuMethods_Identical 1 100 0.0 255. FORMAT "%10.0" ECU_ADDRESS 0x6001110F /end MEASUREMENT
/begin MEASUREMENT ComScl_Dspl_RawSignal_METER_BCAN_FAILCODE_HAC_b "NetworkSignal ComScl_Dspl_RawSignal_METER_BCAN_FAILCODE_HAC_b" UBYTE RB_RBA_Common_CentralElements_CompuMethods_Identical 1 100 0.0 255. FORMAT "%10.0" ECU_ADDRESS 0x6001110E /end MEASUREMENT
/begin MEASUREMENT ComScl_Dspl_RawSignal_METER_BCAN_FAILCODE_MCU_UNIT_b "NetworkSignal ComScl_Dspl_RawSignal_METER_BCAN_FAILCODE_MCU_UNIT_b" UBYTE RB_RBA_Common_CentralElements_CompuMethods_Identical 1 100 0.0 255. FORMAT "%10.0" ECU_ADDRESS 0x6001110D /end MEASUREMENT
/begin MEASUREMENT ComScl_Dspl_RawSignal_METER_BCAN_REPRO_b "NetworkSignal ComScl_Dspl_RawSignal_METER_BCAN_REPRO_b" UBYTE RB_RBA_Common_CentralElements_CompuMethods_Identical 1 100 0.0 255. FORMAT "%10.0" ECU_ADDRESS 0x6001115B /end MEASUREMENT
/begin MEASUREMENT ComScl_Dspl_RawSignal_METER_CC_MAIN_STATUS_b "NetworkSignal ComScl_Dspl_RawSignal_METER_CC_MAIN_STATUS_b" UBYTE RB_RBA_Common_CentralElements_CompuMethods_Identical 1 100 0.0 255. FORMAT "%10.0" ECU_ADDRESS 0x6001115A /end MEASUREMENT
/begin MEASUREMENT ComScl_Dspl_RawSignal_METER_CC_TARGETSP_DISP_b "NetworkSignal ComScl_Dspl_RawSignal_METER_CC_TARGETSP_DISP_b" UBYTE RB_RBA_Common_CentralElements_CompuMethods_Identical 1 100 0.0 255. FORMAT "%10.0" ECU_ADDRESS 0x6001113C /end MEASUREMENT
/begin MEASUREMENT ComScl_Dspl_RawSignal_METER_CHECKSUM_221_2_u8 "NetworkSignal ComScl_Dspl_RawSignal_METER_CHECKSUM_221_2_u8" UBYTE RB_RBA_Common_CentralElements_CompuMethods_Identical 1 100 0.0 255. FORMAT "%10.0" ECU_ADDRESS 0x60011149 /end MEASUREMENT
/begin MEASUREMENT ComScl_Dspl_RawSignal_METER_CHECKSUM_221_u8 "NetworkSignal ComScl_Dspl_RawSignal_METER_CHECKSUM_221_u8" UBYTE RB_RBA_Common_CentralElements_CompuMethods_Identical 1 100 0.0 255. FORMAT "%10.0" ECU_ADDRESS 0x6001114F /end MEASUREMENT
/begin MEASUREMENT ComScl_Dspl_RawSignal_METER_CHECKSUM_296_u8 "NetworkSignal ComScl_Dspl_RawSignal_METER_CHECKSUM_296_u8" UBYTE RB_RBA_Common_CentralElements_CompuMethods_Identical 1 100 0.0 255. FORMAT "%10.0" ECU_ADDRESS 0x60011108 /end MEASUREMENT
/begin MEASUREMENT ComScl_Dspl_RawSignal_METER_CHECKSUM_309_u8 "NetworkSignal ComScl_Dspl_RawSignal_METER_CHECKSUM_309_u8" UBYTE RB_RBA_Common_CentralElements_CompuMethods_Identical 1 100 0.0 255. FORMAT "%10.0" ECU_ADDRESS 0x6001113B /end MEASUREMENT
/begin MEASUREMENT ComScl_Dspl_RawSignal_METER_CHECKSUM_326_u8 "NetworkSignal ComScl_Dspl_RawSignal_METER_CHECKSUM_326_u8" UBYTE RB_RBA_Common_CentralElements_CompuMethods_Identical 1 100 0.0 255. FORMAT "%10.0" ECU_ADDRESS 0x60011159 /end MEASUREMENT
/begin MEASUREMENT ComScl_Dspl_RawSignal_METER_CHECKSUM_331_u8 "NetworkSignal ComScl_Dspl_RawSignal_METER_CHECKSUM_331_u8" UBYTE RB_RBA_Common_CentralElements_CompuMethods_Identical 1 100 0.0 255. FORMAT "%10.0" ECU_ADDRESS 0x600110FF /end MEASUREMENT
/begin MEASUREMENT ComScl_Dspl_RawSignal_METER_CHECKSUM_371_u8 "NetworkSignal ComScl_Dspl_RawSignal_METER_CHECKSUM_371_u8" UBYTE RB_RBA_Common_CentralElements_CompuMethods_Identical 1 100 0.0 255. FORMAT "%10.0" ECU_ADDRESS 0x60011129 /end MEASUREMENT
/begin MEASUREMENT ComScl_Dspl_RawSignal_METER_CHECKSUM_372_2_u8 "NetworkSignal ComScl_Dspl_RawSignal_METER_CHECKSUM_372_2_u8" UBYTE RB_RBA_Common_CentralElements_CompuMethods_Identical 1 100 0.0 255. FORMAT "%10.0" ECU_ADDRESS 0x6001112F /end MEASUREMENT
/begin MEASUREMENT ComScl_Dspl_RawSignal_METER_CHECKSUM_372_u8 "NetworkSignal ComScl_Dspl_RawSignal_METER_CHECKSUM_372_u8" UBYTE RB_RBA_Common_CentralElements_CompuMethods_Identical 1 100 0.0 255. FORMAT "%10.0" ECU_ADDRESS 0x60011135 /end MEASUREMENT
/begin MEASUREMENT ComScl_Dspl_RawSignal_METER_CHECKSUM_374_u8 "NetworkSignal ComScl_Dspl_RawSignal_METER_CHECKSUM_374_u8" UBYTE RB_RBA_Common_CentralElements_CompuMethods_Identical 1 100 0.0 255. FORMAT "%10.0" ECU_ADDRESS 0x60011155 /end MEASUREMENT
/begin MEASUREMENT ComScl_Dspl_RawSignal_METER_CHECKSUM_37B_u8 "NetworkSignal ComScl_Dspl_RawSignal_METER_CHECKSUM_37B_u8" UBYTE RB_RBA_Common_CentralElements_CompuMethods_Identical 1 100 0.0 255. FORMAT "%10.0" ECU_ADDRESS 0x6001111C /end MEASUREMENT
/begin MEASUREMENT ComScl_Dspl_RawSignal_METER_CHECKSUM_396_u8 "NetworkSignal ComScl_Dspl_RawSignal_METER_CHECKSUM_396_u8" UBYTE RB_RBA_Common_CentralElements_CompuMethods_Identical 1 100 0.0 255. FORMAT "%10.0" ECU_ADDRESS 0x60011142 /end MEASUREMENT
/begin MEASUREMENT ComScl_Dspl_RawSignal_METER_CHECKSUM_3A1_u8 "NetworkSignal ComScl_Dspl_RawSignal_METER_CHECKSUM_3A1_u8" UBYTE RB_RBA_Common_CentralElements_CompuMethods_Identical 1 100 0.0 255. FORMAT "%10.0" ECU_ADDRESS 0x60011104 /end MEASUREMENT
/begin MEASUREMENT ComScl_Dspl_RawSignal_METER_CHECKSUM_510_u8 "NetworkSignal ComScl_Dspl_RawSignal_METER_CHECKSUM_510_u8" UBYTE RB_RBA_Common_CentralElements_CompuMethods_Identical 1 100 0.0 255. FORMAT "%10.0" ECU_ADDRESS 0x60011122 /end MEASUREMENT
/begin MEASUREMENT ComScl_Dspl_RawSignal_METER_CHECKSUM_516_u8 "NetworkSignal ComScl_Dspl_RawSignal_METER_CHECKSUM_516_u8" UBYTE RB_RBA_Common_CentralElements_CompuMethods_Identical 1 100 0.0 255. FORMAT "%10.0" ECU_ADDRESS 0x6001110C /end MEASUREMENT
/begin MEASUREMENT ComScl_Dspl_RawSignal_METER_COMPCURRENT_HIBYTE_u8 "NetworkSignal ComScl_Dspl_RawSignal_METER_COMPCURRENT_HIBYTE_u8" UBYTE RB_RBA_Common_CentralElements_CompuMethods_Identical 1 100 0.0 255. FORMAT "%10.0" ECU_ADDRESS 0x60011128 /end MEASUREMENT
/begin MEASUREMENT ComScl_Dspl_RawSignal_METER_COMPCURRENT_LOWBYTE_u8 "NetworkSignal ComScl_Dspl_RawSignal_METER_COMPCURRENT_LOWBYTE_u8" UBYTE RB_RBA_Common_CentralElements_CompuMethods_Identical 1 100 0.0 255. FORMAT "%10.0" ECU_ADDRESS 0x60011127 /end MEASUREMENT
/begin MEASUREMENT ComScl_Dspl_RawSignal_METER_CUSTOM_DEFAULT_b "NetworkSignal ComScl_Dspl_RawSignal_METER_CUSTOM_DEFAULT_b" UBYTE RB_RBA_Common_CentralElements_CompuMethods_Identical 1 100 0.0 255. FORMAT "%10.0" ECU_ADDRESS 0x60011103 /end MEASUREMENT
/begin MEASUREMENT ComScl_Dspl_RawSignal_METER_CUSTOM_KJ_SPEED_LIMITER_b "NetworkSignal ComScl_Dspl_RawSignal_METER_CUSTOM_KJ_SPEED_LIMITER_b" UBYTE RB_RBA_Common_CentralElements_CompuMethods_Identical 1 100 0.0 255. FORMAT "%10.0" ECU_ADDRESS 0x6001113A /end MEASUREMENT
/begin MEASUREMENT ComScl_Dspl_RawSignal_METER_CUSTOM_STATUS_b "NetworkSignal ComScl_Dspl_RawSignal_METER_CUSTOM_STATUS_b" UBYTE RB_RBA_Common_CentralElements_CompuMethods_Identical 1 100 0.0 255. FORMAT "%10.0" ECU_ADDRESS 0x60011102 /end MEASUREMENT
/begin MEASUREMENT ComScl_Dspl_RawSignal_METER_DIGITAL_SPEED_DISPLAY_u8 "NetworkSignal ComScl_Dspl_RawSignal_METER_DIGITAL_SPEED_DISPLAY_u8" UBYTE RB_RBA_Common_CentralElements_CompuMethods_Identical 1 100 0.0 255. FORMAT "%10.0" ECU_ADDRESS 0x60011139 /end MEASUREMENT
/begin MEASUREMENT ComScl_Dspl_RawSignal_METER_DIGITAL_SPEED_TARGET_u16 "NetworkSignal ComScl_Dspl_RawSignal_METER_DIGITAL_SPEED_TARGET_u16" UWORD RB_RBA_Common_CentralElements_CompuMethods_Identical 1 100 0.0 65535. FORMAT "%10.0" ECU_ADDRESS 0x6000ABF0 /end MEASUREMENT
/begin MEASUREMENT ComScl_Dspl_RawSignal_METER_DISPLAY_SPEED_u16 "NetworkSignal ComScl_Dspl_RawSignal_METER_DISPLAY_SPEED_u16" UWORD RB_RBA_Common_CentralElements_CompuMethods_Identical 1 100 0.0 65535. FORMAT "%10.0" ECU_ADDRESS 0x6000ABEE /end MEASUREMENT
/begin MEASUREMENT ComScl_Dspl_RawSignal_METER_ECONSW_ON_2_b "NetworkSignal ComScl_Dspl_RawSignal_METER_ECONSW_ON_2_b" UBYTE RB_RBA_Common_CentralElements_CompuMethods_Identical 1 100 0.0 255. FORMAT "%10.0" ECU_ADDRESS 0x60011148 /end MEASUREMENT
/begin MEASUREMENT ComScl_Dspl_RawSignal_METER_EVA_TEMP_2_u8 "NetworkSignal ComScl_Dspl_RawSignal_METER_EVA_TEMP_2_u8" UBYTE RB_RBA_Common_CentralElements_CompuMethods_Identical 1 100 0.0 255. FORMAT "%10.0" ECU_ADDRESS 0x60011147 /end MEASUREMENT
/begin MEASUREMENT ComScl_Dspl_RawSignal_METER_EVA_TEMP_u8 "NetworkSignal ComScl_Dspl_RawSignal_METER_EVA_TEMP_u8" UBYTE RB_RBA_Common_CentralElements_CompuMethods_Identical 1 100 0.0 255. FORMAT "%10.0" ECU_ADDRESS 0x6001114E /end MEASUREMENT
/begin MEASUREMENT ComScl_Dspl_RawSignal_METER_FRDEF_b "NetworkSignal ComScl_Dspl_RawSignal_METER_FRDEF_b" UBYTE RB_RBA_Common_CentralElements_CompuMethods_Identical 1 100 0.0 255. FORMAT "%10.0" ECU_ADDRESS 0x60011141 /end MEASUREMENT
/begin MEASUREMENT ComScl_Dspl_RawSignal_METER_FRFOGRLY_b "NetworkSignal ComScl_Dspl_RawSignal_METER_FRFOGRLY_b" UBYTE RB_RBA_Common_CentralElements_CompuMethods_Identical 1 100 0.0 255. FORMAT "%10.0" ECU_ADDRESS 0x60011154 /end MEASUREMENT
/begin MEASUREMENT ComScl_Dspl_RawSignal_METER_FUEL_LEVEL_RAW_u8 "NetworkSignal ComScl_Dspl_RawSignal_METER_FUEL_LEVEL_RAW_u8" UBYTE RB_RBA_Common_CentralElements_CompuMethods_Identical 1 100 0.0 255. FORMAT "%10.0" ECU_ADDRESS 0x60011158 /end MEASUREMENT
/begin MEASUREMENT ComScl_Dspl_RawSignal_METER_ICU_ACBLW_VD_u8 "NetworkSignal ComScl_Dspl_RawSignal_METER_ICU_ACBLW_VD_u8" UBYTE RB_RBA_Common_CentralElements_CompuMethods_Identical 1 100 0.0 255. FORMAT "%10.0" ECU_ADDRESS 0x6001111B /end MEASUREMENT
/begin MEASUREMENT ComScl_Dspl_RawSignal_METER_ICU_HOOD_2_b "NetworkSignal ComScl_Dspl_RawSignal_METER_ICU_HOOD_2_b" UBYTE RB_RBA_Common_CentralElements_CompuMethods_Identical 1 100 0.0 255. FORMAT "%10.0" ECU_ADDRESS 0x6001112E /end MEASUREMENT
/begin MEASUREMENT ComScl_Dspl_RawSignal_METER_ICU_HOOD_ERR_2_b "NetworkSignal ComScl_Dspl_RawSignal_METER_ICU_HOOD_ERR_2_b" UBYTE RB_RBA_Common_CentralElements_CompuMethods_Identical 1 100 0.0 255. FORMAT "%10.0" ECU_ADDRESS 0x6001112D /end MEASUREMENT
/begin MEASUREMENT ComScl_Dspl_RawSignal_METER_ICU_HOOD_ERR_b "NetworkSignal ComScl_Dspl_RawSignal_METER_ICU_HOOD_ERR_b" UBYTE RB_RBA_Common_CentralElements_CompuMethods_Identical 1 100 0.0 255. FORMAT "%10.0" ECU_ADDRESS 0x60011133 /end MEASUREMENT
/begin MEASUREMENT ComScl_Dspl_RawSignal_METER_ICU_HOOD_b "NetworkSignal ComScl_Dspl_RawSignal_METER_ICU_HOOD_b" UBYTE RB_RBA_Common_CentralElements_CompuMethods_Identical 1 100 0.0 255. FORMAT "%10.0" ECU_ADDRESS 0x60011134 /end MEASUREMENT
/begin MEASUREMENT ComScl_Dspl_RawSignal_METER_IN_AIR_TEMP_u8 "NetworkSignal ComScl_Dspl_RawSignal_METER_IN_AIR_TEMP_u8" UBYTE RB_RBA_Common_CentralElements_CompuMethods_Identical 1 100 0.0 255. FORMAT "%10.0" ECU_ADDRESS 0x60011140 /end MEASUREMENT
/begin MEASUREMENT ComScl_Dspl_RawSignal_METER_IS_INHIBITSW_ON_2_b "NetworkSignal ComScl_Dspl_RawSignal_METER_IS_INHIBITSW_ON_2_b" UBYTE RB_RBA_Common_CentralElements_CompuMethods_Identical 1 100 0.0 255. FORMAT "%10.0" ECU_ADDRESS 0x60011146 /end MEASUREMENT
/begin MEASUREMENT ComScl_Dspl_RawSignal_METER_IS_INHIBITSW_ON_b "NetworkSignal ComScl_Dspl_RawSignal_METER_IS_INHIBITSW_ON_b" UBYTE RB_RBA_Common_CentralElements_CompuMethods_Identical 1 100 0.0 255. FORMAT "%10.0" ECU_ADDRESS 0x6001114D /end MEASUREMENT
/begin MEASUREMENT ComScl_Dspl_RawSignal_METER_IS_PERMIT_b "NetworkSignal ComScl_Dspl_RawSignal_METER_IS_PERMIT_b" UBYTE RB_RBA_Common_CentralElements_CompuMethods_Identical 1 100 0.0 255. FORMAT "%10.0" ECU_ADDRESS 0x6001113F /end MEASUREMENT
/begin MEASUREMENT ComScl_Dspl_RawSignal_METER_IS_TIME_2_u8 "NetworkSignal ComScl_Dspl_RawSignal_METER_IS_TIME_2_u8" UBYTE RB_RBA_Common_CentralElements_CompuMethods_Identical 1 100 0.0 255. FORMAT "%10.0" ECU_ADDRESS 0x60011145 /end MEASUREMENT
/begin MEASUREMENT ComScl_Dspl_RawSignal_METER_IS_TIME_u8 "NetworkSignal ComScl_Dspl_RawSignal_METER_IS_TIME_u8" UBYTE RB_RBA_Common_CentralElements_CompuMethods_Identical 1 100 0.0 255. FORMAT "%10.0" ECU_ADDRESS 0x6001114C /end MEASUREMENT
/begin MEASUREMENT ComScl_Dspl_RawSignal_METER_KLDDORLOCK_2_u8 "NetworkSignal ComScl_Dspl_RawSignal_METER_KLDDORLOCK_2_u8" UBYTE RB_RBA_Common_CentralElements_CompuMethods_Identical 1 100 0.0 255. FORMAT "%10.0" ECU_ADDRESS 0x6001112C /end MEASUREMENT
/begin MEASUREMENT ComScl_Dspl_RawSignal_METER_MICU_FRDEICERRLY_b "NetworkSignal ComScl_Dspl_RawSignal_METER_MICU_FRDEICERRLY_b" UBYTE RB_RBA_Common_CentralElements_CompuMethods_Identical 1 100 0.0 255. FORMAT "%10.0" ECU_ADDRESS 0x6001111A /end MEASUREMENT
/begin MEASUREMENT ComScl_Dspl_RawSignal_METER_MICU_FRWIPMTR_u8 "NetworkSignal ComScl_Dspl_RawSignal_METER_MICU_FRWIPMTR_u8" UBYTE RB_RBA_Common_CentralElements_CompuMethods_Identical 1 100 0.0 255. FORMAT "%10.0" ECU_ADDRESS 0x60011119 /end MEASUREMENT
/begin MEASUREMENT ComScl_Dspl_RawSignal_METER_MICU_RRDEFSW_b "NetworkSignal ComScl_Dspl_RawSignal_METER_MICU_RRDEFSW_b" UBYTE RB_RBA_Common_CentralElements_CompuMethods_Identical 1 100 0.0 255. FORMAT "%10.0" ECU_ADDRESS 0x60011118 /end MEASUREMENT
/begin MEASUREMENT ComScl_Dspl_RawSignal_METER_MICU_TYPE_b "NetworkSignal ComScl_Dspl_RawSignal_METER_MICU_TYPE_b" UBYTE RB_RBA_Common_CentralElements_CompuMethods_Identical 1 100 0.0 255. FORMAT "%10.0" ECU_ADDRESS 0x60011117 /end MEASUREMENT
/begin MEASUREMENT ComScl_Dspl_RawSignal_METER_ODODATA_STATE_b "NetworkSignal ComScl_Dspl_RawSignal_METER_ODODATA_STATE_b" UBYTE RB_RBA_Common_CentralElements_CompuMethods_Identical 1 100 0.0 255. FORMAT "%10.0" ECU_ADDRESS 0x6001110B /end MEASUREMENT
/begin MEASUREMENT ComScl_Dspl_RawSignal_METER_ODO_DATA_u32 "NetworkSignal ComScl_Dspl_RawSignal_METER_ODO_DATA_u32" ULONG RB_RBA_Common_CentralElements_CompuMethods_Identical 1 100 0.0 4.E9 FORMAT "%10.0" ECU_ADDRESS 0x500026E0 /end MEASUREMENT
/begin MEASUREMENT ComScl_Dspl_RawSignal_METER_OIL_LIFE_RESSW_b "NetworkSignal ComScl_Dspl_RawSignal_METER_OIL_LIFE_RESSW_b" UBYTE RB_RBA_Common_CentralElements_CompuMethods_Identical 1 100 0.0 255. FORMAT "%10.0" ECU_ADDRESS 0x6001110A /end MEASUREMENT
/begin MEASUREMENT ComScl_Dspl_RawSignal_METER_OUTTEMP_u8 "NetworkSignal ComScl_Dspl_RawSignal_METER_OUTTEMP_u8" UBYTE RB_RBA_Common_CentralElements_CompuMethods_Identical 1 100 0.0 255. FORMAT "%10.0" ECU_ADDRESS 0x60011153 /end MEASUREMENT
/begin MEASUREMENT ComScl_Dspl_RawSignal_METER_OUT_AIR_TEMP_u8 "NetworkSignal ComScl_Dspl_RawSignal_METER_OUT_AIR_TEMP_u8" UBYTE RB_RBA_Common_CentralElements_CompuMethods_Identical 1 100 0.0 255. FORMAT "%10.0" ECU_ADDRESS 0x6001113E /end MEASUREMENT
/begin MEASUREMENT ComScl_Dspl_RawSignal_METER_RM_DRLKC_b "NetworkSignal ComScl_Dspl_RawSignal_METER_RM_DRLKC_b" UBYTE RB_RBA_Common_CentralElements_CompuMethods_Identical 1 100 0.0 255. FORMAT "%10.0" ECU_ADDRESS 0x60011116 /end MEASUREMENT
/begin MEASUREMENT ComScl_Dspl_RawSignal_METER_RM_HLHIRLY_b "NetworkSignal ComScl_Dspl_RawSignal_METER_RM_HLHIRLY_b" UBYTE RB_RBA_Common_CentralElements_CompuMethods_Identical 1 100 0.0 255. FORMAT "%10.0" ECU_ADDRESS 0x60011115 /end MEASUREMENT
/begin MEASUREMENT ComScl_Dspl_RawSignal_METER_RM_HLLORLY_b "NetworkSignal ComScl_Dspl_RawSignal_METER_RM_HLLORLY_b" UBYTE RB_RBA_Common_CentralElements_CompuMethods_Identical 1 100 0.0 255. FORMAT "%10.0" ECU_ADDRESS 0x60011114 /end MEASUREMENT
/begin MEASUREMENT ComScl_Dspl_RawSignal_METER_RM_ILL_SML_b "NetworkSignal ComScl_Dspl_RawSignal_METER_RM_ILL_SML_b" UBYTE RB_RBA_Common_CentralElements_CompuMethods_Identical 1 100 0.0 255. FORMAT "%10.0" ECU_ADDRESS 0x60011113 /end MEASUREMENT
/begin MEASUREMENT ComScl_Dspl_RawSignal_METER_RRFOGRLY_b "NetworkSignal ComScl_Dspl_RawSignal_METER_RRFOGRLY_b" UBYTE RB_RBA_Common_CentralElements_CompuMethods_Identical 1 100 0.0 255. FORMAT "%10.0" ECU_ADDRESS 0x60011152 /end MEASUREMENT
/begin MEASUREMENT ComScl_Dspl_RawSignal_METER_SPEED_UNIT_b "NetworkSignal ComScl_Dspl_RawSignal_METER_SPEED_UNIT_b" UBYTE RB_RBA_Common_CentralElements_CompuMethods_Identical 1 100 0.0 255. FORMAT "%10.0" ECU_ADDRESS 0x60011138 /end MEASUREMENT
/begin MEASUREMENT ComScl_Dspl_RawSignal_METER_SW_STATUS_CC_STANDARD_u8 "NetworkSignal ComScl_Dspl_RawSignal_METER_SW_STATUS_CC_STANDARD_u8" UBYTE RB_RBA_Common_CentralElements_CompuMethods_Identical 1 100 0.0 255. FORMAT "%10.0" ECU_ADDRESS 0x60011107 /end MEASUREMENT
/begin MEASUREMENT ComScl_Dspl_RawSignal_METER_SW_STATUS_HAC_2_b "NetworkSignal ComScl_Dspl_RawSignal_METER_SW_STATUS_HAC_2_b" UBYTE RB_RBA_Common_CentralElements_CompuMethods_Identical 1 100 0.0 255. FORMAT "%10.0" ECU_ADDRESS 0x6001112B /end MEASUREMENT
/begin MEASUREMENT ComScl_Dspl_RawSignal_METER_SW_STATUS_HAC_b "NetworkSignal ComScl_Dspl_RawSignal_METER_SW_STATUS_HAC_b" UBYTE RB_RBA_Common_CentralElements_CompuMethods_Identical 1 100 0.0 255. FORMAT "%10.0" ECU_ADDRESS 0x60011132 /end MEASUREMENT
/begin MEASUREMENT ComScl_Dspl_RawSignal_METER_SW_STATUS_IS_INH_b "NetworkSignal ComScl_Dspl_RawSignal_METER_SW_STATUS_IS_INH_b" UBYTE RB_RBA_Common_CentralElements_CompuMethods_Identical 1 100 0.0 255. FORMAT "%10.0" ECU_ADDRESS 0x6001114B /end MEASUREMENT
/begin MEASUREMENT ComScl_Dspl_RawSignal_METER_SW_STATUS_LKAS_CCLIM_DIST_u8 "NetworkSignal ComScl_Dspl_RawSignal_METER_SW_STATUS_LKAS_CCLIM_DIST_u8" UBYTE RB_RBA_Common_CentralElements_CompuMethods_Identical 1 100 0.0 255. FORMAT "%10.0" ECU_ADDRESS 0x60011106 /end MEASUREMENT
/begin MEASUREMENT ComScl_Dspl_RawSignal_METER_SW_STATUS_PARK_BRAKE_b "NetworkSignal ComScl_Dspl_RawSignal_METER_SW_STATUS_PARK_BRAKE_b" UBYTE RB_RBA_Common_CentralElements_CompuMethods_Identical 1 100 0.0 255. FORMAT "%10.0" ECU_ADDRESS 0x60011157 /end MEASUREMENT
/begin MEASUREMENT ComScl_Dspl_RawSignal_METER_WIPER_STATUS_u8 "NetworkSignal ComScl_Dspl_RawSignal_METER_WIPER_STATUS_u8" UBYTE RB_RBA_Common_CentralElements_CompuMethods_Identical 1 100 0.0 255. FORMAT "%10.0" ECU_ADDRESS 0x60011151 /end MEASUREMENT
/begin MEASUREMENT ComScl_EngLin_RawSignal_Lin_Alt_B_Signal_ACG_Temp_8_r_msg_u8 "NetworkSignal ComScl_EngLin_RawSignal_Lin_Alt_B_Signal_ACG_Temp_8_r_msg_u8" UBYTE RB_RBA_Common_CentralElements_CompuMethods_Identical 1 100 0.0 255. FORMAT "%10.0" ECU_ADDRESS 0x60011192 /end MEASUREMENT
/begin MEASUREMENT ComScl_EngLin_RawSignal_Lin_Alt_B_Signal_ComTOut_1_r_msg_b "NetworkSignal ComScl_EngLin_RawSignal_Lin_Alt_B_Signal_ComTOut_1_r_msg_b" UBYTE RB_RBA_Common_CentralElements_CompuMethods_Identical 1 100 0.0 255. FORMAT "%10.0" ECU_ADDRESS 0x60011191 /end MEASUREMENT
/begin MEASUREMENT ComScl_EngLin_RawSignal_Lin_Alt_B_Signal_Com_1_r_msg_b "NetworkSignal ComScl_EngLin_RawSignal_Lin_Alt_B_Signal_Com_1_r_msg_b" UBYTE RB_RBA_Common_CentralElements_CompuMethods_Identical 1 100 0.0 255. FORMAT "%10.0" ECU_ADDRESS 0x60011190 /end MEASUREMENT
/begin MEASUREMENT ComScl_EngLin_RawSignal_Lin_Alt_B_Signal_Dyc_5_r_msg_u8 "NetworkSignal ComScl_EngLin_RawSignal_Lin_Alt_B_Signal_Dyc_5_r_msg_u8" UBYTE RB_RBA_Common_CentralElements_CompuMethods_Identical 1 100 0.0 255. FORMAT "%10.0" ECU_ADDRESS 0x6001118F /end MEASUREMENT
/begin MEASUREMENT ComScl_EngLin_RawSignal_Lin_Alt_B_Signal_Elec_1_r_msg_b "NetworkSignal ComScl_EngLin_RawSignal_Lin_Alt_B_Signal_Elec_1_r_msg_b" UBYTE RB_RBA_Common_CentralElements_CompuMethods_Identical 1 100 0.0 255. FORMAT "%10.0" ECU_ADDRESS 0x6001118E /end MEASUREMENT
/begin MEASUREMENT ComScl_EngLin_RawSignal_Lin_Alt_B_Signal_ExctCrnt_8_r_msg_u8 "NetworkSignal ComScl_EngLin_RawSignal_Lin_Alt_B_Signal_ExctCrnt_8_r_msg_u8" UBYTE RB_RBA_Common_CentralElements_CompuMethods_Identical 1 100 0.0 255. FORMAT "%10.0" ECU_ADDRESS 0x6001118D /end MEASUREMENT
/begin MEASUREMENT ComScl_EngLin_RawSignal_Lin_Alt_B_Signal_HiTemp_1_r_msg_b "NetworkSignal ComScl_EngLin_RawSignal_Lin_Alt_B_Signal_HiTemp_1_r_msg_b" UBYTE RB_RBA_Common_CentralElements_CompuMethods_Identical 1 100 0.0 255. FORMAT "%10.0" ECU_ADDRESS 0x6001118C /end MEASUREMENT
/begin MEASUREMENT ComScl_EngLin_RawSignal_Lin_Alt_B_Signal_Mchn_1_r_msg_b "NetworkSignal ComScl_EngLin_RawSignal_Lin_Alt_B_Signal_Mchn_1_r_msg_b" UBYTE RB_RBA_Common_CentralElements_CompuMethods_Identical 1 100 0.0 255. FORMAT "%10.0" ECU_ADDRESS 0x6001118B /end MEASUREMENT
/begin MEASUREMENT ComScl_EngLin_RawSignal_Lin_BS_B_Signal_OCV_8_r_msg_u8 "NetworkSignal ComScl_EngLin_RawSignal_Lin_BS_B_Signal_OCV_8_r_msg_u8" UBYTE RB_RBA_Common_CentralElements_CompuMethods_Identical 1 100 0.0 255. FORMAT "%10.0" ECU_ADDRESS 0x60011179 /end MEASUREMENT
/begin MEASUREMENT ComScl_EngLin_RawSignal_Lin_BS_B_Signal_STBATTSENRST_1_r_msg_b "NetworkSignal ComScl_EngLin_RawSignal_Lin_BS_B_Signal_STBATTSENRST_1_r_msg_b" UBYTE RB_RBA_Common_CentralElements_CompuMethods_Identical 1 100 0.0 255. FORMAT "%10.0" ECU_ADDRESS 0x60011178 /end MEASUREMENT
/begin MEASUREMENT ComScl_EngLin_RawSignal_Lin_BS_B_Signal_TASIC_8_r_msg_u8 "NetworkSignal ComScl_EngLin_RawSignal_Lin_BS_B_Signal_TASIC_8_r_msg_u8" UBYTE RB_RBA_Common_CentralElements_CompuMethods_Identical 1 100 0.0 255. FORMAT "%10.0" ECU_ADDRESS 0x6001116D /end MEASUREMENT
/begin MEASUREMENT ComScl_EngLin_RawSignal_Lin_BS_B_Signal_tiDurAftIgnOff_16_r_msg_u16 "NetworkSignal ComScl_EngLin_RawSignal_Lin_BS_B_Signal_tiDurAftIgnOff_16_r_msg_u16" UWORD RB_RBA_Common_CentralElements_CompuMethods_Identical 1 100 0.0 65535. FORMAT "%10.0" ECU_ADDRESS 0x6000AC02 /end MEASUREMENT
/begin MEASUREMENT ComScl_EngLin_RawSignal_Lin_BS_Signal_B_BATTCH_16_r_msg_u16 "NetworkSignal ComScl_EngLin_RawSignal_Lin_BS_Signal_B_BATTCH_16_r_msg_u16" UWORD RB_RBA_Common_CentralElements_CompuMethods_Identical 1 100 0.0 65535. FORMAT "%10.0" ECU_ADDRESS 0x6000AC00 /end MEASUREMENT
/begin MEASUREMENT ComScl_EngLin_RawSignal_Lin_BS_Signal_B_BATTDCHA_16_r_msg_u16 "NetworkSignal ComScl_EngLin_RawSignal_Lin_BS_Signal_B_BATTDCHA_16_r_msg_u16" UWORD RB_RBA_Common_CentralElements_CompuMethods_Identical 1 100 0.0 65535. FORMAT "%10.0" ECU_ADDRESS 0x6000ABFE /end MEASUREMENT
/begin MEASUREMENT ComScl_EngLin_RawSignal_Lin_BS_Signal_B_BATT_REPLACE_1_r_msg_b "NetworkSignal ComScl_EngLin_RawSignal_Lin_BS_Signal_B_BATT_REPLACE_1_r_msg_b" UBYTE RB_RBA_Common_CentralElements_CompuMethods_Identical 1 100 0.0 255. FORMAT "%10.0" ECU_ADDRESS 0x60011185 /end MEASUREMENT
/begin MEASUREMENT ComScl_EngLin_RawSignal_Lin_BS_Signal_B_BATT_SIZE_DETECT_1_r_msg_b "NetworkSignal ComScl_EngLin_RawSignal_Lin_BS_Signal_B_BATT_SIZE_DETECT_1_r_msg_b" UBYTE RB_RBA_Common_CentralElements_CompuMethods_Identical 1 100 0.0 255. FORMAT "%10.0" ECU_ADDRESS 0x60011177 /end MEASUREMENT
/begin MEASUREMENT ComScl_EngLin_RawSignal_Lin_BS_Signal_B_BATT_WARM_LEVEL_3_r_msg_u8 "NetworkSignal ComScl_EngLin_RawSignal_Lin_BS_Signal_B_BATT_WARM_LEVEL_3_r_msg_u8" UBYTE RB_RBA_Common_CentralElements_CompuMethods_Identical 1 100 0.0 255. FORMAT "%10.0" ECU_ADDRESS 0x60011184 /end MEASUREMENT
/begin MEASUREMENT ComScl_EngLin_RawSignal_Lin_BS_Signal_B_BCF_1_r_msg_b "NetworkSignal ComScl_EngLin_RawSignal_Lin_BS_Signal_B_BCF_1_r_msg_b" UBYTE RB_RBA_Common_CentralElements_CompuMethods_Identical 1 100 0.0 255. FORMAT "%10.0" ECU_ADDRESS 0x60011176 /end MEASUREMENT
/begin MEASUREMENT ComScl_EngLin_RawSignal_Lin_BS_Signal_B_CHARGE_LOW_1_r_msg_b "NetworkSignal ComScl_EngLin_RawSignal_Lin_BS_Signal_B_CHARGE_LOW_1_r_msg_b" UBYTE RB_RBA_Common_CentralElements_CompuMethods_Identical 1 100 0.0 255. FORMAT "%10.0" ECU_ADDRESS 0x60011183 /end MEASUREMENT
/begin MEASUREMENT ComScl_EngLin_RawSignal_Lin_BS_Signal_B_CTINTRESUPD_2_r_msg_u8 "NetworkSignal ComScl_EngLin_RawSignal_Lin_BS_Signal_B_CTINTRESUPD_2_r_msg_u8" UBYTE RB_RBA_Common_CentralElements_CompuMethods_Identical 1 100 0.0 255. FORMAT "%10.0" ECU_ADDRESS 0x6001116C /end MEASUREMENT
/begin MEASUREMENT ComScl_EngLin_RawSignal_Lin_BS_Signal_B_DATA_FORMAT_8_r_msg_u8 "NetworkSignal ComScl_EngLin_RawSignal_Lin_BS_Signal_B_DATA_FORMAT_8_r_msg_u8" UBYTE RB_RBA_Common_CentralElements_CompuMethods_Identical 1 100 0.0 255. FORMAT "%10.0" ECU_ADDRESS 0x60011182 /end MEASUREMENT
/begin MEASUREMENT ComScl_EngLin_RawSignal_Lin_BS_Signal_B_ERROR_RES_1_r_msg_b "NetworkSignal ComScl_EngLin_RawSignal_Lin_BS_Signal_B_ERROR_RES_1_r_msg_b" UBYTE RB_RBA_Common_CentralElements_CompuMethods_Identical 1 100 0.0 255. FORMAT "%10.0" ECU_ADDRESS 0x60011181 /end MEASUREMENT
/begin MEASUREMENT ComScl_EngLin_RawSignal_Lin_BS_Signal_B_HARNR_2_r_msg_u8 "NetworkSignal ComScl_EngLin_RawSignal_Lin_BS_Signal_B_HARNR_2_r_msg_u8" UBYTE RB_RBA_Common_CentralElements_CompuMethods_Identical 1 100 0.0 255. FORMAT "%10.0" ECU_ADDRESS 0x60011180 /end MEASUREMENT
/begin MEASUREMENT ComScl_EngLin_RawSignal_Lin_BS_Signal_B_IBAT_16_r_msg_u16 "NetworkSignal ComScl_EngLin_RawSignal_Lin_BS_Signal_B_IBAT_16_r_msg_u16" UWORD RB_RBA_Common_CentralElements_CompuMethods_Identical 1 100 0.0 65535. FORMAT "%10.0" ECU_ADDRESS 0x6000AC06 /end MEASUREMENT
/begin MEASUREMENT ComScl_EngLin_RawSignal_Lin_BS_Signal_B_IBAT_8_r_msg_u8 "NetworkSignal ComScl_EngLin_RawSignal_Lin_BS_Signal_B_IBAT_8_r_msg_u8" UBYTE RB_RBA_Common_CentralElements_CompuMethods_Identical 1 100 0.0 255. FORMAT "%10.0" ECU_ADDRESS 0x6001118A /end MEASUREMENT
/begin MEASUREMENT ComScl_EngLin_RawSignal_Lin_BS_Signal_B_IOP_ERROR_1_r_msg_b "NetworkSignal ComScl_EngLin_RawSignal_Lin_BS_Signal_B_IOP_ERROR_1_r_msg_b" UBYTE RB_RBA_Common_CentralElements_CompuMethods_Identical 1 100 0.0 255. FORMAT "%10.0" ECU_ADDRESS 0x6001117F /end MEASUREMENT
/begin MEASUREMENT ComScl_EngLin_RawSignal_Lin_BS_Signal_B_MEASDR_2_r_msg_u8 "NetworkSignal ComScl_EngLin_RawSignal_Lin_BS_Signal_B_MEASDR_2_r_msg_u8" UBYTE RB_RBA_Common_CentralElements_CompuMethods_Identical 1 100 0.0 255. FORMAT "%10.0" ECU_ADDRESS 0x6001116B /end MEASUREMENT
/begin MEASUREMENT ComScl_EngLin_RawSignal_Lin_BS_Signal_B_RESMEASDBATT_16_r_msg_u16 "NetworkSignal ComScl_EngLin_RawSignal_Lin_BS_Signal_B_RESMEASDBATT_16_r_msg_u16" UWORD RB_RBA_Common_CentralElements_CompuMethods_Identical 1 100 0.0 65535. FORMAT "%10.0" ECU_ADDRESS 0x6000ABF4 /end MEASUREMENT
/begin MEASUREMENT ComScl_EngLin_RawSignal_Lin_BS_Signal_B_RI_ST_OTHER_MEASURE_16_r_msg_u16 "NetworkSignal ComScl_EngLin_RawSignal_Lin_BS_Signal_B_RI_ST_OTHER_MEASURE_16_r_msg_u16" UWORD RB_RBA_Common_CentralElements_CompuMethods_Identical 1 100 0.0 65535. FORMAT "%10.0" ECU_ADDRESS 0x6000ABF2 /end MEASUREMENT
/begin MEASUREMENT ComScl_EngLin_RawSignal_Lin_BS_Signal_B_SOC_8_r_msg_u8 "NetworkSignal ComScl_EngLin_RawSignal_Lin_BS_Signal_B_SOC_8_r_msg_u8" UBYTE RB_RBA_Common_CentralElements_CompuMethods_Identical 1 100 0.0 255. FORMAT "%10.0" ECU_ADDRESS 0x6001117E /end MEASUREMENT
/begin MEASUREMENT ComScl_EngLin_RawSignal_Lin_BS_Signal_B_SOC_STATE_3_r_msg_u8 "NetworkSignal ComScl_EngLin_RawSignal_Lin_BS_Signal_B_SOC_STATE_3_r_msg_u8" UBYTE RB_RBA_Common_CentralElements_CompuMethods_Identical 1 100 0.0 255. FORMAT "%10.0" ECU_ADDRESS 0x6001117D /end MEASUREMENT
/begin MEASUREMENT ComScl_EngLin_RawSignal_Lin_BS_Signal_B_SOFV_RESTART_8_r_msg_u8 "NetworkSignal ComScl_EngLin_RawSignal_Lin_BS_Signal_B_SOFV_RESTART_8_r_msg_u8" UBYTE RB_RBA_Common_CentralElements_CompuMethods_Identical 1 100 0.0 255. FORMAT "%10.0" ECU_ADDRESS 0x60011175 /end MEASUREMENT
/begin MEASUREMENT ComScl_EngLin_RawSignal_Lin_BS_Signal_B_SOFV_RESTART_STATE_1_r_msg_b "NetworkSignal ComScl_EngLin_RawSignal_Lin_BS_Signal_B_SOFV_RESTART_STATE_1_r_msg_b" UBYTE RB_RBA_Common_CentralElements_CompuMethods_Identical 1 100 0.0 255. FORMAT "%10.0" ECU_ADDRESS 0x60011174 /end MEASUREMENT
/begin MEASUREMENT ComScl_EngLin_RawSignal_Lin_BS_Signal_B_SOH_COR_8_r_msg_u8 "NetworkSignal ComScl_EngLin_RawSignal_Lin_BS_Signal_B_SOH_COR_8_r_msg_u8" UBYTE RB_RBA_Common_CentralElements_CompuMethods_Identical 1 100 0.0 255. FORMAT "%10.0" ECU_ADDRESS 0x60011173 /end MEASUREMENT
/begin MEASUREMENT ComScl_EngLin_RawSignal_Lin_BS_Signal_B_SOH_COR_STATE_1_r_msg_b "NetworkSignal ComScl_EngLin_RawSignal_Lin_BS_Signal_B_SOH_COR_STATE_1_r_msg_b" UBYTE RB_RBA_Common_CentralElements_CompuMethods_Identical 1 100 0.0 255. FORMAT "%10.0" ECU_ADDRESS 0x60011172 /end MEASUREMENT
/begin MEASUREMENT ComScl_EngLin_RawSignal_Lin_BS_Signal_B_SOH_LAM_8_r_msg_u8 "NetworkSignal ComScl_EngLin_RawSignal_Lin_BS_Signal_B_SOH_LAM_8_r_msg_u8" UBYTE RB_RBA_Common_CentralElements_CompuMethods_Identical 1 100 0.0 255. FORMAT "%10.0" ECU_ADDRESS 0x60011171 /end MEASUREMENT
/begin MEASUREMENT ComScl_EngLin_RawSignal_Lin_BS_Signal_B_SOH_LAM_STATE_1_r_msg_b "NetworkSignal ComScl_EngLin_RawSignal_Lin_BS_Signal_B_SOH_LAM_STATE_1_r_msg_b" UBYTE RB_RBA_Common_CentralElements_CompuMethods_Identical 1 100 0.0 255. FORMAT "%10.0" ECU_ADDRESS 0x60011170 /end MEASUREMENT
/begin MEASUREMENT ComScl_EngLin_RawSignal_Lin_BS_Signal_B_SOH_SUL_8_r_msg_u8 "NetworkSignal ComScl_EngLin_RawSignal_Lin_BS_Signal_B_SOH_SUL_8_r_msg_u8" UBYTE RB_RBA_Common_CentralElements_CompuMethods_Identical 1 100 0.0 255. FORMAT "%10.0" ECU_ADDRESS 0x6001116F /end MEASUREMENT
/begin MEASUREMENT ComScl_EngLin_RawSignal_Lin_BS_Signal_B_SOH_SUL_STATE_1_r_msg_b "NetworkSignal ComScl_EngLin_RawSignal_Lin_BS_Signal_B_SOH_SUL_STATE_1_r_msg_b" UBYTE RB_RBA_Common_CentralElements_CompuMethods_Identical 1 100 0.0 255. FORMAT "%10.0" ECU_ADDRESS 0x6001116E /end MEASUREMENT
/begin MEASUREMENT ComScl_EngLin_RawSignal_Lin_BS_Signal_B_SUPPLIER_CODE_8_r_msg_u8 "NetworkSignal ComScl_EngLin_RawSignal_Lin_BS_Signal_B_SUPPLIER_CODE_8_r_msg_u8" UBYTE RB_RBA_Common_CentralElements_CompuMethods_Identical 1 100 0.0 255. FORMAT "%10.0" ECU_ADDRESS 0x6001117C /end MEASUREMENT
/begin MEASUREMENT ComScl_EngLin_RawSignal_Lin_BS_Signal_B_TBAT_8_r_msg_u8 "NetworkSignal ComScl_EngLin_RawSignal_Lin_BS_Signal_B_TBAT_8_r_msg_u8" UBYTE RB_RBA_Common_CentralElements_CompuMethods_Identical 1 100 0.0 255. FORMAT "%10.0" ECU_ADDRESS 0x6001117B /end MEASUREMENT
/begin MEASUREMENT ComScl_EngLin_RawSignal_Lin_BS_Signal_B_UBAT_16_r_msg_u16 "NetworkSignal ComScl_EngLin_RawSignal_Lin_BS_Signal_B_UBAT_16_r_msg_u16" UWORD RB_RBA_Common_CentralElements_CompuMethods_Identical 1 100 0.0 65535. FORMAT "%10.0" ECU_ADDRESS 0x6000AC04 /end MEASUREMENT
/begin MEASUREMENT ComScl_EngLin_RawSignal_Lin_BS_Signal_B_iStByCurrAft0h_10_r_msg_u16 "NetworkSignal ComScl_EngLin_RawSignal_Lin_BS_Signal_B_iStByCurrAft0h_10_r_msg_u16" UWORD RB_RBA_Common_CentralElements_CompuMethods_Identical 1 100 0.0 65535. FORMAT "%10.0" ECU_ADDRESS 0x6000ABFC /end MEASUREMENT
/begin MEASUREMENT ComScl_EngLin_RawSignal_Lin_BS_Signal_B_iStByCurrAft1h_10_r_msg_u16 "NetworkSignal ComScl_EngLin_RawSignal_Lin_BS_Signal_B_iStByCurrAft1h_10_r_msg_u16" UWORD RB_RBA_Common_CentralElements_CompuMethods_Identical 1 100 0.0 65535. FORMAT "%10.0" ECU_ADDRESS 0x6000ABFA /end MEASUREMENT
/begin MEASUREMENT ComScl_EngLin_RawSignal_Lin_BS_Signal_B_iStByCurrAft2h_10_r_msg_u16 "NetworkSignal ComScl_EngLin_RawSignal_Lin_BS_Signal_B_iStByCurrAft2h_10_r_msg_u16" UWORD RB_RBA_Common_CentralElements_CompuMethods_Identical 1 100 0.0 65535. FORMAT "%10.0" ECU_ADDRESS 0x6000ABF8 /end MEASUREMENT
/begin MEASUREMENT ComScl_EngLin_RawSignal_Lin_BS_Signal_B_iStByCurrLst_10_r_msg_u16 "NetworkSignal ComScl_EngLin_RawSignal_Lin_BS_Signal_B_iStByCurrLst_10_r_msg_u16" UWORD RB_RBA_Common_CentralElements_CompuMethods_Identical 1 100 0.0 65535. FORMAT "%10.0" ECU_ADDRESS 0x6000ABF6 /end MEASUREMENT
/begin MEASUREMENT ComScl_EngLin_RawSignal_Lin_BS_Signal_CHARERR_1_r_msg_b "NetworkSignal ComScl_EngLin_RawSignal_Lin_BS_Signal_CHARERR_1_r_msg_b" UBYTE RB_RBA_Common_CentralElements_CompuMethods_Identical 1 100 0.0 255. FORMAT "%10.0" ECU_ADDRESS 0x60011189 /end MEASUREMENT
/begin MEASUREMENT ComScl_EngLin_RawSignal_Lin_BS_Signal_ERRCMN_1_r_msg_b "NetworkSignal ComScl_EngLin_RawSignal_Lin_BS_Signal_ERRCMN_1_r_msg_b" UBYTE RB_RBA_Common_CentralElements_CompuMethods_Identical 1 100 0.0 255. FORMAT "%10.0" ECU_ADDRESS 0x60011188 /end MEASUREMENT
/begin MEASUREMENT ComScl_EngLin_RawSignal_Lin_BS_Signal_ERRST_1_r_msg_b "NetworkSignal ComScl_EngLin_RawSignal_Lin_BS_Signal_ERRST_1_r_msg_b" UBYTE RB_RBA_Common_CentralElements_CompuMethods_Identical 1 100 0.0 255. FORMAT "%10.0" ECU_ADDRESS 0x60011187 /end MEASUREMENT
/begin MEASUREMENT ComScl_EngLin_RawSignal_Lin_BS_Signal_IBATTAVGLINOFF_8_r_msg_u8 "NetworkSignal ComScl_EngLin_RawSignal_Lin_BS_Signal_IBATTAVGLINOFF_8_r_msg_u8" UBYTE RB_RBA_Common_CentralElements_CompuMethods_Identical 1 100 0.0 255. FORMAT "%10.0" ECU_ADDRESS 0x6001117A /end MEASUREMENT
/begin MEASUREMENT ComScl_EngLin_RawSignal_Lin_DCDC_Signal_nrSwVers_3_r_msg_u8 "NetworkSignal ComScl_EngLin_RawSignal_Lin_DCDC_Signal_nrSwVers_3_r_msg_u8" UBYTE RB_RBA_Common_CentralElements_CompuMethods_Identical 1 100 0.0 255. FORMAT "%10.0" ECU_ADDRESS 0x6001116A /end MEASUREMENT
/begin MEASUREMENT ComScl_EngLin_RawSignal_Lin_DCDC_Signal_stBoosterErr_1_r_msg_b "NetworkSignal ComScl_EngLin_RawSignal_Lin_DCDC_Signal_stBoosterErr_1_r_msg_b" UBYTE RB_RBA_Common_CentralElements_CompuMethods_Identical 1 100 0.0 255. FORMAT "%10.0" ECU_ADDRESS 0x60011169 /end MEASUREMENT
/begin MEASUREMENT ComScl_EngLin_RawSignal_Lin_DCDC_Signal_stCSTErr_1_r_msg_b "NetworkSignal ComScl_EngLin_RawSignal_Lin_DCDC_Signal_stCSTErr_1_r_msg_b" UBYTE RB_RBA_Common_CentralElements_CompuMethods_Identical 1 100 0.0 255. FORMAT "%10.0" ECU_ADDRESS 0x60011168 /end MEASUREMENT
/begin MEASUREMENT ComScl_EngLin_RawSignal_Lin_DCDC_Signal_stCSTHist_1_r_msg_b "NetworkSignal ComScl_EngLin_RawSignal_Lin_DCDC_Signal_stCSTHist_1_r_msg_b" UBYTE RB_RBA_Common_CentralElements_CompuMethods_Identical 1 100 0.0 255. FORMAT "%10.0" ECU_ADDRESS 0x60011167 /end MEASUREMENT
/begin MEASUREMENT ComScl_EngLin_RawSignal_Lin_DCDC_Signal_stDCLinRVer_1_r_msg_b "NetworkSignal ComScl_EngLin_RawSignal_Lin_DCDC_Signal_stDCLinRVer_1_r_msg_b" UBYTE RB_RBA_Common_CentralElements_CompuMethods_Identical 1 100 0.0 255. FORMAT "%10.0" ECU_ADDRESS 0x60011166 /end MEASUREMENT
/begin MEASUREMENT ComScl_EngLin_RawSignal_Lin_DCDC_Signal_stInpErr1_1_r_msg_b "NetworkSignal ComScl_EngLin_RawSignal_Lin_DCDC_Signal_stInpErr1_1_r_msg_b" UBYTE RB_RBA_Common_CentralElements_CompuMethods_Identical 1 100 0.0 255. FORMAT "%10.0" ECU_ADDRESS 0x60011165 /end MEASUREMENT
/begin MEASUREMENT ComScl_EngLin_RawSignal_Lin_DCDC_Signal_stInpErr2_1_r_msg_b "NetworkSignal ComScl_EngLin_RawSignal_Lin_DCDC_Signal_stInpErr2_1_r_msg_b" UBYTE RB_RBA_Common_CentralElements_CompuMethods_Identical 1 100 0.0 255. FORMAT "%10.0" ECU_ADDRESS 0x60011164 /end MEASUREMENT
/begin MEASUREMENT ComScl_EngLin_RawSignal_Lin_DCDC_Signal_stIntErr_1_r_msg_b "NetworkSignal ComScl_EngLin_RawSignal_Lin_DCDC_Signal_stIntErr_1_r_msg_b" UBYTE RB_RBA_Common_CentralElements_CompuMethods_Identical 1 100 0.0 255. FORMAT "%10.0" ECU_ADDRESS 0x60011163 /end MEASUREMENT
/begin MEASUREMENT ComScl_EngLin_RawSignal_Lin_DCDC_Signal_stMode_1_r_msg_b "NetworkSignal ComScl_EngLin_RawSignal_Lin_DCDC_Signal_stMode_1_r_msg_b" UBYTE RB_RBA_Common_CentralElements_CompuMethods_Identical 1 100 0.0 255. FORMAT "%10.0" ECU_ADDRESS 0x60011162 /end MEASUREMENT
/begin MEASUREMENT ComScl_EngLin_RawSignal_Lin_DCDC_Signal_stOutpErr1_1_r_msg_b "NetworkSignal ComScl_EngLin_RawSignal_Lin_DCDC_Signal_stOutpErr1_1_r_msg_b" UBYTE RB_RBA_Common_CentralElements_CompuMethods_Identical 1 100 0.0 255. FORMAT "%10.0" ECU_ADDRESS 0x60011161 /end MEASUREMENT
/begin MEASUREMENT ComScl_EngLin_RawSignal_Lin_DCDC_Signal_stOutpErr2_1_r_msg_b "NetworkSignal ComScl_EngLin_RawSignal_Lin_DCDC_Signal_stOutpErr2_1_r_msg_b" UBYTE RB_RBA_Common_CentralElements_CompuMethods_Identical 1 100 0.0 255. FORMAT "%10.0" ECU_ADDRESS 0x60011160 /end MEASUREMENT
/begin MEASUREMENT ComScl_EngLin_RawSignal_Lin_DCDC_Signal_stTempWarn1_1_r_msg_b "NetworkSignal ComScl_EngLin_RawSignal_Lin_DCDC_Signal_stTempWarn1_1_r_msg_b" UBYTE RB_RBA_Common_CentralElements_CompuMethods_Identical 1 100 0.0 255. FORMAT "%10.0" ECU_ADDRESS 0x6001115F /end MEASUREMENT
/begin MEASUREMENT ComScl_EngLin_RawSignal_Lin_DCDC_Signal_stTempWarn2_1_r_msg_b "NetworkSignal ComScl_EngLin_RawSignal_Lin_DCDC_Signal_stTempWarn2_1_r_msg_b" UBYTE RB_RBA_Common_CentralElements_CompuMethods_Identical 1 100 0.0 255. FORMAT "%10.0" ECU_ADDRESS 0x6001115E /end MEASUREMENT
/begin MEASUREMENT ComScl_EngLin_RawSignal_Lin_DCDC_Signal_stUnitSt_1_r_msg_b "NetworkSignal ComScl_EngLin_RawSignal_Lin_DCDC_Signal_stUnitSt_1_r_msg_b" UBYTE RB_RBA_Common_CentralElements_CompuMethods_Identical 1 100 0.0 255. FORMAT "%10.0" ECU_ADDRESS 0x6001115D /end MEASUREMENT
/begin MEASUREMENT ComScl_Gbx_RawSignal_CVT_MISS_MILON_REQ_FLAG_b "NetworkSignal ComScl_Gbx_RawSignal_CVT_MISS_MILON_REQ_FLAG_b" UBYTE RB_RBA_Common_CentralElements_CompuMethods_Identical 1 100 0.0 255. FORMAT "%10.0" ECU_ADDRESS 0x600111A4 /end MEASUREMENT
/begin MEASUREMENT ComScl_Gbx_RawSignal_CVT_MISS_VSENS_FAIL_FLAG_b "NetworkSignal ComScl_Gbx_RawSignal_CVT_MISS_VSENS_FAIL_FLAG_b" UBYTE RB_RBA_Common_CentralElements_CompuMethods_Identical 1 100 0.0 255. FORMAT "%10.0" ECU_ADDRESS 0x600111A3 /end MEASUREMENT
/begin MEASUREMENT ComScl_Gbx_RawSignal_CVT_MISS_VSENS_OK_FLAG_b "NetworkSignal ComScl_Gbx_RawSignal_CVT_MISS_VSENS_OK_FLAG_b" UBYTE RB_RBA_Common_CentralElements_CompuMethods_Identical 1 100 0.0 255. FORMAT "%10.0" ECU_ADDRESS 0x600111A2 /end MEASUREMENT
/begin MEASUREMENT ComScl_Gbx_RawSignal_CVT_MISS_VSENS_TFCD_FLAG_b "NetworkSignal ComScl_Gbx_RawSignal_CVT_MISS_VSENS_TFCD_FLAG_b" UBYTE RB_RBA_Common_CentralElements_CompuMethods_Identical 1 100 0.0 255. FORMAT "%10.0" ECU_ADDRESS 0x600111A1 /end MEASUREMENT
/begin MEASUREMENT ComScl_Gbx_RawSignal_CVT_RATIO_INFO_191_u8 "NetworkSignal ComScl_Gbx_RawSignal_CVT_RATIO_INFO_191_u8" UBYTE RB_RBA_Common_CentralElements_CompuMethods_Identical 1 100 0.0 255. FORMAT "%10.0" ECU_ADDRESS 0x600111A0 /end MEASUREMENT
/begin MEASUREMENT ComScl_Gbx_RawSignal_CVT_SHFT_IN_D_b "NetworkSignal ComScl_Gbx_RawSignal_CVT_SHFT_IN_D_b" UBYTE RB_RBA_Common_CentralElements_CompuMethods_Identical 1 100 0.0 255. FORMAT "%10.0" ECU_ADDRESS 0x6001119F /end MEASUREMENT
/begin MEASUREMENT ComScl_Gbx_RawSignal_CVT_SHFT_IN_L_b "NetworkSignal ComScl_Gbx_RawSignal_CVT_SHFT_IN_L_b" UBYTE RB_RBA_Common_CentralElements_CompuMethods_Identical 1 100 0.0 255. FORMAT "%10.0" ECU_ADDRESS 0x6001119E /end MEASUREMENT
/begin MEASUREMENT ComScl_Gbx_RawSignal_CVT_SHFT_IN_NEUTRAL_b "NetworkSignal ComScl_Gbx_RawSignal_CVT_SHFT_IN_NEUTRAL_b" UBYTE RB_RBA_Common_CentralElements_CompuMethods_Identical 1 100 0.0 255. FORMAT "%10.0" ECU_ADDRESS 0x6001119D /end MEASUREMENT
/begin MEASUREMENT ComScl_Gbx_RawSignal_CVT_SHFT_IN_PARKING_b "NetworkSignal ComScl_Gbx_RawSignal_CVT_SHFT_IN_PARKING_b" UBYTE RB_RBA_Common_CentralElements_CompuMethods_Identical 1 100 0.0 255. FORMAT "%10.0" ECU_ADDRESS 0x6001119C /end MEASUREMENT
/begin MEASUREMENT ComScl_Gbx_RawSignal_CVT_SHFT_IN_REVERSE_b "NetworkSignal ComScl_Gbx_RawSignal_CVT_SHFT_IN_REVERSE_b" UBYTE RB_RBA_Common_CentralElements_CompuMethods_Identical 1 100 0.0 255. FORMAT "%10.0" ECU_ADDRESS 0x6001119B /end MEASUREMENT
/begin MEASUREMENT ComScl_Gbx_RawSignal_CVT_SHFT_IN_S_b "NetworkSignal ComScl_Gbx_RawSignal_CVT_SHFT_IN_S_b" UBYTE RB_RBA_Common_CentralElements_CompuMethods_Identical 1 100 0.0 255. FORMAT "%10.0" ECU_ADDRESS 0x6001119A /end MEASUREMENT
/begin MEASUREMENT ComScl_Gbx_RawSignal_CVT_SHIFT_SURE_b "NetworkSignal ComScl_Gbx_RawSignal_CVT_SHIFT_SURE_b" UBYTE RB_RBA_Common_CentralElements_CompuMethods_Identical 1 100 0.0 255. FORMAT "%10.0" ECU_ADDRESS 0x60011199 /end MEASUREMENT
/begin MEASUREMENT ComScl_Gbx_RawSignal_CVT_TRANS_MIL_b "NetworkSignal ComScl_Gbx_RawSignal_CVT_TRANS_MIL_b" UBYTE RB_RBA_Common_CentralElements_CompuMethods_Identical 1 100 0.0 255. FORMAT "%10.0" ECU_ADDRESS 0x60011198 /end MEASUREMENT
/begin MEASUREMENT ComScl_Gbx_RawSignal_EAT_ALIVE_COUNTER_158_u8 "NetworkSignal ComScl_Gbx_RawSignal_EAT_ALIVE_COUNTER_158_u8" UBYTE RB_RBA_Common_CentralElements_CompuMethods_Identical 1 100 0.0 255. FORMAT "%10.0" ECU_ADDRESS 0x600111A7 /end MEASUREMENT
/begin MEASUREMENT ComScl_Gbx_RawSignal_EAT_ALIVE_COUNTER_191_u8 "NetworkSignal ComScl_Gbx_RawSignal_EAT_ALIVE_COUNTER_191_u8" UBYTE RB_RBA_Common_CentralElements_CompuMethods_Identical 1 100 0.0 255. FORMAT "%10.0" ECU_ADDRESS 0x60011197 /end MEASUREMENT
/begin MEASUREMENT ComScl_Gbx_RawSignal_EAT_ALIVE_COUNTER_41B_u8 "NetworkSignal ComScl_Gbx_RawSignal_EAT_ALIVE_COUNTER_41B_u8" UBYTE RB_RBA_Common_CentralElements_CompuMethods_Identical 1 100 0.0 255. FORMAT "%10.0" ECU_ADDRESS 0x600111C1 /end MEASUREMENT
/begin MEASUREMENT ComScl_Gbx_RawSignal_EAT_ATF_TEMP_INVALID_b "NetworkSignal ComScl_Gbx_RawSignal_EAT_ATF_TEMP_INVALID_b" UBYTE RB_RBA_Common_CentralElements_CompuMethods_Identical 1 100 0.0 255. FORMAT "%10.0" ECU_ADDRESS 0x600111C0 /end MEASUREMENT
/begin MEASUREMENT ComScl_Gbx_RawSignal_EAT_CHECKSUM_158_u8 "NetworkSignal ComScl_Gbx_RawSignal_EAT_CHECKSUM_158_u8" UBYTE RB_RBA_Common_CentralElements_CompuMethods_Identical 1 100 0.0 255. FORMAT "%10.0" ECU_ADDRESS 0x600111A6 /end MEASUREMENT
/begin MEASUREMENT ComScl_Gbx_RawSignal_EAT_CHECKSUM_191_u8 "NetworkSignal ComScl_Gbx_RawSignal_EAT_CHECKSUM_191_u8" UBYTE RB_RBA_Common_CentralElements_CompuMethods_Identical 1 100 0.0 255. FORMAT "%10.0" ECU_ADDRESS 0x60011196 /end MEASUREMENT
/begin MEASUREMENT ComScl_Gbx_RawSignal_EAT_CHECKSUM_41B_u8 "NetworkSignal ComScl_Gbx_RawSignal_EAT_CHECKSUM_41B_u8" UBYTE RB_RBA_Common_CentralElements_CompuMethods_Identical 1 100 0.0 255. FORMAT "%10.0" ECU_ADDRESS 0x600111BF /end MEASUREMENT
/begin MEASUREMENT ComScl_Gbx_RawSignal_EAT_REF_DISTANCE_TRAVELLED_u8 "NetworkSignal ComScl_Gbx_RawSignal_EAT_REF_DISTANCE_TRAVELLED_u8" UBYTE RB_RBA_Common_CentralElements_CompuMethods_Identical 1 100 0.0 255. FORMAT "%10.0" ECU_ADDRESS 0x600111A5 /end MEASUREMENT
/begin MEASUREMENT ComScl_Gbx_RawSignal_EAT_TRANS_MAIN_SHAFT_SPEED_u16 "NetworkSignal ComScl_Gbx_RawSignal_EAT_TRANS_MAIN_SHAFT_SPEED_u16" UWORD RB_RBA_Common_CentralElements_CompuMethods_Identical 1 100 0.0 65535. FORMAT "%10.0" ECU_ADDRESS 0x6000AC10 /end MEASUREMENT
/begin MEASUREMENT ComScl_Gbx_RawSignal_EAT_TRANS_SPEED_VNC_u16 "NetworkSignal ComScl_Gbx_RawSignal_EAT_TRANS_SPEED_VNC_u16" UWORD RB_RBA_Common_CentralElements_CompuMethods_Identical 1 100 0.0 65535. FORMAT "%10.0" ECU_ADDRESS 0x6000AC0C /end MEASUREMENT
/begin MEASUREMENT ComScl_Gbx_RawSignal_EAT_TRANS_SPEED_u16 "NetworkSignal ComScl_Gbx_RawSignal_EAT_TRANS_SPEED_u16" UWORD RB_RBA_Common_CentralElements_CompuMethods_Identical 1 100 0.0 65535. FORMAT "%10.0" ECU_ADDRESS 0x6000AC0E /end MEASUREMENT
/begin MEASUREMENT ComScl_Gbx_RawSignal_TM_ALCZONE_u8 "NetworkSignal ComScl_Gbx_RawSignal_TM_ALCZONE_u8" UBYTE RB_RBA_Common_CentralElements_CompuMethods_Identical 1 100 0.0 255. FORMAT "%10.0" ECU_ADDRESS 0x600111CB /end MEASUREMENT
/begin MEASUREMENT ComScl_Gbx_RawSignal_TM_ALIVE_COUNTER_071_u8 "NetworkSignal ComScl_Gbx_RawSignal_TM_ALIVE_COUNTER_071_u8" UBYTE RB_RBA_Common_CentralElements_CompuMethods_Identical 1 100 0.0 255. FORMAT "%10.0" ECU_ADDRESS 0x600111BD /end MEASUREMENT
/begin MEASUREMENT ComScl_Gbx_RawSignal_TM_ALIVE_COUNTER_072_u8 "NetworkSignal ComScl_Gbx_RawSignal_TM_ALIVE_COUNTER_072_u8" UBYTE RB_RBA_Common_CentralElements_CompuMethods_Identical 1 100 0.0 255. FORMAT "%10.0" ECU_ADDRESS 0x600111B1 /end MEASUREMENT
/begin MEASUREMENT ComScl_Gbx_RawSignal_TM_ALIVE_COUNTER_07B_u8 "NetworkSignal ComScl_Gbx_RawSignal_TM_ALIVE_COUNTER_07B_u8" UBYTE RB_RBA_Common_CentralElements_CompuMethods_Identical 1 100 0.0 255. FORMAT "%10.0" ECU_ADDRESS 0x600111D7 /end MEASUREMENT
/begin MEASUREMENT ComScl_Gbx_RawSignal_TM_ALIVE_COUNTER_07C_u8 "NetworkSignal ComScl_Gbx_RawSignal_TM_ALIVE_COUNTER_07C_u8" UBYTE RB_RBA_Common_CentralElements_CompuMethods_Identical 1 100 0.0 255. FORMAT "%10.0" ECU_ADDRESS 0x600111D9 /end MEASUREMENT
/begin MEASUREMENT ComScl_Gbx_RawSignal_TM_ALIVE_COUNTER_07E_u8 "NetworkSignal ComScl_Gbx_RawSignal_TM_ALIVE_COUNTER_07E_u8" UBYTE RB_RBA_Common_CentralElements_CompuMethods_Identical 1 100 0.0 255. FORMAT "%10.0" ECU_ADDRESS 0x600111CA /end MEASUREMENT
/begin MEASUREMENT ComScl_Gbx_RawSignal_TM_ALIVE_COUNTER_19D_u8 "NetworkSignal ComScl_Gbx_RawSignal_TM_ALIVE_COUNTER_19D_u8" UBYTE RB_RBA_Common_CentralElements_CompuMethods_Identical 1 100 0.0 255. FORMAT "%10.0" ECU_ADDRESS 0x600111C6 /end MEASUREMENT
/begin MEASUREMENT ComScl_Gbx_RawSignal_TM_ALIVE_COUNTER_1BF_u8 "NetworkSignal ComScl_Gbx_RawSignal_TM_ALIVE_COUNTER_1BF_u8" UBYTE RB_RBA_Common_CentralElements_CompuMethods_Identical 1 100 0.0 255. FORMAT "%10.0" ECU_ADDRESS 0x600111D5 /end MEASUREMENT
/begin MEASUREMENT ComScl_Gbx_RawSignal_TM_ALIVE_COUNTER_1F0_u8 "NetworkSignal ComScl_Gbx_RawSignal_TM_ALIVE_COUNTER_1F0_u8" UBYTE RB_RBA_Common_CentralElements_CompuMethods_Identical 1 100 0.0 255. FORMAT "%10.0" ECU_ADDRESS 0x600111DF /end MEASUREMENT
/begin MEASUREMENT ComScl_Gbx_RawSignal_TM_ALIVE_COUNTER_351_u8 "NetworkSignal ComScl_Gbx_RawSignal_TM_ALIVE_COUNTER_351_u8" UBYTE RB_RBA_Common_CentralElements_CompuMethods_Identical 1 100 0.0 255. FORMAT "%10.0" ECU_ADDRESS 0x600111D0 /end MEASUREMENT
/begin MEASUREMENT ComScl_Gbx_RawSignal_TM_ALIVE_COUNTER_40B_u8 "NetworkSignal ComScl_Gbx_RawSignal_TM_ALIVE_COUNTER_40B_u8" UBYTE RB_RBA_Common_CentralElements_CompuMethods_Identical 1 100 0.0 255. FORMAT "%10.0" ECU_ADDRESS 0x60011195 /end MEASUREMENT
/begin MEASUREMENT ComScl_Gbx_RawSignal_TM_ATF_TEMP_u8 "NetworkSignal ComScl_Gbx_RawSignal_TM_ATF_TEMP_u8" UBYTE RB_RBA_Common_CentralElements_CompuMethods_Identical 1 100 0.0 255. FORMAT "%10.0" ECU_ADDRESS 0x600111BE /end MEASUREMENT
/begin MEASUREMENT ComScl_Gbx_RawSignal_TM_AT_CC_FWD_b "NetworkSignal ComScl_Gbx_RawSignal_TM_AT_CC_FWD_b" UBYTE RB_RBA_Common_CentralElements_CompuMethods_Identical 1 100 0.0 255. FORMAT "%10.0" ECU_ADDRESS 0x600111B0 /end MEASUREMENT
/begin MEASUREMENT ComScl_Gbx_RawSignal_TM_CHECKSUM_071_u8 "NetworkSignal ComScl_Gbx_RawSignal_TM_CHECKSUM_071_u8" UBYTE RB_RBA_Common_CentralElements_CompuMethods_Identical 1 100 0.0 255. FORMAT "%10.0" ECU_ADDRESS 0x600111BC /end MEASUREMENT
/begin MEASUREMENT ComScl_Gbx_RawSignal_TM_CHECKSUM_072_u8 "NetworkSignal ComScl_Gbx_RawSignal_TM_CHECKSUM_072_u8" UBYTE RB_RBA_Common_CentralElements_CompuMethods_Identical 1 100 0.0 255. FORMAT "%10.0" ECU_ADDRESS 0x600111AF /end MEASUREMENT
/begin MEASUREMENT ComScl_Gbx_RawSignal_TM_CHECKSUM_07B_u8 "NetworkSignal ComScl_Gbx_RawSignal_TM_CHECKSUM_07B_u8" UBYTE RB_RBA_Common_CentralElements_CompuMethods_Identical 1 100 0.0 255. FORMAT "%10.0" ECU_ADDRESS 0x600111D6 /end MEASUREMENT
/begin MEASUREMENT ComScl_Gbx_RawSignal_TM_CHECKSUM_07C_u8 "NetworkSignal ComScl_Gbx_RawSignal_TM_CHECKSUM_07C_u8" UBYTE RB_RBA_Common_CentralElements_CompuMethods_Identical 1 100 0.0 255. FORMAT "%10.0" ECU_ADDRESS 0x600111D8 /end MEASUREMENT
/begin MEASUREMENT ComScl_Gbx_RawSignal_TM_CHECKSUM_07E_u8 "NetworkSignal ComScl_Gbx_RawSignal_TM_CHECKSUM_07E_u8" UBYTE RB_RBA_Common_CentralElements_CompuMethods_Identical 1 100 0.0 255. FORMAT "%10.0" ECU_ADDRESS 0x600111C9 /end MEASUREMENT
/begin MEASUREMENT ComScl_Gbx_RawSignal_TM_CHECKSUM_19D_u8 "NetworkSignal ComScl_Gbx_RawSignal_TM_CHECKSUM_19D_u8" UBYTE RB_RBA_Common_CentralElements_CompuMethods_Identical 1 100 0.0 255. FORMAT "%10.0" ECU_ADDRESS 0x600111C5 /end MEASUREMENT
/begin MEASUREMENT ComScl_Gbx_RawSignal_TM_CHECKSUM_1BF_u8 "NetworkSignal ComScl_Gbx_RawSignal_TM_CHECKSUM_1BF_u8" UBYTE RB_RBA_Common_CentralElements_CompuMethods_Identical 1 100 0.0 255. FORMAT "%10.0" ECU_ADDRESS 0x600111D4 /end MEASUREMENT
/begin MEASUREMENT ComScl_Gbx_RawSignal_TM_CHECKSUM_1F0_u8 "NetworkSignal ComScl_Gbx_RawSignal_TM_CHECKSUM_1F0_u8" UBYTE RB_RBA_Common_CentralElements_CompuMethods_Identical 1 100 0.0 255. FORMAT "%10.0" ECU_ADDRESS 0x600111DE /end MEASUREMENT
/begin MEASUREMENT ComScl_Gbx_RawSignal_TM_CHECKSUM_351_u8 "NetworkSignal ComScl_Gbx_RawSignal_TM_CHECKSUM_351_u8" UBYTE RB_RBA_Common_CentralElements_CompuMethods_Identical 1 100 0.0 255. FORMAT "%10.0" ECU_ADDRESS 0x600111CF /end MEASUREMENT
/begin MEASUREMENT ComScl_Gbx_RawSignal_TM_CHECKSUM_40B_u8 "NetworkSignal ComScl_Gbx_RawSignal_TM_CHECKSUM_40B_u8" UBYTE RB_RBA_Common_CentralElements_CompuMethods_Identical 1 100 0.0 255. FORMAT "%10.0" ECU_ADDRESS 0x60011194 /end MEASUREMENT
/begin MEASUREMENT ComScl_Gbx_RawSignal_TM_CVTNP_FLAG_b "NetworkSignal ComScl_Gbx_RawSignal_TM_CVTNP_FLAG_b" UBYTE RB_RBA_Common_CentralElements_CompuMethods_Identical 1 100 0.0 255. FORMAT "%10.0" ECU_ADDRESS 0x600111AE /end MEASUREMENT
/begin MEASUREMENT ComScl_Gbx_RawSignal_TM_DEC_FC_LC_OK_b "NetworkSignal ComScl_Gbx_RawSignal_TM_DEC_FC_LC_OK_b" UBYTE RB_RBA_Common_CentralElements_CompuMethods_Identical 1 100 0.0 255. FORMAT "%10.0" ECU_ADDRESS 0x600111AD /end MEASUREMENT
/begin MEASUREMENT ComScl_Gbx_RawSignal_TM_ECON_POS_FAIL_OK_b "NetworkSignal ComScl_Gbx_RawSignal_TM_ECON_POS_FAIL_OK_b" UBYTE RB_RBA_Common_CentralElements_CompuMethods_Identical 1 100 0.0 255. FORMAT "%10.0" ECU_ADDRESS 0x600111BB /end MEASUREMENT
/begin MEASUREMENT ComScl_Gbx_RawSignal_TM_FAULT_ACTION_STATUS_VSP_FAIL_b "NetworkSignal ComScl_Gbx_RawSignal_TM_FAULT_ACTION_STATUS_VSP_FAIL_b" UBYTE RB_RBA_Common_CentralElements_CompuMethods_Identical 1 100 0.0 255. FORMAT "%10.0" ECU_ADDRESS 0x600111AC /end MEASUREMENT
/begin MEASUREMENT ComScl_Gbx_RawSignal_TM_F_DFTRFENTM_b "NetworkSignal ComScl_Gbx_RawSignal_TM_F_DFTRFENTM_b" UBYTE RB_RBA_Common_CentralElements_CompuMethods_Identical 1 100 0.0 255. FORMAT "%10.0" ECU_ADDRESS 0x600111DD /end MEASUREMENT
/begin MEASUREMENT ComScl_Gbx_RawSignal_TM_GEARPOS_N_DET_b "NetworkSignal ComScl_Gbx_RawSignal_TM_GEARPOS_N_DET_b" UBYTE RB_RBA_Common_CentralElements_CompuMethods_Identical 1 100 0.0 255. FORMAT "%10.0" ECU_ADDRESS 0x600111D3 /end MEASUREMENT
/begin MEASUREMENT ComScl_Gbx_RawSignal_TM_GEARPOS_P_DETSUB_b "NetworkSignal ComScl_Gbx_RawSignal_TM_GEARPOS_P_DETSUB_b" UBYTE RB_RBA_Common_CentralElements_CompuMethods_Identical 1 100 0.0 255. FORMAT "%10.0" ECU_ADDRESS 0x600111CE /end MEASUREMENT
/begin MEASUREMENT ComScl_Gbx_RawSignal_TM_GEARPOS_P_DET_b "NetworkSignal ComScl_Gbx_RawSignal_TM_GEARPOS_P_DET_b" UBYTE RB_RBA_Common_CentralElements_CompuMethods_Identical 1 100 0.0 255. FORMAT "%10.0" ECU_ADDRESS 0x600111D2 /end MEASUREMENT
/begin MEASUREMENT ComScl_Gbx_RawSignal_TM_GEARPOS_P_REQSUB_b "NetworkSignal ComScl_Gbx_RawSignal_TM_GEARPOS_P_REQSUB_b" UBYTE RB_RBA_Common_CentralElements_CompuMethods_Identical 1 100 0.0 255. FORMAT "%10.0" ECU_ADDRESS 0x600111CD /end MEASUREMENT
/begin MEASUREMENT ComScl_Gbx_RawSignal_TM_HACCUT_REQ_b "NetworkSignal ComScl_Gbx_RawSignal_TM_HACCUT_REQ_b" UBYTE RB_RBA_Common_CentralElements_CompuMethods_Identical 1 100 0.0 255. FORMAT "%10.0" ECU_ADDRESS 0x600111BA /end MEASUREMENT
/begin MEASUREMENT ComScl_Gbx_RawSignal_TM_HEAVY_DEC_FLAG_b "NetworkSignal ComScl_Gbx_RawSignal_TM_HEAVY_DEC_FLAG_b" UBYTE RB_RBA_Common_CentralElements_CompuMethods_Identical 1 100 0.0 255. FORMAT "%10.0" ECU_ADDRESS 0x600111B9 /end MEASUREMENT
/begin MEASUREMENT ComScl_Gbx_RawSignal_TM_IDLE_STOP_CONDITION_b "NetworkSignal ComScl_Gbx_RawSignal_TM_IDLE_STOP_CONDITION_b" UBYTE RB_RBA_Common_CentralElements_CompuMethods_Identical 1 100 0.0 255. FORMAT "%10.0" ECU_ADDRESS 0x600111DC /end MEASUREMENT
/begin MEASUREMENT ComScl_Gbx_RawSignal_TM_IDLE_STOP_OK_b "NetworkSignal ComScl_Gbx_RawSignal_TM_IDLE_STOP_OK_b" UBYTE RB_RBA_Common_CentralElements_CompuMethods_Identical 1 100 0.0 255. FORMAT "%10.0" ECU_ADDRESS 0x600111DB /end MEASUREMENT
/begin MEASUREMENT ComScl_Gbx_RawSignal_TM_IDLE_STOP_TRIGGER_b "NetworkSignal ComScl_Gbx_RawSignal_TM_IDLE_STOP_TRIGGER_b" UBYTE RB_RBA_Common_CentralElements_CompuMethods_Identical 1 100 0.0 255. FORMAT "%10.0" ECU_ADDRESS 0x600111DA /end MEASUREMENT
/begin MEASUREMENT ComScl_Gbx_RawSignal_TM_IG1_STATE_b "NetworkSignal ComScl_Gbx_RawSignal_TM_IG1_STATE_b" UBYTE RB_RBA_Common_CentralElements_CompuMethods_Identical 1 100 0.0 255. FORMAT "%10.0" ECU_ADDRESS 0x60011193 /end MEASUREMENT
/begin MEASUREMENT ComScl_Gbx_RawSignal_TM_IG1_VOLTAGE_u16 "NetworkSignal ComScl_Gbx_RawSignal_TM_IG1_VOLTAGE_u16" UWORD RB_RBA_Common_CentralElements_CompuMethods_Identical 1 100 0.0 65535. FORMAT "%10.0" ECU_ADDRESS 0x6000AC0A /end MEASUREMENT
/begin MEASUREMENT ComScl_Gbx_RawSignal_TM_LC_INFORMATION_u8 "NetworkSignal ComScl_Gbx_RawSignal_TM_LC_INFORMATION_u8" UBYTE RB_RBA_Common_CentralElements_CompuMethods_Identical 1 100 0.0 255. FORMAT "%10.0" ECU_ADDRESS 0x600111AB /end MEASUREMENT
/begin MEASUREMENT ComScl_Gbx_RawSignal_TM_LIMP_HOME_MODE_b "NetworkSignal ComScl_Gbx_RawSignal_TM_LIMP_HOME_MODE_b" UBYTE RB_RBA_Common_CentralElements_CompuMethods_Identical 1 100 0.0 255. FORMAT "%10.0" ECU_ADDRESS 0x600111C4 /end MEASUREMENT
/begin MEASUREMENT ComScl_Gbx_RawSignal_TM_MAP_CC_u8 "NetworkSignal ComScl_Gbx_RawSignal_TM_MAP_CC_u8" UBYTE RB_RBA_Common_CentralElements_CompuMethods_Identical 1 100 0.0 255. FORMAT "%10.0" ECU_ADDRESS 0x600111AA /end MEASUREMENT
/begin MEASUREMENT ComScl_Gbx_RawSignal_TM_MIL_REQUEST_b "NetworkSignal ComScl_Gbx_RawSignal_TM_MIL_REQUEST_b" UBYTE RB_RBA_Common_CentralElements_CompuMethods_Identical 1 100 0.0 255. FORMAT "%10.0" ECU_ADDRESS 0x600111A9 /end MEASUREMENT
/begin MEASUREMENT ComScl_Gbx_RawSignal_TM_M_MODE_RUN_b "NetworkSignal ComScl_Gbx_RawSignal_TM_M_MODE_RUN_b" UBYTE RB_RBA_Common_CentralElements_CompuMethods_Identical 1 100 0.0 255. FORMAT "%10.0" ECU_ADDRESS 0x600111C8 /end MEASUREMENT
/begin MEASUREMENT ComScl_Gbx_RawSignal_TM_N_TC_u16 "NetworkSignal ComScl_Gbx_RawSignal_TM_N_TC_u16" UWORD RB_RBA_Common_CentralElements_CompuMethods_Identical 1 100 0.0 65535. FORMAT "%10.0" ECU_ADDRESS 0x6000AC14 /end MEASUREMENT
/begin MEASUREMENT ComScl_Gbx_RawSignal_TM_OVERALL_FILTERED_RATIO_u16 "NetworkSignal ComScl_Gbx_RawSignal_TM_OVERALL_FILTERED_RATIO_u16" UWORD RB_RBA_Common_CentralElements_CompuMethods_Identical 1 100 0.0 65535. FORMAT "%10.0" ECU_ADDRESS 0x6000AC20 /end MEASUREMENT
/begin MEASUREMENT ComScl_Gbx_RawSignal_TM_RECOGNITION_VOLTAGE_u16 "NetworkSignal ComScl_Gbx_RawSignal_TM_RECOGNITION_VOLTAGE_u16" UWORD RB_RBA_Common_CentralElements_CompuMethods_Identical 1 100 0.0 65535. FORMAT "%10.0" ECU_ADDRESS 0x6000AC08 /end MEASUREMENT
/begin MEASUREMENT ComScl_Gbx_RawSignal_TM_REQ_ENG_TORQUE_FAST_s16 "NetworkSignal ComScl_Gbx_RawSignal_TM_REQ_ENG_TORQUE_FAST_s16" SWORD RB_RBA_Common_CentralElements_CompuMethods_Identical 1 100 -32768. 32767. FORMAT "%10.0" ECU_ADDRESS 0x6000AC1A /end MEASUREMENT
/begin MEASUREMENT ComScl_Gbx_RawSignal_TM_REQ_ENG_TORQUE_SLOW_s16 "NetworkSignal ComScl_Gbx_RawSignal_TM_REQ_ENG_TORQUE_SLOW_s16" SWORD RB_RBA_Common_CentralElements_CompuMethods_Identical 1 100 -32768. 32767. FORMAT "%10.0" ECU_ADDRESS 0x6000AC18 /end MEASUREMENT
/begin MEASUREMENT ComScl_Gbx_RawSignal_TM_REQ_MAX_FC_LIMT_ENG_SPEED_u8 "NetworkSignal ComScl_Gbx_RawSignal_TM_REQ_MAX_FC_LIMT_ENG_SPEED_u8" UBYTE RB_RBA_Common_CentralElements_CompuMethods_Identical 1 100 0.0 255. FORMAT "%10.0" ECU_ADDRESS 0x600111B8 /end MEASUREMENT
/begin MEASUREMENT ComScl_Gbx_RawSignal_TM_REQ_MAX_TQ_LIMT_ENG_SPEED_u8 "NetworkSignal ComScl_Gbx_RawSignal_TM_REQ_MAX_TQ_LIMT_ENG_SPEED_u8" UBYTE RB_RBA_Common_CentralElements_CompuMethods_Identical 1 100 0.0 255. FORMAT "%10.0" ECU_ADDRESS 0x600111B7 /end MEASUREMENT
/begin MEASUREMENT ComScl_Gbx_RawSignal_TM_REQ_MIN_IDLE_ENG_SPEED_u8 "NetworkSignal ComScl_Gbx_RawSignal_TM_REQ_MIN_IDLE_ENG_SPEED_u8" UBYTE RB_RBA_Common_CentralElements_CompuMethods_Identical 1 100 0.0 255. FORMAT "%10.0" ECU_ADDRESS 0x600111B6 /end MEASUREMENT
/begin MEASUREMENT ComScl_Gbx_RawSignal_TM_SHFT_IND_RECOM_DOWN_b "NetworkSignal ComScl_Gbx_RawSignal_TM_SHFT_IND_RECOM_DOWN_b" UBYTE RB_RBA_Common_CentralElements_CompuMethods_Identical 1 100 0.0 255. FORMAT "%10.0" ECU_ADDRESS 0x600111B5 /end MEASUREMENT
/begin MEASUREMENT ComScl_Gbx_RawSignal_TM_SHFT_IND_RECOM_UP_b "NetworkSignal ComScl_Gbx_RawSignal_TM_SHFT_IND_RECOM_UP_b" UBYTE RB_RBA_Common_CentralElements_CompuMethods_Identical 1 100 0.0 255. FORMAT "%10.0" ECU_ADDRESS 0x600111B4 /end MEASUREMENT
/begin MEASUREMENT ComScl_Gbx_RawSignal_TM_SHIFT_CONTROL_MODE_u8 "NetworkSignal ComScl_Gbx_RawSignal_TM_SHIFT_CONTROL_MODE_u8" UBYTE RB_RBA_Common_CentralElements_CompuMethods_Identical 1 100 0.0 255. FORMAT "%10.0" ECU_ADDRESS 0x600111A8 /end MEASUREMENT
/begin MEASUREMENT ComScl_Gbx_RawSignal_TM_START_ENABLESUB_b "NetworkSignal ComScl_Gbx_RawSignal_TM_START_ENABLESUB_b" UBYTE RB_RBA_Common_CentralElements_CompuMethods_Identical 1 100 0.0 255. FORMAT "%10.0" ECU_ADDRESS 0x600111CC /end MEASUREMENT
/begin MEASUREMENT ComScl_Gbx_RawSignal_TM_START_ENABLE_b "NetworkSignal ComScl_Gbx_RawSignal_TM_START_ENABLE_b" UBYTE RB_RBA_Common_CentralElements_CompuMethods_Identical 1 100 0.0 255. FORMAT "%10.0" ECU_ADDRESS 0x600111D1 /end MEASUREMENT
/begin MEASUREMENT ComScl_Gbx_RawSignal_TM_TORQUE_CONVERTER_SLIP_u16 "NetworkSignal ComScl_Gbx_RawSignal_TM_TORQUE_CONVERTER_SLIP_u16" UWORD RB_RBA_Common_CentralElements_CompuMethods_Identical 1 100 0.0 65535. FORMAT "%10.0" ECU_ADDRESS 0x6000AC12 /end MEASUREMENT
/begin MEASUREMENT ComScl_Gbx_RawSignal_TM_TORQUE_CONV_TORQUE_RATIO_u16 "NetworkSignal ComScl_Gbx_RawSignal_TM_TORQUE_CONV_TORQUE_RATIO_u16" UWORD RB_RBA_Common_CentralElements_CompuMethods_Identical 1 100 0.0 65535. FORMAT "%10.0" ECU_ADDRESS 0x6000AC22 /end MEASUREMENT
/begin MEASUREMENT ComScl_Gbx_RawSignal_TM_TORQUE_LOSSES_s16 "NetworkSignal ComScl_Gbx_RawSignal_TM_TORQUE_LOSSES_s16" SWORD RB_RBA_Common_CentralElements_CompuMethods_Identical 1 100 -32768. 32767. FORMAT "%10.0" ECU_ADDRESS 0x6000AC16 /end MEASUREMENT
/begin MEASUREMENT ComScl_Gbx_RawSignal_TM_TRQ_CONTROL_MODE_FAST_DNREQ_b "NetworkSignal ComScl_Gbx_RawSignal_TM_TRQ_CONTROL_MODE_FAST_DNREQ_b" UBYTE RB_RBA_Common_CentralElements_CompuMethods_Identical 1 100 0.0 255. FORMAT "%10.0" ECU_ADDRESS 0x600111C3 /end MEASUREMENT
/begin MEASUREMENT ComScl_Gbx_RawSignal_TM_TRQ_CONTROL_MODE_SLOW_DNREQ_b "NetworkSignal ComScl_Gbx_RawSignal_TM_TRQ_CONTROL_MODE_SLOW_DNREQ_b" UBYTE RB_RBA_Common_CentralElements_CompuMethods_Identical 1 100 0.0 255. FORMAT "%10.0" ECU_ADDRESS 0x600111C2 /end MEASUREMENT
/begin MEASUREMENT ComScl_Gbx_RawSignal_TM_TRS_DRV_RATIO_u8 "NetworkSignal ComScl_Gbx_RawSignal_TM_TRS_DRV_RATIO_u8" UBYTE RB_RBA_Common_CentralElements_CompuMethods_Identical 1 100 0.0 255. FORMAT "%10.0" ECU_ADDRESS 0x600111B3 /end MEASUREMENT
/begin MEASUREMENT ComScl_Gbx_RawSignal_TM_VEHICLE_SPEED_u16 "NetworkSignal ComScl_Gbx_RawSignal_TM_VEHICLE_SPEED_u16" UWORD RB_RBA_Common_CentralElements_CompuMethods_Identical 1 100 0.0 65535. FORMAT "%10.0" ECU_ADDRESS 0x6000AC1E /end MEASUREMENT
/begin MEASUREMENT ComScl_Gbx_RawSignal_TM_VLVW_u16 "NetworkSignal ComScl_Gbx_RawSignal_TM_VLVW_u16" UWORD RB_RBA_Common_CentralElements_CompuMethods_Identical 1 100 0.0 65535. FORMAT "%10.0" ECU_ADDRESS 0x6000AC1C /end MEASUREMENT
/begin MEASUREMENT ComScl_Gbx_RawSignal_TM_VSA_INH_b "NetworkSignal ComScl_Gbx_RawSignal_TM_VSA_INH_b" UBYTE RB_RBA_Common_CentralElements_CompuMethods_Identical 1 100 0.0 255. FORMAT "%10.0" ECU_ADDRESS 0x600111C7 /end MEASUREMENT
/begin MEASUREMENT ComScl_Gbx_RawSignal_TM_WRITE_VIN_CLEAR_DONE_b "NetworkSignal ComScl_Gbx_RawSignal_TM_WRITE_VIN_CLEAR_DONE_b" UBYTE RB_RBA_Common_CentralElements_CompuMethods_Identical 1 100 0.0 255. FORMAT "%10.0" ECU_ADDRESS 0x600111B2 /end MEASUREMENT
/begin MEASUREMENT ComScl_Gw_RawSignal_GW_ALIVE_COUNTER_40E_u8 "NetworkSignal ComScl_Gw_RawSignal_GW_ALIVE_COUNTER_40E_u8" UBYTE RB_RBA_Common_CentralElements_CompuMethods_Identical 1 100 0.0 255. FORMAT "%10.0" ECU_ADDRESS 0x600111E2 /end MEASUREMENT
/begin MEASUREMENT ComScl_Gw_RawSignal_GW_ALIVE_COUNTER_444_u8 "NetworkSignal ComScl_Gw_RawSignal_GW_ALIVE_COUNTER_444_u8" UBYTE RB_RBA_Common_CentralElements_CompuMethods_Identical 1 100 0.0 255. FORMAT "%10.0" ECU_ADDRESS 0x600111FD /end MEASUREMENT
/begin MEASUREMENT ComScl_Gw_RawSignal_GW_CHECKSUM_40E_u8 "NetworkSignal ComScl_Gw_RawSignal_GW_CHECKSUM_40E_u8" UBYTE RB_RBA_Common_CentralElements_CompuMethods_Identical 1 100 0.0 255. FORMAT "%10.0" ECU_ADDRESS 0x600111E1 /end MEASUREMENT
/begin MEASUREMENT ComScl_Gw_RawSignal_GW_CHECKSUM_444_u8 "NetworkSignal ComScl_Gw_RawSignal_GW_CHECKSUM_444_u8" UBYTE RB_RBA_Common_CentralElements_CompuMethods_Identical 1 100 0.0 255. FORMAT "%10.0" ECU_ADDRESS 0x600111FC /end MEASUREMENT
/begin MEASUREMENT ComScl_Gw_RawSignal_GW_IG1_STATE_b "NetworkSignal ComScl_Gw_RawSignal_GW_IG1_STATE_b" UBYTE RB_RBA_Common_CentralElements_CompuMethods_Identical 1 100 0.0 255. FORMAT "%10.0" ECU_ADDRESS 0x600111E0 /end MEASUREMENT
/begin MEASUREMENT ComScl_Gw_RawSignal_GW_IG1_VOLTAGE_u16 "NetworkSignal ComScl_Gw_RawSignal_GW_IG1_VOLTAGE_u16" UWORD RB_RBA_Common_CentralElements_CompuMethods_Identical 1 100 0.0 65535. FORMAT "%10.0" ECU_ADDRESS 0x6000AC26 /end MEASUREMENT
/begin MEASUREMENT ComScl_Gw_RawSignal_GW_RECOGNITION_VOLTAGE_u16 "NetworkSignal ComScl_Gw_RawSignal_GW_RECOGNITION_VOLTAGE_u16" UWORD RB_RBA_Common_CentralElements_CompuMethods_Identical 1 100 0.0 65535. FORMAT "%10.0" ECU_ADDRESS 0x6000AC24 /end MEASUREMENT
/begin MEASUREMENT ComScl_Gw_RawSignal_IMG_ALIVE_COUNTER_082_u8 "NetworkSignal ComScl_Gw_RawSignal_IMG_ALIVE_COUNTER_082_u8" UBYTE RB_RBA_Common_CentralElements_CompuMethods_Identical 1 100 0.0 255. FORMAT "%10.0" ECU_ADDRESS 0x600111F6 /end MEASUREMENT
/begin MEASUREMENT ComScl_Gw_RawSignal_IMG_ALIVE_COUNTER_084_u8 "NetworkSignal ComScl_Gw_RawSignal_IMG_ALIVE_COUNTER_084_u8" UBYTE RB_RBA_Common_CentralElements_CompuMethods_Identical 1 100 0.0 255. FORMAT "%10.0" ECU_ADDRESS 0x600111EE /end MEASUREMENT
/begin MEASUREMENT ComScl_Gw_RawSignal_IMG_ALIVE_COUNTER_22B_u8 "NetworkSignal ComScl_Gw_RawSignal_IMG_ALIVE_COUNTER_22B_u8" UBYTE RB_RBA_Common_CentralElements_CompuMethods_Identical 1 100 0.0 255. FORMAT "%10.0" ECU_ADDRESS 0x600111FA /end MEASUREMENT
/begin MEASUREMENT ComScl_Gw_RawSignal_IMG_ALIVE_COUNTER_2F1_u8 "NetworkSignal ComScl_Gw_RawSignal_IMG_ALIVE_COUNTER_2F1_u8" UBYTE RB_RBA_Common_CentralElements_CompuMethods_Identical 1 100 0.0 255. FORMAT "%10.0" ECU_ADDRESS 0x600111E5 /end MEASUREMENT
/begin MEASUREMENT ComScl_Gw_RawSignal_IMG_CHECKSUM_082_u8 "NetworkSignal ComScl_Gw_RawSignal_IMG_CHECKSUM_082_u8" UBYTE RB_RBA_Common_CentralElements_CompuMethods_Identical 1 100 0.0 255. FORMAT "%10.0" ECU_ADDRESS 0x600111F5 /end MEASUREMENT
/begin MEASUREMENT ComScl_Gw_RawSignal_IMG_CHECKSUM_084_u8 "NetworkSignal ComScl_Gw_RawSignal_IMG_CHECKSUM_084_u8" UBYTE RB_RBA_Common_CentralElements_CompuMethods_Identical 1 100 0.0 255. FORMAT "%10.0" ECU_ADDRESS 0x600111ED /end MEASUREMENT
/begin MEASUREMENT ComScl_Gw_RawSignal_IMG_CHECKSUM_22B_u8 "NetworkSignal ComScl_Gw_RawSignal_IMG_CHECKSUM_22B_u8" UBYTE RB_RBA_Common_CentralElements_CompuMethods_Identical 1 100 0.0 255. FORMAT "%10.0" ECU_ADDRESS 0x600111F9 /end MEASUREMENT
/begin MEASUREMENT ComScl_Gw_RawSignal_IMG_CHECKSUM_2F1_u8 "NetworkSignal ComScl_Gw_RawSignal_IMG_CHECKSUM_2F1_u8" UBYTE RB_RBA_Common_CentralElements_CompuMethods_Identical 1 100 0.0 255. FORMAT "%10.0" ECU_ADDRESS 0x600111E4 /end MEASUREMENT
/begin MEASUREMENT ComScl_Gw_RawSignal_IMG_DRVTRQ_STATUS_u8 "NetworkSignal ComScl_Gw_RawSignal_IMG_DRVTRQ_STATUS_u8" UBYTE RB_RBA_Common_CentralElements_CompuMethods_Identical 1 100 0.0 255. FORMAT "%10.0" ECU_ADDRESS 0x600111F4 /end MEASUREMENT
/begin MEASUREMENT ComScl_Gw_RawSignal_IMG_ENG_CAN_RECIEVE_ERROR_b "NetworkSignal ComScl_Gw_RawSignal_IMG_ENG_CAN_RECIEVE_ERROR_b" UBYTE RB_RBA_Common_CentralElements_CompuMethods_Identical 1 100 0.0 255. FORMAT "%10.0" ECU_ADDRESS 0x600111EC /end MEASUREMENT
/begin MEASUREMENT ComScl_Gw_RawSignal_IMG_F_WVINCLDN_b "NetworkSignal ComScl_Gw_RawSignal_IMG_F_WVINCLDN_b" UBYTE RB_RBA_Common_CentralElements_CompuMethods_Identical 1 100 0.0 255. FORMAT "%10.0" ECU_ADDRESS 0x600111E3 /end MEASUREMENT
/begin MEASUREMENT ComScl_Gw_RawSignal_IMG_IDS_GRP_A12_MODE_u8 "NetworkSignal ComScl_Gw_RawSignal_IMG_IDS_GRP_A12_MODE_u8" UBYTE RB_RBA_Common_CentralElements_CompuMethods_Identical 1 100 0.0 255. FORMAT "%10.0" ECU_ADDRESS 0x600111F8 /end MEASUREMENT
/begin MEASUREMENT ComScl_Gw_RawSignal_IMG_IDS_GRP_A5_MODE_u8 "NetworkSignal ComScl_Gw_RawSignal_IMG_IDS_GRP_A5_MODE_u8" UBYTE RB_RBA_Common_CentralElements_CompuMethods_Identical 1 100 0.0 255. FORMAT "%10.0" ECU_ADDRESS 0x600111F7 /end MEASUREMENT
/begin MEASUREMENT ComScl_Gw_RawSignal_IMG_IS_BHOLD_ACT_b "NetworkSignal ComScl_Gw_RawSignal_IMG_IS_BHOLD_ACT_b" UBYTE RB_RBA_Common_CentralElements_CompuMethods_Identical 1 100 0.0 255. FORMAT "%10.0" ECU_ADDRESS 0x600111EB /end MEASUREMENT
/begin MEASUREMENT ComScl_Gw_RawSignal_IMG_IS_BHOLD_STANBY_b "NetworkSignal ComScl_Gw_RawSignal_IMG_IS_BHOLD_STANBY_b" UBYTE RB_RBA_Common_CentralElements_CompuMethods_Identical 1 100 0.0 255. FORMAT "%10.0" ECU_ADDRESS 0x600111EA /end MEASUREMENT
/begin MEASUREMENT ComScl_Gw_RawSignal_IMG_IS_BRKCNT_ADAS_b "NetworkSignal ComScl_Gw_RawSignal_IMG_IS_BRKCNT_ADAS_b" UBYTE RB_RBA_Common_CentralElements_CompuMethods_Identical 1 100 0.0 255. FORMAT "%10.0" ECU_ADDRESS 0x600111F3 /end MEASUREMENT
/begin MEASUREMENT ComScl_Gw_RawSignal_IMG_IS_INHIBITBRK_b "NetworkSignal ComScl_Gw_RawSignal_IMG_IS_INHIBITBRK_b" UBYTE RB_RBA_Common_CentralElements_CompuMethods_Identical 1 100 0.0 255. FORMAT "%10.0" ECU_ADDRESS 0x600111E9 /end MEASUREMENT
/begin MEASUREMENT ComScl_Gw_RawSignal_IMG_IS_RELEASE_REQUEST_b "NetworkSignal ComScl_Gw_RawSignal_IMG_IS_RELEASE_REQUEST_b" UBYTE RB_RBA_Common_CentralElements_CompuMethods_Identical 1 100 0.0 255. FORMAT "%10.0" ECU_ADDRESS 0x600111F2 /end MEASUREMENT
/begin MEASUREMENT ComScl_Gw_RawSignal_IMG_IS_RESTART_INHIBITBRK_b "NetworkSignal ComScl_Gw_RawSignal_IMG_IS_RESTART_INHIBITBRK_b" UBYTE RB_RBA_Common_CentralElements_CompuMethods_Identical 1 100 0.0 255. FORMAT "%10.0" ECU_ADDRESS 0x600111E8 /end MEASUREMENT
/begin MEASUREMENT ComScl_Gw_RawSignal_IMG_IS_SHIFT_INHBITBRK_b "NetworkSignal ComScl_Gw_RawSignal_IMG_IS_SHIFT_INHBITBRK_b" UBYTE RB_RBA_Common_CentralElements_CompuMethods_Identical 1 100 0.0 255. FORMAT "%10.0" ECU_ADDRESS 0x600111E7 /end MEASUREMENT
/begin MEASUREMENT ComScl_Gw_RawSignal_IMG_IS_SYSOFFBRK_b "NetworkSignal ComScl_Gw_RawSignal_IMG_IS_SYSOFFBRK_b" UBYTE RB_RBA_Common_CentralElements_CompuMethods_Identical 1 100 0.0 255. FORMAT "%10.0" ECU_ADDRESS 0x600111E6 /end MEASUREMENT
/begin MEASUREMENT ComScl_Gw_RawSignal_IMG_LIMTRQ_STATUS_u8 "NetworkSignal ComScl_Gw_RawSignal_IMG_LIMTRQ_STATUS_u8" UBYTE RB_RBA_Common_CentralElements_CompuMethods_Identical 1 100 0.0 255. FORMAT "%10.0" ECU_ADDRESS 0x600111F1 /end MEASUREMENT
/begin MEASUREMENT ComScl_Gw_RawSignal_IMG_MIL_REQ_b "NetworkSignal ComScl_Gw_RawSignal_IMG_MIL_REQ_b" UBYTE RB_RBA_Common_CentralElements_CompuMethods_Identical 1 100 0.0 255. FORMAT "%10.0" ECU_ADDRESS 0x600111FB /end MEASUREMENT
/begin MEASUREMENT ComScl_Gw_RawSignal_IMG_REQ_BRK_CTRL_b "NetworkSignal ComScl_Gw_RawSignal_IMG_REQ_BRK_CTRL_b" UBYTE RB_RBA_Common_CentralElements_CompuMethods_Identical 1 100 0.0 255. FORMAT "%10.0" ECU_ADDRESS 0x600111F0 /end MEASUREMENT
/begin MEASUREMENT ComScl_Gw_RawSignal_IMG_REQ_DRVTRQ_s16 "NetworkSignal ComScl_Gw_RawSignal_IMG_REQ_DRVTRQ_s16" SWORD RB_RBA_Common_CentralElements_CompuMethods_Identical 1 100 -32768. 32767. FORMAT "%10.0" ECU_ADDRESS 0x6000AC2A /end MEASUREMENT
/begin MEASUREMENT ComScl_Gw_RawSignal_IMG_REQ_LIMTRQ_s16 "NetworkSignal ComScl_Gw_RawSignal_IMG_REQ_LIMTRQ_s16" SWORD RB_RBA_Common_CentralElements_CompuMethods_Identical 1 100 -32768. 32767. FORMAT "%10.0" ECU_ADDRESS 0x6000AC28 /end MEASUREMENT
/begin MEASUREMENT ComScl_Gw_RawSignal_IMG_SHIFT_REQUEST_u8 "NetworkSignal ComScl_Gw_RawSignal_IMG_SHIFT_REQUEST_u8" UBYTE RB_RBA_Common_CentralElements_CompuMethods_Identical 1 100 0.0 255. FORMAT "%10.0" ECU_ADDRESS 0x600111EF /end MEASUREMENT
/begin MEASUREMENT ComScl_IDAS_RawSignal_IDAS_ALIVE_COUNTER_1EF_u8 "NetworkSignal ComScl_IDAS_RawSignal_IDAS_ALIVE_COUNTER_1EF_u8" UBYTE RB_RBA_Common_CentralElements_CompuMethods_Identical 1 100 0.0 255. FORMAT "%10.0" ECU_ADDRESS 0x60011200 /end MEASUREMENT
/begin MEASUREMENT ComScl_IDAS_RawSignal_IDAS_CHECKSUM_1EF_u8 "NetworkSignal ComScl_IDAS_RawSignal_IDAS_CHECKSUM_1EF_u8" UBYTE RB_RBA_Common_CentralElements_CompuMethods_Identical 1 100 0.0 255. FORMAT "%10.0" ECU_ADDRESS 0x600111FF /end MEASUREMENT
/begin MEASUREMENT ComScl_IDAS_RawSignal_IDAS_ISA_BASE_SPEED_u8 "NetworkSignal ComScl_IDAS_RawSignal_IDAS_ISA_BASE_SPEED_u8" UBYTE RB_RBA_Common_CentralElements_CompuMethods_Identical 1 100 0.0 255. FORMAT "%10.0" ECU_ADDRESS 0x600111FE /end MEASUREMENT
/begin MEASUREMENT ComScl_PCU_RawSignal_PCU_ALIVE_COUNTER_1FB_u8 "NetworkSignal ComScl_PCU_RawSignal_PCU_ALIVE_COUNTER_1FB_u8" UBYTE RB_RBA_Common_CentralElements_CompuMethods_Identical 1 100 0.0 255. FORMAT "%10.0" ECU_ADDRESS 0x60011203 /end MEASUREMENT
/begin MEASUREMENT ComScl_PCU_RawSignal_PCU_CHECKSUM_1FB_u8 "NetworkSignal ComScl_PCU_RawSignal_PCU_CHECKSUM_1FB_u8" UBYTE RB_RBA_Common_CentralElements_CompuMethods_Identical 1 100 0.0 255. FORMAT "%10.0" ECU_ADDRESS 0x60011202 /end MEASUREMENT
/begin MEASUREMENT ComScl_PCU_RawSignal_PCU_INHBIT_START_ENG_b "NetworkSignal ComScl_PCU_RawSignal_PCU_INHBIT_START_ENG_b" UBYTE RB_RBA_Common_CentralElements_CompuMethods_Identical 1 100 0.0 255. FORMAT "%10.0" ECU_ADDRESS 0x60011201 /end MEASUREMENT
/begin MEASUREMENT ComScl_StbIntv_RawSignal_EPB_ALIVE_COUNTER_112_u8 "NetworkSignal ComScl_StbIntv_RawSignal_EPB_ALIVE_COUNTER_112_u8" UBYTE RB_RBA_Common_CentralElements_CompuMethods_Identical 1 100 0.0 255. FORMAT "%10.0" ECU_ADDRESS 0x6001120F /end MEASUREMENT
/begin MEASUREMENT ComScl_StbIntv_RawSignal_EPB_ALIVE_COUNTER_1C2_u8 "NetworkSignal ComScl_StbIntv_RawSignal_EPB_ALIVE_COUNTER_1C2_u8" UBYTE RB_RBA_Common_CentralElements_CompuMethods_Identical 1 100 0.0 255. FORMAT "%10.0" ECU_ADDRESS 0x6001120A /end MEASUREMENT
/begin MEASUREMENT ComScl_StbIntv_RawSignal_EPB_APPLIED_b "NetworkSignal ComScl_StbIntv_RawSignal_EPB_APPLIED_b" UBYTE RB_RBA_Common_CentralElements_CompuMethods_Identical 1 100 0.0 255. FORMAT "%10.0" ECU_ADDRESS 0x60011209 /end MEASUREMENT
/begin MEASUREMENT ComScl_StbIntv_RawSignal_EPB_CHECKSUM_112_u8 "NetworkSignal ComScl_StbIntv_RawSignal_EPB_CHECKSUM_112_u8" UBYTE RB_RBA_Common_CentralElements_CompuMethods_Identical 1 100 0.0 255. FORMAT "%10.0" ECU_ADDRESS 0x6001120E /end MEASUREMENT
/begin MEASUREMENT ComScl_StbIntv_RawSignal_EPB_CHECKSUM_1C2_u8 "NetworkSignal ComScl_StbIntv_RawSignal_EPB_CHECKSUM_1C2_u8" UBYTE RB_RBA_Common_CentralElements_CompuMethods_Identical 1 100 0.0 255. FORMAT "%10.0" ECU_ADDRESS 0x60011208 /end MEASUREMENT
/begin MEASUREMENT ComScl_StbIntv_RawSignal_EPB_CLUTCH_PEADAL_STROKE_u8 "NetworkSignal ComScl_StbIntv_RawSignal_EPB_CLUTCH_PEADAL_STROKE_u8" UBYTE RB_RBA_Common_CentralElements_CompuMethods_Identical 1 100 0.0 255. FORMAT "%10.0" ECU_ADDRESS 0x6001120D /end MEASUREMENT
/begin MEASUREMENT ComScl_StbIntv_RawSignal_EPB_CLUTCH_PEDAL_FAIL_DETECT_b "NetworkSignal ComScl_StbIntv_RawSignal_EPB_CLUTCH_PEDAL_FAIL_DETECT_b" UBYTE RB_RBA_Common_CentralElements_CompuMethods_Identical 1 100 0.0 255. FORMAT "%10.0" ECU_ADDRESS 0x6001120B /end MEASUREMENT
/begin MEASUREMENT ComScl_StbIntv_RawSignal_EPB_CLUTCH_PEDAL_FAIL_b "NetworkSignal ComScl_StbIntv_RawSignal_EPB_CLUTCH_PEDAL_FAIL_b" UBYTE RB_RBA_Common_CentralElements_CompuMethods_Identical 1 100 0.0 255. FORMAT "%10.0" ECU_ADDRESS 0x6001120C /end MEASUREMENT
/begin MEASUREMENT ComScl_StbIntv_RawSignal_EPB_CPS1_OUTPUT_VOLTAGE_u16 "NetworkSignal ComScl_StbIntv_RawSignal_EPB_CPS1_OUTPUT_VOLTAGE_u16" UWORD RB_RBA_Common_CentralElements_CompuMethods_Identical 1 100 0.0 65535. FORMAT "%10.0" ECU_ADDRESS 0x6000AC2E /end MEASUREMENT
/begin MEASUREMENT ComScl_StbIntv_RawSignal_EPB_CPS2_OUTPUT_VOLTAGE_u16 "NetworkSignal ComScl_StbIntv_RawSignal_EPB_CPS2_OUTPUT_VOLTAGE_u16" UWORD RB_RBA_Common_CentralElements_CompuMethods_Identical 1 100 0.0 65535. FORMAT "%10.0" ECU_ADDRESS 0x6000AC2C /end MEASUREMENT
/begin MEASUREMENT ComScl_StbIntv_RawSignal_EPB_INHIBIT_ACT_b "NetworkSignal ComScl_StbIntv_RawSignal_EPB_INHIBIT_ACT_b" UBYTE RB_RBA_Common_CentralElements_CompuMethods_Identical 1 100 0.0 255. FORMAT "%10.0" ECU_ADDRESS 0x60011207 /end MEASUREMENT
/begin MEASUREMENT ComScl_StbIntv_RawSignal_EPB_PLANT_SAFETY_MODE_STATUS_b "NetworkSignal ComScl_StbIntv_RawSignal_EPB_PLANT_SAFETY_MODE_STATUS_b" UBYTE RB_RBA_Common_CentralElements_CompuMethods_Identical 1 100 0.0 255. FORMAT "%10.0" ECU_ADDRESS 0x60011206 /end MEASUREMENT
/begin MEASUREMENT ComScl_StbIntv_RawSignal_EPB_REFUSE_ACT_b "NetworkSignal ComScl_StbIntv_RawSignal_EPB_REFUSE_ACT_b" UBYTE RB_RBA_Common_CentralElements_CompuMethods_Identical 1 100 0.0 255. FORMAT "%10.0" ECU_ADDRESS 0x60011205 /end MEASUREMENT
/begin MEASUREMENT ComScl_StbIntv_RawSignal_EPB_STATE_u8 "NetworkSignal ComScl_StbIntv_RawSignal_EPB_STATE_u8" UBYTE RB_RBA_Common_CentralElements_CompuMethods_Identical 1 100 0.0 255. FORMAT "%10.0" ECU_ADDRESS 0x60011204 /end MEASUREMENT
/begin MEASUREMENT ComScl_StbIntv_RawSignal_VSA_ABS_CHECKSUM_1D0_u8 "NetworkSignal ComScl_StbIntv_RawSignal_VSA_ABS_CHECKSUM_1D0_u8" UBYTE RB_RBA_Common_CentralElements_CompuMethods_Identical 1 100 0.0 255. FORMAT "%10.0" ECU_ADDRESS 0x60011225 /end MEASUREMENT
/begin MEASUREMENT ComScl_StbIntv_RawSignal_VSA_ABS_CTRL_b "NetworkSignal ComScl_StbIntv_RawSignal_VSA_ABS_CTRL_b" UBYTE RB_RBA_Common_CentralElements_CompuMethods_Identical 1 100 0.0 255. FORMAT "%10.0" ECU_ADDRESS 0x60011239 /end MEASUREMENT
/begin MEASUREMENT ComScl_StbIntv_RawSignal_VSA_ABS_EBD_ACT_b "NetworkSignal ComScl_StbIntv_RawSignal_VSA_ABS_EBD_ACT_b" UBYTE RB_RBA_Common_CentralElements_CompuMethods_Identical 1 100 0.0 255. FORMAT "%10.0" ECU_ADDRESS 0x60011238 /end MEASUREMENT
/begin MEASUREMENT ComScl_StbIntv_RawSignal_VSA_ABS_EBD_MIL_b "NetworkSignal ComScl_StbIntv_RawSignal_VSA_ABS_EBD_MIL_b" UBYTE RB_RBA_Common_CentralElements_CompuMethods_Identical 1 100 0.0 255. FORMAT "%10.0" ECU_ADDRESS 0x60011237 /end MEASUREMENT
/begin MEASUREMENT ComScl_StbIntv_RawSignal_VSA_ABS_FAIL_FL_VW_SENSOR_b "NetworkSignal ComScl_StbIntv_RawSignal_VSA_ABS_FAIL_FL_VW_SENSOR_b" UBYTE RB_RBA_Common_CentralElements_CompuMethods_Identical 1 100 0.0 255. FORMAT "%10.0" ECU_ADDRESS 0x6001121D /end MEASUREMENT
/begin MEASUREMENT ComScl_StbIntv_RawSignal_VSA_ABS_FAIL_FR_VW_SENSOR_b "NetworkSignal ComScl_StbIntv_RawSignal_VSA_ABS_FAIL_FR_VW_SENSOR_b" UBYTE RB_RBA_Common_CentralElements_CompuMethods_Identical 1 100 0.0 255. FORMAT "%10.0" ECU_ADDRESS 0x6001121C /end MEASUREMENT
/begin MEASUREMENT ComScl_StbIntv_RawSignal_VSA_ABS_FAIL_RL_VW_SENSOR_b "NetworkSignal ComScl_StbIntv_RawSignal_VSA_ABS_FAIL_RL_VW_SENSOR_b" UBYTE RB_RBA_Common_CentralElements_CompuMethods_Identical 1 100 0.0 255. FORMAT "%10.0" ECU_ADDRESS 0x6001121B /end MEASUREMENT
/begin MEASUREMENT ComScl_StbIntv_RawSignal_VSA_ABS_FAIL_RR_VW_SENSOR_b "NetworkSignal ComScl_StbIntv_RawSignal_VSA_ABS_FAIL_RR_VW_SENSOR_b" UBYTE RB_RBA_Common_CentralElements_CompuMethods_Identical 1 100 0.0 255. FORMAT "%10.0" ECU_ADDRESS 0x6001121A /end MEASUREMENT
/begin MEASUREMENT ComScl_StbIntv_RawSignal_VSA_ABS_FL_WHEEL_SPEED_u16 "NetworkSignal ComScl_StbIntv_RawSignal_VSA_ABS_FL_WHEEL_SPEED_u16" UWORD RB_RBA_Common_CentralElements_CompuMethods_Identical 1 100 0.0 65535. FORMAT "%10.0" ECU_ADDRESS 0x6000AC3C /end MEASUREMENT
/begin MEASUREMENT ComScl_StbIntv_RawSignal_VSA_ABS_FR_WHEEL_SPEED_u16 "NetworkSignal ComScl_StbIntv_RawSignal_VSA_ABS_FR_WHEEL_SPEED_u16" UWORD RB_RBA_Common_CentralElements_CompuMethods_Identical 1 100 0.0 65535. FORMAT "%10.0" ECU_ADDRESS 0x6000AC3A /end MEASUREMENT
/begin MEASUREMENT ComScl_StbIntv_RawSignal_VSA_ABS_RL_WHEEL_SPEED_u16 "NetworkSignal ComScl_StbIntv_RawSignal_VSA_ABS_RL_WHEEL_SPEED_u16" UWORD RB_RBA_Common_CentralElements_CompuMethods_Identical 1 100 0.0 65535. FORMAT "%10.0" ECU_ADDRESS 0x6000AC38 /end MEASUREMENT
/begin MEASUREMENT ComScl_StbIntv_RawSignal_VSA_ABS_RR_WHEEL_SPEED_u16 "NetworkSignal ComScl_StbIntv_RawSignal_VSA_ABS_RR_WHEEL_SPEED_u16" UWORD RB_RBA_Common_CentralElements_CompuMethods_Identical 1 100 0.0 65535. FORMAT "%10.0" ECU_ADDRESS 0x6000AC36 /end MEASUREMENT
/begin MEASUREMENT ComScl_StbIntv_RawSignal_VSA_ACC_BRAKE_ACT_b "NetworkSignal ComScl_StbIntv_RawSignal_VSA_ACC_BRAKE_ACT_b" UBYTE RB_RBA_Common_CentralElements_CompuMethods_Identical 1 100 0.0 255. FORMAT "%10.0" ECU_ADDRESS 0x60011236 /end MEASUREMENT
/begin MEASUREMENT ComScl_StbIntv_RawSignal_VSA_ALIVECOUNTER_1AC_u8 "NetworkSignal ComScl_StbIntv_RawSignal_VSA_ALIVECOUNTER_1AC_u8" UBYTE RB_RBA_Common_CentralElements_CompuMethods_Identical 1 100 0.0 255. FORMAT "%10.0" ECU_ADDRESS 0x60011224 /end MEASUREMENT
/begin MEASUREMENT ComScl_StbIntv_RawSignal_VSA_ALIVE_COUNTER_12E_u8 "NetworkSignal ComScl_StbIntv_RawSignal_VSA_ALIVE_COUNTER_12E_u8" UBYTE RB_RBA_Common_CentralElements_CompuMethods_Identical 1 100 0.0 255. FORMAT "%10.0" ECU_ADDRESS 0x60011213 /end MEASUREMENT
/begin MEASUREMENT ComScl_StbIntv_RawSignal_VSA_ALIVE_COUNTER_1A4_u8 "NetworkSignal ComScl_StbIntv_RawSignal_VSA_ALIVE_COUNTER_1A4_u8" UBYTE RB_RBA_Common_CentralElements_CompuMethods_Identical 1 100 0.0 255. FORMAT "%10.0" ECU_ADDRESS 0x60011235 /end MEASUREMENT
/begin MEASUREMENT ComScl_StbIntv_RawSignal_VSA_ALIVE_COUNTER_1B0_u8 "NetworkSignal ComScl_StbIntv_RawSignal_VSA_ALIVE_COUNTER_1B0_u8" UBYTE RB_RBA_Common_CentralElements_CompuMethods_Identical 1 100 0.0 255. FORMAT "%10.0" ECU_ADDRESS 0x60011219 /end MEASUREMENT
/begin MEASUREMENT ComScl_StbIntv_RawSignal_VSA_BHOLD_STATUS_ACT_b "NetworkSignal ComScl_StbIntv_RawSignal_VSA_BHOLD_STATUS_ACT_b" UBYTE RB_RBA_Common_CentralElements_CompuMethods_Identical 1 100 0.0 255. FORMAT "%10.0" ECU_ADDRESS 0x60011234 /end MEASUREMENT
/begin MEASUREMENT ComScl_StbIntv_RawSignal_VSA_CASEN_b "NetworkSignal ComScl_StbIntv_RawSignal_VSA_CASEN_b" UBYTE RB_RBA_Common_CentralElements_CompuMethods_Identical 1 100 0.0 255. FORMAT "%10.0" ECU_ADDRESS 0x60011233 /end MEASUREMENT
/begin MEASUREMENT ComScl_StbIntv_RawSignal_VSA_CAS_ACT_b "NetworkSignal ComScl_StbIntv_RawSignal_VSA_CAS_ACT_b" UBYTE RB_RBA_Common_CentralElements_CompuMethods_Identical 1 100 0.0 255. FORMAT "%10.0" ECU_ADDRESS 0x60011232 /end MEASUREMENT
/begin MEASUREMENT ComScl_StbIntv_RawSignal_VSA_CHECKSUM_12E_u8 "NetworkSignal ComScl_StbIntv_RawSignal_VSA_CHECKSUM_12E_u8" UBYTE RB_RBA_Common_CentralElements_CompuMethods_Identical 1 100 0.0 255. FORMAT "%10.0" ECU_ADDRESS 0x60011212 /end MEASUREMENT
/begin MEASUREMENT ComScl_StbIntv_RawSignal_VSA_CHECKSUM_1A4_u8 "NetworkSignal ComScl_StbIntv_RawSignal_VSA_CHECKSUM_1A4_u8" UBYTE RB_RBA_Common_CentralElements_CompuMethods_Identical 1 100 0.0 255. FORMAT "%10.0" ECU_ADDRESS 0x60011231 /end MEASUREMENT
/begin MEASUREMENT ComScl_StbIntv_RawSignal_VSA_CHECKSUM_1AC_u8 "NetworkSignal ComScl_StbIntv_RawSignal_VSA_CHECKSUM_1AC_u8" UBYTE RB_RBA_Common_CentralElements_CompuMethods_Identical 1 100 0.0 255. FORMAT "%10.0" ECU_ADDRESS 0x60011223 /end MEASUREMENT
/begin MEASUREMENT ComScl_StbIntv_RawSignal_VSA_CHECKSUM_1B0_u8 "NetworkSignal ComScl_StbIntv_RawSignal_VSA_CHECKSUM_1B0_u8" UBYTE RB_RBA_Common_CentralElements_CompuMethods_Identical 1 100 0.0 255. FORMAT "%10.0" ECU_ADDRESS 0x60011218 /end MEASUREMENT
/begin MEASUREMENT ComScl_StbIntv_RawSignal_VSA_DRV_BRKTRQ_AYCI_u16 "NetworkSignal ComScl_StbIntv_RawSignal_VSA_DRV_BRKTRQ_AYCI_u16" UWORD RB_RBA_Common_CentralElements_CompuMethods_Identical 1 100 0.0 65535. FORMAT "%10.0" ECU_ADDRESS 0x6000AC30 /end MEASUREMENT
/begin MEASUREMENT ComScl_StbIntv_RawSignal_VSA_DRV_BRKTRQ_u16 "NetworkSignal ComScl_StbIntv_RawSignal_VSA_DRV_BRKTRQ_u16" UWORD RB_RBA_Common_CentralElements_CompuMethods_Identical 1 100 0.0 65535. FORMAT "%10.0" ECU_ADDRESS 0x6000AC32 /end MEASUREMENT
/begin MEASUREMENT ComScl_StbIntv_RawSignal_VSA_ECD_ACT_b "NetworkSignal ComScl_StbIntv_RawSignal_VSA_ECD_ACT_b" UBYTE RB_RBA_Common_CentralElements_CompuMethods_Identical 1 100 0.0 255. FORMAT "%10.0" ECU_ADDRESS 0x60011222 /end MEASUREMENT
/begin MEASUREMENT ComScl_StbIntv_RawSignal_VSA_EPB_INHIBIT_BRAKE_b "NetworkSignal ComScl_StbIntv_RawSignal_VSA_EPB_INHIBIT_BRAKE_b" UBYTE RB_RBA_Common_CentralElements_CompuMethods_Identical 1 100 0.0 255. FORMAT "%10.0" ECU_ADDRESS 0x60011230 /end MEASUREMENT
/begin MEASUREMENT ComScl_StbIntv_RawSignal_VSA_FAIL_LONG_G_SENSOR_b "NetworkSignal ComScl_StbIntv_RawSignal_VSA_FAIL_LONG_G_SENSOR_b" UBYTE RB_RBA_Common_CentralElements_CompuMethods_Identical 1 100 0.0 255. FORMAT "%10.0" ECU_ADDRESS 0x60011217 /end MEASUREMENT
/begin MEASUREMENT ComScl_StbIntv_RawSignal_VSA_FAIL_MC_PRESSURE_SENSOR_b "NetworkSignal ComScl_StbIntv_RawSignal_VSA_FAIL_MC_PRESSURE_SENSOR_b" UBYTE RB_RBA_Common_CentralElements_CompuMethods_Identical 1 100 0.0 255. FORMAT "%10.0" ECU_ADDRESS 0x6001122F /end MEASUREMENT
/begin MEASUREMENT ComScl_StbIntv_RawSignal_VSA_FAIL_YAW_RATE_SENSOR_b "NetworkSignal ComScl_StbIntv_RawSignal_VSA_FAIL_YAW_RATE_SENSOR_b" UBYTE RB_RBA_Common_CentralElements_CompuMethods_Identical 1 100 0.0 255. FORMAT "%10.0" ECU_ADDRESS 0x60011216 /end MEASUREMENT
/begin MEASUREMENT ComScl_StbIntv_RawSignal_VSA_HSA_STATUS_ACT_b "NetworkSignal ComScl_StbIntv_RawSignal_VSA_HSA_STATUS_ACT_b" UBYTE RB_RBA_Common_CentralElements_CompuMethods_Identical 1 100 0.0 255. FORMAT "%10.0" ECU_ADDRESS 0x6001122E /end MEASUREMENT
/begin MEASUREMENT ComScl_StbIntv_RawSignal_VSA_INHBIT_LONG_G_SENSOR_b "NetworkSignal ComScl_StbIntv_RawSignal_VSA_INHBIT_LONG_G_SENSOR_b" UBYTE RB_RBA_Common_CentralElements_CompuMethods_Identical 1 100 0.0 255. FORMAT "%10.0" ECU_ADDRESS 0x60011215 /end MEASUREMENT
/begin MEASUREMENT ComScl_StbIntv_RawSignal_VSA_INHBIT_MC_PRESSURE_SENSOR_b "NetworkSignal ComScl_StbIntv_RawSignal_VSA_INHBIT_MC_PRESSURE_SENSOR_b" UBYTE RB_RBA_Common_CentralElements_CompuMethods_Identical 1 100 0.0 255. FORMAT "%10.0" ECU_ADDRESS 0x6001122D /end MEASUREMENT
/begin MEASUREMENT ComScl_StbIntv_RawSignal_VSA_INHBIT_YAW_RATE_SENSOR_b "NetworkSignal ComScl_StbIntv_RawSignal_VSA_INHBIT_YAW_RATE_SENSOR_b" UBYTE RB_RBA_Common_CentralElements_CompuMethods_Identical 1 100 0.0 255. FORMAT "%10.0" ECU_ADDRESS 0x60011214 /end MEASUREMENT
/begin MEASUREMENT ComScl_StbIntv_RawSignal_VSA_ISAB_ACT_b "NetworkSignal ComScl_StbIntv_RawSignal_VSA_ISAB_ACT_b" UBYTE RB_RBA_Common_CentralElements_CompuMethods_Identical 1 100 0.0 255. FORMAT "%10.0" ECU_ADDRESS 0x60011211 /end MEASUREMENT
/begin MEASUREMENT ComScl_StbIntv_RawSignal_VSA_ISAB_ENABLE_b "NetworkSignal ComScl_StbIntv_RawSignal_VSA_ISAB_ENABLE_b" UBYTE RB_RBA_Common_CentralElements_CompuMethods_Identical 1 100 0.0 255. FORMAT "%10.0" ECU_ADDRESS 0x60011210 /end MEASUREMENT
/begin MEASUREMENT ComScl_StbIntv_RawSignal_VSA_LAMP_STATUS_STANBY_BHOLD_b "NetworkSignal ComScl_StbIntv_RawSignal_VSA_LAMP_STATUS_STANBY_BHOLD_b" UBYTE RB_RBA_Common_CentralElements_CompuMethods_Identical 1 100 0.0 255. FORMAT "%10.0" ECU_ADDRESS 0x6001122C /end MEASUREMENT
/begin MEASUREMENT ComScl_StbIntv_RawSignal_VSA_LAMP_STATUS_VSA_OFF_b "NetworkSignal ComScl_StbIntv_RawSignal_VSA_LAMP_STATUS_VSA_OFF_b" UBYTE RB_RBA_Common_CentralElements_CompuMethods_Identical 1 100 0.0 255. FORMAT "%10.0" ECU_ADDRESS 0x6001122B /end MEASUREMENT
/begin MEASUREMENT ComScl_StbIntv_RawSignal_VSA_MASTER_CYLINDER_PRESSURE_u16 "NetworkSignal ComScl_StbIntv_RawSignal_VSA_MASTER_CYLINDER_PRESSURE_u16" UWORD RB_RBA_Common_CentralElements_CompuMethods_Identical 1 100 0.0 65535. FORMAT "%10.0" ECU_ADDRESS 0x6000AC3E /end MEASUREMENT
/begin MEASUREMENT ComScl_StbIntv_RawSignal_VSA_REQ_MSR_PLUS_TRQ_b "NetworkSignal ComScl_StbIntv_RawSignal_VSA_REQ_MSR_PLUS_TRQ_b" UBYTE RB_RBA_Common_CentralElements_CompuMethods_Identical 1 100 0.0 255. FORMAT "%10.0" ECU_ADDRESS 0x60011221 /end MEASUREMENT
/begin MEASUREMENT ComScl_StbIntv_RawSignal_VSA_REQ_TRQ_1AC_s16 "NetworkSignal ComScl_StbIntv_RawSignal_VSA_REQ_TRQ_1AC_s16" SWORD RB_RBA_Common_CentralElements_CompuMethods_Identical 1 100 -32768. 32767. FORMAT "%10.0" ECU_ADDRESS 0x6000AC34 /end MEASUREMENT
/begin MEASUREMENT ComScl_StbIntv_RawSignal_VSA_REWRITE_START_b "NetworkSignal ComScl_StbIntv_RawSignal_VSA_REWRITE_START_b" UBYTE RB_RBA_Common_CentralElements_CompuMethods_Identical 1 100 0.0 255. FORMAT "%10.0" ECU_ADDRESS 0x6001122A /end MEASUREMENT
/begin MEASUREMENT ComScl_StbIntv_RawSignal_VSA_SHIFT_REQ_1AC_u8 "NetworkSignal ComScl_StbIntv_RawSignal_VSA_SHIFT_REQ_1AC_u8" UBYTE RB_RBA_Common_CentralElements_CompuMethods_Identical 1 100 0.0 255. FORMAT "%10.0" ECU_ADDRESS 0x60011220 /end MEASUREMENT
/begin MEASUREMENT ComScl_StbIntv_RawSignal_VSA_TRQ_CONTROL_MODE_u8 "NetworkSignal ComScl_StbIntv_RawSignal_VSA_TRQ_CONTROL_MODE_u8" UBYTE RB_RBA_Common_CentralElements_CompuMethods_Identical 1 100 0.0 255. FORMAT "%10.0" ECU_ADDRESS 0x6001121F /end MEASUREMENT
/begin MEASUREMENT ComScl_StbIntv_RawSignal_VSA_TRQ_DOWN_REQ_FUEL_CUT_u8 "NetworkSignal ComScl_StbIntv_RawSignal_VSA_TRQ_DOWN_REQ_FUEL_CUT_u8" UBYTE RB_RBA_Common_CentralElements_CompuMethods_Identical 1 100 0.0 255. FORMAT "%10.0" ECU_ADDRESS 0x6001121E /end MEASUREMENT
/begin MEASUREMENT ComScl_StbIntv_RawSignal_VSA_VSA_CTRL_b "NetworkSignal ComScl_StbIntv_RawSignal_VSA_VSA_CTRL_b" UBYTE RB_RBA_Common_CentralElements_CompuMethods_Identical 1 100 0.0 255. FORMAT "%10.0" ECU_ADDRESS 0x60011229 /end MEASUREMENT
/begin MEASUREMENT ComScl_StbIntv_RawSignal_VSA_VSA_TCS_ACT_b "NetworkSignal ComScl_StbIntv_RawSignal_VSA_VSA_TCS_ACT_b" UBYTE RB_RBA_Common_CentralElements_CompuMethods_Identical 1 100 0.0 255. FORMAT "%10.0" ECU_ADDRESS 0x60011228 /end MEASUREMENT
/begin MEASUREMENT ComScl_StbIntv_RawSignal_VSA_VSA_TCS_MIL_b "NetworkSignal ComScl_StbIntv_RawSignal_VSA_VSA_TCS_MIL_b" UBYTE RB_RBA_Common_CentralElements_CompuMethods_Identical 1 100 0.0 255. FORMAT "%10.0" ECU_ADDRESS 0x60011227 /end MEASUREMENT
/begin MEASUREMENT ComScl_StbIntv_RawSignal_VSA_WARN_STATUS_ABS_b "NetworkSignal ComScl_StbIntv_RawSignal_VSA_WARN_STATUS_ABS_b" UBYTE RB_RBA_Common_CentralElements_CompuMethods_Identical 1 100 0.0 255. FORMAT "%10.0" ECU_ADDRESS 0x60011226 /end MEASUREMENT
/begin MEASUREMENT ComScl_Strg_RawSignal_EPS_ALIVE_COUNTER_1AB_u8 "NetworkSignal ComScl_Strg_RawSignal_EPS_ALIVE_COUNTER_1AB_u8" UBYTE RB_RBA_Common_CentralElements_CompuMethods_Identical 1 100 0.0 255. FORMAT "%10.0" ECU_ADDRESS 0x6001123E /end MEASUREMENT
/begin MEASUREMENT ComScl_Strg_RawSignal_EPS_CHECKSUM_1AB_u8 "NetworkSignal ComScl_Strg_RawSignal_EPS_CHECKSUM_1AB_u8" UBYTE RB_RBA_Common_CentralElements_CompuMethods_Identical 1 100 0.0 255. FORMAT "%10.0" ECU_ADDRESS 0x6001123D /end MEASUREMENT
/begin MEASUREMENT ComScl_Strg_RawSignal_EPS_IS_RELEASE_REQUEST_b "NetworkSignal ComScl_Strg_RawSignal_EPS_IS_RELEASE_REQUEST_b" UBYTE RB_RBA_Common_CentralElements_CompuMethods_Identical 1 100 0.0 255. FORMAT "%10.0" ECU_ADDRESS 0x6001123C /end MEASUREMENT
/begin MEASUREMENT ComScl_Strg_RawSignal_EPS_IS_SHIFT_INHIBIT_REQUEST_b "NetworkSignal ComScl_Strg_RawSignal_EPS_IS_SHIFT_INHIBIT_REQUEST_b" UBYTE RB_RBA_Common_CentralElements_CompuMethods_Identical 1 100 0.0 255. FORMAT "%10.0" ECU_ADDRESS 0x6001123B /end MEASUREMENT
/begin MEASUREMENT ComScl_Strg_RawSignal_EPS_LOAD_u16 "NetworkSignal ComScl_Strg_RawSignal_EPS_LOAD_u16" UWORD RB_RBA_Common_CentralElements_CompuMethods_Identical 1 100 0.0 65535. FORMAT "%10.0" ECU_ADDRESS 0x6000AC40 /end MEASUREMENT
/begin MEASUREMENT ComScl_Strg_RawSignal_EPS_MID_REQ_b "NetworkSignal ComScl_Strg_RawSignal_EPS_MID_REQ_b" UBYTE RB_RBA_Common_CentralElements_CompuMethods_Identical 1 100 0.0 255. FORMAT "%10.0" ECU_ADDRESS 0x6001123A /end MEASUREMENT
/begin MEASUREMENT rba_Dme_Ovl_stEnable "Overlay state" UBYTE RB_RBA_Common_CentralElements_CompuMethods_Identical 1 100 0.0 255. FORMAT "%5.0" ECU_ADDRESS 0x60014179 /end MEASUREMENT
/begin MEASUREMENT rba_Dme_adrError "address of vector causing error" ULONG RB_RBA_Common_CentralElements_CompuMethods_Identical 1 100 0.0 4.E9 FORMAT "%10.0" ECU_ADDRESS 0x60003AF0 /end MEASUREMENT
/begin MEASUREMENT rba_Dme_numBytesAvailable "number of bytes available for calibration" ULONG RB_RBA_Common_CentralElements_CompuMethods_Identical 1 100 0.0 4.E9 FORMAT "%10.0" ECU_ADDRESS 0x60003AF8 /end MEASUREMENT
/begin MEASUREMENT rba_Dme_numBytesAvailableOvl "number of bytes available for calibration" ULONG RB_RBA_Common_CentralElements_CompuMethods_Identical 1 100 0.0 4.E9 FORMAT "%10.0" ECU_ADDRESS 0x60003AF4 /end MEASUREMENT
/begin MEASUREMENT rba_IoExtLib_KeepAliveDrvErrCyc_u32 "KeepAlive measurement variable" ULONG RB_RBA_Common_CentralElements_CompuMethods_Identical 1 100 0.0 4.E9 FORMAT "%9.0" ECU_ADDRESS 0x600340E8 /end MEASUREMENT
/begin MEASUREMENT rba_IoExtLib_KeepAliveDrvErrPerm_u32 "KeepAlive measurement variable" ULONG RB_RBA_Common_CentralElements_CompuMethods_Identical 1 100 0.0 4.E9 FORMAT "%9.0" ECU_ADDRESS 0x600360C8 /end MEASUREMENT
/begin MEASUREMENT rba_IoExtLib_KeepAliveIniErrCyc_u32 "KeepAlive measurement variable" ULONG RB_RBA_Common_CentralElements_CompuMethods_Identical 1 100 0.0 4.E9 FORMAT "%9.0" ECU_ADDRESS 0x600340E4 /end MEASUREMENT
/begin MEASUREMENT rba_IoExtLib_KeepAliveIniErrPerm_u32 "KeepAlive measurement variable" ULONG RB_RBA_Common_CentralElements_CompuMethods_Identical 1 100 0.0 4.E9 FORMAT "%9.0" ECU_ADDRESS 0x600360C4 /end MEASUREMENT
/begin FUNCTION ComM "9.16.1  McFunction ComM Created by MCFunctionUpdater"
 /begin LOC_MEASUREMENT ComM_ChannelStruct[0].BusSmMode_u8 ComM_ChannelStruct[0].ChannelMode_u8 ComM_ChannelStruct[0].ChannelState_e ComM_ChannelStruct[0].CommunicationAllowed_b ComM_ChannelStruct[0].DiagnosticRequestState_b ComM_ChannelStruct[0].InhibitionReqStatus_u8 ComM_ChannelStruct[0].LightTimeoutCtr_u32 ComM_ChannelStruct[0].MinFullComTimeoutCtr_u16 ComM_ChannelStruct[0].NmBusSleepIndicationStatus_b ComM_ChannelStruct[0].NmNetworkModeStatus_b ComM_ChannelStruct[0].NmNetworkRequestStatus_b ComM_ChannelStruct[0].NmPrepareBusSleepIndicationStatus_b ComM_ChannelStruct[0].PassiveRequestState_u8 ComM_ChannelStruct[0].PncRequestCtr_u8 ComM_ChannelStruct[0].UserRequestCtr_u16 ComM_ChannelStruct[1].BusSmMode_u8 ComM_ChannelStruct[1].ChannelMode_u8 ComM_ChannelStruct[1].ChannelState_e ComM_ChannelStruct[1].CommunicationAllowed_b ComM_ChannelStruct[1].DiagnosticRequestState_b ComM_ChannelStruct[1].InhibitionReqStatus_u8 ComM_ChannelStruct[1].LightTimeoutCtr_u32 ComM_ChannelStruct[1].MinFullComTimeoutCtr_u16 ComM_ChannelStruct[1].NmBusSleepIndicationStatus_b ComM_ChannelStruct[1].NmNetworkModeStatus_b ComM_ChannelStruct[1].NmNetworkRequestStatus_b ComM_ChannelStruct[1].NmPrepareBusSleepIndicationStatus_b ComM_ChannelStruct[1].PassiveRequestState_u8 ComM_ChannelStruct[1].PncRequestCtr_u8 ComM_ChannelStruct[1].UserRequestCtr_u16 ComM_ChannelStruct[2].BusSmMode_u8 ComM_ChannelStruct[2].ChannelMode_u8 ComM_ChannelStruct[2].ChannelState_e ComM_ChannelStruct[2].CommunicationAllowed_b ComM_ChannelStruct[2].DiagnosticRequestState_b ComM_ChannelStruct[2].InhibitionReqStatus_u8 ComM_ChannelStruct[2].LightTimeoutCtr_u32 ComM_ChannelStruct[2].MinFullComTimeoutCtr_u16 ComM_ChannelStruct[2].NmBusSleepIndicationStatus_b ComM_ChannelStruct[2].NmNetworkModeStatus_b ComM_ChannelStruct[2].NmNetworkRequestStatus_b ComM_ChannelStruct[2].NmPrepareBusSleepIndicationStatus_b ComM_ChannelStruct[2].PassiveRequestState_u8 ComM_ChannelStruct[2].PncRequestCtr_u8 ComM_ChannelStruct[2].UserRequestCtr_u16 ComM_ChannelStruct[3].BusSmMode_u8 ComM_ChannelStruct[3].ChannelMode_u8 ComM_ChannelStruct[3].ChannelState_e ComM_ChannelStruct[3].CommunicationAllowed_b ComM_ChannelStruct[3].DiagnosticRequestState_b ComM_ChannelStruct[3].InhibitionReqStatus_u8 ComM_ChannelStruct[3].LightTimeoutCtr_u32 ComM_ChannelStruct[3].MinFullComTimeoutCtr_u16 ComM_ChannelStruct[3].NmBusSleepIndicationStatus_b ComM_ChannelStruct[3].NmNetworkModeStatus_b ComM_ChannelStruct[3].NmNetworkRequestStatus_b ComM_ChannelStruct[3].NmPrepareBusSleepIndicationStatus_b ComM_ChannelStruct[3].PassiveRequestState_u8 ComM_ChannelStruct[3].PncRequestCtr_u8 ComM_ChannelStruct[3].UserRequestCtr_u16 ComM_UserStruct[0].IndicatedUserMode_u8 ComM_UserStruct[0].LimitToNoComCtr_u16 ComM_UserStruct[0].RequestedUserMode_u8 ComM_UserStruct[0].WakeUpInhibitionCtr_u16 ComM_UserStruct[0].numChannelsInFullCom_u8 ComM_UserStruct[0].numChannelsInNoCom_u8 ComM_UserStruct[0].numChannelsInSilentCom_u8 ComM_UserStruct[1].IndicatedUserMode_u8 ComM_UserStruct[1].LimitToNoComCtr_u16 ComM_UserStruct[1].RequestedUserMode_u8 ComM_UserStruct[1].WakeUpInhibitionCtr_u16 ComM_UserStruct[1].numChannelsInFullCom_u8 ComM_UserStruct[1].numChannelsInNoCom_u8 ComM_UserStruct[1].numChannelsInSilentCom_u8 ComM_UserStruct[2].IndicatedUserMode_u8 ComM_UserStruct[2].LimitToNoComCtr_u16 ComM_UserStruct[2].RequestedUserMode_u8 ComM_UserStruct[2].WakeUpInhibitionCtr_u16 ComM_UserStruct[2].numChannelsInFullCom_u8 ComM_UserStruct[2].numChannelsInNoCom_u8 ComM_UserStruct[2].numChannelsInSilentCom_u8 ComM_UserStruct[3].IndicatedUserMode_u8 ComM_UserStruct[3].LimitToNoComCtr_u16 ComM_UserStruct[3].RequestedUserMode_u8 ComM_UserStruct[3].WakeUpInhibitionCtr_u16 ComM_UserStruct[3].numChannelsInFullCom_u8 ComM_UserStruct[3].numChannelsInNoCom_u8 ComM_UserStruct[3].numChannelsInSilentCom_u8 ComM_UserStruct[4].IndicatedUserMode_u8 ComM_UserStruct[4].LimitToNoComCtr_u16 ComM_UserStruct[4].RequestedUserMode_u8 ComM_UserStruct[4].WakeUpInhibitionCtr_u16 ComM_UserStruct[4].numChannelsInFullCom_u8 ComM_UserStruct[4].numChannelsInNoCom_u8 ComM_UserStruct[4].numChannelsInSilentCom_u8 /end LOC_MEASUREMENT
 FUNCTION_VERSION "9.16.1" /end FUNCTION
/begin FUNCTION Fee "5.40.2  McFunction Fee Created by MCFunctionUpdater" /begin LOC_MEASUREMENT Fee_SecChngCnt_u32 /end LOC_MEASUREMENT FUNCTION_VERSION "5.40.2" /end FUNCTION
/begin FUNCTION Lin "8.11.0  McFunction Lin Created by MCFunctionUpdater"
 /begin LOC_MEASUREMENT Lin_ChnlVar_MP[0].CSmodel Lin_ChnlVar_MP[0].ChannelState Lin_ChnlVar_MP[0].FramePid Lin_ChnlVar_MP[0].FrameType Lin_ChnlVar_MP[0].GotoSleepCtr Lin_ChnlVar_MP[0].Length Lin_ChnlVar_MP[0].Lin_Buf_au8 Lin_ChnlVar_MP[0].Status Lin_DrvFlags_MP /end LOC_MEASUREMENT
 FUNCTION_VERSION "8.11.0" /end FUNCTION
/begin FUNCTION LinIf "9.16.2  McFunction LinIf Created by MCFunctionUpdater"
 /begin LOC_MEASUREMENT LinIf_ChnlVar_as[0].ChannelStateFlag_u8 LinIf_ChnlVar_as[0].ChannelStatusFlags_u8 LinIf_ChnlVar_as[0].CurrentIndex_u8 LinIf_ChnlVar_as[0].CurrentScheduleTable_u8 LinIf_ChnlVar_as[0].DelayCount_u8 LinIf_ChnlVar_as[0].GotoSleepCtr LinIf_ChnlVar_as[0].NewScheduleTable_u8 LinIf_ChnlVar_as[0].SavedIndex_u8 LinIf_ChnlVar_as[0].SavedScheduleTable_u8 LinIf_ChnlVar_as[0].SlpGetStatus_u8 LinIf_ChnlVar_as[0].SpoETIndex_u8 LinIf_ChnlVar_as[0].Temp_SpoFrmCount_u8 LinIf_ChnlVar_as[0].TransmitSRF_u8 LinIf_ChnlVar_as[0].Wakeup_u8 LinIf_Status_u8 /end LOC_MEASUREMENT
 FUNCTION_VERSION "9.16.2" /end FUNCTION
/begin FUNCTION LinSM "5.13.0  McFunction LinSM Created by MCFunctionUpdater"
 /begin LOC_MEASUREMENT LinSM_ModeRepeatReq_Max_u8 LinSM_RamVar_ast[0].ChnlState LinSM_RamVar_ast[0].LinSmModReqRepMax LinSM_RamVar_ast[0].LinSm_Conf_Status LinSM_RamVar_ast[0].LinSm_Request_Status LinSM_RamVar_ast[0].LinSm_SchdReq_E_NOT_OK LinSM_RamVar_ast[0].LinSm_Sleep_Status LinSM_RamVar_ast[0].StoredSchdTab LinSM_RamVar_ast[0].TimeOutCounter LinSM_RamVar_ast[0].TimeoutFlag LinSM_State_en /end LOC_MEASUREMENT
 FUNCTION_VERSION "5.13.0" /end FUNCTION
/begin FUNCTION PduR "15.16.2  McFunction PduR Created by MCFunctionUpdater" /begin LOC_MEASUREMENT PduR_State /end LOC_MEASUREMENT FUNCTION_VERSION "15.16.2" /end FUNCTION
/begin FUNCTION rba_ComScl "4.17.3_6.0.0  McFunction rba_ComScl Created by MCFunctionUpdater"
 /begin LOC_MEASUREMENT ComScl_Bdy_RawSignal_PCU_ALIVE_COUNTER_45B_u8 ComScl_Bdy_RawSignal_PCU_CHECKSUM_45B_u8 ComScl_Bdy_RawSignal_PCU_REM_ENG_START_b ComScl_Bdy_RawSignal_SRS_ALIVE_COUNTER_039_u8 ComScl_Bdy_RawSignal_SRS_ALIVE_COUNTER_094_u8 ComScl_Bdy_RawSignal_SRS_ALIVE_COUNTER_305_u8 ComScl_Bdy_RawSignal_SRS_CAL_LAT_G_b ComScl_Bdy_RawSignal_SRS_CAL_LON_G_b ComScl_Bdy_RawSignal_SRS_CHECKSUM_039_u8 ComScl_Bdy_RawSignal_SRS_CHECKSUM_094_u8 ComScl_Bdy_RawSignal_SRS_CHECKSUM_305_u8 ComScl_Bdy_RawSignal_SRS_DR_BELT_STATUS_u8 ComScl_Bdy_RawSignal_SRS_HI_CDS_b ComScl_Bdy_RawSignal_SRS_LAT_G_u16 ComScl_Bdy_RawSignal_SRS_LON_G_u16 ComScl_Bdy_RawSignal_SRS_P_ERR_LAT_G_b ComScl_Bdy_RawSignal_SRS_P_ERR_LON_G_b ComScl_Bdy_RawSignal_SRS_P_ERR_YAW1_b ComScl_Bdy_RawSignal_SRS_SENSOR_ERR_MC_b ComScl_Bdy_RawSignal_SRS_SENSOR_START_UP_b ComScl_Bdy_RawSignal_SRS_SENSOR_STATE_IG_b ComScl_Bdy_RawSignal_SRS_T_ERR_LAT_G_b ComScl_Bdy_RawSignal_SRS_T_ERR_LON_G_b ComScl_Bdy_RawSignal_SRS_T_ERR_YAW1_b ComScl_Bdy_RawSignal_SRS_YAW_1_u16 ComScl_Dspl_RawSignal_METER_AC_ACGUP_REQ_b ComScl_Dspl_RawSignal_METER_AC_FR_BLW_VF_u8 ComScl_Dspl_RawSignal_METER_AC_HACCUT_NG_2_u8 ComScl_Dspl_RawSignal_METER_AC_HACCUT_NG_u8 ComScl_Dspl_RawSignal_METER_AC_OUTAIRTEMP01_u8 ComScl_Dspl_RawSignal_METER_AC_PTC_STATUS_u8 ComScl_Dspl_RawSignal_METER_AC_RRDEF_b ComScl_Dspl_RawSignal_METER_AC_RR_BLW_VF_u8 ComScl_Dspl_RawSignal_METER_AC_TEVATEMP05_u8 ComScl_Dspl_RawSignal_METER_AC_TYPE_ECON_b ComScl_Dspl_RawSignal_METER_AC_VARI_u8 ComScl_Dspl_RawSignal_METER_ALIVE_COUNTER_221_2_u8 ComScl_Dspl_RawSignal_METER_ALIVE_COUNTER_221_u8 ComScl_Dspl_RawSignal_METER_ALIVE_COUNTER_296_u8 ComScl_Dspl_RawSignal_METER_ALIVE_COUNTER_309_u8 ComScl_Dspl_RawSignal_METER_ALIVE_COUNTER_326_u8 ComScl_Dspl_RawSignal_METER_ALIVE_COUNTER_331_u8 ComScl_Dspl_RawSignal_METER_ALIVE_COUNTER_371_u8 ComScl_Dspl_RawSignal_METER_ALIVE_COUNTER_372_2_u8 ComScl_Dspl_RawSignal_METER_ALIVE_COUNTER_372_u8 ComScl_Dspl_RawSignal_METER_ALIVE_COUNTER_374_u8 ComScl_Dspl_RawSignal_METER_ALIVE_COUNTER_37B_u8 ComScl_Dspl_RawSignal_METER_ALIVE_COUNTER_396_u8 ComScl_Dspl_RawSignal_METER_ALIVE_COUNTER_3A1_u8 ComScl_Dspl_RawSignal_METER_ALIVE_COUNTER_510_u8 ComScl_Dspl_RawSignal_METER_ALIVE_COUNTER_516_u8 ComScl_Dspl_RawSignal_METER_ASL_CAN_ERROR_b ComScl_Dspl_RawSignal_METER_BCAN_FAILCODE_BCAN_b ComScl_Dspl_RawSignal_METER_BCAN_FAILCODE_COMB_UNIT_b ComScl_Dspl_RawSignal_METER_BCAN_FAILCODE_HAC_b ComScl_Dspl_RawSignal_METER_BCAN_FAILCODE_MCU_UNIT_b ComScl_Dspl_RawSignal_METER_BCAN_REPRO_b ComScl_Dspl_RawSignal_METER_CC_MAIN_STATUS_b ComScl_Dspl_RawSignal_METER_CC_TARGETSP_DISP_b ComScl_Dspl_RawSignal_METER_CHECKSUM_221_2_u8 ComScl_Dspl_RawSignal_METER_CHECKSUM_221_u8 ComScl_Dspl_RawSignal_METER_CHECKSUM_296_u8 ComScl_Dspl_RawSignal_METER_CHECKSUM_309_u8 ComScl_Dspl_RawSignal_METER_CHECKSUM_326_u8 ComScl_Dspl_RawSignal_METER_CHECKSUM_331_u8 ComScl_Dspl_RawSignal_METER_CHECKSUM_371_u8 ComScl_Dspl_RawSignal_METER_CHECKSUM_372_2_u8 ComScl_Dspl_RawSignal_METER_CHECKSUM_372_u8 ComScl_Dspl_RawSignal_METER_CHECKSUM_374_u8 ComScl_Dspl_RawSignal_METER_CHECKSUM_37B_u8 ComScl_Dspl_RawSignal_METER_CHECKSUM_396_u8 ComScl_Dspl_RawSignal_METER_CHECKSUM_3A1_u8 ComScl_Dspl_RawSignal_METER_CHECKSUM_510_u8 ComScl_Dspl_RawSignal_METER_CHECKSUM_516_u8 ComScl_Dspl_RawSignal_METER_COMPCURRENT_HIBYTE_u8 ComScl_Dspl_RawSignal_METER_COMPCURRENT_LOWBYTE_u8 ComScl_Dspl_RawSignal_METER_CUSTOM_DEFAULT_b ComScl_Dspl_RawSignal_METER_CUSTOM_KJ_SPEED_LIMITER_b ComScl_Dspl_RawSignal_METER_CUSTOM_STATUS_b ComScl_Dspl_RawSignal_METER_DIGITAL_SPEED_DISPLAY_u8 ComScl_Dspl_RawSignal_METER_DIGITAL_SPEED_TARGET_u16 ComScl_Dspl_RawSignal_METER_DISPLAY_SPEED_u16 ComScl_Dspl_RawSignal_METER_ECONSW_ON_2_b ComScl_Dspl_RawSignal_METER_EVA_TEMP_2_u8 ComScl_Dspl_RawSignal_METER_EVA_TEMP_u8 ComScl_Dspl_RawSignal_METER_FRDEF_b ComScl_Dspl_RawSignal_METER_FRFOGRLY_b ComScl_Dspl_RawSignal_METER_FUEL_LEVEL_RAW_u8 ComScl_Dspl_RawSignal_METER_ICU_ACBLW_VD_u8 ComScl_Dspl_RawSignal_METER_ICU_HOOD_2_b ComScl_Dspl_RawSignal_METER_ICU_HOOD_ERR_2_b ComScl_Dspl_RawSignal_METER_ICU_HOOD_ERR_b ComScl_Dspl_RawSignal_METER_ICU_HOOD_b ComScl_Dspl_RawSignal_METER_IN_AIR_TEMP_u8 ComScl_Dspl_RawSignal_METER_IS_INHIBITSW_ON_2_b ComScl_Dspl_RawSignal_METER_IS_INHIBITSW_ON_b ComScl_Dspl_RawSignal_METER_IS_PERMIT_b ComScl_Dspl_RawSignal_METER_IS_TIME_2_u8 ComScl_Dspl_RawSignal_METER_IS_TIME_u8 ComScl_Dspl_RawSignal_METER_KLDDORLOCK_2_u8 ComScl_Dspl_RawSignal_METER_MICU_FRDEICERRLY_b ComScl_Dspl_RawSignal_METER_MICU_FRWIPMTR_u8 ComScl_Dspl_RawSignal_METER_MICU_RRDEFSW_b ComScl_Dspl_RawSignal_METER_MICU_TYPE_b ComScl_Dspl_RawSignal_METER_ODODATA_STATE_b ComScl_Dspl_RawSignal_METER_ODO_DATA_u32 ComScl_Dspl_RawSignal_METER_OIL_LIFE_RESSW_b ComScl_Dspl_RawSignal_METER_OUTTEMP_u8 ComScl_Dspl_RawSignal_METER_OUT_AIR_TEMP_u8 ComScl_Dspl_RawSignal_METER_RM_DRLKC_b ComScl_Dspl_RawSignal_METER_RM_HLHIRLY_b ComScl_Dspl_RawSignal_METER_RM_HLLORLY_b ComScl_Dspl_RawSignal_METER_RM_ILL_SML_b ComScl_Dspl_RawSignal_METER_RRFOGRLY_b ComScl_Dspl_RawSignal_METER_SPEED_UNIT_b ComScl_Dspl_RawSignal_METER_SW_STATUS_CC_STANDARD_u8 ComScl_Dspl_RawSignal_METER_SW_STATUS_HAC_2_b ComScl_Dspl_RawSignal_METER_SW_STATUS_HAC_b ComScl_Dspl_RawSignal_METER_SW_STATUS_IS_INH_b ComScl_Dspl_RawSignal_METER_SW_STATUS_LKAS_CCLIM_DIST_u8 ComScl_Dspl_RawSignal_METER_SW_STATUS_PARK_BRAKE_b ComScl_Dspl_RawSignal_METER_WIPER_STATUS_u8 ComScl_EngLin_RawSignal_Lin_Alt_B_Signal_ACG_Temp_8_r_msg_u8 ComScl_EngLin_RawSignal_Lin_Alt_B_Signal_ComTOut_1_r_msg_b ComScl_EngLin_RawSignal_Lin_Alt_B_Signal_Com_1_r_msg_b ComScl_EngLin_RawSignal_Lin_Alt_B_Signal_Dyc_5_r_msg_u8 ComScl_EngLin_RawSignal_Lin_Alt_B_Signal_Elec_1_r_msg_b ComScl_EngLin_RawSignal_Lin_Alt_B_Signal_ExctCrnt_8_r_msg_u8 ComScl_EngLin_RawSignal_Lin_Alt_B_Signal_HiTemp_1_r_msg_b ComScl_EngLin_RawSignal_Lin_Alt_B_Signal_Mchn_1_r_msg_b ComScl_EngLin_RawSignal_Lin_BS_B_Signal_OCV_8_r_msg_u8 ComScl_EngLin_RawSignal_Lin_BS_B_Signal_STBATTSENRST_1_r_msg_b ComScl_EngLin_RawSignal_Lin_BS_B_Signal_TASIC_8_r_msg_u8 ComScl_EngLin_RawSignal_Lin_BS_B_Signal_tiDurAftIgnOff_16_r_msg_u16 ComScl_EngLin_RawSignal_Lin_BS_Signal_B_BATTCH_16_r_msg_u16 ComScl_EngLin_RawSignal_Lin_BS_Signal_B_BATTDCHA_16_r_msg_u16 ComScl_EngLin_RawSignal_Lin_BS_Signal_B_BATT_REPLACE_1_r_msg_b ComScl_EngLin_RawSignal_Lin_BS_Signal_B_BATT_SIZE_DETECT_1_r_msg_b ComScl_EngLin_RawSignal_Lin_BS_Signal_B_BATT_WARM_LEVEL_3_r_msg_u8 ComScl_EngLin_RawSignal_Lin_BS_Signal_B_BCF_1_r_msg_b ComScl_EngLin_RawSignal_Lin_BS_Signal_B_CHARGE_LOW_1_r_msg_b ComScl_EngLin_RawSignal_Lin_BS_Signal_B_CTINTRESUPD_2_r_msg_u8 ComScl_EngLin_RawSignal_Lin_BS_Signal_B_DATA_FORMAT_8_r_msg_u8 ComScl_EngLin_RawSignal_Lin_BS_Signal_B_ERROR_RES_1_r_msg_b ComScl_EngLin_RawSignal_Lin_BS_Signal_B_HARNR_2_r_msg_u8 ComScl_EngLin_RawSignal_Lin_BS_Signal_B_IBAT_16_r_msg_u16 ComScl_EngLin_RawSignal_Lin_BS_Signal_B_IBAT_8_r_msg_u8 ComScl_EngLin_RawSignal_Lin_BS_Signal_B_IOP_ERROR_1_r_msg_b ComScl_EngLin_RawSignal_Lin_BS_Signal_B_MEASDR_2_r_msg_u8 ComScl_EngLin_RawSignal_Lin_BS_Signal_B_RESMEASDBATT_16_r_msg_u16 ComScl_EngLin_RawSignal_Lin_BS_Signal_B_RI_ST_OTHER_MEASURE_16_r_msg_u16 ComScl_EngLin_RawSignal_Lin_BS_Signal_B_SOC_8_r_msg_u8 ComScl_EngLin_RawSignal_Lin_BS_Signal_B_SOC_STATE_3_r_msg_u8 ComScl_EngLin_RawSignal_Lin_BS_Signal_B_SOFV_RESTART_8_r_msg_u8 ComScl_EngLin_RawSignal_Lin_BS_Signal_B_SOFV_RESTART_STATE_1_r_msg_b ComScl_EngLin_RawSignal_Lin_BS_Signal_B_SOH_COR_8_r_msg_u8 ComScl_EngLin_RawSignal_Lin_BS_Signal_B_SOH_COR_STATE_1_r_msg_b ComScl_EngLin_RawSignal_Lin_BS_Signal_B_SOH_LAM_8_r_msg_u8 ComScl_EngLin_RawSignal_Lin_BS_Signal_B_SOH_LAM_STATE_1_r_msg_b ComScl_EngLin_RawSignal_Lin_BS_Signal_B_SOH_SUL_8_r_msg_u8 ComScl_EngLin_RawSignal_Lin_BS_Signal_B_SOH_SUL_STATE_1_r_msg_b ComScl_EngLin_RawSignal_Lin_BS_Signal_B_SUPPLIER_CODE_8_r_msg_u8 ComScl_EngLin_RawSignal_Lin_BS_Signal_B_TBAT_8_r_msg_u8 ComScl_EngLin_RawSignal_Lin_BS_Signal_B_UBAT_16_r_msg_u16 ComScl_EngLin_RawSignal_Lin_BS_Signal_B_iStByCurrAft0h_10_r_msg_u16 ComScl_EngLin_RawSignal_Lin_BS_Signal_B_iStByCurrAft1h_10_r_msg_u16 ComScl_EngLin_RawSignal_Lin_BS_Signal_B_iStByCurrAft2h_10_r_msg_u16 ComScl_EngLin_RawSignal_Lin_BS_Signal_B_iStByCurrLst_10_r_msg_u16 ComScl_EngLin_RawSignal_Lin_BS_Signal_CHARERR_1_r_msg_b ComScl_EngLin_RawSignal_Lin_BS_Signal_ERRCMN_1_r_msg_b ComScl_EngLin_RawSignal_Lin_BS_Signal_ERRST_1_r_msg_b ComScl_EngLin_RawSignal_Lin_BS_Signal_IBATTAVGLINOFF_8_r_msg_u8 ComScl_EngLin_RawSignal_Lin_DCDC_Signal_nrSwVers_3_r_msg_u8 ComScl_EngLin_RawSignal_Lin_DCDC_Signal_stBoosterErr_1_r_msg_b ComScl_EngLin_RawSignal_Lin_DCDC_Signal_stCSTErr_1_r_msg_b ComScl_EngLin_RawSignal_Lin_DCDC_Signal_stCSTHist_1_r_msg_b ComScl_EngLin_RawSignal_Lin_DCDC_Signal_stDCLinRVer_1_r_msg_b ComScl_EngLin_RawSignal_Lin_DCDC_Signal_stInpErr1_1_r_msg_b ComScl_EngLin_RawSignal_Lin_DCDC_Signal_stInpErr2_1_r_msg_b ComScl_EngLin_RawSignal_Lin_DCDC_Signal_stIntErr_1_r_msg_b ComScl_EngLin_RawSignal_Lin_DCDC_Signal_stMode_1_r_msg_b ComScl_EngLin_RawSignal_Lin_DCDC_Signal_stOutpErr1_1_r_msg_b ComScl_EngLin_RawSignal_Lin_DCDC_Signal_stOutpErr2_1_r_msg_b ComScl_EngLin_RawSignal_Lin_DCDC_Signal_stTempWarn1_1_r_msg_b ComScl_EngLin_RawSignal_Lin_DCDC_Signal_stTempWarn2_1_r_msg_b ComScl_EngLin_RawSignal_Lin_DCDC_Signal_stUnitSt_1_r_msg_b ComScl_Gbx_RawSignal_CVT_MISS_MILON_REQ_FLAG_b ComScl_Gbx_RawSignal_CVT_MISS_VSENS_FAIL_FLAG_b ComScl_Gbx_RawSignal_CVT_MISS_VSENS_OK_FLAG_b ComScl_Gbx_RawSignal_CVT_MISS_VSENS_TFCD_FLAG_b ComScl_Gbx_RawSignal_CVT_RATIO_INFO_191_u8 ComScl_Gbx_RawSignal_CVT_SHFT_IN_D_b ComScl_Gbx_RawSignal_CVT_SHFT_IN_L_b ComScl_Gbx_RawSignal_CVT_SHFT_IN_NEUTRAL_b ComScl_Gbx_RawSignal_CVT_SHFT_IN_PARKING_b ComScl_Gbx_RawSignal_CVT_SHFT_IN_REVERSE_b ComScl_Gbx_RawSignal_CVT_SHFT_IN_S_b ComScl_Gbx_RawSignal_CVT_SHIFT_SURE_b ComScl_Gbx_RawSignal_CVT_TRANS_MIL_b ComScl_Gbx_RawSignal_EAT_ALIVE_COUNTER_158_u8 ComScl_Gbx_RawSignal_EAT_ALIVE_COUNTER_191_u8 ComScl_Gbx_RawSignal_EAT_ALIVE_COUNTER_41B_u8 ComScl_Gbx_RawSignal_EAT_ATF_TEMP_INVALID_b ComScl_Gbx_RawSignal_EAT_CHECKSUM_158_u8 ComScl_Gbx_RawSignal_EAT_CHECKSUM_191_u8 ComScl_Gbx_RawSignal_EAT_CHECKSUM_41B_u8 ComScl_Gbx_RawSignal_EAT_REF_DISTANCE_TRAVELLED_u8 ComScl_Gbx_RawSignal_EAT_TRANS_MAIN_SHAFT_SPEED_u16 ComScl_Gbx_RawSignal_EAT_TRANS_SPEED_VNC_u16 ComScl_Gbx_RawSignal_EAT_TRANS_SPEED_u16 ComScl_Gbx_RawSignal_TM_ALCZONE_u8 ComScl_Gbx_RawSignal_TM_ALIVE_COUNTER_071_u8 ComScl_Gbx_RawSignal_TM_ALIVE_COUNTER_072_u8 ComScl_Gbx_RawSignal_TM_ALIVE_COUNTER_07B_u8 ComScl_Gbx_RawSignal_TM_ALIVE_COUNTER_07C_u8 ComScl_Gbx_RawSignal_TM_ALIVE_COUNTER_07E_u8 ComScl_Gbx_RawSignal_TM_ALIVE_COUNTER_19D_u8 ComScl_Gbx_RawSignal_TM_ALIVE_COUNTER_1BF_u8 ComScl_Gbx_RawSignal_TM_ALIVE_COUNTER_1F0_u8 ComScl_Gbx_RawSignal_TM_ALIVE_COUNTER_351_u8 ComScl_Gbx_RawSignal_TM_ALIVE_COUNTER_40B_u8 ComScl_Gbx_RawSignal_TM_ATF_TEMP_u8 ComScl_Gbx_RawSignal_TM_AT_CC_FWD_b ComScl_Gbx_RawSignal_TM_CHECKSUM_071_u8 ComScl_Gbx_RawSignal_TM_CHECKSUM_072_u8 ComScl_Gbx_RawSignal_TM_CHECKSUM_07B_u8 ComScl_Gbx_RawSignal_TM_CHECKSUM_07C_u8 ComScl_Gbx_RawSignal_TM_CHECKSUM_07E_u8 ComScl_Gbx_RawSignal_TM_CHECKSUM_19D_u8 ComScl_Gbx_RawSignal_TM_CHECKSUM_1BF_u8 ComScl_Gbx_RawSignal_TM_CHECKSUM_1F0_u8 ComScl_Gbx_RawSignal_TM_CHECKSUM_351_u8 ComScl_Gbx_RawSignal_TM_CHECKSUM_40B_u8 ComScl_Gbx_RawSignal_TM_CVTNP_FLAG_b ComScl_Gbx_RawSignal_TM_DEC_FC_LC_OK_b ComScl_Gbx_RawSignal_TM_ECON_POS_FAIL_OK_b ComScl_Gbx_RawSignal_TM_FAULT_ACTION_STATUS_VSP_FAIL_b ComScl_Gbx_RawSignal_TM_F_DFTRFENTM_b ComScl_Gbx_RawSignal_TM_GEARPOS_N_DET_b ComScl_Gbx_RawSignal_TM_GEARPOS_P_DETSUB_b ComScl_Gbx_RawSignal_TM_GEARPOS_P_DET_b ComScl_Gbx_RawSignal_TM_GEARPOS_P_REQSUB_b ComScl_Gbx_RawSignal_TM_HACCUT_REQ_b ComScl_Gbx_RawSignal_TM_HEAVY_DEC_FLAG_b ComScl_Gbx_RawSignal_TM_IDLE_STOP_CONDITION_b ComScl_Gbx_RawSignal_TM_IDLE_STOP_OK_b ComScl_Gbx_RawSignal_TM_IDLE_STOP_TRIGGER_b ComScl_Gbx_RawSignal_TM_IG1_STATE_b ComScl_Gbx_RawSignal_TM_IG1_VOLTAGE_u16 ComScl_Gbx_RawSignal_TM_LC_INFORMATION_u8 ComScl_Gbx_RawSignal_TM_LIMP_HOME_MODE_b ComScl_Gbx_RawSignal_TM_MAP_CC_u8 ComScl_Gbx_RawSignal_TM_MIL_REQUEST_b ComScl_Gbx_RawSignal_TM_M_MODE_RUN_b ComScl_Gbx_RawSignal_TM_N_TC_u16 ComScl_Gbx_RawSignal_TM_OVERALL_FILTERED_RATIO_u16 ComScl_Gbx_RawSignal_TM_RECOGNITION_VOLTAGE_u16 ComScl_Gbx_RawSignal_TM_REQ_ENG_TORQUE_FAST_s16 ComScl_Gbx_RawSignal_TM_REQ_ENG_TORQUE_SLOW_s16 ComScl_Gbx_RawSignal_TM_REQ_MAX_FC_LIMT_ENG_SPEED_u8 ComScl_Gbx_RawSignal_TM_REQ_MAX_TQ_LIMT_ENG_SPEED_u8 ComScl_Gbx_RawSignal_TM_REQ_MIN_IDLE_ENG_SPEED_u8 ComScl_Gbx_RawSignal_TM_SHFT_IND_RECOM_DOWN_b ComScl_Gbx_RawSignal_TM_SHFT_IND_RECOM_UP_b ComScl_Gbx_RawSignal_TM_SHIFT_CONTROL_MODE_u8 ComScl_Gbx_RawSignal_TM_START_ENABLESUB_b ComScl_Gbx_RawSignal_TM_START_ENABLE_b ComScl_Gbx_RawSignal_TM_TORQUE_CONVERTER_SLIP_u16 ComScl_Gbx_RawSignal_TM_TORQUE_CONV_TORQUE_RATIO_u16 ComScl_Gbx_RawSignal_TM_TORQUE_LOSSES_s16 ComScl_Gbx_RawSignal_TM_TRQ_CONTROL_MODE_FAST_DNREQ_b ComScl_Gbx_RawSignal_TM_TRQ_CONTROL_MODE_SLOW_DNREQ_b ComScl_Gbx_RawSignal_TM_TRS_DRV_RATIO_u8 ComScl_Gbx_RawSignal_TM_VEHICLE_SPEED_u16 ComScl_Gbx_RawSignal_TM_VLVW_u16 ComScl_Gbx_RawSignal_TM_VSA_INH_b ComScl_Gbx_RawSignal_TM_WRITE_VIN_CLEAR_DONE_b ComScl_Gw_RawSignal_GW_ALIVE_COUNTER_40E_u8 ComScl_Gw_RawSignal_GW_ALIVE_COUNTER_444_u8 ComScl_Gw_RawSignal_GW_CHECKSUM_40E_u8 ComScl_Gw_RawSignal_GW_CHECKSUM_444_u8 ComScl_Gw_RawSignal_GW_IG1_STATE_b ComScl_Gw_RawSignal_GW_IG1_VOLTAGE_u16 ComScl_Gw_RawSignal_GW_RECOGNITION_VOLTAGE_u16 ComScl_Gw_RawSignal_IMG_ALIVE_COUNTER_082_u8 ComScl_Gw_RawSignal_IMG_ALIVE_COUNTER_084_u8 ComScl_Gw_RawSignal_IMG_ALIVE_COUNTER_22B_u8 ComScl_Gw_RawSignal_IMG_ALIVE_COUNTER_2F1_u8 ComScl_Gw_RawSignal_IMG_CHECKSUM_082_u8 ComScl_Gw_RawSignal_IMG_CHECKSUM_084_u8 ComScl_Gw_RawSignal_IMG_CHECKSUM_22B_u8 ComScl_Gw_RawSignal_IMG_CHECKSUM_2F1_u8 ComScl_Gw_RawSignal_IMG_DRVTRQ_STATUS_u8 ComScl_Gw_RawSignal_IMG_ENG_CAN_RECIEVE_ERROR_b ComScl_Gw_RawSignal_IMG_F_WVINCLDN_b ComScl_Gw_RawSignal_IMG_IDS_GRP_A12_MODE_u8 ComScl_Gw_RawSignal_IMG_IDS_GRP_A5_MODE_u8 ComScl_Gw_RawSignal_IMG_IS_BHOLD_ACT_b ComScl_Gw_RawSignal_IMG_IS_BHOLD_STANBY_b ComScl_Gw_RawSignal_IMG_IS_BRKCNT_ADAS_b ComScl_Gw_RawSignal_IMG_IS_INHIBITBRK_b ComScl_Gw_RawSignal_IMG_IS_RELEASE_REQUEST_b ComScl_Gw_RawSignal_IMG_IS_RESTART_INHIBITBRK_b ComScl_Gw_RawSignal_IMG_IS_SHIFT_INHBITBRK_b ComScl_Gw_RawSignal_IMG_IS_SYSOFFBRK_b ComScl_Gw_RawSignal_IMG_LIMTRQ_STATUS_u8 ComScl_Gw_RawSignal_IMG_MIL_REQ_b ComScl_Gw_RawSignal_IMG_REQ_BRK_CTRL_b ComScl_Gw_RawSignal_IMG_REQ_DRVTRQ_s16 ComScl_Gw_RawSignal_IMG_REQ_LIMTRQ_s16 ComScl_Gw_RawSignal_IMG_SHIFT_REQUEST_u8 ComScl_IDAS_RawSignal_IDAS_ALIVE_COUNTER_1EF_u8 ComScl_IDAS_RawSignal_IDAS_CHECKSUM_1EF_u8 ComScl_IDAS_RawSignal_IDAS_ISA_BASE_SPEED_u8 ComScl_PCU_RawSignal_PCU_ALIVE_COUNTER_1FB_u8 ComScl_PCU_RawSignal_PCU_CHECKSUM_1FB_u8 ComScl_PCU_RawSignal_PCU_INHBIT_START_ENG_b ComScl_StbIntv_RawSignal_EPB_ALIVE_COUNTER_112_u8 ComScl_StbIntv_RawSignal_EPB_ALIVE_COUNTER_1C2_u8 ComScl_StbIntv_RawSignal_EPB_APPLIED_b ComScl_StbIntv_RawSignal_EPB_CHECKSUM_112_u8 ComScl_StbIntv_RawSignal_EPB_CHECKSUM_1C2_u8 ComScl_StbIntv_RawSignal_EPB_CLUTCH_PEADAL_STROKE_u8 ComScl_StbIntv_RawSignal_EPB_CLUTCH_PEDAL_FAIL_DETECT_b ComScl_StbIntv_RawSignal_EPB_CLUTCH_PEDAL_FAIL_b ComScl_StbIntv_RawSignal_EPB_CPS1_OUTPUT_VOLTAGE_u16 ComScl_StbIntv_RawSignal_EPB_CPS2_OUTPUT_VOLTAGE_u16 ComScl_StbIntv_RawSignal_EPB_INHIBIT_ACT_b ComScl_StbIntv_RawSignal_EPB_PLANT_SAFETY_MODE_STATUS_b ComScl_StbIntv_RawSignal_EPB_REFUSE_ACT_b ComScl_StbIntv_RawSignal_EPB_STATE_u8 ComScl_StbIntv_RawSignal_VSA_ABS_CHECKSUM_1D0_u8 ComScl_StbIntv_RawSignal_VSA_ABS_CTRL_b ComScl_StbIntv_RawSignal_VSA_ABS_EBD_ACT_b ComScl_StbIntv_RawSignal_VSA_ABS_EBD_MIL_b ComScl_StbIntv_RawSignal_VSA_ABS_FAIL_FL_VW_SENSOR_b ComScl_StbIntv_RawSignal_VSA_ABS_FAIL_FR_VW_SENSOR_b ComScl_StbIntv_RawSignal_VSA_ABS_FAIL_RL_VW_SENSOR_b ComScl_StbIntv_RawSignal_VSA_ABS_FAIL_RR_VW_SENSOR_b ComScl_StbIntv_RawSignal_VSA_ABS_FL_WHEEL_SPEED_u16 ComScl_StbIntv_RawSignal_VSA_ABS_FR_WHEEL_SPEED_u16 ComScl_StbIntv_RawSignal_VSA_ABS_RL_WHEEL_SPEED_u16 ComScl_StbIntv_RawSignal_VSA_ABS_RR_WHEEL_SPEED_u16 ComScl_StbIntv_RawSignal_VSA_ACC_BRAKE_ACT_b ComScl_StbIntv_RawSignal_VSA_ALIVECOUNTER_1AC_u8 ComScl_StbIntv_RawSignal_VSA_ALIVE_COUNTER_12E_u8 ComScl_StbIntv_RawSignal_VSA_ALIVE_COUNTER_1A4_u8 ComScl_StbIntv_RawSignal_VSA_ALIVE_COUNTER_1B0_u8 ComScl_StbIntv_RawSignal_VSA_BHOLD_STATUS_ACT_b ComScl_StbIntv_RawSignal_VSA_CASEN_b ComScl_StbIntv_RawSignal_VSA_CAS_ACT_b ComScl_StbIntv_RawSignal_VSA_CHECKSUM_12E_u8 ComScl_StbIntv_RawSignal_VSA_CHECKSUM_1A4_u8 ComScl_StbIntv_RawSignal_VSA_CHECKSUM_1AC_u8 ComScl_StbIntv_RawSignal_VSA_CHECKSUM_1B0_u8 ComScl_StbIntv_RawSignal_VSA_DRV_BRKTRQ_AYCI_u16 ComScl_StbIntv_RawSignal_VSA_DRV_BRKTRQ_u16 ComScl_StbIntv_RawSignal_VSA_ECD_ACT_b ComScl_StbIntv_RawSignal_VSA_EPB_INHIBIT_BRAKE_b ComScl_StbIntv_RawSignal_VSA_FAIL_LONG_G_SENSOR_b ComScl_StbIntv_RawSignal_VSA_FAIL_MC_PRESSURE_SENSOR_b ComScl_StbIntv_RawSignal_VSA_FAIL_YAW_RATE_SENSOR_b ComScl_StbIntv_RawSignal_VSA_HSA_STATUS_ACT_b ComScl_StbIntv_RawSignal_VSA_INHBIT_LONG_G_SENSOR_b ComScl_StbIntv_RawSignal_VSA_INHBIT_MC_PRESSURE_SENSOR_b ComScl_StbIntv_RawSignal_VSA_INHBIT_YAW_RATE_SENSOR_b ComScl_StbIntv_RawSignal_VSA_ISAB_ACT_b ComScl_StbIntv_RawSignal_VSA_ISAB_ENABLE_b ComScl_StbIntv_RawSignal_VSA_LAMP_STATUS_STANBY_BHOLD_b ComScl_StbIntv_RawSignal_VSA_LAMP_STATUS_VSA_OFF_b ComScl_StbIntv_RawSignal_VSA_MASTER_CYLINDER_PRESSURE_u16 ComScl_StbIntv_RawSignal_VSA_REQ_MSR_PLUS_TRQ_b ComScl_StbIntv_RawSignal_VSA_REQ_TRQ_1AC_s16 ComScl_StbIntv_RawSignal_VSA_REWRITE_START_b ComScl_StbIntv_RawSignal_VSA_SHIFT_REQ_1AC_u8 ComScl_StbIntv_RawSignal_VSA_TRQ_CONTROL_MODE_u8 ComScl_StbIntv_RawSignal_VSA_TRQ_DOWN_REQ_FUEL_CUT_u8 ComScl_StbIntv_RawSignal_VSA_VSA_CTRL_b ComScl_StbIntv_RawSignal_VSA_VSA_TCS_ACT_b ComScl_StbIntv_RawSignal_VSA_VSA_TCS_MIL_b ComScl_StbIntv_RawSignal_VSA_WARN_STATUS_ABS_b ComScl_Strg_RawSignal_EPS_ALIVE_COUNTER_1AB_u8 ComScl_Strg_RawSignal_EPS_CHECKSUM_1AB_u8 ComScl_Strg_RawSignal_EPS_IS_RELEASE_REQUEST_b ComScl_Strg_RawSignal_EPS_IS_SHIFT_INHIBIT_REQUEST_b ComScl_Strg_RawSignal_EPS_LOAD_u16 ComScl_Strg_RawSignal_EPS_MID_REQ_b /end LOC_MEASUREMENT
 FUNCTION_VERSION "4.17.3_6.0.0" /end FUNCTION
/begin FUNCTION rba_Dme "1.45.0  McFunction rba_Dme Created by MCFunctionUpdater"
 /begin LOC_MEASUREMENT rba_Dme_Ovl_stEnable rba_Dme_adrError rba_Dme_numBytesAvailable rba_Dme_numBytesAvailableOvl /end LOC_MEASUREMENT
 FUNCTION_VERSION "1.45.0" /end FUNCTION
/begin FUNCTION rba_IoExtLib "1.24.1    Library for external devices"
 /begin LOC_MEASUREMENT rba_IoExtLib_KeepAliveDrvErrCyc_u32 rba_IoExtLib_KeepAliveDrvErrPerm_u32 rba_IoExtLib_KeepAliveIniErrCyc_u32 rba_IoExtLib_KeepAliveIniErrPerm_u32 /end LOC_MEASUREMENT
 FUNCTION_VERSION "1.24.1" /end FUNCTION
/*********** Start of merged COMPU_METHOD blocks ***********/
/begin COMPU_METHOD RB_RBA_Common_CentralElements_CompuMethods_Identical "The internal value and the physical one are identical. No physical unit available" RAT_FUNC "%10.5" "noUnit" COEFFS 0.0 1.0 0.0 0.0 0.0 1.0 REF_UNIT RB_RBA_Common_CentralElements_Units_NoUnit /end COMPU_METHOD
/begin COMPU_METHOD RB_RBA_rba_MemLib_CompuMethods_Mem_Identical "The internal value and the physical one are identical. No physical unit available" RAT_FUNC "%10.5" "Mem_NoUnit" COEFFS 0.0 1.0 0.0 0.0 0.0 1.0 REF_UNIT RB_RBA_rba_MemLib_Units_Mem_NoUnit /end COMPU_METHOD
/begin COMPU_METHOD AUTOSAR_Lin_CompuMethods_Lin_Enum_Status_type "Enumeration for status type" TAB_VERB "%10.5" "noUnit" COMPU_TAB_REF AUTOSAR_Lin_CompuMethods_Lin_Enum_Status_type REF_UNIT AUTOSAR_Lin_Units_NoUnit /end COMPU_METHOD
/begin COMPU_METHOD AUTOSAR_Lin_CompuMethods_Lin_Enum_CheckSum_Type "Enumeration for Checksum model" TAB_VERB "%10.5" "noUnit" COMPU_TAB_REF AUTOSAR_Lin_CompuMethods_Lin_Enum_CheckSum_Type REF_UNIT AUTOSAR_Lin_Units_NoUnit /end COMPU_METHOD
/begin COMPU_METHOD AUTOSAR_Lin_CompuMethods_Lin_Enum_FrameRespType "Enumeration for frame responce type" TAB_VERB "%10.5" "noUnit" COMPU_TAB_REF AUTOSAR_Lin_CompuMethods_Lin_Enum_FrameRespType REF_UNIT AUTOSAR_Lin_Units_NoUnit /end COMPU_METHOD
/begin COMPU_METHOD AUTOSAR_Lin_CompuMethods_Lin_Enum_ChannelStateType "Enumeration for channel state" TAB_VERB "%10.5" "noUnit" COMPU_TAB_REF AUTOSAR_Lin_CompuMethods_Lin_Enum_ChannelStateType REF_UNIT AUTOSAR_Lin_Units_NoUnit /end COMPU_METHOD
/begin COMPU_METHOD AUTOSAR_LinSM_CompuMethods_LinSM_CompuMethod_OperationalMode "computation method displaying the Operational modes of LinSM" TAB_VERB "%10.5" "noUnit" COMPU_TAB_REF AUTOSAR_LinSM_CompuMethods_LinSM_CompuMethod_OperationalMode REF_UNIT AUTOSAR_LinSM_Units_NoUnit /end COMPU_METHOD
/begin COMPU_VTAB AUTOSAR_Lin_CompuMethods_Lin_Enum_Status_type "Enumeration for status type" TAB_VERB 11 0 "LIN_NOT_OK" 1 "LIN_TX_OK" 2 "LIN_TX_BUSY" 3 "LIN_TX_HEADER_ERROR" 4 "LIN_TX_ERROR" 5 "LIN_RX_OK" 6 "LIN_RX_BUSY" 7 "LIN_RX_ERROR" 8 "LIN_RX_NO_RESPONSE" 9 "LIN_OPERATIONAL" 10 "LIN_CH_SLEEP" /end COMPU_VTAB
/begin COMPU_VTAB AUTOSAR_Lin_CompuMethods_Lin_Enum_CheckSum_Type "Enumeration for Checksum model" TAB_VERB 2 0 "LIN_ENHANCED_CS" 1 "LIN_CLASSIC_CS" /end COMPU_VTAB
/begin COMPU_VTAB AUTOSAR_Lin_CompuMethods_Lin_Enum_FrameRespType "Enumeration for frame responce type" TAB_VERB 4 0 "LIN_MASTER_RESPONSE" 1 "LIN_SLAVE_RESPONSE" 2 "LIN_SLAVE_TO_SLAVE" 3 "LIN_UNKNOWN_RESPONSE" /end COMPU_VTAB
/begin COMPU_VTAB AUTOSAR_Lin_CompuMethods_Lin_Enum_ChannelStateType "Enumeration for channel state" TAB_VERB 8 0 "LIN_CH_UNINIT_E" 1 "LIN_CH_SLEEP_E" 2 "LIN_CH_IDLE_E" 3 "LIN_CH_SENDFRAME_E" 4 "LIN_CH_RECEIVEHEADER_E" 5 "LIN_CH_RECEIVERESPONSE_E" 6 "LIN_CH_RECEIVESENTCS_E" 7 "LIN_CH_RECEIVESELFWAKEUP_E" /end COMPU_VTAB
/begin COMPU_VTAB AUTOSAR_LinSM_CompuMethods_LinSM_CompuMethod_OperationalMode "computation method displaying the Operational modes of LinSM" TAB_VERB 2 1 "LINSM_FULL_COM" 2 "LINSM_NO_COM" /end COMPU_VTAB
/begin COMPU_METHOD AFS_TYPSWTONCORRN_SC_Compu "" RAT_FUNC "%6.2" "" COEFFS 0 1 0 0 0 1 /end COMPU_METHOD
/begin COMPU_METHOD AFS_VCCSELN_SC_Compu "" TAB_VERB "%6.3" "" COMPU_TAB_REF AFS_VCCSELN_SC_Compu /end COMPU_METHOD
/begin COMPU_VTAB AFS_VCCSELN_SC_Compu "" TAB_VERB 5 0 "12Volt" 1 "5VoltTrk1" 2 "5VoltTrk2" 3 "5VoltTrk3" 4 "5VoltTrk4" /end COMPU_VTAB
/begin COMPU_METHOD AgPrTime_COMPU "" RAT_FUNC "%6.4" "deg CrS/s" COEFFS 0 100 0 0 0 1 /end COMPU_METHOD
/begin COMPU_METHOD AGRVWK_SY_Compu "" TAB_VERB "%6.3" "" COMPU_TAB_REF AGRVWK_SY_Compu /end COMPU_METHOD
/begin COMPU_VTAB AGRVWK_SY_Compu "" TAB_VERB 2 0 "False" 1 "True" /end COMPU_VTAB
/begin COMPU_METHOD AIRACTRLABTEST_SC_Compu "" TAB_VERB "%6.3" "" COMPU_TAB_REF AIRACTRLABTEST_SC_Compu /end COMPU_METHOD
/begin COMPU_VTAB AIRACTRLABTEST_SC_Compu "" TAB_VERB 5 0 "NOTACTV" 1 "ONEVLV" 2 "TWOVLV" 3 "AIRACTR" 4 "BLDC" /end COMPU_VTAB
/begin COMPU_METHOD AIRCDNGSWTOFFENGSTOP_SC_Compu "" RAT_FUNC "%6.2" "" COEFFS 0 1 0 0 0 1 /end COMPU_METHOD
/begin COMPU_METHOD AIRCHRGCTRL_INHOUSE_SC_Compu "" TAB_VERB "%6.3" "" COMPU_TAB_REF AIRCHRGCTRL_INHOUSE_SC_Compu /end COMPU_METHOD
/begin COMPU_VTAB AIRCHRGCTRL_INHOUSE_SC_Compu "" TAB_VERB 2 0 "False" 1 "True" /end COMPU_VTAB
/begin COMPU_METHOD AIRCHRGCYLARYSPST_SC_Compu "" TAB_VERB "%6.3" "" COMPU_TAB_REF AIRCHRGCYLARYSPST_SC_Compu /end COMPU_METHOD
/begin COMPU_VTAB AIRCHRGCYLARYSPST_SC_Compu "" TAB_VERB 2 0 "False" 1 "True" /end COMPU_VTAB
/begin COMPU_METHOD AIRCHRGCYLARY_SC_Compu "" TAB_VERB "%6.3" "" COMPU_TAB_REF AIRCHRGCYLARY_SC_Compu /end COMPU_METHOD
/begin COMPU_VTAB AIRCHRGCYLARY_SC_Compu "" TAB_VERB 2 0 "False" 1 "True" /end COMPU_VTAB
/begin COMPU_METHOD AIRC_ATSINTVMODCMPR_SY_Compu "" RAT_FUNC "%6.2" "" COEFFS 0 1 0 0 0 1 /end COMPU_METHOD
/begin COMPU_METHOD AIRC_ATSINTVMODREDTRQ_SY_Compu "" RAT_FUNC "%6.2" "" COEFFS 0 1 0 0 0 1 /end COMPU_METHOD
/begin COMPU_METHOD AIRC_REDTRQCMPRENA_SY_Compu "" TAB_VERB "%6.3" "" COMPU_TAB_REF AIRC_REDTRQCMPRENA_SY_Compu /end COMPU_METHOD
/begin COMPU_VTAB AIRC_REDTRQCMPRENA_SY_Compu "" TAB_VERB 2 0 "FALSE" 1 "TRUE" /end COMPU_VTAB
/begin COMPU_METHOD AIRDEV_VAR_SY_Compu "" TAB_VERB "%6.3" "" COMPU_TAB_REF AIRDEV_VAR_SY_Compu /end COMPU_METHOD
/begin COMPU_VTAB AIRDEV_VAR_SY_Compu "" TAB_VERB 49 0 "kein Kundenbezug" 1 "DAI" 3 "VWW" 4 "POR" 5 "AUD" 6 "OPE" 9 "FIA" 11 "BMW" 14 "PSA" 15 "REN" 17 "ALF" 18 "SAB" 19 "VOL" 20 "NIS" 21 "GMU" 22 "FOR" 26 "IMJ" 36 "MAN" 51 "SEA" 53 "CHR" 54 "JAG" 55 "ROL" 69 "FER" 72 "TOY" 123 "MIT" 147 "HYU" 159 "HON" 160 "MAZ" 183 "CU" 190 "LRG" 204 "VVW" 214 "AVT" 242 "Iveco" 243 "DMC" 248 "SUZ" 267 "SSANGYONG" 270 "KEF" 289 "AMG" 319 "MVM" 328 "MM" 385 "UAES" 578 "AL" 590 "SCANIA" 760 "WEICHAI" 828 "RBCD" 966 "International" 999 "ALL" 2887 "NONOX" 9454 "Fuso" /end COMPU_VTAB
/begin COMPU_METHOD AIRDVP_PSNSRADPNLCY_SC_Compu "" TAB_VERB "%6.3" "" COMPU_TAB_REF AIRDVP_PSNSRADPNLCY_SC_Compu /end COMPU_METHOD
/begin COMPU_VTAB AIRDVP_PSNSRADPNLCY_SC_Compu "" TAB_VERB 2 0 "NoLegacyInterface" 1 "LegacyInterface" /end COMPU_VTAB
/begin COMPU_METHOD AIRDVP_PTHRVLVUSSNSRHWIF_SC_Compu "" TAB_VERB "%6.3" "" COMPU_TAB_REF AIRDVP_PTHRVLVUSSNSRHWIF_SC_Compu /end COMPU_METHOD
/begin COMPU_VTAB AIRDVP_PTHRVLVUSSNSRHWIF_SC_Compu "" TAB_VERB 6 0 "NO_SENSOR" 1 "Analogous_sensor" 2 "Digital_Sensor" 3 "Analog_sensor/Digital_sensor" 4 "CAN_sensor" 5 "PFM_Sensor" /end COMPU_VTAB
/begin COMPU_METHOD AIRDVP_VAR_SY_Compu "" TAB_VERB "%6.3" "" COMPU_TAB_REF AIRDVP_VAR_SY_Compu /end COMPU_METHOD
/begin COMPU_VTAB AIRDVP_VAR_SY_Compu "" TAB_VERB 50 0 "kein Kundenbezug" 1 "DAI" 3 "VWW" 4 "POR" 5 "AUD" 6 "OPE" 9 "FIA" 11 "BMW" 14 "PSA" 15 "REN" 17 "ALF" 18 "SAB" 19 "VOL" 20 "NIS" 21 "GMU" 22 "FOR" 26 "IMJ" 36 "MAN" 51 "SEA" 53 "CHR" 54 "JAG" 55 "ROL" 69 "FER" 72 "TOY" 123 "MIT" 147 "HYU" 159 "HON" 160 "MAZ" 183 "CU" 190 "LRG" 204 "VVW" 214 "AVT" 242 "Iveco" 243 "DMC" 248 "SUZ" 267 "SSANGYONG" 270 "KEF" 289 "AMG" 308 "TAT" 319 "MVM" 385 "UAES" 578 "AL" 590 "Scania" 609 "Deutz" 760 "WEICHAI" 828 "RBCD" 966 "International" 999 "ALL" 2887 "NONOX" 9454 "Fuso" /end COMPU_VTAB
/begin COMPU_METHOD AirFlRat "" RAT_FUNC "%6.4" "-" COEFFS 0 200 0 0 0 1 /end COMPU_METHOD
/begin COMPU_METHOD AIRLIMFORMAXINJTI_SC_Compu "" TAB_VERB "%6.3" "" COMPU_TAB_REF AIRLIMFORMAXINJTI_SC_Compu /end COMPU_METHOD
/begin COMPU_VTAB AIRLIMFORMAXINJTI_SC_Compu "" TAB_VERB 2 0 "False" 1 "True" /end COMPU_VTAB
/begin COMPU_METHOD AirMass "" RAT_FUNC "%6.4" "g" COEFFS 0 100 0 0 0 1 /end COMPU_METHOD
/begin COMPU_METHOD AirMassPerTimeMgScnd "" RAT_FUNC "%6.3" "mg/s" COEFFS 0 10 0 0 0 1 /end COMPU_METHOD
/begin COMPU_METHOD AirMassPerTime_2 "" RAT_FUNC "%7.6" "g/s" COEFFS 0 31250 0 0 0 1 /end COMPU_METHOD
/begin COMPU_METHOD AirMass_2 "" RAT_FUNC "%6.3" "g" COEFFS 0 10 0 0 0 1 /end COMPU_METHOD
/*********** Start of merged UNIT blocks ***********/
/begin UNIT RB_RBA_Common_CentralElements_Units_NoUnit "No Unit" "noUnit" EXTENDED_SI SI_EXPONENTS 0 0 0 0 0 0 0 /end UNIT
/begin UNIT RB_RBA_rba_MemLib_Units_Mem_NoUnit "Mem No Unit / 1:1 / Identical" "Mem_NoUnit" EXTENDED_SI SI_EXPONENTS 0 0 0 0 0 0 0 /end UNIT
/begin UNIT AUTOSAR_Lin_Units_NoUnit "No Unit" "noUnit" EXTENDED_SI SI_EXPONENTS 0 0 0 0 0 0 0 /end UNIT
/begin UNIT AUTOSAR_LinSM_Units_NoUnit "No Unit" "noUnit" EXTENDED_SI SI_EXPONENTS 0 0 0 0 0 0 0 /end UNIT
/end MODULE
/end PROJECT
