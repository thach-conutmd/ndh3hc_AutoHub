ASAP2_VERSION 1 60
/begin PROJECT MG1CS022 "MG1CS022"
/begin HEADER "" VERSION "MG1CS022_62XSC_V037_TPROT" PROJECT_NO MG1CS022 /end HEADER
/begin MODULE DIM ""
/begin MOD_COMMON "" BYTE_ORDER MSB_LAST ALIGNMENT_BYTE 1 ALIGNMENT_WORD 2 ALIGNMENT_LONG 4 ALIGNMENT_INT64 4 ALIGNMENT_FLOAT32_IEEE 4 ALIGNMENT_FLOAT64_IEEE 4 DATA_SIZE 32 /end MOD_COMMON
/begin CHARACTERISTIC Com_bAYCCond_C "Default value of AYC active condition status" VALUE 0x8057EAF8 RB_Val_Wu8 1.000 OneToOne 0.00 1.000 FORMAT "%5.3" EXTENDED_LIMITS 0.00 255.0 /end CHARACTERISTIC
/begin CHARACTERISTIC Com_bAYCReWr_C "Default value for VSA unit re-writing status" VALUE 0x8057EAF9 RB_Val_Wu8 1.000 OneToOne 0.00 1.000 FORMAT "%5.3" EXTENDED_LIMITS 0.00 255.0 /end CHARACTERISTIC
/begin CHARACTERISTIC Com_ctAYCMonCond_C "Counter for monitoring condition for AYC frame for VSA unit is re-writing" VALUE 0x8057EAFA RB_Val_Wu8 255.0 OneToOne 0.00 255.0 FORMAT "%5.1" /end CHARACTERISTIC
/begin CHARACTERISTIC Com_ctCRingAYCA_C "Default value for Ring counter for AYCA frame" VALUE 0x8057EAFB RB_Val_Wu8 3.000 OneToOne 0.00 3.000 FORMAT "%5.3" EXTENDED_LIMITS 0.00 255.0 /end CHARACTERISTIC
/begin CHARACTERISTIC Com_ctCRingAYCF_C "AYCF Ring counter Calibration" VALUE 0x8057EB18 RB_Val_Wu8 3.000 OneToOne 0.00 3.000 FORMAT "%5.3" EXTENDED_LIMITS 0.00 255.0 /end CHARACTERISTIC
/begin CHARACTERISTIC Com_ctCRingAYCG_C "AYCG Ring counter Calibration" VALUE 0x8057EB34 RB_Val_Wu8 3.000 OneToOne 0.00 3.000 FORMAT "%5.3" EXTENDED_LIMITS 0.00 255.0 /end CHARACTERISTIC
/begin CHARACTERISTIC Com_ctCRingEPBB_C "Initial value for Ring Counter of frame EPBB" VALUE 0x8057EB44 RB_Val_Wu8 3.000 OneToOne 0.00 3.000 FORMAT "%5.3" EXTENDED_LIMITS 0.00 255.0 /end CHARACTERISTIC
/begin CHARACTERISTIC Com_dAYCA2SigSel_C "Signal selection data second for AYCA frame" VALUE 0x8057EAFC RB_Val_Wu8 255.0 OneToOne 0.00 255.0 FORMAT "%5.1" /end CHARACTERISTIC
/begin CHARACTERISTIC Com_dAYCAMaxDiff_C "Application constant for Maximum difference for AYCA frame" VALUE 0x8057EB00 RB_Val_Wu32 4294967295.00 OneToOne 0.00 4294967295.00 FORMAT "%13.2" /end CHARACTERISTIC
/begin CHARACTERISTIC Com_dAYCAMaxPer_C "Period for AYCA frame" VALUE 0x8057EB04 RB_Val_Wu32 4294967295.00 OneToOne 0.00 4294967295.00 FORMAT "%13.2" /end CHARACTERISTIC
/begin CHARACTERISTIC Com_dAYCASigSel_C "Signal selection data for AYCA frame" VALUE 0x8057EB08 RB_Val_Wu8 255.0 OneToOne 0.00 255.0 FORMAT "%5.1" /end CHARACTERISTIC
/begin CHARACTERISTIC Com_dAYCFMaxDiff_C "Application constant for Maximum difference for AYCF frame" VALUE 0x8057EB1C RB_Val_Wu32 4294967295.00 OneToOne 0.00 4294967295.00 FORMAT "%13.2" /end CHARACTERISTIC
/begin CHARACTERISTIC Com_dAYCFMaxPer_C "Period for AYCF frame" VALUE 0x8057EB20 RB_Val_Wu32 4294967295.00 OneToOne 0.00 4294967295.00 FORMAT "%13.2" /end CHARACTERISTIC
/begin CHARACTERISTIC Com_dAYCFSigSel_C "Signal selection data for AYCF frame" VALUE 0x8057EB24 RB_Val_Wu8 255.0 OneToOne 0.00 255.0 FORMAT "%5.1" /end CHARACTERISTIC
/begin CHARACTERISTIC Com_dAYCGMaxDiff_C "Application constant for Maximum difference for ring counter in AYCG frame" VALUE 0x8057EB35 RB_Val_Wu8 255.0 OneToOne 0.00 255.0 FORMAT "%5.1" /end CHARACTERISTIC
/begin CHARACTERISTIC Com_dAYCGMaxPer_C "Application constant for Maximum period for same ring counter in AYCG frame" VALUE 0x8057EB36 RB_Val_Wu8 255.0 OneToOne 0.00 255.0 FORMAT "%5.1" /end CHARACTERISTIC
/begin CHARACTERISTIC Com_dAYCIMaxDiff_C "Maximum difference for AYCI frame" VALUE 0x8057EB42 RB_Val_Wu8 255.0 OneToOne 0.00 255.0 FORMAT "%5.1" /end CHARACTERISTIC
/begin CHARACTERISTIC Com_dAYCIMaxPer_C "Maximum period for AYCI frame" VALUE 0x8057EB43 RB_Val_Wu8 255.0 OneToOne 0.00 255.0 FORMAT "%5.1" /end CHARACTERISTIC
/begin CHARACTERISTIC Com_dEPS1MaxDiff_C "Application constant for Maximum difference for ring counter in EPS1 frame" VALUE 0x8057EB48 RB_Val_Wu32 4294967295.00 OneToOne 0.00 4294967295.00 FORMAT "%13.2" /end CHARACTERISTIC
/begin CHARACTERISTIC Com_dEPS1MaxPer_C "Application constant for Maximum period for same ring counter in EPS1 frame" VALUE 0x8057EB4C RB_Val_Wu32 4294967295.00 OneToOne 0.00 4294967295.00 FORMAT "%13.2" /end CHARACTERISTIC
/begin CHARACTERISTIC Com_dEPS1SigSel_C "Signal selection data for EPS1 frame" VALUE 0x8057EB50 RB_Val_Wu8 255.0 OneToOne 0.00 255.0 FORMAT "%5.1" /end CHARACTERISTIC
/begin CHARACTERISTIC Com_numCsumAYCA_C "Default value for Checksum message for AYCA frame in case of defective reception." VALUE 0x8057EB09 RB_Val_Wu8 15.00 OneToOne 0.00 15.00 FORMAT "%5.2" EXTENDED_LIMITS 0.00 255.0 /end CHARACTERISTIC
/begin CHARACTERISTIC Com_numCsumAYCD_C "Check sum for AYCD frame" VALUE 0x8057EB14 RB_Val_Wu8 15.00 OneToOne 0.00 15.00 FORMAT "%5.2" EXTENDED_LIMITS 0.00 255.0 /end CHARACTERISTIC
/begin CHARACTERISTIC Com_numCsumAYCF_C "AYCF Checksum Calibration" VALUE 0x8057EB25 RB_Val_Wu8 15.00 OneToOne 0.00 15.00 FORMAT "%5.2" EXTENDED_LIMITS 0.00 255.0 /end CHARACTERISTIC
/begin CHARACTERISTIC Com_numCsumAYCG_C "AYCG Checksum Calibration" VALUE 0x8057EB37 RB_Val_Wu8 15.00 OneToOne 0.00 15.00 FORMAT "%5.2" EXTENDED_LIMITS 0.00 255.0 /end CHARACTERISTIC
/begin CHARACTERISTIC Com_numCsumEPBB_C "Initial value of Checksum of EPBB Frame" VALUE 0x8057EB45 RB_Val_Wu8 15.00 OneToOne 0.00 15.00 FORMAT "%5.2" EXTENDED_LIMITS 0.00 255.0 /end CHARACTERISTIC
/begin CHARACTERISTIC Com_pMstCyl_C "pressure of the brake master cylinder" VALUE 0x8057EB0A RB_Val_Ws16 98116.20 Pres_kPa_VSA 0.00 98116.20 FORMAT "%8.2" EXTENDED_LIMITS -785121.3 785097.3 /end CHARACTERISTIC
/begin CHARACTERISTIC Com_stABSEBDFailr_C "ABS, EBD failure status" VALUE 0x8057EB0C RB_Val_Wu8 1.000 OneToOne 0.00 1.000 FORMAT "%5.3" EXTENDED_LIMITS 0.00 255.0 /end CHARACTERISTIC
/begin CHARACTERISTIC Com_stABSWrn_C "status of ABS warning" VALUE 0x8057EB0D RB_Val_Wu8 1.000 OneToOne 0.00 1.000 FORMAT "%5.3" EXTENDED_LIMITS 0.00 255.0 /end CHARACTERISTIC
/begin CHARACTERISTIC Com_stActABSEBD_C "status of ABS+EBD activation" VALUE 0x8057EB0E RB_Val_Wu8 1.000 OneToOne 0.00 1.000 FORMAT "%5.3" EXTENDED_LIMITS 0.00 255.0 /end CHARACTERISTIC
/begin CHARACTERISTIC Com_stActHSA_C "status of HSA activation" VALUE 0x8057EB0F Val_Wu8 1.000 OneToOne 0.00 1.000 FORMAT "%5.3" EXTENDED_LIMITS 0.00 255.0 /end CHARACTERISTIC
/begin CHARACTERISTIC Com_stAYCFShiftReq_C "Initial value of VSA shift control request" VALUE 0x8057EB26 RB_Val_Wu8 255.0 OneToOne 0.00 255.0 FORMAT "%5.1" /end CHARACTERISTIC
/begin CHARACTERISTIC Com_stAYCF_C "VSA shift control request" VALUE 0x8057EB27 RB_Val_Wu8 3.000 OneToOne 0.00 3.000 FORMAT "%5.3" EXTENDED_LIMITS 0.00 255.0 /end CHARACTERISTIC
/begin CHARACTERISTIC Com_stDCSPlusAYCF_C "Positive/Negative torque request" VALUE 0x8057EB28 RB_Val_Wu8 1.000 OneToOne 0.00 1.000 FORMAT "%5.3" EXTENDED_LIMITS 0.00 255.0 /end CHARACTERISTIC
/begin CHARACTERISTIC Com_stFailMstCylPSnsr_C "Status of the brake master cylinder pressure sensor fail" VALUE 0x8057EB10 RB_Val_Wu8 1.000 OneToOne 0.00 1.000 FORMAT "%5.3" EXTENDED_LIMITS 0.00 255.0 /end CHARACTERISTIC
/begin CHARACTERISTIC Com_stFrntLeWhlSpdSnsrErr_C "Calibration for Front Left wheel speed sensor error status" VALUE 0x8057EB38 RB_Val_Wu8 1.00000000000 B_TRUE 0.00 1.00000000000 FORMAT "%13.11" /end CHARACTERISTIC
/begin CHARACTERISTIC Com_stFrntRiWhlSpdSnsrErr_C "Calibration for Front right wheel speed sensor error status" VALUE 0x8057EB39 RB_Val_Wu8 1.00000000000 B_TRUE 0.00 1.00000000000 FORMAT "%13.11" /end CHARACTERISTIC
/begin CHARACTERISTIC Com_stFuCtrlReq_C "Fuel control request signal" VALUE 0x8057EB29 RB_Val_Wu8 255.0 OneToOne 0.00 255.0 FORMAT "%5.1" /end CHARACTERISTIC
/begin CHARACTERISTIC Com_stHydPCtrlOper_C "Status of EPB liquid pressure control" VALUE 0x8057EB2A RB_Val_Wu8 255.0 OneToOne 0.00 255.0 FORMAT "%5.1" /end CHARACTERISTIC
/begin CHARACTERISTIC Com_stInhbMstCylPSnsr_C "Status of the brake master cylinder pressure sensor inhibition" VALUE 0x8057EB11 RB_Val_Wu8 1.000 OneToOne 0.00 1.000 FORMAT "%5.3" EXTENDED_LIMITS 0.00 255.0 /end CHARACTERISTIC
/begin CHARACTERISTIC Com_stLgtGASensErr_C "Application constant for longitudinal acceleration sensor error ." VALUE 0x8057EB3A RB_Val_Wu8 1.000 OneToOne 0.00 1.000 FORMAT "%5.3" EXTENDED_LIMITS 0.00 255.0 /end CHARACTERISTIC
/begin CHARACTERISTIC Com_stLgtGASensInh_C "Application constant for Longitudinal G sensor ." VALUE 0x8057EB3B RB_Val_Wu8 1.000 OneToOne 0.00 1.000 FORMAT "%5.3" EXTENDED_LIMITS 0.00 255.0 /end CHARACTERISTIC
/begin CHARACTERISTIC Com_stReLeWhlSpdSnsrErr_C "Calibration for Rear Left wheel speed sensor error status" VALUE 0x8057EB3C RB_Val_Wu8 1.00000000000 B_TRUE 0.00 1.00000000000 FORMAT "%13.11" /end CHARACTERISTIC
/begin CHARACTERISTIC Com_stReRiWhlSpdSnsrErr_C "Calibration for Rear Right wheel speed sensor error status" VALUE 0x8057EB3D RB_Val_Wu8 1.00000000000 B_TRUE 0.00 1.00000000000 FORMAT "%13.11" /end CHARACTERISTIC
/begin CHARACTERISTIC Com_stSwtCrpTqCorrn_C "Calibration represents status of switch onoff of creep torque correction" VALUE 0x8057EB2B RB_Kw_Wu8 1.00000000000 B_TRUE 0.00 1.00000000000 FORMAT "%13.11" /end CHARACTERISTIC
/begin CHARACTERISTIC Com_stYawRateSnsrErr_C "Calibration for yaw rate sensor error status" VALUE 0x8057EB3E RB_Val_Wu8 1.00000000000 B_TRUE 0.00 1.00000000000 FORMAT "%13.11" /end CHARACTERISTIC
/begin CHARACTERISTIC Com_stYawRateSnsrInhb_C "default value for Yaw late sensor temporary inhibition incase of frame error" VALUE 0x8057EB3F RB_Val_Wu8 1.000 OneToOne 0.00 1.000 FORMAT "%5.3" EXTENDED_LIMITS 0.00 255.0 /end CHARACTERISTIC
/begin CHARACTERISTIC Com_tqBrkOper_C "Calibration for Brake Operation torque (Driver Input)" VALUE 0x8057EB40 RB_Val_Wu16 65535.00 TrqPerSec 0.00 65535.00 FORMAT "%8.2" /end CHARACTERISTIC
/begin CHARACTERISTIC Com_trqAYCFDes_C "Crankshaft torque" VALUE 0x8057EB2C RB_Val_Ws32 429496729.500 trq_q0p1 -214748364.800 214748364.700 FORMAT "%13.3" /end CHARACTERISTIC
/begin CHARACTERISTIC Com_vWhlSpd_C "Calibration Parameter for Wheel Speed" VALUE 0x8057EB16 RB_Val_Ws16 327.6700 Vel 0.00 327.6700 FORMAT "%8.4" EXTENDED_LIMITS -327.6800 327.6700 /end CHARACTERISTIC
/begin CHARACTERISTIC CWSPDGOV "Code word SpdGov" VALUE 0x8057E884 RB_Val_Wu8 255.0 dez 0.00 255.0 FORMAT "%5.1" /end CHARACTERISTIC
/begin CHARACTERISTIC DNSOZW "delta engine speed without ignition angle intervention" CURVE 0x8057E888 RB_Curve_S8_S16_Static 32767.50 nmot_sw_q0p5 -16384.00 16383.50 FORMAT "%8.2"
 /begin AXIS_DESCR STD_AXIS Tra_numGear OneToOne 8 -128.0 127.0 FORMAT "%5.1" DEPOSIT ABSOLUTE /end AXIS_DESCR
/end CHARACTERISTIC
/begin CHARACTERISTIC KLDNMAXH "Overrunning engine speed for injection cutoff" CURVE 0x8057E8A2 RB_Curve_S16_S16 32767.50 nmot_sw_q0p5 -16384.00 16383.50 FORMAT "%8.2"
 /begin AXIS_DESCR STD_AXIS PT_nClth nmot_sw_q0p5 4 -16384.00 16383.50 FORMAT "%8.2" DEPOSIT ABSOLUTE /end AXIS_DESCR
/end CHARACTERISTIC
/begin CHARACTERISTIC rba_StopCntrWakeup_Debug_C "" VALUE 0x8059148C RB_Val_Wu8 1.00000000000 B_TRUE 0.00 1.00000000000 FORMAT "%13.11" /end CHARACTERISTIC
/begin CHARACTERISTIC rba_StopCntrWakeup_MaxProlongCntr_C "" VALUE 0x80591490 RB_Val_Wu32 4294967295.00 OneToOne 0.00 4294967295.00 FORMAT "%13.2" /end CHARACTERISTIC
/begin CHARACTERISTIC rba_StopCntrWakeup_stActv_C "Calibration feture to deactivate stop counter wake up feature for HMC" VALUE 0x80591494 Val_Wu8 255.0 OneToOne 0.00 255.0 FORMAT "%5.1" /end CHARACTERISTIC
/begin CHARACTERISTIC Signals_Mode1Pid_CA "Array welches alle konfigurierten PID Nummer für Signals beinhaltet (read-only für GS)." VAL_BLK 0x80590F9C ValA_Wu8 255.0 OneToOne 0.00 255.0 FORMAT "%5.1" READ_ONLY NUMBER 252 /end CHARACTERISTIC
/begin CHARACTERISTIC Signals_Mode1SigNum_CA "Array welches die zu Signals_Mode1Pid_CA gehörenden Signalnummern beinhaltet (read-only für GS)." VAL_BLK 0x80591098 ValA_Wu16 1168.00000000 Signals_IntSigNumVerb 0.00 1168.00000000 FORMAT "%13.8" READ_ONLY NUMBER 252 /end CHARACTERISTIC
/begin CHARACTERISTIC Signals_stSrv01SuppPid_CA "Array welches alle konfigurierten PID Nummer für Signals beinhaltet (nur GS)." VAL_BLK 0x80591290 ValA_Wu16 172.000000000 Signals_PidVerbSupp 0.00 172.000000000 FORMAT "%13.9" NUMBER 252 /end CHARACTERISTIC
/begin CHARACTERISTIC SpdGov_dfacDistCtOff_C "gradient for dynamic distribution factor at fuel cut off" VALUE 0x8057EAC8 RB_Val_Ws32 499.500000849 Rmp_Fact 0.499999151 500.000000000 FORMAT "%13.9" EXTENDED_LIMITS -4000.00000000 3999.99999814 /end CHARACTERISTIC
/begin CHARACTERISTIC SpdGov_dtrqMax_C "maximum gradient for stationary part of speed controller torque" VALUE 0x8057EACC RB_Val_Ws32 3276799.99847 RmpTrq 0.00 3276799.99847 FORMAT "%13.5" EXTENDED_LIMITS -3276800.00000 3276799.99847 /end CHARACTERISTIC
/begin CHARACTERISTIC SpdGov_facCompRmpDwn_C "step width of the ramp for accessory compensation during idling when ramping downwards" VALUE 0x8057EA98 RB_Val_Wu8 0.9922 fak_ub_b1 0.0039 0.9961 EXTENDED_LIMITS 0.00 0.9961 /end CHARACTERISTIC
/begin CHARACTERISTIC SpdGov_facCompRmpGrip_C "Step width of the ramp for accessory compensation during idling with closed power train" VALUE 0x8057EA99 RB_Val_Wu8 0.9922 fak_ub_b1 0.0039 0.9961 EXTENDED_LIMITS 0.00 0.9961 /end CHARACTERISTIC
/begin CHARACTERISTIC SpdGov_facCompRmpNoGrip_C "Step width of the ramp for accessory compensation during idling with open power train" VALUE 0x8057EA9A RB_Val_Wu8 0.9922 fak_ub_b1 0.0039 0.9961 EXTENDED_LIMITS 0.00 0.9961 /end CHARACTERISTIC
/begin CHARACTERISTIC SpdGov_facComp_CUR "compensation factor during idling" CURVE 0x8057EA9C RB_Curve_S16_U16_Static 1.000000 fak_uw_b2 0.00 1.000000 FORMAT "%8.6" EXTENDED_LIMITS 0.00 1.999969
 /begin AXIS_DESCR STD_AXIS SpdGov_facThrStabComp fak_sw_b4 9 -4.000000 3.999878 FORMAT "%8.6" DEPOSIT ABSOLUTE /end AXIS_DESCR
/end CHARACTERISTIC
/begin CHARACTERISTIC SpdGov_facCorIniINLim_CUR "delta-correction for install of I-Part" CURVE 0x8057E8B4 RB_Curve_S16_U16_Static 1.999969 fak_uw_b2 0.00 1.999969 FORMAT "%8.6"
 /begin AXIS_DESCR STD_AXIS SpdGov_dnFlt EngNGrd 4 -16384.00 16383.50 FORMAT "%8.2" DEPOSIT ABSOLUTE /end AXIS_DESCR
/end CHARACTERISTIC
/begin CHARACTERISTIC SpdGov_facTrqDynDist_C "factor for distribution of dynamic speed controller torque between engine and electric motor" VALUE 0x8057EAD0 RB_Val_Ws16 1.000000 Fact 0.00 1.000000 FORMAT "%8.6" EXTENDED_LIMITS -4.000000 3.999878 /end CHARACTERISTIC
/begin CHARACTERISTIC SpdGov_flgSwtNGrdt_C "flag for filtered engine speed gradient selection switch" VALUE 0x8057E8C6 RB_Val_Wboolean 1.00000000000 B_TRUE 0.00 1.00000000000 FORMAT "%13.11" /end CHARACTERISTIC
/begin CHARACTERISTIC SpdGov_KiNMaxLimTipp_MAP "Integral gain of maximum rpm control for gear lever in TIPP position" MAP 0x8057E8C8 RB_MapGroup_U16 19.99939 q3p052Em4_min_Nm_DIV_s 0.00031 19.99969 FORMAT "%8.5" EXTENDED_LIMITS 0.00 19.99969
 /begin AXIS_DESCR COM_AXIS HLSDem_nSetPHi nmot_sw_q0p5 4 -16384.00 16383.50 FORMAT "%8.2" AXIS_PTS_REF SpdGov_nSetPHi_DST /end AXIS_DESCR
 /begin AXIS_DESCR COM_AXIS Tra_numGear OneToOne 9 -128.0 127.0 FORMAT "%5.1" AXIS_PTS_REF SpdGov_numGear_DST /end AXIS_DESCR
/end CHARACTERISTIC
/begin CHARACTERISTIC SpdGov_KiNMaxLim_MAP "Integral gain of maximum rpm control" MAP 0x8057E910 RB_MapGroup_U16 19.99939 q3p052Em4_min_Nm_DIV_s 0.00031 19.99969 FORMAT "%8.5" EXTENDED_LIMITS 0.00 19.99969
 /begin AXIS_DESCR COM_AXIS HLSDem_nSetPHi nmot_sw_q0p5 4 -16384.00 16383.50 FORMAT "%8.2" AXIS_PTS_REF SpdGov_nSetPHi_DST /end AXIS_DESCR
 /begin AXIS_DESCR COM_AXIS Tra_numGear OneToOne 9 -128.0 127.0 FORMAT "%5.1" AXIS_PTS_REF SpdGov_numGear_DST /end AXIS_DESCR
/end CHARACTERISTIC
/begin CHARACTERISTIC SpdGov_KpNMaxLimTipp_MAP "Proportionall gain of maximum rpm control for gear lever in TIPP position" MAP 0x8057E958 RB_MapGroup_U16 199.9969 q3p05175Em3_min_Nm 0.00 199.9969 FORMAT "%8.4"
 /begin AXIS_DESCR COM_AXIS HLSDem_nSetPHi nmot_sw_q0p5 4 -16384.00 16383.50 FORMAT "%8.2" AXIS_PTS_REF SpdGov_nSetPHi_DST /end AXIS_DESCR
 /begin AXIS_DESCR COM_AXIS Tra_numGear OneToOne 9 -128.0 127.0 FORMAT "%5.1" AXIS_PTS_REF SpdGov_numGear_DST /end AXIS_DESCR
/end CHARACTERISTIC
/begin CHARACTERISTIC SpdGov_KpNMaxLim_MAP "Proportional gain of maximum rpm control" MAP 0x8057E9A0 RB_MapGroup_U16 199.9969 q3p05175Em3_min_Nm 0.00 199.9969 FORMAT "%8.4"
 /begin AXIS_DESCR COM_AXIS HLSDem_nSetPHi nmot_sw_q0p5 4 -16384.00 16383.50 FORMAT "%8.2" AXIS_PTS_REF SpdGov_nSetPHi_DST /end AXIS_DESCR
 /begin AXIS_DESCR COM_AXIS Tra_numGear OneToOne 9 -128.0 127.0 FORMAT "%5.1" AXIS_PTS_REF SpdGov_numGear_DST /end AXIS_DESCR
/end CHARACTERISTIC
/begin CHARACTERISTIC SpdGov_MaskTstrLimCutOff_C "Mask for cut off limitation by tester" VALUE 0x8057E9E8 RB_Val_Wu8 255.0 OneToOne 0.00 255.0 FORMAT "%5.1" /end CHARACTERISTIC
/begin CHARACTERISTIC SpdGov_nDeltaFstTrqRed_C "Deviation of engine speed, when faster reduction of torque is started" VALUE 0x8057E9EA RB_Val_Ws16 16384.00 nmot_sw_q0p5 -16384.00 0.00 FORMAT "%8.2" EXTENDED_LIMITS -16384.00 16383.50 /end CHARACTERISTIC
/begin CHARACTERISTIC SpdGov_nDeltaMinTrq_C "Deviation of engine speed, when min. torque is demanded" VALUE 0x8057E9EC RB_Val_Ws16 16384.00 nmot_sw_q0p5 -16384.00 0.00 FORMAT "%8.2" EXTENDED_LIMITS -16384.00 16383.50 /end CHARACTERISTIC
/begin CHARACTERISTIC SpdGov_nDeltaStopNLim_C "Deviation of maximum and actual engine speed for switch-off rpm control" VALUE 0x8057E9EE RB_Val_Ws16 32767.50 nmot_sw_q0p5 -16384.00 16383.50 FORMAT "%8.2" /end CHARACTERISTIC
/begin CHARACTERISTIC SpdGov_nDiffASDPrioStal_C "difference engine speed for idle detection" VALUE 0x8057EAD2 RB_Val_Ws16 16383.50 EngN 0.00 16383.50 FORMAT "%8.2" EXTENDED_LIMITS -16384.00 16383.50 /end CHARACTERISTIC
/begin CHARACTERISTIC SpdGov_nDiffASDPrio_C "difference speed for ASD-priority" VALUE 0x8057EAD4 RB_Val_Ws16 16383.50 EngN 0.00 16383.50 FORMAT "%8.2" EXTENDED_LIMITS -16384.00 16383.50 /end CHARACTERISTIC
/begin CHARACTERISTIC SpdGov_nLowrThdIncTqAirPah_C "Lower threshold of the predicted engine-speed for the increase of permissible torque on lead-path" VALUE 0x8057E9F0 RB_Val_Ws16 32767.50 nmot_sw_q0p5 -16384.00 16383.50 FORMAT "%8.2" /end CHARACTERISTIC
/begin CHARACTERISTIC SpdGov_NMaxLim_CW "code word for limitation od engine speed" VALUE 0x8057E9F2 RB_Val_Wu8 255.0 dez 0.00 255.0 FORMAT "%5.1" /end CHARACTERISTIC
/begin CHARACTERISTIC SpdGov_nMax_C "engine-speed limitation, transient limit" VALUE 0x8057E9F4 RB_Val_Ws16 32767.50 nmot_sw_q0p5 -16384.00 16383.50 FORMAT "%8.2" /end CHARACTERISTIC
/begin CHARACTERISTIC SpdGov_nMinASDPrio_C "Minimum engine speed for ASD-priority" VALUE 0x8057EAD6 RB_Val_Ws16 32767.50 EngN -16384.00 16383.50 FORMAT "%8.2" /end CHARACTERISTIC
/begin AXIS_PTS SpdGov_nSetPHi_DST "dase point distribution desired engine speed" 0x8057E9F6 HLSDem_nSetPHi RB_Axis_S16 32767.50 nmot_sw_q0p5 4 -16384.00 16383.50 FORMAT "%8.2" DEPOSIT ABSOLUTE /end AXIS_PTS
/begin AXIS_PTS SpdGov_numGear_DST "dase point distribution gear" 0x8057EA00 Tra_numGear RB_Axis_S8 255.0 OneToOne 9 -128.0 127.0 FORMAT "%5.1" DEPOSIT ABSOLUTE /end AXIS_PTS
/begin CHARACTERISTIC SpdGov_nUpprThdIncTqAirPah_C "Upper threshold of the predicted engine-speed for the increase of permissible torque on lead-path" VALUE 0x8057EA0A RB_Val_Ws16 32767.50 nmot_sw_q0p5 -16384.00 16383.50 FORMAT "%8.2" /end CHARACTERISTIC
/begin CHARACTERISTIC SpdGov_rAppThdTqAirPah_C "Threshold of the accelerator pedal position for the increase of permissible torque on lead-path" VALUE 0x8057EA0C RB_Val_Ws16 799.9878 Prc -400.0000 399.9878 FORMAT "%8.4" /end CHARACTERISTIC
/begin CHARACTERISTIC SpdGov_rASDPrio_C "acceleration pedal position for ASD priority" VALUE 0x8057EAD8 RB_Val_Ws16 100.0000 Prc 0.00 100.0000 FORMAT "%8.4" EXTENDED_LIMITS -400.0000 399.9878 /end CHARACTERISTIC
/begin CHARACTERISTIC SpdGov_swtASDPrio_CW "Code word for the activation conditions for ASD prioritization" VALUE 0x8057EADA RB_Val_Wu8 255.0 OneToOne 0.00 255.0 FORMAT "%5.1" /end CHARACTERISTIC
/begin CHARACTERISTIC SpdGov_tiDlyNeutGear_C "Delay time for detection of neutral gear" VALUE 0x8057EA0E RB_Val_Wu8 2.550 t_q0p01 0.00 2.550 FORMAT "%5.3" /end CHARACTERISTIC
/begin CHARACTERISTIC SpdGov_tiFltASDPrio_C "Time constant of PT1 filter for obtaining the torque of the idle speed controller at the driveaway clutch when ASDPrio is activated" VALUE 0x8057EADC RB_Val_Ws32 4294.9672940000000 TimeDelay_s 0.0000020000000 4294.9672959999998 FORMAT "%19.14" EXTENDED_LIMITS 0.000002000000001 4294.9672959999998 /end CHARACTERISTIC
/begin CHARACTERISTIC SpdGov_tiFlt_C "time constant PT1-filter for stationary part of speed controller torque" VALUE 0x8057EAE0 RB_Val_Ws32 4294.9672940000000 TimeDelay_s 0.0000020000000 4294.9672959999998 FORMAT "%19.14" EXTENDED_LIMITS 0.000002000000001 4294.9672959999998 /end CHARACTERISTIC
/begin CHARACTERISTIC SpdGov_tiHldIncTqAirPah_C "Maximum time, in which increase of permissible torque on lead-path is active" VALUE 0x8057EA0F RB_Val_Wu8 2.550 t_q0p01 0.00 2.550 FORMAT "%5.3" /end CHARACTERISTIC
/begin CHARACTERISTIC SpdGov_tiNMaxPrdcTipp_CUR "Time for engine speed prediction of rpm control for gear lever position TIPP" CURVE 0x8057EA10 RB_Curve_S8_S16_Static 5.100000 t20msxs_ub_b5p1 0.00 5.100000 FORMAT "%8.6" EXTENDED_LIMITS -655.3600 655.3400
 /begin AXIS_DESCR STD_AXIS Tra_numGear OneToOne 9 -128.0 127.0 FORMAT "%5.1" DEPOSIT ABSOLUTE /end AXIS_DESCR
/end CHARACTERISTIC
/begin CHARACTERISTIC SpdGov_tiNMaxPrdc_CUR "Time for engine speed prediction of rpm control" CURVE 0x8057EA2C RB_Curve_S8_S16_Static 5.100000 t20msxs_ub_b5p1 0.00 5.100000 FORMAT "%8.6" EXTENDED_LIMITS -655.3600 655.3400
 /begin AXIS_DESCR STD_AXIS Tra_numGear OneToOne 9 -128.0 127.0 FORMAT "%5.1" DEPOSIT ABSOLUTE /end AXIS_DESCR
/end CHARACTERISTIC
/begin CHARACTERISTIC SpdGov_tiStrtEnd_C "Time after end of engine start for the suppression of the P-part in SpdGov_trqFlt during poststart" VALUE 0x8057EAC2 RB_Val_Ws8 40.80 TimeRed -20.48 20.32 FORMAT "%5.2" /end CHARACTERISTIC
/begin CHARACTERISTIC SpdGov_tiTrqFlt_C "time constant for filtered engine speed control torque" VALUE 0x8057EAC4 RB_Val_Wu16 7.999756 t_q0p000122 0.000122 7.999878 FORMAT "%8.6" EXTENDED_LIMITS 0.00 7.999878 /end CHARACTERISTIC
/begin CHARACTERISTIC SpdGov_trqASDPrio_C "driver torque for ASD-priority" VALUE 0x8057EAE4 RB_Val_Ws16 6553.500 Trq -3276.800 3276.700 FORMAT "%8.3" /end CHARACTERISTIC
/begin CHARACTERISTIC SpdGov_TrqDist_CW "codeword: configuration speed governor torque distribution" VALUE 0x8057EAE6 RB_Val_Wu8 255.0 OneToOne 0.00 255.0 FORMAT "%5.1" /end CHARACTERISTIC
/begin CHARACTERISTIC SpdGov_trqIniINMaxLimTipp_MAP "Map for max. initialization value of I-part for gear lever position TIPP" MAP 0x8057EA48 RB_MapGroup_U8 816.0 md_ub_q3p2 0.00 816.0 FORMAT "%5.1"
 /begin AXIS_DESCR COM_AXIS HLSDem_nSetPHi nmot_sw_q0p5 4 -16384.00 16383.50 FORMAT "%8.2" AXIS_PTS_REF SpdGov_nSetPHi_DST /end AXIS_DESCR
 /begin AXIS_DESCR COM_AXIS Tra_numGear OneToOne 9 -128.0 127.0 FORMAT "%5.1" AXIS_PTS_REF SpdGov_numGear_DST /end AXIS_DESCR
/end CHARACTERISTIC
/begin CHARACTERISTIC SpdGov_trqIniINMaxLim_MAP "Map for max. initialization value of I-part" MAP 0x8057EA6C RB_MapGroup_U8 816.0 md_ub_q3p2 0.00 816.0 FORMAT "%5.1"
 /begin AXIS_DESCR COM_AXIS HLSDem_nSetPHi nmot_sw_q0p5 4 -16384.00 16383.50 FORMAT "%8.2" AXIS_PTS_REF SpdGov_nSetPHi_DST /end AXIS_DESCR
 /begin AXIS_DESCR COM_AXIS Tra_numGear OneToOne 9 -128.0 127.0 FORMAT "%5.1" AXIS_PTS_REF SpdGov_numGear_DST /end AXIS_DESCR
/end CHARACTERISTIC
/begin CHARACTERISTIC SpdGov_trqMaxLimInteg_C "maximum value for I-Anteil" VALUE 0x8057EA90 RB_Val_Ws16 3276.700 md_sw_q0p1 0.00 3276.700 FORMAT "%8.3" EXTENDED_LIMITS -3276.800 3276.700 /end CHARACTERISTIC
/begin CHARACTERISTIC SpdGov_trqMinLimInteg_C "minimum value for I-Anteil" VALUE 0x8057EA92 RB_Val_Ws16 6553.500 md_sw_q0p1 -3276.800 3276.700 FORMAT "%8.3" /end CHARACTERISTIC
/begin CHARACTERISTIC SpdGov_trqOfsMin_C "offset for SpdGov minimal torque" VALUE 0x8057EAE8 RB_Val_Ws16 3276.700 Trq 0.00 3276.700 FORMAT "%8.3" EXTENDED_LIMITS -3276.800 3276.700 /end CHARACTERISTIC
/begin CHARACTERISTIC SpdGov_vThdTqAirPah_C "Threshold of the vehicle speed for the increase of permissible torque on lead-path" VALUE 0x8057EA94 RB_Val_Ws16 655.3500 Vel -327.6800 327.6700 FORMAT "%8.4" /end CHARACTERISTIC
/begin CHARACTERISTIC SrvCSwt_tiSwtDebHiLo_C "High to Low debounce time for switch input status." VALUE 0x8057EAEC RB_Val_Ws16 655350.0 TimeDeb -327680.0 327670.0 FORMAT "%8.1" /end CHARACTERISTIC
/begin CHARACTERISTIC SrvCSwt_tiSwtDebLoHi_C "Low to High debounce time for switch input status." VALUE 0x8057EAEE RB_Val_Ws16 655350.0 TimeDeb -327680.0 327670.0 FORMAT "%8.1" /end CHARACTERISTIC
/begin CHARACTERISTIC SSEUI_stFirstEngStrtSeln_C "First engine start selection parameter for display" VALUE 0x8057E470 RB_Val_Wu8 1.00000000000 B_TRUE 0.00 1.00000000000 FORMAT "%13.11" /end CHARACTERISTIC
/begin CHARACTERISTIC SSEUI_stMktSelnSwt_C "Market selection switch for MT variant(for EU market and non EU market)" VALUE 0x8057E471 RB_Val_Wu8 1.00000000000 B_TRUE 0.00 1.00000000000 FORMAT "%13.11" /end CHARACTERISTIC
/begin CHARACTERISTIC SSEUI_stMode05FlgRstMsk_C "Mask for EPS and brake booster request" VALUE 0x8057E474 RB_Val_Wu32 4294967295.00 OneToOne 0.00 4294967295.00 FORMAT "%13.2" /end CHARACTERISTIC
/begin CHARACTERISTIC SSEUI_stMsk1_C "calibration to mask the stop Release Display message" VALUE 0x8057E478 RB_Val_Wu32 4294967295.00 OneToOne 0.00 4294967295.00 FORMAT "%13.2" /end CHARACTERISTIC
/begin CHARACTERISTIC SSEUI_stSwtACCdnByp_C "Calibration to bypass AC condition for mode12h" VALUE 0x8057E47C RB_Val_Wu8 1.00000000000 B_TRUE 0.00 1.00000000000 FORMAT "%13.11" /end CHARACTERISTIC
/begin CHARACTERISTIC SSEUI_stSwtMIDDsbl_C "CAlibration switch to disable MID" VALUE 0x8057E47D RB_Val_Wu8 1.00000000000 B_TRUE 0.00 1.00000000000 FORMAT "%13.11" /end CHARACTERISTIC
/begin CHARACTERISTIC SSEUI_swtSTSReq_C "Calibration to select Starter ON instruction by STS starting request" VALUE 0x8057E47E RB_Val_Wu8 1.00000000000 B_TRUE 0.00 1.00000000000 FORMAT "%13.11" /end CHARACTERISTIC
/begin CHARACTERISTIC SSEUI_tiACDly120s_C "Calibration for AC delay 120s" VALUE 0x8057E480 RB_Val_Ws16 32767.00 Time_Second 0.00 32767.00 FORMAT "%8.2" EXTENDED_LIMITS -32768.00 32767.00 /end CHARACTERISTIC
/begin CHARACTERISTIC SSEUI_tiACDly6s_C "Calibration for AC delay 6s" VALUE 0x8057E482 RB_Val_Ws16 32767.00 Time_Second 0.00 32767.00 FORMAT "%8.2" EXTENDED_LIMITS -32768.00 32767.00 /end CHARACTERISTIC
/begin CHARACTERISTIC SSEUI_tiBrkPedStrtReqDly_C "Delay for start request by reduction of brake negative pressure." VALUE 0x8057E484 RB_Val_Ws16 655.3500 Time_s -327.6800 327.6700 FORMAT "%8.4" /end CHARACTERISTIC
/begin CHARACTERISTIC SSEUI_tiCANErrMask_C "Reset value for the IG2 mask during engine cranking." VALUE 0x8057E486 RB_Val_Ws16 655.3500 Time_s -327.6800 327.6700 FORMAT "%8.4" /end CHARACTERISTIC
/begin CHARACTERISTIC SSEUI_tiCluChkDly_C "Delay time for checking clutch display information conditions" VALUE 0x8057E488 RB_Val_Wu8 2.550 Time_s 0.00 2.550 FORMAT "%5.3" /end CHARACTERISTIC
/begin CHARACTERISTIC SSEUI_tiDispEndDly_C "Calibration threshold for pre indication delay" VALUE 0x8057E48A RB_Val_Ws16 327.6700 Time_s 0.00 327.6700 FORMAT "%8.4" EXTENDED_LIMITS -327.6800 327.6700 /end CHARACTERISTIC
/begin CHARACTERISTIC SSEUI_tiDispTime_C "Display time duration for MID" VALUE 0x8057E48C RB_Val_Ws16 327.6700 Time_s 0.00 327.6700 FORMAT "%8.4" EXTENDED_LIMITS -327.6800 327.6700 /end CHARACTERISTIC
/begin CHARACTERISTIC SSEUI_tiDlySeatBlt_C "Delay after seat belt unlathc and before clutch press indication on MID" VALUE 0x8057E48E RB_Val_Ws16 327.6700 Time_s 0.00 327.6700 FORMAT "%8.4" EXTENDED_LIMITS -327.6800 327.6700 /end CHARACTERISTIC
/begin CHARACTERISTIC SSEUI_tiInGearDly_C "Delay before the display change to neutral gear" VALUE 0x8057E490 RB_Val_Ws16 327.6700 Time_s 0.00 327.6700 FORMAT "%8.4" EXTENDED_LIMITS -327.6800 327.6700 /end CHARACTERISTIC
/begin CHARACTERISTIC SSEUI_tiInitChkDly_C "Initial bulb check delay" VALUE 0x8057E492 RB_Val_Ws16 327.6700 Time_s 0.00 327.6700 FORMAT "%8.4" EXTENDED_LIMITS -327.6800 327.6700 /end CHARACTERISTIC
/begin CHARACTERISTIC SSEUI_tiISGoJudDly_C "Time delay to check Idle stop release conditions once trigger conditions are available for AT or CVT" VALUE 0x8057E494 RB_Val_Ws16 327.6700 Time_s 0.00 327.6700 FORMAT "%8.4" EXTENDED_LIMITS -327.6800 327.6700 /end CHARACTERISTIC
/begin CHARACTERISTIC SSEUI_tiRstrtReqVehCdnDly_C "calibratable time delay for debouncing restart request by vehicle condition" VALUE 0x8057E496 RB_Val_Ws16 327.6700 Time_s 0.00 327.6700 FORMAT "%8.4" EXTENDED_LIMITS -327.6800 327.6700 /end CHARACTERISTIC
/begin CHARACTERISTIC SSEUI_tiVehCdnStopTrigDly_C "Time delay to check Idle stop release conditions once trigger conditions are available" VALUE 0x8057E498 RB_Val_Ws16 327.6700 Time_s 0.00 327.6700 FORMAT "%8.4" EXTENDED_LIMITS -327.6800 327.6700 /end CHARACTERISTIC
/begin CHARACTERISTIC StatyCoorn_flgCluMax_C "Selection of maximum clutch torque" VALUE 0x8057EAF2 RB_Val_Wboolean 1.00000000000 B_TRUE 0.00 1.00000000000 FORMAT "%13.11" /end CHARACTERISTIC
/begin CHARACTERISTIC StatyCoorn_flgCluTotLeadMax_C "Selection of Maximum torque limitation on total lead torque path at clutch level" VALUE 0x8057EAF3 RB_Val_Wboolean 1.00000000000 B_TRUE 0.00 1.00000000000 FORMAT "%13.11" /end CHARACTERISTIC
/begin CHARACTERISTIC StatyCoorn_flgEnaBypCmpdTq_C "Calibration for flag to enable bypass compensated torque for ASD filter" VALUE 0x8057EAF4 RB_Val_Wboolean 1.00000000000 B_TRUE 0.00 1.00000000000 FORMAT "%13.11" /end CHARACTERISTIC
/begin CHARACTERISTIC StbIntv_stAYCFISSInhbReq_C "VSA Inhibit Request" VALUE 0x8057EB30 RB_Val_Wu8 1.000 OneToOne 0.00 1.000 FORMAT "%5.3" EXTENDED_LIMITS 0.00 255.0 /end CHARACTERISTIC
/begin CHARACTERISTIC StrtCtl_ctFaultStrtLim_C "Number of fault starts before the starter cut off is changed" VALUE 0x8057EB54 RB_Val_Wu8 255.0 OneToOne 0.00 255.0 FORMAT "%5.1" /end CHARACTERISTIC
/begin CHARACTERISTIC StrtCtl_flgDiEPBCdn_C "Disable EPB condition flag" VALUE 0x8057EB55 RB_Val_Wu8 1.00000000000 B_TRUE 0.00 1.00000000000 FORMAT "%13.11" /end CHARACTERISTIC
/begin CHARACTERISTIC StrtCtl_nEngSpdThd_C "Threshold for engine speed. Further condition to stall the engine after remote start" VALUE 0x8057EB56 RB_Val_Ws16 32767.50 EngN -16384.00 16383.50 FORMAT "%8.2" /end CHARACTERISTIC
/begin CHARACTERISTIC StrtCtl_nEngStallThd_C "Engine speed threshold to detect a stalled engine" VALUE 0x8057EB58 RB_Val_Ws16 32767.50 EngN -16384.00 16383.50 FORMAT "%8.2" /end CHARACTERISTIC
/begin CHARACTERISTIC StrtCtl_nStrtActv_C "engine-speed threshold for detection of active starter" VALUE 0x8057EB5A RB_Val_Ws16 16383.50 EngN 0.00 16383.50 FORMAT "%8.2" EXTENDED_LIMITS -16384.00 16383.50 /end CHARACTERISTIC
/begin CHARACTERISTIC StrtCtl_nStrtIdl_C "idle starter engine speed" VALUE 0x8057EB5C RB_Val_Ws16 16383.50 EngN 0.00 16383.50 FORMAT "%8.2" EXTENDED_LIMITS -16384.00 16383.50 /end CHARACTERISTIC
/begin CHARACTERISTIC StrtCtl_nStrtRlsMax_C "maximum speed for starter release" VALUE 0x8057EB5E RB_Val_Ws16 16383.50 EngN 0.00 16383.50 FORMAT "%8.2" EXTENDED_LIMITS -16384.00 16383.50 /end CHARACTERISTIC
/begin CHARACTERISTIC StrtCtl_nThresStrtCtOff_MAP "engine-speed threshold for starter cut off" MAP 0x8057EB60 RB_Map_S16S16_S16 800.0000 EngN 0.00 800.0000 FORMAT "%8.4" EXTENDED_LIMITS -16384.00 16383.50
 /begin AXIS_DESCR STD_AXIS CEngDsT_t Temp_Cels 6 -3549.940 3003.560 FORMAT "%8.3" DEPOSIT ABSOLUTE /end AXIS_DESCR
 /begin AXIS_DESCR STD_AXIS BattU_u Volt_Batt 3 -655360.0 655340.0 FORMAT "%8.1" DEPOSIT ABSOLUTE /end AXIS_DESCR
/end CHARACTERISTIC
/begin CHARACTERISTIC StrtCtl_rCluStkHi_C "Calibration for high threshold of clutch pedal stoke" VALUE 0x8057EB9A RB_Val_Wu8 100.0 Prc_EGR 0.00 100.0 FORMAT "%5.1" /end CHARACTERISTIC
/begin CHARACTERISTIC StrtCtl_rCluStkLo_C "Calibration for low threshold of clutch pedal stoke" VALUE 0x8057EB9B RB_Val_Wu8 100.0 Prc_EGR 0.00 100.0 FORMAT "%5.1" /end CHARACTERISTIC
/begin CHARACTERISTIC StrtCtl_stNFaultStrt_Msk "bit mask fault start after starter cut off through speed limit" VALUE 0x8057EB9C RB_Val_Wu16 65535.00 OneToOne 0.00 65535.00 FORMAT "%8.2" /end CHARACTERISTIC
/begin CHARACTERISTIC StrtCtl_stNPosnEnaForBit13_C "Calibration to select Neutral Position Check for Bit13 of Strater Release Conditions" VALUE 0x8057EB9E RB_Val_Wu8 1.00000000000 B_TRUE 0.00 1.00000000000 FORMAT "%13.11" /end CHARACTERISTIC
/begin CHARACTERISTIC StrtCtl_stStA_CW "Code word for starter control" VALUE 0x8057EB9F RB_Val_Wu8 255.0 OneToOne 0.00 255.0 FORMAT "%5.1" /end CHARACTERISTIC
/begin CHARACTERISTIC StrtCtl_stStrtRls_Msk "Mask for release conditions for starter control" VALUE 0x8057EBA0 RB_Val_Wu16 65535.00 OneToOne 0.00 65535.00 FORMAT "%8.2" /end CHARACTERISTIC
/begin CHARACTERISTIC StrtCtl_stStSpStrtRls_Msk "bit mask for starter release at start-stop" VALUE 0x8057EBA2 RB_Val_Wu16 65535.00 OneToOne 0.00 65535.00 FORMAT "%8.2" /end CHARACTERISTIC
/begin CHARACTERISTIC StrtCtl_stSyncStrtOff_C "state of synchronization for analyse engine rotation at starter control" VALUE 0x8057EBA4 RB_Val_Wu8 255.0 OneToOne 0.00 255.0 FORMAT "%5.1" /end CHARACTERISTIC
/begin CHARACTERISTIC StrtCtl_stTiFaultStrt_Msk "bit mask fault start after starter cut off through time limit" VALUE 0x8057EBA6 RB_Val_Wu16 65535.00 OneToOne 0.00 65535.00 FORMAT "%8.2" /end CHARACTERISTIC
/begin CHARACTERISTIC StrtCtl_stTraBrk_CW "codeword to activate the check of transmission, break" VALUE 0x8057EBA8 RB_Val_Wu8 255.0 OneToOne 0.00 255.0 FORMAT "%5.1" /end CHARACTERISTIC
/begin CHARACTERISTIC StrtCtl_tiAltvCluStrt_C "Delay timer for alternative clutch start" VALUE 0x8057EBAA RB_Val_Ws16 655350.0 Time_ms -327680.0 327670.0 FORMAT "%8.1" /end CHARACTERISTIC
/begin CHARACTERISTIC StrtCtl_tiAutoStrtRls_C "Auto start release delay time" VALUE 0x8057EBAC RB_Val_Ws32 4294.96729500 Time_Dt -2147.48364800 2147.48364700 FORMAT "%13.8" /end CHARACTERISTIC
/begin CHARACTERISTIC StrtCtl_tiCanFailrDetnDly_C "Delay time value to detect the Can failure" VALUE 0x8057EBB0 RB_Val_Wu16 655350.0 Time_ms 0.00 655350.0 FORMAT "%8.1" /end CHARACTERISTIC
/begin CHARACTERISTIC StrtCtl_tiComNPDly_C "On delay of shift gear status" VALUE 0x8057EBB4 RB_Val_Ws32 2147.48364700 Time_Dt 0.00 2147.48364700 FORMAT "%13.8" EXTENDED_LIMITS -2147.48364800 2147.48364700 /end CHARACTERISTIC
/begin CHARACTERISTIC StrtCtl_tiDlyStrtCtOffV_C "debounce time for starter cut off via car speed" VALUE 0x8057EBB8 RB_Val_Ws16 327.6700 Time_s 0.00 327.6700 FORMAT "%8.4" EXTENDED_LIMITS -327.6800 327.6700 /end CHARACTERISTIC
/begin CHARACTERISTIC StrtCtl_tiEngStallThd_C "Time limit to confirm an engine stall" VALUE 0x8057EBBA RB_Val_Wu8 2550. Time_ms 0.00 2550. FORMAT "%5.0" /end CHARACTERISTIC
/begin CHARACTERISTIC StrtCtl_tiEPBActtnReqDlyElpd_C "Time limit after the EPB actuation request beyond which EPB applied flag is set" VALUE 0x8057EBBC RB_Val_Ws16 655350.0 Time_ms -327680.0 327670.0 FORMAT "%8.1" /end CHARACTERISTIC
/begin CHARACTERISTIC StrtCtl_tiFuPWait_C "Fuel pressure waiting timer threshold" VALUE 0x8057EBBE RB_Val_Wu16 655350.0 Time_ms 0.00 655350.0 FORMAT "%8.1" /end CHARACTERISTIC
/begin CHARACTERISTIC StrtCtl_tiIdleSpStCmftMax_C "Maximum time for comfort at idle stop for start cut off" VALUE 0x8057EBC0 RB_Val_Ws16 327.6700 Time_s 0.00 327.6700 FORMAT "%8.4" EXTENDED_LIMITS -327.6800 327.6700 /end CHARACTERISTIC
/begin CHARACTERISTIC StrtCtl_tiIgnOnCANDeb_C "Delay time value to receive CAN frames after T15 ON" VALUE 0x8057EBC4 RB_Val_Ws32 2147.48364700 Time_Dt 0.00 2147.48364700 FORMAT "%13.8" EXTENDED_LIMITS -2147.48364800 2147.48364700 /end CHARACTERISTIC
/begin CHARACTERISTIC StrtCtl_tiIgnOnDeb_C "Delay time value to ignore EPB at the first crank from T15 ON" VALUE 0x8057EBC8 RB_Val_Ws32 2147.48364700 Time_Dt 0.00 2147.48364700 FORMAT "%13.8" EXTENDED_LIMITS -2147.48364800 2147.48364700 /end CHARACTERISTIC
/begin CHARACTERISTIC StrtCtl_tiManCrkCdn_C "Manual cranking condition time" VALUE 0x8057EBCC RB_Val_Wu16 655350.0 Time_ms 0.00 655350.0 FORMAT "%8.1" /end CHARACTERISTIC
/begin CHARACTERISTIC StrtCtl_tiNMaxDeb_C "Debounce time for maximum speed for starter release" VALUE 0x8057EBD0 RB_Val_Ws32 2147.48364700 Time_Dt 0.00 2147.48364700 FORMAT "%13.8" EXTENDED_LIMITS -2147.48364800 2147.48364700 /end CHARACTERISTIC
/begin CHARACTERISTIC StrtCtl_tiNZeroDeb_C "debounce time for zero rpm detection" VALUE 0x8057EBD4 RB_Val_Ws32 2147.48364700 Time_Dt 0.00 2147.48364700 FORMAT "%13.8" EXTENDED_LIMITS -2147.48364800 2147.48364700 /end CHARACTERISTIC
/begin CHARACTERISTIC StrtCtl_tiPushBtnStrtCmft_T "Maximum starter operation time in case of push button start (comfort)" CURVE 0x8057EBD8 RB_Curve_S16_S16 327.6700 Time_s 0.00 327.6700 FORMAT "%8.4" EXTENDED_LIMITS -327.6800 327.6700
 /begin AXIS_DESCR STD_AXIS CEngDsT_t Temp_Cels 5 -3549.940 3003.560 FORMAT "%8.3" DEPOSIT ABSOLUTE /end AXIS_DESCR
/end CHARACTERISTIC
/begin CHARACTERISTIC StrtCtl_tiStrtActv_C "debounce time for detection starter rpm" VALUE 0x8057EBF0 RB_Val_Ws32 2147.48364700 Time_Dt 0.00 2147.48364700 FORMAT "%13.8" EXTENDED_LIMITS -2147.48364800 2147.48364700 /end CHARACTERISTIC
/begin CHARACTERISTIC StrtCtl_tiStrtCmftMax_CUR "maximum starter operation time for comfort" CURVE 0x8057EBF4 RB_Curve_S16_S16 327.6700 Time_s 0.00 327.6700 FORMAT "%8.4" EXTENDED_LIMITS -327.6800 327.6700
 /begin AXIS_DESCR STD_AXIS CEngDsT_t Temp_Cels 3 -3549.940 3003.560 FORMAT "%8.3" DEPOSIT ABSOLUTE /end AXIS_DESCR
/end CHARACTERISTIC
/begin CHARACTERISTIC StrtCtl_tiStrtOffMin_C "minimum time between two starter activations" VALUE 0x8057EC04 RB_Val_Ws32 2147.38364700 Time_Dt 0.10000000 2147.48364700 FORMAT "%13.8" EXTENDED_LIMITS -2147.48364800 2147.48364700 /end CHARACTERISTIC
/begin CHARACTERISTIC StrtCtl_tiStrtOnMin_C "Minimum starter operation time at bypassing the time threshold" VALUE 0x8057EC08 RB_Val_Ws16 327.6700 Time_s 0.00 327.6700 FORMAT "%8.4" EXTENDED_LIMITS -327.6800 327.6700 /end CHARACTERISTIC
/begin CHARACTERISTIC StrtCtl_tiStrtOpPanicMax_MAP "maximum starter operation time at panic start" MAP 0x8057EC0A RB_Map_S16S16_S16 327.6700 Time_s 0.00 327.6700 FORMAT "%8.4" EXTENDED_LIMITS -327.6800 327.6700
 /begin AXIS_DESCR STD_AXIS CEngDsT_t Temp_Cels 3 -3549.940 3003.560 FORMAT "%8.3" DEPOSIT ABSOLUTE /end AXIS_DESCR
 /begin AXIS_DESCR STD_AXIS CoEng_tiStrtDly Time_ms 3 -327680.0 327670.0 FORMAT "%8.1" DEPOSIT ABSOLUTE /end AXIS_DESCR
/end CHARACTERISTIC
/begin CHARACTERISTIC StrtCtl_tiStrtPwrIdlMax_C "maximum starter operation time at starter-idle to limit the power consumption" VALUE 0x8057EC2C RB_Val_Ws16 327.6600 Time_s 0.0100 327.6700 FORMAT "%8.4" EXTENDED_LIMITS -327.6800 327.6700 /end CHARACTERISTIC
/begin CHARACTERISTIC StrtCtl_tiStrtPwrMax_CUR "maximum starter operation time to limit the power consumption" CURVE 0x8057EC2E RB_Curve_S16_S16 327.6600 Time_s 0.0100 327.6700 FORMAT "%8.4" EXTENDED_LIMITS -327.6800 327.6700
 /begin AXIS_DESCR STD_AXIS CEngDsT_t Temp_Cels 3 -3549.940 3003.560 FORMAT "%8.3" DEPOSIT ABSOLUTE /end AXIS_DESCR
/end CHARACTERISTIC
/begin CHARACTERISTIC StrtCtl_tiStrtReqRstDly_C "Off delay of stater request reset status" VALUE 0x8057EC3C RB_Val_Ws32 2147.48364700 Time_Dt 0.00 2147.48364700 FORMAT "%13.8" EXTENDED_LIMITS -2147.48364800 2147.48364700 /end CHARACTERISTIC
/begin CHARACTERISTIC StrtCtl_tiStrtReqTCUDlyIMG_C "Delay time after a start request trigger to wait CAN signal from TCU." VALUE 0x8057EC40 RB_Val_Wu16 655350.0 Time_ms 0.00 655350.0 FORMAT "%8.1" /end CHARACTERISTIC
/begin CHARACTERISTIC StrtCtl_tiStrtRlsDly_C "Delay timer for start release" VALUE 0x8057EC44 RB_Val_Ws32 4294.96729500 Time_Dt -2147.48364800 2147.48364700 FORMAT "%13.8" /end CHARACTERISTIC
/begin CHARACTERISTIC StrtCtl_uAutoCrkBatt_C "Battery voltage threshold for auto cranking mode." VALUE 0x8057EC48 RB_Val_Ws16 1310700. Volt_Batt -655360.0 655340.0 FORMAT "%8.1" /end CHARACTERISTIC
/begin CHARACTERISTIC StrtCtl_vThresStrtCtOff_C "car-speed threshold for starter cut off" VALUE 0x8057EC4A RB_Val_Ws16 327.6700 Vel 0.00 327.6700 FORMAT "%8.4" EXTENDED_LIMITS -327.6800 327.6700 /end CHARACTERISTIC
/begin CHARACTERISTIC StrtCtl_vVehRunngThd_C "Threshold speed for vehicle running status" VALUE 0x8057EC4C RB_Val_Ws16 655.3500 Vel -327.6800 327.6700 FORMAT "%8.4" /end CHARACTERISTIC
/begin CHARACTERISTIC Strt_cntrContnsRstrtIntlShoRepl_C "Replacement value for the EEPROM element storing Short interval counter less than 4min" VALUE 0x8057EC52 RB_Val_Wu8 255.0 OneToOne 0.00 255.0 FORMAT "%5.1" /end CHARACTERISTIC
/begin CHARACTERISTIC Strt_cntrRstrtIntlShoRepl_C "Replacement value for EEPROM element storing Short interval counter less than 30s" VALUE 0x8057EC53 RB_Val_Wu8 255.0 OneToOne 0.00 255.0 FORMAT "%5.1" /end CHARACTERISTIC
/begin CHARACTERISTIC Strt_ctCaSEdgMin_C "Application parameter for the number of phase transmitter edges" VALUE 0x8057EC54 RB_Val_Wu16 65535.00 OneToOne 0.00 65535.00 FORMAT "%8.2" /end CHARACTERISTIC
/begin CHARACTERISTIC Strt_flgStrtRlyCntRst_C "Calibration to reset the starter relay count value" VALUE 0x8057EC56 RB_Val_Wboolean 1.00000000000 B_TRUE 0.00 1.00000000000 FORMAT "%13.11" /end CHARACTERISTIC
/begin CHARACTERISTIC Strt_nLckJudg1_C "Threshold engine speed for starter lock judgment 1" VALUE 0x8057EC58 RB_Val_Ws16 32767.50 EngN -16384.00 16383.50 FORMAT "%8.2" /end CHARACTERISTIC
/begin CHARACTERISTIC Strt_nLckJudg2_C "Threshold engine speed for starter lock judgment 2" VALUE 0x8057EC5A RB_Val_Ws16 32767.50 EngN -16384.00 16383.50 FORMAT "%8.2" /end CHARACTERISTIC
/begin CHARACTERISTIC Strt_swtCntRst_C "Calibration for software switch reset counter" VALUE 0x8057EC5C RB_Val_Wboolean 1.00000000000 B_TRUE 0.00 1.00000000000 FORMAT "%13.11" /end CHARACTERISTIC
/begin CHARACTERISTIC Strt_swtStaActv_C "Calibration to select the configuration of the starter activity detection" VALUE 0x8057EC5D RB_Val_Wboolean 1.00000000000 B_TRUE 0.00 1.00000000000 FORMAT "%13.11" /end CHARACTERISTIC
/begin CHARACTERISTIC Strt_tiContnsRstrt_C "Threshold value for Short Interval counter less than 4min between 3rd and 4th successive crankings" VALUE 0x8057EC5E RB_Val_Ws16 655.3500 Time_s -327.6800 327.6700 FORMAT "%8.4" /end CHARACTERISTIC
/begin CHARACTERISTIC Strt_tiImobChk_C "Timer to check for the immobilizer lock status" VALUE 0x8057EC60 RB_Val_Ws16 6553500. Time_ms_100ms -3276800. 3276700. FORMAT "%8.0" /end CHARACTERISTIC
/begin CHARACTERISTIC Strt_tiLckJudg1_C "The time period after which the starter lock judgment based on camshaft edge count should be evaluated" VALUE 0x8057EC62 RB_Val_Ws16 6553500. Time_ms_100ms -3276800. 3276700. FORMAT "%8.0" /end CHARACTERISTIC
/begin CHARACTERISTIC Strt_tiLckJudg2_C "The time period after which the starter lock judgment based on engine speed should be evaluated" VALUE 0x8057EC64 RB_Val_Ws16 6553500. Time_ms_100ms -3276800. 3276700. FORMAT "%8.0" /end CHARACTERISTIC
/begin CHARACTERISTIC Strt_tiRstrtIntl_C "Threshold value for the Short Interval timer less than 30s after 10s cranking" VALUE 0x8057EC66 RB_Val_Ws16 655.3500 Time_s -327.6800 327.6700 FORMAT "%8.4" /end CHARACTERISTIC
/begin CHARACTERISTIC Strt_tiStrtActv_C "Threshold value for 10s cranking" VALUE 0x8057EC68 RB_Val_Ws16 655.3500 Time_s -327.6800 327.6700 FORMAT "%8.4" /end CHARACTERISTIC
/begin CHARACTERISTIC Strt_tiStrtCtOffDiaDur_C "Application parameter for the duration of the diagnosis of the turn off paths" VALUE 0x8057EC6A RB_Val_Ws16 327.6700 Time_s 0.00 327.6700 FORMAT "%8.4" EXTENDED_LIMITS -327.6800 327.6700 /end CHARACTERISTIC
/begin CHARACTERISTIC Strt_uDiaThresCtOffHi_C "High Threshold value for starter cutoff diagnosis" VALUE 0x8057EC6C RB_Val_Wu16 13107.00 Volt 0.00 13107.00 FORMAT "%8.2" /end CHARACTERISTIC
/begin CHARACTERISTIC Strt_uDiaThresCtOffLo_C "Low Threshold value for starter cutoff diagnosis" VALUE 0x8057EC6E RB_Val_Wu16 13107.00 Volt 0.00 13107.00 FORMAT "%8.2" /end CHARACTERISTIC
/begin CHARACTERISTIC Strt_uDiaThresStkHi_C "High threshold value for starter diagnosis" VALUE 0x8057EC70 RB_Val_Wu16 13107.00 Volt 0.00 13107.00 FORMAT "%8.2" /end CHARACTERISTIC
/begin CHARACTERISTIC Strt_uDiaThresStkLo_C "Low threshold value for starter diagnosis" VALUE 0x8057EC72 RB_Val_Wu16 13107.00 Volt 0.00 13107.00 FORMAT "%8.2" /end CHARACTERISTIC
/begin CHARACTERISTIC Strt_uStmDiaMin_C "Voltage threshold to enable the diagnosis of the starter module" VALUE 0x8057EC50 RB_Val_Ws16 1310700. Volt_Batt -655360.0 655340.0 FORMAT "%8.1" /end CHARACTERISTIC
/begin CHARACTERISTIC Strt_uStrtDiaMin_C "Minimum battery voltage to check a correct start activity" VALUE 0x8057EC74 RB_Val_Ws16 655340.0 Volt_Batt 0.00 655340.0 FORMAT "%8.1" EXTENDED_LIMITS -655360.0 655340.0 /end CHARACTERISTIC
/begin CHARACTERISTIC StSpSwt_SwtDeb.tiHiLo_C "Switch debounce structure for StSpSwt / Time for a High to Low transition" VALUE 0x80591488 Kw_Ws16 655350.0 TimeDeb -327680.0 327670.0 FORMAT "%8.1" /end CHARACTERISTIC
/begin CHARACTERISTIC StSpSwt_SwtDeb.tiLoHi_C "Switch debounce structure for StSpSwt / Time for a Low to High transition" VALUE 0x8059148A Kw_Ws16 655350.0 TimeDeb -327680.0 327670.0 FORMAT "%8.1" /end CHARACTERISTIC
/begin CHARACTERISTIC StSpSwt_swtSelTyp_C "Switch to select between signal from CAN or DIO" VALUE 0x8057EAF0 RB_Val_Wu8 3.000 OneToOne 0.00 3.000 FORMAT "%5.3" EXTENDED_LIMITS 0.00 255.0 /end CHARACTERISTIC
/begin CHARACTERISTIC TVDK "delay time after closing of the throttle" VALUE 0x8057E885 RB_Val_Wu8 5.100 t_q0p02 0.00 5.100 FORMAT "%5.3" /end CHARACTERISTIC
/begin CHARACTERISTIC TVDNOZW "time for delta engine speed without ignition angle intervention" VALUE 0x8057EA96 RB_Val_Wu16 655.3500 t_q0p01 0.00 655.3500 FORMAT "%8.4" /end CHARACTERISTIC
/begin CHARACTERISTIC TVLLRPST "delay to disable proportional parameter in start" VALUE 0x8057E886 RB_Val_Wu8 5.100 t_q0p02 0.00 5.100 FORMAT "%5.3" /end CHARACTERISTIC
/begin MEASUREMENT B_enllri_msg "enable integrator: idle speed controller" UBYTE B_TRUE 1 100 0.00 1.00000000000 BIT_MASK 0x1 FORMAT "%13.11" ECU_ADDRESS 0x70000BEB /end MEASUREMENT
/begin MEASUREMENT B_llrein_msg "Idle speed ready to be put into operation after start" UBYTE B_TRUE 1 100 0.00 1.00000000000 BIT_MASK 0x1 FORMAT "%13.11" ECU_ADDRESS 0x70000B82 /end MEASUREMENT
/begin MEASUREMENT B_llri_msg "Condition activation of I-part of idle speed control" UBYTE B_TRUE 1 100 0.00 1.00000000000 BIT_MASK 0x1 FORMAT "%13.11" ECU_ADDRESS 0x70000B80 /end MEASUREMENT
/begin MEASUREMENT B_llrst_msg "speed reaches nstat first time after start" UBYTE B_TRUE 1 100 0.00 1.00000000000 BIT_MASK 0x1 FORMAT "%13.11" ECU_ADDRESS 0x70000B7F /end MEASUREMENT
/begin MEASUREMENT B_llr_msg "condition idle speed control" UBYTE B_TRUE 1 100 0.00 1.00000000000 BIT_MASK 0x1 FORMAT "%13.11" ECU_ADDRESS 0x70000B83 /end MEASUREMENT
/begin MEASUREMENT B_nmax_msg "Condition engine speed limitation active" UBYTE B_TRUE 1 100 0.00 1.00000000000 BIT_MASK 0x1 FORMAT "%13.11" ECU_ADDRESS 0x6000F233 /end MEASUREMENT
/begin MEASUREMENT B_vllr_msg "Condition vehicle is moving with engaged gear" UBYTE B_TRUE 1 100 0.00 1.00000000000 BIT_MASK 0x1 FORMAT "%13.11" ECU_ADDRESS 0x70000AEE /end MEASUREMENT
/begin MEASUREMENT Com_flgFLWhlSpdInvld "Wheel Speed(Front Left) Validity" UBYTE B_TRUE 1 100 0.00 1.00000000000 BIT_MASK 0x1 FORMAT "%13.11" ECU_ADDRESS 0x6000F176 /end MEASUREMENT
/begin MEASUREMENT Com_flgFRWhlSpdInvld "Wheel Speed(Front Right) Validity" UBYTE B_TRUE 1 100 0.00 1.00000000000 BIT_MASK 0x1 FORMAT "%13.11" ECU_ADDRESS 0x6000F175 /end MEASUREMENT
/begin MEASUREMENT Com_flgRLWhlSpdInvld "Wheel Speed(Rear Left) Validity" UBYTE B_TRUE 1 100 0.00 1.00000000000 BIT_MASK 0x1 FORMAT "%13.11" ECU_ADDRESS 0x6000F16F /end MEASUREMENT
/begin MEASUREMENT Com_flgRRWhlSpdInvld "Wheel Speed(Rear Right) Validity" UBYTE B_TRUE 1 100 0.00 1.00000000000 BIT_MASK 0x1 FORMAT "%13.11" ECU_ADDRESS 0x6000F16E /end MEASUREMENT
/begin MEASUREMENT Com_pBrkP "Braking Pressure" SWORD p_q0p5_bar 1 100 -16384.00 16383.50 FORMAT "%8.2" ECU_ADDRESS 0x600092A2 /end MEASUREMENT
/begin MEASUREMENT Com_pMstCylBrk "Master Cylinder Pressure" SLONG PresAC_hPa 1 100 -4294967296.00 4294967294.00 FORMAT "%13.2" ECU_ADDRESS 0x50004DA8 /end MEASUREMENT
/begin MEASUREMENT Com_pMstCylTstr "Pressure of the brake master cylinder considering VSA CAN error" SWORD Pres_kPa_VSA 1 100 -785121.3 785097.3 FORMAT "%8.1" ECU_ADDRESS 0x6000929A /end MEASUREMENT
/begin MEASUREMENT Com_rMulVehMotPT_MP "Measuring point for Vehicle Motor Ratio" SLONG TransR 1 100 -21474836.4800 21474836.4700 FORMAT "%13.4" ECU_ADDRESS 0x7000A0E4 /end MEASUREMENT
/begin MEASUREMENT Com_stAYCFFuCtrlReq "Fuel control request signal" UBYTE OneToOne 1 100 0.00 255.0 FORMAT "%5.1" ECU_ADDRESS 0x6000F628 /end MEASUREMENT
/begin MEASUREMENT Com_stAYCFRaw "Raw value of VSA shift control request" UBYTE OneToOne 1 100 0.00 255.0 FORMAT "%5.1" ECU_ADDRESS 0x6000F627 /end MEASUREMENT
/begin MEASUREMENT Com_stAYCMonCond "Status of monitoring condition for AYC frames" UBYTE OneToOne 1 100 0.00 255.0 FORMAT "%5.1" ECU_ADDRESS 0x6000F626 /end MEASUREMENT
/begin MEASUREMENT Com_stAYCMonEna "Status of monitoring Enabling" UBYTE OneToOne 1 100 0.00 255.0 FORMAT "%5.1" ECU_ADDRESS 0x6000F625 /end MEASUREMENT
/begin MEASUREMENT Com_stEPBAppld "EPB operation" UBYTE OneToOne 1 100 0.00 1.000 FORMAT "%5.3" ECU_ADDRESS 0x6000F5DE /end MEASUREMENT
/begin MEASUREMENT Com_stEPBFailrInfo "EPB Failure Information" UBYTE OneToOne 1 100 0.00 1.000 FORMAT "%5.3" ECU_ADDRESS 0x6000F5DC /end MEASUREMENT
/begin MEASUREMENT Com_stEPBInhbAct "EPB Inhibit condition" UBYTE OneToOne 1 100 0.00 1.000 FORMAT "%5.3" ECU_ADDRESS 0x6000F5DA /end MEASUREMENT
/begin MEASUREMENT Com_stEPBPlaSftyMod "EPB safety mode" UBYTE OneToOne 1 100 0.00 1.000 FORMAT "%5.3" ECU_ADDRESS 0x6000F5D7 /end MEASUREMENT
/begin MEASUREMENT Com_stEPBStInfo "EPB State Information" UBYTE OneToOne 1 100 0.00 15.00 FORMAT "%5.2" ECU_ADDRESS 0x6000F5D5 /end MEASUREMENT
/begin MEASUREMENT Com_stEPSISSRstrtReq "ISS Restart request from EPS" UBYTE OneToOne 1 100 0.00 255.0 FORMAT "%5.1" ECU_ADDRESS 0x6000F5D1 /end MEASUREMENT
/begin MEASUREMENT Com_stRxAYCD "Status of AYCD Frame Reception" UBYTE OneToOne 1 100 0.00 255.0 FORMAT "%5.1" ECU_ADDRESS 0x6000F560 /end MEASUREMENT
/begin MEASUREMENT Com_stRxAYCDChkSumOk "Status of Checksum Error in AYCD frame" UBYTE OneToOne 1 100 0.00 255.0 FORMAT "%5.1" ECU_ADDRESS 0x6000F55F /end MEASUREMENT
/begin MEASUREMENT Com_stRxAYCDDeb "Debounced Status of AYCD Frame Reception" UBYTE OneToOne 1 100 0.00 255.0 FORMAT "%5.1" ECU_ADDRESS 0x6000F55E /end MEASUREMENT
/begin MEASUREMENT Com_stRxAYCDOk "Error Status of AYCD Frame Reception" UBYTE OneToOne 1 100 0.00 255.0 FORMAT "%5.1" ECU_ADDRESS 0x6000F55D /end MEASUREMENT
/begin MEASUREMENT Com_stRxAYCG "AYCG frame status" UBYTE OneToOne 1 100 0.00 255.0 FORMAT "%5.1" ECU_ADDRESS 0x6000F55C /end MEASUREMENT
/begin MEASUREMENT Com_stRxAYCGChkSumOk "AYCG Checksum status" UBYTE OneToOne 1 100 0.00 255.0 FORMAT "%5.1" ECU_ADDRESS 0x6000F55B /end MEASUREMENT
/begin MEASUREMENT Com_stRxAYCGDeb "AYCG Timeout status" UBYTE OneToOne 1 100 0.00 255.0 FORMAT "%5.1" ECU_ADDRESS 0x6000F55A /end MEASUREMENT
/begin MEASUREMENT Com_stRxAYCGOk "Error Status of AYCG Frame Reception" UBYTE OneToOne 1 100 0.00 255.0 FORMAT "%5.1" ECU_ADDRESS 0x6000F559 /end MEASUREMENT
/begin MEASUREMENT Com_stRxAYCGRingCntOk "AYCG Ring counter status" UBYTE OneToOne 1 100 0.00 255.0 FORMAT "%5.1" ECU_ADDRESS 0x6000F558 /end MEASUREMENT
/begin MEASUREMENT Com_stRxEPBB "Staus of EPBB Frame Reception" UBYTE OneToOne 1 100 0.00 255.0 FORMAT "%5.1" ECU_ADDRESS 0x6000F551 /end MEASUREMENT
/begin MEASUREMENT Com_stRxEPBBDeb "Debounced Status of EPBB Frame Reception" UBYTE OneToOne 1 100 0.00 255.0 FORMAT "%5.1" ECU_ADDRESS 0x6000F54F /end MEASUREMENT
/begin MEASUREMENT Com_stRxEPBBOk "Error Staus of EPBB Frame Reception" UBYTE OneToOne 1 100 0.00 255.0 FORMAT "%5.1" ECU_ADDRESS 0x6000F54E /end MEASUREMENT
/begin MEASUREMENT Com_tqCrpTqDif_MP "measurement point" SLONG TrqHigh_q0p01 1 100 -21474836.4800 21474836.4700 FORMAT "%13.4" ECU_ADDRESS 0x7000A0E0 /end MEASUREMENT
/begin MEASUREMENT Com_trqAYCCnvBoost_MP "Measuring point for torque AYC Boost" SLONG TrqHigh 1 100 -2147483.64800 2147483.64700 FORMAT "%13.5" ECU_ADDRESS 0x7000A0DC /end MEASUREMENT
/begin MEASUREMENT Com_trqAYCFDesRaw "Raw value of Crankshaft torque" SWORD OneToOne 1 100 -32768.00 32767.00 FORMAT "%8.2" ECU_ADDRESS 0x60009254 /end MEASUREMENT
/begin MEASUREMENT Com_trqCrpTqAxleLvl_MP "Measuring point for Torque Axle Level" SLONG TrqHigh_q0p01 1 100 -21474836.4800 21474836.4700 FORMAT "%13.4" ECU_ADDRESS 0x7000A0D8 /end MEASUREMENT
/begin MEASUREMENT Com_vWhlFrntLe "Front Left Wheel Speed" UWORD vfzg_uw_b325 1 100 0.00 324.9950 FORMAT "%8.4" ECU_ADDRESS 0x60008CE2 /end MEASUREMENT
/begin MEASUREMENT Com_vWhlFrntRi "Front Right Wheel Speed" UWORD vfzg_uw_b325 1 100 0.00 324.9950 FORMAT "%8.4" ECU_ADDRESS 0x60008CE0 /end MEASUREMENT
/begin MEASUREMENT Com_vWhlReLe "Rear Left Wheel Speed" UWORD vfzg_uw_b325 1 100 0.00 324.9950 FORMAT "%8.4" ECU_ADDRESS 0x60008CDE /end MEASUREMENT
/begin MEASUREMENT Com_vWhlReRi "Rear Right Wheel Speed" UWORD vfzg_uw_b325 1 100 0.00 324.9950 FORMAT "%8.4" ECU_ADDRESS 0x60008CDC /end MEASUREMENT
/begin MEASUREMENT Com_vWhlSpd "Physical value of front axle speed" SWORD Vel 1 100 -327.6800 327.6700 FORMAT "%8.4" ARRAY_SIZE 4 ECU_ADDRESS 0x50005C5C /end MEASUREMENT
/begin MEASUREMENT dmllri_w_msg "desired torque change from the idle speed control (I-)" SWORD rel_sw_b100 1 100 -100.0000 99.9969 FORMAT "%8.4" ECU_ADDRESS 0x60008DA6 /end MEASUREMENT
/begin MEASUREMENT dmllr_w_msg "Desired torque change from the idle speed control (PD-part)." SWORD rel_sw_b100 1 100 -100.0000 99.9969 FORMAT "%8.4" ECU_ADDRESS 0x60008DA8 /end MEASUREMENT
/begin MEASUREMENT dn_w_msg "speed deviation at idle speed control" SWORD nmot_sw_q0p25 1 100 -8192.000 8191.750 FORMAT "%8.3" ECU_ADDRESS 0x70003A20 /end MEASUREMENT
/begin MEASUREMENT EepRdStrt "Starter EEP read status" UBYTE OneToOne 1 100 0.00 255.0 FORMAT "%5.1" ECU_ADDRESS 0x6000ADBC /end MEASUREMENT
/begin MEASUREMENT EepRdStrtRly "Starter relay EEP read status" UBYTE OneToOne 1 100 0.00 255.0 FORMAT "%5.1" ECU_ADDRESS 0x6000ADBB /end MEASUREMENT
/begin MEASUREMENT rba_StopCntrWakeup_ProlongCntr "" ULONG OneToOne 1 100 0.00 4294967295.00 FORMAT "%13.2" ECU_ADDRESS 0x60003AD8 /end MEASUREMENT
/begin MEASUREMENT rba_StopCntrWakeup_stIsWakeUp_u8 "Status if the ECU is in Stop Counter Wakeup Mode" UBYTE OneToOne 1 100 0.00 255.0 FORMAT "%5.1" ECU_ADDRESS 0x6000F94D /end MEASUREMENT
/begin MEASUREMENT SpdGov_bASDPrio_mp "active surge damping (ASD) has priority before low idle governor" UBYTE B_TRUE 1 100 0.00 1.00000000000 BIT_MASK 0x1 FORMAT "%13.11" ECU_ADDRESS 0x7000A0E9 /end MEASUREMENT
/begin MEASUREMENT SpdGov_bEngPrtLimOvrSpd "Condition for engine speed limitition during over speed" UBYTE B_TRUE 1 100 0.00 1.00000000000 BIT_MASK 0x1 FORMAT "%13.11" ECU_ADDRESS 0x6000F0B1 /end MEASUREMENT
/begin MEASUREMENT SpdGov_bNLimActv "Condition engine speed limitation active" UBYTE B_TRUE 1 100 0.00 1.00000000000 BIT_MASK 0x1 FORMAT "%13.11" ECU_ADDRESS 0x6000F0B0 /end MEASUREMENT
/begin MEASUREMENT SpdGov_bNMaxTqLim "Cylinder cut-off by maximum engine speed limitation" UBYTE B_TRUE 1 100 0.00 1.00000000000 BIT_MASK 0x1 FORMAT "%13.11" ECU_ADDRESS 0x6000F0AF /end MEASUREMENT
/begin MEASUREMENT SpdGov_dnFlt "filtered engine-speed gradient" SWORD EngNGrd 1 100 -16384.00 16383.50 FORMAT "%8.2" ECU_ADDRESS 0x60006910 /end MEASUREMENT
/begin MEASUREMENT SpdGov_facComp "Weighting factor for torque loss compensation" SWORD fak_sw_b4 1 100 0.00 1.000000 FORMAT "%8.6" ECU_ADDRESS 0x70003A5C /end MEASUREMENT
/begin MEASUREMENT SpdGov_facCompRmp "ramp factor for accessory compensation during idling" UBYTE fak_ub_b1 1 100 0.00 0.9961 ECU_ADDRESS 0x7000366D /end MEASUREMENT
/begin MEASUREMENT SpdGov_facThrStabComp "stabilization factor for compensation factor due to power steering etc. during idling" SWORD fak_sw_b4 1 100 -4.000000 3.999878 FORMAT "%8.6" ECU_ADDRESS 0x60000E62 /end MEASUREMENT
/begin MEASUREMENT SpdGov_facTrqDynDist "factor for distribution of dynamic speed controller torque between engine and electric motor" SWORD Fact 1 100 -4.000000 3.999878 FORMAT "%8.6" ECU_ADDRESS 0x600068FE /end MEASUREMENT
/begin MEASUREMENT SpdGov_fakLimMech "Factor for modification of Set-path during active NMAX-limitation" UWORD fak_uw_b2 1 100 0.00 1.000000 FORMAT "%8.6" ECU_ADDRESS 0x6000690E /end MEASUREMENT
/begin MEASUREMENT SpdGov_flgEnaCondIncTqAirPah "Release condition for increase of permissible torque on lead-path" UBYTE B_TRUE 1 100 0.00 1.00000000000 BIT_MASK 0x1 FORMAT "%13.11" ECU_ADDRESS 0x6000ADFD /end MEASUREMENT
/begin MEASUREMENT SpdGov_flgFflpAirPah "Flag to indicate that re-activation of increase of permissible torque on lead-path is allowed" UBYTE B_TRUE 1 100 0.00 1.00000000000 BIT_MASK 0x1 FORMAT "%13.11" ECU_ADDRESS 0x6000ADFC /end MEASUREMENT
/begin MEASUREMENT SpdGov_flgIncTqAirPah "Increase of permissible torque on lead-path is active" UBYTE B_TRUE 1 100 0.00 1.00000000000 BIT_MASK 0x1 FORMAT "%13.11" ECU_ADDRESS 0x6000ADFB /end MEASUREMENT
/begin MEASUREMENT SpdGov_flgIniCond "Release condition for the initialization of the filter and the ramp" UBYTE B_TRUE 1 100 0.00 1.00000000000 BIT_MASK 0x1 FORMAT "%13.11" ECU_ADDRESS 0x70000109 /end MEASUREMENT
/begin MEASUREMENT SpdGov_flgNHysIncTqAirPah "Flag of engine speed hysteresis for release of increase of permissible torque on lead-path" UBYTE B_TRUE 1 100 0.00 1.00000000000 BIT_MASK 0x1 FORMAT "%13.11" ECU_ADDRESS 0x6000ADFA /end MEASUREMENT
/begin MEASUREMENT SpdGov_flgnoIAi "flag indication Ignition angle intervention" UBYTE B_TRUE 1 100 0.00 1.00000000000 BIT_MASK 0x1 FORMAT "%13.11" ECU_ADDRESS 0x6000ADF9 /end MEASUREMENT
/begin MEASUREMENT SpdGov_flgTstrLimCutOff "Flag to indicate the cut off limitation due to tester" UBYTE B_TRUE 1 100 0.00 1.00000000000 BIT_MASK 0x1 FORMAT "%13.11" ECU_ADDRESS 0x6000F0AE /end MEASUREMENT
/begin MEASUREMENT SpdGov_KiNMaxLim "Integral gain of maximum rpm control" UWORD q3p052Em4_min_Nm_DIV_s 1 100 0.00 19.99969 FORMAT "%8.5" ECU_ADDRESS 0x6000690C /end MEASUREMENT
/begin MEASUREMENT SpdGov_KpNMaxLim "Gain of proportional component rpm control" UWORD q3p05175Em3_min_Nm 1 100 0.00 199.9969 FORMAT "%8.4" ECU_ADDRESS 0x6000690A /end MEASUREMENT
/begin MEASUREMENT SpdGov_nDiffNMax "Difference between engine speed limit and actual engine speed" SWORD nmot_sw_q0p5 1 100 -16384.00 16383.50 FORMAT "%8.2" ECU_ADDRESS 0x60006908 /end MEASUREMENT
/begin MEASUREMENT SpdGov_NMaxLim_ctReIni "Local drive cycle counter for ReIni" UWORD OneToOne 1 100 0.00 65535.00 FORMAT "%8.2" ECU_ADDRESS 0x60006906 /end MEASUREMENT
/begin MEASUREMENT SpdGov_nMaxPrdc "Predicted engine speed for rpm control" SWORD nmot_sw_q0p5 1 100 -16384.00 16383.50 FORMAT "%8.2" ECU_ADDRESS 0x60008F78 /end MEASUREMENT
/begin MEASUREMENT SpdGov_nSetPLo "Speed array for lower limits of engine speed" SWORD nmot_sw_q0p5 1 100 -16384.00 16383.50 FORMAT "%8.2" ARRAY_SIZE 2 ECU_ADDRESS 0x6000164A /end MEASUREMENT
/begin MEASUREMENT SpdGov_st "Status information of the Speed governor" UWORD dez 1 100 0.00 65535.00 FORMAT "%8.2" ECU_ADDRESS 0x6000075A /end MEASUREMENT
/begin MEASUREMENT SpdGov_stTstrLimCutOff "Status of cut off limitation by tester" UBYTE OneToOne 1 100 0.00 255.0 FORMAT "%5.1" ECU_ADDRESS 0x6000F356 /end MEASUREMENT
/begin MEASUREMENT SpdGov_tqCluLimnMeclDesTemp "Temporary Torque request by engine speed limitation" SWORD md_sw_q0p1 1 100 -3276.800 3276.700 FORMAT "%8.3" ECU_ADDRESS 0x60006904 /end MEASUREMENT
/begin MEASUREMENT SpdGov_tqCluLimnMeclFco "High speed governor's output torque for cut-off path on clutch torque level" SWORD md_sw_q0p1 1 100 -3276.800 3276.700 FORMAT "%8.3" ECU_ADDRESS 0x60008F76 /end MEASUREMENT
/begin MEASUREMENT SpdGov_trqClth "Torque of the idle speed controller at the driveaway clutch" SWORD Trq 1 100 -3276.800 3276.700 FORMAT "%8.3" ECU_ADDRESS 0x60008F74 /end MEASUREMENT
/begin MEASUREMENT SpdGov_trqClthCurr "Torque requested from the speed controller at the clutch level on current path" SWORD Trq 1 100 -3276.800 3276.700 FORMAT "%8.3" ECU_ADDRESS 0x60008F72 /end MEASUREMENT
/begin MEASUREMENT SpdGov_trqClthLead "Torque of the idle speed controller (lead-path) )at the driveaway clutch" SWORD Trq 1 100 -3276.800 3276.700 FORMAT "%8.3" ECU_ADDRESS 0x60008F70 /end MEASUREMENT
/begin MEASUREMENT SpdGov_trqClthLimMechDes "Torque request by engine speed limitation" SWORD md_sw_q0p1 1 100 -3276.800 3276.700 FORMAT "%8.3" ECU_ADDRESS 0x60008F6E /end MEASUREMENT
/begin MEASUREMENT SpdGov_trqClthLimMechLead "indicated nominal torque for NMAX limiting (air)" SWORD md_sw_q0p1 1 100 -3276.800 3276.700 FORMAT "%8.3" ECU_ADDRESS 0x60008F6C /end MEASUREMENT
/begin MEASUREMENT SpdGov_trqDyn "dynamic part of speed controller torque" SWORD Trq 1 100 -3276.800 3276.700 FORMAT "%8.3" ECU_ADDRESS 0x60008F6A /end MEASUREMENT
/begin MEASUREMENT SpdGov_trqDynElM "dynamic part of speed controller torque for electrical machine" SWORD Trq 1 100 -3276.800 3276.700 FORMAT "%8.3" ECU_ADDRESS 0x60008F68 /end MEASUREMENT
/begin MEASUREMENT SpdGov_trqDynEng "dynamic part of speed controller torque for engine" SWORD Trq 1 100 -3276.800 3276.700 FORMAT "%8.3" ECU_ADDRESS 0x60008F66 /end MEASUREMENT
/begin MEASUREMENT SpdGov_trqDynEngLtd "dynamic limited part of speed controller torque for engine" SWORD Trq 1 100 -3276.800 3276.700 FORMAT "%8.3" ECU_ADDRESS 0x60008F64 /end MEASUREMENT
/begin MEASUREMENT SpdGov_trqDynLead "dynamic part of speed controller torque for lead-path" SWORD Trq 1 100 -3276.800 3276.700 FORMAT "%8.3" ECU_ADDRESS 0x60008F62 /end MEASUREMENT
/begin MEASUREMENT SpdGov_trqFlt "Filtered setpoint torque of the speed governor" SWORD md_q0p1 1 100 -3276.800 3276.700 FORMAT "%8.3" ECU_ADDRESS 0x6000075E /end MEASUREMENT
/begin MEASUREMENT SpdGov_trqFltDiag "For diagnosis filter speed governor torque" SWORD md_q0p1 1 100 -3276.800 3276.700 FORMAT "%8.3" ECU_ADDRESS 0x50000888 /end MEASUREMENT
/begin MEASUREMENT SpdGov_trqINMaxLim "Torque by integral component of rpm control" SWORD md_sw_q0p1 1 100 -3276.800 3276.700 FORMAT "%8.3" ECU_ADDRESS 0x60006902 /end MEASUREMENT
/begin MEASUREMENT SpdGov_trqLead "Setpoint torque of the SpdGov on the air path" SWORD md_q0p1 1 100 -3276.800 3276.700 FORMAT "%8.3" ECU_ADDRESS 0x60001648 /end MEASUREMENT
/begin MEASUREMENT SpdGov_trqMax "maximum allowed torque for speed governor" SWORD md_q0p1 1 100 -3276.800 3276.700 FORMAT "%8.3" ECU_ADDRESS 0x60000762 /end MEASUREMENT
/begin MEASUREMENT SpdGov_trqPNMaxLim "Torque by proportional component of rpm control" SWORD md_sw_q0p1 1 100 -3276.800 3276.700 FORMAT "%8.3" ECU_ADDRESS 0x60006900 /end MEASUREMENT
/begin MEASUREMENT SpdGov_trqSet "Setpoint torque of the speed governor on the fuel path" SWORD md_q0p1 1 100 -3276.800 3276.700 FORMAT "%8.3" ECU_ADDRESS 0x60000764 /end MEASUREMENT
/begin MEASUREMENT SpdGov_trqSty "stationary part of speed controller torque" SWORD Trq 1 100 -3276.800 3276.700 FORMAT "%8.3" ECU_ADDRESS 0x60008F5C /end MEASUREMENT
/begin MEASUREMENT SrvCSwt_st "Debounced value of Service check switch" UBYTE OneToOne 1 100 0.00 255.0 FORMAT "%5.1" ECU_ADDRESS 0x50006056 /end MEASUREMENT
/begin MEASUREMENT SrvCSwt_stRaw "Raw value of Service check switch" UBYTE OneToOne 1 100 0.00 255.0 FORMAT "%5.1" ECU_ADDRESS 0x6000F355 /end MEASUREMENT
/begin MEASUREMENT SSEUI_bBrkPedlStrtReq "Start Request by reduction of brake negative pressure" UBYTE B_TRUE 1 100 0.00 1.00000000000 BIT_MASK 0x1 FORMAT "%13.11" ECU_ADDRESS 0x6000ADF8 /end MEASUREMENT
/begin MEASUREMENT SSEUI_cntrReIni "ReIni counter" UBYTE OneToOne 1 100 0.00 255.0 FORMAT "%5.1" ECU_ADDRESS 0x6000ADF7 /end MEASUREMENT
/begin MEASUREMENT SSEUI_flgACForIS "The status of enable condition from AC system for IS" UBYTE B_TRUE 1 100 0.00 1.00000000000 BIT_MASK 0x1 FORMAT "%13.11" ECU_ADDRESS 0x6000ADF6 /end MEASUREMENT
/begin MEASUREMENT SSEUI_flgEngStrtReq "Restart request by battery conditions" UBYTE B_TRUE 1 100 0.00 1.00000000000 BIT_MASK 0x1 FORMAT "%13.11" ECU_ADDRESS 0x6000ADF5 /end MEASUREMENT
/begin MEASUREMENT SSEUI_flgSysFail "System failure conditions" UBYTE B_TRUE 1 100 0.00 1.00000000000 BIT_MASK 0x1 FORMAT "%13.11" ECU_ADDRESS 0x6000ADF4 /end MEASUREMENT
/begin MEASUREMENT SSEUI_flgVehCdnHist "Flag for Vehicle Speed History" UBYTE B_TRUE 1 100 0.00 1.00000000000 BIT_MASK 0x1 FORMAT "%13.11" ECU_ADDRESS 0x6000ADF3 /end MEASUREMENT
/begin MEASUREMENT SSEUI_st2DCSysFailr "Status of FId_SSEUI2DCSysFailr" UBYTE B_TRUE 1 100 0.00 1.00000000000 BIT_MASK 0x1 FORMAT "%13.11" ECU_ADDRESS 0x60038B19 /end MEASUREMENT
/begin MEASUREMENT SSEUI_st2DCSysFailrOld "Status of FId_SSEUI2DCSysFailr in previous driving cycle." UBYTE B_TRUE 1 100 0.00 1.00000000000 BIT_MASK 0x1 FORMAT "%13.11" ECU_ADDRESS 0x6000ADF2 /end MEASUREMENT
/begin MEASUREMENT SSEUI_stActionCVTMode05Old "Old value of CVT action 5 for LAmp display" UBYTE OneToOne 1 100 0.00 255.0 FORMAT "%5.1" ECU_ADDRESS 0x6000ADF1 /end MEASUREMENT
/begin MEASUREMENT SSEUI_stActionMode5Old "Old status of Action in Mode 05h" UBYTE OneToOne 1 100 0.00 255.0 FORMAT "%5.1" ECU_ADDRESS 0x6000ADF0 /end MEASUREMENT
/begin MEASUREMENT SSEUI_stActionOld "Variable to keep the old state value" UBYTE OneToOne 1 100 0.00 255.0 FORMAT "%5.1" ECU_ADDRESS 0x6000ADEF /end MEASUREMENT
/begin MEASUREMENT SSEUI_stActionOldMode40 "Old value of action in Mode 40h" UBYTE OneToOne 1 100 0.00 255.0 FORMAT "%5.1" ECU_ADDRESS 0x6000ADEE /end MEASUREMENT
/begin MEASUREMENT SSEUI_stActn8Trig "Action 8 trigger in Display Mode 5" UBYTE B_TRUE 1 100 0.00 1.00000000000 BIT_MASK 0x1 FORMAT "%13.11" ECU_ADDRESS 0x6000ADED /end MEASUREMENT
/begin MEASUREMENT SSEUI_stAutEngRstrtIndInitEndCVT "Finished initializing for auto engine start timer(Preindication delay), CVT" UBYTE B_TRUE 1 100 0.00 1.00000000000 BIT_MASK 0x1 FORMAT "%13.11" ECU_ADDRESS 0x6000ADEC /end MEASUREMENT
/begin MEASUREMENT SSEUI_stBatt "Suitable battery voltage for IS" UBYTE B_TRUE 1 100 0.00 1.00000000000 BIT_MASK 0x1 FORMAT "%13.11" ECU_ADDRESS 0x6000ADEB /end MEASUREMENT
/begin MEASUREMENT SSEUI_stCANErrMask "Mask to determine CAN commumication reliability." UBYTE B_TRUE 1 100 0.00 1.00000000000 BIT_MASK 0x1 FORMAT "%13.11" ECU_ADDRESS 0x6000F0B6 /end MEASUREMENT
/begin MEASUREMENT SSEUI_stDispAutEngStrtHist "Indication of auto engine start history" UBYTE B_TRUE 1 100 0.00 1.00000000000 BIT_MASK 0x1 FORMAT "%13.11" ECU_ADDRESS 0x6000ADEA /end MEASUREMENT
/begin MEASUREMENT SSEUI_stDispOffReq "Display Off Request in Mode 4." UBYTE B_TRUE 1 100 0.00 1.00000000000 BIT_MASK 0x1 FORMAT "%13.11" ECU_ADDRESS 0x6000F0B5 /end MEASUREMENT
/begin MEASUREMENT SSEUI_stDispReasAutoRcv "Display reason for automatic recovery, MT" UBYTE B_TRUE 1 100 0.00 1.00000000000 BIT_MASK 0x1 FORMAT "%13.11" ECU_ADDRESS 0x6000ADE9 /end MEASUREMENT
/begin MEASUREMENT SSEUI_stDispReasAutoRstrt "Display reason for auto engine start." UBYTE B_TRUE 1 100 0.00 1.00000000000 BIT_MASK 0x1 FORMAT "%13.11" ECU_ADDRESS 0x6000ADE8 /end MEASUREMENT
/begin MEASUREMENT SSEUI_stDrvrGuidInhb "Driver guidance inhibition information" UBYTE OneToOne 1 100 0.00 1.000 FORMAT "%5.3" ECU_ADDRESS 0x6000F360 /end MEASUREMENT
/begin MEASUREMENT SSEUI_stFlgPreIndcnNotOvr "Pre indication Delay not over" UBYTE B_TRUE 1 100 0.00 1.00000000000 BIT_MASK 0x1 FORMAT "%13.11" ECU_ADDRESS 0x6000F0B4 /end MEASUREMENT
/begin MEASUREMENT SSEUI_stHoodAndBlt "Engine Hood , Seat Belt and system conditions in Display Mode 1" UBYTE B_TRUE 1 100 0.00 1.00000000000 BIT_MASK 0x1 FORMAT "%13.11" ECU_ADDRESS 0x6000ADE7 /end MEASUREMENT
/begin MEASUREMENT SSEUI_stIdlStpOk "Idle stop permission ok" UBYTE B_TRUE 1 100 0.00 1.00000000000 BIT_MASK 0x1 FORMAT "%13.11" ECU_ADDRESS 0x6000F0B3 /end MEASUREMENT
/begin MEASUREMENT SSEUI_stInIdleStop "Idle Stop Status" UBYTE B_TRUE 1 100 0.00 1.00000000000 BIT_MASK 0x1 FORMAT "%13.11" ECU_ADDRESS 0x6000ADE6 /end MEASUREMENT
/begin MEASUREMENT SSEUI_stISDispMode "Meter Display Mode" UBYTE OneToOne 1 100 0.00 255.0 FORMAT "%5.1" ECU_ADDRESS 0x6000F35F /end MEASUREMENT
/begin MEASUREMENT SSEUI_stISSInhbReas "The status of idle stop inhibition reason for MID" UBYTE OneToOne 1 100 0.00 255.0 FORMAT "%5.1" ECU_ADDRESS 0x6000F35E /end MEASUREMENT
/begin MEASUREMENT SSEUI_stISSLampReq "The status of ISS lamp-on request for MID" UBYTE OneToOne 1 100 0.00 255.0 FORMAT "%5.1" ECU_ADDRESS 0x6000F35D /end MEASUREMENT
/begin MEASUREMENT SSEUI_stISSLampReqInfo "The status of ISS lamp-on request information for MID" UBYTE OneToOne 1 100 0.00 255.0 FORMAT "%5.1" ECU_ADDRESS 0x6000F35C /end MEASUREMENT
/begin MEASUREMENT SSEUI_stISSWarnReq "The status of ISS warning request for MID" UBYTE OneToOne 1 100 0.00 255.0 FORMAT "%5.1" ECU_ADDRESS 0x6000F35B /end MEASUREMENT
/begin MEASUREMENT SSEUI_stLampOff "Lamp Off conditions in Mode 5(AT\CVT)" UBYTE B_TRUE 1 100 0.00 1.00000000000 BIT_MASK 0x1 FORMAT "%13.11" ECU_ADDRESS 0x6000ADE5 /end MEASUREMENT
/begin MEASUREMENT SSEUI_stLoBattT "Battery temperature in Display Mode 1" UBYTE B_TRUE 1 100 0.00 1.00000000000 BIT_MASK 0x1 FORMAT "%13.11" ECU_ADDRESS 0x6000ADE4 /end MEASUREMENT
/begin MEASUREMENT SSEUI_stLoEngT "Engine Temperature in Display Mode 1" UBYTE B_TRUE 1 100 0.00 1.00000000000 BIT_MASK 0x1 FORMAT "%13.11" ECU_ADDRESS 0x6000ADE3 /end MEASUREMENT
/begin MEASUREMENT SSEUI_stLoSpdCVT "CVT Low Speed Vehicle Presence history" UBYTE B_TRUE 1 100 0.00 1.00000000000 BIT_MASK 0x1 FORMAT "%13.11" ECU_ADDRESS 0x6000ADE2 /end MEASUREMENT
/begin MEASUREMENT SSEUI_stMod01Trig "Mode 1 trigger conditions" UBYTE B_TRUE 1 100 0.00 1.00000000000 BIT_MASK 0x1 FORMAT "%13.11" ECU_ADDRESS 0x6000ADE1 /end MEASUREMENT
/begin MEASUREMENT SSEUI_stMod05StChg "State change conditions in Mode 5" UBYTE B_TRUE 1 100 0.00 1.00000000000 BIT_MASK 0x1 FORMAT "%13.11" ECU_ADDRESS 0x6000ADE0 /end MEASUREMENT
/begin MEASUREMENT SSEUI_stMod05Trig "Mode 5 trigger conditions" UBYTE B_TRUE 1 100 0.00 1.00000000000 BIT_MASK 0x1 FORMAT "%13.11" ECU_ADDRESS 0x6000ADDF /end MEASUREMENT
/begin MEASUREMENT SSEUI_stMod5Actn1 "Mode 5 Action 1 conditions (MT)" UBYTE B_TRUE 1 100 0.00 1.00000000000 BIT_MASK 0x1 FORMAT "%13.11" ECU_ADDRESS 0x6000ADDE /end MEASUREMENT
/begin MEASUREMENT SSEUI_stMod5Actn2 "Mode 5 ACtion 2 conditions (MT)" UBYTE B_TRUE 1 100 0.00 1.00000000000 BIT_MASK 0x1 FORMAT "%13.11" ECU_ADDRESS 0x6000ADDD /end MEASUREMENT
/begin MEASUREMENT SSEUI_stMod5Chg "The Mode Change status in Mode 5" UBYTE OneToOne 1 100 0.00 255.0 FORMAT "%5.1" ECU_ADDRESS 0x6000ADDC /end MEASUREMENT
/begin MEASUREMENT SSEUI_stModeChg "Mode change information" UBYTE OneToOne 1 100 0.00 255.0 FORMAT "%5.1" ECU_ADDRESS 0x6000F35A /end MEASUREMENT
/begin MEASUREMENT SSEUI_stSmrySysFailrFlag "Summary system failure flag" UBYTE OneToOne 1 100 0.00 1.000 FORMAT "%5.3" ECU_ADDRESS 0x6000F359 /end MEASUREMENT
/begin MEASUREMENT SSEUI_stSpstInhbFct "I\S Inhibitor Function" UBYTE B_TRUE 1 100 0.00 1.00000000000 BIT_MASK 0x1 FORMAT "%13.11" ECU_ADDRESS 0x6000ADDB /end MEASUREMENT
/begin MEASUREMENT SSEUI_stStrtClthReq "The status of ISS Start clutch request" UBYTE OneToOne 1 100 0.00 255.0 FORMAT "%5.1" ECU_ADDRESS 0x6000F358 /end MEASUREMENT
/begin MEASUREMENT SSEUI_stStrtrOff "Starter Off status" UBYTE B_TRUE 1 100 0.00 1.00000000000 BIT_MASK 0x1 FORMAT "%13.11" ECU_ADDRESS 0x6000ADDA /end MEASUREMENT
/begin MEASUREMENT SSEUI_stStrtrOnBySTSReq "Starter ON instruction by STS starting request" UBYTE B_TRUE 1 100 0.00 1.00000000000 BIT_MASK 0x1 FORMAT "%13.11" ECU_ADDRESS 0x6000ADD9 /end MEASUREMENT
/begin MEASUREMENT SSEUI_stTrigMod00to11 "Mode 0 to Mode 11 trigger conditions" UBYTE B_TRUE 1 100 0.00 1.00000000000 BIT_MASK 0x1 FORMAT "%13.11" ECU_ADDRESS 0x6000ADD8 /end MEASUREMENT
/begin MEASUREMENT SSEUI_stTrigMod11to00 "Mode 11 to Mode 0 Trigger conditions" UBYTE B_TRUE 1 100 0.00 1.00000000000 BIT_MASK 0x1 FORMAT "%13.11" ECU_ADDRESS 0x6000ADD7 /end MEASUREMENT
/begin MEASUREMENT SSEUI_tiACDlyCVT "Timer for AC delay CVT" UBYTE Time_Second 1 100 0.00 255.0 FORMAT "%5.1" ECU_ADDRESS 0x6000ADD6 /end MEASUREMENT
/begin MEASUREMENT SSEUI_tiCANErrMask "Down Timer for IG2 mask" SWORD Time_s 1 100 -327.6800 327.6700 FORMAT "%8.4" ECU_ADDRESS 0x600068FC /end MEASUREMENT
/begin MEASUREMENT SSEUI_tiDispEndDly "Timer for preindication delay" SWORD Time_s 1 100 0.00 327.6700 FORMAT "%8.4" ECU_ADDRESS 0x600068FA /end MEASUREMENT
/begin MEASUREMENT SSEUI_tiDlySeatBlt "Timer variable to update time after seat belt unlatch" SWORD Time_s 1 100 0.00 327.6700 FORMAT "%8.4" ECU_ADDRESS 0x600068F8 /end MEASUREMENT
/begin MEASUREMENT SSEUI_tiInGearDly "Timer variable to update time before in gear display is provided" SWORD Time_s 1 100 0.00 327.6700 FORMAT "%8.4" ECU_ADDRESS 0x600068F6 /end MEASUREMENT
/begin MEASUREMENT SSEUI_tiIniChk "Timer variable for initial check" SWORD Time_s 1 100 0.00 327.6700 FORMAT "%8.4" ECU_ADDRESS 0x600068F4 /end MEASUREMENT
/begin MEASUREMENT SSEUI_tiISSDisp "Timer varialbe for ISS display delay." SWORD Time_s 1 100 0.00 327.6700 FORMAT "%8.4" ECU_ADDRESS 0x600068F2 /end MEASUREMENT
/begin MEASUREMENT StatyCoorn_flgEnaBypCmpdTq "Flag to enable bypass the compensated torque for ASD filter" UBYTE B_TRUE 1 100 0.00 1.00000000000 BIT_MASK 0x1 FORMAT "%13.11" ECU_ADDRESS 0x6000F0AD /end MEASUREMENT
/begin MEASUREMENT StatyCoorn_tqCluDesBefLimn "Propulsion torque before limitation by stationary limits" SWORD Trq 1 100 -3276.800 3276.700 FORMAT "%8.3" ECU_ADDRESS 0x60008F56 /end MEASUREMENT
/begin MEASUREMENT StatyCoorn_tqCluDesLimd "Propulsion torque limited by stationary limits" SWORD Trq 1 100 -3276.800 3276.700 FORMAT "%8.3" ECU_ADDRESS 0x60008F54 /end MEASUREMENT
/begin MEASUREMENT StatyCoorn_tqCluDrvDmdDes "Propulsion torque limited by differential and transmission protection" SWORD Trq 1 100 -3276.800 3276.700 FORMAT "%8.3" ECU_ADDRESS 0x60008F52 /end MEASUREMENT
/begin MEASUREMENT StatyCoorn_tqCluDrvrDmdGenericLimn "Propulsion torque limited by generic component protection" SWORD Trq 1 100 -3276.800 3276.700 FORMAT "%8.3" ECU_ADDRESS 0x60008F50 /end MEASUREMENT
/begin MEASUREMENT StatyCoorn_tqCluLeadBefEngLimn "Lead torque path at clutch level before engine limitation" SWORD Trq 1 100 -3276.800 3276.700 FORMAT "%8.3" ECU_ADDRESS 0x600068F0 /end MEASUREMENT
/begin MEASUREMENT StatyCoorn_tqCluLeadEngMax "maximum torque of the combustion engine at clutch level on lead path" SWORD Trq 1 100 -3276.800 3276.700 FORMAT "%8.3" ECU_ADDRESS 0x600068EE /end MEASUREMENT
/begin MEASUREMENT StatyCoorn_tqCluLeadEngMin "minimum torque of the combustion engine at clutch level on lead path" SWORD Trq 1 100 -3276.800 3276.700 FORMAT "%8.3" ECU_ADDRESS 0x600068EC /end MEASUREMENT
/begin MEASUREMENT StatyCoorn_tqCluLeadLimd "Limited propulsion torque after stationary torque distribution on lead path at clutch level" SWORD Trq 1 100 -3276.800 3276.700 FORMAT "%8.3" ECU_ADDRESS 0x60008F4E /end MEASUREMENT
/begin MEASUREMENT StatyCoorn_tqCluMax "Maximum stationary allowed torque at clutch level" SWORD Trq 1 100 -3276.800 3276.700 FORMAT "%8.3" ECU_ADDRESS 0x60008F4C /end MEASUREMENT
/begin MEASUREMENT StatyCoorn_tqCluMin "Minimum stationary allowed torque at clutch level" SWORD Trq 1 100 -3276.800 3276.700 FORMAT "%8.3" ECU_ADDRESS 0x60008F4A /end MEASUREMENT
/begin MEASUREMENT StatyCoorn_tqCluTotLeadMax "Maximum torque limitation on total lead torque path at clutch level" SWORD Trq 1 100 -3276.800 3276.700 FORMAT "%8.3" ECU_ADDRESS 0x600068EA /end MEASUREMENT
/begin MEASUREMENT StatyCoorn_tqCluTotLeadMin "Minimum torque limitation on total lead torque path at clutch level" SWORD Trq 1 100 -3276.800 3276.700 FORMAT "%8.3" ECU_ADDRESS 0x600068E8 /end MEASUREMENT
/begin MEASUREMENT StbIntvECU_ctAYCARngCnt_MP "Ring counter message of AYCA frame" UBYTE OneToOne 1 100 0.00 255.0 FORMAT "%5.1" ECU_ADDRESS 0x7000A0E8 /end MEASUREMENT
/begin MEASUREMENT StbIntvECU_ctAYCFRngCnt_MP "Measuring point for AYCF Ring Counter" UBYTE OneToOne 1 100 0.00 255.0 FORMAT "%5.1" ECU_ADDRESS 0x7000A0D4 /end MEASUREMENT
/begin MEASUREMENT StbIntvECU_ctAYCGRngCnt_MP "AYCG Ring Counter Measuring Point" UBYTE OneToOne 1 100 0.00 255.0 FORMAT "%5.1" ECU_ADDRESS 0x7000A0D3 /end MEASUREMENT
/begin MEASUREMENT StbIntvECU_ctAYCIRngCnt_MP "AYCI Ring counter Measuring Point" UBYTE OneToOne 1 100 0.00 3.000 FORMAT "%5.3" ECU_ADDRESS 0x7000A0D2 /end MEASUREMENT
/begin MEASUREMENT StbIntv_bAYCIntvActv "AYC active condition status" UBYTE OneToOne 1 100 0.00 255.0 FORMAT "%5.1" ECU_ADDRESS 0x6000F350 /end MEASUREMENT
/begin MEASUREMENT StbIntv_bDCSIntv "DCS(Drag control system) intervention active status" UBYTE B_TRUE 1 100 0.00 1.00000000000 BIT_MASK 0x1 FORMAT "%13.11" ECU_ADDRESS 0x6000F0AC /end MEASUREMENT
/begin MEASUREMENT StbIntv_bDCSNeutr "Neutral value received for DCS intervention" UBYTE B_TRUE 1 100 0.00 1.00000000000 BIT_MASK 0x1 FORMAT "%13.11" ECU_ADDRESS 0x6000F0AB /end MEASUREMENT
/begin MEASUREMENT StbIntv_bTCSIntv "TCS(Traction Control System) intervention active status" UBYTE B_TRUE 1 100 0.00 1.00000000000 BIT_MASK 0x1 FORMAT "%13.11" ECU_ADDRESS 0x6000F0AA /end MEASUREMENT
/begin MEASUREMENT StbIntv_bTCSNeutr "Neutral value received for TCS intervention" UBYTE B_TRUE 1 100 0.00 1.00000000000 BIT_MASK 0x1 FORMAT "%13.11" ECU_ADDRESS 0x6000F0A9 /end MEASUREMENT
/begin MEASUREMENT StbIntv_flgDCSPlusTrqReqd "Plus torque requested during DCS operation" UBYTE B_TRUE 1 100 0.00 1.00000000000 BIT_MASK 0x1 FORMAT "%13.11" ECU_ADDRESS 0x6000F0A8 /end MEASUREMENT
/begin MEASUREMENT StbIntv_trqDCSDes "DCS intervention torque at wheel level" SLONG trq_q0p1 1 100 -214748364.800 214748364.700 FORMAT "%13.3" ECU_ADDRESS 0x7000525C /end MEASUREMENT
/begin MEASUREMENT StbIntv_trqTCSDes "Desired TCS intervention torque at wheel level" SLONG trq_q0p1 1 100 -214748364.800 214748364.700 FORMAT "%13.3" ECU_ADDRESS 0x70005260 /end MEASUREMENT
/begin MEASUREMENT StbIntv_trqTCSLead "TCS lead torque value." SLONG trq_q0p1 1 100 -214748364.800 214748364.700 FORMAT "%13.3" ECU_ADDRESS 0x70005264 /end MEASUREMENT
/begin MEASUREMENT StbIntv_vWhlSpd "Array of wheel speed value for each wheel" SWORD Vel 1 100 -327.6800 327.6700 FORMAT "%8.4" ARRAY_SIZE 4 ECU_ADDRESS 0x50005DDC /end MEASUREMENT
/begin MEASUREMENT stEepOrd_RstrtIntlSho "EEP Order status for the counter resetting when the Tester function is called" UBYTE OneToOne 1 100 0.00 255.0 FORMAT "%5.1" ECU_ADDRESS 0x6000ADB9 /end MEASUREMENT
/begin MEASUREMENT stPsShOffSeq "Power stage shut-off sequence" UBYTE OneToOne 1 100 0.00 255.0 FORMAT "%5.1" ECU_ADDRESS 0x60038910 /end MEASUREMENT
/begin MEASUREMENT StrgECU_ctRngCntEPS1_MP "EPS Ring Counter Measuring Point" UBYTE OneToOne 1 100 0.00 255.0 FORMAT "%5.1" ECU_ADDRESS 0x7000A0D1 /end MEASUREMENT
/begin MEASUREMENT StrtCtl_bPushBtnStrtCmft_MP "Measuring point for Push button start comfort" UBYTE B_TRUE 1 100 0.00 1.00000000000 BIT_MASK 0x1 FORMAT "%13.11" ECU_ADDRESS 0x7000A0D0 /end MEASUREMENT
/begin MEASUREMENT StrtCtl_bStrtActvN "Condition starter-engine rpm" UBYTE B_TRUE 1 100 0.00 1.00000000000 BIT_MASK 0x1 FORMAT "%13.11" ECU_ADDRESS 0x6000ADD5 /end MEASUREMENT
/begin MEASUREMENT StrtCtl_bStrtActv_MP "Condition starter-engine is active" UBYTE B_TRUE 1 100 0.00 1.00000000000 BIT_MASK 0x1 FORMAT "%13.11" ECU_ADDRESS 0x7000A0CF /end MEASUREMENT
/begin MEASUREMENT StrtCtl_bStrtCmftMax_MP "Measuring point for maximum starter operation time for comfort" UBYTE B_TRUE 1 100 0.00 1.00000000000 BIT_MASK 0x1 FORMAT "%13.11" ECU_ADDRESS 0x7000A0CE /end MEASUREMENT
/begin MEASUREMENT StrtCtl_bStrtOrd "Condition order for starter control" UBYTE B_TRUE 1 100 0.00 1.00000000000 BIT_MASK 0x1 FORMAT "%13.11" ECU_ADDRESS 0x6000ADD4 /end MEASUREMENT
/begin MEASUREMENT StrtCtl_bStrtReq "request for starter control" UBYTE B_TRUE 1 100 0.00 1.00000000000 BIT_MASK 0x1 FORMAT "%13.11" ECU_ADDRESS 0x6000ADBF /end MEASUREMENT
/begin MEASUREMENT StrtCtl_bStrtReqIMG "start request validated for IMG" UBYTE B_TRUE 1 100 0.00 1.00000000000 BIT_MASK 0x1 FORMAT "%13.11" ECU_ADDRESS 0x6000ADD3 /end MEASUREMENT
/begin MEASUREMENT StrtCtl_bStrtrOperTiCdn_MP "Measuring point for Checking the Initial start time conditons" UBYTE B_TRUE 1 100 0.00 1.00000000000 BIT_MASK 0x1 FORMAT "%13.11" ECU_ADDRESS 0x7000A0CD /end MEASUREMENT
/begin MEASUREMENT StrtCtl_bStSpStrtOrd "start order from start-stop-coordinator for starter control" UBYTE B_TRUE 1 100 0.00 1.00000000000 BIT_MASK 0x1 FORMAT "%13.11" ECU_ADDRESS 0x6000ADD2 /end MEASUREMENT
/begin MEASUREMENT StrtCtl_bTiLimCmftSel_MP "Measuring point for time limitation for comfort selection" UBYTE B_TRUE 1 100 0.00 1.00000000000 BIT_MASK 0x1 FORMAT "%13.11" ECU_ADDRESS 0x7000A0CC /end MEASUREMENT
/begin MEASUREMENT StrtCtl_bTraBrkStrtCtlLck "Transmission brake start control lock" UBYTE B_TRUE 1 100 0.00 1.00000000000 BIT_MASK 0x1 FORMAT "%13.11" ECU_ADDRESS 0x6000F0A7 /end MEASUREMENT
/begin MEASUREMENT StrtCtl_bTraBrkStrtReqCncl "Cancel start request as clutch brake missing" UBYTE B_TRUE 1 100 0.00 1.00000000000 BIT_MASK 0x1 FORMAT "%13.11" ECU_ADDRESS 0x6000F0A6 /end MEASUREMENT
/begin MEASUREMENT StrtCtl_ctNFaultStrt "Counter fault starts after starter cut off through speed limit" UBYTE OneToOne 1 100 0.00 255.0 FORMAT "%5.1" ECU_ADDRESS 0x600340D3 /end MEASUREMENT
/begin MEASUREMENT StrtCtl_ctStrtReqRst "Counter of requests to continue the start after reset" UBYTE OneToOne 1 100 0.00 255.0 FORMAT "%5.1" ECU_ADDRESS 0x600340D2 /end MEASUREMENT
/begin MEASUREMENT StrtCtl_ctTiFaultStrt "Counter fault starts after starter cut off through time limit" UBYTE OneToOne 1 100 0.00 255.0 FORMAT "%5.1" ECU_ADDRESS 0x600340D4 /end MEASUREMENT
/begin MEASUREMENT StrtCtl_facStrtTiIdlMax_MP "percentage of used starter idle operation time to maximim allowed idle operation time" SWORD Fact 1 100 -4.000000 3.999878 FORMAT "%8.6" ECU_ADDRESS 0x7000A0CA /end MEASUREMENT
/begin MEASUREMENT StrtCtl_facStrtTiMax_MP "percentage of used starter operation time to maximim allowed operation time" SWORD Fact 1 100 -4.000000 3.999878 FORMAT "%8.6" ECU_ADDRESS 0x7000A0C8 /end MEASUREMENT
/begin MEASUREMENT StrtCtl_flgAltvCluStrt "Alternative Clutch start for timer reach" UBYTE B_TRUE 1 100 0.00 1.00000000000 BIT_MASK 0x1 FORMAT "%13.11" ECU_ADDRESS 0x6000ADD1 /end MEASUREMENT
/begin MEASUREMENT StrtCtl_flgAltvCluStrtPtd "alternative clutch start permit" UBYTE B_TRUE 1 100 0.00 1.00000000000 BIT_MASK 0x1 FORMAT "%13.11" ECU_ADDRESS 0x6000ADD0 /end MEASUREMENT
/begin MEASUREMENT StrtCtl_flgBrkDetn "Brake detection flag" UBYTE B_TRUE 1 100 0.00 1.00000000000 BIT_MASK 0x1 FORMAT "%13.11" ECU_ADDRESS 0x6000F0A5 /end MEASUREMENT
/begin MEASUREMENT StrtCtl_flgCluStkEna "Clutch stroke enable flag" UBYTE B_TRUE 1 100 0.00 1.00000000000 BIT_MASK 0x1 FORMAT "%13.11" ECU_ADDRESS 0x6000ADCF /end MEASUREMENT
/begin MEASUREMENT StrtCtl_flgEBBDfct "Defective EBB flag" UBYTE B_TRUE 1 100 0.00 1.00000000000 BIT_MASK 0x1 FORMAT "%13.11" ECU_ADDRESS 0x6000F0A4 /end MEASUREMENT
/begin MEASUREMENT StrtCtl_flgEBBShiftToPReq "Display Shift to P request" UBYTE B_TRUE 1 100 0.00 1.00000000000 BIT_MASK 0x1 FORMAT "%13.11" ECU_ADDRESS 0x6000F0A3 /end MEASUREMENT
/begin MEASUREMENT StrtCtl_flgEngIrrStop "Engine Irregular stop flag" UBYTE B_TRUE 1 100 0.00 1.00000000000 BIT_MASK 0x1 FORMAT "%13.11" ECU_ADDRESS 0x6000ADBE /end MEASUREMENT
/begin MEASUREMENT StrtCtl_flgEngStall "Flag to detect engine stall" UBYTE B_TRUE 1 100 0.00 1.00000000000 BIT_MASK 0x1 FORMAT "%13.11" ECU_ADDRESS 0x6000F0A0 /end MEASUREMENT
/begin MEASUREMENT StrtCtl_flgEngStrtCmpl "Flag to indicate Engine start completion" UBYTE B_TRUE 1 100 0.00 1.00000000000 BIT_MASK 0x1 FORMAT "%13.11" ECU_ADDRESS 0x6000F09F /end MEASUREMENT
/begin MEASUREMENT StrtCtl_flgEngStrtProhb "Engine start inhibit based on Transmission status for MT vehicles" UBYTE B_TRUE 1 100 0.00 1.00000000000 BIT_MASK 0x1 FORMAT "%13.11" ECU_ADDRESS 0x6000F09E /end MEASUREMENT
/begin MEASUREMENT StrtCtl_flgEngStrtSeq "Engine start sequence" UBYTE B_TRUE 1 100 0.00 1.00000000000 BIT_MASK 0x1 FORMAT "%13.11" ECU_ADDRESS 0x6000F09D /end MEASUREMENT
/begin MEASUREMENT StrtCtl_flgEngStrtSeqCmpl "Engine start sequence complete status flag" UBYTE B_TRUE 1 100 0.00 1.00000000000 BIT_MASK 0x1 FORMAT "%13.11" ECU_ADDRESS 0x6000F09C /end MEASUREMENT
/begin MEASUREMENT StrtCtl_flgEPBAppld "EPB applied status information" UBYTE B_TRUE 1 100 0.00 1.00000000000 BIT_MASK 0x1 FORMAT "%13.11" ECU_ADDRESS 0x6000F0A2 /end MEASUREMENT
/begin MEASUREMENT StrtCtl_flgEPBIgnOn "Flag to indicate EPB at the first crank after T15 ON" UBYTE B_TRUE 1 100 0.00 1.00000000000 BIT_MASK 0x1 FORMAT "%13.11" ECU_ADDRESS 0x6000ADCE /end MEASUREMENT
/begin MEASUREMENT StrtCtl_flgEPBOffDetn "Flag to indicate EPB off detection" UBYTE B_TRUE 1 100 0.00 1.00000000000 BIT_MASK 0x1 FORMAT "%13.11" ECU_ADDRESS 0x6000ADCD /end MEASUREMENT
/begin MEASUREMENT StrtCtl_flgEPBReq "EPB actuation request flag" UBYTE B_TRUE 1 100 0.00 1.00000000000 BIT_MASK 0x1 FORMAT "%13.11" ECU_ADDRESS 0x6000F0A1 /end MEASUREMENT
/begin MEASUREMENT StrtCtl_flgFirstEngStrt "Flag to indicate first engine start" UBYTE B_TRUE 1 100 0.00 1.00000000000 BIT_MASK 0x1 FORMAT "%13.11" ECU_ADDRESS 0x6000F09B /end MEASUREMENT
/begin MEASUREMENT StrtCtl_flgIgnOnCANDeb "Delay time after T15 ON for receiving all the CAN frames" UBYTE B_TRUE 1 100 0.00 1.00000000000 BIT_MASK 0x1 FORMAT "%13.11" ECU_ADDRESS 0x6000ADCC /end MEASUREMENT
/begin MEASUREMENT StrtCtl_flgManCrkDly "Start for manual cranking flag with delay time" UBYTE B_TRUE 1 100 0.00 1.00000000000 BIT_MASK 0x1 FORMAT "%13.11" ECU_ADDRESS 0x6000ADCB /end MEASUREMENT
/begin MEASUREMENT StrtCtl_flgNeutNoPrms_MP "Starter control disable incase of Gear in N + EPB OFF" UBYTE B_TRUE 1 100 0.00 1.00000000000 BIT_MASK 0x1 FORMAT "%13.11" ECU_ADDRESS 0x7000A0C6 /end MEASUREMENT
/begin MEASUREMENT StrtCtl_flgPShiftLockReq "Flag for Parking shift lock request" UBYTE B_TRUE 1 100 0.00 1.00000000000 BIT_MASK 0x1 FORMAT "%13.11" ECU_ADDRESS 0x6000F09A /end MEASUREMENT
/begin MEASUREMENT StrtCtl_flgRxCrkATDeb_MP "CAN frames reception status after undervoltage reset" UBYTE B_TRUE 1 100 0.00 1.00000000000 BIT_MASK 0x1 FORMAT "%13.11" ECU_ADDRESS 0x7000A0C5 /end MEASUREMENT
/begin MEASUREMENT StrtCtl_flgSafeEngStrtCdn1 "Conditions for Auto cranking mode 1" UBYTE B_TRUE 1 100 0.00 1.00000000000 BIT_MASK 0x1 FORMAT "%13.11" ECU_ADDRESS 0x6000ADCA /end MEASUREMENT
/begin MEASUREMENT StrtCtl_flgSafeEngStrtCdn2 "General conditions for cranking mode 2" UBYTE B_TRUE 1 100 0.00 1.00000000000 BIT_MASK 0x1 FORMAT "%13.11" ECU_ADDRESS 0x6000ADC9 /end MEASUREMENT
/begin MEASUREMENT StrtCtl_flgStrtAutCrk "Auto Cranking mode cut condition" UBYTE B_TRUE 1 100 0.00 1.00000000000 BIT_MASK 0x1 FORMAT "%13.11" ECU_ADDRESS 0x6000ADC8 /end MEASUREMENT
/begin MEASUREMENT StrtCtl_flgStrtManCrk "Manual Cranking mode cut condition" UBYTE B_TRUE 1 100 0.00 1.00000000000 BIT_MASK 0x1 FORMAT "%13.11" ECU_ADDRESS 0x6000ADC7 /end MEASUREMENT
/begin MEASUREMENT StrtCtl_flgStrtReqERTOffDly "Flag to indicate the delayed trigger of start request" UBYTE B_TRUE 1 100 0.00 1.00000000000 BIT_MASK 0x1 FORMAT "%13.11" ECU_ADDRESS 0x6000ADC6 /end MEASUREMENT
/begin MEASUREMENT StrtCtl_flgSysStrtReq_MP "System start request" UBYTE B_TRUE 1 100 0.00 1.00000000000 BIT_MASK 0x1 FORMAT "%13.11" ECU_ADDRESS 0x7000A0C4 /end MEASUREMENT
/begin MEASUREMENT StrtCtl_flgT50RstReqTOffD_MP "Delay time to enable continue cranking incase of undervoltage reset" UBYTE B_TRUE 1 100 0.00 1.00000000000 BIT_MASK 0x1 FORMAT "%13.11" ECU_ADDRESS 0x7000A0C3 /end MEASUREMENT
/begin MEASUREMENT StrtCtl_flgTrsmCdnAT_MP "Engine start inhibit based on Transmission status for non-MT vehicles" UBYTE B_TRUE 1 100 0.00 1.00000000000 BIT_MASK 0x1 FORMAT "%13.11" ECU_ADDRESS 0x7000A0C2 /end MEASUREMENT
/begin MEASUREMENT StrtCtl_flgVehDrvInhb "Flag for indicating vehicle drive inhibit" UBYTE B_TRUE 1 100 0.00 1.00000000000 BIT_MASK 0x1 FORMAT "%13.11" ECU_ADDRESS 0x6000F099 /end MEASUREMENT
/begin MEASUREMENT StrtCtl_flgVehDrvRdy "Flag for indicating vehicle drive ready" UBYTE B_TRUE 1 100 0.00 1.00000000000 BIT_MASK 0x1 FORMAT "%13.11" ECU_ADDRESS 0x6000F098 /end MEASUREMENT
/begin MEASUREMENT StrtCtl_flgVehRunng "Vehicle running status" UBYTE B_TRUE 1 100 0.00 1.00000000000 BIT_MASK 0x1 FORMAT "%13.11" ECU_ADDRESS 0x6000F097 /end MEASUREMENT
/begin MEASUREMENT StrtCtl_flgVehStPtd "flag to indicate vehicle state judgement" UBYTE B_TRUE 1 100 0.00 1.00000000000 BIT_MASK 0x1 FORMAT "%13.11" ECU_ADDRESS 0x6000F096 /end MEASUREMENT
/begin MEASUREMENT StrtCtl_stAutManCrkCdn "Condition for cranking start: Auto or Manual mode" UBYTE OneToOne 1 100 0.00 255.0 FORMAT "%5.1" ECU_ADDRESS 0x6000ADC5 /end MEASUREMENT
/begin MEASUREMENT StrtCtl_stCrkEnaAT "Cranking enable for AT" UBYTE B_TRUE 1 100 0.00 1.00000000000 BIT_MASK 0x1 FORMAT "%13.11" ECU_ADDRESS 0x6000ADC4 /end MEASUREMENT
/begin MEASUREMENT StrtCtl_stCrkEnaIMG "Cranking enable stastus for IMG during Under-voltage reset" UBYTE B_TRUE 1 100 0.00 1.00000000000 BIT_MASK 0x1 FORMAT "%13.11" ECU_ADDRESS 0x6000ADC3 /end MEASUREMENT
/begin MEASUREMENT StrtCtl_stEngStrtCmplCntr "counter for Engine start complete" ULONG OneToOne 1 100 0.00 4294967295.00 FORMAT "%13.2" ECU_ADDRESS 0x6000267C /end MEASUREMENT
/begin MEASUREMENT StrtCtl_stIdleSpStTiLimHist "Long cranking Detected from starter" UBYTE B_TRUE 1 100 0.00 1.00000000000 BIT_MASK 0x1 FORMAT "%13.11" ECU_ADDRESS 0x6000F094 /end MEASUREMENT
/begin MEASUREMENT StrtCtl_stRstCrkEnaAT_MP "Cranking enable for AT" UBYTE B_TRUE 1 100 0.00 1.00000000000 BIT_MASK 0x1 FORMAT "%13.11" ECU_ADDRESS 0x7000A0C1 /end MEASUREMENT
/begin MEASUREMENT StrtCtl_stSafeEngStrt "Safe Engine start status" UBYTE B_TRUE 1 100 0.00 1.00000000000 BIT_MASK 0x1 FORMAT "%13.11" ECU_ADDRESS 0x6000F093 /end MEASUREMENT
/begin MEASUREMENT StrtCtl_stShiftN "Actual transmission position for N-range" UBYTE B_TRUE 1 100 0.00 1.00000000000 BIT_MASK 0x1 FORMAT "%13.11" ECU_ADDRESS 0x6000ADC2 /end MEASUREMENT
/begin MEASUREMENT StrtCtl_stShiftNP "Engine start inhibit based on gear status" UBYTE B_TRUE 1 100 0.00 1.00000000000 BIT_MASK 0x1 FORMAT "%13.11" ECU_ADDRESS 0x6000ADC1 /end MEASUREMENT
/begin MEASUREMENT StrtCtl_stShiftP "Actual transmission position for P-range" UBYTE B_TRUE 1 100 0.00 1.00000000000 BIT_MASK 0x1 FORMAT "%13.11" ECU_ADDRESS 0x6000ADC0 /end MEASUREMENT
/begin MEASUREMENT StrtCtl_stStrtCtOff "status of starter cut off conditions" UWORD OneToOne 1 100 0.00 65535.00 FORMAT "%8.2" ECU_ADDRESS 0x60008B90 /end MEASUREMENT
/begin MEASUREMENT StrtCtl_stStrtCtOffMem "Statusbyte for memorized starter cut off condition" UWORD OneToOne 1 100 0.00 65535.00 FORMAT "%8.2" ECU_ADDRESS 0x600068E4 /end MEASUREMENT
/begin MEASUREMENT StrtCtl_stStrtRls "status of release conditions for starter control" UWORD OneToOne 1 100 0.00 65535.00 FORMAT "%8.2" ECU_ADDRESS 0x60008B8E /end MEASUREMENT
/begin MEASUREMENT StrtCtl_stStSpStrtOrdCdn_MP "Condition of engine start order" UBYTE B_TRUE 1 100 0.00 1.00000000000 BIT_MASK 0x1 FORMAT "%13.11" ECU_ADDRESS 0x7000A0C0 /end MEASUREMENT
/begin MEASUREMENT StrtCtl_tiFuPWait "Fuel pressure waiting time" UWORD t_q0p01 1 100 0.00 655.3500 FORMAT "%8.4" ECU_ADDRESS 0x600068E2 /end MEASUREMENT
/begin MEASUREMENT StrtCtl_tiStrtOff "Time since starter cut off" SWORD Time_s 1 100 -327.6800 327.6700 FORMAT "%8.4" ECU_ADDRESS 0x60038912 /end MEASUREMENT
/begin MEASUREMENT StrtCtl_tiStrtOn "Time since starter switch on" SWORD Time_s 1 100 -327.6800 327.6700 FORMAT "%8.4" ECU_ADDRESS 0x600340D6 /end MEASUREMENT
/begin MEASUREMENT StrtCtl_tiStrtOnIdl "Time of starter operation in idle" SWORD Time_s 1 100 -327.6800 327.6700 FORMAT "%8.4" ECU_ADDRESS 0x600068E0 /end MEASUREMENT
/begin MEASUREMENT StrtCtl_vEBBVehSpd "Vehicle speed for judgement of EBB" SWORD Vel 1 100 -327.6800 327.6700 FORMAT "%8.4" ECU_ADDRESS 0x60008F48 /end MEASUREMENT
/begin MEASUREMENT Strt_bImobChk_mp "Measuring point for signal quality check of immobilizer lock status and SCS" UBYTE B_TRUE 1 100 0.00 1.00000000000 BIT_MASK 0x1 FORMAT "%13.11" ECU_ADDRESS 0x7000A0BC /end MEASUREMENT
/begin MEASUREMENT Strt_bLckJudgActv_mp "Activation status of starter lock judgment" UBYTE B_TRUE 1 100 0.00 1.00000000000 BIT_MASK 0x1 FORMAT "%13.11" ECU_ADDRESS 0x7000A0BB /end MEASUREMENT
/begin MEASUREMENT Strt_bLckT1Elpsd_mp "Status indicating that lock judgment timer1 elapsed." UBYTE B_TRUE 1 100 0.00 1.00000000000 BIT_MASK 0x1 FORMAT "%13.11" ECU_ADDRESS 0x7000A0BA /end MEASUREMENT
/begin MEASUREMENT Strt_bLckT2Elpsd_mp "Status indicating that lock judgment timer2 elapsed." UBYTE B_TRUE 1 100 0.00 1.00000000000 BIT_MASK 0x1 FORMAT "%13.11" ECU_ADDRESS 0x7000A0B9 /end MEASUREMENT
/begin MEASUREMENT Strt_bPsShOffSeq_mp "Change order of powerstage cut off" UBYTE B_TRUE 1 100 0.00 1.00000000000 BIT_MASK 0x1 FORMAT "%13.11" ECU_ADDRESS 0x7000A0B8 /end MEASUREMENT
/begin MEASUREMENT Strt_bStmDiaBre_mp "State of the start diagnosis" UBYTE B_TRUE 1 100 0.00 1.00000000000 BIT_MASK 0x1 FORMAT "%13.11" ECU_ADDRESS 0x6000ADBD /end MEASUREMENT
/begin MEASUREMENT Strt_bStrtDia "Requirements for the diagnosis are fulfilled" UBYTE B_TRUE 1 100 0.00 1.00000000000 BIT_MASK 0x1 FORMAT "%13.11" ECU_ADDRESS 0x70000108 /end MEASUREMENT
/begin MEASUREMENT Strt_cntrContnsRstrtIntlSho "Short interval counter for less than 4min for 4th cranking after successive 3 times" UBYTE OneToOne 1 100 0.00 255.0 FORMAT "%5.1" ECU_ADDRESS 0x6000F34B /end MEASUREMENT
/begin MEASUREMENT Strt_cntrContnsStaActv "Successive 3 times counter" UBYTE OneToOne 1 100 0.00 255.0 FORMAT "%5.1" ECU_ADDRESS 0x6000F34A /end MEASUREMENT
/begin MEASUREMENT Strt_cntrRstrtIntlSho "Short interval counter for less than 30sec after clanking 10sec" UBYTE OneToOne 1 100 0.00 255.0 FORMAT "%5.1" ECU_ADDRESS 0x6000F349 /end MEASUREMENT
/begin MEASUREMENT Strt_cntrStaActv "10s continuous cranking counter" UBYTE OneToOne 1 100 0.00 255.0 FORMAT "%5.1" ECU_ADDRESS 0x6000F348 /end MEASUREMENT
/begin MEASUREMENT Strt_cntStaRlyTot "Counter variable for starter relay" ULONG OneToOne 1 100 0.00 4294967295.00 FORMAT "%13.2" ECU_ADDRESS 0x6000265C /end MEASUREMENT
/begin MEASUREMENT Strt_cntTotRlyOper "Counter for starter relay message" ULONG OneToOne 1 100 0.00 4294967295.00 FORMAT "%13.2" ECU_ADDRESS 0x50004FB8 /end MEASUREMENT
/begin MEASUREMENT Strt_cntTotRlyOper1 "First nibble of starter relay counter" UBYTE OneToOne 1 100 0.00 255.0 FORMAT "%5.1" ECU_ADDRESS 0x6000F34F /end MEASUREMENT
/begin MEASUREMENT Strt_cntTotRlyOper2 "second nibble of starter relay counter" UBYTE OneToOne 1 100 0.00 255.0 FORMAT "%5.1" ECU_ADDRESS 0x6000F34E /end MEASUREMENT
/begin MEASUREMENT Strt_cntTotRlyOper3 "Third nibble of starter relay counter" UBYTE OneToOne 1 100 0.00 255.0 FORMAT "%5.1" ECU_ADDRESS 0x6000F34D /end MEASUREMENT
/begin MEASUREMENT Strt_cntTotRlyOper4 "Fourth nibble of starter relay counter" UBYTE OneToOne 1 100 0.00 255.0 FORMAT "%5.1" ECU_ADDRESS 0x6000F34C /end MEASUREMENT
/begin MEASUREMENT Strt_ctCaSEdg_mp "Number of the edges in the camshaft" UWORD OneToOne 1 100 0.00 65535.00 FORMAT "%8.2" ECU_ADDRESS 0x7000A0B6 /end MEASUREMENT
/begin MEASUREMENT Strt_ctStopEngDC "Number changed starter status from OFF to ON in current DC" UWORD OneToOne 1 100 0.00 65535.00 FORMAT "%8.2" ECU_ADDRESS 0x60008B8C /end MEASUREMENT
/begin MEASUREMENT Strt_ctStopEngTot "Total number of changed starter status over DC" ULONG OneToOne 1 100 0.00 4294967295.00 FORMAT "%13.2" ECU_ADDRESS 0x60003898 /end MEASUREMENT
/begin MEASUREMENT Strt_ctStopEngTot1 "Total number of changed starter status over DC" UBYTE OneToOne 1 100 0.00 255.0 FORMAT "%5.1" ECU_ADDRESS 0x6000F347 /end MEASUREMENT
/begin MEASUREMENT Strt_ctStopEngTot2 "Total number of changed starter status over DC" UBYTE OneToOne 1 100 0.00 255.0 FORMAT "%5.1" ECU_ADDRESS 0x6000F346 /end MEASUREMENT
/begin MEASUREMENT Strt_ctStopEngTot3 "Total number of changed starter status over DC" UBYTE OneToOne 1 100 0.00 255.0 FORMAT "%5.1" ECU_ADDRESS 0x6000F345 /end MEASUREMENT
/begin MEASUREMENT Strt_ctStopEngTot4 "Total number of changed starter status over DC" UBYTE OneToOne 1 100 0.00 255.0 FORMAT "%5.1" ECU_ADDRESS 0x6000F344 /end MEASUREMENT
/begin MEASUREMENT Strt_flgRstrtIntl "Flag indicating the occurrence of a 10s continuous cranking and next cranking within a period of threshold value of 30s." UBYTE B_TRUE 1 100 0.00 1.00000000000 BIT_MASK 0x1 FORMAT "%13.11" ECU_ADDRESS 0x70000796 /end MEASUREMENT
/begin MEASUREMENT Strt_flgStop "Flag indicating the non-occurrence of continuous long cranking within a threshold period" UBYTE B_TRUE 1 100 0.00 1.00000000000 BIT_MASK 0x1 FORMAT "%13.11" ECU_ADDRESS 0x70000795 /end MEASUREMENT
/begin MEASUREMENT Strt_st "Status activation starter relay" UBYTE OneToOne 1 100 0.00 255.0 FORMAT "%5.1" ECU_ADDRESS 0x6000F343 /end MEASUREMENT
/begin MEASUREMENT Strt_stLckJudg "Status of lock determination" UBYTE B_TRUE 1 100 0.00 1.00000000000 BIT_MASK 0x1 FORMAT "%13.11" ECU_ADDRESS 0x6000F090 /end MEASUREMENT
/begin MEASUREMENT Strt_stLckJudg1 "Status of lock1 determination" UBYTE B_TRUE 1 100 0.00 1.00000000000 BIT_MASK 0x1 FORMAT "%13.11" ECU_ADDRESS 0x6000F092 /end MEASUREMENT
/begin MEASUREMENT Strt_stLckJudg2 "Status of lock2 determination" UBYTE B_TRUE 1 100 0.00 1.00000000000 BIT_MASK 0x1 FORMAT "%13.11" ECU_ADDRESS 0x6000F091 /end MEASUREMENT
/begin MEASUREMENT Strt_stOL "Error status: open load" ULONG OneToOne 1 100 0.00 4294967295.00 FORMAT "%13.2" ECU_ADDRESS 0x60002678 /end MEASUREMENT
/begin MEASUREMENT Strt_stOL2 "Error status: open load 2" ULONG OneToOne 1 100 0.00 4294967295.00 FORMAT "%13.2" ECU_ADDRESS 0x60002674 /end MEASUREMENT
/begin MEASUREMENT Strt_stPs "The output of the starter to the powerstage" UBYTE OneToOne 1 100 0.00 255.0 FORMAT "%5.1" ECU_ADDRESS 0x60014149 /end MEASUREMENT
/begin MEASUREMENT Strt_stPsRet "Start output stage active" UBYTE OneToOne 1 100 0.00 255.0 FORMAT "%5.1" ECU_ADDRESS 0x6000F342 /end MEASUREMENT
/begin MEASUREMENT Strt_stSCB "Error Status: short to battery" ULONG OneToOne 1 100 0.00 4294967295.00 FORMAT "%13.2" ECU_ADDRESS 0x60002670 /end MEASUREMENT
/begin MEASUREMENT Strt_stSCB2 "Error status: short to battery 2" ULONG OneToOne 1 100 0.00 4294967295.00 FORMAT "%13.2" ECU_ADDRESS 0x6000266C /end MEASUREMENT
/begin MEASUREMENT Strt_stSCG "Error status: short to ground" ULONG OneToOne 1 100 0.00 4294967295.00 FORMAT "%13.2" ECU_ADDRESS 0x60002668 /end MEASUREMENT
/begin MEASUREMENT Strt_stSCG2 "Error status: short to ground 2" ULONG OneToOne 1 100 0.00 4294967295.00 FORMAT "%13.2" ECU_ADDRESS 0x60002664 /end MEASUREMENT
/begin MEASUREMENT Strt_stStaActv "State pinion starter active" UBYTE OneToOne 1 100 0.00 255.0 FORMAT "%5.1" ECU_ADDRESS 0x700054A1 /end MEASUREMENT
/begin MEASUREMENT Strt_stStaActvDly "Status indicating the occurrence of continuous long cranking" UBYTE B_TRUE 1 100 0.00 1.00000000000 BIT_MASK 0x1 FORMAT "%13.11" ECU_ADDRESS 0x6000ADBA /end MEASUREMENT
/begin MEASUREMENT Strt_stStmErrInfo_mp "Error status starter module" UWORD OneToOne 1 100 0.00 65535.00 FORMAT "%8.2" ECU_ADDRESS 0x7000A0BE /end MEASUREMENT
/begin MEASUREMENT Strt_stStmFault "Error status hardware or communication" ULONG OneToOne 1 100 0.00 4294967295.00 FORMAT "%13.2" ECU_ADDRESS 0x60002660 /end MEASUREMENT
/begin MEASUREMENT Strt_stTstrActv "The status of tester demand for updating the starter related EEPROM data" UBYTE OneToOne 1 100 0.00 255.0 FORMAT "%5.1" ECU_ADDRESS 0x6000F341 /end MEASUREMENT
/begin MEASUREMENT Strt_tiStaActv_MP "Measuring point to indicate the output of the 10s cranking timer" SWORD Time_s 1 100 -327.6800 327.6700 FORMAT "%8.4" ECU_ADDRESS 0x7000A0B4 /end MEASUREMENT
/begin MEASUREMENT Strt_tiStopIntl_MP "Measuring point to indicate the starter OFF time" SWORD Time_s 1 100 -327.6800 327.6700 FORMAT "%8.4" ECU_ADDRESS 0x7000A0B2 /end MEASUREMENT
/begin MEASUREMENT Strt_uStrtMonDia "Starter voltage" UWORD Volt 1 100 0.00 13107.00 FORMAT "%8.2" ECU_ADDRESS 0x60008B8A /end MEASUREMENT
/begin MEASUREMENT StSpSwt_st "Status of Start Stop Switch" UBYTE OneToOne 1 100 0.00 255.0 FORMAT "%5.1" ECU_ADDRESS 0x6000F354 /end MEASUREMENT
/begin MEASUREMENT StSpSwt_stRaw "Status of the Raw digital Start Stop pushswitch." UBYTE OneToOne 1 100 0.00 255.0 FORMAT "%5.1" ECU_ADDRESS 0x6000F353 /end MEASUREMENT
/begin MEASUREMENT StSpSwt_stSelTyp "Staus of StartStop switch status" UBYTE OneToOne 1 100 0.00 255.0 FORMAT "%5.1" ECU_ADDRESS 0x6000F352 /end MEASUREMENT
/begin MEASUREMENT StSpSwt_stStrd "Stored value of Start Stop switch status" UBYTE OneToOne 1 100 0.00 255.0 FORMAT "%5.1" ECU_ADDRESS 0x6000F351 /end MEASUREMENT
/begin MEASUREMENT tqBrkOperAYCGOld "Old value of Driver Input torque" UWORD TrqPerSec 1 100 0.00 65535.00 FORMAT "%8.2" ECU_ADDRESS 0x600068E6 /end MEASUREMENT
/begin FUNCTION Signals_Std "30000.65.0Interface for readout of ECU internal measurement values"
 /begin DEF_CHARACTERISTIC Signals_Mode1Pid_CA Signals_Mode1SigNum_CA Signals_stSrv01SuppPid_CA /end DEF_CHARACTERISTIC
 /begin IN_MEASUREMENT I15031_PID83A I15031_PID9BA I15031_PIDA1A I15031_PIDA7A I15031_PIDA8A /end IN_MEASUREMENT
 FUNCTION_VERSION "30000.65.0" /end FUNCTION
/begin FUNCTION SigQly_GlbDefn "1.1.0     Signal Quality Global Definition" FUNCTION_VERSION "1.1.0" /end FUNCTION
/begin FUNCTION SigQly_Srv "1.2.0     Signal Quality Services" FUNCTION_VERSION "1.2.0" /end FUNCTION
/begin FUNCTION SpdGov2ME "1.12.0    ETS Adapter SpdGov to ME" /begin DEF_CHARACTERISTIC CWSPDGOV TVDK TVLLRPST /end DEF_CHARACTERISTIC
 /begin IN_MEASUREMENT B_ll_msg B_stendll_msg B_stendmd_msg CoEng_flgRelsFco EngStrt_bStrtEnd ftrq2mi_w_msg LIGov_bEnblI LIGov_bFrzI LIGov_bInactv LIGov_bNoGrip LIGov_nDiff LIGov_trqI RngMod_trqComp RngMod_trqInrMinWoCtOff RngMod_trqLosEng /end IN_MEASUREMENT
 /begin OUT_MEASUREMENT B_enllri_msg B_llrein_msg B_llri_msg B_llrst_msg B_llr_msg B_vllr_msg dmllri_w_msg dmllr_w_msg dn_w_msg /end OUT_MEASUREMENT
 FUNCTION_VERSION "1.12.0" /end FUNCTION
/begin FUNCTION SpdGov_NMaxLim "28.2.0    Limitation of engine speed"
 /begin DEF_CHARACTERISTIC DNSOZW KLDNMAXH SpdGov_facCorIniINLim_CUR SpdGov_flgSwtNGrdt_C SpdGov_KiNMaxLimTipp_MAP SpdGov_KiNMaxLim_MAP SpdGov_KpNMaxLimTipp_MAP SpdGov_KpNMaxLim_MAP SpdGov_MaskTstrLimCutOff_C SpdGov_nDeltaFstTrqRed_C SpdGov_nDeltaMinTrq_C SpdGov_nDeltaStopNLim_C SpdGov_nLowrThdIncTqAirPah_C SpdGov_NMaxLim_CW SpdGov_nMax_C SpdGov_nSetPHi_DST SpdGov_numGear_DST SpdGov_nUpprThdIncTqAirPah_C SpdGov_rAppThdTqAirPah_C SpdGov_tiDlyNeutGear_C SpdGov_tiHldIncTqAirPah_C SpdGov_tiNMaxPrdcTipp_CUR SpdGov_tiNMaxPrdc_CUR SpdGov_trqIniINMaxLimTipp_MAP SpdGov_trqIniINMaxLim_MAP SpdGov_trqMaxLimInteg_C SpdGov_trqMinLimInteg_C SpdGov_vThdTqAirPah_C TVDNOZW /end DEF_CHARACTERISTIC
 /begin REF_CHARACTERISTIC DNMAXH /end REF_CHARACTERISTIC
 /begin IN_MEASUREMENT ActMod_trqCrSWoDstC APP_r CoVeh_trqAcs ECT_bFCOEnaCmpnPrt ElM_tqActWoAcsyCmp EngPrt_bNLimRed Epm_dnEngAvgFlt Epm_dnEngFlt Gbx_stGearLvr Gbx_stNPos Gbx_stRvsPos HLSDem_bNMaxRed HLSDem_nSetPHi HLSDem_nSetPLo I14229_stABSFailCnclActv LLRNSNF_nOffsSpLoTrckEna PT_bGrip PT_nClth PT_stTraType StatyCoorn_tqCluDesLimd SyC_ctDrvEnter Tra_nMax Tra_nReqEngFco Tra_numGear VehV_v /end IN_MEASUREMENT
 /begin OUT_MEASUREMENT B_nmax_msg SpdGov_bEngPrtLimOvrSpd SpdGov_bNLimActv SpdGov_bNMaxTqLim SpdGov_flgTstrLimCutOff SpdGov_nMaxPrdc SpdGov_stTstrLimCutOff SpdGov_tqCluLimnMeclFco SpdGov_trqClthLimMechDes SpdGov_trqClthLimMechLead /end OUT_MEASUREMENT
 /begin LOC_MEASUREMENT SpdGov_dnFlt SpdGov_fakLimMech SpdGov_flgEnaCondIncTqAirPah SpdGov_flgFflpAirPah SpdGov_flgIncTqAirPah SpdGov_flgNHysIncTqAirPah SpdGov_flgnoIAi SpdGov_KiNMaxLim SpdGov_KpNMaxLim SpdGov_nDiffNMax SpdGov_NMaxLim_ctReIni SpdGov_tqCluLimnMeclDesTemp SpdGov_trqINMaxLim SpdGov_trqPNMaxLim /end LOC_MEASUREMENT
 FUNCTION_VERSION "28.2.0" /end FUNCTION
/begin FUNCTION SpdGov_TrqCalc "32.3.0    Distribution of low-idle governor torque demand on lead and set path."
 /begin DEF_CHARACTERISTIC SpdGov_facCompRmpDwn_C SpdGov_facCompRmpGrip_C SpdGov_facCompRmpNoGrip_C SpdGov_facComp_CUR SpdGov_tiStrtEnd_C SpdGov_tiTrqFlt_C /end DEF_CHARACTERISTIC
 /begin IN_MEASUREMENT CoEng_tiNormalRed DOGov_trqLead DOGov_trqSet HLSDem_nSetPLo HLSDem_nSetPTrck LIGov_bExtTrqDem LIGov_bInactv LIGov_bNoGrip LIGov_bRmpDwn LIGov_facPreCtlRmpMax LIGov_facThrStabAc LIGov_stOvrRun LIGov_tiSync LIGov_trq LIGov_trqI LIGov_trqLead LIGov_trqMax LIGov_trqMin LIGov_trqPreCtl SpdGov_bNLimActv SyC_stSub /end IN_MEASUREMENT
 /begin OUT_MEASUREMENT SpdGov_facComp SpdGov_facCompRmp SpdGov_nSetPLo SpdGov_st SpdGov_trqFlt SpdGov_trqFltDiag SpdGov_trqLead SpdGov_trqMax SpdGov_trqSet /end OUT_MEASUREMENT
 /begin LOC_MEASUREMENT SpdGov_facThrStabComp /end LOC_MEASUREMENT
 FUNCTION_VERSION "32.3.0" /end FUNCTION
/begin FUNCTION SpdGov_TrqDist "200.1.0   Torque Distribution f. Speed Governor (stat.-dynamic, combustion-electric motor)"
 /begin DEF_CHARACTERISTIC SpdGov_dfacDistCtOff_C SpdGov_dtrqMax_C SpdGov_facTrqDynDist_C SpdGov_nDiffASDPrioStal_C SpdGov_nDiffASDPrio_C SpdGov_nMinASDPrio_C SpdGov_rASDPrio_C SpdGov_swtASDPrio_CW SpdGov_tiFltASDPrio_C SpdGov_tiFlt_C SpdGov_trqASDPrio_C SpdGov_TrqDist_CW SpdGov_trqOfsMin_C /end DEF_CHARACTERISTIC
 /begin IN_MEASUREMENT APP_r CoEng_stMai CoPOM_bCtOffDem CoPOM_facTrqDynDist CoPOM_stM CoPOM_stMnSt Epm_nEng HLSDem_nSetPLo PthSet_stOvrRun PT_nClth SpdGov_trqLead SpdGov_trqSet StatyCoorn_tqCluDesLimd /end IN_MEASUREMENT
 /begin OUT_MEASUREMENT SpdGov_trqClth SpdGov_trqClthCurr SpdGov_trqClthLead SpdGov_trqDyn SpdGov_trqDynElM SpdGov_trqDynEng SpdGov_trqDynEngLtd SpdGov_trqDynLead SpdGov_trqSty /end OUT_MEASUREMENT
 /begin LOC_MEASUREMENT SpdGov_bASDPrio_mp SpdGov_facTrqDynDist SpdGov_flgIniCond /end LOC_MEASUREMENT
 FUNCTION_VERSION "200.1.0" /end FUNCTION
/begin FUNCTION SrvB "220.13.0  Basic Services" FUNCTION_VERSION "220.13.0" /end FUNCTION
/begin FUNCTION SrvCSwt_DD "2.0.0     Service check switch input" /begin DEF_CHARACTERISTIC SrvCSwt_tiSwtDebHiLo_C SrvCSwt_tiSwtDebLoHi_C /end DEF_CHARACTERISTIC /begin IN_MEASUREMENT T15_st /end IN_MEASUREMENT /begin OUT_MEASUREMENT SrvCSwt_st /end OUT_MEASUREMENT /begin LOC_MEASUREMENT SrvCSwt_stRaw /end LOC_MEASUREMENT FUNCTION_VERSION "2.0.0" /end FUNCTION
/begin FUNCTION SrvF "220.8.0   Float Services" FUNCTION_VERSION "220.8.0" /end FUNCTION
/begin FUNCTION SrvX "220.11.0  Extended Services" FUNCTION_VERSION "220.11.0" /end FUNCTION
/begin FUNCTION SSEUI_SetData "35.3.0    Stop Start Engine User Interface"
 /begin DEF_CHARACTERISTIC SSEUI_stFirstEngStrtSeln_C SSEUI_stMktSelnSwt_C SSEUI_stMode05FlgRstMsk_C SSEUI_stMsk1_C SSEUI_stSwtACCdnByp_C SSEUI_stSwtMIDDsbl_C SSEUI_swtSTSReq_C SSEUI_tiACDly120s_C SSEUI_tiACDly6s_C SSEUI_tiBrkPedStrtReqDly_C SSEUI_tiCANErrMask_C SSEUI_tiCluChkDly_C SSEUI_tiDispEndDly_C SSEUI_tiDispTime_C SSEUI_tiDlySeatBlt_C SSEUI_tiInGearDly_C SSEUI_tiInitChkDly_C SSEUI_tiISGoJudDly_C SSEUI_tiRstrtReqVehCdnDly_C SSEUI_tiVehCdnStopTrigDly_C /end DEF_CHARACTERISTIC
 /begin REF_CHARACTERISTIC CoVOM_stDrvMod1_C CoVOM_stDrvMod2_C CoVOM_stDrvMod3_C CoVOM_stStopRelsMask_C CoVOM_stStrtReqMask_C CoVOM_swtDrvModSeln_C /end REF_CHARACTERISTIC
 /begin IN_MEASUREMENT ACC_bBrkReq Batt_stEngStopInhbn BrkPed_bEngStrtReq BrkPed_flgISABBrkPSuffVehStill BrkPed_flgVehStandStill Brk_st CoEng_st CoEng_stMai Com_stATISS Com_stATPrkgProc Com_stBCANInfo Com_stDrvModSwt Com_stEAT8Mon Com_stEATBMon Com_stEBB Com_stEngHoodOpn Com_stIdleStrtStopDispFct Com_stIMGISBrkHldActv Com_stPreStop Com_stSeatBltInfo Com_stSptSwtDeb Com_tiISSPrms CoVOM_bACStopReqTimeout CoVOM_bAutoRstrtReq CoVOM_bEngFrstStrtPassed CoVOM_bEngPreStrtOrd CoVOM_bNeutBasdRstrt CoVOM_bRvsHist CoVOM_bSSEEna CoVOM_bSSEEngStopPassed CoVOM_bStopEna CoVOM_bStrtEna CoVOM_bStrtReq CoVOM_bSysOff CoVOM_bVehCdnStopTrig CoVOM_bVXSinceStrtDeb CoVOM_flgEngStallAftDly CoVOM_stISGoJud CoVOM_stISGoStb CoVOM_stMaxNrStrtOperExcdd CoVOM_stRstrtReqByVehCdn CoVOM_stSSE CoVOM_stStopEnaDspl CoVOM_stStrtReqDspl Eep_EnvRamInvld ESS_bEngStopEna ESS_bEngStrtReq Gbx_stGearLvr Gbx_stNPos I14229_stABSFailCnclActv I14229_stIdlStopCdn MoF_stStrtStopEnaMsg PT_bEngStopEna PT_bEngStrtReq PT_stTraType StrtCtl_stStrtRls Strt_st Strt_stPs StSpSwt_st SyC_ctPostDrvLeave SysDiag_flgCModJdg T15_st T50_st TS_bEngStopEna /end IN_MEASUREMENT
 /begin OUT_MEASUREMENT SSEUI_stCANErrMask SSEUI_stDispOffReq SSEUI_stDrvrGuidInhb SSEUI_stIdlStpOk SSEUI_stISDispMode SSEUI_stISSInhbReas SSEUI_stISSLampReq SSEUI_stISSLampReqInfo SSEUI_stISSWarnReq SSEUI_stModeChg SSEUI_stSmrySysFailrFlag SSEUI_stStrtClthReq /end OUT_MEASUREMENT
 /begin LOC_MEASUREMENT SSEUI_bBrkPedlStrtReq SSEUI_cntrReIni SSEUI_flgACForIS SSEUI_flgEngStrtReq SSEUI_flgSysFail SSEUI_flgVehCdnHist SSEUI_st2DCSysFailr SSEUI_st2DCSysFailrOld SSEUI_stActionCVTMode05Old SSEUI_stActionMode5Old SSEUI_stActionOld SSEUI_stActionOldMode40 SSEUI_stActn8Trig SSEUI_stAutEngRstrtIndInitEndCVT SSEUI_stBatt SSEUI_stDispAutEngStrtHist SSEUI_stDispReasAutoRcv SSEUI_stDispReasAutoRstrt SSEUI_stFlgPreIndcnNotOvr SSEUI_stHoodAndBlt SSEUI_stInIdleStop SSEUI_stLampOff SSEUI_stLoBattT SSEUI_stLoEngT SSEUI_stLoSpdCVT SSEUI_stMod01Trig SSEUI_stMod05StChg SSEUI_stMod05Trig SSEUI_stMod5Actn1 SSEUI_stMod5Actn2 SSEUI_stMod5Chg SSEUI_stSpstInhbFct SSEUI_stStrtrOff SSEUI_stStrtrOnBySTSReq SSEUI_stTrigMod00to11 SSEUI_stTrigMod11to00 SSEUI_tiACDlyCVT SSEUI_tiCANErrMask SSEUI_tiDispEndDly SSEUI_tiDlySeatBlt SSEUI_tiInGearDly SSEUI_tiIniChk SSEUI_tiISSDisp /end LOC_MEASUREMENT
 FUNCTION_VERSION "35.3.0" /end FUNCTION
/begin FUNCTION StatyCoorn_TqLimn "233.1.0   Stationary total torque limitation"
 /begin DEF_CHARACTERISTIC StatyCoorn_flgCluMax_C StatyCoorn_flgCluTotLeadMax_C StatyCoorn_flgEnaBypCmpdTq_C /end DEF_CHARACTERISTIC
 /begin IN_MEASUREMENT CoEng_bCtOffConDel CoVeh_trqAcs LsComp_tqSwilLossNotFild PT_tqCluTrsmProtn RngMod_trqCrSMin RngMod_trqCrSMinWoCtOff TMERng_tqCrksftLeadMaxStabCdn VehMot_tqCluDftlProtn VehMot_tqCluGenericLim VMD_tqCluDes /end IN_MEASUREMENT
 /begin OUT_MEASUREMENT StatyCoorn_flgEnaBypCmpdTq StatyCoorn_tqCluDesBefLimn StatyCoorn_tqCluDesLimd StatyCoorn_tqCluDrvDmdDes StatyCoorn_tqCluDrvrDmdGenericLimn StatyCoorn_tqCluLeadLimd StatyCoorn_tqCluMax StatyCoorn_tqCluMin /end OUT_MEASUREMENT
 /begin LOC_MEASUREMENT StatyCoorn_tqCluLeadBefEngLimn StatyCoorn_tqCluLeadEngMax StatyCoorn_tqCluLeadEngMin StatyCoorn_tqCluTotLeadMax StatyCoorn_tqCluTotLeadMin /end LOC_MEASUREMENT
 FUNCTION_VERSION "233.1.0" /end FUNCTION
/begin FUNCTION StbIntvECU_AYCA "11.5.0    Reception process for the CAN frame AYCA"
 /begin DEF_CHARACTERISTIC Com_bAYCCond_C Com_bAYCReWr_C Com_ctAYCMonCond_C Com_ctCRingAYCA_C Com_dAYCA2SigSel_C Com_dAYCAMaxDiff_C Com_dAYCAMaxPer_C Com_dAYCASigSel_C Com_numCsumAYCA_C Com_pMstCyl_C Com_stABSEBDFailr_C Com_stABSWrn_C Com_stActABSEBD_C Com_stActHSA_C Com_stFailMstCylPSnsr_C Com_stInhbMstCylPSnsr_C /end DEF_CHARACTERISTIC
 /begin IN_MEASUREMENT Com_bAYCCond Com_bAYCReWr Com_ctCRingAYCA Com_numCsumAYCA Com_pMstCyl Com_stABSCtrl Com_stABSEBDFailr Com_stABSWrn Com_stACCBrk Com_stActABSEBD Com_stActHSA Com_stBrkHldStby Com_stBrkHldSys Com_stCarAcsSysActv Com_stCarAcsSysPtdOper Com_stEPBInhbBrk Com_stFailMstCylPSnsr Com_stFrmRxEna Com_stInhbMstCylPSnsr Com_stMon Com_stVSACtrl Com_stVSALampOff Com_stVSATCSFailr I14229_stABSFailCnclActv T15_st /end IN_MEASUREMENT
 /begin OUT_MEASUREMENT Com_pBrkP Com_pMstCylBrk Com_pMstCylTstr Com_stAYCMonEna StbIntv_bAYCIntvActv /end OUT_MEASUREMENT
 /begin LOC_MEASUREMENT Com_stAYCMonCond StbIntvECU_ctAYCARngCnt_MP /end LOC_MEASUREMENT
 FUNCTION_VERSION "11.5.0" /end FUNCTION
/begin FUNCTION StbIntvECU_AYCD "8.4.0     CAN messages of the Stability Intevention ECU (AYCD)" /begin DEF_CHARACTERISTIC Com_numCsumAYCD_C Com_vWhlSpd_C /end DEF_CHARACTERISTIC
 /begin IN_MEASUREMENT Com_numCsumAYCD Com_stAYCMonEna Com_stCANANoBusOff Com_stFrmRxEna Com_stMon Com_vFLWhlSpd Com_vFRWhlSpd Com_vRLWhlSpd Com_vRRWhlSpd T15_st /end IN_MEASUREMENT
 /begin OUT_MEASUREMENT Com_flgFLWhlSpdInvld Com_flgFRWhlSpdInvld Com_flgRLWhlSpdInvld Com_flgRRWhlSpdInvld Com_stRxAYCD Com_stRxAYCDChkSumOk Com_stRxAYCDDeb Com_stRxAYCDOk Com_vWhlFrntLe Com_vWhlFrntRi Com_vWhlReLe Com_vWhlReRi Com_vWhlSpd StbIntv_vWhlSpd /end OUT_MEASUREMENT
 FUNCTION_VERSION "8.4.0" /end FUNCTION
/begin FUNCTION StbIntvECU_AYCF "9.4.0     Reception process for the CAN frame AYCF"
 /begin DEF_CHARACTERISTIC Com_ctCRingAYCF_C Com_dAYCFMaxDiff_C Com_dAYCFMaxPer_C Com_dAYCFSigSel_C Com_numCsumAYCF_C Com_stAYCFShiftReq_C Com_stAYCF_C Com_stDCSPlusAYCF_C Com_stFuCtrlReq_C Com_stHydPCtrlOper_C Com_stSwtCrpTqCorrn_C Com_trqAYCFDes_C StbIntv_stAYCFISSInhbReq_C /end DEF_CHARACTERISTIC
 /begin IN_MEASUREMENT Com_ctCRingAYCF Com_numCsumAYCF Com_rTrqCnvBoost Com_stAYCF Com_stAYCFShiftReq Com_stAYCMonEna Com_stDCSPlusAYCF Com_stFrmRxEna Com_stFuCtrlReqRaw Com_stHydPCtrlOper Com_stMon Com_trqAYCFDes Conv_trqOilPmpLoss PT_rTrq PT_trqLos VehMot_rTrqDfftl /end IN_MEASUREMENT
 /begin OUT_MEASUREMENT Com_stAYCFFuCtrlReq Com_stAYCFRaw Com_trqAYCFDesRaw StbIntv_bDCSIntv StbIntv_bDCSNeutr StbIntv_bTCSIntv StbIntv_bTCSNeutr StbIntv_flgDCSPlusTrqReqd StbIntv_trqDCSDes StbIntv_trqTCSDes StbIntv_trqTCSLead /end OUT_MEASUREMENT
 /begin LOC_MEASUREMENT Com_rMulVehMotPT_MP Com_tqCrpTqDif_MP Com_trqAYCCnvBoost_MP Com_trqCrpTqAxleLvl_MP StbIntvECU_ctAYCFRngCnt_MP /end LOC_MEASUREMENT
 FUNCTION_VERSION "9.4.0" /end FUNCTION
/begin FUNCTION StbIntvECU_AYCG "10.3.0    Reception Process for the CAN frame AYCG"
 /begin DEF_CHARACTERISTIC Com_ctCRingAYCG_C Com_dAYCGMaxDiff_C Com_dAYCGMaxPer_C Com_numCsumAYCG_C Com_stFrntLeWhlSpdSnsrErr_C Com_stFrntRiWhlSpdSnsrErr_C Com_stLgtGASensErr_C Com_stLgtGASensInh_C Com_stReLeWhlSpdSnsrErr_C Com_stReRiWhlSpdSnsrErr_C Com_stYawRateSnsrErr_C Com_stYawRateSnsrInhb_C Com_tqBrkOper_C /end DEF_CHARACTERISTIC
 /begin IN_MEASUREMENT Com_ctCRingAYCG Com_numCsumAYCG Com_stAYCMonEna Com_stCANANoBusOff Com_stFrmRxEna Com_stFrntLeWhlSpdSnsrErr Com_stFrntRiWhlSpdSnsrErr Com_stLgtGASensErr Com_stLgtGASensInh Com_stMon Com_stReLeWhlSpdSnsrErr Com_stReRiWhlSpdSnsrErr Com_stYawRateSnsrErr Com_stYawRateSnsrInhb Com_tqBrkOperAYCG /end IN_MEASUREMENT
 /begin OUT_MEASUREMENT Com_stRxAYCG Com_stRxAYCGChkSumOk Com_stRxAYCGDeb Com_stRxAYCGOk Com_stRxAYCGRingCntOk /end OUT_MEASUREMENT
 /begin LOC_MEASUREMENT StbIntvECU_ctAYCGRngCnt_MP tqBrkOperAYCGOld /end LOC_MEASUREMENT
 FUNCTION_VERSION "10.3.0" /end FUNCTION
/begin FUNCTION StbIntvECU_AYCI "2.2.0_6SAAReception process for the CAN frame AYCI" /begin DEF_CHARACTERISTIC Com_dAYCIMaxDiff_C Com_dAYCIMaxPer_C /end DEF_CHARACTERISTIC
 /begin IN_MEASUREMENT Com_ctCRingAYCI Com_numCsumAYCI Com_stFrmRxEna Com_stISABActAYCI Com_stISABEnaAYCI Com_stMon Com_tqBrkOperAYCI /end IN_MEASUREMENT
 /begin LOC_MEASUREMENT StbIntvECU_ctAYCIRngCnt_MP /end LOC_MEASUREMENT
 FUNCTION_VERSION "2.2.0_6SAA" /end FUNCTION
/begin FUNCTION StbIntvECU_EPBB "5.0.0     Receive process for CAN message EPBB" /begin DEF_CHARACTERISTIC Com_ctCRingEPBB_C Com_numCsumEPBB_C /end DEF_CHARACTERISTIC
 /begin IN_MEASUREMENT Com_ctCRingEPBB Com_numCsumEPBB Com_stCANCNoBusOff Com_stEPBAppld_Raw Com_stEPBFailrInfo_Raw Com_stEPBInhbAct_Raw Com_stEPBPlaSftyMod_Raw Com_stEPBStInfo_Raw Com_stFrmRxEna Com_stMon Com_stRxEPBBChkSumOk Com_stRxEPBBRingCntOk /end IN_MEASUREMENT
 /begin OUT_MEASUREMENT Com_stEPBAppld Com_stEPBFailrInfo Com_stEPBInhbAct Com_stEPBPlaSftyMod Com_stEPBStInfo Com_stRxEPBB Com_stRxEPBBDeb Com_stRxEPBBOk /end OUT_MEASUREMENT
 FUNCTION_VERSION "5.0.0" /end FUNCTION
/begin FUNCTION StopCntrWakeup_Conf "147000.0.0_3.0.0Stop Counter Wakeup Mode Handling"
 /begin DEF_CHARACTERISTIC rba_StopCntrWakeup_Debug_C rba_StopCntrWakeup_MaxProlongCntr_C rba_StopCntrWakeup_stActv_C /end DEF_CHARACTERISTIC
 /begin OUT_MEASUREMENT rba_StopCntrWakeup_ProlongCntr rba_StopCntrWakeup_stIsWakeUp_u8 /end OUT_MEASUREMENT
 FUNCTION_VERSION "147000.0.0_3.0.0" /end FUNCTION
/begin FUNCTION StrgECU_EPS1 "5.4.0     Reception process for the CAN frame EPS1" /begin DEF_CHARACTERISTIC Com_dEPS1MaxDiff_C Com_dEPS1MaxPer_C Com_dEPS1SigSel_C /end DEF_CHARACTERISTIC
 /begin IN_MEASUREMENT Com_ctCRingEPS1 Com_iElecLd Com_numCsumEPS1 Com_stEPS1ISSRelsReq Com_stEPSISSInhbReq Com_stEPSMidReq Com_stFrmRxEna Com_stMon /end IN_MEASUREMENT
 /begin OUT_MEASUREMENT Com_stEPSISSRstrtReq /end OUT_MEASUREMENT
 /begin LOC_MEASUREMENT StrgECU_ctRngCntEPS1_MP /end LOC_MEASUREMENT
 FUNCTION_VERSION "5.4.0" /end FUNCTION
/begin FUNCTION StrtCtl_StA "79.3.0    Starter Control for Automatic Start"
 /begin DEF_CHARACTERISTIC StrtCtl_ctFaultStrtLim_C StrtCtl_flgDiEPBCdn_C StrtCtl_nEngSpdThd_C StrtCtl_nEngStallThd_C StrtCtl_nStrtActv_C StrtCtl_nStrtIdl_C StrtCtl_nStrtRlsMax_C StrtCtl_nThresStrtCtOff_MAP StrtCtl_rCluStkHi_C StrtCtl_rCluStkLo_C StrtCtl_stNFaultStrt_Msk StrtCtl_stNPosnEnaForBit13_C StrtCtl_stStA_CW StrtCtl_stStrtRls_Msk StrtCtl_stStSpStrtRls_Msk StrtCtl_stSyncStrtOff_C StrtCtl_stTiFaultStrt_Msk StrtCtl_stTraBrk_CW StrtCtl_tiAltvCluStrt_C StrtCtl_tiAutoStrtRls_C StrtCtl_tiCanFailrDetnDly_C StrtCtl_tiComNPDly_C StrtCtl_tiDlyStrtCtOffV_C StrtCtl_tiEngStallThd_C StrtCtl_tiEPBActtnReqDlyElpd_C StrtCtl_tiFuPWait_C StrtCtl_tiIdleSpStCmftMax_C StrtCtl_tiIgnOnCANDeb_C StrtCtl_tiIgnOnDeb_C StrtCtl_tiManCrkCdn_C StrtCtl_tiNMaxDeb_C StrtCtl_tiNZeroDeb_C StrtCtl_tiPushBtnStrtCmft_T StrtCtl_tiStrtActv_C StrtCtl_tiStrtCmftMax_CUR StrtCtl_tiStrtOffMin_C StrtCtl_tiStrtOnMin_C StrtCtl_tiStrtOpPanicMax_MAP StrtCtl_tiStrtPwrIdlMax_C StrtCtl_tiStrtPwrMax_CUR StrtCtl_tiStrtReqRstDly_C StrtCtl_tiStrtReqTCUDlyIMG_C StrtCtl_tiStrtRlsDly_C StrtCtl_uAutoCrkBatt_C StrtCtl_vThresStrtCtOff_C StrtCtl_vVehRunngThd_C /end DEF_CHARACTERISTIC
 /begin IN_MEASUREMENT BattU_u BrkPed_flgEBBHiSlop Brk_st Brk_stEBBBrkDetn B_urstsprr_msg CEngDsT_t Clth3_st Clth4_st Clth_st CoEng_st CoEng_tiStrtDly Com_bBrkPedON Com_rClthStk Com_stBrkPedON Com_stClthStkFailInfo Com_stEPBAppld Com_stEPBFailrInfo Com_stEPBInhbAct Com_stEPBPlaSftyMod Com_stNeutInfo Com_stNotTxDrvgF Com_stRemEngStrtr Com_stRxAYCDDeb Com_stRxAYCDOk Com_stRxEAT12Deb Com_stRxEAT13Deb Com_stRxEATBDeb Com_stRxEBBADeb Com_stRxEBBAOk Com_stRxEPB Com_stRxEPBBDeb Com_stRxEPBBOk Com_stShftNP Com_vVehSpdCVTCtrl CoVeh_stEngStrtOrd CoVOM_bSSEEngStopPassed CoVOM_bSysOff CoVOM_stSSE EpmRRS_bEngStopAg Epm_nEng Epm_nEng10ms Epm_stSync Gbx_stAnaNPosnWoAlvChk Gbx_stAnNeutPosnFlt Gbx_stNPos Gbx_stPNPosnDeb GlbDa_vX PT_bAutoStrtRls PT_stTraType Sia_stOK SrvCSwt_st StbIntv_vWhlSpd StrtCtl_bFstStrtCtOff Strt_st Strt_stLckJudg SyC_stSub T15_st T50_st VehV_v /end IN_MEASUREMENT
 /begin OUT_MEASUREMENT StrtCtl_bStrtReq StrtCtl_bTraBrkStrtCtlLck StrtCtl_bTraBrkStrtReqCncl StrtCtl_flgBrkDetn StrtCtl_flgEBBDfct StrtCtl_flgEBBShiftToPReq StrtCtl_flgEngIrrStop StrtCtl_flgEngStall StrtCtl_flgEngStrtCmpl StrtCtl_flgEngStrtProhb StrtCtl_flgEngStrtSeq StrtCtl_flgEngStrtSeqCmpl StrtCtl_flgEPBAppld StrtCtl_flgEPBReq StrtCtl_flgFirstEngStrt StrtCtl_flgPShiftLockReq StrtCtl_flgVehDrvInhb StrtCtl_flgVehDrvRdy StrtCtl_flgVehRunng StrtCtl_flgVehStPtd StrtCtl_stIdleSpStTiLimHist StrtCtl_stSafeEngStrt StrtCtl_stStrtCtOff StrtCtl_stStrtRls StrtCtl_vEBBVehSpd /end OUT_MEASUREMENT
 /begin LOC_MEASUREMENT StrtCtl_bPushBtnStrtCmft_MP StrtCtl_bStrtActvN StrtCtl_bStrtActv_MP StrtCtl_bStrtCmftMax_MP StrtCtl_bStrtOrd StrtCtl_bStrtReqIMG StrtCtl_bStrtrOperTiCdn_MP StrtCtl_bStSpStrtOrd StrtCtl_bTiLimCmftSel_MP StrtCtl_ctNFaultStrt StrtCtl_ctStrtReqRst StrtCtl_ctTiFaultStrt StrtCtl_facStrtTiIdlMax_MP StrtCtl_facStrtTiMax_MP StrtCtl_flgAltvCluStrt StrtCtl_flgAltvCluStrtPtd StrtCtl_flgCluStkEna StrtCtl_flgEPBIgnOn StrtCtl_flgEPBOffDetn StrtCtl_flgIgnOnCANDeb StrtCtl_flgManCrkDly StrtCtl_flgNeutNoPrms_MP StrtCtl_flgRxCrkATDeb_MP StrtCtl_flgSafeEngStrtCdn1 StrtCtl_flgSafeEngStrtCdn2 StrtCtl_flgStrtAutCrk StrtCtl_flgStrtManCrk StrtCtl_flgStrtReqERTOffDly StrtCtl_flgSysStrtReq_MP StrtCtl_flgT50RstReqTOffD_MP StrtCtl_flgTrsmCdnAT_MP StrtCtl_stAutManCrkCdn StrtCtl_stCrkEnaAT StrtCtl_stCrkEnaIMG StrtCtl_stEngStrtCmplCntr StrtCtl_stRstCrkEnaAT_MP StrtCtl_stShiftN StrtCtl_stShiftNP StrtCtl_stShiftP StrtCtl_stStrtCtOffMem StrtCtl_stStSpStrtOrdCdn_MP StrtCtl_tiFuPWait StrtCtl_tiStrtOff StrtCtl_tiStrtOn StrtCtl_tiStrtOnIdl /end LOC_MEASUREMENT
 FUNCTION_VERSION "79.3.0" /end FUNCTION
/begin FUNCTION Strt_DD "90.0.0    Starter Relay Device Driver" /begin DEF_CHARACTERISTIC Strt_uStmDiaMin_C /end DEF_CHARACTERISTIC /begin IN_MEASUREMENT BattU_u Strt_stPs SyC_stSub /end IN_MEASUREMENT /begin OUT_MEASUREMENT Strt_stPsRet /end OUT_MEASUREMENT
 /begin LOC_MEASUREMENT Strt_bStmDiaBre_mp Strt_stOL Strt_stOL2 Strt_stSCB Strt_stSCB2 Strt_stSCG Strt_stSCG2 Strt_stStmErrInfo_mp Strt_stStmFault /end LOC_MEASUREMENT
 FUNCTION_VERSION "90.0.0" /end FUNCTION
/begin FUNCTION Strt_VD "70.1.0    Starter Virtual Device"
 /begin DEF_CHARACTERISTIC Strt_cntrContnsRstrtIntlShoRepl_C Strt_cntrRstrtIntlShoRepl_C Strt_ctCaSEdgMin_C Strt_flgStrtRlyCntRst_C Strt_nLckJudg1_C Strt_nLckJudg2_C Strt_swtCntRst_C Strt_swtStaActv_C Strt_tiContnsRstrt_C Strt_tiImobChk_C Strt_tiLckJudg1_C Strt_tiLckJudg2_C Strt_tiRstrtIntl_C Strt_tiStrtActv_C Strt_tiStrtCtOffDiaDur_C Strt_uDiaThresCtOffHi_C Strt_uDiaThresCtOffLo_C Strt_uDiaThresStkHi_C Strt_uDiaThresStkLo_C Strt_uStrtDiaMin_C /end DEF_CHARACTERISTIC
 /begin IN_MEASUREMENT BattU_u Epm_nEng Epm_nEng10ms MoF_stStrtMsg PT_bAutoStrtRls Sia_stIgnLck SrvCSwt_st Strt_stPsRet SyC_stSub T15_st T50_st /end IN_MEASUREMENT
 /begin OUT_MEASUREMENT stEepOrd_RstrtIntlSho Strt_cntrContnsRstrtIntlSho Strt_cntrContnsStaActv Strt_cntrRstrtIntlSho Strt_cntrStaActv Strt_cntTotRlyOper Strt_cntTotRlyOper1 Strt_cntTotRlyOper2 Strt_cntTotRlyOper3 Strt_cntTotRlyOper4 Strt_ctStopEngDC Strt_ctStopEngTot Strt_ctStopEngTot1 Strt_ctStopEngTot2 Strt_ctStopEngTot3 Strt_ctStopEngTot4 Strt_flgRstrtIntl Strt_flgStop Strt_st Strt_stLckJudg Strt_stLckJudg1 Strt_stLckJudg2 Strt_stPs Strt_stStaActv Strt_stTstrActv Strt_uStrtMonDia /end OUT_MEASUREMENT
 /begin LOC_MEASUREMENT EepRdStrt EepRdStrtRly stPsShOffSeq Strt_bImobChk_mp Strt_bLckJudgActv_mp Strt_bLckT1Elpsd_mp Strt_bLckT2Elpsd_mp Strt_bPsShOffSeq_mp Strt_bStrtDia Strt_cntStaRlyTot Strt_ctCaSEdg_mp Strt_stStaActvDly Strt_tiStaActv_MP Strt_tiStopIntl_MP /end LOC_MEASUREMENT
 FUNCTION_VERSION "70.1.0" /end FUNCTION
/begin FUNCTION StSpSwt_DD "70.0.0    Start Stop Enable Switch Device Driver"
 /begin DEF_CHARACTERISTIC StSpSwt_SwtDeb.tiHiLo_C StSpSwt_SwtDeb.tiLoHi_C StSpSwt_swtSelTyp_C /end DEF_CHARACTERISTIC
 /begin IN_MEASUREMENT Com_stISSInhbnSwt T15_st /end IN_MEASUREMENT
 /begin OUT_MEASUREMENT StSpSwt_st StSpSwt_stSelTyp StSpSwt_stStrd /end OUT_MEASUREMENT
 /begin LOC_MEASUREMENT StSpSwt_stRaw /end LOC_MEASUREMENT
 FUNCTION_VERSION "70.0.0" /end FUNCTION
/begin COMPU_METHOD B_TRUE "" TAB_VERB "%6.3" "" COMPU_TAB_REF B_TRUE /end COMPU_METHOD
/begin COMPU_VTAB B_TRUE "" TAB_VERB 2 0 "FALSE" 1 "TRUE" /end COMPU_VTAB
/begin COMPU_METHOD dez "" RAT_FUNC "%6.2" "" COEFFS 0 1 0 0 0 1 /end COMPU_METHOD
/begin COMPU_METHOD EngN "" RAT_FUNC "%6.3" "rpm" COEFFS 0 2 0 0 0 1 /end COMPU_METHOD
/begin COMPU_METHOD EngNGrd "" RAT_FUNC "%6.3" "rpm/s" COEFFS 0 2 0 0 0 1 /end COMPU_METHOD
/begin COMPU_METHOD Fact "" RAT_FUNC "%6.5" "-" COEFFS 0 8192 0 0 0 1 /end COMPU_METHOD
/begin COMPU_METHOD fak_sw_b4 "" RAT_FUNC "%6.5" "-" COEFFS 0 65536 0 0 0 8 /end COMPU_METHOD
/begin COMPU_METHOD fak_ub_b1 "" RAT_FUNC "%6.4" "-" COEFFS 0 256 0 0 0 1 /end COMPU_METHOD
/begin COMPU_METHOD fak_uw_b2 "" RAT_FUNC "%7.6" "-" COEFFS 0 65536 0 0 0 2 /end COMPU_METHOD
/begin COMPU_METHOD md_q0p1 "" RAT_FUNC "%6.3" "Nm" COEFFS 0 10 0 0 0 1 /end COMPU_METHOD
/begin COMPU_METHOD md_sw_q0p1 "" RAT_FUNC "%6.3" "Nm" COEFFS 0 10 0 0 0 1 /end COMPU_METHOD
/begin COMPU_METHOD md_ub_q3p2 "" RAT_FUNC "%6.2" "Nm" COEFFS 0 10 0 0 0 32 /end COMPU_METHOD
/begin COMPU_METHOD nmot_sw_q0p25 "" RAT_FUNC "%6.3" "1/min" COEFFS 0 1 0 0 0 0.25 /end COMPU_METHOD
/begin COMPU_METHOD nmot_sw_q0p5 "" RAT_FUNC "%6.3" "1/min" COEFFS 0 2 0 0 0 1 /end COMPU_METHOD
/begin COMPU_METHOD OneToOne "" RAT_FUNC "%6.2" "-" COEFFS 0 1 0 0 0 1 /end COMPU_METHOD
/begin COMPU_METHOD Prc "" RAT_FUNC "%6.4" "%" COEFFS 0 81.92 0 0 0 1 /end COMPU_METHOD
/begin COMPU_METHOD Prc_EGR "" RAT_FUNC "%6.3" "%" COEFFS 0 2.55 0 0 0 1 /end COMPU_METHOD
/begin COMPU_METHOD PresAC_hPa "" RAT_FUNC "%6.2" "hPa" COEFFS 0 0.5 0 0 0 1 /end COMPU_METHOD
/begin COMPU_METHOD Pres_kPa_VSA "" RAT_FUNC "%6.1" "kPa" COEFFS 0 0.0417362270450751 0 0 0 1 /end COMPU_METHOD
/begin COMPU_METHOD p_q0p5_bar "" RAT_FUNC "%6.3" "bar" COEFFS 0 10 0 0 0 5 /end COMPU_METHOD
/begin COMPU_METHOD q3p05175Em3_min_Nm "" RAT_FUNC "%6.4" "minNm" COEFFS 0 8192 0 0 0 25 /end COMPU_METHOD
/begin COMPU_METHOD q3p052Em4_min_Nm_DIV_s "" RAT_FUNC "%6.5" "minNm/s" COEFFS 0 65536 0 0 0 20 /end COMPU_METHOD
/begin COMPU_METHOD rel_sw_b100 "" RAT_FUNC "%6.4" "%" COEFFS 0 32768 0 0 0 100 /end COMPU_METHOD
/begin COMPU_METHOD RmpTrq "" RAT_FUNC "%6.4" "Nm/s" COEFFS 0 655.36 0 0 0 1 /end COMPU_METHOD
/begin COMPU_METHOD Rmp_Fact "" RAT_FUNC "%8.7" "1/s" COEFFS 0 536870.912 0 0 0 1 /end COMPU_METHOD
/begin COMPU_METHOD Signals_IntSigNumVerb "" TAB_VERB "%6.3" "" COMPU_TAB_REF Signals_IntSigNumVerb /end COMPU_METHOD
/begin COMPU_VTAB Signals_IntSigNumVerb "" TAB_VERB 1169 0 "SIGNALS_Signals_Default" 1 "SIGNALS_APP_rUnFlt" 2 "SIGNALS_APP_r_sig" 3 "SIGNALS_APP_r_signal" 4 "SIGNALS_APP_uRaw1_signal" 5 "SIGNALS_APP_uRaw2_signal" 6 "SIGNALS_AbsLdCom8Bit_PID43h" 7 "SIGNALS_AccPed_tqMapBasd_BENG_signal" 8 "SIGNALS_AccPed_tqMapBasd_TRQB_signal" 9 "SIGNALS_ActMod_trqInr_signal" 10 "SIGNALS_AirC_uAnaRawClnt_signal" 11 "SIGNALS_Alt_iExctLim_signal" 12 "SIGNALS_Alt_rAltExct_signal" 13 "SIGNALS_Alt_uFinalDes_signal" 14 "SIGNALS_BattU_u" 15 "SIGNALS_BattU_uSens1_signal" 16 "SIGNALS_BattU_uSens2_s" 17 "SIGNALS_BattU_uSens_signal" 18 "SIGNALS_Batt_lMaxCnsChk_signal" 19 "SIGNALS_Batt_lMinCnsChk_signal" 20 "SIGNALS_Batt_qCnsChkAH_signal" 21 "SIGNALS_Brk_st" 22 "SIGNALS_Brk_stRed" 23 "SIGNALS_CEngDsT_uRaw_s" 24 "SIGNALS_CEngDsT_uRaw_signal" 25 "SIGNALS_CEngUsT_t_signal" 26 "SIGNALS_CEngUsT_uSnsr_s" 27 "SIGNALS_CoEng_tiCranking_signal" 28 "SIGNALS_CoVeh_trqAcs_s" 29 "SIGNALS_ComEBS_BattID_signal" 30 "SIGNALS_ComEBS_rBattSensCh_signal" 31 "SIGNALS_ComEBS_rBattStrat_signal" 32 "SIGNALS_ComEBS_uBattSens_signal" 33 "SIGNALS_ComEBS_uBattUCO_signal" 34 "SIGNALS_Com_iBattEBS_signal" 35 "SIGNALS_Com_lDst_signal" 36 "SIGNALS_Com_rMeasdBattREbs_signal" 37 "SIGNALS_Com_stI_signal" 38 "SIGNALS_Com_stT_signal" 39 "SIGNALS_Com_stU_signal" 40 "SIGNALS_Com_tBattEBS_signal" 41 "SIGNALS_Com_trqAYCFDes_signal" 42 "SIGNALS_Com_uPeak_signal" 43 "SIGNALS_CrCtl_stShutOffCode0_signal" 44 "SIGNALS_CrCtl_stShutOffCode1_signal" 45 "SIGNALS_CrCtl_stShutOffCode2_signal" 46 "SIGNALS_CrCtl_stShutOffCode3_signal" 47 "SIGNALS_CrCtl_stShutOffCode4_signal" 48 "SIGNALS_CrCtl_stShutOffCode5_signal" 49 "SIGNALS_CrCtl_stShutOffCode6_signal" 50 "SIGNALS_CrCtl_stShutOffCode7_signal" 51 "SIGNALS_CrCtl_stShutOffCode8_signal" 52 "SIGNALS_CrCtl_stShutOffCode9_signal" 53 "SIGNALS_DIUMPR_ctGenDenom_signal" 54 "SIGNALS_DIUMPR_ctIgn_signal" 55 "SIGNALS_DRIVE_numDTCFrz_s" 56 "SIGNALS_DRIVE_stCurTrgMode_signal" 57 "SIGNALS_DRIVE_stHardToStrt_s" 58 "SIGNALS_DSM_tiMICumCont" 59 "SIGNALS_DcmDspUDS_rdbi_2612Byte10_signal" 60 "SIGNALS_DcmDspUDS_rdbi_2612Byte11_signal" 61 "SIGNALS_DcmDspUDS_rdbi_fixed_signal" 62 "SIGNALS_DcmDspUDS_rdbi_reserved0_signal_s" 63 "SIGNALS_DcmDspUDS_rdbi_reserved0_signal_w_s" 64 "SIGNALS_DcmDspUDS_rdbi_reserved1_signal" 65 "SIGNALS_Dspl_stCrsSwtInfo_signal" 66 "SIGNALS_Ebs_qBliChrg_signal" 67 "SIGNALS_Ebs_qBliDchaTotDcyc_0_signal" 68 "SIGNALS_Ebs_qBliDchaTotDcyc_1_signal" 69 "SIGNALS_Ebs_qBliDchaTotDcyc_2_signal" 70 "SIGNALS_Ebs_qBliDchaTotDcyc_3_signal" 71 "SIGNALS_Ebs_qBliDchaTotDcyc_4_signal" 72 "SIGNALS_Ebs_qBliDcha_signal" 73 "SIGNALS_Ebs_stStbIEBSByt0_0_signal" 74 "SIGNALS_Ebs_stStbIEBSByt0_1_signal" 75 "SIGNALS_Ebs_stStbIEBSByt0_2_signal" 76 "SIGNALS_Ebs_stStbIEBSByt0_3_signal" 77 "SIGNALS_Ebs_stStbIEBSByt0_4_signal" 78 "SIGNALS_Ebs_stStbIEBSByt1_0_signal" 79 "SIGNALS_Ebs_stStbIEBSByt1_1_signal" 80 "SIGNALS_Ebs_stStbIEBSByt1_2_signal" 81 "SIGNALS_Ebs_stStbIEBSByt1_3_signal" 82 "SIGNALS_Ebs_stStbIEBSByt1_4_signal" 83 "SIGNALS_Ebs_stStbIEBSByt2_0_signal" 84 "SIGNALS_Ebs_stStbIEBSByt2_1_signal" 85 "SIGNALS_Ebs_stStbIEBSByt2_2_signal" 86 "SIGNALS_Ebs_stStbIEBSByt2_3_signal" 87 "SIGNALS_Ebs_stStbIEBSByt2_4_signal" 88 "SIGNALS_Ebs_stStbIEBSByt3_0_signal" 89 "SIGNALS_Ebs_stStbIEBSByt3_1_signal" 90 "SIGNALS_Ebs_stStbIEBSByt3_2_signal" 91 "SIGNALS_Ebs_stStbIEBSByt3_3_signal" 92 "SIGNALS_Ebs_stStbIEBSByt3_4_signal" 93 "SIGNALS_Ebs_stStbIEBSByt4_0_signal" 94 "SIGNALS_Ebs_stStbIEBSByt4_1_signal" 95 "SIGNALS_Ebs_stStbIEBSByt4_2_signal" 96 "SIGNALS_Ebs_stStbIEBSByt4_3_signal" 97 "SIGNALS_Ebs_stStbIEBSByt4_4_signal" 98 "SIGNALS_EngTrqPtd_trqLead_s" 99 "SIGNALS_EngTrqPtd_trqLead_signal" 100 "SIGNALS_EngTrqPtd_trqSet_s" 101 "SIGNALS_EngTrqPtd_trqSet_signal" 102 "SIGNALS_EpmCaS_ctErrSig_signal" 103 "SIGNALS_EpmCaS_ctNoSig_signal" 104 "SIGNALS_EpmCaS_phiDiffCal2AdapEqAvg_0" 105 "SIGNALS_EpmCaS_phiOfsCorr" 106 "SIGNALS_Epm_nEngAct" 107 "SIGNALS_Epm_nEngRaw_s" 108 "SIGNALS_Epm_nEngRaw_signal" 109 "SIGNALS_Epm_stOpMode" 110 "SIGNALS_Epm_stSync" 111 "SIGNALS_FuPHi_uHiResl_signal" 112 "SIGNALS_GEVlv_ratPhaIntkB1_signal" 113 "SIGNALS_GlbDa_lenTotDstDcycHiResl_signal" 114 "SIGNALS_HEGO_uS2B1Extd_s" 115 "SIGNALS_HEGO_uS2B1HiRes_signal" 116 "SIGNALS_I14229CoEng_tiNormalOBDPrevDcyc_s" 117 "SIGNALS_I14229EpmCaS_ctErrSig1_signal" 118 "SIGNALS_I14229EpmCaS_ctNoSig1_signal" 119 "SIGNALS_I14229GlbDa_lTotDstDCHiReslPrevDcyc_s" 120 "SIGNALS_I14229IntkAirT_tSnsrTstrMax_s" 121 "SIGNALS_I14229IntkAirT_tSnsrTstrMin_s" 122 "SIGNALS_I14229RDBI_nOvrSpd_signal" 123 "SIGNALS_I14229RDBI_tiOvrSpd_signal" 124 "SIGNALS_I14229_AirC_pAnaClnt_signal" 125 "SIGNALS_I14229_ElecLd_iEPSLoadOnly_signal" 126 "SIGNALS_I14229_EpmCaS_ctErrSig2_signal" 127 "SIGNALS_I14229_EpmCaS_ctNoSig2_signal" 128 "SIGNALS_I14229_EpmCrS_ctCaSRev_signal" 129 "SIGNALS_I14229_EpmCrS_ctErrSig_signal" 130 "SIGNALS_I14229_GEVCtl_agMaxAdpdIntk_signal" 131 "SIGNALS_I14229_Gbx_uAna1NPosRaw_signal" 132 "SIGNALS_I14229_Gbx_uAna2NPosRaw_signal" 133 "SIGNALS_I14229_ivzabg_w_signal" 134 "SIGNALS_I14229_lDst_signal" 135 "SIGNALS_I14229_nstat_signal" 136 "SIGNALS_I14229_numDTCFrzFrmHi_signal" 137 "SIGNALS_I14229_numDTCFrzFrmLo_signal" 138 "SIGNALS_I14229_numDTCFrzFrmMid_signal" 139 "SIGNALS_I14229_ps_w_signal" 140 "SIGNALS_I14229_rTrqPT_signal" 141 "SIGNALS_I14229_stTURBODV_signal" 142 "SIGNALS_I14229_tSnsrFild1_signal" 143 "SIGNALS_I14229_tiInj1On_signal" 144 "SIGNALS_I14229_tiOilFlowCompl_signal" 145 "SIGNALS_I14229_tiSia_signal" 146 "SIGNALS_I14229_tkaMax_s" 147 "SIGNALS_I14229_tkaMin_s" 148 "SIGNALS_I14229_tka_signal" 149 "SIGNALS_I14229_tmotMaxCurrDcyc_s" 150 "SIGNALS_I14229_tmotMaxPrevDcyc_s" 151 "SIGNALS_I14229_tmotMinCurrDcyc_s" 152 "SIGNALS_I14229_tmotMinPrevDcyc_s" 153 "SIGNALS_I14229_ubsq_signal" 154 "SIGNALS_I14229_umsrln_w_signal" 155 "SIGNALS_I14229_wdks_w_signal" 156 "SIGNALS_I14229_wped1_signal" 157 "SIGNALS_I14229_wped2_signal" 158 "SIGNALS_I14229_zwist_signal" 159 "SIGNALS_I14229iocpMDA_numABV_signal" 160 "SIGNALS_I14229iocpMDA_numACGC_signal" 161 "SIGNALS_I14229iocpMDA_numAPS_signal" 162 "SIGNALS_I14229iocpMDA_numPSC_signal" 163 "SIGNALS_I14229iocpMDA_numRFAN_signal" 164 "SIGNALS_I14229iocpMDA_numRvsLck_signal" 165 "SIGNALS_I14229iocpMDA_numVTEC_signal" 166 "SIGNALS_I14229iocp_numCtlSt_s" 167 "SIGNALS_I14229iocp_numEXE_signal" 168 "SIGNALS_I14229iocp_numREQ_s" 169 "SIGNALS_I14229iocp_stSFTRJC_s" 170 "SIGNALS_I15031_PID1Dh" 171 "SIGNALS_I15031_PID65Ah" 172 "SIGNALS_I15031_PID66Ah" 173 "SIGNALS_I15031_PID69Ah" 174 "SIGNALS_I15031_PID6AAh" 175 "SIGNALS_I15031_PID6BAh" 176 "SIGNALS_I15031_PID6CAh" 177 "SIGNALS_I15031_PID6DAh" 178 "SIGNALS_I15031_PID6EAh" 179 "SIGNALS_I15031_PID6FAh" 180 "SIGNALS_I15031_PID70Ah" 181 "SIGNALS_I15031_PID71Ah" 182 "SIGNALS_I15031_PID72Ah" 183 "SIGNALS_I15031_PID73Ah" 184 "SIGNALS_I15031_PID74Ah" 185 "SIGNALS_I15031_PID75Ah" 186 "SIGNALS_I15031_PID76Ah" 187 "SIGNALS_I15031_PID77Ah" 188 "SIGNALS_I15031_PID78Ah" 189 "SIGNALS_I15031_PID79Ah" 190 "SIGNALS_I15031_PID7AAh" 191 "SIGNALS_I15031_PID7BAh" 192 "SIGNALS_I15031_PID7CAh" 193 "SIGNALS_I15031_PID7FAh" 194 "SIGNALS_I15031_PID81Ah" 195 "SIGNALS_I15031_PID82Ah" 196 "SIGNALS_I15031_PID85Ah" 197 "SIGNALS_I15031_PID86Ah" 198 "SIGNALS_I15031_PID87Ah" 199 "SIGNALS_I15031_PID89Ah" 200 "SIGNALS_I15031_PID8AAh" 201 "SIGNALS_I15031_PID8FAh" 202 "SIGNALS_I15031_PID92Ah" 203 "SIGNALS_I15031_PID93Ah" 204 "SIGNALS_I15031_PID94Ah" 205 "SIGNALS_I15031_PID98Ah" 206 "SIGNALS_I15031_PID99Ah" 207 "SIGNALS_I15031_PID9CAh" 208 "SIGNALS_I15031_PIDA3Ah" 209 "SIGNALS_I15031_PIDA4Ah" 210 "SIGNALS_I15031_PIDA5Ah" 211 "SIGNALS_I15031_PIDA9Ah" 212 "SIGNALS_I15031_PIDACAh" 213 "SIGNALS_IKCtl_agKnkAvrg_s8_signal" 214 "SIGNALS_InjSys_volFuConsDrvCycCAN_s" 215 "SIGNALS_IntkAirT_tSnsr2_signal" 216 "SIGNALS_IntkAirT_uSnsr1Exprt_signal" 217 "SIGNALS_IntkAirT_uSnsr3CrssSwtLoc_s" 218 "SIGNALS_MoF_rTrqInrAct_s" 219 "SIGNALS_MoF_rTrqPtdFlt_s" 220 "SIGNALS_OBD_ITID_InjSys_volFuConsDrvgCycTstrSrv" 221 "SIGNALS_OilSwmpT_uSnsrRaw_s" 222 "SIGNALS_Oil_pSensPSwmp_signal" 223 "SIGNALS_Oil_uRawPSwmp_signal" 224 "SIGNALS_PID01h" 225 "SIGNALS_PID03h_0" 226 "SIGNALS_PID03h_1" 227 "SIGNALS_PID04h" 228 "SIGNALS_PID05h" 229 "SIGNALS_PID06h_0" 230 "SIGNALS_PID07h_0" 231 "SIGNALS_PID0Ch_Epm_nEng" 232 "SIGNALS_PID0D_VehV_vSens" 233 "SIGNALS_PID0Eh" 234 "SIGNALS_PID0Fh" 235 "SIGNALS_PID0bh_PIntkVUs_pRawObd" 236 "SIGNALS_PID10h" 237 "SIGNALS_PID11h_ThrVlv_ratActSens1AbsltB1_u8" 238 "SIGNALS_PID13h" 239 "SIGNALS_PID15h_0" 240 "SIGNALS_PID15h_1" 241 "SIGNALS_PID1Ch" 242 "SIGNALS_PID1Fh_TiScneEngStrt" 243 "SIGNALS_PID21h" 244 "SIGNALS_PID23h" 245 "SIGNALS_PID2Ch_EGRVlv_rCmdNrm" 246 "SIGNALS_PID2Dh_EGRVlv_rGovDvtNrm" 247 "SIGNALS_PID2Eh" 248 "SIGNALS_PID2Fh" 249 "SIGNALS_PID30h" 250 "SIGNALS_PID31h" 251 "SIGNALS_PID33h_PEnv_pRaw" 252 "SIGNALS_PID34h_0" 253 "SIGNALS_PID34h_1" 254 "SIGNALS_PID3Ch" 255 "SIGNALS_PID41h" 256 "SIGNALS_PID42_BattU_uSens" 257 "SIGNALS_PID43h" 258 "SIGNALS_PID44h" 259 "SIGNALS_PID45h_ThrVlv_ratActSens1RelB1_u8" 260 "SIGNALS_PID46h" 261 "SIGNALS_PID47h_ThrVlv_ratActSens2AbsltB1_u8" 262 "SIGNALS_PID49_APP_uRaw1unLim" 263 "SIGNALS_PID4A_APP_uRaw2unLim" 264 "SIGNALS_PID4Ch_wdks_msg" 265 "SIGNALS_PID4FAh" 266 "SIGNALS_PID4FBh" 267 "SIGNALS_PID4FCh" 268 "SIGNALS_PID4FDh" 269 "SIGNALS_PID50Ah" 270 "SIGNALS_PID50Bh" 271 "SIGNALS_PID50Ch" 272 "SIGNALS_PID50Dh" 273 "SIGNALS_PID51h_PID51_stFuTyp" 274 "SIGNALS_PID52h" 275 "SIGNALS_PID56h_0" 276 "SIGNALS_PID5A_APP_rOBDPID5A" 277 "SIGNALS_PID5Eh_InjSys_volEngFuCnsPerHr" 278 "SIGNALS_PID5Fh" 279 "SIGNALS_PID62h_TME_ratActEngPercTqPrmIdH62" 280 "SIGNALS_IntFloat_PID63h_TqEngRef" 281 "SIGNALS_PID67h_ects2sva_msg" 282 "SIGNALS_PID67h_ects2svb_msg" 283 "SIGNALS_PID67h_ects2svc_msg" 284 "SIGNALS_PID68h_iats2sva" 285 "SIGNALS_PID68h_iats2svb" 286 "SIGNALS_PID68h_iats2svc" 287 "SIGNALS_PID68h_iats2svd" 288 "SIGNALS_PID68h_iats2sve" 289 "SIGNALS_PID68h_iats2svf" 290 "SIGNALS_PID68h_iats2svg" 291 "SIGNALS_PID69h_EGRVlv_rActNrm" 292 "SIGNALS_PID69h_EGRVlv_rCmdNrm" 293 "SIGNALS_PID69h_EGRVlv_rGovDvtNrm" 294 "SIGNALS_PID7Fh_RTId_TotRt" 295 "SIGNALS_PID7Fh_RtId_TotIdleRt" 296 "SIGNALS_PID7Fh_RtId_TotPtoRt" 297 "SIGNALS_PID87h_PIntkVUs_pRawObd" 298 "SIGNALS_PID8BAh" 299 "SIGNALS_PID8CAh" 300 "SIGNALS_PID8Eh_TME_ratEngFricPercTqPrmIdH8E" 301 "SIGNALS_PID93BCh" 302 "SIGNALS_PID9AAh" 303 "SIGNALS_PID9Dh_InjSys_mfEngFuRate" 304 "SIGNALS_PID9Dh_InjSys_mfVehFuRate" 305 "SIGNALS_PID9FAh" 306 "SIGNALS_PIDA6h_lTotDst" 307 "SIGNALS_PID_FILLSIG_1BIT" 308 "SIGNALS_PID_FILLSIG_1BITNZ" 309 "SIGNALS_PID_FILLSIG_1BYTE" 310 "SIGNALS_PID_FILLSIG_1BYTENZ" 311 "SIGNALS_PID_FILLSIG_2BIT" 312 "SIGNALS_PID_FILLSIG_2BITNZ" 313 "SIGNALS_PID_FILLSIG_2BYTE" 314 "SIGNALS_PID_FILLSIG_2BYTENZ" 315 "SIGNALS_PID_FILLSIG_3BIT" 316 "SIGNALS_PID_FILLSIG_3BITNZ" 317 "SIGNALS_PID_FILLSIG_4BIT" 318 "SIGNALS_PID_FILLSIG_4BITNZ" 319 "SIGNALS_PID_FILLSIG_4BYTE" 320 "SIGNALS_PID_FILLSIG_4BYTENZ" 321 "SIGNALS_PID_FILLSIG_5BIT" 322 "SIGNALS_PID_FILLSIG_5BITNZ" 323 "SIGNALS_PID_FILLSIG_6BIT" 324 "SIGNALS_PID_FILLSIG_6BITNZ" 325 "SIGNALS_PID_FILLSIG_7BIT" 326 "SIGNALS_PID_FILLSIG_7BITNZ" 327 "SIGNALS_PIntkVUs_uRawUnFlt_signal" 328 "SIGNALS_PT_rGrip_signal" 329 "SIGNALS_PT_trqLos_signal" 330 "SIGNALS_PThrVlvUs_uRawB1_signal" 331 "SIGNALS_PthLead_trqInrNoMon_s" 332 "SIGNALS_PthLead_trqInrNoMon_signal" 333 "SIGNALS_PthSet_trqInrIABef_s" 334 "SIGNALS_PthSet_trqInrLtd_s" 335 "SIGNALS_RngMod_trqDiffAdap_signal" 336 "SIGNALS_RngMod_trqDiffAdap_signal_s" 337 "SIGNALS_RngMod_trqInrBs_s" 338 "SIGNALS_SIGNAL_GEVlv_agSumSpCsersDeIntkB1" 339 "SIGNALS_Strt_uStrtMonDia_signal" 340 "SIGNALS_TWCD_numMeasB1_s" 341 "SIGNALS_TWCD_rOSCAvrgPriB1_s" 342 "SIGNALS_TWCD_rOSCAvrgPriB1_signal" 343 "SIGNALS_ThrVlv_uRawSens1B1_signal" 344 "SIGNALS_ThrVlv_uRawSens2B1_signal" 345 "SIGNALS_TiEngOff_ti_s" 346 "SIGNALS_VehStc_lDstCityEco_signal" 347 "SIGNALS_VehStc_lDstCity_signal" 348 "SIGNALS_VehStc_lDstHighWayEco_signal" 349 "SIGNALS_VehStc_lDstHighWay_signal" 350 "SIGNALS_VehStc_numFuDiagRecA_0_s" 351 "SIGNALS_VehStc_numFuDiagRecA_10_s" 352 "SIGNALS_VehStc_numFuDiagRecA_11_s" 353 "SIGNALS_VehStc_numFuDiagRecA_12_s" 354 "SIGNALS_VehStc_numFuDiagRecA_13_s" 355 "SIGNALS_VehStc_numFuDiagRecA_14_s" 356 "SIGNALS_VehStc_numFuDiagRecA_15_s" 357 "SIGNALS_VehStc_numFuDiagRecA_16_s" 358 "SIGNALS_VehStc_numFuDiagRecA_17_s" 359 "SIGNALS_VehStc_numFuDiagRecA_18_s" 360 "SIGNALS_VehStc_numFuDiagRecA_19_s" 361 "SIGNALS_VehStc_numFuDiagRecA_1_s" 362 "SIGNALS_VehStc_numFuDiagRecA_20_s" 363 "SIGNALS_VehStc_numFuDiagRecA_2_s" 364 "SIGNALS_VehStc_numFuDiagRecA_3_s" 365 "SIGNALS_VehStc_numFuDiagRecA_4_s" 366 "SIGNALS_VehStc_numFuDiagRecA_5_s" 367 "SIGNALS_VehStc_numFuDiagRecA_6_s" 368 "SIGNALS_VehStc_numFuDiagRecA_7_s" 369 "SIGNALS_VehStc_numFuDiagRecA_8_s" 370 "SIGNALS_VehStc_numFuDiagRecA_9_s" 371 "SIGNALS_VehStc_numMisfDetnHiEctA_0_s" 372 "SIGNALS_VehStc_numMisfDetnHiEctA_10_s" 373 "SIGNALS_VehStc_numMisfDetnHiEctA_11_s" 374 "SIGNALS_VehStc_numMisfDetnHiEctA_12_s" 375 "SIGNALS_VehStc_numMisfDetnHiEctA_13_s" 376 "SIGNALS_VehStc_numMisfDetnHiEctA_14_s" 377 "SIGNALS_VehStc_numMisfDetnHiEctA_15_s" 378 "SIGNALS_VehStc_numMisfDetnHiEctA_16_s" 379 "SIGNALS_VehStc_numMisfDetnHiEctA_17_s" 380 "SIGNALS_VehStc_numMisfDetnHiEctA_18_s" 381 "SIGNALS_VehStc_numMisfDetnHiEctA_19_s" 382 "SIGNALS_VehStc_numMisfDetnHiEctA_1_s" 383 "SIGNALS_VehStc_numMisfDetnHiEctA_20_s" 384 "SIGNALS_VehStc_numMisfDetnHiEctA_2_s" 385 "SIGNALS_VehStc_numMisfDetnHiEctA_3_s" 386 "SIGNALS_VehStc_numMisfDetnHiEctA_4_s" 387 "SIGNALS_VehStc_numMisfDetnHiEctA_5_s" 388 "SIGNALS_VehStc_numMisfDetnHiEctA_6_s" 389 "SIGNALS_VehStc_numMisfDetnHiEctA_7_s" 390 "SIGNALS_VehStc_numMisfDetnHiEctA_8_s" 391 "SIGNALS_VehStc_numMisfDetnHiEctA_9_s" 392 "SIGNALS_VehStc_numMisfDetnLoEctA_0_s" 393 "SIGNALS_VehStc_numMisfDetnLoEctA_10_s" 394 "SIGNALS_VehStc_numMisfDetnLoEctA_11_s" 395 "SIGNALS_VehStc_numMisfDetnLoEctA_12_s" 396 "SIGNALS_VehStc_numMisfDetnLoEctA_13_s" 397 "SIGNALS_VehStc_numMisfDetnLoEctA_14_s" 398 "SIGNALS_VehStc_numMisfDetnLoEctA_15_s" 399 "SIGNALS_VehStc_numMisfDetnLoEctA_16_s" 400 "SIGNALS_VehStc_numMisfDetnLoEctA_17_s" 401 "SIGNALS_VehStc_numMisfDetnLoEctA_18_s" 402 "SIGNALS_VehStc_numMisfDetnLoEctA_19_s" 403 "SIGNALS_VehStc_numMisfDetnLoEctA_1_s" 404 "SIGNALS_VehStc_numMisfDetnLoEctA_20_s" 405 "SIGNALS_VehStc_numMisfDetnLoEctA_2_s" 406 "SIGNALS_VehStc_numMisfDetnLoEctA_3_s" 407 "SIGNALS_VehStc_numMisfDetnLoEctA_4_s" 408 "SIGNALS_VehStc_numMisfDetnLoEctA_5_s" 409 "SIGNALS_VehStc_numMisfDetnLoEctA_6_s" 410 "SIGNALS_VehStc_numMisfDetnLoEctA_7_s" 411 "SIGNALS_VehStc_numMisfDetnLoEctA_8_s" 412 "SIGNALS_VehStc_numMisfDetnLoEctA_9_s" 413 "SIGNALS_VehStc_numMisfDetnNormA_0_s" 414 "SIGNALS_VehStc_numMisfDetnNormA_10_s" 415 "SIGNALS_VehStc_numMisfDetnNormA_11_s" 416 "SIGNALS_VehStc_numMisfDetnNormA_12_s" 417 "SIGNALS_VehStc_numMisfDetnNormA_13_s" 418 "SIGNALS_VehStc_numMisfDetnNormA_14_s" 419 "SIGNALS_VehStc_numMisfDetnNormA_15_s" 420 "SIGNALS_VehStc_numMisfDetnNormA_16_s" 421 "SIGNALS_VehStc_numMisfDetnNormA_17_s" 422 "SIGNALS_VehStc_numMisfDetnNormA_18_s" 423 "SIGNALS_VehStc_numMisfDetnNormA_19_s" 424 "SIGNALS_VehStc_numMisfDetnNormA_1_s" 425 "SIGNALS_VehStc_numMisfDetnNormA_20_s" 426 "SIGNALS_VehStc_numMisfDetnNormA_2_s" 427 "SIGNALS_VehStc_numMisfDetnNormA_3_s" 428 "SIGNALS_VehStc_numMisfDetnNormA_4_s" 429 "SIGNALS_VehStc_numMisfDetnNormA_5_s" 430 "SIGNALS_VehStc_numMisfDetnNormA_6_s" 431 "SIGNALS_VehStc_numMisfDetnNormA_7_s" 432 "SIGNALS_VehStc_numMisfDetnNormA_8_s" 433 "SIGNALS_VehStc_numMisfDetnNormA_9_s" 434 "SIGNALS_VehStc_rDiagRsltB1A_0_s" 435 "SIGNALS_VehStc_rDiagRsltB1A_1_s" 436 "SIGNALS_VehStc_rDiagRsltB1A_2_s" 437 "SIGNALS_VehStc_rDiagRsltB1A_3_s" 438 "SIGNALS_VehStc_rDiagRsltB1A_4_s" 439 "SIGNALS_VehStc_tiRtCityEco_signal" 440 "SIGNALS_VehStc_tiRtCity_signal" 441 "SIGNALS_VehStc_tiRtHighWayEco_signal" 442 "SIGNALS_VehStc_tiRtHighWay_signal" 443 "SIGNALS_VehStc_tiRtStop_signal" 444 "SIGNALS_VehStc_volCnsCityDcyc_signal" 445 "SIGNALS_VehStc_volCnsCityEcoDcyc_signal" 446 "SIGNALS_VehStc_volCnsHighWayDcyc_signal" 447 "SIGNALS_VehStc_volCnsHighWayEcoDcyc_signal" 448 "SIGNALS_VehStc_volCnsStopDcyc_signal" 449 "SIGNALS_VehV_a" 450 "SIGNALS_VehV_v" 451 "SIGNALS_VehV_vSens_signal" 452 "SIGNALS_fra_w_msg_signal" 453 "SIGNALS_fra_w_s" 454 "SIGNALS_ftead_w_msg_s" 455 "SIGNALS_ftead_w_si" 456 "SIGNALS_ftead_w_signal" 457 "SIGNALS_i14229_agIntkB1GEVlv_2Byte_signal" 458 "SIGNALS_i14229_agIntkB1GEVlv_signal" 459 "SIGNALS_i14229_agSpIntkB1GevCtl_2Byte_signal" 460 "SIGNALS_i14229_agSpIntkB1GevCtl_signal" 461 "SIGNALS_lutskzyl_w_0_signal" 462 "SIGNALS_lutskzyl_w_1_signal" 463 "SIGNALS_lutskzyl_w_2_signal" 464 "SIGNALS_lutskzyl_w_3_signal" 465 "SIGNALS_lutskzyl_w_msg_0_signal" 466 "SIGNALS_mshfmst_w_signal" 467 "SIGNALS_ofmsndkh1_w_msg_signal" 468 "SIGNALS_ofmsndkh2_w_msg_signal" 469 "SIGNALS_prsoll_w_msg_s" 470 "SIGNALS_tateout_w_signal" 471 "SIGNALS_tatesoll_w_msg_signal" 472 "SIGNALS_thdev_msg_signal" 473 "SIGNALS_tmst_signal" 474 "SIGNALS_wkratst_signal" 475 "SIGNALS_PID83h_A_BitCombineSignal" 476 "SIGNALS_PID9Bh_A_BitCombineSignal" 477 "SIGNALS_PIDA1h_A_BitCombineSignal" 478 "SIGNALS_PIDA7h_A_BitCombineSignal" 479 "SIGNALS_PIDA8h_A_BitCombineSignal" 480 "SIGNALS_Virtual_DcmDspUDS_2600Byte06_signal" 481 "SIGNALS_Virtual_DcmDspUDS_2610Byte00_signal" 482 "SIGNALS_Virtual_DcmDspUDS_2610Byte01_signal" 483 "SIGNALS_Virtual_DcmDspUDS_2610Byte02_signal" 484 "SIGNALS_Virtual_DcmDspUDS_2610Byte03_signal" 485 "SIGNALS_Virtual_DcmDspUDS_2610Byte04_signal" 486 "SIGNALS_Virtual_DcmDspUDS_2610Byte05_signal" 487 "SIGNALS_Virtual_DcmDspUDS_2610Byte0D_signal" 488 "SIGNALS_Virtual_DcmDspUDS_2610Byte0F_signal" 489 "SIGNALS_Virtual_DcmDspUDS_2610Byte10_signal" 490 "SIGNALS_Virtual_DcmDspUDS_2610Byte1A_signal" 491 "SIGNALS_Virtual_DcmDspUDS_2610Byte1B_signal" 492 "SIGNALS_Virtual_DcmDspUDS_2610Byte1C_signal" 493 "SIGNALS_Virtual_DcmDspUDS_2610Byte1D_signal" 494 "SIGNALS_Virtual_DcmDspUDS_2610Byte1F_signal" 495 "SIGNALS_Virtual_DcmDspUDS_2610Byte20_signal" 496 "SIGNALS_Virtual_DcmDspUDS_2610Byte21_signal" 497 "SIGNALS_Virtual_DcmDspUDS_2610Byte22to23_signal" 498 "SIGNALS_Virtual_DcmDspUDS_2610Byte29_signal" 499 "SIGNALS_Virtual_DcmDspUDS_2610Byte2A_signal" 500 "SIGNALS_Virtual_DcmDspUDS_2611Byte00_signal" 501 "SIGNALS_Virtual_DcmDspUDS_2611Byte01_signal" 502 "SIGNALS_Virtual_DcmDspUDS_2611Byte02_signal" 503 "SIGNALS_Virtual_DcmDspUDS_2611Byte03_signal" 504 "SIGNALS_Virtual_DcmDspUDS_2611Byte04_signal" 505 "SIGNALS_Virtual_DcmDspUDS_2611Byte05_signal" 506 "SIGNALS_Virtual_DcmDspUDS_2611Byte06_07_signal" 507 "SIGNALS_Virtual_DcmDspUDS_2611Byte08to09_signal" 508 "SIGNALS_Virtual_DcmDspUDS_2611Byte0A_signal" 509 "SIGNALS_Virtual_DcmDspUDS_2611Byte0B_signal" 510 "SIGNALS_Virtual_DcmDspUDS_2611Byte0Cto0D_signal" 511 "SIGNALS_Virtual_DcmDspUDS_2611Byte0E_signal" 512 "SIGNALS_Virtual_DcmDspUDS_2611Byte2A_signal" 513 "SIGNALS_Virtual_DcmDspUDS_2611Byte2B_signal" 514 "SIGNALS_Virtual_DcmDspUDS_2611Byte30_signal" 515 "SIGNALS_Virtual_DcmDspUDS_2611Byte31_signal" 516 "SIGNALS_Virtual_DcmDspUDS_2611Byte32_signal" 517 "SIGNALS_Virtual_DcmDspUDS_2611Byte33_signal" 518 "SIGNALS_Virtual_DcmDspUDS_2612Byte00_signal" 519 "SIGNALS_Virtual_DcmDspUDS_2612Byte01_signal" 520 "SIGNALS_Virtual_DcmDspUDS_2612Byte02_signal" 521 "SIGNALS_Virtual_DcmDspUDS_2612Byte03_signal" 522 "SIGNALS_Virtual_DcmDspUDS_2612Byte04_signal" 523 "SIGNALS_Virtual_DcmDspUDS_2612Byte05_signal" 524 "SIGNALS_Virtual_DcmDspUDS_2612Byte0B_0C_signal" 525 "SIGNALS_Virtual_DcmDspUDS_2612Byte14_signal" 526 "SIGNALS_Virtual_DcmDspUDS_2612Byte15_signal" 527 "SIGNALS_Virtual_DcmDspUDS_2612Byte16_signal" 528 "SIGNALS_Virtual_DcmDspUDS_2612Byte17_signal" 529 "SIGNALS_Virtual_DcmDspUDS_2612Byte1F_signal" 530 "SIGNALS_Virtual_DcmDspUDS_2612Byte20_signal" 531 "SIGNALS_Virtual_DcmDspUDS_2612Byte2A_signal" 532 "SIGNALS_Virtual_DcmDspUDS_2612Byte2B_signal" 533 "SIGNALS_Virtual_DcmDspUDS_2613Byte00_signal" 534 "SIGNALS_Virtual_DcmDspUDS_2613Byte01_signal" 535 "SIGNALS_Virtual_DcmDspUDS_2613Byte02_signal" 536 "SIGNALS_Virtual_DcmDspUDS_2613Byte03_signal" 537 "SIGNALS_Virtual_DcmDspUDS_2613Byte04_signal" 538 "SIGNALS_Virtual_DcmDspUDS_2613Byte05_signal" 539 "SIGNALS_Virtual_DcmDspUDS_2613Byte08_signal" 540 "SIGNALS_Virtual_DcmDspUDS_2613Byte09_signal" 541 "SIGNALS_Virtual_DcmDspUDS_2615Byte00_signal" 542 "SIGNALS_Virtual_DcmDspUDS_2615Byte01_signal" 543 "SIGNALS_Virtual_DcmDspUDS_2615Byte02_signal" 544 "SIGNALS_Virtual_DcmDspUDS_2615Byte03_signal" 545 "SIGNALS_Virtual_DcmDspUDS_2615Byte04_signal" 546 "SIGNALS_Virtual_DcmDspUDS_2615Byte05_signal" 547 "SIGNALS_Virtual_DcmDspUDS_2615Byte10_signal" 548 "SIGNALS_Virtual_DcmDspUDS_2615Byte26_signal" 549 "SIGNALS_Virtual_DcmDspUDS_2615Byte27_signal" 550 "SIGNALS_Virtual_DcmDspUDS_2617Byte00_signal" 551 "SIGNALS_Virtual_DcmDspUDS_2617Byte01_signal" 552 "SIGNALS_Virtual_DcmDspUDS_2617Byte02_signal" 553 "SIGNALS_Virtual_DcmDspUDS_2617Byte03_signal" 554 "SIGNALS_Virtual_DcmDspUDS_2617Byte04_signal" 555 "SIGNALS_Virtual_DcmDspUDS_2617Byte05_signal" 556 "SIGNALS_Virtual_DcmDspUDS_261AByte00_signal" 557 "SIGNALS_Virtual_DcmDspUDS_261AByte01_signal" 558 "SIGNALS_Virtual_DcmDspUDS_261AByte02_signal" 559 "SIGNALS_Virtual_DcmDspUDS_261AByte03_signal" 560 "SIGNALS_Virtual_DcmDspUDS_261AByte04_signal" 561 "SIGNALS_Virtual_DcmDspUDS_261AByte05_signal" 562 "SIGNALS_Virtual_DcmDspUDS_261AByte07_signal" 563 "SIGNALS_Virtual_DcmDspUDS_261AByte0A_signal" 564 "SIGNALS_Virtual_DcmDspUDS_261AByte0B_signal" 565 "SIGNALS_Virtual_DcmDspUDS_261AByte0C_signal" 566 "SIGNALS_Virtual_DcmDspUDS_261AByte0D_signal" 567 "SIGNALS_Virtual_DcmDspUDS_261AByte0E_signal" 568 "SIGNALS_Virtual_DcmDspUDS_2620Byte00_signal" 569 "SIGNALS_Virtual_DcmDspUDS_2620Byte01_signal" 570 "SIGNALS_Virtual_DcmDspUDS_2620Byte02_signal" 571 "SIGNALS_Virtual_DcmDspUDS_2620Byte03_signal" 572 "SIGNALS_Virtual_DcmDspUDS_2620Byte04_signal" 573 "SIGNALS_Virtual_DcmDspUDS_2620Byte05_signal" 574 "SIGNALS_Virtual_DcmDspUDS_2621Byte00_signal" 575 "SIGNALS_Virtual_DcmDspUDS_2621Byte01_signal" 576 "SIGNALS_Virtual_DcmDspUDS_2621Byte02_signal" 577 "SIGNALS_Virtual_DcmDspUDS_2621Byte03_signal" 578 "SIGNALS_Virtual_DcmDspUDS_2621Byte04_signal" 579 "SIGNALS_Virtual_DcmDspUDS_2621Byte05_signal" 580 "SIGNALS_Virtual_DcmDspUDS_2622Byte00_signal" 581 "SIGNALS_Virtual_DcmDspUDS_2622Byte01_signal" 582 "SIGNALS_Virtual_DcmDspUDS_2622Byte02_signal" 583 "SIGNALS_Virtual_DcmDspUDS_2622Byte03_signal" 584 "SIGNALS_Virtual_DcmDspUDS_2622Byte04_signal" 585 "SIGNALS_Virtual_DcmDspUDS_2622Byte05_signal" 586 "SIGNALS_Virtual_DcmDspUDS_2623Byte00_signal" 587 "SIGNALS_Virtual_DcmDspUDS_2623Byte01_signal" 588 "SIGNALS_Virtual_DcmDspUDS_2623Byte02_signal" 589 "SIGNALS_Virtual_DcmDspUDS_2623Byte03_signal" 590 "SIGNALS_Virtual_DcmDspUDS_2623Byte04_signal" 591 "SIGNALS_Virtual_DcmDspUDS_2623Byte05_signal" 592 "SIGNALS_Virtual_DcmDspUDS_2625Byte00_signal" 593 "SIGNALS_Virtual_DcmDspUDS_2625Byte01_signal" 594 "SIGNALS_Virtual_DcmDspUDS_2625Byte02_signal" 595 "SIGNALS_Virtual_DcmDspUDS_2625Byte03_signal" 596 "SIGNALS_Virtual_DcmDspUDS_2625Byte04_signal" 597 "SIGNALS_Virtual_DcmDspUDS_2625Byte05_signal" 598 "SIGNALS_Virtual_DcmDspUDS_2627Byte00_signal" 599 "SIGNALS_Virtual_DcmDspUDS_2627Byte01_signal" 600 "SIGNALS_Virtual_DcmDspUDS_2627Byte02_signal" 601 "SIGNALS_Virtual_DcmDspUDS_2627Byte03_signal" 602 "SIGNALS_Virtual_DcmDspUDS_2627Byte04_signal" 603 "SIGNALS_Virtual_DcmDspUDS_2627Byte05_signal" 604 "SIGNALS_Virtual_DcmDspUDS_262AByte00_signal" 605 "SIGNALS_Virtual_DcmDspUDS_262AByte01_signal" 606 "SIGNALS_Virtual_DcmDspUDS_262AByte02_signal" 607 "SIGNALS_Virtual_DcmDspUDS_262AByte03_signal" 608 "SIGNALS_Virtual_DcmDspUDS_262AByte04_signal" 609 "SIGNALS_Virtual_DcmDspUDS_262AByte05_signal" 610 "SIGNALS_Virtual_DcmDspUDS_2660Byte0_signal" 611 "SIGNALS_Virtual_DcmDspUDS_2660Byte11to12_signal" 612 "SIGNALS_Virtual_DcmDspUDS_2660Byte13to14_signal" 613 "SIGNALS_Virtual_DcmDspUDS_2660Byte15_signal" 614 "SIGNALS_Virtual_DcmDspUDS_2660Byte16_signal" 615 "SIGNALS_Virtual_DcmDspUDS_2660Byte17_signal" 616 "SIGNALS_Virtual_DcmDspUDS_2660Byte18_signal" 617 "SIGNALS_Virtual_DcmDspUDS_2660Byte19_signal" 618 "SIGNALS_Virtual_DcmDspUDS_2660Byte1A_signal" 619 "SIGNALS_Virtual_DcmDspUDS_2660Byte1B_signal" 620 "SIGNALS_Virtual_DcmDspUDS_2660Byte1C_signal" 621 "SIGNALS_Virtual_DcmDspUDS_2660Byte1D_signal" 622 "SIGNALS_Virtual_DcmDspUDS_2660Byte1E_signal" 623 "SIGNALS_Virtual_DcmDspUDS_2660Byte1_signal" 624 "SIGNALS_Virtual_DcmDspUDS_2660Byte26to27_signal" 625 "SIGNALS_Virtual_DcmDspUDS_2660Byte2A_signal" 626 "SIGNALS_Virtual_DcmDspUDS_2660Byte2Eto2F_signal" 627 "SIGNALS_Virtual_DcmDspUDS_2660Byte2_signal" 628 "SIGNALS_Virtual_DcmDspUDS_2660Byte3_signal" 629 "SIGNALS_Virtual_DcmDspUDS_2660Byte4_signal" 630 "SIGNALS_Virtual_DcmDspUDS_2660Byte5_signal" 631 "SIGNALS_Virtual_DcmDspUDS_2660Byte6_signal" 632 "SIGNALS_Virtual_DcmDspUDS_2661Byte0A_signal" 633 "SIGNALS_Virtual_DcmDspUDS_2661Byte0B_signal" 634 "SIGNALS_Virtual_DcmDspUDS_2661Byte0C_signal" 635 "SIGNALS_Virtual_DcmDspUDS_2661Byte0D_signal" 636 "SIGNALS_Virtual_DcmDspUDS_2661Byte0E_signal" 637 "SIGNALS_Virtual_DcmDspUDS_2661Byte0F_signal" 638 "SIGNALS_Virtual_DcmDspUDS_2661Byte0_signal" 639 "SIGNALS_Virtual_DcmDspUDS_2661Byte1_signal" 640 "SIGNALS_Virtual_DcmDspUDS_2661Byte2D_signal" 641 "SIGNALS_Virtual_DcmDspUDS_2661Byte2E_signal" 642 "SIGNALS_Virtual_DcmDspUDS_2661Byte2F_signal" 643 "SIGNALS_Virtual_DcmDspUDS_2661Byte2_signal" 644 "SIGNALS_Virtual_DcmDspUDS_2661Byte30_signal" 645 "SIGNALS_Virtual_DcmDspUDS_2661Byte31_signal" 646 "SIGNALS_Virtual_DcmDspUDS_2661Byte32_signal" 647 "SIGNALS_Virtual_DcmDspUDS_2661Byte3_signal" 648 "SIGNALS_Virtual_DcmDspUDS_2661Byte4_signal" 649 "SIGNALS_Virtual_DcmDspUDS_2661Byte5_signal" 650 "SIGNALS_Virtual_DcmDspUDS_2661Byte6_signal" 651 "SIGNALS_Virtual_DcmDspUDS_2661Byte7_signal" 652 "SIGNALS_Virtual_DcmDspUDS_2661Byte8_signal" 653 "SIGNALS_Virtual_DcmDspUDS_2661Byte9_signal" 654 "SIGNALS_Virtual_DcmDspUDS_2662Byte0Cto0D_signal" 655 "SIGNALS_Virtual_DcmDspUDS_2662Byte0_signal" 656 "SIGNALS_Virtual_DcmDspUDS_2662Byte18_signal" 657 "SIGNALS_Virtual_DcmDspUDS_2662Byte19_signal" 658 "SIGNALS_Virtual_DcmDspUDS_2662Byte1_signal" 659 "SIGNALS_Virtual_DcmDspUDS_2662Byte2_signal" 660 "SIGNALS_Virtual_DcmDspUDS_2662Byte3_signal" 661 "SIGNALS_Virtual_DcmDspUDS_2662Byte4_signal" 662 "SIGNALS_Virtual_DcmDspUDS_2662Byte5_signal" 663 "SIGNALS_Virtual_DcmDspUDS_2663Byte0_signal" 664 "SIGNALS_Virtual_DcmDspUDS_2663Byte14Byte15_signal" 665 "SIGNALS_Virtual_DcmDspUDS_2663Byte16Byte17_signal" 666 "SIGNALS_Virtual_DcmDspUDS_2663Byte18Byte19_signal" 667 "SIGNALS_Virtual_DcmDspUDS_2663Byte1AByte1B_signal" 668 "SIGNALS_Virtual_DcmDspUDS_2663Byte1_signal" 669 "SIGNALS_Virtual_DcmDspUDS_2663Byte2_signal" 670 "SIGNALS_Virtual_DcmDspUDS_2663Byte3_signal" 671 "SIGNALS_Virtual_DcmDspUDS_2663Byte4_signal" 672 "SIGNALS_Virtual_DcmDspUDS_2663Byte5_signal" 673 "SIGNALS_Virtual_DcmDspUDS_2664Byte0_signal" 674 "SIGNALS_Virtual_DcmDspUDS_2664Byte1_signal" 675 "SIGNALS_Virtual_DcmDspUDS_2664Byte25_signal" 676 "SIGNALS_Virtual_DcmDspUDS_2664Byte26_signal" 677 "SIGNALS_Virtual_DcmDspUDS_2664Byte2_signal" 678 "SIGNALS_Virtual_DcmDspUDS_2664Byte3_signal" 679 "SIGNALS_Virtual_DcmDspUDS_2664Byte4_signal" 680 "SIGNALS_Virtual_DcmDspUDS_2664Byte5_signal" 681 "SIGNALS_Virtual_DcmDspUDS_2664Byte6_signal" 682 "SIGNALS_Virtual_DcmDspUDS_2664Byte7_signal" 683 "SIGNALS_Virtual_DcmDspUDS_2665Byte0_signal" 684 "SIGNALS_Virtual_DcmDspUDS_2665Byte1_signal" 685 "SIGNALS_Virtual_DcmDspUDS_2665Byte2_signal" 686 "SIGNALS_Virtual_DcmDspUDS_2665Byte3_signal" 687 "SIGNALS_Virtual_DcmDspUDS_2665Byte4_signal" 688 "SIGNALS_Virtual_DcmDspUDS_2665Byte5_signal" 689 "SIGNALS_Virtual_DcmDspUDS_2666Byte0_signal" 690 "SIGNALS_Virtual_DcmDspUDS_2666Byte1_signal" 691 "SIGNALS_Virtual_DcmDspUDS_2666Byte2_signal" 692 "SIGNALS_Virtual_DcmDspUDS_2666Byte3_signal" 693 "SIGNALS_Virtual_DcmDspUDS_2666Byte4_signal" 694 "SIGNALS_Virtual_DcmDspUDS_2666Byte5_signal" 695 "SIGNALS_Virtual_DcmDspUDS_2668Byte0_signal" 696 "SIGNALS_Virtual_DcmDspUDS_2668Byte1_signal" 697 "SIGNALS_Virtual_DcmDspUDS_2668Byte2_signal" 698 "SIGNALS_Virtual_DcmDspUDS_2668Byte3_signal" 699 "SIGNALS_Virtual_DcmDspUDS_2668Byte4_signal" 700 "SIGNALS_Virtual_DcmDspUDS_2668Byte5_signal" 701 "SIGNALS_Virtual_DcmDspUDS_266CByte0_signal" 702 "SIGNALS_Virtual_DcmDspUDS_266CByte1_signal" 703 "SIGNALS_Virtual_DcmDspUDS_266CByte26_signal" 704 "SIGNALS_Virtual_DcmDspUDS_266CByte27_signal" 705 "SIGNALS_Virtual_DcmDspUDS_266CByte2_signal" 706 "SIGNALS_Virtual_DcmDspUDS_266CByte3_signal" 707 "SIGNALS_Virtual_DcmDspUDS_266CByte4_signal" 708 "SIGNALS_Virtual_DcmDspUDS_266CByte5_signal" 709 "SIGNALS_Virtual_DcmDspUDS_266CByte6_signal" 710 "SIGNALS_Virtual_DcmDspUDS_266CByte7_signal" 711 "SIGNALS_Virtual_DcmDspUDS_266CByte8_signal" 712 "SIGNALS_Virtual_DcmDspUDS_266CByte9_signal" 713 "SIGNALS_Virtual_DcmDspUDS_266DByte0_signal" 714 "SIGNALS_Virtual_DcmDspUDS_266DByte1_signal" 715 "SIGNALS_Virtual_DcmDspUDS_266DByte2_signal" 716 "SIGNALS_Virtual_DcmDspUDS_266DByte3_signal" 717 "SIGNALS_Virtual_DcmDspUDS_266DByte4_signal" 718 "SIGNALS_Virtual_DcmDspUDS_266DByte5_signal" 719 "SIGNALS_Virtual_DcmDspUDS_266FByte0_signal" 720 "SIGNALS_Virtual_DcmDspUDS_266FByte1_signal" 721 "SIGNALS_Virtual_DcmDspUDS_266FByte2_signal" 722 "SIGNALS_Virtual_DcmDspUDS_266FByte3_signal" 723 "SIGNALS_Virtual_DcmDspUDS_2673Byte0A_signal" 724 "SIGNALS_Virtual_DcmDspUDS_2673Byte0B_signal" 725 "SIGNALS_Virtual_DcmDspUDS_2673Byte0_signal" 726 "SIGNALS_Virtual_DcmDspUDS_2673Byte12_signal" 727 "SIGNALS_Virtual_DcmDspUDS_2673Byte13_signal" 728 "SIGNALS_Virtual_DcmDspUDS_2673Byte16_signal" 729 "SIGNALS_Virtual_DcmDspUDS_2673Byte17_signal" 730 "SIGNALS_Virtual_DcmDspUDS_2673Byte1E_signal" 731 "SIGNALS_Virtual_DcmDspUDS_2673Byte1F_signal" 732 "SIGNALS_Virtual_DcmDspUDS_2673Byte1_signal" 733 "SIGNALS_Virtual_DcmDspUDS_2673Byte2_signal" 734 "SIGNALS_Virtual_DcmDspUDS_2673Byte3_signal" 735 "SIGNALS_Virtual_DcmDspUDS_2673Byte4_signal" 736 "SIGNALS_Virtual_DcmDspUDS_2673Byte5_signal" 737 "SIGNALS_Virtual_DcmDspUDS_2673Byte6_signal" 738 "SIGNALS_Virtual_DcmDspUDS_2673Byte7_signal" 739 "SIGNALS_Virtual_DcmDspUDS_2676Byte0_signal" 740 "SIGNALS_Virtual_DcmDspUDS_2676Byte1_signal" 741 "SIGNALS_Virtual_DcmDspUDS_2676Byte2E_signal" 742 "SIGNALS_Virtual_DcmDspUDS_2676Byte2F_signal" 743 "SIGNALS_Virtual_DcmDspUDS_2676Byte2_signal" 744 "SIGNALS_Virtual_DcmDspUDS_2676Byte3_signal" 745 "SIGNALS_Virtual_DcmDspUDS_2676Byte4_signal" 746 "SIGNALS_Virtual_DcmDspUDS_2676Byte5_signal" 747 "SIGNALS_Virtual_DcmDspUDS_2676Byte6_signal" 748 "SIGNALS_Virtual_DcmDspUDS_2676Byte7_signal" 749 "SIGNALS_Virtual_DcmDspUDS_267BByte0_signal" 750 "SIGNALS_Virtual_DcmDspUDS_267BByte1_signal" 751 "SIGNALS_Virtual_DcmDspUDS_267BByte2_signal" 752 "SIGNALS_Virtual_DcmDspUDS_267BByte3_signal" 753 "SIGNALS_Virtual_DcmDspUDS_267BByte4_signal" 754 "SIGNALS_Virtual_DcmDspUDS_267BByte5_signal" 755 "SIGNALS_Virtual_DcmDspUDS_267EByte0_signal" 756 "SIGNALS_Virtual_DcmDspUDS_267EByte1_signal" 757 "SIGNALS_Virtual_DcmDspUDS_267EByte22_signal" 758 "SIGNALS_Virtual_DcmDspUDS_267EByte2_signal" 759 "SIGNALS_Virtual_DcmDspUDS_2680Byte00_signal" 760 "SIGNALS_Virtual_DcmDspUDS_2680Byte01_signal" 761 "SIGNALS_Virtual_DcmDspUDS_2680Byte02_signal" 762 "SIGNALS_Virtual_DcmDspUDS_2680Byte03_signal" 763 "SIGNALS_Virtual_DcmDspUDS_2680Byte04_signal" 764 "SIGNALS_Virtual_DcmDspUDS_2680Byte05_signal" 765 "SIGNALS_Virtual_DcmDspUDS_2680Byte08_signal" 766 "SIGNALS_Virtual_DcmDspUDS_2680Byte09_signal" 767 "SIGNALS_Virtual_DcmDspUDS_2680Byte0E_signal" 768 "SIGNALS_Virtual_DcmDspUDS_2680Byte0F_signal" 769 "SIGNALS_Virtual_DcmDspUDS_2681Byte00_signal" 770 "SIGNALS_Virtual_DcmDspUDS_2681Byte01_signal" 771 "SIGNALS_Virtual_DcmDspUDS_2681Byte02_signal" 772 "SIGNALS_Virtual_DcmDspUDS_2681Byte03_signal" 773 "SIGNALS_Virtual_DcmDspUDS_2681Byte04_signal" 774 "SIGNALS_Virtual_DcmDspUDS_2681Byte05_signal" 775 "SIGNALS_Virtual_DcmDspUDS_2681Byte0F_signal" 776 "SIGNALS_Virtual_DcmDspUDS_2681Byte10_signal" 777 "SIGNALS_Virtual_DcmDspUDS_2681Byte13_signal" 778 "SIGNALS_Virtual_DcmDspUDS_2681Byte14_signal" 779 "SIGNALS_Virtual_DcmDspUDS_2681Byte1D_signal" 780 "SIGNALS_Virtual_DcmDspUDS_2681Byte1E_signal" 781 "SIGNALS_Virtual_DcmDspUDS_2682Byte00_signal" 782 "SIGNALS_Virtual_DcmDspUDS_2682Byte01_signal" 783 "SIGNALS_Virtual_DcmDspUDS_2682Byte02_signal" 784 "SIGNALS_Virtual_DcmDspUDS_2682Byte03_signal" 785 "SIGNALS_Virtual_DcmDspUDS_2682Byte04_signal" 786 "SIGNALS_Virtual_DcmDspUDS_2682Byte05_signal" 787 "SIGNALS_Virtual_DcmDspUDS_2682Byte06_07_signal" 788 "SIGNALS_Virtual_DcmDspUDS_2682Byte08_09_signal" 789 "SIGNALS_Virtual_DcmDspUDS_2682Byte0E_signal" 790 "SIGNALS_Virtual_DcmDspUDS_2682Byte11_12_signal" 791 "SIGNALS_Virtual_DcmDspUDS_2682Byte13_14_signal" 792 "SIGNALS_Virtual_DcmDspUDS_2682Byte15_16_signal" 793 "SIGNALS_Virtual_DcmDspUDS_2682Byte18_19_signal" 794 "SIGNALS_Virtual_DcmDspUDS_2682Byte1B_signal" 795 "SIGNALS_Virtual_DcmDspUDS_2682Byte1C_signal" 796 "SIGNALS_Virtual_DcmDspUDS_2683Byte00_signal" 797 "SIGNALS_Virtual_DcmDspUDS_2683Byte01_signal" 798 "SIGNALS_Virtual_DcmDspUDS_2683Byte02_signal" 799 "SIGNALS_Virtual_DcmDspUDS_2683Byte03_signal" 800 "SIGNALS_Virtual_DcmDspUDS_2683Byte04_signal" 801 "SIGNALS_Virtual_DcmDspUDS_2683Byte05_signal" 802 "SIGNALS_Virtual_DcmDspUDS_2684Byte00_signal" 803 "SIGNALS_Virtual_DcmDspUDS_2684Byte01_signal" 804 "SIGNALS_Virtual_DcmDspUDS_2684Byte02_signal" 805 "SIGNALS_Virtual_DcmDspUDS_2684Byte03_signal" 806 "SIGNALS_Virtual_DcmDspUDS_2684Byte04_signal" 807 "SIGNALS_Virtual_DcmDspUDS_2684Byte05_signal" 808 "SIGNALS_Virtual_DcmDspUDS_2688Byte00_signal" 809 "SIGNALS_Virtual_DcmDspUDS_2688Byte01_signal" 810 "SIGNALS_Virtual_DcmDspUDS_2688Byte02_signal" 811 "SIGNALS_Virtual_DcmDspUDS_2688Byte03_signal" 812 "SIGNALS_Virtual_DcmDspUDS_2688Byte04_signal" 813 "SIGNALS_Virtual_DcmDspUDS_2688Byte05_signal" 814 "SIGNALS_Virtual_DcmDspUDS_2689Byte00_signal" 815 "SIGNALS_Virtual_DcmDspUDS_2689Byte01_signal" 816 "SIGNALS_Virtual_DcmDspUDS_2689Byte02_signal" 817 "SIGNALS_Virtual_DcmDspUDS_2689Byte03_signal" 818 "SIGNALS_Virtual_DcmDspUDS_2689Byte04_signal" 819 "SIGNALS_Virtual_DcmDspUDS_2689Byte05_signal" 820 "SIGNALS_Virtual_DcmDspUDS_2689Byte06to09_signal" 821 "SIGNALS_Virtual_DcmDspUDS_2689Byte0Eto11_signal" 822 "SIGNALS_Virtual_DcmDspUDS_2689Byte12to15_signal" 823 "SIGNALS_Virtual_DcmDspUDS_2689Byte16to19_signal" 824 "SIGNALS_Virtual_DcmDspUDS_2689Byte1Ato1D_signal" 825 "SIGNALS_Virtual_DcmDspUDS_2689Byte1Eto21_signal" 826 "SIGNALS_Virtual_DcmDspUDS_2689Byte22to25_signal" 827 "SIGNALS_Virtual_DcmDspUDS_2689Byte26to29_signal" 828 "SIGNALS_Virtual_DcmDspUDS_2689Byte2Ato2D_signal" 829 "SIGNALS_Virtual_DcmDspUDS_2689Byte2Eto31_signal" 830 "SIGNALS_Virtual_DcmDspUDS_268BByte00_signal" 831 "SIGNALS_Virtual_DcmDspUDS_268BByte01_signal" 832 "SIGNALS_Virtual_DcmDspUDS_268BByte02_signal" 833 "SIGNALS_Virtual_DcmDspUDS_268BByte03_signal" 834 "SIGNALS_Virtual_DcmDspUDS_268BByte04_signal" 835 "SIGNALS_Virtual_DcmDspUDS_268BByte05_signal" 836 "SIGNALS_Virtual_DcmDspUDS_268BByte06_signal" 837 "SIGNALS_Virtual_DcmDspUDS_268BByte07_signal" 838 "SIGNALS_Virtual_DcmDspUDS_268BByte08_signal" 839 "SIGNALS_Virtual_DcmDspUDS_268BByte09_signal" 840 "SIGNALS_Virtual_DcmDspUDS_268BByte0A_signal" 841 "SIGNALS_Virtual_DcmDspUDS_268BByte0B_signal" 842 "SIGNALS_Virtual_DcmDspUDS_268BByte0C_signal" 843 "SIGNALS_Virtual_DcmDspUDS_268BByte0D_signal" 844 "SIGNALS_Virtual_DcmDspUDS_268CByte00_signal" 845 "SIGNALS_Virtual_DcmDspUDS_268CByte01_signal" 846 "SIGNALS_Virtual_DcmDspUDS_268CByte02_signal" 847 "SIGNALS_Virtual_DcmDspUDS_268CByte03_signal" 848 "SIGNALS_Virtual_DcmDspUDS_268CByte04_signal" 849 "SIGNALS_Virtual_DcmDspUDS_268CByte05_signal" 850 "SIGNALS_Virtual_DcmDspUDS_268CByte06_signal" 851 "SIGNALS_Virtual_DcmDspUDS_268CByte07_signal" 852 "SIGNALS_Virtual_DcmDspUDS_268CByte08_signal" 853 "SIGNALS_Virtual_DcmDspUDS_268CByte09_signal" 854 "SIGNALS_Virtual_DcmDspUDS_268CByte0A_signal" 855 "SIGNALS_Virtual_DcmDspUDS_268CByte2E_signal" 856 "SIGNALS_Virtual_DcmDspUDS_268CByte2F_signal" 857 "SIGNALS_Virtual_DcmDspUDS_268CByte30_signal" 858 "SIGNALS_Virtual_DcmDspUDS_268CByte31_signal" 859 "SIGNALS_Virtual_DcmDspUDS_268CByte32_signal" 860 "SIGNALS_Virtual_DcmDspUDS_268CByte33_signal" 861 "SIGNALS_Virtual_DcmDspUDS_268EByte00_signal" 862 "SIGNALS_Virtual_DcmDspUDS_268EByte01_signal" 863 "SIGNALS_Virtual_DcmDspUDS_268EByte02_signal" 864 "SIGNALS_Virtual_DcmDspUDS_268EByte03_signal" 865 "SIGNALS_Virtual_DcmDspUDS_268EByte04_signal" 866 "SIGNALS_Virtual_DcmDspUDS_268EByte05_signal" 867 "SIGNALS_Virtual_DcmDspUDS_268EByte08to09_signal" 868 "SIGNALS_Virtual_DcmDspUDS_268EByte0A_signal" 869 "SIGNALS_Virtual_DcmDspUDS_268EByte0B_signal" 870 "SIGNALS_Virtual_DcmDspUDS_268FByte00_signal" 871 "SIGNALS_Virtual_DcmDspUDS_268FByte01_signal" 872 "SIGNALS_Virtual_DcmDspUDS_268FByte02_signal" 873 "SIGNALS_Virtual_DcmDspUDS_268FByte03_signal" 874 "SIGNALS_Virtual_DcmDspUDS_268FByte04_signal" 875 "SIGNALS_Virtual_DcmDspUDS_268FByte05_signal" 876 "SIGNALS_Virtual_DcmDspUDS_268FByte0A_signal" 877 "SIGNALS_Virtual_DcmDspUDS_268FByte0B_signal" 878 "SIGNALS_Virtual_DcmDspUDS_268FByte16_17_signal" 879 "SIGNALS_Virtual_DcmDspUDS_268FByte18_19_signal" 880 "SIGNALS_Virtual_DcmDspUDS_268FByte1A_1B_signal" 881 "SIGNALS_Virtual_DcmDspUDS_2699Byte00_signal" 882 "SIGNALS_Virtual_DcmDspUDS_2699Byte01_signal" 883 "SIGNALS_Virtual_DcmDspUDS_2699Byte02_signal" 884 "SIGNALS_Virtual_DcmDspUDS_2699Byte03_signal" 885 "SIGNALS_Virtual_DcmDspUDS_2699Byte04_signal" 886 "SIGNALS_Virtual_DcmDspUDS_2699Byte05_signal" 887 "SIGNALS_Virtual_DcmDspUDS_2699Byte06_signal" 888 "SIGNALS_Virtual_DcmDspUDS_2699Byte07_signal" 889 "SIGNALS_Virtual_DcmDspUDS_2699Byte0B_0C_signal" 890 "SIGNALS_Virtual_DcmDspUDS_2699Byte16_signal" 891 "SIGNALS_Virtual_DcmDspUDS_2699Byte17_signal" 892 "SIGNALS_Virtual_DcmDspUDS_2699Byte26_27_signal" 893 "SIGNALS_Virtual_DcmDspUDS_2699Byte28_29_signal" 894 "SIGNALS_Virtual_DcmDspUDS_2699Byte2A_2B_signal" 895 "SIGNALS_Virtual_DcmDspUDS_2699Byte2E_signal" 896 "SIGNALS_Virtual_DcmDspUDS_2699Byte2F_30_signal" 897 "SIGNALS_Virtual_DcmDspUDS_269AByte00_signal" 898 "SIGNALS_Virtual_DcmDspUDS_269AByte01_signal" 899 "SIGNALS_Virtual_DcmDspUDS_269AByte02_signal" 900 "SIGNALS_Virtual_DcmDspUDS_269AByte03_signal" 901 "SIGNALS_Virtual_DcmDspUDS_269AByte04_signal" 902 "SIGNALS_Virtual_DcmDspUDS_269AByte05_signal" 903 "SIGNALS_Virtual_DcmDspUDS_269BByte00_signal" 904 "SIGNALS_Virtual_DcmDspUDS_269BByte01_signal" 905 "SIGNALS_Virtual_DcmDspUDS_269BByte02_signal" 906 "SIGNALS_Virtual_DcmDspUDS_269BByte03_signal" 907 "SIGNALS_Virtual_DcmDspUDS_269BByte04_signal" 908 "SIGNALS_Virtual_DcmDspUDS_269BByte05_signal" 909 "SIGNALS_Virtual_DcmDspUDS_269EByte00_signal" 910 "SIGNALS_Virtual_DcmDspUDS_269EByte01_signal" 911 "SIGNALS_Virtual_DcmDspUDS_269EByte02_signal" 912 "SIGNALS_Virtual_DcmDspUDS_269EByte03_signal" 913 "SIGNALS_Virtual_DcmDspUDS_269EByte04_signal" 914 "SIGNALS_Virtual_DcmDspUDS_269EByte05_signal" 915 "SIGNALS_Virtual_DcmDspUDS_26A0Byte00_signal" 916 "SIGNALS_Virtual_DcmDspUDS_26A0Byte01_signal" 917 "SIGNALS_Virtual_DcmDspUDS_26A0Byte02_signal" 918 "SIGNALS_Virtual_DcmDspUDS_26A0Byte03_signal" 919 "SIGNALS_Virtual_DcmDspUDS_26A0Byte04_signal" 920 "SIGNALS_Virtual_DcmDspUDS_26A0Byte05_signal" 921 "SIGNALS_Virtual_DcmDspUDS_26A0Byte06_signal" 922 "SIGNALS_Virtual_DcmDspUDS_26A0Byte07_signal" 923 "SIGNALS_Virtual_DcmDspUDS_26A0Byte08_signal" 924 "SIGNALS_Virtual_DcmDspUDS_26A0Byte09_signal" 925 "SIGNALS_Virtual_DcmDspUDS_26A0Byte0A_signal" 926 "SIGNALS_Virtual_DcmDspUDS_26A0Byte0B_signal" 927 "SIGNALS_Virtual_DcmDspUDS_26A0Byte0C_signal" 928 "SIGNALS_Virtual_DcmDspUDS_26A0Byte0D_signal" 929 "SIGNALS_Virtual_DcmDspUDS_26A0Byte0E_signal" 930 "SIGNALS_Virtual_DcmDspUDS_26A0Byte0F_signal" 931 "SIGNALS_Virtual_DcmDspUDS_26A0Byte10_signal" 932 "SIGNALS_Virtual_DcmDspUDS_26A0Byte11_signal" 933 "SIGNALS_Virtual_DcmDspUDS_26A0Byte12_signal" 934 "SIGNALS_Virtual_DcmDspUDS_26A0Byte13_signal" 935 "SIGNALS_Virtual_DcmDspUDS_26A0Byte14_signal" 936 "SIGNALS_Virtual_DcmDspUDS_26A0Byte15_signal" 937 "SIGNALS_Virtual_DcmDspUDS_26A0Byte16_signal" 938 "SIGNALS_Virtual_DcmDspUDS_26A0Byte17_signal" 939 "SIGNALS_Virtual_DcmDspUDS_26A0Byte18_signal" 940 "SIGNALS_Virtual_DcmDspUDS_26A0Byte19_signal" 941 "SIGNALS_Virtual_DcmDspUDS_26A0Byte1A_signal" 942 "SIGNALS_Virtual_DcmDspUDS_26A0Byte4E_signal" 943 "SIGNALS_Virtual_DcmDspUDS_26A0Byte52_53_signal" 944 "SIGNALS_Virtual_DcmDspUDS_26A0Byte54_55_signal" 945 "SIGNALS_Virtual_DcmDspUDS_26A0Byte56_57_signal" 946 "SIGNALS_Virtual_DcmDspUDS_26A0Byte66_signal" 947 "SIGNALS_Virtual_DcmDspUDS_26A0Byte67_signal" 948 "SIGNALS_Virtual_DcmDspUDS_26A0Byte68_signal" 949 "SIGNALS_Virtual_DcmDspUDS_26A0Byte69_signal" 950 "SIGNALS_Virtual_DcmDspUDS_26A0Byte6A_signal" 951 "SIGNALS_Virtual_DcmDspUDS_26A0Byte6B_signal" 952 "SIGNALS_Virtual_DcmDspUDS_26A0Byte6C_signal" 953 "SIGNALS_Virtual_DcmDspUDS_26A0Byte6D_signal" 954 "SIGNALS_Virtual_DcmDspUDS_26A0Byte7F_80_signal" 955 "SIGNALS_Virtual_DcmDspUDS_26A0Byte81_82_signal" 956 "SIGNALS_Virtual_DcmDspUDS_26A0Byte83_84_signal" 957 "SIGNALS_Virtual_DcmDspUDS_26A0Byte85_86_signal" 958 "SIGNALS_Virtual_DcmDspUDS_26A0Byte87_88_signal" 959 "SIGNALS_Virtual_DcmDspUDS_26A0Byte89_8A_signal" 960 "SIGNALS_Virtual_DcmDspUDS_26A0Byte8B_8C_signal" 961 "SIGNALS_Virtual_DcmDspUDS_26A0Byte8D_8E_signal" 962 "SIGNALS_Virtual_DcmDspUDS_26A0Byte8F_90_signal" 963 "SIGNALS_Virtual_DcmDspUDS_26A0Byte91_92_signal" 964 "SIGNALS_Virtual_DcmDspUDS_26A0Byte93_94_signal" 965 "SIGNALS_Virtual_DcmDspUDS_26A0Byte95_96_signal" 966 "SIGNALS_Virtual_DcmDspUDS_26A0Byte97_98_signal" 967 "SIGNALS_Virtual_DcmDspUDS_26A0Byte99_9A_signal" 968 "SIGNALS_Virtual_DcmDspUDS_26A0Byte9B_9C_signal" 969 "SIGNALS_Virtual_DcmDspUDS_26A0Byte9D_9E_signal" 970 "SIGNALS_Virtual_DcmDspUDS_26A0Byte9F_A0_signal" 971 "SIGNALS_Virtual_DcmDspUDS_26A0ByteA1_A2_signal" 972 "SIGNALS_Virtual_DcmDspUDS_26A0ByteA3_A4_signal" 973 "SIGNALS_Virtual_DcmDspUDS_26A0ByteA5_A6_signal" 974 "SIGNALS_Virtual_DcmDspUDS_26A0ByteA7_A8_signal" 975 "SIGNALS_Virtual_DcmDspUDS_26A0ByteA9_AA_signal" 976 "SIGNALS_Virtual_DcmDspUDS_26A0ByteAB_AC_signal" 977 "SIGNALS_Virtual_DcmDspUDS_26A0ByteAD_AE_signal" 978 "SIGNALS_Virtual_DcmDspUDS_26A0ByteAF_B0_signal" 979 "SIGNALS_Virtual_DcmDspUDS_26A0ByteB1_B2_signal" 980 "SIGNALS_Virtual_DcmDspUDS_26A0ByteB3_B4_signal" 981 "SIGNALS_Virtual_DcmDspUDS_26A0ByteB5_B6_signal" 982 "SIGNALS_Virtual_DcmDspUDS_26A0ByteB7_B8_signal" 983 "SIGNALS_Virtual_DcmDspUDS_26A0ByteB9_BA_signal" 984 "SIGNALS_Virtual_DcmDspUDS_26A0ByteBB_BC_signal" 985 "SIGNALS_Virtual_DcmDspUDS_26A0ByteBD_BE_signal" 986 "SIGNALS_Virtual_DcmDspUDS_26A0ByteBF_C0_signal" 987 "SIGNALS_Virtual_DcmDspUDS_26A0ByteC1_C2_signal" 988 "SIGNALS_Virtual_DcmDspUDS_26A0ByteC3_C4_signal" 989 "SIGNALS_Virtual_DcmDspUDS_26A0ByteC5_C6_signal" 990 "SIGNALS_Virtual_DcmDspUDS_26A0ByteC7_C8_signal" 991 "SIGNALS_Virtual_DcmDspUDS_26A0ByteC9_CA_signal" 992 "SIGNALS_Virtual_DcmDspUDS_26A0ByteCB_CC_signal" 993 "SIGNALS_Virtual_DcmDspUDS_26A0ByteCD_CE_signal" 994 "SIGNALS_Virtual_DcmDspUDS_26A0ByteCF_D0_signal" 995 "SIGNALS_Virtual_DcmDspUDS_26A0ByteD1_D2_signal" 996 "SIGNALS_Virtual_DcmDspUDS_26A0ByteD3_D4_signal" 997 "SIGNALS_Virtual_DcmDspUDS_26A0ByteD5_D6_signal" 998 "SIGNALS_Virtual_DcmDspUDS_26A0ByteD7_D8_signal" 999 "SIGNALS_Virtual_DcmDspUDS_26A0ByteD9_DA_signal" 1000 "SIGNALS_Virtual_DcmDspUDS_26A0ByteDB_DC_signal" 1001 "SIGNALS_Virtual_DcmDspUDS_26A0ByteDD_DE_signal" 1002 "SIGNALS_Virtual_DcmDspUDS_26A0ByteDF_E0_signal" 1003 "SIGNALS_Virtual_DcmDspUDS_26A0ByteE1_E2_signal" 1004 "SIGNALS_Virtual_DcmDspUDS_26A0ByteE3_E4_signal" 1005 "SIGNALS_Virtual_DcmDspUDS_26A0ByteE5_E6_signal" 1006 "SIGNALS_Virtual_DcmDspUDS_26A0ByteE7_E8_signal" 1007 "SIGNALS_Virtual_DcmDspUDS_26A0ByteE9_EA_signal" 1008 "SIGNALS_Virtual_DcmDspUDS_26A0ByteEB_EC_signal" 1009 "SIGNALS_Virtual_DcmDspUDS_26A0ByteED_EE_signal" 1010 "SIGNALS_Virtual_DcmDspUDS_26A0ByteEF_F0_signal" 1011 "SIGNALS_Virtual_DcmDspUDS_26A0ByteF1_F2_signal" 1012 "SIGNALS_Virtual_DcmDspUDS_26A1Byte00_signal" 1013 "SIGNALS_Virtual_DcmDspUDS_26A1Byte01_signal" 1014 "SIGNALS_Virtual_DcmDspUDS_26A1Byte02_signal" 1015 "SIGNALS_Virtual_DcmDspUDS_26A1Byte03_signal" 1016 "SIGNALS_Virtual_DcmDspUDS_26A1Byte04_signal" 1017 "SIGNALS_Virtual_DcmDspUDS_26A1Byte05_signal" 1018 "SIGNALS_Virtual_DcmDspUDS_26A1Byte06_signal" 1019 "SIGNALS_Virtual_DcmDspUDS_26A1Byte07_signal" 1020 "SIGNALS_Virtual_DcmDspUDS_26A1Byte08_signal" 1021 "SIGNALS_Virtual_DcmDspUDS_26A1Byte09_signal" 1022 "SIGNALS_Virtual_DcmDspUDS_26A1Byte0A_signal" 1023 "SIGNALS_Virtual_DcmDspUDS_26A1Byte0B_signal" 1024 "SIGNALS_Virtual_DcmDspUDS_26A1Byte0C_signal" 1025 "SIGNALS_Virtual_DcmDspUDS_26A1Byte0D_signal" 1026 "SIGNALS_Virtual_DcmDspUDS_26A1Byte0E_signal" 1027 "SIGNALS_Virtual_DcmDspUDS_26A1Byte0F_signal" 1028 "SIGNALS_Virtual_DcmDspUDS_26A1Byte10_signal" 1029 "SIGNALS_Virtual_DcmDspUDS_26A1Byte11_signal" 1030 "SIGNALS_Virtual_DcmDspUDS_26A1Byte12_signal" 1031 "SIGNALS_Virtual_DcmDspUDS_26A1Byte13_signal" 1032 "SIGNALS_Virtual_DcmDspUDS_26A1Byte14_signal" 1033 "SIGNALS_Virtual_DcmDspUDS_26A1Byte15_signal" 1034 "SIGNALS_Virtual_DcmDspUDS_26A1Byte16_signal" 1035 "SIGNALS_Virtual_DcmDspUDS_26A1Byte17_signal" 1036 "SIGNALS_Virtual_DcmDspUDS_26A1Byte18_signal" 1037 "SIGNALS_Virtual_DcmDspUDS_26A1Byte19_signal" 1038 "SIGNALS_Virtual_DcmDspUDS_26A1Byte1A_signal" 1039 "SIGNALS_Virtual_DcmDspUDS_26A1Byte1B_1C_signal" 1040 "SIGNALS_Virtual_DcmDspUDS_26A1Byte1D_1E_signal" 1041 "SIGNALS_Virtual_DcmDspUDS_26A1Byte1F_20_signal" 1042 "SIGNALS_Virtual_DcmDspUDS_26A1Byte21_22_signal" 1043 "SIGNALS_Virtual_DcmDspUDS_26A1Byte23_24_signal" 1044 "SIGNALS_Virtual_DcmDspUDS_26A1Byte25_signal" 1045 "SIGNALS_Virtual_DcmDspUDS_26A1Byte26_signal" 1046 "SIGNALS_Virtual_DcmDspUDS_26A1Byte27_signal" 1047 "SIGNALS_Virtual_DcmDspUDS_26A1Byte28_signal" 1048 "SIGNALS_Virtual_DcmDspUDS_26A1Byte29_signal" 1049 "SIGNALS_Virtual_DcmDspUDS_26A1Byte2A_signal" 1050 "SIGNALS_Virtual_DcmDspUDS_26A1Byte2B_signal" 1051 "SIGNALS_Virtual_DcmDspUDS_26A1Byte2C_signal" 1052 "SIGNALS_Virtual_DcmDspUDS_26A1Byte2D_signal" 1053 "SIGNALS_Virtual_DcmDspUDS_26A1Byte2E_signal" 1054 "SIGNALS_Virtual_DcmDspUDS_26A1Byte2F_signal" 1055 "SIGNALS_Virtual_DcmDspUDS_26A1Byte30_signal" 1056 "SIGNALS_Virtual_DcmDspUDS_26A1Byte31_signal" 1057 "SIGNALS_Virtual_DcmDspUDS_26A1Byte32_signal" 1058 "SIGNALS_Virtual_DcmDspUDS_26A1Byte33_signal" 1059 "SIGNALS_Virtual_DcmDspUDS_26A1Byte34_signal" 1060 "SIGNALS_Virtual_DcmDspUDS_26A1Byte35_signal" 1061 "SIGNALS_Virtual_DcmDspUDS_26A1Byte36_signal" 1062 "SIGNALS_Virtual_DcmDspUDS_26A1Byte37_signal" 1063 "SIGNALS_Virtual_DcmDspUDS_26A1Byte38_signal" 1064 "SIGNALS_Virtual_DcmDspUDS_26A1Byte39_signal" 1065 "SIGNALS_Virtual_DcmDspUDS_26A1Byte6F_70_signal" 1066 "SIGNALS_Virtual_DcmDspUDS_26A1Byte71_72_signal" 1067 "SIGNALS_Virtual_DcmDspUDS_26A1Byte73_74_signal" 1068 "SIGNALS_Virtual_DcmDspUDS_26A1Byte75_76_signal" 1069 "SIGNALS_Virtual_DcmDspUDS_26A1Byte77_78_signal" 1070 "SIGNALS_Virtual_DcmDspUDS_26A1Byte79_signal" 1071 "SIGNALS_Virtual_DcmDspUDS_26A1Byte7B_signal" 1072 "SIGNALS_Virtual_DcmDspUDS_26A2Byte00_signal" 1073 "SIGNALS_Virtual_DcmDspUDS_26A2Byte01_signal" 1074 "SIGNALS_Virtual_DcmDspUDS_26A2Byte02_signal" 1075 "SIGNALS_Virtual_DcmDspUDS_26A2Byte03_signal" 1076 "SIGNALS_Virtual_DcmDspUDS_26A2Byte04_signal" 1077 "SIGNALS_Virtual_DcmDspUDS_26A2Byte05_signal" 1078 "SIGNALS_Virtual_DcmDspUDS_26A2Byte12_13_signal" 1079 "SIGNALS_Virtual_DcmDspUDS_26A2Byte1C_signal" 1080 "SIGNALS_Virtual_DcmDspUDS_26A2Byte1D_signal" 1081 "SIGNALS_Virtual_DcmDspUDS_26A2Byte21_signal" 1082 "SIGNALS_Virtual_DcmDspUDS_26A2Byte22_signal" 1083 "SIGNALS_Virtual_DcmDspUDS_Acm_fzabgs_w_signal" 1084 "SIGNALS_Virtual_DcmDspUDS_DID_2613Byte2Eto2F_signal_VirtFunc_s" 1085 "SIGNALS_Virtual_DcmDspUDS_DID_261AByte08_signal" 1086 "SIGNALS_Virtual_DcmDspUDS_DID_261AByte09_signal" 1087 "SIGNALS_Virtual_DcmDspUDS_DID_E402Byte00_signal" 1088 "SIGNALS_Virtual_DcmDspUDS_DID_E402Byte01_signal" 1089 "SIGNALS_Virtual_DcmDspUDS_DID_E402Byte07to08_signal" 1090 "SIGNALS_Virtual_DcmDspUDS_DID_E402Byte10to11_signal" 1091 "SIGNALS_Virtual_DcmDspUDS_DID_E402Byte19to1A_signal" 1092 "SIGNALS_Virtual_DcmDspUDS_DID_E402Byte22to23_signal" 1093 "SIGNALS_Virtual_DcmDspUDS_DID_E402Byte2Bto2C_signal" 1094 "SIGNALS_Virtual_DcmDspUDS_DID_F110Byte0_3_signal" 1095 "SIGNALS_Virtual_DcmDspUDS_DID_F110Byte12_15_signal" 1096 "SIGNALS_Virtual_DcmDspUDS_DID_F110Byte16_signal" 1097 "SIGNALS_Virtual_DcmDspUDS_DID_F110Byte4_7_signal" 1098 "SIGNALS_Virtual_DcmDspUDS_DID_F110Byte8_11_signal" 1099 "SIGNALS_Virtual_DcmDspUDS_DID_F112Byte0_3_signal" 1100 "SIGNALS_Virtual_DcmDspUDS_DID_F112Byte12_15_signal" 1101 "SIGNALS_Virtual_DcmDspUDS_DID_F112Byte16_19_signal" 1102 "SIGNALS_Virtual_DcmDspUDS_DID_F112Byte20_23_signal" 1103 "SIGNALS_Virtual_DcmDspUDS_DID_F112Byte24_27_signal" 1104 "SIGNALS_Virtual_DcmDspUDS_DID_F112Byte28_29_signal" 1105 "SIGNALS_Virtual_DcmDspUDS_DID_F112Byte30_signal" 1106 "SIGNALS_Virtual_DcmDspUDS_DID_F112Byte4_7_signal" 1107 "SIGNALS_Virtual_DcmDspUDS_DID_F112Byte8_11_signal" 1108 "SIGNALS_Virtual_DcmDspUDS_E602Byte2_signal" 1109 "SIGNALS_Virtual_DcmDspUDS_F181Byte0_3_signal" 1110 "SIGNALS_Virtual_DcmDspUDS_F181Byte12_15_signal" 1111 "SIGNALS_Virtual_DcmDspUDS_F181Byte4_7_signal" 1112 "SIGNALS_Virtual_DcmDspUDS_F181Byte8_11_signal" 1113 "SIGNALS_Virtual_DcmDspUDS_fzabgs_w_signal" 1114 "SIGNALS_Virtual_DcmDspUDS_numReWrECUID1_signal" 1115 "SIGNALS_Virtual_DcmDspUDS_numReWrECUID2_signal" 1116 "SIGNALS_Virtual_I14229B9_0490_FrNo09_signal" 1117 "SIGNALS_Virtual_I14229B9_0490_FrNo10_signal" 1118 "SIGNALS_Virtual_I14229B9_04B1_FrNo16_signal" 1119 "SIGNALS_Virtual_I14229B9_04B1_FrNo17_signal" 1120 "SIGNALS_Virtual_I14229B9_04B1_FrNo20_signal" 1121 "SIGNALS_Virtual_I14229B9_04B1_FrNo21_signal" 1122 "SIGNALS_Virtual_I14229B9_04B1_FrNo22_signal" 1123 "SIGNALS_Virtual_I14229B9_04B1_FrNo23_signal" 1124 "SIGNALS_Virtual_I14229B9_04C2_FrNo2021_signal" 1125 "SIGNALS_Virtual_I14229B9_04D2_FrNo24_signal" 1126 "SIGNALS_Virtual_I14229B9_04D2_FrNo25_signal" 1127 "SIGNALS_Virtual_I14229B9_0520_FrNo15_signal" 1128 "SIGNALS_Virtual_I14229B9_0520_FrNo16_signal" 1129 "SIGNALS_Virtual_I14229B9_0523_FrNo42_signal" 1130 "SIGNALS_Virtual_I14229B9_0523_FrNo43_signal" 1131 "SIGNALS_Virtual_I14229B9_0524_FrNo09_signal" 1132 "SIGNALS_Virtual_I14229B9_0524_FrNo10_signal" 1133 "SIGNALS_Virtual_I14229B9_0550_FrNo09_signal" 1134 "SIGNALS_Virtual_I14229B9_0550_FrNo10_signal" 1135 "SIGNALS_Virtual_I14229B9_0553_FrNo13_signal" 1136 "SIGNALS_Virtual_I14229B9_0553_FrNo14_signal" 1137 "SIGNALS_Virtual_I14229B9_056A_FrNo8_signal" 1138 "SIGNALS_Virtual_I14229B9_056A_FrNo9_signal" 1139 "SIGNALS_Virtual_I14229B9_0588_FrNo15_signal" 1140 "SIGNALS_Virtual_I14229B9_0588_FrNo16_signal" 1141 "SIGNALS_Virtual_I14229B9_05A0_FrNo40_signal" 1142 "SIGNALS_Virtual_I14229B9_05A0_FrNo41_signal" 1143 "SIGNALS_Virtual_I14229B9_05B0_FrNo13_signal" 1144 "SIGNALS_Virtual_I14229B9_05B0_FrNo14_signal" 1145 "SIGNALS_Virtual_I14229B9_05C0_FrNo12_signal" 1146 "SIGNALS_Virtual_I14229B9_05C0_FrNo13_signal" 1147 "SIGNALS_Virtual_I14229B9_05E0_FrNo19_signal" 1148 "SIGNALS_Virtual_I14229B9_05E0_FrNo20_signal" 1149 "SIGNALS_Virtual_I14229B9_05E0_FrNo21_signal" 1150 "SIGNALS_Virtual_I14229B9_05E0_FrNo22_signal" 1151 "SIGNALS_Virtual_I14229B9_05E0_FrNo23_signal" 1152 "SIGNALS_Virtual_I14229B9_05E0_FrNo24_signal" 1153 "SIGNALS_Virtual_I14229B9_1208_FrNo34_signal" 1154 "SIGNALS_Virtual_I14229B9_1208_FrNo35_signal" 1155 "SIGNALS_Virtual_I14229B9_1208_FrNo36_signal" 1156 "SIGNALS_Virtual_I14229B9_1208_FrNo37_signal" 1157 "SIGNALS_Virtual_I14229B9_120A_FrNo09_signal" 1158 "SIGNALS_Virtual_I14229B9_120A_FrNo10_signal" 1159 "SIGNALS_Virtual_I14229B9_120B_FrNo09_signal" 1160 "SIGNALS_Virtual_I14229B9_120B_FrNo10_signal" 1161 "SIGNALS_Virtual_I14229_Com_aLgtG_signal" 1162 "SIGNALS_Virtual_I14229_pEngSrtMin_signal" 1163 "SIGNALS_Virtual_IKCtl_agAdpnCurr_s16_signal" 1164 "SIGNALS_Virtual_IKCtl_wIntgRef_au32_0__s" 1165 "SIGNALS_Virtual_PtCoornDyn_tqCluDes_signal" 1166 "SIGNALS_Virtual_PtCoornDyn_tqCluLeadTrsmIntv_signal" 1167 "SIGNALS_Virtual_Tra_numGear_signal" 1168 "SIGNALS_Virtual_i14229_agIntkB1GEVlvSig_signal" /end COMPU_VTAB
/begin COMPU_METHOD Signals_PidVerbSupp "" TAB_VERB "%6.3" "" COMPU_TAB_REF Signals_PidVerbSupp /end COMPU_METHOD
/begin COMPU_VTAB Signals_PidVerbSupp "" TAB_VERB 104 0 "PID_NOT_SUPPORTED" 1 "PID_0x01" 3 "PID_0x03" 4 "PID_0x04" 5 "PID_0x05" 6 "PID_0x06" 7 "PID_0x07" 11 "PID_0x0B" 12 "PID_0x0C" 13 "PID_0x0D" 14 "PID_0x0E" 15 "PID_0x0F" 16 "PID_0x10" 17 "PID_0x11" 19 "PID_0x13" 21 "PID_0x15" 28 "PID_0x1C" 31 "PID_0x1F" 33 "PID_0x21" 35 "PID_0x23" 44 "PID_0x2C" 45 "PID_0x2D" 46 "PID_0x2E" 47 "PID_0x2F" 48 "PID_0x30" 49 "PID_0x31" 51 "PID_0x33" 52 "PID_0x34" 60 "PID_0x3C" 65 "PID_0x41" 66 "PID_0x42" 67 "PID_0x43" 68 "PID_0x44" 69 "PID_0x45" 70 "PID_0x46" 71 "PID_0x47" 73 "PID_0x49" 74 "PID_0x4A" 76 "PID_0x4C" 79 "PID_0x4F" 80 "PID_0x50" 81 "PID_0x51" 82 "PID_0x52" 86 "PID_0x56" 90 "PID_0x5A" 94 "PID_0x5E" 98 "PID_0x62" 99 "PID_0x63" 101 "PID_0x65" 102 "PID_0x66" 103 "PID_0x67" 104 "PID_0x68" 105 "PID_0x69" 106 "PID_0x6A" 107 "PID_0x6B" 108 "PID_0x6C" 109 "PID_0x6D" 110 "PID_0x6E" 111 "PID_0x6F" 112 "PID_0x70" 113 "PID_0x71" 114 "PID_0x72" 115 "PID_0x73" 116 "PID_0x74" 117 "PID_0x75" 118 "PID_0x76" 119 "PID_0x77" 120 "PID_0x78" 121 "PID_0x79" 122 "PID_0x7A" 123 "PID_0x7B" 124 "PID_0x7C" 127 "PID_0x7F" 129 "PID_0x81" 130 "PID_0x82" 131 "PID_0x83" 133 "PID_0x85" 134 "PID_0x86" 135 "PID_0x87" 137 "PID_0x89" 138 "PID_0x8A" 139 "PID_0x8B" 140 "PID_0x8C" 142 "PID_0x8E" 143 "PID_0x8F" 146 "PID_0x92" 147 "PID_0x93" 148 "PID_0x94" 152 "PID_0x98" 153 "PID_0x99" 154 "PID_0x9A" 155 "PID_0x9B" 156 "PID_0x9C" 157 "PID_0x9D" 159 "PID_0x9F" 161 "PID_0xA1" 163 "PID_0xA3" 164 "PID_0xA4" 165 "PID_0xA5" 166 "PID_0xA6" 167 "PID_0xA7" 168 "PID_0xA8" 169 "PID_0xA9" 172 "PID_0xAC" /end COMPU_VTAB
/begin COMPU_METHOD t20msxs_ub_b5p1 "" RAT_FUNC "%6.4" "s" COEFFS 0 1 0 0 0 0.02 /end COMPU_METHOD
/begin COMPU_METHOD TDC_UNEQLGEOM_SY_Compu "" TAB_VERB "%6.3" "" COMPU_TAB_REF TDC_UNEQLGEOM_SY_Compu /end COMPU_METHOD
/begin COMPU_VTAB TDC_UNEQLGEOM_SY_Compu "" TAB_VERB 2 0 "EQL_TDC" 1 "UNEQL_TDC" /end COMPU_VTAB
/begin COMPU_METHOD TDEV_DSQACTVT_SC_Compu "" TAB_VERB "%6.3" "" COMPU_TAB_REF TDEV_DSQACTVT_SC_Compu /end COMPU_METHOD
/begin COMPU_VTAB TDEV_DSQACTVT_SC_Compu "" TAB_VERB 2 0 "Inactive" 1 "Active" /end COMPU_VTAB
/begin COMPU_METHOD TDEV_VAR_SY_Compu "" TAB_VERB "%6.3" "" COMPU_TAB_REF TDEV_VAR_SY_Compu /end COMPU_METHOD
/begin COMPU_VTAB TDEV_VAR_SY_Compu "" TAB_VERB 46 1 "DAI" 3 "VWW" 4 "POR" 5 "AUD" 6 "OPE" 9 "FIA" 11 "BMW" 14 "PSA" 15 "REN" 17 "ALF" 18 "SAB" 19 "VOL" 20 "NIS" 21 "GMU" 22 "FOR" 26 "IMJ" 51 "SEA" 53 "CHR" 54 "JAG" 55 "ROL" 69 "FER" 72 "TOY" 112 "BMW-2wh" 123 "MIT" 147 "HYU" 159 "HON" 160 "MAZ" 183 "CU" 190 "LRG" 204 "VVW" 214 "AVT" 242 "Iveco" 243 "DMC" 248 "SUZ" 267 "SSANGYONG" 270 "KEF" 289 "AMG" 308 "TAT" 319 "MVM" 368 "Prince" 385 "UAES" 590 "Scania" 828 "RBCD" 999 "ALL" 2887 "Nonox" 9454 "Fuso" /end COMPU_VTAB
/begin COMPU_METHOD TDPDTCPVCTRL_SC_Compu "" TAB_VERB "%6.3" "" COMPU_TAB_REF TDPDTCPVCTRL_SC_Compu /end COMPU_METHOD
/begin COMPU_VTAB TDPDTCPVCTRL_SC_Compu "" TAB_VERB 2 0 "False" 1 "True" /end COMPU_VTAB
/begin COMPU_METHOD TECU_SMP480SENSPRS_SC_Compu "" TAB_VERB "%6.3" "" COMPU_TAB_REF TECU_SMP480SENSPRS_SC_Compu /end COMPU_METHOD
/begin COMPU_VTAB TECU_SMP480SENSPRS_SC_Compu "" TAB_VERB 2 0 "False" 1 "True" /end COMPU_VTAB
/begin COMPU_METHOD TECU_TMSGFMT_SC_Compu "" TAB_VERB "%6.3" "" COMPU_TAB_REF TECU_TMSGFMT_SC_Compu /end COMPU_METHOD
/begin COMPU_VTAB TECU_TMSGFMT_SC_Compu "" TAB_VERB 2 1 "MSG" 2 "MSG_ARRAY" /end COMPU_VTAB
/begin COMPU_METHOD TEGRCLR2DS_TYPAVL_SY_Compu "" TAB_VERB "%6.3" "" COMPU_TAB_REF TEGRCLR2DS_TYPAVL_SY_Compu /end COMPU_METHOD
/begin COMPU_VTAB TEGRCLR2DS_TYPAVL_SY_Compu "" TAB_VERB 2 0 "0" 1 "1" /end COMPU_VTAB
/begin COMPU_METHOD TEGRCLRDS_TYPAVL_SY_Compu "" TAB_VERB "%6.3" "" COMPU_TAB_REF TEGRCLRDS_TYPAVL_SY_Compu /end COMPU_METHOD
/begin COMPU_VTAB TEGRCLRDS_TYPAVL_SY_Compu "" TAB_VERB 2 0 "False" 1 "True" /end COMPU_VTAB
/begin COMPU_METHOD TEGRCLRLPDS_TYPAVL_SC_Compu "" TAB_VERB "%6.3" "" COMPU_TAB_REF TEGRCLRLPDS_TYPAVL_SC_Compu /end COMPU_METHOD
/begin COMPU_VTAB TEGRCLRLPDS_TYPAVL_SC_Compu "" TAB_VERB 2 0 "False" 1 "True" /end COMPU_VTAB
/begin COMPU_METHOD TEGRCLRUS_TYPAVL_SY_Compu "" TAB_VERB "%6.3" "" COMPU_TAB_REF TEGRCLRUS_TYPAVL_SY_Compu /end COMPU_METHOD
/begin COMPU_VTAB TEGRCLRUS_TYPAVL_SY_Compu "" TAB_VERB 2 0 "False" 1 "True" /end COMPU_VTAB
/begin COMPU_METHOD TEGRPIPUSSENS_SC_Compu "" TAB_VERB "%6.3" "" COMPU_TAB_REF TEGRPIPUSSENS_SC_Compu /end COMPU_METHOD
/begin COMPU_VTAB TEGRPIPUSSENS_SC_Compu "" TAB_VERB 3 0 "0" 1 "1" 2 "2" /end COMPU_VTAB
/begin COMPU_METHOD TEGRVLVHOTDS_TYPAVL_SC_Compu "" TAB_VERB "%6.3" "" COMPU_TAB_REF TEGRVLVHOTDS_TYPAVL_SC_Compu /end COMPU_METHOD
/begin COMPU_VTAB TEGRVLVHOTDS_TYPAVL_SC_Compu "" TAB_VERB 2 0 "False" 1 "True" /end COMPU_VTAB
/begin COMPU_METHOD Temp2Dyc_COMPU "" RAT_FUNC "%6.4" "deg C/%" COEFFS 0 100 0 0 0 1 /end COMPU_METHOD
/begin COMPU_METHOD TempDiff_Kelv_1K "" RAT_FUNC "%6.2" "K" COEFFS 0 1 0 0 0 1 /end COMPU_METHOD
/begin COMPU_METHOD Temp_Cels "" RAT_FUNC "%6.1" "deg C" COEFFS 0 10 2731.4 0 0 1 /end COMPU_METHOD
/begin COMPU_METHOD Temp_Cels1 "" RAT_FUNC "%6.1" "deg C" COEFFS 0 100 27314 0 0 1 /end COMPU_METHOD
/begin COMPU_METHOD Temp_Cels_1deg "" RAT_FUNC "%6.1" "deg C" COEFFS 0 1 273.14 0 0 1 /end COMPU_METHOD
/begin COMPU_METHOD Temp_Fahr "" RAT_FUNC "%6.1" "deg F" COEFFS 0 5.55555555555556 2553.62222222222 0 0 1 /end COMPU_METHOD
/begin COMPU_METHOD Temp_Kelv_Sec_CtT_Mon "" RAT_FUNC "%7.6" "deg C/s" COEFFS 0 40960 0 0 0 1 /end COMPU_METHOD
/begin COMPU_METHOD temp_q0p75_K "" RAT_FUNC "%6.3" "K" COEFFS 0 1 0 0 0 0.75 /end COMPU_METHOD
/begin COMPU_METHOD temp_q3p57Em7 "" RAT_FUNC "%9.8" "K" COEFFS 0 8388608 0 0 0 3 /end COMPU_METHOD
/begin COMPU_METHOD TFFVRES_SC_Compu "" TAB_VERB "%6.3" "" COMPU_TAB_REF TFFVRES_SC_Compu /end COMPU_METHOD
/begin COMPU_VTAB TFFVRES_SC_Compu "" TAB_VERB 2 0 "False" 1 "True" /end COMPU_VTAB
/begin COMPU_METHOD TFUELADAP_SC_Compu "" TAB_VERB "%6.3" "" COMPU_TAB_REF TFUELADAP_SC_Compu /end COMPU_METHOD
/begin COMPU_VTAB TFUELADAP_SC_Compu "" TAB_VERB 2 0 "0" 1 "1" /end COMPU_VTAB
/begin COMPU_METHOD THDEV_VAR_SY_Compu "" TAB_VERB "%6.3" "" COMPU_TAB_REF THDEV_VAR_SY_Compu /end COMPU_METHOD
/begin COMPU_VTAB THDEV_VAR_SY_Compu "" TAB_VERB 49 1 "DAI" 3 "VWW" 4 "POR" 5 "AUD" 6 "OPE" 9 "FIA" 11 "BMW" 14 "PSA" 15 "REN" 17 "ALF" 18 "SAB" 19 "VOL" 20 "NIS" 21 "GMU" 22 "FOR" 26 "IMJ" 51 "SEA" 53 "CHR" 54 "JAG" 55 "ROL" 69 "FER" 72 "TOY" 123 "MIT" 147 "HYU" 159 "HON" 160 "MAZ" 183 "CU" 190 "LRG" 204 "VVW" 214 "AVT" 242 "Iveco" 243 "DMC" 248 "SUZ" 267 "SSANGYONG" 270 "KEF" 289 "AMG" 308 "TAT" 319 "MVM" 328 "MM" 385 "UAES" 590 "Scania" 760 "WEICHAI" 828 "RBCD" 858 "Kubota" 973 "Yanmar Japan" 999 "ALL" 2887 "Nonox" 9454 "Fuso" 9797 "Mitsubishi Heavy Industr" /end COMPU_VTAB
/begin COMPU_METHOD ThermalCoEff "" RAT_FUNC "%6.3" "W/m/m/k" COEFFS 0 10 0 0 0 1 /end COMPU_METHOD
/begin COMPU_METHOD THERMCOORNENGTQRESVENA_SC_Compu "" TAB_VERB "%6.3" "" COMPU_TAB_REF THERMCOORNENGTQRESVENA_SC_Compu /end COMPU_METHOD
/begin COMPU_VTAB THERMCOORNENGTQRESVENA_SC_Compu "" TAB_VERB 2 0 "False" 1 "True" /end COMPU_VTAB
/begin COMPU_METHOD ThmCnd "" RAT_FUNC "%6.5" "W/m/K" COEFFS 0 1000 0 0 0 1 /end COMPU_METHOD
/begin COMPU_METHOD THROVRHEATGPROTN_SC_Compu "" TAB_VERB "%6.3" "" COMPU_TAB_REF THROVRHEATGPROTN_SC_Compu /end COMPU_METHOD
/begin COMPU_VTAB THROVRHEATGPROTN_SC_Compu "" TAB_VERB 2 0 "False" 1 "True" /end COMPU_VTAB
/begin COMPU_METHOD THRVLVAIRACTR_SC_Compu "" TAB_VERB "%6.3" "" COMPU_TAB_REF THRVLVAIRACTR_SC_Compu /end COMPU_METHOD
/begin COMPU_VTAB THRVLVAIRACTR_SC_Compu "" TAB_VERB 2 0 "False" 1 "True" /end COMPU_VTAB
/begin COMPU_METHOD THRVLVCONTMN_SC_Compu "" TAB_VERB "%6.3" "" COMPU_TAB_REF THRVLVCONTMN_SC_Compu /end COMPU_METHOD
/begin COMPU_VTAB THRVLVCONTMN_SC_Compu "" TAB_VERB 2 0 "False" 1 "True" /end COMPU_VTAB
/begin COMPU_METHOD THRVLVI_TYPAVL_SC_Compu "" TAB_VERB "%6.3" "" COMPU_TAB_REF THRVLVI_TYPAVL_SC_Compu /end COMPU_METHOD
/begin COMPU_VTAB THRVLVI_TYPAVL_SC_Compu "" TAB_VERB 2 0 "False" 1 "True" /end COMPU_VTAB
/begin COMPU_METHOD THRVLVLP_AIRACTR_SC_Compu "" TAB_VERB "%6.3" "" COMPU_TAB_REF THRVLVLP_AIRACTR_SC_Compu /end COMPU_METHOD
/begin COMPU_VTAB THRVLVLP_AIRACTR_SC_Compu "" TAB_VERB 2 0 "0" 1 "1" /end COMPU_VTAB
/begin COMPU_METHOD THRVLVLP_STUCKPOSNDETN_SC_Compu "" TAB_VERB "%6.3" "" COMPU_TAB_REF THRVLVLP_STUCKPOSNDETN_SC_Compu /end COMPU_METHOD
/begin COMPU_VTAB THRVLVLP_STUCKPOSNDETN_SC_Compu "" TAB_VERB 2 0 "Disable" 1 "Enable" /end COMPU_VTAB
/begin COMPU_METHOD THRVLVPROD_SY_Compu "" TAB_VERB "%6.3" "" COMPU_TAB_REF THRVLVPROD_SY_Compu /end COMPU_METHOD
/begin COMPU_VTAB THRVLVPROD_SY_Compu "" TAB_VERB 2 0 "RBTHRVLV" 1 "VISTTHRVLV" /end COMPU_VTAB
/begin COMPU_METHOD THRVLVSNGSNSR_SC_Compu "" TAB_VERB "%6.3" "" COMPU_TAB_REF THRVLVSNGSNSR_SC_Compu /end COMPU_METHOD
/begin COMPU_VTAB THRVLVSNGSNSR_SC_Compu "" TAB_VERB 2 0 "0" 1 "1" /end COMPU_VTAB
/begin COMPU_METHOD THRVLVUST_TYPAVL_SC_Compu "" TAB_VERB "%6.3" "" COMPU_TAB_REF THRVLVUST_TYPAVL_SC_Compu /end COMPU_METHOD
/begin COMPU_VTAB THRVLVUST_TYPAVL_SC_Compu "" TAB_VERB 2 0 "False" 1 "True" /end COMPU_VTAB
/begin COMPU_METHOD THRVLV_AGLIMDAMON_SC_Compu "" TAB_VERB "%6.3" "" COMPU_TAB_REF THRVLV_AGLIMDAMON_SC_Compu /end COMPU_METHOD
/begin COMPU_VTAB THRVLV_AGLIMDAMON_SC_Compu "" TAB_VERB 2 0 "False" 1 "True" /end COMPU_VTAB
/begin COMPU_METHOD THRVLV_ATSENA_SC_Compu "" TAB_VERB "%6.3" "" COMPU_TAB_REF THRVLV_ATSENA_SC_Compu /end COMPU_METHOD
/begin COMPU_VTAB THRVLV_ATSENA_SC_Compu "" TAB_VERB 2 0 "False" 1 "True" /end COMPU_VTAB
/begin COMPU_METHOD THRVLV_BLDCMOT_SC_Compu "" TAB_VERB "%6.3" "" COMPU_TAB_REF THRVLV_BLDCMOT_SC_Compu /end COMPU_METHOD
/begin COMPU_VTAB THRVLV_BLDCMOT_SC_Compu "" TAB_VERB 2 0 "inactive" 1 "active" /end COMPU_VTAB
/begin COMPU_METHOD THRVLV_CLNVRFY_SY_Compu "" TAB_VERB "%6.3" "" COMPU_TAB_REF THRVLV_CLNVRFY_SY_Compu /end COMPU_METHOD
/begin COMPU_VTAB THRVLV_CLNVRFY_SY_Compu "" TAB_VERB 2 0 "False" 1 "True" /end COMPU_VTAB
/begin COMPU_METHOD THRVLV_DCMOT_SC_Compu "" TAB_VERB "%6.3" "" COMPU_TAB_REF THRVLV_DCMOT_SC_Compu /end COMPU_METHOD
/begin COMPU_VTAB THRVLV_DCMOT_SC_Compu "" TAB_VERB 2 0 "inactive" 1 "active" /end COMPU_VTAB
/begin COMPU_METHOD THRVLV_DEDIA_SC_Compu "" TAB_VERB "%6.3" "" COMPU_TAB_REF THRVLV_DEDIA_SC_Compu /end COMPU_METHOD
/begin COMPU_VTAB THRVLV_DEDIA_SC_Compu "" TAB_VERB 2 0 "False" 1 "True" /end COMPU_VTAB
/begin COMPU_METHOD THRVLV_ENAHBRDGSPLYCHK_SC_Compu "" TAB_VERB "%6.3" "" COMPU_TAB_REF THRVLV_ENAHBRDGSPLYCHK_SC_Compu /end COMPU_METHOD
/begin COMPU_VTAB THRVLV_ENAHBRDGSPLYCHK_SC_Compu "" TAB_VERB 2 0 "Disable" 1 "Enable" /end COMPU_VTAB
/begin COMPU_METHOD THRVLV_ENASENTFBSEPSIGLINE_SC_Compu "" TAB_VERB "%6.3" "" COMPU_TAB_REF THRVLV_ENASENTFBSEPSIGLINE_SC_Compu /end COMPU_METHOD
/begin COMPU_VTAB THRVLV_ENASENTFBSEPSIGLINE_SC_Compu "" TAB_VERB 2 0 "False" 1 "True" /end COMPU_VTAB
/begin COMPU_METHOD THRVLV_ENGSPDACTRSPENA_SC_Compu "" TAB_VERB "%6.3" "" COMPU_TAB_REF THRVLV_ENGSPDACTRSPENA_SC_Compu /end COMPU_METHOD
/begin COMPU_VTAB THRVLV_ENGSPDACTRSPENA_SC_Compu "" TAB_VERB 2 0 "False" 1 "True" /end COMPU_VTAB
/begin COMPU_METHOD THRVLV_ENHDICERMVMOD_SC_Compu "" TAB_VERB "%6.3" "" COMPU_TAB_REF THRVLV_ENHDICERMVMOD_SC_Compu /end COMPU_METHOD
/begin COMPU_VTAB THRVLV_ENHDICERMVMOD_SC_Compu "" TAB_VERB 5 0 "Disable" 1 "PRE_DRV" 2 "T15_ON_STRT_INJ_SUPP" 3 "T15_ON_INJ_SUPP" 4 "T15_ON_STRT_INJ_RELD" /end COMPU_VTAB
/begin COMPU_METHOD THRVLV_ICECHKATENGRUN_SC_Compu "" TAB_VERB "%6.3" "" COMPU_TAB_REF THRVLV_ICECHKATENGRUN_SC_Compu /end COMPU_METHOD
/begin COMPU_VTAB THRVLV_ICECHKATENGRUN_SC_Compu "" TAB_VERB 2 0 "False" 1 "True" /end COMPU_VTAB
/begin COMPU_METHOD THRVLV_IOSIGHALFBRDG_SC_Compu "" TAB_VERB "%6.3" "" COMPU_TAB_REF THRVLV_IOSIGHALFBRDG_SC_Compu /end COMPU_METHOD
/begin COMPU_VTAB THRVLV_IOSIGHALFBRDG_SC_Compu "" TAB_VERB 2 0 "False" 1 "True" /end COMPU_VTAB
/begin COMPU_METHOD THRVLV_LIMPAIRPOSNFCTENA_SC_Compu "" TAB_VERB "%6.3" "" COMPU_TAB_REF THRVLV_LIMPAIRPOSNFCTENA_SC_Compu /end COMPU_METHOD
/begin COMPU_VTAB THRVLV_LIMPAIRPOSNFCTENA_SC_Compu "" TAB_VERB 2 0 "False" 1 "True" /end COMPU_VTAB
/begin COMPU_METHOD THRVLV_OPENPOSNLRN_SC_Compu "" TAB_VERB "%6.3" "" COMPU_TAB_REF THRVLV_OPENPOSNLRN_SC_Compu /end COMPU_METHOD
/begin COMPU_VTAB THRVLV_OPENPOSNLRN_SC_Compu "" TAB_VERB 2 0 "False" 1 "True" /end COMPU_VTAB
/begin COMPU_METHOD THRVLV_PARLCHRGCTRL_SC_Compu "" TAB_VERB "%6.3" "" COMPU_TAB_REF THRVLV_PARLCHRGCTRL_SC_Compu /end COMPU_METHOD
/begin COMPU_VTAB THRVLV_PARLCHRGCTRL_SC_Compu "" TAB_VERB 2 0 "False" 1 "True" /end COMPU_VTAB
/begin COMPU_METHOD THRVLV_PHYSRNGCHK_SY_Compu "" TAB_VERB "%6.3" "" COMPU_TAB_REF THRVLV_PHYSRNGCHK_SY_Compu /end COMPU_METHOD
/begin COMPU_VTAB THRVLV_PHYSRNGCHK_SY_Compu "" TAB_VERB 2 0 "False" 1 "True" /end COMPU_VTAB
/begin COMPU_METHOD THRVLV_SENTENA_SC_Compu "" TAB_VERB "%6.3" "" COMPU_TAB_REF THRVLV_SENTENA_SC_Compu /end COMPU_METHOD
/begin COMPU_VTAB THRVLV_SENTENA_SC_Compu "" TAB_VERB 2 0 "False" 1 "True" /end COMPU_VTAB
/begin COMPU_METHOD THRVLV_SNSRDRIFTCMP_SC_Compu "" TAB_VERB "%6.3" "" COMPU_TAB_REF THRVLV_SNSRDRIFTCMP_SC_Compu /end COMPU_METHOD
/begin COMPU_VTAB THRVLV_SNSRDRIFTCMP_SC_Compu "" TAB_VERB 2 0 "DISABLED" 1 "ENABLED" /end COMPU_VTAB
/begin COMPU_METHOD THRVLV_SNSRSPLYB2_SC_Compu "" TAB_VERB "%6.3" "" COMPU_TAB_REF THRVLV_SNSRSPLYB2_SC_Compu /end COMPU_METHOD
/begin COMPU_VTAB THRVLV_SNSRSPLYB2_SC_Compu "" TAB_VERB 9 0 "Powersupply diagnosis deactivated" 1 "Throttle sensors connected to powerstage1" 2 "Throttle sensors connected to powerstage2" 3 "Throttle sensors connected to powerstage3" 4 "Throttle sensors connected to powerstage 4" 5 "Throttle sensors connected to powerstage 5" 6 "Throttle sensors connected to powerstage 6" 7 "Throttle sensors connected to powerstage 7" 8 "Throttle sensors connected to powerstage 8" /end COMPU_VTAB
/begin COMPU_METHOD THRVLV_SNSRSPLY_SC_Compu "" TAB_VERB "%6.3" "" COMPU_TAB_REF THRVLV_SNSRSPLY_SC_Compu /end COMPU_METHOD
/begin COMPU_VTAB THRVLV_SNSRSPLY_SC_Compu "" TAB_VERB 9 0 "Powersupply diagnosis deactivated" 1 "Throttle sensors connected to powerstage1" 2 "Throttle sensors connected to powerstage2" 3 "Throttle sensors connected to powerstage3" 4 "Throttle sensors connected to powerstage 4" 5 "Throttle sensors connected to powerstage 5" 6 "Throttle sensors connected to powerstage 6" 7 "Throttle sensors connected to powerstage 7" 8 "Throttle sensors connected to powerstage 8" /end COMPU_VTAB
/begin COMPU_METHOD THRVLV_TWNDESVAL_SC_Compu "" TAB_VERB "%6.3" "" COMPU_TAB_REF THRVLV_TWNDESVAL_SC_Compu /end COMPU_METHOD
/begin COMPU_VTAB THRVLV_TWNDESVAL_SC_Compu "" TAB_VERB 2 0 "False" 1 "True" /end COMPU_VTAB
/begin COMPU_METHOD THRVLV_TYPTWINFLW_SY_Compu "" TAB_VERB "%6.3" "" COMPU_TAB_REF THRVLV_TYPTWINFLW_SY_Compu /end COMPU_METHOD
/begin COMPU_VTAB THRVLV_TYPTWINFLW_SY_Compu "" TAB_VERB 2 0 "0" 1 "1" /end COMPU_VTAB
/begin COMPU_METHOD THS_COOLTMFEXHMNFLD_SC_Compu "" TAB_VERB "%6.3" "" COMPU_TAB_REF THS_COOLTMFEXHMNFLD_SC_Compu /end COMPU_METHOD
/begin COMPU_VTAB THS_COOLTMFEXHMNFLD_SC_Compu "" TAB_VERB 2 0 "NO" 1 "MODELED" /end COMPU_VTAB
/begin COMPU_METHOD THS_GBXVLVDIAG_SC_Compu "" TAB_VERB "%6.3" "" COMPU_TAB_REF THS_GBXVLVDIAG_SC_Compu /end COMPU_METHOD
/begin COMPU_VTAB THS_GBXVLVDIAG_SC_Compu "" TAB_VERB 2 0 "False" 1 "True" /end COMPU_VTAB
/begin COMPU_METHOD THS_VAR_SY_Compu "" TAB_VERB "%6.3" "" COMPU_TAB_REF THS_VAR_SY_Compu /end COMPU_METHOD
/begin COMPU_VTAB THS_VAR_SY_Compu "" TAB_VERB 45 1 "DAI" 3 "VWW" 4 "POR" 5 "AUD" 6 "OPE" 9 "FIA" 11 "BMW" 14 "PSA" 15 "REN" 17 "ALF" 18 "SAB" 19 "VOL" 20 "NIS" 21 "GMU" 22 "FOR" 26 "IMJ" 51 "SEA" 53 "CHR" 54 "JAG" 55 "ROL" 69 "FER" 72 "TOY" 123 "MIT" 147 "HYU" 159 "HON" 160 "MAZ" 183 "CU" 190 "LRG" 204 "VVW" 214 "AVT" 242 "Iveco" 243 "DMC" 248 "SUZ" 267 "SSANGYONG" 270 "KEF" 289 "AMG" 308 "TAT" 319 "MVM" 328 "MM" 385 "UAES" 590 "Scania" 760 "WEICHAI" 828 "RBCD" 999 "ALL" 9454 "Fuso" /end COMPU_VTAB
/begin COMPU_METHOD TIBASDCMB_SC_Compu "" TAB_VERB "%6.3" "" COMPU_TAB_REF TIBASDCMB_SC_Compu /end COMPU_METHOD
/begin COMPU_VTAB TIBASDCMB_SC_Compu "" TAB_VERB 2 0 "False" 1 "True" /end COMPU_VTAB
/begin COMPU_METHOD TIINJCORRNCUSTACTV_SC_Compu "" TAB_VERB "%6.3" "" COMPU_TAB_REF TIINJCORRNCUSTACTV_SC_Compu /end COMPU_METHOD
/begin COMPU_VTAB TIINJCORRNCUSTACTV_SC_Compu "" TAB_VERB 2 0 "not_active" 1 "active" /end COMPU_VTAB
/begin COMPU_METHOD Time100HrsEngOn "" RAT_FUNC "%6.2" "[100h]" COEFFS 0 1 0 0 0 1 /end COMPU_METHOD
/begin COMPU_METHOD TimeDeb "" RAT_FUNC "%6.1" "ms" COEFFS 0 0.1 0 0 0 1 /end COMPU_METHOD
/begin COMPU_METHOD TimeDelay_s "" RAT_FUNC "%6.1" "s" COEFFS 0 0 1 0 0.00023283064365387 0 /end COMPU_METHOD
/begin COMPU_METHOD TimeRed "" RAT_FUNC "%6.3" "s" COEFFS 0 6.25 0 0 0 1 /end COMPU_METHOD
/begin COMPU_METHOD Time_Dt "" RAT_FUNC "%9.8" "s" COEFFS 0 1000000 0 0 0 1 /end COMPU_METHOD
/begin COMPU_METHOD Time_ms "" RAT_FUNC "%6.1" "ms" COEFFS 0 0.1 0 0 0 1 /end COMPU_METHOD
/begin COMPU_METHOD Time_ms_100ms "" RAT_FUNC "%6.0" "ms" COEFFS 0 0.01 0 0 0 1 /end COMPU_METHOD
/begin COMPU_METHOD Time_s "" RAT_FUNC "%6.4" "s" COEFFS 0 100 0 0 0 1 /end COMPU_METHOD
/begin COMPU_METHOD Time_Second "" RAT_FUNC "%6.2" "s" COEFFS 0 1 0 0 0 1 /end COMPU_METHOD
/begin COMPU_METHOD TransR "" RAT_FUNC "%6.4" "-" COEFFS 0 100 0 0 0 1 /end COMPU_METHOD
/begin COMPU_METHOD Trq "" RAT_FUNC "%6.3" "Nm" COEFFS 0 10 0 0 0 1 /end COMPU_METHOD
/begin COMPU_METHOD TrqHigh "" RAT_FUNC "%6.5" "Nm" COEFFS 0 1000 0 0 0 1 /end COMPU_METHOD
/begin COMPU_METHOD TrqHigh_q0p01 "" RAT_FUNC "%6.4" "Nm" COEFFS 0 100 0 0 0 1 /end COMPU_METHOD
/begin COMPU_METHOD TrqPerSec "" RAT_FUNC "%6.2" "Nm/s" COEFFS 0 1 0 0 0 1 /end COMPU_METHOD
/begin COMPU_METHOD trq_q0p1 "" RAT_FUNC "%6.3" "Nm" COEFFS 0 10 0 0 0 1 /end COMPU_METHOD
/begin COMPU_METHOD t_q0p000122 "" RAT_FUNC "%6.5" "s" COEFFS 0 65536 0 0 0 8 /end COMPU_METHOD
/begin COMPU_METHOD t_q0p01 "" RAT_FUNC "%6.4" "s" COEFFS 0 100 0 0 0 1 /end COMPU_METHOD
/begin COMPU_METHOD t_q0p02 "" RAT_FUNC "%6.4" "s" COEFFS 0 100 0 0 0 2 /end COMPU_METHOD
/begin COMPU_METHOD Vel "" RAT_FUNC "%6.4" "km/h" COEFFS 0 100 0 0 0 1 /end COMPU_METHOD
/begin COMPU_METHOD vfzg_uw_b325 "" RAT_FUNC "%6.4" "km/h" COEFFS 0 65536 0 0 0 325 /end COMPU_METHOD
/begin COMPU_METHOD Volt "" RAT_FUNC "%6.3" "mV" COEFFS 0 5 0 0 0 1 /end COMPU_METHOD
/begin COMPU_METHOD Volt_Batt "" RAT_FUNC "%6.1" "mV" COEFFS 0 0.05 0 0 0 1 /end COMPU_METHOD
/begin RECORD_LAYOUT Kw_Ws16 FNC_VALUES 1 SWORD COLUMN_DIR DIRECT /end RECORD_LAYOUT
/begin RECORD_LAYOUT RB_Axis_S16 NO_AXIS_PTS_X 1 SWORD AXIS_PTS_X 2 SWORD INDEX_INCR DIRECT /end RECORD_LAYOUT
/begin RECORD_LAYOUT RB_Axis_S8 NO_AXIS_PTS_X 1 SBYTE AXIS_PTS_X 2 SBYTE INDEX_INCR DIRECT /end RECORD_LAYOUT
/begin RECORD_LAYOUT RB_Curve_S16_S16 NO_AXIS_PTS_X 1 SWORD AXIS_PTS_X 2 SWORD INDEX_INCR DIRECT FNC_VALUES 3 SWORD COLUMN_DIR DIRECT /end RECORD_LAYOUT
/begin RECORD_LAYOUT RB_Curve_S16_U16_Static NO_AXIS_PTS_X 1 SWORD AXIS_PTS_X 2 SWORD INDEX_INCR DIRECT FNC_VALUES 3 UWORD COLUMN_DIR DIRECT STATIC_RECORD_LAYOUT /end RECORD_LAYOUT
/begin RECORD_LAYOUT RB_Curve_S8_S16_Static NO_AXIS_PTS_X 1 SBYTE AXIS_PTS_X 2 SBYTE INDEX_INCR DIRECT FNC_VALUES 3 SWORD COLUMN_DIR DIRECT STATIC_RECORD_LAYOUT /end RECORD_LAYOUT
/begin RECORD_LAYOUT RB_Kw_Wu8 FNC_VALUES 1 UBYTE COLUMN_DIR DIRECT /end RECORD_LAYOUT
/begin RECORD_LAYOUT RB_MapGroup_U16 FNC_VALUES 1 UWORD COLUMN_DIR DIRECT /end RECORD_LAYOUT
/begin RECORD_LAYOUT RB_MapGroup_U8 FNC_VALUES 1 UBYTE COLUMN_DIR DIRECT /end RECORD_LAYOUT
/begin RECORD_LAYOUT RB_Map_S16S16_S16 NO_AXIS_PTS_X 1 SWORD NO_AXIS_PTS_Y 2 SWORD AXIS_PTS_X 3 SWORD INDEX_INCR DIRECT AXIS_PTS_Y 4 SWORD INDEX_INCR DIRECT FNC_VALUES 5 SWORD COLUMN_DIR DIRECT /end RECORD_LAYOUT
/begin RECORD_LAYOUT RB_Val_Wboolean FNC_VALUES 1 UBYTE COLUMN_DIR DIRECT /end RECORD_LAYOUT
/begin RECORD_LAYOUT RB_Val_Ws16 FNC_VALUES 1 SWORD COLUMN_DIR DIRECT /end RECORD_LAYOUT
/begin RECORD_LAYOUT RB_Val_Ws32 FNC_VALUES 1 SLONG COLUMN_DIR DIRECT /end RECORD_LAYOUT
/begin RECORD_LAYOUT RB_Val_Ws8 FNC_VALUES 1 SBYTE COLUMN_DIR DIRECT /end RECORD_LAYOUT
/begin RECORD_LAYOUT RB_Val_Wu16 FNC_VALUES 1 UWORD COLUMN_DIR DIRECT /end RECORD_LAYOUT
/begin RECORD_LAYOUT RB_Val_Wu32 FNC_VALUES 1 ULONG COLUMN_DIR DIRECT /end RECORD_LAYOUT
/begin RECORD_LAYOUT RB_Val_Wu8 FNC_VALUES 1 UBYTE COLUMN_DIR DIRECT /end RECORD_LAYOUT
/begin RECORD_LAYOUT ValA_Wu16 FNC_VALUES 1 UWORD COLUMN_DIR DIRECT /end RECORD_LAYOUT
/begin RECORD_LAYOUT ValA_Wu8 FNC_VALUES 1 UBYTE COLUMN_DIR DIRECT /end RECORD_LAYOUT
/begin RECORD_LAYOUT Val_Wu8 FNC_VALUES 1 UBYTE COLUMN_DIR DIRECT /end RECORD_LAYOUT
/end MODULE
/end PROJECT
