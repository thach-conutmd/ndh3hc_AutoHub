ASAP2_VERSION 1 60
/begin PROJECT MG1CS022 "MG1CS022"
/begin HEADER "" VERSION "MG1CS022_62XSC_V037_TPROT" PROJECT_NO MG1CS022 /end HEADER
/begin MODULE DIM ""
/begin MOD_COMMON "" BYTE_ORDER MSB_LAST ALIGNMENT_BYTE 1 ALIGNMENT_WORD 2 ALIGNMENT_LONG 4 ALIGNMENT_INT64 4 ALIGNMENT_FLOAT32_IEEE 4 ALIGNMENT_FLOAT64_IEEE 4 DATA_SIZE 32 /end MOD_COMMON
/begin CHARACTERISTIC DFES_Cls.DFC_MOXEMM_SMU_ALM6_5_C "fault class per DFC / Fault class for check DFC_MOXEMM_SMU_ALM6_5" VALUE 0x804D96DB Val_Wu8 30.00 DFES_OneToOne 0.00 30.00 FORMAT "%5.2" EXTENDED_LIMITS 0.00 255.0 /end CHARACTERISTIC
/begin CHARACTERISTIC DFES_Cls.DFC_MOXEMM_SMU_ALM6_7_C "fault class per DFC / Fault class for check DFC_MOXEMM_SMU_ALM6_7" VALUE 0x804D96DC Val_Wu8 30.00 DFES_OneToOne 0.00 30.00 FORMAT "%5.2" EXTENDED_LIMITS 0.00 255.0 /end CHARACTERISTIC
/begin CHARACTERISTIC DFES_Cls.DFC_MOXEMM_SMU_ALM6_8_C "fault class per DFC / Fault class for check DFC_MOXEMM_SMU_ALM6_8" VALUE 0x804D96DD Val_Wu8 30.00 DFES_OneToOne 0.00 30.00 FORMAT "%5.2" EXTENDED_LIMITS 0.00 255.0 /end CHARACTERISTIC
/begin CHARACTERISTIC DFES_Cls.DFC_MOXEMM_SMU_ALM7_1_C "fault class per DFC / Fault class for check DFC_MOXEMM_SMU_ALM7_1" VALUE 0x804D96DE Val_Wu8 30.00 DFES_OneToOne 0.00 30.00 FORMAT "%5.2" EXTENDED_LIMITS 0.00 255.0 /end CHARACTERISTIC
/begin CHARACTERISTIC DFES_Cls.DFC_MOXEMM_SMU_ALM7_12_C "fault class per DFC / Fault class for check DFC_MOXEMM_SMU_ALM7_12" VALUE 0x804D96DF Val_Wu8 30.00 DFES_OneToOne 0.00 30.00 FORMAT "%5.2" EXTENDED_LIMITS 0.00 255.0 /end CHARACTERISTIC
/begin CHARACTERISTIC DFES_Cls.DFC_MOXEMM_SMU_ALM7_13_C "fault class per DFC / Fault class for check DFC_MOXEMM_SMU_ALM7_13" VALUE 0x804D96E0 Val_Wu8 30.00 DFES_OneToOne 0.00 30.00 FORMAT "%5.2" EXTENDED_LIMITS 0.00 255.0 /end CHARACTERISTIC
/begin CHARACTERISTIC DFES_Cls.DFC_MOXEMM_SMU_ALM7_14_C "fault class per DFC / Fault class for check DFC_MOXEMM_SMU_ALM7_14" VALUE 0x804D96E1 Val_Wu8 30.00 DFES_OneToOne 0.00 30.00 FORMAT "%5.2" EXTENDED_LIMITS 0.00 255.0 /end CHARACTERISTIC
/begin CHARACTERISTIC DFES_Cls.DFC_MOXEMM_SMU_ALM7_15_C "fault class per DFC / Fault class for check DFC_MOXEMM_SMU_ALM7_15" VALUE 0x804D96E2 Val_Wu8 30.00 DFES_OneToOne 0.00 30.00 FORMAT "%5.2" EXTENDED_LIMITS 0.00 255.0 /end CHARACTERISTIC
/begin CHARACTERISTIC DFES_Cls.DFC_MOXEMM_SMU_ALM7_16_C "fault class per DFC / Fault class for check DFC_MOXEMM_SMU_ALM7_16" VALUE 0x804D96E3 Val_Wu8 30.00 DFES_OneToOne 0.00 30.00 FORMAT "%5.2" EXTENDED_LIMITS 0.00 255.0 /end CHARACTERISTIC
/begin CHARACTERISTIC DFES_Cls.DFC_MOXEMM_SMU_ALM7_17_C "fault class per DFC / Fault class for check DFC_MOXEMM_SMU_ALM7_17" VALUE 0x804D96E4 Val_Wu8 30.00 DFES_OneToOne 0.00 30.00 FORMAT "%5.2" EXTENDED_LIMITS 0.00 255.0 /end CHARACTERISTIC
/begin CHARACTERISTIC DFES_Cls.DFC_MOXEMM_SMU_ALM7_2_C "fault class per DFC / Fault class for check DFC_MOXEMM_SMU_ALM7_2" VALUE 0x804D96E5 Val_Wu8 30.00 DFES_OneToOne 0.00 30.00 FORMAT "%5.2" EXTENDED_LIMITS 0.00 255.0 /end CHARACTERISTIC
/begin CHARACTERISTIC DFES_Cls.DFC_MOXEMM_SMU_ALM7_20_C "fault class per DFC / Fault class for check DFC_MOXEMM_SMU_ALM7_20" VALUE 0x804D96E6 Val_Wu8 30.00 DFES_OneToOne 0.00 30.00 FORMAT "%5.2" EXTENDED_LIMITS 0.00 255.0 /end CHARACTERISTIC
/begin CHARACTERISTIC DFES_Cls.DFC_MOXEMM_SMU_ALM7_25_C "fault class per DFC / Fault class for check DFC_MOXEMM_SMU_ALM7_25" VALUE 0x804D96E7 Val_Wu8 30.00 DFES_OneToOne 0.00 30.00 FORMAT "%5.2" EXTENDED_LIMITS 0.00 255.0 /end CHARACTERISTIC
/begin CHARACTERISTIC DFES_Cls.DFC_MOXEMM_SMU_ALM7_26_C "fault class per DFC / Fault class for check DFC_MOXEMM_SMU_ALM7_26" VALUE 0x804D96E8 Val_Wu8 30.00 DFES_OneToOne 0.00 30.00 FORMAT "%5.2" EXTENDED_LIMITS 0.00 255.0 /end CHARACTERISTIC
/begin CHARACTERISTIC DFES_Cls.DFC_MOXEMM_SMU_ALM7_28_C "fault class per DFC / Fault class for check DFC_MOXEMM_SMU_ALM7_28" VALUE 0x804D96E9 Val_Wu8 30.00 DFES_OneToOne 0.00 30.00 FORMAT "%5.2" EXTENDED_LIMITS 0.00 255.0 /end CHARACTERISTIC
/begin CHARACTERISTIC DFES_Cls.DFC_MOXEMM_SMU_ALM7_29_C "fault class per DFC / Fault class for check DFC_MOXEMM_SMU_ALM7_29" VALUE 0x804D96EA Val_Wu8 30.00 DFES_OneToOne 0.00 30.00 FORMAT "%5.2" EXTENDED_LIMITS 0.00 255.0 /end CHARACTERISTIC
/begin CHARACTERISTIC DFES_Cls.DFC_MOXEMM_SMU_ALM7_30_C "fault class per DFC / Fault class for check DFC_MOXEMM_SMU_ALM7_30" VALUE 0x804D96EB Val_Wu8 30.00 DFES_OneToOne 0.00 30.00 FORMAT "%5.2" EXTENDED_LIMITS 0.00 255.0 /end CHARACTERISTIC
/begin CHARACTERISTIC DFES_Cls.DFC_MOXEMM_SMU_ALM7_31_C "fault class per DFC / Fault class for check DFC_MOXEMM_SMU_ALM7_31" VALUE 0x804D96EC Val_Wu8 30.00 DFES_OneToOne 0.00 30.00 FORMAT "%5.2" EXTENDED_LIMITS 0.00 255.0 /end CHARACTERISTIC
/begin CHARACTERISTIC DFES_Cls.DFC_MOXEMM_SMU_ALM8_0_C "fault class per DFC / Fault class for check DFC_MOXEMM_SMU_ALM8_0" VALUE 0x804D96ED Val_Wu8 30.00 DFES_OneToOne 0.00 30.00 FORMAT "%5.2" EXTENDED_LIMITS 0.00 255.0 /end CHARACTERISTIC
/begin CHARACTERISTIC DFES_Cls.DFC_MOXEMM_SMU_ALM8_1_C "fault class per DFC / Fault class for check DFC_MOXEMM_SMU_ALM8_1" VALUE 0x804D96EE Val_Wu8 30.00 DFES_OneToOne 0.00 30.00 FORMAT "%5.2" EXTENDED_LIMITS 0.00 255.0 /end CHARACTERISTIC
/begin CHARACTERISTIC DFES_Cls.DFC_MOXEMM_SMU_ALM8_10_C "fault class per DFC / Fault class for check DFC_MOXEMM_SMU_ALM8_10" VALUE 0x804D96EF Val_Wu8 30.00 DFES_OneToOne 0.00 30.00 FORMAT "%5.2" EXTENDED_LIMITS 0.00 255.0 /end CHARACTERISTIC
/begin CHARACTERISTIC DFES_Cls.DFC_MOXEMM_SMU_ALM8_11_C "fault class per DFC / Fault class for check DFC_MOXEMM_SMU_ALM8_11" VALUE 0x804D96F0 Val_Wu8 30.00 DFES_OneToOne 0.00 30.00 FORMAT "%5.2" EXTENDED_LIMITS 0.00 255.0 /end CHARACTERISTIC
/begin CHARACTERISTIC DFES_Cls.DFC_MOXEMM_SMU_ALM8_12_C "fault class per DFC / Fault class for check DFC_MOXEMM_SMU_ALM8_12" VALUE 0x804D96F1 Val_Wu8 30.00 DFES_OneToOne 0.00 30.00 FORMAT "%5.2" EXTENDED_LIMITS 0.00 255.0 /end CHARACTERISTIC
/begin CHARACTERISTIC DFES_Cls.DFC_MOXEMM_SMU_ALM8_16_C "fault class per DFC / Fault class for check DFC_MOXEMM_SMU_ALM8_16" VALUE 0x804D96F2 Val_Wu8 30.00 DFES_OneToOne 0.00 30.00 FORMAT "%5.2" EXTENDED_LIMITS 0.00 255.0 /end CHARACTERISTIC
/begin CHARACTERISTIC DFES_Cls.DFC_MOXEMM_SMU_ALM8_18_C "fault class per DFC / Fault class for check DFC_MOXEMM_SMU_ALM8_18" VALUE 0x804D96F3 Val_Wu8 30.00 DFES_OneToOne 0.00 30.00 FORMAT "%5.2" EXTENDED_LIMITS 0.00 255.0 /end CHARACTERISTIC
/begin CHARACTERISTIC DFES_Cls.DFC_MOXEMM_SMU_ALM8_2_C "fault class per DFC / Fault class for check DFC_MOXEMM_SMU_ALM8_2" VALUE 0x804D96F4 Val_Wu8 30.00 DFES_OneToOne 0.00 30.00 FORMAT "%5.2" EXTENDED_LIMITS 0.00 255.0 /end CHARACTERISTIC
/begin CHARACTERISTIC DFES_Cls.DFC_MOXEMM_SMU_ALM8_3_C "fault class per DFC / Fault class for check DFC_MOXEMM_SMU_ALM8_3" VALUE 0x804D96F5 Val_Wu8 30.00 DFES_OneToOne 0.00 30.00 FORMAT "%5.2" EXTENDED_LIMITS 0.00 255.0 /end CHARACTERISTIC
/begin CHARACTERISTIC DFES_Cls.DFC_MOXEMM_SMU_ALM8_31_C "fault class per DFC / Fault class for check DFC_MOXEMM_SMU_ALM8_31" VALUE 0x804D96F6 Val_Wu8 30.00 DFES_OneToOne 0.00 30.00 FORMAT "%5.2" EXTENDED_LIMITS 0.00 255.0 /end CHARACTERISTIC
/begin CHARACTERISTIC DFES_Cls.DFC_MOXEMM_SMU_ALM8_4_C "fault class per DFC / Fault class for check DFC_MOXEMM_SMU_ALM8_4" VALUE 0x804D96F7 Val_Wu8 30.00 DFES_OneToOne 0.00 30.00 FORMAT "%5.2" EXTENDED_LIMITS 0.00 255.0 /end CHARACTERISTIC
/begin CHARACTERISTIC DFES_Cls.DFC_MOXEMM_SMU_ALM9_0_C "fault class per DFC / Fault class for check DFC_MOXEMM_SMU_ALM9_0" VALUE 0x804D96F8 Val_Wu8 30.00 DFES_OneToOne 0.00 30.00 FORMAT "%5.2" EXTENDED_LIMITS 0.00 255.0 /end CHARACTERISTIC
/begin CHARACTERISTIC DFES_Cls.DFC_MOXEMM_SMU_ALM9_15_C "fault class per DFC / Fault class for check DFC_MOXEMM_SMU_ALM9_15" VALUE 0x804D96F9 Val_Wu8 30.00 DFES_OneToOne 0.00 30.00 FORMAT "%5.2" EXTENDED_LIMITS 0.00 255.0 /end CHARACTERISTIC
/begin CHARACTERISTIC DFES_Cls.DFC_MOXEMM_SMU_ALM9_3_C "fault class per DFC / Fault class for check DFC_MOXEMM_SMU_ALM9_3" VALUE 0x804D96FA Val_Wu8 30.00 DFES_OneToOne 0.00 30.00 FORMAT "%5.2" EXTENDED_LIMITS 0.00 255.0 /end CHARACTERISTIC
/begin CHARACTERISTIC DFES_Cls.DFC_MoCADCNTP_C "fault class per DFC / Fault class for check DFC_MoCADCNTP" VALUE 0x804D96FB Val_Wu8 30.00 DFES_OneToOne 0.00 30.00 FORMAT "%5.2" EXTENDED_LIMITS 0.00 255.0 /end CHARACTERISTIC
/begin CHARACTERISTIC DFES_Cls.DFC_MoCADCTst_C "fault class per DFC / Fault class for check DFC_MoCADCTst" VALUE 0x804D96FC Val_Wu8 30.00 DFES_OneToOne 0.00 30.00 FORMAT "%5.2" EXTENDED_LIMITS 0.00 255.0 /end CHARACTERISTIC
/begin CHARACTERISTIC DFES_Cls.DFC_MoCSOPICO_C "fault class per DFC / Fault class for check DFC_MoCSOPICO" VALUE 0x804D96FD Val_Wu8 30.00 DFES_OneToOne 0.00 30.00 FORMAT "%5.2" EXTENDED_LIMITS 0.00 255.0 /end CHARACTERISTIC
/begin CHARACTERISTIC DFES_Cls.DFC_MoFAPP_C "fault class per DFC / Fault class for check DFC_MoFAPP" VALUE 0x804D96FE Val_Wu8 30.00 DFES_OneToOne 0.00 30.00 FORMAT "%5.2" EXTENDED_LIMITS 0.00 255.0 /end CHARACTERISTIC
/begin CHARACTERISTIC DFES_Cls.DFC_MoFAirFilgPrdc_C "fault class per DFC / Fault class for check DFC_MoFAirFilgPrdc" VALUE 0x804D96FF Val_Wu8 30.00 DFES_OneToOne 0.00 30.00 FORMAT "%5.2" EXTENDED_LIMITS 0.00 255.0 /end CHARACTERISTIC
/begin CHARACTERISTIC DFES_Cls.DFC_MoFAirFlCtOffGdi_C "fault class per DFC / Fault class for check DFC_MoFAirFlCtOffGdi" VALUE 0x804D9700 Val_Wu8 30.00 DFES_OneToOne 0.00 30.00 FORMAT "%5.2" EXTENDED_LIMITS 0.00 255.0 /end CHARACTERISTIC
/begin CHARACTERISTIC DFES_Cls.DFC_MoFAirFlCylGdi_C "fault class per DFC / Fault class for check DFC_MoFAirFlCylGdi" VALUE 0x804D9701 Val_Wu8 30.00 DFES_OneToOne 0.00 30.00 FORMAT "%5.2" EXTENDED_LIMITS 0.00 255.0 /end CHARACTERISTIC
/begin CHARACTERISTIC DFES_Cls.DFC_MoFAirFlFF_C "fault class per DFC / Fault class for check DFC_MoFAirFlFF" VALUE 0x804D9702 Val_Wu8 30.00 DFES_OneToOne 0.00 30.00 FORMAT "%5.2" EXTENDED_LIMITS 0.00 255.0 /end CHARACTERISTIC
/begin CHARACTERISTIC DFES_Cls.DFC_MoFAirFlIn_C "fault class per DFC / Fault class for check DFC_MoFAirFlIn" VALUE 0x804D9703 Val_Wu8 30.00 DFES_OneToOne 0.00 30.00 FORMAT "%5.2" EXTENDED_LIMITS 0.00 255.0 /end CHARACTERISTIC
/begin CHARACTERISTIC DFES_Cls.DFC_MoFAirFlMixCtlGdiChkAirFl_C "fault class per DFC / Fault class for check DFC_MoFAirFlMixCtlGdiChkAirFl" VALUE 0x804D9704 Val_Wu8 30.00 DFES_OneToOne 0.00 30.00 FORMAT "%5.2" EXTENDED_LIMITS 0.00 255.0 /end CHARACTERISTIC
/begin CHARACTERISTIC DFES_Cls.DFC_MoFAirFlMixCtlGdiChkCtrl_C "fault class per DFC / Fault class for check DFC_MoFAirFlMixCtlGdiChkCtrl" VALUE 0x804D9705 Val_Wu8 30.00 DFES_OneToOne 0.00 30.00 FORMAT "%5.2" EXTENDED_LIMITS 0.00 255.0 /end CHARACTERISTIC
/begin CHARACTERISTIC DFES_Cls.DFC_MoFAirFlMode_C "fault class per DFC / Fault class for check DFC_MoFAirFlMode" VALUE 0x804D9706 Val_Wu8 30.00 DFES_OneToOne 0.00 30.00 FORMAT "%5.2" EXTENDED_LIMITS 0.00 255.0 /end CHARACTERISTIC
/begin CHARACTERISTIC DFES_Cls.DFC_MoFESpd_C "fault class per DFC / Fault class for check DFC_MoFESpd" VALUE 0x804D9707 Val_Wu8 30.00 DFES_OneToOne 0.00 30.00 FORMAT "%5.2" EXTENDED_LIMITS 0.00 255.0 /end CHARACTERISTIC
/begin CHARACTERISTIC DFES_Cls.DFC_MoFIACo_C "fault class per DFC / Fault class for check DFC_MoFIACo" VALUE 0x804D9708 Val_Wu8 30.00 DFES_OneToOne 0.00 30.00 FORMAT "%5.2" EXTENDED_LIMITS 0.00 255.0 /end CHARACTERISTIC
/begin CHARACTERISTIC DFES_Cls.DFC_MoFICOL1_C "fault class per DFC / Fault class for check DFC_MoFICOL1" VALUE 0x804D9709 Val_Wu8 30.00 DFES_OneToOne 0.00 30.00 FORMAT "%5.2" EXTENDED_LIMITS 0.00 255.0 /end CHARACTERISTIC
/begin CHARACTERISTIC DFES_Cls.DFC_MoFICOL2_C "fault class per DFC / Fault class for check DFC_MoFICOL2" VALUE 0x804D970A Val_Wu8 30.00 DFES_OneToOne 0.00 30.00 FORMAT "%5.2" EXTENDED_LIMITS 0.00 255.0 /end CHARACTERISTIC
/begin CHARACTERISTIC DFES_Cls.DFC_MoFStrt_C "fault class per DFC / Fault class for check DFC_MoFStrt" VALUE 0x804D970B Val_Wu8 30.00 DFES_OneToOne 0.00 30.00 FORMAT "%5.2" EXTENDED_LIMITS 0.00 255.0 /end CHARACTERISTIC
/begin CHARACTERISTIC DFES_Cls.DFC_MoFTrqCmp_C "fault class per DFC / Fault class for check DFC_MoFTrqCmp" VALUE 0x804D970C Val_Wu8 30.00 DFES_OneToOne 0.00 30.00 FORMAT "%5.2" EXTENDED_LIMITS 0.00 255.0 /end CHARACTERISTIC
/begin CHARACTERISTIC DFES_Cls.DFC_MoFTrqCmpMax_C "fault class per DFC / Fault class for check DFC_MoFTrqCmpMax" VALUE 0x804D970D Val_Wu8 30.00 DFES_OneToOne 0.00 30.00 FORMAT "%5.2" EXTENDED_LIMITS 0.00 255.0 /end CHARACTERISTIC
/begin CHARACTERISTIC DFES_Cls.DFC_MoFTrqCmpMin_C "fault class per DFC / Fault class for check DFC_MoFTrqCmpMin" VALUE 0x804D970E Val_Wu8 30.00 DFES_OneToOne 0.00 30.00 FORMAT "%5.2" EXTENDED_LIMITS 0.00 255.0 /end CHARACTERISTIC
/begin CHARACTERISTIC DFES_Cls.DFC_MoFVarPostBldSel_C "fault class per DFC / Fault class for check DFC_MoFVarPostBldSel" VALUE 0x804D970F Val_Wu8 30.00 DFES_OneToOne 0.00 30.00 FORMAT "%5.2" EXTENDED_LIMITS 0.00 255.0 /end CHARACTERISTIC
/begin CHARACTERISTIC DFES_Cls.DFC_MoXEMMHwLTMCUFW_C "fault class per DFC / Fault class for check DFC_MoXEMMHwLTMCUFW" VALUE 0x804D9710 Val_Wu8 30.00 DFES_OneToOne 0.00 30.00 FORMAT "%5.2" EXTENDED_LIMITS 0.00 255.0 /end CHARACTERISTIC
/begin CHARACTERISTIC DFES_Cls.DFC_MoXEMMHwLTMonBIST_C "fault class per DFC / Fault class for check DFC_MoXEMMHwLTMonBIST" VALUE 0x804D9711 Val_Wu8 30.00 DFES_OneToOne 0.00 30.00 FORMAT "%5.2" EXTENDED_LIMITS 0.00 255.0 /end CHARACTERISTIC
/begin CHARACTERISTIC DFES_Cls.DFC_MoXEMMHwLTRegMonTest_C "fault class per DFC / Fault class for check DFC_MoXEMMHwLTRegMonTest" VALUE 0x804D9712 Val_Wu8 30.00 DFES_OneToOne 0.00 30.00 FORMAT "%5.2" EXTENDED_LIMITS 0.00 255.0 /end CHARACTERISTIC
/begin CHARACTERISTIC DFES_Cls.DFC_MoXEMMHwLTStbySMUAlvTest_C "fault class per DFC / Fault class for check DFC_MoXEMMHwLTStbySMUAlvTest" VALUE 0x804D9713 Val_Wu8 30.00 DFES_OneToOne 0.00 30.00 FORMAT "%5.2" EXTENDED_LIMITS 0.00 255.0 /end CHARACTERISTIC
/begin CHARACTERISTIC DFES_Cls.DFC_MoXEMMHwLTTempSens_C "fault class per DFC / Fault class for check DFC_MoXEMMHwLTTempSens" VALUE 0x804D9714 Val_Wu8 30.00 DFES_OneToOne 0.00 30.00 FORMAT "%5.2" EXTENDED_LIMITS 0.00 255.0 /end CHARACTERISTIC
/begin CHARACTERISTIC DFES_Cls.DFC_MoXEMMHwLTUCBCfg_C "fault class per DFC / Fault class for check DFC_MoXEMMHwLTUCBCfg" VALUE 0x804D9715 Val_Wu8 30.00 DFES_OneToOne 0.00 30.00 FORMAT "%5.2" EXTENDED_LIMITS 0.00 255.0 /end CHARACTERISTIC
/begin CHARACTERISTIC DFES_Cls.DFC_NWSEmax_C "fault class per DFC / Fault class for check DFC_NWSEmax" VALUE 0x804D9716 Val_Wu8 30.00 DFES_OneToOne 0.00 30.00 FORMAT "%5.2" EXTENDED_LIMITS 0.00 255.0 /end CHARACTERISTIC
/begin CHARACTERISTIC DFES_Cls.DFC_NWSmax_C "fault class per DFC / Fault class for check DFC_NWSmax" VALUE 0x804D9717 Val_Wu8 30.00 DFES_OneToOne 0.00 30.00 FORMAT "%5.2" EXTENDED_LIMITS 0.00 255.0 /end CHARACTERISTIC
/begin CHARACTERISTIC DFES_Cls.DFC_OCWDAABEActv_C "fault class per DFC / Fault class for check DFC_OCWDAABEActv" VALUE 0x804D9718 Val_Wu8 30.00 DFES_OneToOne 0.00 30.00 FORMAT "%5.2" EXTENDED_LIMITS 0.00 255.0 /end CHARACTERISTIC
/begin CHARACTERISTIC DFES_Cls.DFC_OCWDACom_C "fault class per DFC / Fault class for check DFC_OCWDACom" VALUE 0x804D9719 Val_Wu8 30.00 DFES_OneToOne 0.00 30.00 FORMAT "%5.2" EXTENDED_LIMITS 0.00 255.0 /end CHARACTERISTIC
/begin CHARACTERISTIC DFES_Cls.DFC_OCWDAErrPin_C "fault class per DFC / Fault class for check DFC_OCWDAErrPin" VALUE 0x804D971A Val_Wu8 30.00 DFES_OneToOne 0.00 30.00 FORMAT "%5.2" EXTENDED_LIMITS 0.00 255.0 /end CHARACTERISTIC
/begin CHARACTERISTIC DFES_Cls.DFC_OCWDAOvrVltg_C "fault class per DFC / Fault class for check DFC_OCWDAOvrVltg" VALUE 0x804D971B Val_Wu8 30.00 DFES_OneToOne 0.00 30.00 FORMAT "%5.2" EXTENDED_LIMITS 0.00 255.0 /end CHARACTERISTIC
/begin CHARACTERISTIC DFES_Cls.DFC_ORAmax_C "fault class per DFC / Fault class for check DFC_ORAmax" VALUE 0x804D971C Val_Wu8 30.00 DFES_OneToOne 0.00 30.00 FORMAT "%5.2" EXTENDED_LIMITS 0.00 255.0 /end CHARACTERISTIC
/begin CHARACTERISTIC DFES_Cls.DFC_ORAmin_C "fault class per DFC / Fault class for check DFC_ORAmin" VALUE 0x804D971D Val_Wu8 30.00 DFES_OneToOne 0.00 30.00 FORMAT "%5.2" EXTENDED_LIMITS 0.00 255.0 /end CHARACTERISTIC
/begin CHARACTERISTIC DFES_Cls.DFC_OilPPlaus_C "fault class per DFC / Fault class for check DFC_OilPPlaus" VALUE 0x804D971E Val_Wu8 30.00 DFES_OneToOne 0.00 30.00 FORMAT "%5.2" EXTENDED_LIMITS 0.00 255.0 /end CHARACTERISTIC
/begin CHARACTERISTIC DFES_Cls.DFC_PLLSUmax_C "fault class per DFC / Fault class for check DFC_PLLSUmax" VALUE 0x804D971F Val_Wu8 30.00 DFES_OneToOne 0.00 30.00 FORMAT "%5.2" EXTENDED_LIMITS 0.00 255.0 /end CHARACTERISTIC
/begin CHARACTERISTIC DFES_Cls.DFC_PLLSUmin_C "fault class per DFC / Fault class for check DFC_PLLSUmin" VALUE 0x804D9720 Val_Wu8 30.00 DFES_OneToOne 0.00 30.00 FORMAT "%5.2" EXTENDED_LIMITS 0.00 255.0 /end CHARACTERISTIC
/begin CHARACTERISTIC DFES_Cls.DFC_PSR1max_C "fault class per DFC / Fault class for check DFC_PSR1max" VALUE 0x804D9721 Val_Wu8 30.00 DFES_OneToOne 0.00 30.00 FORMAT "%5.2" EXTENDED_LIMITS 0.00 255.0 /end CHARACTERISTIC
/begin CHARACTERISTIC DFES_Cls.DFC_PSRBmax_C "fault class per DFC / Fault class for check DFC_PSRBmax" VALUE 0x804D9722 Val_Wu8 30.00 DFES_OneToOne 0.00 30.00 FORMAT "%5.2" EXTENDED_LIMITS 0.00 255.0 /end CHARACTERISTIC
/begin CHARACTERISTIC DFES_Cls.DFC_PSRBmin_C "fault class per DFC / Fault class for check DFC_PSRBmin" VALUE 0x804D9723 Val_Wu8 30.00 DFES_OneToOne 0.00 30.00 FORMAT "%5.2" EXTENDED_LIMITS 0.00 255.0 /end CHARACTERISTIC
/begin CHARACTERISTIC DFES_Cls.DFC_PSRPmax_C "fault class per DFC / Fault class for check DFC_PSRPmax" VALUE 0x804D9724 Val_Wu8 30.00 DFES_OneToOne 0.00 30.00 FORMAT "%5.2" EXTENDED_LIMITS 0.00 255.0 /end CHARACTERISTIC
/begin CHARACTERISTIC DFES_Cls.DFC_PSRPmin_C "fault class per DFC / Fault class for check DFC_PSRPmin" VALUE 0x804D9725 Val_Wu8 30.00 DFES_OneToOne 0.00 30.00 FORMAT "%5.2" EXTENDED_LIMITS 0.00 255.0 /end CHARACTERISTIC
/begin CHARACTERISTIC DFES_Cls.DFC_PSRPsig_C "fault class per DFC / Fault class for check DFC_PSRPsig" VALUE 0x804D9726 Val_Wu8 30.00 DFES_OneToOne 0.00 30.00 FORMAT "%5.2" EXTENDED_LIMITS 0.00 255.0 /end CHARACTERISTIC
/begin CHARACTERISTIC DFES_Cls.DFC_PSRmax_C "fault class per DFC / Fault class for check DFC_PSRmax" VALUE 0x804D9727 Val_Wu8 30.00 DFES_OneToOne 0.00 30.00 FORMAT "%5.2" EXTENDED_LIMITS 0.00 255.0 /end CHARACTERISTIC
/begin CHARACTERISTIC DFES_Cls.DFC_PUmax_C "fault class per DFC / Fault class for check DFC_PUmax" VALUE 0x804D9728 Val_Wu8 30.00 DFES_OneToOne 0.00 30.00 FORMAT "%5.2" EXTENDED_LIMITS 0.00 255.0 /end CHARACTERISTIC
/begin CHARACTERISTIC DFES_Cls.DFC_P_VSE11_OL_C "fault class per DFC / Fault class for check DFC_P_VSE11_OL" VALUE 0x804D9729 Val_Wu8 30.00 DFES_OneToOne 0.00 30.00 FORMAT "%5.2" EXTENDED_LIMITS 0.00 255.0 /end CHARACTERISTIC
/begin CHARACTERISTIC DFES_Cls.DFC_P_VSE11_SCB_C "fault class per DFC / Fault class for check DFC_P_VSE11_SCB" VALUE 0x804D972A Val_Wu8 30.00 DFES_OneToOne 0.00 30.00 FORMAT "%5.2" EXTENDED_LIMITS 0.00 255.0 /end CHARACTERISTIC
/begin CHARACTERISTIC DFES_Cls.DFC_P_VSE11_SCG_C "fault class per DFC / Fault class for check DFC_P_VSE11_SCG" VALUE 0x804D972B Val_Wu8 30.00 DFES_OneToOne 0.00 30.00 FORMAT "%5.2" EXTENDED_LIMITS 0.00 255.0 /end CHARACTERISTIC
/begin CHARACTERISTIC DFES_Cls.DFC_PhyHighAPP1_C "fault class per DFC / Fault class for check DFC_PhyHighAPP1" VALUE 0x804D972C Val_Wu8 30.00 DFES_OneToOne 0.00 30.00 FORMAT "%5.2" EXTENDED_LIMITS 0.00 255.0 /end CHARACTERISTIC
/begin CHARACTERISTIC DFES_Cls.DFC_PhyHighAPP2_C "fault class per DFC / Fault class for check DFC_PhyHighAPP2" VALUE 0x804D972D Val_Wu8 30.00 DFES_OneToOne 0.00 30.00 FORMAT "%5.2" EXTENDED_LIMITS 0.00 255.0 /end CHARACTERISTIC
/begin CHARACTERISTIC DFES_Cls.DFC_PhyLowAPP1_C "fault class per DFC / Fault class for check DFC_PhyLowAPP1" VALUE 0x804D972E Val_Wu8 30.00 DFES_OneToOne 0.00 30.00 FORMAT "%5.2" EXTENDED_LIMITS 0.00 255.0 /end CHARACTERISTIC
/begin CHARACTERISTIC DFES_Cls.DFC_PhyLowAPP2_C "fault class per DFC / Fault class for check DFC_PhyLowAPP2" VALUE 0x804D972F Val_Wu8 30.00 DFES_OneToOne 0.00 30.00 FORMAT "%5.2" EXTENDED_LIMITS 0.00 255.0 /end CHARACTERISTIC
/begin CHARACTERISTIC DFES_Cls.DFC_SRCHighAPP1_C "fault class per DFC / Fault class for check DFC_SRCHighAPP1" VALUE 0x804D9730 Val_Wu8 30.00 DFES_OneToOne 0.00 30.00 FORMAT "%5.2" EXTENDED_LIMITS 0.00 255.0 /end CHARACTERISTIC
/begin CHARACTERISTIC DFES_Cls.DFC_SRCHighAPP2_C "fault class per DFC / Fault class for check DFC_SRCHighAPP2" VALUE 0x804D9731 Val_Wu8 30.00 DFES_OneToOne 0.00 30.00 FORMAT "%5.2" EXTENDED_LIMITS 0.00 255.0 /end CHARACTERISTIC
/begin CHARACTERISTIC DFES_Cls.DFC_SRCLowAPP1_C "fault class per DFC / Fault class for check DFC_SRCLowAPP1" VALUE 0x804D9732 Val_Wu8 30.00 DFES_OneToOne 0.00 30.00 FORMAT "%5.2" EXTENDED_LIMITS 0.00 255.0 /end CHARACTERISTIC
/begin CHARACTERISTIC DFES_Cls.DFC_SRCLowAPP2_C "fault class per DFC / Fault class for check DFC_SRCLowAPP2" VALUE 0x804D9733 Val_Wu8 30.00 DFES_OneToOne 0.00 30.00 FORMAT "%5.2" EXTENDED_LIMITS 0.00 255.0 /end CHARACTERISTIC
/begin CHARACTERISTIC DFES_Cls.DFC_SSpMon2_C "fault class per DFC / Fault class for check DFC_SSpMon2" VALUE 0x804D9734 Val_Wu8 30.00 DFES_OneToOne 0.00 30.00 FORMAT "%5.2" EXTENDED_LIMITS 0.00 255.0 /end CHARACTERISTIC
/begin CHARACTERISTIC DFES_Cls.DFC_STHDRmax_C "fault class per DFC / Fault class for check DFC_STHDRmax" VALUE 0x804D9735 Val_Wu8 30.00 DFES_OneToOne 0.00 30.00 FORMAT "%5.2" EXTENDED_LIMITS 0.00 255.0 /end CHARACTERISTIC
/begin CHARACTERISTIC DFES_Cls.DFC_SWReset_0_C "fault class per DFC / Fault class for check DFC_SWReset_0" VALUE 0x804D9736 Val_Wu8 30.00 DFES_OneToOne 0.00 30.00 FORMAT "%5.2" EXTENDED_LIMITS 0.00 255.0 /end CHARACTERISTIC
/begin CHARACTERISTIC DFES_Cls.DFC_SWReset_1_C "fault class per DFC / Fault class for check DFC_SWReset_1" VALUE 0x804D9737 Val_Wu8 30.00 DFES_OneToOne 0.00 30.00 FORMAT "%5.2" EXTENDED_LIMITS 0.00 255.0 /end CHARACTERISTIC
/begin CHARACTERISTIC DFES_Cls.DFC_SWReset_2_C "fault class per DFC / Fault class for check DFC_SWReset_2" VALUE 0x804D9738 Val_Wu8 30.00 DFES_OneToOne 0.00 30.00 FORMAT "%5.2" EXTENDED_LIMITS 0.00 255.0 /end CHARACTERISTIC
/begin CHARACTERISTIC DFES_Cls.DFC_SyncAPP_C "fault class per DFC / Fault class for check DFC_SyncAPP" VALUE 0x804D9739 Val_Wu8 30.00 DFES_OneToOne 0.00 30.00 FORMAT "%5.2" EXTENDED_LIMITS 0.00 255.0 /end CHARACTERISTIC
/begin CHARACTERISTIC DFES_Cls.DFC_TANKLnpl_C "fault class per DFC / Fault class for check DFC_TANKLnpl" VALUE 0x804D973A Val_Wu8 30.00 DFES_OneToOne 0.00 30.00 FORMAT "%5.2" EXTENDED_LIMITS 0.00 255.0 /end CHARACTERISTIC
/begin CHARACTERISTIC DFES_Cls.DFC_TAmax_Dummy_C "fault class per DFC / Fault class for check DFC_TAmax_Dummy" VALUE 0x804D973B Val_Wu8 30.00 DFES_OneToOne 0.00 30.00 FORMAT "%5.2" EXTENDED_LIMITS 0.00 255.0 /end CHARACTERISTIC
/begin CHARACTERISTIC DFES_Cls.DFC_TESFmax_C "fault class per DFC / Fault class for check DFC_TESFmax" VALUE 0x804D973C Val_Wu8 30.00 DFES_OneToOne 0.00 30.00 FORMAT "%5.2" EXTENDED_LIMITS 0.00 255.0 /end CHARACTERISTIC
/begin CHARACTERISTIC DFES_Cls.DFC_TESGmax_C "fault class per DFC / Fault class for check DFC_TESGmax" VALUE 0x804D973D Val_Wu8 30.00 DFES_OneToOne 0.00 30.00 FORMAT "%5.2" EXTENDED_LIMITS 0.00 255.0 /end CHARACTERISTIC
/begin CHARACTERISTIC DFES_Cls.DFC_TKAEmax_C "fault class per DFC / Fault class for check DFC_TKAEmax" VALUE 0x804D973E Val_Wu8 30.00 DFES_OneToOne 0.00 30.00 FORMAT "%5.2" EXTENDED_LIMITS 0.00 255.0 /end CHARACTERISTIC
/begin CHARACTERISTIC DFES_Cls.DFC_TKAEmin_C "fault class per DFC / Fault class for check DFC_TKAEmin" VALUE 0x804D973F Val_Wu8 30.00 DFES_OneToOne 0.00 30.00 FORMAT "%5.2" EXTENDED_LIMITS 0.00 255.0 /end CHARACTERISTIC
/begin CHARACTERISTIC DFES_Cls.DFC_TKARmax_C "fault class per DFC / Fault class for check DFC_TKARmax" VALUE 0x804D9740 Val_Wu8 30.00 DFES_OneToOne 0.00 30.00 FORMAT "%5.2" EXTENDED_LIMITS 0.00 255.0 /end CHARACTERISTIC
/begin CHARACTERISTIC DFES_Cls.DFC_TKARnpl_C "fault class per DFC / Fault class for check DFC_TKARnpl" VALUE 0x804D9741 Val_Wu8 30.00 DFES_OneToOne 0.00 30.00 FORMAT "%5.2" EXTENDED_LIMITS 0.00 255.0 /end CHARACTERISTIC
/begin CHARACTERISTIC DFES_Cls.DFC_TMmax_Dummy_C "fault class per DFC / Fault class for check DFC_TMmax_Dummy" VALUE 0x804D9742 Val_Wu8 30.00 DFES_OneToOne 0.00 30.00 FORMAT "%5.2" EXTENDED_LIMITS 0.00 255.0 /end CHARACTERISTIC
/begin CHARACTERISTIC DFES_Cls.DFC_TUMmax_Dummy_C "fault class per DFC / Fault class for check DFC_TUMmax_Dummy" VALUE 0x804D9743 Val_Wu8 30.00 DFES_OneToOne 0.00 30.00 FORMAT "%5.2" EXTENDED_LIMITS 0.00 255.0 /end CHARACTERISTIC
/begin CHARACTERISTIC DFES_Cls.DFC_TWCDPriCatB1_C "fault class per DFC / Fault class for check DFC_TWCDPriCatB1" VALUE 0x804D9744 Val_Wu8 30.00 DFES_OneToOne 0.00 30.00 FORMAT "%5.2" EXTENDED_LIMITS 0.00 255.0 /end CHARACTERISTIC
/begin CHARACTERISTIC DFES_Cls.DFC_ThrVlvClsdPosnFirstOffsLrnImpoB1_C "fault class per DFC / Fault class for check DFC_ThrVlvClsdPosnFirstOffsLrnImpoB1" VALUE 0x804D9745 Val_Wu8 30.00 DFES_OneToOne 0.00 30.00 FORMAT "%5.2" EXTENDED_LIMITS 0.00 255.0 /end CHARACTERISTIC
/begin CHARACTERISTIC DFES_Cls.DFC_ThrVlvClsdPosnOffsLrnImpoB1_C "fault class per DFC / Fault class for check DFC_ThrVlvClsdPosnOffsLrnImpoB1" VALUE 0x804D9746 Val_Wu8 30.00 DFES_OneToOne 0.00 30.00 FORMAT "%5.2" EXTENDED_LIMITS 0.00 255.0 /end CHARACTERISTIC
/begin CHARACTERISTIC DFES_Cls.DFC_ThrVlvClsdPosnOffsLrnMaxB1_C "fault class per DFC / Fault class for check DFC_ThrVlvClsdPosnOffsLrnMaxB1" VALUE 0x804D9747 Val_Wu8 30.00 DFES_OneToOne 0.00 30.00 FORMAT "%5.2" EXTENDED_LIMITS 0.00 255.0 /end CHARACTERISTIC
/begin CHARACTERISTIC DFES_Cls.DFC_ThrVlvClsdPosnOffsLrnMinB1_C "fault class per DFC / Fault class for check DFC_ThrVlvClsdPosnOffsLrnMinB1" VALUE 0x804D9748 Val_Wu8 30.00 DFES_OneToOne 0.00 30.00 FORMAT "%5.2" EXTENDED_LIMITS 0.00 255.0 /end CHARACTERISTIC
/begin CHARACTERISTIC DFES_Cls.DFC_ThrVlvCtrlDeB1_C "fault class per DFC / Fault class for check DFC_ThrVlvCtrlDeB1" VALUE 0x804D9749 Val_Wu8 30.00 DFES_OneToOne 0.00 30.00 FORMAT "%5.2" EXTENDED_LIMITS 0.00 255.0 /end CHARACTERISTIC
/begin CHARACTERISTIC DFES_Cls.DFC_ThrVlvDycB1_C "fault class per DFC / Fault class for check DFC_ThrVlvDycB1" VALUE 0x804D974A Val_Wu8 30.00 DFES_OneToOne 0.00 30.00 FORMAT "%5.2" EXTENDED_LIMITS 0.00 255.0 /end CHARACTERISTIC
/begin CHARACTERISTIC DFES_Cls.DFC_ThrVlvLimpAirPosnMaxAbsltDriftB1_C "fault class per DFC / Fault class for check DFC_ThrVlvLimpAirPosnMaxAbsltDriftB1" VALUE 0x804D974B Val_Wu8 30.00 DFES_OneToOne 0.00 30.00 FORMAT "%5.2" EXTENDED_LIMITS 0.00 255.0 /end CHARACTERISTIC
/begin CHARACTERISTIC DFES_Cls.DFC_ThrVlvLimpAirPosnMaxB1_C "fault class per DFC / Fault class for check DFC_ThrVlvLimpAirPosnMaxB1" VALUE 0x804D974C Val_Wu8 30.00 DFES_OneToOne 0.00 30.00 FORMAT "%5.2" EXTENDED_LIMITS 0.00 255.0 /end CHARACTERISTIC
/begin CHARACTERISTIC DFES_Cls.DFC_ThrVlvLimpAirPosnMaxRelDriftB1_C "fault class per DFC / Fault class for check DFC_ThrVlvLimpAirPosnMaxRelDriftB1" VALUE 0x804D974D Val_Wu8 30.00 DFES_OneToOne 0.00 30.00 FORMAT "%5.2" EXTENDED_LIMITS 0.00 255.0 /end CHARACTERISTIC
/begin CHARACTERISTIC DFES_Cls.DFC_ThrVlvLimpAirPosnMinB1_C "fault class per DFC / Fault class for check DFC_ThrVlvLimpAirPosnMinB1" VALUE 0x804D974E Val_Wu8 30.00 DFES_OneToOne 0.00 30.00 FORMAT "%5.2" EXTENDED_LIMITS 0.00 255.0 /end CHARACTERISTIC
/begin CHARACTERISTIC DFES_Cls.DFC_ThrVlvOpenLoadB1_C "fault class per DFC / Fault class for check DFC_ThrVlvOpenLoadB1" VALUE 0x804D974F Val_Wu8 30.00 DFES_OneToOne 0.00 30.00 FORMAT "%5.2" EXTENDED_LIMITS 0.00 255.0 /end CHARACTERISTIC
/begin CHARACTERISTIC DFES_Cls.DFC_ThrVlvOpenSprgB1_C "fault class per DFC / Fault class for check DFC_ThrVlvOpenSprgB1" VALUE 0x804D9750 Val_Wu8 30.00 DFES_OneToOne 0.00 30.00 FORMAT "%5.2" EXTENDED_LIMITS 0.00 255.0 /end CHARACTERISTIC
/begin CHARACTERISTIC DFES_Cls.DFC_ThrVlvOpenSprgSprdB1_C "fault class per DFC / Fault class for check DFC_ThrVlvOpenSprgSprdB1" VALUE 0x804D9751 Val_Wu8 30.00 DFES_OneToOne 0.00 30.00 FORMAT "%5.2" EXTENDED_LIMITS 0.00 255.0 /end CHARACTERISTIC
/begin CHARACTERISTIC DFES_Cls.DFC_ThrVlvOpenSprgTwnB1_C "fault class per DFC / Fault class for check DFC_ThrVlvOpenSprgTwnB1" VALUE 0x804D9752 Val_Wu8 30.00 DFES_OneToOne 0.00 30.00 FORMAT "%5.2" EXTENDED_LIMITS 0.00 255.0 /end CHARACTERISTIC
/begin CHARACTERISTIC DFES_Cls.DFC_ThrVlvOverTB1_C "fault class per DFC / Fault class for check DFC_ThrVlvOverTB1" VALUE 0x804D9753 Val_Wu8 30.00 DFES_OneToOne 0.00 30.00 FORMAT "%5.2" EXTENDED_LIMITS 0.00 255.0 /end CHARACTERISTIC
/begin CHARACTERISTIC DFES_Cls.DFC_ThrVlvRetSprgB1_C "fault class per DFC / Fault class for check DFC_ThrVlvRetSprgB1" VALUE 0x804D9754 Val_Wu8 30.00 DFES_OneToOne 0.00 30.00 FORMAT "%5.2" EXTENDED_LIMITS 0.00 255.0 /end CHARACTERISTIC
/begin CHARACTERISTIC DFES_Cls.DFC_ThrVlvRetSprgSprdB1_C "fault class per DFC / Fault class for check DFC_ThrVlvRetSprgSprdB1" VALUE 0x804D9755 Val_Wu8 30.00 DFES_OneToOne 0.00 30.00 FORMAT "%5.2" EXTENDED_LIMITS 0.00 255.0 /end CHARACTERISTIC
/begin CHARACTERISTIC DFES_Cls.DFC_ThrVlvRetSprgTwnB1_C "fault class per DFC / Fault class for check DFC_ThrVlvRetSprgTwnB1" VALUE 0x804D9756 Val_Wu8 30.00 DFES_OneToOne 0.00 30.00 FORMAT "%5.2" EXTENDED_LIMITS 0.00 255.0 /end CHARACTERISTIC
/begin CHARACTERISTIC DFES_Cls.DFC_ThrVlvSens1MaxB1_C "fault class per DFC / Fault class for check DFC_ThrVlvSens1MaxB1" VALUE 0x804D9757 Val_Wu8 30.00 DFES_OneToOne 0.00 30.00 FORMAT "%5.2" EXTENDED_LIMITS 0.00 255.0 /end CHARACTERISTIC
/begin CHARACTERISTIC DFES_Cls.DFC_ThrVlvSens1NplB1_C "fault class per DFC / Fault class for check DFC_ThrVlvSens1NplB1" VALUE 0x804D9758 Val_Wu8 30.00 DFES_OneToOne 0.00 30.00 FORMAT "%5.2" EXTENDED_LIMITS 0.00 255.0 /end CHARACTERISTIC
/begin CHARACTERISTIC DFES_Cls.DFC_ThrVlvSens2MaxB1_C "fault class per DFC / Fault class for check DFC_ThrVlvSens2MaxB1" VALUE 0x804D9759 Val_Wu8 30.00 DFES_OneToOne 0.00 30.00 FORMAT "%5.2" EXTENDED_LIMITS 0.00 255.0 /end CHARACTERISTIC
/begin CHARACTERISTIC DFES_Cls.DFC_ThrVlvSens2MinB1_C "fault class per DFC / Fault class for check DFC_ThrVlvSens2MinB1" VALUE 0x804D975A Val_Wu8 30.00 DFES_OneToOne 0.00 30.00 FORMAT "%5.2" EXTENDED_LIMITS 0.00 255.0 /end CHARACTERISTIC
/begin CHARACTERISTIC DFES_Cls.DFC_ThrVlvSens2NplB1_C "fault class per DFC / Fault class for check DFC_ThrVlvSens2NplB1" VALUE 0x804D975B Val_Wu8 30.00 DFES_OneToOne 0.00 30.00 FORMAT "%5.2" EXTENDED_LIMITS 0.00 255.0 /end CHARACTERISTIC
/begin CHARACTERISTIC DFES_Cls.DFC_ThrVlvShoCircB1_C "fault class per DFC / Fault class for check DFC_ThrVlvShoCircB1" VALUE 0x804D975C Val_Wu8 30.00 DFES_OneToOne 0.00 30.00 FORMAT "%5.2" EXTENDED_LIMITS 0.00 255.0 /end CHARACTERISTIC
/begin CHARACTERISTIC DFES_Cls.DFC_ThrVlvSpiErrB1_C "fault class per DFC / Fault class for check DFC_ThrVlvSpiErrB1" VALUE 0x804D975D Val_Wu8 30.00 DFES_OneToOne 0.00 30.00 FORMAT "%5.2" EXTENDED_LIMITS 0.00 255.0 /end CHARACTERISTIC
/begin CHARACTERISTIC DFES_Cls.DFC_ThrvlvSens1MinB1_C "fault class per DFC / Fault class for check DFC_ThrvlvSens1MinB1" VALUE 0x804D975E Val_Wu8 30.00 DFES_OneToOne 0.00 30.00 FORMAT "%5.2" EXTENDED_LIMITS 0.00 255.0 /end CHARACTERISTIC
/begin CHARACTERISTIC DFES_Cls.DFC_TiOffTBasdChkFast_C "fault class per DFC / Fault class for check DFC_TiOffTBasdChkFast" VALUE 0x804D975F Val_Wu8 30.00 DFES_OneToOne 0.00 30.00 FORMAT "%5.2" EXTENDED_LIMITS 0.00 255.0 /end CHARACTERISTIC
/begin CHARACTERISTIC DFES_Cls.DFC_TiOffTBasdChkSlow_C "fault class per DFC / Fault class for check DFC_TiOffTBasdChkSlow" VALUE 0x804D9760 Val_Wu8 30.00 DFES_OneToOne 0.00 30.00 FORMAT "%5.2" EXTENDED_LIMITS 0.00 255.0 /end CHARACTERISTIC
/begin CHARACTERISTIC DFES_Cls.DFC_UEGOSnsrMntdS1B1_C "fault class per DFC / Fault class for check DFC_UEGOSnsrMntdS1B1" VALUE 0x804D9761 Val_Wu8 30.00 DFES_OneToOne 0.00 30.00 FORMAT "%5.2" EXTENDED_LIMITS 0.00 255.0 /end CHARACTERISTIC
/begin CHARACTERISTIC DFES_Cls.DFC_VehVSig_C "fault class per DFC / Fault class for check DFC_VehVSig" VALUE 0x804D9762 Val_Wu8 30.00 DFES_OneToOne 0.00 30.00 FORMAT "%5.2" EXTENDED_LIMITS 0.00 255.0 /end CHARACTERISTIC
/begin CHARACTERISTIC DFES_Cls.DFC_VlvLftFbSwtIntk11SpclFail_C "fault class per DFC / Fault class for check DFC_VlvLftFbSwtIntk11SpclFail" VALUE 0x804D9763 Val_Wu8 30.00 DFES_OneToOne 0.00 30.00 FORMAT "%5.2" EXTENDED_LIMITS 0.00 255.0 /end CHARACTERISTIC
/begin CHARACTERISTIC DFES_Cls.DFC_VlvLftFbSwtIntk11StdFail_C "fault class per DFC / Fault class for check DFC_VlvLftFbSwtIntk11StdFail" VALUE 0x804D9764 Val_Wu8 30.00 DFES_OneToOne 0.00 30.00 FORMAT "%5.2" EXTENDED_LIMITS 0.00 255.0 /end CHARACTERISTIC
/begin CHARACTERISTIC DFES_DbLv_C "Debounce level limit for creating fault entry (valid for all DFCs)" VALUE 0x804D9766 Val_Wu8 15.00 DFES_OneToOne 0.00 15.00 FORMAT "%5.2" EXTENDED_LIMITS 0.00 255.0 /end CHARACTERISTIC
/begin CHARACTERISTIC DFES_DTCO.DFC_Unused_C "OBD specific trouble code / " VALUE 0x80503C98 Val_Wu16 65535.00 DFES_OneToOne 0.00 65535.00 FORMAT "%8.2" READ_ONLY /end CHARACTERISTIC
/begin CHARACTERISTIC DFES_DTCO.DFC_AAVEmax_C "OBD specific trouble code / OBD specific diagnostic trouble code for check DFC_AAVEmax" VALUE 0x80503C9A Val_Wu16 65535.00 DFES_OneToOne 0.00 65535.00 FORMAT "%8.2" /end CHARACTERISTIC
/begin CHARACTERISTIC DFES_DTCO.DFC_AAVEmin_C "OBD specific trouble code / OBD specific diagnostic trouble code for check DFC_AAVEmin" VALUE 0x80503C9C Val_Wu16 65535.00 DFES_OneToOne 0.00 65535.00 FORMAT "%8.2" /end CHARACTERISTIC
/begin CHARACTERISTIC DFES_DTCO.DFC_AAVEsig_C "OBD specific trouble code / OBD specific diagnostic trouble code for check DFC_AAVEsig" VALUE 0x80503C9E Val_Wu16 65535.00 DFES_OneToOne 0.00 65535.00 FORMAT "%8.2" /end CHARACTERISTIC
/begin CHARACTERISTIC DFES_DTCO.DFC_AltIOACGFailr_C "OBD specific trouble code / OBD specific diagnostic trouble code for check DFC_AltIOACGFailr" VALUE 0x80503CA0 Val_Wu16 65535.00 DFES_OneToOne 0.00 65535.00 FORMAT "%8.2" /end CHARACTERISTIC
/begin CHARACTERISTIC DFES_DTCO.DFC_AltIOACGHiVltg_C "OBD specific trouble code / OBD specific diagnostic trouble code for check DFC_AltIOACGHiVltg" VALUE 0x80503CA2 Val_Wu16 65535.00 DFES_OneToOne 0.00 65535.00 FORMAT "%8.2" /end CHARACTERISTIC
/begin CHARACTERISTIC DFES_DTCO.DFC_AltIOACGLoVltg_C "OBD specific trouble code / OBD specific diagnostic trouble code for check DFC_AltIOACGLoVltg" VALUE 0x80503CA4 Val_Wu16 65535.00 DFES_OneToOne 0.00 65535.00 FORMAT "%8.2" /end CHARACTERISTIC
/begin CHARACTERISTIC DFES_DTCO.DFC_AltIOACGTHi_C "OBD specific trouble code / OBD specific diagnostic trouble code for check DFC_AltIOACGTHi" VALUE 0x80503CA6 Val_Wu16 65535.00 DFES_OneToOne 0.00 65535.00 FORMAT "%8.2" /end CHARACTERISTIC
/begin CHARACTERISTIC DFES_DTCO.DFC_AltIODConnACG_C "OBD specific trouble code / OBD specific diagnostic trouble code for check DFC_AltIODConnACG" VALUE 0x80503CA8 Val_Wu16 65535.00 DFES_OneToOne 0.00 65535.00 FORMAT "%8.2" /end CHARACTERISTIC
/begin CHARACTERISTIC DFES_DTCO.DFC_BGOELWAF_C "OBD specific trouble code / OBD specific diagnostic trouble code for check DFC_BGOELWAF" VALUE 0x80503CAA Val_Wu16 65535.00 DFES_OneToOne 0.00 65535.00 FORMAT "%8.2" /end CHARACTERISTIC
/begin CHARACTERISTIC DFES_DTCO.DFC_BattUHiFailr_C "OBD specific trouble code / OBD specific diagnostic trouble code for check DFC_BattUHiFailr" VALUE 0x80503CAC Val_Wu16 65535.00 DFES_OneToOne 0.00 65535.00 FORMAT "%8.2" /end CHARACTERISTIC
/begin CHARACTERISTIC DFES_DTCO.DFC_BattULoFailr_C "OBD specific trouble code / OBD specific diagnostic trouble code for check DFC_BattULoFailr" VALUE 0x80503CAE Val_Wu16 65535.00 DFES_OneToOne 0.00 65535.00 FORMAT "%8.2" /end CHARACTERISTIC
/begin CHARACTERISTIC DFES_DTCO.DFC_BrkBstPDriftHiErr_C "OBD specific trouble code / OBD specific diagnostic trouble code for check DFC_BrkBstPDriftHiErr" VALUE 0x80503CB0 Val_Wu16 65535.00 DFES_OneToOne 0.00 65535.00 FORMAT "%8.2" /end CHARACTERISTIC
/begin CHARACTERISTIC DFES_DTCO.DFC_BrkBstPDriftLoErr_C "OBD specific trouble code / OBD specific diagnostic trouble code for check DFC_BrkBstPDriftLoErr" VALUE 0x80503CB2 Val_Wu16 65535.00 DFES_OneToOne 0.00 65535.00 FORMAT "%8.2" /end CHARACTERISTIC
/begin CHARACTERISTIC DFES_DTCO.DFC_BrkBstPSnsrStuck_C "OBD specific trouble code / OBD specific diagnostic trouble code for check DFC_BrkBstPSnsrStuck" VALUE 0x80503CB4 Val_Wu16 65535.00 DFES_OneToOne 0.00 65535.00 FORMAT "%8.2" /end CHARACTERISTIC
/begin CHARACTERISTIC DFES_DTCO.DFC_BrkMnSwtContOn_C "OBD specific trouble code / OBD specific diagnostic trouble code for check DFC_BrkMnSwtContOn" VALUE 0x80503CB6 Val_Wu16 65535.00 DFES_OneToOne 0.00 65535.00 FORMAT "%8.2" /end CHARACTERISTIC
/begin CHARACTERISTIC DFES_DTCO.DFC_BrkMnSwtNotStp_C "OBD specific trouble code / OBD specific diagnostic trouble code for check DFC_BrkMnSwtNotStp" VALUE 0x80503CB8 Val_Wu16 65535.00 DFES_OneToOne 0.00 65535.00 FORMAT "%8.2" /end CHARACTERISTIC
/begin CHARACTERISTIC DFES_DTCO.DFC_BrkNpl_C "OBD specific trouble code / OBD specific diagnostic trouble code for check DFC_BrkNpl" VALUE 0x80503CBA Val_Wu16 65535.00 DFES_OneToOne 0.00 65535.00 FORMAT "%8.2" /end CHARACTERISTIC
/begin CHARACTERISTIC DFES_DTCO.DFC_BrkRdntSwtContOn_C "OBD specific trouble code / OBD specific diagnostic trouble code for check DFC_BrkRdntSwtContOn" VALUE 0x80503CBC Val_Wu16 65535.00 DFES_OneToOne 0.00 65535.00 FORMAT "%8.2" /end CHARACTERISTIC
/begin CHARACTERISTIC DFES_DTCO.DFC_BrkRdntSwtNotStp_C "OBD specific trouble code / OBD specific diagnostic trouble code for check DFC_BrkRdntSwtNotStp" VALUE 0x80503CBE Val_Wu16 65535.00 DFES_OneToOne 0.00 65535.00 FORMAT "%8.2" /end CHARACTERISTIC
/begin CHARACTERISTIC DFES_DTCO.DFC_Clth3ONStuck_C "OBD specific trouble code / OBD specific diagnostic trouble code for check DFC_Clth3ONStuck" VALUE 0x80503CC0 Val_Wu16 65535.00 DFES_OneToOne 0.00 65535.00 FORMAT "%8.2" /end CHARACTERISTIC
/begin CHARACTERISTIC DFES_DTCO.DFC_Clth4OFFStuck_C "OBD specific trouble code / OBD specific diagnostic trouble code for check DFC_Clth4OFFStuck" VALUE 0x80503CC2 Val_Wu16 65535.00 DFES_OneToOne 0.00 65535.00 FORMAT "%8.2" /end CHARACTERISTIC
/begin CHARACTERISTIC DFES_DTCO.DFC_ClthOFFStuck_C "OBD specific trouble code / OBD specific diagnostic trouble code for check DFC_ClthOFFStuck" VALUE 0x80503CC4 Val_Wu16 65535.00 DFES_OneToOne 0.00 65535.00 FORMAT "%8.2" /end CHARACTERISTIC
/begin CHARACTERISTIC DFES_DTCO.DFC_ClthONStuck_C "OBD specific trouble code / OBD specific diagnostic trouble code for check DFC_ClthONStuck" VALUE 0x80503CC6 Val_Wu16 65535.00 DFES_OneToOne 0.00 65535.00 FORMAT "%8.2" /end CHARACTERISTIC
/begin CHARACTERISTIC DFES_DTCO.DFC_ClthStkFailInfo_C "OBD specific trouble code / OBD specific diagnostic trouble code for check DFC_ClthStkFailInfo" VALUE 0x80503CC8 Val_Wu16 65535.00 DFES_OneToOne 0.00 65535.00 FORMAT "%8.2" /end CHARACTERISTIC
/begin CHARACTERISTIC DFES_DTCO.DFC_ComACFailInfo_C "OBD specific trouble code / OBD specific diagnostic trouble code for check DFC_ComACFailInfo" VALUE 0x80503CCA Val_Wu16 65535.00 DFES_OneToOne 0.00 65535.00 FORMAT "%8.2" /end CHARACTERISTIC
/begin CHARACTERISTIC DFES_DTCO.DFC_ComATFTValErr_C "OBD specific trouble code / OBD specific diagnostic trouble code for check DFC_ComATFTValErr" VALUE 0x80503CCC Val_Wu16 65535.00 DFES_OneToOne 0.00 65535.00 FORMAT "%8.2" /end CHARACTERISTIC
/begin CHARACTERISTIC DFES_DTCO.DFC_ComATMILReq_C "OBD specific trouble code / OBD specific diagnostic trouble code for check DFC_ComATMILReq" VALUE 0x80503CCE Val_Wu16 65535.00 DFES_OneToOne 0.00 65535.00 FORMAT "%8.2" /end CHARACTERISTIC
/begin CHARACTERISTIC DFES_DTCO.DFC_ComAYCAChksum_C "OBD specific trouble code / OBD specific diagnostic trouble code for check DFC_ComAYCAChksum" VALUE 0x80503CD0 Val_Wu16 65535.00 DFES_OneToOne 0.00 65535.00 FORMAT "%8.2" /end CHARACTERISTIC
/begin CHARACTERISTIC DFES_DTCO.DFC_ComAYCARingCnt_C "OBD specific trouble code / OBD specific diagnostic trouble code for check DFC_ComAYCARingCnt" VALUE 0x80503CD2 Val_Wu16 65535.00 DFES_OneToOne 0.00 65535.00 FORMAT "%8.2" /end CHARACTERISTIC
/begin CHARACTERISTIC DFES_DTCO.DFC_ComAYCATOut_C "OBD specific trouble code / OBD specific diagnostic trouble code for check DFC_ComAYCATOut" VALUE 0x80503CD4 Val_Wu16 65535.00 DFES_OneToOne 0.00 65535.00 FORMAT "%8.2" /end CHARACTERISTIC
/begin CHARACTERISTIC DFES_DTCO.DFC_ComAYCDChkSum_C "OBD specific trouble code / OBD specific diagnostic trouble code for check DFC_ComAYCDChkSum" VALUE 0x80503CD6 Val_Wu16 65535.00 DFES_OneToOne 0.00 65535.00 FORMAT "%8.2" /end CHARACTERISTIC
/begin CHARACTERISTIC DFES_DTCO.DFC_ComAYCDTOut_C "OBD specific trouble code / OBD specific diagnostic trouble code for check DFC_ComAYCDTOut" VALUE 0x80503CD8 Val_Wu16 65535.00 DFES_OneToOne 0.00 65535.00 FORMAT "%8.2" /end CHARACTERISTIC
/begin CHARACTERISTIC DFES_DTCO.DFC_ComAYCFChksum_C "OBD specific trouble code / OBD specific diagnostic trouble code for check DFC_ComAYCFChksum" VALUE 0x80503CDA Val_Wu16 65535.00 DFES_OneToOne 0.00 65535.00 FORMAT "%8.2" /end CHARACTERISTIC
/begin CHARACTERISTIC DFES_DTCO.DFC_ComAYCFRingCnt_C "OBD specific trouble code / OBD specific diagnostic trouble code for check DFC_ComAYCFRingCnt" VALUE 0x80503CDC Val_Wu16 65535.00 DFES_OneToOne 0.00 65535.00 FORMAT "%8.2" /end CHARACTERISTIC
/begin CHARACTERISTIC DFES_DTCO.DFC_ComAYCFTOut_C "OBD specific trouble code / OBD specific diagnostic trouble code for check DFC_ComAYCFTOut" VALUE 0x80503CDE Val_Wu16 65535.00 DFES_OneToOne 0.00 65535.00 FORMAT "%8.2" /end CHARACTERISTIC
/begin CHARACTERISTIC DFES_DTCO.DFC_ComAYCGChksum_C "OBD specific trouble code / OBD specific diagnostic trouble code for check DFC_ComAYCGChksum" VALUE 0x80503CE0 Val_Wu16 65535.00 DFES_OneToOne 0.00 65535.00 FORMAT "%8.2" /end CHARACTERISTIC
/begin CHARACTERISTIC DFES_DTCO.DFC_ComAYCGRingCnt_C "OBD specific trouble code / OBD specific diagnostic trouble code for check DFC_ComAYCGRingCnt" VALUE 0x80503CE2 Val_Wu16 65535.00 DFES_OneToOne 0.00 65535.00 FORMAT "%8.2" /end CHARACTERISTIC
/begin CHARACTERISTIC DFES_DTCO.DFC_ComAYCGTOut_C "OBD specific trouble code / OBD specific diagnostic trouble code for check DFC_ComAYCGTOut" VALUE 0x80503CE4 Val_Wu16 65535.00 DFES_OneToOne 0.00 65535.00 FORMAT "%8.2" /end CHARACTERISTIC
/begin CHARACTERISTIC DFES_DTCO.DFC_ComAYCIChkSum_C "OBD specific trouble code / OBD specific diagnostic trouble code for check DFC_ComAYCIChkSum" VALUE 0x80503CE6 Val_Wu16 65535.00 DFES_OneToOne 0.00 65535.00 FORMAT "%8.2" /end CHARACTERISTIC
/begin CHARACTERISTIC DFES_DTCO.DFC_ComAYCIRingCnt_C "OBD specific trouble code / OBD specific diagnostic trouble code for check DFC_ComAYCIRingCnt" VALUE 0x80503CE8 Val_Wu16 65535.00 DFES_OneToOne 0.00 65535.00 FORMAT "%8.2" /end CHARACTERISTIC
/begin CHARACTERISTIC DFES_DTCO.DFC_ComAYCITOut_C "OBD specific trouble code / OBD specific diagnostic trouble code for check DFC_ComAYCITOut" VALUE 0x80503CEA Val_Wu16 65535.00 DFES_OneToOne 0.00 65535.00 FORMAT "%8.2" /end CHARACTERISTIC
/begin CHARACTERISTIC DFES_DTCO.DFC_ComBCM1ChkSum_C "OBD specific trouble code / OBD specific diagnostic trouble code for check DFC_ComBCM1ChkSum" VALUE 0x80503CEC Val_Wu16 65535.00 DFES_OneToOne 0.00 65535.00 FORMAT "%8.2" /end CHARACTERISTIC
/begin CHARACTERISTIC DFES_DTCO.DFC_ComBCM1RingCnt_C "OBD specific trouble code / OBD specific diagnostic trouble code for check DFC_ComBCM1RingCnt" VALUE 0x80503CEE Val_Wu16 65535.00 DFES_OneToOne 0.00 65535.00 FORMAT "%8.2" /end CHARACTERISTIC
/begin CHARACTERISTIC DFES_DTCO.DFC_ComBCM1TOut_C "OBD specific trouble code / OBD specific diagnostic trouble code for check DFC_ComBCM1TOut" VALUE 0x80503CF0 Val_Wu16 65535.00 DFES_OneToOne 0.00 65535.00 FORMAT "%8.2" /end CHARACTERISTIC
/begin CHARACTERISTIC DFES_DTCO.DFC_ComCANABusOffErr_C "OBD specific trouble code / OBD specific diagnostic trouble code for check DFC_ComCANABusOffErr" VALUE 0x80503CF2 Val_Wu16 65535.00 DFES_OneToOne 0.00 65535.00 FORMAT "%8.2" /end CHARACTERISTIC
/begin CHARACTERISTIC DFES_DTCO.DFC_ComCANBBusOffErr_C "OBD specific trouble code / OBD specific diagnostic trouble code for check DFC_ComCANBBusOffErr" VALUE 0x80503CF4 Val_Wu16 65535.00 DFES_OneToOne 0.00 65535.00 FORMAT "%8.2" /end CHARACTERISTIC
/begin CHARACTERISTIC DFES_DTCO.DFC_ComCANCBusOffErr_C "OBD specific trouble code / OBD specific diagnostic trouble code for check DFC_ComCANCBusOffErr" VALUE 0x80503CF6 Val_Wu16 65535.00 DFES_OneToOne 0.00 65535.00 FORMAT "%8.2" /end CHARACTERISTIC
/begin CHARACTERISTIC DFES_DTCO.DFC_ComCGW1ChkSum_C "OBD specific trouble code / OBD specific diagnostic trouble code for check DFC_ComCGW1ChkSum" VALUE 0x80503CF8 Val_Wu16 65535.00 DFES_OneToOne 0.00 65535.00 FORMAT "%8.2" /end CHARACTERISTIC
/begin CHARACTERISTIC DFES_DTCO.DFC_ComCGW1RingCnt_C "OBD specific trouble code / OBD specific diagnostic trouble code for check DFC_ComCGW1RingCnt" VALUE 0x80503CFA Val_Wu16 65535.00 DFES_OneToOne 0.00 65535.00 FORMAT "%8.2" /end CHARACTERISTIC
/begin CHARACTERISTIC DFES_DTCO.DFC_ComCGW1TOut_C "OBD specific trouble code / OBD specific diagnostic trouble code for check DFC_ComCGW1TOut" VALUE 0x80503CFC Val_Wu16 65535.00 DFES_OneToOne 0.00 65535.00 FORMAT "%8.2" /end CHARACTERISTIC
/begin CHARACTERISTIC DFES_DTCO.DFC_ComConvBoostErr_C "OBD specific trouble code / OBD specific diagnostic trouble code for check DFC_ComConvBoostErr" VALUE 0x80503CFE Val_Wu16 65535.00 DFES_OneToOne 0.00 65535.00 FORMAT "%8.2" /end CHARACTERISTIC
/begin CHARACTERISTIC DFES_DTCO.DFC_ComConvSlipErr_C "OBD specific trouble code / OBD specific diagnostic trouble code for check DFC_ComConvSlipErr" VALUE 0x80503D00 Val_Wu16 65535.00 DFES_OneToOne 0.00 65535.00 FORMAT "%8.2" /end CHARACTERISTIC
/begin CHARACTERISTIC DFES_DTCO.DFC_ComDCDCPrfmncErr_C "OBD specific trouble code / OBD specific diagnostic trouble code for check DFC_ComDCDCPrfmncErr" VALUE 0x80503D02 Val_Wu16 65535.00 DFES_OneToOne 0.00 65535.00 FORMAT "%8.2" /end CHARACTERISTIC
/begin CHARACTERISTIC DFES_DTCO.DFC_ComDCDCTempWarn_C "OBD specific trouble code / OBD specific diagnostic trouble code for check DFC_ComDCDCTempWarn" VALUE 0x80503D04 Val_Wu16 65535.00 DFES_OneToOne 0.00 65535.00 FORMAT "%8.2" /end CHARACTERISTIC
/begin CHARACTERISTIC DFES_DTCO.DFC_ComEAT10Chksum_C "OBD specific trouble code / OBD specific diagnostic trouble code for check DFC_ComEAT10Chksum" VALUE 0x80503D06 Val_Wu16 65535.00 DFES_OneToOne 0.00 65535.00 FORMAT "%8.2" /end CHARACTERISTIC
/begin CHARACTERISTIC DFES_DTCO.DFC_ComEAT10RingCnt_C "OBD specific trouble code / OBD specific diagnostic trouble code for check DFC_ComEAT10RingCnt" VALUE 0x80503D08 Val_Wu16 65535.00 DFES_OneToOne 0.00 65535.00 FORMAT "%8.2" /end CHARACTERISTIC
/begin CHARACTERISTIC DFES_DTCO.DFC_ComEAT10TOut_C "OBD specific trouble code / OBD specific diagnostic trouble code for check DFC_ComEAT10TOut" VALUE 0x80503D0A Val_Wu16 65535.00 DFES_OneToOne 0.00 65535.00 FORMAT "%8.2" /end CHARACTERISTIC
/begin CHARACTERISTIC DFES_DTCO.DFC_ComEAT11ChkSum_C "OBD specific trouble code / OBD specific diagnostic trouble code for check DFC_ComEAT11ChkSum" VALUE 0x80503D0C Val_Wu16 65535.00 DFES_OneToOne 0.00 65535.00 FORMAT "%8.2" /end CHARACTERISTIC
/begin CHARACTERISTIC DFES_DTCO.DFC_ComEAT11RingCnt_C "OBD specific trouble code / OBD specific diagnostic trouble code for check DFC_ComEAT11RingCnt" VALUE 0x80503D0E Val_Wu16 65535.00 DFES_OneToOne 0.00 65535.00 FORMAT "%8.2" /end CHARACTERISTIC
/begin CHARACTERISTIC DFES_DTCO.DFC_ComEAT11TOut_C "OBD specific trouble code / OBD specific diagnostic trouble code for check DFC_ComEAT11TOut" VALUE 0x80503D10 Val_Wu16 65535.00 DFES_OneToOne 0.00 65535.00 FORMAT "%8.2" /end CHARACTERISTIC
/begin CHARACTERISTIC DFES_DTCO.DFC_ComEAT12ChkSum_C "OBD specific trouble code / OBD specific diagnostic trouble code for check DFC_ComEAT12ChkSum" VALUE 0x80503D12 Val_Wu16 65535.00 DFES_OneToOne 0.00 65535.00 FORMAT "%8.2" /end CHARACTERISTIC
/begin CHARACTERISTIC DFES_DTCO.DFC_ComEAT12RingCnt_C "OBD specific trouble code / OBD specific diagnostic trouble code for check DFC_ComEAT12RingCnt" VALUE 0x80503D14 Val_Wu16 65535.00 DFES_OneToOne 0.00 65535.00 FORMAT "%8.2" /end CHARACTERISTIC
/begin CHARACTERISTIC DFES_DTCO.DFC_ComEAT12TOut_C "OBD specific trouble code / OBD specific diagnostic trouble code for check DFC_ComEAT12TOut" VALUE 0x80503D16 Val_Wu16 65535.00 DFES_OneToOne 0.00 65535.00 FORMAT "%8.2" /end CHARACTERISTIC
/begin CHARACTERISTIC DFES_DTCO.DFC_ComEAT13ChkSum_C "OBD specific trouble code / OBD specific diagnostic trouble code for check DFC_ComEAT13ChkSum" VALUE 0x80503D18 Val_Wu16 65535.00 DFES_OneToOne 0.00 65535.00 FORMAT "%8.2" /end CHARACTERISTIC
/begin CHARACTERISTIC DFES_DTCO.DFC_ComEAT13RingCnt_C "OBD specific trouble code / OBD specific diagnostic trouble code for check DFC_ComEAT13RingCnt" VALUE 0x80503D1A Val_Wu16 65535.00 DFES_OneToOne 0.00 65535.00 FORMAT "%8.2" /end CHARACTERISTIC
/begin CHARACTERISTIC DFES_DTCO.DFC_ComEAT13TOut_C "OBD specific trouble code / OBD specific diagnostic trouble code for check DFC_ComEAT13TOut" VALUE 0x80503D1C Val_Wu16 65535.00 DFES_OneToOne 0.00 65535.00 FORMAT "%8.2" /end CHARACTERISTIC
/begin CHARACTERISTIC DFES_DTCO.DFC_ComEAT1Chksum_C "OBD specific trouble code / OBD specific diagnostic trouble code for check DFC_ComEAT1Chksum" VALUE 0x80503D1E Val_Wu16 65535.00 DFES_OneToOne 0.00 65535.00 FORMAT "%8.2" /end CHARACTERISTIC
/begin CHARACTERISTIC DFES_DTCO.DFC_ComEAT1RingCnt_C "OBD specific trouble code / OBD specific diagnostic trouble code for check DFC_ComEAT1RingCnt" VALUE 0x80503D20 Val_Wu16 65535.00 DFES_OneToOne 0.00 65535.00 FORMAT "%8.2" /end CHARACTERISTIC
/begin CHARACTERISTIC DFES_DTCO.DFC_ComEAT1TOut_C "OBD specific trouble code / OBD specific diagnostic trouble code for check DFC_ComEAT1TOut" VALUE 0x80503D22 Val_Wu16 65535.00 DFES_OneToOne 0.00 65535.00 FORMAT "%8.2" /end CHARACTERISTIC
/begin CHARACTERISTIC DFES_DTCO.DFC_ComEAT2ChkSum_C "OBD specific trouble code / OBD specific diagnostic trouble code for check DFC_ComEAT2ChkSum" VALUE 0x80503D24 Val_Wu16 65535.00 DFES_OneToOne 0.00 65535.00 FORMAT "%8.2" /end CHARACTERISTIC
/begin CHARACTERISTIC DFES_DTCO.DFC_ComEAT2RingCnt_C "OBD specific trouble code / OBD specific diagnostic trouble code for check DFC_ComEAT2RingCnt" VALUE 0x80503D26 Val_Wu16 65535.00 DFES_OneToOne 0.00 65535.00 FORMAT "%8.2" /end CHARACTERISTIC
/begin CHARACTERISTIC DFES_DTCO.DFC_ComEAT2TOut_C "OBD specific trouble code / OBD specific diagnostic trouble code for check DFC_ComEAT2TOut" VALUE 0x80503D28 Val_Wu16 65535.00 DFES_OneToOne 0.00 65535.00 FORMAT "%8.2" /end CHARACTERISTIC
/begin CHARACTERISTIC DFES_DTCO.DFC_ComEAT4ChkSum_C "OBD specific trouble code / OBD specific diagnostic trouble code for check DFC_ComEAT4ChkSum" VALUE 0x80503D2A Val_Wu16 65535.00 DFES_OneToOne 0.00 65535.00 FORMAT "%8.2" /end CHARACTERISTIC
/begin CHARACTERISTIC DFES_DTCO.DFC_ComEAT4RingCnt_C "OBD specific trouble code / OBD specific diagnostic trouble code for check DFC_ComEAT4RingCnt" VALUE 0x80503D2C Val_Wu16 65535.00 DFES_OneToOne 0.00 65535.00 FORMAT "%8.2" /end CHARACTERISTIC
/begin CHARACTERISTIC DFES_DTCO.DFC_ComEAT4TOut_C "OBD specific trouble code / OBD specific diagnostic trouble code for check DFC_ComEAT4TOut" VALUE 0x80503D2E Val_Wu16 65535.00 DFES_OneToOne 0.00 65535.00 FORMAT "%8.2" /end CHARACTERISTIC
/begin CHARACTERISTIC DFES_DTCO.DFC_ComEAT6Chksum_C "OBD specific trouble code / OBD specific diagnostic trouble code for check DFC_ComEAT6Chksum" VALUE 0x80503D30 Val_Wu16 65535.00 DFES_OneToOne 0.00 65535.00 FORMAT "%8.2" /end CHARACTERISTIC
/begin CHARACTERISTIC DFES_DTCO.DFC_ComEAT6RingCnt_C "OBD specific trouble code / OBD specific diagnostic trouble code for check DFC_ComEAT6RingCnt" VALUE 0x80503D32 Val_Wu16 65535.00 DFES_OneToOne 0.00 65535.00 FORMAT "%8.2" /end CHARACTERISTIC
/begin CHARACTERISTIC DFES_DTCO.DFC_ComEAT6TOut_C "OBD specific trouble code / OBD specific diagnostic trouble code for check DFC_ComEAT6TOut" VALUE 0x80503D34 Val_Wu16 65535.00 DFES_OneToOne 0.00 65535.00 FORMAT "%8.2" /end CHARACTERISTIC
/begin CHARACTERISTIC DFES_DTCO.DFC_ComEAT7Chksum_C "OBD specific trouble code / OBD specific diagnostic trouble code for check DFC_ComEAT7Chksum" VALUE 0x80503D36 Val_Wu16 65535.00 DFES_OneToOne 0.00 65535.00 FORMAT "%8.2" /end CHARACTERISTIC
/begin CHARACTERISTIC DFES_DTCO.DFC_ComEAT7RingCnt_C "OBD specific trouble code / OBD specific diagnostic trouble code for check DFC_ComEAT7RingCnt" VALUE 0x80503D38 Val_Wu16 65535.00 DFES_OneToOne 0.00 65535.00 FORMAT "%8.2" /end CHARACTERISTIC
/begin CHARACTERISTIC DFES_DTCO.DFC_ComEAT7TOut_C "OBD specific trouble code / OBD specific diagnostic trouble code for check DFC_ComEAT7TOut" VALUE 0x80503D3A Val_Wu16 65535.00 DFES_OneToOne 0.00 65535.00 FORMAT "%8.2" /end CHARACTERISTIC
/begin CHARACTERISTIC DFES_DTCO.DFC_ComEAT8Chksum_C "OBD specific trouble code / OBD specific diagnostic trouble code for check DFC_ComEAT8Chksum" VALUE 0x80503D3C Val_Wu16 65535.00 DFES_OneToOne 0.00 65535.00 FORMAT "%8.2" /end CHARACTERISTIC
/begin CHARACTERISTIC DFES_DTCO.DFC_ComEAT8RingCnt_C "OBD specific trouble code / OBD specific diagnostic trouble code for check DFC_ComEAT8RingCnt" VALUE 0x80503D3E Val_Wu16 65535.00 DFES_OneToOne 0.00 65535.00 FORMAT "%8.2" /end CHARACTERISTIC
/begin CHARACTERISTIC DFES_DTCO.DFC_ComEAT8TOut_C "OBD specific trouble code / OBD specific diagnostic trouble code for check DFC_ComEAT8TOut" VALUE 0x80503D40 Val_Wu16 65535.00 DFES_OneToOne 0.00 65535.00 FORMAT "%8.2" /end CHARACTERISTIC
/begin CHARACTERISTIC DFES_DTCO.DFC_ComEATAChksum_C "OBD specific trouble code / OBD specific diagnostic trouble code for check DFC_ComEATAChksum" VALUE 0x80503D42 Val_Wu16 65535.00 DFES_OneToOne 0.00 65535.00 FORMAT "%8.2" /end CHARACTERISTIC
/begin CHARACTERISTIC DFES_DTCO.DFC_ComEATARingCnt_C "OBD specific trouble code / OBD specific diagnostic trouble code for check DFC_ComEATARingCnt" VALUE 0x80503D44 Val_Wu16 65535.00 DFES_OneToOne 0.00 65535.00 FORMAT "%8.2" /end CHARACTERISTIC
/begin CHARACTERISTIC DFES_DTCO.DFC_ComEATATOut_C "OBD specific trouble code / OBD specific diagnostic trouble code for check DFC_ComEATATOut" VALUE 0x80503D46 Val_Wu16 65535.00 DFES_OneToOne 0.00 65535.00 FORMAT "%8.2" /end CHARACTERISTIC
/begin CHARACTERISTIC DFES_DTCO.DFC_ComEATBChkSum_C "OBD specific trouble code / OBD specific diagnostic trouble code for check DFC_ComEATBChkSum" VALUE 0x80503D48 Val_Wu16 65535.00 DFES_OneToOne 0.00 65535.00 FORMAT "%8.2" /end CHARACTERISTIC
/begin CHARACTERISTIC DFES_DTCO.DFC_ComEATBRingCnt_C "OBD specific trouble code / OBD specific diagnostic trouble code for check DFC_ComEATBRingCnt" VALUE 0x80503D4A Val_Wu16 65535.00 DFES_OneToOne 0.00 65535.00 FORMAT "%8.2" /end CHARACTERISTIC
/begin CHARACTERISTIC DFES_DTCO.DFC_ComEATBTOut_C "OBD specific trouble code / OBD specific diagnostic trouble code for check DFC_ComEATBTOut" VALUE 0x80503D4C Val_Wu16 65535.00 DFES_OneToOne 0.00 65535.00 FORMAT "%8.2" /end CHARACTERISTIC
/begin CHARACTERISTIC DFES_DTCO.DFC_ComEATCChksum_C "OBD specific trouble code / OBD specific diagnostic trouble code for check DFC_ComEATCChksum" VALUE 0x80503D4E Val_Wu16 65535.00 DFES_OneToOne 0.00 65535.00 FORMAT "%8.2" /end CHARACTERISTIC
/begin CHARACTERISTIC DFES_DTCO.DFC_ComEATCRingCnt_C "OBD specific trouble code / OBD specific diagnostic trouble code for check DFC_ComEATCRingCnt" VALUE 0x80503D50 Val_Wu16 65535.00 DFES_OneToOne 0.00 65535.00 FORMAT "%8.2" /end CHARACTERISTIC
/begin CHARACTERISTIC DFES_DTCO.DFC_ComEATCTOut_C "OBD specific trouble code / OBD specific diagnostic trouble code for check DFC_ComEATCTOut" VALUE 0x80503D52 Val_Wu16 65535.00 DFES_OneToOne 0.00 65535.00 FORMAT "%8.2" /end CHARACTERISTIC
/begin CHARACTERISTIC DFES_DTCO.DFC_ComEPBBChkSum_C "OBD specific trouble code / OBD specific diagnostic trouble code for check DFC_ComEPBBChkSum" VALUE 0x80503D54 Val_Wu16 65535.00 DFES_OneToOne 0.00 65535.00 FORMAT "%8.2" /end CHARACTERISTIC
/begin CHARACTERISTIC DFES_DTCO.DFC_ComEPBBRingCnt_C "OBD specific trouble code / OBD specific diagnostic trouble code for check DFC_ComEPBBRingCnt" VALUE 0x80503D56 Val_Wu16 65535.00 DFES_OneToOne 0.00 65535.00 FORMAT "%8.2" /end CHARACTERISTIC
/begin CHARACTERISTIC DFES_DTCO.DFC_ComEPBBTOut_C "OBD specific trouble code / OBD specific diagnostic trouble code for check DFC_ComEPBBTOut" VALUE 0x80503D58 Val_Wu16 65535.00 DFES_OneToOne 0.00 65535.00 FORMAT "%8.2" /end CHARACTERISTIC
/begin CHARACTERISTIC DFES_DTCO.DFC_ComEPBChksum_C "OBD specific trouble code / OBD specific diagnostic trouble code for check DFC_ComEPBChksum" VALUE 0x80503D5A Val_Wu16 65535.00 DFES_OneToOne 0.00 65535.00 FORMAT "%8.2" /end CHARACTERISTIC
/begin CHARACTERISTIC DFES_DTCO.DFC_ComEPBTOut_C "OBD specific trouble code / OBD specific diagnostic trouble code for check DFC_ComEPBTOut" VALUE 0x80503D5C Val_Wu16 65535.00 DFES_OneToOne 0.00 65535.00 FORMAT "%8.2" /end CHARACTERISTIC
/begin CHARACTERISTIC DFES_DTCO.DFC_ComEPBctRing_C "OBD specific trouble code / OBD specific diagnostic trouble code for check DFC_ComEPBctRing" VALUE 0x80503D5E Val_Wu16 65535.00 DFES_OneToOne 0.00 65535.00 FORMAT "%8.2" /end CHARACTERISTIC
/begin CHARACTERISTIC DFES_DTCO.DFC_ComEPS1Chksum_C "OBD specific trouble code / OBD specific diagnostic trouble code for check DFC_ComEPS1Chksum" VALUE 0x80503D60 Val_Wu16 65535.00 DFES_OneToOne 0.00 65535.00 FORMAT "%8.2" /end CHARACTERISTIC
/begin CHARACTERISTIC DFES_DTCO.DFC_ComEPS1RingCnt_C "OBD specific trouble code / OBD specific diagnostic trouble code for check DFC_ComEPS1RingCnt" VALUE 0x80503D62 Val_Wu16 65535.00 DFES_OneToOne 0.00 65535.00 FORMAT "%8.2" /end CHARACTERISTIC
/begin CHARACTERISTIC DFES_DTCO.DFC_ComEPS1TOut_C "OBD specific trouble code / OBD specific diagnostic trouble code for check DFC_ComEPS1TOut" VALUE 0x80503D64 Val_Wu16 65535.00 DFES_OneToOne 0.00 65535.00 FORMAT "%8.2" /end CHARACTERISTIC
/begin CHARACTERISTIC DFES_DTCO.DFC_ComEngCanRxErr_C "OBD specific trouble code / OBD specific diagnostic trouble code for check DFC_ComEngCanRxErr" VALUE 0x80503D66 Val_Wu16 65535.00 DFES_OneToOne 0.00 65535.00 FORMAT "%8.2" /end CHARACTERISTIC
/begin CHARACTERISTIC DFES_DTCO.DFC_ComGrvySnsrErr_C "OBD specific trouble code / OBD specific diagnostic trouble code for check DFC_ComGrvySnsrErr" VALUE 0x80503D68 Val_Wu16 65535.00 DFES_OneToOne 0.00 65535.00 FORMAT "%8.2" /end CHARACTERISTIC
/begin CHARACTERISTIC DFES_DTCO.DFC_ComGwIMG1ChkSum_C "OBD specific trouble code / OBD specific diagnostic trouble code for check DFC_ComGwIMG1ChkSum" VALUE 0x80503D6A Val_Wu16 65535.00 DFES_OneToOne 0.00 65535.00 FORMAT "%8.2" /end CHARACTERISTIC
/begin CHARACTERISTIC DFES_DTCO.DFC_ComGwIMG1RingCnt_C "OBD specific trouble code / OBD specific diagnostic trouble code for check DFC_ComGwIMG1RingCnt" VALUE 0x80503D6C Val_Wu16 65535.00 DFES_OneToOne 0.00 65535.00 FORMAT "%8.2" /end CHARACTERISTIC
/begin CHARACTERISTIC DFES_DTCO.DFC_ComGwIMG1TOut_C "OBD specific trouble code / OBD specific diagnostic trouble code for check DFC_ComGwIMG1TOut" VALUE 0x80503D6E Val_Wu16 65535.00 DFES_OneToOne 0.00 65535.00 FORMAT "%8.2" /end CHARACTERISTIC
/begin CHARACTERISTIC DFES_DTCO.DFC_ComGwIMG3ChkSum_C "OBD specific trouble code / OBD specific diagnostic trouble code for check DFC_ComGwIMG3ChkSum" VALUE 0x80503D70 Val_Wu16 65535.00 DFES_OneToOne 0.00 65535.00 FORMAT "%8.2" /end CHARACTERISTIC
/begin CHARACTERISTIC DFES_DTCO.DFC_ComGwIMG3RingCnt_C "OBD specific trouble code / OBD specific diagnostic trouble code for check DFC_ComGwIMG3RingCnt" VALUE 0x80503D72 Val_Wu16 65535.00 DFES_OneToOne 0.00 65535.00 FORMAT "%8.2" /end CHARACTERISTIC
/begin CHARACTERISTIC DFES_DTCO.DFC_ComGwIMG3TOut_C "OBD specific trouble code / OBD specific diagnostic trouble code for check DFC_ComGwIMG3TOut" VALUE 0x80503D74 Val_Wu16 65535.00 DFES_OneToOne 0.00 65535.00 FORMAT "%8.2" /end CHARACTERISTIC
/begin CHARACTERISTIC DFES_DTCO.DFC_ComGwIMG4ChkSum_C "OBD specific trouble code / OBD specific diagnostic trouble code for check DFC_ComGwIMG4ChkSum" VALUE 0x80503D76 Val_Wu16 65535.00 DFES_OneToOne 0.00 65535.00 FORMAT "%8.2" /end CHARACTERISTIC
/begin CHARACTERISTIC DFES_DTCO.DFC_ComGwIMG4RingCnt_C "OBD specific trouble code / OBD specific diagnostic trouble code for check DFC_ComGwIMG4RingCnt" VALUE 0x80503D78 Val_Wu16 65535.00 DFES_OneToOne 0.00 65535.00 FORMAT "%8.2" /end CHARACTERISTIC
/begin CHARACTERISTIC DFES_DTCO.DFC_ComGwIMG4TOut_C "OBD specific trouble code / OBD specific diagnostic trouble code for check DFC_ComGwIMG4TOut" VALUE 0x80503D7A Val_Wu16 65535.00 DFES_OneToOne 0.00 65535.00 FORMAT "%8.2" /end CHARACTERISTIC
/begin CHARACTERISTIC DFES_DTCO.DFC_ComGwIMG5ChkSum_C "OBD specific trouble code / OBD specific diagnostic trouble code for check DFC_ComGwIMG5ChkSum" VALUE 0x80503D7C Val_Wu16 65535.00 DFES_OneToOne 0.00 65535.00 FORMAT "%8.2" /end CHARACTERISTIC
/begin CHARACTERISTIC DFES_DTCO.DFC_ComGwIMG5RingCnt_C "OBD specific trouble code / OBD specific diagnostic trouble code for check DFC_ComGwIMG5RingCnt" VALUE 0x80503D7E Val_Wu16 65535.00 DFES_OneToOne 0.00 65535.00 FORMAT "%8.2" /end CHARACTERISTIC
/begin CHARACTERISTIC DFES_DTCO.DFC_ComGwIMG5TOut_C "OBD specific trouble code / OBD specific diagnostic trouble code for check DFC_ComGwIMG5TOut" VALUE 0x80503D80 Val_Wu16 65535.00 DFES_OneToOne 0.00 65535.00 FORMAT "%8.2" /end CHARACTERISTIC
/begin CHARACTERISTIC DFES_DTCO.DFC_ComGwIMG6ChkSum_C "OBD specific trouble code / OBD specific diagnostic trouble code for check DFC_ComGwIMG6ChkSum" VALUE 0x80503D82 Val_Wu16 65535.00 DFES_OneToOne 0.00 65535.00 FORMAT "%8.2" /end CHARACTERISTIC
/begin CHARACTERISTIC DFES_DTCO.DFC_ComGwIMG6RingCnt_C "OBD specific trouble code / OBD specific diagnostic trouble code for check DFC_ComGwIMG6RingCnt" VALUE 0x80503D84 Val_Wu16 65535.00 DFES_OneToOne 0.00 65535.00 FORMAT "%8.2" /end CHARACTERISTIC
/begin CHARACTERISTIC DFES_DTCO.DFC_ComGwIMG6TOut_C "OBD specific trouble code / OBD specific diagnostic trouble code for check DFC_ComGwIMG6TOut" VALUE 0x80503D86 Val_Wu16 65535.00 DFES_OneToOne 0.00 65535.00 FORMAT "%8.2" /end CHARACTERISTIC
/begin CHARACTERISTIC DFES_DTCO.DFC_ComIDASBChksum_C "OBD specific trouble code / OBD specific diagnostic trouble code for check DFC_ComIDASBChksum" VALUE 0x80503D88 Val_Wu16 65535.00 DFES_OneToOne 0.00 65535.00 FORMAT "%8.2" /end CHARACTERISTIC
/begin CHARACTERISTIC DFES_DTCO.DFC_ComIDASBRingCnt_C "OBD specific trouble code / OBD specific diagnostic trouble code for check DFC_ComIDASBRingCnt" VALUE 0x80503D8A Val_Wu16 65535.00 DFES_OneToOne 0.00 65535.00 FORMAT "%8.2" /end CHARACTERISTIC
/begin CHARACTERISTIC DFES_DTCO.DFC_ComIDASBTOut_C "OBD specific trouble code / OBD specific diagnostic trouble code for check DFC_ComIDASBTOut" VALUE 0x80503D8C Val_Wu16 65535.00 DFES_OneToOne 0.00 65535.00 FORMAT "%8.2" /end CHARACTERISTIC
/begin CHARACTERISTIC DFES_DTCO.DFC_ComIMGMILReq_C "OBD specific trouble code / OBD specific diagnostic trouble code for check DFC_ComIMGMILReq" VALUE 0x80503D8E Val_Wu16 65535.00 DFES_OneToOne 0.00 65535.00 FORMAT "%8.2" /end CHARACTERISTIC
/begin CHARACTERISTIC DFES_DTCO.DFC_ComISSPrms_C "OBD specific trouble code / OBD specific diagnostic trouble code for check DFC_ComISSPrms" VALUE 0x80503D90 Val_Wu16 65535.00 DFES_OneToOne 0.00 65535.00 FORMAT "%8.2" /end CHARACTERISTIC
/begin CHARACTERISTIC DFES_DTCO.DFC_ComMETAChksum_C "OBD specific trouble code / OBD specific diagnostic trouble code for check DFC_ComMETAChksum" VALUE 0x80503D92 Val_Wu16 65535.00 DFES_OneToOne 0.00 65535.00 FORMAT "%8.2" /end CHARACTERISTIC
/begin CHARACTERISTIC DFES_DTCO.DFC_ComMETAChksumPstDrv_C "OBD specific trouble code / OBD specific diagnostic trouble code for check DFC_ComMETAChksumPstDrv" VALUE 0x80503D94 Val_Wu16 65535.00 DFES_OneToOne 0.00 65535.00 FORMAT "%8.2" /end CHARACTERISTIC
/begin CHARACTERISTIC DFES_DTCO.DFC_ComMETARingCnt_C "OBD specific trouble code / OBD specific diagnostic trouble code for check DFC_ComMETARingCnt" VALUE 0x80503D96 Val_Wu16 65535.00 DFES_OneToOne 0.00 65535.00 FORMAT "%8.2" /end CHARACTERISTIC
/begin CHARACTERISTIC DFES_DTCO.DFC_ComMETARingCntPstDrv_C "OBD specific trouble code / OBD specific diagnostic trouble code for check DFC_ComMETARingCntPstDrv" VALUE 0x80503D98 Val_Wu16 65535.00 DFES_OneToOne 0.00 65535.00 FORMAT "%8.2" /end CHARACTERISTIC
/begin CHARACTERISTIC DFES_DTCO.DFC_ComMETATOut_C "OBD specific trouble code / OBD specific diagnostic trouble code for check DFC_ComMETATOut" VALUE 0x80503D9A Val_Wu16 65535.00 DFES_OneToOne 0.00 65535.00 FORMAT "%8.2" /end CHARACTERISTIC
/begin CHARACTERISTIC DFES_DTCO.DFC_ComMETATOutPstDrv_C "OBD specific trouble code / OBD specific diagnostic trouble code for check DFC_ComMETATOutPstDrv" VALUE 0x80503D9C Val_Wu16 65535.00 DFES_OneToOne 0.00 65535.00 FORMAT "%8.2" /end CHARACTERISTIC
/begin CHARACTERISTIC DFES_DTCO.DFC_ComMETCChksum_C "OBD specific trouble code / OBD specific diagnostic trouble code for check DFC_ComMETCChksum" VALUE 0x80503D9E Val_Wu16 65535.00 DFES_OneToOne 0.00 65535.00 FORMAT "%8.2" /end CHARACTERISTIC
/begin CHARACTERISTIC DFES_DTCO.DFC_ComMETCRingCnt_C "OBD specific trouble code / OBD specific diagnostic trouble code for check DFC_ComMETCRingCnt" VALUE 0x80503DA0 Val_Wu16 65535.00 DFES_OneToOne 0.00 65535.00 FORMAT "%8.2" /end CHARACTERISTIC
/begin CHARACTERISTIC DFES_DTCO.DFC_ComMETCTOut_C "OBD specific trouble code / OBD specific diagnostic trouble code for check DFC_ComMETCTOut" VALUE 0x80503DA2 Val_Wu16 65535.00 DFES_OneToOne 0.00 65535.00 FORMAT "%8.2" /end CHARACTERISTIC
/begin CHARACTERISTIC DFES_DTCO.DFC_ComMETDChksum_C "OBD specific trouble code / OBD specific diagnostic trouble code for check DFC_ComMETDChksum" VALUE 0x80503DA4 Val_Wu16 65535.00 DFES_OneToOne 0.00 65535.00 FORMAT "%8.2" /end CHARACTERISTIC
/begin CHARACTERISTIC DFES_DTCO.DFC_ComMETDRingCnt_C "OBD specific trouble code / OBD specific diagnostic trouble code for check DFC_ComMETDRingCnt" VALUE 0x80503DA6 Val_Wu16 65535.00 DFES_OneToOne 0.00 65535.00 FORMAT "%8.2" /end CHARACTERISTIC
/begin CHARACTERISTIC DFES_DTCO.DFC_ComMETDTOut_C "OBD specific trouble code / OBD specific diagnostic trouble code for check DFC_ComMETDTOut" VALUE 0x80503DA8 Val_Wu16 65535.00 DFES_OneToOne 0.00 65535.00 FORMAT "%8.2" /end CHARACTERISTIC
/begin CHARACTERISTIC DFES_DTCO.DFC_ComMETE2Chksum_C "OBD specific trouble code / OBD specific diagnostic trouble code for check DFC_ComMETE2Chksum" VALUE 0x80503DAA Val_Wu16 65535.00 DFES_OneToOne 0.00 65535.00 FORMAT "%8.2" /end CHARACTERISTIC
/begin CHARACTERISTIC DFES_DTCO.DFC_ComMETE2RingCnt_C "OBD specific trouble code / OBD specific diagnostic trouble code for check DFC_ComMETE2RingCnt" VALUE 0x80503DAC Val_Wu16 65535.00 DFES_OneToOne 0.00 65535.00 FORMAT "%8.2" /end CHARACTERISTIC
/begin CHARACTERISTIC DFES_DTCO.DFC_ComMETE2TOut_C "OBD specific trouble code / OBD specific diagnostic trouble code for check DFC_ComMETE2TOut" VALUE 0x80503DAE Val_Wu16 65535.00 DFES_OneToOne 0.00 65535.00 FORMAT "%8.2" /end CHARACTERISTIC
/begin CHARACTERISTIC DFES_DTCO.DFC_ComMETFChksum_C "OBD specific trouble code / OBD specific diagnostic trouble code for check DFC_ComMETFChksum" VALUE 0x80503DB0 Val_Wu16 65535.00 DFES_OneToOne 0.00 65535.00 FORMAT "%8.2" /end CHARACTERISTIC
/begin CHARACTERISTIC DFES_DTCO.DFC_ComMETFRingCnt_C "OBD specific trouble code / OBD specific diagnostic trouble code for check DFC_ComMETFRingCnt" VALUE 0x80503DB2 Val_Wu16 65535.00 DFES_OneToOne 0.00 65535.00 FORMAT "%8.2" /end CHARACTERISTIC
/begin CHARACTERISTIC DFES_DTCO.DFC_ComMETFTOut_C "OBD specific trouble code / OBD specific diagnostic trouble code for check DFC_ComMETFTOut" VALUE 0x80503DB4 Val_Wu16 65535.00 DFES_OneToOne 0.00 65535.00 FORMAT "%8.2" /end CHARACTERISTIC
/begin CHARACTERISTIC DFES_DTCO.DFC_ComMETGChksum_C "OBD specific trouble code / OBD specific diagnostic trouble code for check DFC_ComMETGChksum" VALUE 0x80503DB6 Val_Wu16 65535.00 DFES_OneToOne 0.00 65535.00 FORMAT "%8.2" /end CHARACTERISTIC
/begin CHARACTERISTIC DFES_DTCO.DFC_ComMETGRingCnt_C "OBD specific trouble code / OBD specific diagnostic trouble code for check DFC_ComMETGRingCnt" VALUE 0x80503DB8 Val_Wu16 65535.00 DFES_OneToOne 0.00 65535.00 FORMAT "%8.2" /end CHARACTERISTIC
/begin CHARACTERISTIC DFES_DTCO.DFC_ComMETGTOut_C "OBD specific trouble code / OBD specific diagnostic trouble code for check DFC_ComMETGTOut" VALUE 0x80503DBA Val_Wu16 65535.00 DFES_OneToOne 0.00 65535.00 FORMAT "%8.2" /end CHARACTERISTIC
/begin CHARACTERISTIC DFES_DTCO.DFC_ComMETH2Chksum_C "OBD specific trouble code / OBD specific diagnostic trouble code for check DFC_ComMETH2Chksum" VALUE 0x80503DBC Val_Wu16 65535.00 DFES_OneToOne 0.00 65535.00 FORMAT "%8.2" /end CHARACTERISTIC
/begin CHARACTERISTIC DFES_DTCO.DFC_ComMETH2RingCnt_C "OBD specific trouble code / OBD specific diagnostic trouble code for check DFC_ComMETH2RingCnt" VALUE 0x80503DBE Val_Wu16 65535.00 DFES_OneToOne 0.00 65535.00 FORMAT "%8.2" /end CHARACTERISTIC
/begin CHARACTERISTIC DFES_DTCO.DFC_ComMETH2TOut_C "OBD specific trouble code / OBD specific diagnostic trouble code for check DFC_ComMETH2TOut" VALUE 0x80503DC0 Val_Wu16 65535.00 DFES_OneToOne 0.00 65535.00 FORMAT "%8.2" /end CHARACTERISTIC
/begin CHARACTERISTIC DFES_DTCO.DFC_ComMETHChksum_C "OBD specific trouble code / OBD specific diagnostic trouble code for check DFC_ComMETHChksum" VALUE 0x80503DC2 Val_Wu16 65535.00 DFES_OneToOne 0.00 65535.00 FORMAT "%8.2" /end CHARACTERISTIC
/begin CHARACTERISTIC DFES_DTCO.DFC_ComMETHRingCnt_C "OBD specific trouble code / OBD specific diagnostic trouble code for check DFC_ComMETHRingCnt" VALUE 0x80503DC4 Val_Wu16 65535.00 DFES_OneToOne 0.00 65535.00 FORMAT "%8.2" /end CHARACTERISTIC
/begin CHARACTERISTIC DFES_DTCO.DFC_ComMETHTOut_C "OBD specific trouble code / OBD specific diagnostic trouble code for check DFC_ComMETHTOut" VALUE 0x80503DC6 Val_Wu16 65535.00 DFES_OneToOne 0.00 65535.00 FORMAT "%8.2" /end CHARACTERISTIC
/begin CHARACTERISTIC DFES_DTCO.DFC_ComMETIChksum_C "OBD specific trouble code / OBD specific diagnostic trouble code for check DFC_ComMETIChksum" VALUE 0x80503DC8 Val_Wu16 65535.00 DFES_OneToOne 0.00 65535.00 FORMAT "%8.2" /end CHARACTERISTIC
/begin CHARACTERISTIC DFES_DTCO.DFC_ComMETIRingCnt_C "OBD specific trouble code / OBD specific diagnostic trouble code for check DFC_ComMETIRingCnt" VALUE 0x80503DCA Val_Wu16 65535.00 DFES_OneToOne 0.00 65535.00 FORMAT "%8.2" /end CHARACTERISTIC
/begin CHARACTERISTIC DFES_DTCO.DFC_ComMETITOut_C "OBD specific trouble code / OBD specific diagnostic trouble code for check DFC_ComMETITOut" VALUE 0x80503DCC Val_Wu16 65535.00 DFES_OneToOne 0.00 65535.00 FORMAT "%8.2" /end CHARACTERISTIC
/begin CHARACTERISTIC DFES_DTCO.DFC_ComMETKChksum_C "OBD specific trouble code / OBD specific diagnostic trouble code for check DFC_ComMETKChksum" VALUE 0x80503DCE Val_Wu16 65535.00 DFES_OneToOne 0.00 65535.00 FORMAT "%8.2" /end CHARACTERISTIC
/begin CHARACTERISTIC DFES_DTCO.DFC_ComMETKRingCnt_C "OBD specific trouble code / OBD specific diagnostic trouble code for check DFC_ComMETKRingCnt" VALUE 0x80503DD0 Val_Wu16 65535.00 DFES_OneToOne 0.00 65535.00 FORMAT "%8.2" /end CHARACTERISTIC
/begin CHARACTERISTIC DFES_DTCO.DFC_ComMETKTOut_C "OBD specific trouble code / OBD specific diagnostic trouble code for check DFC_ComMETKTOut" VALUE 0x80503DD2 Val_Wu16 65535.00 DFES_OneToOne 0.00 65535.00 FORMAT "%8.2" /end CHARACTERISTIC
/begin CHARACTERISTIC DFES_DTCO.DFC_ComMETLChksum_C "OBD specific trouble code / OBD specific diagnostic trouble code for check DFC_ComMETLChksum" VALUE 0x80503DD4 Val_Wu16 65535.00 DFES_OneToOne 0.00 65535.00 FORMAT "%8.2" /end CHARACTERISTIC
/begin CHARACTERISTIC DFES_DTCO.DFC_ComMETLRingCnt_C "OBD specific trouble code / OBD specific diagnostic trouble code for check DFC_ComMETLRingCnt" VALUE 0x80503DD6 Val_Wu16 65535.00 DFES_OneToOne 0.00 65535.00 FORMAT "%8.2" /end CHARACTERISTIC
/begin CHARACTERISTIC DFES_DTCO.DFC_ComMETLTOut_C "OBD specific trouble code / OBD specific diagnostic trouble code for check DFC_ComMETLTOut" VALUE 0x80503DD8 Val_Wu16 65535.00 DFES_OneToOne 0.00 65535.00 FORMAT "%8.2" /end CHARACTERISTIC
/begin CHARACTERISTIC DFES_DTCO.DFC_ComMETMChksum_C "OBD specific trouble code / OBD specific diagnostic trouble code for check DFC_ComMETMChksum" VALUE 0x80503DDA Val_Wu16 65535.00 DFES_OneToOne 0.00 65535.00 FORMAT "%8.2" /end CHARACTERISTIC
/begin CHARACTERISTIC DFES_DTCO.DFC_ComMETMRingCnt_C "OBD specific trouble code / OBD specific diagnostic trouble code for check DFC_ComMETMRingCnt" VALUE 0x80503DDC Val_Wu16 65535.00 DFES_OneToOne 0.00 65535.00 FORMAT "%8.2" /end CHARACTERISTIC
/begin CHARACTERISTIC DFES_DTCO.DFC_ComMETMTOut_C "OBD specific trouble code / OBD specific diagnostic trouble code for check DFC_ComMETMTOut" VALUE 0x80503DDE Val_Wu16 65535.00 DFES_OneToOne 0.00 65535.00 FORMAT "%8.2" /end CHARACTERISTIC
/begin CHARACTERISTIC DFES_DTCO.DFC_ComMETNChksum_C "OBD specific trouble code / OBD specific diagnostic trouble code for check DFC_ComMETNChksum" VALUE 0x80503DE0 Val_Wu16 65535.00 DFES_OneToOne 0.00 65535.00 FORMAT "%8.2" /end CHARACTERISTIC
/begin CHARACTERISTIC DFES_DTCO.DFC_ComMETNRingCnt_C "OBD specific trouble code / OBD specific diagnostic trouble code for check DFC_ComMETNRingCnt" VALUE 0x80503DE2 Val_Wu16 65535.00 DFES_OneToOne 0.00 65535.00 FORMAT "%8.2" /end CHARACTERISTIC
/begin CHARACTERISTIC DFES_DTCO.DFC_ComMETNTOut_C "OBD specific trouble code / OBD specific diagnostic trouble code for check DFC_ComMETNTOut" VALUE 0x80503DE4 Val_Wu16 65535.00 DFES_OneToOne 0.00 65535.00 FORMAT "%8.2" /end CHARACTERISTIC
/begin CHARACTERISTIC DFES_DTCO.DFC_ComMtrCom_C "OBD specific trouble code / OBD specific diagnostic trouble code for check DFC_ComMtrCom" VALUE 0x80503DE6 Val_Wu16 65535.00 DFES_OneToOne 0.00 65535.00 FORMAT "%8.2" /end CHARACTERISTIC
/begin CHARACTERISTIC DFES_DTCO.DFC_ComPCUChkSum_C "OBD specific trouble code / OBD specific diagnostic trouble code for check DFC_ComPCUChkSum" VALUE 0x80503DE8 Val_Wu16 65535.00 DFES_OneToOne 0.00 65535.00 FORMAT "%8.2" /end CHARACTERISTIC
/begin CHARACTERISTIC DFES_DTCO.DFC_ComPCURingCnt_C "OBD specific trouble code / OBD specific diagnostic trouble code for check DFC_ComPCURingCnt" VALUE 0x80503DEA Val_Wu16 65535.00 DFES_OneToOne 0.00 65535.00 FORMAT "%8.2" /end CHARACTERISTIC
/begin CHARACTERISTIC DFES_DTCO.DFC_ComPCUTOut_C "OBD specific trouble code / OBD specific diagnostic trouble code for check DFC_ComPCUTOut" VALUE 0x80503DEC Val_Wu16 65535.00 DFES_OneToOne 0.00 65535.00 FORMAT "%8.2" /end CHARACTERISTIC
/begin CHARACTERISTIC DFES_DTCO.DFC_ComSRSAChksum_C "OBD specific trouble code / OBD specific diagnostic trouble code for check DFC_ComSRSAChksum" VALUE 0x80503DEE Val_Wu16 65535.00 DFES_OneToOne 0.00 65535.00 FORMAT "%8.2" /end CHARACTERISTIC
/begin CHARACTERISTIC DFES_DTCO.DFC_ComSRSARingCnt_C "OBD specific trouble code / OBD specific diagnostic trouble code for check DFC_ComSRSARingCnt" VALUE 0x80503DF0 Val_Wu16 65535.00 DFES_OneToOne 0.00 65535.00 FORMAT "%8.2" /end CHARACTERISTIC
/begin CHARACTERISTIC DFES_DTCO.DFC_ComSRSATOut_C "OBD specific trouble code / OBD specific diagnostic trouble code for check DFC_ComSRSATOut" VALUE 0x80503DF2 Val_Wu16 65535.00 DFES_OneToOne 0.00 65535.00 FORMAT "%8.2" /end CHARACTERISTIC
/begin CHARACTERISTIC DFES_DTCO.DFC_ComSRSBChksum_C "OBD specific trouble code / OBD specific diagnostic trouble code for check DFC_ComSRSBChksum" VALUE 0x80503DF4 Val_Wu16 65535.00 DFES_OneToOne 0.00 65535.00 FORMAT "%8.2" /end CHARACTERISTIC
/begin CHARACTERISTIC DFES_DTCO.DFC_ComSRSBRingCnt_C "OBD specific trouble code / OBD specific diagnostic trouble code for check DFC_ComSRSBRingCnt" VALUE 0x80503DF6 Val_Wu16 65535.00 DFES_OneToOne 0.00 65535.00 FORMAT "%8.2" /end CHARACTERISTIC
/begin CHARACTERISTIC DFES_DTCO.DFC_ComSRSBTOut_C "OBD specific trouble code / OBD specific diagnostic trouble code for check DFC_ComSRSBTOut" VALUE 0x80503DF8 Val_Wu16 65535.00 DFES_OneToOne 0.00 65535.00 FORMAT "%8.2" /end CHARACTERISTIC
/begin CHARACTERISTIC DFES_DTCO.DFC_ComSRSChksum_C "OBD specific trouble code / OBD specific diagnostic trouble code for check DFC_ComSRSChksum" VALUE 0x80503DFA Val_Wu16 65535.00 DFES_OneToOne 0.00 65535.00 FORMAT "%8.2" /end CHARACTERISTIC
/begin CHARACTERISTIC DFES_DTCO.DFC_ComSRSErr_C "OBD specific trouble code / OBD specific diagnostic trouble code for check DFC_ComSRSErr" VALUE 0x80503DFC Val_Wu16 65535.00 DFES_OneToOne 0.00 65535.00 FORMAT "%8.2" /end CHARACTERISTIC
/begin CHARACTERISTIC DFES_DTCO.DFC_ComSRSRingCnt_C "OBD specific trouble code / OBD specific diagnostic trouble code for check DFC_ComSRSRingCnt" VALUE 0x80503DFE Val_Wu16 65535.00 DFES_OneToOne 0.00 65535.00 FORMAT "%8.2" /end CHARACTERISTIC
/begin CHARACTERISTIC DFES_DTCO.DFC_ComSRSTOut_C "OBD specific trouble code / OBD specific diagnostic trouble code for check DFC_ComSRSTOut" VALUE 0x80503E00 Val_Wu16 65535.00 DFES_OneToOne 0.00 65535.00 FORMAT "%8.2" /end CHARACTERISTIC
/begin CHARACTERISTIC DFES_DTCO.DFC_ComVehSpdPndFltTCU_C "OBD specific trouble code / OBD specific diagnostic trouble code for check DFC_ComVehSpdPndFltTCU" VALUE 0x80503E02 Val_Wu16 65535.00 DFES_OneToOne 0.00 65535.00 FORMAT "%8.2" /end CHARACTERISTIC
/begin CHARACTERISTIC DFES_DTCO.DFC_EbsChartcCurrErr_C "OBD specific trouble code / OBD specific diagnostic trouble code for check DFC_EbsChartcCurrErr" VALUE 0x80503E04 Val_Wu16 65535.00 DFES_OneToOne 0.00 65535.00 FORMAT "%8.2" /end CHARACTERISTIC
/begin CHARACTERISTIC DFES_DTCO.DFC_EbsSelfDiagErr_C "OBD specific trouble code / OBD specific diagnostic trouble code for check DFC_EbsSelfDiagErr" VALUE 0x80503E06 Val_Wu16 65535.00 DFES_OneToOne 0.00 65535.00 FORMAT "%8.2" /end CHARACTERISTIC
/begin CHARACTERISTIC DFES_DTCO.DFC_GEVlvPhaCsersIntkB1_C "OBD specific trouble code / OBD specific diagnostic trouble code for check DFC_GEVlvPhaCsersIntkB1" VALUE 0x80503E08 Val_Wu16 65535.00 DFES_OneToOne 0.00 65535.00 FORMAT "%8.2" /end CHARACTERISTIC
/begin CHARACTERISTIC DFES_DTCO.DFC_GEVlvPhaPsOpenLoadIntkB1_C "OBD specific trouble code / OBD specific diagnostic trouble code for check DFC_GEVlvPhaPsOpenLoadIntkB1" VALUE 0x80503E0A Val_Wu16 65535.00 DFES_OneToOne 0.00 65535.00 FORMAT "%8.2" /end CHARACTERISTIC
/begin CHARACTERISTIC DFES_DTCO.DFC_GEVlvPhaPsShoToBattIntkB1_C "OBD specific trouble code / OBD specific diagnostic trouble code for check DFC_GEVlvPhaPsShoToBattIntkB1" VALUE 0x80503E0C Val_Wu16 65535.00 DFES_OneToOne 0.00 65535.00 FORMAT "%8.2" /end CHARACTERISTIC
/begin CHARACTERISTIC DFES_DTCO.DFC_GEVlvPhaPsShoToGndIntkB1_C "OBD specific trouble code / OBD specific diagnostic trouble code for check DFC_GEVlvPhaPsShoToGndIntkB1" VALUE 0x80503E0E Val_Wu16 65535.00 DFES_OneToOne 0.00 65535.00 FORMAT "%8.2" /end CHARACTERISTIC
/begin CHARACTERISTIC DFES_DTCO.DFC_GbxCANDigPlausErr_C "OBD specific trouble code / OBD specific diagnostic trouble code for check DFC_GbxCANDigPlausErr" VALUE 0x80503E10 Val_Wu16 65535.00 DFES_OneToOne 0.00 65535.00 FORMAT "%8.2" /end CHARACTERISTIC
/begin CHARACTERISTIC DFES_DTCO.DFC_GbxNPos1SRCMax_C "OBD specific trouble code / OBD specific diagnostic trouble code for check DFC_GbxNPos1SRCMax" VALUE 0x80503E12 Val_Wu16 65535.00 DFES_OneToOne 0.00 65535.00 FORMAT "%8.2" /end CHARACTERISTIC
/begin CHARACTERISTIC DFES_DTCO.DFC_GbxNPos1SRCMin_C "OBD specific trouble code / OBD specific diagnostic trouble code for check DFC_GbxNPos1SRCMin" VALUE 0x80503E14 Val_Wu16 65535.00 DFES_OneToOne 0.00 65535.00 FORMAT "%8.2" /end CHARACTERISTIC
/begin CHARACTERISTIC DFES_DTCO.DFC_GbxNPos2SRCMax_C "OBD specific trouble code / OBD specific diagnostic trouble code for check DFC_GbxNPos2SRCMax" VALUE 0x80503E16 Val_Wu16 65535.00 DFES_OneToOne 0.00 65535.00 FORMAT "%8.2" /end CHARACTERISTIC
/begin CHARACTERISTIC DFES_DTCO.DFC_GbxNPos2SRCMin_C "OBD specific trouble code / OBD specific diagnostic trouble code for check DFC_GbxNPos2SRCMin" VALUE 0x80503E18 Val_Wu16 65535.00 DFES_OneToOne 0.00 65535.00 FORMAT "%8.2" /end CHARACTERISTIC
/begin CHARACTERISTIC DFES_DTCO.DFC_GbxNPosAlvChk_C "OBD specific trouble code / OBD specific diagnostic trouble code for check DFC_GbxNPosAlvChk" VALUE 0x80503E1A Val_Wu16 65535.00 DFES_OneToOne 0.00 65535.00 FORMAT "%8.2" /end CHARACTERISTIC
/begin CHARACTERISTIC DFES_DTCO.DFC_GbxNPosSyncErr_C "OBD specific trouble code / OBD specific diagnostic trouble code for check DFC_GbxNPosSyncErr" VALUE 0x80503E1C Val_Wu16 65535.00 DFES_OneToOne 0.00 65535.00 FORMAT "%8.2" /end CHARACTERISTIC
/begin CHARACTERISTIC DFES_DTCO.DFC_HEGOS2B1HtrPsMax_C "OBD specific trouble code / OBD specific diagnostic trouble code for check DFC_HEGOS2B1HtrPsMax" VALUE 0x80503E1E Val_Wu16 65535.00 DFES_OneToOne 0.00 65535.00 FORMAT "%8.2" /end CHARACTERISTIC
/begin CHARACTERISTIC DFES_DTCO.DFC_HEGOS2B1HtrPsMin_C "OBD specific trouble code / OBD specific diagnostic trouble code for check DFC_HEGOS2B1HtrPsMin" VALUE 0x80503E20 Val_Wu16 65535.00 DFES_OneToOne 0.00 65535.00 FORMAT "%8.2" /end CHARACTERISTIC
/begin CHARACTERISTIC DFES_DTCO.DFC_HEGOS2B1HtrPsSig_C "OBD specific trouble code / OBD specific diagnostic trouble code for check DFC_HEGOS2B1HtrPsSig" VALUE 0x80503E22 Val_Wu16 65535.00 DFES_OneToOne 0.00 65535.00 FORMAT "%8.2" /end CHARACTERISTIC
/begin CHARACTERISTIC DFES_DTCO.DFC_LinCSErrACG_C "OBD specific trouble code / OBD specific diagnostic trouble code for check DFC_LinCSErrACG" VALUE 0x80503E24 Val_Wu16 65535.00 DFES_OneToOne 0.00 65535.00 FORMAT "%8.2" /end CHARACTERISTIC
/begin CHARACTERISTIC DFES_DTCO.DFC_LinCSErrAEV_C "OBD specific trouble code / OBD specific diagnostic trouble code for check DFC_LinCSErrAEV" VALUE 0x80503E26 Val_Wu16 65535.00 DFES_OneToOne 0.00 65535.00 FORMAT "%8.2" /end CHARACTERISTIC
/begin CHARACTERISTIC DFES_DTCO.DFC_LinCSErrDCDC_C "OBD specific trouble code / OBD specific diagnostic trouble code for check DFC_LinCSErrDCDC" VALUE 0x80503E28 Val_Wu16 65535.00 DFES_OneToOne 0.00 65535.00 FORMAT "%8.2" /end CHARACTERISTIC
/begin CHARACTERISTIC DFES_DTCO.DFC_LinCSErrEBS_C "OBD specific trouble code / OBD specific diagnostic trouble code for check DFC_LinCSErrEBS" VALUE 0x80503E2A Val_Wu16 65535.00 DFES_OneToOne 0.00 65535.00 FORMAT "%8.2" /end CHARACTERISTIC
/begin CHARACTERISTIC DFES_DTCO.DFC_LinHdrTimeoutErrACG_C "OBD specific trouble code / OBD specific diagnostic trouble code for check DFC_LinHdrTimeoutErrACG" VALUE 0x80503E2C Val_Wu16 65535.00 DFES_OneToOne 0.00 65535.00 FORMAT "%8.2" /end CHARACTERISTIC
/begin CHARACTERISTIC DFES_DTCO.DFC_LinHdrTimeoutErrAEV_C "OBD specific trouble code / OBD specific diagnostic trouble code for check DFC_LinHdrTimeoutErrAEV" VALUE 0x80503E2E Val_Wu16 65535.00 DFES_OneToOne 0.00 65535.00 FORMAT "%8.2" /end CHARACTERISTIC
/begin CHARACTERISTIC DFES_DTCO.DFC_LinHdrTimeoutErrDCDC_C "OBD specific trouble code / OBD specific diagnostic trouble code for check DFC_LinHdrTimeoutErrDCDC" VALUE 0x80503E30 Val_Wu16 65535.00 DFES_OneToOne 0.00 65535.00 FORMAT "%8.2" /end CHARACTERISTIC
/begin CHARACTERISTIC DFES_DTCO.DFC_LinHdrTimeoutErrEBS_C "OBD specific trouble code / OBD specific diagnostic trouble code for check DFC_LinHdrTimeoutErrEBS" VALUE 0x80503E32 Val_Wu16 65535.00 DFES_OneToOne 0.00 65535.00 FORMAT "%8.2" /end CHARACTERISTIC
/begin CHARACTERISTIC DFES_DTCO.DFC_LinMsgTimeoutErrACG_C "OBD specific trouble code / OBD specific diagnostic trouble code for check DFC_LinMsgTimeoutErrACG" VALUE 0x80503E34 Val_Wu16 65535.00 DFES_OneToOne 0.00 65535.00 FORMAT "%8.2" /end CHARACTERISTIC
/begin CHARACTERISTIC DFES_DTCO.DFC_LinMsgTimeoutErrAEV_C "OBD specific trouble code / OBD specific diagnostic trouble code for check DFC_LinMsgTimeoutErrAEV" VALUE 0x80503E36 Val_Wu16 65535.00 DFES_OneToOne 0.00 65535.00 FORMAT "%8.2" /end CHARACTERISTIC
/begin CHARACTERISTIC DFES_DTCO.DFC_LinMsgTimeoutErrDCDC_C "OBD specific trouble code / OBD specific diagnostic trouble code for check DFC_LinMsgTimeoutErrDCDC" VALUE 0x80503E38 Val_Wu16 65535.00 DFES_OneToOne 0.00 65535.00 FORMAT "%8.2" /end CHARACTERISTIC
/begin CHARACTERISTIC DFES_DTCO.DFC_LinMsgTimeoutErrEBS_C "OBD specific trouble code / OBD specific diagnostic trouble code for check DFC_LinMsgTimeoutErrEBS" VALUE 0x80503E3A Val_Wu16 65535.00 DFES_OneToOne 0.00 65535.00 FORMAT "%8.2" /end CHARACTERISTIC
/begin CHARACTERISTIC DFES_DTCO.DFC_LinNoStrtComErr_C "OBD specific trouble code / OBD specific diagnostic trouble code for check DFC_LinNoStrtComErr" VALUE 0x80503E3C Val_Wu16 65535.00 DFES_OneToOne 0.00 65535.00 FORMAT "%8.2" /end CHARACTERISTIC
/begin CHARACTERISTIC DFES_DTCO.DFC_LowPresOilP_C "OBD specific trouble code / OBD specific diagnostic trouble code for check DFC_LowPresOilP" VALUE 0x80503E3E Val_Wu16 65535.00 DFES_OneToOne 0.00 65535.00 FORMAT "%8.2" /end CHARACTERISTIC
/begin CHARACTERISTIC DFES_DTCO.DFC_MisfDetVWhlFrntLeOORHi_C "OBD specific trouble code / OBD specific diagnostic trouble code for check DFC_MisfDetVWhlFrntLeOORHi" VALUE 0x80503E40 Val_Wu16 65535.00 DFES_OneToOne 0.00 65535.00 FORMAT "%8.2" /end CHARACTERISTIC
/begin CHARACTERISTIC DFES_DTCO.DFC_MisfDetVWhlFrntLeRatyHi_C "OBD specific trouble code / OBD specific diagnostic trouble code for check DFC_MisfDetVWhlFrntLeRatyHi" VALUE 0x80503E42 Val_Wu16 65535.00 DFES_OneToOne 0.00 65535.00 FORMAT "%8.2" /end CHARACTERISTIC
/begin CHARACTERISTIC DFES_DTCO.DFC_MisfDetVWhlFrntLeRatyLo_C "OBD specific trouble code / OBD specific diagnostic trouble code for check DFC_MisfDetVWhlFrntLeRatyLo" VALUE 0x80503E44 Val_Wu16 65535.00 DFES_OneToOne 0.00 65535.00 FORMAT "%8.2" /end CHARACTERISTIC
/begin CHARACTERISTIC DFES_DTCO.DFC_MisfDetVWhlFrntLeStuck_C "OBD specific trouble code / OBD specific diagnostic trouble code for check DFC_MisfDetVWhlFrntLeStuck" VALUE 0x80503E46 Val_Wu16 65535.00 DFES_OneToOne 0.00 65535.00 FORMAT "%8.2" /end CHARACTERISTIC
/begin CHARACTERISTIC DFES_DTCO.DFC_MisfDetVWhlFrntRiOORHi_C "OBD specific trouble code / OBD specific diagnostic trouble code for check DFC_MisfDetVWhlFrntRiOORHi" VALUE 0x80503E48 Val_Wu16 65535.00 DFES_OneToOne 0.00 65535.00 FORMAT "%8.2" /end CHARACTERISTIC
/begin CHARACTERISTIC DFES_DTCO.DFC_MisfDetVWhlFrntRiRatyHi_C "OBD specific trouble code / OBD specific diagnostic trouble code for check DFC_MisfDetVWhlFrntRiRatyHi" VALUE 0x80503E4A Val_Wu16 65535.00 DFES_OneToOne 0.00 65535.00 FORMAT "%8.2" /end CHARACTERISTIC
/begin CHARACTERISTIC DFES_DTCO.DFC_MisfDetVWhlFrntRiRatyLo_C "OBD specific trouble code / OBD specific diagnostic trouble code for check DFC_MisfDetVWhlFrntRiRatyLo" VALUE 0x80503E4C Val_Wu16 65535.00 DFES_OneToOne 0.00 65535.00 FORMAT "%8.2" /end CHARACTERISTIC
/begin CHARACTERISTIC DFES_DTCO.DFC_MisfDetVWhlFrntRiStuck_C "OBD specific trouble code / OBD specific diagnostic trouble code for check DFC_MisfDetVWhlFrntRiStuck" VALUE 0x80503E4E Val_Wu16 65535.00 DFES_OneToOne 0.00 65535.00 FORMAT "%8.2" /end CHARACTERISTIC
/begin CHARACTERISTIC DFES_DTCO.DFC_MisfDetVWhlReLeOORHi_C "OBD specific trouble code / OBD specific diagnostic trouble code for check DFC_MisfDetVWhlReLeOORHi" VALUE 0x80503E50 Val_Wu16 65535.00 DFES_OneToOne 0.00 65535.00 FORMAT "%8.2" /end CHARACTERISTIC
/begin CHARACTERISTIC DFES_DTCO.DFC_MisfDetVWhlReLeRatyHi_C "OBD specific trouble code / OBD specific diagnostic trouble code for check DFC_MisfDetVWhlReLeRatyHi" VALUE 0x80503E52 Val_Wu16 65535.00 DFES_OneToOne 0.00 65535.00 FORMAT "%8.2" /end CHARACTERISTIC
/begin CHARACTERISTIC DFES_DTCO.DFC_MisfDetVWhlReLeRatyLo_C "OBD specific trouble code / OBD specific diagnostic trouble code for check DFC_MisfDetVWhlReLeRatyLo" VALUE 0x80503E54 Val_Wu16 65535.00 DFES_OneToOne 0.00 65535.00 FORMAT "%8.2" /end CHARACTERISTIC
/begin CHARACTERISTIC DFES_DTCO.DFC_MisfDetVWhlReLeStuck_C "OBD specific trouble code / OBD specific diagnostic trouble code for check DFC_MisfDetVWhlReLeStuck" VALUE 0x80503E56 Val_Wu16 65535.00 DFES_OneToOne 0.00 65535.00 FORMAT "%8.2" /end CHARACTERISTIC
/begin CHARACTERISTIC DFES_DTCO.DFC_MisfDetVWhlReRiOORHi_C "OBD specific trouble code / OBD specific diagnostic trouble code for check DFC_MisfDetVWhlReRiOORHi" VALUE 0x80503E58 Val_Wu16 65535.00 DFES_OneToOne 0.00 65535.00 FORMAT "%8.2" /end CHARACTERISTIC
/begin CHARACTERISTIC DFES_DTCO.DFC_MisfDetVWhlReRiRatyHi_C "OBD specific trouble code / OBD specific diagnostic trouble code for check DFC_MisfDetVWhlReRiRatyHi" VALUE 0x80503E5A Val_Wu16 65535.00 DFES_OneToOne 0.00 65535.00 FORMAT "%8.2" /end CHARACTERISTIC
/begin CHARACTERISTIC DFES_DTCO.DFC_MisfDetVWhlReRiRatyLo_C "OBD specific trouble code / OBD specific diagnostic trouble code for check DFC_MisfDetVWhlReRiRatyLo" VALUE 0x80503E5C Val_Wu16 65535.00 DFES_OneToOne 0.00 65535.00 FORMAT "%8.2" /end CHARACTERISTIC
/begin CHARACTERISTIC DFES_DTCO.DFC_MisfDetVWhlReRiStuck_C "OBD specific trouble code / OBD specific diagnostic trouble code for check DFC_MisfDetVWhlReRiStuck" VALUE 0x80503E5E Val_Wu16 65535.00 DFES_OneToOne 0.00 65535.00 FORMAT "%8.2" /end CHARACTERISTIC
/begin CHARACTERISTIC DFES_DTCO.DFC_MisfDetdVWhlFrntLePlaus_C "OBD specific trouble code / OBD specific diagnostic trouble code for check DFC_MisfDetdVWhlFrntLePlaus" VALUE 0x80503E60 Val_Wu16 65535.00 DFES_OneToOne 0.00 65535.00 FORMAT "%8.2" /end CHARACTERISTIC
/begin CHARACTERISTIC DFES_DTCO.DFC_MisfDetdVWhlFrntRiPlaus_C "OBD specific trouble code / OBD specific diagnostic trouble code for check DFC_MisfDetdVWhlFrntRiPlaus" VALUE 0x80503E62 Val_Wu16 65535.00 DFES_OneToOne 0.00 65535.00 FORMAT "%8.2" /end CHARACTERISTIC
/begin CHARACTERISTIC DFES_DTCO.DFC_MisfDetdVWhlReLePlaus_C "OBD specific trouble code / OBD specific diagnostic trouble code for check DFC_MisfDetdVWhlReLePlaus" VALUE 0x80503E64 Val_Wu16 65535.00 DFES_OneToOne 0.00 65535.00 FORMAT "%8.2" /end CHARACTERISTIC
/begin CHARACTERISTIC DFES_DTCO.DFC_MisfDetdVWhlReRiPlaus_C "OBD specific trouble code / OBD specific diagnostic trouble code for check DFC_MisfDetdVWhlReRiPlaus" VALUE 0x80503E66 Val_Wu16 65535.00 DFES_OneToOne 0.00 65535.00 FORMAT "%8.2" /end CHARACTERISTIC
/begin CHARACTERISTIC DFES_DTCO.DFC_PEnvSigRngMax_C "OBD specific trouble code / OBD specific diagnostic trouble code for check DFC_PEnvSigRngMax" VALUE 0x80503E68 Val_Wu16 65535.00 DFES_OneToOne 0.00 65535.00 FORMAT "%8.2" /end CHARACTERISTIC
/begin CHARACTERISTIC DFES_DTCO.DFC_PEnvSigRngMin_C "OBD specific trouble code / OBD specific diagnostic trouble code for check DFC_PEnvSigRngMin" VALUE 0x80503E6A Val_Wu16 65535.00 DFES_OneToOne 0.00 65535.00 FORMAT "%8.2" /end CHARACTERISTIC
/begin CHARACTERISTIC DFES_DTCO.DFC_StmFault_C "OBD specific trouble code / OBD specific diagnostic trouble code for check DFC_StmFault" VALUE 0x80503E6C Val_Wu16 65535.00 DFES_OneToOne 0.00 65535.00 FORMAT "%8.2" /end CHARACTERISTIC
/begin CHARACTERISTIC DFES_DTCO.DFC_StrtCtOffPth_C "OBD specific trouble code / OBD specific diagnostic trouble code for check DFC_StrtCtOffPth" VALUE 0x80503E6E Val_Wu16 65535.00 DFES_OneToOne 0.00 65535.00 FORMAT "%8.2" /end CHARACTERISTIC
/begin CHARACTERISTIC DFES_DTCO.DFC_StrtCtlErr_C "OBD specific trouble code / OBD specific diagnostic trouble code for check DFC_StrtCtlErr" VALUE 0x80503E70 Val_Wu16 65535.00 DFES_OneToOne 0.00 65535.00 FORMAT "%8.2" /end CHARACTERISTIC
/begin CHARACTERISTIC DFES_DTCO.DFC_StrtFault_C "OBD specific trouble code / OBD specific diagnostic trouble code for check DFC_StrtFault" VALUE 0x80503E72 Val_Wu16 65535.00 DFES_OneToOne 0.00 65535.00 FORMAT "%8.2" /end CHARACTERISTIC
/begin CHARACTERISTIC DFES_DTCO.DFC_StrtLckJudg1_C "OBD specific trouble code / OBD specific diagnostic trouble code for check DFC_StrtLckJudg1" VALUE 0x80503E74 Val_Wu16 65535.00 DFES_OneToOne 0.00 65535.00 FORMAT "%8.2" /end CHARACTERISTIC
/begin CHARACTERISTIC DFES_DTCO.DFC_StrtLckJudg2_C "OBD specific trouble code / OBD specific diagnostic trouble code for check DFC_StrtLckJudg2" VALUE 0x80503E76 Val_Wu16 65535.00 DFES_OneToOne 0.00 65535.00 FORMAT "%8.2" /end CHARACTERISTIC
/begin CHARACTERISTIC DFES_DTCO.DFC_StrtOL_C "OBD specific trouble code / OBD specific diagnostic trouble code for check DFC_StrtOL" VALUE 0x80503E78 Val_Wu16 65535.00 DFES_OneToOne 0.00 65535.00 FORMAT "%8.2" /end CHARACTERISTIC
/begin CHARACTERISTIC DFES_DTCO.DFC_StrtOL2_C "OBD specific trouble code / OBD specific diagnostic trouble code for check DFC_StrtOL2" VALUE 0x80503E7A Val_Wu16 65535.00 DFES_OneToOne 0.00 65535.00 FORMAT "%8.2" /end CHARACTERISTIC
/begin CHARACTERISTIC DFES_DTCO.DFC_StrtSCB_C "OBD specific trouble code / OBD specific diagnostic trouble code for check DFC_StrtSCB" VALUE 0x80503E7C Val_Wu16 65535.00 DFES_OneToOne 0.00 65535.00 FORMAT "%8.2" /end CHARACTERISTIC
/begin CHARACTERISTIC DFES_DTCO.DFC_StrtSCB2_C "OBD specific trouble code / OBD specific diagnostic trouble code for check DFC_StrtSCB2" VALUE 0x80503E7E Val_Wu16 65535.00 DFES_OneToOne 0.00 65535.00 FORMAT "%8.2" /end CHARACTERISTIC
/begin CHARACTERISTIC DFES_DTCO.DFC_StrtSCG_C "OBD specific trouble code / OBD specific diagnostic trouble code for check DFC_StrtSCG" VALUE 0x80503E80 Val_Wu16 65535.00 DFES_OneToOne 0.00 65535.00 FORMAT "%8.2" /end CHARACTERISTIC
/begin CHARACTERISTIC DFES_DTCO.DFC_StrtSCG2_C "OBD specific trouble code / OBD specific diagnostic trouble code for check DFC_StrtSCG2" VALUE 0x80503E82 Val_Wu16 65535.00 DFES_OneToOne 0.00 65535.00 FORMAT "%8.2" /end CHARACTERISTIC
/begin CHARACTERISTIC DFES_DTCO.DFC_StrtStkRly1_C "OBD specific trouble code / OBD specific diagnostic trouble code for check DFC_StrtStkRly1" VALUE 0x80503E84 Val_Wu16 65535.00 DFES_OneToOne 0.00 65535.00 FORMAT "%8.2" /end CHARACTERISTIC
/begin CHARACTERISTIC DFES_DTCO.DFC_StrtStkRly2_C "OBD specific trouble code / OBD specific diagnostic trouble code for check DFC_StrtStkRly2" VALUE 0x80503E86 Val_Wu16 65535.00 DFES_OneToOne 0.00 65535.00 FORMAT "%8.2" /end CHARACTERISTIC
/begin CHARACTERISTIC DFES_DTCO.DFC_TEVEmax_C "OBD specific trouble code / OBD specific diagnostic trouble code for check DFC_TEVEmax" VALUE 0x80503E88 Val_Wu16 65535.00 DFES_OneToOne 0.00 65535.00 FORMAT "%8.2" /end CHARACTERISTIC
/begin CHARACTERISTIC DFES_DTCO.DFC_TEVEmin_C "OBD specific trouble code / OBD specific diagnostic trouble code for check DFC_TEVEmin" VALUE 0x80503E8A Val_Wu16 65535.00 DFES_OneToOne 0.00 65535.00 FORMAT "%8.2" /end CHARACTERISTIC
/begin CHARACTERISTIC DFES_DTCO.DFC_TEVEsig_C "OBD specific trouble code / OBD specific diagnostic trouble code for check DFC_TEVEsig" VALUE 0x80503E8C Val_Wu16 65535.00 DFES_OneToOne 0.00 65535.00 FORMAT "%8.2" /end CHARACTERISTIC
/begin CHARACTERISTIC DFES_DTCO.DFC_UegoHeatrPrfmncLoS1B1_C "OBD specific trouble code / OBD specific diagnostic trouble code for check DFC_UegoHeatrPrfmncLoS1B1" VALUE 0x80503E8E Val_Wu16 65535.00 DFES_OneToOne 0.00 65535.00 FORMAT "%8.2" /end CHARACTERISTIC
/begin CHARACTERISTIC DFES_DTCO.DFC_VehVAllPlaus_C "OBD specific trouble code / OBD specific diagnostic trouble code for check DFC_VehVAllPlaus" VALUE 0x80503E90 Val_Wu16 65535.00 DFES_OneToOne 0.00 65535.00 FORMAT "%8.2" /end CHARACTERISTIC
/begin CHARACTERISTIC DFES_DTCO.DFC_VehVNCSnsrElecFailr_C "OBD specific trouble code / OBD specific diagnostic trouble code for check DFC_VehVNCSnsrElecFailr" VALUE 0x80503E92 Val_Wu16 65535.00 DFES_OneToOne 0.00 65535.00 FORMAT "%8.2" /end CHARACTERISTIC
/begin CHARACTERISTIC DFES_DTCO.DFC_VehVPlausCan_C "OBD specific trouble code / OBD specific diagnostic trouble code for check DFC_VehVPlausCan" VALUE 0x80503E94 Val_Wu16 65535.00 DFES_OneToOne 0.00 65535.00 FORMAT "%8.2" /end CHARACTERISTIC
/begin CHARACTERISTIC DFES_DTCO.DFC_VehVPlausFco_C "OBD specific trouble code / OBD specific diagnostic trouble code for check DFC_VehVPlausFco" VALUE 0x80503E96 Val_Wu16 65535.00 DFES_OneToOne 0.00 65535.00 FORMAT "%8.2" /end CHARACTERISTIC
/begin CHARACTERISTIC DFES_DTCO.DFC_VehVPlausPwr_C "OBD specific trouble code / OBD specific diagnostic trouble code for check DFC_VehVPlausPwr" VALUE 0x80503E98 Val_Wu16 65535.00 DFES_OneToOne 0.00 65535.00 FORMAT "%8.2" /end CHARACTERISTIC
/begin CHARACTERISTIC DFES_DTCO.DFC_VehVPlausV2N_C "OBD specific trouble code / OBD specific diagnostic trouble code for check DFC_VehVPlausV2N" VALUE 0x80503E9A Val_Wu16 65535.00 DFES_OneToOne 0.00 65535.00 FORMAT "%8.2" /end CHARACTERISTIC
/begin CHARACTERISTIC DFES_DTCO.DFC_VehVSpdSnsrAElecFailr_C "OBD specific trouble code / OBD specific diagnostic trouble code for check DFC_VehVSpdSnsrAElecFailr" VALUE 0x80503E9C Val_Wu16 65535.00 DFES_OneToOne 0.00 65535.00 FORMAT "%8.2" /end CHARACTERISTIC
/begin CHARACTERISTIC DFES_DTCO.DFC_VehVSpdSnsrBElecFailr_C "OBD specific trouble code / OBD specific diagnostic trouble code for check DFC_VehVSpdSnsrBElecFailr" VALUE 0x80503E9E Val_Wu16 65535.00 DFES_OneToOne 0.00 65535.00 FORMAT "%8.2" /end CHARACTERISTIC
/begin CHARACTERISTIC DFES_DTCO.DFC_ClthMax_C "OBD specific trouble code / OBD specific diagnostic trouble code for check DFC_ClthMax" VALUE 0x80503EA0 Val_Wu16 65535.00 DFES_OneToOne 0.00 65535.00 FORMAT "%8.2" /end CHARACTERISTIC
/begin CHARACTERISTIC DFES_DTCO.DFC_IgnClPs_DevComErr_C "OBD specific trouble code / OBD specific diagnostic trouble code for check DFC_IgnClPs_DevComErr" VALUE 0x80503EA2 Val_Wu16 65535.00 DFES_OneToOne 0.00 65535.00 FORMAT "%8.2" /end CHARACTERISTIC
/begin CHARACTERISTIC DFES_DTCO.DFC_IgnClPs_LineOl_0_C "OBD specific trouble code / OBD specific diagnostic trouble code for check DFC_IgnClPs_LineOl_0" VALUE 0x80503EA4 Val_Wu16 65535.00 DFES_OneToOne 0.00 65535.00 FORMAT "%8.2" /end CHARACTERISTIC
/begin CHARACTERISTIC DFES_DTCO.DFC_IgnClPs_LineOl_1_C "OBD specific trouble code / OBD specific diagnostic trouble code for check DFC_IgnClPs_LineOl_1" VALUE 0x80503EA6 Val_Wu16 65535.00 DFES_OneToOne 0.00 65535.00 FORMAT "%8.2" /end CHARACTERISTIC
/begin CHARACTERISTIC DFES_DTCO.DFC_IgnClPs_LineOl_2_C "OBD specific trouble code / OBD specific diagnostic trouble code for check DFC_IgnClPs_LineOl_2" VALUE 0x80503EA8 Val_Wu16 65535.00 DFES_OneToOne 0.00 65535.00 FORMAT "%8.2" /end CHARACTERISTIC
/begin CHARACTERISTIC DFES_DTCO.DFC_IgnClPs_LineOl_3_C "OBD specific trouble code / OBD specific diagnostic trouble code for check DFC_IgnClPs_LineOl_3" VALUE 0x80503EAA Val_Wu16 65535.00 DFES_OneToOne 0.00 65535.00 FORMAT "%8.2" /end CHARACTERISTIC
/begin CHARACTERISTIC DFES_DTCO.DFC_IgnClPs_LineScb_0_C "OBD specific trouble code / OBD specific diagnostic trouble code for check DFC_IgnClPs_LineScb_0" VALUE 0x80503EAC Val_Wu16 65535.00 DFES_OneToOne 0.00 65535.00 FORMAT "%8.2" /end CHARACTERISTIC
/begin CHARACTERISTIC DFES_DTCO.DFC_IgnClPs_LineScb_1_C "OBD specific trouble code / OBD specific diagnostic trouble code for check DFC_IgnClPs_LineScb_1" VALUE 0x80503EAE Val_Wu16 65535.00 DFES_OneToOne 0.00 65535.00 FORMAT "%8.2" /end CHARACTERISTIC
/begin CHARACTERISTIC DFES_DTCO.DFC_IgnClPs_LineScb_2_C "OBD specific trouble code / OBD specific diagnostic trouble code for check DFC_IgnClPs_LineScb_2" VALUE 0x80503EB0 Val_Wu16 65535.00 DFES_OneToOne 0.00 65535.00 FORMAT "%8.2" /end CHARACTERISTIC
/begin CHARACTERISTIC DFES_DTCO.DFC_IgnClPs_LineScb_3_C "OBD specific trouble code / OBD specific diagnostic trouble code for check DFC_IgnClPs_LineScb_3" VALUE 0x80503EB2 Val_Wu16 65535.00 DFES_OneToOne 0.00 65535.00 FORMAT "%8.2" /end CHARACTERISTIC
/begin CHARACTERISTIC DFES_DTCO.DFC_IgnClPs_LineScg_0_C "OBD specific trouble code / OBD specific diagnostic trouble code for check DFC_IgnClPs_LineScg_0" VALUE 0x80503EB4 Val_Wu16 65535.00 DFES_OneToOne 0.00 65535.00 FORMAT "%8.2" /end CHARACTERISTIC
/begin CHARACTERISTIC DFES_DTCO.DFC_IgnClPs_LineScg_1_C "OBD specific trouble code / OBD specific diagnostic trouble code for check DFC_IgnClPs_LineScg_1" VALUE 0x80503EB6 Val_Wu16 65535.00 DFES_OneToOne 0.00 65535.00 FORMAT "%8.2" /end CHARACTERISTIC
/begin CHARACTERISTIC DFES_DTCO.DFC_IgnClPs_LineScg_2_C "OBD specific trouble code / OBD specific diagnostic trouble code for check DFC_IgnClPs_LineScg_2" VALUE 0x80503EB8 Val_Wu16 65535.00 DFES_OneToOne 0.00 65535.00 FORMAT "%8.2" /end CHARACTERISTIC
/begin CHARACTERISTIC DFES_DTCO.DFC_IgnClPs_LineScg_3_C "OBD specific trouble code / OBD specific diagnostic trouble code for check DFC_IgnClPs_LineScg_3" VALUE 0x80503EBA Val_Wu16 65535.00 DFES_OneToOne 0.00 65535.00 FORMAT "%8.2" /end CHARACTERISTIC
/begin CHARACTERISTIC DFES_DTCO.DFC_KRVEKOEVAB_C "OBD specific trouble code / OBD specific diagnostic trouble code for check DFC_KRVEKOEVAB" VALUE 0x80503EBC Val_Wu16 65535.00 DFES_OneToOne 0.00 65535.00 FORMAT "%8.2" /end CHARACTERISTIC
/begin CHARACTERISTIC DFES_DTCO.DFC_KRVEKOEVAB0_C "OBD specific trouble code / OBD specific diagnostic trouble code for check DFC_KRVEKOEVAB0" VALUE 0x80503EBE Val_Wu16 65535.00 DFES_OneToOne 0.00 65535.00 FORMAT "%8.2" /end CHARACTERISTIC
/begin CHARACTERISTIC DFES_DTCO.DFC_KRVEKOEVAB1_C "OBD specific trouble code / OBD specific diagnostic trouble code for check DFC_KRVEKOEVAB1" VALUE 0x80503EC0 Val_Wu16 65535.00 DFES_OneToOne 0.00 65535.00 FORMAT "%8.2" /end CHARACTERISTIC
/begin CHARACTERISTIC DFES_DTCO.DFC_KRVEKOEVAB2_C "OBD specific trouble code / OBD specific diagnostic trouble code for check DFC_KRVEKOEVAB2" VALUE 0x80503EC2 Val_Wu16 65535.00 DFES_OneToOne 0.00 65535.00 FORMAT "%8.2" /end CHARACTERISTIC
/begin CHARACTERISTIC DFES_DTCO.DFC_KRVEKOEVAB3_C "OBD specific trouble code / OBD specific diagnostic trouble code for check DFC_KRVEKOEVAB3" VALUE 0x80503EC4 Val_Wu16 65535.00 DFES_OneToOne 0.00 65535.00 FORMAT "%8.2" /end CHARACTERISTIC
/begin CHARACTERISTIC DFES_DTCO.DFC_UegoSigEcuAsicS1B1_C "OBD specific trouble code / OBD specific diagnostic trouble code for check DFC_UegoSigEcuAsicS1B1" VALUE 0x80503EC6 Val_Wu16 65535.00 DFES_OneToOne 0.00 65535.00 FORMAT "%8.2" /end CHARACTERISTIC
/begin CHARACTERISTIC DFES_DTCO.DFC_UegoSigEcuComS1B1_C "OBD specific trouble code / OBD specific diagnostic trouble code for check DFC_UegoSigEcuComS1B1" VALUE 0x80503EC8 Val_Wu16 65535.00 DFES_OneToOne 0.00 65535.00 FORMAT "%8.2" /end CHARACTERISTIC
/begin CHARACTERISTIC DFES_DTCO.DFC_UegoSigSnsrS1B1_C "OBD specific trouble code / OBD specific diagnostic trouble code for check DFC_UegoSigSnsrS1B1" VALUE 0x80503ECA Val_Wu16 65535.00 DFES_OneToOne 0.00 65535.00 FORMAT "%8.2" /end CHARACTERISTIC
/begin CHARACTERISTIC DFES_DTCO.DFC_UegoSigWireOlApesS1B1_C "OBD specific trouble code / OBD specific diagnostic trouble code for check DFC_UegoSigWireOlApesS1B1" VALUE 0x80503ECC Val_Wu16 65535.00 DFES_OneToOne 0.00 65535.00 FORMAT "%8.2" /end CHARACTERISTIC
/begin CHARACTERISTIC DFES_DTCO.DFC_UegoSigWireOlIpeS1B1_C "OBD specific trouble code / OBD specific diagnostic trouble code for check DFC_UegoSigWireOlIpeS1B1" VALUE 0x80503ECE Val_Wu16 65535.00 DFES_OneToOne 0.00 65535.00 FORMAT "%8.2" /end CHARACTERISTIC
/begin CHARACTERISTIC DFES_DTCO.DFC_UegoSigWireOlReS1B1_C "OBD specific trouble code / OBD specific diagnostic trouble code for check DFC_UegoSigWireOlReS1B1" VALUE 0x80503ED0 Val_Wu16 65535.00 DFES_OneToOne 0.00 65535.00 FORMAT "%8.2" /end CHARACTERISTIC
/begin CHARACTERISTIC DFES_DTCO.DFC_UegoSigWireRCmpS1B1_C "OBD specific trouble code / OBD specific diagnostic trouble code for check DFC_UegoSigWireRCmpS1B1" VALUE 0x80503ED2 Val_Wu16 65535.00 DFES_OneToOne 0.00 65535.00 FORMAT "%8.2" /end CHARACTERISTIC
/begin CHARACTERISTIC DFES_DTCO.DFC_UegoSigWireScbS1B1_C "OBD specific trouble code / OBD specific diagnostic trouble code for check DFC_UegoSigWireScbS1B1" VALUE 0x80503ED4 Val_Wu16 65535.00 DFES_OneToOne 0.00 65535.00 FORMAT "%8.2" /end CHARACTERISTIC
/begin CHARACTERISTIC DFES_DTCO.DFC_UegoSigWireScgS1B1_C "OBD specific trouble code / OBD specific diagnostic trouble code for check DFC_UegoSigWireScgS1B1" VALUE 0x80503ED6 Val_Wu16 65535.00 DFES_OneToOne 0.00 65535.00 FORMAT "%8.2" /end CHARACTERISTIC
/begin CHARACTERISTIC DFES_DTCO.DFC_AfsPhyRngHiB1_C "OBD specific trouble code / OBD specific diagnostic trouble code for check DFC_AfsPhyRngHiB1" VALUE 0x80503ED8 Val_Wu16 65535.00 DFES_OneToOne 0.00 65535.00 FORMAT "%8.2" /end CHARACTERISTIC
/begin CHARACTERISTIC DFES_DTCO.DFC_AfsPhyRngLoB1_C "OBD specific trouble code / OBD specific diagnostic trouble code for check DFC_AfsPhyRngLoB1" VALUE 0x80503EDA Val_Wu16 65535.00 DFES_OneToOne 0.00 65535.00 FORMAT "%8.2" /end CHARACTERISTIC
/begin CHARACTERISTIC DFES_DTCO.DFC_AirCCmprOL_C "OBD specific trouble code / OBD specific diagnostic trouble code for check DFC_AirCCmprOL" VALUE 0x80503EDC Val_Wu16 65535.00 DFES_OneToOne 0.00 65535.00 FORMAT "%8.2" /end CHARACTERISTIC
/begin CHARACTERISTIC DFES_DTCO.DFC_AirCCmprOvrTemp_C "OBD specific trouble code / OBD specific diagnostic trouble code for check DFC_AirCCmprOvrTemp" VALUE 0x80503EDE Val_Wu16 65535.00 DFES_OneToOne 0.00 65535.00 FORMAT "%8.2" /end CHARACTERISTIC
/begin CHARACTERISTIC DFES_DTCO.DFC_AirCCmprSCB_C "OBD specific trouble code / OBD specific diagnostic trouble code for check DFC_AirCCmprSCB" VALUE 0x80503EE0 Val_Wu16 65535.00 DFES_OneToOne 0.00 65535.00 FORMAT "%8.2" /end CHARACTERISTIC
/begin CHARACTERISTIC DFES_DTCO.DFC_AirCCmprSCG_C "OBD specific trouble code / OBD specific diagnostic trouble code for check DFC_AirCCmprSCG" VALUE 0x80503EE2 Val_Wu16 65535.00 DFES_OneToOne 0.00 65535.00 FORMAT "%8.2" /end CHARACTERISTIC
/begin CHARACTERISTIC DFES_DTCO.DFC_AltErr_C "OBD specific trouble code / OBD specific diagnostic trouble code for check DFC_AltErr" VALUE 0x80503EE4 Val_Wu16 65535.00 DFES_OneToOne 0.00 65535.00 FORMAT "%8.2" /end CHARACTERISTIC
/begin CHARACTERISTIC DFES_DTCO.DFC_BattUSRCMax_C "OBD specific trouble code / OBD specific diagnostic trouble code for check DFC_BattUSRCMax" VALUE 0x80503EE6 Val_Wu16 65535.00 DFES_OneToOne 0.00 65535.00 FORMAT "%8.2" /end CHARACTERISTIC
/begin CHARACTERISTIC DFES_DTCO.DFC_BattUSRCMin_C "OBD specific trouble code / OBD specific diagnostic trouble code for check DFC_BattUSRCMin" VALUE 0x80503EE8 Val_Wu16 65535.00 DFES_OneToOne 0.00 65535.00 FORMAT "%8.2" /end CHARACTERISTIC
/begin CHARACTERISTIC DFES_DTCO.DFC_ComChksTCU1_C "OBD specific trouble code / OBD specific diagnostic trouble code for check DFC_ComChksTCU1" VALUE 0x80503EEA Val_Wu16 65535.00 DFES_OneToOne 0.00 65535.00 FORMAT "%8.2" /end CHARACTERISTIC
/begin CHARACTERISTIC DFES_DTCO.DFC_ComChksTCU11_C "OBD specific trouble code / OBD specific diagnostic trouble code for check DFC_ComChksTCU11" VALUE 0x80503EEC Val_Wu16 65535.00 DFES_OneToOne 0.00 65535.00 FORMAT "%8.2" /end CHARACTERISTIC
/begin CHARACTERISTIC DFES_DTCO.DFC_ComChksTCU12_C "OBD specific trouble code / OBD specific diagnostic trouble code for check DFC_ComChksTCU12" VALUE 0x80503EEE Val_Wu16 65535.00 DFES_OneToOne 0.00 65535.00 FORMAT "%8.2" /end CHARACTERISTIC
/begin CHARACTERISTIC DFES_DTCO.DFC_ComChksTCU13_C "OBD specific trouble code / OBD specific diagnostic trouble code for check DFC_ComChksTCU13" VALUE 0x80503EF0 Val_Wu16 65535.00 DFES_OneToOne 0.00 65535.00 FORMAT "%8.2" /end CHARACTERISTIC
/begin CHARACTERISTIC DFES_DTCO.DFC_ComChksTCU2_C "OBD specific trouble code / OBD specific diagnostic trouble code for check DFC_ComChksTCU2" VALUE 0x80503EF2 Val_Wu16 65535.00 DFES_OneToOne 0.00 65535.00 FORMAT "%8.2" /end CHARACTERISTIC
/begin CHARACTERISTIC DFES_DTCO.DFC_ComChksTCU3_C "OBD specific trouble code / OBD specific diagnostic trouble code for check DFC_ComChksTCU3" VALUE 0x80503EF4 Val_Wu16 65535.00 DFES_OneToOne 0.00 65535.00 FORMAT "%8.2" /end CHARACTERISTIC
/begin CHARACTERISTIC DFES_DTCO.DFC_ComChksTCU4_C "OBD specific trouble code / OBD specific diagnostic trouble code for check DFC_ComChksTCU4" VALUE 0x80503EF6 Val_Wu16 65535.00 DFES_OneToOne 0.00 65535.00 FORMAT "%8.2" /end CHARACTERISTIC
/begin CHARACTERISTIC DFES_DTCO.DFC_ComCntTCU1_C "OBD specific trouble code / OBD specific diagnostic trouble code for check DFC_ComCntTCU1" VALUE 0x80503EF8 Val_Wu16 65535.00 DFES_OneToOne 0.00 65535.00 FORMAT "%8.2" /end CHARACTERISTIC
/begin CHARACTERISTIC DFES_DTCO.DFC_ComCntTCU11_C "OBD specific trouble code / OBD specific diagnostic trouble code for check DFC_ComCntTCU11" VALUE 0x80503EFA Val_Wu16 65535.00 DFES_OneToOne 0.00 65535.00 FORMAT "%8.2" /end CHARACTERISTIC
/begin CHARACTERISTIC DFES_DTCO.DFC_ComCntTCU12_C "OBD specific trouble code / OBD specific diagnostic trouble code for check DFC_ComCntTCU12" VALUE 0x80503EFC Val_Wu16 65535.00 DFES_OneToOne 0.00 65535.00 FORMAT "%8.2" /end CHARACTERISTIC
/begin CHARACTERISTIC DFES_DTCO.DFC_ComCntTCU13_C "OBD specific trouble code / OBD specific diagnostic trouble code for check DFC_ComCntTCU13" VALUE 0x80503EFE Val_Wu16 65535.00 DFES_OneToOne 0.00 65535.00 FORMAT "%8.2" /end CHARACTERISTIC
/begin CHARACTERISTIC DFES_DTCO.DFC_ComCntTCU2_C "OBD specific trouble code / OBD specific diagnostic trouble code for check DFC_ComCntTCU2" VALUE 0x80503F00 Val_Wu16 65535.00 DFES_OneToOne 0.00 65535.00 FORMAT "%8.2" /end CHARACTERISTIC
/begin CHARACTERISTIC DFES_DTCO.DFC_ComCntTCU3_C "OBD specific trouble code / OBD specific diagnostic trouble code for check DFC_ComCntTCU3" VALUE 0x80503F02 Val_Wu16 65535.00 DFES_OneToOne 0.00 65535.00 FORMAT "%8.2" /end CHARACTERISTIC
/begin CHARACTERISTIC DFES_DTCO.DFC_ComCntTCU4_C "OBD specific trouble code / OBD specific diagnostic trouble code for check DFC_ComCntTCU4" VALUE 0x80503F04 Val_Wu16 65535.00 DFES_OneToOne 0.00 65535.00 FORMAT "%8.2" /end CHARACTERISTIC
/begin CHARACTERISTIC DFES_DTCO.DFC_ComTOutTCU01_C "OBD specific trouble code / OBD specific diagnostic trouble code for check DFC_ComTOutTCU01" VALUE 0x80503F06 Val_Wu16 65535.00 DFES_OneToOne 0.00 65535.00 FORMAT "%8.2" /end CHARACTERISTIC
/begin CHARACTERISTIC DFES_DTCO.DFC_ComTOutTCU02_C "OBD specific trouble code / OBD specific diagnostic trouble code for check DFC_ComTOutTCU02" VALUE 0x80503F08 Val_Wu16 65535.00 DFES_OneToOne 0.00 65535.00 FORMAT "%8.2" /end CHARACTERISTIC
/begin CHARACTERISTIC DFES_DTCO.DFC_ComTOutTCU1_C "OBD specific trouble code / OBD specific diagnostic trouble code for check DFC_ComTOutTCU1" VALUE 0x80503F0A Val_Wu16 65535.00 DFES_OneToOne 0.00 65535.00 FORMAT "%8.2" /end CHARACTERISTIC
/begin CHARACTERISTIC DFES_DTCO.DFC_ComTOutTCU11_C "OBD specific trouble code / OBD specific diagnostic trouble code for check DFC_ComTOutTCU11" VALUE 0x80503F0C Val_Wu16 65535.00 DFES_OneToOne 0.00 65535.00 FORMAT "%8.2" /end CHARACTERISTIC
/begin CHARACTERISTIC DFES_DTCO.DFC_ComTOutTCU12_C "OBD specific trouble code / OBD specific diagnostic trouble code for check DFC_ComTOutTCU12" VALUE 0x80503F0E Val_Wu16 65535.00 DFES_OneToOne 0.00 65535.00 FORMAT "%8.2" /end CHARACTERISTIC
/begin CHARACTERISTIC DFES_DTCO.DFC_ComTOutTCU13_C "OBD specific trouble code / OBD specific diagnostic trouble code for check DFC_ComTOutTCU13" VALUE 0x80503F10 Val_Wu16 65535.00 DFES_OneToOne 0.00 65535.00 FORMAT "%8.2" /end CHARACTERISTIC
/begin CHARACTERISTIC DFES_DTCO.DFC_ComTOutTCU14_C "OBD specific trouble code / OBD specific diagnostic trouble code for check DFC_ComTOutTCU14" VALUE 0x80503F12 Val_Wu16 65535.00 DFES_OneToOne 0.00 65535.00 FORMAT "%8.2" /end CHARACTERISTIC
/begin CHARACTERISTIC DFES_DTCO.DFC_ComTOutTCU2_C "OBD specific trouble code / OBD specific diagnostic trouble code for check DFC_ComTOutTCU2" VALUE 0x80503F14 Val_Wu16 65535.00 DFES_OneToOne 0.00 65535.00 FORMAT "%8.2" /end CHARACTERISTIC
/begin CHARACTERISTIC DFES_DTCO.DFC_ComTOutTCU3_C "OBD specific trouble code / OBD specific diagnostic trouble code for check DFC_ComTOutTCU3" VALUE 0x80503F16 Val_Wu16 65535.00 DFES_OneToOne 0.00 65535.00 FORMAT "%8.2" /end CHARACTERISTIC
/begin CHARACTERISTIC DFES_DTCO.DFC_ComTOutTCU4_C "OBD specific trouble code / OBD specific diagnostic trouble code for check DFC_ComTOutTCU4" VALUE 0x80503F18 Val_Wu16 65535.00 DFES_OneToOne 0.00 65535.00 FORMAT "%8.2" /end CHARACTERISTIC
/begin CHARACTERISTIC DFES_DTCO.DFC_DevLibBattUHi_C "OBD specific trouble code / OBD specific diagnostic trouble code for check DFC_DevLibBattUHi" VALUE 0x80503F1A Val_Wu16 65535.00 DFES_OneToOne 0.00 65535.00 FORMAT "%8.2" /end CHARACTERISTIC
/begin CHARACTERISTIC DFES_DTCO.DFC_DevLibBattULo_C "OBD specific trouble code / OBD specific diagnostic trouble code for check DFC_DevLibBattULo" VALUE 0x80503F1C Val_Wu16 65535.00 DFES_OneToOne 0.00 65535.00 FORMAT "%8.2" /end CHARACTERISTIC
/begin CHARACTERISTIC DFES_DTCO.DFC_EGRVlvFailSafeActv_C "OBD specific trouble code / OBD specific diagnostic trouble code for check DFC_EGRVlvFailSafeActv" VALUE 0x80503F1E Val_Wu16 65535.00 DFES_OneToOne 0.00 65535.00 FORMAT "%8.2" /end CHARACTERISTIC
/begin CHARACTERISTIC DFES_DTCO.DFC_EGRVlvGovDvtCld_C "OBD specific trouble code / OBD specific diagnostic trouble code for check DFC_EGRVlvGovDvtCld" VALUE 0x80503F20 Val_Wu16 65535.00 DFES_OneToOne 0.00 65535.00 FORMAT "%8.2" /end CHARACTERISTIC
/begin CHARACTERISTIC DFES_DTCO.DFC_EGRVlvPhysSRCMax_C "OBD specific trouble code / OBD specific diagnostic trouble code for check DFC_EGRVlvPhysSRCMax" VALUE 0x80503F22 Val_Wu16 65535.00 DFES_OneToOne 0.00 65535.00 FORMAT "%8.2" /end CHARACTERISTIC
/begin CHARACTERISTIC DFES_DTCO.DFC_EGRVlvPhysSRCMin_C "OBD specific trouble code / OBD specific diagnostic trouble code for check DFC_EGRVlvPhysSRCMin" VALUE 0x80503F24 Val_Wu16 65535.00 DFES_OneToOne 0.00 65535.00 FORMAT "%8.2" /end CHARACTERISTIC
/begin CHARACTERISTIC DFES_DTCO.DFC_FanDIOOL_0_C "OBD specific trouble code / OBD specific diagnostic trouble code for check DFC_FanDIOOL_0" VALUE 0x80503F26 Val_Wu16 65535.00 DFES_OneToOne 0.00 65535.00 FORMAT "%8.2" /end CHARACTERISTIC
/begin CHARACTERISTIC DFES_DTCO.DFC_FanDIOOL_1_C "OBD specific trouble code / OBD specific diagnostic trouble code for check DFC_FanDIOOL_1" VALUE 0x80503F28 Val_Wu16 65535.00 DFES_OneToOne 0.00 65535.00 FORMAT "%8.2" /end CHARACTERISTIC
/begin CHARACTERISTIC DFES_DTCO.DFC_FanDIOOvrTemp_0_C "OBD specific trouble code / OBD specific diagnostic trouble code for check DFC_FanDIOOvrTemp_0" VALUE 0x80503F2A Val_Wu16 65535.00 DFES_OneToOne 0.00 65535.00 FORMAT "%8.2" /end CHARACTERISTIC
/begin CHARACTERISTIC DFES_DTCO.DFC_FanDIOOvrTemp_1_C "OBD specific trouble code / OBD specific diagnostic trouble code for check DFC_FanDIOOvrTemp_1" VALUE 0x80503F2C Val_Wu16 65535.00 DFES_OneToOne 0.00 65535.00 FORMAT "%8.2" /end CHARACTERISTIC
/begin CHARACTERISTIC DFES_DTCO.DFC_FanDIOSCB_0_C "OBD specific trouble code / OBD specific diagnostic trouble code for check DFC_FanDIOSCB_0" VALUE 0x80503F2E Val_Wu16 65535.00 DFES_OneToOne 0.00 65535.00 FORMAT "%8.2" /end CHARACTERISTIC
/begin CHARACTERISTIC DFES_DTCO.DFC_FanDIOSCB_1_C "OBD specific trouble code / OBD specific diagnostic trouble code for check DFC_FanDIOSCB_1" VALUE 0x80503F30 Val_Wu16 65535.00 DFES_OneToOne 0.00 65535.00 FORMAT "%8.2" /end CHARACTERISTIC
/begin CHARACTERISTIC DFES_DTCO.DFC_FanDIOSCG_0_C "OBD specific trouble code / OBD specific diagnostic trouble code for check DFC_FanDIOSCG_0" VALUE 0x80503F32 Val_Wu16 65535.00 DFES_OneToOne 0.00 65535.00 FORMAT "%8.2" /end CHARACTERISTIC
/begin CHARACTERISTIC DFES_DTCO.DFC_FanDIOSCG_1_C "OBD specific trouble code / OBD specific diagnostic trouble code for check DFC_FanDIOSCG_1" VALUE 0x80503F34 Val_Wu16 65535.00 DFES_OneToOne 0.00 65535.00 FORMAT "%8.2" /end CHARACTERISTIC
/begin CHARACTERISTIC DFES_DTCO.DFC_MRlyDcOL_C "OBD specific trouble code / OBD specific diagnostic trouble code for check DFC_MRlyDcOL" VALUE 0x80503F36 Val_Wu16 65535.00 DFES_OneToOne 0.00 65535.00 FORMAT "%8.2" /end CHARACTERISTIC
/begin CHARACTERISTIC DFES_DTCO.DFC_MRlyDcSCB_C "OBD specific trouble code / OBD specific diagnostic trouble code for check DFC_MRlyDcSCB" VALUE 0x80503F38 Val_Wu16 65535.00 DFES_OneToOne 0.00 65535.00 FORMAT "%8.2" /end CHARACTERISTIC
/begin CHARACTERISTIC DFES_DTCO.DFC_MRlyDcSCG_C "OBD specific trouble code / OBD specific diagnostic trouble code for check DFC_MRlyDcSCG" VALUE 0x80503F3A Val_Wu16 65535.00 DFES_OneToOne 0.00 65535.00 FORMAT "%8.2" /end CHARACTERISTIC
/begin CHARACTERISTIC DFES_DTCO.DFC_PSPOL_C "OBD specific trouble code / OBD specific diagnostic trouble code for check DFC_PSPOL" VALUE 0x80503F3C Val_Wu16 65535.00 DFES_OneToOne 0.00 65535.00 FORMAT "%8.2" /end CHARACTERISTIC
/begin CHARACTERISTIC DFES_DTCO.DFC_PSPOvrTemp_C "OBD specific trouble code / OBD specific diagnostic trouble code for check DFC_PSPOvrTemp" VALUE 0x80503F3E Val_Wu16 65535.00 DFES_OneToOne 0.00 65535.00 FORMAT "%8.2" /end CHARACTERISTIC
/begin CHARACTERISTIC DFES_DTCO.DFC_PSPSCB_C "OBD specific trouble code / OBD specific diagnostic trouble code for check DFC_PSPSCB" VALUE 0x80503F40 Val_Wu16 65535.00 DFES_OneToOne 0.00 65535.00 FORMAT "%8.2" /end CHARACTERISTIC
/begin CHARACTERISTIC DFES_DTCO.DFC_PSPSCG_C "OBD specific trouble code / OBD specific diagnostic trouble code for check DFC_PSPSCG" VALUE 0x80503F42 Val_Wu16 65535.00 DFES_OneToOne 0.00 65535.00 FORMAT "%8.2" /end CHARACTERISTIC
/begin CHARACTERISTIC DFES_DTCO.DFC_T50Err_C "OBD specific trouble code / OBD specific diagnostic trouble code for check DFC_T50Err" VALUE 0x80503F44 Val_Wu16 65535.00 DFES_OneToOne 0.00 65535.00 FORMAT "%8.2" /end CHARACTERISTIC
/begin CHARACTERISTIC DFES_DTCO.DFC_ThrVlvLoBattB1_C "OBD specific trouble code / OBD specific diagnostic trouble code for check DFC_ThrVlvLoBattB1" VALUE 0x80503F46 Val_Wu16 65535.00 DFES_OneToOne 0.00 65535.00 FORMAT "%8.2" /end CHARACTERISTIC
/begin CHARACTERISTIC DFES_DTCO.DFC_UegoSigOperPlausS1B1_C "OBD specific trouble code / OBD specific diagnostic trouble code for check DFC_UegoSigOperPlausS1B1" VALUE 0x80503F48 Val_Wu16 65535.00 DFES_OneToOne 0.00 65535.00 FORMAT "%8.2" /end CHARACTERISTIC
/begin CHARACTERISTIC DFES_DTCO.DFC_VehVPhysRngHi_C "OBD specific trouble code / OBD specific diagnostic trouble code for check DFC_VehVPhysRngHi" VALUE 0x80503F4A Val_Wu16 65535.00 DFES_OneToOne 0.00 65535.00 FORMAT "%8.2" /end CHARACTERISTIC
/begin CHARACTERISTIC DFES_DTCO.DFC_VehVSclOutOL_C "OBD specific trouble code / OBD specific diagnostic trouble code for check DFC_VehVSclOutOL" VALUE 0x80503F4C Val_Wu16 65535.00 DFES_OneToOne 0.00 65535.00 FORMAT "%8.2" /end CHARACTERISTIC
/begin CHARACTERISTIC DFES_DTCO.DFC_VehVSclOutOT_C "OBD specific trouble code / OBD specific diagnostic trouble code for check DFC_VehVSclOutOT" VALUE 0x80503F4E Val_Wu16 65535.00 DFES_OneToOne 0.00 65535.00 FORMAT "%8.2" /end CHARACTERISTIC
/begin CHARACTERISTIC DFES_DTCO.DFC_VehVSclOutSCB_C "OBD specific trouble code / OBD specific diagnostic trouble code for check DFC_VehVSclOutSCB" VALUE 0x80503F50 Val_Wu16 65535.00 DFES_OneToOne 0.00 65535.00 FORMAT "%8.2" /end CHARACTERISTIC
/begin CHARACTERISTIC DFES_DTCO.DFC_VehVSclOutSCG_C "OBD specific trouble code / OBD specific diagnostic trouble code for check DFC_VehVSclOutSCG" VALUE 0x80503F52 Val_Wu16 65535.00 DFES_OneToOne 0.00 65535.00 FORMAT "%8.2" /end CHARACTERISTIC
/begin CHARACTERISTIC DFES_DTCO.DFC_VehVSigFL_C "OBD specific trouble code / OBD specific diagnostic trouble code for check DFC_VehVSigFL" VALUE 0x80503F54 Val_Wu16 65535.00 DFES_OneToOne 0.00 65535.00 FORMAT "%8.2" /end CHARACTERISTIC
/begin CHARACTERISTIC DFES_DTCO.DFC_VehVSigFR_C "OBD specific trouble code / OBD specific diagnostic trouble code for check DFC_VehVSigFR" VALUE 0x80503F56 Val_Wu16 65535.00 DFES_OneToOne 0.00 65535.00 FORMAT "%8.2" /end CHARACTERISTIC
/begin CHARACTERISTIC DFES_DTCO.DFC_VehVSigRL_C "OBD specific trouble code / OBD specific diagnostic trouble code for check DFC_VehVSigRL" VALUE 0x80503F58 Val_Wu16 65535.00 DFES_OneToOne 0.00 65535.00 FORMAT "%8.2" /end CHARACTERISTIC
/begin CHARACTERISTIC DFES_DTCO.DFC_VehVSigRR_C "OBD specific trouble code / OBD specific diagnostic trouble code for check DFC_VehVSigRR" VALUE 0x80503F5A Val_Wu16 65535.00 DFES_OneToOne 0.00 65535.00 FORMAT "%8.2" /end CHARACTERISTIC
/begin CHARACTERISTIC DFES_DTCO.DFC_VehVSnsrARngHi_C "OBD specific trouble code / OBD specific diagnostic trouble code for check DFC_VehVSnsrARngHi" VALUE 0x80503F5C Val_Wu16 65535.00 DFES_OneToOne 0.00 65535.00 FORMAT "%8.2" /end CHARACTERISTIC
/begin CHARACTERISTIC DFES_DTCO.DFC_VehVSnsrBRngHi_C "OBD specific trouble code / OBD specific diagnostic trouble code for check DFC_VehVSnsrBRngHi" VALUE 0x80503F5E Val_Wu16 65535.00 DFES_OneToOne 0.00 65535.00 FORMAT "%8.2" /end CHARACTERISTIC
/begin CHARACTERISTIC DFES_DTCO.DFC_VehVSpdRtyDiag_C "OBD specific trouble code / OBD specific diagnostic trouble code for check DFC_VehVSpdRtyDiag" VALUE 0x80503F60 Val_Wu16 65535.00 DFES_OneToOne 0.00 65535.00 FORMAT "%8.2" /end CHARACTERISTIC
/begin CHARACTERISTIC DFES_DTCO.DFC_DHFHD_C "OBD specific trouble code / OBD specific diagnostic trouble code for check DFC_DHFHD" VALUE 0x80503F62 Val_Wu16 65535.00 DFES_OneToOne 0.00 65535.00 FORMAT "%8.2" /end CHARACTERISTIC
/begin CHARACTERISTIC DFES_DTCO.DFC_InjVlv_DI_DcDc_C "OBD specific trouble code / OBD specific diagnostic trouble code for check DFC_InjVlv_DI_DcDc" VALUE 0x80503F64 Val_Wu16 65535.00 DFES_OneToOne 0.00 65535.00 FORMAT "%8.2" /end CHARACTERISTIC
/begin CHARACTERISTIC DFES_DTCO.DFC_InjVlv_DI_NoLd_0_C "OBD specific trouble code / OBD specific diagnostic trouble code for check DFC_InjVlv_DI_NoLd_0" VALUE 0x80503F66 Val_Wu16 65535.00 DFES_OneToOne 0.00 65535.00 FORMAT "%8.2" /end CHARACTERISTIC
/begin CHARACTERISTIC DFES_DTCO.DFC_InjVlv_DI_NoLd_1_C "OBD specific trouble code / OBD specific diagnostic trouble code for check DFC_InjVlv_DI_NoLd_1" VALUE 0x80503F68 Val_Wu16 65535.00 DFES_OneToOne 0.00 65535.00 FORMAT "%8.2" /end CHARACTERISTIC
/begin CHARACTERISTIC DFES_DTCO.DFC_InjVlv_DI_NoLd_2_C "OBD specific trouble code / OBD specific diagnostic trouble code for check DFC_InjVlv_DI_NoLd_2" VALUE 0x80503F6A Val_Wu16 65535.00 DFES_OneToOne 0.00 65535.00 FORMAT "%8.2" /end CHARACTERISTIC
/begin CHARACTERISTIC DFES_DTCO.DFC_InjVlv_DI_NoLd_3_C "OBD specific trouble code / OBD specific diagnostic trouble code for check DFC_InjVlv_DI_NoLd_3" VALUE 0x80503F6C Val_Wu16 65535.00 DFES_OneToOne 0.00 65535.00 FORMAT "%8.2" /end CHARACTERISTIC
/begin CHARACTERISTIC DFES_DTCO.DFC_InjVlv_DI_ScBnk_0_C "OBD specific trouble code / OBD specific diagnostic trouble code for check DFC_InjVlv_DI_ScBnk_0" VALUE 0x80503F6E Val_Wu16 65535.00 DFES_OneToOne 0.00 65535.00 FORMAT "%8.2" /end CHARACTERISTIC
/begin CHARACTERISTIC DFES_DTCO.DFC_InjVlv_DI_ScBnk_1_C "OBD specific trouble code / OBD specific diagnostic trouble code for check DFC_InjVlv_DI_ScBnk_1" VALUE 0x80503F70 Val_Wu16 65535.00 DFES_OneToOne 0.00 65535.00 FORMAT "%8.2" /end CHARACTERISTIC
/begin CHARACTERISTIC DFES_DTCO.DFC_InjVlv_DI_ScBnk_2_C "OBD specific trouble code / OBD specific diagnostic trouble code for check DFC_InjVlv_DI_ScBnk_2" VALUE 0x80503F72 Val_Wu16 65535.00 DFES_OneToOne 0.00 65535.00 FORMAT "%8.2" /end CHARACTERISTIC
/begin CHARACTERISTIC DFES_DTCO.DFC_InjVlv_DI_ScBnk_3_C "OBD specific trouble code / OBD specific diagnostic trouble code for check DFC_InjVlv_DI_ScBnk_3" VALUE 0x80503F74 Val_Wu16 65535.00 DFES_OneToOne 0.00 65535.00 FORMAT "%8.2" /end CHARACTERISTIC
/begin CHARACTERISTIC DFES_DTCO.DFC_InjVlv_DI_ScCyl_0_C "OBD specific trouble code / OBD specific diagnostic trouble code for check DFC_InjVlv_DI_ScCyl_0" VALUE 0x80503F76 Val_Wu16 65535.00 DFES_OneToOne 0.00 65535.00 FORMAT "%8.2" /end CHARACTERISTIC
/begin CHARACTERISTIC DFES_DTCO.DFC_InjVlv_DI_ScCyl_1_C "OBD specific trouble code / OBD specific diagnostic trouble code for check DFC_InjVlv_DI_ScCyl_1" VALUE 0x80503F78 Val_Wu16 65535.00 DFES_OneToOne 0.00 65535.00 FORMAT "%8.2" /end CHARACTERISTIC
/begin CHARACTERISTIC DFES_DTCO.DFC_InjVlv_DI_ScCyl_2_C "OBD specific trouble code / OBD specific diagnostic trouble code for check DFC_InjVlv_DI_ScCyl_2" VALUE 0x80503F7A Val_Wu16 65535.00 DFES_OneToOne 0.00 65535.00 FORMAT "%8.2" /end CHARACTERISTIC
/begin CHARACTERISTIC DFES_DTCO.DFC_InjVlv_DI_ScCyl_3_C "OBD specific trouble code / OBD specific diagnostic trouble code for check DFC_InjVlv_DI_ScCyl_3" VALUE 0x80503F7C Val_Wu16 65535.00 DFES_OneToOne 0.00 65535.00 FORMAT "%8.2" /end CHARACTERISTIC
/begin CHARACTERISTIC DFES_DTCO.DFC_InjVlv_DI_ScHsLs_0_C "OBD specific trouble code / OBD specific diagnostic trouble code for check DFC_InjVlv_DI_ScHsLs_0" VALUE 0x80503F7E Val_Wu16 65535.00 DFES_OneToOne 0.00 65535.00 FORMAT "%8.2" /end CHARACTERISTIC
/begin CHARACTERISTIC DFES_DTCO.DFC_InjVlv_DI_ScHsLs_1_C "OBD specific trouble code / OBD specific diagnostic trouble code for check DFC_InjVlv_DI_ScHsLs_1" VALUE 0x80503F80 Val_Wu16 65535.00 DFES_OneToOne 0.00 65535.00 FORMAT "%8.2" /end CHARACTERISTIC
/begin CHARACTERISTIC DFES_DTCO.DFC_InjVlv_DI_ScHsLs_2_C "OBD specific trouble code / OBD specific diagnostic trouble code for check DFC_InjVlv_DI_ScHsLs_2" VALUE 0x80503F82 Val_Wu16 65535.00 DFES_OneToOne 0.00 65535.00 FORMAT "%8.2" /end CHARACTERISTIC
/begin CHARACTERISTIC DFES_DTCO.DFC_InjVlv_DI_ScHsLs_3_C "OBD specific trouble code / OBD specific diagnostic trouble code for check DFC_InjVlv_DI_ScHsLs_3" VALUE 0x80503F84 Val_Wu16 65535.00 DFES_OneToOne 0.00 65535.00 FORMAT "%8.2" /end CHARACTERISTIC
/begin CHARACTERISTIC DFES_DTCO.DFC_MfPsDiaOpenLoad1_C "OBD specific trouble code / OBD specific diagnostic trouble code for check DFC_MfPsDiaOpenLoad1" VALUE 0x80503F86 Val_Wu16 65535.00 DFES_OneToOne 0.00 65535.00 FORMAT "%8.2" /end CHARACTERISTIC
/begin CHARACTERISTIC DFES_DTCO.DFC_MfPsDiaScHiS1_C "OBD specific trouble code / OBD specific diagnostic trouble code for check DFC_MfPsDiaScHiS1" VALUE 0x80503F88 Val_Wu16 65535.00 DFES_OneToOne 0.00 65535.00 FORMAT "%8.2" /end CHARACTERISTIC
/begin CHARACTERISTIC DFES_DTCO.DFC_MfPsDiaScHiSLowS1_C "OBD specific trouble code / OBD specific diagnostic trouble code for check DFC_MfPsDiaScHiSLowS1" VALUE 0x80503F8A Val_Wu16 65535.00 DFES_OneToOne 0.00 65535.00 FORMAT "%8.2" /end CHARACTERISTIC
/begin CHARACTERISTIC DFES_DTCO.DFC_MfPsDiaScLowS1_C "OBD specific trouble code / OBD specific diagnostic trouble code for check DFC_MfPsDiaScLowS1" VALUE 0x80503F8C Val_Wu16 65535.00 DFES_OneToOne 0.00 65535.00 FORMAT "%8.2" /end CHARACTERISTIC
/begin CHARACTERISTIC DFES_DTCO.DFC_ACEvpTPhysRngHi_C "OBD specific trouble code / OBD specific diagnostic trouble code for check DFC_ACEvpTPhysRngHi" VALUE 0x80503F8E Val_Wu16 65535.00 DFES_OneToOne 0.00 65535.00 FORMAT "%8.2" /end CHARACTERISTIC
/begin CHARACTERISTIC DFES_DTCO.DFC_ACEvpTPhysRngLo_C "OBD specific trouble code / OBD specific diagnostic trouble code for check DFC_ACEvpTPhysRngLo" VALUE 0x80503F90 Val_Wu16 65535.00 DFES_OneToOne 0.00 65535.00 FORMAT "%8.2" /end CHARACTERISTIC
/begin CHARACTERISTIC DFES_DTCO.DFC_ACEvpTSRCMax_C "OBD specific trouble code / OBD specific diagnostic trouble code for check DFC_ACEvpTSRCMax" VALUE 0x80503F92 Val_Wu16 65535.00 DFES_OneToOne 0.00 65535.00 FORMAT "%8.2" /end CHARACTERISTIC
/begin CHARACTERISTIC DFES_DTCO.DFC_ACEvpTSRCMin_C "OBD specific trouble code / OBD specific diagnostic trouble code for check DFC_ACEvpTSRCMin" VALUE 0x80503F94 Val_Wu16 65535.00 DFES_OneToOne 0.00 65535.00 FORMAT "%8.2" /end CHARACTERISTIC
/begin CHARACTERISTIC DFES_DTCO.DFC_AfsRawSigRngHiB1_C "OBD specific trouble code / OBD specific diagnostic trouble code for check DFC_AfsRawSigRngHiB1" VALUE 0x80503F96 Val_Wu16 65535.00 DFES_OneToOne 0.00 65535.00 FORMAT "%8.2" /end CHARACTERISTIC
/begin CHARACTERISTIC DFES_DTCO.DFC_AfsRawSigRngLoB1_C "OBD specific trouble code / OBD specific diagnostic trouble code for check DFC_AfsRawSigRngLoB1" VALUE 0x80503F98 Val_Wu16 65535.00 DFES_OneToOne 0.00 65535.00 FORMAT "%8.2" /end CHARACTERISTIC
/begin CHARACTERISTIC DFES_DTCO.DFC_AfsSnsrErrB1_C "OBD specific trouble code / OBD specific diagnostic trouble code for check DFC_AfsSnsrErrB1" VALUE 0x80503F9A Val_Wu16 65535.00 DFES_OneToOne 0.00 65535.00 FORMAT "%8.2" /end CHARACTERISTIC
/begin CHARACTERISTIC DFES_DTCO.DFC_AirCClntPAnaSRCMax_C "OBD specific trouble code / OBD specific diagnostic trouble code for check DFC_AirCClntPAnaSRCMax" VALUE 0x80503F9C Val_Wu16 65535.00 DFES_OneToOne 0.00 65535.00 FORMAT "%8.2" /end CHARACTERISTIC
/begin CHARACTERISTIC DFES_DTCO.DFC_AirCClntPAnaSRCMin_C "OBD specific trouble code / OBD specific diagnostic trouble code for check DFC_AirCClntPAnaSRCMin" VALUE 0x80503F9E Val_Wu16 65535.00 DFES_OneToOne 0.00 65535.00 FORMAT "%8.2" /end CHARACTERISTIC
/begin CHARACTERISTIC DFES_DTCO.DFC_AirCSwtNpl_C "OBD specific trouble code / OBD specific diagnostic trouble code for check DFC_AirCSwtNpl" VALUE 0x80503FA0 Val_Wu16 65535.00 DFES_OneToOne 0.00 65535.00 FORMAT "%8.2" /end CHARACTERISTIC
/begin CHARACTERISTIC DFES_DTCO.DFC_AirCSwtSig_C "OBD specific trouble code / OBD specific diagnostic trouble code for check DFC_AirCSwtSig" VALUE 0x80503FA2 Val_Wu16 65535.00 DFES_OneToOne 0.00 65535.00 FORMAT "%8.2" /end CHARACTERISTIC
/begin CHARACTERISTIC DFES_DTCO.DFC_Brk_C "OBD specific trouble code / OBD specific diagnostic trouble code for check DFC_Brk" VALUE 0x80503FA4 Val_Wu16 65535.00 DFES_OneToOne 0.00 65535.00 FORMAT "%8.2" /end CHARACTERISTIC
/begin CHARACTERISTIC DFES_DTCO.DFC_BrkBstSensSCB_C "OBD specific trouble code / OBD specific diagnostic trouble code for check DFC_BrkBstSensSCB" VALUE 0x80503FA6 Val_Wu16 65535.00 DFES_OneToOne 0.00 65535.00 FORMAT "%8.2" /end CHARACTERISTIC
/begin CHARACTERISTIC DFES_DTCO.DFC_BrkBstSensSCG_C "OBD specific trouble code / OBD specific diagnostic trouble code for check DFC_BrkBstSensSCG" VALUE 0x80503FA8 Val_Wu16 65535.00 DFES_OneToOne 0.00 65535.00 FORMAT "%8.2" /end CHARACTERISTIC
/begin CHARACTERISTIC DFES_DTCO.DFC_BrkSig_C "OBD specific trouble code / OBD specific diagnostic trouble code for check DFC_BrkSig" VALUE 0x80503FAA Val_Wu16 65535.00 DFES_OneToOne 0.00 65535.00 FORMAT "%8.2" /end CHARACTERISTIC
/begin CHARACTERISTIC DFES_DTCO.DFC_ClthSig_C "OBD specific trouble code / OBD specific diagnostic trouble code for check DFC_ClthSig" VALUE 0x80503FAC Val_Wu16 65535.00 DFES_OneToOne 0.00 65535.00 FORMAT "%8.2" /end CHARACTERISTIC
/begin CHARACTERISTIC DFES_DTCO.DFC_EGRVlvCurrLim_C "OBD specific trouble code / OBD specific diagnostic trouble code for check DFC_EGRVlvCurrLim" VALUE 0x80503FAE Val_Wu16 65535.00 DFES_OneToOne 0.00 65535.00 FORMAT "%8.2" /end CHARACTERISTIC
/begin CHARACTERISTIC DFES_DTCO.DFC_EGRVlvOL_C "OBD specific trouble code / OBD specific diagnostic trouble code for check DFC_EGRVlvOL" VALUE 0x80503FB0 Val_Wu16 65535.00 DFES_OneToOne 0.00 65535.00 FORMAT "%8.2" /end CHARACTERISTIC
/begin CHARACTERISTIC DFES_DTCO.DFC_EGRVlvOvrTemp_C "OBD specific trouble code / OBD specific diagnostic trouble code for check DFC_EGRVlvOvrTemp" VALUE 0x80503FB2 Val_Wu16 65535.00 DFES_OneToOne 0.00 65535.00 FORMAT "%8.2" /end CHARACTERISTIC
/begin CHARACTERISTIC DFES_DTCO.DFC_EGRVlvSCB_C "OBD specific trouble code / OBD specific diagnostic trouble code for check DFC_EGRVlvSCB" VALUE 0x80503FB4 Val_Wu16 65535.00 DFES_OneToOne 0.00 65535.00 FORMAT "%8.2" /end CHARACTERISTIC
/begin CHARACTERISTIC DFES_DTCO.DFC_EGRVlvSCG_C "OBD specific trouble code / OBD specific diagnostic trouble code for check DFC_EGRVlvSCG" VALUE 0x80503FB6 Val_Wu16 65535.00 DFES_OneToOne 0.00 65535.00 FORMAT "%8.2" /end CHARACTERISTIC
/begin CHARACTERISTIC DFES_DTCO.DFC_EGRVlvSRCMax_C "OBD specific trouble code / OBD specific diagnostic trouble code for check DFC_EGRVlvSRCMax" VALUE 0x80503FB8 Val_Wu16 65535.00 DFES_OneToOne 0.00 65535.00 FORMAT "%8.2" /end CHARACTERISTIC
/begin CHARACTERISTIC DFES_DTCO.DFC_EGRVlvSRCMin_C "OBD specific trouble code / OBD specific diagnostic trouble code for check DFC_EGRVlvSRCMin" VALUE 0x80503FBA Val_Wu16 65535.00 DFES_OneToOne 0.00 65535.00 FORMAT "%8.2" /end CHARACTERISTIC
/begin CHARACTERISTIC DFES_DTCO.DFC_HLSDemOvhtEngLim_C "OBD specific trouble code / OBD specific diagnostic trouble code for check DFC_HLSDemOvhtEngLim" VALUE 0x80503FBC Val_Wu16 65535.00 DFES_OneToOne 0.00 65535.00 FORMAT "%8.2" /end CHARACTERISTIC
/begin CHARACTERISTIC DFES_DTCO.DFC_OilPSwmpSRCMax_C "OBD specific trouble code / OBD specific diagnostic trouble code for check DFC_OilPSwmpSRCMax" VALUE 0x80503FBE Val_Wu16 65535.00 DFES_OneToOne 0.00 65535.00 FORMAT "%8.2" /end CHARACTERISTIC
/begin CHARACTERISTIC DFES_DTCO.DFC_OilPSwmpSRCMin_C "OBD specific trouble code / OBD specific diagnostic trouble code for check DFC_OilPSwmpSRCMin" VALUE 0x80503FC0 Val_Wu16 65535.00 DFES_OneToOne 0.00 65535.00 FORMAT "%8.2" /end CHARACTERISTIC
/begin CHARACTERISTIC DFES_DTCO.DFC_PIntkVUsLineHiB1_C "OBD specific trouble code / OBD specific diagnostic trouble code for check DFC_PIntkVUsLineHiB1" VALUE 0x80503FC2 Val_Wu16 65535.00 DFES_OneToOne 0.00 65535.00 FORMAT "%8.2" /end CHARACTERISTIC
/begin CHARACTERISTIC DFES_DTCO.DFC_PIntkVUsLineLoB1_C "OBD specific trouble code / OBD specific diagnostic trouble code for check DFC_PIntkVUsLineLoB1" VALUE 0x80503FC4 Val_Wu16 65535.00 DFES_OneToOne 0.00 65535.00 FORMAT "%8.2" /end CHARACTERISTIC
/begin CHARACTERISTIC DFES_DTCO.DFC_VehVPhysRngLo_C "OBD specific trouble code / OBD specific diagnostic trouble code for check DFC_VehVPhysRngLo" VALUE 0x80503FC6 Val_Wu16 65535.00 DFES_OneToOne 0.00 65535.00 FORMAT "%8.2" /end CHARACTERISTIC
/begin CHARACTERISTIC DFES_DTCO.DFC_VehVSigCan_C "OBD specific trouble code / OBD specific diagnostic trouble code for check DFC_VehVSigCan" VALUE 0x80503FC8 Val_Wu16 65535.00 DFES_OneToOne 0.00 65535.00 FORMAT "%8.2" /end CHARACTERISTIC
/begin CHARACTERISTIC DFES_DTCO.DFC_VehVSigCanSafe_C "OBD specific trouble code / OBD specific diagnostic trouble code for check DFC_VehVSigCanSafe" VALUE 0x80503FCA Val_Wu16 65535.00 DFES_OneToOne 0.00 65535.00 FORMAT "%8.2" /end CHARACTERISTIC
/begin CHARACTERISTIC DFES_DTCO.DFC_VlvLftFbOilPSnsrIntk11SRCMax_C "OBD specific trouble code / OBD specific diagnostic trouble code for check DFC_VlvLftFbOilPSnsrIntk11SRCMax" VALUE 0x80503FCC Val_Wu16 65535.00 DFES_OneToOne 0.00 65535.00 FORMAT "%8.2" /end CHARACTERISTIC
/begin CHARACTERISTIC DFES_DTCO.DFC_VlvLftFbOilPSnsrIntk11SRCMin_C "OBD specific trouble code / OBD specific diagnostic trouble code for check DFC_VlvLftFbOilPSnsrIntk11SRCMin" VALUE 0x80503FCE Val_Wu16 65535.00 DFES_OneToOne 0.00 65535.00 FORMAT "%8.2" /end CHARACTERISTIC
/begin CHARACTERISTIC DFES_DTCO.DFC_ClthNpl_C "OBD specific trouble code / OBD specific diagnostic trouble code for check DFC_ClthNpl" VALUE 0x80503FD0 Val_Wu16 65535.00 DFES_OneToOne 0.00 65535.00 FORMAT "%8.2" /end CHARACTERISTIC
/begin CHARACTERISTIC DFES_DTCO.DFC_GbxPNPosnDrvCdn_C "OBD specific trouble code / OBD specific diagnostic trouble code for check DFC_GbxPNPosnDrvCdn" VALUE 0x80503FD2 Val_Wu16 65535.00 DFES_OneToOne 0.00 65535.00 FORMAT "%8.2" /end CHARACTERISTIC
/begin CHARACTERISTIC DFES_DTCO.DFC_GbxPNPosnPlausy_C "OBD specific trouble code / OBD specific diagnostic trouble code for check DFC_GbxPNPosnPlausy" VALUE 0x80503FD4 Val_Wu16 65535.00 DFES_OneToOne 0.00 65535.00 FORMAT "%8.2" /end CHARACTERISTIC
/begin CHARACTERISTIC DFES_DTCO.DFC_AfsSigErrLineHiB1_C "OBD specific trouble code / OBD specific diagnostic trouble code for check DFC_AfsSigErrLineHiB1" VALUE 0x80503FD6 Val_Wu16 65535.00 DFES_OneToOne 0.00 65535.00 FORMAT "%8.2" /end CHARACTERISTIC
/begin CHARACTERISTIC DFES_DTCO.DFC_AfsSigErrLineLoB1_C "OBD specific trouble code / OBD specific diagnostic trouble code for check DFC_AfsSigErrLineLoB1" VALUE 0x80503FD8 Val_Wu16 65535.00 DFES_OneToOne 0.00 65535.00 FORMAT "%8.2" /end CHARACTERISTIC
/begin CHARACTERISTIC DFES_DTCO.DFC_PEnvCcMax_C "OBD specific trouble code / OBD specific diagnostic trouble code for check DFC_PEnvCcMax" VALUE 0x80503FDA Val_Wu16 65535.00 DFES_OneToOne 0.00 65535.00 FORMAT "%8.2" /end CHARACTERISTIC
/begin CHARACTERISTIC DFES_DTCO.DFC_PEnvCcMin_C "OBD specific trouble code / OBD specific diagnostic trouble code for check DFC_PEnvCcMin" VALUE 0x80503FDC Val_Wu16 65535.00 DFES_OneToOne 0.00 65535.00 FORMAT "%8.2" /end CHARACTERISTIC
/begin CHARACTERISTIC DFES_DTCO.DFC_PEnvRngChkMax_C "OBD specific trouble code / OBD specific diagnostic trouble code for check DFC_PEnvRngChkMax" VALUE 0x80503FDE Val_Wu16 65535.00 DFES_OneToOne 0.00 65535.00 FORMAT "%8.2" /end CHARACTERISTIC
/begin CHARACTERISTIC DFES_DTCO.DFC_PEnvRngChkMin_C "OBD specific trouble code / OBD specific diagnostic trouble code for check DFC_PEnvRngChkMin" VALUE 0x80503FE0 Val_Wu16 65535.00 DFES_OneToOne 0.00 65535.00 FORMAT "%8.2" /end CHARACTERISTIC
/begin CHARACTERISTIC DFES_DTCO.DFC_PEnvSnsrPlaus_C "OBD specific trouble code / OBD specific diagnostic trouble code for check DFC_PEnvSnsrPlaus" VALUE 0x80503FE2 Val_Wu16 65535.00 DFES_OneToOne 0.00 65535.00 FORMAT "%8.2" /end CHARACTERISTIC
/begin CHARACTERISTIC DFES_DTCO.DFC_UEGOHeatrRlyPsOLS1B1_C "OBD specific trouble code / OBD specific diagnostic trouble code for check DFC_UEGOHeatrRlyPsOLS1B1" VALUE 0x80503FE4 Val_Wu16 65535.00 DFES_OneToOne 0.00 65535.00 FORMAT "%8.2" /end CHARACTERISTIC
/begin CHARACTERISTIC DFES_DTCO.DFC_UEGOHeatrRlyPsSCBS1B1_C "OBD specific trouble code / OBD specific diagnostic trouble code for check DFC_UEGOHeatrRlyPsSCBS1B1" VALUE 0x80503FE6 Val_Wu16 65535.00 DFES_OneToOne 0.00 65535.00 FORMAT "%8.2" /end CHARACTERISTIC
/begin CHARACTERISTIC DFES_DTCO.DFC_UEGOHeatrRlyPsSCGS1B1_C "OBD specific trouble code / OBD specific diagnostic trouble code for check DFC_UEGOHeatrRlyPsSCGS1B1" VALUE 0x80503FE8 Val_Wu16 65535.00 DFES_OneToOne 0.00 65535.00 FORMAT "%8.2" /end CHARACTERISTIC
/begin CHARACTERISTIC DFES_DTCO.DFC_UegoHeatrWireOlS1B1_C "OBD specific trouble code / OBD specific diagnostic trouble code for check DFC_UegoHeatrWireOlS1B1" VALUE 0x80503FEA Val_Wu16 65535.00 DFES_OneToOne 0.00 65535.00 FORMAT "%8.2" /end CHARACTERISTIC
/begin CHARACTERISTIC DFES_DTCO.DFC_UegoHeatrWireScbS1B1_C "OBD specific trouble code / OBD specific diagnostic trouble code for check DFC_UegoHeatrWireScbS1B1" VALUE 0x80503FEC Val_Wu16 65535.00 DFES_OneToOne 0.00 65535.00 FORMAT "%8.2" /end CHARACTERISTIC
/begin CHARACTERISTIC DFES_DTCO.DFC_UegoHeatrWireScgS1B1_C "OBD specific trouble code / OBD specific diagnostic trouble code for check DFC_UegoHeatrWireScgS1B1" VALUE 0x80503FEE Val_Wu16 65535.00 DFES_OneToOne 0.00 65535.00 FORMAT "%8.2" /end CHARACTERISTIC
/begin CHARACTERISTIC DFES_DTCO.DFC_KnDetSens1PortAMax_C "OBD specific trouble code / OBD specific diagnostic trouble code for check DFC_KnDetSens1PortAMax" VALUE 0x80503FF0 Val_Wu16 65535.00 DFES_OneToOne 0.00 65535.00 FORMAT "%8.2" /end CHARACTERISTIC
/begin CHARACTERISTIC DFES_DTCO.DFC_KnDetSens1PortAMin_C "OBD specific trouble code / OBD specific diagnostic trouble code for check DFC_KnDetSens1PortAMin" VALUE 0x80503FF2 Val_Wu16 65535.00 DFES_OneToOne 0.00 65535.00 FORMAT "%8.2" /end CHARACTERISTIC
/begin CHARACTERISTIC DFES_DTCO.DFC_KnDetSens1PortBMax_C "OBD specific trouble code / OBD specific diagnostic trouble code for check DFC_KnDetSens1PortBMax" VALUE 0x80503FF4 Val_Wu16 65535.00 DFES_OneToOne 0.00 65535.00 FORMAT "%8.2" /end CHARACTERISTIC
/begin CHARACTERISTIC DFES_DTCO.DFC_KnDetSens1PortBMin_C "OBD specific trouble code / OBD specific diagnostic trouble code for check DFC_KnDetSens1PortBMin" VALUE 0x80503FF6 Val_Wu16 65535.00 DFES_OneToOne 0.00 65535.00 FORMAT "%8.2" /end CHARACTERISTIC
/begin CHARACTERISTIC DFES_DTCO.DFC_Clth2ONStuck_C "OBD specific trouble code / OBD specific diagnostic trouble code for check DFC_Clth2ONStuck" VALUE 0x80503FF8 Val_Wu16 65535.00 DFES_OneToOne 0.00 65535.00 FORMAT "%8.2" /end CHARACTERISTIC
/begin CHARACTERISTIC DFES_DTCO.DFC_Clth2ONStuckLdc_C "OBD specific trouble code / OBD specific diagnostic trouble code for check DFC_Clth2ONStuckLdc" VALUE 0x80503FFA Val_Wu16 65535.00 DFES_OneToOne 0.00 65535.00 FORMAT "%8.2" /end CHARACTERISTIC
/begin CHARACTERISTIC DFES_DTCO.DFC_Clth3ONStuckLdc_C "OBD specific trouble code / OBD specific diagnostic trouble code for check DFC_Clth3ONStuckLdc" VALUE 0x80503FFC Val_Wu16 65535.00 DFES_OneToOne 0.00 65535.00 FORMAT "%8.2" /end CHARACTERISTIC
/begin CHARACTERISTIC DFES_DTCO.DFC_Clth3ONStuckPostDrv_C "OBD specific trouble code / OBD specific diagnostic trouble code for check DFC_Clth3ONStuckPostDrv" VALUE 0x80503FFE Val_Wu16 65535.00 DFES_OneToOne 0.00 65535.00 FORMAT "%8.2" /end CHARACTERISTIC
/begin CHARACTERISTIC DFES_DTCO.DFC_Clth4ONStuck_C "OBD specific trouble code / OBD specific diagnostic trouble code for check DFC_Clth4ONStuck" VALUE 0x80504000 Val_Wu16 65535.00 DFES_OneToOne 0.00 65535.00 FORMAT "%8.2" /end CHARACTERISTIC
/begin CHARACTERISTIC DFES_DTCO.DFC_Clth4ONStuckLdc_C "OBD specific trouble code / OBD specific diagnostic trouble code for check DFC_Clth4ONStuckLdc" VALUE 0x80504002 Val_Wu16 65535.00 DFES_OneToOne 0.00 65535.00 FORMAT "%8.2" /end CHARACTERISTIC
/begin CHARACTERISTIC DFES_DTCO.DFC_ComBCMUnit_C "OBD specific trouble code / OBD specific diagnostic trouble code for check DFC_ComBCMUnit" VALUE 0x80504004 Val_Wu16 65535.00 DFES_OneToOne 0.00 65535.00 FORMAT "%8.2" /end CHARACTERISTIC
/begin CHARACTERISTIC DFES_DTCO.DFC_ComDLCTCU01_C "OBD specific trouble code / OBD specific diagnostic trouble code for check DFC_ComDLCTCU01" VALUE 0x80504006 Val_Wu16 65535.00 DFES_OneToOne 0.00 65535.00 FORMAT "%8.2" /end CHARACTERISTIC
/begin CHARACTERISTIC DFES_DTCO.DFC_ComDLCTCU02_C "OBD specific trouble code / OBD specific diagnostic trouble code for check DFC_ComDLCTCU02" VALUE 0x80504008 Val_Wu16 65535.00 DFES_OneToOne 0.00 65535.00 FORMAT "%8.2" /end CHARACTERISTIC
/begin CHARACTERISTIC DFES_DTCO.DFC_ComDLCTCU1_C "OBD specific trouble code / OBD specific diagnostic trouble code for check DFC_ComDLCTCU1" VALUE 0x8050400A Val_Wu16 65535.00 DFES_OneToOne 0.00 65535.00 FORMAT "%8.2" /end CHARACTERISTIC
/begin CHARACTERISTIC DFES_DTCO.DFC_ComDLCTCU11_C "OBD specific trouble code / OBD specific diagnostic trouble code for check DFC_ComDLCTCU11" VALUE 0x8050400C Val_Wu16 65535.00 DFES_OneToOne 0.00 65535.00 FORMAT "%8.2" /end CHARACTERISTIC
/begin CHARACTERISTIC DFES_DTCO.DFC_ComDLCTCU12_C "OBD specific trouble code / OBD specific diagnostic trouble code for check DFC_ComDLCTCU12" VALUE 0x8050400E Val_Wu16 65535.00 DFES_OneToOne 0.00 65535.00 FORMAT "%8.2" /end CHARACTERISTIC
/begin CHARACTERISTIC DFES_DTCO.DFC_ComDLCTCU13_C "OBD specific trouble code / OBD specific diagnostic trouble code for check DFC_ComDLCTCU13" VALUE 0x80504010 Val_Wu16 65535.00 DFES_OneToOne 0.00 65535.00 FORMAT "%8.2" /end CHARACTERISTIC
/begin CHARACTERISTIC DFES_DTCO.DFC_ComDLCTCU14_C "OBD specific trouble code / OBD specific diagnostic trouble code for check DFC_ComDLCTCU14" VALUE 0x80504012 Val_Wu16 65535.00 DFES_OneToOne 0.00 65535.00 FORMAT "%8.2" /end CHARACTERISTIC
/begin CHARACTERISTIC DFES_DTCO.DFC_ComDLCTCU2_C "OBD specific trouble code / OBD specific diagnostic trouble code for check DFC_ComDLCTCU2" VALUE 0x80504014 Val_Wu16 65535.00 DFES_OneToOne 0.00 65535.00 FORMAT "%8.2" /end CHARACTERISTIC
/begin CHARACTERISTIC DFES_DTCO.DFC_ComDLCTCU3_C "OBD specific trouble code / OBD specific diagnostic trouble code for check DFC_ComDLCTCU3" VALUE 0x80504016 Val_Wu16 65535.00 DFES_OneToOne 0.00 65535.00 FORMAT "%8.2" /end CHARACTERISTIC
/begin CHARACTERISTIC DFES_DTCO.DFC_ComDLCTCU4_C "OBD specific trouble code / OBD specific diagnostic trouble code for check DFC_ComDLCTCU4" VALUE 0x80504018 Val_Wu16 65535.00 DFES_OneToOne 0.00 65535.00 FORMAT "%8.2" /end CHARACTERISTIC
/begin CHARACTERISTIC DFES_DTCO.DFC_ComEPSUnit_C "OBD specific trouble code / OBD specific diagnostic trouble code for check DFC_ComEPSUnit" VALUE 0x8050401A Val_Wu16 65535.00 DFES_OneToOne 0.00 65535.00 FORMAT "%8.2" /end CHARACTERISTIC
/begin CHARACTERISTIC DFES_DTCO.DFC_ComIDASBUnit_C "OBD specific trouble code / OBD specific diagnostic trouble code for check DFC_ComIDASBUnit" VALUE 0x8050401C Val_Wu16 65535.00 DFES_OneToOne 0.00 65535.00 FORMAT "%8.2" /end CHARACTERISTIC
/begin CHARACTERISTIC DFES_DTCO.DFC_ComIMGUnit_C "OBD specific trouble code / OBD specific diagnostic trouble code for check DFC_ComIMGUnit" VALUE 0x8050401E Val_Wu16 65535.00 DFES_OneToOne 0.00 65535.00 FORMAT "%8.2" /end CHARACTERISTIC
/begin CHARACTERISTIC DFES_DTCO.DFC_ComMETUnit_C "OBD specific trouble code / OBD specific diagnostic trouble code for check DFC_ComMETUnit" VALUE 0x80504020 Val_Wu16 65535.00 DFES_OneToOne 0.00 65535.00 FORMAT "%8.2" /end CHARACTERISTIC
/begin CHARACTERISTIC DFES_DTCO.DFC_ComSRSUnit_C "OBD specific trouble code / OBD specific diagnostic trouble code for check DFC_ComSRSUnit" VALUE 0x80504022 Val_Wu16 65535.00 DFES_OneToOne 0.00 65535.00 FORMAT "%8.2" /end CHARACTERISTIC
/begin CHARACTERISTIC DFES_DTCO.DFC_ComVSAUnit_C "OBD specific trouble code / OBD specific diagnostic trouble code for check DFC_ComVSAUnit" VALUE 0x80504024 Val_Wu16 65535.00 DFES_OneToOne 0.00 65535.00 FORMAT "%8.2" /end CHARACTERISTIC
/begin CHARACTERISTIC DFES_DTCO.DFC_EbsSocFlt_C "OBD specific trouble code / OBD specific diagnostic trouble code for check DFC_EbsSocFlt" VALUE 0x80504026 Val_Wu16 65535.00 DFES_OneToOne 0.00 65535.00 FORMAT "%8.2" /end CHARACTERISTIC
/begin CHARACTERISTIC DFES_DTCO.DFC_I14229VINErr_C "OBD specific trouble code / OBD specific diagnostic trouble code for check DFC_I14229VINErr" VALUE 0x80504028 Val_Wu16 65535.00 DFES_OneToOne 0.00 65535.00 FORMAT "%8.2" /end CHARACTERISTIC
/begin CHARACTERISTIC DFES_DTCO.DFC_InjCatHeatgErr_C "OBD specific trouble code / OBD specific diagnostic trouble code for check DFC_InjCatHeatgErr" VALUE 0x8050402A Val_Wu16 65535.00 DFES_OneToOne 0.00 65535.00 FORMAT "%8.2" /end CHARACTERISTIC
/begin CHARACTERISTIC DFES_DTCO.DFC_InjSysMulInjDiagErr_C "OBD specific trouble code / OBD specific diagnostic trouble code for check DFC_InjSysMulInjDiagErr" VALUE 0x8050402C Val_Wu16 65535.00 DFES_OneToOne 0.00 65535.00 FORMAT "%8.2" /end CHARACTERISTIC
/begin CHARACTERISTIC DFES_DTCO.DFC_LLRHmax_C "OBD specific trouble code / OBD specific diagnostic trouble code for check DFC_LLRHmax" VALUE 0x8050402E Val_Wu16 65535.00 DFES_OneToOne 0.00 65535.00 FORMAT "%8.2" /end CHARACTERISTIC
/begin CHARACTERISTIC DFES_DTCO.DFC_LLRHmin_C "OBD specific trouble code / OBD specific diagnostic trouble code for check DFC_LLRHmin" VALUE 0x80504030 Val_Wu16 65535.00 DFES_OneToOne 0.00 65535.00 FORMAT "%8.2" /end CHARACTERISTIC
/begin CHARACTERISTIC DFES_DTCO.DFC_LLRHnpl_C "OBD specific trouble code / OBD specific diagnostic trouble code for check DFC_LLRHnpl" VALUE 0x80504032 Val_Wu16 65535.00 DFES_OneToOne 0.00 65535.00 FORMAT "%8.2" /end CHARACTERISTIC
/begin CHARACTERISTIC DFES_DTCO.DFC_LLRKHmax_C "OBD specific trouble code / OBD specific diagnostic trouble code for check DFC_LLRKHmax" VALUE 0x80504034 Val_Wu16 65535.00 DFES_OneToOne 0.00 65535.00 FORMAT "%8.2" /end CHARACTERISTIC
/begin CHARACTERISTIC DFES_DTCO.DFC_LLRKHmin_C "OBD specific trouble code / OBD specific diagnostic trouble code for check DFC_LLRKHmin" VALUE 0x80504036 Val_Wu16 65535.00 DFES_OneToOne 0.00 65535.00 FORMAT "%8.2" /end CHARACTERISTIC
/begin CHARACTERISTIC DFES_DTCO.DFC_LLRKHnpl_C "OBD specific trouble code / OBD specific diagnostic trouble code for check DFC_LLRKHnpl" VALUE 0x80504038 Val_Wu16 65535.00 DFES_OneToOne 0.00 65535.00 FORMAT "%8.2" /end CHARACTERISTIC
/begin CHARACTERISTIC DFES_DTCO.DFC_LinACGUnit_C "OBD specific trouble code / OBD specific diagnostic trouble code for check DFC_LinACGUnit" VALUE 0x8050403A Val_Wu16 65535.00 DFES_OneToOne 0.00 65535.00 FORMAT "%8.2" /end CHARACTERISTIC
/begin CHARACTERISTIC DFES_DTCO.DFC_LinAEVUnit_C "OBD specific trouble code / OBD specific diagnostic trouble code for check DFC_LinAEVUnit" VALUE 0x8050403C Val_Wu16 65535.00 DFES_OneToOne 0.00 65535.00 FORMAT "%8.2" /end CHARACTERISTIC
/begin CHARACTERISTIC DFES_DTCO.DFC_LinEBSUnit_C "OBD specific trouble code / OBD specific diagnostic trouble code for check DFC_LinEBSUnit" VALUE 0x8050403E Val_Wu16 65535.00 DFES_OneToOne 0.00 65535.00 FORMAT "%8.2" /end CHARACTERISTIC
/begin CHARACTERISTIC DFES_DTCO.DFC_RoughRoad_C "OBD specific trouble code / OBD specific diagnostic trouble code for check DFC_RoughRoad" VALUE 0x80504040 Val_Wu16 65535.00 DFES_OneToOne 0.00 65535.00 FORMAT "%8.2" /end CHARACTERISTIC
/begin CHARACTERISTIC DFES_DTCO.DFC_SiaEEPRdErr_C "OBD specific trouble code / OBD specific diagnostic trouble code for check DFC_SiaEEPRdErr" VALUE 0x80504042 Val_Wu16 65535.00 DFES_OneToOne 0.00 65535.00 FORMAT "%8.2" /end CHARACTERISTIC
/begin CHARACTERISTIC DFES_DTCO.DFC_SiaEEPWrngCod_C "OBD specific trouble code / OBD specific diagnostic trouble code for check DFC_SiaEEPWrngCod" VALUE 0x80504044 Val_Wu16 65535.00 DFES_OneToOne 0.00 65535.00 FORMAT "%8.2" /end CHARACTERISTIC
/begin CHARACTERISTIC DFES_DTCO.DFC_UegoHeatrStrtS1B1_C "OBD specific trouble code / OBD specific diagnostic trouble code for check DFC_UegoHeatrStrtS1B1" VALUE 0x80504046 Val_Wu16 65535.00 DFES_OneToOne 0.00 65535.00 FORMAT "%8.2" /end CHARACTERISTIC
/begin CHARACTERISTIC DFES_DTCO.DFC_BusDiagCANAPPLBusOff_C "OBD specific trouble code / OBD specific diagnostic trouble code for check DFC_BusDiagCANAPPLBusOff" VALUE 0x80504048 Val_Wu16 65535.00 DFES_OneToOne 0.00 65535.00 FORMAT "%8.2" /end CHARACTERISTIC
/begin CHARACTERISTIC DFES_DTCO.DFC_BusDiagCANCANCBusOff_C "OBD specific trouble code / OBD specific diagnostic trouble code for check DFC_BusDiagCANCANCBusOff" VALUE 0x8050404A Val_Wu16 65535.00 DFES_OneToOne 0.00 65535.00 FORMAT "%8.2" /end CHARACTERISTIC
/begin CHARACTERISTIC DFES_DTCO.DFC_BusDiagCANVEHICLEBusOff_C "OBD specific trouble code / OBD specific diagnostic trouble code for check DFC_BusDiagCANVEHICLEBusOff" VALUE 0x8050404C Val_Wu16 65535.00 DFES_OneToOne 0.00 65535.00 FORMAT "%8.2" /end CHARACTERISTIC
/begin CHARACTERISTIC DFES_DTCO.DFC_RBA_IODIAGPWR_rba_IoExtCy329_SignalVltSply_0_C "OBD specific trouble code / OBD specific diagnostic trouble code for check DFC_RBA_IODIAGPWR_rba_IoExtCy329_SignalVltSply_0" VALUE 0x8050404E Val_Wu16 65535.00 DFES_OneToOne 0.00 65535.00 FORMAT "%8.2" /end CHARACTERISTIC
/begin CHARACTERISTIC DFES_DTCO.DFC_RBA_IODIAGPWR_rba_IoExtCy329_SignalVltSply_0OT_C "OBD specific trouble code / OBD specific diagnostic trouble code for check DFC_RBA_IODIAGPWR_rba_IoExtCy329_SignalVltSply_0OT" VALUE 0x80504050 Val_Wu16 65535.00 DFES_OneToOne 0.00 65535.00 FORMAT "%8.2" /end CHARACTERISTIC
/begin CHARACTERISTIC DFES_DTCO.DFC_RBA_IODIAGPWR_rba_IoExtCy329_SignalVltSply_0OV_C "OBD specific trouble code / OBD specific diagnostic trouble code for check DFC_RBA_IODIAGPWR_rba_IoExtCy329_SignalVltSply_0OV" VALUE 0x80504052 Val_Wu16 65535.00 DFES_OneToOne 0.00 65535.00 FORMAT "%8.2" /end CHARACTERISTIC
/begin CHARACTERISTIC DFES_DTCO.DFC_RBA_IODIAGPWR_rba_IoExtCy329_SignalVltSply_0SCG_C "OBD specific trouble code / OBD specific diagnostic trouble code for check DFC_RBA_IODIAGPWR_rba_IoExtCy329_SignalVltSply_0SCG" VALUE 0x80504054 Val_Wu16 65535.00 DFES_OneToOne 0.00 65535.00 FORMAT "%8.2" /end CHARACTERISTIC
/begin CHARACTERISTIC DFES_DTCO.DFC_RBA_IODIAGPWR_rba_IoExtCy329_SignalVltSply_0UV_C "OBD specific trouble code / OBD specific diagnostic trouble code for check DFC_RBA_IODIAGPWR_rba_IoExtCy329_SignalVltSply_0UV" VALUE 0x80504056 Val_Wu16 65535.00 DFES_OneToOne 0.00 65535.00 FORMAT "%8.2" /end CHARACTERISTIC
/begin CHARACTERISTIC DFES_DTCO.DFC_RBA_IODIAGPWR_rba_IoExtCy329_SignalVltSply_1_C "OBD specific trouble code / OBD specific diagnostic trouble code for check DFC_RBA_IODIAGPWR_rba_IoExtCy329_SignalVltSply_1" VALUE 0x80504058 Val_Wu16 65535.00 DFES_OneToOne 0.00 65535.00 FORMAT "%8.2" /end CHARACTERISTIC
/begin CHARACTERISTIC DFES_DTCO.DFC_RBA_IODIAGPWR_rba_IoExtCy329_SignalVltSply_1OT_C "OBD specific trouble code / OBD specific diagnostic trouble code for check DFC_RBA_IODIAGPWR_rba_IoExtCy329_SignalVltSply_1OT" VALUE 0x8050405A Val_Wu16 65535.00 DFES_OneToOne 0.00 65535.00 FORMAT "%8.2" /end CHARACTERISTIC
/begin CHARACTERISTIC DFES_DTCO.DFC_RBA_IODIAGPWR_rba_IoExtCy329_SignalVltSply_1OV_C "OBD specific trouble code / OBD specific diagnostic trouble code for check DFC_RBA_IODIAGPWR_rba_IoExtCy329_SignalVltSply_1OV" VALUE 0x8050405C Val_Wu16 65535.00 DFES_OneToOne 0.00 65535.00 FORMAT "%8.2" /end CHARACTERISTIC
/begin CHARACTERISTIC DFES_DTCO.DFC_RBA_IODIAGPWR_rba_IoExtCy329_SignalVltSply_1SCG_C "OBD specific trouble code / OBD specific diagnostic trouble code for check DFC_RBA_IODIAGPWR_rba_IoExtCy329_SignalVltSply_1SCG" VALUE 0x8050405E Val_Wu16 65535.00 DFES_OneToOne 0.00 65535.00 FORMAT "%8.2" /end CHARACTERISTIC
/begin CHARACTERISTIC DFES_DTCO.DFC_RBA_IODIAGPWR_rba_IoExtCy329_SignalVltSply_1UV_C "OBD specific trouble code / OBD specific diagnostic trouble code for check DFC_RBA_IODIAGPWR_rba_IoExtCy329_SignalVltSply_1UV" VALUE 0x80504060 Val_Wu16 65535.00 DFES_OneToOne 0.00 65535.00 FORMAT "%8.2" /end CHARACTERISTIC
/begin CHARACTERISTIC DFES_DTCO.DFC_RBA_IODIAGPWR_rba_IoExtCy329_SignalVltSply_2_C "OBD specific trouble code / OBD specific diagnostic trouble code for check DFC_RBA_IODIAGPWR_rba_IoExtCy329_SignalVltSply_2" VALUE 0x80504062 Val_Wu16 65535.00 DFES_OneToOne 0.00 65535.00 FORMAT "%8.2" /end CHARACTERISTIC
/begin CHARACTERISTIC DFES_DTCO.DFC_RBA_IODIAGPWR_rba_IoExtCy329_SignalVltSply_2OT_C "OBD specific trouble code / OBD specific diagnostic trouble code for check DFC_RBA_IODIAGPWR_rba_IoExtCy329_SignalVltSply_2OT" VALUE 0x80504064 Val_Wu16 65535.00 DFES_OneToOne 0.00 65535.00 FORMAT "%8.2" /end CHARACTERISTIC
/begin CHARACTERISTIC DFES_DTCO.DFC_RBA_IODIAGPWR_rba_IoExtCy329_SignalVltSply_2OV_C "OBD specific trouble code / OBD specific diagnostic trouble code for check DFC_RBA_IODIAGPWR_rba_IoExtCy329_SignalVltSply_2OV" VALUE 0x80504066 Val_Wu16 65535.00 DFES_OneToOne 0.00 65535.00 FORMAT "%8.2" /end CHARACTERISTIC
/begin CHARACTERISTIC DFES_DTCO.DFC_RBA_IODIAGPWR_rba_IoExtCy329_SignalVltSply_2SCG_C "OBD specific trouble code / OBD specific diagnostic trouble code for check DFC_RBA_IODIAGPWR_rba_IoExtCy329_SignalVltSply_2SCG" VALUE 0x80504068 Val_Wu16 65535.00 DFES_OneToOne 0.00 65535.00 FORMAT "%8.2" /end CHARACTERISTIC
/begin CHARACTERISTIC DFES_DTCO.DFC_RBA_IODIAGPWR_rba_IoExtCy329_SignalVltSply_2UV_C "OBD specific trouble code / OBD specific diagnostic trouble code for check DFC_RBA_IODIAGPWR_rba_IoExtCy329_SignalVltSply_2UV" VALUE 0x8050406A Val_Wu16 65535.00 DFES_OneToOne 0.00 65535.00 FORMAT "%8.2" /end CHARACTERISTIC
/begin CHARACTERISTIC DFES_DTCO.DFC_CAN_E_TIMEOUT_C "OBD specific trouble code / OBD specific diagnostic trouble code for check DFC_CAN_E_TIMEOUT" VALUE 0x8050406C Val_Wu16 65535.00 DFES_OneToOne 0.00 65535.00 FORMAT "%8.2" /end CHARACTERISTIC
/begin CHARACTERISTIC DFES_DTCO.DFC_LIN_E_TIMEOUT_C "OBD specific trouble code / OBD specific diagnostic trouble code for check DFC_LIN_E_TIMEOUT" VALUE 0x8050406E Val_Wu16 65535.00 DFES_OneToOne 0.00 65535.00 FORMAT "%8.2" /end CHARACTERISTIC
/begin CHARACTERISTIC DFES_DTCO.DFC_MRlyOL_C "OBD specific trouble code / OBD specific diagnostic trouble code for check DFC_MRlyOL" VALUE 0x80504070 Val_Wu16 65535.00 DFES_OneToOne 0.00 65535.00 FORMAT "%8.2" /end CHARACTERISTIC
/begin CHARACTERISTIC DFES_DTCO.DFC_MRlySCB_C "OBD specific trouble code / OBD specific diagnostic trouble code for check DFC_MRlySCB" VALUE 0x80504072 Val_Wu16 65535.00 DFES_OneToOne 0.00 65535.00 FORMAT "%8.2" /end CHARACTERISTIC
/begin CHARACTERISTIC DFES_DTCO.DFC_MRlySCG_C "OBD specific trouble code / OBD specific diagnostic trouble code for check DFC_MRlySCG" VALUE 0x80504074 Val_Wu16 65535.00 DFES_OneToOne 0.00 65535.00 FORMAT "%8.2" /end CHARACTERISTIC
/begin CHARACTERISTIC DFES_DTCO.DFC_rba_MultiStackTrace_Threshold_C "OBD specific trouble code / OBD specific diagnostic trouble code for check DFC_rba_MultiStackTrace_Threshold" VALUE 0x80504076 Val_Wu16 65535.00 DFES_OneToOne 0.00 65535.00 FORMAT "%8.2" /end CHARACTERISTIC
/begin CHARACTERISTIC DFES_DTCO.DFC_BSWM_E_ACTION_FAILED_C "OBD specific trouble code / OBD specific diagnostic trouble code for check DFC_BSWM_E_ACTION_FAILED" VALUE 0x80504078 Val_Wu16 65535.00 DFES_OneToOne 0.00 65535.00 FORMAT "%8.2" /end CHARACTERISTIC
/begin CHARACTERISTIC DFES_DTCO.DFC_BSWM_E_INTRPTQUEUE_FULL_C "OBD specific trouble code / OBD specific diagnostic trouble code for check DFC_BSWM_E_INTRPTQUEUE_FULL" VALUE 0x8050407A Val_Wu16 65535.00 DFES_OneToOne 0.00 65535.00 FORMAT "%8.2" /end CHARACTERISTIC
/begin CHARACTERISTIC DFES_DTCO.DFC_RBA_IOEXTLIB_KEEPALIVE_DRV_C "OBD specific trouble code / OBD specific diagnostic trouble code for check DFC_RBA_IOEXTLIB_KEEPALIVE_DRV" VALUE 0x8050407C Val_Wu16 65535.00 DFES_OneToOne 0.00 65535.00 FORMAT "%8.2" /end CHARACTERISTIC
/begin CHARACTERISTIC DFES_DTCO.DFC_RBA_IOEXTLIB_KEEPALIVE_INI_C "OBD specific trouble code / OBD specific diagnostic trouble code for check DFC_RBA_IOEXTLIB_KEEPALIVE_INI" VALUE 0x8050407E Val_Wu16 65535.00 DFES_OneToOne 0.00 65535.00 FORMAT "%8.2" /end CHARACTERISTIC
/begin CHARACTERISTIC DFES_DTCO.DFC_rba_IoSigRtc_StopCounter_C "OBD specific trouble code / OBD specific diagnostic trouble code for check DFC_rba_IoSigRtc_StopCounter" VALUE 0x80504080 Val_Wu16 65535.00 DFES_OneToOne 0.00 65535.00 FORMAT "%8.2" /end CHARACTERISTIC
/begin CHARACTERISTIC DFES_DTCO.DFC_rba_MRly_Diag_Stk_Event_C "OBD specific trouble code / OBD specific diagnostic trouble code for check DFC_rba_MRly_Diag_Stk_Event" VALUE 0x80504082 Val_Wu16 65535.00 DFES_OneToOne 0.00 65535.00 FORMAT "%8.2" /end CHARACTERISTIC
/begin CHARACTERISTIC DFES_DTCO.DFC_rba_MemDiag_MemReadErr_C "OBD specific trouble code / OBD specific diagnostic trouble code for check DFC_rba_MemDiag_MemReadErr" VALUE 0x80504084 Val_Wu16 65535.00 DFES_OneToOne 0.00 65535.00 FORMAT "%8.2" /end CHARACTERISTIC
/begin CHARACTERISTIC DFES_DTCO.DFC_rba_MemDiag_MemWrErr_C "OBD specific trouble code / OBD specific diagnostic trouble code for check DFC_rba_MemDiag_MemWrErr" VALUE 0x80504086 Val_Wu16 65535.00 DFES_OneToOne 0.00 65535.00 FORMAT "%8.2" /end CHARACTERISTIC
/begin CHARACTERISTIC DFES_DTCO.DFC_rba_SyC_IrrSwOffTrigEngRun_Event_C "OBD specific trouble code / OBD specific diagnostic trouble code for check DFC_rba_SyC_IrrSwOffTrigEngRun_Event" VALUE 0x80504088 Val_Wu16 65535.00 DFES_OneToOne 0.00 65535.00 FORMAT "%8.2" /end CHARACTERISTIC
/begin CHARACTERISTIC DFES_DTCO.DFC_rba_T15_Diag_ComInVld_Event_C "OBD specific trouble code / OBD specific diagnostic trouble code for check DFC_rba_T15_Diag_ComInVld_Event" VALUE 0x8050408A Val_Wu16 65535.00 DFES_OneToOne 0.00 65535.00 FORMAT "%8.2" /end CHARACTERISTIC
/begin CHARACTERISTIC DFES_DTCO.DFC_rba_T15_Diag_ComOff_HwOn_Event_C "OBD specific trouble code / OBD specific diagnostic trouble code for check DFC_rba_T15_Diag_ComOff_HwOn_Event" VALUE 0x8050408C Val_Wu16 65535.00 DFES_OneToOne 0.00 65535.00 FORMAT "%8.2" /end CHARACTERISTIC
/begin CHARACTERISTIC DFES_DTCO.DFC_rba_T15_Diag_ComOn_HwOff_Event_C "OBD specific trouble code / OBD specific diagnostic trouble code for check DFC_rba_T15_Diag_ComOn_HwOff_Event" VALUE 0x8050408E Val_Wu16 65535.00 DFES_OneToOne 0.00 65535.00 FORMAT "%8.2" /end CHARACTERISTIC
/begin CHARACTERISTIC DFES_DTCO.DFC_AAVmin_C "OBD specific trouble code / OBD specific diagnostic trouble code for check DFC_AAVmin" VALUE 0x80504090 Val_Wu16 65535.00 DFES_OneToOne 0.00 65535.00 FORMAT "%8.2" /end CHARACTERISTIC
/begin CHARACTERISTIC DFES_DTCO.DFC_AGRSUS_C "OBD specific trouble code / OBD specific diagnostic trouble code for check DFC_AGRSUS" VALUE 0x80504092 Val_Wu16 65535.00 DFES_OneToOne 0.00 65535.00 FORMAT "%8.2" /end CHARACTERISTIC
/begin CHARACTERISTIC DFES_DTCO.DFC_AfsPlausDiagHi_C "OBD specific trouble code / OBD specific diagnostic trouble code for check DFC_AfsPlausDiagHi" VALUE 0x80504094 Val_Wu16 65535.00 DFES_OneToOne 0.00 65535.00 FORMAT "%8.2" /end CHARACTERISTIC
/begin CHARACTERISTIC DFES_DTCO.DFC_AfsPlausDiagLo_C "OBD specific trouble code / OBD specific diagnostic trouble code for check DFC_AfsPlausDiagLo" VALUE 0x80504096 Val_Wu16 65535.00 DFES_OneToOne 0.00 65535.00 FORMAT "%8.2" /end CHARACTERISTIC
/begin CHARACTERISTIC DFES_DTCO.DFC_AfsVrntDiagErrB1_C "OBD specific trouble code / OBD specific diagnostic trouble code for check DFC_AfsVrntDiagErrB1" VALUE 0x80504098 Val_Wu16 65535.00 DFES_OneToOne 0.00 65535.00 FORMAT "%8.2" /end CHARACTERISTIC
/begin CHARACTERISTIC DFES_DTCO.DFC_AppAllSnsrDfct_C "OBD specific trouble code / OBD specific diagnostic trouble code for check DFC_AppAllSnsrDfct" VALUE 0x8050409A Val_Wu16 65535.00 DFES_OneToOne 0.00 65535.00 FORMAT "%8.2" /end CHARACTERISTIC
/begin CHARACTERISTIC DFES_DTCO.DFC_BBKRnldg_C "OBD specific trouble code / OBD specific diagnostic trouble code for check DFC_BBKRnldg" VALUE 0x8050409C Val_Wu16 65535.00 DFES_OneToOne 0.00 65535.00 FORMAT "%8.2" /end CHARACTERISTIC
/begin CHARACTERISTIC DFES_DTCO.DFC_BBKRsyne_C "OBD specific trouble code / OBD specific diagnostic trouble code for check DFC_BBKRsyne" VALUE 0x8050409E Val_Wu16 65535.00 DFES_OneToOne 0.00 65535.00 FORMAT "%8.2" /end CHARACTERISTIC
/begin CHARACTERISTIC DFES_DTCO.DFC_BattUStdbyDiaOL_C "OBD specific trouble code / OBD specific diagnostic trouble code for check DFC_BattUStdbyDiaOL" VALUE 0x805040A0 Val_Wu16 65535.00 DFES_OneToOne 0.00 65535.00 FORMAT "%8.2" /end CHARACTERISTIC
/begin CHARACTERISTIC DFES_DTCO.DFC_BigLeakIntkMnfldEmiInfl_C "OBD specific trouble code / OBD specific diagnostic trouble code for check DFC_BigLeakIntkMnfldEmiInfl" VALUE 0x805040A2 Val_Wu16 65535.00 DFES_OneToOne 0.00 65535.00 FORMAT "%8.2" /end CHARACTERISTIC
/begin CHARACTERISTIC DFES_DTCO.DFC_BlkdLineTank_C "OBD specific trouble code / OBD specific diagnostic trouble code for check DFC_BlkdLineTank" VALUE 0x805040A4 Val_Wu16 65535.00 DFES_OneToOne 0.00 65535.00 FORMAT "%8.2" /end CHARACTERISTIC
/begin CHARACTERISTIC DFES_DTCO.DFC_BrkMnSwtContOnWarnLmp_C "OBD specific trouble code / OBD specific diagnostic trouble code for check DFC_BrkMnSwtContOnWarnLmp" VALUE 0x805040A6 Val_Wu16 65535.00 DFES_OneToOne 0.00 65535.00 FORMAT "%8.2" /end CHARACTERISTIC
/begin CHARACTERISTIC DFES_DTCO.DFC_BrkMnSwtNotStpWarnLmp_C "OBD specific trouble code / OBD specific diagnostic trouble code for check DFC_BrkMnSwtNotStpWarnLmp" VALUE 0x805040A8 Val_Wu16 65535.00 DFES_OneToOne 0.00 65535.00 FORMAT "%8.2" /end CHARACTERISTIC
/begin CHARACTERISTIC DFES_DTCO.DFC_BrkRdntSwtContOnWarnLmp_C "OBD specific trouble code / OBD specific diagnostic trouble code for check DFC_BrkRdntSwtContOnWarnLmp" VALUE 0x805040AA Val_Wu16 65535.00 DFES_OneToOne 0.00 65535.00 FORMAT "%8.2" /end CHARACTERISTIC
/begin CHARACTERISTIC DFES_DTCO.DFC_BrkRdntSwtNotStpWarnLmp_C "OBD specific trouble code / OBD specific diagnostic trouble code for check DFC_BrkRdntSwtNotStpWarnLmp" VALUE 0x805040AC Val_Wu16 65535.00 DFES_OneToOne 0.00 65535.00 FORMAT "%8.2" /end CHARACTERISTIC
/begin CHARACTERISTIC DFES_DTCO.DFC_CEngDsTColdStrtMax_C "OBD specific trouble code / OBD specific diagnostic trouble code for check DFC_CEngDsTColdStrtMax" VALUE 0x805040AE Val_Wu16 65535.00 DFES_OneToOne 0.00 65535.00 FORMAT "%8.2" /end CHARACTERISTIC
/begin CHARACTERISTIC DFES_DTCO.DFC_CEngDsTColdStrtMin_C "OBD specific trouble code / OBD specific diagnostic trouble code for check DFC_CEngDsTColdStrtMin" VALUE 0x805040B0 Val_Wu16 65535.00 DFES_OneToOne 0.00 65535.00 FORMAT "%8.2" /end CHARACTERISTIC
/begin CHARACTERISTIC DFES_DTCO.DFC_CEngDsTImps_C "OBD specific trouble code / OBD specific diagnostic trouble code for check DFC_CEngDsTImps" VALUE 0x805040B2 Val_Wu16 65535.00 DFES_OneToOne 0.00 65535.00 FORMAT "%8.2" /end CHARACTERISTIC
/begin CHARACTERISTIC DFES_DTCO.DFC_CEngDsTPlausHSC_C "OBD specific trouble code / OBD specific diagnostic trouble code for check DFC_CEngDsTPlausHSC" VALUE 0x805040B4 Val_Wu16 65535.00 DFES_OneToOne 0.00 65535.00 FORMAT "%8.2" /end CHARACTERISTIC
/begin CHARACTERISTIC DFES_DTCO.DFC_CEngDsTPlausLSC_C "OBD specific trouble code / OBD specific diagnostic trouble code for check DFC_CEngDsTPlausLSC" VALUE 0x805040B6 Val_Wu16 65535.00 DFES_OneToOne 0.00 65535.00 FORMAT "%8.2" /end CHARACTERISTIC
/begin CHARACTERISTIC DFES_DTCO.DFC_CEngDsTPlausSTC_C "OBD specific trouble code / OBD specific diagnostic trouble code for check DFC_CEngDsTPlausSTC" VALUE 0x805040B8 Val_Wu16 65535.00 DFES_OneToOne 0.00 65535.00 FORMAT "%8.2" /end CHARACTERISTIC
/begin CHARACTERISTIC DFES_DTCO.DFC_CEngDsTSRCMax_C "OBD specific trouble code / OBD specific diagnostic trouble code for check DFC_CEngDsTSRCMax" VALUE 0x805040BA Val_Wu16 65535.00 DFES_OneToOne 0.00 65535.00 FORMAT "%8.2" /end CHARACTERISTIC
/begin CHARACTERISTIC DFES_DTCO.DFC_CEngDsTSRCMin_C "OBD specific trouble code / OBD specific diagnostic trouble code for check DFC_CEngDsTSRCMin" VALUE 0x805040BC Val_Wu16 65535.00 DFES_OneToOne 0.00 65535.00 FORMAT "%8.2" /end CHARACTERISTIC
/begin CHARACTERISTIC DFES_DTCO.DFC_CEngDsTSig_C "OBD specific trouble code / OBD specific diagnostic trouble code for check DFC_CEngDsTSig" VALUE 0x805040BE Val_Wu16 65535.00 DFES_OneToOne 0.00 65535.00 FORMAT "%8.2" /end CHARACTERISTIC
/begin CHARACTERISTIC DFES_DTCO.DFC_CEngUsTColdStrtMax_C "OBD specific trouble code / OBD specific diagnostic trouble code for check DFC_CEngUsTColdStrtMax" VALUE 0x805040C0 Val_Wu16 65535.00 DFES_OneToOne 0.00 65535.00 FORMAT "%8.2" /end CHARACTERISTIC
/begin CHARACTERISTIC DFES_DTCO.DFC_CEngUsTColdStrtMin_C "OBD specific trouble code / OBD specific diagnostic trouble code for check DFC_CEngUsTColdStrtMin" VALUE 0x805040C2 Val_Wu16 65535.00 DFES_OneToOne 0.00 65535.00 FORMAT "%8.2" /end CHARACTERISTIC
/begin CHARACTERISTIC DFES_DTCO.DFC_CEngUsTLooseCnctn_C "OBD specific trouble code / OBD specific diagnostic trouble code for check DFC_CEngUsTLooseCnctn" VALUE 0x805040C4 Val_Wu16 65535.00 DFES_OneToOne 0.00 65535.00 FORMAT "%8.2" /end CHARACTERISTIC
/begin CHARACTERISTIC DFES_DTCO.DFC_CEngUsTSRCMax_C "OBD specific trouble code / OBD specific diagnostic trouble code for check DFC_CEngUsTSRCMax" VALUE 0x805040C6 Val_Wu16 65535.00 DFES_OneToOne 0.00 65535.00 FORMAT "%8.2" /end CHARACTERISTIC
/begin CHARACTERISTIC DFES_DTCO.DFC_CEngUsTSRCMin_C "OBD specific trouble code / OBD specific diagnostic trouble code for check DFC_CEngUsTSRCMin" VALUE 0x805040C8 Val_Wu16 65535.00 DFES_OneToOne 0.00 65535.00 FORMAT "%8.2" /end CHARACTERISTIC
/begin CHARACTERISTIC DFES_DTCO.DFC_ComDCDCACCFailr_C "OBD specific trouble code / OBD specific diagnostic trouble code for check DFC_ComDCDCACCFailr" VALUE 0x805040CA Val_Wu16 65535.00 DFES_OneToOne 0.00 65535.00 FORMAT "%8.2" /end CHARACTERISTIC
/begin CHARACTERISTIC DFES_DTCO.DFC_DCDCFltDet_C "OBD specific trouble code / OBD specific diagnostic trouble code for check DFC_DCDCFltDet" VALUE 0x805040CC Val_Wu16 65535.00 DFES_OneToOne 0.00 65535.00 FORMAT "%8.2" /end CHARACTERISTIC
/begin CHARACTERISTIC DFES_DTCO.DFC_DKRSA_C "OBD specific trouble code / OBD specific diagnostic trouble code for check DFC_DKRSA" VALUE 0x805040CE Val_Wu16 65535.00 DFES_OneToOne 0.00 65535.00 FORMAT "%8.2" /end CHARACTERISTIC
/begin CHARACTERISTIC DFES_DTCO.DFC_DKVSmax_C "OBD specific trouble code / OBD specific diagnostic trouble code for check DFC_DKVSmax" VALUE 0x805040D0 Val_Wu16 65535.00 DFES_OneToOne 0.00 65535.00 FORMAT "%8.2" /end CHARACTERISTIC
/begin CHARACTERISTIC DFES_DTCO.DFC_DKnpl_C "OBD specific trouble code / OBD specific diagnostic trouble code for check DFC_DKnpl" VALUE 0x805040D2 Val_Wu16 65535.00 DFES_OneToOne 0.00 65535.00 FORMAT "%8.2" /end CHARACTERISTIC
/begin CHARACTERISTIC DFES_DTCO.DFC_DSKVRmax_C "OBD specific trouble code / OBD specific diagnostic trouble code for check DFC_DSKVRmax" VALUE 0x805040D4 Val_Wu16 65535.00 DFES_OneToOne 0.00 65535.00 FORMAT "%8.2" /end CHARACTERISTIC
/begin CHARACTERISTIC DFES_DTCO.DFC_DSKVRmin_C "OBD specific trouble code / OBD specific diagnostic trouble code for check DFC_DSKVRmin" VALUE 0x805040D6 Val_Wu16 65535.00 DFES_OneToOne 0.00 65535.00 FORMAT "%8.2" /end CHARACTERISTIC
/begin CHARACTERISTIC DFES_DTCO.DFC_DSKVRnpl_C "OBD specific trouble code / OBD specific diagnostic trouble code for check DFC_DSKVRnpl" VALUE 0x805040D8 Val_Wu16 65535.00 DFES_OneToOne 0.00 65535.00 FORMAT "%8.2" /end CHARACTERISTIC
/begin CHARACTERISTIC DFES_DTCO.DFC_DSKVRsig_C "OBD specific trouble code / OBD specific diagnostic trouble code for check DFC_DSKVRsig" VALUE 0x805040DA Val_Wu16 65535.00 DFES_OneToOne 0.00 65535.00 FORMAT "%8.2" /end CHARACTERISTIC
/begin CHARACTERISTIC DFES_DTCO.DFC_DSKVSsig_C "OBD specific trouble code / OBD specific diagnostic trouble code for check DFC_DSKVSsig" VALUE 0x805040DC Val_Wu16 65535.00 DFES_OneToOne 0.00 65535.00 FORMAT "%8.2" /end CHARACTERISTIC
/begin CHARACTERISTIC DFES_DTCO.DFC_DSSmax_C "OBD specific trouble code / OBD specific diagnostic trouble code for check DFC_DSSmax" VALUE 0x805040DE Val_Wu16 65535.00 DFES_OneToOne 0.00 65535.00 FORMAT "%8.2" /end CHARACTERISTIC
/begin CHARACTERISTIC DFES_DTCO.DFC_DSTDmax_C "OBD specific trouble code / OBD specific diagnostic trouble code for check DFC_DSTDmax" VALUE 0x805040E0 Val_Wu16 65535.00 DFES_OneToOne 0.00 65535.00 FORMAT "%8.2" /end CHARACTERISTIC
/begin CHARACTERISTIC DFES_DTCO.DFC_DSTEmax_C "OBD specific trouble code / OBD specific diagnostic trouble code for check DFC_DSTEmax" VALUE 0x805040E2 Val_Wu16 65535.00 DFES_OneToOne 0.00 65535.00 FORMAT "%8.2" /end CHARACTERISTIC
/begin CHARACTERISTIC DFES_DTCO.DFC_DSTEmin_C "OBD specific trouble code / OBD specific diagnostic trouble code for check DFC_DSTEmin" VALUE 0x805040E4 Val_Wu16 65535.00 DFES_OneToOne 0.00 65535.00 FORMAT "%8.2" /end CHARACTERISTIC
/begin CHARACTERISTIC DFES_DTCO.DFC_DSTOFmax_C "OBD specific trouble code / OBD specific diagnostic trouble code for check DFC_DSTOFmax" VALUE 0x805040E6 Val_Wu16 65535.00 DFES_OneToOne 0.00 65535.00 FORMAT "%8.2" /end CHARACTERISTIC
/begin CHARACTERISTIC DFES_DTCO.DFC_DSTRmax_C "OBD specific trouble code / OBD specific diagnostic trouble code for check DFC_DSTRmax" VALUE 0x805040E8 Val_Wu16 65535.00 DFES_OneToOne 0.00 65535.00 FORMAT "%8.2" /end CHARACTERISTIC
/begin CHARACTERISTIC DFES_DTCO.DFC_DSTRmin_C "OBD specific trouble code / OBD specific diagnostic trouble code for check DFC_DSTRmin" VALUE 0x805040EA Val_Wu16 65535.00 DFES_OneToOne 0.00 65535.00 FORMAT "%8.2" /end CHARACTERISTIC
/begin CHARACTERISTIC DFES_DTCO.DFC_DSTRnpl_C "OBD specific trouble code / OBD specific diagnostic trouble code for check DFC_DSTRnpl" VALUE 0x805040EC Val_Wu16 65535.00 DFES_OneToOne 0.00 65535.00 FORMAT "%8.2" /end CHARACTERISTIC
/begin CHARACTERISTIC DFES_DTCO.DFC_DSTRsig_C "OBD specific trouble code / OBD specific diagnostic trouble code for check DFC_DSTRsig" VALUE 0x805040EE Val_Wu16 65535.00 DFES_OneToOne 0.00 65535.00 FORMAT "%8.2" /end CHARACTERISTIC
/begin CHARACTERISTIC DFES_DTCO.DFC_DSTTI_C "OBD specific trouble code / OBD specific diagnostic trouble code for check DFC_DSTTI" VALUE 0x805040F0 Val_Wu16 65535.00 DFES_OneToOne 0.00 65535.00 FORMAT "%8.2" /end CHARACTERISTIC
/begin CHARACTERISTIC DFES_DTCO.DFC_DSUmax_C "OBD specific trouble code / OBD specific diagnostic trouble code for check DFC_DSUmax" VALUE 0x805040F2 Val_Wu16 65535.00 DFES_OneToOne 0.00 65535.00 FORMAT "%8.2" /end CHARACTERISTIC
/begin CHARACTERISTIC DFES_DTCO.DFC_DiagCpv1DteskLoLoadStuckClsd_C "OBD specific trouble code / OBD specific diagnostic trouble code for check DFC_DiagCpv1DteskLoLoadStuckClsd" VALUE 0x805040F4 Val_Wu16 65535.00 DFES_OneToOne 0.00 65535.00 FORMAT "%8.2" /end CHARACTERISTIC
/begin CHARACTERISTIC DFES_DTCO.DFC_DiagCpv1DteskLoLoadStuckOpen_C "OBD specific trouble code / OBD specific diagnostic trouble code for check DFC_DiagCpv1DteskLoLoadStuckOpen" VALUE 0x805040F6 Val_Wu16 65535.00 DFES_OneToOne 0.00 65535.00 FORMAT "%8.2" /end CHARACTERISTIC
/begin CHARACTERISTIC DFES_DTCO.DFC_EGRVlvDrftClsd_C "OBD specific trouble code / OBD specific diagnostic trouble code for check DFC_EGRVlvDrftClsd" VALUE 0x805040F8 Val_Wu16 65535.00 DFES_OneToOne 0.00 65535.00 FORMAT "%8.2" /end CHARACTERISTIC
/begin CHARACTERISTIC DFES_DTCO.DFC_EGRVlvDrftOpn_C "OBD specific trouble code / OBD specific diagnostic trouble code for check DFC_EGRVlvDrftOpn" VALUE 0x805040FA Val_Wu16 65535.00 DFES_OneToOne 0.00 65535.00 FORMAT "%8.2" /end CHARACTERISTIC
/begin CHARACTERISTIC DFES_DTCO.DFC_EGRVlvJamVlvClsd_C "OBD specific trouble code / OBD specific diagnostic trouble code for check DFC_EGRVlvJamVlvClsd" VALUE 0x805040FC Val_Wu16 65535.00 DFES_OneToOne 0.00 65535.00 FORMAT "%8.2" /end CHARACTERISTIC
/begin CHARACTERISTIC DFES_DTCO.DFC_EGRVlvJamVlvOpn_C "OBD specific trouble code / OBD specific diagnostic trouble code for check DFC_EGRVlvJamVlvOpn" VALUE 0x805040FE Val_Wu16 65535.00 DFES_OneToOne 0.00 65535.00 FORMAT "%8.2" /end CHARACTERISTIC
/begin CHARACTERISTIC DFES_DTCO.DFC_EGRVlvSprgBrk_C "OBD specific trouble code / OBD specific diagnostic trouble code for check DFC_EGRVlvSprgBrk" VALUE 0x80504100 Val_Wu16 65535.00 DFES_OneToOne 0.00 65535.00 FORMAT "%8.2" /end CHARACTERISTIC
/begin CHARACTERISTIC DFES_DTCO.DFC_EGRVlvTempMdlEEPErr_C "OBD specific trouble code / OBD specific diagnostic trouble code for check DFC_EGRVlvTempMdlEEPErr" VALUE 0x80504102 Val_Wu16 65535.00 DFES_OneToOne 0.00 65535.00 FORMAT "%8.2" /end CHARACTERISTIC
/begin CHARACTERISTIC DFES_DTCO.DFC_EGRVlvTmpErr_C "OBD specific trouble code / OBD specific diagnostic trouble code for check DFC_EGRVlvTmpErr" VALUE 0x80504104 Val_Wu16 65535.00 DFES_OneToOne 0.00 65535.00 FORMAT "%8.2" /end CHARACTERISTIC
/begin CHARACTERISTIC DFES_DTCO.DFC_EGSDUS2B1LtrDly_C "OBD specific trouble code / OBD specific diagnostic trouble code for check DFC_EGSDUS2B1LtrDly" VALUE 0x80504106 Val_Wu16 65535.00 DFES_OneToOne 0.00 65535.00 FORMAT "%8.2" /end CHARACTERISTIC
/begin CHARACTERISTIC DFES_DTCO.DFC_EGSDUS2B1LtrPT1_C "OBD specific trouble code / OBD specific diagnostic trouble code for check DFC_EGSDUS2B1LtrPT1" VALUE 0x80504108 Val_Wu16 65535.00 DFES_OneToOne 0.00 65535.00 FORMAT "%8.2" /end CHARACTERISTIC
/begin CHARACTERISTIC DFES_DTCO.DFC_EGSDUS2B1RtlDly_C "OBD specific trouble code / OBD specific diagnostic trouble code for check DFC_EGSDUS2B1RtlDly" VALUE 0x8050410A Val_Wu16 65535.00 DFES_OneToOne 0.00 65535.00 FORMAT "%8.2" /end CHARACTERISTIC
/begin CHARACTERISTIC DFES_DTCO.DFC_EGSDUS2B1RtlPT1_C "OBD specific trouble code / OBD specific diagnostic trouble code for check DFC_EGSDUS2B1RtlPT1" VALUE 0x8050410C Val_Wu16 65535.00 DFES_OneToOne 0.00 65535.00 FORMAT "%8.2" /end CHARACTERISTIC
/begin CHARACTERISTIC DFES_DTCO.DFC_EGSDUS2B1TarLean_C "OBD specific trouble code / OBD specific diagnostic trouble code for check DFC_EGSDUS2B1TarLean" VALUE 0x8050410E Val_Wu16 65535.00 DFES_OneToOne 0.00 65535.00 FORMAT "%8.2" /end CHARACTERISTIC
/begin CHARACTERISTIC DFES_DTCO.DFC_EGSDUS2B1TarRich_C "OBD specific trouble code / OBD specific diagnostic trouble code for check DFC_EGSDUS2B1TarRich" VALUE 0x80504110 Val_Wu16 65535.00 DFES_OneToOne 0.00 65535.00 FORMAT "%8.2" /end CHARACTERISTIC
/begin CHARACTERISTIC DFES_DTCO.DFC_EONVmax_C "OBD specific trouble code / OBD specific diagnostic trouble code for check DFC_EONVmax" VALUE 0x80504112 Val_Wu16 65535.00 DFES_OneToOne 0.00 65535.00 FORMAT "%8.2" /end CHARACTERISTIC
/begin CHARACTERISTIC DFES_DTCO.DFC_ETAKHLmax_C "OBD specific trouble code / OBD specific diagnostic trouble code for check DFC_ETAKHLmax" VALUE 0x80504114 Val_Wu16 65535.00 DFES_OneToOne 0.00 65535.00 FORMAT "%8.2" /end CHARACTERISTIC
/begin CHARACTERISTIC DFES_DTCO.DFC_ETAKHTmax_C "OBD specific trouble code / OBD specific diagnostic trouble code for check DFC_ETAKHTmax" VALUE 0x80504116 Val_Wu16 65535.00 DFES_OneToOne 0.00 65535.00 FORMAT "%8.2" /end CHARACTERISTIC
/begin CHARACTERISTIC DFES_DTCO.DFC_ETHSEmax_C "OBD specific trouble code / OBD specific diagnostic trouble code for check DFC_ETHSEmax" VALUE 0x80504118 Val_Wu16 65535.00 DFES_OneToOne 0.00 65535.00 FORMAT "%8.2" /end CHARACTERISTIC
/begin CHARACTERISTIC DFES_DTCO.DFC_ETHSEmin_C "OBD specific trouble code / OBD specific diagnostic trouble code for check DFC_ETHSEmin" VALUE 0x8050411A Val_Wu16 65535.00 DFES_OneToOne 0.00 65535.00 FORMAT "%8.2" /end CHARACTERISTIC
/begin CHARACTERISTIC DFES_DTCO.DFC_ETHSFmax_C "OBD specific trouble code / OBD specific diagnostic trouble code for check DFC_ETHSFmax" VALUE 0x8050411C Val_Wu16 65535.00 DFES_OneToOne 0.00 65535.00 FORMAT "%8.2" /end CHARACTERISTIC
/begin CHARACTERISTIC DFES_DTCO.DFC_ETHSFmin_C "OBD specific trouble code / OBD specific diagnostic trouble code for check DFC_ETHSFmin" VALUE 0x8050411E Val_Wu16 65535.00 DFES_OneToOne 0.00 65535.00 FORMAT "%8.2" /end CHARACTERISTIC
/begin FUNCTION DFES "30000.73.0_2.0.0Diagnostic Fault Event Storage"
 /begin DEF_CHARACTERISTIC DFES_Cls.DFC_MOXEMM_SMU_ALM6_5_C DFES_Cls.DFC_MOXEMM_SMU_ALM6_7_C DFES_Cls.DFC_MOXEMM_SMU_ALM6_8_C DFES_Cls.DFC_MOXEMM_SMU_ALM7_1_C DFES_Cls.DFC_MOXEMM_SMU_ALM7_12_C DFES_Cls.DFC_MOXEMM_SMU_ALM7_13_C DFES_Cls.DFC_MOXEMM_SMU_ALM7_14_C DFES_Cls.DFC_MOXEMM_SMU_ALM7_15_C DFES_Cls.DFC_MOXEMM_SMU_ALM7_16_C DFES_Cls.DFC_MOXEMM_SMU_ALM7_17_C DFES_Cls.DFC_MOXEMM_SMU_ALM7_2_C DFES_Cls.DFC_MOXEMM_SMU_ALM7_20_C DFES_Cls.DFC_MOXEMM_SMU_ALM7_25_C DFES_Cls.DFC_MOXEMM_SMU_ALM7_26_C DFES_Cls.DFC_MOXEMM_SMU_ALM7_28_C DFES_Cls.DFC_MOXEMM_SMU_ALM7_29_C DFES_Cls.DFC_MOXEMM_SMU_ALM7_30_C DFES_Cls.DFC_MOXEMM_SMU_ALM7_31_C DFES_Cls.DFC_MOXEMM_SMU_ALM8_0_C DFES_Cls.DFC_MOXEMM_SMU_ALM8_1_C DFES_Cls.DFC_MOXEMM_SMU_ALM8_10_C DFES_Cls.DFC_MOXEMM_SMU_ALM8_11_C DFES_Cls.DFC_MOXEMM_SMU_ALM8_12_C DFES_Cls.DFC_MOXEMM_SMU_ALM8_16_C DFES_Cls.DFC_MOXEMM_SMU_ALM8_18_C DFES_Cls.DFC_MOXEMM_SMU_ALM8_2_C DFES_Cls.DFC_MOXEMM_SMU_ALM8_3_C DFES_Cls.DFC_MOXEMM_SMU_ALM8_31_C DFES_Cls.DFC_MOXEMM_SMU_ALM8_4_C DFES_Cls.DFC_MOXEMM_SMU_ALM9_0_C DFES_Cls.DFC_MOXEMM_SMU_ALM9_15_C DFES_Cls.DFC_MOXEMM_SMU_ALM9_3_C DFES_Cls.DFC_MoCADCNTP_C DFES_Cls.DFC_MoCADCTst_C DFES_Cls.DFC_MoCSOPICO_C DFES_Cls.DFC_MoFAPP_C DFES_Cls.DFC_MoFAirFilgPrdc_C DFES_Cls.DFC_MoFAirFlCtOffGdi_C DFES_Cls.DFC_MoFAirFlCylGdi_C DFES_Cls.DFC_MoFAirFlFF_C DFES_Cls.DFC_MoFAirFlIn_C DFES_Cls.DFC_MoFAirFlMixCtlGdiChkAirFl_C DFES_Cls.DFC_MoFAirFlMixCtlGdiChkCtrl_C DFES_Cls.DFC_MoFAirFlMode_C DFES_Cls.DFC_MoFESpd_C DFES_Cls.DFC_MoFIACo_C DFES_Cls.DFC_MoFICOL1_C DFES_Cls.DFC_MoFICOL2_C DFES_Cls.DFC_MoFStrt_C DFES_Cls.DFC_MoFTrqCmp_C DFES_Cls.DFC_MoFTrqCmpMax_C DFES_Cls.DFC_MoFTrqCmpMin_C DFES_Cls.DFC_MoFVarPostBldSel_C DFES_Cls.DFC_MoXEMMHwLTMCUFW_C DFES_Cls.DFC_MoXEMMHwLTMonBIST_C DFES_Cls.DFC_MoXEMMHwLTRegMonTest_C DFES_Cls.DFC_MoXEMMHwLTStbySMUAlvTest_C DFES_Cls.DFC_MoXEMMHwLTTempSens_C DFES_Cls.DFC_MoXEMMHwLTUCBCfg_C DFES_Cls.DFC_NWSEmax_C DFES_Cls.DFC_NWSmax_C DFES_Cls.DFC_OCWDAABEActv_C DFES_Cls.DFC_OCWDACom_C DFES_Cls.DFC_OCWDAErrPin_C DFES_Cls.DFC_OCWDAOvrVltg_C DFES_Cls.DFC_ORAmax_C DFES_Cls.DFC_ORAmin_C DFES_Cls.DFC_OilPPlaus_C DFES_Cls.DFC_PLLSUmax_C DFES_Cls.DFC_PLLSUmin_C DFES_Cls.DFC_PSR1max_C DFES_Cls.DFC_PSRBmax_C DFES_Cls.DFC_PSRBmin_C DFES_Cls.DFC_PSRPmax_C DFES_Cls.DFC_PSRPmin_C DFES_Cls.DFC_PSRPsig_C DFES_Cls.DFC_PSRmax_C DFES_Cls.DFC_PUmax_C DFES_Cls.DFC_P_VSE11_OL_C DFES_Cls.DFC_P_VSE11_SCB_C DFES_Cls.DFC_P_VSE11_SCG_C DFES_Cls.DFC_PhyHighAPP1_C DFES_Cls.DFC_PhyHighAPP2_C DFES_Cls.DFC_PhyLowAPP1_C DFES_Cls.DFC_PhyLowAPP2_C DFES_Cls.DFC_SRCHighAPP1_C DFES_Cls.DFC_SRCHighAPP2_C DFES_Cls.DFC_SRCLowAPP1_C DFES_Cls.DFC_SRCLowAPP2_C DFES_Cls.DFC_SSpMon2_C DFES_Cls.DFC_STHDRmax_C DFES_Cls.DFC_SWReset_0_C DFES_Cls.DFC_SWReset_1_C DFES_Cls.DFC_SWReset_2_C DFES_Cls.DFC_SyncAPP_C DFES_Cls.DFC_TANKLnpl_C DFES_Cls.DFC_TAmax_Dummy_C DFES_Cls.DFC_TESFmax_C DFES_Cls.DFC_TESGmax_C DFES_Cls.DFC_TKAEmax_C DFES_Cls.DFC_TKAEmin_C DFES_Cls.DFC_TKARmax_C DFES_Cls.DFC_TKARnpl_C DFES_Cls.DFC_TMmax_Dummy_C DFES_Cls.DFC_TUMmax_Dummy_C DFES_Cls.DFC_TWCDPriCatB1_C DFES_Cls.DFC_ThrVlvClsdPosnFirstOffsLrnImpoB1_C DFES_Cls.DFC_ThrVlvClsdPosnOffsLrnImpoB1_C DFES_Cls.DFC_ThrVlvClsdPosnOffsLrnMaxB1_C DFES_Cls.DFC_ThrVlvClsdPosnOffsLrnMinB1_C DFES_Cls.DFC_ThrVlvCtrlDeB1_C DFES_Cls.DFC_ThrVlvDycB1_C DFES_Cls.DFC_ThrVlvLimpAirPosnMaxAbsltDriftB1_C DFES_Cls.DFC_ThrVlvLimpAirPosnMaxB1_C DFES_Cls.DFC_ThrVlvLimpAirPosnMaxRelDriftB1_C DFES_Cls.DFC_ThrVlvLimpAirPosnMinB1_C DFES_Cls.DFC_ThrVlvOpenLoadB1_C DFES_Cls.DFC_ThrVlvOpenSprgB1_C DFES_Cls.DFC_ThrVlvOpenSprgSprdB1_C DFES_Cls.DFC_ThrVlvOpenSprgTwnB1_C DFES_Cls.DFC_ThrVlvOverTB1_C DFES_Cls.DFC_ThrVlvRetSprgB1_C DFES_Cls.DFC_ThrVlvRetSprgSprdB1_C DFES_Cls.DFC_ThrVlvRetSprgTwnB1_C DFES_Cls.DFC_ThrVlvSens1MaxB1_C DFES_Cls.DFC_ThrVlvSens1NplB1_C DFES_Cls.DFC_ThrVlvSens2MaxB1_C DFES_Cls.DFC_ThrVlvSens2MinB1_C DFES_Cls.DFC_ThrVlvSens2NplB1_C DFES_Cls.DFC_ThrVlvShoCircB1_C DFES_Cls.DFC_ThrVlvSpiErrB1_C DFES_Cls.DFC_ThrvlvSens1MinB1_C DFES_Cls.DFC_TiOffTBasdChkFast_C DFES_Cls.DFC_TiOffTBasdChkSlow_C DFES_Cls.DFC_UEGOSnsrMntdS1B1_C DFES_Cls.DFC_VehVSig_C DFES_Cls.DFC_VlvLftFbSwtIntk11SpclFail_C DFES_Cls.DFC_VlvLftFbSwtIntk11StdFail_C DFES_DbLv_C DFES_DTCO.DFC_Unused_C DFES_DTCO.DFC_AAVEmax_C DFES_DTCO.DFC_AAVEmin_C DFES_DTCO.DFC_AAVEsig_C DFES_DTCO.DFC_AltIOACGFailr_C DFES_DTCO.DFC_AltIOACGHiVltg_C DFES_DTCO.DFC_AltIOACGLoVltg_C DFES_DTCO.DFC_AltIOACGTHi_C DFES_DTCO.DFC_AltIODConnACG_C DFES_DTCO.DFC_BGOELWAF_C DFES_DTCO.DFC_BattUHiFailr_C DFES_DTCO.DFC_BattULoFailr_C DFES_DTCO.DFC_BrkBstPDriftHiErr_C DFES_DTCO.DFC_BrkBstPDriftLoErr_C DFES_DTCO.DFC_BrkBstPSnsrStuck_C DFES_DTCO.DFC_BrkMnSwtContOn_C DFES_DTCO.DFC_BrkMnSwtNotStp_C DFES_DTCO.DFC_BrkNpl_C DFES_DTCO.DFC_BrkRdntSwtContOn_C DFES_DTCO.DFC_BrkRdntSwtNotStp_C DFES_DTCO.DFC_Clth3ONStuck_C DFES_DTCO.DFC_Clth4OFFStuck_C DFES_DTCO.DFC_ClthOFFStuck_C DFES_DTCO.DFC_ClthONStuck_C DFES_DTCO.DFC_ClthStkFailInfo_C DFES_DTCO.DFC_ComACFailInfo_C DFES_DTCO.DFC_ComATFTValErr_C DFES_DTCO.DFC_ComATMILReq_C DFES_DTCO.DFC_ComAYCAChksum_C DFES_DTCO.DFC_ComAYCARingCnt_C DFES_DTCO.DFC_ComAYCATOut_C DFES_DTCO.DFC_ComAYCDChkSum_C DFES_DTCO.DFC_ComAYCDTOut_C DFES_DTCO.DFC_ComAYCFChksum_C DFES_DTCO.DFC_ComAYCFRingCnt_C DFES_DTCO.DFC_ComAYCFTOut_C DFES_DTCO.DFC_ComAYCGChksum_C DFES_DTCO.DFC_ComAYCGRingCnt_C DFES_DTCO.DFC_ComAYCGTOut_C DFES_DTCO.DFC_ComAYCIChkSum_C DFES_DTCO.DFC_ComAYCIRingCnt_C DFES_DTCO.DFC_ComAYCITOut_C DFES_DTCO.DFC_ComBCM1ChkSum_C DFES_DTCO.DFC_ComBCM1RingCnt_C DFES_DTCO.DFC_ComBCM1TOut_C DFES_DTCO.DFC_ComCANABusOffErr_C DFES_DTCO.DFC_ComCANBBusOffErr_C DFES_DTCO.DFC_ComCANCBusOffErr_C DFES_DTCO.DFC_ComCGW1ChkSum_C DFES_DTCO.DFC_ComCGW1RingCnt_C DFES_DTCO.DFC_ComCGW1TOut_C DFES_DTCO.DFC_ComConvBoostErr_C DFES_DTCO.DFC_ComConvSlipErr_C DFES_DTCO.DFC_ComDCDCPrfmncErr_C DFES_DTCO.DFC_ComDCDCTempWarn_C DFES_DTCO.DFC_ComEAT10Chksum_C DFES_DTCO.DFC_ComEAT10RingCnt_C DFES_DTCO.DFC_ComEAT10TOut_C DFES_DTCO.DFC_ComEAT11ChkSum_C DFES_DTCO.DFC_ComEAT11RingCnt_C DFES_DTCO.DFC_ComEAT11TOut_C DFES_DTCO.DFC_ComEAT12ChkSum_C DFES_DTCO.DFC_ComEAT12RingCnt_C DFES_DTCO.DFC_ComEAT12TOut_C DFES_DTCO.DFC_ComEAT13ChkSum_C DFES_DTCO.DFC_ComEAT13RingCnt_C DFES_DTCO.DFC_ComEAT13TOut_C DFES_DTCO.DFC_ComEAT1Chksum_C DFES_DTCO.DFC_ComEAT1RingCnt_C DFES_DTCO.DFC_ComEAT1TOut_C DFES_DTCO.DFC_ComEAT2ChkSum_C DFES_DTCO.DFC_ComEAT2RingCnt_C DFES_DTCO.DFC_ComEAT2TOut_C DFES_DTCO.DFC_ComEAT4ChkSum_C DFES_DTCO.DFC_ComEAT4RingCnt_C DFES_DTCO.DFC_ComEAT4TOut_C DFES_DTCO.DFC_ComEAT6Chksum_C DFES_DTCO.DFC_ComEAT6RingCnt_C DFES_DTCO.DFC_ComEAT6TOut_C DFES_DTCO.DFC_ComEAT7Chksum_C DFES_DTCO.DFC_ComEAT7RingCnt_C DFES_DTCO.DFC_ComEAT7TOut_C DFES_DTCO.DFC_ComEAT8Chksum_C DFES_DTCO.DFC_ComEAT8RingCnt_C DFES_DTCO.DFC_ComEAT8TOut_C DFES_DTCO.DFC_ComEATAChksum_C DFES_DTCO.DFC_ComEATARingCnt_C DFES_DTCO.DFC_ComEATATOut_C DFES_DTCO.DFC_ComEATBChkSum_C DFES_DTCO.DFC_ComEATBRingCnt_C DFES_DTCO.DFC_ComEATBTOut_C DFES_DTCO.DFC_ComEATCChksum_C DFES_DTCO.DFC_ComEATCRingCnt_C DFES_DTCO.DFC_ComEATCTOut_C DFES_DTCO.DFC_ComEPBBChkSum_C DFES_DTCO.DFC_ComEPBBRingCnt_C DFES_DTCO.DFC_ComEPBBTOut_C DFES_DTCO.DFC_ComEPBChksum_C DFES_DTCO.DFC_ComEPBTOut_C DFES_DTCO.DFC_ComEPBctRing_C DFES_DTCO.DFC_ComEPS1Chksum_C DFES_DTCO.DFC_ComEPS1RingCnt_C DFES_DTCO.DFC_ComEPS1TOut_C DFES_DTCO.DFC_ComEngCanRxErr_C DFES_DTCO.DFC_ComGrvySnsrErr_C DFES_DTCO.DFC_ComGwIMG1ChkSum_C DFES_DTCO.DFC_ComGwIMG1RingCnt_C DFES_DTCO.DFC_ComGwIMG1TOut_C DFES_DTCO.DFC_ComGwIMG3ChkSum_C DFES_DTCO.DFC_ComGwIMG3RingCnt_C DFES_DTCO.DFC_ComGwIMG3TOut_C DFES_DTCO.DFC_ComGwIMG4ChkSum_C DFES_DTCO.DFC_ComGwIMG4RingCnt_C DFES_DTCO.DFC_ComGwIMG4TOut_C DFES_DTCO.DFC_ComGwIMG5ChkSum_C DFES_DTCO.DFC_ComGwIMG5RingCnt_C DFES_DTCO.DFC_ComGwIMG5TOut_C DFES_DTCO.DFC_ComGwIMG6ChkSum_C DFES_DTCO.DFC_ComGwIMG6RingCnt_C DFES_DTCO.DFC_ComGwIMG6TOut_C DFES_DTCO.DFC_ComIDASBChksum_C DFES_DTCO.DFC_ComIDASBRingCnt_C DFES_DTCO.DFC_ComIDASBTOut_C DFES_DTCO.DFC_ComIMGMILReq_C DFES_DTCO.DFC_ComISSPrms_C DFES_DTCO.DFC_ComMETAChksum_C DFES_DTCO.DFC_ComMETAChksumPstDrv_C DFES_DTCO.DFC_ComMETARingCnt_C DFES_DTCO.DFC_ComMETARingCntPstDrv_C DFES_DTCO.DFC_ComMETATOut_C DFES_DTCO.DFC_ComMETATOutPstDrv_C DFES_DTCO.DFC_ComMETCChksum_C DFES_DTCO.DFC_ComMETCRingCnt_C DFES_DTCO.DFC_ComMETCTOut_C DFES_DTCO.DFC_ComMETDChksum_C DFES_DTCO.DFC_ComMETDRingCnt_C DFES_DTCO.DFC_ComMETDTOut_C DFES_DTCO.DFC_ComMETE2Chksum_C DFES_DTCO.DFC_ComMETE2RingCnt_C DFES_DTCO.DFC_ComMETE2TOut_C DFES_DTCO.DFC_ComMETFChksum_C DFES_DTCO.DFC_ComMETFRingCnt_C DFES_DTCO.DFC_ComMETFTOut_C DFES_DTCO.DFC_ComMETGChksum_C DFES_DTCO.DFC_ComMETGRingCnt_C DFES_DTCO.DFC_ComMETGTOut_C DFES_DTCO.DFC_ComMETH2Chksum_C DFES_DTCO.DFC_ComMETH2RingCnt_C DFES_DTCO.DFC_ComMETH2TOut_C DFES_DTCO.DFC_ComMETHChksum_C DFES_DTCO.DFC_ComMETHRingCnt_C DFES_DTCO.DFC_ComMETHTOut_C DFES_DTCO.DFC_ComMETIChksum_C DFES_DTCO.DFC_ComMETIRingCnt_C DFES_DTCO.DFC_ComMETITOut_C DFES_DTCO.DFC_ComMETKChksum_C DFES_DTCO.DFC_ComMETKRingCnt_C DFES_DTCO.DFC_ComMETKTOut_C DFES_DTCO.DFC_ComMETLChksum_C DFES_DTCO.DFC_ComMETLRingCnt_C DFES_DTCO.DFC_ComMETLTOut_C DFES_DTCO.DFC_ComMETMChksum_C DFES_DTCO.DFC_ComMETMRingCnt_C DFES_DTCO.DFC_ComMETMTOut_C DFES_DTCO.DFC_ComMETNChksum_C DFES_DTCO.DFC_ComMETNRingCnt_C DFES_DTCO.DFC_ComMETNTOut_C DFES_DTCO.DFC_ComMtrCom_C DFES_DTCO.DFC_ComPCUChkSum_C DFES_DTCO.DFC_ComPCURingCnt_C DFES_DTCO.DFC_ComPCUTOut_C DFES_DTCO.DFC_ComSRSAChksum_C DFES_DTCO.DFC_ComSRSARingCnt_C DFES_DTCO.DFC_ComSRSATOut_C DFES_DTCO.DFC_ComSRSBChksum_C DFES_DTCO.DFC_ComSRSBRingCnt_C DFES_DTCO.DFC_ComSRSBTOut_C DFES_DTCO.DFC_ComSRSChksum_C DFES_DTCO.DFC_ComSRSErr_C DFES_DTCO.DFC_ComSRSRingCnt_C DFES_DTCO.DFC_ComSRSTOut_C DFES_DTCO.DFC_ComVehSpdPndFltTCU_C DFES_DTCO.DFC_EbsChartcCurrErr_C DFES_DTCO.DFC_EbsSelfDiagErr_C DFES_DTCO.DFC_GEVlvPhaCsersIntkB1_C DFES_DTCO.DFC_GEVlvPhaPsOpenLoadIntkB1_C DFES_DTCO.DFC_GEVlvPhaPsShoToBattIntkB1_C DFES_DTCO.DFC_GEVlvPhaPsShoToGndIntkB1_C DFES_DTCO.DFC_GbxCANDigPlausErr_C DFES_DTCO.DFC_GbxNPos1SRCMax_C DFES_DTCO.DFC_GbxNPos1SRCMin_C DFES_DTCO.DFC_GbxNPos2SRCMax_C DFES_DTCO.DFC_GbxNPos2SRCMin_C DFES_DTCO.DFC_GbxNPosAlvChk_C DFES_DTCO.DFC_GbxNPosSyncErr_C DFES_DTCO.DFC_HEGOS2B1HtrPsMax_C DFES_DTCO.DFC_HEGOS2B1HtrPsMin_C DFES_DTCO.DFC_HEGOS2B1HtrPsSig_C DFES_DTCO.DFC_LinCSErrACG_C DFES_DTCO.DFC_LinCSErrAEV_C DFES_DTCO.DFC_LinCSErrDCDC_C DFES_DTCO.DFC_LinCSErrEBS_C DFES_DTCO.DFC_LinHdrTimeoutErrACG_C DFES_DTCO.DFC_LinHdrTimeoutErrAEV_C DFES_DTCO.DFC_LinHdrTimeoutErrDCDC_C DFES_DTCO.DFC_LinHdrTimeoutErrEBS_C DFES_DTCO.DFC_LinMsgTimeoutErrACG_C DFES_DTCO.DFC_LinMsgTimeoutErrAEV_C DFES_DTCO.DFC_LinMsgTimeoutErrDCDC_C DFES_DTCO.DFC_LinMsgTimeoutErrEBS_C DFES_DTCO.DFC_LinNoStrtComErr_C DFES_DTCO.DFC_LowPresOilP_C DFES_DTCO.DFC_MisfDetVWhlFrntLeOORHi_C DFES_DTCO.DFC_MisfDetVWhlFrntLeRatyHi_C DFES_DTCO.DFC_MisfDetVWhlFrntLeRatyLo_C DFES_DTCO.DFC_MisfDetVWhlFrntLeStuck_C DFES_DTCO.DFC_MisfDetVWhlFrntRiOORHi_C DFES_DTCO.DFC_MisfDetVWhlFrntRiRatyHi_C DFES_DTCO.DFC_MisfDetVWhlFrntRiRatyLo_C DFES_DTCO.DFC_MisfDetVWhlFrntRiStuck_C DFES_DTCO.DFC_MisfDetVWhlReLeOORHi_C DFES_DTCO.DFC_MisfDetVWhlReLeRatyHi_C DFES_DTCO.DFC_MisfDetVWhlReLeRatyLo_C DFES_DTCO.DFC_MisfDetVWhlReLeStuck_C DFES_DTCO.DFC_MisfDetVWhlReRiOORHi_C DFES_DTCO.DFC_MisfDetVWhlReRiRatyHi_C DFES_DTCO.DFC_MisfDetVWhlReRiRatyLo_C DFES_DTCO.DFC_MisfDetVWhlReRiStuck_C DFES_DTCO.DFC_MisfDetdVWhlFrntLePlaus_C DFES_DTCO.DFC_MisfDetdVWhlFrntRiPlaus_C DFES_DTCO.DFC_MisfDetdVWhlReLePlaus_C DFES_DTCO.DFC_MisfDetdVWhlReRiPlaus_C DFES_DTCO.DFC_PEnvSigRngMax_C DFES_DTCO.DFC_PEnvSigRngMin_C DFES_DTCO.DFC_StmFault_C DFES_DTCO.DFC_StrtCtOffPth_C DFES_DTCO.DFC_StrtCtlErr_C DFES_DTCO.DFC_StrtFault_C DFES_DTCO.DFC_StrtLckJudg1_C DFES_DTCO.DFC_StrtLckJudg2_C DFES_DTCO.DFC_StrtOL_C DFES_DTCO.DFC_StrtOL2_C DFES_DTCO.DFC_StrtSCB_C DFES_DTCO.DFC_StrtSCB2_C DFES_DTCO.DFC_StrtSCG_C DFES_DTCO.DFC_StrtSCG2_C DFES_DTCO.DFC_StrtStkRly1_C DFES_DTCO.DFC_StrtStkRly2_C DFES_DTCO.DFC_TEVEmax_C DFES_DTCO.DFC_TEVEmin_C DFES_DTCO.DFC_TEVEsig_C DFES_DTCO.DFC_UegoHeatrPrfmncLoS1B1_C DFES_DTCO.DFC_VehVAllPlaus_C DFES_DTCO.DFC_VehVNCSnsrElecFailr_C DFES_DTCO.DFC_VehVPlausCan_C DFES_DTCO.DFC_VehVPlausFco_C DFES_DTCO.DFC_VehVPlausPwr_C DFES_DTCO.DFC_VehVPlausV2N_C DFES_DTCO.DFC_VehVSpdSnsrAElecFailr_C DFES_DTCO.DFC_VehVSpdSnsrBElecFailr_C DFES_DTCO.DFC_ClthMax_C DFES_DTCO.DFC_IgnClPs_DevComErr_C DFES_DTCO.DFC_IgnClPs_LineOl_0_C DFES_DTCO.DFC_IgnClPs_LineOl_1_C DFES_DTCO.DFC_IgnClPs_LineOl_2_C DFES_DTCO.DFC_IgnClPs_LineOl_3_C DFES_DTCO.DFC_IgnClPs_LineScb_0_C DFES_DTCO.DFC_IgnClPs_LineScb_1_C DFES_DTCO.DFC_IgnClPs_LineScb_2_C DFES_DTCO.DFC_IgnClPs_LineScb_3_C DFES_DTCO.DFC_IgnClPs_LineScg_0_C DFES_DTCO.DFC_IgnClPs_LineScg_1_C DFES_DTCO.DFC_IgnClPs_LineScg_2_C DFES_DTCO.DFC_IgnClPs_LineScg_3_C DFES_DTCO.DFC_KRVEKOEVAB_C DFES_DTCO.DFC_KRVEKOEVAB0_C DFES_DTCO.DFC_KRVEKOEVAB1_C DFES_DTCO.DFC_KRVEKOEVAB2_C DFES_DTCO.DFC_KRVEKOEVAB3_C DFES_DTCO.DFC_UegoSigEcuAsicS1B1_C DFES_DTCO.DFC_UegoSigEcuComS1B1_C DFES_DTCO.DFC_UegoSigSnsrS1B1_C DFES_DTCO.DFC_UegoSigWireOlApesS1B1_C DFES_DTCO.DFC_UegoSigWireOlIpeS1B1_C DFES_DTCO.DFC_UegoSigWireOlReS1B1_C DFES_DTCO.DFC_UegoSigWireRCmpS1B1_C DFES_DTCO.DFC_UegoSigWireScbS1B1_C DFES_DTCO.DFC_UegoSigWireScgS1B1_C DFES_DTCO.DFC_AfsPhyRngHiB1_C DFES_DTCO.DFC_AfsPhyRngLoB1_C DFES_DTCO.DFC_AirCCmprOL_C DFES_DTCO.DFC_AirCCmprOvrTemp_C DFES_DTCO.DFC_AirCCmprSCB_C DFES_DTCO.DFC_AirCCmprSCG_C DFES_DTCO.DFC_AltErr_C DFES_DTCO.DFC_BattUSRCMax_C DFES_DTCO.DFC_BattUSRCMin_C DFES_DTCO.DFC_ComChksTCU1_C DFES_DTCO.DFC_ComChksTCU11_C DFES_DTCO.DFC_ComChksTCU12_C DFES_DTCO.DFC_ComChksTCU13_C DFES_DTCO.DFC_ComChksTCU2_C DFES_DTCO.DFC_ComChksTCU3_C DFES_DTCO.DFC_ComChksTCU4_C DFES_DTCO.DFC_ComCntTCU1_C DFES_DTCO.DFC_ComCntTCU11_C DFES_DTCO.DFC_ComCntTCU12_C DFES_DTCO.DFC_ComCntTCU13_C DFES_DTCO.DFC_ComCntTCU2_C DFES_DTCO.DFC_ComCntTCU3_C DFES_DTCO.DFC_ComCntTCU4_C DFES_DTCO.DFC_ComTOutTCU01_C DFES_DTCO.DFC_ComTOutTCU02_C DFES_DTCO.DFC_ComTOutTCU1_C DFES_DTCO.DFC_ComTOutTCU11_C DFES_DTCO.DFC_ComTOutTCU12_C DFES_DTCO.DFC_ComTOutTCU13_C DFES_DTCO.DFC_ComTOutTCU14_C DFES_DTCO.DFC_ComTOutTCU2_C DFES_DTCO.DFC_ComTOutTCU3_C DFES_DTCO.DFC_ComTOutTCU4_C DFES_DTCO.DFC_DevLibBattUHi_C DFES_DTCO.DFC_DevLibBattULo_C DFES_DTCO.DFC_EGRVlvFailSafeActv_C DFES_DTCO.DFC_EGRVlvGovDvtCld_C DFES_DTCO.DFC_EGRVlvPhysSRCMax_C DFES_DTCO.DFC_EGRVlvPhysSRCMin_C DFES_DTCO.DFC_FanDIOOL_0_C DFES_DTCO.DFC_FanDIOOL_1_C DFES_DTCO.DFC_FanDIOOvrTemp_0_C DFES_DTCO.DFC_FanDIOOvrTemp_1_C DFES_DTCO.DFC_FanDIOSCB_0_C DFES_DTCO.DFC_FanDIOSCB_1_C DFES_DTCO.DFC_FanDIOSCG_0_C DFES_DTCO.DFC_FanDIOSCG_1_C DFES_DTCO.DFC_MRlyDcOL_C DFES_DTCO.DFC_MRlyDcSCB_C DFES_DTCO.DFC_MRlyDcSCG_C DFES_DTCO.DFC_PSPOL_C DFES_DTCO.DFC_PSPOvrTemp_C DFES_DTCO.DFC_PSPSCB_C DFES_DTCO.DFC_PSPSCG_C DFES_DTCO.DFC_T50Err_C DFES_DTCO.DFC_ThrVlvLoBattB1_C DFES_DTCO.DFC_UegoSigOperPlausS1B1_C DFES_DTCO.DFC_VehVPhysRngHi_C DFES_DTCO.DFC_VehVSclOutOL_C DFES_DTCO.DFC_VehVSclOutOT_C DFES_DTCO.DFC_VehVSclOutSCB_C DFES_DTCO.DFC_VehVSclOutSCG_C DFES_DTCO.DFC_VehVSigFL_C DFES_DTCO.DFC_VehVSigFR_C DFES_DTCO.DFC_VehVSigRL_C DFES_DTCO.DFC_VehVSigRR_C DFES_DTCO.DFC_VehVSnsrARngHi_C DFES_DTCO.DFC_VehVSnsrBRngHi_C DFES_DTCO.DFC_VehVSpdRtyDiag_C DFES_DTCO.DFC_DHFHD_C DFES_DTCO.DFC_InjVlv_DI_DcDc_C DFES_DTCO.DFC_InjVlv_DI_NoLd_0_C DFES_DTCO.DFC_InjVlv_DI_NoLd_1_C DFES_DTCO.DFC_InjVlv_DI_NoLd_2_C DFES_DTCO.DFC_InjVlv_DI_NoLd_3_C DFES_DTCO.DFC_InjVlv_DI_ScBnk_0_C DFES_DTCO.DFC_InjVlv_DI_ScBnk_1_C DFES_DTCO.DFC_InjVlv_DI_ScBnk_2_C DFES_DTCO.DFC_InjVlv_DI_ScBnk_3_C DFES_DTCO.DFC_InjVlv_DI_ScCyl_0_C DFES_DTCO.DFC_InjVlv_DI_ScCyl_1_C DFES_DTCO.DFC_InjVlv_DI_ScCyl_2_C DFES_DTCO.DFC_InjVlv_DI_ScCyl_3_C DFES_DTCO.DFC_InjVlv_DI_ScHsLs_0_C DFES_DTCO.DFC_InjVlv_DI_ScHsLs_1_C DFES_DTCO.DFC_InjVlv_DI_ScHsLs_2_C DFES_DTCO.DFC_InjVlv_DI_ScHsLs_3_C DFES_DTCO.DFC_MfPsDiaOpenLoad1_C DFES_DTCO.DFC_MfPsDiaScHiS1_C DFES_DTCO.DFC_MfPsDiaScHiSLowS1_C DFES_DTCO.DFC_MfPsDiaScLowS1_C DFES_DTCO.DFC_ACEvpTPhysRngHi_C DFES_DTCO.DFC_ACEvpTPhysRngLo_C DFES_DTCO.DFC_ACEvpTSRCMax_C DFES_DTCO.DFC_ACEvpTSRCMin_C DFES_DTCO.DFC_AfsRawSigRngHiB1_C DFES_DTCO.DFC_AfsRawSigRngLoB1_C DFES_DTCO.DFC_AfsSnsrErrB1_C DFES_DTCO.DFC_AirCClntPAnaSRCMax_C DFES_DTCO.DFC_AirCClntPAnaSRCMin_C DFES_DTCO.DFC_AirCSwtNpl_C DFES_DTCO.DFC_AirCSwtSig_C DFES_DTCO.DFC_Brk_C DFES_DTCO.DFC_BrkBstSensSCB_C DFES_DTCO.DFC_BrkBstSensSCG_C DFES_DTCO.DFC_BrkSig_C DFES_DTCO.DFC_ClthSig_C DFES_DTCO.DFC_EGRVlvCurrLim_C DFES_DTCO.DFC_EGRVlvOL_C DFES_DTCO.DFC_EGRVlvOvrTemp_C DFES_DTCO.DFC_EGRVlvSCB_C DFES_DTCO.DFC_EGRVlvSCG_C DFES_DTCO.DFC_EGRVlvSRCMax_C DFES_DTCO.DFC_EGRVlvSRCMin_C DFES_DTCO.DFC_HLSDemOvhtEngLim_C DFES_DTCO.DFC_OilPSwmpSRCMax_C DFES_DTCO.DFC_OilPSwmpSRCMin_C DFES_DTCO.DFC_PIntkVUsLineHiB1_C DFES_DTCO.DFC_PIntkVUsLineLoB1_C DFES_DTCO.DFC_VehVPhysRngLo_C DFES_DTCO.DFC_VehVSigCan_C DFES_DTCO.DFC_VehVSigCanSafe_C DFES_DTCO.DFC_VlvLftFbOilPSnsrIntk11SRCMax_C DFES_DTCO.DFC_VlvLftFbOilPSnsrIntk11SRCMin_C DFES_DTCO.DFC_ClthNpl_C DFES_DTCO.DFC_GbxPNPosnDrvCdn_C DFES_DTCO.DFC_GbxPNPosnPlausy_C DFES_DTCO.DFC_AfsSigErrLineHiB1_C DFES_DTCO.DFC_AfsSigErrLineLoB1_C DFES_DTCO.DFC_PEnvCcMax_C DFES_DTCO.DFC_PEnvCcMin_C DFES_DTCO.DFC_PEnvRngChkMax_C DFES_DTCO.DFC_PEnvRngChkMin_C DFES_DTCO.DFC_PEnvSnsrPlaus_C DFES_DTCO.DFC_UEGOHeatrRlyPsOLS1B1_C DFES_DTCO.DFC_UEGOHeatrRlyPsSCBS1B1_C DFES_DTCO.DFC_UEGOHeatrRlyPsSCGS1B1_C DFES_DTCO.DFC_UegoHeatrWireOlS1B1_C DFES_DTCO.DFC_UegoHeatrWireScbS1B1_C DFES_DTCO.DFC_UegoHeatrWireScgS1B1_C DFES_DTCO.DFC_KnDetSens1PortAMax_C DFES_DTCO.DFC_KnDetSens1PortAMin_C DFES_DTCO.DFC_KnDetSens1PortBMax_C DFES_DTCO.DFC_KnDetSens1PortBMin_C DFES_DTCO.DFC_Clth2ONStuck_C DFES_DTCO.DFC_Clth2ONStuckLdc_C DFES_DTCO.DFC_Clth3ONStuckLdc_C DFES_DTCO.DFC_Clth3ONStuckPostDrv_C DFES_DTCO.DFC_Clth4ONStuck_C DFES_DTCO.DFC_Clth4ONStuckLdc_C DFES_DTCO.DFC_ComBCMUnit_C DFES_DTCO.DFC_ComDLCTCU01_C DFES_DTCO.DFC_ComDLCTCU02_C DFES_DTCO.DFC_ComDLCTCU1_C DFES_DTCO.DFC_ComDLCTCU11_C DFES_DTCO.DFC_ComDLCTCU12_C DFES_DTCO.DFC_ComDLCTCU13_C DFES_DTCO.DFC_ComDLCTCU14_C DFES_DTCO.DFC_ComDLCTCU2_C DFES_DTCO.DFC_ComDLCTCU3_C DFES_DTCO.DFC_ComDLCTCU4_C DFES_DTCO.DFC_ComEPSUnit_C DFES_DTCO.DFC_ComIDASBUnit_C DFES_DTCO.DFC_ComIMGUnit_C DFES_DTCO.DFC_ComMETUnit_C DFES_DTCO.DFC_ComSRSUnit_C DFES_DTCO.DFC_ComVSAUnit_C DFES_DTCO.DFC_EbsSocFlt_C DFES_DTCO.DFC_I14229VINErr_C DFES_DTCO.DFC_InjCatHeatgErr_C DFES_DTCO.DFC_InjSysMulInjDiagErr_C DFES_DTCO.DFC_LLRHmax_C DFES_DTCO.DFC_LLRHmin_C DFES_DTCO.DFC_LLRHnpl_C DFES_DTCO.DFC_LLRKHmax_C DFES_DTCO.DFC_LLRKHmin_C DFES_DTCO.DFC_LLRKHnpl_C DFES_DTCO.DFC_LinACGUnit_C DFES_DTCO.DFC_LinAEVUnit_C DFES_DTCO.DFC_LinEBSUnit_C DFES_DTCO.DFC_RoughRoad_C DFES_DTCO.DFC_SiaEEPRdErr_C DFES_DTCO.DFC_SiaEEPWrngCod_C DFES_DTCO.DFC_UegoHeatrStrtS1B1_C DFES_DTCO.DFC_BusDiagCANAPPLBusOff_C DFES_DTCO.DFC_BusDiagCANCANCBusOff_C DFES_DTCO.DFC_BusDiagCANVEHICLEBusOff_C DFES_DTCO.DFC_RBA_IODIAGPWR_rba_IoExtCy329_SignalVltSply_0_C DFES_DTCO.DFC_RBA_IODIAGPWR_rba_IoExtCy329_SignalVltSply_0OT_C DFES_DTCO.DFC_RBA_IODIAGPWR_rba_IoExtCy329_SignalVltSply_0OV_C DFES_DTCO.DFC_RBA_IODIAGPWR_rba_IoExtCy329_SignalVltSply_0SCG_C DFES_DTCO.DFC_RBA_IODIAGPWR_rba_IoExtCy329_SignalVltSply_0UV_C DFES_DTCO.DFC_RBA_IODIAGPWR_rba_IoExtCy329_SignalVltSply_1_C DFES_DTCO.DFC_RBA_IODIAGPWR_rba_IoExtCy329_SignalVltSply_1OT_C DFES_DTCO.DFC_RBA_IODIAGPWR_rba_IoExtCy329_SignalVltSply_1OV_C DFES_DTCO.DFC_RBA_IODIAGPWR_rba_IoExtCy329_SignalVltSply_1SCG_C DFES_DTCO.DFC_RBA_IODIAGPWR_rba_IoExtCy329_SignalVltSply_1UV_C DFES_DTCO.DFC_RBA_IODIAGPWR_rba_IoExtCy329_SignalVltSply_2_C DFES_DTCO.DFC_RBA_IODIAGPWR_rba_IoExtCy329_SignalVltSply_2OT_C DFES_DTCO.DFC_RBA_IODIAGPWR_rba_IoExtCy329_SignalVltSply_2OV_C DFES_DTCO.DFC_RBA_IODIAGPWR_rba_IoExtCy329_SignalVltSply_2SCG_C DFES_DTCO.DFC_RBA_IODIAGPWR_rba_IoExtCy329_SignalVltSply_2UV_C DFES_DTCO.DFC_CAN_E_TIMEOUT_C DFES_DTCO.DFC_LIN_E_TIMEOUT_C DFES_DTCO.DFC_MRlyOL_C DFES_DTCO.DFC_MRlySCB_C DFES_DTCO.DFC_MRlySCG_C DFES_DTCO.DFC_rba_MultiStackTrace_Threshold_C DFES_DTCO.DFC_BSWM_E_ACTION_FAILED_C DFES_DTCO.DFC_BSWM_E_INTRPTQUEUE_FULL_C DFES_DTCO.DFC_RBA_IOEXTLIB_KEEPALIVE_DRV_C DFES_DTCO.DFC_RBA_IOEXTLIB_KEEPALIVE_INI_C DFES_DTCO.DFC_rba_IoSigRtc_StopCounter_C DFES_DTCO.DFC_rba_MRly_Diag_Stk_Event_C DFES_DTCO.DFC_rba_MemDiag_MemReadErr_C DFES_DTCO.DFC_rba_MemDiag_MemWrErr_C DFES_DTCO.DFC_rba_SyC_IrrSwOffTrigEngRun_Event_C DFES_DTCO.DFC_rba_T15_Diag_ComInVld_Event_C DFES_DTCO.DFC_rba_T15_Diag_ComOff_HwOn_Event_C DFES_DTCO.DFC_rba_T15_Diag_ComOn_HwOff_Event_C DFES_DTCO.DFC_AAVmin_C DFES_DTCO.DFC_AGRSUS_C DFES_DTCO.DFC_AfsPlausDiagHi_C DFES_DTCO.DFC_AfsPlausDiagLo_C DFES_DTCO.DFC_AfsVrntDiagErrB1_C DFES_DTCO.DFC_AppAllSnsrDfct_C DFES_DTCO.DFC_BBKRnldg_C DFES_DTCO.DFC_BBKRsyne_C DFES_DTCO.DFC_BattUStdbyDiaOL_C DFES_DTCO.DFC_BigLeakIntkMnfldEmiInfl_C DFES_DTCO.DFC_BlkdLineTank_C DFES_DTCO.DFC_BrkMnSwtContOnWarnLmp_C DFES_DTCO.DFC_BrkMnSwtNotStpWarnLmp_C DFES_DTCO.DFC_BrkRdntSwtContOnWarnLmp_C DFES_DTCO.DFC_BrkRdntSwtNotStpWarnLmp_C DFES_DTCO.DFC_CEngDsTColdStrtMax_C DFES_DTCO.DFC_CEngDsTColdStrtMin_C DFES_DTCO.DFC_CEngDsTImps_C DFES_DTCO.DFC_CEngDsTPlausHSC_C DFES_DTCO.DFC_CEngDsTPlausLSC_C DFES_DTCO.DFC_CEngDsTPlausSTC_C DFES_DTCO.DFC_CEngDsTSRCMax_C DFES_DTCO.DFC_CEngDsTSRCMin_C DFES_DTCO.DFC_CEngDsTSig_C DFES_DTCO.DFC_CEngUsTColdStrtMax_C DFES_DTCO.DFC_CEngUsTColdStrtMin_C DFES_DTCO.DFC_CEngUsTLooseCnctn_C DFES_DTCO.DFC_CEngUsTSRCMax_C DFES_DTCO.DFC_CEngUsTSRCMin_C DFES_DTCO.DFC_ComDCDCACCFailr_C DFES_DTCO.DFC_DCDCFltDet_C DFES_DTCO.DFC_DKRSA_C DFES_DTCO.DFC_DKVSmax_C DFES_DTCO.DFC_DKnpl_C DFES_DTCO.DFC_DSKVRmax_C DFES_DTCO.DFC_DSKVRmin_C DFES_DTCO.DFC_DSKVRnpl_C DFES_DTCO.DFC_DSKVRsig_C DFES_DTCO.DFC_DSKVSsig_C DFES_DTCO.DFC_DSSmax_C DFES_DTCO.DFC_DSTDmax_C DFES_DTCO.DFC_DSTEmax_C DFES_DTCO.DFC_DSTEmin_C DFES_DTCO.DFC_DSTOFmax_C DFES_DTCO.DFC_DSTRmax_C DFES_DTCO.DFC_DSTRmin_C DFES_DTCO.DFC_DSTRnpl_C DFES_DTCO.DFC_DSTRsig_C DFES_DTCO.DFC_DSTTI_C DFES_DTCO.DFC_DSUmax_C DFES_DTCO.DFC_DiagCpv1DteskLoLoadStuckClsd_C DFES_DTCO.DFC_DiagCpv1DteskLoLoadStuckOpen_C DFES_DTCO.DFC_EGRVlvDrftClsd_C DFES_DTCO.DFC_EGRVlvDrftOpn_C DFES_DTCO.DFC_EGRVlvJamVlvClsd_C DFES_DTCO.DFC_EGRVlvJamVlvOpn_C DFES_DTCO.DFC_EGRVlvSprgBrk_C DFES_DTCO.DFC_EGRVlvTempMdlEEPErr_C DFES_DTCO.DFC_EGRVlvTmpErr_C DFES_DTCO.DFC_EGSDUS2B1LtrDly_C DFES_DTCO.DFC_EGSDUS2B1LtrPT1_C DFES_DTCO.DFC_EGSDUS2B1RtlDly_C DFES_DTCO.DFC_EGSDUS2B1RtlPT1_C DFES_DTCO.DFC_EGSDUS2B1TarLean_C DFES_DTCO.DFC_EGSDUS2B1TarRich_C DFES_DTCO.DFC_EONVmax_C DFES_DTCO.DFC_ETAKHLmax_C DFES_DTCO.DFC_ETAKHTmax_C DFES_DTCO.DFC_ETHSEmax_C DFES_DTCO.DFC_ETHSEmin_C DFES_DTCO.DFC_ETHSFmax_C DFES_DTCO.DFC_ETHSFmin_C /end DEF_CHARACTERISTIC
 FUNCTION_VERSION "30000.73.0_2.0.0" /end FUNCTION
/begin COMPU_METHOD DFES_OneToOne "" RAT_FUNC "%6.2" "-" COEFFS 0 1 0 0 0 1 /end COMPU_METHOD
/begin RECORD_LAYOUT Val_Wu16 FNC_VALUES 1 UWORD COLUMN_DIR DIRECT /end RECORD_LAYOUT
/begin RECORD_LAYOUT Val_Wu8 FNC_VALUES 1 UBYTE COLUMN_DIR DIRECT /end RECORD_LAYOUT
/end MODULE
/end PROJECT
