ASAP2_VERSION 1 60
/begin PROJECT MG1CS022 "MG1CS022"
/begin HEADER "" VERSION "MG1CS022_62XSC_V037_TPROT" PROJECT_NO MG1CS022 /end HEADER
/begin MODULE DIM ""
/begin MOD_COMMON "" BYTE_ORDER MSB_LAST ALIGNMENT_BYTE 1 ALIGNMENT_WORD 2 ALIGNMENT_LONG 4 ALIGNMENT_INT64 4 ALIGNMENT_FLOAT32_IEEE 4 ALIGNMENT_FLOAT64_IEEE 4 DATA_SIZE 32 /end MOD_COMMON
/begin CHARACTERISTIC DFES_Cls.DFC_ClthONStuck_C "fault class per DFC / Fault class for check DFC_ClthONStuck" VALUE 0x804D93F1 Val_Wu8 30.00 DFES_OneToOne 0.00 30.00 FORMAT "%5.2" EXTENDED_LIMITS 0.00 255.0 /end CHARACTERISTIC
/begin CHARACTERISTIC DFES_Cls.DFC_ClthStkFailInfo_C "fault class per DFC / Fault class for check DFC_ClthStkFailInfo" VALUE 0x804D93F2 Val_Wu8 30.00 DFES_OneToOne 0.00 30.00 FORMAT "%5.2" EXTENDED_LIMITS 0.00 255.0 /end CHARACTERISTIC
/begin CHARACTERISTIC DFES_Cls.DFC_ComACFailInfo_C "fault class per DFC / Fault class for check DFC_ComACFailInfo" VALUE 0x804D93F3 Val_Wu8 30.00 DFES_OneToOne 0.00 30.00 FORMAT "%5.2" EXTENDED_LIMITS 0.00 255.0 /end CHARACTERISTIC
/begin CHARACTERISTIC DFES_Cls.DFC_ComATFTValErr_C "fault class per DFC / Fault class for check DFC_ComATFTValErr" VALUE 0x804D93F4 Val_Wu8 30.00 DFES_OneToOne 0.00 30.00 FORMAT "%5.2" EXTENDED_LIMITS 0.00 255.0 /end CHARACTERISTIC
/begin CHARACTERISTIC DFES_Cls.DFC_ComATMILReq_C "fault class per DFC / Fault class for check DFC_ComATMILReq" VALUE 0x804D93F5 Val_Wu8 30.00 DFES_OneToOne 0.00 30.00 FORMAT "%5.2" EXTENDED_LIMITS 0.00 255.0 /end CHARACTERISTIC
/begin CHARACTERISTIC DFES_Cls.DFC_ComAYCAChksum_C "fault class per DFC / Fault class for check DFC_ComAYCAChksum" VALUE 0x804D93F6 Val_Wu8 30.00 DFES_OneToOne 0.00 30.00 FORMAT "%5.2" EXTENDED_LIMITS 0.00 255.0 /end CHARACTERISTIC
/begin CHARACTERISTIC DFES_Cls.DFC_ComAYCARingCnt_C "fault class per DFC / Fault class for check DFC_ComAYCARingCnt" VALUE 0x804D93F7 Val_Wu8 30.00 DFES_OneToOne 0.00 30.00 FORMAT "%5.2" EXTENDED_LIMITS 0.00 255.0 /end CHARACTERISTIC
/begin CHARACTERISTIC DFES_Cls.DFC_ComAYCATOut_C "fault class per DFC / Fault class for check DFC_ComAYCATOut" VALUE 0x804D93F8 Val_Wu8 30.00 DFES_OneToOne 0.00 30.00 FORMAT "%5.2" EXTENDED_LIMITS 0.00 255.0 /end CHARACTERISTIC
/begin CHARACTERISTIC DFES_Cls.DFC_ComAYCDChkSum_C "fault class per DFC / Fault class for check DFC_ComAYCDChkSum" VALUE 0x804D93F9 Val_Wu8 30.00 DFES_OneToOne 0.00 30.00 FORMAT "%5.2" EXTENDED_LIMITS 0.00 255.0 /end CHARACTERISTIC
/begin CHARACTERISTIC DFES_Cls.DFC_ComAYCDTOut_C "fault class per DFC / Fault class for check DFC_ComAYCDTOut" VALUE 0x804D93FA Val_Wu8 30.00 DFES_OneToOne 0.00 30.00 FORMAT "%5.2" EXTENDED_LIMITS 0.00 255.0 /end CHARACTERISTIC
/begin CHARACTERISTIC DFES_Cls.DFC_ComAYCFChksum_C "fault class per DFC / Fault class for check DFC_ComAYCFChksum" VALUE 0x804D93FB Val_Wu8 30.00 DFES_OneToOne 0.00 30.00 FORMAT "%5.2" EXTENDED_LIMITS 0.00 255.0 /end CHARACTERISTIC
/begin CHARACTERISTIC DFES_Cls.DFC_ComAYCFRingCnt_C "fault class per DFC / Fault class for check DFC_ComAYCFRingCnt" VALUE 0x804D93FC Val_Wu8 30.00 DFES_OneToOne 0.00 30.00 FORMAT "%5.2" EXTENDED_LIMITS 0.00 255.0 /end CHARACTERISTIC
/begin CHARACTERISTIC DFES_Cls.DFC_ComAYCFTOut_C "fault class per DFC / Fault class for check DFC_ComAYCFTOut" VALUE 0x804D93FD Val_Wu8 30.00 DFES_OneToOne 0.00 30.00 FORMAT "%5.2" EXTENDED_LIMITS 0.00 255.0 /end CHARACTERISTIC
/begin CHARACTERISTIC DFES_Cls.DFC_ComAYCGChksum_C "fault class per DFC / Fault class for check DFC_ComAYCGChksum" VALUE 0x804D93FE Val_Wu8 30.00 DFES_OneToOne 0.00 30.00 FORMAT "%5.2" EXTENDED_LIMITS 0.00 255.0 /end CHARACTERISTIC
/begin CHARACTERISTIC DFES_Cls.DFC_ComAYCGRingCnt_C "fault class per DFC / Fault class for check DFC_ComAYCGRingCnt" VALUE 0x804D93FF Val_Wu8 30.00 DFES_OneToOne 0.00 30.00 FORMAT "%5.2" EXTENDED_LIMITS 0.00 255.0 /end CHARACTERISTIC
/begin CHARACTERISTIC DFES_Cls.DFC_ComAYCGTOut_C "fault class per DFC / Fault class for check DFC_ComAYCGTOut" VALUE 0x804D9400 Val_Wu8 30.00 DFES_OneToOne 0.00 30.00 FORMAT "%5.2" EXTENDED_LIMITS 0.00 255.0 /end CHARACTERISTIC
/begin CHARACTERISTIC DFES_Cls.DFC_ComAYCIChkSum_C "fault class per DFC / Fault class for check DFC_ComAYCIChkSum" VALUE 0x804D9401 Val_Wu8 30.00 DFES_OneToOne 0.00 30.00 FORMAT "%5.2" EXTENDED_LIMITS 0.00 255.0 /end CHARACTERISTIC
/begin CHARACTERISTIC DFES_Cls.DFC_ComAYCIRingCnt_C "fault class per DFC / Fault class for check DFC_ComAYCIRingCnt" VALUE 0x804D9402 Val_Wu8 30.00 DFES_OneToOne 0.00 30.00 FORMAT "%5.2" EXTENDED_LIMITS 0.00 255.0 /end CHARACTERISTIC
/begin CHARACTERISTIC DFES_Cls.DFC_ComAYCITOut_C "fault class per DFC / Fault class for check DFC_ComAYCITOut" VALUE 0x804D9403 Val_Wu8 30.00 DFES_OneToOne 0.00 30.00 FORMAT "%5.2" EXTENDED_LIMITS 0.00 255.0 /end CHARACTERISTIC
/begin CHARACTERISTIC DFES_Cls.DFC_ComBCM1ChkSum_C "fault class per DFC / Fault class for check DFC_ComBCM1ChkSum" VALUE 0x804D9404 Val_Wu8 30.00 DFES_OneToOne 0.00 30.00 FORMAT "%5.2" EXTENDED_LIMITS 0.00 255.0 /end CHARACTERISTIC
/begin CHARACTERISTIC DFES_Cls.DFC_ComBCM1RingCnt_C "fault class per DFC / Fault class for check DFC_ComBCM1RingCnt" VALUE 0x804D9405 Val_Wu8 30.00 DFES_OneToOne 0.00 30.00 FORMAT "%5.2" EXTENDED_LIMITS 0.00 255.0 /end CHARACTERISTIC
/begin CHARACTERISTIC DFES_Cls.DFC_ComBCM1TOut_C "fault class per DFC / Fault class for check DFC_ComBCM1TOut" VALUE 0x804D9406 Val_Wu8 30.00 DFES_OneToOne 0.00 30.00 FORMAT "%5.2" EXTENDED_LIMITS 0.00 255.0 /end CHARACTERISTIC
/begin CHARACTERISTIC DFES_Cls.DFC_ComCANABusOffErr_C "fault class per DFC / Fault class for check DFC_ComCANABusOffErr" VALUE 0x804D9407 Val_Wu8 30.00 DFES_OneToOne 0.00 30.00 FORMAT "%5.2" EXTENDED_LIMITS 0.00 255.0 /end CHARACTERISTIC
/begin CHARACTERISTIC DFES_Cls.DFC_ComCANBBusOffErr_C "fault class per DFC / Fault class for check DFC_ComCANBBusOffErr" VALUE 0x804D9408 Val_Wu8 30.00 DFES_OneToOne 0.00 30.00 FORMAT "%5.2" EXTENDED_LIMITS 0.00 255.0 /end CHARACTERISTIC
/begin CHARACTERISTIC DFES_Cls.DFC_ComCANCBusOffErr_C "fault class per DFC / Fault class for check DFC_ComCANCBusOffErr" VALUE 0x804D9409 Val_Wu8 30.00 DFES_OneToOne 0.00 30.00 FORMAT "%5.2" EXTENDED_LIMITS 0.00 255.0 /end CHARACTERISTIC
/begin CHARACTERISTIC DFES_Cls.DFC_ComCGW1ChkSum_C "fault class per DFC / Fault class for check DFC_ComCGW1ChkSum" VALUE 0x804D940A Val_Wu8 30.00 DFES_OneToOne 0.00 30.00 FORMAT "%5.2" EXTENDED_LIMITS 0.00 255.0 /end CHARACTERISTIC
/begin CHARACTERISTIC DFES_Cls.DFC_ComCGW1RingCnt_C "fault class per DFC / Fault class for check DFC_ComCGW1RingCnt" VALUE 0x804D940B Val_Wu8 30.00 DFES_OneToOne 0.00 30.00 FORMAT "%5.2" EXTENDED_LIMITS 0.00 255.0 /end CHARACTERISTIC
/begin CHARACTERISTIC DFES_Cls.DFC_ComCGW1TOut_C "fault class per DFC / Fault class for check DFC_ComCGW1TOut" VALUE 0x804D940C Val_Wu8 30.00 DFES_OneToOne 0.00 30.00 FORMAT "%5.2" EXTENDED_LIMITS 0.00 255.0 /end CHARACTERISTIC
/begin CHARACTERISTIC DFES_Cls.DFC_ComConvBoostErr_C "fault class per DFC / Fault class for check DFC_ComConvBoostErr" VALUE 0x804D940D Val_Wu8 30.00 DFES_OneToOne 0.00 30.00 FORMAT "%5.2" EXTENDED_LIMITS 0.00 255.0 /end CHARACTERISTIC
/begin CHARACTERISTIC DFES_Cls.DFC_ComConvSlipErr_C "fault class per DFC / Fault class for check DFC_ComConvSlipErr" VALUE 0x804D940E Val_Wu8 30.00 DFES_OneToOne 0.00 30.00 FORMAT "%5.2" EXTENDED_LIMITS 0.00 255.0 /end CHARACTERISTIC
/begin CHARACTERISTIC DFES_Cls.DFC_ComDCDCPrfmncErr_C "fault class per DFC / Fault class for check DFC_ComDCDCPrfmncErr" VALUE 0x804D940F Val_Wu8 30.00 DFES_OneToOne 0.00 30.00 FORMAT "%5.2" EXTENDED_LIMITS 0.00 255.0 /end CHARACTERISTIC
/begin CHARACTERISTIC DFES_Cls.DFC_ComDCDCTempWarn_C "fault class per DFC / Fault class for check DFC_ComDCDCTempWarn" VALUE 0x804D9410 Val_Wu8 30.00 DFES_OneToOne 0.00 30.00 FORMAT "%5.2" EXTENDED_LIMITS 0.00 255.0 /end CHARACTERISTIC
/begin CHARACTERISTIC DFES_Cls.DFC_ComEAT10Chksum_C "fault class per DFC / Fault class for check DFC_ComEAT10Chksum" VALUE 0x804D9411 Val_Wu8 30.00 DFES_OneToOne 0.00 30.00 FORMAT "%5.2" EXTENDED_LIMITS 0.00 255.0 /end CHARACTERISTIC
/begin CHARACTERISTIC DFES_Cls.DFC_ComEAT10RingCnt_C "fault class per DFC / Fault class for check DFC_ComEAT10RingCnt" VALUE 0x804D9412 Val_Wu8 30.00 DFES_OneToOne 0.00 30.00 FORMAT "%5.2" EXTENDED_LIMITS 0.00 255.0 /end CHARACTERISTIC
/begin CHARACTERISTIC DFES_Cls.DFC_ComEAT10TOut_C "fault class per DFC / Fault class for check DFC_ComEAT10TOut" VALUE 0x804D9413 Val_Wu8 30.00 DFES_OneToOne 0.00 30.00 FORMAT "%5.2" EXTENDED_LIMITS 0.00 255.0 /end CHARACTERISTIC
/begin CHARACTERISTIC DFES_Cls.DFC_ComEAT11ChkSum_C "fault class per DFC / Fault class for check DFC_ComEAT11ChkSum" VALUE 0x804D9414 Val_Wu8 30.00 DFES_OneToOne 0.00 30.00 FORMAT "%5.2" EXTENDED_LIMITS 0.00 255.0 /end CHARACTERISTIC
/begin CHARACTERISTIC DFES_Cls.DFC_ComEAT11RingCnt_C "fault class per DFC / Fault class for check DFC_ComEAT11RingCnt" VALUE 0x804D9415 Val_Wu8 30.00 DFES_OneToOne 0.00 30.00 FORMAT "%5.2" EXTENDED_LIMITS 0.00 255.0 /end CHARACTERISTIC
/begin CHARACTERISTIC DFES_Cls.DFC_ComEAT11TOut_C "fault class per DFC / Fault class for check DFC_ComEAT11TOut" VALUE 0x804D9416 Val_Wu8 30.00 DFES_OneToOne 0.00 30.00 FORMAT "%5.2" EXTENDED_LIMITS 0.00 255.0 /end CHARACTERISTIC
/begin CHARACTERISTIC DFES_Cls.DFC_ComEAT12ChkSum_C "fault class per DFC / Fault class for check DFC_ComEAT12ChkSum" VALUE 0x804D9417 Val_Wu8 30.00 DFES_OneToOne 0.00 30.00 FORMAT "%5.2" EXTENDED_LIMITS 0.00 255.0 /end CHARACTERISTIC
/begin CHARACTERISTIC DFES_Cls.DFC_ComEAT12RingCnt_C "fault class per DFC / Fault class for check DFC_ComEAT12RingCnt" VALUE 0x804D9418 Val_Wu8 30.00 DFES_OneToOne 0.00 30.00 FORMAT "%5.2" EXTENDED_LIMITS 0.00 255.0 /end CHARACTERISTIC
/begin CHARACTERISTIC DFES_Cls.DFC_ComEAT12TOut_C "fault class per DFC / Fault class for check DFC_ComEAT12TOut" VALUE 0x804D9419 Val_Wu8 30.00 DFES_OneToOne 0.00 30.00 FORMAT "%5.2" EXTENDED_LIMITS 0.00 255.0 /end CHARACTERISTIC
/begin CHARACTERISTIC DFES_Cls.DFC_ComEAT13ChkSum_C "fault class per DFC / Fault class for check DFC_ComEAT13ChkSum" VALUE 0x804D941A Val_Wu8 30.00 DFES_OneToOne 0.00 30.00 FORMAT "%5.2" EXTENDED_LIMITS 0.00 255.0 /end CHARACTERISTIC
/begin CHARACTERISTIC DFES_Cls.DFC_ComEAT13RingCnt_C "fault class per DFC / Fault class for check DFC_ComEAT13RingCnt" VALUE 0x804D941B Val_Wu8 30.00 DFES_OneToOne 0.00 30.00 FORMAT "%5.2" EXTENDED_LIMITS 0.00 255.0 /end CHARACTERISTIC
/begin CHARACTERISTIC DFES_Cls.DFC_ComEAT13TOut_C "fault class per DFC / Fault class for check DFC_ComEAT13TOut" VALUE 0x804D941C Val_Wu8 30.00 DFES_OneToOne 0.00 30.00 FORMAT "%5.2" EXTENDED_LIMITS 0.00 255.0 /end CHARACTERISTIC
/begin CHARACTERISTIC DFES_Cls.DFC_ComEAT1Chksum_C "fault class per DFC / Fault class for check DFC_ComEAT1Chksum" VALUE 0x804D941D Val_Wu8 30.00 DFES_OneToOne 0.00 30.00 FORMAT "%5.2" EXTENDED_LIMITS 0.00 255.0 /end CHARACTERISTIC
/begin CHARACTERISTIC DFES_Cls.DFC_ComEAT1RingCnt_C "fault class per DFC / Fault class for check DFC_ComEAT1RingCnt" VALUE 0x804D941E Val_Wu8 30.00 DFES_OneToOne 0.00 30.00 FORMAT "%5.2" EXTENDED_LIMITS 0.00 255.0 /end CHARACTERISTIC
/begin CHARACTERISTIC DFES_Cls.DFC_ComEAT1TOut_C "fault class per DFC / Fault class for check DFC_ComEAT1TOut" VALUE 0x804D941F Val_Wu8 30.00 DFES_OneToOne 0.00 30.00 FORMAT "%5.2" EXTENDED_LIMITS 0.00 255.0 /end CHARACTERISTIC
/begin CHARACTERISTIC DFES_Cls.DFC_ComEAT2ChkSum_C "fault class per DFC / Fault class for check DFC_ComEAT2ChkSum" VALUE 0x804D9420 Val_Wu8 30.00 DFES_OneToOne 0.00 30.00 FORMAT "%5.2" EXTENDED_LIMITS 0.00 255.0 /end CHARACTERISTIC
/begin CHARACTERISTIC DFES_Cls.DFC_ComEAT2RingCnt_C "fault class per DFC / Fault class for check DFC_ComEAT2RingCnt" VALUE 0x804D9421 Val_Wu8 30.00 DFES_OneToOne 0.00 30.00 FORMAT "%5.2" EXTENDED_LIMITS 0.00 255.0 /end CHARACTERISTIC
/begin CHARACTERISTIC DFES_Cls.DFC_ComEAT2TOut_C "fault class per DFC / Fault class for check DFC_ComEAT2TOut" VALUE 0x804D9422 Val_Wu8 30.00 DFES_OneToOne 0.00 30.00 FORMAT "%5.2" EXTENDED_LIMITS 0.00 255.0 /end CHARACTERISTIC
/begin CHARACTERISTIC DFES_Cls.DFC_ComEAT4ChkSum_C "fault class per DFC / Fault class for check DFC_ComEAT4ChkSum" VALUE 0x804D9423 Val_Wu8 30.00 DFES_OneToOne 0.00 30.00 FORMAT "%5.2" EXTENDED_LIMITS 0.00 255.0 /end CHARACTERISTIC
/begin CHARACTERISTIC DFES_Cls.DFC_ComEAT4RingCnt_C "fault class per DFC / Fault class for check DFC_ComEAT4RingCnt" VALUE 0x804D9424 Val_Wu8 30.00 DFES_OneToOne 0.00 30.00 FORMAT "%5.2" EXTENDED_LIMITS 0.00 255.0 /end CHARACTERISTIC
/begin CHARACTERISTIC DFES_Cls.DFC_ComEAT4TOut_C "fault class per DFC / Fault class for check DFC_ComEAT4TOut" VALUE 0x804D9425 Val_Wu8 30.00 DFES_OneToOne 0.00 30.00 FORMAT "%5.2" EXTENDED_LIMITS 0.00 255.0 /end CHARACTERISTIC
/begin CHARACTERISTIC DFES_Cls.DFC_ComEAT6Chksum_C "fault class per DFC / Fault class for check DFC_ComEAT6Chksum" VALUE 0x804D9426 Val_Wu8 30.00 DFES_OneToOne 0.00 30.00 FORMAT "%5.2" EXTENDED_LIMITS 0.00 255.0 /end CHARACTERISTIC
/begin CHARACTERISTIC DFES_Cls.DFC_ComEAT6RingCnt_C "fault class per DFC / Fault class for check DFC_ComEAT6RingCnt" VALUE 0x804D9427 Val_Wu8 30.00 DFES_OneToOne 0.00 30.00 FORMAT "%5.2" EXTENDED_LIMITS 0.00 255.0 /end CHARACTERISTIC
/begin CHARACTERISTIC DFES_Cls.DFC_ComEAT6TOut_C "fault class per DFC / Fault class for check DFC_ComEAT6TOut" VALUE 0x804D9428 Val_Wu8 30.00 DFES_OneToOne 0.00 30.00 FORMAT "%5.2" EXTENDED_LIMITS 0.00 255.0 /end CHARACTERISTIC
/begin CHARACTERISTIC DFES_Cls.DFC_ComEAT7Chksum_C "fault class per DFC / Fault class for check DFC_ComEAT7Chksum" VALUE 0x804D9429 Val_Wu8 30.00 DFES_OneToOne 0.00 30.00 FORMAT "%5.2" EXTENDED_LIMITS 0.00 255.0 /end CHARACTERISTIC
/begin CHARACTERISTIC DFES_Cls.DFC_ComEAT7RingCnt_C "fault class per DFC / Fault class for check DFC_ComEAT7RingCnt" VALUE 0x804D942A Val_Wu8 30.00 DFES_OneToOne 0.00 30.00 FORMAT "%5.2" EXTENDED_LIMITS 0.00 255.0 /end CHARACTERISTIC
/begin CHARACTERISTIC DFES_Cls.DFC_ComEAT7TOut_C "fault class per DFC / Fault class for check DFC_ComEAT7TOut" VALUE 0x804D942B Val_Wu8 30.00 DFES_OneToOne 0.00 30.00 FORMAT "%5.2" EXTENDED_LIMITS 0.00 255.0 /end CHARACTERISTIC
/begin CHARACTERISTIC DFES_Cls.DFC_ComEAT8Chksum_C "fault class per DFC / Fault class for check DFC_ComEAT8Chksum" VALUE 0x804D942C Val_Wu8 30.00 DFES_OneToOne 0.00 30.00 FORMAT "%5.2" EXTENDED_LIMITS 0.00 255.0 /end CHARACTERISTIC
/begin CHARACTERISTIC DFES_Cls.DFC_ComEAT8RingCnt_C "fault class per DFC / Fault class for check DFC_ComEAT8RingCnt" VALUE 0x804D942D Val_Wu8 30.00 DFES_OneToOne 0.00 30.00 FORMAT "%5.2" EXTENDED_LIMITS 0.00 255.0 /end CHARACTERISTIC
/begin CHARACTERISTIC DFES_Cls.DFC_ComEAT8TOut_C "fault class per DFC / Fault class for check DFC_ComEAT8TOut" VALUE 0x804D942E Val_Wu8 30.00 DFES_OneToOne 0.00 30.00 FORMAT "%5.2" EXTENDED_LIMITS 0.00 255.0 /end CHARACTERISTIC
/begin CHARACTERISTIC DFES_Cls.DFC_ComEATAChksum_C "fault class per DFC / Fault class for check DFC_ComEATAChksum" VALUE 0x804D942F Val_Wu8 30.00 DFES_OneToOne 0.00 30.00 FORMAT "%5.2" EXTENDED_LIMITS 0.00 255.0 /end CHARACTERISTIC
/begin CHARACTERISTIC DFES_Cls.DFC_ComEATARingCnt_C "fault class per DFC / Fault class for check DFC_ComEATARingCnt" VALUE 0x804D9430 Val_Wu8 30.00 DFES_OneToOne 0.00 30.00 FORMAT "%5.2" EXTENDED_LIMITS 0.00 255.0 /end CHARACTERISTIC
/begin CHARACTERISTIC DFES_Cls.DFC_ComEATATOut_C "fault class per DFC / Fault class for check DFC_ComEATATOut" VALUE 0x804D9431 Val_Wu8 30.00 DFES_OneToOne 0.00 30.00 FORMAT "%5.2" EXTENDED_LIMITS 0.00 255.0 /end CHARACTERISTIC
/begin CHARACTERISTIC DFES_Cls.DFC_ComEATBChkSum_C "fault class per DFC / Fault class for check DFC_ComEATBChkSum" VALUE 0x804D9432 Val_Wu8 30.00 DFES_OneToOne 0.00 30.00 FORMAT "%5.2" EXTENDED_LIMITS 0.00 255.0 /end CHARACTERISTIC
/begin CHARACTERISTIC DFES_Cls.DFC_ComEATBRingCnt_C "fault class per DFC / Fault class for check DFC_ComEATBRingCnt" VALUE 0x804D9433 Val_Wu8 30.00 DFES_OneToOne 0.00 30.00 FORMAT "%5.2" EXTENDED_LIMITS 0.00 255.0 /end CHARACTERISTIC
/begin CHARACTERISTIC DFES_Cls.DFC_ComEATBTOut_C "fault class per DFC / Fault class for check DFC_ComEATBTOut" VALUE 0x804D9434 Val_Wu8 30.00 DFES_OneToOne 0.00 30.00 FORMAT "%5.2" EXTENDED_LIMITS 0.00 255.0 /end CHARACTERISTIC
/begin CHARACTERISTIC DFES_Cls.DFC_ComEATCChksum_C "fault class per DFC / Fault class for check DFC_ComEATCChksum" VALUE 0x804D9435 Val_Wu8 30.00 DFES_OneToOne 0.00 30.00 FORMAT "%5.2" EXTENDED_LIMITS 0.00 255.0 /end CHARACTERISTIC
/begin CHARACTERISTIC DFES_Cls.DFC_ComEATCRingCnt_C "fault class per DFC / Fault class for check DFC_ComEATCRingCnt" VALUE 0x804D9436 Val_Wu8 30.00 DFES_OneToOne 0.00 30.00 FORMAT "%5.2" EXTENDED_LIMITS 0.00 255.0 /end CHARACTERISTIC
/begin CHARACTERISTIC DFES_Cls.DFC_ComEATCTOut_C "fault class per DFC / Fault class for check DFC_ComEATCTOut" VALUE 0x804D9437 Val_Wu8 30.00 DFES_OneToOne 0.00 30.00 FORMAT "%5.2" EXTENDED_LIMITS 0.00 255.0 /end CHARACTERISTIC
/begin CHARACTERISTIC DFES_Cls.DFC_ComEPBBChkSum_C "fault class per DFC / Fault class for check DFC_ComEPBBChkSum" VALUE 0x804D9438 Val_Wu8 30.00 DFES_OneToOne 0.00 30.00 FORMAT "%5.2" EXTENDED_LIMITS 0.00 255.0 /end CHARACTERISTIC
/begin CHARACTERISTIC DFES_Cls.DFC_ComEPBBRingCnt_C "fault class per DFC / Fault class for check DFC_ComEPBBRingCnt" VALUE 0x804D9439 Val_Wu8 30.00 DFES_OneToOne 0.00 30.00 FORMAT "%5.2" EXTENDED_LIMITS 0.00 255.0 /end CHARACTERISTIC
/begin CHARACTERISTIC DFES_Cls.DFC_ComEPBBTOut_C "fault class per DFC / Fault class for check DFC_ComEPBBTOut" VALUE 0x804D943A Val_Wu8 30.00 DFES_OneToOne 0.00 30.00 FORMAT "%5.2" EXTENDED_LIMITS 0.00 255.0 /end CHARACTERISTIC
/begin CHARACTERISTIC DFES_Cls.DFC_ComEPBChksum_C "fault class per DFC / Fault class for check DFC_ComEPBChksum" VALUE 0x804D943B Val_Wu8 30.00 DFES_OneToOne 0.00 30.00 FORMAT "%5.2" EXTENDED_LIMITS 0.00 255.0 /end CHARACTERISTIC
/begin CHARACTERISTIC DFES_Cls.DFC_ComEPBTOut_C "fault class per DFC / Fault class for check DFC_ComEPBTOut" VALUE 0x804D943C Val_Wu8 30.00 DFES_OneToOne 0.00 30.00 FORMAT "%5.2" EXTENDED_LIMITS 0.00 255.0 /end CHARACTERISTIC
/begin CHARACTERISTIC DFES_Cls.DFC_ComEPBctRing_C "fault class per DFC / Fault class for check DFC_ComEPBctRing" VALUE 0x804D943D Val_Wu8 30.00 DFES_OneToOne 0.00 30.00 FORMAT "%5.2" EXTENDED_LIMITS 0.00 255.0 /end CHARACTERISTIC
/begin CHARACTERISTIC DFES_Cls.DFC_ComEPS1Chksum_C "fault class per DFC / Fault class for check DFC_ComEPS1Chksum" VALUE 0x804D943E Val_Wu8 30.00 DFES_OneToOne 0.00 30.00 FORMAT "%5.2" EXTENDED_LIMITS 0.00 255.0 /end CHARACTERISTIC
/begin CHARACTERISTIC DFES_Cls.DFC_ComEPS1RingCnt_C "fault class per DFC / Fault class for check DFC_ComEPS1RingCnt" VALUE 0x804D943F Val_Wu8 30.00 DFES_OneToOne 0.00 30.00 FORMAT "%5.2" EXTENDED_LIMITS 0.00 255.0 /end CHARACTERISTIC
/begin CHARACTERISTIC DFES_Cls.DFC_ComEPS1TOut_C "fault class per DFC / Fault class for check DFC_ComEPS1TOut" VALUE 0x804D9440 Val_Wu8 30.00 DFES_OneToOne 0.00 30.00 FORMAT "%5.2" EXTENDED_LIMITS 0.00 255.0 /end CHARACTERISTIC
/begin CHARACTERISTIC DFES_Cls.DFC_ComEngCanRxErr_C "fault class per DFC / Fault class for check DFC_ComEngCanRxErr" VALUE 0x804D9441 Val_Wu8 30.00 DFES_OneToOne 0.00 30.00 FORMAT "%5.2" EXTENDED_LIMITS 0.00 255.0 /end CHARACTERISTIC
/begin CHARACTERISTIC DFES_Cls.DFC_ComGrvySnsrErr_C "fault class per DFC / Fault class for check DFC_ComGrvySnsrErr" VALUE 0x804D9442 Val_Wu8 30.00 DFES_OneToOne 0.00 30.00 FORMAT "%5.2" EXTENDED_LIMITS 0.00 255.0 /end CHARACTERISTIC
/begin CHARACTERISTIC DFES_Cls.DFC_ComGwIMG1ChkSum_C "fault class per DFC / Fault class for check DFC_ComGwIMG1ChkSum" VALUE 0x804D9443 Val_Wu8 30.00 DFES_OneToOne 0.00 30.00 FORMAT "%5.2" EXTENDED_LIMITS 0.00 255.0 /end CHARACTERISTIC
/begin CHARACTERISTIC DFES_Cls.DFC_ComGwIMG1RingCnt_C "fault class per DFC / Fault class for check DFC_ComGwIMG1RingCnt" VALUE 0x804D9444 Val_Wu8 30.00 DFES_OneToOne 0.00 30.00 FORMAT "%5.2" EXTENDED_LIMITS 0.00 255.0 /end CHARACTERISTIC
/begin CHARACTERISTIC DFES_Cls.DFC_ComGwIMG1TOut_C "fault class per DFC / Fault class for check DFC_ComGwIMG1TOut" VALUE 0x804D9445 Val_Wu8 30.00 DFES_OneToOne 0.00 30.00 FORMAT "%5.2" EXTENDED_LIMITS 0.00 255.0 /end CHARACTERISTIC
/begin CHARACTERISTIC DFES_Cls.DFC_ComGwIMG3ChkSum_C "fault class per DFC / Fault class for check DFC_ComGwIMG3ChkSum" VALUE 0x804D9446 Val_Wu8 30.00 DFES_OneToOne 0.00 30.00 FORMAT "%5.2" EXTENDED_LIMITS 0.00 255.0 /end CHARACTERISTIC
/begin CHARACTERISTIC DFES_Cls.DFC_ComGwIMG3RingCnt_C "fault class per DFC / Fault class for check DFC_ComGwIMG3RingCnt" VALUE 0x804D9447 Val_Wu8 30.00 DFES_OneToOne 0.00 30.00 FORMAT "%5.2" EXTENDED_LIMITS 0.00 255.0 /end CHARACTERISTIC
/begin CHARACTERISTIC DFES_Cls.DFC_ComGwIMG3TOut_C "fault class per DFC / Fault class for check DFC_ComGwIMG3TOut" VALUE 0x804D9448 Val_Wu8 30.00 DFES_OneToOne 0.00 30.00 FORMAT "%5.2" EXTENDED_LIMITS 0.00 255.0 /end CHARACTERISTIC
/begin CHARACTERISTIC DFES_Cls.DFC_ComGwIMG4ChkSum_C "fault class per DFC / Fault class for check DFC_ComGwIMG4ChkSum" VALUE 0x804D9449 Val_Wu8 30.00 DFES_OneToOne 0.00 30.00 FORMAT "%5.2" EXTENDED_LIMITS 0.00 255.0 /end CHARACTERISTIC
/begin CHARACTERISTIC DFES_Cls.DFC_ComGwIMG4RingCnt_C "fault class per DFC / Fault class for check DFC_ComGwIMG4RingCnt" VALUE 0x804D944A Val_Wu8 30.00 DFES_OneToOne 0.00 30.00 FORMAT "%5.2" EXTENDED_LIMITS 0.00 255.0 /end CHARACTERISTIC
/begin CHARACTERISTIC DFES_Cls.DFC_ComGwIMG4TOut_C "fault class per DFC / Fault class for check DFC_ComGwIMG4TOut" VALUE 0x804D944B Val_Wu8 30.00 DFES_OneToOne 0.00 30.00 FORMAT "%5.2" EXTENDED_LIMITS 0.00 255.0 /end CHARACTERISTIC
/begin CHARACTERISTIC DFES_Cls.DFC_ComGwIMG5ChkSum_C "fault class per DFC / Fault class for check DFC_ComGwIMG5ChkSum" VALUE 0x804D944C Val_Wu8 30.00 DFES_OneToOne 0.00 30.00 FORMAT "%5.2" EXTENDED_LIMITS 0.00 255.0 /end CHARACTERISTIC
/begin CHARACTERISTIC DFES_Cls.DFC_ComGwIMG5RingCnt_C "fault class per DFC / Fault class for check DFC_ComGwIMG5RingCnt" VALUE 0x804D944D Val_Wu8 30.00 DFES_OneToOne 0.00 30.00 FORMAT "%5.2" EXTENDED_LIMITS 0.00 255.0 /end CHARACTERISTIC
/begin CHARACTERISTIC DFES_Cls.DFC_ComGwIMG5TOut_C "fault class per DFC / Fault class for check DFC_ComGwIMG5TOut" VALUE 0x804D944E Val_Wu8 30.00 DFES_OneToOne 0.00 30.00 FORMAT "%5.2" EXTENDED_LIMITS 0.00 255.0 /end CHARACTERISTIC
/begin CHARACTERISTIC DFES_Cls.DFC_ComGwIMG6ChkSum_C "fault class per DFC / Fault class for check DFC_ComGwIMG6ChkSum" VALUE 0x804D944F Val_Wu8 30.00 DFES_OneToOne 0.00 30.00 FORMAT "%5.2" EXTENDED_LIMITS 0.00 255.0 /end CHARACTERISTIC
/begin CHARACTERISTIC DFES_Cls.DFC_ComGwIMG6RingCnt_C "fault class per DFC / Fault class for check DFC_ComGwIMG6RingCnt" VALUE 0x804D9450 Val_Wu8 30.00 DFES_OneToOne 0.00 30.00 FORMAT "%5.2" EXTENDED_LIMITS 0.00 255.0 /end CHARACTERISTIC
/begin CHARACTERISTIC DFES_Cls.DFC_ComGwIMG6TOut_C "fault class per DFC / Fault class for check DFC_ComGwIMG6TOut" VALUE 0x804D9451 Val_Wu8 30.00 DFES_OneToOne 0.00 30.00 FORMAT "%5.2" EXTENDED_LIMITS 0.00 255.0 /end CHARACTERISTIC
/begin CHARACTERISTIC DFES_Cls.DFC_ComIDASBChksum_C "fault class per DFC / Fault class for check DFC_ComIDASBChksum" VALUE 0x804D9452 Val_Wu8 30.00 DFES_OneToOne 0.00 30.00 FORMAT "%5.2" EXTENDED_LIMITS 0.00 255.0 /end CHARACTERISTIC
/begin CHARACTERISTIC DFES_Cls.DFC_ComIDASBRingCnt_C "fault class per DFC / Fault class for check DFC_ComIDASBRingCnt" VALUE 0x804D9453 Val_Wu8 30.00 DFES_OneToOne 0.00 30.00 FORMAT "%5.2" EXTENDED_LIMITS 0.00 255.0 /end CHARACTERISTIC
/begin CHARACTERISTIC DFES_Cls.DFC_ComIDASBTOut_C "fault class per DFC / Fault class for check DFC_ComIDASBTOut" VALUE 0x804D9454 Val_Wu8 30.00 DFES_OneToOne 0.00 30.00 FORMAT "%5.2" EXTENDED_LIMITS 0.00 255.0 /end CHARACTERISTIC
/begin CHARACTERISTIC DFES_Cls.DFC_ComIMGMILReq_C "fault class per DFC / Fault class for check DFC_ComIMGMILReq" VALUE 0x804D9455 Val_Wu8 30.00 DFES_OneToOne 0.00 30.00 FORMAT "%5.2" EXTENDED_LIMITS 0.00 255.0 /end CHARACTERISTIC
/begin CHARACTERISTIC DFES_Cls.DFC_ComISSPrms_C "fault class per DFC / Fault class for check DFC_ComISSPrms" VALUE 0x804D9456 Val_Wu8 30.00 DFES_OneToOne 0.00 30.00 FORMAT "%5.2" EXTENDED_LIMITS 0.00 255.0 /end CHARACTERISTIC
/begin CHARACTERISTIC DFES_Cls.DFC_ComMETAChksum_C "fault class per DFC / Fault class for check DFC_ComMETAChksum" VALUE 0x804D9457 Val_Wu8 30.00 DFES_OneToOne 0.00 30.00 FORMAT "%5.2" EXTENDED_LIMITS 0.00 255.0 /end CHARACTERISTIC
/begin CHARACTERISTIC DFES_Cls.DFC_ComMETAChksumPstDrv_C "fault class per DFC / Fault class for check DFC_ComMETAChksumPstDrv" VALUE 0x804D9458 Val_Wu8 30.00 DFES_OneToOne 0.00 30.00 FORMAT "%5.2" EXTENDED_LIMITS 0.00 255.0 /end CHARACTERISTIC
/begin CHARACTERISTIC DFES_Cls.DFC_ComMETARingCnt_C "fault class per DFC / Fault class for check DFC_ComMETARingCnt" VALUE 0x804D9459 Val_Wu8 30.00 DFES_OneToOne 0.00 30.00 FORMAT "%5.2" EXTENDED_LIMITS 0.00 255.0 /end CHARACTERISTIC
/begin CHARACTERISTIC DFES_Cls.DFC_ComMETARingCntPstDrv_C "fault class per DFC / Fault class for check DFC_ComMETARingCntPstDrv" VALUE 0x804D945A Val_Wu8 30.00 DFES_OneToOne 0.00 30.00 FORMAT "%5.2" EXTENDED_LIMITS 0.00 255.0 /end CHARACTERISTIC
/begin CHARACTERISTIC DFES_Cls.DFC_ComMETATOut_C "fault class per DFC / Fault class for check DFC_ComMETATOut" VALUE 0x804D945B Val_Wu8 30.00 DFES_OneToOne 0.00 30.00 FORMAT "%5.2" EXTENDED_LIMITS 0.00 255.0 /end CHARACTERISTIC
/begin CHARACTERISTIC DFES_Cls.DFC_ComMETATOutPstDrv_C "fault class per DFC / Fault class for check DFC_ComMETATOutPstDrv" VALUE 0x804D945C Val_Wu8 30.00 DFES_OneToOne 0.00 30.00 FORMAT "%5.2" EXTENDED_LIMITS 0.00 255.0 /end CHARACTERISTIC
/begin CHARACTERISTIC DFES_Cls.DFC_ComMETCChksum_C "fault class per DFC / Fault class for check DFC_ComMETCChksum" VALUE 0x804D945D Val_Wu8 30.00 DFES_OneToOne 0.00 30.00 FORMAT "%5.2" EXTENDED_LIMITS 0.00 255.0 /end CHARACTERISTIC
/begin CHARACTERISTIC DFES_Cls.DFC_ComMETCRingCnt_C "fault class per DFC / Fault class for check DFC_ComMETCRingCnt" VALUE 0x804D945E Val_Wu8 30.00 DFES_OneToOne 0.00 30.00 FORMAT "%5.2" EXTENDED_LIMITS 0.00 255.0 /end CHARACTERISTIC
/begin CHARACTERISTIC DFES_Cls.DFC_ComMETCTOut_C "fault class per DFC / Fault class for check DFC_ComMETCTOut" VALUE 0x804D945F Val_Wu8 30.00 DFES_OneToOne 0.00 30.00 FORMAT "%5.2" EXTENDED_LIMITS 0.00 255.0 /end CHARACTERISTIC
/begin CHARACTERISTIC DFES_Cls.DFC_ComMETDChksum_C "fault class per DFC / Fault class for check DFC_ComMETDChksum" VALUE 0x804D9460 Val_Wu8 30.00 DFES_OneToOne 0.00 30.00 FORMAT "%5.2" EXTENDED_LIMITS 0.00 255.0 /end CHARACTERISTIC
/begin CHARACTERISTIC DFES_Cls.DFC_ComMETDRingCnt_C "fault class per DFC / Fault class for check DFC_ComMETDRingCnt" VALUE 0x804D9461 Val_Wu8 30.00 DFES_OneToOne 0.00 30.00 FORMAT "%5.2" EXTENDED_LIMITS 0.00 255.0 /end CHARACTERISTIC
/begin CHARACTERISTIC DFES_Cls.DFC_ComMETDTOut_C "fault class per DFC / Fault class for check DFC_ComMETDTOut" VALUE 0x804D9462 Val_Wu8 30.00 DFES_OneToOne 0.00 30.00 FORMAT "%5.2" EXTENDED_LIMITS 0.00 255.0 /end CHARACTERISTIC
/begin CHARACTERISTIC DFES_Cls.DFC_ComMETE2Chksum_C "fault class per DFC / Fault class for check DFC_ComMETE2Chksum" VALUE 0x804D9463 Val_Wu8 30.00 DFES_OneToOne 0.00 30.00 FORMAT "%5.2" EXTENDED_LIMITS 0.00 255.0 /end CHARACTERISTIC
/begin CHARACTERISTIC DFES_Cls.DFC_ComMETE2RingCnt_C "fault class per DFC / Fault class for check DFC_ComMETE2RingCnt" VALUE 0x804D9464 Val_Wu8 30.00 DFES_OneToOne 0.00 30.00 FORMAT "%5.2" EXTENDED_LIMITS 0.00 255.0 /end CHARACTERISTIC
/begin CHARACTERISTIC DFES_Cls.DFC_ComMETE2TOut_C "fault class per DFC / Fault class for check DFC_ComMETE2TOut" VALUE 0x804D9465 Val_Wu8 30.00 DFES_OneToOne 0.00 30.00 FORMAT "%5.2" EXTENDED_LIMITS 0.00 255.0 /end CHARACTERISTIC
/begin CHARACTERISTIC DFES_Cls.DFC_ComMETFChksum_C "fault class per DFC / Fault class for check DFC_ComMETFChksum" VALUE 0x804D9466 Val_Wu8 30.00 DFES_OneToOne 0.00 30.00 FORMAT "%5.2" EXTENDED_LIMITS 0.00 255.0 /end CHARACTERISTIC
/begin CHARACTERISTIC DFES_Cls.DFC_ComMETFRingCnt_C "fault class per DFC / Fault class for check DFC_ComMETFRingCnt" VALUE 0x804D9467 Val_Wu8 30.00 DFES_OneToOne 0.00 30.00 FORMAT "%5.2" EXTENDED_LIMITS 0.00 255.0 /end CHARACTERISTIC
/begin CHARACTERISTIC DFES_Cls.DFC_ComMETFTOut_C "fault class per DFC / Fault class for check DFC_ComMETFTOut" VALUE 0x804D9468 Val_Wu8 30.00 DFES_OneToOne 0.00 30.00 FORMAT "%5.2" EXTENDED_LIMITS 0.00 255.0 /end CHARACTERISTIC
/begin CHARACTERISTIC DFES_Cls.DFC_ComMETGChksum_C "fault class per DFC / Fault class for check DFC_ComMETGChksum" VALUE 0x804D9469 Val_Wu8 30.00 DFES_OneToOne 0.00 30.00 FORMAT "%5.2" EXTENDED_LIMITS 0.00 255.0 /end CHARACTERISTIC
/begin CHARACTERISTIC DFES_Cls.DFC_ComMETGRingCnt_C "fault class per DFC / Fault class for check DFC_ComMETGRingCnt" VALUE 0x804D946A Val_Wu8 30.00 DFES_OneToOne 0.00 30.00 FORMAT "%5.2" EXTENDED_LIMITS 0.00 255.0 /end CHARACTERISTIC
/begin CHARACTERISTIC DFES_Cls.DFC_ComMETGTOut_C "fault class per DFC / Fault class for check DFC_ComMETGTOut" VALUE 0x804D946B Val_Wu8 30.00 DFES_OneToOne 0.00 30.00 FORMAT "%5.2" EXTENDED_LIMITS 0.00 255.0 /end CHARACTERISTIC
/begin CHARACTERISTIC DFES_Cls.DFC_ComMETH2Chksum_C "fault class per DFC / Fault class for check DFC_ComMETH2Chksum" VALUE 0x804D946C Val_Wu8 30.00 DFES_OneToOne 0.00 30.00 FORMAT "%5.2" EXTENDED_LIMITS 0.00 255.0 /end CHARACTERISTIC
/begin CHARACTERISTIC DFES_Cls.DFC_ComMETH2RingCnt_C "fault class per DFC / Fault class for check DFC_ComMETH2RingCnt" VALUE 0x804D946D Val_Wu8 30.00 DFES_OneToOne 0.00 30.00 FORMAT "%5.2" EXTENDED_LIMITS 0.00 255.0 /end CHARACTERISTIC
/begin CHARACTERISTIC DFES_Cls.DFC_ComMETH2TOut_C "fault class per DFC / Fault class for check DFC_ComMETH2TOut" VALUE 0x804D946E Val_Wu8 30.00 DFES_OneToOne 0.00 30.00 FORMAT "%5.2" EXTENDED_LIMITS 0.00 255.0 /end CHARACTERISTIC
/begin CHARACTERISTIC DFES_Cls.DFC_ComMETHChksum_C "fault class per DFC / Fault class for check DFC_ComMETHChksum" VALUE 0x804D946F Val_Wu8 30.00 DFES_OneToOne 0.00 30.00 FORMAT "%5.2" EXTENDED_LIMITS 0.00 255.0 /end CHARACTERISTIC
/begin CHARACTERISTIC DFES_Cls.DFC_ComMETHRingCnt_C "fault class per DFC / Fault class for check DFC_ComMETHRingCnt" VALUE 0x804D9470 Val_Wu8 30.00 DFES_OneToOne 0.00 30.00 FORMAT "%5.2" EXTENDED_LIMITS 0.00 255.0 /end CHARACTERISTIC
/begin CHARACTERISTIC DFES_Cls.DFC_ComMETHTOut_C "fault class per DFC / Fault class for check DFC_ComMETHTOut" VALUE 0x804D9471 Val_Wu8 30.00 DFES_OneToOne 0.00 30.00 FORMAT "%5.2" EXTENDED_LIMITS 0.00 255.0 /end CHARACTERISTIC
/begin CHARACTERISTIC DFES_Cls.DFC_ComMETIChksum_C "fault class per DFC / Fault class for check DFC_ComMETIChksum" VALUE 0x804D9472 Val_Wu8 30.00 DFES_OneToOne 0.00 30.00 FORMAT "%5.2" EXTENDED_LIMITS 0.00 255.0 /end CHARACTERISTIC
/begin CHARACTERISTIC DFES_Cls.DFC_ComMETIRingCnt_C "fault class per DFC / Fault class for check DFC_ComMETIRingCnt" VALUE 0x804D9473 Val_Wu8 30.00 DFES_OneToOne 0.00 30.00 FORMAT "%5.2" EXTENDED_LIMITS 0.00 255.0 /end CHARACTERISTIC
/begin CHARACTERISTIC DFES_Cls.DFC_ComMETITOut_C "fault class per DFC / Fault class for check DFC_ComMETITOut" VALUE 0x804D9474 Val_Wu8 30.00 DFES_OneToOne 0.00 30.00 FORMAT "%5.2" EXTENDED_LIMITS 0.00 255.0 /end CHARACTERISTIC
/begin CHARACTERISTIC DFES_Cls.DFC_ComMETKChksum_C "fault class per DFC / Fault class for check DFC_ComMETKChksum" VALUE 0x804D9475 Val_Wu8 30.00 DFES_OneToOne 0.00 30.00 FORMAT "%5.2" EXTENDED_LIMITS 0.00 255.0 /end CHARACTERISTIC
/begin CHARACTERISTIC DFES_Cls.DFC_ComMETKRingCnt_C "fault class per DFC / Fault class for check DFC_ComMETKRingCnt" VALUE 0x804D9476 Val_Wu8 30.00 DFES_OneToOne 0.00 30.00 FORMAT "%5.2" EXTENDED_LIMITS 0.00 255.0 /end CHARACTERISTIC
/begin CHARACTERISTIC DFES_Cls.DFC_ComMETKTOut_C "fault class per DFC / Fault class for check DFC_ComMETKTOut" VALUE 0x804D9477 Val_Wu8 30.00 DFES_OneToOne 0.00 30.00 FORMAT "%5.2" EXTENDED_LIMITS 0.00 255.0 /end CHARACTERISTIC
/begin CHARACTERISTIC DFES_Cls.DFC_ComMETLChksum_C "fault class per DFC / Fault class for check DFC_ComMETLChksum" VALUE 0x804D9478 Val_Wu8 30.00 DFES_OneToOne 0.00 30.00 FORMAT "%5.2" EXTENDED_LIMITS 0.00 255.0 /end CHARACTERISTIC
/begin CHARACTERISTIC DFES_Cls.DFC_ComMETLRingCnt_C "fault class per DFC / Fault class for check DFC_ComMETLRingCnt" VALUE 0x804D9479 Val_Wu8 30.00 DFES_OneToOne 0.00 30.00 FORMAT "%5.2" EXTENDED_LIMITS 0.00 255.0 /end CHARACTERISTIC
/begin CHARACTERISTIC DFES_Cls.DFC_ComMETLTOut_C "fault class per DFC / Fault class for check DFC_ComMETLTOut" VALUE 0x804D947A Val_Wu8 30.00 DFES_OneToOne 0.00 30.00 FORMAT "%5.2" EXTENDED_LIMITS 0.00 255.0 /end CHARACTERISTIC
/begin CHARACTERISTIC DFES_Cls.DFC_ComMETMChksum_C "fault class per DFC / Fault class for check DFC_ComMETMChksum" VALUE 0x804D947B Val_Wu8 30.00 DFES_OneToOne 0.00 30.00 FORMAT "%5.2" EXTENDED_LIMITS 0.00 255.0 /end CHARACTERISTIC
/begin CHARACTERISTIC DFES_Cls.DFC_ComMETMRingCnt_C "fault class per DFC / Fault class for check DFC_ComMETMRingCnt" VALUE 0x804D947C Val_Wu8 30.00 DFES_OneToOne 0.00 30.00 FORMAT "%5.2" EXTENDED_LIMITS 0.00 255.0 /end CHARACTERISTIC
/begin CHARACTERISTIC DFES_Cls.DFC_ComMETMTOut_C "fault class per DFC / Fault class for check DFC_ComMETMTOut" VALUE 0x804D947D Val_Wu8 30.00 DFES_OneToOne 0.00 30.00 FORMAT "%5.2" EXTENDED_LIMITS 0.00 255.0 /end CHARACTERISTIC
/begin CHARACTERISTIC DFES_Cls.DFC_ComMETNChksum_C "fault class per DFC / Fault class for check DFC_ComMETNChksum" VALUE 0x804D947E Val_Wu8 30.00 DFES_OneToOne 0.00 30.00 FORMAT "%5.2" EXTENDED_LIMITS 0.00 255.0 /end CHARACTERISTIC
/begin CHARACTERISTIC DFES_Cls.DFC_ComMETNRingCnt_C "fault class per DFC / Fault class for check DFC_ComMETNRingCnt" VALUE 0x804D947F Val_Wu8 30.00 DFES_OneToOne 0.00 30.00 FORMAT "%5.2" EXTENDED_LIMITS 0.00 255.0 /end CHARACTERISTIC
/begin CHARACTERISTIC DFES_Cls.DFC_ComMETNTOut_C "fault class per DFC / Fault class for check DFC_ComMETNTOut" VALUE 0x804D9480 Val_Wu8 30.00 DFES_OneToOne 0.00 30.00 FORMAT "%5.2" EXTENDED_LIMITS 0.00 255.0 /end CHARACTERISTIC
/begin CHARACTERISTIC DFES_Cls.DFC_ComMtrCom_C "fault class per DFC / Fault class for check DFC_ComMtrCom" VALUE 0x804D9481 Val_Wu8 30.00 DFES_OneToOne 0.00 30.00 FORMAT "%5.2" EXTENDED_LIMITS 0.00 255.0 /end CHARACTERISTIC
/begin CHARACTERISTIC DFES_Cls.DFC_ComPCUChkSum_C "fault class per DFC / Fault class for check DFC_ComPCUChkSum" VALUE 0x804D9482 Val_Wu8 30.00 DFES_OneToOne 0.00 30.00 FORMAT "%5.2" EXTENDED_LIMITS 0.00 255.0 /end CHARACTERISTIC
/begin CHARACTERISTIC DFES_Cls.DFC_ComPCURingCnt_C "fault class per DFC / Fault class for check DFC_ComPCURingCnt" VALUE 0x804D9483 Val_Wu8 30.00 DFES_OneToOne 0.00 30.00 FORMAT "%5.2" EXTENDED_LIMITS 0.00 255.0 /end CHARACTERISTIC
/begin CHARACTERISTIC DFES_Cls.DFC_ComPCUTOut_C "fault class per DFC / Fault class for check DFC_ComPCUTOut" VALUE 0x804D9484 Val_Wu8 30.00 DFES_OneToOne 0.00 30.00 FORMAT "%5.2" EXTENDED_LIMITS 0.00 255.0 /end CHARACTERISTIC
/begin CHARACTERISTIC DFES_Cls.DFC_ComSRSAChksum_C "fault class per DFC / Fault class for check DFC_ComSRSAChksum" VALUE 0x804D9485 Val_Wu8 30.00 DFES_OneToOne 0.00 30.00 FORMAT "%5.2" EXTENDED_LIMITS 0.00 255.0 /end CHARACTERISTIC
/begin CHARACTERISTIC DFES_Cls.DFC_ComSRSARingCnt_C "fault class per DFC / Fault class for check DFC_ComSRSARingCnt" VALUE 0x804D9486 Val_Wu8 30.00 DFES_OneToOne 0.00 30.00 FORMAT "%5.2" EXTENDED_LIMITS 0.00 255.0 /end CHARACTERISTIC
/begin CHARACTERISTIC DFES_Cls.DFC_ComSRSATOut_C "fault class per DFC / Fault class for check DFC_ComSRSATOut" VALUE 0x804D9487 Val_Wu8 30.00 DFES_OneToOne 0.00 30.00 FORMAT "%5.2" EXTENDED_LIMITS 0.00 255.0 /end CHARACTERISTIC
/begin CHARACTERISTIC DFES_Cls.DFC_ComSRSBChksum_C "fault class per DFC / Fault class for check DFC_ComSRSBChksum" VALUE 0x804D9488 Val_Wu8 30.00 DFES_OneToOne 0.00 30.00 FORMAT "%5.2" EXTENDED_LIMITS 0.00 255.0 /end CHARACTERISTIC
/begin CHARACTERISTIC DFES_Cls.DFC_ComSRSBRingCnt_C "fault class per DFC / Fault class for check DFC_ComSRSBRingCnt" VALUE 0x804D9489 Val_Wu8 30.00 DFES_OneToOne 0.00 30.00 FORMAT "%5.2" EXTENDED_LIMITS 0.00 255.0 /end CHARACTERISTIC
/begin CHARACTERISTIC DFES_Cls.DFC_ComSRSBTOut_C "fault class per DFC / Fault class for check DFC_ComSRSBTOut" VALUE 0x804D948A Val_Wu8 30.00 DFES_OneToOne 0.00 30.00 FORMAT "%5.2" EXTENDED_LIMITS 0.00 255.0 /end CHARACTERISTIC
/begin CHARACTERISTIC DFES_Cls.DFC_ComSRSChksum_C "fault class per DFC / Fault class for check DFC_ComSRSChksum" VALUE 0x804D948B Val_Wu8 30.00 DFES_OneToOne 0.00 30.00 FORMAT "%5.2" EXTENDED_LIMITS 0.00 255.0 /end CHARACTERISTIC
/begin CHARACTERISTIC DFES_Cls.DFC_ComSRSErr_C "fault class per DFC / Fault class for check DFC_ComSRSErr" VALUE 0x804D948C Val_Wu8 30.00 DFES_OneToOne 0.00 30.00 FORMAT "%5.2" EXTENDED_LIMITS 0.00 255.0 /end CHARACTERISTIC
/begin CHARACTERISTIC DFES_Cls.DFC_ComSRSRingCnt_C "fault class per DFC / Fault class for check DFC_ComSRSRingCnt" VALUE 0x804D948D Val_Wu8 30.00 DFES_OneToOne 0.00 30.00 FORMAT "%5.2" EXTENDED_LIMITS 0.00 255.0 /end CHARACTERISTIC
/begin CHARACTERISTIC DFES_Cls.DFC_ComSRSTOut_C "fault class per DFC / Fault class for check DFC_ComSRSTOut" VALUE 0x804D948E Val_Wu8 30.00 DFES_OneToOne 0.00 30.00 FORMAT "%5.2" EXTENDED_LIMITS 0.00 255.0 /end CHARACTERISTIC
/begin CHARACTERISTIC DFES_Cls.DFC_ComVehSpdPndFltTCU_C "fault class per DFC / Fault class for check DFC_ComVehSpdPndFltTCU" VALUE 0x804D948F Val_Wu8 30.00 DFES_OneToOne 0.00 30.00 FORMAT "%5.2" EXTENDED_LIMITS 0.00 255.0 /end CHARACTERISTIC
/begin CHARACTERISTIC DFES_Cls.DFC_EbsChartcCurrErr_C "fault class per DFC / Fault class for check DFC_EbsChartcCurrErr" VALUE 0x804D9490 Val_Wu8 30.00 DFES_OneToOne 0.00 30.00 FORMAT "%5.2" EXTENDED_LIMITS 0.00 255.0 /end CHARACTERISTIC
/begin CHARACTERISTIC DFES_Cls.DFC_EbsSelfDiagErr_C "fault class per DFC / Fault class for check DFC_EbsSelfDiagErr" VALUE 0x804D9491 Val_Wu8 30.00 DFES_OneToOne 0.00 30.00 FORMAT "%5.2" EXTENDED_LIMITS 0.00 255.0 /end CHARACTERISTIC
/begin CHARACTERISTIC DFES_Cls.DFC_GEVlvPhaCsersIntkB1_C "fault class per DFC / Fault class for check DFC_GEVlvPhaCsersIntkB1" VALUE 0x804D9492 Val_Wu8 30.00 DFES_OneToOne 0.00 30.00 FORMAT "%5.2" EXTENDED_LIMITS 0.00 255.0 /end CHARACTERISTIC
/begin CHARACTERISTIC DFES_Cls.DFC_GEVlvPhaPsOpenLoadIntkB1_C "fault class per DFC / Fault class for check DFC_GEVlvPhaPsOpenLoadIntkB1" VALUE 0x804D9493 Val_Wu8 30.00 DFES_OneToOne 0.00 30.00 FORMAT "%5.2" EXTENDED_LIMITS 0.00 255.0 /end CHARACTERISTIC
/begin CHARACTERISTIC DFES_Cls.DFC_GEVlvPhaPsShoToBattIntkB1_C "fault class per DFC / Fault class for check DFC_GEVlvPhaPsShoToBattIntkB1" VALUE 0x804D9494 Val_Wu8 30.00 DFES_OneToOne 0.00 30.00 FORMAT "%5.2" EXTENDED_LIMITS 0.00 255.0 /end CHARACTERISTIC
/begin CHARACTERISTIC DFES_Cls.DFC_GEVlvPhaPsShoToGndIntkB1_C "fault class per DFC / Fault class for check DFC_GEVlvPhaPsShoToGndIntkB1" VALUE 0x804D9495 Val_Wu8 30.00 DFES_OneToOne 0.00 30.00 FORMAT "%5.2" EXTENDED_LIMITS 0.00 255.0 /end CHARACTERISTIC
/begin CHARACTERISTIC DFES_Cls.DFC_GbxCANDigPlausErr_C "fault class per DFC / Fault class for check DFC_GbxCANDigPlausErr" VALUE 0x804D9496 Val_Wu8 30.00 DFES_OneToOne 0.00 30.00 FORMAT "%5.2" EXTENDED_LIMITS 0.00 255.0 /end CHARACTERISTIC
/begin CHARACTERISTIC DFES_Cls.DFC_GbxNPos1SRCMax_C "fault class per DFC / Fault class for check DFC_GbxNPos1SRCMax" VALUE 0x804D9497 Val_Wu8 30.00 DFES_OneToOne 0.00 30.00 FORMAT "%5.2" EXTENDED_LIMITS 0.00 255.0 /end CHARACTERISTIC
/begin CHARACTERISTIC DFES_Cls.DFC_GbxNPos1SRCMin_C "fault class per DFC / Fault class for check DFC_GbxNPos1SRCMin" VALUE 0x804D9498 Val_Wu8 30.00 DFES_OneToOne 0.00 30.00 FORMAT "%5.2" EXTENDED_LIMITS 0.00 255.0 /end CHARACTERISTIC
/begin CHARACTERISTIC DFES_Cls.DFC_GbxNPos2SRCMax_C "fault class per DFC / Fault class for check DFC_GbxNPos2SRCMax" VALUE 0x804D9499 Val_Wu8 30.00 DFES_OneToOne 0.00 30.00 FORMAT "%5.2" EXTENDED_LIMITS 0.00 255.0 /end CHARACTERISTIC
/begin CHARACTERISTIC DFES_Cls.DFC_GbxNPos2SRCMin_C "fault class per DFC / Fault class for check DFC_GbxNPos2SRCMin" VALUE 0x804D949A Val_Wu8 30.00 DFES_OneToOne 0.00 30.00 FORMAT "%5.2" EXTENDED_LIMITS 0.00 255.0 /end CHARACTERISTIC
/begin CHARACTERISTIC DFES_Cls.DFC_GbxNPosAlvChk_C "fault class per DFC / Fault class for check DFC_GbxNPosAlvChk" VALUE 0x804D949B Val_Wu8 30.00 DFES_OneToOne 0.00 30.00 FORMAT "%5.2" EXTENDED_LIMITS 0.00 255.0 /end CHARACTERISTIC
/begin CHARACTERISTIC DFES_Cls.DFC_GbxNPosSyncErr_C "fault class per DFC / Fault class for check DFC_GbxNPosSyncErr" VALUE 0x804D949C Val_Wu8 30.00 DFES_OneToOne 0.00 30.00 FORMAT "%5.2" EXTENDED_LIMITS 0.00 255.0 /end CHARACTERISTIC
/begin CHARACTERISTIC DFES_Cls.DFC_HEGOS2B1HtrPsMax_C "fault class per DFC / Fault class for check DFC_HEGOS2B1HtrPsMax" VALUE 0x804D949D Val_Wu8 30.00 DFES_OneToOne 0.00 30.00 FORMAT "%5.2" EXTENDED_LIMITS 0.00 255.0 /end CHARACTERISTIC
/begin CHARACTERISTIC DFES_Cls.DFC_HEGOS2B1HtrPsMin_C "fault class per DFC / Fault class for check DFC_HEGOS2B1HtrPsMin" VALUE 0x804D949E Val_Wu8 30.00 DFES_OneToOne 0.00 30.00 FORMAT "%5.2" EXTENDED_LIMITS 0.00 255.0 /end CHARACTERISTIC
/begin CHARACTERISTIC DFES_Cls.DFC_HEGOS2B1HtrPsSig_C "fault class per DFC / Fault class for check DFC_HEGOS2B1HtrPsSig" VALUE 0x804D949F Val_Wu8 30.00 DFES_OneToOne 0.00 30.00 FORMAT "%5.2" EXTENDED_LIMITS 0.00 255.0 /end CHARACTERISTIC
/begin CHARACTERISTIC DFES_Cls.DFC_LinCSErrACG_C "fault class per DFC / Fault class for check DFC_LinCSErrACG" VALUE 0x804D94A0 Val_Wu8 30.00 DFES_OneToOne 0.00 30.00 FORMAT "%5.2" EXTENDED_LIMITS 0.00 255.0 /end CHARACTERISTIC
/begin CHARACTERISTIC DFES_Cls.DFC_LinCSErrAEV_C "fault class per DFC / Fault class for check DFC_LinCSErrAEV" VALUE 0x804D94A1 Val_Wu8 30.00 DFES_OneToOne 0.00 30.00 FORMAT "%5.2" EXTENDED_LIMITS 0.00 255.0 /end CHARACTERISTIC
/begin CHARACTERISTIC DFES_Cls.DFC_LinCSErrDCDC_C "fault class per DFC / Fault class for check DFC_LinCSErrDCDC" VALUE 0x804D94A2 Val_Wu8 30.00 DFES_OneToOne 0.00 30.00 FORMAT "%5.2" EXTENDED_LIMITS 0.00 255.0 /end CHARACTERISTIC
/begin CHARACTERISTIC DFES_Cls.DFC_LinCSErrEBS_C "fault class per DFC / Fault class for check DFC_LinCSErrEBS" VALUE 0x804D94A3 Val_Wu8 30.00 DFES_OneToOne 0.00 30.00 FORMAT "%5.2" EXTENDED_LIMITS 0.00 255.0 /end CHARACTERISTIC
/begin CHARACTERISTIC DFES_Cls.DFC_LinHdrTimeoutErrACG_C "fault class per DFC / Fault class for check DFC_LinHdrTimeoutErrACG" VALUE 0x804D94A4 Val_Wu8 30.00 DFES_OneToOne 0.00 30.00 FORMAT "%5.2" EXTENDED_LIMITS 0.00 255.0 /end CHARACTERISTIC
/begin CHARACTERISTIC DFES_Cls.DFC_LinHdrTimeoutErrAEV_C "fault class per DFC / Fault class for check DFC_LinHdrTimeoutErrAEV" VALUE 0x804D94A5 Val_Wu8 30.00 DFES_OneToOne 0.00 30.00 FORMAT "%5.2" EXTENDED_LIMITS 0.00 255.0 /end CHARACTERISTIC
/begin CHARACTERISTIC DFES_Cls.DFC_LinHdrTimeoutErrDCDC_C "fault class per DFC / Fault class for check DFC_LinHdrTimeoutErrDCDC" VALUE 0x804D94A6 Val_Wu8 30.00 DFES_OneToOne 0.00 30.00 FORMAT "%5.2" EXTENDED_LIMITS 0.00 255.0 /end CHARACTERISTIC
/begin CHARACTERISTIC DFES_Cls.DFC_LinHdrTimeoutErrEBS_C "fault class per DFC / Fault class for check DFC_LinHdrTimeoutErrEBS" VALUE 0x804D94A7 Val_Wu8 30.00 DFES_OneToOne 0.00 30.00 FORMAT "%5.2" EXTENDED_LIMITS 0.00 255.0 /end CHARACTERISTIC
/begin CHARACTERISTIC DFES_Cls.DFC_LinMsgTimeoutErrACG_C "fault class per DFC / Fault class for check DFC_LinMsgTimeoutErrACG" VALUE 0x804D94A8 Val_Wu8 30.00 DFES_OneToOne 0.00 30.00 FORMAT "%5.2" EXTENDED_LIMITS 0.00 255.0 /end CHARACTERISTIC
/begin CHARACTERISTIC DFES_Cls.DFC_LinMsgTimeoutErrAEV_C "fault class per DFC / Fault class for check DFC_LinMsgTimeoutErrAEV" VALUE 0x804D94A9 Val_Wu8 30.00 DFES_OneToOne 0.00 30.00 FORMAT "%5.2" EXTENDED_LIMITS 0.00 255.0 /end CHARACTERISTIC
/begin CHARACTERISTIC DFES_Cls.DFC_LinMsgTimeoutErrDCDC_C "fault class per DFC / Fault class for check DFC_LinMsgTimeoutErrDCDC" VALUE 0x804D94AA Val_Wu8 30.00 DFES_OneToOne 0.00 30.00 FORMAT "%5.2" EXTENDED_LIMITS 0.00 255.0 /end CHARACTERISTIC
/begin CHARACTERISTIC DFES_Cls.DFC_LinMsgTimeoutErrEBS_C "fault class per DFC / Fault class for check DFC_LinMsgTimeoutErrEBS" VALUE 0x804D94AB Val_Wu8 30.00 DFES_OneToOne 0.00 30.00 FORMAT "%5.2" EXTENDED_LIMITS 0.00 255.0 /end CHARACTERISTIC
/begin CHARACTERISTIC DFES_Cls.DFC_LinNoStrtComErr_C "fault class per DFC / Fault class for check DFC_LinNoStrtComErr" VALUE 0x804D94AC Val_Wu8 30.00 DFES_OneToOne 0.00 30.00 FORMAT "%5.2" EXTENDED_LIMITS 0.00 255.0 /end CHARACTERISTIC
/begin CHARACTERISTIC DFES_Cls.DFC_LowPresOilP_C "fault class per DFC / Fault class for check DFC_LowPresOilP" VALUE 0x804D94AD Val_Wu8 30.00 DFES_OneToOne 0.00 30.00 FORMAT "%5.2" EXTENDED_LIMITS 0.00 255.0 /end CHARACTERISTIC
/begin CHARACTERISTIC DFES_Cls.DFC_MisfDetVWhlFrntLeOORHi_C "fault class per DFC / Fault class for check DFC_MisfDetVWhlFrntLeOORHi" VALUE 0x804D94AE Val_Wu8 30.00 DFES_OneToOne 0.00 30.00 FORMAT "%5.2" EXTENDED_LIMITS 0.00 255.0 /end CHARACTERISTIC
/begin CHARACTERISTIC DFES_Cls.DFC_MisfDetVWhlFrntLeRatyHi_C "fault class per DFC / Fault class for check DFC_MisfDetVWhlFrntLeRatyHi" VALUE 0x804D94AF Val_Wu8 30.00 DFES_OneToOne 0.00 30.00 FORMAT "%5.2" EXTENDED_LIMITS 0.00 255.0 /end CHARACTERISTIC
/begin CHARACTERISTIC DFES_Cls.DFC_MisfDetVWhlFrntLeRatyLo_C "fault class per DFC / Fault class for check DFC_MisfDetVWhlFrntLeRatyLo" VALUE 0x804D94B0 Val_Wu8 30.00 DFES_OneToOne 0.00 30.00 FORMAT "%5.2" EXTENDED_LIMITS 0.00 255.0 /end CHARACTERISTIC
/begin CHARACTERISTIC DFES_Cls.DFC_MisfDetVWhlFrntLeStuck_C "fault class per DFC / Fault class for check DFC_MisfDetVWhlFrntLeStuck" VALUE 0x804D94B1 Val_Wu8 30.00 DFES_OneToOne 0.00 30.00 FORMAT "%5.2" EXTENDED_LIMITS 0.00 255.0 /end CHARACTERISTIC
/begin CHARACTERISTIC DFES_Cls.DFC_MisfDetVWhlFrntRiOORHi_C "fault class per DFC / Fault class for check DFC_MisfDetVWhlFrntRiOORHi" VALUE 0x804D94B2 Val_Wu8 30.00 DFES_OneToOne 0.00 30.00 FORMAT "%5.2" EXTENDED_LIMITS 0.00 255.0 /end CHARACTERISTIC
/begin CHARACTERISTIC DFES_Cls.DFC_MisfDetVWhlFrntRiRatyHi_C "fault class per DFC / Fault class for check DFC_MisfDetVWhlFrntRiRatyHi" VALUE 0x804D94B3 Val_Wu8 30.00 DFES_OneToOne 0.00 30.00 FORMAT "%5.2" EXTENDED_LIMITS 0.00 255.0 /end CHARACTERISTIC
/begin CHARACTERISTIC DFES_Cls.DFC_MisfDetVWhlFrntRiRatyLo_C "fault class per DFC / Fault class for check DFC_MisfDetVWhlFrntRiRatyLo" VALUE 0x804D94B4 Val_Wu8 30.00 DFES_OneToOne 0.00 30.00 FORMAT "%5.2" EXTENDED_LIMITS 0.00 255.0 /end CHARACTERISTIC
/begin CHARACTERISTIC DFES_Cls.DFC_MisfDetVWhlFrntRiStuck_C "fault class per DFC / Fault class for check DFC_MisfDetVWhlFrntRiStuck" VALUE 0x804D94B5 Val_Wu8 30.00 DFES_OneToOne 0.00 30.00 FORMAT "%5.2" EXTENDED_LIMITS 0.00 255.0 /end CHARACTERISTIC
/begin CHARACTERISTIC DFES_Cls.DFC_MisfDetVWhlReLeOORHi_C "fault class per DFC / Fault class for check DFC_MisfDetVWhlReLeOORHi" VALUE 0x804D94B6 Val_Wu8 30.00 DFES_OneToOne 0.00 30.00 FORMAT "%5.2" EXTENDED_LIMITS 0.00 255.0 /end CHARACTERISTIC
/begin CHARACTERISTIC DFES_Cls.DFC_MisfDetVWhlReLeRatyHi_C "fault class per DFC / Fault class for check DFC_MisfDetVWhlReLeRatyHi" VALUE 0x804D94B7 Val_Wu8 30.00 DFES_OneToOne 0.00 30.00 FORMAT "%5.2" EXTENDED_LIMITS 0.00 255.0 /end CHARACTERISTIC
/begin CHARACTERISTIC DFES_Cls.DFC_MisfDetVWhlReLeRatyLo_C "fault class per DFC / Fault class for check DFC_MisfDetVWhlReLeRatyLo" VALUE 0x804D94B8 Val_Wu8 30.00 DFES_OneToOne 0.00 30.00 FORMAT "%5.2" EXTENDED_LIMITS 0.00 255.0 /end CHARACTERISTIC
/begin CHARACTERISTIC DFES_Cls.DFC_MisfDetVWhlReLeStuck_C "fault class per DFC / Fault class for check DFC_MisfDetVWhlReLeStuck" VALUE 0x804D94B9 Val_Wu8 30.00 DFES_OneToOne 0.00 30.00 FORMAT "%5.2" EXTENDED_LIMITS 0.00 255.0 /end CHARACTERISTIC
/begin CHARACTERISTIC DFES_Cls.DFC_MisfDetVWhlReRiOORHi_C "fault class per DFC / Fault class for check DFC_MisfDetVWhlReRiOORHi" VALUE 0x804D94BA Val_Wu8 30.00 DFES_OneToOne 0.00 30.00 FORMAT "%5.2" EXTENDED_LIMITS 0.00 255.0 /end CHARACTERISTIC
/begin CHARACTERISTIC DFES_Cls.DFC_MisfDetVWhlReRiRatyHi_C "fault class per DFC / Fault class for check DFC_MisfDetVWhlReRiRatyHi" VALUE 0x804D94BB Val_Wu8 30.00 DFES_OneToOne 0.00 30.00 FORMAT "%5.2" EXTENDED_LIMITS 0.00 255.0 /end CHARACTERISTIC
/begin CHARACTERISTIC DFES_Cls.DFC_MisfDetVWhlReRiRatyLo_C "fault class per DFC / Fault class for check DFC_MisfDetVWhlReRiRatyLo" VALUE 0x804D94BC Val_Wu8 30.00 DFES_OneToOne 0.00 30.00 FORMAT "%5.2" EXTENDED_LIMITS 0.00 255.0 /end CHARACTERISTIC
/begin CHARACTERISTIC DFES_Cls.DFC_MisfDetVWhlReRiStuck_C "fault class per DFC / Fault class for check DFC_MisfDetVWhlReRiStuck" VALUE 0x804D94BD Val_Wu8 30.00 DFES_OneToOne 0.00 30.00 FORMAT "%5.2" EXTENDED_LIMITS 0.00 255.0 /end CHARACTERISTIC
/begin CHARACTERISTIC DFES_Cls.DFC_MisfDetdVWhlFrntLePlaus_C "fault class per DFC / Fault class for check DFC_MisfDetdVWhlFrntLePlaus" VALUE 0x804D94BE Val_Wu8 30.00 DFES_OneToOne 0.00 30.00 FORMAT "%5.2" EXTENDED_LIMITS 0.00 255.0 /end CHARACTERISTIC
/begin CHARACTERISTIC DFES_Cls.DFC_MisfDetdVWhlFrntRiPlaus_C "fault class per DFC / Fault class for check DFC_MisfDetdVWhlFrntRiPlaus" VALUE 0x804D94BF Val_Wu8 30.00 DFES_OneToOne 0.00 30.00 FORMAT "%5.2" EXTENDED_LIMITS 0.00 255.0 /end CHARACTERISTIC
/begin CHARACTERISTIC DFES_Cls.DFC_MisfDetdVWhlReLePlaus_C "fault class per DFC / Fault class for check DFC_MisfDetdVWhlReLePlaus" VALUE 0x804D94C0 Val_Wu8 30.00 DFES_OneToOne 0.00 30.00 FORMAT "%5.2" EXTENDED_LIMITS 0.00 255.0 /end CHARACTERISTIC
/begin CHARACTERISTIC DFES_Cls.DFC_MisfDetdVWhlReRiPlaus_C "fault class per DFC / Fault class for check DFC_MisfDetdVWhlReRiPlaus" VALUE 0x804D94C1 Val_Wu8 30.00 DFES_OneToOne 0.00 30.00 FORMAT "%5.2" EXTENDED_LIMITS 0.00 255.0 /end CHARACTERISTIC
/begin CHARACTERISTIC DFES_Cls.DFC_PEnvSigRngMax_C "fault class per DFC / Fault class for check DFC_PEnvSigRngMax" VALUE 0x804D94C2 Val_Wu8 30.00 DFES_OneToOne 0.00 30.00 FORMAT "%5.2" EXTENDED_LIMITS 0.00 255.0 /end CHARACTERISTIC
/begin CHARACTERISTIC DFES_Cls.DFC_PEnvSigRngMin_C "fault class per DFC / Fault class for check DFC_PEnvSigRngMin" VALUE 0x804D94C3 Val_Wu8 30.00 DFES_OneToOne 0.00 30.00 FORMAT "%5.2" EXTENDED_LIMITS 0.00 255.0 /end CHARACTERISTIC
/begin CHARACTERISTIC DFES_Cls.DFC_StmFault_C "fault class per DFC / Fault class for check DFC_StmFault" VALUE 0x804D94C4 Val_Wu8 30.00 DFES_OneToOne 0.00 30.00 FORMAT "%5.2" EXTENDED_LIMITS 0.00 255.0 /end CHARACTERISTIC
/begin CHARACTERISTIC DFES_Cls.DFC_StrtCtOffPth_C "fault class per DFC / Fault class for check DFC_StrtCtOffPth" VALUE 0x804D94C5 Val_Wu8 30.00 DFES_OneToOne 0.00 30.00 FORMAT "%5.2" EXTENDED_LIMITS 0.00 255.0 /end CHARACTERISTIC
/begin CHARACTERISTIC DFES_Cls.DFC_StrtCtlErr_C "fault class per DFC / Fault class for check DFC_StrtCtlErr" VALUE 0x804D94C6 Val_Wu8 30.00 DFES_OneToOne 0.00 30.00 FORMAT "%5.2" EXTENDED_LIMITS 0.00 255.0 /end CHARACTERISTIC
/begin CHARACTERISTIC DFES_Cls.DFC_StrtFault_C "fault class per DFC / Fault class for check DFC_StrtFault" VALUE 0x804D94C7 Val_Wu8 30.00 DFES_OneToOne 0.00 30.00 FORMAT "%5.2" EXTENDED_LIMITS 0.00 255.0 /end CHARACTERISTIC
/begin CHARACTERISTIC DFES_Cls.DFC_StrtLckJudg1_C "fault class per DFC / Fault class for check DFC_StrtLckJudg1" VALUE 0x804D94C8 Val_Wu8 30.00 DFES_OneToOne 0.00 30.00 FORMAT "%5.2" EXTENDED_LIMITS 0.00 255.0 /end CHARACTERISTIC
/begin CHARACTERISTIC DFES_Cls.DFC_StrtLckJudg2_C "fault class per DFC / Fault class for check DFC_StrtLckJudg2" VALUE 0x804D94C9 Val_Wu8 30.00 DFES_OneToOne 0.00 30.00 FORMAT "%5.2" EXTENDED_LIMITS 0.00 255.0 /end CHARACTERISTIC
/begin CHARACTERISTIC DFES_Cls.DFC_StrtOL_C "fault class per DFC / Fault class for check DFC_StrtOL" VALUE 0x804D94CA Val_Wu8 30.00 DFES_OneToOne 0.00 30.00 FORMAT "%5.2" EXTENDED_LIMITS 0.00 255.0 /end CHARACTERISTIC
/begin CHARACTERISTIC DFES_Cls.DFC_StrtOL2_C "fault class per DFC / Fault class for check DFC_StrtOL2" VALUE 0x804D94CB Val_Wu8 30.00 DFES_OneToOne 0.00 30.00 FORMAT "%5.2" EXTENDED_LIMITS 0.00 255.0 /end CHARACTERISTIC
/begin CHARACTERISTIC DFES_Cls.DFC_StrtSCB_C "fault class per DFC / Fault class for check DFC_StrtSCB" VALUE 0x804D94CC Val_Wu8 30.00 DFES_OneToOne 0.00 30.00 FORMAT "%5.2" EXTENDED_LIMITS 0.00 255.0 /end CHARACTERISTIC
/begin CHARACTERISTIC DFES_Cls.DFC_StrtSCB2_C "fault class per DFC / Fault class for check DFC_StrtSCB2" VALUE 0x804D94CD Val_Wu8 30.00 DFES_OneToOne 0.00 30.00 FORMAT "%5.2" EXTENDED_LIMITS 0.00 255.0 /end CHARACTERISTIC
/begin CHARACTERISTIC DFES_Cls.DFC_StrtSCG_C "fault class per DFC / Fault class for check DFC_StrtSCG" VALUE 0x804D94CE Val_Wu8 30.00 DFES_OneToOne 0.00 30.00 FORMAT "%5.2" EXTENDED_LIMITS 0.00 255.0 /end CHARACTERISTIC
/begin CHARACTERISTIC DFES_Cls.DFC_StrtSCG2_C "fault class per DFC / Fault class for check DFC_StrtSCG2" VALUE 0x804D94CF Val_Wu8 30.00 DFES_OneToOne 0.00 30.00 FORMAT "%5.2" EXTENDED_LIMITS 0.00 255.0 /end CHARACTERISTIC
/begin CHARACTERISTIC DFES_Cls.DFC_StrtStkRly1_C "fault class per DFC / Fault class for check DFC_StrtStkRly1" VALUE 0x804D94D0 Val_Wu8 30.00 DFES_OneToOne 0.00 30.00 FORMAT "%5.2" EXTENDED_LIMITS 0.00 255.0 /end CHARACTERISTIC
/begin CHARACTERISTIC DFES_Cls.DFC_StrtStkRly2_C "fault class per DFC / Fault class for check DFC_StrtStkRly2" VALUE 0x804D94D1 Val_Wu8 30.00 DFES_OneToOne 0.00 30.00 FORMAT "%5.2" EXTENDED_LIMITS 0.00 255.0 /end CHARACTERISTIC
/begin CHARACTERISTIC DFES_Cls.DFC_TEVEmax_C "fault class per DFC / Fault class for check DFC_TEVEmax" VALUE 0x804D94D2 Val_Wu8 30.00 DFES_OneToOne 0.00 30.00 FORMAT "%5.2" EXTENDED_LIMITS 0.00 255.0 /end CHARACTERISTIC
/begin CHARACTERISTIC DFES_Cls.DFC_TEVEmin_C "fault class per DFC / Fault class for check DFC_TEVEmin" VALUE 0x804D94D3 Val_Wu8 30.00 DFES_OneToOne 0.00 30.00 FORMAT "%5.2" EXTENDED_LIMITS 0.00 255.0 /end CHARACTERISTIC
/begin CHARACTERISTIC DFES_Cls.DFC_TEVEsig_C "fault class per DFC / Fault class for check DFC_TEVEsig" VALUE 0x804D94D4 Val_Wu8 30.00 DFES_OneToOne 0.00 30.00 FORMAT "%5.2" EXTENDED_LIMITS 0.00 255.0 /end CHARACTERISTIC
/begin CHARACTERISTIC DFES_Cls.DFC_UegoHeatrPrfmncLoS1B1_C "fault class per DFC / Fault class for check DFC_UegoHeatrPrfmncLoS1B1" VALUE 0x804D94D5 Val_Wu8 30.00 DFES_OneToOne 0.00 30.00 FORMAT "%5.2" EXTENDED_LIMITS 0.00 255.0 /end CHARACTERISTIC
/begin CHARACTERISTIC DFES_Cls.DFC_VehVAllPlaus_C "fault class per DFC / Fault class for check DFC_VehVAllPlaus" VALUE 0x804D94D6 Val_Wu8 30.00 DFES_OneToOne 0.00 30.00 FORMAT "%5.2" EXTENDED_LIMITS 0.00 255.0 /end CHARACTERISTIC
/begin CHARACTERISTIC DFES_Cls.DFC_VehVNCSnsrElecFailr_C "fault class per DFC / Fault class for check DFC_VehVNCSnsrElecFailr" VALUE 0x804D94D7 Val_Wu8 30.00 DFES_OneToOne 0.00 30.00 FORMAT "%5.2" EXTENDED_LIMITS 0.00 255.0 /end CHARACTERISTIC
/begin CHARACTERISTIC DFES_Cls.DFC_VehVPlausCan_C "fault class per DFC / Fault class for check DFC_VehVPlausCan" VALUE 0x804D94D8 Val_Wu8 30.00 DFES_OneToOne 0.00 30.00 FORMAT "%5.2" EXTENDED_LIMITS 0.00 255.0 /end CHARACTERISTIC
/begin CHARACTERISTIC DFES_Cls.DFC_VehVPlausFco_C "fault class per DFC / Fault class for check DFC_VehVPlausFco" VALUE 0x804D94D9 Val_Wu8 30.00 DFES_OneToOne 0.00 30.00 FORMAT "%5.2" EXTENDED_LIMITS 0.00 255.0 /end CHARACTERISTIC
/begin CHARACTERISTIC DFES_Cls.DFC_VehVPlausPwr_C "fault class per DFC / Fault class for check DFC_VehVPlausPwr" VALUE 0x804D94DA Val_Wu8 30.00 DFES_OneToOne 0.00 30.00 FORMAT "%5.2" EXTENDED_LIMITS 0.00 255.0 /end CHARACTERISTIC
/begin CHARACTERISTIC DFES_Cls.DFC_VehVPlausV2N_C "fault class per DFC / Fault class for check DFC_VehVPlausV2N" VALUE 0x804D94DB Val_Wu8 30.00 DFES_OneToOne 0.00 30.00 FORMAT "%5.2" EXTENDED_LIMITS 0.00 255.0 /end CHARACTERISTIC
/begin CHARACTERISTIC DFES_Cls.DFC_VehVSpdSnsrAElecFailr_C "fault class per DFC / Fault class for check DFC_VehVSpdSnsrAElecFailr" VALUE 0x804D94DC Val_Wu8 30.00 DFES_OneToOne 0.00 30.00 FORMAT "%5.2" EXTENDED_LIMITS 0.00 255.0 /end CHARACTERISTIC
/begin CHARACTERISTIC DFES_Cls.DFC_VehVSpdSnsrBElecFailr_C "fault class per DFC / Fault class for check DFC_VehVSpdSnsrBElecFailr" VALUE 0x804D94DD Val_Wu8 30.00 DFES_OneToOne 0.00 30.00 FORMAT "%5.2" EXTENDED_LIMITS 0.00 255.0 /end CHARACTERISTIC
/begin CHARACTERISTIC DFES_Cls.DFC_ClthMax_C "fault class per DFC / Fault class for check DFC_ClthMax" VALUE 0x804D94DE Val_Wu8 30.00 DFES_OneToOne 0.00 30.00 FORMAT "%5.2" EXTENDED_LIMITS 0.00 255.0 /end CHARACTERISTIC
/begin CHARACTERISTIC DFES_Cls.DFC_IgnClPs_DevComErr_C "fault class per DFC / Fault class for check DFC_IgnClPs_DevComErr" VALUE 0x804D94DF Val_Wu8 30.00 DFES_OneToOne 0.00 30.00 FORMAT "%5.2" EXTENDED_LIMITS 0.00 255.0 /end CHARACTERISTIC
/begin CHARACTERISTIC DFES_Cls.DFC_IgnClPs_LineOl_0_C "fault class per DFC / Fault class for check DFC_IgnClPs_LineOl_0" VALUE 0x804D94E0 Val_Wu8 30.00 DFES_OneToOne 0.00 30.00 FORMAT "%5.2" EXTENDED_LIMITS 0.00 255.0 /end CHARACTERISTIC
/begin CHARACTERISTIC DFES_Cls.DFC_IgnClPs_LineOl_1_C "fault class per DFC / Fault class for check DFC_IgnClPs_LineOl_1" VALUE 0x804D94E1 Val_Wu8 30.00 DFES_OneToOne 0.00 30.00 FORMAT "%5.2" EXTENDED_LIMITS 0.00 255.0 /end CHARACTERISTIC
/begin CHARACTERISTIC DFES_Cls.DFC_IgnClPs_LineOl_2_C "fault class per DFC / Fault class for check DFC_IgnClPs_LineOl_2" VALUE 0x804D94E2 Val_Wu8 30.00 DFES_OneToOne 0.00 30.00 FORMAT "%5.2" EXTENDED_LIMITS 0.00 255.0 /end CHARACTERISTIC
/begin CHARACTERISTIC DFES_Cls.DFC_IgnClPs_LineOl_3_C "fault class per DFC / Fault class for check DFC_IgnClPs_LineOl_3" VALUE 0x804D94E3 Val_Wu8 30.00 DFES_OneToOne 0.00 30.00 FORMAT "%5.2" EXTENDED_LIMITS 0.00 255.0 /end CHARACTERISTIC
/begin CHARACTERISTIC DFES_Cls.DFC_IgnClPs_LineScb_0_C "fault class per DFC / Fault class for check DFC_IgnClPs_LineScb_0" VALUE 0x804D94E4 Val_Wu8 30.00 DFES_OneToOne 0.00 30.00 FORMAT "%5.2" EXTENDED_LIMITS 0.00 255.0 /end CHARACTERISTIC
/begin CHARACTERISTIC DFES_Cls.DFC_IgnClPs_LineScb_1_C "fault class per DFC / Fault class for check DFC_IgnClPs_LineScb_1" VALUE 0x804D94E5 Val_Wu8 30.00 DFES_OneToOne 0.00 30.00 FORMAT "%5.2" EXTENDED_LIMITS 0.00 255.0 /end CHARACTERISTIC
/begin CHARACTERISTIC DFES_Cls.DFC_IgnClPs_LineScb_2_C "fault class per DFC / Fault class for check DFC_IgnClPs_LineScb_2" VALUE 0x804D94E6 Val_Wu8 30.00 DFES_OneToOne 0.00 30.00 FORMAT "%5.2" EXTENDED_LIMITS 0.00 255.0 /end CHARACTERISTIC
/begin CHARACTERISTIC DFES_Cls.DFC_IgnClPs_LineScb_3_C "fault class per DFC / Fault class for check DFC_IgnClPs_LineScb_3" VALUE 0x804D94E7 Val_Wu8 30.00 DFES_OneToOne 0.00 30.00 FORMAT "%5.2" EXTENDED_LIMITS 0.00 255.0 /end CHARACTERISTIC
/begin CHARACTERISTIC DFES_Cls.DFC_IgnClPs_LineScg_0_C "fault class per DFC / Fault class for check DFC_IgnClPs_LineScg_0" VALUE 0x804D94E8 Val_Wu8 30.00 DFES_OneToOne 0.00 30.00 FORMAT "%5.2" EXTENDED_LIMITS 0.00 255.0 /end CHARACTERISTIC
/begin CHARACTERISTIC DFES_Cls.DFC_IgnClPs_LineScg_1_C "fault class per DFC / Fault class for check DFC_IgnClPs_LineScg_1" VALUE 0x804D94E9 Val_Wu8 30.00 DFES_OneToOne 0.00 30.00 FORMAT "%5.2" EXTENDED_LIMITS 0.00 255.0 /end CHARACTERISTIC
/begin CHARACTERISTIC DFES_Cls.DFC_IgnClPs_LineScg_2_C "fault class per DFC / Fault class for check DFC_IgnClPs_LineScg_2" VALUE 0x804D94EA Val_Wu8 30.00 DFES_OneToOne 0.00 30.00 FORMAT "%5.2" EXTENDED_LIMITS 0.00 255.0 /end CHARACTERISTIC
/begin CHARACTERISTIC DFES_Cls.DFC_IgnClPs_LineScg_3_C "fault class per DFC / Fault class for check DFC_IgnClPs_LineScg_3" VALUE 0x804D94EB Val_Wu8 30.00 DFES_OneToOne 0.00 30.00 FORMAT "%5.2" EXTENDED_LIMITS 0.00 255.0 /end CHARACTERISTIC
/begin CHARACTERISTIC DFES_Cls.DFC_KRVEKOEVAB_C "fault class per DFC / Fault class for check DFC_KRVEKOEVAB" VALUE 0x804D94EC Val_Wu8 30.00 DFES_OneToOne 0.00 30.00 FORMAT "%5.2" EXTENDED_LIMITS 0.00 255.0 /end CHARACTERISTIC
/begin CHARACTERISTIC DFES_Cls.DFC_KRVEKOEVAB0_C "fault class per DFC / Fault class for check DFC_KRVEKOEVAB0" VALUE 0x804D94ED Val_Wu8 30.00 DFES_OneToOne 0.00 30.00 FORMAT "%5.2" EXTENDED_LIMITS 0.00 255.0 /end CHARACTERISTIC
/begin CHARACTERISTIC DFES_Cls.DFC_KRVEKOEVAB1_C "fault class per DFC / Fault class for check DFC_KRVEKOEVAB1" VALUE 0x804D94EE Val_Wu8 30.00 DFES_OneToOne 0.00 30.00 FORMAT "%5.2" EXTENDED_LIMITS 0.00 255.0 /end CHARACTERISTIC
/begin CHARACTERISTIC DFES_Cls.DFC_KRVEKOEVAB2_C "fault class per DFC / Fault class for check DFC_KRVEKOEVAB2" VALUE 0x804D94EF Val_Wu8 30.00 DFES_OneToOne 0.00 30.00 FORMAT "%5.2" EXTENDED_LIMITS 0.00 255.0 /end CHARACTERISTIC
/begin CHARACTERISTIC DFES_Cls.DFC_KRVEKOEVAB3_C "fault class per DFC / Fault class for check DFC_KRVEKOEVAB3" VALUE 0x804D94F0 Val_Wu8 30.00 DFES_OneToOne 0.00 30.00 FORMAT "%5.2" EXTENDED_LIMITS 0.00 255.0 /end CHARACTERISTIC
/begin CHARACTERISTIC DFES_Cls.DFC_UegoSigEcuAsicS1B1_C "fault class per DFC / Fault class for check DFC_UegoSigEcuAsicS1B1" VALUE 0x804D94F1 Val_Wu8 30.00 DFES_OneToOne 0.00 30.00 FORMAT "%5.2" EXTENDED_LIMITS 0.00 255.0 /end CHARACTERISTIC
/begin CHARACTERISTIC DFES_Cls.DFC_UegoSigEcuComS1B1_C "fault class per DFC / Fault class for check DFC_UegoSigEcuComS1B1" VALUE 0x804D94F2 Val_Wu8 30.00 DFES_OneToOne 0.00 30.00 FORMAT "%5.2" EXTENDED_LIMITS 0.00 255.0 /end CHARACTERISTIC
/begin CHARACTERISTIC DFES_Cls.DFC_UegoSigSnsrS1B1_C "fault class per DFC / Fault class for check DFC_UegoSigSnsrS1B1" VALUE 0x804D94F3 Val_Wu8 30.00 DFES_OneToOne 0.00 30.00 FORMAT "%5.2" EXTENDED_LIMITS 0.00 255.0 /end CHARACTERISTIC
/begin CHARACTERISTIC DFES_Cls.DFC_UegoSigWireOlApesS1B1_C "fault class per DFC / Fault class for check DFC_UegoSigWireOlApesS1B1" VALUE 0x804D94F4 Val_Wu8 30.00 DFES_OneToOne 0.00 30.00 FORMAT "%5.2" EXTENDED_LIMITS 0.00 255.0 /end CHARACTERISTIC
/begin CHARACTERISTIC DFES_Cls.DFC_UegoSigWireOlIpeS1B1_C "fault class per DFC / Fault class for check DFC_UegoSigWireOlIpeS1B1" VALUE 0x804D94F5 Val_Wu8 30.00 DFES_OneToOne 0.00 30.00 FORMAT "%5.2" EXTENDED_LIMITS 0.00 255.0 /end CHARACTERISTIC
/begin CHARACTERISTIC DFES_Cls.DFC_UegoSigWireOlReS1B1_C "fault class per DFC / Fault class for check DFC_UegoSigWireOlReS1B1" VALUE 0x804D94F6 Val_Wu8 30.00 DFES_OneToOne 0.00 30.00 FORMAT "%5.2" EXTENDED_LIMITS 0.00 255.0 /end CHARACTERISTIC
/begin CHARACTERISTIC DFES_Cls.DFC_UegoSigWireRCmpS1B1_C "fault class per DFC / Fault class for check DFC_UegoSigWireRCmpS1B1" VALUE 0x804D94F7 Val_Wu8 30.00 DFES_OneToOne 0.00 30.00 FORMAT "%5.2" EXTENDED_LIMITS 0.00 255.0 /end CHARACTERISTIC
/begin CHARACTERISTIC DFES_Cls.DFC_UegoSigWireScbS1B1_C "fault class per DFC / Fault class for check DFC_UegoSigWireScbS1B1" VALUE 0x804D94F8 Val_Wu8 30.00 DFES_OneToOne 0.00 30.00 FORMAT "%5.2" EXTENDED_LIMITS 0.00 255.0 /end CHARACTERISTIC
/begin CHARACTERISTIC DFES_Cls.DFC_UegoSigWireScgS1B1_C "fault class per DFC / Fault class for check DFC_UegoSigWireScgS1B1" VALUE 0x804D94F9 Val_Wu8 30.00 DFES_OneToOne 0.00 30.00 FORMAT "%5.2" EXTENDED_LIMITS 0.00 255.0 /end CHARACTERISTIC
/begin CHARACTERISTIC DFES_Cls.DFC_AfsPhyRngHiB1_C "fault class per DFC / Fault class for check DFC_AfsPhyRngHiB1" VALUE 0x804D94FA Val_Wu8 30.00 DFES_OneToOne 0.00 30.00 FORMAT "%5.2" EXTENDED_LIMITS 0.00 255.0 /end CHARACTERISTIC
/begin CHARACTERISTIC DFES_Cls.DFC_AfsPhyRngLoB1_C "fault class per DFC / Fault class for check DFC_AfsPhyRngLoB1" VALUE 0x804D94FB Val_Wu8 30.00 DFES_OneToOne 0.00 30.00 FORMAT "%5.2" EXTENDED_LIMITS 0.00 255.0 /end CHARACTERISTIC
/begin CHARACTERISTIC DFES_Cls.DFC_AirCCmprOL_C "fault class per DFC / Fault class for check DFC_AirCCmprOL" VALUE 0x804D94FC Val_Wu8 30.00 DFES_OneToOne 0.00 30.00 FORMAT "%5.2" EXTENDED_LIMITS 0.00 255.0 /end CHARACTERISTIC
/begin CHARACTERISTIC DFES_Cls.DFC_AirCCmprOvrTemp_C "fault class per DFC / Fault class for check DFC_AirCCmprOvrTemp" VALUE 0x804D94FD Val_Wu8 30.00 DFES_OneToOne 0.00 30.00 FORMAT "%5.2" EXTENDED_LIMITS 0.00 255.0 /end CHARACTERISTIC
/begin CHARACTERISTIC DFES_Cls.DFC_AirCCmprSCB_C "fault class per DFC / Fault class for check DFC_AirCCmprSCB" VALUE 0x804D94FE Val_Wu8 30.00 DFES_OneToOne 0.00 30.00 FORMAT "%5.2" EXTENDED_LIMITS 0.00 255.0 /end CHARACTERISTIC
/begin CHARACTERISTIC DFES_Cls.DFC_AirCCmprSCG_C "fault class per DFC / Fault class for check DFC_AirCCmprSCG" VALUE 0x804D94FF Val_Wu8 30.00 DFES_OneToOne 0.00 30.00 FORMAT "%5.2" EXTENDED_LIMITS 0.00 255.0 /end CHARACTERISTIC
/begin CHARACTERISTIC DFES_Cls.DFC_AltErr_C "fault class per DFC / Fault class for check DFC_AltErr" VALUE 0x804D9500 Val_Wu8 30.00 DFES_OneToOne 0.00 30.00 FORMAT "%5.2" EXTENDED_LIMITS 0.00 255.0 /end CHARACTERISTIC
/begin CHARACTERISTIC DFES_Cls.DFC_BattUSRCMax_C "fault class per DFC / Fault class for check DFC_BattUSRCMax" VALUE 0x804D9501 Val_Wu8 30.00 DFES_OneToOne 0.00 30.00 FORMAT "%5.2" EXTENDED_LIMITS 0.00 255.0 /end CHARACTERISTIC
/begin CHARACTERISTIC DFES_Cls.DFC_BattUSRCMin_C "fault class per DFC / Fault class for check DFC_BattUSRCMin" VALUE 0x804D9502 Val_Wu8 30.00 DFES_OneToOne 0.00 30.00 FORMAT "%5.2" EXTENDED_LIMITS 0.00 255.0 /end CHARACTERISTIC
/begin CHARACTERISTIC DFES_Cls.DFC_ComChksTCU1_C "fault class per DFC / Fault class for check DFC_ComChksTCU1" VALUE 0x804D9503 Val_Wu8 30.00 DFES_OneToOne 0.00 30.00 FORMAT "%5.2" EXTENDED_LIMITS 0.00 255.0 /end CHARACTERISTIC
/begin CHARACTERISTIC DFES_Cls.DFC_ComChksTCU11_C "fault class per DFC / Fault class for check DFC_ComChksTCU11" VALUE 0x804D9504 Val_Wu8 30.00 DFES_OneToOne 0.00 30.00 FORMAT "%5.2" EXTENDED_LIMITS 0.00 255.0 /end CHARACTERISTIC
/begin CHARACTERISTIC DFES_Cls.DFC_ComChksTCU12_C "fault class per DFC / Fault class for check DFC_ComChksTCU12" VALUE 0x804D9505 Val_Wu8 30.00 DFES_OneToOne 0.00 30.00 FORMAT "%5.2" EXTENDED_LIMITS 0.00 255.0 /end CHARACTERISTIC
/begin CHARACTERISTIC DFES_Cls.DFC_ComChksTCU13_C "fault class per DFC / Fault class for check DFC_ComChksTCU13" VALUE 0x804D9506 Val_Wu8 30.00 DFES_OneToOne 0.00 30.00 FORMAT "%5.2" EXTENDED_LIMITS 0.00 255.0 /end CHARACTERISTIC
/begin CHARACTERISTIC DFES_Cls.DFC_ComChksTCU2_C "fault class per DFC / Fault class for check DFC_ComChksTCU2" VALUE 0x804D9507 Val_Wu8 30.00 DFES_OneToOne 0.00 30.00 FORMAT "%5.2" EXTENDED_LIMITS 0.00 255.0 /end CHARACTERISTIC
/begin CHARACTERISTIC DFES_Cls.DFC_ComChksTCU3_C "fault class per DFC / Fault class for check DFC_ComChksTCU3" VALUE 0x804D9508 Val_Wu8 30.00 DFES_OneToOne 0.00 30.00 FORMAT "%5.2" EXTENDED_LIMITS 0.00 255.0 /end CHARACTERISTIC
/begin CHARACTERISTIC DFES_Cls.DFC_ComChksTCU4_C "fault class per DFC / Fault class for check DFC_ComChksTCU4" VALUE 0x804D9509 Val_Wu8 30.00 DFES_OneToOne 0.00 30.00 FORMAT "%5.2" EXTENDED_LIMITS 0.00 255.0 /end CHARACTERISTIC
/begin CHARACTERISTIC DFES_Cls.DFC_ComCntTCU1_C "fault class per DFC / Fault class for check DFC_ComCntTCU1" VALUE 0x804D950A Val_Wu8 30.00 DFES_OneToOne 0.00 30.00 FORMAT "%5.2" EXTENDED_LIMITS 0.00 255.0 /end CHARACTERISTIC
/begin CHARACTERISTIC DFES_Cls.DFC_ComCntTCU11_C "fault class per DFC / Fault class for check DFC_ComCntTCU11" VALUE 0x804D950B Val_Wu8 30.00 DFES_OneToOne 0.00 30.00 FORMAT "%5.2" EXTENDED_LIMITS 0.00 255.0 /end CHARACTERISTIC
/begin CHARACTERISTIC DFES_Cls.DFC_ComCntTCU12_C "fault class per DFC / Fault class for check DFC_ComCntTCU12" VALUE 0x804D950C Val_Wu8 30.00 DFES_OneToOne 0.00 30.00 FORMAT "%5.2" EXTENDED_LIMITS 0.00 255.0 /end CHARACTERISTIC
/begin CHARACTERISTIC DFES_Cls.DFC_ComCntTCU13_C "fault class per DFC / Fault class for check DFC_ComCntTCU13" VALUE 0x804D950D Val_Wu8 30.00 DFES_OneToOne 0.00 30.00 FORMAT "%5.2" EXTENDED_LIMITS 0.00 255.0 /end CHARACTERISTIC
/begin CHARACTERISTIC DFES_Cls.DFC_ComCntTCU2_C "fault class per DFC / Fault class for check DFC_ComCntTCU2" VALUE 0x804D950E Val_Wu8 30.00 DFES_OneToOne 0.00 30.00 FORMAT "%5.2" EXTENDED_LIMITS 0.00 255.0 /end CHARACTERISTIC
/begin CHARACTERISTIC DFES_Cls.DFC_ComCntTCU3_C "fault class per DFC / Fault class for check DFC_ComCntTCU3" VALUE 0x804D950F Val_Wu8 30.00 DFES_OneToOne 0.00 30.00 FORMAT "%5.2" EXTENDED_LIMITS 0.00 255.0 /end CHARACTERISTIC
/begin CHARACTERISTIC DFES_Cls.DFC_ComCntTCU4_C "fault class per DFC / Fault class for check DFC_ComCntTCU4" VALUE 0x804D9510 Val_Wu8 30.00 DFES_OneToOne 0.00 30.00 FORMAT "%5.2" EXTENDED_LIMITS 0.00 255.0 /end CHARACTERISTIC
/begin CHARACTERISTIC DFES_Cls.DFC_ComTOutTCU01_C "fault class per DFC / Fault class for check DFC_ComTOutTCU01" VALUE 0x804D9511 Val_Wu8 30.00 DFES_OneToOne 0.00 30.00 FORMAT "%5.2" EXTENDED_LIMITS 0.00 255.0 /end CHARACTERISTIC
/begin CHARACTERISTIC DFES_Cls.DFC_ComTOutTCU02_C "fault class per DFC / Fault class for check DFC_ComTOutTCU02" VALUE 0x804D9512 Val_Wu8 30.00 DFES_OneToOne 0.00 30.00 FORMAT "%5.2" EXTENDED_LIMITS 0.00 255.0 /end CHARACTERISTIC
/begin CHARACTERISTIC DFES_Cls.DFC_ComTOutTCU1_C "fault class per DFC / Fault class for check DFC_ComTOutTCU1" VALUE 0x804D9513 Val_Wu8 30.00 DFES_OneToOne 0.00 30.00 FORMAT "%5.2" EXTENDED_LIMITS 0.00 255.0 /end CHARACTERISTIC
/begin CHARACTERISTIC DFES_Cls.DFC_ComTOutTCU11_C "fault class per DFC / Fault class for check DFC_ComTOutTCU11" VALUE 0x804D9514 Val_Wu8 30.00 DFES_OneToOne 0.00 30.00 FORMAT "%5.2" EXTENDED_LIMITS 0.00 255.0 /end CHARACTERISTIC
/begin CHARACTERISTIC DFES_Cls.DFC_ComTOutTCU12_C "fault class per DFC / Fault class for check DFC_ComTOutTCU12" VALUE 0x804D9515 Val_Wu8 30.00 DFES_OneToOne 0.00 30.00 FORMAT "%5.2" EXTENDED_LIMITS 0.00 255.0 /end CHARACTERISTIC
/begin CHARACTERISTIC DFES_Cls.DFC_ComTOutTCU13_C "fault class per DFC / Fault class for check DFC_ComTOutTCU13" VALUE 0x804D9516 Val_Wu8 30.00 DFES_OneToOne 0.00 30.00 FORMAT "%5.2" EXTENDED_LIMITS 0.00 255.0 /end CHARACTERISTIC
/begin CHARACTERISTIC DFES_Cls.DFC_ComTOutTCU14_C "fault class per DFC / Fault class for check DFC_ComTOutTCU14" VALUE 0x804D9517 Val_Wu8 30.00 DFES_OneToOne 0.00 30.00 FORMAT "%5.2" EXTENDED_LIMITS 0.00 255.0 /end CHARACTERISTIC
/begin CHARACTERISTIC DFES_Cls.DFC_ComTOutTCU2_C "fault class per DFC / Fault class for check DFC_ComTOutTCU2" VALUE 0x804D9518 Val_Wu8 30.00 DFES_OneToOne 0.00 30.00 FORMAT "%5.2" EXTENDED_LIMITS 0.00 255.0 /end CHARACTERISTIC
/begin CHARACTERISTIC DFES_Cls.DFC_ComTOutTCU3_C "fault class per DFC / Fault class for check DFC_ComTOutTCU3" VALUE 0x804D9519 Val_Wu8 30.00 DFES_OneToOne 0.00 30.00 FORMAT "%5.2" EXTENDED_LIMITS 0.00 255.0 /end CHARACTERISTIC
/begin CHARACTERISTIC DFES_Cls.DFC_ComTOutTCU4_C "fault class per DFC / Fault class for check DFC_ComTOutTCU4" VALUE 0x804D951A Val_Wu8 30.00 DFES_OneToOne 0.00 30.00 FORMAT "%5.2" EXTENDED_LIMITS 0.00 255.0 /end CHARACTERISTIC
/begin CHARACTERISTIC DFES_Cls.DFC_DevLibBattUHi_C "fault class per DFC / Fault class for check DFC_DevLibBattUHi" VALUE 0x804D951B Val_Wu8 30.00 DFES_OneToOne 0.00 30.00 FORMAT "%5.2" EXTENDED_LIMITS 0.00 255.0 /end CHARACTERISTIC
/begin CHARACTERISTIC DFES_Cls.DFC_DevLibBattULo_C "fault class per DFC / Fault class for check DFC_DevLibBattULo" VALUE 0x804D951C Val_Wu8 30.00 DFES_OneToOne 0.00 30.00 FORMAT "%5.2" EXTENDED_LIMITS 0.00 255.0 /end CHARACTERISTIC
/begin CHARACTERISTIC DFES_Cls.DFC_EGRVlvFailSafeActv_C "fault class per DFC / Fault class for check DFC_EGRVlvFailSafeActv" VALUE 0x804D951D Val_Wu8 30.00 DFES_OneToOne 0.00 30.00 FORMAT "%5.2" EXTENDED_LIMITS 0.00 255.0 /end CHARACTERISTIC
/begin CHARACTERISTIC DFES_Cls.DFC_EGRVlvGovDvtCld_C "fault class per DFC / Fault class for check DFC_EGRVlvGovDvtCld" VALUE 0x804D951E Val_Wu8 30.00 DFES_OneToOne 0.00 30.00 FORMAT "%5.2" EXTENDED_LIMITS 0.00 255.0 /end CHARACTERISTIC
/begin CHARACTERISTIC DFES_Cls.DFC_EGRVlvPhysSRCMax_C "fault class per DFC / Fault class for check DFC_EGRVlvPhysSRCMax" VALUE 0x804D951F Val_Wu8 30.00 DFES_OneToOne 0.00 30.00 FORMAT "%5.2" EXTENDED_LIMITS 0.00 255.0 /end CHARACTERISTIC
/begin CHARACTERISTIC DFES_Cls.DFC_EGRVlvPhysSRCMin_C "fault class per DFC / Fault class for check DFC_EGRVlvPhysSRCMin" VALUE 0x804D9520 Val_Wu8 30.00 DFES_OneToOne 0.00 30.00 FORMAT "%5.2" EXTENDED_LIMITS 0.00 255.0 /end CHARACTERISTIC
/begin CHARACTERISTIC DFES_Cls.DFC_FanDIOOL_0_C "fault class per DFC / Fault class for check DFC_FanDIOOL_0" VALUE 0x804D9521 Val_Wu8 30.00 DFES_OneToOne 0.00 30.00 FORMAT "%5.2" EXTENDED_LIMITS 0.00 255.0 /end CHARACTERISTIC
/begin CHARACTERISTIC DFES_Cls.DFC_FanDIOOL_1_C "fault class per DFC / Fault class for check DFC_FanDIOOL_1" VALUE 0x804D9522 Val_Wu8 30.00 DFES_OneToOne 0.00 30.00 FORMAT "%5.2" EXTENDED_LIMITS 0.00 255.0 /end CHARACTERISTIC
/begin CHARACTERISTIC DFES_Cls.DFC_FanDIOOvrTemp_0_C "fault class per DFC / Fault class for check DFC_FanDIOOvrTemp_0" VALUE 0x804D9523 Val_Wu8 30.00 DFES_OneToOne 0.00 30.00 FORMAT "%5.2" EXTENDED_LIMITS 0.00 255.0 /end CHARACTERISTIC
/begin CHARACTERISTIC DFES_Cls.DFC_FanDIOOvrTemp_1_C "fault class per DFC / Fault class for check DFC_FanDIOOvrTemp_1" VALUE 0x804D9524 Val_Wu8 30.00 DFES_OneToOne 0.00 30.00 FORMAT "%5.2" EXTENDED_LIMITS 0.00 255.0 /end CHARACTERISTIC
/begin CHARACTERISTIC DFES_Cls.DFC_FanDIOSCB_0_C "fault class per DFC / Fault class for check DFC_FanDIOSCB_0" VALUE 0x804D9525 Val_Wu8 30.00 DFES_OneToOne 0.00 30.00 FORMAT "%5.2" EXTENDED_LIMITS 0.00 255.0 /end CHARACTERISTIC
/begin CHARACTERISTIC DFES_Cls.DFC_FanDIOSCB_1_C "fault class per DFC / Fault class for check DFC_FanDIOSCB_1" VALUE 0x804D9526 Val_Wu8 30.00 DFES_OneToOne 0.00 30.00 FORMAT "%5.2" EXTENDED_LIMITS 0.00 255.0 /end CHARACTERISTIC
/begin CHARACTERISTIC DFES_Cls.DFC_FanDIOSCG_0_C "fault class per DFC / Fault class for check DFC_FanDIOSCG_0" VALUE 0x804D9527 Val_Wu8 30.00 DFES_OneToOne 0.00 30.00 FORMAT "%5.2" EXTENDED_LIMITS 0.00 255.0 /end CHARACTERISTIC
/begin CHARACTERISTIC DFES_Cls.DFC_FanDIOSCG_1_C "fault class per DFC / Fault class for check DFC_FanDIOSCG_1" VALUE 0x804D9528 Val_Wu8 30.00 DFES_OneToOne 0.00 30.00 FORMAT "%5.2" EXTENDED_LIMITS 0.00 255.0 /end CHARACTERISTIC
/begin CHARACTERISTIC DFES_Cls.DFC_MRlyDcOL_C "fault class per DFC / Fault class for check DFC_MRlyDcOL" VALUE 0x804D9529 Val_Wu8 30.00 DFES_OneToOne 0.00 30.00 FORMAT "%5.2" EXTENDED_LIMITS 0.00 255.0 /end CHARACTERISTIC
/begin CHARACTERISTIC DFES_Cls.DFC_MRlyDcSCB_C "fault class per DFC / Fault class for check DFC_MRlyDcSCB" VALUE 0x804D952A Val_Wu8 30.00 DFES_OneToOne 0.00 30.00 FORMAT "%5.2" EXTENDED_LIMITS 0.00 255.0 /end CHARACTERISTIC
/begin CHARACTERISTIC DFES_Cls.DFC_MRlyDcSCG_C "fault class per DFC / Fault class for check DFC_MRlyDcSCG" VALUE 0x804D952B Val_Wu8 30.00 DFES_OneToOne 0.00 30.00 FORMAT "%5.2" EXTENDED_LIMITS 0.00 255.0 /end CHARACTERISTIC
/begin CHARACTERISTIC DFES_Cls.DFC_PSPOL_C "fault class per DFC / Fault class for check DFC_PSPOL" VALUE 0x804D952C Val_Wu8 30.00 DFES_OneToOne 0.00 30.00 FORMAT "%5.2" EXTENDED_LIMITS 0.00 255.0 /end CHARACTERISTIC
/begin CHARACTERISTIC DFES_Cls.DFC_PSPOvrTemp_C "fault class per DFC / Fault class for check DFC_PSPOvrTemp" VALUE 0x804D952D Val_Wu8 30.00 DFES_OneToOne 0.00 30.00 FORMAT "%5.2" EXTENDED_LIMITS 0.00 255.0 /end CHARACTERISTIC
/begin CHARACTERISTIC DFES_Cls.DFC_PSPSCB_C "fault class per DFC / Fault class for check DFC_PSPSCB" VALUE 0x804D952E Val_Wu8 30.00 DFES_OneToOne 0.00 30.00 FORMAT "%5.2" EXTENDED_LIMITS 0.00 255.0 /end CHARACTERISTIC
/begin CHARACTERISTIC DFES_Cls.DFC_PSPSCG_C "fault class per DFC / Fault class for check DFC_PSPSCG" VALUE 0x804D952F Val_Wu8 30.00 DFES_OneToOne 0.00 30.00 FORMAT "%5.2" EXTENDED_LIMITS 0.00 255.0 /end CHARACTERISTIC
/begin CHARACTERISTIC DFES_Cls.DFC_T50Err_C "fault class per DFC / Fault class for check DFC_T50Err" VALUE 0x804D9530 Val_Wu8 30.00 DFES_OneToOne 0.00 30.00 FORMAT "%5.2" EXTENDED_LIMITS 0.00 255.0 /end CHARACTERISTIC
/begin CHARACTERISTIC DFES_Cls.DFC_ThrVlvLoBattB1_C "fault class per DFC / Fault class for check DFC_ThrVlvLoBattB1" VALUE 0x804D9531 Val_Wu8 30.00 DFES_OneToOne 0.00 30.00 FORMAT "%5.2" EXTENDED_LIMITS 0.00 255.0 /end CHARACTERISTIC
/begin CHARACTERISTIC DFES_Cls.DFC_UegoSigOperPlausS1B1_C "fault class per DFC / Fault class for check DFC_UegoSigOperPlausS1B1" VALUE 0x804D9532 Val_Wu8 30.00 DFES_OneToOne 0.00 30.00 FORMAT "%5.2" EXTENDED_LIMITS 0.00 255.0 /end CHARACTERISTIC
/begin CHARACTERISTIC DFES_Cls.DFC_VehVPhysRngHi_C "fault class per DFC / Fault class for check DFC_VehVPhysRngHi" VALUE 0x804D9533 Val_Wu8 30.00 DFES_OneToOne 0.00 30.00 FORMAT "%5.2" EXTENDED_LIMITS 0.00 255.0 /end CHARACTERISTIC
/begin CHARACTERISTIC DFES_Cls.DFC_VehVSclOutOL_C "fault class per DFC / Fault class for check DFC_VehVSclOutOL" VALUE 0x804D9534 Val_Wu8 30.00 DFES_OneToOne 0.00 30.00 FORMAT "%5.2" EXTENDED_LIMITS 0.00 255.0 /end CHARACTERISTIC
/begin CHARACTERISTIC DFES_Cls.DFC_VehVSclOutOT_C "fault class per DFC / Fault class for check DFC_VehVSclOutOT" VALUE 0x804D9535 Val_Wu8 30.00 DFES_OneToOne 0.00 30.00 FORMAT "%5.2" EXTENDED_LIMITS 0.00 255.0 /end CHARACTERISTIC
/begin CHARACTERISTIC DFES_Cls.DFC_VehVSclOutSCB_C "fault class per DFC / Fault class for check DFC_VehVSclOutSCB" VALUE 0x804D9536 Val_Wu8 30.00 DFES_OneToOne 0.00 30.00 FORMAT "%5.2" EXTENDED_LIMITS 0.00 255.0 /end CHARACTERISTIC
/begin CHARACTERISTIC DFES_Cls.DFC_VehVSclOutSCG_C "fault class per DFC / Fault class for check DFC_VehVSclOutSCG" VALUE 0x804D9537 Val_Wu8 30.00 DFES_OneToOne 0.00 30.00 FORMAT "%5.2" EXTENDED_LIMITS 0.00 255.0 /end CHARACTERISTIC
/begin CHARACTERISTIC DFES_Cls.DFC_VehVSigFL_C "fault class per DFC / Fault class for check DFC_VehVSigFL" VALUE 0x804D9538 Val_Wu8 30.00 DFES_OneToOne 0.00 30.00 FORMAT "%5.2" EXTENDED_LIMITS 0.00 255.0 /end CHARACTERISTIC
/begin CHARACTERISTIC DFES_Cls.DFC_VehVSigFR_C "fault class per DFC / Fault class for check DFC_VehVSigFR" VALUE 0x804D9539 Val_Wu8 30.00 DFES_OneToOne 0.00 30.00 FORMAT "%5.2" EXTENDED_LIMITS 0.00 255.0 /end CHARACTERISTIC
/begin CHARACTERISTIC DFES_Cls.DFC_VehVSigRL_C "fault class per DFC / Fault class for check DFC_VehVSigRL" VALUE 0x804D953A Val_Wu8 30.00 DFES_OneToOne 0.00 30.00 FORMAT "%5.2" EXTENDED_LIMITS 0.00 255.0 /end CHARACTERISTIC
/begin CHARACTERISTIC DFES_Cls.DFC_VehVSigRR_C "fault class per DFC / Fault class for check DFC_VehVSigRR" VALUE 0x804D953B Val_Wu8 30.00 DFES_OneToOne 0.00 30.00 FORMAT "%5.2" EXTENDED_LIMITS 0.00 255.0 /end CHARACTERISTIC
/begin CHARACTERISTIC DFES_Cls.DFC_VehVSnsrARngHi_C "fault class per DFC / Fault class for check DFC_VehVSnsrARngHi" VALUE 0x804D953C Val_Wu8 30.00 DFES_OneToOne 0.00 30.00 FORMAT "%5.2" EXTENDED_LIMITS 0.00 255.0 /end CHARACTERISTIC
/begin CHARACTERISTIC DFES_Cls.DFC_VehVSnsrBRngHi_C "fault class per DFC / Fault class for check DFC_VehVSnsrBRngHi" VALUE 0x804D953D Val_Wu8 30.00 DFES_OneToOne 0.00 30.00 FORMAT "%5.2" EXTENDED_LIMITS 0.00 255.0 /end CHARACTERISTIC
/begin CHARACTERISTIC DFES_Cls.DFC_VehVSpdRtyDiag_C "fault class per DFC / Fault class for check DFC_VehVSpdRtyDiag" VALUE 0x804D953E Val_Wu8 30.00 DFES_OneToOne 0.00 30.00 FORMAT "%5.2" EXTENDED_LIMITS 0.00 255.0 /end CHARACTERISTIC
/begin CHARACTERISTIC DFES_Cls.DFC_DHFHD_C "fault class per DFC / Fault class for check DFC_DHFHD" VALUE 0x804D953F Val_Wu8 30.00 DFES_OneToOne 0.00 30.00 FORMAT "%5.2" EXTENDED_LIMITS 0.00 255.0 /end CHARACTERISTIC
/begin CHARACTERISTIC DFES_Cls.DFC_InjVlv_DI_DcDc_C "fault class per DFC / Fault class for check DFC_InjVlv_DI_DcDc" VALUE 0x804D9540 Val_Wu8 30.00 DFES_OneToOne 0.00 30.00 FORMAT "%5.2" EXTENDED_LIMITS 0.00 255.0 /end CHARACTERISTIC
/begin CHARACTERISTIC DFES_Cls.DFC_InjVlv_DI_NoLd_0_C "fault class per DFC / Fault class for check DFC_InjVlv_DI_NoLd_0" VALUE 0x804D9541 Val_Wu8 30.00 DFES_OneToOne 0.00 30.00 FORMAT "%5.2" EXTENDED_LIMITS 0.00 255.0 /end CHARACTERISTIC
/begin CHARACTERISTIC DFES_Cls.DFC_InjVlv_DI_NoLd_1_C "fault class per DFC / Fault class for check DFC_InjVlv_DI_NoLd_1" VALUE 0x804D9542 Val_Wu8 30.00 DFES_OneToOne 0.00 30.00 FORMAT "%5.2" EXTENDED_LIMITS 0.00 255.0 /end CHARACTERISTIC
/begin CHARACTERISTIC DFES_Cls.DFC_InjVlv_DI_NoLd_2_C "fault class per DFC / Fault class for check DFC_InjVlv_DI_NoLd_2" VALUE 0x804D9543 Val_Wu8 30.00 DFES_OneToOne 0.00 30.00 FORMAT "%5.2" EXTENDED_LIMITS 0.00 255.0 /end CHARACTERISTIC
/begin CHARACTERISTIC DFES_Cls.DFC_InjVlv_DI_NoLd_3_C "fault class per DFC / Fault class for check DFC_InjVlv_DI_NoLd_3" VALUE 0x804D9544 Val_Wu8 30.00 DFES_OneToOne 0.00 30.00 FORMAT "%5.2" EXTENDED_LIMITS 0.00 255.0 /end CHARACTERISTIC
/begin CHARACTERISTIC DFES_Cls.DFC_InjVlv_DI_ScBnk_0_C "fault class per DFC / Fault class for check DFC_InjVlv_DI_ScBnk_0" VALUE 0x804D9545 Val_Wu8 30.00 DFES_OneToOne 0.00 30.00 FORMAT "%5.2" EXTENDED_LIMITS 0.00 255.0 /end CHARACTERISTIC
/begin CHARACTERISTIC DFES_Cls.DFC_InjVlv_DI_ScBnk_1_C "fault class per DFC / Fault class for check DFC_InjVlv_DI_ScBnk_1" VALUE 0x804D9546 Val_Wu8 30.00 DFES_OneToOne 0.00 30.00 FORMAT "%5.2" EXTENDED_LIMITS 0.00 255.0 /end CHARACTERISTIC
/begin CHARACTERISTIC DFES_Cls.DFC_InjVlv_DI_ScBnk_2_C "fault class per DFC / Fault class for check DFC_InjVlv_DI_ScBnk_2" VALUE 0x804D9547 Val_Wu8 30.00 DFES_OneToOne 0.00 30.00 FORMAT "%5.2" EXTENDED_LIMITS 0.00 255.0 /end CHARACTERISTIC
/begin CHARACTERISTIC DFES_Cls.DFC_InjVlv_DI_ScBnk_3_C "fault class per DFC / Fault class for check DFC_InjVlv_DI_ScBnk_3" VALUE 0x804D9548 Val_Wu8 30.00 DFES_OneToOne 0.00 30.00 FORMAT "%5.2" EXTENDED_LIMITS 0.00 255.0 /end CHARACTERISTIC
/begin CHARACTERISTIC DFES_Cls.DFC_InjVlv_DI_ScCyl_0_C "fault class per DFC / Fault class for check DFC_InjVlv_DI_ScCyl_0" VALUE 0x804D9549 Val_Wu8 30.00 DFES_OneToOne 0.00 30.00 FORMAT "%5.2" EXTENDED_LIMITS 0.00 255.0 /end CHARACTERISTIC
/begin CHARACTERISTIC DFES_Cls.DFC_InjVlv_DI_ScCyl_1_C "fault class per DFC / Fault class for check DFC_InjVlv_DI_ScCyl_1" VALUE 0x804D954A Val_Wu8 30.00 DFES_OneToOne 0.00 30.00 FORMAT "%5.2" EXTENDED_LIMITS 0.00 255.0 /end CHARACTERISTIC
/begin CHARACTERISTIC DFES_Cls.DFC_InjVlv_DI_ScCyl_2_C "fault class per DFC / Fault class for check DFC_InjVlv_DI_ScCyl_2" VALUE 0x804D954B Val_Wu8 30.00 DFES_OneToOne 0.00 30.00 FORMAT "%5.2" EXTENDED_LIMITS 0.00 255.0 /end CHARACTERISTIC
/begin CHARACTERISTIC DFES_Cls.DFC_InjVlv_DI_ScCyl_3_C "fault class per DFC / Fault class for check DFC_InjVlv_DI_ScCyl_3" VALUE 0x804D954C Val_Wu8 30.00 DFES_OneToOne 0.00 30.00 FORMAT "%5.2" EXTENDED_LIMITS 0.00 255.0 /end CHARACTERISTIC
/begin CHARACTERISTIC DFES_Cls.DFC_InjVlv_DI_ScHsLs_0_C "fault class per DFC / Fault class for check DFC_InjVlv_DI_ScHsLs_0" VALUE 0x804D954D Val_Wu8 30.00 DFES_OneToOne 0.00 30.00 FORMAT "%5.2" EXTENDED_LIMITS 0.00 255.0 /end CHARACTERISTIC
/begin CHARACTERISTIC DFES_Cls.DFC_InjVlv_DI_ScHsLs_1_C "fault class per DFC / Fault class for check DFC_InjVlv_DI_ScHsLs_1" VALUE 0x804D954E Val_Wu8 30.00 DFES_OneToOne 0.00 30.00 FORMAT "%5.2" EXTENDED_LIMITS 0.00 255.0 /end CHARACTERISTIC
/begin CHARACTERISTIC DFES_Cls.DFC_InjVlv_DI_ScHsLs_2_C "fault class per DFC / Fault class for check DFC_InjVlv_DI_ScHsLs_2" VALUE 0x804D954F Val_Wu8 30.00 DFES_OneToOne 0.00 30.00 FORMAT "%5.2" EXTENDED_LIMITS 0.00 255.0 /end CHARACTERISTIC
/begin CHARACTERISTIC DFES_Cls.DFC_InjVlv_DI_ScHsLs_3_C "fault class per DFC / Fault class for check DFC_InjVlv_DI_ScHsLs_3" VALUE 0x804D9550 Val_Wu8 30.00 DFES_OneToOne 0.00 30.00 FORMAT "%5.2" EXTENDED_LIMITS 0.00 255.0 /end CHARACTERISTIC
/begin CHARACTERISTIC DFES_Cls.DFC_MfPsDiaOpenLoad1_C "fault class per DFC / Fault class for check DFC_MfPsDiaOpenLoad1" VALUE 0x804D9551 Val_Wu8 30.00 DFES_OneToOne 0.00 30.00 FORMAT "%5.2" EXTENDED_LIMITS 0.00 255.0 /end CHARACTERISTIC
/begin CHARACTERISTIC DFES_Cls.DFC_MfPsDiaScHiS1_C "fault class per DFC / Fault class for check DFC_MfPsDiaScHiS1" VALUE 0x804D9552 Val_Wu8 30.00 DFES_OneToOne 0.00 30.00 FORMAT "%5.2" EXTENDED_LIMITS 0.00 255.0 /end CHARACTERISTIC
/begin CHARACTERISTIC DFES_Cls.DFC_MfPsDiaScHiSLowS1_C "fault class per DFC / Fault class for check DFC_MfPsDiaScHiSLowS1" VALUE 0x804D9553 Val_Wu8 30.00 DFES_OneToOne 0.00 30.00 FORMAT "%5.2" EXTENDED_LIMITS 0.00 255.0 /end CHARACTERISTIC
/begin CHARACTERISTIC DFES_Cls.DFC_MfPsDiaScLowS1_C "fault class per DFC / Fault class for check DFC_MfPsDiaScLowS1" VALUE 0x804D9554 Val_Wu8 30.00 DFES_OneToOne 0.00 30.00 FORMAT "%5.2" EXTENDED_LIMITS 0.00 255.0 /end CHARACTERISTIC
/begin CHARACTERISTIC DFES_Cls.DFC_ACEvpTPhysRngHi_C "fault class per DFC / Fault class for check DFC_ACEvpTPhysRngHi" VALUE 0x804D9555 Val_Wu8 30.00 DFES_OneToOne 0.00 30.00 FORMAT "%5.2" EXTENDED_LIMITS 0.00 255.0 /end CHARACTERISTIC
/begin CHARACTERISTIC DFES_Cls.DFC_ACEvpTPhysRngLo_C "fault class per DFC / Fault class for check DFC_ACEvpTPhysRngLo" VALUE 0x804D9556 Val_Wu8 30.00 DFES_OneToOne 0.00 30.00 FORMAT "%5.2" EXTENDED_LIMITS 0.00 255.0 /end CHARACTERISTIC
/begin CHARACTERISTIC DFES_Cls.DFC_ACEvpTSRCMax_C "fault class per DFC / Fault class for check DFC_ACEvpTSRCMax" VALUE 0x804D9557 Val_Wu8 30.00 DFES_OneToOne 0.00 30.00 FORMAT "%5.2" EXTENDED_LIMITS 0.00 255.0 /end CHARACTERISTIC
/begin CHARACTERISTIC DFES_Cls.DFC_ACEvpTSRCMin_C "fault class per DFC / Fault class for check DFC_ACEvpTSRCMin" VALUE 0x804D9558 Val_Wu8 30.00 DFES_OneToOne 0.00 30.00 FORMAT "%5.2" EXTENDED_LIMITS 0.00 255.0 /end CHARACTERISTIC
/begin CHARACTERISTIC DFES_Cls.DFC_AfsRawSigRngHiB1_C "fault class per DFC / Fault class for check DFC_AfsRawSigRngHiB1" VALUE 0x804D9559 Val_Wu8 30.00 DFES_OneToOne 0.00 30.00 FORMAT "%5.2" EXTENDED_LIMITS 0.00 255.0 /end CHARACTERISTIC
/begin CHARACTERISTIC DFES_Cls.DFC_AfsRawSigRngLoB1_C "fault class per DFC / Fault class for check DFC_AfsRawSigRngLoB1" VALUE 0x804D955A Val_Wu8 30.00 DFES_OneToOne 0.00 30.00 FORMAT "%5.2" EXTENDED_LIMITS 0.00 255.0 /end CHARACTERISTIC
/begin CHARACTERISTIC DFES_Cls.DFC_AfsSnsrErrB1_C "fault class per DFC / Fault class for check DFC_AfsSnsrErrB1" VALUE 0x804D955B Val_Wu8 30.00 DFES_OneToOne 0.00 30.00 FORMAT "%5.2" EXTENDED_LIMITS 0.00 255.0 /end CHARACTERISTIC
/begin CHARACTERISTIC DFES_Cls.DFC_AirCClntPAnaSRCMax_C "fault class per DFC / Fault class for check DFC_AirCClntPAnaSRCMax" VALUE 0x804D955C Val_Wu8 30.00 DFES_OneToOne 0.00 30.00 FORMAT "%5.2" EXTENDED_LIMITS 0.00 255.0 /end CHARACTERISTIC
/begin CHARACTERISTIC DFES_Cls.DFC_AirCClntPAnaSRCMin_C "fault class per DFC / Fault class for check DFC_AirCClntPAnaSRCMin" VALUE 0x804D955D Val_Wu8 30.00 DFES_OneToOne 0.00 30.00 FORMAT "%5.2" EXTENDED_LIMITS 0.00 255.0 /end CHARACTERISTIC
/begin CHARACTERISTIC DFES_Cls.DFC_AirCSwtNpl_C "fault class per DFC / Fault class for check DFC_AirCSwtNpl" VALUE 0x804D955E Val_Wu8 30.00 DFES_OneToOne 0.00 30.00 FORMAT "%5.2" EXTENDED_LIMITS 0.00 255.0 /end CHARACTERISTIC
/begin CHARACTERISTIC DFES_Cls.DFC_AirCSwtSig_C "fault class per DFC / Fault class for check DFC_AirCSwtSig" VALUE 0x804D955F Val_Wu8 30.00 DFES_OneToOne 0.00 30.00 FORMAT "%5.2" EXTENDED_LIMITS 0.00 255.0 /end CHARACTERISTIC
/begin CHARACTERISTIC DFES_Cls.DFC_Brk_C "fault class per DFC / Fault class for check DFC_Brk" VALUE 0x804D9560 Val_Wu8 30.00 DFES_OneToOne 0.00 30.00 FORMAT "%5.2" EXTENDED_LIMITS 0.00 255.0 /end CHARACTERISTIC
/begin CHARACTERISTIC DFES_Cls.DFC_BrkBstSensSCB_C "fault class per DFC / Fault class for check DFC_BrkBstSensSCB" VALUE 0x804D9561 Val_Wu8 30.00 DFES_OneToOne 0.00 30.00 FORMAT "%5.2" EXTENDED_LIMITS 0.00 255.0 /end CHARACTERISTIC
/begin CHARACTERISTIC DFES_Cls.DFC_BrkBstSensSCG_C "fault class per DFC / Fault class for check DFC_BrkBstSensSCG" VALUE 0x804D9562 Val_Wu8 30.00 DFES_OneToOne 0.00 30.00 FORMAT "%5.2" EXTENDED_LIMITS 0.00 255.0 /end CHARACTERISTIC
/begin CHARACTERISTIC DFES_Cls.DFC_BrkSig_C "fault class per DFC / Fault class for check DFC_BrkSig" VALUE 0x804D9563 Val_Wu8 30.00 DFES_OneToOne 0.00 30.00 FORMAT "%5.2" EXTENDED_LIMITS 0.00 255.0 /end CHARACTERISTIC
/begin CHARACTERISTIC DFES_Cls.DFC_ClthSig_C "fault class per DFC / Fault class for check DFC_ClthSig" VALUE 0x804D9564 Val_Wu8 30.00 DFES_OneToOne 0.00 30.00 FORMAT "%5.2" EXTENDED_LIMITS 0.00 255.0 /end CHARACTERISTIC
/begin CHARACTERISTIC DFES_Cls.DFC_EGRVlvCurrLim_C "fault class per DFC / Fault class for check DFC_EGRVlvCurrLim" VALUE 0x804D9565 Val_Wu8 30.00 DFES_OneToOne 0.00 30.00 FORMAT "%5.2" EXTENDED_LIMITS 0.00 255.0 /end CHARACTERISTIC
/begin CHARACTERISTIC DFES_Cls.DFC_EGRVlvOL_C "fault class per DFC / Fault class for check DFC_EGRVlvOL" VALUE 0x804D9566 Val_Wu8 30.00 DFES_OneToOne 0.00 30.00 FORMAT "%5.2" EXTENDED_LIMITS 0.00 255.0 /end CHARACTERISTIC
/begin CHARACTERISTIC DFES_Cls.DFC_EGRVlvOvrTemp_C "fault class per DFC / Fault class for check DFC_EGRVlvOvrTemp" VALUE 0x804D9567 Val_Wu8 30.00 DFES_OneToOne 0.00 30.00 FORMAT "%5.2" EXTENDED_LIMITS 0.00 255.0 /end CHARACTERISTIC
/begin CHARACTERISTIC DFES_Cls.DFC_EGRVlvSCB_C "fault class per DFC / Fault class for check DFC_EGRVlvSCB" VALUE 0x804D9568 Val_Wu8 30.00 DFES_OneToOne 0.00 30.00 FORMAT "%5.2" EXTENDED_LIMITS 0.00 255.0 /end CHARACTERISTIC
/begin CHARACTERISTIC DFES_Cls.DFC_EGRVlvSCG_C "fault class per DFC / Fault class for check DFC_EGRVlvSCG" VALUE 0x804D9569 Val_Wu8 30.00 DFES_OneToOne 0.00 30.00 FORMAT "%5.2" EXTENDED_LIMITS 0.00 255.0 /end CHARACTERISTIC
/begin CHARACTERISTIC DFES_Cls.DFC_EGRVlvSRCMax_C "fault class per DFC / Fault class for check DFC_EGRVlvSRCMax" VALUE 0x804D956A Val_Wu8 30.00 DFES_OneToOne 0.00 30.00 FORMAT "%5.2" EXTENDED_LIMITS 0.00 255.0 /end CHARACTERISTIC
/begin CHARACTERISTIC DFES_Cls.DFC_EGRVlvSRCMin_C "fault class per DFC / Fault class for check DFC_EGRVlvSRCMin" VALUE 0x804D956B Val_Wu8 30.00 DFES_OneToOne 0.00 30.00 FORMAT "%5.2" EXTENDED_LIMITS 0.00 255.0 /end CHARACTERISTIC
/begin CHARACTERISTIC DFES_Cls.DFC_HLSDemOvhtEngLim_C "fault class per DFC / Fault class for check DFC_HLSDemOvhtEngLim" VALUE 0x804D956C Val_Wu8 30.00 DFES_OneToOne 0.00 30.00 FORMAT "%5.2" EXTENDED_LIMITS 0.00 255.0 /end CHARACTERISTIC
/begin CHARACTERISTIC DFES_Cls.DFC_OilPSwmpSRCMax_C "fault class per DFC / Fault class for check DFC_OilPSwmpSRCMax" VALUE 0x804D956D Val_Wu8 30.00 DFES_OneToOne 0.00 30.00 FORMAT "%5.2" EXTENDED_LIMITS 0.00 255.0 /end CHARACTERISTIC
/begin CHARACTERISTIC DFES_Cls.DFC_OilPSwmpSRCMin_C "fault class per DFC / Fault class for check DFC_OilPSwmpSRCMin" VALUE 0x804D956E Val_Wu8 30.00 DFES_OneToOne 0.00 30.00 FORMAT "%5.2" EXTENDED_LIMITS 0.00 255.0 /end CHARACTERISTIC
/begin CHARACTERISTIC DFES_Cls.DFC_PIntkVUsLineHiB1_C "fault class per DFC / Fault class for check DFC_PIntkVUsLineHiB1" VALUE 0x804D956F Val_Wu8 30.00 DFES_OneToOne 0.00 30.00 FORMAT "%5.2" EXTENDED_LIMITS 0.00 255.0 /end CHARACTERISTIC
/begin CHARACTERISTIC DFES_Cls.DFC_PIntkVUsLineLoB1_C "fault class per DFC / Fault class for check DFC_PIntkVUsLineLoB1" VALUE 0x804D9570 Val_Wu8 30.00 DFES_OneToOne 0.00 30.00 FORMAT "%5.2" EXTENDED_LIMITS 0.00 255.0 /end CHARACTERISTIC
/begin CHARACTERISTIC DFES_Cls.DFC_VehVPhysRngLo_C "fault class per DFC / Fault class for check DFC_VehVPhysRngLo" VALUE 0x804D9571 Val_Wu8 30.00 DFES_OneToOne 0.00 30.00 FORMAT "%5.2" EXTENDED_LIMITS 0.00 255.0 /end CHARACTERISTIC
/begin CHARACTERISTIC DFES_Cls.DFC_VehVSigCan_C "fault class per DFC / Fault class for check DFC_VehVSigCan" VALUE 0x804D9572 Val_Wu8 30.00 DFES_OneToOne 0.00 30.00 FORMAT "%5.2" EXTENDED_LIMITS 0.00 255.0 /end CHARACTERISTIC
/begin CHARACTERISTIC DFES_Cls.DFC_VehVSigCanSafe_C "fault class per DFC / Fault class for check DFC_VehVSigCanSafe" VALUE 0x804D9573 Val_Wu8 30.00 DFES_OneToOne 0.00 30.00 FORMAT "%5.2" EXTENDED_LIMITS 0.00 255.0 /end CHARACTERISTIC
/begin CHARACTERISTIC DFES_Cls.DFC_VlvLftFbOilPSnsrIntk11SRCMax_C "fault class per DFC / Fault class for check DFC_VlvLftFbOilPSnsrIntk11SRCMax" VALUE 0x804D9574 Val_Wu8 30.00 DFES_OneToOne 0.00 30.00 FORMAT "%5.2" EXTENDED_LIMITS 0.00 255.0 /end CHARACTERISTIC
/begin CHARACTERISTIC DFES_Cls.DFC_VlvLftFbOilPSnsrIntk11SRCMin_C "fault class per DFC / Fault class for check DFC_VlvLftFbOilPSnsrIntk11SRCMin" VALUE 0x804D9575 Val_Wu8 30.00 DFES_OneToOne 0.00 30.00 FORMAT "%5.2" EXTENDED_LIMITS 0.00 255.0 /end CHARACTERISTIC
/begin CHARACTERISTIC DFES_Cls.DFC_ClthNpl_C "fault class per DFC / Fault class for check DFC_ClthNpl" VALUE 0x804D9576 Val_Wu8 30.00 DFES_OneToOne 0.00 30.00 FORMAT "%5.2" EXTENDED_LIMITS 0.00 255.0 /end CHARACTERISTIC
/begin CHARACTERISTIC DFES_Cls.DFC_GbxPNPosnDrvCdn_C "fault class per DFC / Fault class for check DFC_GbxPNPosnDrvCdn" VALUE 0x804D9577 Val_Wu8 30.00 DFES_OneToOne 0.00 30.00 FORMAT "%5.2" EXTENDED_LIMITS 0.00 255.0 /end CHARACTERISTIC
/begin CHARACTERISTIC DFES_Cls.DFC_GbxPNPosnPlausy_C "fault class per DFC / Fault class for check DFC_GbxPNPosnPlausy" VALUE 0x804D9578 Val_Wu8 30.00 DFES_OneToOne 0.00 30.00 FORMAT "%5.2" EXTENDED_LIMITS 0.00 255.0 /end CHARACTERISTIC
/begin CHARACTERISTIC DFES_Cls.DFC_AfsSigErrLineHiB1_C "fault class per DFC / Fault class for check DFC_AfsSigErrLineHiB1" VALUE 0x804D9579 Val_Wu8 30.00 DFES_OneToOne 0.00 30.00 FORMAT "%5.2" EXTENDED_LIMITS 0.00 255.0 /end CHARACTERISTIC
/begin CHARACTERISTIC DFES_Cls.DFC_AfsSigErrLineLoB1_C "fault class per DFC / Fault class for check DFC_AfsSigErrLineLoB1" VALUE 0x804D957A Val_Wu8 30.00 DFES_OneToOne 0.00 30.00 FORMAT "%5.2" EXTENDED_LIMITS 0.00 255.0 /end CHARACTERISTIC
/begin CHARACTERISTIC DFES_Cls.DFC_PEnvCcMax_C "fault class per DFC / Fault class for check DFC_PEnvCcMax" VALUE 0x804D957B Val_Wu8 30.00 DFES_OneToOne 0.00 30.00 FORMAT "%5.2" EXTENDED_LIMITS 0.00 255.0 /end CHARACTERISTIC
/begin CHARACTERISTIC DFES_Cls.DFC_PEnvCcMin_C "fault class per DFC / Fault class for check DFC_PEnvCcMin" VALUE 0x804D957C Val_Wu8 30.00 DFES_OneToOne 0.00 30.00 FORMAT "%5.2" EXTENDED_LIMITS 0.00 255.0 /end CHARACTERISTIC
/begin CHARACTERISTIC DFES_Cls.DFC_PEnvRngChkMax_C "fault class per DFC / Fault class for check DFC_PEnvRngChkMax" VALUE 0x804D957D Val_Wu8 30.00 DFES_OneToOne 0.00 30.00 FORMAT "%5.2" EXTENDED_LIMITS 0.00 255.0 /end CHARACTERISTIC
/begin CHARACTERISTIC DFES_Cls.DFC_PEnvRngChkMin_C "fault class per DFC / Fault class for check DFC_PEnvRngChkMin" VALUE 0x804D957E Val_Wu8 30.00 DFES_OneToOne 0.00 30.00 FORMAT "%5.2" EXTENDED_LIMITS 0.00 255.0 /end CHARACTERISTIC
/begin CHARACTERISTIC DFES_Cls.DFC_PEnvSnsrPlaus_C "fault class per DFC / Fault class for check DFC_PEnvSnsrPlaus" VALUE 0x804D957F Val_Wu8 30.00 DFES_OneToOne 0.00 30.00 FORMAT "%5.2" EXTENDED_LIMITS 0.00 255.0 /end CHARACTERISTIC
/begin CHARACTERISTIC DFES_Cls.DFC_UEGOHeatrRlyPsOLS1B1_C "fault class per DFC / Fault class for check DFC_UEGOHeatrRlyPsOLS1B1" VALUE 0x804D9580 Val_Wu8 30.00 DFES_OneToOne 0.00 30.00 FORMAT "%5.2" EXTENDED_LIMITS 0.00 255.0 /end CHARACTERISTIC
/begin CHARACTERISTIC DFES_Cls.DFC_UEGOHeatrRlyPsSCBS1B1_C "fault class per DFC / Fault class for check DFC_UEGOHeatrRlyPsSCBS1B1" VALUE 0x804D9581 Val_Wu8 30.00 DFES_OneToOne 0.00 30.00 FORMAT "%5.2" EXTENDED_LIMITS 0.00 255.0 /end CHARACTERISTIC
/begin CHARACTERISTIC DFES_Cls.DFC_UEGOHeatrRlyPsSCGS1B1_C "fault class per DFC / Fault class for check DFC_UEGOHeatrRlyPsSCGS1B1" VALUE 0x804D9582 Val_Wu8 30.00 DFES_OneToOne 0.00 30.00 FORMAT "%5.2" EXTENDED_LIMITS 0.00 255.0 /end CHARACTERISTIC
/begin CHARACTERISTIC DFES_Cls.DFC_UegoHeatrWireOlS1B1_C "fault class per DFC / Fault class for check DFC_UegoHeatrWireOlS1B1" VALUE 0x804D9583 Val_Wu8 30.00 DFES_OneToOne 0.00 30.00 FORMAT "%5.2" EXTENDED_LIMITS 0.00 255.0 /end CHARACTERISTIC
/begin CHARACTERISTIC DFES_Cls.DFC_UegoHeatrWireScbS1B1_C "fault class per DFC / Fault class for check DFC_UegoHeatrWireScbS1B1" VALUE 0x804D9584 Val_Wu8 30.00 DFES_OneToOne 0.00 30.00 FORMAT "%5.2" EXTENDED_LIMITS 0.00 255.0 /end CHARACTERISTIC
/begin CHARACTERISTIC DFES_Cls.DFC_UegoHeatrWireScgS1B1_C "fault class per DFC / Fault class for check DFC_UegoHeatrWireScgS1B1" VALUE 0x804D9585 Val_Wu8 30.00 DFES_OneToOne 0.00 30.00 FORMAT "%5.2" EXTENDED_LIMITS 0.00 255.0 /end CHARACTERISTIC
/begin CHARACTERISTIC DFES_Cls.DFC_KnDetSens1PortAMax_C "fault class per DFC / Fault class for check DFC_KnDetSens1PortAMax" VALUE 0x804D9586 Val_Wu8 30.00 DFES_OneToOne 0.00 30.00 FORMAT "%5.2" EXTENDED_LIMITS 0.00 255.0 /end CHARACTERISTIC
/begin CHARACTERISTIC DFES_Cls.DFC_KnDetSens1PortAMin_C "fault class per DFC / Fault class for check DFC_KnDetSens1PortAMin" VALUE 0x804D9587 Val_Wu8 30.00 DFES_OneToOne 0.00 30.00 FORMAT "%5.2" EXTENDED_LIMITS 0.00 255.0 /end CHARACTERISTIC
/begin CHARACTERISTIC DFES_Cls.DFC_KnDetSens1PortBMax_C "fault class per DFC / Fault class for check DFC_KnDetSens1PortBMax" VALUE 0x804D9588 Val_Wu8 30.00 DFES_OneToOne 0.00 30.00 FORMAT "%5.2" EXTENDED_LIMITS 0.00 255.0 /end CHARACTERISTIC
/begin CHARACTERISTIC DFES_Cls.DFC_KnDetSens1PortBMin_C "fault class per DFC / Fault class for check DFC_KnDetSens1PortBMin" VALUE 0x804D9589 Val_Wu8 30.00 DFES_OneToOne 0.00 30.00 FORMAT "%5.2" EXTENDED_LIMITS 0.00 255.0 /end CHARACTERISTIC
/begin CHARACTERISTIC DFES_Cls.DFC_Clth2ONStuck_C "fault class per DFC / Fault class for check DFC_Clth2ONStuck" VALUE 0x804D958A Val_Wu8 30.00 DFES_OneToOne 0.00 30.00 FORMAT "%5.2" EXTENDED_LIMITS 0.00 255.0 /end CHARACTERISTIC
/begin CHARACTERISTIC DFES_Cls.DFC_Clth2ONStuckLdc_C "fault class per DFC / Fault class for check DFC_Clth2ONStuckLdc" VALUE 0x804D958B Val_Wu8 30.00 DFES_OneToOne 0.00 30.00 FORMAT "%5.2" EXTENDED_LIMITS 0.00 255.0 /end CHARACTERISTIC
/begin CHARACTERISTIC DFES_Cls.DFC_Clth3ONStuckLdc_C "fault class per DFC / Fault class for check DFC_Clth3ONStuckLdc" VALUE 0x804D958C Val_Wu8 30.00 DFES_OneToOne 0.00 30.00 FORMAT "%5.2" EXTENDED_LIMITS 0.00 255.0 /end CHARACTERISTIC
/begin CHARACTERISTIC DFES_Cls.DFC_Clth3ONStuckPostDrv_C "fault class per DFC / Fault class for check DFC_Clth3ONStuckPostDrv" VALUE 0x804D958D Val_Wu8 30.00 DFES_OneToOne 0.00 30.00 FORMAT "%5.2" EXTENDED_LIMITS 0.00 255.0 /end CHARACTERISTIC
/begin CHARACTERISTIC DFES_Cls.DFC_Clth4ONStuck_C "fault class per DFC / Fault class for check DFC_Clth4ONStuck" VALUE 0x804D958E Val_Wu8 30.00 DFES_OneToOne 0.00 30.00 FORMAT "%5.2" EXTENDED_LIMITS 0.00 255.0 /end CHARACTERISTIC
/begin CHARACTERISTIC DFES_Cls.DFC_Clth4ONStuckLdc_C "fault class per DFC / Fault class for check DFC_Clth4ONStuckLdc" VALUE 0x804D958F Val_Wu8 30.00 DFES_OneToOne 0.00 30.00 FORMAT "%5.2" EXTENDED_LIMITS 0.00 255.0 /end CHARACTERISTIC
/begin CHARACTERISTIC DFES_Cls.DFC_ComBCMUnit_C "fault class per DFC / Fault class for check DFC_ComBCMUnit" VALUE 0x804D9590 Val_Wu8 30.00 DFES_OneToOne 0.00 30.00 FORMAT "%5.2" EXTENDED_LIMITS 0.00 255.0 /end CHARACTERISTIC
/begin CHARACTERISTIC DFES_Cls.DFC_ComDLCTCU01_C "fault class per DFC / Fault class for check DFC_ComDLCTCU01" VALUE 0x804D9591 Val_Wu8 30.00 DFES_OneToOne 0.00 30.00 FORMAT "%5.2" EXTENDED_LIMITS 0.00 255.0 /end CHARACTERISTIC
/begin CHARACTERISTIC DFES_Cls.DFC_ComDLCTCU02_C "fault class per DFC / Fault class for check DFC_ComDLCTCU02" VALUE 0x804D9592 Val_Wu8 30.00 DFES_OneToOne 0.00 30.00 FORMAT "%5.2" EXTENDED_LIMITS 0.00 255.0 /end CHARACTERISTIC
/begin CHARACTERISTIC DFES_Cls.DFC_ComDLCTCU1_C "fault class per DFC / Fault class for check DFC_ComDLCTCU1" VALUE 0x804D9593 Val_Wu8 30.00 DFES_OneToOne 0.00 30.00 FORMAT "%5.2" EXTENDED_LIMITS 0.00 255.0 /end CHARACTERISTIC
/begin CHARACTERISTIC DFES_Cls.DFC_ComDLCTCU11_C "fault class per DFC / Fault class for check DFC_ComDLCTCU11" VALUE 0x804D9594 Val_Wu8 30.00 DFES_OneToOne 0.00 30.00 FORMAT "%5.2" EXTENDED_LIMITS 0.00 255.0 /end CHARACTERISTIC
/begin CHARACTERISTIC DFES_Cls.DFC_ComDLCTCU12_C "fault class per DFC / Fault class for check DFC_ComDLCTCU12" VALUE 0x804D9595 Val_Wu8 30.00 DFES_OneToOne 0.00 30.00 FORMAT "%5.2" EXTENDED_LIMITS 0.00 255.0 /end CHARACTERISTIC
/begin CHARACTERISTIC DFES_Cls.DFC_ComDLCTCU13_C "fault class per DFC / Fault class for check DFC_ComDLCTCU13" VALUE 0x804D9596 Val_Wu8 30.00 DFES_OneToOne 0.00 30.00 FORMAT "%5.2" EXTENDED_LIMITS 0.00 255.0 /end CHARACTERISTIC
/begin CHARACTERISTIC DFES_Cls.DFC_ComDLCTCU14_C "fault class per DFC / Fault class for check DFC_ComDLCTCU14" VALUE 0x804D9597 Val_Wu8 30.00 DFES_OneToOne 0.00 30.00 FORMAT "%5.2" EXTENDED_LIMITS 0.00 255.0 /end CHARACTERISTIC
/begin CHARACTERISTIC DFES_Cls.DFC_ComDLCTCU2_C "fault class per DFC / Fault class for check DFC_ComDLCTCU2" VALUE 0x804D9598 Val_Wu8 30.00 DFES_OneToOne 0.00 30.00 FORMAT "%5.2" EXTENDED_LIMITS 0.00 255.0 /end CHARACTERISTIC
/begin CHARACTERISTIC DFES_Cls.DFC_ComDLCTCU3_C "fault class per DFC / Fault class for check DFC_ComDLCTCU3" VALUE 0x804D9599 Val_Wu8 30.00 DFES_OneToOne 0.00 30.00 FORMAT "%5.2" EXTENDED_LIMITS 0.00 255.0 /end CHARACTERISTIC
/begin CHARACTERISTIC DFES_Cls.DFC_ComDLCTCU4_C "fault class per DFC / Fault class for check DFC_ComDLCTCU4" VALUE 0x804D959A Val_Wu8 30.00 DFES_OneToOne 0.00 30.00 FORMAT "%5.2" EXTENDED_LIMITS 0.00 255.0 /end CHARACTERISTIC
/begin CHARACTERISTIC DFES_Cls.DFC_ComEPSUnit_C "fault class per DFC / Fault class for check DFC_ComEPSUnit" VALUE 0x804D959B Val_Wu8 30.00 DFES_OneToOne 0.00 30.00 FORMAT "%5.2" EXTENDED_LIMITS 0.00 255.0 /end CHARACTERISTIC
/begin CHARACTERISTIC DFES_Cls.DFC_ComIDASBUnit_C "fault class per DFC / Fault class for check DFC_ComIDASBUnit" VALUE 0x804D959C Val_Wu8 30.00 DFES_OneToOne 0.00 30.00 FORMAT "%5.2" EXTENDED_LIMITS 0.00 255.0 /end CHARACTERISTIC
/begin CHARACTERISTIC DFES_Cls.DFC_ComIMGUnit_C "fault class per DFC / Fault class for check DFC_ComIMGUnit" VALUE 0x804D959D Val_Wu8 30.00 DFES_OneToOne 0.00 30.00 FORMAT "%5.2" EXTENDED_LIMITS 0.00 255.0 /end CHARACTERISTIC
/begin CHARACTERISTIC DFES_Cls.DFC_ComMETUnit_C "fault class per DFC / Fault class for check DFC_ComMETUnit" VALUE 0x804D959E Val_Wu8 30.00 DFES_OneToOne 0.00 30.00 FORMAT "%5.2" EXTENDED_LIMITS 0.00 255.0 /end CHARACTERISTIC
/begin CHARACTERISTIC DFES_Cls.DFC_ComSRSUnit_C "fault class per DFC / Fault class for check DFC_ComSRSUnit" VALUE 0x804D959F Val_Wu8 30.00 DFES_OneToOne 0.00 30.00 FORMAT "%5.2" EXTENDED_LIMITS 0.00 255.0 /end CHARACTERISTIC
/begin CHARACTERISTIC DFES_Cls.DFC_ComVSAUnit_C "fault class per DFC / Fault class for check DFC_ComVSAUnit" VALUE 0x804D95A0 Val_Wu8 30.00 DFES_OneToOne 0.00 30.00 FORMAT "%5.2" EXTENDED_LIMITS 0.00 255.0 /end CHARACTERISTIC
/begin CHARACTERISTIC DFES_Cls.DFC_EbsSocFlt_C "fault class per DFC / Fault class for check DFC_EbsSocFlt" VALUE 0x804D95A1 Val_Wu8 30.00 DFES_OneToOne 0.00 30.00 FORMAT "%5.2" EXTENDED_LIMITS 0.00 255.0 /end CHARACTERISTIC
/begin CHARACTERISTIC DFES_Cls.DFC_I14229VINErr_C "fault class per DFC / Fault class for check DFC_I14229VINErr" VALUE 0x804D95A2 Val_Wu8 30.00 DFES_OneToOne 0.00 30.00 FORMAT "%5.2" EXTENDED_LIMITS 0.00 255.0 /end CHARACTERISTIC
/begin CHARACTERISTIC DFES_Cls.DFC_InjCatHeatgErr_C "fault class per DFC / Fault class for check DFC_InjCatHeatgErr" VALUE 0x804D95A3 Val_Wu8 30.00 DFES_OneToOne 0.00 30.00 FORMAT "%5.2" EXTENDED_LIMITS 0.00 255.0 /end CHARACTERISTIC
/begin CHARACTERISTIC DFES_Cls.DFC_InjSysMulInjDiagErr_C "fault class per DFC / Fault class for check DFC_InjSysMulInjDiagErr" VALUE 0x804D95A4 Val_Wu8 30.00 DFES_OneToOne 0.00 30.00 FORMAT "%5.2" EXTENDED_LIMITS 0.00 255.0 /end CHARACTERISTIC
/begin CHARACTERISTIC DFES_Cls.DFC_LLRHmax_C "fault class per DFC / Fault class for check DFC_LLRHmax" VALUE 0x804D95A5 Val_Wu8 30.00 DFES_OneToOne 0.00 30.00 FORMAT "%5.2" EXTENDED_LIMITS 0.00 255.0 /end CHARACTERISTIC
/begin CHARACTERISTIC DFES_Cls.DFC_LLRHmin_C "fault class per DFC / Fault class for check DFC_LLRHmin" VALUE 0x804D95A6 Val_Wu8 30.00 DFES_OneToOne 0.00 30.00 FORMAT "%5.2" EXTENDED_LIMITS 0.00 255.0 /end CHARACTERISTIC
/begin CHARACTERISTIC DFES_Cls.DFC_LLRHnpl_C "fault class per DFC / Fault class for check DFC_LLRHnpl" VALUE 0x804D95A7 Val_Wu8 30.00 DFES_OneToOne 0.00 30.00 FORMAT "%5.2" EXTENDED_LIMITS 0.00 255.0 /end CHARACTERISTIC
/begin CHARACTERISTIC DFES_Cls.DFC_LLRKHmax_C "fault class per DFC / Fault class for check DFC_LLRKHmax" VALUE 0x804D95A8 Val_Wu8 30.00 DFES_OneToOne 0.00 30.00 FORMAT "%5.2" EXTENDED_LIMITS 0.00 255.0 /end CHARACTERISTIC
/begin CHARACTERISTIC DFES_Cls.DFC_LLRKHmin_C "fault class per DFC / Fault class for check DFC_LLRKHmin" VALUE 0x804D95A9 Val_Wu8 30.00 DFES_OneToOne 0.00 30.00 FORMAT "%5.2" EXTENDED_LIMITS 0.00 255.0 /end CHARACTERISTIC
/begin CHARACTERISTIC DFES_Cls.DFC_LLRKHnpl_C "fault class per DFC / Fault class for check DFC_LLRKHnpl" VALUE 0x804D95AA Val_Wu8 30.00 DFES_OneToOne 0.00 30.00 FORMAT "%5.2" EXTENDED_LIMITS 0.00 255.0 /end CHARACTERISTIC
/begin CHARACTERISTIC DFES_Cls.DFC_LinACGUnit_C "fault class per DFC / Fault class for check DFC_LinACGUnit" VALUE 0x804D95AB Val_Wu8 30.00 DFES_OneToOne 0.00 30.00 FORMAT "%5.2" EXTENDED_LIMITS 0.00 255.0 /end CHARACTERISTIC
/begin CHARACTERISTIC DFES_Cls.DFC_LinAEVUnit_C "fault class per DFC / Fault class for check DFC_LinAEVUnit" VALUE 0x804D95AC Val_Wu8 30.00 DFES_OneToOne 0.00 30.00 FORMAT "%5.2" EXTENDED_LIMITS 0.00 255.0 /end CHARACTERISTIC
/begin CHARACTERISTIC DFES_Cls.DFC_LinEBSUnit_C "fault class per DFC / Fault class for check DFC_LinEBSUnit" VALUE 0x804D95AD Val_Wu8 30.00 DFES_OneToOne 0.00 30.00 FORMAT "%5.2" EXTENDED_LIMITS 0.00 255.0 /end CHARACTERISTIC
/begin CHARACTERISTIC DFES_Cls.DFC_RoughRoad_C "fault class per DFC / Fault class for check DFC_RoughRoad" VALUE 0x804D95AE Val_Wu8 30.00 DFES_OneToOne 0.00 30.00 FORMAT "%5.2" EXTENDED_LIMITS 0.00 255.0 /end CHARACTERISTIC
/begin CHARACTERISTIC DFES_Cls.DFC_SiaEEPRdErr_C "fault class per DFC / Fault class for check DFC_SiaEEPRdErr" VALUE 0x804D95AF Val_Wu8 30.00 DFES_OneToOne 0.00 30.00 FORMAT "%5.2" EXTENDED_LIMITS 0.00 255.0 /end CHARACTERISTIC
/begin CHARACTERISTIC DFES_Cls.DFC_SiaEEPWrngCod_C "fault class per DFC / Fault class for check DFC_SiaEEPWrngCod" VALUE 0x804D95B0 Val_Wu8 30.00 DFES_OneToOne 0.00 30.00 FORMAT "%5.2" EXTENDED_LIMITS 0.00 255.0 /end CHARACTERISTIC
/begin CHARACTERISTIC DFES_Cls.DFC_UegoHeatrStrtS1B1_C "fault class per DFC / Fault class for check DFC_UegoHeatrStrtS1B1" VALUE 0x804D95B1 Val_Wu8 30.00 DFES_OneToOne 0.00 30.00 FORMAT "%5.2" EXTENDED_LIMITS 0.00 255.0 /end CHARACTERISTIC
/begin CHARACTERISTIC DFES_Cls.DFC_BusDiagCANAPPLBusOff_C "fault class per DFC / Fault class for check DFC_BusDiagCANAPPLBusOff" VALUE 0x804D95B2 Val_Wu8 30.00 DFES_OneToOne 0.00 30.00 FORMAT "%5.2" EXTENDED_LIMITS 0.00 255.0 /end CHARACTERISTIC
/begin CHARACTERISTIC DFES_Cls.DFC_BusDiagCANCANCBusOff_C "fault class per DFC / Fault class for check DFC_BusDiagCANCANCBusOff" VALUE 0x804D95B3 Val_Wu8 30.00 DFES_OneToOne 0.00 30.00 FORMAT "%5.2" EXTENDED_LIMITS 0.00 255.0 /end CHARACTERISTIC
/begin CHARACTERISTIC DFES_Cls.DFC_BusDiagCANVEHICLEBusOff_C "fault class per DFC / Fault class for check DFC_BusDiagCANVEHICLEBusOff" VALUE 0x804D95B4 Val_Wu8 30.00 DFES_OneToOne 0.00 30.00 FORMAT "%5.2" EXTENDED_LIMITS 0.00 255.0 /end CHARACTERISTIC
/begin CHARACTERISTIC DFES_Cls.DFC_RBA_IODIAGPWR_rba_IoExtCy329_SignalVltSply_0_C "fault class per DFC / Fault class for check DFC_RBA_IODIAGPWR_rba_IoExtCy329_SignalVltSply_0" VALUE 0x804D95B5 Val_Wu8 30.00 DFES_OneToOne 0.00 30.00 FORMAT "%5.2" EXTENDED_LIMITS 0.00 255.0 /end CHARACTERISTIC
/begin CHARACTERISTIC DFES_Cls.DFC_RBA_IODIAGPWR_rba_IoExtCy329_SignalVltSply_0OT_C "fault class per DFC / Fault class for check DFC_RBA_IODIAGPWR_rba_IoExtCy329_SignalVltSply_0OT" VALUE 0x804D95B6 Val_Wu8 30.00 DFES_OneToOne 0.00 30.00 FORMAT "%5.2" EXTENDED_LIMITS 0.00 255.0 /end CHARACTERISTIC
/begin CHARACTERISTIC DFES_Cls.DFC_RBA_IODIAGPWR_rba_IoExtCy329_SignalVltSply_0OV_C "fault class per DFC / Fault class for check DFC_RBA_IODIAGPWR_rba_IoExtCy329_SignalVltSply_0OV" VALUE 0x804D95B7 Val_Wu8 30.00 DFES_OneToOne 0.00 30.00 FORMAT "%5.2" EXTENDED_LIMITS 0.00 255.0 /end CHARACTERISTIC
/begin CHARACTERISTIC DFES_Cls.DFC_RBA_IODIAGPWR_rba_IoExtCy329_SignalVltSply_0SCG_C "fault class per DFC / Fault class for check DFC_RBA_IODIAGPWR_rba_IoExtCy329_SignalVltSply_0SCG" VALUE 0x804D95B8 Val_Wu8 30.00 DFES_OneToOne 0.00 30.00 FORMAT "%5.2" EXTENDED_LIMITS 0.00 255.0 /end CHARACTERISTIC
/begin CHARACTERISTIC DFES_Cls.DFC_RBA_IODIAGPWR_rba_IoExtCy329_SignalVltSply_0UV_C "fault class per DFC / Fault class for check DFC_RBA_IODIAGPWR_rba_IoExtCy329_SignalVltSply_0UV" VALUE 0x804D95B9 Val_Wu8 30.00 DFES_OneToOne 0.00 30.00 FORMAT "%5.2" EXTENDED_LIMITS 0.00 255.0 /end CHARACTERISTIC
/begin CHARACTERISTIC DFES_Cls.DFC_RBA_IODIAGPWR_rba_IoExtCy329_SignalVltSply_1_C "fault class per DFC / Fault class for check DFC_RBA_IODIAGPWR_rba_IoExtCy329_SignalVltSply_1" VALUE 0x804D95BA Val_Wu8 30.00 DFES_OneToOne 0.00 30.00 FORMAT "%5.2" EXTENDED_LIMITS 0.00 255.0 /end CHARACTERISTIC
/begin CHARACTERISTIC DFES_Cls.DFC_RBA_IODIAGPWR_rba_IoExtCy329_SignalVltSply_1OT_C "fault class per DFC / Fault class for check DFC_RBA_IODIAGPWR_rba_IoExtCy329_SignalVltSply_1OT" VALUE 0x804D95BB Val_Wu8 30.00 DFES_OneToOne 0.00 30.00 FORMAT "%5.2" EXTENDED_LIMITS 0.00 255.0 /end CHARACTERISTIC
/begin CHARACTERISTIC DFES_Cls.DFC_RBA_IODIAGPWR_rba_IoExtCy329_SignalVltSply_1OV_C "fault class per DFC / Fault class for check DFC_RBA_IODIAGPWR_rba_IoExtCy329_SignalVltSply_1OV" VALUE 0x804D95BC Val_Wu8 30.00 DFES_OneToOne 0.00 30.00 FORMAT "%5.2" EXTENDED_LIMITS 0.00 255.0 /end CHARACTERISTIC
/begin CHARACTERISTIC DFES_Cls.DFC_RBA_IODIAGPWR_rba_IoExtCy329_SignalVltSply_1SCG_C "fault class per DFC / Fault class for check DFC_RBA_IODIAGPWR_rba_IoExtCy329_SignalVltSply_1SCG" VALUE 0x804D95BD Val_Wu8 30.00 DFES_OneToOne 0.00 30.00 FORMAT "%5.2" EXTENDED_LIMITS 0.00 255.0 /end CHARACTERISTIC
/begin CHARACTERISTIC DFES_Cls.DFC_RBA_IODIAGPWR_rba_IoExtCy329_SignalVltSply_1UV_C "fault class per DFC / Fault class for check DFC_RBA_IODIAGPWR_rba_IoExtCy329_SignalVltSply_1UV" VALUE 0x804D95BE Val_Wu8 30.00 DFES_OneToOne 0.00 30.00 FORMAT "%5.2" EXTENDED_LIMITS 0.00 255.0 /end CHARACTERISTIC
/begin CHARACTERISTIC DFES_Cls.DFC_RBA_IODIAGPWR_rba_IoExtCy329_SignalVltSply_2_C "fault class per DFC / Fault class for check DFC_RBA_IODIAGPWR_rba_IoExtCy329_SignalVltSply_2" VALUE 0x804D95BF Val_Wu8 30.00 DFES_OneToOne 0.00 30.00 FORMAT "%5.2" EXTENDED_LIMITS 0.00 255.0 /end CHARACTERISTIC
/begin CHARACTERISTIC DFES_Cls.DFC_RBA_IODIAGPWR_rba_IoExtCy329_SignalVltSply_2OT_C "fault class per DFC / Fault class for check DFC_RBA_IODIAGPWR_rba_IoExtCy329_SignalVltSply_2OT" VALUE 0x804D95C0 Val_Wu8 30.00 DFES_OneToOne 0.00 30.00 FORMAT "%5.2" EXTENDED_LIMITS 0.00 255.0 /end CHARACTERISTIC
/begin CHARACTERISTIC DFES_Cls.DFC_RBA_IODIAGPWR_rba_IoExtCy329_SignalVltSply_2OV_C "fault class per DFC / Fault class for check DFC_RBA_IODIAGPWR_rba_IoExtCy329_SignalVltSply_2OV" VALUE 0x804D95C1 Val_Wu8 30.00 DFES_OneToOne 0.00 30.00 FORMAT "%5.2" EXTENDED_LIMITS 0.00 255.0 /end CHARACTERISTIC
/begin CHARACTERISTIC DFES_Cls.DFC_RBA_IODIAGPWR_rba_IoExtCy329_SignalVltSply_2SCG_C "fault class per DFC / Fault class for check DFC_RBA_IODIAGPWR_rba_IoExtCy329_SignalVltSply_2SCG" VALUE 0x804D95C2 Val_Wu8 30.00 DFES_OneToOne 0.00 30.00 FORMAT "%5.2" EXTENDED_LIMITS 0.00 255.0 /end CHARACTERISTIC
/begin CHARACTERISTIC DFES_Cls.DFC_RBA_IODIAGPWR_rba_IoExtCy329_SignalVltSply_2UV_C "fault class per DFC / Fault class for check DFC_RBA_IODIAGPWR_rba_IoExtCy329_SignalVltSply_2UV" VALUE 0x804D95C3 Val_Wu8 30.00 DFES_OneToOne 0.00 30.00 FORMAT "%5.2" EXTENDED_LIMITS 0.00 255.0 /end CHARACTERISTIC
/begin CHARACTERISTIC DFES_Cls.DFC_CAN_E_TIMEOUT_C "fault class per DFC / Fault class for check DFC_CAN_E_TIMEOUT" VALUE 0x804D95C4 Val_Wu8 30.00 DFES_OneToOne 0.00 30.00 FORMAT "%5.2" EXTENDED_LIMITS 0.00 255.0 /end CHARACTERISTIC
/begin CHARACTERISTIC DFES_Cls.DFC_LIN_E_TIMEOUT_C "fault class per DFC / Fault class for check DFC_LIN_E_TIMEOUT" VALUE 0x804D95C5 Val_Wu8 30.00 DFES_OneToOne 0.00 30.00 FORMAT "%5.2" EXTENDED_LIMITS 0.00 255.0 /end CHARACTERISTIC
/begin CHARACTERISTIC DFES_Cls.DFC_MRlyOL_C "fault class per DFC / Fault class for check DFC_MRlyOL" VALUE 0x804D95C6 Val_Wu8 30.00 DFES_OneToOne 0.00 30.00 FORMAT "%5.2" EXTENDED_LIMITS 0.00 255.0 /end CHARACTERISTIC
/begin CHARACTERISTIC DFES_Cls.DFC_MRlySCB_C "fault class per DFC / Fault class for check DFC_MRlySCB" VALUE 0x804D95C7 Val_Wu8 30.00 DFES_OneToOne 0.00 30.00 FORMAT "%5.2" EXTENDED_LIMITS 0.00 255.0 /end CHARACTERISTIC
/begin CHARACTERISTIC DFES_Cls.DFC_MRlySCG_C "fault class per DFC / Fault class for check DFC_MRlySCG" VALUE 0x804D95C8 Val_Wu8 30.00 DFES_OneToOne 0.00 30.00 FORMAT "%5.2" EXTENDED_LIMITS 0.00 255.0 /end CHARACTERISTIC
/begin CHARACTERISTIC DFES_Cls.DFC_rba_MultiStackTrace_Threshold_C "fault class per DFC / Fault class for check DFC_rba_MultiStackTrace_Threshold" VALUE 0x804D95C9 Val_Wu8 30.00 DFES_OneToOne 0.00 30.00 FORMAT "%5.2" EXTENDED_LIMITS 0.00 255.0 /end CHARACTERISTIC
/begin CHARACTERISTIC DFES_Cls.DFC_BSWM_E_ACTION_FAILED_C "fault class per DFC / Fault class for check DFC_BSWM_E_ACTION_FAILED" VALUE 0x804D95CA Val_Wu8 30.00 DFES_OneToOne 0.00 30.00 FORMAT "%5.2" EXTENDED_LIMITS 0.00 255.0 /end CHARACTERISTIC
/begin CHARACTERISTIC DFES_Cls.DFC_BSWM_E_INTRPTQUEUE_FULL_C "fault class per DFC / Fault class for check DFC_BSWM_E_INTRPTQUEUE_FULL" VALUE 0x804D95CB Val_Wu8 30.00 DFES_OneToOne 0.00 30.00 FORMAT "%5.2" EXTENDED_LIMITS 0.00 255.0 /end CHARACTERISTIC
/begin CHARACTERISTIC DFES_Cls.DFC_RBA_IOEXTLIB_KEEPALIVE_DRV_C "fault class per DFC / Fault class for check DFC_RBA_IOEXTLIB_KEEPALIVE_DRV" VALUE 0x804D95CC Val_Wu8 30.00 DFES_OneToOne 0.00 30.00 FORMAT "%5.2" EXTENDED_LIMITS 0.00 255.0 /end CHARACTERISTIC
/begin CHARACTERISTIC DFES_Cls.DFC_RBA_IOEXTLIB_KEEPALIVE_INI_C "fault class per DFC / Fault class for check DFC_RBA_IOEXTLIB_KEEPALIVE_INI" VALUE 0x804D95CD Val_Wu8 30.00 DFES_OneToOne 0.00 30.00 FORMAT "%5.2" EXTENDED_LIMITS 0.00 255.0 /end CHARACTERISTIC
/begin CHARACTERISTIC DFES_Cls.DFC_rba_IoSigRtc_StopCounter_C "fault class per DFC / Fault class for check DFC_rba_IoSigRtc_StopCounter" VALUE 0x804D95CE Val_Wu8 30.00 DFES_OneToOne 0.00 30.00 FORMAT "%5.2" EXTENDED_LIMITS 0.00 255.0 /end CHARACTERISTIC
/begin CHARACTERISTIC DFES_Cls.DFC_rba_MRly_Diag_Stk_Event_C "fault class per DFC / Fault class for check DFC_rba_MRly_Diag_Stk_Event" VALUE 0x804D95CF Val_Wu8 30.00 DFES_OneToOne 0.00 30.00 FORMAT "%5.2" EXTENDED_LIMITS 0.00 255.0 /end CHARACTERISTIC
/begin CHARACTERISTIC DFES_Cls.DFC_rba_MemDiag_MemReadErr_C "fault class per DFC / Fault class for check DFC_rba_MemDiag_MemReadErr" VALUE 0x804D95D0 Val_Wu8 30.00 DFES_OneToOne 0.00 30.00 FORMAT "%5.2" EXTENDED_LIMITS 0.00 255.0 /end CHARACTERISTIC
/begin CHARACTERISTIC DFES_Cls.DFC_rba_MemDiag_MemWrErr_C "fault class per DFC / Fault class for check DFC_rba_MemDiag_MemWrErr" VALUE 0x804D95D1 Val_Wu8 30.00 DFES_OneToOne 0.00 30.00 FORMAT "%5.2" EXTENDED_LIMITS 0.00 255.0 /end CHARACTERISTIC
/begin CHARACTERISTIC DFES_Cls.DFC_rba_SyC_IrrSwOffTrigEngRun_Event_C "fault class per DFC / Fault class for check DFC_rba_SyC_IrrSwOffTrigEngRun_Event" VALUE 0x804D95D2 Val_Wu8 30.00 DFES_OneToOne 0.00 30.00 FORMAT "%5.2" EXTENDED_LIMITS 0.00 255.0 /end CHARACTERISTIC
/begin CHARACTERISTIC DFES_Cls.DFC_rba_T15_Diag_ComInVld_Event_C "fault class per DFC / Fault class for check DFC_rba_T15_Diag_ComInVld_Event" VALUE 0x804D95D3 Val_Wu8 30.00 DFES_OneToOne 0.00 30.00 FORMAT "%5.2" EXTENDED_LIMITS 0.00 255.0 /end CHARACTERISTIC
/begin CHARACTERISTIC DFES_Cls.DFC_rba_T15_Diag_ComOff_HwOn_Event_C "fault class per DFC / Fault class for check DFC_rba_T15_Diag_ComOff_HwOn_Event" VALUE 0x804D95D4 Val_Wu8 30.00 DFES_OneToOne 0.00 30.00 FORMAT "%5.2" EXTENDED_LIMITS 0.00 255.0 /end CHARACTERISTIC
/begin CHARACTERISTIC DFES_Cls.DFC_rba_T15_Diag_ComOn_HwOff_Event_C "fault class per DFC / Fault class for check DFC_rba_T15_Diag_ComOn_HwOff_Event" VALUE 0x804D95D5 Val_Wu8 30.00 DFES_OneToOne 0.00 30.00 FORMAT "%5.2" EXTENDED_LIMITS 0.00 255.0 /end CHARACTERISTIC
/begin CHARACTERISTIC DFES_Cls.DFC_AAVmin_C "fault class per DFC / Fault class for check DFC_AAVmin" VALUE 0x804D95D6 Val_Wu8 30.00 DFES_OneToOne 0.00 30.00 FORMAT "%5.2" EXTENDED_LIMITS 0.00 255.0 /end CHARACTERISTIC
/begin CHARACTERISTIC DFES_Cls.DFC_AGRSUS_C "fault class per DFC / Fault class for check DFC_AGRSUS" VALUE 0x804D95D7 Val_Wu8 30.00 DFES_OneToOne 0.00 30.00 FORMAT "%5.2" EXTENDED_LIMITS 0.00 255.0 /end CHARACTERISTIC
/begin CHARACTERISTIC DFES_Cls.DFC_AfsPlausDiagHi_C "fault class per DFC / Fault class for check DFC_AfsPlausDiagHi" VALUE 0x804D95D8 Val_Wu8 30.00 DFES_OneToOne 0.00 30.00 FORMAT "%5.2" EXTENDED_LIMITS 0.00 255.0 /end CHARACTERISTIC
/begin CHARACTERISTIC DFES_Cls.DFC_AfsPlausDiagLo_C "fault class per DFC / Fault class for check DFC_AfsPlausDiagLo" VALUE 0x804D95D9 Val_Wu8 30.00 DFES_OneToOne 0.00 30.00 FORMAT "%5.2" EXTENDED_LIMITS 0.00 255.0 /end CHARACTERISTIC
/begin CHARACTERISTIC DFES_Cls.DFC_AfsVrntDiagErrB1_C "fault class per DFC / Fault class for check DFC_AfsVrntDiagErrB1" VALUE 0x804D95DA Val_Wu8 30.00 DFES_OneToOne 0.00 30.00 FORMAT "%5.2" EXTENDED_LIMITS 0.00 255.0 /end CHARACTERISTIC
/begin CHARACTERISTIC DFES_Cls.DFC_AppAllSnsrDfct_C "fault class per DFC / Fault class for check DFC_AppAllSnsrDfct" VALUE 0x804D95DB Val_Wu8 30.00 DFES_OneToOne 0.00 30.00 FORMAT "%5.2" EXTENDED_LIMITS 0.00 255.0 /end CHARACTERISTIC
/begin CHARACTERISTIC DFES_Cls.DFC_BBKRnldg_C "fault class per DFC / Fault class for check DFC_BBKRnldg" VALUE 0x804D95DC Val_Wu8 30.00 DFES_OneToOne 0.00 30.00 FORMAT "%5.2" EXTENDED_LIMITS 0.00 255.0 /end CHARACTERISTIC
/begin CHARACTERISTIC DFES_Cls.DFC_BBKRsyne_C "fault class per DFC / Fault class for check DFC_BBKRsyne" VALUE 0x804D95DD Val_Wu8 30.00 DFES_OneToOne 0.00 30.00 FORMAT "%5.2" EXTENDED_LIMITS 0.00 255.0 /end CHARACTERISTIC
/begin CHARACTERISTIC DFES_Cls.DFC_BattUStdbyDiaOL_C "fault class per DFC / Fault class for check DFC_BattUStdbyDiaOL" VALUE 0x804D95DE Val_Wu8 30.00 DFES_OneToOne 0.00 30.00 FORMAT "%5.2" EXTENDED_LIMITS 0.00 255.0 /end CHARACTERISTIC
/begin CHARACTERISTIC DFES_Cls.DFC_BigLeakIntkMnfldEmiInfl_C "fault class per DFC / Fault class for check DFC_BigLeakIntkMnfldEmiInfl" VALUE 0x804D95DF Val_Wu8 30.00 DFES_OneToOne 0.00 30.00 FORMAT "%5.2" EXTENDED_LIMITS 0.00 255.0 /end CHARACTERISTIC
/begin CHARACTERISTIC DFES_Cls.DFC_BlkdLineTank_C "fault class per DFC / Fault class for check DFC_BlkdLineTank" VALUE 0x804D95E0 Val_Wu8 30.00 DFES_OneToOne 0.00 30.00 FORMAT "%5.2" EXTENDED_LIMITS 0.00 255.0 /end CHARACTERISTIC
/begin CHARACTERISTIC DFES_Cls.DFC_BrkMnSwtContOnWarnLmp_C "fault class per DFC / Fault class for check DFC_BrkMnSwtContOnWarnLmp" VALUE 0x804D95E1 Val_Wu8 30.00 DFES_OneToOne 0.00 30.00 FORMAT "%5.2" EXTENDED_LIMITS 0.00 255.0 /end CHARACTERISTIC
/begin CHARACTERISTIC DFES_Cls.DFC_BrkMnSwtNotStpWarnLmp_C "fault class per DFC / Fault class for check DFC_BrkMnSwtNotStpWarnLmp" VALUE 0x804D95E2 Val_Wu8 30.00 DFES_OneToOne 0.00 30.00 FORMAT "%5.2" EXTENDED_LIMITS 0.00 255.0 /end CHARACTERISTIC
/begin CHARACTERISTIC DFES_Cls.DFC_BrkRdntSwtContOnWarnLmp_C "fault class per DFC / Fault class for check DFC_BrkRdntSwtContOnWarnLmp" VALUE 0x804D95E3 Val_Wu8 30.00 DFES_OneToOne 0.00 30.00 FORMAT "%5.2" EXTENDED_LIMITS 0.00 255.0 /end CHARACTERISTIC
/begin CHARACTERISTIC DFES_Cls.DFC_BrkRdntSwtNotStpWarnLmp_C "fault class per DFC / Fault class for check DFC_BrkRdntSwtNotStpWarnLmp" VALUE 0x804D95E4 Val_Wu8 30.00 DFES_OneToOne 0.00 30.00 FORMAT "%5.2" EXTENDED_LIMITS 0.00 255.0 /end CHARACTERISTIC
/begin CHARACTERISTIC DFES_Cls.DFC_CEngDsTColdStrtMax_C "fault class per DFC / Fault class for check DFC_CEngDsTColdStrtMax" VALUE 0x804D95E5 Val_Wu8 30.00 DFES_OneToOne 0.00 30.00 FORMAT "%5.2" EXTENDED_LIMITS 0.00 255.0 /end CHARACTERISTIC
/begin CHARACTERISTIC DFES_Cls.DFC_CEngDsTColdStrtMin_C "fault class per DFC / Fault class for check DFC_CEngDsTColdStrtMin" VALUE 0x804D95E6 Val_Wu8 30.00 DFES_OneToOne 0.00 30.00 FORMAT "%5.2" EXTENDED_LIMITS 0.00 255.0 /end CHARACTERISTIC
/begin CHARACTERISTIC DFES_Cls.DFC_CEngDsTImps_C "fault class per DFC / Fault class for check DFC_CEngDsTImps" VALUE 0x804D95E7 Val_Wu8 30.00 DFES_OneToOne 0.00 30.00 FORMAT "%5.2" EXTENDED_LIMITS 0.00 255.0 /end CHARACTERISTIC
/begin CHARACTERISTIC DFES_Cls.DFC_CEngDsTPlausHSC_C "fault class per DFC / Fault class for check DFC_CEngDsTPlausHSC" VALUE 0x804D95E8 Val_Wu8 30.00 DFES_OneToOne 0.00 30.00 FORMAT "%5.2" EXTENDED_LIMITS 0.00 255.0 /end CHARACTERISTIC
/begin CHARACTERISTIC DFES_Cls.DFC_CEngDsTPlausLSC_C "fault class per DFC / Fault class for check DFC_CEngDsTPlausLSC" VALUE 0x804D95E9 Val_Wu8 30.00 DFES_OneToOne 0.00 30.00 FORMAT "%5.2" EXTENDED_LIMITS 0.00 255.0 /end CHARACTERISTIC
/begin CHARACTERISTIC DFES_Cls.DFC_CEngDsTPlausSTC_C "fault class per DFC / Fault class for check DFC_CEngDsTPlausSTC" VALUE 0x804D95EA Val_Wu8 30.00 DFES_OneToOne 0.00 30.00 FORMAT "%5.2" EXTENDED_LIMITS 0.00 255.0 /end CHARACTERISTIC
/begin CHARACTERISTIC DFES_Cls.DFC_CEngDsTSRCMax_C "fault class per DFC / Fault class for check DFC_CEngDsTSRCMax" VALUE 0x804D95EB Val_Wu8 30.00 DFES_OneToOne 0.00 30.00 FORMAT "%5.2" EXTENDED_LIMITS 0.00 255.0 /end CHARACTERISTIC
/begin CHARACTERISTIC DFES_Cls.DFC_CEngDsTSRCMin_C "fault class per DFC / Fault class for check DFC_CEngDsTSRCMin" VALUE 0x804D95EC Val_Wu8 30.00 DFES_OneToOne 0.00 30.00 FORMAT "%5.2" EXTENDED_LIMITS 0.00 255.0 /end CHARACTERISTIC
/begin CHARACTERISTIC DFES_Cls.DFC_CEngDsTSig_C "fault class per DFC / Fault class for check DFC_CEngDsTSig" VALUE 0x804D95ED Val_Wu8 30.00 DFES_OneToOne 0.00 30.00 FORMAT "%5.2" EXTENDED_LIMITS 0.00 255.0 /end CHARACTERISTIC
/begin CHARACTERISTIC DFES_Cls.DFC_CEngUsTColdStrtMax_C "fault class per DFC / Fault class for check DFC_CEngUsTColdStrtMax" VALUE 0x804D95EE Val_Wu8 30.00 DFES_OneToOne 0.00 30.00 FORMAT "%5.2" EXTENDED_LIMITS 0.00 255.0 /end CHARACTERISTIC
/begin CHARACTERISTIC DFES_Cls.DFC_CEngUsTColdStrtMin_C "fault class per DFC / Fault class for check DFC_CEngUsTColdStrtMin" VALUE 0x804D95EF Val_Wu8 30.00 DFES_OneToOne 0.00 30.00 FORMAT "%5.2" EXTENDED_LIMITS 0.00 255.0 /end CHARACTERISTIC
/begin CHARACTERISTIC DFES_Cls.DFC_CEngUsTLooseCnctn_C "fault class per DFC / Fault class for check DFC_CEngUsTLooseCnctn" VALUE 0x804D95F0 Val_Wu8 30.00 DFES_OneToOne 0.00 30.00 FORMAT "%5.2" EXTENDED_LIMITS 0.00 255.0 /end CHARACTERISTIC
/begin CHARACTERISTIC DFES_Cls.DFC_CEngUsTSRCMax_C "fault class per DFC / Fault class for check DFC_CEngUsTSRCMax" VALUE 0x804D95F1 Val_Wu8 30.00 DFES_OneToOne 0.00 30.00 FORMAT "%5.2" EXTENDED_LIMITS 0.00 255.0 /end CHARACTERISTIC
/begin CHARACTERISTIC DFES_Cls.DFC_CEngUsTSRCMin_C "fault class per DFC / Fault class for check DFC_CEngUsTSRCMin" VALUE 0x804D95F2 Val_Wu8 30.00 DFES_OneToOne 0.00 30.00 FORMAT "%5.2" EXTENDED_LIMITS 0.00 255.0 /end CHARACTERISTIC
/begin CHARACTERISTIC DFES_Cls.DFC_ComDCDCACCFailr_C "fault class per DFC / Fault class for check DFC_ComDCDCACCFailr" VALUE 0x804D95F3 Val_Wu8 30.00 DFES_OneToOne 0.00 30.00 FORMAT "%5.2" EXTENDED_LIMITS 0.00 255.0 /end CHARACTERISTIC
/begin CHARACTERISTIC DFES_Cls.DFC_DCDCFltDet_C "fault class per DFC / Fault class for check DFC_DCDCFltDet" VALUE 0x804D95F4 Val_Wu8 30.00 DFES_OneToOne 0.00 30.00 FORMAT "%5.2" EXTENDED_LIMITS 0.00 255.0 /end CHARACTERISTIC
/begin CHARACTERISTIC DFES_Cls.DFC_DKRSA_C "fault class per DFC / Fault class for check DFC_DKRSA" VALUE 0x804D95F5 Val_Wu8 30.00 DFES_OneToOne 0.00 30.00 FORMAT "%5.2" EXTENDED_LIMITS 0.00 255.0 /end CHARACTERISTIC
/begin CHARACTERISTIC DFES_Cls.DFC_DKVSmax_C "fault class per DFC / Fault class for check DFC_DKVSmax" VALUE 0x804D95F6 Val_Wu8 30.00 DFES_OneToOne 0.00 30.00 FORMAT "%5.2" EXTENDED_LIMITS 0.00 255.0 /end CHARACTERISTIC
/begin CHARACTERISTIC DFES_Cls.DFC_DKnpl_C "fault class per DFC / Fault class for check DFC_DKnpl" VALUE 0x804D95F7 Val_Wu8 30.00 DFES_OneToOne 0.00 30.00 FORMAT "%5.2" EXTENDED_LIMITS 0.00 255.0 /end CHARACTERISTIC
/begin CHARACTERISTIC DFES_Cls.DFC_DSKVRmax_C "fault class per DFC / Fault class for check DFC_DSKVRmax" VALUE 0x804D95F8 Val_Wu8 30.00 DFES_OneToOne 0.00 30.00 FORMAT "%5.2" EXTENDED_LIMITS 0.00 255.0 /end CHARACTERISTIC
/begin CHARACTERISTIC DFES_Cls.DFC_DSKVRmin_C "fault class per DFC / Fault class for check DFC_DSKVRmin" VALUE 0x804D95F9 Val_Wu8 30.00 DFES_OneToOne 0.00 30.00 FORMAT "%5.2" EXTENDED_LIMITS 0.00 255.0 /end CHARACTERISTIC
/begin CHARACTERISTIC DFES_Cls.DFC_DSKVRnpl_C "fault class per DFC / Fault class for check DFC_DSKVRnpl" VALUE 0x804D95FA Val_Wu8 30.00 DFES_OneToOne 0.00 30.00 FORMAT "%5.2" EXTENDED_LIMITS 0.00 255.0 /end CHARACTERISTIC
/begin CHARACTERISTIC DFES_Cls.DFC_DSKVRsig_C "fault class per DFC / Fault class for check DFC_DSKVRsig" VALUE 0x804D95FB Val_Wu8 30.00 DFES_OneToOne 0.00 30.00 FORMAT "%5.2" EXTENDED_LIMITS 0.00 255.0 /end CHARACTERISTIC
/begin CHARACTERISTIC DFES_Cls.DFC_DSKVSsig_C "fault class per DFC / Fault class for check DFC_DSKVSsig" VALUE 0x804D95FC Val_Wu8 30.00 DFES_OneToOne 0.00 30.00 FORMAT "%5.2" EXTENDED_LIMITS 0.00 255.0 /end CHARACTERISTIC
/begin CHARACTERISTIC DFES_Cls.DFC_DSSmax_C "fault class per DFC / Fault class for check DFC_DSSmax" VALUE 0x804D95FD Val_Wu8 30.00 DFES_OneToOne 0.00 30.00 FORMAT "%5.2" EXTENDED_LIMITS 0.00 255.0 /end CHARACTERISTIC
/begin CHARACTERISTIC DFES_Cls.DFC_DSTDmax_C "fault class per DFC / Fault class for check DFC_DSTDmax" VALUE 0x804D95FE Val_Wu8 30.00 DFES_OneToOne 0.00 30.00 FORMAT "%5.2" EXTENDED_LIMITS 0.00 255.0 /end CHARACTERISTIC
/begin CHARACTERISTIC DFES_Cls.DFC_DSTEmax_C "fault class per DFC / Fault class for check DFC_DSTEmax" VALUE 0x804D95FF Val_Wu8 30.00 DFES_OneToOne 0.00 30.00 FORMAT "%5.2" EXTENDED_LIMITS 0.00 255.0 /end CHARACTERISTIC
/begin CHARACTERISTIC DFES_Cls.DFC_DSTEmin_C "fault class per DFC / Fault class for check DFC_DSTEmin" VALUE 0x804D9600 Val_Wu8 30.00 DFES_OneToOne 0.00 30.00 FORMAT "%5.2" EXTENDED_LIMITS 0.00 255.0 /end CHARACTERISTIC
/begin CHARACTERISTIC DFES_Cls.DFC_DSTOFmax_C "fault class per DFC / Fault class for check DFC_DSTOFmax" VALUE 0x804D9601 Val_Wu8 30.00 DFES_OneToOne 0.00 30.00 FORMAT "%5.2" EXTENDED_LIMITS 0.00 255.0 /end CHARACTERISTIC
/begin CHARACTERISTIC DFES_Cls.DFC_DSTRmax_C "fault class per DFC / Fault class for check DFC_DSTRmax" VALUE 0x804D9602 Val_Wu8 30.00 DFES_OneToOne 0.00 30.00 FORMAT "%5.2" EXTENDED_LIMITS 0.00 255.0 /end CHARACTERISTIC
/begin CHARACTERISTIC DFES_Cls.DFC_DSTRmin_C "fault class per DFC / Fault class for check DFC_DSTRmin" VALUE 0x804D9603 Val_Wu8 30.00 DFES_OneToOne 0.00 30.00 FORMAT "%5.2" EXTENDED_LIMITS 0.00 255.0 /end CHARACTERISTIC
/begin CHARACTERISTIC DFES_Cls.DFC_DSTRnpl_C "fault class per DFC / Fault class for check DFC_DSTRnpl" VALUE 0x804D9604 Val_Wu8 30.00 DFES_OneToOne 0.00 30.00 FORMAT "%5.2" EXTENDED_LIMITS 0.00 255.0 /end CHARACTERISTIC
/begin CHARACTERISTIC DFES_Cls.DFC_DSTRsig_C "fault class per DFC / Fault class for check DFC_DSTRsig" VALUE 0x804D9605 Val_Wu8 30.00 DFES_OneToOne 0.00 30.00 FORMAT "%5.2" EXTENDED_LIMITS 0.00 255.0 /end CHARACTERISTIC
/begin CHARACTERISTIC DFES_Cls.DFC_DSTTI_C "fault class per DFC / Fault class for check DFC_DSTTI" VALUE 0x804D9606 Val_Wu8 30.00 DFES_OneToOne 0.00 30.00 FORMAT "%5.2" EXTENDED_LIMITS 0.00 255.0 /end CHARACTERISTIC
/begin CHARACTERISTIC DFES_Cls.DFC_DSUmax_C "fault class per DFC / Fault class for check DFC_DSUmax" VALUE 0x804D9607 Val_Wu8 30.00 DFES_OneToOne 0.00 30.00 FORMAT "%5.2" EXTENDED_LIMITS 0.00 255.0 /end CHARACTERISTIC
/begin CHARACTERISTIC DFES_Cls.DFC_DiagCpv1DteskLoLoadStuckClsd_C "fault class per DFC / Fault class for check DFC_DiagCpv1DteskLoLoadStuckClsd" VALUE 0x804D9608 Val_Wu8 30.00 DFES_OneToOne 0.00 30.00 FORMAT "%5.2" EXTENDED_LIMITS 0.00 255.0 /end CHARACTERISTIC
/begin CHARACTERISTIC DFES_Cls.DFC_DiagCpv1DteskLoLoadStuckOpen_C "fault class per DFC / Fault class for check DFC_DiagCpv1DteskLoLoadStuckOpen" VALUE 0x804D9609 Val_Wu8 30.00 DFES_OneToOne 0.00 30.00 FORMAT "%5.2" EXTENDED_LIMITS 0.00 255.0 /end CHARACTERISTIC
/begin CHARACTERISTIC DFES_Cls.DFC_EGRVlvDrftClsd_C "fault class per DFC / Fault class for check DFC_EGRVlvDrftClsd" VALUE 0x804D960A Val_Wu8 30.00 DFES_OneToOne 0.00 30.00 FORMAT "%5.2" EXTENDED_LIMITS 0.00 255.0 /end CHARACTERISTIC
/begin CHARACTERISTIC DFES_Cls.DFC_EGRVlvDrftOpn_C "fault class per DFC / Fault class for check DFC_EGRVlvDrftOpn" VALUE 0x804D960B Val_Wu8 30.00 DFES_OneToOne 0.00 30.00 FORMAT "%5.2" EXTENDED_LIMITS 0.00 255.0 /end CHARACTERISTIC
/begin CHARACTERISTIC DFES_Cls.DFC_EGRVlvJamVlvClsd_C "fault class per DFC / Fault class for check DFC_EGRVlvJamVlvClsd" VALUE 0x804D960C Val_Wu8 30.00 DFES_OneToOne 0.00 30.00 FORMAT "%5.2" EXTENDED_LIMITS 0.00 255.0 /end CHARACTERISTIC
/begin CHARACTERISTIC DFES_Cls.DFC_EGRVlvJamVlvOpn_C "fault class per DFC / Fault class for check DFC_EGRVlvJamVlvOpn" VALUE 0x804D960D Val_Wu8 30.00 DFES_OneToOne 0.00 30.00 FORMAT "%5.2" EXTENDED_LIMITS 0.00 255.0 /end CHARACTERISTIC
/begin CHARACTERISTIC DFES_Cls.DFC_EGRVlvSprgBrk_C "fault class per DFC / Fault class for check DFC_EGRVlvSprgBrk" VALUE 0x804D960E Val_Wu8 30.00 DFES_OneToOne 0.00 30.00 FORMAT "%5.2" EXTENDED_LIMITS 0.00 255.0 /end CHARACTERISTIC
/begin CHARACTERISTIC DFES_Cls.DFC_EGRVlvTempMdlEEPErr_C "fault class per DFC / Fault class for check DFC_EGRVlvTempMdlEEPErr" VALUE 0x804D960F Val_Wu8 30.00 DFES_OneToOne 0.00 30.00 FORMAT "%5.2" EXTENDED_LIMITS 0.00 255.0 /end CHARACTERISTIC
/begin CHARACTERISTIC DFES_Cls.DFC_EGRVlvTmpErr_C "fault class per DFC / Fault class for check DFC_EGRVlvTmpErr" VALUE 0x804D9610 Val_Wu8 30.00 DFES_OneToOne 0.00 30.00 FORMAT "%5.2" EXTENDED_LIMITS 0.00 255.0 /end CHARACTERISTIC
/begin CHARACTERISTIC DFES_Cls.DFC_EGSDUS2B1LtrDly_C "fault class per DFC / Fault class for check DFC_EGSDUS2B1LtrDly" VALUE 0x804D9611 Val_Wu8 30.00 DFES_OneToOne 0.00 30.00 FORMAT "%5.2" EXTENDED_LIMITS 0.00 255.0 /end CHARACTERISTIC
/begin CHARACTERISTIC DFES_Cls.DFC_EGSDUS2B1LtrPT1_C "fault class per DFC / Fault class for check DFC_EGSDUS2B1LtrPT1" VALUE 0x804D9612 Val_Wu8 30.00 DFES_OneToOne 0.00 30.00 FORMAT "%5.2" EXTENDED_LIMITS 0.00 255.0 /end CHARACTERISTIC
/begin CHARACTERISTIC DFES_Cls.DFC_EGSDUS2B1RtlDly_C "fault class per DFC / Fault class for check DFC_EGSDUS2B1RtlDly" VALUE 0x804D9613 Val_Wu8 30.00 DFES_OneToOne 0.00 30.00 FORMAT "%5.2" EXTENDED_LIMITS 0.00 255.0 /end CHARACTERISTIC
/begin CHARACTERISTIC DFES_Cls.DFC_EGSDUS2B1RtlPT1_C "fault class per DFC / Fault class for check DFC_EGSDUS2B1RtlPT1" VALUE 0x804D9614 Val_Wu8 30.00 DFES_OneToOne 0.00 30.00 FORMAT "%5.2" EXTENDED_LIMITS 0.00 255.0 /end CHARACTERISTIC
/begin CHARACTERISTIC DFES_Cls.DFC_EGSDUS2B1TarLean_C "fault class per DFC / Fault class for check DFC_EGSDUS2B1TarLean" VALUE 0x804D9615 Val_Wu8 30.00 DFES_OneToOne 0.00 30.00 FORMAT "%5.2" EXTENDED_LIMITS 0.00 255.0 /end CHARACTERISTIC
/begin CHARACTERISTIC DFES_Cls.DFC_EGSDUS2B1TarRich_C "fault class per DFC / Fault class for check DFC_EGSDUS2B1TarRich" VALUE 0x804D9616 Val_Wu8 30.00 DFES_OneToOne 0.00 30.00 FORMAT "%5.2" EXTENDED_LIMITS 0.00 255.0 /end CHARACTERISTIC
/begin CHARACTERISTIC DFES_Cls.DFC_EONVmax_C "fault class per DFC / Fault class for check DFC_EONVmax" VALUE 0x804D9617 Val_Wu8 30.00 DFES_OneToOne 0.00 30.00 FORMAT "%5.2" EXTENDED_LIMITS 0.00 255.0 /end CHARACTERISTIC
/begin CHARACTERISTIC DFES_Cls.DFC_ETAKHLmax_C "fault class per DFC / Fault class for check DFC_ETAKHLmax" VALUE 0x804D9618 Val_Wu8 30.00 DFES_OneToOne 0.00 30.00 FORMAT "%5.2" EXTENDED_LIMITS 0.00 255.0 /end CHARACTERISTIC
/begin CHARACTERISTIC DFES_Cls.DFC_ETAKHTmax_C "fault class per DFC / Fault class for check DFC_ETAKHTmax" VALUE 0x804D9619 Val_Wu8 30.00 DFES_OneToOne 0.00 30.00 FORMAT "%5.2" EXTENDED_LIMITS 0.00 255.0 /end CHARACTERISTIC
/begin CHARACTERISTIC DFES_Cls.DFC_ETHSEmax_C "fault class per DFC / Fault class for check DFC_ETHSEmax" VALUE 0x804D961A Val_Wu8 30.00 DFES_OneToOne 0.00 30.00 FORMAT "%5.2" EXTENDED_LIMITS 0.00 255.0 /end CHARACTERISTIC
/begin CHARACTERISTIC DFES_Cls.DFC_ETHSEmin_C "fault class per DFC / Fault class for check DFC_ETHSEmin" VALUE 0x804D961B Val_Wu8 30.00 DFES_OneToOne 0.00 30.00 FORMAT "%5.2" EXTENDED_LIMITS 0.00 255.0 /end CHARACTERISTIC
/begin CHARACTERISTIC DFES_Cls.DFC_ETHSFmax_C "fault class per DFC / Fault class for check DFC_ETHSFmax" VALUE 0x804D961C Val_Wu8 30.00 DFES_OneToOne 0.00 30.00 FORMAT "%5.2" EXTENDED_LIMITS 0.00 255.0 /end CHARACTERISTIC
/begin CHARACTERISTIC DFES_Cls.DFC_ETHSFmin_C "fault class per DFC / Fault class for check DFC_ETHSFmin" VALUE 0x804D961D Val_Wu8 30.00 DFES_OneToOne 0.00 30.00 FORMAT "%5.2" EXTENDED_LIMITS 0.00 255.0 /end CHARACTERISTIC
/begin CHARACTERISTIC DFES_Cls.DFC_ETHSFsig_C "fault class per DFC / Fault class for check DFC_ETHSFsig" VALUE 0x804D961E Val_Wu8 30.00 DFES_OneToOne 0.00 30.00 FORMAT "%5.2" EXTENDED_LIMITS 0.00 255.0 /end CHARACTERISTIC
/begin CHARACTERISTIC DFES_Cls.DFC_ETHSNPWmax_C "fault class per DFC / Fault class for check DFC_ETHSNPWmax" VALUE 0x804D961F Val_Wu8 30.00 DFES_OneToOne 0.00 30.00 FORMAT "%5.2" EXTENDED_LIMITS 0.00 255.0 /end CHARACTERISTIC
/begin CHARACTERISTIC DFES_Cls.DFC_ETHSNPWmin_C "fault class per DFC / Fault class for check DFC_ETHSNPWmin" VALUE 0x804D9620 Val_Wu8 30.00 DFES_OneToOne 0.00 30.00 FORMAT "%5.2" EXTENDED_LIMITS 0.00 255.0 /end CHARACTERISTIC
/begin CHARACTERISTIC DFES_Cls.DFC_ETHSNPWsig_C "fault class per DFC / Fault class for check DFC_ETHSNPWsig" VALUE 0x804D9621 Val_Wu8 30.00 DFES_OneToOne 0.00 30.00 FORMAT "%5.2" EXTENDED_LIMITS 0.00 255.0 /end CHARACTERISTIC
/begin CHARACTERISTIC DFES_Cls.DFC_ETHSPLnpl_C "fault class per DFC / Fault class for check DFC_ETHSPLnpl" VALUE 0x804D9622 Val_Wu8 30.00 DFES_OneToOne 0.00 30.00 FORMAT "%5.2" EXTENDED_LIMITS 0.00 255.0 /end CHARACTERISTIC
/begin CHARACTERISTIC DFES_Cls.DFC_ETHSTPLnpl_C "fault class per DFC / Fault class for check DFC_ETHSTPLnpl" VALUE 0x804D9623 Val_Wu8 30.00 DFES_OneToOne 0.00 30.00 FORMAT "%5.2" EXTENDED_LIMITS 0.00 255.0 /end CHARACTERISTIC
/begin CHARACTERISTIC DFES_Cls.DFC_EngICO_C "fault class per DFC / Fault class for check DFC_EngICO" VALUE 0x804D9624 Val_Wu8 30.00 DFES_OneToOne 0.00 30.00 FORMAT "%5.2" EXTENDED_LIMITS 0.00 255.0 /end CHARACTERISTIC
/begin CHARACTERISTIC DFES_Cls.DFC_EngPrtOvrSpdMon_C "fault class per DFC / Fault class for check DFC_EngPrtOvrSpdMon" VALUE 0x804D9625 Val_Wu8 30.00 DFES_OneToOne 0.00 30.00 FORMAT "%5.2" EXTENDED_LIMITS 0.00 255.0 /end CHARACTERISTIC
/begin CHARACTERISTIC DFES_Cls.DFC_EpmCaSI1ErrSig_C "fault class per DFC / Fault class for check DFC_EpmCaSI1ErrSig" VALUE 0x804D9626 Val_Wu8 30.00 DFES_OneToOne 0.00 30.00 FORMAT "%5.2" EXTENDED_LIMITS 0.00 255.0 /end CHARACTERISTIC
/begin CHARACTERISTIC DFES_Cls.DFC_EpmCaSI1MntErr_C "fault class per DFC / Fault class for check DFC_EpmCaSI1MntErr" VALUE 0x804D9627 Val_Wu8 30.00 DFES_OneToOne 0.00 30.00 FORMAT "%5.2" EXTENDED_LIMITS 0.00 255.0 /end CHARACTERISTIC
/begin CHARACTERISTIC DFES_Cls.DFC_EpmCaSI1NoSigMax_C "fault class per DFC / Fault class for check DFC_EpmCaSI1NoSigMax" VALUE 0x804D9628 Val_Wu8 30.00 DFES_OneToOne 0.00 30.00 FORMAT "%5.2" EXTENDED_LIMITS 0.00 255.0 /end CHARACTERISTIC
/begin CHARACTERISTIC DFES_Cls.DFC_EpmCaSI1NoSigMin_C "fault class per DFC / Fault class for check DFC_EpmCaSI1NoSigMin" VALUE 0x804D9629 Val_Wu8 30.00 DFES_OneToOne 0.00 30.00 FORMAT "%5.2" EXTENDED_LIMITS 0.00 255.0 /end CHARACTERISTIC
/begin CHARACTERISTIC DFES_Cls.DFC_EpmCaSI1OfsErr_C "fault class per DFC / Fault class for check DFC_EpmCaSI1OfsErr" VALUE 0x804D962A Val_Wu8 30.00 DFES_OneToOne 0.00 30.00 FORMAT "%5.2" EXTENDED_LIMITS 0.00 255.0 /end CHARACTERISTIC
/begin CHARACTERISTIC DFES_Cls.DFC_EpmCrSDGI_C "fault class per DFC / Fault class for check DFC_EpmCrSDGI" VALUE 0x804D962B Val_Wu8 30.00 DFES_OneToOne 0.00 30.00 FORMAT "%5.2" EXTENDED_LIMITS 0.00 255.0 /end CHARACTERISTIC
/begin CHARACTERISTIC DFES_Cls.DFC_EpmCrSErrSig_C "fault class per DFC / Fault class for check DFC_EpmCrSErrSig" VALUE 0x804D962C Val_Wu8 30.00 DFES_OneToOne 0.00 30.00 FORMAT "%5.2" EXTENDED_LIMITS 0.00 255.0 /end CHARACTERISTIC
/begin CHARACTERISTIC DFES_Cls.DFC_EpmCrSNoSig_C "fault class per DFC / Fault class for check DFC_EpmCrSNoSig" VALUE 0x804D962D Val_Wu8 30.00 DFES_OneToOne 0.00 30.00 FORMAT "%5.2" EXTENDED_LIMITS 0.00 255.0 /end CHARACTERISTIC
/begin CHARACTERISTIC DFES_Cls.DFC_EtaEngIdleNonCsers_C "fault class per DFC / Fault class for check DFC_EtaEngIdleNonCsers" VALUE 0x804D962E Val_Wu8 30.00 DFES_OneToOne 0.00 30.00 FORMAT "%5.2" EXTENDED_LIMITS 0.00 255.0 /end CHARACTERISTIC
/begin CHARACTERISTIC DFES_Cls.DFC_EtaEngPtlNonCsers_C "fault class per DFC / Fault class for check DFC_EtaEngPtlNonCsers" VALUE 0x804D962F Val_Wu8 30.00 DFES_OneToOne 0.00 30.00 FORMAT "%5.2" EXTENDED_LIMITS 0.00 255.0 /end CHARACTERISTIC
/begin CHARACTERISTIC DFES_Cls.DFC_FRAmax_C "fault class per DFC / Fault class for check DFC_FRAmax" VALUE 0x804D9630 Val_Wu8 30.00 DFES_OneToOne 0.00 30.00 FORMAT "%5.2" EXTENDED_LIMITS 0.00 255.0 /end CHARACTERISTIC
/begin CHARACTERISTIC DFES_Cls.DFC_FRAmin_C "fault class per DFC / Fault class for check DFC_FRAmin" VALUE 0x804D9631 Val_Wu8 30.00 DFES_OneToOne 0.00 30.00 FORMAT "%5.2" EXTENDED_LIMITS 0.00 255.0 /end CHARACTERISTIC
/begin CHARACTERISTIC DFES_Cls.DFC_FSTEmax_C "fault class per DFC / Fault class for check DFC_FSTEmax" VALUE 0x804D9632 Val_Wu8 30.00 DFES_OneToOne 0.00 30.00 FORMAT "%5.2" EXTENDED_LIMITS 0.00 255.0 /end CHARACTERISTIC
/begin CHARACTERISTIC DFES_Cls.DFC_FSTEmin_C "fault class per DFC / Fault class for check DFC_FSTEmin" VALUE 0x804D9633 Val_Wu8 30.00 DFES_OneToOne 0.00 30.00 FORMAT "%5.2" EXTENDED_LIMITS 0.00 255.0 /end CHARACTERISTIC
/begin CHARACTERISTIC DFES_Cls.DFC_FSTRmax_C "fault class per DFC / Fault class for check DFC_FSTRmax" VALUE 0x804D9634 Val_Wu8 30.00 DFES_OneToOne 0.00 30.00 FORMAT "%5.2" EXTENDED_LIMITS 0.00 255.0 /end CHARACTERISTIC
/begin CHARACTERISTIC DFES_Cls.DFC_FSTRmin_C "fault class per DFC / Fault class for check DFC_FSTRmin" VALUE 0x804D9635 Val_Wu8 30.00 DFES_OneToOne 0.00 30.00 FORMAT "%5.2" EXTENDED_LIMITS 0.00 255.0 /end CHARACTERISTIC
/begin CHARACTERISTIC DFES_Cls.DFC_FSTRnpl_C "fault class per DFC / Fault class for check DFC_FSTRnpl" VALUE 0x804D9636 Val_Wu8 30.00 DFES_OneToOne 0.00 30.00 FORMAT "%5.2" EXTENDED_LIMITS 0.00 255.0 /end CHARACTERISTIC
/begin CHARACTERISTIC DFES_Cls.DFC_FSTmax_C "fault class per DFC / Fault class for check DFC_FSTmax" VALUE 0x804D9637 Val_Wu8 30.00 DFES_OneToOne 0.00 30.00 FORMAT "%5.2" EXTENDED_LIMITS 0.00 255.0 /end CHARACTERISTIC
/begin CHARACTERISTIC DFES_Cls.DFC_FTDLAmax_C "fault class per DFC / Fault class for check DFC_FTDLAmax" VALUE 0x804D9638 Val_Wu8 30.00 DFES_OneToOne 0.00 30.00 FORMAT "%5.2" EXTENDED_LIMITS 0.00 255.0 /end CHARACTERISTIC
/begin CHARACTERISTIC DFES_Cls.DFC_FTDLAmin_C "fault class per DFC / Fault class for check DFC_FTDLAmin" VALUE 0x804D9639 Val_Wu8 30.00 DFES_OneToOne 0.00 30.00 FORMAT "%5.2" EXTENDED_LIMITS 0.00 255.0 /end CHARACTERISTIC
/begin CHARACTERISTIC DFES_Cls.DFC_FuPHiSnsrEleclmax_C "fault class per DFC / Fault class for check DFC_FuPHiSnsrEleclmax" VALUE 0x804D963A Val_Wu8 30.00 DFES_OneToOne 0.00 30.00 FORMAT "%5.2" EXTENDED_LIMITS 0.00 255.0 /end CHARACTERISTIC
/begin CHARACTERISTIC DFES_Cls.DFC_FuPHiSnsrEleclmin_C "fault class per DFC / Fault class for check DFC_FuPHiSnsrEleclmin" VALUE 0x804D963B Val_Wu8 30.00 DFES_OneToOne 0.00 30.00 FORMAT "%5.2" EXTENDED_LIMITS 0.00 255.0 /end CHARACTERISTIC
/begin CHARACTERISTIC DFES_Cls.DFC_FuPHiSnsrEleclnpl_C "fault class per DFC / Fault class for check DFC_FuPHiSnsrEleclnpl" VALUE 0x804D963C Val_Wu8 30.00 DFES_OneToOne 0.00 30.00 FORMAT "%5.2" EXTENDED_LIMITS 0.00 255.0 /end CHARACTERISTIC
/begin CHARACTERISTIC DFES_Cls.DFC_FuPHiSnsrURngMax_C "fault class per DFC / Fault class for check DFC_FuPHiSnsrURngMax" VALUE 0x804D963D Val_Wu8 30.00 DFES_OneToOne 0.00 30.00 FORMAT "%5.2" EXTENDED_LIMITS 0.00 255.0 /end CHARACTERISTIC
/begin CHARACTERISTIC DFES_Cls.DFC_FuPHiSnsrURngMin_C "fault class per DFC / Fault class for check DFC_FuPHiSnsrURngMin" VALUE 0x804D963E Val_Wu8 30.00 DFES_OneToOne 0.00 30.00 FORMAT "%5.2" EXTENDED_LIMITS 0.00 255.0 /end CHARACTERISTIC
/begin CHARACTERISTIC DFES_Cls.DFC_FuSnsrPhyRngMaxErr_C "fault class per DFC / Fault class for check DFC_FuSnsrPhyRngMaxErr" VALUE 0x804D963F Val_Wu8 30.00 DFES_OneToOne 0.00 30.00 FORMAT "%5.2" EXTENDED_LIMITS 0.00 255.0 /end CHARACTERISTIC
/begin CHARACTERISTIC DFES_Cls.DFC_FuSnsrPhyRngMinErr_C "fault class per DFC / Fault class for check DFC_FuSnsrPhyRngMinErr" VALUE 0x804D9640 Val_Wu8 30.00 DFES_OneToOne 0.00 30.00 FORMAT "%5.2" EXTENDED_LIMITS 0.00 255.0 /end CHARACTERISTIC
/begin CHARACTERISTIC DFES_Cls.DFC_GEVlvLockPinDiagIntkB1_C "fault class per DFC / Fault class for check DFC_GEVlvLockPinDiagIntkB1" VALUE 0x804D9641 Val_Wu8 30.00 DFES_OneToOne 0.00 30.00 FORMAT "%5.2" EXTENDED_LIMITS 0.00 255.0 /end CHARACTERISTIC
/begin CHARACTERISTIC DFES_Cls.DFC_GEVlvPhaSlowIntkB1_C "fault class per DFC / Fault class for check DFC_GEVlvPhaSlowIntkB1" VALUE 0x804D9642 Val_Wu8 30.00 DFES_OneToOne 0.00 30.00 FORMAT "%5.2" EXTENDED_LIMITS 0.00 255.0 /end CHARACTERISTIC
/begin CHARACTERISTIC DFES_Cls.DFC_GEVlvPhaTargIntkB1_C "fault class per DFC / Fault class for check DFC_GEVlvPhaTargIntkB1" VALUE 0x804D9643 Val_Wu8 30.00 DFES_OneToOne 0.00 30.00 FORMAT "%5.2" EXTENDED_LIMITS 0.00 255.0 /end CHARACTERISTIC
/begin CHARACTERISTIC DFES_Cls.DFC_GbxRvsSwtStk_C "fault class per DFC / Fault class for check DFC_GbxRvsSwtStk" VALUE 0x804D9644 Val_Wu8 30.00 DFES_OneToOne 0.00 30.00 FORMAT "%5.2" EXTENDED_LIMITS 0.00 255.0 /end CHARACTERISTIC
/begin CHARACTERISTIC DFES_Cls.DFC_HDRKHmax_C "fault class per DFC / Fault class for check DFC_HDRKHmax" VALUE 0x804D9645 Val_Wu8 30.00 DFES_OneToOne 0.00 30.00 FORMAT "%5.2" EXTENDED_LIMITS 0.00 255.0 /end CHARACTERISTIC
/begin CHARACTERISTIC DFES_Cls.DFC_HDRKHmin_C "fault class per DFC / Fault class for check DFC_HDRKHmin" VALUE 0x804D9646 Val_Wu8 30.00 DFES_OneToOne 0.00 30.00 FORMAT "%5.2" EXTENDED_LIMITS 0.00 255.0 /end CHARACTERISTIC
/begin CHARACTERISTIC DFES_Cls.DFC_HDRPLmax_C "fault class per DFC / Fault class for check DFC_HDRPLmax" VALUE 0x804D9647 Val_Wu8 30.00 DFES_OneToOne 0.00 30.00 FORMAT "%5.2" EXTENDED_LIMITS 0.00 255.0 /end CHARACTERISTIC
/begin CHARACTERISTIC DFES_Cls.DFC_HDRPLmin_C "fault class per DFC / Fault class for check DFC_HDRPLmin" VALUE 0x804D9648 Val_Wu8 30.00 DFES_OneToOne 0.00 30.00 FORMAT "%5.2" EXTENDED_LIMITS 0.00 255.0 /end CHARACTERISTIC
/begin CHARACTERISTIC DFES_Cls.DFC_HDRmax_C "fault class per DFC / Fault class for check DFC_HDRmax" VALUE 0x804D9649 Val_Wu8 30.00 DFES_OneToOne 0.00 30.00 FORMAT "%5.2" EXTENDED_LIMITS 0.00 255.0 /end CHARACTERISTIC
/begin CHARACTERISTIC DFES_Cls.DFC_HDRmin_C "fault class per DFC / Fault class for check DFC_HDRmin" VALUE 0x804D964A Val_Wu8 30.00 DFES_OneToOne 0.00 30.00 FORMAT "%5.2" EXTENDED_LIMITS 0.00 255.0 /end CHARACTERISTIC
/begin CHARACTERISTIC DFES_Cls.DFC_HEGOS2B1ElecMax_C "fault class per DFC / Fault class for check DFC_HEGOS2B1ElecMax" VALUE 0x804D964B Val_Wu8 30.00 DFES_OneToOne 0.00 30.00 FORMAT "%5.2" EXTENDED_LIMITS 0.00 255.0 /end CHARACTERISTIC
/begin CHARACTERISTIC DFES_Cls.DFC_HEGOS2B1ElecMin_C "fault class per DFC / Fault class for check DFC_HEGOS2B1ElecMin" VALUE 0x804D964C Val_Wu8 30.00 DFES_OneToOne 0.00 30.00 FORMAT "%5.2" EXTENDED_LIMITS 0.00 255.0 /end CHARACTERISTIC
/begin CHARACTERISTIC DFES_Cls.DFC_HEGOS2B1ElecSig_C "fault class per DFC / Fault class for check DFC_HEGOS2B1ElecSig" VALUE 0x804D964D Val_Wu8 30.00 DFES_OneToOne 0.00 30.00 FORMAT "%5.2" EXTENDED_LIMITS 0.00 255.0 /end CHARACTERISTIC
/begin CHARACTERISTIC DFES_Cls.DFC_HEGOS2B1HtgNpl_C "fault class per DFC / Fault class for check DFC_HEGOS2B1HtgNpl" VALUE 0x804D964E Val_Wu8 30.00 DFES_OneToOne 0.00 30.00 FORMAT "%5.2" EXTENDED_LIMITS 0.00 255.0 /end CHARACTERISTIC
/begin CHARACTERISTIC DFES_Cls.DFC_HEV00max_C "fault class per DFC / Fault class for check DFC_HEV00max" VALUE 0x804D964F Val_Wu8 30.00 DFES_OneToOne 0.00 30.00 FORMAT "%5.2" EXTENDED_LIMITS 0.00 255.0 /end CHARACTERISTIC
/begin CHARACTERISTIC DFES_Cls.DFC_HEV01max_C "fault class per DFC / Fault class for check DFC_HEV01max" VALUE 0x804D9650 Val_Wu8 30.00 DFES_OneToOne 0.00 30.00 FORMAT "%5.2" EXTENDED_LIMITS 0.00 255.0 /end CHARACTERISTIC
/begin CHARACTERISTIC DFES_Cls.DFC_HEV02max_C "fault class per DFC / Fault class for check DFC_HEV02max" VALUE 0x804D9651 Val_Wu8 30.00 DFES_OneToOne 0.00 30.00 FORMAT "%5.2" EXTENDED_LIMITS 0.00 255.0 /end CHARACTERISTIC
/begin CHARACTERISTIC DFES_Cls.DFC_HEV03max_C "fault class per DFC / Fault class for check DFC_HEV03max" VALUE 0x804D9652 Val_Wu8 30.00 DFES_OneToOne 0.00 30.00 FORMAT "%5.2" EXTENDED_LIMITS 0.00 255.0 /end CHARACTERISTIC
/begin CHARACTERISTIC DFES_Cls.DFC_HEVE0max_C "fault class per DFC / Fault class for check DFC_HEVE0max" VALUE 0x804D9653 Val_Wu8 30.00 DFES_OneToOne 0.00 30.00 FORMAT "%5.2" EXTENDED_LIMITS 0.00 255.0 /end CHARACTERISTIC
/begin CHARACTERISTIC DFES_Cls.DFC_HEVE1max_C "fault class per DFC / Fault class for check DFC_HEVE1max" VALUE 0x804D9654 Val_Wu8 30.00 DFES_OneToOne 0.00 30.00 FORMAT "%5.2" EXTENDED_LIMITS 0.00 255.0 /end CHARACTERISTIC
/begin CHARACTERISTIC DFES_Cls.DFC_HFMmax_C "fault class per DFC / Fault class for check DFC_HFMmax" VALUE 0x804D9655 Val_Wu8 30.00 DFES_OneToOne 0.00 30.00 FORMAT "%5.2" EXTENDED_LIMITS 0.00 255.0 /end CHARACTERISTIC
/begin CHARACTERISTIC DFES_Cls.DFC_HiPSysHiPMaxLimExcdd_C "fault class per DFC / Fault class for check DFC_HiPSysHiPMaxLimExcdd" VALUE 0x804D9656 Val_Wu8 30.00 DFES_OneToOne 0.00 30.00 FORMAT "%5.2" EXTENDED_LIMITS 0.00 255.0 /end CHARACTERISTIC
/begin CHARACTERISTIC DFES_Cls.DFC_IVGdiCtlCvoErrMax_0_C "fault class per DFC / Fault class for check DFC_IVGdiCtlCvoErrMax_0" VALUE 0x804D9657 Val_Wu8 30.00 DFES_OneToOne 0.00 30.00 FORMAT "%5.2" EXTENDED_LIMITS 0.00 255.0 /end CHARACTERISTIC
/begin CHARACTERISTIC DFES_Cls.DFC_IVGdiCtlCvoErrMax_1_C "fault class per DFC / Fault class for check DFC_IVGdiCtlCvoErrMax_1" VALUE 0x804D9658 Val_Wu8 30.00 DFES_OneToOne 0.00 30.00 FORMAT "%5.2" EXTENDED_LIMITS 0.00 255.0 /end CHARACTERISTIC
/begin CHARACTERISTIC DFES_Cls.DFC_IVGdiCtlCvoErrMax_2_C "fault class per DFC / Fault class for check DFC_IVGdiCtlCvoErrMax_2" VALUE 0x804D9659 Val_Wu8 30.00 DFES_OneToOne 0.00 30.00 FORMAT "%5.2" EXTENDED_LIMITS 0.00 255.0 /end CHARACTERISTIC
/begin CHARACTERISTIC DFES_Cls.DFC_IVGdiCtlCvoErrMax_3_C "fault class per DFC / Fault class for check DFC_IVGdiCtlCvoErrMax_3" VALUE 0x804D965A Val_Wu8 30.00 DFES_OneToOne 0.00 30.00 FORMAT "%5.2" EXTENDED_LIMITS 0.00 255.0 /end CHARACTERISTIC
/begin CHARACTERISTIC DFES_Cls.DFC_IVGdiCtlCvoErrMin_0_C "fault class per DFC / Fault class for check DFC_IVGdiCtlCvoErrMin_0" VALUE 0x804D965B Val_Wu8 30.00 DFES_OneToOne 0.00 30.00 FORMAT "%5.2" EXTENDED_LIMITS 0.00 255.0 /end CHARACTERISTIC
/begin CHARACTERISTIC DFES_Cls.DFC_IVGdiCtlCvoErrMin_1_C "fault class per DFC / Fault class for check DFC_IVGdiCtlCvoErrMin_1" VALUE 0x804D965C Val_Wu8 30.00 DFES_OneToOne 0.00 30.00 FORMAT "%5.2" EXTENDED_LIMITS 0.00 255.0 /end CHARACTERISTIC
/begin CHARACTERISTIC DFES_Cls.DFC_IVGdiCtlCvoErrMin_2_C "fault class per DFC / Fault class for check DFC_IVGdiCtlCvoErrMin_2" VALUE 0x804D965D Val_Wu8 30.00 DFES_OneToOne 0.00 30.00 FORMAT "%5.2" EXTENDED_LIMITS 0.00 255.0 /end CHARACTERISTIC
/begin CHARACTERISTIC DFES_Cls.DFC_IVGdiCtlCvoErrMin_3_C "fault class per DFC / Fault class for check DFC_IVGdiCtlCvoErrMin_3" VALUE 0x804D965E Val_Wu8 30.00 DFES_OneToOne 0.00 30.00 FORMAT "%5.2" EXTENDED_LIMITS 0.00 255.0 /end CHARACTERISTIC
/begin CHARACTERISTIC DFES_Cls.DFC_IVGdiCtlCvoErrMinMax_C "fault class per DFC / Fault class for check DFC_IVGdiCtlCvoErrMinMax" VALUE 0x804D965F Val_Wu8 30.00 DFES_OneToOne 0.00 30.00 FORMAT "%5.2" EXTENDED_LIMITS 0.00 255.0 /end CHARACTERISTIC
/begin CHARACTERISTIC DFES_Cls.DFC_IVGdiCtlCvoSigPlausErrSmrCdn_C "fault class per DFC / Fault class for check DFC_IVGdiCtlCvoSigPlausErrSmrCdn" VALUE 0x804D9660 Val_Wu8 30.00 DFES_OneToOne 0.00 30.00 FORMAT "%5.2" EXTENDED_LIMITS 0.00 255.0 /end CHARACTERISTIC
/begin CHARACTERISTIC DFES_Cls.DFC_IVGdiCtl_CvoErr_C "fault class per DFC / Fault class for check DFC_IVGdiCtl_CvoErr" VALUE 0x804D9661 Val_Wu8 30.00 DFES_OneToOne 0.00 30.00 FORMAT "%5.2" EXTENDED_LIMITS 0.00 255.0 /end CHARACTERISTIC
/begin CHARACTERISTIC DFES_Cls.DFC_IVGdiCtl_CvoSigPlaus_0_C "fault class per DFC / Fault class for check DFC_IVGdiCtl_CvoSigPlaus_0" VALUE 0x804D9662 Val_Wu8 30.00 DFES_OneToOne 0.00 30.00 FORMAT "%5.2" EXTENDED_LIMITS 0.00 255.0 /end CHARACTERISTIC
/begin CHARACTERISTIC DFES_Cls.DFC_IVGdiCtl_CvoSigPlaus_1_C "fault class per DFC / Fault class for check DFC_IVGdiCtl_CvoSigPlaus_1" VALUE 0x804D9663 Val_Wu8 30.00 DFES_OneToOne 0.00 30.00 FORMAT "%5.2" EXTENDED_LIMITS 0.00 255.0 /end CHARACTERISTIC
/begin CHARACTERISTIC DFES_Cls.DFC_IVGdiCtl_CvoSigPlaus_2_C "fault class per DFC / Fault class for check DFC_IVGdiCtl_CvoSigPlaus_2" VALUE 0x804D9664 Val_Wu8 30.00 DFES_OneToOne 0.00 30.00 FORMAT "%5.2" EXTENDED_LIMITS 0.00 255.0 /end CHARACTERISTIC
/begin CHARACTERISTIC DFES_Cls.DFC_IVGdiCtl_CvoSigPlaus_3_C "fault class per DFC / Fault class for check DFC_IVGdiCtl_CvoSigPlaus_3" VALUE 0x804D9665 Val_Wu8 30.00 DFES_OneToOne 0.00 30.00 FORMAT "%5.2" EXTENDED_LIMITS 0.00 255.0 /end CHARACTERISTIC
/begin CHARACTERISTIC DFES_Cls.DFC_IntkAirTAirFltDsCrssMax_C "fault class per DFC / Fault class for check DFC_IntkAirTAirFltDsCrssMax" VALUE 0x804D9666 Val_Wu8 30.00 DFES_OneToOne 0.00 30.00 FORMAT "%5.2" EXTENDED_LIMITS 0.00 255.0 /end CHARACTERISTIC
/begin CHARACTERISTIC DFES_Cls.DFC_IntkAirTAirFltDsCrssMin_C "fault class per DFC / Fault class for check DFC_IntkAirTAirFltDsCrssMin" VALUE 0x804D9667 Val_Wu8 30.00 DFES_OneToOne 0.00 30.00 FORMAT "%5.2" EXTENDED_LIMITS 0.00 255.0 /end CHARACTERISTIC
/begin CHARACTERISTIC DFES_Cls.DFC_IntkAirTAirFltDsHSCMax_C "fault class per DFC / Fault class for check DFC_IntkAirTAirFltDsHSCMax" VALUE 0x804D9668 Val_Wu8 30.00 DFES_OneToOne 0.00 30.00 FORMAT "%5.2" EXTENDED_LIMITS 0.00 255.0 /end CHARACTERISTIC
/begin CHARACTERISTIC DFES_Cls.DFC_IntkAirTAirFltDsImps_C "fault class per DFC / Fault class for check DFC_IntkAirTAirFltDsImps" VALUE 0x804D9669 Val_Wu8 30.00 DFES_OneToOne 0.00 30.00 FORMAT "%5.2" EXTENDED_LIMITS 0.00 255.0 /end CHARACTERISTIC
/begin CHARACTERISTIC DFES_Cls.DFC_IntkAirTAirFltDsPRCMax_C "fault class per DFC / Fault class for check DFC_IntkAirTAirFltDsPRCMax" VALUE 0x804D966A Val_Wu8 30.00 DFES_OneToOne 0.00 30.00 FORMAT "%5.2" EXTENDED_LIMITS 0.00 255.0 /end CHARACTERISTIC
/begin CHARACTERISTIC DFES_Cls.DFC_IntkAirTAirFltDsPRCMin_C "fault class per DFC / Fault class for check DFC_IntkAirTAirFltDsPRCMin" VALUE 0x804D966B Val_Wu8 30.00 DFES_OneToOne 0.00 30.00 FORMAT "%5.2" EXTENDED_LIMITS 0.00 255.0 /end CHARACTERISTIC
/begin CHARACTERISTIC DFES_Cls.DFC_IntkAirTAirFltDsSRCMax_C "fault class per DFC / Fault class for check DFC_IntkAirTAirFltDsSRCMax" VALUE 0x804D966C Val_Wu8 30.00 DFES_OneToOne 0.00 30.00 FORMAT "%5.2" EXTENDED_LIMITS 0.00 255.0 /end CHARACTERISTIC
/begin CHARACTERISTIC DFES_Cls.DFC_IntkAirTAirFltDsSRCMin_C "fault class per DFC / Fault class for check DFC_IntkAirTAirFltDsSRCMin" VALUE 0x804D966D Val_Wu8 30.00 DFES_OneToOne 0.00 30.00 FORMAT "%5.2" EXTENDED_LIMITS 0.00 255.0 /end CHARACTERISTIC
/begin CHARACTERISTIC DFES_Cls.DFC_IntkAirTAirFltDsSTC_C "fault class per DFC / Fault class for check DFC_IntkAirTAirFltDsSTC" VALUE 0x804D966E Val_Wu8 30.00 DFES_OneToOne 0.00 30.00 FORMAT "%5.2" EXTENDED_LIMITS 0.00 255.0 /end CHARACTERISTIC
/begin CHARACTERISTIC DFES_Cls.DFC_IntkAirTIntkMnfldCrssMax_C "fault class per DFC / Fault class for check DFC_IntkAirTIntkMnfldCrssMax" VALUE 0x804D966F Val_Wu8 30.00 DFES_OneToOne 0.00 30.00 FORMAT "%5.2" EXTENDED_LIMITS 0.00 255.0 /end CHARACTERISTIC
/begin CHARACTERISTIC DFES_Cls.DFC_IntkAirTIntkMnfldCrssMin_C "fault class per DFC / Fault class for check DFC_IntkAirTIntkMnfldCrssMin" VALUE 0x804D9670 Val_Wu8 30.00 DFES_OneToOne 0.00 30.00 FORMAT "%5.2" EXTENDED_LIMITS 0.00 255.0 /end CHARACTERISTIC
/begin CHARACTERISTIC DFES_Cls.DFC_IntkAirTIntkMnfldHSCMax_C "fault class per DFC / Fault class for check DFC_IntkAirTIntkMnfldHSCMax" VALUE 0x804D9671 Val_Wu8 30.00 DFES_OneToOne 0.00 30.00 FORMAT "%5.2" EXTENDED_LIMITS 0.00 255.0 /end CHARACTERISTIC
/begin CHARACTERISTIC DFES_Cls.DFC_IntkAirTIntkMnfldImps_C "fault class per DFC / Fault class for check DFC_IntkAirTIntkMnfldImps" VALUE 0x804D9672 Val_Wu8 30.00 DFES_OneToOne 0.00 30.00 FORMAT "%5.2" EXTENDED_LIMITS 0.00 255.0 /end CHARACTERISTIC
/begin CHARACTERISTIC DFES_Cls.DFC_IntkAirTIntkMnfldPRCMax_C "fault class per DFC / Fault class for check DFC_IntkAirTIntkMnfldPRCMax" VALUE 0x804D9673 Val_Wu8 30.00 DFES_OneToOne 0.00 30.00 FORMAT "%5.2" EXTENDED_LIMITS 0.00 255.0 /end CHARACTERISTIC
/begin CHARACTERISTIC DFES_Cls.DFC_IntkAirTIntkMnfldPRCMin_C "fault class per DFC / Fault class for check DFC_IntkAirTIntkMnfldPRCMin" VALUE 0x804D9674 Val_Wu8 30.00 DFES_OneToOne 0.00 30.00 FORMAT "%5.2" EXTENDED_LIMITS 0.00 255.0 /end CHARACTERISTIC
/begin CHARACTERISTIC DFES_Cls.DFC_IntkAirTIntkMnfldSRCMax_C "fault class per DFC / Fault class for check DFC_IntkAirTIntkMnfldSRCMax" VALUE 0x804D9675 Val_Wu8 30.00 DFES_OneToOne 0.00 30.00 FORMAT "%5.2" EXTENDED_LIMITS 0.00 255.0 /end CHARACTERISTIC
/begin CHARACTERISTIC DFES_Cls.DFC_IntkAirTIntkMnfldSRCMin_C "fault class per DFC / Fault class for check DFC_IntkAirTIntkMnfldSRCMin" VALUE 0x804D9676 Val_Wu8 30.00 DFES_OneToOne 0.00 30.00 FORMAT "%5.2" EXTENDED_LIMITS 0.00 255.0 /end CHARACTERISTIC
/begin CHARACTERISTIC DFES_Cls.DFC_IntkAirTIntkMnfldSTC_C "fault class per DFC / Fault class for check DFC_IntkAirTIntkMnfldSTC" VALUE 0x804D9677 Val_Wu8 30.00 DFES_OneToOne 0.00 30.00 FORMAT "%5.2" EXTENDED_LIMITS 0.00 255.0 /end CHARACTERISTIC
/begin CHARACTERISTIC DFES_Cls.DFC_KRREGRLMX_C "fault class per DFC / Fault class for check DFC_KRREGRLMX" VALUE 0x804D9678 Val_Wu8 30.00 DFES_OneToOne 0.00 30.00 FORMAT "%5.2" EXTENDED_LIMITS 0.00 255.0 /end CHARACTERISTIC
/begin CHARACTERISTIC DFES_Cls.DFC_KRVEKOCVLCI_C "fault class per DFC / Fault class for check DFC_KRVEKOCVLCI" VALUE 0x804D9679 Val_Wu8 30.00 DFES_OneToOne 0.00 30.00 FORMAT "%5.2" EXTENDED_LIMITS 0.00 255.0 /end CHARACTERISTIC
/begin CHARACTERISTIC DFES_Cls.DFC_KRVEKOENCHMT_C "fault class per DFC / Fault class for check DFC_KRVEKOENCHMT" VALUE 0x804D967A Val_Wu8 30.00 DFES_OneToOne 0.00 30.00 FORMAT "%5.2" EXTENDED_LIMITS 0.00 255.0 /end CHARACTERISTIC
/begin CHARACTERISTIC DFES_Cls.DFC_KRVEKOENCHMT0_C "fault class per DFC / Fault class for check DFC_KRVEKOENCHMT0" VALUE 0x804D967B Val_Wu8 30.00 DFES_OneToOne 0.00 30.00 FORMAT "%5.2" EXTENDED_LIMITS 0.00 255.0 /end CHARACTERISTIC
/begin CHARACTERISTIC DFES_Cls.DFC_KRVEKOENCHMT1_C "fault class per DFC / Fault class for check DFC_KRVEKOENCHMT1" VALUE 0x804D967C Val_Wu8 30.00 DFES_OneToOne 0.00 30.00 FORMAT "%5.2" EXTENDED_LIMITS 0.00 255.0 /end CHARACTERISTIC
/begin CHARACTERISTIC DFES_Cls.DFC_KRVEKOENCHMT2_C "fault class per DFC / Fault class for check DFC_KRVEKOENCHMT2" VALUE 0x804D967D Val_Wu8 30.00 DFES_OneToOne 0.00 30.00 FORMAT "%5.2" EXTENDED_LIMITS 0.00 255.0 /end CHARACTERISTIC
/begin CHARACTERISTIC DFES_Cls.DFC_KRVEKOENCHMT3_C "fault class per DFC / Fault class for check DFC_KRVEKOENCHMT3" VALUE 0x804D967E Val_Wu8 30.00 DFES_OneToOne 0.00 30.00 FORMAT "%5.2" EXTENDED_LIMITS 0.00 255.0 /end CHARACTERISTIC
/begin CHARACTERISTIC DFES_Cls.DFC_KRVEKOENCHMT4_C "fault class per DFC / Fault class for check DFC_KRVEKOENCHMT4" VALUE 0x804D967F Val_Wu8 30.00 DFES_OneToOne 0.00 30.00 FORMAT "%5.2" EXTENDED_LIMITS 0.00 255.0 /end CHARACTERISTIC
/begin CHARACTERISTIC DFES_Cls.DFC_KRVEKOENCHMT5_C "fault class per DFC / Fault class for check DFC_KRVEKOENCHMT5" VALUE 0x804D9680 Val_Wu8 30.00 DFES_OneToOne 0.00 30.00 FORMAT "%5.2" EXTENDED_LIMITS 0.00 255.0 /end CHARACTERISTIC
/begin CHARACTERISTIC DFES_Cls.DFC_KRVEKOENCHMT6_C "fault class per DFC / Fault class for check DFC_KRVEKOENCHMT6" VALUE 0x804D9681 Val_Wu8 30.00 DFES_OneToOne 0.00 30.00 FORMAT "%5.2" EXTENDED_LIMITS 0.00 255.0 /end CHARACTERISTIC
/begin CHARACTERISTIC DFES_Cls.DFC_KRVEKOENCHMT7_C "fault class per DFC / Fault class for check DFC_KRVEKOENCHMT7" VALUE 0x804D9682 Val_Wu8 30.00 DFES_OneToOne 0.00 30.00 FORMAT "%5.2" EXTENDED_LIMITS 0.00 255.0 /end CHARACTERISTIC
/begin CHARACTERISTIC DFES_Cls.DFC_KRVEKORLMX_C "fault class per DFC / Fault class for check DFC_KRVEKORLMX" VALUE 0x804D9683 Val_Wu8 30.00 DFES_OneToOne 0.00 30.00 FORMAT "%5.2" EXTENDED_LIMITS 0.00 255.0 /end CHARACTERISTIC
/begin CHARACTERISTIC DFES_Cls.DFC_KRVEKORLMXL_C "fault class per DFC / Fault class for check DFC_KRVEKORLMXL" VALUE 0x804D9684 Val_Wu8 30.00 DFES_OneToOne 0.00 30.00 FORMAT "%5.2" EXTENDED_LIMITS 0.00 255.0 /end CHARACTERISTIC
/begin CHARACTERISTIC DFES_Cls.DFC_KS1max_C "fault class per DFC / Fault class for check DFC_KS1max" VALUE 0x804D9685 Val_Wu8 30.00 DFES_OneToOne 0.00 30.00 FORMAT "%5.2" EXTENDED_LIMITS 0.00 255.0 /end CHARACTERISTIC
/begin CHARACTERISTIC DFES_Cls.DFC_KS1min_C "fault class per DFC / Fault class for check DFC_KS1min" VALUE 0x804D9686 Val_Wu8 30.00 DFES_OneToOne 0.00 30.00 FORMAT "%5.2" EXTENDED_LIMITS 0.00 255.0 /end CHARACTERISTIC
/begin CHARACTERISTIC DFES_Cls.DFC_LMmax_C "fault class per DFC / Fault class for check DFC_LMmax" VALUE 0x804D9687 Val_Wu8 30.00 DFES_OneToOne 0.00 30.00 FORMAT "%5.2" EXTENDED_LIMITS 0.00 255.0 /end CHARACTERISTIC
/begin CHARACTERISTIC DFES_Cls.DFC_LZSRnpl_C "fault class per DFC / Fault class for check DFC_LZSRnpl" VALUE 0x804D9688 Val_Wu8 30.00 DFES_OneToOne 0.00 30.00 FORMAT "%5.2" EXTENDED_LIMITS 0.00 255.0 /end CHARACTERISTIC
/begin CHARACTERISTIC DFES_Cls.DFC_LamDynDiagS1B1_C "fault class per DFC / Fault class for check DFC_LamDynDiagS1B1" VALUE 0x804D9689 Val_Wu8 30.00 DFES_OneToOne 0.00 30.00 FORMAT "%5.2" EXTENDED_LIMITS 0.00 255.0 /end CHARACTERISTIC
/begin CHARACTERISTIC DFES_Cls.DFC_LeakIntkMnfldEmiInfl_C "fault class per DFC / Fault class for check DFC_LeakIntkMnfldEmiInfl" VALUE 0x804D968A Val_Wu8 30.00 DFES_OneToOne 0.00 30.00 FORMAT "%5.2" EXTENDED_LIMITS 0.00 255.0 /end CHARACTERISTIC
/begin CHARACTERISTIC DFES_Cls.DFC_LinFrameErrDCDC_C "fault class per DFC / Fault class for check DFC_LinFrameErrDCDC" VALUE 0x804D968B Val_Wu8 30.00 DFES_OneToOne 0.00 30.00 FORMAT "%5.2" EXTENDED_LIMITS 0.00 255.0 /end CHARACTERISTIC
/begin CHARACTERISTIC DFES_Cls.DFC_LinOverrunErrDCDC_C "fault class per DFC / Fault class for check DFC_LinOverrunErrDCDC" VALUE 0x804D968C Val_Wu8 30.00 DFES_OneToOne 0.00 30.00 FORMAT "%5.2" EXTENDED_LIMITS 0.00 255.0 /end CHARACTERISTIC
/begin CHARACTERISTIC DFES_Cls.DFC_MD00max_C "fault class per DFC / Fault class for check DFC_MD00max" VALUE 0x804D968D Val_Wu8 30.00 DFES_OneToOne 0.00 30.00 FORMAT "%5.2" EXTENDED_LIMITS 0.00 255.0 /end CHARACTERISTIC
/begin CHARACTERISTIC DFES_Cls.DFC_MDBmax_C "fault class per DFC / Fault class for check DFC_MDBmax" VALUE 0x804D968E Val_Wu8 30.00 DFES_OneToOne 0.00 30.00 FORMAT "%5.2" EXTENDED_LIMITS 0.00 255.0 /end CHARACTERISTIC
/begin CHARACTERISTIC DFES_Cls.DFC_MDCat_C "fault class per DFC / Fault class for check DFC_MDCat" VALUE 0x804D968F Val_Wu8 30.00 DFES_OneToOne 0.00 30.00 FORMAT "%5.2" EXTENDED_LIMITS 0.00 255.0 /end CHARACTERISTIC
/begin CHARACTERISTIC DFES_Cls.DFC_MDCatCrit_C "fault class per DFC / Fault class for check DFC_MDCatCrit" VALUE 0x804D9690 Val_Wu8 30.00 DFES_OneToOne 0.00 30.00 FORMAT "%5.2" EXTENDED_LIMITS 0.00 255.0 /end CHARACTERISTIC
/begin CHARACTERISTIC DFES_Cls.DFC_MDCatCurr_C "fault class per DFC / Fault class for check DFC_MDCatCurr" VALUE 0x804D9691 Val_Wu8 30.00 DFES_OneToOne 0.00 30.00 FORMAT "%5.2" EXTENDED_LIMITS 0.00 255.0 /end CHARACTERISTIC
/begin CHARACTERISTIC DFES_Cls.DFC_MDCyl_0_C "fault class per DFC / Fault class for check DFC_MDCyl_0" VALUE 0x804D9692 Val_Wu8 30.00 DFES_OneToOne 0.00 30.00 FORMAT "%5.2" EXTENDED_LIMITS 0.00 255.0 /end CHARACTERISTIC
/begin CHARACTERISTIC DFES_Cls.DFC_MDCyl_1_C "fault class per DFC / Fault class for check DFC_MDCyl_1" VALUE 0x804D9693 Val_Wu8 30.00 DFES_OneToOne 0.00 30.00 FORMAT "%5.2" EXTENDED_LIMITS 0.00 255.0 /end CHARACTERISTIC
/begin CHARACTERISTIC DFES_Cls.DFC_MDCyl_2_C "fault class per DFC / Fault class for check DFC_MDCyl_2" VALUE 0x804D9694 Val_Wu8 30.00 DFES_OneToOne 0.00 30.00 FORMAT "%5.2" EXTENDED_LIMITS 0.00 255.0 /end CHARACTERISTIC
/begin CHARACTERISTIC DFES_Cls.DFC_MDCyl_3_C "fault class per DFC / Fault class for check DFC_MDCyl_3" VALUE 0x804D9695 Val_Wu8 30.00 DFES_OneToOne 0.00 30.00 FORMAT "%5.2" EXTENDED_LIMITS 0.00 255.0 /end CHARACTERISTIC
/begin CHARACTERISTIC DFES_Cls.DFC_MDEmi_C "fault class per DFC / Fault class for check DFC_MDEmi" VALUE 0x804D9696 Val_Wu8 30.00 DFES_OneToOne 0.00 30.00 FORMAT "%5.2" EXTENDED_LIMITS 0.00 255.0 /end CHARACTERISTIC
/begin CHARACTERISTIC DFES_Cls.DFC_MDEmiStrt_C "fault class per DFC / Fault class for check DFC_MDEmiStrt" VALUE 0x804D9697 Val_Wu8 30.00 DFES_OneToOne 0.00 30.00 FORMAT "%5.2" EXTENDED_LIMITS 0.00 255.0 /end CHARACTERISTIC
/begin CHARACTERISTIC DFES_Cls.DFC_MDFco_C "fault class per DFC / Fault class for check DFC_MDFco" VALUE 0x804D9698 Val_Wu8 30.00 DFES_OneToOne 0.00 30.00 FORMAT "%5.2" EXTENDED_LIMITS 0.00 255.0 /end CHARACTERISTIC
/begin CHARACTERISTIC DFES_Cls.DFC_MDMpl_C "fault class per DFC / Fault class for check DFC_MDMpl" VALUE 0x804D9699 Val_Wu8 30.00 DFES_OneToOne 0.00 30.00 FORMAT "%5.2" EXTENDED_LIMITS 0.00 255.0 /end CHARACTERISTIC
/begin CHARACTERISTIC DFES_Cls.DFC_MDSegTiAdpn_C "fault class per DFC / Fault class for check DFC_MDSegTiAdpn" VALUE 0x804D969A Val_Wu8 30.00 DFES_OneToOne 0.00 30.00 FORMAT "%5.2" EXTENDED_LIMITS 0.00 255.0 /end CHARACTERISTIC
/begin CHARACTERISTIC DFES_Cls.DFC_MDmax_C "fault class per DFC / Fault class for check DFC_MDmax" VALUE 0x804D969B Val_Wu8 30.00 DFES_OneToOne 0.00 30.00 FORMAT "%5.2" EXTENDED_LIMITS 0.00 255.0 /end CHARACTERISTIC
/begin CHARACTERISTIC DFES_Cls.DFC_MFuOilMax_C "fault class per DFC / Fault class for check DFC_MFuOilMax" VALUE 0x804D969C Val_Wu8 30.00 DFES_OneToOne 0.00 30.00 FORMAT "%5.2" EXTENDED_LIMITS 0.00 255.0 /end CHARACTERISTIC
/begin CHARACTERISTIC DFES_Cls.DFC_MOXEMM_SMU_ALM0_0_C "fault class per DFC / Fault class for check DFC_MOXEMM_SMU_ALM0_0" VALUE 0x804D969D Val_Wu8 30.00 DFES_OneToOne 0.00 30.00 FORMAT "%5.2" EXTENDED_LIMITS 0.00 255.0 /end CHARACTERISTIC
/begin CHARACTERISTIC DFES_Cls.DFC_MOXEMM_SMU_ALM0_1_C "fault class per DFC / Fault class for check DFC_MOXEMM_SMU_ALM0_1" VALUE 0x804D969E Val_Wu8 30.00 DFES_OneToOne 0.00 30.00 FORMAT "%5.2" EXTENDED_LIMITS 0.00 255.0 /end CHARACTERISTIC
/begin CHARACTERISTIC DFES_Cls.DFC_MOXEMM_SMU_ALM0_10_C "fault class per DFC / Fault class for check DFC_MOXEMM_SMU_ALM0_10" VALUE 0x804D969F Val_Wu8 30.00 DFES_OneToOne 0.00 30.00 FORMAT "%5.2" EXTENDED_LIMITS 0.00 255.0 /end CHARACTERISTIC
/begin CHARACTERISTIC DFES_Cls.DFC_MOXEMM_SMU_ALM0_11_C "fault class per DFC / Fault class for check DFC_MOXEMM_SMU_ALM0_11" VALUE 0x804D96A0 Val_Wu8 30.00 DFES_OneToOne 0.00 30.00 FORMAT "%5.2" EXTENDED_LIMITS 0.00 255.0 /end CHARACTERISTIC
/begin CHARACTERISTIC DFES_Cls.DFC_MOXEMM_SMU_ALM0_13_C "fault class per DFC / Fault class for check DFC_MOXEMM_SMU_ALM0_13" VALUE 0x804D96A1 Val_Wu8 30.00 DFES_OneToOne 0.00 30.00 FORMAT "%5.2" EXTENDED_LIMITS 0.00 255.0 /end CHARACTERISTIC
/begin CHARACTERISTIC DFES_Cls.DFC_MOXEMM_SMU_ALM0_14_C "fault class per DFC / Fault class for check DFC_MOXEMM_SMU_ALM0_14" VALUE 0x804D96A2 Val_Wu8 30.00 DFES_OneToOne 0.00 30.00 FORMAT "%5.2" EXTENDED_LIMITS 0.00 255.0 /end CHARACTERISTIC
/begin CHARACTERISTIC DFES_Cls.DFC_MOXEMM_SMU_ALM0_2_C "fault class per DFC / Fault class for check DFC_MOXEMM_SMU_ALM0_2" VALUE 0x804D96A3 Val_Wu8 30.00 DFES_OneToOne 0.00 30.00 FORMAT "%5.2" EXTENDED_LIMITS 0.00 255.0 /end CHARACTERISTIC
/begin CHARACTERISTIC DFES_Cls.DFC_MOXEMM_SMU_ALM0_22_C "fault class per DFC / Fault class for check DFC_MOXEMM_SMU_ALM0_22" VALUE 0x804D96A4 Val_Wu8 30.00 DFES_OneToOne 0.00 30.00 FORMAT "%5.2" EXTENDED_LIMITS 0.00 255.0 /end CHARACTERISTIC
/begin CHARACTERISTIC DFES_Cls.DFC_MOXEMM_SMU_ALM0_23_C "fault class per DFC / Fault class for check DFC_MOXEMM_SMU_ALM0_23" VALUE 0x804D96A5 Val_Wu8 30.00 DFES_OneToOne 0.00 30.00 FORMAT "%5.2" EXTENDED_LIMITS 0.00 255.0 /end CHARACTERISTIC
/begin CHARACTERISTIC DFES_Cls.DFC_MOXEMM_SMU_ALM0_4_C "fault class per DFC / Fault class for check DFC_MOXEMM_SMU_ALM0_4" VALUE 0x804D96A6 Val_Wu8 30.00 DFES_OneToOne 0.00 30.00 FORMAT "%5.2" EXTENDED_LIMITS 0.00 255.0 /end CHARACTERISTIC
/begin CHARACTERISTIC DFES_Cls.DFC_MOXEMM_SMU_ALM0_5_C "fault class per DFC / Fault class for check DFC_MOXEMM_SMU_ALM0_5" VALUE 0x804D96A7 Val_Wu8 30.00 DFES_OneToOne 0.00 30.00 FORMAT "%5.2" EXTENDED_LIMITS 0.00 255.0 /end CHARACTERISTIC
/begin CHARACTERISTIC DFES_Cls.DFC_MOXEMM_SMU_ALM0_7_C "fault class per DFC / Fault class for check DFC_MOXEMM_SMU_ALM0_7" VALUE 0x804D96A8 Val_Wu8 30.00 DFES_OneToOne 0.00 30.00 FORMAT "%5.2" EXTENDED_LIMITS 0.00 255.0 /end CHARACTERISTIC
/begin CHARACTERISTIC DFES_Cls.DFC_MOXEMM_SMU_ALM0_8_C "fault class per DFC / Fault class for check DFC_MOXEMM_SMU_ALM0_8" VALUE 0x804D96A9 Val_Wu8 30.00 DFES_OneToOne 0.00 30.00 FORMAT "%5.2" EXTENDED_LIMITS 0.00 255.0 /end CHARACTERISTIC
/begin CHARACTERISTIC DFES_Cls.DFC_MOXEMM_SMU_ALM10_16_C "fault class per DFC / Fault class for check DFC_MOXEMM_SMU_ALM10_16" VALUE 0x804D96AA Val_Wu8 30.00 DFES_OneToOne 0.00 30.00 FORMAT "%5.2" EXTENDED_LIMITS 0.00 255.0 /end CHARACTERISTIC
/begin CHARACTERISTIC DFES_Cls.DFC_MOXEMM_SMU_ALM10_17_C "fault class per DFC / Fault class for check DFC_MOXEMM_SMU_ALM10_17" VALUE 0x804D96AB Val_Wu8 30.00 DFES_OneToOne 0.00 30.00 FORMAT "%5.2" EXTENDED_LIMITS 0.00 255.0 /end CHARACTERISTIC
/begin CHARACTERISTIC DFES_Cls.DFC_MOXEMM_SMU_ALM10_21_C "fault class per DFC / Fault class for check DFC_MOXEMM_SMU_ALM10_21" VALUE 0x804D96AC Val_Wu8 30.00 DFES_OneToOne 0.00 30.00 FORMAT "%5.2" EXTENDED_LIMITS 0.00 255.0 /end CHARACTERISTIC
/begin CHARACTERISTIC DFES_Cls.DFC_MOXEMM_SMU_ALM11_0_C "fault class per DFC / Fault class for check DFC_MOXEMM_SMU_ALM11_0" VALUE 0x804D96AD Val_Wu8 30.00 DFES_OneToOne 0.00 30.00 FORMAT "%5.2" EXTENDED_LIMITS 0.00 255.0 /end CHARACTERISTIC
/begin CHARACTERISTIC DFES_Cls.DFC_MOXEMM_SMU_ALM11_1_C "fault class per DFC / Fault class for check DFC_MOXEMM_SMU_ALM11_1" VALUE 0x804D96AE Val_Wu8 30.00 DFES_OneToOne 0.00 30.00 FORMAT "%5.2" EXTENDED_LIMITS 0.00 255.0 /end CHARACTERISTIC
/begin CHARACTERISTIC DFES_Cls.DFC_MOXEMM_SMU_ALM11_2_C "fault class per DFC / Fault class for check DFC_MOXEMM_SMU_ALM11_2" VALUE 0x804D96AF Val_Wu8 30.00 DFES_OneToOne 0.00 30.00 FORMAT "%5.2" EXTENDED_LIMITS 0.00 255.0 /end CHARACTERISTIC
/begin CHARACTERISTIC DFES_Cls.DFC_MOXEMM_SMU_ALM11_3_C "fault class per DFC / Fault class for check DFC_MOXEMM_SMU_ALM11_3" VALUE 0x804D96B0 Val_Wu8 30.00 DFES_OneToOne 0.00 30.00 FORMAT "%5.2" EXTENDED_LIMITS 0.00 255.0 /end CHARACTERISTIC
/begin CHARACTERISTIC DFES_Cls.DFC_MOXEMM_SMU_ALM11_4_C "fault class per DFC / Fault class for check DFC_MOXEMM_SMU_ALM11_4" VALUE 0x804D96B1 Val_Wu8 30.00 DFES_OneToOne 0.00 30.00 FORMAT "%5.2" EXTENDED_LIMITS 0.00 255.0 /end CHARACTERISTIC
/begin CHARACTERISTIC DFES_Cls.DFC_MOXEMM_SMU_ALM11_5_C "fault class per DFC / Fault class for check DFC_MOXEMM_SMU_ALM11_5" VALUE 0x804D96B2 Val_Wu8 30.00 DFES_OneToOne 0.00 30.00 FORMAT "%5.2" EXTENDED_LIMITS 0.00 255.0 /end CHARACTERISTIC
/begin CHARACTERISTIC DFES_Cls.DFC_MOXEMM_SMU_ALM11_8_C "fault class per DFC / Fault class for check DFC_MOXEMM_SMU_ALM11_8" VALUE 0x804D96B3 Val_Wu8 30.00 DFES_OneToOne 0.00 30.00 FORMAT "%5.2" EXTENDED_LIMITS 0.00 255.0 /end CHARACTERISTIC
/begin CHARACTERISTIC DFES_Cls.DFC_MOXEMM_SMU_ALM11_9_C "fault class per DFC / Fault class for check DFC_MOXEMM_SMU_ALM11_9" VALUE 0x804D96B4 Val_Wu8 30.00 DFES_OneToOne 0.00 30.00 FORMAT "%5.2" EXTENDED_LIMITS 0.00 255.0 /end CHARACTERISTIC
/begin CHARACTERISTIC DFES_Cls.DFC_MOXEMM_SMU_ALM1_0_C "fault class per DFC / Fault class for check DFC_MOXEMM_SMU_ALM1_0" VALUE 0x804D96B5 Val_Wu8 30.00 DFES_OneToOne 0.00 30.00 FORMAT "%5.2" EXTENDED_LIMITS 0.00 255.0 /end CHARACTERISTIC
/begin CHARACTERISTIC DFES_Cls.DFC_MOXEMM_SMU_ALM1_1_C "fault class per DFC / Fault class for check DFC_MOXEMM_SMU_ALM1_1" VALUE 0x804D96B6 Val_Wu8 30.00 DFES_OneToOne 0.00 30.00 FORMAT "%5.2" EXTENDED_LIMITS 0.00 255.0 /end CHARACTERISTIC
/begin CHARACTERISTIC DFES_Cls.DFC_MOXEMM_SMU_ALM1_10_C "fault class per DFC / Fault class for check DFC_MOXEMM_SMU_ALM1_10" VALUE 0x804D96B7 Val_Wu8 30.00 DFES_OneToOne 0.00 30.00 FORMAT "%5.2" EXTENDED_LIMITS 0.00 255.0 /end CHARACTERISTIC
/begin CHARACTERISTIC DFES_Cls.DFC_MOXEMM_SMU_ALM1_11_C "fault class per DFC / Fault class for check DFC_MOXEMM_SMU_ALM1_11" VALUE 0x804D96B8 Val_Wu8 30.00 DFES_OneToOne 0.00 30.00 FORMAT "%5.2" EXTENDED_LIMITS 0.00 255.0 /end CHARACTERISTIC
/begin CHARACTERISTIC DFES_Cls.DFC_MOXEMM_SMU_ALM1_13_C "fault class per DFC / Fault class for check DFC_MOXEMM_SMU_ALM1_13" VALUE 0x804D96B9 Val_Wu8 30.00 DFES_OneToOne 0.00 30.00 FORMAT "%5.2" EXTENDED_LIMITS 0.00 255.0 /end CHARACTERISTIC
/begin CHARACTERISTIC DFES_Cls.DFC_MOXEMM_SMU_ALM1_14_C "fault class per DFC / Fault class for check DFC_MOXEMM_SMU_ALM1_14" VALUE 0x804D96BA Val_Wu8 30.00 DFES_OneToOne 0.00 30.00 FORMAT "%5.2" EXTENDED_LIMITS 0.00 255.0 /end CHARACTERISTIC
/begin CHARACTERISTIC DFES_Cls.DFC_MOXEMM_SMU_ALM1_2_C "fault class per DFC / Fault class for check DFC_MOXEMM_SMU_ALM1_2" VALUE 0x804D96BB Val_Wu8 30.00 DFES_OneToOne 0.00 30.00 FORMAT "%5.2" EXTENDED_LIMITS 0.00 255.0 /end CHARACTERISTIC
/begin CHARACTERISTIC DFES_Cls.DFC_MOXEMM_SMU_ALM1_22_C "fault class per DFC / Fault class for check DFC_MOXEMM_SMU_ALM1_22" VALUE 0x804D96BC Val_Wu8 30.00 DFES_OneToOne 0.00 30.00 FORMAT "%5.2" EXTENDED_LIMITS 0.00 255.0 /end CHARACTERISTIC
/begin CHARACTERISTIC DFES_Cls.DFC_MOXEMM_SMU_ALM1_23_C "fault class per DFC / Fault class for check DFC_MOXEMM_SMU_ALM1_23" VALUE 0x804D96BD Val_Wu8 30.00 DFES_OneToOne 0.00 30.00 FORMAT "%5.2" EXTENDED_LIMITS 0.00 255.0 /end CHARACTERISTIC
/begin CHARACTERISTIC DFES_Cls.DFC_MOXEMM_SMU_ALM1_4_C "fault class per DFC / Fault class for check DFC_MOXEMM_SMU_ALM1_4" VALUE 0x804D96BE Val_Wu8 30.00 DFES_OneToOne 0.00 30.00 FORMAT "%5.2" EXTENDED_LIMITS 0.00 255.0 /end CHARACTERISTIC
/begin CHARACTERISTIC DFES_Cls.DFC_MOXEMM_SMU_ALM1_5_C "fault class per DFC / Fault class for check DFC_MOXEMM_SMU_ALM1_5" VALUE 0x804D96BF Val_Wu8 30.00 DFES_OneToOne 0.00 30.00 FORMAT "%5.2" EXTENDED_LIMITS 0.00 255.0 /end CHARACTERISTIC
/begin CHARACTERISTIC DFES_Cls.DFC_MOXEMM_SMU_ALM1_7_C "fault class per DFC / Fault class for check DFC_MOXEMM_SMU_ALM1_7" VALUE 0x804D96C0 Val_Wu8 30.00 DFES_OneToOne 0.00 30.00 FORMAT "%5.2" EXTENDED_LIMITS 0.00 255.0 /end CHARACTERISTIC
/begin CHARACTERISTIC DFES_Cls.DFC_MOXEMM_SMU_ALM1_8_C "fault class per DFC / Fault class for check DFC_MOXEMM_SMU_ALM1_8" VALUE 0x804D96C1 Val_Wu8 30.00 DFES_OneToOne 0.00 30.00 FORMAT "%5.2" EXTENDED_LIMITS 0.00 255.0 /end CHARACTERISTIC
/begin CHARACTERISTIC DFES_Cls.DFC_MOXEMM_SMU_ALM21_0_C "fault class per DFC / Fault class for check DFC_MOXEMM_SMU_ALM21_0" VALUE 0x804D96C2 Val_Wu8 30.00 DFES_OneToOne 0.00 30.00 FORMAT "%5.2" EXTENDED_LIMITS 0.00 255.0 /end CHARACTERISTIC
/begin CHARACTERISTIC DFES_Cls.DFC_MOXEMM_SMU_ALM21_16_C "fault class per DFC / Fault class for check DFC_MOXEMM_SMU_ALM21_16" VALUE 0x804D96C3 Val_Wu8 30.00 DFES_OneToOne 0.00 30.00 FORMAT "%5.2" EXTENDED_LIMITS 0.00 255.0 /end CHARACTERISTIC
/begin CHARACTERISTIC DFES_Cls.DFC_MOXEMM_SMU_ALM21_3_C "fault class per DFC / Fault class for check DFC_MOXEMM_SMU_ALM21_3" VALUE 0x804D96C4 Val_Wu8 30.00 DFES_OneToOne 0.00 30.00 FORMAT "%5.2" EXTENDED_LIMITS 0.00 255.0 /end CHARACTERISTIC
/begin CHARACTERISTIC DFES_Cls.DFC_MOXEMM_SMU_ALM2_1_C "fault class per DFC / Fault class for check DFC_MOXEMM_SMU_ALM2_1" VALUE 0x804D96C5 Val_Wu8 30.00 DFES_OneToOne 0.00 30.00 FORMAT "%5.2" EXTENDED_LIMITS 0.00 255.0 /end CHARACTERISTIC
/begin CHARACTERISTIC DFES_Cls.DFC_MOXEMM_SMU_ALM2_10_C "fault class per DFC / Fault class for check DFC_MOXEMM_SMU_ALM2_10" VALUE 0x804D96C6 Val_Wu8 30.00 DFES_OneToOne 0.00 30.00 FORMAT "%5.2" EXTENDED_LIMITS 0.00 255.0 /end CHARACTERISTIC
/begin CHARACTERISTIC DFES_Cls.DFC_MOXEMM_SMU_ALM2_11_C "fault class per DFC / Fault class for check DFC_MOXEMM_SMU_ALM2_11" VALUE 0x804D96C7 Val_Wu8 30.00 DFES_OneToOne 0.00 30.00 FORMAT "%5.2" EXTENDED_LIMITS 0.00 255.0 /end CHARACTERISTIC
/begin CHARACTERISTIC DFES_Cls.DFC_MOXEMM_SMU_ALM2_13_C "fault class per DFC / Fault class for check DFC_MOXEMM_SMU_ALM2_13" VALUE 0x804D96C8 Val_Wu8 30.00 DFES_OneToOne 0.00 30.00 FORMAT "%5.2" EXTENDED_LIMITS 0.00 255.0 /end CHARACTERISTIC
/begin CHARACTERISTIC DFES_Cls.DFC_MOXEMM_SMU_ALM2_14_C "fault class per DFC / Fault class for check DFC_MOXEMM_SMU_ALM2_14" VALUE 0x804D96C9 Val_Wu8 30.00 DFES_OneToOne 0.00 30.00 FORMAT "%5.2" EXTENDED_LIMITS 0.00 255.0 /end CHARACTERISTIC
/begin CHARACTERISTIC DFES_Cls.DFC_MOXEMM_SMU_ALM2_22_C "fault class per DFC / Fault class for check DFC_MOXEMM_SMU_ALM2_22" VALUE 0x804D96CA Val_Wu8 30.00 DFES_OneToOne 0.00 30.00 FORMAT "%5.2" EXTENDED_LIMITS 0.00 255.0 /end CHARACTERISTIC
/begin CHARACTERISTIC DFES_Cls.DFC_MOXEMM_SMU_ALM2_23_C "fault class per DFC / Fault class for check DFC_MOXEMM_SMU_ALM2_23" VALUE 0x804D96CB Val_Wu8 30.00 DFES_OneToOne 0.00 30.00 FORMAT "%5.2" EXTENDED_LIMITS 0.00 255.0 /end CHARACTERISTIC
/begin CHARACTERISTIC DFES_Cls.DFC_MOXEMM_SMU_ALM2_4_C "fault class per DFC / Fault class for check DFC_MOXEMM_SMU_ALM2_4" VALUE 0x804D96CC Val_Wu8 30.00 DFES_OneToOne 0.00 30.00 FORMAT "%5.2" EXTENDED_LIMITS 0.00 255.0 /end CHARACTERISTIC
/begin CHARACTERISTIC DFES_Cls.DFC_MOXEMM_SMU_ALM2_5_C "fault class per DFC / Fault class for check DFC_MOXEMM_SMU_ALM2_5" VALUE 0x804D96CD Val_Wu8 30.00 DFES_OneToOne 0.00 30.00 FORMAT "%5.2" EXTENDED_LIMITS 0.00 255.0 /end CHARACTERISTIC
/begin CHARACTERISTIC DFES_Cls.DFC_MOXEMM_SMU_ALM2_7_C "fault class per DFC / Fault class for check DFC_MOXEMM_SMU_ALM2_7" VALUE 0x804D96CE Val_Wu8 30.00 DFES_OneToOne 0.00 30.00 FORMAT "%5.2" EXTENDED_LIMITS 0.00 255.0 /end CHARACTERISTIC
/begin CHARACTERISTIC DFES_Cls.DFC_MOXEMM_SMU_ALM2_8_C "fault class per DFC / Fault class for check DFC_MOXEMM_SMU_ALM2_8" VALUE 0x804D96CF Val_Wu8 30.00 DFES_OneToOne 0.00 30.00 FORMAT "%5.2" EXTENDED_LIMITS 0.00 255.0 /end CHARACTERISTIC
/begin CHARACTERISTIC DFES_Cls.DFC_MOXEMM_SMU_ALM6_0_C "fault class per DFC / Fault class for check DFC_MOXEMM_SMU_ALM6_0" VALUE 0x804D96D0 Val_Wu8 30.00 DFES_OneToOne 0.00 30.00 FORMAT "%5.2" EXTENDED_LIMITS 0.00 255.0 /end CHARACTERISTIC
/begin CHARACTERISTIC DFES_Cls.DFC_MOXEMM_SMU_ALM6_11_C "fault class per DFC / Fault class for check DFC_MOXEMM_SMU_ALM6_11" VALUE 0x804D96D1 Val_Wu8 30.00 DFES_OneToOne 0.00 30.00 FORMAT "%5.2" EXTENDED_LIMITS 0.00 255.0 /end CHARACTERISTIC
/begin CHARACTERISTIC DFES_Cls.DFC_MOXEMM_SMU_ALM6_12_C "fault class per DFC / Fault class for check DFC_MOXEMM_SMU_ALM6_12" VALUE 0x804D96D2 Val_Wu8 30.00 DFES_OneToOne 0.00 30.00 FORMAT "%5.2" EXTENDED_LIMITS 0.00 255.0 /end CHARACTERISTIC
/begin CHARACTERISTIC DFES_Cls.DFC_MOXEMM_SMU_ALM6_14_C "fault class per DFC / Fault class for check DFC_MOXEMM_SMU_ALM6_14" VALUE 0x804D96D3 Val_Wu8 30.00 DFES_OneToOne 0.00 30.00 FORMAT "%5.2" EXTENDED_LIMITS 0.00 255.0 /end CHARACTERISTIC
/begin CHARACTERISTIC DFES_Cls.DFC_MOXEMM_SMU_ALM6_15_C "fault class per DFC / Fault class for check DFC_MOXEMM_SMU_ALM6_15" VALUE 0x804D96D4 Val_Wu8 30.00 DFES_OneToOne 0.00 30.00 FORMAT "%5.2" EXTENDED_LIMITS 0.00 255.0 /end CHARACTERISTIC
/begin CHARACTERISTIC DFES_Cls.DFC_MOXEMM_SMU_ALM6_17_C "fault class per DFC / Fault class for check DFC_MOXEMM_SMU_ALM6_17" VALUE 0x804D96D5 Val_Wu8 30.00 DFES_OneToOne 0.00 30.00 FORMAT "%5.2" EXTENDED_LIMITS 0.00 255.0 /end CHARACTERISTIC
/begin CHARACTERISTIC DFES_Cls.DFC_MOXEMM_SMU_ALM6_18_C "fault class per DFC / Fault class for check DFC_MOXEMM_SMU_ALM6_18" VALUE 0x804D96D6 Val_Wu8 30.00 DFES_OneToOne 0.00 30.00 FORMAT "%5.2" EXTENDED_LIMITS 0.00 255.0 /end CHARACTERISTIC
/begin CHARACTERISTIC DFES_Cls.DFC_MOXEMM_SMU_ALM6_20_C "fault class per DFC / Fault class for check DFC_MOXEMM_SMU_ALM6_20" VALUE 0x804D96D7 Val_Wu8 30.00 DFES_OneToOne 0.00 30.00 FORMAT "%5.2" EXTENDED_LIMITS 0.00 255.0 /end CHARACTERISTIC
/begin CHARACTERISTIC DFES_Cls.DFC_MOXEMM_SMU_ALM6_21_C "fault class per DFC / Fault class for check DFC_MOXEMM_SMU_ALM6_21" VALUE 0x804D96D8 Val_Wu8 30.00 DFES_OneToOne 0.00 30.00 FORMAT "%5.2" EXTENDED_LIMITS 0.00 255.0 /end CHARACTERISTIC
/begin CHARACTERISTIC DFES_Cls.DFC_MOXEMM_SMU_ALM6_25_C "fault class per DFC / Fault class for check DFC_MOXEMM_SMU_ALM6_25" VALUE 0x804D96D9 Val_Wu8 30.00 DFES_OneToOne 0.00 30.00 FORMAT "%5.2" EXTENDED_LIMITS 0.00 255.0 /end CHARACTERISTIC
/begin CHARACTERISTIC DFES_Cls.DFC_MOXEMM_SMU_ALM6_4_C "fault class per DFC / Fault class for check DFC_MOXEMM_SMU_ALM6_4" VALUE 0x804D96DA Val_Wu8 30.00 DFES_OneToOne 0.00 30.00 FORMAT "%5.2" EXTENDED_LIMITS 0.00 255.0 /end CHARACTERISTIC
/begin FUNCTION DFES "30000.73.0_2.0.0Diagnostic Fault Event Storage"
 /begin DEF_CHARACTERISTIC DFES_Cls.DFC_ClthONStuck_C DFES_Cls.DFC_ClthStkFailInfo_C DFES_Cls.DFC_ComACFailInfo_C DFES_Cls.DFC_ComATFTValErr_C DFES_Cls.DFC_ComATMILReq_C DFES_Cls.DFC_ComAYCAChksum_C DFES_Cls.DFC_ComAYCARingCnt_C DFES_Cls.DFC_ComAYCATOut_C DFES_Cls.DFC_ComAYCDChkSum_C DFES_Cls.DFC_ComAYCDTOut_C DFES_Cls.DFC_ComAYCFChksum_C DFES_Cls.DFC_ComAYCFRingCnt_C DFES_Cls.DFC_ComAYCFTOut_C DFES_Cls.DFC_ComAYCGChksum_C DFES_Cls.DFC_ComAYCGRingCnt_C DFES_Cls.DFC_ComAYCGTOut_C DFES_Cls.DFC_ComAYCIChkSum_C DFES_Cls.DFC_ComAYCIRingCnt_C DFES_Cls.DFC_ComAYCITOut_C DFES_Cls.DFC_ComBCM1ChkSum_C DFES_Cls.DFC_ComBCM1RingCnt_C DFES_Cls.DFC_ComBCM1TOut_C DFES_Cls.DFC_ComCANABusOffErr_C DFES_Cls.DFC_ComCANBBusOffErr_C DFES_Cls.DFC_ComCANCBusOffErr_C DFES_Cls.DFC_ComCGW1ChkSum_C DFES_Cls.DFC_ComCGW1RingCnt_C DFES_Cls.DFC_ComCGW1TOut_C DFES_Cls.DFC_ComConvBoostErr_C DFES_Cls.DFC_ComConvSlipErr_C DFES_Cls.DFC_ComDCDCPrfmncErr_C DFES_Cls.DFC_ComDCDCTempWarn_C DFES_Cls.DFC_ComEAT10Chksum_C DFES_Cls.DFC_ComEAT10RingCnt_C DFES_Cls.DFC_ComEAT10TOut_C DFES_Cls.DFC_ComEAT11ChkSum_C DFES_Cls.DFC_ComEAT11RingCnt_C DFES_Cls.DFC_ComEAT11TOut_C DFES_Cls.DFC_ComEAT12ChkSum_C DFES_Cls.DFC_ComEAT12RingCnt_C DFES_Cls.DFC_ComEAT12TOut_C DFES_Cls.DFC_ComEAT13ChkSum_C DFES_Cls.DFC_ComEAT13RingCnt_C DFES_Cls.DFC_ComEAT13TOut_C DFES_Cls.DFC_ComEAT1Chksum_C DFES_Cls.DFC_ComEAT1RingCnt_C DFES_Cls.DFC_ComEAT1TOut_C DFES_Cls.DFC_ComEAT2ChkSum_C DFES_Cls.DFC_ComEAT2RingCnt_C DFES_Cls.DFC_ComEAT2TOut_C DFES_Cls.DFC_ComEAT4ChkSum_C DFES_Cls.DFC_ComEAT4RingCnt_C DFES_Cls.DFC_ComEAT4TOut_C DFES_Cls.DFC_ComEAT6Chksum_C DFES_Cls.DFC_ComEAT6RingCnt_C DFES_Cls.DFC_ComEAT6TOut_C DFES_Cls.DFC_ComEAT7Chksum_C DFES_Cls.DFC_ComEAT7RingCnt_C DFES_Cls.DFC_ComEAT7TOut_C DFES_Cls.DFC_ComEAT8Chksum_C DFES_Cls.DFC_ComEAT8RingCnt_C DFES_Cls.DFC_ComEAT8TOut_C DFES_Cls.DFC_ComEATAChksum_C DFES_Cls.DFC_ComEATARingCnt_C DFES_Cls.DFC_ComEATATOut_C DFES_Cls.DFC_ComEATBChkSum_C DFES_Cls.DFC_ComEATBRingCnt_C DFES_Cls.DFC_ComEATBTOut_C DFES_Cls.DFC_ComEATCChksum_C DFES_Cls.DFC_ComEATCRingCnt_C DFES_Cls.DFC_ComEATCTOut_C DFES_Cls.DFC_ComEPBBChkSum_C DFES_Cls.DFC_ComEPBBRingCnt_C DFES_Cls.DFC_ComEPBBTOut_C DFES_Cls.DFC_ComEPBChksum_C DFES_Cls.DFC_ComEPBTOut_C DFES_Cls.DFC_ComEPBctRing_C DFES_Cls.DFC_ComEPS1Chksum_C DFES_Cls.DFC_ComEPS1RingCnt_C DFES_Cls.DFC_ComEPS1TOut_C DFES_Cls.DFC_ComEngCanRxErr_C DFES_Cls.DFC_ComGrvySnsrErr_C DFES_Cls.DFC_ComGwIMG1ChkSum_C DFES_Cls.DFC_ComGwIMG1RingCnt_C DFES_Cls.DFC_ComGwIMG1TOut_C DFES_Cls.DFC_ComGwIMG3ChkSum_C DFES_Cls.DFC_ComGwIMG3RingCnt_C DFES_Cls.DFC_ComGwIMG3TOut_C DFES_Cls.DFC_ComGwIMG4ChkSum_C DFES_Cls.DFC_ComGwIMG4RingCnt_C DFES_Cls.DFC_ComGwIMG4TOut_C DFES_Cls.DFC_ComGwIMG5ChkSum_C DFES_Cls.DFC_ComGwIMG5RingCnt_C DFES_Cls.DFC_ComGwIMG5TOut_C DFES_Cls.DFC_ComGwIMG6ChkSum_C DFES_Cls.DFC_ComGwIMG6RingCnt_C DFES_Cls.DFC_ComGwIMG6TOut_C DFES_Cls.DFC_ComIDASBChksum_C DFES_Cls.DFC_ComIDASBRingCnt_C DFES_Cls.DFC_ComIDASBTOut_C DFES_Cls.DFC_ComIMGMILReq_C DFES_Cls.DFC_ComISSPrms_C DFES_Cls.DFC_ComMETAChksum_C DFES_Cls.DFC_ComMETAChksumPstDrv_C DFES_Cls.DFC_ComMETARingCnt_C DFES_Cls.DFC_ComMETARingCntPstDrv_C DFES_Cls.DFC_ComMETATOut_C DFES_Cls.DFC_ComMETATOutPstDrv_C DFES_Cls.DFC_ComMETCChksum_C DFES_Cls.DFC_ComMETCRingCnt_C DFES_Cls.DFC_ComMETCTOut_C DFES_Cls.DFC_ComMETDChksum_C DFES_Cls.DFC_ComMETDRingCnt_C DFES_Cls.DFC_ComMETDTOut_C DFES_Cls.DFC_ComMETE2Chksum_C DFES_Cls.DFC_ComMETE2RingCnt_C DFES_Cls.DFC_ComMETE2TOut_C DFES_Cls.DFC_ComMETFChksum_C DFES_Cls.DFC_ComMETFRingCnt_C DFES_Cls.DFC_ComMETFTOut_C DFES_Cls.DFC_ComMETGChksum_C DFES_Cls.DFC_ComMETGRingCnt_C DFES_Cls.DFC_ComMETGTOut_C DFES_Cls.DFC_ComMETH2Chksum_C DFES_Cls.DFC_ComMETH2RingCnt_C DFES_Cls.DFC_ComMETH2TOut_C DFES_Cls.DFC_ComMETHChksum_C DFES_Cls.DFC_ComMETHRingCnt_C DFES_Cls.DFC_ComMETHTOut_C DFES_Cls.DFC_ComMETIChksum_C DFES_Cls.DFC_ComMETIRingCnt_C DFES_Cls.DFC_ComMETITOut_C DFES_Cls.DFC_ComMETKChksum_C DFES_Cls.DFC_ComMETKRingCnt_C DFES_Cls.DFC_ComMETKTOut_C DFES_Cls.DFC_ComMETLChksum_C DFES_Cls.DFC_ComMETLRingCnt_C DFES_Cls.DFC_ComMETLTOut_C DFES_Cls.DFC_ComMETMChksum_C DFES_Cls.DFC_ComMETMRingCnt_C DFES_Cls.DFC_ComMETMTOut_C DFES_Cls.DFC_ComMETNChksum_C DFES_Cls.DFC_ComMETNRingCnt_C DFES_Cls.DFC_ComMETNTOut_C DFES_Cls.DFC_ComMtrCom_C DFES_Cls.DFC_ComPCUChkSum_C DFES_Cls.DFC_ComPCURingCnt_C DFES_Cls.DFC_ComPCUTOut_C DFES_Cls.DFC_ComSRSAChksum_C DFES_Cls.DFC_ComSRSARingCnt_C DFES_Cls.DFC_ComSRSATOut_C DFES_Cls.DFC_ComSRSBChksum_C DFES_Cls.DFC_ComSRSBRingCnt_C DFES_Cls.DFC_ComSRSBTOut_C DFES_Cls.DFC_ComSRSChksum_C DFES_Cls.DFC_ComSRSErr_C DFES_Cls.DFC_ComSRSRingCnt_C DFES_Cls.DFC_ComSRSTOut_C DFES_Cls.DFC_ComVehSpdPndFltTCU_C DFES_Cls.DFC_EbsChartcCurrErr_C DFES_Cls.DFC_EbsSelfDiagErr_C DFES_Cls.DFC_GEVlvPhaCsersIntkB1_C DFES_Cls.DFC_GEVlvPhaPsOpenLoadIntkB1_C DFES_Cls.DFC_GEVlvPhaPsShoToBattIntkB1_C DFES_Cls.DFC_GEVlvPhaPsShoToGndIntkB1_C DFES_Cls.DFC_GbxCANDigPlausErr_C DFES_Cls.DFC_GbxNPos1SRCMax_C DFES_Cls.DFC_GbxNPos1SRCMin_C DFES_Cls.DFC_GbxNPos2SRCMax_C DFES_Cls.DFC_GbxNPos2SRCMin_C DFES_Cls.DFC_GbxNPosAlvChk_C DFES_Cls.DFC_GbxNPosSyncErr_C DFES_Cls.DFC_HEGOS2B1HtrPsMax_C DFES_Cls.DFC_HEGOS2B1HtrPsMin_C DFES_Cls.DFC_HEGOS2B1HtrPsSig_C DFES_Cls.DFC_LinCSErrACG_C DFES_Cls.DFC_LinCSErrAEV_C DFES_Cls.DFC_LinCSErrDCDC_C DFES_Cls.DFC_LinCSErrEBS_C DFES_Cls.DFC_LinHdrTimeoutErrACG_C DFES_Cls.DFC_LinHdrTimeoutErrAEV_C DFES_Cls.DFC_LinHdrTimeoutErrDCDC_C DFES_Cls.DFC_LinHdrTimeoutErrEBS_C DFES_Cls.DFC_LinMsgTimeoutErrACG_C DFES_Cls.DFC_LinMsgTimeoutErrAEV_C DFES_Cls.DFC_LinMsgTimeoutErrDCDC_C DFES_Cls.DFC_LinMsgTimeoutErrEBS_C DFES_Cls.DFC_LinNoStrtComErr_C DFES_Cls.DFC_LowPresOilP_C DFES_Cls.DFC_MisfDetVWhlFrntLeOORHi_C DFES_Cls.DFC_MisfDetVWhlFrntLeRatyHi_C DFES_Cls.DFC_MisfDetVWhlFrntLeRatyLo_C DFES_Cls.DFC_MisfDetVWhlFrntLeStuck_C DFES_Cls.DFC_MisfDetVWhlFrntRiOORHi_C DFES_Cls.DFC_MisfDetVWhlFrntRiRatyHi_C DFES_Cls.DFC_MisfDetVWhlFrntRiRatyLo_C DFES_Cls.DFC_MisfDetVWhlFrntRiStuck_C DFES_Cls.DFC_MisfDetVWhlReLeOORHi_C DFES_Cls.DFC_MisfDetVWhlReLeRatyHi_C DFES_Cls.DFC_MisfDetVWhlReLeRatyLo_C DFES_Cls.DFC_MisfDetVWhlReLeStuck_C DFES_Cls.DFC_MisfDetVWhlReRiOORHi_C DFES_Cls.DFC_MisfDetVWhlReRiRatyHi_C DFES_Cls.DFC_MisfDetVWhlReRiRatyLo_C DFES_Cls.DFC_MisfDetVWhlReRiStuck_C DFES_Cls.DFC_MisfDetdVWhlFrntLePlaus_C DFES_Cls.DFC_MisfDetdVWhlFrntRiPlaus_C DFES_Cls.DFC_MisfDetdVWhlReLePlaus_C DFES_Cls.DFC_MisfDetdVWhlReRiPlaus_C DFES_Cls.DFC_PEnvSigRngMax_C DFES_Cls.DFC_PEnvSigRngMin_C DFES_Cls.DFC_StmFault_C DFES_Cls.DFC_StrtCtOffPth_C DFES_Cls.DFC_StrtCtlErr_C DFES_Cls.DFC_StrtFault_C DFES_Cls.DFC_StrtLckJudg1_C DFES_Cls.DFC_StrtLckJudg2_C DFES_Cls.DFC_StrtOL_C DFES_Cls.DFC_StrtOL2_C DFES_Cls.DFC_StrtSCB_C DFES_Cls.DFC_StrtSCB2_C DFES_Cls.DFC_StrtSCG_C DFES_Cls.DFC_StrtSCG2_C DFES_Cls.DFC_StrtStkRly1_C DFES_Cls.DFC_StrtStkRly2_C DFES_Cls.DFC_TEVEmax_C DFES_Cls.DFC_TEVEmin_C DFES_Cls.DFC_TEVEsig_C DFES_Cls.DFC_UegoHeatrPrfmncLoS1B1_C DFES_Cls.DFC_VehVAllPlaus_C DFES_Cls.DFC_VehVNCSnsrElecFailr_C DFES_Cls.DFC_VehVPlausCan_C DFES_Cls.DFC_VehVPlausFco_C DFES_Cls.DFC_VehVPlausPwr_C DFES_Cls.DFC_VehVPlausV2N_C DFES_Cls.DFC_VehVSpdSnsrAElecFailr_C DFES_Cls.DFC_VehVSpdSnsrBElecFailr_C DFES_Cls.DFC_ClthMax_C DFES_Cls.DFC_IgnClPs_DevComErr_C DFES_Cls.DFC_IgnClPs_LineOl_0_C DFES_Cls.DFC_IgnClPs_LineOl_1_C DFES_Cls.DFC_IgnClPs_LineOl_2_C DFES_Cls.DFC_IgnClPs_LineOl_3_C DFES_Cls.DFC_IgnClPs_LineScb_0_C DFES_Cls.DFC_IgnClPs_LineScb_1_C DFES_Cls.DFC_IgnClPs_LineScb_2_C DFES_Cls.DFC_IgnClPs_LineScb_3_C DFES_Cls.DFC_IgnClPs_LineScg_0_C DFES_Cls.DFC_IgnClPs_LineScg_1_C DFES_Cls.DFC_IgnClPs_LineScg_2_C DFES_Cls.DFC_IgnClPs_LineScg_3_C DFES_Cls.DFC_KRVEKOEVAB_C DFES_Cls.DFC_KRVEKOEVAB0_C DFES_Cls.DFC_KRVEKOEVAB1_C DFES_Cls.DFC_KRVEKOEVAB2_C DFES_Cls.DFC_KRVEKOEVAB3_C DFES_Cls.DFC_UegoSigEcuAsicS1B1_C DFES_Cls.DFC_UegoSigEcuComS1B1_C DFES_Cls.DFC_UegoSigSnsrS1B1_C DFES_Cls.DFC_UegoSigWireOlApesS1B1_C DFES_Cls.DFC_UegoSigWireOlIpeS1B1_C DFES_Cls.DFC_UegoSigWireOlReS1B1_C DFES_Cls.DFC_UegoSigWireRCmpS1B1_C DFES_Cls.DFC_UegoSigWireScbS1B1_C DFES_Cls.DFC_UegoSigWireScgS1B1_C DFES_Cls.DFC_AfsPhyRngHiB1_C DFES_Cls.DFC_AfsPhyRngLoB1_C DFES_Cls.DFC_AirCCmprOL_C DFES_Cls.DFC_AirCCmprOvrTemp_C DFES_Cls.DFC_AirCCmprSCB_C DFES_Cls.DFC_AirCCmprSCG_C DFES_Cls.DFC_AltErr_C DFES_Cls.DFC_BattUSRCMax_C DFES_Cls.DFC_BattUSRCMin_C DFES_Cls.DFC_ComChksTCU1_C DFES_Cls.DFC_ComChksTCU11_C DFES_Cls.DFC_ComChksTCU12_C DFES_Cls.DFC_ComChksTCU13_C DFES_Cls.DFC_ComChksTCU2_C DFES_Cls.DFC_ComChksTCU3_C DFES_Cls.DFC_ComChksTCU4_C DFES_Cls.DFC_ComCntTCU1_C DFES_Cls.DFC_ComCntTCU11_C DFES_Cls.DFC_ComCntTCU12_C DFES_Cls.DFC_ComCntTCU13_C DFES_Cls.DFC_ComCntTCU2_C DFES_Cls.DFC_ComCntTCU3_C DFES_Cls.DFC_ComCntTCU4_C DFES_Cls.DFC_ComTOutTCU01_C DFES_Cls.DFC_ComTOutTCU02_C DFES_Cls.DFC_ComTOutTCU1_C DFES_Cls.DFC_ComTOutTCU11_C DFES_Cls.DFC_ComTOutTCU12_C DFES_Cls.DFC_ComTOutTCU13_C DFES_Cls.DFC_ComTOutTCU14_C DFES_Cls.DFC_ComTOutTCU2_C DFES_Cls.DFC_ComTOutTCU3_C DFES_Cls.DFC_ComTOutTCU4_C DFES_Cls.DFC_DevLibBattUHi_C DFES_Cls.DFC_DevLibBattULo_C DFES_Cls.DFC_EGRVlvFailSafeActv_C DFES_Cls.DFC_EGRVlvGovDvtCld_C DFES_Cls.DFC_EGRVlvPhysSRCMax_C DFES_Cls.DFC_EGRVlvPhysSRCMin_C DFES_Cls.DFC_FanDIOOL_0_C DFES_Cls.DFC_FanDIOOL_1_C DFES_Cls.DFC_FanDIOOvrTemp_0_C DFES_Cls.DFC_FanDIOOvrTemp_1_C DFES_Cls.DFC_FanDIOSCB_0_C DFES_Cls.DFC_FanDIOSCB_1_C DFES_Cls.DFC_FanDIOSCG_0_C DFES_Cls.DFC_FanDIOSCG_1_C DFES_Cls.DFC_MRlyDcOL_C DFES_Cls.DFC_MRlyDcSCB_C DFES_Cls.DFC_MRlyDcSCG_C DFES_Cls.DFC_PSPOL_C DFES_Cls.DFC_PSPOvrTemp_C DFES_Cls.DFC_PSPSCB_C DFES_Cls.DFC_PSPSCG_C DFES_Cls.DFC_T50Err_C DFES_Cls.DFC_ThrVlvLoBattB1_C DFES_Cls.DFC_UegoSigOperPlausS1B1_C DFES_Cls.DFC_VehVPhysRngHi_C DFES_Cls.DFC_VehVSclOutOL_C DFES_Cls.DFC_VehVSclOutOT_C DFES_Cls.DFC_VehVSclOutSCB_C DFES_Cls.DFC_VehVSclOutSCG_C DFES_Cls.DFC_VehVSigFL_C DFES_Cls.DFC_VehVSigFR_C DFES_Cls.DFC_VehVSigRL_C DFES_Cls.DFC_VehVSigRR_C DFES_Cls.DFC_VehVSnsrARngHi_C DFES_Cls.DFC_VehVSnsrBRngHi_C DFES_Cls.DFC_VehVSpdRtyDiag_C DFES_Cls.DFC_DHFHD_C DFES_Cls.DFC_InjVlv_DI_DcDc_C DFES_Cls.DFC_InjVlv_DI_NoLd_0_C DFES_Cls.DFC_InjVlv_DI_NoLd_1_C DFES_Cls.DFC_InjVlv_DI_NoLd_2_C DFES_Cls.DFC_InjVlv_DI_NoLd_3_C DFES_Cls.DFC_InjVlv_DI_ScBnk_0_C DFES_Cls.DFC_InjVlv_DI_ScBnk_1_C DFES_Cls.DFC_InjVlv_DI_ScBnk_2_C DFES_Cls.DFC_InjVlv_DI_ScBnk_3_C DFES_Cls.DFC_InjVlv_DI_ScCyl_0_C DFES_Cls.DFC_InjVlv_DI_ScCyl_1_C DFES_Cls.DFC_InjVlv_DI_ScCyl_2_C DFES_Cls.DFC_InjVlv_DI_ScCyl_3_C DFES_Cls.DFC_InjVlv_DI_ScHsLs_0_C DFES_Cls.DFC_InjVlv_DI_ScHsLs_1_C DFES_Cls.DFC_InjVlv_DI_ScHsLs_2_C DFES_Cls.DFC_InjVlv_DI_ScHsLs_3_C DFES_Cls.DFC_MfPsDiaOpenLoad1_C DFES_Cls.DFC_MfPsDiaScHiS1_C DFES_Cls.DFC_MfPsDiaScHiSLowS1_C DFES_Cls.DFC_MfPsDiaScLowS1_C DFES_Cls.DFC_ACEvpTPhysRngHi_C DFES_Cls.DFC_ACEvpTPhysRngLo_C DFES_Cls.DFC_ACEvpTSRCMax_C DFES_Cls.DFC_ACEvpTSRCMin_C DFES_Cls.DFC_AfsRawSigRngHiB1_C DFES_Cls.DFC_AfsRawSigRngLoB1_C DFES_Cls.DFC_AfsSnsrErrB1_C DFES_Cls.DFC_AirCClntPAnaSRCMax_C DFES_Cls.DFC_AirCClntPAnaSRCMin_C DFES_Cls.DFC_AirCSwtNpl_C DFES_Cls.DFC_AirCSwtSig_C DFES_Cls.DFC_Brk_C DFES_Cls.DFC_BrkBstSensSCB_C DFES_Cls.DFC_BrkBstSensSCG_C DFES_Cls.DFC_BrkSig_C DFES_Cls.DFC_ClthSig_C DFES_Cls.DFC_EGRVlvCurrLim_C DFES_Cls.DFC_EGRVlvOL_C DFES_Cls.DFC_EGRVlvOvrTemp_C DFES_Cls.DFC_EGRVlvSCB_C DFES_Cls.DFC_EGRVlvSCG_C DFES_Cls.DFC_EGRVlvSRCMax_C DFES_Cls.DFC_EGRVlvSRCMin_C DFES_Cls.DFC_HLSDemOvhtEngLim_C DFES_Cls.DFC_OilPSwmpSRCMax_C DFES_Cls.DFC_OilPSwmpSRCMin_C DFES_Cls.DFC_PIntkVUsLineHiB1_C DFES_Cls.DFC_PIntkVUsLineLoB1_C DFES_Cls.DFC_VehVPhysRngLo_C DFES_Cls.DFC_VehVSigCan_C DFES_Cls.DFC_VehVSigCanSafe_C DFES_Cls.DFC_VlvLftFbOilPSnsrIntk11SRCMax_C DFES_Cls.DFC_VlvLftFbOilPSnsrIntk11SRCMin_C DFES_Cls.DFC_ClthNpl_C DFES_Cls.DFC_GbxPNPosnDrvCdn_C DFES_Cls.DFC_GbxPNPosnPlausy_C DFES_Cls.DFC_AfsSigErrLineHiB1_C DFES_Cls.DFC_AfsSigErrLineLoB1_C DFES_Cls.DFC_PEnvCcMax_C DFES_Cls.DFC_PEnvCcMin_C DFES_Cls.DFC_PEnvRngChkMax_C DFES_Cls.DFC_PEnvRngChkMin_C DFES_Cls.DFC_PEnvSnsrPlaus_C DFES_Cls.DFC_UEGOHeatrRlyPsOLS1B1_C DFES_Cls.DFC_UEGOHeatrRlyPsSCBS1B1_C DFES_Cls.DFC_UEGOHeatrRlyPsSCGS1B1_C DFES_Cls.DFC_UegoHeatrWireOlS1B1_C DFES_Cls.DFC_UegoHeatrWireScbS1B1_C DFES_Cls.DFC_UegoHeatrWireScgS1B1_C DFES_Cls.DFC_KnDetSens1PortAMax_C DFES_Cls.DFC_KnDetSens1PortAMin_C DFES_Cls.DFC_KnDetSens1PortBMax_C DFES_Cls.DFC_KnDetSens1PortBMin_C DFES_Cls.DFC_Clth2ONStuck_C DFES_Cls.DFC_Clth2ONStuckLdc_C DFES_Cls.DFC_Clth3ONStuckLdc_C DFES_Cls.DFC_Clth3ONStuckPostDrv_C DFES_Cls.DFC_Clth4ONStuck_C DFES_Cls.DFC_Clth4ONStuckLdc_C DFES_Cls.DFC_ComBCMUnit_C DFES_Cls.DFC_ComDLCTCU01_C DFES_Cls.DFC_ComDLCTCU02_C DFES_Cls.DFC_ComDLCTCU1_C DFES_Cls.DFC_ComDLCTCU11_C DFES_Cls.DFC_ComDLCTCU12_C DFES_Cls.DFC_ComDLCTCU13_C DFES_Cls.DFC_ComDLCTCU14_C DFES_Cls.DFC_ComDLCTCU2_C DFES_Cls.DFC_ComDLCTCU3_C DFES_Cls.DFC_ComDLCTCU4_C DFES_Cls.DFC_ComEPSUnit_C DFES_Cls.DFC_ComIDASBUnit_C DFES_Cls.DFC_ComIMGUnit_C DFES_Cls.DFC_ComMETUnit_C DFES_Cls.DFC_ComSRSUnit_C DFES_Cls.DFC_ComVSAUnit_C DFES_Cls.DFC_EbsSocFlt_C DFES_Cls.DFC_I14229VINErr_C DFES_Cls.DFC_InjCatHeatgErr_C DFES_Cls.DFC_InjSysMulInjDiagErr_C DFES_Cls.DFC_LLRHmax_C DFES_Cls.DFC_LLRHmin_C DFES_Cls.DFC_LLRHnpl_C DFES_Cls.DFC_LLRKHmax_C DFES_Cls.DFC_LLRKHmin_C DFES_Cls.DFC_LLRKHnpl_C DFES_Cls.DFC_LinACGUnit_C DFES_Cls.DFC_LinAEVUnit_C DFES_Cls.DFC_LinEBSUnit_C DFES_Cls.DFC_RoughRoad_C DFES_Cls.DFC_SiaEEPRdErr_C DFES_Cls.DFC_SiaEEPWrngCod_C DFES_Cls.DFC_UegoHeatrStrtS1B1_C DFES_Cls.DFC_BusDiagCANAPPLBusOff_C DFES_Cls.DFC_BusDiagCANCANCBusOff_C DFES_Cls.DFC_BusDiagCANVEHICLEBusOff_C DFES_Cls.DFC_RBA_IODIAGPWR_rba_IoExtCy329_SignalVltSply_0_C DFES_Cls.DFC_RBA_IODIAGPWR_rba_IoExtCy329_SignalVltSply_0OT_C DFES_Cls.DFC_RBA_IODIAGPWR_rba_IoExtCy329_SignalVltSply_0OV_C DFES_Cls.DFC_RBA_IODIAGPWR_rba_IoExtCy329_SignalVltSply_0SCG_C DFES_Cls.DFC_RBA_IODIAGPWR_rba_IoExtCy329_SignalVltSply_0UV_C DFES_Cls.DFC_RBA_IODIAGPWR_rba_IoExtCy329_SignalVltSply_1_C DFES_Cls.DFC_RBA_IODIAGPWR_rba_IoExtCy329_SignalVltSply_1OT_C DFES_Cls.DFC_RBA_IODIAGPWR_rba_IoExtCy329_SignalVltSply_1OV_C DFES_Cls.DFC_RBA_IODIAGPWR_rba_IoExtCy329_SignalVltSply_1SCG_C DFES_Cls.DFC_RBA_IODIAGPWR_rba_IoExtCy329_SignalVltSply_1UV_C DFES_Cls.DFC_RBA_IODIAGPWR_rba_IoExtCy329_SignalVltSply_2_C DFES_Cls.DFC_RBA_IODIAGPWR_rba_IoExtCy329_SignalVltSply_2OT_C DFES_Cls.DFC_RBA_IODIAGPWR_rba_IoExtCy329_SignalVltSply_2OV_C DFES_Cls.DFC_RBA_IODIAGPWR_rba_IoExtCy329_SignalVltSply_2SCG_C DFES_Cls.DFC_RBA_IODIAGPWR_rba_IoExtCy329_SignalVltSply_2UV_C DFES_Cls.DFC_CAN_E_TIMEOUT_C DFES_Cls.DFC_LIN_E_TIMEOUT_C DFES_Cls.DFC_MRlyOL_C DFES_Cls.DFC_MRlySCB_C DFES_Cls.DFC_MRlySCG_C DFES_Cls.DFC_rba_MultiStackTrace_Threshold_C DFES_Cls.DFC_BSWM_E_ACTION_FAILED_C DFES_Cls.DFC_BSWM_E_INTRPTQUEUE_FULL_C DFES_Cls.DFC_RBA_IOEXTLIB_KEEPALIVE_DRV_C DFES_Cls.DFC_RBA_IOEXTLIB_KEEPALIVE_INI_C DFES_Cls.DFC_rba_IoSigRtc_StopCounter_C DFES_Cls.DFC_rba_MRly_Diag_Stk_Event_C DFES_Cls.DFC_rba_MemDiag_MemReadErr_C DFES_Cls.DFC_rba_MemDiag_MemWrErr_C DFES_Cls.DFC_rba_SyC_IrrSwOffTrigEngRun_Event_C DFES_Cls.DFC_rba_T15_Diag_ComInVld_Event_C DFES_Cls.DFC_rba_T15_Diag_ComOff_HwOn_Event_C DFES_Cls.DFC_rba_T15_Diag_ComOn_HwOff_Event_C DFES_Cls.DFC_AAVmin_C DFES_Cls.DFC_AGRSUS_C DFES_Cls.DFC_AfsPlausDiagHi_C DFES_Cls.DFC_AfsPlausDiagLo_C DFES_Cls.DFC_AfsVrntDiagErrB1_C DFES_Cls.DFC_AppAllSnsrDfct_C DFES_Cls.DFC_BBKRnldg_C DFES_Cls.DFC_BBKRsyne_C DFES_Cls.DFC_BattUStdbyDiaOL_C DFES_Cls.DFC_BigLeakIntkMnfldEmiInfl_C DFES_Cls.DFC_BlkdLineTank_C DFES_Cls.DFC_BrkMnSwtContOnWarnLmp_C DFES_Cls.DFC_BrkMnSwtNotStpWarnLmp_C DFES_Cls.DFC_BrkRdntSwtContOnWarnLmp_C DFES_Cls.DFC_BrkRdntSwtNotStpWarnLmp_C DFES_Cls.DFC_CEngDsTColdStrtMax_C DFES_Cls.DFC_CEngDsTColdStrtMin_C DFES_Cls.DFC_CEngDsTImps_C DFES_Cls.DFC_CEngDsTPlausHSC_C DFES_Cls.DFC_CEngDsTPlausLSC_C DFES_Cls.DFC_CEngDsTPlausSTC_C DFES_Cls.DFC_CEngDsTSRCMax_C DFES_Cls.DFC_CEngDsTSRCMin_C DFES_Cls.DFC_CEngDsTSig_C DFES_Cls.DFC_CEngUsTColdStrtMax_C DFES_Cls.DFC_CEngUsTColdStrtMin_C DFES_Cls.DFC_CEngUsTLooseCnctn_C DFES_Cls.DFC_CEngUsTSRCMax_C DFES_Cls.DFC_CEngUsTSRCMin_C DFES_Cls.DFC_ComDCDCACCFailr_C DFES_Cls.DFC_DCDCFltDet_C DFES_Cls.DFC_DKRSA_C DFES_Cls.DFC_DKVSmax_C DFES_Cls.DFC_DKnpl_C DFES_Cls.DFC_DSKVRmax_C DFES_Cls.DFC_DSKVRmin_C DFES_Cls.DFC_DSKVRnpl_C DFES_Cls.DFC_DSKVRsig_C DFES_Cls.DFC_DSKVSsig_C DFES_Cls.DFC_DSSmax_C DFES_Cls.DFC_DSTDmax_C DFES_Cls.DFC_DSTEmax_C DFES_Cls.DFC_DSTEmin_C DFES_Cls.DFC_DSTOFmax_C DFES_Cls.DFC_DSTRmax_C DFES_Cls.DFC_DSTRmin_C DFES_Cls.DFC_DSTRnpl_C DFES_Cls.DFC_DSTRsig_C DFES_Cls.DFC_DSTTI_C DFES_Cls.DFC_DSUmax_C DFES_Cls.DFC_DiagCpv1DteskLoLoadStuckClsd_C DFES_Cls.DFC_DiagCpv1DteskLoLoadStuckOpen_C DFES_Cls.DFC_EGRVlvDrftClsd_C DFES_Cls.DFC_EGRVlvDrftOpn_C DFES_Cls.DFC_EGRVlvJamVlvClsd_C DFES_Cls.DFC_EGRVlvJamVlvOpn_C DFES_Cls.DFC_EGRVlvSprgBrk_C DFES_Cls.DFC_EGRVlvTempMdlEEPErr_C DFES_Cls.DFC_EGRVlvTmpErr_C DFES_Cls.DFC_EGSDUS2B1LtrDly_C DFES_Cls.DFC_EGSDUS2B1LtrPT1_C DFES_Cls.DFC_EGSDUS2B1RtlDly_C DFES_Cls.DFC_EGSDUS2B1RtlPT1_C DFES_Cls.DFC_EGSDUS2B1TarLean_C DFES_Cls.DFC_EGSDUS2B1TarRich_C DFES_Cls.DFC_EONVmax_C DFES_Cls.DFC_ETAKHLmax_C DFES_Cls.DFC_ETAKHTmax_C DFES_Cls.DFC_ETHSEmax_C DFES_Cls.DFC_ETHSEmin_C DFES_Cls.DFC_ETHSFmax_C DFES_Cls.DFC_ETHSFmin_C DFES_Cls.DFC_ETHSFsig_C DFES_Cls.DFC_ETHSNPWmax_C DFES_Cls.DFC_ETHSNPWmin_C DFES_Cls.DFC_ETHSNPWsig_C DFES_Cls.DFC_ETHSPLnpl_C DFES_Cls.DFC_ETHSTPLnpl_C DFES_Cls.DFC_EngICO_C DFES_Cls.DFC_EngPrtOvrSpdMon_C DFES_Cls.DFC_EpmCaSI1ErrSig_C DFES_Cls.DFC_EpmCaSI1MntErr_C DFES_Cls.DFC_EpmCaSI1NoSigMax_C DFES_Cls.DFC_EpmCaSI1NoSigMin_C DFES_Cls.DFC_EpmCaSI1OfsErr_C DFES_Cls.DFC_EpmCrSDGI_C DFES_Cls.DFC_EpmCrSErrSig_C DFES_Cls.DFC_EpmCrSNoSig_C DFES_Cls.DFC_EtaEngIdleNonCsers_C DFES_Cls.DFC_EtaEngPtlNonCsers_C DFES_Cls.DFC_FRAmax_C DFES_Cls.DFC_FRAmin_C DFES_Cls.DFC_FSTEmax_C DFES_Cls.DFC_FSTEmin_C DFES_Cls.DFC_FSTRmax_C DFES_Cls.DFC_FSTRmin_C DFES_Cls.DFC_FSTRnpl_C DFES_Cls.DFC_FSTmax_C DFES_Cls.DFC_FTDLAmax_C DFES_Cls.DFC_FTDLAmin_C DFES_Cls.DFC_FuPHiSnsrEleclmax_C DFES_Cls.DFC_FuPHiSnsrEleclmin_C DFES_Cls.DFC_FuPHiSnsrEleclnpl_C DFES_Cls.DFC_FuPHiSnsrURngMax_C DFES_Cls.DFC_FuPHiSnsrURngMin_C DFES_Cls.DFC_FuSnsrPhyRngMaxErr_C DFES_Cls.DFC_FuSnsrPhyRngMinErr_C DFES_Cls.DFC_GEVlvLockPinDiagIntkB1_C DFES_Cls.DFC_GEVlvPhaSlowIntkB1_C DFES_Cls.DFC_GEVlvPhaTargIntkB1_C DFES_Cls.DFC_GbxRvsSwtStk_C DFES_Cls.DFC_HDRKHmax_C DFES_Cls.DFC_HDRKHmin_C DFES_Cls.DFC_HDRPLmax_C DFES_Cls.DFC_HDRPLmin_C DFES_Cls.DFC_HDRmax_C DFES_Cls.DFC_HDRmin_C DFES_Cls.DFC_HEGOS2B1ElecMax_C DFES_Cls.DFC_HEGOS2B1ElecMin_C DFES_Cls.DFC_HEGOS2B1ElecSig_C DFES_Cls.DFC_HEGOS2B1HtgNpl_C DFES_Cls.DFC_HEV00max_C DFES_Cls.DFC_HEV01max_C DFES_Cls.DFC_HEV02max_C DFES_Cls.DFC_HEV03max_C DFES_Cls.DFC_HEVE0max_C DFES_Cls.DFC_HEVE1max_C DFES_Cls.DFC_HFMmax_C DFES_Cls.DFC_HiPSysHiPMaxLimExcdd_C DFES_Cls.DFC_IVGdiCtlCvoErrMax_0_C DFES_Cls.DFC_IVGdiCtlCvoErrMax_1_C DFES_Cls.DFC_IVGdiCtlCvoErrMax_2_C DFES_Cls.DFC_IVGdiCtlCvoErrMax_3_C DFES_Cls.DFC_IVGdiCtlCvoErrMin_0_C DFES_Cls.DFC_IVGdiCtlCvoErrMin_1_C DFES_Cls.DFC_IVGdiCtlCvoErrMin_2_C DFES_Cls.DFC_IVGdiCtlCvoErrMin_3_C DFES_Cls.DFC_IVGdiCtlCvoErrMinMax_C DFES_Cls.DFC_IVGdiCtlCvoSigPlausErrSmrCdn_C DFES_Cls.DFC_IVGdiCtl_CvoErr_C DFES_Cls.DFC_IVGdiCtl_CvoSigPlaus_0_C DFES_Cls.DFC_IVGdiCtl_CvoSigPlaus_1_C DFES_Cls.DFC_IVGdiCtl_CvoSigPlaus_2_C DFES_Cls.DFC_IVGdiCtl_CvoSigPlaus_3_C DFES_Cls.DFC_IntkAirTAirFltDsCrssMax_C DFES_Cls.DFC_IntkAirTAirFltDsCrssMin_C DFES_Cls.DFC_IntkAirTAirFltDsHSCMax_C DFES_Cls.DFC_IntkAirTAirFltDsImps_C DFES_Cls.DFC_IntkAirTAirFltDsPRCMax_C DFES_Cls.DFC_IntkAirTAirFltDsPRCMin_C DFES_Cls.DFC_IntkAirTAirFltDsSRCMax_C DFES_Cls.DFC_IntkAirTAirFltDsSRCMin_C DFES_Cls.DFC_IntkAirTAirFltDsSTC_C DFES_Cls.DFC_IntkAirTIntkMnfldCrssMax_C DFES_Cls.DFC_IntkAirTIntkMnfldCrssMin_C DFES_Cls.DFC_IntkAirTIntkMnfldHSCMax_C DFES_Cls.DFC_IntkAirTIntkMnfldImps_C DFES_Cls.DFC_IntkAirTIntkMnfldPRCMax_C DFES_Cls.DFC_IntkAirTIntkMnfldPRCMin_C DFES_Cls.DFC_IntkAirTIntkMnfldSRCMax_C DFES_Cls.DFC_IntkAirTIntkMnfldSRCMin_C DFES_Cls.DFC_IntkAirTIntkMnfldSTC_C DFES_Cls.DFC_KRREGRLMX_C DFES_Cls.DFC_KRVEKOCVLCI_C DFES_Cls.DFC_KRVEKOENCHMT_C DFES_Cls.DFC_KRVEKOENCHMT0_C DFES_Cls.DFC_KRVEKOENCHMT1_C DFES_Cls.DFC_KRVEKOENCHMT2_C DFES_Cls.DFC_KRVEKOENCHMT3_C DFES_Cls.DFC_KRVEKOENCHMT4_C DFES_Cls.DFC_KRVEKOENCHMT5_C DFES_Cls.DFC_KRVEKOENCHMT6_C DFES_Cls.DFC_KRVEKOENCHMT7_C DFES_Cls.DFC_KRVEKORLMX_C DFES_Cls.DFC_KRVEKORLMXL_C DFES_Cls.DFC_KS1max_C DFES_Cls.DFC_KS1min_C DFES_Cls.DFC_LMmax_C DFES_Cls.DFC_LZSRnpl_C DFES_Cls.DFC_LamDynDiagS1B1_C DFES_Cls.DFC_LeakIntkMnfldEmiInfl_C DFES_Cls.DFC_LinFrameErrDCDC_C DFES_Cls.DFC_LinOverrunErrDCDC_C DFES_Cls.DFC_MD00max_C DFES_Cls.DFC_MDBmax_C DFES_Cls.DFC_MDCat_C DFES_Cls.DFC_MDCatCrit_C DFES_Cls.DFC_MDCatCurr_C DFES_Cls.DFC_MDCyl_0_C DFES_Cls.DFC_MDCyl_1_C DFES_Cls.DFC_MDCyl_2_C DFES_Cls.DFC_MDCyl_3_C DFES_Cls.DFC_MDEmi_C DFES_Cls.DFC_MDEmiStrt_C DFES_Cls.DFC_MDFco_C DFES_Cls.DFC_MDMpl_C DFES_Cls.DFC_MDSegTiAdpn_C DFES_Cls.DFC_MDmax_C DFES_Cls.DFC_MFuOilMax_C DFES_Cls.DFC_MOXEMM_SMU_ALM0_0_C DFES_Cls.DFC_MOXEMM_SMU_ALM0_1_C DFES_Cls.DFC_MOXEMM_SMU_ALM0_10_C DFES_Cls.DFC_MOXEMM_SMU_ALM0_11_C DFES_Cls.DFC_MOXEMM_SMU_ALM0_13_C DFES_Cls.DFC_MOXEMM_SMU_ALM0_14_C DFES_Cls.DFC_MOXEMM_SMU_ALM0_2_C DFES_Cls.DFC_MOXEMM_SMU_ALM0_22_C DFES_Cls.DFC_MOXEMM_SMU_ALM0_23_C DFES_Cls.DFC_MOXEMM_SMU_ALM0_4_C DFES_Cls.DFC_MOXEMM_SMU_ALM0_5_C DFES_Cls.DFC_MOXEMM_SMU_ALM0_7_C DFES_Cls.DFC_MOXEMM_SMU_ALM0_8_C DFES_Cls.DFC_MOXEMM_SMU_ALM10_16_C DFES_Cls.DFC_MOXEMM_SMU_ALM10_17_C DFES_Cls.DFC_MOXEMM_SMU_ALM10_21_C DFES_Cls.DFC_MOXEMM_SMU_ALM11_0_C DFES_Cls.DFC_MOXEMM_SMU_ALM11_1_C DFES_Cls.DFC_MOXEMM_SMU_ALM11_2_C DFES_Cls.DFC_MOXEMM_SMU_ALM11_3_C DFES_Cls.DFC_MOXEMM_SMU_ALM11_4_C DFES_Cls.DFC_MOXEMM_SMU_ALM11_5_C DFES_Cls.DFC_MOXEMM_SMU_ALM11_8_C DFES_Cls.DFC_MOXEMM_SMU_ALM11_9_C DFES_Cls.DFC_MOXEMM_SMU_ALM1_0_C DFES_Cls.DFC_MOXEMM_SMU_ALM1_1_C DFES_Cls.DFC_MOXEMM_SMU_ALM1_10_C DFES_Cls.DFC_MOXEMM_SMU_ALM1_11_C DFES_Cls.DFC_MOXEMM_SMU_ALM1_13_C DFES_Cls.DFC_MOXEMM_SMU_ALM1_14_C DFES_Cls.DFC_MOXEMM_SMU_ALM1_2_C DFES_Cls.DFC_MOXEMM_SMU_ALM1_22_C DFES_Cls.DFC_MOXEMM_SMU_ALM1_23_C DFES_Cls.DFC_MOXEMM_SMU_ALM1_4_C DFES_Cls.DFC_MOXEMM_SMU_ALM1_5_C DFES_Cls.DFC_MOXEMM_SMU_ALM1_7_C DFES_Cls.DFC_MOXEMM_SMU_ALM1_8_C DFES_Cls.DFC_MOXEMM_SMU_ALM21_0_C DFES_Cls.DFC_MOXEMM_SMU_ALM21_16_C DFES_Cls.DFC_MOXEMM_SMU_ALM21_3_C DFES_Cls.DFC_MOXEMM_SMU_ALM2_1_C DFES_Cls.DFC_MOXEMM_SMU_ALM2_10_C DFES_Cls.DFC_MOXEMM_SMU_ALM2_11_C DFES_Cls.DFC_MOXEMM_SMU_ALM2_13_C DFES_Cls.DFC_MOXEMM_SMU_ALM2_14_C DFES_Cls.DFC_MOXEMM_SMU_ALM2_22_C DFES_Cls.DFC_MOXEMM_SMU_ALM2_23_C DFES_Cls.DFC_MOXEMM_SMU_ALM2_4_C DFES_Cls.DFC_MOXEMM_SMU_ALM2_5_C DFES_Cls.DFC_MOXEMM_SMU_ALM2_7_C DFES_Cls.DFC_MOXEMM_SMU_ALM2_8_C DFES_Cls.DFC_MOXEMM_SMU_ALM6_0_C DFES_Cls.DFC_MOXEMM_SMU_ALM6_11_C DFES_Cls.DFC_MOXEMM_SMU_ALM6_12_C DFES_Cls.DFC_MOXEMM_SMU_ALM6_14_C DFES_Cls.DFC_MOXEMM_SMU_ALM6_15_C DFES_Cls.DFC_MOXEMM_SMU_ALM6_17_C DFES_Cls.DFC_MOXEMM_SMU_ALM6_18_C DFES_Cls.DFC_MOXEMM_SMU_ALM6_20_C DFES_Cls.DFC_MOXEMM_SMU_ALM6_21_C DFES_Cls.DFC_MOXEMM_SMU_ALM6_25_C DFES_Cls.DFC_MOXEMM_SMU_ALM6_4_C /end DEF_CHARACTERISTIC
 FUNCTION_VERSION "30000.73.0_2.0.0" /end FUNCTION
/begin COMPU_METHOD DFES_OneToOne "" RAT_FUNC "%6.2" "-" COEFFS 0 1 0 0 0 1 /end COMPU_METHOD
/begin RECORD_LAYOUT Val_Wu8 FNC_VALUES 1 UBYTE COLUMN_DIR DIRECT /end RECORD_LAYOUT
/end MODULE
/end PROJECT
