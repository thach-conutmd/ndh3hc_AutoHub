ASAP2_VERSION 1 60
/begin PROJECT MG1CS022 "MG1CS022"
/begin HEADER "" VERSION "MG1CS022_62XSC_V037_TPROT" PROJECT_NO MG1CS022 /end HEADER
/begin MODULE DIM ""
/begin MOD_COMMON "" BYTE_ORDER MSB_LAST ALIGNMENT_BYTE 1 ALIGNMENT_WORD 2 ALIGNMENT_LONG 4 ALIGNMENT_INT64 4 ALIGNMENT_FLOAT32_IEEE 4 ALIGNMENT_FLOAT64_IEEE 4 DATA_SIZE 32 /end MOD_COMMON
/begin CHARACTERISTIC CrCtl_ctATVehSpdErr_C "AT vehicle Speed error Count" VALUE 0x80533818 Val_Ws16 65535.00 OneToOne -32768.00 32767.00 FORMAT "%8.2" /end CHARACTERISTIC
/begin CHARACTERISTIC CrCtl_ctContTapDnInitOut_C "output counter value for continuation Tap Down initial" VALUE 0x80533B20 Val_Wu8 127.0 OneToOne 0.00 127.0 FORMAT "%5.1" EXTENDED_LIMITS 0.00 255.0 /end CHARACTERISTIC
/begin CHARACTERISTIC CrCtl_ctContTapUpCnt_C "continuation TAP UP count value for CC" VALUE 0x8053381A Val_Wu8 127.0 OneToOne 0.00 127.0 FORMAT "%5.1" EXTENDED_LIMITS 0.00 255.0 /end CHARACTERISTIC
/begin CHARACTERISTIC CrCtl_ctContTapUpInitOut_C "output counter value for continuation Tap Up initial" VALUE 0x80533B21 Val_Wu8 127.0 OneToOne 0.00 127.0 FORMAT "%5.1" EXTENDED_LIMITS 0.00 255.0 /end CHARACTERISTIC
/begin CHARACTERISTIC CrCtl_ctTapDnInitOut_C "output counter value for Tap Down initial" VALUE 0x80533B22 Val_Wu8 127.0 OneToOne 0.00 127.0 FORMAT "%5.1" EXTENDED_LIMITS 0.00 255.0 /end CHARACTERISTIC
/begin CHARACTERISTIC CrCtl_ctTapUpInitOut_C "output counter value for Tap Up initial" VALUE 0x80533B23 Val_Wu8 127.0 OneToOne 0.00 127.0 FORMAT "%5.1" EXTENDED_LIMITS 0.00 255.0 /end CHARACTERISTIC
/begin CHARACTERISTIC CrCtl_fac1LGAppDiffCls_GMAP "Correct value of APP in 1 level lower gear for close side" MAP 0x80533B24 MapG_Ws16 511.9922 Fact1 -256.0000 255.9922 FORMAT "%8.4"
 /begin AXIS_DESCR COM_AXIS CrCtl_rReq_mp APPCrCtl1 12 0.00 163.8350 FORMAT "%8.4" EXTENDED_LIMITS -163.8400 163.8350 AXIS_PTS_REF CrCtl_facAPPReviX_AXIS /end AXIS_DESCR
 /begin AXIS_DESCR COM_AXIS CrCtl_vVehUpByte Vel_CrCtl1 6 0.00 255.0000 FORMAT "%8.4" EXTENDED_LIMITS -32768.00 32767.00 AXIS_PTS_REF CrCtl_facAPPReviY_AXIS /end AXIS_DESCR
/end CHARACTERISTIC
/begin CHARACTERISTIC CrCtl_fac1LGAppDiff_GMAP "Correct value of APP in 1 level lower gear for open side" MAP 0x80533BB4 MapG_Ws16 511.9922 Fact1 -256.0000 255.9922 FORMAT "%8.4"
 /begin AXIS_DESCR COM_AXIS CrCtl_rReq_mp APPCrCtl1 12 0.00 163.8350 FORMAT "%8.4" EXTENDED_LIMITS -163.8400 163.8350 AXIS_PTS_REF CrCtl_facAPPReviX_AXIS /end AXIS_DESCR
 /begin AXIS_DESCR COM_AXIS CrCtl_vVehUpByte Vel_CrCtl1 6 0.00 255.0000 FORMAT "%8.4" EXTENDED_LIMITS -32768.00 32767.00 AXIS_PTS_REF CrCtl_facAPPReviY_AXIS /end AXIS_DESCR
/end CHARACTERISTIC
/begin CHARACTERISTIC CrCtl_fac2LGAppDiffCls_GMAP "Correct value of APP in 2 level lower gear for close side" MAP 0x80533C44 MapG_Ws16 511.9922 Fact1 -256.0000 255.9922 FORMAT "%8.4"
 /begin AXIS_DESCR COM_AXIS CrCtl_rReq_mp APPCrCtl1 12 0.00 163.8350 FORMAT "%8.4" EXTENDED_LIMITS -163.8400 163.8350 AXIS_PTS_REF CrCtl_facAPPReviX_AXIS /end AXIS_DESCR
 /begin AXIS_DESCR COM_AXIS CrCtl_vVehUpByte Vel_CrCtl1 6 0.00 255.0000 FORMAT "%8.4" EXTENDED_LIMITS -32768.00 32767.00 AXIS_PTS_REF CrCtl_facAPPReviY_AXIS /end AXIS_DESCR
/end CHARACTERISTIC
/begin CHARACTERISTIC CrCtl_fac2LGAppDiff_GMAP "Correct value of APP in 2 level lower gear for open side" MAP 0x80533CD4 MapG_Ws16 511.9922 Fact1 -256.0000 255.9922 FORMAT "%8.4"
 /begin AXIS_DESCR COM_AXIS CrCtl_rReq_mp APPCrCtl1 12 0.00 163.8350 FORMAT "%8.4" EXTENDED_LIMITS -163.8400 163.8350 AXIS_PTS_REF CrCtl_facAPPReviX_AXIS /end AXIS_DESCR
 /begin AXIS_DESCR COM_AXIS CrCtl_vVehUpByte Vel_CrCtl1 6 0.00 255.0000 FORMAT "%8.4" EXTENDED_LIMITS -32768.00 32767.00 AXIS_PTS_REF CrCtl_facAPPReviY_AXIS /end AXIS_DESCR
/end CHARACTERISTIC
/begin CHARACTERISTIC CrCtl_fac3LGAppDiffCls_GMAP "Correct value of APP in 3 level lower gear for close side" MAP 0x80533D64 MapG_Ws16 511.9922 Fact1 -256.0000 255.9922 FORMAT "%8.4"
 /begin AXIS_DESCR COM_AXIS CrCtl_rReq_mp APPCrCtl1 12 0.00 163.8350 FORMAT "%8.4" EXTENDED_LIMITS -163.8400 163.8350 AXIS_PTS_REF CrCtl_facAPPReviX_AXIS /end AXIS_DESCR
 /begin AXIS_DESCR COM_AXIS CrCtl_vVehUpByte Vel_CrCtl1 6 0.00 255.0000 FORMAT "%8.4" EXTENDED_LIMITS -32768.00 32767.00 AXIS_PTS_REF CrCtl_facAPPReviY_AXIS /end AXIS_DESCR
/end CHARACTERISTIC
/begin CHARACTERISTIC CrCtl_fac3LGAppDiff_GMAP "Correct value of APP in 3 level lower gear for open side" MAP 0x80533DF4 MapG_Ws16 511.9922 Fact1 -256.0000 255.9922 FORMAT "%8.4"
 /begin AXIS_DESCR COM_AXIS CrCtl_rReq_mp APPCrCtl1 12 0.00 163.8350 FORMAT "%8.4" EXTENDED_LIMITS -163.8400 163.8350 AXIS_PTS_REF CrCtl_facAPPReviX_AXIS /end AXIS_DESCR
 /begin AXIS_DESCR COM_AXIS CrCtl_vVehUpByte Vel_CrCtl1 6 0.00 255.0000 FORMAT "%8.4" EXTENDED_LIMITS -32768.00 32767.00 AXIS_PTS_REF CrCtl_facAPPReviY_AXIS /end AXIS_DESCR
/end CHARACTERISTIC
/begin CHARACTERISTIC CrCtl_fac4LGAppDiffCls_GMAP "Correct value of APP in 4 level lower gear for close side" MAP 0x80533E84 MapG_Ws16 511.9922 Fact1 -256.0000 255.9922 FORMAT "%8.4"
 /begin AXIS_DESCR COM_AXIS CrCtl_rReq_mp APPCrCtl1 12 0.00 163.8350 FORMAT "%8.4" EXTENDED_LIMITS -163.8400 163.8350 AXIS_PTS_REF CrCtl_facAPPReviX_AXIS /end AXIS_DESCR
 /begin AXIS_DESCR COM_AXIS CrCtl_vVehUpByte Vel_CrCtl1 6 0.00 255.0000 FORMAT "%8.4" EXTENDED_LIMITS -32768.00 32767.00 AXIS_PTS_REF CrCtl_facAPPReviY_AXIS /end AXIS_DESCR
/end CHARACTERISTIC
/begin CHARACTERISTIC CrCtl_fac4LGAppDiff_GMAP "Correct value of APP in 4 level lower gear for open side" MAP 0x80533F14 MapG_Ws16 511.9922 Fact1 -256.0000 255.9922 FORMAT "%8.4"
 /begin AXIS_DESCR COM_AXIS CrCtl_rReq_mp APPCrCtl1 12 0.00 163.8350 FORMAT "%8.4" EXTENDED_LIMITS -163.8400 163.8350 AXIS_PTS_REF CrCtl_facAPPReviX_AXIS /end AXIS_DESCR
 /begin AXIS_DESCR COM_AXIS CrCtl_vVehUpByte Vel_CrCtl1 6 0.00 255.0000 FORMAT "%8.4" EXTENDED_LIMITS -32768.00 32767.00 AXIS_PTS_REF CrCtl_facAPPReviY_AXIS /end AXIS_DESCR
/end CHARACTERISTIC
/begin CHARACTERISTIC CrCtl_facACCAccnGn12_GCUR "Curve for Gain factor of ACC acceleration value" CURVE 0x80533FA4 CurG_Ws16 2047.938 Fact2 0.00 2047.938 FORMAT "%8.3" EXTENDED_LIMITS -2048.000 2047.938
 /begin AXIS_DESCR COM_AXIS CrCtl_vVehUpByte Vel_CrCtl1 12 0.00 255.0000 FORMAT "%8.4" EXTENDED_LIMITS -32768.00 32767.00 AXIS_PTS_REF CrCtl_vAccnCont_AX /end AXIS_DESCR
/end CHARACTERISTIC
/begin CHARACTERISTIC CrCtl_facACCDR1FbA_CUR "Accel differential coeffecient for DR1 judgement at ACC_F/B" CURVE 0x80533FBC RB_Cur_Xs16Ws16 0.9960938 Fact_CrCtl 0.00 0.9960938 FORMAT "%9.7" EXTENDED_LIMITS -128.0000 127.9961
 /begin AXIS_DESCR STD_AXIS CrCtl_vSpdDvtRgl_mp Vel_CrCtl 6 -128.0000 127.9961 FORMAT "%8.4" DEPOSIT ABSOLUTE /end AXIS_DESCR
/end CHARACTERISTIC
/begin CHARACTERISTIC CrCtl_facACCDR1ResA_MAP "Accel differential coeffecient data for DR1 judgement at ACC_RESUME" MAP 0x80533FD6 Map_Xs16Ys16Ws16 0.9960938 Fact_CrCtl 0.00 0.9960938 FORMAT "%9.7" EXTENDED_LIMITS -128.0000 127.9961
 /begin AXIS_DESCR STD_AXIS CrCtl_tiDRAccnControl_mp Time_ms_100ms 6 0.00 3276700. FORMAT "%8.0" EXTENDED_LIMITS -3276800. 3276700. DEPOSIT ABSOLUTE /end AXIS_DESCR
 /begin AXIS_DESCR STD_AXIS CrCtl_vSpdDvtRgl_mp Vel_CrCtl 6 -128.0000 127.9961 FORMAT "%8.4" DEPOSIT ABSOLUTE /end AXIS_DESCR
/end CHARACTERISTIC
/begin CHARACTERISTIC CrCtl_facACCDR2FbA_CUR "Accel differential coeffecient for DR2 judgement at ACC_F/B" CURVE 0x8053403A RB_Cur_Xs16Ws16 0.9960938 Fact_CrCtl 0.00 0.9960938 FORMAT "%9.7" EXTENDED_LIMITS -128.0000 127.9961
 /begin AXIS_DESCR STD_AXIS CrCtl_vSpdDvtRgl_mp Vel_CrCtl 6 -128.0000 127.9961 FORMAT "%8.4" DEPOSIT ABSOLUTE /end AXIS_DESCR
/end CHARACTERISTIC
/begin CHARACTERISTIC CrCtl_facACCDR2ResA_MAP "Accel differential coeffecient data for DR2 judgement at ACC_RESUME" MAP 0x80534054 Map_Xs16Ys16Ws16 0.9960938 Fact_CrCtl 0.00 0.9960938 FORMAT "%9.7" EXTENDED_LIMITS -128.0000 127.9961
 /begin AXIS_DESCR STD_AXIS CrCtl_tiDRAccnControl_mp Time_ms_100ms 6 0.00 3276700. FORMAT "%8.0" EXTENDED_LIMITS -3276800. 3276700. DEPOSIT ABSOLUTE /end AXIS_DESCR
 /begin AXIS_DESCR STD_AXIS CrCtl_vSpdDvtRgl_mp Vel_CrCtl 6 -128.0000 127.9961 FORMAT "%8.4" DEPOSIT ABSOLUTE /end AXIS_DESCR
/end CHARACTERISTIC
/begin CHARACTERISTIC CrCtl_facACCDR3FbA_CUR "Accel differential coeffecient for DR3 judgement at ACC_F/B" CURVE 0x805340B8 RB_Cur_Xs16Ws16 0.9960938 Fact_CrCtl 0.00 0.9960938 FORMAT "%9.7" EXTENDED_LIMITS -128.0000 127.9961
 /begin AXIS_DESCR STD_AXIS CrCtl_vSpdDvtRgl_mp Vel_CrCtl 6 -128.0000 127.9961 FORMAT "%8.4" DEPOSIT ABSOLUTE /end AXIS_DESCR
/end CHARACTERISTIC
/begin CHARACTERISTIC CrCtl_facACCDR3ResA_MAP "Accel differential coeffecient data for DR3 judgement at ACC_RESUME" MAP 0x805340D2 Map_Xs16Ys16Ws16 0.9960938 Fact_CrCtl 0.00 0.9960938 FORMAT "%9.7" EXTENDED_LIMITS -128.0000 127.9961
 /begin AXIS_DESCR STD_AXIS CrCtl_tiDRAccnControl_mp Time_ms_100ms 6 0.00 3276700. FORMAT "%8.0" EXTENDED_LIMITS -3276800. 3276700. DEPOSIT ABSOLUTE /end AXIS_DESCR
 /begin AXIS_DESCR STD_AXIS CrCtl_vSpdDvtRgl_mp Vel_CrCtl 6 -128.0000 127.9961 FORMAT "%8.4" DEPOSIT ABSOLUTE /end AXIS_DESCR
/end CHARACTERISTIC
/begin CHARACTERISTIC CrCtl_facACCDR4FbA_CUR "Accel differential coeffecient for DR4 judgement at ACC_FB" CURVE 0x80534136 RB_Cur_Xs16Ws16 0.9960938 Fact_CrCtl 0.00 0.9960938 FORMAT "%9.7" EXTENDED_LIMITS -128.0000 127.9961
 /begin AXIS_DESCR STD_AXIS CrCtl_vSpdDvtRgl_mp Vel_CrCtl 6 -128.0000 127.9961 FORMAT "%8.4" DEPOSIT ABSOLUTE /end AXIS_DESCR
/end CHARACTERISTIC
/begin CHARACTERISTIC CrCtl_facACCDR4ResA_MAP "Accel differential coeffecient data for DR4 judgement at ACC_RESUME" MAP 0x80534150 Map_Xs16Ys16Ws16 0.9960938 Fact_CrCtl 0.00 0.9960938 FORMAT "%9.7" EXTENDED_LIMITS -128.0000 127.9961
 /begin AXIS_DESCR STD_AXIS CrCtl_tiDRAccnControl_mp Time_ms_100ms 6 0.00 3276700. FORMAT "%8.0" EXTENDED_LIMITS -3276800. 3276700. DEPOSIT ABSOLUTE /end AXIS_DESCR
 /begin AXIS_DESCR STD_AXIS CrCtl_vSpdDvtRgl_mp Vel_CrCtl 6 -128.0000 127.9961 FORMAT "%8.4" DEPOSIT ABSOLUTE /end AXIS_DESCR
/end CHARACTERISTIC
/begin CHARACTERISTIC CrCtl_facACCDR5FbA_CUR "Accel differential coeffecient for DR5 judgement at ACC_FB" CURVE 0x805341B4 RB_Cur_Xs16Ws16 0.9960938 Fact_CrCtl 0.00 0.9960938 FORMAT "%9.7" EXTENDED_LIMITS -128.0000 127.9961
 /begin AXIS_DESCR STD_AXIS CrCtl_vSpdDvtRgl_mp Vel_CrCtl 6 -128.0000 127.9961 FORMAT "%8.4" DEPOSIT ABSOLUTE /end AXIS_DESCR
/end CHARACTERISTIC
/begin CHARACTERISTIC CrCtl_facACCDR5ResA_MAP "Accel differential coeffecient data for DR5 judgement at ACC_RESUME" MAP 0x805341CE Map_Xs16Ys16Ws16 0.9960938 Fact_CrCtl 0.00 0.9960938 FORMAT "%9.7" EXTENDED_LIMITS -128.0000 127.9961
 /begin AXIS_DESCR STD_AXIS CrCtl_tiDRAccnControl_mp Time_ms_100ms 6 0.00 3276700. FORMAT "%8.0" EXTENDED_LIMITS -3276800. 3276700. DEPOSIT ABSOLUTE /end AXIS_DESCR
 /begin AXIS_DESCR STD_AXIS CrCtl_vSpdDvtRgl_mp Vel_CrCtl 6 -128.0000 127.9961 FORMAT "%8.4" DEPOSIT ABSOLUTE /end AXIS_DESCR
/end CHARACTERISTIC
/begin CHARACTERISTIC CrCtl_facACCDR6FbA_CUR "Accel differential coeffecient for DR6 judgement at ACC_FB" CURVE 0x80534232 RB_Cur_Xs16Ws16 0.9960938 Fact_CrCtl 0.00 0.9960938 FORMAT "%9.7" EXTENDED_LIMITS -128.0000 127.9961
 /begin AXIS_DESCR STD_AXIS CrCtl_vSpdDvtRgl_mp Vel_CrCtl 6 -128.0000 127.9961 FORMAT "%8.4" DEPOSIT ABSOLUTE /end AXIS_DESCR
/end CHARACTERISTIC
/begin CHARACTERISTIC CrCtl_facACCDR6ResA_MAP "Accel differential coeffecient data for DR6 judgement at ACC_RESUME" MAP 0x8053424C Map_Xs16Ys16Ws16 0.9960938 Fact_CrCtl 0.00 0.9960938 FORMAT "%9.7" EXTENDED_LIMITS -128.0000 127.9961
 /begin AXIS_DESCR STD_AXIS CrCtl_tiDRAccnControl_mp Time_ms_100ms 6 0.00 3276700. FORMAT "%8.0" EXTENDED_LIMITS -3276800. 3276700. DEPOSIT ABSOLUTE /end AXIS_DESCR
 /begin AXIS_DESCR STD_AXIS CrCtl_vSpdDvtRgl_mp Vel_CrCtl 6 -128.0000 127.9961 FORMAT "%8.4" DEPOSIT ABSOLUTE /end AXIS_DESCR
/end CHARACTERISTIC
/begin CHARACTERISTIC CrCtl_facACCDR7FbA_CUR "Accel differential coeffecient for DR7 judgement at ACC_FB" CURVE 0x805342B0 RB_Cur_Xs16Ws16 0.9960938 Fact_CrCtl 0.00 0.9960938 FORMAT "%9.7" EXTENDED_LIMITS -128.0000 127.9961
 /begin AXIS_DESCR STD_AXIS CrCtl_vSpdDvtRgl_mp Vel_CrCtl 6 -128.0000 127.9961 FORMAT "%8.4" DEPOSIT ABSOLUTE /end AXIS_DESCR
/end CHARACTERISTIC
/begin CHARACTERISTIC CrCtl_facACCDR7ResA_MAP "Accel differential coeffecient data for DR7 judgement at ACC_RESUME" MAP 0x805342CA Map_Xs16Ys16Ws16 0.9960938 Fact_CrCtl 0.00 0.9960938 FORMAT "%9.7" EXTENDED_LIMITS -128.0000 127.9961
 /begin AXIS_DESCR STD_AXIS CrCtl_tiDRAccnControl_mp Time_ms_100ms 6 0.00 3276700. FORMAT "%8.0" EXTENDED_LIMITS -3276800. 3276700. DEPOSIT ABSOLUTE /end AXIS_DESCR
 /begin AXIS_DESCR STD_AXIS CrCtl_vSpdDvtRgl_mp Vel_CrCtl 6 -128.0000 127.9961 FORMAT "%8.4" DEPOSIT ABSOLUTE /end AXIS_DESCR
/end CHARACTERISTIC
/begin CHARACTERISTIC CrCtl_facACCECDR1AccrA_CUR "Accel differential coeffecient for DR1 judgement at CC_ACCEL for ECON" CURVE 0x8053432E RB_Cur_Xs16Ws16 0.9960938 Fact_CrCtl 0.00 0.9960938 FORMAT "%9.7" EXTENDED_LIMITS -128.0000 127.9961
 /begin AXIS_DESCR STD_AXIS CrCtl_tiDRAccnControl_mp Time_ms_100ms 6 0.00 3276700. FORMAT "%8.0" EXTENDED_LIMITS -3276800. 3276700. DEPOSIT ABSOLUTE /end AXIS_DESCR
/end CHARACTERISTIC
/begin CHARACTERISTIC CrCtl_facACCECDR1FbA_CUR "Accel differential coeffecient for DR1 judgement at ACC_F/B for ECON" CURVE 0x80534348 RB_Cur_Xs16Ws16 0.9960938 Fact_CrCtl 0.00 0.9960938 FORMAT "%9.7" EXTENDED_LIMITS -128.0000 127.9961
 /begin AXIS_DESCR STD_AXIS CrCtl_vSpdDvtRgl_mp Vel_CrCtl 6 -128.0000 127.9961 FORMAT "%8.4" DEPOSIT ABSOLUTE /end AXIS_DESCR
/end CHARACTERISTIC
/begin CHARACTERISTIC CrCtl_facACCECDR1ResA_MAP "Accel differential coeffecient data for DR1 judgement at ACC_RESUME for ECON" MAP 0x80534362 Map_Xs16Ys16Ws16 0.9960938 Fact_CrCtl 0.00 0.9960938 FORMAT "%9.7" EXTENDED_LIMITS -128.0000 127.9961
 /begin AXIS_DESCR STD_AXIS CrCtl_tiDRAccnControl_mp Time_ms_100ms 6 0.00 3276700. FORMAT "%8.0" EXTENDED_LIMITS -3276800. 3276700. DEPOSIT ABSOLUTE /end AXIS_DESCR
 /begin AXIS_DESCR STD_AXIS CrCtl_vSpdDvtRgl_mp Vel_CrCtl 6 -128.0000 127.9961 FORMAT "%8.4" DEPOSIT ABSOLUTE /end AXIS_DESCR
/end CHARACTERISTIC
/begin CHARACTERISTIC CrCtl_facACCECDR2AccrA_CUR "Accel differential coeffecient for DR2 judgement at CC_ACCEL for ECON" CURVE 0x805343C6 RB_Cur_Xs16Ws16 0.9960938 Fact_CrCtl 0.00 0.9960938 FORMAT "%9.7" EXTENDED_LIMITS -128.0000 127.9961
 /begin AXIS_DESCR STD_AXIS CrCtl_tiDRAccnControl_mp Time_ms_100ms 6 0.00 3276700. FORMAT "%8.0" EXTENDED_LIMITS -3276800. 3276700. DEPOSIT ABSOLUTE /end AXIS_DESCR
/end CHARACTERISTIC
/begin CHARACTERISTIC CrCtl_facACCECDR2FbA_CUR "Accel differential coeffecient for DR2 judgement at ACC_F/B for ECON" CURVE 0x805343E0 RB_Cur_Xs16Ws16 0.9960938 Fact_CrCtl 0.00 0.9960938 FORMAT "%9.7" EXTENDED_LIMITS -128.0000 127.9961
 /begin AXIS_DESCR STD_AXIS CrCtl_vSpdDvtRgl_mp Vel_CrCtl 6 -128.0000 127.9961 FORMAT "%8.4" DEPOSIT ABSOLUTE /end AXIS_DESCR
/end CHARACTERISTIC
/begin CHARACTERISTIC CrCtl_facACCECDR2ResA_MAP "Accel differential coeffecient data for DR2 judgement at ACC_RESUME for ECON" MAP 0x805343FA Map_Xs16Ys16Ws16 0.9960938 Fact_CrCtl 0.00 0.9960938 FORMAT "%9.7" EXTENDED_LIMITS -128.0000 127.9961
 /begin AXIS_DESCR STD_AXIS CrCtl_tiDRAccnControl_mp Time_ms_100ms 6 0.00 3276700. FORMAT "%8.0" EXTENDED_LIMITS -3276800. 3276700. DEPOSIT ABSOLUTE /end AXIS_DESCR
 /begin AXIS_DESCR STD_AXIS CrCtl_vSpdDvtRgl_mp Vel_CrCtl 6 -128.0000 127.9961 FORMAT "%8.4" DEPOSIT ABSOLUTE /end AXIS_DESCR
/end CHARACTERISTIC
/begin CHARACTERISTIC CrCtl_facACCECDR3AccrA_CUR "Accel differential coeffecient for DR3 judgement at CC_ACCEL for ECON" CURVE 0x8053445E RB_Cur_Xs16Ws16 0.9960938 Fact_CrCtl 0.00 0.9960938 FORMAT "%9.7" EXTENDED_LIMITS -128.0000 127.9961
 /begin AXIS_DESCR STD_AXIS CrCtl_tiDRAccnControl_mp Time_ms_100ms 6 0.00 3276700. FORMAT "%8.0" EXTENDED_LIMITS -3276800. 3276700. DEPOSIT ABSOLUTE /end AXIS_DESCR
/end CHARACTERISTIC
/begin CHARACTERISTIC CrCtl_facACCECDR3FbA_CUR "Accel differential coeffecient for DR3 judgement at ACC_F/B for ECON" CURVE 0x80534478 RB_Cur_Xs16Ws16 0.9960938 Fact_CrCtl 0.00 0.9960938 FORMAT "%9.7" EXTENDED_LIMITS -128.0000 127.9961
 /begin AXIS_DESCR STD_AXIS CrCtl_vSpdDvtRgl_mp Vel_CrCtl 6 -128.0000 127.9961 FORMAT "%8.4" DEPOSIT ABSOLUTE /end AXIS_DESCR
/end CHARACTERISTIC
/begin CHARACTERISTIC CrCtl_facACCECDR3ResA_MAP "Accel differential coeffecient data for DR3 judgement at ACC_RESUME for ECON" MAP 0x80534492 Map_Xs16Ys16Ws16 0.9960938 Fact_CrCtl 0.00 0.9960938 FORMAT "%9.7" EXTENDED_LIMITS -128.0000 127.9961
 /begin AXIS_DESCR STD_AXIS CrCtl_tiDRAccnControl_mp Time_ms_100ms 6 0.00 3276700. FORMAT "%8.0" EXTENDED_LIMITS -3276800. 3276700. DEPOSIT ABSOLUTE /end AXIS_DESCR
 /begin AXIS_DESCR STD_AXIS CrCtl_vSpdDvtRgl_mp Vel_CrCtl 6 -128.0000 127.9961 FORMAT "%8.4" DEPOSIT ABSOLUTE /end AXIS_DESCR
/end CHARACTERISTIC
/begin CHARACTERISTIC CrCtl_facACCECDR4AccrA_CUR "Accel differential coeffecient for DR4 judgement at CC_ACCEL for ECON" CURVE 0x805344F6 RB_Cur_Xs16Ws16 0.9960938 Fact_CrCtl 0.00 0.9960938 FORMAT "%9.7" EXTENDED_LIMITS -128.0000 127.9961
 /begin AXIS_DESCR STD_AXIS CrCtl_tiDRAccnControl_mp Time_ms_100ms 6 0.00 3276700. FORMAT "%8.0" EXTENDED_LIMITS -3276800. 3276700. DEPOSIT ABSOLUTE /end AXIS_DESCR
/end CHARACTERISTIC
/begin CHARACTERISTIC CrCtl_facACCECDR4FbA_CUR "Accel differential coeffecient for DR4 judgement at ACC_FB for ECON" CURVE 0x80534510 RB_Cur_Xs16Ws16 0.9960938 Fact_CrCtl 0.00 0.9960938 FORMAT "%9.7" EXTENDED_LIMITS -128.0000 127.9961
 /begin AXIS_DESCR STD_AXIS CrCtl_vSpdDvtRgl_mp Vel_CrCtl 6 -128.0000 127.9961 FORMAT "%8.4" DEPOSIT ABSOLUTE /end AXIS_DESCR
/end CHARACTERISTIC
/begin CHARACTERISTIC CrCtl_facACCECDR4ResA_MAP "Accel differential coeffecient data for DR4 judgement at ACC_RESUME for ECON" MAP 0x8053452A Map_Xs16Ys16Ws16 0.9960938 Fact_CrCtl 0.00 0.9960938 FORMAT "%9.7" EXTENDED_LIMITS -128.0000 127.9961
 /begin AXIS_DESCR STD_AXIS CrCtl_tiDRAccnControl_mp Time_ms_100ms 6 0.00 3276700. FORMAT "%8.0" EXTENDED_LIMITS -3276800. 3276700. DEPOSIT ABSOLUTE /end AXIS_DESCR
 /begin AXIS_DESCR STD_AXIS CrCtl_vSpdDvtRgl_mp Vel_CrCtl 6 -128.0000 127.9961 FORMAT "%8.4" DEPOSIT ABSOLUTE /end AXIS_DESCR
/end CHARACTERISTIC
/begin CHARACTERISTIC CrCtl_facACCECDR5AccrA_CUR "Accel differential coeffecient for DR5 judgement at CC_ACCEL for ECON" CURVE 0x8053458E RB_Cur_Xs16Ws16 0.9960938 Fact_CrCtl 0.00 0.9960938 FORMAT "%9.7" EXTENDED_LIMITS -128.0000 127.9961
 /begin AXIS_DESCR STD_AXIS CrCtl_tiDRAccnControl_mp Time_ms_100ms 6 0.00 3276700. FORMAT "%8.0" EXTENDED_LIMITS -3276800. 3276700. DEPOSIT ABSOLUTE /end AXIS_DESCR
/end CHARACTERISTIC
/begin CHARACTERISTIC CrCtl_facACCECDR5FbA_CUR "Accel differential coeffecient for DR5 judgement at ACC_FB for ECON" CURVE 0x805345A8 RB_Cur_Xs16Ws16 0.9960938 Fact_CrCtl 0.00 0.9960938 FORMAT "%9.7" EXTENDED_LIMITS -128.0000 127.9961
 /begin AXIS_DESCR STD_AXIS CrCtl_vSpdDvtRgl_mp Vel_CrCtl 6 -128.0000 127.9961 FORMAT "%8.4" DEPOSIT ABSOLUTE /end AXIS_DESCR
/end CHARACTERISTIC
/begin CHARACTERISTIC CrCtl_facACCECDR5ResA_MAP "Accel differential coeffecient data for DR5 judgement at ACC_RESUME for ECON" MAP 0x805345C2 Map_Xs16Ys16Ws16 0.9960938 Fact_CrCtl 0.00 0.9960938 FORMAT "%9.7" EXTENDED_LIMITS -128.0000 127.9961
 /begin AXIS_DESCR STD_AXIS CrCtl_tiDRAccnControl_mp Time_ms_100ms 6 0.00 3276700. FORMAT "%8.0" EXTENDED_LIMITS -3276800. 3276700. DEPOSIT ABSOLUTE /end AXIS_DESCR
 /begin AXIS_DESCR STD_AXIS CrCtl_vSpdDvtRgl_mp Vel_CrCtl 6 -128.0000 127.9961 FORMAT "%8.4" DEPOSIT ABSOLUTE /end AXIS_DESCR
/end CHARACTERISTIC
/begin CHARACTERISTIC CrCtl_facACCECDR6AccrA_CUR "Accel differential coeffecient for DR6 judgement at CC_ACCEL for ECON" CURVE 0x80534626 RB_Cur_Xs16Ws16 0.9960938 Fact_CrCtl 0.00 0.9960938 FORMAT "%9.7" EXTENDED_LIMITS -128.0000 127.9961
 /begin AXIS_DESCR STD_AXIS CrCtl_tiDRAccnControl_mp Time_ms_100ms 6 0.00 3276700. FORMAT "%8.0" EXTENDED_LIMITS -3276800. 3276700. DEPOSIT ABSOLUTE /end AXIS_DESCR
/end CHARACTERISTIC
/begin CHARACTERISTIC CrCtl_facACCECDR6FbA_CUR "Accel differential coeffecient for DR6 judgement at ACC_FB for ECON" CURVE 0x80534640 RB_Cur_Xs16Ws16 0.9960938 Fact_CrCtl 0.00 0.9960938 FORMAT "%9.7" EXTENDED_LIMITS -128.0000 127.9961
 /begin AXIS_DESCR STD_AXIS CrCtl_vSpdDvtRgl_mp Vel_CrCtl 6 -128.0000 127.9961 FORMAT "%8.4" DEPOSIT ABSOLUTE /end AXIS_DESCR
/end CHARACTERISTIC
/begin CHARACTERISTIC CrCtl_facACCECDR6ResA_MAP "Accel differential coeffecient data for DR6 judgement at ACC_RESUME for ECON" MAP 0x8053465A Map_Xs16Ys16Ws16 0.9960938 Fact_CrCtl 0.00 0.9960938 FORMAT "%9.7" EXTENDED_LIMITS -128.0000 127.9961
 /begin AXIS_DESCR STD_AXIS CrCtl_tiDRAccnControl_mp Time_ms_100ms 6 0.00 3276700. FORMAT "%8.0" EXTENDED_LIMITS -3276800. 3276700. DEPOSIT ABSOLUTE /end AXIS_DESCR
 /begin AXIS_DESCR STD_AXIS CrCtl_vSpdDvtRgl_mp Vel_CrCtl 6 -128.0000 127.9961 FORMAT "%8.4" DEPOSIT ABSOLUTE /end AXIS_DESCR
/end CHARACTERISTIC
/begin CHARACTERISTIC CrCtl_facACCECDR7AccrA_CUR "Accel differential coeffecient for DR7 judgement at CC_ACCEL for ECON" CURVE 0x805346BE RB_Cur_Xs16Ws16 0.9960938 Fact_CrCtl 0.00 0.9960938 FORMAT "%9.7" EXTENDED_LIMITS -128.0000 127.9961
 /begin AXIS_DESCR STD_AXIS CrCtl_tiDRAccnControl_mp Time_ms_100ms 6 0.00 3276700. FORMAT "%8.0" EXTENDED_LIMITS -3276800. 3276700. DEPOSIT ABSOLUTE /end AXIS_DESCR
/end CHARACTERISTIC
/begin CHARACTERISTIC CrCtl_facACCECDR7FbA_CUR "Accel differential coeffecient for DR7 judgement at ACC_FB for ECON" CURVE 0x805346D8 RB_Cur_Xs16Ws16 0.9960938 Fact_CrCtl 0.00 0.9960938 FORMAT "%9.7" EXTENDED_LIMITS -128.0000 127.9961
 /begin AXIS_DESCR STD_AXIS CrCtl_vSpdDvtRgl_mp Vel_CrCtl 6 -128.0000 127.9961 FORMAT "%8.4" DEPOSIT ABSOLUTE /end AXIS_DESCR
/end CHARACTERISTIC
/begin CHARACTERISTIC CrCtl_facACCECDR7ResA_MAP "Accel differential coeffecient data for DR7 judgement at ACC_RESUME for ECON" MAP 0x805346F2 Map_Xs16Ys16Ws16 0.9960938 Fact_CrCtl 0.00 0.9960938 FORMAT "%9.7" EXTENDED_LIMITS -128.0000 127.9961
 /begin AXIS_DESCR STD_AXIS CrCtl_tiDRAccnControl_mp Time_ms_100ms 6 0.00 3276700. FORMAT "%8.0" EXTENDED_LIMITS -3276800. 3276700. DEPOSIT ABSOLUTE /end AXIS_DESCR
 /begin AXIS_DESCR STD_AXIS CrCtl_vSpdDvtRgl_mp Vel_CrCtl 6 -128.0000 127.9961 FORMAT "%8.4" DEPOSIT ABSOLUTE /end AXIS_DESCR
/end CHARACTERISTIC
/begin CHARACTERISTIC CrCtl_facACCECOffAAppUp2_CUR "Acceleration factor for changing APP limitation number for ECON to 3 from 2 (for Acceleration , ECON sw OFF, and during ACC)" CURVE 0x80534756 RB_Cur_Xs16Ws16 0.9960938 Fact_CrCtl 0.00 0.9960938 FORMAT "%9.7" EXTENDED_LIMITS -128.0000 127.9961
 /begin AXIS_DESCR STD_AXIS CrCtl_tiDRAccnControl_mp Time_ms_100ms 6 -3276800. 3276700. FORMAT "%8.0" DEPOSIT ABSOLUTE /end AXIS_DESCR
/end CHARACTERISTIC
/begin CHARACTERISTIC CrCtl_facACCECOffAAppUp3_CUR "Acceleration factor for changing APP limitation number for ECON to 4 from 3 (for Acceleration , ECON sw OFF, and during ACC)" CURVE 0x80534770 RB_Cur_Xs16Ws16 0.9960938 Fact_CrCtl 0.00 0.9960938 FORMAT "%9.7" EXTENDED_LIMITS -128.0000 127.9961
 /begin AXIS_DESCR STD_AXIS CrCtl_tiDRAccnControl_mp Time_ms_100ms 6 -3276800. 3276700. FORMAT "%8.0" DEPOSIT ABSOLUTE /end AXIS_DESCR
/end CHARACTERISTIC
/begin CHARACTERISTIC CrCtl_facACCECOffAAppUp4_CUR "Acceleration factor for changing APP limitation number for ECON to 5 from 4 (for Acceleration , ECON sw OFF, and during ACC)" CURVE 0x8053478A RB_Cur_Xs16Ws16 0.9960938 Fact_CrCtl 0.00 0.9960938 FORMAT "%9.7" EXTENDED_LIMITS -128.0000 127.9961
 /begin AXIS_DESCR STD_AXIS CrCtl_tiDRAccnControl_mp Time_ms_100ms 6 -3276800. 3276700. FORMAT "%8.0" DEPOSIT ABSOLUTE /end AXIS_DESCR
/end CHARACTERISTIC
/begin CHARACTERISTIC CrCtl_facACCECOffAAppUp5_CUR "Acceleration factor for changing APP limitation number for ECON to 2 from 1 (for Acceleration , ECON sw ON, and during ACC)" CURVE 0x805347A4 RB_Cur_Xs16Ws16 0.9960938 Fact_CrCtl 0.00 0.9960938 FORMAT "%9.7" EXTENDED_LIMITS -128.0000 127.9961
 /begin AXIS_DESCR STD_AXIS CrCtl_tiDRAccnControl_mp Time_ms_100ms 6 -3276800. 3276700. FORMAT "%8.0" DEPOSIT ABSOLUTE /end AXIS_DESCR
/end CHARACTERISTIC
/begin CHARACTERISTIC CrCtl_facACCECOffAFbUp2_CUR "Acceleration factor for changing APP limitation number for ECON to 3 from 2 (for FB, ECON sw OFF, and during ACC)" CURVE 0x805347BE RB_Cur_Xs16Ws16 0.9960938 Fact_CrCtl 0.00 0.9960938 FORMAT "%9.7" EXTENDED_LIMITS -128.0000 127.9961
 /begin AXIS_DESCR STD_AXIS CrCtl_vSpdVar_mp Vel_CrCtl 6 -128.0000 127.9961 FORMAT "%8.4" DEPOSIT ABSOLUTE /end AXIS_DESCR
/end CHARACTERISTIC
/begin CHARACTERISTIC CrCtl_facACCECOffAFbUp3_CUR "Acceleration factor for changing APP limitation number for ECON to 4 from 3 (for FB, ECON sw OFF, and during ACC)" CURVE 0x805347D8 RB_Cur_Xs16Ws16 0.9960938 Fact_CrCtl 0.00 0.9960938 FORMAT "%9.7" EXTENDED_LIMITS -128.0000 127.9961
 /begin AXIS_DESCR STD_AXIS CrCtl_vSpdVar_mp Vel_CrCtl 6 -128.0000 127.9961 FORMAT "%8.4" DEPOSIT ABSOLUTE /end AXIS_DESCR
/end CHARACTERISTIC
/begin CHARACTERISTIC CrCtl_facACCECOffAFbUp4_CUR "Acceleration factor for changing APP limitation number for ECON to 5 from 4 (for FB, ECON sw OFF, and during ACC)" CURVE 0x805347F2 RB_Cur_Xs16Ws16 0.9960938 Fact_CrCtl 0.00 0.9960938 FORMAT "%9.7" EXTENDED_LIMITS -128.0000 127.9961
 /begin AXIS_DESCR STD_AXIS CrCtl_vSpdVar_mp Vel_CrCtl 6 -128.0000 127.9961 FORMAT "%8.4" DEPOSIT ABSOLUTE /end AXIS_DESCR
/end CHARACTERISTIC
/begin CHARACTERISTIC CrCtl_facACCECOffAFbUp5_CUR "Acceleration factor for changing APP limitation number for ECON to 2 from 1 (for FB, ECON sw ON, and during ACC)" CURVE 0x8053480C RB_Cur_Xs16Ws16 0.9960938 Fact_CrCtl 0.00 0.9960938 FORMAT "%9.7" EXTENDED_LIMITS -128.0000 127.9961
 /begin AXIS_DESCR STD_AXIS CrCtl_vSpdVar_mp Vel_CrCtl 6 -128.0000 127.9961 FORMAT "%8.4" DEPOSIT ABSOLUTE /end AXIS_DESCR
/end CHARACTERISTIC
/begin CHARACTERISTIC CrCtl_facACCECOffAResUp2_MAP "Acceleration factor for changing APP limitation number for ECON to 3 from 2 (for Resume, ECON sw OFF, and during ACC)" MAP 0x80534826 Map_Xs16Ys16Ws16 0.9960938 Fact_CrCtl 0.00 0.9960938 FORMAT "%9.7" EXTENDED_LIMITS -128.0000 127.9961
 /begin AXIS_DESCR STD_AXIS CrCtl_tiDRAccnControl_mp Time_ms_100ms 6 -3276800. 3276700. FORMAT "%8.0" DEPOSIT ABSOLUTE /end AXIS_DESCR
 /begin AXIS_DESCR STD_AXIS CrCtl_vSpdVar_mp Vel_CrCtl 6 -128.0000 127.9961 FORMAT "%8.4" DEPOSIT ABSOLUTE /end AXIS_DESCR
/end CHARACTERISTIC
/begin CHARACTERISTIC CrCtl_facACCECOffAResUp3_MAP "Acceleration factor for changing APP limitation number for ECON to 4 from 3 (for Resume, ECON sw OFF, and during ACC)" MAP 0x8053488A Map_Xs16Ys16Ws16 0.9960938 Fact_CrCtl 0.00 0.9960938 FORMAT "%9.7" EXTENDED_LIMITS -128.0000 127.9961
 /begin AXIS_DESCR STD_AXIS CrCtl_tiDRAccnControl_mp Time_ms_100ms 6 -3276800. 3276700. FORMAT "%8.0" DEPOSIT ABSOLUTE /end AXIS_DESCR
 /begin AXIS_DESCR STD_AXIS CrCtl_vSpdVar_mp Vel_CrCtl 6 -128.0000 127.9961 FORMAT "%8.4" DEPOSIT ABSOLUTE /end AXIS_DESCR
/end CHARACTERISTIC
/begin CHARACTERISTIC CrCtl_facACCECOffAResUp4_MAP "Acceleration factor for changing APP limitation number for ECON to 5 from 4 (for Resume, ECON sw OFF, and during ACC)" MAP 0x805348EE Map_Xs16Ys16Ws16 0.9960938 Fact_CrCtl 0.00 0.9960938 FORMAT "%9.7" EXTENDED_LIMITS -128.0000 127.9961
 /begin AXIS_DESCR STD_AXIS CrCtl_tiDRAccnControl_mp Time_ms_100ms 6 -3276800. 3276700. FORMAT "%8.0" DEPOSIT ABSOLUTE /end AXIS_DESCR
 /begin AXIS_DESCR STD_AXIS CrCtl_vSpdVar_mp Vel_CrCtl 6 -128.0000 127.9961 FORMAT "%8.4" DEPOSIT ABSOLUTE /end AXIS_DESCR
/end CHARACTERISTIC
/begin CHARACTERISTIC CrCtl_facACCECOffAResUp5_MAP "Acceleration factor for changing APP limitation number for ECON to 2 from 1 (for Resume, ECON sw ON, and during ACC)" MAP 0x80534952 Map_Xs16Ys16Ws16 0.9960938 Fact_CrCtl 0.00 0.9960938 FORMAT "%9.7" EXTENDED_LIMITS -128.0000 127.9961
 /begin AXIS_DESCR STD_AXIS CrCtl_tiDRAccnControl_mp Time_ms_100ms 6 -3276800. 3276700. FORMAT "%8.0" DEPOSIT ABSOLUTE /end AXIS_DESCR
 /begin AXIS_DESCR STD_AXIS CrCtl_vSpdVar_mp Vel_CrCtl 6 -128.0000 127.9961 FORMAT "%8.4" DEPOSIT ABSOLUTE /end AXIS_DESCR
/end CHARACTERISTIC
/begin CHARACTERISTIC CrCtl_facACCECOnAAppUp2_CUR "Acceleration factor for changing APP limitation number for ECON to 3 from 2 (for Acceleration , ECON sw ON, and during ACC)" CURVE 0x805349B6 RB_Cur_Xs16Ws16 0.9960938 Fact_CrCtl 0.00 0.9960938 FORMAT "%9.7" EXTENDED_LIMITS -128.0000 127.9961
 /begin AXIS_DESCR STD_AXIS CrCtl_tiDRAccnControl_mp Time_ms_100ms 6 -3276800. 3276700. FORMAT "%8.0" DEPOSIT ABSOLUTE /end AXIS_DESCR
/end CHARACTERISTIC
/begin CHARACTERISTIC CrCtl_facAccnFltFltVal_C "factor of acceleration filtering for cruise control" VALUE 0x8053381C Val_Ws16 255.9961 Fact_CrCtl -128.0000 127.9961 FORMAT "%8.4" /end CHARACTERISTIC
/begin CHARACTERISTIC CrCtl_facAccnFltVal_C "factor of acceleration filtering for cruise control" VALUE 0x8053381E Val_Ws16 255.9961 Fact_CrCtl -128.0000 127.9961 FORMAT "%8.4" /end CHARACTERISTIC
/begin CHARACTERISTIC CrCtl_facAirRes_C "factor of Air resistance value" VALUE 0x80533820 Val_Ws32 65535.9999847 Fact_CrCtl4 -32768.0000000 32767.9999847 FORMAT "%13.7" /end CHARACTERISTIC
/begin AXIS_PTS CrCtl_facAPPReviX_AXIS "Number of X-Axispoints for CrCtl_facAPPRevi_GMAP." 0x80534C52 CrCtl_rReq_mp Axis_Xs16 163.8350 APPCrCtl1 12 0.00 163.8350 FORMAT "%8.4" EXTENDED_LIMITS -163.8400 163.8350 DEPOSIT ABSOLUTE /end AXIS_PTS
/begin AXIS_PTS CrCtl_facAPPReviY_AXIS "Number of Y-axispoints for CrCtl_facAPPRevi_GMAP." 0x80534C6C CrCtl_vVehUpByte Axis_Xs16 255.0000 Vel_CrCtl1 6 0.00 255.0000 FORMAT "%8.4" EXTENDED_LIMITS -32768.00 32767.00 DEPOSIT ABSOLUTE /end AXIS_PTS
/begin CHARACTERISTIC CrCtl_facASLAcclFltVal_C "Factor of accelerate speed filter" VALUE 0x80533824 Val_Ws16 255.9961 Fact_CrCtl -128.0000 127.9961 FORMAT "%8.4" /end CHARACTERISTIC
/begin CHARACTERISTIC CrCtl_facASLVehFlt_C "Factor of vehicle speed filter" VALUE 0x80533826 Val_Ws16 255.9961 Fact_CrCtl -128.0000 127.9961 FORMAT "%8.4" /end CHARACTERISTIC
/begin CHARACTERISTIC CrCtl_facAtmPresSlpA_C "Atmospheric pressure correction for Slope A" VALUE 0x80533828 Val_Wu16 65535.00 OneToOne 0.00 65535.00 FORMAT "%8.2" /end CHARACTERISTIC
/begin CHARACTERISTIC CrCtl_facAtmPresSlpB_C "Atmospheric pressure correction for Slope B" VALUE 0x8053382A Val_Wu16 65535.00 OneToOne 0.00 65535.00 FORMAT "%8.2" /end CHARACTERISTIC
/begin CHARACTERISTIC CrCtl_facDecAPP_C "Percentage decrease in CC_AT cooperative control" VALUE 0x8053382C Val_Ws16 255.9961 Fact_CrCtl -128.0000 127.9961 FORMAT "%8.4" /end CHARACTERISTIC
/begin CHARACTERISTIC CrCtl_facEngInert_C "factor of Engine inertia value for cruise control" VALUE 0x80533830 Val_Ws32 65535.9999847 Fact_CrCtl4 -32768.0000000 32767.9999847 FORMAT "%13.7" /end CHARACTERISTIC
/begin CHARACTERISTIC CrCtl_facEstSlpReviA12_GCUR "Curve for factor of Estimation Slope revision value A" CURVE 0x80533834 CurG_Ws16 255.9961 Fact_CrCtl -128.0000 127.9961 FORMAT "%8.4"
 /begin AXIS_DESCR COM_AXIS CrCtl_vVehUpByte Vel_CrCtl1 12 0.00 255.0000 FORMAT "%8.4" EXTENDED_LIMITS -32768.00 32767.00 AXIS_PTS_REF CrCtl_vEstSlp_AXIS /end AXIS_DESCR
/end CHARACTERISTIC
/begin CHARACTERISTIC CrCtl_facEstSlpReviB12_GCUR "Curve for factor of Estimation Slope revision value B" CURVE 0x8053384C CurG_Ws16 255.9961 Fact_CrCtl -128.0000 127.9961 FORMAT "%8.4"
 /begin AXIS_DESCR COM_AXIS CrCtl_vVehUpByte Vel_CrCtl1 12 0.00 255.0000 FORMAT "%8.4" EXTENDED_LIMITS -32768.00 32767.00 AXIS_PTS_REF CrCtl_vEstSlp_AXIS /end AXIS_DESCR
/end CHARACTERISTIC
/begin CHARACTERISTIC CrCtl_facIDASVehFil_C "Factor of cruise control Vehicle Speed Filter under IDAS control" VALUE 0x80533864 Val_Ws16 255.9961 Fact_CrCtl -128.0000 127.9961 FORMAT "%8.4" /end CHARACTERISTIC
/begin CHARACTERISTIC CrCtl_facMETReviFlt_C "factor of Filtering Meter revision" VALUE 0x80533866 Val_Ws16 255.9961 Fact_CrCtl -128.0000 127.9961 FORMAT "%8.4" /end CHARACTERISTIC
/begin CHARACTERISTIC CrCtl_facMETSpdFlt_C "factor of Filtering Meter Vehicle Speed" VALUE 0x80533868 Val_Ws16 255.9961 Fact_CrCtl -128.0000 127.9961 FORMAT "%8.4" /end CHARACTERISTIC
/begin CHARACTERISTIC CrCtl_facRollRes_C "factor of Roll resistance value" VALUE 0x8053386C Val_Ws32 65535.9999847 Fact_CrCtl4 -32768.0000000 32767.9999847 FORMAT "%13.7" /end CHARACTERISTIC
/begin CHARACTERISTIC CrCtl_facSlpFltVal_C "factor of filtering Estimation Slope value for cruise control" VALUE 0x80533870 Val_Ws16 255.9961 Fact_CrCtl -128.0000 127.9961 FORMAT "%8.4" /end CHARACTERISTIC
/begin CHARACTERISTIC CrCtl_facSpdUnConv_C "Conversion factor from MPH to Kmph" VALUE 0x80533872 Val_Ws16 32767.00 OneToOne 0.00 32767.00 FORMAT "%8.2" EXTENDED_LIMITS -32768.00 32767.00 /end CHARACTERISTIC
/begin CHARACTERISTIC CrCtl_facTireInert_C "factor of Tire inertia value for cruise control" VALUE 0x80533874 Val_Ws16 255.9961 Fact_CrCtl -128.0000 127.9961 FORMAT "%8.4" /end CHARACTERISTIC
/begin CHARACTERISTIC CrCtl_facTrqConv_C "factor of Torque conversion value" VALUE 0x80533878 Val_Ws32 65535.9999847 Fact_CrCtl4 -32768.0000000 32767.9999847 FORMAT "%13.7" /end CHARACTERISTIC
/begin CHARACTERISTIC CrCtl_facVehFlt_C "factor of cruise control Vehicle Speed Filter" VALUE 0x8053387C Val_Ws16 255.9961 Fact_CrCtl -128.0000 127.9961 FORMAT "%8.4" /end CHARACTERISTIC
/begin CHARACTERISTIC CrCtl_facVehReFlt_C "factor of Meter Vehicle Speed ReFilter" VALUE 0x8053387E Val_Ws16 255.9961 Fact_CrCtl -128.0000 127.9961 FORMAT "%8.4" /end CHARACTERISTIC
/begin CHARACTERISTIC CrCtl_flgSwtNoMemSpdActCdn_C "Calibration to activate cruise control in case of no set speed display on meter" VALUE 0x80533880 Val_Wu8 255.0 OneToOne 0.00 255.0 FORMAT "%5.1" /end CHARACTERISTIC
/begin CHARACTERISTIC CrCtl_flgSwtNoMemSpd_C "Calibration to activate cruise control at current speed when resume switch is pressed" VALUE 0x80533881 Val_Wu8 255.0 OneToOne 0.00 255.0 FORMAT "%5.1" /end CHARACTERISTIC
/begin CHARACTERISTIC CrCtl_mCar_C "Car mass value for cruise control" VALUE 0x80533882 Val_Ws16 65535.00 m_Car_CrCtl -32768.00 32767.00 FORMAT "%8.2" /end CHARACTERISTIC
/begin CHARACTERISTIC CrCtl_numACCType_C "cruise control type number" VALUE 0x80533884 Val_Wu8 150.0 OneToOne 0.00 150.0 FORMAT "%5.1" EXTENDED_LIMITS 0.00 255.0 /end CHARACTERISTIC
/begin CHARACTERISTIC CrCtl_numMETReviSel_C "Meter Revision control select Number" VALUE 0x80533885 Val_Wu8 127.0 OneToOne 0.00 127.0 FORMAT "%5.1" EXTENDED_LIMITS 0.00 255.0 /end CHARACTERISTIC
/begin CHARACTERISTIC CrCtl_rConvSlipRatLim_C "Conversion slip ratio limit" VALUE 0x80533886 Val_Ws16 163.8350 CrCtlSlipRat 0.00 163.8350 FORMAT "%8.4" EXTENDED_LIMITS -163.8400 163.8350 /end CHARACTERISTIC
/begin CHARACTERISTIC CrCtl_rEstSlpTrnsAT_CUR "Estimated slope value for AT" CURVE 0x80533888 Cur_Xs16Ws16 3276.700 Prc_CrCtl2 0.00 3276.700 FORMAT "%8.3" EXTENDED_LIMITS -3276.800 3276.700
 /begin AXIS_DESCR STD_AXIS Gbx_rConvSlip CrCtlSlipRat 6 -163.8400 163.8350 FORMAT "%8.4" DEPOSIT ABSOLUTE /end AXIS_DESCR
/end CHARACTERISTIC
/begin CHARACTERISTIC CrCtl_rEstSlpTrns_C "Transition Ratio of Estimation Slope value" VALUE 0x805338A2 Val_Ws16 3276.700 Prc_CrCtl2 0.00 3276.700 FORMAT "%8.3" EXTENDED_LIMITS -3276.800 3276.700 /end CHARACTERISTIC
/begin CHARACTERISTIC CrCtl_rMETFltDflVal_C "default value of Filtering Meter revision ratio value" VALUE 0x805338A4 Val_Ws32 65535.9999695 Fact_CrCtl1 0.00 65535.9999695 FORMAT "%13.7" EXTENDED_LIMITS -65536.0000000 65535.9999695 /end CHARACTERISTIC
/begin CHARACTERISTIC CrCtl_rMETReviDflVal_C "default value of Meter revision Ratio value" VALUE 0x805338A8 Val_Ws16 655.3500 Prc_CrCtl1 -327.6800 327.6700 FORMAT "%8.4" /end CHARACTERISTIC
/begin CHARACTERISTIC CrCtl_rMETReviLoLim_GCUR "Curve for Ratio of Meter Vehicle Speed revision Lo limit value" CURVE 0x805338AA CurG_Ws16 327.6700 Prc_CrCtl1 0.00 327.6700 FORMAT "%8.4" EXTENDED_LIMITS -327.6800 327.6700
 /begin AXIS_DESCR COM_AXIS CrCtl_vFltdUpByte_mp Vel_CrCtl1 12 0.00 255.0000 FORMAT "%8.4" EXTENDED_LIMITS -32768.00 32767.00 AXIS_PTS_REF CrCtl_vMETRevi_AXIS /end AXIS_DESCR
/end CHARACTERISTIC
/begin CHARACTERISTIC CrCtl_rMETReviUpLim_GCUR "Curve for Ratio of Meter Vehicle Speed revision Upper limit value" CURVE 0x805338C2 CurG_Ws16 327.6700 Prc_CrCtl1 0.00 327.6700 FORMAT "%8.4" EXTENDED_LIMITS -327.6800 327.6700
 /begin AXIS_DESCR COM_AXIS CrCtl_vFltdUpByte_mp Vel_CrCtl1 12 0.00 255.0000 FORMAT "%8.4" EXTENDED_LIMITS -32768.00 32767.00 AXIS_PTS_REF CrCtl_vMETRevi_AXIS /end AXIS_DESCR
/end CHARACTERISTIC
/begin CHARACTERISTIC CrCtl_rMETSpdRevi_GCUR "Curve for Ratio of Meter Vehicle Speed revision value" CURVE 0x805338DA CurG_Ws16 327.6700 Prc_CrCtl1 0.00 327.6700 FORMAT "%8.4" EXTENDED_LIMITS -327.6800 327.6700
 /begin AXIS_DESCR COM_AXIS CrCtl_vFltdUpByte_mp Vel_CrCtl1 12 0.00 255.0000 FORMAT "%8.4" EXTENDED_LIMITS -32768.00 32767.00 AXIS_PTS_REF CrCtl_vMETRevi_AXIS /end AXIS_DESCR
/end CHARACTERISTIC
/begin CHARACTERISTIC CrCtl_rShutOffChkVal_C "Accel shut off check value" VALUE 0x805338F2 Val_Ws16 100.0000 Prc 0.00 100.0000 FORMAT "%8.4" EXTENDED_LIMITS -400.0000 399.9878 /end CHARACTERISTIC
/begin CHARACTERISTIC CrCtl_rVehErrChkVal_C "Vehicle Speed Error Check ratio" VALUE 0x805338F4 Val_Ws8 127.0 Prc_CrCtl 0.00 127.0 FORMAT "%5.1" EXTENDED_LIMITS -128.0 127.0 /end CHARACTERISTIC
/begin CHARACTERISTIC CrCtl_stACCRstSel_C "selected value by Reset spec for ACC" VALUE 0x805338F5 Val_Wu8 1.000 OneToOne 0.00 1.000 FORMAT "%5.3" EXTENDED_LIMITS 0.00 255.0 /end CHARACTERISTIC
/begin CHARACTERISTIC CrCtl_stATComSel_C "Status value for com seletion for Automatic Transmission" VALUE 0x805338F6 Val_Wu8 1.000 OneToOne 0.00 1.000 FORMAT "%5.3" EXTENDED_LIMITS 0.00 255.0 /end CHARACTERISTIC
/begin CHARACTERISTIC CrCtl_stCCCoaDisbl_C "Switch which coast control is disabled when SET-SW is pushed long." VALUE 0x805338F7 Val_Wu8 1.000 OneToOne 0.00 1.000 FORMAT "%5.3" EXTENDED_LIMITS 0.00 255.0 /end CHARACTERISTIC
/begin CHARACTERISTIC CrCtl_stManCnclSupt_C "Status to cancel the operation which is assigned to each bit" VALUE 0x805338F8 Val_Wu8 127.0 OneToOne 0.00 127.0 FORMAT "%5.1" EXTENDED_LIMITS 0.00 255.0 /end CHARACTERISTIC
/begin CHARACTERISTIC CrCtl_stMemMETReviSel_C "Meter revision select value for Memory speed" VALUE 0x805338F9 Val_Wu8 1.000 OneToOne 0.00 1.000 FORMAT "%5.3" EXTENDED_LIMITS 0.00 255.0 /end CHARACTERISTIC
/begin CHARACTERISTIC CrCtl_stMETReviLSBSel_C "selected value by LSB of Meter revisions" VALUE 0x805338FA Val_Wu8 1.000 OneToOne 0.00 1.000 FORMAT "%5.3" EXTENDED_LIMITS 0.00 255.0 /end CHARACTERISTIC
/begin CHARACTERISTIC CrCtl_stMETReviSel_C "Meter Revision select value" VALUE 0x805338FB Val_Wu8 1.000 OneToOne 0.00 1.000 FORMAT "%5.3" EXTENDED_LIMITS 0.00 255.0 /end CHARACTERISTIC
/begin CHARACTERISTIC CrCtl_swtISSSel_C "Switch for ISS selection in cruise control" VALUE 0x805338FC Val_Wu8 1.000 OneToOne 0.00 1.000 FORMAT "%5.3" EXTENDED_LIMITS 0.00 255.0 /end CHARACTERISTIC
/begin CHARACTERISTIC CrCtl_swtResSetSel_C "Behavior of keeping SETRES-SW pushed" VALUE 0x805338FD Val_Wu8 1.000 OneToOne 0.00 1.000 FORMAT "%5.3" EXTENDED_LIMITS 0.00 255.0 /end CHARACTERISTIC
/begin CHARACTERISTIC CrCtl_swtSetSpdCorEna_C "Enable switch to correct set speed for cruise control" VALUE 0x805338FE Val_Wu8 1.000 OneToOne 0.00 1.000 FORMAT "%5.3" EXTENDED_LIMITS 0.00 255.0 /end CHARACTERISTIC
/begin CHARACTERISTIC CrCtl_tiACCAPrelErr_C "Time of ACCA communication preliminary error check value" VALUE 0x80533900 Val_Ws16 327670.0 Time_ms 0.00 327670.0 FORMAT "%8.1" EXTENDED_LIMITS -327680.0 327670.0 /end CHARACTERISTIC
/begin CHARACTERISTIC CrCtl_tiACCBPrelErr_C "Time of ACCB communication preliminary error check value" VALUE 0x80533902 Val_Ws16 327670.0 Time_ms 0.00 327670.0 FORMAT "%8.1" EXTENDED_LIMITS -327680.0 327670.0 /end CHARACTERISTIC
/begin CHARACTERISTIC CrCtl_tiACCFail_C "Time of ACC Fail detection check value" VALUE 0x80533904 Val_Ws16 327670.0 Time_ms 0.00 327670.0 FORMAT "%8.1" EXTENDED_LIMITS -327680.0 327670.0 /end CHARACTERISTIC
/begin CHARACTERISTIC CrCtl_tiACCInfo_C "time to ACC information check" VALUE 0x80533906 Val_Ws16 327670.0 Time_ms 0.00 327670.0 FORMAT "%8.1" EXTENDED_LIMITS -327680.0 327670.0 /end CHARACTERISTIC
/begin CHARACTERISTIC CrCtl_tiACCMod_C "Time of ACC Mode detection check value" VALUE 0x80533908 Val_Ws16 327670.0 Time_ms 0.00 327670.0 FORMAT "%8.1" EXTENDED_LIMITS -327680.0 327670.0 /end CHARACTERISTIC
/begin CHARACTERISTIC CrCtl_tiAutoBrkHold_C "time to auto brake condition hold check" VALUE 0x8053390A Val_Ws16 327670.0 Time_ms 0.00 327670.0 FORMAT "%8.1" EXTENDED_LIMITS -327680.0 327670.0 /end CHARACTERISTIC
/begin CHARACTERISTIC CrCtl_tiAValFild_C "Filtering time for vehicle speed changing" VALUE 0x8053390C Val_Ws32 4294967.3 TimeDelay_ms 0.0 4294967.3 FORMAT "%12.1" /end CHARACTERISTIC
/begin CHARACTERISTIC CrCtl_tiCluFild_C "Filtering time for cluth torque" VALUE 0x80533910 Val_Ws32 4294967.3 TimeDelay_ms 0.0 4294967.3 FORMAT "%12.1" /end CHARACTERISTIC
/begin CHARACTERISTIC CrCtl_tiContInhib_C "cruise control inhibit time" VALUE 0x80533914 Val_Ws16 327670.0 Time_ms 0.00 327670.0 FORMAT "%8.1" EXTENDED_LIMITS -327680.0 327670.0 /end CHARACTERISTIC
/begin CHARACTERISTIC CrCtl_tiEstSlpCalcStp_C "Estimation Slope calculation stop check time" VALUE 0x80533916 Val_Ws16 3276700. Time_ms_100ms 0.00 3276700. FORMAT "%8.0" EXTENDED_LIMITS -3276800. 3276700. /end CHARACTERISTIC
/begin CHARACTERISTIC CrCtl_tiFltVarChk_C "Filter Vehicle speed variant check time" VALUE 0x80533918 Val_Ws16 3276700. Time_ms_100ms 0.00 3276700. FORMAT "%8.0" EXTENDED_LIMITS -3276800. 3276700. /end CHARACTERISTIC
/begin CHARACTERISTIC CrCtl_tiIDASAExsJdg_C "Time to excessive judgment in acceleration under IDAS control" VALUE 0x8053391A Val_Ws16 327670.0 Time_ms 0.00 327670.0 FORMAT "%8.1" EXTENDED_LIMITS -327680.0 327670.0 /end CHARACTERISTIC
/begin CHARACTERISTIC CrCtl_tiIdasbErr_C "." VALUE 0x8053391C Val_Ws16 327670.0 Time_ms 0.00 327670.0 FORMAT "%8.1" EXTENDED_LIMITS -327680.0 327670.0 /end CHARACTERISTIC
/begin CHARACTERISTIC CrCtl_tiIDASFailARels_C "Time to acceleration fail release under IDAS control" VALUE 0x8053391E Val_Ws16 327670.0 Time_ms 0.00 327670.0 FORMAT "%8.1" EXTENDED_LIMITS -327680.0 327670.0 /end CHARACTERISTIC
/begin CHARACTERISTIC CrCtl_tiMemSpdErrChk_C "time to Memory Speed error check" VALUE 0x80533920 Val_Ws16 327670.0 Time_ms 0.00 327670.0 FORMAT "%8.1" EXTENDED_LIMITS -327680.0 327670.0 /end CHARACTERISTIC
/begin CHARACTERISTIC CrCtl_tiMETVarChk_C "Meter speed variant check time" VALUE 0x80533922 Val_Ws16 3276700. Time_ms_100ms 0.00 3276700. FORMAT "%8.0" EXTENDED_LIMITS -3276800. 3276700. /end CHARACTERISTIC
/begin CHARACTERISTIC CrCtl_tiRePermSet_C "RePermit set check time" VALUE 0x80533924 Val_Ws16 327670.0 Time_ms 0.00 327670.0 FORMAT "%8.1" EXTENDED_LIMITS -327680.0 327670.0 /end CHARACTERISTIC
/begin CHARACTERISTIC CrCtl_tiVehErrStart_C "vehicle speed error check start time" VALUE 0x80533926 Val_Ws16 327670.0 Time_ms 0.00 327670.0 FORMAT "%8.1" EXTENDED_LIMITS -327680.0 327670.0 /end CHARACTERISTIC
/begin CHARACTERISTIC CrCtl_vACCAccnDeclErrChk_C "acceleration/deceleration error check value for ACC" VALUE 0x80533928 Val_Ws32 127.996093750 Vel_CrCtl 0.00 127.996093750 FORMAT "%13.9" EXTENDED_LIMITS -8388608.00000 8388607.99609 /end CHARACTERISTIC
/begin CHARACTERISTIC CrCtl_vACCAftTapMemSpdKmhAP_C "Memory speed of finished Tap up for ACC Asia Pacific" VALUE 0x8053392C Val_Ws32 16777215.9961 Vel_CrCtl -8388608.00000 8388607.99609 FORMAT "%13.5" /end CHARACTERISTIC
/begin CHARACTERISTIC CrCtl_vACCAftTapMemSpdMPHAP_C "Memory speed in MPH unit of finished Tap up for ACC Asia Pacific" VALUE 0x80533930 Val_Ws32 127.996093750 Vel_CrCtl_MPH 0.00 127.996093750 FORMAT "%13.9" EXTENDED_LIMITS -8388608.00000 8388607.99609 /end CHARACTERISTIC
/begin CHARACTERISTIC CrCtl_vACCAftTapUDQntKmhJ_C "After tap speed for ACC in kmph for japan" VALUE 0x80533934 Val_Ws32 127.996093750 Vel_CrCtl 0.00 127.996093750 FORMAT "%13.9" EXTENDED_LIMITS -8388608.00000 8388607.99609 /end CHARACTERISTIC
/begin CHARACTERISTIC CrCtl_vACCAftTapUDQntKmhUS_C "After tap speed for ACC in kmph for USA" VALUE 0x80533938 Val_Ws32 127.996093750 Vel_CrCtl 0.00 127.996093750 FORMAT "%13.9" EXTENDED_LIMITS -8388608.00000 8388607.99609 /end CHARACTERISTIC
/begin CHARACTERISTIC CrCtl_vACCAftTapUDQntKmh_C "value of memory speed of finished Tap Up/Down for ACC(km/h)" VALUE 0x8053393C Val_Ws32 127.996093750 Vel_CrCtl 0.00 127.996093750 FORMAT "%13.9" EXTENDED_LIMITS -8388608.00000 8388607.99609 /end CHARACTERISTIC
/begin CHARACTERISTIC CrCtl_vACCAftTapUDQntMPHUS_C "After tap speed for ACC in kmph for EU" VALUE 0x80533940 Val_Ws32 127.996093750 Vel_CrCtl_MPH 0.00 127.996093750 FORMAT "%13.9" EXTENDED_LIMITS -8388608.00000 8388607.99609 /end CHARACTERISTIC
/begin CHARACTERISTIC CrCtl_vACCAftTapUDQntMPH_C "value of memory speed of finished Tap Up/Down for ACC(MPH)" VALUE 0x80533944 Val_Ws32 127.996093750 Vel_CrCtl_MPH 0.00 127.996093750 FORMAT "%13.9" EXTENDED_LIMITS -8388608.00000 8388607.99609 /end CHARACTERISTIC
/begin CHARACTERISTIC CrCtl_vACCContTapUpdSpdKmhAP_C "Updated speed of continuous Tap updown for ACC Asia Pacific" VALUE 0x80533948 Val_Ws16 127.9961 Vel_CrCtl 0.00 127.9961 FORMAT "%8.4" EXTENDED_LIMITS -128.0000 127.9961 /end CHARACTERISTIC
/begin CHARACTERISTIC CrCtl_vACCContTapUpdSpdKmhUS_C "Memory speed update value with Kmph for ACC US when continuous TapUp/Down" VALUE 0x8053394A Val_Ws16 127.9961 Vel_CrCtl 0.00 127.9961 FORMAT "%8.4" EXTENDED_LIMITS -128.0000 127.9961 /end CHARACTERISTIC
/begin CHARACTERISTIC CrCtl_vACCContTapUpdSpdKmh_C "Memory speed update value with Kmph for ACC EU when continuous TapUp/Down" VALUE 0x8053394C Val_Ws16 127.9961 Vel_CrCtl 0.00 127.9961 FORMAT "%8.4" EXTENDED_LIMITS -128.0000 127.9961 /end CHARACTERISTIC
/begin CHARACTERISTIC CrCtl_vACCContTapUpdSpdMPHAP_C "Updated speed in MPH unit of continuous Tap updown for ACC Asia Pacific" VALUE 0x8053394E Val_Ws16 127.9961 Vel_CrCtl_MPH 0.00 127.9961 FORMAT "%8.4" EXTENDED_LIMITS -128.0000 127.9961 /end CHARACTERISTIC
/begin CHARACTERISTIC CrCtl_vACCContTapUpdSpdMPHUS_C "Memory speed update value with MPH for ACC US when continuous TapUp/Down" VALUE 0x80533950 Val_Ws16 127.9961 Vel_CrCtl_MPH 0.00 127.9961 FORMAT "%8.4" EXTENDED_LIMITS -128.0000 127.9961 /end CHARACTERISTIC
/begin CHARACTERISTIC CrCtl_vACCContTapUpdSpdMPH_C "Memory speed update value with MPH for ACC EU when continuous TapUp/Down" VALUE 0x80533952 Val_Ws16 127.9961 Vel_CrCtl_MPH 0.00 127.9961 FORMAT "%8.4" EXTENDED_LIMITS -128.0000 127.9961 /end CHARACTERISTIC
/begin CHARACTERISTIC CrCtl_vACCMemSpdLoLimJ_C "Lower limit of the ACC memeory speed forJapan" VALUE 0x80533954 Val_Ws32 127.996093750 Vel_CrCtl 0.00 127.996093750 FORMAT "%13.9" EXTENDED_LIMITS -8388608.00000 8388607.99609 /end CHARACTERISTIC
/begin CHARACTERISTIC CrCtl_vACCMemSpdLoLimKmhAP_C "Lower limit of ACC memory speed for Asia Pacific" VALUE 0x80533958 Val_Ws32 16777215.9961 Vel_CrCtl -8388608.00000 8388607.99609 FORMAT "%13.5" /end CHARACTERISTIC
/begin CHARACTERISTIC CrCtl_vACCMemSpdLoLimMPHAP_C "Lower limit in MPH unit of ACC memory speed for Asia Pacific" VALUE 0x8053395C Val_Ws32 127.996093750 Vel_CrCtl_MPH 0.00 127.996093750 FORMAT "%13.9" EXTENDED_LIMITS -8388608.00000 8388607.99609 /end CHARACTERISTIC
/begin CHARACTERISTIC CrCtl_vACCMemSpdLoLimMPHUS_C "Lower limit of the ACC memory speed for the US(MPH)" VALUE 0x80533960 Val_Ws32 127.996093750 Vel_CrCtl_MPH 0.00 127.996093750 FORMAT "%13.9" EXTENDED_LIMITS -8388608.00000 8388607.99609 /end CHARACTERISTIC
/begin CHARACTERISTIC CrCtl_vACCMemSpdLoLimMPH_C "Memory speed Low Limit value(MPH) for ACC" VALUE 0x80533964 Val_Ws32 16777215.9961 Vel_CrCtl_MPH -8388608.00000 8388607.99609 FORMAT "%13.5" /end CHARACTERISTIC
/begin CHARACTERISTIC CrCtl_vACCMemSpdLoLimUS_C "Lower limit of ACC memory speed for US(Kmh)" VALUE 0x80533968 Val_Ws32 127.996093750 Vel_CrCtl 0.00 127.996093750 FORMAT "%13.9" EXTENDED_LIMITS -8388608.00000 8388607.99609 /end CHARACTERISTIC
/begin CHARACTERISTIC CrCtl_vACCMemSpdLoLim_C "Memory speed Low Limit value for ACC" VALUE 0x8053396C Val_Ws32 16777215.9961 Vel_CrCtl -8388608.00000 8388607.99609 FORMAT "%13.5" /end CHARACTERISTIC
/begin CHARACTERISTIC CrCtl_vACCMemSpdUpLimJ_C "Lower limit of ACC memory speed for Japan(Kmh)" VALUE 0x80533970 Val_Ws32 127.996093750 Vel_CrCtl 0.00 127.996093750 FORMAT "%13.9" EXTENDED_LIMITS -8388608.00000 8388607.99609 /end CHARACTERISTIC
/begin CHARACTERISTIC CrCtl_vACCMemSpdUpLimKmhAP_C "Upper limit of ACC memory speed for Asia Pacific" VALUE 0x80533974 Val_Ws32 16777215.9961 Vel_CrCtl -8388608.00000 8388607.99609 FORMAT "%13.5" /end CHARACTERISTIC
/begin CHARACTERISTIC CrCtl_vACCMemSpdUpLimMPHAP_C "Upper limit in MPH unit of ACC memory speed for Asia Pacific" VALUE 0x80533978 Val_Ws32 127.996093750 Vel_CrCtl_MPH 0.00 127.996093750 FORMAT "%13.9" EXTENDED_LIMITS -8388608.00000 8388607.99609 /end CHARACTERISTIC
/begin CHARACTERISTIC CrCtl_vACCMemSpdUpLimMPHUS_C "Upper limit of ACC memory speed for US (MPH)" VALUE 0x8053397C Val_Ws32 127.996093750 Vel_CrCtl_MPH 0.00 127.996093750 FORMAT "%13.9" EXTENDED_LIMITS -8388608.00000 8388607.99609 /end CHARACTERISTIC
/begin CHARACTERISTIC CrCtl_vACCMemSpdUpLimMPH_C "Memory speed Upper Limit value(MPH) for ACC" VALUE 0x80533980 Val_Ws32 16777215.9961 Vel_CrCtl_MPH -8388608.00000 8388607.99609 FORMAT "%13.5" /end CHARACTERISTIC
/begin CHARACTERISTIC CrCtl_vACCMemSpdUpLimUS_C "Lower limit of ACC memory speed for US(Kmh)" VALUE 0x80533984 Val_Ws32 8388607.99609 Vel_CrCtl 0.00 8388607.99609 FORMAT "%13.5" EXTENDED_LIMITS -8388608.00000 8388607.99609 /end CHARACTERISTIC
/begin CHARACTERISTIC CrCtl_vACCMemSpdUpLim_C "Memory speed Upper Limit value for ACC" VALUE 0x80533988 Val_Ws32 16777215.9961 Vel_CrCtl -8388608.00000 8388607.99609 FORMAT "%13.5" /end CHARACTERISTIC
/begin AXIS_PTS CrCtl_vAccnCont_AX "Axis Points for Acceleration Continuous of cruise control" 0x80539998 CrCtl_vVehUpByte Axis_Xs16 255.0000 Vel_CrCtl1 12 0.00 255.0000 FORMAT "%8.4" EXTENDED_LIMITS -32768.00 32767.00 DEPOSIT ABSOLUTE /end AXIS_PTS
/begin CHARACTERISTIC CrCtl_vAccnDeclErrChk_C "acceleration/deceleration error check value for CC" VALUE 0x8053398C Val_Ws32 127.996093750 Vel_CrCtl 0.00 127.996093750 FORMAT "%13.9" EXTENDED_LIMITS -8388608.00000 8388607.99609 /end CHARACTERISTIC
/begin CHARACTERISTIC CrCtl_vAccnSlpStp_C "acceleration value of stop the slope caluclation" VALUE 0x80533990 Val_Ws32 127.996093750 Vel_CrCtl 0.00 127.996093750 FORMAT "%13.9" EXTENDED_LIMITS -8388608.00000 8388607.99609 /end CHARACTERISTIC
/begin CHARACTERISTIC CrCtl_vAccnValFltLim_C "Limit value for filtered acceleration value for cruise control" VALUE 0x80533994 Val_Ws16 255.9961 Vel_CrCtl -128.0000 127.9961 FORMAT "%8.4" /end CHARACTERISTIC
/begin CHARACTERISTIC CrCtl_vACCSpdContLoLimJ_C "Lower limit for the continous speed for Japan" VALUE 0x80533998 Val_Ws32 127.996093750 Vel_CrCtl 0.00 127.996093750 FORMAT "%13.9" EXTENDED_LIMITS -8388608.00000 8388607.99609 /end CHARACTERISTIC
/begin CHARACTERISTIC CrCtl_vACCSpdContLoLimKmhAP_C "Lower limit speed value for ACC Asia Pacific" VALUE 0x8053399C Val_Ws32 16777215.9961 Vel_CrCtl -8388608.00000 8388607.99609 FORMAT "%13.5" /end CHARACTERISTIC
/begin CHARACTERISTIC CrCtl_vACCSpdContLoLimMPHAP_C "Lower limit speed value in MPH unit for ACC Asia Pacific" VALUE 0x805339A0 Val_Ws32 127.996093750 Vel_CrCtl_MPH 0.00 127.996093750 FORMAT "%13.9" EXTENDED_LIMITS -8388608.00000 8388607.99609 /end CHARACTERISTIC
/begin CHARACTERISTIC CrCtl_vACCSpdContLoLimMPHUS_C "Lower limit for the continous speed for US(MPH)" VALUE 0x805339A4 Val_Ws32 127.996093750 Vel_CrCtl_MPH 0.00 127.996093750 FORMAT "%13.9" EXTENDED_LIMITS -8388608.00000 8388607.99609 /end CHARACTERISTIC
/begin CHARACTERISTIC CrCtl_vACCSpdContLoLimMPH_C "Low limit speed value(MPH) for ACC" VALUE 0x805339A8 Val_Ws32 127.996093750 Vel_CrCtl_MPH 0.00 127.996093750 FORMAT "%13.9" EXTENDED_LIMITS -8388608.00000 8388607.99609 /end CHARACTERISTIC
/begin CHARACTERISTIC CrCtl_vACCSpdContLoLimUS_C "Lower limit for the continous speed for Japan(Kmh)" VALUE 0x805339AC Val_Ws32 127.996093750 Vel_CrCtl 0.00 127.996093750 FORMAT "%13.9" EXTENDED_LIMITS -8388608.00000 8388607.99609 /end CHARACTERISTIC
/begin CHARACTERISTIC CrCtl_vACCSpdContLoLim_C "Low limit speed value for ACC" VALUE 0x805339B0 Val_Ws32 16777215.9961 Vel_CrCtl -8388608.00000 8388607.99609 FORMAT "%13.5" /end CHARACTERISTIC
/begin CHARACTERISTIC CrCtl_vACCTapUDQntKmhAP_C "Memory speed of Tap updown for ACC Asia Pacific" VALUE 0x805339B4 Val_Ws32 16777215.9961 Vel_CrCtl -8388608.00000 8388607.99609 FORMAT "%13.5" /end CHARACTERISTIC
/begin CHARACTERISTIC CrCtl_vACCTapUDQntKmhJ_C "ACC Tap speed for Japan" VALUE 0x805339B8 Val_Ws32 127.996093750 Vel_CrCtl 0.00 127.996093750 FORMAT "%13.9" EXTENDED_LIMITS -8388608.00000 8388607.99609 /end CHARACTERISTIC
/begin CHARACTERISTIC CrCtl_vACCTapUDQntKmhUS_C "ACC Tap speed for US(Kmh)" VALUE 0x805339BC Val_Ws32 127.996093750 Vel_CrCtl 0.00 127.996093750 FORMAT "%13.9" EXTENDED_LIMITS -8388608.00000 8388607.99609 /end CHARACTERISTIC
/begin CHARACTERISTIC CrCtl_vACCTapUDQntKmh_C "value of Tap Up/Down for memory speed(km/h) for ACC(km/h)" VALUE 0x805339C0 Val_Ws32 127.992187500 Vel_CrCtl 0.003906250 127.996093750 FORMAT "%13.9" EXTENDED_LIMITS -8388608.00000 8388607.99609 /end CHARACTERISTIC
/begin CHARACTERISTIC CrCtl_vACCTapUDQntMPHAP_C "Memory speed in MPH unit of Tap updown for ACC Asia Pacific" VALUE 0x805339C4 Val_Ws32 127.996093750 Vel_CrCtl_MPH 0.00 127.996093750 FORMAT "%13.9" EXTENDED_LIMITS -8388608.00000 8388607.99609 /end CHARACTERISTIC
/begin CHARACTERISTIC CrCtl_vACCTapUDQntMPHUS_C "ACC Tap speed for (Kmh)" VALUE 0x805339C8 Val_Ws32 127.996093750 Vel_CrCtl_MPH 0.00 127.996093750 FORMAT "%13.9" EXTENDED_LIMITS -8388608.00000 8388607.99609 /end CHARACTERISTIC
/begin CHARACTERISTIC CrCtl_vACCTapUDQntMPH_C "value of Tap Up/Down for memory speed(km/h) for ACC(MPH)" VALUE 0x805339CC Val_Ws32 127.992187500 Vel_CrCtl_MPH 0.003906250 127.996093750 FORMAT "%13.9" EXTENDED_LIMITS -8388608.00000 8388607.99609 /end CHARACTERISTIC
/begin CHARACTERISTIC CrCtl_vACCUpSpdHysHiJ_C "Higher limit of the ACC Upper speed hysterysis for Japan" VALUE 0x805339D0 Val_Ws32 8388607.99609 Vel_CrCtl 0.00 8388607.99609 FORMAT "%13.5" EXTENDED_LIMITS -8388608.00000 8388607.99609 /end CHARACTERISTIC
/begin CHARACTERISTIC CrCtl_vACCUpSpdHysHiKmhAP_C "Upper limit hysteresis of ACC Upper speed value for Asia Pacific" VALUE 0x805339D4 Val_Ws32 16777215.9961 Vel_CrCtl -8388608.00000 8388607.99609 FORMAT "%13.5" /end CHARACTERISTIC
/begin CHARACTERISTIC CrCtl_vACCUpSpdHysHiMPHAP_C "Upper limit hysteresis in MPH unit of ACC Upper speed value for Asia Pacific" VALUE 0x805339D8 Val_Ws32 127.996093750 Vel_CrCtl_MPH 0.00 127.996093750 FORMAT "%13.9" EXTENDED_LIMITS -8388608.00000 8388607.99609 /end CHARACTERISTIC
/begin CHARACTERISTIC CrCtl_vACCUpSpdHysHiMPHUS_C "Higher limit of the ACC Upper speed hysterysis for US(MPH)" VALUE 0x805339DC Val_Ws32 127.996093750 Vel_CrCtl_MPH 0.00 127.996093750 FORMAT "%13.9" EXTENDED_LIMITS -8388608.00000 8388607.99609 /end CHARACTERISTIC
/begin CHARACTERISTIC CrCtl_vACCUpSpdHysHiMPH_C "High limit hysteresis of ACC Upper speed value(MPH)" VALUE 0x805339E0 Val_Ws32 16777215.9961 Vel_CrCtl_MPH -8388608.00000 8388607.99609 FORMAT "%13.5" /end CHARACTERISTIC
/begin CHARACTERISTIC CrCtl_vACCUpSpdHysHiUS_C "Higher limit of the ACC Upper speed hysterysis for US(Kmh)" VALUE 0x805339E4 Val_Ws32 8388607.99609 Vel_CrCtl 0.00 8388607.99609 FORMAT "%13.5" EXTENDED_LIMITS -8388608.00000 8388607.99609 /end CHARACTERISTIC
/begin CHARACTERISTIC CrCtl_vACCUpSpdHysHi_C "High limit hysteresis of ACC Upper speed value" VALUE 0x805339E8 Val_Ws32 16777215.9961 Vel_CrCtl -8388608.00000 8388607.99609 FORMAT "%13.5" /end CHARACTERISTIC
/begin CHARACTERISTIC CrCtl_vACCUpSpdHysLoJ_C "Lower limit of the ACC Upper speed hysterysis for Japan" VALUE 0x805339EC Val_Ws32 8388607.99609 Vel_CrCtl 0.00 8388607.99609 FORMAT "%13.5" EXTENDED_LIMITS -8388608.00000 8388607.99609 /end CHARACTERISTIC
/begin CHARACTERISTIC CrCtl_vACCUpSpdHysLoKmhAP_C "Lower limit hysteresis of ACC Upper speed value for Asia Pacific" VALUE 0x805339F0 Val_Ws32 16777215.9961 Vel_CrCtl -8388608.00000 8388607.99609 FORMAT "%13.5" /end CHARACTERISTIC
/begin CHARACTERISTIC CrCtl_vACCUpSpdHysLoMPHAP_C "Lower limit hysteresis in MPH unit of ACC Upper speed value for Asia Pacific" VALUE 0x805339F4 Val_Ws32 127.996093750 Vel_CrCtl_MPH 0.00 127.996093750 FORMAT "%13.9" EXTENDED_LIMITS -8388608.00000 8388607.99609 /end CHARACTERISTIC
/begin CHARACTERISTIC CrCtl_vACCUpSpdHysLoMPHUS_C "Higher limit of the ACC Upper speed hysterysis for US(MPH)" VALUE 0x805339F8 Val_Ws32 127.996093750 Vel_CrCtl_MPH 0.00 127.996093750 FORMAT "%13.9" EXTENDED_LIMITS -8388608.00000 8388607.99609 /end CHARACTERISTIC
/begin CHARACTERISTIC CrCtl_vACCUpSpdHysLoMPH_C "Low limit hysteresis of ACC Upper speed value(MPH)" VALUE 0x805339FC Val_Ws32 16777215.9961 Vel_CrCtl_MPH -8388608.00000 8388607.99609 FORMAT "%13.5" /end CHARACTERISTIC
/begin CHARACTERISTIC CrCtl_vACCUpSpdHysLoUS_C "Higher limit of the ACC Upper speed hysterysis for US(Kmh)" VALUE 0x80533A00 Val_Ws32 8388607.99609 Vel_CrCtl 0.00 8388607.99609 FORMAT "%13.5" EXTENDED_LIMITS -8388608.00000 8388607.99609 /end CHARACTERISTIC
/begin CHARACTERISTIC CrCtl_vACCUpSpdHysLo_C "Low limit hysteresis of ACC Upper speed value" VALUE 0x80533A04 Val_Ws32 16777215.9961 Vel_CrCtl -8388608.00000 8388607.99609 FORMAT "%13.5" /end CHARACTERISTIC
/begin CHARACTERISTIC CrCtl_vAftTapMemSpdKmh_C "After tap memory speed in Knh for EU" VALUE 0x80533A08 Val_Ws32 127.996093750 Vel_CrCtl 0.00 127.996093750 FORMAT "%13.9" EXTENDED_LIMITS -8388608.00000 8388607.99609 /end CHARACTERISTIC
/begin CHARACTERISTIC CrCtl_vContTapUpdSpdKmhAP_C "Updated speed of continuous Tap updown for CC Asia Pacific" VALUE 0x80533A0C Val_Ws16 127.9961 Vel_CrCtl 0.00 127.9961 FORMAT "%8.4" EXTENDED_LIMITS -128.0000 127.9961 /end CHARACTERISTIC
/begin CHARACTERISTIC CrCtl_vContTapUpdSpdKmhJ_C "Memory speed update value with Kmph for CC Japan when continuous TapUpDown" VALUE 0x80533A0E Val_Ws16 127.0000 Vel_CrCtl 0.00 127.0000 FORMAT "%8.4" EXTENDED_LIMITS -128.0000 127.9961 /end CHARACTERISTIC
/begin CHARACTERISTIC CrCtl_vContTapUpdSpdKmhUS_C "Memory speed update value with Kmph for CC US when continuous TapUp/Down" VALUE 0x80533A10 Val_Ws16 127.9961 Vel_CrCtl 0.00 127.9961 FORMAT "%8.4" EXTENDED_LIMITS -128.0000 127.9961 /end CHARACTERISTIC
/begin CHARACTERISTIC CrCtl_vContTapUpdSpdKmh_C "Memory speed update value with Kmph for CC EU when continuous TapUp/Down" VALUE 0x80533A12 Val_Ws16 127.9961 Vel_CrCtl 0.00 127.9961 FORMAT "%8.4" EXTENDED_LIMITS -128.0000 127.9961 /end CHARACTERISTIC
/begin CHARACTERISTIC CrCtl_vContTapUpdSpdMPHAP_C "Memory speed update value with MPH for CC AP when continuous Tap Up or Down" VALUE 0x80533A14 Val_Ws16 127.9961 Vel_CrCtl_MPH 0.00 127.9961 FORMAT "%8.4" EXTENDED_LIMITS -128.0000 127.9961 /end CHARACTERISTIC
/begin CHARACTERISTIC CrCtl_vContTapUpdSpdMPHUS_C "Memory speed update value with MPH for CC US when continuous TapUp/Down" VALUE 0x80533A16 Val_Ws16 127.9961 Vel_CrCtl_MPH 0.00 127.9961 FORMAT "%8.4" EXTENDED_LIMITS -128.0000 127.9961 /end CHARACTERISTIC
/begin CHARACTERISTIC CrCtl_vContTapUpdSpdMPH_C "Memory speed update value with MPH for CC EU when continuous TapUp/Down" VALUE 0x80533A18 Val_Ws16 127.9961 Vel_CrCtl_MPH 0.00 127.9961 FORMAT "%8.4" EXTENDED_LIMITS -128.0000 127.9961 /end CHARACTERISTIC
/begin CHARACTERISTIC CrCtl_vEstSlpCalcLSF_C "Calibration parameter for threshold velocity for calculation of estimated slope for LSF" VALUE 0x80533A1C Val_Ws32 16777215.9961 Vel_CrCtl -8388608.00000 8388607.99609 FORMAT "%13.5" /end CHARACTERISTIC
/begin AXIS_PTS CrCtl_vEstSlp_AXIS "Axis Points for Estimation Slope speed of cruise control" 0x80533A20 CrCtl_vVehUpByte Axis_Xs16 255.0000 Vel_CrCtl1 12 0.00 255.0000 FORMAT "%8.4" EXTENDED_LIMITS -32768.00 32767.00 DEPOSIT ABSOLUTE /end AXIS_PTS
/begin CHARACTERISTIC CrCtl_vFltVarChk_C "Meter Speed variant check value" VALUE 0x80533A3C Val_Ws32 16777215.9961 Vel_CrCtl -8388608.00000 8388607.99609 FORMAT "%13.5" /end CHARACTERISTIC
/begin CHARACTERISTIC CrCtl_vIDASFailAExs_CUR "Curve for Fail excessive acceleration under IDAS control" CURVE 0x80533A40 Cur_Xs16Ws16 20.00000 Vel_CrCtl -10.00000 10.00000 FORMAT "%8.5" EXTENDED_LIMITS -128.0000 127.9961
 /begin AXIS_DESCR STD_AXIS CrCtl_vIDASVehUpByte Vel_CrCtl1 12 -32768.00 32767.00 FORMAT "%8.2" DEPOSIT ABSOLUTE /end AXIS_DESCR
/end CHARACTERISTIC
/begin CHARACTERISTIC CrCtl_vIDASVehUpprLim_C "Parameter to set the upper limit of the speed which CC and ASL under IDAS control" VALUE 0x80533A74 Val_Ws32 325.000000000 Vel_CrCtl 0.00 325.000000000 FORMAT "%13.9" EXTENDED_LIMITS -8388608.00000 8388607.99609 /end CHARACTERISTIC
/begin CHARACTERISTIC CrCtl_vLowrLimSpdMtrRvsn_C "parameter to set the lower limit of the speed for Meter revision calculation." VALUE 0x80533A78 Val_Ws32 325.000000000 Vel_CrCtl 0.00 325.000000000 FORMAT "%13.9" EXTENDED_LIMITS -8388608.00000 8388607.99609 /end CHARACTERISTIC
/begin CHARACTERISTIC CrCtl_vLowrLimTapUpDwnThd_C "lower limit vehicle speed to accept tap-up or tap-down" VALUE 0x80533A7C Val_Ws32 255.996093750 Vel_CrCtl 0.00 255.996093750 FORMAT "%13.9" EXTENDED_LIMITS -8388608.00000 8388607.99609 /end CHARACTERISTIC
/begin CHARACTERISTIC CrCtl_vMemSpdCorKmh_C "Correct value of memory speed for cruise control (km/h)" VALUE 0x80533A80 Val_Ws32 127.996093750 Vel_CrCtl 0.00 127.996093750 FORMAT "%13.9" EXTENDED_LIMITS -8388608.00000 8388607.99609 /end CHARACTERISTIC
/begin CHARACTERISTIC CrCtl_vMemSpdCorMPH_C "Correct value of memory speed for cruise control (MPH)" VALUE 0x80533A84 Val_Ws32 127.996093750 Vel_CrCtl_MPH 0.00 127.996093750 FORMAT "%13.9" EXTENDED_LIMITS -8388608.00000 8388607.99609 /end CHARACTERISTIC
/begin CHARACTERISTIC CrCtl_vMemSpdLoLimJ_C "Lower limit of CC memory speed for Japan" VALUE 0x80533A88 Val_Ws32 127.996093750 Vel_CrCtl 0.00 127.996093750 FORMAT "%13.9" EXTENDED_LIMITS -8388608.00000 8388607.99609 /end CHARACTERISTIC
/begin CHARACTERISTIC CrCtl_vMemSpdLoLimKmhAP_C "Lower limit of CC memory speed for Asia Pacific" VALUE 0x80533A8C Val_Ws32 16777215.9961 Vel_CrCtl -8388608.00000 8388607.99609 FORMAT "%13.5" /end CHARACTERISTIC
/begin CHARACTERISTIC CrCtl_vMemSpdLoLimKmhUS_C "Lower limit of memory speed for US Kmph" VALUE 0x80533A90 Val_Ws32 255.996093750 Vel_CrCtl 0.00 255.996093750 FORMAT "%13.9" EXTENDED_LIMITS -8388608.00000 8388607.99609 /end CHARACTERISTIC
/begin CHARACTERISTIC CrCtl_vMemSpdLoLimKmh_C "Lower limit of memory speed for EU Kmph" VALUE 0x80533A94 Val_Ws32 255.996093750 Vel_CrCtl 0.00 255.996093750 FORMAT "%13.9" EXTENDED_LIMITS -8388608.00000 8388607.99609 /end CHARACTERISTIC
/begin CHARACTERISTIC CrCtl_vMemSpdLoLimMPHAP_C "Lower limit in MPH unit of CC memory speed for Asia Pacific" VALUE 0x80533A98 Val_Ws32 16777215.9961 Vel_CrCtl_MPH -8388608.00000 8388607.99609 FORMAT "%13.5" /end CHARACTERISTIC
/begin CHARACTERISTIC CrCtl_vMemSpdLoLimMPHUS_C "Lower limit of memory speed for US MPH" VALUE 0x80533A9C Val_Ws32 255.996093750 Vel_CrCtl_MPH 0.00 255.996093750 FORMAT "%13.9" EXTENDED_LIMITS -8388608.00000 8388607.99609 /end CHARACTERISTIC
/begin CHARACTERISTIC CrCtl_vMemSpdLoLimMPH_C "Lower limit of memory speed for EU MPH" VALUE 0x80533AA0 Val_Ws32 255.996093750 Vel_CrCtl_MPH 0.00 255.996093750 FORMAT "%13.9" EXTENDED_LIMITS -8388608.00000 8388607.99609 /end CHARACTERISTIC
/begin CHARACTERISTIC CrCtl_vMemSpdUpLimJ_C "Upper limit of CC memory speed for Japan" VALUE 0x80533AA4 Val_Ws32 127.996093750 Vel_CrCtl 0.00 127.996093750 FORMAT "%13.9" EXTENDED_LIMITS -8388608.00000 8388607.99609 /end CHARACTERISTIC
/begin CHARACTERISTIC CrCtl_vMemSpdUpLimKmhAP_C "Upper limit of CC memory speed for Asia Pacific" VALUE 0x80533AA8 Val_Ws32 16777215.9961 Vel_CrCtl -8388608.00000 8388607.99609 FORMAT "%13.5" /end CHARACTERISTIC
/begin CHARACTERISTIC CrCtl_vMemSpdUpLimKmhUS_C "Upper limit of memory speed for US Kmph" VALUE 0x80533AAC Val_Ws32 255.996093750 Vel_CrCtl 0.00 255.996093750 FORMAT "%13.9" EXTENDED_LIMITS -8388608.00000 8388607.99609 /end CHARACTERISTIC
/begin CHARACTERISTIC CrCtl_vMemSpdUpLimKmh_C "Upper limit of memory speed for EU Kmph" VALUE 0x80533AB0 Val_Ws32 325.000000000 Vel_CrCtl 0.00 325.000000000 FORMAT "%13.9" EXTENDED_LIMITS -8388608.00000 8388607.99609 /end CHARACTERISTIC
/begin CHARACTERISTIC CrCtl_vMemSpdUpLimMPHAP_C "Upper limit in MPH of CC memory speed for Asia Pacific" VALUE 0x80533AB4 Val_Ws32 16777215.9961 Vel_CrCtl_MPH -8388608.00000 8388607.99609 FORMAT "%13.5" /end CHARACTERISTIC
/begin CHARACTERISTIC CrCtl_vMemSpdUpLimMPHUS_C "Upper limit of memory speed for US MPH" VALUE 0x80533AB8 Val_Ws32 255.996093750 Vel_CrCtl_MPH 0.00 255.996093750 FORMAT "%13.9" EXTENDED_LIMITS -8388608.00000 8388607.99609 /end CHARACTERISTIC
/begin CHARACTERISTIC CrCtl_vMemSpdUpLimMPH_C "Upper limit of memory speed for EU MPH" VALUE 0x80533ABC Val_Ws32 255.996093750 Vel_CrCtl_MPH 0.00 255.996093750 FORMAT "%13.9" EXTENDED_LIMITS -8388608.00000 8388607.99609 /end CHARACTERISTIC
/begin CHARACTERISTIC CrCtl_vMemSpdVar_C "Memory speed of variation data" VALUE 0x80533AC0 Val_Ws32 127.996093750 Vel_CrCtl 0.00 127.996093750 FORMAT "%13.9" EXTENDED_LIMITS -8388608.00000 8388607.99609 /end CHARACTERISTIC
/begin CHARACTERISTIC CrCtl_vMETReviChkVar_C "Meter revision check variant value" VALUE 0x80533AC4 Val_Ws32 16777215.9961 Vel_CrCtl -8388608.00000 8388607.99609 FORMAT "%13.5" /end CHARACTERISTIC
/begin AXIS_PTS CrCtl_vMETRevi_AXIS "Axis Points for METER speed revision value of cruise control" 0x80533AC8 CrCtl_vFltdUpByte_mp Axis_Xs16 255.0000 Vel_CrCtl1 12 0.00 255.0000 FORMAT "%8.4" EXTENDED_LIMITS -32768.00 32767.00 DEPOSIT ABSOLUTE /end AXIS_PTS
/begin CHARACTERISTIC CrCtl_vMETVarChk_C "Meter Speed variant check value" VALUE 0x80533AE4 Val_Ws32 16777215.9961 Vel_CrCtl -8388608.00000 8388607.99609 FORMAT "%13.5" /end CHARACTERISTIC
/begin CHARACTERISTIC CrCtl_vSpdContLoLimJ_C "Lower limit for the continous speed for EU" VALUE 0x80533AE8 Val_Ws32 127.996093750 Vel_CrCtl 0.00 127.996093750 FORMAT "%13.9" EXTENDED_LIMITS -8388608.00000 8388607.99609 /end CHARACTERISTIC
/begin CHARACTERISTIC CrCtl_vSpdContLoLimKmhAP_C "Lower limit speed value for CC Asia Pacific" VALUE 0x80533AEC Val_Ws32 16777215.9961 Vel_CrCtl -8388608.00000 8388607.99609 FORMAT "%13.5" /end CHARACTERISTIC
/begin CHARACTERISTIC CrCtl_vSpdContLoLimMPHAP_C "Lower limit speed value in MPH unit for CC Asia Pacific" VALUE 0x80533AF0 Val_Ws32 16777215.9961 Vel_CrCtl_MPH -8388608.00000 8388607.99609 FORMAT "%13.5" /end CHARACTERISTIC
/begin CHARACTERISTIC CrCtl_vSpdLoLimKmhUS_C "Lower limit of control speed with Kmph for US" VALUE 0x80533AF4 Val_Ws32 255.996093750 Vel_CrCtl 0.00 255.996093750 FORMAT "%13.9" EXTENDED_LIMITS -8388608.00000 8388607.99609 /end CHARACTERISTIC
/begin CHARACTERISTIC CrCtl_vSpdLoLimKmh_C "Lower limit of control speed for EU Kmph" VALUE 0x80533AF8 Val_Ws32 255.996093750 Vel_CrCtl 0.00 255.996093750 FORMAT "%13.9" EXTENDED_LIMITS -8388608.00000 8388607.99609 /end CHARACTERISTIC
/begin CHARACTERISTIC CrCtl_vSpdLoLimMPHUS_C "Lower limit of control speed with MPH for US" VALUE 0x80533AFC Val_Ws32 255.996093750 Vel_CrCtl_MPH 0.00 255.996093750 FORMAT "%13.9" EXTENDED_LIMITS -8388608.00000 8388607.99609 /end CHARACTERISTIC
/begin CHARACTERISTIC CrCtl_vSpdLoLimMPH_C "Lower limit of control speed for EU MPH" VALUE 0x80533B00 Val_Ws32 255.996093750 Vel_CrCtl_MPH 0.00 255.996093750 FORMAT "%13.9" EXTENDED_LIMITS -8388608.00000 8388607.99609 /end CHARACTERISTIC
/begin CHARACTERISTIC CrCtl_vTapMemSpdUpdJ_C "Memory speed update value of CC TapUp/Down for Japan" VALUE 0x80533B04 Val_Ws16 127.9922 Vel_CrCtl 0.0039 127.9961 FORMAT "%8.4" EXTENDED_LIMITS -128.0000 127.9961 /end CHARACTERISTIC
/begin CHARACTERISTIC CrCtl_vTapMemSpdUpdKmhDsp_C "Memory speed update value of CC TapUpDown for CC Kmph display" VALUE 0x80533B06 Val_Ws16 127.9922 Vel_CrCtl 0.0039 127.9961 FORMAT "%8.4" EXTENDED_LIMITS -128.0000 127.9961 /end CHARACTERISTIC
/begin CHARACTERISTIC CrCtl_vTapMemSpdUpdKmhUS_C "Memory speed update value of CC TapUp/Down for US Kmph" VALUE 0x80533B08 Val_Ws16 127.9922 Vel_CrCtl 0.0039 127.9961 FORMAT "%8.4" EXTENDED_LIMITS -128.0000 127.9961 /end CHARACTERISTIC
/begin CHARACTERISTIC CrCtl_vTapMemSpdUpdKmh_C "Memory speed update value of CC TapUp/Down for EU Kmph" VALUE 0x80533B0A Val_Ws16 127.9922 Vel_CrCtl 0.0039 127.9961 FORMAT "%8.4" EXTENDED_LIMITS -128.0000 127.9961 /end CHARACTERISTIC
/begin CHARACTERISTIC CrCtl_vTapMemSpdUpdMPHUS_C "Memory speed update value of CC TapUp/Down for US MPH" VALUE 0x80533B0C Val_Ws16 127.9922 Vel_CrCtl_MPH 0.0039 127.9961 FORMAT "%8.4" EXTENDED_LIMITS -128.0000 127.9961 /end CHARACTERISTIC
/begin CHARACTERISTIC CrCtl_vTapMemSpdUpdMPH_C "Memory speed update value of CC TapUp/Down for EU MPH" VALUE 0x80533B0E Val_Ws16 127.9922 Vel_CrCtl_MPH 0.0039 127.9961 FORMAT "%8.4" EXTENDED_LIMITS -128.0000 127.9961 /end CHARACTERISTIC
/begin CHARACTERISTIC CrCtl_vTapUDQntKmhAP_C "Memory speed of Tap updown for CC Asia Pacific" VALUE 0x80533B10 Val_Ws16 127.0000 Vel_CrCtl 0.00 127.0000 FORMAT "%8.4" EXTENDED_LIMITS -128.0000 127.9961 /end CHARACTERISTIC
/begin CHARACTERISTIC CrCtl_vTapUDQntMPHAP_C "Memory speed in MPH unit of Tap updown for CC Asia Pacific" VALUE 0x80533B14 Val_Ws32 16777215.9961 Vel_CrCtl_MPH -8388608.00000 8388607.99609 FORMAT "%13.5" /end CHARACTERISTIC
/begin CHARACTERISTIC CrCtl_vTapUpdSpdKmhDisp_C "Memory speed update value of CC Tap UpDown for US Kmph when display CC speed" VALUE 0x80533B18 Val_Ws16 127.0000 Vel_CrCtl 0.00 127.0000 FORMAT "%8.4" EXTENDED_LIMITS -128.0000 127.9961 /end CHARACTERISTIC
/begin CHARACTERISTIC CrCtl_vVehSpdUpprLim_C "Parameter to set the upper limit of the speed which CC and ASL." VALUE 0x80533B1C Val_Ws32 325.000000000 Vel_CrCtl 0.00 325.000000000 FORMAT "%13.9" EXTENDED_LIMITS -8388608.00000 8388607.99609 /end CHARACTERISTIC
/begin MEASUREMENT CrCtl_bCtOffPhd "status: fuel cut off prohibited by cruise control" UBYTE OneToOne 1 100 0.00 255.0 BIT_MASK 0x1 FORMAT "%5.1" ECU_ADDRESS 0x6000F150 /end MEASUREMENT
/begin MEASUREMENT CrCtl_ctATVehSpdErr_mp "Debounce counter for detection of vehicle speed error" SWORD OneToOne 1 100 -32768.00 32767.00 FORMAT "%8.2" ECU_ADDRESS 0x7000A766 /end MEASUREMENT
/begin MEASUREMENT CrCtl_ctContTapDnInitReq_mp "Counter value for continuation Tap Down initial request" UBYTE OneToOne 1 100 0.00 255.0 FORMAT "%5.1" ECU_ADDRESS 0x7000A60D /end MEASUREMENT
/begin MEASUREMENT CrCtl_ctContTapUpCnt_mp "Counter value for continuation Tap Up" UBYTE OneToOne 1 100 0.00 255.0 FORMAT "%5.1" ECU_ADDRESS 0x7000A764 /end MEASUREMENT
/begin MEASUREMENT CrCtl_ctContTapUpInitReq_mp "Counter value for continuation Tap Up initial request" UBYTE OneToOne 1 100 0.00 255.0 FORMAT "%5.1" ECU_ADDRESS 0x7000A60C /end MEASUREMENT
/begin MEASUREMENT CrCtl_ctTapDnInitReq_mp "Counter value for Tap Down initial request" UBYTE OneToOne 1 100 0.00 255.0 FORMAT "%5.1" ECU_ADDRESS 0x7000A60B /end MEASUREMENT
/begin MEASUREMENT CrCtl_ctTapUpInitReq_mp "Counter value for Tap Up initial request" UBYTE OneToOne 1 100 0.00 255.0 FORMAT "%5.1" ECU_ADDRESS 0x7000A60A /end MEASUREMENT
/begin MEASUREMENT CrCtl_EstSlpA_mp "Estimation Slope value A" SLONG OneToOne 1 100 -2147483648.00 2147483647.00 FORMAT "%13.2" ECU_ADDRESS 0x7000A760 /end MEASUREMENT
/begin MEASUREMENT CrCtl_EstSlpB_mp "Estimation Slope value B" SLONG OneToOne 1 100 -2147483648.00 2147483647.00 FORMAT "%13.2" ECU_ADDRESS 0x7000A75C /end MEASUREMENT
/begin MEASUREMENT CrCtl_EstSlpC_mp "Estimation Slope value C" SLONG OneToOne 1 100 -2147483648.00 2147483647.00 FORMAT "%13.2" ECU_ADDRESS 0x7000A758 /end MEASUREMENT
/begin MEASUREMENT CrCtl_facACCAccnGn_mp "factor of ACC acceleration gain value" SWORD Fact2 1 100 -2048.000 2047.938 FORMAT "%8.3" ECU_ADDRESS 0x7000A608 /end MEASUREMENT
/begin MEASUREMENT CrCtl_facACCFdbkGn_mp "factor of ACC acceleration Feed Back gain value" SWORD Fact2 1 100 -2048.000 2047.938 FORMAT "%8.3" ECU_ADDRESS 0x7000A606 /end MEASUREMENT
/begin MEASUREMENT CrCtl_facAccnD_mp "acceleration D factor value" SWORD Fact_CrCtl2 1 100 -512.0000 511.9844 FORMAT "%8.4" ECU_ADDRESS 0x7000A604 /end MEASUREMENT
/begin MEASUREMENT CrCtl_facAccnP_mp "acceleration P factor value" SWORD Fact_CrCtl2 1 100 -512.0000 511.9844 FORMAT "%8.4" ECU_ADDRESS 0x7000A602 /end MEASUREMENT
/begin MEASUREMENT CrCtl_facAccnShutOff_mp "factor of acceleration shut off value" SBYTE Fact_CrCtl2 1 100 -2.000 1.984 FORMAT "%5.3" ECU_ADDRESS 0x7000A600 /end MEASUREMENT
/begin MEASUREMENT CrCtl_facAPPRedRevi_mp "factor of APP reduce revisions value for Clutch out" SWORD Fact_CrCtl2 1 100 -512.0000 511.9844 FORMAT "%8.4" ECU_ADDRESS 0x7000A5FE /end MEASUREMENT
/begin MEASUREMENT CrCtl_facAPPReviVal_mp "factor of revision APP value" SWORD Fact1 1 100 -256.0000 255.9922 FORMAT "%8.4" ECU_ADDRESS 0x7000A5FC /end MEASUREMENT
/begin MEASUREMENT CrCtl_facDiffCoeffDR1ACCEL_mp "Accel defferential coeffecient for DR1 judgement at CC_ACCEL" SWORD Fact_CrCtl 1 100 -128.0000 127.9961 FORMAT "%8.4" ECU_ADDRESS 0x7000A5FA /end MEASUREMENT
/begin MEASUREMENT CrCtl_facDiffCoeffDR1FB_mp "Accel defferential coeffecient for DR1 judgement at CC_F/B" SWORD Fact_CrCtl 1 100 -128.0000 127.9961 FORMAT "%8.4" ECU_ADDRESS 0x7000A5F8 /end MEASUREMENT
/begin MEASUREMENT CrCtl_facDiffCoeffDR1Resume_mp "Accel defferential coeffecient for DR1 judgement at CC_RESUME" SWORD Fact_CrCtl 1 100 -128.0000 127.9961 FORMAT "%8.4" ECU_ADDRESS 0x7000A5F6 /end MEASUREMENT
/begin MEASUREMENT CrCtl_facDiffCoeffDR2ACCEL_mp "Accel defferential coeffecient for DR2 judgement at CC_ACCEL" SWORD Fact_CrCtl 1 100 -128.0000 127.9961 FORMAT "%8.4" ECU_ADDRESS 0x7000A5F4 /end MEASUREMENT
/begin MEASUREMENT CrCtl_facDiffCoeffDR2FB_mp "Accel defferential coeffecient for DR2 judgement at CC_F/B" SWORD Fact_CrCtl 1 100 -128.0000 127.9961 FORMAT "%8.4" ECU_ADDRESS 0x7000A5F2 /end MEASUREMENT
/begin MEASUREMENT CrCtl_facDiffCoeffDR2Resume_mp "Accel defferential coeffecient for DR2 judgement at CC_RESUME" SWORD Fact_CrCtl 1 100 -128.0000 127.9961 FORMAT "%8.4" ECU_ADDRESS 0x7000A5F0 /end MEASUREMENT
/begin MEASUREMENT CrCtl_facDiffCoeffDR3ACCEL_mp "Accel defferential coeffecient for DR3 judgement at CC_ACCEL" SWORD Fact_CrCtl 1 100 -128.0000 127.9961 FORMAT "%8.4" ECU_ADDRESS 0x7000A5EE /end MEASUREMENT
/begin MEASUREMENT CrCtl_facDiffCoeffDR3FB_mp "Accel defferential coeffecient for DR3 judgement at CC_F/B" SWORD Fact_CrCtl 1 100 -128.0000 127.9961 FORMAT "%8.4" ECU_ADDRESS 0x7000A5EC /end MEASUREMENT
/begin MEASUREMENT CrCtl_facDiffCoeffDR3Resume_mp "Accel defferential coeffecient for DR3 judgement at CC_RESUME" SWORD Fact_CrCtl 1 100 -128.0000 127.9961 FORMAT "%8.4" ECU_ADDRESS 0x7000A5EA /end MEASUREMENT
/begin MEASUREMENT CrCtl_facDiffCoeffDR4ACCEL_mp "Accel differential coeffecient for DR4 judgement at CC_ACCEL" SWORD Fact_CrCtl 1 100 -128.0000 127.9961 FORMAT "%8.4" ECU_ADDRESS 0x7000A5E8 /end MEASUREMENT
/begin MEASUREMENT CrCtl_facDiffCoeffDR4FB_mp "Accel differential coeffecient for DR4 judgement at CC_FB" SWORD Fact_CrCtl 1 100 -128.0000 127.9961 FORMAT "%8.4" ECU_ADDRESS 0x7000A5E6 /end MEASUREMENT
/begin MEASUREMENT CrCtl_facDiffCoeffDR4Resume_mp "Accel differential coeffecient for DR4 judgement at CC_RESUME" SWORD Fact_CrCtl 1 100 -128.0000 127.9961 FORMAT "%8.4" ECU_ADDRESS 0x7000A5E4 /end MEASUREMENT
/begin MEASUREMENT CrCtl_facDiffCoeffDR5ACCEL_mp "Accel differential coeffecient for DR5 judgement at CC_ACCEL" SWORD Fact_CrCtl 1 100 -128.0000 127.9961 FORMAT "%8.4" ECU_ADDRESS 0x7000A5E2 /end MEASUREMENT
/begin MEASUREMENT CrCtl_facDiffCoeffDR5FB_mp "Accel defferential coeffecient for DR5 judgement at CC_FB" SWORD Fact_CrCtl 1 100 -128.0000 127.9961 FORMAT "%8.4" ECU_ADDRESS 0x7000A5E0 /end MEASUREMENT
/begin MEASUREMENT CrCtl_facDiffCoeffDR5Resume_mp "Accel defferential coeffecient for DR5 judgement at CC_RESUME" SWORD Fact_CrCtl 1 100 -128.0000 127.9961 FORMAT "%8.4" ECU_ADDRESS 0x7000A5DE /end MEASUREMENT
/begin MEASUREMENT CrCtl_facDiffCoeffDR6ACCEL_mp "Accel differential coeffecient for DR6 judgement at CC_ACCEL" SWORD Fact_CrCtl 1 100 -128.0000 127.9961 FORMAT "%8.4" ECU_ADDRESS 0x7000A5DC /end MEASUREMENT
/begin MEASUREMENT CrCtl_facDiffCoeffDR6FB_mp "Accel defferential coeffecient for DR6 judgement at CC_FB" SWORD Fact_CrCtl 1 100 -128.0000 127.9961 FORMAT "%8.4" ECU_ADDRESS 0x7000A5DA /end MEASUREMENT
/begin MEASUREMENT CrCtl_facDiffCoeffDR6Resume_mp "Accel defferential coeffecient for DR6 judgement at CC_RESUME" SWORD Fact_CrCtl 1 100 -128.0000 127.9961 FORMAT "%8.4" ECU_ADDRESS 0x7000A5D8 /end MEASUREMENT
/begin MEASUREMENT CrCtl_facDiffCoeffDR7ACCEL_mp "Accel differential coeffecient for DR7 judgement at CC_ACCEL" SWORD Fact_CrCtl 1 100 -128.0000 127.9961 FORMAT "%8.4" ECU_ADDRESS 0x7000A5D6 /end MEASUREMENT
/begin MEASUREMENT CrCtl_facDiffCoeffDR7FB_mp "Accel differential coeffecient for DR7 judgement at CC_FB" SWORD Fact_CrCtl 1 100 -128.0000 127.9961 FORMAT "%8.4" ECU_ADDRESS 0x7000A5D4 /end MEASUREMENT
/begin MEASUREMENT CrCtl_facDiffCoeffDR7Resume_mp "Accel differential coeffecient for DR7 judgement at CC_RESUME" SWORD Fact_CrCtl 1 100 -128.0000 127.9961 FORMAT "%8.4" ECU_ADDRESS 0x7000A5D2 /end MEASUREMENT
/begin MEASUREMENT CrCtl_facECAAppUp2_mp "Acceleration factor for changing APP limitation number for ECON to 2 from 1 (for Acceleration)" UBYTE Fact_CrCtl 1 100 0.00 0.9961 ECU_ADDRESS 0x7000A5D0 /end MEASUREMENT
/begin MEASUREMENT CrCtl_facECAAppUp3_mp "Acceleration factor for changing APP limitation number for ECON to 3 from 2 (for Acceleration)" UBYTE Fact_CrCtl 1 100 0.00 0.9961 ECU_ADDRESS 0x7000A5CF /end MEASUREMENT
/begin MEASUREMENT CrCtl_facECAAppUp4_mp "Acceleration factor for changing APP limitation number for ECON to 4 from 3 (for Acceleration)" UBYTE Fact_CrCtl 1 100 0.00 0.9961 ECU_ADDRESS 0x7000A5CE /end MEASUREMENT
/begin MEASUREMENT CrCtl_facECAAppUp5_mp "Acceleration factor for changing APP limitation number for ECON to 5 from 4 (for Acceleration)" UBYTE Fact_CrCtl 1 100 0.00 0.9961 ECU_ADDRESS 0x7000A5CD /end MEASUREMENT
/begin MEASUREMENT CrCtl_facECAFbUp2_mp "Acceleration factor for changing APP limitation number for ECON to 2 from 1 (for FB)" UBYTE Fact_CrCtl 1 100 0.00 0.9961 ECU_ADDRESS 0x7000A5CC /end MEASUREMENT
/begin MEASUREMENT CrCtl_facECAFbUp3_mp "Acceleration factor for changing APP limitation number for ECON to 3 from 2 (for FB)" UBYTE Fact_CrCtl 1 100 0.00 0.9961 ECU_ADDRESS 0x7000A5CB /end MEASUREMENT
/begin MEASUREMENT CrCtl_facECAFbUp4_mp "yAcceleration factor for changing APP limitation number for ECON to 4 from 3 (for FB)" UBYTE Fact_CrCtl 1 100 0.00 0.9961 ECU_ADDRESS 0x7000A5CA /end MEASUREMENT
/begin MEASUREMENT CrCtl_facECAFbUp5_mp "Acceleration factor for changing APP limitation number for ECON to 5 from 4 (for FB)" UBYTE Fact_CrCtl 1 100 0.00 0.9961 ECU_ADDRESS 0x7000A5C9 /end MEASUREMENT
/begin MEASUREMENT CrCtl_facECAppInitCor_mp "Correct value of initial request APP for ECON" UBYTE Fact_CrCtl2 1 100 0.00 3.984 FORMAT "%5.3" ECU_ADDRESS 0x7000A5C8 /end MEASUREMENT
/begin MEASUREMENT CrCtl_facECAResUp2_mp "Acceleration factor for changing APP limitation number for ECON to 2 from 1 (for Resume)" UBYTE Fact_CrCtl 1 100 0.00 0.9961 ECU_ADDRESS 0x7000A5C7 /end MEASUREMENT
/begin MEASUREMENT CrCtl_facECAResUp3_mp "Acceleration factor for changing APP limitation number for ECON to 3 from 2 (for Resume)" UBYTE Fact_CrCtl 1 100 0.00 0.9961 ECU_ADDRESS 0x7000A5C6 /end MEASUREMENT
/begin MEASUREMENT CrCtl_facECAResUp4_mp "Acceleration factor for changing APP limitation number for ECON to 4 from 3 (for Resume)" UBYTE Fact_CrCtl 1 100 0.00 0.9961 ECU_ADDRESS 0x7000A5C5 /end MEASUREMENT
/begin MEASUREMENT CrCtl_facECAResUp5_mp "Acceleration factor for changing APP limitation number for ECON to 5 from 4 (for Resume)" UBYTE Fact_CrCtl 1 100 0.00 0.9961 ECU_ADDRESS 0x7000A5C4 /end MEASUREMENT
/begin MEASUREMENT CrCtl_facEstSlpEquiv_mp "factor of Estimation Slope equivalent mass value" SLONG Fact_CrCtl4 1 100 -32768.0000000 32767.9999847 FORMAT "%13.7" ECU_ADDRESS 0x7000A754 /end MEASUREMENT
/begin MEASUREMENT CrCtl_facEstSlpReviA_mp "factor of Estimation Slope revision value A" SWORD Fact_CrCtl 1 100 -128.0000 127.9961 FORMAT "%8.4" ECU_ADDRESS 0x7000A752 /end MEASUREMENT
/begin MEASUREMENT CrCtl_facEstSlpReviB_mp "factor of Estimation Slope revision value B" SWORD Fact_CrCtl 1 100 -128.0000 127.9961 FORMAT "%8.4" ECU_ADDRESS 0x7000A750 /end MEASUREMENT
/begin MEASUREMENT CrCtl_facEstSlpTrq_mp "factor of Estimation Slope torque value" ULONG Fact_CrCtl 1 100 0.00 16777215.9961 FORMAT "%13.4" ECU_ADDRESS 0x7000A74C /end MEASUREMENT
/begin MEASUREMENT CrCtl_facFdbkDCont_mp "Feed Back control D factor value" SWORD Fact_CrCtl2 1 100 -512.0000 511.9844 FORMAT "%8.4" ECU_ADDRESS 0x7000A5C2 /end MEASUREMENT
/begin MEASUREMENT CrCtl_facFdbkDReviVal_mp "factor of Feed Back D Gear revision value" SWORD Fact1 1 100 -256.0000 255.9922 FORMAT "%8.4" ECU_ADDRESS 0x7000A5C0 /end MEASUREMENT
/begin MEASUREMENT CrCtl_facFdbkPCont_mp "Feed Back control P factor value" SWORD Fact_CrCtl3 1 100 -32.00000 31.99902 FORMAT "%8.5" ECU_ADDRESS 0x7000A5BE /end MEASUREMENT
/begin MEASUREMENT CrCtl_facFdbkPReviVal_mp "factor of Feed Back P Gear revision value" SWORD Fact1 1 100 -256.0000 255.9922 FORMAT "%8.4" ECU_ADDRESS 0x7000A5BC /end MEASUREMENT
/begin MEASUREMENT CrCtl_facNeLimDCont_mp "factor of D value for Ne Set Clutch out" SWORD Fact_CrCtl2 1 100 -512.0000 511.9844 FORMAT "%8.4" ECU_ADDRESS 0x7000A5BA /end MEASUREMENT
/begin MEASUREMENT CrCtl_facNeLimPCont_mp "factor of P value for Ne Set Clutch out" SWORD Fact_CrCtl3 1 100 -32.00000 31.99902 FORMAT "%8.5" ECU_ADDRESS 0x7000A5B8 /end MEASUREMENT
/begin MEASUREMENT CrCtl_facShutOffReviVal_mp "factor of shut off revision value" SBYTE Fact_CrCtl2 1 100 -2.000 1.984 FORMAT "%5.3" ECU_ADDRESS 0x7000A5B6 /end MEASUREMENT
/begin MEASUREMENT CrCtl_facTrgAccnRate "Factor to determine the target accleration rate based on the difference between target speed and current speed" SWORD Fact100 1 100 -327.6800 327.6700 FORMAT "%8.4" ECU_ADDRESS 0x6000107A /end MEASUREMENT
/begin MEASUREMENT CrCtl_flgCrsCtrlACCRxNorm "Cruise control ACC CAN Rx normal. (FId_CrCtlACCRxErr is not inhibited)" UBYTE B_TRUE 1 100 0.00 1.00000000000 BIT_MASK 0x1 FORMAT "%13.11" ECU_ADDRESS 0x6000F14F /end MEASUREMENT
/begin MEASUREMENT CrCtl_nDesVal_mp "value of desired engine speed" SWORD EngNCrCtl 1 100 -32768.00 32767.00 FORMAT "%8.2" ECU_ADDRESS 0x7000A5B4 /end MEASUREMENT
/begin MEASUREMENT CrCtl_nTrqOffChkAdd "Torque off Check NE additional value" SWORD EngNCrCtl 1 100 0.00 32767.00 FORMAT "%8.2" ECU_ADDRESS 0x60009226 /end MEASUREMENT
/begin MEASUREMENT CrCtl_nTrqOffLimA_mp "Torque off Check limit NE value A" SWORD EngNCrCtl 1 100 -32768.00 32767.00 FORMAT "%8.2" ECU_ADDRESS 0x7000A5B2 /end MEASUREMENT
/begin MEASUREMENT CrCtl_nTrqOffLimB_mp "Torque off Check limit NE value B" SWORD EngNCrCtl 1 100 -32768.00 32767.00 FORMAT "%8.2" ECU_ADDRESS 0x7000A5B0 /end MEASUREMENT
/begin MEASUREMENT CrCtl_nTrqOffReqChk "Variable for Torque off Check NE value" SWORD EngNCrCtl 1 100 0.00 32767.00 FORMAT "%8.2" ECU_ADDRESS 0x60009224 /end MEASUREMENT
/begin MEASUREMENT CrCtl_numACCType "Cruise control type number" UBYTE OneToOne 1 100 0.00 255.0 FORMAT "%5.1" ECU_ADDRESS 0x6000F4AF /end MEASUREMENT
/begin MEASUREMENT CrCtl_numATType "Type of transmission used" UBYTE OneToOne 1 100 0.00 255.0 FORMAT "%5.1" ECU_ADDRESS 0x6000F4AE /end MEASUREMENT
/begin MEASUREMENT CrCtl_numECAppLim "CC ECON opening limitation number" UBYTE OneToOne 1 100 0.00 255.0 FORMAT "%5.1" ECU_ADDRESS 0x6000F4AD /end MEASUREMENT
/begin MEASUREMENT CrCtl_numECAppLimOld "Old CC ECON opening limitation number" UBYTE OneToOne 1 100 0.00 255.0 FORMAT "%5.1" ECU_ADDRESS 0x6000F4AC /end MEASUREMENT
/begin MEASUREMENT CrCtl_rACCBrkReqChg "Variable for APP request value of Gear Change for ACC Brake On" SWORD APPCrCtl1 1 100 0.00 163.8350 FORMAT "%8.4" ECU_ADDRESS 0x60009222 /end MEASUREMENT
/begin MEASUREMENT CrCtl_rACCFstTUAccnRed_mp "ACC First Tap Up acceleration reduce value" SWORD Prc_CrCtl2 1 100 -3276.800 3276.700 FORMAT "%8.3" ECU_ADDRESS 0x7000A5AE /end MEASUREMENT
/begin MEASUREMENT CrCtl_rAccnFltVal_mp "ratio of filtered acceleration value" SWORD Prc_CrCtl2 1 100 -3276.800 3276.700 FORMAT "%8.3" ECU_ADDRESS 0x7000A5AC /end MEASUREMENT
/begin MEASUREMENT CrCtl_rACCTxEstSlp "Estimation Slope value for ACC Tx" SBYTE Prc_CrCtl3 1 100 -16.00 15.88 FORMAT "%5.2" ECU_ADDRESS 0x6000F7BB /end MEASUREMENT
/begin MEASUREMENT CrCtl_rACCTxEstSlpOld "Old value of estimation slope for ACC Tx" SBYTE Prc_CrCtl3 1 100 -16.00 15.88 FORMAT "%5.2" ECU_ADDRESS 0x6000F7BA /end MEASUREMENT
/begin MEASUREMENT CrCtl_rACCTxTrq "Ratio of Torque value for ACC Tx" SWORD Prc_CrCtl 1 100 -32768.00 32767.00 FORMAT "%8.2" ECU_ADDRESS 0x60009220 /end MEASUREMENT
/begin MEASUREMENT CrCtl_rAPPACCFU_mp "Upper limit of acc. pedal opening at ACC follow-up control" SWORD APPCrCtl1 1 100 -163.8400 163.8350 FORMAT "%8.4" ECU_ADDRESS 0x7000A5AA /end MEASUREMENT
/begin MEASUREMENT CrCtl_rAppDec10ms_mp "APP request every 10ms Sub variant value" SWORD APPCrCtl1 1 100 -163.8400 163.8350 FORMAT "%8.4" ECU_ADDRESS 0x7000A5A8 /end MEASUREMENT
/begin MEASUREMENT CrCtl_rAppInc10ms_mp "APP request every 10ms Add variant value" SWORD APPCrCtl1 1 100 -163.8400 163.8350 FORMAT "%8.4" ECU_ADDRESS 0x7000A5A6 /end MEASUREMENT
/begin MEASUREMENT CrCtl_rAPPOpnDR1CnclDwnSlp_mp "Accped opening for DR1 cancellation at CC down slope" SWORD APPCrCtl1 1 100 -163.8400 163.8350 FORMAT "%8.4" ECU_ADDRESS 0x7000A5A4 /end MEASUREMENT
/begin MEASUREMENT CrCtl_rAPPOpnDR2CnclDwnSlp_mp "Accped opening for DR2 cancellation at CC down slope" SWORD APPCrCtl1 1 100 -163.8400 163.8350 FORMAT "%8.4" ECU_ADDRESS 0x7000A5A2 /end MEASUREMENT
/begin MEASUREMENT CrCtl_rAPPOpnDR3CnclDwnSlp_mp "Accped opening for DR3 cancellation at CC down slope" SWORD APPCrCtl1 1 100 -163.8400 163.8350 FORMAT "%8.4" ECU_ADDRESS 0x7000A5A0 /end MEASUREMENT
/begin MEASUREMENT CrCtl_rAPPOpnDR4CnclDwnSlp_mp "Accped opening for DR4 cancellation at CC down slope" SWORD APPCrCtl1 1 100 -163.8400 163.8350 FORMAT "%8.4" ECU_ADDRESS 0x7000A59E /end MEASUREMENT
/begin MEASUREMENT CrCtl_rAPPOpnDR5CnclDwnSlp_mp "Accped opening for DR5 cancellation at CC down slope" SWORD APPCrCtl1 1 100 -163.8400 163.8350 FORMAT "%8.4" ECU_ADDRESS 0x7000A59C /end MEASUREMENT
/begin MEASUREMENT CrCtl_rAPPOpnDR6CnclDwnSlp_mp "Accped opening for DR6 cancellation at CC down slope" SWORD APPCrCtl1 1 100 -163.8400 163.8350 FORMAT "%8.4" ECU_ADDRESS 0x7000A59A /end MEASUREMENT
/begin MEASUREMENT CrCtl_rAPPOpnDR7CnclDwnSlp_mp "Accped opening for DR7 cancellation at CC down slope" SWORD APPCrCtl1 1 100 -163.8400 163.8350 FORMAT "%8.4" ECU_ADDRESS 0x7000A598 /end MEASUREMENT
/begin MEASUREMENT CrCtl_rDes "Cruise Control APP ratio demand" SWORD APPCrCtl1 1 100 -163.8400 163.8350 FORMAT "%8.4" ECU_ADDRESS 0x6000921E /end MEASUREMENT
/begin MEASUREMENT CrCtl_rDiff100msMid_mp "100ms cycle difference APP ratio request midle value" SWORD APPCrCtl1 1 100 -163.8400 163.8350 FORMAT "%8.4" ECU_ADDRESS 0x7000A596 /end MEASUREMENT
/begin MEASUREMENT CrCtl_rDiff100ms_mp "100ms cycle difference APP ratio request value" SWORD APPCrCtl1 1 100 -163.8400 163.8350 FORMAT "%8.4" ECU_ADDRESS 0x7000A594 /end MEASUREMENT
/begin MEASUREMENT CrCtl_rDiffAccnReq_mp "Difference acceleration torque request value" SLONG APPCrCtl1 1 100 -10737418.2400 10737418.2350 FORMAT "%13.4" ECU_ADDRESS 0x7000A590 /end MEASUREMENT
/begin MEASUREMENT CrCtl_rDiffClthOut_mp "Torque difference value for Clutch out" SLONG APPCrCtl1 1 100 -10737418.2400 10737418.2350 FORMAT "%13.4" ECU_ADDRESS 0x7000A58C /end MEASUREMENT
/begin MEASUREMENT CrCtl_rDiffVal_mp "Target APP ratio difference value" SLONG APPCrCtl1 1 100 -10737418.2400 10737418.2350 FORMAT "%13.4" ECU_ADDRESS 0x7000A588 /end MEASUREMENT
/begin MEASUREMENT CrCtl_rDwnCncl_mp "first APP ratio Down value for Cruise Control cancel" SWORD APPCrCtl1 1 100 -163.8400 163.8350 FORMAT "%8.4" ECU_ADDRESS 0x7000A586 /end MEASUREMENT
/begin MEASUREMENT CrCtl_rECAppLimNum1_mp "APP limitation value for ECON when APP limitation number is 1." SWORD APPCrCtl1 1 100 -163.8400 163.8350 FORMAT "%8.4" ECU_ADDRESS 0x7000A584 /end MEASUREMENT
/begin MEASUREMENT CrCtl_rECAppLimNum2_mp "APP limitation value for ECON when APP limitation number is 2." SWORD APPCrCtl1 1 100 -163.8400 163.8350 FORMAT "%8.4" ECU_ADDRESS 0x7000A582 /end MEASUREMENT
/begin MEASUREMENT CrCtl_rECAppLimNum3_mp "APP limitation value for ECON when APP limitation number is 3." SWORD APPCrCtl1 1 100 -163.8400 163.8350 FORMAT "%8.4" ECU_ADDRESS 0x7000A580 /end MEASUREMENT
/begin MEASUREMENT CrCtl_rECAppLimNum4_mp "APP limitation value for ECON when APP limitation number is 4." SWORD APPCrCtl1 1 100 -163.8400 163.8350 FORMAT "%8.4" ECU_ADDRESS 0x7000A57E /end MEASUREMENT
/begin MEASUREMENT CrCtl_rECAppLimNum5_mp "APP limitation value for ECON when APP limitation number is 5." SWORD APPCrCtl1 1 100 -163.8400 163.8350 FORMAT "%8.4" ECU_ADDRESS 0x7000A57C /end MEASUREMENT
/begin MEASUREMENT CrCtl_rECShiftVal1_mp "APP change value of shift1 for ECON when ECON sw state is changed." SWORD APPCrCtl1 1 100 -163.8400 163.8350 FORMAT "%8.4" ECU_ADDRESS 0x7000A57A /end MEASUREMENT
/begin MEASUREMENT CrCtl_rECShiftVal2_mp "APP change value of shift2 for ECON when ECON sw state is changed." SWORD APPCrCtl1 1 100 -163.8400 163.8350 FORMAT "%8.4" ECU_ADDRESS 0x7000A578 /end MEASUREMENT
/begin MEASUREMENT CrCtl_rECShiftVal3_mp "APP change value of shift3 for ECON when ECON sw state is changed." SWORD APPCrCtl1 1 100 -163.8400 163.8350 FORMAT "%8.4" ECU_ADDRESS 0x7000A576 /end MEASUREMENT
/begin MEASUREMENT CrCtl_rECShiftVal4_mp "APP change value of shift4 for ECON when ECON sw state is changed." SWORD APPCrCtl1 1 100 -163.8400 163.8350 FORMAT "%8.4" ECU_ADDRESS 0x7000A574 /end MEASUREMENT
/begin MEASUREMENT CrCtl_rECShiftVal5_mp "APP change value of shift5 for ECON when ECON sw state is changed." SWORD APPCrCtl1 1 100 -163.8400 163.8350 FORMAT "%8.4" ECU_ADDRESS 0x7000A572 /end MEASUREMENT
/begin MEASUREMENT CrCtl_rECShiftValItm_mp "Intermediately status of ECON active for Cruise control" SWORD APPCrCtl1 1 100 -163.8400 163.8350 FORMAT "%8.4" ECU_ADDRESS 0x7000A570 /end MEASUREMENT
/begin MEASUREMENT CrCtl_rECSlopDwn1_mp "Slope for changing APP limitation number for ECON to 1 from 2" SWORD Prc_CrCtl4 1 100 -128.0000 127.9961 FORMAT "%8.4" ECU_ADDRESS 0x7000A56E /end MEASUREMENT
/begin MEASUREMENT CrCtl_rECSlopDwn2_mp "Slope for changing APP limitation number for ECON to 2 from 3" SWORD Prc_CrCtl4 1 100 -128.0000 127.9961 FORMAT "%8.4" ECU_ADDRESS 0x7000A56C /end MEASUREMENT
/begin MEASUREMENT CrCtl_rECSlopDwn3_mp "Slope for changing APP limitation number for ECON to 3 from 4" SWORD Prc_CrCtl4 1 100 -128.0000 127.9961 FORMAT "%8.4" ECU_ADDRESS 0x7000A56A /end MEASUREMENT
/begin MEASUREMENT CrCtl_rECSlopDwn4_mp "Slope for changing APP limitation number for ECON to 4 from 5" SWORD Prc_CrCtl4 1 100 -128.0000 127.9961 FORMAT "%8.4" ECU_ADDRESS 0x7000A568 /end MEASUREMENT
/begin MEASUREMENT CrCtl_rEstSlpAftRevi_mp "Estimation Slope after revisions value" SWORD Prc_CrCtl4 1 100 -128.0000 127.9961 FORMAT "%8.4" ECU_ADDRESS 0x7000A74A /end MEASUREMENT
/begin MEASUREMENT CrCtl_rEstSlpFltVal "Filtered Estimation Slope value" SWORD Prc_CrCtl4 1 100 -128.0000 127.9961 FORMAT "%8.4" ECU_ADDRESS 0x6000921C /end MEASUREMENT
/begin MEASUREMENT CrCtl_rEstSlpFltValOld_mp "Old Filtered Estimation Slope value" SWORD Prc_CrCtl4 1 100 -128.0000 127.9961 FORMAT "%8.4" ECU_ADDRESS 0x7000A748 /end MEASUREMENT
/begin MEASUREMENT CrCtl_rEstSlpTab_mp "table search for Estimation Slope value" SWORD Prc_CrCtl4 1 100 -128.0000 127.9961 FORMAT "%8.4" ECU_ADDRESS 0x7000A566 /end MEASUREMENT
/begin MEASUREMENT CrCtl_rEstSlpTrnsEff_mp "Transmission effeciency" SWORD Prc_CrCtl2 1 100 -3276.800 3276.700 FORMAT "%8.3" ECU_ADDRESS 0x7000A746 /end MEASUREMENT
/begin MEASUREMENT CrCtl_rEstSlpValDR1Cncl_mp "Slope assessed value for CC_DR1 cancel judgement" SWORD Prc_CrCtl4 1 100 -128.0000 127.9961 FORMAT "%8.4" ECU_ADDRESS 0x7000A564 /end MEASUREMENT
/begin MEASUREMENT CrCtl_rEstSlpValDR2Cncl_mp "Slope assessed value for CC_DR3 cancel judgement" SWORD Prc_CrCtl4 1 100 -128.0000 127.9961 FORMAT "%8.4" ECU_ADDRESS 0x7000A562 /end MEASUREMENT
/begin MEASUREMENT CrCtl_rEstSlpValDR3Cncl_mp "Slope assessed value for CC_DR3 cancel judgement" SWORD Prc_CrCtl4 1 100 -128.0000 127.9961 FORMAT "%8.4" ECU_ADDRESS 0x7000A560 /end MEASUREMENT
/begin MEASUREMENT CrCtl_rEstSlpValDR4Cncl_mp "Slope assessed value for CC_DR4 cancel judgement" SWORD Prc_CrCtl4 1 100 -128.0000 127.9961 FORMAT "%8.4" ECU_ADDRESS 0x7000A55E /end MEASUREMENT
/begin MEASUREMENT CrCtl_rEstSlpValDR5Cncl_mp "Slope assessed value for CC_DR5 cancel judgement" SWORD Prc_CrCtl4 1 100 -128.0000 127.9961 FORMAT "%8.4" ECU_ADDRESS 0x7000A55C /end MEASUREMENT
/begin MEASUREMENT CrCtl_rEstSlpValDR6Cncl_mp "Slope assessed value for CC_DR6 cancel judgement" SWORD Prc_CrCtl4 1 100 -128.0000 127.9961 FORMAT "%8.4" ECU_ADDRESS 0x7000A55A /end MEASUREMENT
/begin MEASUREMENT CrCtl_rEstSlpValDR7Cncl_mp "Slope assessed value for CC_DR7 cancel judgement" SWORD Prc_CrCtl4 1 100 -128.0000 127.9961 FORMAT "%8.4" ECU_ADDRESS 0x7000A558 /end MEASUREMENT
/begin MEASUREMENT CrCtl_rEstSlpVal_mp "Estimation Slope value" SWORD Prc_CrCtl4 1 100 -128.0000 127.9961 FORMAT "%8.4" ECU_ADDRESS 0x7000A744 /end MEASUREMENT
/begin MEASUREMENT CrCtl_rGearNo0 "ratio nv for Gear Down 0 check value" SLONG NToVel_CrCtl 1 100 -8388608.00000 8388607.99609 FORMAT "%13.5" ECU_ADDRESS 0x60003998 /end MEASUREMENT
/begin MEASUREMENT CrCtl_rGearNo1 "ratio nv for Gear Down 1 check value" SLONG NToVel_CrCtl 1 100 -8388608.00000 8388607.99609 FORMAT "%13.5" ECU_ADDRESS 0x60003994 /end MEASUREMENT
/begin MEASUREMENT CrCtl_rGearNo2 "ratio nv for Gear Down 2 check value" SLONG NToVel_CrCtl 1 100 -8388608.00000 8388607.99609 FORMAT "%13.5" ECU_ADDRESS 0x60003990 /end MEASUREMENT
/begin MEASUREMENT CrCtl_rGearNo3 "ratio nv for Gear Down 3 check value" SLONG NToVel_CrCtl 1 100 -8388608.00000 8388607.99609 FORMAT "%13.5" ECU_ADDRESS 0x6000398C /end MEASUREMENT
/begin MEASUREMENT CrCtl_rInitReq_mp "initial torque request value" SWORD APPCrCtl1 1 100 -163.8400 163.8350 FORMAT "%8.4" ECU_ADDRESS 0x7000A556 /end MEASUREMENT
/begin MEASUREMENT CrCtl_rLSFStrtAPP_mp "LSF start demand value" SWORD APPCrCtl1 1 100 -163.8400 163.8350 FORMAT "%8.4" ECU_ADDRESS 0x7000A554 /end MEASUREMENT
/begin MEASUREMENT CrCtl_rMaxAPPCC_mp "Max. acc pedal opening in CC" SWORD APPCrCtl1 1 100 -163.8400 163.8350 FORMAT "%8.4" ECU_ADDRESS 0x7000A552 /end MEASUREMENT
/begin MEASUREMENT CrCtl_rMaxCC3LG_mp "Max. acc. pedal opening in CC3 lower gear" SWORD APPCrCtl1 1 100 -163.8400 163.8350 FORMAT "%8.4" ECU_ADDRESS 0x7000A550 /end MEASUREMENT
/begin MEASUREMENT CrCtl_rMaxCC4LG_mp "Max. acc. pedal opening in CC4 lower gear" SWORD APPCrCtl1 1 100 -163.8400 163.8350 FORMAT "%8.4" ECU_ADDRESS 0x7000A54E /end MEASUREMENT
/begin MEASUREMENT CrCtl_rMaxCC5LG_mp "Max. acc. pedal opening in CC5 lower gear" SWORD APPCrCtl1 1 100 -163.8400 163.8350 FORMAT "%8.4" ECU_ADDRESS 0x7000A54C /end MEASUREMENT
/begin MEASUREMENT CrCtl_rMaxCC6LG_mp "Max. acc. pedal opening in CC6 lower gear" SWORD APPCrCtl1 1 100 -163.8400 163.8350 FORMAT "%8.4" ECU_ADDRESS 0x7000A54A /end MEASUREMENT
/begin MEASUREMENT CrCtl_rMaxCCLG_mp "Max. acc. pedal opening in CC2 lower gear" SWORD APPCrCtl1 1 100 -163.8400 163.8350 FORMAT "%8.4" ECU_ADDRESS 0x7000A548 /end MEASUREMENT
/begin MEASUREMENT CrCtl_rMaxCCNG_mp "Max. acc. pedal opening in CC next gear" SWORD APPCrCtl1 1 100 -163.8400 163.8350 FORMAT "%8.4" ECU_ADDRESS 0x7000A546 /end MEASUREMENT
/begin MEASUREMENT CrCtl_rMaxCCTG_mp "Max. acc. pedal opening in CC top gear" SWORD APPCrCtl1 1 100 -163.8400 163.8350 FORMAT "%8.4" ECU_ADDRESS 0x7000A544 /end MEASUREMENT
/begin MEASUREMENT CrCtl_rMETFltOld_mp "Old Filtering Meter revision ratio" SLONG Fact_CrCtl1 1 100 -65536.0000000 65535.9999695 FORMAT "%13.7" ECU_ADDRESS 0x7000A740 /end MEASUREMENT
/begin MEASUREMENT CrCtl_rMETFlt_mp "Filtering Meter revision ratio" SLONG Fact_CrCtl1 1 100 -65536.0000000 65535.9999695 FORMAT "%13.7" ECU_ADDRESS 0x7000A73C /end MEASUREMENT
/begin MEASUREMENT CrCtl_rMETReviChngVal "Ratio of Speed METER revision change value for Cruise Control" SBYTE Prc_CrCtl2 1 100 -12.80 12.70 FORMAT "%5.2" ECU_ADDRESS 0x6000F7B9 /end MEASUREMENT
/begin MEASUREMENT CrCtl_rMETReviDet_mp "Ratio of Meter revision ratio determination value" SWORD Prc_CrCtl2 1 100 -3276.800 3276.700 FORMAT "%8.3" ECU_ADDRESS 0x7000A73A /end MEASUREMENT
/begin MEASUREMENT CrCtl_rMETReviLoLim_mp "Ratio of Meter Vehicle Speed revision Lo limit value" SWORD Prc_CrCtl1 1 100 -327.6800 327.6700 FORMAT "%8.4" ECU_ADDRESS 0x7000A738 /end MEASUREMENT
/begin MEASUREMENT CrCtl_rMETReviUpLim_mp "Ratio of Meter Vehicle Speed revision Upper limit value" SWORD Prc_CrCtl1 1 100 -327.6800 327.6700 FORMAT "%8.4" ECU_ADDRESS 0x7000A736 /end MEASUREMENT
/begin MEASUREMENT CrCtl_rMETSpdReviFlt_mp "Ratio of Filterd Meter Vehicle Speed revision ratio value" SWORD Prc_CrCtl1 1 100 -327.6800 327.6700 FORMAT "%8.4" ECU_ADDRESS 0x7000A734 /end MEASUREMENT
/begin MEASUREMENT CrCtl_rMETSpdRevi_mp "Ratio of Meter Vehicle Speed revision ratio value" SWORD Prc_CrCtl1 1 100 -327.6800 327.6700 FORMAT "%8.4" ECU_ADDRESS 0x7000A732 /end MEASUREMENT
/begin MEASUREMENT CrCtl_rReqChg "Variable for Gear Change APP request value" SWORD APPCrCtl1 1 100 -163.8400 163.8350 FORMAT "%8.4" ECU_ADDRESS 0x6000921A /end MEASUREMENT
/begin MEASUREMENT CrCtl_rReq_mp "APP ratio request value" SWORD APPCrCtl1 1 100 -163.8400 163.8350 FORMAT "%8.4" ECU_ADDRESS 0x7000A542 /end MEASUREMENT
/begin MEASUREMENT CrCtl_rSptReqChg "Variable for Gear Change APP request value for sport mode" SWORD APPCrCtl1 1 100 -163.8400 163.8350 FORMAT "%8.4" ECU_ADDRESS 0x60009218 /end MEASUREMENT
/begin MEASUREMENT CrCtl_rTapInitCalc_mp "Tap initial caluculation work value" SWORD APPCrCtl1 1 100 -163.8400 163.8350 FORMAT "%8.4" ECU_ADDRESS 0x7000A540 /end MEASUREMENT
/begin MEASUREMENT CrCtl_rTDInitDet_mp "Tap Down initial detection value" SWORD APPCrCtl1 1 100 -163.8400 163.8350 FORMAT "%8.4" ECU_ADDRESS 0x7000A53E /end MEASUREMENT
/begin MEASUREMENT CrCtl_rTrgSubWork_mp "subtraction value of target APP ratio work" SWORD APPCrCtl1 1 100 -163.8400 163.8350 FORMAT "%8.4" ECU_ADDRESS 0x7000A53C /end MEASUREMENT
/begin MEASUREMENT CrCtl_rTUInitDet_mp "Tap Up initial detection value" SWORD APPCrCtl1 1 100 -163.8400 163.8350 FORMAT "%8.4" ECU_ADDRESS 0x7000A53A /end MEASUREMENT
/begin MEASUREMENT CrCtl_stACCAPPOn "Status for ACC accelerator pedal On flag" UBYTE OneToOne 1 100 0.00 255.0 FORMAT "%5.1" ECU_ADDRESS 0x6000F4AB /end MEASUREMENT
/begin MEASUREMENT CrCtl_stACCAPrelErr_mp "Status of ACCA communication preliminary error" UBYTE OneToOne 1 100 0.00 255.0 FORMAT "%5.1" ECU_ADDRESS 0x7000A731 /end MEASUREMENT
/begin MEASUREMENT CrCtl_stACCBPrelErr_mp "Status of ACCB communication preliminary error" UBYTE OneToOne 1 100 0.00 255.0 FORMAT "%5.1" ECU_ADDRESS 0x7000A730 /end MEASUREMENT
/begin MEASUREMENT CrCtl_stACCBrkDet "Status for ACC Brake detection flag" UBYTE OneToOne 1 100 0.00 255.0 FORMAT "%5.1" ECU_ADDRESS 0x6000F4AA /end MEASUREMENT
/begin MEASUREMENT CrCtl_stACCCond "Status for ACC condition flag" UBYTE OneToOne 1 100 0.00 255.0 FORMAT "%5.1" ECU_ADDRESS 0x6000F4A9 /end MEASUREMENT
/begin MEASUREMENT CrCtl_stAccCont "Status for Accel control condition" UBYTE OneToOne 1 100 0.00 255.0 FORMAT "%5.1" ECU_ADDRESS 0x6000F4A4 /end MEASUREMENT
/begin MEASUREMENT CrCtl_stACCDR1_mp "Down request 1 from ACC ECU" UBYTE OneToOne 1 100 0.00 255.0 FORMAT "%5.1" ECU_ADDRESS 0x7000A539 /end MEASUREMENT
/begin MEASUREMENT CrCtl_stACCDR2_mp "Down request 2 from ACC ECU" UBYTE OneToOne 1 100 0.00 255.0 FORMAT "%5.1" ECU_ADDRESS 0x7000A538 /end MEASUREMENT
/begin MEASUREMENT CrCtl_stACCDR3_mp "Down request 3 from ACC ECU" UBYTE OneToOne 1 100 0.00 255.0 FORMAT "%5.1" ECU_ADDRESS 0x7000A537 /end MEASUREMENT
/begin MEASUREMENT CrCtl_stACCDR4_mp "Down request4 from ACC ECU" UBYTE OneToOne 1 100 0.00 255.0 FORMAT "%5.1" ECU_ADDRESS 0x7000A536 /end MEASUREMENT
/begin MEASUREMENT CrCtl_stACCDR5_mp "Down request5 from ACC ECU" UBYTE OneToOne 1 100 0.00 255.0 FORMAT "%5.1" ECU_ADDRESS 0x7000A535 /end MEASUREMENT
/begin MEASUREMENT CrCtl_stACCDR6_mp "Down request6 from ACC ECU" UBYTE OneToOne 1 100 0.00 255.0 FORMAT "%5.1" ECU_ADDRESS 0x7000A534 /end MEASUREMENT
/begin MEASUREMENT CrCtl_stACCDR7_mp "Down request7 from ACC ECU" UBYTE OneToOne 1 100 0.00 255.0 FORMAT "%5.1" ECU_ADDRESS 0x7000A533 /end MEASUREMENT
/begin MEASUREMENT CrCtl_stACCFailDet_mp "Status for ACC Fail detection flag" UBYTE OneToOne 1 100 0.00 255.0 FORMAT "%5.1" ECU_ADDRESS 0x7000A72F /end MEASUREMENT
/begin MEASUREMENT CrCtl_stACCFstTU "Status of ACC First Tap Up flag" UBYTE OneToOne 1 100 0.00 255.0 FORMAT "%5.1" ECU_ADDRESS 0x6000F4A8 /end MEASUREMENT
/begin MEASUREMENT CrCtl_stACCFstTUAccnStp_mp "Status of ACC First Tap Up acceleration control stop flag" UBYTE OneToOne 1 100 0.00 255.0 FORMAT "%5.1" ECU_ADDRESS 0x7000A532 /end MEASUREMENT
/begin MEASUREMENT CrCtl_stAccnContStop_mp "Status of acceleration control stop flag" UBYTE OneToOne 1 100 0.00 255.0 FORMAT "%5.1" ECU_ADDRESS 0x7000A531 /end MEASUREMENT
/begin MEASUREMENT CrCtl_stAccnErr_mp "Status of vehicle acceleration Error flag" UBYTE OneToOne 1 100 0.00 255.0 FORMAT "%5.1" ECU_ADDRESS 0x7000A72E /end MEASUREMENT
/begin MEASUREMENT CrCtl_stAccPedOffReq "Status of accelerator pedal off request flag" UBYTE OneToOne 1 100 0.00 255.0 FORMAT "%5.1" ECU_ADDRESS 0x6000F4A3 /end MEASUREMENT
/begin MEASUREMENT CrCtl_stACCReqNoDet "Status for ACC Request No. detection" UBYTE OneToOne 1 100 0.00 255.0 FORMAT "%5.1" ECU_ADDRESS 0x6000F4A7 /end MEASUREMENT
/begin MEASUREMENT CrCtl_stActive "flag for an active cruise control" UBYTE OneToOne 1 100 0.00 255.0 FORMAT "%5.1" ECU_ADDRESS 0x6000F4A2 /end MEASUREMENT
/begin MEASUREMENT CrCtl_stAPPACCFU_mp "Flag for selecting the upper limit of acc.pedal opening at ACC follow-up control" UBYTE OneToOne 1 100 0.00 255.0 FORMAT "%5.1" ECU_ADDRESS 0x7000A530 /end MEASUREMENT
/begin MEASUREMENT CrCtl_stASLSysOffReq "Status of System off request flag" UBYTE OneToOne 1 100 0.00 255.0 FORMAT "%5.1" ECU_ADDRESS 0x6000F4A6 /end MEASUREMENT
/begin MEASUREMENT CrCtl_stASLTaskCont "Status of Task control flag used in ASL" UBYTE OneToOne 1 100 0.00 255.0 FORMAT "%5.1" ECU_ADDRESS 0x6000F4A5 /end MEASUREMENT
/begin MEASUREMENT CrCtl_stATVehSpdErr_mp "Status indicating if vehicle speed error is present or not" UBYTE OneToOne 1 100 0.00 255.0 FORMAT "%5.1" ECU_ADDRESS 0x7000A72D /end MEASUREMENT
/begin MEASUREMENT CrCtl_stChngACCtoCC_mp "Status for Mode Change for ACC to CC flag" UBYTE OneToOne 1 100 0.00 255.0 FORMAT "%5.1" ECU_ADDRESS 0x7000A72C /end MEASUREMENT
/begin MEASUREMENT CrCtl_stChngGearInitTrq_mp "Status for initial torque request of Change Gear flag" UBYTE OneToOne 1 100 0.00 255.0 FORMAT "%5.1" ECU_ADDRESS 0x7000A52F /end MEASUREMENT
/begin MEASUREMENT CrCtl_stCnclPermStr "Status of permission store for cancel reason flag" UBYTE OneToOne 1 100 0.00 255.0 FORMAT "%5.1" ECU_ADDRESS 0x6000F4A1 /end MEASUREMENT
/begin MEASUREMENT CrCtl_stCnclResCode0_mp "Status of cancel reason code 0" UWORD OneToOne 1 100 0.00 65535.00 FORMAT "%8.2" ECU_ADDRESS 0x7000A72A /end MEASUREMENT
/begin MEASUREMENT CrCtl_stCnclResCode1_mp "Status of cancel reason code 1" UWORD OneToOne 1 100 0.00 65535.00 FORMAT "%8.2" ECU_ADDRESS 0x7000A728 /end MEASUREMENT
/begin MEASUREMENT CrCtl_stCnclResCode2_mp "Status of cancel reason code 2" UWORD OneToOne 1 100 0.00 65535.00 FORMAT "%8.2" ECU_ADDRESS 0x7000A726 /end MEASUREMENT
/begin MEASUREMENT CrCtl_stCnclResCode3_mp "Status of cancel reason code 3" UWORD OneToOne 1 100 0.00 65535.00 FORMAT "%8.2" ECU_ADDRESS 0x7000A724 /end MEASUREMENT
/begin MEASUREMENT CrCtl_stCnclResCode4_mp "Status of cancel reason code 4" UWORD OneToOne 1 100 0.00 65535.00 FORMAT "%8.2" ECU_ADDRESS 0x7000A722 /end MEASUREMENT
/begin MEASUREMENT CrCtl_stCnclResCode5_mp "Status of cancel reason code 5" UWORD OneToOne 1 100 0.00 65535.00 FORMAT "%8.2" ECU_ADDRESS 0x7000A720 /end MEASUREMENT
/begin MEASUREMENT CrCtl_stCnclResCode6_mp "Status of cancel reason code 6" UWORD OneToOne 1 100 0.00 65535.00 FORMAT "%8.2" ECU_ADDRESS 0x7000A71E /end MEASUREMENT
/begin MEASUREMENT CrCtl_stCnclResCode7_mp "Status of cancel reason code 7" UWORD OneToOne 1 100 0.00 65535.00 FORMAT "%8.2" ECU_ADDRESS 0x7000A71C /end MEASUREMENT
/begin MEASUREMENT CrCtl_stCnclResCode8_mp "Status of cancel reason code 8" UWORD OneToOne 1 100 0.00 65535.00 FORMAT "%8.2" ECU_ADDRESS 0x7000A71A /end MEASUREMENT
/begin MEASUREMENT CrCtl_stCnclResCode9_mp "Status of cancel reason code 9" UWORD OneToOne 1 100 0.00 65535.00 FORMAT "%8.2" ECU_ADDRESS 0x7000A718 /end MEASUREMENT
/begin MEASUREMENT CrCtl_stCntIntReq "Status of counter initial request flag" UBYTE OneToOne 1 100 0.00 255.0 FORMAT "%5.1" ECU_ADDRESS 0x6000F4A0 /end MEASUREMENT
/begin MEASUREMENT CrCtl_stCoaCont "Status for Coast control condition" UBYTE OneToOne 1 100 0.00 255.0 FORMAT "%5.1" ECU_ADDRESS 0x6000F49F /end MEASUREMENT
/begin MEASUREMENT CrCtl_stCond "Status of Cruise Control condition No." UBYTE OneToOne 1 100 0.00 255.0 FORMAT "%5.1" ECU_ADDRESS 0x6000F49E /end MEASUREMENT
/begin MEASUREMENT CrCtl_stCondNo "Status of Old Cruise Control condition No." UBYTE OneToOne 1 100 0.00 255.0 FORMAT "%5.1" ECU_ADDRESS 0x6000F49D /end MEASUREMENT
/begin MEASUREMENT CrCtl_stCondNoOld_mp "Status of Old Cruise Control condition No." UBYTE OneToOne 1 100 0.00 255.0 FORMAT "%5.1" ECU_ADDRESS 0x7000A52E /end MEASUREMENT
/begin MEASUREMENT CrCtl_stContTapDnCond_mp "Status of continuation TAP Down condition" UBYTE OneToOne 1 100 0.00 255.0 FORMAT "%5.1" ECU_ADDRESS 0x7000A717 /end MEASUREMENT
/begin MEASUREMENT CrCtl_stContTapUpCnt_mp "Status of continuation TAP UP count value for ACC/CC" UBYTE OneToOne 1 100 0.00 255.0 FORMAT "%5.1" ECU_ADDRESS 0x7000A716 /end MEASUREMENT
/begin MEASUREMENT CrCtl_stCrsErrDet "Status of Cruise control error detection" UBYTE OneToOne 1 100 0.00 255.0 FORMAT "%5.1" ECU_ADDRESS 0x6000F49C /end MEASUREMENT
/begin MEASUREMENT CrCtl_stDes2ChgActv_mp "During control to change 2nd desired vehicle speed" UBYTE OneToOne 1 100 0.00 255.0 FORMAT "%5.1" ECU_ADDRESS 0x7000A52D /end MEASUREMENT
/begin MEASUREMENT CrCtl_stDesChgCdn_mp "Activation of condition for changing 2nd desired vehicle speed" UBYTE OneToOne 1 100 0.00 255.0 FORMAT "%5.1" ECU_ADDRESS 0x7000A52C /end MEASUREMENT
/begin MEASUREMENT CrCtl_stDisAPPInc_mp "Flag for disabling the increase in reqtd. acc. pedal opening after deciding CC_DR" UBYTE OneToOne 1 100 0.00 255.0 FORMAT "%5.1" ECU_ADDRESS 0x7000A52B /end MEASUREMENT
/begin MEASUREMENT CrCtl_stDistOn "Status of driven distance control flag" UBYTE OneToOne 1 100 0.00 255.0 FORMAT "%5.1" ECU_ADDRESS 0x6000F484 /end MEASUREMENT
/begin MEASUREMENT CrCtl_stDR1DwnSlp "DR1 judgement flag for CC down-slope" UBYTE OneToOne 1 100 0.00 255.0 FORMAT "%5.1" ECU_ADDRESS 0x6000F49B /end MEASUREMENT
/begin MEASUREMENT CrCtl_stDR1Req "CC_DR1 request flag" UBYTE OneToOne 1 100 0.00 255.0 FORMAT "%5.1" ECU_ADDRESS 0x6000F49A /end MEASUREMENT
/begin MEASUREMENT CrCtl_stDR1UpSlp "DR1 judgement flag for CC up-slope" UBYTE OneToOne 1 100 0.00 255.0 FORMAT "%5.1" ECU_ADDRESS 0x6000F499 /end MEASUREMENT
/begin MEASUREMENT CrCtl_stDR2DwnSlp "DR2 judgement flag for CC down-slope" UBYTE OneToOne 1 100 0.00 255.0 FORMAT "%5.1" ECU_ADDRESS 0x6000F498 /end MEASUREMENT
/begin MEASUREMENT CrCtl_stDR2Req "CC_DR2 request flag" UBYTE OneToOne 1 100 0.00 255.0 FORMAT "%5.1" ECU_ADDRESS 0x6000F497 /end MEASUREMENT
/begin MEASUREMENT CrCtl_stDR2UpSlp "DR2 judgement flag for CC up-slope" UBYTE OneToOne 1 100 0.00 255.0 FORMAT "%5.1" ECU_ADDRESS 0x6000F496 /end MEASUREMENT
/begin MEASUREMENT CrCtl_stDR3DwnSlp "DR3 judgement flag for CC down-slope" UBYTE OneToOne 1 100 0.00 255.0 FORMAT "%5.1" ECU_ADDRESS 0x6000F495 /end MEASUREMENT
/begin MEASUREMENT CrCtl_stDR3Req "Auto cruise control down request flag3" UBYTE OneToOne 1 100 0.00 255.0 FORMAT "%5.1" ECU_ADDRESS 0x6000F494 /end MEASUREMENT
/begin MEASUREMENT CrCtl_stDR3UpSlp "DR3 judgement flag for CC up-slope" UBYTE OneToOne 1 100 0.00 255.0 FORMAT "%5.1" ECU_ADDRESS 0x6000F493 /end MEASUREMENT
/begin MEASUREMENT CrCtl_stDR4DwnSlp "DR4 judgement flag for CC down slope" UBYTE OneToOne 1 100 0.00 255.0 FORMAT "%5.1" ECU_ADDRESS 0x6000F492 /end MEASUREMENT
/begin MEASUREMENT CrCtl_stDR4Req "CC_DR4 request flag" UBYTE OneToOne 1 100 0.00 255.0 FORMAT "%5.1" ECU_ADDRESS 0x6000F491 /end MEASUREMENT
/begin MEASUREMENT CrCtl_stDR4UpSlp "DR4 judgement flag for CC up slope" UBYTE OneToOne 1 100 0.00 255.0 FORMAT "%5.1" ECU_ADDRESS 0x6000F490 /end MEASUREMENT
/begin MEASUREMENT CrCtl_stDR5DwnSlp "DR5 judgement flag for CC down slope" UBYTE OneToOne 1 100 0.00 255.0 FORMAT "%5.1" ECU_ADDRESS 0x6000F48F /end MEASUREMENT
/begin MEASUREMENT CrCtl_stDR5Req "CC_DR5 request flag" UBYTE OneToOne 1 100 0.00 255.0 FORMAT "%5.1" ECU_ADDRESS 0x6000F48E /end MEASUREMENT
/begin MEASUREMENT CrCtl_stDR5UpSlp "DR5 judgement flag for CC up slope" UBYTE OneToOne 1 100 0.00 255.0 FORMAT "%5.1" ECU_ADDRESS 0x6000F48D /end MEASUREMENT
/begin MEASUREMENT CrCtl_stDR6DwnSlp "DR6 judgement flag for CC down slope" UBYTE OneToOne 1 100 0.00 255.0 FORMAT "%5.1" ECU_ADDRESS 0x6000F48C /end MEASUREMENT
/begin MEASUREMENT CrCtl_stDR6Req "CC_DR6 request flag" UBYTE OneToOne 1 100 0.00 255.0 FORMAT "%5.1" ECU_ADDRESS 0x6000F48B /end MEASUREMENT
/begin MEASUREMENT CrCtl_stDR6UpSlp "DR6 judgement flag for CC up slope" UBYTE OneToOne 1 100 0.00 255.0 FORMAT "%5.1" ECU_ADDRESS 0x6000F48A /end MEASUREMENT
/begin MEASUREMENT CrCtl_stDR7DwnSlp "DR7 judgement flag for CC down slope" UBYTE OneToOne 1 100 0.00 255.0 FORMAT "%5.1" ECU_ADDRESS 0x6000F489 /end MEASUREMENT
/begin MEASUREMENT CrCtl_stDR7Req "CC_DR7 request flag" UBYTE OneToOne 1 100 0.00 255.0 FORMAT "%5.1" ECU_ADDRESS 0x6000F488 /end MEASUREMENT
/begin MEASUREMENT CrCtl_stDR7UpSlp "DR7 judgement flag for CC up slope" UBYTE OneToOne 1 100 0.00 255.0 FORMAT "%5.1" ECU_ADDRESS 0x6000F487 /end MEASUREMENT
/begin MEASUREMENT CrCtl_stDRCnclProsmaDisbl "Down-slope prosma disable request flag at CC_DR cancellation" UBYTE OneToOne 1 100 0.00 255.0 FORMAT "%5.1" ECU_ADDRESS 0x6000F486 /end MEASUREMENT
/begin MEASUREMENT CrCtl_stDRReqNo "CC_DR request number" UBYTE OneToOne 1 100 0.00 255.0 FORMAT "%5.1" ECU_ADDRESS 0x6000F485 /end MEASUREMENT
/begin MEASUREMENT CrCtl_stECDesChgContTU_mp "Add value for continuous TAPUP is used for 2nd desired vehicle speed calculation for ECON" UBYTE OneToOne 1 100 0.00 255.0 FORMAT "%5.1" ECU_ADDRESS 0x7000A52A /end MEASUREMENT
/begin MEASUREMENT CrCtl_stErrExtnTmrIdc_mp "Status of Cruise control error continuous check timer indication" UBYTE OneToOne 1 100 0.00 255.0 FORMAT "%5.1" ECU_ADDRESS 0x7000A529 /end MEASUREMENT
/begin MEASUREMENT CrCtl_stErrMTVehSpd "Status of MT Vehicle Speed sensor error" UBYTE OneToOne 1 100 0.00 255.0 FORMAT "%5.1" ECU_ADDRESS 0x6000F483 /end MEASUREMENT
/begin MEASUREMENT CrCtl_stEstSlpGearNo_mp "Status for Estimation Slope old Gear Down No." UBYTE OneToOne 1 100 0.00 255.0 FORMAT "%5.1" ECU_ADDRESS 0x7000A715 /end MEASUREMENT
/begin MEASUREMENT CrCtl_stFailCond "Status for Fail condition flag" UBYTE OneToOne 1 100 0.00 255.0 FORMAT "%5.1" ECU_ADDRESS 0x6000F482 /end MEASUREMENT
/begin MEASUREMENT CrCtl_stFltSpdVar "Filtered Cruise Control speed variation status" UBYTE OneToOne 1 100 0.00 255.0 FORMAT "%5.1" ECU_ADDRESS 0x6000F481 /end MEASUREMENT
/begin MEASUREMENT CrCtl_stFolChng "Status for follow up" UBYTE OneToOne 1 100 0.00 255.0 FORMAT "%5.1" ECU_ADDRESS 0x6000F480 /end MEASUREMENT
/begin MEASUREMENT CrCtl_stGuidDispNo "Status for Cruise Control Mode No." UBYTE OneToOne 1 100 0.00 255.0 FORMAT "%5.1" ECU_ADDRESS 0x6000F47F /end MEASUREMENT
/begin MEASUREMENT CrCtl_stIdasbCanErr "Active status of IDAS CAN communication error for cruise control" UBYTE OneToOne 1 100 0.00 255.0 FORMAT "%5.1" ECU_ADDRESS 0x6000F47C /end MEASUREMENT
/begin MEASUREMENT CrCtl_stIDASExsJdg "Excessive judgment flag in acceleration under IDAS control" UBYTE OneToOne 1 100 0.00 1.000 FORMAT "%5.3" ECU_ADDRESS 0x6000F47E /end MEASUREMENT
/begin MEASUREMENT CrCtl_stInitOut "Status of nitialize output flag" UBYTE OneToOne 1 100 0.00 255.0 FORMAT "%5.1" ECU_ADDRESS 0x6000F47B /end MEASUREMENT
/begin MEASUREMENT CrCtl_stInitTrqReq "Status of initial torque request flag" UBYTE OneToOne 1 100 0.00 255.0 FORMAT "%5.1" ECU_ADDRESS 0x6000F47A /end MEASUREMENT
/begin MEASUREMENT CrCtl_stLckOnAccOld_mp "Status of Old Lock On Accel flag" UBYTE OneToOne 1 100 0.00 255.0 FORMAT "%5.1" ECU_ADDRESS 0x7000A528 /end MEASUREMENT
/begin MEASUREMENT CrCtl_stLckOnAcc_mp "Status of Lock On Accel flag" UBYTE OneToOne 1 100 0.00 255.0 FORMAT "%5.1" ECU_ADDRESS 0x7000A527 /end MEASUREMENT
/begin MEASUREMENT CrCtl_stLmpOn "Status for Cruise Control Lamp On" UBYTE OneToOne 1 100 0.00 255.0 FORMAT "%5.1" ECU_ADDRESS 0x6000F479 /end MEASUREMENT
/begin MEASUREMENT CrCtl_stManCncl "Status of manual cancel flag" UBYTE OneToOne 1 100 0.00 255.0 FORMAT "%5.1" ECU_ADDRESS 0x6000F478 /end MEASUREMENT
/begin MEASUREMENT CrCtl_stMemSpdErr "Status for Memory Speed Error flag" UBYTE OneToOne 1 100 0.00 255.0 FORMAT "%5.1" ECU_ADDRESS 0x6000F477 /end MEASUREMENT
/begin MEASUREMENT CrCtl_stMETSpdVar_mp "Status for Meter Vehicle Speed variant flag" UBYTE OneToOne 1 100 0.00 255.0 FORMAT "%5.1" ECU_ADDRESS 0x7000A714 /end MEASUREMENT
/begin MEASUREMENT CrCtl_stModeNo "Status for Cruise Control Mode No." UBYTE OneToOne 1 100 0.00 255.0 FORMAT "%5.1" ECU_ADDRESS 0x6000F476 /end MEASUREMENT
/begin MEASUREMENT CrCtl_stModeNoOld "Old status for Cruise Control Mode No." UBYTE OneToOne 1 100 0.00 255.0 FORMAT "%5.1" ECU_ADDRESS 0x6000F475 /end MEASUREMENT
/begin MEASUREMENT CrCtl_stNOContInitReq "Status for initial request flag" UBYTE OneToOne 1 100 0.00 255.0 FORMAT "%5.1" ECU_ADDRESS 0x6000F474 /end MEASUREMENT
/begin MEASUREMENT CrCtl_stPartSpdCont "Status of Practical speed of cruise control" UBYTE OneToOne 1 100 0.00 1.000 FORMAT "%5.3" ECU_ADDRESS 0x6000F473 /end MEASUREMENT
/begin MEASUREMENT CrCtl_stPartSpdCont_mp "Status of Practical speed of cruise control" UBYTE OneToOne 1 100 0.00 255.0 FORMAT "%5.1" ECU_ADDRESS 0x7000A713 /end MEASUREMENT
/begin MEASUREMENT CrCtl_stPtd "Cruise Control is active or on ""Stand-BY"" Mode" UBYTE OneToOne 1 100 0.00 255.0 FORMAT "%5.1" ECU_ADDRESS 0x6000F472 /end MEASUREMENT
/begin MEASUREMENT CrCtl_stRePermSet "Status of RePermit set flag" UBYTE OneToOne 1 100 0.00 255.0 FORMAT "%5.1" ECU_ADDRESS 0x6000F471 /end MEASUREMENT
/begin MEASUREMENT CrCtl_stReq "Cruise control is active" UBYTE OneToOne 1 100 0.00 255.0 FORMAT "%5.1" ECU_ADDRESS 0x6000F470 /end MEASUREMENT
/begin MEASUREMENT CrCtl_stResMTClth "Status of Resume to MT clutch control flag" UBYTE OneToOne 1 100 0.00 255.0 FORMAT "%5.1" ECU_ADDRESS 0x6000F46F /end MEASUREMENT
/begin MEASUREMENT CrCtl_stResOffActv "Resume off control active" UBYTE OneToOne 1 100 0.00 255.0 FORMAT "%5.1" ECU_ADDRESS 0x6000F46E /end MEASUREMENT
/begin MEASUREMENT CrCtl_stResOffReq "Resume off control request" UBYTE OneToOne 1 100 0.00 255.0 FORMAT "%5.1" ECU_ADDRESS 0x6000F46D /end MEASUREMENT
/begin MEASUREMENT CrCtl_stSelSlpVal "Status for select slope value flag" UBYTE OneToOne 1 100 0.00 255.0 FORMAT "%5.1" ECU_ADDRESS 0x6000F46C /end MEASUREMENT
/begin MEASUREMENT CrCtl_stSetMETRevi_mp "Status of carried out Meter revisions control for Cruise Control set" UBYTE OneToOne 1 100 0.00 255.0 FORMAT "%5.1" ECU_ADDRESS 0x7000A712 /end MEASUREMENT
/begin MEASUREMENT CrCtl_stShftUpReq "Status of Driver Shift Up Request flag" UBYTE OneToOne 1 100 0.00 255.0 FORMAT "%5.1" ECU_ADDRESS 0x6000F46B /end MEASUREMENT
/begin MEASUREMENT CrCtl_stShutOffCode0 "store shutoff reason code 0" UWORD OneToOne 1 100 0.00 65535.00 FORMAT "%8.2" ECU_ADDRESS 0x60008CD6 /end MEASUREMENT
/begin MEASUREMENT CrCtl_stShutOffCode1 "store shutoff reason code 1" UWORD OneToOne 1 100 0.00 65535.00 FORMAT "%8.2" ECU_ADDRESS 0x60008CD4 /end MEASUREMENT
/begin MEASUREMENT CrCtl_stShutOffCode2 "store shutoff reason code 2" UWORD OneToOne 1 100 0.00 65535.00 FORMAT "%8.2" ECU_ADDRESS 0x60008CD2 /end MEASUREMENT
/begin MEASUREMENT CrCtl_stShutOffCode3 "store shutoff reason code 3" UWORD OneToOne 1 100 0.00 65535.00 FORMAT "%8.2" ECU_ADDRESS 0x60008CD0 /end MEASUREMENT
/begin MEASUREMENT CrCtl_stShutOffCode4 "store shutoff reason code 4" UWORD OneToOne 1 100 0.00 65535.00 FORMAT "%8.2" ECU_ADDRESS 0x60008CCE /end MEASUREMENT
/begin MEASUREMENT CrCtl_stShutOffCode5 "store shutoff reason code 5" UWORD OneToOne 1 100 0.00 65535.00 FORMAT "%8.2" ECU_ADDRESS 0x60008CCC /end MEASUREMENT
/begin MEASUREMENT CrCtl_stShutOffCode6 "store shutoff reason code 6" UWORD OneToOne 1 100 0.00 65535.00 FORMAT "%8.2" ECU_ADDRESS 0x60008CCA /end MEASUREMENT
/begin MEASUREMENT CrCtl_stShutOffCode7 "store shutoff reason code 7" UWORD OneToOne 1 100 0.00 65535.00 FORMAT "%8.2" ECU_ADDRESS 0x60008CC8 /end MEASUREMENT
/begin MEASUREMENT CrCtl_stShutOffCode8 "store shutoff reason code 8" UWORD OneToOne 1 100 0.00 65535.00 FORMAT "%8.2" ECU_ADDRESS 0x60008CC6 /end MEASUREMENT
/begin MEASUREMENT CrCtl_stShutOffCode9 "store shutoff reason code 9" UWORD OneToOne 1 100 0.00 65535.00 FORMAT "%8.2" ECU_ADDRESS 0x60008CC4 /end MEASUREMENT
/begin MEASUREMENT CrCtl_stSpdErr_mp "Status for Speed Error flag" UBYTE OneToOne 1 100 0.00 255.0 FORMAT "%5.1" ECU_ADDRESS 0x7000A711 /end MEASUREMENT
/begin MEASUREMENT CrCtl_stStore_mp "Status of store condition flag" UBYTE OneToOne 1 100 0.00 255.0 FORMAT "%5.1" ECU_ADDRESS 0x7000A710 /end MEASUREMENT
/begin MEASUREMENT CrCtl_stSysOffReq_mp "Status for System off request flag" UBYTE OneToOne 1 100 0.00 255.0 FORMAT "%5.1" ECU_ADDRESS 0x7000A70F /end MEASUREMENT
/begin MEASUREMENT CrCtl_stTaskCont "Status for Task control flag" UBYTE OneToOne 1 100 0.00 255.0 FORMAT "%5.1" ECU_ADDRESS 0x6000F46A /end MEASUREMENT
/begin MEASUREMENT CrCtl_stTrqReqZero "Status of Zero torque request flag" UBYTE OneToOne 1 100 0.00 255.0 FORMAT "%5.1" ECU_ADDRESS 0x6000F469 /end MEASUREMENT
/begin MEASUREMENT CrCtl_stUpCC1LG_mp "Flag for indicating the upper limit canc. in CC1 lower gear" UBYTE OneToOne 1 100 0.00 255.0 FORMAT "%5.1" ECU_ADDRESS 0x7000A526 /end MEASUREMENT
/begin MEASUREMENT CrCtl_stUpCC2LG_mp "Flag for indicating the upper limit canc. in CC2 lower gear" UBYTE OneToOne 1 100 0.00 255.0 FORMAT "%5.1" ECU_ADDRESS 0x7000A525 /end MEASUREMENT
/begin MEASUREMENT CrCtl_stUpCC3LG_mp "Flag for indicating the upper limit canc. in CC3 lower gear" UBYTE OneToOne 1 100 0.00 255.0 FORMAT "%5.1" ECU_ADDRESS 0x7000A524 /end MEASUREMENT
/begin MEASUREMENT CrCtl_stUpCC4LG_mp "Flag for indicating the upper limit canc. in CC4 lower gear" UBYTE OneToOne 1 100 0.00 255.0 FORMAT "%5.1" ECU_ADDRESS 0x7000A523 /end MEASUREMENT
/begin MEASUREMENT CrCtl_stUpCC5LG_mp "Flag for indicating the upper limit canc. in CC5 lower gear" UBYTE OneToOne 1 100 0.00 255.0 FORMAT "%5.1" ECU_ADDRESS 0x7000A522 /end MEASUREMENT
/begin MEASUREMENT CrCtl_stUpCC6LG_mp "Flag for indicating the upper limit canc. in CC6 lower gear" UBYTE OneToOne 1 100 0.00 255.0 FORMAT "%5.1" ECU_ADDRESS 0x7000A521 /end MEASUREMENT
/begin MEASUREMENT CrCtl_stUpCCTG_mp "Flag for indicating the upper limit canc. in CC top gear" UBYTE OneToOne 1 100 0.00 255.0 FORMAT "%5.1" ECU_ADDRESS 0x7000A520 /end MEASUREMENT
/begin MEASUREMENT CrCtl_stVehCalOK_mp "Status of cruise control vehicle speed caluculation OK condition" UBYTE OneToOne 1 100 0.00 255.0 FORMAT "%5.1" ECU_ADDRESS 0x7000A70E /end MEASUREMENT
/begin MEASUREMENT CrCtl_stVehSpdAreaNoOld_mp "Previous status for Control Area Mode No." UBYTE OneToOne 1 100 0.00 255.0 FORMAT "%5.1" ECU_ADDRESS 0x7000A51F /end MEASUREMENT
/begin MEASUREMENT CrCtl_stVehSpdAreaNo_mp "Status for Control Area Mode No." UBYTE OneToOne 1 100 0.00 255.0 FORMAT "%5.1" ECU_ADDRESS 0x7000A51E /end MEASUREMENT
/begin MEASUREMENT CrCtl_tiACCAPrelErr_mp "Timer of ACCA communication preliminary error" SWORD Time_ms 1 100 -327680.0 327670.0 FORMAT "%8.1" ECU_ADDRESS 0x7000A70C /end MEASUREMENT
/begin MEASUREMENT CrCtl_tiACCBPrelErr_mp "Timer of ACCB communication preliminary error" SWORD Time_ms 1 100 -327680.0 327670.0 FORMAT "%8.1" ECU_ADDRESS 0x7000A70A /end MEASUREMENT
/begin MEASUREMENT CrCtl_tiACCBrkHold_mp "Timer of ACC Brake Hold check" SWORD Time_ms 1 100 -327680.0 327670.0 FORMAT "%8.1" ECU_ADDRESS 0x7000A708 /end MEASUREMENT
/begin MEASUREMENT CrCtl_tiACCBrk_mp "Timer of ACC Brake detection check" SWORD Time_ms 1 100 -327680.0 327670.0 FORMAT "%8.1" ECU_ADDRESS 0x7000A706 /end MEASUREMENT
/begin MEASUREMENT CrCtl_tiACCChngRes_mp "Timer for Resume to ACC Change Gear for setpoint speed change check time" SWORD Time_ms 1 100 -327680.0 327670.0 FORMAT "%8.1" ECU_ADDRESS 0x7000A51C /end MEASUREMENT
/begin MEASUREMENT CrCtl_tiACCFail_mp "Timer of ACC Fail detection check" SWORD Time_ms 1 100 -327680.0 327670.0 FORMAT "%8.1" ECU_ADDRESS 0x7000A704 /end MEASUREMENT
/begin MEASUREMENT CrCtl_tiACCInfo "time to ACC information check" SWORD Time_ms 1 100 0.00 327670.0 FORMAT "%8.1" ECU_ADDRESS 0x60009216 /end MEASUREMENT
/begin MEASUREMENT CrCtl_tiACCMode_mp "Timer of ACC Mode detection check" SWORD Time_ms 1 100 -327680.0 327670.0 FORMAT "%8.1" ECU_ADDRESS 0x7000A702 /end MEASUREMENT
/begin MEASUREMENT CrCtl_tiAccnDR1UpSlp_mp "Judgement timer for DR1 acceleration at CC up slope DR1 acceleration judgement timer for CC up slope" SWORD Time_ms_100ms 1 100 -3276800. 3276700. FORMAT "%8.0" ECU_ADDRESS 0x7000A51A /end MEASUREMENT
/begin MEASUREMENT CrCtl_tiAccnDR2UpSlp_mp "Judgement timer for DR1 acceleration at CC up slope DR2 acceleration judgement timer for CC up slope" SWORD Time_ms_100ms 1 100 -3276800. 3276700. FORMAT "%8.0" ECU_ADDRESS 0x7000A518 /end MEASUREMENT
/begin MEASUREMENT CrCtl_tiAccnDR3UpSlp_mp "Judgement timer for DR1 acceleration at CC up slope DR3 acceleration judgement timer for CC up slope" SWORD Time_ms_100ms 1 100 -3276800. 3276700. FORMAT "%8.0" ECU_ADDRESS 0x7000A516 /end MEASUREMENT
/begin MEASUREMENT CrCtl_tiAccnDR4UpSlp_mp "Judgement timer for DR4 acceleration at CC up slope\ DR4 acceleration judgement timer for CC up slope" SWORD Time_ms_100ms 1 100 -3276800. 3276700. FORMAT "%8.0" ECU_ADDRESS 0x7000A514 /end MEASUREMENT
/begin MEASUREMENT CrCtl_tiAccnDR5UpSlp_mp "Judgement timer for DR5 acceleration at CC up slope\ DR5 acceleration judgement timer for CC up slope" SWORD Time_ms_100ms 1 100 -3276800. 3276700. FORMAT "%8.0" ECU_ADDRESS 0x7000A512 /end MEASUREMENT
/begin MEASUREMENT CrCtl_tiAccnDR6UpSlp_mp "Judgement timer for DR6 acceleration at CC up slope\ DR6 acceleration judgement timer for CC up slope" SWORD Time_ms_100ms 1 100 -3276800. 3276700. FORMAT "%8.0" ECU_ADDRESS 0x7000A510 /end MEASUREMENT
/begin MEASUREMENT CrCtl_tiAccnDR7UpSlp_mp "Judgement timer for DR7 acceleration at CC up slope\ DR7 acceleration judgement timer for CC up slope" SWORD Time_ms_100ms 1 100 -3276800. 3276700. FORMAT "%8.0" ECU_ADDRESS 0x7000A50E /end MEASUREMENT
/begin MEASUREMENT CrCtl_tiAutoBrkHold "time to auto brake condition hold check" SWORD Time_ms 1 100 0.00 327670.0 FORMAT "%8.1" ECU_ADDRESS 0x60009214 /end MEASUREMENT
/begin MEASUREMENT CrCtl_tiCC1LGMaxRat_mp "CC1 lower gear max. opening stick timer" SWORD Time_ms_100ms 1 100 -3276800. 3276700. FORMAT "%8.0" ECU_ADDRESS 0x7000A50C /end MEASUREMENT
/begin MEASUREMENT CrCtl_tiCC2LGMaxRat_mp "CC2 lower gear max. opening stick timer" SWORD Time_ms_100ms 1 100 -3276800. 3276700. FORMAT "%8.0" ECU_ADDRESS 0x7000A50A /end MEASUREMENT
/begin MEASUREMENT CrCtl_tiCC3LGMaxRat_mp "CC3 lower gear max. opening stick timer" SWORD Time_ms_100ms 1 100 -3276800. 3276700. FORMAT "%8.0" ECU_ADDRESS 0x7000A508 /end MEASUREMENT
/begin MEASUREMENT CrCtl_tiCC4LGMaxRat_mp "CC4 lower gear max. opening stick timer" SWORD Time_ms_100ms 1 100 -3276800. 3276700. FORMAT "%8.0" ECU_ADDRESS 0x7000A506 /end MEASUREMENT
/begin MEASUREMENT CrCtl_tiCC5LGMaxRat_mp "CC5 lower gear max. opening stick timer" SWORD Time_ms_100ms 1 100 -3276800. 3276700. FORMAT "%8.0" ECU_ADDRESS 0x7000A504 /end MEASUREMENT
/begin MEASUREMENT CrCtl_tiCC6LGMaxRat_mp "CC6 lower gear max. opening stick timer" SWORD Time_ms_100ms 1 100 -3276800. 3276700. FORMAT "%8.0" ECU_ADDRESS 0x7000A502 /end MEASUREMENT
/begin MEASUREMENT CrCtl_tiCCMaxRat_mp "CC max. opening stick timer" SWORD Time_ms_100ms 1 100 -3276800. 3276700. FORMAT "%8.0" ECU_ADDRESS 0x7000A500 /end MEASUREMENT
/begin MEASUREMENT CrCtl_tiCCTGMaxRat_mp "CC top gear max. opening stick timer" SWORD Time_ms_100ms 1 100 -3276800. 3276700. FORMAT "%8.0" ECU_ADDRESS 0x7000A4FE /end MEASUREMENT
/begin MEASUREMENT CrCtl_tiClthOnContChng_mp "Timer for Clutch On NE F/B control change check time" SWORD Time_ms 1 100 -327680.0 327670.0 FORMAT "%8.1" ECU_ADDRESS 0x7000A4FC /end MEASUREMENT
/begin MEASUREMENT CrCtl_tiContInhib "Cruise control inhibit time" SWORD Time_ms 1 100 -327680.0 327670.0 FORMAT "%8.1" ECU_ADDRESS 0x60009212 /end MEASUREMENT
/begin MEASUREMENT CrCtl_tiDisAPPInc_mp "Timer for disabling the increase in reqtd. acc. pedal opening after deciding CC_DR" SWORD Time_ms_100ms 1 100 -3276800. 3276700. FORMAT "%8.0" ECU_ADDRESS 0x7000A4FA /end MEASUREMENT
/begin MEASUREMENT CrCtl_tiDR1CnclHold_mp "DR1 cancel hold timer for CC up-slope" SWORD Time_ms_100ms 1 100 -3276800. 3276700. FORMAT "%8.0" ECU_ADDRESS 0x7000A4F8 /end MEASUREMENT
/begin MEASUREMENT CrCtl_tiDR1CnclMskDwnSlp_mp "DR1 cancellation judgement mask timer at CC down slope" SWORD Time_ms_100ms 1 100 -3276800. 3276700. FORMAT "%8.0" ECU_ADDRESS 0x7000A4F6 /end MEASUREMENT
/begin MEASUREMENT CrCtl_tiDR1CnclUpSlp_mp "DR1 cancel judgement timer for CC up slope" SWORD Time_ms_100ms 1 100 -3276800. 3276700. FORMAT "%8.0" ECU_ADDRESS 0x7000A4F4 /end MEASUREMENT
/begin MEASUREMENT CrCtl_tiDR2CnclHold_mp "DR2 cancel hold timer for CC up-slope" SWORD Time_ms_100ms 1 100 -3276800. 3276700. FORMAT "%8.0" ECU_ADDRESS 0x7000A4F2 /end MEASUREMENT
/begin MEASUREMENT CrCtl_tiDR2CnclMskDwnSlp_mp "DR2 cancellation judgement mask timer at CC down slope" SWORD Time_ms_100ms 1 100 -3276800. 3276700. FORMAT "%8.0" ECU_ADDRESS 0x7000A4F0 /end MEASUREMENT
/begin MEASUREMENT CrCtl_tiDR2CnclUpSlp_mp "DR2 cancel judgement timer for CC up slope" SWORD Time_ms_100ms 1 100 -3276800. 3276700. FORMAT "%8.0" ECU_ADDRESS 0x7000A4EE /end MEASUREMENT
/begin MEASUREMENT CrCtl_tiDR3CnclHold_mp "DR3 cancel hold timer for CC up-slope" SWORD Time_ms_100ms 1 100 -3276800. 3276700. FORMAT "%8.0" ECU_ADDRESS 0x7000A4EC /end MEASUREMENT
/begin MEASUREMENT CrCtl_tiDR3CnclMskDwnSlp_mp "DR3 cancellation judgement mask timer at CC down slope" SWORD Time_ms_100ms 1 100 -3276800. 3276700. FORMAT "%8.0" ECU_ADDRESS 0x7000A4EA /end MEASUREMENT
/begin MEASUREMENT CrCtl_tiDR3CnclUpSlp_mp "DR3 cancel judgement timer for CC up slope" SWORD Time_ms_100ms 1 100 -3276800. 3276700. FORMAT "%8.0" ECU_ADDRESS 0x7000A4E8 /end MEASUREMENT
/begin MEASUREMENT CrCtl_tiDR4CnclHold_mp "DR4 cancel hold timer for CC up-slope" SWORD Time_ms_100ms 1 100 -3276800. 3276700. FORMAT "%8.0" ECU_ADDRESS 0x7000A4E6 /end MEASUREMENT
/begin MEASUREMENT CrCtl_tiDR4CnclMskDwnSlp_mp "DR4 cancellation judgement timer at CC down slope" SWORD Time_ms_100ms 1 100 -3276800. 3276700. FORMAT "%8.0" ECU_ADDRESS 0x7000A4E4 /end MEASUREMENT
/begin MEASUREMENT CrCtl_tiDR4CnclUpSlp_mp "DR4 cancel judgement timer for CC up slope" SWORD Time_ms_100ms 1 100 -3276800. 3276700. FORMAT "%8.0" ECU_ADDRESS 0x7000A4E2 /end MEASUREMENT
/begin MEASUREMENT CrCtl_tiDR5CnclHold_mp "DR5 cancel hold timer for CC up-slope" SWORD Time_ms_100ms 1 100 -3276800. 3276700. FORMAT "%8.0" ECU_ADDRESS 0x7000A4E0 /end MEASUREMENT
/begin MEASUREMENT CrCtl_tiDR5CnclMskDwnSlp_mp "DR5 cancellation judgement timer at CC down slope" SWORD Time_ms_100ms 1 100 -3276800. 3276700. FORMAT "%8.0" ECU_ADDRESS 0x7000A4DE /end MEASUREMENT
/begin MEASUREMENT CrCtl_tiDR5CnclUpSlp_mp "DR5 cancel judgement timer for CC up slope" SWORD Time_ms_100ms 1 100 -3276800. 3276700. FORMAT "%8.0" ECU_ADDRESS 0x7000A4DC /end MEASUREMENT
/begin MEASUREMENT CrCtl_tiDR6CnclHold_mp "DR6 cancel hold timer for CC up-slope" SWORD Time_ms_100ms 1 100 -3276800. 3276700. FORMAT "%8.0" ECU_ADDRESS 0x7000A4DA /end MEASUREMENT
/begin MEASUREMENT CrCtl_tiDR6CnclMskDwnSlp_mp "DR6 cancellation judgement timer at CC down slope" SWORD Time_ms_100ms 1 100 -3276800. 3276700. FORMAT "%8.0" ECU_ADDRESS 0x7000A4D8 /end MEASUREMENT
/begin MEASUREMENT CrCtl_tiDR6CnclUpSlp_mp "DR6 cancel judgement timer for CC up slope" SWORD Time_ms_100ms 1 100 -3276800. 3276700. FORMAT "%8.0" ECU_ADDRESS 0x7000A4D6 /end MEASUREMENT
/begin MEASUREMENT CrCtl_tiDR7CnclHold_mp "DR7 cancel hold timer for CC up-slope" SWORD Time_ms_100ms 1 100 -3276800. 3276700. FORMAT "%8.0" ECU_ADDRESS 0x7000A4D4 /end MEASUREMENT
/begin MEASUREMENT CrCtl_tiDR7CnclMskDwnSlp_mp "DR7 cancellation judgement timer at CC down slope" SWORD Time_ms_100ms 1 100 -3276800. 3276700. FORMAT "%8.0" ECU_ADDRESS 0x7000A4D2 /end MEASUREMENT
/begin MEASUREMENT CrCtl_tiDR7CnclUpSlp_mp "DR7 cancel judgement timer for CC up slope" SWORD Time_ms_100ms 1 100 -3276800. 3276700. FORMAT "%8.0" ECU_ADDRESS 0x7000A4D0 /end MEASUREMENT
/begin MEASUREMENT CrCtl_tiDRAccnControl_mp "Timer for switching the DR judgement accl.at CC accl. control" SWORD Time_ms_100ms 1 100 -3276800. 3276700. FORMAT "%8.0" ECU_ADDRESS 0x7000A4CE /end MEASUREMENT
/begin MEASUREMENT CrCtl_tiDRCnclPROSMADisbl_mp "POROSMA disable timer for CC down slope cancellation." SWORD Time_ms_100ms 1 100 -3276800. 3276700. FORMAT "%8.0" ECU_ADDRESS 0x7000A4CC /end MEASUREMENT
/begin MEASUREMENT CrCtl_tiDRMskACCEL_mp "Mask timer for DR judgement at CC_ACCEL" SWORD Time_ms_100ms 1 100 -3276800. 3276700. FORMAT "%8.0" ECU_ADDRESS 0x7000A4CA /end MEASUREMENT
/begin MEASUREMENT CrCtl_tiDRMskCoast_mp "DR judgement mask timer at CC Coasting" SWORD Time_ms_100ms 1 100 -3276800. 3276700. FORMAT "%8.0" ECU_ADDRESS 0x7000A4C8 /end MEASUREMENT
/begin MEASUREMENT CrCtl_tiDwnReqDisbl_mp "DR disable timer at start of CC Control" SWORD Time_ms_100ms 1 100 -3276800. 3276700. FORMAT "%8.0" ECU_ADDRESS 0x7000A4C6 /end MEASUREMENT
/begin MEASUREMENT CrCtl_tiECAppContns1_mp "Timer for checking continuous APP limitation of shift1 for ECON" SWORD Time_ms_100ms 1 100 -3276800. 3276700. FORMAT "%8.0" ECU_ADDRESS 0x7000A4C4 /end MEASUREMENT
/begin MEASUREMENT CrCtl_tiECAppContns2_mp "Timer for checking continuous APP limitation of shift2 for ECON" SWORD Time_ms_100ms 1 100 -3276800. 3276700. FORMAT "%8.0" ECU_ADDRESS 0x7000A4C2 /end MEASUREMENT
/begin MEASUREMENT CrCtl_tiECAppContns3_mp "Timer for checking continuous APP limitation of shift3 for ECON" SWORD Time_ms_100ms 1 100 -3276800. 3276700. FORMAT "%8.0" ECU_ADDRESS 0x7000A4C0 /end MEASUREMENT
/begin MEASUREMENT CrCtl_tiECAppContns4_mp "Timer for checking continuous APP limitation of shift4 for ECON" SWORD Time_ms_100ms 1 100 -3276800. 3276700. FORMAT "%8.0" ECU_ADDRESS 0x7000A4BE /end MEASUREMENT
/begin MEASUREMENT CrCtl_tiECMaskAUp2_mp "Mask timer for changing APP limitation number for ECON to 2 from 1 (for Acceleration)" SWORD Time_ms_100ms 1 100 -3276800. 3276700. FORMAT "%8.0" ECU_ADDRESS 0x7000A4BC /end MEASUREMENT
/begin MEASUREMENT CrCtl_tiECMaskAUp3_mp "Mask timer for changing APP limitation number for ECON to 3 from 2 (for Acceleration)" SWORD Time_ms_100ms 1 100 -3276800. 3276700. FORMAT "%8.0" ECU_ADDRESS 0x7000A4BA /end MEASUREMENT
/begin MEASUREMENT CrCtl_tiECMaskAUp4_mp "Mask timer for changing APP limitation number for ECON to 4 from 3 (for Acceleration)" SWORD Time_ms_100ms 1 100 -3276800. 3276700. FORMAT "%8.0" ECU_ADDRESS 0x7000A4B8 /end MEASUREMENT
/begin MEASUREMENT CrCtl_tiECMaskAUp5_mp "Mask timer for changing APP limitation number for ECON to 5 from 4 (for Acceleration)" SWORD Time_ms_100ms 1 100 -3276800. 3276700. FORMAT "%8.0" ECU_ADDRESS 0x7000A4B6 /end MEASUREMENT
/begin MEASUREMENT CrCtl_tiECMaskDwn1_mp "Mask timer for changing APP limitation number for ECON to 1 from 2" SWORD Time_ms_100ms 1 100 -3276800. 3276700. FORMAT "%8.0" ECU_ADDRESS 0x7000A4B4 /end MEASUREMENT
/begin MEASUREMENT CrCtl_tiECMaskDwn2_mp "Mask timer for changing APP limitation number for ECON to 2 from 3" SWORD Time_ms_100ms 1 100 -3276800. 3276700. FORMAT "%8.0" ECU_ADDRESS 0x7000A4B2 /end MEASUREMENT
/begin MEASUREMENT CrCtl_tiECMaskDwn3_mp "Mask timer for changing APP limitation number for ECON to 3 from 4" SWORD Time_ms_100ms 1 100 -3276800. 3276700. FORMAT "%8.0" ECU_ADDRESS 0x7000A4B0 /end MEASUREMENT
/begin MEASUREMENT CrCtl_tiECMaskDwn4_mp "Mask timer for changing APP limitation number for ECON to 4 from 5" SWORD Time_ms_100ms 1 100 -3276800. 3276700. FORMAT "%8.0" ECU_ADDRESS 0x7000A4AE /end MEASUREMENT
/begin MEASUREMENT CrCtl_tiErrChkExtn_mp "Timer of Cruise control error check extend" SWORD Time_ms 1 100 -327680.0 327670.0 FORMAT "%8.1" ECU_ADDRESS 0x7000A4AC /end MEASUREMENT
/begin MEASUREMENT CrCtl_tiEstSlpCalcStp_mp "Timer of Estimation Slope calculation stop check" SWORD Time_ms_100ms 1 100 -3276800. 3276700. FORMAT "%8.0" ECU_ADDRESS 0x7000A700 /end MEASUREMENT
/begin MEASUREMENT CrCtl_tiExtCont_mp "Timer of Extend Cruise Control check time" SWORD Time_ms 1 100 -327680.0 327670.0 FORMAT "%8.1" ECU_ADDRESS 0x7000A4AA /end MEASUREMENT
/begin MEASUREMENT CrCtl_tiFltVarChk_mp "Timer of Filter Vehicle speed variant check time" SWORD Time_ms_100ms 1 100 -3276800. 3276700. FORMAT "%8.0" ECU_ADDRESS 0x7000A6FE /end MEASUREMENT
/begin MEASUREMENT CrCtl_tiGuidDisp "Guide Display time" SWORD Time_ms 1 100 0.00 327670.0 FORMAT "%8.1" ECU_ADDRESS 0x60009210 /end MEASUREMENT
/begin MEASUREMENT CrCtl_tiIDASAExsJdg_mp "Timer of Excessive judgment in acceleration under IDAS control" SWORD Time_ms 1 100 -327680.0 327670.0 FORMAT "%8.1" ECU_ADDRESS 0x7000A6FC /end MEASUREMENT
/begin MEASUREMENT CrCtl_tiIdasbErr_mp "." SWORD Time_ms 1 100 -327680.0 327670.0 FORMAT "%8.1" ECU_ADDRESS 0x7000A6FA /end MEASUREMENT
/begin MEASUREMENT CrCtl_tiIDASFailARels_mp "Timer of acceleration fail release under IDAS control" SWORD Time_ms 1 100 -327680.0 327670.0 FORMAT "%8.1" ECU_ADDRESS 0x7000A6F8 /end MEASUREMENT
/begin MEASUREMENT CrCtl_tiIGNOnVeh "Timer of IGN ON" SWORD Time_ms 1 100 -327680.0 327670.0 FORMAT "%8.1" ECU_ADDRESS 0x6000920E /end MEASUREMENT
/begin MEASUREMENT CrCtl_tiMemSpdErrChk_mp "Timer of Memory Speed error check" SWORD Time_ms 1 100 -327680.0 327670.0 FORMAT "%8.1" ECU_ADDRESS 0x7000A6F6 /end MEASUREMENT
/begin MEASUREMENT CrCtl_tiMETVarChk_mp "Timer of Meter speed variant check time" SWORD Time_ms_100ms 1 100 -3276800. 3276700. FORMAT "%8.0" ECU_ADDRESS 0x7000A6F4 /end MEASUREMENT
/begin MEASUREMENT CrCtl_tiMskDR1UpSlp_mp "Mask timer for DR1 judgement at CC upslope" SWORD Time_ms_100ms 1 100 -3276800. 3276700. FORMAT "%8.0" ECU_ADDRESS 0x7000A4A8 /end MEASUREMENT
/begin MEASUREMENT CrCtl_tiMskDR2DwnSlp_mp "Mask timer for DR2 judgement at CC down slope" SWORD Time_ms_100ms 1 100 -3276800. 3276700. FORMAT "%8.0" ECU_ADDRESS 0x7000A4A6 /end MEASUREMENT
/begin MEASUREMENT CrCtl_tiMskDR2UpSlp_mp "Mask timer for DR2 judgement at CC upslope" SWORD Time_ms_100ms 1 100 -3276800. 3276700. FORMAT "%8.0" ECU_ADDRESS 0x7000A4A4 /end MEASUREMENT
/begin MEASUREMENT CrCtl_tiMskDR3DwnSlp_mp "Mask timer for DR3 judgement at CC down slope" SWORD Time_ms_100ms 1 100 -3276800. 3276700. FORMAT "%8.0" ECU_ADDRESS 0x7000A4A2 /end MEASUREMENT
/begin MEASUREMENT CrCtl_tiMskDR3UpSlp_mp "Mask timer for DR3 judgement at CC upslope" SWORD Time_ms_100ms 1 100 -3276800. 3276700. FORMAT "%8.0" ECU_ADDRESS 0x7000A4A0 /end MEASUREMENT
/begin MEASUREMENT CrCtl_tiMskDR4DwnSlp_mp "Mask timer for DR4 judgement at CC down slope" SWORD Time_ms_100ms 1 100 -3276800. 3276700. FORMAT "%8.0" ECU_ADDRESS 0x7000A49E /end MEASUREMENT
/begin MEASUREMENT CrCtl_tiMskDR4UpSlp_mp "Mask timer for DR4 judgement at CC upslope" SWORD Time_ms_100ms 1 100 -3276800. 3276700. FORMAT "%8.0" ECU_ADDRESS 0x7000A49C /end MEASUREMENT
/begin MEASUREMENT CrCtl_tiMskDR5DwnSlp_mp "Mask timer for DR5 judgement at CC down slope" SWORD Time_ms_100ms 1 100 -3276800. 3276700. FORMAT "%8.0" ECU_ADDRESS 0x7000A49A /end MEASUREMENT
/begin MEASUREMENT CrCtl_tiMskDR5UpSlp_mp "Mask timer for DR5 judgement at CC upslope" SWORD Time_ms_100ms 1 100 -3276800. 3276700. FORMAT "%8.0" ECU_ADDRESS 0x7000A498 /end MEASUREMENT
/begin MEASUREMENT CrCtl_tiMskDR6DwnSlp_mp "Mask timer for DR6 judgement at CC down slope" SWORD Time_ms_100ms 1 100 -3276800. 3276700. FORMAT "%8.0" ECU_ADDRESS 0x7000A496 /end MEASUREMENT
/begin MEASUREMENT CrCtl_tiMskDR6UpSlp_mp "Mask timer for DR6 judgement at CC upslope" SWORD Time_ms_100ms 1 100 -3276800. 3276700. FORMAT "%8.0" ECU_ADDRESS 0x7000A494 /end MEASUREMENT
/begin MEASUREMENT CrCtl_tiMskDR7DwnSlp_mp "Mask timer for DR7 judgement at CC down slope" SWORD Time_ms_100ms 1 100 -3276800. 3276700. FORMAT "%8.0" ECU_ADDRESS 0x7000A492 /end MEASUREMENT
/begin MEASUREMENT CrCtl_tiMskDR7UpSlp_mp "Mask timer for DR7 judgement at CC upslope" SWORD Time_ms_100ms 1 100 -3276800. 3276700. FORMAT "%8.0" ECU_ADDRESS 0x7000A490 /end MEASUREMENT
/begin MEASUREMENT CrCtl_tiMskDRDwnSlp_mp "DR mask timer at CC down slope" SWORD Time_ms_100ms 1 100 -3276800. 3276700. FORMAT "%8.0" ECU_ADDRESS 0x7000A48E /end MEASUREMENT
/begin MEASUREMENT CrCtl_tiRePermSet_mp "Timer of RePermit set check" SWORD Time_ms 1 100 -327680.0 327670.0 FORMAT "%8.1" ECU_ADDRESS 0x7000A6F2 /end MEASUREMENT
/begin MEASUREMENT CrCtl_tiSpdCnclMskDR2DR1_mp "DR2/DR1 speed cancel timer for CC down slope" SWORD Time_ms_100ms 1 100 -3276800. 3276700. FORMAT "%8.0" ECU_ADDRESS 0x7000A48C /end MEASUREMENT
/begin MEASUREMENT CrCtl_tiSpdCnclMskDR3DR2_mp "DR3/DR2 speed cancel mask timer for CC down slope" SWORD Time_ms_100ms 1 100 -3276800. 3276700. FORMAT "%8.0" ECU_ADDRESS 0x7000A48A /end MEASUREMENT
/begin MEASUREMENT CrCtl_tiSpdCnclMskDR4DR3_mp "DR4\DR3 speed cancel timer for CC down slope" SWORD Time_ms_100ms 1 100 -3276800. 3276700. FORMAT "%8.0" ECU_ADDRESS 0x7000A488 /end MEASUREMENT
/begin MEASUREMENT CrCtl_tiSpdCnclMskDR5DR4_mp "DR5\DR4 speed cancel timer for CC down slope" SWORD Time_ms_100ms 1 100 -3276800. 3276700. FORMAT "%8.0" ECU_ADDRESS 0x7000A486 /end MEASUREMENT
/begin MEASUREMENT CrCtl_tiSpdCnclMskDR6DR5_mp "DR6\DR5 speed cancel timer for CC down slope" SWORD Time_ms_100ms 1 100 -3276800. 3276700. FORMAT "%8.0" ECU_ADDRESS 0x7000A484 /end MEASUREMENT
/begin MEASUREMENT CrCtl_tiSpdCnclMskDR7DR6_mp "DR7\DR6 speed cancel timer for CC down slope" SWORD Time_ms_100ms 1 100 -3276800. 3276700. FORMAT "%8.0" ECU_ADDRESS 0x7000A482 /end MEASUREMENT
/begin MEASUREMENT CrCtl_tiTaskCont_mp "Timer of Task Control check" SWORD Time_ms 1 100 -327680.0 327670.0 FORMAT "%8.1" ECU_ADDRESS 0x7000A6F0 /end MEASUREMENT
/begin MEASUREMENT CrCtl_tiVehNoiseDet_mp "Timer of vehicle speed Noise detection" SWORD Time_ms 1 100 -327680.0 327670.0 FORMAT "%8.1" ECU_ADDRESS 0x7000A6EE /end MEASUREMENT
/begin MEASUREMENT CrCtl_tiWaitReqDR0DR1_mp "Timer to wait DR1 request after DR0 request" SWORD Time_ms 1 100 -327680.0 327670.0 FORMAT "%8.1" ECU_ADDRESS 0x7000A480 /end MEASUREMENT
/begin MEASUREMENT CrCtl_tiWaitReqDR1DR0_mp "Timer to wait DR0 request after DR1 request" SWORD Time_ms 1 100 -327680.0 327670.0 FORMAT "%8.1" ECU_ADDRESS 0x7000A47E /end MEASUREMENT
/begin MEASUREMENT CrCtl_tiWaitReqDR1DR2_mp "Timer to wait DR2 request after DR1 request" SWORD Time_ms 1 100 -327680.0 327670.0 FORMAT "%8.1" ECU_ADDRESS 0x7000A47C /end MEASUREMENT
/begin MEASUREMENT CrCtl_tiWaitReqDR2DR1_mp "Timer to wait DR1 request after DR2 request" SWORD Time_ms 1 100 -327680.0 327670.0 FORMAT "%8.1" ECU_ADDRESS 0x7000A47A /end MEASUREMENT
/begin MEASUREMENT CrCtl_tiWaitReqDR2DR3_mp "Timer to wait DR3 request after DR2 request" SWORD Time_ms 1 100 -327680.0 327670.0 FORMAT "%8.1" ECU_ADDRESS 0x7000A478 /end MEASUREMENT
/begin MEASUREMENT CrCtl_tiWaitReqDR3DR2_mp "Timer to wait DR2 request after DR3 request" SWORD Time_ms 1 100 -327680.0 327670.0 FORMAT "%8.1" ECU_ADDRESS 0x7000A476 /end MEASUREMENT
/begin MEASUREMENT CrCtl_tiWaitReqDR3DR4_mp "Timer to wait DR2 request after DR3 request" SWORD Time_ms 1 100 -327680.0 327670.0 FORMAT "%8.1" ECU_ADDRESS 0x7000A474 /end MEASUREMENT
/begin MEASUREMENT CrCtl_tiWaitReqDR4DR3_mp "Timer to wait DR3 request after DR4 request" SWORD Time_ms 1 100 -327680.0 327670.0 FORMAT "%8.1" ECU_ADDRESS 0x7000A472 /end MEASUREMENT
/begin MEASUREMENT CrCtl_tiWaitReqDR4DR5_mp "Timer to wait DR5 request after DR4 request" SWORD Time_ms 1 100 -327680.0 327670.0 FORMAT "%8.1" ECU_ADDRESS 0x7000A470 /end MEASUREMENT
/begin MEASUREMENT CrCtl_tiWaitReqDR5DR4_mp "Timer to wait DR4 request after DR5 request" SWORD Time_ms 1 100 -327680.0 327670.0 FORMAT "%8.1" ECU_ADDRESS 0x7000A46E /end MEASUREMENT
/begin MEASUREMENT CrCtl_tiWaitReqDR5DR6_mp "Timer to wait DR6 request after DR5 request" SWORD Time_ms 1 100 -327680.0 327670.0 FORMAT "%8.1" ECU_ADDRESS 0x7000A46C /end MEASUREMENT
/begin MEASUREMENT CrCtl_tiWaitReqDR6DR5_mp "Timer to wait DR5 request after DR6 request" SWORD Time_ms 1 100 -327680.0 327670.0 FORMAT "%8.1" ECU_ADDRESS 0x7000A46A /end MEASUREMENT
/begin MEASUREMENT CrCtl_tiWaitReqDR6DR7_mp "Timer to wait DR7 request after DR6 request" SWORD Time_ms 1 100 -327680.0 327670.0 FORMAT "%8.1" ECU_ADDRESS 0x7000A468 /end MEASUREMENT
/begin MEASUREMENT CrCtl_tqCluFild "Cluth torque after filtering" SWORD Trq 1 100 -3276.800 3276.700 FORMAT "%8.3" ECU_ADDRESS 0x6000920C /end MEASUREMENT
/begin MEASUREMENT CrCtl_trqEng_mp "Cruise control desired torque" SWORD TrqPrp_CrCtl 1 100 -2048.000 2047.938 FORMAT "%8.3" ECU_ADDRESS 0x7000A6EC /end MEASUREMENT
/begin MEASUREMENT CrCtl_vACCAftTapMemSpd_mp "Memory speed of finished Tap Up for ACC" SLONG Vel_CrCtl 1 100 -8388608.00000 8388607.99609 FORMAT "%13.5" ECU_ADDRESS 0x7000A6E8 /end MEASUREMENT
/begin MEASUREMENT CrCtl_vACCAppMemSpdKmh_mp "Accel Memory speed(km/h) for ACC" SWORD Vel_CrCtl1 1 100 -32768.00 32767.00 FORMAT "%8.2" ECU_ADDRESS 0x7000A6E4 /end MEASUREMENT
/begin MEASUREMENT CrCtl_vACCAppMemSpdMPH_mp "Accel Memory speed(MPH) for ACC" SWORD Vel_CrCtl1_MPH 1 100 -32768.00 32767.00 FORMAT "%8.2" ECU_ADDRESS 0x7000A6E2 /end MEASUREMENT
/begin MEASUREMENT CrCtl_vACCCoaMemSpdKmh_mp "Coast Memory speed(km/h) for ACC" SWORD Vel_CrCtl1 1 100 -32768.00 32767.00 FORMAT "%8.2" ECU_ADDRESS 0x7000A6E0 /end MEASUREMENT
/begin MEASUREMENT CrCtl_vACCCoaMemSpdMPH_mp "Coast Memory speed(MPH) for ACC" SWORD Vel_CrCtl1_MPH 1 100 -32768.00 32767.00 FORMAT "%8.2" ECU_ADDRESS 0x7000A6DE /end MEASUREMENT
/begin MEASUREMENT CrCtl_vACCFstAccnDet_mp "ACC First Tap Up acceleration detection value" SLONG Vel_CrCtl 1 100 -8388608.00000 8388607.99609 FORMAT "%13.5" ECU_ADDRESS 0x7000A464 /end MEASUREMENT
/begin MEASUREMENT CrCtl_vACCMemSpd "Memory speed for ACC" SWORD Vel_CrCtl1 1 100 -32768.00 32767.00 FORMAT "%8.2" ECU_ADDRESS 0x6000920A /end MEASUREMENT
/begin MEASUREMENT CrCtl_vACCMemSpdKmh "Memory speed(kmh) for ACC" SWORD Vel_CrCtl1 1 100 -32768.00 32767.00 FORMAT "%8.2" ECU_ADDRESS 0x60009208 /end MEASUREMENT
/begin MEASUREMENT CrCtl_vACCMemSpdMPH "Memory speed(MPH) for ACC" SWORD Vel_CrCtl1_MPH 1 100 -32768.00 32767.00 FORMAT "%8.2" ECU_ADDRESS 0x60009206 /end MEASUREMENT
/begin MEASUREMENT CrCtl_vAccnATCtrl "Accel. For CC_AT cooperative control" SWORD Vel_CrCtl 1 100 -128.0000 127.9961 FORMAT "%8.4" ECU_ADDRESS 0x600091FE /end MEASUREMENT
/begin MEASUREMENT CrCtl_vAccnATCtrlOld_mp "Previoud value for Accel. For CC_AT cooperative control" SWORD Vel_CrCtl 1 100 -128.0000 127.9961 FORMAT "%8.4" ECU_ADDRESS 0x7000A6DC /end MEASUREMENT
/begin MEASUREMENT CrCtl_vAccnDeclErrChk_mp "acceleration/deceleration error check value for ACC/CC" SLONG Vel_CrCtl 1 100 -8388608.00000 8388607.99609 FORMAT "%13.5" ECU_ADDRESS 0x7000A6D8 /end MEASUREMENT
/begin MEASUREMENT CrCtl_vAccnDR1DwnSlp_mp "Acc.for DR1 judgement at CC down slope" SWORD Vel_CrCtl 1 100 -128.0000 127.9961 FORMAT "%8.4" ECU_ADDRESS 0x7000A462 /end MEASUREMENT
/begin MEASUREMENT CrCtl_vAccnDR1UpSlp_mp "Accel. For DR1 judgement at CC upslope" SWORD Vel_CrCtl 1 100 -128.0000 127.9961 FORMAT "%8.4" ECU_ADDRESS 0x7000A460 /end MEASUREMENT
/begin MEASUREMENT CrCtl_vAccnDR2DwnSlp_mp "Acc.for DR2 judgement at CC down slope" SWORD Vel_CrCtl 1 100 -128.0000 127.9961 FORMAT "%8.4" ECU_ADDRESS 0x7000A45E /end MEASUREMENT
/begin MEASUREMENT CrCtl_vAccnDR2UpSlp_mp "Accel. For DR2 judgement at CC upslope" SWORD Vel_CrCtl 1 100 -128.0000 127.9961 FORMAT "%8.4" ECU_ADDRESS 0x7000A45C /end MEASUREMENT
/begin MEASUREMENT CrCtl_vAccnDR3DwnSlp_mp "CrCtl_vAccnDR3DwnSlp_mp" SWORD Vel_CrCtl 1 100 -128.0000 127.9961 FORMAT "%8.4" ECU_ADDRESS 0x7000A45A /end MEASUREMENT
/begin MEASUREMENT CrCtl_vAccnDR3UpSlp_mp "CrCtl_vAccnDR3UpSlp_mp" SWORD Vel_CrCtl 1 100 -128.0000 127.9961 FORMAT "%8.4" ECU_ADDRESS 0x7000A458 /end MEASUREMENT
/begin MEASUREMENT CrCtl_vAccnDR4DwnSlp_mp "Accel.for DR4 judgement at CC down slope" SWORD Vel_CrCtl 1 100 -128.0000 127.9961 FORMAT "%8.4" ECU_ADDRESS 0x7000A456 /end MEASUREMENT
/begin MEASUREMENT CrCtl_vAccnDR4UpSlp_mp "Accel. For DR4 judgement at CC upslope" SWORD Vel_CrCtl 1 100 -128.0000 127.9961 FORMAT "%8.4" ECU_ADDRESS 0x7000A454 /end MEASUREMENT
/begin MEASUREMENT CrCtl_vAccnDR5DwnSlp_mp "Accel.for DR5 judgement at CC down slope" SWORD Vel_CrCtl 1 100 -128.0000 127.9961 FORMAT "%8.4" ECU_ADDRESS 0x7000A452 /end MEASUREMENT
/begin MEASUREMENT CrCtl_vAccnDR5UpSlp_mp "Accel. For DR5 judgement at CC upslope" SWORD Vel_CrCtl 1 100 -128.0000 127.9961 FORMAT "%8.4" ECU_ADDRESS 0x7000A450 /end MEASUREMENT
/begin MEASUREMENT CrCtl_vAccnDR6DwnSlp_mp "Accel.for DR6 judgement at CC down slope" SWORD Vel_CrCtl 1 100 -128.0000 127.9961 FORMAT "%8.4" ECU_ADDRESS 0x7000A44E /end MEASUREMENT
/begin MEASUREMENT CrCtl_vAccnDR6UpSlp_mp "Accel. For DR6 judgement at CC upslope" SWORD Vel_CrCtl 1 100 -128.0000 127.9961 FORMAT "%8.4" ECU_ADDRESS 0x7000A44C /end MEASUREMENT
/begin MEASUREMENT CrCtl_vAccnDR7DwnSlp_mp "Accel.for DR7 judgement at CC down slope" SWORD Vel_CrCtl 1 100 -128.0000 127.9961 FORMAT "%8.4" ECU_ADDRESS 0x7000A44A /end MEASUREMENT
/begin MEASUREMENT CrCtl_vAccnDR7UpSlp_mp "Accel. For DR7 judgement at CC upslope" SWORD Vel_CrCtl 1 100 -128.0000 127.9961 FORMAT "%8.4" ECU_ADDRESS 0x7000A448 /end MEASUREMENT
/begin MEASUREMENT CrCtl_vAccnDvtDR1CnclUpSlp_mp "Deviation in accel for DR1 cancel judgement at CC up slope" SWORD Vel_CrCtl 1 100 -128.0000 127.9961 FORMAT "%8.4" ECU_ADDRESS 0x7000A446 /end MEASUREMENT
/begin MEASUREMENT CrCtl_vAccnDvtDR2CnclUpSlp_mp "Deviation in accel for DR2 cancel judgement at CC up slope" SWORD Vel_CrCtl 1 100 -128.0000 127.9961 FORMAT "%8.4" ECU_ADDRESS 0x7000A444 /end MEASUREMENT
/begin MEASUREMENT CrCtl_vAccnDvtDR3CnclUpSlp_mp "Deviation in accel for DR3 cancel judgement at CC up slope" SWORD Vel_CrCtl 1 100 -128.0000 127.9961 FORMAT "%8.4" ECU_ADDRESS 0x7000A442 /end MEASUREMENT
/begin MEASUREMENT CrCtl_vAccnDvtDR4CnclUpSlp_mp "Deviation in accel for DR4 cancel judgement at CC up slope" SWORD Vel_CrCtl 1 100 -128.0000 127.9961 FORMAT "%8.4" ECU_ADDRESS 0x7000A440 /end MEASUREMENT
/begin MEASUREMENT CrCtl_vAccnDvtDR5CnclUpSlp_mp "Deviation in accel for DR5 cancel judgement at CC up slope" SWORD Vel_CrCtl 1 100 -128.0000 127.9961 FORMAT "%8.4" ECU_ADDRESS 0x7000A43E /end MEASUREMENT
/begin MEASUREMENT CrCtl_vAccnDvtDR6CnclUpSlp_mp "Deviation in accel for DR6 cancel judgement at CC up slope" SWORD Vel_CrCtl 1 100 -128.0000 127.9961 FORMAT "%8.4" ECU_ADDRESS 0x7000A43C /end MEASUREMENT
/begin MEASUREMENT CrCtl_vAccnDvtDR7CnclUpSlp_mp "Deviation in accel for DR7 cancel judgement at CC up slope" SWORD Vel_CrCtl 1 100 -128.0000 127.9961 FORMAT "%8.4" ECU_ADDRESS 0x7000A43A /end MEASUREMENT
/begin MEASUREMENT CrCtl_vAccnFltFltVal "filtered acceleration value of filtered for cruise control" SWORD Vel_CrCtl 1 100 -128.0000 127.9961 FORMAT "%8.4" ECU_ADDRESS 0x600091FC /end MEASUREMENT
/begin MEASUREMENT CrCtl_vAccnFltFltValOld_mp "Old value of filtered acceleration value of filtered for cruise control" SWORD Vel_CrCtl 1 100 -128.0000 127.9961 FORMAT "%8.4" ECU_ADDRESS 0x7000A6D6 /end MEASUREMENT
/begin MEASUREMENT CrCtl_vAccnFltVal "filtered acceleration value for cruise control" SWORD Vel_CrCtl 1 100 -128.0000 127.9961 FORMAT "%8.4" ECU_ADDRESS 0x600091FA /end MEASUREMENT
/begin MEASUREMENT CrCtl_vAccnFltValOld_mp "Old filtered acceleration for cruise control" SWORD Vel_CrCtl 1 100 -128.0000 127.9961 FORMAT "%8.4" ECU_ADDRESS 0x7000A6D4 /end MEASUREMENT
/begin MEASUREMENT CrCtl_vAccnValFlt_mp "calculation of fileterd acceleration value" SWORD Vel_CrCtl 1 100 -128.0000 127.9961 FORMAT "%8.4" ECU_ADDRESS 0x70009EDE /end MEASUREMENT
/begin MEASUREMENT CrCtl_vAccnVal_mp "calculation of acceleration value" SWORD Vel_CrCtl 1 100 -128.0000 127.9961 FORMAT "%8.4" ECU_ADDRESS 0x7000A6D2 /end MEASUREMENT
/begin MEASUREMENT CrCtl_vAccnVar_mp "acceleration variant value" SWORD Vel_CrCtl 1 100 -128.0000 127.9961 FORMAT "%8.4" ECU_ADDRESS 0x7000A438 /end MEASUREMENT
/begin MEASUREMENT CrCtl_vACCRPntHysLo_mp "ACC RP (hysteresis Lo) value" SLONG Vel_CrCtl 1 100 -8388608.00000 8388607.99609 FORMAT "%13.5" ECU_ADDRESS 0x7000A434 /end MEASUREMENT
/begin MEASUREMENT CrCtl_vACCTDStrtMemSpdKmh_mp "Tap Down Start of memory speed(km/h) for ACC" SWORD Vel_CrCtl1 1 100 -32768.00 32767.00 FORMAT "%8.2" ECU_ADDRESS 0x7000A6D0 /end MEASUREMENT
/begin MEASUREMENT CrCtl_vACCTDStrtMemSpdMPH_mp "Tap Down Start of memory speed(MPH) for ACC" SWORD Vel_CrCtl1_MPH 1 100 -32768.00 32767.00 FORMAT "%8.2" ECU_ADDRESS 0x7000A6CE /end MEASUREMENT
/begin MEASUREMENT CrCtl_vACCTrgAccnRedDet_mp "ACC Target acceleration reduce detection value" SLONG Vel_CrCtl 1 100 -8388608.00000 8388607.99609 FORMAT "%13.5" ECU_ADDRESS 0x7000A430 /end MEASUREMENT
/begin MEASUREMENT CrCtl_vACCTUStrtMemSpdKmh_mp "Tap Up Start of memory speed(km/h) for ACC" SWORD Vel_CrCtl1 1 100 -32768.00 32767.00 FORMAT "%8.2" ECU_ADDRESS 0x7000A6CC /end MEASUREMENT
/begin MEASUREMENT CrCtl_vACCTUStrtMemSpdMPH_mp "Tap Up Start of memory speed(MPH) for ACC" SWORD Vel_CrCtl1_MPH 1 100 -32768.00 32767.00 FORMAT "%8.2" ECU_ADDRESS 0x70009EDC /end MEASUREMENT
/begin MEASUREMENT CrCtl_vACCUpSpdHysHi_mp "High limit hysteresis of ACC Upper speed value" SLONG Vel_CrCtl 1 100 -8388608.00000 8388607.99609 FORMAT "%13.5" ECU_ADDRESS 0x70009C38 /end MEASUREMENT
/begin MEASUREMENT CrCtl_vACCUpSpdHysLo_mp "Low limit hysteresis of ACC Upper speed value" SLONG Vel_CrCtl 1 100 -8388608.00000 8388607.99609 FORMAT "%13.5" ECU_ADDRESS 0x7000A6C8 /end MEASUREMENT
/begin MEASUREMENT CrCtl_vASLAcclFltVal "Acceleration value for ASL control" SWORD Vel 1 100 -327.6800 327.6700 FORMAT "%8.4" ECU_ADDRESS 0x60009204 /end MEASUREMENT
/begin MEASUREMENT CrCtl_vASLAcclFltValOld_mp "Old filtered acceleration value for ASL" SWORD Vel 1 100 -327.6800 327.6700 FORMAT "%8.4" ECU_ADDRESS 0x7000A6C6 /end MEASUREMENT
/begin MEASUREMENT CrCtl_vASLAcclVal_mp "Acceleration value for ASL" SWORD Vel 1 100 -327.6800 327.6700 FORMAT "%8.4" ECU_ADDRESS 0x7000A6C4 /end MEASUREMENT
/begin MEASUREMENT CrCtl_vASLSensOld_mp "Old vehicle speed" SWORD Vel 1 100 -327.6800 327.6700 FORMAT "%8.4" ECU_ADDRESS 0x7000A6C2 /end MEASUREMENT
/begin MEASUREMENT CrCtl_vASLVehAftFlt_mp "Vehicle speed the of after filter for ASL" SWORD Vel 1 100 -327.6800 327.6700 FORMAT "%8.4" ECU_ADDRESS 0x7000A6C0 /end MEASUREMENT
/begin MEASUREMENT CrCtl_vASLVehBefUpLim_mp "ASL control vehicle speed (before up limit)" SLONG Vel 1 100 -21474836.4800 21474836.4700 FORMAT "%13.4" ECU_ADDRESS 0x7000A6BC /end MEASUREMENT
/begin MEASUREMENT CrCtl_vASLVehCont "Vehicle speed for ASL control" SWORD Vel 1 100 -327.6800 327.6700 FORMAT "%8.4" ECU_ADDRESS 0x60009202 /end MEASUREMENT
/begin MEASUREMENT CrCtl_vASLVehContOld_mp "Old vehicle speed for ASL control" SWORD Vel 1 100 -327.6800 327.6700 FORMAT "%8.4" ECU_ADDRESS 0x7000A6B8 /end MEASUREMENT
/begin MEASUREMENT CrCtl_vASLVehFlt_mp "Value of filtering vehicle speed for ASL" SLONG Fact_CrCtl1 1 100 -65536.0000000 65535.9999695 FORMAT "%13.7" ECU_ADDRESS 0x7000A6B4 /end MEASUREMENT
/begin MEASUREMENT CrCtl_vAValFild "The changing of vehicle speed after filtering" SWORD Vel_CrCtl 1 100 -128.0000 127.9961 FORMAT "%8.4" ECU_ADDRESS 0x60009200 /end MEASUREMENT
/begin MEASUREMENT CrCtl_vContnsTUDvtHys_mp "Deviation speed for selecting variation of desired vehicle speed for ECON (Continuous TAPUP, Enable hysteresis)" SWORD Vel_CrCtl 1 100 -128.0000 127.9961 FORMAT "%8.4" ECU_ADDRESS 0x7000A42E /end MEASUREMENT
/begin MEASUREMENT CrCtl_vContnsTUDvt_mp "Deviation speed for selecting variation of desired vehicle speed for ECON (Continuous TAPUP, Disable hysteresis)" SWORD Vel_CrCtl 1 100 -128.0000 127.9961 FORMAT "%8.4" ECU_ADDRESS 0x7000A42C /end MEASUREMENT
/begin MEASUREMENT CrCtl_vContTapUpdSpdKmph_mp "Update speed with unit Kmph for continuous Tap Up/Down" SLONG Vel_CrCtl 1 100 -8388608.00000 8388607.99609 FORMAT "%13.5" ECU_ADDRESS 0x7000A6B0 /end MEASUREMENT
/begin MEASUREMENT CrCtl_vContTapUpdSpdMPH_mp "Update speed with unit MPH for continuous Tap Up/Down" SLONG Vel_CrCtl_MPH 1 100 -8388608.00000 8388607.99609 FORMAT "%13.5" ECU_ADDRESS 0x7000A6AC /end MEASUREMENT
/begin MEASUREMENT CrCtl_vDes2Offs_mp "Offset value of 2nd desired vehicle speed" SWORD Vel_CrCtl 1 100 -128.0000 127.9961 FORMAT "%8.4" ECU_ADDRESS 0x7000A42A /end MEASUREMENT
/begin MEASUREMENT CrCtl_vDes2UpByte_mp "Up byte of 2nd desired vehicle speed" SWORD Vel_CrCtl1 1 100 -32768.00 32767.00 FORMAT "%8.2" ECU_ADDRESS 0x7000A428 /end MEASUREMENT
/begin MEASUREMENT CrCtl_vDes2_mp "Desired vehicle speed (2nd)" SLONG Vel_CrCtl 1 100 -8388608.00000 8388607.99609 FORMAT "%13.5" ECU_ADDRESS 0x7000A424 /end MEASUREMENT
/begin MEASUREMENT CrCtl_vDesClthOnStrt_mp "setpoint speed add value for Cruise Control Clutch On Start" SLONG Vel_CrCtl 1 100 -8388608.00000 8388607.99609 FORMAT "%13.5" ECU_ADDRESS 0x7000A420 /end MEASUREMENT
/begin MEASUREMENT CrCtl_vDesOld_mp "Cruise Control setpoint speed Old value" SLONG Vel_CrCtl 1 100 -8388608.00000 8388607.99609 FORMAT "%13.5" ECU_ADDRESS 0x7000A41C /end MEASUREMENT
/begin MEASUREMENT CrCtl_vDesUpByte_mp "Upper byte setpoint speed value for cruise control" SWORD Vel_CrCtl1 1 100 -32768.00 32767.00 FORMAT "%8.2" ECU_ADDRESS 0x7000A41A /end MEASUREMENT
/begin MEASUREMENT CrCtl_vDesVar_mp "setpoint speed variant value" SWORD Vel_CrCtl 1 100 -128.0000 127.9961 FORMAT "%8.4" ECU_ADDRESS 0x7000A418 /end MEASUREMENT
/begin MEASUREMENT CrCtl_vDes_mp "Cruise control desired speed" SLONG Vel_CrCtl 1 100 -8388608.00000 8388607.99609 FORMAT "%13.5" ECU_ADDRESS 0x7000A414 /end MEASUREMENT
/begin MEASUREMENT CrCtl_vDiffAbs_mp "the absolute value of Vehicle speed" SLONG Vel_CrCtl 1 100 -8388608.00000 8388607.99609 FORMAT "%13.5" ECU_ADDRESS 0x7000A6A8 /end MEASUREMENT
/begin MEASUREMENT CrCtl_vDLimHysHi_mp "CC/ACC DL (hysteresis Hi) value" SLONG Vel_CrCtl 1 100 -8388608.00000 8388607.99609 FORMAT "%13.5" ECU_ADDRESS 0x7000A410 /end MEASUREMENT
/begin MEASUREMENT CrCtl_vDLimHysLo_mp "CC/ACC DL (hysteresis Lo) value" SLONG Vel_CrCtl 1 100 -8388608.00000 8388607.99609 FORMAT "%13.5" ECU_ADDRESS 0x7000A40C /end MEASUREMENT
/begin MEASUREMENT CrCtl_vDLim_mp "DL value" SLONG Vel_CrCtl 1 100 -8388608.00000 8388607.99609 FORMAT "%13.5" ECU_ADDRESS 0x7000A408 /end MEASUREMENT
/begin MEASUREMENT CrCtl_vDR1DvtDwnSlp_mp "Deviation in vehicle speed for DR1 judgement at CC down slp" SWORD Vel_CrCtl 1 100 -128.0000 127.9961 FORMAT "%8.4" ECU_ADDRESS 0x7000A406 /end MEASUREMENT
/begin MEASUREMENT CrCtl_vDR2DvtDwnSlp_mp "Deviation in vehicle speed for DR2 judgement at CC down slp" SWORD Vel_CrCtl 1 100 -128.0000 127.9961 FORMAT "%8.4" ECU_ADDRESS 0x7000A404 /end MEASUREMENT
/begin MEASUREMENT CrCtl_vDR3DvtDwnSlp_mp "Deviation in vehicle speed for DR3 judgement at CC down slp" SWORD Vel_CrCtl 1 100 -128.0000 127.9961 FORMAT "%8.4" ECU_ADDRESS 0x7000A402 /end MEASUREMENT
/begin MEASUREMENT CrCtl_vDR4DvtDwnSlp_mp "Deviation in vehicle speed for DR4 judgement at CC down slope" SWORD Vel_CrCtl 1 100 -128.0000 127.9961 FORMAT "%8.4" ECU_ADDRESS 0x7000A400 /end MEASUREMENT
/begin MEASUREMENT CrCtl_vDR5DvtDwnSlp_mp "Deviation in vehicle speed for DR5 judgement at CC down slope" SWORD Vel_CrCtl 1 100 -128.0000 127.9961 FORMAT "%8.4" ECU_ADDRESS 0x7000A3FE /end MEASUREMENT
/begin MEASUREMENT CrCtl_vDR6DvtDwnSlp_mp "Deviation in vehicle speed for DR6 judgement at CC down slope" SWORD Vel_CrCtl 1 100 -128.0000 127.9961 FORMAT "%8.4" ECU_ADDRESS 0x7000A3FC /end MEASUREMENT
/begin MEASUREMENT CrCtl_vDR7DvtDwnSlp_mp "Deviation in vehicle speed for DR7 judgement at CC down slope" SWORD Vel_CrCtl 1 100 -128.0000 127.9961 FORMAT "%8.4" ECU_ADDRESS 0x7000A3FA /end MEASUREMENT
/begin MEASUREMENT CrCtl_vDvtDR1UpSlp_mp "Deviation in accel for DR1 judgement at CC up slope" SWORD Vel_CrCtl 1 100 -128.0000 127.9961 FORMAT "%8.4" ECU_ADDRESS 0x7000A3F8 /end MEASUREMENT
/begin MEASUREMENT CrCtl_vDvtDR2UpSlp_mp "Deviation in accel for DR2 judgement at CC up slope" SWORD Vel_CrCtl 1 100 -128.0000 127.9961 FORMAT "%8.4" ECU_ADDRESS 0x7000A3F6 /end MEASUREMENT
/begin MEASUREMENT CrCtl_vDvtDR3UpSlp_mp "Deviation in accel for DR3 judgement at CC up slope" SWORD Vel_CrCtl 1 100 -128.0000 127.9961 FORMAT "%8.4" ECU_ADDRESS 0x7000A3F4 /end MEASUREMENT
/begin MEASUREMENT CrCtl_vDvtDR4UpSlp_mp "Deviation in accel for DR4 judgement at CC up slope" SWORD Vel_CrCtl 1 100 -128.0000 127.9961 FORMAT "%8.4" ECU_ADDRESS 0x7000A3F2 /end MEASUREMENT
/begin MEASUREMENT CrCtl_vDvtDR5UpSlp_mp "Deviation in accel for DR5 judgement at CC up slope" SWORD Vel_CrCtl 1 100 -128.0000 127.9961 FORMAT "%8.4" ECU_ADDRESS 0x7000A3F0 /end MEASUREMENT
/begin MEASUREMENT CrCtl_vDvtDR6UpSlp_mp "Deviation in accel for DR6 judgement at CC up slope" SWORD Vel_CrCtl 1 100 -128.0000 127.9961 FORMAT "%8.4" ECU_ADDRESS 0x7000A3EE /end MEASUREMENT
/begin MEASUREMENT CrCtl_vDvtDR7UpSlp_mp "Deviation in accel for DR7 judgement at CC up slope" SWORD Vel_CrCtl 1 100 -128.0000 127.9961 FORMAT "%8.4" ECU_ADDRESS 0x7000A3EC /end MEASUREMENT
/begin MEASUREMENT CrCtl_vECAUp2_mp "Acceleration for changing APP limitation number for ECON to 1 from 2" SWORD Vel_CrCtl 1 100 -128.0000 127.9961 FORMAT "%8.4" ECU_ADDRESS 0x7000A3EA /end MEASUREMENT
/begin MEASUREMENT CrCtl_vECAUp3_mp "Acceleration for changing APP limitation number for ECON to 2 from 3" SWORD Vel_CrCtl 1 100 -128.0000 127.9961 FORMAT "%8.4" ECU_ADDRESS 0x7000A3E8 /end MEASUREMENT
/begin MEASUREMENT CrCtl_vECAUp4_mp "Acceleration for changing APP limitation number for ECON to 3 from 4" SWORD Vel_CrCtl 1 100 -128.0000 127.9961 FORMAT "%8.4" ECU_ADDRESS 0x7000A3E6 /end MEASUREMENT
/begin MEASUREMENT CrCtl_vECAUp5_mp "Acceleration for changing APP limitation number for ECON to 4 from 5" SWORD Vel_CrCtl 1 100 -128.0000 127.9961 FORMAT "%8.4" ECU_ADDRESS 0x7000A3E4 /end MEASUREMENT
/begin MEASUREMENT CrCtl_vECDesDiff_mp "Variation of changine 2nd desired vehicle speed" SLONG Vel_CrCtl 1 100 -8388608.00000 8388607.99609 FORMAT "%13.5" ECU_ADDRESS 0x7000A3E0 /end MEASUREMENT
/begin MEASUREMENT CrCtl_vECDesInc100ms_mp "Added value in each 100ms to variation of desired vehicle speed for ECON" SWORD Vel_CrCtl 1 100 -128.0000 127.9961 FORMAT "%8.4" ECU_ADDRESS 0x7000A3DE /end MEASUREMENT
/begin MEASUREMENT CrCtl_vECDvtDwn1_mp "Deviation speed for changing APP limitation number for ECON to 1 from 2" SWORD Vel_CrCtl 1 100 -128.0000 127.9961 FORMAT "%8.4" ECU_ADDRESS 0x7000A3DC /end MEASUREMENT
/begin MEASUREMENT CrCtl_vECDvtDwn2_mp "Deviation speed for changing APP limitation number for ECON to 2 from 3" SWORD Vel_CrCtl 1 100 -128.0000 127.9961 FORMAT "%8.4" ECU_ADDRESS 0x7000A3DA /end MEASUREMENT
/begin MEASUREMENT CrCtl_vECDvtDwn3_mp "Deviation speed for changing APP limitation number for ECON to 3 from 4" SWORD Vel_CrCtl 1 100 -128.0000 127.9961 FORMAT "%8.4" ECU_ADDRESS 0x7000A3D8 /end MEASUREMENT
/begin MEASUREMENT CrCtl_vECDvtDwn4_mp "Deviation speed for changing APP limitation number for ECON to 4 from 5" SWORD Vel_CrCtl 1 100 -128.0000 127.9961 FORMAT "%8.4" ECU_ADDRESS 0x7000A3D6 /end MEASUREMENT
/begin MEASUREMENT CrCtl_vECDvtPtdVal_mp "Remainder value of changine deviation speed" SWORD Vel_CrCtl 1 100 -128.0000 127.9961 FORMAT "%8.4" ECU_ADDRESS 0x7000A3D4 /end MEASUREMENT
/begin MEASUREMENT CrCtl_vECDvtUp2_mp "Deviation speed for changing APP limitation number for ECON to 2 from 1" SWORD Vel_CrCtl 1 100 -128.0000 127.9961 FORMAT "%8.4" ECU_ADDRESS 0x7000A3D2 /end MEASUREMENT
/begin MEASUREMENT CrCtl_vECDvtUp3_mp "Deviation speed for changing APP limitation number for ECON to 3 from 2" SWORD Vel_CrCtl 1 100 -128.0000 127.9961 FORMAT "%8.4" ECU_ADDRESS 0x7000A3D0 /end MEASUREMENT
/begin MEASUREMENT CrCtl_vECDvtUp4_mp "Deviation speed for changing APP limitation number for ECON to 4 from 3" SWORD Vel_CrCtl 1 100 -128.0000 127.9961 FORMAT "%8.4" ECU_ADDRESS 0x7000A3CE /end MEASUREMENT
/begin MEASUREMENT CrCtl_vECDvtUp5_mp "Deviation speed for changing APP limitation number for ECON to 5 from 4" SWORD Vel_CrCtl 1 100 -128.0000 127.9961 FORMAT "%8.4" ECU_ADDRESS 0x7000A3CC /end MEASUREMENT
/begin MEASUREMENT CrCtl_vEstSlpCalc_mp "Threshold velocity for calculation of estimated slope for LSF" SLONG Vel_CrCtl 1 100 -8388608.00000 8388607.99609 FORMAT "%13.5" ECU_ADDRESS 0x7000A6A4 /end MEASUREMENT
/begin MEASUREMENT CrCtl_vFiltOld_mp "Old vehicle speed for cruise control" SLONG Vel_CrCtl 1 100 -8388608.00000 8388607.99609 FORMAT "%13.5" ECU_ADDRESS 0x7000A6A0 /end MEASUREMENT
/begin MEASUREMENT CrCtl_vFilt_mp "Vehicle speed for cruise control" SLONG Vel_CrCtl 1 100 -8388608.00000 8388607.99609 FORMAT "%13.5" ECU_ADDRESS 0x7000A69C /end MEASUREMENT
/begin MEASUREMENT CrCtl_vFltdUpByte_mp "Upper byte Filterd Vehicle speed for cruise control" SWORD Vel_CrCtl1 1 100 -32768.00 32767.00 FORMAT "%8.2" ECU_ADDRESS 0x7000A698 /end MEASUREMENT
/begin MEASUREMENT CrCtl_vFltVehSpd "cruise control filtered vehicle speed" SWORD Vel 1 100 -327.6800 327.6700 FORMAT "%8.4" ECU_ADDRESS 0x60001078 /end MEASUREMENT
/begin MEASUREMENT CrCtl_vFltVehSpdOld "cruise control old filtered vehicle speed value" SWORD Vel 1 100 -327.6800 327.6700 FORMAT "%8.4" ECU_ADDRESS 0x60001076 /end MEASUREMENT
/begin MEASUREMENT CrCtl_vIDASFailAExs "Fail excessive acceleration under IDAS control" SWORD Vel_CrCtl 1 100 -128.0000 127.9961 FORMAT "%8.4" ECU_ADDRESS 0x600091F8 /end MEASUREMENT
/begin MEASUREMENT CrCtl_vIDASFilOld_mp "Old vehicle speed for cruise control under IDAS control" SLONG Vel_CrCtl 1 100 -8388608.00000 8388607.99609 FORMAT "%13.5" ECU_ADDRESS 0x7000A694 /end MEASUREMENT
/begin MEASUREMENT CrCtl_vIDASFil_mp "Vehicle speed for cruise control under IDAS control" SLONG Vel_CrCtl 1 100 -8388608.00000 8388607.99609 FORMAT "%13.5" ECU_ADDRESS 0x7000A690 /end MEASUREMENT
/begin MEASUREMENT CrCtl_vIDASVehAftFil_mp "Vehicle speed the of after Filter under IDAS control" SLONG Vel_CrCtl 1 100 -8388608.00000 8388607.99609 FORMAT "%13.5" ECU_ADDRESS 0x7000A68C /end MEASUREMENT
/begin MEASUREMENT CrCtl_vIDASVehCtrl "Vehicle speed for cruise control under IDAS control" SLONG Vel_CrCtl 1 100 -8388608.00000 8388607.99609 FORMAT "%13.5" ECU_ADDRESS 0x6000379C /end MEASUREMENT
/begin MEASUREMENT CrCtl_vIDASVehCtrlOld_mp "Old vehicle speed for cruise control under IDAS control" SLONG Vel_CrCtl 1 100 -8388608.00000 8388607.99609 FORMAT "%13.5" ECU_ADDRESS 0x7000A688 /end MEASUREMENT
/begin MEASUREMENT CrCtl_vIDASVehDeVal "The deviation of Vehicle speed for cruise control among 100msec under IDAS control" SWORD Vel_CrCtl 1 100 -128.0000 127.9961 FORMAT "%8.4" ECU_ADDRESS 0x600089CA /end MEASUREMENT
/begin MEASUREMENT CrCtl_vIDASVehFil_mp "Value of filtering Vehicle speed under IDAS cotrol" SLONG Fact_CrCtl1 1 100 -65536.0000000 65535.9999695 FORMAT "%13.7" ECU_ADDRESS 0x7000A684 /end MEASUREMENT
/begin MEASUREMENT CrCtl_vIDASVehUpByte "Upper byte vehicle speed for cruise control under IDAS control" SWORD Vel_CrCtl1 1 100 -32768.00 32767.00 FORMAT "%8.2" ECU_ADDRESS 0x600089C8 /end MEASUREMENT
/begin MEASUREMENT CrCtl_vMemSpd "Memory speed Low Limit value for CC" SLONG Vel_CrCtl 1 100 -8388608.00000 8388607.99609 FORMAT "%13.5" ECU_ADDRESS 0x60003988 /end MEASUREMENT
/begin MEASUREMENT CrCtl_vMemSpdAftCor "setpoint speed for cruise control" SLONG Vel_CrCtl 1 100 -8388608.00000 8388607.99609 FORMAT "%13.5" ECU_ADDRESS 0x60003984 /end MEASUREMENT
/begin MEASUREMENT CrCtl_vMemSpdCncl_mp "Memory speed for Cancel" SLONG Vel_CrCtl 1 100 -8388608.00000 8388607.99609 FORMAT "%13.5" ECU_ADDRESS 0x7000A680 /end MEASUREMENT
/begin MEASUREMENT CrCtl_vMemSpdLoLimChk_mp "Memory speed Low limit check value" SLONG Vel_CrCtl 1 100 -8388608.00000 8388607.99609 FORMAT "%13.5" ECU_ADDRESS 0x7000A67C /end MEASUREMENT
/begin MEASUREMENT CrCtl_vMemSpdLoLim_mp "Memory speed Low Limit value for ACC/CC" SLONG Vel_CrCtl 1 100 -8388608.00000 8388607.99609 FORMAT "%13.5" ECU_ADDRESS 0x7000A678 /end MEASUREMENT
/begin MEASUREMENT CrCtl_vMemSpdMPHItm_mp "Intermediate value to calculate memory speed with unit MPH" SWORD Vel_CrCtl1_MPH 1 100 -32768.00 32767.00 FORMAT "%8.2" ECU_ADDRESS 0x7000A674 /end MEASUREMENT
/begin MEASUREMENT CrCtl_vMemSpdMPH_mp "Memory speed (MPH)" SLONG Vel_CrCtl_MPH 1 100 -8388608.00000 8388607.99609 FORMAT "%13.5" ECU_ADDRESS 0x7000A670 /end MEASUREMENT
/begin MEASUREMENT CrCtl_vMemSpdUpLim "Memory speed Upper Limit value for ACC/CC" SLONG Vel_CrCtl 1 100 -8388608.00000 8388607.99609 FORMAT "%13.5" ECU_ADDRESS 0x60003980 /end MEASUREMENT
/begin MEASUREMENT CrCtl_vMemSpdUpLimChk_mp "Memory speed Upper limit check value" SLONG Vel_CrCtl 1 100 -8388608.00000 8388607.99609 FORMAT "%13.5" ECU_ADDRESS 0x7000A66C /end MEASUREMENT
/begin MEASUREMENT CrCtl_vMemSpdVar_mp "Memory speed of variation" SWORD Vel_CrCtl 1 100 -128.0000 127.9961 FORMAT "%8.4" ECU_ADDRESS 0x7000A668 /end MEASUREMENT
/begin MEASUREMENT CrCtl_vMemSpdVerfDat_mp "Memory speed of verification Data" SLONG Vel_CrCtl 1 100 -8388608.00000 8388607.99609 FORMAT "%13.5" ECU_ADDRESS 0x7000A664 /end MEASUREMENT
/begin MEASUREMENT CrCtl_vMETFltAbs_mp "the absolute value of Filterd Meter Vehicle speed" SLONG Vel_CrCtl 1 100 -8388608.00000 8388607.99609 FORMAT "%13.5" ECU_ADDRESS 0x7000A660 /end MEASUREMENT
/begin MEASUREMENT CrCtl_vMETFltOld_mp "Old Filtering Meter Vehicle speed" SLONG Fact_CrCtl1 1 100 -65536.0000000 65535.9999695 FORMAT "%13.7" ECU_ADDRESS 0x7000A65C /end MEASUREMENT
/begin MEASUREMENT CrCtl_vMETFlt_mp "Filtering Meter Vehicle speed" SLONG Fact_CrCtl1 1 100 -65536.0000000 65535.9999695 FORMAT "%13.7" ECU_ADDRESS 0x7000A658 /end MEASUREMENT
/begin MEASUREMENT CrCtl_vMETReviVar_mp "absolute value of Meter Speed revision variant" SLONG Vel_CrCtl 1 100 -8388608.00000 8388607.99609 FORMAT "%13.5" ECU_ADDRESS 0x7000A654 /end MEASUREMENT
/begin MEASUREMENT CrCtl_vMETSpdFlt_mp "Filterd Meter Vehicle speed" SLONG Vel_CrCtl 1 100 -8388608.00000 8388607.99609 FORMAT "%13.5" ECU_ADDRESS 0x7000A650 /end MEASUREMENT
/begin MEASUREMENT CrCtl_vRPntHysHi_mp "CC/ACC RP (hysteresis Hi) value" SLONG Vel_CrCtl 1 100 -8388608.00000 8388607.99609 FORMAT "%13.5" ECU_ADDRESS 0x7000A3C8 /end MEASUREMENT
/begin MEASUREMENT CrCtl_vRPntHysLo_mp "CC RP (hysteresis Lo) value" SLONG Vel_CrCtl 1 100 -8388608.00000 8388607.99609 FORMAT "%13.5" ECU_ADDRESS 0x7000A3C4 /end MEASUREMENT
/begin MEASUREMENT CrCtl_vRPnt_mp "RP value" SLONG Vel_CrCtl 1 100 -8388608.00000 8388607.99609 FORMAT "%13.5" ECU_ADDRESS 0x7000A3C0 /end MEASUREMENT
/begin MEASUREMENT CrCtl_vSetSwtOn "Vehicle speed for Set SW ON" SLONG Vel_CrCtl 1 100 -8388608.00000 8388607.99609 FORMAT "%13.5" ECU_ADDRESS 0x6000397C /end MEASUREMENT
/begin MEASUREMENT CrCtl_vSpdContLoLim_mp "Low limit speed value for ACC/CC" SLONG Vel_CrCtl 1 100 -8388608.00000 8388607.99609 FORMAT "%13.5" ECU_ADDRESS 0x7000A64C /end MEASUREMENT
/begin MEASUREMENT CrCtl_vSpdDvtRgl_mp "Deviation speed between desired vehicle speed and control vehicle speed" SWORD Vel_CrCtl 1 100 -128.0000 127.9961 FORMAT "%8.4" ECU_ADDRESS 0x7000A3BE /end MEASUREMENT
/begin MEASUREMENT CrCtl_vSpdDvt_mp "Deviation speed used in state number check" SWORD Vel_CrCtl 1 100 -128.0000 127.9961 FORMAT "%8.4" ECU_ADDRESS 0x7000A3BC /end MEASUREMENT
/begin MEASUREMENT CrCtl_vSpdTab_mp "table search data for Vehicle speed" SWORD Vel_CrCtl1 1 100 -32768.00 32767.00 FORMAT "%8.2" ECU_ADDRESS 0x7000A3BA /end MEASUREMENT
/begin MEASUREMENT CrCtl_vSpdVar_mp "Vehicle speed variant value" SWORD Vel_CrCtl 1 100 -128.0000 127.9961 FORMAT "%8.4" ECU_ADDRESS 0x7000A3B8 /end MEASUREMENT
/begin MEASUREMENT CrCtl_vTapMemSpdMPH_mp "Memory speed for Tap Up/Down value(MPH)" SLONG Vel_CrCtl_MPH 1 100 -8388608.00000 8388607.99609 FORMAT "%13.5" ECU_ADDRESS 0x7000A648 /end MEASUREMENT
/begin MEASUREMENT CrCtl_vTapMemSpd_mp "Memory speed for Tap Up/Down value" SLONG Vel_CrCtl 1 100 -8388608.00000 8388607.99609 FORMAT "%13.5" ECU_ADDRESS 0x7000A644 /end MEASUREMENT
/begin MEASUREMENT CrCtl_vTapStrtMemSpd_mp "Tap Up/Down Start of Vehicle memory speed" SLONG Vel_CrCtl 1 100 -8388608.00000 8388607.99609 FORMAT "%13.5" ECU_ADDRESS 0x7000A640 /end MEASUREMENT
/begin MEASUREMENT CrCtl_vTapStrtSpd_mp "Tap Up/Down Start of Vehicle speed" SLONG Vel_CrCtl 1 100 -8388608.00000 8388607.99609 FORMAT "%13.5" ECU_ADDRESS 0x7000A63C /end MEASUREMENT
/begin MEASUREMENT CrCtl_vTapUDQntKmh_mp "Tap Up/Down for memory speed(km/h)" SLONG Vel_CrCtl 1 100 -8388608.00000 8388607.99609 FORMAT "%13.5" ECU_ADDRESS 0x7000A638 /end MEASUREMENT
/begin MEASUREMENT CrCtl_vTapUDQntMPH_mp "Tap Up/Down for memory speed(MPH)" SLONG Vel_CrCtl_MPH 1 100 -8388608.00000 8388607.99609 FORMAT "%13.5" ECU_ADDRESS 0x7000A634 /end MEASUREMENT
/begin MEASUREMENT CrCtl_vTrgAccnBas_mp "Target acceleration basic value" SLONG Vel_CrCtl 1 100 -8388608.00000 8388607.99609 FORMAT "%13.5" ECU_ADDRESS 0x7000A3B4 /end MEASUREMENT
/begin MEASUREMENT CrCtl_vTrgAccnDet_mp "Target acceleration detection" SLONG Vel_CrCtl 1 100 -8388608.00000 8388607.99609 FORMAT "%13.5" ECU_ADDRESS 0x7000A3B0 /end MEASUREMENT
/begin MEASUREMENT CrCtl_vVehAftFlt_mp "Vehicle speed the of after Filter" SLONG Vel_CrCtl 1 100 -8388608.00000 8388607.99609 FORMAT "%13.5" ECU_ADDRESS 0x7000A630 /end MEASUREMENT
/begin MEASUREMENT CrCtl_vVehCont "Vehicle speed for cruise control" SLONG Vel_CrCtl 1 100 -8388608.00000 8388607.99609 FORMAT "%13.5" ECU_ADDRESS 0x60003978 /end MEASUREMENT
/begin MEASUREMENT CrCtl_vVehContOld_mp "Old vehicle speed for cruise control" SLONG Vel_CrCtl 1 100 -8388608.00000 8388607.99609 FORMAT "%13.5" ECU_ADDRESS 0x7000A62C /end MEASUREMENT
/begin MEASUREMENT CrCtl_vVehErrChkVal_mp "Vehicle speed error check value" SLONG Vel_CrCtl 1 100 -8388608.00000 8388607.99609 FORMAT "%13.5" ECU_ADDRESS 0x7000A628 /end MEASUREMENT
/begin MEASUREMENT CrCtl_vVehFltAbs_mp "the absolute value of Filterd Vehicle speed" SLONG Vel_CrCtl 1 100 -8388608.00000 8388607.99609 FORMAT "%13.5" ECU_ADDRESS 0x7000A624 /end MEASUREMENT
/begin MEASUREMENT CrCtl_vVehFlt_mp "Value of filtering Vehicle speed" SLONG Fact_CrCtl1 1 100 -65536.0000000 65535.9999695 FORMAT "%13.7" ECU_ADDRESS 0x7000A620 /end MEASUREMENT
/begin MEASUREMENT CrCtl_vVehLimless_mp "limitless vehicle speed value" SLONG Vel_CrCtl 1 100 -8388608.00000 8388607.99609 FORMAT "%13.5" ECU_ADDRESS 0x7000A61C /end MEASUREMENT
/begin MEASUREMENT CrCtl_vVehReFltOld_mp "Old Filtering Filterd Vehicle speed" SLONG Fact_CrCtl1 1 100 -65536.0000000 65535.9999695 FORMAT "%13.7" ECU_ADDRESS 0x7000A618 /end MEASUREMENT
/begin MEASUREMENT CrCtl_vVehReFlt_mp "Filtering Filterd Vehicle speed" SLONG Fact_CrCtl1 1 100 -65536.0000000 65535.9999695 FORMAT "%13.7" ECU_ADDRESS 0x7000A614 /end MEASUREMENT
/begin MEASUREMENT CrCtl_vVehSecFlt_mp "Secound Filter Vehicle speed" SLONG Vel_CrCtl 1 100 -8388608.00000 8388607.99609 FORMAT "%13.5" ECU_ADDRESS 0x7000A610 /end MEASUREMENT
/begin MEASUREMENT CrCtl_vVehSpd_mp "Vehicle speed for CrCtl" SWORD Vel_CrCtl1 1 100 -32768.00 32767.00 FORMAT "%8.2" ECU_ADDRESS 0x7000A3AE /end MEASUREMENT
/begin MEASUREMENT CrCtl_vVehUpByte "Upper byte vehicle speed for cruise control" SWORD Vel_CrCtl1 1 100 -32768.00 32767.00 FORMAT "%8.2" ECU_ADDRESS 0x600091F6 /end MEASUREMENT
/begin MEASUREMENT CrCtl_vVehUpBytTbl_mp "Vehicle speed to use for searching table in control area mode check" SWORD Vel_CrCtl1 1 100 -32768.00 32767.00 FORMAT "%8.2" ECU_ADDRESS 0x7000A3AC /end MEASUREMENT
/begin FUNCTION CrCtl_SpdCalc "7.1.0     Cruise control Setpoint Speed calculation"
 /begin DEF_CHARACTERISTIC CrCtl_ctATVehSpdErr_C CrCtl_ctContTapUpCnt_C CrCtl_facAccnFltFltVal_C CrCtl_facAccnFltVal_C CrCtl_facAirRes_C CrCtl_facASLAcclFltVal_C CrCtl_facASLVehFlt_C CrCtl_facAtmPresSlpA_C CrCtl_facAtmPresSlpB_C CrCtl_facDecAPP_C CrCtl_facEngInert_C CrCtl_facEstSlpReviA12_GCUR CrCtl_facEstSlpReviB12_GCUR CrCtl_facIDASVehFil_C CrCtl_facMETReviFlt_C CrCtl_facMETSpdFlt_C CrCtl_facRollRes_C CrCtl_facSlpFltVal_C CrCtl_facSpdUnConv_C CrCtl_facTireInert_C CrCtl_facTrqConv_C CrCtl_facVehFlt_C CrCtl_facVehReFlt_C CrCtl_flgSwtNoMemSpdActCdn_C CrCtl_flgSwtNoMemSpd_C CrCtl_mCar_C CrCtl_numACCType_C CrCtl_numMETReviSel_C CrCtl_rConvSlipRatLim_C CrCtl_rEstSlpTrnsAT_CUR CrCtl_rEstSlpTrns_C CrCtl_rMETFltDflVal_C CrCtl_rMETReviDflVal_C CrCtl_rMETReviLoLim_GCUR CrCtl_rMETReviUpLim_GCUR CrCtl_rMETSpdRevi_GCUR CrCtl_rShutOffChkVal_C CrCtl_rVehErrChkVal_C CrCtl_stACCRstSel_C CrCtl_stATComSel_C CrCtl_stCCCoaDisbl_C CrCtl_stManCnclSupt_C CrCtl_stMemMETReviSel_C CrCtl_stMETReviLSBSel_C CrCtl_stMETReviSel_C CrCtl_swtISSSel_C CrCtl_swtResSetSel_C CrCtl_swtSetSpdCorEna_C CrCtl_tiACCAPrelErr_C CrCtl_tiACCBPrelErr_C CrCtl_tiACCFail_C CrCtl_tiACCInfo_C CrCtl_tiACCMod_C CrCtl_tiAutoBrkHold_C CrCtl_tiAValFild_C CrCtl_tiCluFild_C CrCtl_tiContInhib_C CrCtl_tiEstSlpCalcStp_C CrCtl_tiFltVarChk_C CrCtl_tiIDASAExsJdg_C CrCtl_tiIdasbErr_C CrCtl_tiIDASFailARels_C CrCtl_tiMemSpdErrChk_C CrCtl_tiMETVarChk_C CrCtl_tiRePermSet_C CrCtl_tiVehErrStart_C CrCtl_vACCAccnDeclErrChk_C CrCtl_vACCAftTapMemSpdKmhAP_C CrCtl_vACCAftTapMemSpdMPHAP_C CrCtl_vACCAftTapUDQntKmhJ_C CrCtl_vACCAftTapUDQntKmhUS_C CrCtl_vACCAftTapUDQntKmh_C CrCtl_vACCAftTapUDQntMPHUS_C CrCtl_vACCAftTapUDQntMPH_C CrCtl_vACCContTapUpdSpdKmhAP_C CrCtl_vACCContTapUpdSpdKmhUS_C CrCtl_vACCContTapUpdSpdKmh_C CrCtl_vACCContTapUpdSpdMPHAP_C CrCtl_vACCContTapUpdSpdMPHUS_C CrCtl_vACCContTapUpdSpdMPH_C CrCtl_vACCMemSpdLoLimJ_C CrCtl_vACCMemSpdLoLimKmhAP_C CrCtl_vACCMemSpdLoLimMPHAP_C CrCtl_vACCMemSpdLoLimMPHUS_C CrCtl_vACCMemSpdLoLimMPH_C CrCtl_vACCMemSpdLoLimUS_C CrCtl_vACCMemSpdLoLim_C CrCtl_vACCMemSpdUpLimJ_C CrCtl_vACCMemSpdUpLimKmhAP_C CrCtl_vACCMemSpdUpLimMPHAP_C CrCtl_vACCMemSpdUpLimMPHUS_C CrCtl_vACCMemSpdUpLimMPH_C CrCtl_vACCMemSpdUpLimUS_C CrCtl_vACCMemSpdUpLim_C CrCtl_vAccnDeclErrChk_C CrCtl_vAccnSlpStp_C CrCtl_vAccnValFltLim_C CrCtl_vACCSpdContLoLimJ_C CrCtl_vACCSpdContLoLimKmhAP_C CrCtl_vACCSpdContLoLimMPHAP_C CrCtl_vACCSpdContLoLimMPHUS_C CrCtl_vACCSpdContLoLimMPH_C CrCtl_vACCSpdContLoLimUS_C CrCtl_vACCSpdContLoLim_C CrCtl_vACCTapUDQntKmhAP_C CrCtl_vACCTapUDQntKmhJ_C CrCtl_vACCTapUDQntKmhUS_C CrCtl_vACCTapUDQntKmh_C CrCtl_vACCTapUDQntMPHAP_C CrCtl_vACCTapUDQntMPHUS_C CrCtl_vACCTapUDQntMPH_C CrCtl_vACCUpSpdHysHiJ_C CrCtl_vACCUpSpdHysHiKmhAP_C CrCtl_vACCUpSpdHysHiMPHAP_C CrCtl_vACCUpSpdHysHiMPHUS_C CrCtl_vACCUpSpdHysHiMPH_C CrCtl_vACCUpSpdHysHiUS_C CrCtl_vACCUpSpdHysHi_C CrCtl_vACCUpSpdHysLoJ_C CrCtl_vACCUpSpdHysLoKmhAP_C CrCtl_vACCUpSpdHysLoMPHAP_C CrCtl_vACCUpSpdHysLoMPHUS_C CrCtl_vACCUpSpdHysLoMPH_C CrCtl_vACCUpSpdHysLoUS_C CrCtl_vACCUpSpdHysLo_C CrCtl_vAftTapMemSpdKmh_C CrCtl_vContTapUpdSpdKmhAP_C CrCtl_vContTapUpdSpdKmhJ_C CrCtl_vContTapUpdSpdKmhUS_C CrCtl_vContTapUpdSpdKmh_C CrCtl_vContTapUpdSpdMPHAP_C CrCtl_vContTapUpdSpdMPHUS_C CrCtl_vContTapUpdSpdMPH_C CrCtl_vEstSlpCalcLSF_C CrCtl_vEstSlp_AXIS CrCtl_vFltVarChk_C CrCtl_vIDASFailAExs_CUR CrCtl_vIDASVehUpprLim_C CrCtl_vLowrLimSpdMtrRvsn_C CrCtl_vLowrLimTapUpDwnThd_C CrCtl_vMemSpdCorKmh_C CrCtl_vMemSpdCorMPH_C CrCtl_vMemSpdLoLimJ_C CrCtl_vMemSpdLoLimKmhAP_C CrCtl_vMemSpdLoLimKmhUS_C CrCtl_vMemSpdLoLimKmh_C CrCtl_vMemSpdLoLimMPHAP_C CrCtl_vMemSpdLoLimMPHUS_C CrCtl_vMemSpdLoLimMPH_C CrCtl_vMemSpdUpLimJ_C CrCtl_vMemSpdUpLimKmhAP_C CrCtl_vMemSpdUpLimKmhUS_C CrCtl_vMemSpdUpLimKmh_C CrCtl_vMemSpdUpLimMPHAP_C CrCtl_vMemSpdUpLimMPHUS_C CrCtl_vMemSpdUpLimMPH_C CrCtl_vMemSpdVar_C CrCtl_vMETReviChkVar_C CrCtl_vMETRevi_AXIS CrCtl_vMETVarChk_C CrCtl_vSpdContLoLimJ_C CrCtl_vSpdContLoLimKmhAP_C CrCtl_vSpdContLoLimMPHAP_C CrCtl_vSpdLoLimKmhUS_C CrCtl_vSpdLoLimKmh_C CrCtl_vSpdLoLimMPHUS_C CrCtl_vSpdLoLimMPH_C CrCtl_vTapMemSpdUpdJ_C CrCtl_vTapMemSpdUpdKmhDsp_C CrCtl_vTapMemSpdUpdKmhUS_C CrCtl_vTapMemSpdUpdKmh_C CrCtl_vTapMemSpdUpdMPHUS_C CrCtl_vTapMemSpdUpdMPH_C CrCtl_vTapUDQntKmhAP_C CrCtl_vTapUDQntMPHAP_C CrCtl_vTapUpdSpdKmhDisp_C CrCtl_vVehSpdUpprLim_C /end DEF_CHARACTERISTIC
 /begin IN_MEASUREMENT AccPed_swtDrvMod ACC_bBrkReq ACC_bExsMinDstBrkReq ACC_bFail ACC_st ActMod_trqClth APP_r CoEng_st Com_dACCCmdVehSpdDispd Com_flgACCNorm Com_flgGwIMG3Norm Com_stACCActv Com_stACCAMon Com_stACCBMon Com_stEATAMon Com_stIDASEngFail Com_stIDASInhb CoVMD_rCrCtlACCReq CoVMD_stSwtCCASLTqSeln CoVOM_bSSEEngStopPassed CoVOM_stSSE CrCtl_numECAppLim CrCtl_numECAppLimOld CrCtl_stACCFstTU CrCtl_stCondNo CrCtl_stCrsErrDet CrCtl_stNOContInitReq CrCtl_stResOffActv CrCtl_stResOffReq CrCUI_flgAutoBrkActvChk CrCUI_nEngSpd CrCUI_numLSF CrCUI_stACCASLSwtErrDet CrCUI_stACCClthOn CrCUI_stACCNoUpdReq CrCUI_stACCSpdIndTrg CrCUI_stATShft CrCUI_stAYCCond CrCUI_stCancelSwt CrCUI_stCANRxErr CrCUI_stClthCond CrCUI_stCntFstChk CrCUI_stCrsSwtErrDet CrCUI_stCrsSwtFild CrCUI_stCvtLmap CrCUI_stEAT2RxErr CrCUI_stFiSysFailCond CrCUI_stGearDownNo CrCUI_stLowGearCancel CrCUI_stMainDeb CrCUI_stMETSpdDspEna CrCUI_stModeChgCncl CrCUI_stNeDnCncl CrCUI_stNeUpCncl CrCUI_stSwtBrkMnDeb CrCUI_stSwtBrkMnLSF CrCUI_stSwtBrkRedDeb CrCUI_stSwtBrkRedLSF CrCUI_stSwtClthDeb CrCUI_stSwtOpErr CrCUI_stSwtResNo CrCUI_stSwtSetNo CrCUI_stTmrEndChk CrCUI_stVehUn CrCUI_vMETSpd CrCUI_vMETSpd2 EnvP_p Epm_nEng Gbx_rConvSlip I14229iocbiCrCtl1_stVal I14229iocbiCrCtl_stVal I14229rcCrCtl_stLmp LLim_stASLRxErrDet LLim_stCCASLDataErr T15_st VehV_v VehV_vSens /end IN_MEASUREMENT
 /begin OUT_MEASUREMENT CrCtl_flgCrsCtrlACCRxNorm CrCtl_numACCType CrCtl_rACCTxEstSlp CrCtl_rACCTxEstSlpOld CrCtl_rEstSlpFltVal CrCtl_rMETReviChngVal CrCtl_stACCBrkDet CrCtl_stACCCond CrCtl_stAccCont CrCtl_stAccPedOffReq CrCtl_stACCReqNoDet CrCtl_stActive CrCtl_stASLSysOffReq CrCtl_stASLTaskCont CrCtl_stCnclPermStr CrCtl_stCntIntReq CrCtl_stCoaCont CrCtl_stCond CrCtl_stDistOn CrCtl_stFailCond CrCtl_stFltSpdVar CrCtl_stFolChng CrCtl_stIdasbCanErr CrCtl_stIDASExsJdg CrCtl_stInitOut CrCtl_stInitTrqReq CrCtl_stLmpOn CrCtl_stManCncl CrCtl_stMemSpdErr CrCtl_stModeNo CrCtl_stPartSpdCont CrCtl_stRePermSet CrCtl_stResMTClth CrCtl_stSelSlpVal CrCtl_stShutOffCode0 CrCtl_stShutOffCode1 CrCtl_stShutOffCode2 CrCtl_stShutOffCode3 CrCtl_stShutOffCode4 CrCtl_stShutOffCode5 CrCtl_stShutOffCode6 CrCtl_stShutOffCode7 CrCtl_stShutOffCode8 CrCtl_stShutOffCode9 CrCtl_stTaskCont CrCtl_stTrqReqZero CrCtl_tiACCInfo CrCtl_tiAutoBrkHold CrCtl_tiContInhib CrCtl_tiIGNOnVeh CrCtl_tqCluFild CrCtl_vACCMemSpd CrCtl_vACCMemSpdKmh CrCtl_vACCMemSpdMPH CrCtl_vAccnATCtrl CrCtl_vAccnFltFltVal CrCtl_vAccnFltVal CrCtl_vASLAcclFltVal CrCtl_vASLVehCont CrCtl_vAValFild CrCtl_vIDASVehCtrl CrCtl_vMemSpd CrCtl_vMemSpdAftCor CrCtl_vMemSpdUpLim CrCtl_vSetSwtOn CrCtl_vVehCont CrCtl_vVehUpByte /end OUT_MEASUREMENT
 /begin LOC_MEASUREMENT CrCtl_ctATVehSpdErr_mp CrCtl_ctContTapUpCnt_mp CrCtl_EstSlpA_mp CrCtl_EstSlpB_mp CrCtl_EstSlpC_mp CrCtl_facEstSlpEquiv_mp CrCtl_facEstSlpReviA_mp CrCtl_facEstSlpReviB_mp CrCtl_facEstSlpTrq_mp CrCtl_rEstSlpAftRevi_mp CrCtl_rEstSlpFltValOld_mp CrCtl_rEstSlpTrnsEff_mp CrCtl_rEstSlpVal_mp CrCtl_rMETFltOld_mp CrCtl_rMETFlt_mp CrCtl_rMETReviDet_mp CrCtl_rMETReviLoLim_mp CrCtl_rMETReviUpLim_mp CrCtl_rMETSpdReviFlt_mp CrCtl_rMETSpdRevi_mp CrCtl_stACCAPrelErr_mp CrCtl_stACCBPrelErr_mp CrCtl_stACCFailDet_mp CrCtl_stAccnErr_mp CrCtl_stATVehSpdErr_mp CrCtl_stChngACCtoCC_mp CrCtl_stCnclResCode0_mp CrCtl_stCnclResCode1_mp CrCtl_stCnclResCode2_mp CrCtl_stCnclResCode3_mp CrCtl_stCnclResCode4_mp CrCtl_stCnclResCode5_mp CrCtl_stCnclResCode6_mp CrCtl_stCnclResCode7_mp CrCtl_stCnclResCode8_mp CrCtl_stCnclResCode9_mp CrCtl_stContTapDnCond_mp CrCtl_stContTapUpCnt_mp CrCtl_stEstSlpGearNo_mp CrCtl_stMETSpdVar_mp CrCtl_stPartSpdCont_mp CrCtl_stSetMETRevi_mp CrCtl_stSpdErr_mp CrCtl_stStore_mp CrCtl_stSysOffReq_mp CrCtl_stVehCalOK_mp CrCtl_tiACCAPrelErr_mp CrCtl_tiACCBPrelErr_mp CrCtl_tiACCBrkHold_mp CrCtl_tiACCBrk_mp CrCtl_tiACCFail_mp CrCtl_tiACCMode_mp CrCtl_tiEstSlpCalcStp_mp CrCtl_tiFltVarChk_mp CrCtl_tiIDASAExsJdg_mp CrCtl_tiIdasbErr_mp CrCtl_tiIDASFailARels_mp CrCtl_tiMemSpdErrChk_mp CrCtl_tiMETVarChk_mp CrCtl_tiRePermSet_mp CrCtl_tiTaskCont_mp CrCtl_tiVehNoiseDet_mp CrCtl_trqEng_mp CrCtl_vACCAftTapMemSpd_mp CrCtl_vACCAppMemSpdKmh_mp CrCtl_vACCAppMemSpdMPH_mp CrCtl_vACCCoaMemSpdKmh_mp CrCtl_vACCCoaMemSpdMPH_mp CrCtl_vAccnATCtrlOld_mp CrCtl_vAccnDeclErrChk_mp CrCtl_vAccnFltFltValOld_mp CrCtl_vAccnFltValOld_mp CrCtl_vAccnValFlt_mp CrCtl_vAccnVal_mp CrCtl_vACCTDStrtMemSpdKmh_mp CrCtl_vACCTDStrtMemSpdMPH_mp CrCtl_vACCTUStrtMemSpdKmh_mp CrCtl_vACCTUStrtMemSpdMPH_mp CrCtl_vACCUpSpdHysHi_mp CrCtl_vACCUpSpdHysLo_mp CrCtl_vASLAcclFltValOld_mp CrCtl_vASLAcclVal_mp CrCtl_vASLSensOld_mp CrCtl_vASLVehAftFlt_mp CrCtl_vASLVehBefUpLim_mp CrCtl_vASLVehContOld_mp CrCtl_vASLVehFlt_mp CrCtl_vContTapUpdSpdKmph_mp CrCtl_vContTapUpdSpdMPH_mp CrCtl_vDiffAbs_mp CrCtl_vEstSlpCalc_mp CrCtl_vFiltOld_mp CrCtl_vFilt_mp CrCtl_vFltdUpByte_mp CrCtl_vIDASFailAExs CrCtl_vIDASFilOld_mp CrCtl_vIDASFil_mp CrCtl_vIDASVehAftFil_mp CrCtl_vIDASVehCtrlOld_mp CrCtl_vIDASVehDeVal CrCtl_vIDASVehFil_mp CrCtl_vIDASVehUpByte CrCtl_vMemSpdCncl_mp CrCtl_vMemSpdLoLimChk_mp CrCtl_vMemSpdLoLim_mp CrCtl_vMemSpdMPHItm_mp CrCtl_vMemSpdMPH_mp CrCtl_vMemSpdUpLimChk_mp CrCtl_vMemSpdVar_mp CrCtl_vMemSpdVerfDat_mp CrCtl_vMETFltAbs_mp CrCtl_vMETFltOld_mp CrCtl_vMETFlt_mp CrCtl_vMETReviVar_mp CrCtl_vMETSpdFlt_mp CrCtl_vSpdContLoLim_mp CrCtl_vTapMemSpdMPH_mp CrCtl_vTapMemSpd_mp CrCtl_vTapStrtMemSpd_mp CrCtl_vTapStrtSpd_mp CrCtl_vTapUDQntKmh_mp CrCtl_vTapUDQntMPH_mp CrCtl_vVehAftFlt_mp CrCtl_vVehContOld_mp CrCtl_vVehErrChkVal_mp CrCtl_vVehFltAbs_mp CrCtl_vVehFlt_mp CrCtl_vVehLimless_mp CrCtl_vVehReFltOld_mp CrCtl_vVehReFlt_mp CrCtl_vVehSecFlt_mp /end LOC_MEASUREMENT
 FUNCTION_VERSION "7.1.0" /end FUNCTION
/begin FUNCTION CrCtl_TrqCalc "6.3.0     Cruise Control torque calculation"
 /begin DEF_CHARACTERISTIC CrCtl_ctContTapDnInitOut_C CrCtl_ctContTapUpInitOut_C CrCtl_ctTapDnInitOut_C CrCtl_ctTapUpInitOut_C CrCtl_fac1LGAppDiffCls_GMAP CrCtl_fac1LGAppDiff_GMAP CrCtl_fac2LGAppDiffCls_GMAP CrCtl_fac2LGAppDiff_GMAP CrCtl_fac3LGAppDiffCls_GMAP CrCtl_fac3LGAppDiff_GMAP CrCtl_fac4LGAppDiffCls_GMAP CrCtl_fac4LGAppDiff_GMAP CrCtl_facACCAccnGn12_GCUR CrCtl_facACCDR1FbA_CUR CrCtl_facACCDR1ResA_MAP CrCtl_facACCDR2FbA_CUR CrCtl_facACCDR2ResA_MAP CrCtl_facACCDR3FbA_CUR CrCtl_facACCDR3ResA_MAP CrCtl_facACCDR4FbA_CUR CrCtl_facACCDR4ResA_MAP CrCtl_facACCDR5FbA_CUR CrCtl_facACCDR5ResA_MAP CrCtl_facACCDR6FbA_CUR CrCtl_facACCDR6ResA_MAP CrCtl_facACCDR7FbA_CUR CrCtl_facACCDR7ResA_MAP CrCtl_facACCECDR1AccrA_CUR CrCtl_facACCECDR1FbA_CUR CrCtl_facACCECDR1ResA_MAP CrCtl_facACCECDR2AccrA_CUR CrCtl_facACCECDR2FbA_CUR CrCtl_facACCECDR2ResA_MAP CrCtl_facACCECDR3AccrA_CUR CrCtl_facACCECDR3FbA_CUR CrCtl_facACCECDR3ResA_MAP CrCtl_facACCECDR4AccrA_CUR CrCtl_facACCECDR4FbA_CUR CrCtl_facACCECDR4ResA_MAP CrCtl_facACCECDR5AccrA_CUR CrCtl_facACCECDR5FbA_CUR CrCtl_facACCECDR5ResA_MAP CrCtl_facACCECDR6AccrA_CUR CrCtl_facACCECDR6FbA_CUR CrCtl_facACCECDR6ResA_MAP CrCtl_facACCECDR7AccrA_CUR CrCtl_facACCECDR7FbA_CUR CrCtl_facACCECDR7ResA_MAP CrCtl_facACCECOffAAppUp2_CUR CrCtl_facACCECOffAAppUp3_CUR CrCtl_facACCECOffAAppUp4_CUR CrCtl_facACCECOffAAppUp5_CUR CrCtl_facACCECOffAFbUp2_CUR CrCtl_facACCECOffAFbUp3_CUR CrCtl_facACCECOffAFbUp4_CUR CrCtl_facACCECOffAFbUp5_CUR CrCtl_facACCECOffAResUp2_MAP CrCtl_facACCECOffAResUp3_MAP CrCtl_facACCECOffAResUp4_MAP CrCtl_facACCECOffAResUp5_MAP CrCtl_facACCECOnAAppUp2_CUR /end DEF_CHARACTERISTIC
 /begin REF_CHARACTERISTIC CrCtl_swtResSetSel_C CrCUI_stFctInfo_C /end REF_CHARACTERISTIC
 /begin IN_MEASUREMENT AccPed_swtDrvMod ACC_bExsMinDstBrkReq ACC_bFrtCar ACC_bJmpDes ACC_rTrqAccRed ACC_stACCDR1Req ACC_stACCDR2Req ACC_vDes APP_r Com_numCvtGearShiftMap Com_stACCActv Com_stACCIgrBrk Com_stACCTrsmGearChgReq Com_stIDASShftReq Com_stLSFStrtValDmd CoVMD_rCrCtl CoVMD_stSwtCCASLTqSeln CrCtl_flgCrsCtrlACCRxNorm CrCtl_rEstSlpFltVal CrCtl_stACCBrkDet CrCtl_stACCCond CrCtl_stAccCont CrCtl_stAccPedOffReq CrCtl_stACCReqNoDet CrCtl_stActive CrCtl_stCnclPermStr CrCtl_stCntIntReq CrCtl_stCoaCont CrCtl_stCond CrCtl_stDistOn CrCtl_stFltSpdVar CrCtl_stFolChng CrCtl_stIdasbCanErr CrCtl_stInitOut CrCtl_stInitTrqReq CrCtl_stLmpOn CrCtl_stMemSpdErr CrCtl_stModeNo CrCtl_stPartSpdCont CrCtl_stRePermSet CrCtl_stResMTClth CrCtl_stSelSlpVal CrCtl_stTaskCont CrCtl_stTrqReqZero CrCtl_vAccnATCtrl CrCtl_vAccnFltFltVal CrCtl_vAccnFltVal CrCtl_vMemSpd CrCtl_vMemSpdAftCor CrCtl_vMemSpdUpLim CrCtl_vSetSwtOn CrCtl_vVehCont CrCtl_vVehUpByte CrCUI_flgAutoBrkActvChk CrCUI_flgCrCUICANRxNorm CrCUI_flgCrsCtrlShtOffEngNorm CrCUI_nEngSpd CrCUI_nFlt CrCUI_nFltDiff CrCUI_nLIDes CrCUI_numLSF CrCUI_stACCClthCont CrCUI_stACCClthOn CrCUI_stATShft CrCUI_stAYCCond CrCUI_stClthCond CrCUI_stCmftDrvMod CrCUI_stEcoDrvMod CrCUI_stECONActv CrCUI_stECONActvOld CrCUI_stFiSysFailCond CrCUI_stGearDownNo CrCUI_stMainDeb CrCUI_stMETSpdDspEna CrCUI_stPlusRDrvMod CrCUI_stSptDrvMod CrCUI_stSwtBrkMnDeb CrCUI_stSwtBrkRedDeb CrCUI_stSwtClthDeb CrCUI_stSwtResNo CrCUI_stSwtSetNo CrCUI_stVehUn LLim_stActive LLim_stCCASLDataErr SyC_ctIrrSwOff SyC_stHistTiPostDrvMax T15_st VehV_v VehV_vSens /end IN_MEASUREMENT
 /begin OUT_MEASUREMENT CrCtl_bCtOffPhd CrCtl_nTrqOffChkAdd CrCtl_nTrqOffReqChk CrCtl_numATType CrCtl_numECAppLim CrCtl_numECAppLimOld CrCtl_rACCBrkReqChg CrCtl_rACCTxTrq CrCtl_rDes CrCtl_rGearNo0 CrCtl_rGearNo1 CrCtl_rGearNo2 CrCtl_rGearNo3 CrCtl_rReqChg CrCtl_rSptReqChg CrCtl_stACCAPPOn CrCtl_stACCFstTU CrCtl_stCondNo CrCtl_stCrsErrDet CrCtl_stDR1DwnSlp CrCtl_stDR1Req CrCtl_stDR1UpSlp CrCtl_stDR2DwnSlp CrCtl_stDR2Req CrCtl_stDR2UpSlp CrCtl_stDR3DwnSlp CrCtl_stDR3Req CrCtl_stDR3UpSlp CrCtl_stDR4DwnSlp CrCtl_stDR4Req CrCtl_stDR4UpSlp CrCtl_stDR5DwnSlp CrCtl_stDR5Req CrCtl_stDR5UpSlp CrCtl_stDR6DwnSlp CrCtl_stDR6Req CrCtl_stDR6UpSlp CrCtl_stDR7DwnSlp CrCtl_stDR7Req CrCtl_stDR7UpSlp CrCtl_stDRCnclProsmaDisbl CrCtl_stDRReqNo CrCtl_stErrMTVehSpd CrCtl_stGuidDispNo CrCtl_stNOContInitReq CrCtl_stPtd CrCtl_stReq CrCtl_stResOffActv CrCtl_stResOffReq CrCtl_stShftUpReq CrCtl_tiGuidDisp /end OUT_MEASUREMENT
 /begin LOC_MEASUREMENT CrCtl_ctContTapDnInitReq_mp CrCtl_ctContTapUpInitReq_mp CrCtl_ctTapDnInitReq_mp CrCtl_ctTapUpInitReq_mp CrCtl_facACCAccnGn_mp CrCtl_facACCFdbkGn_mp CrCtl_facAccnD_mp CrCtl_facAccnP_mp CrCtl_facAccnShutOff_mp CrCtl_facAPPRedRevi_mp CrCtl_facAPPReviVal_mp CrCtl_facDiffCoeffDR1ACCEL_mp CrCtl_facDiffCoeffDR1FB_mp CrCtl_facDiffCoeffDR1Resume_mp CrCtl_facDiffCoeffDR2ACCEL_mp CrCtl_facDiffCoeffDR2FB_mp CrCtl_facDiffCoeffDR2Resume_mp CrCtl_facDiffCoeffDR3ACCEL_mp CrCtl_facDiffCoeffDR3FB_mp CrCtl_facDiffCoeffDR3Resume_mp CrCtl_facDiffCoeffDR4ACCEL_mp CrCtl_facDiffCoeffDR4FB_mp CrCtl_facDiffCoeffDR4Resume_mp CrCtl_facDiffCoeffDR5ACCEL_mp CrCtl_facDiffCoeffDR5FB_mp CrCtl_facDiffCoeffDR5Resume_mp CrCtl_facDiffCoeffDR6ACCEL_mp CrCtl_facDiffCoeffDR6FB_mp CrCtl_facDiffCoeffDR6Resume_mp CrCtl_facDiffCoeffDR7ACCEL_mp CrCtl_facDiffCoeffDR7FB_mp CrCtl_facDiffCoeffDR7Resume_mp CrCtl_facECAAppUp2_mp CrCtl_facECAAppUp3_mp CrCtl_facECAAppUp4_mp CrCtl_facECAAppUp5_mp CrCtl_facECAFbUp2_mp CrCtl_facECAFbUp3_mp CrCtl_facECAFbUp4_mp CrCtl_facECAFbUp5_mp CrCtl_facECAppInitCor_mp CrCtl_facECAResUp2_mp CrCtl_facECAResUp3_mp CrCtl_facECAResUp4_mp CrCtl_facECAResUp5_mp CrCtl_facFdbkDCont_mp CrCtl_facFdbkDReviVal_mp CrCtl_facFdbkPCont_mp CrCtl_facFdbkPReviVal_mp CrCtl_facNeLimDCont_mp CrCtl_facNeLimPCont_mp CrCtl_facShutOffReviVal_mp CrCtl_facTrgAccnRate CrCtl_nDesVal_mp CrCtl_nTrqOffLimA_mp CrCtl_nTrqOffLimB_mp CrCtl_rACCFstTUAccnRed_mp CrCtl_rAccnFltVal_mp CrCtl_rAPPACCFU_mp CrCtl_rAppDec10ms_mp CrCtl_rAppInc10ms_mp CrCtl_rAPPOpnDR1CnclDwnSlp_mp CrCtl_rAPPOpnDR2CnclDwnSlp_mp CrCtl_rAPPOpnDR3CnclDwnSlp_mp CrCtl_rAPPOpnDR4CnclDwnSlp_mp CrCtl_rAPPOpnDR5CnclDwnSlp_mp CrCtl_rAPPOpnDR6CnclDwnSlp_mp CrCtl_rAPPOpnDR7CnclDwnSlp_mp CrCtl_rDiff100msMid_mp CrCtl_rDiff100ms_mp CrCtl_rDiffAccnReq_mp CrCtl_rDiffClthOut_mp CrCtl_rDiffVal_mp CrCtl_rDwnCncl_mp CrCtl_rECAppLimNum1_mp CrCtl_rECAppLimNum2_mp CrCtl_rECAppLimNum3_mp CrCtl_rECAppLimNum4_mp CrCtl_rECAppLimNum5_mp CrCtl_rECShiftVal1_mp CrCtl_rECShiftVal2_mp CrCtl_rECShiftVal3_mp CrCtl_rECShiftVal4_mp CrCtl_rECShiftVal5_mp CrCtl_rECShiftValItm_mp CrCtl_rECSlopDwn1_mp CrCtl_rECSlopDwn2_mp CrCtl_rECSlopDwn3_mp CrCtl_rECSlopDwn4_mp CrCtl_rEstSlpTab_mp CrCtl_rEstSlpValDR1Cncl_mp CrCtl_rEstSlpValDR2Cncl_mp CrCtl_rEstSlpValDR3Cncl_mp CrCtl_rEstSlpValDR4Cncl_mp CrCtl_rEstSlpValDR5Cncl_mp CrCtl_rEstSlpValDR6Cncl_mp CrCtl_rEstSlpValDR7Cncl_mp CrCtl_rInitReq_mp CrCtl_rLSFStrtAPP_mp CrCtl_rMaxAPPCC_mp CrCtl_rMaxCC3LG_mp CrCtl_rMaxCC4LG_mp CrCtl_rMaxCC5LG_mp CrCtl_rMaxCC6LG_mp CrCtl_rMaxCCLG_mp CrCtl_rMaxCCNG_mp CrCtl_rMaxCCTG_mp CrCtl_rReq_mp CrCtl_rTapInitCalc_mp CrCtl_rTDInitDet_mp CrCtl_rTrgSubWork_mp CrCtl_rTUInitDet_mp CrCtl_stACCDR1_mp CrCtl_stACCDR2_mp CrCtl_stACCDR3_mp CrCtl_stACCDR4_mp CrCtl_stACCDR5_mp CrCtl_stACCDR6_mp CrCtl_stACCDR7_mp CrCtl_stACCFstTUAccnStp_mp CrCtl_stAccnContStop_mp CrCtl_stAPPACCFU_mp CrCtl_stChngGearInitTrq_mp CrCtl_stCondNoOld_mp CrCtl_stDes2ChgActv_mp CrCtl_stDesChgCdn_mp CrCtl_stDisAPPInc_mp CrCtl_stECDesChgContTU_mp CrCtl_stErrExtnTmrIdc_mp CrCtl_stLckOnAccOld_mp CrCtl_stLckOnAcc_mp CrCtl_stModeNoOld CrCtl_stUpCC1LG_mp CrCtl_stUpCC2LG_mp CrCtl_stUpCC3LG_mp CrCtl_stUpCC4LG_mp CrCtl_stUpCC5LG_mp CrCtl_stUpCC6LG_mp CrCtl_stUpCCTG_mp CrCtl_stVehSpdAreaNoOld_mp CrCtl_stVehSpdAreaNo_mp CrCtl_tiACCChngRes_mp CrCtl_tiAccnDR1UpSlp_mp CrCtl_tiAccnDR2UpSlp_mp CrCtl_tiAccnDR3UpSlp_mp CrCtl_tiAccnDR4UpSlp_mp CrCtl_tiAccnDR5UpSlp_mp CrCtl_tiAccnDR6UpSlp_mp CrCtl_tiAccnDR7UpSlp_mp CrCtl_tiCC1LGMaxRat_mp CrCtl_tiCC2LGMaxRat_mp CrCtl_tiCC3LGMaxRat_mp CrCtl_tiCC4LGMaxRat_mp CrCtl_tiCC5LGMaxRat_mp CrCtl_tiCC6LGMaxRat_mp CrCtl_tiCCMaxRat_mp CrCtl_tiCCTGMaxRat_mp CrCtl_tiClthOnContChng_mp CrCtl_tiDisAPPInc_mp CrCtl_tiDR1CnclHold_mp CrCtl_tiDR1CnclMskDwnSlp_mp CrCtl_tiDR1CnclUpSlp_mp CrCtl_tiDR2CnclHold_mp CrCtl_tiDR2CnclMskDwnSlp_mp CrCtl_tiDR2CnclUpSlp_mp CrCtl_tiDR3CnclHold_mp CrCtl_tiDR3CnclMskDwnSlp_mp CrCtl_tiDR3CnclUpSlp_mp CrCtl_tiDR4CnclHold_mp CrCtl_tiDR4CnclMskDwnSlp_mp CrCtl_tiDR4CnclUpSlp_mp CrCtl_tiDR5CnclHold_mp CrCtl_tiDR5CnclMskDwnSlp_mp CrCtl_tiDR5CnclUpSlp_mp CrCtl_tiDR6CnclHold_mp CrCtl_tiDR6CnclMskDwnSlp_mp CrCtl_tiDR6CnclUpSlp_mp CrCtl_tiDR7CnclHold_mp CrCtl_tiDR7CnclMskDwnSlp_mp CrCtl_tiDR7CnclUpSlp_mp CrCtl_tiDRAccnControl_mp CrCtl_tiDRCnclPROSMADisbl_mp CrCtl_tiDRMskACCEL_mp CrCtl_tiDRMskCoast_mp CrCtl_tiDwnReqDisbl_mp CrCtl_tiECAppContns1_mp CrCtl_tiECAppContns2_mp CrCtl_tiECAppContns3_mp CrCtl_tiECAppContns4_mp CrCtl_tiECMaskAUp2_mp CrCtl_tiECMaskAUp3_mp CrCtl_tiECMaskAUp4_mp CrCtl_tiECMaskAUp5_mp CrCtl_tiECMaskDwn1_mp CrCtl_tiECMaskDwn2_mp CrCtl_tiECMaskDwn3_mp CrCtl_tiECMaskDwn4_mp CrCtl_tiErrChkExtn_mp CrCtl_tiExtCont_mp CrCtl_tiMskDR1UpSlp_mp CrCtl_tiMskDR2DwnSlp_mp CrCtl_tiMskDR2UpSlp_mp CrCtl_tiMskDR3DwnSlp_mp CrCtl_tiMskDR3UpSlp_mp CrCtl_tiMskDR4DwnSlp_mp CrCtl_tiMskDR4UpSlp_mp CrCtl_tiMskDR5DwnSlp_mp CrCtl_tiMskDR5UpSlp_mp CrCtl_tiMskDR6DwnSlp_mp CrCtl_tiMskDR6UpSlp_mp CrCtl_tiMskDR7DwnSlp_mp CrCtl_tiMskDR7UpSlp_mp CrCtl_tiMskDRDwnSlp_mp CrCtl_tiSpdCnclMskDR2DR1_mp CrCtl_tiSpdCnclMskDR3DR2_mp CrCtl_tiSpdCnclMskDR4DR3_mp CrCtl_tiSpdCnclMskDR5DR4_mp CrCtl_tiSpdCnclMskDR6DR5_mp CrCtl_tiSpdCnclMskDR7DR6_mp CrCtl_tiWaitReqDR0DR1_mp CrCtl_tiWaitReqDR1DR0_mp CrCtl_tiWaitReqDR1DR2_mp CrCtl_tiWaitReqDR2DR1_mp CrCtl_tiWaitReqDR2DR3_mp CrCtl_tiWaitReqDR3DR2_mp CrCtl_tiWaitReqDR3DR4_mp CrCtl_tiWaitReqDR4DR3_mp CrCtl_tiWaitReqDR4DR5_mp CrCtl_tiWaitReqDR5DR4_mp CrCtl_tiWaitReqDR5DR6_mp CrCtl_tiWaitReqDR6DR5_mp CrCtl_tiWaitReqDR6DR7_mp CrCtl_vACCFstAccnDet_mp CrCtl_vAccnDR1DwnSlp_mp CrCtl_vAccnDR1UpSlp_mp CrCtl_vAccnDR2DwnSlp_mp CrCtl_vAccnDR2UpSlp_mp CrCtl_vAccnDR3DwnSlp_mp CrCtl_vAccnDR3UpSlp_mp CrCtl_vAccnDR4DwnSlp_mp CrCtl_vAccnDR4UpSlp_mp CrCtl_vAccnDR5DwnSlp_mp CrCtl_vAccnDR5UpSlp_mp CrCtl_vAccnDR6DwnSlp_mp CrCtl_vAccnDR6UpSlp_mp CrCtl_vAccnDR7DwnSlp_mp CrCtl_vAccnDR7UpSlp_mp CrCtl_vAccnDvtDR1CnclUpSlp_mp CrCtl_vAccnDvtDR2CnclUpSlp_mp CrCtl_vAccnDvtDR3CnclUpSlp_mp CrCtl_vAccnDvtDR4CnclUpSlp_mp CrCtl_vAccnDvtDR5CnclUpSlp_mp CrCtl_vAccnDvtDR6CnclUpSlp_mp CrCtl_vAccnDvtDR7CnclUpSlp_mp CrCtl_vAccnVar_mp CrCtl_vACCRPntHysLo_mp CrCtl_vACCTrgAccnRedDet_mp CrCtl_vContnsTUDvtHys_mp CrCtl_vContnsTUDvt_mp CrCtl_vDes2Offs_mp CrCtl_vDes2UpByte_mp CrCtl_vDes2_mp CrCtl_vDesClthOnStrt_mp CrCtl_vDesOld_mp CrCtl_vDesUpByte_mp CrCtl_vDesVar_mp CrCtl_vDes_mp CrCtl_vDLimHysHi_mp CrCtl_vDLimHysLo_mp CrCtl_vDLim_mp CrCtl_vDR1DvtDwnSlp_mp CrCtl_vDR2DvtDwnSlp_mp CrCtl_vDR3DvtDwnSlp_mp CrCtl_vDR4DvtDwnSlp_mp CrCtl_vDR5DvtDwnSlp_mp CrCtl_vDR6DvtDwnSlp_mp CrCtl_vDR7DvtDwnSlp_mp CrCtl_vDvtDR1UpSlp_mp CrCtl_vDvtDR2UpSlp_mp CrCtl_vDvtDR3UpSlp_mp CrCtl_vDvtDR4UpSlp_mp CrCtl_vDvtDR5UpSlp_mp CrCtl_vDvtDR6UpSlp_mp CrCtl_vDvtDR7UpSlp_mp CrCtl_vECAUp2_mp CrCtl_vECAUp3_mp CrCtl_vECAUp4_mp CrCtl_vECAUp5_mp CrCtl_vECDesDiff_mp CrCtl_vECDesInc100ms_mp CrCtl_vECDvtDwn1_mp CrCtl_vECDvtDwn2_mp CrCtl_vECDvtDwn3_mp CrCtl_vECDvtDwn4_mp CrCtl_vECDvtPtdVal_mp CrCtl_vECDvtUp2_mp CrCtl_vECDvtUp3_mp CrCtl_vECDvtUp4_mp CrCtl_vECDvtUp5_mp CrCtl_vFltVehSpd CrCtl_vFltVehSpdOld CrCtl_vRPntHysHi_mp CrCtl_vRPntHysLo_mp CrCtl_vRPnt_mp CrCtl_vSpdDvtRgl_mp CrCtl_vSpdDvt_mp CrCtl_vSpdTab_mp CrCtl_vSpdVar_mp CrCtl_vTrgAccnBas_mp CrCtl_vTrgAccnDet_mp CrCtl_vVehSpd_mp CrCtl_vVehUpBytTbl_mp /end LOC_MEASUREMENT
 FUNCTION_VERSION "6.3.0" /end FUNCTION
/begin COMPU_METHOD APPCrCtl1 "" RAT_FUNC "%6.4" "%" COEFFS 0 200 0 0 0 1 /end COMPU_METHOD
/begin COMPU_METHOD B_TRUE "" TAB_VERB "%6.3" "" COMPU_TAB_REF B_TRUE /end COMPU_METHOD
/begin COMPU_VTAB B_TRUE "" TAB_VERB 2 0 "FALSE" 1 "TRUE" /end COMPU_VTAB
/begin COMPU_METHOD CrCtlSlipRat "" RAT_FUNC "%6.4" "%" COEFFS 0 200 0 0 0 1 /end COMPU_METHOD
/begin COMPU_METHOD DSMBAS_PNDRPRTMOD2_SC_Compu "" TAB_VERB "%6.3" "" COMPU_TAB_REF DSMBAS_PNDRPRTMOD2_SC_Compu /end COMPU_METHOD
/begin COMPU_VTAB DSMBAS_PNDRPRTMOD2_SC_Compu "" TAB_VERB 2 0 "CONFIRMED" 1 "PENDING" /end COMPU_VTAB
/begin COMPU_METHOD DSMBAS_PREFAILDINTDEB_SC_Compu "" TAB_VERB "%6.3" "" COMPU_TAB_REF DSMBAS_PREFAILDINTDEB_SC_Compu /end COMPU_METHOD
/begin COMPU_VTAB DSMBAS_PREFAILDINTDEB_SC_Compu "" TAB_VERB 2 0 "Disable" 1 "Enable" /end COMPU_VTAB
/begin COMPU_METHOD DSMBAS_REINIMETHSELN_SC_Compu "" TAB_VERB "%6.3" "" COMPU_TAB_REF DSMBAS_REINIMETHSELN_SC_Compu /end COMPU_METHOD
/begin COMPU_VTAB DSMBAS_REINIMETHSELN_SC_Compu "" TAB_VERB 2 0 "CYCLIC_TASK" 1 "INIDRV_TASK" /end COMPU_VTAB
/begin COMPU_METHOD EngNCrCtl "" RAT_FUNC "%6.2" "rpm" COEFFS 0 1 0 0 0 1 /end COMPU_METHOD
/begin COMPU_METHOD Fact1 "" RAT_FUNC "%6.4" "-" COEFFS 0 128 0 0 0 1 /end COMPU_METHOD
/begin COMPU_METHOD Fact100 "" RAT_FUNC "%6.4" "-" COEFFS 0 100 0 0 0 1 /end COMPU_METHOD
/begin COMPU_METHOD Fact2 "" RAT_FUNC "%6.4" "-" COEFFS 0 16 0 0 0 1 /end COMPU_METHOD
/begin COMPU_METHOD Fact_CrCtl "" RAT_FUNC "%6.4" "-" COEFFS 0 256 0 0 0 1 /end COMPU_METHOD
/begin COMPU_METHOD Fact_CrCtl1 "" RAT_FUNC "%7.6" "-" COEFFS 0 32768 0 0 0 1 /end COMPU_METHOD
/begin COMPU_METHOD Fact_CrCtl2 "" RAT_FUNC "%6.4" "-" COEFFS 0 64 0 0 0 1 /end COMPU_METHOD
/begin COMPU_METHOD Fact_CrCtl3 "" RAT_FUNC "%6.5" "-" COEFFS 0 1024 0 0 0 1 /end COMPU_METHOD
/begin COMPU_METHOD Fact_CrCtl4 "" RAT_FUNC "%7.6" "-" COEFFS 0 65536 0 0 0 1 /end COMPU_METHOD
/begin COMPU_METHOD m_Car_CrCtl "" RAT_FUNC "%6.2" "kg" COEFFS 0 1 0 0 0 1 /end COMPU_METHOD
/begin COMPU_METHOD NToVel_CrCtl "" RAT_FUNC "%6.4" "-" COEFFS 0 256 0 0 0 1 /end COMPU_METHOD
/begin COMPU_METHOD OneToOne "" RAT_FUNC "%6.2" "-" COEFFS 0 1 0 0 0 1 /end COMPU_METHOD
/begin COMPU_METHOD Prc "" RAT_FUNC "%6.4" "%" COEFFS 0 81.92 0 0 0 1 /end COMPU_METHOD
/begin COMPU_METHOD Prc_CrCtl "" RAT_FUNC "%6.2" "%" COEFFS 0 1 0 0 0 1 /end COMPU_METHOD
/begin COMPU_METHOD Prc_CrCtl1 "" RAT_FUNC "%6.4" "%" COEFFS 0 100 0 0 0 1 /end COMPU_METHOD
/begin COMPU_METHOD Prc_CrCtl2 "" RAT_FUNC "%6.3" "%" COEFFS 0 10 0 0 0 1 /end COMPU_METHOD
/begin COMPU_METHOD Prc_CrCtl3 "" RAT_FUNC "%6.3" "%" COEFFS 0 8 0 0 0 1 /end COMPU_METHOD
/begin COMPU_METHOD Prc_CrCtl4 "" RAT_FUNC "%6.4" "%" COEFFS 0 256 0 0 0 1 /end COMPU_METHOD
/begin COMPU_METHOD TimeDelay_ms "" RAT_FUNC "%13.2" "ms" COEFFS 0 0 1 0 2.3283064365387e-007 0 /end COMPU_METHOD
/begin COMPU_METHOD Time_ms "" RAT_FUNC "%6.1" "ms" COEFFS 0 0.1 0 0 0 1 /end COMPU_METHOD
/begin COMPU_METHOD Time_ms_100ms "" RAT_FUNC "%6.0" "ms" COEFFS 0 0.01 0 0 0 1 /end COMPU_METHOD
/begin COMPU_METHOD Trq "" RAT_FUNC "%6.3" "Nm" COEFFS 0 10 0 0 0 1 /end COMPU_METHOD
/begin COMPU_METHOD TrqPrp_CrCtl "" RAT_FUNC "%6.4" "Kgfm" COEFFS 0 16 0 0 0 1 /end COMPU_METHOD
/begin COMPU_METHOD Vel "" RAT_FUNC "%6.4" "km/h" COEFFS 0 100 0 0 0 1 /end COMPU_METHOD
/begin COMPU_METHOD Vel_CrCtl "" RAT_FUNC "%6.4" "km/h" COEFFS 0 256 0 0 0 1 /end COMPU_METHOD
/begin COMPU_METHOD Vel_CrCtl1 "" RAT_FUNC "%6.2" "km/h" COEFFS 0 1 0 0 0 1 /end COMPU_METHOD
/begin COMPU_METHOD Vel_CrCtl1_MPH "" RAT_FUNC "%6.2" "MPH" COEFFS 0 1 0 0 0 1 /end COMPU_METHOD
/begin COMPU_METHOD Vel_CrCtl_MPH "" RAT_FUNC "%6.4" "MPH" COEFFS 0 256 0 0 0 1 /end COMPU_METHOD
/*********** End of merged RECORD_LAYOUT blocks ***********/
/begin RECORD_LAYOUT Axis_Xs16 NO_AXIS_PTS_X 1 SWORD AXIS_PTS_X 2 SWORD INDEX_INCR DIRECT /end RECORD_LAYOUT
/begin RECORD_LAYOUT CurG_Ws16 FNC_VALUES 1 SWORD COLUMN_DIR DIRECT /end RECORD_LAYOUT
/begin RECORD_LAYOUT Cur_Xs16Ws16 NO_AXIS_PTS_X 1 SWORD AXIS_PTS_X 2 SWORD INDEX_INCR DIRECT FNC_VALUES 3 SWORD COLUMN_DIR DIRECT /end RECORD_LAYOUT
/begin RECORD_LAYOUT MapG_Ws16 FNC_VALUES 1 SWORD COLUMN_DIR DIRECT /end RECORD_LAYOUT
/begin RECORD_LAYOUT Map_Xs16Ys16Ws16 NO_AXIS_PTS_X 1 SWORD NO_AXIS_PTS_Y 2 SWORD AXIS_PTS_X 3 SWORD INDEX_INCR DIRECT AXIS_PTS_Y 4 SWORD INDEX_INCR DIRECT FNC_VALUES 5 SWORD COLUMN_DIR DIRECT /end RECORD_LAYOUT
/begin RECORD_LAYOUT RB_Cur_Xs16Ws16 NO_AXIS_PTS_X 1 SWORD AXIS_PTS_X 2 SWORD INDEX_INCR DIRECT FNC_VALUES 3 SWORD COLUMN_DIR DIRECT /end RECORD_LAYOUT
/begin RECORD_LAYOUT Val_Ws16 FNC_VALUES 1 SWORD COLUMN_DIR DIRECT /end RECORD_LAYOUT
/begin RECORD_LAYOUT Val_Ws32 FNC_VALUES 1 SLONG COLUMN_DIR DIRECT /end RECORD_LAYOUT
/begin RECORD_LAYOUT Val_Ws8 FNC_VALUES 1 SBYTE COLUMN_DIR DIRECT /end RECORD_LAYOUT
/begin RECORD_LAYOUT Val_Wu16 FNC_VALUES 1 UWORD COLUMN_DIR DIRECT /end RECORD_LAYOUT
/begin RECORD_LAYOUT Val_Wu8 FNC_VALUES 1 UBYTE COLUMN_DIR DIRECT /end RECORD_LAYOUT
/end MODULE
/end PROJECT
