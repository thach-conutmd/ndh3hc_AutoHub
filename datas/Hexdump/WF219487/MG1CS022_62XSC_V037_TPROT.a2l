ASAP2_VERSION 1 60
/begin PROJECT MG1CS022 "MG1CS022"
/begin HEADER "" VERSION "MG1CS022_62XSC_V037_TPROT" PROJECT_NO MG1CS022 /end HEADER
/begin MODULE DIM ""
/begin MOD_COMMON "" BYTE_ORDER MSB_LAST ALIGNMENT_BYTE 1 ALIGNMENT_WORD 2 ALIGNMENT_LONG 4 ALIGNMENT_INT64 4 ALIGNMENT_FLOAT32_IEEE 4 ALIGNMENT_FLOAT64_IEEE 4 DATA_SIZE 32 /end MOD_COMMON
/begin AXIS_PTS InjSys_pCvoExtdRng_Ax "CVO rail pressure group points" 0x80557ECE InjSys_pPRailCvoExtdRng RB_Axis_U16 131.0700 RBPtCel_p_0p002_1 5 0.00 131.0700 FORMAT "%8.4" DEPOSIT ABSOLUTE /end AXIS_PTS
/begin AXIS_PTS InjSys_vcosCvo_Ax "CVO fuel viscosity group points" 0x80557EDE InjSys_vcosPntCvo RB_Axis_U16 3.276750 RBPtCel_vcos_5p0em5_1 6 0.00 3.276750 FORMAT "%8.6" DEPOSIT ABSOLUTE /end AXIS_PTS
/begin CHARACTERISTIC InjVvG_CvoAdpn_enable_dti_C "Release of the usage of the ti-correction" VALUE 0x8058A354 KwWU8 255.0 dez 0.00 255.0 FORMAT "%5.1" /end CHARACTERISTIC
/begin CHARACTERISTIC InjVvG_CvoAdpn_MeasPnts_InjNr_DtiCalc_C "selection of the injection pulse used for the measurement variables of the dti calculation" VALUE 0x8058A355 KwWU8 255.0 dez 0.00 255.0 FORMAT "%5.1" /end CHARACTERISTIC
/begin CHARACTERISTIC InjVvg_pMaxAdpnFullLift_C "Maximum pressure threshold for CVO adaption in full lift area" VALUE 0x8058A356 KwWU16 131.0700 RBPtCel_p_0p002_1 0.00 131.0700 FORMAT "%8.4" /end CHARACTERISTIC
/begin CHARACTERISTIC InjVvG_pMaxCtrlFullLift_C "max. pressure threshold for full lift control" VALUE 0x8058A358 KwWU16 131.0700 RBPtCel_p_0p002_1 0.00 131.0700 FORMAT "%8.4" /end CHARACTERISTIC
/begin CHARACTERISTIC InjVvG_pMaxDeltaInjrCvo_C "Maximum difference pressure at injector for CVO" VALUE 0x8058A35A KwWU16 131.0700 RBPtCel_p_0p002_1 0.00 131.0700 FORMAT "%8.4" /end CHARACTERISTIC
/begin CHARACTERISTIC InjVvg_pMinAdpnFullLift_C "Minimum pressure threshold for CVO adaption in full lift area" VALUE 0x8058A35C KwWU16 131.0700 RBPtCel_p_0p002_1 0.00 131.0700 FORMAT "%8.4" /end CHARACTERISTIC
/begin CHARACTERISTIC InjVvG_pMinCtrlFullLift_C "min. pressure threshold for full lift control" VALUE 0x8058A35E KwWU16 131.0700 RBPtCel_p_0p002_1 0.00 131.0700 FORMAT "%8.4" /end CHARACTERISTIC
/begin CHARACTERISTIC InjVvG_pMinDeltaInjrCvo_C "Minimum difference pressure at injector for CVO" VALUE 0x8058A360 KwWU16 131.0700 RBPtCel_p_0p002_1 0.00 131.0700 FORMAT "%8.4" /end CHARACTERISTIC
/begin CHARACTERISTIC InjVvg_tiOpenMinAdpnFullLift_C "Minimum value injection open time for adaption in full lift range" VALUE 0x8058A362 KwWU16 65.08500 t_q0p001_ms 0.45000 65.53500 FORMAT "%8.5" EXTENDED_LIMITS 0.00 65.53500 /end CHARACTERISTIC
/begin CHARACTERISTIC InjVvg_tiOpenMinCtrlBall_C "Minimum value injection open time for control in ballistic range" VALUE 0x8058A364 KwWU16 65.53500 t_q0p001_ms 0.00 65.53500 FORMAT "%8.5" /end CHARACTERISTIC
/begin CHARACTERISTIC InjVvG_tiOpenMinCtrlOffsEB_C "open time offset to the learned end of ballistic, for release of the full lift controller" VALUE 0x8058A366 KwWU16 65.53500 t_q0p001_ms 0.00 65.53500 FORMAT "%8.5" /end CHARACTERISTIC
/begin CHARACTERISTIC InjVvg_vcosMaxAdpnFullLiftCvo_C "max. viscosity for Full Lift Adaption" VALUE 0x8058A368 KwWU16 3.276750 RBPtCel_vcos_5p0em5_1 0.00 3.276750 FORMAT "%8.6" /end CHARACTERISTIC
/begin CHARACTERISTIC InjVvg_vcosMinAdpnFullLiftCvo_C "min. viscosity for Full Lift Adaption" VALUE 0x8058A36A KwWU16 3.276750 RBPtCel_vcos_5p0em5_1 0.00 3.276750 FORMAT "%8.6" /end CHARACTERISTIC
/begin CHARACTERISTIC IntkAirT_cntrSTC1HiVld_C "stuck-check sensor 1: necessary number of high-phases" VALUE 0x8056CCB0 RB_Val_Wu8 255.0 OneToOne 0.00 255.0 FORMAT "%5.1" /end CHARACTERISTIC
/begin CHARACTERISTIC IntkAirT_cntrSTC1LoVld_C "stuck-check sensor 1: necessary number of low-phases" VALUE 0x8056CCB1 RB_Val_Wu8 255.0 OneToOne 0.00 255.0 FORMAT "%5.1" /end CHARACTERISTIC
/begin CHARACTERISTIC IntkAirT_cntrSTC2HiVld_C "stuck-check sensor 2: necessary number of high-phases" VALUE 0x8056CD40 RB_Val_Wu8 255.0 OneToOne 0.00 255.0 FORMAT "%5.1" /end CHARACTERISTIC
/begin CHARACTERISTIC IntkAirT_cntrSTC2LoVld_C "stuck-check sensor 2: necessary number of low-phases" VALUE 0x8056CD41 RB_Val_Wu8 255.0 OneToOne 0.00 255.0 FORMAT "%5.1" /end CHARACTERISTIC
/begin CHARACTERISTIC IntkAirT_mHSC1MLMax_C "high-side-check sensor 1: threshold for physical diagnosis enabling" VALUE 0x8056CCB2 RB_Val_Wu8 1020. m_ub_b1020 0.00 1020. FORMAT "%5.0" /end CHARACTERISTIC
/begin CHARACTERISTIC IntkAirT_mHSC1MLMin_C "high-side-check sensor 1: threshold for physical diagnosis enabling" VALUE 0x8056CCB3 RB_Val_Wu8 1020. m_ub_b1020 0.00 1020. FORMAT "%5.0" /end CHARACTERISTIC
/begin CHARACTERISTIC IntkAirT_mHSC2MLMax_C "high-side-check sensor 2: threshold for physical diagnosis enabling" VALUE 0x8056CD42 RB_Val_Wu8 1020. m_ub_b1020 0.00 1020. FORMAT "%5.0" /end CHARACTERISTIC
/begin CHARACTERISTIC IntkAirT_mHSC2MLMin_C "high-side-check sensor 2: threshold for physical diagnosis enabling" VALUE 0x8056CD43 RB_Val_Wu8 1020. m_ub_b1020 0.00 1020. FORMAT "%5.0" /end CHARACTERISTIC
/begin CHARACTERISTIC IntkAirT_mSTC1HiMLInteg_T "stuck-check sensor 1: minimum air mass for detection of the high-phase" CURVE 0x8056CCB4 RB_Curve_S16_U8_Static 23.21 m_ub_b23p3 0.00 23.21 FORMAT "%5.2"
 /begin AXIS_DESCR STD_AXIS CEngDsT_tStrtFrst Temp_Cels 3 -3549.940 3003.560 FORMAT "%8.3" DEPOSIT ABSOLUTE /end AXIS_DESCR
/end CHARACTERISTIC
/begin CHARACTERISTIC IntkAirT_mSTC1HiMLMax_C "stuck-check sensor 1: ml-threshold for high-phase" VALUE 0x8056CCC0 RB_Val_Wu8 1020. m_ub_b1020 0.00 1020. FORMAT "%5.0" /end CHARACTERISTIC
/begin CHARACTERISTIC IntkAirT_mSTC1LoMLMax_C "stuck-check sensor 1: ml-threshold for low-phase" VALUE 0x8056CCC1 RB_Val_Wu8 1020. m_ub_b1020 0.00 1020. FORMAT "%5.0" /end CHARACTERISTIC
/begin CHARACTERISTIC IntkAirT_mSTC1LoMLMin_C "stuck-check sensor 1: ml-threshold for low-phase" VALUE 0x8056CCC2 RB_Val_Wu8 1020. m_ub_b1020 0.00 1020. FORMAT "%5.0" /end CHARACTERISTIC
/begin CHARACTERISTIC IntkAirT_mSTC2HiMLInteg_T "stuck-check sensor 2: minimum air mass for detection of the high-phase" CURVE 0x8056CD44 RB_Curve_S16_U8_Static 23.21 m_ub_b23p3 0.00 23.21 FORMAT "%5.2"
 /begin AXIS_DESCR STD_AXIS CEngDsT_tStrtFrst Temp_Cels 3 -3549.940 3003.560 FORMAT "%8.3" DEPOSIT ABSOLUTE /end AXIS_DESCR
/end CHARACTERISTIC
/begin CHARACTERISTIC IntkAirT_mSTC2HiMLMax_C "stuck-check sensor 2: ml-threshold for high-phase" VALUE 0x8056CD50 RB_Val_Wu8 1020. m_ub_b1020 0.00 1020. FORMAT "%5.0" /end CHARACTERISTIC
/begin CHARACTERISTIC IntkAirT_mSTC2LoMLMax_C "stuck-check sensor 2: ml-threshold for low-phase" VALUE 0x8056CD51 RB_Val_Wu8 1020. m_ub_b1020 0.00 1020. FORMAT "%5.0" /end CHARACTERISTIC
/begin CHARACTERISTIC IntkAirT_mSTC2LoMLMin_C "stuck-check sensor 2: ml-threshold for low-phase" VALUE 0x8056CD52 RB_Val_Wu8 1020. m_ub_b1020 0.00 1020. FORMAT "%5.0" /end CHARACTERISTIC
/begin CHARACTERISTIC IntkAirT_stCfgAirFltDs_C "Code word to configure the intake air temperature after air filter" VALUE 0x8056CDD0 RB_Val_Wu8 255.0 OneToOne 0.00 255.0 FORMAT "%5.1" /end CHARACTERISTIC
/begin CHARACTERISTIC IntkAirT_stCfgHSC1_C "Code word for the configuration of the High-Side-Check for the intake air temperature sensor 1" VALUE 0x8056CCC3 RB_Val_Wu8 255.0 OneToOne 0.00 255.0 FORMAT "%5.1" /end CHARACTERISTIC
/begin CHARACTERISTIC IntkAirT_stCfgHSC2_C "Code word for the configuration of the High-Side-Check for the intake air temperature sensor 2" VALUE 0x8056CD53 RB_Val_Wu8 255.0 OneToOne 0.00 255.0 FORMAT "%5.1" /end CHARACTERISTIC
/begin CHARACTERISTIC IntkAirT_stCfgIntkMnfld_C "Code word to configure the intake air temperature in manifold IntkAirT_tThrVlvUs" VALUE 0x8056CDD4 RB_Val_Wu8 255.0 OneToOne 0.00 255.0 FORMAT "%5.1" /end CHARACTERISTIC
/begin CHARACTERISTIC IntkAirT_stCfgPRC1_C "Code word for the configuration of the Physical-Range-Check for the intake air temperature sensor 1" VALUE 0x8056CCC4 RB_Val_Wu8 255.0 OneToOne 0.00 255.0 FORMAT "%5.1" /end CHARACTERISTIC
/begin CHARACTERISTIC IntkAirT_stCfgPRC2_C "Code word for the configuration of the Physical-Range-Check for the intake air temperature sensor 2" VALUE 0x8056CD54 RB_Val_Wu8 255.0 OneToOne 0.00 255.0 FORMAT "%5.1" /end CHARACTERISTIC
/begin CHARACTERISTIC IntkAirT_stCfgSTC1_C "Code word for the configuration of the Stuck-Check for the intake air temperature sensor 1" VALUE 0x8056CCC5 RB_Val_Wu8 255.0 OneToOne 0.00 255.0 FORMAT "%5.1" /end CHARACTERISTIC
/begin CHARACTERISTIC IntkAirT_stCfgSTC2_C "Code word for the configuration of the Stuck-Check for the intake air temperature sensor 2" VALUE 0x8056CD55 RB_Val_Wu8 255.0 OneToOne 0.00 255.0 FORMAT "%5.1" /end CHARACTERISTIC
/begin CHARACTERISTIC IntkAirT_stCfgThrVlvUs_C "Code word to configure the intake air temperature upstream throttle IntkAirT_tThrVlvUs" VALUE 0x8056CDDC RB_Val_Wu8 255.0 OneToOne 0.00 255.0 FORMAT "%5.1" /end CHARACTERISTIC
/begin CHARACTERISTIC IntkAirT_tHSC1HealThd_C "high-side-check sensor 1: temperature threshold for healing" VALUE 0x8056CCC6 RB_Val_Ws16 6553.500 Temp_Cels -3549.940 3003.560 FORMAT "%8.3" /end CHARACTERISTIC
/begin CHARACTERISTIC IntkAirT_tHSC1Mdl_T "high-side-check sensor 1: characteristic line to calculate the model value for high-side-check" CURVE 0x8056CCC8 RB_Curve_S16_S16 6553.500 Temp_Cels -3549.940 3003.560 FORMAT "%8.3"
 /begin AXIS_DESCR STD_AXIS CEngDsT_t Temp_Cels 3 -3549.940 3003.560 FORMAT "%8.3" DEPOSIT ABSOLUTE /end AXIS_DESCR
/end CHARACTERISTIC
/begin CHARACTERISTIC IntkAirT_tHSC2HealThd_C "high-side-check sensor 2: temperature threshold for healing" VALUE 0x8056CD56 RB_Val_Ws16 6553.500 Temp_Cels -3549.940 3003.560 FORMAT "%8.3" /end CHARACTERISTIC
/begin CHARACTERISTIC IntkAirT_tHSC2Mdl_T "high-side-check sensor 2: characteristic line to calculate the model value for high-side-check" CURVE 0x8056CD58 RB_Curve_S16_S16 6553.500 Temp_Cels -3549.940 3003.560 FORMAT "%8.3"
 /begin AXIS_DESCR STD_AXIS CEngDsT_t Temp_Cels 3 -3549.940 3003.560 FORMAT "%8.3" DEPOSIT ABSOLUTE /end AXIS_DESCR
/end CHARACTERISTIC
/begin CHARACTERISTIC IntkAirT_tiAirFltDsMeasdVldDly_C "Debouncing time of lowpass filter for the intake air temperature after air filter" VALUE 0x8056CDD1 RB_Val_Wu8 25.50 t_q0p1 0.00 25.50 FORMAT "%5.2" /end CHARACTERISTIC
/begin CHARACTERISTIC IntkAirT_tiAirFltDs_C "Time constant of lowpass for the intake air temperature after air filter" VALUE 0x8056CDD2 RB_Val_Wu8 25.40 t_q0p1 0.10 25.50 FORMAT "%5.2" EXTENDED_LIMITS 0.00 25.50 /end CHARACTERISTIC
/begin CHARACTERISTIC IntkAirT_tiHSC1EnaDly_C "High-Side-Check sensor 1: debounce-time for physical diagnosis enabling" VALUE 0x8056CCD6 RB_Val_Wu8 255.0 t_q1 0.00 255.0 FORMAT "%5.1" /end CHARACTERISTIC
/begin CHARACTERISTIC IntkAirT_tiHSC1ErrDly_C "high-side-check sensor 1: debounce-time for error-entry" VALUE 0x8056CCD7 RB_Val_Wu8 255.0 t_q1 0.00 255.0 FORMAT "%5.1" /end CHARACTERISTIC
/begin CHARACTERISTIC IntkAirT_tiHSC1HealDly_C "high-side-check sensor 1: debounce time for error-healing" VALUE 0x8056CCD8 RB_Val_Wu8 255.0 t_q1 0.00 255.0 FORMAT "%5.1" /end CHARACTERISTIC
/begin CHARACTERISTIC IntkAirT_tiHSC1MLDly_C "High-Side-Check sensor 1: maximal interrupt time of the air-mass flow for diagnosis enabling" VALUE 0x8056CCD9 RB_Val_Wu8 255.0 t_q1 0.00 255.0 FORMAT "%5.1" /end CHARACTERISTIC
/begin CHARACTERISTIC IntkAirT_tiHSC2EnaDly_C "High-Side-Check sensor 2: debounce-time for physical diagnosis enabling" VALUE 0x8056CD66 RB_Val_Wu8 255.0 t_q1 0.00 255.0 FORMAT "%5.1" /end CHARACTERISTIC
/begin CHARACTERISTIC IntkAirT_tiHSC2ErrDly_C "high-side-check sensor 2: debounce-time for error-entry" VALUE 0x8056CD67 RB_Val_Wu8 255.0 t_q1 0.00 255.0 FORMAT "%5.1" /end CHARACTERISTIC
/begin CHARACTERISTIC IntkAirT_tiHSC2HealDly_C "high-side-check sensor 2: debounce time for error-healing" VALUE 0x8056CD68 RB_Val_Wu8 255.0 t_q1 0.00 255.0 FORMAT "%5.1" /end CHARACTERISTIC
/begin CHARACTERISTIC IntkAirT_tiHSC2MLDly_C "High-Side-Check sensor 2: maximal interrupt time of the air-mass flow for diagnosis enabling" VALUE 0x8056CD69 RB_Val_Wu8 255.0 t_q1 0.00 255.0 FORMAT "%5.1" /end CHARACTERISTIC
/begin CHARACTERISTIC IntkAirT_tiIntkMnfldFil_C "Time constant of lowpass for the intake air temperature in manifold" VALUE 0x8056CDD5 RB_Val_Wu8 25.40 t_q0p1 0.10 25.50 FORMAT "%5.2" EXTENDED_LIMITS 0.00 25.50 /end CHARACTERISTIC
/begin CHARACTERISTIC IntkAirT_tiIntkMnfldMeasdVldDly_C "Debouncing time of lowpass filter for the intake air temperature in manifold" VALUE 0x8056CDD6 RB_Val_Wu8 25.50 t_q0p1 0.00 25.50 FORMAT "%5.2" /end CHARACTERISTIC
/begin CHARACTERISTIC IntkAirT_tiPRC1ErrDly_C "Debouncing time for error entry (min/max) for Physical-Range-Check TFA1" VALUE 0x8056CCDA RB_Val_Wu8 25.50 t_q0p1 0.00 25.50 FORMAT "%5.2" /end CHARACTERISTIC
/begin CHARACTERISTIC IntkAirT_tiPRC1HealDly_C "Debouncing time for error healing (min/max) for Physical-Range-Check TFA1" VALUE 0x8056CCDB RB_Val_Wu8 25.50 t_q0p1 0.00 25.50 FORMAT "%5.2" /end CHARACTERISTIC
/begin CHARACTERISTIC IntkAirT_tiPRC2ErrDly_C "Debouncing time for error entry (min/max) for Physical-Range-Check TFA2" VALUE 0x8056CD6A RB_Val_Wu8 25.50 t_q0p1 0.00 25.50 FORMAT "%5.2" /end CHARACTERISTIC
/begin CHARACTERISTIC IntkAirT_tiPRC2HealDly_C "Debouncing time for error healing (min/max) for Physical-Range-Check TFA2" VALUE 0x8056CD6B RB_Val_Wu8 25.50 t_q0p1 0.00 25.50 FORMAT "%5.2" /end CHARACTERISTIC
/begin CHARACTERISTIC IntkAirT_tiSTC1HiOffDly_C "stuck-check sensor 1: maximum allowed time-duration outside high-phase" VALUE 0x8056CCDC RB_Val_Wu8 255.0 t_q1 0.00 255.0 FORMAT "%5.1" /end CHARACTERISTIC
/begin CHARACTERISTIC IntkAirT_tiSTC1HiOnDly_C "stuck-check sensor 1: minimum necessary time-duration for hig-phase-cycle" VALUE 0x8056CCDD RB_Val_Wu8 255.0 t_q1 0.00 255.0 FORMAT "%5.1" /end CHARACTERISTIC
/begin CHARACTERISTIC IntkAirT_tiSTC1LoOffDly_C "stuck-check sensor 1: maximum allowed time-duration outside low-phase" VALUE 0x8056CCDE RB_Val_Wu8 255.0 t_q1 0.00 255.0 FORMAT "%5.1" /end CHARACTERISTIC
/begin CHARACTERISTIC IntkAirT_tiSTC1LoOnDly_C "stuck-check sensor 1: minimum necessary time-duration for low-phase-cycle" VALUE 0x8056CCDF RB_Val_Wu8 255.0 t_q1 0.00 255.0 FORMAT "%5.1" /end CHARACTERISTIC
/begin CHARACTERISTIC IntkAirT_tiSTC2HiOffDly_C "stuck-check sensor 2: maximum allowed time-duration outside high-phase" VALUE 0x8056CD6C RB_Val_Wu8 255.0 t_q1 0.00 255.0 FORMAT "%5.1" /end CHARACTERISTIC
/begin CHARACTERISTIC IntkAirT_tiSTC2HiOnDly_C "stuck-check sensor 2: minimum necessary time-duration for hig-phase-cycle" VALUE 0x8056CD6D RB_Val_Wu8 255.0 t_q1 0.00 255.0 FORMAT "%5.1" /end CHARACTERISTIC
/begin CHARACTERISTIC IntkAirT_tiSTC2LoOffDly_C "stuck-check sensor 2: maximum allowed time-duration outside low-phase" VALUE 0x8056CD6E RB_Val_Wu8 255.0 t_q1 0.00 255.0 FORMAT "%5.1" /end CHARACTERISTIC
/begin CHARACTERISTIC IntkAirT_tiSTC2LoOnDly_C "stuck-check sensor 2: minimum necessary time-duration for low-phase-cycle" VALUE 0x8056CD6F RB_Val_Wu8 255.0 t_q1 0.00 255.0 FORMAT "%5.1" /end CHARACTERISTIC
/begin CHARACTERISTIC IntkAirT_tPRC1Max_C "Maximum permissible temperature for Physical-Range-Check intake air temperature sensor 1" VALUE 0x8056CCE0 RB_Val_Ws16 6553.500 Temp_Cels -3549.940 3003.560 FORMAT "%8.3" /end CHARACTERISTIC
/begin CHARACTERISTIC IntkAirT_tPRC1Min_C "Minimum permissible temperature for Physical-Range-Check intake air temperature sensor 1" VALUE 0x8056CCE2 RB_Val_Ws16 6553.500 Temp_Cels -3549.940 3003.560 FORMAT "%8.3" /end CHARACTERISTIC
/begin CHARACTERISTIC IntkAirT_tPRC2Max_C "Maximum permissible temperature for Physical-Range-Check intake air temperature sensor 2" VALUE 0x8056CD70 RB_Val_Ws16 6553.500 Temp_Cels -3549.940 3003.560 FORMAT "%8.3" /end CHARACTERISTIC
/begin CHARACTERISTIC IntkAirT_tPRC2Min_C "Minimum permissible temperature for Physical-Range-Check intake air temperature sensor 2" VALUE 0x8056CD72 RB_Val_Ws16 6553.500 Temp_Cels -3549.940 3003.560 FORMAT "%8.3" /end CHARACTERISTIC
/begin CHARACTERISTIC IntkAirT_tReplSnsr1Mdl_C "Replacement value of the intake air temperature sensor 1" VALUE 0x8056CDD8 RB_Val_Ws16 6553.500 Temp_Cels -3549.940 3003.560 FORMAT "%8.3" /end CHARACTERISTIC
/begin CHARACTERISTIC IntkAirT_tReplSnsr2Mdl_C "Replacement value of the intake air temperature sensor 2" VALUE 0x8056CDDA RB_Val_Ws16 6553.500 Temp_Cels -3549.940 3003.560 FORMAT "%8.3" /end CHARACTERISTIC
/begin CHARACTERISTIC IntkAirT_tSTC1EnaThdMax_C "stuck-check sensor 1: threshold of the motor start temperature for enabling the diagnosis" VALUE 0x8056CCE4 RB_Val_Ws16 6553.500 Temp_Cels -3549.940 3003.560 FORMAT "%8.3" /end CHARACTERISTIC
/begin CHARACTERISTIC IntkAirT_tSTC1ErrThd_T "stuck-check sensor 1: Threshold for error detection" CURVE 0x8056CCE6 RB_Curve_S16_S16 6553.500 Temp_Cels -3549.940 3003.560 FORMAT "%8.3"
 /begin AXIS_DESCR STD_AXIS IntkAirT_tSnsrFild1Min Temp_Cels 20 -3549.940 3003.560 FORMAT "%8.3" DEPOSIT ABSOLUTE /end AXIS_DESCR
/end CHARACTERISTIC
/begin CHARACTERISTIC IntkAirT_tSTC1HiTMotMin_C "stuck-check TFA1: Threshold of motor temperature for high-phase" VALUE 0x8056CD38 RB_Val_Ws16 6553.500 Temp_Cels -3549.940 3003.560 FORMAT "%8.3" /end CHARACTERISTIC
/begin CHARACTERISTIC IntkAirT_tSTC2EnaThdMax_C "stuck-check sensor 2: threshold of the motor start temperature for enabling the diagnosis" VALUE 0x8056CD74 RB_Val_Ws16 6553.500 Temp_Cels -3549.940 3003.560 FORMAT "%8.3" /end CHARACTERISTIC
/begin CHARACTERISTIC IntkAirT_tSTC2ErrThd_T "stuck-check sensor 2: Threshold for error detection" CURVE 0x8056CD76 RB_Curve_S16_S16 6553.500 Temp_Cels -3549.940 3003.560 FORMAT "%8.3"
 /begin AXIS_DESCR STD_AXIS IntkAirT_tSnsrFild2Min Temp_Cels 20 -3549.940 3003.560 FORMAT "%8.3" DEPOSIT ABSOLUTE /end AXIS_DESCR
/end CHARACTERISTIC
/begin CHARACTERISTIC IntkAirT_tSTC2HiTMotMin_C "stuck-check TFA2: Threshold of motor temperature for high-phase" VALUE 0x8056CDC8 RB_Val_Ws16 6553.500 Temp_Cels -3549.940 3003.560 FORMAT "%8.3" /end CHARACTERISTIC
/begin CHARACTERISTIC IntkAirT_tThrVlvUsTolrMax_C "Maximum tolerance of the intake air temperature before the throttle valve" VALUE 0x8056CDDE RB_Val_Ws16 6553.500 Temp_Cels -3549.940 3003.560 FORMAT "%8.3" /end CHARACTERISTIC
/begin CHARACTERISTIC IntkAirT_vHSC1VMin_C "high-side-check sensor 1: Threshold of vehicle speed for enabling diagnosis" VALUE 0x8056CD3A RB_Val_Ws16 655.3500 Vel -327.6800 327.6700 FORMAT "%8.4" /end CHARACTERISTIC
/begin CHARACTERISTIC IntkAirT_vHSC2VMin_C "high-side-check sensor 2: Threshold of vehicle speed for enabling diagnosis" VALUE 0x8056CDCA RB_Val_Ws16 655.3500 Vel -327.6800 327.6700 FORMAT "%8.4" /end CHARACTERISTIC
/begin CHARACTERISTIC IntkAirT_vSTC1HiVMax_C "stuck-check sensor 1: Threshold of vehicle speed fr high-phase" VALUE 0x8056CD3C RB_Val_Ws16 655.3500 Vel -327.6800 327.6700 FORMAT "%8.4" /end CHARACTERISTIC
/begin CHARACTERISTIC IntkAirT_vSTC1LoVMin_C "stuck-check sensor 1: Threshold of vehicle speed fr low-phase" VALUE 0x8056CD3E RB_Val_Ws16 655.3500 Vel -327.6800 327.6700 FORMAT "%8.4" /end CHARACTERISTIC
/begin CHARACTERISTIC IntkAirT_vSTC2HiVMax_C "stuck-check sensor 2: Threshold of vehicle speed fr high-phase" VALUE 0x8056CDCC RB_Val_Ws16 655.3500 Vel -327.6800 327.6700 FORMAT "%8.4" /end CHARACTERISTIC
/begin CHARACTERISTIC IntkAirT_vSTC2LoVMin_C "stuck-check sensor 2: Threshold of vehicle speed fr low-phase" VALUE 0x8056CDCE RB_Val_Ws16 655.3500 Vel -327.6800 327.6700 FORMAT "%8.4" /end CHARACTERISTIC
/begin CHARACTERISTIC IVGdiCtl_CvoAdpn_Bal_DftValCyl_dti_CA "default value of the ti correction in the ballistic area (cylinderindividual)" VAL_BLK 0x8058A36C KwbWS8 102.0 t_q0p4us -51.20 50.80 FORMAT "%5.2" NUMBER 4 /end CHARACTERISTIC
/begin CHARACTERISTIC IVGdiCtl_CvoAdpn_Bal_dTiOpenMaxCtrlRamp_C "delta ti open to the last measurement, till the bal. integrator is ramped down" VALUE 0x8058A370 KwWU8 255.0 t_us_q1 0.00 255.0 FORMAT "%5.1" /end CHARACTERISTIC
/begin CHARACTERISTIC IVGdiCtl_CvoAdpn_Bal_dTiOpenMidCtrlRamp_C "max. open time difference in the ballistic, where the complete controller value ist used" VALUE 0x8058A371 KwWU8 255.0 t_us_q1 0.00 255.0 FORMAT "%5.1" /end CHARACTERISTIC
/begin CHARACTERISTIC IVGdiCtl_CvoAdpn_Bal_dTopenCtrlMax2EndBal_C "Open time distance between controller maximum and end of ballistic area" VALUE 0x8058A372 KwWU8 255.0 t_us_q1 0.00 255.0 FORMAT "%5.1" /end CHARACTERISTIC
/begin CHARACTERISTIC IVGdiCtl_CvoAdpn_Bal_SlopCorrn_Fac_FullLft_tab_C "ballistic slop correction: influence of fulllift tab" VALUE 0x8058A374 KwWS32 429496729.500 freq_q0p1 -214748364.800 214748364.700 FORMAT "%13.3" /end CHARACTERISTIC
/begin CHARACTERISTIC IVGdiCtl_CvoAdpn_Bal_SlopCorrn_Fac_Press_C "ballistic slop correction: influence of pressure" VALUE 0x8058A378 KwWS32 429496729.500 IVGdiCtl_CvoAdpn_q0p1_DIV_e6_MPa -214748364.800 214748364.700 FORMAT "%13.3" /end CHARACTERISTIC
/begin CHARACTERISTIC IVGdiCtl_CvoAdpn_Bal_SlopCorrn_Fac_tantot_C "ballistic slop correction: influence of tantot" VALUE 0x8058A37C KwWS32 429496729.500 freq_q0p1 -214748364.800 214748364.700 FORMAT "%13.3" /end CHARACTERISTIC
/begin CHARACTERISTIC IVGdiCtl_CvoAdpn_Bal_SlopCorrn_Fac_tOpenEB_C "ballistic slop correction: influence of topen at the end of the balistic area" VALUE 0x8058A380 KwWS32 429496729.500 freq_q0p1 -214748364.800 214748364.700 FORMAT "%13.3" /end CHARACTERISTIC
/begin CHARACTERISTIC IVGdiCtl_CvoAdpn_Bal_SlopCorrn_Offs_C "ballistic slop correction: offset" VALUE 0x8058A384 KwWS32 429496729.500 IVGdiCtl_CvoAdpn_q0p1_DIV_e6 -214748364.800 214748364.700 FORMAT "%13.3" /end CHARACTERISTIC
/begin CHARACTERISTIC IVGdiCtl_CvoAdpn_Bal_TiOpenMinCtrlRamp_C "minimum open time in the ballistic where the interpolation of the controller value is allowed" VALUE 0x8058A388 KwWU16 65535.00 t_us_q1 0.00 65535.00 FORMAT "%8.2" /end CHARACTERISTIC
/begin CHARACTERISTIC IVGdiCtl_CvoAdpn_Bal_UseDftVal_dti_C "usage of the default value instead of the learned dti" VALUE 0x8058A38A KwWU8 255.0 dez 0.00 255.0 FORMAT "%5.1" /end CHARACTERISTIC
/begin CHARACTERISTIC IVGdiCtl_CvoAdpn_BaseAdpnElpdThd_C "Limit: Number of injections until a new base adaption is triggered" VALUE 0x8058A38C KwWU16 65533.00 dez 2.00 65535.00 FORMAT "%8.2" EXTENDED_LIMITS 0.00 65535.00 /end CHARACTERISTIC
/begin CHARACTERISTIC IVGdiCtl_CvoAdpn_BaseAdpnElpdThd_High_C "Limit with high priority: Number of injections until a new base adaption is triggered" VALUE 0x8058A38E KwWU16 65533.00 dez 2.00 65535.00 FORMAT "%8.2" EXTENDED_LIMITS 0.00 65535.00 /end CHARACTERISTIC
/begin CHARACTERISTIC IVGdiCtl_CvoAdpn_Cal1_C "Debug-Interface" VALUE 0x8058A390 KwWU8 255.0 dez 0.00 255.0 FORMAT "%5.1" /end CHARACTERISTIC
/begin CHARACTERISTIC IVGdiCtl_CvoAdpn_CorrnTantotTp_CUR "correction for opening delay time (tantot) depending on pause time" CURVE 0x8058A392 KlAxU8SstxU16WS16_Static 6553.500 t_q0p1_us -3276.800 3276.700 FORMAT "%8.3"
 /begin AXIS_DESCR STD_AXIS IVGdiCtl_CvoAdpn_currTp_u16 t_q0p001_ms 20 0.00 65.53500 FORMAT "%8.5" DEPOSIT ABSOLUTE /end AXIS_DESCR
/end CHARACTERISTIC
/begin CHARACTERISTIC IVGdiCtl_CvoAdpn_Ctrl_FacDeltaTopenToDti_GT "percentage gain: dTopen to dTi" CURVE 0x8058A3E4 GklWU16 255.0000 rel_q1 0.00 255.0000 FORMAT "%8.4" EXTENDED_LIMITS 0.00 65535.00
 /begin AXIS_DESCR COM_AXIS IVGdiCtl_CvoAdpn_currTopen_u16 t_q0p1_us 5 0.00 6553.500 FORMAT "%8.3" AXIS_PTS_REF IVGdiCtl_CvoAdpn_Topen_Ax /end AXIS_DESCR
/end CHARACTERISTIC
/begin CHARACTERISTIC IVGdiCtl_CvoAdpn_Ctrl_FacDeltaTopenToIntegGain_CUR "additional controller gain" CURVE 0x8058A3EE KlAxU8SstxS16WU16_Static 255.0000 rel_q1 0.00 255.0000 FORMAT "%8.4" EXTENDED_LIMITS 0.00 65535.00
 /begin AXIS_DESCR STD_AXIS IVGdiCtl_CvoAdpn_delta_toffen_s16 t_q0p1_us 5 -3276.800 3276.700 FORMAT "%8.3" DEPOSIT ABSOLUTE /end AXIS_DESCR
/end CHARACTERISTIC
/begin CHARACTERISTIC IVGdiCtl_CvoAdpn_Ctrl_Lim_dtiIterStep_GT "Limit: max. dti within one iteration step" CURVE 0x8058A404 GklWS16 25.50000 t_q0p1_us 0.00 25.50000 FORMAT "%8.5" EXTENDED_LIMITS -3276.800 3276.700
 /begin AXIS_DESCR COM_AXIS IVGdiCtl_CvoAdpn_currTopen_u16 t_q0p1_us 5 0.00 6553.500 FORMAT "%8.3" AXIS_PTS_REF IVGdiCtl_CvoAdpn_Topen_Ax /end AXIS_DESCR
/end CHARACTERISTIC
/begin CHARACTERISTIC IVGdiCtl_CvoAdpn_Ctrl_Lim_dTopenInsdTolrRng_C "Limit: number of successive dtopen in the tolerance range as stability condition" VALUE 0x8058A40E KwWU8 255.0 dez 0.00 255.0 FORMAT "%5.1" /end CHARACTERISTIC
/begin CHARACTERISTIC IVGdiCtl_CvoAdpn_Ctrl_Lim_dtpIterStep_C "Limit: allowed tp-step without controller reset" VALUE 0x8058A40F KwWU8 10.20 t_q0p04_ms 0.00 10.20 FORMAT "%5.2" /end CHARACTERISTIC
/begin CHARACTERISTIC IVGdiCtl_CvoAdpn_Ctrl_TolrRng_dTopen_GT "dTopen tolerance range as stability condition" CURVE 0x8058A410 GklWS16 6553.500 t_q0p1_us -3276.800 3276.700 FORMAT "%8.3"
 /begin AXIS_DESCR COM_AXIS IVGdiCtl_CvoAdpn_currTopen_u16 t_q0p1_us 5 0.00 6553.500 FORMAT "%8.3" AXIS_PTS_REF IVGdiCtl_CvoAdpn_Topen_Ax /end AXIS_DESCR
/end CHARACTERISTIC
/begin CHARACTERISTIC IVGdiCtl_CvoAdpn_DftVal_tantot_const_GT "Default value for the constant opening delay time (tantot) - viscosity-specific" CURVE 0x8058A4F8 RB_CurveGroup_U16 6553.500 t_q0p1_us 0.00 6553.500 FORMAT "%8.3"
 /begin AXIS_DESCR COM_AXIS InjSys_vcosPntCvo RBPtCel_vcos_5p0em5_1 6 0.00 3.276750 FORMAT "%8.6" AXIS_PTS_REF InjSys_vcosCvo_Ax /end AXIS_DESCR
/end CHARACTERISTIC
/begin CHARACTERISTIC IVGdiCtl_CvoAdpn_DrgPtrClr_C "Reset drag pointers" VALUE 0x8058A41A KwWU8 255.0 dez 0.00 255.0 FORMAT "%5.1" /end CHARACTERISTIC
/begin CHARACTERISTIC IVGdiCtl_CvoAdpn_DrgPtr_VcosMsk_CA "bit mask for the selection of the viscosities for the drag pointers" VAL_BLK 0x8058A41B KwbUb 255.0 dez 0.00 255.0 FORMAT "%5.1" NUMBER 2 /end CHARACTERISTIC
/begin CHARACTERISTIC IVGdiCtl_CvoAdpn_dTantot_CUR "delta tantot dependent from current delta ti" CURVE 0x8058A41E KlAxU8SstxS16WS16 6553.500 t_q0p1_us -3276.800 3276.700 FORMAT "%8.3"
 /begin AXIS_DESCR STD_AXIS IVGdiCtl_CvoAdpn_Estimd_delta_ti_s16 t_q0p1_us 7 -3276.800 3276.700 FORMAT "%8.3" DEPOSIT ABSOLUTE /end AXIS_DESCR
/end CHARACTERISTIC
/begin CHARACTERISTIC IVGdiCtl_CvoAdpn_enable_FullLft_ReAdpn_C "activate readaption in the full lift area" VALUE 0x8058A43C KwWU8 255.0 dez 0.00 255.0 FORMAT "%5.1" /end CHARACTERISTIC
/begin CHARACTERISTIC IVGdiCtl_CvoAdpn_enable_IntegRstNoCtrl_C "enable reset of dti integrators on lost of control release" VALUE 0x8058A43D KwWU8 255.0 dez 0.00 255.0 FORMAT "%5.1" /end CHARACTERISTIC
/begin CHARACTERISTIC IVGdiCtl_CvoAdpn_enable_IntegValPls_C "Consider the integrator values for the pulse-individual injection time correction (bit-coded)" VALUE 0x8058A43E KwWU8 255.0 dez 0.00 255.0 FORMAT "%5.1" /end CHARACTERISTIC
/begin CHARACTERISTIC IVGdiCtl_CvoAdpn_enable_OnlineCtrl_C "enable online control" VALUE 0x8058A43F KwWU8 255.0 dez 0.00 255.0 FORMAT "%5.1" /end CHARACTERISTIC
/begin CHARACTERISTIC IVGdiCtl_CvoAdpn_enable_SimErr_C "fault simulation" VALUE 0x8058A440 KwWU16 65535.00 dez 0.00 65535.00 FORMAT "%8.2" /end CHARACTERISTIC
/begin CHARACTERISTIC IVGdiCtl_CvoAdpn_enable_TiCorDurTantotDet_C "activate delta ti correction during tantot detection" VALUE 0x8058A442 KwWU8 255.0 dez 0.00 255.0 FORMAT "%5.1" /end CHARACTERISTIC
/begin CHARACTERISTIC IVGdiCtl_CvoAdpn_Fac_DtiDtopenEB_C "factor for weighting of the ballistic gradient correction using the injection time correction (dti) and the open time correction (dtopen)" VALUE 0x8058A443 KwWU8 0.9961 fak_ub_b1 0.00 0.9961 /end CHARACTERISTIC
/begin CHARACTERISTIC IVGdiCtl_CvoAdpn_FiltAdpnVal_Fac_C "amplification factor for dti low pass filter" VALUE 0x8058A444 KwWU8 99.61 rel_ub_b100 0.00 99.61 FORMAT "%5.2" /end CHARACTERISTIC
/begin CHARACTERISTIC IVGdiCtl_CvoAdpn_FiltTabAdpnInteg_Fac_C "amplification factor for adaption tab low pass filter" VALUE 0x8058A445 KwWU8 99.61 rel_ub_b100 0.00 99.61 FORMAT "%5.2" /end CHARACTERISTIC
/begin CHARACTERISTIC IVGdiCtl_CvoAdpn_FiltTabInteg_Fac_C "amplification factor for tab low pass filter" VALUE 0x8058A446 KwWU8 99.61 rel_ub_b100 0.00 99.61 FORMAT "%5.2" /end CHARACTERISTIC
/begin CHARACTERISTIC IVGdiCtl_CvoAdpn_Filt_dti_Thd_C "threshold to adopt the filter value as adaption value" VALUE 0x8058A448 KwWU16 6553.500 t_q0p1_us 0.00 6553.500 FORMAT "%8.3" /end CHARACTERISTIC
/begin CHARACTERISTIC IVGdiCtl_CvoAdpn_FullLft_DftValCyl_dti_CA "dti default value during full lift" VAL_BLK 0x8058A44A KwbWS16 26214.00 t_q0p4us -13107.20 13106.80 FORMAT "%8.2" NUMBER 4 /end CHARACTERISTIC
/begin CHARACTERISTIC IVGdiCtl_CvoAdpn_FullLft_dTiOpenMaxCtrlRamp_C "delta ti open to the last measurement, till the full lift integrator is ramped down" VALUE 0x8058A452 KwWU8 255.0 t_us_q1 0.00 255.0 FORMAT "%5.1" /end CHARACTERISTIC
/begin CHARACTERISTIC IVGdiCtl_CvoAdpn_FullLft_dTiOpenMidCtrlRamp_C "max. open time difference in the full lift, where the complete controller value ist used" VALUE 0x8058A453 KwWU8 255.0 t_us_q1 0.00 255.0 FORMAT "%5.1" /end CHARACTERISTIC
/begin CHARACTERISTIC IVGdiCtl_CvoAdpn_FullLft_SlopCorrn_Fac_Tab_C "pressure dependent gradient correction of the adapted full lift tab" VALUE 0x8058A454 KwWS16 6553.500 IVGdiCtl_CvoAdpn_q0p1_us_DIV_MPa -3276.800 3276.700 FORMAT "%8.3" /end CHARACTERISTIC
/begin CHARACTERISTIC IVGdiCtl_CvoAdpn_FullLft_TiOpenMaxCtrlRamp_C "minimum open time in full lift area where the interpolation of the controller value is allowed" VALUE 0x8058A456 KwWU16 65535.00 t_us_q1 0.00 65535.00 FORMAT "%8.2" /end CHARACTERISTIC
/begin CHARACTERISTIC IVGdiCtl_CvoAdpn_FullLft_UseDftVal_dti_C "use default value instead of adapted ti correction value during full lift" VALUE 0x8058A458 KwWU8 255.0 dez 0.00 255.0 FORMAT "%5.1" /end CHARACTERISTIC
/begin CHARACTERISTIC IVGdiCtl_CvoAdpn_FullLift_tabAdpn_Thd_C "threshold to adapt the filtered full lift tab as adaption value" VALUE 0x8058A45A KwWU16 6553.500 t_q0p1_us 0.00 6553.500 FORMAT "%8.3" /end CHARACTERISTIC
/begin CHARACTERISTIC IVGdiCtl_CvoAdpn_IninAdpnVal_C "Reset of all adaption values" VALUE 0x8058A45C KwWU8 255.0 dez 0.00 255.0 FORMAT "%5.1" /end CHARACTERISTIC
/begin CHARACTERISTIC IVGdiCtl_CvoAdpn_IninIntegVal_C "Reset of all controller" VALUE 0x8058A45D KwWU8 255.0 dez 0.00 255.0 FORMAT "%5.1" /end CHARACTERISTIC
/begin CHARACTERISTIC IVGdiCtl_CvoAdpn_Lim_Bal_dtiNeg_C "lower limit for allowed ballistic dit adaption value" VALUE 0x8058A45E KwWS16 204.0000 t_q0p4us -51.2000 152.8000 FORMAT "%8.4" EXTENDED_LIMITS -13107.20 13106.80 /end CHARACTERISTIC
/begin CHARACTERISTIC IVGdiCtl_CvoAdpn_Lim_Bal_dtiPos_C "upper limit for allowed ballistic dit adaption value" VALUE 0x8058A460 KwWS16 204.0000 t_q0p4us -51.2000 152.8000 FORMAT "%8.4" EXTENDED_LIMITS -13107.20 13106.80 /end CHARACTERISTIC
/begin CHARACTERISTIC IVGdiCtl_CvoAdpn_Lim_FullLft_dtiNeg_C "negative error limit of full lift dti for adaption" VALUE 0x8058A462 KwWS16 26214.00 t_q0p4us -13107.20 13106.80 FORMAT "%8.2" /end CHARACTERISTIC
/begin CHARACTERISTIC IVGdiCtl_CvoAdpn_Lim_FullLft_dtiPos_C "positive error limit of full lift dti for adaption" VALUE 0x8058A464 KwWS16 26214.00 t_q0p4us -13107.20 13106.80 FORMAT "%8.2" /end CHARACTERISTIC
/begin CHARACTERISTIC IVGdiCtl_CvoAdpn_Lim_IntegNeg_GT "negative controller thresholds dependent of the valve open time" CURVE 0x8058A466 GklWS16 6553.500 t_q0p1_us -3276.800 3276.700 FORMAT "%8.3"
 /begin AXIS_DESCR COM_AXIS IVGdiCtl_CvoAdpn_currTopen_u16 t_q0p1_us 5 0.00 6553.500 FORMAT "%8.3" AXIS_PTS_REF IVGdiCtl_CvoAdpn_Topen_Ax /end AXIS_DESCR
/end CHARACTERISTIC
/begin CHARACTERISTIC IVGdiCtl_CvoAdpn_Lim_IntegPos_GT "positive controller thresholds dependent of the valve open time" CURVE 0x8058A470 GklWS16 6553.500 t_q0p1_us -3276.800 3276.700 FORMAT "%8.3"
 /begin AXIS_DESCR COM_AXIS IVGdiCtl_CvoAdpn_currTopen_u16 t_q0p1_us 5 0.00 6553.500 FORMAT "%8.3" AXIS_PTS_REF IVGdiCtl_CvoAdpn_Topen_Ax /end AXIS_DESCR
/end CHARACTERISTIC
/begin CHARACTERISTIC IVGdiCtl_CvoAdpn_MaxTiForDtiCorrn_GT "Threshold: dti inclusion only until this ti-threshold (pressure dependent)" CURVE 0x8058A504 RB_CurveGroup_U16 65.53500 t_q0p001_ms 0.00 65.53500 FORMAT "%8.5"
 /begin AXIS_DESCR COM_AXIS InjSys_pPRailCvoExtdRng RBPtCel_p_0p002_1 5 0.00 131.0700 FORMAT "%8.4" AXIS_PTS_REF InjSys_pCvoExtdRng_Ax /end AXIS_DESCR
/end CHARACTERISTIC
/begin CHARACTERISTIC IVGdiCtl_CvoAdpn_pRef_TabFullLft_C "reference pressure for full lift tab" VALUE 0x8058A47A KwWU16 131.0700 RBPtCel_p_0p002_1 0.00 131.0700 FORMAT "%8.4" /end CHARACTERISTIC
/begin CHARACTERISTIC IVGdiCtl_CvoAdpn_ReqDtiPrsForRefTiCorrn_C "necessary adaption progress for dti consideration during RefTi correction" VALUE 0x8058A47C KwWU8 100.0 rel_q1 0.00 100.0 FORMAT "%5.1" EXTENDED_LIMITS 0.00 255.0 /end CHARACTERISTIC
/begin CHARACTERISTIC IVGdiCtl_CvoAdpn_SimErrCyl_Bal_dtiOffs_CA "Error simulation: offset added to the calculated correction delta Ti of a ballistic injection pulse" VAL_BLK 0x8058A47E KwbWS16 6553.500 t_q0p1_us -3276.800 3276.700 FORMAT "%8.3" NUMBER 4 /end CHARACTERISTIC
/begin CHARACTERISTIC IVGdiCtl_CvoAdpn_SimErrCyl_Bal_tabOffs_CA "Error simulation: offset added to injector closing delay of ballistic injections" VAL_BLK 0x8058A486 KwbWS16 6553.500 t_q0p1_us -3276.800 3276.700 FORMAT "%8.3" NUMBER 4 /end CHARACTERISTIC
/begin CHARACTERISTIC IVGdiCtl_CvoAdpn_SimErrCyl_dTiOpenOffs_CA "Error simulation: offset added to the difference between desired and measured injector opening duration" VAL_BLK 0x8058A48E KwbWS16 6553.500 t_q0p1_us -3276.800 3276.700 FORMAT "%8.3" NUMBER 4 /end CHARACTERISTIC
/begin CHARACTERISTIC IVGdiCtl_CvoAdpn_SimErrCyl_FullLft_dtiOffs_CA "Error simulation: offset added to the calculated correction delta Ti of a full lift injection pulse" VAL_BLK 0x8058A496 KwbWS16 6553.500 t_q0p1_us -3276.800 3276.700 FORMAT "%8.3" NUMBER 4 /end CHARACTERISTIC
/begin CHARACTERISTIC IVGdiCtl_CvoAdpn_SimErrCyl_FullLft_tabOffs_CA "Error simulation: offset added to injector closing delay of full lift injections" VAL_BLK 0x8058A49E KwbWS16 6553.500 t_q0p1_us -3276.800 3276.700 FORMAT "%8.3" NUMBER 4 /end CHARACTERISTIC
/begin CHARACTERISTIC IVGdiCtl_CvoAdpn_SimErrCyl_tantotOffs_CA "Error simulation: offset added to the measured tantot" VAL_BLK 0x8058A4A6 KwbWS16 6553.500 t_q0p1_us -3276.800 3276.700 FORMAT "%8.3" NUMBER 4 /end CHARACTERISTIC
/begin CHARACTERISTIC IVGdiCtl_CvoAdpn_SimErrCyl_Tran_TiOpenOffs_CA "Error simulation: offset added to the open time during transition" VAL_BLK 0x8058A4AE KwbWS16 6553.500 t_q0p1_us -3276.800 3276.700 FORMAT "%8.3" NUMBER 4 /end CHARACTERISTIC
/begin CHARACTERISTIC IVGdiCtl_CvoAdpn_SubValCorrnFac_tantot_C "correction factor (percental) for usage of tantot defalt value" VALUE 0x8058A4B6 KwWU8 255.0 rel_q1 0.00 255.0 FORMAT "%5.1" /end CHARACTERISTIC
/begin CHARACTERISTIC IVGdiCtl_CvoAdpn_SubValTyp_C "Usage of a replacement value for tantot" VALUE 0x8058A4B7 KwWU8 255.0 dez 0.00 255.0 FORMAT "%5.1" /end CHARACTERISTIC
/begin CHARACTERISTIC IVGdiCtl_CvoAdpn_SubValVcosSrchPrio_GT "priority of viscosity for subvalue search" CURVE 0x8058A4B8 RB_CurveGroup_U8 255.0 dez 0.00 255.0 FORMAT "%5.1"
 /begin AXIS_DESCR COM_AXIS InjSys_vcosPntCvo RBPtCel_vcos_5p0em5_1 6 0.00 3.276750 FORMAT "%8.6" AXIS_PTS_REF InjSys_vcosCvo_Ax /end AXIS_DESCR
/end CHARACTERISTIC
/begin CHARACTERISTIC IVGdiCtl_CvoAdpn_TiAtTantotConst_CUR "ti where tantot is not changing anymore, dependent of tantot constant" CURVE 0x8058A4BE KlAxU8SstxU16WU16 6553.500 t_q0p1_us 0.00 6553.500 FORMAT "%8.3"
 /begin AXIS_DESCR STD_AXIS IVGdiCtl_CvoAdpn_used_tantot_u16 t_q0p1_us 3 0.00 6553.500 FORMAT "%8.3" DEPOSIT ABSOLUTE /end AXIS_DESCR
/end CHARACTERISTIC
/begin CHARACTERISTIC IVGdiCtl_CvoAdpn_tiMinPseAdpn_C "minimum necessary pause time for release of adaption" VALUE 0x8058A4CC KwWU16 2621.400 t_q0p04_ms 0.00 2621.400 FORMAT "%8.3" /end CHARACTERISTIC
/begin CHARACTERISTIC IVGdiCtl_CvoAdpn_tiMinPseCtrl_C "Minimum required pause time for release of controller" VALUE 0x8058A4CE KwWU16 2621.400 t_q0p04_ms 0.00 2621.400 FORMAT "%8.3" /end CHARACTERISTIC
/begin CHARACTERISTIC IVGdiCtl_CvoAdpn_tiOpenRampEnd_C "open time end of interpolation ramp" VALUE 0x8058A4D0 KwWU16 65.53500 t_q0p001_ms 0.00 65.53500 FORMAT "%8.5" /end CHARACTERISTIC
/begin CHARACTERISTIC IVGdiCtl_CvoAdpn_tiStrt_Dti_tabmin_CUR "ti-offset for ti at tabmin for determination of the desired ti" CURVE 0x8058A4D2 KlAxU8SstxU16WU8_Static 255.0 t_us_q1 0.00 255.0 FORMAT "%5.1"
 /begin AXIS_DESCR STD_AXIS IVGdiCtl_CvoAdpn_TiStrt_CvoSigEvln_Tab_u16 t_us_q1 4 0.00 65535.00 FORMAT "%8.2" DEPOSIT ABSOLUTE /end AXIS_DESCR
/end CHARACTERISTIC
/begin AXIS_PTS IVGdiCtl_CvoAdpn_Topen_Ax "group axis with Topen sampling point" 0x8058A4E0 IVGdiCtl_CvoAdpn_currTopen_u16 SstAU8SstU16 6553.500 t_q0p1_us 5 0.00 6553.500 FORMAT "%8.3" DEPOSIT ABSOLUTE /end AXIS_PTS
/begin CHARACTERISTIC IVGdiCtl_CvoAdpn_Tran_DftValCyl_dTopen_CA "default value for dTopen correction during transition (cylinder individual)" VAL_BLK 0x8058A4EC KwbWS16 6553.500 t_q0p1_us -3276.800 3276.700 FORMAT "%8.3" NUMBER 4 /end CHARACTERISTIC
/begin CHARACTERISTIC IVGdiCtl_CvoAdpn_Tran_SlopCorrn_Fac_dTopen_C "pressure dependent correction of dTopen during transition" VALUE 0x8058A4F4 KwWS16 6553.500 IVGdiCtl_CvoAdpn_q0p1_us_DIV_MPa -3276.800 3276.700 FORMAT "%8.3" /end CHARACTERISTIC
/begin CHARACTERISTIC IVGdiCtl_CvoAdpn_Tran_UseDftVal_dTopen_C "Use default value of dTopen during transition instead of the adapted correction value" VALUE 0x8058A4F6 KwWU8 255.0 dez 0.00 255.0 FORMAT "%5.1" /end CHARACTERISTIC
/begin CHARACTERISTIC IVGdiCtl_CvoAdpn_UseDft_tantot_C "Usage of default tantot instead of the learned tantot" VALUE 0x8058A4F7 KwWU8 255.0 dez 0.00 255.0 FORMAT "%5.1" /end CHARACTERISTIC
/begin MEASUREMENT InjVvG_CvoAdpn_BaseAdpnCntr_Vcos0 "?Controlled valve operation? (CVO) number of the executed base adaptions (temperature individual) for viscosity 0" UWORD dez 1 100 0.00 65535.00 FORMAT "%8.2" ECU_ADDRESS 0x60009DF8 /end MEASUREMENT
/begin MEASUREMENT InjVvG_CvoAdpn_BaseAdpnCntr_Vcos1 "?Controlled valve operation? (CVO) number of the executed base adaptions (temperature individual) for viscosity 1" UWORD dez 1 100 0.00 65535.00 FORMAT "%8.2" ECU_ADDRESS 0x60009DF6 /end MEASUREMENT
/begin MEASUREMENT InjVvG_CvoAdpn_BaseAdpnCntr_Vcos2 "?Controlled valve operation? (CVO) number of the executed base adaptions (temperature individual) for viscosity 2" UWORD dez 1 100 0.00 65535.00 FORMAT "%8.2" ECU_ADDRESS 0x60009DF4 /end MEASUREMENT
/begin MEASUREMENT InjVvG_CvoAdpn_BaseAdpnCntr_Vcos3 "?Controlled valve operation? (CVO) number of the executed base adaptions (temperature individual) for viscosity 3" UWORD dez 1 100 0.00 65535.00 FORMAT "%8.2" ECU_ADDRESS 0x60009DF2 /end MEASUREMENT
/begin MEASUREMENT InjVvG_CvoAdpn_BaseAdpnCntr_Vcos4 "?Controlled valve operation? (CVO) number of the executed base adaptions (temperature individual) for viscosity 4" UWORD dez 1 100 0.00 65535.00 FORMAT "%8.2" ECU_ADDRESS 0x60009DF0 /end MEASUREMENT
/begin MEASUREMENT InjVvG_CvoAdpn_BaseAdpnCntr_Vcos5 "?Controlled valve operation? (CVO) number of the executed base adaptions (temperature individual) for viscosity 5" UWORD dez 1 100 0.00 65535.00 FORMAT "%8.2" ECU_ADDRESS 0x60009DEE /end MEASUREMENT
/begin MEASUREMENT InjVvG_CvoAdpn_BaseAdpnLstMeas_Vcos0 "?Controlled valve operation? (CVO) injection counter since the last base adaption (temperature individual) for viscosity 0" ULONG dez 1 100 0.00 4294967295.00 FORMAT "%13.2" ECU_ADDRESS 0x60004E80 /end MEASUREMENT
/begin MEASUREMENT InjVvG_CvoAdpn_BaseAdpnLstMeas_Vcos1 "?Controlled valve operation? (CVO) injection counter since the last base adaption (temperature individual) for viscosity 1" ULONG dez 1 100 0.00 4294967295.00 FORMAT "%13.2" ECU_ADDRESS 0x60004E7C /end MEASUREMENT
/begin MEASUREMENT InjVvG_CvoAdpn_BaseAdpnLstMeas_Vcos2 "?Controlled valve operation? (CVO) injection counter since the last base adaption (temperature individual) for viscosity 2" ULONG dez 1 100 0.00 4294967295.00 FORMAT "%13.2" ECU_ADDRESS 0x60004E78 /end MEASUREMENT
/begin MEASUREMENT InjVvG_CvoAdpn_BaseAdpnLstMeas_Vcos3 "?Controlled valve operation? (CVO) injection counter since the last base adaption (temperature individual) for viscosity 3" ULONG dez 1 100 0.00 4294967295.00 FORMAT "%13.2" ECU_ADDRESS 0x60004E74 /end MEASUREMENT
/begin MEASUREMENT InjVvG_CvoAdpn_BaseAdpnLstMeas_Vcos4 "?Controlled valve operation? (CVO) injection counter since the last base adaption (temperature individual) for viscosity 4" ULONG dez 1 100 0.00 4294967295.00 FORMAT "%13.2" ECU_ADDRESS 0x60004E70 /end MEASUREMENT
/begin MEASUREMENT InjVvG_CvoAdpn_BaseAdpnLstMeas_Vcos5 "?Controlled valve operation? (CVO) injection counter since the last base adaption (temperature individual) for viscosity 5" ULONG dez 1 100 0.00 4294967295.00 FORMAT "%13.2" ECU_ADDRESS 0x60004E6C /end MEASUREMENT
/begin MEASUREMENT InjVvG_CvoAdpn_DeltaTiBal_SwCyl0_Vcos0_Press0 "delta ti adaption value in ballistic for cylinder 0, viscocity 0 and pressure 0" SBYTE IVGdiCtl_CvoAdpn_t_q0p8us_o51p2 1 100 -51.2 152.8 FORMAT "%5.1" ECU_ADDRESS 0x60010989 /end MEASUREMENT
/begin MEASUREMENT InjVvG_CvoAdpn_DeltaTiBal_SwCyl0_Vcos0_Press1 "delta ti adaption value in ballistic for cylinder 0, viscocity 0 and pressure 1" SBYTE IVGdiCtl_CvoAdpn_t_q0p8us_o51p2 1 100 -51.2 152.8 FORMAT "%5.1" ECU_ADDRESS 0x60010988 /end MEASUREMENT
/begin MEASUREMENT InjVvG_CvoAdpn_DeltaTiBal_SwCyl0_Vcos0_Press2 "delta ti adaption value in ballistic for cylinder 0, viscocity 0 and pressure 2" SBYTE IVGdiCtl_CvoAdpn_t_q0p8us_o51p2 1 100 -51.2 152.8 FORMAT "%5.1" ECU_ADDRESS 0x60010987 /end MEASUREMENT
/begin MEASUREMENT InjVvG_CvoAdpn_DeltaTiBal_SwCyl0_Vcos0_Press3 "delta ti adaption value in ballistic for cylinder 0, viscocity 0 and pressure 3" SBYTE IVGdiCtl_CvoAdpn_t_q0p8us_o51p2 1 100 -51.2 152.8 FORMAT "%5.1" ECU_ADDRESS 0x60010986 /end MEASUREMENT
/begin MEASUREMENT InjVvG_CvoAdpn_DeltaTiBal_SwCyl0_Vcos0_Press4 "delta ti adaption value in ballistic for cylinder 0, viscocity 0 and pressure 4" SBYTE IVGdiCtl_CvoAdpn_t_q0p8us_o51p2 1 100 -51.2 152.8 FORMAT "%5.1" ECU_ADDRESS 0x60010985 /end MEASUREMENT
/begin MEASUREMENT InjVvG_CvoAdpn_DeltaTiBal_SwCyl0_Vcos1_Press0 "delta ti adaption value in ballistic for cylinder 0, viscocity 1 and pressure 0" SBYTE IVGdiCtl_CvoAdpn_t_q0p8us_o51p2 1 100 -51.2 152.8 FORMAT "%5.1" ECU_ADDRESS 0x60010984 /end MEASUREMENT
/begin MEASUREMENT InjVvG_CvoAdpn_DeltaTiBal_SwCyl0_Vcos1_Press1 "delta ti adaption value in ballistic for cylinder 0, viscocity 1 and pressure 1" SBYTE IVGdiCtl_CvoAdpn_t_q0p8us_o51p2 1 100 -51.2 152.8 FORMAT "%5.1" ECU_ADDRESS 0x60010983 /end MEASUREMENT
/begin MEASUREMENT InjVvG_CvoAdpn_DeltaTiBal_SwCyl0_Vcos1_Press2 "delta ti adaption value in ballistic for cylinder 0, viscocity 1 and pressure 2" SBYTE IVGdiCtl_CvoAdpn_t_q0p8us_o51p2 1 100 -51.2 152.8 FORMAT "%5.1" ECU_ADDRESS 0x60010982 /end MEASUREMENT
/begin MEASUREMENT InjVvG_CvoAdpn_DeltaTiBal_SwCyl0_Vcos1_Press3 "delta ti adaption value in ballistic for cylinder 0, viscocity 1 and pressure 3" SBYTE IVGdiCtl_CvoAdpn_t_q0p8us_o51p2 1 100 -51.2 152.8 FORMAT "%5.1" ECU_ADDRESS 0x60010981 /end MEASUREMENT
/begin MEASUREMENT InjVvG_CvoAdpn_DeltaTiBal_SwCyl0_Vcos1_Press4 "delta ti adaption value in ballistic for cylinder 0, viscocity 1 and pressure 4" SBYTE IVGdiCtl_CvoAdpn_t_q0p8us_o51p2 1 100 -51.2 152.8 FORMAT "%5.1" ECU_ADDRESS 0x60010980 /end MEASUREMENT
/begin MEASUREMENT InjVvG_CvoAdpn_DeltaTiBal_SwCyl0_Vcos2_Press0 "delta ti adaption value in ballistic for cylinder 0, viscocity 2 and pressure 0" SBYTE IVGdiCtl_CvoAdpn_t_q0p8us_o51p2 1 100 -51.2 152.8 FORMAT "%5.1" ECU_ADDRESS 0x6001097F /end MEASUREMENT
/begin MEASUREMENT InjVvG_CvoAdpn_DeltaTiBal_SwCyl0_Vcos2_Press1 "delta ti adaption value in ballistic for cylinder 0, viscocity 2 and pressure 1" SBYTE IVGdiCtl_CvoAdpn_t_q0p8us_o51p2 1 100 -51.2 152.8 FORMAT "%5.1" ECU_ADDRESS 0x6001097E /end MEASUREMENT
/begin MEASUREMENT InjVvG_CvoAdpn_DeltaTiBal_SwCyl0_Vcos2_Press2 "delta ti adaption value in ballistic for cylinder 0, viscocity 2 and pressure 2" SBYTE IVGdiCtl_CvoAdpn_t_q0p8us_o51p2 1 100 -51.2 152.8 FORMAT "%5.1" ECU_ADDRESS 0x6001097D /end MEASUREMENT
/begin MEASUREMENT InjVvG_CvoAdpn_DeltaTiBal_SwCyl0_Vcos2_Press3 "delta ti adaption value in ballistic for cylinder 0, viscocity 2 and pressure 3" SBYTE IVGdiCtl_CvoAdpn_t_q0p8us_o51p2 1 100 -51.2 152.8 FORMAT "%5.1" ECU_ADDRESS 0x6001097C /end MEASUREMENT
/begin MEASUREMENT InjVvG_CvoAdpn_DeltaTiBal_SwCyl0_Vcos2_Press4 "delta ti adaption value in ballistic for cylinder 0, viscocity 2 and pressure 4" SBYTE IVGdiCtl_CvoAdpn_t_q0p8us_o51p2 1 100 -51.2 152.8 FORMAT "%5.1" ECU_ADDRESS 0x6001097B /end MEASUREMENT
/begin MEASUREMENT InjVvG_CvoAdpn_DeltaTiBal_SwCyl0_Vcos3_Press0 "delta ti adaption value in ballistic for cylinder 0, viscocity 3 and pressure 0" SBYTE IVGdiCtl_CvoAdpn_t_q0p8us_o51p2 1 100 -51.2 152.8 FORMAT "%5.1" ECU_ADDRESS 0x6001097A /end MEASUREMENT
/begin MEASUREMENT InjVvG_CvoAdpn_DeltaTiBal_SwCyl0_Vcos3_Press1 "delta ti adaption value in ballistic for cylinder 0, viscocity 3 and pressure 1" SBYTE IVGdiCtl_CvoAdpn_t_q0p8us_o51p2 1 100 -51.2 152.8 FORMAT "%5.1" ECU_ADDRESS 0x60010979 /end MEASUREMENT
/begin MEASUREMENT InjVvG_CvoAdpn_DeltaTiBal_SwCyl0_Vcos3_Press2 "delta ti adaption value in ballistic for cylinder 0, viscocity 3 and pressure 2" SBYTE IVGdiCtl_CvoAdpn_t_q0p8us_o51p2 1 100 -51.2 152.8 FORMAT "%5.1" ECU_ADDRESS 0x60010978 /end MEASUREMENT
/begin MEASUREMENT InjVvG_CvoAdpn_DeltaTiBal_SwCyl0_Vcos3_Press3 "delta ti adaption value in ballistic for cylinder 0, viscocity 3 and pressure 3" SBYTE IVGdiCtl_CvoAdpn_t_q0p8us_o51p2 1 100 -51.2 152.8 FORMAT "%5.1" ECU_ADDRESS 0x60010977 /end MEASUREMENT
/begin MEASUREMENT InjVvG_CvoAdpn_DeltaTiBal_SwCyl0_Vcos3_Press4 "delta ti adaption value in ballistic for cylinder 0, viscocity 3 and pressure 4" SBYTE IVGdiCtl_CvoAdpn_t_q0p8us_o51p2 1 100 -51.2 152.8 FORMAT "%5.1" ECU_ADDRESS 0x60010976 /end MEASUREMENT
/begin MEASUREMENT InjVvG_CvoAdpn_DeltaTiBal_SwCyl0_Vcos4_Press0 "delta ti adaption value in ballistic for cylinder 0, viscocity 4 and pressure 0" SBYTE IVGdiCtl_CvoAdpn_t_q0p8us_o51p2 1 100 -51.2 152.8 FORMAT "%5.1" ECU_ADDRESS 0x60010975 /end MEASUREMENT
/begin MEASUREMENT InjVvG_CvoAdpn_DeltaTiBal_SwCyl0_Vcos4_Press1 "delta ti adaption value in ballistic for cylinder 0, viscocity 4 and pressure 1" SBYTE IVGdiCtl_CvoAdpn_t_q0p8us_o51p2 1 100 -51.2 152.8 FORMAT "%5.1" ECU_ADDRESS 0x60010974 /end MEASUREMENT
/begin MEASUREMENT InjVvG_CvoAdpn_DeltaTiBal_SwCyl0_Vcos4_Press2 "delta ti adaption value in ballistic for cylinder 0, viscocity 4 and pressure 2" SBYTE IVGdiCtl_CvoAdpn_t_q0p8us_o51p2 1 100 -51.2 152.8 FORMAT "%5.1" ECU_ADDRESS 0x60010973 /end MEASUREMENT
/begin MEASUREMENT InjVvG_CvoAdpn_DeltaTiBal_SwCyl0_Vcos4_Press3 "delta ti adaption value in ballistic for cylinder 0, viscocity 4 and pressure 3" SBYTE IVGdiCtl_CvoAdpn_t_q0p8us_o51p2 1 100 -51.2 152.8 FORMAT "%5.1" ECU_ADDRESS 0x60010972 /end MEASUREMENT
/begin MEASUREMENT InjVvG_CvoAdpn_DeltaTiBal_SwCyl0_Vcos4_Press4 "delta ti adaption value in ballistic for cylinder 0, viscocity 4 and pressure 4" SBYTE IVGdiCtl_CvoAdpn_t_q0p8us_o51p2 1 100 -51.2 152.8 FORMAT "%5.1" ECU_ADDRESS 0x60010971 /end MEASUREMENT
/begin MEASUREMENT InjVvG_CvoAdpn_DeltaTiBal_SwCyl0_Vcos5_Press0 "delta ti adaption value in ballistic for cylinder 0, viscocity 5 and pressure 0" SBYTE IVGdiCtl_CvoAdpn_t_q0p8us_o51p2 1 100 -51.2 152.8 FORMAT "%5.1" ECU_ADDRESS 0x60010970 /end MEASUREMENT
/begin MEASUREMENT InjVvG_CvoAdpn_DeltaTiBal_SwCyl0_Vcos5_Press1 "delta ti adaption value in ballistic for cylinder 0, viscocity 5 and pressure 1" SBYTE IVGdiCtl_CvoAdpn_t_q0p8us_o51p2 1 100 -51.2 152.8 FORMAT "%5.1" ECU_ADDRESS 0x6001096F /end MEASUREMENT
/begin MEASUREMENT InjVvG_CvoAdpn_DeltaTiBal_SwCyl0_Vcos5_Press2 "delta ti adaption value in ballistic for cylinder 0, viscocity 5 and pressure 2" SBYTE IVGdiCtl_CvoAdpn_t_q0p8us_o51p2 1 100 -51.2 152.8 FORMAT "%5.1" ECU_ADDRESS 0x6001096E /end MEASUREMENT
/begin MEASUREMENT InjVvG_CvoAdpn_DeltaTiBal_SwCyl0_Vcos5_Press3 "delta ti adaption value in ballistic for cylinder 0, viscocity 5 and pressure 3" SBYTE IVGdiCtl_CvoAdpn_t_q0p8us_o51p2 1 100 -51.2 152.8 FORMAT "%5.1" ECU_ADDRESS 0x6001096D /end MEASUREMENT
/begin MEASUREMENT InjVvG_CvoAdpn_DeltaTiBal_SwCyl0_Vcos5_Press4 "delta ti adaption value in ballistic for cylinder 0, viscocity 5 and pressure 4" SBYTE IVGdiCtl_CvoAdpn_t_q0p8us_o51p2 1 100 -51.2 152.8 FORMAT "%5.1" ECU_ADDRESS 0x6001096C /end MEASUREMENT
/begin MEASUREMENT InjVvG_CvoAdpn_DeltaTiBal_SwCyl1_Vcos0_Press0 "delta ti adaption value in ballistic for cylinder 1, viscocity 0 and pressure 0" SBYTE IVGdiCtl_CvoAdpn_t_q0p8us_o51p2 1 100 -51.2 152.8 FORMAT "%5.1" ECU_ADDRESS 0x6001096B /end MEASUREMENT
/begin MEASUREMENT InjVvG_CvoAdpn_DeltaTiBal_SwCyl1_Vcos0_Press1 "delta ti adaption value in ballistic for cylinder 1, viscocity 0 and pressure 1" SBYTE IVGdiCtl_CvoAdpn_t_q0p8us_o51p2 1 100 -51.2 152.8 FORMAT "%5.1" ECU_ADDRESS 0x6001096A /end MEASUREMENT
/begin MEASUREMENT InjVvG_CvoAdpn_DeltaTiBal_SwCyl1_Vcos0_Press2 "delta ti adaption value in ballistic for cylinder 1, viscocity 0 and pressure 2" SBYTE IVGdiCtl_CvoAdpn_t_q0p8us_o51p2 1 100 -51.2 152.8 FORMAT "%5.1" ECU_ADDRESS 0x60010969 /end MEASUREMENT
/begin MEASUREMENT InjVvG_CvoAdpn_DeltaTiBal_SwCyl1_Vcos0_Press3 "delta ti adaption value in ballistic for cylinder 1, viscocity 0 and pressure 3" SBYTE IVGdiCtl_CvoAdpn_t_q0p8us_o51p2 1 100 -51.2 152.8 FORMAT "%5.1" ECU_ADDRESS 0x60010968 /end MEASUREMENT
/begin MEASUREMENT InjVvG_CvoAdpn_DeltaTiBal_SwCyl1_Vcos0_Press4 "delta ti adaption value in ballistic for cylinder 1, viscocity 0 and pressure 4" SBYTE IVGdiCtl_CvoAdpn_t_q0p8us_o51p2 1 100 -51.2 152.8 FORMAT "%5.1" ECU_ADDRESS 0x60010967 /end MEASUREMENT
/begin MEASUREMENT InjVvG_CvoAdpn_DeltaTiBal_SwCyl1_Vcos1_Press0 "delta ti adaption value in ballistic for cylinder 1, viscocity 1 and pressure 0" SBYTE IVGdiCtl_CvoAdpn_t_q0p8us_o51p2 1 100 -51.2 152.8 FORMAT "%5.1" ECU_ADDRESS 0x60010966 /end MEASUREMENT
/begin MEASUREMENT InjVvG_CvoAdpn_DeltaTiBal_SwCyl1_Vcos1_Press1 "delta ti adaption value in ballistic for cylinder 1, viscocity 1 and pressure 1" SBYTE IVGdiCtl_CvoAdpn_t_q0p8us_o51p2 1 100 -51.2 152.8 FORMAT "%5.1" ECU_ADDRESS 0x60010965 /end MEASUREMENT
/begin MEASUREMENT InjVvG_CvoAdpn_DeltaTiBal_SwCyl1_Vcos1_Press2 "delta ti adaption value in ballistic for cylinder 1, viscocity 1 and pressure 2" SBYTE IVGdiCtl_CvoAdpn_t_q0p8us_o51p2 1 100 -51.2 152.8 FORMAT "%5.1" ECU_ADDRESS 0x60010964 /end MEASUREMENT
/begin MEASUREMENT InjVvG_CvoAdpn_DeltaTiBal_SwCyl1_Vcos1_Press3 "delta ti adaption value in ballistic for cylinder 1, viscocity 1 and pressure 3" SBYTE IVGdiCtl_CvoAdpn_t_q0p8us_o51p2 1 100 -51.2 152.8 FORMAT "%5.1" ECU_ADDRESS 0x60010963 /end MEASUREMENT
/begin MEASUREMENT InjVvG_CvoAdpn_DeltaTiBal_SwCyl1_Vcos1_Press4 "delta ti adaption value in ballistic for cylinder 1, viscocity 1 and pressure 4" SBYTE IVGdiCtl_CvoAdpn_t_q0p8us_o51p2 1 100 -51.2 152.8 FORMAT "%5.1" ECU_ADDRESS 0x60010962 /end MEASUREMENT
/begin MEASUREMENT InjVvG_CvoAdpn_DeltaTiBal_SwCyl1_Vcos2_Press0 "delta ti adaption value in ballistic for cylinder 1, viscocity 2 and pressure 0" SBYTE IVGdiCtl_CvoAdpn_t_q0p8us_o51p2 1 100 -51.2 152.8 FORMAT "%5.1" ECU_ADDRESS 0x60010961 /end MEASUREMENT
/begin MEASUREMENT InjVvG_CvoAdpn_DeltaTiBal_SwCyl1_Vcos2_Press1 "delta ti adaption value in ballistic for cylinder 1, viscocity 2 and pressure 1" SBYTE IVGdiCtl_CvoAdpn_t_q0p8us_o51p2 1 100 -51.2 152.8 FORMAT "%5.1" ECU_ADDRESS 0x60010960 /end MEASUREMENT
/begin MEASUREMENT InjVvG_CvoAdpn_DeltaTiBal_SwCyl1_Vcos2_Press2 "delta ti adaption value in ballistic for cylinder 1, viscocity 2 and pressure 2" SBYTE IVGdiCtl_CvoAdpn_t_q0p8us_o51p2 1 100 -51.2 152.8 FORMAT "%5.1" ECU_ADDRESS 0x6001095F /end MEASUREMENT
/begin MEASUREMENT InjVvG_CvoAdpn_DeltaTiBal_SwCyl1_Vcos2_Press3 "delta ti adaption value in ballistic for cylinder 1, viscocity 2 and pressure 3" SBYTE IVGdiCtl_CvoAdpn_t_q0p8us_o51p2 1 100 -51.2 152.8 FORMAT "%5.1" ECU_ADDRESS 0x6001095E /end MEASUREMENT
/begin MEASUREMENT InjVvG_CvoAdpn_DeltaTiBal_SwCyl1_Vcos2_Press4 "delta ti adaption value in ballistic for cylinder 1, viscocity 2 and pressure 4" SBYTE IVGdiCtl_CvoAdpn_t_q0p8us_o51p2 1 100 -51.2 152.8 FORMAT "%5.1" ECU_ADDRESS 0x6001095D /end MEASUREMENT
/begin MEASUREMENT InjVvG_CvoAdpn_DeltaTiBal_SwCyl1_Vcos3_Press0 "delta ti adaption value in ballistic for cylinder 1, viscocity 3 and pressure 0" SBYTE IVGdiCtl_CvoAdpn_t_q0p8us_o51p2 1 100 -51.2 152.8 FORMAT "%5.1" ECU_ADDRESS 0x6001095C /end MEASUREMENT
/begin MEASUREMENT InjVvG_CvoAdpn_DeltaTiBal_SwCyl1_Vcos3_Press1 "delta ti adaption value in ballistic for cylinder 1, viscocity 3 and pressure 1" SBYTE IVGdiCtl_CvoAdpn_t_q0p8us_o51p2 1 100 -51.2 152.8 FORMAT "%5.1" ECU_ADDRESS 0x6001095B /end MEASUREMENT
/begin MEASUREMENT InjVvG_CvoAdpn_DeltaTiBal_SwCyl1_Vcos3_Press2 "delta ti adaption value in ballistic for cylinder 1, viscocity 3 and pressure 2" SBYTE IVGdiCtl_CvoAdpn_t_q0p8us_o51p2 1 100 -51.2 152.8 FORMAT "%5.1" ECU_ADDRESS 0x6001095A /end MEASUREMENT
/begin MEASUREMENT InjVvG_CvoAdpn_DeltaTiBal_SwCyl1_Vcos3_Press3 "delta ti adaption value in ballistic for cylinder 1, viscocity 3 and pressure 3" SBYTE IVGdiCtl_CvoAdpn_t_q0p8us_o51p2 1 100 -51.2 152.8 FORMAT "%5.1" ECU_ADDRESS 0x60010959 /end MEASUREMENT
/begin MEASUREMENT InjVvG_CvoAdpn_DeltaTiBal_SwCyl1_Vcos3_Press4 "delta ti adaption value in ballistic for cylinder 1, viscocity 3 and pressure 4" SBYTE IVGdiCtl_CvoAdpn_t_q0p8us_o51p2 1 100 -51.2 152.8 FORMAT "%5.1" ECU_ADDRESS 0x60010958 /end MEASUREMENT
/begin MEASUREMENT InjVvG_CvoAdpn_DeltaTiBal_SwCyl1_Vcos4_Press0 "delta ti adaption value in ballistic for cylinder 1, viscocity 4 and pressure 0" SBYTE IVGdiCtl_CvoAdpn_t_q0p8us_o51p2 1 100 -51.2 152.8 FORMAT "%5.1" ECU_ADDRESS 0x60010957 /end MEASUREMENT
/begin MEASUREMENT InjVvG_CvoAdpn_DeltaTiBal_SwCyl1_Vcos4_Press1 "delta ti adaption value in ballistic for cylinder 1, viscocity 4 and pressure 1" SBYTE IVGdiCtl_CvoAdpn_t_q0p8us_o51p2 1 100 -51.2 152.8 FORMAT "%5.1" ECU_ADDRESS 0x60010956 /end MEASUREMENT
/begin MEASUREMENT InjVvG_CvoAdpn_DeltaTiBal_SwCyl1_Vcos4_Press2 "delta ti adaption value in ballistic for cylinder 1, viscocity 4 and pressure 2" SBYTE IVGdiCtl_CvoAdpn_t_q0p8us_o51p2 1 100 -51.2 152.8 FORMAT "%5.1" ECU_ADDRESS 0x60010955 /end MEASUREMENT
/begin MEASUREMENT InjVvG_CvoAdpn_DeltaTiBal_SwCyl1_Vcos4_Press3 "delta ti adaption value in ballistic for cylinder 1, viscocity 4 and pressure 3" SBYTE IVGdiCtl_CvoAdpn_t_q0p8us_o51p2 1 100 -51.2 152.8 FORMAT "%5.1" ECU_ADDRESS 0x60010954 /end MEASUREMENT
/begin MEASUREMENT InjVvG_CvoAdpn_DeltaTiBal_SwCyl1_Vcos4_Press4 "delta ti adaption value in ballistic for cylinder 1, viscocity 4 and pressure 4" SBYTE IVGdiCtl_CvoAdpn_t_q0p8us_o51p2 1 100 -51.2 152.8 FORMAT "%5.1" ECU_ADDRESS 0x60010953 /end MEASUREMENT
/begin MEASUREMENT InjVvG_CvoAdpn_DeltaTiBal_SwCyl1_Vcos5_Press0 "delta ti adaption value in ballistic for cylinder 1, viscocity 5 and pressure 0" SBYTE IVGdiCtl_CvoAdpn_t_q0p8us_o51p2 1 100 -51.2 152.8 FORMAT "%5.1" ECU_ADDRESS 0x60010952 /end MEASUREMENT
/begin MEASUREMENT InjVvG_CvoAdpn_DeltaTiBal_SwCyl1_Vcos5_Press1 "delta ti adaption value in ballistic for cylinder 1, viscocity 5 and pressure 1" SBYTE IVGdiCtl_CvoAdpn_t_q0p8us_o51p2 1 100 -51.2 152.8 FORMAT "%5.1" ECU_ADDRESS 0x60010951 /end MEASUREMENT
/begin MEASUREMENT InjVvG_CvoAdpn_DeltaTiBal_SwCyl1_Vcos5_Press2 "delta ti adaption value in ballistic for cylinder 1, viscocity 5 and pressure 2" SBYTE IVGdiCtl_CvoAdpn_t_q0p8us_o51p2 1 100 -51.2 152.8 FORMAT "%5.1" ECU_ADDRESS 0x60010950 /end MEASUREMENT
/begin MEASUREMENT InjVvG_CvoAdpn_DeltaTiBal_SwCyl1_Vcos5_Press3 "delta ti adaption value in ballistic for cylinder 1, viscocity 5 and pressure 3" SBYTE IVGdiCtl_CvoAdpn_t_q0p8us_o51p2 1 100 -51.2 152.8 FORMAT "%5.1" ECU_ADDRESS 0x6001094F /end MEASUREMENT
/begin MEASUREMENT InjVvG_CvoAdpn_DeltaTiBal_SwCyl1_Vcos5_Press4 "delta ti adaption value in ballistic for cylinder 1, viscocity 5 and pressure 4" SBYTE IVGdiCtl_CvoAdpn_t_q0p8us_o51p2 1 100 -51.2 152.8 FORMAT "%5.1" ECU_ADDRESS 0x6001094E /end MEASUREMENT
/begin MEASUREMENT InjVvG_CvoAdpn_DeltaTiBal_SwCyl2_Vcos0_Press0 "delta ti adaption value in ballistic for cylinder 2, viscocity 0 and pressure 0" SBYTE IVGdiCtl_CvoAdpn_t_q0p8us_o51p2 1 100 -51.2 152.8 FORMAT "%5.1" ECU_ADDRESS 0x6001094D /end MEASUREMENT
/begin MEASUREMENT InjVvG_CvoAdpn_DeltaTiBal_SwCyl2_Vcos0_Press1 "delta ti adaption value in ballistic for cylinder 2, viscocity 0 and pressure 1" SBYTE IVGdiCtl_CvoAdpn_t_q0p8us_o51p2 1 100 -51.2 152.8 FORMAT "%5.1" ECU_ADDRESS 0x6001094C /end MEASUREMENT
/begin MEASUREMENT InjVvG_CvoAdpn_DeltaTiBal_SwCyl2_Vcos0_Press2 "delta ti adaption value in ballistic for cylinder 2, viscocity 0 and pressure 2" SBYTE IVGdiCtl_CvoAdpn_t_q0p8us_o51p2 1 100 -51.2 152.8 FORMAT "%5.1" ECU_ADDRESS 0x6001094B /end MEASUREMENT
/begin MEASUREMENT InjVvG_CvoAdpn_DeltaTiBal_SwCyl2_Vcos0_Press3 "delta ti adaption value in ballistic for cylinder 2, viscocity 0 and pressure 3" SBYTE IVGdiCtl_CvoAdpn_t_q0p8us_o51p2 1 100 -51.2 152.8 FORMAT "%5.1" ECU_ADDRESS 0x6001094A /end MEASUREMENT
/begin MEASUREMENT InjVvG_CvoAdpn_DeltaTiBal_SwCyl2_Vcos0_Press4 "delta ti adaption value in ballistic for cylinder 2, viscocity 0 and pressure 4" SBYTE IVGdiCtl_CvoAdpn_t_q0p8us_o51p2 1 100 -51.2 152.8 FORMAT "%5.1" ECU_ADDRESS 0x60010949 /end MEASUREMENT
/begin MEASUREMENT InjVvG_CvoAdpn_DeltaTiBal_SwCyl2_Vcos1_Press0 "delta ti adaption value in ballistic for cylinder 2, viscocity 1 and pressure 0" SBYTE IVGdiCtl_CvoAdpn_t_q0p8us_o51p2 1 100 -51.2 152.8 FORMAT "%5.1" ECU_ADDRESS 0x60010948 /end MEASUREMENT
/begin MEASUREMENT InjVvG_CvoAdpn_DeltaTiBal_SwCyl2_Vcos1_Press1 "delta ti adaption value in ballistic for cylinder 2, viscocity 1 and pressure 1" SBYTE IVGdiCtl_CvoAdpn_t_q0p8us_o51p2 1 100 -51.2 152.8 FORMAT "%5.1" ECU_ADDRESS 0x60010947 /end MEASUREMENT
/begin MEASUREMENT InjVvG_CvoAdpn_DeltaTiBal_SwCyl2_Vcos1_Press2 "delta ti adaption value in ballistic for cylinder 2, viscocity 1 and pressure 2" SBYTE IVGdiCtl_CvoAdpn_t_q0p8us_o51p2 1 100 -51.2 152.8 FORMAT "%5.1" ECU_ADDRESS 0x60010946 /end MEASUREMENT
/begin MEASUREMENT InjVvG_CvoAdpn_DeltaTiBal_SwCyl2_Vcos1_Press3 "delta ti adaption value in ballistic for cylinder 2, viscocity 1 and pressure 3" SBYTE IVGdiCtl_CvoAdpn_t_q0p8us_o51p2 1 100 -51.2 152.8 FORMAT "%5.1" ECU_ADDRESS 0x60010945 /end MEASUREMENT
/begin MEASUREMENT InjVvG_CvoAdpn_DeltaTiBal_SwCyl2_Vcos1_Press4 "delta ti adaption value in ballistic for cylinder 2, viscocity 1 and pressure 4" SBYTE IVGdiCtl_CvoAdpn_t_q0p8us_o51p2 1 100 -51.2 152.8 FORMAT "%5.1" ECU_ADDRESS 0x60010944 /end MEASUREMENT
/begin MEASUREMENT InjVvG_CvoAdpn_DeltaTiBal_SwCyl2_Vcos2_Press0 "delta ti adaption value in ballistic for cylinder 2, viscocity 2 and pressure 0" SBYTE IVGdiCtl_CvoAdpn_t_q0p8us_o51p2 1 100 -51.2 152.8 FORMAT "%5.1" ECU_ADDRESS 0x60010943 /end MEASUREMENT
/begin MEASUREMENT InjVvG_CvoAdpn_DeltaTiBal_SwCyl2_Vcos2_Press1 "delta ti adaption value in ballistic for cylinder 2, viscocity 2 and pressure 1" SBYTE IVGdiCtl_CvoAdpn_t_q0p8us_o51p2 1 100 -51.2 152.8 FORMAT "%5.1" ECU_ADDRESS 0x60010942 /end MEASUREMENT
/begin MEASUREMENT InjVvG_CvoAdpn_DeltaTiBal_SwCyl2_Vcos2_Press2 "delta ti adaption value in ballistic for cylinder 2, viscocity 2 and pressure 2" SBYTE IVGdiCtl_CvoAdpn_t_q0p8us_o51p2 1 100 -51.2 152.8 FORMAT "%5.1" ECU_ADDRESS 0x60010941 /end MEASUREMENT
/begin MEASUREMENT InjVvG_CvoAdpn_DeltaTiBal_SwCyl2_Vcos2_Press3 "delta ti adaption value in ballistic for cylinder 2, viscocity 2 and pressure 3" SBYTE IVGdiCtl_CvoAdpn_t_q0p8us_o51p2 1 100 -51.2 152.8 FORMAT "%5.1" ECU_ADDRESS 0x60010940 /end MEASUREMENT
/begin MEASUREMENT InjVvG_CvoAdpn_DeltaTiBal_SwCyl2_Vcos2_Press4 "delta ti adaption value in ballistic for cylinder 2, viscocity 2 and pressure 4" SBYTE IVGdiCtl_CvoAdpn_t_q0p8us_o51p2 1 100 -51.2 152.8 FORMAT "%5.1" ECU_ADDRESS 0x6001093F /end MEASUREMENT
/begin MEASUREMENT InjVvG_CvoAdpn_DeltaTiBal_SwCyl2_Vcos3_Press0 "delta ti adaption value in ballistic for cylinder 2, viscocity 3 and pressure 0" SBYTE IVGdiCtl_CvoAdpn_t_q0p8us_o51p2 1 100 -51.2 152.8 FORMAT "%5.1" ECU_ADDRESS 0x6001093E /end MEASUREMENT
/begin MEASUREMENT InjVvG_CvoAdpn_DeltaTiBal_SwCyl2_Vcos3_Press1 "delta ti adaption value in ballistic for cylinder 2, viscocity 3 and pressure 1" SBYTE IVGdiCtl_CvoAdpn_t_q0p8us_o51p2 1 100 -51.2 152.8 FORMAT "%5.1" ECU_ADDRESS 0x6001093D /end MEASUREMENT
/begin MEASUREMENT InjVvG_CvoAdpn_DeltaTiBal_SwCyl2_Vcos3_Press2 "delta ti adaption value in ballistic for cylinder 2, viscocity 3 and pressure 2" SBYTE IVGdiCtl_CvoAdpn_t_q0p8us_o51p2 1 100 -51.2 152.8 FORMAT "%5.1" ECU_ADDRESS 0x6001093C /end MEASUREMENT
/begin MEASUREMENT InjVvG_CvoAdpn_DeltaTiBal_SwCyl2_Vcos3_Press3 "delta ti adaption value in ballistic for cylinder 2, viscocity 3 and pressure 3" SBYTE IVGdiCtl_CvoAdpn_t_q0p8us_o51p2 1 100 -51.2 152.8 FORMAT "%5.1" ECU_ADDRESS 0x6001093B /end MEASUREMENT
/begin MEASUREMENT InjVvG_CvoAdpn_DeltaTiBal_SwCyl2_Vcos3_Press4 "delta ti adaption value in ballistic for cylinder 2, viscocity 3 and pressure 4" SBYTE IVGdiCtl_CvoAdpn_t_q0p8us_o51p2 1 100 -51.2 152.8 FORMAT "%5.1" ECU_ADDRESS 0x6001093A /end MEASUREMENT
/begin MEASUREMENT InjVvG_CvoAdpn_DeltaTiBal_SwCyl2_Vcos4_Press0 "delta ti adaption value in ballistic for cylinder 2, viscocity 4 and pressure 0" SBYTE IVGdiCtl_CvoAdpn_t_q0p8us_o51p2 1 100 -51.2 152.8 FORMAT "%5.1" ECU_ADDRESS 0x60010939 /end MEASUREMENT
/begin MEASUREMENT InjVvG_CvoAdpn_DeltaTiBal_SwCyl2_Vcos4_Press1 "delta ti adaption value in ballistic for cylinder 2, viscocity 4 and pressure 1" SBYTE IVGdiCtl_CvoAdpn_t_q0p8us_o51p2 1 100 -51.2 152.8 FORMAT "%5.1" ECU_ADDRESS 0x60010938 /end MEASUREMENT
/begin MEASUREMENT InjVvG_CvoAdpn_DeltaTiBal_SwCyl2_Vcos4_Press2 "delta ti adaption value in ballistic for cylinder 2, viscocity 4 and pressure 2" SBYTE IVGdiCtl_CvoAdpn_t_q0p8us_o51p2 1 100 -51.2 152.8 FORMAT "%5.1" ECU_ADDRESS 0x60010937 /end MEASUREMENT
/begin MEASUREMENT InjVvG_CvoAdpn_DeltaTiBal_SwCyl2_Vcos4_Press3 "delta ti adaption value in ballistic for cylinder 2, viscocity 4 and pressure 3" SBYTE IVGdiCtl_CvoAdpn_t_q0p8us_o51p2 1 100 -51.2 152.8 FORMAT "%5.1" ECU_ADDRESS 0x60010936 /end MEASUREMENT
/begin MEASUREMENT InjVvG_CvoAdpn_DeltaTiBal_SwCyl2_Vcos4_Press4 "delta ti adaption value in ballistic for cylinder 2, viscocity 4 and pressure 4" SBYTE IVGdiCtl_CvoAdpn_t_q0p8us_o51p2 1 100 -51.2 152.8 FORMAT "%5.1" ECU_ADDRESS 0x60010935 /end MEASUREMENT
/begin MEASUREMENT InjVvG_CvoAdpn_DeltaTiBal_SwCyl2_Vcos5_Press0 "delta ti adaption value in ballistic for cylinder 2, viscocity 5 and pressure 0" SBYTE IVGdiCtl_CvoAdpn_t_q0p8us_o51p2 1 100 -51.2 152.8 FORMAT "%5.1" ECU_ADDRESS 0x60010934 /end MEASUREMENT
/begin MEASUREMENT InjVvG_CvoAdpn_DeltaTiBal_SwCyl2_Vcos5_Press1 "delta ti adaption value in ballistic for cylinder 2, viscocity 5 and pressure 1" SBYTE IVGdiCtl_CvoAdpn_t_q0p8us_o51p2 1 100 -51.2 152.8 FORMAT "%5.1" ECU_ADDRESS 0x60010933 /end MEASUREMENT
/begin MEASUREMENT InjVvG_CvoAdpn_DeltaTiBal_SwCyl2_Vcos5_Press2 "delta ti adaption value in ballistic for cylinder 2, viscocity 5 and pressure 2" SBYTE IVGdiCtl_CvoAdpn_t_q0p8us_o51p2 1 100 -51.2 152.8 FORMAT "%5.1" ECU_ADDRESS 0x60010932 /end MEASUREMENT
/begin MEASUREMENT InjVvG_CvoAdpn_DeltaTiBal_SwCyl2_Vcos5_Press3 "delta ti adaption value in ballistic for cylinder 2, viscocity 5 and pressure 3" SBYTE IVGdiCtl_CvoAdpn_t_q0p8us_o51p2 1 100 -51.2 152.8 FORMAT "%5.1" ECU_ADDRESS 0x60010931 /end MEASUREMENT
/begin MEASUREMENT InjVvG_CvoAdpn_DeltaTiBal_SwCyl2_Vcos5_Press4 "delta ti adaption value in ballistic for cylinder 2, viscocity 5 and pressure 4" SBYTE IVGdiCtl_CvoAdpn_t_q0p8us_o51p2 1 100 -51.2 152.8 FORMAT "%5.1" ECU_ADDRESS 0x60010930 /end MEASUREMENT
/begin MEASUREMENT InjVvG_CvoAdpn_DeltaTiBal_SwCyl3_Vcos0_Press0 "delta ti adaption value in ballistic for cylinder 3, viscocity 0 and pressure 0" SBYTE IVGdiCtl_CvoAdpn_t_q0p8us_o51p2 1 100 -51.2 152.8 FORMAT "%5.1" ECU_ADDRESS 0x6001092F /end MEASUREMENT
/begin MEASUREMENT InjVvG_CvoAdpn_DeltaTiBal_SwCyl3_Vcos0_Press1 "delta ti adaption value in ballistic for cylinder 3, viscocity 0 and pressure 1" SBYTE IVGdiCtl_CvoAdpn_t_q0p8us_o51p2 1 100 -51.2 152.8 FORMAT "%5.1" ECU_ADDRESS 0x6001092E /end MEASUREMENT
/begin MEASUREMENT InjVvG_CvoAdpn_DeltaTiBal_SwCyl3_Vcos0_Press2 "delta ti adaption value in ballistic for cylinder 3, viscocity 0 and pressure 2" SBYTE IVGdiCtl_CvoAdpn_t_q0p8us_o51p2 1 100 -51.2 152.8 FORMAT "%5.1" ECU_ADDRESS 0x6001092D /end MEASUREMENT
/begin MEASUREMENT InjVvG_CvoAdpn_DeltaTiBal_SwCyl3_Vcos0_Press3 "delta ti adaption value in ballistic for cylinder 3, viscocity 0 and pressure 3" SBYTE IVGdiCtl_CvoAdpn_t_q0p8us_o51p2 1 100 -51.2 152.8 FORMAT "%5.1" ECU_ADDRESS 0x6001092C /end MEASUREMENT
/begin MEASUREMENT InjVvG_CvoAdpn_DeltaTiBal_SwCyl3_Vcos0_Press4 "delta ti adaption value in ballistic for cylinder 3, viscocity 0 and pressure 4" SBYTE IVGdiCtl_CvoAdpn_t_q0p8us_o51p2 1 100 -51.2 152.8 FORMAT "%5.1" ECU_ADDRESS 0x6001092B /end MEASUREMENT
/begin MEASUREMENT InjVvG_CvoAdpn_DeltaTiBal_SwCyl3_Vcos1_Press0 "delta ti adaption value in ballistic for cylinder 3, viscocity 1 and pressure 0" SBYTE IVGdiCtl_CvoAdpn_t_q0p8us_o51p2 1 100 -51.2 152.8 FORMAT "%5.1" ECU_ADDRESS 0x6001092A /end MEASUREMENT
/begin MEASUREMENT InjVvG_CvoAdpn_DeltaTiBal_SwCyl3_Vcos1_Press1 "delta ti adaption value in ballistic for cylinder 3, viscocity 1 and pressure 1" SBYTE IVGdiCtl_CvoAdpn_t_q0p8us_o51p2 1 100 -51.2 152.8 FORMAT "%5.1" ECU_ADDRESS 0x60010929 /end MEASUREMENT
/begin MEASUREMENT InjVvG_CvoAdpn_DeltaTiBal_SwCyl3_Vcos1_Press2 "delta ti adaption value in ballistic for cylinder 3, viscocity 1 and pressure 2" SBYTE IVGdiCtl_CvoAdpn_t_q0p8us_o51p2 1 100 -51.2 152.8 FORMAT "%5.1" ECU_ADDRESS 0x60010928 /end MEASUREMENT
/begin MEASUREMENT InjVvG_CvoAdpn_DeltaTiBal_SwCyl3_Vcos1_Press3 "delta ti adaption value in ballistic for cylinder 3, viscocity 1 and pressure 3" SBYTE IVGdiCtl_CvoAdpn_t_q0p8us_o51p2 1 100 -51.2 152.8 FORMAT "%5.1" ECU_ADDRESS 0x60010927 /end MEASUREMENT
/begin MEASUREMENT InjVvG_CvoAdpn_DeltaTiBal_SwCyl3_Vcos1_Press4 "delta ti adaption value in ballistic for cylinder 3, viscocity 1 and pressure 4" SBYTE IVGdiCtl_CvoAdpn_t_q0p8us_o51p2 1 100 -51.2 152.8 FORMAT "%5.1" ECU_ADDRESS 0x60010926 /end MEASUREMENT
/begin MEASUREMENT InjVvG_CvoAdpn_DeltaTiBal_SwCyl3_Vcos2_Press0 "delta ti adaption value in ballistic for cylinder 3, viscocity 2 and pressure 0" SBYTE IVGdiCtl_CvoAdpn_t_q0p8us_o51p2 1 100 -51.2 152.8 FORMAT "%5.1" ECU_ADDRESS 0x60010925 /end MEASUREMENT
/begin MEASUREMENT InjVvG_CvoAdpn_DeltaTiBal_SwCyl3_Vcos2_Press1 "delta ti adaption value in ballistic for cylinder 3, viscocity 2 and pressure 1" SBYTE IVGdiCtl_CvoAdpn_t_q0p8us_o51p2 1 100 -51.2 152.8 FORMAT "%5.1" ECU_ADDRESS 0x60010924 /end MEASUREMENT
/begin MEASUREMENT InjVvG_CvoAdpn_DeltaTiBal_SwCyl3_Vcos2_Press2 "delta ti adaption value in ballistic for cylinder 3, viscocity 2 and pressure 2" SBYTE IVGdiCtl_CvoAdpn_t_q0p8us_o51p2 1 100 -51.2 152.8 FORMAT "%5.1" ECU_ADDRESS 0x60010923 /end MEASUREMENT
/begin MEASUREMENT InjVvG_CvoAdpn_DeltaTiBal_SwCyl3_Vcos2_Press3 "delta ti adaption value in ballistic for cylinder 3, viscocity 2 and pressure 3" SBYTE IVGdiCtl_CvoAdpn_t_q0p8us_o51p2 1 100 -51.2 152.8 FORMAT "%5.1" ECU_ADDRESS 0x60010922 /end MEASUREMENT
/begin MEASUREMENT InjVvG_CvoAdpn_DeltaTiBal_SwCyl3_Vcos2_Press4 "delta ti adaption value in ballistic for cylinder 3, viscocity 2 and pressure 4" SBYTE IVGdiCtl_CvoAdpn_t_q0p8us_o51p2 1 100 -51.2 152.8 FORMAT "%5.1" ECU_ADDRESS 0x60010921 /end MEASUREMENT
/begin MEASUREMENT InjVvG_CvoAdpn_DeltaTiBal_SwCyl3_Vcos3_Press0 "delta ti adaption value in ballistic for cylinder 3, viscocity 3 and pressure 0" SBYTE IVGdiCtl_CvoAdpn_t_q0p8us_o51p2 1 100 -51.2 152.8 FORMAT "%5.1" ECU_ADDRESS 0x60010920 /end MEASUREMENT
/begin MEASUREMENT InjVvG_CvoAdpn_DeltaTiBal_SwCyl3_Vcos3_Press1 "delta ti adaption value in ballistic for cylinder 3, viscocity 3 and pressure 1" SBYTE IVGdiCtl_CvoAdpn_t_q0p8us_o51p2 1 100 -51.2 152.8 FORMAT "%5.1" ECU_ADDRESS 0x6001091F /end MEASUREMENT
/begin MEASUREMENT InjVvG_CvoAdpn_DeltaTiBal_SwCyl3_Vcos3_Press2 "delta ti adaption value in ballistic for cylinder 3, viscocity 3 and pressure 2" SBYTE IVGdiCtl_CvoAdpn_t_q0p8us_o51p2 1 100 -51.2 152.8 FORMAT "%5.1" ECU_ADDRESS 0x6001091E /end MEASUREMENT
/begin MEASUREMENT InjVvG_CvoAdpn_DeltaTiBal_SwCyl3_Vcos3_Press3 "delta ti adaption value in ballistic for cylinder 3, viscocity 3 and pressure 3" SBYTE IVGdiCtl_CvoAdpn_t_q0p8us_o51p2 1 100 -51.2 152.8 FORMAT "%5.1" ECU_ADDRESS 0x6001091D /end MEASUREMENT
/begin MEASUREMENT InjVvG_CvoAdpn_DeltaTiBal_SwCyl3_Vcos3_Press4 "delta ti adaption value in ballistic for cylinder 3, viscocity 3 and pressure 4" SBYTE IVGdiCtl_CvoAdpn_t_q0p8us_o51p2 1 100 -51.2 152.8 FORMAT "%5.1" ECU_ADDRESS 0x6001091C /end MEASUREMENT
/begin MEASUREMENT InjVvG_CvoAdpn_DeltaTiBal_SwCyl3_Vcos4_Press0 "delta ti adaption value in ballistic for cylinder 3, viscocity 4 and pressure 0" SBYTE IVGdiCtl_CvoAdpn_t_q0p8us_o51p2 1 100 -51.2 152.8 FORMAT "%5.1" ECU_ADDRESS 0x6001091B /end MEASUREMENT
/begin MEASUREMENT InjVvG_CvoAdpn_DeltaTiBal_SwCyl3_Vcos4_Press1 "delta ti adaption value in ballistic for cylinder 3, viscocity 4 and pressure 1" SBYTE IVGdiCtl_CvoAdpn_t_q0p8us_o51p2 1 100 -51.2 152.8 FORMAT "%5.1" ECU_ADDRESS 0x6001091A /end MEASUREMENT
/begin MEASUREMENT InjVvG_CvoAdpn_DeltaTiBal_SwCyl3_Vcos4_Press2 "delta ti adaption value in ballistic for cylinder 3, viscocity 4 and pressure 2" SBYTE IVGdiCtl_CvoAdpn_t_q0p8us_o51p2 1 100 -51.2 152.8 FORMAT "%5.1" ECU_ADDRESS 0x60010919 /end MEASUREMENT
/begin MEASUREMENT InjVvG_CvoAdpn_DeltaTiBal_SwCyl3_Vcos4_Press3 "delta ti adaption value in ballistic for cylinder 3, viscocity 4 and pressure 3" SBYTE IVGdiCtl_CvoAdpn_t_q0p8us_o51p2 1 100 -51.2 152.8 FORMAT "%5.1" ECU_ADDRESS 0x60010918 /end MEASUREMENT
/begin MEASUREMENT InjVvG_CvoAdpn_DeltaTiBal_SwCyl3_Vcos4_Press4 "delta ti adaption value in ballistic for cylinder 3, viscocity 4 and pressure 4" SBYTE IVGdiCtl_CvoAdpn_t_q0p8us_o51p2 1 100 -51.2 152.8 FORMAT "%5.1" ECU_ADDRESS 0x60010917 /end MEASUREMENT
/begin MEASUREMENT InjVvG_CvoAdpn_DeltaTiBal_SwCyl3_Vcos5_Press0 "delta ti adaption value in ballistic for cylinder 3, viscocity 5 and pressure 0" SBYTE IVGdiCtl_CvoAdpn_t_q0p8us_o51p2 1 100 -51.2 152.8 FORMAT "%5.1" ECU_ADDRESS 0x60010916 /end MEASUREMENT
/begin MEASUREMENT InjVvG_CvoAdpn_DeltaTiBal_SwCyl3_Vcos5_Press1 "delta ti adaption value in ballistic for cylinder 3, viscocity 5 and pressure 1" SBYTE IVGdiCtl_CvoAdpn_t_q0p8us_o51p2 1 100 -51.2 152.8 FORMAT "%5.1" ECU_ADDRESS 0x60010915 /end MEASUREMENT
/begin MEASUREMENT InjVvG_CvoAdpn_DeltaTiBal_SwCyl3_Vcos5_Press2 "delta ti adaption value in ballistic for cylinder 3, viscocity 5 and pressure 2" SBYTE IVGdiCtl_CvoAdpn_t_q0p8us_o51p2 1 100 -51.2 152.8 FORMAT "%5.1" ECU_ADDRESS 0x60010914 /end MEASUREMENT
/begin MEASUREMENT InjVvG_CvoAdpn_DeltaTiBal_SwCyl3_Vcos5_Press3 "delta ti adaption value in ballistic for cylinder 3, viscocity 5 and pressure 3" SBYTE IVGdiCtl_CvoAdpn_t_q0p8us_o51p2 1 100 -51.2 152.8 FORMAT "%5.1" ECU_ADDRESS 0x60010913 /end MEASUREMENT
/begin MEASUREMENT InjVvG_CvoAdpn_DeltaTiBal_SwCyl3_Vcos5_Press4 "delta ti adaption value in ballistic for cylinder 3, viscocity 5 and pressure 4" SBYTE IVGdiCtl_CvoAdpn_t_q0p8us_o51p2 1 100 -51.2 152.8 FORMAT "%5.1" ECU_ADDRESS 0x60010912 /end MEASUREMENT
/begin MEASUREMENT InjVvG_CvoAdpn_DrgPtr_dtiCorrnBal_Max_Vcos0 "drag pointer for maximum injection time correction dti in ballistic area, for viscosity selection 0" SBYTE t_q2p0_us 1 100 -256.0 254.0 FORMAT "%5.1" ARRAY_SIZE 4 ECU_ADDRESS 0x700041EE /end MEASUREMENT
/begin MEASUREMENT InjVvG_CvoAdpn_DrgPtr_dtiCorrnBal_Max_Vcos1 "drag pointer for maximum injection time correction dti in ballistic area, for viscosity selection 1" SBYTE t_q2p0_us 1 100 -256.0 254.0 FORMAT "%5.1" ARRAY_SIZE 4 ECU_ADDRESS 0x700041EA /end MEASUREMENT
/begin MEASUREMENT InjVvG_CvoAdpn_DrgPtr_dtiCorrnBal_Min_Vcos0 "drag pointer for minimum injection time correction dti in ballistic area, for viscosity selection 0" SBYTE t_q2p0_us 1 100 -256.0 254.0 FORMAT "%5.1" ARRAY_SIZE 4 ECU_ADDRESS 0x700041E6 /end MEASUREMENT
/begin MEASUREMENT InjVvG_CvoAdpn_DrgPtr_dtiCorrnBal_Min_Vcos1 "drag pointer for minimum injection time correction dti in ballistic area, for viscosity selection 1" SBYTE t_q2p0_us 1 100 -256.0 254.0 FORMAT "%5.1" ARRAY_SIZE 4 ECU_ADDRESS 0x700041E2 /end MEASUREMENT
/begin MEASUREMENT InjVvG_CvoAdpn_DrgPtr_tantot_Max_Vcos0 "drag pointer for the maximum opening delay time (tantot) for viscosity selection 0" UBYTE t_q0p004_ms 1 100 0.00 1.020 FORMAT "%5.3" ARRAY_SIZE 4 ECU_ADDRESS 0x700041DE /end MEASUREMENT
/begin MEASUREMENT InjVvG_CvoAdpn_DrgPtr_tantot_Max_Vcos1 "drag pointer for the maximum opening delay time (tantot) for viscosity selection 1" UBYTE t_q0p004_ms 1 100 0.00 1.020 FORMAT "%5.3" ARRAY_SIZE 4 ECU_ADDRESS 0x700041DA /end MEASUREMENT
/begin MEASUREMENT InjVvG_CvoAdpn_DrgPtr_tantot_Min_Vcos0 "drag pointer for the minimum opening delay time (tantot) for viscosity selection 0" UBYTE t_q0p004_ms 1 100 0.00 1.020 FORMAT "%5.3" ARRAY_SIZE 4 ECU_ADDRESS 0x700041D6 /end MEASUREMENT
/begin MEASUREMENT InjVvG_CvoAdpn_DrgPtr_tantot_Min_Vcos1 "drag pointer for the minimum opening delay time (tantot) for viscosity selection 1" UBYTE t_q0p004_ms 1 100 0.00 1.020 FORMAT "%5.3" ARRAY_SIZE 4 ECU_ADDRESS 0x700041D2 /end MEASUREMENT
/begin MEASUREMENT InjVvG_CvoAdpn_dtidtopenEB_SwCyl0 "?Controlled valve operation? (CVO) ballistic gradient of characteristic curve of the gasoline injector for cylinder 0" SWORD fak_sw_b2 1 100 -2.000000 1.999939 FORMAT "%8.6" ECU_ADDRESS 0x60009E00 /end MEASUREMENT
/begin MEASUREMENT InjVvG_CvoAdpn_dtidtopenEB_SwCyl1 "?Controlled valve operation? (CVO) ballistic gradient of characteristic curve of the gasoline injector for cylinder 1" SWORD fak_sw_b2 1 100 -2.000000 1.999939 FORMAT "%8.6" ECU_ADDRESS 0x60009DFE /end MEASUREMENT
/begin MEASUREMENT InjVvG_CvoAdpn_dtidtopenEB_SwCyl2 "?Controlled valve operation? (CVO) ballistic gradient of characteristic curve of the gasoline injector for cylinder 2" SWORD fak_sw_b2 1 100 -2.000000 1.999939 FORMAT "%8.6" ECU_ADDRESS 0x60009DFC /end MEASUREMENT
/begin MEASUREMENT InjVvG_CvoAdpn_dtidtopenEB_SwCyl3 "?Controlled valve operation? (CVO) ballistic gradient of characteristic curve of the gasoline injector for cylinder 3" SWORD fak_sw_b2 1 100 -2.000000 1.999939 FORMAT "%8.6" ECU_ADDRESS 0x60009DFA /end MEASUREMENT
/begin MEASUREMENT InjVvG_CvoAdpn_flgRelCtrl "Release for online controller (regulation in all operation areas possible)" UBYTE B_TRUE 1 100 0.00 1.00000000000 BIT_MASK 0x1 FORMAT "%13.11" ECU_ADDRESS 0x6000F8DF /end MEASUREMENT
/begin MEASUREMENT InjVvG_CvoAdpn_FullLft_DeltaTi_SwCyl0 "?Controlled valve operation? (CVO) injection time correction for gasoline injector operating time for full lift injections for cylinder 0" SWORD t_q0p1_us 1 100 -3276.800 3276.700 FORMAT "%8.3" ECU_ADDRESS 0x60009E18 /end MEASUREMENT
/begin MEASUREMENT InjVvG_CvoAdpn_FullLft_DeltaTi_SwCyl1 "?Controlled valve operation? (CVO) injection time correction for gasoline injector operating time for full lift injections for cylinder 1" SWORD t_q0p1_us 1 100 -3276.800 3276.700 FORMAT "%8.3" ECU_ADDRESS 0x60009E16 /end MEASUREMENT
/begin MEASUREMENT InjVvG_CvoAdpn_FullLft_DeltaTi_SwCyl2 "?Controlled valve operation? (CVO) injection time correction for gasoline injector operating time for full lift injections for cylinder 2" SWORD t_q0p1_us 1 100 -3276.800 3276.700 FORMAT "%8.3" ECU_ADDRESS 0x60009E14 /end MEASUREMENT
/begin MEASUREMENT InjVvG_CvoAdpn_FullLft_DeltaTi_SwCyl3 "?Controlled valve operation? (CVO) injection time correction for gasoline injector operating time for full lift injections for cylinder 3" SWORD t_q0p1_us 1 100 -3276.800 3276.700 FORMAT "%8.3" ECU_ADDRESS 0x60009E12 /end MEASUREMENT
/begin MEASUREMENT InjVvG_CvoAdpn_FullLft_tab_SwCyl0 "?Controlled valve operation? (CVO) adaption value for gasoline injector deactivation delay time for full lift injections for cylinder 0" UWORD t_q0p1_us 1 100 0.00 6553.500 FORMAT "%8.3" ECU_ADDRESS 0x60009E10 /end MEASUREMENT
/begin MEASUREMENT InjVvG_CvoAdpn_FullLft_tab_SwCyl1 "?Controlled valve operation? (CVO) adaption value for gasoline injector deactivation delay time for full lift injections for cylinder 1" UWORD t_q0p1_us 1 100 0.00 6553.500 FORMAT "%8.3" ECU_ADDRESS 0x60009E0E /end MEASUREMENT
/begin MEASUREMENT InjVvG_CvoAdpn_FullLft_tab_SwCyl2 "?Controlled valve operation? (CVO) adaption value for gasoline injector deactivation delay time for full lift injections for cylinder 2" UWORD t_q0p1_us 1 100 0.00 6553.500 FORMAT "%8.3" ECU_ADDRESS 0x60009E0C /end MEASUREMENT
/begin MEASUREMENT InjVvG_CvoAdpn_FullLft_tab_SwCyl3 "?Controlled valve operation? (CVO) adaption value for gasoline injector deactivation delay time for full lift injections for cylinder 3" UWORD t_q0p1_us 1 100 0.00 6553.500 FORMAT "%8.3" ECU_ADDRESS 0x60009E0A /end MEASUREMENT
/begin MEASUREMENT InjVvG_CvoAdpn_InjCntr "?Controlled valve operation? (CVO) Injection counter of all injections since powerfail" ULONG dez 1 100 0.00 4294967295.00 FORMAT "%13.2" ECU_ADDRESS 0x60004E84 /end MEASUREMENT
/begin MEASUREMENT InjVvG_CvoAdpn_RefTiCorrAry "Correction of the reverse calculated Ti, corresponding to the reference injection setpoint (cylinder specific)" SBYTE t_q0p001_ms 1 100 -0.1280 0.1270 FORMAT "%6.4" ARRAY_SIZE 4 ECU_ADDRESS 0x700035F6 /end MEASUREMENT
/begin MEASUREMENT InjVvG_CvoAdpn_RelCtrlCyl "Release of online control (cylinder individual)" UBYTE dez 1 100 0.00 255.0 FORMAT "%5.1" ECU_ADDRESS 0x700035D0 /end MEASUREMENT
/begin MEASUREMENT InjVvG_CvoAdpn_RmnCylMask "Bitmask: remaining cylinder for adaption" UBYTE dez 1 100 0.00 255.0 FORMAT "%5.1" ECU_ADDRESS 0x700035CF /end MEASUREMENT
/begin MEASUREMENT InjVvG_CvoAdpn_RmnPMask "Bitmask: remaining adaption pressures" UBYTE dez 1 100 0.00 255.0 FORMAT "%5.1" ECU_ADDRESS 0x700035CE /end MEASUREMENT
/begin MEASUREMENT InjVvG_CvoAdpn_stReasBascAdpn "state why a base adaption is requested" UBYTE dez 1 100 0.00 255.0 FORMAT "%5.1" ECU_ADDRESS 0x700035CC /end MEASUREMENT
/begin MEASUREMENT InjVvG_CvoAdpn_Tantot_SwCyl0_Vcos0 "" UWORD t_q0p1_us 1 100 0.00 6553.500 FORMAT "%8.3" ECU_ADDRESS 0x60009E48 /end MEASUREMENT
/begin MEASUREMENT InjVvG_CvoAdpn_Tantot_SwCyl0_Vcos1 "" UWORD t_q0p1_us 1 100 0.00 6553.500 FORMAT "%8.3" ECU_ADDRESS 0x60009E46 /end MEASUREMENT
/begin MEASUREMENT InjVvG_CvoAdpn_Tantot_SwCyl0_Vcos2 "" UWORD t_q0p1_us 1 100 0.00 6553.500 FORMAT "%8.3" ECU_ADDRESS 0x60009E44 /end MEASUREMENT
/begin MEASUREMENT InjVvG_CvoAdpn_Tantot_SwCyl0_Vcos3 "" UWORD t_q0p1_us 1 100 0.00 6553.500 FORMAT "%8.3" ECU_ADDRESS 0x60009E42 /end MEASUREMENT
/begin MEASUREMENT InjVvG_CvoAdpn_Tantot_SwCyl0_Vcos4 "" UWORD t_q0p1_us 1 100 0.00 6553.500 FORMAT "%8.3" ECU_ADDRESS 0x60009E40 /end MEASUREMENT
/begin MEASUREMENT InjVvG_CvoAdpn_Tantot_SwCyl0_Vcos5 "" UWORD t_q0p1_us 1 100 0.00 6553.500 FORMAT "%8.3" ECU_ADDRESS 0x60009E3E /end MEASUREMENT
/begin MEASUREMENT InjVvG_CvoAdpn_Tantot_SwCyl1_Vcos0 "" UWORD t_q0p1_us 1 100 0.00 6553.500 FORMAT "%8.3" ECU_ADDRESS 0x60009E3C /end MEASUREMENT
/begin MEASUREMENT InjVvG_CvoAdpn_Tantot_SwCyl1_Vcos1 "" UWORD t_q0p1_us 1 100 0.00 6553.500 FORMAT "%8.3" ECU_ADDRESS 0x60009E3A /end MEASUREMENT
/begin MEASUREMENT InjVvG_CvoAdpn_Tantot_SwCyl1_Vcos2 "" UWORD t_q0p1_us 1 100 0.00 6553.500 FORMAT "%8.3" ECU_ADDRESS 0x60009E38 /end MEASUREMENT
/begin MEASUREMENT InjVvG_CvoAdpn_Tantot_SwCyl1_Vcos3 "" UWORD t_q0p1_us 1 100 0.00 6553.500 FORMAT "%8.3" ECU_ADDRESS 0x60009E36 /end MEASUREMENT
/begin MEASUREMENT InjVvG_CvoAdpn_Tantot_SwCyl1_Vcos4 "" UWORD t_q0p1_us 1 100 0.00 6553.500 FORMAT "%8.3" ECU_ADDRESS 0x60009E34 /end MEASUREMENT
/begin MEASUREMENT InjVvG_CvoAdpn_Tantot_SwCyl1_Vcos5 "" UWORD t_q0p1_us 1 100 0.00 6553.500 FORMAT "%8.3" ECU_ADDRESS 0x60009E32 /end MEASUREMENT
/begin MEASUREMENT InjVvG_CvoAdpn_Tantot_SwCyl2_Vcos0 "" UWORD t_q0p1_us 1 100 0.00 6553.500 FORMAT "%8.3" ECU_ADDRESS 0x60009E30 /end MEASUREMENT
/begin MEASUREMENT InjVvG_CvoAdpn_Tantot_SwCyl2_Vcos1 "" UWORD t_q0p1_us 1 100 0.00 6553.500 FORMAT "%8.3" ECU_ADDRESS 0x60009E2E /end MEASUREMENT
/begin MEASUREMENT InjVvG_CvoAdpn_Tantot_SwCyl2_Vcos2 "" UWORD t_q0p1_us 1 100 0.00 6553.500 FORMAT "%8.3" ECU_ADDRESS 0x60009E2C /end MEASUREMENT
/begin MEASUREMENT InjVvG_CvoAdpn_Tantot_SwCyl2_Vcos3 "" UWORD t_q0p1_us 1 100 0.00 6553.500 FORMAT "%8.3" ECU_ADDRESS 0x60009E2A /end MEASUREMENT
/begin MEASUREMENT InjVvG_CvoAdpn_Tantot_SwCyl2_Vcos4 "" UWORD t_q0p1_us 1 100 0.00 6553.500 FORMAT "%8.3" ECU_ADDRESS 0x60009E28 /end MEASUREMENT
/begin MEASUREMENT InjVvG_CvoAdpn_Tantot_SwCyl2_Vcos5 "" UWORD t_q0p1_us 1 100 0.00 6553.500 FORMAT "%8.3" ECU_ADDRESS 0x60009E26 /end MEASUREMENT
/begin MEASUREMENT InjVvG_CvoAdpn_Tantot_SwCyl3_Vcos0 "" UWORD t_q0p1_us 1 100 0.00 6553.500 FORMAT "%8.3" ECU_ADDRESS 0x60009E24 /end MEASUREMENT
/begin MEASUREMENT InjVvG_CvoAdpn_Tantot_SwCyl3_Vcos1 "" UWORD t_q0p1_us 1 100 0.00 6553.500 FORMAT "%8.3" ECU_ADDRESS 0x60009E22 /end MEASUREMENT
/begin MEASUREMENT InjVvG_CvoAdpn_Tantot_SwCyl3_Vcos2 "" UWORD t_q0p1_us 1 100 0.00 6553.500 FORMAT "%8.3" ECU_ADDRESS 0x60009E20 /end MEASUREMENT
/begin MEASUREMENT InjVvG_CvoAdpn_Tantot_SwCyl3_Vcos3 "" UWORD t_q0p1_us 1 100 0.00 6553.500 FORMAT "%8.3" ECU_ADDRESS 0x60009E1E /end MEASUREMENT
/begin MEASUREMENT InjVvG_CvoAdpn_Tantot_SwCyl3_Vcos4 "" UWORD t_q0p1_us 1 100 0.00 6553.500 FORMAT "%8.3" ECU_ADDRESS 0x60009E1C /end MEASUREMENT
/begin MEASUREMENT InjVvG_CvoAdpn_Tantot_SwCyl3_Vcos5 "" UWORD t_q0p1_us 1 100 0.00 6553.500 FORMAT "%8.3" ECU_ADDRESS 0x60009E1A /end MEASUREMENT
/begin MEASUREMENT InjVvG_CvoAdpn_Tran_DeltaTopen_SwCyl0 "?Controlled valve operation? (CVO) opening time deviation in the transition area of the gasoline injector for cylinder 0" SWORD t_q0p1_us 1 100 -3276.800 3276.700 FORMAT "%8.3" ECU_ADDRESS 0x60009E08 /end MEASUREMENT
/begin MEASUREMENT InjVvG_CvoAdpn_Tran_DeltaTopen_SwCyl1 "?Controlled valve operation? (CVO) opening time deviation in the transition area of the gasoline injector for cylinder 1" SWORD t_q0p1_us 1 100 -3276.800 3276.700 FORMAT "%8.3" ECU_ADDRESS 0x60009E06 /end MEASUREMENT
/begin MEASUREMENT InjVvG_CvoAdpn_Tran_DeltaTopen_SwCyl2 "?Controlled valve operation? (CVO) opening time deviation in the transition area of the gasoline injector for cylinder 2" SWORD t_q0p1_us 1 100 -3276.800 3276.700 FORMAT "%8.3" ECU_ADDRESS 0x60009E04 /end MEASUREMENT
/begin MEASUREMENT InjVvG_CvoAdpn_Tran_DeltaTopen_SwCyl3 "?Controlled valve operation? (CVO) opening time deviation in the transition area of the gasoline injector for cylinder 3" SWORD t_q0p1_us 1 100 -3276.800 3276.700 FORMAT "%8.3" ECU_ADDRESS 0x60009E02 /end MEASUREMENT
/begin MEASUREMENT InjVvG_CvoAdpn_Tran_RmnCylMask "Bitmask: remaining cylinder for current adaption pressures in the transition range" UBYTE dez 1 100 0.00 255.0 FORMAT "%5.1" ECU_ADDRESS 0x700035CD /end MEASUREMENT
/begin MEASUREMENT IntkAirT_cntrSTC1HiVld "stuck-check sensor 1: counter for high-phase" UBYTE OneToOne 1 100 0.00 255.0 FORMAT "%5.1" ECU_ADDRESS 0x6000AF68 /end MEASUREMENT
/begin MEASUREMENT IntkAirT_cntrSTC1LoVld "stuck-check sensor 1: counter for low-phase" UBYTE OneToOne 1 100 0.00 255.0 FORMAT "%5.1" ECU_ADDRESS 0x6000AF67 /end MEASUREMENT
/begin MEASUREMENT IntkAirT_cntrSTC2HiVld "stuck-check sensor 2: counter for high-phase" UBYTE OneToOne 1 100 0.00 255.0 FORMAT "%5.1" ECU_ADDRESS 0x6000AF5F /end MEASUREMENT
/begin MEASUREMENT IntkAirT_cntrSTC2LoVld "stuck-check sensor 2: counter for low-phase" UBYTE OneToOne 1 100 0.00 255.0 FORMAT "%5.1" ECU_ADDRESS 0x6000AF5E /end MEASUREMENT
/begin MEASUREMENT IntkAirT_flgAirFltDsReplVld "Condition: Replacement value of the Intake air temperature after air filter is valid" UBYTE B_TRUE 1 100 0.00 1.00000000000 BIT_MASK 0x1 FORMAT "%13.11" ECU_ADDRESS 0x700001D0 /end MEASUREMENT
/begin MEASUREMENT IntkAirT_flgAirFltDsVld "Condition: intake air temperature after air filter is valid" UBYTE B_TRUE 1 100 0.00 1.00000000000 BIT_MASK 0x1 FORMAT "%13.11" ECU_ADDRESS 0x70000865 /end MEASUREMENT
/begin MEASUREMENT IntkAirT_flgDSMClr1000msPlausDiagSnsr1 "DSM Clear requested for intake air temperature sensor 1" UBYTE B_TRUE 1 100 0.00 1.00000000000 BIT_MASK 0x1 FORMAT "%13.11" ECU_ADDRESS 0x6000AF66 /end MEASUREMENT
/begin MEASUREMENT IntkAirT_flgDSMClr1000msPlausDiagSnsr2 "DSM Clear requested for intake air temperature sensor 2" UBYTE B_TRUE 1 100 0.00 1.00000000000 BIT_MASK 0x1 FORMAT "%13.11" ECU_ADDRESS 0x6000AF5D /end MEASUREMENT
/begin MEASUREMENT IntkAirT_flgDSMClr100msPlausDiagSnsr1 "DSM Clear requested for intake air temperature sensor 1" UBYTE B_TRUE 1 100 0.00 1.00000000000 BIT_MASK 0x1 FORMAT "%13.11" ECU_ADDRESS 0x6000AF65 /end MEASUREMENT
/begin MEASUREMENT IntkAirT_flgDSMClr100msPlausDiagSnsr2 "DSM Clear requested for intake air temperature sensor 2" UBYTE B_TRUE 1 100 0.00 1.00000000000 BIT_MASK 0x1 FORMAT "%13.11" ECU_ADDRESS 0x6000AF5C /end MEASUREMENT
/begin MEASUREMENT IntkAirT_flgHSC1Ena "high-side-check sesnor 1: diagnosis (physically) enabled" UBYTE B_TRUE 1 100 0.00 1.00000000000 BIT_MASK 0x1 FORMAT "%13.11" ECU_ADDRESS 0x700001EC /end MEASUREMENT
/begin MEASUREMENT IntkAirT_flgHSC1MaxErr "Error flag of the max.error of the High-Side-Check for sensor 1, debounced" UBYTE B_TRUE 1 100 0.00 1.00000000000 BIT_MASK 0x1 FORMAT "%13.11" ECU_ADDRESS 0x70000858 /end MEASUREMENT
/begin MEASUREMENT IntkAirT_flgHSC1MaxHeal "Healing flag of the max.error of the High-Side-Check for sensor 1, debounced" UBYTE B_TRUE 1 100 0.00 1.00000000000 BIT_MASK 0x1 FORMAT "%13.11" ECU_ADDRESS 0x70000857 /end MEASUREMENT
/begin MEASUREMENT IntkAirT_flgHSC1NumrInc "release iumpr-numerator for the High-Side-Check for intake air temperature sensor 1" UBYTE B_TRUE 1 100 0.00 1.00000000000 BIT_MASK 0x1 FORMAT "%13.11" ECU_ADDRESS 0x700001EB /end MEASUREMENT
/begin MEASUREMENT IntkAirT_flgHSC2Ena "high-side-check sesnor 2: diagnosis (physically) enabled" UBYTE B_TRUE 1 100 0.00 1.00000000000 BIT_MASK 0x1 FORMAT "%13.11" ECU_ADDRESS 0x700001DE /end MEASUREMENT
/begin MEASUREMENT IntkAirT_flgHSC2MaxErr "Error flag of the max.error of the High-Side-Check for sensor 2, debounced" UBYTE B_TRUE 1 100 0.00 1.00000000000 BIT_MASK 0x1 FORMAT "%13.11" ECU_ADDRESS 0x70000856 /end MEASUREMENT
/begin MEASUREMENT IntkAirT_flgHSC2MaxHeal "Healing flag of the max.error of the High-Side-Check for sensor 2, debounced" UBYTE B_TRUE 1 100 0.00 1.00000000000 BIT_MASK 0x1 FORMAT "%13.11" ECU_ADDRESS 0x70000855 /end MEASUREMENT
/begin MEASUREMENT IntkAirT_flgHSC2NumrInc "release iumpr-numerator for the High-Side-Check for intake air temperature sensor 2" UBYTE B_TRUE 1 100 0.00 1.00000000000 BIT_MASK 0x1 FORMAT "%13.11" ECU_ADDRESS 0x700001DD /end MEASUREMENT
/begin MEASUREMENT IntkAirT_flgIntkMnfldReplSnsrVld "Condition: Sensor value from the other bank as replacement value of the intake air temperature in manifold is valid" UBYTE B_TRUE 1 100 0.00 1.00000000000 BIT_MASK 0x1 FORMAT "%13.11" ECU_ADDRESS 0x700001CF /end MEASUREMENT
/begin MEASUREMENT IntkAirT_flgIntkMnfldReplVld "Condition: replacement value of the intake air temperature in manifold is valid" UBYTE B_TRUE 1 100 0.00 1.00000000000 BIT_MASK 0x1 FORMAT "%13.11" ECU_ADDRESS 0x700001CE /end MEASUREMENT
/begin MEASUREMENT IntkAirT_flgIntkMnfldSeln "Validity of the selected intake air temperature in manifold" UBYTE B_TRUE 1 100 0.00 1.00000000000 BIT_MASK 0x1 FORMAT "%13.11" ECU_ADDRESS 0x700001CD /end MEASUREMENT
/begin MEASUREMENT IntkAirT_flgIntkMnfldSelnSwt "Trigger of the loe pass filter of the selected intake air temperature in manifold" UBYTE B_TRUE 1 100 0.00 1.00000000000 BIT_MASK 0x1 FORMAT "%13.11" ECU_ADDRESS 0x700001CC /end MEASUREMENT
/begin MEASUREMENT IntkAirT_flgIntkMnfldVld "Condition: intake air temperature in manifold is valid" UBYTE B_TRUE 1 100 0.00 1.00000000000 BIT_MASK 0x1 FORMAT "%13.11" ECU_ADDRESS 0x70000853 /end MEASUREMENT
/begin MEASUREMENT IntkAirT_flgPlausChk1NumrInc "release iumpr-numerator for the Plaus-Check for intake air temperature sensor 1" UBYTE B_TRUE 1 100 0.00 1.00000000000 BIT_MASK 0x1 FORMAT "%13.11" ECU_ADDRESS 0x7000084A /end MEASUREMENT
/begin MEASUREMENT IntkAirT_flgPlausChk2NumrInc "release iumpr-numerator for the Plaus-Check for intake air temperature sensor 2" UBYTE B_TRUE 1 100 0.00 1.00000000000 BIT_MASK 0x1 FORMAT "%13.11" ECU_ADDRESS 0x70000849 /end MEASUREMENT
/begin MEASUREMENT IntkAirT_flgPRC1ErrDeb "Error flag of the the Physical-Range-Check for sensor 1, debounced" UBYTE B_TRUE 1 100 0.00 1.00000000000 BIT_MASK 0x1 FORMAT "%13.11" ECU_ADDRESS 0x700001EA /end MEASUREMENT
/begin MEASUREMENT IntkAirT_flgPRC1ErrTmp "Error flag of the the Physical-Range-Check for sensor 1, temporary" UBYTE B_TRUE 1 100 0.00 1.00000000000 BIT_MASK 0x1 FORMAT "%13.11" ECU_ADDRESS 0x700001E9 /end MEASUREMENT
/begin MEASUREMENT IntkAirT_flgPRC1HealDeb "Healing flag of the Physical-Range-Check for sensor 1, debounced" UBYTE B_TRUE 1 100 0.00 1.00000000000 BIT_MASK 0x1 FORMAT "%13.11" ECU_ADDRESS 0x700001E8 /end MEASUREMENT
/begin MEASUREMENT IntkAirT_flgPRC1MaxErr "Error flag of the max.error of the Physical-Range-Check for sensor 1, debounced" UBYTE B_TRUE 1 100 0.00 1.00000000000 BIT_MASK 0x1 FORMAT "%13.11" ECU_ADDRESS 0x70000852 /end MEASUREMENT
/begin MEASUREMENT IntkAirT_flgPRC1MaxErrTmp "Error flag of the max.error of the Physical-Range-Check for sensor 1, temporary" UBYTE B_TRUE 1 100 0.00 1.00000000000 BIT_MASK 0x1 FORMAT "%13.11" ECU_ADDRESS 0x700001E7 /end MEASUREMENT
/begin MEASUREMENT IntkAirT_flgPRC1MaxHeal "Healing flag of the max.error of the Physical-Range-Check for sensor 1, debounced" UBYTE B_TRUE 1 100 0.00 1.00000000000 BIT_MASK 0x1 FORMAT "%13.11" ECU_ADDRESS 0x70000851 /end MEASUREMENT
/begin MEASUREMENT IntkAirT_flgPRC1MinErr "Error flag of the min.error of the Physical-Range-Check for sensor 1, debounced" UBYTE B_TRUE 1 100 0.00 1.00000000000 BIT_MASK 0x1 FORMAT "%13.11" ECU_ADDRESS 0x70000850 /end MEASUREMENT
/begin MEASUREMENT IntkAirT_flgPRC1MinErrTmp "Error flag of the min.error of the Physical-Range-Check for sensor 1, temporary" UBYTE B_TRUE 1 100 0.00 1.00000000000 BIT_MASK 0x1 FORMAT "%13.11" ECU_ADDRESS 0x700001E6 /end MEASUREMENT
/begin MEASUREMENT IntkAirT_flgPRC1MinHeal "Healing flag of the min.error of the Physical-Range-Check for sensor 1, debounced" UBYTE B_TRUE 1 100 0.00 1.00000000000 BIT_MASK 0x1 FORMAT "%13.11" ECU_ADDRESS 0x7000084F /end MEASUREMENT
/begin MEASUREMENT IntkAirT_flgPRC2ErrDeb "Error flag of the the Physical-Range-Check for sensor 2, debounced" UBYTE B_TRUE 1 100 0.00 1.00000000000 BIT_MASK 0x1 FORMAT "%13.11" ECU_ADDRESS 0x700001DC /end MEASUREMENT
/begin MEASUREMENT IntkAirT_flgPRC2ErrTmp "Error flag of the the Physical-Range-Check for sensor 2, temporary" UBYTE B_TRUE 1 100 0.00 1.00000000000 BIT_MASK 0x1 FORMAT "%13.11" ECU_ADDRESS 0x700001DB /end MEASUREMENT
/begin MEASUREMENT IntkAirT_flgPRC2HealDeb "Healing flag of the Physical-Range-Check for sensor 2, debounced" UBYTE B_TRUE 1 100 0.00 1.00000000000 BIT_MASK 0x1 FORMAT "%13.11" ECU_ADDRESS 0x700001DA /end MEASUREMENT
/begin MEASUREMENT IntkAirT_flgPRC2MaxErr "Error flag of the max.error of the Physical-Range-Check for sensor 2, debounced" UBYTE B_TRUE 1 100 0.00 1.00000000000 BIT_MASK 0x1 FORMAT "%13.11" ECU_ADDRESS 0x7000084E /end MEASUREMENT
/begin MEASUREMENT IntkAirT_flgPRC2MaxErrTmp "Error flag of the max.error of the Physical-Range-Check for sensor 2, temporary" UBYTE B_TRUE 1 100 0.00 1.00000000000 BIT_MASK 0x1 FORMAT "%13.11" ECU_ADDRESS 0x700001D9 /end MEASUREMENT
/begin MEASUREMENT IntkAirT_flgPRC2MaxHeal "Healing flag of the max.error of the Physical-Range-Check for sensor 2, debounced" UBYTE B_TRUE 1 100 0.00 1.00000000000 BIT_MASK 0x1 FORMAT "%13.11" ECU_ADDRESS 0x7000084D /end MEASUREMENT
/begin MEASUREMENT IntkAirT_flgPRC2MinErr "Error flag of the min.error of the Physical-Range-Check for sensor 2, debounced" UBYTE B_TRUE 1 100 0.00 1.00000000000 BIT_MASK 0x1 FORMAT "%13.11" ECU_ADDRESS 0x7000084C /end MEASUREMENT
/begin MEASUREMENT IntkAirT_flgPRC2MinErrTmp "Error flag of the min.error of the Physical-Range-Check for sensor 2, temporary" UBYTE B_TRUE 1 100 0.00 1.00000000000 BIT_MASK 0x1 FORMAT "%13.11" ECU_ADDRESS 0x700001D8 /end MEASUREMENT
/begin MEASUREMENT IntkAirT_flgPRC2MinHeal "Healing flag of the min.error of the Physical-Range-Check for sensor 2, debounced" UBYTE B_TRUE 1 100 0.00 1.00000000000 BIT_MASK 0x1 FORMAT "%13.11" ECU_ADDRESS 0x7000084B /end MEASUREMENT
/begin MEASUREMENT IntkAirT_flgSTC1Ena "stuck-check sesnor 1: diagnosis (physically) enabled" UBYTE B_TRUE 1 100 0.00 1.00000000000 BIT_MASK 0x1 FORMAT "%13.11" ECU_ADDRESS 0x700001E5 /end MEASUREMENT
/begin MEASUREMENT IntkAirT_flgSTC1Err "Error flag of the Stuck-Check for sensor 1, debounced" UBYTE B_TRUE 1 100 0.00 1.00000000000 BIT_MASK 0x1 FORMAT "%13.11" ECU_ADDRESS 0x70000848 /end MEASUREMENT
/begin MEASUREMENT IntkAirT_flgSTC1ErrTmp "Error flag of the max.error of the stuck-check for sensor 1, temporary" UBYTE B_TRUE 1 100 0.00 1.00000000000 BIT_MASK 0x1 FORMAT "%13.11" ECU_ADDRESS 0x700001E4 /end MEASUREMENT
/begin MEASUREMENT IntkAirT_flgSTC1Heal "Healing flag of the Stuck-Check for sensor 1, debounced" UBYTE B_TRUE 1 100 0.00 1.00000000000 BIT_MASK 0x1 FORMAT "%13.11" ECU_ADDRESS 0x70000847 /end MEASUREMENT
/begin MEASUREMENT IntkAirT_flgSTC1HiTmp "stuck-check sensor 1: condition for high-phase fulfilled" UBYTE B_TRUE 1 100 0.00 1.00000000000 BIT_MASK 0x1 FORMAT "%13.11" ECU_ADDRESS 0x700001E3 /end MEASUREMENT
/begin MEASUREMENT IntkAirT_flgSTC1HiVld "stuck-check: release counter for high-phase" UBYTE B_TRUE 1 100 0.00 1.00000000000 BIT_MASK 0x1 FORMAT "%13.11" ECU_ADDRESS 0x700001E2 /end MEASUREMENT
/begin MEASUREMENT IntkAirT_flgSTC1LoTmp "stuck-check sensor 1: condition for low-phase fulfilled" UBYTE B_TRUE 1 100 0.00 1.00000000000 BIT_MASK 0x1 FORMAT "%13.11" ECU_ADDRESS 0x700001E1 /end MEASUREMENT
/begin MEASUREMENT IntkAirT_flgSTC1LoVld "stuck-check: release counter for low-phase" UBYTE B_TRUE 1 100 0.00 1.00000000000 BIT_MASK 0x1 FORMAT "%13.11" ECU_ADDRESS 0x700001E0 /end MEASUREMENT
/begin MEASUREMENT IntkAirT_flgSTC1NumrInc "release iumpr-numerator for the Stuck-Check for intake air temperature sensor 1" UBYTE B_TRUE 1 100 0.00 1.00000000000 BIT_MASK 0x1 FORMAT "%13.11" ECU_ADDRESS 0x700001DF /end MEASUREMENT
/begin MEASUREMENT IntkAirT_flgSTC2Ena "stuck-check sesnor 2: diagnosis (physically) enabled" UBYTE B_TRUE 1 100 0.00 1.00000000000 BIT_MASK 0x1 FORMAT "%13.11" ECU_ADDRESS 0x700001D7 /end MEASUREMENT
/begin MEASUREMENT IntkAirT_flgSTC2Err "Error flag of the Stuck-Check for sensor 2, debounced" UBYTE B_TRUE 1 100 0.00 1.00000000000 BIT_MASK 0x1 FORMAT "%13.11" ECU_ADDRESS 0x70000846 /end MEASUREMENT
/begin MEASUREMENT IntkAirT_flgSTC2ErrTmp "Error flag of the max.error of the stuck-check for sensor 2, temporary" UBYTE B_TRUE 1 100 0.00 1.00000000000 BIT_MASK 0x1 FORMAT "%13.11" ECU_ADDRESS 0x700001D6 /end MEASUREMENT
/begin MEASUREMENT IntkAirT_flgSTC2Heal "Healing flag of the Stuck-Check for sensor 2, debounced" UBYTE B_TRUE 1 100 0.00 1.00000000000 BIT_MASK 0x1 FORMAT "%13.11" ECU_ADDRESS 0x70000845 /end MEASUREMENT
/begin MEASUREMENT IntkAirT_flgSTC2HiTmp "stuck-check sensor 2: condition for high-phase fulfilled" UBYTE B_TRUE 1 100 0.00 1.00000000000 BIT_MASK 0x1 FORMAT "%13.11" ECU_ADDRESS 0x700001D5 /end MEASUREMENT
/begin MEASUREMENT IntkAirT_flgSTC2HiVld "stuck-check: release counter for high-phase" UBYTE B_TRUE 1 100 0.00 1.00000000000 BIT_MASK 0x1 FORMAT "%13.11" ECU_ADDRESS 0x700001D4 /end MEASUREMENT
/begin MEASUREMENT IntkAirT_flgSTC2LoTmp "stuck-check sensor 2: condition for low-phase fulfilled" UBYTE B_TRUE 1 100 0.00 1.00000000000 BIT_MASK 0x1 FORMAT "%13.11" ECU_ADDRESS 0x700001D3 /end MEASUREMENT
/begin MEASUREMENT IntkAirT_flgSTC2LoVld "stuck-check: release counter for low-phase" UBYTE B_TRUE 1 100 0.00 1.00000000000 BIT_MASK 0x1 FORMAT "%13.11" ECU_ADDRESS 0x700001D2 /end MEASUREMENT
/begin MEASUREMENT IntkAirT_flgSTC2NumrInc "release iumpr-numerator for the Stuck-Check for intake air temperature sensor 2" UBYTE B_TRUE 1 100 0.00 1.00000000000 BIT_MASK 0x1 FORMAT "%13.11" ECU_ADDRESS 0x700001D1 /end MEASUREMENT
/begin MEASUREMENT IntkAirT_flgThrVlvUsReplSnsrVld "Condition: Sensor value from the other bank as replacement value of the intake air temperature before throttle" UBYTE B_TRUE 1 100 0.00 1.00000000000 BIT_MASK 0x1 FORMAT "%13.11" ECU_ADDRESS 0x700001CB /end MEASUREMENT
/begin MEASUREMENT IntkAirT_flgThrVlvUsReplVld "Condition: replacement value of the intake air temperature before throttle is valid" UBYTE B_TRUE 1 100 0.00 1.00000000000 BIT_MASK 0x1 FORMAT "%13.11" ECU_ADDRESS 0x700001CA /end MEASUREMENT
/begin MEASUREMENT IntkAirT_flgThrVlvUsVld "Condition: intake air temperature before throttle is valid" UBYTE B_TRUE 1 100 0.00 1.00000000000 BIT_MASK 0x1 FORMAT "%13.11" ECU_ADDRESS 0x70000836 /end MEASUREMENT
/begin MEASUREMENT IntkAirT_mSTC1HiMLInteg "stuck-check sensor 1: air mass flow integrator output" UBYTE m_ub_b23p3 1 100 0.00 23.21 FORMAT "%5.2" ECU_ADDRESS 0x6000AF64 /end MEASUREMENT
/begin MEASUREMENT IntkAirT_mSTC2HiMLInteg "stuck-check sensor 2: air mass flow integrator output" UBYTE m_ub_b23p3 1 100 0.00 23.21 FORMAT "%5.2" ECU_ADDRESS 0x6000AF5B /end MEASUREMENT
/begin MEASUREMENT IntkAirT_tAirFltDs "Intake air temperature after air filter" SWORD Temp_Cels 1 100 -3549.940 3003.560 FORMAT "%8.3" ECU_ADDRESS 0x6000881E /end MEASUREMENT
/begin MEASUREMENT IntkAirT_tAirFltDsMdlInt "Model value from the TDev internal model for the Intake air temperature after air filter" SWORD Temp_Cels 1 100 -3549.940 3003.560 FORMAT "%8.3" ECU_ADDRESS 0x60006B72 /end MEASUREMENT
/begin MEASUREMENT IntkAirT_tAirFltDsRepl "Replacement value of the Intake air temperature after air filter" SWORD Temp_Cels 1 100 -3549.940 3003.560 FORMAT "%8.3" ECU_ADDRESS 0x60006B70 /end MEASUREMENT
/begin MEASUREMENT IntkAirT_tAirFltDsUnFlt "Intake air temperature after air filter without filtering" SWORD Temp_Cels 1 100 -3549.940 3003.560 FORMAT "%8.3" ECU_ADDRESS 0x60006B6E /end MEASUREMENT
/begin MEASUREMENT IntkAirT_tAirFltDs_Sq "Signal quality of Intake air temperature after air filter" UBYTE SigQly_COMPU_VERB 1 100 0.00 15.0000000000 FORMAT "%13.10" ECU_ADDRESS 0x6000EF56 /end MEASUREMENT
/begin MEASUREMENT IntkAirT_tHSC1Mdl "model value for high-side-check" SWORD Temp_Cels 1 100 -3549.940 3003.560 FORMAT "%8.3" ECU_ADDRESS 0x60006B7E /end MEASUREMENT
/begin MEASUREMENT IntkAirT_tHSC2Mdl "model value for high-side-check" SWORD Temp_Cels 1 100 -3549.940 3003.560 FORMAT "%8.3" ECU_ADDRESS 0x60006B78 /end MEASUREMENT
/begin MEASUREMENT IntkAirT_tIntkMnfld "Intake air temperature in manifold" SWORD Temp_Cels 1 100 -3549.940 3003.560 FORMAT "%8.3" ECU_ADDRESS 0x60013F98 /end MEASUREMENT
/begin MEASUREMENT IntkAirT_tIntkMnfldMdlInt "Model value from the TDev internal model for the intake air temperature in manifold" SWORD Temp_Cels 1 100 -3549.940 3003.560 FORMAT "%8.3" ECU_ADDRESS 0x60006B6C /end MEASUREMENT
/begin MEASUREMENT IntkAirT_tIntkMnfldRepl "Replacement value of the intake air temperature in manifold" SWORD Temp_Cels 1 100 -3549.940 3003.560 FORMAT "%8.3" ECU_ADDRESS 0x60006B6A /end MEASUREMENT
/begin MEASUREMENT IntkAirT_tIntkMnfldReplSnsr "Sensor value from the other bank as Replacement value of the intake air temperature in manifold" SWORD Temp_Cels 1 100 -3549.940 3003.560 FORMAT "%8.3" ECU_ADDRESS 0x60006B68 /end MEASUREMENT
/begin MEASUREMENT IntkAirT_tIntkMnfldSeln "Selected intak air temperature in manifold" SWORD Temp_Cels 1 100 -3549.940 3003.560 FORMAT "%8.3" ECU_ADDRESS 0x60006B66 /end MEASUREMENT
/begin MEASUREMENT IntkAirT_tIntkMnfld_Sq "Signal quality of Intake air temperature in manifold" UBYTE SigQly_COMPU_VERB 1 100 0.00 15.0000000000 FORMAT "%13.10" ECU_ADDRESS 0x6000EF55 /end MEASUREMENT
/begin MEASUREMENT IntkAirT_tiSTC1HiOff "stuck-check sensor 1: disruption time for high-phase" UBYTE t_q1 1 100 0.00 255.0 FORMAT "%5.1" ECU_ADDRESS 0x6000AF63 /end MEASUREMENT
/begin MEASUREMENT IntkAirT_tiSTC1HiOn "stuck-check sensor 1: time duration in high-phase" UBYTE t_q1 1 100 0.00 255.0 FORMAT "%5.1" ECU_ADDRESS 0x6000AF62 /end MEASUREMENT
/begin MEASUREMENT IntkAirT_tiSTC1LoOff "stuck-check sensor 1: disruption time for low-phase" UBYTE t_q1 1 100 0.00 255.0 FORMAT "%5.1" ECU_ADDRESS 0x6000AF61 /end MEASUREMENT
/begin MEASUREMENT IntkAirT_tiSTC1LoOn "stuck-check sensor 1: time duration in low-phase" UBYTE t_q1 1 100 0.00 255.0 FORMAT "%5.1" ECU_ADDRESS 0x6000AF60 /end MEASUREMENT
/begin MEASUREMENT IntkAirT_tiSTC2HiOff "stuck-check sensor 2: disruption time for high-phase" UBYTE t_q1 1 100 0.00 255.0 FORMAT "%5.1" ECU_ADDRESS 0x6000AF5A /end MEASUREMENT
/begin MEASUREMENT IntkAirT_tiSTC2HiOn "stuck-check sensor 2: time duration in high-phase" UBYTE t_q1 1 100 0.00 255.0 FORMAT "%5.1" ECU_ADDRESS 0x6000AF59 /end MEASUREMENT
/begin MEASUREMENT IntkAirT_tiSTC2LoOff "stuck-check sensor 2: disruption time for low-phase" UBYTE t_q1 1 100 0.00 255.0 FORMAT "%5.1" ECU_ADDRESS 0x6000AF58 /end MEASUREMENT
/begin MEASUREMENT IntkAirT_tiSTC2LoOn "stuck-check sensor 2: time duration in low-phase" UBYTE t_q1 1 100 0.00 255.0 FORMAT "%5.1" ECU_ADDRESS 0x6000AF57 /end MEASUREMENT
/begin MEASUREMENT IntkAirT_tSnsr1Mdl "model-value for intake air temperature sensor 1 (IntkAirT_tSnsr1, tfa1)" SWORD Temp_Cels 1 100 -3549.940 3003.560 FORMAT "%8.3" ECU_ADDRESS 0x60008814 /end MEASUREMENT
/begin MEASUREMENT IntkAirT_tSnsr2Mdl "model-value for intake air temperature sensor 2 (IntkAirT_tSnsr2)" SWORD Temp_Cels 1 100 -3549.940 3003.560 FORMAT "%8.3" ECU_ADDRESS 0x6000880E /end MEASUREMENT
/begin MEASUREMENT IntkAirT_tSnsrFild1Max "maximum value IntkAirT_tSnsrFild1" SWORD Temp_Cels 1 100 -3549.940 3003.560 FORMAT "%8.3" ECU_ADDRESS 0x60006B7C /end MEASUREMENT
/begin MEASUREMENT IntkAirT_tSnsrFild1Min "minimum value IntkAirT_tSnsrFild1" SWORD Temp_Cels 1 100 -3549.940 3003.560 FORMAT "%8.3" ECU_ADDRESS 0x60006B7A /end MEASUREMENT
/begin MEASUREMENT IntkAirT_tSnsrFild2Max "maximum value IntkAirT_tSnsrFild2" SWORD Temp_Cels 1 100 -3549.940 3003.560 FORMAT "%8.3" ECU_ADDRESS 0x60006B76 /end MEASUREMENT
/begin MEASUREMENT IntkAirT_tSnsrFild2Min "minimum value IntkAirT_tSnsrFild2" SWORD Temp_Cels 1 100 -3549.940 3003.560 FORMAT "%8.3" ECU_ADDRESS 0x60006B74 /end MEASUREMENT
/begin MEASUREMENT IntkAirT_tThrVlvUs "Before intake throttle" SWORD Temp_Cels 1 100 -3549.940 3003.560 FORMAT "%8.3" ECU_ADDRESS 0x50005D9A /end MEASUREMENT
/begin MEASUREMENT IntkAirT_tThrVlvUsMax "Maximum intake air temperature upstream throttle valve" SWORD Temp_Cels 1 100 -3549.940 3003.560 FORMAT "%8.3" ECU_ADDRESS 0x600087FA /end MEASUREMENT
/begin MEASUREMENT IntkAirT_tThrVlvUsMdlInt "Model value from the TDev internal model for the intake air temperature bedore throttle" SWORD Temp_Cels 1 100 -3549.940 3003.560 FORMAT "%8.3" ECU_ADDRESS 0x60006B64 /end MEASUREMENT
/begin MEASUREMENT IntkAirT_tThrVlvUsMin "Minimum intake air temperature upstream throttle valve" SWORD Temp_Cels 1 100 -3549.940 3003.560 FORMAT "%8.3" ECU_ADDRESS 0x600087F8 /end MEASUREMENT
/begin MEASUREMENT IntkAirT_tThrVlvUsRepl "Replacement value of the intake air temperature before throttle" SWORD Temp_Cels 1 100 -3549.940 3003.560 FORMAT "%8.3" ECU_ADDRESS 0x60006B62 /end MEASUREMENT
/begin MEASUREMENT IntkAirT_tThrVlvUsReplSnsr "Sensor value from the other bank as Replacement value of the intake air temperature before throttle" SWORD Temp_Cels 1 100 -3549.940 3003.560 FORMAT "%8.3" ECU_ADDRESS 0x60006B60 /end MEASUREMENT
/begin MEASUREMENT IntkAirT_tThrVlvUs_Sq "Signal quality of intake air temperature before throttle" UBYTE SigQly_COMPU_VERB 1 100 0.00 15.0000000000 FORMAT "%13.10" ECU_ADDRESS 0x6000EF50 /end MEASUREMENT
/begin MEASUREMENT IVGdiCtl_CvoAdpn_Bal_stCtrlRunngMask "Contoller ballistic injection active" UBYTE dez 1 100 0.00 255.0 FORMAT "%5.1" ECU_ADDRESS 0x700035F3 /end MEASUREMENT
/begin MEASUREMENT IVGdiCtl_CvoAdpn_Bal_tiOpenAtIntegCalc_u16 "ti open where the bal. integrator was calculated for the last time" UWORD t_us_q1 1 100 0.00 65535.00 FORMAT "%8.2" ARRAY_SIZE 16 ECU_ADDRESS 0x60009968 /end MEASUREMENT
/begin MEASUREMENT IVGdiCtl_CvoAdpn_BaseAdpnFinshdCntr_u16 "" UWORD dez 1 100 0.00 65535.00 FORMAT "%8.2" ARRAY_SIZE 6 ECU_ADDRESS 0x70003E6E /end MEASUREMENT
/begin MEASUREMENT IVGdiCtl_CvoAdpn_BaseAdpnPntVld_b "Status: Measurement fullfills the conditions of the base adaption" UBYTE dez 1 100 0.00 255.0 BIT_MASK 0x1 FORMAT "%5.1" ECU_ADDRESS 0x600103F8 /end MEASUREMENT
/begin MEASUREMENT IVGdiCtl_CvoAdpn_currTi_u32 "ti of the last measurement" ULONG t_q0p1_us 1 100 0.00 429496729.500 FORMAT "%13.3" ECU_ADDRESS 0x6000402C /end MEASUREMENT
/begin MEASUREMENT IVGdiCtl_CvoAdpn_currTopen_pls_u16 "calculated opening time of the last measurement (cylinder and pulse individual)" UWORD t_q0p1_us 1 100 0.00 6553.500 FORMAT "%8.3" ARRAY_SIZE 16 ECU_ADDRESS 0x60009A6C /end MEASUREMENT
/begin MEASUREMENT IVGdiCtl_CvoAdpn_currTopen_u16 "calculated opening time of the last measurement" UWORD t_q0p1_us 1 100 0.00 6553.500 FORMAT "%8.3" ECU_ADDRESS 0x600099F4 /end MEASUREMENT
/begin MEASUREMENT IVGdiCtl_CvoAdpn_currTopen_u32 "calculated opening time of the last measurement" ULONG t_q0p1_us 1 100 0.00 429496729.500 FORMAT "%13.3" ECU_ADDRESS 0x60004030 /end MEASUREMENT
/begin MEASUREMENT IVGdiCtl_CvoAdpn_currTp_u16 "tp of the last measurement" UWORD t_q0p001_ms 1 100 0.00 65.53500 FORMAT "%8.5" ECU_ADDRESS 0x60009A8E /end MEASUREMENT
/begin MEASUREMENT IVGdiCtl_CvoAdpn_CylState "cylinder individual adaption status" SLONG IVGdiCtl_CvoAdpn_State_t 1 100 0.00 9.00000000000 FORMAT "%13.11" ARRAY_SIZE 4 ECU_ADDRESS 0x60004008 /end MEASUREMENT
/begin MEASUREMENT IVGdiCtl_CvoAdpn_Cyl_CvoSigEvln_u8 "cylinder of the last measurement of CvoSigEvln" UBYTE dez 1 100 0.00 255.0 FORMAT "%5.1" ECU_ADDRESS 0x600103F7 /end MEASUREMENT
/begin MEASUREMENT IVGdiCtl_CvoAdpn_Cyl_InjDDGdi_u8 "cylinder of the last measurement of injddgdi" UBYTE dez 1 100 0.00 255.0 FORMAT "%5.1" ECU_ADDRESS 0x600103F5 /end MEASUREMENT
/begin MEASUREMENT IVGdiCtl_CvoAdpn_deltaInjCntr_u16 "past injections since the last base adaption (temperature individual or viscosity individual)" UWORD dez 1 100 0.00 65535.00 FORMAT "%8.2" ARRAY_SIZE 6 ECU_ADDRESS 0x600099F8 /end MEASUREMENT
/begin MEASUREMENT IVGdiCtl_CvoAdpn_delta_tantot_tp_s16 "tantot correction depending on tp" SWORD t_q0p1_us 1 100 -3276.800 3276.700 FORMAT "%8.3" ECU_ADDRESS 0x60009A9E /end MEASUREMENT
/begin MEASUREMENT IVGdiCtl_CvoAdpn_delta_toffen_cyl_s16 "difference between calculated and desired opening time of the last measurement (cylinder individual)" SWORD t_q0p1_us 1 100 -3276.800 3276.700 FORMAT "%8.3" ARRAY_SIZE 4 ECU_ADDRESS 0x60009A04 /end MEASUREMENT
/begin MEASUREMENT IVGdiCtl_CvoAdpn_delta_toffen_s16 "difference between calculated and desired opening time of the last measurement" SWORD t_q0p1_us 1 100 -3276.800 3276.700 FORMAT "%8.3" ECU_ADDRESS 0x600099F6 /end MEASUREMENT
/begin MEASUREMENT IVGdiCtl_CvoAdpn_desTopen_u16 "desired opening time of the last measurement" UWORD t_q0p1_us 1 100 0.00 6553.500 FORMAT "%8.3" ECU_ADDRESS 0x60009AA0 /end MEASUREMENT
/begin MEASUREMENT IVGdiCtl_CvoAdpn_DrgPtr_dtiCorrnFullLft_Max_s8 "Drag pointer: max. correction dTi for full lift injection pulses" SBYTE t_q2p0_us 1 100 -256.0 254.0 FORMAT "%5.1" ARRAY_SIZE 4 ECU_ADDRESS 0x600103D5 /end MEASUREMENT
/begin MEASUREMENT IVGdiCtl_CvoAdpn_DrgPtr_dtiCorrnFullLft_Min_s8 "Drag pointer: min. correction dTi for full lift injection pulses" SBYTE t_q2p0_us 1 100 -256.0 254.0 FORMAT "%5.1" ARRAY_SIZE 4 ECU_ADDRESS 0x600103D1 /end MEASUREMENT
/begin MEASUREMENT IVGdiCtl_CvoAdpn_DrgPtr_dTopenPlateau_Max_s8 "Dragpointer: max. Plateau from adaption" SBYTE t_q2p0_us 1 100 -256.0 254.0 FORMAT "%5.1" ARRAY_SIZE 4 ECU_ADDRESS 0x600103E8 /end MEASUREMENT
/begin MEASUREMENT IVGdiCtl_CvoAdpn_DrgPtr_dTopenPlateau_Min_s8 "Dragpointer: min. Plateau from adaption" SBYTE t_q2p0_us 1 100 -256.0 254.0 FORMAT "%5.1" ARRAY_SIZE 4 ECU_ADDRESS 0x600103E4 /end MEASUREMENT
/begin MEASUREMENT IVGdiCtl_CvoAdpn_DrgPtr_tiAbFullLft_Max_u8 "drag pointer for the maximum close time tab in full lift" UBYTE t_q2p0_us 1 100 0.00 510.0 FORMAT "%5.1" ARRAY_SIZE 4 ECU_ADDRESS 0x600103F0 /end MEASUREMENT
/begin MEASUREMENT IVGdiCtl_CvoAdpn_DrgPtr_tiAbFullLft_Min_u8 "drag pointer for the minimum close time tab in full lift" UBYTE t_q2p0_us 1 100 0.00 510.0 FORMAT "%5.1" ARRAY_SIZE 4 ECU_ADDRESS 0x600103EC /end MEASUREMENT
/begin MEASUREMENT IVGdiCtl_CvoAdpn_dtiInteg_ChgdPls_u8 "Bitmask: changed controller since the last base adaption (cylinder individual)" UBYTE dez 1 100 0.00 255.0 FORMAT "%5.1" ARRAY_SIZE 4 ECU_ADDRESS 0x600103B7 /end MEASUREMENT
/begin MEASUREMENT IVGdiCtl_CvoAdpn_dti_Bal_cyl_s16 "dti-part out of the ballistic area" SWORD t_q0p1_us 1 100 -3276.800 3276.700 FORMAT "%8.3" ARRAY_SIZE 4 ECU_ADDRESS 0x60009908 /end MEASUREMENT
/begin MEASUREMENT IVGdiCtl_CvoAdpn_dti_Bal_dtopen_to_dti_s32 "gain for ballistic slop correction" SLONG dez 1 100 -2147483648.00 2147483647.00 FORMAT "%13.2" ARRAY_SIZE 4 ECU_ADDRESS 0x60004018 /end MEASUREMENT
/begin MEASUREMENT IVGdiCtl_CvoAdpn_dti_Bal_dtopen_to_ref_s16 "topen-difference to the reference point" SWORD t_us_q1 1 100 -32768.00 32767.00 FORMAT "%8.2" ARRAY_SIZE 4 ECU_ADDRESS 0x60009948 /end MEASUREMENT
/begin MEASUREMENT IVGdiCtl_CvoAdpn_dti_Bal_Integ_cyl_s16 "part of the bal. integrator that is used for the delta ti calclulation" SWORD t_q0p1_us 1 100 -3276.800 3276.700 FORMAT "%8.3" ARRAY_SIZE 4 ECU_ADDRESS 0x60009918 /end MEASUREMENT
/begin MEASUREMENT IVGdiCtl_CvoAdpn_dti_Bal_Slop_cyl_s16 "dti-part out of the ballistic slope correction" SWORD t_q0p1_us 1 100 -3276.800 3276.700 FORMAT "%8.3" ARRAY_SIZE 4 ECU_ADDRESS 0x60009910 /end MEASUREMENT
/begin MEASUREMENT IVGdiCtl_CvoAdpn_dti_finished_cylMask_Press0 "" UBYTE dez 1 100 0.00 255.0 FORMAT "%5.1" ARRAY_SIZE 6 ECU_ADDRESS 0x70003E68 /end MEASUREMENT
/begin MEASUREMENT IVGdiCtl_CvoAdpn_dti_finished_cylMask_Press1 "" UBYTE dez 1 100 0.00 255.0 FORMAT "%5.1" ARRAY_SIZE 6 ECU_ADDRESS 0x70003E62 /end MEASUREMENT
/begin MEASUREMENT IVGdiCtl_CvoAdpn_dti_finished_cylMask_Press2 "" UBYTE dez 1 100 0.00 255.0 FORMAT "%5.1" ARRAY_SIZE 6 ECU_ADDRESS 0x70003E5C /end MEASUREMENT
/begin MEASUREMENT IVGdiCtl_CvoAdpn_dti_finished_cylMask_Press3 "" UBYTE dez 1 100 0.00 255.0 FORMAT "%5.1" ARRAY_SIZE 6 ECU_ADDRESS 0x70003E56 /end MEASUREMENT
/begin MEASUREMENT IVGdiCtl_CvoAdpn_dti_finished_cylMask_Press4 "" UBYTE dez 1 100 0.00 255.0 FORMAT "%5.1" ARRAY_SIZE 6 ECU_ADDRESS 0x70003E50 /end MEASUREMENT
/begin MEASUREMENT IVGdiCtl_CvoAdpn_dti_FullLft_cyl_s16 "dti-part out of the full lift" SWORD t_q0p1_us 1 100 -3276.800 3276.700 FORMAT "%8.3" ARRAY_SIZE 4 ECU_ADDRESS 0x60009928 /end MEASUREMENT
/begin MEASUREMENT IVGdiCtl_CvoAdpn_dti_FullLft_Integ_cyl_s16 "part of the full lift integrator that is used for the delta ti calclulation" SWORD t_q0p1_us 1 100 -3276.800 3276.700 FORMAT "%8.3" ARRAY_SIZE 4 ECU_ADDRESS 0x60009930 /end MEASUREMENT
/begin MEASUREMENT IVGdiCtl_CvoAdpn_dti_Tran_Plateau_cyl_s16 "dti-part out of the plateau" SWORD t_q0p1_us 1 100 -3276.800 3276.700 FORMAT "%8.3" ARRAY_SIZE 4 ECU_ADDRESS 0x60009920 /end MEASUREMENT
/begin MEASUREMENT IVGdiCtl_CvoAdpn_Estimd_delta_ti_s16 "estimated dti for the last measurement" SWORD t_q0p1_us 1 100 -3276.800 3276.700 FORMAT "%8.3" ECU_ADDRESS 0x60009A8C /end MEASUREMENT
/begin MEASUREMENT IVGdiCtl_CvoAdpn_FacDeltaTopenToDtiTot_u16 "complete conversion factor from deltaTopen to dti" UWORD rel_q0p01 1 100 0.00 655.3500 FORMAT "%8.4" ECU_ADDRESS 0x60009AA2 /end MEASUREMENT
/begin MEASUREMENT IVGdiCtl_CvoAdpn_FacDeltaTopenToDti_u8 "conversion factor from deltaTopen to dti" UBYTE rel_q1 1 100 0.00 255.0 FORMAT "%5.1" ECU_ADDRESS 0x600103FC /end MEASUREMENT
/begin MEASUREMENT IVGdiCtl_CvoAdpn_FacDeltaTopenToIntegGain_u8 "conversion factor from deltaTopen to controller gain" UBYTE rel_q1 1 100 0.00 255.0 FORMAT "%5.1" ECU_ADDRESS 0x600103FD /end MEASUREMENT
/begin MEASUREMENT IVGdiCtl_CvoAdpn_finished_cyl_u8 "bitmask: finished learned cylinder (pressure and temperature or viscosity individual)" UBYTE dez 1 100 0.00 255.0 FORMAT "%5.1" ARRAY_SIZE 30 ECU_ADDRESS 0x600103FE /end MEASUREMENT
/begin MEASUREMENT IVGdiCtl_CvoAdpn_FrzFrmVld_b "status bit: freeze frame is valid" UBYTE dez 1 100 0.00 255.0 BIT_MASK 0x1 FORMAT "%5.1" ECU_ADDRESS 0x600103F9 /end MEASUREMENT
/begin MEASUREMENT IVGdiCtl_CvoAdpn_FullLft_dtiInteg_ChgdPls_u8 "bit mask: full lift integrators(injection pulse) that have changed since last adaption (cylinder individual)" UBYTE dez 1 100 0.00 255.0 FORMAT "%5.1" ARRAY_SIZE 4 ECU_ADDRESS 0x600103CB /end MEASUREMENT
/begin MEASUREMENT IVGdiCtl_CvoAdpn_FullLft_dti_finished_cyl_u8 "bit mask: cylinders where the full lift dti has been learned" UBYTE dez 1 100 0.00 255.0 FORMAT "%5.1" ECU_ADDRESS 0x60010423 /end MEASUREMENT
/begin MEASUREMENT IVGdiCtl_CvoAdpn_FullLft_Filt_dti_cyl_s16 "filtered dti values during full lift" SWORD t_q0p1_us 1 100 -3276.800 3276.700 FORMAT "%8.3" ARRAY_SIZE 4 ECU_ADDRESS 0x600098F8 /end MEASUREMENT
/begin MEASUREMENT IVGdiCtl_CvoAdpn_FullLft_finished_cyl_u8 "bit mask: cylinders that are adapted completely during full lift" UBYTE dez 1 100 0.00 255.0 FORMAT "%5.1" ECU_ADDRESS 0x60010422 /end MEASUREMENT
/begin MEASUREMENT IVGdiCtl_CvoAdpn_FullLft_Integ_DeltaInjTi "controller integrator value for ti correction during full lift (cylinder individual)" SWORD t_q0p1_us 1 100 -3276.800 3276.700 FORMAT "%8.3" ARRAY_SIZE 16 ECU_ADDRESS 0x600099A8 /end MEASUREMENT
/begin MEASUREMENT IVGdiCtl_CvoAdpn_FullLft_RmnCylMask "not yet adapted cylinders during full lift" UBYTE dez 1 100 0.00 255.0 FORMAT "%5.1" ECU_ADDRESS 0x600103DC /end MEASUREMENT
/begin MEASUREMENT IVGdiCtl_CvoAdpn_FullLft_stCtrlRunngMask "Controller full lift injection active" UBYTE dez 1 100 0.00 255.0 FORMAT "%5.1" ECU_ADDRESS 0x700035F2 /end MEASUREMENT
/begin MEASUREMENT IVGdiCtl_CvoAdpn_FullLft_tiOpenAtIntegCalc_u16 "ti open where the full lift integrator was calculated for the last time" UWORD t_us_q1 1 100 0.00 65535.00 FORMAT "%8.2" ARRAY_SIZE 16 ECU_ADDRESS 0x600099C8 /end MEASUREMENT
/begin MEASUREMENT IVGdiCtl_CvoAdpn_idxP_u8 "Index: current adaption pressure point" UBYTE dez 1 100 0.00 255.0 FORMAT "%5.1" ECU_ADDRESS 0x600103FA /end MEASUREMENT
/begin MEASUREMENT IVGdiCtl_CvoAdpn_idxVcos_u8 "measurement point for the current viscosity index" UBYTE dez 1 100 0.00 255.0 FORMAT "%5.1" ECU_ADDRESS 0x600103FB /end MEASUREMENT
/begin MEASUREMENT IVGdiCtl_CvoAdpn_InjDDGdi_CvoActCyl_u8 "Bitmask: cylinder for which the injection driver uses the dti" UBYTE dez 1 100 0.00 255.0 FORMAT "%5.1" ECU_ADDRESS 0x60010384 /end MEASUREMENT
/begin MEASUREMENT IVGdiCtl_CvoAdpn_Integ_DeltaInjTi_s16 "pulse and cylinder individual dti-controller" SWORD t_q0p1_us 1 100 -3276.800 3276.700 FORMAT "%8.3" ARRAY_SIZE 16 ECU_ADDRESS 0x60009988 /end MEASUREMENT
/begin MEASUREMENT IVGdiCtl_CvoAdpn_Integ_Tp_u16 "tp to pulse individual controller" UWORD t_q0p04_ms 1 100 0.00 2621.400 FORMAT "%8.3" ARRAY_SIZE 12 ECU_ADDRESS 0x60009950 /end MEASUREMENT
/begin MEASUREMENT IVGdiCtl_CvoAdpn_MeasCntr_u8 "number of the measurements for each operation point" UBYTE dez 1 100 0.00 255.0 FORMAT "%5.1" ARRAY_SIZE 120 ECU_ADDRESS 0x6001030C /end MEASUREMENT
/begin MEASUREMENT IVGdiCtl_CvoAdpn_MeasPlsInfo_pls_u16 "information about the last measured pulse (pulse individual)" UWORD IVGdiCtl_CvoAdpn_MeasPlsInfo_t 1 100 0.00 23040.0000000 FORMAT "%13.7" ARRAY_SIZE 4 ECU_ADDRESS 0x600099EC /end MEASUREMENT
/begin MEASUREMENT IVGdiCtl_CvoAdpn_MeasPlsInfo_u16 "information about the measured pulse" UWORD IVGdiCtl_CvoAdpn_MeasPlsInfo_t 1 100 0.00 23040.0000000 FORMAT "%13.7" ECU_ADDRESS 0x600099EA /end MEASUREMENT
/begin MEASUREMENT IVGdiCtl_CvoAdpn_Pls_InjDDGdi_u8 "injection puls number of the last measurement" UBYTE dez 1 100 0.00 255.0 FORMAT "%5.1" ECU_ADDRESS 0x600103F6 /end MEASUREMENT
/begin MEASUREMENT IVGdiCtl_CvoAdpn_PPrioAry_u8 "priority of th adaption pressures (temperature individual or viscosity individual)" UBYTE dez 1 100 0.00 255.0 FORMAT "%5.1" ARRAY_SIZE 30 ECU_ADDRESS 0x700035D4 /end MEASUREMENT
/begin MEASUREMENT IVGdiCtl_CvoAdpn_ReAdpnCntrCyl_u8 "counter of readaptions (cylinder individual)" UBYTE dez 1 100 0.00 255.0 FORMAT "%5.1" ARRAY_SIZE 4 ECU_ADDRESS 0x600103DD /end MEASUREMENT
/begin MEASUREMENT IVGdiCtl_CvoAdpn_RelBits_u8 "Status: Releaseconditions" UBYTE dez 1 100 0.00 255.0 FORMAT "%5.1" ECU_ADDRESS 0x600103F4 /end MEASUREMENT
/begin MEASUREMENT IVGdiCtl_CvoAdpn_stAdpnCmpl_u8 "cylinders with finished adaption. Bit coded" UBYTE dez 1 100 0.00 255.0 FORMAT "%5.1" ECU_ADDRESS 0x600103DA /end MEASUREMENT
/begin MEASUREMENT IVGdiCtl_CvoAdpn_stReasBascAdpn_u8 "state why a base adaption is requested, temperature or viscosity individual" UBYTE dez 1 100 0.00 255.0 FORMAT "%5.1" ARRAY_SIZE 6 ECU_ADDRESS 0x600386BA /end MEASUREMENT
/begin MEASUREMENT IVGdiCtl_CvoAdpn_tantotReAdpnReq_vcos_u8 "bit mask: viscosities where tantot has been expired and can be readapted" UBYTE dez 1 100 0.00 255.0 FORMAT "%5.1" ECU_ADDRESS 0x600103DB /end MEASUREMENT
/begin MEASUREMENT IVGdiCtl_CvoAdpn_tantot_finished_cyl_u8 "Bitmask: cylinder with a learned tantot (pressure- and temperature or viscosity individual)" UBYTE dez 1 100 0.00 255.0 FORMAT "%5.1" ARRAY_SIZE 6 ECU_ADDRESS 0x6001041C /end MEASUREMENT
/begin MEASUREMENT IVGdiCtl_CvoAdpn_TempBaseAdpnReqCyl_u8 "Bitmask: temporary request of an base adaption (pressure- and temperature or viscosity individual)" UBYTE dez 1 100 0.00 255.0 FORMAT "%5.1" ARRAY_SIZE 30 ECU_ADDRESS 0x60010385 /end MEASUREMENT
/begin MEASUREMENT IVGdiCtl_CvoAdpn_tiOpenMinFullLftCtrl_u16 "calculated lower open time limit for full lift control" UWORD t_q0p001_ms 1 100 0.00 65.53500 FORMAT "%8.5" ECU_ADDRESS 0x60009A90 /end MEASUREMENT
/begin MEASUREMENT IVGdiCtl_CvoAdpn_TiStrt_CvoSigEvln_Tab_u16 "tab at tabmin for determination of the desired ti" UWORD t_us_q1 1 100 0.00 65535.00 FORMAT "%8.2" ECU_ADDRESS 0x60009A92 /end MEASUREMENT
/begin MEASUREMENT IVGdiCtl_CvoAdpn_TiStrt_CvoSigEvln_Ti_u16 "ti at tabmin for determination of the desired ti" UWORD t_us_q1 1 100 0.00 65535.00 FORMAT "%8.2" ECU_ADDRESS 0x60009A94 /end MEASUREMENT
/begin MEASUREMENT IVGdiCtl_CvoAdpn_TiStrt_InitVal_s16 "start value of the controller in the reference point" SWORD t_us_q1 1 100 -32768.00 32767.00 FORMAT "%8.2" ECU_ADDRESS 0x60009A98 /end MEASUREMENT
/begin MEASUREMENT IVGdiCtl_CvoAdpn_TiStrt_Ti_u16 "desired ti of the reference point" UWORD t_us_q1 1 100 0.00 65535.00 FORMAT "%8.2" ECU_ADDRESS 0x60009A96 /end MEASUREMENT
/begin MEASUREMENT IVGdiCtl_CvoAdpn_toffenCtrl_Progs "working state of controller" SLONG IVGdiCtl_CvoAdpn_toffenCtrl_Progs_t 1 100 0.00 13.0000000000 FORMAT "%13.10" ECU_ADDRESS 0x6000404C /end MEASUREMENT
/begin MEASUREMENT IVGdiCtl_CvoAdpn_Tran_des_te_s16 "desired te out of current open time" SWORD t_q0p1_us 1 100 -3276.800 3276.700 FORMAT "%8.3" ARRAY_SIZE 4 ECU_ADDRESS 0x60009940 /end MEASUREMENT
/begin MEASUREMENT IVGdiCtl_CvoAdpn_Tran_dTopen_finished_cyl_u8 "finished cylinders during transition" UBYTE dez 1 100 0.00 255.0 FORMAT "%5.1" ECU_ADDRESS 0x60010425 /end MEASUREMENT
/begin MEASUREMENT IVGdiCtl_CvoAdpn_Tran_estim_te_s16 "estimated te out of current open time during transition" SWORD t_q0p1_us 1 100 -3276.800 3276.700 FORMAT "%8.3" ARRAY_SIZE 4 ECU_ADDRESS 0x60009938 /end MEASUREMENT
/begin MEASUREMENT IVGdiCtl_CvoAdpn_Tran_finished_cyl_u8 "finished cylinders during transition" UBYTE dez 1 100 0.00 255.0 FORMAT "%5.1" ECU_ADDRESS 0x60010424 /end MEASUREMENT
/begin MEASUREMENT IVGdiCtl_CvoAdpn_TrigBaseAdpnCntr_u16 "Counter: extern triggerd base adaptions" UWORD dez 1 100 0.00 65535.00 FORMAT "%8.2" ECU_ADDRESS 0x60009AA4 /end MEASUREMENT
/begin MEASUREMENT IVGdiCtl_CvoAdpn_TrigBaseAdpnWithRstCntr_u16 "Counter: extern triggerd base adaptions with reset" UWORD dez 1 100 0.00 65535.00 FORMAT "%8.2" ECU_ADDRESS 0x60009AA6 /end MEASUREMENT
/begin MEASUREMENT IVGdiCtl_CvoAdpn_used_tantot_const_u16 "for tantot calculation used tantot constant" UWORD t_q0p1_us 1 100 0.00 6553.500 FORMAT "%8.3" ECU_ADDRESS 0x60009A9C /end MEASUREMENT
/begin MEASUREMENT IVGdiCtl_CvoAdpn_used_tantot_type "used tantot-type for open time calculation" SLONG IVGdiCtl_CvoAdpn_TantotType_t 1 100 0.00 255.000000000 FORMAT "%13.9" ECU_ADDRESS 0x60004050 /end MEASUREMENT
/begin MEASUREMENT IVGdiCtl_CvoAdpn_used_tantot_u16 "used tantot for opening time calculation" UWORD t_q0p1_us 1 100 0.00 6553.500 FORMAT "%8.3" ECU_ADDRESS 0x60009A9A /end MEASUREMENT
/begin FUNCTION IntkAirT_PlausDiagSnsr1 "1.7.0     Plausibility Check of the Intake Air Temperature sensor 1"
 /begin DEF_CHARACTERISTIC IntkAirT_cntrSTC1HiVld_C IntkAirT_cntrSTC1LoVld_C IntkAirT_mHSC1MLMax_C IntkAirT_mHSC1MLMin_C IntkAirT_mSTC1HiMLInteg_T IntkAirT_mSTC1HiMLMax_C IntkAirT_mSTC1LoMLMax_C IntkAirT_mSTC1LoMLMin_C IntkAirT_stCfgHSC1_C IntkAirT_stCfgPRC1_C IntkAirT_stCfgSTC1_C IntkAirT_tHSC1HealThd_C IntkAirT_tHSC1Mdl_T IntkAirT_tiHSC1EnaDly_C IntkAirT_tiHSC1ErrDly_C IntkAirT_tiHSC1HealDly_C IntkAirT_tiHSC1MLDly_C IntkAirT_tiPRC1ErrDly_C IntkAirT_tiPRC1HealDly_C IntkAirT_tiSTC1HiOffDly_C IntkAirT_tiSTC1HiOnDly_C IntkAirT_tiSTC1LoOffDly_C IntkAirT_tiSTC1LoOnDly_C IntkAirT_tPRC1Max_C IntkAirT_tPRC1Min_C IntkAirT_tSTC1EnaThdMax_C IntkAirT_tSTC1ErrThd_T IntkAirT_tSTC1HiTMotMin_C IntkAirT_vHSC1VMin_C IntkAirT_vSTC1HiVMax_C IntkAirT_vSTC1LoVMin_C /end DEF_CHARACTERISTIC
 /begin IN_MEASUREMENT AirMod_mfAirCyl CEngDsT_t CEngDsT_tStrtFrst Epm_stSpd IntkAirT_flgSnsr1PlausChkClr IntkAirT_flgSnsr1PlausChkPrms IntkAirT_flgSRCMaxEna IntkAirT_flgSRCMinEna IntkAirT_stSnsr1 IntkAirT_tSnsrFild1 SyC_stSub VehV_v /end IN_MEASUREMENT
 /begin OUT_MEASUREMENT IntkAirT_flgHSC1MaxErr IntkAirT_flgHSC1MaxHeal IntkAirT_flgPlausChk1NumrInc IntkAirT_flgPRC1MaxErr IntkAirT_flgPRC1MaxHeal IntkAirT_flgPRC1MinErr IntkAirT_flgPRC1MinHeal IntkAirT_flgSTC1Err IntkAirT_flgSTC1Heal /end OUT_MEASUREMENT
 /begin LOC_MEASUREMENT IntkAirT_cntrSTC1HiVld IntkAirT_cntrSTC1LoVld IntkAirT_flgDSMClr1000msPlausDiagSnsr1 IntkAirT_flgDSMClr100msPlausDiagSnsr1 IntkAirT_flgHSC1Ena IntkAirT_flgHSC1NumrInc IntkAirT_flgPRC1ErrDeb IntkAirT_flgPRC1ErrTmp IntkAirT_flgPRC1HealDeb IntkAirT_flgPRC1MaxErrTmp IntkAirT_flgPRC1MinErrTmp IntkAirT_flgSTC1Ena IntkAirT_flgSTC1ErrTmp IntkAirT_flgSTC1HiTmp IntkAirT_flgSTC1HiVld IntkAirT_flgSTC1LoTmp IntkAirT_flgSTC1LoVld IntkAirT_flgSTC1NumrInc IntkAirT_mSTC1HiMLInteg IntkAirT_tHSC1Mdl IntkAirT_tiSTC1HiOff IntkAirT_tiSTC1HiOn IntkAirT_tiSTC1LoOff IntkAirT_tiSTC1LoOn IntkAirT_tSnsrFild1Max IntkAirT_tSnsrFild1Min /end LOC_MEASUREMENT
 FUNCTION_VERSION "1.7.0" /end FUNCTION
/begin FUNCTION IntkAirT_PlausDiagSnsr2 "1.8.0     Plausibility Check of the Intake Air Temperature sensor 2"
 /begin DEF_CHARACTERISTIC IntkAirT_cntrSTC2HiVld_C IntkAirT_cntrSTC2LoVld_C IntkAirT_mHSC2MLMax_C IntkAirT_mHSC2MLMin_C IntkAirT_mSTC2HiMLInteg_T IntkAirT_mSTC2HiMLMax_C IntkAirT_mSTC2LoMLMax_C IntkAirT_mSTC2LoMLMin_C IntkAirT_stCfgHSC2_C IntkAirT_stCfgPRC2_C IntkAirT_stCfgSTC2_C IntkAirT_tHSC2HealThd_C IntkAirT_tHSC2Mdl_T IntkAirT_tiHSC2EnaDly_C IntkAirT_tiHSC2ErrDly_C IntkAirT_tiHSC2HealDly_C IntkAirT_tiHSC2MLDly_C IntkAirT_tiPRC2ErrDly_C IntkAirT_tiPRC2HealDly_C IntkAirT_tiSTC2HiOffDly_C IntkAirT_tiSTC2HiOnDly_C IntkAirT_tiSTC2LoOffDly_C IntkAirT_tiSTC2LoOnDly_C IntkAirT_tPRC2Max_C IntkAirT_tPRC2Min_C IntkAirT_tSTC2EnaThdMax_C IntkAirT_tSTC2ErrThd_T IntkAirT_tSTC2HiTMotMin_C IntkAirT_vHSC2VMin_C IntkAirT_vSTC2HiVMax_C IntkAirT_vSTC2LoVMin_C /end DEF_CHARACTERISTIC
 /begin IN_MEASUREMENT AirMod_mfAirCyl CEngDsT_t CEngDsT_tStrtFrst Epm_stSpd IntkAirT_flgSnsr2PlausChkClr IntkAirT_flgSnsr2PlausChkPrms IntkAirT_flgSRCMaxEna IntkAirT_flgSRCMinEna IntkAirT_stSnsr2 IntkAirT_tSnsrFild2 SyC_stSub VehV_v /end IN_MEASUREMENT
 /begin OUT_MEASUREMENT IntkAirT_flgHSC2MaxErr IntkAirT_flgHSC2MaxHeal IntkAirT_flgPlausChk2NumrInc IntkAirT_flgPRC2MaxErr IntkAirT_flgPRC2MaxHeal IntkAirT_flgPRC2MinErr IntkAirT_flgPRC2MinHeal IntkAirT_flgSTC2Err IntkAirT_flgSTC2Heal /end OUT_MEASUREMENT
 /begin LOC_MEASUREMENT IntkAirT_cntrSTC2HiVld IntkAirT_cntrSTC2LoVld IntkAirT_flgDSMClr1000msPlausDiagSnsr2 IntkAirT_flgDSMClr100msPlausDiagSnsr2 IntkAirT_flgHSC2Ena IntkAirT_flgHSC2NumrInc IntkAirT_flgPRC2ErrDeb IntkAirT_flgPRC2ErrTmp IntkAirT_flgPRC2HealDeb IntkAirT_flgPRC2MaxErrTmp IntkAirT_flgPRC2MinErrTmp IntkAirT_flgSTC2Ena IntkAirT_flgSTC2ErrTmp IntkAirT_flgSTC2HiTmp IntkAirT_flgSTC2HiVld IntkAirT_flgSTC2LoTmp IntkAirT_flgSTC2LoVld IntkAirT_flgSTC2NumrInc IntkAirT_mSTC2HiMLInteg IntkAirT_tHSC2Mdl IntkAirT_tiSTC2HiOff IntkAirT_tiSTC2HiOn IntkAirT_tiSTC2LoOff IntkAirT_tiSTC2LoOn IntkAirT_tSnsrFild2Max IntkAirT_tSnsrFild2Min /end LOC_MEASUREMENT
 FUNCTION_VERSION "1.8.0" /end FUNCTION
/begin FUNCTION IntkAirT_VdAirFilDs "1.5.0     Intake Air Temperature after Air Filter"
 /begin DEF_CHARACTERISTIC IntkAirT_stCfgAirFltDs_C IntkAirT_tiAirFltDsMeasdVldDly_C IntkAirT_tiAirFltDs_C /end DEF_CHARACTERISTIC
 /begin IN_MEASUREMENT B_tavvmg_msg IntkAirT_flgAirFltDsMeasdVld IntkAirT_tAirFltDsMeasd IntkAirT_tSnsr2Mdl tavvm_w_msg /end IN_MEASUREMENT
 /begin OUT_MEASUREMENT IntkAirT_flgAirFltDsVld IntkAirT_tAirFltDs IntkAirT_tAirFltDs_Sq /end OUT_MEASUREMENT
 /begin LOC_MEASUREMENT IntkAirT_flgAirFltDsReplVld IntkAirT_tAirFltDsMdlInt IntkAirT_tAirFltDsRepl IntkAirT_tAirFltDsUnFlt /end LOC_MEASUREMENT
 FUNCTION_VERSION "1.5.0" /end FUNCTION
/begin FUNCTION IntkAirT_VdIntkMnfld "1.9.0     Intake Air Temperature in Manifold before Intake Valve (after EGR)"
 /begin DEF_CHARACTERISTIC IntkAirT_stCfgIntkMnfld_C IntkAirT_tiIntkMnfldFil_C IntkAirT_tiIntkMnfldMeasdVldDly_C /end DEF_CHARACTERISTIC
 /begin IN_MEASUREMENT B_tasrmg_msg IntkAirT_flgIntkMnfldMeasdVld IntkAirT_stSnsr1 IntkAirT_tIntkMnfldMeasd IntkAirT_tSnsr1Mdl tasrm_w_msg /end IN_MEASUREMENT
 /begin OUT_MEASUREMENT IntkAirT_flgIntkMnfldVld IntkAirT_tIntkMnfld IntkAirT_tIntkMnfld_Sq /end OUT_MEASUREMENT
 /begin LOC_MEASUREMENT IntkAirT_flgIntkMnfldReplSnsrVld IntkAirT_flgIntkMnfldReplVld IntkAirT_flgIntkMnfldSeln IntkAirT_flgIntkMnfldSelnSwt IntkAirT_tIntkMnfldMdlInt IntkAirT_tIntkMnfldRepl IntkAirT_tIntkMnfldReplSnsr IntkAirT_tIntkMnfldSeln /end LOC_MEASUREMENT
 FUNCTION_VERSION "1.9.0" /end FUNCTION
/begin FUNCTION IntkAirT_VdReplMdlSnsr1 "1.1.0     Virtual Device: Replacement value for intake air temperature sensor 1" /begin DEF_CHARACTERISTIC IntkAirT_tReplSnsr1Mdl_C /end DEF_CHARACTERISTIC /begin IN_MEASUREMENT SyC_stSub /end IN_MEASUREMENT /begin OUT_MEASUREMENT IntkAirT_tSnsr1Mdl /end OUT_MEASUREMENT FUNCTION_VERSION "1.1.0" /end FUNCTION
/begin FUNCTION IntkAirT_VdReplMdlSnsr2 "1.1.0     Virtual Device: Replacement value for intake air temperature sensor 2" /begin DEF_CHARACTERISTIC IntkAirT_tReplSnsr2Mdl_C /end DEF_CHARACTERISTIC /begin IN_MEASUREMENT SyC_stSub /end IN_MEASUREMENT /begin OUT_MEASUREMENT IntkAirT_tSnsr2Mdl /end OUT_MEASUREMENT FUNCTION_VERSION "1.1.0" /end FUNCTION
/begin FUNCTION IntkAirT_VdThrVlvUs "1.9.0     Intake Air Temperature before Throttle Valve" /begin DEF_CHARACTERISTIC IntkAirT_stCfgThrVlvUs_C IntkAirT_tThrVlvUsTolrMax_C /end DEF_CHARACTERISTIC /begin IN_MEASUREMENT B_tavdkmg_msg tavdkm_w_msg /end IN_MEASUREMENT
 /begin OUT_MEASUREMENT IntkAirT_flgThrVlvUsVld IntkAirT_tThrVlvUs IntkAirT_tThrVlvUsMax IntkAirT_tThrVlvUsMin IntkAirT_tThrVlvUs_Sq /end OUT_MEASUREMENT
 /begin LOC_MEASUREMENT IntkAirT_flgThrVlvUsReplSnsrVld IntkAirT_flgThrVlvUsReplVld IntkAirT_tThrVlvUsMdlInt IntkAirT_tThrVlvUsRepl IntkAirT_tThrVlvUsReplSnsr /end LOC_MEASUREMENT
 FUNCTION_VERSION "1.9.0" /end FUNCTION
/begin FUNCTION IVGdiCtl_CvoAdpn "22.2.0    Component Driver Controlled Valve Operation, component adaption"
 /begin DEF_CHARACTERISTIC InjVvG_CvoAdpn_enable_dti_C InjVvG_CvoAdpn_MeasPnts_InjNr_DtiCalc_C InjVvg_pMaxAdpnFullLift_C InjVvG_pMaxCtrlFullLift_C InjVvG_pMaxDeltaInjrCvo_C InjVvg_pMinAdpnFullLift_C InjVvG_pMinCtrlFullLift_C InjVvG_pMinDeltaInjrCvo_C InjVvg_tiOpenMinAdpnFullLift_C InjVvg_tiOpenMinCtrlBall_C InjVvG_tiOpenMinCtrlOffsEB_C InjVvg_vcosMaxAdpnFullLiftCvo_C InjVvg_vcosMinAdpnFullLiftCvo_C IVGdiCtl_CvoAdpn_Bal_DftValCyl_dti_CA IVGdiCtl_CvoAdpn_Bal_dTiOpenMaxCtrlRamp_C IVGdiCtl_CvoAdpn_Bal_dTiOpenMidCtrlRamp_C IVGdiCtl_CvoAdpn_Bal_dTopenCtrlMax2EndBal_C IVGdiCtl_CvoAdpn_Bal_SlopCorrn_Fac_FullLft_tab_C IVGdiCtl_CvoAdpn_Bal_SlopCorrn_Fac_Press_C IVGdiCtl_CvoAdpn_Bal_SlopCorrn_Fac_tantot_C IVGdiCtl_CvoAdpn_Bal_SlopCorrn_Fac_tOpenEB_C IVGdiCtl_CvoAdpn_Bal_SlopCorrn_Offs_C IVGdiCtl_CvoAdpn_Bal_TiOpenMinCtrlRamp_C IVGdiCtl_CvoAdpn_Bal_UseDftVal_dti_C IVGdiCtl_CvoAdpn_BaseAdpnElpdThd_C IVGdiCtl_CvoAdpn_BaseAdpnElpdThd_High_C IVGdiCtl_CvoAdpn_Cal1_C IVGdiCtl_CvoAdpn_CorrnTantotTp_CUR IVGdiCtl_CvoAdpn_Ctrl_FacDeltaTopenToDti_GT IVGdiCtl_CvoAdpn_Ctrl_FacDeltaTopenToIntegGain_CUR IVGdiCtl_CvoAdpn_Ctrl_Lim_dtiIterStep_GT IVGdiCtl_CvoAdpn_Ctrl_Lim_dTopenInsdTolrRng_C IVGdiCtl_CvoAdpn_Ctrl_Lim_dtpIterStep_C IVGdiCtl_CvoAdpn_Ctrl_TolrRng_dTopen_GT IVGdiCtl_CvoAdpn_DftVal_tantot_const_GT IVGdiCtl_CvoAdpn_DrgPtrClr_C IVGdiCtl_CvoAdpn_DrgPtr_VcosMsk_CA IVGdiCtl_CvoAdpn_dTantot_CUR IVGdiCtl_CvoAdpn_enable_FullLft_ReAdpn_C IVGdiCtl_CvoAdpn_enable_IntegRstNoCtrl_C IVGdiCtl_CvoAdpn_enable_IntegValPls_C IVGdiCtl_CvoAdpn_enable_OnlineCtrl_C IVGdiCtl_CvoAdpn_enable_SimErr_C IVGdiCtl_CvoAdpn_enable_TiCorDurTantotDet_C IVGdiCtl_CvoAdpn_Fac_DtiDtopenEB_C IVGdiCtl_CvoAdpn_FiltAdpnVal_Fac_C IVGdiCtl_CvoAdpn_FiltTabAdpnInteg_Fac_C IVGdiCtl_CvoAdpn_FiltTabInteg_Fac_C IVGdiCtl_CvoAdpn_Filt_dti_Thd_C IVGdiCtl_CvoAdpn_FullLft_DftValCyl_dti_CA IVGdiCtl_CvoAdpn_FullLft_dTiOpenMaxCtrlRamp_C IVGdiCtl_CvoAdpn_FullLft_dTiOpenMidCtrlRamp_C IVGdiCtl_CvoAdpn_FullLft_SlopCorrn_Fac_Tab_C IVGdiCtl_CvoAdpn_FullLft_TiOpenMaxCtrlRamp_C IVGdiCtl_CvoAdpn_FullLft_UseDftVal_dti_C IVGdiCtl_CvoAdpn_FullLift_tabAdpn_Thd_C IVGdiCtl_CvoAdpn_IninAdpnVal_C IVGdiCtl_CvoAdpn_IninIntegVal_C IVGdiCtl_CvoAdpn_Lim_Bal_dtiNeg_C IVGdiCtl_CvoAdpn_Lim_Bal_dtiPos_C IVGdiCtl_CvoAdpn_Lim_FullLft_dtiNeg_C IVGdiCtl_CvoAdpn_Lim_FullLft_dtiPos_C IVGdiCtl_CvoAdpn_Lim_IntegNeg_GT IVGdiCtl_CvoAdpn_Lim_IntegPos_GT IVGdiCtl_CvoAdpn_MaxTiForDtiCorrn_GT IVGdiCtl_CvoAdpn_pRef_TabFullLft_C IVGdiCtl_CvoAdpn_ReqDtiPrsForRefTiCorrn_C IVGdiCtl_CvoAdpn_SimErrCyl_Bal_dtiOffs_CA IVGdiCtl_CvoAdpn_SimErrCyl_Bal_tabOffs_CA IVGdiCtl_CvoAdpn_SimErrCyl_dTiOpenOffs_CA IVGdiCtl_CvoAdpn_SimErrCyl_FullLft_dtiOffs_CA IVGdiCtl_CvoAdpn_SimErrCyl_FullLft_tabOffs_CA IVGdiCtl_CvoAdpn_SimErrCyl_tantotOffs_CA IVGdiCtl_CvoAdpn_SimErrCyl_Tran_TiOpenOffs_CA IVGdiCtl_CvoAdpn_SubValCorrnFac_tantot_C IVGdiCtl_CvoAdpn_SubValTyp_C IVGdiCtl_CvoAdpn_SubValVcosSrchPrio_GT IVGdiCtl_CvoAdpn_TiAtTantotConst_CUR IVGdiCtl_CvoAdpn_tiMinPseAdpn_C IVGdiCtl_CvoAdpn_tiMinPseCtrl_C IVGdiCtl_CvoAdpn_tiOpenRampEnd_C IVGdiCtl_CvoAdpn_tiStrt_Dti_tabmin_CUR IVGdiCtl_CvoAdpn_Topen_Ax IVGdiCtl_CvoAdpn_Tran_DftValCyl_dTopen_CA IVGdiCtl_CvoAdpn_Tran_SlopCorrn_Fac_dTopen_C IVGdiCtl_CvoAdpn_Tran_UseDftVal_dTopen_C IVGdiCtl_CvoAdpn_UseDft_tantot_C /end DEF_CHARACTERISTIC
 /begin REF_CHARACTERISTIC InjSys_idxPPntTran_C InjSys_idxVcosPntTran_C InjSys_nrPVcosPrioCvo1_GT InjSys_nrPVcosPrioCvo2_GT InjSys_nrPVcosPrioCvo3_GT InjSys_nrPVcosPrioCvo4_GT InjSys_nrPVcosPrioCvo5_GT InjSys_nrPVcosPrioCvo6_GT InjSys_pCvoExtdRng_Ax InjSys_tiDeltaEndBall_C InjSys_tiInjNlnrHiResl_T InjSys_tiOpenMaxBall_C InjSys_tiOpenMinFullLft_C InjSys_tiOpenRefCvo_C InjSys_vcosCvo_Ax TIMINP /end REF_CHARACTERISTIC
 /begin IN_MEASUREMENT Epm_numCyl evz_austot_msg InjSys_flgAdpnCvo InjSys_flgBascAdpnCvo InjSys_flgCtrlCvo InjSys_flgSysGenRelsCvo InjSys_flgVcosOperCvo InjSys_pPRailCvoExtdRng InjSys_pSpRailCvoExtdRng InjSys_tiInjRefBgnTrans InjSys_tiInjRefCvo InjSys_vcosFuCvo InjSys_vcosPntCvo IVGdiCtl_CvoSigEvln_AcqCtr IVGdiCtl_CvoSigEvln_Status SyC_stSub /end IN_MEASUREMENT
 /begin OUT_MEASUREMENT InjVvG_CvoAdpn_flgRelCtrl InjVvG_CvoAdpn_RefTiCorrAry InjVvG_CvoAdpn_RelCtrlCyl InjVvG_CvoAdpn_RmnCylMask InjVvG_CvoAdpn_RmnPMask InjVvG_CvoAdpn_stReasBascAdpn InjVvG_CvoAdpn_Tran_RmnCylMask IVGdiCtl_CvoAdpn_Bal_stCtrlRunngMask IVGdiCtl_CvoAdpn_FullLft_stCtrlRunngMask IVGdiCtl_CvoAdpn_PPrioAry_u8 /end OUT_MEASUREMENT
 /begin LOC_MEASUREMENT InjVvG_CvoAdpn_DrgPtr_dtiCorrnBal_Max_Vcos0 InjVvG_CvoAdpn_DrgPtr_dtiCorrnBal_Max_Vcos1 InjVvG_CvoAdpn_DrgPtr_dtiCorrnBal_Min_Vcos0 InjVvG_CvoAdpn_DrgPtr_dtiCorrnBal_Min_Vcos1 InjVvG_CvoAdpn_DrgPtr_tantot_Max_Vcos0 InjVvG_CvoAdpn_DrgPtr_tantot_Max_Vcos1 InjVvG_CvoAdpn_DrgPtr_tantot_Min_Vcos0 InjVvG_CvoAdpn_DrgPtr_tantot_Min_Vcos1 IVGdiCtl_CvoAdpn_Bal_tiOpenAtIntegCalc_u16 IVGdiCtl_CvoAdpn_BaseAdpnPntVld_b IVGdiCtl_CvoAdpn_currTi_u32 IVGdiCtl_CvoAdpn_currTopen_pls_u16 IVGdiCtl_CvoAdpn_currTopen_u16 IVGdiCtl_CvoAdpn_currTopen_u32 IVGdiCtl_CvoAdpn_currTp_u16 IVGdiCtl_CvoAdpn_CylState IVGdiCtl_CvoAdpn_Cyl_CvoSigEvln_u8 IVGdiCtl_CvoAdpn_Cyl_InjDDGdi_u8 IVGdiCtl_CvoAdpn_deltaInjCntr_u16 IVGdiCtl_CvoAdpn_delta_tantot_tp_s16 IVGdiCtl_CvoAdpn_delta_toffen_cyl_s16 IVGdiCtl_CvoAdpn_delta_toffen_s16 IVGdiCtl_CvoAdpn_desTopen_u16 IVGdiCtl_CvoAdpn_DrgPtr_dtiCorrnFullLft_Max_s8 IVGdiCtl_CvoAdpn_DrgPtr_dtiCorrnFullLft_Min_s8 IVGdiCtl_CvoAdpn_DrgPtr_dTopenPlateau_Max_s8 IVGdiCtl_CvoAdpn_DrgPtr_dTopenPlateau_Min_s8 IVGdiCtl_CvoAdpn_DrgPtr_tiAbFullLft_Max_u8 IVGdiCtl_CvoAdpn_DrgPtr_tiAbFullLft_Min_u8 IVGdiCtl_CvoAdpn_dtiInteg_ChgdPls_u8 IVGdiCtl_CvoAdpn_dti_Bal_cyl_s16 IVGdiCtl_CvoAdpn_dti_Bal_dtopen_to_dti_s32 IVGdiCtl_CvoAdpn_dti_Bal_dtopen_to_ref_s16 IVGdiCtl_CvoAdpn_dti_Bal_Integ_cyl_s16 IVGdiCtl_CvoAdpn_dti_Bal_Slop_cyl_s16 IVGdiCtl_CvoAdpn_dti_FullLft_cyl_s16 IVGdiCtl_CvoAdpn_dti_FullLft_Integ_cyl_s16 IVGdiCtl_CvoAdpn_dti_Tran_Plateau_cyl_s16 IVGdiCtl_CvoAdpn_Estimd_delta_ti_s16 IVGdiCtl_CvoAdpn_FacDeltaTopenToDtiTot_u16 IVGdiCtl_CvoAdpn_FacDeltaTopenToDti_u8 IVGdiCtl_CvoAdpn_FacDeltaTopenToIntegGain_u8 IVGdiCtl_CvoAdpn_finished_cyl_u8 IVGdiCtl_CvoAdpn_FrzFrmVld_b IVGdiCtl_CvoAdpn_FullLft_dtiInteg_ChgdPls_u8 IVGdiCtl_CvoAdpn_FullLft_dti_finished_cyl_u8 IVGdiCtl_CvoAdpn_FullLft_Filt_dti_cyl_s16 IVGdiCtl_CvoAdpn_FullLft_finished_cyl_u8 IVGdiCtl_CvoAdpn_FullLft_Integ_DeltaInjTi IVGdiCtl_CvoAdpn_FullLft_RmnCylMask IVGdiCtl_CvoAdpn_FullLft_tiOpenAtIntegCalc_u16 IVGdiCtl_CvoAdpn_idxP_u8 IVGdiCtl_CvoAdpn_idxVcos_u8 IVGdiCtl_CvoAdpn_InjDDGdi_CvoActCyl_u8 IVGdiCtl_CvoAdpn_Integ_DeltaInjTi_s16 IVGdiCtl_CvoAdpn_Integ_Tp_u16 IVGdiCtl_CvoAdpn_MeasCntr_u8 IVGdiCtl_CvoAdpn_MeasPlsInfo_pls_u16 IVGdiCtl_CvoAdpn_MeasPlsInfo_u16 IVGdiCtl_CvoAdpn_Pls_InjDDGdi_u8 IVGdiCtl_CvoAdpn_ReAdpnCntrCyl_u8 IVGdiCtl_CvoAdpn_RelBits_u8 IVGdiCtl_CvoAdpn_stAdpnCmpl_u8 IVGdiCtl_CvoAdpn_stReasBascAdpn_u8 IVGdiCtl_CvoAdpn_tantotReAdpnReq_vcos_u8 IVGdiCtl_CvoAdpn_tantot_finished_cyl_u8 IVGdiCtl_CvoAdpn_TempBaseAdpnReqCyl_u8 IVGdiCtl_CvoAdpn_tiOpenMinFullLftCtrl_u16 IVGdiCtl_CvoAdpn_TiStrt_CvoSigEvln_Tab_u16 IVGdiCtl_CvoAdpn_TiStrt_CvoSigEvln_Ti_u16 IVGdiCtl_CvoAdpn_TiStrt_InitVal_s16 IVGdiCtl_CvoAdpn_TiStrt_Ti_u16 IVGdiCtl_CvoAdpn_toffenCtrl_Progs IVGdiCtl_CvoAdpn_Tran_des_te_s16 IVGdiCtl_CvoAdpn_Tran_dTopen_finished_cyl_u8 IVGdiCtl_CvoAdpn_Tran_estim_te_s16 IVGdiCtl_CvoAdpn_Tran_finished_cyl_u8 IVGdiCtl_CvoAdpn_TrigBaseAdpnCntr_u16 IVGdiCtl_CvoAdpn_TrigBaseAdpnWithRstCntr_u16 IVGdiCtl_CvoAdpn_used_tantot_const_u16 IVGdiCtl_CvoAdpn_used_tantot_type IVGdiCtl_CvoAdpn_used_tantot_u16 /end LOC_MEASUREMENT
 FUNCTION_VERSION "22.2.0" /end FUNCTION
/begin FUNCTION IVGdiCtl_CvoAdpn_Auto "IVGdiCtl_CvoAdpn_Auto"
 /begin OUT_MEASUREMENT IVGdiCtl_CvoAdpn_BaseAdpnFinshdCntr_u16 IVGdiCtl_CvoAdpn_dti_finished_cylMask_Press0 IVGdiCtl_CvoAdpn_dti_finished_cylMask_Press1 IVGdiCtl_CvoAdpn_dti_finished_cylMask_Press2 IVGdiCtl_CvoAdpn_dti_finished_cylMask_Press3 IVGdiCtl_CvoAdpn_dti_finished_cylMask_Press4 /end OUT_MEASUREMENT
 /begin LOC_MEASUREMENT InjVvG_CvoAdpn_BaseAdpnCntr_Vcos0 InjVvG_CvoAdpn_BaseAdpnCntr_Vcos1 InjVvG_CvoAdpn_BaseAdpnCntr_Vcos2 InjVvG_CvoAdpn_BaseAdpnCntr_Vcos3 InjVvG_CvoAdpn_BaseAdpnCntr_Vcos4 InjVvG_CvoAdpn_BaseAdpnCntr_Vcos5 InjVvG_CvoAdpn_BaseAdpnLstMeas_Vcos0 InjVvG_CvoAdpn_BaseAdpnLstMeas_Vcos1 InjVvG_CvoAdpn_BaseAdpnLstMeas_Vcos2 InjVvG_CvoAdpn_BaseAdpnLstMeas_Vcos3 InjVvG_CvoAdpn_BaseAdpnLstMeas_Vcos4 InjVvG_CvoAdpn_BaseAdpnLstMeas_Vcos5 InjVvG_CvoAdpn_DeltaTiBal_SwCyl0_Vcos0_Press0 InjVvG_CvoAdpn_DeltaTiBal_SwCyl0_Vcos0_Press1 InjVvG_CvoAdpn_DeltaTiBal_SwCyl0_Vcos0_Press2 InjVvG_CvoAdpn_DeltaTiBal_SwCyl0_Vcos0_Press3 InjVvG_CvoAdpn_DeltaTiBal_SwCyl0_Vcos0_Press4 InjVvG_CvoAdpn_DeltaTiBal_SwCyl0_Vcos1_Press0 InjVvG_CvoAdpn_DeltaTiBal_SwCyl0_Vcos1_Press1 InjVvG_CvoAdpn_DeltaTiBal_SwCyl0_Vcos1_Press2 InjVvG_CvoAdpn_DeltaTiBal_SwCyl0_Vcos1_Press3 InjVvG_CvoAdpn_DeltaTiBal_SwCyl0_Vcos1_Press4 InjVvG_CvoAdpn_DeltaTiBal_SwCyl0_Vcos2_Press0 InjVvG_CvoAdpn_DeltaTiBal_SwCyl0_Vcos2_Press1 InjVvG_CvoAdpn_DeltaTiBal_SwCyl0_Vcos2_Press2 InjVvG_CvoAdpn_DeltaTiBal_SwCyl0_Vcos2_Press3 InjVvG_CvoAdpn_DeltaTiBal_SwCyl0_Vcos2_Press4 InjVvG_CvoAdpn_DeltaTiBal_SwCyl0_Vcos3_Press0 InjVvG_CvoAdpn_DeltaTiBal_SwCyl0_Vcos3_Press1 InjVvG_CvoAdpn_DeltaTiBal_SwCyl0_Vcos3_Press2 InjVvG_CvoAdpn_DeltaTiBal_SwCyl0_Vcos3_Press3 InjVvG_CvoAdpn_DeltaTiBal_SwCyl0_Vcos3_Press4 InjVvG_CvoAdpn_DeltaTiBal_SwCyl0_Vcos4_Press0 InjVvG_CvoAdpn_DeltaTiBal_SwCyl0_Vcos4_Press1 InjVvG_CvoAdpn_DeltaTiBal_SwCyl0_Vcos4_Press2 InjVvG_CvoAdpn_DeltaTiBal_SwCyl0_Vcos4_Press3 InjVvG_CvoAdpn_DeltaTiBal_SwCyl0_Vcos4_Press4 InjVvG_CvoAdpn_DeltaTiBal_SwCyl0_Vcos5_Press0 InjVvG_CvoAdpn_DeltaTiBal_SwCyl0_Vcos5_Press1 InjVvG_CvoAdpn_DeltaTiBal_SwCyl0_Vcos5_Press2 InjVvG_CvoAdpn_DeltaTiBal_SwCyl0_Vcos5_Press3 InjVvG_CvoAdpn_DeltaTiBal_SwCyl0_Vcos5_Press4 InjVvG_CvoAdpn_DeltaTiBal_SwCyl1_Vcos0_Press0 InjVvG_CvoAdpn_DeltaTiBal_SwCyl1_Vcos0_Press1 InjVvG_CvoAdpn_DeltaTiBal_SwCyl1_Vcos0_Press2 InjVvG_CvoAdpn_DeltaTiBal_SwCyl1_Vcos0_Press3 InjVvG_CvoAdpn_DeltaTiBal_SwCyl1_Vcos0_Press4 InjVvG_CvoAdpn_DeltaTiBal_SwCyl1_Vcos1_Press0 InjVvG_CvoAdpn_DeltaTiBal_SwCyl1_Vcos1_Press1 InjVvG_CvoAdpn_DeltaTiBal_SwCyl1_Vcos1_Press2 InjVvG_CvoAdpn_DeltaTiBal_SwCyl1_Vcos1_Press3 InjVvG_CvoAdpn_DeltaTiBal_SwCyl1_Vcos1_Press4 InjVvG_CvoAdpn_DeltaTiBal_SwCyl1_Vcos2_Press0 InjVvG_CvoAdpn_DeltaTiBal_SwCyl1_Vcos2_Press1 InjVvG_CvoAdpn_DeltaTiBal_SwCyl1_Vcos2_Press2 InjVvG_CvoAdpn_DeltaTiBal_SwCyl1_Vcos2_Press3 InjVvG_CvoAdpn_DeltaTiBal_SwCyl1_Vcos2_Press4 InjVvG_CvoAdpn_DeltaTiBal_SwCyl1_Vcos3_Press0 InjVvG_CvoAdpn_DeltaTiBal_SwCyl1_Vcos3_Press1 InjVvG_CvoAdpn_DeltaTiBal_SwCyl1_Vcos3_Press2 InjVvG_CvoAdpn_DeltaTiBal_SwCyl1_Vcos3_Press3 InjVvG_CvoAdpn_DeltaTiBal_SwCyl1_Vcos3_Press4 InjVvG_CvoAdpn_DeltaTiBal_SwCyl1_Vcos4_Press0 InjVvG_CvoAdpn_DeltaTiBal_SwCyl1_Vcos4_Press1 InjVvG_CvoAdpn_DeltaTiBal_SwCyl1_Vcos4_Press2 InjVvG_CvoAdpn_DeltaTiBal_SwCyl1_Vcos4_Press3 InjVvG_CvoAdpn_DeltaTiBal_SwCyl1_Vcos4_Press4 InjVvG_CvoAdpn_DeltaTiBal_SwCyl1_Vcos5_Press0 InjVvG_CvoAdpn_DeltaTiBal_SwCyl1_Vcos5_Press1 InjVvG_CvoAdpn_DeltaTiBal_SwCyl1_Vcos5_Press2 InjVvG_CvoAdpn_DeltaTiBal_SwCyl1_Vcos5_Press3 InjVvG_CvoAdpn_DeltaTiBal_SwCyl1_Vcos5_Press4 InjVvG_CvoAdpn_DeltaTiBal_SwCyl2_Vcos0_Press0 InjVvG_CvoAdpn_DeltaTiBal_SwCyl2_Vcos0_Press1 InjVvG_CvoAdpn_DeltaTiBal_SwCyl2_Vcos0_Press2 InjVvG_CvoAdpn_DeltaTiBal_SwCyl2_Vcos0_Press3 InjVvG_CvoAdpn_DeltaTiBal_SwCyl2_Vcos0_Press4 InjVvG_CvoAdpn_DeltaTiBal_SwCyl2_Vcos1_Press0 InjVvG_CvoAdpn_DeltaTiBal_SwCyl2_Vcos1_Press1 InjVvG_CvoAdpn_DeltaTiBal_SwCyl2_Vcos1_Press2 InjVvG_CvoAdpn_DeltaTiBal_SwCyl2_Vcos1_Press3 InjVvG_CvoAdpn_DeltaTiBal_SwCyl2_Vcos1_Press4 InjVvG_CvoAdpn_DeltaTiBal_SwCyl2_Vcos2_Press0 InjVvG_CvoAdpn_DeltaTiBal_SwCyl2_Vcos2_Press1 InjVvG_CvoAdpn_DeltaTiBal_SwCyl2_Vcos2_Press2 InjVvG_CvoAdpn_DeltaTiBal_SwCyl2_Vcos2_Press3 InjVvG_CvoAdpn_DeltaTiBal_SwCyl2_Vcos2_Press4 InjVvG_CvoAdpn_DeltaTiBal_SwCyl2_Vcos3_Press0 InjVvG_CvoAdpn_DeltaTiBal_SwCyl2_Vcos3_Press1 InjVvG_CvoAdpn_DeltaTiBal_SwCyl2_Vcos3_Press2 InjVvG_CvoAdpn_DeltaTiBal_SwCyl2_Vcos3_Press3 InjVvG_CvoAdpn_DeltaTiBal_SwCyl2_Vcos3_Press4 InjVvG_CvoAdpn_DeltaTiBal_SwCyl2_Vcos4_Press0 InjVvG_CvoAdpn_DeltaTiBal_SwCyl2_Vcos4_Press1 InjVvG_CvoAdpn_DeltaTiBal_SwCyl2_Vcos4_Press2 InjVvG_CvoAdpn_DeltaTiBal_SwCyl2_Vcos4_Press3 InjVvG_CvoAdpn_DeltaTiBal_SwCyl2_Vcos4_Press4 InjVvG_CvoAdpn_DeltaTiBal_SwCyl2_Vcos5_Press0 InjVvG_CvoAdpn_DeltaTiBal_SwCyl2_Vcos5_Press1 InjVvG_CvoAdpn_DeltaTiBal_SwCyl2_Vcos5_Press2 InjVvG_CvoAdpn_DeltaTiBal_SwCyl2_Vcos5_Press3 InjVvG_CvoAdpn_DeltaTiBal_SwCyl2_Vcos5_Press4 InjVvG_CvoAdpn_DeltaTiBal_SwCyl3_Vcos0_Press0 InjVvG_CvoAdpn_DeltaTiBal_SwCyl3_Vcos0_Press1 InjVvG_CvoAdpn_DeltaTiBal_SwCyl3_Vcos0_Press2 InjVvG_CvoAdpn_DeltaTiBal_SwCyl3_Vcos0_Press3 InjVvG_CvoAdpn_DeltaTiBal_SwCyl3_Vcos0_Press4 InjVvG_CvoAdpn_DeltaTiBal_SwCyl3_Vcos1_Press0 InjVvG_CvoAdpn_DeltaTiBal_SwCyl3_Vcos1_Press1 InjVvG_CvoAdpn_DeltaTiBal_SwCyl3_Vcos1_Press2 InjVvG_CvoAdpn_DeltaTiBal_SwCyl3_Vcos1_Press3 InjVvG_CvoAdpn_DeltaTiBal_SwCyl3_Vcos1_Press4 InjVvG_CvoAdpn_DeltaTiBal_SwCyl3_Vcos2_Press0 InjVvG_CvoAdpn_DeltaTiBal_SwCyl3_Vcos2_Press1 InjVvG_CvoAdpn_DeltaTiBal_SwCyl3_Vcos2_Press2 InjVvG_CvoAdpn_DeltaTiBal_SwCyl3_Vcos2_Press3 InjVvG_CvoAdpn_DeltaTiBal_SwCyl3_Vcos2_Press4 InjVvG_CvoAdpn_DeltaTiBal_SwCyl3_Vcos3_Press0 InjVvG_CvoAdpn_DeltaTiBal_SwCyl3_Vcos3_Press1 InjVvG_CvoAdpn_DeltaTiBal_SwCyl3_Vcos3_Press2 InjVvG_CvoAdpn_DeltaTiBal_SwCyl3_Vcos3_Press3 InjVvG_CvoAdpn_DeltaTiBal_SwCyl3_Vcos3_Press4 InjVvG_CvoAdpn_DeltaTiBal_SwCyl3_Vcos4_Press0 InjVvG_CvoAdpn_DeltaTiBal_SwCyl3_Vcos4_Press1 InjVvG_CvoAdpn_DeltaTiBal_SwCyl3_Vcos4_Press2 InjVvG_CvoAdpn_DeltaTiBal_SwCyl3_Vcos4_Press3 InjVvG_CvoAdpn_DeltaTiBal_SwCyl3_Vcos4_Press4 InjVvG_CvoAdpn_DeltaTiBal_SwCyl3_Vcos5_Press0 InjVvG_CvoAdpn_DeltaTiBal_SwCyl3_Vcos5_Press1 InjVvG_CvoAdpn_DeltaTiBal_SwCyl3_Vcos5_Press2 InjVvG_CvoAdpn_DeltaTiBal_SwCyl3_Vcos5_Press3 InjVvG_CvoAdpn_DeltaTiBal_SwCyl3_Vcos5_Press4 InjVvG_CvoAdpn_dtidtopenEB_SwCyl0 InjVvG_CvoAdpn_dtidtopenEB_SwCyl1 InjVvG_CvoAdpn_dtidtopenEB_SwCyl2 InjVvG_CvoAdpn_dtidtopenEB_SwCyl3 InjVvG_CvoAdpn_FullLft_DeltaTi_SwCyl0 InjVvG_CvoAdpn_FullLft_DeltaTi_SwCyl1 InjVvG_CvoAdpn_FullLft_DeltaTi_SwCyl2 InjVvG_CvoAdpn_FullLft_DeltaTi_SwCyl3 InjVvG_CvoAdpn_FullLft_tab_SwCyl0 InjVvG_CvoAdpn_FullLft_tab_SwCyl1 InjVvG_CvoAdpn_FullLft_tab_SwCyl2 InjVvG_CvoAdpn_FullLft_tab_SwCyl3 InjVvG_CvoAdpn_InjCntr InjVvG_CvoAdpn_Tantot_SwCyl0_Vcos0 InjVvG_CvoAdpn_Tantot_SwCyl0_Vcos1 InjVvG_CvoAdpn_Tantot_SwCyl0_Vcos2 InjVvG_CvoAdpn_Tantot_SwCyl0_Vcos3 InjVvG_CvoAdpn_Tantot_SwCyl0_Vcos4 InjVvG_CvoAdpn_Tantot_SwCyl0_Vcos5 InjVvG_CvoAdpn_Tantot_SwCyl1_Vcos0 InjVvG_CvoAdpn_Tantot_SwCyl1_Vcos1 InjVvG_CvoAdpn_Tantot_SwCyl1_Vcos2 InjVvG_CvoAdpn_Tantot_SwCyl1_Vcos3 InjVvG_CvoAdpn_Tantot_SwCyl1_Vcos4 InjVvG_CvoAdpn_Tantot_SwCyl1_Vcos5 InjVvG_CvoAdpn_Tantot_SwCyl2_Vcos0 InjVvG_CvoAdpn_Tantot_SwCyl2_Vcos1 InjVvG_CvoAdpn_Tantot_SwCyl2_Vcos2 InjVvG_CvoAdpn_Tantot_SwCyl2_Vcos3 InjVvG_CvoAdpn_Tantot_SwCyl2_Vcos4 InjVvG_CvoAdpn_Tantot_SwCyl2_Vcos5 InjVvG_CvoAdpn_Tantot_SwCyl3_Vcos0 InjVvG_CvoAdpn_Tantot_SwCyl3_Vcos1 InjVvG_CvoAdpn_Tantot_SwCyl3_Vcos2 InjVvG_CvoAdpn_Tantot_SwCyl3_Vcos3 InjVvG_CvoAdpn_Tantot_SwCyl3_Vcos4 InjVvG_CvoAdpn_Tantot_SwCyl3_Vcos5 InjVvG_CvoAdpn_Tran_DeltaTopen_SwCyl0 InjVvG_CvoAdpn_Tran_DeltaTopen_SwCyl1 InjVvG_CvoAdpn_Tran_DeltaTopen_SwCyl2 InjVvG_CvoAdpn_Tran_DeltaTopen_SwCyl3 /end LOC_MEASUREMENT
/end FUNCTION
/begin COMPU_METHOD B_TRUE "" TAB_VERB "%6.3" "" COMPU_TAB_REF B_TRUE /end COMPU_METHOD
/begin COMPU_VTAB B_TRUE "" TAB_VERB 2 0 "FALSE" 1 "TRUE" /end COMPU_VTAB
/begin COMPU_METHOD dez "" RAT_FUNC "%6.2" "" COEFFS 0 1 0 0 0 1 /end COMPU_METHOD
/begin COMPU_METHOD fak_sw_b2 "" RAT_FUNC "%7.6" "-" COEFFS 0 65536 0 0 0 4 /end COMPU_METHOD
/begin COMPU_METHOD fak_ub_b1 "" RAT_FUNC "%6.4" "-" COEFFS 0 256 0 0 0 1 /end COMPU_METHOD
/begin COMPU_METHOD freq_q0p1 "" RAT_FUNC "%6.3" "1/s" COEFFS 0 1 0 0 0 0.1 /end COMPU_METHOD
/begin COMPU_METHOD IVGdiCtl_CvoAdpn_MeasPlsInfo_t "" TAB_VERB "%6.3" "" COMPU_TAB_REF IVGdiCtl_CvoAdpn_MeasPlsInfo_t /end COMPU_METHOD
/begin COMPU_VTAB IVGdiCtl_CvoAdpn_MeasPlsInfo_t "" TAB_VERB 33 0 "None" 8 "Bal" 9 "BalAdpn" 10 "BalCtrl" 128 "Tran" 144 "TranAdpn" 160 "TranCtrl" 2048 "FullLft" 2304 "FullLftAdpn" 2560 "FullLftCtrl" 2816 "FullLftCtrlAdpn" 6144 "Locked_FullLft" 16384 "NotUsed" 16392 "NotUsed_Bal" 16393 "NotUsed_BalAdpn" 16394 "NotUsed_BalCtrl" 16512 "NotUsed_Tran" 16528 "NotUsed_TranAdpn" 16544 "NotUsed_TranCtrl" 18432 "NotUsed_FullLft" 18688 "NotUsed_FullLftAdpn" 18944 "NotUsed_FullLftCtrl" 19200 "NotUsed_FullLftCtrlAdpn" 20480 "Locked_NotUsed" 20488 "Locked_NotUsed_Bal" 20489 "Locked_NotUsed_BalAdpn" 20490 "Locked_NotUsed_BalCtrl" 20608 "Locked_NotUsed_Tran" 20624 "Locked_NotUsed_TranAdpn" 20640 "Locked_NotUsed_TranCtrl" 22528 "Locked_NotUsed_FullLft" 22784 "Locked_NotUsed_FullLftAdpn" 23040 "Locked_NotUsed_FullLftCtrl" /end COMPU_VTAB
/begin COMPU_METHOD IVGdiCtl_CvoAdpn_q0p1_DIV_e6 "" RAT_FUNC "%6.3" "e-6" COEFFS 0 10 0 0 0 1 /end COMPU_METHOD
/begin COMPU_METHOD IVGdiCtl_CvoAdpn_q0p1_DIV_e6_MPa "" RAT_FUNC "%6.3" "e-6/MPa" COEFFS 0 10 0 0 0 1 /end COMPU_METHOD
/begin COMPU_METHOD IVGdiCtl_CvoAdpn_q0p1_us_DIV_MPa "" RAT_FUNC "%6.3" "us/MPa" COEFFS 0 10 0 0 0 1 /end COMPU_METHOD
/begin COMPU_METHOD IVGdiCtl_CvoAdpn_State_t "" TAB_VERB "%6.3" "" COMPU_TAB_REF IVGdiCtl_CvoAdpn_State_t /end COMPU_METHOD
/begin COMPU_VTAB IVGdiCtl_CvoAdpn_State_t "" TAB_VERB 10 0 "Idle" 1 "Tantot" 2 "RefTi" 3 "ReAdpn" 4 "OnlineCtrl" 5 "UpdTantot" 6 "FullLftAdpn" 7 "FullLft" 8 "Tran" 9 "TranAdpn" /end COMPU_VTAB
/begin COMPU_METHOD IVGdiCtl_CvoAdpn_TantotType_t "" TAB_VERB "%6.3" "" COMPU_TAB_REF IVGdiCtl_CvoAdpn_TantotType_t /end COMPU_METHOD
/begin COMPU_VTAB IVGdiCtl_CvoAdpn_TantotType_t "" TAB_VERB 4 0 "Learned" 1 "Default" 2 "ExtSubVal" 255 "None" /end COMPU_VTAB
/begin COMPU_METHOD IVGdiCtl_CvoAdpn_toffenCtrl_Progs_t "" TAB_VERB "%6.3" "" COMPU_TAB_REF IVGdiCtl_CvoAdpn_toffenCtrl_Progs_t /end COMPU_METHOD
/begin COMPU_VTAB IVGdiCtl_CvoAdpn_toffenCtrl_Progs_t "" TAB_VERB 14 0 "Idle" 1 "Called" 2 "DataConsistent" 3 "Released" 4 "MeasPlaus" 5 "UpdInteg" 6 "IntegStabChkd" 7 "dTopenInsdTolRng" 8 "AdpnIntegStab" 9 "AdpnIntegNotStab" 10 "dTopenOutsdTolRng" 11 "IntegStabNotChkd" 12 "AdpnIntegBalStab" 13 "AdpnIntegFullStab" /end COMPU_VTAB
/begin COMPU_METHOD IVGdiCtl_CvoAdpn_t_q0p8us_o51p2 "" RAT_FUNC "%6.2" "us" COEFFS 0 1 -51.2 0 0 0.8 /end COMPU_METHOD
/begin COMPU_METHOD m_ub_b1020 "" RAT_FUNC "%6.2" "kg/h" COEFFS 0 1 0 0 0 4 /end COMPU_METHOD
/begin COMPU_METHOD m_ub_b23p3 "" RAT_FUNC "%6.3" "kg" COEFFS 0 2812.5 0 0 0 256 /end COMPU_METHOD
/begin COMPU_METHOD OneToOne "" RAT_FUNC "%6.2" "-" COEFFS 0 1 0 0 0 1 /end COMPU_METHOD
/begin COMPU_METHOD RBPtCel_p_0p002_1 "" RAT_FUNC "%6.4" "MPa" COEFFS 0 1000 0 0 0 2 /end COMPU_METHOD
/begin COMPU_METHOD RBPtCel_vcos_5p0em5_1 "" RAT_FUNC "%7.6" "mPaSec" COEFFS 0 20000 0 0 0 1 /end COMPU_METHOD
/begin COMPU_METHOD rel_q0p01 "" RAT_FUNC "%6.4" "%" COEFFS 0 100 0 0 0 1 /end COMPU_METHOD
/begin COMPU_METHOD rel_q1 "" RAT_FUNC "%6.2" "%" COEFFS 0 1 0 0 0 1 /end COMPU_METHOD
/begin COMPU_METHOD rel_ub_b100 "" RAT_FUNC "%6.3" "%" COEFFS 0 256 0 0 0 100 /end COMPU_METHOD
/begin COMPU_METHOD SigQly_COMPU_VERB "" TAB_VERB "%6.3" "" COMPU_TAB_REF SigQly_COMPU_VERB /end COMPU_METHOD
/begin COMPU_VTAB SigQly_COMPU_VERB "" TAB_VERB 16 0 "SIGQLY_NOTCALC" 1 "SIGQLY_INIT" 2 "SIGQLY_OK" 3 "SIGQLY_MODEL" 4 "SIGQLY_REPLACEMENT" 5 "SIGQLY_FROZEN" 6 "SIGQLY_INVALID" 7 "SIGQLY_RESERVED_7" 8 "SIGQLY_RESERVED_8" 9 "SIGQLY_RESERVED_9" 10 "SIGQLY_RESERVED_10" 11 "SIGQLY_RESERVED_11" 12 "SIGQLY_RESERVED_12" 13 "SIGQLY_RESERVED_13" 14 "SIGQLY_RESERVED_14" 15 "SIGQLY_RESERVED_15" /end COMPU_VTAB
/begin COMPU_METHOD SPDCTL_TQLVL_SC_Compu "" TAB_VERB "%6.3" "" COMPU_TAB_REF SPDCTL_TQLVL_SC_Compu /end COMPU_METHOD
/begin COMPU_VTAB SPDCTL_TQLVL_SC_Compu "" TAB_VERB 2 0 "0" 1 "1" /end COMPU_VTAB
/begin COMPU_METHOD SPDCTL_VAR_SY_Compu "" TAB_VERB "%6.3" "" COMPU_TAB_REF SPDCTL_VAR_SY_Compu /end COMPU_METHOD
/begin COMPU_VTAB SPDCTL_VAR_SY_Compu "" TAB_VERB 54 1 "DAI" 3 "VWW" 4 "POR" 5 "AUD" 6 "OPE" 9 "FIA" 11 "BMW" 14 "PSA" 15 "REN" 17 "ALF" 18 "SAB" 19 "VOL" 20 "NIS" 21 "GMU" 22 "FOR" 26 "IMJ" 51 "SEA" 53 "CHR" 54 "JAG" 55 "ROL" 69 "FER" 72 "TOY" 123 "MIT" 147 "HYU" 159 "HON" 160 "MAZ" 183 "CU" 190 "LRG" 204 "VVW" 214 "AVT" 242 "Iveco" 243 "DMC" 248 "SUZ" 267 "SSANGYONG" 270 "KEF" 289 "AMG" 308 "TAT" 319 "MVM" 328 "MM" 385 "UAES" 425 "Polaris" 590 "Scania" 828 "RBCD" 858 "Kubota" 898 "MFTBC" 944 "DOOSAN_Infracore" 973 "Yanmar_Japan" 987 "Shanghai Diesel" 999 "ALL" 2887 "Nonox" 9347 "SDFG" 9454 "Fuso" 9797 "Mitsubishi_Heavy_Industr" 9947 "SONSTIGE" /end COMPU_VTAB
/begin COMPU_METHOD SPDLIM_SY_Compu "" TAB_VERB "%6.3" "" COMPU_TAB_REF SPDLIM_SY_Compu /end COMPU_METHOD
/begin COMPU_VTAB SPDLIM_SY_Compu "" TAB_VERB 2 0 "False" 1 "True" /end COMPU_VTAB
/begin COMPU_METHOD SpecHeatFine "" RAT_FUNC "%6.3" "J/Kg/K" COEFFS 0 5 0 0 0 1 /end COMPU_METHOD
/begin COMPU_METHOD SpecificHeat "" RAT_FUNC "%7.6" "J/g/K" COEFFS 0 10000 0 0 0 1 /end COMPU_METHOD
/begin COMPU_METHOD SPRT_SY_Compu "" TAB_VERB "%6.3" "" COMPU_TAB_REF SPRT_SY_Compu /end COMPU_METHOD
/begin COMPU_VTAB SPRT_SY_Compu "" TAB_VERB 2 0 "no sport driving mode available" 1 "sport driving mode available" /end COMPU_VTAB
/begin COMPU_METHOD SPTENGSTRT_SC_Compu "" TAB_VERB "%6.3" "" COMPU_TAB_REF SPTENGSTRT_SC_Compu /end COMPU_METHOD
/begin COMPU_VTAB SPTENGSTRT_SC_Compu "" TAB_VERB 2 0 "False" 1 "True" /end COMPU_VTAB
/begin COMPU_METHOD SqrVltg_s "" RAT_FUNC "%6.3" "V^2s" COEFFS 0 10 0 0 0 1 /end COMPU_METHOD
/begin COMPU_METHOD SSPRITNUM_SY_Compu "" TAB_VERB "%6.3" "" COMPU_TAB_REF SSPRITNUM_SY_Compu /end COMPU_METHOD
/begin COMPU_VTAB SSPRITNUM_SY_Compu "" TAB_VERB 2 0 "False" 1 "True" /end COMPU_VTAB
/begin COMPU_METHOD STADAP_INHCUST_SY_Compu "" TAB_VERB "%6.3" "" COMPU_TAB_REF STADAP_INHCUST_SY_Compu /end COMPU_METHOD
/begin COMPU_VTAB STADAP_INHCUST_SY_Compu "" TAB_VERB 2 0 "False" 1 "True" /end COMPU_VTAB
/begin COMPU_METHOD STF_SY_Compu "" TAB_VERB "%6.3" "" COMPU_TAB_REF STF_SY_Compu /end COMPU_METHOD
/begin COMPU_VTAB STF_SY_Compu "" TAB_VERB 2 0 "False" 1 "True" /end COMPU_VTAB
/begin COMPU_METHOD STNETHAD_INHCUST_SY_Compu "" TAB_VERB "%6.3" "" COMPU_TAB_REF STNETHAD_INHCUST_SY_Compu /end COMPU_METHOD
/begin COMPU_VTAB STNETHAD_INHCUST_SY_Compu "" TAB_VERB 2 0 "False" 1 "True" /end COMPU_VTAB
/begin COMPU_METHOD STNETH_INHCUST_SY_Compu "" TAB_VERB "%6.3" "" COMPU_TAB_REF STNETH_INHCUST_SY_Compu /end COMPU_METHOD
/begin COMPU_VTAB STNETH_INHCUST_SY_Compu "" TAB_VERB 2 0 "False" 1 "True" /end COMPU_VTAB
/begin COMPU_METHOD STNETH_SY_Compu "" TAB_VERB "%6.3" "" COMPU_TAB_REF STNETH_SY_Compu /end COMPU_METHOD
/begin COMPU_VTAB STNETH_SY_Compu "" TAB_VERB 3 0 "ZERO" 1 "ONE" 2 "TWO" /end COMPU_VTAB
/begin COMPU_METHOD STOPPHDREDN_SC_Compu "" TAB_VERB "%6.3" "" COMPU_TAB_REF STOPPHDREDN_SC_Compu /end COMPU_METHOD
/begin COMPU_VTAB STOPPHDREDN_SC_Compu "" TAB_VERB 4 0 "Reduction of stop prohibition not active" 1 "Reduction of stop proh. PF reset of steady state" 2 "Reduction of stop prohibition active for Audi feat" 3 "Reduction of stop proh. PF no reset of stead" /end COMPU_VTAB
/begin COMPU_METHOD STRGOILP_SC_Compu "" TAB_VERB "%6.3" "" COMPU_TAB_REF STRGOILP_SC_Compu /end COMPU_METHOD
/begin COMPU_VTAB STRGOILP_SC_Compu "" TAB_VERB 2 0 "False" 1 "True" /end COMPU_VTAB
/begin COMPU_METHOD STRGTYP_SY_Compu "" TAB_VERB "%6.3" "" COMPU_TAB_REF STRGTYP_SY_Compu /end COMPU_METHOD
/begin COMPU_VTAB STRGTYP_SY_Compu "" TAB_VERB 5 0 "STRGTYP_NOSTRG" 1 "STRGTYP_MECH" 2 "STRGTYP_LVELEC" 3 "STRGTYP_HVELEC" 4 "STRGTYP_DIFPWRSTRG" /end COMPU_VTAB
/begin COMPU_METHOD stroke_pml "" RAT_FUNC "%6.3" "1/ml" COEFFS 0 10 0 0 0 1 /end COMPU_METHOD
/begin COMPU_METHOD STRTCTL_ONEPUSHSTRT_SC_Compu "" TAB_VERB "%6.3" "" COMPU_TAB_REF STRTCTL_ONEPUSHSTRT_SC_Compu /end COMPU_METHOD
/begin COMPU_VTAB STRTCTL_ONEPUSHSTRT_SC_Compu "" TAB_VERB 2 0 "False" 1 "True" /end COMPU_VTAB
/begin COMPU_METHOD STRTCTL_SC_Compu "" TAB_VERB "%6.3" "" COMPU_TAB_REF STRTCTL_SC_Compu /end COMPU_METHOD
/begin COMPU_VTAB STRTCTL_SC_Compu "" TAB_VERB 5 0 "NOSTARTER" 1 "STRTCTLEXT" 2 "STRTCTLCOMMON" 3 "STRTCTLDS" 4 "STRTCTLGS" /end COMPU_VTAB
/begin COMPU_METHOD STRT_STRTRACTVNRLY_SC_Compu "" TAB_VERB "%6.3" "" COMPU_TAB_REF STRT_STRTRACTVNRLY_SC_Compu /end COMPU_METHOD
/begin COMPU_VTAB STRT_STRTRACTVNRLY_SC_Compu "" TAB_VERB 2 0 "False" 1 "True" /end COMPU_VTAB
/begin COMPU_METHOD STSPTYP_SY_Compu "" TAB_VERB "%6.3" "" COMPU_TAB_REF STSPTYP_SY_Compu /end COMPU_METHOD
/begin COMPU_VTAB STSPTYP_SY_Compu "" TAB_VERB 5 0 "STSPTYP_NO" 1 "STSPTYP_FMC" 2 "STSPTYP_VCC" 3 "STSPTYP_SMCINT" 4 "STSPTYP_SMCEXT" /end COMPU_VTAB
/begin COMPU_METHOD STSP_EXT_SY_Compu "" TAB_VERB "%6.3" "" COMPU_TAB_REF STSP_EXT_SY_Compu /end COMPU_METHOD
/begin COMPU_VTAB STSP_EXT_SY_Compu "" TAB_VERB 2 0 "False" 1 "True" /end COMPU_VTAB
/begin COMPU_METHOD Temp_Cels "" RAT_FUNC "%6.1" "deg C" COEFFS 0 10 2731.4 0 0 1 /end COMPU_METHOD
/begin COMPU_METHOD t_q0p001_ms "" RAT_FUNC "%6.5" "ms" COEFFS 0 1 0 0 0 0.001 /end COMPU_METHOD
/begin COMPU_METHOD t_q0p004_ms "" RAT_FUNC "%6.4" "ms" COEFFS 0 1 0 0 0 0.004 /end COMPU_METHOD
/begin COMPU_METHOD t_q0p04_ms "" RAT_FUNC "%6.4" "ms" COEFFS 0 1 0 0 0 0.04 /end COMPU_METHOD
/begin COMPU_METHOD t_q0p1 "" RAT_FUNC "%6.3" "s" COEFFS 0 10 0 0 0 1 /end COMPU_METHOD
/begin COMPU_METHOD t_q0p1_us "" RAT_FUNC "%6.3" "us" COEFFS 0 10 0 0 0 1 /end COMPU_METHOD
/begin COMPU_METHOD t_q0p4us "" RAT_FUNC "%6.3" "us" COEFFS 0 1 0 0 0 0.4 /end COMPU_METHOD
/begin COMPU_METHOD t_q1 "" RAT_FUNC "%6.2" "s" COEFFS 0 1 0 0 0 1 /end COMPU_METHOD
/begin COMPU_METHOD t_q2p0_us "" RAT_FUNC "%6.2" "us" COEFFS 0 1 0 0 0 2 /end COMPU_METHOD
/begin COMPU_METHOD t_us_q1 "" RAT_FUNC "%6.2" "us" COEFFS 0 1 0 0 0 1 /end COMPU_METHOD
/begin COMPU_METHOD Vel "" RAT_FUNC "%6.4" "km/h" COEFFS 0 100 0 0 0 1 /end COMPU_METHOD
/begin RECORD_LAYOUT GklWS16 FNC_VALUES 1 SWORD COLUMN_DIR DIRECT /end RECORD_LAYOUT
/begin RECORD_LAYOUT GklWU16 FNC_VALUES 1 UWORD COLUMN_DIR DIRECT /end RECORD_LAYOUT
/begin RECORD_LAYOUT KlAxU8SstxS16WS16 NO_AXIS_PTS_X 1 SWORD AXIS_PTS_X 2 SWORD INDEX_INCR DIRECT FNC_VALUES 3 SWORD COLUMN_DIR DIRECT /end RECORD_LAYOUT
/begin RECORD_LAYOUT KlAxU8SstxS16WU16_Static NO_AXIS_PTS_X 1 UWORD AXIS_PTS_X 2 SWORD INDEX_INCR DIRECT FNC_VALUES 3 UWORD COLUMN_DIR DIRECT STATIC_RECORD_LAYOUT /end RECORD_LAYOUT
/begin RECORD_LAYOUT KlAxU8SstxU16WS16_Static NO_AXIS_PTS_X 1 UWORD AXIS_PTS_X 2 UWORD INDEX_INCR DIRECT FNC_VALUES 3 SWORD COLUMN_DIR DIRECT STATIC_RECORD_LAYOUT /end RECORD_LAYOUT
/begin RECORD_LAYOUT KlAxU8SstxU16WU16 NO_AXIS_PTS_X 1 UWORD AXIS_PTS_X 2 UWORD INDEX_INCR DIRECT FNC_VALUES 3 UWORD COLUMN_DIR DIRECT /end RECORD_LAYOUT
/begin RECORD_LAYOUT KlAxU8SstxU16WU8_Static NO_AXIS_PTS_X 1 UWORD AXIS_PTS_X 2 UWORD INDEX_INCR DIRECT FNC_VALUES 3 UBYTE COLUMN_DIR DIRECT STATIC_RECORD_LAYOUT /end RECORD_LAYOUT
/begin RECORD_LAYOUT KwbUb FNC_VALUES 1 UBYTE COLUMN_DIR DIRECT /end RECORD_LAYOUT
/begin RECORD_LAYOUT KwbWS16 FNC_VALUES 1 SWORD COLUMN_DIR DIRECT /end RECORD_LAYOUT
/begin RECORD_LAYOUT KwbWS8 FNC_VALUES 1 SBYTE COLUMN_DIR DIRECT /end RECORD_LAYOUT
/begin RECORD_LAYOUT KwWS16 FNC_VALUES 1 SWORD COLUMN_DIR DIRECT /end RECORD_LAYOUT
/begin RECORD_LAYOUT KwWS32 FNC_VALUES 1 SLONG COLUMN_DIR DIRECT /end RECORD_LAYOUT
/begin RECORD_LAYOUT KwWU16 FNC_VALUES 1 UWORD COLUMN_DIR DIRECT /end RECORD_LAYOUT
/begin RECORD_LAYOUT KwWU8 FNC_VALUES 1 UBYTE COLUMN_DIR DIRECT /end RECORD_LAYOUT
/begin RECORD_LAYOUT RB_Axis_U16 NO_AXIS_PTS_X 1 UWORD AXIS_PTS_X 2 UWORD INDEX_INCR DIRECT /end RECORD_LAYOUT
/begin RECORD_LAYOUT RB_CurveGroup_U16 FNC_VALUES 1 UWORD COLUMN_DIR DIRECT /end RECORD_LAYOUT
/begin RECORD_LAYOUT RB_CurveGroup_U8 FNC_VALUES 1 UBYTE COLUMN_DIR DIRECT /end RECORD_LAYOUT
/begin RECORD_LAYOUT RB_Curve_S16_S16 NO_AXIS_PTS_X 1 SWORD AXIS_PTS_X 2 SWORD INDEX_INCR DIRECT FNC_VALUES 3 SWORD COLUMN_DIR DIRECT /end RECORD_LAYOUT
/begin RECORD_LAYOUT RB_Curve_S16_U8_Static NO_AXIS_PTS_X 1 SWORD AXIS_PTS_X 2 SWORD INDEX_INCR DIRECT FNC_VALUES 3 UBYTE COLUMN_DIR DIRECT STATIC_RECORD_LAYOUT /end RECORD_LAYOUT
/begin RECORD_LAYOUT RB_Val_Ws16 FNC_VALUES 1 SWORD COLUMN_DIR DIRECT /end RECORD_LAYOUT
/begin RECORD_LAYOUT RB_Val_Wu8 FNC_VALUES 1 UBYTE COLUMN_DIR DIRECT /end RECORD_LAYOUT
/begin RECORD_LAYOUT SstAU8SstU16 NO_AXIS_PTS_X 1 UWORD AXIS_PTS_X 2 UWORD INDEX_INCR DIRECT /end RECORD_LAYOUT
/end MODULE
/end PROJECT
