ASAP2_VERSION 1 60
/begin PROJECT MG1CS022 "MG1CS022"
/begin HEADER "" VERSION "MG1CS022_62XSC_V037_TPROT" PROJECT_NO MG1CS022 /end HEADER
/begin MODULE DIM ""
/begin MOD_COMMON "" BYTE_ORDER MSB_LAST ALIGNMENT_BYTE 1 ALIGNMENT_WORD 2 ALIGNMENT_LONG 4 ALIGNMENT_INT64 4 ALIGNMENT_FLOAT32_IEEE 4 ALIGNMENT_FLOAT64_IEEE 4 DATA_SIZE 32 /end MOD_COMMON
/begin CHARACTERISTIC ExhMod_arSurfCondsB1_T "area condensation bank 1" CURVE 0x8054E814 RB_Curve_R32_R32_Static 2.00000E+037 a_q1_m2 -1.00000E+037 1.00000E+037 FORMAT "%10.5" EXTENDED_LIMITS -3.40282E+038 3.40282E+038
 /begin AXIS_DESCR STD_AXIS NO_INPUT_QUANTITY dez 12 0. 1.000000E+037 FORMAT "%10.0" EXTENDED_LIMITS -3.402823E+038 3.402823E+038 DEPOSIT ABSOLUTE /end AXIS_DESCR
/end CHARACTERISTIC
/begin CHARACTERISTIC ExhMod_cpAbsltCanngB1_M "absolute heat capacity catalyst canning bank 1" MAP 0x8054DE50 RB_Map_S16U8_U16 14563.11 fak_q0p2222_JK 0.22 14563.33 FORMAT "%8.2" EXTENDED_LIMITS 0.00 14563.33
 /begin AXIS_DESCR STD_AXIS NO_INPUT_QUANTITY Temp_Cels 6 -3549.940 3003.560 FORMAT "%8.3" DEPOSIT ABSOLUTE /end AXIS_DESCR
 /begin AXIS_DESCR STD_AXIS NO_INPUT_QUANTITY dez 6 0.00 255.0 FORMAT "%5.1" DEPOSIT ABSOLUTE /end AXIS_DESCR
/end CHARACTERISTIC
/begin CHARACTERISTIC ExhMod_cpAbsltPipeCatB1_M "absolute thermal capacity pipes and catalyst bricks bank 1" MAP 0x8054DEAE RB_Map_S16U8_U16 14563.11 fak_q0p2222_JK 0.22 14563.33 FORMAT "%8.2" EXTENDED_LIMITS 0.00 14563.33
 /begin AXIS_DESCR STD_AXIS NO_INPUT_QUANTITY Temp_Cels 6 -3549.940 3003.560 FORMAT "%8.3" DEPOSIT ABSOLUTE /end AXIS_DESCR
 /begin AXIS_DESCR STD_AXIS NO_INPUT_QUANTITY dez 12 0.00 255.0 FORMAT "%5.1" DEPOSIT ABSOLUTE /end AXIS_DESCR
/end CHARACTERISTIC
/begin CHARACTERISTIC ExhMod_cpAbsltPistB1_C "heat capacity piston" VALUE 0x8054E490 RB_Val_Wu16 14563.11 fak_q0p2222_JK 0.22 14563.33 FORMAT "%8.2" EXTENDED_LIMITS 0.00 14563.33 /end CHARACTERISTIC
/begin CHARACTERISTIC ExhMod_cpAbsltVlvB1_C "absolute thermal capacity valve bank 1" VALUE 0x8054C49C RB_Val_Wu16 14563.11 fak_q0p2222_JK 0.22 14563.33 FORMAT "%8.2" EXTENDED_LIMITS 0.00 14563.33 /end CHARACTERISTIC
/begin CHARACTERISTIC ExhMod_cpAbsltVlvFildB1_C "absolute thermal capacity valve (dynamic model filter) bank 1" VALUE 0x8054C49E RB_Val_Wu16 3881.069 q5p922Em2_JK 0.059 3881.128 FORMAT "%8.3" EXTENDED_LIMITS 0.00 3881.128 /end CHARACTERISTIC
/begin CHARACTERISTIC ExhMod_cpShcpExhGas_T "Specific heat capacity of exhaust gas" CURVE 0x8054DF5A RB_Curve_U16_U16 3276.750 q0p05_J_DIV_kg_K 0.00 3276.750 FORMAT "%8.3"
 /begin AXIS_DESCR STD_AXIS NO_INPUT_QUANTITY temp_q0p0234_o273 10 -273.150 1262.827 FORMAT "%8.3" DEPOSIT ABSOLUTE /end AXIS_DESCR
/end CHARACTERISTIC
/begin CHARACTERISTIC ExhMod_egyEnthCondsH2oB1_M "enthalpie condensation water bank 1" MAP 0x8054E878 RB_Map_U16U16_U16 16000.00 q5p333_J_DIV_g 0.00 16000.00 FORMAT "%8.2" EXTENDED_LIMITS 0.00 349520.0
 /begin AXIS_DESCR STD_AXIS NO_INPUT_QUANTITY m_q0p00781 2 0.00 511.9922 FORMAT "%8.4" DEPOSIT ABSOLUTE /end AXIS_DESCR
 /begin AXIS_DESCR STD_AXIS NO_INPUT_QUANTITY dez 12 0.00 255.0000 FORMAT "%8.4" EXTENDED_LIMITS 0.00 65535.00 DEPOSIT ABSOLUTE /end AXIS_DESCR
/end CHARACTERISTIC
/begin CHARACTERISTIC ExhMod_facCorrnTVlvFcoMFlowB1_M "Motordrehzahl- und massenstromabhängiger Korrekturfaktor der Auslasstemperatur für Kraftstoffabschaltung für Bank 1" MAP 0x8054C4A0 RB_Map_S16U16_U8 1.992188 fak_ub_b2 0.00 1.992188 FORMAT "%8.6"
 /begin AXIS_DESCR STD_AXIS Epm_nEng nmot_q0p5 10 -16384.00 16383.50 FORMAT "%8.2" DEPOSIT ABSOLUTE /end AXIS_DESCR
 /begin AXIS_DESCR STD_AXIS NO_INPUT_QUANTITY m_uw_b6553p5 10 0.00 6553.500 FORMAT "%8.3" DEPOSIT ABSOLUTE /end AXIS_DESCR
/end CHARACTERISTIC
/begin CHARACTERISTIC ExhMod_facEgyThdTspNoCatHeatgS1B1_M "reduction factor of heat quantity threshold for dew-point end detection for thermo shock protected sensor 1 without catalyst heating, bank 1" MAP 0x8054E566 RB_Map_S16S16_U8 1.000000 fak_ub_b2 0.00 1.000000 FORMAT "%8.6" EXTENDED_LIMITS 0.00 1.992188
 /begin AXIS_DESCR STD_AXIS NO_INPUT_QUANTITY Temp_Cels 7 -3549.940 3003.560 FORMAT "%8.3" DEPOSIT ABSOLUTE /end AXIS_DESCR
 /begin AXIS_DESCR STD_AXIS NO_INPUT_QUANTITY Temp_Cels 7 -3549.940 3003.560 FORMAT "%8.3" DEPOSIT ABSOLUTE /end AXIS_DESCR
/end CHARACTERISTIC
/begin CHARACTERISTIC ExhMod_facEgyThdTspNoCatHeatgS2B1_M "Reduction factor of heat quantity threshold for dew-point end detection for thermo shock protectedsensor 2 without catalyst heating, bank 1" MAP 0x8054E5B8 RB_Map_S16S16_U8 1.000000 fak_ub_b2 0.00 1.000000 FORMAT "%8.6" EXTENDED_LIMITS 0.00 1.992188
 /begin AXIS_DESCR STD_AXIS NO_INPUT_QUANTITY Temp_Cels 7 -3549.940 3003.560 FORMAT "%8.3" DEPOSIT ABSOLUTE /end AXIS_DESCR
 /begin AXIS_DESCR STD_AXIS NO_INPUT_QUANTITY Temp_Cels 7 -3549.940 3003.560 FORMAT "%8.3" DEPOSIT ABSOLUTE /end AXIS_DESCR
/end CHARACTERISTIC
/begin CHARACTERISTIC ExhMod_facEgyThdTspNoCatHeatgSecFuS1B1_M "Reduction factor of heat quantity threshold second fuel for dew-point end detection for thermo shock protected sensor 1 without catalyst heating, bank 1" MAP 0x8054E60A RB_Map_S16S16_U8 1.000000 fak_ub_b2 0.00 1.000000 FORMAT "%8.6" EXTENDED_LIMITS 0.00 1.992188
 /begin AXIS_DESCR STD_AXIS NO_INPUT_QUANTITY Temp_Cels 7 -3549.940 3003.560 FORMAT "%8.3" DEPOSIT ABSOLUTE /end AXIS_DESCR
 /begin AXIS_DESCR STD_AXIS NO_INPUT_QUANTITY Temp_Cels 7 -3549.940 3003.560 FORMAT "%8.3" DEPOSIT ABSOLUTE /end AXIS_DESCR
/end CHARACTERISTIC
/begin CHARACTERISTIC ExhMod_facEgyThdTspNoCatHeatgSecFuS2B1_M "Reduction factor of heat quantity threshold second fuel for dew-point end detection for thermo shock protected sensor 2 without catalyst heating, bank 1" MAP 0x8054E65C RB_Map_S16S16_U8 1.000000 fak_ub_b2 0.00 1.000000 FORMAT "%8.6" EXTENDED_LIMITS 0.00 1.992188
 /begin AXIS_DESCR STD_AXIS NO_INPUT_QUANTITY Temp_Cels 7 -3549.940 3003.560 FORMAT "%8.3" DEPOSIT ABSOLUTE /end AXIS_DESCR
 /begin AXIS_DESCR STD_AXIS NO_INPUT_QUANTITY Temp_Cels 7 -3549.940 3003.560 FORMAT "%8.3" DEPOSIT ABSOLUTE /end AXIS_DESCR
/end CHARACTERISTIC
/begin CHARACTERISTIC ExhMod_facEgyThdTspS1B1_M "reduction factor of heat quantity threshold for dew-point end detection for TSP sensor 1" MAP 0x8054E6AE RB_Map_S16S16_U8 1.000000 fak_ub_b2 0.00 1.000000 FORMAT "%8.6" EXTENDED_LIMITS 0.00 1.992188
 /begin AXIS_DESCR STD_AXIS NO_INPUT_QUANTITY Temp_Cels 7 -3549.940 3003.560 FORMAT "%8.3" DEPOSIT ABSOLUTE /end AXIS_DESCR
 /begin AXIS_DESCR STD_AXIS NO_INPUT_QUANTITY Temp_Cels 7 -3549.940 3003.560 FORMAT "%8.3" DEPOSIT ABSOLUTE /end AXIS_DESCR
/end CHARACTERISTIC
/begin CHARACTERISTIC ExhMod_facEgyThdTspS2B1_M "reduction factor of heat quantity threshold for dew-point end detection for TSP sensor 2" MAP 0x8054E700 RB_Map_S16S16_U8 1.000000 fak_ub_b2 0.00 1.000000 FORMAT "%8.6" EXTENDED_LIMITS 0.00 1.992188
 /begin AXIS_DESCR STD_AXIS NO_INPUT_QUANTITY Temp_Cels 7 -3549.940 3003.560 FORMAT "%8.3" DEPOSIT ABSOLUTE /end AXIS_DESCR
 /begin AXIS_DESCR STD_AXIS NO_INPUT_QUANTITY Temp_Cels 7 -3549.940 3003.560 FORMAT "%8.3" DEPOSIT ABSOLUTE /end AXIS_DESCR
/end CHARACTERISTIC
/begin CHARACTERISTIC ExhMod_facEgyThdTspSecFuS1B1_M "Reduction factor of heat quantity threshold second fuel for dew-point end detection for TSP sensor 1, bank 1" MAP 0x8054E752 RB_Map_S16S16_U8 1.000000 fak_ub_b2 0.00 1.000000 FORMAT "%8.6" EXTENDED_LIMITS 0.00 1.992188
 /begin AXIS_DESCR STD_AXIS NO_INPUT_QUANTITY Temp_Cels 7 -3549.940 3003.560 FORMAT "%8.3" DEPOSIT ABSOLUTE /end AXIS_DESCR
 /begin AXIS_DESCR STD_AXIS NO_INPUT_QUANTITY Temp_Cels 7 -3549.940 3003.560 FORMAT "%8.3" DEPOSIT ABSOLUTE /end AXIS_DESCR
/end CHARACTERISTIC
/begin CHARACTERISTIC ExhMod_facEgyThdTspSecFuS2B1_M "Reduction factor of heat quantity threshold second fuel for dew-point end detection for TSP sensor 2, bank 1" MAP 0x8054E7A4 RB_Map_S16S16_U8 1.000000 fak_ub_b2 0.00 1.000000 FORMAT "%8.6" EXTENDED_LIMITS 0.00 1.992188
 /begin AXIS_DESCR STD_AXIS NO_INPUT_QUANTITY Temp_Cels 7 -3549.940 3003.560 FORMAT "%8.3" DEPOSIT ABSOLUTE /end AXIS_DESCR
 /begin AXIS_DESCR STD_AXIS NO_INPUT_QUANTITY Temp_Cels 7 -3549.940 3003.560 FORMAT "%8.3" DEPOSIT ABSOLUTE /end AXIS_DESCR
/end CHARACTERISTIC
/begin CHARACTERISTIC ExhMod_facEnvPCorrnHtcWallEnv_T "Ambient pressure based correction factor for heat transmission coefficient between wall and the environment" CURVE 0x8054DF84 RB_Curve_U16_U8_Static 1.992188 fak_ub_b2 0.00 1.992188 FORMAT "%8.6"
 /begin AXIS_DESCR STD_AXIS PEnv_p p_uw_q0p039 6 0.00 2559.961 FORMAT "%8.3" DEPOSIT ABSOLUTE /end AXIS_DESCR
/end CHARACTERISTIC
/begin CHARACTERISTIC ExhMod_facHeatTranCoeffExhVlvSecFu_C "scaling factor heat transport coefficient exhaust valve for secondary fuel" VALUE 0x8054C530 RB_Val_Wu16 1.999969 fak_uw_b2 0.00 1.999969 FORMAT "%8.6" /end CHARACTERISTIC
/begin CHARACTERISTIC ExhMod_facHeatTranCoeffExhWallBrickSecFu_C "scaling factor heat transport coefficient exhaust wall and brick for secondary fuel" VALUE 0x8054DF98 RB_Val_Wu16 1.999969 fak_uw_b2 0.00 1.999969 FORMAT "%8.6" /end CHARACTERISTIC
/begin CHARACTERISTIC ExhMod_facHtcPistFco_C "correction factor heat transfer to piston during fuel cut off" VALUE 0x8054E492 RB_Val_Wu16 1.000000 fak_uw_b2 0.00 1.000000 FORMAT "%8.6" EXTENDED_LIMITS 0.00 1.999969 /end CHARACTERISTIC
/begin CHARACTERISTIC ExhMod_facHtcPist_T "correction factor heat transfer to piston" CURVE 0x8054E494 RB_Curve_S8_U16_Static 1.000000 fak_uw_b2 0.00 1.000000 FORMAT "%8.6" EXTENDED_LIMITS 0.00 1.999969
 /begin AXIS_DESCR STD_AXIS Ign_iacalc_s8 kw_q0p75 8 -96.00 95.25 FORMAT "%5.2" DEPOSIT ABSOLUTE /end AXIS_DESCR
/end CHARACTERISTIC
/begin CHARACTERISTIC ExhMod_facHtcWallEnvBlowrCorrnB1_T "Vehicle velocity based correction curve for the cooling fan based heat transfer coefficient offset bank 1" CURVE 0x8054DF9A RB_Curve_U16_U8_Static 1.000000 fak_ub_b2 0.00 1.000000 FORMAT "%8.6" EXTENDED_LIMITS 0.00 1.992188
 /begin AXIS_DESCR STD_AXIS ExhMod_vVehLoc vfzg_uw_b512 6 0.00 511.9922 FORMAT "%8.4" DEPOSIT ABSOLUTE /end AXIS_DESCR
/end CHARACTERISTIC
/begin CHARACTERISTIC ExhMod_facIgnAgCorrn_T "correction factor heat transfer to piston caused by ignition angle" CURVE 0x8054E4AE RB_Curve_S16_U16_Static 1.000000 fak_uw_b2 0.00 1.000000 FORMAT "%8.6" EXTENDED_LIMITS 0.00 1.999969
 /begin AXIS_DESCR STD_AXIS TPist_iaDif kw_q0p75 6 -24576.00 24575.25 FORMAT "%8.2" DEPOSIT ABSOLUTE /end AXIS_DESCR
/end CHARACTERISTIC
/begin CHARACTERISTIC ExhMod_facIntrpnCoolgCrv_M "interpolation factor cooling curve" MAP 0x8054E3F0 RB_Map_U16U8_U8 0.9961 fak_ub_b1 0.00 0.9961
 /begin AXIS_DESCR STD_AXIS NO_INPUT_QUANTITY t1sxs_uw_q1 10 0.00 65535.00 FORMAT "%8.2" DEPOSIT ABSOLUTE /end AXIS_DESCR
 /begin AXIS_DESCR STD_AXIS NO_INPUT_QUANTITY dez 5 0.00 255.0 FORMAT "%5.1" DEPOSIT ABSOLUTE /end AXIS_DESCR
/end CHARACTERISTIC
/begin CHARACTERISTIC ExhMod_facIntrpnTspWtrCntntSecFu_T "The value of interpolation factor that accomodates for the variation in water content for different fuel types" CURVE 0x8054E7F6 RB_Curve_U16_U16 1.999969 fak_uw_b2 0.00 1.999969 FORMAT "%8.6"
 /begin AXIS_DESCR STD_AXIS ExhMod_facIntrpnGslSecFu fak_uw_b2 5 0.00 1.999969 FORMAT "%8.6" DEPOSIT ABSOLUTE /end AXIS_DESCR
/end CHARACTERISTIC
/begin CHARACTERISTIC ExhMod_facMFlowCorrn_T "correction of mass flow for calculation of piston temperature" CURVE 0x8054E4C8 RB_Curve_R32_R32_Static 1.00000000 Fact1_float 0.00 1.00000000 FORMAT "%10.8" EXTENDED_LIMITS -3.40282347E+038 3.40282347E+038
 /begin AXIS_DESCR STD_AXIS ExhMod_mfExhVlvB1 AirMassPerTime_float 6 0.00 50000.0000 FORMAT "%10.4" EXTENDED_LIMITS -3.40282347E+038 3.40282347E+038 DEPOSIT ABSOLUTE /end AXIS_DESCR
/end CHARACTERISTIC
/begin CHARACTERISTIC ExhMod_facRednSatPB1_M "reduction factor saturation pressure bank 1" MAP 0x8054E8C8 RB_Map_U16U16_U16 1.999969 fak_uw_b2 0.00 1.999969 FORMAT "%8.6"
 /begin AXIS_DESCR STD_AXIS NO_INPUT_QUANTITY m_q0p00781 10 0.00 511.9922 FORMAT "%8.4" DEPOSIT ABSOLUTE /end AXIS_DESCR
 /begin AXIS_DESCR STD_AXIS NO_INPUT_QUANTITY dez 12 0.00 255.0000 FORMAT "%8.4" EXTENDED_LIMITS 0.00 65535.00 DEPOSIT ABSOLUTE /end AXIS_DESCR
/end CHARACTERISTIC
/begin CHARACTERISTIC ExhMod_facRednSurfCondsB1_M "reduction factor area condensation bank 1" MAP 0x8054E9E8 RB_Map_U16U16_U16 1.999969 fak_uw_b2 0.00 1.999969 FORMAT "%8.6"
 /begin AXIS_DESCR STD_AXIS NO_INPUT_QUANTITY m_q0p00781 2 0.00 511.9922 FORMAT "%8.4" DEPOSIT ABSOLUTE /end AXIS_DESCR
 /begin AXIS_DESCR STD_AXIS NO_INPUT_QUANTITY dez 12 0.00 255.0000 FORMAT "%8.4" EXTENDED_LIMITS 0.00 65535.00 DEPOSIT ABSOLUTE /end AXIS_DESCR
/end CHARACTERISTIC
/begin CHARACTERISTIC ExhMod_facTauTExhB1_T "Factor time constant for successive filtering of gas temperatures" CURVE 0x8054DDD8 RB_Curve_U16_U16 1.000000 fak_uw_b2 0.00 1.000000 FORMAT "%8.6" EXTENDED_LIMITS 0.00 1.999969
 /begin AXIS_DESCR STD_AXIS NO_INPUT_QUANTITY m_q0p1 6 0.00 6553.500 FORMAT "%8.3" DEPOSIT ABSOLUTE /end AXIS_DESCR
/end CHARACTERISTIC
/begin CHARACTERISTIC ExhMod_facTExhVlvCorrnEngT_T "Correction factor for the offset correction of the stationary temperatue at exhaust valve depending on engine temperature" CURVE 0x8054C532 RB_Curve_S16_S8_Static 3.984 fak_sb_b2 -2.000 1.984 FORMAT "%5.3"
 /begin AXIS_DESCR STD_AXIS ExhMod_tEngCoolt Temp_Cels 6 -3549.940 3003.560 FORMAT "%8.3" DEPOSIT ABSOLUTE /end AXIS_DESCR
/end CHARACTERISTIC
/begin CHARACTERISTIC ExhMod_facTExhVlvCorrnIntkAir_T "correction temperature exhaust at valve homogeneous mode for intake air temperature" CURVE 0x8054C546 RB_Curve_S16_S8_Static 3.984 fak_sb_b2 -2.000 1.984 FORMAT "%5.3"
 /begin AXIS_DESCR STD_AXIS ExhMod_tExhVlvIntkAir Temp_Cels 6 -3549.940 3003.560 FORMAT "%8.3" DEPOSIT ABSOLUTE /end AXIS_DESCR
/end CHARACTERISTIC
/begin CHARACTERISTIC ExhMod_facTExhVlvCorrnLamB1_M "lambda correction exhaust temperature at valve bank 1" MAP 0x8054C55A RB_Map_U16U16_U16 1.999969 fak_uw_b2 0.00 1.999969 FORMAT "%8.6"
 /begin AXIS_DESCR STD_AXIS NO_INPUT_QUANTITY fak_uw_b16 12 0.00 15.99976 FORMAT "%8.5" DEPOSIT ABSOLUTE /end AXIS_DESCR
 /begin AXIS_DESCR STD_AXIS NO_INPUT_QUANTITY m_uw_b6553p5 6 0.00 6553.500 FORMAT "%8.3" DEPOSIT ABSOLUTE /end AXIS_DESCR
/end CHARACTERISTIC
/begin CHARACTERISTIC ExhMod_facTExhVlvCorrnLamB1_T "lambda correction exhaust gas temperature downstream bank 1" CURVE 0x8054C612 RB_Curve_U16_U16 1.999969 fak_uw_b2 0.00 1.999969 FORMAT "%8.6"
 /begin AXIS_DESCR STD_AXIS NO_INPUT_QUANTITY fak_uw_b16 12 0.00 15.99976 FORMAT "%8.5" DEPOSIT ABSOLUTE /end AXIS_DESCR
/end CHARACTERISTIC
/begin CHARACTERISTIC ExhMod_facTExhVlvCorrnLamSecFuB1_M "lambda correction exhaust temperature valve secondary fuel bank 1" MAP 0x8054C644 RB_Map_U16U16_U16 1.999969 fak_uw_b2 0.00 1.999969 FORMAT "%8.6"
 /begin AXIS_DESCR STD_AXIS NO_INPUT_QUANTITY fak_uw_b16 12 0.00 15.99976 FORMAT "%8.5" DEPOSIT ABSOLUTE /end AXIS_DESCR
 /begin AXIS_DESCR STD_AXIS NO_INPUT_QUANTITY m_uw_b6553p5 6 0.00 6553.500 FORMAT "%8.3" DEPOSIT ABSOLUTE /end AXIS_DESCR
/end CHARACTERISTIC
/begin CHARACTERISTIC ExhMod_facTExhVlvCorrnLamSecFuB1_T "Lambda correction for the gas temperature at exhaust valve for secondary fuel systems bank 1" CURVE 0x8054C6FC RB_Curve_U16_U16 1.999969 fak_uw_b2 0.00 1.999969 FORMAT "%8.6"
 /begin AXIS_DESCR STD_AXIS NO_INPUT_QUANTITY fak_uw_b16 12 0.00 15.99976 FORMAT "%8.5" DEPOSIT ABSOLUTE /end AXIS_DESCR
/end CHARACTERISTIC
/begin CHARACTERISTIC ExhMod_facTExhVlvCorrnRriB1_M "Map for Correction factor based on inert gas rate bank 1" MAP 0x8054C72E RB_Map_U16U16_U16 1.999969 fak_uw_b2 0.00 1.999969 FORMAT "%8.6"
 /begin AXIS_DESCR STD_AXIS rri_w_msg rel_uw_b100 10 0.00 99.99847 FORMAT "%8.5" DEPOSIT ABSOLUTE /end AXIS_DESCR
 /begin AXIS_DESCR STD_AXIS NO_INPUT_QUANTITY m_uw_b6553p5 10 0.00 6553.500 FORMAT "%8.3" DEPOSIT ABSOLUTE /end AXIS_DESCR
/end CHARACTERISTIC
/begin CHARACTERISTIC ExhMod_htcCatCanngB1_M "heat transport coefficient catalyst catalyst canning bank 1" MAP 0x8054DFAE RB_Map_U16U16_U16 113.7760 fak_q0p00174_JsK 0.00 113.7760 FORMAT "%8.4"
 /begin AXIS_DESCR STD_AXIS NO_INPUT_QUANTITY m_uw_b6553p5 5 0.00 6553.500 FORMAT "%8.3" DEPOSIT ABSOLUTE /end AXIS_DESCR
 /begin AXIS_DESCR STD_AXIS NO_INPUT_QUANTITY dez 6 0.00 255.0000 FORMAT "%8.4" EXTENDED_LIMITS 0.00 65535.00 DEPOSIT ABSOLUTE /end AXIS_DESCR
/end CHARACTERISTIC
/begin CHARACTERISTIC ExhMod_htcCooltWtrPist_T "heat transfer coefficient from cooling water to piston" CURVE 0x8054E4FC RB_Curve_S16_U16_Static 113.7760 fak_q0p00174_JsK 0.00 113.7760 FORMAT "%8.4"
 /begin AXIS_DESCR STD_AXIS Epm_nEng EngN 8 -16384.00 16383.50 FORMAT "%8.2" DEPOSIT ABSOLUTE /end AXIS_DESCR
/end CHARACTERISTIC
/begin CHARACTERISTIC ExhMod_htcExhPistB1_T "heat transfer coefficient from exaust gas to piston" CURVE 0x8054E51E RB_Curve_S16_U16_Static 255.9961 fak_uw_b256 0.00 255.9961 FORMAT "%8.4"
 /begin AXIS_DESCR STD_AXIS Epm_nEng EngN 8 -16384.00 16383.50 FORMAT "%8.2" DEPOSIT ABSOLUTE /end AXIS_DESCR
/end CHARACTERISTIC
/begin CHARACTERISTIC ExhMod_htcExhVlvWallB1_T "Curve for heat transfer coefficient between exhaust gas wall at exhaust valve, bank 1" CURVE 0x8054C824 RB_Curve_S16_S32_Static 3728270.22049 fak_q0p00174_JsK 0.00000 3728270.22049 FORMAT "%13.5" EXTENDED_LIMITS -3728270.22222 3728270.22049
 /begin AXIS_DESCR STD_AXIS NO_INPUT_QUANTITY m_q0p1 12 0.00000 3276.70000 FORMAT "%13.5" EXTENDED_LIMITS -3276.80000 3276.70000 DEPOSIT ABSOLUTE /end AXIS_DESCR
/end CHARACTERISTIC
/begin CHARACTERISTIC ExhMod_htcExhWallBrickB1_M "heat transport coefficient exhaust wall and Brick bank 1" MAP 0x8054E004 RB_Map_S16S16_S32 7456540.44271 fak_q0p00174_JsK -3728270.22222 3728270.22049 FORMAT "%13.5"
 /begin AXIS_DESCR STD_AXIS NO_INPUT_QUANTITY m_uw_b6553p5 12 0.00 3276.700 FORMAT "%8.3" EXTENDED_LIMITS -3276.800 3276.700 DEPOSIT ABSOLUTE /end AXIS_DESCR
 /begin AXIS_DESCR STD_AXIS NO_INPUT_QUANTITY dez 12 0.00 255.0000 FORMAT "%8.4" EXTENDED_LIMITS -32768.00 32767.00 DEPOSIT ABSOLUTE /end AXIS_DESCR
/end CHARACTERISTIC
/begin CHARACTERISTIC ExhMod_htcOilPist_T "heat transfer coefficient from engine oil to piston" CURVE 0x8054E540 RB_Curve_S16_U16_Static 113.7760 fak_q0p00174_JsK 0.00 113.7760 FORMAT "%8.4"
 /begin AXIS_DESCR STD_AXIS Oil_pRel Pres 8 -3276.800 3276.700 FORMAT "%8.3" DEPOSIT ABSOLUTE /end AXIS_DESCR
/end CHARACTERISTIC
/begin CHARACTERISTIC ExhMod_htcVlvEnvB1_C "heat transfer coefficent valve environment bank 1" VALUE 0x8054C870 RB_Val_Wu16 113.7760 fak_q0p00174_JsK 0.00 113.7760 FORMAT "%8.4" /end CHARACTERISTIC
/begin CHARACTERISTIC ExhMod_htcWallEnvB1_M "heat transport coefficient wall environment bank 1" MAP 0x8054E278 RB_Map_U16U16_U16 113.7760 fak_q0p00174_JsK 0.00 113.7760 FORMAT "%8.4"
 /begin AXIS_DESCR STD_AXIS ExhMod_vVehLoc vfzg_uw_b512 7 0.00 511.9922 FORMAT "%8.4" DEPOSIT ABSOLUTE /end AXIS_DESCR
 /begin AXIS_DESCR STD_AXIS NO_INPUT_QUANTITY dez 12 0.00 255.0000 FORMAT "%8.4" EXTENDED_LIMITS 0.00 65535.00 DEPOSIT ABSOLUTE /end AXIS_DESCR
/end CHARACTERISTIC
/begin CHARACTERISTIC ExhMod_htcWallEnvBlowrB1_M "heat transport coefficient wall environment blower bank 1" MAP 0x8054E34A RB_Map_U16U16_U16 113.7760 fak_q0p00174_JsK 0.00 113.7760 FORMAT "%8.4"
 /begin AXIS_DESCR STD_AXIS NO_INPUT_QUANTITY rel_q0p012207 5 0.00 399.9878 FORMAT "%8.4" EXTENDED_LIMITS 0.00 799.9878 DEPOSIT ABSOLUTE /end AXIS_DESCR
 /begin AXIS_DESCR STD_AXIS NO_INPUT_QUANTITY dez 12 0.00 255.0000 FORMAT "%8.4" EXTENDED_LIMITS 0.00 65535.00 DEPOSIT ABSOLUTE /end AXIS_DESCR
/end CHARACTERISTIC
/begin CHARACTERISTIC ExhMod_idxIninSctn_CA "index initialisation section" VAL_BLK 0x8054E440 RB_ValA_Wu8 4.000 dez 0.00 4.000 FORMAT "%5.3" EXTENDED_LIMITS 0.00 255.0 NUMBER 12 /end CHARACTERISTIC
/begin CHARACTERISTIC ExhMod_idxSnsrB1_CA "Configuration array sensor positions" VAL_BLK 0x8054DDF2 RB_ValA_Wu8 11.00 dez 0.00 11.00 FORMAT "%5.2" EXTENDED_LIMITS 0.00 255.0 NUMBER 2 /end CHARACTERISTIC
/begin CHARACTERISTIC ExhMod_idxTCat1ExtdB1_CA "Extended configuration array temperatures catalyst 1" VAL_BLK 0x8054DDF4 RB_ValA_Wu8 11.00 dez 0.00 11.00 FORMAT "%5.2" EXTENDED_LIMITS 0.00 255.0 NUMBER 5 /end CHARACTERISTIC
/begin CHARACTERISTIC ExhMod_idxTCat2ExtdB1_CA "Extended configuration array temperatures catalyst 2" VAL_BLK 0x8054DDF9 RB_ValA_Wu8 11.00 dez 0.00 11.00 FORMAT "%5.2" EXTENDED_LIMITS 0.00 255.0 NUMBER 5 /end CHARACTERISTIC
/begin CHARACTERISTIC ExhMod_idxTExhB1_CA "Configuration array exhaust gas temperatures" VAL_BLK 0x8054DDFE RB_ValA_Wu8 11.00 dez 0.00 11.00 FORMAT "%5.2" EXTENDED_LIMITS 0.00 255.0 NUMBER 3 /end CHARACTERISTIC
/begin CHARACTERISTIC ExhMod_mtcH2oB1_M "mass transfer coefficient bank 1" MAP 0x8054EA38 RB_Map_R32R32_R32 2.0000E+037 q1_kg_DIV_s_m2 -1.0000E+037 1.0000E+037 FORMAT "%10.4" EXTENDED_LIMITS -3.4028E+038 3.4028E+038
 /begin AXIS_DESCR STD_AXIS NO_INPUT_QUANTITY q1_kg_DIV_h 8 0.0000 1.0000E+037 FORMAT "%10.4" EXTENDED_LIMITS -3.4028E+038 3.4028E+038 DEPOSIT ABSOLUTE /end AXIS_DESCR
 /begin AXIS_DESCR STD_AXIS NO_INPUT_QUANTITY dez 12 0. 1.000000E+037 FORMAT "%10.0" EXTENDED_LIMITS -3.402823E+038 3.402823E+038 DEPOSIT ABSOLUTE /end AXIS_DESCR
/end CHARACTERISTIC
/begin CHARACTERISTIC ExhMod_nrMaxColdStrtTspS1_C "maximum value cold start counter for thermo shock protected sensor fast release feature sensor 1" VALUE 0x8054E80C RB_Val_Wu8 255.0 dez 0.00 255.0 FORMAT "%5.1" /end CHARACTERISTIC
/begin CHARACTERISTIC ExhMod_nrMaxColdStrtTspS2_C "maximum value cold start counter for thermo shock protected sensor fast release feature sensor 2" VALUE 0x8054E80D RB_Val_Wu8 255.0 dez 0.00 255.0 FORMAT "%5.1" /end CHARACTERISTIC
/begin CHARACTERISTIC ExhMod_offsTExhVlvCorrnEngTB1_M "Map for the offset correction of the stationary temperature at exhaust valve depending on engine temperature bank 1" MAP 0x8054C872 RB_Map_S16U16_U16 1535.977 temp_q0p0234 0.00 1535.977 FORMAT "%8.3"
 /begin AXIS_DESCR STD_AXIS Epm_nEng nmot_q0p5 11 -16384.00 16383.50 FORMAT "%8.2" DEPOSIT ABSOLUTE /end AXIS_DESCR
 /begin AXIS_DESCR STD_AXIS AirMod_ratChrgAirCyl rel_q0p0234 11 0.00 1535.977 FORMAT "%8.3" DEPOSIT ABSOLUTE /end AXIS_DESCR
/end CHARACTERISTIC
/begin CHARACTERISTIC ExhMod_offsTExhVlvCorrnFcoIntkAir_T "Curve for the offset correction of the stationary temperature at exhaust valve during fuel-cutoff depending on intake air temperature" CURVE 0x8054C994 RB_Curve_S16_S16 1535.977 temp_q0p0234 -768.0000 767.9766 FORMAT "%8.4"
 /begin AXIS_DESCR STD_AXIS ExhMod_tExhVlvIntkAir Temp_Cels 6 -3549.940 3003.560 FORMAT "%8.3" DEPOSIT ABSOLUTE /end AXIS_DESCR
/end CHARACTERISTIC
/begin CHARACTERISTIC ExhMod_offsTExhVlvCorrnIntkAirB1_M "correction temperature exhaust at valve homogenous mode for intake air temperature (offset) Bank 1" MAP 0x8054C9AE RB_Map_S16U16_U16 1535.977 temp_q0p0234 0.00 1535.977 FORMAT "%8.3"
 /begin AXIS_DESCR STD_AXIS Epm_nEng nmot_q0p5 11 -16384.00 16383.50 FORMAT "%8.2" DEPOSIT ABSOLUTE /end AXIS_DESCR
 /begin AXIS_DESCR STD_AXIS AirMod_ratChrgAirCyl rel_q0p0234 11 0.00 1535.977 FORMAT "%8.3" DEPOSIT ABSOLUTE /end AXIS_DESCR
/end CHARACTERISTIC
/begin CHARACTERISTIC ExhMod_offsTExhVlvCorrnLamB1_M "offset lambda correction exhaust gas temperature downstream valve bank 1" MAP 0x8054CAD0 RB_Map_S16U16_S16 1535.977 temp_q0p0234 -768.0000 767.9766 FORMAT "%8.4"
 /begin AXIS_DESCR STD_AXIS Epm_nEng nmot_q0p5 11 -16384.00 16383.50 FORMAT "%8.2" DEPOSIT ABSOLUTE /end AXIS_DESCR
 /begin AXIS_DESCR STD_AXIS AirMod_ratChrgAirCyl rel_q0p0234 11 0.00 1535.977 FORMAT "%8.3" DEPOSIT ABSOLUTE /end AXIS_DESCR
/end CHARACTERISTIC
/begin CHARACTERISTIC ExhMod_offsTExhVlvCorrnLamSecFuB1_M "Lambda based offset correction for the gas temperature at exhaust valve for secondary fuel systems bank 1" MAP 0x8054CBF2 RB_Map_S16U16_S16 1535.977 temp_q0p0234 -768.0000 767.9766 FORMAT "%8.4"
 /begin AXIS_DESCR STD_AXIS Epm_nEng nmot_q0p5 11 -16384.00 16383.50 FORMAT "%8.2" DEPOSIT ABSOLUTE /end AXIS_DESCR
 /begin AXIS_DESCR STD_AXIS AirMod_ratChrgAirCyl rel_q0p0234 11 0.00 1535.977 FORMAT "%8.3" DEPOSIT ABSOLUTE /end AXIS_DESCR
/end CHARACTERISTIC
/begin CHARACTERISTIC ExhMod_pExhApplWtrMdl_C "application value pressure exhaust water modell" VALUE 0x8054EC10 RB_Val_Wu16 2559.961 p_q0p039 0.00 2559.961 FORMAT "%8.3" /end CHARACTERISTIC
/begin CHARACTERISTIC ExhMod_stCalcnIdealHeatTrfExhBrickB1_CA "Status of calculation with ideal heat transfer between gas and catalyst brick bank 1" VAL_BLK 0x8054E3E8 RB_ValA_Wu8 1.00000000000 B_TRUE 0.00 1.00000000000 FORMAT "%13.11" NUMBER 6 /end CHARACTERISTIC
/begin CHARACTERISTIC ExhMod_stCfgIninB1_CA "Configuration array for determination of the initialisation strategy bank 1" VAL_BLK 0x8054E44C RB_ValA_Wu8 2.000 dez 1.000 3.000 FORMAT "%5.3" EXTENDED_LIMITS 0.00 255.0 NUMBER 12 /end CHARACTERISTIC
/begin CHARACTERISTIC ExhMod_stSelnExhTSnsrInvldTiEngOffB1_CA "Selection of exhaust temperature sensor in case of invalid engine-off time bank 1" VAL_BLK 0x8054E458 RB_ValA_Wu8 1.000 OneToOne 0.00 1.000 FORMAT "%5.3" EXTENDED_LIMITS 0.00 255.0 NUMBER 12 /end CHARACTERISTIC
/begin CHARACTERISTIC ExhMod_stSelnReplcmtValStgyB1_CA "status of selection of replacement value strategy during intiialisation bank 1" VAL_BLK 0x8054E464 RB_ValA_Wu8 2.000 OneToOne 0.00 2.000 FORMAT "%5.3" EXTENDED_LIMITS 0.00 255.0 NUMBER 12 /end CHARACTERISTIC
/begin CHARACTERISTIC ExhMod_stSelnTCalcnAftSucInin_C "Selection of temperature calculationa after successful initialisation" VALUE 0x8054E48C RB_Val_Wu8 1.00000000000 B_TRUE 0.00 1.00000000000 FORMAT "%13.11" /end CHARACTERISTIC
/begin CHARACTERISTIC ExhMod_stSelnTCalcnDurgEngOff_C "Selection of temperature calculation during engine-off status" VALUE 0x8054E48D RB_Val_Wu8 1.00000000000 B_TRUE 0.00 1.00000000000 FORMAT "%13.11" /end CHARACTERISTIC
/begin CHARACTERISTIC ExhMod_stSepCanngActv_C "Status if seperate canning is active or not" VALUE 0x8054E3EE RB_Val_Wboolean 1.00000000000 B_TRUE 0.00 1.00000000000 FORMAT "%13.11" /end CHARACTERISTIC
/begin CHARACTERISTIC ExhMod_stSigQlyMskEnvT_C "status of signal quality mask for the environment temperature" VALUE 0x8054E470 RB_Val_Wu16 65535.00 OneToOne 0.00 65535.00 FORMAT "%8.2" /end CHARACTERISTIC
/begin CHARACTERISTIC ExhMod_stTExhCat1_C "codeword for the assignment of the exhaust temperatures at cat 1 with application values" VALUE 0x8054DE02 RB_Val_Wu16 65535.00 dez 0.00 65535.00 FORMAT "%8.2" /end CHARACTERISTIC
/begin CHARACTERISTIC ExhMod_stTExhCat2_C "codeword for the assignment of the exhaust temperatures at cat 2 with application values" VALUE 0x8054DE04 RB_Val_Wu16 65535.00 dez 0.00 65535.00 FORMAT "%8.2" /end CHARACTERISTIC
/begin CHARACTERISTIC ExhMod_stTExhFltd_C "Codeword for additional filtering of exhaust gas temperatures" VALUE 0x8054DE06 RB_Val_Wu8 255.0 dez 0.00 255.0 FORMAT "%5.1" /end CHARACTERISTIC
/begin CHARACTERISTIC ExhMod_stTExhMnfFirstPipY_C "codeword for the assignment of the exhaust temperatures in manifold, first pipe and Y-configuration with application values" VALUE 0x8054DE08 RB_Val_Wu16 65535.00 dez 0.00 65535.00 FORMAT "%8.2" /end CHARACTERISTIC
/begin CHARACTERISTIC ExhMod_stTExhSnsr_C "codeword for the assignment of the exhaust temperatures at the sensors with application values" VALUE 0x8054DE0A RB_Val_Wu16 65535.00 dez 0.00 65535.00 FORMAT "%8.2" /end CHARACTERISTIC
/begin CHARACTERISTIC ExhMod_stTPist_C "code word piston temperature model" VALUE 0x8054E562 RB_Val_Wu16 65535.00 dez 0.00 65535.00 FORMAT "%8.2" /end CHARACTERISTIC
/begin CHARACTERISTIC ExhMod_stTspSnsrRelsB1_CA "sensor specific code word array for ExhMod_TspSnsrRels" VAL_BLK 0x8054E80E RB_ValA_Wu8 255.0 OneToOne 0.00 255.0 FORMAT "%5.1" NUMBER 2 /end CHARACTERISTIC
/begin CHARACTERISTIC ExhMod_stTspSnsrRels_C "codeword for ExhMod_StTspSnsrRels" VALUE 0x8054E810 RB_Val_Wu8 255.0 dez 0.00 255.0 FORMAT "%5.1" /end CHARACTERISTIC
/begin CHARACTERISTIC ExhMod_stTVlvMdl_C "codeword TExhVlvMdl" VALUE 0x8054CD14 RB_Val_Wu16 65535.00 dez 0.00 65535.00 FORMAT "%8.2" /end CHARACTERISTIC
/begin CHARACTERISTIC ExhMod_stTWallSnsr_C "codeword for the assignment of the wall temperatures at the sensors with application values" VALUE 0x8054DE0C RB_Val_Wu16 65535.00 dez 0.00 65535.00 FORMAT "%8.2" /end CHARACTERISTIC
/begin CHARACTERISTIC ExhMod_stUtil_C "codeword for ExhMod_StUtil" VALUE 0x8054E812 RB_Val_Wu8 255.0 dez 0.00 255.0 FORMAT "%5.1" /end CHARACTERISTIC
/begin CHARACTERISTIC ExhMod_stWtrMdl_C "codeword water modell" VALUE 0x8054EC12 RB_Val_Wu8 255.0 dez 0.00 255.0 FORMAT "%5.1" /end CHARACTERISTIC
/begin CHARACTERISTIC ExhMod_tauTExhCat1ExtdB1_CA "Extended array time constants for additional filtering of exhaust temperatures in catalyst 1, bank 1" VAL_BLK 0x8054DE0E RB_ValA_Wu16 3276.700 t_q0p05 0.050 3276.750 FORMAT "%8.3" EXTENDED_LIMITS 0.00 3276.750 NUMBER 5 /end CHARACTERISTIC
/begin CHARACTERISTIC ExhMod_tauTExhCat2ExtdB1_CA "Extended array time constants for additional filtering of exhaust temperatures in catalyst 2, bank 1" VAL_BLK 0x8054DE18 RB_ValA_Wu16 3276.700 t_q0p05 0.050 3276.750 FORMAT "%8.3" EXTENDED_LIMITS 0.00 3276.750 NUMBER 5 /end CHARACTERISTIC
/begin CHARACTERISTIC ExhMod_tauTExhMnfFirstPipYB1_CA "array time constants for additional filtering of exhaust temperature in manifold, first brick and Y-configuration, bank 1" VAL_BLK 0x8054DE22 RB_ValA_Wu16 3276.700 t_q0p05 0.050 3276.750 FORMAT "%8.3" EXTENDED_LIMITS 0.00 3276.750 NUMBER 3 /end CHARACTERISTIC
/begin CHARACTERISTIC ExhMod_tauTExhSnsrB1_CA "array time constants for additional filtering of exhaust temperature at the sensors, bank 1" VAL_BLK 0x8054DE28 RB_ValA_Wu16 3276.700 t_q0p05 0.050 3276.750 FORMAT "%8.3" EXTENDED_LIMITS 0.00 3276.750 NUMBER 2 /end CHARACTERISTIC
/begin CHARACTERISTIC ExhMod_tExhCat1ExtdAppl_CA "Extended application array for the exhaust temperatures at cat 1" VAL_BLK 0x8054DE2C RB_ValA_Ws16 6553.500 Temp_Cels -3549.940 3003.560 FORMAT "%8.3" NUMBER 5 /end CHARACTERISTIC
/begin CHARACTERISTIC ExhMod_tExhCat2ExtdAppl_CA "Extended application array for the exhaust temperatures at cat 2" VAL_BLK 0x8054DE36 RB_ValA_Ws16 6553.500 Temp_Cels -3549.940 3003.560 FORMAT "%8.3" NUMBER 5 /end CHARACTERISTIC
/begin CHARACTERISTIC ExhMod_tExhIninB1_CA "initialisation temperature exhaust gas bank 1" VAL_BLK 0x8054E472 RB_ValA_Wu16 1535.977 temp_q0p0234_o273 -273.150 1262.827 FORMAT "%8.3" NUMBER 12 /end CHARACTERISTIC
/begin CHARACTERISTIC ExhMod_tExhSnsrAppl_CA "application array for the exhaust temperatures at the sensors" VAL_BLK 0x8054DE40 RB_ValA_Ws16 6553.500 Temp_Cels -3549.940 3003.560 FORMAT "%8.3" NUMBER 2 /end CHARACTERISTIC
/begin CHARACTERISTIC ExhMod_tExhVlvCorrnOffB1_M "exhaust temperature valve offset correction bank 1" MAP 0x8054CD16 RB_Map_U16U16_S16 1535.977 temp_q0p0234 -768.0000 767.9766 FORMAT "%8.4"
 /begin AXIS_DESCR STD_AXIS CEngDsT_t Temp_Cels 5 -273.140 3003.560 FORMAT "%8.3" EXTENDED_LIMITS -273.1400 6280.360 DEPOSIT ABSOLUTE /end AXIS_DESCR
 /begin AXIS_DESCR STD_AXIS NO_INPUT_QUANTITY m_uw_b6553p5 4 0.00 6553.500 FORMAT "%8.3" DEPOSIT ABSOLUTE /end AXIS_DESCR
/end CHARACTERISTIC
/begin CHARACTERISTIC ExhMod_tExhVlvEgrHomB1_M "exhaust temperature valve homogenous mode with exhaust gas recirculation bank 1" MAP 0x8054CD54 RB_Map_S16U16_S16 6553.500 Temp_Cels -3549.940 3003.560 FORMAT "%8.3"
 /begin AXIS_DESCR STD_AXIS Epm_nEng nmot_q0p5 11 -16384.00 16383.50 FORMAT "%8.2" DEPOSIT ABSOLUTE /end AXIS_DESCR
 /begin AXIS_DESCR STD_AXIS NO_INPUT_QUANTITY rel_uw_b3072 11 0.00 3071.953 FORMAT "%8.3" DEPOSIT ABSOLUTE /end AXIS_DESCR
/end CHARACTERISTIC
/begin CHARACTERISTIC ExhMod_tExhVlvEgrHomSecFuB1_M "Abgastemperatur Ventil Homogen-Betrieb mit Abgasrückführung alternativer Treibstoff Bank 1" MAP 0x8054CE76 RB_Map_S16U16_S16 6553.500 Temp_Cels -3549.940 3003.560 FORMAT "%8.3"
 /begin AXIS_DESCR STD_AXIS Epm_nEng nmot_q0p5 11 -16384.00 16383.50 FORMAT "%8.2" DEPOSIT ABSOLUTE /end AXIS_DESCR
 /begin AXIS_DESCR STD_AXIS NO_INPUT_QUANTITY rel_uw_b3072 11 0.00 3071.953 FORMAT "%8.3" DEPOSIT ABSOLUTE /end AXIS_DESCR
/end CHARACTERISTIC
/begin CHARACTERISTIC ExhMod_tExhVlvFcoB1_M "exhaust temperature valve fuel cut off bank 1" MAP 0x8054CF98 RB_Map_S16U16_U16 1535.977 temp_q0p0234_o273 -273.150 1262.827 FORMAT "%8.3"
 /begin AXIS_DESCR STD_AXIS Epm_nEng nmot_q0p5 10 -16384.00 16383.50 FORMAT "%8.2" DEPOSIT ABSOLUTE /end AXIS_DESCR
 /begin AXIS_DESCR STD_AXIS ExhMod_tEngCoolt Temp_Cels 5 -273.140 3003.560 FORMAT "%8.3" EXTENDED_LIMITS -273.1400 6280.360 DEPOSIT ABSOLUTE /end AXIS_DESCR
/end CHARACTERISTIC
/begin CHARACTERISTIC ExhMod_tExhVlvFcoHiVlvLft_M "Gas temperature at exhaust valve during fuel-cutoff with active high valve lift" MAP 0x8054D01E RB_Map_S16U16_U16 1535.977 temp_q0p0234_o273 -273.150 1262.827 FORMAT "%8.3"
 /begin AXIS_DESCR STD_AXIS Epm_nEng nmot_q0p5 10 -16384.00 16383.50 FORMAT "%8.2" DEPOSIT ABSOLUTE /end AXIS_DESCR
 /begin AXIS_DESCR STD_AXIS ExhMod_tEngCoolt Temp_Cels 5 -273.140 3003.560 FORMAT "%8.3" EXTENDED_LIMITS -273.1400 6280.360 DEPOSIT ABSOLUTE /end AXIS_DESCR
/end CHARACTERISTIC
/begin CHARACTERISTIC ExhMod_tExhVlvHomB1_M "exhaust temperature valve homogenous mode bank 1" MAP 0x8054D0A4 RB_Map_S16U16_S16 6553.500 Temp_Cels -3549.940 3003.560 FORMAT "%8.3"
 /begin AXIS_DESCR STD_AXIS Epm_nEng nmot_q0p5 11 -16384.00 16383.50 FORMAT "%8.2" DEPOSIT ABSOLUTE /end AXIS_DESCR
 /begin AXIS_DESCR STD_AXIS NO_INPUT_QUANTITY rel_uw_b3072 11 0.00 3071.953 FORMAT "%8.3" DEPOSIT ABSOLUTE /end AXIS_DESCR
/end CHARACTERISTIC
/begin CHARACTERISTIC ExhMod_tExhVlvHomHiVlvLftB1_M "exhaust temperature valve homogenous mode high valve lift bank 1" MAP 0x8054D1C6 RB_Map_S16U16_S16 6553.500 Temp_Cels -3549.940 3003.560 FORMAT "%8.3"
 /begin AXIS_DESCR STD_AXIS Epm_nEng nmot_q0p5 11 -16384.00 16383.50 FORMAT "%8.2" DEPOSIT ABSOLUTE /end AXIS_DESCR
 /begin AXIS_DESCR STD_AXIS NO_INPUT_QUANTITY rel_uw_b3072 11 0.00 3071.953 FORMAT "%8.3" DEPOSIT ABSOLUTE /end AXIS_DESCR
/end CHARACTERISTIC
/begin CHARACTERISTIC ExhMod_tExhVlvHomSecFuB1_M "exhaust temperature valve homogenous mode secondary fuel bank 1" MAP 0x8054D2E8 RB_Map_S16U16_S16 6553.500 Temp_Cels -3549.940 3003.560 FORMAT "%8.3"
 /begin AXIS_DESCR STD_AXIS Epm_nEng nmot_q0p5 11 -16384.00 16383.50 FORMAT "%8.2" DEPOSIT ABSOLUTE /end AXIS_DESCR
 /begin AXIS_DESCR STD_AXIS NO_INPUT_QUANTITY rel_uw_b3072 11 0.00 3071.953 FORMAT "%8.3" DEPOSIT ABSOLUTE /end AXIS_DESCR
/end CHARACTERISTIC
/begin CHARACTERISTIC ExhMod_tiConTExhVlvFcoB1_T "time constant exhaust temperature fuel cut-off bank 1" CURVE 0x8054D40A RB_Curve_U16_U16 3276.7499992 zk50msxs_uw_b3276p8 0.0500008 3276.8000000 FORMAT "%12.7" EXTENDED_LIMITS 0.050000762951 3276.8000000
 /begin AXIS_DESCR STD_AXIS NO_INPUT_QUANTITY m_uw_b6553p5 8 0.00 6553.500 FORMAT "%8.3" DEPOSIT ABSOLUTE /end AXIS_DESCR
/end CHARACTERISTIC
/begin CHARACTERISTIC ExhMod_tiDlyEngStop_C "Time to hold engine off time for ExhMod zero after engine shut down" VALUE 0x8054E564 RB_Val_Wu8 12.75 t_q0p05 0.00 12.75 FORMAT "%5.2" /end CHARACTERISTIC
/begin CHARACTERISTIC ExhMod_tiSigHoldEngRunng_C "Calculation interval of the slowest raster which imports ExhMod_flgEngRunngTiEngOff" VALUE 0x8054E565 RB_Val_Wu8 12.75 t_q0p05 0.00 12.75 FORMAT "%5.2" /end CHARACTERISTIC
/begin CHARACTERISTIC ExhMod_tMnfFirstPipYAppl_CA "application array for the exhaust temperatures in manifold, first pipe and Y-configuration" VAL_BLK 0x8054DE44 RB_ValA_Ws16 6553.500 Temp_Cels -3549.940 3003.560 FORMAT "%8.3" NUMBER 3 /end CHARACTERISTIC
/begin CHARACTERISTIC ExhMod_tReplcmtVal_C "Replacement value for temperature" VALUE 0x8054E48A RB_Val_Wu16 1535.977 temp_q0p0234_o273 -273.150 1262.827 FORMAT "%8.3" /end CHARACTERISTIC
/begin CHARACTERISTIC ExhMod_tWallSnsrAppl_CA "application array for the wall temperatures at the sensors" VAL_BLK 0x8054DE4A RB_ValA_Ws16 6553.500 Temp_Cels -3549.940 3003.560 FORMAT "%8.3" NUMBER 2 /end CHARACTERISTIC
/begin CHARACTERISTIC FanCtl_facAftRunCorrd_CUR "correction factor afterrun time" CURVE 0x8054EF74 RB_Curve_S16_S16 511.9922 Fact1 -256.0000 255.9922 FORMAT "%8.4"
 /begin AXIS_DESCR STD_AXIS GlbDa_tEnv Temp_Cels 4 -3549.940 3003.560 FORMAT "%8.3" DEPOSIT ABSOLUTE /end AXIS_DESCR
/end CHARACTERISTIC
/begin CHARACTERISTIC FanCtl_flgSwtAntiFlickDeactv_C "Anti headlight flicker de-actived switch" VALUE 0x8054EF86 RB_Val_Wu8 1.00000000000 B_TRUE 0.00 1.00000000000 FORMAT "%13.11" READ_ONLY /end CHARACTERISTIC
/begin CHARACTERISTIC FanCtl_nAntiFlickThd_C "Low engine speed threshold for anti headlight flicker" VALUE 0x8054EF88 RB_Val_Ws16 32767.50 EngN -16384.00 16383.50 FORMAT "%8.2" READ_ONLY /end CHARACTERISTIC
/begin CHARACTERISTIC FanCtl_nFanDecelHi_C "High speed value for Fan deceleration." VALUE 0x8054EF8A RB_Val_Ws16 32767.50 EngN -16384.00 16383.50 FORMAT "%8.2" /end CHARACTERISTIC
/begin CHARACTERISTIC FanCtl_nFanDecelLo_C "Low speed value for Fan deceleration." VALUE 0x8054EF8C RB_Val_Ws16 32767.50 EngN -16384.00 16383.50 FORMAT "%8.2" /end CHARACTERISTIC
/begin CHARACTERISTIC FanCtl_nSpdHi_C "Hysteresis threshold Hi of vehicle speed for FanCtl demand of vehicle speed" VALUE 0x8054EF8E RB_Val_Ws16 32767.50 EngN -16384.00 16383.50 FORMAT "%8.2" /end CHARACTERISTIC
/begin CHARACTERISTIC FanCtl_nSpdLo_C "Hysteresis threshold Lo of vehicle speed for FanCtl demand of vehicle speed" VALUE 0x8054EF90 RB_Val_Ws16 32767.50 EngN -16384.00 16383.50 FORMAT "%8.2" /end CHARACTERISTIC
/begin CHARACTERISTIC FanCtl_pCooltPDeltaHi_C "Hysteresis threshold Hi delta value of coolant pressure" VALUE 0x8054EF92 RB_Val_Ws16 131070.0 PresAC_hPa -65536.00 65534.00 FORMAT "%8.2" /end CHARACTERISTIC
/begin CHARACTERISTIC FanCtl_pCooltPHiHi_T "Hysteresis threshold Hi value of coolant pressure depends on vehicle speed" CURVE 0x8054EF94 RB_Curve_S16_S16 131070.0 PresAC_hPa -65536.00 65534.00 FORMAT "%8.2"
 /begin AXIS_DESCR STD_AXIS VehV_v Vel 5 -327.6800 327.6700 FORMAT "%8.4" DEPOSIT ABSOLUTE /end AXIS_DESCR
/end CHARACTERISTIC
/begin CHARACTERISTIC FanCtl_pCooltPLoHi_C "Hysteresis threshold Hi of E-Comp coolant pressure prohibition" VALUE 0x8054EFAA RB_Val_Ws16 131070.0 PresAC_hPa -65536.00 65534.00 FORMAT "%8.2" /end CHARACTERISTIC
/begin CHARACTERISTIC FanCtl_pCooltPLoLo_C "Hysteresis threshold Low of E-Comp coolant pressure prohibition" VALUE 0x8054EFAC RB_Val_Ws16 131070.0 PresAC_hPa -65536.00 65534.00 FORMAT "%8.2" /end CHARACTERISTIC
/begin CHARACTERISTIC FanCtl_pCooltPProhbHi_C "Hysteresis threshold Hi of coolant pressure prohibition" VALUE 0x8054EFAE RB_Val_Ws16 131070.0 PresAC_hPa -65536.00 65534.00 FORMAT "%8.2" /end CHARACTERISTIC
/begin CHARACTERISTIC FanCtl_pCooltPProhbLo_C "Hysteresis threshold Low of coolant pressure prohibition" VALUE 0x8054EFB0 RB_Val_Ws16 131070.0 PresAC_hPa -65536.00 65534.00 FORMAT "%8.2" /end CHARACTERISTIC
/begin CHARACTERISTIC FanCtl_pDutyPerdP11Hi_C "High Coolant pressure for Duty period 11" VALUE 0x8054EFB2 RB_Val_Ws16 32767.00 RBPtCel_p_1p0_3 0.00 32767.00 FORMAT "%8.2" EXTENDED_LIMITS -32768.00 32767.00 /end CHARACTERISTIC
/begin CHARACTERISTIC FanCtl_pDutyPerdP11Lo_C "Low Coolant pressure for Duty period 11" VALUE 0x8054EFB4 RB_Val_Ws16 32767.00 RBPtCel_p_1p0_3 0.00 32767.00 FORMAT "%8.2" EXTENDED_LIMITS -32768.00 32767.00 /end CHARACTERISTIC
/begin CHARACTERISTIC FanCtl_pDutyPerdP12Hi_C "High Coolant pressure for Duty period 12" VALUE 0x8054EFB6 RB_Val_Ws16 32767.00 RBPtCel_p_1p0_3 0.00 32767.00 FORMAT "%8.2" EXTENDED_LIMITS -32768.00 32767.00 /end CHARACTERISTIC
/begin CHARACTERISTIC FanCtl_pDutyPerdP12Lo_C "Low Coolant pressure for Duty period 12" VALUE 0x8054EFB8 RB_Val_Ws16 32767.00 RBPtCel_p_1p0_3 0.00 32767.00 FORMAT "%8.2" EXTENDED_LIMITS -32768.00 32767.00 /end CHARACTERISTIC
/begin CHARACTERISTIC FanCtl_pDutyPerdP13Hi_C "High Coolant pressure for Duty period 13" VALUE 0x8054EFBA RB_Val_Ws16 32767.00 RBPtCel_p_1p0_3 0.00 32767.00 FORMAT "%8.2" EXTENDED_LIMITS -32768.00 32767.00 /end CHARACTERISTIC
/begin CHARACTERISTIC FanCtl_pDutyPerdP13Lo_C "Low Coolant pressure for Duty period 13" VALUE 0x8054EFBC RB_Val_Ws16 32767.00 RBPtCel_p_1p0_3 0.00 32767.00 FORMAT "%8.2" EXTENDED_LIMITS -32768.00 32767.00 /end CHARACTERISTIC
/begin CHARACTERISTIC FanCtl_pDutyPerdP14Hi_C "High Coolant pressure for Duty period 14" VALUE 0x8054EFBE RB_Val_Ws16 32767.00 RBPtCel_p_1p0_3 0.00 32767.00 FORMAT "%8.2" EXTENDED_LIMITS -32768.00 32767.00 /end CHARACTERISTIC
/begin CHARACTERISTIC FanCtl_pDutyPerdP14Lo_C "Low Coolant pressure for Duty period 14" VALUE 0x8054EFC0 RB_Val_Ws16 32767.00 RBPtCel_p_1p0_3 0.00 32767.00 FORMAT "%8.2" EXTENDED_LIMITS -32768.00 32767.00 /end CHARACTERISTIC
/begin CHARACTERISTIC FanCtl_pDutyPerdP1Hi_C "High Coolant pressure for Duty period 1" VALUE 0x8054EFC2 RB_Val_Ws16 32767.00 RBPtCel_p_1p0_3 0.00 32767.00 FORMAT "%8.2" EXTENDED_LIMITS -32768.00 32767.00 /end CHARACTERISTIC
/begin CHARACTERISTIC FanCtl_pDutyPerdP1Lo_C "Low Coolant pressure for Duty period 1" VALUE 0x8054EFC4 RB_Val_Ws16 32767.00 RBPtCel_p_1p0_3 0.00 32767.00 FORMAT "%8.2" EXTENDED_LIMITS -32768.00 32767.00 /end CHARACTERISTIC
/begin CHARACTERISTIC FanCtl_pDutyPerdP21Hi_C "High Coolant pressure for Duty period 21" VALUE 0x8054EFC6 RB_Val_Ws16 32767.00 RBPtCel_p_1p0_3 0.00 32767.00 FORMAT "%8.2" EXTENDED_LIMITS -32768.00 32767.00 /end CHARACTERISTIC
/begin CHARACTERISTIC FanCtl_pDutyPerdP21Lo_C "Low Coolant pressure for Duty period 21" VALUE 0x8054EFC8 RB_Val_Ws16 32767.00 RBPtCel_p_1p0_3 0.00 32767.00 FORMAT "%8.2" EXTENDED_LIMITS -32768.00 32767.00 /end CHARACTERISTIC
/begin CHARACTERISTIC FanCtl_pDutyPerdP22Hi_C "High Coolant pressure for Duty period 22" VALUE 0x8054EFCA RB_Val_Ws16 32767.00 RBPtCel_p_1p0_3 0.00 32767.00 FORMAT "%8.2" EXTENDED_LIMITS -32768.00 32767.00 /end CHARACTERISTIC
/begin CHARACTERISTIC FanCtl_pDutyPerdP22Lo_C "Low Coolant pressure for Duty period 22" VALUE 0x8054EFCC RB_Val_Ws16 32767.00 RBPtCel_p_1p0_3 0.00 32767.00 FORMAT "%8.2" EXTENDED_LIMITS -32768.00 32767.00 /end CHARACTERISTIC
/begin CHARACTERISTIC FanCtl_pDutyPerdP23Hi_C "High Coolant pressure for Duty period 23" VALUE 0x8054EFCE RB_Val_Ws16 32767.00 RBPtCel_p_1p0_3 0.00 32767.00 FORMAT "%8.2" EXTENDED_LIMITS -32768.00 32767.00 /end CHARACTERISTIC
/begin CHARACTERISTIC FanCtl_pDutyPerdP23Lo_C "Low Coolant pressure for Duty period 23" VALUE 0x8054EFD0 RB_Val_Ws16 32767.00 RBPtCel_p_1p0_3 0.00 32767.00 FORMAT "%8.2" EXTENDED_LIMITS -32768.00 32767.00 /end CHARACTERISTIC
/begin CHARACTERISTIC FanCtl_pDutyPerdP24Hi_C "High Coolant pressure for Duty period 24" VALUE 0x8054EFD2 RB_Val_Ws16 32767.00 RBPtCel_p_1p0_3 0.00 32767.00 FORMAT "%8.2" EXTENDED_LIMITS -32768.00 32767.00 /end CHARACTERISTIC
/begin CHARACTERISTIC FanCtl_pDutyPerdP24Lo_C "Low Coolant pressure for Duty period 24" VALUE 0x8054EFD4 RB_Val_Ws16 32767.00 RBPtCel_p_1p0_3 0.00 32767.00 FORMAT "%8.2" EXTENDED_LIMITS -32768.00 32767.00 /end CHARACTERISTIC
/begin CHARACTERISTIC FanCtl_pDutyPerdP2Hi_C "High Coolant pressure for Duty period 2" VALUE 0x8054EFD6 RB_Val_Ws16 32767.00 RBPtCel_p_1p0_3 0.00 32767.00 FORMAT "%8.2" EXTENDED_LIMITS -32768.00 32767.00 /end CHARACTERISTIC
/begin CHARACTERISTIC FanCtl_pDutyPerdP2Lo_C "Low Coolant pressure for Duty period 2" VALUE 0x8054EFD8 RB_Val_Ws16 32767.00 RBPtCel_p_1p0_3 0.00 32767.00 FORMAT "%8.2" EXTENDED_LIMITS -32768.00 32767.00 /end CHARACTERISTIC
/begin CHARACTERISTIC FanCtl_pDutyPerdP3HiHi_C "High Coolant pressure for Duty period 3 High" VALUE 0x8054EFDA RB_Val_Ws16 32767.00 RBPtCel_p_1p0_3 0.00 32767.00 FORMAT "%8.2" EXTENDED_LIMITS -32768.00 32767.00 /end CHARACTERISTIC
/begin CHARACTERISTIC FanCtl_pDutyPerdP3HiLo_C "Low Coolant pressure for Duty period 3 Low" VALUE 0x8054EFDC RB_Val_Ws16 32767.00 RBPtCel_p_1p0_3 0.00 32767.00 FORMAT "%8.2" EXTENDED_LIMITS -32768.00 32767.00 /end CHARACTERISTIC
/begin CHARACTERISTIC FanCtl_pDutyPerdP3Hi_C "High Coolant pressure for Duty period 3" VALUE 0x8054EFDE RB_Val_Ws16 32767.00 RBPtCel_p_1p0_3 0.00 32767.00 FORMAT "%8.2" EXTENDED_LIMITS -32768.00 32767.00 /end CHARACTERISTIC
/begin CHARACTERISTIC FanCtl_pDutyPerdP3Lo_C "Low Coolant pressure for Duty period 3" VALUE 0x8054EFE0 RB_Val_Ws16 32767.00 RBPtCel_p_1p0_3 0.00 32767.00 FORMAT "%8.2" EXTENDED_LIMITS -32768.00 32767.00 /end CHARACTERISTIC
/begin CHARACTERISTIC FanCtl_pDutyPerdP4Hi_C "High Coolant pressure for Duty period 4" VALUE 0x8054EFE2 RB_Val_Ws16 32767.00 RBPtCel_p_1p0_3 0.00 32767.00 FORMAT "%8.2" EXTENDED_LIMITS -32768.00 32767.00 /end CHARACTERISTIC
/begin CHARACTERISTIC FanCtl_pDutyPerdP4Lo_C "Low Coolant pressure for Duty period 4" VALUE 0x8054EFE4 RB_Val_Ws16 32767.00 RBPtCel_p_1p0_3 0.00 32767.00 FORMAT "%8.2" EXTENDED_LIMITS -32768.00 32767.00 /end CHARACTERISTIC
/begin CHARACTERISTIC FanCtl_rAftRunDutyPred_C "Duty period percentage during after run." VALUE 0x8054EFE6 RB_Val_Ws16 799.9878 Prc -400.0000 399.9878 FORMAT "%8.4" /end CHARACTERISTIC
/begin CHARACTERISTIC FanCtl_rAftRunEnd_C "Duty period percentage for after run end." VALUE 0x8054EFE8 RB_Val_Ws16 799.9878 Prc -400.0000 399.9878 FORMAT "%8.4" /end CHARACTERISTIC
/begin CHARACTERISTIC FanCtl_rDutyPredHi_C "Fan Duty period high percentage value" VALUE 0x8054EFEA RB_Val_Ws16 799.9878 Prc -400.0000 399.9878 FORMAT "%8.4" /end CHARACTERISTIC
/begin CHARACTERISTIC FanCtl_rDutyPredLo_C "Fan Duty period low percentage value" VALUE 0x8054EFEC RB_Val_Ws16 799.9878 Prc -400.0000 399.9878 FORMAT "%8.4" /end CHARACTERISTIC
/begin CHARACTERISTIC FanCtl_rDutyPredMid1_C "Fan Duty period Mid1 percentage value" VALUE 0x8054EFEE RB_Val_Ws16 799.9878 Prc -400.0000 399.9878 FORMAT "%8.4" /end CHARACTERISTIC
/begin CHARACTERISTIC FanCtl_rDutyPredMid2_C "Fan Duty period Mid2 percentage value" VALUE 0x8054EFF0 RB_Val_Ws16 799.9878 Prc -400.0000 399.9878 FORMAT "%8.4" /end CHARACTERISTIC
/begin CHARACTERISTIC FanCtl_rFailSafeDutyPerd_C "Fail safe value for fan duty period" VALUE 0x8054EFF2 RB_Val_Ws16 799.9878 Prc -400.0000 399.9878 FORMAT "%8.4" /end CHARACTERISTIC
/begin CHARACTERISTIC FanCtl_rFanDutyHi_C "Percentage value for Fan duty high" VALUE 0x8054EFF4 RB_Val_Ws16 799.9878 Prc -400.0000 399.9878 FORMAT "%8.4" /end CHARACTERISTIC
/begin CHARACTERISTIC FanCtl_rFanDutyLo_C "Percentage value for Fan duty low" VALUE 0x8054EFF6 RB_Val_Ws16 799.9878 Prc -400.0000 399.9878 FORMAT "%8.4" /end CHARACTERISTIC
/begin CHARACTERISTIC FanCtl_rFanDutyOff_C "Percentage value for Fan duty cycle in off state" VALUE 0x8054EFF8 RB_Val_Ws16 799.9878 Prc -400.0000 399.9878 FORMAT "%8.4" /end CHARACTERISTIC
/begin CHARACTERISTIC FanCtl_rPDpdtDutyPerd11_C "Fan Duty period based on coolant pressure 11 value" VALUE 0x8054EFFA RB_Val_Ws16 799.9878 Prc -400.0000 399.9878 FORMAT "%8.4" /end CHARACTERISTIC
/begin CHARACTERISTIC FanCtl_rPDpdtDutyPerd12_C "Fan Duty period based on coolant pressure 12 value" VALUE 0x8054EFFC RB_Val_Ws16 799.9878 Prc -400.0000 399.9878 FORMAT "%8.4" /end CHARACTERISTIC
/begin CHARACTERISTIC FanCtl_rPDpdtDutyPerd13_C "Fan Duty period based on coolant pressure 13 value" VALUE 0x8054EFFE RB_Val_Ws16 799.9878 Prc -400.0000 399.9878 FORMAT "%8.4" /end CHARACTERISTIC
/begin CHARACTERISTIC FanCtl_rPDpdtDutyPerd14_C "Fan Duty period based on coolant pressure 14 value" VALUE 0x8054F000 RB_Val_Ws16 799.9878 Prc -400.0000 399.9878 FORMAT "%8.4" /end CHARACTERISTIC
/begin CHARACTERISTIC FanCtl_rPDpdtDutyPerd15_C "Fan Duty period based on coolant pressure 15 value" VALUE 0x8054F002 RB_Val_Ws16 799.9878 Prc -400.0000 399.9878 FORMAT "%8.4" /end CHARACTERISTIC
/begin CHARACTERISTIC FanCtl_rPDpdtDutyPerd1_C "Fan Duty period based on coolant pressure 1 value" VALUE 0x8054F004 RB_Val_Ws16 799.9878 Prc -400.0000 399.9878 FORMAT "%8.4" /end CHARACTERISTIC
/begin CHARACTERISTIC FanCtl_rPDpdtDutyPerd21_C "Fan Duty period based on coolant pressure 21 value" VALUE 0x8054F006 RB_Val_Ws16 799.9878 Prc -400.0000 399.9878 FORMAT "%8.4" /end CHARACTERISTIC
/begin CHARACTERISTIC FanCtl_rPDpdtDutyPerd22_C "Fan Duty period based on coolant pressure 22 value" VALUE 0x8054F008 RB_Val_Ws16 799.9878 Prc -400.0000 399.9878 FORMAT "%8.4" /end CHARACTERISTIC
/begin CHARACTERISTIC FanCtl_rPDpdtDutyPerd23_C "Fan Duty period based on coolant pressure 23 value" VALUE 0x8054F00A RB_Val_Ws16 799.9878 Prc -400.0000 399.9878 FORMAT "%8.4" /end CHARACTERISTIC
/begin CHARACTERISTIC FanCtl_rPDpdtDutyPerd24_C "Fan Duty period based on coolant pressure 24 value" VALUE 0x8054F00C RB_Val_Ws16 799.9878 Prc -400.0000 399.9878 FORMAT "%8.4" /end CHARACTERISTIC
/begin CHARACTERISTIC FanCtl_rPDpdtDutyPerd25_C "Fan Duty period based on coolant pressure 25 value" VALUE 0x8054F00E RB_Val_Ws16 799.9878 Prc -400.0000 399.9878 FORMAT "%8.4" /end CHARACTERISTIC
/begin CHARACTERISTIC FanCtl_rPDpdtDutyPerd2_C "Fan Duty period based on coolant pressure 2 value" VALUE 0x8054F010 RB_Val_Ws16 799.9878 Prc -400.0000 399.9878 FORMAT "%8.4" /end CHARACTERISTIC
/begin CHARACTERISTIC FanCtl_rPDpdtDutyPerd3_C "Fan Duty period based on coolant pressure 3 value" VALUE 0x8054F012 RB_Val_Ws16 799.9878 Prc -400.0000 399.9878 FORMAT "%8.4" /end CHARACTERISTIC
/begin CHARACTERISTIC FanCtl_rPDpdtDutyPerd4_C "Fan Duty period based on coolant pressure 4 value" VALUE 0x8054F014 RB_Val_Ws16 799.9878 Prc -400.0000 399.9878 FORMAT "%8.4" /end CHARACTERISTIC
/begin CHARACTERISTIC FanCtl_rPDpdtDutyPerd5_C "Fan Duty period based on coolant pressure 5 value" VALUE 0x8054F016 RB_Val_Ws16 799.9878 Prc -400.0000 399.9878 FORMAT "%8.4" /end CHARACTERISTIC
/begin CHARACTERISTIC FanCtl_rRadrFanDutyHi_C "Radiator fan duty period high value" VALUE 0x8054F018 RB_Val_Ws16 799.9878 Prc -400.0000 399.9878 FORMAT "%8.4" /end CHARACTERISTIC
/begin CHARACTERISTIC FanCtl_rTDpdtDutyPerd1_C "Fan Duty period based on coolant temperature 1 value" VALUE 0x8054F01A RB_Val_Ws16 799.9878 Prc -400.0000 399.9878 FORMAT "%8.4" /end CHARACTERISTIC
/begin CHARACTERISTIC FanCtl_rTDpdtDutyPerd2_C "Fan Duty period based on coolant temperature 2 value" VALUE 0x8054F01C RB_Val_Ws16 799.9878 Prc -400.0000 399.9878 FORMAT "%8.4" /end CHARACTERISTIC
/begin CHARACTERISTIC FanCtl_rTDpdtDutyPerd3_C "Fan Duty period based on coolant temperature 3 value" VALUE 0x8054F01E RB_Val_Ws16 799.9878 Prc -400.0000 399.9878 FORMAT "%8.4" /end CHARACTERISTIC
/begin CHARACTERISTIC FanCtl_rTDpdtDutyPerd4_C "Fan Duty period based on coolant temperature 4value" VALUE 0x8054F020 RB_Val_Ws16 799.9878 Prc -400.0000 399.9878 FORMAT "%8.4" /end CHARACTERISTIC
/begin CHARACTERISTIC FanCtl_stACCooltPSnsr_C "AC coolant pressure sensor status" VALUE 0x8054F022 RB_Val_Wu8 1.000 OneToOne 0.00 1.000 FORMAT "%5.3" EXTENDED_LIMITS 0.00 255.0 /end CHARACTERISTIC
/begin CHARACTERISTIC FanCtl_swtPWMFanActv_C "Switch to select for PWM or Two-Stage logic" VALUE 0x8054F023 RB_Val_Wu8 1.00000000000 B_TRUE 0.00 1.00000000000 FORMAT "%13.11" /end CHARACTERISTIC
/begin CHARACTERISTIC FanCtl_tCooltTHi_C "Hysteresis threshold Hi for coolant temperature" VALUE 0x8054F024 RB_Val_Ws16 6553.500 Temp_Cels -3549.940 3003.560 FORMAT "%8.3" /end CHARACTERISTIC
/begin CHARACTERISTIC FanCtl_tCooltTLoHi_C "Radiator fan Lo\Hi contol, Lo mode implement water temperature (Hysteresis Hi)" VALUE 0x8054F026 RB_Val_Ws16 6553.500 Temp_Cels -3549.940 3003.560 FORMAT "%8.3" /end CHARACTERISTIC
/begin CHARACTERISTIC FanCtl_tCooltTLoLo_C "Radiator fan Lo\Hi control, Lo mode implement water temperature (Hysteresis Lo)" VALUE 0x8054F028 RB_Val_Ws16 6553.500 Temp_Cels -3549.940 3003.560 FORMAT "%8.3" /end CHARACTERISTIC
/begin CHARACTERISTIC FanCtl_tCooltTLo_C "Hysteresis threshold Lo for coolant temperature" VALUE 0x8054F02A RB_Val_Ws16 6553.500 Temp_Cels -3549.940 3003.560 FORMAT "%8.3" /end CHARACTERISTIC
/begin CHARACTERISTIC FanCtl_tCooltT_C "Threshold of coolant temperature which is used for FanCtl demand of reducing vehicle speed" VALUE 0x8054F02C RB_Val_Ws16 6553.500 Temp_Cels -3549.940 3003.560 FORMAT "%8.3" /end CHARACTERISTIC
/begin CHARACTERISTIC FanCtl_tDutyPerdT1Hi_C "Fan Duty period based on coolant temperature 1 high value" VALUE 0x8054F02E RB_Val_Ws16 6553.500 Temp_Cels -3549.940 3003.560 FORMAT "%8.3" /end CHARACTERISTIC
/begin CHARACTERISTIC FanCtl_tDutyPerdT1Lo_C "Fan Duty period based on coolant temperature 1 low value" VALUE 0x8054F030 RB_Val_Ws16 6553.500 Temp_Cels -3549.940 3003.560 FORMAT "%8.3" /end CHARACTERISTIC
/begin CHARACTERISTIC FanCtl_tDutyPerdT2Hi_C "Fan Duty period based on coolant temperature 2 high value" VALUE 0x8054F032 RB_Val_Ws16 6553.500 Temp_Cels -3549.940 3003.560 FORMAT "%8.3" /end CHARACTERISTIC
/begin CHARACTERISTIC FanCtl_tDutyPerdT2Lo_C "Fan Duty period based on coolant temperature 2 low value" VALUE 0x8054F034 RB_Val_Ws16 6553.500 Temp_Cels -3549.940 3003.560 FORMAT "%8.3" /end CHARACTERISTIC
/begin CHARACTERISTIC FanCtl_tDutyPerdT3Hi_C "Fan Duty period based on coolant temperature 3 high value" VALUE 0x8054F036 RB_Val_Ws16 6553.500 Temp_Cels -3549.940 3003.560 FORMAT "%8.3" /end CHARACTERISTIC
/begin CHARACTERISTIC FanCtl_tDutyPerdT3Lo_C "Fan Duty period based on coolant temperature 3 low value" VALUE 0x8054F038 RB_Val_Ws16 6553.500 Temp_Cels -3549.940 3003.560 FORMAT "%8.3" /end CHARACTERISTIC
/begin CHARACTERISTIC FanCtl_tiACGFixdMod_C "Delay Time for ACG fixed mode" VALUE 0x8054F03A RB_Val_Ws16 327.6700 Time_s 0.00 327.6700 FORMAT "%8.4" EXTENDED_LIMITS -327.6800 327.6700 /end CHARACTERISTIC
/begin CHARACTERISTIC FanCtl_tiAftRun_C "fan afterrun time" VALUE 0x8054F03C RB_Val_Ws16 65535.00 TimeEngOn -32768.00 32767.00 FORMAT "%8.2" /end CHARACTERISTIC
/begin CHARACTERISTIC FanCtl_tiAftRun_CUR "fan afterrun time" CURVE 0x8054F03E RB_Curve_S16_S16 65535.00 TimeEngOn -32768.00 32767.00 FORMAT "%8.2"
 /begin AXIS_DESCR STD_AXIS FanCtl_tCooltT Temp_Cels 4 -3549.940 3003.560 FORMAT "%8.3" DEPOSIT ABSOLUTE /end AXIS_DESCR
/end CHARACTERISTIC
/begin CHARACTERISTIC FanCtl_tiAntiFlickLim_C "Delay Time for limit anti headlight flicker" VALUE 0x8054F050 RB_Val_Ws16 327.6700 Time_s 0.00 327.6700 FORMAT "%8.4" EXTENDED_LIMITS -327.6800 327.6700 READ_ONLY /end CHARACTERISTIC
/begin CHARACTERISTIC FanCtl_tiImdtHiStgOnDly_C "Time delay for Immediate High stage ON" VALUE 0x8054F052 RB_Val_Wu16 655.3500 Time_s 0.00 655.3500 FORMAT "%8.4" /end CHARACTERISTIC
/begin CHARACTERISTIC FanCtl_tiRlyCtrlDly_C "Time for fan relay control delay" VALUE 0x8054F054 RB_Val_Ws16 655350.0 Time_ms -327680.0 327670.0 FORMAT "%8.1" /end CHARACTERISTIC
/begin CHARACTERISTIC FanCtl_tiSpdOffDly_C "TrnOffDly threshold for FanCtl demand of vehicle speed" VALUE 0x8054F056 RB_Val_Ws16 327.6700 Time_s 0.00 327.6700 FORMAT "%8.4" EXTENDED_LIMITS -327.6800 327.6700 /end CHARACTERISTIC
/begin CHARACTERISTIC FanCtl_tiSpdOnDly_C "TrnOnDly threshold for FanCtl demand of vehicle speed" VALUE 0x8054F058 RB_Val_Ws16 327.6700 Time_s 0.00 327.6700 FORMAT "%8.4" EXTENDED_LIMITS -327.6800 327.6700 /end CHARACTERISTIC
/begin CHARACTERISTIC FanCtl_tiTrqResvFan1_C "Delay Time for reserve torque for Fan 1" VALUE 0x8054F05A RB_Val_Ws16 327.6700 Time_s 0.00 327.6700 FORMAT "%8.4" EXTENDED_LIMITS -327.6800 327.6700 /end CHARACTERISTIC
/begin CHARACTERISTIC FanCtl_tiTrqResvFan2_C "Delay Time for reserve torque for Fan 2" VALUE 0x8054F05C RB_Val_Ws16 327.6700 Time_s 0.00 327.6700 FORMAT "%8.4" EXTENDED_LIMITS -327.6800 327.6700 /end CHARACTERISTIC
/begin CHARACTERISTIC FanCtl_tqThrIdleTqValHi_C "Throttle idle torque for fan control high" VALUE 0x8054F060 RB_Val_Ws32 429496729.500 TrqPrpHigh -214748364.800 214748364.700 FORMAT "%13.3" /end CHARACTERISTIC
/begin CHARACTERISTIC FanCtl_tqThrIdleTqValLo_C "Throttle idle torque for fan control low" VALUE 0x8054F064 RB_Val_Ws32 429496729.500 TrqPrpHigh -214748364.800 214748364.700 FORMAT "%13.3" /end CHARACTERISTIC
/begin CHARACTERISTIC FanCtl_uAntiFlickThd_C "Under transition voltage threshold for anti headlight flicker" VALUE 0x8054F068 RB_Val_Ws16 1310700. Volt_Batt -655360.0 655340.0 FORMAT "%8.1" READ_ONLY /end CHARACTERISTIC
/begin CHARACTERISTIC FanCtl_uDutyPerdUHi_C "Blower fan high voltage for fan duty period" VALUE 0x8054F06A RB_Val_Ws16 1638.350 RBPtCel_u_0p05_1 0.00 1638.350 FORMAT "%8.3" EXTENDED_LIMITS -1638.400 1638.350 /end CHARACTERISTIC
/begin CHARACTERISTIC FanCtl_uDutyPerdULo_C "Blower fan low voltage for fan duty period" VALUE 0x8054F06C RB_Val_Ws16 1638.350 RBPtCel_u_0p05_1 0.00 1638.350 FORMAT "%8.3" EXTENDED_LIMITS -1638.400 1638.350 /end CHARACTERISTIC
/begin CHARACTERISTIC FanCtl_uFailSafeBlowrU_C "Fail safe blower fan voltage" VALUE 0x8054F06E RB_Val_Ws16 1638.350 RBPtCel_u_0p05_1 0.00 1638.350 FORMAT "%8.3" EXTENDED_LIMITS -1638.400 1638.350 /end CHARACTERISTIC
/begin CHARACTERISTIC FanCtl_vLoVehSpdHi_C "Hysteresis threshold Hi of vehicle speed for FanCtl demand of AC" VALUE 0x8054F070 RB_Val_Ws16 655.3500 Vel -327.6800 327.6700 FORMAT "%8.4" /end CHARACTERISTIC
/begin CHARACTERISTIC FanCtl_vModSelnSpdHiHi_C "Mode selection velocity for high high" VALUE 0x8054F072 RB_Val_Ws16 655.3500 Vel -327.6800 327.6700 FORMAT "%8.4" /end CHARACTERISTIC
/begin CHARACTERISTIC FanCtl_vModSelnSpdHiLo_C "Mode selection velocity for high low" VALUE 0x8054F074 RB_Val_Ws16 655.3500 Vel -327.6800 327.6700 FORMAT "%8.4" /end CHARACTERISTIC
/begin CHARACTERISTIC FanCtl_vModSelnSpdLoHi_C "Mode selection velocity for low high" VALUE 0x8054F076 RB_Val_Ws16 655.3500 Vel -327.6800 327.6700 FORMAT "%8.4" /end CHARACTERISTIC
/begin CHARACTERISTIC FanCtl_vModSelnSpdLoLo_C "Mode selection velocity for low low" VALUE 0x8054F078 RB_Val_Ws16 655.3500 Vel -327.6800 327.6700 FORMAT "%8.4" /end CHARACTERISTIC
/begin CHARACTERISTIC FanCtl_vSpdHiHi_C "Hysteresis threshold Hi of Hi vehicle speed for FanCtl demand of AC" VALUE 0x8054F07A RB_Val_Ws16 655.3500 Vel -327.6800 327.6700 FORMAT "%8.4" /end CHARACTERISTIC
/begin CHARACTERISTIC FanCtl_vSpdHiLo_C "Hysteresis threshold Lo of Hi vehicle speed for FanCtl demand of AC" VALUE 0x8054F07C RB_Val_Ws16 655.3500 Vel -327.6800 327.6700 FORMAT "%8.4" /end CHARACTERISTIC
/begin CHARACTERISTIC FanCtl_vSpdLoHi_C "Hysteresis threshold Hi of Lo vehicle speed for FanCtl demand of AC" VALUE 0x8054F07E RB_Val_Ws16 655.3500 Vel -327.6800 327.6700 FORMAT "%8.4" /end CHARACTERISTIC
/begin CHARACTERISTIC FanCtl_vSpdLoLo_C "Hysteresis threshold Lo of Lo vehicle speed for FanCtl demand of AC" VALUE 0x8054F080 RB_Val_Ws16 655.3500 Vel -327.6800 327.6700 FORMAT "%8.4" /end CHARACTERISTIC
/begin CHARACTERISTIC FanDig0_ATS.LimitTypeMsk_C "Actuator test FanDig0_ATS / Tester demand monitoring enable mask for actuators" VALUE 0x8058A76C Val_Wu8 255.0 OneToOne 0.00 255.0 FORMAT "%5.1" /end CHARACTERISTIC
/begin CHARACTERISTIC FanDig0_ATS.CnvNorm_C "Actuator test FanDig0_ATS / Conversion norm used for conversion to/from internal scaling" VALUE 0x8058A76D Val_Wu8 255.0 OneToOne 0.00 255.0 FORMAT "%5.1" /end CHARACTERISTIC
/begin CHARACTERISTIC FanDig0_ATS.LowLim_C "Actuator test FanDig0_ATS / Lower limit for monitoring" VALUE 0x8058A76E Val_Ws16 65535.00 OneToOne -32768.00 32767.00 FORMAT "%8.2" /end CHARACTERISTIC
/begin CHARACTERISTIC FanDig0_ATS.UpLim_C "Actuator test FanDig0_ATS / Upper limit for monitoring" VALUE 0x8058A770 Val_Ws16 65535.00 OneToOne -32768.00 32767.00 FORMAT "%8.2" /end CHARACTERISTIC
/begin CHARACTERISTIC FanDig0_ATS.CnvFac_C "Actuator test FanDig0_ATS / Factor used for conversion to/from internal scaling" VALUE 0x8058A774 Val_Ws32 4294967295.00 OneToOne -2147483648.00 2147483647.00 FORMAT "%13.2" /end CHARACTERISTIC
/begin CHARACTERISTIC FanDig0_ATS.CnvOfs_C "Actuator test FanDig0_ATS / Offset used for conversion to/from internal scaling" VALUE 0x8058A778 Val_Ws16 65535.00 OneToOne -32768.00 32767.00 FORMAT "%8.2" /end CHARACTERISTIC
/begin CHARACTERISTIC FanDig0_ATS.DfltVal_C "Actuator test FanDig0_ATS / Default value for standbytest" VALUE 0x8058A77A Val_Ws16 65535.00 OneToOne -32768.00 32767.00 FORMAT "%8.2" /end CHARACTERISTIC
/begin CHARACTERISTIC FanDig1_ATS.LimitTypeMsk_C "Actuator test FanDig1_ATS / Tester demand monitoring enable mask for actuators" VALUE 0x8058A77C Val_Wu8 255.0 OneToOne 0.00 255.0 FORMAT "%5.1" /end CHARACTERISTIC
/begin CHARACTERISTIC FanDig1_ATS.CnvNorm_C "Actuator test FanDig1_ATS / Conversion norm used for conversion to/from internal scaling" VALUE 0x8058A77D Val_Wu8 255.0 OneToOne 0.00 255.0 FORMAT "%5.1" /end CHARACTERISTIC
/begin CHARACTERISTIC FanDig1_ATS.LowLim_C "Actuator test FanDig1_ATS / Lower limit for monitoring" VALUE 0x8058A77E Val_Ws16 65535.00 OneToOne -32768.00 32767.00 FORMAT "%8.2" /end CHARACTERISTIC
/begin CHARACTERISTIC FanDig1_ATS.UpLim_C "Actuator test FanDig1_ATS / Upper limit for monitoring" VALUE 0x8058A780 Val_Ws16 65535.00 OneToOne -32768.00 32767.00 FORMAT "%8.2" /end CHARACTERISTIC
/begin CHARACTERISTIC FanDig1_ATS.CnvFac_C "Actuator test FanDig1_ATS / Factor used for conversion to/from internal scaling" VALUE 0x8058A784 Val_Ws32 4294967295.00 OneToOne -2147483648.00 2147483647.00 FORMAT "%13.2" /end CHARACTERISTIC
/begin CHARACTERISTIC FanDig1_ATS.CnvOfs_C "Actuator test FanDig1_ATS / Offset used for conversion to/from internal scaling" VALUE 0x8058A788 Val_Ws16 65535.00 OneToOne -32768.00 32767.00 FORMAT "%8.2" /end CHARACTERISTIC
/begin CHARACTERISTIC FanDig1_ATS.DfltVal_C "Actuator test FanDig1_ATS / Default value for standbytest" VALUE 0x8058A78A Val_Ws16 65535.00 OneToOne -32768.00 32767.00 FORMAT "%8.2" /end CHARACTERISTIC
/begin CHARACTERISTIC Fans_tiTrqConsFltFan1_C "Time Delay for Filtering of static Torque Consumed of Fan 1" VALUE 0x8054F084 RB_Val_Ws32 4294.9672940000000 TimeDelay_s 0.0000020000000 4294.9672959999998 FORMAT "%19.14" EXTENDED_LIMITS 0.000002000000001 4294.9672959999998 /end CHARACTERISTIC
/begin CHARACTERISTIC Fans_tiTrqConsFltFan2_C "Time Delay for Filtering of static Torque Consumed of Fan 2" VALUE 0x8054F088 RB_Val_Ws32 4294.9672940000000 TimeDelay_s 0.0000020000000 4294.9672959999998 FORMAT "%19.14" EXTENDED_LIMITS 0.000002000000001 4294.9672959999998 /end CHARACTERISTIC
/begin CHARACTERISTIC Fans_tiTrqResvFan1_C "Time Delay Off of static Torque Reserve for Fan 1 running" VALUE 0x8054F08C RB_Val_Ws32 21474836.4700 Time_s 0.00 21474836.4700 FORMAT "%13.4" EXTENDED_LIMITS -21474836.4800 21474836.4700 /end CHARACTERISTIC
/begin CHARACTERISTIC Fans_tiTrqResvFan2_C "Time Delay Off of static Torque Reserve for Fan 2 running" VALUE 0x8054F090 RB_Val_Ws32 21474836.4700 Time_s 0.00 21474836.4700 FORMAT "%13.4" EXTENDED_LIMITS -21474836.4800 21474836.4700 /end CHARACTERISTIC
/begin CHARACTERISTIC Fans_tiTrqResvFltFan1_C "Time Delay for Filtering of static Torque Reserve of Fan 1" VALUE 0x8054F094 RB_Val_Ws32 4294.9672940000000 TimeDelay_s 0.0000020000000 4294.9672959999998 FORMAT "%19.14" EXTENDED_LIMITS 0.000002000000001 4294.9672959999998 /end CHARACTERISTIC
/begin CHARACTERISTIC Fans_tiTrqResvFltFan2_C "Time Delay for Filtering of static Torque Reserve of Fan 2" VALUE 0x8054F098 RB_Val_Ws32 4294.9672940000000 TimeDelay_s 0.0000020000000 4294.9672959999998 FORMAT "%19.14" EXTENDED_LIMITS 0.000002000000001 4294.9672959999998 /end CHARACTERISTIC
/begin CHARACTERISTIC Fans_trqConsFan1_CUR "Mapping between PWM signal of Fan_r and the resulting static torque consumed for Fan 1" CURVE 0x8054F09C RB_Curve_S16_S16 6553.500 Trq -3276.800 3276.700 FORMAT "%8.3"
 /begin AXIS_DESCR STD_AXIS Fan_r Prc 2 -400.0000 399.9878 FORMAT "%8.4" DEPOSIT ABSOLUTE /end AXIS_DESCR
/end CHARACTERISTIC
/begin CHARACTERISTIC Fans_trqConsFan2_CUR "Mapping between PWM signal of Fan_r and the resulting static torque consumed for Fan 2" CURVE 0x8054F0A6 RB_Curve_S16_S16 6553.500 Trq -3276.800 3276.700 FORMAT "%8.3"
 /begin AXIS_DESCR STD_AXIS Fan_r2 Prc 2 -400.0000 399.9878 FORMAT "%8.4" DEPOSIT ABSOLUTE /end AXIS_DESCR
/end CHARACTERISTIC
/begin CHARACTERISTIC Fans_trqResvFan1_C "Reserve Torque Consumed for Fan 1" VALUE 0x8054F0B0 RB_Val_Ws16 6553.500 Trq -3276.800 3276.700 FORMAT "%8.3" /end CHARACTERISTIC
/begin CHARACTERISTIC Fans_trqResvFan1_CUR "Curve to determine the equivalent torque as per the request for Fan 1" CURVE 0x8054F0B2 RB_Curve_S16_S16 6553.500 Trq -3276.800 3276.700 FORMAT "%8.3"
 /begin AXIS_DESCR STD_AXIS Epm_nEng EngN 4 -16384.00 16383.50 FORMAT "%8.2" DEPOSIT ABSOLUTE /end AXIS_DESCR
/end CHARACTERISTIC
/begin CHARACTERISTIC Fans_trqResvFan2_C "Reserve Torque Consumed for Fan 2" VALUE 0x8054F0C4 RB_Val_Ws16 6553.500 Trq -3276.800 3276.700 FORMAT "%8.3" /end CHARACTERISTIC
/begin CHARACTERISTIC Fans_trqResvFan2_CUR "Curve to determine the equivalent torque as per the request for fan 2" CURVE 0x8054F0C6 RB_Curve_S16_S16 6553.500 Trq -3276.800 3276.700 FORMAT "%8.3"
 /begin AXIS_DESCR STD_AXIS Epm_nEng EngN 4 -16384.00 16383.50 FORMAT "%8.2" DEPOSIT ABSOLUTE /end AXIS_DESCR
/end CHARACTERISTIC
/begin CHARACTERISTIC Fan_DigOut0.tiBtwTstSCB_C "Structure containing parameters for Digital output power stage error handling for Fan / Time between tests for SCB error" VALUE 0x80590EE4 Kw_Ws16 1000.000 Time_ms 0.00 1000.000 FORMAT "%8.3" EXTENDED_LIMITS -327680.0 327670.0 /end CHARACTERISTIC
/begin CHARACTERISTIC Fan_DigOut0.tiBtwTstOT_C "Structure containing parameters for Digital output power stage error handling for Fan / Time between tests for OT error" VALUE 0x80590EE6 Kw_Ws16 100.0000 Time_s 0.00 100.0000 FORMAT "%8.4" EXTENDED_LIMITS -327.6800 327.6700 /end CHARACTERISTIC
/begin CHARACTERISTIC Fan_DigOut0.numTstMax_C "Structure containing parameters for Digital output power stage error handling for Fan / Maximum number of tests allowed on permanent defect" VALUE 0x80590EE8 Kw_Wu16 65535.00 OneToOne 0.00 65535.00 FORMAT "%8.2" /end CHARACTERISTIC
/begin CHARACTERISTIC Fan_DigOut1.tiBtwTstSCB_C "Structure containing parameters for Digital output power stage error handling for Fan / Time between tests for SCB error" VALUE 0x80590EEA Kw_Ws16 1000.000 Time_ms 0.00 1000.000 FORMAT "%8.3" EXTENDED_LIMITS -327680.0 327670.0 /end CHARACTERISTIC
/begin CHARACTERISTIC Fan_DigOut1.tiBtwTstOT_C "Structure containing parameters for Digital output power stage error handling for Fan / Time between tests for OT error" VALUE 0x80590EEC Kw_Ws16 100.0000 Time_s 0.00 100.0000 FORMAT "%8.4" EXTENDED_LIMITS -327.6800 327.6700 /end CHARACTERISTIC
/begin CHARACTERISTIC Fan_DigOut1.numTstMax_C "Structure containing parameters for Digital output power stage error handling for Fan / Maximum number of tests allowed on permanent defect" VALUE 0x80590EEE Kw_Wu16 65535.00 OneToOne 0.00 65535.00 FORMAT "%8.2" /end CHARACTERISTIC
/begin CHARACTERISTIC Fan_rHysHi_CA "High threshold of hysterisis to set digital fan power stage output to true" VAL_BLK 0x80590EF0 ValA_Ws16 799.9878 Prc -400.0000 399.9878 FORMAT "%8.4" NUMBER 2 /end CHARACTERISTIC
/begin CHARACTERISTIC Fan_rHysLo_CA "Low threshold of hysterisis to set digital fan power stage output to true" VAL_BLK 0x80590EF4 ValA_Ws16 799.9878 Prc -400.0000 399.9878 FORMAT "%8.4" NUMBER 2 /end CHARACTERISTIC
/begin CHARACTERISTIC Fan_stPsDiaDisblDIO_CA "aplication array for disabling the digital fan compressor powerstage diagnosis" VAL_BLK 0x80590EF8 ValA_Wu16 65535.00 OneToOne 0.00 65535.00 FORMAT "%8.2" NUMBER 2 /end CHARACTERISTIC
/begin CHARACTERISTIC Fan_stPsDisDIO_CA "aplication array for disabling the digital fan compressor powerstage" VAL_BLK 0x80590EFC ValA_Wu16 65535.00 OneToOne 0.00 65535.00 FORMAT "%8.2" NUMBER 2 /end CHARACTERISTIC
/begin CHARACTERISTIC FfPrm_facCorrnSpd_C "ramp speed for fuel adaptation factor integrator at correction method" VALUE 0x8054F0E2 RB_Val_Wu16 4.999924 q7p63Em5_DIV_s 0.00 4.999924 FORMAT "%8.6" /end CHARACTERISTIC
/begin CHARACTERISTIC FfPrm_facFuAdpnMax_C "Maximum value of fuel adaptation factor in initialization" VALUE 0x8054F0E4 RB_Val_Wu16 1.999969 fak_uw_b2 0.00 1.999969 FORMAT "%8.6" /end CHARACTERISTIC
/begin CHARACTERISTIC FfPrm_facFuAdpnMin_C "Minimum value of ffuel adpatation factor in initialization" VALUE 0x8054F0E6 RB_Val_Wu16 1.999969 fak_uw_b2 0.00 1.999969 FORMAT "%8.6" /end CHARACTERISTIC
/begin CHARACTERISTIC FfPrm_facFuNeut_C "fuel adaptation factor default value in medium range" VALUE 0x8054F0E8 RB_Val_Wu16 1.999969 fak_uw_b2 0.00 1.999969 FORMAT "%8.6" /end CHARACTERISTIC
/begin CHARACTERISTIC FfPrm_facFuToEth_C "constant for calculation ffuel to fethmnmx" VALUE 0x8054F0D8 RB_Val_Wu16 1.999939 fak_uw_b2 0.000031 1.999969 FORMAT "%8.6" EXTENDED_LIMITS 0.00 1.999969 /end CHARACTERISTIC
/begin CHARACTERISTIC FfPrm_percEthMax_C "Maximum ethanol content (vol.-) of fuels at considered market" VALUE 0x8054F0DA RB_Val_Wu16 100.0000 rel_uw_b200 0.00 100.0000 FORMAT "%8.4" EXTENDED_LIMITS 0.00 199.9969 /end CHARACTERISTIC
/begin CHARACTERISTIC FfPrm_percEthMin_C "Minimum ethanol content (vol.-) of fuels at considered market" VALUE 0x8054F0DC RB_Val_Wu16 100.0000 rel_uw_b200 0.00 100.0000 FORMAT "%8.4" EXTENDED_LIMITS 0.00 199.9969 /end CHARACTERISTIC
/begin CHARACTERISTIC FfPrm_perEthImpsOBD_C "Ethanol percentage to be shown on PID52 in case of ethanol sensor failure." VALUE 0x8054F0DE RB_Val_Wu8 100.0 rel_q0p392 0.00 100.0 FORMAT "%5.1" /end CHARACTERISTIC
/begin CHARACTERISTIC FfPrm_stCfgFuAdpn_C "Configuration for Fuel Adaptation Function" VALUE 0x8054F0EA RB_Val_Wu8 255.0 dez 0.00 255.0 FORMAT "%5.1" /end CHARACTERISTIC
/begin CHARACTERISTIC FfPrm_stEna_C "Codeword FlexFuel vehicle" VALUE 0x8054F0DF RB_Val_Wu8 255.0 OneToOne 0.00 255.0 FORMAT "%5.1" /end CHARACTERISTIC
/begin CHARACTERISTIC FfPrm_stEthCalcCfg_C "codeword configuration BGFETH" VALUE 0x8054F0E0 RB_Val_Wu8 255.0 OneToOne 0.00 255.0 FORMAT "%5.1" /end CHARACTERISTIC
/begin CHARACTERISTIC FfPrm_tiProdModEnd_C "Time after primal fueling finished to disable Production Mode" VALUE 0x8054F0E1 RB_Val_Wu8 51.00 t_q0p2 0.00 51.00 FORMAT "%5.2" /end CHARACTERISTIC
/begin CHARACTERISTIC TExhVlvMdl_CorrnIgnAgB1_I.facCorrnIgnAgCatHeatg_M "Ignition angle correction for the gas temperature, Bank 1 / Input class for Ignition angle correction" MAP 0x8054D42C RB_Map_U8U16_U16 1.999969 fak_uw_b2 0.00 1.999969 FORMAT "%8.6"
 /begin AXIS_DESCR STD_AXIS NO_INPUT_QUANTITY rel_ub_b127p5 8 0.00 127.5 FORMAT "%5.1" DEPOSIT ABSOLUTE /end AXIS_DESCR
 /begin AXIS_DESCR STD_AXIS NO_INPUT_QUANTITY m_uw_b6553p5 8 0.00 6553.500 FORMAT "%8.3" DEPOSIT ABSOLUTE /end AXIS_DESCR
/end CHARACTERISTIC
/begin CHARACTERISTIC TExhVlvMdl_CorrnIgnAgB1_I.facCorrnIgnAgHomSecFu_M "Ignition angle correction for the gas temperature, Bank 1 / Input class for Ignition angle correction" MAP 0x8054D4C6 RB_Map_U8U16_U16 1.999969 fak_uw_b2 0.00 1.999969 FORMAT "%8.6"
 /begin AXIS_DESCR STD_AXIS NO_INPUT_QUANTITY rel_ub_b127p5 8 0.00 127.5 FORMAT "%5.1" DEPOSIT ABSOLUTE /end AXIS_DESCR
 /begin AXIS_DESCR STD_AXIS NO_INPUT_QUANTITY m_uw_b6553p5 8 0.00 6553.500 FORMAT "%8.3" DEPOSIT ABSOLUTE /end AXIS_DESCR
/end CHARACTERISTIC
/begin CHARACTERISTIC TExhVlvMdl_CorrnIgnAgB1_I.facCorrnIgnAgHom_M "Ignition angle correction for the gas temperature, Bank 1 / Input class for Ignition angle correction" MAP 0x8054D560 RB_Map_U8U16_U16 1.999969 fak_uw_b2 0.00 1.999969 FORMAT "%8.6"
 /begin AXIS_DESCR STD_AXIS NO_INPUT_QUANTITY rel_ub_b127p5 8 0.00 127.5 FORMAT "%5.1" DEPOSIT ABSOLUTE /end AXIS_DESCR
 /begin AXIS_DESCR STD_AXIS NO_INPUT_QUANTITY m_uw_b6553p5 8 0.00 6553.500 FORMAT "%8.3" DEPOSIT ABSOLUTE /end AXIS_DESCR
/end CHARACTERISTIC
/begin CHARACTERISTIC TExhVlvMdl_CorrnIgnAgB1_I.facCorrnIgnAgHom_T "Ignition angle correction for the gas temperature, Bank 1 / Input class for Ignition angle correction" CURVE 0x8054D5FA RB_Curve_U8_U16_Static 1.999969 fak_uw_b2 0.00 1.999969 FORMAT "%8.6"
 /begin AXIS_DESCR STD_AXIS NO_INPUT_QUANTITY rel_ub_b127p5 6 0.00 127.5 FORMAT "%5.1" DEPOSIT ABSOLUTE /end AXIS_DESCR
/end CHARACTERISTIC
/begin CHARACTERISTIC TExhVlvMdl_CorrnIgnAgB1_I.facCorrnIgnAgHspCatHeatSust_M "Ignition angle correction for the gas temperature, Bank 1 / Input class for Ignition angle correction" MAP 0x8054D60E RB_Map_U8U16_U16 1.999969 fak_uw_b2 0.00 1.999969 FORMAT "%8.6"
 /begin AXIS_DESCR STD_AXIS NO_INPUT_QUANTITY rel_ub_b127p5 8 0.00 127.5 FORMAT "%5.1" DEPOSIT ABSOLUTE /end AXIS_DESCR
 /begin AXIS_DESCR STD_AXIS NO_INPUT_QUANTITY m_uw_b6553p5 8 0.00 6553.500 FORMAT "%8.3" DEPOSIT ABSOLUTE /end AXIS_DESCR
/end CHARACTERISTIC
/begin CHARACTERISTIC TExhVlvMdl_CorrnIgnAgB1_I.facCorrnIgnAgHspCatHeatSust_T "Ignition angle correction for the gas temperature, Bank 1 / Input class for Ignition angle correction" CURVE 0x8054D6A8 RB_Curve_U8_U16_Static 1.999969 fak_uw_b2 0.00 1.999969 FORMAT "%8.6"
 /begin AXIS_DESCR STD_AXIS NO_INPUT_QUANTITY rel_ub_b127p5 6 0.00 127.5 FORMAT "%5.1" DEPOSIT ABSOLUTE /end AXIS_DESCR
/end CHARACTERISTIC
/begin CHARACTERISTIC TExhVlvMdl_CorrnIgnAgB1_I.facCorrnIgnAgHspCatHeatg_T "Ignition angle correction for the gas temperature, Bank 1 / Input class for Ignition angle correction" CURVE 0x8054D6BC RB_Curve_U8_U16_Static 1.999969 fak_uw_b2 0.00 1.999969 FORMAT "%8.6"
 /begin AXIS_DESCR STD_AXIS NO_INPUT_QUANTITY rel_ub_b127p5 6 0.00 127.5 FORMAT "%5.1" DEPOSIT ABSOLUTE /end AXIS_DESCR
/end CHARACTERISTIC
/begin CHARACTERISTIC TExhVlvMdl_CorrnIgnAgB1_I.facCorrnIgnAgHspRgn_M "Ignition angle correction for the gas temperature, Bank 1 / Input class for Ignition angle correction" MAP 0x8054D6D0 RB_Map_U8U16_U16 1.999969 fak_uw_b2 0.00 1.999969 FORMAT "%8.6"
 /begin AXIS_DESCR STD_AXIS NO_INPUT_QUANTITY rel_ub_b127p5 8 0.00 127.5 FORMAT "%5.1" DEPOSIT ABSOLUTE /end AXIS_DESCR
 /begin AXIS_DESCR STD_AXIS NO_INPUT_QUANTITY m_uw_b6553p5 8 0.00 6553.500 FORMAT "%8.3" DEPOSIT ABSOLUTE /end AXIS_DESCR
/end CHARACTERISTIC
/begin CHARACTERISTIC TExhVlvMdl_CorrnIgnAgB1_I.facCorrnIgnAgHsp_M "Ignition angle correction for the gas temperature, Bank 1 / Input class for Ignition angle correction" MAP 0x8054D76A RB_Map_U8U16_U16 1.999969 fak_uw_b2 0.00 1.999969 FORMAT "%8.6"
 /begin AXIS_DESCR STD_AXIS NO_INPUT_QUANTITY rel_ub_b127p5 8 0.00 127.5 FORMAT "%5.1" DEPOSIT ABSOLUTE /end AXIS_DESCR
 /begin AXIS_DESCR STD_AXIS NO_INPUT_QUANTITY m_uw_b6553p5 8 0.00 6553.500 FORMAT "%8.3" DEPOSIT ABSOLUTE /end AXIS_DESCR
/end CHARACTERISTIC
/begin CHARACTERISTIC TExhVlvMdl_CorrnIgnAgB1_I.facCorrnIgnAgHsp_T "Ignition angle correction for the gas temperature, Bank 1 / Input class for Ignition angle correction" CURVE 0x8054D804 RB_Curve_U8_U16_Static 1.999969 fak_uw_b2 0.00 1.999969 FORMAT "%8.6"
 /begin AXIS_DESCR STD_AXIS NO_INPUT_QUANTITY rel_ub_b127p5 6 0.00 127.5 FORMAT "%5.1" DEPOSIT ABSOLUTE /end AXIS_DESCR
/end CHARACTERISTIC
/begin CHARACTERISTIC TExhVlvMdl_CorrnIgnAgB1_I.facCorrnIgnAgSecFu_T "Ignition angle correction for the gas temperature, Bank 1 / Input class for Ignition angle correction" CURVE 0x8054D818 RB_Curve_U8_U16_Static 1.999969 fak_uw_b2 0.00 1.999969 FORMAT "%8.6"
 /begin AXIS_DESCR STD_AXIS NO_INPUT_QUANTITY rel_ub_b127p5 6 0.00 127.5 FORMAT "%5.1" DEPOSIT ABSOLUTE /end AXIS_DESCR
/end CHARACTERISTIC
/begin CHARACTERISTIC TExhVlvMdl_CorrnIgnAgB1_I.offsCorrnIgnAgHom_M "Ignition angle correction for the gas temperature, Bank 1 / Input class for Ignition angle correction" MAP 0x8054D82C RB_Map_S16U16_S16 1535.977 temp_q0p0234 -768.0000 767.9766 FORMAT "%8.4"
 /begin AXIS_DESCR STD_AXIS NO_INPUT_QUANTITY nmot_q0p5 11 -16384.00 16383.50 FORMAT "%8.2" DEPOSIT ABSOLUTE /end AXIS_DESCR
 /begin AXIS_DESCR STD_AXIS NO_INPUT_QUANTITY rel_q0p0234 11 0.00 1535.977 FORMAT "%8.3" DEPOSIT ABSOLUTE /end AXIS_DESCR
/end CHARACTERISTIC
/begin CHARACTERISTIC TExhVlvMdl_CorrnIgnAgB1_I.offsCorrnIgnAgHspCatHeatSust_M "Ignition angle correction for the gas temperature, Bank 1 / Input class for Ignition angle correction" MAP 0x8054D94E RB_Map_S16U16_S16 1535.977 temp_q0p0234 -768.0000 767.9766 FORMAT "%8.4"
 /begin AXIS_DESCR STD_AXIS NO_INPUT_QUANTITY nmot_q0p5 11 -16384.00 16383.50 FORMAT "%8.2" DEPOSIT ABSOLUTE /end AXIS_DESCR
 /begin AXIS_DESCR STD_AXIS NO_INPUT_QUANTITY rel_q0p0234 11 0.00 1535.977 FORMAT "%8.3" DEPOSIT ABSOLUTE /end AXIS_DESCR
/end CHARACTERISTIC
/begin CHARACTERISTIC TExhVlvMdl_CorrnIgnAgB1_I.offsCorrnIgnAgHspCatHeatg_M "Ignition angle correction for the gas temperature, Bank 1 / Input class for Ignition angle correction" MAP 0x8054DA70 RB_Map_S16U16_S16 1535.977 temp_q0p0234 -768.0000 767.9766 FORMAT "%8.4"
 /begin AXIS_DESCR STD_AXIS NO_INPUT_QUANTITY nmot_q0p5 11 -16384.00 16383.50 FORMAT "%8.2" DEPOSIT ABSOLUTE /end AXIS_DESCR
 /begin AXIS_DESCR STD_AXIS NO_INPUT_QUANTITY rel_q0p0234 11 0.00 1535.977 FORMAT "%8.3" DEPOSIT ABSOLUTE /end AXIS_DESCR
/end CHARACTERISTIC
/begin CHARACTERISTIC TExhVlvMdl_CorrnIgnAgB1_I.offsCorrnIgnAgHsp_M "Ignition angle correction for the gas temperature, Bank 1 / Input class for Ignition angle correction" MAP 0x8054DB92 RB_Map_S16U16_S16 1535.977 temp_q0p0234 -768.0000 767.9766 FORMAT "%8.4"
 /begin AXIS_DESCR STD_AXIS NO_INPUT_QUANTITY nmot_q0p5 11 -16384.00 16383.50 FORMAT "%8.2" DEPOSIT ABSOLUTE /end AXIS_DESCR
 /begin AXIS_DESCR STD_AXIS NO_INPUT_QUANTITY rel_q0p0234 11 0.00 1535.977 FORMAT "%8.3" DEPOSIT ABSOLUTE /end AXIS_DESCR
/end CHARACTERISTIC
/begin CHARACTERISTIC TExhVlvMdl_CorrnIgnAgB1_I.offsCorrnIgnAgSecFu_M "Ignition angle correction for the gas temperature, Bank 1 / Input class for Ignition angle correction" MAP 0x8054DCB4 RB_Map_S16U16_S16 1535.977 temp_q0p0234 -768.0000 767.9766 FORMAT "%8.4"
 /begin AXIS_DESCR STD_AXIS NO_INPUT_QUANTITY nmot_q0p5 11 -16384.00 16383.50 FORMAT "%8.2" DEPOSIT ABSOLUTE /end AXIS_DESCR
 /begin AXIS_DESCR STD_AXIS NO_INPUT_QUANTITY rel_q0p0234 11 0.00 1535.977 FORMAT "%8.3" DEPOSIT ABSOLUTE /end AXIS_DESCR
/end CHARACTERISTIC
/begin MEASUREMENT B_ethadap_msg "adaptation of ethanol content active" UBYTE B_TRUE 1 100 0.00 1.00000000000 BIT_MASK 0x1 FORMAT "%13.11" ECU_ADDRESS 0x70000BE0 /end MEASUREMENT
/begin MEASUREMENT B_ethg_msg "ethanol content valid" UBYTE B_TRUE 1 100 0.00 1.00000000000 BIT_MASK 0x1 FORMAT "%13.11" ECU_ADDRESS 0x70000BDF /end MEASUREMENT
/begin MEASUREMENT B_ethhte_msg "hight tolerance in ethanol content calculation expected" UBYTE B_TRUE 1 100 0.00 1.00000000000 BIT_MASK 0x1 FORMAT "%13.11" ECU_ADDRESS 0x70000BDE /end MEASUREMENT
/begin MEASUREMENT B_ethqadap_msg "quick adaptation of ethanol content active" UBYTE B_TRUE 1 100 0.00 1.00000000000 BIT_MASK 0x1 FORMAT "%13.11" ECU_ADDRESS 0x70000BDD /end MEASUREMENT
/begin MEASUREMENT B_ffuelnw_msg "Condition adaptation to neutral value" UBYTE B_TRUE 1 100 0.00 1.00000000000 BIT_MASK 0x1 FORMAT "%13.11" ECU_ADDRESS 0x70000BC6 /end MEASUREMENT
/begin MEASUREMENT B_ffuelrp_msg "ramp for ffuel correction active" UBYTE B_TRUE 1 100 0.00 1.00000000000 BIT_MASK 0x1 FORMAT "%13.11" ECU_ADDRESS 0x70000BC5 /end MEASUREMENT
/begin MEASUREMENT B_garesf_msg "Condition mixture adaptation reset due to errors" UBYTE B_TRUE 1 100 0.00 1.00000000000 BIT_MASK 0x1 FORMAT "%13.11" ECU_ADDRESS 0x70000BB1 /end MEASUREMENT
/begin MEASUREMENT ExhMod_bStrtEndOffActiveLst "local Bit: start-end off-time in hold mode (bit start end active)" UBYTE B_TRUE 1 100 0.00 1.00000000000 BIT_MASK 0x1 FORMAT "%13.11" ECU_ADDRESS 0x6000B089 /end MEASUREMENT
/begin MEASUREMENT ExhMod_cntrMplBrB1 "Counter for the calibrated multi-bricks in exhaust system bank 1" UBYTE dez 1 100 0.00 255.0 FORMAT "%5.1" ECU_ADDRESS 0x6000B086 /end MEASUREMENT
/begin MEASUREMENT ExhMod_cntrStrtEndOffRstLst "local reset-counter of engine of engine off time based on start-end" UBYTE OneToOne 1 100 0.00 255.0 FORMAT "%5.1" ECU_ADDRESS 0x600365F4 /end MEASUREMENT
/begin MEASUREMENT ExhMod_concMH2oAryWtrMdlB1 "mass concentration H2O array water modell, bank 1" UWORD fak_uw_b0p5 1 100 0.00 0.4999924 FORMAT "%9.7" ARRAY_SIZE 12 ECU_ADDRESS 0x60000F5A /end MEASUREMENT
/begin MEASUREMENT ExhMod_concMH2oEgrUsB1 "Water mass concentration upstream EGR Bank1" UWORD fak_uw_b0p5 1 100 0.00 0.4999924 FORMAT "%9.7" ECU_ADDRESS 0x600086EE /end MEASUREMENT
/begin MEASUREMENT ExhMod_effIgnAgAvrgB1 "average efficency depending on ignition angle bank 1" UBYTE rel_ub_b127p5 1 100 0.00 127.5 FORMAT "%5.1" ECU_ADDRESS 0x6000EF94 /end MEASUREMENT
/begin MEASUREMENT ExhMod_effIgnAgAvrgBas "average efficency depending on ignition angle" UBYTE rel_ub_b127p5 1 100 0.00 127.5 FORMAT "%5.1" ECU_ADDRESS 0x6000B08D /end MEASUREMENT
/begin MEASUREMENT ExhMod_facCorrnTExhVlvIgnAgB1 "Correction factor for stationary temperature dependent on ignition angle B1" UWORD fak_uw_b2 1 100 0.00 1.999969 FORMAT "%8.6" ECU_ADDRESS 0x600086CA /end MEASUREMENT
/begin MEASUREMENT ExhMod_facCorrnTExhVlvIgnAgB2 "Correction factor for stationary temperature dependent on ignition angle B2" UWORD fak_uw_b2 1 100 0.00 1.999969 FORMAT "%8.6" ECU_ADDRESS 0x600086C8 /end MEASUREMENT
/begin MEASUREMENT ExhMod_facCorrnTExhVlvIgnAgBasB1 "Correction factor for stationary temperature dependent on base ignition angle efficiency B1" UWORD fak_uw_b2 1 100 0.00 1.999969 FORMAT "%8.6" ECU_ADDRESS 0x600086C6 /end MEASUREMENT
/begin MEASUREMENT ExhMod_facCorrnTExhVlvIgnAgBasB2 "Correction factor for stationary temperature dependent on base ignition angle efficiency B2" UWORD fak_uw_b2 1 100 0.00 1.999969 FORMAT "%8.6" ECU_ADDRESS 0x600086C4 /end MEASUREMENT
/begin MEASUREMENT ExhMod_facCorrnTExhVlvLamB1 "Correction factor for stationary temperature dependent on lambada B1" UWORD fak_uw_b2 1 100 0.00 1.999969 FORMAT "%8.6" ECU_ADDRESS 0x600086C2 /end MEASUREMENT
/begin MEASUREMENT ExhMod_facCorrnTExhVlvLamB2 "Correction factor for stationary temperature dependent on lambda B2" UWORD fak_uw_b2 1 100 0.00 1.999969 FORMAT "%8.6" ECU_ADDRESS 0x600086C0 /end MEASUREMENT
/begin MEASUREMENT ExhMod_facEgyThdTspS1B1 "reduction factor of heat quantity threshold for dew-point end detection for TSP sensor 1 bank 1" UBYTE fak_ub_b2 1 100 0.00 1.000000 FORMAT "%8.6" ECU_ADDRESS 0x6000B071 /end MEASUREMENT
/begin MEASUREMENT ExhMod_facEgyThdTspS2B1 "reduction factor of heat quantity threshold for dew-point end detection for TSP sensor 2 bank 1" UBYTE fak_ub_b2 1 100 0.00 1.000000 FORMAT "%8.6" ECU_ADDRESS 0x6000B070 /end MEASUREMENT
/begin MEASUREMENT ExhMod_facIaActB1 "Ignition angle efficiency -local value for exhmod" UWORD fak_uw_b2 1 100 0.00 1.999969 FORMAT "%8.6" ECU_ADDRESS 0x60006E2A /end MEASUREMENT
/begin MEASUREMENT ExhMod_facIntrpnGslSecFu "interpolation factor gasoline secondary fuel" UWORD fak_uw_b2 1 100 0.00 1.999969 FORMAT "%8.6" ECU_ADDRESS 0x600086B2 /end MEASUREMENT
/begin MEASUREMENT ExhMod_facTExhVlvCorrnRriB1 "Correction factor based on inert gas rate bank 1" UWORD fak_uw_b2 1 100 0.00 1.999969 FORMAT "%8.6" ECU_ADDRESS 0x60006E28 /end MEASUREMENT
/begin MEASUREMENT ExhMod_flgCatHtgColdStrtTsp "flag catalyst heating cold start for TSP sensors detected" UBYTE B_TRUE 1 100 0.00 1.00000000000 BIT_MASK 0x1 FORMAT "%13.11" ECU_ADDRESS 0x70000262 /end MEASUREMENT
/begin MEASUREMENT ExhMod_flgCcoB1 "Status flag for cylinder cut-off bank 1" UBYTE B_TRUE 1 100 0.00 1.00000000000 BIT_MASK 0x1 FORMAT "%13.11" ECU_ADDRESS 0x6000B08C /end MEASUREMENT
/begin MEASUREMENT ExhMod_flgCondsAryB1 "bit condensation array bank 1" UBYTE B_TRUE 1 100 0.00 1.00000000000 FORMAT "%13.11" ARRAY_SIZE 12 ECU_ADDRESS 0x60000F4E /end MEASUREMENT
/begin MEASUREMENT ExhMod_flgCorrnTExhVlvSeln "Flag for selection of correction strategy between offset and factor based." UBYTE B_TRUE 1 100 0.00 1.00000000000 BIT_MASK 0x1 FORMAT "%13.11" ECU_ADDRESS 0x6000EE4D /end MEASUREMENT
/begin MEASUREMENT ExhMod_flgDewPntEndRstTspS1B1 "flag reset dew-point end for thermal shock protected sensor 1" UBYTE B_TRUE 1 100 0.00 1.00000000000 BIT_MASK 0x1 FORMAT "%13.11" ECU_ADDRESS 0x7000095E /end MEASUREMENT
/begin MEASUREMENT ExhMod_flgDewPntEndRstTspS2B1 "flag reset dew-point end for TSP sensor 2" UBYTE B_TRUE 1 100 0.00 1.00000000000 BIT_MASK 0x1 FORMAT "%13.11" ECU_ADDRESS 0x70000261 /end MEASUREMENT
/begin MEASUREMENT ExhMod_flgEngRunngTiEngOff "Engine-running-status corresponding to the engine off time used in ExhMod" UBYTE B_TRUE 1 100 0.00 1.00000000000 BIT_MASK 0x1 FORMAT "%13.11" ECU_ADDRESS 0x70000958 /end MEASUREMENT
/begin MEASUREMENT ExhMod_flgEngRunngTiEngOffRaw "Engine-running-status corresponding to the engine off time used in ExhMod (raw value)" UBYTE B_TRUE 1 100 0.00 1.00000000000 BIT_MASK 0x1 FORMAT "%13.11" ECU_ADDRESS 0x70000263 /end MEASUREMENT
/begin MEASUREMENT ExhMod_flgFrstEngRunng "Flag to indicate that the engine was running atleast once" UBYTE B_TRUE 1 100 0.00 1.00000000000 BIT_MASK 0x1 FORMAT "%13.11" ECU_ADDRESS 0x6000B079 /end MEASUREMENT
/begin MEASUREMENT ExhMod_flgHeatgTspS1B1 "flag reduced heat quantity threshold for TSP(Thermal shock protection) sensor 1 reached" UBYTE B_TRUE 1 100 0.00 1.00000000000 BIT_MASK 0x1 FORMAT "%13.11" ECU_ADDRESS 0x70000953 /end MEASUREMENT
/begin MEASUREMENT ExhMod_flgHeatgTspS2B1 "flag reduced heat quantity threshold for thermal shock protected sensor 2 reached" UBYTE B_TRUE 1 100 0.00 1.00000000000 BIT_MASK 0x1 FORMAT "%13.11" ECU_ADDRESS 0x70000952 /end MEASUREMENT
/begin MEASUREMENT ExhMod_flgHiVlvlft "Flag high valve lift" UBYTE B_TRUE 1 100 0.00 1.00000000000 BIT_MASK 0x1 FORMAT "%13.11" ECU_ADDRESS 0x70000265 /end MEASUREMENT
/begin MEASUREMENT ExhMod_flgIninSepCanngActv "Flag to indicate if seperate canning is active for TMdl initialisation" UBYTE B_TRUE 1 100 0.00 1.00000000000 BIT_MASK 0x1 FORMAT "%13.11" ECU_ADDRESS 0x6000B084 /end MEASUREMENT
/begin MEASUREMENT ExhMod_flgInvldNvVal "Flag to indicate if non-volatile values are invalid" UBYTE B_TRUE 1 100 0.00 1.00000000000 BIT_MASK 0x1 FORMAT "%13.11" ECU_ADDRESS 0x60036DCC /end MEASUREMENT
/begin MEASUREMENT ExhMod_flgInvldNvValInin "Flag non volatile values are invalid" UBYTE B_TRUE 1 100 0.00 1.00000000000 BIT_MASK 0x1 FORMAT "%13.11" ECU_ADDRESS 0x60039042 /end MEASUREMENT
/begin MEASUREMENT ExhMod_flgMdlCalcnFrcd "Flag to indicate if model calculation is enforced" UBYTE flgMdlCalcnFrcd_Enum_VERB 1 100 0.00 1.00000000000 FORMAT "%13.11" ECU_ADDRESS 0x6000B078 /end MEASUREMENT
/begin MEASUREMENT ExhMod_flgSelnCorrnTExhVlvLoc "Flag for the selection of the correction strategy of the stationary temperature at exhaust valve" UBYTE B_TRUE 1 100 0.00 1.00000000000 BIT_MASK 0x1 FORMAT "%13.11" ECU_ADDRESS 0x70000264 /end MEASUREMENT
/begin MEASUREMENT ExhMod_flgSelnTCalcnAftSucInin "Flag to indicate the selection of the temperature calculation after a successful initialization" UBYTE flgSelnTCalcnAftSucInin_Enum_VERB 1 100 0.00 1.00000000000 FORMAT "%13.11" ECU_ADDRESS 0x6000B077 /end MEASUREMENT
/begin MEASUREMENT ExhMod_flgSelnTCalcnDurgEngOff "Flag to indicate the selection of temperature calculation during engine-off state" UBYTE flgSelnTCalcnDurgEngOff_Enum_VERB 1 100 0.00 1.00000000000 FORMAT "%13.11" ECU_ADDRESS 0x6000B076 /end MEASUREMENT
/begin MEASUREMENT ExhMod_flgSepCanngActv "flag separate canning is active" UBYTE B_TRUE 1 100 0.00 1.00000000000 BIT_MASK 0x1 FORMAT "%13.11" ECU_ADDRESS 0x6000B085 /end MEASUREMENT
/begin MEASUREMENT ExhMod_flgStFrstEngRunng "Flag to indicate the status if engine has run already once" UBYTE flgStFrstEngRunng_Enum_VERB 1 100 0.00 1.00000000000 FORMAT "%13.11" ECU_ADDRESS 0x6000B075 /end MEASUREMENT
/begin MEASUREMENT ExhMod_flgStIninSuc "Flag to indicate the status if initialization was successful" UBYTE flgStIninSuc_Enum_VERB 1 100 0.00 1.00000000000 FORMAT "%13.11" ECU_ADDRESS 0x6000B074 /end MEASUREMENT
/begin MEASUREMENT ExhMod_flgStMdlCalcn "Flag to indicate the status of model calculation" UBYTE flgStMdlCalcn_Enum_VERB 1 100 0.00 1.00000000000 FORMAT "%13.11" ECU_ADDRESS 0x6000B073 /end MEASUREMENT
/begin MEASUREMENT ExhMod_flgTiEngOffVld "Validity status of the engine off time used in ExhMod" UBYTE B_TRUE 1 100 0.00 1.00000000000 BIT_MASK 0x1 FORMAT "%13.11" ECU_ADDRESS 0x70000940 /end MEASUREMENT
/begin MEASUREMENT ExhMod_flgTIninCmpl "Statusflag for completion of initialization of modelled temperatures" UBYTE B_TRUE 1 100 0.00 1.00000000000 BIT_MASK 0x1 FORMAT "%13.11" ECU_ADDRESS 0x70000942 /end MEASUREMENT
/begin MEASUREMENT ExhMod_flgTspRelsNoRstS1B1 "flag TSP heat quantity threshold reached this driving cycle S1B1" UBYTE B_TRUE 1 100 0.00 1.00000000000 BIT_MASK 0x1 FORMAT "%13.11" ECU_ADDRESS 0x70000260 /end MEASUREMENT
/begin MEASUREMENT ExhMod_flgTspRelsNoRstS2B1 "flag TSP heat quantity threshold reached this driving cycle S2B1" UBYTE B_TRUE 1 100 0.00 1.00000000000 BIT_MASK 0x1 FORMAT "%13.11" ECU_ADDRESS 0x7000025F /end MEASUREMENT
/begin MEASUREMENT ExhMod_flgVldyEnvTInin "Flag environment temperature validity" UBYTE B_TRUE 1 100 0.00 1.00000000000 BIT_MASK 0x1 FORMAT "%13.11" ECU_ADDRESS 0x6000B083 /end MEASUREMENT
/begin MEASUREMENT ExhMod_htcExhWallBrickB1 "heat transport coefficient exhaust wall and Brick bank 1" SLONG fak_q0p00174_JsK 1 100 -3728270.22222 3728270.22049 FORMAT "%13.5" ARRAY_SIZE 12 ECU_ADDRESS 0x600028C8 /end MEASUREMENT
/begin MEASUREMENT ExhMod_htcWallEnvB1 "Heat transfer coefficient between the wall of the exhaust gas system and the environment bank 1" UWORD fak_q0p00174_JsK 1 100 0.00 113.7760 FORMAT "%8.4" ARRAY_SIZE 12 ECU_ADDRESS 0x50005662 /end MEASUREMENT
/begin MEASUREMENT ExhMod_mfTExhVlvMdlB1 "exhaust gas mass flow at outlet valves" UWORD m_uw_b6553p5 1 100 0.00 6553.500 FORMAT "%8.3" ECU_ADDRESS 0x60006E26 /end MEASUREMENT
/begin MEASUREMENT ExhMod_mH2oAryB1 "array mass of water in exhaust system" FLOAT32_IEEE m_q1_g 1 100 -1.0000E+037 1.0000E+037 FORMAT "%10.4" ARRAY_SIZE 12 ECU_ADDRESS 0x60039010 /end MEASUREMENT
/begin MEASUREMENT ExhMod_offsCorrnTExhVlvEngTB1 "Offset correction for the stationary temperature at exhaust valve depending on the ignition angle efficiency bank 1" SWORD temp_q0p0234 1 100 -768.0000 767.9766 FORMAT "%8.4" ECU_ADDRESS 0x60006E24 /end MEASUREMENT
/begin MEASUREMENT ExhMod_offsCorrnTExhVlvIntkAirB1 "Intake air temperature based offset correction for the stationary temperature at exhaust valve bank 1" SWORD temp_q0p0234 1 100 -768.0000 767.9766 FORMAT "%8.4" ECU_ADDRESS 0x60006E22 /end MEASUREMENT
/begin MEASUREMENT ExhMod_offsTExhVlvCorrnLamB1 "Lambda based offset correction for the gas temperature at exhaust valve bank 1" SWORD temp_q0p0234 1 100 -768.0000 767.9766 FORMAT "%8.4" ECU_ADDRESS 0x60006E20 /end MEASUREMENT
/begin MEASUREMENT ExhMod_pwrCondsAryB1 "array heatflow condensation evaporation bank 1" FLOAT32_IEEE leist_q1_W 1 100 -1.0000E+037 1.0000E+037 FORMAT "%10.4" ARRAY_SIZE 12 ECU_ADDRESS 0x60003830 /end MEASUREMENT
/begin MEASUREMENT ExhMod_ratLamVlvB1 "lambda valve bank 1" UWORD fak_uw_b16 1 100 0.00 15.99976 FORMAT "%8.5" ECU_ADDRESS 0x60006E1E /end MEASUREMENT
/begin MEASUREMENT ExhMod_ratRelAirFuFillgB1 "relative air- or fuelfilling bank 1" UWORD rel_uw_b3072 1 100 0.00 3071.953 FORMAT "%8.3" ECU_ADDRESS 0x60006E1C /end MEASUREMENT
/begin MEASUREMENT ExhMod_stSubOldTspSnsrRels "SyC_stSub last calculation step TspSnsrRels" UBYTE ExeCon_State_02 1 100 0.00 6.00000000000 FORMAT "%13.11" ECU_ADDRESS 0x6000B06F /end MEASUREMENT
/begin MEASUREMENT ExhMod_stTMdlCurrMod "Status of the current mode of the temperature model calculation" UBYTE OneToOne 1 100 0.00 255.0 FORMAT "%5.1" ECU_ADDRESS 0x6000EF86 /end MEASUREMENT
/begin MEASUREMENT ExhMod_stTMdlCurrModLoc "." UBYTE stCurrModTMdl_Mode_Enum_VERB 1 100 0.00 2.00000000000 FORMAT "%13.11" ECU_ADDRESS 0x6000B072 /end MEASUREMENT
/begin MEASUREMENT ExhMod_stTMdlIninCurrModAryB1 "Status of the current mode of the temperature model intialisation bank 1" UBYTE dez 1 100 0.00 5.000 FORMAT "%5.3" ARRAY_SIZE 12 ECU_ADDRESS 0x6000EF7A /end MEASUREMENT
/begin MEASUREMENT ExhMod_tCanngMplBrickAryB1 "Array for the canning temperatures of multi-bricks in bank 1" FLOAT32_IEEE TempC_float 1 100 -273.140 4294967021.860 FORMAT "%13.3" ARRAY_SIZE 18 ECU_ADDRESS 0x60002880 /end MEASUREMENT
/begin MEASUREMENT ExhMod_tCat1AvrgB1 "average temperature catalyst 1" SWORD Temp_Cels 1 100 -3549.940 3003.560 FORMAT "%8.3" ECU_ADDRESS 0x60008908 /end MEASUREMENT
/begin MEASUREMENT ExhMod_tCat1B1 "temperature catalyst 1" SWORD Temp_Cels 1 100 -3549.940 3003.560 FORMAT "%8.3" ECU_ADDRESS 0x60008906 /end MEASUREMENT
/begin MEASUREMENT ExhMod_tCat1EndB1 "Temperature end of catalyst 1" SWORD Temp_Cels 1 100 -3549.940 3003.560 FORMAT "%8.3" ECU_ADDRESS 0x60008904 /end MEASUREMENT
/begin MEASUREMENT ExhMod_tCat1InB1 "Exhaust gas temperature at the start brick of catalyst1 bank1" SWORD Temp_Cels 1 100 -3549.940 3003.560 FORMAT "%8.3" ECU_ADDRESS 0x60008902 /end MEASUREMENT
/begin MEASUREMENT ExhMod_tCat1MaxB1 "maximum temperature catalyst 1" SWORD Temp_Cels 1 100 -3549.940 3003.560 FORMAT "%8.3" ECU_ADDRESS 0x60008900 /end MEASUREMENT
/begin MEASUREMENT ExhMod_tCat1MinB1 "minimum temperature catalyst 1" SWORD Temp_Cels 1 100 -3549.940 3003.560 FORMAT "%8.3" ECU_ADDRESS 0x600088FE /end MEASUREMENT
/begin MEASUREMENT ExhMod_tCat2AvrgB1 "average temperature catalyst 2" SWORD Temp_Cels 1 100 -3549.940 3003.560 FORMAT "%8.3" ECU_ADDRESS 0x600088FC /end MEASUREMENT
/begin MEASUREMENT ExhMod_tCat2B1 "Temperature catalyst 2" SWORD Temp_Cels 1 100 -3549.940 3003.560 FORMAT "%8.3" ECU_ADDRESS 0x600088FA /end MEASUREMENT
/begin MEASUREMENT ExhMod_tCat2EndB1 "Temperature end of catalyst 2" SWORD Temp_Cels 1 100 -3549.940 3003.560 FORMAT "%8.3" ECU_ADDRESS 0x600088F8 /end MEASUREMENT
/begin MEASUREMENT ExhMod_tCat2InB1 "Exhaust gas temperature at the start brick of catalyst2 bank1" SWORD Temp_Cels 1 100 -3549.940 3003.560 FORMAT "%8.3" ECU_ADDRESS 0x600088F6 /end MEASUREMENT
/begin MEASUREMENT ExhMod_tCat2MaxB1 "maximum temperature catalyst 2" SWORD Temp_Cels 1 100 -3549.940 3003.560 FORMAT "%8.3" ECU_ADDRESS 0x600088F4 /end MEASUREMENT
/begin MEASUREMENT ExhMod_tCat2MinB1 "minimum temperature catalyst 2" SWORD Temp_Cels 1 100 -3549.940 3003.560 FORMAT "%8.3" ECU_ADDRESS 0x600088F2 /end MEASUREMENT
/begin MEASUREMENT ExhMod_tCatAryB1 "Array catalyst temperatures" SWORD Temp_Cels 1 100 -3549.940 3003.560 FORMAT "%8.3" ARRAY_SIZE 2 ECU_ADDRESS 0x600088EE /end MEASUREMENT
/begin MEASUREMENT ExhMod_tCatAvrgAryB1 "Array average catalyst temperatures" SWORD Temp_Cels 1 100 -3549.940 3003.560 FORMAT "%8.3" ARRAY_SIZE 2 ECU_ADDRESS 0x600088EA /end MEASUREMENT
/begin MEASUREMENT ExhMod_tCatBrickAryB1 "Array of exhaust gas brick temperatures in catalyst - bank 1" SWORD Temp_Cels 1 100 -3549.940 3003.560 FORMAT "%8.3" ARRAY_SIZE 6 ECU_ADDRESS 0x50005D32 /end MEASUREMENT
/begin MEASUREMENT ExhMod_tCatBrickHiReslAryB1 "Temperature of catalyst brick that is stored in high resolution for Bank 1" FLOAT32_IEEE TempC_float 1 100 -273.140 4294967021.860 FORMAT "%13.3" ARRAY_SIZE 6 ECU_ADDRESS 0x60002868 /end MEASUREMENT
/begin MEASUREMENT ExhMod_tCatBrickIninAryB1 "Array of initialisation temperatures for catalyst bricks bank 1" UWORD temp_q0p0234_o273 1 100 -273.150 1262.827 FORMAT "%8.3" ARRAY_SIZE 6 ECU_ADDRESS 0x60008644 /end MEASUREMENT
/begin MEASUREMENT ExhMod_tCatEndAryB1 "Temperature array for storing catalyst brick end temperatures in B1" SWORD Temp_Cels 1 100 -3549.940 3003.560 FORMAT "%8.3" ARRAY_SIZE 2 ECU_ADDRESS 0x600088E6 /end MEASUREMENT
/begin MEASUREMENT ExhMod_tCatInAryB1 "Exhaust Gas array temeprature of catalyst in Bank1" SWORD Temp_Cels 1 100 -3549.940 3003.560 FORMAT "%8.3" ARRAY_SIZE 2 ECU_ADDRESS 0x600088E2 /end MEASUREMENT
/begin MEASUREMENT ExhMod_tCatMplBrickAryB1 "Array for the brick temperatures of multi-bricks in bank 1" FLOAT32_IEEE TempC_float 1 100 -273.140 4294967021.860 FORMAT "%13.3" ARRAY_SIZE 18 ECU_ADDRESS 0x60002820 /end MEASUREMENT
/begin MEASUREMENT ExhMod_tCatNvAryB1 "temperature catalyst (not volatile) bank 1" UWORD temp_q0p0234_o273 1 100 -273.150 1262.827 FORMAT "%8.3" ARRAY_SIZE 6 ECU_ADDRESS 0x6003905C /end MEASUREMENT
/begin MEASUREMENT ExhMod_tEng "engine temperature, shown in Celsius, internally in Kelvin" SWORD Temp_Cels 1 100 -3549.940 3003.560 FORMAT "%8.3" ECU_ADDRESS 0x600088E0 /end MEASUREMENT
/begin MEASUREMENT ExhMod_tEngCoolt "Engine coolant temperature" SWORD Temp_Cels 1 100 -3549.940 3003.560 FORMAT "%8.3" ECU_ADDRESS 0x60006E1A /end MEASUREMENT
/begin MEASUREMENT ExhMod_tEngInin "Engine temperature for TMdl initialisation" UWORD temp_q0p0234_o273 1 100 -273.150 1262.827 FORMAT "%8.3" ECU_ADDRESS 0x60006DC6 /end MEASUREMENT
/begin MEASUREMENT ExhMod_tEnvInin "ExhMod internal environment temperature" UWORD temp_q0p0234_o273 1 100 -273.150 1262.827 FORMAT "%8.3" ECU_ADDRESS 0x60006DC4 /end MEASUREMENT
/begin MEASUREMENT ExhMod_tExhAryB1 "exhaust gas temperature array" SWORD Temp_Cels 1 100 -3549.940 3003.560 FORMAT "%8.3" ARRAY_SIZE 12 ECU_ADDRESS 0x60013F2C /end MEASUREMENT
/begin MEASUREMENT ExhMod_tExhCat1DsB1 "exhaust gas temperature catalyst 1 downstream" SWORD Temp_Cels 1 100 -3549.940 3003.560 FORMAT "%8.3" ECU_ADDRESS 0x600088DA /end MEASUREMENT
/begin MEASUREMENT ExhMod_tExhCat1UsAvrgB1 "Average exhaust gas temperature upstream catalyst 1" SWORD Temp_Cels 1 100 -3549.940 3003.560 FORMAT "%8.3" ECU_ADDRESS 0x60013F44 /end MEASUREMENT
/begin MEASUREMENT ExhMod_tExhCat1UsB1 "exhaust gas temperature catalyst 1 upstream" SWORD Temp_Cels 1 100 -3549.940 3003.560 FORMAT "%8.3" ECU_ADDRESS 0x600088D8 /end MEASUREMENT
/begin MEASUREMENT ExhMod_tExhCat2DsB1 "exhaust gas temperature catalyst 2 downstream" SWORD Temp_Cels 1 100 -3549.940 3003.560 FORMAT "%8.3" ECU_ADDRESS 0x60013F46 /end MEASUREMENT
/begin MEASUREMENT ExhMod_tExhCat2UsAvrgB1 "Average exhaust gas temperature upstream catalyst 2" SWORD Temp_Cels 1 100 -3549.940 3003.560 FORMAT "%8.3" ECU_ADDRESS 0x600088D6 /end MEASUREMENT
/begin MEASUREMENT ExhMod_tExhCat2UsB1 "exhaust gas temperature catalyst 2 upstream" SWORD Temp_Cels 1 100 -3549.940 3003.560 FORMAT "%8.3" ECU_ADDRESS 0x600088D4 /end MEASUREMENT
/begin MEASUREMENT ExhMod_tExhCatDsAryB1 "Array exhaustgas temperature downstream catalysts" SWORD Temp_Cels 1 100 -3549.940 3003.560 FORMAT "%8.3" ARRAY_SIZE 2 ECU_ADDRESS 0x600088D0 /end MEASUREMENT
/begin MEASUREMENT ExhMod_tExhCatUsAryB1 "Array exhaustgas temperature upstream catalysts" SWORD Temp_Cels 1 100 -3549.940 3003.560 FORMAT "%8.3" ARRAY_SIZE 2 ECU_ADDRESS 0x600088CC /end MEASUREMENT
/begin MEASUREMENT ExhMod_tExhDsVlvB1 "Exhaust gas temperature downstream exhaust valve, modelled" SWORD Temp_Cels 1 100 -3549.940 3003.560 FORMAT "%8.3" ECU_ADDRESS 0x600088CA /end MEASUREMENT
/begin MEASUREMENT ExhMod_tExhFrtPipB1 "Exhaust gas temperature downstream manifold" SWORD Temp_Cels 1 100 -3549.940 3003.560 FORMAT "%8.3" ECU_ADDRESS 0x600088C8 /end MEASUREMENT
/begin MEASUREMENT ExhMod_tExhMnfB1 "Exhaust gas temperature manifold, bank1" SWORD Temp_Cels 1 100 -3549.940 3003.560 FORMAT "%8.3" ECU_ADDRESS 0x600088C6 /end MEASUREMENT
/begin MEASUREMENT ExhMod_tExhMnfQstyB1 "Exhaust gas temperature in exhaust manifold (quasi steady state, high dynamic) - bank 1" SWORD Temp_Cels 1 100 -3549.940 3003.560 FORMAT "%8.3" ECU_ADDRESS 0x600088C4 /end MEASUREMENT
/begin MEASUREMENT ExhMod_tExhMplBrickAryB1 "Array for the gas temperatures of multi-bricks in bank 1" FLOAT32_IEEE TempC_float 1 100 -273.140 4294967021.860 FORMAT "%13.3" ARRAY_SIZE 18 ECU_ADDRESS 0x600027D8 /end MEASUREMENT
/begin MEASUREMENT ExhMod_tExhS1B1 "exhaust gas temperature sensor 1" SWORD Temp_Cels 1 100 -3549.940 3003.560 FORMAT "%8.3" ECU_ADDRESS 0x600088C2 /end MEASUREMENT
/begin MEASUREMENT ExhMod_tExhS2B1 "exhaust gas temperature sensor 2" SWORD Temp_Cels 1 100 -3549.940 3003.560 FORMAT "%8.3" ECU_ADDRESS 0x600088C0 /end MEASUREMENT
/begin MEASUREMENT ExhMod_tExhSnsrAryB1 "exhaust gas temperature array sensors" SWORD Temp_Cels 1 100 -3549.940 3003.560 FORMAT "%8.3" ARRAY_SIZE 2 ECU_ADDRESS 0x600088BC /end MEASUREMENT
/begin MEASUREMENT ExhMod_tExhVlvB1 "exhaust temperature valve bank 1" SWORD Temp_Cels 1 100 -3549.940 3003.560 FORMAT "%8.3" ECU_ADDRESS 0x600088B6 /end MEASUREMENT
/begin MEASUREMENT ExhMod_tExhVlvCcoFcoB1 "Target gas temperature in the cylinder during cylinder cutoff, fuel-cutoff bank 1" UWORD temp_q0p0234_o273 1 100 -273.150 1262.827 FORMAT "%8.3" ECU_ADDRESS 0x60006E18 /end MEASUREMENT
/begin MEASUREMENT ExhMod_tExhVlvCorrdB1 "Corrected temperature at the exhaust valve bank 1" FLOAT32_IEEE TempC_float 1 100 -273.1400 65261.8600 FORMAT "%10.4" ECU_ADDRESS 0x60002994 /end MEASUREMENT
/begin MEASUREMENT ExhMod_tExhVlvCorrdDynB1 "exhaust temperature valve with dynamic correction bank 1" FLOAT32_IEEE TempC_float 1 100 -273.1400 65261.8600 FORMAT "%10.4" ECU_ADDRESS 0x60002990 /end MEASUREMENT
/begin MEASUREMENT ExhMod_tExhVlvCorrdFildB1 "exhaust temperature valve filtered bank 1" UWORD temp_q0p0234_o273 1 100 -273.150 1262.827 FORMAT "%8.3" ECU_ADDRESS 0x60006E16 /end MEASUREMENT
/begin MEASUREMENT ExhMod_tExhVlvCorrdIgnAgB1 "exhaust temperature valve with ignition angle correction bank 1" FLOAT32_IEEE TempC_float 1 100 -273.1400 65261.8600 FORMAT "%10.4" ECU_ADDRESS 0x6000298C /end MEASUREMENT
/begin MEASUREMENT ExhMod_tExhVlvCorrdIntkAirB1 "Stationary temperature at exhaust valve corrected based on the intake air temperature bank 1" FLOAT32_IEEE TempC_float 1 100 -273.1400 65261.8600 FORMAT "%10.4" ECU_ADDRESS 0x60002988 /end MEASUREMENT
/begin MEASUREMENT ExhMod_tExhVlvCorrdLamThrB1 "exhaust temperature valve with lambda or throttle correction bank 1" FLOAT32_IEEE TempC_float 1 100 -273.1400 65261.8600 FORMAT "%10.4" ECU_ADDRESS 0x60002984 /end MEASUREMENT
/begin MEASUREMENT ExhMod_tExhVlvCorrdRriB1 "Stationary gas temperature corrected depending on the inert gas rate bank 1" FLOAT32_IEEE TempC_float 1 100 -273.1400 65261.8600 FORMAT "%10.4" ECU_ADDRESS 0x60002980 /end MEASUREMENT
/begin MEASUREMENT ExhMod_tExhVlvHomB1 "exhaust temperature valve homogenous mode bank 1" SWORD Temp_Cels 1 100 -3549.940 3003.560 FORMAT "%8.3" ECU_ADDRESS 0x60006E14 /end MEASUREMENT
/begin MEASUREMENT ExhMod_tExhVlvHomEgrB1 "exhaust temperature valve homogenous mode with exhaust gas recirculation bank 1" SWORD Temp_Cels 1 100 -3549.940 3003.560 FORMAT "%8.3" ECU_ADDRESS 0x60006E12 /end MEASUREMENT
/begin MEASUREMENT ExhMod_tExhVlvIntkAir "Intake air temperature for the modelling of the temperature at exhaust valve" SWORD Temp_Cels 1 100 -3549.940 3003.560 FORMAT "%8.3" ECU_ADDRESS 0x60006E10 /end MEASUREMENT
/begin MEASUREMENT ExhMod_tExhVlvLocB1 "Stationary exhaust gas temperature at the exhaust valve for local calculations bank 1" FLOAT32_IEEE TempC_float 1 100 -273.1400 65261.8600 FORMAT "%10.4" ECU_ADDRESS 0x6000297C /end MEASUREMENT
/begin MEASUREMENT ExhMod_tiEngOff "engine off time" UWORD t_q1 1 100 0.00 65535.00 FORMAT "%8.2" ECU_ADDRESS 0x60008612 /end MEASUREMENT
/begin MEASUREMENT ExhMod_tiEngOffCorrn "correction engine off time" UWORD t_q1 1 100 0.00 65535.00 FORMAT "%8.2" ECU_ADDRESS 0x60039040 /end MEASUREMENT
/begin MEASUREMENT ExhMod_tiEngOffLoc "ExhMod internal engine-off time" UWORD t_q1 1 100 0.00 65535.00 FORMAT "%8.2" ECU_ADDRESS 0x60006DC2 /end MEASUREMENT
/begin MEASUREMENT ExhMod_tiSigHoldEngRunng "Internal timer ExhMod_TiEngOff" UBYTE t_q0p05 1 100 0.00 12.75 FORMAT "%5.2" ECU_ADDRESS 0x6000B088 /end MEASUREMENT
/begin MEASUREMENT ExhMod_tiStrtEndOff "." UWORD t_q1 1 100 0.00 65535.00 FORMAT "%8.2" ECU_ADDRESS 0x60039068 /end MEASUREMENT
/begin MEASUREMENT ExhMod_tiStrtEndOffLoc "." UWORD t_q1 1 100 0.00 65535.00 FORMAT "%8.2" ECU_ADDRESS 0x60006DE6 /end MEASUREMENT
/begin MEASUREMENT ExhMod_tMtrlAryB1 "Material Temperature Array in the exhaust system - Bank 1" SWORD Temp_Cels 1 100 -3549.940 3003.560 FORMAT "%8.3" ARRAY_SIZE 12 ECU_ADDRESS 0x60006DC8 /end MEASUREMENT
/begin MEASUREMENT ExhMod_tOffsCorrnTExhVlvIgnAgB1 "Offset correction dependent on ignition angle-B1" SWORD temp_q0p1_K 1 100 -3276.800 3276.700 FORMAT "%8.3" ECU_ADDRESS 0x600088B4 /end MEASUREMENT
/begin MEASUREMENT ExhMod_tOffsCorrnTExhVlvIgnAgBasB1 "Offset correction dependant on base ignition angle efficiency B1" SWORD temp_q0p1_K 1 100 -3276.800 3276.700 FORMAT "%8.3" ECU_ADDRESS 0x600088B2 /end MEASUREMENT
/begin MEASUREMENT ExhMod_tOffsCorrnTExhVlvLamB1 "Offset correction dependent on lambda-B1" SWORD temp_q0p1_K 1 100 -3276.800 3276.700 FORMAT "%8.3" ECU_ADDRESS 0x600088B0 /end MEASUREMENT
/begin MEASUREMENT ExhMod_tPistB1 "piston temperature" SWORD Temp_Cels 1 100 -3549.940 3003.560 FORMAT "%8.3" ECU_ADDRESS 0x600088AE /end MEASUREMENT
/begin MEASUREMENT ExhMod_tPistCmbB1 "piston temperature, burning cylinders, bank 1" ULONG temp_q3p57Em7_om273 1 100 -273.15000000 1262.84999964 FORMAT "%13.8" ECU_ADDRESS 0x60003760 /end MEASUREMENT
/begin MEASUREMENT ExhMod_tPistDeltaB1 "Delta piston temperature bank 1" SWORD Temp_Cels 1 100 -3549.940 3003.560 FORMAT "%8.3" ECU_ADDRESS 0x600088AC /end MEASUREMENT
/begin MEASUREMENT ExhMod_tPistDeltaKelvinB1 "Delta piston temperature bank 1 in Kelvin" SWORD Temp_Kelv 1 100 -3276.800 3276.700 FORMAT "%8.3" ECU_ADDRESS 0x600088AA /end MEASUREMENT
/begin MEASUREMENT ExhMod_tPistQstyB1 "piston temperature, quasi-stationary, bank 1" SWORD Temp_Cels 1 100 -3549.940 3003.560 FORMAT "%8.3" ECU_ADDRESS 0x600088A8 /end MEASUREMENT
/begin MEASUREMENT ExhMod_tQstyExhVlvB1 "Quasi-stationary gas temperature at the exhaust valve bank 1" SWORD Temp_Cels 1 100 -3549.940 3003.560 FORMAT "%8.3" ECU_ADDRESS 0x60006E0E /end MEASUREMENT
/begin MEASUREMENT ExhMod_tVlvB1 "temperature valve bank 1" FLOAT32_IEEE TempC_float 1 100 -273.1400 65261.8600 FORMAT "%10.4" ECU_ADDRESS 0x60002978 /end MEASUREMENT
/begin MEASUREMENT ExhMod_tWallAryB1 "wall temperature array" SWORD Temp_Cels 1 100 -3549.940 3003.560 FORMAT "%8.3" ARRAY_SIZE 12 ECU_ADDRESS 0x50005D56 /end MEASUREMENT
/begin MEASUREMENT ExhMod_tWallCat1AvrgB1 "average wall temperature catalyst 1, bank 1" SWORD Temp_Cels 1 100 -3549.940 3003.560 FORMAT "%8.3" ECU_ADDRESS 0x600088A6 /end MEASUREMENT
/begin MEASUREMENT ExhMod_tWallCat1B1 "Wall temperature at the Middle brick of catalyst1 bank1" SWORD Temp_Cels 1 100 -3549.940 3003.560 FORMAT "%8.3" ECU_ADDRESS 0x600088A4 /end MEASUREMENT
/begin MEASUREMENT ExhMod_tWallCat1EndB1 "Wall temperature at the End brick of catalyst1 bank1" SWORD Temp_Cels 1 100 -3549.940 3003.560 FORMAT "%8.3" ECU_ADDRESS 0x600088A2 /end MEASUREMENT
/begin MEASUREMENT ExhMod_tWallCat1InB1 "Wall temperature at the start brick of catalyst1 bank1" SWORD Temp_Cels 1 100 -3549.940 3003.560 FORMAT "%8.3" ECU_ADDRESS 0x600088A0 /end MEASUREMENT
/begin MEASUREMENT ExhMod_tWallCat1MaxB1 "Maximum wall temperature of catalyst 1 in B1" SWORD Temp_Cels 1 100 -3549.940 3003.560 FORMAT "%8.3" ECU_ADDRESS 0x6000889E /end MEASUREMENT
/begin MEASUREMENT ExhMod_tWallCat1MinB1 "Minimum wall temperature of catalyst 1 in B1" SWORD Temp_Cels 1 100 -3549.940 3003.560 FORMAT "%8.3" ECU_ADDRESS 0x6000889C /end MEASUREMENT
/begin MEASUREMENT ExhMod_tWallCat2AvrgB1 "average wall temperature catalyst 2, bank 1" SWORD Temp_Cels 1 100 -3549.940 3003.560 FORMAT "%8.3" ECU_ADDRESS 0x6000889A /end MEASUREMENT
/begin MEASUREMENT ExhMod_tWallCat2B1 "Wall temperature at the Middle brick of catalyst2 bank1" SWORD Temp_Cels 1 100 -3549.940 3003.560 FORMAT "%8.3" ECU_ADDRESS 0x60008898 /end MEASUREMENT
/begin MEASUREMENT ExhMod_tWallCat2EndB1 "Wall temperature at the End brick of catalyst2 bank1" SWORD Temp_Cels 1 100 -3549.940 3003.560 FORMAT "%8.3" ECU_ADDRESS 0x60008896 /end MEASUREMENT
/begin MEASUREMENT ExhMod_tWallCat2InB1 "Wall temperature at the start brick of catalyst2 bank1" SWORD Temp_Cels 1 100 -3549.940 3003.560 FORMAT "%8.3" ECU_ADDRESS 0x60008894 /end MEASUREMENT
/begin MEASUREMENT ExhMod_tWallCat2MaxB1 "Maximum wall temperature of catalyst 2 in B1" SWORD Temp_Cels 1 100 -3549.940 3003.560 FORMAT "%8.3" ECU_ADDRESS 0x60008892 /end MEASUREMENT
/begin MEASUREMENT ExhMod_tWallCat2MinB1 "Minimum wall temperature of catalyst 2 in B1" SWORD Temp_Cels 1 100 -3549.940 3003.560 FORMAT "%8.3" ECU_ADDRESS 0x60008890 /end MEASUREMENT
/begin MEASUREMENT ExhMod_tWallCatAryB1 "Temperature array for storing wall temperatures of catalysts in B1" SWORD Temp_Cels 1 100 -3549.940 3003.560 FORMAT "%8.3" ARRAY_SIZE 2 ECU_ADDRESS 0x6000888C /end MEASUREMENT
/begin MEASUREMENT ExhMod_tWallCatAvrgAryB1 "Temperature array for average wall temperatures of catalysts in Bank1" SWORD Temp_Cels 1 100 -3549.940 3003.560 FORMAT "%8.3" ARRAY_SIZE 2 ECU_ADDRESS 0x60008888 /end MEASUREMENT
/begin MEASUREMENT ExhMod_tWallCatEndAryB1 "Temperature array for storing end wall temperatures of catalysts in B1" SWORD Temp_Cels 1 100 -3549.940 3003.560 FORMAT "%8.3" ARRAY_SIZE 2 ECU_ADDRESS 0x60008884 /end MEASUREMENT
/begin MEASUREMENT ExhMod_tWallCatInAryB1 "Temperature array for storing inside wall temperatures of catalysts in B1" SWORD Temp_Cels 1 100 -3549.940 3003.560 FORMAT "%8.3" ARRAY_SIZE 2 ECU_ADDRESS 0x60008880 /end MEASUREMENT
/begin MEASUREMENT ExhMod_tWallIninAryB1 "Array of Initialization temperatures for the wall in exhaust system Bank 1" UWORD temp_q0p0234_o273 1 100 -273.150 1262.827 FORMAT "%8.3" ARRAY_SIZE 12 ECU_ADDRESS 0x60008614 /end MEASUREMENT
/begin MEASUREMENT ExhMod_tWallMnfB1 "Wall temperature manifold" SWORD Temp_Cels 1 100 -3549.940 3003.560 FORMAT "%8.3" ECU_ADDRESS 0x6000887E /end MEASUREMENT
/begin MEASUREMENT ExhMod_tWallNvAryB1 "wall temperatures array (not volatile) bank 1" UWORD temp_q0p0234_o273 1 100 -273.150 1262.827 FORMAT "%8.3" ARRAY_SIZE 12 ECU_ADDRESS 0x60039044 /end MEASUREMENT
/begin MEASUREMENT ExhMod_tWallS1B1 "wall temperature sensor 1" SWORD Temp_Cels 1 100 -3549.940 3003.560 FORMAT "%8.3" ECU_ADDRESS 0x6000887C /end MEASUREMENT
/begin MEASUREMENT ExhMod_tWallS2B1 "wall temperature sensor 2" SWORD Temp_Cels 1 100 -3549.940 3003.560 FORMAT "%8.3" ECU_ADDRESS 0x6000887A /end MEASUREMENT
/begin MEASUREMENT ExhMod_tWallSnsrAryB1 "wall temperature array sensors" SWORD Temp_Cels 1 100 -3549.940 3003.560 FORMAT "%8.3" ARRAY_SIZE 2 ECU_ADDRESS 0x50005D6E /end MEASUREMENT
/begin MEASUREMENT FanCtl_bTrqResvFan1 "Triggering of Torque Reserve for Fan 1 running" UBYTE B_TRUE 1 100 0.00 1.00000000000 BIT_MASK 0x1 FORMAT "%13.11" ECU_ADDRESS 0x6000EE49 /end MEASUREMENT
/begin MEASUREMENT FanCtl_bTrqResvFan2 "Triggering of Torque Reserve for Fan 2 running" UBYTE B_TRUE 1 100 0.00 1.00000000000 BIT_MASK 0x1 FORMAT "%13.11" ECU_ADDRESS 0x6000EE48 /end MEASUREMENT
/begin MEASUREMENT FanCtl_cntrReIni "post drive state counter" UBYTE OneToOne 1 100 0.00 255.0 FORMAT "%5.1" ECU_ADDRESS 0x6000B06E /end MEASUREMENT
/begin MEASUREMENT FanCtl_flgACGOn "ACG On status flag from Fan module" UBYTE B_TRUE 1 100 0.00 1.00000000000 BIT_MASK 0x1 FORMAT "%13.11" ECU_ADDRESS 0x6000EE47 /end MEASUREMENT
/begin MEASUREMENT FanCtl_flgActvCooltTHi "Flag for coolant temperature high status active" UBYTE B_TRUE 1 100 0.00 1.00000000000 BIT_MASK 0x1 FORMAT "%13.11" ECU_ADDRESS 0x6000B06D /end MEASUREMENT
/begin MEASUREMENT FanCtl_flgActvCooltTLo "Flag for coolant temperature Low status active" UBYTE B_TRUE 1 100 0.00 1.00000000000 BIT_MASK 0x1 FORMAT "%13.11" ECU_ADDRESS 0x6000B06C /end MEASUREMENT
/begin MEASUREMENT FanCtl_flgActvSpdOld "Previous flag of FanCtl demand of vehicle speed" UBYTE B_TRUE 1 100 0.00 1.00000000000 BIT_MASK 0x1 FORMAT "%13.11" ECU_ADDRESS 0x6000B06B /end MEASUREMENT
/begin MEASUREMENT FanCtl_flgAftRunActv "fan afterrun active" UBYTE B_TRUE 1 100 0.00 1.00000000000 BIT_MASK 0x1 FORMAT "%13.11" ECU_ADDRESS 0x6000EE46 /end MEASUREMENT
/begin MEASUREMENT FanCtl_flgAntiFlickActv "Flag of anti headlight flicker active" UBYTE B_TRUE 1 100 0.00 1.00000000000 BIT_MASK 0x1 FORMAT "%13.11" ECU_ADDRESS 0x6000EE45 /end MEASUREMENT
/begin MEASUREMENT FanCtl_flgAntiFlickHiStg "Flag of anti headlight flicker affect to high stage output status" UBYTE B_TRUE 1 100 0.00 1.00000000000 BIT_MASK 0x1 FORMAT "%13.11" ECU_ADDRESS 0x6000EE44 /end MEASUREMENT
/begin MEASUREMENT FanCtl_flgFailActn "Failsafe action enable flag" UBYTE B_TRUE 1 100 0.00 1.00000000000 BIT_MASK 0x1 FORMAT "%13.11" ECU_ADDRESS 0x6000B06A /end MEASUREMENT
/begin MEASUREMENT FanCtl_flgFanCooltPHiSts "Flag for coolant pressure high status" UBYTE B_TRUE 1 100 0.00 1.00000000000 BIT_MASK 0x1 FORMAT "%13.11" ECU_ADDRESS 0x6000B069 /end MEASUREMENT
/begin MEASUREMENT FanCtl_flgFanCooltPLoSts "Flag for Coolant pressure low status" UBYTE B_TRUE 1 100 0.00 1.00000000000 BIT_MASK 0x1 FORMAT "%13.11" ECU_ADDRESS 0x6000B068 /end MEASUREMENT
/begin MEASUREMENT FanCtl_flgHiDlyCtrlProhbSts "Flag for High delay prohibition demand status" UBYTE B_TRUE 1 100 0.00 1.00000000000 BIT_MASK 0x1 FORMAT "%13.11" ECU_ADDRESS 0x6000B067 /end MEASUREMENT
/begin MEASUREMENT FanCtl_flgHiStgSt "Flag for High stage output status" UBYTE B_TRUE 1 100 0.00 1.00000000000 BIT_MASK 0x1 FORMAT "%13.11" ECU_ADDRESS 0x6000B066 /end MEASUREMENT
/begin MEASUREMENT FanCtl_flgIdleStopCdn "Idle stop condition for selection of fan state" UBYTE B_TRUE 1 100 0.00 1.00000000000 BIT_MASK 0x1 FORMAT "%13.11" ECU_ADDRESS 0x6000B065 /end MEASUREMENT
/begin MEASUREMENT FanCtl_flgImdtHiStg "Flag for Immediate High stage from OFF stage status" UBYTE B_TRUE 1 100 0.00 1.00000000000 BIT_MASK 0x1 FORMAT "%13.11" ECU_ADDRESS 0x6000B064 /end MEASUREMENT
/begin MEASUREMENT FanCtl_flgLowStgSt "Flag for Low stage output status" UBYTE B_TRUE 1 100 0.00 1.00000000000 BIT_MASK 0x1 FORMAT "%13.11" ECU_ADDRESS 0x6000B063 /end MEASUREMENT
/begin MEASUREMENT FanCtl_flgXPostDrv_mp "Request for ECU afterrun from fan control" UBYTE B_TRUE 1 100 0.00 1.00000000000 BIT_MASK 0x1 FORMAT "%13.11" ECU_ADDRESS 0x7000A29B /end MEASUREMENT
/begin MEASUREMENT FanCtl_pClnt "Coolant pressure for Fan control." SWORD RBPtCel_p_1p0_3 1 100 -32768.00 32767.00 FORMAT "%8.2" ECU_ADDRESS 0x60006DB8 /end MEASUREMENT
/begin MEASUREMENT FanCtl_rFan1 "Desired fan 1 speed ratio" SWORD Prc 1 100 -400.0000 399.9878 FORMAT "%8.4" ECU_ADDRESS 0x60006DB6 /end MEASUREMENT
/begin MEASUREMENT FanCtl_rFan2 "Desired fan 2 speed ratio" SWORD Prc 1 100 -400.0000 399.9878 FORMAT "%8.4" ECU_ADDRESS 0x60006DB4 /end MEASUREMENT
/begin MEASUREMENT FanCtl_rPDpdtDutyPerd "Fan duty period based on Coolant pressure and temperature" SWORD Prc 1 100 -400.0000 399.9878 FORMAT "%8.4" ECU_ADDRESS 0x60008878 /end MEASUREMENT
/begin MEASUREMENT FanCtl_rPTDpdtDutyPerd "Fan Duty period value based on coolant pressure and temperature" SWORD Prc 1 100 -400.0000 399.9878 FORMAT "%8.4" ECU_ADDRESS 0x60008876 /end MEASUREMENT
/begin MEASUREMENT FanCtl_rTDpdtDutyPerd "Fan Duty period based on coolant temperature value" SWORD Prc 1 100 -400.0000 399.9878 FORMAT "%8.4" ECU_ADDRESS 0x60008874 /end MEASUREMENT
/begin MEASUREMENT FanCtl_st "Status of fan activation" UBYTE OneToOne 1 100 0.00 255.0 FORMAT "%5.1" ECU_ADDRESS 0x6000EF79 /end MEASUREMENT
/begin MEASUREMENT FanCtl_stActvHi_MP "Status of Fan High Activation." UBYTE B_TRUE 1 100 0.00 1.00000000000 BIT_MASK 0x1 FORMAT "%13.11" ECU_ADDRESS 0x7000A29A /end MEASUREMENT
/begin MEASUREMENT FanCtl_stActvLo_MP "Status of Fan Low Activation." UBYTE B_TRUE 1 100 0.00 1.00000000000 BIT_MASK 0x1 FORMAT "%13.11" ECU_ADDRESS 0x7000A299 /end MEASUREMENT
/begin MEASUREMENT FanCtl_stCooltPHiCtrlHys "Coolant pressure high control hysteresis output status" UBYTE B_TRUE 1 100 0.00 1.00000000000 BIT_MASK 0x1 FORMAT "%13.11" ECU_ADDRESS 0x6000B062 /end MEASUREMENT
/begin MEASUREMENT FanCtl_stCooltPLoCtrlHys "Low Coolant pressure for E-Com hysteresis output status" UBYTE B_TRUE 1 100 0.00 1.00000000000 BIT_MASK 0x1 FORMAT "%13.11" ECU_ADDRESS 0x6000B061 /end MEASUREMENT
/begin MEASUREMENT FanCtl_stCooltPProhbHysOutp "Coolant pressure prohibition demand hysteresis output status" UBYTE B_TRUE 1 100 0.00 1.00000000000 BIT_MASK 0x1 FORMAT "%13.11" ECU_ADDRESS 0x6000B060 /end MEASUREMENT
/begin MEASUREMENT FanCtl_stFanDecel_MP "Measurement point for fan deceleration status" UBYTE B_TRUE 1 100 0.00 1.00000000000 BIT_MASK 0x1 FORMAT "%13.11" ECU_ADDRESS 0x7000A298 /end MEASUREMENT
/begin MEASUREMENT FanCtl_stFanRlyCtrl_MP "Status for fan relay control" UBYTE B_TRUE 1 100 0.00 1.00000000000 BIT_MASK 0x1 FORMAT "%13.11" ECU_ADDRESS 0x7000A297 /end MEASUREMENT
/begin MEASUREMENT FanCtl_stHiModDutyPred_MP "Status of high mod fan duty period calculation" UBYTE OneToOne 1 100 0.00 255.0 FORMAT "%5.1" ECU_ADDRESS 0x7000A296 /end MEASUREMENT
/begin MEASUREMENT FanCtl_stLoModDutyPred_MP "Status of low mode fan duty period calculation" UBYTE OneToOne 1 100 0.00 255.0 FORMAT "%5.1" ECU_ADDRESS 0x7000A295 /end MEASUREMENT
/begin MEASUREMENT FanCtl_stMidModDutyPred_MP "Status of Mid mode fan duty period calculation" UBYTE OneToOne 1 100 0.00 255.0 FORMAT "%5.1" ECU_ADDRESS 0x7000A294 /end MEASUREMENT
/begin MEASUREMENT FanCtl_stMod "Status of Fan control mode" UBYTE OneToOne 1 100 0.00 255.0 FORMAT "%5.1" ECU_ADDRESS 0x6000B05F /end MEASUREMENT
/begin MEASUREMENT FanCtl_stModSelnSpdHi_MP "Status of high speed mode selection" UBYTE B_TRUE 1 100 0.00 1.00000000000 BIT_MASK 0x1 FORMAT "%13.11" ECU_ADDRESS 0x7000A293 /end MEASUREMENT
/begin MEASUREMENT FanCtl_stModSelnSpdLo_MP "Status of low speed mode selection" UBYTE B_TRUE 1 100 0.00 1.00000000000 BIT_MASK 0x1 FORMAT "%13.11" ECU_ADDRESS 0x7000A292 /end MEASUREMENT
/begin MEASUREMENT FanCtl_stPDpdtDutyHiDmd "Status of pressure dependent duty period high demand" UBYTE B_TRUE 1 100 0.00 1.00000000000 BIT_MASK 0x1 FORMAT "%13.11" ECU_ADDRESS 0x6000EE42 /end MEASUREMENT
/begin MEASUREMENT FanCtl_stSpd_mp "Measureing point for FanCtl demand of vehicle speed" UBYTE OneToOne 1 100 0.00 255.0 FORMAT "%5.1" ECU_ADDRESS 0x7000A291 /end MEASUREMENT
/begin MEASUREMENT FanCtl_stStg "Fan stage selection status" UBYTE OneToOne 1 100 0.00 255.0 FORMAT "%5.1" ECU_ADDRESS 0x6000EF78 /end MEASUREMENT
/begin MEASUREMENT FanCtl_stTDpdtDutyHiDmd "Status of temperature dependent duty period high demand" UBYTE B_TRUE 1 100 0.00 1.00000000000 BIT_MASK 0x1 FORMAT "%13.11" ECU_ADDRESS 0x6000EE41 /end MEASUREMENT
/begin MEASUREMENT FanCtl_stTDpdtDutyPerd_MP "Status of temperature dependent duty period." UBYTE OneToOne 1 100 0.00 255.0 FORMAT "%5.1" ECU_ADDRESS 0x7000A290 /end MEASUREMENT
/begin MEASUREMENT FanCtl_stThrIdle "Status of throttle idle" UBYTE B_TRUE 1 100 0.00 1.00000000000 BIT_MASK 0x1 FORMAT "%13.11" ECU_ADDRESS 0x6000B05E /end MEASUREMENT
/begin MEASUREMENT FanCtl_tClnt "Coolant temperature for fan control" SWORD Temp_Cels 1 100 -3549.940 3003.560 FORMAT "%8.3" ECU_ADDRESS 0x60008872 /end MEASUREMENT
/begin MEASUREMENT FanCtl_tCooltT "Coolant temperature which is used for FanCtl demand of coolant temperature" SWORD Temp_Cels 1 100 -3549.940 3003.560 FORMAT "%8.3" ECU_ADDRESS 0x60006DB2 /end MEASUREMENT
/begin MEASUREMENT FanCtl_tiAftRunRmn "remaining fan afterrun time" SWORD TimeEngOn 1 100 -32768.00 32767.00 FORMAT "%8.2" ECU_ADDRESS 0x60035668 /end MEASUREMENT
/begin MEASUREMENT FanCtl_tiAR1S_mp "Timer value to measure 1 sec for AfterRun" SWORD Time_s 1 100 -327.6800 327.6700 FORMAT "%8.4" ECU_ADDRESS 0x7000A28E /end MEASUREMENT
/begin MEASUREMENT FanCtl_tiSpdDiffTmr "SW timer value for FanCtl deman of Speed" SWORD Time_s 1 100 -327.6800 327.6700 FORMAT "%8.4" ECU_ADDRESS 0x60006DB0 /end MEASUREMENT
/begin MEASUREMENT FanCtl_uBlowrFanU "Blower fan voltage for fan control" SWORD RBPtCel_u_0p05_1 1 100 0.00 1638.350 FORMAT "%8.3" ECU_ADDRESS 0x60006DAE /end MEASUREMENT
/begin MEASUREMENT Fans_trqCons "Torque consumed by Fan" SWORD Trq 1 100 -3276.800 3276.700 FORMAT "%8.3" ECU_ADDRESS 0x60013F48 /end MEASUREMENT
/begin MEASUREMENT Fans_trqConsFan1_MP "Filtered Static Torque Consumed for Fan 1" SWORD Trq 1 100 -3276.800 3276.700 FORMAT "%8.3" ECU_ADDRESS 0x7000A28C /end MEASUREMENT
/begin MEASUREMENT Fans_trqConsFan2_MP "Filtered Static Torque Consumed for Fan 2" SWORD Trq 1 100 -3276.800 3276.700 FORMAT "%8.3" ECU_ADDRESS 0x7000A28A /end MEASUREMENT
/begin MEASUREMENT Fans_trqConsUnFltFan1_MP "Unfiltered Static Torque Consumed for Fan 1" SWORD Trq 1 100 -3276.800 3276.700 FORMAT "%8.3" ECU_ADDRESS 0x7000A288 /end MEASUREMENT
/begin MEASUREMENT Fans_trqConsUnFltFan2_MP "Unfiltered Static Torque Consumed for Fan 2" SWORD Trq 1 100 -3276.800 3276.700 FORMAT "%8.3" ECU_ADDRESS 0x7000A286 /end MEASUREMENT
/begin MEASUREMENT Fans_trqResv "Torque reserve for cooling fan" SWORD Trq 1 100 -3276.800 3276.700 FORMAT "%8.3" ECU_ADDRESS 0x6000886E /end MEASUREMENT
/begin MEASUREMENT Fans_trqResvFan1_MP "Filtered Static Torque Reserve for Fan 1" SWORD Trq 1 100 -3276.800 3276.700 FORMAT "%8.3" ECU_ADDRESS 0x7000A284 /end MEASUREMENT
/begin MEASUREMENT Fans_trqResvFan2_MP "Filtered Static Torque Reserve for Fan 2" SWORD Trq 1 100 -3276.800 3276.700 FORMAT "%8.3" ECU_ADDRESS 0x7000A282 /end MEASUREMENT
/begin MEASUREMENT Fans_trqResvUnFltFan1_MP "Unfiltered Static Torque Reserve for Fan 1" SWORD Trq 1 100 -3276.800 3276.700 FORMAT "%8.3" ECU_ADDRESS 0x7000A280 /end MEASUREMENT
/begin MEASUREMENT Fans_trqResvUnFltFan2_MP "Unfiltered Static Torque Reserve for Fan 2" SWORD Trq 1 100 -3276.800 3276.700 FORMAT "%8.3" ECU_ADDRESS 0x7000A27E /end MEASUREMENT
/begin MEASUREMENT Fan_r "Actuator setpoint value for the first fan output." SWORD Prc 1 100 -400.0000 399.9878 FORMAT "%8.4" ECU_ADDRESS 0x600094F6 /end MEASUREMENT
/begin MEASUREMENT Fan_r2 "set point duty cycle for Pulse Width Modulation fan power stage 2" SWORD Prc 1 100 -400.0000 399.9878 FORMAT "%8.4" ECU_ADDRESS 0x600094F8 /end MEASUREMENT
/begin MEASUREMENT Fan_stPs "Output status to the the fan actuators" UBYTE OneToOne 1 100 0.00 255.0 FORMAT "%5.1" ARRAY_SIZE 2 ECU_ADDRESS 0x6000F841 /end MEASUREMENT
/begin MEASUREMENT fethmnmx_msg "ethanol content interpolation factor" UBYTE fak_ub_b2 1 100 0.00 1.992188 FORMAT "%8.6" ECU_ADDRESS 0x6000EEF7 /end MEASUREMENT
/begin MEASUREMENT fethmnmx_w_msg "ethanol content interpolation factor" UWORD fak_uw_b2 1 100 0.00 1.999969 FORMAT "%8.6" ECU_ADDRESS 0x6000853A /end MEASUREMENT
/begin MEASUREMENT fethstoe_msg "ethanol content of current stoichiometric correction (ffuel_w) interpolation factor" UBYTE fak_ub_b2 1 100 0.00 1.992188 FORMAT "%8.6" ECU_ADDRESS 0x6000EEF6 /end MEASUREMENT
/begin MEASUREMENT fethstoe_w_msg "ethanol content of current stoichiometric correction (ffuel_w) interpolation factor" UWORD fak_uw_b2 1 100 0.00 1.999969 FORMAT "%8.6" ECU_ADDRESS 0x60008536 /end MEASUREMENT
/begin MEASUREMENT FfPrm_ctReIni200ms "Counter post drive leave" UBYTE OneToOne 1 100 0.00 255.0 FORMAT "%5.1" ECU_ADDRESS 0x6000B05C /end MEASUREMENT
/begin MEASUREMENT FfPrm_EthCalctIniDrv "Local variable for counter of IniDrv" UBYTE OneToOne 1 100 0.00 255.0 FORMAT "%5.1" ECU_ADDRESS 0x6000B05D /end MEASUREMENT
/begin MEASUREMENT FfPrm_facEth "Ethanol content factor in fuel" UWORD fak_uw_b2 1 100 0.00 1.999969 FORMAT "%8.6" ECU_ADDRESS 0x6003958E /end MEASUREMENT
/begin MEASUREMENT FfPrm_facEthCurr "Ethanol content of current stoichiometric correction (ffuel_w) interpolation factor" UWORD fak_uw_b2 1 100 0.00 1.999969 FORMAT "%8.6" ECU_ADDRESS 0x6003958C /end MEASUREMENT
/begin MEASUREMENT FfPrm_facEthEep "Ethanol content interpolation factor restored from EEP during power failure" UWORD fak_uw_b2 1 100 0.00 1.999969 FORMAT "%8.6" ECU_ADDRESS 0x60008610 /end MEASUREMENT
/begin MEASUREMENT FfPrm_facEthPredMax "Predicted maximum ethanol content (interpolation factor)" UWORD fak_uw_b2 1 100 0.00 1.999969 FORMAT "%8.6" ECU_ADDRESS 0x6000860E /end MEASUREMENT
/begin MEASUREMENT FfPrm_facEthPredMin "Predicted minimum ethanol content (interpolation factor)" UWORD fak_uw_b2 1 100 0.00 1.999969 FORMAT "%8.6" ECU_ADDRESS 0x6000860C /end MEASUREMENT
/begin MEASUREMENT FfPrm_facFuAdpn "Correction factor fuel blend for injection time" UWORD fak_uw_b2 1 100 0.00 1.999969 FORMAT "%8.6" ECU_ADDRESS 0x6003958A /end MEASUREMENT
/begin MEASUREMENT FfPrm_facFuAdpnCorrn "Fuel adapatation factor correction value" UWORD fak_uw_b2 1 100 0.00 1.999969 FORMAT "%8.6" ECU_ADDRESS 0x60039588 /end MEASUREMENT
/begin MEASUREMENT FfPrm_facFuAdpnInjr "Correction factor fuel blend for injection time at injection valve" UWORD fak_uw_b2 1 100 0.00 1.999969 FORMAT "%8.6" ECU_ADDRESS 0x6000860A /end MEASUREMENT
/begin MEASUREMENT FfPrm_facFuAdpnInt "Correction factor fuel blend for injection time (internal)" UWORD fak_uw_b2 1 100 0.00 1.999969 FORMAT "%8.6" ECU_ADDRESS 0x60039586 /end MEASUREMENT
/begin MEASUREMENT FfPrm_facMixIntegSpd "integration speed integrator FRA_IK for fuel adaptation correction" SWORD q7p63Em5_DIV_s 1 100 -2.500000 2.499924 FORMAT "%8.6" ECU_ADDRESS 0x6000886C /end MEASUREMENT
/begin MEASUREMENT FfPrm_flgActv "Flex Fuel functionality active" UBYTE B_TRUE 1 100 0.00 1.00000000000 BIT_MASK 0x1 FORMAT "%13.11" ECU_ADDRESS 0x60039546 /end MEASUREMENT
/begin MEASUREMENT FfPrm_flgChgPtd "Stoichiometric factor change permitted" UBYTE B_TRUE 1 100 0.00 1.00000000000 BIT_MASK 0x1 FORMAT "%13.11" ECU_ADDRESS 0x6000EE40 /end MEASUREMENT
/begin MEASUREMENT FfPrm_flgCorrnLoc "fuel adaptation factor ramp for correction method" UBYTE B_TRUE 1 100 0.00 1.00000000000 BIT_MASK 0x1 FORMAT "%13.11" ECU_ADDRESS 0x6003900C /end MEASUREMENT
/begin MEASUREMENT FfPrm_flgEthAdpn "adaptation of ethanol content active" UBYTE B_TRUE 1 100 0.00 1.00000000000 BIT_MASK 0x1 FORMAT "%13.11" ECU_ADDRESS 0x6000EE3F /end MEASUREMENT
/begin MEASUREMENT FfPrm_flgEthHiTolr "High tolerance in ethanol content calculation expected" UBYTE B_TRUE 1 100 0.00 1.00000000000 BIT_MASK 0x1 FORMAT "%13.11" ECU_ADDRESS 0x6000EE3D /end MEASUREMENT
/begin MEASUREMENT FfPrm_flgEthVld "Ethanol content valid" UBYTE B_TRUE 1 100 0.00 1.00000000000 BIT_MASK 0x1 FORMAT "%13.11" ECU_ADDRESS 0x60039545 /end MEASUREMENT
/begin MEASUREMENT FfPrm_flgFuAdpnCorrn "ramp for fuel adaptation correction active" UBYTE B_TRUE 1 100 0.00 1.00000000000 BIT_MASK 0x1 FORMAT "%13.11" ECU_ADDRESS 0x6000EE3C /end MEASUREMENT
/begin MEASUREMENT FfPrm_flgProdMod "Flex Fuel Production Mode" UBYTE B_TRUE 1 100 0.00 1.00000000000 BIT_MASK 0x1 FORMAT "%13.11" ECU_ADDRESS 0x6000EE39 /end MEASUREMENT
/begin MEASUREMENT FfPrm_flgSnsrInit "Flag Ethanol sensor value valid" UBYTE B_TRUE 1 100 0.00 1.00000000000 BIT_MASK 0x1 FORMAT "%13.11" ECU_ADDRESS 0x6003900B /end MEASUREMENT
/begin MEASUREMENT FfPrm_perEth "Alcohol Fuel Percentage for PID52" UBYTE rel_q0p392 1 100 0.00 100.0 FORMAT "%5.1" ECU_ADDRESS 0x60039565 /end MEASUREMENT
/begin MEASUREMENT FfPrm_perEthOBD "Alcohol Fuel Percentage for PID52" UBYTE rel_q0p392 1 100 0.00 100.0 FORMAT "%5.1" ECU_ADDRESS 0x60039564 /end MEASUREMENT
/begin MEASUREMENT FfPrm_perEthRaw "Alcohol Fuel Percentage (raw value) for PID52" UWORD rel_q0p392 1 100 0.00 25700.00 FORMAT "%8.2" ECU_ADDRESS 0x60008606 /end MEASUREMENT
/begin MEASUREMENT FfPrm_stEthVldRdnt "Redundancy for FfPrm_flgEthVld" UBYTE OneToOne 1 100 0.00 255.0 FORMAT "%5.1" ECU_ADDRESS 0x60039563 /end MEASUREMENT
/begin MEASUREMENT FfPrm_stFacFuAdpn "Status Fuel Adaptation" UBYTE ethanolstat 1 100 0.00 4.00000000000 FORMAT "%13.11" ECU_ADDRESS 0x6000EF77 /end MEASUREMENT
/begin MEASUREMENT FfPrm_stFuAdpnRdnt "Redundancy for FfPrm_stFuAdpn" UWORD dez 1 100 0.00 65535.00 FORMAT "%8.2" ECU_ADDRESS 0x7000397E /end MEASUREMENT
/begin MEASUREMENT ffuelnw_w_msg "ffuel neutral value" UWORD fak_uw_b2 1 100 0.00 1.999969 FORMAT "%8.6" ECU_ADDRESS 0x60008532 /end MEASUREMENT
/begin MEASUREMENT ffuel_w_msg "Correction factor fuel blend for injection time" UWORD fak_uw_b2 1 100 0.00 1.999969 FORMAT "%8.6" ECU_ADDRESS 0x60008534 /end MEASUREMENT
/begin MEASUREMENT flgSelnExhTSnsrInvldTiEngOffB1 "valdity of flag engine off bank1" UBYTE flgSelnExhTSnsrInvldTiEngOff_Enum_VERB 1 100 0.00 1.00000000000 FORMAT "%13.11" ECU_ADDRESS 0x6000B082 /end MEASUREMENT
/begin MEASUREMENT flgSelnReplcmtValStgy "flag for replacement value" UBYTE flgSelnReplcmtValStgy_Enum_VERB 1 100 0.00 2.00000000000 FORMAT "%13.11" ECU_ADDRESS 0x6000B081 /end MEASUREMENT
/begin MEASUREMENT flgVldyCooltT "flag for cooling temperature validity" UBYTE flgVldyCooltT_Enum_VERB 1 100 0.00 1.00000000000 FORMAT "%13.11" ECU_ADDRESS 0x6000B080 /end MEASUREMENT
/begin MEASUREMENT flgVldyEnvT "flag for enironmental temperatue validity" UBYTE flgVldyEnvT_Enum_VERB 1 100 0.00 1.00000000000 FORMAT "%13.11" ECU_ADDRESS 0x6000B07F /end MEASUREMENT
/begin MEASUREMENT flgVldyExhTSnsr "flag for exhaust temperature sensor validity" UBYTE flgVldyExhTSnsr_Enum_VERB 1 100 0.00 1.00000000000 FORMAT "%13.11" ECU_ADDRESS 0x6000B07E /end MEASUREMENT
/begin MEASUREMENT flgVldyTiEngOff "flag for enigne off time validitiy" UBYTE flgVldyTiEngOff_Enum_VERB 1 100 0.00 1.00000000000 FORMAT "%13.11" ECU_ADDRESS 0x6000B07D /end MEASUREMENT
/begin MEASUREMENT fraffck_w_msg "integration speed integrator FRA_IK for FFUEL correction" SWORD q7p63Em5_DIV_s 1 100 -2.500000 2.499924 FORMAT "%8.6" ECU_ADDRESS 0x60008770 /end MEASUREMENT
/begin MEASUREMENT MINMAXAVRG_n.tavrg "Class instance to calculate average temperature(wall ,radial) of catalyst / Average temperature" SWORD Temp_Cels 1 100 -3549.940 3003.560 FORMAT "%8.3" ECU_ADDRESS 0x60006DE0 /end MEASUREMENT
/begin MEASUREMENT MINMAXAVRG_n.tmax "Class instance to calculate average temperature(wall ,radial) of catalyst / Maximal temperature" SWORD Temp_Cels 1 100 -3549.940 3003.560 FORMAT "%8.3" ECU_ADDRESS 0x60006DE2 /end MEASUREMENT
/begin MEASUREMENT MINMAXAVRG_n.tmin "Class instance to calculate average temperature(wall ,radial) of catalyst / Minimal temperature" SWORD Temp_Cels 1 100 -3549.940 3003.560 FORMAT "%8.3" ECU_ADDRESS 0x60006DE4 /end MEASUREMENT
/begin MEASUREMENT stCfgIninB1 "status configuration Bank1" UBYTE stCfgInin_CA_Enum_VERB 1 100 0.00 2.00000000000 FORMAT "%13.11" ECU_ADDRESS 0x6000B07C /end MEASUREMENT
/begin MEASUREMENT stTMdlIninCurrModB1 "status of current mode Bank1" UBYTE stCurrModTMdlInin_Mode_Enum_VERB 1 100 0.00 5.00000000000 FORMAT "%13.11" ECU_ADDRESS 0x6000B07B /end MEASUREMENT
/begin MEASUREMENT TExhVlMdl_If_CorrnIgnAg_I.B_khakt "Input class for Ignition angle correction / Input class for Ignition angle correction" UBYTE B_TRUE 1 100 0.00 1.00000000000 BIT_MASK 0x1 FORMAT "%13.11" ECU_ADDRESS 0x60006DF4 /end MEASUREMENT
/begin MEASUREMENT TExhVlMdl_If_CorrnIgnAg_I.B_khakw "Input class for Ignition angle correction / Input class for Ignition angle correction" UBYTE B_TRUE 1 100 0.00 1.00000000000 BIT_MASK 0x1 FORMAT "%13.11" ECU_ADDRESS 0x60006DF5 /end MEASUREMENT
/begin MEASUREMENT TExhVlMdl_If_CorrnIgnAg_I.B_khasu "Input class for Ignition angle correction / Input class for Ignition angle correction" UBYTE B_TRUE 1 100 0.00 1.00000000000 BIT_MASK 0x1 FORMAT "%13.11" ECU_ADDRESS 0x60006DF6 /end MEASUREMENT
/begin MEASUREMENT TExhVlMdl_If_CorrnIgnAg_I.ExhMgT_flgCatHeatgPfil "Input class for Ignition angle correction / Input class for Ignition angle correction" UBYTE B_TRUE 1 100 0.00 1.00000000000 BIT_MASK 0x1 FORMAT "%13.11" ECU_ADDRESS 0x60006DF7 /end MEASUREMENT
/begin MEASUREMENT TExhVlMdl_If_CorrnIgnAg_I.effIgnAgAvrg "Input class for Ignition angle correction / Input class for Ignition angle correction" UBYTE rel_ub_b127p5 1 100 0.00 127.5 FORMAT "%5.1" ECU_ADDRESS 0x60006DF8 /end MEASUREMENT
/begin MEASUREMENT TExhVlMdl_If_CorrnIgnAg_I.etakh_w "Input class for Ignition angle correction / Input class for Ignition angle correction" UWORD fak_uw_b2 1 100 0.00 1.999969 FORMAT "%8.6" ECU_ADDRESS 0x60006DFA /end MEASUREMENT
/begin MEASUREMENT TExhVlMdl_If_CorrnIgnAg_I.facIntrpnGslSecFu "Input class for Ignition angle correction / Class argument for interpolation factor" UWORD fak_uw_b2 1 100 0.00 1.000000 FORMAT "%8.6" ECU_ADDRESS 0x60006DFC /end MEASUREMENT
/begin MEASUREMENT TExhVlMdl_If_CorrnIgnAg_I.flgHspActv "Input class for Ignition angle correction / Class argument for HSP activation" UBYTE B_TRUE 1 100 0.00 1.00000000000 BIT_MASK 0x1 FORMAT "%13.11" ECU_ADDRESS 0x60006DFE /end MEASUREMENT
/begin MEASUREMENT TExhVlMdl_If_CorrnIgnAg_I.flgSelnCorrnTExhVlv "Input class for Ignition angle correction / Input class for Ignition angle correction" UBYTE B_TRUE 1 100 0.00 1.00000000000 BIT_MASK 0x1 FORMAT "%13.11" ECU_ADDRESS 0x60006DFF /end MEASUREMENT
/begin MEASUREMENT TExhVlMdl_If_CorrnIgnAg_I.flgTExhVlvGpfRgnActv "Input class for Ignition angle correction / GPF Regeneration active flag" UBYTE B_TRUE 1 100 0.00 1.00000000000 BIT_MASK 0x1 FORMAT "%13.11" ECU_ADDRESS 0x60006E00 /end MEASUREMENT
/begin MEASUREMENT TExhVlMdl_If_CorrnIgnAg_I.idxMapTExhVlv "Input class for Ignition angle correction / Class argument for map index" UBYTE dez 1 100 0.00 255.0 FORMAT "%5.1" ECU_ADDRESS 0x60006E01 /end MEASUREMENT
/begin MEASUREMENT TExhVlMdl_If_CorrnIgnAg_I.idxMapTExhVlvSecFu "Input class for Ignition angle correction / Class argument for map index" UBYTE dez 1 100 0.00 255.0 FORMAT "%5.1" ECU_ADDRESS 0x60006E02 /end MEASUREMENT
/begin MEASUREMENT TExhVlMdl_If_CorrnIgnAg_I.mfTExhVlvMdl "Input class for Ignition angle correction / Input class for Ignition angle correction" UWORD m_uw_b6553p5 1 100 0.00 6553.500 FORMAT "%8.3" ECU_ADDRESS 0x60006E04 /end MEASUREMENT
/begin MEASUREMENT TExhVlMdl_If_CorrnIgnAg_I.nEng "Input class for Ignition angle correction / Input class for Ignition angle correction" SWORD nmot_q0p5 1 100 -16384.00 16383.50 FORMAT "%8.2" ECU_ADDRESS 0x60006E06 /end MEASUREMENT
/begin MEASUREMENT TExhVlMdl_If_CorrnIgnAg_I.ratChrgAirCyl "Input class for Ignition angle correction / Input class for Ignition angle correction" UWORD rel_q0p0234 1 100 0.00 1535.977 FORMAT "%8.3" ECU_ADDRESS 0x60006E08 /end MEASUREMENT
/begin MEASUREMENT TExhVlMdl_If_Out_CorrnIgnAgB1_I.facCorrnIgnAg "Output class for Ignition angle correction for the gas temperature, Bank 1 / Output class for Ignition angle correction" UWORD fak_uw_b2 1 100 0.00 1.999969 FORMAT "%8.6" ECU_ADDRESS 0x60002960 /end MEASUREMENT
/begin MEASUREMENT TExhVlMdl_If_Out_CorrnIgnAgB1_I.facCorrnIgnAgHom "Output class for Ignition angle correction for the gas temperature, Bank 1 / Output class for Ignition angle correction" UWORD fak_uw_b2 1 100 0.00 1.999969 FORMAT "%8.6" ECU_ADDRESS 0x60002962 /end MEASUREMENT
/begin MEASUREMENT TExhVlMdl_If_Out_CorrnIgnAgB1_I.facCorrnIgnAgHsp "Output class for Ignition angle correction for the gas temperature, Bank 1 / Output class for Ignition angle correction" UWORD fak_uw_b2 1 100 0.00 1.999969 FORMAT "%8.6" ECU_ADDRESS 0x60002964 /end MEASUREMENT
/begin MEASUREMENT TExhVlMdl_If_Out_CorrnIgnAgB1_I.offsCorrnIgnAg "Output class for Ignition angle correction for the gas temperature, Bank 1 / Output class for Ignition angle correction" SLONG temp_q0p0234 1 100 -4000.03125000 4000.00781250 FORMAT "%13.8" ECU_ADDRESS 0x60002968 /end MEASUREMENT
/begin MEASUREMENT TExhVlMdl_If_Out_CorrnIgnAgB1_I.offsCorrnIgnAgHom "Output class for Ignition angle correction for the gas temperature, Bank 1 / Output class for Ignition angle correction" SWORD temp_q0p0234 1 100 -768.0000 767.9766 FORMAT "%8.4" ECU_ADDRESS 0x6000296C /end MEASUREMENT
/begin MEASUREMENT TExhVlMdl_If_Out_CorrnIgnAgB1_I.offsCorrnIgnAgHsp "Output class for Ignition angle correction for the gas temperature, Bank 1 / Output class for Ignition angle correction" SWORD temp_q0p0234 1 100 -768.0000 767.9766 FORMAT "%8.4" ECU_ADDRESS 0x6000296E /end MEASUREMENT
/begin MEASUREMENT TExhVlMdl_If_Out_CorrnIgnAgB1_I.offsCorrnIgnAgLoc "Output class for Ignition angle correction for the gas temperature, Bank 1 / Output class for Ignition angle correction" SWORD temp_q0p0234 1 100 -768.0000 767.9766 FORMAT "%8.4" ECU_ADDRESS 0x60002970 /end MEASUREMENT
/begin MEASUREMENT TExhVlMdl_If_Out_CorrnIgnAgB1_I.tOffsCorrnIgnAgEom "Output class for Ignition angle correction for the gas temperature, Bank 1 / Output class for Ignition angle correction" UWORD temp_q0p0234 1 100 0.00 1535.977 FORMAT "%8.3" ECU_ADDRESS 0x60002972 /end MEASUREMENT
/begin MEASUREMENT TExhVlMdl_If_Out_CorrnIgnAgB1_I.tOffsCorrnIgnAgEomGsl "Output class for Ignition angle correction for the gas temperature, Bank 1 / Output class for Ignition angle correction" UWORD temp_q0p0234 1 100 0.00 1535.977 FORMAT "%8.3" ECU_ADDRESS 0x60002974 /end MEASUREMENT
/begin MEASUREMENT TExhVlMdl_If_Out_CorrnIgnAgB1_I.tOffsCorrnIgnAgEomSecFu "Output class for Ignition angle correction for the gas temperature, Bank 1 / Output class for Ignition angle correction" UWORD temp_q0p0234 1 100 0.00 1535.977 FORMAT "%8.3" ECU_ADDRESS 0x60002976 /end MEASUREMENT
/begin MEASUREMENT TExhVlMdl_If_Out_CorrnIgnAgBasB1_I.facCorrnIgnAg "Output class for average efficency depending on ignition angle correction, Bank 1 / Output class for Ignition angle correction" UWORD fak_uw_b2 1 100 0.00 1.999969 FORMAT "%8.6" ECU_ADDRESS 0x60002948 /end MEASUREMENT
/begin MEASUREMENT TExhVlMdl_If_Out_CorrnIgnAgBasB1_I.facCorrnIgnAgHom "Output class for average efficency depending on ignition angle correction, Bank 1 / Output class for Ignition angle correction" UWORD fak_uw_b2 1 100 0.00 1.999969 FORMAT "%8.6" ECU_ADDRESS 0x6000294A /end MEASUREMENT
/begin MEASUREMENT TExhVlMdl_If_Out_CorrnIgnAgBasB1_I.facCorrnIgnAgHsp "Output class for average efficency depending on ignition angle correction, Bank 1 / Output class for Ignition angle correction" UWORD fak_uw_b2 1 100 0.00 1.999969 FORMAT "%8.6" ECU_ADDRESS 0x6000294C /end MEASUREMENT
/begin MEASUREMENT TExhVlMdl_If_Out_CorrnIgnAgBasB1_I.offsCorrnIgnAg "Output class for average efficency depending on ignition angle correction, Bank 1 / Output class for Ignition angle correction" SLONG temp_q0p0234 1 100 -4000.03125000 4000.00781250 FORMAT "%13.8" ECU_ADDRESS 0x60002950 /end MEASUREMENT
/begin MEASUREMENT TExhVlMdl_If_Out_CorrnIgnAgBasB1_I.offsCorrnIgnAgHom "Output class for average efficency depending on ignition angle correction, Bank 1 / Output class for Ignition angle correction" SWORD temp_q0p0234 1 100 -768.0000 767.9766 FORMAT "%8.4" ECU_ADDRESS 0x60002954 /end MEASUREMENT
/begin MEASUREMENT TExhVlMdl_If_Out_CorrnIgnAgBasB1_I.offsCorrnIgnAgHsp "Output class for average efficency depending on ignition angle correction, Bank 1 / Output class for Ignition angle correction" SWORD temp_q0p0234 1 100 -768.0000 767.9766 FORMAT "%8.4" ECU_ADDRESS 0x60002956 /end MEASUREMENT
/begin MEASUREMENT TExhVlMdl_If_Out_CorrnIgnAgBasB1_I.offsCorrnIgnAgLoc "Output class for average efficency depending on ignition angle correction, Bank 1 / Output class for Ignition angle correction" SWORD temp_q0p0234 1 100 -768.0000 767.9766 FORMAT "%8.4" ECU_ADDRESS 0x60002958 /end MEASUREMENT
/begin MEASUREMENT TExhVlMdl_If_Out_CorrnIgnAgBasB1_I.tOffsCorrnIgnAgEom "Output class for average efficency depending on ignition angle correction, Bank 1 / Output class for Ignition angle correction" UWORD temp_q0p0234 1 100 0.00 1535.977 FORMAT "%8.3" ECU_ADDRESS 0x6000295A /end MEASUREMENT
/begin MEASUREMENT TExhVlMdl_If_Out_CorrnIgnAgBasB1_I.tOffsCorrnIgnAgEomGsl "Output class for average efficency depending on ignition angle correction, Bank 1 / Output class for Ignition angle correction" UWORD temp_q0p0234 1 100 0.00 1535.977 FORMAT "%8.3" ECU_ADDRESS 0x6000295C /end MEASUREMENT
/begin MEASUREMENT TExhVlMdl_If_Out_CorrnIgnAgBasB1_I.tOffsCorrnIgnAgEomSecFu "Output class for average efficency depending on ignition angle correction, Bank 1 / Output class for Ignition angle correction" UWORD temp_q0p0234 1 100 0.00 1535.977 FORMAT "%8.3" ECU_ADDRESS 0x6000295E /end MEASUREMENT
/begin MEASUREMENT TExhVlvMdl_AvrgB1_I.cntrSum "Class instance for calculation of average efficency depending on ignition angle, bank 1 / average efficency depending on ignition angle" UBYTE dez 1 100 0.00 255.0 FORMAT "%5.1" ECU_ADDRESS 0x6000B08B /end MEASUREMENT
/begin MEASUREMENT TExhVlvMdl_AvrgB1_I.effIgnAgAvrg "Class instance for calculation of average efficency depending on ignition angle, bank 1 / average efficency depending on ignition angle" UBYTE rel_ub_b127p5 1 100 0.00 127.5 FORMAT "%5.1" ECU_ADDRESS 0x60006DEE /end MEASUREMENT
/begin MEASUREMENT TExhVlvMdl_AvrgB1_I.effIgnAgSingleValue "Class instance for calculation of average efficency depending on ignition angle, bank 1 / average efficency depending on ignition angle" UWORD rel_ub_b127p5 1 100 0.00 32767.50 FORMAT "%8.2" ECU_ADDRESS 0x60006DF0 /end MEASUREMENT
/begin MEASUREMENT TExhVlvMdl_AvrgB1_I.effIgnAgSum "Class instance for calculation of average efficency depending on ignition angle, bank 1 / average efficency depending on ignition angle" UWORD rel_ub_b127p5 1 100 0.00 32767.50 FORMAT "%8.2" ECU_ADDRESS 0x60006DF2 /end MEASUREMENT
/begin MEASUREMENT TExhVlvMdl_AvrgBas_I.cntrSum "Class instance for calculation of average efficency depending on ignition angle / average efficency depending on ignition angle" UBYTE dez 1 100 0.00 255.0 FORMAT "%5.1" ECU_ADDRESS 0x6000B08A /end MEASUREMENT
/begin MEASUREMENT TExhVlvMdl_AvrgBas_I.effIgnAgAvrg "Class instance for calculation of average efficency depending on ignition angle / average efficency depending on ignition angle" UBYTE rel_ub_b127p5 1 100 0.00 127.5 FORMAT "%5.1" ECU_ADDRESS 0x60006DE8 /end MEASUREMENT
/begin MEASUREMENT TExhVlvMdl_AvrgBas_I.effIgnAgSingleValue "Class instance for calculation of average efficency depending on ignition angle / average efficency depending on ignition angle" UWORD rel_ub_b127p5 1 100 0.00 32767.50 FORMAT "%8.2" ECU_ADDRESS 0x60006DEA /end MEASUREMENT
/begin MEASUREMENT TExhVlvMdl_AvrgBas_I.effIgnAgSum "Class instance for calculation of average efficency depending on ignition angle / average efficency depending on ignition angle" UWORD rel_ub_b127p5 1 100 0.00 32767.50 FORMAT "%8.2" ECU_ADDRESS 0x60006DEC /end MEASUREMENT
/begin MEASUREMENT TExhVlvMdl_PipMdl_I.tExhOutp "Class for modelling of pipe temperature / model of pipe in exhaust system" FLOAT32_IEEE TempC_float 1 100 -273.1400 65261.8600 FORMAT "%10.4" ECU_ADDRESS 0x600028F8 /end MEASUREMENT
/begin MEASUREMENT TExhVlvMdl_PipMdl_I.ExhMod_HeatBalIfPipMdl_I.HeatStorg1 "Class for modelling of pipe temperature / Instance of Heat Balance equation, interface class / Class attribute" SLONG RBPtCel_fac_0p00001_1 1 100 -21474.8364800 21474.8364700 FORMAT "%13.7" ECU_ADDRESS 0x600028FC /end MEASUREMENT
/begin MEASUREMENT TExhVlvMdl_PipMdl_I.ExhMod_HeatBalIfPipMdl_I.HeatStorg2 "Class for modelling of pipe temperature / Instance of Heat Balance equation, interface class / Class attribute" SLONG RBPtCel_fac_0p00001_1 1 100 -21474.8364800 21474.8364700 FORMAT "%13.7" ECU_ADDRESS 0x60002900 /end MEASUREMENT
/begin MEASUREMENT TExhVlvMdl_PipMdl_I.ExhMod_HeatBalIfPipMdl_I.HeatStorg3 "Class for modelling of pipe temperature / Instance of Heat Balance equation, interface class / Class attribute" SLONG RBPtCel_fac_0p00001_1 1 100 -21474.8364800 21474.8364700 FORMAT "%13.7" ECU_ADDRESS 0x60002904 /end MEASUREMENT
/begin MEASUREMENT TExhVlvMdl_PipMdl_I.ExhMod_HeatBalIfPipMdl_I.HeatTrf0To1 "Class for modelling of pipe temperature / Instance of Heat Balance equation, interface class / Class attribute" SLONG RBPtCel_fac_0p00001_1 1 100 -21474.8364800 21474.8364700 FORMAT "%13.7" ECU_ADDRESS 0x60002908 /end MEASUREMENT
/begin MEASUREMENT TExhVlvMdl_PipMdl_I.ExhMod_HeatBalIfPipMdl_I.HeatTrf1To2 "Class for modelling of pipe temperature / Instance of Heat Balance equation, interface class / Class attribute" SLONG RBPtCel_fac_0p00001_1 1 100 -21474.8364800 21474.8364700 FORMAT "%13.7" ECU_ADDRESS 0x6000290C /end MEASUREMENT
/begin MEASUREMENT TExhVlvMdl_PipMdl_I.ExhMod_HeatBalIfPipMdl_I.HeatTrf2To3 "Class for modelling of pipe temperature / Instance of Heat Balance equation, interface class / Class attribute" SLONG RBPtCel_fac_0p00001_1 1 100 -21474.8364800 21474.8364700 FORMAT "%13.7" ECU_ADDRESS 0x60002910 /end MEASUREMENT
/begin MEASUREMENT TExhVlvMdl_PipMdl_I.ExhMod_HeatBalIfPipMdl_I.HeatTrf3To4 "Class for modelling of pipe temperature / Instance of Heat Balance equation, interface class / Class attribute" SLONG RBPtCel_fac_0p00001_1 1 100 -21474.8364800 21474.8364700 FORMAT "%13.7" ECU_ADDRESS 0x60002914 /end MEASUREMENT
/begin MEASUREMENT TExhVlvMdl_PipMdl_I.ExhMod_HeatBalIfPipMdl_I.egyExt1 "Class for modelling of pipe temperature / Instance of Heat Balance equation, interface class / Class attribute" FLOAT32_IEEE RBPtCel_egy_1p0_2 1 100 -1.0000000E+037 1.0000000E+037 FORMAT "%15.7" ECU_ADDRESS 0x60002918 /end MEASUREMENT
/begin MEASUREMENT TExhVlvMdl_PipMdl_I.ExhMod_HeatBalIfPipMdl_I.egyExt2 "Class for modelling of pipe temperature / Instance of Heat Balance equation, interface class / Class attribute" FLOAT32_IEEE RBPtCel_egy_1p0_2 1 100 -1.0000000E+037 1.0000000E+037 FORMAT "%15.7" ECU_ADDRESS 0x6000291C /end MEASUREMENT
/begin MEASUREMENT TExhVlvMdl_PipMdl_I.ExhMod_HeatBalIfPipMdl_I.egyExt3 "Class for modelling of pipe temperature / Instance of Heat Balance equation, interface class / Class attribute" FLOAT32_IEEE RBPtCel_egy_1p0_2 1 100 -1.0000000E+037 1.0000000E+037 FORMAT "%15.7" ECU_ADDRESS 0x60002920 /end MEASUREMENT
/begin MEASUREMENT TExhVlvMdl_PipMdl_I.ExhMod_HeatBalIfPipMdl_I.flg3HeatBal "Class for modelling of pipe temperature / Instance of Heat Balance equation, interface class / Class attribute" UBYTE B_TRUE 1 100 0.00 1.00000000000 BIT_MASK 0x1 FORMAT "%13.11" ECU_ADDRESS 0x60002924 /end MEASUREMENT
/begin MEASUREMENT TExhVlvMdl_PipMdl_I.ExhMod_HeatBalIfPipMdl_I.tHiResl0 "Class for modelling of pipe temperature / Instance of Heat Balance equation, interface class / Class attribute" FLOAT32_IEEE TempK_float 1 100 -1.0000E+037 1.0000E+037 FORMAT "%10.4" ECU_ADDRESS 0x60002928 /end MEASUREMENT
/begin MEASUREMENT TExhVlvMdl_PipMdl_I.ExhMod_HeatBalIfPipMdl_I.tHiResl1 "Class for modelling of pipe temperature / Instance of Heat Balance equation, interface class / Class attribute" FLOAT32_IEEE TempK_float 1 100 -1.0000E+037 1.0000E+037 FORMAT "%10.4" ECU_ADDRESS 0x6000292C /end MEASUREMENT
/begin MEASUREMENT TExhVlvMdl_PipMdl_I.ExhMod_HeatBalIfPipMdl_I.tHiResl2 "Class for modelling of pipe temperature / Instance of Heat Balance equation, interface class / Class attribute" FLOAT32_IEEE TempK_float 1 100 -1.0000E+037 1.0000E+037 FORMAT "%10.4" ECU_ADDRESS 0x60002930 /end MEASUREMENT
/begin MEASUREMENT TExhVlvMdl_PipMdl_I.ExhMod_HeatBalIfPipMdl_I.tHiResl3 "Class for modelling of pipe temperature / Instance of Heat Balance equation, interface class / Class attribute" FLOAT32_IEEE TempK_float 1 100 -1.0000E+037 1.0000E+037 FORMAT "%10.4" ECU_ADDRESS 0x60002934 /end MEASUREMENT
/begin MEASUREMENT TExhVlvMdl_PipMdl_I.ExhMod_HeatBalIfPipMdl_I.tHiResl4 "Class for modelling of pipe temperature / Instance of Heat Balance equation, interface class / Class attribute" FLOAT32_IEEE TempK_float 1 100 -1.0000E+037 1.0000E+037 FORMAT "%10.4" ECU_ADDRESS 0x60002938 /end MEASUREMENT
/begin MEASUREMENT TExhVlvMdl_PipMdl_I.ExhMod_HeatBal_I.tHiReslOutp1 "Class for modelling of pipe temperature / Instance of heat balance equation class / high resolution temperature output1" FLOAT32_IEEE TempK_float 1 100 -1.0000E+037 1.0000E+037 FORMAT "%10.4" ECU_ADDRESS 0x6000293C /end MEASUREMENT
/begin MEASUREMENT TExhVlvMdl_PipMdl_I.ExhMod_HeatBal_I.tHiReslOutp2 "Class for modelling of pipe temperature / Instance of heat balance equation class / high resolution temperature output2" FLOAT32_IEEE TempK_float 1 100 -1.0000E+037 1.0000E+037 FORMAT "%10.4" ECU_ADDRESS 0x60002940 /end MEASUREMENT
/begin MEASUREMENT TExhVlvMdl_PipMdl_I.ExhMod_HeatBal_I.tHiReslOutp3 "Class for modelling of pipe temperature / Instance of heat balance equation class / high resolution temperature output3" FLOAT32_IEEE TempK_float 1 100 -1.0000E+037 1.0000E+037 FORMAT "%10.4" ECU_ADDRESS 0x60002944 /end MEASUREMENT
/begin MEASUREMENT TExhVlv_facCorrnLamB1 "lambda correction" UWORD fak_uw_b2 1 100 0.00 1.999969 FORMAT "%8.6" ECU_ADDRESS 0x60006E0C /end MEASUREMENT
/begin MEASUREMENT TExhVlv_offsCorrnLamB1 "offset lambda correction" SWORD temp_q0p0234 1 100 -768.0000 767.9766 FORMAT "%8.4" ECU_ADDRESS 0x60006E0A /end MEASUREMENT
/begin MEASUREMENT TiEngOff_ctReIni "Counter for ReIni detection" UBYTE OneToOne 1 100 0.00 255.0 FORMAT "%5.1" ECU_ADDRESS 0x6000B087 /end MEASUREMENT
/begin MEASUREMENT TPist_htcExhPistCmbB1 "heat transfer coefficient from gas to piston" ULONG fak_q1p526Em5 1 100 0.00 255.996093750 FORMAT "%13.9" ECU_ADDRESS 0x600027D4 /end MEASUREMENT
/begin MEASUREMENT TPist_iaDif "difference between base ignition angle and current outcoming ignition angle" SWORD kw_q0p75 1 100 -24576.00 24575.25 FORMAT "%8.2" ECU_ADDRESS 0x60006DC0 /end MEASUREMENT
/begin MEASUREMENT TPist_mfExhCmbB1 "massflow in during half engine mode burning cylinder" FLOAT32_IEEE AirMassPerTime_float 1 100 0.00 50000.0000 FORMAT "%10.4" ECU_ADDRESS 0x600027D0 /end MEASUREMENT
/begin MEASUREMENT TPist_pwrOilCmbB1 "exothermy from oil to piston for during half engine mode burning cylinders" FLOAT32_IEEE HtFlw_Fl 1 100 -5000000.000 5000000.000 FORMAT "%11.3" ECU_ADDRESS 0x600027CC /end MEASUREMENT
/begin MEASUREMENT TPist_tExhPist "gas temperature in combustion chamber" UWORD temp_q0p0234_o273 1 100 -273.150 1262.827 FORMAT "%8.3" ECU_ADDRESS 0x60006DBE /end MEASUREMENT
/begin MEASUREMENT TPist_tExhPistInB1 "Temperature of exhaust gas input to the piston" UWORD temp_q0p0234_o273 1 100 -273.150 1262.827 FORMAT "%8.3" ECU_ADDRESS 0x60006DBC /end MEASUREMENT
/begin MEASUREMENT TPist_tPistCmbQstyB1 "piston temperature, burning cylinders, bank 1" SWORD Temp_Cels 1 100 -3549.940 3003.560 FORMAT "%8.3" ECU_ADDRESS 0x60006DBA /end MEASUREMENT
/begin FUNCTION ExhMod_TExhVlvMdl "1.34.0    Temperature model exhaust valve"
 /begin DEF_CHARACTERISTIC ExhMod_cpAbsltVlvB1_C ExhMod_cpAbsltVlvFildB1_C ExhMod_facCorrnTVlvFcoMFlowB1_M ExhMod_facHeatTranCoeffExhVlvSecFu_C ExhMod_facTExhVlvCorrnEngT_T ExhMod_facTExhVlvCorrnIntkAir_T ExhMod_facTExhVlvCorrnLamB1_M ExhMod_facTExhVlvCorrnLamB1_T ExhMod_facTExhVlvCorrnLamSecFuB1_M ExhMod_facTExhVlvCorrnLamSecFuB1_T ExhMod_facTExhVlvCorrnRriB1_M ExhMod_htcExhVlvWallB1_T ExhMod_htcVlvEnvB1_C ExhMod_offsTExhVlvCorrnEngTB1_M ExhMod_offsTExhVlvCorrnFcoIntkAir_T ExhMod_offsTExhVlvCorrnIntkAirB1_M ExhMod_offsTExhVlvCorrnLamB1_M ExhMod_offsTExhVlvCorrnLamSecFuB1_M ExhMod_stTVlvMdl_C ExhMod_tExhVlvCorrnOffB1_M ExhMod_tExhVlvEgrHomB1_M ExhMod_tExhVlvEgrHomSecFuB1_M ExhMod_tExhVlvFcoB1_M ExhMod_tExhVlvFcoHiVlvLft_M ExhMod_tExhVlvHomB1_M ExhMod_tExhVlvHomHiVlvLftB1_M ExhMod_tExhVlvHomSecFuB1_M ExhMod_tiConTExhVlvFcoB1_T TExhVlvMdl_CorrnIgnAgB1_I.facCorrnIgnAgCatHeatg_M TExhVlvMdl_CorrnIgnAgB1_I.facCorrnIgnAgHomSecFu_M TExhVlvMdl_CorrnIgnAgB1_I.facCorrnIgnAgHom_M TExhVlvMdl_CorrnIgnAgB1_I.facCorrnIgnAgHom_T TExhVlvMdl_CorrnIgnAgB1_I.facCorrnIgnAgHspCatHeatSust_M TExhVlvMdl_CorrnIgnAgB1_I.facCorrnIgnAgHspCatHeatSust_T TExhVlvMdl_CorrnIgnAgB1_I.facCorrnIgnAgHspCatHeatg_T TExhVlvMdl_CorrnIgnAgB1_I.facCorrnIgnAgHspRgn_M TExhVlvMdl_CorrnIgnAgB1_I.facCorrnIgnAgHsp_M TExhVlvMdl_CorrnIgnAgB1_I.facCorrnIgnAgHsp_T TExhVlvMdl_CorrnIgnAgB1_I.facCorrnIgnAgSecFu_T TExhVlvMdl_CorrnIgnAgB1_I.offsCorrnIgnAgHom_M TExhVlvMdl_CorrnIgnAgB1_I.offsCorrnIgnAgHspCatHeatSust_M TExhVlvMdl_CorrnIgnAgB1_I.offsCorrnIgnAgHspCatHeatg_M TExhVlvMdl_CorrnIgnAgB1_I.offsCorrnIgnAgHsp_M TExhVlvMdl_CorrnIgnAgB1_I.offsCorrnIgnAgSecFu_M /end DEF_CHARACTERISTIC
 /begin REF_CHARACTERISTIC ExhMod_cpShcpExhGas_T /end REF_CHARACTERISTIC
 /begin IN_MEASUREMENT AirMod_ratChrgAirCyl B_bevab_msg B_khakt_msg B_khakw_msg B_sa_msg B_vheg_msg CEngDsT_t CoEOM_flgHsp EngStrt_bFrstStrtEnd EngStrt_bStrtEnd Epm_nEng etazwb_w_msg etazwist_w_msg ExhMod_facIntrpnGslSecFu ExhMod_mfExhAryB1 ExhMod_mfExhVlvB1 ExhMod_tWallAryB1 frrieas_msg InjSys_ratFuMTot IntkAirT_tIntkMnfld IntkAirT_tThrVlvUs lamsbg_w_msg redistb1_msg rri_w_msg /end IN_MEASUREMENT
 /begin OUT_MEASUREMENT ExhMod_effIgnAgAvrgB1 ExhMod_facCorrnTExhVlvIgnAgB1 ExhMod_facCorrnTExhVlvIgnAgB2 ExhMod_facCorrnTExhVlvIgnAgBasB1 ExhMod_facCorrnTExhVlvIgnAgBasB2 ExhMod_facCorrnTExhVlvLamB1 ExhMod_facCorrnTExhVlvLamB2 ExhMod_flgCorrnTExhVlvSeln ExhMod_tExhDsVlvB1 ExhMod_tExhVlvB1 ExhMod_tOffsCorrnTExhVlvIgnAgB1 ExhMod_tOffsCorrnTExhVlvIgnAgBasB1 ExhMod_tOffsCorrnTExhVlvLamB1 /end OUT_MEASUREMENT
 /begin LOC_MEASUREMENT ExhMod_effIgnAgAvrgBas ExhMod_facIaActB1 ExhMod_facTExhVlvCorrnRriB1 ExhMod_flgCcoB1 ExhMod_flgHiVlvlft ExhMod_flgSelnCorrnTExhVlvLoc ExhMod_mfTExhVlvMdlB1 ExhMod_offsCorrnTExhVlvEngTB1 ExhMod_offsCorrnTExhVlvIntkAirB1 ExhMod_offsTExhVlvCorrnLamB1 ExhMod_ratLamVlvB1 ExhMod_ratRelAirFuFillgB1 ExhMod_tEngCoolt ExhMod_tExhVlvCcoFcoB1 ExhMod_tExhVlvCorrdB1 ExhMod_tExhVlvCorrdDynB1 ExhMod_tExhVlvCorrdFildB1 ExhMod_tExhVlvCorrdIgnAgB1 ExhMod_tExhVlvCorrdIntkAirB1 ExhMod_tExhVlvCorrdLamThrB1 ExhMod_tExhVlvCorrdRriB1 ExhMod_tExhVlvHomB1 ExhMod_tExhVlvHomEgrB1 ExhMod_tExhVlvIntkAir ExhMod_tExhVlvLocB1 ExhMod_tQstyExhVlvB1 ExhMod_tVlvB1 TExhVlMdl_If_CorrnIgnAg_I.B_khakt TExhVlMdl_If_CorrnIgnAg_I.B_khakw TExhVlMdl_If_CorrnIgnAg_I.B_khasu TExhVlMdl_If_CorrnIgnAg_I.ExhMgT_flgCatHeatgPfil TExhVlMdl_If_CorrnIgnAg_I.effIgnAgAvrg TExhVlMdl_If_CorrnIgnAg_I.etakh_w TExhVlMdl_If_CorrnIgnAg_I.facIntrpnGslSecFu TExhVlMdl_If_CorrnIgnAg_I.flgHspActv TExhVlMdl_If_CorrnIgnAg_I.flgSelnCorrnTExhVlv TExhVlMdl_If_CorrnIgnAg_I.flgTExhVlvGpfRgnActv TExhVlMdl_If_CorrnIgnAg_I.idxMapTExhVlv TExhVlMdl_If_CorrnIgnAg_I.idxMapTExhVlvSecFu TExhVlMdl_If_CorrnIgnAg_I.mfTExhVlvMdl TExhVlMdl_If_CorrnIgnAg_I.nEng TExhVlMdl_If_CorrnIgnAg_I.ratChrgAirCyl TExhVlMdl_If_Out_CorrnIgnAgB1_I.facCorrnIgnAg TExhVlMdl_If_Out_CorrnIgnAgB1_I.facCorrnIgnAgHom TExhVlMdl_If_Out_CorrnIgnAgB1_I.facCorrnIgnAgHsp TExhVlMdl_If_Out_CorrnIgnAgB1_I.offsCorrnIgnAg TExhVlMdl_If_Out_CorrnIgnAgB1_I.offsCorrnIgnAgHom TExhVlMdl_If_Out_CorrnIgnAgB1_I.offsCorrnIgnAgHsp TExhVlMdl_If_Out_CorrnIgnAgB1_I.offsCorrnIgnAgLoc TExhVlMdl_If_Out_CorrnIgnAgB1_I.tOffsCorrnIgnAgEom TExhVlMdl_If_Out_CorrnIgnAgB1_I.tOffsCorrnIgnAgEomGsl TExhVlMdl_If_Out_CorrnIgnAgB1_I.tOffsCorrnIgnAgEomSecFu TExhVlMdl_If_Out_CorrnIgnAgBasB1_I.facCorrnIgnAg TExhVlMdl_If_Out_CorrnIgnAgBasB1_I.facCorrnIgnAgHom TExhVlMdl_If_Out_CorrnIgnAgBasB1_I.facCorrnIgnAgHsp TExhVlMdl_If_Out_CorrnIgnAgBasB1_I.offsCorrnIgnAg TExhVlMdl_If_Out_CorrnIgnAgBasB1_I.offsCorrnIgnAgHom TExhVlMdl_If_Out_CorrnIgnAgBasB1_I.offsCorrnIgnAgHsp TExhVlMdl_If_Out_CorrnIgnAgBasB1_I.offsCorrnIgnAgLoc TExhVlMdl_If_Out_CorrnIgnAgBasB1_I.tOffsCorrnIgnAgEom TExhVlMdl_If_Out_CorrnIgnAgBasB1_I.tOffsCorrnIgnAgEomGsl TExhVlMdl_If_Out_CorrnIgnAgBasB1_I.tOffsCorrnIgnAgEomSecFu TExhVlvMdl_AvrgB1_I.cntrSum TExhVlvMdl_AvrgB1_I.effIgnAgAvrg TExhVlvMdl_AvrgB1_I.effIgnAgSingleValue TExhVlvMdl_AvrgB1_I.effIgnAgSum TExhVlvMdl_AvrgBas_I.cntrSum TExhVlvMdl_AvrgBas_I.effIgnAgAvrg TExhVlvMdl_AvrgBas_I.effIgnAgSingleValue TExhVlvMdl_AvrgBas_I.effIgnAgSum TExhVlvMdl_PipMdl_I.tExhOutp TExhVlvMdl_PipMdl_I.ExhMod_HeatBalIfPipMdl_I.HeatStorg1 TExhVlvMdl_PipMdl_I.ExhMod_HeatBalIfPipMdl_I.HeatStorg2 TExhVlvMdl_PipMdl_I.ExhMod_HeatBalIfPipMdl_I.HeatStorg3 TExhVlvMdl_PipMdl_I.ExhMod_HeatBalIfPipMdl_I.HeatTrf0To1 TExhVlvMdl_PipMdl_I.ExhMod_HeatBalIfPipMdl_I.HeatTrf1To2 TExhVlvMdl_PipMdl_I.ExhMod_HeatBalIfPipMdl_I.HeatTrf2To3 TExhVlvMdl_PipMdl_I.ExhMod_HeatBalIfPipMdl_I.HeatTrf3To4 TExhVlvMdl_PipMdl_I.ExhMod_HeatBalIfPipMdl_I.egyExt1 TExhVlvMdl_PipMdl_I.ExhMod_HeatBalIfPipMdl_I.egyExt2 TExhVlvMdl_PipMdl_I.ExhMod_HeatBalIfPipMdl_I.egyExt3 TExhVlvMdl_PipMdl_I.ExhMod_HeatBalIfPipMdl_I.flg3HeatBal TExhVlvMdl_PipMdl_I.ExhMod_HeatBalIfPipMdl_I.tHiResl0 TExhVlvMdl_PipMdl_I.ExhMod_HeatBalIfPipMdl_I.tHiResl1 TExhVlvMdl_PipMdl_I.ExhMod_HeatBalIfPipMdl_I.tHiResl2 TExhVlvMdl_PipMdl_I.ExhMod_HeatBalIfPipMdl_I.tHiResl3 TExhVlvMdl_PipMdl_I.ExhMod_HeatBalIfPipMdl_I.tHiResl4 TExhVlvMdl_PipMdl_I.ExhMod_HeatBal_I.tHiReslOutp1 TExhVlvMdl_PipMdl_I.ExhMod_HeatBal_I.tHiReslOutp2 TExhVlvMdl_PipMdl_I.ExhMod_HeatBal_I.tHiReslOutp3 TExhVlv_facCorrnLamB1 TExhVlv_offsCorrnLamB1 /end LOC_MEASUREMENT
 FUNCTION_VERSION "1.34.0" /end FUNCTION
/begin FUNCTION ExhMod_TiEngOff "1.5.0     Calculation of Engine Off Time for ExhMod" /begin DEF_CHARACTERISTIC ExhMod_tiDlyEngStop_C ExhMod_tiSigHoldEngRunng_C /end DEF_CHARACTERISTIC
 /begin IN_MEASUREMENT SyC_ctPostDrvLeave TiOff_bStrtEndOffActive TiOff_cntrStrtEndOffRst TiOff_stTiStrtEndOff TiOff_tiStrtEndOff /end IN_MEASUREMENT
 /begin OUT_MEASUREMENT ExhMod_flgEngRunngTiEngOff ExhMod_flgTiEngOffVld ExhMod_tiEngOff /end OUT_MEASUREMENT
 /begin LOC_MEASUREMENT ExhMod_bStrtEndOffActiveLst ExhMod_cntrStrtEndOffRstLst ExhMod_flgEngRunngTiEngOffRaw ExhMod_tiSigHoldEngRunng ExhMod_tiStrtEndOff ExhMod_tiStrtEndOffLoc TiEngOff_ctReIni /end LOC_MEASUREMENT
 FUNCTION_VERSION "1.5.0" /end FUNCTION
/begin FUNCTION ExhMod_TIf "1.28.0    Conversion From Intern Temperatures Of The Exhaust Temperature Modell To The Sys"
 /begin DEF_CHARACTERISTIC ExhMod_facTauTExhB1_T ExhMod_idxSnsrB1_CA ExhMod_idxTCat1ExtdB1_CA ExhMod_idxTCat2ExtdB1_CA ExhMod_idxTExhB1_CA ExhMod_stTExhCat1_C ExhMod_stTExhCat2_C ExhMod_stTExhFltd_C ExhMod_stTExhMnfFirstPipY_C ExhMod_stTExhSnsr_C ExhMod_stTWallSnsr_C ExhMod_tauTExhCat1ExtdB1_CA ExhMod_tauTExhCat2ExtdB1_CA ExhMod_tauTExhMnfFirstPipYB1_CA ExhMod_tauTExhSnsrB1_CA ExhMod_tExhCat1ExtdAppl_CA ExhMod_tExhCat2ExtdAppl_CA ExhMod_tExhSnsrAppl_CA ExhMod_tMnfFirstPipYAppl_CA ExhMod_tWallSnsrAppl_CA /end DEF_CHARACTERISTIC
 /begin IN_MEASUREMENT CEngDsT_t EngStrt_bFrstStrtEnd EngStrt_bStrtEnd ExhMod_idxFrtBrickCatAryB1 ExhMod_idxLstBrickCatAryB1 ExhMod_mfExhMnfB1 ExhMod_nrBrickCatAryB1 ExhMod_tExhAryB1 ExhMod_tMtrlAryB1 ExhMod_tWallAryB1 /end IN_MEASUREMENT
 /begin OUT_MEASUREMENT ExhMod_tCat1AvrgB1 ExhMod_tCat1B1 ExhMod_tCat1EndB1 ExhMod_tCat1InB1 ExhMod_tCat1MaxB1 ExhMod_tCat1MinB1 ExhMod_tCat2AvrgB1 ExhMod_tCat2B1 ExhMod_tCat2EndB1 ExhMod_tCat2InB1 ExhMod_tCat2MaxB1 ExhMod_tCat2MinB1 ExhMod_tCatAryB1 ExhMod_tCatAvrgAryB1 ExhMod_tCatBrickAryB1 ExhMod_tCatEndAryB1 ExhMod_tCatInAryB1 ExhMod_tEng ExhMod_tExhCat1DsB1 ExhMod_tExhCat1UsAvrgB1 ExhMod_tExhCat1UsB1 ExhMod_tExhCat2DsB1 ExhMod_tExhCat2UsAvrgB1 ExhMod_tExhCat2UsB1 ExhMod_tExhCatDsAryB1 ExhMod_tExhCatUsAryB1 ExhMod_tExhFrtPipB1 ExhMod_tExhMnfB1 ExhMod_tExhMnfQstyB1 ExhMod_tExhS1B1 ExhMod_tExhS2B1 ExhMod_tExhSnsrAryB1 ExhMod_tWallCat1AvrgB1 ExhMod_tWallCat1B1 ExhMod_tWallCat1EndB1 ExhMod_tWallCat1InB1 ExhMod_tWallCat1MaxB1 ExhMod_tWallCat1MinB1 ExhMod_tWallCat2AvrgB1 ExhMod_tWallCat2B1 ExhMod_tWallCat2EndB1 ExhMod_tWallCat2InB1 ExhMod_tWallCat2MaxB1 ExhMod_tWallCat2MinB1 ExhMod_tWallCatAryB1 ExhMod_tWallCatEndAryB1 ExhMod_tWallCatInAryB1 ExhMod_tWallMnfB1 ExhMod_tWallS1B1 ExhMod_tWallS2B1 ExhMod_tWallSnsrAryB1 /end OUT_MEASUREMENT
 /begin LOC_MEASUREMENT ExhMod_tWallCatAvrgAryB1 MINMAXAVRG_n.tavrg MINMAXAVRG_n.tmax MINMAXAVRG_n.tmin /end LOC_MEASUREMENT
 FUNCTION_VERSION "1.28.0" /end FUNCTION
/begin FUNCTION ExhMod_TMdl "7.8.1     Temperature Model Exhaust System"
 /begin DEF_CHARACTERISTIC ExhMod_cpAbsltCanngB1_M ExhMod_cpAbsltPipeCatB1_M ExhMod_cpShcpExhGas_T ExhMod_facEnvPCorrnHtcWallEnv_T ExhMod_facHeatTranCoeffExhWallBrickSecFu_C ExhMod_facHtcWallEnvBlowrCorrnB1_T ExhMod_htcCatCanngB1_M ExhMod_htcExhWallBrickB1_M ExhMod_htcWallEnvB1_M ExhMod_htcWallEnvBlowrB1_M ExhMod_stCalcnIdealHeatTrfExhBrickB1_CA ExhMod_stSepCanngActv_C /end DEF_CHARACTERISTIC
 /begin REF_CHARACTERISTIC ExhMod_stCfgExhSysB1_CA /end REF_CHARACTERISTIC
 /begin IN_MEASUREMENT ExhMod_facIntrpnGslSecFu ExhMod_idxFrtBrickCatAryB1 ExhMod_idxLstBrickCatAryB1 ExhMod_mfExhAryB1 ExhMod_pwrCondsAryB1 ExhMod_pwrReactnMapBasdAryB1 ExhMod_ratBlowrAvrgB1 ExhMod_stTMdlCurrMod ExhMod_tCatBrickIninAryB1 ExhMod_tEnvCorrdTEngAryB1 ExhMod_tExhDsVlvB1 ExhMod_tWallIninAryB1 ExhMod_vVehLoc PEnv_p /end IN_MEASUREMENT
 /begin OUT_MEASUREMENT ExhMod_tCatNvAryB1 ExhMod_tExhAryB1 ExhMod_tMtrlAryB1 ExhMod_tWallAryB1 ExhMod_tWallNvAryB1 /end OUT_MEASUREMENT
 /begin LOC_MEASUREMENT ExhMod_cntrMplBrB1 ExhMod_flgSepCanngActv ExhMod_htcExhWallBrickB1 ExhMod_htcWallEnvB1 ExhMod_tCanngMplBrickAryB1 ExhMod_tCatBrickHiReslAryB1 ExhMod_tCatMplBrickAryB1 ExhMod_tExhMplBrickAryB1 /end LOC_MEASUREMENT
 FUNCTION_VERSION "7.8.1" /end FUNCTION
/begin FUNCTION ExhMod_TMdlInin "1.0.1     Initialisation of the exhaust system temperature model"
 /begin DEF_CHARACTERISTIC ExhMod_facIntrpnCoolgCrv_M ExhMod_idxIninSctn_CA ExhMod_stCfgIninB1_CA ExhMod_stSelnExhTSnsrInvldTiEngOffB1_CA ExhMod_stSelnReplcmtValStgyB1_CA ExhMod_stSigQlyMskEnvT_C ExhMod_tExhIninB1_CA ExhMod_tReplcmtVal_C /end DEF_CHARACTERISTIC
 /begin REF_CHARACTERISTIC ExhMod_stCfgExhSysB1_CA ExhMod_stSepCanngActv_C /end REF_CHARACTERISTIC
 /begin IN_MEASUREMENT CEngDsT_t Eep_EnvRamHist Eep_EnvRamInvld EnvT_t EnvT_t_Sq ExhMod_flgEngRunngTiEngOff ExhMod_flgTiEngOffVld ExhMod_stTMdlCurrMod ExhMod_tCatNvAryB1 ExhMod_tiEngOff ExhMod_tWallNvAryB1 /end IN_MEASUREMENT
 /begin OUT_MEASUREMENT ExhMod_stTMdlIninCurrModAryB1 ExhMod_tCatBrickIninAryB1 ExhMod_tWallIninAryB1 /end OUT_MEASUREMENT
 /begin LOC_MEASUREMENT ExhMod_flgIninSepCanngActv ExhMod_flgInvldNvValInin ExhMod_flgVldyEnvTInin ExhMod_tEngInin ExhMod_tEnvInin ExhMod_tiEngOffCorrn ExhMod_tiEngOffLoc flgSelnExhTSnsrInvldTiEngOffB1 flgSelnReplcmtValStgy flgVldyCooltT flgVldyEnvT flgVldyExhTSnsr flgVldyTiEngOff stCfgIninB1 stTMdlIninCurrModB1 /end LOC_MEASUREMENT
 FUNCTION_VERSION "1.0.1" /end FUNCTION
/begin FUNCTION ExhMod_TMdlSt "1.0.0     Determination of exhaust sytem temperature model state"
 /begin DEF_CHARACTERISTIC ExhMod_stSelnTCalcnAftSucInin_C ExhMod_stSelnTCalcnDurgEngOff_C /end DEF_CHARACTERISTIC
 /begin IN_MEASUREMENT Eep_EnvRamHist Eep_EnvRamInvld ExhMod_flgEngRunngTiEngOff ExhMod_flgTiEngOffVld /end IN_MEASUREMENT
 /begin OUT_MEASUREMENT ExhMod_flgTIninCmpl ExhMod_stTMdlCurrMod /end OUT_MEASUREMENT
 /begin LOC_MEASUREMENT ExhMod_flgFrstEngRunng ExhMod_flgInvldNvVal ExhMod_flgMdlCalcnFrcd ExhMod_flgSelnTCalcnAftSucInin ExhMod_flgSelnTCalcnDurgEngOff ExhMod_flgStFrstEngRunng ExhMod_flgStIninSuc ExhMod_flgStMdlCalcn ExhMod_stTMdlCurrModLoc /end LOC_MEASUREMENT
 FUNCTION_VERSION "1.0.0" /end FUNCTION
/begin FUNCTION ExhMod_TPistMdl "1.8.0     Piston Temperature Model"
 /begin DEF_CHARACTERISTIC ExhMod_cpAbsltPistB1_C ExhMod_facHtcPistFco_C ExhMod_facHtcPist_T ExhMod_facIgnAgCorrn_T ExhMod_facMFlowCorrn_T ExhMod_htcCooltWtrPist_T ExhMod_htcExhPistB1_T ExhMod_htcOilPist_T ExhMod_stTPist_C /end DEF_CHARACTERISTIC
 /begin IN_MEASUREMENT B_sa_msg CEngDsT_t Epm_nEng ExhMod_mfExhVlvB1 ExhMod_tExhDsVlvB1 ExhMod_tExhVlvB1 Ign_iaBas_s8 Ign_iacalc_s8 OilSwmpT_t OilSwmpT_tMdl Oil_pRel /end IN_MEASUREMENT
 /begin OUT_MEASUREMENT ExhMod_tPistB1 ExhMod_tPistCmbB1 ExhMod_tPistDeltaB1 ExhMod_tPistDeltaKelvinB1 ExhMod_tPistQstyB1 /end OUT_MEASUREMENT
 /begin LOC_MEASUREMENT TPist_htcExhPistCmbB1 TPist_iaDif TPist_mfExhCmbB1 TPist_pwrOilCmbB1 TPist_tExhPist TPist_tExhPistInB1 TPist_tPistCmbQstyB1 /end LOC_MEASUREMENT
 FUNCTION_VERSION "1.8.0" /end FUNCTION
/begin FUNCTION ExhMod_TspSnsrRels "1.9.0     TSP sensor heater release condition from ExhMod"
 /begin DEF_CHARACTERISTIC ExhMod_facEgyThdTspNoCatHeatgS1B1_M ExhMod_facEgyThdTspNoCatHeatgS2B1_M ExhMod_facEgyThdTspNoCatHeatgSecFuS1B1_M ExhMod_facEgyThdTspNoCatHeatgSecFuS2B1_M ExhMod_facEgyThdTspS1B1_M ExhMod_facEgyThdTspS2B1_M ExhMod_facEgyThdTspSecFuS1B1_M ExhMod_facEgyThdTspSecFuS2B1_M ExhMod_facIntrpnTspWtrCntntSecFu_T ExhMod_nrMaxColdStrtTspS1_C ExhMod_nrMaxColdStrtTspS2_C ExhMod_stTspSnsrRelsB1_CA ExhMod_stTspSnsrRels_C /end DEF_CHARACTERISTIC
 /begin IN_MEASUREMENT B_ethadap_msg B_ethhte_msg B_khakt_msg B_khan_msg CEngDsT_tStrtFrst EngStrt_bFrstStrtEnd ExhMod_cntrCldStrtS1B1 ExhMod_cntrCldStrtS2B1 ExhMod_egyDewPntEndS1B1 ExhMod_egyDewPntEndS2B1 ExhMod_egyThdDewPntEndS1B1 ExhMod_egyThdDewPntEndS2B1 ExhMod_facIntrpnGslSecFu ExhMod_flgDewPntEndS1B1 ExhMod_flgDewPntEndS2B1 ExhMod_tEngStrtDewDet ExhMod_tExhStrtS1B1 ExhMod_tExhStrtS2B1 SyC_stSub /end IN_MEASUREMENT
 /begin OUT_MEASUREMENT ExhMod_flgDewPntEndRstTspS1B1 ExhMod_flgHeatgTspS1B1 ExhMod_flgHeatgTspS2B1 /end OUT_MEASUREMENT
 /begin LOC_MEASUREMENT ExhMod_facEgyThdTspS1B1 ExhMod_facEgyThdTspS2B1 ExhMod_flgCatHtgColdStrtTsp ExhMod_flgDewPntEndRstTspS2B1 ExhMod_flgTspRelsNoRstS1B1 ExhMod_flgTspRelsNoRstS2B1 ExhMod_stSubOldTspSnsrRels /end LOC_MEASUREMENT
 FUNCTION_VERSION "1.9.0" /end FUNCTION
/begin FUNCTION ExhMod_Util "1.7.0     Service function for BC ExhMod" /begin DEF_CHARACTERISTIC ExhMod_stUtil_C /end DEF_CHARACTERISTIC /begin IN_MEASUREMENT FfPrm_facEth FfPrm_flgEthHiTolr /end IN_MEASUREMENT /begin OUT_MEASUREMENT ExhMod_facIntrpnGslSecFu /end OUT_MEASUREMENT FUNCTION_VERSION "1.7.0" /end FUNCTION
/begin FUNCTION ExhMod_WtrMdl "2.6.1_1.4.0Exhaust Condense Water Modell"
 /begin DEF_CHARACTERISTIC ExhMod_arSurfCondsB1_T ExhMod_egyEnthCondsH2oB1_M ExhMod_facRednSatPB1_M ExhMod_facRednSurfCondsB1_M ExhMod_mtcH2oB1_M ExhMod_pExhApplWtrMdl_C ExhMod_stWtrMdl_C /end DEF_CHARACTERISTIC
 /begin REF_CHARACTERISTIC ExhMod_pSatnH2o_T ExhMod_stCfgExhSysB1_CA ExhMod_stRawEmiMdl_C /end REF_CHARACTERISTIC
 /begin IN_MEASUREMENT ExhMod_concMH2oVlvB1 ExhMod_idxEgrPosnB1 ExhMod_mfExhAryB1 ExhMod_pExhAryB1 ExhMod_tMtrlAryB1 ExhMod_tWallAryB1 PEnv_p /end IN_MEASUREMENT
 /begin OUT_MEASUREMENT ExhMod_concMH2oEgrUsB1 ExhMod_pwrCondsAryB1 /end OUT_MEASUREMENT
 /begin LOC_MEASUREMENT ExhMod_concMH2oAryWtrMdlB1 ExhMod_flgCondsAryB1 ExhMod_mH2oAryB1 /end LOC_MEASUREMENT
 FUNCTION_VERSION "2.6.1_1.4.0" /end FUNCTION
/begin FUNCTION FanCtl_Spd "104.5.0   Fan Control"
 /begin DEF_CHARACTERISTIC FanCtl_facAftRunCorrd_CUR FanCtl_flgSwtAntiFlickDeactv_C FanCtl_nAntiFlickThd_C FanCtl_nFanDecelHi_C FanCtl_nFanDecelLo_C FanCtl_nSpdHi_C FanCtl_nSpdLo_C FanCtl_pCooltPDeltaHi_C FanCtl_pCooltPHiHi_T FanCtl_pCooltPLoHi_C FanCtl_pCooltPLoLo_C FanCtl_pCooltPProhbHi_C FanCtl_pCooltPProhbLo_C FanCtl_pDutyPerdP11Hi_C FanCtl_pDutyPerdP11Lo_C FanCtl_pDutyPerdP12Hi_C FanCtl_pDutyPerdP12Lo_C FanCtl_pDutyPerdP13Hi_C FanCtl_pDutyPerdP13Lo_C FanCtl_pDutyPerdP14Hi_C FanCtl_pDutyPerdP14Lo_C FanCtl_pDutyPerdP1Hi_C FanCtl_pDutyPerdP1Lo_C FanCtl_pDutyPerdP21Hi_C FanCtl_pDutyPerdP21Lo_C FanCtl_pDutyPerdP22Hi_C FanCtl_pDutyPerdP22Lo_C FanCtl_pDutyPerdP23Hi_C FanCtl_pDutyPerdP23Lo_C FanCtl_pDutyPerdP24Hi_C FanCtl_pDutyPerdP24Lo_C FanCtl_pDutyPerdP2Hi_C FanCtl_pDutyPerdP2Lo_C FanCtl_pDutyPerdP3HiHi_C FanCtl_pDutyPerdP3HiLo_C FanCtl_pDutyPerdP3Hi_C FanCtl_pDutyPerdP3Lo_C FanCtl_pDutyPerdP4Hi_C FanCtl_pDutyPerdP4Lo_C FanCtl_rAftRunDutyPred_C FanCtl_rAftRunEnd_C FanCtl_rDutyPredHi_C FanCtl_rDutyPredLo_C FanCtl_rDutyPredMid1_C FanCtl_rDutyPredMid2_C FanCtl_rFailSafeDutyPerd_C FanCtl_rFanDutyHi_C FanCtl_rFanDutyLo_C FanCtl_rFanDutyOff_C FanCtl_rPDpdtDutyPerd11_C FanCtl_rPDpdtDutyPerd12_C FanCtl_rPDpdtDutyPerd13_C FanCtl_rPDpdtDutyPerd14_C FanCtl_rPDpdtDutyPerd15_C FanCtl_rPDpdtDutyPerd1_C FanCtl_rPDpdtDutyPerd21_C FanCtl_rPDpdtDutyPerd22_C FanCtl_rPDpdtDutyPerd23_C FanCtl_rPDpdtDutyPerd24_C FanCtl_rPDpdtDutyPerd25_C FanCtl_rPDpdtDutyPerd2_C FanCtl_rPDpdtDutyPerd3_C FanCtl_rPDpdtDutyPerd4_C FanCtl_rPDpdtDutyPerd5_C FanCtl_rRadrFanDutyHi_C FanCtl_rTDpdtDutyPerd1_C FanCtl_rTDpdtDutyPerd2_C FanCtl_rTDpdtDutyPerd3_C FanCtl_rTDpdtDutyPerd4_C FanCtl_stACCooltPSnsr_C FanCtl_swtPWMFanActv_C FanCtl_tCooltTHi_C FanCtl_tCooltTLoHi_C FanCtl_tCooltTLoLo_C FanCtl_tCooltTLo_C FanCtl_tCooltT_C FanCtl_tDutyPerdT1Hi_C FanCtl_tDutyPerdT1Lo_C FanCtl_tDutyPerdT2Hi_C FanCtl_tDutyPerdT2Lo_C FanCtl_tDutyPerdT3Hi_C FanCtl_tDutyPerdT3Lo_C FanCtl_tiACGFixdMod_C FanCtl_tiAftRun_C FanCtl_tiAftRun_CUR FanCtl_tiAntiFlickLim_C FanCtl_tiImdtHiStgOnDly_C FanCtl_tiRlyCtrlDly_C FanCtl_tiSpdOffDly_C FanCtl_tiSpdOnDly_C FanCtl_tiTrqResvFan1_C FanCtl_tiTrqResvFan2_C FanCtl_tqThrIdleTqValHi_C FanCtl_tqThrIdleTqValLo_C FanCtl_uAntiFlickThd_C FanCtl_uDutyPerdUHi_C FanCtl_uDutyPerdULo_C FanCtl_uFailSafeBlowrU_C FanCtl_vLoVehSpdHi_C FanCtl_vModSelnSpdHiHi_C FanCtl_vModSelnSpdHiLo_C FanCtl_vModSelnSpdLoHi_C FanCtl_vModSelnSpdLoLo_C FanCtl_vSpdHiHi_C FanCtl_vSpdHiLo_C FanCtl_vSpdLoHi_C FanCtl_vSpdLoLo_C /end DEF_CHARACTERISTIC
 /begin IN_MEASUREMENT ACCtl_stSwtAc AirC_pClnt Alt_stSel Alt_uDes BattU_u Com_stISSRelsPreNotif Com_uFrntBlowrU Com_uMICUTxBlowrU CoVeh_stEngStrtOrd CoVM_trqLead ElecLd_stAutoAC ElecLd_stHdLiInfo Epm_nEng FanCtl_stFanCtrlEnd Fan_r Fan_r2 GlbDa_tEnv HdLi_flgActv PthSet_bOvrRun PT_stTraType SrvCSwt_st Strt_stStaActv SyC_ctPostDrvLeave T15_st Tra_stCrkNotCmpl TSDa_tClntRadOut TS_tClntEngOut VehV_v /end IN_MEASUREMENT
 /begin OUT_MEASUREMENT FanCtl_bTrqResvFan1 FanCtl_bTrqResvFan2 FanCtl_flgACGOn FanCtl_flgAftRunActv FanCtl_flgAntiFlickActv FanCtl_rPDpdtDutyPerd FanCtl_rPTDpdtDutyPerd FanCtl_rTDpdtDutyPerd FanCtl_st FanCtl_stPDpdtDutyHiDmd FanCtl_stStg FanCtl_stTDpdtDutyHiDmd FanCtl_tClnt /end OUT_MEASUREMENT
 /begin LOC_MEASUREMENT FanCtl_cntrReIni FanCtl_flgActvCooltTHi FanCtl_flgActvCooltTLo FanCtl_flgActvSpdOld FanCtl_flgAntiFlickHiStg FanCtl_flgFailActn FanCtl_flgFanCooltPHiSts FanCtl_flgFanCooltPLoSts FanCtl_flgHiDlyCtrlProhbSts FanCtl_flgHiStgSt FanCtl_flgIdleStopCdn FanCtl_flgImdtHiStg FanCtl_flgLowStgSt FanCtl_flgXPostDrv_mp FanCtl_pClnt FanCtl_rFan1 FanCtl_rFan2 FanCtl_stActvHi_MP FanCtl_stActvLo_MP FanCtl_stCooltPHiCtrlHys FanCtl_stCooltPLoCtrlHys FanCtl_stCooltPProhbHysOutp FanCtl_stFanDecel_MP FanCtl_stFanRlyCtrl_MP FanCtl_stHiModDutyPred_MP FanCtl_stLoModDutyPred_MP FanCtl_stMidModDutyPred_MP FanCtl_stMod FanCtl_stModSelnSpdHi_MP FanCtl_stModSelnSpdLo_MP FanCtl_stSpd_mp FanCtl_stTDpdtDutyPerd_MP FanCtl_stThrIdle FanCtl_tCooltT FanCtl_tiAftRunRmn FanCtl_tiAR1S_mp FanCtl_tiSpdDiffTmr FanCtl_uBlowrFanU /end LOC_MEASUREMENT
 FUNCTION_VERSION "104.5.0" /end FUNCTION
/begin FUNCTION Fans_Trq "24.1.0    Fans Torque Request"
 /begin DEF_CHARACTERISTIC Fans_tiTrqConsFltFan1_C Fans_tiTrqConsFltFan2_C Fans_tiTrqResvFan1_C Fans_tiTrqResvFan2_C Fans_tiTrqResvFltFan1_C Fans_tiTrqResvFltFan2_C Fans_trqConsFan1_CUR Fans_trqConsFan2_CUR Fans_trqResvFan1_C Fans_trqResvFan1_CUR Fans_trqResvFan2_C Fans_trqResvFan2_CUR /end DEF_CHARACTERISTIC
 /begin IN_MEASUREMENT Epm_nEng FanCtl_bTrqResvFan1 FanCtl_bTrqResvFan2 Fan_r Fan_r2 T15_st /end IN_MEASUREMENT
 /begin OUT_MEASUREMENT Fans_trqCons Fans_trqResv /end OUT_MEASUREMENT
 /begin LOC_MEASUREMENT Fans_trqConsFan1_MP Fans_trqConsFan2_MP Fans_trqConsUnFltFan1_MP Fans_trqConsUnFltFan2_MP Fans_trqResvFan1_MP Fans_trqResvFan2_MP Fans_trqResvUnFltFan1_MP Fans_trqResvUnFltFan2_MP /end LOC_MEASUREMENT
 FUNCTION_VERSION "24.1.0" /end FUNCTION
/begin FUNCTION Fan_DD "4.12.0    Fan Device Driver"
 /begin DEF_CHARACTERISTIC FanDig0_ATS.LimitTypeMsk_C FanDig0_ATS.CnvNorm_C FanDig0_ATS.LowLim_C FanDig0_ATS.UpLim_C FanDig0_ATS.CnvFac_C FanDig0_ATS.CnvOfs_C FanDig0_ATS.DfltVal_C FanDig1_ATS.LimitTypeMsk_C FanDig1_ATS.CnvNorm_C FanDig1_ATS.LowLim_C FanDig1_ATS.UpLim_C FanDig1_ATS.CnvFac_C FanDig1_ATS.CnvOfs_C FanDig1_ATS.DfltVal_C Fan_DigOut0.tiBtwTstSCB_C Fan_DigOut0.tiBtwTstOT_C Fan_DigOut0.numTstMax_C Fan_DigOut1.tiBtwTstSCB_C Fan_DigOut1.tiBtwTstOT_C Fan_DigOut1.numTstMax_C Fan_rHysHi_CA Fan_rHysLo_CA Fan_stPsDiaDisblDIO_CA Fan_stPsDisDIO_CA /end DEF_CHARACTERISTIC
 /begin IN_MEASUREMENT DevLib_stPwrStgEnaCond /end IN_MEASUREMENT
 /begin OUT_MEASUREMENT Fan_r Fan_r2 Fan_stPs /end OUT_MEASUREMENT
 FUNCTION_VERSION "4.12.0" /end FUNCTION
/begin FUNCTION FfPrm_EthCalc "4.1.0     Calculation of ethanol content in fuel"
 /begin DEF_CHARACTERISTIC FfPrm_facFuToEth_C FfPrm_percEthMax_C FfPrm_percEthMin_C FfPrm_perEthImpsOBD_C FfPrm_stEna_C FfPrm_stEthCalcCfg_C FfPrm_tiProdModEnd_C /end DEF_CHARACTERISTIC
 /begin REF_CHARACTERISTIC ETHSCP_percEthRaw_T KLFETHFQES /end REF_CHARACTERISTIC
 /begin IN_MEASUREMENT B_ethgg_msg B_urstsprr_msg Eep_EnvRamHist Eep_EnvRamInvld EngStrt_bStrtEnd fethev_w_msg FfPrm_facFuAdpnInt fqethsr_w_msg frai_w_msg SyC_ctDrvEnter SyC_stSub /end IN_MEASUREMENT
 /begin OUT_MEASUREMENT FfPrm_facEth FfPrm_facEthCurr FfPrm_facEthEep FfPrm_facEthPredMax FfPrm_facEthPredMin FfPrm_flgActv FfPrm_flgEthHiTolr FfPrm_flgEthVld FfPrm_flgProdMod FfPrm_perEth FfPrm_perEthOBD FfPrm_perEthRaw FfPrm_stEthVldRdnt /end OUT_MEASUREMENT
 /begin LOC_MEASUREMENT FfPrm_EthCalctIniDrv /end LOC_MEASUREMENT
 FUNCTION_VERSION "4.1.0" /end FUNCTION
/begin FUNCTION FfPrm_FuAdpn "3.1.0     Calculation of Fuel Adaptation Value"
 /begin DEF_CHARACTERISTIC FfPrm_facCorrnSpd_C FfPrm_facFuAdpnMax_C FfPrm_facFuAdpnMin_C FfPrm_facFuNeut_C FfPrm_stCfgFuAdpn_C /end DEF_CHARACTERISTIC
 /begin REF_CHARACTERISTIC FfPrm_facFuToEth_C FfPrm_stEna_C /end REF_CHARACTERISTIC
 /begin IN_MEASUREMENT B_ethgg_msg Eep_EnvRamHist Eep_EnvRamInvld fethev_w_msg FfPrm_facEth FfPrm_flgEthVld frai_w_msg SyC_ctPostDrvLeave SyC_stSub /end IN_MEASUREMENT
 /begin OUT_MEASUREMENT FfPrm_facFuAdpn FfPrm_facFuAdpnCorrn FfPrm_facFuAdpnInjr FfPrm_facFuAdpnInt FfPrm_facMixIntegSpd FfPrm_flgChgPtd FfPrm_flgEthAdpn FfPrm_flgFuAdpnCorrn FfPrm_stFacFuAdpn FfPrm_stFuAdpnRdnt /end OUT_MEASUREMENT
 /begin LOC_MEASUREMENT FfPrm_ctReIni200ms FfPrm_flgCorrnLoc FfPrm_flgSnsrInit /end LOC_MEASUREMENT
 FUNCTION_VERSION "3.1.0" /end FUNCTION
/begin FUNCTION FfPrm_Vld2Lcy "1.0.0     Flex Fuel Parameter -Mapping Valid to Legacy Interface Elements"
 /begin IN_MEASUREMENT FfPrm_facEth FfPrm_facEthCurr FfPrm_facFuAdpn FfPrm_facFuAdpnNeut FfPrm_facMixIntegSpd FfPrm_flgEthAdpn FfPrm_flgEthFastAdpn FfPrm_flgEthHiTolr FfPrm_flgEthVld FfPrm_flgFuAdpnCorrn FfPrm_flgFuAdpnInhbn FfPrm_flgNeutValReq /end IN_MEASUREMENT
 /begin OUT_MEASUREMENT B_ethadap_msg B_ethg_msg B_ethhte_msg B_ethqadap_msg B_ffuelnw_msg B_ffuelrp_msg B_garesf_msg fethmnmx_msg fethmnmx_w_msg fethstoe_msg fethstoe_w_msg ffuelnw_w_msg ffuel_w_msg fraffck_w_msg /end OUT_MEASUREMENT
 FUNCTION_VERSION "1.0.0" /end FUNCTION
/begin COMPU_METHOD AirMassPerTime_float "" RAT_FUNC "%6.2" "Kg/h" COEFFS 0 1 0 0 0 1 /end COMPU_METHOD
/begin COMPU_METHOD a_q1_m2 "" RAT_FUNC "%6.2" "m^2" COEFFS 0 1 0 0 0 1 /end COMPU_METHOD
/begin COMPU_METHOD B_TRUE "" TAB_VERB "%6.3" "" COMPU_TAB_REF B_TRUE /end COMPU_METHOD
/begin COMPU_VTAB B_TRUE "" TAB_VERB 2 0 "FALSE" 1 "TRUE" /end COMPU_VTAB
/begin COMPU_METHOD dez "" RAT_FUNC "%6.2" "" COEFFS 0 1 0 0 0 1 /end COMPU_METHOD
/begin COMPU_METHOD EngN "" RAT_FUNC "%6.3" "rpm" COEFFS 0 2 0 0 0 1 /end COMPU_METHOD
/begin COMPU_METHOD ethanolstat "" TAB_VERB "%6.3" "" COMPU_TAB_REF ethanolstat /end COMPU_METHOD
/begin COMPU_VTAB ethanolstat "" TAB_VERB 5 0 "Sensor" 1 "Sensor - Hold" 2 "Ramp" 3 "Replacement" 4 "Backupstart" /end COMPU_VTAB
/begin COMPU_METHOD ExeCon_State_02 "" TAB_VERB "%6.3" "" COMPU_TAB_REF ExeCon_State_02 /end COMPU_METHOD
/begin COMPU_VTAB ExeCon_State_02 "" TAB_VERB 7 0 "SYC_INI" 1 "SYC_INISYN" 2 "SYC_INIEND" 3 "SYC_PREDRIVE" 4 "SYC_DRIVE" 5 "SYC_POSTDRIVE" 6 "SYC_POST_OS_EXIT" /end COMPU_VTAB
/begin COMPU_METHOD Fact1 "" RAT_FUNC "%6.4" "-" COEFFS 0 128 0 0 0 1 /end COMPU_METHOD
/begin COMPU_METHOD Fact1_float "" RAT_FUNC "%6.2" "-" COEFFS 0 1 0 0 0 1 /end COMPU_METHOD
/begin COMPU_METHOD fak_q0p00174_JsK "" RAT_FUNC "%6.4" "J/sK" COEFFS 0 576 0 0 0 1 /end COMPU_METHOD
/begin COMPU_METHOD fak_q0p2222_JK "" RAT_FUNC "%6.3" "J/K" COEFFS 0 9 0 0 0 2 /end COMPU_METHOD
/begin COMPU_METHOD fak_q1p526Em5 "" RAT_FUNC "%7.6" "-" COEFFS 0 65536 0 0 0 1 /end COMPU_METHOD
/begin COMPU_METHOD fak_sb_b2 "" RAT_FUNC "%6.4" "-" COEFFS 0 256 0 0 0 4 /end COMPU_METHOD
/begin COMPU_METHOD fak_ub_b1 "" RAT_FUNC "%6.4" "-" COEFFS 0 256 0 0 0 1 /end COMPU_METHOD
/begin COMPU_METHOD fak_ub_b2 "" RAT_FUNC "%8.5" "-" COEFFS 0 256 0 0 0 2 /end COMPU_METHOD
/begin COMPU_METHOD fak_uw_b0p5 "" RAT_FUNC "%8.7" "-" COEFFS 0 65536 0 0 0 0.5 /end COMPU_METHOD
/begin COMPU_METHOD fak_uw_b16 "" RAT_FUNC "%6.5" "-" COEFFS 0 65536 0 0 0 16 /end COMPU_METHOD
/begin COMPU_METHOD fak_uw_b2 "" RAT_FUNC "%7.6" "-" COEFFS 0 65536 0 0 0 2 /end COMPU_METHOD
/begin COMPU_METHOD fak_uw_b256 "" RAT_FUNC "%6.4" "-" COEFFS 0 65536 0 0 0 256 /end COMPU_METHOD
/begin COMPU_METHOD flgMdlCalcnFrcd_Enum_VERB "" TAB_VERB "%6.3" "" COMPU_TAB_REF flgMdlCalcnFrcd_Enum_VERB /end COMPU_METHOD
/begin COMPU_VTAB flgMdlCalcnFrcd_Enum_VERB "" TAB_VERB 2 0 "model_calculation_not_enforced" 1 "model_calculation_enforced" /end COMPU_VTAB
/begin COMPU_METHOD flgSelnExhTSnsrInvldTiEngOff_Enum_VERB "" TAB_VERB "%6.3" "" COMPU_TAB_REF flgSelnExhTSnsrInvldTiEngOff_Enum_VERB /end COMPU_METHOD
/begin COMPU_VTAB flgSelnExhTSnsrInvldTiEngOff_Enum_VERB "" TAB_VERB 2 0 "No_Temp_Sensor" 1 "Use_Temp_Sensor" /end COMPU_VTAB
/begin COMPU_METHOD flgSelnReplcmtValStgy_Enum_VERB "" TAB_VERB "%6.3" "" COMPU_TAB_REF flgSelnReplcmtValStgy_Enum_VERB /end COMPU_METHOD
/begin COMPU_VTAB flgSelnReplcmtValStgy_Enum_VERB "" TAB_VERB 3 0 "Use_environment_temp" 1 "Use_coolant_temp" 2 "Use_replacement_value" /end COMPU_VTAB
/begin COMPU_METHOD flgSelnTCalcnAftSucInin_Enum_VERB "" TAB_VERB "%6.3" "" COMPU_TAB_REF flgSelnTCalcnAftSucInin_Enum_VERB /end COMPU_METHOD
/begin COMPU_VTAB flgSelnTCalcnAftSucInin_Enum_VERB "" TAB_VERB 2 0 "continue_initialisation" 1 "start_model_calculation" /end COMPU_VTAB
/begin COMPU_METHOD flgSelnTCalcnDurgEngOff_Enum_VERB "" TAB_VERB "%6.3" "" COMPU_TAB_REF flgSelnTCalcnDurgEngOff_Enum_VERB /end COMPU_METHOD
/begin COMPU_VTAB flgSelnTCalcnDurgEngOff_Enum_VERB "" TAB_VERB 2 0 "start_cooling_curve_calculation" 1 "continue_model_calculation" /end COMPU_VTAB
/begin COMPU_METHOD flgStFrstEngRunng_Enum_VERB "" TAB_VERB "%6.3" "" COMPU_TAB_REF flgStFrstEngRunng_Enum_VERB /end COMPU_METHOD
/begin COMPU_VTAB flgStFrstEngRunng_Enum_VERB "" TAB_VERB 2 0 "engine_not_run_yet" 1 "engine_previously_run" /end COMPU_VTAB
/begin COMPU_METHOD flgStIninSuc_Enum_VERB "" TAB_VERB "%6.3" "" COMPU_TAB_REF flgStIninSuc_Enum_VERB /end COMPU_METHOD
/begin COMPU_VTAB flgStIninSuc_Enum_VERB "" TAB_VERB 2 0 "initialisation_unsuccessful" 1 "initialisation_successful" /end COMPU_VTAB
/begin COMPU_METHOD flgStMdlCalcn_Enum_VERB "" TAB_VERB "%6.3" "" COMPU_TAB_REF flgStMdlCalcn_Enum_VERB /end COMPU_METHOD
/begin COMPU_VTAB flgStMdlCalcn_Enum_VERB "" TAB_VERB 2 0 "model_not_yet_calculated" 1 "model_already_calculated" /end COMPU_VTAB
/begin COMPU_METHOD flgVldyCooltT_Enum_VERB "" TAB_VERB "%6.3" "" COMPU_TAB_REF flgVldyCooltT_Enum_VERB /end COMPU_METHOD
/begin COMPU_VTAB flgVldyCooltT_Enum_VERB "" TAB_VERB 2 0 "Invalid_coolant_temp" 1 "Valid_coolant_temp" /end COMPU_VTAB
/begin COMPU_METHOD flgVldyEnvT_Enum_VERB "" TAB_VERB "%6.3" "" COMPU_TAB_REF flgVldyEnvT_Enum_VERB /end COMPU_METHOD
/begin COMPU_VTAB flgVldyEnvT_Enum_VERB "" TAB_VERB 2 0 "Invalid_environment_temp" 1 "Valid_environment_temp" /end COMPU_VTAB
/begin COMPU_METHOD flgVldyExhTSnsr_Enum_VERB "" TAB_VERB "%6.3" "" COMPU_TAB_REF flgVldyExhTSnsr_Enum_VERB /end COMPU_METHOD
/begin COMPU_VTAB flgVldyExhTSnsr_Enum_VERB "" TAB_VERB 2 0 "Invalid_exhaust_temp_sensor" 1 "Valid_exhaust_temp_sensor" /end COMPU_VTAB
/begin COMPU_METHOD flgVldyTiEngOff_Enum_VERB "" TAB_VERB "%6.3" "" COMPU_TAB_REF flgVldyTiEngOff_Enum_VERB /end COMPU_METHOD
/begin COMPU_VTAB flgVldyTiEngOff_Enum_VERB "" TAB_VERB 2 0 "Invalid_Time_Eng_Off" 1 "Valid_Time_Eng_Off" /end COMPU_VTAB
/begin COMPU_METHOD HtFlw_Fl "" RAT_FUNC "%6.2" "J/s" COEFFS 0 1 0 0 0 1 /end COMPU_METHOD
/begin COMPU_METHOD kw_q0p75 "" RAT_FUNC "%6.3" "Grad KW" COEFFS 0 4 0 0 0 3 /end COMPU_METHOD
/begin COMPU_METHOD leist_q1_W "" RAT_FUNC "%6.2" "W" COEFFS 0 1 0 0 0 1 /end COMPU_METHOD
/begin COMPU_METHOD MILDHEV_SC_Compu "" TAB_VERB "%6.3" "" COMPU_TAB_REF MILDHEV_SC_Compu /end COMPU_METHOD
/begin COMPU_VTAB MILDHEV_SC_Compu "" TAB_VERB 3 0 "NOMILDHEV" 1 "MILDHEV48V" 2 "MILDHEV12V" /end COMPU_VTAB
/begin COMPU_METHOD MILLMP_2HZBLINK_SC_Compu "" TAB_VERB "%6.3" "" COMPU_TAB_REF MILLMP_2HZBLINK_SC_Compu /end COMPU_METHOD
/begin COMPU_VTAB MILLMP_2HZBLINK_SC_Compu "" TAB_VERB 2 0 "False" 1 "True" /end COMPU_VTAB
/begin COMPU_METHOD MILLMP_ENGSTRTWITH2SECCDN_SC_Compu "" TAB_VERB "%6.3" "" COMPU_TAB_REF MILLMP_ENGSTRTWITH2SECCDN_SC_Compu /end COMPU_METHOD
/begin COMPU_VTAB MILLMP_ENGSTRTWITH2SECCDN_SC_Compu "" TAB_VERB 2 0 "False" 1 "True" /end COMPU_VTAB
/begin COMPU_METHOD MILLMP_PWRSTG_SY_Compu "" TAB_VERB "%6.3" "" COMPU_TAB_REF MILLMP_PWRSTG_SY_Compu /end COMPU_METHOD
/begin COMPU_VTAB MILLMP_PWRSTG_SY_Compu "" TAB_VERB 2 0 "False" 1 "True" /end COMPU_VTAB
/begin COMPU_METHOD MILLMP_SUPRT_ATS_SY_Compu "" TAB_VERB "%6.3" "" COMPU_TAB_REF MILLMP_SUPRT_ATS_SY_Compu /end COMPU_METHOD
/begin COMPU_VTAB MILLMP_SUPRT_ATS_SY_Compu "" TAB_VERB 2 0 "False" 1 "True" /end COMPU_VTAB
/begin COMPU_METHOD MISFDETD_AVL_SY_Compu "" TAB_VERB "%6.3" "" COMPU_TAB_REF MISFDETD_AVL_SY_Compu /end COMPU_METHOD
/begin COMPU_VTAB MISFDETD_AVL_SY_Compu "" TAB_VERB 2 0 "False" 1 "True" /end COMPU_VTAB
/begin COMPU_METHOD MISFDET_ACTVTESTSUSPCMISFCNTR_SC_Compu "" TAB_VERB "%6.3" "" COMPU_TAB_REF MISFDET_ACTVTESTSUSPCMISFCNTR_SC_Compu /end COMPU_METHOD
/begin COMPU_VTAB MISFDET_ACTVTESTSUSPCMISFCNTR_SC_Compu "" TAB_VERB 2 0 "no_cntr" 1 "wi_cntr" /end COMPU_VTAB
/begin COMPU_METHOD MISFDET_ACTVTEST_SC_Compu "" TAB_VERB "%6.3" "" COMPU_TAB_REF MISFDET_ACTVTEST_SC_Compu /end COMPU_METHOD
/begin COMPU_VTAB MISFDET_ACTVTEST_SC_Compu "" TAB_VERB 2 0 "actvTest_notUsed" 1 "actvTest_used" /end COMPU_VTAB
/begin COMPU_METHOD MISFDET_ADPNDATAEEP_SC_Compu "" TAB_VERB "%6.3" "" COMPU_TAB_REF MISFDET_ADPNDATAEEP_SC_Compu /end COMPU_METHOD
/begin COMPU_VTAB MISFDET_ADPNDATAEEP_SC_Compu "" TAB_VERB 2 0 "data_in_NVRAM" 1 "data_in_EEP" /end COMPU_VTAB
/begin COMPU_METHOD MISFDET_BNKIMBAL_SC_Compu "" TAB_VERB "%6.3" "" COMPU_TAB_REF MISFDET_BNKIMBAL_SC_Compu /end COMPU_METHOD
/begin COMPU_VTAB MISFDET_BNKIMBAL_SC_Compu "" TAB_VERB 2 0 "noBnkImbalDetn" 1 "wiBankImbalDetn" /end COMPU_VTAB
/begin COMPU_METHOD MISFDET_DMFDSTBC_SC_Compu "" TAB_VERB "%6.3" "" COMPU_TAB_REF MISFDET_DMFDSTBC_SC_Compu /end COMPU_METHOD
/begin COMPU_VTAB MISFDET_DMFDSTBC_SC_Compu "" TAB_VERB 2 0 "Deactive" 1 "Active" /end COMPU_VTAB
/begin COMPU_METHOD MISFDET_DNADPNNRRNGNENG_SC_Compu "" RAT_FUNC "%6.2" "" COEFFS 0 1 0 0 0 1 /end COMPU_METHOD
/begin COMPU_METHOD MISFDET_DNADPNNRRNGTQ_SC_Compu "" RAT_FUNC "%6.2" "" COEFFS 0 1 0 0 0 1 /end COMPU_METHOD
/begin COMPU_METHOD MISFDET_DNADPN_SC_Compu "" TAB_VERB "%6.3" "" COMPU_TAB_REF MISFDET_DNADPN_SC_Compu /end COMPU_METHOD
/begin COMPU_VTAB MISFDET_DNADPN_SC_Compu "" TAB_VERB 3 0 "no_adpn" 1 "adpn_pos_tq" 2 "adpn_pos_tq_fco" /end COMPU_VTAB
/begin COMPU_METHOD MISFDET_DNCALCNTQBAL_SC_Compu "" TAB_VERB "%6.3" "" COMPU_TAB_REF MISFDET_DNCALCNTQBAL_SC_Compu /end COMPU_METHOD
/begin COMPU_VTAB MISFDET_DNCALCNTQBAL_SC_Compu "" TAB_VERB 3 0 "no_dncalcntqbal" 1 "wi_dncalcntqbal" 2 "wi_dncalcntqbalsegadpn" /end COMPU_VTAB
/begin COMPU_METHOD MISFDET_DNDIFSIG_SC_Compu "" TAB_VERB "%6.3" "" COMPU_TAB_REF MISFDET_DNDIFSIG_SC_Compu /end COMPU_METHOD
/begin COMPU_VTAB MISFDET_DNDIFSIG_SC_Compu "" TAB_VERB 2 0 "False" 1 "True" /end COMPU_VTAB
/begin COMPU_METHOD MISFDET_DNPRECTRL_SC_Compu "" TAB_VERB "%6.3" "" COMPU_TAB_REF MISFDET_DNPRECTRL_SC_Compu /end COMPU_METHOD
/begin COMPU_VTAB MISFDET_DNPRECTRL_SC_Compu "" TAB_VERB 2 0 "no_preCtrl" 1 "wi_preCtrl" /end COMPU_VTAB
/begin COMPU_METHOD MISFDET_DUALINJTEST_SC_Compu "" TAB_VERB "%6.3" "" COMPU_TAB_REF MISFDET_DUALINJTEST_SC_Compu /end COMPU_METHOD
/begin COMPU_VTAB MISFDET_DUALINJTEST_SC_Compu "" TAB_VERB 2 0 "False" 1 "True" /end COMPU_VTAB
/begin COMPU_METHOD MISFDET_EXHGASPBASDDETN_SC_Compu "" TAB_VERB "%6.3" "" COMPU_TAB_REF MISFDET_EXHGASPBASDDETN_SC_Compu /end COMPU_METHOD
/begin COMPU_VTAB MISFDET_EXHGASPBASDDETN_SC_Compu "" TAB_VERB 2 0 "noExhGasPBasdDetn" 1 "wiExhGasPBasdDetn" /end COMPU_VTAB
/begin COMPU_METHOD MISFDET_FUREACVN_SC_Compu "" TAB_VERB "%6.3" "" COMPU_TAB_REF MISFDET_FUREACVN_SC_Compu /end COMPU_METHOD
/begin COMPU_VTAB MISFDET_FUREACVN_SC_Compu "" TAB_VERB 2 0 "Deactive" 1 "Active" /end COMPU_VTAB
/begin COMPU_METHOD MISFDET_LAMBASDDETN_SC_Compu "" TAB_VERB "%6.3" "" COMPU_TAB_REF MISFDET_LAMBASDDETN_SC_Compu /end COMPU_METHOD
/begin COMPU_VTAB MISFDET_LAMBASDDETN_SC_Compu "" TAB_VERB 2 0 "noLamBasdDetn" 1 "wiLamBasdDetn" /end COMPU_VTAB
/begin COMPU_METHOD MISFDET_NOTEQUIDIGN_SC_Compu "" TAB_VERB "%6.3" "" COMPU_TAB_REF MISFDET_NOTEQUIDIGN_SC_Compu /end COMPU_METHOD
/begin COMPU_VTAB MISFDET_NOTEQUIDIGN_SC_Compu "" TAB_VERB 2 0 "not_supported" 1 "supported" /end COMPU_VTAB
/begin COMPU_METHOD MISFDET_NRTRSMTYP_SC_Compu "" TAB_VERB "%6.3" "" COMPU_TAB_REF MISFDET_NRTRSMTYP_SC_Compu /end COMPU_METHOD
/begin COMPU_VTAB MISFDET_NRTRSMTYP_SC_Compu "" TAB_VERB 3 0 "oneTraTyp" 1 "twoTraTyp" 2 "threeTraTyp" /end COMPU_VTAB
/begin COMPU_METHOD MISFDET_PATDETNTOOTHBASD_SC_Compu "" TAB_VERB "%6.3" "" COMPU_TAB_REF MISFDET_PATDETNTOOTHBASD_SC_Compu /end COMPU_METHOD
/begin COMPU_VTAB MISFDET_PATDETNTOOTHBASD_SC_Compu "" TAB_VERB 2 0 "dnBasd" 1 "toothBasd" /end COMPU_VTAB
/begin COMPU_METHOD MISFDET_PATDETN_SC_Compu "" TAB_VERB "%6.3" "" COMPU_TAB_REF MISFDET_PATDETN_SC_Compu /end COMPU_METHOD
/begin COMPU_VTAB MISFDET_PATDETN_SC_Compu "" TAB_VERB 2 0 "Deactive" 1 "Active" /end COMPU_VTAB
/begin COMPU_METHOD MISFDET_REDFCT_SC_Compu "" RAT_FUNC "%6.2" "" COEFFS 0 1 0 0 0 1 /end COMPU_METHOD
/begin COMPU_METHOD MISFDET_ROUGHROADDIAG_SC_Compu "" TAB_VERB "%6.3" "" COMPU_TAB_REF MISFDET_ROUGHROADDIAG_SC_Compu /end COMPU_METHOD
/begin COMPU_VTAB MISFDET_ROUGHROADDIAG_SC_Compu "" TAB_VERB 2 0 "no_diag" 1 "with_diag" /end COMPU_VTAB
/begin COMPU_METHOD MISFDET_ROUGHROADTYP_SC_Compu "" TAB_VERB "%6.3" "" COMPU_TAB_REF MISFDET_ROUGHROADTYP_SC_Compu /end COMPU_METHOD
/begin COMPU_VTAB MISFDET_ROUGHROADTYP_SC_Compu "" TAB_VERB 8 0 "none" 1 "whlSpdDgs" 2 "whlSpd" 3 "engRoughns" 4 "body" 5 "ABS" 6 "whlSpdOrABS" 7 "whlSpd2Whl" /end COMPU_VTAB
/begin COMPU_METHOD MISFDET_SEGPOSNCYL_SC_Compu "" TAB_VERB "%6.3" "" COMPU_TAB_REF MISFDET_SEGPOSNCYL_SC_Compu /end COMPU_METHOD
/begin COMPU_VTAB MISFDET_SEGPOSNCYL_SC_Compu "" TAB_VERB 2 0 "cmn_seg" 1 "cyl_ind_seg" /end COMPU_VTAB
/begin COMPU_METHOD MISFDET_SEGSHIFTGPFRGN_SC_Compu "" TAB_VERB "%6.3" "" COMPU_TAB_REF MISFDET_SEGSHIFTGPFRGN_SC_Compu /end COMPU_METHOD
/begin COMPU_VTAB MISFDET_SEGSHIFTGPFRGN_SC_Compu "" TAB_VERB 2 0 "no_seg_shift_gpfrgn" 1 "seg_shift_gpfrgn" /end COMPU_VTAB
/begin COMPU_METHOD MISFDET_SEGSHIFTIDLE_SC_Compu "" TAB_VERB "%6.3" "" COMPU_TAB_REF MISFDET_SEGSHIFTIDLE_SC_Compu /end COMPU_METHOD
/begin COMPU_VTAB MISFDET_SEGSHIFTIDLE_SC_Compu "" TAB_VERB 2 0 "no_seg_shift_idle" 1 "seg_shift_idle" /end COMPU_VTAB
/begin COMPU_METHOD MISFDET_SEGSHIFT_SC_Compu "" TAB_VERB "%6.3" "" COMPU_TAB_REF MISFDET_SEGSHIFT_SC_Compu /end COMPU_METHOD
/begin COMPU_VTAB MISFDET_SEGSHIFT_SC_Compu "" TAB_VERB 3 0 "no_seg_shift" 1 "two_pos" 2 "mpl_pos" /end COMPU_VTAB
/begin COMPU_METHOD MISFDET_SEGTIADPN_SC_Compu "" TAB_VERB "%6.3" "" COMPU_TAB_REF MISFDET_SEGTIADPN_SC_Compu /end COMPU_METHOD
/begin COMPU_VTAB MISFDET_SEGTIADPN_SC_Compu "" TAB_VERB 3 0 "woAdpn" 1 "wiAdpn" 2 "wiAdpnEnhd" /end COMPU_VTAB
/begin COMPU_METHOD MISFDET_SEGTICALCNTYP_SC_Compu "" TAB_VERB "%6.3" "" COMPU_TAB_REF MISFDET_SEGTICALCNTYP_SC_Compu /end COMPU_METHOD
/begin COMPU_VTAB MISFDET_SEGTICALCNTYP_SC_Compu "" TAB_VERB 2 0 "Std" 1 "ToothTi" /end COMPU_VTAB
/begin COMPU_METHOD MISFDET_SUSPCEMIEXCDC_SC_Compu "" TAB_VERB "%6.3" "" COMPU_TAB_REF MISFDET_SUSPCEMIEXCDC_SC_Compu /end COMPU_METHOD
/begin COMPU_VTAB MISFDET_SUSPCEMIEXCDC_SC_Compu "" TAB_VERB 2 0 "no_supsc_emi" 1 "wi_supsc_emi" /end COMPU_VTAB
/begin COMPU_METHOD MISFDET_TWOWHLIF_SC_Compu "" TAB_VERB "%6.3" "" COMPU_TAB_REF MISFDET_TWOWHLIF_SC_Compu /end COMPU_METHOD
/begin COMPU_VTAB MISFDET_TWOWHLIF_SC_Compu "" TAB_VERB 3 0 "No input interface adaptation" 1 "MSE_PF" 2 "Power Sports PF" /end COMPU_VTAB
/begin COMPU_METHOD MISFDET_TYP_SC_Compu "" TAB_VERB "%6.3" "" COMPU_TAB_REF MISFDET_TYP_SC_Compu /end COMPU_METHOD
/begin COMPU_VTAB MISFDET_TYP_SC_Compu "" TAB_VERB 5 0 "none" 1 "DS_classic" 2 "DS_enhanced" 3 "GS_DMD" 4 "DGS" /end COMPU_VTAB
/begin COMPU_METHOD MISFDET_VAR_SY_Compu "" TAB_VERB "%6.3" "" COMPU_TAB_REF MISFDET_VAR_SY_Compu /end COMPU_METHOD
/begin COMPU_VTAB MISFDET_VAR_SY_Compu "" TAB_VERB 48 1 "DAI" 3 "VWW" 4 "POR" 5 "AUD" 6 "OPE" 9 "FIA" 11 "BMW" 14 "PSA" 15 "REN" 17 "ALF" 18 "SAB" 19 "VOL" 20 "NIS" 21 "GMU" 22 "FOR" 26 "IMJ" 51 "SEA" 53 "CHR" 54 "JAG" 55 "ROL" 69 "FER" 72 "TOY" 112 "BMWMotorradAG" 123 "MIT" 147 "HYU" 159 "HON" 160 "MAZ" 183 "CU" 190 "LRG" 204 "VVW" 214 "AVT" 242 "Iveco" 243 "DMC" 248 "SUZ" 267 "SSANGYONG" 268 "BRP-Rotax" 270 "KEF" 289 "AMG" 308 "TAT" 319 "MVM" 385 "UAES" 425 "Polaris" 590 "Scania" 828 "RBCD" 898 "MFTBC" 999 "ALL" 2887 "Nonox" 9454 "Fuso" /end COMPU_VTAB
/begin COMPU_METHOD MIXADPNACTVPSETI_SC_Compu "" TAB_VERB "%6.3" "" COMPU_TAB_REF MIXADPNACTVPSETI_SC_Compu /end COMPU_METHOD
/begin COMPU_VTAB MIXADPNACTVPSETI_SC_Compu "" TAB_VERB 2 0 "False" 1 "True" /end COMPU_VTAB
/begin COMPU_METHOD MIXADPNCATHEAT_SC_Compu "" TAB_VERB "%6.3" "" COMPU_TAB_REF MIXADPNCATHEAT_SC_Compu /end COMPU_METHOD
/begin COMPU_VTAB MIXADPNCATHEAT_SC_Compu "" TAB_VERB 2 0 "False" 1 "True" /end COMPU_VTAB
/begin COMPU_METHOD m_q0p00781 "" RAT_FUNC "%6.4" "g/s" COEFFS 0 65536 0 0 0 512 /end COMPU_METHOD
/begin COMPU_METHOD m_q0p1 "" RAT_FUNC "%6.3" "kg/h" COEFFS 0 10 0 0 0 1 /end COMPU_METHOD
/begin COMPU_METHOD m_q1_g "" RAT_FUNC "%6.2" "g" COEFFS 0 1 0 0 0 1 /end COMPU_METHOD
/begin COMPU_METHOD m_uw_b6553p5 "" RAT_FUNC "%6.3" "kg/h" COEFFS 0 1 0 0 0 0.1 /end COMPU_METHOD
/begin COMPU_METHOD nmot_q0p5 "" RAT_FUNC "%6.3" "1/min" COEFFS 0 2 0 0 0 1 /end COMPU_METHOD
/begin COMPU_METHOD OneToOne "" RAT_FUNC "%6.2" "-" COEFFS 0 1 0 0 0 1 /end COMPU_METHOD
/begin COMPU_METHOD Prc "" RAT_FUNC "%6.4" "%" COEFFS 0 81.92 0 0 0 1 /end COMPU_METHOD
/begin COMPU_METHOD Pres "" RAT_FUNC "%6.3" "kPa" COEFFS 0 10 0 0 0 1 /end COMPU_METHOD
/begin COMPU_METHOD PresAC_hPa "" RAT_FUNC "%6.2" "hPa" COEFFS 0 0.5 0 0 0 1 /end COMPU_METHOD
/begin COMPU_METHOD p_q0p039 "" RAT_FUNC "%6.4" "hPa" COEFFS 0 256 0 0 0 10 /end COMPU_METHOD
/begin COMPU_METHOD p_uw_q0p039 "" RAT_FUNC "%6.4" "hPa" COEFFS 0 256 0 0 0 10 /end COMPU_METHOD
/begin COMPU_METHOD q0p05_J_DIV_kg_K "" RAT_FUNC "%6.4" "J/(kg·K)" COEFFS 0 20 0 0 0 1 /end COMPU_METHOD
/begin COMPU_METHOD q1_kg_DIV_h "" RAT_FUNC "%6.2" "kg/h" COEFFS 0 1 0 0 0 1 /end COMPU_METHOD
/begin COMPU_METHOD q1_kg_DIV_s_m2 "" RAT_FUNC "%6.2" "kg/(s*m^2)" COEFFS 0 1 0 0 0 1 /end COMPU_METHOD
/begin COMPU_METHOD q5p333_J_DIV_g "" RAT_FUNC "%6.2" "J/g" COEFFS 0 3 0 0 0 16 /end COMPU_METHOD
/begin COMPU_METHOD q5p922Em2_JK "" RAT_FUNC "%6.4" "J/K" COEFFS 0 2304000 0 0 0 136448 /end COMPU_METHOD
/begin COMPU_METHOD q7p63Em5_DIV_s "" RAT_FUNC "%7.6" "1/s" COEFFS 0 65536 0 0 0 5 /end COMPU_METHOD
/begin COMPU_METHOD RBPtCel_egy_1p0_2 "" RAT_FUNC "%6.2" "J" COEFFS 0 1 0 0 0 1 /end COMPU_METHOD
/begin COMPU_METHOD RBPtCel_fac_0p00001_1 "" RAT_FUNC "%8.7" "-" COEFFS 0 100000 0 0 0 1 /end COMPU_METHOD
/begin COMPU_METHOD RBPtCel_p_1p0_3 "" RAT_FUNC "%6.2" "kPa" COEFFS 0 1 0 0 0 1 /end COMPU_METHOD
/begin COMPU_METHOD RBPtCel_u_0p05_1 "" RAT_FUNC "%6.4" "V" COEFFS 0 20 0 0 0 1 /end COMPU_METHOD
/begin COMPU_METHOD rel_q0p012207 "" RAT_FUNC "%6.4" "%" COEFFS 0 8192 0 0 0 100 /end COMPU_METHOD
/begin COMPU_METHOD rel_q0p0234 "" RAT_FUNC "%6.4" "%" COEFFS 0 128 0 0 0 3 /end COMPU_METHOD
/begin COMPU_METHOD rel_q0p392 "" RAT_FUNC "%6.3" "%" COEFFS 0 255 0 0 0 100 /end COMPU_METHOD
/begin COMPU_METHOD rel_ub_b127p5 "" RAT_FUNC "%6.3" "%" COEFFS 0 2 0 0 0 1 /end COMPU_METHOD
/begin COMPU_METHOD rel_uw_b100 "" RAT_FUNC "%6.4" "%" COEFFS 0 65536 0 0 0 100 /end COMPU_METHOD
/begin COMPU_METHOD rel_uw_b200 "" RAT_FUNC "%6.4" "%" COEFFS 0 65536 0 0 0 200 /end COMPU_METHOD
/begin COMPU_METHOD rel_uw_b3072 "" RAT_FUNC "%6.4" "%" COEFFS 0 65536 0 0 0 3072 /end COMPU_METHOD
/begin COMPU_METHOD stCfgInin_CA_Enum_VERB "" TAB_VERB "%6.3" "" COMPU_TAB_REF stCfgInin_CA_Enum_VERB /end COMPU_METHOD
/begin COMPU_VTAB stCfgInin_CA_Enum_VERB "" TAB_VERB 3 0 "FixdPrm" 1 "ExhTSnsrVal" 2 "CoolgCrv" /end COMPU_VTAB
/begin COMPU_METHOD stCurrModTMdlInin_Mode_Enum_VERB "" TAB_VERB "%6.3" "" COMPU_TAB_REF stCurrModTMdlInin_Mode_Enum_VERB /end COMPU_METHOD
/begin COMPU_VTAB stCurrModTMdlInin_Mode_Enum_VERB "" TAB_VERB 6 0 "Replacement_Value" 1 "Fixed_Param" 2 "Exhaust_Temp_Sensor" 3 "Environment_Temp_Sensor" 4 "Cooling_Curve" 5 "Coolant_Temp_Sensor" /end COMPU_VTAB
/begin COMPU_METHOD stCurrModTMdl_Mode_Enum_VERB "" TAB_VERB "%6.3" "" COMPU_TAB_REF stCurrModTMdl_Mode_Enum_VERB /end COMPU_METHOD
/begin COMPU_VTAB stCurrModTMdl_Mode_Enum_VERB "" TAB_VERB 3 0 "MODEL_INIT" 1 "MODEL_CALCN" 2 "COOLG_STOP_PHASE" /end COMPU_VTAB
/begin COMPU_METHOD t1sxs_uw_q1 "" RAT_FUNC "%6.2" "s" COEFFS 0 1 0 0 0 1 /end COMPU_METHOD
/begin COMPU_METHOD TempC_float "" RAT_FUNC "%6.1" "deg C" COEFFS 0 1 273.14 0 0 1 /end COMPU_METHOD
/begin COMPU_METHOD TempK_float "" RAT_FUNC "%6.2" "K" COEFFS 0 1 0 0 0 1 /end COMPU_METHOD
/begin COMPU_METHOD Temp_Cels "" RAT_FUNC "%6.1" "deg C" COEFFS 0 10 2731.4 0 0 1 /end COMPU_METHOD
/begin COMPU_METHOD Temp_Kelv "" RAT_FUNC "%6.3" "K" COEFFS 0 10 0 0 0 1 /end COMPU_METHOD
/begin COMPU_METHOD temp_q0p0234 "" RAT_FUNC "%6.4" "K" COEFFS 0 256 0 0 0 6 /end COMPU_METHOD
/begin COMPU_METHOD temp_q0p0234_o273 "" RAT_FUNC "%6.1" "Grad C" COEFFS 0 1 273.15 0 0 0.0234375 /end COMPU_METHOD
/begin COMPU_METHOD temp_q0p1_K "" RAT_FUNC "%6.3" "K" COEFFS 0 10 0 0 0 1 /end COMPU_METHOD
/begin COMPU_METHOD temp_q3p57Em7_om273 "" RAT_FUNC "%6.1" "Grad C" COEFFS 0 8388608 2291348275.2 0 0 3 /end COMPU_METHOD
/begin COMPU_METHOD TimeDelay_s "" RAT_FUNC "%6.1" "s" COEFFS 0 0 1 0 0.00023283064365387 0 /end COMPU_METHOD
/begin COMPU_METHOD TimeEngOn "" RAT_FUNC "%6.2" "s" COEFFS 0 1 0 0 0 1 /end COMPU_METHOD
/begin COMPU_METHOD Time_ms "" RAT_FUNC "%6.1" "ms" COEFFS 0 0.1 0 0 0 1 /end COMPU_METHOD
/begin COMPU_METHOD Time_s "" RAT_FUNC "%6.4" "s" COEFFS 0 100 0 0 0 1 /end COMPU_METHOD
/begin COMPU_METHOD Trq "" RAT_FUNC "%6.3" "Nm" COEFFS 0 10 0 0 0 1 /end COMPU_METHOD
/begin COMPU_METHOD TrqPrpHigh "" RAT_FUNC "%6.3" "Nm" COEFFS 0 10 0 0 0 1 /end COMPU_METHOD
/begin COMPU_METHOD t_q0p05 "" RAT_FUNC "%6.4" "s" COEFFS 0 100 0 0 0 5 /end COMPU_METHOD
/begin COMPU_METHOD t_q0p2 "" RAT_FUNC "%6.3" "s" COEFFS 0 10 0 0 0 2 /end COMPU_METHOD
/begin COMPU_METHOD t_q1 "" RAT_FUNC "%6.2" "s" COEFFS 0 1 0 0 0 1 /end COMPU_METHOD
/begin COMPU_METHOD Vel "" RAT_FUNC "%6.4" "km/h" COEFFS 0 100 0 0 0 1 /end COMPU_METHOD
/begin COMPU_METHOD vfzg_uw_b512 "" RAT_FUNC "%6.4" "km/h" COEFFS 0 65536 0 0 0 512 /end COMPU_METHOD
/begin COMPU_METHOD Volt_Batt "" RAT_FUNC "%6.1" "mV" COEFFS 0 0.05 0 0 0 1 /end COMPU_METHOD
/begin COMPU_METHOD zk50msxs_uw_b3276p8 "" RAT_FUNC "%6.1" "s" COEFFS 0 0 65536 0 20 0 /end COMPU_METHOD
/begin RECORD_LAYOUT Kw_Ws16 FNC_VALUES 1 SWORD COLUMN_DIR DIRECT /end RECORD_LAYOUT
/begin RECORD_LAYOUT Kw_Wu16 FNC_VALUES 1 UWORD COLUMN_DIR DIRECT /end RECORD_LAYOUT
/begin RECORD_LAYOUT RB_Curve_R32_R32_Static NO_AXIS_PTS_X 1 ULONG AXIS_PTS_X 2 FLOAT32_IEEE INDEX_INCR DIRECT FNC_VALUES 3 FLOAT32_IEEE COLUMN_DIR DIRECT STATIC_RECORD_LAYOUT /end RECORD_LAYOUT
/begin RECORD_LAYOUT RB_Curve_S16_S16 NO_AXIS_PTS_X 1 SWORD AXIS_PTS_X 2 SWORD INDEX_INCR DIRECT FNC_VALUES 3 SWORD COLUMN_DIR DIRECT /end RECORD_LAYOUT
/begin RECORD_LAYOUT RB_Curve_S16_S32_Static NO_AXIS_PTS_X 1 SWORD AXIS_PTS_X 2 SWORD INDEX_INCR DIRECT FNC_VALUES 3 SLONG COLUMN_DIR DIRECT STATIC_RECORD_LAYOUT /end RECORD_LAYOUT
/begin RECORD_LAYOUT RB_Curve_S16_S8_Static NO_AXIS_PTS_X 1 SWORD AXIS_PTS_X 2 SWORD INDEX_INCR DIRECT FNC_VALUES 3 SBYTE COLUMN_DIR DIRECT STATIC_RECORD_LAYOUT /end RECORD_LAYOUT
/begin RECORD_LAYOUT RB_Curve_S16_U16_Static NO_AXIS_PTS_X 1 SWORD AXIS_PTS_X 2 SWORD INDEX_INCR DIRECT FNC_VALUES 3 UWORD COLUMN_DIR DIRECT STATIC_RECORD_LAYOUT /end RECORD_LAYOUT
/begin RECORD_LAYOUT RB_Curve_S8_U16_Static NO_AXIS_PTS_X 1 SBYTE AXIS_PTS_X 2 SBYTE INDEX_INCR DIRECT FNC_VALUES 3 UWORD COLUMN_DIR DIRECT STATIC_RECORD_LAYOUT /end RECORD_LAYOUT
/begin RECORD_LAYOUT RB_Curve_U16_U16 NO_AXIS_PTS_X 1 UWORD AXIS_PTS_X 2 UWORD INDEX_INCR DIRECT FNC_VALUES 3 UWORD COLUMN_DIR DIRECT /end RECORD_LAYOUT
/begin RECORD_LAYOUT RB_Curve_U16_U8_Static NO_AXIS_PTS_X 1 UWORD AXIS_PTS_X 2 UWORD INDEX_INCR DIRECT FNC_VALUES 3 UBYTE COLUMN_DIR DIRECT STATIC_RECORD_LAYOUT /end RECORD_LAYOUT
/begin RECORD_LAYOUT RB_Curve_U8_U16_Static NO_AXIS_PTS_X 1 UBYTE AXIS_PTS_X 2 UBYTE INDEX_INCR DIRECT FNC_VALUES 3 UWORD COLUMN_DIR DIRECT STATIC_RECORD_LAYOUT /end RECORD_LAYOUT
/begin RECORD_LAYOUT RB_Map_R32R32_R32 NO_AXIS_PTS_X 1 ULONG NO_AXIS_PTS_Y 2 ULONG AXIS_PTS_X 3 FLOAT32_IEEE INDEX_INCR DIRECT AXIS_PTS_Y 4 FLOAT32_IEEE INDEX_INCR DIRECT FNC_VALUES 5 FLOAT32_IEEE COLUMN_DIR DIRECT /end RECORD_LAYOUT
/begin RECORD_LAYOUT RB_Map_S16S16_S32 NO_AXIS_PTS_X 1 SWORD NO_AXIS_PTS_Y 2 SWORD AXIS_PTS_X 3 SWORD INDEX_INCR DIRECT AXIS_PTS_Y 4 SWORD INDEX_INCR DIRECT FNC_VALUES 5 SLONG COLUMN_DIR DIRECT /end RECORD_LAYOUT
/begin RECORD_LAYOUT RB_Map_S16S16_U8 NO_AXIS_PTS_X 1 SWORD NO_AXIS_PTS_Y 2 SWORD AXIS_PTS_X 3 SWORD INDEX_INCR DIRECT AXIS_PTS_Y 4 SWORD INDEX_INCR DIRECT FNC_VALUES 5 UBYTE COLUMN_DIR DIRECT /end RECORD_LAYOUT
/begin RECORD_LAYOUT RB_Map_S16U16_S16 NO_AXIS_PTS_X 1 SWORD NO_AXIS_PTS_Y 2 SWORD AXIS_PTS_X 3 SWORD INDEX_INCR DIRECT AXIS_PTS_Y 4 UWORD INDEX_INCR DIRECT FNC_VALUES 5 SWORD ROW_DIR DIRECT /end RECORD_LAYOUT
/begin RECORD_LAYOUT RB_Map_S16U16_U16 NO_AXIS_PTS_X 1 SWORD NO_AXIS_PTS_Y 2 SWORD AXIS_PTS_X 3 SWORD INDEX_INCR DIRECT AXIS_PTS_Y 4 UWORD INDEX_INCR DIRECT FNC_VALUES 5 UWORD ROW_DIR DIRECT /end RECORD_LAYOUT
/begin RECORD_LAYOUT RB_Map_S16U16_U8 NO_AXIS_PTS_X 1 SWORD NO_AXIS_PTS_Y 2 SWORD AXIS_PTS_X 3 SWORD INDEX_INCR DIRECT AXIS_PTS_Y 4 UWORD INDEX_INCR DIRECT FNC_VALUES 5 UBYTE ROW_DIR DIRECT /end RECORD_LAYOUT
/begin RECORD_LAYOUT RB_Map_S16U8_U16 NO_AXIS_PTS_X 1 SWORD NO_AXIS_PTS_Y 2 SWORD AXIS_PTS_X 3 SWORD INDEX_INCR DIRECT AXIS_PTS_Y 4 UBYTE INDEX_INCR DIRECT FNC_VALUES 5 UWORD COLUMN_DIR DIRECT /end RECORD_LAYOUT
/begin RECORD_LAYOUT RB_Map_U16U16_S16 NO_AXIS_PTS_X 1 UWORD NO_AXIS_PTS_Y 2 UWORD AXIS_PTS_X 3 UWORD INDEX_INCR DIRECT AXIS_PTS_Y 4 UWORD INDEX_INCR DIRECT FNC_VALUES 5 SWORD COLUMN_DIR DIRECT /end RECORD_LAYOUT
/begin RECORD_LAYOUT RB_Map_U16U16_U16 NO_AXIS_PTS_X 1 UWORD NO_AXIS_PTS_Y 2 UWORD AXIS_PTS_X 3 UWORD INDEX_INCR DIRECT AXIS_PTS_Y 4 UWORD INDEX_INCR DIRECT FNC_VALUES 5 UWORD COLUMN_DIR DIRECT /end RECORD_LAYOUT
/begin RECORD_LAYOUT RB_Map_U16U8_U8 NO_AXIS_PTS_X 1 UWORD NO_AXIS_PTS_Y 2 UWORD AXIS_PTS_X 3 UWORD INDEX_INCR DIRECT AXIS_PTS_Y 4 UBYTE INDEX_INCR DIRECT FNC_VALUES 5 UBYTE COLUMN_DIR DIRECT /end RECORD_LAYOUT
/begin RECORD_LAYOUT RB_Map_U8U16_U16 NO_AXIS_PTS_X 1 UBYTE NO_AXIS_PTS_Y 2 UBYTE AXIS_PTS_X 3 UBYTE INDEX_INCR DIRECT AXIS_PTS_Y 4 UWORD INDEX_INCR DIRECT FNC_VALUES 5 UWORD ROW_DIR DIRECT /end RECORD_LAYOUT
/begin RECORD_LAYOUT RB_ValA_Ws16 FNC_VALUES 1 SWORD COLUMN_DIR DIRECT /end RECORD_LAYOUT
/begin RECORD_LAYOUT RB_ValA_Wu16 FNC_VALUES 1 UWORD COLUMN_DIR DIRECT /end RECORD_LAYOUT
/begin RECORD_LAYOUT RB_ValA_Wu8 FNC_VALUES 1 UBYTE COLUMN_DIR DIRECT /end RECORD_LAYOUT
/begin RECORD_LAYOUT RB_Val_Wboolean FNC_VALUES 1 UBYTE COLUMN_DIR DIRECT /end RECORD_LAYOUT
/begin RECORD_LAYOUT RB_Val_Ws16 FNC_VALUES 1 SWORD COLUMN_DIR DIRECT /end RECORD_LAYOUT
/begin RECORD_LAYOUT RB_Val_Ws32 FNC_VALUES 1 SLONG COLUMN_DIR DIRECT /end RECORD_LAYOUT
/begin RECORD_LAYOUT RB_Val_Wu16 FNC_VALUES 1 UWORD COLUMN_DIR DIRECT /end RECORD_LAYOUT
/begin RECORD_LAYOUT RB_Val_Wu8 FNC_VALUES 1 UBYTE COLUMN_DIR DIRECT /end RECORD_LAYOUT
/begin RECORD_LAYOUT ValA_Ws16 FNC_VALUES 1 SWORD COLUMN_DIR DIRECT /end RECORD_LAYOUT
/begin RECORD_LAYOUT ValA_Wu16 FNC_VALUES 1 UWORD COLUMN_DIR DIRECT /end RECORD_LAYOUT
/begin RECORD_LAYOUT Val_Ws16 FNC_VALUES 1 SWORD COLUMN_DIR DIRECT /end RECORD_LAYOUT
/begin RECORD_LAYOUT Val_Ws32 FNC_VALUES 1 SLONG COLUMN_DIR DIRECT /end RECORD_LAYOUT
/begin RECORD_LAYOUT Val_Wu8 FNC_VALUES 1 UBYTE COLUMN_DIR DIRECT /end RECORD_LAYOUT
/end MODULE
/end PROJECT
