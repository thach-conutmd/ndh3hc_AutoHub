ASAP2_VERSION 1 60
/begin PROJECT MG1CS022 "MG1CS022"
/begin HEADER "" VERSION "MG1CS022_62XSC_V037_TPROT" PROJECT_NO MG1CS022 /end HEADER
/begin MODULE DIM ""
/begin MOD_COMMON "" BYTE_ORDER MSB_LAST ALIGNMENT_BYTE 1 ALIGNMENT_WORD 2 ALIGNMENT_LONG 4 ALIGNMENT_INT64 4 ALIGNMENT_FLOAT32_IEEE 4 ALIGNMENT_FLOAT64_IEEE 4 DATA_SIZE 32 /end MOD_COMMON
/begin MEASUREMENT DFC_b.LDF_GEVlvPhaCsersIntkB1 "Bit encoding / Last debounced flag bit for check DFC_GEVlvPhaCsersIntkB1" UBYTE DFC_OneToOne 1 100 0.00 1.000 BIT_MASK 0x10 FORMAT "%5.3" ECU_ADDRESS 0x60036F72 /end MEASUREMENT
/begin MEASUREMENT DFC_b.LDF_GEVlvPhaPsOpenLoadIntkB1 "Bit encoding / Last debounced flag bit for check DFC_GEVlvPhaPsOpenLoadIntkB1" UBYTE DFC_OneToOne 1 100 0.00 1.000 BIT_MASK 0x10 FORMAT "%5.3" ECU_ADDRESS 0x60036F73 /end MEASUREMENT
/begin MEASUREMENT DFC_b.LDF_GEVlvPhaPsShoToBattIntkB1 "Bit encoding / Last debounced flag bit for check DFC_GEVlvPhaPsShoToBattIntkB1" UBYTE DFC_OneToOne 1 100 0.00 1.000 BIT_MASK 0x10 FORMAT "%5.3" ECU_ADDRESS 0x60036F74 /end MEASUREMENT
/begin MEASUREMENT DFC_b.LDF_GEVlvPhaPsShoToGndIntkB1 "Bit encoding / Last debounced flag bit for check DFC_GEVlvPhaPsShoToGndIntkB1" UBYTE DFC_OneToOne 1 100 0.00 1.000 BIT_MASK 0x10 FORMAT "%5.3" ECU_ADDRESS 0x60036F75 /end MEASUREMENT
/begin MEASUREMENT DFC_b.LDF_GbxCANDigPlausErr "Bit encoding / Last debounced flag bit for check DFC_GbxCANDigPlausErr" UBYTE DFC_OneToOne 1 100 0.00 1.000 BIT_MASK 0x10 FORMAT "%5.3" ECU_ADDRESS 0x60036F76 /end MEASUREMENT
/begin MEASUREMENT DFC_b.LDF_GbxNPos1SRCMax "Bit encoding / Last debounced flag bit for check DFC_GbxNPos1SRCMax" UBYTE DFC_OneToOne 1 100 0.00 1.000 BIT_MASK 0x10 FORMAT "%5.3" ECU_ADDRESS 0x60036F77 /end MEASUREMENT
/begin MEASUREMENT DFC_b.LDF_GbxNPos1SRCMin "Bit encoding / Last debounced flag bit for check DFC_GbxNPos1SRCMin" UBYTE DFC_OneToOne 1 100 0.00 1.000 BIT_MASK 0x10 FORMAT "%5.3" ECU_ADDRESS 0x60036F78 /end MEASUREMENT
/begin MEASUREMENT DFC_b.LDF_GbxNPos2SRCMax "Bit encoding / Last debounced flag bit for check DFC_GbxNPos2SRCMax" UBYTE DFC_OneToOne 1 100 0.00 1.000 BIT_MASK 0x10 FORMAT "%5.3" ECU_ADDRESS 0x60036F79 /end MEASUREMENT
/begin MEASUREMENT DFC_b.LDF_GbxNPos2SRCMin "Bit encoding / Last debounced flag bit for check DFC_GbxNPos2SRCMin" UBYTE DFC_OneToOne 1 100 0.00 1.000 BIT_MASK 0x10 FORMAT "%5.3" ECU_ADDRESS 0x60036F7A /end MEASUREMENT
/begin MEASUREMENT DFC_b.LDF_GbxNPosAlvChk "Bit encoding / Last debounced flag bit for check DFC_GbxNPosAlvChk" UBYTE DFC_OneToOne 1 100 0.00 1.000 BIT_MASK 0x10 FORMAT "%5.3" ECU_ADDRESS 0x60036F7B /end MEASUREMENT
/begin MEASUREMENT DFC_b.LDF_GbxNPosSyncErr "Bit encoding / Last debounced flag bit for check DFC_GbxNPosSyncErr" UBYTE DFC_OneToOne 1 100 0.00 1.000 BIT_MASK 0x10 FORMAT "%5.3" ECU_ADDRESS 0x60036F7C /end MEASUREMENT
/begin MEASUREMENT DFC_b.LDF_HEGOS2B1HtrPsMax "Bit encoding / Last debounced flag bit for check DFC_HEGOS2B1HtrPsMax" UBYTE DFC_OneToOne 1 100 0.00 1.000 BIT_MASK 0x10 FORMAT "%5.3" ECU_ADDRESS 0x60036F7D /end MEASUREMENT
/begin MEASUREMENT DFC_b.LDF_HEGOS2B1HtrPsMin "Bit encoding / Last debounced flag bit for check DFC_HEGOS2B1HtrPsMin" UBYTE DFC_OneToOne 1 100 0.00 1.000 BIT_MASK 0x10 FORMAT "%5.3" ECU_ADDRESS 0x60036F7E /end MEASUREMENT
/begin MEASUREMENT DFC_b.LDF_HEGOS2B1HtrPsSig "Bit encoding / Last debounced flag bit for check DFC_HEGOS2B1HtrPsSig" UBYTE DFC_OneToOne 1 100 0.00 1.000 BIT_MASK 0x10 FORMAT "%5.3" ECU_ADDRESS 0x60036F7F /end MEASUREMENT
/begin MEASUREMENT DFC_b.LDF_LinCSErrACG "Bit encoding / Last debounced flag bit for check DFC_LinCSErrACG" UBYTE DFC_OneToOne 1 100 0.00 1.000 BIT_MASK 0x10 FORMAT "%5.3" ECU_ADDRESS 0x60036F80 /end MEASUREMENT
/begin MEASUREMENT DFC_b.LDF_LinCSErrAEV "Bit encoding / Last debounced flag bit for check DFC_LinCSErrAEV" UBYTE DFC_OneToOne 1 100 0.00 1.000 BIT_MASK 0x10 FORMAT "%5.3" ECU_ADDRESS 0x60036F81 /end MEASUREMENT
/begin MEASUREMENT DFC_b.LDF_LinCSErrDCDC "Bit encoding / Last debounced flag bit for check DFC_LinCSErrDCDC" UBYTE DFC_OneToOne 1 100 0.00 1.000 BIT_MASK 0x10 FORMAT "%5.3" ECU_ADDRESS 0x60036F82 /end MEASUREMENT
/begin MEASUREMENT DFC_b.LDF_LinCSErrEBS "Bit encoding / Last debounced flag bit for check DFC_LinCSErrEBS" UBYTE DFC_OneToOne 1 100 0.00 1.000 BIT_MASK 0x10 FORMAT "%5.3" ECU_ADDRESS 0x60036F83 /end MEASUREMENT
/begin MEASUREMENT DFC_b.LDF_LinHdrTimeoutErrACG "Bit encoding / Last debounced flag bit for check DFC_LinHdrTimeoutErrACG" UBYTE DFC_OneToOne 1 100 0.00 1.000 BIT_MASK 0x10 FORMAT "%5.3" ECU_ADDRESS 0x60036F84 /end MEASUREMENT
/begin MEASUREMENT DFC_b.LDF_LinHdrTimeoutErrAEV "Bit encoding / Last debounced flag bit for check DFC_LinHdrTimeoutErrAEV" UBYTE DFC_OneToOne 1 100 0.00 1.000 BIT_MASK 0x10 FORMAT "%5.3" ECU_ADDRESS 0x60036F85 /end MEASUREMENT
/begin MEASUREMENT DFC_b.LDF_LinHdrTimeoutErrDCDC "Bit encoding / Last debounced flag bit for check DFC_LinHdrTimeoutErrDCDC" UBYTE DFC_OneToOne 1 100 0.00 1.000 BIT_MASK 0x10 FORMAT "%5.3" ECU_ADDRESS 0x60036F86 /end MEASUREMENT
/begin MEASUREMENT DFC_b.LDF_LinHdrTimeoutErrEBS "Bit encoding / Last debounced flag bit for check DFC_LinHdrTimeoutErrEBS" UBYTE DFC_OneToOne 1 100 0.00 1.000 BIT_MASK 0x10 FORMAT "%5.3" ECU_ADDRESS 0x60036F87 /end MEASUREMENT
/begin MEASUREMENT DFC_b.LDF_LinMsgTimeoutErrACG "Bit encoding / Last debounced flag bit for check DFC_LinMsgTimeoutErrACG" UBYTE DFC_OneToOne 1 100 0.00 1.000 BIT_MASK 0x10 FORMAT "%5.3" ECU_ADDRESS 0x60036F88 /end MEASUREMENT
/begin MEASUREMENT DFC_b.LDF_LinMsgTimeoutErrAEV "Bit encoding / Last debounced flag bit for check DFC_LinMsgTimeoutErrAEV" UBYTE DFC_OneToOne 1 100 0.00 1.000 BIT_MASK 0x10 FORMAT "%5.3" ECU_ADDRESS 0x60036F89 /end MEASUREMENT
/begin MEASUREMENT DFC_b.LDF_LinMsgTimeoutErrDCDC "Bit encoding / Last debounced flag bit for check DFC_LinMsgTimeoutErrDCDC" UBYTE DFC_OneToOne 1 100 0.00 1.000 BIT_MASK 0x10 FORMAT "%5.3" ECU_ADDRESS 0x60036F8A /end MEASUREMENT
/begin MEASUREMENT DFC_b.LDF_LinMsgTimeoutErrEBS "Bit encoding / Last debounced flag bit for check DFC_LinMsgTimeoutErrEBS" UBYTE DFC_OneToOne 1 100 0.00 1.000 BIT_MASK 0x10 FORMAT "%5.3" ECU_ADDRESS 0x60036F8B /end MEASUREMENT
/begin MEASUREMENT DFC_b.LDF_LinNoStrtComErr "Bit encoding / Last debounced flag bit for check DFC_LinNoStrtComErr" UBYTE DFC_OneToOne 1 100 0.00 1.000 BIT_MASK 0x10 FORMAT "%5.3" ECU_ADDRESS 0x60036F8C /end MEASUREMENT
/begin MEASUREMENT DFC_b.LDF_LowPresOilP "Bit encoding / Last debounced flag bit for check DFC_LowPresOilP" UBYTE DFC_OneToOne 1 100 0.00 1.000 BIT_MASK 0x10 FORMAT "%5.3" ECU_ADDRESS 0x60036F8D /end MEASUREMENT
/begin MEASUREMENT DFC_b.LDF_MisfDetVWhlFrntLeOORHi "Bit encoding / Last debounced flag bit for check DFC_MisfDetVWhlFrntLeOORHi" UBYTE DFC_OneToOne 1 100 0.00 1.000 BIT_MASK 0x10 FORMAT "%5.3" ECU_ADDRESS 0x60036F8E /end MEASUREMENT
/begin MEASUREMENT DFC_b.LDF_MisfDetVWhlFrntLeRatyHi "Bit encoding / Last debounced flag bit for check DFC_MisfDetVWhlFrntLeRatyHi" UBYTE DFC_OneToOne 1 100 0.00 1.000 BIT_MASK 0x10 FORMAT "%5.3" ECU_ADDRESS 0x60036F8F /end MEASUREMENT
/begin MEASUREMENT DFC_b.LDF_MisfDetVWhlFrntLeRatyLo "Bit encoding / Last debounced flag bit for check DFC_MisfDetVWhlFrntLeRatyLo" UBYTE DFC_OneToOne 1 100 0.00 1.000 BIT_MASK 0x10 FORMAT "%5.3" ECU_ADDRESS 0x60036F90 /end MEASUREMENT
/begin MEASUREMENT DFC_b.LDF_MisfDetVWhlFrntLeStuck "Bit encoding / Last debounced flag bit for check DFC_MisfDetVWhlFrntLeStuck" UBYTE DFC_OneToOne 1 100 0.00 1.000 BIT_MASK 0x10 FORMAT "%5.3" ECU_ADDRESS 0x60036F91 /end MEASUREMENT
/begin MEASUREMENT DFC_b.LDF_MisfDetVWhlFrntRiOORHi "Bit encoding / Last debounced flag bit for check DFC_MisfDetVWhlFrntRiOORHi" UBYTE DFC_OneToOne 1 100 0.00 1.000 BIT_MASK 0x10 FORMAT "%5.3" ECU_ADDRESS 0x60036F92 /end MEASUREMENT
/begin MEASUREMENT DFC_b.LDF_MisfDetVWhlFrntRiRatyHi "Bit encoding / Last debounced flag bit for check DFC_MisfDetVWhlFrntRiRatyHi" UBYTE DFC_OneToOne 1 100 0.00 1.000 BIT_MASK 0x10 FORMAT "%5.3" ECU_ADDRESS 0x60036F93 /end MEASUREMENT
/begin MEASUREMENT DFC_b.LDF_MisfDetVWhlFrntRiRatyLo "Bit encoding / Last debounced flag bit for check DFC_MisfDetVWhlFrntRiRatyLo" UBYTE DFC_OneToOne 1 100 0.00 1.000 BIT_MASK 0x10 FORMAT "%5.3" ECU_ADDRESS 0x60036F94 /end MEASUREMENT
/begin MEASUREMENT DFC_b.LDF_MisfDetVWhlFrntRiStuck "Bit encoding / Last debounced flag bit for check DFC_MisfDetVWhlFrntRiStuck" UBYTE DFC_OneToOne 1 100 0.00 1.000 BIT_MASK 0x10 FORMAT "%5.3" ECU_ADDRESS 0x60036F95 /end MEASUREMENT
/begin MEASUREMENT DFC_b.LDF_MisfDetVWhlReLeOORHi "Bit encoding / Last debounced flag bit for check DFC_MisfDetVWhlReLeOORHi" UBYTE DFC_OneToOne 1 100 0.00 1.000 BIT_MASK 0x10 FORMAT "%5.3" ECU_ADDRESS 0x60036F96 /end MEASUREMENT
/begin MEASUREMENT DFC_b.LDF_MisfDetVWhlReLeRatyHi "Bit encoding / Last debounced flag bit for check DFC_MisfDetVWhlReLeRatyHi" UBYTE DFC_OneToOne 1 100 0.00 1.000 BIT_MASK 0x10 FORMAT "%5.3" ECU_ADDRESS 0x60036F97 /end MEASUREMENT
/begin MEASUREMENT DFC_b.LDF_MisfDetVWhlReLeRatyLo "Bit encoding / Last debounced flag bit for check DFC_MisfDetVWhlReLeRatyLo" UBYTE DFC_OneToOne 1 100 0.00 1.000 BIT_MASK 0x10 FORMAT "%5.3" ECU_ADDRESS 0x60036F98 /end MEASUREMENT
/begin MEASUREMENT DFC_b.LDF_MisfDetVWhlReLeStuck "Bit encoding / Last debounced flag bit for check DFC_MisfDetVWhlReLeStuck" UBYTE DFC_OneToOne 1 100 0.00 1.000 BIT_MASK 0x10 FORMAT "%5.3" ECU_ADDRESS 0x60036F99 /end MEASUREMENT
/begin MEASUREMENT DFC_b.LDF_MisfDetVWhlReRiOORHi "Bit encoding / Last debounced flag bit for check DFC_MisfDetVWhlReRiOORHi" UBYTE DFC_OneToOne 1 100 0.00 1.000 BIT_MASK 0x10 FORMAT "%5.3" ECU_ADDRESS 0x60036F9A /end MEASUREMENT
/begin MEASUREMENT DFC_b.LDF_MisfDetVWhlReRiRatyHi "Bit encoding / Last debounced flag bit for check DFC_MisfDetVWhlReRiRatyHi" UBYTE DFC_OneToOne 1 100 0.00 1.000 BIT_MASK 0x10 FORMAT "%5.3" ECU_ADDRESS 0x60036F9B /end MEASUREMENT
/begin MEASUREMENT DFC_b.LDF_MisfDetVWhlReRiRatyLo "Bit encoding / Last debounced flag bit for check DFC_MisfDetVWhlReRiRatyLo" UBYTE DFC_OneToOne 1 100 0.00 1.000 BIT_MASK 0x10 FORMAT "%5.3" ECU_ADDRESS 0x60036F9C /end MEASUREMENT
/begin MEASUREMENT DFC_b.LDF_MisfDetVWhlReRiStuck "Bit encoding / Last debounced flag bit for check DFC_MisfDetVWhlReRiStuck" UBYTE DFC_OneToOne 1 100 0.00 1.000 BIT_MASK 0x10 FORMAT "%5.3" ECU_ADDRESS 0x60036F9D /end MEASUREMENT
/begin MEASUREMENT DFC_b.LDF_MisfDetdVWhlFrntLePlaus "Bit encoding / Last debounced flag bit for check DFC_MisfDetdVWhlFrntLePlaus" UBYTE DFC_OneToOne 1 100 0.00 1.000 BIT_MASK 0x10 FORMAT "%5.3" ECU_ADDRESS 0x60036F9E /end MEASUREMENT
/begin MEASUREMENT DFC_b.LDF_MisfDetdVWhlFrntRiPlaus "Bit encoding / Last debounced flag bit for check DFC_MisfDetdVWhlFrntRiPlaus" UBYTE DFC_OneToOne 1 100 0.00 1.000 BIT_MASK 0x10 FORMAT "%5.3" ECU_ADDRESS 0x60036F9F /end MEASUREMENT
/begin MEASUREMENT DFC_b.LDF_MisfDetdVWhlReLePlaus "Bit encoding / Last debounced flag bit for check DFC_MisfDetdVWhlReLePlaus" UBYTE DFC_OneToOne 1 100 0.00 1.000 BIT_MASK 0x10 FORMAT "%5.3" ECU_ADDRESS 0x60036FA0 /end MEASUREMENT
/begin MEASUREMENT DFC_b.LDF_MisfDetdVWhlReRiPlaus "Bit encoding / Last debounced flag bit for check DFC_MisfDetdVWhlReRiPlaus" UBYTE DFC_OneToOne 1 100 0.00 1.000 BIT_MASK 0x10 FORMAT "%5.3" ECU_ADDRESS 0x60036FA1 /end MEASUREMENT
/begin MEASUREMENT DFC_b.LDF_PEnvSigRngMax "Bit encoding / Last debounced flag bit for check DFC_PEnvSigRngMax" UBYTE DFC_OneToOne 1 100 0.00 1.000 BIT_MASK 0x10 FORMAT "%5.3" ECU_ADDRESS 0x60036FA2 /end MEASUREMENT
/begin MEASUREMENT DFC_b.LDF_PEnvSigRngMin "Bit encoding / Last debounced flag bit for check DFC_PEnvSigRngMin" UBYTE DFC_OneToOne 1 100 0.00 1.000 BIT_MASK 0x10 FORMAT "%5.3" ECU_ADDRESS 0x60036FA3 /end MEASUREMENT
/begin MEASUREMENT DFC_b.LDF_StmFault "Bit encoding / Last debounced flag bit for check DFC_StmFault" UBYTE DFC_OneToOne 1 100 0.00 1.000 BIT_MASK 0x10 FORMAT "%5.3" ECU_ADDRESS 0x60036FA4 /end MEASUREMENT
/begin MEASUREMENT DFC_b.LDF_StrtCtOffPth "Bit encoding / Last debounced flag bit for check DFC_StrtCtOffPth" UBYTE DFC_OneToOne 1 100 0.00 1.000 BIT_MASK 0x10 FORMAT "%5.3" ECU_ADDRESS 0x60036FA5 /end MEASUREMENT
/begin MEASUREMENT DFC_b.LDF_StrtCtlErr "Bit encoding / Last debounced flag bit for check DFC_StrtCtlErr" UBYTE DFC_OneToOne 1 100 0.00 1.000 BIT_MASK 0x10 FORMAT "%5.3" ECU_ADDRESS 0x60036FA6 /end MEASUREMENT
/begin MEASUREMENT DFC_b.LDF_StrtFault "Bit encoding / Last debounced flag bit for check DFC_StrtFault" UBYTE DFC_OneToOne 1 100 0.00 1.000 BIT_MASK 0x10 FORMAT "%5.3" ECU_ADDRESS 0x60036FA7 /end MEASUREMENT
/begin MEASUREMENT DFC_b.LDF_StrtLckJudg1 "Bit encoding / Last debounced flag bit for check DFC_StrtLckJudg1" UBYTE DFC_OneToOne 1 100 0.00 1.000 BIT_MASK 0x10 FORMAT "%5.3" ECU_ADDRESS 0x60036FA8 /end MEASUREMENT
/begin MEASUREMENT DFC_b.LDF_StrtLckJudg2 "Bit encoding / Last debounced flag bit for check DFC_StrtLckJudg2" UBYTE DFC_OneToOne 1 100 0.00 1.000 BIT_MASK 0x10 FORMAT "%5.3" ECU_ADDRESS 0x60036FA9 /end MEASUREMENT
/begin MEASUREMENT DFC_b.LDF_StrtOL "Bit encoding / Last debounced flag bit for check DFC_StrtOL" UBYTE DFC_OneToOne 1 100 0.00 1.000 BIT_MASK 0x10 FORMAT "%5.3" ECU_ADDRESS 0x60036FAA /end MEASUREMENT
/begin MEASUREMENT DFC_b.LDF_StrtOL2 "Bit encoding / Last debounced flag bit for check DFC_StrtOL2" UBYTE DFC_OneToOne 1 100 0.00 1.000 BIT_MASK 0x10 FORMAT "%5.3" ECU_ADDRESS 0x60036FAB /end MEASUREMENT
/begin MEASUREMENT DFC_b.LDF_StrtSCB "Bit encoding / Last debounced flag bit for check DFC_StrtSCB" UBYTE DFC_OneToOne 1 100 0.00 1.000 BIT_MASK 0x10 FORMAT "%5.3" ECU_ADDRESS 0x60036FAC /end MEASUREMENT
/begin MEASUREMENT DFC_b.LDF_StrtSCB2 "Bit encoding / Last debounced flag bit for check DFC_StrtSCB2" UBYTE DFC_OneToOne 1 100 0.00 1.000 BIT_MASK 0x10 FORMAT "%5.3" ECU_ADDRESS 0x60036FAD /end MEASUREMENT
/begin MEASUREMENT DFC_b.LDF_StrtSCG "Bit encoding / Last debounced flag bit for check DFC_StrtSCG" UBYTE DFC_OneToOne 1 100 0.00 1.000 BIT_MASK 0x10 FORMAT "%5.3" ECU_ADDRESS 0x60036FAE /end MEASUREMENT
/begin MEASUREMENT DFC_b.LDF_StrtSCG2 "Bit encoding / Last debounced flag bit for check DFC_StrtSCG2" UBYTE DFC_OneToOne 1 100 0.00 1.000 BIT_MASK 0x10 FORMAT "%5.3" ECU_ADDRESS 0x60036FAF /end MEASUREMENT
/begin MEASUREMENT DFC_b.LDF_StrtStkRly1 "Bit encoding / Last debounced flag bit for check DFC_StrtStkRly1" UBYTE DFC_OneToOne 1 100 0.00 1.000 BIT_MASK 0x10 FORMAT "%5.3" ECU_ADDRESS 0x60036FB0 /end MEASUREMENT
/begin MEASUREMENT DFC_b.LDF_StrtStkRly2 "Bit encoding / Last debounced flag bit for check DFC_StrtStkRly2" UBYTE DFC_OneToOne 1 100 0.00 1.000 BIT_MASK 0x10 FORMAT "%5.3" ECU_ADDRESS 0x60036FB1 /end MEASUREMENT
/begin MEASUREMENT DFC_b.LDF_TEVEmax "Bit encoding / Last debounced flag bit for check DFC_TEVEmax" UBYTE DFC_OneToOne 1 100 0.00 1.000 BIT_MASK 0x10 FORMAT "%5.3" ECU_ADDRESS 0x60036FB2 /end MEASUREMENT
/begin MEASUREMENT DFC_b.LDF_TEVEmin "Bit encoding / Last debounced flag bit for check DFC_TEVEmin" UBYTE DFC_OneToOne 1 100 0.00 1.000 BIT_MASK 0x10 FORMAT "%5.3" ECU_ADDRESS 0x60036FB3 /end MEASUREMENT
/begin MEASUREMENT DFC_b.LDF_TEVEsig "Bit encoding / Last debounced flag bit for check DFC_TEVEsig" UBYTE DFC_OneToOne 1 100 0.00 1.000 BIT_MASK 0x10 FORMAT "%5.3" ECU_ADDRESS 0x60036FB4 /end MEASUREMENT
/begin MEASUREMENT DFC_b.LDF_UegoHeatrPrfmncLoS1B1 "Bit encoding / Last debounced flag bit for check DFC_UegoHeatrPrfmncLoS1B1" UBYTE DFC_OneToOne 1 100 0.00 1.000 BIT_MASK 0x10 FORMAT "%5.3" ECU_ADDRESS 0x60036FB5 /end MEASUREMENT
/begin MEASUREMENT DFC_b.LDF_VehVAllPlaus "Bit encoding / Last debounced flag bit for check DFC_VehVAllPlaus" UBYTE DFC_OneToOne 1 100 0.00 1.000 BIT_MASK 0x10 FORMAT "%5.3" ECU_ADDRESS 0x60036FB6 /end MEASUREMENT
/begin MEASUREMENT DFC_b.LDF_VehVNCSnsrElecFailr "Bit encoding / Last debounced flag bit for check DFC_VehVNCSnsrElecFailr" UBYTE DFC_OneToOne 1 100 0.00 1.000 BIT_MASK 0x10 FORMAT "%5.3" ECU_ADDRESS 0x60036FB7 /end MEASUREMENT
/begin MEASUREMENT DFC_b.LDF_VehVPlausCan "Bit encoding / Last debounced flag bit for check DFC_VehVPlausCan" UBYTE DFC_OneToOne 1 100 0.00 1.000 BIT_MASK 0x10 FORMAT "%5.3" ECU_ADDRESS 0x60036FB8 /end MEASUREMENT
/begin MEASUREMENT DFC_b.LDF_VehVPlausFco "Bit encoding / Last debounced flag bit for check DFC_VehVPlausFco" UBYTE DFC_OneToOne 1 100 0.00 1.000 BIT_MASK 0x10 FORMAT "%5.3" ECU_ADDRESS 0x60036FB9 /end MEASUREMENT
/begin MEASUREMENT DFC_b.LDF_VehVPlausPwr "Bit encoding / Last debounced flag bit for check DFC_VehVPlausPwr" UBYTE DFC_OneToOne 1 100 0.00 1.000 BIT_MASK 0x10 FORMAT "%5.3" ECU_ADDRESS 0x60036FBA /end MEASUREMENT
/begin MEASUREMENT DFC_b.LDF_VehVPlausV2N "Bit encoding / Last debounced flag bit for check DFC_VehVPlausV2N" UBYTE DFC_OneToOne 1 100 0.00 1.000 BIT_MASK 0x10 FORMAT "%5.3" ECU_ADDRESS 0x60036FBB /end MEASUREMENT
/begin MEASUREMENT DFC_b.LDF_VehVSpdSnsrAElecFailr "Bit encoding / Last debounced flag bit for check DFC_VehVSpdSnsrAElecFailr" UBYTE DFC_OneToOne 1 100 0.00 1.000 BIT_MASK 0x10 FORMAT "%5.3" ECU_ADDRESS 0x60036FBC /end MEASUREMENT
/begin MEASUREMENT DFC_b.LDF_VehVSpdSnsrBElecFailr "Bit encoding / Last debounced flag bit for check DFC_VehVSpdSnsrBElecFailr" UBYTE DFC_OneToOne 1 100 0.00 1.000 BIT_MASK 0x10 FORMAT "%5.3" ECU_ADDRESS 0x60036FBD /end MEASUREMENT
/begin MEASUREMENT DFC_b.LDF_ClthMax "Bit encoding / Last debounced flag bit for check DFC_ClthMax" UBYTE DFC_OneToOne 1 100 0.00 1.000 BIT_MASK 0x10 FORMAT "%5.3" ECU_ADDRESS 0x60036FBE /end MEASUREMENT
/begin MEASUREMENT DFC_b.LDF_IgnClPs_DevComErr "Bit encoding / Last debounced flag bit for check DFC_IgnClPs_DevComErr" UBYTE DFC_OneToOne 1 100 0.00 1.000 BIT_MASK 0x10 FORMAT "%5.3" ECU_ADDRESS 0x60036FBF /end MEASUREMENT
/begin MEASUREMENT DFC_b.LDF_IgnClPs_LineOl_0 "Bit encoding / Last debounced flag bit for check DFC_IgnClPs_LineOl_0" UBYTE DFC_OneToOne 1 100 0.00 1.000 BIT_MASK 0x10 FORMAT "%5.3" ECU_ADDRESS 0x60036FC0 /end MEASUREMENT
/begin MEASUREMENT DFC_b.LDF_IgnClPs_LineOl_1 "Bit encoding / Last debounced flag bit for check DFC_IgnClPs_LineOl_1" UBYTE DFC_OneToOne 1 100 0.00 1.000 BIT_MASK 0x10 FORMAT "%5.3" ECU_ADDRESS 0x60036FC1 /end MEASUREMENT
/begin MEASUREMENT DFC_b.LDF_IgnClPs_LineOl_2 "Bit encoding / Last debounced flag bit for check DFC_IgnClPs_LineOl_2" UBYTE DFC_OneToOne 1 100 0.00 1.000 BIT_MASK 0x10 FORMAT "%5.3" ECU_ADDRESS 0x60036FC2 /end MEASUREMENT
/begin MEASUREMENT DFC_b.LDF_IgnClPs_LineOl_3 "Bit encoding / Last debounced flag bit for check DFC_IgnClPs_LineOl_3" UBYTE DFC_OneToOne 1 100 0.00 1.000 BIT_MASK 0x10 FORMAT "%5.3" ECU_ADDRESS 0x60036FC3 /end MEASUREMENT
/begin MEASUREMENT DFC_b.LDF_IgnClPs_LineScb_0 "Bit encoding / Last debounced flag bit for check DFC_IgnClPs_LineScb_0" UBYTE DFC_OneToOne 1 100 0.00 1.000 BIT_MASK 0x10 FORMAT "%5.3" ECU_ADDRESS 0x60036FC4 /end MEASUREMENT
/begin MEASUREMENT DFC_b.LDF_IgnClPs_LineScb_1 "Bit encoding / Last debounced flag bit for check DFC_IgnClPs_LineScb_1" UBYTE DFC_OneToOne 1 100 0.00 1.000 BIT_MASK 0x10 FORMAT "%5.3" ECU_ADDRESS 0x60036FC5 /end MEASUREMENT
/begin MEASUREMENT DFC_b.LDF_IgnClPs_LineScb_2 "Bit encoding / Last debounced flag bit for check DFC_IgnClPs_LineScb_2" UBYTE DFC_OneToOne 1 100 0.00 1.000 BIT_MASK 0x10 FORMAT "%5.3" ECU_ADDRESS 0x60036FC6 /end MEASUREMENT
/begin MEASUREMENT DFC_b.LDF_IgnClPs_LineScb_3 "Bit encoding / Last debounced flag bit for check DFC_IgnClPs_LineScb_3" UBYTE DFC_OneToOne 1 100 0.00 1.000 BIT_MASK 0x10 FORMAT "%5.3" ECU_ADDRESS 0x60036FC7 /end MEASUREMENT
/begin MEASUREMENT DFC_b.LDF_IgnClPs_LineScg_0 "Bit encoding / Last debounced flag bit for check DFC_IgnClPs_LineScg_0" UBYTE DFC_OneToOne 1 100 0.00 1.000 BIT_MASK 0x10 FORMAT "%5.3" ECU_ADDRESS 0x60036FC8 /end MEASUREMENT
/begin MEASUREMENT DFC_b.LDF_IgnClPs_LineScg_1 "Bit encoding / Last debounced flag bit for check DFC_IgnClPs_LineScg_1" UBYTE DFC_OneToOne 1 100 0.00 1.000 BIT_MASK 0x10 FORMAT "%5.3" ECU_ADDRESS 0x60036FC9 /end MEASUREMENT
/begin MEASUREMENT DFC_b.LDF_IgnClPs_LineScg_2 "Bit encoding / Last debounced flag bit for check DFC_IgnClPs_LineScg_2" UBYTE DFC_OneToOne 1 100 0.00 1.000 BIT_MASK 0x10 FORMAT "%5.3" ECU_ADDRESS 0x60036FCA /end MEASUREMENT
/begin MEASUREMENT DFC_b.LDF_IgnClPs_LineScg_3 "Bit encoding / Last debounced flag bit for check DFC_IgnClPs_LineScg_3" UBYTE DFC_OneToOne 1 100 0.00 1.000 BIT_MASK 0x10 FORMAT "%5.3" ECU_ADDRESS 0x60036FCB /end MEASUREMENT
/begin MEASUREMENT DFC_b.LDF_KRVEKOEVAB "Bit encoding / Last debounced flag bit for check DFC_KRVEKOEVAB" UBYTE DFC_OneToOne 1 100 0.00 1.000 BIT_MASK 0x10 FORMAT "%5.3" ECU_ADDRESS 0x60036FCC /end MEASUREMENT
/begin MEASUREMENT DFC_b.LDF_KRVEKOEVAB0 "Bit encoding / Last debounced flag bit for check DFC_KRVEKOEVAB0" UBYTE DFC_OneToOne 1 100 0.00 1.000 BIT_MASK 0x10 FORMAT "%5.3" ECU_ADDRESS 0x60036FCD /end MEASUREMENT
/begin MEASUREMENT DFC_b.LDF_KRVEKOEVAB1 "Bit encoding / Last debounced flag bit for check DFC_KRVEKOEVAB1" UBYTE DFC_OneToOne 1 100 0.00 1.000 BIT_MASK 0x10 FORMAT "%5.3" ECU_ADDRESS 0x60036FCE /end MEASUREMENT
/begin MEASUREMENT DFC_b.LDF_KRVEKOEVAB2 "Bit encoding / Last debounced flag bit for check DFC_KRVEKOEVAB2" UBYTE DFC_OneToOne 1 100 0.00 1.000 BIT_MASK 0x10 FORMAT "%5.3" ECU_ADDRESS 0x60036FCF /end MEASUREMENT
/begin MEASUREMENT DFC_b.LDF_KRVEKOEVAB3 "Bit encoding / Last debounced flag bit for check DFC_KRVEKOEVAB3" UBYTE DFC_OneToOne 1 100 0.00 1.000 BIT_MASK 0x10 FORMAT "%5.3" ECU_ADDRESS 0x60036FD0 /end MEASUREMENT
/begin MEASUREMENT DFC_b.LDF_UegoSigEcuAsicS1B1 "Bit encoding / Last debounced flag bit for check DFC_UegoSigEcuAsicS1B1" UBYTE DFC_OneToOne 1 100 0.00 1.000 BIT_MASK 0x10 FORMAT "%5.3" ECU_ADDRESS 0x60036FD1 /end MEASUREMENT
/begin MEASUREMENT DFC_b.LDF_UegoSigEcuComS1B1 "Bit encoding / Last debounced flag bit for check DFC_UegoSigEcuComS1B1" UBYTE DFC_OneToOne 1 100 0.00 1.000 BIT_MASK 0x10 FORMAT "%5.3" ECU_ADDRESS 0x60036FD2 /end MEASUREMENT
/begin MEASUREMENT DFC_b.LDF_UegoSigSnsrS1B1 "Bit encoding / Last debounced flag bit for check DFC_UegoSigSnsrS1B1" UBYTE DFC_OneToOne 1 100 0.00 1.000 BIT_MASK 0x10 FORMAT "%5.3" ECU_ADDRESS 0x60036FD3 /end MEASUREMENT
/begin MEASUREMENT DFC_b.LDF_UegoSigWireOlApesS1B1 "Bit encoding / Last debounced flag bit for check DFC_UegoSigWireOlApesS1B1" UBYTE DFC_OneToOne 1 100 0.00 1.000 BIT_MASK 0x10 FORMAT "%5.3" ECU_ADDRESS 0x60036FD4 /end MEASUREMENT
/begin MEASUREMENT DFC_b.LDF_UegoSigWireOlIpeS1B1 "Bit encoding / Last debounced flag bit for check DFC_UegoSigWireOlIpeS1B1" UBYTE DFC_OneToOne 1 100 0.00 1.000 BIT_MASK 0x10 FORMAT "%5.3" ECU_ADDRESS 0x60036FD5 /end MEASUREMENT
/begin MEASUREMENT DFC_b.LDF_UegoSigWireOlReS1B1 "Bit encoding / Last debounced flag bit for check DFC_UegoSigWireOlReS1B1" UBYTE DFC_OneToOne 1 100 0.00 1.000 BIT_MASK 0x10 FORMAT "%5.3" ECU_ADDRESS 0x60036FD6 /end MEASUREMENT
/begin MEASUREMENT DFC_b.LDF_UegoSigWireRCmpS1B1 "Bit encoding / Last debounced flag bit for check DFC_UegoSigWireRCmpS1B1" UBYTE DFC_OneToOne 1 100 0.00 1.000 BIT_MASK 0x10 FORMAT "%5.3" ECU_ADDRESS 0x60036FD7 /end MEASUREMENT
/begin MEASUREMENT DFC_b.LDF_UegoSigWireScbS1B1 "Bit encoding / Last debounced flag bit for check DFC_UegoSigWireScbS1B1" UBYTE DFC_OneToOne 1 100 0.00 1.000 BIT_MASK 0x10 FORMAT "%5.3" ECU_ADDRESS 0x60036FD8 /end MEASUREMENT
/begin MEASUREMENT DFC_b.LDF_UegoSigWireScgS1B1 "Bit encoding / Last debounced flag bit for check DFC_UegoSigWireScgS1B1" UBYTE DFC_OneToOne 1 100 0.00 1.000 BIT_MASK 0x10 FORMAT "%5.3" ECU_ADDRESS 0x60036FD9 /end MEASUREMENT
/begin MEASUREMENT DFC_b.LDF_AfsPhyRngHiB1 "Bit encoding / Last debounced flag bit for check DFC_AfsPhyRngHiB1" UBYTE DFC_OneToOne 1 100 0.00 1.000 BIT_MASK 0x10 FORMAT "%5.3" ECU_ADDRESS 0x60036FDA /end MEASUREMENT
/begin MEASUREMENT DFC_b.LDF_AfsPhyRngLoB1 "Bit encoding / Last debounced flag bit for check DFC_AfsPhyRngLoB1" UBYTE DFC_OneToOne 1 100 0.00 1.000 BIT_MASK 0x10 FORMAT "%5.3" ECU_ADDRESS 0x60036FDB /end MEASUREMENT
/begin MEASUREMENT DFC_b.LDF_AirCCmprOL "Bit encoding / Last debounced flag bit for check DFC_AirCCmprOL" UBYTE DFC_OneToOne 1 100 0.00 1.000 BIT_MASK 0x10 FORMAT "%5.3" ECU_ADDRESS 0x60036FDC /end MEASUREMENT
/begin MEASUREMENT DFC_b.LDF_AirCCmprOvrTemp "Bit encoding / Last debounced flag bit for check DFC_AirCCmprOvrTemp" UBYTE DFC_OneToOne 1 100 0.00 1.000 BIT_MASK 0x10 FORMAT "%5.3" ECU_ADDRESS 0x60036FDD /end MEASUREMENT
/begin MEASUREMENT DFC_b.LDF_AirCCmprSCB "Bit encoding / Last debounced flag bit for check DFC_AirCCmprSCB" UBYTE DFC_OneToOne 1 100 0.00 1.000 BIT_MASK 0x10 FORMAT "%5.3" ECU_ADDRESS 0x60036FDE /end MEASUREMENT
/begin MEASUREMENT DFC_b.LDF_AirCCmprSCG "Bit encoding / Last debounced flag bit for check DFC_AirCCmprSCG" UBYTE DFC_OneToOne 1 100 0.00 1.000 BIT_MASK 0x10 FORMAT "%5.3" ECU_ADDRESS 0x60036FDF /end MEASUREMENT
/begin MEASUREMENT DFC_b.LDF_AltErr "Bit encoding / Last debounced flag bit for check DFC_AltErr" UBYTE DFC_OneToOne 1 100 0.00 1.000 BIT_MASK 0x10 FORMAT "%5.3" ECU_ADDRESS 0x60036FE0 /end MEASUREMENT
/begin MEASUREMENT DFC_b.LDF_BattUSRCMax "Bit encoding / Last debounced flag bit for check DFC_BattUSRCMax" UBYTE DFC_OneToOne 1 100 0.00 1.000 BIT_MASK 0x10 FORMAT "%5.3" ECU_ADDRESS 0x60036FE1 /end MEASUREMENT
/begin MEASUREMENT DFC_b.LDF_BattUSRCMin "Bit encoding / Last debounced flag bit for check DFC_BattUSRCMin" UBYTE DFC_OneToOne 1 100 0.00 1.000 BIT_MASK 0x10 FORMAT "%5.3" ECU_ADDRESS 0x60036FE2 /end MEASUREMENT
/begin MEASUREMENT DFC_b.LDF_ComChksTCU1 "Bit encoding / Last debounced flag bit for check DFC_ComChksTCU1" UBYTE DFC_OneToOne 1 100 0.00 1.000 BIT_MASK 0x10 FORMAT "%5.3" ECU_ADDRESS 0x60036FE3 /end MEASUREMENT
/begin MEASUREMENT DFC_b.LDF_ComChksTCU11 "Bit encoding / Last debounced flag bit for check DFC_ComChksTCU11" UBYTE DFC_OneToOne 1 100 0.00 1.000 BIT_MASK 0x10 FORMAT "%5.3" ECU_ADDRESS 0x60036FE4 /end MEASUREMENT
/begin MEASUREMENT DFC_b.LDF_ComChksTCU12 "Bit encoding / Last debounced flag bit for check DFC_ComChksTCU12" UBYTE DFC_OneToOne 1 100 0.00 1.000 BIT_MASK 0x10 FORMAT "%5.3" ECU_ADDRESS 0x60036FE5 /end MEASUREMENT
/begin MEASUREMENT DFC_b.LDF_ComChksTCU13 "Bit encoding / Last debounced flag bit for check DFC_ComChksTCU13" UBYTE DFC_OneToOne 1 100 0.00 1.000 BIT_MASK 0x10 FORMAT "%5.3" ECU_ADDRESS 0x60036FE6 /end MEASUREMENT
/begin MEASUREMENT DFC_b.LDF_ComChksTCU2 "Bit encoding / Last debounced flag bit for check DFC_ComChksTCU2" UBYTE DFC_OneToOne 1 100 0.00 1.000 BIT_MASK 0x10 FORMAT "%5.3" ECU_ADDRESS 0x60036FE7 /end MEASUREMENT
/begin MEASUREMENT DFC_b.LDF_ComChksTCU3 "Bit encoding / Last debounced flag bit for check DFC_ComChksTCU3" UBYTE DFC_OneToOne 1 100 0.00 1.000 BIT_MASK 0x10 FORMAT "%5.3" ECU_ADDRESS 0x60036FE8 /end MEASUREMENT
/begin MEASUREMENT DFC_b.LDF_ComChksTCU4 "Bit encoding / Last debounced flag bit for check DFC_ComChksTCU4" UBYTE DFC_OneToOne 1 100 0.00 1.000 BIT_MASK 0x10 FORMAT "%5.3" ECU_ADDRESS 0x60036FE9 /end MEASUREMENT
/begin MEASUREMENT DFC_b.LDF_ComCntTCU1 "Bit encoding / Last debounced flag bit for check DFC_ComCntTCU1" UBYTE DFC_OneToOne 1 100 0.00 1.000 BIT_MASK 0x10 FORMAT "%5.3" ECU_ADDRESS 0x60036FEA /end MEASUREMENT
/begin MEASUREMENT DFC_b.LDF_ComCntTCU11 "Bit encoding / Last debounced flag bit for check DFC_ComCntTCU11" UBYTE DFC_OneToOne 1 100 0.00 1.000 BIT_MASK 0x10 FORMAT "%5.3" ECU_ADDRESS 0x60036FEB /end MEASUREMENT
/begin MEASUREMENT DFC_b.LDF_ComCntTCU12 "Bit encoding / Last debounced flag bit for check DFC_ComCntTCU12" UBYTE DFC_OneToOne 1 100 0.00 1.000 BIT_MASK 0x10 FORMAT "%5.3" ECU_ADDRESS 0x60036FEC /end MEASUREMENT
/begin MEASUREMENT DFC_b.LDF_ComCntTCU13 "Bit encoding / Last debounced flag bit for check DFC_ComCntTCU13" UBYTE DFC_OneToOne 1 100 0.00 1.000 BIT_MASK 0x10 FORMAT "%5.3" ECU_ADDRESS 0x60036FED /end MEASUREMENT
/begin MEASUREMENT DFC_b.LDF_ComCntTCU2 "Bit encoding / Last debounced flag bit for check DFC_ComCntTCU2" UBYTE DFC_OneToOne 1 100 0.00 1.000 BIT_MASK 0x10 FORMAT "%5.3" ECU_ADDRESS 0x60036FEE /end MEASUREMENT
/begin MEASUREMENT DFC_b.LDF_ComCntTCU3 "Bit encoding / Last debounced flag bit for check DFC_ComCntTCU3" UBYTE DFC_OneToOne 1 100 0.00 1.000 BIT_MASK 0x10 FORMAT "%5.3" ECU_ADDRESS 0x60036FEF /end MEASUREMENT
/begin MEASUREMENT DFC_b.LDF_ComCntTCU4 "Bit encoding / Last debounced flag bit for check DFC_ComCntTCU4" UBYTE DFC_OneToOne 1 100 0.00 1.000 BIT_MASK 0x10 FORMAT "%5.3" ECU_ADDRESS 0x60036FF0 /end MEASUREMENT
/begin MEASUREMENT DFC_b.LDF_ComTOutTCU01 "Bit encoding / Last debounced flag bit for check DFC_ComTOutTCU01" UBYTE DFC_OneToOne 1 100 0.00 1.000 BIT_MASK 0x10 FORMAT "%5.3" ECU_ADDRESS 0x60036FF1 /end MEASUREMENT
/begin MEASUREMENT DFC_b.LDF_ComTOutTCU02 "Bit encoding / Last debounced flag bit for check DFC_ComTOutTCU02" UBYTE DFC_OneToOne 1 100 0.00 1.000 BIT_MASK 0x10 FORMAT "%5.3" ECU_ADDRESS 0x60036FF2 /end MEASUREMENT
/begin MEASUREMENT DFC_b.LDF_ComTOutTCU1 "Bit encoding / Last debounced flag bit for check DFC_ComTOutTCU1" UBYTE DFC_OneToOne 1 100 0.00 1.000 BIT_MASK 0x10 FORMAT "%5.3" ECU_ADDRESS 0x60036FF3 /end MEASUREMENT
/begin MEASUREMENT DFC_b.LDF_ComTOutTCU11 "Bit encoding / Last debounced flag bit for check DFC_ComTOutTCU11" UBYTE DFC_OneToOne 1 100 0.00 1.000 BIT_MASK 0x10 FORMAT "%5.3" ECU_ADDRESS 0x60036FF4 /end MEASUREMENT
/begin MEASUREMENT DFC_b.LDF_ComTOutTCU12 "Bit encoding / Last debounced flag bit for check DFC_ComTOutTCU12" UBYTE DFC_OneToOne 1 100 0.00 1.000 BIT_MASK 0x10 FORMAT "%5.3" ECU_ADDRESS 0x60036FF5 /end MEASUREMENT
/begin MEASUREMENT DFC_b.LDF_ComTOutTCU13 "Bit encoding / Last debounced flag bit for check DFC_ComTOutTCU13" UBYTE DFC_OneToOne 1 100 0.00 1.000 BIT_MASK 0x10 FORMAT "%5.3" ECU_ADDRESS 0x60036FF6 /end MEASUREMENT
/begin MEASUREMENT DFC_b.LDF_ComTOutTCU14 "Bit encoding / Last debounced flag bit for check DFC_ComTOutTCU14" UBYTE DFC_OneToOne 1 100 0.00 1.000 BIT_MASK 0x10 FORMAT "%5.3" ECU_ADDRESS 0x60036FF7 /end MEASUREMENT
/begin MEASUREMENT DFC_b.LDF_ComTOutTCU2 "Bit encoding / Last debounced flag bit for check DFC_ComTOutTCU2" UBYTE DFC_OneToOne 1 100 0.00 1.000 BIT_MASK 0x10 FORMAT "%5.3" ECU_ADDRESS 0x60036FF8 /end MEASUREMENT
/begin MEASUREMENT DFC_b.LDF_ComTOutTCU3 "Bit encoding / Last debounced flag bit for check DFC_ComTOutTCU3" UBYTE DFC_OneToOne 1 100 0.00 1.000 BIT_MASK 0x10 FORMAT "%5.3" ECU_ADDRESS 0x60036FF9 /end MEASUREMENT
/begin MEASUREMENT DFC_b.LDF_ComTOutTCU4 "Bit encoding / Last debounced flag bit for check DFC_ComTOutTCU4" UBYTE DFC_OneToOne 1 100 0.00 1.000 BIT_MASK 0x10 FORMAT "%5.3" ECU_ADDRESS 0x60036FFA /end MEASUREMENT
/begin MEASUREMENT DFC_b.LDF_DevLibBattUHi "Bit encoding / Last debounced flag bit for check DFC_DevLibBattUHi" UBYTE DFC_OneToOne 1 100 0.00 1.000 BIT_MASK 0x10 FORMAT "%5.3" ECU_ADDRESS 0x60036FFB /end MEASUREMENT
/begin MEASUREMENT DFC_b.LDF_DevLibBattULo "Bit encoding / Last debounced flag bit for check DFC_DevLibBattULo" UBYTE DFC_OneToOne 1 100 0.00 1.000 BIT_MASK 0x10 FORMAT "%5.3" ECU_ADDRESS 0x60036FFC /end MEASUREMENT
/begin MEASUREMENT DFC_b.LDF_EGRVlvFailSafeActv "Bit encoding / Last debounced flag bit for check DFC_EGRVlvFailSafeActv" UBYTE DFC_OneToOne 1 100 0.00 1.000 BIT_MASK 0x10 FORMAT "%5.3" ECU_ADDRESS 0x60036FFD /end MEASUREMENT
/begin MEASUREMENT DFC_b.LDF_EGRVlvGovDvtCld "Bit encoding / Last debounced flag bit for check DFC_EGRVlvGovDvtCld" UBYTE DFC_OneToOne 1 100 0.00 1.000 BIT_MASK 0x10 FORMAT "%5.3" ECU_ADDRESS 0x60036FFE /end MEASUREMENT
/begin MEASUREMENT DFC_b.LDF_EGRVlvPhysSRCMax "Bit encoding / Last debounced flag bit for check DFC_EGRVlvPhysSRCMax" UBYTE DFC_OneToOne 1 100 0.00 1.000 BIT_MASK 0x10 FORMAT "%5.3" ECU_ADDRESS 0x60036FFF /end MEASUREMENT
/begin MEASUREMENT DFC_b.LDF_EGRVlvPhysSRCMin "Bit encoding / Last debounced flag bit for check DFC_EGRVlvPhysSRCMin" UBYTE DFC_OneToOne 1 100 0.00 1.000 BIT_MASK 0x10 FORMAT "%5.3" ECU_ADDRESS 0x60037000 /end MEASUREMENT
/begin MEASUREMENT DFC_b.LDF_FanDIOOL_0 "Bit encoding / Last debounced flag bit for check DFC_FanDIOOL_0" UBYTE DFC_OneToOne 1 100 0.00 1.000 BIT_MASK 0x10 FORMAT "%5.3" ECU_ADDRESS 0x60037001 /end MEASUREMENT
/begin MEASUREMENT DFC_b.LDF_FanDIOOL_1 "Bit encoding / Last debounced flag bit for check DFC_FanDIOOL_1" UBYTE DFC_OneToOne 1 100 0.00 1.000 BIT_MASK 0x10 FORMAT "%5.3" ECU_ADDRESS 0x60037002 /end MEASUREMENT
/begin MEASUREMENT DFC_b.LDF_FanDIOOvrTemp_0 "Bit encoding / Last debounced flag bit for check DFC_FanDIOOvrTemp_0" UBYTE DFC_OneToOne 1 100 0.00 1.000 BIT_MASK 0x10 FORMAT "%5.3" ECU_ADDRESS 0x60037003 /end MEASUREMENT
/begin MEASUREMENT DFC_b.LDF_FanDIOOvrTemp_1 "Bit encoding / Last debounced flag bit for check DFC_FanDIOOvrTemp_1" UBYTE DFC_OneToOne 1 100 0.00 1.000 BIT_MASK 0x10 FORMAT "%5.3" ECU_ADDRESS 0x60037004 /end MEASUREMENT
/begin MEASUREMENT DFC_b.LDF_FanDIOSCB_0 "Bit encoding / Last debounced flag bit for check DFC_FanDIOSCB_0" UBYTE DFC_OneToOne 1 100 0.00 1.000 BIT_MASK 0x10 FORMAT "%5.3" ECU_ADDRESS 0x60037005 /end MEASUREMENT
/begin MEASUREMENT DFC_b.LDF_FanDIOSCB_1 "Bit encoding / Last debounced flag bit for check DFC_FanDIOSCB_1" UBYTE DFC_OneToOne 1 100 0.00 1.000 BIT_MASK 0x10 FORMAT "%5.3" ECU_ADDRESS 0x60037006 /end MEASUREMENT
/begin MEASUREMENT DFC_b.LDF_FanDIOSCG_0 "Bit encoding / Last debounced flag bit for check DFC_FanDIOSCG_0" UBYTE DFC_OneToOne 1 100 0.00 1.000 BIT_MASK 0x10 FORMAT "%5.3" ECU_ADDRESS 0x60037007 /end MEASUREMENT
/begin MEASUREMENT DFC_b.LDF_FanDIOSCG_1 "Bit encoding / Last debounced flag bit for check DFC_FanDIOSCG_1" UBYTE DFC_OneToOne 1 100 0.00 1.000 BIT_MASK 0x10 FORMAT "%5.3" ECU_ADDRESS 0x60037008 /end MEASUREMENT
/begin MEASUREMENT DFC_b.LDF_MRlyDcOL "Bit encoding / Last debounced flag bit for check DFC_MRlyDcOL" UBYTE DFC_OneToOne 1 100 0.00 1.000 BIT_MASK 0x10 FORMAT "%5.3" ECU_ADDRESS 0x60037009 /end MEASUREMENT
/begin MEASUREMENT DFC_b.LDF_MRlyDcSCB "Bit encoding / Last debounced flag bit for check DFC_MRlyDcSCB" UBYTE DFC_OneToOne 1 100 0.00 1.000 BIT_MASK 0x10 FORMAT "%5.3" ECU_ADDRESS 0x6003700A /end MEASUREMENT
/begin MEASUREMENT DFC_b.LDF_MRlyDcSCG "Bit encoding / Last debounced flag bit for check DFC_MRlyDcSCG" UBYTE DFC_OneToOne 1 100 0.00 1.000 BIT_MASK 0x10 FORMAT "%5.3" ECU_ADDRESS 0x6003700B /end MEASUREMENT
/begin MEASUREMENT DFC_b.LDF_PSPOL "Bit encoding / Last debounced flag bit for check DFC_PSPOL" UBYTE DFC_OneToOne 1 100 0.00 1.000 BIT_MASK 0x10 FORMAT "%5.3" ECU_ADDRESS 0x6003700C /end MEASUREMENT
/begin MEASUREMENT DFC_b.LDF_PSPOvrTemp "Bit encoding / Last debounced flag bit for check DFC_PSPOvrTemp" UBYTE DFC_OneToOne 1 100 0.00 1.000 BIT_MASK 0x10 FORMAT "%5.3" ECU_ADDRESS 0x6003700D /end MEASUREMENT
/begin MEASUREMENT DFC_b.LDF_PSPSCB "Bit encoding / Last debounced flag bit for check DFC_PSPSCB" UBYTE DFC_OneToOne 1 100 0.00 1.000 BIT_MASK 0x10 FORMAT "%5.3" ECU_ADDRESS 0x6003700E /end MEASUREMENT
/begin MEASUREMENT DFC_b.LDF_PSPSCG "Bit encoding / Last debounced flag bit for check DFC_PSPSCG" UBYTE DFC_OneToOne 1 100 0.00 1.000 BIT_MASK 0x10 FORMAT "%5.3" ECU_ADDRESS 0x6003700F /end MEASUREMENT
/begin MEASUREMENT DFC_b.LDF_T50Err "Bit encoding / Last debounced flag bit for check DFC_T50Err" UBYTE DFC_OneToOne 1 100 0.00 1.000 BIT_MASK 0x10 FORMAT "%5.3" ECU_ADDRESS 0x60037010 /end MEASUREMENT
/begin MEASUREMENT DFC_b.LDF_ThrVlvLoBattB1 "Bit encoding / Last debounced flag bit for check DFC_ThrVlvLoBattB1" UBYTE DFC_OneToOne 1 100 0.00 1.000 BIT_MASK 0x10 FORMAT "%5.3" ECU_ADDRESS 0x60037011 /end MEASUREMENT
/begin MEASUREMENT DFC_b.LDF_UegoSigOperPlausS1B1 "Bit encoding / Last debounced flag bit for check DFC_UegoSigOperPlausS1B1" UBYTE DFC_OneToOne 1 100 0.00 1.000 BIT_MASK 0x10 FORMAT "%5.3" ECU_ADDRESS 0x60037012 /end MEASUREMENT
/begin MEASUREMENT DFC_b.LDF_VehVPhysRngHi "Bit encoding / Last debounced flag bit for check DFC_VehVPhysRngHi" UBYTE DFC_OneToOne 1 100 0.00 1.000 BIT_MASK 0x10 FORMAT "%5.3" ECU_ADDRESS 0x60037013 /end MEASUREMENT
/begin MEASUREMENT DFC_b.LDF_VehVSclOutOL "Bit encoding / Last debounced flag bit for check DFC_VehVSclOutOL" UBYTE DFC_OneToOne 1 100 0.00 1.000 BIT_MASK 0x10 FORMAT "%5.3" ECU_ADDRESS 0x60037014 /end MEASUREMENT
/begin MEASUREMENT DFC_b.LDF_VehVSclOutOT "Bit encoding / Last debounced flag bit for check DFC_VehVSclOutOT" UBYTE DFC_OneToOne 1 100 0.00 1.000 BIT_MASK 0x10 FORMAT "%5.3" ECU_ADDRESS 0x60037015 /end MEASUREMENT
/begin MEASUREMENT DFC_b.LDF_VehVSclOutSCB "Bit encoding / Last debounced flag bit for check DFC_VehVSclOutSCB" UBYTE DFC_OneToOne 1 100 0.00 1.000 BIT_MASK 0x10 FORMAT "%5.3" ECU_ADDRESS 0x60037016 /end MEASUREMENT
/begin MEASUREMENT DFC_b.LDF_VehVSclOutSCG "Bit encoding / Last debounced flag bit for check DFC_VehVSclOutSCG" UBYTE DFC_OneToOne 1 100 0.00 1.000 BIT_MASK 0x10 FORMAT "%5.3" ECU_ADDRESS 0x60037017 /end MEASUREMENT
/begin MEASUREMENT DFC_b.LDF_VehVSigFL "Bit encoding / Last debounced flag bit for check DFC_VehVSigFL" UBYTE DFC_OneToOne 1 100 0.00 1.000 BIT_MASK 0x10 FORMAT "%5.3" ECU_ADDRESS 0x60037018 /end MEASUREMENT
/begin MEASUREMENT DFC_b.LDF_VehVSigFR "Bit encoding / Last debounced flag bit for check DFC_VehVSigFR" UBYTE DFC_OneToOne 1 100 0.00 1.000 BIT_MASK 0x10 FORMAT "%5.3" ECU_ADDRESS 0x60037019 /end MEASUREMENT
/begin MEASUREMENT DFC_b.LDF_VehVSigRL "Bit encoding / Last debounced flag bit for check DFC_VehVSigRL" UBYTE DFC_OneToOne 1 100 0.00 1.000 BIT_MASK 0x10 FORMAT "%5.3" ECU_ADDRESS 0x6003701A /end MEASUREMENT
/begin MEASUREMENT DFC_b.LDF_VehVSigRR "Bit encoding / Last debounced flag bit for check DFC_VehVSigRR" UBYTE DFC_OneToOne 1 100 0.00 1.000 BIT_MASK 0x10 FORMAT "%5.3" ECU_ADDRESS 0x6003701B /end MEASUREMENT
/begin MEASUREMENT DFC_b.LDF_VehVSnsrARngHi "Bit encoding / Last debounced flag bit for check DFC_VehVSnsrARngHi" UBYTE DFC_OneToOne 1 100 0.00 1.000 BIT_MASK 0x10 FORMAT "%5.3" ECU_ADDRESS 0x6003701C /end MEASUREMENT
/begin MEASUREMENT DFC_b.LDF_VehVSnsrBRngHi "Bit encoding / Last debounced flag bit for check DFC_VehVSnsrBRngHi" UBYTE DFC_OneToOne 1 100 0.00 1.000 BIT_MASK 0x10 FORMAT "%5.3" ECU_ADDRESS 0x6003701D /end MEASUREMENT
/begin MEASUREMENT DFC_b.LDF_VehVSpdRtyDiag "Bit encoding / Last debounced flag bit for check DFC_VehVSpdRtyDiag" UBYTE DFC_OneToOne 1 100 0.00 1.000 BIT_MASK 0x10 FORMAT "%5.3" ECU_ADDRESS 0x6003701E /end MEASUREMENT
/begin MEASUREMENT DFC_b.LDF_DHFHD "Bit encoding / Last debounced flag bit for check DFC_DHFHD" UBYTE DFC_OneToOne 1 100 0.00 1.000 BIT_MASK 0x10 FORMAT "%5.3" ECU_ADDRESS 0x6003701F /end MEASUREMENT
/begin MEASUREMENT DFC_b.LDF_InjVlv_DI_DcDc "Bit encoding / Last debounced flag bit for check DFC_InjVlv_DI_DcDc" UBYTE DFC_OneToOne 1 100 0.00 1.000 BIT_MASK 0x10 FORMAT "%5.3" ECU_ADDRESS 0x60037020 /end MEASUREMENT
/begin MEASUREMENT DFC_b.LDF_InjVlv_DI_NoLd_0 "Bit encoding / Last debounced flag bit for check DFC_InjVlv_DI_NoLd_0" UBYTE DFC_OneToOne 1 100 0.00 1.000 BIT_MASK 0x10 FORMAT "%5.3" ECU_ADDRESS 0x60037021 /end MEASUREMENT
/begin MEASUREMENT DFC_b.LDF_InjVlv_DI_NoLd_1 "Bit encoding / Last debounced flag bit for check DFC_InjVlv_DI_NoLd_1" UBYTE DFC_OneToOne 1 100 0.00 1.000 BIT_MASK 0x10 FORMAT "%5.3" ECU_ADDRESS 0x60037022 /end MEASUREMENT
/begin MEASUREMENT DFC_b.LDF_InjVlv_DI_NoLd_2 "Bit encoding / Last debounced flag bit for check DFC_InjVlv_DI_NoLd_2" UBYTE DFC_OneToOne 1 100 0.00 1.000 BIT_MASK 0x10 FORMAT "%5.3" ECU_ADDRESS 0x60037023 /end MEASUREMENT
/begin MEASUREMENT DFC_b.LDF_InjVlv_DI_NoLd_3 "Bit encoding / Last debounced flag bit for check DFC_InjVlv_DI_NoLd_3" UBYTE DFC_OneToOne 1 100 0.00 1.000 BIT_MASK 0x10 FORMAT "%5.3" ECU_ADDRESS 0x60037024 /end MEASUREMENT
/begin MEASUREMENT DFC_b.LDF_InjVlv_DI_ScBnk_0 "Bit encoding / Last debounced flag bit for check DFC_InjVlv_DI_ScBnk_0" UBYTE DFC_OneToOne 1 100 0.00 1.000 BIT_MASK 0x10 FORMAT "%5.3" ECU_ADDRESS 0x60037025 /end MEASUREMENT
/begin MEASUREMENT DFC_b.LDF_InjVlv_DI_ScBnk_1 "Bit encoding / Last debounced flag bit for check DFC_InjVlv_DI_ScBnk_1" UBYTE DFC_OneToOne 1 100 0.00 1.000 BIT_MASK 0x10 FORMAT "%5.3" ECU_ADDRESS 0x60037026 /end MEASUREMENT
/begin MEASUREMENT DFC_b.LDF_InjVlv_DI_ScBnk_2 "Bit encoding / Last debounced flag bit for check DFC_InjVlv_DI_ScBnk_2" UBYTE DFC_OneToOne 1 100 0.00 1.000 BIT_MASK 0x10 FORMAT "%5.3" ECU_ADDRESS 0x60037027 /end MEASUREMENT
/begin MEASUREMENT DFC_b.LDF_InjVlv_DI_ScBnk_3 "Bit encoding / Last debounced flag bit for check DFC_InjVlv_DI_ScBnk_3" UBYTE DFC_OneToOne 1 100 0.00 1.000 BIT_MASK 0x10 FORMAT "%5.3" ECU_ADDRESS 0x60037028 /end MEASUREMENT
/begin MEASUREMENT DFC_b.LDF_InjVlv_DI_ScCyl_0 "Bit encoding / Last debounced flag bit for check DFC_InjVlv_DI_ScCyl_0" UBYTE DFC_OneToOne 1 100 0.00 1.000 BIT_MASK 0x10 FORMAT "%5.3" ECU_ADDRESS 0x60037029 /end MEASUREMENT
/begin MEASUREMENT DFC_b.LDF_InjVlv_DI_ScCyl_1 "Bit encoding / Last debounced flag bit for check DFC_InjVlv_DI_ScCyl_1" UBYTE DFC_OneToOne 1 100 0.00 1.000 BIT_MASK 0x10 FORMAT "%5.3" ECU_ADDRESS 0x6003702A /end MEASUREMENT
/begin MEASUREMENT DFC_b.LDF_InjVlv_DI_ScCyl_2 "Bit encoding / Last debounced flag bit for check DFC_InjVlv_DI_ScCyl_2" UBYTE DFC_OneToOne 1 100 0.00 1.000 BIT_MASK 0x10 FORMAT "%5.3" ECU_ADDRESS 0x6003702B /end MEASUREMENT
/begin MEASUREMENT DFC_b.LDF_InjVlv_DI_ScCyl_3 "Bit encoding / Last debounced flag bit for check DFC_InjVlv_DI_ScCyl_3" UBYTE DFC_OneToOne 1 100 0.00 1.000 BIT_MASK 0x10 FORMAT "%5.3" ECU_ADDRESS 0x6003702C /end MEASUREMENT
/begin MEASUREMENT DFC_b.LDF_InjVlv_DI_ScHsLs_0 "Bit encoding / Last debounced flag bit for check DFC_InjVlv_DI_ScHsLs_0" UBYTE DFC_OneToOne 1 100 0.00 1.000 BIT_MASK 0x10 FORMAT "%5.3" ECU_ADDRESS 0x6003702D /end MEASUREMENT
/begin MEASUREMENT DFC_b.LDF_InjVlv_DI_ScHsLs_1 "Bit encoding / Last debounced flag bit for check DFC_InjVlv_DI_ScHsLs_1" UBYTE DFC_OneToOne 1 100 0.00 1.000 BIT_MASK 0x10 FORMAT "%5.3" ECU_ADDRESS 0x6003702E /end MEASUREMENT
/begin MEASUREMENT DFC_b.LDF_InjVlv_DI_ScHsLs_2 "Bit encoding / Last debounced flag bit for check DFC_InjVlv_DI_ScHsLs_2" UBYTE DFC_OneToOne 1 100 0.00 1.000 BIT_MASK 0x10 FORMAT "%5.3" ECU_ADDRESS 0x6003702F /end MEASUREMENT
/begin MEASUREMENT DFC_b.LDF_InjVlv_DI_ScHsLs_3 "Bit encoding / Last debounced flag bit for check DFC_InjVlv_DI_ScHsLs_3" UBYTE DFC_OneToOne 1 100 0.00 1.000 BIT_MASK 0x10 FORMAT "%5.3" ECU_ADDRESS 0x60037030 /end MEASUREMENT
/begin MEASUREMENT DFC_b.LDF_MfPsDiaOpenLoad1 "Bit encoding / Last debounced flag bit for check DFC_MfPsDiaOpenLoad1" UBYTE DFC_OneToOne 1 100 0.00 1.000 BIT_MASK 0x10 FORMAT "%5.3" ECU_ADDRESS 0x60037031 /end MEASUREMENT
/begin MEASUREMENT DFC_b.LDF_MfPsDiaScHiS1 "Bit encoding / Last debounced flag bit for check DFC_MfPsDiaScHiS1" UBYTE DFC_OneToOne 1 100 0.00 1.000 BIT_MASK 0x10 FORMAT "%5.3" ECU_ADDRESS 0x60037032 /end MEASUREMENT
/begin MEASUREMENT DFC_b.LDF_MfPsDiaScHiSLowS1 "Bit encoding / Last debounced flag bit for check DFC_MfPsDiaScHiSLowS1" UBYTE DFC_OneToOne 1 100 0.00 1.000 BIT_MASK 0x10 FORMAT "%5.3" ECU_ADDRESS 0x60037033 /end MEASUREMENT
/begin MEASUREMENT DFC_b.LDF_MfPsDiaScLowS1 "Bit encoding / Last debounced flag bit for check DFC_MfPsDiaScLowS1" UBYTE DFC_OneToOne 1 100 0.00 1.000 BIT_MASK 0x10 FORMAT "%5.3" ECU_ADDRESS 0x60037034 /end MEASUREMENT
/begin MEASUREMENT DFC_b.LDF_ACEvpTPhysRngHi "Bit encoding / Last debounced flag bit for check DFC_ACEvpTPhysRngHi" UBYTE DFC_OneToOne 1 100 0.00 1.000 BIT_MASK 0x10 FORMAT "%5.3" ECU_ADDRESS 0x60037035 /end MEASUREMENT
/begin MEASUREMENT DFC_b.LDF_ACEvpTPhysRngLo "Bit encoding / Last debounced flag bit for check DFC_ACEvpTPhysRngLo" UBYTE DFC_OneToOne 1 100 0.00 1.000 BIT_MASK 0x10 FORMAT "%5.3" ECU_ADDRESS 0x60037036 /end MEASUREMENT
/begin MEASUREMENT DFC_b.LDF_ACEvpTSRCMax "Bit encoding / Last debounced flag bit for check DFC_ACEvpTSRCMax" UBYTE DFC_OneToOne 1 100 0.00 1.000 BIT_MASK 0x10 FORMAT "%5.3" ECU_ADDRESS 0x60037037 /end MEASUREMENT
/begin MEASUREMENT DFC_b.LDF_ACEvpTSRCMin "Bit encoding / Last debounced flag bit for check DFC_ACEvpTSRCMin" UBYTE DFC_OneToOne 1 100 0.00 1.000 BIT_MASK 0x10 FORMAT "%5.3" ECU_ADDRESS 0x60037038 /end MEASUREMENT
/begin MEASUREMENT DFC_b.LDF_AfsRawSigRngHiB1 "Bit encoding / Last debounced flag bit for check DFC_AfsRawSigRngHiB1" UBYTE DFC_OneToOne 1 100 0.00 1.000 BIT_MASK 0x10 FORMAT "%5.3" ECU_ADDRESS 0x60037039 /end MEASUREMENT
/begin MEASUREMENT DFC_b.LDF_AfsRawSigRngLoB1 "Bit encoding / Last debounced flag bit for check DFC_AfsRawSigRngLoB1" UBYTE DFC_OneToOne 1 100 0.00 1.000 BIT_MASK 0x10 FORMAT "%5.3" ECU_ADDRESS 0x6003703A /end MEASUREMENT
/begin MEASUREMENT DFC_b.LDF_AfsSnsrErrB1 "Bit encoding / Last debounced flag bit for check DFC_AfsSnsrErrB1" UBYTE DFC_OneToOne 1 100 0.00 1.000 BIT_MASK 0x10 FORMAT "%5.3" ECU_ADDRESS 0x6003703B /end MEASUREMENT
/begin MEASUREMENT DFC_b.LDF_AirCClntPAnaSRCMax "Bit encoding / Last debounced flag bit for check DFC_AirCClntPAnaSRCMax" UBYTE DFC_OneToOne 1 100 0.00 1.000 BIT_MASK 0x10 FORMAT "%5.3" ECU_ADDRESS 0x6003703C /end MEASUREMENT
/begin MEASUREMENT DFC_b.LDF_AirCClntPAnaSRCMin "Bit encoding / Last debounced flag bit for check DFC_AirCClntPAnaSRCMin" UBYTE DFC_OneToOne 1 100 0.00 1.000 BIT_MASK 0x10 FORMAT "%5.3" ECU_ADDRESS 0x6003703D /end MEASUREMENT
/begin MEASUREMENT DFC_b.LDF_AirCSwtNpl "Bit encoding / Last debounced flag bit for check DFC_AirCSwtNpl" UBYTE DFC_OneToOne 1 100 0.00 1.000 BIT_MASK 0x10 FORMAT "%5.3" ECU_ADDRESS 0x6003703E /end MEASUREMENT
/begin MEASUREMENT DFC_b.LDF_AirCSwtSig "Bit encoding / Last debounced flag bit for check DFC_AirCSwtSig" UBYTE DFC_OneToOne 1 100 0.00 1.000 BIT_MASK 0x10 FORMAT "%5.3" ECU_ADDRESS 0x6003703F /end MEASUREMENT
/begin MEASUREMENT DFC_b.LDF_Brk "Bit encoding / Last debounced flag bit for check DFC_Brk" UBYTE DFC_OneToOne 1 100 0.00 1.000 BIT_MASK 0x10 FORMAT "%5.3" ECU_ADDRESS 0x60037040 /end MEASUREMENT
/begin MEASUREMENT DFC_b.LDF_BrkBstSensSCB "Bit encoding / Last debounced flag bit for check DFC_BrkBstSensSCB" UBYTE DFC_OneToOne 1 100 0.00 1.000 BIT_MASK 0x10 FORMAT "%5.3" ECU_ADDRESS 0x60037041 /end MEASUREMENT
/begin MEASUREMENT DFC_b.LDF_BrkBstSensSCG "Bit encoding / Last debounced flag bit for check DFC_BrkBstSensSCG" UBYTE DFC_OneToOne 1 100 0.00 1.000 BIT_MASK 0x10 FORMAT "%5.3" ECU_ADDRESS 0x60037042 /end MEASUREMENT
/begin MEASUREMENT DFC_b.LDF_BrkSig "Bit encoding / Last debounced flag bit for check DFC_BrkSig" UBYTE DFC_OneToOne 1 100 0.00 1.000 BIT_MASK 0x10 FORMAT "%5.3" ECU_ADDRESS 0x60037043 /end MEASUREMENT
/begin MEASUREMENT DFC_b.LDF_ClthSig "Bit encoding / Last debounced flag bit for check DFC_ClthSig" UBYTE DFC_OneToOne 1 100 0.00 1.000 BIT_MASK 0x10 FORMAT "%5.3" ECU_ADDRESS 0x60037044 /end MEASUREMENT
/begin MEASUREMENT DFC_b.LDF_EGRVlvCurrLim "Bit encoding / Last debounced flag bit for check DFC_EGRVlvCurrLim" UBYTE DFC_OneToOne 1 100 0.00 1.000 BIT_MASK 0x10 FORMAT "%5.3" ECU_ADDRESS 0x60037045 /end MEASUREMENT
/begin MEASUREMENT DFC_b.LDF_EGRVlvOL "Bit encoding / Last debounced flag bit for check DFC_EGRVlvOL" UBYTE DFC_OneToOne 1 100 0.00 1.000 BIT_MASK 0x10 FORMAT "%5.3" ECU_ADDRESS 0x60037046 /end MEASUREMENT
/begin MEASUREMENT DFC_b.LDF_EGRVlvOvrTemp "Bit encoding / Last debounced flag bit for check DFC_EGRVlvOvrTemp" UBYTE DFC_OneToOne 1 100 0.00 1.000 BIT_MASK 0x10 FORMAT "%5.3" ECU_ADDRESS 0x60037047 /end MEASUREMENT
/begin MEASUREMENT DFC_b.LDF_EGRVlvSCB "Bit encoding / Last debounced flag bit for check DFC_EGRVlvSCB" UBYTE DFC_OneToOne 1 100 0.00 1.000 BIT_MASK 0x10 FORMAT "%5.3" ECU_ADDRESS 0x60037048 /end MEASUREMENT
/begin MEASUREMENT DFC_b.LDF_EGRVlvSCG "Bit encoding / Last debounced flag bit for check DFC_EGRVlvSCG" UBYTE DFC_OneToOne 1 100 0.00 1.000 BIT_MASK 0x10 FORMAT "%5.3" ECU_ADDRESS 0x60037049 /end MEASUREMENT
/begin MEASUREMENT DFC_b.LDF_EGRVlvSRCMax "Bit encoding / Last debounced flag bit for check DFC_EGRVlvSRCMax" UBYTE DFC_OneToOne 1 100 0.00 1.000 BIT_MASK 0x10 FORMAT "%5.3" ECU_ADDRESS 0x6003704A /end MEASUREMENT
/begin MEASUREMENT DFC_b.LDF_EGRVlvSRCMin "Bit encoding / Last debounced flag bit for check DFC_EGRVlvSRCMin" UBYTE DFC_OneToOne 1 100 0.00 1.000 BIT_MASK 0x10 FORMAT "%5.3" ECU_ADDRESS 0x6003704B /end MEASUREMENT
/begin MEASUREMENT DFC_b.LDF_HLSDemOvhtEngLim "Bit encoding / Last debounced flag bit for check DFC_HLSDemOvhtEngLim" UBYTE DFC_OneToOne 1 100 0.00 1.000 BIT_MASK 0x10 FORMAT "%5.3" ECU_ADDRESS 0x6003704C /end MEASUREMENT
/begin MEASUREMENT DFC_b.LDF_OilPSwmpSRCMax "Bit encoding / Last debounced flag bit for check DFC_OilPSwmpSRCMax" UBYTE DFC_OneToOne 1 100 0.00 1.000 BIT_MASK 0x10 FORMAT "%5.3" ECU_ADDRESS 0x6003704D /end MEASUREMENT
/begin MEASUREMENT DFC_b.LDF_OilPSwmpSRCMin "Bit encoding / Last debounced flag bit for check DFC_OilPSwmpSRCMin" UBYTE DFC_OneToOne 1 100 0.00 1.000 BIT_MASK 0x10 FORMAT "%5.3" ECU_ADDRESS 0x6003704E /end MEASUREMENT
/begin MEASUREMENT DFC_b.LDF_PIntkVUsLineHiB1 "Bit encoding / Last debounced flag bit for check DFC_PIntkVUsLineHiB1" UBYTE DFC_OneToOne 1 100 0.00 1.000 BIT_MASK 0x10 FORMAT "%5.3" ECU_ADDRESS 0x6003704F /end MEASUREMENT
/begin MEASUREMENT DFC_b.LDF_PIntkVUsLineLoB1 "Bit encoding / Last debounced flag bit for check DFC_PIntkVUsLineLoB1" UBYTE DFC_OneToOne 1 100 0.00 1.000 BIT_MASK 0x10 FORMAT "%5.3" ECU_ADDRESS 0x60037050 /end MEASUREMENT
/begin MEASUREMENT DFC_b.LDF_VehVPhysRngLo "Bit encoding / Last debounced flag bit for check DFC_VehVPhysRngLo" UBYTE DFC_OneToOne 1 100 0.00 1.000 BIT_MASK 0x10 FORMAT "%5.3" ECU_ADDRESS 0x60037051 /end MEASUREMENT
/begin MEASUREMENT DFC_b.LDF_VehVSigCan "Bit encoding / Last debounced flag bit for check DFC_VehVSigCan" UBYTE DFC_OneToOne 1 100 0.00 1.000 BIT_MASK 0x10 FORMAT "%5.3" ECU_ADDRESS 0x60037052 /end MEASUREMENT
/begin MEASUREMENT DFC_b.LDF_VehVSigCanSafe "Bit encoding / Last debounced flag bit for check DFC_VehVSigCanSafe" UBYTE DFC_OneToOne 1 100 0.00 1.000 BIT_MASK 0x10 FORMAT "%5.3" ECU_ADDRESS 0x60037053 /end MEASUREMENT
/begin MEASUREMENT DFC_b.LDF_VlvLftFbOilPSnsrIntk11SRCMax "Bit encoding / Last debounced flag bit for check DFC_VlvLftFbOilPSnsrIntk11SRCMax" UBYTE DFC_OneToOne 1 100 0.00 1.000 BIT_MASK 0x10 FORMAT "%5.3" ECU_ADDRESS 0x60037054 /end MEASUREMENT
/begin MEASUREMENT DFC_b.LDF_VlvLftFbOilPSnsrIntk11SRCMin "Bit encoding / Last debounced flag bit for check DFC_VlvLftFbOilPSnsrIntk11SRCMin" UBYTE DFC_OneToOne 1 100 0.00 1.000 BIT_MASK 0x10 FORMAT "%5.3" ECU_ADDRESS 0x60037055 /end MEASUREMENT
/begin MEASUREMENT DFC_b.LDF_ClthNpl "Bit encoding / Last debounced flag bit for check DFC_ClthNpl" UBYTE DFC_OneToOne 1 100 0.00 1.000 BIT_MASK 0x10 FORMAT "%5.3" ECU_ADDRESS 0x60037056 /end MEASUREMENT
/begin MEASUREMENT DFC_b.LDF_GbxPNPosnDrvCdn "Bit encoding / Last debounced flag bit for check DFC_GbxPNPosnDrvCdn" UBYTE DFC_OneToOne 1 100 0.00 1.000 BIT_MASK 0x10 FORMAT "%5.3" ECU_ADDRESS 0x60037057 /end MEASUREMENT
/begin MEASUREMENT DFC_b.LDF_GbxPNPosnPlausy "Bit encoding / Last debounced flag bit for check DFC_GbxPNPosnPlausy" UBYTE DFC_OneToOne 1 100 0.00 1.000 BIT_MASK 0x10 FORMAT "%5.3" ECU_ADDRESS 0x60037058 /end MEASUREMENT
/begin MEASUREMENT DFC_b.LDF_AfsSigErrLineHiB1 "Bit encoding / Last debounced flag bit for check DFC_AfsSigErrLineHiB1" UBYTE DFC_OneToOne 1 100 0.00 1.000 BIT_MASK 0x10 FORMAT "%5.3" ECU_ADDRESS 0x60037059 /end MEASUREMENT
/begin MEASUREMENT DFC_b.LDF_AfsSigErrLineLoB1 "Bit encoding / Last debounced flag bit for check DFC_AfsSigErrLineLoB1" UBYTE DFC_OneToOne 1 100 0.00 1.000 BIT_MASK 0x10 FORMAT "%5.3" ECU_ADDRESS 0x6003705A /end MEASUREMENT
/begin MEASUREMENT DFC_b.LDF_PEnvCcMax "Bit encoding / Last debounced flag bit for check DFC_PEnvCcMax" UBYTE DFC_OneToOne 1 100 0.00 1.000 BIT_MASK 0x10 FORMAT "%5.3" ECU_ADDRESS 0x6003705B /end MEASUREMENT
/begin MEASUREMENT DFC_b.LDF_PEnvCcMin "Bit encoding / Last debounced flag bit for check DFC_PEnvCcMin" UBYTE DFC_OneToOne 1 100 0.00 1.000 BIT_MASK 0x10 FORMAT "%5.3" ECU_ADDRESS 0x6003705C /end MEASUREMENT
/begin MEASUREMENT DFC_b.LDF_PEnvRngChkMax "Bit encoding / Last debounced flag bit for check DFC_PEnvRngChkMax" UBYTE DFC_OneToOne 1 100 0.00 1.000 BIT_MASK 0x10 FORMAT "%5.3" ECU_ADDRESS 0x6003705D /end MEASUREMENT
/begin MEASUREMENT DFC_b.LDF_PEnvRngChkMin "Bit encoding / Last debounced flag bit for check DFC_PEnvRngChkMin" UBYTE DFC_OneToOne 1 100 0.00 1.000 BIT_MASK 0x10 FORMAT "%5.3" ECU_ADDRESS 0x6003705E /end MEASUREMENT
/begin MEASUREMENT DFC_b.LDF_PEnvSnsrPlaus "Bit encoding / Last debounced flag bit for check DFC_PEnvSnsrPlaus" UBYTE DFC_OneToOne 1 100 0.00 1.000 BIT_MASK 0x10 FORMAT "%5.3" ECU_ADDRESS 0x6003705F /end MEASUREMENT
/begin MEASUREMENT DFC_b.LDF_UEGOHeatrRlyPsOLS1B1 "Bit encoding / Last debounced flag bit for check DFC_UEGOHeatrRlyPsOLS1B1" UBYTE DFC_OneToOne 1 100 0.00 1.000 BIT_MASK 0x10 FORMAT "%5.3" ECU_ADDRESS 0x60037060 /end MEASUREMENT
/begin MEASUREMENT DFC_b.LDF_UEGOHeatrRlyPsSCBS1B1 "Bit encoding / Last debounced flag bit for check DFC_UEGOHeatrRlyPsSCBS1B1" UBYTE DFC_OneToOne 1 100 0.00 1.000 BIT_MASK 0x10 FORMAT "%5.3" ECU_ADDRESS 0x60037061 /end MEASUREMENT
/begin MEASUREMENT DFC_b.LDF_UEGOHeatrRlyPsSCGS1B1 "Bit encoding / Last debounced flag bit for check DFC_UEGOHeatrRlyPsSCGS1B1" UBYTE DFC_OneToOne 1 100 0.00 1.000 BIT_MASK 0x10 FORMAT "%5.3" ECU_ADDRESS 0x60037062 /end MEASUREMENT
/begin MEASUREMENT DFC_b.LDF_UegoHeatrWireOlS1B1 "Bit encoding / Last debounced flag bit for check DFC_UegoHeatrWireOlS1B1" UBYTE DFC_OneToOne 1 100 0.00 1.000 BIT_MASK 0x10 FORMAT "%5.3" ECU_ADDRESS 0x60037063 /end MEASUREMENT
/begin MEASUREMENT DFC_b.LDF_UegoHeatrWireScbS1B1 "Bit encoding / Last debounced flag bit for check DFC_UegoHeatrWireScbS1B1" UBYTE DFC_OneToOne 1 100 0.00 1.000 BIT_MASK 0x10 FORMAT "%5.3" ECU_ADDRESS 0x60037064 /end MEASUREMENT
/begin MEASUREMENT DFC_b.LDF_UegoHeatrWireScgS1B1 "Bit encoding / Last debounced flag bit for check DFC_UegoHeatrWireScgS1B1" UBYTE DFC_OneToOne 1 100 0.00 1.000 BIT_MASK 0x10 FORMAT "%5.3" ECU_ADDRESS 0x60037065 /end MEASUREMENT
/begin MEASUREMENT DFC_b.LDF_KnDetSens1PortAMax "Bit encoding / Last debounced flag bit for check DFC_KnDetSens1PortAMax" UBYTE DFC_OneToOne 1 100 0.00 1.000 BIT_MASK 0x10 FORMAT "%5.3" ECU_ADDRESS 0x60037066 /end MEASUREMENT
/begin MEASUREMENT DFC_b.LDF_KnDetSens1PortAMin "Bit encoding / Last debounced flag bit for check DFC_KnDetSens1PortAMin" UBYTE DFC_OneToOne 1 100 0.00 1.000 BIT_MASK 0x10 FORMAT "%5.3" ECU_ADDRESS 0x60037067 /end MEASUREMENT
/begin MEASUREMENT DFC_b.LDF_KnDetSens1PortBMax "Bit encoding / Last debounced flag bit for check DFC_KnDetSens1PortBMax" UBYTE DFC_OneToOne 1 100 0.00 1.000 BIT_MASK 0x10 FORMAT "%5.3" ECU_ADDRESS 0x60037068 /end MEASUREMENT
/begin MEASUREMENT DFC_b.LDF_KnDetSens1PortBMin "Bit encoding / Last debounced flag bit for check DFC_KnDetSens1PortBMin" UBYTE DFC_OneToOne 1 100 0.00 1.000 BIT_MASK 0x10 FORMAT "%5.3" ECU_ADDRESS 0x60037069 /end MEASUREMENT
/begin MEASUREMENT DFC_b.LDF_Clth2ONStuck "Bit encoding / Last debounced flag bit for check DFC_Clth2ONStuck" UBYTE DFC_OneToOne 1 100 0.00 1.000 BIT_MASK 0x10 FORMAT "%5.3" ECU_ADDRESS 0x6003706A /end MEASUREMENT
/begin MEASUREMENT DFC_b.LDF_Clth2ONStuckLdc "Bit encoding / Last debounced flag bit for check DFC_Clth2ONStuckLdc" UBYTE DFC_OneToOne 1 100 0.00 1.000 BIT_MASK 0x10 FORMAT "%5.3" ECU_ADDRESS 0x6003706B /end MEASUREMENT
/begin MEASUREMENT DFC_b.LDF_Clth3ONStuckLdc "Bit encoding / Last debounced flag bit for check DFC_Clth3ONStuckLdc" UBYTE DFC_OneToOne 1 100 0.00 1.000 BIT_MASK 0x10 FORMAT "%5.3" ECU_ADDRESS 0x6003706C /end MEASUREMENT
/begin MEASUREMENT DFC_b.LDF_Clth3ONStuckPostDrv "Bit encoding / Last debounced flag bit for check DFC_Clth3ONStuckPostDrv" UBYTE DFC_OneToOne 1 100 0.00 1.000 BIT_MASK 0x10 FORMAT "%5.3" ECU_ADDRESS 0x6003706D /end MEASUREMENT
/begin MEASUREMENT DFC_b.LDF_Clth4ONStuck "Bit encoding / Last debounced flag bit for check DFC_Clth4ONStuck" UBYTE DFC_OneToOne 1 100 0.00 1.000 BIT_MASK 0x10 FORMAT "%5.3" ECU_ADDRESS 0x6003706E /end MEASUREMENT
/begin MEASUREMENT DFC_b.LDF_Clth4ONStuckLdc "Bit encoding / Last debounced flag bit for check DFC_Clth4ONStuckLdc" UBYTE DFC_OneToOne 1 100 0.00 1.000 BIT_MASK 0x10 FORMAT "%5.3" ECU_ADDRESS 0x6003706F /end MEASUREMENT
/begin MEASUREMENT DFC_b.LDF_ComBCMUnit "Bit encoding / Last debounced flag bit for check DFC_ComBCMUnit" UBYTE DFC_OneToOne 1 100 0.00 1.000 BIT_MASK 0x10 FORMAT "%5.3" ECU_ADDRESS 0x60037070 /end MEASUREMENT
/begin MEASUREMENT DFC_b.LDF_ComDLCTCU01 "Bit encoding / Last debounced flag bit for check DFC_ComDLCTCU01" UBYTE DFC_OneToOne 1 100 0.00 1.000 BIT_MASK 0x10 FORMAT "%5.3" ECU_ADDRESS 0x60037071 /end MEASUREMENT
/begin MEASUREMENT DFC_b.LDF_ComDLCTCU02 "Bit encoding / Last debounced flag bit for check DFC_ComDLCTCU02" UBYTE DFC_OneToOne 1 100 0.00 1.000 BIT_MASK 0x10 FORMAT "%5.3" ECU_ADDRESS 0x60037072 /end MEASUREMENT
/begin MEASUREMENT DFC_b.LDF_ComDLCTCU1 "Bit encoding / Last debounced flag bit for check DFC_ComDLCTCU1" UBYTE DFC_OneToOne 1 100 0.00 1.000 BIT_MASK 0x10 FORMAT "%5.3" ECU_ADDRESS 0x60037073 /end MEASUREMENT
/begin MEASUREMENT DFC_b.LDF_ComDLCTCU11 "Bit encoding / Last debounced flag bit for check DFC_ComDLCTCU11" UBYTE DFC_OneToOne 1 100 0.00 1.000 BIT_MASK 0x10 FORMAT "%5.3" ECU_ADDRESS 0x60037074 /end MEASUREMENT
/begin MEASUREMENT DFC_b.LDF_ComDLCTCU12 "Bit encoding / Last debounced flag bit for check DFC_ComDLCTCU12" UBYTE DFC_OneToOne 1 100 0.00 1.000 BIT_MASK 0x10 FORMAT "%5.3" ECU_ADDRESS 0x60037075 /end MEASUREMENT
/begin MEASUREMENT DFC_b.LDF_ComDLCTCU13 "Bit encoding / Last debounced flag bit for check DFC_ComDLCTCU13" UBYTE DFC_OneToOne 1 100 0.00 1.000 BIT_MASK 0x10 FORMAT "%5.3" ECU_ADDRESS 0x60037076 /end MEASUREMENT
/begin MEASUREMENT DFC_b.LDF_ComDLCTCU14 "Bit encoding / Last debounced flag bit for check DFC_ComDLCTCU14" UBYTE DFC_OneToOne 1 100 0.00 1.000 BIT_MASK 0x10 FORMAT "%5.3" ECU_ADDRESS 0x60037077 /end MEASUREMENT
/begin MEASUREMENT DFC_b.LDF_ComDLCTCU2 "Bit encoding / Last debounced flag bit for check DFC_ComDLCTCU2" UBYTE DFC_OneToOne 1 100 0.00 1.000 BIT_MASK 0x10 FORMAT "%5.3" ECU_ADDRESS 0x60037078 /end MEASUREMENT
/begin MEASUREMENT DFC_b.LDF_ComDLCTCU3 "Bit encoding / Last debounced flag bit for check DFC_ComDLCTCU3" UBYTE DFC_OneToOne 1 100 0.00 1.000 BIT_MASK 0x10 FORMAT "%5.3" ECU_ADDRESS 0x60037079 /end MEASUREMENT
/begin MEASUREMENT DFC_b.LDF_ComDLCTCU4 "Bit encoding / Last debounced flag bit for check DFC_ComDLCTCU4" UBYTE DFC_OneToOne 1 100 0.00 1.000 BIT_MASK 0x10 FORMAT "%5.3" ECU_ADDRESS 0x6003707A /end MEASUREMENT
/begin MEASUREMENT DFC_b.LDF_ComEPSUnit "Bit encoding / Last debounced flag bit for check DFC_ComEPSUnit" UBYTE DFC_OneToOne 1 100 0.00 1.000 BIT_MASK 0x10 FORMAT "%5.3" ECU_ADDRESS 0x6003707B /end MEASUREMENT
/begin MEASUREMENT DFC_b.LDF_ComIDASBUnit "Bit encoding / Last debounced flag bit for check DFC_ComIDASBUnit" UBYTE DFC_OneToOne 1 100 0.00 1.000 BIT_MASK 0x10 FORMAT "%5.3" ECU_ADDRESS 0x6003707C /end MEASUREMENT
/begin MEASUREMENT DFC_b.LDF_ComIMGUnit "Bit encoding / Last debounced flag bit for check DFC_ComIMGUnit" UBYTE DFC_OneToOne 1 100 0.00 1.000 BIT_MASK 0x10 FORMAT "%5.3" ECU_ADDRESS 0x6003707D /end MEASUREMENT
/begin MEASUREMENT DFC_b.LDF_ComMETUnit "Bit encoding / Last debounced flag bit for check DFC_ComMETUnit" UBYTE DFC_OneToOne 1 100 0.00 1.000 BIT_MASK 0x10 FORMAT "%5.3" ECU_ADDRESS 0x6003707E /end MEASUREMENT
/begin MEASUREMENT DFC_b.LDF_ComSRSUnit "Bit encoding / Last debounced flag bit for check DFC_ComSRSUnit" UBYTE DFC_OneToOne 1 100 0.00 1.000 BIT_MASK 0x10 FORMAT "%5.3" ECU_ADDRESS 0x6003707F /end MEASUREMENT
/begin MEASUREMENT DFC_b.LDF_ComVSAUnit "Bit encoding / Last debounced flag bit for check DFC_ComVSAUnit" UBYTE DFC_OneToOne 1 100 0.00 1.000 BIT_MASK 0x10 FORMAT "%5.3" ECU_ADDRESS 0x60037080 /end MEASUREMENT
/begin MEASUREMENT DFC_b.LDF_EbsSocFlt "Bit encoding / Last debounced flag bit for check DFC_EbsSocFlt" UBYTE DFC_OneToOne 1 100 0.00 1.000 BIT_MASK 0x10 FORMAT "%5.3" ECU_ADDRESS 0x60037081 /end MEASUREMENT
/begin MEASUREMENT DFC_b.LDF_I14229VINErr "Bit encoding / Last debounced flag bit for check DFC_I14229VINErr" UBYTE DFC_OneToOne 1 100 0.00 1.000 BIT_MASK 0x10 FORMAT "%5.3" ECU_ADDRESS 0x60037082 /end MEASUREMENT
/begin MEASUREMENT DFC_b.LDF_InjCatHeatgErr "Bit encoding / Last debounced flag bit for check DFC_InjCatHeatgErr" UBYTE DFC_OneToOne 1 100 0.00 1.000 BIT_MASK 0x10 FORMAT "%5.3" ECU_ADDRESS 0x60037083 /end MEASUREMENT
/begin MEASUREMENT DFC_b.LDF_InjSysMulInjDiagErr "Bit encoding / Last debounced flag bit for check DFC_InjSysMulInjDiagErr" UBYTE DFC_OneToOne 1 100 0.00 1.000 BIT_MASK 0x10 FORMAT "%5.3" ECU_ADDRESS 0x60037084 /end MEASUREMENT
/begin MEASUREMENT DFC_b.LDF_LLRHmax "Bit encoding / Last debounced flag bit for check DFC_LLRHmax" UBYTE DFC_OneToOne 1 100 0.00 1.000 BIT_MASK 0x10 FORMAT "%5.3" ECU_ADDRESS 0x60037085 /end MEASUREMENT
/begin MEASUREMENT DFC_b.LDF_LLRHmin "Bit encoding / Last debounced flag bit for check DFC_LLRHmin" UBYTE DFC_OneToOne 1 100 0.00 1.000 BIT_MASK 0x10 FORMAT "%5.3" ECU_ADDRESS 0x60037086 /end MEASUREMENT
/begin MEASUREMENT DFC_b.LDF_LLRHnpl "Bit encoding / Last debounced flag bit for check DFC_LLRHnpl" UBYTE DFC_OneToOne 1 100 0.00 1.000 BIT_MASK 0x10 FORMAT "%5.3" ECU_ADDRESS 0x60037087 /end MEASUREMENT
/begin MEASUREMENT DFC_b.LDF_LLRKHmax "Bit encoding / Last debounced flag bit for check DFC_LLRKHmax" UBYTE DFC_OneToOne 1 100 0.00 1.000 BIT_MASK 0x10 FORMAT "%5.3" ECU_ADDRESS 0x60037088 /end MEASUREMENT
/begin MEASUREMENT DFC_b.LDF_LLRKHmin "Bit encoding / Last debounced flag bit for check DFC_LLRKHmin" UBYTE DFC_OneToOne 1 100 0.00 1.000 BIT_MASK 0x10 FORMAT "%5.3" ECU_ADDRESS 0x60037089 /end MEASUREMENT
/begin MEASUREMENT DFC_b.LDF_LLRKHnpl "Bit encoding / Last debounced flag bit for check DFC_LLRKHnpl" UBYTE DFC_OneToOne 1 100 0.00 1.000 BIT_MASK 0x10 FORMAT "%5.3" ECU_ADDRESS 0x6003708A /end MEASUREMENT
/begin MEASUREMENT DFC_b.LDF_LinACGUnit "Bit encoding / Last debounced flag bit for check DFC_LinACGUnit" UBYTE DFC_OneToOne 1 100 0.00 1.000 BIT_MASK 0x10 FORMAT "%5.3" ECU_ADDRESS 0x6003708B /end MEASUREMENT
/begin MEASUREMENT DFC_b.LDF_LinAEVUnit "Bit encoding / Last debounced flag bit for check DFC_LinAEVUnit" UBYTE DFC_OneToOne 1 100 0.00 1.000 BIT_MASK 0x10 FORMAT "%5.3" ECU_ADDRESS 0x6003708C /end MEASUREMENT
/begin MEASUREMENT DFC_b.LDF_LinEBSUnit "Bit encoding / Last debounced flag bit for check DFC_LinEBSUnit" UBYTE DFC_OneToOne 1 100 0.00 1.000 BIT_MASK 0x10 FORMAT "%5.3" ECU_ADDRESS 0x6003708D /end MEASUREMENT
/begin MEASUREMENT DFC_b.LDF_RoughRoad "Bit encoding / Last debounced flag bit for check DFC_RoughRoad" UBYTE DFC_OneToOne 1 100 0.00 1.000 BIT_MASK 0x10 FORMAT "%5.3" ECU_ADDRESS 0x6003708E /end MEASUREMENT
/begin MEASUREMENT DFC_b.LDF_SiaEEPRdErr "Bit encoding / Last debounced flag bit for check DFC_SiaEEPRdErr" UBYTE DFC_OneToOne 1 100 0.00 1.000 BIT_MASK 0x10 FORMAT "%5.3" ECU_ADDRESS 0x6003708F /end MEASUREMENT
/begin MEASUREMENT DFC_b.LDF_SiaEEPWrngCod "Bit encoding / Last debounced flag bit for check DFC_SiaEEPWrngCod" UBYTE DFC_OneToOne 1 100 0.00 1.000 BIT_MASK 0x10 FORMAT "%5.3" ECU_ADDRESS 0x60037090 /end MEASUREMENT
/begin MEASUREMENT DFC_b.LDF_UegoHeatrStrtS1B1 "Bit encoding / Last debounced flag bit for check DFC_UegoHeatrStrtS1B1" UBYTE DFC_OneToOne 1 100 0.00 1.000 BIT_MASK 0x10 FORMAT "%5.3" ECU_ADDRESS 0x60037091 /end MEASUREMENT
/begin MEASUREMENT DFC_b.LDF_BusDiagCANAPPLBusOff "Bit encoding / Last debounced flag bit for check DFC_BusDiagCANAPPLBusOff" UBYTE DFC_OneToOne 1 100 0.00 1.000 BIT_MASK 0x10 FORMAT "%5.3" ECU_ADDRESS 0x60037092 /end MEASUREMENT
/begin MEASUREMENT DFC_b.LDF_BusDiagCANCANCBusOff "Bit encoding / Last debounced flag bit for check DFC_BusDiagCANCANCBusOff" UBYTE DFC_OneToOne 1 100 0.00 1.000 BIT_MASK 0x10 FORMAT "%5.3" ECU_ADDRESS 0x60037093 /end MEASUREMENT
/begin MEASUREMENT DFC_b.LDF_BusDiagCANVEHICLEBusOff "Bit encoding / Last debounced flag bit for check DFC_BusDiagCANVEHICLEBusOff" UBYTE DFC_OneToOne 1 100 0.00 1.000 BIT_MASK 0x10 FORMAT "%5.3" ECU_ADDRESS 0x60037094 /end MEASUREMENT
/begin MEASUREMENT DFC_b.LDF_RBA_IODIAGPWR_rba_IoExtCy329_SignalVltSply_0 "Bit encoding / Last debounced flag bit for check DFC_RBA_IODIAGPWR_rba_IoExtCy329_SignalVltSply_0" UBYTE DFC_OneToOne 1 100 0.00 1.000 BIT_MASK 0x10 FORMAT "%5.3" ECU_ADDRESS 0x60037095 /end MEASUREMENT
/begin MEASUREMENT DFC_b.LDF_RBA_IODIAGPWR_rba_IoExtCy329_SignalVltSply_0OT "Bit encoding / Last debounced flag bit for check DFC_RBA_IODIAGPWR_rba_IoExtCy329_SignalVltSply_0OT" UBYTE DFC_OneToOne 1 100 0.00 1.000 BIT_MASK 0x10 FORMAT "%5.3" ECU_ADDRESS 0x60037096 /end MEASUREMENT
/begin MEASUREMENT DFC_b.LDF_RBA_IODIAGPWR_rba_IoExtCy329_SignalVltSply_0OV "Bit encoding / Last debounced flag bit for check DFC_RBA_IODIAGPWR_rba_IoExtCy329_SignalVltSply_0OV" UBYTE DFC_OneToOne 1 100 0.00 1.000 BIT_MASK 0x10 FORMAT "%5.3" ECU_ADDRESS 0x60037097 /end MEASUREMENT
/begin MEASUREMENT DFC_b.LDF_RBA_IODIAGPWR_rba_IoExtCy329_SignalVltSply_0SCG "Bit encoding / Last debounced flag bit for check DFC_RBA_IODIAGPWR_rba_IoExtCy329_SignalVltSply_0SCG" UBYTE DFC_OneToOne 1 100 0.00 1.000 BIT_MASK 0x10 FORMAT "%5.3" ECU_ADDRESS 0x60037098 /end MEASUREMENT
/begin MEASUREMENT DFC_b.LDF_RBA_IODIAGPWR_rba_IoExtCy329_SignalVltSply_0UV "Bit encoding / Last debounced flag bit for check DFC_RBA_IODIAGPWR_rba_IoExtCy329_SignalVltSply_0UV" UBYTE DFC_OneToOne 1 100 0.00 1.000 BIT_MASK 0x10 FORMAT "%5.3" ECU_ADDRESS 0x60037099 /end MEASUREMENT
/begin MEASUREMENT DFC_b.LDF_RBA_IODIAGPWR_rba_IoExtCy329_SignalVltSply_1 "Bit encoding / Last debounced flag bit for check DFC_RBA_IODIAGPWR_rba_IoExtCy329_SignalVltSply_1" UBYTE DFC_OneToOne 1 100 0.00 1.000 BIT_MASK 0x10 FORMAT "%5.3" ECU_ADDRESS 0x6003709A /end MEASUREMENT
/begin MEASUREMENT DFC_b.LDF_RBA_IODIAGPWR_rba_IoExtCy329_SignalVltSply_1OT "Bit encoding / Last debounced flag bit for check DFC_RBA_IODIAGPWR_rba_IoExtCy329_SignalVltSply_1OT" UBYTE DFC_OneToOne 1 100 0.00 1.000 BIT_MASK 0x10 FORMAT "%5.3" ECU_ADDRESS 0x6003709B /end MEASUREMENT
/begin MEASUREMENT DFC_b.LDF_RBA_IODIAGPWR_rba_IoExtCy329_SignalVltSply_1OV "Bit encoding / Last debounced flag bit for check DFC_RBA_IODIAGPWR_rba_IoExtCy329_SignalVltSply_1OV" UBYTE DFC_OneToOne 1 100 0.00 1.000 BIT_MASK 0x10 FORMAT "%5.3" ECU_ADDRESS 0x6003709C /end MEASUREMENT
/begin MEASUREMENT DFC_b.LDF_RBA_IODIAGPWR_rba_IoExtCy329_SignalVltSply_1SCG "Bit encoding / Last debounced flag bit for check DFC_RBA_IODIAGPWR_rba_IoExtCy329_SignalVltSply_1SCG" UBYTE DFC_OneToOne 1 100 0.00 1.000 BIT_MASK 0x10 FORMAT "%5.3" ECU_ADDRESS 0x6003709D /end MEASUREMENT
/begin MEASUREMENT DFC_b.LDF_RBA_IODIAGPWR_rba_IoExtCy329_SignalVltSply_1UV "Bit encoding / Last debounced flag bit for check DFC_RBA_IODIAGPWR_rba_IoExtCy329_SignalVltSply_1UV" UBYTE DFC_OneToOne 1 100 0.00 1.000 BIT_MASK 0x10 FORMAT "%5.3" ECU_ADDRESS 0x6003709E /end MEASUREMENT
/begin MEASUREMENT DFC_b.LDF_RBA_IODIAGPWR_rba_IoExtCy329_SignalVltSply_2 "Bit encoding / Last debounced flag bit for check DFC_RBA_IODIAGPWR_rba_IoExtCy329_SignalVltSply_2" UBYTE DFC_OneToOne 1 100 0.00 1.000 BIT_MASK 0x10 FORMAT "%5.3" ECU_ADDRESS 0x6003709F /end MEASUREMENT
/begin MEASUREMENT DFC_b.LDF_RBA_IODIAGPWR_rba_IoExtCy329_SignalVltSply_2OT "Bit encoding / Last debounced flag bit for check DFC_RBA_IODIAGPWR_rba_IoExtCy329_SignalVltSply_2OT" UBYTE DFC_OneToOne 1 100 0.00 1.000 BIT_MASK 0x10 FORMAT "%5.3" ECU_ADDRESS 0x600370A0 /end MEASUREMENT
/begin MEASUREMENT DFC_b.LDF_RBA_IODIAGPWR_rba_IoExtCy329_SignalVltSply_2OV "Bit encoding / Last debounced flag bit for check DFC_RBA_IODIAGPWR_rba_IoExtCy329_SignalVltSply_2OV" UBYTE DFC_OneToOne 1 100 0.00 1.000 BIT_MASK 0x10 FORMAT "%5.3" ECU_ADDRESS 0x600370A1 /end MEASUREMENT
/begin MEASUREMENT DFC_b.LDF_RBA_IODIAGPWR_rba_IoExtCy329_SignalVltSply_2SCG "Bit encoding / Last debounced flag bit for check DFC_RBA_IODIAGPWR_rba_IoExtCy329_SignalVltSply_2SCG" UBYTE DFC_OneToOne 1 100 0.00 1.000 BIT_MASK 0x10 FORMAT "%5.3" ECU_ADDRESS 0x600370A2 /end MEASUREMENT
/begin MEASUREMENT DFC_b.LDF_RBA_IODIAGPWR_rba_IoExtCy329_SignalVltSply_2UV "Bit encoding / Last debounced flag bit for check DFC_RBA_IODIAGPWR_rba_IoExtCy329_SignalVltSply_2UV" UBYTE DFC_OneToOne 1 100 0.00 1.000 BIT_MASK 0x10 FORMAT "%5.3" ECU_ADDRESS 0x600370A3 /end MEASUREMENT
/begin MEASUREMENT DFC_b.LDF_CAN_E_TIMEOUT "Bit encoding / Last debounced flag bit for check DFC_CAN_E_TIMEOUT" UBYTE DFC_OneToOne 1 100 0.00 1.000 BIT_MASK 0x10 FORMAT "%5.3" ECU_ADDRESS 0x600370A4 /end MEASUREMENT
/begin MEASUREMENT DFC_b.LDF_LIN_E_TIMEOUT "Bit encoding / Last debounced flag bit for check DFC_LIN_E_TIMEOUT" UBYTE DFC_OneToOne 1 100 0.00 1.000 BIT_MASK 0x10 FORMAT "%5.3" ECU_ADDRESS 0x600370A5 /end MEASUREMENT
/begin MEASUREMENT DFC_b.LDF_MRlyOL "Bit encoding / Last debounced flag bit for check DFC_MRlyOL" UBYTE DFC_OneToOne 1 100 0.00 1.000 BIT_MASK 0x10 FORMAT "%5.3" ECU_ADDRESS 0x600370A6 /end MEASUREMENT
/begin MEASUREMENT DFC_b.LDF_MRlySCB "Bit encoding / Last debounced flag bit for check DFC_MRlySCB" UBYTE DFC_OneToOne 1 100 0.00 1.000 BIT_MASK 0x10 FORMAT "%5.3" ECU_ADDRESS 0x600370A7 /end MEASUREMENT
/begin MEASUREMENT DFC_b.LDF_MRlySCG "Bit encoding / Last debounced flag bit for check DFC_MRlySCG" UBYTE DFC_OneToOne 1 100 0.00 1.000 BIT_MASK 0x10 FORMAT "%5.3" ECU_ADDRESS 0x600370A8 /end MEASUREMENT
/begin MEASUREMENT DFC_b.LDF_rba_MultiStackTrace_Threshold "Bit encoding / Last debounced flag bit for check DFC_rba_MultiStackTrace_Threshold" UBYTE DFC_OneToOne 1 100 0.00 1.000 BIT_MASK 0x10 FORMAT "%5.3" ECU_ADDRESS 0x600370A9 /end MEASUREMENT
/begin MEASUREMENT DFC_b.LDF_BSWM_E_ACTION_FAILED "Bit encoding / Last debounced flag bit for check DFC_BSWM_E_ACTION_FAILED" UBYTE DFC_OneToOne 1 100 0.00 1.000 BIT_MASK 0x10 FORMAT "%5.3" ECU_ADDRESS 0x600370AA /end MEASUREMENT
/begin MEASUREMENT DFC_b.LDF_BSWM_E_INTRPTQUEUE_FULL "Bit encoding / Last debounced flag bit for check DFC_BSWM_E_INTRPTQUEUE_FULL" UBYTE DFC_OneToOne 1 100 0.00 1.000 BIT_MASK 0x10 FORMAT "%5.3" ECU_ADDRESS 0x600370AB /end MEASUREMENT
/begin MEASUREMENT DFC_b.LDF_RBA_IOEXTLIB_KEEPALIVE_DRV "Bit encoding / Last debounced flag bit for check DFC_RBA_IOEXTLIB_KEEPALIVE_DRV" UBYTE DFC_OneToOne 1 100 0.00 1.000 BIT_MASK 0x10 FORMAT "%5.3" ECU_ADDRESS 0x600370AC /end MEASUREMENT
/begin MEASUREMENT DFC_b.LDF_RBA_IOEXTLIB_KEEPALIVE_INI "Bit encoding / Last debounced flag bit for check DFC_RBA_IOEXTLIB_KEEPALIVE_INI" UBYTE DFC_OneToOne 1 100 0.00 1.000 BIT_MASK 0x10 FORMAT "%5.3" ECU_ADDRESS 0x600370AD /end MEASUREMENT
/begin MEASUREMENT DFC_b.LDF_rba_IoSigRtc_StopCounter "Bit encoding / Last debounced flag bit for check DFC_rba_IoSigRtc_StopCounter" UBYTE DFC_OneToOne 1 100 0.00 1.000 BIT_MASK 0x10 FORMAT "%5.3" ECU_ADDRESS 0x600370AE /end MEASUREMENT
/begin MEASUREMENT DFC_b.LDF_rba_MRly_Diag_Stk_Event "Bit encoding / Last debounced flag bit for check DFC_rba_MRly_Diag_Stk_Event" UBYTE DFC_OneToOne 1 100 0.00 1.000 BIT_MASK 0x10 FORMAT "%5.3" ECU_ADDRESS 0x600370AF /end MEASUREMENT
/begin MEASUREMENT DFC_b.LDF_rba_MemDiag_MemReadErr "Bit encoding / Last debounced flag bit for check DFC_rba_MemDiag_MemReadErr" UBYTE DFC_OneToOne 1 100 0.00 1.000 BIT_MASK 0x10 FORMAT "%5.3" ECU_ADDRESS 0x600370B0 /end MEASUREMENT
/begin MEASUREMENT DFC_b.LDF_rba_MemDiag_MemWrErr "Bit encoding / Last debounced flag bit for check DFC_rba_MemDiag_MemWrErr" UBYTE DFC_OneToOne 1 100 0.00 1.000 BIT_MASK 0x10 FORMAT "%5.3" ECU_ADDRESS 0x600370B1 /end MEASUREMENT
/begin MEASUREMENT DFC_b.LDF_rba_SyC_IrrSwOffTrigEngRun_Event "Bit encoding / Last debounced flag bit for check DFC_rba_SyC_IrrSwOffTrigEngRun_Event" UBYTE DFC_OneToOne 1 100 0.00 1.000 BIT_MASK 0x10 FORMAT "%5.3" ECU_ADDRESS 0x600370B2 /end MEASUREMENT
/begin MEASUREMENT DFC_b.LDF_rba_T15_Diag_ComInVld_Event "Bit encoding / Last debounced flag bit for check DFC_rba_T15_Diag_ComInVld_Event" UBYTE DFC_OneToOne 1 100 0.00 1.000 BIT_MASK 0x10 FORMAT "%5.3" ECU_ADDRESS 0x600370B3 /end MEASUREMENT
/begin MEASUREMENT DFC_b.LDF_rba_T15_Diag_ComOff_HwOn_Event "Bit encoding / Last debounced flag bit for check DFC_rba_T15_Diag_ComOff_HwOn_Event" UBYTE DFC_OneToOne 1 100 0.00 1.000 BIT_MASK 0x10 FORMAT "%5.3" ECU_ADDRESS 0x600370B4 /end MEASUREMENT
/begin MEASUREMENT DFC_b.LDF_rba_T15_Diag_ComOn_HwOff_Event "Bit encoding / Last debounced flag bit for check DFC_rba_T15_Diag_ComOn_HwOff_Event" UBYTE DFC_OneToOne 1 100 0.00 1.000 BIT_MASK 0x10 FORMAT "%5.3" ECU_ADDRESS 0x600370B5 /end MEASUREMENT
/begin MEASUREMENT DFC_b.LDF_AAVmin "Bit encoding / Last debounced flag bit for check DFC_AAVmin" UBYTE DFC_OneToOne 1 100 0.00 1.000 BIT_MASK 0x10 FORMAT "%5.3" ECU_ADDRESS 0x600370B6 /end MEASUREMENT
/begin MEASUREMENT DFC_b.LDF_AGRSUS "Bit encoding / Last debounced flag bit for check DFC_AGRSUS" UBYTE DFC_OneToOne 1 100 0.00 1.000 BIT_MASK 0x10 FORMAT "%5.3" ECU_ADDRESS 0x600370B7 /end MEASUREMENT
/begin MEASUREMENT DFC_b.LDF_AfsPlausDiagHi "Bit encoding / Last debounced flag bit for check DFC_AfsPlausDiagHi" UBYTE DFC_OneToOne 1 100 0.00 1.000 BIT_MASK 0x10 FORMAT "%5.3" ECU_ADDRESS 0x600370B8 /end MEASUREMENT
/begin MEASUREMENT DFC_b.LDF_AfsPlausDiagLo "Bit encoding / Last debounced flag bit for check DFC_AfsPlausDiagLo" UBYTE DFC_OneToOne 1 100 0.00 1.000 BIT_MASK 0x10 FORMAT "%5.3" ECU_ADDRESS 0x600370B9 /end MEASUREMENT
/begin MEASUREMENT DFC_b.LDF_AfsVrntDiagErrB1 "Bit encoding / Last debounced flag bit for check DFC_AfsVrntDiagErrB1" UBYTE DFC_OneToOne 1 100 0.00 1.000 BIT_MASK 0x10 FORMAT "%5.3" ECU_ADDRESS 0x600370BA /end MEASUREMENT
/begin MEASUREMENT DFC_b.LDF_AppAllSnsrDfct "Bit encoding / Last debounced flag bit for check DFC_AppAllSnsrDfct" UBYTE DFC_OneToOne 1 100 0.00 1.000 BIT_MASK 0x10 FORMAT "%5.3" ECU_ADDRESS 0x600370BB /end MEASUREMENT
/begin MEASUREMENT DFC_b.LDF_BBKRnldg "Bit encoding / Last debounced flag bit for check DFC_BBKRnldg" UBYTE DFC_OneToOne 1 100 0.00 1.000 BIT_MASK 0x10 FORMAT "%5.3" ECU_ADDRESS 0x600370BC /end MEASUREMENT
/begin MEASUREMENT DFC_b.LDF_BBKRsyne "Bit encoding / Last debounced flag bit for check DFC_BBKRsyne" UBYTE DFC_OneToOne 1 100 0.00 1.000 BIT_MASK 0x10 FORMAT "%5.3" ECU_ADDRESS 0x600370BD /end MEASUREMENT
/begin MEASUREMENT DFC_b.LDF_BattUStdbyDiaOL "Bit encoding / Last debounced flag bit for check DFC_BattUStdbyDiaOL" UBYTE DFC_OneToOne 1 100 0.00 1.000 BIT_MASK 0x10 FORMAT "%5.3" ECU_ADDRESS 0x600370BE /end MEASUREMENT
/begin MEASUREMENT DFC_b.LDF_BigLeakIntkMnfldEmiInfl "Bit encoding / Last debounced flag bit for check DFC_BigLeakIntkMnfldEmiInfl" UBYTE DFC_OneToOne 1 100 0.00 1.000 BIT_MASK 0x10 FORMAT "%5.3" ECU_ADDRESS 0x600370BF /end MEASUREMENT
/begin MEASUREMENT DFC_b.LDF_BlkdLineTank "Bit encoding / Last debounced flag bit for check DFC_BlkdLineTank" UBYTE DFC_OneToOne 1 100 0.00 1.000 BIT_MASK 0x10 FORMAT "%5.3" ECU_ADDRESS 0x600370C0 /end MEASUREMENT
/begin MEASUREMENT DFC_b.LDF_BrkMnSwtContOnWarnLmp "Bit encoding / Last debounced flag bit for check DFC_BrkMnSwtContOnWarnLmp" UBYTE DFC_OneToOne 1 100 0.00 1.000 BIT_MASK 0x10 FORMAT "%5.3" ECU_ADDRESS 0x600370C1 /end MEASUREMENT
/begin MEASUREMENT DFC_b.LDF_BrkMnSwtNotStpWarnLmp "Bit encoding / Last debounced flag bit for check DFC_BrkMnSwtNotStpWarnLmp" UBYTE DFC_OneToOne 1 100 0.00 1.000 BIT_MASK 0x10 FORMAT "%5.3" ECU_ADDRESS 0x600370C2 /end MEASUREMENT
/begin MEASUREMENT DFC_b.LDF_BrkRdntSwtContOnWarnLmp "Bit encoding / Last debounced flag bit for check DFC_BrkRdntSwtContOnWarnLmp" UBYTE DFC_OneToOne 1 100 0.00 1.000 BIT_MASK 0x10 FORMAT "%5.3" ECU_ADDRESS 0x600370C3 /end MEASUREMENT
/begin MEASUREMENT DFC_b.LDF_BrkRdntSwtNotStpWarnLmp "Bit encoding / Last debounced flag bit for check DFC_BrkRdntSwtNotStpWarnLmp" UBYTE DFC_OneToOne 1 100 0.00 1.000 BIT_MASK 0x10 FORMAT "%5.3" ECU_ADDRESS 0x600370C4 /end MEASUREMENT
/begin MEASUREMENT DFC_b.LDF_CEngDsTColdStrtMax "Bit encoding / Last debounced flag bit for check DFC_CEngDsTColdStrtMax" UBYTE DFC_OneToOne 1 100 0.00 1.000 BIT_MASK 0x10 FORMAT "%5.3" ECU_ADDRESS 0x600370C5 /end MEASUREMENT
/begin MEASUREMENT DFC_b.LDF_CEngDsTColdStrtMin "Bit encoding / Last debounced flag bit for check DFC_CEngDsTColdStrtMin" UBYTE DFC_OneToOne 1 100 0.00 1.000 BIT_MASK 0x10 FORMAT "%5.3" ECU_ADDRESS 0x600370C6 /end MEASUREMENT
/begin MEASUREMENT DFC_b.LDF_CEngDsTImps "Bit encoding / Last debounced flag bit for check DFC_CEngDsTImps" UBYTE DFC_OneToOne 1 100 0.00 1.000 BIT_MASK 0x10 FORMAT "%5.3" ECU_ADDRESS 0x600370C7 /end MEASUREMENT
/begin MEASUREMENT DFC_b.LDF_CEngDsTPlausHSC "Bit encoding / Last debounced flag bit for check DFC_CEngDsTPlausHSC" UBYTE DFC_OneToOne 1 100 0.00 1.000 BIT_MASK 0x10 FORMAT "%5.3" ECU_ADDRESS 0x600370C8 /end MEASUREMENT
/begin MEASUREMENT DFC_b.LDF_CEngDsTPlausLSC "Bit encoding / Last debounced flag bit for check DFC_CEngDsTPlausLSC" UBYTE DFC_OneToOne 1 100 0.00 1.000 BIT_MASK 0x10 FORMAT "%5.3" ECU_ADDRESS 0x600370C9 /end MEASUREMENT
/begin MEASUREMENT DFC_b.LDF_CEngDsTPlausSTC "Bit encoding / Last debounced flag bit for check DFC_CEngDsTPlausSTC" UBYTE DFC_OneToOne 1 100 0.00 1.000 BIT_MASK 0x10 FORMAT "%5.3" ECU_ADDRESS 0x600370CA /end MEASUREMENT
/begin MEASUREMENT DFC_b.LDF_CEngDsTSRCMax "Bit encoding / Last debounced flag bit for check DFC_CEngDsTSRCMax" UBYTE DFC_OneToOne 1 100 0.00 1.000 BIT_MASK 0x10 FORMAT "%5.3" ECU_ADDRESS 0x600370CB /end MEASUREMENT
/begin MEASUREMENT DFC_b.LDF_CEngDsTSRCMin "Bit encoding / Last debounced flag bit for check DFC_CEngDsTSRCMin" UBYTE DFC_OneToOne 1 100 0.00 1.000 BIT_MASK 0x10 FORMAT "%5.3" ECU_ADDRESS 0x600370CC /end MEASUREMENT
/begin MEASUREMENT DFC_b.LDF_CEngDsTSig "Bit encoding / Last debounced flag bit for check DFC_CEngDsTSig" UBYTE DFC_OneToOne 1 100 0.00 1.000 BIT_MASK 0x10 FORMAT "%5.3" ECU_ADDRESS 0x600370CD /end MEASUREMENT
/begin MEASUREMENT DFC_b.LDF_CEngUsTColdStrtMax "Bit encoding / Last debounced flag bit for check DFC_CEngUsTColdStrtMax" UBYTE DFC_OneToOne 1 100 0.00 1.000 BIT_MASK 0x10 FORMAT "%5.3" ECU_ADDRESS 0x600370CE /end MEASUREMENT
/begin MEASUREMENT DFC_b.LDF_CEngUsTColdStrtMin "Bit encoding / Last debounced flag bit for check DFC_CEngUsTColdStrtMin" UBYTE DFC_OneToOne 1 100 0.00 1.000 BIT_MASK 0x10 FORMAT "%5.3" ECU_ADDRESS 0x600370CF /end MEASUREMENT
/begin MEASUREMENT DFC_b.LDF_CEngUsTLooseCnctn "Bit encoding / Last debounced flag bit for check DFC_CEngUsTLooseCnctn" UBYTE DFC_OneToOne 1 100 0.00 1.000 BIT_MASK 0x10 FORMAT "%5.3" ECU_ADDRESS 0x600370D0 /end MEASUREMENT
/begin MEASUREMENT DFC_b.LDF_CEngUsTSRCMax "Bit encoding / Last debounced flag bit for check DFC_CEngUsTSRCMax" UBYTE DFC_OneToOne 1 100 0.00 1.000 BIT_MASK 0x10 FORMAT "%5.3" ECU_ADDRESS 0x600370D1 /end MEASUREMENT
/begin MEASUREMENT DFC_b.LDF_CEngUsTSRCMin "Bit encoding / Last debounced flag bit for check DFC_CEngUsTSRCMin" UBYTE DFC_OneToOne 1 100 0.00 1.000 BIT_MASK 0x10 FORMAT "%5.3" ECU_ADDRESS 0x600370D2 /end MEASUREMENT
/begin MEASUREMENT DFC_b.LDF_ComDCDCACCFailr "Bit encoding / Last debounced flag bit for check DFC_ComDCDCACCFailr" UBYTE DFC_OneToOne 1 100 0.00 1.000 BIT_MASK 0x10 FORMAT "%5.3" ECU_ADDRESS 0x600370D3 /end MEASUREMENT
/begin MEASUREMENT DFC_b.LDF_DCDCFltDet "Bit encoding / Last debounced flag bit for check DFC_DCDCFltDet" UBYTE DFC_OneToOne 1 100 0.00 1.000 BIT_MASK 0x10 FORMAT "%5.3" ECU_ADDRESS 0x600370D4 /end MEASUREMENT
/begin MEASUREMENT DFC_b.LDF_DKRSA "Bit encoding / Last debounced flag bit for check DFC_DKRSA" UBYTE DFC_OneToOne 1 100 0.00 1.000 BIT_MASK 0x10 FORMAT "%5.3" ECU_ADDRESS 0x600370D5 /end MEASUREMENT
/begin MEASUREMENT DFC_b.LDF_DKVSmax "Bit encoding / Last debounced flag bit for check DFC_DKVSmax" UBYTE DFC_OneToOne 1 100 0.00 1.000 BIT_MASK 0x10 FORMAT "%5.3" ECU_ADDRESS 0x600370D6 /end MEASUREMENT
/begin MEASUREMENT DFC_b.LDF_DKnpl "Bit encoding / Last debounced flag bit for check DFC_DKnpl" UBYTE DFC_OneToOne 1 100 0.00 1.000 BIT_MASK 0x10 FORMAT "%5.3" ECU_ADDRESS 0x600370D7 /end MEASUREMENT
/begin MEASUREMENT DFC_b.LDF_DSKVRmax "Bit encoding / Last debounced flag bit for check DFC_DSKVRmax" UBYTE DFC_OneToOne 1 100 0.00 1.000 BIT_MASK 0x10 FORMAT "%5.3" ECU_ADDRESS 0x600370D8 /end MEASUREMENT
/begin MEASUREMENT DFC_b.LDF_DSKVRmin "Bit encoding / Last debounced flag bit for check DFC_DSKVRmin" UBYTE DFC_OneToOne 1 100 0.00 1.000 BIT_MASK 0x10 FORMAT "%5.3" ECU_ADDRESS 0x600370D9 /end MEASUREMENT
/begin MEASUREMENT DFC_b.LDF_DSKVRnpl "Bit encoding / Last debounced flag bit for check DFC_DSKVRnpl" UBYTE DFC_OneToOne 1 100 0.00 1.000 BIT_MASK 0x10 FORMAT "%5.3" ECU_ADDRESS 0x600370DA /end MEASUREMENT
/begin MEASUREMENT DFC_b.LDF_DSKVRsig "Bit encoding / Last debounced flag bit for check DFC_DSKVRsig" UBYTE DFC_OneToOne 1 100 0.00 1.000 BIT_MASK 0x10 FORMAT "%5.3" ECU_ADDRESS 0x600370DB /end MEASUREMENT
/begin MEASUREMENT DFC_b.LDF_DSKVSsig "Bit encoding / Last debounced flag bit for check DFC_DSKVSsig" UBYTE DFC_OneToOne 1 100 0.00 1.000 BIT_MASK 0x10 FORMAT "%5.3" ECU_ADDRESS 0x600370DC /end MEASUREMENT
/begin MEASUREMENT DFC_b.LDF_DSSmax "Bit encoding / Last debounced flag bit for check DFC_DSSmax" UBYTE DFC_OneToOne 1 100 0.00 1.000 BIT_MASK 0x10 FORMAT "%5.3" ECU_ADDRESS 0x600370DD /end MEASUREMENT
/begin MEASUREMENT DFC_b.LDF_DSTDmax "Bit encoding / Last debounced flag bit for check DFC_DSTDmax" UBYTE DFC_OneToOne 1 100 0.00 1.000 BIT_MASK 0x10 FORMAT "%5.3" ECU_ADDRESS 0x600370DE /end MEASUREMENT
/begin MEASUREMENT DFC_b.LDF_DSTEmax "Bit encoding / Last debounced flag bit for check DFC_DSTEmax" UBYTE DFC_OneToOne 1 100 0.00 1.000 BIT_MASK 0x10 FORMAT "%5.3" ECU_ADDRESS 0x600370DF /end MEASUREMENT
/begin MEASUREMENT DFC_b.LDF_DSTEmin "Bit encoding / Last debounced flag bit for check DFC_DSTEmin" UBYTE DFC_OneToOne 1 100 0.00 1.000 BIT_MASK 0x10 FORMAT "%5.3" ECU_ADDRESS 0x600370E0 /end MEASUREMENT
/begin MEASUREMENT DFC_b.LDF_DSTOFmax "Bit encoding / Last debounced flag bit for check DFC_DSTOFmax" UBYTE DFC_OneToOne 1 100 0.00 1.000 BIT_MASK 0x10 FORMAT "%5.3" ECU_ADDRESS 0x600370E1 /end MEASUREMENT
/begin MEASUREMENT DFC_b.LDF_DSTRmax "Bit encoding / Last debounced flag bit for check DFC_DSTRmax" UBYTE DFC_OneToOne 1 100 0.00 1.000 BIT_MASK 0x10 FORMAT "%5.3" ECU_ADDRESS 0x600370E2 /end MEASUREMENT
/begin MEASUREMENT DFC_b.LDF_DSTRmin "Bit encoding / Last debounced flag bit for check DFC_DSTRmin" UBYTE DFC_OneToOne 1 100 0.00 1.000 BIT_MASK 0x10 FORMAT "%5.3" ECU_ADDRESS 0x600370E3 /end MEASUREMENT
/begin MEASUREMENT DFC_b.LDF_DSTRnpl "Bit encoding / Last debounced flag bit for check DFC_DSTRnpl" UBYTE DFC_OneToOne 1 100 0.00 1.000 BIT_MASK 0x10 FORMAT "%5.3" ECU_ADDRESS 0x600370E4 /end MEASUREMENT
/begin MEASUREMENT DFC_b.LDF_DSTRsig "Bit encoding / Last debounced flag bit for check DFC_DSTRsig" UBYTE DFC_OneToOne 1 100 0.00 1.000 BIT_MASK 0x10 FORMAT "%5.3" ECU_ADDRESS 0x600370E5 /end MEASUREMENT
/begin MEASUREMENT DFC_b.LDF_DSTTI "Bit encoding / Last debounced flag bit for check DFC_DSTTI" UBYTE DFC_OneToOne 1 100 0.00 1.000 BIT_MASK 0x10 FORMAT "%5.3" ECU_ADDRESS 0x600370E6 /end MEASUREMENT
/begin MEASUREMENT DFC_b.LDF_DSUmax "Bit encoding / Last debounced flag bit for check DFC_DSUmax" UBYTE DFC_OneToOne 1 100 0.00 1.000 BIT_MASK 0x10 FORMAT "%5.3" ECU_ADDRESS 0x600370E7 /end MEASUREMENT
/begin MEASUREMENT DFC_b.LDF_DiagCpv1DteskLoLoadStuckClsd "Bit encoding / Last debounced flag bit for check DFC_DiagCpv1DteskLoLoadStuckClsd" UBYTE DFC_OneToOne 1 100 0.00 1.000 BIT_MASK 0x10 FORMAT "%5.3" ECU_ADDRESS 0x600370E8 /end MEASUREMENT
/begin MEASUREMENT DFC_b.LDF_DiagCpv1DteskLoLoadStuckOpen "Bit encoding / Last debounced flag bit for check DFC_DiagCpv1DteskLoLoadStuckOpen" UBYTE DFC_OneToOne 1 100 0.00 1.000 BIT_MASK 0x10 FORMAT "%5.3" ECU_ADDRESS 0x600370E9 /end MEASUREMENT
/begin MEASUREMENT DFC_b.LDF_EGRVlvDrftClsd "Bit encoding / Last debounced flag bit for check DFC_EGRVlvDrftClsd" UBYTE DFC_OneToOne 1 100 0.00 1.000 BIT_MASK 0x10 FORMAT "%5.3" ECU_ADDRESS 0x600370EA /end MEASUREMENT
/begin MEASUREMENT DFC_b.LDF_EGRVlvDrftOpn "Bit encoding / Last debounced flag bit for check DFC_EGRVlvDrftOpn" UBYTE DFC_OneToOne 1 100 0.00 1.000 BIT_MASK 0x10 FORMAT "%5.3" ECU_ADDRESS 0x600370EB /end MEASUREMENT
/begin MEASUREMENT DFC_b.LDF_EGRVlvJamVlvClsd "Bit encoding / Last debounced flag bit for check DFC_EGRVlvJamVlvClsd" UBYTE DFC_OneToOne 1 100 0.00 1.000 BIT_MASK 0x10 FORMAT "%5.3" ECU_ADDRESS 0x600370EC /end MEASUREMENT
/begin MEASUREMENT DFC_b.LDF_EGRVlvJamVlvOpn "Bit encoding / Last debounced flag bit for check DFC_EGRVlvJamVlvOpn" UBYTE DFC_OneToOne 1 100 0.00 1.000 BIT_MASK 0x10 FORMAT "%5.3" ECU_ADDRESS 0x600370ED /end MEASUREMENT
/begin MEASUREMENT DFC_b.LDF_EGRVlvSprgBrk "Bit encoding / Last debounced flag bit for check DFC_EGRVlvSprgBrk" UBYTE DFC_OneToOne 1 100 0.00 1.000 BIT_MASK 0x10 FORMAT "%5.3" ECU_ADDRESS 0x600370EE /end MEASUREMENT
/begin MEASUREMENT DFC_b.LDF_EGRVlvTempMdlEEPErr "Bit encoding / Last debounced flag bit for check DFC_EGRVlvTempMdlEEPErr" UBYTE DFC_OneToOne 1 100 0.00 1.000 BIT_MASK 0x10 FORMAT "%5.3" ECU_ADDRESS 0x600370EF /end MEASUREMENT
/begin MEASUREMENT DFC_b.LDF_EGRVlvTmpErr "Bit encoding / Last debounced flag bit for check DFC_EGRVlvTmpErr" UBYTE DFC_OneToOne 1 100 0.00 1.000 BIT_MASK 0x10 FORMAT "%5.3" ECU_ADDRESS 0x600370F0 /end MEASUREMENT
/begin MEASUREMENT DFC_b.LDF_EGSDUS2B1LtrDly "Bit encoding / Last debounced flag bit for check DFC_EGSDUS2B1LtrDly" UBYTE DFC_OneToOne 1 100 0.00 1.000 BIT_MASK 0x10 FORMAT "%5.3" ECU_ADDRESS 0x600370F1 /end MEASUREMENT
/begin MEASUREMENT DFC_b.LDF_EGSDUS2B1LtrPT1 "Bit encoding / Last debounced flag bit for check DFC_EGSDUS2B1LtrPT1" UBYTE DFC_OneToOne 1 100 0.00 1.000 BIT_MASK 0x10 FORMAT "%5.3" ECU_ADDRESS 0x600370F2 /end MEASUREMENT
/begin MEASUREMENT DFC_b.LDF_EGSDUS2B1RtlDly "Bit encoding / Last debounced flag bit for check DFC_EGSDUS2B1RtlDly" UBYTE DFC_OneToOne 1 100 0.00 1.000 BIT_MASK 0x10 FORMAT "%5.3" ECU_ADDRESS 0x600370F3 /end MEASUREMENT
/begin MEASUREMENT DFC_b.LDF_EGSDUS2B1RtlPT1 "Bit encoding / Last debounced flag bit for check DFC_EGSDUS2B1RtlPT1" UBYTE DFC_OneToOne 1 100 0.00 1.000 BIT_MASK 0x10 FORMAT "%5.3" ECU_ADDRESS 0x600370F4 /end MEASUREMENT
/begin MEASUREMENT DFC_b.LDF_EGSDUS2B1TarLean "Bit encoding / Last debounced flag bit for check DFC_EGSDUS2B1TarLean" UBYTE DFC_OneToOne 1 100 0.00 1.000 BIT_MASK 0x10 FORMAT "%5.3" ECU_ADDRESS 0x600370F5 /end MEASUREMENT
/begin MEASUREMENT DFC_b.LDF_EGSDUS2B1TarRich "Bit encoding / Last debounced flag bit for check DFC_EGSDUS2B1TarRich" UBYTE DFC_OneToOne 1 100 0.00 1.000 BIT_MASK 0x10 FORMAT "%5.3" ECU_ADDRESS 0x600370F6 /end MEASUREMENT
/begin MEASUREMENT DFC_b.LDF_EONVmax "Bit encoding / Last debounced flag bit for check DFC_EONVmax" UBYTE DFC_OneToOne 1 100 0.00 1.000 BIT_MASK 0x10 FORMAT "%5.3" ECU_ADDRESS 0x600370F7 /end MEASUREMENT
/begin MEASUREMENT DFC_b.LDF_ETAKHLmax "Bit encoding / Last debounced flag bit for check DFC_ETAKHLmax" UBYTE DFC_OneToOne 1 100 0.00 1.000 BIT_MASK 0x10 FORMAT "%5.3" ECU_ADDRESS 0x600370F8 /end MEASUREMENT
/begin MEASUREMENT DFC_b.LDF_ETAKHTmax "Bit encoding / Last debounced flag bit for check DFC_ETAKHTmax" UBYTE DFC_OneToOne 1 100 0.00 1.000 BIT_MASK 0x10 FORMAT "%5.3" ECU_ADDRESS 0x600370F9 /end MEASUREMENT
/begin MEASUREMENT DFC_b.LDF_ETHSEmax "Bit encoding / Last debounced flag bit for check DFC_ETHSEmax" UBYTE DFC_OneToOne 1 100 0.00 1.000 BIT_MASK 0x10 FORMAT "%5.3" ECU_ADDRESS 0x600370FA /end MEASUREMENT
/begin MEASUREMENT DFC_b.LDF_ETHSEmin "Bit encoding / Last debounced flag bit for check DFC_ETHSEmin" UBYTE DFC_OneToOne 1 100 0.00 1.000 BIT_MASK 0x10 FORMAT "%5.3" ECU_ADDRESS 0x600370FB /end MEASUREMENT
/begin MEASUREMENT DFC_b.LDF_ETHSFmax "Bit encoding / Last debounced flag bit for check DFC_ETHSFmax" UBYTE DFC_OneToOne 1 100 0.00 1.000 BIT_MASK 0x10 FORMAT "%5.3" ECU_ADDRESS 0x600370FC /end MEASUREMENT
/begin MEASUREMENT DFC_b.LDF_ETHSFmin "Bit encoding / Last debounced flag bit for check DFC_ETHSFmin" UBYTE DFC_OneToOne 1 100 0.00 1.000 BIT_MASK 0x10 FORMAT "%5.3" ECU_ADDRESS 0x600370FD /end MEASUREMENT
/begin MEASUREMENT DFC_b.LDF_ETHSFsig "Bit encoding / Last debounced flag bit for check DFC_ETHSFsig" UBYTE DFC_OneToOne 1 100 0.00 1.000 BIT_MASK 0x10 FORMAT "%5.3" ECU_ADDRESS 0x600370FE /end MEASUREMENT
/begin MEASUREMENT DFC_b.LDF_ETHSNPWmax "Bit encoding / Last debounced flag bit for check DFC_ETHSNPWmax" UBYTE DFC_OneToOne 1 100 0.00 1.000 BIT_MASK 0x10 FORMAT "%5.3" ECU_ADDRESS 0x600370FF /end MEASUREMENT
/begin MEASUREMENT DFC_b.LDF_ETHSNPWmin "Bit encoding / Last debounced flag bit for check DFC_ETHSNPWmin" UBYTE DFC_OneToOne 1 100 0.00 1.000 BIT_MASK 0x10 FORMAT "%5.3" ECU_ADDRESS 0x60037100 /end MEASUREMENT
/begin MEASUREMENT DFC_b.LDF_ETHSNPWsig "Bit encoding / Last debounced flag bit for check DFC_ETHSNPWsig" UBYTE DFC_OneToOne 1 100 0.00 1.000 BIT_MASK 0x10 FORMAT "%5.3" ECU_ADDRESS 0x60037101 /end MEASUREMENT
/begin MEASUREMENT DFC_b.LDF_ETHSPLnpl "Bit encoding / Last debounced flag bit for check DFC_ETHSPLnpl" UBYTE DFC_OneToOne 1 100 0.00 1.000 BIT_MASK 0x10 FORMAT "%5.3" ECU_ADDRESS 0x60037102 /end MEASUREMENT
/begin MEASUREMENT DFC_b.LDF_ETHSTPLnpl "Bit encoding / Last debounced flag bit for check DFC_ETHSTPLnpl" UBYTE DFC_OneToOne 1 100 0.00 1.000 BIT_MASK 0x10 FORMAT "%5.3" ECU_ADDRESS 0x60037103 /end MEASUREMENT
/begin MEASUREMENT DFC_b.LDF_EngICO "Bit encoding / Last debounced flag bit for check DFC_EngICO" UBYTE DFC_OneToOne 1 100 0.00 1.000 BIT_MASK 0x10 FORMAT "%5.3" ECU_ADDRESS 0x60037104 /end MEASUREMENT
/begin MEASUREMENT DFC_b.LDF_EngPrtOvrSpdMon "Bit encoding / Last debounced flag bit for check DFC_EngPrtOvrSpdMon" UBYTE DFC_OneToOne 1 100 0.00 1.000 BIT_MASK 0x10 FORMAT "%5.3" ECU_ADDRESS 0x60037105 /end MEASUREMENT
/begin MEASUREMENT DFC_b.LDF_EpmCaSI1ErrSig "Bit encoding / Last debounced flag bit for check DFC_EpmCaSI1ErrSig" UBYTE DFC_OneToOne 1 100 0.00 1.000 BIT_MASK 0x10 FORMAT "%5.3" ECU_ADDRESS 0x60037106 /end MEASUREMENT
/begin MEASUREMENT DFC_b.LDF_EpmCaSI1MntErr "Bit encoding / Last debounced flag bit for check DFC_EpmCaSI1MntErr" UBYTE DFC_OneToOne 1 100 0.00 1.000 BIT_MASK 0x10 FORMAT "%5.3" ECU_ADDRESS 0x60037107 /end MEASUREMENT
/begin MEASUREMENT DFC_b.LDF_EpmCaSI1NoSigMax "Bit encoding / Last debounced flag bit for check DFC_EpmCaSI1NoSigMax" UBYTE DFC_OneToOne 1 100 0.00 1.000 BIT_MASK 0x10 FORMAT "%5.3" ECU_ADDRESS 0x60037108 /end MEASUREMENT
/begin MEASUREMENT DFC_b.LDF_EpmCaSI1NoSigMin "Bit encoding / Last debounced flag bit for check DFC_EpmCaSI1NoSigMin" UBYTE DFC_OneToOne 1 100 0.00 1.000 BIT_MASK 0x10 FORMAT "%5.3" ECU_ADDRESS 0x60037109 /end MEASUREMENT
/begin MEASUREMENT DFC_b.LDF_EpmCaSI1OfsErr "Bit encoding / Last debounced flag bit for check DFC_EpmCaSI1OfsErr" UBYTE DFC_OneToOne 1 100 0.00 1.000 BIT_MASK 0x10 FORMAT "%5.3" ECU_ADDRESS 0x6003710A /end MEASUREMENT
/begin MEASUREMENT DFC_b.LDF_EpmCrSDGI "Bit encoding / Last debounced flag bit for check DFC_EpmCrSDGI" UBYTE DFC_OneToOne 1 100 0.00 1.000 BIT_MASK 0x10 FORMAT "%5.3" ECU_ADDRESS 0x6003710B /end MEASUREMENT
/begin MEASUREMENT DFC_b.LDF_EpmCrSErrSig "Bit encoding / Last debounced flag bit for check DFC_EpmCrSErrSig" UBYTE DFC_OneToOne 1 100 0.00 1.000 BIT_MASK 0x10 FORMAT "%5.3" ECU_ADDRESS 0x6003710C /end MEASUREMENT
/begin MEASUREMENT DFC_b.LDF_EpmCrSNoSig "Bit encoding / Last debounced flag bit for check DFC_EpmCrSNoSig" UBYTE DFC_OneToOne 1 100 0.00 1.000 BIT_MASK 0x10 FORMAT "%5.3" ECU_ADDRESS 0x6003710D /end MEASUREMENT
/begin MEASUREMENT DFC_b.LDF_EtaEngIdleNonCsers "Bit encoding / Last debounced flag bit for check DFC_EtaEngIdleNonCsers" UBYTE DFC_OneToOne 1 100 0.00 1.000 BIT_MASK 0x10 FORMAT "%5.3" ECU_ADDRESS 0x6003710E /end MEASUREMENT
/begin MEASUREMENT DFC_b.LDF_EtaEngPtlNonCsers "Bit encoding / Last debounced flag bit for check DFC_EtaEngPtlNonCsers" UBYTE DFC_OneToOne 1 100 0.00 1.000 BIT_MASK 0x10 FORMAT "%5.3" ECU_ADDRESS 0x6003710F /end MEASUREMENT
/begin MEASUREMENT DFC_b.LDF_FRAmax "Bit encoding / Last debounced flag bit for check DFC_FRAmax" UBYTE DFC_OneToOne 1 100 0.00 1.000 BIT_MASK 0x10 FORMAT "%5.3" ECU_ADDRESS 0x60037110 /end MEASUREMENT
/begin MEASUREMENT DFC_b.LDF_FRAmin "Bit encoding / Last debounced flag bit for check DFC_FRAmin" UBYTE DFC_OneToOne 1 100 0.00 1.000 BIT_MASK 0x10 FORMAT "%5.3" ECU_ADDRESS 0x60037111 /end MEASUREMENT
/begin MEASUREMENT DFC_b.LDF_FSTEmax "Bit encoding / Last debounced flag bit for check DFC_FSTEmax" UBYTE DFC_OneToOne 1 100 0.00 1.000 BIT_MASK 0x10 FORMAT "%5.3" ECU_ADDRESS 0x60037112 /end MEASUREMENT
/begin MEASUREMENT DFC_b.LDF_FSTEmin "Bit encoding / Last debounced flag bit for check DFC_FSTEmin" UBYTE DFC_OneToOne 1 100 0.00 1.000 BIT_MASK 0x10 FORMAT "%5.3" ECU_ADDRESS 0x60037113 /end MEASUREMENT
/begin MEASUREMENT DFC_b.LDF_FSTRmax "Bit encoding / Last debounced flag bit for check DFC_FSTRmax" UBYTE DFC_OneToOne 1 100 0.00 1.000 BIT_MASK 0x10 FORMAT "%5.3" ECU_ADDRESS 0x60037114 /end MEASUREMENT
/begin MEASUREMENT DFC_b.LDF_FSTRmin "Bit encoding / Last debounced flag bit for check DFC_FSTRmin" UBYTE DFC_OneToOne 1 100 0.00 1.000 BIT_MASK 0x10 FORMAT "%5.3" ECU_ADDRESS 0x60037115 /end MEASUREMENT
/begin MEASUREMENT DFC_b.LDF_FSTRnpl "Bit encoding / Last debounced flag bit for check DFC_FSTRnpl" UBYTE DFC_OneToOne 1 100 0.00 1.000 BIT_MASK 0x10 FORMAT "%5.3" ECU_ADDRESS 0x60037116 /end MEASUREMENT
/begin MEASUREMENT DFC_b.LDF_FSTmax "Bit encoding / Last debounced flag bit for check DFC_FSTmax" UBYTE DFC_OneToOne 1 100 0.00 1.000 BIT_MASK 0x10 FORMAT "%5.3" ECU_ADDRESS 0x60037117 /end MEASUREMENT
/begin MEASUREMENT DFC_b.LDF_FTDLAmax "Bit encoding / Last debounced flag bit for check DFC_FTDLAmax" UBYTE DFC_OneToOne 1 100 0.00 1.000 BIT_MASK 0x10 FORMAT "%5.3" ECU_ADDRESS 0x60037118 /end MEASUREMENT
/begin MEASUREMENT DFC_b.LDF_FTDLAmin "Bit encoding / Last debounced flag bit for check DFC_FTDLAmin" UBYTE DFC_OneToOne 1 100 0.00 1.000 BIT_MASK 0x10 FORMAT "%5.3" ECU_ADDRESS 0x60037119 /end MEASUREMENT
/begin MEASUREMENT DFC_b.LDF_FuPHiSnsrEleclmax "Bit encoding / Last debounced flag bit for check DFC_FuPHiSnsrEleclmax" UBYTE DFC_OneToOne 1 100 0.00 1.000 BIT_MASK 0x10 FORMAT "%5.3" ECU_ADDRESS 0x6003711A /end MEASUREMENT
/begin MEASUREMENT DFC_b.LDF_FuPHiSnsrEleclmin "Bit encoding / Last debounced flag bit for check DFC_FuPHiSnsrEleclmin" UBYTE DFC_OneToOne 1 100 0.00 1.000 BIT_MASK 0x10 FORMAT "%5.3" ECU_ADDRESS 0x6003711B /end MEASUREMENT
/begin MEASUREMENT DFC_b.LDF_FuPHiSnsrEleclnpl "Bit encoding / Last debounced flag bit for check DFC_FuPHiSnsrEleclnpl" UBYTE DFC_OneToOne 1 100 0.00 1.000 BIT_MASK 0x10 FORMAT "%5.3" ECU_ADDRESS 0x6003711C /end MEASUREMENT
/begin MEASUREMENT DFC_b.LDF_FuPHiSnsrURngMax "Bit encoding / Last debounced flag bit for check DFC_FuPHiSnsrURngMax" UBYTE DFC_OneToOne 1 100 0.00 1.000 BIT_MASK 0x10 FORMAT "%5.3" ECU_ADDRESS 0x6003711D /end MEASUREMENT
/begin MEASUREMENT DFC_b.LDF_FuPHiSnsrURngMin "Bit encoding / Last debounced flag bit for check DFC_FuPHiSnsrURngMin" UBYTE DFC_OneToOne 1 100 0.00 1.000 BIT_MASK 0x10 FORMAT "%5.3" ECU_ADDRESS 0x6003711E /end MEASUREMENT
/begin MEASUREMENT DFC_b.LDF_FuSnsrPhyRngMaxErr "Bit encoding / Last debounced flag bit for check DFC_FuSnsrPhyRngMaxErr" UBYTE DFC_OneToOne 1 100 0.00 1.000 BIT_MASK 0x10 FORMAT "%5.3" ECU_ADDRESS 0x6003711F /end MEASUREMENT
/begin MEASUREMENT DFC_b.LDF_FuSnsrPhyRngMinErr "Bit encoding / Last debounced flag bit for check DFC_FuSnsrPhyRngMinErr" UBYTE DFC_OneToOne 1 100 0.00 1.000 BIT_MASK 0x10 FORMAT "%5.3" ECU_ADDRESS 0x60037120 /end MEASUREMENT
/begin MEASUREMENT DFC_b.LDF_GEVlvLockPinDiagIntkB1 "Bit encoding / Last debounced flag bit for check DFC_GEVlvLockPinDiagIntkB1" UBYTE DFC_OneToOne 1 100 0.00 1.000 BIT_MASK 0x10 FORMAT "%5.3" ECU_ADDRESS 0x60037121 /end MEASUREMENT
/begin MEASUREMENT DFC_b.LDF_GEVlvPhaSlowIntkB1 "Bit encoding / Last debounced flag bit for check DFC_GEVlvPhaSlowIntkB1" UBYTE DFC_OneToOne 1 100 0.00 1.000 BIT_MASK 0x10 FORMAT "%5.3" ECU_ADDRESS 0x60037122 /end MEASUREMENT
/begin MEASUREMENT DFC_b.LDF_GEVlvPhaTargIntkB1 "Bit encoding / Last debounced flag bit for check DFC_GEVlvPhaTargIntkB1" UBYTE DFC_OneToOne 1 100 0.00 1.000 BIT_MASK 0x10 FORMAT "%5.3" ECU_ADDRESS 0x60037123 /end MEASUREMENT
/begin MEASUREMENT DFC_b.LDF_GbxRvsSwtStk "Bit encoding / Last debounced flag bit for check DFC_GbxRvsSwtStk" UBYTE DFC_OneToOne 1 100 0.00 1.000 BIT_MASK 0x10 FORMAT "%5.3" ECU_ADDRESS 0x60037124 /end MEASUREMENT
/begin MEASUREMENT DFC_b.LDF_HDRKHmax "Bit encoding / Last debounced flag bit for check DFC_HDRKHmax" UBYTE DFC_OneToOne 1 100 0.00 1.000 BIT_MASK 0x10 FORMAT "%5.3" ECU_ADDRESS 0x60037125 /end MEASUREMENT
/begin MEASUREMENT DFC_b.LDF_HDRKHmin "Bit encoding / Last debounced flag bit for check DFC_HDRKHmin" UBYTE DFC_OneToOne 1 100 0.00 1.000 BIT_MASK 0x10 FORMAT "%5.3" ECU_ADDRESS 0x60037126 /end MEASUREMENT
/begin MEASUREMENT DFC_b.LDF_HDRPLmax "Bit encoding / Last debounced flag bit for check DFC_HDRPLmax" UBYTE DFC_OneToOne 1 100 0.00 1.000 BIT_MASK 0x10 FORMAT "%5.3" ECU_ADDRESS 0x60037127 /end MEASUREMENT
/begin MEASUREMENT DFC_b.LDF_HDRPLmin "Bit encoding / Last debounced flag bit for check DFC_HDRPLmin" UBYTE DFC_OneToOne 1 100 0.00 1.000 BIT_MASK 0x10 FORMAT "%5.3" ECU_ADDRESS 0x60037128 /end MEASUREMENT
/begin MEASUREMENT DFC_b.LDF_HDRmax "Bit encoding / Last debounced flag bit for check DFC_HDRmax" UBYTE DFC_OneToOne 1 100 0.00 1.000 BIT_MASK 0x10 FORMAT "%5.3" ECU_ADDRESS 0x60037129 /end MEASUREMENT
/begin MEASUREMENT DFC_b.LDF_HDRmin "Bit encoding / Last debounced flag bit for check DFC_HDRmin" UBYTE DFC_OneToOne 1 100 0.00 1.000 BIT_MASK 0x10 FORMAT "%5.3" ECU_ADDRESS 0x6003712A /end MEASUREMENT
/begin MEASUREMENT DFC_b.LDF_HEGOS2B1ElecMax "Bit encoding / Last debounced flag bit for check DFC_HEGOS2B1ElecMax" UBYTE DFC_OneToOne 1 100 0.00 1.000 BIT_MASK 0x10 FORMAT "%5.3" ECU_ADDRESS 0x6003712B /end MEASUREMENT
/begin MEASUREMENT DFC_b.LDF_HEGOS2B1ElecMin "Bit encoding / Last debounced flag bit for check DFC_HEGOS2B1ElecMin" UBYTE DFC_OneToOne 1 100 0.00 1.000 BIT_MASK 0x10 FORMAT "%5.3" ECU_ADDRESS 0x6003712C /end MEASUREMENT
/begin MEASUREMENT DFC_b.LDF_HEGOS2B1ElecSig "Bit encoding / Last debounced flag bit for check DFC_HEGOS2B1ElecSig" UBYTE DFC_OneToOne 1 100 0.00 1.000 BIT_MASK 0x10 FORMAT "%5.3" ECU_ADDRESS 0x6003712D /end MEASUREMENT
/begin MEASUREMENT DFC_b.LDF_HEGOS2B1HtgNpl "Bit encoding / Last debounced flag bit for check DFC_HEGOS2B1HtgNpl" UBYTE DFC_OneToOne 1 100 0.00 1.000 BIT_MASK 0x10 FORMAT "%5.3" ECU_ADDRESS 0x6003712E /end MEASUREMENT
/begin MEASUREMENT DFC_b.LDF_HEV00max "Bit encoding / Last debounced flag bit for check DFC_HEV00max" UBYTE DFC_OneToOne 1 100 0.00 1.000 BIT_MASK 0x10 FORMAT "%5.3" ECU_ADDRESS 0x6003712F /end MEASUREMENT
/begin MEASUREMENT DFC_b.LDF_HEV01max "Bit encoding / Last debounced flag bit for check DFC_HEV01max" UBYTE DFC_OneToOne 1 100 0.00 1.000 BIT_MASK 0x10 FORMAT "%5.3" ECU_ADDRESS 0x60037130 /end MEASUREMENT
/begin MEASUREMENT DFC_b.LDF_HEV02max "Bit encoding / Last debounced flag bit for check DFC_HEV02max" UBYTE DFC_OneToOne 1 100 0.00 1.000 BIT_MASK 0x10 FORMAT "%5.3" ECU_ADDRESS 0x60037131 /end MEASUREMENT
/begin MEASUREMENT DFC_b.LDF_HEV03max "Bit encoding / Last debounced flag bit for check DFC_HEV03max" UBYTE DFC_OneToOne 1 100 0.00 1.000 BIT_MASK 0x10 FORMAT "%5.3" ECU_ADDRESS 0x60037132 /end MEASUREMENT
/begin MEASUREMENT DFC_b.LDF_HEVE0max "Bit encoding / Last debounced flag bit for check DFC_HEVE0max" UBYTE DFC_OneToOne 1 100 0.00 1.000 BIT_MASK 0x10 FORMAT "%5.3" ECU_ADDRESS 0x60037133 /end MEASUREMENT
/begin MEASUREMENT DFC_b.LDF_HEVE1max "Bit encoding / Last debounced flag bit for check DFC_HEVE1max" UBYTE DFC_OneToOne 1 100 0.00 1.000 BIT_MASK 0x10 FORMAT "%5.3" ECU_ADDRESS 0x60037134 /end MEASUREMENT
/begin MEASUREMENT DFC_b.LDF_HFMmax "Bit encoding / Last debounced flag bit for check DFC_HFMmax" UBYTE DFC_OneToOne 1 100 0.00 1.000 BIT_MASK 0x10 FORMAT "%5.3" ECU_ADDRESS 0x60037135 /end MEASUREMENT
/begin MEASUREMENT DFC_b.LDF_HiPSysHiPMaxLimExcdd "Bit encoding / Last debounced flag bit for check DFC_HiPSysHiPMaxLimExcdd" UBYTE DFC_OneToOne 1 100 0.00 1.000 BIT_MASK 0x10 FORMAT "%5.3" ECU_ADDRESS 0x60037136 /end MEASUREMENT
/begin MEASUREMENT DFC_b.LDF_IVGdiCtlCvoErrMax_0 "Bit encoding / Last debounced flag bit for check DFC_IVGdiCtlCvoErrMax_0" UBYTE DFC_OneToOne 1 100 0.00 1.000 BIT_MASK 0x10 FORMAT "%5.3" ECU_ADDRESS 0x60037137 /end MEASUREMENT
/begin MEASUREMENT DFC_b.LDF_IVGdiCtlCvoErrMax_1 "Bit encoding / Last debounced flag bit for check DFC_IVGdiCtlCvoErrMax_1" UBYTE DFC_OneToOne 1 100 0.00 1.000 BIT_MASK 0x10 FORMAT "%5.3" ECU_ADDRESS 0x60037138 /end MEASUREMENT
/begin MEASUREMENT DFC_b.LDF_IVGdiCtlCvoErrMax_2 "Bit encoding / Last debounced flag bit for check DFC_IVGdiCtlCvoErrMax_2" UBYTE DFC_OneToOne 1 100 0.00 1.000 BIT_MASK 0x10 FORMAT "%5.3" ECU_ADDRESS 0x60037139 /end MEASUREMENT
/begin MEASUREMENT DFC_b.LDF_IVGdiCtlCvoErrMax_3 "Bit encoding / Last debounced flag bit for check DFC_IVGdiCtlCvoErrMax_3" UBYTE DFC_OneToOne 1 100 0.00 1.000 BIT_MASK 0x10 FORMAT "%5.3" ECU_ADDRESS 0x6003713A /end MEASUREMENT
/begin MEASUREMENT DFC_b.LDF_IVGdiCtlCvoErrMin_0 "Bit encoding / Last debounced flag bit for check DFC_IVGdiCtlCvoErrMin_0" UBYTE DFC_OneToOne 1 100 0.00 1.000 BIT_MASK 0x10 FORMAT "%5.3" ECU_ADDRESS 0x6003713B /end MEASUREMENT
/begin MEASUREMENT DFC_b.LDF_IVGdiCtlCvoErrMin_1 "Bit encoding / Last debounced flag bit for check DFC_IVGdiCtlCvoErrMin_1" UBYTE DFC_OneToOne 1 100 0.00 1.000 BIT_MASK 0x10 FORMAT "%5.3" ECU_ADDRESS 0x6003713C /end MEASUREMENT
/begin MEASUREMENT DFC_b.LDF_IVGdiCtlCvoErrMin_2 "Bit encoding / Last debounced flag bit for check DFC_IVGdiCtlCvoErrMin_2" UBYTE DFC_OneToOne 1 100 0.00 1.000 BIT_MASK 0x10 FORMAT "%5.3" ECU_ADDRESS 0x6003713D /end MEASUREMENT
/begin MEASUREMENT DFC_b.LDF_IVGdiCtlCvoErrMin_3 "Bit encoding / Last debounced flag bit for check DFC_IVGdiCtlCvoErrMin_3" UBYTE DFC_OneToOne 1 100 0.00 1.000 BIT_MASK 0x10 FORMAT "%5.3" ECU_ADDRESS 0x6003713E /end MEASUREMENT
/begin MEASUREMENT DFC_b.LDF_IVGdiCtlCvoErrMinMax "Bit encoding / Last debounced flag bit for check DFC_IVGdiCtlCvoErrMinMax" UBYTE DFC_OneToOne 1 100 0.00 1.000 BIT_MASK 0x10 FORMAT "%5.3" ECU_ADDRESS 0x6003713F /end MEASUREMENT
/begin MEASUREMENT DFC_b.LDF_IVGdiCtlCvoSigPlausErrSmrCdn "Bit encoding / Last debounced flag bit for check DFC_IVGdiCtlCvoSigPlausErrSmrCdn" UBYTE DFC_OneToOne 1 100 0.00 1.000 BIT_MASK 0x10 FORMAT "%5.3" ECU_ADDRESS 0x60037140 /end MEASUREMENT
/begin MEASUREMENT DFC_b.LDF_IVGdiCtl_CvoErr "Bit encoding / Last debounced flag bit for check DFC_IVGdiCtl_CvoErr" UBYTE DFC_OneToOne 1 100 0.00 1.000 BIT_MASK 0x10 FORMAT "%5.3" ECU_ADDRESS 0x60037141 /end MEASUREMENT
/begin MEASUREMENT DFC_b.LDF_IVGdiCtl_CvoSigPlaus_0 "Bit encoding / Last debounced flag bit for check DFC_IVGdiCtl_CvoSigPlaus_0" UBYTE DFC_OneToOne 1 100 0.00 1.000 BIT_MASK 0x10 FORMAT "%5.3" ECU_ADDRESS 0x60037142 /end MEASUREMENT
/begin MEASUREMENT DFC_b.LDF_IVGdiCtl_CvoSigPlaus_1 "Bit encoding / Last debounced flag bit for check DFC_IVGdiCtl_CvoSigPlaus_1" UBYTE DFC_OneToOne 1 100 0.00 1.000 BIT_MASK 0x10 FORMAT "%5.3" ECU_ADDRESS 0x60037143 /end MEASUREMENT
/begin MEASUREMENT DFC_b.LDF_IVGdiCtl_CvoSigPlaus_2 "Bit encoding / Last debounced flag bit for check DFC_IVGdiCtl_CvoSigPlaus_2" UBYTE DFC_OneToOne 1 100 0.00 1.000 BIT_MASK 0x10 FORMAT "%5.3" ECU_ADDRESS 0x60037144 /end MEASUREMENT
/begin MEASUREMENT DFC_b.LDF_IVGdiCtl_CvoSigPlaus_3 "Bit encoding / Last debounced flag bit for check DFC_IVGdiCtl_CvoSigPlaus_3" UBYTE DFC_OneToOne 1 100 0.00 1.000 BIT_MASK 0x10 FORMAT "%5.3" ECU_ADDRESS 0x60037145 /end MEASUREMENT
/begin MEASUREMENT DFC_b.LDF_IntkAirTAirFltDsCrssMax "Bit encoding / Last debounced flag bit for check DFC_IntkAirTAirFltDsCrssMax" UBYTE DFC_OneToOne 1 100 0.00 1.000 BIT_MASK 0x10 FORMAT "%5.3" ECU_ADDRESS 0x60037146 /end MEASUREMENT
/begin MEASUREMENT DFC_b.LDF_IntkAirTAirFltDsCrssMin "Bit encoding / Last debounced flag bit for check DFC_IntkAirTAirFltDsCrssMin" UBYTE DFC_OneToOne 1 100 0.00 1.000 BIT_MASK 0x10 FORMAT "%5.3" ECU_ADDRESS 0x60037147 /end MEASUREMENT
/begin MEASUREMENT DFC_b.LDF_IntkAirTAirFltDsHSCMax "Bit encoding / Last debounced flag bit for check DFC_IntkAirTAirFltDsHSCMax" UBYTE DFC_OneToOne 1 100 0.00 1.000 BIT_MASK 0x10 FORMAT "%5.3" ECU_ADDRESS 0x60037148 /end MEASUREMENT
/begin MEASUREMENT DFC_b.LDF_IntkAirTAirFltDsImps "Bit encoding / Last debounced flag bit for check DFC_IntkAirTAirFltDsImps" UBYTE DFC_OneToOne 1 100 0.00 1.000 BIT_MASK 0x10 FORMAT "%5.3" ECU_ADDRESS 0x60037149 /end MEASUREMENT
/begin MEASUREMENT DFC_b.LDF_IntkAirTAirFltDsPRCMax "Bit encoding / Last debounced flag bit for check DFC_IntkAirTAirFltDsPRCMax" UBYTE DFC_OneToOne 1 100 0.00 1.000 BIT_MASK 0x10 FORMAT "%5.3" ECU_ADDRESS 0x6003714A /end MEASUREMENT
/begin MEASUREMENT DFC_b.LDF_IntkAirTAirFltDsPRCMin "Bit encoding / Last debounced flag bit for check DFC_IntkAirTAirFltDsPRCMin" UBYTE DFC_OneToOne 1 100 0.00 1.000 BIT_MASK 0x10 FORMAT "%5.3" ECU_ADDRESS 0x6003714B /end MEASUREMENT
/begin MEASUREMENT DFC_b.LDF_IntkAirTAirFltDsSRCMax "Bit encoding / Last debounced flag bit for check DFC_IntkAirTAirFltDsSRCMax" UBYTE DFC_OneToOne 1 100 0.00 1.000 BIT_MASK 0x10 FORMAT "%5.3" ECU_ADDRESS 0x6003714C /end MEASUREMENT
/begin MEASUREMENT DFC_b.LDF_IntkAirTAirFltDsSRCMin "Bit encoding / Last debounced flag bit for check DFC_IntkAirTAirFltDsSRCMin" UBYTE DFC_OneToOne 1 100 0.00 1.000 BIT_MASK 0x10 FORMAT "%5.3" ECU_ADDRESS 0x6003714D /end MEASUREMENT
/begin MEASUREMENT DFC_b.LDF_IntkAirTAirFltDsSTC "Bit encoding / Last debounced flag bit for check DFC_IntkAirTAirFltDsSTC" UBYTE DFC_OneToOne 1 100 0.00 1.000 BIT_MASK 0x10 FORMAT "%5.3" ECU_ADDRESS 0x6003714E /end MEASUREMENT
/begin MEASUREMENT DFC_b.LDF_IntkAirTIntkMnfldCrssMax "Bit encoding / Last debounced flag bit for check DFC_IntkAirTIntkMnfldCrssMax" UBYTE DFC_OneToOne 1 100 0.00 1.000 BIT_MASK 0x10 FORMAT "%5.3" ECU_ADDRESS 0x6003714F /end MEASUREMENT
/begin MEASUREMENT DFC_b.LDF_IntkAirTIntkMnfldCrssMin "Bit encoding / Last debounced flag bit for check DFC_IntkAirTIntkMnfldCrssMin" UBYTE DFC_OneToOne 1 100 0.00 1.000 BIT_MASK 0x10 FORMAT "%5.3" ECU_ADDRESS 0x60037150 /end MEASUREMENT
/begin MEASUREMENT DFC_b.LDF_IntkAirTIntkMnfldHSCMax "Bit encoding / Last debounced flag bit for check DFC_IntkAirTIntkMnfldHSCMax" UBYTE DFC_OneToOne 1 100 0.00 1.000 BIT_MASK 0x10 FORMAT "%5.3" ECU_ADDRESS 0x60037151 /end MEASUREMENT
/begin MEASUREMENT DFC_b.LDF_IntkAirTIntkMnfldImps "Bit encoding / Last debounced flag bit for check DFC_IntkAirTIntkMnfldImps" UBYTE DFC_OneToOne 1 100 0.00 1.000 BIT_MASK 0x10 FORMAT "%5.3" ECU_ADDRESS 0x60037152 /end MEASUREMENT
/begin MEASUREMENT DFC_b.LDF_IntkAirTIntkMnfldPRCMax "Bit encoding / Last debounced flag bit for check DFC_IntkAirTIntkMnfldPRCMax" UBYTE DFC_OneToOne 1 100 0.00 1.000 BIT_MASK 0x10 FORMAT "%5.3" ECU_ADDRESS 0x60037153 /end MEASUREMENT
/begin MEASUREMENT DFC_b.LDF_IntkAirTIntkMnfldPRCMin "Bit encoding / Last debounced flag bit for check DFC_IntkAirTIntkMnfldPRCMin" UBYTE DFC_OneToOne 1 100 0.00 1.000 BIT_MASK 0x10 FORMAT "%5.3" ECU_ADDRESS 0x60037154 /end MEASUREMENT
/begin MEASUREMENT DFC_b.LDF_IntkAirTIntkMnfldSRCMax "Bit encoding / Last debounced flag bit for check DFC_IntkAirTIntkMnfldSRCMax" UBYTE DFC_OneToOne 1 100 0.00 1.000 BIT_MASK 0x10 FORMAT "%5.3" ECU_ADDRESS 0x60037155 /end MEASUREMENT
/begin MEASUREMENT DFC_b.LDF_IntkAirTIntkMnfldSRCMin "Bit encoding / Last debounced flag bit for check DFC_IntkAirTIntkMnfldSRCMin" UBYTE DFC_OneToOne 1 100 0.00 1.000 BIT_MASK 0x10 FORMAT "%5.3" ECU_ADDRESS 0x60037156 /end MEASUREMENT
/begin MEASUREMENT DFC_b.LDF_IntkAirTIntkMnfldSTC "Bit encoding / Last debounced flag bit for check DFC_IntkAirTIntkMnfldSTC" UBYTE DFC_OneToOne 1 100 0.00 1.000 BIT_MASK 0x10 FORMAT "%5.3" ECU_ADDRESS 0x60037157 /end MEASUREMENT
/begin MEASUREMENT DFC_b.LDF_KRREGRLMX "Bit encoding / Last debounced flag bit for check DFC_KRREGRLMX" UBYTE DFC_OneToOne 1 100 0.00 1.000 BIT_MASK 0x10 FORMAT "%5.3" ECU_ADDRESS 0x60037158 /end MEASUREMENT
/begin MEASUREMENT DFC_b.LDF_KRVEKOCVLCI "Bit encoding / Last debounced flag bit for check DFC_KRVEKOCVLCI" UBYTE DFC_OneToOne 1 100 0.00 1.000 BIT_MASK 0x10 FORMAT "%5.3" ECU_ADDRESS 0x60037159 /end MEASUREMENT
/begin MEASUREMENT DFC_b.LDF_KRVEKOENCHMT "Bit encoding / Last debounced flag bit for check DFC_KRVEKOENCHMT" UBYTE DFC_OneToOne 1 100 0.00 1.000 BIT_MASK 0x10 FORMAT "%5.3" ECU_ADDRESS 0x6003715A /end MEASUREMENT
/begin MEASUREMENT DFC_b.LDF_KRVEKOENCHMT0 "Bit encoding / Last debounced flag bit for check DFC_KRVEKOENCHMT0" UBYTE DFC_OneToOne 1 100 0.00 1.000 BIT_MASK 0x10 FORMAT "%5.3" ECU_ADDRESS 0x6003715B /end MEASUREMENT
/begin MEASUREMENT DFC_b.LDF_KRVEKOENCHMT1 "Bit encoding / Last debounced flag bit for check DFC_KRVEKOENCHMT1" UBYTE DFC_OneToOne 1 100 0.00 1.000 BIT_MASK 0x10 FORMAT "%5.3" ECU_ADDRESS 0x6003715C /end MEASUREMENT
/begin MEASUREMENT DFC_b.LDF_KRVEKOENCHMT2 "Bit encoding / Last debounced flag bit for check DFC_KRVEKOENCHMT2" UBYTE DFC_OneToOne 1 100 0.00 1.000 BIT_MASK 0x10 FORMAT "%5.3" ECU_ADDRESS 0x6003715D /end MEASUREMENT
/begin MEASUREMENT DFC_b.LDF_KRVEKOENCHMT3 "Bit encoding / Last debounced flag bit for check DFC_KRVEKOENCHMT3" UBYTE DFC_OneToOne 1 100 0.00 1.000 BIT_MASK 0x10 FORMAT "%5.3" ECU_ADDRESS 0x6003715E /end MEASUREMENT
/begin MEASUREMENT DFC_b.LDF_KRVEKOENCHMT4 "Bit encoding / Last debounced flag bit for check DFC_KRVEKOENCHMT4" UBYTE DFC_OneToOne 1 100 0.00 1.000 BIT_MASK 0x10 FORMAT "%5.3" ECU_ADDRESS 0x6003715F /end MEASUREMENT
/begin MEASUREMENT DFC_b.LDF_KRVEKOENCHMT5 "Bit encoding / Last debounced flag bit for check DFC_KRVEKOENCHMT5" UBYTE DFC_OneToOne 1 100 0.00 1.000 BIT_MASK 0x10 FORMAT "%5.3" ECU_ADDRESS 0x60037160 /end MEASUREMENT
/begin MEASUREMENT DFC_b.LDF_KRVEKOENCHMT6 "Bit encoding / Last debounced flag bit for check DFC_KRVEKOENCHMT6" UBYTE DFC_OneToOne 1 100 0.00 1.000 BIT_MASK 0x10 FORMAT "%5.3" ECU_ADDRESS 0x60037161 /end MEASUREMENT
/begin MEASUREMENT DFC_b.LDF_KRVEKOENCHMT7 "Bit encoding / Last debounced flag bit for check DFC_KRVEKOENCHMT7" UBYTE DFC_OneToOne 1 100 0.00 1.000 BIT_MASK 0x10 FORMAT "%5.3" ECU_ADDRESS 0x60037162 /end MEASUREMENT
/begin MEASUREMENT DFC_b.LDF_KRVEKORLMX "Bit encoding / Last debounced flag bit for check DFC_KRVEKORLMX" UBYTE DFC_OneToOne 1 100 0.00 1.000 BIT_MASK 0x10 FORMAT "%5.3" ECU_ADDRESS 0x60037163 /end MEASUREMENT
/begin MEASUREMENT DFC_b.LDF_KRVEKORLMXL "Bit encoding / Last debounced flag bit for check DFC_KRVEKORLMXL" UBYTE DFC_OneToOne 1 100 0.00 1.000 BIT_MASK 0x10 FORMAT "%5.3" ECU_ADDRESS 0x60037164 /end MEASUREMENT
/begin MEASUREMENT DFC_b.LDF_KS1max "Bit encoding / Last debounced flag bit for check DFC_KS1max" UBYTE DFC_OneToOne 1 100 0.00 1.000 BIT_MASK 0x10 FORMAT "%5.3" ECU_ADDRESS 0x60037165 /end MEASUREMENT
/begin MEASUREMENT DFC_b.LDF_KS1min "Bit encoding / Last debounced flag bit for check DFC_KS1min" UBYTE DFC_OneToOne 1 100 0.00 1.000 BIT_MASK 0x10 FORMAT "%5.3" ECU_ADDRESS 0x60037166 /end MEASUREMENT
/begin MEASUREMENT DFC_b.LDF_LMmax "Bit encoding / Last debounced flag bit for check DFC_LMmax" UBYTE DFC_OneToOne 1 100 0.00 1.000 BIT_MASK 0x10 FORMAT "%5.3" ECU_ADDRESS 0x60037167 /end MEASUREMENT
/begin MEASUREMENT DFC_b.LDF_LZSRnpl "Bit encoding / Last debounced flag bit for check DFC_LZSRnpl" UBYTE DFC_OneToOne 1 100 0.00 1.000 BIT_MASK 0x10 FORMAT "%5.3" ECU_ADDRESS 0x60037168 /end MEASUREMENT
/begin MEASUREMENT DFC_b.LDF_LamDynDiagS1B1 "Bit encoding / Last debounced flag bit for check DFC_LamDynDiagS1B1" UBYTE DFC_OneToOne 1 100 0.00 1.000 BIT_MASK 0x10 FORMAT "%5.3" ECU_ADDRESS 0x60037169 /end MEASUREMENT
/begin MEASUREMENT DFC_b.LDF_LeakIntkMnfldEmiInfl "Bit encoding / Last debounced flag bit for check DFC_LeakIntkMnfldEmiInfl" UBYTE DFC_OneToOne 1 100 0.00 1.000 BIT_MASK 0x10 FORMAT "%5.3" ECU_ADDRESS 0x6003716A /end MEASUREMENT
/begin MEASUREMENT DFC_b.LDF_LinFrameErrDCDC "Bit encoding / Last debounced flag bit for check DFC_LinFrameErrDCDC" UBYTE DFC_OneToOne 1 100 0.00 1.000 BIT_MASK 0x10 FORMAT "%5.3" ECU_ADDRESS 0x6003716B /end MEASUREMENT
/begin MEASUREMENT DFC_b.LDF_LinOverrunErrDCDC "Bit encoding / Last debounced flag bit for check DFC_LinOverrunErrDCDC" UBYTE DFC_OneToOne 1 100 0.00 1.000 BIT_MASK 0x10 FORMAT "%5.3" ECU_ADDRESS 0x6003716C /end MEASUREMENT
/begin MEASUREMENT DFC_b.LDF_MD00max "Bit encoding / Last debounced flag bit for check DFC_MD00max" UBYTE DFC_OneToOne 1 100 0.00 1.000 BIT_MASK 0x10 FORMAT "%5.3" ECU_ADDRESS 0x6003716D /end MEASUREMENT
/begin MEASUREMENT DFC_b.LDF_MDBmax "Bit encoding / Last debounced flag bit for check DFC_MDBmax" UBYTE DFC_OneToOne 1 100 0.00 1.000 BIT_MASK 0x10 FORMAT "%5.3" ECU_ADDRESS 0x6003716E /end MEASUREMENT
/begin MEASUREMENT DFC_b.LDF_MDCat "Bit encoding / Last debounced flag bit for check DFC_MDCat" UBYTE DFC_OneToOne 1 100 0.00 1.000 BIT_MASK 0x10 FORMAT "%5.3" ECU_ADDRESS 0x6003716F /end MEASUREMENT
/begin MEASUREMENT DFC_b.LDF_MDCatCrit "Bit encoding / Last debounced flag bit for check DFC_MDCatCrit" UBYTE DFC_OneToOne 1 100 0.00 1.000 BIT_MASK 0x10 FORMAT "%5.3" ECU_ADDRESS 0x60037170 /end MEASUREMENT
/begin MEASUREMENT DFC_b.LDF_MDCatCurr "Bit encoding / Last debounced flag bit for check DFC_MDCatCurr" UBYTE DFC_OneToOne 1 100 0.00 1.000 BIT_MASK 0x10 FORMAT "%5.3" ECU_ADDRESS 0x60037171 /end MEASUREMENT
/begin MEASUREMENT DFC_b.LDF_MDCyl_0 "Bit encoding / Last debounced flag bit for check DFC_MDCyl_0" UBYTE DFC_OneToOne 1 100 0.00 1.000 BIT_MASK 0x10 FORMAT "%5.3" ECU_ADDRESS 0x60037172 /end MEASUREMENT
/begin MEASUREMENT DFC_b.LDF_MDCyl_1 "Bit encoding / Last debounced flag bit for check DFC_MDCyl_1" UBYTE DFC_OneToOne 1 100 0.00 1.000 BIT_MASK 0x10 FORMAT "%5.3" ECU_ADDRESS 0x60037173 /end MEASUREMENT
/begin MEASUREMENT DFC_b.LDF_MDCyl_2 "Bit encoding / Last debounced flag bit for check DFC_MDCyl_2" UBYTE DFC_OneToOne 1 100 0.00 1.000 BIT_MASK 0x10 FORMAT "%5.3" ECU_ADDRESS 0x60037174 /end MEASUREMENT
/begin MEASUREMENT DFC_b.LDF_MDCyl_3 "Bit encoding / Last debounced flag bit for check DFC_MDCyl_3" UBYTE DFC_OneToOne 1 100 0.00 1.000 BIT_MASK 0x10 FORMAT "%5.3" ECU_ADDRESS 0x60037175 /end MEASUREMENT
/begin MEASUREMENT DFC_b.LDF_MDEmi "Bit encoding / Last debounced flag bit for check DFC_MDEmi" UBYTE DFC_OneToOne 1 100 0.00 1.000 BIT_MASK 0x10 FORMAT "%5.3" ECU_ADDRESS 0x60037176 /end MEASUREMENT
/begin MEASUREMENT DFC_b.LDF_MDEmiStrt "Bit encoding / Last debounced flag bit for check DFC_MDEmiStrt" UBYTE DFC_OneToOne 1 100 0.00 1.000 BIT_MASK 0x10 FORMAT "%5.3" ECU_ADDRESS 0x60037177 /end MEASUREMENT
/begin MEASUREMENT DFC_b.LDF_MDFco "Bit encoding / Last debounced flag bit for check DFC_MDFco" UBYTE DFC_OneToOne 1 100 0.00 1.000 BIT_MASK 0x10 FORMAT "%5.3" ECU_ADDRESS 0x60037178 /end MEASUREMENT
/begin MEASUREMENT DFC_b.LDF_MDMpl "Bit encoding / Last debounced flag bit for check DFC_MDMpl" UBYTE DFC_OneToOne 1 100 0.00 1.000 BIT_MASK 0x10 FORMAT "%5.3" ECU_ADDRESS 0x60037179 /end MEASUREMENT
/begin MEASUREMENT DFC_b.LDF_MDSegTiAdpn "Bit encoding / Last debounced flag bit for check DFC_MDSegTiAdpn" UBYTE DFC_OneToOne 1 100 0.00 1.000 BIT_MASK 0x10 FORMAT "%5.3" ECU_ADDRESS 0x6003717A /end MEASUREMENT
/begin MEASUREMENT DFC_b.LDF_MDmax "Bit encoding / Last debounced flag bit for check DFC_MDmax" UBYTE DFC_OneToOne 1 100 0.00 1.000 BIT_MASK 0x10 FORMAT "%5.3" ECU_ADDRESS 0x6003717B /end MEASUREMENT
/begin MEASUREMENT DFC_b.LDF_MFuOilMax "Bit encoding / Last debounced flag bit for check DFC_MFuOilMax" UBYTE DFC_OneToOne 1 100 0.00 1.000 BIT_MASK 0x10 FORMAT "%5.3" ECU_ADDRESS 0x6003717C /end MEASUREMENT
/begin MEASUREMENT DFC_b.LDF_MOXEMM_SMU_ALM0_0 "Bit encoding / Last debounced flag bit for check DFC_MOXEMM_SMU_ALM0_0" UBYTE DFC_OneToOne 1 100 0.00 1.000 BIT_MASK 0x10 FORMAT "%5.3" ECU_ADDRESS 0x6003717D /end MEASUREMENT
/begin MEASUREMENT DFC_b.LDF_MOXEMM_SMU_ALM0_1 "Bit encoding / Last debounced flag bit for check DFC_MOXEMM_SMU_ALM0_1" UBYTE DFC_OneToOne 1 100 0.00 1.000 BIT_MASK 0x10 FORMAT "%5.3" ECU_ADDRESS 0x6003717E /end MEASUREMENT
/begin MEASUREMENT DFC_b.LDF_MOXEMM_SMU_ALM0_10 "Bit encoding / Last debounced flag bit for check DFC_MOXEMM_SMU_ALM0_10" UBYTE DFC_OneToOne 1 100 0.00 1.000 BIT_MASK 0x10 FORMAT "%5.3" ECU_ADDRESS 0x6003717F /end MEASUREMENT
/begin MEASUREMENT DFC_b.LDF_MOXEMM_SMU_ALM0_11 "Bit encoding / Last debounced flag bit for check DFC_MOXEMM_SMU_ALM0_11" UBYTE DFC_OneToOne 1 100 0.00 1.000 BIT_MASK 0x10 FORMAT "%5.3" ECU_ADDRESS 0x60037180 /end MEASUREMENT
/begin MEASUREMENT DFC_b.LDF_MOXEMM_SMU_ALM0_13 "Bit encoding / Last debounced flag bit for check DFC_MOXEMM_SMU_ALM0_13" UBYTE DFC_OneToOne 1 100 0.00 1.000 BIT_MASK 0x10 FORMAT "%5.3" ECU_ADDRESS 0x60037181 /end MEASUREMENT
/begin MEASUREMENT DFC_b.LDF_MOXEMM_SMU_ALM0_14 "Bit encoding / Last debounced flag bit for check DFC_MOXEMM_SMU_ALM0_14" UBYTE DFC_OneToOne 1 100 0.00 1.000 BIT_MASK 0x10 FORMAT "%5.3" ECU_ADDRESS 0x60037182 /end MEASUREMENT
/begin MEASUREMENT DFC_b.LDF_MOXEMM_SMU_ALM0_2 "Bit encoding / Last debounced flag bit for check DFC_MOXEMM_SMU_ALM0_2" UBYTE DFC_OneToOne 1 100 0.00 1.000 BIT_MASK 0x10 FORMAT "%5.3" ECU_ADDRESS 0x60037183 /end MEASUREMENT
/begin MEASUREMENT DFC_b.LDF_MOXEMM_SMU_ALM0_22 "Bit encoding / Last debounced flag bit for check DFC_MOXEMM_SMU_ALM0_22" UBYTE DFC_OneToOne 1 100 0.00 1.000 BIT_MASK 0x10 FORMAT "%5.3" ECU_ADDRESS 0x60037184 /end MEASUREMENT
/begin MEASUREMENT DFC_b.LDF_MOXEMM_SMU_ALM0_23 "Bit encoding / Last debounced flag bit for check DFC_MOXEMM_SMU_ALM0_23" UBYTE DFC_OneToOne 1 100 0.00 1.000 BIT_MASK 0x10 FORMAT "%5.3" ECU_ADDRESS 0x60037185 /end MEASUREMENT
/begin MEASUREMENT DFC_b.LDF_MOXEMM_SMU_ALM0_4 "Bit encoding / Last debounced flag bit for check DFC_MOXEMM_SMU_ALM0_4" UBYTE DFC_OneToOne 1 100 0.00 1.000 BIT_MASK 0x10 FORMAT "%5.3" ECU_ADDRESS 0x60037186 /end MEASUREMENT
/begin MEASUREMENT DFC_b.LDF_MOXEMM_SMU_ALM0_5 "Bit encoding / Last debounced flag bit for check DFC_MOXEMM_SMU_ALM0_5" UBYTE DFC_OneToOne 1 100 0.00 1.000 BIT_MASK 0x10 FORMAT "%5.3" ECU_ADDRESS 0x60037187 /end MEASUREMENT
/begin MEASUREMENT DFC_b.LDF_MOXEMM_SMU_ALM0_7 "Bit encoding / Last debounced flag bit for check DFC_MOXEMM_SMU_ALM0_7" UBYTE DFC_OneToOne 1 100 0.00 1.000 BIT_MASK 0x10 FORMAT "%5.3" ECU_ADDRESS 0x60037188 /end MEASUREMENT
/begin MEASUREMENT DFC_b.LDF_MOXEMM_SMU_ALM0_8 "Bit encoding / Last debounced flag bit for check DFC_MOXEMM_SMU_ALM0_8" UBYTE DFC_OneToOne 1 100 0.00 1.000 BIT_MASK 0x10 FORMAT "%5.3" ECU_ADDRESS 0x60037189 /end MEASUREMENT
/begin MEASUREMENT DFC_b.LDF_MOXEMM_SMU_ALM10_16 "Bit encoding / Last debounced flag bit for check DFC_MOXEMM_SMU_ALM10_16" UBYTE DFC_OneToOne 1 100 0.00 1.000 BIT_MASK 0x10 FORMAT "%5.3" ECU_ADDRESS 0x6003718A /end MEASUREMENT
/begin MEASUREMENT DFC_b.LDF_MOXEMM_SMU_ALM10_17 "Bit encoding / Last debounced flag bit for check DFC_MOXEMM_SMU_ALM10_17" UBYTE DFC_OneToOne 1 100 0.00 1.000 BIT_MASK 0x10 FORMAT "%5.3" ECU_ADDRESS 0x6003718B /end MEASUREMENT
/begin MEASUREMENT DFC_b.LDF_MOXEMM_SMU_ALM10_21 "Bit encoding / Last debounced flag bit for check DFC_MOXEMM_SMU_ALM10_21" UBYTE DFC_OneToOne 1 100 0.00 1.000 BIT_MASK 0x10 FORMAT "%5.3" ECU_ADDRESS 0x6003718C /end MEASUREMENT
/begin MEASUREMENT DFC_b.LDF_MOXEMM_SMU_ALM11_0 "Bit encoding / Last debounced flag bit for check DFC_MOXEMM_SMU_ALM11_0" UBYTE DFC_OneToOne 1 100 0.00 1.000 BIT_MASK 0x10 FORMAT "%5.3" ECU_ADDRESS 0x6003718D /end MEASUREMENT
/begin MEASUREMENT DFC_b.LDF_MOXEMM_SMU_ALM11_1 "Bit encoding / Last debounced flag bit for check DFC_MOXEMM_SMU_ALM11_1" UBYTE DFC_OneToOne 1 100 0.00 1.000 BIT_MASK 0x10 FORMAT "%5.3" ECU_ADDRESS 0x6003718E /end MEASUREMENT
/begin MEASUREMENT DFC_b.LDF_MOXEMM_SMU_ALM11_2 "Bit encoding / Last debounced flag bit for check DFC_MOXEMM_SMU_ALM11_2" UBYTE DFC_OneToOne 1 100 0.00 1.000 BIT_MASK 0x10 FORMAT "%5.3" ECU_ADDRESS 0x6003718F /end MEASUREMENT
/begin MEASUREMENT DFC_b.LDF_MOXEMM_SMU_ALM11_3 "Bit encoding / Last debounced flag bit for check DFC_MOXEMM_SMU_ALM11_3" UBYTE DFC_OneToOne 1 100 0.00 1.000 BIT_MASK 0x10 FORMAT "%5.3" ECU_ADDRESS 0x60037190 /end MEASUREMENT
/begin MEASUREMENT DFC_b.LDF_MOXEMM_SMU_ALM11_4 "Bit encoding / Last debounced flag bit for check DFC_MOXEMM_SMU_ALM11_4" UBYTE DFC_OneToOne 1 100 0.00 1.000 BIT_MASK 0x10 FORMAT "%5.3" ECU_ADDRESS 0x60037191 /end MEASUREMENT
/begin MEASUREMENT DFC_b.LDF_MOXEMM_SMU_ALM11_5 "Bit encoding / Last debounced flag bit for check DFC_MOXEMM_SMU_ALM11_5" UBYTE DFC_OneToOne 1 100 0.00 1.000 BIT_MASK 0x10 FORMAT "%5.3" ECU_ADDRESS 0x60037192 /end MEASUREMENT
/begin MEASUREMENT DFC_b.LDF_MOXEMM_SMU_ALM11_8 "Bit encoding / Last debounced flag bit for check DFC_MOXEMM_SMU_ALM11_8" UBYTE DFC_OneToOne 1 100 0.00 1.000 BIT_MASK 0x10 FORMAT "%5.3" ECU_ADDRESS 0x60037193 /end MEASUREMENT
/begin MEASUREMENT DFC_b.LDF_MOXEMM_SMU_ALM11_9 "Bit encoding / Last debounced flag bit for check DFC_MOXEMM_SMU_ALM11_9" UBYTE DFC_OneToOne 1 100 0.00 1.000 BIT_MASK 0x10 FORMAT "%5.3" ECU_ADDRESS 0x60037194 /end MEASUREMENT
/begin MEASUREMENT DFC_b.LDF_MOXEMM_SMU_ALM1_0 "Bit encoding / Last debounced flag bit for check DFC_MOXEMM_SMU_ALM1_0" UBYTE DFC_OneToOne 1 100 0.00 1.000 BIT_MASK 0x10 FORMAT "%5.3" ECU_ADDRESS 0x60037195 /end MEASUREMENT
/begin MEASUREMENT DFC_b.LDF_MOXEMM_SMU_ALM1_1 "Bit encoding / Last debounced flag bit for check DFC_MOXEMM_SMU_ALM1_1" UBYTE DFC_OneToOne 1 100 0.00 1.000 BIT_MASK 0x10 FORMAT "%5.3" ECU_ADDRESS 0x60037196 /end MEASUREMENT
/begin MEASUREMENT DFC_b.LDF_MOXEMM_SMU_ALM1_10 "Bit encoding / Last debounced flag bit for check DFC_MOXEMM_SMU_ALM1_10" UBYTE DFC_OneToOne 1 100 0.00 1.000 BIT_MASK 0x10 FORMAT "%5.3" ECU_ADDRESS 0x60037197 /end MEASUREMENT
/begin MEASUREMENT DFC_b.LDF_MOXEMM_SMU_ALM1_11 "Bit encoding / Last debounced flag bit for check DFC_MOXEMM_SMU_ALM1_11" UBYTE DFC_OneToOne 1 100 0.00 1.000 BIT_MASK 0x10 FORMAT "%5.3" ECU_ADDRESS 0x60037198 /end MEASUREMENT
/begin MEASUREMENT DFC_b.LDF_MOXEMM_SMU_ALM1_13 "Bit encoding / Last debounced flag bit for check DFC_MOXEMM_SMU_ALM1_13" UBYTE DFC_OneToOne 1 100 0.00 1.000 BIT_MASK 0x10 FORMAT "%5.3" ECU_ADDRESS 0x60037199 /end MEASUREMENT
/begin MEASUREMENT DFC_b.LDF_MOXEMM_SMU_ALM1_14 "Bit encoding / Last debounced flag bit for check DFC_MOXEMM_SMU_ALM1_14" UBYTE DFC_OneToOne 1 100 0.00 1.000 BIT_MASK 0x10 FORMAT "%5.3" ECU_ADDRESS 0x6003719A /end MEASUREMENT
/begin MEASUREMENT DFC_b.LDF_MOXEMM_SMU_ALM1_2 "Bit encoding / Last debounced flag bit for check DFC_MOXEMM_SMU_ALM1_2" UBYTE DFC_OneToOne 1 100 0.00 1.000 BIT_MASK 0x10 FORMAT "%5.3" ECU_ADDRESS 0x6003719B /end MEASUREMENT
/begin MEASUREMENT DFC_b.LDF_MOXEMM_SMU_ALM1_22 "Bit encoding / Last debounced flag bit for check DFC_MOXEMM_SMU_ALM1_22" UBYTE DFC_OneToOne 1 100 0.00 1.000 BIT_MASK 0x10 FORMAT "%5.3" ECU_ADDRESS 0x6003719C /end MEASUREMENT
/begin MEASUREMENT DFC_b.LDF_MOXEMM_SMU_ALM1_23 "Bit encoding / Last debounced flag bit for check DFC_MOXEMM_SMU_ALM1_23" UBYTE DFC_OneToOne 1 100 0.00 1.000 BIT_MASK 0x10 FORMAT "%5.3" ECU_ADDRESS 0x6003719D /end MEASUREMENT
/begin MEASUREMENT DFC_b.LDF_MOXEMM_SMU_ALM1_4 "Bit encoding / Last debounced flag bit for check DFC_MOXEMM_SMU_ALM1_4" UBYTE DFC_OneToOne 1 100 0.00 1.000 BIT_MASK 0x10 FORMAT "%5.3" ECU_ADDRESS 0x6003719E /end MEASUREMENT
/begin MEASUREMENT DFC_b.LDF_MOXEMM_SMU_ALM1_5 "Bit encoding / Last debounced flag bit for check DFC_MOXEMM_SMU_ALM1_5" UBYTE DFC_OneToOne 1 100 0.00 1.000 BIT_MASK 0x10 FORMAT "%5.3" ECU_ADDRESS 0x6003719F /end MEASUREMENT
/begin MEASUREMENT DFC_b.LDF_MOXEMM_SMU_ALM1_7 "Bit encoding / Last debounced flag bit for check DFC_MOXEMM_SMU_ALM1_7" UBYTE DFC_OneToOne 1 100 0.00 1.000 BIT_MASK 0x10 FORMAT "%5.3" ECU_ADDRESS 0x600371A0 /end MEASUREMENT
/begin MEASUREMENT DFC_b.LDF_MOXEMM_SMU_ALM1_8 "Bit encoding / Last debounced flag bit for check DFC_MOXEMM_SMU_ALM1_8" UBYTE DFC_OneToOne 1 100 0.00 1.000 BIT_MASK 0x10 FORMAT "%5.3" ECU_ADDRESS 0x600371A1 /end MEASUREMENT
/begin MEASUREMENT DFC_b.LDF_MOXEMM_SMU_ALM21_0 "Bit encoding / Last debounced flag bit for check DFC_MOXEMM_SMU_ALM21_0" UBYTE DFC_OneToOne 1 100 0.00 1.000 BIT_MASK 0x10 FORMAT "%5.3" ECU_ADDRESS 0x600371A2 /end MEASUREMENT
/begin MEASUREMENT DFC_b.LDF_MOXEMM_SMU_ALM21_16 "Bit encoding / Last debounced flag bit for check DFC_MOXEMM_SMU_ALM21_16" UBYTE DFC_OneToOne 1 100 0.00 1.000 BIT_MASK 0x10 FORMAT "%5.3" ECU_ADDRESS 0x600371A3 /end MEASUREMENT
/begin MEASUREMENT DFC_b.LDF_MOXEMM_SMU_ALM21_3 "Bit encoding / Last debounced flag bit for check DFC_MOXEMM_SMU_ALM21_3" UBYTE DFC_OneToOne 1 100 0.00 1.000 BIT_MASK 0x10 FORMAT "%5.3" ECU_ADDRESS 0x600371A4 /end MEASUREMENT
/begin MEASUREMENT DFC_b.LDF_MOXEMM_SMU_ALM2_1 "Bit encoding / Last debounced flag bit for check DFC_MOXEMM_SMU_ALM2_1" UBYTE DFC_OneToOne 1 100 0.00 1.000 BIT_MASK 0x10 FORMAT "%5.3" ECU_ADDRESS 0x600371A5 /end MEASUREMENT
/begin MEASUREMENT DFC_b.LDF_MOXEMM_SMU_ALM2_10 "Bit encoding / Last debounced flag bit for check DFC_MOXEMM_SMU_ALM2_10" UBYTE DFC_OneToOne 1 100 0.00 1.000 BIT_MASK 0x10 FORMAT "%5.3" ECU_ADDRESS 0x600371A6 /end MEASUREMENT
/begin MEASUREMENT DFC_b.LDF_MOXEMM_SMU_ALM2_11 "Bit encoding / Last debounced flag bit for check DFC_MOXEMM_SMU_ALM2_11" UBYTE DFC_OneToOne 1 100 0.00 1.000 BIT_MASK 0x10 FORMAT "%5.3" ECU_ADDRESS 0x600371A7 /end MEASUREMENT
/begin MEASUREMENT DFC_b.LDF_MOXEMM_SMU_ALM2_13 "Bit encoding / Last debounced flag bit for check DFC_MOXEMM_SMU_ALM2_13" UBYTE DFC_OneToOne 1 100 0.00 1.000 BIT_MASK 0x10 FORMAT "%5.3" ECU_ADDRESS 0x600371A8 /end MEASUREMENT
/begin MEASUREMENT DFC_b.LDF_MOXEMM_SMU_ALM2_14 "Bit encoding / Last debounced flag bit for check DFC_MOXEMM_SMU_ALM2_14" UBYTE DFC_OneToOne 1 100 0.00 1.000 BIT_MASK 0x10 FORMAT "%5.3" ECU_ADDRESS 0x600371A9 /end MEASUREMENT
/begin MEASUREMENT DFC_b.LDF_MOXEMM_SMU_ALM2_22 "Bit encoding / Last debounced flag bit for check DFC_MOXEMM_SMU_ALM2_22" UBYTE DFC_OneToOne 1 100 0.00 1.000 BIT_MASK 0x10 FORMAT "%5.3" ECU_ADDRESS 0x600371AA /end MEASUREMENT
/begin MEASUREMENT DFC_b.LDF_MOXEMM_SMU_ALM2_23 "Bit encoding / Last debounced flag bit for check DFC_MOXEMM_SMU_ALM2_23" UBYTE DFC_OneToOne 1 100 0.00 1.000 BIT_MASK 0x10 FORMAT "%5.3" ECU_ADDRESS 0x600371AB /end MEASUREMENT
/begin MEASUREMENT DFC_b.LDF_MOXEMM_SMU_ALM2_4 "Bit encoding / Last debounced flag bit for check DFC_MOXEMM_SMU_ALM2_4" UBYTE DFC_OneToOne 1 100 0.00 1.000 BIT_MASK 0x10 FORMAT "%5.3" ECU_ADDRESS 0x600371AC /end MEASUREMENT
/begin MEASUREMENT DFC_b.LDF_MOXEMM_SMU_ALM2_5 "Bit encoding / Last debounced flag bit for check DFC_MOXEMM_SMU_ALM2_5" UBYTE DFC_OneToOne 1 100 0.00 1.000 BIT_MASK 0x10 FORMAT "%5.3" ECU_ADDRESS 0x600371AD /end MEASUREMENT
/begin MEASUREMENT DFC_b.LDF_MOXEMM_SMU_ALM2_7 "Bit encoding / Last debounced flag bit for check DFC_MOXEMM_SMU_ALM2_7" UBYTE DFC_OneToOne 1 100 0.00 1.000 BIT_MASK 0x10 FORMAT "%5.3" ECU_ADDRESS 0x600371AE /end MEASUREMENT
/begin MEASUREMENT DFC_b.LDF_MOXEMM_SMU_ALM2_8 "Bit encoding / Last debounced flag bit for check DFC_MOXEMM_SMU_ALM2_8" UBYTE DFC_OneToOne 1 100 0.00 1.000 BIT_MASK 0x10 FORMAT "%5.3" ECU_ADDRESS 0x600371AF /end MEASUREMENT
/begin MEASUREMENT DFC_b.LDF_MOXEMM_SMU_ALM6_0 "Bit encoding / Last debounced flag bit for check DFC_MOXEMM_SMU_ALM6_0" UBYTE DFC_OneToOne 1 100 0.00 1.000 BIT_MASK 0x10 FORMAT "%5.3" ECU_ADDRESS 0x600371B0 /end MEASUREMENT
/begin MEASUREMENT DFC_b.LDF_MOXEMM_SMU_ALM6_11 "Bit encoding / Last debounced flag bit for check DFC_MOXEMM_SMU_ALM6_11" UBYTE DFC_OneToOne 1 100 0.00 1.000 BIT_MASK 0x10 FORMAT "%5.3" ECU_ADDRESS 0x600371B1 /end MEASUREMENT
/begin MEASUREMENT DFC_b.LDF_MOXEMM_SMU_ALM6_12 "Bit encoding / Last debounced flag bit for check DFC_MOXEMM_SMU_ALM6_12" UBYTE DFC_OneToOne 1 100 0.00 1.000 BIT_MASK 0x10 FORMAT "%5.3" ECU_ADDRESS 0x600371B2 /end MEASUREMENT
/begin MEASUREMENT DFC_b.LDF_MOXEMM_SMU_ALM6_14 "Bit encoding / Last debounced flag bit for check DFC_MOXEMM_SMU_ALM6_14" UBYTE DFC_OneToOne 1 100 0.00 1.000 BIT_MASK 0x10 FORMAT "%5.3" ECU_ADDRESS 0x600371B3 /end MEASUREMENT
/begin MEASUREMENT DFC_b.LDF_MOXEMM_SMU_ALM6_15 "Bit encoding / Last debounced flag bit for check DFC_MOXEMM_SMU_ALM6_15" UBYTE DFC_OneToOne 1 100 0.00 1.000 BIT_MASK 0x10 FORMAT "%5.3" ECU_ADDRESS 0x600371B4 /end MEASUREMENT
/begin MEASUREMENT DFC_b.LDF_MOXEMM_SMU_ALM6_17 "Bit encoding / Last debounced flag bit for check DFC_MOXEMM_SMU_ALM6_17" UBYTE DFC_OneToOne 1 100 0.00 1.000 BIT_MASK 0x10 FORMAT "%5.3" ECU_ADDRESS 0x600371B5 /end MEASUREMENT
/begin MEASUREMENT DFC_b.LDF_MOXEMM_SMU_ALM6_18 "Bit encoding / Last debounced flag bit for check DFC_MOXEMM_SMU_ALM6_18" UBYTE DFC_OneToOne 1 100 0.00 1.000 BIT_MASK 0x10 FORMAT "%5.3" ECU_ADDRESS 0x600371B6 /end MEASUREMENT
/begin MEASUREMENT DFC_b.LDF_MOXEMM_SMU_ALM6_20 "Bit encoding / Last debounced flag bit for check DFC_MOXEMM_SMU_ALM6_20" UBYTE DFC_OneToOne 1 100 0.00 1.000 BIT_MASK 0x10 FORMAT "%5.3" ECU_ADDRESS 0x600371B7 /end MEASUREMENT
/begin MEASUREMENT DFC_b.LDF_MOXEMM_SMU_ALM6_21 "Bit encoding / Last debounced flag bit for check DFC_MOXEMM_SMU_ALM6_21" UBYTE DFC_OneToOne 1 100 0.00 1.000 BIT_MASK 0x10 FORMAT "%5.3" ECU_ADDRESS 0x600371B8 /end MEASUREMENT
/begin MEASUREMENT DFC_b.LDF_MOXEMM_SMU_ALM6_25 "Bit encoding / Last debounced flag bit for check DFC_MOXEMM_SMU_ALM6_25" UBYTE DFC_OneToOne 1 100 0.00 1.000 BIT_MASK 0x10 FORMAT "%5.3" ECU_ADDRESS 0x600371B9 /end MEASUREMENT
/begin MEASUREMENT DFC_b.LDF_MOXEMM_SMU_ALM6_4 "Bit encoding / Last debounced flag bit for check DFC_MOXEMM_SMU_ALM6_4" UBYTE DFC_OneToOne 1 100 0.00 1.000 BIT_MASK 0x10 FORMAT "%5.3" ECU_ADDRESS 0x600371BA /end MEASUREMENT
/begin MEASUREMENT DFC_b.LDF_MOXEMM_SMU_ALM6_5 "Bit encoding / Last debounced flag bit for check DFC_MOXEMM_SMU_ALM6_5" UBYTE DFC_OneToOne 1 100 0.00 1.000 BIT_MASK 0x10 FORMAT "%5.3" ECU_ADDRESS 0x600371BB /end MEASUREMENT
/begin MEASUREMENT DFC_b.LDF_MOXEMM_SMU_ALM6_7 "Bit encoding / Last debounced flag bit for check DFC_MOXEMM_SMU_ALM6_7" UBYTE DFC_OneToOne 1 100 0.00 1.000 BIT_MASK 0x10 FORMAT "%5.3" ECU_ADDRESS 0x600371BC /end MEASUREMENT
/begin MEASUREMENT DFC_b.LDF_MOXEMM_SMU_ALM6_8 "Bit encoding / Last debounced flag bit for check DFC_MOXEMM_SMU_ALM6_8" UBYTE DFC_OneToOne 1 100 0.00 1.000 BIT_MASK 0x10 FORMAT "%5.3" ECU_ADDRESS 0x600371BD /end MEASUREMENT
/begin MEASUREMENT DFC_b.LDF_MOXEMM_SMU_ALM7_1 "Bit encoding / Last debounced flag bit for check DFC_MOXEMM_SMU_ALM7_1" UBYTE DFC_OneToOne 1 100 0.00 1.000 BIT_MASK 0x10 FORMAT "%5.3" ECU_ADDRESS 0x600371BE /end MEASUREMENT
/begin MEASUREMENT DFC_b.LDF_MOXEMM_SMU_ALM7_12 "Bit encoding / Last debounced flag bit for check DFC_MOXEMM_SMU_ALM7_12" UBYTE DFC_OneToOne 1 100 0.00 1.000 BIT_MASK 0x10 FORMAT "%5.3" ECU_ADDRESS 0x600371BF /end MEASUREMENT
/begin MEASUREMENT DFC_b.LDF_MOXEMM_SMU_ALM7_13 "Bit encoding / Last debounced flag bit for check DFC_MOXEMM_SMU_ALM7_13" UBYTE DFC_OneToOne 1 100 0.00 1.000 BIT_MASK 0x10 FORMAT "%5.3" ECU_ADDRESS 0x600371C0 /end MEASUREMENT
/begin MEASUREMENT DFC_b.LDF_MOXEMM_SMU_ALM7_14 "Bit encoding / Last debounced flag bit for check DFC_MOXEMM_SMU_ALM7_14" UBYTE DFC_OneToOne 1 100 0.00 1.000 BIT_MASK 0x10 FORMAT "%5.3" ECU_ADDRESS 0x600371C1 /end MEASUREMENT
/begin MEASUREMENT DFC_b.LDF_MOXEMM_SMU_ALM7_15 "Bit encoding / Last debounced flag bit for check DFC_MOXEMM_SMU_ALM7_15" UBYTE DFC_OneToOne 1 100 0.00 1.000 BIT_MASK 0x10 FORMAT "%5.3" ECU_ADDRESS 0x600371C2 /end MEASUREMENT
/begin MEASUREMENT DFC_b.LDF_MOXEMM_SMU_ALM7_16 "Bit encoding / Last debounced flag bit for check DFC_MOXEMM_SMU_ALM7_16" UBYTE DFC_OneToOne 1 100 0.00 1.000 BIT_MASK 0x10 FORMAT "%5.3" ECU_ADDRESS 0x600371C3 /end MEASUREMENT
/begin MEASUREMENT DFC_b.LDF_MOXEMM_SMU_ALM7_17 "Bit encoding / Last debounced flag bit for check DFC_MOXEMM_SMU_ALM7_17" UBYTE DFC_OneToOne 1 100 0.00 1.000 BIT_MASK 0x10 FORMAT "%5.3" ECU_ADDRESS 0x600371C4 /end MEASUREMENT
/begin MEASUREMENT DFC_b.LDF_MOXEMM_SMU_ALM7_2 "Bit encoding / Last debounced flag bit for check DFC_MOXEMM_SMU_ALM7_2" UBYTE DFC_OneToOne 1 100 0.00 1.000 BIT_MASK 0x10 FORMAT "%5.3" ECU_ADDRESS 0x600371C5 /end MEASUREMENT
/begin MEASUREMENT DFC_b.LDF_MOXEMM_SMU_ALM7_20 "Bit encoding / Last debounced flag bit for check DFC_MOXEMM_SMU_ALM7_20" UBYTE DFC_OneToOne 1 100 0.00 1.000 BIT_MASK 0x10 FORMAT "%5.3" ECU_ADDRESS 0x600371C6 /end MEASUREMENT
/begin MEASUREMENT DFC_b.LDF_MOXEMM_SMU_ALM7_25 "Bit encoding / Last debounced flag bit for check DFC_MOXEMM_SMU_ALM7_25" UBYTE DFC_OneToOne 1 100 0.00 1.000 BIT_MASK 0x10 FORMAT "%5.3" ECU_ADDRESS 0x600371C7 /end MEASUREMENT
/begin MEASUREMENT DFC_b.LDF_MOXEMM_SMU_ALM7_26 "Bit encoding / Last debounced flag bit for check DFC_MOXEMM_SMU_ALM7_26" UBYTE DFC_OneToOne 1 100 0.00 1.000 BIT_MASK 0x10 FORMAT "%5.3" ECU_ADDRESS 0x600371C8 /end MEASUREMENT
/begin MEASUREMENT DFC_b.LDF_MOXEMM_SMU_ALM7_28 "Bit encoding / Last debounced flag bit for check DFC_MOXEMM_SMU_ALM7_28" UBYTE DFC_OneToOne 1 100 0.00 1.000 BIT_MASK 0x10 FORMAT "%5.3" ECU_ADDRESS 0x600371C9 /end MEASUREMENT
/begin MEASUREMENT DFC_b.LDF_MOXEMM_SMU_ALM7_29 "Bit encoding / Last debounced flag bit for check DFC_MOXEMM_SMU_ALM7_29" UBYTE DFC_OneToOne 1 100 0.00 1.000 BIT_MASK 0x10 FORMAT "%5.3" ECU_ADDRESS 0x600371CA /end MEASUREMENT
/begin MEASUREMENT DFC_b.LDF_MOXEMM_SMU_ALM7_30 "Bit encoding / Last debounced flag bit for check DFC_MOXEMM_SMU_ALM7_30" UBYTE DFC_OneToOne 1 100 0.00 1.000 BIT_MASK 0x10 FORMAT "%5.3" ECU_ADDRESS 0x600371CB /end MEASUREMENT
/begin MEASUREMENT DFC_b.LDF_MOXEMM_SMU_ALM7_31 "Bit encoding / Last debounced flag bit for check DFC_MOXEMM_SMU_ALM7_31" UBYTE DFC_OneToOne 1 100 0.00 1.000 BIT_MASK 0x10 FORMAT "%5.3" ECU_ADDRESS 0x600371CC /end MEASUREMENT
/begin MEASUREMENT DFC_b.LDF_MOXEMM_SMU_ALM8_0 "Bit encoding / Last debounced flag bit for check DFC_MOXEMM_SMU_ALM8_0" UBYTE DFC_OneToOne 1 100 0.00 1.000 BIT_MASK 0x10 FORMAT "%5.3" ECU_ADDRESS 0x600371CD /end MEASUREMENT
/begin MEASUREMENT DFC_b.LDF_MOXEMM_SMU_ALM8_1 "Bit encoding / Last debounced flag bit for check DFC_MOXEMM_SMU_ALM8_1" UBYTE DFC_OneToOne 1 100 0.00 1.000 BIT_MASK 0x10 FORMAT "%5.3" ECU_ADDRESS 0x600371CE /end MEASUREMENT
/begin MEASUREMENT DFC_b.LDF_MOXEMM_SMU_ALM8_10 "Bit encoding / Last debounced flag bit for check DFC_MOXEMM_SMU_ALM8_10" UBYTE DFC_OneToOne 1 100 0.00 1.000 BIT_MASK 0x10 FORMAT "%5.3" ECU_ADDRESS 0x600371CF /end MEASUREMENT
/begin MEASUREMENT DFC_b.LDF_MOXEMM_SMU_ALM8_11 "Bit encoding / Last debounced flag bit for check DFC_MOXEMM_SMU_ALM8_11" UBYTE DFC_OneToOne 1 100 0.00 1.000 BIT_MASK 0x10 FORMAT "%5.3" ECU_ADDRESS 0x600371D0 /end MEASUREMENT
/begin MEASUREMENT DFC_b.LDF_MOXEMM_SMU_ALM8_12 "Bit encoding / Last debounced flag bit for check DFC_MOXEMM_SMU_ALM8_12" UBYTE DFC_OneToOne 1 100 0.00 1.000 BIT_MASK 0x10 FORMAT "%5.3" ECU_ADDRESS 0x600371D1 /end MEASUREMENT
/begin MEASUREMENT DFC_b.LDF_MOXEMM_SMU_ALM8_16 "Bit encoding / Last debounced flag bit for check DFC_MOXEMM_SMU_ALM8_16" UBYTE DFC_OneToOne 1 100 0.00 1.000 BIT_MASK 0x10 FORMAT "%5.3" ECU_ADDRESS 0x600371D2 /end MEASUREMENT
/begin MEASUREMENT DFC_b.LDF_MOXEMM_SMU_ALM8_18 "Bit encoding / Last debounced flag bit for check DFC_MOXEMM_SMU_ALM8_18" UBYTE DFC_OneToOne 1 100 0.00 1.000 BIT_MASK 0x10 FORMAT "%5.3" ECU_ADDRESS 0x600371D3 /end MEASUREMENT
/begin MEASUREMENT DFC_b.LDF_MOXEMM_SMU_ALM8_2 "Bit encoding / Last debounced flag bit for check DFC_MOXEMM_SMU_ALM8_2" UBYTE DFC_OneToOne 1 100 0.00 1.000 BIT_MASK 0x10 FORMAT "%5.3" ECU_ADDRESS 0x600371D4 /end MEASUREMENT
/begin MEASUREMENT DFC_b.LDF_MOXEMM_SMU_ALM8_3 "Bit encoding / Last debounced flag bit for check DFC_MOXEMM_SMU_ALM8_3" UBYTE DFC_OneToOne 1 100 0.00 1.000 BIT_MASK 0x10 FORMAT "%5.3" ECU_ADDRESS 0x600371D5 /end MEASUREMENT
/begin MEASUREMENT DFC_b.LDF_MOXEMM_SMU_ALM8_31 "Bit encoding / Last debounced flag bit for check DFC_MOXEMM_SMU_ALM8_31" UBYTE DFC_OneToOne 1 100 0.00 1.000 BIT_MASK 0x10 FORMAT "%5.3" ECU_ADDRESS 0x600371D6 /end MEASUREMENT
/begin MEASUREMENT DFC_b.LDF_MOXEMM_SMU_ALM8_4 "Bit encoding / Last debounced flag bit for check DFC_MOXEMM_SMU_ALM8_4" UBYTE DFC_OneToOne 1 100 0.00 1.000 BIT_MASK 0x10 FORMAT "%5.3" ECU_ADDRESS 0x600371D7 /end MEASUREMENT
/begin MEASUREMENT DFC_b.LDF_MOXEMM_SMU_ALM9_0 "Bit encoding / Last debounced flag bit for check DFC_MOXEMM_SMU_ALM9_0" UBYTE DFC_OneToOne 1 100 0.00 1.000 BIT_MASK 0x10 FORMAT "%5.3" ECU_ADDRESS 0x600371D8 /end MEASUREMENT
/begin MEASUREMENT DFC_b.LDF_MOXEMM_SMU_ALM9_15 "Bit encoding / Last debounced flag bit for check DFC_MOXEMM_SMU_ALM9_15" UBYTE DFC_OneToOne 1 100 0.00 1.000 BIT_MASK 0x10 FORMAT "%5.3" ECU_ADDRESS 0x600371D9 /end MEASUREMENT
/begin MEASUREMENT DFC_b.LDF_MOXEMM_SMU_ALM9_3 "Bit encoding / Last debounced flag bit for check DFC_MOXEMM_SMU_ALM9_3" UBYTE DFC_OneToOne 1 100 0.00 1.000 BIT_MASK 0x10 FORMAT "%5.3" ECU_ADDRESS 0x600371DA /end MEASUREMENT
/begin MEASUREMENT DFC_b.LDF_MoCADCNTP "Bit encoding / Last debounced flag bit for check DFC_MoCADCNTP" UBYTE DFC_OneToOne 1 100 0.00 1.000 BIT_MASK 0x10 FORMAT "%5.3" ECU_ADDRESS 0x600371DB /end MEASUREMENT
/begin MEASUREMENT DFC_b.LDF_MoCADCTst "Bit encoding / Last debounced flag bit for check DFC_MoCADCTst" UBYTE DFC_OneToOne 1 100 0.00 1.000 BIT_MASK 0x10 FORMAT "%5.3" ECU_ADDRESS 0x600371DC /end MEASUREMENT
/begin MEASUREMENT DFC_b.LDF_MoCSOPICO "Bit encoding / Last debounced flag bit for check DFC_MoCSOPICO" UBYTE DFC_OneToOne 1 100 0.00 1.000 BIT_MASK 0x10 FORMAT "%5.3" ECU_ADDRESS 0x600371DD /end MEASUREMENT
/begin MEASUREMENT DFC_b.LDF_MoFAPP "Bit encoding / Last debounced flag bit for check DFC_MoFAPP" UBYTE DFC_OneToOne 1 100 0.00 1.000 BIT_MASK 0x10 FORMAT "%5.3" ECU_ADDRESS 0x600371DE /end MEASUREMENT
/begin MEASUREMENT DFC_b.LDF_MoFAirFilgPrdc "Bit encoding / Last debounced flag bit for check DFC_MoFAirFilgPrdc" UBYTE DFC_OneToOne 1 100 0.00 1.000 BIT_MASK 0x10 FORMAT "%5.3" ECU_ADDRESS 0x600371DF /end MEASUREMENT
/begin MEASUREMENT DFC_b.LDF_MoFAirFlCtOffGdi "Bit encoding / Last debounced flag bit for check DFC_MoFAirFlCtOffGdi" UBYTE DFC_OneToOne 1 100 0.00 1.000 BIT_MASK 0x10 FORMAT "%5.3" ECU_ADDRESS 0x600371E0 /end MEASUREMENT
/begin MEASUREMENT DFC_b.LDF_MoFAirFlCylGdi "Bit encoding / Last debounced flag bit for check DFC_MoFAirFlCylGdi" UBYTE DFC_OneToOne 1 100 0.00 1.000 BIT_MASK 0x10 FORMAT "%5.3" ECU_ADDRESS 0x600371E1 /end MEASUREMENT
/begin MEASUREMENT DFC_b.LDF_MoFAirFlFF "Bit encoding / Last debounced flag bit for check DFC_MoFAirFlFF" UBYTE DFC_OneToOne 1 100 0.00 1.000 BIT_MASK 0x10 FORMAT "%5.3" ECU_ADDRESS 0x600371E2 /end MEASUREMENT
/begin MEASUREMENT DFC_b.LDF_MoFAirFlIn "Bit encoding / Last debounced flag bit for check DFC_MoFAirFlIn" UBYTE DFC_OneToOne 1 100 0.00 1.000 BIT_MASK 0x10 FORMAT "%5.3" ECU_ADDRESS 0x600371E3 /end MEASUREMENT
/begin MEASUREMENT DFC_b.LDF_MoFAirFlMixCtlGdiChkAirFl "Bit encoding / Last debounced flag bit for check DFC_MoFAirFlMixCtlGdiChkAirFl" UBYTE DFC_OneToOne 1 100 0.00 1.000 BIT_MASK 0x10 FORMAT "%5.3" ECU_ADDRESS 0x600371E4 /end MEASUREMENT
/begin MEASUREMENT DFC_b.LDF_MoFAirFlMixCtlGdiChkCtrl "Bit encoding / Last debounced flag bit for check DFC_MoFAirFlMixCtlGdiChkCtrl" UBYTE DFC_OneToOne 1 100 0.00 1.000 BIT_MASK 0x10 FORMAT "%5.3" ECU_ADDRESS 0x600371E5 /end MEASUREMENT
/begin MEASUREMENT DFC_b.LDF_MoFAirFlMode "Bit encoding / Last debounced flag bit for check DFC_MoFAirFlMode" UBYTE DFC_OneToOne 1 100 0.00 1.000 BIT_MASK 0x10 FORMAT "%5.3" ECU_ADDRESS 0x600371E6 /end MEASUREMENT
/begin MEASUREMENT DFC_b.LDF_MoFESpd "Bit encoding / Last debounced flag bit for check DFC_MoFESpd" UBYTE DFC_OneToOne 1 100 0.00 1.000 BIT_MASK 0x10 FORMAT "%5.3" ECU_ADDRESS 0x600371E7 /end MEASUREMENT
/begin MEASUREMENT DFC_b.LDF_MoFIACo "Bit encoding / Last debounced flag bit for check DFC_MoFIACo" UBYTE DFC_OneToOne 1 100 0.00 1.000 BIT_MASK 0x10 FORMAT "%5.3" ECU_ADDRESS 0x600371E8 /end MEASUREMENT
/begin MEASUREMENT DFC_b.LDF_MoFICOL1 "Bit encoding / Last debounced flag bit for check DFC_MoFICOL1" UBYTE DFC_OneToOne 1 100 0.00 1.000 BIT_MASK 0x10 FORMAT "%5.3" ECU_ADDRESS 0x600371E9 /end MEASUREMENT
/begin MEASUREMENT DFC_b.LDF_MoFICOL2 "Bit encoding / Last debounced flag bit for check DFC_MoFICOL2" UBYTE DFC_OneToOne 1 100 0.00 1.000 BIT_MASK 0x10 FORMAT "%5.3" ECU_ADDRESS 0x600371EA /end MEASUREMENT
/begin MEASUREMENT DFC_b.LDF_MoFStrt "Bit encoding / Last debounced flag bit for check DFC_MoFStrt" UBYTE DFC_OneToOne 1 100 0.00 1.000 BIT_MASK 0x10 FORMAT "%5.3" ECU_ADDRESS 0x600371EB /end MEASUREMENT
/begin MEASUREMENT DFC_b.LDF_MoFTrqCmp "Bit encoding / Last debounced flag bit for check DFC_MoFTrqCmp" UBYTE DFC_OneToOne 1 100 0.00 1.000 BIT_MASK 0x10 FORMAT "%5.3" ECU_ADDRESS 0x600371EC /end MEASUREMENT
/begin MEASUREMENT DFC_b.LDF_MoFTrqCmpMax "Bit encoding / Last debounced flag bit for check DFC_MoFTrqCmpMax" UBYTE DFC_OneToOne 1 100 0.00 1.000 BIT_MASK 0x10 FORMAT "%5.3" ECU_ADDRESS 0x600371ED /end MEASUREMENT
/begin MEASUREMENT DFC_b.LDF_MoFTrqCmpMin "Bit encoding / Last debounced flag bit for check DFC_MoFTrqCmpMin" UBYTE DFC_OneToOne 1 100 0.00 1.000 BIT_MASK 0x10 FORMAT "%5.3" ECU_ADDRESS 0x600371EE /end MEASUREMENT
/begin MEASUREMENT DFC_b.LDF_MoFVarPostBldSel "Bit encoding / Last debounced flag bit for check DFC_MoFVarPostBldSel" UBYTE DFC_OneToOne 1 100 0.00 1.000 BIT_MASK 0x10 FORMAT "%5.3" ECU_ADDRESS 0x600371EF /end MEASUREMENT
/begin MEASUREMENT DFC_b.LDF_MoXEMMHwLTMCUFW "Bit encoding / Last debounced flag bit for check DFC_MoXEMMHwLTMCUFW" UBYTE DFC_OneToOne 1 100 0.00 1.000 BIT_MASK 0x10 FORMAT "%5.3" ECU_ADDRESS 0x600371F0 /end MEASUREMENT
/begin MEASUREMENT DFC_b.LDF_MoXEMMHwLTMonBIST "Bit encoding / Last debounced flag bit for check DFC_MoXEMMHwLTMonBIST" UBYTE DFC_OneToOne 1 100 0.00 1.000 BIT_MASK 0x10 FORMAT "%5.3" ECU_ADDRESS 0x600371F1 /end MEASUREMENT
/begin MEASUREMENT DFC_b.LDF_MoXEMMHwLTRegMonTest "Bit encoding / Last debounced flag bit for check DFC_MoXEMMHwLTRegMonTest" UBYTE DFC_OneToOne 1 100 0.00 1.000 BIT_MASK 0x10 FORMAT "%5.3" ECU_ADDRESS 0x600371F2 /end MEASUREMENT
/begin MEASUREMENT DFC_b.LDF_MoXEMMHwLTStbySMUAlvTest "Bit encoding / Last debounced flag bit for check DFC_MoXEMMHwLTStbySMUAlvTest" UBYTE DFC_OneToOne 1 100 0.00 1.000 BIT_MASK 0x10 FORMAT "%5.3" ECU_ADDRESS 0x600371F3 /end MEASUREMENT
/begin MEASUREMENT DFC_b.LDF_MoXEMMHwLTTempSens "Bit encoding / Last debounced flag bit for check DFC_MoXEMMHwLTTempSens" UBYTE DFC_OneToOne 1 100 0.00 1.000 BIT_MASK 0x10 FORMAT "%5.3" ECU_ADDRESS 0x600371F4 /end MEASUREMENT
/begin MEASUREMENT DFC_b.LDF_MoXEMMHwLTUCBCfg "Bit encoding / Last debounced flag bit for check DFC_MoXEMMHwLTUCBCfg" UBYTE DFC_OneToOne 1 100 0.00 1.000 BIT_MASK 0x10 FORMAT "%5.3" ECU_ADDRESS 0x600371F5 /end MEASUREMENT
/begin MEASUREMENT DFC_b.LDF_NWSEmax "Bit encoding / Last debounced flag bit for check DFC_NWSEmax" UBYTE DFC_OneToOne 1 100 0.00 1.000 BIT_MASK 0x10 FORMAT "%5.3" ECU_ADDRESS 0x600371F6 /end MEASUREMENT
/begin MEASUREMENT DFC_b.LDF_NWSmax "Bit encoding / Last debounced flag bit for check DFC_NWSmax" UBYTE DFC_OneToOne 1 100 0.00 1.000 BIT_MASK 0x10 FORMAT "%5.3" ECU_ADDRESS 0x600371F7 /end MEASUREMENT
/begin MEASUREMENT DFC_b.LDF_OCWDAABEActv "Bit encoding / Last debounced flag bit for check DFC_OCWDAABEActv" UBYTE DFC_OneToOne 1 100 0.00 1.000 BIT_MASK 0x10 FORMAT "%5.3" ECU_ADDRESS 0x600371F8 /end MEASUREMENT
/begin MEASUREMENT DFC_b.LDF_OCWDACom "Bit encoding / Last debounced flag bit for check DFC_OCWDACom" UBYTE DFC_OneToOne 1 100 0.00 1.000 BIT_MASK 0x10 FORMAT "%5.3" ECU_ADDRESS 0x600371F9 /end MEASUREMENT
/begin MEASUREMENT DFC_b.LDF_OCWDAErrPin "Bit encoding / Last debounced flag bit for check DFC_OCWDAErrPin" UBYTE DFC_OneToOne 1 100 0.00 1.000 BIT_MASK 0x10 FORMAT "%5.3" ECU_ADDRESS 0x600371FA /end MEASUREMENT
/begin MEASUREMENT DFC_b.LDF_OCWDAOvrVltg "Bit encoding / Last debounced flag bit for check DFC_OCWDAOvrVltg" UBYTE DFC_OneToOne 1 100 0.00 1.000 BIT_MASK 0x10 FORMAT "%5.3" ECU_ADDRESS 0x600371FB /end MEASUREMENT
/begin MEASUREMENT DFC_b.LDF_ORAmax "Bit encoding / Last debounced flag bit for check DFC_ORAmax" UBYTE DFC_OneToOne 1 100 0.00 1.000 BIT_MASK 0x10 FORMAT "%5.3" ECU_ADDRESS 0x600371FC /end MEASUREMENT
/begin MEASUREMENT DFC_b.LDF_ORAmin "Bit encoding / Last debounced flag bit for check DFC_ORAmin" UBYTE DFC_OneToOne 1 100 0.00 1.000 BIT_MASK 0x10 FORMAT "%5.3" ECU_ADDRESS 0x600371FD /end MEASUREMENT
/begin MEASUREMENT DFC_b.LDF_OilPPlaus "Bit encoding / Last debounced flag bit for check DFC_OilPPlaus" UBYTE DFC_OneToOne 1 100 0.00 1.000 BIT_MASK 0x10 FORMAT "%5.3" ECU_ADDRESS 0x600371FE /end MEASUREMENT
/begin MEASUREMENT DFC_b.LDF_PLLSUmax "Bit encoding / Last debounced flag bit for check DFC_PLLSUmax" UBYTE DFC_OneToOne 1 100 0.00 1.000 BIT_MASK 0x10 FORMAT "%5.3" ECU_ADDRESS 0x600371FF /end MEASUREMENT
/begin MEASUREMENT DFC_b.LDF_PLLSUmin "Bit encoding / Last debounced flag bit for check DFC_PLLSUmin" UBYTE DFC_OneToOne 1 100 0.00 1.000 BIT_MASK 0x10 FORMAT "%5.3" ECU_ADDRESS 0x60037200 /end MEASUREMENT
/begin MEASUREMENT DFC_b.LDF_PSR1max "Bit encoding / Last debounced flag bit for check DFC_PSR1max" UBYTE DFC_OneToOne 1 100 0.00 1.000 BIT_MASK 0x10 FORMAT "%5.3" ECU_ADDRESS 0x60037201 /end MEASUREMENT
/begin MEASUREMENT DFC_b.LDF_PSRBmax "Bit encoding / Last debounced flag bit for check DFC_PSRBmax" UBYTE DFC_OneToOne 1 100 0.00 1.000 BIT_MASK 0x10 FORMAT "%5.3" ECU_ADDRESS 0x60037202 /end MEASUREMENT
/begin MEASUREMENT DFC_b.LDF_PSRBmin "Bit encoding / Last debounced flag bit for check DFC_PSRBmin" UBYTE DFC_OneToOne 1 100 0.00 1.000 BIT_MASK 0x10 FORMAT "%5.3" ECU_ADDRESS 0x60037203 /end MEASUREMENT
/begin MEASUREMENT DFC_b.LDF_PSRPmax "Bit encoding / Last debounced flag bit for check DFC_PSRPmax" UBYTE DFC_OneToOne 1 100 0.00 1.000 BIT_MASK 0x10 FORMAT "%5.3" ECU_ADDRESS 0x60037204 /end MEASUREMENT
/begin MEASUREMENT DFC_b.LDF_PSRPmin "Bit encoding / Last debounced flag bit for check DFC_PSRPmin" UBYTE DFC_OneToOne 1 100 0.00 1.000 BIT_MASK 0x10 FORMAT "%5.3" ECU_ADDRESS 0x60037205 /end MEASUREMENT
/begin MEASUREMENT DFC_b.LDF_PSRPsig "Bit encoding / Last debounced flag bit for check DFC_PSRPsig" UBYTE DFC_OneToOne 1 100 0.00 1.000 BIT_MASK 0x10 FORMAT "%5.3" ECU_ADDRESS 0x60037206 /end MEASUREMENT
/begin MEASUREMENT DFC_b.LDF_PSRmax "Bit encoding / Last debounced flag bit for check DFC_PSRmax" UBYTE DFC_OneToOne 1 100 0.00 1.000 BIT_MASK 0x10 FORMAT "%5.3" ECU_ADDRESS 0x60037207 /end MEASUREMENT
/begin MEASUREMENT DFC_b.LDF_PUmax "Bit encoding / Last debounced flag bit for check DFC_PUmax" UBYTE DFC_OneToOne 1 100 0.00 1.000 BIT_MASK 0x10 FORMAT "%5.3" ECU_ADDRESS 0x60037208 /end MEASUREMENT
/begin MEASUREMENT DFC_b.LDF_P_VSE11_OL "Bit encoding / Last debounced flag bit for check DFC_P_VSE11_OL" UBYTE DFC_OneToOne 1 100 0.00 1.000 BIT_MASK 0x10 FORMAT "%5.3" ECU_ADDRESS 0x60037209 /end MEASUREMENT
/begin MEASUREMENT DFC_b.LDF_P_VSE11_SCB "Bit encoding / Last debounced flag bit for check DFC_P_VSE11_SCB" UBYTE DFC_OneToOne 1 100 0.00 1.000 BIT_MASK 0x10 FORMAT "%5.3" ECU_ADDRESS 0x6003720A /end MEASUREMENT
/begin MEASUREMENT DFC_b.LDF_P_VSE11_SCG "Bit encoding / Last debounced flag bit for check DFC_P_VSE11_SCG" UBYTE DFC_OneToOne 1 100 0.00 1.000 BIT_MASK 0x10 FORMAT "%5.3" ECU_ADDRESS 0x6003720B /end MEASUREMENT
/begin MEASUREMENT DFC_b.LDF_PhyHighAPP1 "Bit encoding / Last debounced flag bit for check DFC_PhyHighAPP1" UBYTE DFC_OneToOne 1 100 0.00 1.000 BIT_MASK 0x10 FORMAT "%5.3" ECU_ADDRESS 0x6003720C /end MEASUREMENT
/begin MEASUREMENT DFC_b.LDF_PhyHighAPP2 "Bit encoding / Last debounced flag bit for check DFC_PhyHighAPP2" UBYTE DFC_OneToOne 1 100 0.00 1.000 BIT_MASK 0x10 FORMAT "%5.3" ECU_ADDRESS 0x6003720D /end MEASUREMENT
/begin MEASUREMENT DFC_b.LDF_PhyLowAPP1 "Bit encoding / Last debounced flag bit for check DFC_PhyLowAPP1" UBYTE DFC_OneToOne 1 100 0.00 1.000 BIT_MASK 0x10 FORMAT "%5.3" ECU_ADDRESS 0x6003720E /end MEASUREMENT
/begin MEASUREMENT DFC_b.LDF_PhyLowAPP2 "Bit encoding / Last debounced flag bit for check DFC_PhyLowAPP2" UBYTE DFC_OneToOne 1 100 0.00 1.000 BIT_MASK 0x10 FORMAT "%5.3" ECU_ADDRESS 0x6003720F /end MEASUREMENT
/begin MEASUREMENT DFC_b.LDF_SRCHighAPP1 "Bit encoding / Last debounced flag bit for check DFC_SRCHighAPP1" UBYTE DFC_OneToOne 1 100 0.00 1.000 BIT_MASK 0x10 FORMAT "%5.3" ECU_ADDRESS 0x60037210 /end MEASUREMENT
/begin MEASUREMENT DFC_b.LDF_SRCHighAPP2 "Bit encoding / Last debounced flag bit for check DFC_SRCHighAPP2" UBYTE DFC_OneToOne 1 100 0.00 1.000 BIT_MASK 0x10 FORMAT "%5.3" ECU_ADDRESS 0x60037211 /end MEASUREMENT
/begin MEASUREMENT DFC_b.LDF_SRCLowAPP1 "Bit encoding / Last debounced flag bit for check DFC_SRCLowAPP1" UBYTE DFC_OneToOne 1 100 0.00 1.000 BIT_MASK 0x10 FORMAT "%5.3" ECU_ADDRESS 0x60037212 /end MEASUREMENT
/begin MEASUREMENT DFC_b.LDF_SRCLowAPP2 "Bit encoding / Last debounced flag bit for check DFC_SRCLowAPP2" UBYTE DFC_OneToOne 1 100 0.00 1.000 BIT_MASK 0x10 FORMAT "%5.3" ECU_ADDRESS 0x60037213 /end MEASUREMENT
/begin MEASUREMENT DFC_b.LDF_SSpMon2 "Bit encoding / Last debounced flag bit for check DFC_SSpMon2" UBYTE DFC_OneToOne 1 100 0.00 1.000 BIT_MASK 0x10 FORMAT "%5.3" ECU_ADDRESS 0x60037214 /end MEASUREMENT
/begin MEASUREMENT DFC_b.LDF_STHDRmax "Bit encoding / Last debounced flag bit for check DFC_STHDRmax" UBYTE DFC_OneToOne 1 100 0.00 1.000 BIT_MASK 0x10 FORMAT "%5.3" ECU_ADDRESS 0x60037215 /end MEASUREMENT
/begin MEASUREMENT DFC_b.LDF_SWReset_0 "Bit encoding / Last debounced flag bit for check DFC_SWReset_0" UBYTE DFC_OneToOne 1 100 0.00 1.000 BIT_MASK 0x10 FORMAT "%5.3" ECU_ADDRESS 0x60037216 /end MEASUREMENT
/begin MEASUREMENT DFC_b.LDF_SWReset_1 "Bit encoding / Last debounced flag bit for check DFC_SWReset_1" UBYTE DFC_OneToOne 1 100 0.00 1.000 BIT_MASK 0x10 FORMAT "%5.3" ECU_ADDRESS 0x60037217 /end MEASUREMENT
/begin MEASUREMENT DFC_b.LDF_SWReset_2 "Bit encoding / Last debounced flag bit for check DFC_SWReset_2" UBYTE DFC_OneToOne 1 100 0.00 1.000 BIT_MASK 0x10 FORMAT "%5.3" ECU_ADDRESS 0x60037218 /end MEASUREMENT
/begin MEASUREMENT DFC_b.LDF_SyncAPP "Bit encoding / Last debounced flag bit for check DFC_SyncAPP" UBYTE DFC_OneToOne 1 100 0.00 1.000 BIT_MASK 0x10 FORMAT "%5.3" ECU_ADDRESS 0x60037219 /end MEASUREMENT
/begin MEASUREMENT DFC_b.LDF_TANKLnpl "Bit encoding / Last debounced flag bit for check DFC_TANKLnpl" UBYTE DFC_OneToOne 1 100 0.00 1.000 BIT_MASK 0x10 FORMAT "%5.3" ECU_ADDRESS 0x6003721A /end MEASUREMENT
/begin MEASUREMENT DFC_b.LDF_TAmax_Dummy "Bit encoding / Last debounced flag bit for check DFC_TAmax_Dummy" UBYTE DFC_OneToOne 1 100 0.00 1.000 BIT_MASK 0x10 FORMAT "%5.3" ECU_ADDRESS 0x6003721B /end MEASUREMENT
/begin MEASUREMENT DFC_b.LDF_TESFmax "Bit encoding / Last debounced flag bit for check DFC_TESFmax" UBYTE DFC_OneToOne 1 100 0.00 1.000 BIT_MASK 0x10 FORMAT "%5.3" ECU_ADDRESS 0x6003721C /end MEASUREMENT
/begin MEASUREMENT DFC_b.LDF_TESGmax "Bit encoding / Last debounced flag bit for check DFC_TESGmax" UBYTE DFC_OneToOne 1 100 0.00 1.000 BIT_MASK 0x10 FORMAT "%5.3" ECU_ADDRESS 0x6003721D /end MEASUREMENT
/begin MEASUREMENT DFC_b.LDF_TKAEmax "Bit encoding / Last debounced flag bit for check DFC_TKAEmax" UBYTE DFC_OneToOne 1 100 0.00 1.000 BIT_MASK 0x10 FORMAT "%5.3" ECU_ADDRESS 0x6003721E /end MEASUREMENT
/begin MEASUREMENT DFC_b.LDF_TKAEmin "Bit encoding / Last debounced flag bit for check DFC_TKAEmin" UBYTE DFC_OneToOne 1 100 0.00 1.000 BIT_MASK 0x10 FORMAT "%5.3" ECU_ADDRESS 0x6003721F /end MEASUREMENT
/begin MEASUREMENT DFC_b.LDF_TKARmax "Bit encoding / Last debounced flag bit for check DFC_TKARmax" UBYTE DFC_OneToOne 1 100 0.00 1.000 BIT_MASK 0x10 FORMAT "%5.3" ECU_ADDRESS 0x60037220 /end MEASUREMENT
/begin MEASUREMENT DFC_b.LDF_TKARnpl "Bit encoding / Last debounced flag bit for check DFC_TKARnpl" UBYTE DFC_OneToOne 1 100 0.00 1.000 BIT_MASK 0x10 FORMAT "%5.3" ECU_ADDRESS 0x60037221 /end MEASUREMENT
/begin MEASUREMENT DFC_b.LDF_TMmax_Dummy "Bit encoding / Last debounced flag bit for check DFC_TMmax_Dummy" UBYTE DFC_OneToOne 1 100 0.00 1.000 BIT_MASK 0x10 FORMAT "%5.3" ECU_ADDRESS 0x60037222 /end MEASUREMENT
/begin MEASUREMENT DFC_b.LDF_TUMmax_Dummy "Bit encoding / Last debounced flag bit for check DFC_TUMmax_Dummy" UBYTE DFC_OneToOne 1 100 0.00 1.000 BIT_MASK 0x10 FORMAT "%5.3" ECU_ADDRESS 0x60037223 /end MEASUREMENT
/begin MEASUREMENT DFC_b.LDF_TWCDPriCatB1 "Bit encoding / Last debounced flag bit for check DFC_TWCDPriCatB1" UBYTE DFC_OneToOne 1 100 0.00 1.000 BIT_MASK 0x10 FORMAT "%5.3" ECU_ADDRESS 0x60037224 /end MEASUREMENT
/begin MEASUREMENT DFC_b.LDF_ThrVlvClsdPosnFirstOffsLrnImpoB1 "Bit encoding / Last debounced flag bit for check DFC_ThrVlvClsdPosnFirstOffsLrnImpoB1" UBYTE DFC_OneToOne 1 100 0.00 1.000 BIT_MASK 0x10 FORMAT "%5.3" ECU_ADDRESS 0x60037225 /end MEASUREMENT
/begin MEASUREMENT DFC_b.LDF_ThrVlvClsdPosnOffsLrnImpoB1 "Bit encoding / Last debounced flag bit for check DFC_ThrVlvClsdPosnOffsLrnImpoB1" UBYTE DFC_OneToOne 1 100 0.00 1.000 BIT_MASK 0x10 FORMAT "%5.3" ECU_ADDRESS 0x60037226 /end MEASUREMENT
/begin MEASUREMENT DFC_b.LDF_ThrVlvClsdPosnOffsLrnMaxB1 "Bit encoding / Last debounced flag bit for check DFC_ThrVlvClsdPosnOffsLrnMaxB1" UBYTE DFC_OneToOne 1 100 0.00 1.000 BIT_MASK 0x10 FORMAT "%5.3" ECU_ADDRESS 0x60037227 /end MEASUREMENT
/begin MEASUREMENT DFC_b.LDF_ThrVlvClsdPosnOffsLrnMinB1 "Bit encoding / Last debounced flag bit for check DFC_ThrVlvClsdPosnOffsLrnMinB1" UBYTE DFC_OneToOne 1 100 0.00 1.000 BIT_MASK 0x10 FORMAT "%5.3" ECU_ADDRESS 0x60037228 /end MEASUREMENT
/begin MEASUREMENT DFC_b.LDF_ThrVlvCtrlDeB1 "Bit encoding / Last debounced flag bit for check DFC_ThrVlvCtrlDeB1" UBYTE DFC_OneToOne 1 100 0.00 1.000 BIT_MASK 0x10 FORMAT "%5.3" ECU_ADDRESS 0x60037229 /end MEASUREMENT
/begin MEASUREMENT DFC_b.LDF_ThrVlvDycB1 "Bit encoding / Last debounced flag bit for check DFC_ThrVlvDycB1" UBYTE DFC_OneToOne 1 100 0.00 1.000 BIT_MASK 0x10 FORMAT "%5.3" ECU_ADDRESS 0x6003722A /end MEASUREMENT
/begin MEASUREMENT DFC_b.LDF_ThrVlvLimpAirPosnMaxAbsltDriftB1 "Bit encoding / Last debounced flag bit for check DFC_ThrVlvLimpAirPosnMaxAbsltDriftB1" UBYTE DFC_OneToOne 1 100 0.00 1.000 BIT_MASK 0x10 FORMAT "%5.3" ECU_ADDRESS 0x6003722B /end MEASUREMENT
/begin MEASUREMENT DFC_b.LDF_ThrVlvLimpAirPosnMaxB1 "Bit encoding / Last debounced flag bit for check DFC_ThrVlvLimpAirPosnMaxB1" UBYTE DFC_OneToOne 1 100 0.00 1.000 BIT_MASK 0x10 FORMAT "%5.3" ECU_ADDRESS 0x6003722C /end MEASUREMENT
/begin MEASUREMENT DFC_b.LDF_ThrVlvLimpAirPosnMaxRelDriftB1 "Bit encoding / Last debounced flag bit for check DFC_ThrVlvLimpAirPosnMaxRelDriftB1" UBYTE DFC_OneToOne 1 100 0.00 1.000 BIT_MASK 0x10 FORMAT "%5.3" ECU_ADDRESS 0x6003722D /end MEASUREMENT
/begin MEASUREMENT DFC_b.LDF_ThrVlvLimpAirPosnMinB1 "Bit encoding / Last debounced flag bit for check DFC_ThrVlvLimpAirPosnMinB1" UBYTE DFC_OneToOne 1 100 0.00 1.000 BIT_MASK 0x10 FORMAT "%5.3" ECU_ADDRESS 0x6003722E /end MEASUREMENT
/begin MEASUREMENT DFC_b.LDF_ThrVlvOpenLoadB1 "Bit encoding / Last debounced flag bit for check DFC_ThrVlvOpenLoadB1" UBYTE DFC_OneToOne 1 100 0.00 1.000 BIT_MASK 0x10 FORMAT "%5.3" ECU_ADDRESS 0x6003722F /end MEASUREMENT
/begin MEASUREMENT DFC_b.LDF_ThrVlvOpenSprgB1 "Bit encoding / Last debounced flag bit for check DFC_ThrVlvOpenSprgB1" UBYTE DFC_OneToOne 1 100 0.00 1.000 BIT_MASK 0x10 FORMAT "%5.3" ECU_ADDRESS 0x60037230 /end MEASUREMENT
/begin MEASUREMENT DFC_b.LDF_ThrVlvOpenSprgSprdB1 "Bit encoding / Last debounced flag bit for check DFC_ThrVlvOpenSprgSprdB1" UBYTE DFC_OneToOne 1 100 0.00 1.000 BIT_MASK 0x10 FORMAT "%5.3" ECU_ADDRESS 0x60037231 /end MEASUREMENT
/begin MEASUREMENT DFC_b.LDF_ThrVlvOpenSprgTwnB1 "Bit encoding / Last debounced flag bit for check DFC_ThrVlvOpenSprgTwnB1" UBYTE DFC_OneToOne 1 100 0.00 1.000 BIT_MASK 0x10 FORMAT "%5.3" ECU_ADDRESS 0x60037232 /end MEASUREMENT
/begin MEASUREMENT DFC_b.LDF_ThrVlvOverTB1 "Bit encoding / Last debounced flag bit for check DFC_ThrVlvOverTB1" UBYTE DFC_OneToOne 1 100 0.00 1.000 BIT_MASK 0x10 FORMAT "%5.3" ECU_ADDRESS 0x60037233 /end MEASUREMENT
/begin MEASUREMENT DFC_b.LDF_ThrVlvRetSprgB1 "Bit encoding / Last debounced flag bit for check DFC_ThrVlvRetSprgB1" UBYTE DFC_OneToOne 1 100 0.00 1.000 BIT_MASK 0x10 FORMAT "%5.3" ECU_ADDRESS 0x60037234 /end MEASUREMENT
/begin MEASUREMENT DFC_b.LDF_ThrVlvRetSprgSprdB1 "Bit encoding / Last debounced flag bit for check DFC_ThrVlvRetSprgSprdB1" UBYTE DFC_OneToOne 1 100 0.00 1.000 BIT_MASK 0x10 FORMAT "%5.3" ECU_ADDRESS 0x60037235 /end MEASUREMENT
/begin MEASUREMENT DFC_b.LDF_ThrVlvRetSprgTwnB1 "Bit encoding / Last debounced flag bit for check DFC_ThrVlvRetSprgTwnB1" UBYTE DFC_OneToOne 1 100 0.00 1.000 BIT_MASK 0x10 FORMAT "%5.3" ECU_ADDRESS 0x60037236 /end MEASUREMENT
/begin MEASUREMENT DFC_b.LDF_ThrVlvSens1MaxB1 "Bit encoding / Last debounced flag bit for check DFC_ThrVlvSens1MaxB1" UBYTE DFC_OneToOne 1 100 0.00 1.000 BIT_MASK 0x10 FORMAT "%5.3" ECU_ADDRESS 0x60037237 /end MEASUREMENT
/begin MEASUREMENT DFC_b.LDF_ThrVlvSens1NplB1 "Bit encoding / Last debounced flag bit for check DFC_ThrVlvSens1NplB1" UBYTE DFC_OneToOne 1 100 0.00 1.000 BIT_MASK 0x10 FORMAT "%5.3" ECU_ADDRESS 0x60037238 /end MEASUREMENT
/begin MEASUREMENT DFC_b.LDF_ThrVlvSens2MaxB1 "Bit encoding / Last debounced flag bit for check DFC_ThrVlvSens2MaxB1" UBYTE DFC_OneToOne 1 100 0.00 1.000 BIT_MASK 0x10 FORMAT "%5.3" ECU_ADDRESS 0x60037239 /end MEASUREMENT
/begin MEASUREMENT DFC_b.LDF_ThrVlvSens2MinB1 "Bit encoding / Last debounced flag bit for check DFC_ThrVlvSens2MinB1" UBYTE DFC_OneToOne 1 100 0.00 1.000 BIT_MASK 0x10 FORMAT "%5.3" ECU_ADDRESS 0x6003723A /end MEASUREMENT
/begin MEASUREMENT DFC_b.LDF_ThrVlvSens2NplB1 "Bit encoding / Last debounced flag bit for check DFC_ThrVlvSens2NplB1" UBYTE DFC_OneToOne 1 100 0.00 1.000 BIT_MASK 0x10 FORMAT "%5.3" ECU_ADDRESS 0x6003723B /end MEASUREMENT
/begin MEASUREMENT DFC_b.LDF_ThrVlvShoCircB1 "Bit encoding / Last debounced flag bit for check DFC_ThrVlvShoCircB1" UBYTE DFC_OneToOne 1 100 0.00 1.000 BIT_MASK 0x10 FORMAT "%5.3" ECU_ADDRESS 0x6003723C /end MEASUREMENT
/begin MEASUREMENT DFC_b.LDF_ThrVlvSpiErrB1 "Bit encoding / Last debounced flag bit for check DFC_ThrVlvSpiErrB1" UBYTE DFC_OneToOne 1 100 0.00 1.000 BIT_MASK 0x10 FORMAT "%5.3" ECU_ADDRESS 0x6003723D /end MEASUREMENT
/begin MEASUREMENT DFC_b.LDF_ThrvlvSens1MinB1 "Bit encoding / Last debounced flag bit for check DFC_ThrvlvSens1MinB1" UBYTE DFC_OneToOne 1 100 0.00 1.000 BIT_MASK 0x10 FORMAT "%5.3" ECU_ADDRESS 0x6003723E /end MEASUREMENT
/begin MEASUREMENT DFC_b.LDF_TiOffTBasdChkFast "Bit encoding / Last debounced flag bit for check DFC_TiOffTBasdChkFast" UBYTE DFC_OneToOne 1 100 0.00 1.000 BIT_MASK 0x10 FORMAT "%5.3" ECU_ADDRESS 0x6003723F /end MEASUREMENT
/begin MEASUREMENT DFC_b.LDF_TiOffTBasdChkSlow "Bit encoding / Last debounced flag bit for check DFC_TiOffTBasdChkSlow" UBYTE DFC_OneToOne 1 100 0.00 1.000 BIT_MASK 0x10 FORMAT "%5.3" ECU_ADDRESS 0x60037240 /end MEASUREMENT
/begin MEASUREMENT DFC_b.LDF_UEGOSnsrMntdS1B1 "Bit encoding / Last debounced flag bit for check DFC_UEGOSnsrMntdS1B1" UBYTE DFC_OneToOne 1 100 0.00 1.000 BIT_MASK 0x10 FORMAT "%5.3" ECU_ADDRESS 0x60037241 /end MEASUREMENT
/begin MEASUREMENT DFC_b.LDF_VehVSig "Bit encoding / Last debounced flag bit for check DFC_VehVSig" UBYTE DFC_OneToOne 1 100 0.00 1.000 BIT_MASK 0x10 FORMAT "%5.3" ECU_ADDRESS 0x60037242 /end MEASUREMENT
/begin MEASUREMENT DFC_b.LDF_VlvLftFbSwtIntk11SpclFail "Bit encoding / Last debounced flag bit for check DFC_VlvLftFbSwtIntk11SpclFail" UBYTE DFC_OneToOne 1 100 0.00 1.000 BIT_MASK 0x10 FORMAT "%5.3" ECU_ADDRESS 0x60037243 /end MEASUREMENT
/begin MEASUREMENT DFC_b.LDF_VlvLftFbSwtIntk11StdFail "Bit encoding / Last debounced flag bit for check DFC_VlvLftFbSwtIntk11StdFail" UBYTE DFC_OneToOne 1 100 0.00 1.000 BIT_MASK 0x10 FORMAT "%5.3" ECU_ADDRESS 0x60037244 /end MEASUREMENT
/begin MEASUREMENT DFC_b.TSC_AAVEmax "Bit encoding / Ok-Tested Since Clear bit for check DFC_AAVEmax" UBYTE DFC_OneToOne 1 100 0.00 1.000 BIT_MASK 0x20 FORMAT "%5.3" ECU_ADDRESS 0x60036EBB /end MEASUREMENT
/begin MEASUREMENT DFC_b.TSC_AAVEmin "Bit encoding / Ok-Tested Since Clear bit for check DFC_AAVEmin" UBYTE DFC_OneToOne 1 100 0.00 1.000 BIT_MASK 0x20 FORMAT "%5.3" ECU_ADDRESS 0x60036EBC /end MEASUREMENT
/begin MEASUREMENT DFC_b.TSC_AAVEsig "Bit encoding / Ok-Tested Since Clear bit for check DFC_AAVEsig" UBYTE DFC_OneToOne 1 100 0.00 1.000 BIT_MASK 0x20 FORMAT "%5.3" ECU_ADDRESS 0x60036EBD /end MEASUREMENT
/begin MEASUREMENT DFC_b.TSC_AltIOACGFailr "Bit encoding / Ok-Tested Since Clear bit for check DFC_AltIOACGFailr" UBYTE DFC_OneToOne 1 100 0.00 1.000 BIT_MASK 0x20 FORMAT "%5.3" ECU_ADDRESS 0x60036EBE /end MEASUREMENT
/begin MEASUREMENT DFC_b.TSC_AltIOACGHiVltg "Bit encoding / Ok-Tested Since Clear bit for check DFC_AltIOACGHiVltg" UBYTE DFC_OneToOne 1 100 0.00 1.000 BIT_MASK 0x20 FORMAT "%5.3" ECU_ADDRESS 0x60036EBF /end MEASUREMENT
/begin MEASUREMENT DFC_b.TSC_AltIOACGLoVltg "Bit encoding / Ok-Tested Since Clear bit for check DFC_AltIOACGLoVltg" UBYTE DFC_OneToOne 1 100 0.00 1.000 BIT_MASK 0x20 FORMAT "%5.3" ECU_ADDRESS 0x60036EC0 /end MEASUREMENT
/begin MEASUREMENT DFC_b.TSC_AltIOACGTHi "Bit encoding / Ok-Tested Since Clear bit for check DFC_AltIOACGTHi" UBYTE DFC_OneToOne 1 100 0.00 1.000 BIT_MASK 0x20 FORMAT "%5.3" ECU_ADDRESS 0x60036EC1 /end MEASUREMENT
/begin MEASUREMENT DFC_b.TSC_AltIODConnACG "Bit encoding / Ok-Tested Since Clear bit for check DFC_AltIODConnACG" UBYTE DFC_OneToOne 1 100 0.00 1.000 BIT_MASK 0x20 FORMAT "%5.3" ECU_ADDRESS 0x60036EC2 /end MEASUREMENT
/begin MEASUREMENT DFC_b.TSC_BGOELWAF "Bit encoding / Ok-Tested Since Clear bit for check DFC_BGOELWAF" UBYTE DFC_OneToOne 1 100 0.00 1.000 BIT_MASK 0x20 FORMAT "%5.3" ECU_ADDRESS 0x60036EC3 /end MEASUREMENT
/begin MEASUREMENT DFC_b.TSC_BattUHiFailr "Bit encoding / Ok-Tested Since Clear bit for check DFC_BattUHiFailr" UBYTE DFC_OneToOne 1 100 0.00 1.000 BIT_MASK 0x20 FORMAT "%5.3" ECU_ADDRESS 0x60036EC4 /end MEASUREMENT
/begin MEASUREMENT DFC_b.TSC_BattULoFailr "Bit encoding / Ok-Tested Since Clear bit for check DFC_BattULoFailr" UBYTE DFC_OneToOne 1 100 0.00 1.000 BIT_MASK 0x20 FORMAT "%5.3" ECU_ADDRESS 0x60036EC5 /end MEASUREMENT
/begin MEASUREMENT DFC_b.TSC_BrkBstPDriftHiErr "Bit encoding / Ok-Tested Since Clear bit for check DFC_BrkBstPDriftHiErr" UBYTE DFC_OneToOne 1 100 0.00 1.000 BIT_MASK 0x20 FORMAT "%5.3" ECU_ADDRESS 0x60036EC6 /end MEASUREMENT
/begin MEASUREMENT DFC_b.TSC_BrkBstPDriftLoErr "Bit encoding / Ok-Tested Since Clear bit for check DFC_BrkBstPDriftLoErr" UBYTE DFC_OneToOne 1 100 0.00 1.000 BIT_MASK 0x20 FORMAT "%5.3" ECU_ADDRESS 0x60036EC7 /end MEASUREMENT
/begin MEASUREMENT DFC_b.TSC_BrkBstPSnsrStuck "Bit encoding / Ok-Tested Since Clear bit for check DFC_BrkBstPSnsrStuck" UBYTE DFC_OneToOne 1 100 0.00 1.000 BIT_MASK 0x20 FORMAT "%5.3" ECU_ADDRESS 0x60036EC8 /end MEASUREMENT
/begin MEASUREMENT DFC_b.TSC_BrkMnSwtContOn "Bit encoding / Ok-Tested Since Clear bit for check DFC_BrkMnSwtContOn" UBYTE DFC_OneToOne 1 100 0.00 1.000 BIT_MASK 0x20 FORMAT "%5.3" ECU_ADDRESS 0x60036EC9 /end MEASUREMENT
/begin MEASUREMENT DFC_b.TSC_BrkMnSwtNotStp "Bit encoding / Ok-Tested Since Clear bit for check DFC_BrkMnSwtNotStp" UBYTE DFC_OneToOne 1 100 0.00 1.000 BIT_MASK 0x20 FORMAT "%5.3" ECU_ADDRESS 0x60036ECA /end MEASUREMENT
/begin MEASUREMENT DFC_b.TSC_BrkNpl "Bit encoding / Ok-Tested Since Clear bit for check DFC_BrkNpl" UBYTE DFC_OneToOne 1 100 0.00 1.000 BIT_MASK 0x20 FORMAT "%5.3" ECU_ADDRESS 0x60036ECB /end MEASUREMENT
/begin MEASUREMENT DFC_b.TSC_BrkRdntSwtContOn "Bit encoding / Ok-Tested Since Clear bit for check DFC_BrkRdntSwtContOn" UBYTE DFC_OneToOne 1 100 0.00 1.000 BIT_MASK 0x20 FORMAT "%5.3" ECU_ADDRESS 0x60036ECC /end MEASUREMENT
/begin MEASUREMENT DFC_b.TSC_BrkRdntSwtNotStp "Bit encoding / Ok-Tested Since Clear bit for check DFC_BrkRdntSwtNotStp" UBYTE DFC_OneToOne 1 100 0.00 1.000 BIT_MASK 0x20 FORMAT "%5.3" ECU_ADDRESS 0x60036ECD /end MEASUREMENT
/begin MEASUREMENT DFC_b.TSC_Clth3ONStuck "Bit encoding / Ok-Tested Since Clear bit for check DFC_Clth3ONStuck" UBYTE DFC_OneToOne 1 100 0.00 1.000 BIT_MASK 0x20 FORMAT "%5.3" ECU_ADDRESS 0x60036ECE /end MEASUREMENT
/begin MEASUREMENT DFC_b.TSC_Clth4OFFStuck "Bit encoding / Ok-Tested Since Clear bit for check DFC_Clth4OFFStuck" UBYTE DFC_OneToOne 1 100 0.00 1.000 BIT_MASK 0x20 FORMAT "%5.3" ECU_ADDRESS 0x60036ECF /end MEASUREMENT
/begin MEASUREMENT DFC_b.TSC_ClthOFFStuck "Bit encoding / Ok-Tested Since Clear bit for check DFC_ClthOFFStuck" UBYTE DFC_OneToOne 1 100 0.00 1.000 BIT_MASK 0x20 FORMAT "%5.3" ECU_ADDRESS 0x60036ED0 /end MEASUREMENT
/begin MEASUREMENT DFC_b.TSC_ClthONStuck "Bit encoding / Ok-Tested Since Clear bit for check DFC_ClthONStuck" UBYTE DFC_OneToOne 1 100 0.00 1.000 BIT_MASK 0x20 FORMAT "%5.3" ECU_ADDRESS 0x60036ED1 /end MEASUREMENT
/begin MEASUREMENT DFC_b.TSC_ClthStkFailInfo "Bit encoding / Ok-Tested Since Clear bit for check DFC_ClthStkFailInfo" UBYTE DFC_OneToOne 1 100 0.00 1.000 BIT_MASK 0x20 FORMAT "%5.3" ECU_ADDRESS 0x60036ED2 /end MEASUREMENT
/begin MEASUREMENT DFC_b.TSC_ComACFailInfo "Bit encoding / Ok-Tested Since Clear bit for check DFC_ComACFailInfo" UBYTE DFC_OneToOne 1 100 0.00 1.000 BIT_MASK 0x20 FORMAT "%5.3" ECU_ADDRESS 0x60036ED3 /end MEASUREMENT
/begin MEASUREMENT DFC_b.TSC_ComATFTValErr "Bit encoding / Ok-Tested Since Clear bit for check DFC_ComATFTValErr" UBYTE DFC_OneToOne 1 100 0.00 1.000 BIT_MASK 0x20 FORMAT "%5.3" ECU_ADDRESS 0x60036ED4 /end MEASUREMENT
/begin MEASUREMENT DFC_b.TSC_ComATMILReq "Bit encoding / Ok-Tested Since Clear bit for check DFC_ComATMILReq" UBYTE DFC_OneToOne 1 100 0.00 1.000 BIT_MASK 0x20 FORMAT "%5.3" ECU_ADDRESS 0x60036ED5 /end MEASUREMENT
/begin MEASUREMENT DFC_b.TSC_ComAYCAChksum "Bit encoding / Ok-Tested Since Clear bit for check DFC_ComAYCAChksum" UBYTE DFC_OneToOne 1 100 0.00 1.000 BIT_MASK 0x20 FORMAT "%5.3" ECU_ADDRESS 0x60036ED6 /end MEASUREMENT
/begin MEASUREMENT DFC_b.TSC_ComAYCARingCnt "Bit encoding / Ok-Tested Since Clear bit for check DFC_ComAYCARingCnt" UBYTE DFC_OneToOne 1 100 0.00 1.000 BIT_MASK 0x20 FORMAT "%5.3" ECU_ADDRESS 0x60036ED7 /end MEASUREMENT
/begin MEASUREMENT DFC_b.TSC_ComAYCATOut "Bit encoding / Ok-Tested Since Clear bit for check DFC_ComAYCATOut" UBYTE DFC_OneToOne 1 100 0.00 1.000 BIT_MASK 0x20 FORMAT "%5.3" ECU_ADDRESS 0x60036ED8 /end MEASUREMENT
/begin MEASUREMENT DFC_b.TSC_ComAYCDChkSum "Bit encoding / Ok-Tested Since Clear bit for check DFC_ComAYCDChkSum" UBYTE DFC_OneToOne 1 100 0.00 1.000 BIT_MASK 0x20 FORMAT "%5.3" ECU_ADDRESS 0x60036ED9 /end MEASUREMENT
/begin MEASUREMENT DFC_b.TSC_ComAYCDTOut "Bit encoding / Ok-Tested Since Clear bit for check DFC_ComAYCDTOut" UBYTE DFC_OneToOne 1 100 0.00 1.000 BIT_MASK 0x20 FORMAT "%5.3" ECU_ADDRESS 0x60036EDA /end MEASUREMENT
/begin MEASUREMENT DFC_b.TSC_ComAYCFChksum "Bit encoding / Ok-Tested Since Clear bit for check DFC_ComAYCFChksum" UBYTE DFC_OneToOne 1 100 0.00 1.000 BIT_MASK 0x20 FORMAT "%5.3" ECU_ADDRESS 0x60036EDB /end MEASUREMENT
/begin MEASUREMENT DFC_b.TSC_ComAYCFRingCnt "Bit encoding / Ok-Tested Since Clear bit for check DFC_ComAYCFRingCnt" UBYTE DFC_OneToOne 1 100 0.00 1.000 BIT_MASK 0x20 FORMAT "%5.3" ECU_ADDRESS 0x60036EDC /end MEASUREMENT
/begin MEASUREMENT DFC_b.TSC_ComAYCFTOut "Bit encoding / Ok-Tested Since Clear bit for check DFC_ComAYCFTOut" UBYTE DFC_OneToOne 1 100 0.00 1.000 BIT_MASK 0x20 FORMAT "%5.3" ECU_ADDRESS 0x60036EDD /end MEASUREMENT
/begin MEASUREMENT DFC_b.TSC_ComAYCGChksum "Bit encoding / Ok-Tested Since Clear bit for check DFC_ComAYCGChksum" UBYTE DFC_OneToOne 1 100 0.00 1.000 BIT_MASK 0x20 FORMAT "%5.3" ECU_ADDRESS 0x60036EDE /end MEASUREMENT
/begin MEASUREMENT DFC_b.TSC_ComAYCGRingCnt "Bit encoding / Ok-Tested Since Clear bit for check DFC_ComAYCGRingCnt" UBYTE DFC_OneToOne 1 100 0.00 1.000 BIT_MASK 0x20 FORMAT "%5.3" ECU_ADDRESS 0x60036EDF /end MEASUREMENT
/begin MEASUREMENT DFC_b.TSC_ComAYCGTOut "Bit encoding / Ok-Tested Since Clear bit for check DFC_ComAYCGTOut" UBYTE DFC_OneToOne 1 100 0.00 1.000 BIT_MASK 0x20 FORMAT "%5.3" ECU_ADDRESS 0x60036EE0 /end MEASUREMENT
/begin MEASUREMENT DFC_b.TSC_ComAYCIChkSum "Bit encoding / Ok-Tested Since Clear bit for check DFC_ComAYCIChkSum" UBYTE DFC_OneToOne 1 100 0.00 1.000 BIT_MASK 0x20 FORMAT "%5.3" ECU_ADDRESS 0x60036EE1 /end MEASUREMENT
/begin MEASUREMENT DFC_b.TSC_ComAYCIRingCnt "Bit encoding / Ok-Tested Since Clear bit for check DFC_ComAYCIRingCnt" UBYTE DFC_OneToOne 1 100 0.00 1.000 BIT_MASK 0x20 FORMAT "%5.3" ECU_ADDRESS 0x60036EE2 /end MEASUREMENT
/begin MEASUREMENT DFC_b.TSC_ComAYCITOut "Bit encoding / Ok-Tested Since Clear bit for check DFC_ComAYCITOut" UBYTE DFC_OneToOne 1 100 0.00 1.000 BIT_MASK 0x20 FORMAT "%5.3" ECU_ADDRESS 0x60036EE3 /end MEASUREMENT
/begin MEASUREMENT DFC_b.TSC_ComBCM1ChkSum "Bit encoding / Ok-Tested Since Clear bit for check DFC_ComBCM1ChkSum" UBYTE DFC_OneToOne 1 100 0.00 1.000 BIT_MASK 0x20 FORMAT "%5.3" ECU_ADDRESS 0x60036EE4 /end MEASUREMENT
/begin MEASUREMENT DFC_b.TSC_ComBCM1RingCnt "Bit encoding / Ok-Tested Since Clear bit for check DFC_ComBCM1RingCnt" UBYTE DFC_OneToOne 1 100 0.00 1.000 BIT_MASK 0x20 FORMAT "%5.3" ECU_ADDRESS 0x60036EE5 /end MEASUREMENT
/begin MEASUREMENT DFC_b.TSC_ComBCM1TOut "Bit encoding / Ok-Tested Since Clear bit for check DFC_ComBCM1TOut" UBYTE DFC_OneToOne 1 100 0.00 1.000 BIT_MASK 0x20 FORMAT "%5.3" ECU_ADDRESS 0x60036EE6 /end MEASUREMENT
/begin MEASUREMENT DFC_b.TSC_ComCANABusOffErr "Bit encoding / Ok-Tested Since Clear bit for check DFC_ComCANABusOffErr" UBYTE DFC_OneToOne 1 100 0.00 1.000 BIT_MASK 0x20 FORMAT "%5.3" ECU_ADDRESS 0x60036EE7 /end MEASUREMENT
/begin MEASUREMENT DFC_b.TSC_ComCANBBusOffErr "Bit encoding / Ok-Tested Since Clear bit for check DFC_ComCANBBusOffErr" UBYTE DFC_OneToOne 1 100 0.00 1.000 BIT_MASK 0x20 FORMAT "%5.3" ECU_ADDRESS 0x60036EE8 /end MEASUREMENT
/begin MEASUREMENT DFC_b.TSC_ComCANCBusOffErr "Bit encoding / Ok-Tested Since Clear bit for check DFC_ComCANCBusOffErr" UBYTE DFC_OneToOne 1 100 0.00 1.000 BIT_MASK 0x20 FORMAT "%5.3" ECU_ADDRESS 0x60036EE9 /end MEASUREMENT
/begin MEASUREMENT DFC_b.TSC_ComCGW1ChkSum "Bit encoding / Ok-Tested Since Clear bit for check DFC_ComCGW1ChkSum" UBYTE DFC_OneToOne 1 100 0.00 1.000 BIT_MASK 0x20 FORMAT "%5.3" ECU_ADDRESS 0x60036EEA /end MEASUREMENT
/begin MEASUREMENT DFC_b.TSC_ComCGW1RingCnt "Bit encoding / Ok-Tested Since Clear bit for check DFC_ComCGW1RingCnt" UBYTE DFC_OneToOne 1 100 0.00 1.000 BIT_MASK 0x20 FORMAT "%5.3" ECU_ADDRESS 0x60036EEB /end MEASUREMENT
/begin MEASUREMENT DFC_b.TSC_ComCGW1TOut "Bit encoding / Ok-Tested Since Clear bit for check DFC_ComCGW1TOut" UBYTE DFC_OneToOne 1 100 0.00 1.000 BIT_MASK 0x20 FORMAT "%5.3" ECU_ADDRESS 0x60036EEC /end MEASUREMENT
/begin MEASUREMENT DFC_b.TSC_ComConvBoostErr "Bit encoding / Ok-Tested Since Clear bit for check DFC_ComConvBoostErr" UBYTE DFC_OneToOne 1 100 0.00 1.000 BIT_MASK 0x20 FORMAT "%5.3" ECU_ADDRESS 0x60036EED /end MEASUREMENT
/begin MEASUREMENT DFC_b.TSC_ComConvSlipErr "Bit encoding / Ok-Tested Since Clear bit for check DFC_ComConvSlipErr" UBYTE DFC_OneToOne 1 100 0.00 1.000 BIT_MASK 0x20 FORMAT "%5.3" ECU_ADDRESS 0x60036EEE /end MEASUREMENT
/begin MEASUREMENT DFC_b.TSC_ComDCDCPrfmncErr "Bit encoding / Ok-Tested Since Clear bit for check DFC_ComDCDCPrfmncErr" UBYTE DFC_OneToOne 1 100 0.00 1.000 BIT_MASK 0x20 FORMAT "%5.3" ECU_ADDRESS 0x60036EEF /end MEASUREMENT
/begin MEASUREMENT DFC_b.TSC_ComDCDCTempWarn "Bit encoding / Ok-Tested Since Clear bit for check DFC_ComDCDCTempWarn" UBYTE DFC_OneToOne 1 100 0.00 1.000 BIT_MASK 0x20 FORMAT "%5.3" ECU_ADDRESS 0x60036EF0 /end MEASUREMENT
/begin MEASUREMENT DFC_b.TSC_ComEAT10Chksum "Bit encoding / Ok-Tested Since Clear bit for check DFC_ComEAT10Chksum" UBYTE DFC_OneToOne 1 100 0.00 1.000 BIT_MASK 0x20 FORMAT "%5.3" ECU_ADDRESS 0x60036EF1 /end MEASUREMENT
/begin MEASUREMENT DFC_b.TSC_ComEAT10RingCnt "Bit encoding / Ok-Tested Since Clear bit for check DFC_ComEAT10RingCnt" UBYTE DFC_OneToOne 1 100 0.00 1.000 BIT_MASK 0x20 FORMAT "%5.3" ECU_ADDRESS 0x60036EF2 /end MEASUREMENT
/begin MEASUREMENT DFC_b.TSC_ComEAT10TOut "Bit encoding / Ok-Tested Since Clear bit for check DFC_ComEAT10TOut" UBYTE DFC_OneToOne 1 100 0.00 1.000 BIT_MASK 0x20 FORMAT "%5.3" ECU_ADDRESS 0x60036EF3 /end MEASUREMENT
/begin MEASUREMENT DFC_b.TSC_ComEAT11ChkSum "Bit encoding / Ok-Tested Since Clear bit for check DFC_ComEAT11ChkSum" UBYTE DFC_OneToOne 1 100 0.00 1.000 BIT_MASK 0x20 FORMAT "%5.3" ECU_ADDRESS 0x60036EF4 /end MEASUREMENT
/begin MEASUREMENT DFC_b.TSC_ComEAT11RingCnt "Bit encoding / Ok-Tested Since Clear bit for check DFC_ComEAT11RingCnt" UBYTE DFC_OneToOne 1 100 0.00 1.000 BIT_MASK 0x20 FORMAT "%5.3" ECU_ADDRESS 0x60036EF5 /end MEASUREMENT
/begin MEASUREMENT DFC_b.TSC_ComEAT11TOut "Bit encoding / Ok-Tested Since Clear bit for check DFC_ComEAT11TOut" UBYTE DFC_OneToOne 1 100 0.00 1.000 BIT_MASK 0x20 FORMAT "%5.3" ECU_ADDRESS 0x60036EF6 /end MEASUREMENT
/begin MEASUREMENT DFC_b.TSC_ComEAT12ChkSum "Bit encoding / Ok-Tested Since Clear bit for check DFC_ComEAT12ChkSum" UBYTE DFC_OneToOne 1 100 0.00 1.000 BIT_MASK 0x20 FORMAT "%5.3" ECU_ADDRESS 0x60036EF7 /end MEASUREMENT
/begin MEASUREMENT DFC_b.TSC_ComEAT12RingCnt "Bit encoding / Ok-Tested Since Clear bit for check DFC_ComEAT12RingCnt" UBYTE DFC_OneToOne 1 100 0.00 1.000 BIT_MASK 0x20 FORMAT "%5.3" ECU_ADDRESS 0x60036EF8 /end MEASUREMENT
/begin MEASUREMENT DFC_b.TSC_ComEAT12TOut "Bit encoding / Ok-Tested Since Clear bit for check DFC_ComEAT12TOut" UBYTE DFC_OneToOne 1 100 0.00 1.000 BIT_MASK 0x20 FORMAT "%5.3" ECU_ADDRESS 0x60036EF9 /end MEASUREMENT
/begin MEASUREMENT DFC_b.TSC_ComEAT13ChkSum "Bit encoding / Ok-Tested Since Clear bit for check DFC_ComEAT13ChkSum" UBYTE DFC_OneToOne 1 100 0.00 1.000 BIT_MASK 0x20 FORMAT "%5.3" ECU_ADDRESS 0x60036EFA /end MEASUREMENT
/begin MEASUREMENT DFC_b.TSC_ComEAT13RingCnt "Bit encoding / Ok-Tested Since Clear bit for check DFC_ComEAT13RingCnt" UBYTE DFC_OneToOne 1 100 0.00 1.000 BIT_MASK 0x20 FORMAT "%5.3" ECU_ADDRESS 0x60036EFB /end MEASUREMENT
/begin MEASUREMENT DFC_b.TSC_ComEAT13TOut "Bit encoding / Ok-Tested Since Clear bit for check DFC_ComEAT13TOut" UBYTE DFC_OneToOne 1 100 0.00 1.000 BIT_MASK 0x20 FORMAT "%5.3" ECU_ADDRESS 0x60036EFC /end MEASUREMENT
/begin MEASUREMENT DFC_b.TSC_ComEAT1Chksum "Bit encoding / Ok-Tested Since Clear bit for check DFC_ComEAT1Chksum" UBYTE DFC_OneToOne 1 100 0.00 1.000 BIT_MASK 0x20 FORMAT "%5.3" ECU_ADDRESS 0x60036EFD /end MEASUREMENT
/begin MEASUREMENT DFC_b.TSC_ComEAT1RingCnt "Bit encoding / Ok-Tested Since Clear bit for check DFC_ComEAT1RingCnt" UBYTE DFC_OneToOne 1 100 0.00 1.000 BIT_MASK 0x20 FORMAT "%5.3" ECU_ADDRESS 0x60036EFE /end MEASUREMENT
/begin MEASUREMENT DFC_b.TSC_ComEAT1TOut "Bit encoding / Ok-Tested Since Clear bit for check DFC_ComEAT1TOut" UBYTE DFC_OneToOne 1 100 0.00 1.000 BIT_MASK 0x20 FORMAT "%5.3" ECU_ADDRESS 0x60036EFF /end MEASUREMENT
/begin MEASUREMENT DFC_b.TSC_ComEAT2ChkSum "Bit encoding / Ok-Tested Since Clear bit for check DFC_ComEAT2ChkSum" UBYTE DFC_OneToOne 1 100 0.00 1.000 BIT_MASK 0x20 FORMAT "%5.3" ECU_ADDRESS 0x60036F00 /end MEASUREMENT
/begin MEASUREMENT DFC_b.TSC_ComEAT2RingCnt "Bit encoding / Ok-Tested Since Clear bit for check DFC_ComEAT2RingCnt" UBYTE DFC_OneToOne 1 100 0.00 1.000 BIT_MASK 0x20 FORMAT "%5.3" ECU_ADDRESS 0x60036F01 /end MEASUREMENT
/begin MEASUREMENT DFC_b.TSC_ComEAT2TOut "Bit encoding / Ok-Tested Since Clear bit for check DFC_ComEAT2TOut" UBYTE DFC_OneToOne 1 100 0.00 1.000 BIT_MASK 0x20 FORMAT "%5.3" ECU_ADDRESS 0x60036F02 /end MEASUREMENT
/begin MEASUREMENT DFC_b.TSC_ComEAT4ChkSum "Bit encoding / Ok-Tested Since Clear bit for check DFC_ComEAT4ChkSum" UBYTE DFC_OneToOne 1 100 0.00 1.000 BIT_MASK 0x20 FORMAT "%5.3" ECU_ADDRESS 0x60036F03 /end MEASUREMENT
/begin MEASUREMENT DFC_b.TSC_ComEAT4RingCnt "Bit encoding / Ok-Tested Since Clear bit for check DFC_ComEAT4RingCnt" UBYTE DFC_OneToOne 1 100 0.00 1.000 BIT_MASK 0x20 FORMAT "%5.3" ECU_ADDRESS 0x60036F04 /end MEASUREMENT
/begin MEASUREMENT DFC_b.TSC_ComEAT4TOut "Bit encoding / Ok-Tested Since Clear bit for check DFC_ComEAT4TOut" UBYTE DFC_OneToOne 1 100 0.00 1.000 BIT_MASK 0x20 FORMAT "%5.3" ECU_ADDRESS 0x60036F05 /end MEASUREMENT
/begin MEASUREMENT DFC_b.TSC_ComEAT6Chksum "Bit encoding / Ok-Tested Since Clear bit for check DFC_ComEAT6Chksum" UBYTE DFC_OneToOne 1 100 0.00 1.000 BIT_MASK 0x20 FORMAT "%5.3" ECU_ADDRESS 0x60036F06 /end MEASUREMENT
/begin MEASUREMENT DFC_b.TSC_ComEAT6RingCnt "Bit encoding / Ok-Tested Since Clear bit for check DFC_ComEAT6RingCnt" UBYTE DFC_OneToOne 1 100 0.00 1.000 BIT_MASK 0x20 FORMAT "%5.3" ECU_ADDRESS 0x60036F07 /end MEASUREMENT
/begin MEASUREMENT DFC_b.TSC_ComEAT6TOut "Bit encoding / Ok-Tested Since Clear bit for check DFC_ComEAT6TOut" UBYTE DFC_OneToOne 1 100 0.00 1.000 BIT_MASK 0x20 FORMAT "%5.3" ECU_ADDRESS 0x60036F08 /end MEASUREMENT
/begin MEASUREMENT DFC_b.TSC_ComEAT7Chksum "Bit encoding / Ok-Tested Since Clear bit for check DFC_ComEAT7Chksum" UBYTE DFC_OneToOne 1 100 0.00 1.000 BIT_MASK 0x20 FORMAT "%5.3" ECU_ADDRESS 0x60036F09 /end MEASUREMENT
/begin MEASUREMENT DFC_b.TSC_ComEAT7RingCnt "Bit encoding / Ok-Tested Since Clear bit for check DFC_ComEAT7RingCnt" UBYTE DFC_OneToOne 1 100 0.00 1.000 BIT_MASK 0x20 FORMAT "%5.3" ECU_ADDRESS 0x60036F0A /end MEASUREMENT
/begin MEASUREMENT DFC_b.TSC_ComEAT7TOut "Bit encoding / Ok-Tested Since Clear bit for check DFC_ComEAT7TOut" UBYTE DFC_OneToOne 1 100 0.00 1.000 BIT_MASK 0x20 FORMAT "%5.3" ECU_ADDRESS 0x60036F0B /end MEASUREMENT
/begin MEASUREMENT DFC_b.TSC_ComEAT8Chksum "Bit encoding / Ok-Tested Since Clear bit for check DFC_ComEAT8Chksum" UBYTE DFC_OneToOne 1 100 0.00 1.000 BIT_MASK 0x20 FORMAT "%5.3" ECU_ADDRESS 0x60036F0C /end MEASUREMENT
/begin MEASUREMENT DFC_b.TSC_ComEAT8RingCnt "Bit encoding / Ok-Tested Since Clear bit for check DFC_ComEAT8RingCnt" UBYTE DFC_OneToOne 1 100 0.00 1.000 BIT_MASK 0x20 FORMAT "%5.3" ECU_ADDRESS 0x60036F0D /end MEASUREMENT
/begin MEASUREMENT DFC_b.TSC_ComEAT8TOut "Bit encoding / Ok-Tested Since Clear bit for check DFC_ComEAT8TOut" UBYTE DFC_OneToOne 1 100 0.00 1.000 BIT_MASK 0x20 FORMAT "%5.3" ECU_ADDRESS 0x60036F0E /end MEASUREMENT
/begin MEASUREMENT DFC_b.TSC_ComEATAChksum "Bit encoding / Ok-Tested Since Clear bit for check DFC_ComEATAChksum" UBYTE DFC_OneToOne 1 100 0.00 1.000 BIT_MASK 0x20 FORMAT "%5.3" ECU_ADDRESS 0x60036F0F /end MEASUREMENT
/begin MEASUREMENT DFC_b.TSC_ComEATARingCnt "Bit encoding / Ok-Tested Since Clear bit for check DFC_ComEATARingCnt" UBYTE DFC_OneToOne 1 100 0.00 1.000 BIT_MASK 0x20 FORMAT "%5.3" ECU_ADDRESS 0x60036F10 /end MEASUREMENT
/begin FUNCTION DFC "30000.33.0_1.1.0Diagnostic Fault Check"
 /begin OUT_MEASUREMENT DFC_b.LDF_GEVlvPhaCsersIntkB1 DFC_b.LDF_GEVlvPhaPsOpenLoadIntkB1 DFC_b.LDF_GEVlvPhaPsShoToBattIntkB1 DFC_b.LDF_GEVlvPhaPsShoToGndIntkB1 DFC_b.LDF_GbxCANDigPlausErr DFC_b.LDF_GbxNPos1SRCMax DFC_b.LDF_GbxNPos1SRCMin DFC_b.LDF_GbxNPos2SRCMax DFC_b.LDF_GbxNPos2SRCMin DFC_b.LDF_GbxNPosAlvChk DFC_b.LDF_GbxNPosSyncErr DFC_b.LDF_HEGOS2B1HtrPsMax DFC_b.LDF_HEGOS2B1HtrPsMin DFC_b.LDF_HEGOS2B1HtrPsSig DFC_b.LDF_LinCSErrACG DFC_b.LDF_LinCSErrAEV DFC_b.LDF_LinCSErrDCDC DFC_b.LDF_LinCSErrEBS DFC_b.LDF_LinHdrTimeoutErrACG DFC_b.LDF_LinHdrTimeoutErrAEV DFC_b.LDF_LinHdrTimeoutErrDCDC DFC_b.LDF_LinHdrTimeoutErrEBS DFC_b.LDF_LinMsgTimeoutErrACG DFC_b.LDF_LinMsgTimeoutErrAEV DFC_b.LDF_LinMsgTimeoutErrDCDC DFC_b.LDF_LinMsgTimeoutErrEBS DFC_b.LDF_LinNoStrtComErr DFC_b.LDF_LowPresOilP DFC_b.LDF_MisfDetVWhlFrntLeOORHi DFC_b.LDF_MisfDetVWhlFrntLeRatyHi DFC_b.LDF_MisfDetVWhlFrntLeRatyLo DFC_b.LDF_MisfDetVWhlFrntLeStuck DFC_b.LDF_MisfDetVWhlFrntRiOORHi DFC_b.LDF_MisfDetVWhlFrntRiRatyHi DFC_b.LDF_MisfDetVWhlFrntRiRatyLo DFC_b.LDF_MisfDetVWhlFrntRiStuck DFC_b.LDF_MisfDetVWhlReLeOORHi DFC_b.LDF_MisfDetVWhlReLeRatyHi DFC_b.LDF_MisfDetVWhlReLeRatyLo DFC_b.LDF_MisfDetVWhlReLeStuck DFC_b.LDF_MisfDetVWhlReRiOORHi DFC_b.LDF_MisfDetVWhlReRiRatyHi DFC_b.LDF_MisfDetVWhlReRiRatyLo DFC_b.LDF_MisfDetVWhlReRiStuck DFC_b.LDF_MisfDetdVWhlFrntLePlaus DFC_b.LDF_MisfDetdVWhlFrntRiPlaus DFC_b.LDF_MisfDetdVWhlReLePlaus DFC_b.LDF_MisfDetdVWhlReRiPlaus DFC_b.LDF_PEnvSigRngMax DFC_b.LDF_PEnvSigRngMin DFC_b.LDF_StmFault DFC_b.LDF_StrtCtOffPth DFC_b.LDF_StrtCtlErr DFC_b.LDF_StrtFault DFC_b.LDF_StrtLckJudg1 DFC_b.LDF_StrtLckJudg2 DFC_b.LDF_StrtOL DFC_b.LDF_StrtOL2 DFC_b.LDF_StrtSCB DFC_b.LDF_StrtSCB2 DFC_b.LDF_StrtSCG DFC_b.LDF_StrtSCG2 DFC_b.LDF_StrtStkRly1 DFC_b.LDF_StrtStkRly2 DFC_b.LDF_TEVEmax DFC_b.LDF_TEVEmin DFC_b.LDF_TEVEsig DFC_b.LDF_UegoHeatrPrfmncLoS1B1 DFC_b.LDF_VehVAllPlaus DFC_b.LDF_VehVNCSnsrElecFailr DFC_b.LDF_VehVPlausCan DFC_b.LDF_VehVPlausFco DFC_b.LDF_VehVPlausPwr DFC_b.LDF_VehVPlausV2N DFC_b.LDF_VehVSpdSnsrAElecFailr DFC_b.LDF_VehVSpdSnsrBElecFailr DFC_b.LDF_ClthMax DFC_b.LDF_IgnClPs_DevComErr DFC_b.LDF_IgnClPs_LineOl_0 DFC_b.LDF_IgnClPs_LineOl_1 DFC_b.LDF_IgnClPs_LineOl_2 DFC_b.LDF_IgnClPs_LineOl_3 DFC_b.LDF_IgnClPs_LineScb_0 DFC_b.LDF_IgnClPs_LineScb_1 DFC_b.LDF_IgnClPs_LineScb_2 DFC_b.LDF_IgnClPs_LineScb_3 DFC_b.LDF_IgnClPs_LineScg_0 DFC_b.LDF_IgnClPs_LineScg_1 DFC_b.LDF_IgnClPs_LineScg_2 DFC_b.LDF_IgnClPs_LineScg_3 DFC_b.LDF_KRVEKOEVAB DFC_b.LDF_KRVEKOEVAB0 DFC_b.LDF_KRVEKOEVAB1 DFC_b.LDF_KRVEKOEVAB2 DFC_b.LDF_KRVEKOEVAB3 DFC_b.LDF_UegoSigEcuAsicS1B1 DFC_b.LDF_UegoSigEcuComS1B1 DFC_b.LDF_UegoSigSnsrS1B1 DFC_b.LDF_UegoSigWireOlApesS1B1 DFC_b.LDF_UegoSigWireOlIpeS1B1 DFC_b.LDF_UegoSigWireOlReS1B1 DFC_b.LDF_UegoSigWireRCmpS1B1 DFC_b.LDF_UegoSigWireScbS1B1 DFC_b.LDF_UegoSigWireScgS1B1 DFC_b.LDF_AfsPhyRngHiB1 DFC_b.LDF_AfsPhyRngLoB1 DFC_b.LDF_AirCCmprOL DFC_b.LDF_AirCCmprOvrTemp DFC_b.LDF_AirCCmprSCB DFC_b.LDF_AirCCmprSCG DFC_b.LDF_AltErr DFC_b.LDF_BattUSRCMax DFC_b.LDF_BattUSRCMin DFC_b.LDF_ComChksTCU1 DFC_b.LDF_ComChksTCU11 DFC_b.LDF_ComChksTCU12 DFC_b.LDF_ComChksTCU13 DFC_b.LDF_ComChksTCU2 DFC_b.LDF_ComChksTCU3 DFC_b.LDF_ComChksTCU4 DFC_b.LDF_ComCntTCU1 DFC_b.LDF_ComCntTCU11 DFC_b.LDF_ComCntTCU12 DFC_b.LDF_ComCntTCU13 DFC_b.LDF_ComCntTCU2 DFC_b.LDF_ComCntTCU3 DFC_b.LDF_ComCntTCU4 DFC_b.LDF_ComTOutTCU01 DFC_b.LDF_ComTOutTCU02 DFC_b.LDF_ComTOutTCU1 DFC_b.LDF_ComTOutTCU11 DFC_b.LDF_ComTOutTCU12 DFC_b.LDF_ComTOutTCU13 DFC_b.LDF_ComTOutTCU14 DFC_b.LDF_ComTOutTCU2 DFC_b.LDF_ComTOutTCU3 DFC_b.LDF_ComTOutTCU4 DFC_b.LDF_DevLibBattUHi DFC_b.LDF_DevLibBattULo DFC_b.LDF_EGRVlvFailSafeActv DFC_b.LDF_EGRVlvGovDvtCld DFC_b.LDF_EGRVlvPhysSRCMax DFC_b.LDF_EGRVlvPhysSRCMin DFC_b.LDF_FanDIOOL_0 DFC_b.LDF_FanDIOOL_1 DFC_b.LDF_FanDIOOvrTemp_0 DFC_b.LDF_FanDIOOvrTemp_1 DFC_b.LDF_FanDIOSCB_0 DFC_b.LDF_FanDIOSCB_1 DFC_b.LDF_FanDIOSCG_0 DFC_b.LDF_FanDIOSCG_1 DFC_b.LDF_MRlyDcOL DFC_b.LDF_MRlyDcSCB DFC_b.LDF_MRlyDcSCG DFC_b.LDF_PSPOL DFC_b.LDF_PSPOvrTemp DFC_b.LDF_PSPSCB DFC_b.LDF_PSPSCG DFC_b.LDF_T50Err DFC_b.LDF_ThrVlvLoBattB1 DFC_b.LDF_UegoSigOperPlausS1B1 DFC_b.LDF_VehVPhysRngHi DFC_b.LDF_VehVSclOutOL DFC_b.LDF_VehVSclOutOT DFC_b.LDF_VehVSclOutSCB DFC_b.LDF_VehVSclOutSCG DFC_b.LDF_VehVSigFL DFC_b.LDF_VehVSigFR DFC_b.LDF_VehVSigRL DFC_b.LDF_VehVSigRR DFC_b.LDF_VehVSnsrARngHi DFC_b.LDF_VehVSnsrBRngHi DFC_b.LDF_VehVSpdRtyDiag DFC_b.LDF_DHFHD DFC_b.LDF_InjVlv_DI_DcDc DFC_b.LDF_InjVlv_DI_NoLd_0 DFC_b.LDF_InjVlv_DI_NoLd_1 DFC_b.LDF_InjVlv_DI_NoLd_2 DFC_b.LDF_InjVlv_DI_NoLd_3 DFC_b.LDF_InjVlv_DI_ScBnk_0 DFC_b.LDF_InjVlv_DI_ScBnk_1 DFC_b.LDF_InjVlv_DI_ScBnk_2 DFC_b.LDF_InjVlv_DI_ScBnk_3 DFC_b.LDF_InjVlv_DI_ScCyl_0 DFC_b.LDF_InjVlv_DI_ScCyl_1 DFC_b.LDF_InjVlv_DI_ScCyl_2 DFC_b.LDF_InjVlv_DI_ScCyl_3 DFC_b.LDF_InjVlv_DI_ScHsLs_0 DFC_b.LDF_InjVlv_DI_ScHsLs_1 DFC_b.LDF_InjVlv_DI_ScHsLs_2 DFC_b.LDF_InjVlv_DI_ScHsLs_3 DFC_b.LDF_MfPsDiaOpenLoad1 DFC_b.LDF_MfPsDiaScHiS1 DFC_b.LDF_MfPsDiaScHiSLowS1 DFC_b.LDF_MfPsDiaScLowS1 DFC_b.LDF_ACEvpTPhysRngHi DFC_b.LDF_ACEvpTPhysRngLo DFC_b.LDF_ACEvpTSRCMax DFC_b.LDF_ACEvpTSRCMin DFC_b.LDF_AfsRawSigRngHiB1 DFC_b.LDF_AfsRawSigRngLoB1 DFC_b.LDF_AfsSnsrErrB1 DFC_b.LDF_AirCClntPAnaSRCMax DFC_b.LDF_AirCClntPAnaSRCMin DFC_b.LDF_AirCSwtNpl DFC_b.LDF_AirCSwtSig DFC_b.LDF_Brk DFC_b.LDF_BrkBstSensSCB DFC_b.LDF_BrkBstSensSCG DFC_b.LDF_BrkSig DFC_b.LDF_ClthSig DFC_b.LDF_EGRVlvCurrLim DFC_b.LDF_EGRVlvOL DFC_b.LDF_EGRVlvOvrTemp DFC_b.LDF_EGRVlvSCB DFC_b.LDF_EGRVlvSCG DFC_b.LDF_EGRVlvSRCMax DFC_b.LDF_EGRVlvSRCMin DFC_b.LDF_HLSDemOvhtEngLim DFC_b.LDF_OilPSwmpSRCMax DFC_b.LDF_OilPSwmpSRCMin DFC_b.LDF_PIntkVUsLineHiB1 DFC_b.LDF_PIntkVUsLineLoB1 DFC_b.LDF_VehVPhysRngLo DFC_b.LDF_VehVSigCan DFC_b.LDF_VehVSigCanSafe DFC_b.LDF_VlvLftFbOilPSnsrIntk11SRCMax DFC_b.LDF_VlvLftFbOilPSnsrIntk11SRCMin DFC_b.LDF_ClthNpl DFC_b.LDF_GbxPNPosnDrvCdn DFC_b.LDF_GbxPNPosnPlausy DFC_b.LDF_AfsSigErrLineHiB1 DFC_b.LDF_AfsSigErrLineLoB1 DFC_b.LDF_PEnvCcMax DFC_b.LDF_PEnvCcMin DFC_b.LDF_PEnvRngChkMax DFC_b.LDF_PEnvRngChkMin DFC_b.LDF_PEnvSnsrPlaus DFC_b.LDF_UEGOHeatrRlyPsOLS1B1 DFC_b.LDF_UEGOHeatrRlyPsSCBS1B1 DFC_b.LDF_UEGOHeatrRlyPsSCGS1B1 DFC_b.LDF_UegoHeatrWireOlS1B1 DFC_b.LDF_UegoHeatrWireScbS1B1 DFC_b.LDF_UegoHeatrWireScgS1B1 DFC_b.LDF_KnDetSens1PortAMax DFC_b.LDF_KnDetSens1PortAMin DFC_b.LDF_KnDetSens1PortBMax DFC_b.LDF_KnDetSens1PortBMin DFC_b.LDF_Clth2ONStuck DFC_b.LDF_Clth2ONStuckLdc DFC_b.LDF_Clth3ONStuckLdc DFC_b.LDF_Clth3ONStuckPostDrv DFC_b.LDF_Clth4ONStuck DFC_b.LDF_Clth4ONStuckLdc DFC_b.LDF_ComBCMUnit DFC_b.LDF_ComDLCTCU01 DFC_b.LDF_ComDLCTCU02 DFC_b.LDF_ComDLCTCU1 DFC_b.LDF_ComDLCTCU11 DFC_b.LDF_ComDLCTCU12 DFC_b.LDF_ComDLCTCU13 DFC_b.LDF_ComDLCTCU14 DFC_b.LDF_ComDLCTCU2 DFC_b.LDF_ComDLCTCU3 DFC_b.LDF_ComDLCTCU4 DFC_b.LDF_ComEPSUnit DFC_b.LDF_ComIDASBUnit DFC_b.LDF_ComIMGUnit DFC_b.LDF_ComMETUnit DFC_b.LDF_ComSRSUnit DFC_b.LDF_ComVSAUnit DFC_b.LDF_EbsSocFlt DFC_b.LDF_I14229VINErr DFC_b.LDF_InjCatHeatgErr DFC_b.LDF_InjSysMulInjDiagErr DFC_b.LDF_LLRHmax DFC_b.LDF_LLRHmin DFC_b.LDF_LLRHnpl DFC_b.LDF_LLRKHmax DFC_b.LDF_LLRKHmin DFC_b.LDF_LLRKHnpl DFC_b.LDF_LinACGUnit DFC_b.LDF_LinAEVUnit DFC_b.LDF_LinEBSUnit DFC_b.LDF_RoughRoad DFC_b.LDF_SiaEEPRdErr DFC_b.LDF_SiaEEPWrngCod DFC_b.LDF_UegoHeatrStrtS1B1 DFC_b.LDF_BusDiagCANAPPLBusOff DFC_b.LDF_BusDiagCANCANCBusOff DFC_b.LDF_BusDiagCANVEHICLEBusOff DFC_b.LDF_RBA_IODIAGPWR_rba_IoExtCy329_SignalVltSply_0 DFC_b.LDF_RBA_IODIAGPWR_rba_IoExtCy329_SignalVltSply_0OT DFC_b.LDF_RBA_IODIAGPWR_rba_IoExtCy329_SignalVltSply_0OV DFC_b.LDF_RBA_IODIAGPWR_rba_IoExtCy329_SignalVltSply_0SCG DFC_b.LDF_RBA_IODIAGPWR_rba_IoExtCy329_SignalVltSply_0UV DFC_b.LDF_RBA_IODIAGPWR_rba_IoExtCy329_SignalVltSply_1 DFC_b.LDF_RBA_IODIAGPWR_rba_IoExtCy329_SignalVltSply_1OT DFC_b.LDF_RBA_IODIAGPWR_rba_IoExtCy329_SignalVltSply_1OV DFC_b.LDF_RBA_IODIAGPWR_rba_IoExtCy329_SignalVltSply_1SCG DFC_b.LDF_RBA_IODIAGPWR_rba_IoExtCy329_SignalVltSply_1UV DFC_b.LDF_RBA_IODIAGPWR_rba_IoExtCy329_SignalVltSply_2 DFC_b.LDF_RBA_IODIAGPWR_rba_IoExtCy329_SignalVltSply_2OT DFC_b.LDF_RBA_IODIAGPWR_rba_IoExtCy329_SignalVltSply_2OV DFC_b.LDF_RBA_IODIAGPWR_rba_IoExtCy329_SignalVltSply_2SCG DFC_b.LDF_RBA_IODIAGPWR_rba_IoExtCy329_SignalVltSply_2UV DFC_b.LDF_CAN_E_TIMEOUT DFC_b.LDF_LIN_E_TIMEOUT DFC_b.LDF_MRlyOL DFC_b.LDF_MRlySCB DFC_b.LDF_MRlySCG DFC_b.LDF_rba_MultiStackTrace_Threshold DFC_b.LDF_BSWM_E_ACTION_FAILED DFC_b.LDF_BSWM_E_INTRPTQUEUE_FULL DFC_b.LDF_RBA_IOEXTLIB_KEEPALIVE_DRV DFC_b.LDF_RBA_IOEXTLIB_KEEPALIVE_INI DFC_b.LDF_rba_IoSigRtc_StopCounter DFC_b.LDF_rba_MRly_Diag_Stk_Event DFC_b.LDF_rba_MemDiag_MemReadErr DFC_b.LDF_rba_MemDiag_MemWrErr DFC_b.LDF_rba_SyC_IrrSwOffTrigEngRun_Event DFC_b.LDF_rba_T15_Diag_ComInVld_Event DFC_b.LDF_rba_T15_Diag_ComOff_HwOn_Event DFC_b.LDF_rba_T15_Diag_ComOn_HwOff_Event DFC_b.LDF_AAVmin DFC_b.LDF_AGRSUS DFC_b.LDF_AfsPlausDiagHi DFC_b.LDF_AfsPlausDiagLo DFC_b.LDF_AfsVrntDiagErrB1 DFC_b.LDF_AppAllSnsrDfct DFC_b.LDF_BBKRnldg DFC_b.LDF_BBKRsyne DFC_b.LDF_BattUStdbyDiaOL DFC_b.LDF_BigLeakIntkMnfldEmiInfl DFC_b.LDF_BlkdLineTank DFC_b.LDF_BrkMnSwtContOnWarnLmp DFC_b.LDF_BrkMnSwtNotStpWarnLmp DFC_b.LDF_BrkRdntSwtContOnWarnLmp DFC_b.LDF_BrkRdntSwtNotStpWarnLmp DFC_b.LDF_CEngDsTColdStrtMax DFC_b.LDF_CEngDsTColdStrtMin DFC_b.LDF_CEngDsTImps DFC_b.LDF_CEngDsTPlausHSC DFC_b.LDF_CEngDsTPlausLSC DFC_b.LDF_CEngDsTPlausSTC DFC_b.LDF_CEngDsTSRCMax DFC_b.LDF_CEngDsTSRCMin DFC_b.LDF_CEngDsTSig DFC_b.LDF_CEngUsTColdStrtMax DFC_b.LDF_CEngUsTColdStrtMin DFC_b.LDF_CEngUsTLooseCnctn DFC_b.LDF_CEngUsTSRCMax DFC_b.LDF_CEngUsTSRCMin DFC_b.LDF_ComDCDCACCFailr DFC_b.LDF_DCDCFltDet DFC_b.LDF_DKRSA DFC_b.LDF_DKVSmax DFC_b.LDF_DKnpl DFC_b.LDF_DSKVRmax DFC_b.LDF_DSKVRmin DFC_b.LDF_DSKVRnpl DFC_b.LDF_DSKVRsig DFC_b.LDF_DSKVSsig DFC_b.LDF_DSSmax DFC_b.LDF_DSTDmax DFC_b.LDF_DSTEmax DFC_b.LDF_DSTEmin DFC_b.LDF_DSTOFmax DFC_b.LDF_DSTRmax DFC_b.LDF_DSTRmin DFC_b.LDF_DSTRnpl DFC_b.LDF_DSTRsig DFC_b.LDF_DSTTI DFC_b.LDF_DSUmax DFC_b.LDF_DiagCpv1DteskLoLoadStuckClsd DFC_b.LDF_DiagCpv1DteskLoLoadStuckOpen DFC_b.LDF_EGRVlvDrftClsd DFC_b.LDF_EGRVlvDrftOpn DFC_b.LDF_EGRVlvJamVlvClsd DFC_b.LDF_EGRVlvJamVlvOpn DFC_b.LDF_EGRVlvSprgBrk DFC_b.LDF_EGRVlvTempMdlEEPErr DFC_b.LDF_EGRVlvTmpErr DFC_b.LDF_EGSDUS2B1LtrDly DFC_b.LDF_EGSDUS2B1LtrPT1 DFC_b.LDF_EGSDUS2B1RtlDly DFC_b.LDF_EGSDUS2B1RtlPT1 DFC_b.LDF_EGSDUS2B1TarLean DFC_b.LDF_EGSDUS2B1TarRich DFC_b.LDF_EONVmax DFC_b.LDF_ETAKHLmax DFC_b.LDF_ETAKHTmax DFC_b.LDF_ETHSEmax DFC_b.LDF_ETHSEmin DFC_b.LDF_ETHSFmax DFC_b.LDF_ETHSFmin DFC_b.LDF_ETHSFsig DFC_b.LDF_ETHSNPWmax DFC_b.LDF_ETHSNPWmin DFC_b.LDF_ETHSNPWsig DFC_b.LDF_ETHSPLnpl DFC_b.LDF_ETHSTPLnpl DFC_b.LDF_EngICO DFC_b.LDF_EngPrtOvrSpdMon DFC_b.LDF_EpmCaSI1ErrSig DFC_b.LDF_EpmCaSI1MntErr DFC_b.LDF_EpmCaSI1NoSigMax DFC_b.LDF_EpmCaSI1NoSigMin DFC_b.LDF_EpmCaSI1OfsErr DFC_b.LDF_EpmCrSDGI DFC_b.LDF_EpmCrSErrSig DFC_b.LDF_EpmCrSNoSig DFC_b.LDF_EtaEngIdleNonCsers DFC_b.LDF_EtaEngPtlNonCsers DFC_b.LDF_FRAmax DFC_b.LDF_FRAmin DFC_b.LDF_FSTEmax DFC_b.LDF_FSTEmin DFC_b.LDF_FSTRmax DFC_b.LDF_FSTRmin DFC_b.LDF_FSTRnpl DFC_b.LDF_FSTmax DFC_b.LDF_FTDLAmax DFC_b.LDF_FTDLAmin DFC_b.LDF_FuPHiSnsrEleclmax DFC_b.LDF_FuPHiSnsrEleclmin DFC_b.LDF_FuPHiSnsrEleclnpl DFC_b.LDF_FuPHiSnsrURngMax DFC_b.LDF_FuPHiSnsrURngMin DFC_b.LDF_FuSnsrPhyRngMaxErr DFC_b.LDF_FuSnsrPhyRngMinErr DFC_b.LDF_GEVlvLockPinDiagIntkB1 DFC_b.LDF_GEVlvPhaSlowIntkB1 DFC_b.LDF_GEVlvPhaTargIntkB1 DFC_b.LDF_GbxRvsSwtStk DFC_b.LDF_HDRKHmax DFC_b.LDF_HDRKHmin DFC_b.LDF_HDRPLmax DFC_b.LDF_HDRPLmin DFC_b.LDF_HDRmax DFC_b.LDF_HDRmin DFC_b.LDF_HEGOS2B1ElecMax DFC_b.LDF_HEGOS2B1ElecMin DFC_b.LDF_HEGOS2B1ElecSig DFC_b.LDF_HEGOS2B1HtgNpl DFC_b.LDF_HEV00max DFC_b.LDF_HEV01max DFC_b.LDF_HEV02max DFC_b.LDF_HEV03max DFC_b.LDF_HEVE0max DFC_b.LDF_HEVE1max DFC_b.LDF_HFMmax DFC_b.LDF_HiPSysHiPMaxLimExcdd DFC_b.LDF_IVGdiCtlCvoErrMax_0 DFC_b.LDF_IVGdiCtlCvoErrMax_1 DFC_b.LDF_IVGdiCtlCvoErrMax_2 DFC_b.LDF_IVGdiCtlCvoErrMax_3 DFC_b.LDF_IVGdiCtlCvoErrMin_0 DFC_b.LDF_IVGdiCtlCvoErrMin_1 DFC_b.LDF_IVGdiCtlCvoErrMin_2 DFC_b.LDF_IVGdiCtlCvoErrMin_3 DFC_b.LDF_IVGdiCtlCvoErrMinMax DFC_b.LDF_IVGdiCtlCvoSigPlausErrSmrCdn DFC_b.LDF_IVGdiCtl_CvoErr DFC_b.LDF_IVGdiCtl_CvoSigPlaus_0 DFC_b.LDF_IVGdiCtl_CvoSigPlaus_1 DFC_b.LDF_IVGdiCtl_CvoSigPlaus_2 DFC_b.LDF_IVGdiCtl_CvoSigPlaus_3 DFC_b.LDF_IntkAirTAirFltDsCrssMax DFC_b.LDF_IntkAirTAirFltDsCrssMin DFC_b.LDF_IntkAirTAirFltDsHSCMax DFC_b.LDF_IntkAirTAirFltDsImps DFC_b.LDF_IntkAirTAirFltDsPRCMax DFC_b.LDF_IntkAirTAirFltDsPRCMin DFC_b.LDF_IntkAirTAirFltDsSRCMax DFC_b.LDF_IntkAirTAirFltDsSRCMin DFC_b.LDF_IntkAirTAirFltDsSTC DFC_b.LDF_IntkAirTIntkMnfldCrssMax DFC_b.LDF_IntkAirTIntkMnfldCrssMin DFC_b.LDF_IntkAirTIntkMnfldHSCMax DFC_b.LDF_IntkAirTIntkMnfldImps DFC_b.LDF_IntkAirTIntkMnfldPRCMax DFC_b.LDF_IntkAirTIntkMnfldPRCMin DFC_b.LDF_IntkAirTIntkMnfldSRCMax DFC_b.LDF_IntkAirTIntkMnfldSRCMin DFC_b.LDF_IntkAirTIntkMnfldSTC DFC_b.LDF_KRREGRLMX DFC_b.LDF_KRVEKOCVLCI DFC_b.LDF_KRVEKOENCHMT DFC_b.LDF_KRVEKOENCHMT0 DFC_b.LDF_KRVEKOENCHMT1 DFC_b.LDF_KRVEKOENCHMT2 DFC_b.LDF_KRVEKOENCHMT3 DFC_b.LDF_KRVEKOENCHMT4 DFC_b.LDF_KRVEKOENCHMT5 DFC_b.LDF_KRVEKOENCHMT6 DFC_b.LDF_KRVEKOENCHMT7 DFC_b.LDF_KRVEKORLMX DFC_b.LDF_KRVEKORLMXL DFC_b.LDF_KS1max DFC_b.LDF_KS1min DFC_b.LDF_LMmax DFC_b.LDF_LZSRnpl DFC_b.LDF_LamDynDiagS1B1 DFC_b.LDF_LeakIntkMnfldEmiInfl DFC_b.LDF_LinFrameErrDCDC DFC_b.LDF_LinOverrunErrDCDC DFC_b.LDF_MD00max DFC_b.LDF_MDBmax DFC_b.LDF_MDCat DFC_b.LDF_MDCatCrit DFC_b.LDF_MDCatCurr DFC_b.LDF_MDCyl_0 DFC_b.LDF_MDCyl_1 DFC_b.LDF_MDCyl_2 DFC_b.LDF_MDCyl_3 DFC_b.LDF_MDEmi DFC_b.LDF_MDEmiStrt DFC_b.LDF_MDFco DFC_b.LDF_MDMpl DFC_b.LDF_MDSegTiAdpn DFC_b.LDF_MDmax DFC_b.LDF_MFuOilMax DFC_b.LDF_MOXEMM_SMU_ALM0_0 DFC_b.LDF_MOXEMM_SMU_ALM0_1 DFC_b.LDF_MOXEMM_SMU_ALM0_10 DFC_b.LDF_MOXEMM_SMU_ALM0_11 DFC_b.LDF_MOXEMM_SMU_ALM0_13 DFC_b.LDF_MOXEMM_SMU_ALM0_14 DFC_b.LDF_MOXEMM_SMU_ALM0_2 DFC_b.LDF_MOXEMM_SMU_ALM0_22 DFC_b.LDF_MOXEMM_SMU_ALM0_23 DFC_b.LDF_MOXEMM_SMU_ALM0_4 DFC_b.LDF_MOXEMM_SMU_ALM0_5 DFC_b.LDF_MOXEMM_SMU_ALM0_7 DFC_b.LDF_MOXEMM_SMU_ALM0_8 DFC_b.LDF_MOXEMM_SMU_ALM10_16 DFC_b.LDF_MOXEMM_SMU_ALM10_17 DFC_b.LDF_MOXEMM_SMU_ALM10_21 DFC_b.LDF_MOXEMM_SMU_ALM11_0 DFC_b.LDF_MOXEMM_SMU_ALM11_1 DFC_b.LDF_MOXEMM_SMU_ALM11_2 DFC_b.LDF_MOXEMM_SMU_ALM11_3 DFC_b.LDF_MOXEMM_SMU_ALM11_4 DFC_b.LDF_MOXEMM_SMU_ALM11_5 DFC_b.LDF_MOXEMM_SMU_ALM11_8 DFC_b.LDF_MOXEMM_SMU_ALM11_9 DFC_b.LDF_MOXEMM_SMU_ALM1_0 DFC_b.LDF_MOXEMM_SMU_ALM1_1 DFC_b.LDF_MOXEMM_SMU_ALM1_10 DFC_b.LDF_MOXEMM_SMU_ALM1_11 DFC_b.LDF_MOXEMM_SMU_ALM1_13 DFC_b.LDF_MOXEMM_SMU_ALM1_14 DFC_b.LDF_MOXEMM_SMU_ALM1_2 DFC_b.LDF_MOXEMM_SMU_ALM1_22 DFC_b.LDF_MOXEMM_SMU_ALM1_23 DFC_b.LDF_MOXEMM_SMU_ALM1_4 DFC_b.LDF_MOXEMM_SMU_ALM1_5 DFC_b.LDF_MOXEMM_SMU_ALM1_7 DFC_b.LDF_MOXEMM_SMU_ALM1_8 DFC_b.LDF_MOXEMM_SMU_ALM21_0 DFC_b.LDF_MOXEMM_SMU_ALM21_16 DFC_b.LDF_MOXEMM_SMU_ALM21_3 DFC_b.LDF_MOXEMM_SMU_ALM2_1 DFC_b.LDF_MOXEMM_SMU_ALM2_10 DFC_b.LDF_MOXEMM_SMU_ALM2_11 DFC_b.LDF_MOXEMM_SMU_ALM2_13 DFC_b.LDF_MOXEMM_SMU_ALM2_14 DFC_b.LDF_MOXEMM_SMU_ALM2_22 DFC_b.LDF_MOXEMM_SMU_ALM2_23 DFC_b.LDF_MOXEMM_SMU_ALM2_4 DFC_b.LDF_MOXEMM_SMU_ALM2_5 DFC_b.LDF_MOXEMM_SMU_ALM2_7 DFC_b.LDF_MOXEMM_SMU_ALM2_8 DFC_b.LDF_MOXEMM_SMU_ALM6_0 DFC_b.LDF_MOXEMM_SMU_ALM6_11 DFC_b.LDF_MOXEMM_SMU_ALM6_12 DFC_b.LDF_MOXEMM_SMU_ALM6_14 DFC_b.LDF_MOXEMM_SMU_ALM6_15 DFC_b.LDF_MOXEMM_SMU_ALM6_17 DFC_b.LDF_MOXEMM_SMU_ALM6_18 DFC_b.LDF_MOXEMM_SMU_ALM6_20 DFC_b.LDF_MOXEMM_SMU_ALM6_21 DFC_b.LDF_MOXEMM_SMU_ALM6_25 DFC_b.LDF_MOXEMM_SMU_ALM6_4 DFC_b.LDF_MOXEMM_SMU_ALM6_5 DFC_b.LDF_MOXEMM_SMU_ALM6_7 DFC_b.LDF_MOXEMM_SMU_ALM6_8 DFC_b.LDF_MOXEMM_SMU_ALM7_1 DFC_b.LDF_MOXEMM_SMU_ALM7_12 DFC_b.LDF_MOXEMM_SMU_ALM7_13 DFC_b.LDF_MOXEMM_SMU_ALM7_14 DFC_b.LDF_MOXEMM_SMU_ALM7_15 DFC_b.LDF_MOXEMM_SMU_ALM7_16 DFC_b.LDF_MOXEMM_SMU_ALM7_17 DFC_b.LDF_MOXEMM_SMU_ALM7_2 DFC_b.LDF_MOXEMM_SMU_ALM7_20 DFC_b.LDF_MOXEMM_SMU_ALM7_25 DFC_b.LDF_MOXEMM_SMU_ALM7_26 DFC_b.LDF_MOXEMM_SMU_ALM7_28 DFC_b.LDF_MOXEMM_SMU_ALM7_29 DFC_b.LDF_MOXEMM_SMU_ALM7_30 DFC_b.LDF_MOXEMM_SMU_ALM7_31 DFC_b.LDF_MOXEMM_SMU_ALM8_0 DFC_b.LDF_MOXEMM_SMU_ALM8_1 DFC_b.LDF_MOXEMM_SMU_ALM8_10 DFC_b.LDF_MOXEMM_SMU_ALM8_11 DFC_b.LDF_MOXEMM_SMU_ALM8_12 DFC_b.LDF_MOXEMM_SMU_ALM8_16 DFC_b.LDF_MOXEMM_SMU_ALM8_18 DFC_b.LDF_MOXEMM_SMU_ALM8_2 DFC_b.LDF_MOXEMM_SMU_ALM8_3 DFC_b.LDF_MOXEMM_SMU_ALM8_31 DFC_b.LDF_MOXEMM_SMU_ALM8_4 DFC_b.LDF_MOXEMM_SMU_ALM9_0 DFC_b.LDF_MOXEMM_SMU_ALM9_15 DFC_b.LDF_MOXEMM_SMU_ALM9_3 DFC_b.LDF_MoCADCNTP DFC_b.LDF_MoCADCTst DFC_b.LDF_MoCSOPICO DFC_b.LDF_MoFAPP DFC_b.LDF_MoFAirFilgPrdc DFC_b.LDF_MoFAirFlCtOffGdi DFC_b.LDF_MoFAirFlCylGdi DFC_b.LDF_MoFAirFlFF DFC_b.LDF_MoFAirFlIn DFC_b.LDF_MoFAirFlMixCtlGdiChkAirFl DFC_b.LDF_MoFAirFlMixCtlGdiChkCtrl DFC_b.LDF_MoFAirFlMode DFC_b.LDF_MoFESpd DFC_b.LDF_MoFIACo DFC_b.LDF_MoFICOL1 DFC_b.LDF_MoFICOL2 DFC_b.LDF_MoFStrt DFC_b.LDF_MoFTrqCmp DFC_b.LDF_MoFTrqCmpMax DFC_b.LDF_MoFTrqCmpMin DFC_b.LDF_MoFVarPostBldSel DFC_b.LDF_MoXEMMHwLTMCUFW DFC_b.LDF_MoXEMMHwLTMonBIST DFC_b.LDF_MoXEMMHwLTRegMonTest DFC_b.LDF_MoXEMMHwLTStbySMUAlvTest DFC_b.LDF_MoXEMMHwLTTempSens DFC_b.LDF_MoXEMMHwLTUCBCfg DFC_b.LDF_NWSEmax DFC_b.LDF_NWSmax DFC_b.LDF_OCWDAABEActv DFC_b.LDF_OCWDACom DFC_b.LDF_OCWDAErrPin DFC_b.LDF_OCWDAOvrVltg DFC_b.LDF_ORAmax DFC_b.LDF_ORAmin DFC_b.LDF_OilPPlaus DFC_b.LDF_PLLSUmax DFC_b.LDF_PLLSUmin DFC_b.LDF_PSR1max DFC_b.LDF_PSRBmax DFC_b.LDF_PSRBmin DFC_b.LDF_PSRPmax DFC_b.LDF_PSRPmin DFC_b.LDF_PSRPsig DFC_b.LDF_PSRmax DFC_b.LDF_PUmax DFC_b.LDF_P_VSE11_OL DFC_b.LDF_P_VSE11_SCB DFC_b.LDF_P_VSE11_SCG DFC_b.LDF_PhyHighAPP1 DFC_b.LDF_PhyHighAPP2 DFC_b.LDF_PhyLowAPP1 DFC_b.LDF_PhyLowAPP2 DFC_b.LDF_SRCHighAPP1 DFC_b.LDF_SRCHighAPP2 DFC_b.LDF_SRCLowAPP1 DFC_b.LDF_SRCLowAPP2 DFC_b.LDF_SSpMon2 DFC_b.LDF_STHDRmax DFC_b.LDF_SWReset_0 DFC_b.LDF_SWReset_1 DFC_b.LDF_SWReset_2 DFC_b.LDF_SyncAPP DFC_b.LDF_TANKLnpl DFC_b.LDF_TAmax_Dummy DFC_b.LDF_TESFmax DFC_b.LDF_TESGmax DFC_b.LDF_TKAEmax DFC_b.LDF_TKAEmin DFC_b.LDF_TKARmax DFC_b.LDF_TKARnpl DFC_b.LDF_TMmax_Dummy DFC_b.LDF_TUMmax_Dummy DFC_b.LDF_TWCDPriCatB1 DFC_b.LDF_ThrVlvClsdPosnFirstOffsLrnImpoB1 DFC_b.LDF_ThrVlvClsdPosnOffsLrnImpoB1 DFC_b.LDF_ThrVlvClsdPosnOffsLrnMaxB1 DFC_b.LDF_ThrVlvClsdPosnOffsLrnMinB1 DFC_b.LDF_ThrVlvCtrlDeB1 DFC_b.LDF_ThrVlvDycB1 DFC_b.LDF_ThrVlvLimpAirPosnMaxAbsltDriftB1 DFC_b.LDF_ThrVlvLimpAirPosnMaxB1 DFC_b.LDF_ThrVlvLimpAirPosnMaxRelDriftB1 DFC_b.LDF_ThrVlvLimpAirPosnMinB1 DFC_b.LDF_ThrVlvOpenLoadB1 DFC_b.LDF_ThrVlvOpenSprgB1 DFC_b.LDF_ThrVlvOpenSprgSprdB1 DFC_b.LDF_ThrVlvOpenSprgTwnB1 DFC_b.LDF_ThrVlvOverTB1 DFC_b.LDF_ThrVlvRetSprgB1 DFC_b.LDF_ThrVlvRetSprgSprdB1 DFC_b.LDF_ThrVlvRetSprgTwnB1 DFC_b.LDF_ThrVlvSens1MaxB1 DFC_b.LDF_ThrVlvSens1NplB1 DFC_b.LDF_ThrVlvSens2MaxB1 DFC_b.LDF_ThrVlvSens2MinB1 DFC_b.LDF_ThrVlvSens2NplB1 DFC_b.LDF_ThrVlvShoCircB1 DFC_b.LDF_ThrVlvSpiErrB1 DFC_b.LDF_ThrvlvSens1MinB1 DFC_b.LDF_TiOffTBasdChkFast DFC_b.LDF_TiOffTBasdChkSlow DFC_b.LDF_UEGOSnsrMntdS1B1 DFC_b.LDF_VehVSig DFC_b.LDF_VlvLftFbSwtIntk11SpclFail DFC_b.LDF_VlvLftFbSwtIntk11StdFail DFC_b.TSC_AAVEmax DFC_b.TSC_AAVEmin DFC_b.TSC_AAVEsig DFC_b.TSC_AltIOACGFailr DFC_b.TSC_AltIOACGHiVltg DFC_b.TSC_AltIOACGLoVltg DFC_b.TSC_AltIOACGTHi DFC_b.TSC_AltIODConnACG DFC_b.TSC_BGOELWAF DFC_b.TSC_BattUHiFailr DFC_b.TSC_BattULoFailr DFC_b.TSC_BrkBstPDriftHiErr DFC_b.TSC_BrkBstPDriftLoErr DFC_b.TSC_BrkBstPSnsrStuck DFC_b.TSC_BrkMnSwtContOn DFC_b.TSC_BrkMnSwtNotStp DFC_b.TSC_BrkNpl DFC_b.TSC_BrkRdntSwtContOn DFC_b.TSC_BrkRdntSwtNotStp DFC_b.TSC_Clth3ONStuck DFC_b.TSC_Clth4OFFStuck DFC_b.TSC_ClthOFFStuck DFC_b.TSC_ClthONStuck DFC_b.TSC_ClthStkFailInfo DFC_b.TSC_ComACFailInfo DFC_b.TSC_ComATFTValErr DFC_b.TSC_ComATMILReq DFC_b.TSC_ComAYCAChksum DFC_b.TSC_ComAYCARingCnt DFC_b.TSC_ComAYCATOut DFC_b.TSC_ComAYCDChkSum DFC_b.TSC_ComAYCDTOut DFC_b.TSC_ComAYCFChksum DFC_b.TSC_ComAYCFRingCnt DFC_b.TSC_ComAYCFTOut DFC_b.TSC_ComAYCGChksum DFC_b.TSC_ComAYCGRingCnt DFC_b.TSC_ComAYCGTOut DFC_b.TSC_ComAYCIChkSum DFC_b.TSC_ComAYCIRingCnt DFC_b.TSC_ComAYCITOut DFC_b.TSC_ComBCM1ChkSum DFC_b.TSC_ComBCM1RingCnt DFC_b.TSC_ComBCM1TOut DFC_b.TSC_ComCANABusOffErr DFC_b.TSC_ComCANBBusOffErr DFC_b.TSC_ComCANCBusOffErr DFC_b.TSC_ComCGW1ChkSum DFC_b.TSC_ComCGW1RingCnt DFC_b.TSC_ComCGW1TOut DFC_b.TSC_ComConvBoostErr DFC_b.TSC_ComConvSlipErr DFC_b.TSC_ComDCDCPrfmncErr DFC_b.TSC_ComDCDCTempWarn DFC_b.TSC_ComEAT10Chksum DFC_b.TSC_ComEAT10RingCnt DFC_b.TSC_ComEAT10TOut DFC_b.TSC_ComEAT11ChkSum DFC_b.TSC_ComEAT11RingCnt DFC_b.TSC_ComEAT11TOut DFC_b.TSC_ComEAT12ChkSum DFC_b.TSC_ComEAT12RingCnt DFC_b.TSC_ComEAT12TOut DFC_b.TSC_ComEAT13ChkSum DFC_b.TSC_ComEAT13RingCnt DFC_b.TSC_ComEAT13TOut DFC_b.TSC_ComEAT1Chksum DFC_b.TSC_ComEAT1RingCnt DFC_b.TSC_ComEAT1TOut DFC_b.TSC_ComEAT2ChkSum DFC_b.TSC_ComEAT2RingCnt DFC_b.TSC_ComEAT2TOut DFC_b.TSC_ComEAT4ChkSum DFC_b.TSC_ComEAT4RingCnt DFC_b.TSC_ComEAT4TOut DFC_b.TSC_ComEAT6Chksum DFC_b.TSC_ComEAT6RingCnt DFC_b.TSC_ComEAT6TOut DFC_b.TSC_ComEAT7Chksum DFC_b.TSC_ComEAT7RingCnt DFC_b.TSC_ComEAT7TOut DFC_b.TSC_ComEAT8Chksum DFC_b.TSC_ComEAT8RingCnt DFC_b.TSC_ComEAT8TOut DFC_b.TSC_ComEATAChksum DFC_b.TSC_ComEATARingCnt /end OUT_MEASUREMENT
 FUNCTION_VERSION "30000.33.0_1.1.0" /end FUNCTION
/begin COMPU_METHOD DFC_OneToOne "" RAT_FUNC "%6.2" "-" COEFFS 0 1 0 0 0 1 /end COMPU_METHOD
/end MODULE
/end PROJECT
