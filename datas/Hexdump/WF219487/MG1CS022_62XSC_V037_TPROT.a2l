ASAP2_VERSION 1 60
/begin PROJECT MG1CS022 "MG1CS022"
/begin HEADER "" VERSION "MG1CS022_62XSC_V037_TPROT" PROJECT_NO MG1CS022 /end HEADER
/begin MODULE DIM ""
/begin MOD_COMMON "" BYTE_ORDER MSB_LAST ALIGNMENT_BYTE 1 ALIGNMENT_WORD 2 ALIGNMENT_LONG 4 ALIGNMENT_INT64 4 ALIGNMENT_FLOAT32_IEEE 4 ALIGNMENT_FLOAT64_IEEE 4 DATA_SIZE 32 /end MOD_COMMON
/begin CHARACTERISTIC AirMod_agChartcDeltaPrdnHomMod_T "Characteristic curve delta prediction angle for homogenous mode" CURVE 0x80525CB4 RB_Curve_S16_S16 49151.25 kw_q0p75 -24576.00 24575.25 FORMAT "%8.2"
 /begin AXIS_DESCR STD_AXIS CEngDsT_t Temp_Cels 4 -3549.940 3003.560 FORMAT "%8.3" DEPOSIT ABSOLUTE /end AXIS_DESCR
/end CHARACTERISTIC
/begin CHARACTERISTIC AirMod_nrSyncAirChrgPredOff_C "Offset for the amount of cylinders between charge and charge prediction" VALUE 0x80525CC6 RB_Val_Ws8 255.0 OneToOne -128.0 127.0 FORMAT "%5.1" /end CHARACTERISTIC
/begin CHARACTERISTIC Blwr_uComBlwrURepl_C "AC-blower voltage replacement value in came of communication error" VALUE 0x80525FD6 RB_Val_Ws16 65535.00 Volt_q1 -32768.00 32767.00 FORMAT "%8.2" /end CHARACTERISTIC
/begin CHARACTERISTIC BrkBstP_aDecelBrkThdMax_C "Maximum deceleration brake threshold" VALUE 0x80525FF8 RB_Val_Ws16 65.53500 Acc -32.76800 32.76700 FORMAT "%8.5" /end CHARACTERISTIC
/begin CHARACTERISTIC BrkBstP_aDecelBrkThdMin_C "Minimum deceleration brake threshold" VALUE 0x80525FFA RB_Val_Ws16 65.53500 Acc -32.76800 32.76700 FORMAT "%8.5" /end CHARACTERISTIC
/begin CHARACTERISTIC BrkBstP_cntMstCylPVal_C "Frequency of integral calculation of master cylinder hydraulic pressure learning value" VALUE 0x80525FFC RB_Val_Wu16 65535.00 OneToOne 0.00 65535.00 FORMAT "%8.2" /end CHARACTERISTIC
/begin CHARACTERISTIC BrkBstP_ctDriftHi_C "High drift error counter threshold" VALUE 0x80525FFE RB_Val_Wu16 65535.00 OneToOne 0.00 65535.00 FORMAT "%8.2" /end CHARACTERISTIC
/begin CHARACTERISTIC BrkBstP_ctDriftLo_C "Low drift error counter threshold" VALUE 0x80526000 RB_Val_Wu16 65535.00 OneToOne 0.00 65535.00 FORMAT "%8.2" /end CHARACTERISTIC
/begin CHARACTERISTIC BrkBstP_ctVehStopThd_C "Vehicle stop count threshold" VALUE 0x80526002 RB_Val_Wu16 65535.00 OneToOne 0.00 65535.00 FORMAT "%8.2" /end CHARACTERISTIC
/begin CHARACTERISTIC BrkBstP_dpMstCyl_C "Change in master cylinder pressure limit" VALUE 0x80526004 RB_Val_Ws32 214748364.700 Pres 0.00 214748364.700 FORMAT "%13.3" EXTENDED_LIMITS -214748364.800 214748364.700 /end CHARACTERISTIC
/begin CHARACTERISTIC BrkBstP_flgSwtActv_C "Calibration switch to enable and disable the functionality" VALUE 0x80525FD8 RB_Val_Wboolean 1.00000000000 B_TRUE 0.00 1.00000000000 FORMAT "%13.11" /end CHARACTERISTIC
/begin CHARACTERISTIC BrkBstP_nVacPmp_C "Vacuum pump working speed" VALUE 0x80526008 RB_Val_Ws16 32767.50 EngN -16384.00 16383.50 FORMAT "%8.2" /end CHARACTERISTIC
/begin CHARACTERISTIC BrkBstP_pBrkBoostDiffThd_C "Difference in brake boost pressure threshold for stuck error finding" VALUE 0x8052600C RB_Val_Ws32 4294967295.00 Pres_hPa -2147483648.00 2147483647.00 FORMAT "%13.2" /end CHARACTERISTIC
/begin CHARACTERISTIC BrkBstP_pBrkNotPsd_C "Brake pressure when brake pedal not pressed" VALUE 0x80526010 RB_Val_Ws32 429496729.500 Pres -214748364.800 214748364.700 FORMAT "%13.3" /end CHARACTERISTIC
/begin CHARACTERISTIC BrkBstP_pCmpFldThd_C "Threshold value for Compensated Brake pressure value" VALUE 0x80526014 RB_Val_Ws32 429496729.500 Pres -214748364.800 214748364.700 FORMAT "%13.3" /end CHARACTERISTIC
/begin CHARACTERISTIC BrkBstP_pDifQntyHi_C "The amount limit value of zero hydraulic pressure correction value change iDifference quantity large j" VALUE 0x80526018 RB_Val_Ws32 429496729.500 Pres -214748364.800 214748364.700 FORMAT "%13.3" /end CHARACTERISTIC
/begin CHARACTERISTIC BrkBstP_pDifQntyLo_C "The amount limit value of zero hydraulic pressure correction value change iDifference quantity small j" VALUE 0x8052601C RB_Val_Ws32 429496729.500 Pres -214748364.800 214748364.700 FORMAT "%13.3" /end CHARACTERISTIC
/begin CHARACTERISTIC BrkBstP_pDifQntyLrgJdg_C "Difference quantity large judgment value of zero hydraulic pressure learning value and correction value" VALUE 0x80526020 RB_Val_Ws32 429496729.500 Pres -214748364.800 214748364.700 FORMAT "%13.3" /end CHARACTERISTIC
/begin CHARACTERISTIC BrkBstP_pDifQntyMid_C "The amount limit value of zero hydraulic pressure correction value change iDifference quantity middle j" VALUE 0x80526024 RB_Val_Ws32 429496729.500 Pres -214748364.800 214748364.700 FORMAT "%13.3" /end CHARACTERISTIC
/begin CHARACTERISTIC BrkBstP_pDifQntySmallJdg_C "Difference quantity smallness judgment value of zero hydraulic pressure learning value and correction value" VALUE 0x80526028 RB_Val_Ws32 429496729.500 Pres -214748364.800 214748364.700 FORMAT "%13.3" /end CHARACTERISTIC
/begin CHARACTERISTIC BrkBstP_pDriftHiThd_C "High saturated limit of brake booster pressure for drift error check" VALUE 0x8052602C RB_Val_Ws16 65535.00 Pres_hPa -32768.00 32767.00 FORMAT "%8.2" /end CHARACTERISTIC
/begin CHARACTERISTIC BrkBstP_pDriftLoThd_C "Low saturated limit of brake booster pressure for drift error check" VALUE 0x8052602E RB_Val_Ws16 65535.00 Pres_hPa -32768.00 32767.00 FORMAT "%8.2" /end CHARACTERISTIC
/begin CHARACTERISTIC BrkBstP_pFldPOffsMaxVal_C "Maximum Master cylinder hydraulic pressure receiving value" VALUE 0x80526030 RB_Val_Ws32 429496729.500 Pres -214748364.800 214748364.700 FORMAT "%13.3" /end CHARACTERISTIC
/begin CHARACTERISTIC BrkBstP_pFldPOffsMinVal_C "Minimum Master cylinder hydraulic pressure receiving value" VALUE 0x80526034 RB_Val_Ws32 429496729.500 Pres -214748364.800 214748364.700 FORMAT "%13.3" /end CHARACTERISTIC
/begin CHARACTERISTIC BrkBstP_pMstCylMax_C "Allowed master cylinder maximum threshold" VALUE 0x80526038 RB_Val_Ws32 429496729.500 Pres -214748364.800 214748364.700 FORMAT "%13.3" /end CHARACTERISTIC
/begin CHARACTERISTIC BrkBstP_pMstCylMin_C "Allowed master cylinder minimum threshold" VALUE 0x8052603C RB_Val_Ws32 429496729.500 Pres -214748364.800 214748364.700 FORMAT "%13.3" /end CHARACTERISTIC
/begin CHARACTERISTIC BrkBstP_pMstCylPIniVal_C "Zero master cylinder hydraulic pressure adjustment initial value" VALUE 0x80526040 RB_Val_Ws32 429496729.500 Pres -214748364.800 214748364.700 FORMAT "%13.3" /end CHARACTERISTIC
/begin CHARACTERISTIC BrkBstP_pMstCylSatMax_C "Maximum master cylinder saturated pressure" VALUE 0x80526044 RB_Val_Ws32 429496729.500 Pres -214748364.800 214748364.700 FORMAT "%13.3" /end CHARACTERISTIC
/begin CHARACTERISTIC BrkBstP_pMstCYlSatMin_C "Minimum master cylinder saturated pressure" VALUE 0x80526048 RB_Val_Ws32 429496729.500 Pres -214748364.800 214748364.700 FORMAT "%13.3" /end CHARACTERISTIC
/begin CHARACTERISTIC BrkBstP_pOutpEnaMask_C "Master cylinder pressure enable mask" VALUE 0x8052604C RB_Val_Ws16 1570219. Pres_kPa_VSA -785121.3 785097.3 FORMAT "%8.1" /end CHARACTERISTIC
/begin CHARACTERISTIC BrkBstP_pRawFldPStabyVal_C "The hydraulic pressure value permission range of fluctuation under learning" VALUE 0x80526050 RB_Val_Ws32 429496729.500 Pres -214748364.800 214748364.700 FORMAT "%13.3" /end CHARACTERISTIC
/begin CHARACTERISTIC BrkBstP_pTransf_CUR "Curve for determining Brake Boost Vacuum Pressure from ADC" CURVE 0x80525FDA RB_Curve_S16_S16 65535.00 Pres_hPa -32768.00 32767.00 FORMAT "%8.2"
 /begin AXIS_DESCR STD_AXIS BrkBstP_uRaw Volt 6 -6553.600 6553.400 FORMAT "%8.3" DEPOSIT ABSOLUTE /end AXIS_DESCR
/end CHARACTERISTIC
/begin CHARACTERISTIC BrkBstP_pVacPOffsVal_C "Vacuum pressure offset value" VALUE 0x80526054 RB_Val_Ws32 429496729.500 Pres -214748364.800 214748364.700 FORMAT "%13.3" /end CHARACTERISTIC
/begin CHARACTERISTIC BrkBstP_rAccPedThd_C "Accpedal threshold value for brake fluid pressure condition calculation" VALUE 0x80526058 RB_Val_Ws16 799.9878 Prc -400.0000 399.9878 FORMAT "%8.4" /end CHARACTERISTIC
/begin CHARACTERISTIC BrkBstP_stFldPOffsMeasCdnMsk_C "Judgment master cylinder hydraulic pressure zero point learning permission conditon mask" VALUE 0x8052605A RB_Val_Wu16 65535.00 OneToOne 0.00 65535.00 FORMAT "%8.2" /end CHARACTERISTIC
/begin CHARACTERISTIC BrkBstP_stStopRelsMaskSeln_C "Stop release mask selection" VALUE 0x8052605C RB_Val_Wu32 4294967295.00 OneToOne 0.00 4294967295.00 FORMAT "%13.2" /end CHARACTERISTIC
/begin CHARACTERISTIC BrkBstP_stStopRelsMask_C "Stop release mask" VALUE 0x80526060 RB_Val_Wu32 4294967295.00 OneToOne 0.00 4294967295.00 FORMAT "%13.2" /end CHARACTERISTIC
/begin CHARACTERISTIC BrkBstP_swtHSAEna_C "Hill start switch enable status" VALUE 0x80526064 RB_Val_Wboolean 1.00000000000 B_TRUE 0.00 1.00000000000 FORMAT "%13.11" /end CHARACTERISTIC
/begin CHARACTERISTIC BrkBstP_tiABSVSADi_C "Delay time for ABS and VSA when it is disabled" VALUE 0x80526066 RB_Val_Wu16 655.3500 Time_s 0.00 655.3500 FORMAT "%8.4" /end CHARACTERISTIC
/begin CHARACTERISTIC BrkBstP_tiAYCEna_C "AYC activation time" VALUE 0x80526068 RB_Val_Wu32 327670.000000 Time_ms 0.00 327670.000000 FORMAT "%13.6" EXTENDED_LIMITS 0.00 42949672950.0 /end CHARACTERISTIC
/begin CHARACTERISTIC BrkBstP_tiDecelBrkDetn_C "Debounce to detect deceleration by brake" VALUE 0x8052606C RB_Val_Ws32 21474836.4700 Time_s 0.00 21474836.4700 FORMAT "%13.4" EXTENDED_LIMITS -21474836.4800 21474836.4700 /end CHARACTERISTIC
/begin CHARACTERISTIC BrkBstP_tiDriftErrRelsThd_C "Drift error release time threshold" VALUE 0x80526070 RB_Val_Ws32 21474836.4700 Time_s 0.00 21474836.4700 FORMAT "%13.4" EXTENDED_LIMITS -21474836.4800 21474836.4700 /end CHARACTERISTIC
/begin CHARACTERISTIC BrkBstP_tiDriftHiMax_C "Debouncing the brake booster pressure drift on high side maximum" VALUE 0x80526074 RB_Val_Ws16 327.6700 Time_s 0.00 327.6700 FORMAT "%8.4" EXTENDED_LIMITS -327.6800 327.6700 /end CHARACTERISTIC
/begin CHARACTERISTIC BrkBstP_tiDriftHiMin_C "Debouncing the brake booster pressure drift on high side minimum" VALUE 0x80526076 RB_Val_Ws16 327.6700 Time_s 0.00 327.6700 FORMAT "%8.4" EXTENDED_LIMITS -327.6800 327.6700 /end CHARACTERISTIC
/begin CHARACTERISTIC BrkBstP_tiDriftLoMax_C "Debouncing the brake booster pressure drift on low side maximum" VALUE 0x80526078 RB_Val_Ws16 327.6700 Time_s 0.00 327.6700 FORMAT "%8.4" EXTENDED_LIMITS -327.6800 327.6700 /end CHARACTERISTIC
/begin CHARACTERISTIC BrkBstP_tiDriftLoMin_C "Debouncing the brake booster pressure drift on low side minimum" VALUE 0x8052607A RB_Val_Ws16 327.6700 Time_s 0.00 327.6700 FORMAT "%8.4" EXTENDED_LIMITS -327.6800 327.6700 /end CHARACTERISTIC
/begin CHARACTERISTIC BrkBstP_tiDriftTmrFrz_C "Minimum time beween drift error check" VALUE 0x8052607C RB_Val_Ws16 327.6700 Time_s 0.00 327.6700 FORMAT "%8.4" EXTENDED_LIMITS -327.6800 327.6700 /end CHARACTERISTIC
/begin CHARACTERISTIC BrkBstP_tiMstCylPStabyThd_C "Threshold time for Master cylinder stability check" VALUE 0x80526080 RB_Val_Ws32 21474836.4700 Time_s 0.00 21474836.4700 FORMAT "%13.4" EXTENDED_LIMITS -21474836.4800 21474836.4700 /end CHARACTERISTIC
/begin CHARACTERISTIC BrkBstP_tiMstCylPT1_C "Master cylinder brake pressure filtering time" VALUE 0x80526084 RB_Val_Ws32 4294.9672940000000 TimeDelay_s 0.0000020000000 4294.9672959999998 FORMAT "%19.14" EXTENDED_LIMITS 0.000002000000001 4294.9672959999998 /end CHARACTERISTIC
/begin CHARACTERISTIC BrkBstP_tiVacBoostPT1_C "Vacuum booster pressure filtering time" VALUE 0x80526088 RB_Val_Ws32 4294.9672940000000 TimeDelay_s 0.0000020000000 4294.9672959999998 FORMAT "%19.14" EXTENDED_LIMITS 0.000002000000001 4294.9672959999998 /end CHARACTERISTIC
/begin CHARACTERISTIC BrkBstP_tiVehAPT1_C "Vehcile acceleration filtering time" VALUE 0x8052608C RB_Val_Ws32 4294.9672940000000 TimeDelay_s 0.0000020000000 4294.9672959999998 FORMAT "%19.14" EXTENDED_LIMITS 0.000002000000001 4294.9672959999998 /end CHARACTERISTIC
/begin CHARACTERISTIC BrkBstP_tiVehStopDly_C "Vehicle stop confirmation delay" VALUE 0x80526090 RB_Val_Wu16 655.3500 Time_s 0.00 655.3500 FORMAT "%8.4" /end CHARACTERISTIC
/begin CHARACTERISTIC BrkBstP_tiVehVPT1_C "Vehicle velocity filtering time" VALUE 0x80526094 RB_Val_Ws32 4294.9672940000000 TimeDelay_s 0.0000020000000 4294.9672959999998 FORMAT "%19.14" EXTENDED_LIMITS 0.000002000000001 4294.9672959999998 /end CHARACTERISTIC
/begin CHARACTERISTIC BrkBstP_uSensSRCMax_C "Maximum voltage for sensor short circuit to battery" VALUE 0x80525FF4 RB_Val_Ws16 13107.00 Volt -6553.600 6553.400 FORMAT "%8.3" /end CHARACTERISTIC
/begin CHARACTERISTIC BrkBstP_uSensSRCMin_C "Minimum value for sensor short circuit to ground" VALUE 0x80525FF6 RB_Val_Ws16 13107.00 Volt -6553.600 6553.400 FORMAT "%8.3" /end CHARACTERISTIC
/begin CHARACTERISTIC BrkBstP_vRunngThd_C "Vehicle running threshold" VALUE 0x80526098 RB_Val_Ws16 655.3500 Vel -327.6800 327.6700 FORMAT "%8.4" /end CHARACTERISTIC
/begin CHARACTERISTIC BrkBstP_vStopThd_C "Vehicle stop threshold" VALUE 0x8052609A RB_Val_Ws16 655.3500 Vel -327.6800 327.6700 FORMAT "%8.4" /end CHARACTERISTIC
/begin CHARACTERISTIC BrkBstP_vVehSpdThd_C "Vehicle speed threshold value for brake fluid pressure condition calculation" VALUE 0x8052609C RB_Val_Ws16 655.3500 Vel -327.6800 327.6700 FORMAT "%8.4" /end CHARACTERISTIC
/begin CHARACTERISTIC BrkBst_dpBrkPsdThd_C "Minimal pressure difference of the brake pressure, to estimate a vacuum consumption during brake pressing" VALUE 0x805260A0 RB_Val_Ws16 131070.0 q2_bar_DIV_s -65536.00 65534.00 FORMAT "%8.2" /end CHARACTERISTIC
/begin CHARACTERISTIC BrkBst_dpBrkReldThd_C "Minimal pressure difference of the brake pressure, to estimate a vacuum consumption during brake releasing" VALUE 0x805260A2 RB_Val_Ws16 131070.0 q2_bar_DIV_s -65536.00 65534.00 FORMAT "%8.2" /end CHARACTERISTIC
/begin CHARACTERISTIC BrkBst_facBkupMdl_C "Factor for Vacuum consumption in the backup mode" VALUE 0x805260A4 RB_Val_Ws16 65.53500 Fact1000 -32.76800 32.76700 FORMAT "%8.5" /end CHARACTERISTIC
/begin CHARACTERISTIC BrkBst_facBrkPrsESPLL_CUR "brake pressure gradient dependent to the pressure gradient when brake is pressed for the left side driver" CURVE 0x805260A6 RB_Curve_S16_S16 32.76700 Fact1000 0.00 32.76700 FORMAT "%8.5" EXTENDED_LIMITS -32.76800 32.76700
 /begin AXIS_DESCR STD_AXIS NO_INPUT_QUANTITY q2_bar_DIV_s 8 -65536.00 65534.00 FORMAT "%8.2" DEPOSIT ABSOLUTE /end AXIS_DESCR
/end CHARACTERISTIC
/begin CHARACTERISTIC BrkBst_facBrkRlsESPLL_CUR "brake pressure gradient dependent to the pressure gradient when brake is released for the left side driver" CURVE 0x805260C8 RB_Curve_S16_S16 32.76700 Fact1000 0.00 32.76700 FORMAT "%8.5" EXTENDED_LIMITS -32.76800 32.76700
 /begin AXIS_DESCR STD_AXIS NO_INPUT_QUANTITY q2_bar_DIV_s 8 -65536.00 65534.00 FORMAT "%8.2" DEPOSIT ABSOLUTE /end AXIS_DESCR
/end CHARACTERISTIC
/begin CHARACTERISTIC BrkBst_facBrkStHld_CUR "Curve to get the vacuum consumption factor as a result of the brake status during brake pressed" CURVE 0x805260EA RB_Curve_S16_S16 65.53500 Fact1000 -32.76800 32.76700 FORMAT "%8.5"
 /begin AXIS_DESCR STD_AXIS NO_INPUT_QUANTITY Vel 6 -327.6800 327.6700 FORMAT "%8.4" DEPOSIT ABSOLUTE /end AXIS_DESCR
/end CHARACTERISTIC
/begin CHARACTERISTIC BrkBst_facBrkStPsd_CUR "Curve to get the vacuum consumption factor as a result of the brake status during brake pressing" CURVE 0x80526104 RB_Curve_S16_S16 65.53500 Fact1000 -32.76800 32.76700 FORMAT "%8.5"
 /begin AXIS_DESCR STD_AXIS NO_INPUT_QUANTITY Vel 6 -327.6800 327.6700 FORMAT "%8.4" DEPOSIT ABSOLUTE /end AXIS_DESCR
/end CHARACTERISTIC
/begin CHARACTERISTIC BrkBst_facBrkStReld_CUR "Curve to get the vacuum consumption factor as a result of the brake status during brake releasing" CURVE 0x8052611E RB_Curve_S16_S16 65.53500 Fact1000 -32.76800 32.76700 FORMAT "%8.5"
 /begin AXIS_DESCR STD_AXIS NO_INPUT_QUANTITY Vel 6 -327.6800 327.6700 FORMAT "%8.4" DEPOSIT ABSOLUTE /end AXIS_DESCR
/end CHARACTERISTIC
/begin CHARACTERISTIC BrkBst_facPMnfldRedn_C "factor which determines the speed of the vacuum generation by the manifold" VALUE 0x80526138 RB_Val_Ws16 32.76700 Fact1000 0.00 32.76700 FORMAT "%8.5" EXTENDED_LIMITS -32.76800 32.76700 /end CHARACTERISTIC
/begin CHARACTERISTIC BrkBst_facPresLeak_C "factor pressure gradient caused by leakage of brake booster" VALUE 0x8052613A RB_Val_Ws16 65.53500 Fact1000 -32.76800 32.76700 FORMAT "%8.5" /end CHARACTERISTIC
/begin CHARACTERISTIC BrkBst_MdlCfg_CW "Configuration of the vacuum consumer for the model of the brake booster" VALUE 0x8052613C RB_Val_Wu8 255.0 OneToOne 0.00 255.0 FORMAT "%5.1" /end CHARACTERISTIC
/begin CHARACTERISTIC BrkBst_tiBkupMdlVacCns_C "Time in the backup mode for vacuum consumption" VALUE 0x8052613E RB_Val_Wu16 655.3500 Time_s 0.00 655.3500 FORMAT "%8.4" /end CHARACTERISTIC
/begin CHARACTERISTIC BrkBst_tiBrkPFlt_C "Filter time constant to calculate the brake pressure change" VALUE 0x80526140 RB_Val_Ws32 4294.9672940000000 TimeDelay_s 0.0000020000000 4294.9672959999998 FORMAT "%19.14" EXTENDED_LIMITS 0.000002000000001 4294.9672959999998 /end CHARACTERISTIC
/begin CHARACTERISTIC BrkBst_tiPerdBkupMdl_C "Periodic time to calculate the vacuum consumption in the back up mode" VALUE 0x80526144 RB_Val_Ws32 42949672.9500 Time_s -21474836.4800 21474836.4700 FORMAT "%13.4" /end CHARACTERISTIC
/begin CHARACTERISTIC BrkBst_tiPMdl_C "Integration constant to calculate the current model value of the brake booster" VALUE 0x80526148 RB_Val_Ws32 4294.9672940000000 TimeDelay_s 0.0000020000000 4294.9672959999998 FORMAT "%19.14" EXTENDED_LIMITS 0.000002000000001 4294.9672959999998 /end CHARACTERISTIC
/begin CHARACTERISTIC BrkBst_vBrkSt_C "Default value of the current vehicle velocity" VALUE 0x8052614C RB_Val_Ws16 655.3500 Vel -327.6800 327.6700 FORMAT "%8.4" /end CHARACTERISTIC
/begin CHARACTERISTIC BrkPed_aEBBSlopHi_C "Threshold slope for detection of slope high flag." VALUE 0x80526158 RB_Val_Ws16 65.53500 RBPtCel_m_0p001_1 -32.76800 32.76700 FORMAT "%8.5" /end CHARACTERISTIC
/begin CHARACTERISTIC BrkPed_aGrdtFildDifThd_C "Threshold for maximum difference allowed between gradient sampes collected received during window period for vehicle standstill detection" VALUE 0x8052615A RB_Val_Ws16 65.53500 RBPtCel_m_0p001_1 -32.76800 32.76700 FORMAT "%8.5" /end CHARACTERISTIC
/begin CHARACTERISTIC BrkPed_aGrdtHiLimForISAB_C "Higher gradient limit to disallow Idle stop" VALUE 0x8052615C RB_Val_Ws16 65.53500 RBPtCel_m_0p001_1 -32.76800 32.76700 FORMAT "%8.5" /end CHARACTERISTIC
/begin CHARACTERISTIC BrkPed_aGrdtLoLimForISAB_C "Lower gradient limit to disallow Idle stop" VALUE 0x8052615E RB_Val_Ws16 65.53500 RBPtCel_m_0p001_1 -32.76800 32.76700 FORMAT "%8.5" /end CHARACTERISTIC
/begin CHARACTERISTIC BrkPed_aSlopNeg_C "The negative slope threshold gradient value" VALUE 0x80526160 RB_Val_Ws16 65.53500 RBPtCel_m_0p001_1 -32.76800 32.76700 FORMAT "%8.5" /end CHARACTERISTIC
/begin CHARACTERISTIC BrkPed_aSlopPos_C "The positive slope threshold gradient value" VALUE 0x80526162 RB_Val_Ws16 65.53500 RBPtCel_m_0p001_1 -32.76800 32.76700 FORMAT "%8.5" /end CHARACTERISTIC
/begin CHARACTERISTIC BrkPed_cntrISABRlsThd_T "Counter threshold to disable ISAB function" CURVE 0x80526164 RB_Curve_S16_S16 327.6700 Fact_100 0.00 327.6700 FORMAT "%8.4" EXTENDED_LIMITS -327.6800 327.6700
 /begin AXIS_DESCR STD_AXIS BrkPed_aGrdtFild RBPtCel_m_0p001_1 10 -32.76800 32.76700 FORMAT "%8.5" DEPOSIT ABSOLUTE /end AXIS_DESCR
/end CHARACTERISTIC
/begin CHARACTERISTIC BrkPed_cntStepISABRls_T "Curve to determine the counter increment value in every raster based on Accelerator pedal ratio" CURVE 0x8052618E RB_Curve_S16_S16 327.6700 Fact_100 0.00 327.6700 FORMAT "%8.4" EXTENDED_LIMITS -327.6800 327.6700
 /begin AXIS_DESCR STD_AXIS VMD_rVirtAPP Prc 11 -400.0000 399.9878 FORMAT "%8.4" DEPOSIT ABSOLUTE /end AXIS_DESCR
/end CHARACTERISTIC
/begin CHARACTERISTIC BrkPed_flgSwtISABAvl_C "ISAB available flag" VALUE 0x805261BC RB_Val_Wu8 1.00000000000 B_TRUE 0.00 1.00000000000 FORMAT "%13.11" /end CHARACTERISTIC
/begin CHARACTERISTIC BrkPed_flgSwtVehStandStillJdg_C "Calibration switch for selection of vehicle standstill judgement method" VALUE 0x805261BD RB_Val_Wu8 1.00000000000 B_TRUE 0.00 1.00000000000 FORMAT "%13.11" /end CHARACTERISTIC
/begin CHARACTERISTIC BrkPed_nEngISABThd_C "Engine speed threhold above which ISAB cancellation request will be calculated" VALUE 0x805261BE RB_Val_Ws16 32767.50 EngN -16384.00 16383.50 FORMAT "%8.2" /end CHARACTERISTIC
/begin CHARACTERISTIC BrkPed_pEngStopDisbl_M "MAP for upper threshold of Hysteresis function of engine start request based on brake pressure" MAP 0x805261C0 RB_Map_S16S16_S16 65535.00 Pres_hPa -32768.00 32767.00 FORMAT "%8.2"
 /begin AXIS_DESCR STD_AXIS NO_INPUT_QUANTITY Pres_hPa 5 -32768.00 32767.00 FORMAT "%8.2" DEPOSIT ABSOLUTE /end AXIS_DESCR
 /begin AXIS_DESCR STD_AXIS GlbDa_vX Vel 5 -327.6800 327.6700 FORMAT "%8.4" DEPOSIT ABSOLUTE /end AXIS_DESCR
/end CHARACTERISTIC
/begin CHARACTERISTIC BrkPed_pEngStopEna_M "MAP for lower threshold of Hysteresis function for engine start request based on brake pressure" MAP 0x8052620A RB_Map_S16S16_S16 65535.00 Pres_hPa -32768.00 32767.00 FORMAT "%8.2"
 /begin AXIS_DESCR STD_AXIS NO_INPUT_QUANTITY Pres_hPa 5 -32768.00 32767.00 FORMAT "%8.2" DEPOSIT ABSOLUTE /end AXIS_DESCR
 /begin AXIS_DESCR STD_AXIS GlbDa_vX Vel 5 -327.6800 327.6700 FORMAT "%8.4" DEPOSIT ABSOLUTE /end AXIS_DESCR
/end CHARACTERISTIC
/begin CHARACTERISTIC BrkPed_pEnvPMax_C "threshold for environmental pressure for engine start request based on brake pressure" VALUE 0x80526254 RB_Val_Ws16 65535.00 Pres_hPa -32768.00 32767.00 FORMAT "%8.2" /end CHARACTERISTIC
/begin CHARACTERISTIC BrkPed_swtBrkBstPSeln_C "Switch to select brake booster pressure" VALUE 0x80526256 RB_Val_Wu8 1.00000000000 B_TRUE 0.00 1.00000000000 FORMAT "%13.11" /end CHARACTERISTIC
/begin CHARACTERISTIC BrkPed_swtBrkStrtEna_C "Switch to activate brake pedal condition for the brake negative" VALUE 0x80526257 RB_Val_Wu8 1.00000000000 B_TRUE 0.00 1.00000000000 FORMAT "%13.11" /end CHARACTERISTIC
/begin CHARACTERISTIC BrkPed_swtEVPECUEna_C "Switch to select an algortithm either with or without EVP-ECU" VALUE 0x80526258 RB_Val_Wu8 1.00000000000 B_TRUE 0.00 1.00000000000 FORMAT "%13.11" /end CHARACTERISTIC
/begin CHARACTERISTIC BrkPed_tiEBBSlopDetn_C "Threshold time for calculation of slope." VALUE 0x8052625A RB_Val_Wu16 655350.0 Time_ms 0.00 655350.0 FORMAT "%8.1" /end CHARACTERISTIC
/begin CHARACTERISTIC BrkPed_tiEBBSlopRst_C "Threshold time for reset of slope." VALUE 0x8052625C RB_Val_Wu16 655350.0 Time_ms 0.00 655350.0 FORMAT "%8.1" /end CHARACTERISTIC
/begin CHARACTERISTIC BrkPed_tiSnsrFailHeal_C "Minimum time to confirm sensor failure is healed to allow ISAB." VALUE 0x8052625E RB_Val_Wu16 655.3500 Time_s 0.00 655.3500 FORMAT "%8.4" /end CHARACTERISTIC
/begin CHARACTERISTIC BrkPed_tiVehStandStillJdgThd1_C "First calibration time period after which vehicle standstill judgement shall be performed" VALUE 0x80526260 RB_Val_Ws16 655.3500 Time_s -327.6800 327.6700 FORMAT "%8.4" /end CHARACTERISTIC
/begin CHARACTERISTIC BrkPed_tiVehStandStillJdgThd2_C "Second calibration time period after which vehicle standstill judgement must be performed" VALUE 0x80526262 RB_Val_Ws16 655.3500 Time_s -327.6800 327.6700 FORMAT "%8.4" /end CHARACTERISTIC
/begin CHARACTERISTIC BrkPed_tiVehStandStill_C "Time after which vehicle stand still condition is confirmed" VALUE 0x80526264 RB_Val_Wu16 655.3500 Time_s 0.00 655.3500 FORMAT "%8.4" /end CHARACTERISTIC
/begin CHARACTERISTIC BrkPed_tiVSAGrdtPT1_C "PT1 filter time parameter for filtering of VSA gradient information" VALUE 0x80526266 RB_Val_Ws16 655.3500 Time_s -327.6800 327.6700 FORMAT "%8.4" /end CHARACTERISTIC
/begin CHARACTERISTIC BrkPed_tiWinPerdGrdtChk_C "Calibration for window period for collecting gradient samples for vehicle standstill judgement" VALUE 0x80526268 RB_Val_Ws16 1000.000 Time_ms_20ms 0.00 1000.000 FORMAT "%8.3" EXTENDED_LIMITS -655360.0 655340.0 /end CHARACTERISTIC
/begin CHARACTERISTIC BrkPed_tqBrkOffsThdForIS_C "Brake torque offset threshold for Idle Stop for EBB" VALUE 0x8052626A RB_Val_Wu16 20000.00 TrqPerSec 0.00 20000.00 FORMAT "%8.2" EXTENDED_LIMITS 0.00 65535.00 /end CHARACTERISTIC
/begin CHARACTERISTIC BrkPed_tqBrkThdforIS_T "Curve to determine the brake torque required at wheel for a given inclination to avoid roll back." CURVE 0x8052626C RB_Curve_S16_S16 20000.00 TrqPerSec 0.00 20000.00 FORMAT "%8.2" EXTENDED_LIMITS -32768.00 32767.00
 /begin AXIS_DESCR STD_AXIS BrkPed_aGrdtFild RBPtCel_m_0p001_1 9 -32.76800 32.76700 FORMAT "%8.5" DEPOSIT ABSOLUTE /end AXIS_DESCR
/end CHARACTERISTIC
/begin CHARACTERISTIC BrkPed_vEBBSpdHi_C "Vehicle speed upper threshold for calculation of slope." VALUE 0x80526292 RB_Val_Ws16 327.6700 Vel 0.00 327.6700 FORMAT "%8.4" EXTENDED_LIMITS -327.6800 327.6700 /end CHARACTERISTIC
/begin CHARACTERISTIC BrkPed_vEBBSpdLo_C "Vehicle speed lower threshold for calculation of slope." VALUE 0x80526294 RB_Val_Ws16 327.6700 Vel 0.00 327.6700 FORMAT "%8.4" EXTENDED_LIMITS -327.6800 327.6700 /end CHARACTERISTIC
/begin CHARACTERISTIC BrkP_pDfl_C "Brake master cylinder default pressure" VALUE 0x80526150 RB_Val_Ws32 4294967295.00 Pres_hPa -2147483648.00 2147483647.00 FORMAT "%13.2" /end CHARACTERISTIC
/begin CHARACTERISTIC BrkP_swtSig_C "switch to select Brake pressure input source" VALUE 0x80526154 RB_Val_Wu8 255.0 OneToOne 0.00 255.0 FORMAT "%5.1" /end CHARACTERISTIC
/begin CHARACTERISTIC Brk_ctBrkHealThd_C "This is SW-CALPRM" VALUE 0x8058A8AA Val_Wu8 255.0 OneToOne 0.00 255.0 FORMAT "%5.1" /end CHARACTERISTIC
/begin CHARACTERISTIC Brk_ctBrkSwtNotStpThd_C "This is SW-CALPRM" VALUE 0x8058A8AB Val_Wu8 255.0 OneToOne 0.00 255.0 FORMAT "%5.1" /end CHARACTERISTIC
/begin CHARACTERISTIC Brk_ctPlaMax_C "Maximum counter value for plausibility check" VALUE 0x8058A8AC Val_Wu8 255.0 OneToOne 0.00 255.0 FORMAT "%5.1" /end CHARACTERISTIC
/begin CHARACTERISTIC Brk_ctSwtContOnThd_C "This is SW-CALPRM" VALUE 0x8058A8AE Val_Wu16 65535.00 OneToOne 0.00 65535.00 FORMAT "%8.2" /end CHARACTERISTIC
/begin CHARACTERISTIC Brk_flgSwtCntrDi_C "This is SW-CALPRM" VALUE 0x8058A8B0 Val_Wu8 1.000 OneToOne 0.00 1.000 FORMAT "%5.3" EXTENDED_LIMITS 0.00 255.0 /end CHARACTERISTIC
/begin CHARACTERISTIC Brk_flgSwtExch_C "Calibration switch to indicate the brake sensors placement exchanged" VALUE 0x8058A8B1 Val_Wu8 255.0 OneToOne 0.00 255.0 FORMAT "%5.1" /end CHARACTERISTIC
/begin CHARACTERISTIC Brk_MnDeb.tiHiLo_C "Parameter structure for debounce times of main brake switch / Time for a High to Low transition" VALUE 0x8058A8A0 Kw_Ws16 655350.0 TimeDeb -327680.0 327670.0 FORMAT "%8.1" /end CHARACTERISTIC
/begin CHARACTERISTIC Brk_MnDeb.tiLoHi_C "Parameter structure for debounce times of main brake switch / Time for a Low to High transition" VALUE 0x8058A8A2 Kw_Ws16 655350.0 TimeDeb -327680.0 327670.0 FORMAT "%8.1" /end CHARACTERISTIC
/begin CHARACTERISTIC Brk_nPlaMin_C "Minimum value of engine speed for plausibility" VALUE 0x8058A8B2 Val_Ws16 32767.50 EngN -16384.00 16383.50 FORMAT "%8.2" /end CHARACTERISTIC
/begin CHARACTERISTIC Brk_RedDeb.tiHiLo_C "Parameter structure for debounce times of redundant brake switch / Time for a High to Low transition" VALUE 0x8058A8A4 Kw_Ws16 655350.0 TimeDeb -327680.0 327670.0 FORMAT "%8.1" /end CHARACTERISTIC
/begin CHARACTERISTIC Brk_RedDeb.tiLoHi_C "Parameter structure for debounce times of redundant brake switch / Time for a Low to High transition" VALUE 0x8058A8A6 Kw_Ws16 655350.0 TimeDeb -327680.0 327670.0 FORMAT "%8.1" /end CHARACTERISTIC
/begin CHARACTERISTIC Brk_stDflVal_C "Default value for brake switch state" VALUE 0x8058A8B4 Val_Wu8 3.000 OneToOne 0.00 3.000 FORMAT "%5.3" EXTENDED_LIMITS 0.00 255.0 /end CHARACTERISTIC
/begin CHARACTERISTIC Brk_stEnaHydPCtrlOper_C "Calibration for activation of clutch stroke sensor for GS" VALUE 0x8058A8B5 Val_Wu8 255.0 OneToOne 0.00 255.0 FORMAT "%5.1" /end CHARACTERISTIC
/begin CHARACTERISTIC Brk_swtMnRed1_C "Switch for comparison of Main and Redundant Brake information" VALUE 0x8058A8B6 Val_Wu8 255.0 OneToOne 0.00 255.0 FORMAT "%5.1" /end CHARACTERISTIC
/begin CHARACTERISTIC Brk_swtMnRed2_C "Switch for comparison of Main and Redundant Brake information" VALUE 0x8058A8B7 Val_Wu8 255.0 OneToOne 0.00 255.0 FORMAT "%5.1" /end CHARACTERISTIC
/begin CHARACTERISTIC Brk_swtRedSensPrs_C "Switch redundant brake switch present" VALUE 0x8058A8B8 Val_Wu8 1.000 OneToOne 0.00 1.000 FORMAT "%5.3" EXTENDED_LIMITS 0.00 255.0 /end CHARACTERISTIC
/begin CHARACTERISTIC Brk_swtSig_C "Switch signal source for main and redundant brake switch" VALUE 0x8058A8A8 Val_Wu8 255.0 OneToOne 0.00 255.0 FORMAT "%5.1" /end CHARACTERISTIC
/begin CHARACTERISTIC Brk_tiBrkSwtContStpErrClr_C "This is SW-CALPRM" VALUE 0x8058A8BA Val_Wu16 655350.0 Time_ms 0.00 655350.0 FORMAT "%8.1" /end CHARACTERISTIC
/begin CHARACTERISTIC Brk_tiBrkSwtNormDet_C "This is SW-CALPRM" VALUE 0x8058A8BC Val_Wu16 655350.0 Time_ms 0.00 655350.0 FORMAT "%8.1" /end CHARACTERISTIC
/begin CHARACTERISTIC Brk_tiPlaMax_C "Maximum timer value for plausibility check" VALUE 0x8058A8BE Val_Ws16 655350.0 Time_ms -327680.0 327670.0 FORMAT "%8.1" /end CHARACTERISTIC
/begin CHARACTERISTIC Brk_tiRdntBrkOnDly_C "Delay time for Redundant Brake Switch On flag." VALUE 0x8058A8C0 Val_Wu16 655350.0 Time_ms 0.00 655350.0 FORMAT "%8.1" /end CHARACTERISTIC
/begin CHARACTERISTIC Brk_vLwrThdBrkSwtNotStp_C "This is SW-CALPRM" VALUE 0x8058A8C2 Val_Ws16 327.6700 Vel 0.00 327.6700 FORMAT "%8.4" EXTENDED_LIMITS -327.6800 327.6700 /end CHARACTERISTIC
/begin CHARACTERISTIC Brk_vPlaMin_C "Minimum value of vehicle speed for plausibility" VALUE 0x8058A8C4 Val_Ws16 655.3500 Vel -327.6800 327.6700 FORMAT "%8.4" /end CHARACTERISTIC
/begin CHARACTERISTIC Brk_vSpdThdBrkSwtStp_C "This is SW-CALPRM" VALUE 0x8058A8C6 Val_Ws16 327.6700 Vel 0.00 327.6700 FORMAT "%8.4" EXTENDED_LIMITS -327.6800 327.6700 /end CHARACTERISTIC
/begin CHARACTERISTIC Brk_vUpprThdBrkSwtNotStp_C "This is SW-CALPRM" VALUE 0x8058A8C8 Val_Ws16 327.6700 Vel 0.00 327.6700 FORMAT "%8.4" EXTENDED_LIMITS -327.6800 327.6700 /end CHARACTERISTIC
/begin CHARACTERISTIC CEngDsT_flgSnsrFrzEna_C "Flag for eingine compartment temperature sensor freez enable" VALUE 0x80526298 RB_Val_Wu8 1.00000000000 B_TRUE 0.00 1.00000000000 FORMAT "%13.11" /end CHARACTERISTIC
/begin CHARACTERISTIC CEngDsT_flgSwtEnaFil_C "Switch for activation of low pass filter" VALUE 0x80526318 RB_Val_Wu8 1.00000000000 B_TRUE 0.00 1.00000000000 FORMAT "%13.11" /end CHARACTERISTIC
/begin CHARACTERISTIC CEngDsT_swtSnsrCfg_C "codeword for configuration of DeviceDriver engine coolant temperature sensor" VALUE 0x80526299 RB_Val_Wu8 255.0 OneToOne 0.00 255.0 FORMAT "%5.1" /end CHARACTERISTIC
/begin CHARACTERISTIC CEngDsT_swtSnsrSigAvl_C "codeword for configuration of signal availability engine coolant temperature sensor" VALUE 0x8052629A RB_Val_Wu8 255.0 OneToOne 0.00 255.0 FORMAT "%5.1" /end CHARACTERISTIC
/begin CHARACTERISTIC CEngDsT_tiDebImpsErrTmp_C "debounce time error detection Loose-Connection-Check eingine compartment temperature sensor" VALUE 0x8052629C RB_Val_Ws32 2147.48364700 Time_Dt 0.00 2147.48364700 FORMAT "%13.8" EXTENDED_LIMITS -2147.48364800 2147.48364700 /end CHARACTERISTIC
/begin CHARACTERISTIC CEngDsT_tiDebImpsErr_C "debounce time error Loose-Connection-Check eingine compartment temperature sensor" VALUE 0x805262A0 RB_Val_Ws32 2147.48364700 Time_Dt 0.00 2147.48364700 FORMAT "%13.8" EXTENDED_LIMITS -2147.48364800 2147.48364700 /end CHARACTERISTIC
/begin CHARACTERISTIC CEngDsT_tiDebSigErr_C "debounce time error Signal-Check eingine compartment temperature sensor" VALUE 0x805262A4 RB_Val_Ws32 2147.48364700 Time_Dt 0.00 2147.48364700 FORMAT "%13.8" EXTENDED_LIMITS -2147.48364800 2147.48364700 /end CHARACTERISTIC
/begin CHARACTERISTIC CEngDsT_tiDebSigHeal_C "debounce time healing Signal-Check eingine compartment temperature sensor" VALUE 0x805262A8 RB_Val_Ws32 2147.48364700 Time_Dt 0.00 2147.48364700 FORMAT "%13.8" EXTENDED_LIMITS -2147.48364800 2147.48364700 /end CHARACTERISTIC
/begin CHARACTERISTIC CEngDsT_tiDebSnsrElecVld_C "debounce time electrical validity eingine compartment temperature sensor" VALUE 0x805262AC RB_Val_Ws32 2147.48364700 Time_Dt 0.00 2147.48364700 FORMAT "%13.8" EXTENDED_LIMITS -2147.48364800 2147.48364700 /end CHARACTERISTIC
/begin CHARACTERISTIC CEngDsT_tiDebSRCErr_C "debounce time error Signal-Range-Check eingine compartment temperature sensor" VALUE 0x805262B0 RB_Val_Ws32 2.50000000000 Time_Dt 0.00 2.50000000000 FORMAT "%13.11" EXTENDED_LIMITS -2147.48364800 2147.48364700 /end CHARACTERISTIC
/begin CHARACTERISTIC CEngDsT_tiDebSRCHeal_C "debounce time healing Signal-Range-Check eingine compartment temperature sensor" VALUE 0x805262B4 RB_Val_Ws32 2147.48364700 Time_Dt 0.00 2147.48364700 FORMAT "%13.8" EXTENDED_LIMITS -2147.48364800 2147.48364700 /end CHARACTERISTIC
/begin CHARACTERISTIC CEngDsT_tiFil_C "Lowpassfilterconstant for switch from replacement to sensor value of tmot" VALUE 0x8052631A RB_Val_Wu16 655.3500 t_q0p01 0.00 655.3500 FORMAT "%8.4" /end CHARACTERISTIC
/begin CHARACTERISTIC CEngDsT_tiSnsrURawFildImps_C "Time constant for filtering the raw sensor voltage for engine coolant sensor for loose connection check" VALUE 0x805262B8 RB_Val_Wu16 6553.500 t_q0p1 0.00 6553.500 FORMAT "%8.3" /end CHARACTERISTIC
/begin CHARACTERISTIC CEngDsT_tiSnsrURawFild_C "Time constant for filtering the raw sensor voltage for engine coolant sensor" VALUE 0x805262BA RB_Val_Wu16 6553.500 t_q0p1 0.00 6553.500 FORMAT "%8.3" /end CHARACTERISTIC
/begin CHARACTERISTIC CEngDsT_tStopInin_C "Initialisation value for engine shut off temperature in case of power failure" VALUE 0x8052631C RB_Val_Wu8 191.3 temp_ub_q0p75_o48 -48.0 143.3 FORMAT "%5.1" /end CHARACTERISTIC
/begin CHARACTERISTIC CEngDsT_tStrtThd_C "maximum threshold for enabling tmst-correction in case of active block-heater" VALUE 0x8052631E RB_Val_Ws16 6553.500 Temp_Cels -3549.940 3003.560 FORMAT "%8.3" /end CHARACTERISTIC
/begin CHARACTERISTIC CEngDsT_tTrfSnsr_CUR "linearisation curve sensor voltage engine coolant temperature" CURVE 0x805262BC RB_Curve_U16_S16_Static 6553.500 Temp_Cels -3549.940 3003.560 FORMAT "%8.3"
 /begin AXIS_DESCR STD_AXIS CEngDsT_uRaw Volt 20 0.00 5000.000 FORMAT "%8.3" EXTENDED_LIMITS 0.00 13107.00 DEPOSIT ABSOLUTE /end AXIS_DESCR
/end CHARACTERISTIC
/begin CHARACTERISTIC CEngDsT_uAbsltDifRawFltdMin_C "theshold for absolute value difference sensor voltage (filtered - unfiltered) engine coolant temperature sensor" VALUE 0x8052630E RB_Val_Wu16 5000.000 Volt 0.00 5000.000 FORMAT "%8.3" EXTENDED_LIMITS 0.00 13107.00 /end CHARACTERISTIC
/begin CHARACTERISTIC CEngDsT_uRawDfl_C "default value sensor voltage engine coolant temperature sensor" VALUE 0x80526310 RB_Val_Wu16 5000.000 Volt 0.00 5000.000 FORMAT "%8.3" EXTENDED_LIMITS 0.00 13107.00 /end CHARACTERISTIC
/begin CHARACTERISTIC CEngDsT_uRawMaxSRC_C "upper threshold sensor voltagefor signal-range-check engine coolant temperature sensor" VALUE 0x80526312 RB_Val_Wu16 5000.000 Volt 0.00 5000.000 FORMAT "%8.3" EXTENDED_LIMITS 0.00 13107.00 /end CHARACTERISTIC
/begin CHARACTERISTIC CEngDsT_uRawMinSRC_C "lower threshold sensor voltagefor signal-range-check engine coolant temperature sensor" VALUE 0x80526314 RB_Val_Wu16 5000.000 Volt 0.00 5000.000 FORMAT "%8.3" EXTENDED_LIMITS 0.00 13107.00 /end CHARACTERISTIC
/begin CHARACTERISTIC CWBGRLP "Code word configuration function BGRLP" VALUE 0x80525CC7 RB_Val_Wu8 255.0 OneToOne 0.00 255.0 FORMAT "%5.1" /end CHARACTERISTIC
/begin CHARACTERISTIC CWBGTMPK "codeword for %BGTMPK" VALUE 0x805251EC RB_Val_Wu16 65535.00 dez 0.00 65535.00 FORMAT "%8.2" /end CHARACTERISTIC
/begin CHARACTERISTIC CWBGTPAGR "code word for configuration of %BGTPAGRAPP" VALUE 0x80525A6A RB_Val_Wu8 255.0 dez 0.00 255.0 FORMAT "%5.1" /end CHARACTERISTIC
/begin CHARACTERISTIC CWBGWDKM "Codeword for BGWDKM" VALUE 0x80525CAA RB_Val_Wu8 255.0 OneToOne 0.00 255.0 FORMAT "%5.1" /end CHARACTERISTIC
/begin CHARACTERISTIC CWTMSV "codeword MSV temperature" VALUE 0x8052591A RB_Val_Wu8 255.0 dez 0.00 255.0 FORMAT "%5.1" /end CHARACTERISTIC
/begin CHARACTERISTIC CWTMSVST "codeword MSV temperature model" VALUE 0x8052591B RB_Val_Wu8 255.0 dez 0.00 255.0 FORMAT "%5.1" /end CHARACTERISTIC
/begin CHARACTERISTIC CWWPR "Code word configuration function BGWPR" VALUE 0x80525CC8 RB_Val_Wu8 255.0 OneToOne 0.00 255.0 FORMAT "%5.1" /end CHARACTERISTIC
/begin CHARACTERISTIC DTEVS "Delta temperature of inlet valve to engine temperature after start" VALUE 0x805251EE RB_Val_Wu8 191.3 temp_q0p75_om48 -48.0 143.3 FORMAT "%5.1" /end CHARACTERISTIC
/begin CHARACTERISTIC DZWOLA "Lambda dependency of optimized model reference ignition angle referred to Lambda 1" CURVE 0x80524588 RB_Curve_U16_S16_Static 36.00000 zw_q2p9297Em3_deg_KW -12.00000 24.00000 FORMAT "%8.5" EXTENDED_LIMITS -96.00000 95.99707
 /begin AXIS_DESCR STD_AXIS NO_INPUT_QUANTITY fak_uw_b16 10 0.00 15.99976 FORMAT "%8.5" DEPOSIT ABSOLUTE /end AXIS_DESCR
/end CHARACTERISTIC
/begin CHARACTERISTIC DZWOLA2KA "Lambda dependency of optimized model reference ignition angle referred to Lambda 1 - 2nd fuel" CURVE 0x805245B2 RB_Curve_U16_S16_Static 36.00000 zw_q2p9297Em3_deg_KW -12.00000 24.00000 FORMAT "%8.5" EXTENDED_LIMITS -96.00000 95.99707
 /begin AXIS_DESCR STD_AXIS NO_INPUT_QUANTITY fak_uw_b16 10 0.00 15.99976 FORMAT "%8.5" DEPOSIT ABSOLUTE /end AXIS_DESCR
/end CHARACTERISTIC
/begin CHARACTERISTIC DZWOLA2KAH "Lambda based delta added to optimized model reference reference ignition angle for HSP - 2nd fuel." CURVE 0x805245DC RB_Curve_U16_S16_Static 36.00000 zw_q2p9297Em3_deg_KW -12.00000 24.00000 FORMAT "%8.5" EXTENDED_LIMITS -96.00000 95.99707
 /begin AXIS_DESCR STD_AXIS NO_INPUT_QUANTITY fak_uw_b16 10 0.00 15.99976 FORMAT "%8.5" DEPOSIT ABSOLUTE /end AXIS_DESCR
/end CHARACTERISTIC
/begin CHARACTERISTIC DZWOLAH "Lambda based delta added to optimized model reference ignition angle for HSP." CURVE 0x80524606 RB_Curve_U16_S16_Static 36.00000 zw_q2p9297Em3_deg_KW -12.00000 24.00000 FORMAT "%8.5" EXTENDED_LIMITS -96.00000 95.99707
 /begin AXIS_DESCR STD_AXIS NO_INPUT_QUANTITY fak_uw_b16 10 0.00 15.99976 FORMAT "%8.5" DEPOSIT ABSOLUTE /end AXIS_DESCR
/end CHARACTERISTIC
/begin CHARACTERISTIC ETALAM "Lambda efficiency" CURVE 0x80524630 RB_Curve_U16_U16 1.999969 fak_uw_b2 0.00 1.999969 FORMAT "%8.6"
 /begin AXIS_DESCR STD_AXIS NO_INPUT_QUANTITY fak_uw_b16 10 0.00 15.99976 FORMAT "%8.5" DEPOSIT ABSOLUTE /end AXIS_DESCR
/end CHARACTERISTIC
/begin CHARACTERISTIC ETALAM2KA "Lambda effeciency - 2nd fuel" CURVE 0x8052465A RB_Curve_U16_U16 1.999969 fak_uw_b2 0.00 1.999969 FORMAT "%8.6"
 /begin AXIS_DESCR STD_AXIS NO_INPUT_QUANTITY fak_uw_b16 10 0.00 15.99976 FORMAT "%8.5" DEPOSIT ABSOLUTE /end AXIS_DESCR
/end CHARACTERISTIC
/begin CHARACTERISTIC ETALAM2KAH "Lambda effeciency in HSP - 2nd fuel" CURVE 0x80524684 RB_Curve_U16_U16 1.999969 fak_uw_b2 0.00 1.999969 FORMAT "%8.6"
 /begin AXIS_DESCR STD_AXIS NO_INPUT_QUANTITY fak_uw_b16 10 0.00 15.99976 FORMAT "%8.5" DEPOSIT ABSOLUTE /end AXIS_DESCR
/end CHARACTERISTIC
/begin CHARACTERISTIC ETALAMH "Lambda effeciency HSP" CURVE 0x805246AE RB_Curve_U16_U16 1.999969 fak_uw_b2 0.00 1.999969 FORMAT "%8.6"
 /begin AXIS_DESCR STD_AXIS NO_INPUT_QUANTITY fak_uw_b16 10 0.00 15.99976 FORMAT "%8.5" DEPOSIT ABSOLUTE /end AXIS_DESCR
/end CHARACTERISTIC
/begin CHARACTERISTIC FTIETHMNMX "weight factor of temperature correction dependent of ethanol content" CURVE 0x805251F0 RB_Curve_U16_U16 1.000000 fak_uw_b2 0.00 1.000000 FORMAT "%8.6" EXTENDED_LIMITS 0.00 1.999969
 /begin AXIS_DESCR STD_AXIS FfPrm_facEth fak_uw_b2 5 0.00 1.999969 FORMAT "%8.6" DEPOSIT ABSOLUTE /end AXIS_DESCR
/end CHARACTERISTIC
/begin CHARACTERISTIC FTOCHLWIN "initialization value for weighting factor oiltemperature in cylinder-head" VALUE 0x80525A56 RB_Val_Wu8 1.000 fak_q0p00392 0.00 1.000 FORMAT "%5.3" /end CHARACTERISTIC
/begin CHARACTERISTIC FTVDKTAVDK "Temperature factor for air at throttle valve" CURVE 0x80525206 RB_Curve_U16_U16 1.999969 fak_uw_b2 0.00 1.999969 FORMAT "%8.6"
 /begin AXIS_DESCR STD_AXIS NO_INPUT_QUANTITY temp_q0p0234_o273 16 -273.150 1262.827 FORMAT "%8.3" DEPOSIT ABSOLUTE /end AXIS_DESCR
/end CHARACTERISTIC
/begin CHARACTERISTIC FTVWDKMX "Delay factor: max. DK angle" VALUE 0x80525CC9 RB_Val_Wu8 1.992188 fak_ub_b2 0.00 1.992188 FORMAT "%8.6" /end CHARACTERISTIC
/begin CHARACTERISTIC FWDKUGDSP "Factor for hysteresis on throttle valve angle during which 95% charge is reached" VALUE 0x80525CCA RB_Val_Wu16 1.000000 fak_uw_b2 0.00 1.000000 FORMAT "%8.6" EXTENDED_LIMITS 0.00 1.999969 /end CHARACTERISTIC
/begin CHARACTERISTIC KFDTAHEVATI "Supression factor at startup for the dynamic correction of the air temperature behind inlet valve" MAP 0x80525248 RB_Map_S16U16_U16 1.000000 fak_uw_b2 0.00 1.000000 FORMAT "%8.6" EXTENDED_LIMITS 0.00 1.999969
 /begin AXIS_DESCR STD_AXIS CEngDsT_tStrt Temp_Cels 8 -3549.940 3003.560 FORMAT "%8.3" DEPOSIT ABSOLUTE /end AXIS_DESCR
 /begin AXIS_DESCR STD_AXIS anztib_w_msg dez 8 0.00 65535.00 FORMAT "%8.2" DEPOSIT ABSOLUTE /end AXIS_DESCR
/end CHARACTERISTIC
/begin CHARACTERISTIC KFDTAHEVET "correction of fresh air temperature in combustion chamber for flexfuel" MAP 0x805252EC RB_Map_U16S16_U16 199.9922 temp_q0p0234_o273 -99.99375 99.99844 FORMAT "%8.5" EXTENDED_LIMITS -273.1500 1262.827
 /begin AXIS_DESCR STD_AXIS psr_w_msg p_q0p078 10 0.00 5119.922 FORMAT "%8.3" DEPOSIT ABSOLUTE /end AXIS_DESCR
 /begin AXIS_DESCR STD_AXIS Epm_nEng EngN 12 -16384.00 16383.50 FORMAT "%8.2" DEPOSIT ABSOLUTE /end AXIS_DESCR
/end CHARACTERISTIC
/begin CHARACTERISTIC KFDTAHEVPN "Dynamic correction of the air temperature dependent from the engine speed and the intake manifold pressure" MAP 0x8052540C RB_Map_U16S16_U16 1.000000 fak_uw_b2 0.00 1.000000 FORMAT "%8.6" EXTENDED_LIMITS 0.00 1.999969
 /begin AXIS_DESCR STD_AXIS psr_w_msg p_q0p078 8 0.00 5119.922 FORMAT "%8.3" DEPOSIT ABSOLUTE /end AXIS_DESCR
 /begin AXIS_DESCR STD_AXIS Epm_nEng EngN 8 -16384.00 16383.50 FORMAT "%8.2" DEPOSIT ABSOLUTE /end AXIS_DESCR
/end CHARACTERISTIC
/begin CHARACTERISTIC KFDTR "correction value for the dynamic correction of the air temperature behind inlet valve" MAP 0x805254B0 RB_Map_U16S16_U16 1535.977 temp_q0p0234_o273 -273.150 1262.827 FORMAT "%8.3"
 /begin AXIS_DESCR STD_AXIS psr_w_msg p_q0p078 10 0.00 5119.922 FORMAT "%8.3" DEPOSIT ABSOLUTE /end AXIS_DESCR
 /begin AXIS_DESCR STD_AXIS Epm_nEng EngN 10 -16384.00 16383.50 FORMAT "%8.2" DEPOSIT ABSOLUTE /end AXIS_DESCR
/end CHARACTERISTIC
/begin CHARACTERISTIC KFDTZ "Time constant for the dynamic correction of the air temperature behind inlet valve" MAP 0x805255A4 RB_Map_U16S16_U16 655.3500 t_q0p01 0.00 655.3500 FORMAT "%8.4"
 /begin AXIS_DESCR STD_AXIS psr_w_msg p_q0p078 8 0.00 5119.922 FORMAT "%8.3" DEPOSIT ABSOLUTE /end AXIS_DESCR
 /begin AXIS_DESCR STD_AXIS Epm_nEng EngN 8 -16384.00 16383.50 FORMAT "%8.2" DEPOSIT ABSOLUTE /end AXIS_DESCR
/end CHARACTERISTIC
/begin CHARACTERISTIC KFEIGMSV "power dissipation influence to nmot and vfzg, MSV body temperature" MAP 0x8052591C RB_Map_U8U8_U8 191.3 temp_ub_q0p75_o48 -48.0 143.3 FORMAT "%5.1"
 /begin AXIS_DESCR STD_AXIS nmot_bgtmsv_loc nmot_ub_q40 4 0.00 10200. FORMAT "%5.0" DEPOSIT ABSOLUTE /end AXIS_DESCR
 /begin AXIS_DESCR STD_AXIS vfzg_bgtmsv_loc vfzg_ub_q1p25 3 0.00 318.8 FORMAT "%5.1" DEPOSIT ABSOLUTE /end AXIS_DESCR
/end CHARACTERISTIC
/begin CHARACTERISTIC KFFWLKFTAHEV "Warm up coorection for fresh air temperature in combustion chamber" MAP 0x80525648 RB_Map_U16S16_U16 1.999969 fak_uw_b2 0.00 1.999969 FORMAT "%8.6"
 /begin AXIS_DESCR STD_AXIS tmotdifk_w temp_q0p0234_o273 8 -273.150 1262.827 FORMAT "%8.3" DEPOSIT ABSOLUTE /end AXIS_DESCR
 /begin AXIS_DESCR STD_AXIS CEngDsT_tStrt Temp_Cels 5 -3549.940 3003.560 FORMAT "%8.3" DEPOSIT ABSOLUTE /end AXIS_DESCR
/end CHARACTERISTIC
/begin CHARACTERISTIC KFFWLKPN "Map factor on warm up correction based on pressure and engine speed" MAP 0x805256B6 RB_Map_U16S16_U16 1.000000 fak_uw_b2 0.00 1.000000 FORMAT "%8.6" EXTENDED_LIMITS 0.00 1.999969
 /begin AXIS_DESCR STD_AXIS psr_w_msg p_q0p078 10 0.00 5119.922 FORMAT "%8.3" DEPOSIT ABSOLUTE /end AXIS_DESCR
 /begin AXIS_DESCR STD_AXIS Epm_nEng EngN 10 -16384.00 16383.50 FORMAT "%8.2" DEPOSIT ABSOLUTE /end AXIS_DESCR
/end CHARACTERISTIC
/begin CHARACTERISTIC KFMSAGFQEV "Map, mass flow calculation from heat transfer (sampling, valve), vehicle speed" MAP 0x80525A6C RB_Map_U16S16_U16 6553.500 m_uw_b6553p5 0.00 6553.500 FORMAT "%8.3"
 /begin AXIS_DESCR STD_AXIS fagrevx_w fak_uw_b2 9 0.00 1.999969 FORMAT "%8.6" DEPOSIT ABSOLUTE /end AXIS_DESCR
 /begin AXIS_DESCR STD_AXIS VehV_v Vel 7 -327.6800 327.6700 FORMAT "%8.4" DEPOSIT ABSOLUTE /end AXIS_DESCR
/end CHARACTERISTIC
/begin CHARACTERISTIC KFTMKMSV "Map for basis MSV temperature correction for fuel mass and ambient temperature influence" MAP 0x80525932 RB_Map_U16U16_U16 3.984375 fak_ub_b4 0.00 3.984375 FORMAT "%8.6" EXTENDED_LIMITS 0.00 1023.984
 /begin AXIS_DESCR STD_AXIS tflmass_w_bgtmsv_loc m_uw_q0p24 4 0.00 15728.40 FORMAT "%8.2" DEPOSIT ABSOLUTE /end AXIS_DESCR
 /begin AXIS_DESCR STD_AXIS tumg_bgtmsv_loc temp_ub_q0p75_o48 3 -48.0000 143.2500 FORMAT "%8.4" EXTENDED_LIMITS -48.00000 49103.25 DEPOSIT ABSOLUTE /end AXIS_DESCR
/end CHARACTERISTIC
/begin CHARACTERISTIC KFTMSVM "lowpass filter constant" MAP 0x8052595C RB_Map_U16U16_U16 13106.999997 zk200msxs_uw_b13107p2 0.200003 13107.200000 FORMAT "%12.6" EXTENDED_LIMITS 0.20000305180 13107.200000
 /begin AXIS_DESCR STD_AXIS tfuelsrc_bgtmsv_loc temp_ub_q0p75_o48 8 -48.0000 143.2500 FORMAT "%8.4" EXTENDED_LIMITS -48.00000 49103.25 DEPOSIT ABSOLUTE /end AXIS_DESCR
 /begin AXIS_DESCR STD_AXIS difftmtans temp_ub_q0p75_o48 8 -48.0000 143.2500 FORMAT "%8.4" EXTENDED_LIMITS -48.00000 49103.25 DEPOSIT ABSOLUTE /end AXIS_DESCR
/end CHARACTERISTIC
/begin CHARACTERISTIC KFTOCHLW "Map for weighting-factor for oiltemperature in cylinder-head" MAP 0x80525A57 RB_Map_U8U8_U8 1.000 fak_q0p00392 0.00 1.000 FORMAT "%5.3"
 /begin AXIS_DESCR STD_AXIS mltoch m_ub_b1020 3 0.00 1020. FORMAT "%5.0" DEPOSIT ABSOLUTE /end AXIS_DESCR
 /begin AXIS_DESCR STD_AXIS nmottoch nmot_ub_q40 3 0.00 10200. FORMAT "%5.0" DEPOSIT ABSOLUTE /end AXIS_DESCR
/end CHARACTERISTIC
/begin CHARACTERISTIC KFWANAGRV "Heat exchange (between EGR-valve- and intake air-temperature)" MAP 0x80525B0E RB_Map_U16S16_U16 1.999969 fak_uw_b2 0.00 1.999969 FORMAT "%8.6"
 /begin AXIS_DESCR STD_AXIS msagr_w_msg m_uw_b6553p5 8 0.00 6553.500 FORMAT "%8.3" DEPOSIT ABSOLUTE /end AXIS_DESCR
 /begin AXIS_DESCR STD_AXIS VehV_v Vel 7 -327.6800 327.6700 FORMAT "%8.4" DEPOSIT ABSOLUTE /end AXIS_DESCR
/end CHARACTERISTIC
/begin CHARACTERISTIC KFWANLEOT "Heat exchange (between EGR-take-off point- and intake air-temperature)" MAP 0x80525BA0 RB_Map_U16S16_U16 1.999969 fak_uw_b2 0.00 1.999969 FORMAT "%8.6"
 /begin AXIS_DESCR STD_AXIS msagr_w_msg m_uw_b6553p5 9 0.00 6553.500 FORMAT "%8.3" DEPOSIT ABSOLUTE /end AXIS_DESCR
 /begin AXIS_DESCR STD_AXIS VehV_v Vel 7 -327.6800 327.6700 FORMAT "%8.4" DEPOSIT ABSOLUTE /end AXIS_DESCR
/end CHARACTERISTIC
/begin CHARACTERISTIC KFWTBR "Weighting factor Tans/Tmot for combustion chamber temperature model" MAP 0x805257AA RB_Map_U16S16_U16 1.999969 fak_uw_b2 0.00 1.999969 FORMAT "%8.6"
 /begin AXIS_DESCR STD_AXIS psr_w_msg p_q0p078 10 0.00 5119.922 FORMAT "%8.3" DEPOSIT ABSOLUTE /end AXIS_DESCR
 /begin AXIS_DESCR STD_AXIS Epm_nEng EngN 12 -16384.00 16383.50 FORMAT "%8.2" DEPOSIT ABSOLUTE /end AXIS_DESCR
/end CHARACTERISTIC
/begin CHARACTERISTIC KLFEXPSL "Characteristic line E-function (1-e(-x))" CURVE 0x805258CA RB_Curve_U16_U16 0.9999847 fak_uw_b1 0.00 0.9999847 FORMAT "%9.7"
 /begin AXIS_DESCR STD_AXIS quotntke_w_msg fak_uw_b8 6 0.00 7.999878 FORMAT "%8.6" DEPOSIT ABSOLUTE /end AXIS_DESCR
/end CHARACTERISTIC
/begin CHARACTERISTIC KLTFWLK "Characteristic Curve for Interpolation Factor of Ethanol Content" CURVE 0x805258E4 RB_Curve_U16_U16 1.999969 fak_uw_b2 0.00 1.999969 FORMAT "%8.6"
 /begin AXIS_DESCR STD_AXIS FfPrm_facEth fak_uw_b2 6 0.00 1.999969 FORMAT "%8.6" DEPOSIT ABSOLUTE /end AXIS_DESCR
/end CHARACTERISTIC
/begin CHARACTERISTIC KLTMSVHS "curve for hot start calculation" CURVE 0x80525A00 RB_Curve_U16_U8_Static 191.3 temp_ub_q0p75_o48 -48.0 143.3 FORMAT "%5.1"
 /begin AXIS_DESCR STD_AXIS tengsq1_w_bgtmsv_loc t1sxs_uw_q1 8 0.00 65535.00 FORMAT "%8.2" DEPOSIT ABSOLUTE /end AXIS_DESCR
/end CHARACTERISTIC
/begin CHARACTERISTIC KLTMSVST "curve for hot start calculation" CURVE 0x80525A1A RB_Curve_U16_U8_Static 0.9961 fak_ub_b1 0.00 0.9961
 /begin AXIS_DESCR STD_AXIS tengsq1_w_bgtmsv_loc t1sxs_uw_q1 10 0.00 65535.00 FORMAT "%8.2" DEPOSIT ABSOLUTE /end AXIS_DESCR
/end CHARACTERISTIC
/begin CHARACTERISTIC KLTMTAMSV "curve for basis MSV temperature" CURVE 0x80525A3A RB_Curve_U8_S8_Static 3.984 fak_sb_b2 -2.000 1.984 FORMAT "%5.3"
 /begin AXIS_DESCR STD_AXIS difftmtans temp_ub_q0p75_o48 6 -48.0 143.3 FORMAT "%5.1" DEPOSIT ABSOLUTE /end AXIS_DESCR
/end CHARACTERISTIC
/begin CHARACTERISTIC KLTTRECLAM "characteristic delay time egr mass flow lambda" CURVE 0x80525C42 RB_Curve_U16_U16 1310.700 t_q0p02 0.00 1310.700 FORMAT "%8.3"
 /begin AXIS_DESCR STD_AXIS AirMod_mfEgrAct m_uw_b6553p5 6 0.00 6553.500 FORMAT "%8.3" DEPOSIT ABSOLUTE /end AXIS_DESCR
/end CHARACTERISTIC
/begin CHARACTERISTIC LAAEOAGRMX "max. Lambda in EGR output for EGR calculation" VALUE 0x80525C5C RB_Val_Wu16 15.99976 fak_uw_b16 0.00 15.99976 FORMAT "%8.5" /end CHARACTERISTIC
/begin CHARACTERISTIC LAAGREOAP "Lambda at egr output point (calibration value)" VALUE 0x80525C5E RB_Val_Wu16 15.99976 fak_uw_b16 0.00 15.99976 FORMAT "%8.5" /end CHARACTERISTIC
/begin CHARACTERISTIC medc_datasetid "Text with the dataset identification" ASCII 0x8058A8CA ValA_Wu8 255.0 defaultAscii 0.00 255.0 NUMBER 99 /end CHARACTERISTIC
/begin CHARACTERISTIC MSAGRZKES "characteristic time constant egr temperture at feed point" CURVE 0x80525C60 RB_Curve_U16_U16 6553.4999985 zk100msxs_uw_b6553 0.1000015 6553.6000000 FORMAT "%12.7" EXTENDED_LIMITS 0.10000152590 6553.6000000
 /begin AXIS_DESCR STD_AXIS msagr_w_msg m_uw_b6553p5 8 0.00 6553.500 FORMAT "%8.3" DEPOSIT ABSOLUTE /end AXIS_DESCR
/end CHARACTERISTIC
/begin CHARACTERISTIC MSAGRZKV "characteristic time constant egr temperture of valve" CURVE 0x80525C82 RB_Curve_U16_U16 6553.4999985 zk100msxs_uw_b6553 0.1000015 6553.6000000 FORMAT "%12.7" EXTENDED_LIMITS 0.10000152590 6553.6000000
 /begin AXIS_DESCR STD_AXIS msagr_w_msg m_uw_b6553p5 8 0.00 6553.500 FORMAT "%8.3" DEPOSIT ABSOLUTE /end AXIS_DESCR
/end CHARACTERISTIC
/begin CHARACTERISTIC NMOTRLPU "Lower threshold for prediction of air charge" VALUE 0x80525CCC RB_Val_Ws16 32767.50 EngN -16384.00 16383.50 FORMAT "%8.2" /end CHARACTERISTIC
/begin CHARACTERISTIC NWKEV "Engine speed Parameter for calculation thermal contact of fresh air" VALUE 0x805258FE RB_Val_Wu16 16383.75 nmot_q0p25 0.00 16383.75 FORMAT "%8.2" /end CHARACTERISTIC
/begin CHARACTERISTIC PAAGREOAP "exhaust gas pressure at egr output point (calibration value)" VALUE 0x80525CA4 RB_Val_Wu16 5119.922 p_uw_q0p078 0.00 5119.922 FORMAT "%8.3" /end CHARACTERISTIC
/begin CHARACTERISTIC TAGREOAP "Exhaust gas temperature at EGR ouput point (calibration value)" VALUE 0x80525CA6 RB_Val_Wu16 1535.977 temp_q0p0234_o273 -273.150 1262.827 FORMAT "%8.3" /end CHARACTERISTIC
/begin CHARACTERISTIC TDTAGRSR "debounce time for tagrsr to be valid again (re-engage models)" VALUE 0x80525CA8 RB_Val_Wu8 25.50 t_q0p1 0.00 25.50 FORMAT "%5.2" /end CHARACTERISTIC
/begin CHARACTERISTIC TDTEVATI "Time constant delta temperature of inlet valve to engine temperature after start" CURVE 0x80525900 RB_Curve_U16_U8_Static 0.9961 fak_q0p0039 0.00 0.9961
 /begin AXIS_DESCR STD_AXIS anztib_w_msg dez 6 0.00 65535.00 FORMAT "%8.2" DEPOSIT ABSOLUTE /end AXIS_DESCR
/end CHARACTERISTIC
/begin CHARACTERISTIC TEIG "time constant lowpass body temperature, tmsvm" VALUE 0x80525A48 RB_Val_Wu16 13106.999997 zk200msxs_uw_b13107p2 0.200003 13107.200000 FORMAT "%12.6" EXTENDED_LIMITS 0.20000305180 13107.200000 /end CHARACTERISTIC
/begin CHARACTERISTIC TEVSMX "Maximal tmperatur of inlet valve for temperature correction after start" VALUE 0x80525914 RB_Val_Wu8 191.3 temp_q0p75_om48 -48.0 143.3 FORMAT "%5.1" /end CHARACTERISTIC
/begin CHARACTERISTIC TMECmb_diaChrgMtnIntkOpen_M "correction of the optimized model reference ignition angle depending on charge motion due to intake opening" MAP 0x805247AE RB_Map_S16S16_S16 191.9971 zw_q2p9297Em3_deg_KW -96.00000 95.99707 FORMAT "%8.5"
 /begin AXIS_DESCR STD_AXIS NO_INPUT_QUANTITY kw_q0p0156 6 -512.0000 511.9844 FORMAT "%8.4" DEPOSIT ABSOLUTE /end AXIS_DESCR
 /begin AXIS_DESCR STD_AXIS Epm_nEng EngN 4 -16384.00 16383.50 FORMAT "%8.2" DEPOSIT ABSOLUTE /end AXIS_DESCR
/end CHARACTERISTIC
/begin CHARACTERISTIC TMECmb_diaChrgMtn_M "correction of the optimized model reference ignition angle depending on charge motion" MAP 0x805247F6 RB_Map_S16S16_S16 191.9971 zw_q2p9297Em3_deg_KW -96.00000 95.99707 FORMAT "%8.5"
 /begin AXIS_DESCR STD_AXIS NO_INPUT_QUANTITY kw_q0p0156 20 -512.0000 511.9844 FORMAT "%8.4" DEPOSIT ABSOLUTE /end AXIS_DESCR
 /begin AXIS_DESCR STD_AXIS Epm_nEng EngN 16 -16384.00 16383.50 FORMAT "%8.2" DEPOSIT ABSOLUTE /end AXIS_DESCR
/end CHARACTERISTIC
/begin CHARACTERISTIC TMECmb_diaFu2LoVlvlft_T "Lambda dependency of optimized model reference ignition angle with Low valve lift, second fuel" CURVE 0x805246D8 RB_Curve_U16_S16_Static 191.9971 zw_q2p9297Em3_deg_KW -96.00000 95.99707 FORMAT "%8.5"
 /begin AXIS_DESCR STD_AXIS NO_INPUT_QUANTITY fak_uw_b16 10 0.00 15.99976 FORMAT "%8.5" DEPOSIT ABSOLUTE /end AXIS_DESCR
/end CHARACTERISTIC
/begin CHARACTERISTIC TMECmb_diaHspFu2LoVlvlft_T "Lambda based delta added to optimized model reference reference ignition angle for HSP with Low valve lift, second fuel" CURVE 0x80524702 RB_Curve_U16_S16_Static 191.9971 zw_q2p9297Em3_deg_KW -96.00000 95.99707 FORMAT "%8.5"
 /begin AXIS_DESCR STD_AXIS NO_INPUT_QUANTITY fak_uw_b16 10 0.00 15.99976 FORMAT "%8.5" DEPOSIT ABSOLUTE /end AXIS_DESCR
/end CHARACTERISTIC
/begin CHARACTERISTIC TMECmb_diaHspLoVlvlft_T "Lambda based delta added to optimized model reference ignition angle for HSP with Low valve lift" CURVE 0x8052472C RB_Curve_U16_S16_Static 191.9971 zw_q2p9297Em3_deg_KW -96.00000 95.99707 FORMAT "%8.5"
 /begin AXIS_DESCR STD_AXIS NO_INPUT_QUANTITY fak_uw_b16 10 0.00 15.99976 FORMAT "%8.5" DEPOSIT ABSOLUTE /end AXIS_DESCR
/end CHARACTERISTIC
/begin CHARACTERISTIC TMECmb_diaRefInertCylEgr_M "Map to calculate the delta ignition angle based on external and internal residual gas rate" MAP 0x80524B56 RB_Map_U16U16_S16 191.9971 zw_q2p9297Em3_deg_KW -96.00000 95.99707 FORMAT "%8.5"
 /begin AXIS_DESCR STD_AXIS NO_INPUT_QUANTITY rel_uw_b100 16 0.00 99.99847 FORMAT "%8.5" DEPOSIT ABSOLUTE /end AXIS_DESCR
 /begin AXIS_DESCR STD_AXIS NO_INPUT_QUANTITY rel_uw_b100 16 0.00 99.99847 FORMAT "%8.5" DEPOSIT ABSOLUTE /end AXIS_DESCR
/end CHARACTERISTIC
/begin CHARACTERISTIC TMECmb_facAgIntkClsd_T "correction delta ignition angle of the inert gas rate dependent from IVC" CURVE 0x80524D9A RB_Curve_S16_U16_Static 1.999969 fak_uw_b2 0.00 1.999969 FORMAT "%8.6"
 /begin AXIS_DESCR STD_AXIS NO_INPUT_QUANTITY kw_q0p0156 20 -512.0000 511.9844 FORMAT "%8.4" DEPOSIT ABSOLUTE /end AXIS_DESCR
/end CHARACTERISTIC
/begin CHARACTERISTIC TMECmb_facChrgMtnIntkClsd_T "curve for IVC influence on charge motion efficiency within torque model" CURVE 0x80524AC2 RB_Curve_S16_U16_Static 1.999969 fak_uw_b2 0.00 1.999969 FORMAT "%8.6"
 /begin AXIS_DESCR STD_AXIS NO_INPUT_QUANTITY kw_q0p0156 20 -512.0000 511.9844 FORMAT "%8.4" DEPOSIT ABSOLUTE /end AXIS_DESCR
/end CHARACTERISTIC
/begin CHARACTERISTIC TMECmb_facChrgMtnN_T "curve for engine speed influence on charge motion efficiency within torque model" CURVE 0x80524B14 RB_Curve_S16_U16_Static 1.999969 fak_uw_b2 0.00 1.999969 FORMAT "%8.6"
 /begin AXIS_DESCR STD_AXIS Epm_nEng EngN 16 -16384.00 16383.50 FORMAT "%8.2" DEPOSIT ABSOLUTE /end AXIS_DESCR
/end CHARACTERISTIC
/begin CHARACTERISTIC TMECmb_facRefInertCylEgr_M "Map for correction of the ignition angle efficiency dependent on external and internal residual gas rate" MAP 0x80524DEC RB_Map_U16U16_U16 1.999969 fak_uw_b2 0.00 1.999969 FORMAT "%8.6"
 /begin AXIS_DESCR STD_AXIS AirMod_ratInertEgrIntCyl rel_uw_b100 16 0.00 99.99847 FORMAT "%8.5" DEPOSIT ABSOLUTE /end AXIS_DESCR
 /begin AXIS_DESCR STD_AXIS AirMod_ratInertEgrExtCyl rel_uw_b100 16 0.00 99.99847 FORMAT "%8.5" DEPOSIT ABSOLUTE /end AXIS_DESCR
/end CHARACTERISTIC
/begin CHARACTERISTIC TMECmb_iaLamDpdVVlvLft_T "Lambda dependency of optimized model reference ignition angle referred to Lambda 1for variable valve lift" CURVE 0x80524756 RB_Curve_U16_S16_Static 36.00000 zw_q2p9297Em3_deg_KW -12.00000 24.00000 FORMAT "%8.5" EXTENDED_LIMITS -96.00000 95.99707
 /begin AXIS_DESCR STD_AXIS NO_INPUT_QUANTITY fak_uw_b16 10 0.00 15.99976 FORMAT "%8.5" DEPOSIT ABSOLUTE /end AXIS_DESCR
/end CHARACTERISTIC
/begin CHARACTERISTIC TMECmb_ratInertCylRef_M "reference inert gas rate used at calibration of basic ignition angles" MAP 0x80525030 RB_Map_S16U16_U16 99.99847 rel_uw_b100 0.00 99.99847 FORMAT "%8.5"
 /begin AXIS_DESCR STD_AXIS NO_INPUT_QUANTITY EngN 16 -16384.00 16383.50 FORMAT "%8.2" DEPOSIT ABSOLUTE /end AXIS_DESCR
 /begin AXIS_DESCR STD_AXIS NO_INPUT_QUANTITY rel_q0p0234 12 0.00 1535.977 FORMAT "%8.3" DEPOSIT ABSOLUTE /end AXIS_DESCR
/end CHARACTERISTIC
/begin CHARACTERISTIC TMECmb_stVlvlftMpg_I.OperMod2Idx_M "Mapping of a 16-bit mode of operation to the valve lift. / Mapping-Table for the conversion of the operation-mode-information in an other format" MAP 0x80524780 RB_Map_U8U8_U8 255.0 OneToOne 0.00 255.0 FORMAT "%5.1"
 /begin AXIS_DESCR STD_AXIS NO_INPUT_QUANTITY CoEOM_idxOperModCfgd_VERB 4 0.00 3.00000000000 FORMAT "%13.11" DEPOSIT ABSOLUTE /end AXIS_DESCR
 /begin AXIS_DESCR STD_AXIS NO_INPUT_QUANTITY CoEOM_idxOperModStgTot_VERB 8 0.00 15.0000000000 FORMAT "%13.10" DEPOSIT ABSOLUTE /end AXIS_DESCR
/end CHARACTERISTIC
/begin CHARACTERISTIC TMOTKWRMK "engine temperature for warm engine" VALUE 0x80525916 RB_Val_Wu16 1535.977 temp_q0p0234_o273 -273.150 1262.827 FORMAT "%8.3" /end CHARACTERISTIC
/begin CHARACTERISTIC TMSVABMX "temperature threshold to recognize hot start" VALUE 0x80525A4A RB_Val_Wu8 191.3 temp_ub_q0p75_o48 -48.0 143.3 FORMAT "%5.1" /end CHARACTERISTIC
/begin CHARACTERISTIC TMSVAPL "application parameter MSV-temperature" VALUE 0x80525A4B RB_Val_Wu8 191.3 temp_ub_q0p75_o48 -48.0 143.3 FORMAT "%5.1" /end CHARACTERISTIC
/begin CHARACTERISTIC TMSVQUALI "time period for steady-state, tmsvm" VALUE 0x80525A4C RB_Val_Wu16 13107.00 t_q0p2 0.00 13107.00 FORMAT "%8.2" /end CHARACTERISTIC
/begin CHARACTERISTIC TMSVTMTMX "temperature threshold to recognize hot start" VALUE 0x80525A4E RB_Val_Wu8 191.3 temp_ub_q0p75_o48 -48.0 143.3 FORMAT "%5.1" /end CHARACTERISTIC
/begin CHARACTERISTIC TNSURLP "Time rl prediction suppression in post-start" VALUE 0x80525CCE RB_Val_Wu16 655.3500 t10msxs_uw_b655p35 0.00 655.3500 FORMAT "%8.4" /end CHARACTERISTIC
/begin CHARACTERISTIC TTMSVSA "filter constant fuel mass and ambient temperature influence" VALUE 0x80525A50 RB_Val_Wu16 13106.999997 zk200msxs_uw_b13107p2 0.200003 13107.200000 FORMAT "%12.6" EXTENDED_LIMITS 0.20000305180 13107.200000 /end CHARACTERISTIC
/begin CHARACTERISTIC TTOCHLWTD "delay-time for activating weighting-factor" VALUE 0x80525A68 RB_Val_Wu8 255.0 t_q1 0.00 255.0 FORMAT "%5.1" /end CHARACTERISTIC
/begin CHARACTERISTIC TTOCHLWTP "time-constant for weighting-factor" VALUE 0x80525A69 RB_Val_Wu8 254.0 t_q1 1.0 255.0 FORMAT "%5.1" EXTENDED_LIMITS 0.00 255.0 /end CHARACTERISTIC
/begin CHARACTERISTIC TTSTST "time constant lowpass motor temperature, tmsvm" VALUE 0x80525A52 RB_Val_Wu16 13106.999997 zk200msxs_uw_b13107p2 0.200003 13107.200000 FORMAT "%12.6" EXTENDED_LIMITS 0.20000305180 13107.200000 /end CHARACTERISTIC
/begin CHARACTERISTIC TVBGTMSVG "delay after start for model validation" VALUE 0x80525A54 RB_Val_Wu16 6553.500 t_q0p1 0.00 6553.500 FORMAT "%8.3" /end CHARACTERISTIC
/begin CHARACTERISTIC TVDKPRMX "Max. delay time of DK prediction" VALUE 0x80525CD0 RB_Val_Wu8 0.2550 t_q0p001 0.00 0.2550 FORMAT "%6.4" /end CHARACTERISTIC
/begin CHARACTERISTIC WPRHOMMX "maximum prediction angle for homogen mode" VALUE 0x80525CD2 RB_Val_Wu16 49151.25 kw_q0p75 0.00 49151.25 FORMAT "%8.2" /end CHARACTERISTIC
/begin CHARACTERISTIC ZBRT "time constant for combustion chamber temp. model" VALUE 0x80525918 RB_Val_Wu16 6553.4999985 zk100msxs_uw_b6553p6 0.1000015 6553.6000000 FORMAT "%12.7" EXTENDED_LIMITS 0.10000152590 6553.6000000 /end CHARACTERISTIC
/begin CHARACTERISTIC ZWDKM1 "1. time constant throttle angle model" VALUE 0x80525CAC RB_Val_Wu16 2.5400387579 zk10msxs_uw_b655p36 0.0100001526 2.5500389105 FORMAT "%12.10" EXTENDED_LIMITS 0.010000152590 655.36000000 /end CHARACTERISTIC
/begin CHARACTERISTIC ZWDKM2 "2. time constant throttle angle model" VALUE 0x80525CAE RB_Val_Wu16 2.5400387579 zk10msxs_uw_b655p36 0.0100001526 2.5500389105 FORMAT "%12.10" EXTENDED_LIMITS 0.010000152590 655.36000000 /end CHARACTERISTIC
/begin CHARACTERISTIC ZWDKM3 "1. time constant throttle angle model" VALUE 0x80525CB0 RB_Val_Wu16 65.534999985 zk1msxs_uw_b65p536 0.001000015 65.536000000 FORMAT "%12.9" EXTENDED_LIMITS 0.0010000152590 65.536000000 /end CHARACTERISTIC
/begin CHARACTERISTIC ZWDKM4 "2. time constant throttle angle model" VALUE 0x80525CB2 RB_Val_Wu16 65.534999985 zk1msxs_uw_b65p536 0.001000015 65.536000000 FORMAT "%12.9" EXTENDED_LIMITS 0.0010000152590 65.536000000 /end CHARACTERISTIC
/begin MEASUREMENT AirMod_facWrmUpCorrn "Warm up correction factor for air charge in combustion chamber after engine start" UWORD fak_uw_b2 1 100 0.00 1.999969 FORMAT "%8.6" ECU_ADDRESS 0x600010B0 /end MEASUREMENT
/begin MEASUREMENT AirMod_idxCylAirChrgPred "Index on cylinder for air charge prediction" UBYTE OneToOne 1 100 0.00 255.0 FORMAT "%5.1" ECU_ADDRESS 0x50000985 /end MEASUREMENT
/begin MEASUREMENT AirMod_idxSynAirChrgPredMax "Index on cylinder for air charge prediction with maximum prediction horizont" UBYTE OneToOne 1 100 0.00 255.0 FORMAT "%5.1" ECU_ADDRESS 0x7000372F /end MEASUREMENT
/begin MEASUREMENT AirMod_mfEgrAct "Actual EGR mass flow" UWORD m_uw_b6553p5 1 100 0.00 6553.500 FORMAT "%8.3" ECU_ADDRESS 0x60001082 /end MEASUREMENT
/begin MEASUREMENT AirMod_nrSynAirChrgPred "Amount of cylinders between charge and charge prediction" UBYTE OneToOne 1 100 0.00 255.0 FORMAT "%5.1" ECU_ADDRESS 0x50000986 /end MEASUREMENT
/begin MEASUREMENT AirMod_nrSynAirChrgPredHom "Number of Sync for injection prediction in hom mode" UBYTE OneToOne 1 100 0.00 255.0 FORMAT "%5.1" ECU_ADDRESS 0x60000A82 /end MEASUREMENT
/begin MEASUREMENT AirMod_nrSynAirChrgPredMax "Amount of cylinders between charge and charge prediction with maximum prediction horizont" UBYTE OneToOne 1 100 0.00 255.0 FORMAT "%5.1" ECU_ADDRESS 0x7000372E /end MEASUREMENT
/begin MEASUREMENT AirMod_tAirEngCmptmt_mp "modelled air temperature in the engine compartment (measurement point)" UWORD temp_q0p0234_o273 1 100 -273.150 1262.827 FORMAT "%8.3" ECU_ADDRESS 0x7000A7EA /end MEASUREMENT
/begin MEASUREMENT AirMod_tAirPipExhMnfldDs_mp "modelled gas temperature at the end of the first part of the EGR pipe (measurement point)" UWORD temp_q0p0234_o273 1 100 -273.150 1262.827 FORMAT "%8.3" ECU_ADDRESS 0x7000A7E8 /end MEASUREMENT
/begin MEASUREMENT BGTMPK_U_TEMP_FTEMP_FAST_I.tahevX_w "temperature compensation, fast calculation / tahevX_winput for interface class BGTMPK_U_TEMP_FTEMP" UWORD temp_q0p0234_o273 1 100 -273.150 1262.827 FORMAT "%8.3" ECU_ADDRESS 0x600010AA /end MEASUREMENT
/begin MEASUREMENT Blwr_uVoltReq "COM - signal AC-blower voltage" SWORD Volt_q1 1 100 -32768.00 32767.00 FORMAT "%8.2" ECU_ADDRESS 0x60008A1C /end MEASUREMENT
/begin MEASUREMENT BrkBstP_aXFil "Filtered acceleration" SWORD Acc 1 100 -32.76800 32.76700 FORMAT "%8.5" ECU_ADDRESS 0x6000938E /end MEASUREMENT
/begin MEASUREMENT BrkBstP_bDecelByBrk "Deceleration by brake" UBYTE B_TRUE 1 100 0.00 1.00000000000 BIT_MASK 0x1 FORMAT "%13.11" ECU_ADDRESS 0x6000F1EF /end MEASUREMENT
/begin MEASUREMENT BrkBstP_bDriftTmrFrz "Flag for drift timer freeze" UBYTE B_TRUE 1 100 0.00 1.00000000000 BIT_MASK 0x1 FORMAT "%13.11" ECU_ADDRESS 0x6000E8BC /end MEASUREMENT
/begin MEASUREMENT BrkBstP_bStopByBrk "Stop by brake flag" UBYTE B_TRUE 1 100 0.00 1.00000000000 BIT_MASK 0x1 FORMAT "%13.11" ECU_ADDRESS 0x6000F1EE /end MEASUREMENT
/begin MEASUREMENT BrkBstP_bVehRunng "Vehicle in running flag" UBYTE B_TRUE 1 100 0.00 1.00000000000 BIT_MASK 0x1 FORMAT "%13.11" ECU_ADDRESS 0x6000F1ED /end MEASUREMENT
/begin MEASUREMENT BrkBstP_bVehStop "Vehicle stop flag" UBYTE B_TRUE 1 100 0.00 1.00000000000 BIT_MASK 0x1 FORMAT "%13.11" ECU_ADDRESS 0x6000F1EC /end MEASUREMENT
/begin MEASUREMENT BrkBstP_cntMstCylPValCnt "Master cylinder hydraulic pressure learning value counter" UWORD OneToOne 1 100 0.00 65535.00 FORMAT "%8.2" ECU_ADDRESS 0x600077BA /end MEASUREMENT
/begin MEASUREMENT BrkBstP_ctDriftErr "Drift error counter" UWORD OneToOne 1 100 0.00 65535.00 FORMAT "%8.2" ECU_ADDRESS 0x600077B8 /end MEASUREMENT
/begin MEASUREMENT BrkBstP_ctDriftHiErr "High drift error counter" UWORD OneToOne 1 100 0.00 65535.00 FORMAT "%8.2" ECU_ADDRESS 0x600077B6 /end MEASUREMENT
/begin MEASUREMENT BrkBstP_ctDriftLoErr "Low drift error counter" UWORD OneToOne 1 100 0.00 65535.00 FORMAT "%8.2" ECU_ADDRESS 0x600077B4 /end MEASUREMENT
/begin MEASUREMENT BrkBstP_ctVehStop "Vehicle stop count" UWORD OneToOne 1 100 0.00 65535.00 FORMAT "%8.2" ECU_ADDRESS 0x60008D4A /end MEASUREMENT
/begin MEASUREMENT BrkBstP_dpAbsMstCyl "Absolute change in pressure in master cylinder" SLONG Pres 1 100 0.00 214748364.700 FORMAT "%13.3" ECU_ADDRESS 0x60003128 /end MEASUREMENT
/begin MEASUREMENT BrkBstP_flgDSMClr "DSM clear trigger flag" UBYTE B_TRUE 1 100 0.00 1.00000000000 BIT_MASK 0x1 FORMAT "%13.11" ECU_ADDRESS 0x6000E8BB /end MEASUREMENT
/begin MEASUREMENT BrkBstP_flgMstCylPStabyChk "Master cylinder pressure stability flag" UBYTE B_TRUE 1 100 0.00 1.00000000000 BIT_MASK 0x1 FORMAT "%13.11" ECU_ADDRESS 0x6000E8BA /end MEASUREMENT
/begin MEASUREMENT BrkBstP_pAftFil "Brake boost pressure after filtering" SWORD Pres_hPa 1 100 -32768.00 32767.00 FORMAT "%8.2" ECU_ADDRESS 0x6000938A /end MEASUREMENT
/begin MEASUREMENT BrkBstP_pBrkBoostDiff "Difference in brake booster pressure before and after brake pressed" SLONG Pres_hPa 1 100 -2147483648.00 2147483647.00 FORMAT "%13.2" ECU_ADDRESS 0x60003124 /end MEASUREMENT
/begin MEASUREMENT BrkBstP_pBrkBoostMax "Maximum brake booster pressure after brake pressed" SWORD Pres_hPa 1 100 -32768.00 32767.00 FORMAT "%8.2" ECU_ADDRESS 0x60009388 /end MEASUREMENT
/begin MEASUREMENT BrkBstP_pBrkBoostMin "Minimum brake booster pressure before brake pressed" SWORD Pres_hPa 1 100 -32768.00 32767.00 FORMAT "%8.2" ECU_ADDRESS 0x60009386 /end MEASUREMENT
/begin MEASUREMENT BrkBstP_pChgMaxVal "The amount limit value of zero hydraulic pressure correction value change" SLONG Pres 1 100 -214748364.800 214748364.700 FORMAT "%13.3" ECU_ADDRESS 0x500010C4 /end MEASUREMENT
/begin MEASUREMENT BrkBstP_pCmpFldP "Master cylinder hydraulic pressure after zero-point adjustment" SLONG Pres 1 100 -214748364.800 214748364.700 FORMAT "%13.3" ECU_ADDRESS 0x50004D58 /end MEASUREMENT
/begin MEASUREMENT BrkBstP_pCorrnPVal "Zero master cylinder hydraulic pressure correction value" SLONG Pres 1 100 -214748364.800 214748364.700 FORMAT "%13.3" ECU_ADDRESS 0x600039FC /end MEASUREMENT
/begin MEASUREMENT BrkBstP_pCorrnPValInt "Zero master cylinder hydraulic pressure correction value(ENV RAM variable)" SLONG Pres 1 100 -214748364.800 214748364.700 FORMAT "%13.3" ECU_ADDRESS 0x60039490 /end MEASUREMENT
/begin MEASUREMENT BrkBstP_pDifAbsltVal "Absolute value of Difference of zero hydraulic pressure learning value and correction value" SLONG Pres 1 100 -214748364.800 214748364.700 FORMAT "%13.3" ECU_ADDRESS 0x500010C8 /end MEASUREMENT
/begin MEASUREMENT BrkBstP_pIntegdMstcylPVal "Zero master cylinder hydraulic pressure learning value integrated value" SLONG Pres 1 100 -214748364.800 214748364.700 FORMAT "%13.3" ECU_ADDRESS 0x60003120 /end MEASUREMENT
/begin MEASUREMENT BrkBstP_pLimVal "Difference of zero hydraulic pressure learning value and correction value with Limits applied" SLONG Pres 1 100 -214748364.800 214748364.700 FORMAT "%13.3" ECU_ADDRESS 0x500010CC /end MEASUREMENT
/begin MEASUREMENT BrkBstP_pLimValLo "Lower limit value in order to calculate the correction pressure value" SLONG Pres 1 100 -214748364.800 214748364.700 FORMAT "%13.3" ECU_ADDRESS 0x6000311C /end MEASUREMENT
/begin MEASUREMENT BrkBstP_pLrngCorrnPValDif "Difference of zero hydraulic pressure learning value and correction value" SLONG Pres 1 100 -214748364.800 214748364.700 FORMAT "%13.3" ECU_ADDRESS 0x500010D0 /end MEASUREMENT
/begin MEASUREMENT BrkBstP_pMstCylAftFil "Master cylinder pressure after filtering" SLONG Pres 1 100 -214748364.800 214748364.700 FORMAT "%13.3" ECU_ADDRESS 0x50004D5C /end MEASUREMENT
/begin MEASUREMENT BrkBstP_pMstCylAftFilOld "Master cylinder pressure after filtered old value" SLONG Pres 1 100 -214748364.800 214748364.700 FORMAT "%13.3" ECU_ADDRESS 0x60003118 /end MEASUREMENT
/begin MEASUREMENT BrkBstP_pMstCylAftOffsCalcn "Master cylinder brake pressure offset calculation" SLONG Pres 1 100 -214748364.800 214748364.700 FORMAT "%13.3" ECU_ADDRESS 0x600039F8 /end MEASUREMENT
/begin MEASUREMENT BrkBstP_pMstCylOffsVal "Master cylinder pressure offset value" SLONG Pres 1 100 -214748364.800 214748364.700 FORMAT "%13.3" ECU_ADDRESS 0x500010D4 /end MEASUREMENT
/begin MEASUREMENT BrkBstP_pMstCylOld "Master cylinder pressure old value" SWORD Pres_kPa_VSA 1 100 -785121.3 785097.3 FORMAT "%8.1" ECU_ADDRESS 0x600077B2 /end MEASUREMENT
/begin MEASUREMENT BrkBstP_pMstCylPAvgVal "Zero master cylinder hydraulic pressure learning value(Average value)" SLONG Pres 1 100 -214748364.800 214748364.700 FORMAT "%13.3" ECU_ADDRESS 0x60003114 /end MEASUREMENT
/begin MEASUREMENT BrkBstP_pMstCylReslCnv "Master Cylinder Oil pressure after resolution conversion" SLONG Pres 1 100 -214748364.800 214748364.700 FORMAT "%13.3" ECU_ADDRESS 0x500010D8 /end MEASUREMENT
/begin MEASUREMENT BrkBstP_pRawFldPDifVal "Master cylinder pressure min max difference value" SLONG Pres 1 100 -214748364.800 214748364.700 FORMAT "%13.3" ECU_ADDRESS 0x60003110 /end MEASUREMENT
/begin MEASUREMENT BrkBstP_pRawFldPMaxVal "maximum value during master cylinder hydraulic pressure data learning." SLONG Pres 1 100 -214748364.800 214748364.700 FORMAT "%13.3" ECU_ADDRESS 0x6000310C /end MEASUREMENT
/begin MEASUREMENT BrkBstP_pRawFldPMinVal "minimum value during master cylinder hydraulic pressure data learning." SLONG Pres 1 100 -214748364.800 214748364.700 FORMAT "%13.3" ECU_ADDRESS 0x500010DC /end MEASUREMENT
/begin MEASUREMENT BrkBstP_pSens "Sensed Brake Boost Vacuum pressure from sensor" SWORD Pres_hPa 1 100 -32768.00 32767.00 FORMAT "%8.2" ECU_ADDRESS 0x60009384 /end MEASUREMENT
/begin MEASUREMENT BrkBstP_stAYCBrkOilEna "AYC brake oil enable status" UBYTE B_TRUE 1 100 0.00 1.00000000000 BIT_MASK 0x1 FORMAT "%13.11" ECU_ADDRESS 0x6000F1EB /end MEASUREMENT
/begin MEASUREMENT BrkBstP_stBrkPsdDriftErr "Drift error check status" UBYTE OneToOne 1 100 0.00 255.0 FORMAT "%5.1" ECU_ADDRESS 0x6000F786 /end MEASUREMENT
/begin MEASUREMENT BrkBstP_stDrift "Drift error determination" UWORD OneToOne 1 100 0.00 65535.00 FORMAT "%8.2" ECU_ADDRESS 0x600077B0 /end MEASUREMENT
/begin MEASUREMENT BrkBstP_stFldPMeasCdn "Judgment master cylinder hydraulic pressure zero point learning permission flag." UBYTE B_TRUE 1 100 0.00 1.00000000000 BIT_MASK 0x1 FORMAT "%13.11" ECU_ADDRESS 0x6000E8B9 /end MEASUREMENT
/begin MEASUREMENT BrkBstP_stFldPOffsMeasCalcn "Judgment master cylinder hydraulic pressure zero point learning execution flag." UBYTE B_TRUE 1 100 0.00 1.00000000000 BIT_MASK 0x1 FORMAT "%13.11" ECU_ADDRESS 0x6000E8B8 /end MEASUREMENT
/begin MEASUREMENT BrkBstP_stFldPOffsMeasCdn "Judgment master cylinder hydraulic pressure zero point learning permission conditon" UWORD OneToOne 1 100 0.00 65535.00 FORMAT "%8.2" ECU_ADDRESS 0x600077AE /end MEASUREMENT
/begin MEASUREMENT BrkBstP_stFldPStaby "Hydraulic pressure stability flag" UBYTE B_TRUE 1 100 0.00 1.00000000000 BIT_MASK 0x1 FORMAT "%13.11" ECU_ADDRESS 0x6000E8B7 /end MEASUREMENT
/begin MEASUREMENT BrkBstP_stIniValCdn "Zero master cylinder hydraulic pressure adjustment initial value condition" UBYTE B_TRUE 1 100 0.00 1.00000000000 BIT_MASK 0x1 FORMAT "%13.11" ECU_ADDRESS 0x6003948D /end MEASUREMENT
/begin MEASUREMENT BrkBstP_stMstCylOffsVal "Master cylinder offset determination" UBYTE OneToOne 1 100 0.00 255.0 FORMAT "%5.1" ECU_ADDRESS 0x6000E8B6 /end MEASUREMENT
/begin MEASUREMENT BrkBstP_stVehStopCfmd "Vehicle stop confirmation" UBYTE OneToOne 1 100 0.00 255.0 FORMAT "%5.1" ECU_ADDRESS 0x6000E8B5 /end MEASUREMENT
/begin MEASUREMENT BrkBstP_stZrPntCalcnJdg "In process of master cylinder hydraulic pressure zero point learning value calculation" UBYTE B_TRUE 1 100 0.00 1.00000000000 BIT_MASK 0x1 FORMAT "%13.11" ECU_ADDRESS 0x6000F1EA /end MEASUREMENT
/begin MEASUREMENT BrkBstP_tiDecelByBrk "Checking the time during deceleration by brake" SLONG Time_s 1 100 -21474836.4800 21474836.4700 FORMAT "%13.4" ECU_ADDRESS 0x500010E0 /end MEASUREMENT
/begin MEASUREMENT BrkBstP_tiDriftErrRels "Drift error release time" SLONG Time_s 1 100 -21474836.4800 21474836.4700 FORMAT "%13.4" ECU_ADDRESS 0x60003108 /end MEASUREMENT
/begin MEASUREMENT BrkBstP_tiMstCylPStaby "Time for Master cylinder stability check" SLONG Time_s 1 100 -21474836.4800 21474836.4700 FORMAT "%13.4" ECU_ADDRESS 0x60003104 /end MEASUREMENT
/begin MEASUREMENT BrkBstP_uRaw "Raw voltage from ADC for brake Boost Vacuum pressure sensor" SWORD Volt 1 100 -6553.600 6553.400 FORMAT "%8.3" ECU_ADDRESS 0x60009382 /end MEASUREMENT
/begin MEASUREMENT BrkBstP_vXFil "Filtered vehicle speed" SWORD Vel 1 100 -327.6800 327.6700 FORMAT "%8.4" ECU_ADDRESS 0x60009380 /end MEASUREMENT
/begin MEASUREMENT BrkBst_dpBrkP_MP "Measure point of the current brake pressure difference" SWORD q2_bar_DIV_s 1 100 -65536.00 65534.00 FORMAT "%8.2" ECU_ADDRESS 0x7000A7E6 /end MEASUREMENT
/begin MEASUREMENT BrkBst_facBrkBkup_MP "Measure point of the current vacuum consumption factor in backup mode" SWORD Fact1000 1 100 -32.76800 32.76700 FORMAT "%8.5" ECU_ADDRESS 0x7000A7E4 /end MEASUREMENT
/begin MEASUREMENT BrkBst_facBrkPPsd_MP "Measure point of the current vacuum consumption factor of the brake pressure during brake pressing" SWORD Fact1000 1 100 -32.76800 32.76700 FORMAT "%8.5" ECU_ADDRESS 0x7000A7E2 /end MEASUREMENT
/begin MEASUREMENT BrkBst_facBrkPReld_MP "Measure point of the current vacuum consumption factor of the brake pressure during brake releasing" SWORD Fact1000 1 100 -32.76800 32.76700 FORMAT "%8.5" ECU_ADDRESS 0x7000A7E0 /end MEASUREMENT
/begin MEASUREMENT BrkBst_facBrkSt_MP "Measure point of the current vacuum consumption factor of the brake status" SWORD Fact1000 1 100 -32.76800 32.76700 FORMAT "%8.5" ECU_ADDRESS 0x7000A7DE /end MEASUREMENT
/begin MEASUREMENT BrkBst_pBrkPDlyd_MP "Measure point for the delayed brake pressure" SWORD p_q10 1 100 -327680.0 327670.0 FORMAT "%8.1" ECU_ADDRESS 0x7000A7DC /end MEASUREMENT
/begin MEASUREMENT BrkBst_pMdl "Modeled Pressure in the brake booster" SWORD Pres_hPa 1 100 -32768.00 32767.00 FORMAT "%8.2" ECU_ADDRESS 0x6000937E /end MEASUREMENT
/begin MEASUREMENT BrkBst_pMdlInc_MP "Calculated pressure increase of the brake booster pressure model" SWORD Pres_hPa 1 100 -32768.00 32767.00 FORMAT "%8.2" ECU_ADDRESS 0x7000A7DA /end MEASUREMENT
/begin MEASUREMENT BrkBst_pMdlRedn_MP "Current pressure change by vacuum generators, which reduce the model value" SWORD Pres_hPa 1 100 -32768.00 32767.00 FORMAT "%8.2" ECU_ADDRESS 0x7000A7D8 /end MEASUREMENT
/begin MEASUREMENT BrkBst_pMnfldRedn_MP "Measure point of the current vacuum generation value of the manifold" SWORD Pres_hPa 1 100 -32768.00 32767.00 FORMAT "%8.2" ECU_ADDRESS 0x7000A7D6 /end MEASUREMENT
/begin MEASUREMENT BrkPed_aDif "The longitudinal acceleration difference rate value" SWORD RBPtCel_m_0p001_1 1 100 -32.76800 32.76700 FORMAT "%8.5" ECU_ADDRESS 0x60009378 /end MEASUREMENT
/begin MEASUREMENT BrkPed_aGrdt "The longitudinal acceleration value after rate limit" SWORD RBPtCel_m_0p001_1 1 100 -32.76800 32.76700 FORMAT "%8.5" ECU_ADDRESS 0x60009376 /end MEASUREMENT
/begin MEASUREMENT BrkPed_aGrdtFild "Filtered value of gradient information received from SRS" SWORD RBPtCel_m_0p001_1 1 100 -32.76800 32.76700 FORMAT "%8.5" ECU_ADDRESS 0x60009374 /end MEASUREMENT
/begin MEASUREMENT BrkPed_aGrdtFildDif "Difference between the maximum and minimum gradient value received during window period" SLONG RBPtCel_m_0p001_1 1 100 -2147483.64800 2147483.64700 FORMAT "%13.5" ECU_ADDRESS 0x60003100 /end MEASUREMENT
/begin MEASUREMENT BrkPed_aGrdtFildHist_a "Array for storing history values of g sensor output during window period for vehicle standstill detection" SWORD RBPtCel_m_0p001_1 1 100 -32.76800 32.76700 FORMAT "%8.5" ARRAY_SIZE 50 ECU_ADDRESS 0x6000774A /end MEASUREMENT
/begin MEASUREMENT BrkPed_aGrdtFildMax "Maximum gradient value received during window period for vehicle standstill detection" SWORD RBPtCel_m_0p001_1 1 100 -32.76800 32.76700 FORMAT "%8.5" ECU_ADDRESS 0x60007748 /end MEASUREMENT
/begin MEASUREMENT BrkPed_aGrdtFildMin "Minimum gradient value recieved during window period for vehicle standstill detection" SWORD RBPtCel_m_0p001_1 1 100 -32.76800 32.76700 FORMAT "%8.5" ECU_ADDRESS 0x60007746 /end MEASUREMENT
/begin MEASUREMENT BrkPed_aLgtG "The longitudinal acceleration information" SLONG RBPtCel_m_0p001_1 1 100 -2147483.64800 2147483.64700 FORMAT "%13.5" ECU_ADDRESS 0x600030FC /end MEASUREMENT
/begin MEASUREMENT BrkPed_aLgtGCnvn "The converted longitudinal acceleration information" SWORD RBPtCel_m_0p001_1 1 100 -32.76800 32.76700 FORMAT "%8.5" ECU_ADDRESS 0x60009372 /end MEASUREMENT
/begin MEASUREMENT BrkPed_aSlopEBB "Slope value for EBB" SWORD RBPtCel_m_0p001_1 1 100 -32.76800 32.76700 FORMAT "%8.5" ECU_ADDRESS 0x60009370 /end MEASUREMENT
/begin MEASUREMENT BrkPed_bEngStopEna "stop release brake system" UBYTE B_TRUE 1 100 0.00 1.00000000000 BIT_MASK 0x1 FORMAT "%13.11" ECU_ADDRESS 0x70000ADE /end MEASUREMENT
/begin MEASUREMENT BrkPed_bEngStrtReq "start request brake system" UBYTE B_TRUE 1 100 0.00 1.00000000000 BIT_MASK 0x1 FORMAT "%13.11" ECU_ADDRESS 0x70000ADD /end MEASUREMENT
/begin MEASUREMENT BrkPed_cntrISABRls "Counter for calculation of ISAB request cancellation" UWORD Fact_100 1 100 0.00 655.3500 FORMAT "%8.4" ECU_ADDRESS 0x60007744 /end MEASUREMENT
/begin MEASUREMENT BrkPed_flgBrkBoostEngStopEna "Stop release brake from Brake Booster function" UBYTE B_TRUE 1 100 0.00 1.00000000000 BIT_MASK 0x1 FORMAT "%13.11" ECU_ADDRESS 0x700003ED /end MEASUREMENT
/begin MEASUREMENT BrkPed_flgBrkBoostEngStrtReq "Start request brake from Brake Booster function" UBYTE B_TRUE 1 100 0.00 1.00000000000 BIT_MASK 0x1 FORMAT "%13.11" ECU_ADDRESS 0x700003EC /end MEASUREMENT
/begin MEASUREMENT BrkPed_flgBrkBoostEngSysOff "System off by EBB from Brake Booster function" UBYTE B_TRUE 1 100 0.00 1.00000000000 BIT_MASK 0x1 FORMAT "%13.11" ECU_ADDRESS 0x700003EB /end MEASUREMENT
/begin MEASUREMENT BrkPed_flgEBBEngSysOff "System off by EBB" UBYTE B_TRUE 1 100 0.00 1.00000000000 BIT_MASK 0x1 FORMAT "%13.11" ECU_ADDRESS 0x6000F1E9 /end MEASUREMENT
/begin MEASUREMENT BrkPed_flgEBBFailrOcc_MP "Measurement Point for EBB failure Occurance" UBYTE B_TRUE 1 100 0.00 1.00000000000 BIT_MASK 0x1 FORMAT "%13.11" ECU_ADDRESS 0x7000A7D4 /end MEASUREMENT
/begin MEASUREMENT BrkPed_flgEBBHiSlop "Slope High flag for EBB" UBYTE B_TRUE 1 100 0.00 1.00000000000 BIT_MASK 0x1 FORMAT "%13.11" ECU_ADDRESS 0x6000F1E8 /end MEASUREMENT
/begin MEASUREMENT BrkPed_flgEBBVehStandStill "Vehicle stand still status confirmed for EBB" UBYTE B_TRUE 1 100 0.00 1.00000000000 BIT_MASK 0x1 FORMAT "%13.11" ECU_ADDRESS 0x6000E8B4 /end MEASUREMENT
/begin MEASUREMENT BrkPed_flgIMGEngStopEna "Stop release brake from IMG ECU" UBYTE B_TRUE 1 100 0.00 1.00000000000 BIT_MASK 0x1 FORMAT "%13.11" ECU_ADDRESS 0x700003EA /end MEASUREMENT
/begin MEASUREMENT BrkPed_flgIMGEngStrtReq "Start request brake from IMG ECU" UBYTE B_TRUE 1 100 0.00 1.00000000000 BIT_MASK 0x1 FORMAT "%13.11" ECU_ADDRESS 0x700003E9 /end MEASUREMENT
/begin MEASUREMENT BrkPed_flgIMGEngSysOff "System off by EBB from IMG ECU" UBYTE B_TRUE 1 100 0.00 1.00000000000 BIT_MASK 0x1 FORMAT "%13.11" ECU_ADDRESS 0x700003E8 /end MEASUREMENT
/begin MEASUREMENT BrkPed_flgISABBrkPSuffVehStill "Flag to indicate that Vehicle is stand still and enough brake pressure available to allow Idle stop" UBYTE B_TRUE 1 100 0.00 1.00000000000 BIT_MASK 0x1 FORMAT "%13.11" ECU_ADDRESS 0x6000F1E7 /end MEASUREMENT
/begin MEASUREMENT BrkPed_flgISABDi "Flag to indicate that ISAB is disabled due to sensor failure or slope out of range" UBYTE B_TRUE 1 100 0.00 1.00000000000 BIT_MASK 0x1 FORMAT "%13.11" ECU_ADDRESS 0x6000F1E6 /end MEASUREMENT
/begin MEASUREMENT BrkPed_flgISABReq "Flag for ISAB Request" UBYTE B_TRUE 1 100 0.00 1.00000000000 BIT_MASK 0x1 FORMAT "%13.11" ECU_ADDRESS 0x6000F1E5 /end MEASUREMENT
/begin MEASUREMENT BrkPed_flgLgtGComErr "Flag indicate for failure information of G sensor abnormal" UBYTE B_TRUE 1 100 0.00 1.00000000000 BIT_MASK 0x1 FORMAT "%13.11" ECU_ADDRESS 0x6000F1E4 /end MEASUREMENT
/begin MEASUREMENT BrkPed_flgNonServoFailr_MP "Measurement Point for Non Servo Failure" UBYTE B_TRUE 1 100 0.00 1.00000000000 BIT_MASK 0x1 FORMAT "%13.11" ECU_ADDRESS 0x7000A7D3 /end MEASUREMENT
/begin MEASUREMENT BrkPed_flgSlopeExcd "Flag to indicate that slope is outside the permitted range to allow idle stop" UBYTE B_TRUE 1 100 0.00 1.00000000000 BIT_MASK 0x1 FORMAT "%13.11" ECU_ADDRESS 0x6000F1E3 /end MEASUREMENT
/begin MEASUREMENT BrkPed_flgSwtISABAvl "ISAB enable flag" UBYTE B_TRUE 1 100 0.00 1.00000000000 BIT_MASK 0x1 FORMAT "%13.11" ECU_ADDRESS 0x6000F1E2 /end MEASUREMENT
/begin MEASUREMENT BrkPed_flgVehStandStill "Vehicle standstill condition detection" UBYTE B_TRUE 1 100 0.00 1.00000000000 BIT_MASK 0x1 FORMAT "%13.11" ECU_ADDRESS 0x6000F1E1 /end MEASUREMENT
/begin MEASUREMENT BrkPed_flgVSAFailr_MP "Measurement Point for VSA failure" UBYTE B_TRUE 1 100 0.00 1.00000000000 BIT_MASK 0x1 FORMAT "%13.11" ECU_ADDRESS 0x7000A7D2 /end MEASUREMENT
/begin MEASUREMENT BrkPed_nrGrdtArySize "Number of gradient samples to be collected during window period for vehicle standstill detection" UBYTE OneToOne 1 100 0.00 50.00 FORMAT "%5.2" ECU_ADDRESS 0x6000E8B3 /end MEASUREMENT
/begin MEASUREMENT BrkPed_pEnvP_MP "Minimum threshold value of environmental pressure" SWORD Pres_hPa 1 100 -32768.00 32767.00 FORMAT "%8.2" ECU_ADDRESS 0x7000A7D0 /end MEASUREMENT
/begin MEASUREMENT BrkPed_pEVPMnFldP_MP "Measurement point for manifold pressure after convert from mmHg to hPa" SLONG Pres_hPa 1 100 -2147483648.00 2147483647.00 FORMAT "%13.2" ECU_ADDRESS 0x7000A7CC /end MEASUREMENT
/begin MEASUREMENT BrkPed_pRel "Difference between brake pressure and environmental pressure" SLONG Pres_hPa 1 100 -65535.0000000 65535.0000000 FORMAT "%13.7" ECU_ADDRESS 0x600039EC /end MEASUREMENT
/begin MEASUREMENT BrkPed_stVehStandStill "Vehicle stand still status" UBYTE B_TRUE 1 100 0.00 1.00000000000 BIT_MASK 0x1 FORMAT "%13.11" ECU_ADDRESS 0x6000E8B2 /end MEASUREMENT
/begin MEASUREMENT BrkPed_tiEBBSlopInRng "Timer value for slope in vehicle speed range." UWORD Time_ms 1 100 0.00 655350.0 FORMAT "%8.1" ECU_ADDRESS 0x60007742 /end MEASUREMENT
/begin MEASUREMENT BrkPed_tiElpdSnceVehSpdZr "Time elapsed since vehicle speed and wheel speed was zero" SWORD Time_s 1 100 -327.6800 327.6700 FORMAT "%8.4" ECU_ADDRESS 0x60007740 /end MEASUREMENT
/begin MEASUREMENT BrkPed_tqIMGISABIdleStop "Brake torque required to prevent vehicle roll back for current road inclination" SWORD TrqPerSec 1 100 0.00 20000.00 FORMAT "%8.2" ECU_ADDRESS 0x6000936C /end MEASUREMENT
/begin MEASUREMENT BrkP_dpMstCyl "Master Cylinder Differential Pressure" SWORD p_q100 1 100 -3276800. 3276700. FORMAT "%8.0" ECU_ADDRESS 0x6000937C /end MEASUREMENT
/begin MEASUREMENT BrkP_p "Brake Pressure" SLONG Pres_hPa 1 100 -2147483648.00 2147483647.00 FORMAT "%13.2" ECU_ADDRESS 0x600039F4 /end MEASUREMENT
/begin MEASUREMENT BrkP_pMstCylold "old value of Master cylinder pressure" SLONG Pres_hPa 1 100 -2147483648.00 2147483647.00 FORMAT "%13.2" ECU_ADDRESS 0x600030F8 /end MEASUREMENT
/begin MEASUREMENT BrkP_pSnsr "Main brake cylinder pressure raw value" SLONG Pres_hPa 1 100 -2147483648.00 2147483647.00 FORMAT "%13.2" ECU_ADDRESS 0x600039F0 /end MEASUREMENT
/begin MEASUREMENT Brk_cntrReIni "ReIni counter" UBYTE OneToOne 1 100 0.00 255.0 FORMAT "%5.1" ECU_ADDRESS 0x6000E8B1 /end MEASUREMENT
/begin MEASUREMENT Brk_ctMnBrkSwtNotStp "Fault counter value for main brake switch not pressed" UBYTE OneToOne 1 100 0.00 255.0 FORMAT "%5.1" ECU_ADDRESS 0x6000F8A7 /end MEASUREMENT
/begin MEASUREMENT Brk_ctMnSwtContOn "Main Brake Switch continuous stepped on fault detect counter." UWORD OneToOne 1 100 0.00 65535.00 FORMAT "%8.2" ECU_ADDRESS 0x600094DC /end MEASUREMENT
/begin MEASUREMENT Brk_ctMnSwtContOnHealCond "Counter value for Main brake continuously pressed fault detection healing condition" UBYTE OneToOne 1 100 0.00 255.0 FORMAT "%5.1" ECU_ADDRESS 0x6000F8A6 /end MEASUREMENT
/begin MEASUREMENT Brk_ctMnSwtNotStpHealCond "Counter value for Main Brake not stepped on fault detection healing condition" UBYTE OneToOne 1 100 0.00 255.0 FORMAT "%5.1" ECU_ADDRESS 0x6000F8A5 /end MEASUREMENT
/begin MEASUREMENT Brk_ctPla_mp "counter brake not plausible" UBYTE OneToOne 1 100 0.00 255.0 FORMAT "%5.1" ECU_ADDRESS 0x70009FED /end MEASUREMENT
/begin MEASUREMENT Brk_ctRdntBrkSwtNotStp "Fault counter value for redundant brake switch not pressed" UBYTE OneToOne 1 100 0.00 255.0 FORMAT "%5.1" ECU_ADDRESS 0x6000F8A4 /end MEASUREMENT
/begin MEASUREMENT Brk_ctRdntSwtContOn "Redundant Brake Switch continuous stepped on fault detect counter." UWORD OneToOne 1 100 0.00 65535.00 FORMAT "%8.2" ECU_ADDRESS 0x600094DA /end MEASUREMENT
/begin MEASUREMENT Brk_ctRdntSwtContOnHealCond "Counter value for Main Brake continuosly stepped on fault detection healing condition" UBYTE OneToOne 1 100 0.00 255.0 FORMAT "%5.1" ECU_ADDRESS 0x6000F8A3 /end MEASUREMENT
/begin MEASUREMENT Brk_ctRdntSwtNotStpHealCond "Counter value for Redundant Brake not stepped on fault detection healing condition" UBYTE OneToOne 1 100 0.00 255.0 FORMAT "%5.1" ECU_ADDRESS 0x6000F8A2 /end MEASUREMENT
/begin MEASUREMENT Brk_flgMaiContsOnFltCntrDi "flag to disable main brake continuous on fault detection" UBYTE OneToOne 1 100 0.00 1.000 BIT_MASK 0x1 FORMAT "%5.3" ECU_ADDRESS 0x6000F7D1 /end MEASUREMENT
/begin MEASUREMENT Brk_flgMaiNonStepFltCntrDi "flag to disable main brake not pressed fault detection" UBYTE OneToOne 1 100 0.00 1.000 BIT_MASK 0x1 FORMAT "%5.3" ECU_ADDRESS 0x6000F7D0 /end MEASUREMENT
/begin MEASUREMENT Brk_flgMnSwtContOnHealCnt "Flag for Main brake continuosly pressed error healing condition counter value" UBYTE OneToOne 1 100 0.00 255.0 FORMAT "%5.1" ECU_ADDRESS 0x6000F8A1 /end MEASUREMENT
/begin MEASUREMENT Brk_flgMnSwtNotStpHealCnt "Flag for Main brake not stepped on error healing condition counter value" UBYTE OneToOne 1 100 0.00 255.0 FORMAT "%5.1" ECU_ADDRESS 0x6000F8A0 /end MEASUREMENT
/begin MEASUREMENT Brk_flgRdntBrkOn_mp "Measuring point for Redundant Brake On flag after delay." UBYTE OneToOne 1 100 0.00 255.0 FORMAT "%5.1" ECU_ADDRESS 0x70009FEC /end MEASUREMENT
/begin MEASUREMENT Brk_flgRdntContsOnFltCntrDi "flag to disable redundant brake continuous on fault detection" UBYTE OneToOne 1 100 0.00 1.000 BIT_MASK 0x1 FORMAT "%5.3" ECU_ADDRESS 0x6000F7CF /end MEASUREMENT
/begin MEASUREMENT Brk_flgRdntNonStepFltCntrDi "flag to disable redundant brake not pressed fault detection" UBYTE OneToOne 1 100 0.00 1.000 BIT_MASK 0x1 FORMAT "%5.3" ECU_ADDRESS 0x6000F7CE /end MEASUREMENT
/begin MEASUREMENT Brk_flgRdntSwtContOnHealCnt "Flag for redundant brake continuosly stepped on error healing condition counter" UBYTE OneToOne 1 100 0.00 255.0 FORMAT "%5.1" ECU_ADDRESS 0x6000F89F /end MEASUREMENT
/begin MEASUREMENT Brk_flgRdntSwtNotStpHealCnt "Flag for redundant brake not stepped on error healing condition counter value" UBYTE OneToOne 1 100 0.00 255.0 FORMAT "%5.1" ECU_ADDRESS 0x6000F89E /end MEASUREMENT
/begin MEASUREMENT Brk_st "Brake switch state" UBYTE OneToOne 1 100 0.00 255.0 FORMAT "%5.1" ECU_ADDRESS 0x50006006 /end MEASUREMENT
/begin MEASUREMENT Brk_stAry "Array of Brake status input" UBYTE OneToOne 1 100 0.00 255.0 FORMAT "%5.1" ARRAY_SIZE 4 ECU_ADDRESS 0x6000F89A /end MEASUREMENT
/begin MEASUREMENT Brk_stBrkChgPrio "Turbo charger position governor." UBYTE OneToOne 1 100 0.00 255.0 FORMAT "%5.1" ECU_ADDRESS 0x6000F899 /end MEASUREMENT
/begin MEASUREMENT Brk_stBrkVSA "Brake Status based on the automatic brake execution information from VSA ( Status is high priority)" UBYTE OneToOne 1 100 0.00 255.0 FORMAT "%5.1" ECU_ADDRESS 0x6000F898 /end MEASUREMENT
/begin MEASUREMENT Brk_stMn "State main brake switch" UBYTE OneToOne 1 100 0.00 255.0 BIT_MASK 0x1 FORMAT "%5.1" ECU_ADDRESS 0x6000F7CD /end MEASUREMENT
/begin MEASUREMENT Brk_stMnBrkSwtContStp_mp "Measuring point for the status of main brake continuously pressed" UBYTE OneToOne 1 100 0.00 255.0 FORMAT "%5.1" ECU_ADDRESS 0x70009FEB /end MEASUREMENT
/begin MEASUREMENT Brk_stMnBrkSwtNotStp_mp "Measuring point for the status of main brake switch not pressed" UBYTE OneToOne 1 100 0.00 255.0 FORMAT "%5.1" ECU_ADDRESS 0x70009FEA /end MEASUREMENT
/begin MEASUREMENT Brk_stMnRaw "State main brake switch, raw value" UBYTE OneToOne 1 100 0.00 255.0 FORMAT "%5.1" ECU_ADDRESS 0x6001410F /end MEASUREMENT
/begin MEASUREMENT Brk_stMnSwtContStpErrLstDC "Status of Main brake continuosly stepped on error condition in previous DC" UBYTE OneToOne 1 100 0.00 255.0 FORMAT "%5.1" ECU_ADDRESS 0x6000F897 /end MEASUREMENT
/begin MEASUREMENT Brk_stMnSwtNotStpErrLstDC "Status of Main Brake not stepped on error in previous DC" UBYTE OneToOne 1 100 0.00 255.0 FORMAT "%5.1" ECU_ADDRESS 0x6000F896 /end MEASUREMENT
/begin MEASUREMENT Brk_stRdntBrkSwtContStp_mp "Measuring point for the status of redundant brake continuously pressed" UBYTE OneToOne 1 100 0.00 255.0 FORMAT "%5.1" ECU_ADDRESS 0x70009FE9 /end MEASUREMENT
/begin MEASUREMENT Brk_stRdntBrkSwtNotStp_mp "Measuring point for the status of redundant brake switch not pressed" UBYTE OneToOne 1 100 0.00 255.0 FORMAT "%5.1" ECU_ADDRESS 0x70009FE8 /end MEASUREMENT
/begin MEASUREMENT Brk_stRdntSwtContStpErrLstDC "Status fo Redundant brake continuosly pressed error condition in previous DC" UBYTE OneToOne 1 100 0.00 255.0 FORMAT "%5.1" ECU_ADDRESS 0x6000F895 /end MEASUREMENT
/begin MEASUREMENT Brk_stRdntSwtNotStpErrLstDC "Status of Redundant brake not stepped on error in previuos DC" UBYTE OneToOne 1 100 0.00 255.0 FORMAT "%5.1" ECU_ADDRESS 0x6000F894 /end MEASUREMENT
/begin MEASUREMENT Brk_stRed "State redundant brake switch" UBYTE OneToOne 1 100 0.00 255.0 BIT_MASK 0x1 FORMAT "%5.1" ECU_ADDRESS 0x6000F7CC /end MEASUREMENT
/begin MEASUREMENT Brk_stRedRaw "State redundant brake switch, raw value" UBYTE OneToOne 1 100 0.00 255.0 FORMAT "%5.1" ECU_ADDRESS 0x60014110 /end MEASUREMENT
/begin MEASUREMENT Brk_stRstBrkNotStp "Reset for Brake not stepped condition" UBYTE OneToOne 1 100 0.00 255.0 FORMAT "%5.1" ECU_ADDRESS 0x6000F893 /end MEASUREMENT
/begin MEASUREMENT BusDiag_flgAPPLBUSOFF "Bus off state for APPL can node" UBYTE OneToOne 1 100 0.00 255.0 BIT_MASK 0x1 FORMAT "%5.1" ECU_ADDRESS 0x6000F1DD /end MEASUREMENT
/begin MEASUREMENT BusDiag_flgCANCBUSOFF "Bus off state for the CAN C can node" UBYTE OneToOne 1 100 0.00 255.0 BIT_MASK 0x1 FORMAT "%5.1" ECU_ADDRESS 0x6000F1DC /end MEASUREMENT
/begin MEASUREMENT BusDiag_flgVEHICLEBUSOFF "Bus off state for the VEHICLE can node" UBYTE OneToOne 1 100 0.00 255.0 BIT_MASK 0x1 FORMAT "%5.1" ECU_ADDRESS 0x60014111 /end MEASUREMENT
/begin MEASUREMENT B_agrblamx_msg "Condition: EGR is limited because of high value of lambda" UBYTE B_TRUE 1 100 0.00 1.00000000000 BIT_MASK 0x1 FORMAT "%13.11" ECU_ADDRESS 0x60000256 /end MEASUREMENT
/begin MEASUREMENT B_msvact_bgtmsv_loc "Condition fuel temperature sensor raw value plausible local value BGTMSV" UBYTE B_TRUE 1 100 0.00 1.00000000000 BIT_MASK 0x1 FORMAT "%13.11" ECU_ADDRESS 0x60000127 /end MEASUREMENT
/begin MEASUREMENT B_nsp_msg "condition for post-injection" UBYTE B_TRUE 1 100 0.00 1.00000000000 BIT_MASK 0x1 FORMAT "%13.11" ECU_ADDRESS 0x7000363F /end MEASUREMENT
/begin MEASUREMENT B_rlpdms_msg "condition for load prediction uses mass flow model at throttle valve (2. extrapolation)" UBYTE B_TRUE 1 100 0.00 1.00000000000 BIT_MASK 0x1 FORMAT "%13.11" ECU_ADDRESS 0x600014E7 /end MEASUREMENT
/begin MEASUREMENT B_rlpdp_msg "condition for load prediction using the gradient of the intake manifold pressure (1. extrapolation)" UBYTE B_TRUE 1 100 0.00 1.00000000000 BIT_MASK 0x1 FORMAT "%13.11" ECU_ADDRESS 0x600014E6 /end MEASUREMENT
/begin MEASUREMENT B_rlpvheus "condition load prediction for changed cam lift" UBYTE B_TRUE 1 100 0.00 1.00000000000 BIT_MASK 0x1 FORMAT "%13.11" ECU_ADDRESS 0x6000107C /end MEASUREMENT
/begin MEASUREMENT B_rlp_msg "condition for load prediction" UBYTE B_TRUE 1 100 0.00 1.00000000000 BIT_MASK 0x1 FORMAT "%13.11" ECU_ADDRESS 0x600014E8 /end MEASUREMENT
/begin MEASUREMENT B_stendz_bgtmsv_loc "condition first end of start in cycle local value BGTMSV" UBYTE B_TRUE 1 100 0.00 1.00000000000 BIT_MASK 0x1 FORMAT "%13.11" ECU_ADDRESS 0x60000126 /end MEASUREMENT
/begin MEASUREMENT B_stend_bgtmsv_loc "condition end of start local value BGTMSV" UBYTE B_TRUE 1 100 0.00 1.00000000000 BIT_MASK 0x1 FORMAT "%13.11" ECU_ADDRESS 0x60000125 /end MEASUREMENT
/begin MEASUREMENT B_tagrsrg_msg "exhaust gas temperature at manifold intake point is valid" UBYTE B_TRUE 1 100 0.00 1.00000000000 BIT_MASK 0x1 FORMAT "%13.11" ECU_ADDRESS 0x600001CF /end MEASUREMENT
/begin MEASUREMENT B_tahevg_msg "Condition tahev is valid" UBYTE B_TRUE 1 100 0.00 1.00000000000 BIT_MASK 0x1 FORMAT "%13.11" ECU_ADDRESS 0x600001CE /end MEASUREMENT
/begin MEASUREMENT B_tfuelg_bgtmsv_loc "condition fuel temperature value valid (sensor- or model value) local value BGTMSV" UBYTE B_TRUE 1 100 0.00 1.00000000000 BIT_MASK 0x1 FORMAT "%13.11" ECU_ADDRESS 0x60000124 /end MEASUREMENT
/begin MEASUREMENT B_tmsvmg_bgtmsv_loc "MSV temperature from model valid local value BGTMSV" UBYTE B_TRUE 1 100 0.00 1.00000000000 BIT_MASK 0x1 FORMAT "%13.11" ECU_ADDRESS 0x60000123 /end MEASUREMENT
/begin MEASUREMENT B_tmsvmg_msg "Condition mass flow valve temperature from model valid" UBYTE B_TRUE 1 100 0.00 1.00000000000 BIT_MASK 0x1 FORMAT "%13.11" ECU_ADDRESS 0x600001C1 /end MEASUREMENT
/begin MEASUREMENT B_tochgloc "validity of signal toch" UBYTE B_TRUE 1 100 0.00 1.00000000000 BIT_MASK 0x1 FORMAT "%13.11" ECU_ADDRESS 0x60000122 /end MEASUREMENT
/begin MEASUREMENT B_tochg_msg "validity of signal toch" UBYTE B_TRUE 1 100 0.00 1.00000000000 BIT_MASK 0x1 FORMAT "%13.11" ECU_ADDRESS 0x70000B0A /end MEASUREMENT
/begin MEASUREMENT B_tochlow "oiltemperature model cylinder-head (low-part)" UBYTE B_TRUE 1 100 0.00 1.00000000000 BIT_MASK 0x1 FORMAT "%13.11" ECU_ADDRESS 0x60000121 /end MEASUREMENT
/begin MEASUREMENT B_ugdsp_msg "condition predicted set value throttle angle near full load" UBYTE B_TRUE 1 100 0.00 1.00000000000 BIT_MASK 0x1 FORMAT "%13.11" ECU_ADDRESS 0x600014E3 /end MEASUREMENT
/begin MEASUREMENT CBUtil_stReProgEvnt "Reprogramming Event Status flag" UBYTE OneToOne 1 100 0.00 255.0 FORMAT "%5.1" ECU_ADDRESS 0x700035F5 /end MEASUREMENT
/begin MEASUREMENT CDRV_DELTA_TDC_CYL "Distance between TDCs in angle timer ticks." UWORD AngleCrS 1 100 0.00 1439.978 FORMAT "%8.3" ARRAY_SIZE 4 ECU_ADDRESS 0x50005886 /end MEASUREMENT
/begin MEASUREMENT CDRV_TDC_CYL "TDCs in angle timer ticks." UWORD AngleCrS 1 100 0.00 1439.978 FORMAT "%8.3" ARRAY_SIZE 4 ECU_ADDRESS 0x5000588E /end MEASUREMENT
/begin MEASUREMENT CdSHdG_GTMLib_PMTCtr "counter to check, if continous position minus time recalculation by SW is performed" UBYTE OneToOne 1 100 0.00 255.0 FORMAT "%5.1" ECU_ADDRESS 0x60010B19 /end MEASUREMENT
/begin MEASUREMENT CEngDsT_facLamDesLim "Desired Lambda limitation (word)" UWORD fak_uw_b16 1 100 0.00 15.99976 FORMAT "%8.5" ECU_ADDRESS 0x60008754 /end MEASUREMENT
/begin MEASUREMENT CEngDsT_flgCalcnEngStopVld "flag: CEngDsT_tStop calculation has been finished correctly in last driving cycle" UBYTE B_TRUE 1 100 0.00 1.00000000000 BIT_MASK 0x1 FORMAT "%13.11" ECU_ADDRESS 0x60036E09 /end MEASUREMENT
/begin MEASUREMENT CEngDsT_flgEngN "Condition: Engine Rotation higher Min-Threshold" UBYTE B_TRUE 1 100 0.00 1.00000000000 BIT_MASK 0x1 FORMAT "%13.11" ECU_ADDRESS 0x70000AD3 /end MEASUREMENT
/begin MEASUREMENT CEngDsT_flgHml "GDI mode homogeneous lean" UBYTE B_TRUE 1 100 0.00 1.00000000000 BIT_MASK 0x1 FORMAT "%13.11" ECU_ADDRESS 0x70000AD2 /end MEASUREMENT
/begin MEASUREMENT CEngDsT_flgImpsDi "disable flag loose connection check Engine Coolant temperature Sensor" UBYTE B_TRUE 1 100 0.00 1.00000000000 BIT_MASK 0x1 FORMAT "%13.11" ECU_ADDRESS 0x70000AD1 /end MEASUREMENT
/begin MEASUREMENT CEngDsT_flgImpsErr "error Loose-Connection-Check engine coolant temperature sensor" UBYTE B_TRUE 1 100 0.00 1.00000000000 BIT_MASK 0x1 FORMAT "%13.11" ECU_ADDRESS 0x70000AD0 /end MEASUREMENT
/begin MEASUREMENT CEngDsT_flgImpsErrTmp "undebounced error Loose-Connection-Check engine coolant temperature sensor" UBYTE B_TRUE 1 100 0.00 1.00000000000 BIT_MASK 0x1 FORMAT "%13.11" ECU_ADDRESS 0x700003E7 /end MEASUREMENT
/begin MEASUREMENT CEngDsT_flgImpsErrTmpDeb "debounced temporary error Loose-Connection-Check engine coolant temperature sensor" UBYTE B_TRUE 1 100 0.00 1.00000000000 BIT_MASK 0x1 FORMAT "%13.11" ECU_ADDRESS 0x700003E6 /end MEASUREMENT
/begin MEASUREMENT CEngDsT_flgImpsFF "FlipFlop error Loose-Connection-Check engine coolant temperature sensor" UBYTE B_TRUE 1 100 0.00 1.00000000000 BIT_MASK 0x1 FORMAT "%13.11" ECU_ADDRESS 0x700003E5 /end MEASUREMENT
/begin MEASUREMENT CEngDsT_flgImpsHeal "healing Loose-Connection-Check engine coolant temperature sensor" UBYTE B_TRUE 1 100 0.00 1.00000000000 BIT_MASK 0x1 FORMAT "%13.11" ECU_ADDRESS 0x70000ACF /end MEASUREMENT
/begin MEASUREMENT CEngDsT_flgImpsStr "storage error Loose-Connection-Check engine coolant temperature sensor" UBYTE B_TRUE 1 100 0.00 1.00000000000 BIT_MASK 0x1 FORMAT "%13.11" ECU_ADDRESS 0x60036DED /end MEASUREMENT
/begin MEASUREMENT CEngDsT_flgOvrRun "condition: fuel cutoff" UBYTE B_TRUE 1 100 0.00 1.00000000000 BIT_MASK 0x1 FORMAT "%13.11" ECU_ADDRESS 0x70000ACE /end MEASUREMENT
/begin MEASUREMENT CEngDsT_flgPhevChrgnMod "PHEV charge mode activated. Sensor values freezed." UBYTE B_TRUE 1 100 0.00 1.00000000000 BIT_MASK 0x1 FORMAT "%13.11" ECU_ADDRESS 0x70000ACD /end MEASUREMENT
/begin MEASUREMENT CEngDsT_flgPhevChrgnModEdgeFall "Edge Falling of CEngDsT_flgPhevChrgnMod" UBYTE B_TRUE 1 100 0.00 1.00000000000 BIT_MASK 0x1 FORMAT "%13.11" ECU_ADDRESS 0x70000ACC /end MEASUREMENT
/begin MEASUREMENT CEngDsT_flgSigErr "error Signal-Check engine coolant temperature sensor" UBYTE B_TRUE 1 100 0.00 1.00000000000 BIT_MASK 0x1 FORMAT "%13.11" ECU_ADDRESS 0x70000AB5 /end MEASUREMENT
/begin MEASUREMENT CEngDsT_flgSigErrTmp "undebounced error Signal-Check engine coolant temperature sensor" UBYTE B_TRUE 1 100 0.00 1.00000000000 BIT_MASK 0x1 FORMAT "%13.11" ECU_ADDRESS 0x700003E4 /end MEASUREMENT
/begin MEASUREMENT CEngDsT_flgSigHeal "healing Signal-Check engine coolant temperature sensor" UBYTE B_TRUE 1 100 0.00 1.00000000000 BIT_MASK 0x1 FORMAT "%13.11" ECU_ADDRESS 0x70000AB4 /end MEASUREMENT
/begin MEASUREMENT CEngDsT_flgSnsrElecVld "electrical validity engine coolant temperature sensor" UBYTE B_TRUE 1 100 0.00 1.00000000000 BIT_MASK 0x1 FORMAT "%13.11" ECU_ADDRESS 0x70000AB0 /end MEASUREMENT
/begin MEASUREMENT CEngDsT_flgSnsrElecVldDebInit "Flag for switch debounce time electrical validity engine coolant temperature sensor" UBYTE B_TRUE 1 100 0.00 1.00000000000 BIT_MASK 0x1 FORMAT "%13.11" ECU_ADDRESS 0x700003E3 /end MEASUREMENT
/begin MEASUREMENT CEngDsT_flgSnsrElecVldTmp "undebounced electrical validity engine coolant temperature sensor" UBYTE B_TRUE 1 100 0.00 1.00000000000 BIT_MASK 0x1 FORMAT "%13.11" ECU_ADDRESS 0x700003E2 /end MEASUREMENT
/begin MEASUREMENT CEngDsT_flgSnsrLCEna "Loose Connect Check is enable" UBYTE B_TRUE 1 100 0.00 1.00000000000 BIT_MASK 0x1 FORMAT "%13.11" ECU_ADDRESS 0x700003E1 /end MEASUREMENT
/begin MEASUREMENT CEngDsT_flgSnsrSigAvl "Validity Flag: signal from engine coolant temperature sensor available" UBYTE B_TRUE 1 100 0.00 1.00000000000 BIT_MASK 0x1 FORMAT "%13.11" ECU_ADDRESS 0x70000AAE /end MEASUREMENT
/begin MEASUREMENT CEngDsT_flgSnsrSigAvlER "Validity Flag: signal from engine coolant temperature sensor available (after edge-rising)" UBYTE B_TRUE 1 100 0.00 1.00000000000 BIT_MASK 0x1 FORMAT "%13.11" ECU_ADDRESS 0x700003E0 /end MEASUREMENT
/begin MEASUREMENT CEngDsT_flgSnsrVldStop "Bit: engine off temperature CEngDsT_tStop is valid" UBYTE B_TRUE 1 100 0.00 1.00000000000 BIT_MASK 0x1 FORMAT "%13.11" ECU_ADDRESS 0x60036E08 /end MEASUREMENT
/begin MEASUREMENT CEngDsT_flgSnsrVldStopFrst "validity information for CEngDsT_tStopFrst" UBYTE B_TRUE 1 100 0.00 1.00000000000 BIT_MASK 0x1 FORMAT "%13.11" ECU_ADDRESS 0x70000AAC /end MEASUREMENT
/begin MEASUREMENT CEngDsT_flgSnsrVldStrt "Bit: engine start temperature is valid" UBYTE B_TRUE 1 100 0.00 1.00000000000 BIT_MASK 0x1 FORMAT "%13.11" ECU_ADDRESS 0x70000AAB /end MEASUREMENT
/begin MEASUREMENT CEngDsT_flgSnsrVldStrtFrst "Bit: engine start temperature at first start is valid" UBYTE B_TRUE 1 100 0.00 1.00000000000 BIT_MASK 0x1 FORMAT "%13.11" ECU_ADDRESS 0x70000AAA /end MEASUREMENT
/begin MEASUREMENT CEngDsT_flgSRCDebInit "Flag for switch debounce time Signal-Range-Checky engine compartment temperature sensor" UBYTE B_TRUE 1 100 0.00 1.00000000000 BIT_MASK 0x1 FORMAT "%13.11" ECU_ADDRESS 0x700003DF /end MEASUREMENT
/begin MEASUREMENT CEngDsT_flgSRCErr "debounced error Signal-Range-Check engine coolant temperature sensor" UBYTE B_TRUE 1 100 0.00 1.00000000000 BIT_MASK 0x1 FORMAT "%13.11" ECU_ADDRESS 0x700003DE /end MEASUREMENT
/begin MEASUREMENT CEngDsT_flgSRCErrTmp "undebounced error Signal-Range-Check engine coolant temperature sensor" UBYTE B_TRUE 1 100 0.00 1.00000000000 BIT_MASK 0x1 FORMAT "%13.11" ECU_ADDRESS 0x700003DD /end MEASUREMENT
/begin MEASUREMENT CEngDsT_flgSRCHealTmp "temporrary healing Signal-Range-Check engine coolant temperature sensor" UBYTE B_TRUE 1 100 0.00 1.00000000000 BIT_MASK 0x1 FORMAT "%13.11" ECU_ADDRESS 0x700003DC /end MEASUREMENT
/begin MEASUREMENT CEngDsT_flgSRCMaxErr "debounced Max-error Signal-Range-Check engine coolant temperature sensor" UBYTE B_TRUE 1 100 0.00 1.00000000000 BIT_MASK 0x1 FORMAT "%13.11" ECU_ADDRESS 0x70000AB9 /end MEASUREMENT
/begin MEASUREMENT CEngDsT_flgSRCMaxErrTmp "undebounced Max-error Signal-Range-Check engine coolant temperature sensor" UBYTE B_TRUE 1 100 0.00 1.00000000000 BIT_MASK 0x1 FORMAT "%13.11" ECU_ADDRESS 0x700003DB /end MEASUREMENT
/begin MEASUREMENT CEngDsT_flgSRCMaxHeal "healing max error Signal-Range-Check engine coolant temperature sensor" UBYTE B_TRUE 1 100 0.00 1.00000000000 BIT_MASK 0x1 FORMAT "%13.11" ECU_ADDRESS 0x70000AB8 /end MEASUREMENT
/begin MEASUREMENT CEngDsT_flgSRCMinErr "debounced Min-error Signal-Range-Check engine coolant temperature sensor" UBYTE B_TRUE 1 100 0.00 1.00000000000 BIT_MASK 0x1 FORMAT "%13.11" ECU_ADDRESS 0x70000AB7 /end MEASUREMENT
/begin MEASUREMENT CEngDsT_flgSRCMinErrTmp "undebounced Min-error Signal-Range-Check engine coolant temperature sensor" UBYTE B_TRUE 1 100 0.00 1.00000000000 BIT_MASK 0x1 FORMAT "%13.11" ECU_ADDRESS 0x700003DA /end MEASUREMENT
/begin MEASUREMENT CEngDsT_flgSRCMinHeal "Heilung Min-Fehler elektrische Bereichsprüfung KühlmitteltemperaturSensor" UBYTE B_TRUE 1 100 0.00 1.00000000000 BIT_MASK 0x1 FORMAT "%13.11" ECU_ADDRESS 0x70000AB6 /end MEASUREMENT
/begin MEASUREMENT CEngDsT_flgStopFrst "Bit: first engine stop during actual driving cycle has taken place" UBYTE B_TRUE 1 100 0.00 1.00000000000 BIT_MASK 0x1 FORMAT "%13.11" ECU_ADDRESS 0x70000AA9 /end MEASUREMENT
/begin MEASUREMENT CEngDsT_flgStrat "GDI mode stratified" UBYTE B_TRUE 1 100 0.00 1.00000000000 BIT_MASK 0x1 FORMAT "%13.11" ECU_ADDRESS 0x70000AA8 /end MEASUREMENT
/begin MEASUREMENT CEngDsT_flgStrtEnd "condition end of start" UBYTE B_TRUE 1 100 0.00 1.00000000000 BIT_MASK 0x1 FORMAT "%13.11" ECU_ADDRESS 0x70000AA7 /end MEASUREMENT
/begin MEASUREMENT CEngDsT_flgStrtEndFrst "condition first end of start in cycle" UBYTE B_TRUE 1 100 0.00 1.00000000000 BIT_MASK 0x1 FORMAT "%13.11" ECU_ADDRESS 0x70000AA6 /end MEASUREMENT
/begin MEASUREMENT CEngDsT_flgSwtReplMdl "Condition - calculation replacement value" UBYTE B_TRUE 1 100 0.00 1.00000000000 BIT_MASK 0x1 FORMAT "%13.11" ECU_ADDRESS 0x70000AA5 /end MEASUREMENT
/begin MEASUREMENT CEngDsT_flgSwtReplMdlStrt "control-flag for switching over to replacement-value of engine-coolant temperature at start" UBYTE B_TRUE 1 100 0.00 1.00000000000 BIT_MASK 0x1 FORMAT "%13.11" ECU_ADDRESS 0x70000AA4 /end MEASUREMENT
/begin MEASUREMENT CEngDsT_flgSwtReplMdlStrtEdgeFall "edge falling: control-flag for switching over to replacement-value of engine-coolant temperature at start" UBYTE B_TRUE 1 100 0.00 1.00000000000 BIT_MASK 0x1 FORMAT "%13.11" ECU_ADDRESS 0x70000AA3 /end MEASUREMENT
/begin MEASUREMENT CEngDsT_mAirIntgl "integrated air mass flow from engine start to maximum value (copy for CEngDsT)" UBYTE m_ub_b23p3 1 100 0.00 23.21 FORMAT "%5.2" ECU_ADDRESS 0x6000F04B /end MEASUREMENT
/begin MEASUREMENT CEngDsT_mfAir "Air mass flow copy for CEngDsT package" UBYTE m_ub_b1020 1 100 0.00 1020. FORMAT "%5.0" ECU_ADDRESS 0x6000F04A /end MEASUREMENT
/begin MEASUREMENT CEngDsT_t "Coolant temperature measured at engine outlet" SWORD Temp_Cels 1 100 -3549.940 3003.560 FORMAT "%8.3" ECU_ADDRESS 0x50005C2C /end MEASUREMENT
/begin MEASUREMENT CEngDsT_tExtRepl "external temperature value engine coolant temperature" SWORD Temp_Cels 1 100 -3549.940 3003.560 FORMAT "%8.3" ECU_ADDRESS 0x60009360 /end MEASUREMENT
/begin MEASUREMENT CEngDsT_tInpFil "engine coolant temperature at low-pass input" SWORD Temp_Cels 1 100 -3549.940 3003.560 FORMAT "%8.3" ECU_ADDRESS 0x6000935E /end MEASUREMENT
/begin MEASUREMENT CEngDsT_tPID05Tstr "Engine Coolant Temperature for PID05 signal" SWORD Temp_Cels 1 100 -3549.940 3003.560 FORMAT "%8.3" ECU_ADDRESS 0x60008A18 /end MEASUREMENT
/begin MEASUREMENT CEngDsT_tSnsr "sensor value engine coolant temperature" SWORD Temp_Cels 1 100 -3549.940 3003.560 FORMAT "%8.3" ECU_ADDRESS 0x60008A0C /end MEASUREMENT
/begin MEASUREMENT CEngDsT_tSnsrFild "filtered sensor value engine coolant temperature" SWORD Temp_Cels 1 100 -3549.940 3003.560 FORMAT "%8.3" ECU_ADDRESS 0x60013E06 /end MEASUREMENT
/begin MEASUREMENT CEngDsT_tSnsrFildFrzn "engine coolant temperature (sensor value) after lowpass filter local for calculation of engine coolant temperature" SWORD Temp_Cels 1 100 -3549.940 3003.560 FORMAT "%8.3" ECU_ADDRESS 0x6000935C /end MEASUREMENT
/begin MEASUREMENT CEngDsT_tSnsrStrt "measured engine coolant temperature at start, linearised and calculated" SWORD Temp_Cels 1 100 -3549.940 3003.560 FORMAT "%8.3" ECU_ADDRESS 0x6000935A /end MEASUREMENT
/begin MEASUREMENT CEngDsT_tSnsrStrtFrst "measured engine coolant temperature at first start of driving cycle, linearised and calculated" SWORD Temp_Cels 1 100 -3549.940 3003.560 FORMAT "%8.3" ECU_ADDRESS 0x60009358 /end MEASUREMENT
/begin MEASUREMENT CEngDsT_tSnsrTstr "Coolant Engine Temperature for PID-Service" SWORD Temp_Cels 1 100 -3549.940 3003.560 FORMAT "%8.3" ECU_ADDRESS 0x60008A0A /end MEASUREMENT
/begin MEASUREMENT CEngDsT_tStop "engine coolant temperature at engine stop or cut-off cranking" SWORD Temp_Cels 1 100 -3549.940 3003.560 FORMAT "%8.3" ECU_ADDRESS 0x600395CE /end MEASUREMENT
/begin MEASUREMENT CEngDsT_tStopFrst "Cooling water temperature at stop of engine of last driving cycle" SWORD Temp_Cels 1 100 -3549.940 3003.560 FORMAT "%8.3" ECU_ADDRESS 0x60009356 /end MEASUREMENT
/begin MEASUREMENT CEngDsT_tStrt "Starting value of downstream engine coolant temperature" SWORD Temp_Cels 1 100 -3549.940 3003.560 FORMAT "%8.3" ECU_ADDRESS 0x60013E08 /end MEASUREMENT
/begin MEASUREMENT CEngDsT_tStrtFrst "Engine coolant downstream temperature during the first engine start of the driving cycle." SWORD Temp_Cels 1 100 -3549.940 3003.560 FORMAT "%8.3" ECU_ADDRESS 0x60009354 /end MEASUREMENT
/begin MEASUREMENT CEngDsT_t_Sq "Signal Quality of CEngDsT_t" UBYTE SigQly_COMPU_VERB 1 100 0.00 15.0000000000 FORMAT "%13.10" ECU_ADDRESS 0x6000F785 /end MEASUREMENT
/begin MEASUREMENT CEngDsT_uAbsltDifRawFltd "absolute value difference sensor voltage (filtered - unfiltered) engine coolant temperature sensor" UWORD Volt 1 100 0.00 5000.000 FORMAT "%8.3" ECU_ADDRESS 0x6000773E /end MEASUREMENT
/begin MEASUREMENT CEngDsT_uRaw "Raw ADC value of downstream engine coolant temperature sensor signal" UWORD Volt 1 100 0.00 5000.000 FORMAT "%8.3" ECU_ADDRESS 0x60013E0A /end MEASUREMENT
/begin MEASUREMENT CEngDsT_uRawFild "filtered sensor voltage engine coolant temperature sensor" UWORD Volt 1 100 0.00 5000.000 FORMAT "%8.3" ECU_ADDRESS 0x60008752 /end MEASUREMENT
/begin MEASUREMENT CEngDsT_uRawFildImps "filtered sensor voltage engine coolant temperature sensor for loose connection check" UWORD Volt 1 100 0.00 5000.000 FORMAT "%8.3" ECU_ADDRESS 0x6000773C /end MEASUREMENT
/begin MEASUREMENT difftmtans "difference temperature between tmot and tans" UBYTE temp_ub_q0p75_o48 1 100 -48.0 143.3 FORMAT "%5.1" ECU_ADDRESS 0x600010A8 /end MEASUREMENT
/begin MEASUREMENT difftmtfl "difference temperature between tmot and tfuelsq" UBYTE temp_ub_q0p75_o48 1 100 -48.0 143.3 FORMAT "%5.1" ECU_ADDRESS 0x600010A7 /end MEASUREMENT
/begin MEASUREMENT dtahevdyraw_w "raw value dynamic correction fresh air temperature in combustion chamber: dynamic at rl-nmot change" SWORD temp_q0p0234 1 100 -768.0000 767.9766 FORMAT "%8.4" ECU_ADDRESS 0x600010B4 /end MEASUREMENT
/begin MEASUREMENT dtahevdy_w "Delta fresh air temperature in combustion chamber: dynamic at rl-nmot change" SWORD temp_q0p0234 1 100 -768.0000 767.9766 FORMAT "%8.4" ECU_ADDRESS 0x600010B2 /end MEASUREMENT
/begin MEASUREMENT dtahevet_w "correction of fresh air temperature in combustion chamber for flexfuel" UWORD temp_q0p0234_o273 1 100 -273.150 1262.827 FORMAT "%8.3" ECU_ADDRESS 0x60001494 /end MEASUREMENT
/begin MEASUREMENT dzwolb_w_msg "correction of the optimized model reference ignition angle depending on charge motion" SWORD zw_q2p9297Em3_deg_KW 1 100 -96.00000 95.99707 FORMAT "%8.5" ECU_ADDRESS 0x500008AC /end MEASUREMENT
/begin MEASUREMENT dzwol_w_msg "Lambda-dependent correction of optimized model reference ignition angle" SWORD zw_q2p9297Em3_deg_KW 1 100 -96.00000 95.99707 FORMAT "%8.5" ECU_ADDRESS 0x500008AA /end MEASUREMENT
/begin MEASUREMENT dzworriref_w_msg "Shift of optimum ignition angle for reference ratio of residual gas" SWORD zw_q2p9297Em3_deg_KW 1 100 -96.00000 95.99707 FORMAT "%8.5" ECU_ADDRESS 0x500008B0 /end MEASUREMENT
/begin MEASUREMENT dzworri_w_msg "inert gas rate dependent correction of optimized model reference ignition angle" SWORD zw_q2p9297Em3_deg_KW 1 100 -96.00000 95.99707 FORMAT "%8.5" ECU_ADDRESS 0x500008AE /end MEASUREMENT
/begin MEASUREMENT etalab_w_msg "Lambda efficiency without intervention referred to optimum torque at Lambda=1" UWORD fak_uw_b2 1 100 0.00 1.999969 FORMAT "%8.6" ECU_ADDRESS 0x500008B6 /end MEASUREMENT
/begin MEASUREMENT etalb_w_msg "charge motion efficiency within torque model" UWORD fak_uw_b2 1 100 0.00 1.999969 FORMAT "%8.6" ECU_ADDRESS 0x500008B8 /end MEASUREMENT
/begin MEASUREMENT etalrplk_w_msg "Actual lambda efficiency during active lambda modulation" UWORD fak_uw_b2 1 100 0.00 1.999969 FORMAT "%8.6" ECU_ADDRESS 0x700037A6 /end MEASUREMENT
/begin MEASUREMENT etarri_w_msg "inert gas efficieny within torque model" UWORD fak_uw_b2 1 100 0.00 1.999969 FORMAT "%8.6" ECU_ADDRESS 0x500008BA /end MEASUREMENT
/begin MEASUREMENT fagrevx_w "Factor, heat transfer EGR sampling until valve at max. permiss. temp." UWORD fak_uw_b2 1 100 0.00 1.999969 FORMAT "%8.6" ECU_ADDRESS 0x60001080 /end MEASUREMENT
/begin MEASUREMENT ftahevmx_w_msg "maximum factor temperatur fesh air downstream inlet valve" UWORD fak_uw_b2 1 100 0.00 1.999969 FORMAT "%8.6" ECU_ADDRESS 0x600015F2 /end MEASUREMENT
/begin MEASUREMENT ftahev_w_msg "Factor temperature fresh air behind inlet valve" UWORD fak_uw_b2 1 100 0.00 1.999969 FORMAT "%8.6" ECU_ADDRESS 0x60000CDA /end MEASUREMENT
/begin MEASUREMENT ftavdkmn_w_msg "factor min correction air temperature for throttle valve flow f(intake air temp.,altit." UWORD fak_uw_b2 1 100 0.00 1.999969 FORMAT "%8.6" ECU_ADDRESS 0x60000CDC /end MEASUREMENT
/begin MEASUREMENT ftavdkmx_w_msg "factor maxcorrection air temperature for throttle valve flow f(intake air temp.,altit.)" UWORD fak_uw_b2 1 100 0.00 1.999969 FORMAT "%8.6" ECU_ADDRESS 0x60000CE0 /end MEASUREMENT
/begin MEASUREMENT ftochlw "weighting factor oiltemperature cylinder head lowpass-filtered" UBYTE fak_q0p00392 1 100 0.00 1.000 FORMAT "%5.3" ECU_ADDRESS 0x6000108C /end MEASUREMENT
/begin MEASUREMENT ftochwu "weighting factor oiltemperature cylinder head" UBYTE fak_q0p00392 1 100 0.00 1.000 FORMAT "%5.3" ECU_ADDRESS 0x6000108B /end MEASUREMENT
/begin MEASUREMENT ftsr_w_msg "correction factor for air temperature in the manifold" UWORD fak_uw_b2 1 100 0.00 1.999969 FORMAT "%8.6" ECU_ADDRESS 0x6000147A /end MEASUREMENT
/begin MEASUREMENT ftu_msg "factor: ambient temperature" UBYTE fak_ub_b2 1 100 0.00 1.992188 FORMAT "%8.6" ECU_ADDRESS 0x60001414 /end MEASUREMENT
/begin MEASUREMENT ftvdk_w_msg "correction factor for temperature upstream throttle" UWORD fak_uw_b2 1 100 0.00 1.999969 FORMAT "%8.6" ECU_ADDRESS 0x60001478 /end MEASUREMENT
/begin MEASUREMENT ftw_w "factor weighting of temperaturetwandsr, tasr" UWORD fak_uw_b2 1 100 0.00 1.999969 FORMAT "%8.6" ECU_ADDRESS 0x600010AE /end MEASUREMENT
/begin MEASUREMENT fwlkbgtmpk "local copy of fwlk" UWORD fak_uw_b2 1 100 0.00 1.999969 FORMAT "%8.6" ECU_ADDRESS 0x6000146E /end MEASUREMENT
/begin MEASUREMENT fwprs_w "Factor prediction angle with respect to segment" UWORD fak_uw_b32 1 100 0.00 31.99951 FORMAT "%8.5" ECU_ADDRESS 0x7000311A /end MEASUREMENT
/begin MEASUREMENT fwprs_w_msg "Factor prediction angle with respect to segment" UWORD fak_uw_b32 1 100 0.00 31.99951 FORMAT "%8.5" ECU_ADDRESS 0x500008D8 /end MEASUREMENT
/begin MEASUREMENT fwtevta_w "Factor heat transfer between valve temperature and intake air temperature" UWORD fak_uw_b1 1 100 0.00 0.9999847 FORMAT "%9.7" ECU_ADDRESS 0x6000146C /end MEASUREMENT
/begin MEASUREMENT laaeoagr_w_msg "Lambda in EGR output without modulation, model" UWORD fak_uw_b16 1 100 0.00 15.99976 FORMAT "%8.5" ECU_ADDRESS 0x60000CF0 /end MEASUREMENT
/begin MEASUREMENT lamdzwol_mp "measurement point lambda" UWORD fak_uw_b16 1 100 0.00 15.99976 FORMAT "%8.5" ECU_ADDRESS 0x7000A7EC /end MEASUREMENT
/begin MEASUREMENT mltoch "local copy - air mass flow" UBYTE m_ub_b1020 1 100 0.00 1020. FORMAT "%5.0" ECU_ADDRESS 0x6000108A /end MEASUREMENT
/begin MEASUREMENT msagrvmx_w_msg "Max. mass flow at max. permiss. temp. at valvle" UWORD m_uw_b6553p5 1 100 0.00 6553.500 FORMAT "%8.3" ECU_ADDRESS 0x60001456 /end MEASUREMENT
/begin MEASUREMENT nmottoch "local copy - engine speed" UBYTE nmot_ub_q40 1 100 0.00 10200. FORMAT "%5.0" ECU_ADDRESS 0x60001089 /end MEASUREMENT
/begin MEASUREMENT nmot_bgtmsv_loc "engine speed local value BGTMSV" UBYTE nmot_ub_q40 1 100 0.00 10200. FORMAT "%5.0" ECU_ADDRESS 0x600010A6 /end MEASUREMENT
/begin MEASUREMENT OilCylHdT_flgTCEngDsTVld "Validity of engine downstream temperature" UBYTE B_TRUE 1 100 0.00 1.00000000000 BIT_MASK 0x1 FORMAT "%13.11" ECU_ADDRESS 0x60000120 /end MEASUREMENT
/begin MEASUREMENT paagreo_w_msg "exhaust gas pressure at egr output point" UWORD p_uw_q0p039 1 100 0.00 2559.961 FORMAT "%8.3" ECU_ADDRESS 0x60000D08 /end MEASUREMENT
/begin MEASUREMENT pagreo_w_msg "exhaust gas pressure at egr output point value range until 5.1 bar" UWORD p_uw_q0p078 1 100 0.00 5119.922 FORMAT "%8.3" ECU_ADDRESS 0x60000D0C /end MEASUREMENT
/begin MEASUREMENT quotntke_w_msg "Engine speed quotient for thermo contact succed in massflow with inlet valve" UWORD fak_uw_b8 1 100 0.00 7.999878 FORMAT "%8.6" ECU_ADDRESS 0x60000D1C /end MEASUREMENT
/begin MEASUREMENT reclagre_w_msg "egr - reciprocal value from lambda (1/lambda)" UWORD fak_uw_b16 1 100 0.00 15.99976 FORMAT "%8.5" ECU_ADDRESS 0x60001596 /end MEASUREMENT
/begin MEASUREMENT rriref_w_msg "Residual gas for reference position of camshaft control andor control valve for external EGR" UWORD rel_uw_b100 1 100 0.00 99.99847 FORMAT "%8.5" ECU_ADDRESS 0x50000936 /end MEASUREMENT
/begin MEASUREMENT taev_w_msg "air temperature at inlet valve" UWORD temp_q0p0234_o273 1 100 -273.150 1262.827 FORMAT "%8.3" ECU_ADDRESS 0x60001546 /end MEASUREMENT
/begin MEASUREMENT tagreo_w_msg "temperature egr trapping point" UWORD temp_q0p0234_o273 1 100 -273.150 1262.827 FORMAT "%8.3" ECU_ADDRESS 0x60001432 /end MEASUREMENT
/begin MEASUREMENT tagrsr_w_msg "exhaust gas temperature at manifold intake point" UWORD temp_q0p0234_o273 1 100 -273.150 1262.827 FORMAT "%8.3" ECU_ADDRESS 0x60000D36 /end MEASUREMENT
/begin MEASUREMENT tagrvsr_w_msg "exhaust gas temperature vor manifold" UWORD temp_q0p0234_o273 1 100 -273.150 1262.827 FORMAT "%8.3" ECU_ADDRESS 0x60001430 /end MEASUREMENT
/begin MEASUREMENT tahevkor_w "dynamic correction value for fresh air behind inlet valve" UWORD temp_q0p0234_o273 1 100 -273.150 1262.827 FORMAT "%8.3" ECU_ADDRESS 0x60001544 /end MEASUREMENT
/begin MEASUREMENT tahev_w_msg "Temperature fresh air behind inlet valve" UWORD temp_q0p0234_o273 1 100 -273.150 1262.827 FORMAT "%8.3" ECU_ADDRESS 0x60000D3A /end MEASUREMENT
/begin MEASUREMENT tans_bgtmsv_loc "intake air temperature local value BGTMSV" UBYTE temp_ub_q0p75_o48 1 100 -48.0 143.3 FORMAT "%5.1" ECU_ADDRESS 0x600010A5 /end MEASUREMENT
/begin MEASUREMENT tengslst_bgtmsv_loc "state of variable tengs_l (local value BGTMSV)" UBYTE OneToOne 1 100 0.00 255.0 FORMAT "%5.1" ECU_ADDRESS 0x600010A4 /end MEASUREMENT
/begin MEASUREMENT tengsq1_w_bgtmsv_loc "engine stop time (measured from each engine stop or stall) local value BGTMSV" UWORD t1sxs_uw_q1 1 100 0.00 65535.00 FORMAT "%8.2" ECU_ADDRESS 0x600010A2 /end MEASUREMENT
/begin MEASUREMENT tev_w_msg "Temperature of inlet valve" UWORD temp_q0p0234_o273 1 100 -273.150 1262.827 FORMAT "%8.3" ECU_ADDRESS 0x6000142E /end MEASUREMENT
/begin MEASUREMENT tflmass_w_bgtmsv_loc "calculated fuel mass flow (local value BGTMSV)" UWORD m_uw_q0p24 1 100 0.00 15728.40 FORMAT "%8.2" ECU_ADDRESS 0x600010A0 /end MEASUREMENT
/begin MEASUREMENT tfuelhpsq_bgtmsv_loc "fuel temperature (rail) local value BGTMSV" UBYTE temp_ub_q0p75_o48 1 100 -48.0 143.3 FORMAT "%5.1" ECU_ADDRESS 0x6000109F /end MEASUREMENT
/begin MEASUREMENT tfuelsq_bgtmsv_loc "fuel temperature (sensor, model or subsitute value) local value BGTMSV" UBYTE temp_ub_q0p75_o48 1 100 -48.0 143.3 FORMAT "%5.1" ECU_ADDRESS 0x6000109E /end MEASUREMENT
/begin MEASUREMENT tfuelsrc_bgtmsv_loc "source fuel temperature ( tfuelsq or tfuelhpsq) local value BGTMSV" UBYTE temp_ub_q0p75_o48 1 100 -48.0 143.3 FORMAT "%5.1" ECU_ADDRESS 0x6000109D /end MEASUREMENT
/begin MEASUREMENT tgagrv_msg "Exhaust gas temperature at EGR-valve" UBYTE temp_q6_o273 1 100 -273. 1257. FORMAT "%5.0" ECU_ADDRESS 0x60001408 /end MEASUREMENT
/begin MEASUREMENT tgagrv_w_msg "Exhaust gas temperature at EGR-valve (Word)" UWORD temp_q0p0234_o273 1 100 -273.150 1262.827 FORMAT "%8.3" ECU_ADDRESS 0x6000142A /end MEASUREMENT
/begin MEASUREMENT tgnagrv_w_msg "Exhaust gas temperature at EGR-valve downstream" UWORD temp_q0p0234_o273 1 100 -273.150 1262.827 FORMAT "%8.3" ECU_ADDRESS 0x60001428 /end MEASUREMENT
/begin MEASUREMENT tgvagrv_w_msg "Exhaust gas temperature at EGR-valve upstream" UWORD temp_q0p0234_o273 1 100 -273.150 1262.827 FORMAT "%8.3" ECU_ADDRESS 0x60001426 /end MEASUREMENT
/begin MEASUREMENT TMECmb_diaAgIntkOpen "correction of the optimized model reference ignition angle depending on charge motion due to intake opening" SWORD zw_q2p9297Em3_deg_KW 1 100 -96.00000 95.99707 FORMAT "%8.5" ECU_ADDRESS 0x70003A5A /end MEASUREMENT
/begin MEASUREMENT TMECmb_diaRefChrgMtnAdv_a "correction of the optimized model reference ignition angle depending on charge motion" SWORD zw_q2p9297Em3_deg_KW 1 100 -96.00000 95.99707 FORMAT "%8.5" ARRAY_SIZE 4 ECU_ADDRESS 0x70003A52 /end MEASUREMENT
/begin MEASUREMENT TMECmb_diaRefInertCylAdv_a "Ign.angle offset dependent to residual inert gas(formerly dzworri)" SWORD zw_q2p9297Em3_deg_KW 1 100 -96.00000 95.99707 FORMAT "%8.5" ARRAY_SIZE 4 ECU_ADDRESS 0x70003A4A /end MEASUREMENT
/begin MEASUREMENT TMECmb_diaRefInertCylRefAdv_a "shifting of zwopt with ref.residual inert gas i.e.Cam in des.pos.(formerly dzworriref)" SWORD zw_q2p9297Em3_deg_KW 1 100 -96.00000 95.99707 FORMAT "%8.5" ARRAY_SIZE 4 ECU_ADDRESS 0x70003A42 /end MEASUREMENT
/begin MEASUREMENT TMECmb_facChrgMtnAdv_a "charge motion efficiency within torque model" UWORD fak_uw_b2 1 100 0.00 1.999969 FORMAT "%8.6" ARRAY_SIZE 4 ECU_ADDRESS 0x700037E0 /end MEASUREMENT
/begin MEASUREMENT TMECmb_facInertCylAdv_a "inert gas efficieny within torque model" UWORD fak_uw_b2 1 100 0.00 1.999969 FORMAT "%8.6" ARRAY_SIZE 4 ECU_ADDRESS 0x700037C0 /end MEASUREMENT
/begin MEASUREMENT TMECmb_IfEtalam_I.HSPActiv "dataset instance / Combustion dataset: condition GDI-operating mode for actual ignition cylinder is homogeneous-split" UBYTE dez 1 100 0.00 255.0 FORMAT "%5.1" ECU_ADDRESS 0x50000970 /end MEASUREMENT
/begin MEASUREMENT TMECmb_IfEtalam_I.f2ka "dataset instance / actual weighting factor of 2nd fuel - torque" UBYTE fak_ub_b1 1 100 0.00 0.9961 ECU_ADDRESS 0x50000971 /end MEASUREMENT
/begin MEASUREMENT TMECmb_IfEtalam_I.f2kazw "dataset instance / actual weighting factor of 2nd fuel - ignition" UBYTE fak_ub_b1 1 100 0.00 0.9961 ECU_ADDRESS 0x50000972 /end MEASUREMENT
/begin MEASUREMENT TMECmb_IfEtalam_I.flb "dataset instance / Combustion dataset: Factor charge-movement" UBYTE fak_ub_b1 1 100 0.00 0.9961 ECU_ADDRESS 0x50000973 /end MEASUREMENT
/begin MEASUREMENT TMECmb_IfEtalam_I.vlvlftActv "dataset instance / valve lift information" UBYTE OneToOne 1 100 0.00 255.0 FORMAT "%5.1" ECU_ADDRESS 0x50000974 /end MEASUREMENT
/begin MEASUREMENT tmotab_bgtmsv_loc "engine coolant temperature at engine stop or cut-off cranking (local value BGTMSV)" UBYTE temp_ub_q0p75_o48 1 100 -48.0 143.3 FORMAT "%5.1" ECU_ADDRESS 0x6000109C /end MEASUREMENT
/begin MEASUREMENT tmotdifk_w "difference from actuel engine temperature to warm engine temperature" UWORD temp_q0p0234_o273 1 100 -273.150 1262.827 FORMAT "%8.3" ECU_ADDRESS 0x600010AC /end MEASUREMENT
/begin MEASUREMENT tmot_bgtmsv_loc "Engine temperature (local value BGTMSV)" UBYTE temp_ub_q0p75_o48 1 100 -48.0 143.3 FORMAT "%5.1" ECU_ADDRESS 0x6000109B /end MEASUREMENT
/begin MEASUREMENT tmsvab "engine shut off MSV coil temperature" UBYTE temp_ub_q0p75_o48 1 100 -48.0 143.3 FORMAT "%5.1" ECU_ADDRESS 0x6000109A /end MEASUREMENT
/begin MEASUREMENT tmsvbas "basis temperature for MSV coil temperature" UBYTE temp_ub_q0p75_o48 1 100 -48.0 143.3 FORMAT "%5.1" ECU_ADDRESS 0x60001099 /end MEASUREMENT
/begin MEASUREMENT tmsvbasf "filtered basis temperature for MSV coil temperature" UBYTE temp_ub_q0p75_o48 1 100 -48.0 143.3 FORMAT "%5.1" ECU_ADDRESS 0x60001098 /end MEASUREMENT
/begin MEASUREMENT tmsveig "influence of body temperature, MSV" UBYTE temp_ub_q0p75_o48 1 100 -48.0 143.3 FORMAT "%5.1" ECU_ADDRESS 0x60001097 /end MEASUREMENT
/begin MEASUREMENT tmsveigf "influence of body temperature MSV, filtered" UBYTE temp_ub_q0p75_o48 1 100 -48.0 143.3 FORMAT "%5.1" ECU_ADDRESS 0x60001096 /end MEASUREMENT
/begin MEASUREMENT tmsvmab "engine shut off MSV coil temperature" UBYTE temp_ub_q0p75_o48 1 100 -48.0 143.3 FORMAT "%5.1" ECU_ADDRESS 0x60039494 /end MEASUREMENT
/begin MEASUREMENT tmsvmst "engine start MSV coil temperature" UBYTE temp_ub_q0p75_o48 1 100 -48.0 143.3 FORMAT "%5.1" ECU_ADDRESS 0x60001095 /end MEASUREMENT
/begin MEASUREMENT tmsvm_bgtmsv_loc "temperature msv coil (calculated) local value BGTMSV" UBYTE temp_ub_q0p75_o48 1 100 -48.0 143.3 FORMAT "%5.1" ECU_ADDRESS 0x60001094 /end MEASUREMENT
/begin MEASUREMENT tmsvm_msg "Calculated coil temperature of mass flow valve" UBYTE temp_ub_q0p75_o48 1 100 -48.0 143.3 FORMAT "%5.1" ECU_ADDRESS 0x60001406 /end MEASUREMENT
/begin MEASUREMENT tmsvsa "fuel mass and ambient temperature influence" UBYTE fak_ub_b4 1 100 0.00 3.984 FORMAT "%5.3" ECU_ADDRESS 0x60001093 /end MEASUREMENT
/begin MEASUREMENT tmsvsaf "filtered fuel mass and ambient temperature influence" UBYTE fak_ub_b4 1 100 0.00 3.984 FORMAT "%5.3" ECU_ADDRESS 0x60001092 /end MEASUREMENT
/begin MEASUREMENT tnse_w_bgtmsv_loc "time counter at end of start (16 bit) local value BGTMSV" UWORD t_q0p1 1 100 0.00 6553.500 FORMAT "%8.3" ECU_ADDRESS 0x60001090 /end MEASUREMENT
/begin MEASUREMENT tochloc "oil temperature in cylinder head" UBYTE temp_ub_q0p75_o48 1 100 -48.0 143.3 FORMAT "%5.1" ECU_ADDRESS 0x60001088 /end MEASUREMENT
/begin MEASUREMENT tochloc_w "oil temperature in cylinder head" UWORD temp_q0p0234_o273 1 100 -273.150 1262.827 FORMAT "%8.3" ECU_ADDRESS 0x60001086 /end MEASUREMENT
/begin MEASUREMENT tochlw_w "oiltemperature in cylinder head ; low-model (word)" UWORD temp_q0p0234_o273 1 100 -273.150 1262.827 FORMAT "%8.3" ECU_ADDRESS 0x60001084 /end MEASUREMENT
/begin MEASUREMENT toch_msg "oil temperature in cylinder head" UBYTE temp_ub_q0p75_o48 1 100 -48.0 143.3 FORMAT "%5.1" ECU_ADDRESS 0x6000EECA /end MEASUREMENT
/begin MEASUREMENT toch_w_msg "oil temperature in cylinder head" UWORD temp_q0p0234_o273 1 100 -273.150 1262.827 FORMAT "%8.3" ECU_ADDRESS 0x6001404A /end MEASUREMENT
/begin MEASUREMENT tumg_bgtmsv_loc "ambient (air) temperature local value BGTMSV" UBYTE temp_ub_q0p75_o48 1 100 -48.0 143.3 FORMAT "%5.1" ECU_ADDRESS 0x6000108E /end MEASUREMENT
/begin MEASUREMENT tvwdkprs_msg "Delay time of DK angle due to prediction" UBYTE t_q0p001 1 100 0.00 0.2550 FORMAT "%6.4" ECU_ADDRESS 0x60001512 /end MEASUREMENT
/begin MEASUREMENT VehMot_stBrkPed "Information brake pedal pressed" UBYTE OneToOne 1 100 0.00 255.0 FORMAT "%5.1" ECU_ADDRESS 0x6000F30D /end MEASUREMENT
/begin MEASUREMENT vfzg_bgtmsv_loc "vehicle speed (kmh) local value BGTMSV" UBYTE vfzg_ub_q1p25 1 100 0.00 318.8 FORMAT "%5.1" ECU_ADDRESS 0x6000108D /end MEASUREMENT
/begin MEASUREMENT vwkw_msg "crankshaft angular speed" UBYTE rel_ub_q0p1875 1 100 0.00 47.81 FORMAT "%5.2" ECU_ADDRESS 0x50000FB4 /end MEASUREMENT
/begin MEASUREMENT wdkbap1_w "predicted throttle angle wdkbl for ti-calculation (Word)" UWORD rel_uw_b100 1 100 0.00 99.99847 FORMAT "%8.5" ECU_ADDRESS 0x6000107E /end MEASUREMENT
/begin MEASUREMENT wdkbapfast "predicted throttle angle wdkbl for ti-calculation (Word)" UWORD rel_uw_b100 1 100 0.00 99.99847 FORMAT "%8.5" ECU_ADDRESS 0x60000A70 /end MEASUREMENT
/begin MEASUREMENT wdkbap_w_msg "predicted throttle angle wdkbl for ti-calculation (Word)" UWORD rel_uw_b100 1 100 0.00 99.99847 FORMAT "%8.5" ECU_ADDRESS 0x50000FAE /end MEASUREMENT
/begin MEASUREMENT wprhom_w "Calculated injection angle for load prediction for homogen mode" UWORD kw_q0p75 1 100 0.00 49151.25 FORMAT "%8.2" ECU_ADDRESS 0x70003118 /end MEASUREMENT
/begin MEASUREMENT wprhom_w_msg "Calculated injection angle for load prediction for homogen mode" UWORD kw_q0p75 1 100 0.00 49151.25 FORMAT "%8.2" ECU_ADDRESS 0x7000374C /end MEASUREMENT
/begin MEASUREMENT wprsch_w_msg "Calculated injection angle for load prediction" UWORD kw_q0p75 1 100 0.00 49151.25 FORMAT "%8.2" ECU_ADDRESS 0x7000374A /end MEASUREMENT
/begin FUNCTION BGTMOLAM "159.0.0   Calculation of efficiency and ignition angle correction - Lambda"
 /begin DEF_CHARACTERISTIC DZWOLA DZWOLA2KA DZWOLA2KAH DZWOLAH ETALAM ETALAM2KA ETALAM2KAH ETALAMH TMECmb_diaFu2LoVlvlft_T TMECmb_diaHspFu2LoVlvlft_T TMECmb_diaHspLoVlvlft_T TMECmb_iaLamDpdVVlvLft_T TMECmb_stVlvlftMpg_I.OperMod2Idx_M /end DEF_CHARACTERISTIC
 /begin IN_MEASUREMENT B_lamkora_msg CoEOM_stEomCylAdv_a f2kazw_msg f2ka_msg Gen_ctCylAdv Ign_flgHspNxtCmb lamrplk_w_msg lamsbg_w_msg /end IN_MEASUREMENT
 /begin OUT_MEASUREMENT dzwol_w_msg etalab_w_msg etalrplk_w_msg /end OUT_MEASUREMENT
 /begin LOC_MEASUREMENT lamdzwol_mp TMECmb_IfEtalam_I.HSPActiv TMECmb_IfEtalam_I.f2ka TMECmb_IfEtalam_I.f2kazw TMECmb_IfEtalam_I.flb TMECmb_IfEtalam_I.vlvlftActv /end LOC_MEASUREMENT
 FUNCTION_VERSION "159.0.0" /end FUNCTION
/begin FUNCTION BGTMOLB "3.6.0     Calculation of efficiency and ingition correction angle - charge motion"
 /begin DEF_CHARACTERISTIC TMECmb_diaChrgMtnIntkOpen_M TMECmb_diaChrgMtn_M TMECmb_facChrgMtnIntkClsd_T TMECmb_facChrgMtnN_T /end DEF_CHARACTERISTIC
 /begin IN_MEASUREMENT Epm_nEng Gen_ctCylAdv GEVCtl_agIntkClsd GEVCtl_agIntkOpen /end IN_MEASUREMENT
 /begin OUT_MEASUREMENT dzwolb_w_msg etalb_w_msg TMECmb_diaAgIntkOpen TMECmb_diaRefChrgMtnAdv_a TMECmb_facChrgMtnAdv_a /end OUT_MEASUREMENT
 FUNCTION_VERSION "3.6.0" /end FUNCTION
/begin FUNCTION BGTMORRI "5.5.0     Computation of efficiency and ignition correction - inert gas"
 /begin DEF_CHARACTERISTIC TMECmb_diaRefInertCylEgr_M TMECmb_facAgIntkClsd_T TMECmb_facRefInertCylEgr_M TMECmb_ratInertCylRef_M /end DEF_CHARACTERISTIC
 /begin IN_MEASUREMENT AirMod_ratChrgAirCylAdv_a AirMod_ratInertCylAdv_a AirMod_ratInertEgrExtCyl AirMod_ratInertEgrIntCyl Epm_nEng Gen_ctCylAdv GEVCtl_agIntkClsd /end IN_MEASUREMENT
 /begin OUT_MEASUREMENT dzworriref_w_msg dzworri_w_msg etarri_w_msg rriref_w_msg TMECmb_diaRefInertCylAdv_a TMECmb_diaRefInertCylRefAdv_a TMECmb_facInertCylAdv_a /end OUT_MEASUREMENT
 FUNCTION_VERSION "5.5.0" /end FUNCTION
/begin FUNCTION BGTMPK "12.9.1    Calculation of temperature compensation for intake manifold model"
 /begin DEF_CHARACTERISTIC CWBGTMPK DTEVS FTIETHMNMX FTVDKTAVDK KFDTAHEVATI KFDTAHEVET KFDTAHEVPN KFDTR KFDTZ KFFWLKFTAHEV KFFWLKPN KFWTBR KLFEXPSL KLTFWLK NWKEV TDTEVATI TEVSMX TMOTKWRMK ZBRT /end DEF_CHARACTERISTIC
 /begin IN_MEASUREMENT anztib_w_msg B_tasrg_msg CEngDsT_flgSnsrVld CEngDsT_tStrt Epm_nEng ExhMod_tEng FfPrm_facEth IntkAirT_tIntkMnfld IntkAirT_tThrVlvUs psr_w_msg SyC_stSub tadk_w_msg tavdkmn_w_msg tavdkmx_w_msg toch_msg twvev_w_msg /end IN_MEASUREMENT
 /begin OUT_MEASUREMENT B_tahevg_msg ftahevmx_w_msg ftahev_w_msg ftavdkmn_w_msg ftavdkmx_w_msg ftsr_w_msg ftu_msg ftvdk_w_msg quotntke_w_msg taev_w_msg tahev_w_msg tev_w_msg /end OUT_MEASUREMENT
 /begin LOC_MEASUREMENT AirMod_facWrmUpCorrn BGTMPK_U_TEMP_FTEMP_FAST_I.tahevX_w dtahevdyraw_w dtahevdy_w dtahevet_w ftw_w fwlkbgtmpk fwtevta_w tahevkor_w tmotdifk_w /end LOC_MEASUREMENT
 FUNCTION_VERSION "12.9.1" /end FUNCTION
/begin FUNCTION BGTMSV "51.3.0    MSV temperature"
 /begin DEF_CHARACTERISTIC CWTMSV CWTMSVST KFEIGMSV KFTMKMSV KFTMSVM KLTMSVHS KLTMSVST KLTMTAMSV TEIG TMSVABMX TMSVAPL TMSVQUALI TMSVTMTMX TTMSVSA TTSTST TVBGTMSVG /end DEF_CHARACTERISTIC
 /begin IN_MEASUREMENT B_msvact_msg B_tfuelg_msg CEngDsT_t CEngDsT_tStop EngStrt_bFrstStrtEnd EngStrt_bStrtEnd EnvT_t Epm_nEngLRes FlSys_tFlHPSys FlSys_tFlLPSys SyC_stSub tans_msg tengsq1_w_msg tflmass_w_msg TiEngOff_stTi tnse_w_msg VehV_v /end IN_MEASUREMENT
 /begin OUT_MEASUREMENT B_tmsvmg_msg tmsvm_msg /end OUT_MEASUREMENT
 /begin LOC_MEASUREMENT B_msvact_bgtmsv_loc B_stendz_bgtmsv_loc B_stend_bgtmsv_loc B_tfuelg_bgtmsv_loc B_tmsvmg_bgtmsv_loc difftmtans difftmtfl nmot_bgtmsv_loc tans_bgtmsv_loc tengslst_bgtmsv_loc tengsq1_w_bgtmsv_loc tflmass_w_bgtmsv_loc tfuelhpsq_bgtmsv_loc tfuelsq_bgtmsv_loc tfuelsrc_bgtmsv_loc tmotab_bgtmsv_loc tmot_bgtmsv_loc tmsvab tmsvbas tmsvbasf tmsveig tmsveigf tmsvmab tmsvmst tmsvm_bgtmsv_loc tmsvsa tmsvsaf tnse_w_bgtmsv_loc tumg_bgtmsv_loc vfzg_bgtmsv_loc /end LOC_MEASUREMENT
 FUNCTION_VERSION "51.3.0" /end FUNCTION
/begin FUNCTION BGTOCH "10.0.0    oil temperature in cylinder head" /begin DEF_CHARACTERISTIC FTOCHLWIN KFTOCHLW TTOCHLWTD TTOCHLWTP /end DEF_CHARACTERISTIC /begin IN_MEASUREMENT CEngDsT_t Epm_nEng Epm_stSpd ml_msg OilSwmpT_t SyC_stSub /end IN_MEASUREMENT /begin OUT_MEASUREMENT B_tochg_msg toch_msg toch_w_msg /end OUT_MEASUREMENT
 /begin LOC_MEASUREMENT B_tochgloc B_tochlow ftochlw ftochwu mltoch nmottoch OilCylHdT_flgTCEngDsTVld tochloc tochloc_w tochlw_w /end LOC_MEASUREMENT
 FUNCTION_VERSION "10.0.0" /end FUNCTION
/begin FUNCTION BGTPAGR "3.5.0     Calculation of temperature and pressure of EGR valve"
 /begin DEF_CHARACTERISTIC CWBGTPAGR KFMSAGFQEV KFWANAGRV KFWANLEOT KLTTRECLAM LAAEOAGRMX LAAGREOAP MSAGRZKES MSAGRZKV PAAGREOAP TAGREOAP TDTAGRSR /end DEF_CHARACTERISTIC
 /begin REF_CHARACTERISTIC TGAGRVMAX /end REF_CHARACTERISTIC
 /begin IN_MEASUREMENT B_cdagr_msg B_tavdkgg_msg ExhMod_pExhCat2UsB1 ExhMod_tExhCat1DsB1 IntkAirT_tThrVlvUs laonvkm_w_msg msagr_w_msg SyC_stSub VehV_v /end IN_MEASUREMENT
 /begin OUT_MEASUREMENT B_agrblamx_msg B_tagrsrg_msg laaeoagr_w_msg msagrvmx_w_msg paagreo_w_msg pagreo_w_msg reclagre_w_msg tagreo_w_msg tagrsr_w_msg tagrvsr_w_msg tgagrv_msg tgagrv_w_msg tgnagrv_w_msg tgvagrv_w_msg /end OUT_MEASUREMENT
 /begin LOC_MEASUREMENT AirMod_mfEgrAct AirMod_tAirEngCmptmt_mp AirMod_tAirPipExhMnfldDs_mp fagrevx_w /end LOC_MEASUREMENT
 FUNCTION_VERSION "3.5.0" /end FUNCTION
/begin FUNCTION BGWDKM "5.4.0     Calculation of throttle angle model" /begin DEF_CHARACTERISTIC CWBGWDKM ZWDKM1 ZWDKM2 ZWDKM3 ZWDKM4 /end DEF_CHARACTERISTIC /begin IN_MEASUREMENT B_wdksg_msg SyC_stSub ThrVlv_ratActPosnB1 wdksp_w_msg /end IN_MEASUREMENT /begin OUT_MEASUREMENT wdkbap_w_msg /end OUT_MEASUREMENT /begin LOC_MEASUREMENT wdkbap1_w wdkbapfast /end LOC_MEASUREMENT FUNCTION_VERSION "5.4.0" /end FUNCTION
/begin FUNCTION BGWPR "31.1.0    Calculated Value prediction angle"
 /begin DEF_CHARACTERISTIC AirMod_agChartcDeltaPrdnHomMod_T AirMod_nrSyncAirChrgPredOff_C CWBGRLP CWWPR FTVWDKMX FWDKUGDSP NMOTRLPU TNSURLP TVDKPRMX WPRHOMMX /end DEF_CHARACTERISTIC
 /begin REF_CHARACTERISTIC VPSRVDUGD /end REF_CHARACTERISTIC
 /begin IN_MEASUREMENT B_ll_msg B_msdpg_msg B_nswo2_msg B_vhefeps_msg CEngDsT_t ChrCtl_flgChrgCalcnTiBasd EngStrt_bStrt EngStrt_bStrtEnd Epm_ctCyl Epm_nEng Epm_stSpd GEVCtl_agIntkClsd GEVCtl_agSpIntkClsd InjSys_ofsCylCntrHom SyC_stSub tnst_w_msg vpsrvd_w_msg wdkbap_w_msg wdkugd_w_msg wrlbhom_w_msg /end IN_MEASUREMENT
 /begin OUT_MEASUREMENT AirMod_idxCylAirChrgPred AirMod_idxSynAirChrgPredMax AirMod_nrSynAirChrgPred AirMod_nrSynAirChrgPredHom AirMod_nrSynAirChrgPredMax B_nsp_msg B_rlpdms_msg B_rlpdp_msg B_rlp_msg B_ugdsp_msg fwprs_w_msg tvwdkprs_msg vwkw_msg wprhom_w_msg wprsch_w_msg /end OUT_MEASUREMENT
 /begin LOC_MEASUREMENT B_rlpvheus fwprs_w wprhom_w /end LOC_MEASUREMENT
 FUNCTION_VERSION "31.1.0" /end FUNCTION
/begin FUNCTION Blwr_DD "7.0.0     HW-depending device driver for cabine blower" /begin DEF_CHARACTERISTIC Blwr_uComBlwrURepl_C /end DEF_CHARACTERISTIC /begin IN_MEASUREMENT Com_uFrntBlowrU Com_uRrBlowrU T15_st /end IN_MEASUREMENT /begin OUT_MEASUREMENT Blwr_uVoltReq /end OUT_MEASUREMENT FUNCTION_VERSION "7.0.0" /end FUNCTION
/begin FUNCTION BrkBstP_DD "26.0.0    Pressure sensor for brakebooster device driver"
 /begin DEF_CHARACTERISTIC BrkBstP_flgSwtActv_C BrkBstP_pTransf_CUR BrkBstP_uSensSRCMax_C BrkBstP_uSensSRCMin_C /end DEF_CHARACTERISTIC
 /begin OUT_MEASUREMENT BrkBstP_pSens BrkBstP_uRaw /end OUT_MEASUREMENT
 FUNCTION_VERSION "26.0.0" /end FUNCTION
/begin FUNCTION BrkBstP_VD "29.0.0    Pressure sensor for brakebooster virtual device"
 /begin DEF_CHARACTERISTIC BrkBstP_aDecelBrkThdMax_C BrkBstP_aDecelBrkThdMin_C BrkBstP_cntMstCylPVal_C BrkBstP_ctDriftHi_C BrkBstP_ctDriftLo_C BrkBstP_ctVehStopThd_C BrkBstP_dpMstCyl_C BrkBstP_nVacPmp_C BrkBstP_pBrkBoostDiffThd_C BrkBstP_pBrkNotPsd_C BrkBstP_pCmpFldThd_C BrkBstP_pDifQntyHi_C BrkBstP_pDifQntyLo_C BrkBstP_pDifQntyLrgJdg_C BrkBstP_pDifQntyMid_C BrkBstP_pDifQntySmallJdg_C BrkBstP_pDriftHiThd_C BrkBstP_pDriftLoThd_C BrkBstP_pFldPOffsMaxVal_C BrkBstP_pFldPOffsMinVal_C BrkBstP_pMstCylMax_C BrkBstP_pMstCylMin_C BrkBstP_pMstCylPIniVal_C BrkBstP_pMstCylSatMax_C BrkBstP_pMstCYlSatMin_C BrkBstP_pOutpEnaMask_C BrkBstP_pRawFldPStabyVal_C BrkBstP_pVacPOffsVal_C BrkBstP_rAccPedThd_C BrkBstP_stFldPOffsMeasCdnMsk_C BrkBstP_stStopRelsMaskSeln_C BrkBstP_stStopRelsMask_C BrkBstP_swtHSAEna_C BrkBstP_tiABSVSADi_C BrkBstP_tiAYCEna_C BrkBstP_tiDecelBrkDetn_C BrkBstP_tiDriftErrRelsThd_C BrkBstP_tiDriftHiMax_C BrkBstP_tiDriftHiMin_C BrkBstP_tiDriftLoMax_C BrkBstP_tiDriftLoMin_C BrkBstP_tiDriftTmrFrz_C BrkBstP_tiMstCylPStabyThd_C BrkBstP_tiMstCylPT1_C BrkBstP_tiVacBoostPT1_C BrkBstP_tiVehAPT1_C BrkBstP_tiVehStopDly_C BrkBstP_tiVehVPT1_C BrkBstP_vRunngThd_C BrkBstP_vStopThd_C BrkBstP_vVehSpdThd_C /end DEF_CHARACTERISTIC
 /begin IN_MEASUREMENT APP_r BrkBstP_pSens CoEng_st CoEng_tiNormal Com_bAYCCond Com_pMstCyl Com_stACCBrk Com_stActABSEBD Com_stActHSA Com_stFailMstCylPSnsr Com_stInhbMstCylPSnsr CoTS_stSSEStopInhb CoVMD_stLoLimActv CoVOM_stStopRls CrCtl_stActive Eep_EnvRamInvld Epm_nEng GlbDa_vX I14229_stABSFailCnclActv I14229_stSuppRst SysDiag_flgCModJdg T15_st VehMot_stBrkPed VehV_aRawUnFlt VehV_vUnFlt VMD_rASLCC /end IN_MEASUREMENT
 /begin OUT_MEASUREMENT BrkBstP_aXFil BrkBstP_bDecelByBrk BrkBstP_bStopByBrk BrkBstP_bVehRunng BrkBstP_bVehStop BrkBstP_ctVehStop BrkBstP_pAftFil BrkBstP_pBrkBoostMax BrkBstP_pBrkBoostMin BrkBstP_pCmpFldP BrkBstP_pCorrnPVal BrkBstP_pMstCylAftFil BrkBstP_pMstCylAftOffsCalcn BrkBstP_stAYCBrkOilEna BrkBstP_stBrkPsdDriftErr BrkBstP_stZrPntCalcnJdg BrkBstP_vXFil /end OUT_MEASUREMENT
 /begin LOC_MEASUREMENT BrkBstP_bDriftTmrFrz BrkBstP_cntMstCylPValCnt BrkBstP_ctDriftErr BrkBstP_ctDriftHiErr BrkBstP_ctDriftLoErr BrkBstP_dpAbsMstCyl BrkBstP_flgDSMClr BrkBstP_flgMstCylPStabyChk BrkBstP_pBrkBoostDiff BrkBstP_pChgMaxVal BrkBstP_pCorrnPValInt BrkBstP_pDifAbsltVal BrkBstP_pIntegdMstcylPVal BrkBstP_pLimVal BrkBstP_pLimValLo BrkBstP_pLrngCorrnPValDif BrkBstP_pMstCylAftFilOld BrkBstP_pMstCylOffsVal BrkBstP_pMstCylOld BrkBstP_pMstCylPAvgVal BrkBstP_pMstCylReslCnv BrkBstP_pRawFldPDifVal BrkBstP_pRawFldPMaxVal BrkBstP_pRawFldPMinVal BrkBstP_stDrift BrkBstP_stFldPMeasCdn BrkBstP_stFldPOffsMeasCalcn BrkBstP_stFldPOffsMeasCdn BrkBstP_stFldPStaby BrkBstP_stIniValCdn BrkBstP_stMstCylOffsVal BrkBstP_stVehStopCfmd BrkBstP_tiDecelByBrk BrkBstP_tiDriftErrRels BrkBstP_tiMstCylPStaby /end LOC_MEASUREMENT
 FUNCTION_VERSION "29.0.0" /end FUNCTION
/begin FUNCTION BrkBst_ModPres "3.3.0     Calculation of modeled pressure of brake booster"
 /begin DEF_CHARACTERISTIC BrkBst_dpBrkPsdThd_C BrkBst_dpBrkReldThd_C BrkBst_facBkupMdl_C BrkBst_facBrkPrsESPLL_CUR BrkBst_facBrkRlsESPLL_CUR BrkBst_facBrkStHld_CUR BrkBst_facBrkStPsd_CUR BrkBst_facBrkStReld_CUR BrkBst_facPMnfldRedn_C BrkBst_facPresLeak_C BrkBst_MdlCfg_CW BrkBst_tiBkupMdlVacCns_C BrkBst_tiBrkPFlt_C BrkBst_tiPerdBkupMdl_C BrkBst_tiPMdl_C BrkBst_vBrkSt_C /end DEF_CHARACTERISTIC
 /begin IN_MEASUREMENT BrkP_p Brk_st PEnv_p PIntkVUs_p VehV_v /end IN_MEASUREMENT
 /begin OUT_MEASUREMENT BrkBst_pMdl /end OUT_MEASUREMENT
 /begin LOC_MEASUREMENT BrkBst_dpBrkP_MP BrkBst_facBrkBkup_MP BrkBst_facBrkPPsd_MP BrkBst_facBrkPReld_MP BrkBst_facBrkSt_MP BrkBst_pBrkPDlyd_MP BrkBst_pMdlInc_MP BrkBst_pMdlRedn_MP BrkBst_pMnfldRedn_MP /end LOC_MEASUREMENT
 FUNCTION_VERSION "3.3.0" /end FUNCTION
/begin FUNCTION BrkPed_SetData "128.1.0   Brake Pedal Information"
 /begin DEF_CHARACTERISTIC BrkPed_aEBBSlopHi_C BrkPed_aGrdtFildDifThd_C BrkPed_aGrdtHiLimForISAB_C BrkPed_aGrdtLoLimForISAB_C BrkPed_aSlopNeg_C BrkPed_aSlopPos_C BrkPed_cntrISABRlsThd_T BrkPed_cntStepISABRls_T BrkPed_flgSwtISABAvl_C BrkPed_flgSwtVehStandStillJdg_C BrkPed_nEngISABThd_C BrkPed_pEngStopDisbl_M BrkPed_pEngStopEna_M BrkPed_pEnvPMax_C BrkPed_swtBrkBstPSeln_C BrkPed_swtBrkStrtEna_C BrkPed_swtEVPECUEna_C BrkPed_tiEBBSlopDetn_C BrkPed_tiEBBSlopRst_C BrkPed_tiSnsrFailHeal_C BrkPed_tiVehStandStillJdgThd1_C BrkPed_tiVehStandStillJdgThd2_C BrkPed_tiVehStandStill_C BrkPed_tiVSAGrdtPT1_C BrkPed_tiWinPerdGrdtChk_C BrkPed_tqBrkOffsThdForIS_C BrkPed_tqBrkThdforIS_T BrkPed_vEBBSpdHi_C BrkPed_vEBBSpdLo_C /end DEF_CHARACTERISTIC
 /begin IN_MEASUREMENT BrkBstP_pAftFil BrkP_p Brk_st Brk_stEBBBrkDetn Com_aLgtG Com_pEVPMnfldP Com_stACCBrk Com_stBrkHldSys Com_stCalCmplLgtG Com_stCVTEngmtInfo Com_stEBB Com_stEVPIdleStopFail Com_stEVPIdleStopReq Com_stFailrLgtG Com_stIMGISInhbBrk Com_stIMGISSysOffBrk Com_stIngearEngmt Com_stISEBBFail Com_stLgtGASensErr Com_stLgtGASensInh Com_stRxAYCGOk Com_stRxSRSAOk Com_stShftInNeutr Com_stStrtupProc Com_stTempAbnormLgtG Com_tqBrkOper CoVOM_stSSE EnvP_p Epm_nEng Gbx_stGearLvr GlbDa_vAvrgWhlSpd GlbDa_vX PT_stTraType StrtCtl_flgEngStall StrtCtl_vEBBVehSpd T15_st VMD_rVirtAPP /end IN_MEASUREMENT
 /begin OUT_MEASUREMENT BrkPed_aGrdtFild BrkPed_aSlopEBB BrkPed_bEngStopEna BrkPed_bEngStrtReq BrkPed_flgEBBEngSysOff BrkPed_flgEBBHiSlop BrkPed_flgISABBrkPSuffVehStill BrkPed_flgISABDi BrkPed_flgISABReq BrkPed_flgLgtGComErr BrkPed_flgSlopeExcd BrkPed_flgSwtISABAvl BrkPed_flgVehStandStill BrkPed_pRel BrkPed_tqIMGISABIdleStop VehMot_stBrkPed /end OUT_MEASUREMENT
 /begin LOC_MEASUREMENT BrkPed_aDif BrkPed_aGrdt BrkPed_aGrdtFildDif BrkPed_aGrdtFildHist_a BrkPed_aGrdtFildMax BrkPed_aGrdtFildMin BrkPed_aLgtG BrkPed_aLgtGCnvn BrkPed_cntrISABRls BrkPed_flgBrkBoostEngStopEna BrkPed_flgBrkBoostEngStrtReq BrkPed_flgBrkBoostEngSysOff BrkPed_flgEBBFailrOcc_MP BrkPed_flgEBBVehStandStill BrkPed_flgIMGEngStopEna BrkPed_flgIMGEngStrtReq BrkPed_flgIMGEngSysOff BrkPed_flgNonServoFailr_MP BrkPed_flgVSAFailr_MP BrkPed_nrGrdtArySize BrkPed_pEnvP_MP BrkPed_pEVPMnFldP_MP BrkPed_stVehStandStill BrkPed_tiEBBSlopInRng BrkPed_tiElpdSnceVehSpdZr /end LOC_MEASUREMENT
 FUNCTION_VERSION "128.1.0" /end FUNCTION
/begin FUNCTION BrkP_VD "3.8.0     Virtual Device Driver for Pressure in the Main Brake Cylinder" /begin DEF_CHARACTERISTIC BrkP_pDfl_C BrkP_swtSig_C /end DEF_CHARACTERISTIC /begin OUT_MEASUREMENT BrkP_dpMstCyl BrkP_p BrkP_pSnsr /end OUT_MEASUREMENT /begin LOC_MEASUREMENT BrkP_pMstCylold /end LOC_MEASUREMENT FUNCTION_VERSION "3.8.0" /end FUNCTION
/begin FUNCTION Brk_DD "56.0.0    Brake Device Driver"
 /begin DEF_CHARACTERISTIC Brk_MnDeb.tiHiLo_C Brk_MnDeb.tiLoHi_C Brk_RedDeb.tiHiLo_C Brk_RedDeb.tiLoHi_C Brk_swtSig_C /end DEF_CHARACTERISTIC
 /begin IN_MEASUREMENT Brk_stMn Brk_stRed Com_stBrk /end IN_MEASUREMENT
 /begin OUT_MEASUREMENT Brk_stMnRaw Brk_stRedRaw /end OUT_MEASUREMENT
 FUNCTION_VERSION "56.0.0" /end FUNCTION
/begin FUNCTION Brk_VD "64.0.0    Brake Position Sensor Virtual Device"
 /begin DEF_CHARACTERISTIC Brk_ctBrkHealThd_C Brk_ctBrkSwtNotStpThd_C Brk_ctPlaMax_C Brk_ctSwtContOnThd_C Brk_flgSwtCntrDi_C Brk_flgSwtExch_C Brk_nPlaMin_C Brk_stDflVal_C Brk_stEnaHydPCtrlOper_C Brk_swtMnRed1_C Brk_swtMnRed2_C Brk_swtRedSensPrs_C Brk_tiBrkSwtContStpErrClr_C Brk_tiBrkSwtNormDet_C Brk_tiPlaMax_C Brk_tiRdntBrkOnDly_C Brk_vLwrThdBrkSwtNotStp_C Brk_vPlaMin_C Brk_vSpdThdBrkSwtStp_C Brk_vUpprThdBrkSwtNotStp_C /end DEF_CHARACTERISTIC
 /begin REF_CHARACTERISTIC Clth_stStkActvn_C /end REF_CHARACTERISTIC
 /begin IN_MEASUREMENT Brk_stMnRaw Brk_stRedRaw CoEng_st Com_stACCBrk Com_stBrk Com_stHydPCtrlOper Com_stIMGACCBrkReq Epm_nEng SyC_ctPostDrvLeave T15_st VehV_v VMD_rVirtAPP /end IN_MEASUREMENT
 /begin OUT_MEASUREMENT Brk_ctMnBrkSwtNotStp Brk_ctMnSwtContOn Brk_ctRdntBrkSwtNotStp Brk_ctRdntSwtContOn Brk_st Brk_stAry Brk_stBrkChgPrio Brk_stBrkVSA Brk_stMn Brk_stRed /end OUT_MEASUREMENT
 /begin LOC_MEASUREMENT Brk_cntrReIni Brk_ctMnSwtContOnHealCond Brk_ctMnSwtNotStpHealCond Brk_ctPla_mp Brk_ctRdntSwtContOnHealCond Brk_ctRdntSwtNotStpHealCond Brk_flgMaiContsOnFltCntrDi Brk_flgMaiNonStepFltCntrDi Brk_flgMnSwtContOnHealCnt Brk_flgMnSwtNotStpHealCnt Brk_flgRdntBrkOn_mp Brk_flgRdntContsOnFltCntrDi Brk_flgRdntNonStepFltCntrDi Brk_flgRdntSwtContOnHealCnt Brk_flgRdntSwtNotStpHealCnt Brk_stMnBrkSwtContStp_mp Brk_stMnBrkSwtNotStp_mp Brk_stMnSwtContStpErrLstDC Brk_stMnSwtNotStpErrLstDC Brk_stRdntBrkSwtContStp_mp Brk_stRdntBrkSwtNotStp_mp Brk_stRdntSwtContStpErrLstDC Brk_stRdntSwtNotStpErrLstDC Brk_stRstBrkNotStp /end LOC_MEASUREMENT
 FUNCTION_VERSION "64.0.0" /end FUNCTION
/begin FUNCTION BswM "4.14.1    Basis Software Mode Manager" FUNCTION_VERSION "4.14.1" /end FUNCTION
/begin FUNCTION BusDiag_BusOff "69.0.0_6SAAmonitoring CAN hardware"
 /begin OUT_MEASUREMENT BusDiag_flgAPPLBUSOFF BusDiag_flgCANCBUSOFF BusDiag_flgVEHICLEBUSOFF /end OUT_MEASUREMENT
 FUNCTION_VERSION "69.0.0_6SAA" /end FUNCTION
/begin FUNCTION CBUtil "170.0.0   Customer Block Utilities" /begin OUT_MEASUREMENT CBUtil_stReProgEvnt /end OUT_MEASUREMENT FUNCTION_VERSION "170.0.0" /end FUNCTION
/begin FUNCTION CDrv_Shared "1000.4.0  Complex Driver Shared Definitions Gasoline" /begin IN_MEASUREMENT EpmSyn_phiOffs Epm_numCyl /end IN_MEASUREMENT /begin LOC_MEASUREMENT CDRV_DELTA_TDC_CYL CDRV_TDC_CYL /end LOC_MEASUREMENT FUNCTION_VERSION "1000.4.0" /end FUNCTION
/begin FUNCTION CDShdG_GTMLib "2.12.0_1.8.1_1.0.0Complex Driver Shared GTM Service Library" /begin LOC_MEASUREMENT CdSHdG_GTMLib_PMTCtr /end LOC_MEASUREMENT FUNCTION_VERSION "2.12.0_1.8.1_1.0.0" /end FUNCTION
/begin FUNCTION CEL_Compu "1.278.0   Arithemetic computation methods and physical units in MSR language" FUNCTION_VERSION "1.278.0" /end FUNCTION
/begin FUNCTION CEL_CompuLcy "1.1.0     Computation methods and SW Units with old DGS naming convention" FUNCTION_VERSION "1.1.0" /end FUNCTION
/begin FUNCTION CEL_Const "1.20.0    DGS central System Constants of the category FIXED" /begin DEF_CHARACTERISTIC medc_datasetid /end DEF_CHARACTERISTIC FUNCTION_VERSION "1.20.0" /end FUNCTION
/begin FUNCTION CEngDsT_AdprInp "1.8.1     Input Adapter for Coolant Engine Downstream Temperature"
 /begin IN_MEASUREMENT B_sa_msg CoEOM_bHLN CoEOM_flgStrat EngStrt_bFrstStrtEnd EngStrt_bStrtEnd Epm_stSpd ExhMod_mAirMfIntegEngStrt lamsbg_w_msg ml_msg /end IN_MEASUREMENT
 /begin OUT_MEASUREMENT CEngDsT_facLamDesLim CEngDsT_flgEngN CEngDsT_flgHml CEngDsT_flgOvrRun CEngDsT_flgStrat CEngDsT_flgStrtEnd CEngDsT_flgStrtEndFrst CEngDsT_mAirIntgl CEngDsT_mfAir /end OUT_MEASUREMENT
 FUNCTION_VERSION "1.8.1" /end FUNCTION
/begin FUNCTION CEngDsT_DD "21.19.0   Coolant temperature (at engine outlet) - device driver"
 /begin DEF_CHARACTERISTIC CEngDsT_flgSnsrFrzEna_C CEngDsT_swtSnsrCfg_C CEngDsT_swtSnsrSigAvl_C CEngDsT_tiDebImpsErrTmp_C CEngDsT_tiDebImpsErr_C CEngDsT_tiDebSigErr_C CEngDsT_tiDebSigHeal_C CEngDsT_tiDebSnsrElecVld_C CEngDsT_tiDebSRCErr_C CEngDsT_tiDebSRCHeal_C CEngDsT_tiSnsrURawFildImps_C CEngDsT_tiSnsrURawFild_C CEngDsT_tTrfSnsr_CUR CEngDsT_uAbsltDifRawFltdMin_C CEngDsT_uRawDfl_C CEngDsT_uRawMaxSRC_C CEngDsT_uRawMinSRC_C /end DEF_CHARACTERISTIC
 /begin IN_MEASUREMENT CEngDsT_flgSnsrElecClr SyC_stSub /end IN_MEASUREMENT
 /begin OUT_MEASUREMENT CEngDsT_flgImpsDi CEngDsT_flgImpsErr CEngDsT_flgImpsHeal CEngDsT_flgPhevChrgnMod CEngDsT_flgSigErr CEngDsT_flgSigHeal CEngDsT_flgSnsrElecVld CEngDsT_flgSnsrSigAvl CEngDsT_flgSRCMaxErr CEngDsT_flgSRCMaxHeal CEngDsT_flgSRCMinErr CEngDsT_flgSRCMinHeal CEngDsT_tPID05Tstr CEngDsT_tSnsr CEngDsT_tSnsrFild CEngDsT_tSnsrTstr CEngDsT_uRaw CEngDsT_uRawFild /end OUT_MEASUREMENT
 /begin LOC_MEASUREMENT CEngDsT_flgImpsErrTmp CEngDsT_flgImpsErrTmpDeb CEngDsT_flgImpsFF CEngDsT_flgImpsStr CEngDsT_flgSigErrTmp CEngDsT_flgSnsrElecVldDebInit CEngDsT_flgSnsrElecVldTmp CEngDsT_flgSnsrLCEna CEngDsT_flgSnsrSigAvlER CEngDsT_flgSRCDebInit CEngDsT_flgSRCErr CEngDsT_flgSRCErrTmp CEngDsT_flgSRCHealTmp CEngDsT_flgSRCMaxErrTmp CEngDsT_flgSRCMinErrTmp CEngDsT_uAbsltDifRawFltd CEngDsT_uRawFildImps /end LOC_MEASUREMENT
 FUNCTION_VERSION "21.19.0" /end FUNCTION
/begin FUNCTION CEngDsT_VD "21.9.0    Engine coolant temperature Down Stream Virtual Driver"
 /begin DEF_CHARACTERISTIC CEngDsT_flgSwtEnaFil_C CEngDsT_tiFil_C CEngDsT_tStopInin_C CEngDsT_tStrtThd_C /end DEF_CHARACTERISTIC
 /begin IN_MEASUREMENT CEngDsT_flgPhevChrgnMod CEngDsT_flgSnsrVld CEngDsT_tReplMdl CEngDsT_tSnsrFild Eep_EnvRamHist Eep_EnvRamInvld SyC_stSub TiEngOff_bEngRot TiEngOff_bRst /end IN_MEASUREMENT
 /begin OUT_MEASUREMENT CEngDsT_flgSnsrVldStop CEngDsT_flgSnsrVldStopFrst CEngDsT_flgSnsrVldStrt CEngDsT_flgSnsrVldStrtFrst CEngDsT_flgSwtReplMdl CEngDsT_t CEngDsT_tInpFil CEngDsT_tSnsrStrt CEngDsT_tSnsrStrtFrst CEngDsT_tStop CEngDsT_tStopFrst CEngDsT_tStrt CEngDsT_tStrtFrst CEngDsT_t_Sq /end OUT_MEASUREMENT
 /begin LOC_MEASUREMENT CEngDsT_flgCalcnEngStopVld CEngDsT_flgPhevChrgnModEdgeFall CEngDsT_flgStopFrst CEngDsT_flgSwtReplMdlStrt CEngDsT_flgSwtReplMdlStrtEdgeFall CEngDsT_tExtRepl CEngDsT_tSnsrFildFrzn /end LOC_MEASUREMENT
 FUNCTION_VERSION "21.9.0" /end FUNCTION
/begin COMPU_METHOD Acc "" RAT_FUNC "%6.5" "m/s^2" COEFFS 0 1000 0 0 0 1 /end COMPU_METHOD
/begin COMPU_METHOD AngleCrS "" RAT_FUNC "%6.4" "deg CrS" COEFFS 0 45.5111111111 0 0 0 1 /end COMPU_METHOD
/begin COMPU_METHOD B_TRUE "" TAB_VERB "%6.3" "" COMPU_TAB_REF B_TRUE /end COMPU_METHOD
/begin COMPU_VTAB B_TRUE "" TAB_VERB 2 0 "FALSE" 1 "TRUE" /end COMPU_VTAB
/begin COMPU_METHOD CoEOM_idxOperModCfgd_VERB "" TAB_VERB "%6.3" "-" COMPU_TAB_REF CoEOM_idxOperModCfgd_VERB /end COMPU_METHOD
/begin COMPU_VTAB CoEOM_idxOperModCfgd_VERB "" TAB_VERB 4 0 "Base" 1 "WarmUp" 2 "CatHtg" 3 "Start" /end COMPU_VTAB
/begin COMPU_METHOD CoEOM_idxOperModStgTot_VERB "" TAB_VERB "%6.3" "-" COMPU_TAB_REF CoEOM_idxOperModStgTot_VERB /end COMPU_METHOD
/begin COMPU_VTAB CoEOM_idxOperModStgTot_VERB "" TAB_VERB 16 0 "HOM-SNGL_FullLft" 1 "HOM_FullLft" 2 "HSP_FullLft" 3 "HSPIC_FullLft" 4 "HOM-SNGL_EIVC" 5 "HOM_EIVC" 6 "HSP_EIVC" 7 "HSPIC_EIVC" 8 "Stage 8" 9 "Stage 9" 10 "Stage 10" 11 "Stage 11" 12 "Stage 12" 13 "Stage 13" 14 "Stage 14" 15 "Stage 15" /end COMPU_VTAB
/begin COMPU_METHOD CRKCSPABSLT_TYPAVL_SY_Compu "" TAB_VERB "%6.3" "" COMPU_TAB_REF CRKCSPABSLT_TYPAVL_SY_Compu /end COMPU_METHOD
/begin COMPU_VTAB CRKCSPABSLT_TYPAVL_SY_Compu "" TAB_VERB 2 0 "False" 1 "True" /end COMPU_VTAB
/begin COMPU_METHOD CRKCSVENTDIAG_SC_Compu "" TAB_VERB "%6.3" "" COMPU_TAB_REF CRKCSVENTDIAG_SC_Compu /end COMPU_METHOD
/begin COMPU_VTAB CRKCSVENTDIAG_SC_Compu "" TAB_VERB 2 0 "NONE" 1 "VALVE_DELTA_PRESSURE" /end COMPU_VTAB
/begin COMPU_METHOD CRKCSVENTNVLV_SC_Compu "" TAB_VERB "%6.3" "" COMPU_TAB_REF CRKCSVENTNVLV_SC_Compu /end COMPU_METHOD
/begin COMPU_VTAB CRKCSVENTNVLV_SC_Compu "" TAB_VERB 2 0 "False" 1 "True" /end COMPU_VTAB
/begin COMPU_METHOD CRKCSVLVTYP_SC_Compu "" TAB_VERB "%6.3" "" COMPU_TAB_REF CRKCSVLVTYP_SC_Compu /end COMPU_METHOD
/begin COMPU_VTAB CRKCSVLVTYP_SC_Compu "" TAB_VERB 4 0 "standard" 1 "switch_on/off_electronically_controlled" 2 "two_stage_switch_electronically_controlled" 3 "two_stage_switch_mechanically_controlled" /end COMPU_VTAB
/begin COMPU_METHOD CRSSENSTYP_SY_Compu "" TAB_VERB "%6.3" "" COMPU_TAB_REF CRSSENSTYP_SY_Compu /end COMPU_METHOD
/begin COMPU_VTAB CRSSENSTYP_SY_Compu "" TAB_VERB 3 0 "STD" 1 "DGI" 2 "DG_DGI" /end COMPU_VTAB
/begin COMPU_METHOD CRSTYP_SY_Compu "" TAB_VERB "%6.3" "" COMPU_TAB_REF CRSTYP_SY_Compu /end COMPU_METHOD
/begin COMPU_VTAB CRSTYP_SY_Compu "" TAB_VERB 5 0 "SYMMETRIC_GAP" 1 "SHORT_GAP" 2 "CODED_GAP" 3 "ASYMMETRIC_GAP" 4 "INTRPT_GAP" /end COMPU_VTAB
/begin COMPU_METHOD CRS_BACKUP_CASTYP_SY_Compu "" TAB_VERB "%6.3" "" COMPU_TAB_REF CRS_BACKUP_CASTYP_SY_Compu /end COMPU_METHOD
/begin COMPU_VTAB CRS_BACKUP_CASTYP_SY_Compu "" TAB_VERB 7 0 "ZN_PLUS_1_WHEEL" 1 "DS_STD_WHEEL" 2 "GS_STD_WHEEL" 3 "HALFMOON_WHEEL" 7 "CAS_3TOOTH_180_60" 8 "CAS_10PULSE_WHEEL" 12 "SWTCHCAL_DS_STD_WHEEL_GS_STD_WHEEL" /end COMPU_VTAB
/begin COMPU_METHOD CRS_BACKUP_DYN_SY_Compu "" TAB_VERB "%6.3" "" COMPU_TAB_REF CRS_BACKUP_DYN_SY_Compu /end COMPU_METHOD
/begin COMPU_VTAB CRS_BACKUP_DYN_SY_Compu "" TAB_VERB 2 0 "CAL_DYNCOR" 1 "ADAP_DYNCAOR" /end COMPU_VTAB
/begin COMPU_METHOD CRS_BACKUP_SY_Compu "" TAB_VERB "%6.3" "" COMPU_TAB_REF CRS_BACKUP_SY_Compu /end COMPU_METHOD
/begin COMPU_VTAB CRS_BACKUP_SY_Compu "" TAB_VERB 4 0 "NO_BCR" 1 "BCR" 2 "BCR_DYNCOR_START" 3 "BCR_DYNCOR_ALWAYS" /end COMPU_VTAB
/begin COMPU_METHOD CRS_CY30CONF_SY_Compu "" TAB_VERB "%6.3" "" COMPU_TAB_REF CRS_CY30CONF_SY_Compu /end COMPU_METHOD
/begin COMPU_VTAB CRS_CY30CONF_SY_Compu "" TAB_VERB 4 0 "HARD_WIRED" 1 "CONF_TH_VIA_SW" 2 "CONF_K_VIA_SW" 3 "CONF_TH_K_VIA_SW" /end COMPU_VTAB
/begin COMPU_METHOD CRS_DIAG_DETAIL_SY_Compu "" TAB_VERB "%6.3" "" COMPU_TAB_REF CRS_DIAG_DETAIL_SY_Compu /end COMPU_METHOD
/begin COMPU_VTAB CRS_DIAG_DETAIL_SY_Compu "" TAB_VERB 3 0 "NO_DETAIL" 1 "DETAIL_ERRSIG" 2 "DETAIL_ERRSIG_GLITCH" /end COMPU_VTAB
/begin COMPU_METHOD CRS_DIAG_SYNCINJLOST_SY_Compu "" TAB_VERB "%6.3" "" COMPU_TAB_REF CRS_DIAG_SYNCINJLOST_SY_Compu /end COMPU_METHOD
/begin COMPU_VTAB CRS_DIAG_SYNCINJLOST_SY_Compu "" TAB_VERB 3 0 "NO_ADD_DIAG" 1 "ACTIVATED" 2 "ACTIVATED_ALL" /end COMPU_VTAB
/begin COMPU_METHOD CRS_MIAP_SY_Compu "" TAB_VERB "%6.3" "" COMPU_TAB_REF CRS_MIAP_SY_Compu /end COMPU_METHOD
/begin COMPU_VTAB CRS_MIAP_SY_Compu "" TAB_VERB 2 0 "NO_COR" 1 "MIAP" /end COMPU_VTAB
/begin COMPU_METHOD CRS_SSP_SY_Compu "" TAB_VERB "%6.3" "" COMPU_TAB_REF CRS_SSP_SY_Compu /end COMPU_METHOD
/begin COMPU_VTAB CRS_SSP_SY_Compu "" TAB_VERB 4 0 "NO_CRS_SSPMON" 1 "CRS_SSPMON1" 2 "CRS_SSPMON2" 3 "CRS_SSPMON3" /end COMPU_VTAB
/begin COMPU_METHOD CRS_TAA_SY_Compu "" TAB_VERB "%6.3" "" COMPU_TAB_REF CRS_TAA_SY_Compu /end COMPU_METHOD
/begin COMPU_VTAB CRS_TAA_SY_Compu "" TAB_VERB 3 0 "NO_COR" 1 "TAA" 2 "TAA_ChkCor" /end COMPU_VTAB
/begin COMPU_METHOD CRS_TOOTHAVRG_SY_Compu "" TAB_VERB "%6.3" "" COMPU_TAB_REF CRS_TOOTHAVRG_SY_Compu /end COMPU_METHOD
/begin COMPU_VTAB CRS_TOOTHAVRG_SY_Compu "" TAB_VERB 2 0 "NO_AVRG" 1 "TOOTH_AVERAGE" /end COMPU_VTAB
/begin COMPU_METHOD CSERSABVANDBYND_SC_Compu "" TAB_VERB "%6.3" "" COMPU_TAB_REF CSERSABVANDBYND_SC_Compu /end COMPU_METHOD
/begin COMPU_VTAB CSERSABVANDBYND_SC_Compu "" TAB_VERB 2 0 "NO_CSERS" 1 "CSERS_ABV_BYND" /end COMPU_VTAB
/begin COMPU_METHOD CSTRPURGNOFUPURGCRKCS_SC_Compu "" TAB_VERB "%6.3" "" COMPU_TAB_REF CSTRPURGNOFUPURGCRKCS_SC_Compu /end COMPU_METHOD
/begin COMPU_VTAB CSTRPURGNOFUPURGCRKCS_SC_Compu "" TAB_VERB 2 0 "Disable" 1 "Enable" /end COMPU_VTAB
/begin COMPU_METHOD CTEGRCLRDS_TYPAVL_SC_Compu "" TAB_VERB "%6.3" "" COMPU_TAB_REF CTEGRCLRDS_TYPAVL_SC_Compu /end COMPU_METHOD
/begin COMPU_VTAB CTEGRCLRDS_TYPAVL_SC_Compu "" TAB_VERB 2 0 "False" 1 "True" /end COMPU_VTAB
/begin COMPU_METHOD CTEGRCLRLPUS_TYPAVL_SC_Compu "" TAB_VERB "%6.3" "" COMPU_TAB_REF CTEGRCLRLPUS_TYPAVL_SC_Compu /end COMPU_METHOD
/begin COMPU_VTAB CTEGRCLRLPUS_TYPAVL_SC_Compu "" TAB_VERB 2 0 "False" 1 "True" /end COMPU_VTAB
/begin COMPU_METHOD CTEGRCLRUS_TYPAVL_SY_Compu "" TAB_VERB "%6.3" "" COMPU_TAB_REF CTEGRCLRUS_TYPAVL_SY_Compu /end COMPU_METHOD
/begin COMPU_VTAB CTEGRCLRUS_TYPAVL_SY_Compu "" TAB_VERB 2 0 "0" 1 "1" /end COMPU_VTAB
/begin COMPU_METHOD CTEVCHRGRDS_TYPAVL_SY_Compu "" TAB_VERB "%6.3" "" COMPU_TAB_REF CTEVCHRGRDS_TYPAVL_SY_Compu /end COMPU_METHOD
/begin COMPU_VTAB CTEVCHRGRDS_TYPAVL_SY_Compu "" TAB_VERB 2 0 "False" 1 "True" /end COMPU_VTAB
/begin COMPU_METHOD CTEVEMDS_TYPAVL_SY_Compu "" TAB_VERB "%6.3" "" COMPU_TAB_REF CTEVEMDS_TYPAVL_SY_Compu /end COMPU_METHOD
/begin COMPU_VTAB CTEVEMDS_TYPAVL_SY_Compu "" TAB_VERB 2 0 "False" 1 "True" /end COMPU_VTAB
/begin COMPU_METHOD CTEVHTRDS_TYPAVL_SC_Compu "" TAB_VERB "%6.3" "" COMPU_TAB_REF CTEVHTRDS_TYPAVL_SC_Compu /end COMPU_METHOD
/begin COMPU_VTAB CTEVHTRDS_TYPAVL_SC_Compu "" TAB_VERB 2 0 "False" 1 "True" /end COMPU_VTAB
/begin COMPU_METHOD CTEVHTREXCHGDS_TYPAVL_SC_Compu "" TAB_VERB "%6.3" "" COMPU_TAB_REF CTEVHTREXCHGDS_TYPAVL_SC_Compu /end COMPU_METHOD
/begin COMPU_VTAB CTEVHTREXCHGDS_TYPAVL_SC_Compu "" TAB_VERB 2 0 "False" 1 "True" /end COMPU_VTAB
/begin COMPU_METHOD CTEVHTRUS_TYPAVL_SC_Compu "" TAB_VERB "%6.3" "" COMPU_TAB_REF CTEVHTRUS_TYPAVL_SC_Compu /end COMPU_METHOD
/begin COMPU_VTAB CTEVHTRUS_TYPAVL_SC_Compu "" TAB_VERB 2 0 "False" 1 "True" /end COMPU_VTAB
/begin COMPU_METHOD CTEVINVRUS_TYPAVL_SY_Compu "" TAB_VERB "%6.3" "" COMPU_TAB_REF CTEVINVRUS_TYPAVL_SY_Compu /end COMPU_METHOD
/begin COMPU_VTAB CTEVINVRUS_TYPAVL_SY_Compu "" TAB_VERB 2 0 "False" 1 "True" /end COMPU_VTAB
/begin COMPU_METHOD CTEVLEDS_TYPAVL_SY_Compu "" TAB_VERB "%6.3" "" COMPU_TAB_REF CTEVLEDS_TYPAVL_SY_Compu /end COMPU_METHOD
/begin COMPU_VTAB CTEVLEDS_TYPAVL_SY_Compu "" TAB_VERB 2 0 "False" 1 "True" /end COMPU_VTAB
/begin COMPU_METHOD CTHEATGRET_ADCSNSR_SC_Compu "" TAB_VERB "%6.3" "" COMPU_TAB_REF CTHEATGRET_ADCSNSR_SC_Compu /end COMPU_METHOD
/begin COMPU_VTAB CTHEATGRET_ADCSNSR_SC_Compu "" TAB_VERB 2 0 "no ADC sensor" 1 "ADC sensor" /end COMPU_VTAB
/begin COMPU_METHOD CTHEATGRET_COLDSTRTDIAG_SC_Compu "" TAB_VERB "%6.3" "" COMPU_TAB_REF CTHEATGRET_COLDSTRTDIAG_SC_Compu /end COMPU_METHOD
/begin COMPU_VTAB CTHEATGRET_COLDSTRTDIAG_SC_Compu "" TAB_VERB 2 0 "False" 1 "True" /end COMPU_VTAB
/begin COMPU_METHOD CTHMST_TYPAVLDELIBSTDACTR_SY_Compu "" TAB_VERB "%6.3" "" COMPU_TAB_REF CTHMST_TYPAVLDELIBSTDACTR_SY_Compu /end COMPU_METHOD
/begin COMPU_VTAB CTHMST_TYPAVLDELIBSTDACTR_SY_Compu "" TAB_VERB 2 0 "FALSE" 1 "TRUE" /end COMPU_VTAB
/begin COMPU_METHOD CTRLDENGSTOPPOSNG_SC_Compu "" TAB_VERB "%6.3" "" COMPU_TAB_REF CTRLDENGSTOPPOSNG_SC_Compu /end COMPU_METHOD
/begin COMPU_VTAB CTRLDENGSTOPPOSNG_SC_Compu "" TAB_VERB 4 0 "NONE" 1 "THROTTLEBLADE" 2 "VVT" 3 "E_MACHINE" /end COMPU_VTAB
/begin COMPU_METHOD CTRLDPISTCOOLGVLV_SC_Compu "" RAT_FUNC "%6.2" "" COEFFS 0 1 0 0 0 1 /end COMPU_METHOD
/begin COMPU_METHOD CTTCTL_SY_Compu "" TAB_VERB "%6.3" "" COMPU_TAB_REF CTTCTL_SY_Compu /end COMPU_METHOD
/begin COMPU_VTAB CTTCTL_SY_Compu "" TAB_VERB 2 0 "False" 1 "True" /end COMPU_VTAB
/begin COMPU_METHOD CTTSTDETN_SC_Compu "" TAB_VERB "%6.3" "" COMPU_TAB_REF CTTSTDETN_SC_Compu /end COMPU_METHOD
/begin COMPU_VTAB CTTSTDETN_SC_Compu "" TAB_VERB 2 0 "False" 1 "True" /end COMPU_VTAB
/begin COMPU_METHOD CT_REPLVALSRC_SY_Compu "" TAB_VERB "%6.3" "" COMPU_TAB_REF CT_REPLVALSRC_SY_Compu /end COMPU_METHOD
/begin COMPU_VTAB CT_REPLVALSRC_SY_Compu "" TAB_VERB 2 1 "TFA1LINF_CALC" 2 "TFA2LINF_CALC" /end COMPU_VTAB
/begin COMPU_METHOD CubMtrPerHr "" RAT_FUNC "%6.3" "m^3/h" COEFFS 0 10 0 0 0 1 /end COMPU_METHOD
/begin COMPU_METHOD CUSTTEMPMDL_SC_Compu "" TAB_VERB "%6.3" "" COMPU_TAB_REF CUSTTEMPMDL_SC_Compu /end COMPU_METHOD
/begin COMPU_VTAB CUSTTEMPMDL_SC_Compu "" TAB_VERB 2 0 "False" 1 "True" /end COMPU_VTAB
/begin COMPU_METHOD CVC_SY_Compu "" TAB_VERB "%6.3" "" COMPU_TAB_REF CVC_SY_Compu /end COMPU_METHOD
/begin COMPU_VTAB CVC_SY_Compu "" TAB_VERB 2 0 "False" 1 "True" /end COMPU_VTAB
/begin COMPU_METHOD CvoAdapReqCust_SC_Compu "" TAB_VERB "%6.3" "" COMPU_TAB_REF CvoAdapReqCust_SC_Compu /end COMPU_METHOD
/begin COMPU_VTAB CvoAdapReqCust_SC_Compu "" TAB_VERB 2 0 "False" 1 "True" /end COMPU_VTAB
/begin COMPU_METHOD CVOADV_SC_Compu "" TAB_VERB "%6.3" "" COMPU_TAB_REF CVOADV_SC_Compu /end COMPU_METHOD
/begin COMPU_VTAB CVOADV_SC_Compu "" TAB_VERB 2 0 "No_CVOADV" 1 "CVO2ADV" /end COMPU_VTAB
/begin COMPU_METHOD CVOCFG_SC_Compu "" TAB_VERB "%6.3" "" COMPU_TAB_REF CVOCFG_SC_Compu /end COMPU_METHOD
/begin COMPU_VTAB CVOCFG_SC_Compu "" TAB_VERB 6 0 "NO_CVO" 1 "BASC_CVO" 2 "STEP2_CVO" 3 "STEP3_CVO" 4 "STEP4_CVO" 5 "STEP5_CVO" /end COMPU_VTAB
/begin COMPU_METHOD CVOCPTPCK_SC_Compu "" TAB_VERB "%6.3" "" COMPU_TAB_REF CVOCPTPCK_SC_Compu /end COMPU_METHOD
/begin COMPU_VTAB CVOCPTPCK_SC_Compu "" TAB_VERB 2 0 "0" 1 "1" /end COMPU_VTAB
/begin COMPU_METHOD CVODIAGTYP_SC_Compu "" TAB_VERB "%6.3" "" COMPU_TAB_REF CVODIAGTYP_SC_Compu /end COMPU_METHOD
/begin COMPU_VTAB CVODIAGTYP_SC_Compu "" TAB_VERB 2 1 "StdCvoDiag" 2 "ExtdCvoDiag" /end COMPU_VTAB
/begin COMPU_METHOD CVT_SY_Compu "" TAB_VERB "%6.3" "" COMPU_TAB_REF CVT_SY_Compu /end COMPU_METHOD
/begin COMPU_VTAB CVT_SY_Compu "" TAB_VERB 2 0 "no CVT gear active" 1 "CVT gear active" /end COMPU_VTAB
/begin COMPU_METHOD CY326_SC_Compu "" TAB_VERB "%6.3" "" COMPU_TAB_REF CY326_SC_Compu /end COMPU_METHOD
/begin COMPU_VTAB CY326_SC_Compu "" TAB_VERB 3 0 "No CY326" 1 "One CY326" 2 "Two CY326" /end COMPU_VTAB
/begin COMPU_METHOD CY327_SY_Compu "" TAB_VERB "%6.3" "" COMPU_TAB_REF CY327_SY_Compu /end COMPU_METHOD
/begin COMPU_VTAB CY327_SY_Compu "" TAB_VERB 3 0 "No CY327" 1 "One CY327" 2 "Two CY327" /end COMPU_VTAB
/begin COMPU_METHOD CY329_SC_Compu "" TAB_VERB "%6.3" "" COMPU_TAB_REF CY329_SC_Compu /end COMPU_METHOD
/begin COMPU_VTAB CY329_SC_Compu "" TAB_VERB 4 0 "No CY329" 1 "One CY329" 2 "Two CY329" 3 "Three CY329" /end COMPU_VTAB
/begin COMPU_METHOD CylHtRls "" RAT_FUNC "%6.3" "J" COEFFS 0 4 0 0 0 1 /end COMPU_METHOD
/begin COMPU_METHOD CylHtRlsRate "" RAT_FUNC "%6.4" "J/AgCA" COEFFS 0 64 0 0 0 1 /end COMPU_METHOD
/begin COMPU_METHOD CylinderVolumeCpp "" RAT_FUNC "%9.8" "m^3" COEFFS 0 1000000 0 0 0 1 /end COMPU_METHOD
/begin COMPU_METHOD CylK1 "" RAT_FUNC "%6.4" "10^-5m^3/AgCA" COEFFS 0 128 0 0 0 1 /end COMPU_METHOD
/begin COMPU_METHOD CylK2 "" RAT_FUNC "%7.6" "-" COEFFS 0 16384 0 0 0 1 /end COMPU_METHOD
/begin COMPU_METHOD CylPres "" RAT_FUNC "%6.4" "bar" COEFFS 0 128 0 0 0 1 /end COMPU_METHOD
/begin COMPU_METHOD CYL_MAX_Compu "" RAT_FUNC "%6.2" "" COEFFS 0 1 0 0 0 1 /end COMPU_METHOD
/begin COMPU_METHOD DAPRID_DRVT_SC_Compu "" TAB_VERB "%6.3" "" COMPU_TAB_REF DAPRID_DRVT_SC_Compu /end COMPU_METHOD
/begin COMPU_VTAB DAPRID_DRVT_SC_Compu "" TAB_VERB 8 0 "0" 1 "1" 2 "2" 3 "3" 4 "4" 5 "5" 6 "6" 7 "7" /end COMPU_VTAB
/begin COMPU_METHOD DAPRID_SC_Compu "" TAB_VERB "%6.3" "" COMPU_TAB_REF DAPRID_SC_Compu /end COMPU_METHOD
/begin COMPU_VTAB DAPRID_SC_Compu "" TAB_VERB 9 0 "keine Zuordnung" 1 "ME 9.7 NGV" 2 "ME 17.7 UHP" 3 "MED 17.7.1 MoVE" 4 "MED 17.7.2 M270/M274" 5 "MED 17.7.3" 6 "MED 17.7.4 M177/M178" 7 "ME17.7.20 M281 Smart" 8 "ME17.7.20 M281 REX" /end COMPU_VTAB
/begin COMPU_METHOD DCCHRGRINTKT_TYPAVL_SC_Compu "" TAB_VERB "%6.3" "" COMPU_TAB_REF DCCHRGRINTKT_TYPAVL_SC_Compu /end COMPU_METHOD
/begin COMPU_VTAB DCCHRGRINTKT_TYPAVL_SC_Compu "" TAB_VERB 2 0 "False" 1 "True" /end COMPU_VTAB
/begin COMPU_METHOD DCPVCC_SC_Compu "" TAB_VERB "%6.3" "" COMPU_TAB_REF DCPVCC_SC_Compu /end COMPU_METHOD
/begin COMPU_VTAB DCPVCC_SC_Compu "" TAB_VERB 2 0 "False" 1 "True" /end COMPU_VTAB
/begin COMPU_METHOD DCPVDSSP_SC_Compu "" TAB_VERB "%6.3" "" COMPU_TAB_REF DCPVDSSP_SC_Compu /end COMPU_METHOD
/begin COMPU_VTAB DCPVDSSP_SC_Compu "" TAB_VERB 2 0 "False" 1 "True" /end COMPU_VTAB
/begin COMPU_METHOD DCPVPDY_SC_Compu "" TAB_VERB "%6.3" "" COMPU_TAB_REF DCPVPDY_SC_Compu /end COMPU_METHOD
/begin COMPU_VTAB DCPVPDY_SC_Compu "" TAB_VERB 2 0 "False" 1 "True" /end COMPU_VTAB
/begin COMPU_METHOD DCPVPS_SC_Compu "" TAB_VERB "%6.3" "" COMPU_TAB_REF DCPVPS_SC_Compu /end COMPU_METHOD
/begin COMPU_VTAB DCPVPS_SC_Compu "" TAB_VERB 2 0 "False" 1 "True" /end COMPU_VTAB
/begin COMPU_METHOD DCPVSELECTION_SC_Compu "" TAB_VERB "%6.3" "" COMPU_TAB_REF DCPVSELECTION_SC_Compu /end COMPU_METHOD
/begin COMPU_VTAB DCPVSELECTION_SC_Compu "" TAB_VERB 2 0 "False" 1 "True" /end COMPU_VTAB
/begin COMPU_METHOD DCSOVRDSAPPERR_SC_Compu "" TAB_VERB "%6.3" "" COMPU_TAB_REF DCSOVRDSAPPERR_SC_Compu /end COMPU_METHOD
/begin COMPU_VTAB DCSOVRDSAPPERR_SC_Compu "" TAB_VERB 2 0 "False" 1 "True" /end COMPU_VTAB
/begin COMPU_METHOD DCSOVRDSDFFTLPRT_SY_Compu "" TAB_VERB "%6.3" "" COMPU_TAB_REF DCSOVRDSDFFTLPRT_SY_Compu /end COMPU_METHOD
/begin COMPU_VTAB DCSOVRDSDFFTLPRT_SY_Compu "" TAB_VERB 2 0 "Differential protection has higher Priotity as DCS" 1 "DCS has higher Priotity as differential protection" /end COMPU_VTAB
/begin COMPU_METHOD DCSOVRDSTRAPRT_SY_Compu "" TAB_VERB "%6.3" "" COMPU_TAB_REF DCSOVRDSTRAPRT_SY_Compu /end COMPU_METHOD
/begin COMPU_VTAB DCSOVRDSTRAPRT_SY_Compu "" TAB_VERB 2 0 "FALSE" 1 "TRUE" /end COMPU_VTAB
/begin COMPU_METHOD DCSOVRDSTSCDEC_SY_Compu "" TAB_VERB "%6.3" "" COMPU_TAB_REF DCSOVRDSTSCDEC_SY_Compu /end COMPU_METHOD
/begin COMPU_VTAB DCSOVRDSTSCDEC_SY_Compu "" TAB_VERB 2 0 "FALSE" 1 "TRUE" /end COMPU_VTAB
/begin COMPU_METHOD DDRCOBSVRNRINTL_SC_Compu "" RAT_FUNC "%6.2" "" COEFFS 0 1 0 0 0 1 /end COMPU_METHOD
/begin COMPU_METHOD DDRCOBSVRNRREC_SC_Compu "" RAT_FUNC "%6.2" "" COEFFS 0 1 0 0 0 1 /end COMPU_METHOD
/begin COMPU_METHOD DDRC_DTRFRZINFHEALDEB_SY_Compu "" TAB_VERB "%6.3" "" COMPU_TAB_REF DDRC_DTRFRZINFHEALDEB_SY_Compu /end COMPU_METHOD
/begin COMPU_VTAB DDRC_DTRFRZINFHEALDEB_SY_Compu "" TAB_VERB 2 0 "False" 1 "True" /end COMPU_VTAB
/begin COMPU_METHOD DDRC_DTRUPDSUP_SY_Compu "" TAB_VERB "%6.3" "" COMPU_TAB_REF DDRC_DTRUPDSUP_SY_Compu /end COMPU_METHOD
/begin COMPU_VTAB DDRC_DTRUPDSUP_SY_Compu "" TAB_VERB 2 0 "False" 1 "True" /end COMPU_VTAB
/begin COMPU_METHOD dez "" RAT_FUNC "%6.2" "" COEFFS 0 1 0 0 0 1 /end COMPU_METHOD
/begin COMPU_METHOD EngN "" RAT_FUNC "%6.3" "rpm" COEFFS 0 2 0 0 0 1 /end COMPU_METHOD
/begin COMPU_METHOD Fact1000 "" RAT_FUNC "%6.5" "-" COEFFS 0 1000 0 0 0 1 /end COMPU_METHOD
/begin COMPU_METHOD Fact_100 "" RAT_FUNC "%6.4" "-" COEFFS 0 100 0 0 0 1 /end COMPU_METHOD
/begin COMPU_METHOD fak_q0p0039 "" RAT_FUNC "%6.4" "-" COEFFS 0 256 0 0 0 1 /end COMPU_METHOD
/begin COMPU_METHOD fak_q0p00392 "" RAT_FUNC "%6.4" "-" COEFFS 0 255 0 0 0 1 /end COMPU_METHOD
/begin COMPU_METHOD fak_sb_b2 "" RAT_FUNC "%6.4" "-" COEFFS 0 256 0 0 0 4 /end COMPU_METHOD
/begin COMPU_METHOD fak_ub_b1 "" RAT_FUNC "%6.4" "-" COEFFS 0 256 0 0 0 1 /end COMPU_METHOD
/begin COMPU_METHOD fak_ub_b2 "" RAT_FUNC "%8.5" "-" COEFFS 0 256 0 0 0 2 /end COMPU_METHOD
/begin COMPU_METHOD fak_ub_b4 "" RAT_FUNC "%6.4" "-" COEFFS 0 256 0 0 0 4 /end COMPU_METHOD
/begin COMPU_METHOD fak_uw_b1 "" RAT_FUNC "%7.6" "-" COEFFS 0 65536 0 0 0 1 /end COMPU_METHOD
/begin COMPU_METHOD fak_uw_b16 "" RAT_FUNC "%6.5" "-" COEFFS 0 65536 0 0 0 16 /end COMPU_METHOD
/begin COMPU_METHOD fak_uw_b2 "" RAT_FUNC "%7.6" "-" COEFFS 0 65536 0 0 0 2 /end COMPU_METHOD
/begin COMPU_METHOD fak_uw_b32 "" RAT_FUNC "%6.5" "-" COEFFS 0 65536 0 0 0 32 /end COMPU_METHOD
/begin COMPU_METHOD fak_uw_b8 "" RAT_FUNC "%6.5" "-" COEFFS 0 65536 0 0 0 8 /end COMPU_METHOD
/begin COMPU_METHOD kw_q0p0156 "" RAT_FUNC "%6.4" "Grad KW" COEFFS 0 64 0 0 0 1 /end COMPU_METHOD
/begin COMPU_METHOD kw_q0p75 "" RAT_FUNC "%6.3" "Grad KW" COEFFS 0 4 0 0 0 3 /end COMPU_METHOD
/begin COMPU_METHOD m_ub_b1020 "" RAT_FUNC "%6.2" "kg/h" COEFFS 0 1 0 0 0 4 /end COMPU_METHOD
/begin COMPU_METHOD m_ub_b23p3 "" RAT_FUNC "%6.3" "kg" COEFFS 0 2812.5 0 0 0 256 /end COMPU_METHOD
/begin COMPU_METHOD m_uw_b6553p5 "" RAT_FUNC "%6.3" "kg/h" COEFFS 0 1 0 0 0 0.1 /end COMPU_METHOD
/begin COMPU_METHOD m_uw_q0p24 "" RAT_FUNC "%6.3" "g/min" COEFFS 0 1 0 0 0 0.24 /end COMPU_METHOD
/begin COMPU_METHOD nmot_q0p25 "" RAT_FUNC "%6.3" "1/min" COEFFS 0 4 0 0 0 1 /end COMPU_METHOD
/begin COMPU_METHOD nmot_ub_q40 "" RAT_FUNC "%6.1" "1/min" COEFFS 0 1 0 0 0 40 /end COMPU_METHOD
/begin COMPU_METHOD OneToOne "" RAT_FUNC "%6.2" "-" COEFFS 0 1 0 0 0 1 /end COMPU_METHOD
/begin COMPU_METHOD Prc "" RAT_FUNC "%6.4" "%" COEFFS 0 81.92 0 0 0 1 /end COMPU_METHOD
/begin COMPU_METHOD Pres "" RAT_FUNC "%6.3" "kPa" COEFFS 0 10 0 0 0 1 /end COMPU_METHOD
/begin COMPU_METHOD Pres_hPa "" RAT_FUNC "%6.2" "hPa" COEFFS 0 1 0 0 0 1 /end COMPU_METHOD
/begin COMPU_METHOD Pres_kPa_VSA "" RAT_FUNC "%6.1" "kPa" COEFFS 0 0.0417362270450751 0 0 0 1 /end COMPU_METHOD
/begin COMPU_METHOD p_q0p078 "" RAT_FUNC "%6.4" "hPa" COEFFS 0 64 0 0 0 5 /end COMPU_METHOD
/begin COMPU_METHOD p_q10 "" RAT_FUNC "%6.1" "hPa" COEFFS 0 1 0 0 0 10 /end COMPU_METHOD
/begin COMPU_METHOD p_q100 "" RAT_FUNC "%6.0" "hPa" COEFFS 0 1 0 0 0 100 /end COMPU_METHOD
/begin COMPU_METHOD p_uw_q0p039 "" RAT_FUNC "%6.4" "hPa" COEFFS 0 256 0 0 0 10 /end COMPU_METHOD
/begin COMPU_METHOD p_uw_q0p078 "" RAT_FUNC "%6.4" "hPa" COEFFS 0 256 0 0 0 20 /end COMPU_METHOD
/begin COMPU_METHOD q2_bar_DIV_s "" RAT_FUNC "%6.2" "bar/s" COEFFS 0 1 0 0 0 2 /end COMPU_METHOD
/begin COMPU_METHOD RBPtCel_m_0p001_1 "" RAT_FUNC "%6.5" "g" COEFFS 0 1000 0 0 0 1 /end COMPU_METHOD
/begin COMPU_METHOD rel_q0p0234 "" RAT_FUNC "%6.4" "%" COEFFS 0 128 0 0 0 3 /end COMPU_METHOD
/begin COMPU_METHOD rel_ub_q0p1875 "" RAT_FUNC "%6.3" "KW/ms" COEFFS 0 256 0 0 0 48 /end COMPU_METHOD
/begin COMPU_METHOD rel_uw_b100 "" RAT_FUNC "%6.4" "%" COEFFS 0 65536 0 0 0 100 /end COMPU_METHOD
/begin COMPU_METHOD SigQly_COMPU_VERB "" TAB_VERB "%6.3" "" COMPU_TAB_REF SigQly_COMPU_VERB /end COMPU_METHOD
/begin COMPU_VTAB SigQly_COMPU_VERB "" TAB_VERB 16 0 "SIGQLY_NOTCALC" 1 "SIGQLY_INIT" 2 "SIGQLY_OK" 3 "SIGQLY_MODEL" 4 "SIGQLY_REPLACEMENT" 5 "SIGQLY_FROZEN" 6 "SIGQLY_INVALID" 7 "SIGQLY_RESERVED_7" 8 "SIGQLY_RESERVED_8" 9 "SIGQLY_RESERVED_9" 10 "SIGQLY_RESERVED_10" 11 "SIGQLY_RESERVED_11" 12 "SIGQLY_RESERVED_12" 13 "SIGQLY_RESERVED_13" 14 "SIGQLY_RESERVED_14" 15 "SIGQLY_RESERVED_15" /end COMPU_VTAB
/begin COMPU_METHOD t10msxs_uw_b655p35 "" RAT_FUNC "%6.4" "s" COEFFS 0 1 0 0 0 0.01 /end COMPU_METHOD
/begin COMPU_METHOD t1sxs_uw_q1 "" RAT_FUNC "%6.2" "s" COEFFS 0 1 0 0 0 1 /end COMPU_METHOD
/begin COMPU_METHOD Temp_Cels "" RAT_FUNC "%6.1" "deg C" COEFFS 0 10 2731.4 0 0 1 /end COMPU_METHOD
/begin COMPU_METHOD temp_q0p0234 "" RAT_FUNC "%6.4" "K" COEFFS 0 256 0 0 0 6 /end COMPU_METHOD
/begin COMPU_METHOD temp_q0p0234_o273 "" RAT_FUNC "%6.1" "Grad C" COEFFS 0 1 273.15 0 0 0.0234375 /end COMPU_METHOD
/begin COMPU_METHOD temp_q0p75_om48 "" RAT_FUNC "%6.2" "Grad C" COEFFS 0 4 192 0 0 3 /end COMPU_METHOD
/begin COMPU_METHOD temp_q6_o273 "" RAT_FUNC "%6.1" "Grad C" COEFFS 0 1 273.15 0 0 6 /end COMPU_METHOD
/begin COMPU_METHOD temp_ub_q0p75_o48 "" RAT_FUNC "%6.2" "Grad C" COEFFS 0 1 48 0 0 0.75 /end COMPU_METHOD
/begin COMPU_METHOD TimeDeb "" RAT_FUNC "%6.1" "ms" COEFFS 0 0.1 0 0 0 1 /end COMPU_METHOD
/begin COMPU_METHOD TimeDelay_s "" RAT_FUNC "%6.1" "s" COEFFS 0 0 1 0 0.00023283064365387 0 /end COMPU_METHOD
/begin COMPU_METHOD Time_Dt "" RAT_FUNC "%9.8" "s" COEFFS 0 1000000 0 0 0 1 /end COMPU_METHOD
/begin COMPU_METHOD Time_ms "" RAT_FUNC "%6.1" "ms" COEFFS 0 0.1 0 0 0 1 /end COMPU_METHOD
/begin COMPU_METHOD Time_ms_20ms "" RAT_FUNC "%6.1" "ms" COEFFS 0 0.05 0 0 0 1 /end COMPU_METHOD
/begin COMPU_METHOD Time_s "" RAT_FUNC "%6.4" "s" COEFFS 0 100 0 0 0 1 /end COMPU_METHOD
/begin COMPU_METHOD TrqPerSec "" RAT_FUNC "%6.2" "Nm/s" COEFFS 0 1 0 0 0 1 /end COMPU_METHOD
/begin COMPU_METHOD t_q0p001 "" RAT_FUNC "%6.5" "s" COEFFS 0 1000 0 0 0 1 /end COMPU_METHOD
/begin COMPU_METHOD t_q0p01 "" RAT_FUNC "%6.4" "s" COEFFS 0 100 0 0 0 1 /end COMPU_METHOD
/begin COMPU_METHOD t_q0p02 "" RAT_FUNC "%6.4" "s" COEFFS 0 100 0 0 0 2 /end COMPU_METHOD
/begin COMPU_METHOD t_q0p1 "" RAT_FUNC "%6.3" "s" COEFFS 0 10 0 0 0 1 /end COMPU_METHOD
/begin COMPU_METHOD t_q0p2 "" RAT_FUNC "%6.3" "s" COEFFS 0 10 0 0 0 2 /end COMPU_METHOD
/begin COMPU_METHOD t_q1 "" RAT_FUNC "%6.2" "s" COEFFS 0 1 0 0 0 1 /end COMPU_METHOD
/begin COMPU_METHOD Vel "" RAT_FUNC "%6.4" "km/h" COEFFS 0 100 0 0 0 1 /end COMPU_METHOD
/begin COMPU_METHOD vfzg_ub_q1p25 "" RAT_FUNC "%6.2" "km/h" COEFFS 0 1 0 0 0 1.25 /end COMPU_METHOD
/begin COMPU_METHOD Volt "" RAT_FUNC "%6.3" "mV" COEFFS 0 5 0 0 0 1 /end COMPU_METHOD
/begin COMPU_METHOD Volt_q1 "" RAT_FUNC "%6.2" "V" COEFFS 0 1 0 0 0 1 /end COMPU_METHOD
/begin COMPU_METHOD zk100msxs_uw_b6553 "" RAT_FUNC "%6.1" "s" COEFFS 0 0 65536 0 10 0 /end COMPU_METHOD
/begin COMPU_METHOD zk100msxs_uw_b6553p6 "" RAT_FUNC "%6.1" "s" COEFFS 0 0 65536 0 10 0 /end COMPU_METHOD
/begin COMPU_METHOD zk10msxs_uw_b655p36 "" RAT_FUNC "%6.2" "s" COEFFS 0 0 65536 0 100 0 /end COMPU_METHOD
/begin COMPU_METHOD zk1msxs_uw_b65p536 "" RAT_FUNC "%6.3" "s" COEFFS 0 0 65536 0 1000 0 /end COMPU_METHOD
/begin COMPU_METHOD zk200msxs_uw_b13107p2 "" RAT_FUNC "%6.0" "s" COEFFS 0 0 65536 0 5 0 /end COMPU_METHOD
/begin COMPU_METHOD zw_q2p9297Em3_deg_KW "" RAT_FUNC "%6.4" "deg KW" COEFFS 0 1024 0 0 0 3 /end COMPU_METHOD
/begin COMPU_METHOD defaultAscii "" RAT_FUNC "%6.2" "" COEFFS 0 1 0 0 0 1 /end COMPU_METHOD
/begin RECORD_LAYOUT Kw_Ws16 FNC_VALUES 1 SWORD COLUMN_DIR DIRECT /end RECORD_LAYOUT
/begin RECORD_LAYOUT RB_Curve_S16_S16 NO_AXIS_PTS_X 1 SWORD AXIS_PTS_X 2 SWORD INDEX_INCR DIRECT FNC_VALUES 3 SWORD COLUMN_DIR DIRECT /end RECORD_LAYOUT
/begin RECORD_LAYOUT RB_Curve_S16_U16_Static NO_AXIS_PTS_X 1 SWORD AXIS_PTS_X 2 SWORD INDEX_INCR DIRECT FNC_VALUES 3 UWORD COLUMN_DIR DIRECT STATIC_RECORD_LAYOUT /end RECORD_LAYOUT
/begin RECORD_LAYOUT RB_Curve_U16_S16_Static NO_AXIS_PTS_X 1 UWORD AXIS_PTS_X 2 UWORD INDEX_INCR DIRECT FNC_VALUES 3 SWORD COLUMN_DIR DIRECT STATIC_RECORD_LAYOUT /end RECORD_LAYOUT
/begin RECORD_LAYOUT RB_Curve_U16_U16 NO_AXIS_PTS_X 1 UWORD AXIS_PTS_X 2 UWORD INDEX_INCR DIRECT FNC_VALUES 3 UWORD COLUMN_DIR DIRECT /end RECORD_LAYOUT
/begin RECORD_LAYOUT RB_Curve_U16_U8_Static NO_AXIS_PTS_X 1 UWORD AXIS_PTS_X 2 UWORD INDEX_INCR DIRECT FNC_VALUES 3 UBYTE COLUMN_DIR DIRECT STATIC_RECORD_LAYOUT /end RECORD_LAYOUT
/begin RECORD_LAYOUT RB_Curve_U8_S8_Static NO_AXIS_PTS_X 1 UBYTE AXIS_PTS_X 2 UBYTE INDEX_INCR DIRECT FNC_VALUES 3 SBYTE COLUMN_DIR DIRECT STATIC_RECORD_LAYOUT /end RECORD_LAYOUT
/begin RECORD_LAYOUT RB_Map_S16S16_S16 NO_AXIS_PTS_X 1 SWORD NO_AXIS_PTS_Y 2 SWORD AXIS_PTS_X 3 SWORD INDEX_INCR DIRECT AXIS_PTS_Y 4 SWORD INDEX_INCR DIRECT FNC_VALUES 5 SWORD COLUMN_DIR DIRECT /end RECORD_LAYOUT
/begin RECORD_LAYOUT RB_Map_S16U16_U16 NO_AXIS_PTS_X 1 SWORD NO_AXIS_PTS_Y 2 SWORD AXIS_PTS_X 3 SWORD INDEX_INCR DIRECT AXIS_PTS_Y 4 UWORD INDEX_INCR DIRECT FNC_VALUES 5 UWORD ROW_DIR DIRECT /end RECORD_LAYOUT
/begin RECORD_LAYOUT RB_Map_U16S16_U16 NO_AXIS_PTS_X 1 UWORD NO_AXIS_PTS_Y 2 UWORD AXIS_PTS_X 3 UWORD INDEX_INCR DIRECT AXIS_PTS_Y 4 SWORD INDEX_INCR DIRECT FNC_VALUES 5 UWORD COLUMN_DIR DIRECT /end RECORD_LAYOUT
/begin RECORD_LAYOUT RB_Map_U16U16_S16 NO_AXIS_PTS_X 1 UWORD NO_AXIS_PTS_Y 2 UWORD AXIS_PTS_X 3 UWORD INDEX_INCR DIRECT AXIS_PTS_Y 4 UWORD INDEX_INCR DIRECT FNC_VALUES 5 SWORD COLUMN_DIR DIRECT /end RECORD_LAYOUT
/begin RECORD_LAYOUT RB_Map_U16U16_U16 NO_AXIS_PTS_X 1 UWORD NO_AXIS_PTS_Y 2 UWORD AXIS_PTS_X 3 UWORD INDEX_INCR DIRECT AXIS_PTS_Y 4 UWORD INDEX_INCR DIRECT FNC_VALUES 5 UWORD COLUMN_DIR DIRECT /end RECORD_LAYOUT
/begin RECORD_LAYOUT RB_Map_U8U8_U8 NO_AXIS_PTS_X 1 UBYTE NO_AXIS_PTS_Y 2 UBYTE AXIS_PTS_X 3 UBYTE INDEX_INCR DIRECT AXIS_PTS_Y 4 UBYTE INDEX_INCR DIRECT FNC_VALUES 5 UBYTE COLUMN_DIR DIRECT /end RECORD_LAYOUT
/begin RECORD_LAYOUT RB_Val_Wboolean FNC_VALUES 1 UBYTE COLUMN_DIR DIRECT /end RECORD_LAYOUT
/begin RECORD_LAYOUT RB_Val_Ws16 FNC_VALUES 1 SWORD COLUMN_DIR DIRECT /end RECORD_LAYOUT
/begin RECORD_LAYOUT RB_Val_Ws32 FNC_VALUES 1 SLONG COLUMN_DIR DIRECT /end RECORD_LAYOUT
/begin RECORD_LAYOUT RB_Val_Ws8 FNC_VALUES 1 SBYTE COLUMN_DIR DIRECT /end RECORD_LAYOUT
/begin RECORD_LAYOUT RB_Val_Wu16 FNC_VALUES 1 UWORD COLUMN_DIR DIRECT /end RECORD_LAYOUT
/begin RECORD_LAYOUT RB_Val_Wu32 FNC_VALUES 1 ULONG COLUMN_DIR DIRECT /end RECORD_LAYOUT
/begin RECORD_LAYOUT RB_Val_Wu8 FNC_VALUES 1 UBYTE COLUMN_DIR DIRECT /end RECORD_LAYOUT
/begin RECORD_LAYOUT ValA_Wu8 FNC_VALUES 1 UBYTE COLUMN_DIR DIRECT /end RECORD_LAYOUT
/begin RECORD_LAYOUT Val_Ws16 FNC_VALUES 1 SWORD COLUMN_DIR DIRECT /end RECORD_LAYOUT
/begin RECORD_LAYOUT Val_Wu16 FNC_VALUES 1 UWORD COLUMN_DIR DIRECT /end RECORD_LAYOUT
/begin RECORD_LAYOUT Val_Wu8 FNC_VALUES 1 UBYTE COLUMN_DIR DIRECT /end RECORD_LAYOUT
/end MODULE
/end PROJECT
