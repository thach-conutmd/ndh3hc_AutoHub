ASAP2_VERSION 1 60
/begin PROJECT MG1CS022 "MG1CS022"
/begin HEADER "" VERSION "MG1CS022_62XSC_V037_TPROT" PROJECT_NO MG1CS022 /end HEADER
/begin MODULE DIM ""
/begin MOD_COMMON "" BYTE_ORDER MSB_LAST ALIGNMENT_BYTE 1 ALIGNMENT_WORD 2 ALIGNMENT_LONG 4 ALIGNMENT_INT64 4 ALIGNMENT_FLOAT32_IEEE 4 ALIGNMENT_FLOAT64_IEEE 4 DATA_SIZE 32 /end MOD_COMMON
/begin CHARACTERISTIC ACTR_TST_CP_ATS_ATS.LimitTypeMsk_C "Actuator test ACTR_TST_CP_ATS_ATS / Tester demand monitoring enable mask for actuators" VALUE 0x8058A670 Val_Wu8 255.0 OneToOne 0.00 255.0 FORMAT "%5.1" /end CHARACTERISTIC
/begin CHARACTERISTIC ACTR_TST_CP_ATS_ATS.CnvNorm_C "Actuator test ACTR_TST_CP_ATS_ATS / Conversion norm used for conversion to/from internal scaling" VALUE 0x8058A671 Val_Wu8 255.0 OneToOne 0.00 255.0 FORMAT "%5.1" /end CHARACTERISTIC
/begin CHARACTERISTIC ACTR_TST_CP_ATS_ATS.LowLim_C "Actuator test ACTR_TST_CP_ATS_ATS / Lower limit for monitoring" VALUE 0x8058A672 Val_Ws16 799.9878 Prc -400.0000 399.9878 FORMAT "%8.4" /end CHARACTERISTIC
/begin CHARACTERISTIC ACTR_TST_CP_ATS_ATS.UpLim_C "Actuator test ACTR_TST_CP_ATS_ATS / Upper limit for monitoring" VALUE 0x8058A674 Val_Ws16 799.9878 Prc -400.0000 399.9878 FORMAT "%8.4" /end CHARACTERISTIC
/begin CHARACTERISTIC ACTR_TST_CP_ATS_ATS.CnvFac_C "Actuator test ACTR_TST_CP_ATS_ATS / Factor used for conversion to/from internal scaling" VALUE 0x8058A678 Val_Ws32 4294967295.00 OneToOne -2147483648.00 2147483647.00 FORMAT "%13.2" /end CHARACTERISTIC
/begin CHARACTERISTIC ACTR_TST_CP_ATS_ATS.CnvOfs_C "Actuator test ACTR_TST_CP_ATS_ATS / Offset used for conversion to/from internal scaling" VALUE 0x8058A67C Val_Ws16 65535.00 OneToOne -32768.00 32767.00 FORMAT "%8.2" /end CHARACTERISTIC
/begin CHARACTERISTIC ACTR_TST_CP_ATS_ATS.DfltVal_C "Actuator test ACTR_TST_CP_ATS_ATS / Default value for standbytest" VALUE 0x8058A67E Val_Ws16 65535.00 OneToOne -32768.00 32767.00 FORMAT "%8.2" /end CHARACTERISTIC
/begin CHARACTERISTIC ACTR_TST_THRVLV_ATS_ATS.LimitTypeMsk_C "Actuator test ACTR_TST_THRVLV_ATS_ATS / Tester demand monitoring enable mask for actuators" VALUE 0x8058A690 Val_Wu8 255.0 OneToOne 0.00 255.0 FORMAT "%5.1" /end CHARACTERISTIC
/begin CHARACTERISTIC ACTR_TST_THRVLV_ATS_ATS.CnvNorm_C "Actuator test ACTR_TST_THRVLV_ATS_ATS / Conversion norm used for conversion to/from internal scaling" VALUE 0x8058A691 Val_Wu8 255.0 OneToOne 0.00 255.0 FORMAT "%5.1" /end CHARACTERISTIC
/begin CHARACTERISTIC ACTR_TST_THRVLV_ATS_ATS.LowLim_C "Actuator test ACTR_TST_THRVLV_ATS_ATS / Lower limit for monitoring" VALUE 0x8058A692 Val_Ws16 25599.61 rel_ub_b99p6 -12800.00 12799.61 FORMAT "%8.2" /end CHARACTERISTIC
/begin CHARACTERISTIC ACTR_TST_THRVLV_ATS_ATS.UpLim_C "Actuator test ACTR_TST_THRVLV_ATS_ATS / Upper limit for monitoring" VALUE 0x8058A694 Val_Ws16 25599.61 rel_ub_b99p6 -12800.00 12799.61 FORMAT "%8.2" /end CHARACTERISTIC
/begin CHARACTERISTIC ACTR_TST_THRVLV_ATS_ATS.CnvFac_C "Actuator test ACTR_TST_THRVLV_ATS_ATS / Factor used for conversion to/from internal scaling" VALUE 0x8058A698 Val_Ws32 4294967295.00 OneToOne -2147483648.00 2147483647.00 FORMAT "%13.2" /end CHARACTERISTIC
/begin CHARACTERISTIC ACTR_TST_THRVLV_ATS_ATS.CnvOfs_C "Actuator test ACTR_TST_THRVLV_ATS_ATS / Offset used for conversion to/from internal scaling" VALUE 0x8058A69C Val_Ws16 65535.00 OneToOne -32768.00 32767.00 FORMAT "%8.2" /end CHARACTERISTIC
/begin CHARACTERISTIC ACTR_TST_THRVLV_ATS_ATS.DfltVal_C "Actuator test ACTR_TST_THRVLV_ATS_ATS / Default value for standbytest" VALUE 0x8058A69E Val_Ws16 65535.00 OneToOne -32768.00 32767.00 FORMAT "%8.2" /end CHARACTERISTIC
/begin CHARACTERISTIC ACTR_TST_VSV_ATS_ATS.LimitTypeMsk_C "Actuator test ACTR_TST_VSV_ATS_ATS / Tester demand monitoring enable mask for actuators" VALUE 0x8058A6A0 Val_Wu8 255.0 OneToOne 0.00 255.0 FORMAT "%5.1" /end CHARACTERISTIC
/begin CHARACTERISTIC ACTR_TST_VSV_ATS_ATS.CnvNorm_C "Actuator test ACTR_TST_VSV_ATS_ATS / Conversion norm used for conversion to/from internal scaling" VALUE 0x8058A6A1 Val_Wu8 255.0 OneToOne 0.00 255.0 FORMAT "%5.1" /end CHARACTERISTIC
/begin CHARACTERISTIC ACTR_TST_VSV_ATS_ATS.LowLim_C "Actuator test ACTR_TST_VSV_ATS_ATS / Lower limit for monitoring" VALUE 0x8058A6A2 Val_Ws16 65535.00 OneToOne -32768.00 32767.00 FORMAT "%8.2" /end CHARACTERISTIC
/begin CHARACTERISTIC ACTR_TST_VSV_ATS_ATS.UpLim_C "Actuator test ACTR_TST_VSV_ATS_ATS / Upper limit for monitoring" VALUE 0x8058A6A4 Val_Ws16 65535.00 OneToOne -32768.00 32767.00 FORMAT "%8.2" /end CHARACTERISTIC
/begin CHARACTERISTIC ACTR_TST_VSV_ATS_ATS.CnvFac_C "Actuator test ACTR_TST_VSV_ATS_ATS / Factor used for conversion to/from internal scaling" VALUE 0x8058A6A8 Val_Ws32 4294967295.00 OneToOne -2147483648.00 2147483647.00 FORMAT "%13.2" /end CHARACTERISTIC
/begin CHARACTERISTIC ACTR_TST_VSV_ATS_ATS.CnvOfs_C "Actuator test ACTR_TST_VSV_ATS_ATS / Offset used for conversion to/from internal scaling" VALUE 0x8058A6AC Val_Ws16 65535.00 OneToOne -32768.00 32767.00 FORMAT "%8.2" /end CHARACTERISTIC
/begin CHARACTERISTIC ACTR_TST_VSV_ATS_ATS.DfltVal_C "Actuator test ACTR_TST_VSV_ATS_ATS / Default value for standbytest" VALUE 0x8058A6AE Val_Ws16 65535.00 OneToOne -32768.00 32767.00 FORMAT "%8.2" /end CHARACTERISTIC
/begin CHARACTERISTIC ASDrf_Cfg2_CW "configuration label 2 for driveability filter" VALUE 0x8050AE04 RB_Val_Wu16 65535.00 dez 0.00 65535.00 FORMAT "%8.2" /end CHARACTERISTIC
/begin CHARACTERISTIC ASDrf_Cfg3_CW "configuration label 3 for driveability filter gradient limitiation" VALUE 0x8050AE06 RB_Val_Wu8 255.0 dez 0.00 255.0 FORMAT "%5.1" /end CHARACTERISTIC
/begin CHARACTERISTIC ASDrf_Cfg4_CW "configuration label 4 for driveability filter" VALUE 0x8050AE08 RB_Val_Wu16 65535.00 dez 0.00 65535.00 FORMAT "%8.2" /end CHARACTERISTIC
/begin CHARACTERISTIC ASDrf_Cfg_CW "configuration label for driveability filter" VALUE 0x8050AE0A RB_Val_Wu16 65535.00 dez 0.00 65535.00 FORMAT "%8.2" /end CHARACTERISTIC
/begin CHARACTERISTIC ASDrf_CoefAAirCdnrOnGripNeg_GT "Coef A, Grip at clutch, neg. load alteration damping for AC on" CURVE 0x8050AE0C RB_CurveGroup_U8 15.94 q0p0625_DIV_Nm_s 0.00 15.94 FORMAT "%5.2"
 /begin AXIS_DESCR COM_AXIS PT_rTrq TransR 8 -327.6800 327.6700 FORMAT "%8.4" AXIS_PTS_REF ASDrf_rTrq_DST /end AXIS_DESCR
/end CHARACTERISTIC
/begin CHARACTERISTIC ASDrf_CoefAEcoAirCdnrOnGripNeg_GT "Coef A, ECO Grip at clutch, neg. load alteration damping for AC on" CURVE 0x8050AE14 RB_CurveGroup_U8 15.94 q0p0625_DIV_Nm_s 0.00 15.94 FORMAT "%5.2"
 /begin AXIS_DESCR COM_AXIS PT_rTrq TransR 8 -327.6800 327.6700 FORMAT "%8.4" AXIS_PTS_REF ASDrf_rTrq_DST /end AXIS_DESCR
/end CHARACTERISTIC
/begin CHARACTERISTIC ASDrf_CoefAEcoMtModNeg_GT "Coef A, Eco Manual transmission mode, neg. load alteration damping" CURVE 0x8050AE1C RB_CurveGroup_U8 15.94 q0p0625_DIV_Nm_s 0.00 15.94 FORMAT "%5.2"
 /begin AXIS_DESCR COM_AXIS PT_rTrq TransR 8 -327.6800 327.6700 FORMAT "%8.4" AXIS_PTS_REF ASDrf_rTrq_DST /end AXIS_DESCR
/end CHARACTERISTIC
/begin CHARACTERISTIC ASDrf_CoefAEcoMtModPosAbv_GT "Coef A, Eco Manual transmission mode, pos. load alteration damping" CURVE 0x8050AE24 RB_CurveGroup_U8 15.94 q0p0625_DIV_Nm_s 0.00 15.94 FORMAT "%5.2"
 /begin AXIS_DESCR COM_AXIS PT_rTrq TransR 8 -327.6800 327.6700 FORMAT "%8.4" AXIS_PTS_REF ASDrf_rTrq_DST /end AXIS_DESCR
/end CHARACTERISTIC
/begin CHARACTERISTIC ASDrf_CoefAEcoMtModPosBlw_GT "Coef A, Eco , Manual transmission mode, pos. load alteration damping" CURVE 0x8050AE2C RB_CurveGroup_U8 15.94 q0p0625_DIV_Nm_s 0.00 15.94 FORMAT "%5.2"
 /begin AXIS_DESCR COM_AXIS PT_rTrq TransR 8 -327.6800 327.6700 FORMAT "%8.4" AXIS_PTS_REF ASDrf_rTrq_DST /end AXIS_DESCR
/end CHARACTERISTIC
/begin CHARACTERISTIC ASDrf_CoefAEcoNeg_GT "Coef A, Eco, neg. load alteration damping" CURVE 0x8050AE34 RB_CurveGroup_U8 15.94 q0p0625_DIV_Nm_s 0.00 15.94 FORMAT "%5.2"
 /begin AXIS_DESCR COM_AXIS PT_rTrq TransR 8 -327.6800 327.6700 FORMAT "%8.4" AXIS_PTS_REF ASDrf_rTrq_DST /end AXIS_DESCR
/end CHARACTERISTIC
/begin CHARACTERISTIC ASDrf_CoefAEcoPosAbvAcOn_GT "Coef A, Eco, pos. load alteration damping during AC On" CURVE 0x8050AE3C RB_CurveGroup_U8 15.94 q0p0625_DIV_Nm_s 0.00 15.94 FORMAT "%5.2"
 /begin AXIS_DESCR COM_AXIS PT_rTrq TransR 8 -327.6800 327.6700 FORMAT "%8.4" AXIS_PTS_REF ASDrf_rTrq_DST /end AXIS_DESCR
/end CHARACTERISTIC
/begin CHARACTERISTIC ASDrf_CoefAEcoPosAbv_GT "Coef A, Eco, pos. load alteration damping" CURVE 0x8050AE44 RB_CurveGroup_U8 15.94 q0p0625_DIV_Nm_s 0.00 15.94 FORMAT "%5.2"
 /begin AXIS_DESCR COM_AXIS PT_rTrq TransR 8 -327.6800 327.6700 FORMAT "%8.4" AXIS_PTS_REF ASDrf_rTrq_DST /end AXIS_DESCR
/end CHARACTERISTIC
/begin CHARACTERISTIC ASDrf_CoefAEcoPosBlwAcOn_GT "Coef A, Eco, pos. load alteration damping during AC On" CURVE 0x8050AE4C RB_CurveGroup_U8 15.94 q0p0625_DIV_Nm_s 0.00 15.94 FORMAT "%5.2"
 /begin AXIS_DESCR COM_AXIS PT_rTrq TransR 8 -327.6800 327.6700 FORMAT "%8.4" AXIS_PTS_REF ASDrf_rTrq_DST /end AXIS_DESCR
/end CHARACTERISTIC
/begin CHARACTERISTIC ASDrf_CoefAEcoPosBlw_GT "Coef A, Eco, pos. load alteration damping" CURVE 0x8050AE54 RB_CurveGroup_U8 15.94 q0p0625_DIV_Nm_s 0.00 15.94 FORMAT "%5.2"
 /begin AXIS_DESCR COM_AXIS PT_rTrq TransR 8 -327.6800 327.6700 FORMAT "%8.4" AXIS_PTS_REF ASDrf_rTrq_DST /end AXIS_DESCR
/end CHARACTERISTIC
/begin CHARACTERISTIC ASDrf_CoefAGripMtModNeg_GT "Coef A, Grip at clutch, manual transmission mode, neg. load alteration damping" CURVE 0x8050AE5C RB_CurveGroup_U8 15.94 q0p0625_DIV_Nm_s 0.00 15.94 FORMAT "%5.2"
 /begin AXIS_DESCR COM_AXIS PT_rTrq TransR 8 -327.6800 327.6700 FORMAT "%8.4" AXIS_PTS_REF ASDrf_rTrq_DST /end AXIS_DESCR
/end CHARACTERISTIC
/begin CHARACTERISTIC ASDrf_CoefAGripMtModPosAbv_GT "Coef A, Grip at clutch, manual transmission mode, pos. load alteration damping" CURVE 0x8050AE64 RB_CurveGroup_U8 15.94 q0p0625_DIV_Nm_s 0.00 15.94 FORMAT "%5.2"
 /begin AXIS_DESCR COM_AXIS PT_rTrq TransR 8 -327.6800 327.6700 FORMAT "%8.4" AXIS_PTS_REF ASDrf_rTrq_DST /end AXIS_DESCR
/end CHARACTERISTIC
/begin CHARACTERISTIC ASDrf_CoefAGripMtModPosBlw_GT "Coef A, Grip at clutch, manual transmission mode, pos. load alteration damping" CURVE 0x8050AE6C RB_CurveGroup_U8 15.94 q0p0625_DIV_Nm_s 0.00 15.94 FORMAT "%5.2"
 /begin AXIS_DESCR COM_AXIS PT_rTrq TransR 8 -327.6800 327.6700 FORMAT "%8.4" AXIS_PTS_REF ASDrf_rTrq_DST /end AXIS_DESCR
/end CHARACTERISTIC
/begin CHARACTERISTIC ASDrf_CoefAGripNeg_CUR "Coef A, Grip at clutch, neg. load alteration damping" CURVE 0x8050AE74 RB_CurveGroup_U8 15.94 q0p0625_DIV_Nm_s 0.00 15.94 FORMAT "%5.2"
 /begin AXIS_DESCR COM_AXIS PT_rTrq TransR 8 -327.6800 327.6700 FORMAT "%8.4" AXIS_PTS_REF ASDrf_rTrq_DST /end AXIS_DESCR
/end CHARACTERISTIC
/begin CHARACTERISTIC ASDrf_CoefAGripPosAbvAcOn_GCUR "Coef A, Grip at clutch, pos. load alteration damping during AC On" CURVE 0x8050AE7C RB_CurveGroup_U8 15.94 q0p0625_DIV_Nm_s 0.00 15.94 FORMAT "%5.2"
 /begin AXIS_DESCR COM_AXIS PT_rTrq TransR 8 -327.6800 327.6700 FORMAT "%8.4" AXIS_PTS_REF ASDrf_rTrq_DST /end AXIS_DESCR
/end CHARACTERISTIC
/begin CHARACTERISTIC ASDrf_CoefAGripPosAbv_GCUR "Coef A, Grip at clutch, pos. load alteration damping" CURVE 0x8050AE84 RB_CurveGroup_U8 15.94 q0p0625_DIV_Nm_s 0.00 15.94 FORMAT "%5.2"
 /begin AXIS_DESCR COM_AXIS PT_rTrq TransR 8 -327.6800 327.6700 FORMAT "%8.4" AXIS_PTS_REF ASDrf_rTrq_DST /end AXIS_DESCR
/end CHARACTERISTIC
/begin CHARACTERISTIC ASDrf_CoefAGripPosBlwAcOn_GCUR "Coef A, Grip at clutch, pos. load alteration damping during AC On" CURVE 0x8050AE8C RB_CurveGroup_U8 15.94 q0p0625_DIV_Nm_s 0.00 15.94 FORMAT "%5.2"
 /begin AXIS_DESCR COM_AXIS PT_rTrq TransR 8 -327.6800 327.6700 FORMAT "%8.4" AXIS_PTS_REF ASDrf_rTrq_DST /end AXIS_DESCR
/end CHARACTERISTIC
/begin CHARACTERISTIC ASDrf_CoefAGripPosBlw_GCUR "Coef A, Grip at clutch, pos. load alteration damping" CURVE 0x8050AE94 RB_CurveGroup_U8 15.94 q0p0625_DIV_Nm_s 0.00 15.94 FORMAT "%5.2"
 /begin AXIS_DESCR COM_AXIS PT_rTrq TransR 8 -327.6800 327.6700 FORMAT "%8.4" AXIS_PTS_REF ASDrf_rTrq_DST /end AXIS_DESCR
/end CHARACTERISTIC
/begin CHARACTERISTIC ASDrf_CoefANoGripNegAddl_C "Coef A, open powertrain, neg. load alteration damping" VALUE 0x8050AE9C RB_Val_Wu8 15.94 q0p0625_DIV_Nm_s 0.00 15.94 FORMAT "%5.2" /end CHARACTERISTIC
/begin CHARACTERISTIC ASDrf_CoefANoGripNeg_C "Coef A, open powertrain, neg. load alteration damping" VALUE 0x8050AE9D RB_Val_Wu8 15.94 q0p0625_DIV_Nm_s 0.00 15.94 FORMAT "%5.2" /end CHARACTERISTIC
/begin CHARACTERISTIC ASDrf_CoefANoGripPosAddl_C "Coef A, open powertrain, pos. load alteration damping" VALUE 0x8050AE9E RB_Val_Wu8 15.94 q0p0625_DIV_Nm_s 0.00 15.94 FORMAT "%5.2" /end CHARACTERISTIC
/begin CHARACTERISTIC ASDrf_CoefANoGripPos_C "Coef A, open powertrain, pos. load alteration damping" VALUE 0x8050AE9F RB_Val_Wu8 15.94 q0p0625_DIV_Nm_s 0.00 15.94 FORMAT "%5.2" /end CHARACTERISTIC
/begin CHARACTERISTIC ASDrf_CoefASprtMtModNeg_GT "Coef A, Sport, Manual transmission mode, neg. load alteration damping" CURVE 0x8050AEA0 RB_CurveGroup_U8 15.94 q0p0625_DIV_Nm_s 0.00 15.94 FORMAT "%5.2"
 /begin AXIS_DESCR COM_AXIS PT_rTrq TransR 8 -327.6800 327.6700 FORMAT "%8.4" AXIS_PTS_REF ASDrf_rTrq_DST /end AXIS_DESCR
/end CHARACTERISTIC
/begin CHARACTERISTIC ASDrf_CoefASprtMtModPosAbv_GT "Coef A, Sport, Manual transmission mode, pos. load alteration damping" CURVE 0x8050AEA8 RB_CurveGroup_U8 15.94 q0p0625_DIV_Nm_s 0.00 15.94 FORMAT "%5.2"
 /begin AXIS_DESCR COM_AXIS PT_rTrq TransR 8 -327.6800 327.6700 FORMAT "%8.4" AXIS_PTS_REF ASDrf_rTrq_DST /end AXIS_DESCR
/end CHARACTERISTIC
/begin CHARACTERISTIC ASDrf_CoefASprtMtModPosBlw_GT "Coef A, Sport, Manual transmission mode, pos. load alteration damping" CURVE 0x8050AEB0 RB_CurveGroup_U8 15.94 q0p0625_DIV_Nm_s 0.00 15.94 FORMAT "%5.2"
 /begin AXIS_DESCR COM_AXIS PT_rTrq TransR 8 -327.6800 327.6700 FORMAT "%8.4" AXIS_PTS_REF ASDrf_rTrq_DST /end AXIS_DESCR
/end CHARACTERISTIC
/begin CHARACTERISTIC ASDrf_CoefASprtNegAcOn_GT "Coef A, Sport, neg. load alteration damping with AC on" CURVE 0x8050AEB8 RB_CurveGroup_U8 15.94 q0p0625_DIV_Nm_s 0.00 15.94 FORMAT "%5.2"
 /begin AXIS_DESCR COM_AXIS PT_rTrq TransR 8 -327.6800 327.6700 FORMAT "%8.4" AXIS_PTS_REF ASDrf_rTrq_DST /end AXIS_DESCR
/end CHARACTERISTIC
/begin CHARACTERISTIC ASDrf_CoefASprtNeg_GT "Coef A, Sport, neg. load alteration damping" CURVE 0x8050AEC0 RB_CurveGroup_U8 15.94 q0p0625_DIV_Nm_s 0.00 15.94 FORMAT "%5.2"
 /begin AXIS_DESCR COM_AXIS PT_rTrq TransR 8 -327.6800 327.6700 FORMAT "%8.4" AXIS_PTS_REF ASDrf_rTrq_DST /end AXIS_DESCR
/end CHARACTERISTIC
/begin CHARACTERISTIC ASDrf_CoefASprtPosAbvAcOn_GT "Coef A, Sport, pos. load alteration damping with AC on" CURVE 0x8050AEC8 RB_CurveGroup_U8 15.94 q0p0625_DIV_Nm_s 0.00 15.94 FORMAT "%5.2"
 /begin AXIS_DESCR COM_AXIS PT_rTrq TransR 8 -327.6800 327.6700 FORMAT "%8.4" AXIS_PTS_REF ASDrf_rTrq_DST /end AXIS_DESCR
/end CHARACTERISTIC
/begin CHARACTERISTIC ASDrf_CoefASprtPosAbv_GT "Coef A, Sport, pos. load alteration damping" CURVE 0x8050AED0 RB_CurveGroup_U8 15.94 q0p0625_DIV_Nm_s 0.00 15.94 FORMAT "%5.2"
 /begin AXIS_DESCR COM_AXIS PT_rTrq TransR 8 -327.6800 327.6700 FORMAT "%8.4" AXIS_PTS_REF ASDrf_rTrq_DST /end AXIS_DESCR
/end CHARACTERISTIC
/begin CHARACTERISTIC ASDrf_CoefASprtPosBlwAcOn_GT "Coef A, Sport, pos. load alteration damping with AC on" CURVE 0x8050AED8 RB_CurveGroup_U8 15.94 q0p0625_DIV_Nm_s 0.00 15.94 FORMAT "%5.2"
 /begin AXIS_DESCR COM_AXIS PT_rTrq TransR 8 -327.6800 327.6700 FORMAT "%8.4" AXIS_PTS_REF ASDrf_rTrq_DST /end AXIS_DESCR
/end CHARACTERISTIC
/begin CHARACTERISTIC ASDrf_CoefASprtPosBlw_GT "Coef A, Sport, pos. load alteration damping" CURVE 0x8050AEE0 RB_CurveGroup_U8 15.94 q0p0625_DIV_Nm_s 0.00 15.94 FORMAT "%5.2"
 /begin AXIS_DESCR COM_AXIS PT_rTrq TransR 8 -327.6800 327.6700 FORMAT "%8.4" AXIS_PTS_REF ASDrf_rTrq_DST /end AXIS_DESCR
/end CHARACTERISTIC
/begin CHARACTERISTIC ASDrf_CoefBAirCdnrOnGripNeg_GM "Coef B, Grip at clutch, neg. load alteration damping for AC on" MAP 0x8050AEE8 RB_MapGroup_U8 2540. mdgrad_q10 10. 2550. FORMAT "%5.0" EXTENDED_LIMITS 0.00 2550.
 /begin AXIS_DESCR COM_AXIS ASDrf_tqCluBasc Trq 5 -3276.800 3276.700 FORMAT "%8.3" AXIS_PTS_REF ASDrf_trqClthBs_DST /end AXIS_DESCR
 /begin AXIS_DESCR COM_AXIS Epm_nEng EngN 8 -16384.00 16383.50 FORMAT "%8.2" AXIS_PTS_REF ASDrf_nEng_DST /end AXIS_DESCR
/end CHARACTERISTIC
/begin CHARACTERISTIC ASDrf_CoefBEcoAirCdnrOnGripNeg_GM "Coef B, ECO Grip at clutch, neg. load alteration damping for AC on" MAP 0x8050AF10 RB_MapGroup_U8 2540. mdgrad_q10 10. 2550. FORMAT "%5.0" EXTENDED_LIMITS 0.00 2550.
 /begin AXIS_DESCR COM_AXIS ASDrf_tqCluBasc Trq 5 -3276.800 3276.700 FORMAT "%8.3" AXIS_PTS_REF ASDrf_trqClthBs_DST /end AXIS_DESCR
 /begin AXIS_DESCR COM_AXIS Epm_nEng EngN 8 -16384.00 16383.50 FORMAT "%8.2" AXIS_PTS_REF ASDrf_nEng_DST /end AXIS_DESCR
/end CHARACTERISTIC
/begin CHARACTERISTIC ASDrf_CoefBEcoMtModNeg_GM "Coef B, Eco, Manual transmission mode, neg. load alteration damping" MAP 0x8050AF38 RB_MapGroup_U8 2540. mdgrad_q10 10. 2550. FORMAT "%5.0" EXTENDED_LIMITS 0.00 2550.
 /begin AXIS_DESCR COM_AXIS ASDrf_tqCluBasc Trq 5 -3276.800 3276.700 FORMAT "%8.3" AXIS_PTS_REF ASDrf_trqClthBs_DST /end AXIS_DESCR
 /begin AXIS_DESCR COM_AXIS Epm_nEng EngN 8 -16384.00 16383.50 FORMAT "%8.2" AXIS_PTS_REF ASDrf_nEng_DST /end AXIS_DESCR
/end CHARACTERISTIC
/begin CHARACTERISTIC ASDrf_CoefBEcoMtModPosAbv_GM "Coef B, Eco, Manual transmission mode, pos. load alteration damping" MAP 0x8050AF60 RB_MapGroup_U8 2540. mdgrad_q10 10. 2550. FORMAT "%5.0" EXTENDED_LIMITS 0.00 2550.
 /begin AXIS_DESCR COM_AXIS PT_rTrq TransR 8 -327.6800 327.6700 FORMAT "%8.4" AXIS_PTS_REF ASDrf_rTrq_DST /end AXIS_DESCR
 /begin AXIS_DESCR COM_AXIS Epm_nEng EngN 8 -16384.00 16383.50 FORMAT "%8.2" AXIS_PTS_REF ASDrf_nEng_DST /end AXIS_DESCR
/end CHARACTERISTIC
/begin CHARACTERISTIC ASDrf_CoefBEcoMtModPosBlw_GM "Coef B, Eco, Manual transmission mode, pos. load alteration damping" MAP 0x8050AFA0 RB_MapGroup_U8 2550. mdgrad_q10 0.00 2550. FORMAT "%5.0"
 /begin AXIS_DESCR COM_AXIS PT_rTrq TransR 8 -327.6800 327.6700 FORMAT "%8.4" AXIS_PTS_REF ASDrf_rTrq_DST /end AXIS_DESCR
 /begin AXIS_DESCR COM_AXIS Epm_nEng EngN 8 -16384.00 16383.50 FORMAT "%8.2" AXIS_PTS_REF ASDrf_nEng_DST /end AXIS_DESCR
/end CHARACTERISTIC
/begin CHARACTERISTIC ASDrf_CoefBEcoNeg_GM "Coef B, Eco, neg. load alteration damping" MAP 0x8050AFE0 RB_MapGroup_U8 2540. mdgrad_q10 10. 2550. FORMAT "%5.0" EXTENDED_LIMITS 0.00 2550.
 /begin AXIS_DESCR COM_AXIS ASDrf_tqCluBasc Trq 5 -3276.800 3276.700 FORMAT "%8.3" AXIS_PTS_REF ASDrf_trqClthBs_DST /end AXIS_DESCR
 /begin AXIS_DESCR COM_AXIS Epm_nEng EngN 8 -16384.00 16383.50 FORMAT "%8.2" AXIS_PTS_REF ASDrf_nEng_DST /end AXIS_DESCR
/end CHARACTERISTIC
/begin CHARACTERISTIC ASDrf_CoefBEcoPosAbvAcOn_GM "Coef B, Eco,pos. load alteration damping during AC On" MAP 0x8050B008 RB_MapGroup_U8 2540. mdgrad_q10 10. 2550. FORMAT "%5.0" EXTENDED_LIMITS 0.00 2550.
 /begin AXIS_DESCR COM_AXIS PT_rTrq TransR 8 -327.6800 327.6700 FORMAT "%8.4" AXIS_PTS_REF ASDrf_rTrq_DST /end AXIS_DESCR
 /begin AXIS_DESCR COM_AXIS Epm_nEng EngN 8 -16384.00 16383.50 FORMAT "%8.2" AXIS_PTS_REF ASDrf_nEng_DST /end AXIS_DESCR
/end CHARACTERISTIC
/begin CHARACTERISTIC ASDrf_CoefBEcoPosAbv_GM "Coef B, Eco,pos. load alteration damping" MAP 0x8050B048 RB_MapGroup_U8 2540. mdgrad_q10 10. 2550. FORMAT "%5.0" EXTENDED_LIMITS 0.00 2550.
 /begin AXIS_DESCR COM_AXIS PT_rTrq TransR 8 -327.6800 327.6700 FORMAT "%8.4" AXIS_PTS_REF ASDrf_rTrq_DST /end AXIS_DESCR
 /begin AXIS_DESCR COM_AXIS Epm_nEng EngN 8 -16384.00 16383.50 FORMAT "%8.2" AXIS_PTS_REF ASDrf_nEng_DST /end AXIS_DESCR
/end CHARACTERISTIC
/begin CHARACTERISTIC ASDrf_CoefBEcoPosBlwAcOn_GM "Coef B, Eco, pos. load alteration damping during AC On" MAP 0x8050B088 RB_MapGroup_U8 2550. mdgrad_q10 0.00 2550. FORMAT "%5.0"
 /begin AXIS_DESCR COM_AXIS PT_rTrq TransR 8 -327.6800 327.6700 FORMAT "%8.4" AXIS_PTS_REF ASDrf_rTrq_DST /end AXIS_DESCR
 /begin AXIS_DESCR COM_AXIS Epm_nEng EngN 8 -16384.00 16383.50 FORMAT "%8.2" AXIS_PTS_REF ASDrf_nEng_DST /end AXIS_DESCR
/end CHARACTERISTIC
/begin CHARACTERISTIC ASDrf_CoefBEcoPosBlw_GM "Coef B, Eco, pos. load alteration damping" MAP 0x8050B0C8 RB_MapGroup_U8 2550. mdgrad_q10 0.00 2550. FORMAT "%5.0"
 /begin AXIS_DESCR COM_AXIS PT_rTrq TransR 8 -327.6800 327.6700 FORMAT "%8.4" AXIS_PTS_REF ASDrf_rTrq_DST /end AXIS_DESCR
 /begin AXIS_DESCR COM_AXIS Epm_nEng EngN 8 -16384.00 16383.50 FORMAT "%8.2" AXIS_PTS_REF ASDrf_nEng_DST /end AXIS_DESCR
/end CHARACTERISTIC
/begin CHARACTERISTIC ASDrf_CoefBGripMtModNeg_GM "Coef B, Grip at clutch, manual transmission mode, neg. load alteration damping" MAP 0x8050B108 RB_MapGroup_U8 2540. mdgrad_q10 10. 2550. FORMAT "%5.0" EXTENDED_LIMITS 0.00 2550.
 /begin AXIS_DESCR COM_AXIS ASDrf_tqCluBasc Trq 5 -3276.800 3276.700 FORMAT "%8.3" AXIS_PTS_REF ASDrf_trqClthBs_DST /end AXIS_DESCR
 /begin AXIS_DESCR COM_AXIS Epm_nEng EngN 8 -16384.00 16383.50 FORMAT "%8.2" AXIS_PTS_REF ASDrf_nEng_DST /end AXIS_DESCR
/end CHARACTERISTIC
/begin CHARACTERISTIC ASDrf_CoefBGripMtModPosAbv_GM "Coef B, Grip at clutch, manual transmission mode, pos. load alteration damping" MAP 0x8050B130 RB_MapGroup_U8 2540. mdgrad_q10 10. 2550. FORMAT "%5.0" EXTENDED_LIMITS 0.00 2550.
 /begin AXIS_DESCR COM_AXIS PT_rTrq TransR 8 -327.6800 327.6700 FORMAT "%8.4" AXIS_PTS_REF ASDrf_rTrq_DST /end AXIS_DESCR
 /begin AXIS_DESCR COM_AXIS Epm_nEng EngN 8 -16384.00 16383.50 FORMAT "%8.2" AXIS_PTS_REF ASDrf_nEng_DST /end AXIS_DESCR
/end CHARACTERISTIC
/begin CHARACTERISTIC ASDrf_CoefBGripMtModPosBlw_GM "Coef B, Grip at clutch, manual transmission mode, pos. load alteration damping" MAP 0x8050B170 RB_MapGroup_U8 2550. mdgrad_q10 0.00 2550. FORMAT "%5.0"
 /begin AXIS_DESCR COM_AXIS PT_rTrq TransR 8 -327.6800 327.6700 FORMAT "%8.4" AXIS_PTS_REF ASDrf_rTrq_DST /end AXIS_DESCR
 /begin AXIS_DESCR COM_AXIS Epm_nEng EngN 8 -16384.00 16383.50 FORMAT "%8.2" AXIS_PTS_REF ASDrf_nEng_DST /end AXIS_DESCR
/end CHARACTERISTIC
/begin CHARACTERISTIC ASDrf_CoefBGripNeg_GMAP "Coef B, Grip at clutch, neg. load alteration damping" MAP 0x8050B1B0 RB_MapGroup_U8 2540. mdgrad_q10 10. 2550. FORMAT "%5.0" EXTENDED_LIMITS 0.00 2550.
 /begin AXIS_DESCR COM_AXIS ASDrf_tqCluBasc Trq 5 -3276.800 3276.700 FORMAT "%8.3" AXIS_PTS_REF ASDrf_trqClthBs_DST /end AXIS_DESCR
 /begin AXIS_DESCR COM_AXIS ASDrf_nPt EngN 8 -16384.00 16383.50 FORMAT "%8.2" AXIS_PTS_REF ASDrf_nPt_DST /end AXIS_DESCR
/end CHARACTERISTIC
/begin CHARACTERISTIC ASDrf_CoefBGripPosAbvAcOn_GMAP "Coef B, Grip at clutch, pos. load alteration damping during AC On" MAP 0x8050B1D8 RB_MapGroup_U8 2540. mdgrad_q10 10. 2550. FORMAT "%5.0" EXTENDED_LIMITS 0.00 2550.
 /begin AXIS_DESCR COM_AXIS PT_rTrq TransR 8 -327.6800 327.6700 FORMAT "%8.4" AXIS_PTS_REF ASDrf_rTrq_DST /end AXIS_DESCR
 /begin AXIS_DESCR COM_AXIS Epm_nEng EngN 8 -16384.00 16383.50 FORMAT "%8.2" AXIS_PTS_REF ASDrf_nEng_DST /end AXIS_DESCR
/end CHARACTERISTIC
/begin CHARACTERISTIC ASDrf_CoefBGripPosAbv_GMAP "Coef B, Grip at clutch, pos. load alteration damping" MAP 0x8050B218 RB_MapGroup_U8 2540. mdgrad_q10 10. 2550. FORMAT "%5.0" EXTENDED_LIMITS 0.00 2550.
 /begin AXIS_DESCR COM_AXIS PT_rTrq TransR 8 -327.6800 327.6700 FORMAT "%8.4" AXIS_PTS_REF ASDrf_rTrq_DST /end AXIS_DESCR
 /begin AXIS_DESCR COM_AXIS ASDrf_nPt EngN 8 -16384.00 16383.50 FORMAT "%8.2" AXIS_PTS_REF ASDrf_nPt_DST /end AXIS_DESCR
/end CHARACTERISTIC
/begin CHARACTERISTIC ASDrf_CoefBGripPosBlwAcOn_GMAP "Coef B, Grip at clutch, pos. load alteration damping during AC On" MAP 0x8050B258 RB_MapGroup_U8 2550. mdgrad_q10 0.00 2550. FORMAT "%5.0"
 /begin AXIS_DESCR COM_AXIS PT_rTrq TransR 8 -327.6800 327.6700 FORMAT "%8.4" AXIS_PTS_REF ASDrf_rTrq_DST /end AXIS_DESCR
 /begin AXIS_DESCR COM_AXIS Epm_nEng EngN 8 -16384.00 16383.50 FORMAT "%8.2" AXIS_PTS_REF ASDrf_nEng_DST /end AXIS_DESCR
/end CHARACTERISTIC
/begin CHARACTERISTIC ASDrf_CoefBGripPosBlw_GMAP "Coef B, Grip at clutch, pos. load alteration damping" MAP 0x8050B298 RB_MapGroup_U8 2550. mdgrad_q10 0.00 2550. FORMAT "%5.0"
 /begin AXIS_DESCR COM_AXIS PT_rTrq TransR 8 -327.6800 327.6700 FORMAT "%8.4" AXIS_PTS_REF ASDrf_rTrq_DST /end AXIS_DESCR
 /begin AXIS_DESCR COM_AXIS ASDrf_nPt EngN 8 -16384.00 16383.50 FORMAT "%8.2" AXIS_PTS_REF ASDrf_nPt_DST /end AXIS_DESCR
/end CHARACTERISTIC
/begin CHARACTERISTIC ASDrf_CoefBNoGripNegAddl_C "Coef B, open powertrain, neg. load alteration damping" VALUE 0x8050B2D8 RB_Val_Wu8 2540. mdgrad_q10 10. 2550. FORMAT "%5.0" EXTENDED_LIMITS 0.00 2550. /end CHARACTERISTIC
/begin CHARACTERISTIC ASDrf_CoefBNoGripNeg_C "Coef B, open powertrain, neg. load alteration damping" VALUE 0x8050B2D9 RB_Val_Wu8 2540. mdgrad_q10 10. 2550. FORMAT "%5.0" EXTENDED_LIMITS 0.00 2550. /end CHARACTERISTIC
/begin CHARACTERISTIC ASDrf_CoefBNoGripPosAddl_C "Coef B, open powertrain, pos. load alteration damping" VALUE 0x8050B2DA RB_Val_Wu8 2540. mdgrad_q10 10. 2550. FORMAT "%5.0" EXTENDED_LIMITS 0.00 2550. /end CHARACTERISTIC
/begin CHARACTERISTIC ASDrf_CoefBNoGripPos_C "Coef B, open powertrain, pos. load alteration damping" VALUE 0x8050B2DB RB_Val_Wu8 2540. mdgrad_q10 10. 2550. FORMAT "%5.0" EXTENDED_LIMITS 0.00 2550. /end CHARACTERISTIC
/begin CHARACTERISTIC ASDrf_CoefBSprtMtModNeg_GM "Coef B, Sport, Manual transmission mode, neg. load alteration damping" MAP 0x8050B2DC RB_MapGroup_U8 2540. mdgrad_q10 10. 2550. FORMAT "%5.0" EXTENDED_LIMITS 0.00 2550.
 /begin AXIS_DESCR COM_AXIS ASDrf_tqCluBasc Trq 5 -3276.800 3276.700 FORMAT "%8.3" AXIS_PTS_REF ASDrf_trqClthBs_DST /end AXIS_DESCR
 /begin AXIS_DESCR COM_AXIS Epm_nEng EngN 8 -16384.00 16383.50 FORMAT "%8.2" AXIS_PTS_REF ASDrf_nEng_DST /end AXIS_DESCR
/end CHARACTERISTIC
/begin CHARACTERISTIC ASDrf_CoefBSprtMtModPosAbv_GM "Coef B, Sport, Manual transmission mode, pos. load alteration damping" MAP 0x8050B304 RB_MapGroup_U8 2540. mdgrad_q10 10. 2550. FORMAT "%5.0" EXTENDED_LIMITS 0.00 2550.
 /begin AXIS_DESCR COM_AXIS PT_rTrq TransR 8 -327.6800 327.6700 FORMAT "%8.4" AXIS_PTS_REF ASDrf_rTrq_DST /end AXIS_DESCR
 /begin AXIS_DESCR COM_AXIS Epm_nEng EngN 8 -16384.00 16383.50 FORMAT "%8.2" AXIS_PTS_REF ASDrf_nEng_DST /end AXIS_DESCR
/end CHARACTERISTIC
/begin CHARACTERISTIC ASDrf_CoefBSprtMtModPosBlw_GM "Coef B, Sport, Manual transmission mode, pos. load alteration damping" MAP 0x8050B344 RB_MapGroup_U8 2550. mdgrad_q10 0.00 2550. FORMAT "%5.0"
 /begin AXIS_DESCR COM_AXIS PT_rTrq TransR 8 -327.6800 327.6700 FORMAT "%8.4" AXIS_PTS_REF ASDrf_rTrq_DST /end AXIS_DESCR
 /begin AXIS_DESCR COM_AXIS Epm_nEng EngN 8 -16384.00 16383.50 FORMAT "%8.2" AXIS_PTS_REF ASDrf_nEng_DST /end AXIS_DESCR
/end CHARACTERISTIC
/begin CHARACTERISTIC ASDrf_CoefBSprtNegAcOn_GM "Coef B, Sport, neg. load alteration damping with AC on" MAP 0x8050B384 RB_MapGroup_U8 2540. mdgrad_q10 10. 2550. FORMAT "%5.0" EXTENDED_LIMITS 0.00 2550.
 /begin AXIS_DESCR COM_AXIS ASDrf_tqCluBasc Trq 5 -3276.800 3276.700 FORMAT "%8.3" AXIS_PTS_REF ASDrf_trqClthBs_DST /end AXIS_DESCR
 /begin AXIS_DESCR COM_AXIS Epm_nEng EngN 8 -16384.00 16383.50 FORMAT "%8.2" AXIS_PTS_REF ASDrf_nEng_DST /end AXIS_DESCR
/end CHARACTERISTIC
/begin CHARACTERISTIC ASDrf_CoefBSprtNeg_GM "Coef B, Sport, neg. load alteration damping" MAP 0x8050B3AC RB_MapGroup_U8 2540. mdgrad_q10 10. 2550. FORMAT "%5.0" EXTENDED_LIMITS 0.00 2550.
 /begin AXIS_DESCR COM_AXIS ASDrf_tqCluBasc Trq 5 -3276.800 3276.700 FORMAT "%8.3" AXIS_PTS_REF ASDrf_trqClthBs_DST /end AXIS_DESCR
 /begin AXIS_DESCR COM_AXIS Epm_nEng EngN 8 -16384.00 16383.50 FORMAT "%8.2" AXIS_PTS_REF ASDrf_nEng_DST /end AXIS_DESCR
/end CHARACTERISTIC
/begin CHARACTERISTIC ASDrf_CoefBSprtPosAbvAcOn_GM "Coef B, Sport, pos. load alteration damping with AC on" MAP 0x8050B3D4 RB_MapGroup_U8 2540. mdgrad_q10 10. 2550. FORMAT "%5.0" EXTENDED_LIMITS 0.00 2550.
 /begin AXIS_DESCR COM_AXIS PT_rTrq TransR 8 -327.6800 327.6700 FORMAT "%8.4" AXIS_PTS_REF ASDrf_rTrq_DST /end AXIS_DESCR
 /begin AXIS_DESCR COM_AXIS Epm_nEng EngN 8 -16384.00 16383.50 FORMAT "%8.2" AXIS_PTS_REF ASDrf_nEng_DST /end AXIS_DESCR
/end CHARACTERISTIC
/begin CHARACTERISTIC ASDrf_CoefBSprtPosAbv_GM "Coef B, Sport, pos. load alteration damping" MAP 0x8050B414 RB_MapGroup_U8 2540. mdgrad_q10 10. 2550. FORMAT "%5.0" EXTENDED_LIMITS 0.00 2550.
 /begin AXIS_DESCR COM_AXIS PT_rTrq TransR 8 -327.6800 327.6700 FORMAT "%8.4" AXIS_PTS_REF ASDrf_rTrq_DST /end AXIS_DESCR
 /begin AXIS_DESCR COM_AXIS Epm_nEng EngN 8 -16384.00 16383.50 FORMAT "%8.2" AXIS_PTS_REF ASDrf_nEng_DST /end AXIS_DESCR
/end CHARACTERISTIC
/begin CHARACTERISTIC ASDrf_CoefBSprtPosBlwAcOn_GM "Coef B, Sport, pos. load alteration damping with AC on" MAP 0x8050B454 RB_MapGroup_U8 2550. mdgrad_q10 0.00 2550. FORMAT "%5.0"
 /begin AXIS_DESCR COM_AXIS PT_rTrq TransR 8 -327.6800 327.6700 FORMAT "%8.4" AXIS_PTS_REF ASDrf_rTrq_DST /end AXIS_DESCR
 /begin AXIS_DESCR COM_AXIS Epm_nEng EngN 8 -16384.00 16383.50 FORMAT "%8.2" AXIS_PTS_REF ASDrf_nEng_DST /end AXIS_DESCR
/end CHARACTERISTIC
/begin CHARACTERISTIC ASDrf_CoefBSprtPosBlw_GM "Coef B, Sport, pos. load alteration damping" MAP 0x8050B494 RB_MapGroup_U8 2550. mdgrad_q10 0.00 2550. FORMAT "%5.0"
 /begin AXIS_DESCR COM_AXIS PT_rTrq TransR 8 -327.6800 327.6700 FORMAT "%8.4" AXIS_PTS_REF ASDrf_rTrq_DST /end AXIS_DESCR
 /begin AXIS_DESCR COM_AXIS Epm_nEng EngN 8 -16384.00 16383.50 FORMAT "%8.2" AXIS_PTS_REF ASDrf_nEng_DST /end AXIS_DESCR
/end CHARACTERISTIC
/begin CHARACTERISTIC ASDrf_CoeffAEcoMtModNegAcOn_GT "coefficient A Eco Mode negative load alteration when AC is On" CURVE 0x8050B4D4 RB_CurveGroup_U8 15.94 q0p0625_DIV_Nm_s 0.00 15.94 FORMAT "%5.2"
 /begin AXIS_DESCR COM_AXIS PT_rTrq TransR 8 -327.6800 327.6700 FORMAT "%8.4" AXIS_PTS_REF ASDrf_rTrq_DST /end AXIS_DESCR
/end CHARACTERISTIC
/begin CHARACTERISTIC ASDrf_CoeffAEcoMtModPosAbvAcOn_GT "coefficient A Eco Mode positive load alteration when AC is On for above" CURVE 0x8050B4DC RB_CurveGroup_U8 15.94 q0p0625_DIV_Nm_s 0.00 15.94 FORMAT "%5.2"
 /begin AXIS_DESCR COM_AXIS PT_rTrq TransR 8 -327.6800 327.6700 FORMAT "%8.4" AXIS_PTS_REF ASDrf_rTrq_DST /end AXIS_DESCR
/end CHARACTERISTIC
/begin CHARACTERISTIC ASDrf_CoeffAEcoMtModPosBlwAcOn_GT "coefficient A Eco Mode positive load alteration when AC is On for below" CURVE 0x8050B4E4 RB_CurveGroup_U8 15.94 q0p0625_DIV_Nm_s 0.00 15.94 FORMAT "%5.2"
 /begin AXIS_DESCR COM_AXIS PT_rTrq TransR 8 -327.6800 327.6700 FORMAT "%8.4" AXIS_PTS_REF ASDrf_rTrq_DST /end AXIS_DESCR
/end CHARACTERISTIC
/begin CHARACTERISTIC ASDrf_CoeffAGripMtModNegAcOn_GT "coefficient A negative load alteration when AC is On" CURVE 0x8050B4EC RB_CurveGroup_U8 15.94 q0p0625_DIV_Nm_s 0.00 15.94 FORMAT "%5.2"
 /begin AXIS_DESCR COM_AXIS PT_rTrq TransR 8 -327.6800 327.6700 FORMAT "%8.4" AXIS_PTS_REF ASDrf_rTrq_DST /end AXIS_DESCR
/end CHARACTERISTIC
/begin CHARACTERISTIC ASDrf_CoeffAGripMtModPosAbvAcOn_GT "coefficient A, positive load alteration when AC is On for above" CURVE 0x8050B4F4 RB_CurveGroup_U8 15.94 q0p0625_DIV_Nm_s 0.00 15.94 FORMAT "%5.2"
 /begin AXIS_DESCR COM_AXIS PT_rTrq TransR 8 -327.6800 327.6700 FORMAT "%8.4" AXIS_PTS_REF ASDrf_rTrq_DST /end AXIS_DESCR
/end CHARACTERISTIC
/begin CHARACTERISTIC ASDrf_CoeffAGripMtModPosBlwAcOn_GT "coefficient A, positive load alteration when AC is On for below" CURVE 0x8050B4FC RB_CurveGroup_U8 15.94 q0p0625_DIV_Nm_s 0.00 15.94 FORMAT "%5.2"
 /begin AXIS_DESCR COM_AXIS PT_rTrq TransR 8 -327.6800 327.6700 FORMAT "%8.4" AXIS_PTS_REF ASDrf_rTrq_DST /end AXIS_DESCR
/end CHARACTERISTIC
/begin CHARACTERISTIC ASDrf_CoeffASptMtModNegAcOn_GT "coefficient A Sport Mode negative load alteration when AC is On" CURVE 0x8050B504 RB_CurveGroup_U8 15.94 q0p0625_DIV_Nm_s 0.00 15.94 FORMAT "%5.2"
 /begin AXIS_DESCR COM_AXIS PT_rTrq TransR 8 -327.6800 327.6700 FORMAT "%8.4" AXIS_PTS_REF ASDrf_rTrq_DST /end AXIS_DESCR
/end CHARACTERISTIC
/begin CHARACTERISTIC ASDrf_CoeffASptMtModPosAbvAcOn_GT "coefficient A Sport Mode positive load alteration when AC is On for above" CURVE 0x8050B50C RB_CurveGroup_U8 15.94 q0p0625_DIV_Nm_s 0.00 15.94 FORMAT "%5.2"
 /begin AXIS_DESCR COM_AXIS PT_rTrq TransR 8 -327.6800 327.6700 FORMAT "%8.4" AXIS_PTS_REF ASDrf_rTrq_DST /end AXIS_DESCR
/end CHARACTERISTIC
/begin CHARACTERISTIC ASDrf_CoeffASptMtModPosBlwAcOn_GT "coefficient A Sport Mode positive load alteration when AC is On for below" CURVE 0x8050B514 RB_CurveGroup_U8 15.94 q0p0625_DIV_Nm_s 0.00 15.94 FORMAT "%5.2"
 /begin AXIS_DESCR COM_AXIS PT_rTrq TransR 8 -327.6800 327.6700 FORMAT "%8.4" AXIS_PTS_REF ASDrf_rTrq_DST /end AXIS_DESCR
/end CHARACTERISTIC
/begin CHARACTERISTIC ASDrf_CoeffBEcoMtModNegAcOn_GM "coefficient B Eco Mode negative load alteration when AC is On" MAP 0x8050B51C RB_MapGroup_U8 2540. mdgrad_q10 10. 2550. FORMAT "%5.0" EXTENDED_LIMITS 0.00 2550.
 /begin AXIS_DESCR COM_AXIS ASDrf_tqCluBasc Trq 5 -3276.800 3276.700 FORMAT "%8.3" AXIS_PTS_REF ASDrf_trqClthBs_DST /end AXIS_DESCR
 /begin AXIS_DESCR COM_AXIS Epm_nEng EngN 8 -16384.00 16383.50 FORMAT "%8.2" AXIS_PTS_REF ASDrf_nEng_DST /end AXIS_DESCR
/end CHARACTERISTIC
/begin CHARACTERISTIC ASDrf_CoeffBEcoMtModPosAbvAcOn_GM "coefficient B Eco Mode positive load alteration when AC is On for above" MAP 0x8050B544 RB_MapGroup_U8 2540. mdgrad_q10 10. 2550. FORMAT "%5.0" EXTENDED_LIMITS 0.00 2550.
 /begin AXIS_DESCR COM_AXIS PT_rTrq TransR 8 -327.6800 327.6700 FORMAT "%8.4" AXIS_PTS_REF ASDrf_rTrq_DST /end AXIS_DESCR
 /begin AXIS_DESCR COM_AXIS Epm_nEng EngN 8 -16384.00 16383.50 FORMAT "%8.2" AXIS_PTS_REF ASDrf_nEng_DST /end AXIS_DESCR
/end CHARACTERISTIC
/begin CHARACTERISTIC ASDrf_CoeffBEcoMtModPosBlwAcOn_GM "coefficient B Eco Mode positive load alteration when AC is On for below" MAP 0x8050B584 RB_MapGroup_U8 2550. mdgrad_q10 0.00 2550. FORMAT "%5.0"
 /begin AXIS_DESCR COM_AXIS PT_rTrq TransR 8 -327.6800 327.6700 FORMAT "%8.4" AXIS_PTS_REF ASDrf_rTrq_DST /end AXIS_DESCR
 /begin AXIS_DESCR COM_AXIS Epm_nEng EngN 8 -16384.00 16383.50 FORMAT "%8.2" AXIS_PTS_REF ASDrf_nEng_DST /end AXIS_DESCR
/end CHARACTERISTIC
/begin CHARACTERISTIC ASDrf_CoeffBGripMtModNegAcOn_GM "coefficient B negative load alteration when AC is On" MAP 0x8050B5C4 RB_MapGroup_U8 2540. mdgrad_q10 10. 2550. FORMAT "%5.0" EXTENDED_LIMITS 0.00 2550.
 /begin AXIS_DESCR COM_AXIS ASDrf_tqCluBasc Trq 5 -3276.800 3276.700 FORMAT "%8.3" AXIS_PTS_REF ASDrf_trqClthBs_DST /end AXIS_DESCR
 /begin AXIS_DESCR COM_AXIS Epm_nEng EngN 8 -16384.00 16383.50 FORMAT "%8.2" AXIS_PTS_REF ASDrf_nEng_DST /end AXIS_DESCR
/end CHARACTERISTIC
/begin CHARACTERISTIC ASDrf_CoeffBGripMtModPosAbvAcOn_GM "coefficient B, positive load alteration when AC is On for above" MAP 0x8050B5EC RB_MapGroup_U8 2540. mdgrad_q10 10. 2550. FORMAT "%5.0" EXTENDED_LIMITS 0.00 2550.
 /begin AXIS_DESCR COM_AXIS PT_rTrq TransR 8 -327.6800 327.6700 FORMAT "%8.4" AXIS_PTS_REF ASDrf_rTrq_DST /end AXIS_DESCR
 /begin AXIS_DESCR COM_AXIS Epm_nEng EngN 8 -16384.00 16383.50 FORMAT "%8.2" AXIS_PTS_REF ASDrf_nEng_DST /end AXIS_DESCR
/end CHARACTERISTIC
/begin CHARACTERISTIC ASDrf_CoeffBGripMtModPosBlwAcOn_GM "coefficient B, positive load alteration when AC is On for below" MAP 0x8050B62C RB_MapGroup_U8 2550. mdgrad_q10 0.00 2550. FORMAT "%5.0"
 /begin AXIS_DESCR COM_AXIS PT_rTrq TransR 8 -327.6800 327.6700 FORMAT "%8.4" AXIS_PTS_REF ASDrf_rTrq_DST /end AXIS_DESCR
 /begin AXIS_DESCR COM_AXIS Epm_nEng EngN 8 -16384.00 16383.50 FORMAT "%8.2" AXIS_PTS_REF ASDrf_nEng_DST /end AXIS_DESCR
/end CHARACTERISTIC
/begin CHARACTERISTIC ASDrf_CoeffBSptMtModNegAcOn_GM "coefficient B Sport Mode negative load alteration when AC is On" MAP 0x8050B66C RB_MapGroup_U8 2540. mdgrad_q10 10. 2550. FORMAT "%5.0" EXTENDED_LIMITS 0.00 2550.
 /begin AXIS_DESCR COM_AXIS ASDrf_tqCluBasc Trq 5 -3276.800 3276.700 FORMAT "%8.3" AXIS_PTS_REF ASDrf_trqClthBs_DST /end AXIS_DESCR
 /begin AXIS_DESCR COM_AXIS Epm_nEng EngN 8 -16384.00 16383.50 FORMAT "%8.2" AXIS_PTS_REF ASDrf_nEng_DST /end AXIS_DESCR
/end CHARACTERISTIC
/begin CHARACTERISTIC ASDrf_CoeffBSptMtModPosAbvAcOn_GM "coefficient B Sport Mode positive load alteration when AC is On for above" MAP 0x8050B694 RB_MapGroup_U8 2540. mdgrad_q10 10. 2550. FORMAT "%5.0" EXTENDED_LIMITS 0.00 2550.
 /begin AXIS_DESCR COM_AXIS PT_rTrq TransR 8 -327.6800 327.6700 FORMAT "%8.4" AXIS_PTS_REF ASDrf_rTrq_DST /end AXIS_DESCR
 /begin AXIS_DESCR COM_AXIS Epm_nEng EngN 8 -16384.00 16383.50 FORMAT "%8.2" AXIS_PTS_REF ASDrf_nEng_DST /end AXIS_DESCR
/end CHARACTERISTIC
/begin CHARACTERISTIC ASDrf_CoeffBSptMtModPosBlwAcOn_GM "coefficient B Sport Mode positive load alteration when AC is On for below" MAP 0x8050B6D4 RB_MapGroup_U8 2550. mdgrad_q10 0.00 2550. FORMAT "%5.0"
 /begin AXIS_DESCR COM_AXIS PT_rTrq TransR 8 -327.6800 327.6700 FORMAT "%8.4" AXIS_PTS_REF ASDrf_rTrq_DST /end AXIS_DESCR
 /begin AXIS_DESCR COM_AXIS Epm_nEng EngN 8 -16384.00 16383.50 FORMAT "%8.2" AXIS_PTS_REF ASDrf_nEng_DST /end AXIS_DESCR
/end CHARACTERISTIC
/begin AXIS_PTS ASDrf_dnEngFlt_DST "gradient of engine speed" 0x8050B714 Epm_dnEngFlt RB_Axis_S16 32767.50 EngNGrd 6 -16384.00 16383.50 FORMAT "%8.2" DEPOSIT ABSOLUTE /end AXIS_PTS
/begin CHARACTERISTIC ASDrf_facCoefAEcoGripAirCdnrOnNeg_GT "weighting factor for Coef A ECO engine temperature dependent for AC on" CURVE 0x8050B722 RB_CurveGroup_U8 1.992188 fak_ub_b2 0.00 1.992188 FORMAT "%8.6"
 /begin AXIS_DESCR COM_AXIS EngDa_tEng Temp_Cels 6 -3549.940 3003.560 FORMAT "%8.3" AXIS_PTS_REF ASDrf_tEng_DST /end AXIS_DESCR
/end CHARACTERISTIC
/begin CHARACTERISTIC ASDrf_facCoefAEcoMtModPosAbv_GT "weighting for CoefA Eco, Manual transmission mode" CURVE 0x8050B728 RB_CurveGroup_U8 1.000000 fak_ub_b2 0.00 1.000000 FORMAT "%8.6" EXTENDED_LIMITS 0.00 1.992188
 /begin AXIS_DESCR COM_AXIS ASDrf_facDesDyn Fact 10 -4.000000 3.999878 FORMAT "%8.6" AXIS_PTS_REF ASDrf_facDesDyn_DST /end AXIS_DESCR
/end CHARACTERISTIC
/begin CHARACTERISTIC ASDrf_facCoefAEcoPosAbvAcOn_GT "Eco mode factor for Coef-A during AC On" CURVE 0x8050B732 RB_CurveGroup_U8 1.000000 fak_ub_b2 0.00 1.000000 FORMAT "%8.6" EXTENDED_LIMITS 0.00 1.992188
 /begin AXIS_DESCR COM_AXIS ASDrf_facDesDyn Fact 10 -4.000000 3.999878 FORMAT "%8.6" AXIS_PTS_REF ASDrf_facDesDyn_DST /end AXIS_DESCR
/end CHARACTERISTIC
/begin CHARACTERISTIC ASDrf_facCoefAEcoPosAbv_GT "Eco mode factor for Coef-A" CURVE 0x8050B73C RB_CurveGroup_U8 1.000000 fak_ub_b2 0.00 1.000000 FORMAT "%8.6" EXTENDED_LIMITS 0.00 1.992188
 /begin AXIS_DESCR COM_AXIS ASDrf_facDesDyn Fact 10 -4.000000 3.999878 FORMAT "%8.6" AXIS_PTS_REF ASDrf_facDesDyn_DST /end AXIS_DESCR
/end CHARACTERISTIC
/begin CHARACTERISTIC ASDrf_facCoefAGripAirCdnrOnNeg_GT "weighting factor for Coef A engine temperature dependent for AC on" CURVE 0x8050B746 RB_CurveGroup_U8 1.992188 fak_ub_b2 0.00 1.992188 FORMAT "%8.6"
 /begin AXIS_DESCR COM_AXIS EngDa_tEng Temp_Cels 6 -3549.940 3003.560 FORMAT "%8.3" AXIS_PTS_REF ASDrf_tEng_DST /end AXIS_DESCR
/end CHARACTERISTIC
/begin CHARACTERISTIC ASDrf_facCoefAGripNeg_GT "weighting factor for Coef A engine temperature dependent" CURVE 0x8050B74C RB_CurveGroup_U8 1.992188 fak_ub_b2 0.00 1.992188 FORMAT "%8.6"
 /begin AXIS_DESCR COM_AXIS EngDa_tEng Temp_Cels 6 -3549.940 3003.560 FORMAT "%8.3" AXIS_PTS_REF ASDrf_tEng_DST /end AXIS_DESCR
/end CHARACTERISTIC
/begin CHARACTERISTIC ASDrf_facCoefAMtModPosAbv_GT "weighting for CoefA, manual transmission mode, pos" CURVE 0x8050B752 RB_CurveGroup_U8 1.000000 fak_ub_b2 0.00 1.000000 FORMAT "%8.6" EXTENDED_LIMITS 0.00 1.992188
 /begin AXIS_DESCR COM_AXIS ASDrf_facDesDyn Fact 10 -4.000000 3.999878 FORMAT "%8.6" AXIS_PTS_REF ASDrf_facDesDyn_DST /end AXIS_DESCR
/end CHARACTERISTIC
/begin CHARACTERISTIC ASDrf_facCoefAPosAbvAcOn_GCUR "weighting for CoefA during AC On" CURVE 0x8050B75C RB_CurveGroup_U8 1.000000 fak_ub_b2 0.00 1.000000 FORMAT "%8.6" EXTENDED_LIMITS 0.00 1.992188
 /begin AXIS_DESCR COM_AXIS ASDrf_facDesDyn Fact 10 -4.000000 3.999878 FORMAT "%8.6" AXIS_PTS_REF ASDrf_facDesDyn_DST /end AXIS_DESCR
/end CHARACTERISTIC
/begin CHARACTERISTIC ASDrf_facCoefAPosAbv_GCUR "weighting for CoefA" CURVE 0x8050B766 RB_CurveGroup_U8 1.000000 fak_ub_b2 0.00 1.000000 FORMAT "%8.6" EXTENDED_LIMITS 0.00 1.992188
 /begin AXIS_DESCR COM_AXIS ASDrf_facDesDyn Fact 10 -4.000000 3.999878 FORMAT "%8.6" AXIS_PTS_REF ASDrf_facDesDyn_DST /end AXIS_DESCR
/end CHARACTERISTIC
/begin CHARACTERISTIC ASDrf_facCoefASprtMtModPosAbv_GT "weighting for CoefA Sport, Manual transmission mode" CURVE 0x8050B770 RB_CurveGroup_U8 1.000000 fak_ub_b2 0.00 1.000000 FORMAT "%8.6" EXTENDED_LIMITS 0.00 1.992188
 /begin AXIS_DESCR COM_AXIS ASDrf_facDesDyn Fact 10 -4.000000 3.999878 FORMAT "%8.6" AXIS_PTS_REF ASDrf_facDesDyn_DST /end AXIS_DESCR
/end CHARACTERISTIC
/begin CHARACTERISTIC ASDrf_facCoefASprtPosAbvAcOn_GT "weighting for CoefA Sport with AC on" CURVE 0x8050B77A RB_CurveGroup_U8 1.000000 fak_ub_b2 0.00 1.000000 FORMAT "%8.6" EXTENDED_LIMITS 0.00 1.992188
 /begin AXIS_DESCR COM_AXIS ASDrf_facDesDyn Fact 10 -4.000000 3.999878 FORMAT "%8.6" AXIS_PTS_REF ASDrf_facDesDyn_DST /end AXIS_DESCR
/end CHARACTERISTIC
/begin CHARACTERISTIC ASDrf_facCoefASprtPosAbv_GT "weighting for CoefA Sport" CURVE 0x8050B784 RB_CurveGroup_U8 1.000000 fak_ub_b2 0.00 1.000000 FORMAT "%8.6" EXTENDED_LIMITS 0.00 1.992188
 /begin AXIS_DESCR COM_AXIS ASDrf_facDesDyn Fact 10 -4.000000 3.999878 FORMAT "%8.6" AXIS_PTS_REF ASDrf_facDesDyn_DST /end AXIS_DESCR
/end CHARACTERISTIC
/begin CHARACTERISTIC ASDrf_facCoefBAirCdnrOnNeg_GT "weighting factor for Coef B for AC on" CURVE 0x8050B78E RB_CurveGroup_U8 7.969 fak_ub_b8 0.00 7.969 FORMAT "%5.3"
 /begin AXIS_DESCR COM_AXIS PT_rTrq TransR 8 -327.6800 327.6700 FORMAT "%8.4" AXIS_PTS_REF ASDrf_rTrq_DST /end AXIS_DESCR
/end CHARACTERISTIC
/begin CHARACTERISTIC ASDrf_facCoefBEcoAirCdnrOnNeg_GT "weighting factor for Coef B ECO for AC on" CURVE 0x8050B796 RB_CurveGroup_U8 7.969 fak_ub_b8 0.00 7.969 FORMAT "%5.3"
 /begin AXIS_DESCR COM_AXIS PT_rTrq TransR 8 -327.6800 327.6700 FORMAT "%8.4" AXIS_PTS_REF ASDrf_rTrq_DST /end AXIS_DESCR
/end CHARACTERISTIC
/begin CHARACTERISTIC ASDrf_facCoefBEcoGripAirCdnrOnNeg_GT "weighting factor for Coef B ECO engine temperature dependent for AC on" CURVE 0x8050B79E RB_CurveGroup_U8 1.992188 fak_ub_b2 0.00 1.992188 FORMAT "%8.6"
 /begin AXIS_DESCR COM_AXIS EngDa_tEng Temp_Cels 6 -3549.940 3003.560 FORMAT "%8.3" AXIS_PTS_REF ASDrf_tEng_DST /end AXIS_DESCR
/end CHARACTERISTIC
/begin CHARACTERISTIC ASDrf_facCoefBEcoMtModNeg_GT "weighting factor for Coef B Eco, Manual transmission mode" CURVE 0x8050B7A4 RB_CurveGroup_U8 7.969 fak_ub_b8 0.00 7.969 FORMAT "%5.3"
 /begin AXIS_DESCR COM_AXIS PT_rTrq TransR 8 -327.6800 327.6700 FORMAT "%8.4" AXIS_PTS_REF ASDrf_rTrq_DST /end AXIS_DESCR
/end CHARACTERISTIC
/begin CHARACTERISTIC ASDrf_facCoefBEcoMtModPosAbv_GM "weighting factor Coef B, Eco Manual transmission mode, pos. load alteration damping" MAP 0x8050B7AC RB_MapGroup_U8 1.000000 fak_ub_b2 0.00 1.000000 FORMAT "%8.6" EXTENDED_LIMITS 0.00 1.992188
 /begin AXIS_DESCR COM_AXIS ASDrf_facDesDyn Fact 10 -4.000000 3.999878 FORMAT "%8.6" AXIS_PTS_REF ASDrf_facDesDyn_DST /end AXIS_DESCR
 /begin AXIS_DESCR COM_AXIS Epm_nEng EngN 8 -16384.00 16383.50 FORMAT "%8.2" AXIS_PTS_REF ASDrf_nEng_DST /end AXIS_DESCR
/end CHARACTERISTIC
/begin CHARACTERISTIC ASDrf_facCoefBEcoMtModPosBlw_GM "weighting factor Coef B, Eco, Manual transmission mode, pos. load alteration damping" MAP 0x8050B7FC RB_MapGroup_U8 1.000000 fak_ub_b2 0.00 1.000000 FORMAT "%8.6" EXTENDED_LIMITS 0.00 1.992188
 /begin AXIS_DESCR COM_AXIS ASDrf_facDesDyn Fact 10 -4.000000 3.999878 FORMAT "%8.6" AXIS_PTS_REF ASDrf_facDesDyn_DST /end AXIS_DESCR
 /begin AXIS_DESCR COM_AXIS Epm_nEng EngN 8 -16384.00 16383.50 FORMAT "%8.2" AXIS_PTS_REF ASDrf_nEng_DST /end AXIS_DESCR
/end CHARACTERISTIC
/begin CHARACTERISTIC ASDrf_facCoefBEcoNeg_GT "Eco mode factor for Coef-B" CURVE 0x8050B84C RB_CurveGroup_U8 7.969 fak_ub_b8 0.00 7.969 FORMAT "%5.3"
 /begin AXIS_DESCR COM_AXIS PT_rTrq TransR 8 -327.6800 327.6700 FORMAT "%8.4" AXIS_PTS_REF ASDrf_rTrq_DST /end AXIS_DESCR
/end CHARACTERISTIC
/begin CHARACTERISTIC ASDrf_facCoefBEcoPosAbvAcOn_GM "Eco mode factor for Coef-A during AC On" MAP 0x8050B854 RB_MapGroup_U8 1.000000 fak_ub_b2 0.00 1.000000 FORMAT "%8.6" EXTENDED_LIMITS 0.00 1.992188
 /begin AXIS_DESCR COM_AXIS ASDrf_facDesDyn Fact 10 -4.000000 3.999878 FORMAT "%8.6" AXIS_PTS_REF ASDrf_facDesDyn_DST /end AXIS_DESCR
 /begin AXIS_DESCR COM_AXIS Epm_nEng EngN 8 -16384.00 16383.50 FORMAT "%8.2" AXIS_PTS_REF ASDrf_nEng_DST /end AXIS_DESCR
/end CHARACTERISTIC
/begin CHARACTERISTIC ASDrf_facCoefBEcoPosAbv_GM "Eco mode factor for Coef-A" MAP 0x8050B8A4 RB_MapGroup_U8 1.000000 fak_ub_b2 0.00 1.000000 FORMAT "%8.6" EXTENDED_LIMITS 0.00 1.992188
 /begin AXIS_DESCR COM_AXIS ASDrf_facDesDyn Fact 10 -4.000000 3.999878 FORMAT "%8.6" AXIS_PTS_REF ASDrf_facDesDyn_DST /end AXIS_DESCR
 /begin AXIS_DESCR COM_AXIS Epm_nEng EngN 8 -16384.00 16383.50 FORMAT "%8.2" AXIS_PTS_REF ASDrf_nEng_DST /end AXIS_DESCR
/end CHARACTERISTIC
/begin CHARACTERISTIC ASDrf_facCoefBEcoPosBlwAcOn_GM "Eco mode factor for Coef-A during AC On" MAP 0x8050B8F4 RB_MapGroup_U8 1.000000 fak_ub_b2 0.00 1.000000 FORMAT "%8.6" EXTENDED_LIMITS 0.00 1.992188
 /begin AXIS_DESCR COM_AXIS ASDrf_facDesDyn Fact 10 -4.000000 3.999878 FORMAT "%8.6" AXIS_PTS_REF ASDrf_facDesDyn_DST /end AXIS_DESCR
 /begin AXIS_DESCR COM_AXIS Epm_nEng EngN 8 -16384.00 16383.50 FORMAT "%8.2" AXIS_PTS_REF ASDrf_nEng_DST /end AXIS_DESCR
/end CHARACTERISTIC
/begin CHARACTERISTIC ASDrf_facCoefBEcoPosBlw_GM "Eco mode factor for Coef-A" MAP 0x8050B944 RB_MapGroup_U8 1.000000 fak_ub_b2 0.00 1.000000 FORMAT "%8.6" EXTENDED_LIMITS 0.00 1.992188
 /begin AXIS_DESCR COM_AXIS ASDrf_facDesDyn Fact 10 -4.000000 3.999878 FORMAT "%8.6" AXIS_PTS_REF ASDrf_facDesDyn_DST /end AXIS_DESCR
 /begin AXIS_DESCR COM_AXIS Epm_nEng EngN 8 -16384.00 16383.50 FORMAT "%8.2" AXIS_PTS_REF ASDrf_nEng_DST /end AXIS_DESCR
/end CHARACTERISTIC
/begin CHARACTERISTIC ASDrf_facCoefBGripAirCdnrOnNeg_GT "weighting factor for Coef B engine temperature dependent for AC on" CURVE 0x8050B994 RB_CurveGroup_U8 1.992188 fak_ub_b2 0.00 1.992188 FORMAT "%8.6"
 /begin AXIS_DESCR COM_AXIS EngDa_tEng Temp_Cels 6 -3549.940 3003.560 FORMAT "%8.3" AXIS_PTS_REF ASDrf_tEng_DST /end AXIS_DESCR
/end CHARACTERISTIC
/begin CHARACTERISTIC ASDrf_facCoefBGripNeg_GT "weighting factor for Coef B engine temperature dependent" CURVE 0x8050B99A RB_CurveGroup_U8 1.992188 fak_ub_b2 0.00 1.992188 FORMAT "%8.6"
 /begin AXIS_DESCR COM_AXIS EngDa_tEng Temp_Cels 6 -3549.940 3003.560 FORMAT "%8.3" AXIS_PTS_REF ASDrf_tEng_DST /end AXIS_DESCR
/end CHARACTERISTIC
/begin CHARACTERISTIC ASDrf_facCoefBMtModNeg_GT "weighting factor Coef B, manual transmission mode, neg" CURVE 0x8050B9A0 RB_CurveGroup_U8 7.969 fak_ub_b8 0.00 7.969 FORMAT "%5.3"
 /begin AXIS_DESCR COM_AXIS PT_rTrq TransR 8 -327.6800 327.6700 FORMAT "%8.4" AXIS_PTS_REF ASDrf_rTrq_DST /end AXIS_DESCR
/end CHARACTERISTIC
/begin CHARACTERISTIC ASDrf_facCoefBMtModPosAbv_GM "weighting factor Coef B, manual transmission mode, pos. load alteration damping" MAP 0x8050B9A8 RB_MapGroup_U8 1.000000 fak_ub_b2 0.00 1.000000 FORMAT "%8.6" EXTENDED_LIMITS 0.00 1.992188
 /begin AXIS_DESCR COM_AXIS ASDrf_facDesDyn Fact 10 -4.000000 3.999878 FORMAT "%8.6" AXIS_PTS_REF ASDrf_facDesDyn_DST /end AXIS_DESCR
 /begin AXIS_DESCR COM_AXIS Epm_nEng EngN 8 -16384.00 16383.50 FORMAT "%8.2" AXIS_PTS_REF ASDrf_nEng_DST /end AXIS_DESCR
/end CHARACTERISTIC
/begin CHARACTERISTIC ASDrf_facCoefBMtModPosBlw_GM "weighting factor Coef B, manual transmission mode, pos. load alteration damping" MAP 0x8050B9F8 RB_MapGroup_U8 1.000000 fak_ub_b2 0.00 1.000000 FORMAT "%8.6" EXTENDED_LIMITS 0.00 1.992188
 /begin AXIS_DESCR COM_AXIS ASDrf_facDesDyn Fact 10 -4.000000 3.999878 FORMAT "%8.6" AXIS_PTS_REF ASDrf_facDesDyn_DST /end AXIS_DESCR
 /begin AXIS_DESCR COM_AXIS Epm_nEng EngN 8 -16384.00 16383.50 FORMAT "%8.2" AXIS_PTS_REF ASDrf_nEng_DST /end AXIS_DESCR
/end CHARACTERISTIC
/begin CHARACTERISTIC ASDrf_facCoefBNeg_GCUR "weighting factor for Coef B" CURVE 0x8050BA48 RB_CurveGroup_U8 7.969 fak_ub_b8 0.00 7.969 FORMAT "%5.3"
 /begin AXIS_DESCR COM_AXIS PT_rTrq TransR 8 -327.6800 327.6700 FORMAT "%8.4" AXIS_PTS_REF ASDrf_rTrq_DST /end AXIS_DESCR
/end CHARACTERISTIC
/begin CHARACTERISTIC ASDrf_facCoefBPosAbvAcOn_GMAP "weighting factor Coef B, pos. load alteration damping during AC On" MAP 0x8050BA50 RB_MapGroup_U8 1.000000 fak_ub_b2 0.00 1.000000 FORMAT "%8.6" EXTENDED_LIMITS 0.00 1.992188
 /begin AXIS_DESCR COM_AXIS ASDrf_facDesDyn Fact 10 -4.000000 3.999878 FORMAT "%8.6" AXIS_PTS_REF ASDrf_facDesDyn_DST /end AXIS_DESCR
 /begin AXIS_DESCR COM_AXIS Epm_nEng EngN 8 -16384.00 16383.50 FORMAT "%8.2" AXIS_PTS_REF ASDrf_nEng_DST /end AXIS_DESCR
/end CHARACTERISTIC
/begin CHARACTERISTIC ASDrf_facCoefBPosAbv_GMAP "weighting factor Coef B, pos. load alteration damping" MAP 0x8050BAA0 RB_MapGroup_U8 1.000000 fak_ub_b2 0.00 1.000000 FORMAT "%8.6" EXTENDED_LIMITS 0.00 1.992188
 /begin AXIS_DESCR COM_AXIS ASDrf_facDesDyn Fact 10 -4.000000 3.999878 FORMAT "%8.6" AXIS_PTS_REF ASDrf_facDesDyn_DST /end AXIS_DESCR
 /begin AXIS_DESCR COM_AXIS ASDrf_nPt EngN 8 -16384.00 16383.50 FORMAT "%8.2" AXIS_PTS_REF ASDrf_nPt_DST /end AXIS_DESCR
/end CHARACTERISTIC
/begin CHARACTERISTIC ASDrf_facCoefBPosBlwAcOn_GMAP "weighting factor Coef B, pos. load alteration damping during AC On" MAP 0x8050BAF0 RB_MapGroup_U8 1.000000 fak_ub_b2 0.00 1.000000 FORMAT "%8.6" EXTENDED_LIMITS 0.00 1.992188
 /begin AXIS_DESCR COM_AXIS ASDrf_facDesDyn Fact 10 -4.000000 3.999878 FORMAT "%8.6" AXIS_PTS_REF ASDrf_facDesDyn_DST /end AXIS_DESCR
 /begin AXIS_DESCR COM_AXIS Epm_nEng EngN 8 -16384.00 16383.50 FORMAT "%8.2" AXIS_PTS_REF ASDrf_nEng_DST /end AXIS_DESCR
/end CHARACTERISTIC
/begin CHARACTERISTIC ASDrf_facCoefBPosBlw_GMAP "weighting factor Coef B, pos. load alteration damping" MAP 0x8050BB40 RB_MapGroup_U8 1.000000 fak_ub_b2 0.00 1.000000 FORMAT "%8.6" EXTENDED_LIMITS 0.00 1.992188
 /begin AXIS_DESCR COM_AXIS ASDrf_facDesDyn Fact 10 -4.000000 3.999878 FORMAT "%8.6" AXIS_PTS_REF ASDrf_facDesDyn_DST /end AXIS_DESCR
 /begin AXIS_DESCR COM_AXIS ASDrf_nPt EngN 8 -16384.00 16383.50 FORMAT "%8.2" AXIS_PTS_REF ASDrf_nPt_DST /end AXIS_DESCR
/end CHARACTERISTIC
/begin CHARACTERISTIC ASDrf_facCoefBSprtMtModNeg_GT "weighting factor for Coef B Sport, Manual transmission mode" CURVE 0x8050BB90 RB_CurveGroup_U8 7.969 fak_ub_b8 0.00 7.969 FORMAT "%5.3"
 /begin AXIS_DESCR COM_AXIS PT_rTrq TransR 8 -327.6800 327.6700 FORMAT "%8.4" AXIS_PTS_REF ASDrf_rTrq_DST /end AXIS_DESCR
/end CHARACTERISTIC
/begin CHARACTERISTIC ASDrf_facCoefBSprtMtModPosAbv_GM "weighting factor Coef B, Sport, Manual transmission mode, pos. load alteration damping" MAP 0x8050BB98 RB_MapGroup_U8 1.000000 fak_ub_b2 0.00 1.000000 FORMAT "%8.6" EXTENDED_LIMITS 0.00 1.992188
 /begin AXIS_DESCR COM_AXIS ASDrf_facDesDyn Fact 10 -4.000000 3.999878 FORMAT "%8.6" AXIS_PTS_REF ASDrf_facDesDyn_DST /end AXIS_DESCR
 /begin AXIS_DESCR COM_AXIS Epm_nEng EngN 8 -16384.00 16383.50 FORMAT "%8.2" AXIS_PTS_REF ASDrf_nEng_DST /end AXIS_DESCR
/end CHARACTERISTIC
/begin CHARACTERISTIC ASDrf_facCoefBSprtMtModPosBlw_GM "weighting factor Coef B, Sport, Manual transmission mode, pos. load alteration damping" MAP 0x8050BBE8 RB_MapGroup_U8 1.000000 fak_ub_b2 0.00 1.000000 FORMAT "%8.6" EXTENDED_LIMITS 0.00 1.992188
 /begin AXIS_DESCR COM_AXIS ASDrf_facDesDyn Fact 10 -4.000000 3.999878 FORMAT "%8.6" AXIS_PTS_REF ASDrf_facDesDyn_DST /end AXIS_DESCR
 /begin AXIS_DESCR COM_AXIS Epm_nEng EngN 8 -16384.00 16383.50 FORMAT "%8.2" AXIS_PTS_REF ASDrf_nEng_DST /end AXIS_DESCR
/end CHARACTERISTIC
/begin CHARACTERISTIC ASDrf_facCoefBSprtNegAcOn_GT "weighting factor for Coef B Sport with AC on" CURVE 0x8050BC38 RB_CurveGroup_U8 7.969 fak_ub_b8 0.00 7.969 FORMAT "%5.3"
 /begin AXIS_DESCR COM_AXIS PT_rTrq TransR 8 -327.6800 327.6700 FORMAT "%8.4" AXIS_PTS_REF ASDrf_rTrq_DST /end AXIS_DESCR
/end CHARACTERISTIC
/begin CHARACTERISTIC ASDrf_facCoefBSprtNeg_GT "weighting factor for Coef B Sport" CURVE 0x8050BC40 RB_CurveGroup_U8 7.969 fak_ub_b8 0.00 7.969 FORMAT "%5.3"
 /begin AXIS_DESCR COM_AXIS PT_rTrq TransR 8 -327.6800 327.6700 FORMAT "%8.4" AXIS_PTS_REF ASDrf_rTrq_DST /end AXIS_DESCR
/end CHARACTERISTIC
/begin CHARACTERISTIC ASDrf_facCoefBSprtPosAbvAcOn_GM "weighting factor Coef B, Sport, pos. load alteration damping with AC on" MAP 0x8050BC48 RB_MapGroup_U8 1.000000 fak_ub_b2 0.00 1.000000 FORMAT "%8.6" EXTENDED_LIMITS 0.00 1.992188
 /begin AXIS_DESCR COM_AXIS ASDrf_facDesDyn Fact 10 -4.000000 3.999878 FORMAT "%8.6" AXIS_PTS_REF ASDrf_facDesDyn_DST /end AXIS_DESCR
 /begin AXIS_DESCR COM_AXIS Epm_nEng EngN 8 -16384.00 16383.50 FORMAT "%8.2" AXIS_PTS_REF ASDrf_nEng_DST /end AXIS_DESCR
/end CHARACTERISTIC
/begin CHARACTERISTIC ASDrf_facCoefBSprtPosAbv_GM "weighting factor Coef B, Sport, pos. load alteration damping" MAP 0x8050BC98 RB_MapGroup_U8 1.000000 fak_ub_b2 0.00 1.000000 FORMAT "%8.6" EXTENDED_LIMITS 0.00 1.992188
 /begin AXIS_DESCR COM_AXIS ASDrf_facDesDyn Fact 10 -4.000000 3.999878 FORMAT "%8.6" AXIS_PTS_REF ASDrf_facDesDyn_DST /end AXIS_DESCR
 /begin AXIS_DESCR COM_AXIS Epm_nEng EngN 8 -16384.00 16383.50 FORMAT "%8.2" AXIS_PTS_REF ASDrf_nEng_DST /end AXIS_DESCR
/end CHARACTERISTIC
/begin CHARACTERISTIC ASDrf_facCoefBSprtPosBlwAcOn_GM "weighting factor Coef B, Sport, pos. load alteration damping with AC on" MAP 0x8050BCE8 RB_MapGroup_U8 1.000000 fak_ub_b2 0.00 1.000000 FORMAT "%8.6" EXTENDED_LIMITS 0.00 1.992188
 /begin AXIS_DESCR COM_AXIS ASDrf_facDesDyn Fact 10 -4.000000 3.999878 FORMAT "%8.6" AXIS_PTS_REF ASDrf_facDesDyn_DST /end AXIS_DESCR
 /begin AXIS_DESCR COM_AXIS Epm_nEng EngN 8 -16384.00 16383.50 FORMAT "%8.2" AXIS_PTS_REF ASDrf_nEng_DST /end AXIS_DESCR
/end CHARACTERISTIC
/begin CHARACTERISTIC ASDrf_facCoefBSprtPosBlw_GM "weighting factor Coef B, Sport, pos. load alteration damping" MAP 0x8050BD38 RB_MapGroup_U8 1.000000 fak_ub_b2 0.00 1.000000 FORMAT "%8.6" EXTENDED_LIMITS 0.00 1.992188
 /begin AXIS_DESCR COM_AXIS ASDrf_facDesDyn Fact 10 -4.000000 3.999878 FORMAT "%8.6" AXIS_PTS_REF ASDrf_facDesDyn_DST /end AXIS_DESCR
 /begin AXIS_DESCR COM_AXIS Epm_nEng EngN 8 -16384.00 16383.50 FORMAT "%8.2" AXIS_PTS_REF ASDrf_nEng_DST /end AXIS_DESCR
/end CHARACTERISTIC
/begin CHARACTERISTIC ASDrf_facCoeffAEcoMtModPosAbvAcOn_GT "weighting factor for coefficient A, ECO mode positive load alteration when AC is On for above" CURVE 0x8050BD88 RB_CurveGroup_U8 1.000000 fak_ub_b2 0.00 1.000000 FORMAT "%8.6" EXTENDED_LIMITS 0.00 1.992188
 /begin AXIS_DESCR COM_AXIS ASDrf_facDesDyn Fact 10 -4.000000 3.999878 FORMAT "%8.6" AXIS_PTS_REF ASDrf_facDesDyn_DST /end AXIS_DESCR
/end CHARACTERISTIC
/begin CHARACTERISTIC ASDrf_facCoeffAMtModPosAbvAcOn_GT "weighting factor for coefficient A, positive load alteration when AC is On for above" CURVE 0x8050BD92 RB_CurveGroup_U8 1.000000 fak_ub_b2 0.00 1.000000 FORMAT "%8.6" EXTENDED_LIMITS 0.00 1.992188
 /begin AXIS_DESCR COM_AXIS ASDrf_facDesDyn Fact 10 -4.000000 3.999878 FORMAT "%8.6" AXIS_PTS_REF ASDrf_facDesDyn_DST /end AXIS_DESCR
/end CHARACTERISTIC
/begin CHARACTERISTIC ASDrf_facCoeffASptMtModPosAbvAcOn_GT "weighting factor for coefficient A, Sport mode positive load alteration when AC isOn for above" CURVE 0x8050BD9C RB_CurveGroup_U8 1.000000 fak_ub_b2 0.00 1.000000 FORMAT "%8.6" EXTENDED_LIMITS 0.00 1.992188
 /begin AXIS_DESCR COM_AXIS ASDrf_facDesDyn Fact 10 -4.000000 3.999878 FORMAT "%8.6" AXIS_PTS_REF ASDrf_facDesDyn_DST /end AXIS_DESCR
/end CHARACTERISTIC
/begin CHARACTERISTIC ASDrf_facCoeffBEcoMtModNegAcOn_GT "weighting factor for coefficient B,Eco mode negative load alteration when AC is On" CURVE 0x8050BDA6 RB_CurveGroup_U8 7.969 fak_ub_b8 0.00 7.969 FORMAT "%5.3"
 /begin AXIS_DESCR COM_AXIS PT_rTrq TransR 8 -327.6800 327.6700 FORMAT "%8.4" AXIS_PTS_REF ASDrf_rTrq_DST /end AXIS_DESCR
/end CHARACTERISTIC
/begin CHARACTERISTIC ASDrf_facCoeffBEcoMtModPosAbvAcOn_GM "weighting factor for coefficient B, Eco mode positive load alteration when AC is On for above" MAP 0x8050BDAE RB_MapGroup_U8 1.000000 fak_ub_b2 0.00 1.000000 FORMAT "%8.6" EXTENDED_LIMITS 0.00 1.992188
 /begin AXIS_DESCR COM_AXIS ASDrf_facDesDyn Fact 10 -4.000000 3.999878 FORMAT "%8.6" AXIS_PTS_REF ASDrf_facDesDyn_DST /end AXIS_DESCR
 /begin AXIS_DESCR COM_AXIS Epm_nEng EngN 8 -16384.00 16383.50 FORMAT "%8.2" AXIS_PTS_REF ASDrf_nEng_DST /end AXIS_DESCR
/end CHARACTERISTIC
/begin CHARACTERISTIC ASDrf_facCoeffBEcoMtModPosBlwAcOn_GM "weighting factor for coefficient B, Eco mode positive load alteration when AC is On for below" MAP 0x8050BDFE RB_MapGroup_U8 1.000000 fak_ub_b2 0.00 1.000000 FORMAT "%8.6" EXTENDED_LIMITS 0.00 1.992188
 /begin AXIS_DESCR COM_AXIS ASDrf_facDesDyn Fact 10 -4.000000 3.999878 FORMAT "%8.6" AXIS_PTS_REF ASDrf_facDesDyn_DST /end AXIS_DESCR
 /begin AXIS_DESCR COM_AXIS Epm_nEng EngN 8 -16384.00 16383.50 FORMAT "%8.2" AXIS_PTS_REF ASDrf_nEng_DST /end AXIS_DESCR
/end CHARACTERISTIC
/begin CHARACTERISTIC ASDrf_facCoeffBMtModNegAcOn_GT "weighting factor for coefficient B, negative load alteration when AC is On" CURVE 0x8050BE4E RB_CurveGroup_U8 7.969 fak_ub_b8 0.00 7.969 FORMAT "%5.3"
 /begin AXIS_DESCR COM_AXIS PT_rTrq TransR 8 -327.6800 327.6700 FORMAT "%8.4" AXIS_PTS_REF ASDrf_rTrq_DST /end AXIS_DESCR
/end CHARACTERISTIC
/begin CHARACTERISTIC ASDrf_facCoeffBMtModPosAbvAcOn_GM "weighting factor for coefficient B, positive load alteration when AC is On for above" MAP 0x8050BE56 RB_MapGroup_U8 1.000000 fak_ub_b2 0.00 1.000000 FORMAT "%8.6" EXTENDED_LIMITS 0.00 1.992188
 /begin AXIS_DESCR COM_AXIS ASDrf_facDesDyn Fact 10 -4.000000 3.999878 FORMAT "%8.6" AXIS_PTS_REF ASDrf_facDesDyn_DST /end AXIS_DESCR
 /begin AXIS_DESCR COM_AXIS Epm_nEng EngN 8 -16384.00 16383.50 FORMAT "%8.2" AXIS_PTS_REF ASDrf_nEng_DST /end AXIS_DESCR
/end CHARACTERISTIC
/begin CHARACTERISTIC ASDrf_facCoeffBMtModPosBlwAcOn_GM "weighting factor for coefficient B, positive load alteration when AC is On for below" MAP 0x8050BEA6 RB_MapGroup_U8 1.000000 fak_ub_b2 0.00 1.000000 FORMAT "%8.6" EXTENDED_LIMITS 0.00 1.992188
 /begin AXIS_DESCR COM_AXIS ASDrf_facDesDyn Fact 10 -4.000000 3.999878 FORMAT "%8.6" AXIS_PTS_REF ASDrf_facDesDyn_DST /end AXIS_DESCR
 /begin AXIS_DESCR COM_AXIS Epm_nEng EngN 8 -16384.00 16383.50 FORMAT "%8.2" AXIS_PTS_REF ASDrf_nEng_DST /end AXIS_DESCR
/end CHARACTERISTIC
/begin CHARACTERISTIC ASDrf_facCoeffBSptMtModNegAcOn_GT "weighting factor for coefficient B, sport mode negative load alteration when AC is On" CURVE 0x8050BEF6 RB_CurveGroup_U8 7.969 fak_ub_b8 0.00 7.969 FORMAT "%5.3"
 /begin AXIS_DESCR COM_AXIS PT_rTrq TransR 8 -327.6800 327.6700 FORMAT "%8.4" AXIS_PTS_REF ASDrf_rTrq_DST /end AXIS_DESCR
/end CHARACTERISTIC
/begin CHARACTERISTIC ASDrf_facCoeffBSptMtModPosAbvAcOn_GM "weighting factor for coefficient B, sport mode positive load alteration when AC is On for above" MAP 0x8050BEFE RB_MapGroup_U8 1.000000 fak_ub_b2 0.00 1.000000 FORMAT "%8.6" EXTENDED_LIMITS 0.00 1.992188
 /begin AXIS_DESCR COM_AXIS ASDrf_facDesDyn Fact 10 -4.000000 3.999878 FORMAT "%8.6" AXIS_PTS_REF ASDrf_facDesDyn_DST /end AXIS_DESCR
 /begin AXIS_DESCR COM_AXIS Epm_nEng EngN 8 -16384.00 16383.50 FORMAT "%8.2" AXIS_PTS_REF ASDrf_nEng_DST /end AXIS_DESCR
/end CHARACTERISTIC
/begin CHARACTERISTIC ASDrf_facCoeffBSptMtModPosBlwAcOn_GM "weighting factor for coefficient B, sport mode positive load alteration when AC is On for below" MAP 0x8050BF4E RB_MapGroup_U8 1.000000 fak_ub_b2 0.00 1.000000 FORMAT "%8.6" EXTENDED_LIMITS 0.00 1.992188
 /begin AXIS_DESCR COM_AXIS ASDrf_facDesDyn Fact 10 -4.000000 3.999878 FORMAT "%8.6" AXIS_PTS_REF ASDrf_facDesDyn_DST /end AXIS_DESCR
 /begin AXIS_DESCR COM_AXIS Epm_nEng EngN 8 -16384.00 16383.50 FORMAT "%8.2" AXIS_PTS_REF ASDrf_nEng_DST /end AXIS_DESCR
/end CHARACTERISTIC
/begin AXIS_PTS ASDrf_facDesDyn_DST "driveability factor" 0x8050BF9E ASDrf_facDesDyn RB_Axis_S16 7.999878 Fact 10 -4.000000 3.999878 FORMAT "%8.6" DEPOSIT ABSOLUTE /end AXIS_PTS
/begin CHARACTERISTIC ASDrf_facTiAirCdnrOnNeg_GT "weighting factor time constant, negative load alteration damping for AC on" CURVE 0x8050BFB4 RB_CurveGroup_U8 7.969 fak_ub_b8 0.00 7.969 FORMAT "%5.3"
 /begin AXIS_DESCR COM_AXIS PT_rTrq TransR 8 -327.6800 327.6700 FORMAT "%8.4" AXIS_PTS_REF ASDrf_rTrq_DST /end AXIS_DESCR
/end CHARACTERISTIC
/begin CHARACTERISTIC ASDrf_facTiEcoAirCdnrOnNeg_GT "weighting factor time constant, ECO, negative load alteration damping for AC on" CURVE 0x8050BFBC RB_CurveGroup_U8 7.969 fak_ub_b8 0.00 7.969 FORMAT "%5.3"
 /begin AXIS_DESCR COM_AXIS PT_rTrq TransR 8 -327.6800 327.6700 FORMAT "%8.4" AXIS_PTS_REF ASDrf_rTrq_DST /end AXIS_DESCR
/end CHARACTERISTIC
/begin CHARACTERISTIC ASDrf_facTiEcoMtModNegAcOn_GT "time constant, Eco mode negative load alteration when AC is On" CURVE 0x8050BFC4 RB_CurveGroup_U8 7.969 fak_ub_b8 0.00 7.969 FORMAT "%5.3"
 /begin AXIS_DESCR COM_AXIS PT_rTrq TransR 8 -327.6800 327.6700 FORMAT "%8.4" AXIS_PTS_REF ASDrf_rTrq_DST /end AXIS_DESCR
/end CHARACTERISTIC
/begin CHARACTERISTIC ASDrf_facTiEcoMtModNeg_GT "weighting factor time constant, Eco , Manual transmission mode, negative load alteration damping" CURVE 0x8050BFCC RB_CurveGroup_U8 7.969 fak_ub_b8 0.00 7.969 FORMAT "%5.3"
 /begin AXIS_DESCR COM_AXIS PT_rTrq TransR 8 -327.6800 327.6700 FORMAT "%8.4" AXIS_PTS_REF ASDrf_rTrq_DST /end AXIS_DESCR
/end CHARACTERISTIC
/begin CHARACTERISTIC ASDrf_facTiEcoMtModPosAbvAcOn_GM "time constant, Eco mode positive load alteration when AC is On for above" MAP 0x8050BFD4 RB_MapGroup_U8 14.94 fak_ub_b16 1.00 15.94 FORMAT "%5.2" EXTENDED_LIMITS 0.00 15.94
 /begin AXIS_DESCR COM_AXIS ASDrf_facDesDyn Fact 10 -4.000000 3.999878 FORMAT "%8.6" AXIS_PTS_REF ASDrf_facDesDyn_DST /end AXIS_DESCR
 /begin AXIS_DESCR COM_AXIS Epm_nEng EngN 8 -16384.00 16383.50 FORMAT "%8.2" AXIS_PTS_REF ASDrf_nEng_DST /end AXIS_DESCR
/end CHARACTERISTIC
/begin CHARACTERISTIC ASDrf_facTiEcoMtModPosAbv_GM "weighting factor time constant, Eco, Manual transmission mode, pos. load alteration damping" MAP 0x8050C024 RB_MapGroup_U8 14.94 fak_ub_b16 1.00 15.94 FORMAT "%5.2" EXTENDED_LIMITS 0.00 15.94
 /begin AXIS_DESCR COM_AXIS ASDrf_facDesDyn Fact 10 -4.000000 3.999878 FORMAT "%8.6" AXIS_PTS_REF ASDrf_facDesDyn_DST /end AXIS_DESCR
 /begin AXIS_DESCR COM_AXIS Epm_nEng EngN 8 -16384.00 16383.50 FORMAT "%8.2" AXIS_PTS_REF ASDrf_nEng_DST /end AXIS_DESCR
/end CHARACTERISTIC
/begin CHARACTERISTIC ASDrf_facTiEcoMtModPosBlwAcOn_GM "time constant, Eco mode positive load alteration when AC is On for below" MAP 0x8050C074 RB_MapGroup_U8 14.94 fak_ub_b16 1.00 15.94 FORMAT "%5.2" EXTENDED_LIMITS 0.00 15.94
 /begin AXIS_DESCR COM_AXIS ASDrf_facDesDyn Fact 10 -4.000000 3.999878 FORMAT "%8.6" AXIS_PTS_REF ASDrf_facDesDyn_DST /end AXIS_DESCR
 /begin AXIS_DESCR COM_AXIS Epm_nEng EngN 8 -16384.00 16383.50 FORMAT "%8.2" AXIS_PTS_REF ASDrf_nEng_DST /end AXIS_DESCR
/end CHARACTERISTIC
/begin CHARACTERISTIC ASDrf_facTiEcoMtModPosBlw_GM "weighting factor time constant, Eco, Manual transmission mode, pos. load alteration damping" MAP 0x8050C0C4 RB_MapGroup_U8 14.94 fak_ub_b16 1.00 15.94 FORMAT "%5.2" EXTENDED_LIMITS 0.00 15.94
 /begin AXIS_DESCR COM_AXIS ASDrf_facDesDyn Fact 10 -4.000000 3.999878 FORMAT "%8.6" AXIS_PTS_REF ASDrf_facDesDyn_DST /end AXIS_DESCR
 /begin AXIS_DESCR COM_AXIS Epm_nEng EngN 8 -16384.00 16383.50 FORMAT "%8.2" AXIS_PTS_REF ASDrf_nEng_DST /end AXIS_DESCR
/end CHARACTERISTIC
/begin CHARACTERISTIC ASDrf_facTiEcoNeg_GT "Eco mode time constant" CURVE 0x8050C114 RB_CurveGroup_U8 7.969 fak_ub_b8 0.00 7.969 FORMAT "%5.3"
 /begin AXIS_DESCR COM_AXIS PT_rTrq TransR 8 -327.6800 327.6700 FORMAT "%8.4" AXIS_PTS_REF ASDrf_rTrq_DST /end AXIS_DESCR
/end CHARACTERISTIC
/begin CHARACTERISTIC ASDrf_facTiEcoPosAbvAcOn_GM "Eco mode time const during AC On" MAP 0x8050C11C RB_MapGroup_U8 14.94 fak_ub_b16 1.00 15.94 FORMAT "%5.2" EXTENDED_LIMITS 0.00 15.94
 /begin AXIS_DESCR COM_AXIS ASDrf_facDesDyn Fact 10 -4.000000 3.999878 FORMAT "%8.6" AXIS_PTS_REF ASDrf_facDesDyn_DST /end AXIS_DESCR
 /begin AXIS_DESCR COM_AXIS Epm_nEng EngN 8 -16384.00 16383.50 FORMAT "%8.2" AXIS_PTS_REF ASDrf_nEng_DST /end AXIS_DESCR
/end CHARACTERISTIC
/begin CHARACTERISTIC ASDrf_facTiEcoPosAbv_GM "Eco mode time const" MAP 0x8050C16C RB_MapGroup_U8 14.94 fak_ub_b16 1.00 15.94 FORMAT "%5.2" EXTENDED_LIMITS 0.00 15.94
 /begin AXIS_DESCR COM_AXIS ASDrf_facDesDyn Fact 10 -4.000000 3.999878 FORMAT "%8.6" AXIS_PTS_REF ASDrf_facDesDyn_DST /end AXIS_DESCR
 /begin AXIS_DESCR COM_AXIS Epm_nEng EngN 8 -16384.00 16383.50 FORMAT "%8.2" AXIS_PTS_REF ASDrf_nEng_DST /end AXIS_DESCR
/end CHARACTERISTIC
/begin CHARACTERISTIC ASDrf_facTiEcoPosBlwAcOn_GM "Eco mode time const during AC On" MAP 0x8050C1BC RB_MapGroup_U8 14.94 fak_ub_b16 1.00 15.94 FORMAT "%5.2" EXTENDED_LIMITS 0.00 15.94
 /begin AXIS_DESCR COM_AXIS ASDrf_facDesDyn Fact 10 -4.000000 3.999878 FORMAT "%8.6" AXIS_PTS_REF ASDrf_facDesDyn_DST /end AXIS_DESCR
 /begin AXIS_DESCR COM_AXIS Epm_nEng EngN 8 -16384.00 16383.50 FORMAT "%8.2" AXIS_PTS_REF ASDrf_nEng_DST /end AXIS_DESCR
/end CHARACTERISTIC
/begin CHARACTERISTIC ASDrf_facTiEcoPosBlw_GM "Eco mode time const" MAP 0x8050C20C RB_MapGroup_U8 14.94 fak_ub_b16 1.00 15.94 FORMAT "%5.2" EXTENDED_LIMITS 0.00 15.94
 /begin AXIS_DESCR COM_AXIS ASDrf_facDesDyn Fact 10 -4.000000 3.999878 FORMAT "%8.6" AXIS_PTS_REF ASDrf_facDesDyn_DST /end AXIS_DESCR
 /begin AXIS_DESCR COM_AXIS Epm_nEng EngN 8 -16384.00 16383.50 FORMAT "%8.2" AXIS_PTS_REF ASDrf_nEng_DST /end AXIS_DESCR
/end CHARACTERISTIC
/begin CHARACTERISTIC ASDrf_facTiFltSetEcoGripAirCdnrOnNeg_GT "weighting factor time constant, ECO, engine temperature dependent for AC on" CURVE 0x8050C25C RB_CurveGroup_U8 1.992188 fak_ub_b2 0.00 1.992188 FORMAT "%8.6"
 /begin AXIS_DESCR COM_AXIS EngDa_tEng Temp_Cels 6 -3549.940 3003.560 FORMAT "%8.3" AXIS_PTS_REF ASDrf_tEng_DST /end AXIS_DESCR
/end CHARACTERISTIC
/begin CHARACTERISTIC ASDrf_facTiFltSetGripAirCdnrOnNeg_GT "weighting factor time constant engine temperature dependent for AC on" CURVE 0x8050C262 RB_CurveGroup_U8 1.992188 fak_ub_b2 0.00 1.992188 FORMAT "%8.6"
 /begin AXIS_DESCR COM_AXIS EngDa_tEng Temp_Cels 6 -3549.940 3003.560 FORMAT "%8.3" AXIS_PTS_REF ASDrf_tEng_DST /end AXIS_DESCR
/end CHARACTERISTIC
/begin CHARACTERISTIC ASDrf_facTiFltSetGripNeg_GT "weighting factor time constant engine temperature dependent" CURVE 0x8050C268 RB_CurveGroup_U8 1.992188 fak_ub_b2 0.00 1.992188 FORMAT "%8.6"
 /begin AXIS_DESCR COM_AXIS EngDa_tEng Temp_Cels 6 -3549.940 3003.560 FORMAT "%8.3" AXIS_PTS_REF ASDrf_tEng_DST /end AXIS_DESCR
/end CHARACTERISTIC
/begin CHARACTERISTIC ASDrf_facTiMtModNegAcOn_GT "time constant, negative load alteration when AC is On" CURVE 0x8050C26E RB_CurveGroup_U8 7.969 fak_ub_b8 0.00 7.969 FORMAT "%5.3"
 /begin AXIS_DESCR COM_AXIS PT_rTrq TransR 8 -327.6800 327.6700 FORMAT "%8.4" AXIS_PTS_REF ASDrf_rTrq_DST /end AXIS_DESCR
/end CHARACTERISTIC
/begin CHARACTERISTIC ASDrf_facTiMtModNeg_GT "weighting factor time constant manual transmission mode neg." CURVE 0x8050C276 RB_CurveGroup_U8 7.969 fak_ub_b8 0.00 7.969 FORMAT "%5.3"
 /begin AXIS_DESCR COM_AXIS PT_rTrq TransR 8 -327.6800 327.6700 FORMAT "%8.4" AXIS_PTS_REF ASDrf_rTrq_DST /end AXIS_DESCR
/end CHARACTERISTIC
/begin CHARACTERISTIC ASDrf_facTiMtModPosAbvAcOn_GM "time constant, positive load alteration when AC is On for above" MAP 0x8050C27E RB_MapGroup_U8 14.94 fak_ub_b16 1.00 15.94 FORMAT "%5.2" EXTENDED_LIMITS 0.00 15.94
 /begin AXIS_DESCR COM_AXIS ASDrf_facDesDyn Fact 10 -4.000000 3.999878 FORMAT "%8.6" AXIS_PTS_REF ASDrf_facDesDyn_DST /end AXIS_DESCR
 /begin AXIS_DESCR COM_AXIS Epm_nEng EngN 8 -16384.00 16383.50 FORMAT "%8.2" AXIS_PTS_REF ASDrf_nEng_DST /end AXIS_DESCR
/end CHARACTERISTIC
/begin CHARACTERISTIC ASDrf_facTiMtModPosAbv_GM "weighting factor time constant, manual transmission mode, pos. load alteration damping" MAP 0x8050C2CE RB_MapGroup_U8 14.94 fak_ub_b16 1.00 15.94 FORMAT "%5.2" EXTENDED_LIMITS 0.00 15.94
 /begin AXIS_DESCR COM_AXIS ASDrf_facDesDyn Fact 10 -4.000000 3.999878 FORMAT "%8.6" AXIS_PTS_REF ASDrf_facDesDyn_DST /end AXIS_DESCR
 /begin AXIS_DESCR COM_AXIS Epm_nEng EngN 8 -16384.00 16383.50 FORMAT "%8.2" AXIS_PTS_REF ASDrf_nEng_DST /end AXIS_DESCR
/end CHARACTERISTIC
/begin CHARACTERISTIC ASDrf_facTiMtModPosBlwAcOn_GM "time constant, positive load alteration when AC is On for below" MAP 0x8050C31E RB_MapGroup_U8 14.94 fak_ub_b16 1.00 15.94 FORMAT "%5.2" EXTENDED_LIMITS 0.00 15.94
 /begin AXIS_DESCR COM_AXIS ASDrf_facDesDyn Fact 10 -4.000000 3.999878 FORMAT "%8.6" AXIS_PTS_REF ASDrf_facDesDyn_DST /end AXIS_DESCR
 /begin AXIS_DESCR COM_AXIS Epm_nEng EngN 8 -16384.00 16383.50 FORMAT "%8.2" AXIS_PTS_REF ASDrf_nEng_DST /end AXIS_DESCR
/end CHARACTERISTIC
/begin CHARACTERISTIC ASDrf_facTiMtModPosBlw_GM "weighting factor time constant, manual transmission mode, pos. load alteration damping" MAP 0x8050C36E RB_MapGroup_U8 14.94 fak_ub_b16 1.00 15.94 FORMAT "%5.2" EXTENDED_LIMITS 0.00 15.94
 /begin AXIS_DESCR COM_AXIS ASDrf_facDesDyn Fact 10 -4.000000 3.999878 FORMAT "%8.6" AXIS_PTS_REF ASDrf_facDesDyn_DST /end AXIS_DESCR
 /begin AXIS_DESCR COM_AXIS Epm_nEng EngN 8 -16384.00 16383.50 FORMAT "%8.2" AXIS_PTS_REF ASDrf_nEng_DST /end AXIS_DESCR
/end CHARACTERISTIC
/begin CHARACTERISTIC ASDrf_facTiNeg_GCUR "weighting factor time constant, negative load alteration damping" CURVE 0x8050C3BE RB_CurveGroup_U8 7.969 fak_ub_b8 0.00 7.969 FORMAT "%5.3"
 /begin AXIS_DESCR COM_AXIS PT_rTrq TransR 8 -327.6800 327.6700 FORMAT "%8.4" AXIS_PTS_REF ASDrf_rTrq_DST /end AXIS_DESCR
/end CHARACTERISTIC
/begin CHARACTERISTIC ASDrf_facTiPosAbvAcOn_GMAP "weighting factor time constant pos. load alteration damping during AC On" MAP 0x8050C3C6 RB_MapGroup_U8 14.94 fak_ub_b16 1.00 15.94 FORMAT "%5.2" EXTENDED_LIMITS 0.00 15.94
 /begin AXIS_DESCR COM_AXIS ASDrf_facDesDyn Fact 10 -4.000000 3.999878 FORMAT "%8.6" AXIS_PTS_REF ASDrf_facDesDyn_DST /end AXIS_DESCR
 /begin AXIS_DESCR COM_AXIS Epm_nEng EngN 8 -16384.00 16383.50 FORMAT "%8.2" AXIS_PTS_REF ASDrf_nEng_DST /end AXIS_DESCR
/end CHARACTERISTIC
/begin CHARACTERISTIC ASDrf_facTiPosAbv_GMAP "weighting factor time constant pos. load alteration damping" MAP 0x8050C416 RB_MapGroup_U8 14.94 fak_ub_b16 1.00 15.94 FORMAT "%5.2" EXTENDED_LIMITS 0.00 15.94
 /begin AXIS_DESCR COM_AXIS ASDrf_facDesDyn Fact 10 -4.000000 3.999878 FORMAT "%8.6" AXIS_PTS_REF ASDrf_facDesDyn_DST /end AXIS_DESCR
 /begin AXIS_DESCR COM_AXIS ASDrf_nPt EngN 8 -16384.00 16383.50 FORMAT "%8.2" AXIS_PTS_REF ASDrf_nPt_DST /end AXIS_DESCR
/end CHARACTERISTIC
/begin CHARACTERISTIC ASDrf_facTiPosBlwAcOn_GMAP "weighting factor time constant pos. load alteration damping during AC On" MAP 0x8050C466 RB_MapGroup_U8 14.94 fak_ub_b16 1.00 15.94 FORMAT "%5.2" EXTENDED_LIMITS 0.00 15.94
 /begin AXIS_DESCR COM_AXIS ASDrf_facDesDyn Fact 10 -4.000000 3.999878 FORMAT "%8.6" AXIS_PTS_REF ASDrf_facDesDyn_DST /end AXIS_DESCR
 /begin AXIS_DESCR COM_AXIS Epm_nEng EngN 8 -16384.00 16383.50 FORMAT "%8.2" AXIS_PTS_REF ASDrf_nEng_DST /end AXIS_DESCR
/end CHARACTERISTIC
/begin CHARACTERISTIC ASDrf_facTiPosBlw_GMAP "weighting factor time constant pos. load alteration damping" MAP 0x8050C4B6 RB_MapGroup_U8 14.94 fak_ub_b16 1.00 15.94 FORMAT "%5.2" EXTENDED_LIMITS 0.00 15.94
 /begin AXIS_DESCR COM_AXIS ASDrf_facDesDyn Fact 10 -4.000000 3.999878 FORMAT "%8.6" AXIS_PTS_REF ASDrf_facDesDyn_DST /end AXIS_DESCR
 /begin AXIS_DESCR COM_AXIS ASDrf_nPt EngN 8 -16384.00 16383.50 FORMAT "%8.2" AXIS_PTS_REF ASDrf_nPt_DST /end AXIS_DESCR
/end CHARACTERISTIC
/begin CHARACTERISTIC ASDrf_facTiSprtMtModNeg_GT "weighting factor time constant, Sport, Manual transmission mode, negative load alteration damping" CURVE 0x8050C506 RB_CurveGroup_U8 7.969 fak_ub_b8 0.00 7.969 FORMAT "%5.3"
 /begin AXIS_DESCR COM_AXIS PT_rTrq TransR 8 -327.6800 327.6700 FORMAT "%8.4" AXIS_PTS_REF ASDrf_rTrq_DST /end AXIS_DESCR
/end CHARACTERISTIC
/begin CHARACTERISTIC ASDrf_facTiSprtMtModPosAbv_GM "weighting factor time constant, Sport, Manual transmission mode, pos. load alteration damping" MAP 0x8050C50E RB_MapGroup_U8 14.94 fak_ub_b16 1.00 15.94 FORMAT "%5.2" EXTENDED_LIMITS 0.00 15.94
 /begin AXIS_DESCR COM_AXIS ASDrf_facDesDyn Fact 10 -4.000000 3.999878 FORMAT "%8.6" AXIS_PTS_REF ASDrf_facDesDyn_DST /end AXIS_DESCR
 /begin AXIS_DESCR COM_AXIS Epm_nEng EngN 8 -16384.00 16383.50 FORMAT "%8.2" AXIS_PTS_REF ASDrf_nEng_DST /end AXIS_DESCR
/end CHARACTERISTIC
/begin CHARACTERISTIC ASDrf_facTiSprtMtModPosBlw_GM "weighting factor time constant, Sport, Manual transmission mode, pos. load alteration damping" MAP 0x8050C55E RB_MapGroup_U8 14.94 fak_ub_b16 1.00 15.94 FORMAT "%5.2" EXTENDED_LIMITS 0.00 15.94
 /begin AXIS_DESCR COM_AXIS ASDrf_facDesDyn Fact 10 -4.000000 3.999878 FORMAT "%8.6" AXIS_PTS_REF ASDrf_facDesDyn_DST /end AXIS_DESCR
 /begin AXIS_DESCR COM_AXIS Epm_nEng EngN 8 -16384.00 16383.50 FORMAT "%8.2" AXIS_PTS_REF ASDrf_nEng_DST /end AXIS_DESCR
/end CHARACTERISTIC
/begin CHARACTERISTIC ASDrf_facTiSprtNegAcOn_GT "weighting factor time constant, Sport , negative load alteration damping with AC on" CURVE 0x8050C5AE RB_CurveGroup_U8 7.969 fak_ub_b8 0.00 7.969 FORMAT "%5.3"
 /begin AXIS_DESCR COM_AXIS PT_rTrq TransR 8 -327.6800 327.6700 FORMAT "%8.4" AXIS_PTS_REF ASDrf_rTrq_DST /end AXIS_DESCR
/end CHARACTERISTIC
/begin CHARACTERISTIC ASDrf_facTiSprtNeg_GT "weighting factor time constant, Sport , negative load alteration damping" CURVE 0x8050C5B6 RB_CurveGroup_U8 7.969 fak_ub_b8 0.00 7.969 FORMAT "%5.3"
 /begin AXIS_DESCR COM_AXIS PT_rTrq TransR 8 -327.6800 327.6700 FORMAT "%8.4" AXIS_PTS_REF ASDrf_rTrq_DST /end AXIS_DESCR
/end CHARACTERISTIC
/begin CHARACTERISTIC ASDrf_facTiSprtPosAbvAcOn_GM "weighting factor time constant, Sport, pos. load alteration damping with AC on" MAP 0x8050C5BE RB_MapGroup_U8 14.94 fak_ub_b16 1.00 15.94 FORMAT "%5.2" EXTENDED_LIMITS 0.00 15.94
 /begin AXIS_DESCR COM_AXIS ASDrf_facDesDyn Fact 10 -4.000000 3.999878 FORMAT "%8.6" AXIS_PTS_REF ASDrf_facDesDyn_DST /end AXIS_DESCR
 /begin AXIS_DESCR COM_AXIS Epm_nEng EngN 8 -16384.00 16383.50 FORMAT "%8.2" AXIS_PTS_REF ASDrf_nEng_DST /end AXIS_DESCR
/end CHARACTERISTIC
/begin CHARACTERISTIC ASDrf_facTiSprtPosAbv_GM "weighting factor time constant, Sport, pos. load alteration damping" MAP 0x8050C60E RB_MapGroup_U8 14.94 fak_ub_b16 1.00 15.94 FORMAT "%5.2" EXTENDED_LIMITS 0.00 15.94
 /begin AXIS_DESCR COM_AXIS ASDrf_facDesDyn Fact 10 -4.000000 3.999878 FORMAT "%8.6" AXIS_PTS_REF ASDrf_facDesDyn_DST /end AXIS_DESCR
 /begin AXIS_DESCR COM_AXIS Epm_nEng EngN 8 -16384.00 16383.50 FORMAT "%8.2" AXIS_PTS_REF ASDrf_nEng_DST /end AXIS_DESCR
/end CHARACTERISTIC
/begin CHARACTERISTIC ASDrf_facTiSprtPosBlwAcOn_GM "weighting factor time constant, Sport, pos. load alteration damping with AC on" MAP 0x8050C65E RB_MapGroup_U8 14.94 fak_ub_b16 1.00 15.94 FORMAT "%5.2" EXTENDED_LIMITS 0.00 15.94
 /begin AXIS_DESCR COM_AXIS ASDrf_facDesDyn Fact 10 -4.000000 3.999878 FORMAT "%8.6" AXIS_PTS_REF ASDrf_facDesDyn_DST /end AXIS_DESCR
 /begin AXIS_DESCR COM_AXIS Epm_nEng EngN 8 -16384.00 16383.50 FORMAT "%8.2" AXIS_PTS_REF ASDrf_nEng_DST /end AXIS_DESCR
/end CHARACTERISTIC
/begin CHARACTERISTIC ASDrf_facTiSprtPosBlw_GM "weighting factor time constant, Sport, pos. load alteration damping" MAP 0x8050C6AE RB_MapGroup_U8 14.94 fak_ub_b16 1.00 15.94 FORMAT "%5.2" EXTENDED_LIMITS 0.00 15.94
 /begin AXIS_DESCR COM_AXIS ASDrf_facDesDyn Fact 10 -4.000000 3.999878 FORMAT "%8.6" AXIS_PTS_REF ASDrf_facDesDyn_DST /end AXIS_DESCR
 /begin AXIS_DESCR COM_AXIS Epm_nEng EngN 8 -16384.00 16383.50 FORMAT "%8.2" AXIS_PTS_REF ASDrf_nEng_DST /end AXIS_DESCR
/end CHARACTERISTIC
/begin CHARACTERISTIC ASDrf_facTiSptMtModNegAcOn_GT "time constant, sport mode negative load alteration when AC is On" CURVE 0x8050C6FE RB_CurveGroup_U8 7.969 fak_ub_b8 0.00 7.969 FORMAT "%5.3"
 /begin AXIS_DESCR COM_AXIS PT_rTrq TransR 8 -327.6800 327.6700 FORMAT "%8.4" AXIS_PTS_REF ASDrf_rTrq_DST /end AXIS_DESCR
/end CHARACTERISTIC
/begin CHARACTERISTIC ASDrf_facTiSptMtModPosAbvAcOn_GM "time constant, sport mode positive load alteration when AC is On for above" MAP 0x8050C706 RB_MapGroup_U8 14.94 fak_ub_b16 1.00 15.94 FORMAT "%5.2" EXTENDED_LIMITS 0.00 15.94
 /begin AXIS_DESCR COM_AXIS ASDrf_facDesDyn Fact 10 -4.000000 3.999878 FORMAT "%8.6" AXIS_PTS_REF ASDrf_facDesDyn_DST /end AXIS_DESCR
 /begin AXIS_DESCR COM_AXIS Epm_nEng EngN 8 -16384.00 16383.50 FORMAT "%8.2" AXIS_PTS_REF ASDrf_nEng_DST /end AXIS_DESCR
/end CHARACTERISTIC
/begin CHARACTERISTIC ASDrf_facTiSptMtModPosBlwAcOn_GM "time constant, sport mode positive load alteration when AC is On for below" MAP 0x8050C756 RB_MapGroup_U8 14.94 fak_ub_b16 1.00 15.94 FORMAT "%5.2" EXTENDED_LIMITS 0.00 15.94
 /begin AXIS_DESCR COM_AXIS ASDrf_facDesDyn Fact 10 -4.000000 3.999878 FORMAT "%8.6" AXIS_PTS_REF ASDrf_facDesDyn_DST /end AXIS_DESCR
 /begin AXIS_DESCR COM_AXIS Epm_nEng EngN 8 -16384.00 16383.50 FORMAT "%8.2" AXIS_PTS_REF ASDrf_nEng_DST /end AXIS_DESCR
/end CHARACTERISTIC
/begin CHARACTERISTIC ASDrf_KdFilSetEcoAirCdnrOnNeg_GM "unfiltered part, Eco , neg. load alteration damping with AC on" MAP 0x8050C7A6 RB_MapGroup_U8 1.000000 fak_ub_b2 0.00 1.000000 FORMAT "%8.6" EXTENDED_LIMITS 0.00 1.992188
 /begin AXIS_DESCR COM_AXIS PT_rTrq TransR 8 -327.6800 327.6700 FORMAT "%8.4" AXIS_PTS_REF ASDrf_rTrq_DST /end AXIS_DESCR
 /begin AXIS_DESCR COM_AXIS Epm_nEng EngN 8 -16384.00 16383.50 FORMAT "%8.2" AXIS_PTS_REF ASDrf_nEng_DST /end AXIS_DESCR
/end CHARACTERISTIC
/begin CHARACTERISTIC ASDrf_KdFilSetEcoMtModNegAcOn_GM "infiltered part, Eco Mode negative load alteration when AC is On" MAP 0x8050C7E6 RB_MapGroup_U8 1.000000 fak_ub_b2 0.00 1.000000 FORMAT "%8.6" EXTENDED_LIMITS 0.00 1.992188
 /begin AXIS_DESCR COM_AXIS PT_rTrq TransR 8 -327.6800 327.6700 FORMAT "%8.4" AXIS_PTS_REF ASDrf_rTrq_DST /end AXIS_DESCR
 /begin AXIS_DESCR COM_AXIS Epm_nEng EngN 8 -16384.00 16383.50 FORMAT "%8.2" AXIS_PTS_REF ASDrf_nEng_DST /end AXIS_DESCR
/end CHARACTERISTIC
/begin CHARACTERISTIC ASDrf_KdFilSetEcoMtModNeg_GM "unfiltered part, eco, Manual transmission mode, neg. load alteration damping" MAP 0x8050C826 RB_MapGroup_U8 1.000000 fak_ub_b2 0.00 1.000000 FORMAT "%8.6" EXTENDED_LIMITS 0.00 1.992188
 /begin AXIS_DESCR COM_AXIS PT_rTrq TransR 8 -327.6800 327.6700 FORMAT "%8.4" AXIS_PTS_REF ASDrf_rTrq_DST /end AXIS_DESCR
 /begin AXIS_DESCR COM_AXIS Epm_nEng EngN 8 -16384.00 16383.50 FORMAT "%8.2" AXIS_PTS_REF ASDrf_nEng_DST /end AXIS_DESCR
/end CHARACTERISTIC
/begin CHARACTERISTIC ASDrf_KdFilSetEcoMtModPosAbvAcOn_GM "infiltered part, Eco Mode positive load alteration when AC is On for above" MAP 0x8050C866 RB_MapGroup_U8 1.000000 fak_ub_b2 0.00 1.000000 FORMAT "%8.6" EXTENDED_LIMITS 0.00 1.992188
 /begin AXIS_DESCR COM_AXIS PT_rTrq TransR 8 -327.6800 327.6700 FORMAT "%8.4" AXIS_PTS_REF ASDrf_rTrq_DST /end AXIS_DESCR
 /begin AXIS_DESCR COM_AXIS Epm_nEng EngN 8 -16384.00 16383.50 FORMAT "%8.2" AXIS_PTS_REF ASDrf_nEng_DST /end AXIS_DESCR
/end CHARACTERISTIC
/begin CHARACTERISTIC ASDrf_KdFilSetEcoMtModPosAbv_GM "unfiltered part, Eco, Manual transmission mode, pos. load alteration damping" MAP 0x8050C8A6 RB_MapGroup_U8 1.000000 fak_ub_b2 0.00 1.000000 FORMAT "%8.6" EXTENDED_LIMITS 0.00 1.992188
 /begin AXIS_DESCR COM_AXIS PT_rTrq TransR 8 -327.6800 327.6700 FORMAT "%8.4" AXIS_PTS_REF ASDrf_rTrq_DST /end AXIS_DESCR
 /begin AXIS_DESCR COM_AXIS Epm_nEng EngN 8 -16384.00 16383.50 FORMAT "%8.2" AXIS_PTS_REF ASDrf_nEng_DST /end AXIS_DESCR
/end CHARACTERISTIC
/begin CHARACTERISTIC ASDrf_KdFilSetEcoNeg_GM "unfiltered part, Eco , neg. load alteration damping" MAP 0x8050C8E6 RB_MapGroup_U8 1.000000 fak_ub_b2 0.00 1.000000 FORMAT "%8.6" EXTENDED_LIMITS 0.00 1.992188
 /begin AXIS_DESCR COM_AXIS PT_rTrq TransR 8 -327.6800 327.6700 FORMAT "%8.4" AXIS_PTS_REF ASDrf_rTrq_DST /end AXIS_DESCR
 /begin AXIS_DESCR COM_AXIS Epm_nEng EngN 8 -16384.00 16383.50 FORMAT "%8.2" AXIS_PTS_REF ASDrf_nEng_DST /end AXIS_DESCR
/end CHARACTERISTIC
/begin CHARACTERISTIC ASDrf_KdFilSetEcoPosAbvAcOn_GM "unfiltered part, Eco, pos. load alteration damping during AC On" MAP 0x8050C926 RB_MapGroup_U8 1.000000 fak_ub_b2 0.00 1.000000 FORMAT "%8.6" EXTENDED_LIMITS 0.00 1.992188
 /begin AXIS_DESCR COM_AXIS PT_rTrq TransR 8 -327.6800 327.6700 FORMAT "%8.4" AXIS_PTS_REF ASDrf_rTrq_DST /end AXIS_DESCR
 /begin AXIS_DESCR COM_AXIS Epm_nEng EngN 8 -16384.00 16383.50 FORMAT "%8.2" AXIS_PTS_REF ASDrf_nEng_DST /end AXIS_DESCR
/end CHARACTERISTIC
/begin CHARACTERISTIC ASDrf_KdFilSetEcoPosAbv_GM "unfiltered part, Eco, pos. load alteration damping" MAP 0x8050C966 RB_MapGroup_U8 1.000000 fak_ub_b2 0.00 1.000000 FORMAT "%8.6" EXTENDED_LIMITS 0.00 1.992188
 /begin AXIS_DESCR COM_AXIS PT_rTrq TransR 8 -327.6800 327.6700 FORMAT "%8.4" AXIS_PTS_REF ASDrf_rTrq_DST /end AXIS_DESCR
 /begin AXIS_DESCR COM_AXIS Epm_nEng EngN 8 -16384.00 16383.50 FORMAT "%8.2" AXIS_PTS_REF ASDrf_nEng_DST /end AXIS_DESCR
/end CHARACTERISTIC
/begin CHARACTERISTIC ASDrf_KdFilSetGripAirCdnrOnNeg_GM "unfiltered part, Grip at clutch, neg. load alteration damping with AC on" MAP 0x8050C9A6 RB_MapGroup_U8 1.000000 fak_ub_b2 0.00 1.000000 FORMAT "%8.6" EXTENDED_LIMITS 0.00 1.992188
 /begin AXIS_DESCR COM_AXIS PT_rTrq TransR 8 -327.6800 327.6700 FORMAT "%8.4" AXIS_PTS_REF ASDrf_rTrq_DST /end AXIS_DESCR
 /begin AXIS_DESCR COM_AXIS Epm_nEng EngN 8 -16384.00 16383.50 FORMAT "%8.2" AXIS_PTS_REF ASDrf_nEng_DST /end AXIS_DESCR
/end CHARACTERISTIC
/begin CHARACTERISTIC ASDrf_KdFilSetGripMtModNegAcOn_GM "infiltered part, negative load alteration when AC is On" MAP 0x8050C9E6 RB_MapGroup_U8 1.000000 fak_ub_b2 0.00 1.000000 FORMAT "%8.6" EXTENDED_LIMITS 0.00 1.992188
 /begin AXIS_DESCR COM_AXIS PT_rTrq TransR 8 -327.6800 327.6700 FORMAT "%8.4" AXIS_PTS_REF ASDrf_rTrq_DST /end AXIS_DESCR
 /begin AXIS_DESCR COM_AXIS Epm_nEng EngN 8 -16384.00 16383.50 FORMAT "%8.2" AXIS_PTS_REF ASDrf_nEng_DST /end AXIS_DESCR
/end CHARACTERISTIC
/begin CHARACTERISTIC ASDrf_KdFilSetGripMtModNeg_GM "unfiltered part, Grip at clutch, manual transmission mode, neg. load alteration damping" MAP 0x8050CA26 RB_MapGroup_U8 1.000000 fak_ub_b2 0.00 1.000000 FORMAT "%8.6" EXTENDED_LIMITS 0.00 1.992188
 /begin AXIS_DESCR COM_AXIS PT_rTrq TransR 8 -327.6800 327.6700 FORMAT "%8.4" AXIS_PTS_REF ASDrf_rTrq_DST /end AXIS_DESCR
 /begin AXIS_DESCR COM_AXIS Epm_nEng EngN 8 -16384.00 16383.50 FORMAT "%8.2" AXIS_PTS_REF ASDrf_nEng_DST /end AXIS_DESCR
/end CHARACTERISTIC
/begin CHARACTERISTIC ASDrf_KdFilSetGripMtModPosAbvAcOn_GM "infiltered part, positive load alteration when AC is On for above" MAP 0x8050CA66 RB_MapGroup_U8 1.000000 fak_ub_b2 0.00 1.000000 FORMAT "%8.6" EXTENDED_LIMITS 0.00 1.992188
 /begin AXIS_DESCR COM_AXIS PT_rTrq TransR 8 -327.6800 327.6700 FORMAT "%8.4" AXIS_PTS_REF ASDrf_rTrq_DST /end AXIS_DESCR
 /begin AXIS_DESCR COM_AXIS Epm_nEng EngN 8 -16384.00 16383.50 FORMAT "%8.2" AXIS_PTS_REF ASDrf_nEng_DST /end AXIS_DESCR
/end CHARACTERISTIC
/begin CHARACTERISTIC ASDrf_KdFilSetGripMtModPosAbv_GM "unfiltered part, Grip at clutch, manual tranission mode, pos. load alteration damping" MAP 0x8050CAA6 RB_MapGroup_U8 1.000000 fak_ub_b2 0.00 1.000000 FORMAT "%8.6" EXTENDED_LIMITS 0.00 1.992188
 /begin AXIS_DESCR COM_AXIS PT_rTrq TransR 8 -327.6800 327.6700 FORMAT "%8.4" AXIS_PTS_REF ASDrf_rTrq_DST /end AXIS_DESCR
 /begin AXIS_DESCR COM_AXIS Epm_nEng EngN 8 -16384.00 16383.50 FORMAT "%8.2" AXIS_PTS_REF ASDrf_nEng_DST /end AXIS_DESCR
/end CHARACTERISTIC
/begin CHARACTERISTIC ASDrf_KdFilSetGripNeg_GM "unfiltered part, Grip at clutch, neg. load alteration damping" MAP 0x8050CAE6 RB_MapGroup_U8 1.000000 fak_ub_b2 0.00 1.000000 FORMAT "%8.6" EXTENDED_LIMITS 0.00 1.992188
 /begin AXIS_DESCR COM_AXIS PT_rTrq TransR 8 -327.6800 327.6700 FORMAT "%8.4" AXIS_PTS_REF ASDrf_rTrq_DST /end AXIS_DESCR
 /begin AXIS_DESCR COM_AXIS Epm_nEng EngN 8 -16384.00 16383.50 FORMAT "%8.2" AXIS_PTS_REF ASDrf_nEng_DST /end AXIS_DESCR
/end CHARACTERISTIC
/begin CHARACTERISTIC ASDrf_KdFilSetGripPosAbvAcOn_GM "unfiltered part, Grip at clutch, pos. load alteration damping during AC On" MAP 0x8050CB26 RB_MapGroup_U8 1.000000 fak_ub_b2 0.00 1.000000 FORMAT "%8.6" EXTENDED_LIMITS 0.00 1.992188
 /begin AXIS_DESCR COM_AXIS PT_rTrq TransR 8 -327.6800 327.6700 FORMAT "%8.4" AXIS_PTS_REF ASDrf_rTrq_DST /end AXIS_DESCR
 /begin AXIS_DESCR COM_AXIS Epm_nEng EngN 8 -16384.00 16383.50 FORMAT "%8.2" AXIS_PTS_REF ASDrf_nEng_DST /end AXIS_DESCR
/end CHARACTERISTIC
/begin CHARACTERISTIC ASDrf_KdFilSetGripPosAbv_GM "unfiltered part, Grip at clutch, pos. load alteration damping" MAP 0x8050CB66 RB_MapGroup_U8 1.000000 fak_ub_b2 0.00 1.000000 FORMAT "%8.6" EXTENDED_LIMITS 0.00 1.992188
 /begin AXIS_DESCR COM_AXIS PT_rTrq TransR 8 -327.6800 327.6700 FORMAT "%8.4" AXIS_PTS_REF ASDrf_rTrq_DST /end AXIS_DESCR
 /begin AXIS_DESCR COM_AXIS Epm_nEng EngN 8 -16384.00 16383.50 FORMAT "%8.2" AXIS_PTS_REF ASDrf_nEng_DST /end AXIS_DESCR
/end CHARACTERISTIC
/begin CHARACTERISTIC ASDrf_KdFilSetSprtMtModNeg_GM "unfiltered part, Sport, Manual transmission mode, neg. load alteration damping" MAP 0x8050CBA6 RB_MapGroup_U8 1.000000 fak_ub_b2 0.00 1.000000 FORMAT "%8.6" EXTENDED_LIMITS 0.00 1.992188
 /begin AXIS_DESCR COM_AXIS PT_rTrq TransR 8 -327.6800 327.6700 FORMAT "%8.4" AXIS_PTS_REF ASDrf_rTrq_DST /end AXIS_DESCR
 /begin AXIS_DESCR COM_AXIS Epm_nEng EngN 8 -16384.00 16383.50 FORMAT "%8.2" AXIS_PTS_REF ASDrf_nEng_DST /end AXIS_DESCR
/end CHARACTERISTIC
/begin CHARACTERISTIC ASDrf_KdFilSetSprtMtModPosAbv_GM "unfiltered part, Sport, Manual transmission mode, pos. load alteration damping" MAP 0x8050CBE6 RB_MapGroup_U8 1.000000 fak_ub_b2 0.00 1.000000 FORMAT "%8.6" EXTENDED_LIMITS 0.00 1.992188
 /begin AXIS_DESCR COM_AXIS PT_rTrq TransR 8 -327.6800 327.6700 FORMAT "%8.4" AXIS_PTS_REF ASDrf_rTrq_DST /end AXIS_DESCR
 /begin AXIS_DESCR COM_AXIS Epm_nEng EngN 8 -16384.00 16383.50 FORMAT "%8.2" AXIS_PTS_REF ASDrf_nEng_DST /end AXIS_DESCR
/end CHARACTERISTIC
/begin CHARACTERISTIC ASDrf_KdFilSetSprtNegAcOn_GM "unfiltered part, Sport , neg. load alteration damping with AC on" MAP 0x8050CC26 RB_MapGroup_U8 1.000000 fak_ub_b2 0.00 1.000000 FORMAT "%8.6" EXTENDED_LIMITS 0.00 1.992188
 /begin AXIS_DESCR COM_AXIS PT_rTrq TransR 8 -327.6800 327.6700 FORMAT "%8.4" AXIS_PTS_REF ASDrf_rTrq_DST /end AXIS_DESCR
 /begin AXIS_DESCR COM_AXIS Epm_nEng EngN 8 -16384.00 16383.50 FORMAT "%8.2" AXIS_PTS_REF ASDrf_nEng_DST /end AXIS_DESCR
/end CHARACTERISTIC
/begin CHARACTERISTIC ASDrf_KdFilSetSprtNeg_GM "unfiltered part, Sport , neg. load alteration damping" MAP 0x8050CC66 RB_MapGroup_U8 1.000000 fak_ub_b2 0.00 1.000000 FORMAT "%8.6" EXTENDED_LIMITS 0.00 1.992188
 /begin AXIS_DESCR COM_AXIS PT_rTrq TransR 8 -327.6800 327.6700 FORMAT "%8.4" AXIS_PTS_REF ASDrf_rTrq_DST /end AXIS_DESCR
 /begin AXIS_DESCR COM_AXIS Epm_nEng EngN 8 -16384.00 16383.50 FORMAT "%8.2" AXIS_PTS_REF ASDrf_nEng_DST /end AXIS_DESCR
/end CHARACTERISTIC
/begin CHARACTERISTIC ASDrf_KdFilSetSprtPosAbvAcOn_GM "unfiltered part, Sport, pos. load alteration damping with AC on" MAP 0x8050CCA6 RB_MapGroup_U8 1.000000 fak_ub_b2 0.00 1.000000 FORMAT "%8.6" EXTENDED_LIMITS 0.00 1.992188
 /begin AXIS_DESCR COM_AXIS PT_rTrq TransR 8 -327.6800 327.6700 FORMAT "%8.4" AXIS_PTS_REF ASDrf_rTrq_DST /end AXIS_DESCR
 /begin AXIS_DESCR COM_AXIS Epm_nEng EngN 8 -16384.00 16383.50 FORMAT "%8.2" AXIS_PTS_REF ASDrf_nEng_DST /end AXIS_DESCR
/end CHARACTERISTIC
/begin CHARACTERISTIC ASDrf_KdFilSetSprtPosAbv_GM "unfiltered part, Sport, pos. load alteration damping" MAP 0x8050CCE6 RB_MapGroup_U8 1.000000 fak_ub_b2 0.00 1.000000 FORMAT "%8.6" EXTENDED_LIMITS 0.00 1.992188
 /begin AXIS_DESCR COM_AXIS PT_rTrq TransR 8 -327.6800 327.6700 FORMAT "%8.4" AXIS_PTS_REF ASDrf_rTrq_DST /end AXIS_DESCR
 /begin AXIS_DESCR COM_AXIS Epm_nEng EngN 8 -16384.00 16383.50 FORMAT "%8.2" AXIS_PTS_REF ASDrf_nEng_DST /end AXIS_DESCR
/end CHARACTERISTIC
/begin CHARACTERISTIC ASDrf_KdFilSetSptMtModNegAcOn_GM "infiltered part, Sport Mode negative load alteration when AC is On" MAP 0x8050CD26 RB_MapGroup_U8 1.000000 fak_ub_b2 0.00 1.000000 FORMAT "%8.6" EXTENDED_LIMITS 0.00 1.992188
 /begin AXIS_DESCR COM_AXIS PT_rTrq TransR 8 -327.6800 327.6700 FORMAT "%8.4" AXIS_PTS_REF ASDrf_rTrq_DST /end AXIS_DESCR
 /begin AXIS_DESCR COM_AXIS Epm_nEng EngN 8 -16384.00 16383.50 FORMAT "%8.2" AXIS_PTS_REF ASDrf_nEng_DST /end AXIS_DESCR
/end CHARACTERISTIC
/begin CHARACTERISTIC ASDrf_KdFilSetSptMtModPosAbvAcOn_GM "infiltered part, Sport Mode positive load alteration when AC is On for above" MAP 0x8050CD66 RB_MapGroup_U8 1.000000 fak_ub_b2 0.00 1.000000 FORMAT "%8.6" EXTENDED_LIMITS 0.00 1.992188
 /begin AXIS_DESCR COM_AXIS PT_rTrq TransR 8 -327.6800 327.6700 FORMAT "%8.4" AXIS_PTS_REF ASDrf_rTrq_DST /end AXIS_DESCR
 /begin AXIS_DESCR COM_AXIS Epm_nEng EngN 8 -16384.00 16383.50 FORMAT "%8.2" AXIS_PTS_REF ASDrf_nEng_DST /end AXIS_DESCR
/end CHARACTERISTIC
/begin CHARACTERISTIC ASDrf_KdFltSetNoGripNeg_C "unfiltered part, open powertrain, neg. load alteration damping" VALUE 0x8050CDA6 RB_Val_Wu8 1.000000 fak_ub_b2 0.00 1.000000 FORMAT "%8.6" EXTENDED_LIMITS 0.00 1.992188 /end CHARACTERISTIC
/begin CHARACTERISTIC ASDrf_KdFltSetNoGripPos_C "unfiltered part, open powertrain, pos. load alteration damping" VALUE 0x8050CDA7 RB_Val_Wu8 1.000000 fak_ub_b2 0.00 1.000000 FORMAT "%8.6" EXTENDED_LIMITS 0.00 1.992188 /end CHARACTERISTIC
/begin CHARACTERISTIC ASDrf_nATSlipOpnEngSpdLo_C "Low speed threshold for the automatic transmission slip open w.r.t engine speed" VALUE 0x8050CDA8 RB_Val_Ws16 32767.50 EngN -16384.00 16383.50 FORMAT "%8.2" /end CHARACTERISTIC
/begin CHARACTERISTIC ASDrf_nDiffCnvrEngSelThd_C "Threshold for the speed difference between turbine speed and engine speed" VALUE 0x8050CDAA RB_Val_Ws16 32767.50 EngN -16384.00 16383.50 FORMAT "%8.2" /end CHARACTERISTIC
/begin AXIS_PTS ASDrf_nEng_DST "engine speed" 0x8050CDAC Epm_nEng RB_Axis_S16 32767.50 EngN 8 -16384.00 16383.50 FORMAT "%8.2" DEPOSIT ABSOLUTE /end AXIS_PTS
/begin AXIS_PTS ASDrf_nPt_DST "speed powertrain" 0x8050CDBE ASDrf_nPt RB_Axis_S16 32767.50 EngN 8 -16384.00 16383.50 FORMAT "%8.2" DEPOSIT ABSOLUTE /end AXIS_PTS
/begin AXIS_PTS ASDrf_nrGear_DST "gear" 0x8050CDD0 Tra_numGear RB_Axis_S8 255.0 OneToOne 10 -128.0 127.0 FORMAT "%5.1" DEPOSIT ABSOLUTE /end AXIS_PTS
/begin CHARACTERISTIC ASDrf_nThresNCmp_GMAP "Correction of turbine rpm during open converter clutch" MAP 0x8050CDDC RB_MapGroup_S16 32767.50 nmot_q0p5 -16384.00 16383.50 FORMAT "%8.2"
 /begin AXIS_DESCR COM_AXIS PT_rTrq TransR 8 -327.6800 327.6700 FORMAT "%8.4" AXIS_PTS_REF ASDrf_rTrq_DST /end AXIS_DESCR
 /begin AXIS_DESCR COM_AXIS Epm_dnEngFlt EngNGrd 6 -16384.00 16383.50 FORMAT "%8.2" AXIS_PTS_REF ASDrf_dnEngFlt_DST /end AXIS_DESCR
/end CHARACTERISTIC
/begin CHARACTERISTIC ASDrf_nTrbnThresHi_C "Higher threshold for the turbine speed" VALUE 0x8050CE3C RB_Val_Ws16 32767.50 EngN -16384.00 16383.50 FORMAT "%8.2" /end CHARACTERISTIC
/begin CHARACTERISTIC ASDrf_nTrbnThresLo_C "Lower threshold for the turbine speed" VALUE 0x8050CE3E RB_Val_Ws16 32767.50 EngN -16384.00 16383.50 FORMAT "%8.2" /end CHARACTERISTIC
/begin CHARACTERISTIC ASDrf_ratSlipOpenActvThdEco_M "Ratio of Active slip open threshold for Eco Mode" MAP 0x8050CE40 RB_Map_S16U16_U16 327.6750 CrCtlSlipRat 0.00 327.6750 FORMAT "%8.4"
 /begin AXIS_DESCR STD_AXIS Epm_nEng EngN 11 -16384.00 16383.50 FORMAT "%8.2" DEPOSIT ABSOLUTE /end AXIS_DESCR
 /begin AXIS_DESCR STD_AXIS Com_rTrsmTotFild Fact_2pwr11 10 0.00 31.99951 FORMAT "%8.5" DEPOSIT ABSOLUTE /end AXIS_DESCR
/end CHARACTERISTIC
/begin CHARACTERISTIC ASDrf_ratSlipOpenActvThdSpt_M "Ratio of Active slip open threshold for sports mode" MAP 0x8050CF4A RB_Map_S16U16_U16 327.6750 CrCtlSlipRat 0.00 327.6750 FORMAT "%8.4"
 /begin AXIS_DESCR STD_AXIS Epm_nEng EngN 11 -16384.00 16383.50 FORMAT "%8.2" DEPOSIT ABSOLUTE /end AXIS_DESCR
 /begin AXIS_DESCR STD_AXIS Com_rTrsmTotFild Fact_2pwr11 10 0.00 31.99951 FORMAT "%8.5" DEPOSIT ABSOLUTE /end AXIS_DESCR
/end CHARACTERISTIC
/begin CHARACTERISTIC ASDrf_ratSlipOpenActvThdTrsmMt_M "Ratio of Active slip open threshold for manual transmission" MAP 0x8050D054 RB_Map_S16U16_U16 327.6750 CrCtlSlipRat 0.00 327.6750 FORMAT "%8.4"
 /begin AXIS_DESCR STD_AXIS Epm_nEng EngN 11 -16384.00 16383.50 FORMAT "%8.2" DEPOSIT ABSOLUTE /end AXIS_DESCR
 /begin AXIS_DESCR STD_AXIS Com_rTrsmTotFild Fact_2pwr11 10 0.00 31.99951 FORMAT "%8.5" DEPOSIT ABSOLUTE /end AXIS_DESCR
/end CHARACTERISTIC
/begin CHARACTERISTIC ASDrf_ratSlipOpenAppCmpEco_M "Ratio of Active slip open Acceleration pedal compensation Eco Mode" MAP 0x8050D15E RB_Map_S16U16_U16 163.0000 CrCtlSlipRat 0.00 163.0000 FORMAT "%8.4" EXTENDED_LIMITS 0.00 327.6750
 /begin AXIS_DESCR STD_AXIS APP_r Prc 10 -400.0000 399.9878 FORMAT "%8.4" DEPOSIT ABSOLUTE /end AXIS_DESCR
 /begin AXIS_DESCR STD_AXIS Com_rTrsmTotFild Fact_2pwr11 10 0.00 31.99951 FORMAT "%8.5" DEPOSIT ABSOLUTE /end AXIS_DESCR
/end CHARACTERISTIC
/begin CHARACTERISTIC ASDrf_ratSlipOpenAppCmpSpt_M "Ratio of Active slip open Acceleration pedal compensation for sports mode" MAP 0x8050D252 RB_Map_S16U16_U16 163.0000 CrCtlSlipRat 0.00 163.0000 FORMAT "%8.4" EXTENDED_LIMITS 0.00 327.6750
 /begin AXIS_DESCR STD_AXIS APP_r Prc 10 -400.0000 399.9878 FORMAT "%8.4" DEPOSIT ABSOLUTE /end AXIS_DESCR
 /begin AXIS_DESCR STD_AXIS Com_rTrsmTotFild Fact_2pwr11 10 0.00 31.99951 FORMAT "%8.5" DEPOSIT ABSOLUTE /end AXIS_DESCR
/end CHARACTERISTIC
/begin CHARACTERISTIC ASDrf_ratSlipOpenAppCmpTrsmMt_M "Ratio of Active slip open Acceleration pedal compensation for manual transmission" MAP 0x8050D346 RB_Map_S16U16_U16 163.0000 CrCtlSlipRat 0.00 163.0000 FORMAT "%8.4" EXTENDED_LIMITS 0.00 327.6750
 /begin AXIS_DESCR STD_AXIS APP_r Prc 10 -400.0000 399.9878 FORMAT "%8.4" DEPOSIT ABSOLUTE /end AXIS_DESCR
 /begin AXIS_DESCR STD_AXIS Com_rTrsmTotFild Fact_2pwr11 10 0.00 31.99951 FORMAT "%8.5" DEPOSIT ABSOLUTE /end AXIS_DESCR
/end CHARACTERISTIC
/begin CHARACTERISTIC ASDrf_ratSlipOpenAppCmp_M "Ratio of Active slip open Acceleration pedal compensation" MAP 0x8050D43A RB_Map_S16U16_U16 163.0000 CrCtlSlipRat 0.00 163.0000 FORMAT "%8.4" EXTENDED_LIMITS 0.00 327.6750
 /begin AXIS_DESCR STD_AXIS APP_r Prc 10 -400.0000 399.9878 FORMAT "%8.4" DEPOSIT ABSOLUTE /end AXIS_DESCR
 /begin AXIS_DESCR STD_AXIS Com_rTrsmTotFild Fact_2pwr11 10 0.00 31.99951 FORMAT "%8.5" DEPOSIT ABSOLUTE /end AXIS_DESCR
/end CHARACTERISTIC
/begin CHARACTERISTIC ASDrf_ratSlipOpenEngCmpEco_M "Ratio of Active slip open Engine speed compensation Eco Mode" MAP 0x8050D52E RB_Map_S16U16_U16 163.0000 CrCtlSlipRat 0.00 163.0000 FORMAT "%8.4" EXTENDED_LIMITS 0.00 327.6750
 /begin AXIS_DESCR STD_AXIS Epm_nEng EngN 11 -16384.00 16383.50 FORMAT "%8.2" DEPOSIT ABSOLUTE /end AXIS_DESCR
 /begin AXIS_DESCR STD_AXIS Com_rTrsmTotFild Fact_2pwr11 10 0.00 31.99951 FORMAT "%8.5" DEPOSIT ABSOLUTE /end AXIS_DESCR
/end CHARACTERISTIC
/begin CHARACTERISTIC ASDrf_ratSlipOpenEngCmpSpt_M "Ratio of Active slip open Engine speed compensation for sports mode" MAP 0x8050D638 RB_Map_S16U16_U16 163.0000 CrCtlSlipRat 0.00 163.0000 FORMAT "%8.4" EXTENDED_LIMITS 0.00 327.6750
 /begin AXIS_DESCR STD_AXIS Epm_nEng EngN 11 -16384.00 16383.50 FORMAT "%8.2" DEPOSIT ABSOLUTE /end AXIS_DESCR
 /begin AXIS_DESCR STD_AXIS Com_rTrsmTotFild Fact_2pwr11 10 0.00 31.99951 FORMAT "%8.5" DEPOSIT ABSOLUTE /end AXIS_DESCR
/end CHARACTERISTIC
/begin CHARACTERISTIC ASDrf_ratSlipOpenEngCmpTrsmMt_M "Ratio of Active slip open Engine speed compensation for manual transmission" MAP 0x8050D742 RB_Map_S16U16_U16 163.0000 CrCtlSlipRat 0.00 163.0000 FORMAT "%8.4" EXTENDED_LIMITS 0.00 327.6750
 /begin AXIS_DESCR STD_AXIS Epm_nEng EngN 11 -16384.00 16383.50 FORMAT "%8.2" DEPOSIT ABSOLUTE /end AXIS_DESCR
 /begin AXIS_DESCR STD_AXIS Com_rTrsmTotFild Fact_2pwr11 10 0.00 31.99951 FORMAT "%8.5" DEPOSIT ABSOLUTE /end AXIS_DESCR
/end CHARACTERISTIC
/begin CHARACTERISTIC ASDrf_rATSlipOpnActvThres_MAP "Threshold for the enabling converter slip open state for AT" MAP 0x8050D84C RB_Map_S16U16_U16 327.6750 CrCtlSlipRat 0.00 327.6750 FORMAT "%8.4"
 /begin AXIS_DESCR STD_AXIS Epm_nEng EngN 11 -16384.00 16383.50 FORMAT "%8.2" DEPOSIT ABSOLUTE /end AXIS_DESCR
 /begin AXIS_DESCR STD_AXIS Com_rTrsmTotFild Fact_2pwr11 10 0.00 31.99951 FORMAT "%8.5" DEPOSIT ABSOLUTE /end AXIS_DESCR
/end CHARACTERISTIC
/begin CHARACTERISTIC ASDrf_rATSlipOpnNCmp_MAP "Threshold to determinine engine speed lower than turbine speed for converter slip open state in AT" MAP 0x8050D956 RB_Map_S16U16_U16 163.0000 CrCtlSlipRat 0.00 163.0000 FORMAT "%8.4" EXTENDED_LIMITS 0.00 327.6750
 /begin AXIS_DESCR STD_AXIS Epm_nEng EngN 11 -16384.00 16383.50 FORMAT "%8.2" DEPOSIT ABSOLUTE /end AXIS_DESCR
 /begin AXIS_DESCR STD_AXIS Com_rTrsmTotFild Fact_2pwr11 10 0.00 31.99951 FORMAT "%8.5" DEPOSIT ABSOLUTE /end AXIS_DESCR
/end CHARACTERISTIC
/begin AXIS_PTS ASDrf_rTrq_DST "ratio of transmission" 0x8050DA60 PT_rTrq RB_Axis_S16 655.3500 TransR 8 -327.6800 327.6700 FORMAT "%8.4" DEPOSIT ABSOLUTE /end AXIS_PTS
/begin CHARACTERISTIC ASDrf_stEngOperModSeln_FT "Satus to select drivability mode for parameter" CURVE 0x8050DA72 RB_Curve_U8_U8 255.0 OneToOne 0.00 255.0 FORMAT "%5.1"
 /begin AXIS_DESCR STD_AXIS AccPed_swtDrvMod OneToOne 16 0.00 255.0 FORMAT "%5.1" DEPOSIT ABSOLUTE /end AXIS_DESCR
/end CHARACTERISTIC
/begin CHARACTERISTIC ASDrf_stFltCutEna_C "release filter cut off" VALUE 0x8050DA93 RB_Val_Wboolean 1.00000000000 B_TRUE 0.00 1.00000000000 FORMAT "%13.11" /end CHARACTERISTIC
/begin CHARACTERISTIC ASDrf_tATSlipOpnEngTLo_C "Low coolant temperature threshold for the automatic transmission slip open" VALUE 0x8050DA94 RB_Val_Ws16 6553.500 Temp_Cels -3549.940 3003.560 FORMAT "%8.3" /end CHARACTERISTIC
/begin AXIS_PTS ASDrf_tEng_DST "engine temperature" 0x8050DA96 EngDa_tEng RB_Axis_S16 6553.500 Temp_Cels 6 -3549.940 3003.560 FORMAT "%8.3" DEPOSIT ABSOLUTE /end AXIS_PTS
/begin CHARACTERISTIC ASDrf_tiFilSetEcoMtModNegAcOn_GM "time constant, Eco Mode negative load alteration when Ac is On" MAP 0x8050DAA4 RB_MapGroup_U8 2.540 t_q0p01 0.010 2.550 FORMAT "%5.3" EXTENDED_LIMITS 0.00 2.550
 /begin AXIS_DESCR COM_AXIS ASDrf_tqCluBasc Trq 5 -3276.800 3276.700 FORMAT "%8.3" AXIS_PTS_REF ASDrf_trqClthBs_DST /end AXIS_DESCR
 /begin AXIS_DESCR COM_AXIS Epm_nEng EngN 8 -16384.00 16383.50 FORMAT "%8.2" AXIS_PTS_REF ASDrf_nEng_DST /end AXIS_DESCR
/end CHARACTERISTIC
/begin CHARACTERISTIC ASDrf_tiFilSetEcoMtModNeg_GM "time constant, Eco, Manual transmission mode, neg. load alteration damping" MAP 0x8050DACC RB_MapGroup_U8 2.540 t_q0p01 0.010 2.550 FORMAT "%5.3" EXTENDED_LIMITS 0.00 2.550
 /begin AXIS_DESCR COM_AXIS ASDrf_tqCluBasc Trq 5 -3276.800 3276.700 FORMAT "%8.3" AXIS_PTS_REF ASDrf_trqClthBs_DST /end AXIS_DESCR
 /begin AXIS_DESCR COM_AXIS Epm_nEng EngN 8 -16384.00 16383.50 FORMAT "%8.2" AXIS_PTS_REF ASDrf_nEng_DST /end AXIS_DESCR
/end CHARACTERISTIC
/begin CHARACTERISTIC ASDrf_tiFilSetEcoMtModPosAbvAcOn_GM "time constant, Eco Mode positive load alteration when Ac is On for above" MAP 0x8050DAF4 RB_MapGroup_U8 2.540 t_q0p01 0.010 2.550 FORMAT "%5.3" EXTENDED_LIMITS 0.00 2.550
 /begin AXIS_DESCR COM_AXIS PT_rTrq TransR 8 -327.6800 327.6700 FORMAT "%8.4" AXIS_PTS_REF ASDrf_rTrq_DST /end AXIS_DESCR
 /begin AXIS_DESCR COM_AXIS Epm_nEng EngN 8 -16384.00 16383.50 FORMAT "%8.2" AXIS_PTS_REF ASDrf_nEng_DST /end AXIS_DESCR
/end CHARACTERISTIC
/begin CHARACTERISTIC ASDrf_tiFilSetEcoMtModPosAbv_GM "time constant, Eco, Manual transmission mode, pos. load alteration damping" MAP 0x8050DB34 RB_MapGroup_U8 2.540 t_q0p01 0.010 2.550 FORMAT "%5.3" EXTENDED_LIMITS 0.00 2.550
 /begin AXIS_DESCR COM_AXIS PT_rTrq TransR 8 -327.6800 327.6700 FORMAT "%8.4" AXIS_PTS_REF ASDrf_rTrq_DST /end AXIS_DESCR
 /begin AXIS_DESCR COM_AXIS Epm_nEng EngN 8 -16384.00 16383.50 FORMAT "%8.2" AXIS_PTS_REF ASDrf_nEng_DST /end AXIS_DESCR
/end CHARACTERISTIC
/begin CHARACTERISTIC ASDrf_tiFilSetEcoMtModPosBlwAcOn_GM "time constant, Eco Mode positive load alteration when Ac is On for below" MAP 0x8050DB74 RB_MapGroup_U8 2.540 t_q0p01 0.010 2.550 FORMAT "%5.3" EXTENDED_LIMITS 0.00 2.550
 /begin AXIS_DESCR COM_AXIS PT_rTrq TransR 8 -327.6800 327.6700 FORMAT "%8.4" AXIS_PTS_REF ASDrf_rTrq_DST /end AXIS_DESCR
 /begin AXIS_DESCR COM_AXIS Epm_nEng EngN 8 -16384.00 16383.50 FORMAT "%8.2" AXIS_PTS_REF ASDrf_nEng_DST /end AXIS_DESCR
/end CHARACTERISTIC
/begin CHARACTERISTIC ASDrf_tiFilSetEcoMtModPosBlw_GM "time constant, Eco, Manual transmission mode, pos. load alteration damping" MAP 0x8050DBB4 RB_MapGroup_U8 2.540 t_q0p01 0.010 2.550 FORMAT "%5.3" EXTENDED_LIMITS 0.00 2.550
 /begin AXIS_DESCR COM_AXIS PT_rTrq TransR 8 -327.6800 327.6700 FORMAT "%8.4" AXIS_PTS_REF ASDrf_rTrq_DST /end AXIS_DESCR
 /begin AXIS_DESCR COM_AXIS Epm_nEng EngN 8 -16384.00 16383.50 FORMAT "%8.2" AXIS_PTS_REF ASDrf_nEng_DST /end AXIS_DESCR
/end CHARACTERISTIC
/begin CHARACTERISTIC ASDrf_tiFilSetEcoNeg_GM "time constant, Eco , neg. load alteration damping" MAP 0x8050DBF4 RB_MapGroup_U8 2.540 t_q0p01 0.010 2.550 FORMAT "%5.3" EXTENDED_LIMITS 0.00 2.550
 /begin AXIS_DESCR COM_AXIS ASDrf_tqCluBasc Trq 5 -3276.800 3276.700 FORMAT "%8.3" AXIS_PTS_REF ASDrf_trqClthBs_DST /end AXIS_DESCR
 /begin AXIS_DESCR COM_AXIS Epm_nEng EngN 8 -16384.00 16383.50 FORMAT "%8.2" AXIS_PTS_REF ASDrf_nEng_DST /end AXIS_DESCR
/end CHARACTERISTIC
/begin CHARACTERISTIC ASDrf_tiFilSetEcoPosAbvAcOn_GM "time constant, Eco, pos. load alteration damping during AC On" MAP 0x8050DC1C RB_MapGroup_U8 2.540 t_q0p01 0.010 2.550 FORMAT "%5.3" EXTENDED_LIMITS 0.00 2.550
 /begin AXIS_DESCR COM_AXIS PT_rTrq TransR 8 -327.6800 327.6700 FORMAT "%8.4" AXIS_PTS_REF ASDrf_rTrq_DST /end AXIS_DESCR
 /begin AXIS_DESCR COM_AXIS Epm_nEng EngN 8 -16384.00 16383.50 FORMAT "%8.2" AXIS_PTS_REF ASDrf_nEng_DST /end AXIS_DESCR
/end CHARACTERISTIC
/begin CHARACTERISTIC ASDrf_tiFilSetEcoPosAbv_GM "time constant, Eco, pos. load alteration damping" MAP 0x8050DC5C RB_MapGroup_U8 2.540 t_q0p01 0.010 2.550 FORMAT "%5.3" EXTENDED_LIMITS 0.00 2.550
 /begin AXIS_DESCR COM_AXIS PT_rTrq TransR 8 -327.6800 327.6700 FORMAT "%8.4" AXIS_PTS_REF ASDrf_rTrq_DST /end AXIS_DESCR
 /begin AXIS_DESCR COM_AXIS Epm_nEng EngN 8 -16384.00 16383.50 FORMAT "%8.2" AXIS_PTS_REF ASDrf_nEng_DST /end AXIS_DESCR
/end CHARACTERISTIC
/begin CHARACTERISTIC ASDrf_tiFilSetEcoPosBlwAcOn_GM "time constant, Eco , pos. load alteration damping during AC On" MAP 0x8050DC9C RB_MapGroup_U8 2.540 t_q0p01 0.010 2.550 FORMAT "%5.3" EXTENDED_LIMITS 0.00 2.550
 /begin AXIS_DESCR COM_AXIS PT_rTrq TransR 8 -327.6800 327.6700 FORMAT "%8.4" AXIS_PTS_REF ASDrf_rTrq_DST /end AXIS_DESCR
 /begin AXIS_DESCR COM_AXIS Epm_nEng EngN 8 -16384.00 16383.50 FORMAT "%8.2" AXIS_PTS_REF ASDrf_nEng_DST /end AXIS_DESCR
/end CHARACTERISTIC
/begin CHARACTERISTIC ASDrf_tiFilSetEcoPosBlw_GM "time constant, Eco , pos. load alteration damping" MAP 0x8050DCDC RB_MapGroup_U8 2.540 t_q0p01 0.010 2.550 FORMAT "%5.3" EXTENDED_LIMITS 0.00 2.550
 /begin AXIS_DESCR COM_AXIS PT_rTrq TransR 8 -327.6800 327.6700 FORMAT "%8.4" AXIS_PTS_REF ASDrf_rTrq_DST /end AXIS_DESCR
 /begin AXIS_DESCR COM_AXIS Epm_nEng EngN 8 -16384.00 16383.50 FORMAT "%8.2" AXIS_PTS_REF ASDrf_nEng_DST /end AXIS_DESCR
/end CHARACTERISTIC
/begin CHARACTERISTIC ASDrf_tiFilSetGripMtModNegAcOn_GM "time constant, negative load alteration when Ac is On" MAP 0x8050DD1C RB_MapGroup_U8 2.540 t_q0p01 0.010 2.550 FORMAT "%5.3" EXTENDED_LIMITS 0.00 2.550
 /begin AXIS_DESCR COM_AXIS ASDrf_tqCluBasc Trq 5 -3276.800 3276.700 FORMAT "%8.3" AXIS_PTS_REF ASDrf_trqClthBs_DST /end AXIS_DESCR
 /begin AXIS_DESCR COM_AXIS Epm_nEng EngN 8 -16384.00 16383.50 FORMAT "%8.2" AXIS_PTS_REF ASDrf_nEng_DST /end AXIS_DESCR
/end CHARACTERISTIC
/begin CHARACTERISTIC ASDrf_tiFilSetGripMtModNeg_GM "time constant, Grip at clutch, manual transmission mode, neg. load alteration damping" MAP 0x8050DD44 RB_MapGroup_U8 2.540 t_q0p01 0.010 2.550 FORMAT "%5.3" EXTENDED_LIMITS 0.00 2.550
 /begin AXIS_DESCR COM_AXIS ASDrf_tqCluBasc Trq 5 -3276.800 3276.700 FORMAT "%8.3" AXIS_PTS_REF ASDrf_trqClthBs_DST /end AXIS_DESCR
 /begin AXIS_DESCR COM_AXIS Epm_nEng EngN 8 -16384.00 16383.50 FORMAT "%8.2" AXIS_PTS_REF ASDrf_nEng_DST /end AXIS_DESCR
/end CHARACTERISTIC
/begin CHARACTERISTIC ASDrf_tiFilSetGripMtModPosAbvAcOn_GM "time constant, positive load alteration when Ac is On for above" MAP 0x8050DD6C RB_MapGroup_U8 2.540 t_q0p01 0.010 2.550 FORMAT "%5.3" EXTENDED_LIMITS 0.00 2.550
 /begin AXIS_DESCR COM_AXIS PT_rTrq TransR 8 -327.6800 327.6700 FORMAT "%8.4" AXIS_PTS_REF ASDrf_rTrq_DST /end AXIS_DESCR
 /begin AXIS_DESCR COM_AXIS Epm_nEng EngN 8 -16384.00 16383.50 FORMAT "%8.2" AXIS_PTS_REF ASDrf_nEng_DST /end AXIS_DESCR
/end CHARACTERISTIC
/begin CHARACTERISTIC ASDrf_tiFilSetGripMtModPosAbv_GM "time constant, Grip at clutch, manual transmission mode, pos. load alteration damping" MAP 0x8050DDAC RB_MapGroup_U8 2.540 t_q0p01 0.010 2.550 FORMAT "%5.3" EXTENDED_LIMITS 0.00 2.550
 /begin AXIS_DESCR COM_AXIS PT_rTrq TransR 8 -327.6800 327.6700 FORMAT "%8.4" AXIS_PTS_REF ASDrf_rTrq_DST /end AXIS_DESCR
 /begin AXIS_DESCR COM_AXIS Epm_nEng EngN 8 -16384.00 16383.50 FORMAT "%8.2" AXIS_PTS_REF ASDrf_nEng_DST /end AXIS_DESCR
/end CHARACTERISTIC
/begin CHARACTERISTIC ASDrf_tiFilSetGripMtModPosBlwAcOn_GM "time constant, positive load alteration when Ac is On for below" MAP 0x8050DDEC RB_MapGroup_U8 2.540 t_q0p01 0.010 2.550 FORMAT "%5.3" EXTENDED_LIMITS 0.00 2.550
 /begin AXIS_DESCR COM_AXIS PT_rTrq TransR 8 -327.6800 327.6700 FORMAT "%8.4" AXIS_PTS_REF ASDrf_rTrq_DST /end AXIS_DESCR
 /begin AXIS_DESCR COM_AXIS Epm_nEng EngN 8 -16384.00 16383.50 FORMAT "%8.2" AXIS_PTS_REF ASDrf_nEng_DST /end AXIS_DESCR
/end CHARACTERISTIC
/begin CHARACTERISTIC ASDrf_tiFilSetGripMtModPosBlw_GM "time constant, Grip at clutch, manual transmission mode, pos. load alteration damping" MAP 0x8050DE2C RB_MapGroup_U8 2.540 t_q0p01 0.010 2.550 FORMAT "%5.3" EXTENDED_LIMITS 0.00 2.550
 /begin AXIS_DESCR COM_AXIS PT_rTrq TransR 8 -327.6800 327.6700 FORMAT "%8.4" AXIS_PTS_REF ASDrf_rTrq_DST /end AXIS_DESCR
 /begin AXIS_DESCR COM_AXIS Epm_nEng EngN 8 -16384.00 16383.50 FORMAT "%8.2" AXIS_PTS_REF ASDrf_nEng_DST /end AXIS_DESCR
/end CHARACTERISTIC
/begin CHARACTERISTIC ASDrf_tiFilSetSprtMtModNeg_GM "time constant, Sport, Manual transmission mode, neg. load alteration damping" MAP 0x8050DE6C RB_MapGroup_U8 2.540 t_q0p01 0.010 2.550 FORMAT "%5.3" EXTENDED_LIMITS 0.00 2.550
 /begin AXIS_DESCR COM_AXIS ASDrf_tqCluBasc Trq 5 -3276.800 3276.700 FORMAT "%8.3" AXIS_PTS_REF ASDrf_trqClthBs_DST /end AXIS_DESCR
 /begin AXIS_DESCR COM_AXIS Epm_nEng EngN 8 -16384.00 16383.50 FORMAT "%8.2" AXIS_PTS_REF ASDrf_nEng_DST /end AXIS_DESCR
/end CHARACTERISTIC
/begin CHARACTERISTIC ASDrf_tiFilSetSprtMtModPosAbv_GM "time constant, Sport, Manual transmission mode, pos. load alteration damping" MAP 0x8050DE94 RB_MapGroup_U8 2.540 t_q0p01 0.010 2.550 FORMAT "%5.3" EXTENDED_LIMITS 0.00 2.550
 /begin AXIS_DESCR COM_AXIS PT_rTrq TransR 8 -327.6800 327.6700 FORMAT "%8.4" AXIS_PTS_REF ASDrf_rTrq_DST /end AXIS_DESCR
 /begin AXIS_DESCR COM_AXIS Epm_nEng EngN 8 -16384.00 16383.50 FORMAT "%8.2" AXIS_PTS_REF ASDrf_nEng_DST /end AXIS_DESCR
/end CHARACTERISTIC
/begin CHARACTERISTIC ASDrf_tiFilSetSprtMtModPosBlw_GM "time constant, Sport, Manual transmission mode, pos. load alteration damping" MAP 0x8050DED4 RB_MapGroup_U8 2.540 t_q0p01 0.010 2.550 FORMAT "%5.3" EXTENDED_LIMITS 0.00 2.550
 /begin AXIS_DESCR COM_AXIS PT_rTrq TransR 8 -327.6800 327.6700 FORMAT "%8.4" AXIS_PTS_REF ASDrf_rTrq_DST /end AXIS_DESCR
 /begin AXIS_DESCR COM_AXIS Epm_nEng EngN 8 -16384.00 16383.50 FORMAT "%8.2" AXIS_PTS_REF ASDrf_nEng_DST /end AXIS_DESCR
/end CHARACTERISTIC
/begin CHARACTERISTIC ASDrf_tiFilSetSprtNegAcOn_GM "time constant, Sport , neg. load alteration damping with AC on" MAP 0x8050DF14 RB_MapGroup_U8 2.540 t_q0p01 0.010 2.550 FORMAT "%5.3" EXTENDED_LIMITS 0.00 2.550
 /begin AXIS_DESCR COM_AXIS ASDrf_tqCluBasc Trq 5 -3276.800 3276.700 FORMAT "%8.3" AXIS_PTS_REF ASDrf_trqClthBs_DST /end AXIS_DESCR
 /begin AXIS_DESCR COM_AXIS Epm_nEng EngN 8 -16384.00 16383.50 FORMAT "%8.2" AXIS_PTS_REF ASDrf_nEng_DST /end AXIS_DESCR
/end CHARACTERISTIC
/begin CHARACTERISTIC ASDrf_tiFilSetSprtNeg_GM "time constant, Sport , neg. load alteration damping" MAP 0x8050DF3C RB_MapGroup_U8 2.540 t_q0p01 0.010 2.550 FORMAT "%5.3" EXTENDED_LIMITS 0.00 2.550
 /begin AXIS_DESCR COM_AXIS ASDrf_tqCluBasc Trq 5 -3276.800 3276.700 FORMAT "%8.3" AXIS_PTS_REF ASDrf_trqClthBs_DST /end AXIS_DESCR
 /begin AXIS_DESCR COM_AXIS Epm_nEng EngN 8 -16384.00 16383.50 FORMAT "%8.2" AXIS_PTS_REF ASDrf_nEng_DST /end AXIS_DESCR
/end CHARACTERISTIC
/begin CHARACTERISTIC ASDrf_tiFilSetSprtPosAbvAcOn_GM "time constant, Sport, pos. load alteration damping with AC on" MAP 0x8050DF64 RB_MapGroup_U8 2.540 t_q0p01 0.010 2.550 FORMAT "%5.3" EXTENDED_LIMITS 0.00 2.550
 /begin AXIS_DESCR COM_AXIS PT_rTrq TransR 8 -327.6800 327.6700 FORMAT "%8.4" AXIS_PTS_REF ASDrf_rTrq_DST /end AXIS_DESCR
 /begin AXIS_DESCR COM_AXIS Epm_nEng EngN 8 -16384.00 16383.50 FORMAT "%8.2" AXIS_PTS_REF ASDrf_nEng_DST /end AXIS_DESCR
/end CHARACTERISTIC
/begin CHARACTERISTIC ASDrf_tiFilSetSprtPosAbv_GM "time constant, Sport, pos. load alteration damping" MAP 0x8050DFA4 RB_MapGroup_U8 2.540 t_q0p01 0.010 2.550 FORMAT "%5.3" EXTENDED_LIMITS 0.00 2.550
 /begin AXIS_DESCR COM_AXIS PT_rTrq TransR 8 -327.6800 327.6700 FORMAT "%8.4" AXIS_PTS_REF ASDrf_rTrq_DST /end AXIS_DESCR
 /begin AXIS_DESCR COM_AXIS Epm_nEng EngN 8 -16384.00 16383.50 FORMAT "%8.2" AXIS_PTS_REF ASDrf_nEng_DST /end AXIS_DESCR
/end CHARACTERISTIC
/begin CHARACTERISTIC ASDrf_tiFilSetSprtPosBlwAcOn_GM "time constant, Sport, pos. load alteration damping with AC on" MAP 0x8050DFE4 RB_MapGroup_U8 2.540 t_q0p01 0.010 2.550 FORMAT "%5.3" EXTENDED_LIMITS 0.00 2.550
 /begin AXIS_DESCR COM_AXIS PT_rTrq TransR 8 -327.6800 327.6700 FORMAT "%8.4" AXIS_PTS_REF ASDrf_rTrq_DST /end AXIS_DESCR
 /begin AXIS_DESCR COM_AXIS Epm_nEng EngN 8 -16384.00 16383.50 FORMAT "%8.2" AXIS_PTS_REF ASDrf_nEng_DST /end AXIS_DESCR
/end CHARACTERISTIC
/begin CHARACTERISTIC ASDrf_tiFilSetSprtPosBlw_GM "time constant, Sport, pos. load alteration damping" MAP 0x8050E024 RB_MapGroup_U8 2.540 t_q0p01 0.010 2.550 FORMAT "%5.3" EXTENDED_LIMITS 0.00 2.550
 /begin AXIS_DESCR COM_AXIS PT_rTrq TransR 8 -327.6800 327.6700 FORMAT "%8.4" AXIS_PTS_REF ASDrf_rTrq_DST /end AXIS_DESCR
 /begin AXIS_DESCR COM_AXIS Epm_nEng EngN 8 -16384.00 16383.50 FORMAT "%8.2" AXIS_PTS_REF ASDrf_nEng_DST /end AXIS_DESCR
/end CHARACTERISTIC
/begin CHARACTERISTIC ASDrf_tiFilSetSptMtModNegAcOn_GM "time constant, sport Mode negative load alteration when Ac is On" MAP 0x8050E064 RB_MapGroup_U8 2.540 t_q0p01 0.010 2.550 FORMAT "%5.3" EXTENDED_LIMITS 0.00 2.550
 /begin AXIS_DESCR COM_AXIS ASDrf_tqCluBasc Trq 5 -3276.800 3276.700 FORMAT "%8.3" AXIS_PTS_REF ASDrf_trqClthBs_DST /end AXIS_DESCR
 /begin AXIS_DESCR COM_AXIS Epm_nEng EngN 8 -16384.00 16383.50 FORMAT "%8.2" AXIS_PTS_REF ASDrf_nEng_DST /end AXIS_DESCR
/end CHARACTERISTIC
/begin CHARACTERISTIC ASDrf_tiFilSetSptMtModPosAbvAcOn_GM "time constant, sport Mode positive load alteration when Ac is On for above" MAP 0x8050E08C RB_MapGroup_U8 2.540 t_q0p01 0.010 2.550 FORMAT "%5.3" EXTENDED_LIMITS 0.00 2.550
 /begin AXIS_DESCR COM_AXIS PT_rTrq TransR 8 -327.6800 327.6700 FORMAT "%8.4" AXIS_PTS_REF ASDrf_rTrq_DST /end AXIS_DESCR
 /begin AXIS_DESCR COM_AXIS Epm_nEng EngN 8 -16384.00 16383.50 FORMAT "%8.2" AXIS_PTS_REF ASDrf_nEng_DST /end AXIS_DESCR
/end CHARACTERISTIC
/begin CHARACTERISTIC ASDrf_tiFilSetSptMtModPosBlwAcOn_GM "time constant, sport Mode positive load alteration when Ac is On for below" MAP 0x8050E0CC RB_MapGroup_U8 2.540 t_q0p01 0.010 2.550 FORMAT "%5.3" EXTENDED_LIMITS 0.00 2.550
 /begin AXIS_DESCR COM_AXIS PT_rTrq TransR 8 -327.6800 327.6700 FORMAT "%8.4" AXIS_PTS_REF ASDrf_rTrq_DST /end AXIS_DESCR
 /begin AXIS_DESCR COM_AXIS Epm_nEng EngN 8 -16384.00 16383.50 FORMAT "%8.2" AXIS_PTS_REF ASDrf_nEng_DST /end AXIS_DESCR
/end CHARACTERISTIC
/begin CHARACTERISTIC ASDrf_tiFltSetAirCdnrOnGripNeg_GM "time constant, Grip at clutch, neg. load alteration damping for AC on" MAP 0x8050E10C RB_MapGroup_U8 2.540 t_q0p01 0.010 2.550 FORMAT "%5.3" EXTENDED_LIMITS 0.00 2.550
 /begin AXIS_DESCR COM_AXIS ASDrf_tqCluBasc Trq 5 -3276.800 3276.700 FORMAT "%8.3" AXIS_PTS_REF ASDrf_trqClthBs_DST /end AXIS_DESCR
 /begin AXIS_DESCR COM_AXIS Epm_nEng EngN 8 -16384.00 16383.50 FORMAT "%8.2" AXIS_PTS_REF ASDrf_nEng_DST /end AXIS_DESCR
/end CHARACTERISTIC
/begin CHARACTERISTIC ASDrf_tiFltSetAirCdnrOnNegFCOEco_GT "Filter time constant for FCO negative in Eco mode when AC is ON" CURVE 0x8050E134 RB_CurveGroup_U8 2.540 t_q0p01 0.010 2.550 FORMAT "%5.3" EXTENDED_LIMITS 0.00 2.550
 /begin AXIS_DESCR COM_AXIS Epm_nEng EngN 8 -16384.00 16383.50 FORMAT "%8.2" AXIS_PTS_REF ASDrf_nEng_DST /end AXIS_DESCR
/end CHARACTERISTIC
/begin CHARACTERISTIC ASDrf_tiFltSetAirCdnrOnNegFCO_GT "time constant for transission into FCO für AC on" CURVE 0x8050E13C RB_CurveGroup_U8 2.540 t_q0p01 0.010 2.550 FORMAT "%5.3" EXTENDED_LIMITS 0.00 2.550
 /begin AXIS_DESCR COM_AXIS Epm_nEng EngN 8 -16384.00 16383.50 FORMAT "%8.2" AXIS_PTS_REF ASDrf_nEng_DST /end AXIS_DESCR
/end CHARACTERISTIC
/begin CHARACTERISTIC ASDrf_tiFltSetEcoAirCdnrOnGripNeg_GM "time constant, ECO, Grip at clutch, neg. load alteration damping for AC on" MAP 0x8050E144 RB_MapGroup_U8 2.540 t_q0p01 0.010 2.550 FORMAT "%5.3" EXTENDED_LIMITS 0.00 2.550
 /begin AXIS_DESCR COM_AXIS ASDrf_tqCluBasc Trq 5 -3276.800 3276.700 FORMAT "%8.3" AXIS_PTS_REF ASDrf_trqClthBs_DST /end AXIS_DESCR
 /begin AXIS_DESCR COM_AXIS Epm_nEng EngN 8 -16384.00 16383.50 FORMAT "%8.2" AXIS_PTS_REF ASDrf_nEng_DST /end AXIS_DESCR
/end CHARACTERISTIC
/begin CHARACTERISTIC ASDrf_tiFltSetGripNeg_MAP "time constant, Grip at clutch, neg. load alteration damping" MAP 0x8050E16C RB_MapGroup_U8 2.540 t_q0p01 0.010 2.550 FORMAT "%5.3" EXTENDED_LIMITS 0.00 2.550
 /begin AXIS_DESCR COM_AXIS ASDrf_tqCluBasc Trq 5 -3276.800 3276.700 FORMAT "%8.3" AXIS_PTS_REF ASDrf_trqClthBs_DST /end AXIS_DESCR
 /begin AXIS_DESCR COM_AXIS ASDrf_nPt EngN 8 -16384.00 16383.50 FORMAT "%8.2" AXIS_PTS_REF ASDrf_nPt_DST /end AXIS_DESCR
/end CHARACTERISTIC
/begin CHARACTERISTIC ASDrf_tiFltSetGripPosAbvAcOn_GMAP "time constant, Grip at clutch, pos. load alteration damping during AC On" MAP 0x8050E194 RB_MapGroup_U8 2.540 t_q0p01 0.010 2.550 FORMAT "%5.3" EXTENDED_LIMITS 0.00 2.550
 /begin AXIS_DESCR COM_AXIS PT_rTrq TransR 8 -327.6800 327.6700 FORMAT "%8.4" AXIS_PTS_REF ASDrf_rTrq_DST /end AXIS_DESCR
 /begin AXIS_DESCR COM_AXIS Epm_nEng EngN 8 -16384.00 16383.50 FORMAT "%8.2" AXIS_PTS_REF ASDrf_nEng_DST /end AXIS_DESCR
/end CHARACTERISTIC
/begin CHARACTERISTIC ASDrf_tiFltSetGripPosAbv_GMAP "time constant, Grip at clutch, pos. load alteration damping" MAP 0x8050E1D4 RB_MapGroup_U8 2.540 t_q0p01 0.010 2.550 FORMAT "%5.3" EXTENDED_LIMITS 0.00 2.550
 /begin AXIS_DESCR COM_AXIS PT_rTrq TransR 8 -327.6800 327.6700 FORMAT "%8.4" AXIS_PTS_REF ASDrf_rTrq_DST /end AXIS_DESCR
 /begin AXIS_DESCR COM_AXIS ASDrf_nPt EngN 8 -16384.00 16383.50 FORMAT "%8.2" AXIS_PTS_REF ASDrf_nPt_DST /end AXIS_DESCR
/end CHARACTERISTIC
/begin CHARACTERISTIC ASDrf_tiFltSetGripPosBlwAcOn_GMAP "time constant, Grip at clutch, pos. load alteration damping during AC On" MAP 0x8050E214 RB_MapGroup_U8 2.540 t_q0p01 0.010 2.550 FORMAT "%5.3" EXTENDED_LIMITS 0.00 2.550
 /begin AXIS_DESCR COM_AXIS PT_rTrq TransR 8 -327.6800 327.6700 FORMAT "%8.4" AXIS_PTS_REF ASDrf_rTrq_DST /end AXIS_DESCR
 /begin AXIS_DESCR COM_AXIS Epm_nEng EngN 8 -16384.00 16383.50 FORMAT "%8.2" AXIS_PTS_REF ASDrf_nEng_DST /end AXIS_DESCR
/end CHARACTERISTIC
/begin CHARACTERISTIC ASDrf_tiFltSetGripPosBlw_GMAP "time constant, Grip at clutch, pos. load alteration damping" MAP 0x8050E254 RB_MapGroup_U8 2.540 t_q0p01 0.010 2.550 FORMAT "%5.3" EXTENDED_LIMITS 0.00 2.550
 /begin AXIS_DESCR COM_AXIS PT_rTrq TransR 8 -327.6800 327.6700 FORMAT "%8.4" AXIS_PTS_REF ASDrf_rTrq_DST /end AXIS_DESCR
 /begin AXIS_DESCR COM_AXIS ASDrf_nPt EngN 8 -16384.00 16383.50 FORMAT "%8.2" AXIS_PTS_REF ASDrf_nPt_DST /end AXIS_DESCR
/end CHARACTERISTIC
/begin CHARACTERISTIC ASDrf_tiFltSetNegFCOEco_GT "time constant, Eco , neg. load alteration damping for FCO" CURVE 0x8050E294 RB_CurveGroup_U8 2.540 t_q0p01 0.010 2.550 FORMAT "%5.3" EXTENDED_LIMITS 0.00 2.550
 /begin AXIS_DESCR COM_AXIS Epm_nEng EngN 8 -16384.00 16383.50 FORMAT "%8.2" AXIS_PTS_REF ASDrf_nEng_DST /end AXIS_DESCR
/end CHARACTERISTIC
/begin CHARACTERISTIC ASDrf_tiFltSetNegFCOSprt_GCUR "Sports mode:time constant for transission into FCO" CURVE 0x8050E29C RB_CurveGroup_U8 2.540 t_q0p01 0.010 2.550 FORMAT "%5.3" EXTENDED_LIMITS 0.00 2.550
 /begin AXIS_DESCR COM_AXIS Epm_nEng EngN 8 -16384.00 16383.50 FORMAT "%8.2" AXIS_PTS_REF ASDrf_nEng_DST /end AXIS_DESCR
/end CHARACTERISTIC
/begin CHARACTERISTIC ASDrf_tiFltSetNegFCO_GCUR "time constant for transission into FCO" CURVE 0x8050E2A4 RB_CurveGroup_U8 2.540 t_q0p01 0.010 2.550 FORMAT "%5.3" EXTENDED_LIMITS 0.00 2.550
 /begin AXIS_DESCR COM_AXIS ASDrf_nPt EngN 8 -16384.00 16383.50 FORMAT "%8.2" AXIS_PTS_REF ASDrf_nPt_DST /end AXIS_DESCR
/end CHARACTERISTIC
/begin CHARACTERISTIC ASDrf_tiFltSetNegMax_C "maximum filter time at negative load change" VALUE 0x8050E2AC RB_Val_Wu8 2.540 t_q0p01 0.010 2.550 FORMAT "%5.3" EXTENDED_LIMITS 0.00 2.550 /end CHARACTERISTIC
/begin CHARACTERISTIC ASDrf_tiFltSetNoGripNegAddl_C "time constant, open powertrain, neg. load alteration damping" VALUE 0x8050E2AD RB_Val_Wu8 2.540 t_q0p01 0.010 2.550 FORMAT "%5.3" EXTENDED_LIMITS 0.00 2.550 /end CHARACTERISTIC
/begin CHARACTERISTIC ASDrf_tiFltSetNoGripNeg_C "time constant, open powertrain, neg. load alteration damping" VALUE 0x8050E2AE RB_Val_Wu8 2.540 t_q0p01 0.010 2.550 FORMAT "%5.3" EXTENDED_LIMITS 0.00 2.550 /end CHARACTERISTIC
/begin CHARACTERISTIC ASDrf_tiFltSetNoGripPosAddl_C "time constant, open powertrain, pos. load alteration damping" VALUE 0x8050E2AF RB_Val_Wu8 2.540 t_q0p01 0.010 2.550 FORMAT "%5.3" EXTENDED_LIMITS 0.00 2.550 /end CHARACTERISTIC
/begin CHARACTERISTIC ASDrf_tiFltSetNoGripPos_C "time constant, open powertrain, pos. load alteration damping" VALUE 0x8050E2B0 RB_Val_Wu8 2.540 t_q0p01 0.010 2.550 FORMAT "%5.3" EXTENDED_LIMITS 0.00 2.550 /end CHARACTERISTIC
/begin CHARACTERISTIC ASDrf_tiFltSetPosFCOEco_GMAP "time constant for resumption after fuel cut off, Eco mode" MAP 0x8050E2B1 RB_MapGroup_U8 2.540 t_q0p01 0.010 2.550 FORMAT "%5.3" EXTENDED_LIMITS 0.00 2.550
 /begin AXIS_DESCR COM_AXIS ASDrf_facDesDyn Fact 10 -4.000000 3.999878 FORMAT "%8.6" AXIS_PTS_REF ASDrf_facDesDyn_DST /end AXIS_DESCR
 /begin AXIS_DESCR COM_AXIS PT_rTrq TransR 8 -327.6800 327.6700 FORMAT "%8.4" AXIS_PTS_REF ASDrf_rTrq_DST /end AXIS_DESCR
/end CHARACTERISTIC
/begin CHARACTERISTIC ASDrf_tiFltSetPosFCOSprt_GMAP "Sports mode:time constant for resumption after fuel cut off" MAP 0x8050E301 RB_MapGroup_U8 2.540 t_q0p01 0.010 2.550 FORMAT "%5.3" EXTENDED_LIMITS 0.00 2.550
 /begin AXIS_DESCR COM_AXIS ASDrf_facDesDyn Fact 10 -4.000000 3.999878 FORMAT "%8.6" AXIS_PTS_REF ASDrf_facDesDyn_DST /end AXIS_DESCR
 /begin AXIS_DESCR COM_AXIS PT_rTrq TransR 8 -327.6800 327.6700 FORMAT "%8.4" AXIS_PTS_REF ASDrf_rTrq_DST /end AXIS_DESCR
/end CHARACTERISTIC
/begin CHARACTERISTIC ASDrf_tiFltSetPosFCO_GMAP "time constant for resumption after fuel cut off" MAP 0x8050E351 RB_MapGroup_U8 2.540 t_q0p01 0.010 2.550 FORMAT "%5.3" EXTENDED_LIMITS 0.00 2.550
 /begin AXIS_DESCR COM_AXIS ASDrf_facDesDyn Fact 10 -4.000000 3.999878 FORMAT "%8.6" AXIS_PTS_REF ASDrf_facDesDyn_DST /end AXIS_DESCR
 /begin AXIS_DESCR COM_AXIS PT_rTrq TransR 8 -327.6800 327.6700 FORMAT "%8.4" AXIS_PTS_REF ASDrf_rTrq_DST /end AXIS_DESCR
/end CHARACTERISTIC
/begin CHARACTERISTIC ASDrf_tiMaxCalcOff_C "maximum use time of reset condition" VALUE 0x8050E3A1 RB_Val_Wu8 2.550 t_q0p01 0.00 2.550 FORMAT "%5.3" /end CHARACTERISTIC
/begin CHARACTERISTIC ASDrf_tqLosOfsAirCdnrOnNegSet_C "offset to clutch torque zero neg. load alteration damping for AC on" VALUE 0x8050E3A2 RB_Val_Ws16 6553.500 md_sw_q0p1 -3276.800 3276.700 FORMAT "%8.3" /end CHARACTERISTIC
/begin AXIS_PTS ASDrf_trqClthBs_DST "basic torque on clutch level" 0x8050E3A4 ASDrf_tqCluBasc RB_Axis_S16 6553.500 Trq 5 -3276.800 3276.700 FORMAT "%8.3" DEPOSIT ABSOLUTE /end AXIS_PTS
/begin CHARACTERISTIC ASDrf_trqFCOFltCut_C "ASDrf condition filter cut off threshold torque path" VALUE 0x8050E3B0 RB_Val_Wu16 6553.500 Trq 0.00 6553.500 FORMAT "%8.3" /end CHARACTERISTIC
/begin CHARACTERISTIC ASDrf_trqLosOfsNegSetEco_C "Eco mode:offset to clutch torque zero neg. load alteration damping" VALUE 0x8050E3B2 RB_Val_Ws16 6553.500 md_sw_q0p1 -3276.800 3276.700 FORMAT "%8.3" /end CHARACTERISTIC
/begin CHARACTERISTIC ASDrf_trqLosOfsNegSetSprt_C "Sports mode:offset to clutch torque zero neg. load alteration damping" VALUE 0x8050E3B4 RB_Val_Ws16 6553.500 md_sw_q0p1 -3276.800 3276.700 FORMAT "%8.3" /end CHARACTERISTIC
/begin CHARACTERISTIC ASDrf_trqLosOfsNegSet_C "offset to clutch torque zero neg. load alteration damping" VALUE 0x8050E3B6 RB_Val_Ws16 6553.500 Trq -3276.800 3276.700 FORMAT "%8.3" /end CHARACTERISTIC
/begin CHARACTERISTIC ASDrf_trqLosOfsPosSetEco_C "Eco mode:offset to clutch torque zero pos. load alteration damping" VALUE 0x8050E3B8 RB_Val_Ws16 6553.500 md_sw_q0p1 -3276.800 3276.700 FORMAT "%8.3" /end CHARACTERISTIC
/begin CHARACTERISTIC ASDrf_trqLosOfsPosSetSprt_C "Sports mode:offset to clutch torque zero pos. load alteration damping" VALUE 0x8050E3BA RB_Val_Ws16 6553.500 md_sw_q0p1 -3276.800 3276.700 FORMAT "%8.3" /end CHARACTERISTIC
/begin CHARACTERISTIC ASDrf_trqLosOfsPosSet_C "offset to clutch torque zero pos. load alteration damping" VALUE 0x8050E3BC RB_Val_Ws16 6553.500 Trq -3276.800 3276.700 FORMAT "%8.3" /end CHARACTERISTIC
/begin CHARACTERISTIC ASDrf_trqThresDP1_C "torque threshold negative load alteration" VALUE 0x8050E3BE RB_Val_Ws16 3276.700 Trq 0.00 3276.700 FORMAT "%8.3" EXTENDED_LIMITS -3276.800 3276.700 /end CHARACTERISTIC
/begin CHARACTERISTIC ASDrf_trqThresDP2_C "torque threshold negative load alteration" VALUE 0x8050E3C0 RB_Val_Ws16 3276.800 Trq -3276.800 0.00 FORMAT "%8.3" EXTENDED_LIMITS -3276.800 3276.700 /end CHARACTERISTIC
/begin CHARACTERISTIC ASDrf_vDONeg_C "speed threshold for negative driveability" VALUE 0x8050E3C2 RB_Val_Ws16 655.3500 vel_q0p01 -327.6800 327.6700 FORMAT "%8.4" /end CHARACTERISTIC
/begin CHARACTERISTIC ASDrf_vDOPos_C "speed threshold for positive driveability" VALUE 0x8050E3C4 RB_Val_Ws16 655.3500 vel_q0p01 -327.6800 327.6700 FORMAT "%8.4" /end CHARACTERISTIC
/begin CHARACTERISTIC ASDrf_vNoGripDQ_C "speed threshold for no grip" VALUE 0x8050E3C6 RB_Val_Ws16 655.3500 vel_q0p01 -327.6800 327.6700 FORMAT "%8.4" /end CHARACTERISTIC
/begin CHARACTERISTIC ATS_Standby_Disabled_C "" VALUE 0x8058A6E0 Val_Wu8 255.0 OneToOne 0.00 255.0 FORMAT "%5.1" /end CHARACTERISTIC
/begin CHARACTERISTIC ATS_tiTstDemHeal_C "" VALUE 0x8058A6E2 Val_Wu16 655.3500 Time_s 0.00 655.3500 FORMAT "%8.4" /end CHARACTERISTIC
/begin CHARACTERISTIC ATS_tiTstDemMax_C "" VALUE 0x8058A6E4 Val_Wu16 655.3500 Time_s 0.00 655.3500 FORMAT "%8.4" /end CHARACTERISTIC
/begin CHARACTERISTIC ATS_TmrBehaviour_C "" VALUE 0x8058A6E6 Val_Wu8 255.0 OneToOne 0.00 255.0 FORMAT "%5.1" /end CHARACTERISTIC
/begin CHARACTERISTIC ATS_TstDemMaxEngN_C "" VALUE 0x8058A6F8 Val_Wu8 10200. EngN_LRes 0.00 10200. FORMAT "%5.0" /end CHARACTERISTIC
/begin CHARACTERISTIC ATS_TstDemMaxVSSCDV_C "" VALUE 0x8058A6FA Val_Ws16 655.3500 Vel -327.6800 327.6700 FORMAT "%8.4" /end CHARACTERISTIC
/begin CHARACTERISTIC ComDCDC_stBitMskByt0_C "Disabling/enabling bit mask for reception message byte 0 from DCDC converter" VALUE 0x80525CD4 RB_Val_Wu8 255.0 OneToOne 0.00 255.0 FORMAT "%5.1" /end CHARACTERISTIC
/begin CHARACTERISTIC ComDCDC_stBitMskByt1_C "Disabling/enabling bit mask for reception message byte 1 from DCDC converter" VALUE 0x80525CD5 RB_Val_Wu8 255.0 OneToOne 0.00 255.0 FORMAT "%5.1" /end CHARACTERISTIC
/begin CHARACTERISTIC PHAACTRINTK_CTL_ATS_ATS.LimitTypeMsk_C "Actuator test PHAACTRINTK_CTL_ATS_ATS / Tester demand monitoring enable mask for actuators" VALUE 0x8058A82C Val_Wu8 255.0 OneToOne 0.00 255.0 FORMAT "%5.1" /end CHARACTERISTIC
/begin CHARACTERISTIC PHAACTRINTK_CTL_ATS_ATS.CnvNorm_C "Actuator test PHAACTRINTK_CTL_ATS_ATS / Conversion norm used for conversion to/from internal scaling" VALUE 0x8058A82D Val_Wu8 255.0 OneToOne 0.00 255.0 FORMAT "%5.1" /end CHARACTERISTIC
/begin CHARACTERISTIC PHAACTRINTK_CTL_ATS_ATS.LowLim_C "Actuator test PHAACTRINTK_CTL_ATS_ATS / Lower limit for monitoring" VALUE 0x8058A82E Val_Ws16 1023.984 kw_q0p0156 -512.0000 511.9844 FORMAT "%8.4" /end CHARACTERISTIC
/begin CHARACTERISTIC PHAACTRINTK_CTL_ATS_ATS.UpLim_C "Actuator test PHAACTRINTK_CTL_ATS_ATS / Upper limit for monitoring" VALUE 0x8058A830 Val_Ws16 1023.984 kw_q0p0156 -512.0000 511.9844 FORMAT "%8.4" /end CHARACTERISTIC
/begin CHARACTERISTIC PHAACTRINTK_CTL_ATS_ATS.CnvFac_C "Actuator test PHAACTRINTK_CTL_ATS_ATS / Factor used for conversion to/from internal scaling" VALUE 0x8058A834 Val_Ws32 4294967295.00 OneToOne -2147483648.00 2147483647.00 FORMAT "%13.2" /end CHARACTERISTIC
/begin CHARACTERISTIC PHAACTRINTK_CTL_ATS_ATS.CnvOfs_C "Actuator test PHAACTRINTK_CTL_ATS_ATS / Offset used for conversion to/from internal scaling" VALUE 0x8058A838 Val_Ws16 65535.00 OneToOne -32768.00 32767.00 FORMAT "%8.2" /end CHARACTERISTIC
/begin CHARACTERISTIC PHAACTRINTK_CTL_ATS_ATS.DfltVal_C "Actuator test PHAACTRINTK_CTL_ATS_ATS / Default value for standbytest" VALUE 0x8058A83A Val_Ws16 65535.00 OneToOne -32768.00 32767.00 FORMAT "%8.2" /end CHARACTERISTIC
/begin CHARACTERISTIC PSPVDKUG "Ratio pspvdk not reduced" VALUE 0x8050E3C8 RB_Val_Wu16 1.999969 fak_uw_b2 0.00 1.999969 FORMAT "%8.6" READ_ONLY /end CHARACTERISTIC
/begin CHARACTERISTIC Vlvlft_agOffsSafeSwt_C "Valve Lift Angle crank for switch intake" VALUE 0x8050E3CA RB_Val_Wu16 65535.00 kw_q1 0.00 65535.00 FORMAT "%8.2" /end CHARACTERISTIC
/begin CHARACTERISTIC Vlvlft_nrCylActrIntk_T "Allocate Cylinder to corresponding actuator" VAL_BLK 0x8050E3CC RB_ValA_Wu8 255.0 dez 0.00 255.0 FORMAT "%5.1" NUMBER 8 /end CHARACTERISTIC
/begin CHARACTERISTIC VlvLft_nrSegOffsTrigChrgDetrmIntk_C "No of segments offset for delaying aircharge calculation signal one synchro before expected valve switch." VALUE 0x8050E3D4 RB_Val_Wu8 8.000 dez 0.00 8.000 FORMAT "%5.3" EXTENDED_LIMITS 0.00 255.0 /end CHARACTERISTIC
/begin CHARACTERISTIC VlvLft_percAirChrgChgThd_C "Threshold for dynamic relative air charge for DK when switching air actuators" VALUE 0x8050E3D6 RB_Val_Ws16 1535.977 rel_q0p0234 -768.0000 767.9766 FORMAT "%8.4" /end CHARACTERISTIC
/begin CHARACTERISTIC VlvLft_selStdLftCfg_C "Codeword to select Standard Lift configuration" VALUE 0x8050E3D8 RB_Val_Wu8 255.0 dez 0.00 255.0 FORMAT "%5.1" /end CHARACTERISTIC
/begin CHARACTERISTIC Vlvlft_tiEleclDlySpclIntk_M "Map for Electrical delay during Special Lift" MAP 0x8050E3D9 RB_Map_U8U8_U8 255.0 t_q1_ms 0.00 255.0 FORMAT "%5.1"
 /begin AXIS_DESCR STD_AXIS NO_INPUT_QUANTITY temp_ub_q0p75_o48 6 -48.0 143.3 FORMAT "%5.1" DEPOSIT ABSOLUTE /end AXIS_DESCR
 /begin AXIS_DESCR STD_AXIS NO_INPUT_QUANTITY spg_q0p1 6 0.00 25.50 FORMAT "%5.2" DEPOSIT ABSOLUTE /end AXIS_DESCR
/end CHARACTERISTIC
/begin CHARACTERISTIC Vlvlft_tiEleclDlyStdIntk_M "Map for Electrical delay during Standard Lift" MAP 0x8050E40B RB_Map_U8U8_U8 255.0 t_q1_ms 0.00 255.0 FORMAT "%5.1"
 /begin AXIS_DESCR STD_AXIS NO_INPUT_QUANTITY temp_ub_q0p75_o48 6 -48.0 143.3 FORMAT "%5.1" DEPOSIT ABSOLUTE /end AXIS_DESCR
 /begin AXIS_DESCR STD_AXIS NO_INPUT_QUANTITY spg_q0p1 6 0.00 25.50 FORMAT "%5.2" DEPOSIT ABSOLUTE /end AXIS_DESCR
/end CHARACTERISTIC
/begin CHARACTERISTIC Vlvlft_tiMeclDlySpclIntk_M "Map for Mechanical delay during Special Lift" MAP 0x8050E43D RB_Map_U8U8_U8 255.0 t_q1_ms 0.00 255.0 FORMAT "%5.1"
 /begin AXIS_DESCR STD_AXIS NO_INPUT_QUANTITY temp_ub_q0p75_o48 6 -48.0 143.3 FORMAT "%5.1" DEPOSIT ABSOLUTE /end AXIS_DESCR
 /begin AXIS_DESCR STD_AXIS NO_INPUT_QUANTITY nmot_ub_q40 6 0.00 10200. FORMAT "%5.0" DEPOSIT ABSOLUTE /end AXIS_DESCR
/end CHARACTERISTIC
/begin CHARACTERISTIC Vlvlft_tiMeclDlyStdIntk_M "Map for Mechanical delay during Standard Lift" MAP 0x8050E46F RB_Map_U8U8_U8 255.0 t_q1_ms 0.00 255.0 FORMAT "%5.1"
 /begin AXIS_DESCR STD_AXIS NO_INPUT_QUANTITY temp_ub_q0p75_o48 6 -48.0 143.3 FORMAT "%5.1" DEPOSIT ABSOLUTE /end AXIS_DESCR
 /begin AXIS_DESCR STD_AXIS NO_INPUT_QUANTITY nmot_ub_q40 6 0.00 10200. FORMAT "%5.0" DEPOSIT ABSOLUTE /end AXIS_DESCR
/end CHARACTERISTIC
/begin CHARACTERISTIC Vlvlft_tiOilPDlySpclIntk_M "Map for pressure pump delay during Special Lift" MAP 0x8050E4A2 RB_Map_S16S16_S16 510.0000 t_q1_ms -255.0000 255.0000 FORMAT "%8.4" EXTENDED_LIMITS -32768.00 32767.00
 /begin AXIS_DESCR STD_AXIS NO_INPUT_QUANTITY temp_ub_q0p75_o48 6 -48.0000 143.2500 FORMAT "%8.4" EXTENDED_LIMITS -24624.00 24527.25 DEPOSIT ABSOLUTE /end AXIS_DESCR
 /begin AXIS_DESCR STD_AXIS NO_INPUT_QUANTITY Pres 6 0.00 1638.300 FORMAT "%8.3" EXTENDED_LIMITS -3276.800 3276.700 DEPOSIT ABSOLUTE /end AXIS_DESCR
/end CHARACTERISTIC
/begin CHARACTERISTIC Vlvlft_tiOilPDlyStdIntk_M "Map for pressure pump delay during Standard Lift" MAP 0x8050E506 RB_Map_S16S16_S16 510.0000 t_q1_ms -255.0000 255.0000 FORMAT "%8.4" EXTENDED_LIMITS -32768.00 32767.00
 /begin AXIS_DESCR STD_AXIS NO_INPUT_QUANTITY temp_ub_q0p75_o48 6 -48.0000 143.2500 FORMAT "%8.4" EXTENDED_LIMITS -24624.00 24527.25 DEPOSIT ABSOLUTE /end AXIS_DESCR
 /begin AXIS_DESCR STD_AXIS NO_INPUT_QUANTITY Pres 6 0.00 1638.300 FORMAT "%8.3" EXTENDED_LIMITS -3276.800 3276.700 DEPOSIT ABSOLUTE /end AXIS_DESCR
/end CHARACTERISTIC
/begin MEASUREMENT arqttev_w_msg "Set value by tester for canister purge valve" SWORD rel_q0p01 1 100 -327.6800 327.6700 FORMAT "%8.4" ECU_ADDRESS 0x60008DAC /end MEASUREMENT
/begin MEASUREMENT ASDrf_bATSlipOpnInhb "Bit status indicating converter slip open inhibition for Automatic Transmission" UBYTE B_TRUE 1 100 0.00 1.00000000000 BIT_MASK 0x1 FORMAT "%13.11" ECU_ADDRESS 0x6000E94F /end MEASUREMENT
/begin MEASUREMENT ASDrf_bCalcTrqBs "calculation base torque active" UBYTE B_TRUE 1 100 0.00 1.00000000000 BIT_MASK 0x1 FORMAT "%13.11" ECU_ADDRESS 0x6000F2A2 /end MEASUREMENT
/begin MEASUREMENT ASDrf_bCalcTrqBsFF_I.status "flip-flop calculation base torque active / current value of RS-FF" UBYTE B_TRUE 1 100 0.00 1.00000000000 BIT_MASK 0x1 FORMAT "%13.11" ECU_ADDRESS 0x600140A0 /end MEASUREMENT
/begin MEASUREMENT ASDrf_bCoEngCutOffER_I.buffer "CoEng condition filter cut off / rising edge detected" UBYTE B_TRUE 1 100 0.00 1.00000000000 BIT_MASK 0x1 FORMAT "%13.11" ECU_ADDRESS 0x600078B4 /end MEASUREMENT
/begin MEASUREMENT ASDrf_bCoEngCutOffER_I.oldSignal "CoEng condition filter cut off / flag rising edge" UBYTE B_TRUE 1 100 0.00 1.00000000000 BIT_MASK 0x1 FORMAT "%13.11" ECU_ADDRESS 0x600078B5 /end MEASUREMENT
/begin MEASUREMENT ASDrf_bConvSlipOpn "Converter slip open" UBYTE B_TRUE 1 100 0.00 1.00000000000 BIT_MASK 0x1 FORMAT "%13.11" ECU_ADDRESS 0x6000F2A1 /end MEASUREMENT
/begin MEASUREMENT ASDrf_bCutOffFF_I.status "ASDrf condition filter cut off / current value of RS-FF" UBYTE B_TRUE 1 100 0.00 1.00000000000 BIT_MASK 0x1 FORMAT "%13.11" ECU_ADDRESS 0x6000E94E /end MEASUREMENT
/begin MEASUREMENT ASDrf_bFltCut "ASDrf condition filter cut off activation flag" UBYTE B_TRUE 1 100 0.00 1.00000000000 BIT_MASK 0x1 FORMAT "%13.11" ECU_ADDRESS 0x6000F2A0 /end MEASUREMENT
/begin MEASUREMENT ASDrf_bNCmp "engine speed lower than turbin speed" UBYTE B_TRUE 1 100 0.00 1.00000000000 BIT_MASK 0x1 FORMAT "%13.11" ECU_ADDRESS 0x6000F29E /end MEASUREMENT
/begin MEASUREMENT ASDrf_bNCmpCvt "engine speed lower than turbin speed for CVT" UBYTE B_TRUE 1 100 0.00 1.00000000000 BIT_MASK 0x1 FORMAT "%13.11" ECU_ADDRESS 0x6000F29D /end MEASUREMENT
/begin MEASUREMENT ASDrf_bNCmpFF_I.status "flip-flop slip open active / current value of RS-FF" UBYTE B_TRUE 1 100 0.00 1.00000000000 BIT_MASK 0x1 FORMAT "%13.11" ECU_ADDRESS 0x600140A1 /end MEASUREMENT
/begin MEASUREMENT ASDrf_bNoGrip "Open Clutch from view of ASDrf" UBYTE B_TRUE 1 100 0.00 1.00000000000 BIT_MASK 0x1 FORMAT "%13.11" ECU_ADDRESS 0x6000F29C /end MEASUREMENT
/begin MEASUREMENT ASDrf_bSlipOpnActv "slip open active" UBYTE B_TRUE 1 100 0.00 1.00000000000 BIT_MASK 0x1 FORMAT "%13.11" ECU_ADDRESS 0x6000F297 /end MEASUREMENT
/begin MEASUREMENT ASDrf_CoefA "coefficient A of the parabolic limiter" UBYTE q0p0625_DIV_Nm_s 1 100 0.00 15.94 FORMAT "%5.2" ECU_ADDRESS 0x70005483 /end MEASUREMENT
/begin MEASUREMENT ASDrf_CoefB "coefficient B of the parabolic limiter" UBYTE mdgrad_q10 1 100 10. 2550. FORMAT "%5.0" ECU_ADDRESS 0x70005484 /end MEASUREMENT
/begin MEASUREMENT ASDrf_ctIniDrvSelPar10ms "drive cycle counter 10ms-task" UBYTE OneToOne 1 100 0.00 255.0 FORMAT "%5.1" ECU_ADDRESS 0x600140A7 /end MEASUREMENT
/begin MEASUREMENT ASDrf_dtqERNM_I.oldSignal "rising edge for reset of calculation base torque active / value of input signal last calculation" UBYTE B_TRUE 1 100 0.00 1.00000000000 BIT_MASK 0x1 FORMAT "%13.11" ECU_ADDRESS 0x6000E94D /end MEASUREMENT
/begin MEASUREMENT ASDrf_dtqTOFFVNM_I.time "turn off delay for reset of calculation base torque active / delay time" UBYTE t_q0p01 1 100 0.00 2.550 FORMAT "%5.3" ECU_ADDRESS 0x6000E94C /end MEASUREMENT
/begin MEASUREMENT ASDrf_facDesDyn "Factor driving dynamic" SWORD Fact 1 100 -4.000000 3.999878 FORMAT "%8.6" ECU_ADDRESS 0x600093EC /end MEASUREMENT
/begin MEASUREMENT ASDrf_flgEcoModActv "Flag to indicate eco mode related drivability parameters are active" UBYTE B_TRUE 1 100 0.00 1.00000000000 BIT_MASK 0x1 FORMAT "%13.11" ECU_ADDRESS 0x6000F296 /end MEASUREMENT
/begin MEASUREMENT ASDrf_flgSptModActv "Flag to indicate sport mode related drivability parameters are active" UBYTE B_TRUE 1 100 0.00 1.00000000000 BIT_MASK 0x1 FORMAT "%13.11" ECU_ADDRESS 0x6000F295 /end MEASUREMENT
/begin MEASUREMENT ASDrf_flgTrsmMtModActv "manual gear mode active" UBYTE B_TRUE 1 100 0.00 1.00000000000 BIT_MASK 0x1 FORMAT "%13.11" ECU_ADDRESS 0x6000F294 /end MEASUREMENT
/begin MEASUREMENT ASDrf_KdFltSet "factor: not filtered drivers request" UBYTE fak_ub_b2 1 100 0.00 1.000000 FORMAT "%8.6" ECU_ADDRESS 0x600140FD /end MEASUREMENT
/begin MEASUREMENT ASDrf_nPt "speed powertrain" SWORD EngN 1 100 -16384.00 16383.50 FORMAT "%8.2" ECU_ADDRESS 0x600093EA /end MEASUREMENT
/begin MEASUREMENT ASDrf_nThresNCmp "Correction of turbine rpm during open converter clutch" SWORD nmot_q0p5 1 100 -16384.00 16383.50 FORMAT "%8.2" ECU_ADDRESS 0x70005358 /end MEASUREMENT
/begin MEASUREMENT ASDrf_posSlipOpnER_I.buffer "rising edge torque gradient for slip open active / rising edge detected" UBYTE B_TRUE 1 100 0.00 1.00000000000 BIT_MASK 0x1 FORMAT "%13.11" ECU_ADDRESS 0x600078B2 /end MEASUREMENT
/begin MEASUREMENT ASDrf_posSlipOpnER_I.oldSignal "rising edge torque gradient for slip open active / flag rising edge" UBYTE B_TRUE 1 100 0.00 1.00000000000 BIT_MASK 0x1 FORMAT "%13.11" ECU_ADDRESS 0x600078B3 /end MEASUREMENT
/begin MEASUREMENT ASDrf_ratSlipOpenCmp "Open Slip compensation" UWORD CrCtlSlipRat 1 100 0.00 327.6750 FORMAT "%8.4" ECU_ADDRESS 0x600078BC /end MEASUREMENT
/begin MEASUREMENT ASDrf_rConvSlip "Ratio of Turbine speed to engine speed in percentage" UWORD CrCtlSlipRat 1 100 0.00 327.6750 FORMAT "%8.4" ECU_ADDRESS 0x60008D52 /end MEASUREMENT
/begin MEASUREMENT ASDrf_stEngOperModSeln "Satus to select drivability mode for parameter" UBYTE OneToOne 1 100 0.00 255.0 FORMAT "%5.1" ECU_ADDRESS 0x7000321E /end MEASUREMENT
/begin MEASUREMENT ASDrf_stParSet "status acktive set of parameter" UWORD dez 1 100 0.00 65535.00 FORMAT "%8.2" ECU_ADDRESS 0x70005286 /end MEASUREMENT
/begin MEASUREMENT ASDrf_tiFltSet "time constant set path" UBYTE t_q0p01 1 100 0.010 2.550 FORMAT "%5.3" ECU_ADDRESS 0x600140FE /end MEASUREMENT
/begin MEASUREMENT ASDrf_tqCluBas "base torque clutch torque level" SWORD Trq 1 100 -3276.800 3276.700 FORMAT "%8.3" ECU_ADDRESS 0x600093E8 /end MEASUREMENT
/begin MEASUREMENT ASDrf_tqCluBasc "basic clutch torque" SWORD Trq 1 100 -3276.800 3276.700 FORMAT "%8.3" ECU_ADDRESS 0x600093E4 /end MEASUREMENT
/begin MEASUREMENT ASDrf_tqCluBasLead "base torque clutch torque level for lead path" SWORD Trq 1 100 -3276.800 3276.700 FORMAT "%8.3" ECU_ADDRESS 0x600093E6 /end MEASUREMENT
/begin MEASUREMENT ASDrf_tqCluDemSet "set torque before ASD clutch torque level" SWORD Trq 1 100 -3276.800 3276.700 FORMAT "%8.3" ECU_ADDRESS 0x600093E2 /end MEASUREMENT
/begin MEASUREMENT ASDrf_tqLossBasc "Torque loss Bsis" SWORD Trq 1 100 -3276.800 3276.700 FORMAT "%8.3" ECU_ADDRESS 0x600078BA /end MEASUREMENT
/begin MEASUREMENT ASDrf_trqLosClthComp "Torque loss clutch compensation" SWORD Trq 1 100 -3276.800 3276.700 FORMAT "%8.3" ECU_ADDRESS 0x600078B8 /end MEASUREMENT
/begin MEASUREMENT ASDrf_trqLosComp "Torque loss compensation" SWORD Trq 1 100 -3276.800 3276.700 FORMAT "%8.3" ECU_ADDRESS 0x600078B6 /end MEASUREMENT
/begin MEASUREMENT ASDrf_trqLosSet "reference torque for ASD" SWORD Trq 1 100 -3276.800 3276.700 FORMAT "%8.3" ECU_ADDRESS 0x600093D6 /end MEASUREMENT
/begin MEASUREMENT ATS_ctCurRunTst "" UBYTE OneToOne 1 100 0.00 255.0 FORMAT "%5.1" ECU_ADDRESS 0x6000F8AA /end MEASUREMENT
/begin MEASUREMENT ATS_IntvVal_mp "Intervention value" SWORD OneToOne 1 100 -32768.00 32767.00 FORMAT "%8.2" ECU_ADDRESS 0x70009EE2 /end MEASUREMENT
/begin MEASUREMENT ATS_stMon "status of ATS internal monitoring" UBYTE OneToOne 1 100 0.00 255.0 FORMAT "%5.1" ECU_ADDRESS 0x6000F951 /end MEASUREMENT
/begin MEASUREMENT ATS_stMonTimeLimit "Behaviour time limit response for new tester demands" UBYTE OneToOne 1 100 0.00 255.0 FORMAT "%5.1" ECU_ADDRESS 0x6000F8A9 /end MEASUREMENT
/begin MEASUREMENT ATS_TstStatus_mp "Status of actuatorintervention" UBYTE OneToOne 1 100 0.00 255.0 FORMAT "%5.1" ECU_ADDRESS 0x70009FEE /end MEASUREMENT
/begin MEASUREMENT B_btaavet_msg "condition actuator request; Canister vent open" UBYTE B_TRUE 1 100 0.00 1.00000000000 BIT_MASK 0x1 FORMAT "%13.11" ECU_ADDRESS 0x6000F277 /end MEASUREMENT
/begin MEASUREMENT B_btaave_msg "condition actuator request; Canister vent enable" UBYTE B_TRUE 1 100 0.00 1.00000000000 BIT_MASK 0x1 FORMAT "%13.11" ECU_ADDRESS 0x6000F278 /end MEASUREMENT
/begin MEASUREMENT B_cwdk_msg "device control DCPIDCM" UBYTE B_TRUE 1 100 0.00 1.00000000000 BIT_MASK 0x1 FORMAT "%13.11" ECU_ADDRESS 0x70000C18 /end MEASUREMENT
/begin MEASUREMENT B_faevz_msg "condition cylinder fade out by tester" UBYTE B_TRUE 1 100 0.00 1.00000000000 BIT_MASK 0x1 FORMAT "%13.11" ECU_ADDRESS 0x70000BCE /end MEASUREMENT
/begin MEASUREMENT B_rqttev_msg "Condition request by tester for canister purge valve" UBYTE B_TRUE 1 100 0.00 1.00000000000 BIT_MASK 0x1 FORMAT "%13.11" ECU_ADDRESS 0x70000B32 /end MEASUREMENT
/begin MEASUREMENT B_vhegfeloc "local variable for the mentioned label name in the var. e.g FC_var name" UBYTE B_TRUE 1 100 0.00 1.00000000000 BIT_MASK 0x1 FORMAT "%13.11" ECU_ADDRESS 0x70003632 /end MEASUREMENT
/begin MEASUREMENT B_vhegfe_msg "condition: high valve lift for timing of air charge determination ( one calculation step before calculation of air charge for switched cylinder)" UBYTE B_TRUE 1 100 0.00 1.00000000000 BIT_MASK 0x1 FORMAT "%13.11" ECU_ADDRESS 0x70003633 /end MEASUREMENT
/begin MEASUREMENT ComDCDC_nrSwVers "Software version from DCDC" UBYTE OneToOne 1 100 0.00 255.0 FORMAT "%5.1" ECU_ADDRESS 0x6000F714 /end MEASUREMENT
/begin MEASUREMENT ComDCDC_stBoosterErr "Booster error of DCDC" UBYTE OneToOne 1 100 0.00 255.0 FORMAT "%5.1" ECU_ADDRESS 0x6000F713 /end MEASUREMENT
/begin MEASUREMENT ComDCDC_stCSTErr "CST error for DC-DC unit" UBYTE OneToOne 1 100 0.00 255.0 FORMAT "%5.1" ECU_ADDRESS 0x6000F712 /end MEASUREMENT
/begin MEASUREMENT ComDCDC_stCSTHist "CST History from DCDC" UBYTE OneToOne 1 100 0.00 255.0 FORMAT "%5.1" ECU_ADDRESS 0x6000F711 /end MEASUREMENT
/begin MEASUREMENT ComDCDC_stDCLinRVer "Bit1.3 signal for frame id 0x10" UBYTE OneToOne 1 100 0.00 255.0 FORMAT "%5.1" ECU_ADDRESS 0x6000F710 /end MEASUREMENT
/begin MEASUREMENT ComDCDC_stErrEna "DC-DC converter error detection enable status" UBYTE OneToOne 1 100 0.00 255.0 FORMAT "%5.1" ECU_ADDRESS 0x6000F70D /end MEASUREMENT
/begin MEASUREMENT ComDCDC_stInpErr1 "Input error 1 of DCDC" UBYTE OneToOne 1 100 0.00 255.0 FORMAT "%5.1" ECU_ADDRESS 0x6000F70C /end MEASUREMENT
/begin MEASUREMENT ComDCDC_stInpErr2 "Input error 2 of DCDC" UBYTE OneToOne 1 100 0.00 255.0 FORMAT "%5.1" ECU_ADDRESS 0x6000F70B /end MEASUREMENT
/begin MEASUREMENT ComDCDC_stIntErr "Internal error of DCDC" UBYTE OneToOne 1 100 0.00 255.0 FORMAT "%5.1" ECU_ADDRESS 0x6000F70A /end MEASUREMENT
/begin MEASUREMENT ComDCDC_stMode "DCDC Mode status" UBYTE OneToOne 1 100 0.00 255.0 FORMAT "%5.1" ECU_ADDRESS 0x6000F709 /end MEASUREMENT
/begin MEASUREMENT ComDCDC_stOutpErr1 "Output error 1 of DCDC" UBYTE OneToOne 1 100 0.00 255.0 FORMAT "%5.1" ECU_ADDRESS 0x6000F708 /end MEASUREMENT
/begin MEASUREMENT ComDCDC_stOutpErr2 "Output error 2 of DCDC" UBYTE OneToOne 1 100 0.00 255.0 FORMAT "%5.1" ECU_ADDRESS 0x6000F707 /end MEASUREMENT
/begin MEASUREMENT ComDCDC_stTempWarn1 "Temperature warning 1 from DCDC" UBYTE OneToOne 1 100 0.00 255.0 FORMAT "%5.1" ECU_ADDRESS 0x6000F705 /end MEASUREMENT
/begin MEASUREMENT ComDCDC_stTempWarn2 "Temperature warning 2 from DCDC" UBYTE OneToOne 1 100 0.00 255.0 FORMAT "%5.1" ECU_ADDRESS 0x6000F704 /end MEASUREMENT
/begin MEASUREMENT ComDCDC_stUnitSt "Temperature warning 3 from DCDCC" UBYTE OneToOne 1 100 0.00 255.0 FORMAT "%5.1" ECU_ADDRESS 0x6000F703 /end MEASUREMENT
/begin MEASUREMENT Com_ctReIni10msBattECU_DCDC "The counter of ReInit Proc for BattEcu_DCDC" UBYTE OneToOne 1 100 0.00 255.0 FORMAT "%5.1" ECU_ADDRESS 0x6000E947 /end MEASUREMENT
/begin MEASUREMENT cvwdk_msg "device control value DCPIDCM" UBYTE rel_ub_b99p6 1 100 0.00 99.61 FORMAT "%5.2" ECU_ADDRESS 0x6000F2FE /end MEASUREMENT
/begin MEASUREMENT devoff_msg "injector fade out pattern at tester requirement" UBYTE dez 1 100 0.00 255.0 FORMAT "%5.1" ECU_ADDRESS 0x6000F2FD /end MEASUREMENT
/begin MEASUREMENT Epm_stSpdloc10ms "Engine Speed local variable" UBYTE B_TRUE 1 100 0.00 1.00000000000 BIT_MASK 0x1 FORMAT "%13.11" ECU_ADDRESS 0x6000F12B /end MEASUREMENT
/begin MEASUREMENT pspvds_w_msg "quotient manifold pressurepressure before throttle plate" UWORD fak_uw_b2 1 100 0.00 1.999969 FORMAT "%8.6" ECU_ADDRESS 0x60000D16 /end MEASUREMENT
/begin MEASUREMENT pssol_w_msg "Set intake manifold pressure" UWORD p_uw_q0p039 1 100 0.00 2559.961 FORMAT "%8.3" ECU_ADDRESS 0x60000D1A /end MEASUREMENT
/begin MEASUREMENT VlvLftCtl_agCrkforSwtIntkloc "local variable for FC:AVHE appended with the parent variable name" UWORD kw_q1 1 100 0.00 39500.00 FORMAT "%8.2" ECU_ADDRESS 0x50000890 /end MEASUREMENT
/begin MEASUREMENT VlvLftCtl_agGrundwertlocS0 "local variable for FC:AVHE appended with the parent variable name" UBYTE kw_q1 1 100 0.00 255.0 FORMAT "%5.1" ECU_ADDRESS 0x6000090A /end MEASUREMENT
/begin MEASUREMENT VlvLftCtl_facdrldvlswlocS0 "local variable for FC:AVHE appended with the parent variable name" SWORD rel_q0p0234 1 100 0.00 767.9766 FORMAT "%8.4" ECU_ADDRESS 0x600005EE /end MEASUREMENT
/begin MEASUREMENT VlvLftCtl_flgBkl15locS0loc "local variable for FC:AVHE appended with the parent variable name" UBYTE B_TRUE 1 100 0.00 1.00000000000 BIT_MASK 0x1 FORMAT "%13.11" ECU_ADDRESS 0x70003211 /end MEASUREMENT
/begin MEASUREMENT VlvLftCtl_flgBnminloc10ms "local variable for FC:AVHE appended with the parent variable name" UBYTE B_TRUE 1 100 0.00 1.00000000000 BIT_MASK 0x1 FORMAT "%13.11" ECU_ADDRESS 0x6000F05F /end MEASUREMENT
/begin MEASUREMENT VlvLftCtl_flgBvhegabgnlocS0 "local variable for FC:AVHE appended with the parent variable name" UBYTE B_TRUE 1 100 0.00 1.00000000000 BIT_MASK 0x1 FORMAT "%13.11" ECU_ADDRESS 0x70003210 /end MEASUREMENT
/begin MEASUREMENT VlvLftCtl_flgfbIntkswtoutp11loc "local variable for FC:AVHE appended with the parent variable name" UBYTE B_TRUE 1 100 0.00 1.00000000000 BIT_MASK 0x1 FORMAT "%13.11" ECU_ADDRESS 0x6000E94B /end MEASUREMENT
/begin MEASUREMENT VlvLftCtl_flgSyncVlvPosIntkloc "local variable for FC:AVHE appended with the parent variable name" UBYTE B_TRUE 1 100 0.00 1.00000000000 BIT_MASK 0x1 FORMAT "%13.11" ECU_ADDRESS 0x7000320F /end MEASUREMENT
/begin MEASUREMENT VlvLftCtl_nmotloc10ms "local variable for FC:AVHE appended with the parent variable name" UBYTE nmot_ub_q40 1 100 0.00 10200. FORMAT "%5.0" ECU_ADDRESS 0x6000F308 /end MEASUREMENT
/begin MEASUREMENT VlvLftCtl_nrCylSyncIntkloc "local variable for FC:AVHE appended with the parent variable name" UBYTE dez 1 100 0.00 255.0 FORMAT "%5.1" ECU_ADDRESS 0x50000976 /end MEASUREMENT
/begin MEASUREMENT VlvLftCtl_nrSegSwtIntkloc "local variable for FC:AVHE appended with the parent variable name" UBYTE dez 1 100 0.00 255.0 FORMAT "%5.1" ECU_ADDRESS 0x50000977 /end MEASUREMENT
/begin MEASUREMENT VlvLftCtl_nzzyllocS0 "local variable for FC:AVHE appended with the parent variable name" UBYTE dez 1 100 0.00 255.0 FORMAT "%5.1" ECU_ADDRESS 0x6000090B /end MEASUREMENT
/begin MEASUREMENT VlvLftCtl_poilploc20ms "local variable for FC:AVHE appended with the parent variable name" SWORD Pres 1 100 -3276.800 3276.700 FORMAT "%8.3" ECU_ADDRESS 0x600078B0 /end MEASUREMENT
/begin MEASUREMENT VlvLftCtl_ttochloc20ms "local variable for FC:AVHE appended with the parent variable name" UBYTE temp_ub_q0p75_o48 1 100 -48.0 143.3 FORMAT "%5.1" ECU_ADDRESS 0x6000E94A /end MEASUREMENT
/begin MEASUREMENT VlvLftCtl_ubsqfloc20ms "local variable for FC:AVHE appended with the parent variable name" UBYTE spg_q0p1 1 100 0.00 25.50 FORMAT "%5.2" ECU_ADDRESS 0x6000E949 /end MEASUREMENT
/begin MEASUREMENT VlvLftCtl_vwkwloc20ms "local variable for FC:AVHA appended with the parent variable name" UBYTE rel_ub_q0p1875 1 100 0.00 47.81 FORMAT "%5.2" ECU_ADDRESS 0x6000E948 /end MEASUREMENT
/begin MEASUREMENT VlvLftCtl_vwkwlocS0 "local variable for FC:AVHE appended with the parent variable name" UBYTE rel_ub_q0p1875 1 100 0.00 47.81 FORMAT "%5.2" ECU_ADDRESS 0x7000320E /end MEASUREMENT
/begin MEASUREMENT VlvLftCtl_wvhesdw20ms "local variable for FC:AVHE appended with the parent variable name" UWORD kw_q1 1 100 0.00 39500.00 FORMAT "%8.2" ECU_ADDRESS 0x600078AE /end MEASUREMENT
/begin MEASUREMENT VlvLft_agCrkForSwtIntk_msg "Valve Lift Angle crank for switch intake" UWORD kw_q1 1 100 0.00 39500.00 FORMAT "%8.2" ECU_ADDRESS 0x60008B36 /end MEASUREMENT
/begin MEASUREMENT VlvLft_fbIntkSwtVrbl11 "Verbal display of Actuator 11 feedback high or low cam" UBYTE VLVLFT_FBSWT_VERB 1 100 0.00 1.00000000000 FORMAT "%13.11" ECU_ADDRESS 0x6000F307 /end MEASUREMENT
/begin MEASUREMENT VlvLft_fbStIntkVrbl "Verbal display of ValveLft feedback high or low cam" UBYTE VLVLFT_FBSWT_VERB 1 100 0.00 1.00000000000 FORMAT "%13.11" ECU_ADDRESS 0x6000F306 /end MEASUREMENT
/begin MEASUREMENT VlvLft_flgCoorn1SynctoSwt "coordination signal one synchro before Valve switch" UBYTE B_TRUE 1 100 0.00 1.00000000000 BIT_MASK 0x1 FORMAT "%13.11" ECU_ADDRESS 0x70003603 /end MEASUREMENT
/begin MEASUREMENT VlvLft_flgCoornStrtofSwt "Coordination signal for start of Valve switch" UBYTE B_TRUE 1 100 0.00 1.00000000000 BIT_MASK 0x1 FORMAT "%13.11" ECU_ADDRESS 0x70003602 /end MEASUREMENT
/begin MEASUREMENT VlvLft_flgCtrlActrIntk1 "Condition controlling inlet magnetic valve 1 for VLI" UBYTE B_TRUE 1 100 0.00 1.00000000000 BIT_MASK 0x1 FORMAT "%13.11" ECU_ADDRESS 0x70003601 /end MEASUREMENT
/begin MEASUREMENT VlvLft_flgEnerBgnAdpnIntk "Flag energise begin adapted for Intake." UBYTE B_TRUE 1 100 0.00 1.00000000000 BIT_MASK 0x1 FORMAT "%13.11" ECU_ADDRESS 0x70003600 /end MEASUREMENT
/begin MEASUREMENT VlvLft_flgFbVlvStIntk "Condition valve lift variation switching camshaft control (hand shake)" UBYTE B_TRUE 1 100 0.00 1.00000000000 BIT_MASK 0x1 FORMAT "%13.11" ECU_ADDRESS 0x700035FF /end MEASUREMENT
/begin MEASUREMENT VlvLft_flgSyncVlvPosIntk_msg "Beginend of synchronization valve lift variation deactivation, injection, air charge and ignition 2 sychros before switch" UBYTE B_TRUE 1 100 0.00 1.00000000000 BIT_MASK 0x1 FORMAT "%13.11" ECU_ADDRESS 0x700035FE /end MEASUREMENT
/begin MEASUREMENT VlvLft_nrCylSyncIntk_msg "Cylinder number of first activateddeactivated VLI cylinder updated 2 syncros before switch" UBYTE dez 1 100 0.00 255.0 FORMAT "%5.1" ECU_ADDRESS 0x500009B7 /end MEASUREMENT
/begin MEASUREMENT VlvLft_nrSegSwtIntk_msg "Number of segments until VLI possible" UBYTE dez 1 100 0.00 255.0 FORMAT "%5.1" ECU_ADDRESS 0x7000366B /end MEASUREMENT
/begin MEASUREMENT VlvLft_stflgCtrlActrIntkVrbl1 "Verbal display of VlvLft_flgCtrlActrIntk1 signal" UBYTE VLVLFT_SIGACTR_VERB 1 100 0.00 1.00000000000 FORMAT "%13.11" ECU_ADDRESS 0x6000F305 /end MEASUREMENT
/begin MEASUREMENT VlvLft_tiDlyVlvActvnIntk "Delay time for VLI-valve activation" UBYTE t_q1_ms 1 100 0.00 255.0 FORMAT "%5.1" ECU_ADDRESS 0x6000F304 /end MEASUREMENT
/begin MEASUREMENT wvhesd_w_msg "crank angle from begin of switching lifted cam to inlet valve opens (based on current cam profile)" UWORD kw_q1 1 100 0.00 39500.00 FORMAT "%8.2" ECU_ADDRESS 0x50005EB6 /end MEASUREMENT
/begin MEASUREMENT zzylvheb "Calculated VHE starting with cylinder number" UBYTE dez 1 100 0.00 254.0 FORMAT "%5.1" ECU_ADDRESS 0x50000981 /end MEASUREMENT
/begin MEASUREMENT zzylvheb_temp "The cylinder number which is going to actuated first." UBYTE dez 1 100 0.00 254.0 FORMAT "%5.1" ECU_ADDRESS 0x6000092B /end MEASUREMENT
/begin FUNCTION ASDrf_SelPar "28.7.0    Parameter sets of drivability filters"
 /begin DEF_CHARACTERISTIC ASDrf_Cfg2_CW ASDrf_Cfg3_CW ASDrf_Cfg4_CW ASDrf_Cfg_CW ASDrf_CoefAAirCdnrOnGripNeg_GT ASDrf_CoefAEcoAirCdnrOnGripNeg_GT ASDrf_CoefAEcoMtModNeg_GT ASDrf_CoefAEcoMtModPosAbv_GT ASDrf_CoefAEcoMtModPosBlw_GT ASDrf_CoefAEcoNeg_GT ASDrf_CoefAEcoPosAbvAcOn_GT ASDrf_CoefAEcoPosAbv_GT ASDrf_CoefAEcoPosBlwAcOn_GT ASDrf_CoefAEcoPosBlw_GT ASDrf_CoefAGripMtModNeg_GT ASDrf_CoefAGripMtModPosAbv_GT ASDrf_CoefAGripMtModPosBlw_GT ASDrf_CoefAGripNeg_CUR ASDrf_CoefAGripPosAbvAcOn_GCUR ASDrf_CoefAGripPosAbv_GCUR ASDrf_CoefAGripPosBlwAcOn_GCUR ASDrf_CoefAGripPosBlw_GCUR ASDrf_CoefANoGripNegAddl_C ASDrf_CoefANoGripNeg_C ASDrf_CoefANoGripPosAddl_C ASDrf_CoefANoGripPos_C ASDrf_CoefASprtMtModNeg_GT ASDrf_CoefASprtMtModPosAbv_GT ASDrf_CoefASprtMtModPosBlw_GT ASDrf_CoefASprtNegAcOn_GT ASDrf_CoefASprtNeg_GT ASDrf_CoefASprtPosAbvAcOn_GT ASDrf_CoefASprtPosAbv_GT ASDrf_CoefASprtPosBlwAcOn_GT ASDrf_CoefASprtPosBlw_GT ASDrf_CoefBAirCdnrOnGripNeg_GM ASDrf_CoefBEcoAirCdnrOnGripNeg_GM ASDrf_CoefBEcoMtModNeg_GM ASDrf_CoefBEcoMtModPosAbv_GM ASDrf_CoefBEcoMtModPosBlw_GM ASDrf_CoefBEcoNeg_GM ASDrf_CoefBEcoPosAbvAcOn_GM ASDrf_CoefBEcoPosAbv_GM ASDrf_CoefBEcoPosBlwAcOn_GM ASDrf_CoefBEcoPosBlw_GM ASDrf_CoefBGripMtModNeg_GM ASDrf_CoefBGripMtModPosAbv_GM ASDrf_CoefBGripMtModPosBlw_GM ASDrf_CoefBGripNeg_GMAP ASDrf_CoefBGripPosAbvAcOn_GMAP ASDrf_CoefBGripPosAbv_GMAP ASDrf_CoefBGripPosBlwAcOn_GMAP ASDrf_CoefBGripPosBlw_GMAP ASDrf_CoefBNoGripNegAddl_C ASDrf_CoefBNoGripNeg_C ASDrf_CoefBNoGripPosAddl_C ASDrf_CoefBNoGripPos_C ASDrf_CoefBSprtMtModNeg_GM ASDrf_CoefBSprtMtModPosAbv_GM ASDrf_CoefBSprtMtModPosBlw_GM ASDrf_CoefBSprtNegAcOn_GM ASDrf_CoefBSprtNeg_GM ASDrf_CoefBSprtPosAbvAcOn_GM ASDrf_CoefBSprtPosAbv_GM ASDrf_CoefBSprtPosBlwAcOn_GM ASDrf_CoefBSprtPosBlw_GM ASDrf_CoeffAEcoMtModNegAcOn_GT ASDrf_CoeffAEcoMtModPosAbvAcOn_GT ASDrf_CoeffAEcoMtModPosBlwAcOn_GT ASDrf_CoeffAGripMtModNegAcOn_GT ASDrf_CoeffAGripMtModPosAbvAcOn_GT ASDrf_CoeffAGripMtModPosBlwAcOn_GT ASDrf_CoeffASptMtModNegAcOn_GT ASDrf_CoeffASptMtModPosAbvAcOn_GT ASDrf_CoeffASptMtModPosBlwAcOn_GT ASDrf_CoeffBEcoMtModNegAcOn_GM ASDrf_CoeffBEcoMtModPosAbvAcOn_GM ASDrf_CoeffBEcoMtModPosBlwAcOn_GM ASDrf_CoeffBGripMtModNegAcOn_GM ASDrf_CoeffBGripMtModPosAbvAcOn_GM ASDrf_CoeffBGripMtModPosBlwAcOn_GM ASDrf_CoeffBSptMtModNegAcOn_GM ASDrf_CoeffBSptMtModPosAbvAcOn_GM ASDrf_CoeffBSptMtModPosBlwAcOn_GM ASDrf_dnEngFlt_DST ASDrf_facCoefAEcoGripAirCdnrOnNeg_GT ASDrf_facCoefAEcoMtModPosAbv_GT ASDrf_facCoefAEcoPosAbvAcOn_GT ASDrf_facCoefAEcoPosAbv_GT ASDrf_facCoefAGripAirCdnrOnNeg_GT ASDrf_facCoefAGripNeg_GT ASDrf_facCoefAMtModPosAbv_GT ASDrf_facCoefAPosAbvAcOn_GCUR ASDrf_facCoefAPosAbv_GCUR ASDrf_facCoefASprtMtModPosAbv_GT ASDrf_facCoefASprtPosAbvAcOn_GT ASDrf_facCoefASprtPosAbv_GT ASDrf_facCoefBAirCdnrOnNeg_GT ASDrf_facCoefBEcoAirCdnrOnNeg_GT ASDrf_facCoefBEcoGripAirCdnrOnNeg_GT ASDrf_facCoefBEcoMtModNeg_GT ASDrf_facCoefBEcoMtModPosAbv_GM ASDrf_facCoefBEcoMtModPosBlw_GM ASDrf_facCoefBEcoNeg_GT ASDrf_facCoefBEcoPosAbvAcOn_GM ASDrf_facCoefBEcoPosAbv_GM ASDrf_facCoefBEcoPosBlwAcOn_GM ASDrf_facCoefBEcoPosBlw_GM ASDrf_facCoefBGripAirCdnrOnNeg_GT ASDrf_facCoefBGripNeg_GT ASDrf_facCoefBMtModNeg_GT ASDrf_facCoefBMtModPosAbv_GM ASDrf_facCoefBMtModPosBlw_GM ASDrf_facCoefBNeg_GCUR ASDrf_facCoefBPosAbvAcOn_GMAP ASDrf_facCoefBPosAbv_GMAP ASDrf_facCoefBPosBlwAcOn_GMAP ASDrf_facCoefBPosBlw_GMAP ASDrf_facCoefBSprtMtModNeg_GT ASDrf_facCoefBSprtMtModPosAbv_GM ASDrf_facCoefBSprtMtModPosBlw_GM ASDrf_facCoefBSprtNegAcOn_GT ASDrf_facCoefBSprtNeg_GT ASDrf_facCoefBSprtPosAbvAcOn_GM ASDrf_facCoefBSprtPosAbv_GM ASDrf_facCoefBSprtPosBlwAcOn_GM ASDrf_facCoefBSprtPosBlw_GM ASDrf_facCoeffAEcoMtModPosAbvAcOn_GT ASDrf_facCoeffAMtModPosAbvAcOn_GT ASDrf_facCoeffASptMtModPosAbvAcOn_GT ASDrf_facCoeffBEcoMtModNegAcOn_GT ASDrf_facCoeffBEcoMtModPosAbvAcOn_GM ASDrf_facCoeffBEcoMtModPosBlwAcOn_GM ASDrf_facCoeffBMtModNegAcOn_GT ASDrf_facCoeffBMtModPosAbvAcOn_GM ASDrf_facCoeffBMtModPosBlwAcOn_GM ASDrf_facCoeffBSptMtModNegAcOn_GT ASDrf_facCoeffBSptMtModPosAbvAcOn_GM ASDrf_facCoeffBSptMtModPosBlwAcOn_GM ASDrf_facDesDyn_DST ASDrf_facTiAirCdnrOnNeg_GT ASDrf_facTiEcoAirCdnrOnNeg_GT ASDrf_facTiEcoMtModNegAcOn_GT ASDrf_facTiEcoMtModNeg_GT ASDrf_facTiEcoMtModPosAbvAcOn_GM ASDrf_facTiEcoMtModPosAbv_GM ASDrf_facTiEcoMtModPosBlwAcOn_GM ASDrf_facTiEcoMtModPosBlw_GM ASDrf_facTiEcoNeg_GT ASDrf_facTiEcoPosAbvAcOn_GM ASDrf_facTiEcoPosAbv_GM ASDrf_facTiEcoPosBlwAcOn_GM ASDrf_facTiEcoPosBlw_GM ASDrf_facTiFltSetEcoGripAirCdnrOnNeg_GT ASDrf_facTiFltSetGripAirCdnrOnNeg_GT ASDrf_facTiFltSetGripNeg_GT ASDrf_facTiMtModNegAcOn_GT ASDrf_facTiMtModNeg_GT ASDrf_facTiMtModPosAbvAcOn_GM ASDrf_facTiMtModPosAbv_GM ASDrf_facTiMtModPosBlwAcOn_GM ASDrf_facTiMtModPosBlw_GM ASDrf_facTiNeg_GCUR ASDrf_facTiPosAbvAcOn_GMAP ASDrf_facTiPosAbv_GMAP ASDrf_facTiPosBlwAcOn_GMAP ASDrf_facTiPosBlw_GMAP ASDrf_facTiSprtMtModNeg_GT ASDrf_facTiSprtMtModPosAbv_GM ASDrf_facTiSprtMtModPosBlw_GM ASDrf_facTiSprtNegAcOn_GT ASDrf_facTiSprtNeg_GT ASDrf_facTiSprtPosAbvAcOn_GM ASDrf_facTiSprtPosAbv_GM ASDrf_facTiSprtPosBlwAcOn_GM ASDrf_facTiSprtPosBlw_GM ASDrf_facTiSptMtModNegAcOn_GT ASDrf_facTiSptMtModPosAbvAcOn_GM ASDrf_facTiSptMtModPosBlwAcOn_GM ASDrf_KdFilSetEcoAirCdnrOnNeg_GM ASDrf_KdFilSetEcoMtModNegAcOn_GM ASDrf_KdFilSetEcoMtModNeg_GM ASDrf_KdFilSetEcoMtModPosAbvAcOn_GM ASDrf_KdFilSetEcoMtModPosAbv_GM ASDrf_KdFilSetEcoNeg_GM ASDrf_KdFilSetEcoPosAbvAcOn_GM ASDrf_KdFilSetEcoPosAbv_GM ASDrf_KdFilSetGripAirCdnrOnNeg_GM ASDrf_KdFilSetGripMtModNegAcOn_GM ASDrf_KdFilSetGripMtModNeg_GM ASDrf_KdFilSetGripMtModPosAbvAcOn_GM ASDrf_KdFilSetGripMtModPosAbv_GM ASDrf_KdFilSetGripNeg_GM ASDrf_KdFilSetGripPosAbvAcOn_GM ASDrf_KdFilSetGripPosAbv_GM ASDrf_KdFilSetSprtMtModNeg_GM ASDrf_KdFilSetSprtMtModPosAbv_GM ASDrf_KdFilSetSprtNegAcOn_GM ASDrf_KdFilSetSprtNeg_GM ASDrf_KdFilSetSprtPosAbvAcOn_GM ASDrf_KdFilSetSprtPosAbv_GM ASDrf_KdFilSetSptMtModNegAcOn_GM ASDrf_KdFilSetSptMtModPosAbvAcOn_GM ASDrf_KdFltSetNoGripNeg_C ASDrf_KdFltSetNoGripPos_C ASDrf_nATSlipOpnEngSpdLo_C ASDrf_nDiffCnvrEngSelThd_C ASDrf_nEng_DST ASDrf_nPt_DST ASDrf_nrGear_DST ASDrf_nThresNCmp_GMAP ASDrf_nTrbnThresHi_C ASDrf_nTrbnThresLo_C ASDrf_ratSlipOpenActvThdEco_M ASDrf_ratSlipOpenActvThdSpt_M ASDrf_ratSlipOpenActvThdTrsmMt_M ASDrf_ratSlipOpenAppCmpEco_M ASDrf_ratSlipOpenAppCmpSpt_M ASDrf_ratSlipOpenAppCmpTrsmMt_M ASDrf_ratSlipOpenAppCmp_M ASDrf_ratSlipOpenEngCmpEco_M ASDrf_ratSlipOpenEngCmpSpt_M ASDrf_ratSlipOpenEngCmpTrsmMt_M ASDrf_rATSlipOpnActvThres_MAP ASDrf_rATSlipOpnNCmp_MAP ASDrf_rTrq_DST ASDrf_stEngOperModSeln_FT ASDrf_stFltCutEna_C ASDrf_tATSlipOpnEngTLo_C ASDrf_tEng_DST ASDrf_tiFilSetEcoMtModNegAcOn_GM ASDrf_tiFilSetEcoMtModNeg_GM ASDrf_tiFilSetEcoMtModPosAbvAcOn_GM ASDrf_tiFilSetEcoMtModPosAbv_GM ASDrf_tiFilSetEcoMtModPosBlwAcOn_GM ASDrf_tiFilSetEcoMtModPosBlw_GM ASDrf_tiFilSetEcoNeg_GM ASDrf_tiFilSetEcoPosAbvAcOn_GM ASDrf_tiFilSetEcoPosAbv_GM ASDrf_tiFilSetEcoPosBlwAcOn_GM ASDrf_tiFilSetEcoPosBlw_GM ASDrf_tiFilSetGripMtModNegAcOn_GM ASDrf_tiFilSetGripMtModNeg_GM ASDrf_tiFilSetGripMtModPosAbvAcOn_GM ASDrf_tiFilSetGripMtModPosAbv_GM ASDrf_tiFilSetGripMtModPosBlwAcOn_GM ASDrf_tiFilSetGripMtModPosBlw_GM ASDrf_tiFilSetSprtMtModNeg_GM ASDrf_tiFilSetSprtMtModPosAbv_GM ASDrf_tiFilSetSprtMtModPosBlw_GM ASDrf_tiFilSetSprtNegAcOn_GM ASDrf_tiFilSetSprtNeg_GM ASDrf_tiFilSetSprtPosAbvAcOn_GM ASDrf_tiFilSetSprtPosAbv_GM ASDrf_tiFilSetSprtPosBlwAcOn_GM ASDrf_tiFilSetSprtPosBlw_GM ASDrf_tiFilSetSptMtModNegAcOn_GM ASDrf_tiFilSetSptMtModPosAbvAcOn_GM ASDrf_tiFilSetSptMtModPosBlwAcOn_GM ASDrf_tiFltSetAirCdnrOnGripNeg_GM ASDrf_tiFltSetAirCdnrOnNegFCOEco_GT ASDrf_tiFltSetAirCdnrOnNegFCO_GT ASDrf_tiFltSetEcoAirCdnrOnGripNeg_GM ASDrf_tiFltSetGripNeg_MAP ASDrf_tiFltSetGripPosAbvAcOn_GMAP ASDrf_tiFltSetGripPosAbv_GMAP ASDrf_tiFltSetGripPosBlwAcOn_GMAP ASDrf_tiFltSetGripPosBlw_GMAP ASDrf_tiFltSetNegFCOEco_GT ASDrf_tiFltSetNegFCOSprt_GCUR ASDrf_tiFltSetNegFCO_GCUR ASDrf_tiFltSetNegMax_C ASDrf_tiFltSetNoGripNegAddl_C ASDrf_tiFltSetNoGripNeg_C ASDrf_tiFltSetNoGripPosAddl_C ASDrf_tiFltSetNoGripPos_C ASDrf_tiFltSetPosFCOEco_GMAP ASDrf_tiFltSetPosFCOSprt_GMAP ASDrf_tiFltSetPosFCO_GMAP ASDrf_tiMaxCalcOff_C ASDrf_tqLosOfsAirCdnrOnNegSet_C ASDrf_trqClthBs_DST ASDrf_trqFCOFltCut_C ASDrf_trqLosOfsNegSetEco_C ASDrf_trqLosOfsNegSetSprt_C ASDrf_trqLosOfsNegSet_C ASDrf_trqLosOfsPosSetEco_C ASDrf_trqLosOfsPosSetSprt_C ASDrf_trqLosOfsPosSet_C ASDrf_trqThresDP1_C ASDrf_trqThresDP2_C ASDrf_vDONeg_C ASDrf_vDOPos_C ASDrf_vNoGripDQ_C /end DEF_CHARACTERISTIC
 /begin IN_MEASUREMENT AccPed_swtDrvMod AirC_stPsCmpr APP_r ASDrf_bPosNegDes ASDrf_stLimMinMax ASDrf_trqClthFlt B_ll_msg CEngDsT_t Clth4_st CoEng_bCtOffCon CoETS_bFltDemSet CoETS_trqInrLimSet Com_flgExecdManMod Com_rTrsmTotFild Com_stEATBByte0Info Com_stShftInNeutr Com_stShftInPark Com_stShiftPosnIndcn Com_stTrqReqFast Com_stTrsmFailMod Conv_nTrbn CoVeh_trqAcs EngDa_tEng EngStrt_bStrtEnd Epm_dnEngFlt Epm_nEng Gbx_bATSlipOpn Gbx_bNCmp Gbx_nTrbn Gbx_stGearLvr Gbx_stNPos LsComp_tqCmpActvSpdGovr LsComp_tqSwilLossNotFild PthLead_trqInrLead PthSet_stCylIndivCtOff PthSet_stTrgFCO PT_bConvSlipOpn PT_bGrip PT_bNoGrip PT_nClth PT_rTrq PT_stTraType RngMod_trqClthMin RngMod_trqCrSBs RngMod_trqInrBs SpdGov_trqClth SpdGov_trqLead StatyCoorn_tqCluDesLimd SyC_ctDrvEnter Tra_numGear VehMot_facDesDyn VehV_v /end IN_MEASUREMENT
 /begin OUT_MEASUREMENT ASDrf_bCalcTrqBs ASDrf_bConvSlipOpn ASDrf_bFltCut ASDrf_bNCmp ASDrf_bNCmpCvt ASDrf_bNoGrip ASDrf_bSlipOpnActv ASDrf_CoefA ASDrf_CoefB ASDrf_facDesDyn ASDrf_flgEcoModActv ASDrf_flgSptModActv ASDrf_flgTrsmMtModActv ASDrf_KdFltSet ASDrf_nPt ASDrf_nThresNCmp ASDrf_rConvSlip ASDrf_tiFltSet ASDrf_tqCluBas ASDrf_tqCluBasc ASDrf_tqCluBasLead ASDrf_tqCluDemSet ASDrf_trqLosSet /end OUT_MEASUREMENT
 /begin LOC_MEASUREMENT ASDrf_bATSlipOpnInhb ASDrf_bCalcTrqBsFF_I.status ASDrf_bCoEngCutOffER_I.buffer ASDrf_bCoEngCutOffER_I.oldSignal ASDrf_bCutOffFF_I.status ASDrf_bNCmpFF_I.status ASDrf_ctIniDrvSelPar10ms ASDrf_dtqERNM_I.oldSignal ASDrf_dtqTOFFVNM_I.time ASDrf_posSlipOpnER_I.buffer ASDrf_posSlipOpnER_I.oldSignal ASDrf_ratSlipOpenCmp ASDrf_stEngOperModSeln ASDrf_stParSet ASDrf_tqLossBasc ASDrf_trqLosClthComp ASDrf_trqLosComp /end LOC_MEASUREMENT
 FUNCTION_VERSION "28.7.0" /end FUNCTION
/begin FUNCTION ATCADAP "5.1.0     software adapter for MF ATC" /begin DEF_CHARACTERISTIC PSPVDKUG /end DEF_CHARACTERISTIC /begin IN_MEASUREMENT psrs_w_msg SyC_stSub vpsrvd_w_msg /end IN_MEASUREMENT /begin OUT_MEASUREMENT pspvds_w_msg pssol_w_msg /end OUT_MEASUREMENT FUNCTION_VERSION "5.1.0" /end FUNCTION
/begin FUNCTION ATS2CP "68.0.0    ATS configuration for tank purge valve" /begin OUT_MEASUREMENT arqttev_w_msg B_rqttev_msg /end OUT_MEASUREMENT FUNCTION_VERSION "68.0.0" /end FUNCTION
/begin FUNCTION ATS2INJ "68.0.0    ATS interface for injection test" /begin OUT_MEASUREMENT B_faevz_msg devoff_msg /end OUT_MEASUREMENT FUNCTION_VERSION "68.0.0" /end FUNCTION
/begin FUNCTION ATS2THRVLV "68.0.0    ATS configuration for throttle valve" /begin OUT_MEASUREMENT B_cwdk_msg cvwdk_msg /end OUT_MEASUREMENT FUNCTION_VERSION "68.0.0" /end FUNCTION
/begin FUNCTION ATS2VSV "68.0.0    ATS Configuration for Vapour Canister Vent shut off valve" /begin OUT_MEASUREMENT B_btaavet_msg B_btaave_msg /end OUT_MEASUREMENT FUNCTION_VERSION "68.0.0" /end FUNCTION
/begin FUNCTION ATSADAPT "68.0.0    adapter for ATS" FUNCTION_VERSION "68.0.0" /end FUNCTION
/begin FUNCTION ATSExtd_Std "30000.0.0 Handling of actuator test demands with diagnostics extended" FUNCTION_VERSION "30000.0.0" /end FUNCTION
/begin FUNCTION ATS_Std "30000.29.0Handling of actuator test demands with diagnostics"
 /begin DEF_CHARACTERISTIC ACTR_TST_CP_ATS_ATS.LimitTypeMsk_C ACTR_TST_CP_ATS_ATS.CnvNorm_C ACTR_TST_CP_ATS_ATS.LowLim_C ACTR_TST_CP_ATS_ATS.UpLim_C ACTR_TST_CP_ATS_ATS.CnvFac_C ACTR_TST_CP_ATS_ATS.CnvOfs_C ACTR_TST_CP_ATS_ATS.DfltVal_C ACTR_TST_THRVLV_ATS_ATS.LimitTypeMsk_C ACTR_TST_THRVLV_ATS_ATS.CnvNorm_C ACTR_TST_THRVLV_ATS_ATS.LowLim_C ACTR_TST_THRVLV_ATS_ATS.UpLim_C ACTR_TST_THRVLV_ATS_ATS.CnvFac_C ACTR_TST_THRVLV_ATS_ATS.CnvOfs_C ACTR_TST_THRVLV_ATS_ATS.DfltVal_C ACTR_TST_VSV_ATS_ATS.LimitTypeMsk_C ACTR_TST_VSV_ATS_ATS.CnvNorm_C ACTR_TST_VSV_ATS_ATS.LowLim_C ACTR_TST_VSV_ATS_ATS.UpLim_C ACTR_TST_VSV_ATS_ATS.CnvFac_C ACTR_TST_VSV_ATS_ATS.CnvOfs_C ACTR_TST_VSV_ATS_ATS.DfltVal_C ATS_Standby_Disabled_C ATS_tiTstDemHeal_C ATS_tiTstDemMax_C ATS_TmrBehaviour_C ATS_TstDemMaxEngN_C ATS_TstDemMaxVSSCDV_C PHAACTRINTK_CTL_ATS_ATS.LimitTypeMsk_C PHAACTRINTK_CTL_ATS_ATS.CnvNorm_C PHAACTRINTK_CTL_ATS_ATS.LowLim_C PHAACTRINTK_CTL_ATS_ATS.UpLim_C PHAACTRINTK_CTL_ATS_ATS.CnvFac_C PHAACTRINTK_CTL_ATS_ATS.CnvOfs_C PHAACTRINTK_CTL_ATS_ATS.DfltVal_C /end DEF_CHARACTERISTIC
 /begin REF_CHARACTERISTIC ACTR_TST_HDP_ATS_ATS.LimitTypeMsk_C ACTR_TST_HDP_ATS_ATS.CnvNorm_C ACTR_TST_HDP_ATS_ATS.LowLim_C ACTR_TST_HDP_ATS_ATS.UpLim_C ACTR_TST_HDP_ATS_ATS.CnvFac_C ACTR_TST_HDP_ATS_ATS.CnvOfs_C ACTR_TST_HDP_ATS_ATS.DfltVal_C AirCCmpr_ATS.LimitTypeMsk_C AirCCmpr_ATS.CnvNorm_C AirCCmpr_ATS.LowLim_C AirCCmpr_ATS.UpLim_C AirCCmpr_ATS.CnvFac_C AirCCmpr_ATS.CnvOfs_C AirCCmpr_ATS.DfltVal_C AltIO_ATS.LimitTypeMsk_C AltIO_ATS.CnvNorm_C AltIO_ATS.LowLim_C AltIO_ATS.UpLim_C AltIO_ATS.CnvFac_C AltIO_ATS.CnvOfs_C AltIO_ATS.DfltVal_C APP_I_P_ATS_ATS.LimitTypeMsk_C APP_I_P_ATS_ATS.CnvNorm_C APP_I_P_ATS_ATS.LowLim_C APP_I_P_ATS_ATS.UpLim_C APP_I_P_ATS_ATS.CnvFac_C APP_I_P_ATS_ATS.CnvOfs_C APP_I_P_ATS_ATS.DfltVal_C ATS_TrbCh_B1.LimitTypeMsk_C ATS_TrbCh_B1.CnvNorm_C ATS_TrbCh_B1.LowLim_C ATS_TrbCh_B1.UpLim_C ATS_TrbCh_B1.CnvFac_C ATS_TrbCh_B1.CnvOfs_C ATS_TrbCh_B1.DfltVal_C CACPmpRly_ATS.LimitTypeMsk_C CACPmpRly_ATS.CnvNorm_C CACPmpRly_ATS.LowLim_C CACPmpRly_ATS.UpLim_C CACPmpRly_ATS.CnvFac_C CACPmpRly_ATS.CnvOfs_C CACPmpRly_ATS.DfltVal_C CACPmp_ATS.LimitTypeMsk_C CACPmp_ATS.CnvNorm_C CACPmp_ATS.LowLim_C CACPmp_ATS.UpLim_C CACPmp_ATS.CnvFac_C CACPmp_ATS.CnvOfs_C CACPmp_ATS.DfltVal_C CByVlvB1_Test_ATS.LimitTypeMsk_C CByVlvB1_Test_ATS.CnvNorm_C CByVlvB1_Test_ATS.LowLim_C CByVlvB1_Test_ATS.UpLim_C CByVlvB1_Test_ATS.CnvFac_C CByVlvB1_Test_ATS.CnvOfs_C CByVlvB1_Test_ATS.DfltVal_C CPV_ADDCTL_ATS_ATS.LimitTypeMsk_C CPV_ADDCTL_ATS_ATS.CnvNorm_C CPV_ADDCTL_ATS_ATS.LowLim_C CPV_ADDCTL_ATS_ATS.UpLim_C CPV_ADDCTL_ATS_ATS.CnvFac_C CPV_ADDCTL_ATS_ATS.CnvOfs_C CPV_ADDCTL_ATS_ATS.DfltVal_C EGRVlv_ATS.LimitTypeMsk_C EGRVlv_ATS.CnvNorm_C EGRVlv_ATS.LowLim_C EGRVlv_ATS.UpLim_C EGRVlv_ATS.CnvFac_C EGRVlv_ATS.CnvOfs_C EGRVlv_ATS.DfltVal_C EGRVlv_DTYCYC_ATS.LimitTypeMsk_C EGRVlv_DTYCYC_ATS.CnvNorm_C EGRVlv_DTYCYC_ATS.LowLim_C EGRVlv_DTYCYC_ATS.UpLim_C EGRVlv_DTYCYC_ATS.CnvFac_C EGRVlv_DTYCYC_ATS.CnvOfs_C EGRVlv_DTYCYC_ATS.DfltVal_C EGRVlv_LRN_ATS.LimitTypeMsk_C EGRVlv_LRN_ATS.CnvNorm_C EGRVlv_LRN_ATS.LowLim_C EGRVlv_LRN_ATS.UpLim_C EGRVlv_LRN_ATS.CnvFac_C EGRVlv_LRN_ATS.CnvOfs_C EGRVlv_LRN_ATS.DfltVal_C FanDig0_ATS.LimitTypeMsk_C FanDig0_ATS.CnvNorm_C FanDig0_ATS.LowLim_C FanDig0_ATS.UpLim_C FanDig0_ATS.CnvFac_C FanDig0_ATS.CnvOfs_C FanDig0_ATS.DfltVal_C FanDig1_ATS.LimitTypeMsk_C FanDig1_ATS.CnvNorm_C FanDig1_ATS.LowLim_C FanDig1_ATS.UpLim_C FanDig1_ATS.CnvFac_C FanDig1_ATS.CnvOfs_C FanDig1_ATS.DfltVal_C GbxRevLck_ATS.LimitTypeMsk_C GbxRevLck_ATS.CnvNorm_C GbxRevLck_ATS.LowLim_C GbxRevLck_ATS.UpLim_C GbxRevLck_ATS.CnvFac_C GbxRevLck_ATS.CnvOfs_C GbxRevLck_ATS.DfltVal_C InjSys_facCylIndCorrn0_ATS_ATS.LimitTypeMsk_C InjSys_facCylIndCorrn0_ATS_ATS.CnvNorm_C InjSys_facCylIndCorrn0_ATS_ATS.LowLim_C InjSys_facCylIndCorrn0_ATS_ATS.UpLim_C InjSys_facCylIndCorrn0_ATS_ATS.CnvFac_C InjSys_facCylIndCorrn0_ATS_ATS.CnvOfs_C InjSys_facCylIndCorrn0_ATS_ATS.DfltVal_C InjSys_facCylIndCorrn1_ATS_ATS.LimitTypeMsk_C InjSys_facCylIndCorrn1_ATS_ATS.CnvNorm_C InjSys_facCylIndCorrn1_ATS_ATS.LowLim_C InjSys_facCylIndCorrn1_ATS_ATS.UpLim_C InjSys_facCylIndCorrn1_ATS_ATS.CnvFac_C InjSys_facCylIndCorrn1_ATS_ATS.CnvOfs_C InjSys_facCylIndCorrn1_ATS_ATS.DfltVal_C InjSys_facCylIndCorrn2_ATS_ATS.LimitTypeMsk_C InjSys_facCylIndCorrn2_ATS_ATS.CnvNorm_C InjSys_facCylIndCorrn2_ATS_ATS.LowLim_C InjSys_facCylIndCorrn2_ATS_ATS.UpLim_C InjSys_facCylIndCorrn2_ATS_ATS.CnvFac_C InjSys_facCylIndCorrn2_ATS_ATS.CnvOfs_C InjSys_facCylIndCorrn2_ATS_ATS.DfltVal_C InjSys_facCylIndCorrn3_ATS_ATS.LimitTypeMsk_C InjSys_facCylIndCorrn3_ATS_ATS.CnvNorm_C InjSys_facCylIndCorrn3_ATS_ATS.LowLim_C InjSys_facCylIndCorrn3_ATS_ATS.UpLim_C InjSys_facCylIndCorrn3_ATS_ATS.CnvFac_C InjSys_facCylIndCorrn3_ATS_ATS.CnvOfs_C InjSys_facCylIndCorrn3_ATS_ATS.DfltVal_C InjSys_facCylIndCorrn4_ATS_ATS.LimitTypeMsk_C InjSys_facCylIndCorrn4_ATS_ATS.CnvNorm_C InjSys_facCylIndCorrn4_ATS_ATS.LowLim_C InjSys_facCylIndCorrn4_ATS_ATS.UpLim_C InjSys_facCylIndCorrn4_ATS_ATS.CnvFac_C InjSys_facCylIndCorrn4_ATS_ATS.CnvOfs_C InjSys_facCylIndCorrn4_ATS_ATS.DfltVal_C InjSys_facCylIndCorrn5_ATS_ATS.LimitTypeMsk_C InjSys_facCylIndCorrn5_ATS_ATS.CnvNorm_C InjSys_facCylIndCorrn5_ATS_ATS.LowLim_C InjSys_facCylIndCorrn5_ATS_ATS.UpLim_C InjSys_facCylIndCorrn5_ATS_ATS.CnvFac_C InjSys_facCylIndCorrn5_ATS_ATS.CnvOfs_C InjSys_facCylIndCorrn5_ATS_ATS.DfltVal_C InjSys_facCylIndCorrn6_ATS_ATS.LimitTypeMsk_C InjSys_facCylIndCorrn6_ATS_ATS.CnvNorm_C InjSys_facCylIndCorrn6_ATS_ATS.LowLim_C InjSys_facCylIndCorrn6_ATS_ATS.UpLim_C InjSys_facCylIndCorrn6_ATS_ATS.CnvFac_C InjSys_facCylIndCorrn6_ATS_ATS.CnvOfs_C InjSys_facCylIndCorrn6_ATS_ATS.DfltVal_C InjSys_facCylIndCorrn7_ATS_ATS.LimitTypeMsk_C InjSys_facCylIndCorrn7_ATS_ATS.CnvNorm_C InjSys_facCylIndCorrn7_ATS_ATS.LowLim_C InjSys_facCylIndCorrn7_ATS_ATS.UpLim_C InjSys_facCylIndCorrn7_ATS_ATS.CnvFac_C InjSys_facCylIndCorrn7_ATS_ATS.CnvOfs_C InjSys_facCylIndCorrn7_ATS_ATS.DfltVal_C InjSys_FcoCylInd_ATS_ATS.LimitTypeMsk_C InjSys_FcoCylInd_ATS_ATS.CnvNorm_C InjSys_FcoCylInd_ATS_ATS.LowLim_C InjSys_FcoCylInd_ATS_ATS.UpLim_C InjSys_FcoCylInd_ATS_ATS.CnvFac_C InjSys_FcoCylInd_ATS_ATS.CnvOfs_C InjSys_FcoCylInd_ATS_ATS.DfltVal_C PHAACTROUTL_CTL_ATS_ATS.LimitTypeMsk_C PHAACTROUTL_CTL_ATS_ATS.CnvNorm_C PHAACTROUTL_CTL_ATS_ATS.LowLim_C PHAACTROUTL_CTL_ATS_ATS.UpLim_C PHAACTROUTL_CTL_ATS_ATS.CnvFac_C PHAACTROUTL_CTL_ATS_ATS.CnvOfs_C PHAACTROUTL_CTL_ATS_ATS.DfltVal_C PHAOCVINTKB1_CTL_ATS_ATS.LimitTypeMsk_C PHAOCVINTKB1_CTL_ATS_ATS.CnvNorm_C PHAOCVINTKB1_CTL_ATS_ATS.LowLim_C PHAOCVINTKB1_CTL_ATS_ATS.UpLim_C PHAOCVINTKB1_CTL_ATS_ATS.CnvFac_C PHAOCVINTKB1_CTL_ATS_ATS.CnvOfs_C PHAOCVINTKB1_CTL_ATS_ATS.DfltVal_C PSPDig_ATS.LimitTypeMsk_C PSPDig_ATS.CnvNorm_C PSPDig_ATS.LowLim_C PSPDig_ATS.UpLim_C PSPDig_ATS.CnvFac_C PSPDig_ATS.CnvOfs_C PSPDig_ATS.DfltVal_C ThrVlv_ATS.LimitTypeMsk_C ThrVlv_ATS.CnvNorm_C ThrVlv_ATS.LowLim_C ThrVlv_ATS.UpLim_C ThrVlv_ATS.CnvFac_C ThrVlv_ATS.CnvOfs_C ThrVlv_ATS.DfltVal_C VLVLFT_SPINTK_ATS.LimitTypeMsk_C VLVLFT_SPINTK_ATS.CnvNorm_C VLVLFT_SPINTK_ATS.LowLim_C VLVLFT_SPINTK_ATS.UpLim_C VLVLFT_SPINTK_ATS.CnvFac_C VLVLFT_SPINTK_ATS.CnvOfs_C VLVLFT_SPINTK_ATS.DfltVal_C /end REF_CHARACTERISTIC
 /begin IN_MEASUREMENT Epm_nEngLRes T15_st VehV_v /end IN_MEASUREMENT
 /begin OUT_MEASUREMENT ATS_ctCurRunTst ATS_stMon ATS_stMonTimeLimit /end OUT_MEASUREMENT
 /begin LOC_MEASUREMENT ATS_IntvVal_mp ATS_TstStatus_mp /end LOC_MEASUREMENT
 FUNCTION_VERSION "30000.29.0" /end FUNCTION
/begin FUNCTION AVHE "14.0.0    Control of variable valve lift inlet"
 /begin DEF_CHARACTERISTIC Vlvlft_agOffsSafeSwt_C Vlvlft_nrCylActrIntk_T VlvLft_nrSegOffsTrigChrgDetrmIntk_C VlvLft_percAirChrgChgThd_C VlvLft_selStdLftCfg_C Vlvlft_tiEleclDlySpclIntk_M Vlvlft_tiEleclDlyStdIntk_M Vlvlft_tiMeclDlySpclIntk_M Vlvlft_tiMeclDlyStdIntk_M Vlvlft_tiOilPDlySpclIntk_M Vlvlft_tiOilPDlyStdIntk_M /end DEF_CHARACTERISTIC
 /begin IN_MEASUREMENT BattU_uFild B_kl15_msg B_vhegabgn_msg CoEng_stSpVlvLftIntk drldvls_w_msg Epm_ctCyl Epm_nEng Epm_stSpd GEVCtl_agDifStdSpclLftOpenIntk GEVCtl_agIntkOpen grundwert_msg OilP_p SyC_stSub toch_msg VlvLft_fbIntkSwtOutp11 Vlvlft_stFbSwtActvIntk vwkw_msg /end IN_MEASUREMENT
 /begin OUT_MEASUREMENT B_vhegfe_msg VlvLft_agCrkForSwtIntk_msg VlvLft_fbIntkSwtVrbl11 VlvLft_fbStIntkVrbl VlvLft_flgCoorn1SynctoSwt VlvLft_flgCoornStrtofSwt VlvLft_flgCtrlActrIntk1 VlvLft_flgEnerBgnAdpnIntk VlvLft_flgFbVlvStIntk VlvLft_flgSyncVlvPosIntk_msg VlvLft_nrCylSyncIntk_msg VlvLft_nrSegSwtIntk_msg VlvLft_stflgCtrlActrIntkVrbl1 VlvLft_tiDlyVlvActvnIntk wvhesd_w_msg /end OUT_MEASUREMENT
 /begin LOC_MEASUREMENT B_vhegfeloc Epm_stSpdloc10ms VlvLftCtl_agCrkforSwtIntkloc VlvLftCtl_agGrundwertlocS0 VlvLftCtl_facdrldvlswlocS0 VlvLftCtl_flgBkl15locS0loc VlvLftCtl_flgBnminloc10ms VlvLftCtl_flgBvhegabgnlocS0 VlvLftCtl_flgfbIntkswtoutp11loc VlvLftCtl_flgSyncVlvPosIntkloc VlvLftCtl_nmotloc10ms VlvLftCtl_nrCylSyncIntkloc VlvLftCtl_nrSegSwtIntkloc VlvLftCtl_nzzyllocS0 VlvLftCtl_poilploc20ms VlvLftCtl_ttochloc20ms VlvLftCtl_ubsqfloc20ms VlvLftCtl_vwkwloc20ms VlvLftCtl_vwkwlocS0 VlvLftCtl_wvhesdw20ms zzylvheb zzylvheb_temp /end LOC_MEASUREMENT
 FUNCTION_VERSION "14.0.0" /end FUNCTION
/begin FUNCTION AVSExtd_Std "30000.0.0 Adjustment Value Service extended" FUNCTION_VERSION "30000.0.0" /end FUNCTION
/begin FUNCTION AVS_Std "30000.15.0Adjustment Value Service" FUNCTION_VERSION "30000.15.0" /end FUNCTION
/begin FUNCTION BattECU_DCDC "3.8.0     LIN frame of the Battery ECU" /begin DEF_CHARACTERISTIC ComDCDC_stBitMskByt0_C ComDCDC_stBitMskByt1_C /end DEF_CHARACTERISTIC
 /begin IN_MEASUREMENT Com_stMon Lin_DCDC_Signal_nrSwVers_3_r_msg Lin_DCDC_Signal_stBoosterErr_1_r_msg Lin_DCDC_Signal_stCSTErr_1_r_msg Lin_DCDC_Signal_stCSTHist_1_r_msg Lin_DCDC_Signal_stDCLinRVer_1_r_msg Lin_DCDC_Signal_stInpErr1_1_r_msg Lin_DCDC_Signal_stInpErr2_1_r_msg Lin_DCDC_Signal_stIntErr_1_r_msg Lin_DCDC_Signal_stMode_1_r_msg Lin_DCDC_Signal_stOutpErr1_1_r_msg Lin_DCDC_Signal_stOutpErr2_1_r_msg Lin_DCDC_Signal_stTempWarn1_1_r_msg Lin_DCDC_Signal_stTempWarn2_1_r_msg Lin_DCDC_Signal_stUnitSt_1_r_msg SyC_ctPostDrvLeave /end IN_MEASUREMENT
 /begin OUT_MEASUREMENT ComDCDC_nrSwVers ComDCDC_stBoosterErr ComDCDC_stCSTErr ComDCDC_stCSTHist ComDCDC_stDCLinRVer ComDCDC_stErrEna ComDCDC_stInpErr1 ComDCDC_stInpErr2 ComDCDC_stIntErr ComDCDC_stMode ComDCDC_stOutpErr1 ComDCDC_stOutpErr2 ComDCDC_stTempWarn1 ComDCDC_stTempWarn2 ComDCDC_stUnitSt Com_ctReIni10msBattECU_DCDC /end OUT_MEASUREMENT
 FUNCTION_VERSION "3.8.0" /end FUNCTION
/begin COMPU_METHOD B_TRUE "" TAB_VERB "%6.3" "" COMPU_TAB_REF B_TRUE /end COMPU_METHOD
/begin COMPU_VTAB B_TRUE "" TAB_VERB 2 0 "FALSE" 1 "TRUE" /end COMPU_VTAB
/begin COMPU_METHOD CAMSFT_AGSPATS_SC_Compu "" TAB_VERB "%6.3" "" COMPU_TAB_REF CAMSFT_AGSPATS_SC_Compu /end COMPU_METHOD
/begin COMPU_VTAB CAMSFT_AGSPATS_SC_Compu "" TAB_VERB 2 0 "False" 1 "True" /end COMPU_VTAB
/begin COMPU_METHOD CAMSFT_ATS_SC_Compu "" TAB_VERB "%6.3" "" COMPU_TAB_REF CAMSFT_ATS_SC_Compu /end COMPU_METHOD
/begin COMPU_VTAB CAMSFT_ATS_SC_Compu "" TAB_VERB 2 0 "False" 1 "True" /end COMPU_VTAB
/begin COMPU_METHOD CAMSFT_CLNGENGSTALLACTVT_SC_Compu "" TAB_VERB "%6.3" "" COMPU_TAB_REF CAMSFT_CLNGENGSTALLACTVT_SC_Compu /end COMPU_METHOD
/begin COMPU_VTAB CAMSFT_CLNGENGSTALLACTVT_SC_Compu "" TAB_VERB 2 0 "False" 1 "True" /end COMPU_VTAB
/begin COMPU_METHOD CAMSFT_CLNGMOD_SC_Compu "" TAB_VERB "%6.3" "" COMPU_TAB_REF CAMSFT_CLNGMOD_SC_Compu /end COMPU_METHOD
/begin COMPU_VTAB CAMSFT_CLNGMOD_SC_Compu "" TAB_VERB 4 0 "noCl" 1 "Clshft" 2 "ClSwofff" 3 "Clall" /end COMPU_VTAB
/begin COMPU_METHOD CAMSFT_CMNPHAACTRINTKOUTL_SC_Compu "" TAB_VERB "%6.3" "" COMPU_TAB_REF CAMSFT_CMNPHAACTRINTKOUTL_SC_Compu /end COMPU_METHOD
/begin COMPU_VTAB CAMSFT_CMNPHAACTRINTKOUTL_SC_Compu "" TAB_VERB 2 0 "False" 1 "True" /end COMPU_VTAB
/begin COMPU_METHOD CAMSFT_CSERSDIAGEXTD_SC_Compu "" TAB_VERB "%6.3" "" COMPU_TAB_REF CAMSFT_CSERSDIAGEXTD_SC_Compu /end COMPU_METHOD
/begin COMPU_VTAB CAMSFT_CSERSDIAGEXTD_SC_Compu "" TAB_VERB 2 0 "False" 1 "True" /end COMPU_VTAB
/begin COMPU_METHOD CAMSFT_DEACTVENGSTOP_SC_Compu "" TAB_VERB "%6.3" "" COMPU_TAB_REF CAMSFT_DEACTVENGSTOP_SC_Compu /end COMPU_METHOD
/begin COMPU_VTAB CAMSFT_DEACTVENGSTOP_SC_Compu "" TAB_VERB 2 0 "False" 1 "True" /end COMPU_VTAB
/begin COMPU_METHOD CAMSFT_ELECINTKVVT_SC_Compu "" TAB_VERB "%6.3" "" COMPU_TAB_REF CAMSFT_ELECINTKVVT_SC_Compu /end COMPU_METHOD
/begin COMPU_VTAB CAMSFT_ELECINTKVVT_SC_Compu "" TAB_VERB 2 0 "False" 1 "True" /end COMPU_VTAB
/begin COMPU_METHOD CAMSFT_EOMSPDECALCN_SC_Compu "" TAB_VERB "%6.3" "" COMPU_TAB_REF CAMSFT_EOMSPDECALCN_SC_Compu /end COMPU_METHOD
/begin COMPU_VTAB CAMSFT_EOMSPDECALCN_SC_Compu "" TAB_VERB 2 0 "False" 1 "True" /end COMPU_VTAB
/begin COMPU_METHOD CAMSFT_HLDDUTYCYCADPN_SC_Compu "" TAB_VERB "%6.3" "" COMPU_TAB_REF CAMSFT_HLDDUTYCYCADPN_SC_Compu /end COMPU_METHOD
/begin COMPU_VTAB CAMSFT_HLDDUTYCYCADPN_SC_Compu "" TAB_VERB 2 0 "False" 1 "True" /end COMPU_VTAB
/begin COMPU_METHOD CAMSFT_INHPHAADJMTTQLIMN_SC_Compu "" TAB_VERB "%6.3" "" COMPU_TAB_REF CAMSFT_INHPHAADJMTTQLIMN_SC_Compu /end COMPU_METHOD
/begin COMPU_VTAB CAMSFT_INHPHAADJMTTQLIMN_SC_Compu "" TAB_VERB 2 0 "False" 1 "True" /end COMPU_VTAB
/begin COMPU_METHOD CAMSFT_KNKPREVN_SC_Compu "" TAB_VERB "%6.3" "" COMPU_TAB_REF CAMSFT_KNKPREVN_SC_Compu /end COMPU_METHOD
/begin COMPU_VTAB CAMSFT_KNKPREVN_SC_Compu "" TAB_VERB 2 0 "False" 1 "True" /end COMPU_VTAB
/begin COMPU_METHOD CAMSFT_LIMPHOMECFG_SC_Compu "" TAB_VERB "%6.3" "" COMPU_TAB_REF CAMSFT_LIMPHOMECFG_SC_Compu /end COMPU_METHOD
/begin COMPU_VTAB CAMSFT_LIMPHOMECFG_SC_Compu "" TAB_VERB 2 0 "NoLimp" 1 "LftLimpSpclSp" /end COMPU_VTAB
/begin COMPU_METHOD CAMSFT_LOCKDIAGINTK_SC_Compu "" TAB_VERB "%6.3" "" COMPU_TAB_REF CAMSFT_LOCKDIAGINTK_SC_Compu /end COMPU_METHOD
/begin COMPU_VTAB CAMSFT_LOCKDIAGINTK_SC_Compu "" TAB_VERB 2 0 "False" 1 "True" /end COMPU_VTAB
/begin COMPU_METHOD CAMSFT_LOCKDIAGOUTL_SC_Compu "" TAB_VERB "%6.3" "" COMPU_TAB_REF CAMSFT_LOCKDIAGOUTL_SC_Compu /end COMPU_METHOD
/begin COMPU_VTAB CAMSFT_LOCKDIAGOUTL_SC_Compu "" TAB_VERB 2 0 "False" 1 "True" /end COMPU_VTAB
/begin COMPU_METHOD CAMSFT_MIDLOCKPOSNINTK_SC_Compu "" TAB_VERB "%6.3" "" COMPU_TAB_REF CAMSFT_MIDLOCKPOSNINTK_SC_Compu /end COMPU_METHOD
/begin COMPU_VTAB CAMSFT_MIDLOCKPOSNINTK_SC_Compu "" TAB_VERB 2 0 "NO_INTK_MIDLOCKPOSN" 1 "INTK_MIDLOCKPOSN" /end COMPU_VTAB
/begin COMPU_METHOD CAMSFT_NOERRHEALDCYC_SC_Compu "" TAB_VERB "%6.3" "" COMPU_TAB_REF CAMSFT_NOERRHEALDCYC_SC_Compu /end COMPU_METHOD
/begin COMPU_VTAB CAMSFT_NOERRHEALDCYC_SC_Compu "" TAB_VERB 2 0 "False" 1 "True" /end COMPU_VTAB
/begin COMPU_METHOD CAMSFT_NOMINOVLMISF_SC_Compu "" TAB_VERB "%6.3" "" COMPU_TAB_REF CAMSFT_NOMINOVLMISF_SC_Compu /end COMPU_METHOD
/begin COMPU_VTAB CAMSFT_NOMINOVLMISF_SC_Compu "" TAB_VERB 2 0 "False" 1 "True" /end COMPU_VTAB
/begin COMPU_METHOD CAMSFT_POIL_SC_Compu "" TAB_VERB "%6.3" "" COMPU_TAB_REF CAMSFT_POIL_SC_Compu /end COMPU_METHOD
/begin COMPU_VTAB CAMSFT_POIL_SC_Compu "" TAB_VERB 2 0 "False" 1 "True" /end COMPU_VTAB
/begin COMPU_METHOD CAMSFT_REFADPNCLNGRQRD_SC_Compu "" TAB_VERB "%6.3" "" COMPU_TAB_REF CAMSFT_REFADPNCLNGRQRD_SC_Compu /end COMPU_METHOD
/begin COMPU_VTAB CAMSFT_REFADPNCLNGRQRD_SC_Compu "" TAB_VERB 2 0 "no_cleaning_required" 1 "cleaning_required" /end COMPU_VTAB
/begin COMPU_METHOD CAMSFT_REFPOSNCORRNTYP_SC_Compu "" TAB_VERB "%6.3" "" COMPU_TAB_REF CAMSFT_REFPOSNCORRNTYP_SC_Compu /end COMPU_METHOD
/begin COMPU_VTAB CAMSFT_REFPOSNCORRNTYP_SC_Compu "" TAB_VERB 5 0 "no_correction" 1 "AdpnKnDet" 2 "SWSH_VAR3" 3 "SWSH" 4 "ChrAdap" /end COMPU_VTAB
/begin COMPU_METHOD CAMSFT_REFPOSNCORRN_SC_Compu "" TAB_VERB "%6.3" "" COMPU_TAB_REF CAMSFT_REFPOSNCORRN_SC_Compu /end COMPU_METHOD
/begin COMPU_VTAB CAMSFT_REFPOSNCORRN_SC_Compu "" TAB_VERB 2 0 "False" 1 "True" /end COMPU_VTAB
/begin COMPU_METHOD CAMSFT_REFPOSNINTK_SC_Compu "" TAB_VERB "%6.3" "" COMPU_TAB_REF CAMSFT_REFPOSNINTK_SC_Compu /end COMPU_METHOD
/begin COMPU_VTAB CAMSFT_REFPOSNINTK_SC_Compu "" TAB_VERB 2 0 "False" 1 "True" /end COMPU_VTAB
/begin COMPU_METHOD CAMSFT_REFPOSNOUTL_SC_Compu "" TAB_VERB "%6.3" "" COMPU_TAB_REF CAMSFT_REFPOSNOUTL_SC_Compu /end COMPU_METHOD
/begin COMPU_VTAB CAMSFT_REFPOSNOUTL_SC_Compu "" TAB_VERB 2 0 "False" 1 "True" /end COMPU_VTAB
/begin COMPU_METHOD CAMSFT_SOLNTMDL_SC_Compu "" TAB_VERB "%6.3" "" COMPU_TAB_REF CAMSFT_SOLNTMDL_SC_Compu /end COMPU_METHOD
/begin COMPU_VTAB CAMSFT_SOLNTMDL_SC_Compu "" TAB_VERB 2 0 "False" 1 "True" /end COMPU_VTAB
/begin COMPU_METHOD CAMSFT_SPCLDUTYCYCINTVACTVT_SC_Compu "" TAB_VERB "%6.3" "" COMPU_TAB_REF CAMSFT_SPCLDUTYCYCINTVACTVT_SC_Compu /end COMPU_METHOD
/begin COMPU_VTAB CAMSFT_SPCLDUTYCYCINTVACTVT_SC_Compu "" TAB_VERB 2 0 "False" 1 "True" /end COMPU_VTAB
/begin COMPU_METHOD CAMSFT_SPCLSPRGNEGTSYS_SC_Compu "" TAB_VERB "%6.3" "" COMPU_TAB_REF CAMSFT_SPCLSPRGNEGTSYS_SC_Compu /end COMPU_METHOD
/begin COMPU_VTAB CAMSFT_SPCLSPRGNEGTSYS_SC_Compu "" TAB_VERB 2 0 "False" 1 "True" /end COMPU_VTAB
/begin COMPU_METHOD CAMSFT_SWTOFFPSELECERRDSTCN_SC_Compu "" TAB_VERB "%6.3" "" COMPU_TAB_REF CAMSFT_SWTOFFPSELECERRDSTCN_SC_Compu /end COMPU_METHOD
/begin COMPU_VTAB CAMSFT_SWTOFFPSELECERRDSTCN_SC_Compu "" TAB_VERB 2 0 "False" 1 "True" /end COMPU_VTAB
/begin COMPU_METHOD CAMSFT_VARIINTK_SC_Compu "" TAB_VERB "%6.3" "" COMPU_TAB_REF CAMSFT_VARIINTK_SC_Compu /end COMPU_METHOD
/begin COMPU_VTAB CAMSFT_VARIINTK_SC_Compu "" TAB_VERB 3 0 "NoShft" 1 "2PtShft" 2 "ContShft" /end COMPU_VTAB
/begin COMPU_METHOD CAMSFT_VARIOUTL_SC_Compu "" TAB_VERB "%6.3" "" COMPU_TAB_REF CAMSFT_VARIOUTL_SC_Compu /end COMPU_METHOD
/begin COMPU_VTAB CAMSFT_VARIOUTL_SC_Compu "" TAB_VERB 3 0 "NoShft" 1 "2PtShft" 2 "ContShft" /end COMPU_VTAB
/begin COMPU_METHOD CANBMS_SY_Compu "" TAB_VERB "%6.3" "" COMPU_TAB_REF CANBMS_SY_Compu /end COMPU_METHOD
/begin COMPU_VTAB CANBMS_SY_Compu "" TAB_VERB 2 0 "False" 1 "True" /end COMPU_VTAB
/begin COMPU_METHOD CANEPB_SY_Compu "" TAB_VERB "%6.3" "" COMPU_TAB_REF CANEPB_SY_Compu /end COMPU_METHOD
/begin COMPU_VTAB CANEPB_SY_Compu "" TAB_VERB 2 0 "False" 1 "True" /end COMPU_VTAB
/begin COMPU_METHOD CrCtlSlipRat "" RAT_FUNC "%6.4" "%" COEFFS 0 200 0 0 0 1 /end COMPU_METHOD
/begin COMPU_METHOD dez "" RAT_FUNC "%6.2" "" COEFFS 0 1 0 0 0 1 /end COMPU_METHOD
/begin COMPU_METHOD EngN "" RAT_FUNC "%6.3" "rpm" COEFFS 0 2 0 0 0 1 /end COMPU_METHOD
/begin COMPU_METHOD EngNGrd "" RAT_FUNC "%6.3" "rpm/s" COEFFS 0 2 0 0 0 1 /end COMPU_METHOD
/begin COMPU_METHOD EngN_LRes "" RAT_FUNC "%6.1" "rpm" COEFFS 0 0.025 0 0 0 1 /end COMPU_METHOD
/begin COMPU_METHOD Fact "" RAT_FUNC "%6.5" "-" COEFFS 0 8192 0 0 0 1 /end COMPU_METHOD
/begin COMPU_METHOD Fact_2pwr11 "" RAT_FUNC "%6.5" "-" COEFFS 0 2048 0 0 0 1 /end COMPU_METHOD
/begin COMPU_METHOD fak_ub_b16 "" RAT_FUNC "%6.4" "-" COEFFS 0 256 0 0 0 16 /end COMPU_METHOD
/begin COMPU_METHOD fak_ub_b2 "" RAT_FUNC "%8.5" "-" COEFFS 0 256 0 0 0 2 /end COMPU_METHOD
/begin COMPU_METHOD fak_ub_b8 "" RAT_FUNC "%6.4" "-" COEFFS 0 256 0 0 0 8 /end COMPU_METHOD
/begin COMPU_METHOD fak_uw_b2 "" RAT_FUNC "%7.6" "-" COEFFS 0 65536 0 0 0 2 /end COMPU_METHOD
/begin COMPU_METHOD kw_q0p0156 "" RAT_FUNC "%6.4" "Grad KW" COEFFS 0 64 0 0 0 1 /end COMPU_METHOD
/begin COMPU_METHOD kw_q1 "" RAT_FUNC "%6.2" "Grad KW" COEFFS 0 1 0 0 0 1 /end COMPU_METHOD
/begin COMPU_METHOD mdgrad_q10 "" RAT_FUNC "%6.1" "Nm/s" COEFFS 0 1 0 0 0 10 /end COMPU_METHOD
/begin COMPU_METHOD md_sw_q0p1 "" RAT_FUNC "%6.3" "Nm" COEFFS 0 10 0 0 0 1 /end COMPU_METHOD
/begin COMPU_METHOD nmot_q0p5 "" RAT_FUNC "%6.3" "1/min" COEFFS 0 2 0 0 0 1 /end COMPU_METHOD
/begin COMPU_METHOD nmot_ub_q40 "" RAT_FUNC "%6.1" "1/min" COEFFS 0 1 0 0 0 40 /end COMPU_METHOD
/begin COMPU_METHOD OneToOne "" RAT_FUNC "%6.2" "-" COEFFS 0 1 0 0 0 1 /end COMPU_METHOD
/begin COMPU_METHOD Prc "" RAT_FUNC "%6.4" "%" COEFFS 0 81.92 0 0 0 1 /end COMPU_METHOD
/begin COMPU_METHOD Pres "" RAT_FUNC "%6.3" "kPa" COEFFS 0 10 0 0 0 1 /end COMPU_METHOD
/begin COMPU_METHOD p_uw_q0p039 "" RAT_FUNC "%6.4" "hPa" COEFFS 0 256 0 0 0 10 /end COMPU_METHOD
/begin COMPU_METHOD q0p0625_DIV_Nm_s "" RAT_FUNC "%6.4" "1/(Nm*s)" COEFFS 0 65536 0 0 0 4096 /end COMPU_METHOD
/begin COMPU_METHOD rel_q0p01 "" RAT_FUNC "%6.4" "%" COEFFS 0 100 0 0 0 1 /end COMPU_METHOD
/begin COMPU_METHOD rel_q0p0234 "" RAT_FUNC "%6.4" "%" COEFFS 0 128 0 0 0 3 /end COMPU_METHOD
/begin COMPU_METHOD rel_ub_b99p6 "" RAT_FUNC "%6.3" "%" COEFFS 0 256 0 0 0 100 /end COMPU_METHOD
/begin COMPU_METHOD rel_ub_q0p1875 "" RAT_FUNC "%6.3" "KW/ms" COEFFS 0 256 0 0 0 48 /end COMPU_METHOD
/begin COMPU_METHOD spg_q0p1 "" RAT_FUNC "%6.3" "V" COEFFS 0 1 0 0 0 0.1 /end COMPU_METHOD
/begin COMPU_METHOD Temp_Cels "" RAT_FUNC "%6.1" "deg C" COEFFS 0 10 2731.4 0 0 1 /end COMPU_METHOD
/begin COMPU_METHOD temp_ub_q0p75_o48 "" RAT_FUNC "%6.2" "Grad C" COEFFS 0 1 48 0 0 0.75 /end COMPU_METHOD
/begin COMPU_METHOD Time_s "" RAT_FUNC "%6.4" "s" COEFFS 0 100 0 0 0 1 /end COMPU_METHOD
/begin COMPU_METHOD TransR "" RAT_FUNC "%6.4" "-" COEFFS 0 100 0 0 0 1 /end COMPU_METHOD
/begin COMPU_METHOD Trq "" RAT_FUNC "%6.3" "Nm" COEFFS 0 10 0 0 0 1 /end COMPU_METHOD
/begin COMPU_METHOD t_q0p01 "" RAT_FUNC "%6.4" "s" COEFFS 0 100 0 0 0 1 /end COMPU_METHOD
/begin COMPU_METHOD t_q1_ms "" RAT_FUNC "%6.2" "ms" COEFFS 0 1 0 0 0 1 /end COMPU_METHOD
/begin COMPU_METHOD Vel "" RAT_FUNC "%6.4" "km/h" COEFFS 0 100 0 0 0 1 /end COMPU_METHOD
/begin COMPU_METHOD vel_q0p01 "" RAT_FUNC "%6.4" "km/h" COEFFS 0 100 0 0 0 1 /end COMPU_METHOD
/begin COMPU_METHOD VLVLFT_FBSWT_VERB "" TAB_VERB "%6.3" "" COMPU_TAB_REF VLVLFT_FBSWT_VERB /end COMPU_METHOD
/begin COMPU_VTAB VLVLFT_FBSWT_VERB "" TAB_VERB 2 0 "VLVLFT_FBSWT_LOWCAM" 1 "VLVLFT_FBSWT_HIGHCAM" /end COMPU_VTAB
/begin COMPU_METHOD VLVLFT_SIGACTR_VERB "" TAB_VERB "%6.3" "" COMPU_TAB_REF VLVLFT_SIGACTR_VERB /end COMPU_METHOD
/begin COMPU_VTAB VLVLFT_SIGACTR_VERB "" TAB_VERB 2 0 "VLVLFT_SIGACTR_LOWCAM" 1 "VLVLFT_SIGACTR_HIGHCAM" /end COMPU_VTAB
/begin RECORD_LAYOUT RB_Axis_S16 NO_AXIS_PTS_X 1 SWORD AXIS_PTS_X 2 SWORD INDEX_INCR DIRECT /end RECORD_LAYOUT
/begin RECORD_LAYOUT RB_Axis_S8 NO_AXIS_PTS_X 1 SBYTE AXIS_PTS_X 2 SBYTE INDEX_INCR DIRECT /end RECORD_LAYOUT
/begin RECORD_LAYOUT RB_CurveGroup_U8 FNC_VALUES 1 UBYTE COLUMN_DIR DIRECT /end RECORD_LAYOUT
/begin RECORD_LAYOUT RB_Curve_U8_U8 NO_AXIS_PTS_X 1 UBYTE AXIS_PTS_X 2 UBYTE INDEX_INCR DIRECT FNC_VALUES 3 UBYTE COLUMN_DIR DIRECT /end RECORD_LAYOUT
/begin RECORD_LAYOUT RB_MapGroup_S16 FNC_VALUES 1 SWORD COLUMN_DIR DIRECT /end RECORD_LAYOUT
/begin RECORD_LAYOUT RB_MapGroup_U8 FNC_VALUES 1 UBYTE COLUMN_DIR DIRECT /end RECORD_LAYOUT
/begin RECORD_LAYOUT RB_Map_S16S16_S16 NO_AXIS_PTS_X 1 SWORD NO_AXIS_PTS_Y 2 SWORD AXIS_PTS_X 3 SWORD INDEX_INCR DIRECT AXIS_PTS_Y 4 SWORD INDEX_INCR DIRECT FNC_VALUES 5 SWORD COLUMN_DIR DIRECT /end RECORD_LAYOUT
/begin RECORD_LAYOUT RB_Map_S16U16_U16 NO_AXIS_PTS_X 1 SWORD NO_AXIS_PTS_Y 2 SWORD AXIS_PTS_X 3 SWORD INDEX_INCR DIRECT AXIS_PTS_Y 4 UWORD INDEX_INCR DIRECT FNC_VALUES 5 UWORD ROW_DIR DIRECT /end RECORD_LAYOUT
/begin RECORD_LAYOUT RB_Map_U8U8_U8 NO_AXIS_PTS_X 1 UBYTE NO_AXIS_PTS_Y 2 UBYTE AXIS_PTS_X 3 UBYTE INDEX_INCR DIRECT AXIS_PTS_Y 4 UBYTE INDEX_INCR DIRECT FNC_VALUES 5 UBYTE COLUMN_DIR DIRECT /end RECORD_LAYOUT
/begin RECORD_LAYOUT RB_ValA_Wu8 FNC_VALUES 1 UBYTE COLUMN_DIR DIRECT /end RECORD_LAYOUT
/begin RECORD_LAYOUT RB_Val_Wboolean FNC_VALUES 1 UBYTE COLUMN_DIR DIRECT /end RECORD_LAYOUT
/begin RECORD_LAYOUT RB_Val_Ws16 FNC_VALUES 1 SWORD COLUMN_DIR DIRECT /end RECORD_LAYOUT
/begin RECORD_LAYOUT RB_Val_Wu16 FNC_VALUES 1 UWORD COLUMN_DIR DIRECT /end RECORD_LAYOUT
/begin RECORD_LAYOUT RB_Val_Wu8 FNC_VALUES 1 UBYTE COLUMN_DIR DIRECT /end RECORD_LAYOUT
/begin RECORD_LAYOUT Val_Ws16 FNC_VALUES 1 SWORD COLUMN_DIR DIRECT /end RECORD_LAYOUT
/begin RECORD_LAYOUT Val_Ws32 FNC_VALUES 1 SLONG COLUMN_DIR DIRECT /end RECORD_LAYOUT
/begin RECORD_LAYOUT Val_Wu16 FNC_VALUES 1 UWORD COLUMN_DIR DIRECT /end RECORD_LAYOUT
/begin RECORD_LAYOUT Val_Wu8 FNC_VALUES 1 UBYTE COLUMN_DIR DIRECT /end RECORD_LAYOUT
/end MODULE
/end PROJECT
