ASAP2_VERSION 1 60
/begin PROJECT MG1CS022 "MG1CS022"
/begin HEADER "" VERSION "MG1CS022_62XSC_V037_TPROT" PROJECT_NO MG1CS022 /end HEADER
/begin MODULE DIM ""
/begin MOD_COMMON "" BYTE_ORDER MSB_LAST ALIGNMENT_BYTE 1 ALIGNMENT_WORD 2 ALIGNMENT_LONG 4 ALIGNMENT_INT64 4 ALIGNMENT_FLOAT32_IEEE 4 ALIGNMENT_FLOAT64_IEEE 4 DATA_SIZE 32 /end MOD_COMMON
/begin CHARACTERISTIC DFES_EnvRef.DFC_EbsChartcCurrErr_C "used environment signals / Reference to used environment condition set for check DFC_EbsChartcCurrErr" VALUE 0x80504468 Val_Wu8 1.00000000000 DFES_EnvTabVerb 0.00 1.00000000000 FORMAT "%13.11" /end CHARACTERISTIC
/begin CHARACTERISTIC DFES_EnvRef.DFC_EbsSelfDiagErr_C "used environment signals / Reference to used environment condition set for check DFC_EbsSelfDiagErr" VALUE 0x80504469 Val_Wu8 1.00000000000 DFES_EnvTabVerb 0.00 1.00000000000 FORMAT "%13.11" /end CHARACTERISTIC
/begin CHARACTERISTIC DFES_EnvRef.DFC_GEVlvPhaCsersIntkB1_C "used environment signals / Reference to used environment condition set for check DFC_GEVlvPhaCsersIntkB1" VALUE 0x8050446A Val_Wu8 1.00000000000 DFES_EnvTabVerb 0.00 1.00000000000 FORMAT "%13.11" /end CHARACTERISTIC
/begin CHARACTERISTIC DFES_EnvRef.DFC_GEVlvPhaPsOpenLoadIntkB1_C "used environment signals / Reference to used environment condition set for check DFC_GEVlvPhaPsOpenLoadIntkB1" VALUE 0x8050446B Val_Wu8 1.00000000000 DFES_EnvTabVerb 0.00 1.00000000000 FORMAT "%13.11" /end CHARACTERISTIC
/begin CHARACTERISTIC DFES_EnvRef.DFC_GEVlvPhaPsShoToBattIntkB1_C "used environment signals / Reference to used environment condition set for check DFC_GEVlvPhaPsShoToBattIntkB1" VALUE 0x8050446C Val_Wu8 1.00000000000 DFES_EnvTabVerb 0.00 1.00000000000 FORMAT "%13.11" /end CHARACTERISTIC
/begin CHARACTERISTIC DFES_EnvRef.DFC_GEVlvPhaPsShoToGndIntkB1_C "used environment signals / Reference to used environment condition set for check DFC_GEVlvPhaPsShoToGndIntkB1" VALUE 0x8050446D Val_Wu8 1.00000000000 DFES_EnvTabVerb 0.00 1.00000000000 FORMAT "%13.11" /end CHARACTERISTIC
/begin CHARACTERISTIC DFES_EnvRef.DFC_GbxCANDigPlausErr_C "used environment signals / Reference to used environment condition set for check DFC_GbxCANDigPlausErr" VALUE 0x8050446E Val_Wu8 1.00000000000 DFES_EnvTabVerb 0.00 1.00000000000 FORMAT "%13.11" /end CHARACTERISTIC
/begin CHARACTERISTIC DFES_EnvRef.DFC_GbxNPos1SRCMax_C "used environment signals / Reference to used environment condition set for check DFC_GbxNPos1SRCMax" VALUE 0x8050446F Val_Wu8 1.00000000000 DFES_EnvTabVerb 0.00 1.00000000000 FORMAT "%13.11" /end CHARACTERISTIC
/begin CHARACTERISTIC DFES_EnvRef.DFC_GbxNPos1SRCMin_C "used environment signals / Reference to used environment condition set for check DFC_GbxNPos1SRCMin" VALUE 0x80504470 Val_Wu8 1.00000000000 DFES_EnvTabVerb 0.00 1.00000000000 FORMAT "%13.11" /end CHARACTERISTIC
/begin CHARACTERISTIC DFES_EnvRef.DFC_GbxNPos2SRCMax_C "used environment signals / Reference to used environment condition set for check DFC_GbxNPos2SRCMax" VALUE 0x80504471 Val_Wu8 1.00000000000 DFES_EnvTabVerb 0.00 1.00000000000 FORMAT "%13.11" /end CHARACTERISTIC
/begin CHARACTERISTIC DFES_EnvRef.DFC_GbxNPos2SRCMin_C "used environment signals / Reference to used environment condition set for check DFC_GbxNPos2SRCMin" VALUE 0x80504472 Val_Wu8 1.00000000000 DFES_EnvTabVerb 0.00 1.00000000000 FORMAT "%13.11" /end CHARACTERISTIC
/begin CHARACTERISTIC DFES_EnvRef.DFC_GbxNPosAlvChk_C "used environment signals / Reference to used environment condition set for check DFC_GbxNPosAlvChk" VALUE 0x80504473 Val_Wu8 1.00000000000 DFES_EnvTabVerb 0.00 1.00000000000 FORMAT "%13.11" /end CHARACTERISTIC
/begin CHARACTERISTIC DFES_EnvRef.DFC_GbxNPosSyncErr_C "used environment signals / Reference to used environment condition set for check DFC_GbxNPosSyncErr" VALUE 0x80504474 Val_Wu8 1.00000000000 DFES_EnvTabVerb 0.00 1.00000000000 FORMAT "%13.11" /end CHARACTERISTIC
/begin CHARACTERISTIC DFES_EnvRef.DFC_HEGOS2B1HtrPsMax_C "used environment signals / Reference to used environment condition set for check DFC_HEGOS2B1HtrPsMax" VALUE 0x80504475 Val_Wu8 1.00000000000 DFES_EnvTabVerb 0.00 1.00000000000 FORMAT "%13.11" /end CHARACTERISTIC
/begin CHARACTERISTIC DFES_EnvRef.DFC_HEGOS2B1HtrPsMin_C "used environment signals / Reference to used environment condition set for check DFC_HEGOS2B1HtrPsMin" VALUE 0x80504476 Val_Wu8 1.00000000000 DFES_EnvTabVerb 0.00 1.00000000000 FORMAT "%13.11" /end CHARACTERISTIC
/begin CHARACTERISTIC DFES_EnvRef.DFC_HEGOS2B1HtrPsSig_C "used environment signals / Reference to used environment condition set for check DFC_HEGOS2B1HtrPsSig" VALUE 0x80504477 Val_Wu8 1.00000000000 DFES_EnvTabVerb 0.00 1.00000000000 FORMAT "%13.11" /end CHARACTERISTIC
/begin CHARACTERISTIC DFES_EnvRef.DFC_LinCSErrACG_C "used environment signals / Reference to used environment condition set for check DFC_LinCSErrACG" VALUE 0x80504478 Val_Wu8 1.00000000000 DFES_EnvTabVerb 0.00 1.00000000000 FORMAT "%13.11" /end CHARACTERISTIC
/begin CHARACTERISTIC DFES_EnvRef.DFC_LinCSErrAEV_C "used environment signals / Reference to used environment condition set for check DFC_LinCSErrAEV" VALUE 0x80504479 Val_Wu8 1.00000000000 DFES_EnvTabVerb 0.00 1.00000000000 FORMAT "%13.11" /end CHARACTERISTIC
/begin CHARACTERISTIC DFES_EnvRef.DFC_LinCSErrDCDC_C "used environment signals / Reference to used environment condition set for check DFC_LinCSErrDCDC" VALUE 0x8050447A Val_Wu8 1.00000000000 DFES_EnvTabVerb 0.00 1.00000000000 FORMAT "%13.11" /end CHARACTERISTIC
/begin CHARACTERISTIC DFES_EnvRef.DFC_LinCSErrEBS_C "used environment signals / Reference to used environment condition set for check DFC_LinCSErrEBS" VALUE 0x8050447B Val_Wu8 1.00000000000 DFES_EnvTabVerb 0.00 1.00000000000 FORMAT "%13.11" /end CHARACTERISTIC
/begin CHARACTERISTIC DFES_EnvRef.DFC_LinHdrTimeoutErrACG_C "used environment signals / Reference to used environment condition set for check DFC_LinHdrTimeoutErrACG" VALUE 0x8050447C Val_Wu8 1.00000000000 DFES_EnvTabVerb 0.00 1.00000000000 FORMAT "%13.11" /end CHARACTERISTIC
/begin CHARACTERISTIC DFES_EnvRef.DFC_LinHdrTimeoutErrAEV_C "used environment signals / Reference to used environment condition set for check DFC_LinHdrTimeoutErrAEV" VALUE 0x8050447D Val_Wu8 1.00000000000 DFES_EnvTabVerb 0.00 1.00000000000 FORMAT "%13.11" /end CHARACTERISTIC
/begin CHARACTERISTIC DFES_EnvRef.DFC_LinHdrTimeoutErrDCDC_C "used environment signals / Reference to used environment condition set for check DFC_LinHdrTimeoutErrDCDC" VALUE 0x8050447E Val_Wu8 1.00000000000 DFES_EnvTabVerb 0.00 1.00000000000 FORMAT "%13.11" /end CHARACTERISTIC
/begin CHARACTERISTIC DFES_EnvRef.DFC_LinHdrTimeoutErrEBS_C "used environment signals / Reference to used environment condition set for check DFC_LinHdrTimeoutErrEBS" VALUE 0x8050447F Val_Wu8 1.00000000000 DFES_EnvTabVerb 0.00 1.00000000000 FORMAT "%13.11" /end CHARACTERISTIC
/begin CHARACTERISTIC DFES_EnvRef.DFC_LinMsgTimeoutErrACG_C "used environment signals / Reference to used environment condition set for check DFC_LinMsgTimeoutErrACG" VALUE 0x80504480 Val_Wu8 1.00000000000 DFES_EnvTabVerb 0.00 1.00000000000 FORMAT "%13.11" /end CHARACTERISTIC
/begin CHARACTERISTIC DFES_EnvRef.DFC_LinMsgTimeoutErrAEV_C "used environment signals / Reference to used environment condition set for check DFC_LinMsgTimeoutErrAEV" VALUE 0x80504481 Val_Wu8 1.00000000000 DFES_EnvTabVerb 0.00 1.00000000000 FORMAT "%13.11" /end CHARACTERISTIC
/begin CHARACTERISTIC DFES_EnvRef.DFC_LinMsgTimeoutErrDCDC_C "used environment signals / Reference to used environment condition set for check DFC_LinMsgTimeoutErrDCDC" VALUE 0x80504482 Val_Wu8 1.00000000000 DFES_EnvTabVerb 0.00 1.00000000000 FORMAT "%13.11" /end CHARACTERISTIC
/begin CHARACTERISTIC DFES_EnvRef.DFC_LinMsgTimeoutErrEBS_C "used environment signals / Reference to used environment condition set for check DFC_LinMsgTimeoutErrEBS" VALUE 0x80504483 Val_Wu8 1.00000000000 DFES_EnvTabVerb 0.00 1.00000000000 FORMAT "%13.11" /end CHARACTERISTIC
/begin CHARACTERISTIC DFES_EnvRef.DFC_LinNoStrtComErr_C "used environment signals / Reference to used environment condition set for check DFC_LinNoStrtComErr" VALUE 0x80504484 Val_Wu8 1.00000000000 DFES_EnvTabVerb 0.00 1.00000000000 FORMAT "%13.11" /end CHARACTERISTIC
/begin CHARACTERISTIC DFES_EnvRef.DFC_LowPresOilP_C "used environment signals / Reference to used environment condition set for check DFC_LowPresOilP" VALUE 0x80504485 Val_Wu8 1.00000000000 DFES_EnvTabVerb 0.00 1.00000000000 FORMAT "%13.11" /end CHARACTERISTIC
/begin CHARACTERISTIC DFES_EnvRef.DFC_MisfDetVWhlFrntLeOORHi_C "used environment signals / Reference to used environment condition set for check DFC_MisfDetVWhlFrntLeOORHi" VALUE 0x80504486 Val_Wu8 1.00000000000 DFES_EnvTabVerb 0.00 1.00000000000 FORMAT "%13.11" /end CHARACTERISTIC
/begin CHARACTERISTIC DFES_EnvRef.DFC_MisfDetVWhlFrntLeRatyHi_C "used environment signals / Reference to used environment condition set for check DFC_MisfDetVWhlFrntLeRatyHi" VALUE 0x80504487 Val_Wu8 1.00000000000 DFES_EnvTabVerb 0.00 1.00000000000 FORMAT "%13.11" /end CHARACTERISTIC
/begin CHARACTERISTIC DFES_EnvRef.DFC_MisfDetVWhlFrntLeRatyLo_C "used environment signals / Reference to used environment condition set for check DFC_MisfDetVWhlFrntLeRatyLo" VALUE 0x80504488 Val_Wu8 1.00000000000 DFES_EnvTabVerb 0.00 1.00000000000 FORMAT "%13.11" /end CHARACTERISTIC
/begin CHARACTERISTIC DFES_EnvRef.DFC_MisfDetVWhlFrntLeStuck_C "used environment signals / Reference to used environment condition set for check DFC_MisfDetVWhlFrntLeStuck" VALUE 0x80504489 Val_Wu8 1.00000000000 DFES_EnvTabVerb 0.00 1.00000000000 FORMAT "%13.11" /end CHARACTERISTIC
/begin CHARACTERISTIC DFES_EnvRef.DFC_MisfDetVWhlFrntRiOORHi_C "used environment signals / Reference to used environment condition set for check DFC_MisfDetVWhlFrntRiOORHi" VALUE 0x8050448A Val_Wu8 1.00000000000 DFES_EnvTabVerb 0.00 1.00000000000 FORMAT "%13.11" /end CHARACTERISTIC
/begin CHARACTERISTIC DFES_EnvRef.DFC_MisfDetVWhlFrntRiRatyHi_C "used environment signals / Reference to used environment condition set for check DFC_MisfDetVWhlFrntRiRatyHi" VALUE 0x8050448B Val_Wu8 1.00000000000 DFES_EnvTabVerb 0.00 1.00000000000 FORMAT "%13.11" /end CHARACTERISTIC
/begin CHARACTERISTIC DFES_EnvRef.DFC_MisfDetVWhlFrntRiRatyLo_C "used environment signals / Reference to used environment condition set for check DFC_MisfDetVWhlFrntRiRatyLo" VALUE 0x8050448C Val_Wu8 1.00000000000 DFES_EnvTabVerb 0.00 1.00000000000 FORMAT "%13.11" /end CHARACTERISTIC
/begin CHARACTERISTIC DFES_EnvRef.DFC_MisfDetVWhlFrntRiStuck_C "used environment signals / Reference to used environment condition set for check DFC_MisfDetVWhlFrntRiStuck" VALUE 0x8050448D Val_Wu8 1.00000000000 DFES_EnvTabVerb 0.00 1.00000000000 FORMAT "%13.11" /end CHARACTERISTIC
/begin CHARACTERISTIC DFES_EnvRef.DFC_MisfDetVWhlReLeOORHi_C "used environment signals / Reference to used environment condition set for check DFC_MisfDetVWhlReLeOORHi" VALUE 0x8050448E Val_Wu8 1.00000000000 DFES_EnvTabVerb 0.00 1.00000000000 FORMAT "%13.11" /end CHARACTERISTIC
/begin CHARACTERISTIC DFES_EnvRef.DFC_MisfDetVWhlReLeRatyHi_C "used environment signals / Reference to used environment condition set for check DFC_MisfDetVWhlReLeRatyHi" VALUE 0x8050448F Val_Wu8 1.00000000000 DFES_EnvTabVerb 0.00 1.00000000000 FORMAT "%13.11" /end CHARACTERISTIC
/begin CHARACTERISTIC DFES_EnvRef.DFC_MisfDetVWhlReLeRatyLo_C "used environment signals / Reference to used environment condition set for check DFC_MisfDetVWhlReLeRatyLo" VALUE 0x80504490 Val_Wu8 1.00000000000 DFES_EnvTabVerb 0.00 1.00000000000 FORMAT "%13.11" /end CHARACTERISTIC
/begin CHARACTERISTIC DFES_EnvRef.DFC_MisfDetVWhlReLeStuck_C "used environment signals / Reference to used environment condition set for check DFC_MisfDetVWhlReLeStuck" VALUE 0x80504491 Val_Wu8 1.00000000000 DFES_EnvTabVerb 0.00 1.00000000000 FORMAT "%13.11" /end CHARACTERISTIC
/begin CHARACTERISTIC DFES_EnvRef.DFC_MisfDetVWhlReRiOORHi_C "used environment signals / Reference to used environment condition set for check DFC_MisfDetVWhlReRiOORHi" VALUE 0x80504492 Val_Wu8 1.00000000000 DFES_EnvTabVerb 0.00 1.00000000000 FORMAT "%13.11" /end CHARACTERISTIC
/begin CHARACTERISTIC DFES_EnvRef.DFC_MisfDetVWhlReRiRatyHi_C "used environment signals / Reference to used environment condition set for check DFC_MisfDetVWhlReRiRatyHi" VALUE 0x80504493 Val_Wu8 1.00000000000 DFES_EnvTabVerb 0.00 1.00000000000 FORMAT "%13.11" /end CHARACTERISTIC
/begin CHARACTERISTIC DFES_EnvRef.DFC_MisfDetVWhlReRiRatyLo_C "used environment signals / Reference to used environment condition set for check DFC_MisfDetVWhlReRiRatyLo" VALUE 0x80504494 Val_Wu8 1.00000000000 DFES_EnvTabVerb 0.00 1.00000000000 FORMAT "%13.11" /end CHARACTERISTIC
/begin CHARACTERISTIC DFES_EnvRef.DFC_MisfDetVWhlReRiStuck_C "used environment signals / Reference to used environment condition set for check DFC_MisfDetVWhlReRiStuck" VALUE 0x80504495 Val_Wu8 1.00000000000 DFES_EnvTabVerb 0.00 1.00000000000 FORMAT "%13.11" /end CHARACTERISTIC
/begin CHARACTERISTIC DFES_EnvRef.DFC_MisfDetdVWhlFrntLePlaus_C "used environment signals / Reference to used environment condition set for check DFC_MisfDetdVWhlFrntLePlaus" VALUE 0x80504496 Val_Wu8 1.00000000000 DFES_EnvTabVerb 0.00 1.00000000000 FORMAT "%13.11" /end CHARACTERISTIC
/begin CHARACTERISTIC DFES_EnvRef.DFC_MisfDetdVWhlFrntRiPlaus_C "used environment signals / Reference to used environment condition set for check DFC_MisfDetdVWhlFrntRiPlaus" VALUE 0x80504497 Val_Wu8 1.00000000000 DFES_EnvTabVerb 0.00 1.00000000000 FORMAT "%13.11" /end CHARACTERISTIC
/begin CHARACTERISTIC DFES_EnvRef.DFC_MisfDetdVWhlReLePlaus_C "used environment signals / Reference to used environment condition set for check DFC_MisfDetdVWhlReLePlaus" VALUE 0x80504498 Val_Wu8 1.00000000000 DFES_EnvTabVerb 0.00 1.00000000000 FORMAT "%13.11" /end CHARACTERISTIC
/begin CHARACTERISTIC DFES_EnvRef.DFC_MisfDetdVWhlReRiPlaus_C "used environment signals / Reference to used environment condition set for check DFC_MisfDetdVWhlReRiPlaus" VALUE 0x80504499 Val_Wu8 1.00000000000 DFES_EnvTabVerb 0.00 1.00000000000 FORMAT "%13.11" /end CHARACTERISTIC
/begin CHARACTERISTIC DFES_EnvRef.DFC_PEnvSigRngMax_C "used environment signals / Reference to used environment condition set for check DFC_PEnvSigRngMax" VALUE 0x8050449A Val_Wu8 1.00000000000 DFES_EnvTabVerb 0.00 1.00000000000 FORMAT "%13.11" /end CHARACTERISTIC
/begin CHARACTERISTIC DFES_EnvRef.DFC_PEnvSigRngMin_C "used environment signals / Reference to used environment condition set for check DFC_PEnvSigRngMin" VALUE 0x8050449B Val_Wu8 1.00000000000 DFES_EnvTabVerb 0.00 1.00000000000 FORMAT "%13.11" /end CHARACTERISTIC
/begin CHARACTERISTIC DFES_EnvRef.DFC_StmFault_C "used environment signals / Reference to used environment condition set for check DFC_StmFault" VALUE 0x8050449C Val_Wu8 1.00000000000 DFES_EnvTabVerb 0.00 1.00000000000 FORMAT "%13.11" /end CHARACTERISTIC
/begin CHARACTERISTIC DFES_EnvRef.DFC_StrtCtOffPth_C "used environment signals / Reference to used environment condition set for check DFC_StrtCtOffPth" VALUE 0x8050449D Val_Wu8 1.00000000000 DFES_EnvTabVerb 0.00 1.00000000000 FORMAT "%13.11" /end CHARACTERISTIC
/begin CHARACTERISTIC DFES_EnvRef.DFC_StrtCtlErr_C "used environment signals / Reference to used environment condition set for check DFC_StrtCtlErr" VALUE 0x8050449E Val_Wu8 1.00000000000 DFES_EnvTabVerb 0.00 1.00000000000 FORMAT "%13.11" /end CHARACTERISTIC
/begin CHARACTERISTIC DFES_EnvRef.DFC_StrtFault_C "used environment signals / Reference to used environment condition set for check DFC_StrtFault" VALUE 0x8050449F Val_Wu8 1.00000000000 DFES_EnvTabVerb 0.00 1.00000000000 FORMAT "%13.11" /end CHARACTERISTIC
/begin CHARACTERISTIC DFES_EnvRef.DFC_StrtLckJudg1_C "used environment signals / Reference to used environment condition set for check DFC_StrtLckJudg1" VALUE 0x805044A0 Val_Wu8 1.00000000000 DFES_EnvTabVerb 0.00 1.00000000000 FORMAT "%13.11" /end CHARACTERISTIC
/begin CHARACTERISTIC DFES_EnvRef.DFC_StrtLckJudg2_C "used environment signals / Reference to used environment condition set for check DFC_StrtLckJudg2" VALUE 0x805044A1 Val_Wu8 1.00000000000 DFES_EnvTabVerb 0.00 1.00000000000 FORMAT "%13.11" /end CHARACTERISTIC
/begin CHARACTERISTIC DFES_EnvRef.DFC_StrtOL_C "used environment signals / Reference to used environment condition set for check DFC_StrtOL" VALUE 0x805044A2 Val_Wu8 1.00000000000 DFES_EnvTabVerb 0.00 1.00000000000 FORMAT "%13.11" /end CHARACTERISTIC
/begin CHARACTERISTIC DFES_EnvRef.DFC_StrtOL2_C "used environment signals / Reference to used environment condition set for check DFC_StrtOL2" VALUE 0x805044A3 Val_Wu8 1.00000000000 DFES_EnvTabVerb 0.00 1.00000000000 FORMAT "%13.11" /end CHARACTERISTIC
/begin CHARACTERISTIC DFES_EnvRef.DFC_StrtSCB_C "used environment signals / Reference to used environment condition set for check DFC_StrtSCB" VALUE 0x805044A4 Val_Wu8 1.00000000000 DFES_EnvTabVerb 0.00 1.00000000000 FORMAT "%13.11" /end CHARACTERISTIC
/begin CHARACTERISTIC DFES_EnvRef.DFC_StrtSCB2_C "used environment signals / Reference to used environment condition set for check DFC_StrtSCB2" VALUE 0x805044A5 Val_Wu8 1.00000000000 DFES_EnvTabVerb 0.00 1.00000000000 FORMAT "%13.11" /end CHARACTERISTIC
/begin CHARACTERISTIC DFES_EnvRef.DFC_StrtSCG_C "used environment signals / Reference to used environment condition set for check DFC_StrtSCG" VALUE 0x805044A6 Val_Wu8 1.00000000000 DFES_EnvTabVerb 0.00 1.00000000000 FORMAT "%13.11" /end CHARACTERISTIC
/begin CHARACTERISTIC DFES_EnvRef.DFC_StrtSCG2_C "used environment signals / Reference to used environment condition set for check DFC_StrtSCG2" VALUE 0x805044A7 Val_Wu8 1.00000000000 DFES_EnvTabVerb 0.00 1.00000000000 FORMAT "%13.11" /end CHARACTERISTIC
/begin CHARACTERISTIC DFES_EnvRef.DFC_StrtStkRly1_C "used environment signals / Reference to used environment condition set for check DFC_StrtStkRly1" VALUE 0x805044A8 Val_Wu8 1.00000000000 DFES_EnvTabVerb 0.00 1.00000000000 FORMAT "%13.11" /end CHARACTERISTIC
/begin CHARACTERISTIC DFES_EnvRef.DFC_StrtStkRly2_C "used environment signals / Reference to used environment condition set for check DFC_StrtStkRly2" VALUE 0x805044A9 Val_Wu8 1.00000000000 DFES_EnvTabVerb 0.00 1.00000000000 FORMAT "%13.11" /end CHARACTERISTIC
/begin CHARACTERISTIC DFES_EnvRef.DFC_TEVEmax_C "used environment signals / Reference to used environment condition set for check DFC_TEVEmax" VALUE 0x805044AA Val_Wu8 1.00000000000 DFES_EnvTabVerb 0.00 1.00000000000 FORMAT "%13.11" /end CHARACTERISTIC
/begin CHARACTERISTIC DFES_EnvRef.DFC_TEVEmin_C "used environment signals / Reference to used environment condition set for check DFC_TEVEmin" VALUE 0x805044AB Val_Wu8 1.00000000000 DFES_EnvTabVerb 0.00 1.00000000000 FORMAT "%13.11" /end CHARACTERISTIC
/begin CHARACTERISTIC DFES_EnvRef.DFC_TEVEsig_C "used environment signals / Reference to used environment condition set for check DFC_TEVEsig" VALUE 0x805044AC Val_Wu8 1.00000000000 DFES_EnvTabVerb 0.00 1.00000000000 FORMAT "%13.11" /end CHARACTERISTIC
/begin CHARACTERISTIC DFES_EnvRef.DFC_UegoHeatrPrfmncLoS1B1_C "used environment signals / Reference to used environment condition set for check DFC_UegoHeatrPrfmncLoS1B1" VALUE 0x805044AD Val_Wu8 1.00000000000 DFES_EnvTabVerb 0.00 1.00000000000 FORMAT "%13.11" /end CHARACTERISTIC
/begin CHARACTERISTIC DFES_EnvRef.DFC_VehVAllPlaus_C "used environment signals / Reference to used environment condition set for check DFC_VehVAllPlaus" VALUE 0x805044AE Val_Wu8 1.00000000000 DFES_EnvTabVerb 0.00 1.00000000000 FORMAT "%13.11" /end CHARACTERISTIC
/begin CHARACTERISTIC DFES_EnvRef.DFC_VehVNCSnsrElecFailr_C "used environment signals / Reference to used environment condition set for check DFC_VehVNCSnsrElecFailr" VALUE 0x805044AF Val_Wu8 1.00000000000 DFES_EnvTabVerb 0.00 1.00000000000 FORMAT "%13.11" /end CHARACTERISTIC
/begin CHARACTERISTIC DFES_EnvRef.DFC_VehVPlausCan_C "used environment signals / Reference to used environment condition set for check DFC_VehVPlausCan" VALUE 0x805044B0 Val_Wu8 1.00000000000 DFES_EnvTabVerb 0.00 1.00000000000 FORMAT "%13.11" /end CHARACTERISTIC
/begin CHARACTERISTIC DFES_EnvRef.DFC_VehVPlausFco_C "used environment signals / Reference to used environment condition set for check DFC_VehVPlausFco" VALUE 0x805044B1 Val_Wu8 1.00000000000 DFES_EnvTabVerb 0.00 1.00000000000 FORMAT "%13.11" /end CHARACTERISTIC
/begin CHARACTERISTIC DFES_EnvRef.DFC_VehVPlausPwr_C "used environment signals / Reference to used environment condition set for check DFC_VehVPlausPwr" VALUE 0x805044B2 Val_Wu8 1.00000000000 DFES_EnvTabVerb 0.00 1.00000000000 FORMAT "%13.11" /end CHARACTERISTIC
/begin CHARACTERISTIC DFES_EnvRef.DFC_VehVPlausV2N_C "used environment signals / Reference to used environment condition set for check DFC_VehVPlausV2N" VALUE 0x805044B3 Val_Wu8 1.00000000000 DFES_EnvTabVerb 0.00 1.00000000000 FORMAT "%13.11" /end CHARACTERISTIC
/begin CHARACTERISTIC DFES_EnvRef.DFC_VehVSpdSnsrAElecFailr_C "used environment signals / Reference to used environment condition set for check DFC_VehVSpdSnsrAElecFailr" VALUE 0x805044B4 Val_Wu8 1.00000000000 DFES_EnvTabVerb 0.00 1.00000000000 FORMAT "%13.11" /end CHARACTERISTIC
/begin CHARACTERISTIC DFES_EnvRef.DFC_VehVSpdSnsrBElecFailr_C "used environment signals / Reference to used environment condition set for check DFC_VehVSpdSnsrBElecFailr" VALUE 0x805044B5 Val_Wu8 1.00000000000 DFES_EnvTabVerb 0.00 1.00000000000 FORMAT "%13.11" /end CHARACTERISTIC
/begin CHARACTERISTIC DFES_EnvRef.DFC_ClthMax_C "used environment signals / Reference to used environment condition set for check DFC_ClthMax" VALUE 0x805044B6 Val_Wu8 1.00000000000 DFES_EnvTabVerb 0.00 1.00000000000 FORMAT "%13.11" /end CHARACTERISTIC
/begin CHARACTERISTIC DFES_EnvRef.DFC_IgnClPs_DevComErr_C "used environment signals / Reference to used environment condition set for check DFC_IgnClPs_DevComErr" VALUE 0x805044B7 Val_Wu8 1.00000000000 DFES_EnvTabVerb 0.00 1.00000000000 FORMAT "%13.11" /end CHARACTERISTIC
/begin CHARACTERISTIC DFES_EnvRef.DFC_IgnClPs_LineOl_0_C "used environment signals / Reference to used environment condition set for check DFC_IgnClPs_LineOl_0" VALUE 0x805044B8 Val_Wu8 1.00000000000 DFES_EnvTabVerb 0.00 1.00000000000 FORMAT "%13.11" /end CHARACTERISTIC
/begin CHARACTERISTIC DFES_EnvRef.DFC_IgnClPs_LineOl_1_C "used environment signals / Reference to used environment condition set for check DFC_IgnClPs_LineOl_1" VALUE 0x805044B9 Val_Wu8 1.00000000000 DFES_EnvTabVerb 0.00 1.00000000000 FORMAT "%13.11" /end CHARACTERISTIC
/begin CHARACTERISTIC DFES_EnvRef.DFC_IgnClPs_LineOl_2_C "used environment signals / Reference to used environment condition set for check DFC_IgnClPs_LineOl_2" VALUE 0x805044BA Val_Wu8 1.00000000000 DFES_EnvTabVerb 0.00 1.00000000000 FORMAT "%13.11" /end CHARACTERISTIC
/begin CHARACTERISTIC DFES_EnvRef.DFC_IgnClPs_LineOl_3_C "used environment signals / Reference to used environment condition set for check DFC_IgnClPs_LineOl_3" VALUE 0x805044BB Val_Wu8 1.00000000000 DFES_EnvTabVerb 0.00 1.00000000000 FORMAT "%13.11" /end CHARACTERISTIC
/begin CHARACTERISTIC DFES_EnvRef.DFC_IgnClPs_LineScb_0_C "used environment signals / Reference to used environment condition set for check DFC_IgnClPs_LineScb_0" VALUE 0x805044BC Val_Wu8 1.00000000000 DFES_EnvTabVerb 0.00 1.00000000000 FORMAT "%13.11" /end CHARACTERISTIC
/begin CHARACTERISTIC DFES_EnvRef.DFC_IgnClPs_LineScb_1_C "used environment signals / Reference to used environment condition set for check DFC_IgnClPs_LineScb_1" VALUE 0x805044BD Val_Wu8 1.00000000000 DFES_EnvTabVerb 0.00 1.00000000000 FORMAT "%13.11" /end CHARACTERISTIC
/begin CHARACTERISTIC DFES_EnvRef.DFC_IgnClPs_LineScb_2_C "used environment signals / Reference to used environment condition set for check DFC_IgnClPs_LineScb_2" VALUE 0x805044BE Val_Wu8 1.00000000000 DFES_EnvTabVerb 0.00 1.00000000000 FORMAT "%13.11" /end CHARACTERISTIC
/begin CHARACTERISTIC DFES_EnvRef.DFC_IgnClPs_LineScb_3_C "used environment signals / Reference to used environment condition set for check DFC_IgnClPs_LineScb_3" VALUE 0x805044BF Val_Wu8 1.00000000000 DFES_EnvTabVerb 0.00 1.00000000000 FORMAT "%13.11" /end CHARACTERISTIC
/begin CHARACTERISTIC DFES_EnvRef.DFC_IgnClPs_LineScg_0_C "used environment signals / Reference to used environment condition set for check DFC_IgnClPs_LineScg_0" VALUE 0x805044C0 Val_Wu8 1.00000000000 DFES_EnvTabVerb 0.00 1.00000000000 FORMAT "%13.11" /end CHARACTERISTIC
/begin CHARACTERISTIC DFES_EnvRef.DFC_IgnClPs_LineScg_1_C "used environment signals / Reference to used environment condition set for check DFC_IgnClPs_LineScg_1" VALUE 0x805044C1 Val_Wu8 1.00000000000 DFES_EnvTabVerb 0.00 1.00000000000 FORMAT "%13.11" /end CHARACTERISTIC
/begin CHARACTERISTIC DFES_EnvRef.DFC_IgnClPs_LineScg_2_C "used environment signals / Reference to used environment condition set for check DFC_IgnClPs_LineScg_2" VALUE 0x805044C2 Val_Wu8 1.00000000000 DFES_EnvTabVerb 0.00 1.00000000000 FORMAT "%13.11" /end CHARACTERISTIC
/begin CHARACTERISTIC DFES_EnvRef.DFC_IgnClPs_LineScg_3_C "used environment signals / Reference to used environment condition set for check DFC_IgnClPs_LineScg_3" VALUE 0x805044C3 Val_Wu8 1.00000000000 DFES_EnvTabVerb 0.00 1.00000000000 FORMAT "%13.11" /end CHARACTERISTIC
/begin CHARACTERISTIC DFES_EnvRef.DFC_KRVEKOEVAB_C "used environment signals / Reference to used environment condition set for check DFC_KRVEKOEVAB" VALUE 0x805044C4 Val_Wu8 1.00000000000 DFES_EnvTabVerb 0.00 1.00000000000 FORMAT "%13.11" /end CHARACTERISTIC
/begin CHARACTERISTIC DFES_EnvRef.DFC_KRVEKOEVAB0_C "used environment signals / Reference to used environment condition set for check DFC_KRVEKOEVAB0" VALUE 0x805044C5 Val_Wu8 1.00000000000 DFES_EnvTabVerb 0.00 1.00000000000 FORMAT "%13.11" /end CHARACTERISTIC
/begin CHARACTERISTIC DFES_EnvRef.DFC_KRVEKOEVAB1_C "used environment signals / Reference to used environment condition set for check DFC_KRVEKOEVAB1" VALUE 0x805044C6 Val_Wu8 1.00000000000 DFES_EnvTabVerb 0.00 1.00000000000 FORMAT "%13.11" /end CHARACTERISTIC
/begin CHARACTERISTIC DFES_EnvRef.DFC_KRVEKOEVAB2_C "used environment signals / Reference to used environment condition set for check DFC_KRVEKOEVAB2" VALUE 0x805044C7 Val_Wu8 1.00000000000 DFES_EnvTabVerb 0.00 1.00000000000 FORMAT "%13.11" /end CHARACTERISTIC
/begin CHARACTERISTIC DFES_EnvRef.DFC_KRVEKOEVAB3_C "used environment signals / Reference to used environment condition set for check DFC_KRVEKOEVAB3" VALUE 0x805044C8 Val_Wu8 1.00000000000 DFES_EnvTabVerb 0.00 1.00000000000 FORMAT "%13.11" /end CHARACTERISTIC
/begin CHARACTERISTIC DFES_EnvRef.DFC_UegoSigEcuAsicS1B1_C "used environment signals / Reference to used environment condition set for check DFC_UegoSigEcuAsicS1B1" VALUE 0x805044C9 Val_Wu8 1.00000000000 DFES_EnvTabVerb 0.00 1.00000000000 FORMAT "%13.11" /end CHARACTERISTIC
/begin CHARACTERISTIC DFES_EnvRef.DFC_UegoSigEcuComS1B1_C "used environment signals / Reference to used environment condition set for check DFC_UegoSigEcuComS1B1" VALUE 0x805044CA Val_Wu8 1.00000000000 DFES_EnvTabVerb 0.00 1.00000000000 FORMAT "%13.11" /end CHARACTERISTIC
/begin CHARACTERISTIC DFES_EnvRef.DFC_UegoSigSnsrS1B1_C "used environment signals / Reference to used environment condition set for check DFC_UegoSigSnsrS1B1" VALUE 0x805044CB Val_Wu8 1.00000000000 DFES_EnvTabVerb 0.00 1.00000000000 FORMAT "%13.11" /end CHARACTERISTIC
/begin CHARACTERISTIC DFES_EnvRef.DFC_UegoSigWireOlApesS1B1_C "used environment signals / Reference to used environment condition set for check DFC_UegoSigWireOlApesS1B1" VALUE 0x805044CC Val_Wu8 1.00000000000 DFES_EnvTabVerb 0.00 1.00000000000 FORMAT "%13.11" /end CHARACTERISTIC
/begin CHARACTERISTIC DFES_EnvRef.DFC_UegoSigWireOlIpeS1B1_C "used environment signals / Reference to used environment condition set for check DFC_UegoSigWireOlIpeS1B1" VALUE 0x805044CD Val_Wu8 1.00000000000 DFES_EnvTabVerb 0.00 1.00000000000 FORMAT "%13.11" /end CHARACTERISTIC
/begin CHARACTERISTIC DFES_EnvRef.DFC_UegoSigWireOlReS1B1_C "used environment signals / Reference to used environment condition set for check DFC_UegoSigWireOlReS1B1" VALUE 0x805044CE Val_Wu8 1.00000000000 DFES_EnvTabVerb 0.00 1.00000000000 FORMAT "%13.11" /end CHARACTERISTIC
/begin CHARACTERISTIC DFES_EnvRef.DFC_UegoSigWireRCmpS1B1_C "used environment signals / Reference to used environment condition set for check DFC_UegoSigWireRCmpS1B1" VALUE 0x805044CF Val_Wu8 1.00000000000 DFES_EnvTabVerb 0.00 1.00000000000 FORMAT "%13.11" /end CHARACTERISTIC
/begin CHARACTERISTIC DFES_EnvRef.DFC_UegoSigWireScbS1B1_C "used environment signals / Reference to used environment condition set for check DFC_UegoSigWireScbS1B1" VALUE 0x805044D0 Val_Wu8 1.00000000000 DFES_EnvTabVerb 0.00 1.00000000000 FORMAT "%13.11" /end CHARACTERISTIC
/begin CHARACTERISTIC DFES_EnvRef.DFC_UegoSigWireScgS1B1_C "used environment signals / Reference to used environment condition set for check DFC_UegoSigWireScgS1B1" VALUE 0x805044D1 Val_Wu8 1.00000000000 DFES_EnvTabVerb 0.00 1.00000000000 FORMAT "%13.11" /end CHARACTERISTIC
/begin CHARACTERISTIC DFES_EnvRef.DFC_AfsPhyRngHiB1_C "used environment signals / Reference to used environment condition set for check DFC_AfsPhyRngHiB1" VALUE 0x805044D2 Val_Wu8 1.00000000000 DFES_EnvTabVerb 0.00 1.00000000000 FORMAT "%13.11" /end CHARACTERISTIC
/begin CHARACTERISTIC DFES_EnvRef.DFC_AfsPhyRngLoB1_C "used environment signals / Reference to used environment condition set for check DFC_AfsPhyRngLoB1" VALUE 0x805044D3 Val_Wu8 1.00000000000 DFES_EnvTabVerb 0.00 1.00000000000 FORMAT "%13.11" /end CHARACTERISTIC
/begin CHARACTERISTIC DFES_EnvRef.DFC_AirCCmprOL_C "used environment signals / Reference to used environment condition set for check DFC_AirCCmprOL" VALUE 0x805044D4 Val_Wu8 1.00000000000 DFES_EnvTabVerb 0.00 1.00000000000 FORMAT "%13.11" /end CHARACTERISTIC
/begin CHARACTERISTIC DFES_EnvRef.DFC_AirCCmprOvrTemp_C "used environment signals / Reference to used environment condition set for check DFC_AirCCmprOvrTemp" VALUE 0x805044D5 Val_Wu8 1.00000000000 DFES_EnvTabVerb 0.00 1.00000000000 FORMAT "%13.11" /end CHARACTERISTIC
/begin CHARACTERISTIC DFES_EnvRef.DFC_AirCCmprSCB_C "used environment signals / Reference to used environment condition set for check DFC_AirCCmprSCB" VALUE 0x805044D6 Val_Wu8 1.00000000000 DFES_EnvTabVerb 0.00 1.00000000000 FORMAT "%13.11" /end CHARACTERISTIC
/begin CHARACTERISTIC DFES_EnvRef.DFC_AirCCmprSCG_C "used environment signals / Reference to used environment condition set for check DFC_AirCCmprSCG" VALUE 0x805044D7 Val_Wu8 1.00000000000 DFES_EnvTabVerb 0.00 1.00000000000 FORMAT "%13.11" /end CHARACTERISTIC
/begin CHARACTERISTIC DFES_EnvRef.DFC_AltErr_C "used environment signals / Reference to used environment condition set for check DFC_AltErr" VALUE 0x805044D8 Val_Wu8 1.00000000000 DFES_EnvTabVerb 0.00 1.00000000000 FORMAT "%13.11" /end CHARACTERISTIC
/begin CHARACTERISTIC DFES_EnvRef.DFC_BattUSRCMax_C "used environment signals / Reference to used environment condition set for check DFC_BattUSRCMax" VALUE 0x805044D9 Val_Wu8 1.00000000000 DFES_EnvTabVerb 0.00 1.00000000000 FORMAT "%13.11" /end CHARACTERISTIC
/begin CHARACTERISTIC DFES_EnvRef.DFC_BattUSRCMin_C "used environment signals / Reference to used environment condition set for check DFC_BattUSRCMin" VALUE 0x805044DA Val_Wu8 1.00000000000 DFES_EnvTabVerb 0.00 1.00000000000 FORMAT "%13.11" /end CHARACTERISTIC
/begin CHARACTERISTIC DFES_EnvRef.DFC_ComChksTCU1_C "used environment signals / Reference to used environment condition set for check DFC_ComChksTCU1" VALUE 0x805044DB Val_Wu8 1.00000000000 DFES_EnvTabVerb 0.00 1.00000000000 FORMAT "%13.11" /end CHARACTERISTIC
/begin CHARACTERISTIC DFES_EnvRef.DFC_ComChksTCU11_C "used environment signals / Reference to used environment condition set for check DFC_ComChksTCU11" VALUE 0x805044DC Val_Wu8 1.00000000000 DFES_EnvTabVerb 0.00 1.00000000000 FORMAT "%13.11" /end CHARACTERISTIC
/begin CHARACTERISTIC DFES_EnvRef.DFC_ComChksTCU12_C "used environment signals / Reference to used environment condition set for check DFC_ComChksTCU12" VALUE 0x805044DD Val_Wu8 1.00000000000 DFES_EnvTabVerb 0.00 1.00000000000 FORMAT "%13.11" /end CHARACTERISTIC
/begin CHARACTERISTIC DFES_EnvRef.DFC_ComChksTCU13_C "used environment signals / Reference to used environment condition set for check DFC_ComChksTCU13" VALUE 0x805044DE Val_Wu8 1.00000000000 DFES_EnvTabVerb 0.00 1.00000000000 FORMAT "%13.11" /end CHARACTERISTIC
/begin CHARACTERISTIC DFES_EnvRef.DFC_ComChksTCU2_C "used environment signals / Reference to used environment condition set for check DFC_ComChksTCU2" VALUE 0x805044DF Val_Wu8 1.00000000000 DFES_EnvTabVerb 0.00 1.00000000000 FORMAT "%13.11" /end CHARACTERISTIC
/begin CHARACTERISTIC DFES_EnvRef.DFC_ComChksTCU3_C "used environment signals / Reference to used environment condition set for check DFC_ComChksTCU3" VALUE 0x805044E0 Val_Wu8 1.00000000000 DFES_EnvTabVerb 0.00 1.00000000000 FORMAT "%13.11" /end CHARACTERISTIC
/begin CHARACTERISTIC DFES_EnvRef.DFC_ComChksTCU4_C "used environment signals / Reference to used environment condition set for check DFC_ComChksTCU4" VALUE 0x805044E1 Val_Wu8 1.00000000000 DFES_EnvTabVerb 0.00 1.00000000000 FORMAT "%13.11" /end CHARACTERISTIC
/begin CHARACTERISTIC DFES_EnvRef.DFC_ComCntTCU1_C "used environment signals / Reference to used environment condition set for check DFC_ComCntTCU1" VALUE 0x805044E2 Val_Wu8 1.00000000000 DFES_EnvTabVerb 0.00 1.00000000000 FORMAT "%13.11" /end CHARACTERISTIC
/begin CHARACTERISTIC DFES_EnvRef.DFC_ComCntTCU11_C "used environment signals / Reference to used environment condition set for check DFC_ComCntTCU11" VALUE 0x805044E3 Val_Wu8 1.00000000000 DFES_EnvTabVerb 0.00 1.00000000000 FORMAT "%13.11" /end CHARACTERISTIC
/begin CHARACTERISTIC DFES_EnvRef.DFC_ComCntTCU12_C "used environment signals / Reference to used environment condition set for check DFC_ComCntTCU12" VALUE 0x805044E4 Val_Wu8 1.00000000000 DFES_EnvTabVerb 0.00 1.00000000000 FORMAT "%13.11" /end CHARACTERISTIC
/begin CHARACTERISTIC DFES_EnvRef.DFC_ComCntTCU13_C "used environment signals / Reference to used environment condition set for check DFC_ComCntTCU13" VALUE 0x805044E5 Val_Wu8 1.00000000000 DFES_EnvTabVerb 0.00 1.00000000000 FORMAT "%13.11" /end CHARACTERISTIC
/begin CHARACTERISTIC DFES_EnvRef.DFC_ComCntTCU2_C "used environment signals / Reference to used environment condition set for check DFC_ComCntTCU2" VALUE 0x805044E6 Val_Wu8 1.00000000000 DFES_EnvTabVerb 0.00 1.00000000000 FORMAT "%13.11" /end CHARACTERISTIC
/begin CHARACTERISTIC DFES_EnvRef.DFC_ComCntTCU3_C "used environment signals / Reference to used environment condition set for check DFC_ComCntTCU3" VALUE 0x805044E7 Val_Wu8 1.00000000000 DFES_EnvTabVerb 0.00 1.00000000000 FORMAT "%13.11" /end CHARACTERISTIC
/begin CHARACTERISTIC DFES_EnvRef.DFC_ComCntTCU4_C "used environment signals / Reference to used environment condition set for check DFC_ComCntTCU4" VALUE 0x805044E8 Val_Wu8 1.00000000000 DFES_EnvTabVerb 0.00 1.00000000000 FORMAT "%13.11" /end CHARACTERISTIC
/begin CHARACTERISTIC DFES_EnvRef.DFC_ComTOutTCU01_C "used environment signals / Reference to used environment condition set for check DFC_ComTOutTCU01" VALUE 0x805044E9 Val_Wu8 1.00000000000 DFES_EnvTabVerb 0.00 1.00000000000 FORMAT "%13.11" /end CHARACTERISTIC
/begin CHARACTERISTIC DFES_EnvRef.DFC_ComTOutTCU02_C "used environment signals / Reference to used environment condition set for check DFC_ComTOutTCU02" VALUE 0x805044EA Val_Wu8 1.00000000000 DFES_EnvTabVerb 0.00 1.00000000000 FORMAT "%13.11" /end CHARACTERISTIC
/begin CHARACTERISTIC DFES_EnvRef.DFC_ComTOutTCU1_C "used environment signals / Reference to used environment condition set for check DFC_ComTOutTCU1" VALUE 0x805044EB Val_Wu8 1.00000000000 DFES_EnvTabVerb 0.00 1.00000000000 FORMAT "%13.11" /end CHARACTERISTIC
/begin CHARACTERISTIC DFES_EnvRef.DFC_ComTOutTCU11_C "used environment signals / Reference to used environment condition set for check DFC_ComTOutTCU11" VALUE 0x805044EC Val_Wu8 1.00000000000 DFES_EnvTabVerb 0.00 1.00000000000 FORMAT "%13.11" /end CHARACTERISTIC
/begin CHARACTERISTIC DFES_EnvRef.DFC_ComTOutTCU12_C "used environment signals / Reference to used environment condition set for check DFC_ComTOutTCU12" VALUE 0x805044ED Val_Wu8 1.00000000000 DFES_EnvTabVerb 0.00 1.00000000000 FORMAT "%13.11" /end CHARACTERISTIC
/begin CHARACTERISTIC DFES_EnvRef.DFC_ComTOutTCU13_C "used environment signals / Reference to used environment condition set for check DFC_ComTOutTCU13" VALUE 0x805044EE Val_Wu8 1.00000000000 DFES_EnvTabVerb 0.00 1.00000000000 FORMAT "%13.11" /end CHARACTERISTIC
/begin CHARACTERISTIC DFES_EnvRef.DFC_ComTOutTCU14_C "used environment signals / Reference to used environment condition set for check DFC_ComTOutTCU14" VALUE 0x805044EF Val_Wu8 1.00000000000 DFES_EnvTabVerb 0.00 1.00000000000 FORMAT "%13.11" /end CHARACTERISTIC
/begin CHARACTERISTIC DFES_EnvRef.DFC_ComTOutTCU2_C "used environment signals / Reference to used environment condition set for check DFC_ComTOutTCU2" VALUE 0x805044F0 Val_Wu8 1.00000000000 DFES_EnvTabVerb 0.00 1.00000000000 FORMAT "%13.11" /end CHARACTERISTIC
/begin CHARACTERISTIC DFES_EnvRef.DFC_ComTOutTCU3_C "used environment signals / Reference to used environment condition set for check DFC_ComTOutTCU3" VALUE 0x805044F1 Val_Wu8 1.00000000000 DFES_EnvTabVerb 0.00 1.00000000000 FORMAT "%13.11" /end CHARACTERISTIC
/begin CHARACTERISTIC DFES_EnvRef.DFC_ComTOutTCU4_C "used environment signals / Reference to used environment condition set for check DFC_ComTOutTCU4" VALUE 0x805044F2 Val_Wu8 1.00000000000 DFES_EnvTabVerb 0.00 1.00000000000 FORMAT "%13.11" /end CHARACTERISTIC
/begin CHARACTERISTIC DFES_EnvRef.DFC_DevLibBattUHi_C "used environment signals / Reference to used environment condition set for check DFC_DevLibBattUHi" VALUE 0x805044F3 Val_Wu8 1.00000000000 DFES_EnvTabVerb 0.00 1.00000000000 FORMAT "%13.11" /end CHARACTERISTIC
/begin CHARACTERISTIC DFES_EnvRef.DFC_DevLibBattULo_C "used environment signals / Reference to used environment condition set for check DFC_DevLibBattULo" VALUE 0x805044F4 Val_Wu8 1.00000000000 DFES_EnvTabVerb 0.00 1.00000000000 FORMAT "%13.11" /end CHARACTERISTIC
/begin CHARACTERISTIC DFES_EnvRef.DFC_EGRVlvFailSafeActv_C "used environment signals / Reference to used environment condition set for check DFC_EGRVlvFailSafeActv" VALUE 0x805044F5 Val_Wu8 1.00000000000 DFES_EnvTabVerb 0.00 1.00000000000 FORMAT "%13.11" /end CHARACTERISTIC
/begin CHARACTERISTIC DFES_EnvRef.DFC_EGRVlvGovDvtCld_C "used environment signals / Reference to used environment condition set for check DFC_EGRVlvGovDvtCld" VALUE 0x805044F6 Val_Wu8 1.00000000000 DFES_EnvTabVerb 0.00 1.00000000000 FORMAT "%13.11" /end CHARACTERISTIC
/begin CHARACTERISTIC DFES_EnvRef.DFC_EGRVlvPhysSRCMax_C "used environment signals / Reference to used environment condition set for check DFC_EGRVlvPhysSRCMax" VALUE 0x805044F7 Val_Wu8 1.00000000000 DFES_EnvTabVerb 0.00 1.00000000000 FORMAT "%13.11" /end CHARACTERISTIC
/begin CHARACTERISTIC DFES_EnvRef.DFC_EGRVlvPhysSRCMin_C "used environment signals / Reference to used environment condition set for check DFC_EGRVlvPhysSRCMin" VALUE 0x805044F8 Val_Wu8 1.00000000000 DFES_EnvTabVerb 0.00 1.00000000000 FORMAT "%13.11" /end CHARACTERISTIC
/begin CHARACTERISTIC DFES_EnvRef.DFC_FanDIOOL_0_C "used environment signals / Reference to used environment condition set for check DFC_FanDIOOL_0" VALUE 0x805044F9 Val_Wu8 1.00000000000 DFES_EnvTabVerb 0.00 1.00000000000 FORMAT "%13.11" /end CHARACTERISTIC
/begin CHARACTERISTIC DFES_EnvRef.DFC_FanDIOOL_1_C "used environment signals / Reference to used environment condition set for check DFC_FanDIOOL_1" VALUE 0x805044FA Val_Wu8 1.00000000000 DFES_EnvTabVerb 0.00 1.00000000000 FORMAT "%13.11" /end CHARACTERISTIC
/begin CHARACTERISTIC DFES_EnvRef.DFC_FanDIOOvrTemp_0_C "used environment signals / Reference to used environment condition set for check DFC_FanDIOOvrTemp_0" VALUE 0x805044FB Val_Wu8 1.00000000000 DFES_EnvTabVerb 0.00 1.00000000000 FORMAT "%13.11" /end CHARACTERISTIC
/begin CHARACTERISTIC DFES_EnvRef.DFC_FanDIOOvrTemp_1_C "used environment signals / Reference to used environment condition set for check DFC_FanDIOOvrTemp_1" VALUE 0x805044FC Val_Wu8 1.00000000000 DFES_EnvTabVerb 0.00 1.00000000000 FORMAT "%13.11" /end CHARACTERISTIC
/begin CHARACTERISTIC DFES_EnvRef.DFC_FanDIOSCB_0_C "used environment signals / Reference to used environment condition set for check DFC_FanDIOSCB_0" VALUE 0x805044FD Val_Wu8 1.00000000000 DFES_EnvTabVerb 0.00 1.00000000000 FORMAT "%13.11" /end CHARACTERISTIC
/begin CHARACTERISTIC DFES_EnvRef.DFC_FanDIOSCB_1_C "used environment signals / Reference to used environment condition set for check DFC_FanDIOSCB_1" VALUE 0x805044FE Val_Wu8 1.00000000000 DFES_EnvTabVerb 0.00 1.00000000000 FORMAT "%13.11" /end CHARACTERISTIC
/begin CHARACTERISTIC DFES_EnvRef.DFC_FanDIOSCG_0_C "used environment signals / Reference to used environment condition set for check DFC_FanDIOSCG_0" VALUE 0x805044FF Val_Wu8 1.00000000000 DFES_EnvTabVerb 0.00 1.00000000000 FORMAT "%13.11" /end CHARACTERISTIC
/begin CHARACTERISTIC DFES_EnvRef.DFC_FanDIOSCG_1_C "used environment signals / Reference to used environment condition set for check DFC_FanDIOSCG_1" VALUE 0x80504500 Val_Wu8 1.00000000000 DFES_EnvTabVerb 0.00 1.00000000000 FORMAT "%13.11" /end CHARACTERISTIC
/begin CHARACTERISTIC DFES_EnvRef.DFC_MRlyDcOL_C "used environment signals / Reference to used environment condition set for check DFC_MRlyDcOL" VALUE 0x80504501 Val_Wu8 1.00000000000 DFES_EnvTabVerb 0.00 1.00000000000 FORMAT "%13.11" /end CHARACTERISTIC
/begin CHARACTERISTIC DFES_EnvRef.DFC_MRlyDcSCB_C "used environment signals / Reference to used environment condition set for check DFC_MRlyDcSCB" VALUE 0x80504502 Val_Wu8 1.00000000000 DFES_EnvTabVerb 0.00 1.00000000000 FORMAT "%13.11" /end CHARACTERISTIC
/begin CHARACTERISTIC DFES_EnvRef.DFC_MRlyDcSCG_C "used environment signals / Reference to used environment condition set for check DFC_MRlyDcSCG" VALUE 0x80504503 Val_Wu8 1.00000000000 DFES_EnvTabVerb 0.00 1.00000000000 FORMAT "%13.11" /end CHARACTERISTIC
/begin CHARACTERISTIC DFES_EnvRef.DFC_PSPOL_C "used environment signals / Reference to used environment condition set for check DFC_PSPOL" VALUE 0x80504504 Val_Wu8 1.00000000000 DFES_EnvTabVerb 0.00 1.00000000000 FORMAT "%13.11" /end CHARACTERISTIC
/begin CHARACTERISTIC DFES_EnvRef.DFC_PSPOvrTemp_C "used environment signals / Reference to used environment condition set for check DFC_PSPOvrTemp" VALUE 0x80504505 Val_Wu8 1.00000000000 DFES_EnvTabVerb 0.00 1.00000000000 FORMAT "%13.11" /end CHARACTERISTIC
/begin CHARACTERISTIC DFES_EnvRef.DFC_PSPSCB_C "used environment signals / Reference to used environment condition set for check DFC_PSPSCB" VALUE 0x80504506 Val_Wu8 1.00000000000 DFES_EnvTabVerb 0.00 1.00000000000 FORMAT "%13.11" /end CHARACTERISTIC
/begin CHARACTERISTIC DFES_EnvRef.DFC_PSPSCG_C "used environment signals / Reference to used environment condition set for check DFC_PSPSCG" VALUE 0x80504507 Val_Wu8 1.00000000000 DFES_EnvTabVerb 0.00 1.00000000000 FORMAT "%13.11" /end CHARACTERISTIC
/begin CHARACTERISTIC DFES_EnvRef.DFC_T50Err_C "used environment signals / Reference to used environment condition set for check DFC_T50Err" VALUE 0x80504508 Val_Wu8 1.00000000000 DFES_EnvTabVerb 0.00 1.00000000000 FORMAT "%13.11" /end CHARACTERISTIC
/begin CHARACTERISTIC DFES_EnvRef.DFC_ThrVlvLoBattB1_C "used environment signals / Reference to used environment condition set for check DFC_ThrVlvLoBattB1" VALUE 0x80504509 Val_Wu8 1.00000000000 DFES_EnvTabVerb 0.00 1.00000000000 FORMAT "%13.11" /end CHARACTERISTIC
/begin CHARACTERISTIC DFES_EnvRef.DFC_UegoSigOperPlausS1B1_C "used environment signals / Reference to used environment condition set for check DFC_UegoSigOperPlausS1B1" VALUE 0x8050450A Val_Wu8 1.00000000000 DFES_EnvTabVerb 0.00 1.00000000000 FORMAT "%13.11" /end CHARACTERISTIC
/begin CHARACTERISTIC DFES_EnvRef.DFC_VehVPhysRngHi_C "used environment signals / Reference to used environment condition set for check DFC_VehVPhysRngHi" VALUE 0x8050450B Val_Wu8 1.00000000000 DFES_EnvTabVerb 0.00 1.00000000000 FORMAT "%13.11" /end CHARACTERISTIC
/begin CHARACTERISTIC DFES_EnvRef.DFC_VehVSclOutOL_C "used environment signals / Reference to used environment condition set for check DFC_VehVSclOutOL" VALUE 0x8050450C Val_Wu8 1.00000000000 DFES_EnvTabVerb 0.00 1.00000000000 FORMAT "%13.11" /end CHARACTERISTIC
/begin CHARACTERISTIC DFES_EnvRef.DFC_VehVSclOutOT_C "used environment signals / Reference to used environment condition set for check DFC_VehVSclOutOT" VALUE 0x8050450D Val_Wu8 1.00000000000 DFES_EnvTabVerb 0.00 1.00000000000 FORMAT "%13.11" /end CHARACTERISTIC
/begin CHARACTERISTIC DFES_EnvRef.DFC_VehVSclOutSCB_C "used environment signals / Reference to used environment condition set for check DFC_VehVSclOutSCB" VALUE 0x8050450E Val_Wu8 1.00000000000 DFES_EnvTabVerb 0.00 1.00000000000 FORMAT "%13.11" /end CHARACTERISTIC
/begin CHARACTERISTIC DFES_EnvRef.DFC_VehVSclOutSCG_C "used environment signals / Reference to used environment condition set for check DFC_VehVSclOutSCG" VALUE 0x8050450F Val_Wu8 1.00000000000 DFES_EnvTabVerb 0.00 1.00000000000 FORMAT "%13.11" /end CHARACTERISTIC
/begin CHARACTERISTIC DFES_EnvRef.DFC_VehVSigFL_C "used environment signals / Reference to used environment condition set for check DFC_VehVSigFL" VALUE 0x80504510 Val_Wu8 1.00000000000 DFES_EnvTabVerb 0.00 1.00000000000 FORMAT "%13.11" /end CHARACTERISTIC
/begin CHARACTERISTIC DFES_EnvRef.DFC_VehVSigFR_C "used environment signals / Reference to used environment condition set for check DFC_VehVSigFR" VALUE 0x80504511 Val_Wu8 1.00000000000 DFES_EnvTabVerb 0.00 1.00000000000 FORMAT "%13.11" /end CHARACTERISTIC
/begin CHARACTERISTIC DFES_EnvRef.DFC_VehVSigRL_C "used environment signals / Reference to used environment condition set for check DFC_VehVSigRL" VALUE 0x80504512 Val_Wu8 1.00000000000 DFES_EnvTabVerb 0.00 1.00000000000 FORMAT "%13.11" /end CHARACTERISTIC
/begin CHARACTERISTIC DFES_EnvRef.DFC_VehVSigRR_C "used environment signals / Reference to used environment condition set for check DFC_VehVSigRR" VALUE 0x80504513 Val_Wu8 1.00000000000 DFES_EnvTabVerb 0.00 1.00000000000 FORMAT "%13.11" /end CHARACTERISTIC
/begin CHARACTERISTIC DFES_EnvRef.DFC_VehVSnsrARngHi_C "used environment signals / Reference to used environment condition set for check DFC_VehVSnsrARngHi" VALUE 0x80504514 Val_Wu8 1.00000000000 DFES_EnvTabVerb 0.00 1.00000000000 FORMAT "%13.11" /end CHARACTERISTIC
/begin CHARACTERISTIC DFES_EnvRef.DFC_VehVSnsrBRngHi_C "used environment signals / Reference to used environment condition set for check DFC_VehVSnsrBRngHi" VALUE 0x80504515 Val_Wu8 1.00000000000 DFES_EnvTabVerb 0.00 1.00000000000 FORMAT "%13.11" /end CHARACTERISTIC
/begin CHARACTERISTIC DFES_EnvRef.DFC_VehVSpdRtyDiag_C "used environment signals / Reference to used environment condition set for check DFC_VehVSpdRtyDiag" VALUE 0x80504516 Val_Wu8 1.00000000000 DFES_EnvTabVerb 0.00 1.00000000000 FORMAT "%13.11" /end CHARACTERISTIC
/begin CHARACTERISTIC DFES_EnvRef.DFC_DHFHD_C "used environment signals / Reference to used environment condition set for check DFC_DHFHD" VALUE 0x80504517 Val_Wu8 1.00000000000 DFES_EnvTabVerb 0.00 1.00000000000 FORMAT "%13.11" /end CHARACTERISTIC
/begin CHARACTERISTIC DFES_EnvRef.DFC_InjVlv_DI_DcDc_C "used environment signals / Reference to used environment condition set for check DFC_InjVlv_DI_DcDc" VALUE 0x80504518 Val_Wu8 1.00000000000 DFES_EnvTabVerb 0.00 1.00000000000 FORMAT "%13.11" /end CHARACTERISTIC
/begin CHARACTERISTIC DFES_EnvRef.DFC_InjVlv_DI_NoLd_0_C "used environment signals / Reference to used environment condition set for check DFC_InjVlv_DI_NoLd_0" VALUE 0x80504519 Val_Wu8 1.00000000000 DFES_EnvTabVerb 0.00 1.00000000000 FORMAT "%13.11" /end CHARACTERISTIC
/begin CHARACTERISTIC DFES_EnvRef.DFC_InjVlv_DI_NoLd_1_C "used environment signals / Reference to used environment condition set for check DFC_InjVlv_DI_NoLd_1" VALUE 0x8050451A Val_Wu8 1.00000000000 DFES_EnvTabVerb 0.00 1.00000000000 FORMAT "%13.11" /end CHARACTERISTIC
/begin CHARACTERISTIC DFES_EnvRef.DFC_InjVlv_DI_NoLd_2_C "used environment signals / Reference to used environment condition set for check DFC_InjVlv_DI_NoLd_2" VALUE 0x8050451B Val_Wu8 1.00000000000 DFES_EnvTabVerb 0.00 1.00000000000 FORMAT "%13.11" /end CHARACTERISTIC
/begin CHARACTERISTIC DFES_EnvRef.DFC_InjVlv_DI_NoLd_3_C "used environment signals / Reference to used environment condition set for check DFC_InjVlv_DI_NoLd_3" VALUE 0x8050451C Val_Wu8 1.00000000000 DFES_EnvTabVerb 0.00 1.00000000000 FORMAT "%13.11" /end CHARACTERISTIC
/begin CHARACTERISTIC DFES_EnvRef.DFC_InjVlv_DI_ScBnk_0_C "used environment signals / Reference to used environment condition set for check DFC_InjVlv_DI_ScBnk_0" VALUE 0x8050451D Val_Wu8 1.00000000000 DFES_EnvTabVerb 0.00 1.00000000000 FORMAT "%13.11" /end CHARACTERISTIC
/begin CHARACTERISTIC DFES_EnvRef.DFC_InjVlv_DI_ScBnk_1_C "used environment signals / Reference to used environment condition set for check DFC_InjVlv_DI_ScBnk_1" VALUE 0x8050451E Val_Wu8 1.00000000000 DFES_EnvTabVerb 0.00 1.00000000000 FORMAT "%13.11" /end CHARACTERISTIC
/begin CHARACTERISTIC DFES_EnvRef.DFC_InjVlv_DI_ScBnk_2_C "used environment signals / Reference to used environment condition set for check DFC_InjVlv_DI_ScBnk_2" VALUE 0x8050451F Val_Wu8 1.00000000000 DFES_EnvTabVerb 0.00 1.00000000000 FORMAT "%13.11" /end CHARACTERISTIC
/begin CHARACTERISTIC DFES_EnvRef.DFC_InjVlv_DI_ScBnk_3_C "used environment signals / Reference to used environment condition set for check DFC_InjVlv_DI_ScBnk_3" VALUE 0x80504520 Val_Wu8 1.00000000000 DFES_EnvTabVerb 0.00 1.00000000000 FORMAT "%13.11" /end CHARACTERISTIC
/begin CHARACTERISTIC DFES_EnvRef.DFC_InjVlv_DI_ScCyl_0_C "used environment signals / Reference to used environment condition set for check DFC_InjVlv_DI_ScCyl_0" VALUE 0x80504521 Val_Wu8 1.00000000000 DFES_EnvTabVerb 0.00 1.00000000000 FORMAT "%13.11" /end CHARACTERISTIC
/begin CHARACTERISTIC DFES_EnvRef.DFC_InjVlv_DI_ScCyl_1_C "used environment signals / Reference to used environment condition set for check DFC_InjVlv_DI_ScCyl_1" VALUE 0x80504522 Val_Wu8 1.00000000000 DFES_EnvTabVerb 0.00 1.00000000000 FORMAT "%13.11" /end CHARACTERISTIC
/begin CHARACTERISTIC DFES_EnvRef.DFC_InjVlv_DI_ScCyl_2_C "used environment signals / Reference to used environment condition set for check DFC_InjVlv_DI_ScCyl_2" VALUE 0x80504523 Val_Wu8 1.00000000000 DFES_EnvTabVerb 0.00 1.00000000000 FORMAT "%13.11" /end CHARACTERISTIC
/begin CHARACTERISTIC DFES_EnvRef.DFC_InjVlv_DI_ScCyl_3_C "used environment signals / Reference to used environment condition set for check DFC_InjVlv_DI_ScCyl_3" VALUE 0x80504524 Val_Wu8 1.00000000000 DFES_EnvTabVerb 0.00 1.00000000000 FORMAT "%13.11" /end CHARACTERISTIC
/begin CHARACTERISTIC DFES_EnvRef.DFC_InjVlv_DI_ScHsLs_0_C "used environment signals / Reference to used environment condition set for check DFC_InjVlv_DI_ScHsLs_0" VALUE 0x80504525 Val_Wu8 1.00000000000 DFES_EnvTabVerb 0.00 1.00000000000 FORMAT "%13.11" /end CHARACTERISTIC
/begin CHARACTERISTIC DFES_EnvRef.DFC_InjVlv_DI_ScHsLs_1_C "used environment signals / Reference to used environment condition set for check DFC_InjVlv_DI_ScHsLs_1" VALUE 0x80504526 Val_Wu8 1.00000000000 DFES_EnvTabVerb 0.00 1.00000000000 FORMAT "%13.11" /end CHARACTERISTIC
/begin CHARACTERISTIC DFES_EnvRef.DFC_InjVlv_DI_ScHsLs_2_C "used environment signals / Reference to used environment condition set for check DFC_InjVlv_DI_ScHsLs_2" VALUE 0x80504527 Val_Wu8 1.00000000000 DFES_EnvTabVerb 0.00 1.00000000000 FORMAT "%13.11" /end CHARACTERISTIC
/begin CHARACTERISTIC DFES_EnvRef.DFC_InjVlv_DI_ScHsLs_3_C "used environment signals / Reference to used environment condition set for check DFC_InjVlv_DI_ScHsLs_3" VALUE 0x80504528 Val_Wu8 1.00000000000 DFES_EnvTabVerb 0.00 1.00000000000 FORMAT "%13.11" /end CHARACTERISTIC
/begin CHARACTERISTIC DFES_EnvRef.DFC_MfPsDiaOpenLoad1_C "used environment signals / Reference to used environment condition set for check DFC_MfPsDiaOpenLoad1" VALUE 0x80504529 Val_Wu8 1.00000000000 DFES_EnvTabVerb 0.00 1.00000000000 FORMAT "%13.11" /end CHARACTERISTIC
/begin CHARACTERISTIC DFES_EnvRef.DFC_MfPsDiaScHiS1_C "used environment signals / Reference to used environment condition set for check DFC_MfPsDiaScHiS1" VALUE 0x8050452A Val_Wu8 1.00000000000 DFES_EnvTabVerb 0.00 1.00000000000 FORMAT "%13.11" /end CHARACTERISTIC
/begin CHARACTERISTIC DFES_EnvRef.DFC_MfPsDiaScHiSLowS1_C "used environment signals / Reference to used environment condition set for check DFC_MfPsDiaScHiSLowS1" VALUE 0x8050452B Val_Wu8 1.00000000000 DFES_EnvTabVerb 0.00 1.00000000000 FORMAT "%13.11" /end CHARACTERISTIC
/begin CHARACTERISTIC DFES_EnvRef.DFC_MfPsDiaScLowS1_C "used environment signals / Reference to used environment condition set for check DFC_MfPsDiaScLowS1" VALUE 0x8050452C Val_Wu8 1.00000000000 DFES_EnvTabVerb 0.00 1.00000000000 FORMAT "%13.11" /end CHARACTERISTIC
/begin CHARACTERISTIC DFES_EnvRef.DFC_ACEvpTPhysRngHi_C "used environment signals / Reference to used environment condition set for check DFC_ACEvpTPhysRngHi" VALUE 0x8050452D Val_Wu8 1.00000000000 DFES_EnvTabVerb 0.00 1.00000000000 FORMAT "%13.11" /end CHARACTERISTIC
/begin CHARACTERISTIC DFES_EnvRef.DFC_ACEvpTPhysRngLo_C "used environment signals / Reference to used environment condition set for check DFC_ACEvpTPhysRngLo" VALUE 0x8050452E Val_Wu8 1.00000000000 DFES_EnvTabVerb 0.00 1.00000000000 FORMAT "%13.11" /end CHARACTERISTIC
/begin CHARACTERISTIC DFES_EnvRef.DFC_ACEvpTSRCMax_C "used environment signals / Reference to used environment condition set for check DFC_ACEvpTSRCMax" VALUE 0x8050452F Val_Wu8 1.00000000000 DFES_EnvTabVerb 0.00 1.00000000000 FORMAT "%13.11" /end CHARACTERISTIC
/begin CHARACTERISTIC DFES_EnvRef.DFC_ACEvpTSRCMin_C "used environment signals / Reference to used environment condition set for check DFC_ACEvpTSRCMin" VALUE 0x80504530 Val_Wu8 1.00000000000 DFES_EnvTabVerb 0.00 1.00000000000 FORMAT "%13.11" /end CHARACTERISTIC
/begin CHARACTERISTIC DFES_EnvRef.DFC_AfsRawSigRngHiB1_C "used environment signals / Reference to used environment condition set for check DFC_AfsRawSigRngHiB1" VALUE 0x80504531 Val_Wu8 1.00000000000 DFES_EnvTabVerb 0.00 1.00000000000 FORMAT "%13.11" /end CHARACTERISTIC
/begin CHARACTERISTIC DFES_EnvRef.DFC_AfsRawSigRngLoB1_C "used environment signals / Reference to used environment condition set for check DFC_AfsRawSigRngLoB1" VALUE 0x80504532 Val_Wu8 1.00000000000 DFES_EnvTabVerb 0.00 1.00000000000 FORMAT "%13.11" /end CHARACTERISTIC
/begin CHARACTERISTIC DFES_EnvRef.DFC_AfsSnsrErrB1_C "used environment signals / Reference to used environment condition set for check DFC_AfsSnsrErrB1" VALUE 0x80504533 Val_Wu8 1.00000000000 DFES_EnvTabVerb 0.00 1.00000000000 FORMAT "%13.11" /end CHARACTERISTIC
/begin CHARACTERISTIC DFES_EnvRef.DFC_AirCClntPAnaSRCMax_C "used environment signals / Reference to used environment condition set for check DFC_AirCClntPAnaSRCMax" VALUE 0x80504534 Val_Wu8 1.00000000000 DFES_EnvTabVerb 0.00 1.00000000000 FORMAT "%13.11" /end CHARACTERISTIC
/begin CHARACTERISTIC DFES_EnvRef.DFC_AirCClntPAnaSRCMin_C "used environment signals / Reference to used environment condition set for check DFC_AirCClntPAnaSRCMin" VALUE 0x80504535 Val_Wu8 1.00000000000 DFES_EnvTabVerb 0.00 1.00000000000 FORMAT "%13.11" /end CHARACTERISTIC
/begin CHARACTERISTIC DFES_EnvRef.DFC_AirCSwtNpl_C "used environment signals / Reference to used environment condition set for check DFC_AirCSwtNpl" VALUE 0x80504536 Val_Wu8 1.00000000000 DFES_EnvTabVerb 0.00 1.00000000000 FORMAT "%13.11" /end CHARACTERISTIC
/begin CHARACTERISTIC DFES_EnvRef.DFC_AirCSwtSig_C "used environment signals / Reference to used environment condition set for check DFC_AirCSwtSig" VALUE 0x80504537 Val_Wu8 1.00000000000 DFES_EnvTabVerb 0.00 1.00000000000 FORMAT "%13.11" /end CHARACTERISTIC
/begin CHARACTERISTIC DFES_EnvRef.DFC_Brk_C "used environment signals / Reference to used environment condition set for check DFC_Brk" VALUE 0x80504538 Val_Wu8 1.00000000000 DFES_EnvTabVerb 0.00 1.00000000000 FORMAT "%13.11" /end CHARACTERISTIC
/begin CHARACTERISTIC DFES_EnvRef.DFC_BrkBstSensSCB_C "used environment signals / Reference to used environment condition set for check DFC_BrkBstSensSCB" VALUE 0x80504539 Val_Wu8 1.00000000000 DFES_EnvTabVerb 0.00 1.00000000000 FORMAT "%13.11" /end CHARACTERISTIC
/begin CHARACTERISTIC DFES_EnvRef.DFC_BrkBstSensSCG_C "used environment signals / Reference to used environment condition set for check DFC_BrkBstSensSCG" VALUE 0x8050453A Val_Wu8 1.00000000000 DFES_EnvTabVerb 0.00 1.00000000000 FORMAT "%13.11" /end CHARACTERISTIC
/begin CHARACTERISTIC DFES_EnvRef.DFC_BrkSig_C "used environment signals / Reference to used environment condition set for check DFC_BrkSig" VALUE 0x8050453B Val_Wu8 1.00000000000 DFES_EnvTabVerb 0.00 1.00000000000 FORMAT "%13.11" /end CHARACTERISTIC
/begin CHARACTERISTIC DFES_EnvRef.DFC_ClthSig_C "used environment signals / Reference to used environment condition set for check DFC_ClthSig" VALUE 0x8050453C Val_Wu8 1.00000000000 DFES_EnvTabVerb 0.00 1.00000000000 FORMAT "%13.11" /end CHARACTERISTIC
/begin CHARACTERISTIC DFES_EnvRef.DFC_EGRVlvCurrLim_C "used environment signals / Reference to used environment condition set for check DFC_EGRVlvCurrLim" VALUE 0x8050453D Val_Wu8 1.00000000000 DFES_EnvTabVerb 0.00 1.00000000000 FORMAT "%13.11" /end CHARACTERISTIC
/begin CHARACTERISTIC DFES_EnvRef.DFC_EGRVlvOL_C "used environment signals / Reference to used environment condition set for check DFC_EGRVlvOL" VALUE 0x8050453E Val_Wu8 1.00000000000 DFES_EnvTabVerb 0.00 1.00000000000 FORMAT "%13.11" /end CHARACTERISTIC
/begin CHARACTERISTIC DFES_EnvRef.DFC_EGRVlvOvrTemp_C "used environment signals / Reference to used environment condition set for check DFC_EGRVlvOvrTemp" VALUE 0x8050453F Val_Wu8 1.00000000000 DFES_EnvTabVerb 0.00 1.00000000000 FORMAT "%13.11" /end CHARACTERISTIC
/begin CHARACTERISTIC DFES_EnvRef.DFC_EGRVlvSCB_C "used environment signals / Reference to used environment condition set for check DFC_EGRVlvSCB" VALUE 0x80504540 Val_Wu8 1.00000000000 DFES_EnvTabVerb 0.00 1.00000000000 FORMAT "%13.11" /end CHARACTERISTIC
/begin CHARACTERISTIC DFES_EnvRef.DFC_EGRVlvSCG_C "used environment signals / Reference to used environment condition set for check DFC_EGRVlvSCG" VALUE 0x80504541 Val_Wu8 1.00000000000 DFES_EnvTabVerb 0.00 1.00000000000 FORMAT "%13.11" /end CHARACTERISTIC
/begin CHARACTERISTIC DFES_EnvRef.DFC_EGRVlvSRCMax_C "used environment signals / Reference to used environment condition set for check DFC_EGRVlvSRCMax" VALUE 0x80504542 Val_Wu8 1.00000000000 DFES_EnvTabVerb 0.00 1.00000000000 FORMAT "%13.11" /end CHARACTERISTIC
/begin CHARACTERISTIC DFES_EnvRef.DFC_EGRVlvSRCMin_C "used environment signals / Reference to used environment condition set for check DFC_EGRVlvSRCMin" VALUE 0x80504543 Val_Wu8 1.00000000000 DFES_EnvTabVerb 0.00 1.00000000000 FORMAT "%13.11" /end CHARACTERISTIC
/begin CHARACTERISTIC DFES_EnvRef.DFC_HLSDemOvhtEngLim_C "used environment signals / Reference to used environment condition set for check DFC_HLSDemOvhtEngLim" VALUE 0x80504544 Val_Wu8 1.00000000000 DFES_EnvTabVerb 0.00 1.00000000000 FORMAT "%13.11" /end CHARACTERISTIC
/begin CHARACTERISTIC DFES_EnvRef.DFC_OilPSwmpSRCMax_C "used environment signals / Reference to used environment condition set for check DFC_OilPSwmpSRCMax" VALUE 0x80504545 Val_Wu8 1.00000000000 DFES_EnvTabVerb 0.00 1.00000000000 FORMAT "%13.11" /end CHARACTERISTIC
/begin CHARACTERISTIC DFES_EnvRef.DFC_OilPSwmpSRCMin_C "used environment signals / Reference to used environment condition set for check DFC_OilPSwmpSRCMin" VALUE 0x80504546 Val_Wu8 1.00000000000 DFES_EnvTabVerb 0.00 1.00000000000 FORMAT "%13.11" /end CHARACTERISTIC
/begin CHARACTERISTIC DFES_EnvRef.DFC_PIntkVUsLineHiB1_C "used environment signals / Reference to used environment condition set for check DFC_PIntkVUsLineHiB1" VALUE 0x80504547 Val_Wu8 1.00000000000 DFES_EnvTabVerb 0.00 1.00000000000 FORMAT "%13.11" /end CHARACTERISTIC
/begin CHARACTERISTIC DFES_EnvRef.DFC_PIntkVUsLineLoB1_C "used environment signals / Reference to used environment condition set for check DFC_PIntkVUsLineLoB1" VALUE 0x80504548 Val_Wu8 1.00000000000 DFES_EnvTabVerb 0.00 1.00000000000 FORMAT "%13.11" /end CHARACTERISTIC
/begin CHARACTERISTIC DFES_EnvRef.DFC_VehVPhysRngLo_C "used environment signals / Reference to used environment condition set for check DFC_VehVPhysRngLo" VALUE 0x80504549 Val_Wu8 1.00000000000 DFES_EnvTabVerb 0.00 1.00000000000 FORMAT "%13.11" /end CHARACTERISTIC
/begin CHARACTERISTIC DFES_EnvRef.DFC_VehVSigCan_C "used environment signals / Reference to used environment condition set for check DFC_VehVSigCan" VALUE 0x8050454A Val_Wu8 1.00000000000 DFES_EnvTabVerb 0.00 1.00000000000 FORMAT "%13.11" /end CHARACTERISTIC
/begin CHARACTERISTIC DFES_EnvRef.DFC_VehVSigCanSafe_C "used environment signals / Reference to used environment condition set for check DFC_VehVSigCanSafe" VALUE 0x8050454B Val_Wu8 1.00000000000 DFES_EnvTabVerb 0.00 1.00000000000 FORMAT "%13.11" /end CHARACTERISTIC
/begin CHARACTERISTIC DFES_EnvRef.DFC_VlvLftFbOilPSnsrIntk11SRCMax_C "used environment signals / Reference to used environment condition set for check DFC_VlvLftFbOilPSnsrIntk11SRCMax" VALUE 0x8050454C Val_Wu8 1.00000000000 DFES_EnvTabVerb 0.00 1.00000000000 FORMAT "%13.11" /end CHARACTERISTIC
/begin CHARACTERISTIC DFES_EnvRef.DFC_VlvLftFbOilPSnsrIntk11SRCMin_C "used environment signals / Reference to used environment condition set for check DFC_VlvLftFbOilPSnsrIntk11SRCMin" VALUE 0x8050454D Val_Wu8 1.00000000000 DFES_EnvTabVerb 0.00 1.00000000000 FORMAT "%13.11" /end CHARACTERISTIC
/begin CHARACTERISTIC DFES_EnvRef.DFC_ClthNpl_C "used environment signals / Reference to used environment condition set for check DFC_ClthNpl" VALUE 0x8050454E Val_Wu8 1.00000000000 DFES_EnvTabVerb 0.00 1.00000000000 FORMAT "%13.11" /end CHARACTERISTIC
/begin CHARACTERISTIC DFES_EnvRef.DFC_GbxPNPosnDrvCdn_C "used environment signals / Reference to used environment condition set for check DFC_GbxPNPosnDrvCdn" VALUE 0x8050454F Val_Wu8 1.00000000000 DFES_EnvTabVerb 0.00 1.00000000000 FORMAT "%13.11" /end CHARACTERISTIC
/begin CHARACTERISTIC DFES_EnvRef.DFC_GbxPNPosnPlausy_C "used environment signals / Reference to used environment condition set for check DFC_GbxPNPosnPlausy" VALUE 0x80504550 Val_Wu8 1.00000000000 DFES_EnvTabVerb 0.00 1.00000000000 FORMAT "%13.11" /end CHARACTERISTIC
/begin CHARACTERISTIC DFES_EnvRef.DFC_AfsSigErrLineHiB1_C "used environment signals / Reference to used environment condition set for check DFC_AfsSigErrLineHiB1" VALUE 0x80504551 Val_Wu8 1.00000000000 DFES_EnvTabVerb 0.00 1.00000000000 FORMAT "%13.11" /end CHARACTERISTIC
/begin CHARACTERISTIC DFES_EnvRef.DFC_AfsSigErrLineLoB1_C "used environment signals / Reference to used environment condition set for check DFC_AfsSigErrLineLoB1" VALUE 0x80504552 Val_Wu8 1.00000000000 DFES_EnvTabVerb 0.00 1.00000000000 FORMAT "%13.11" /end CHARACTERISTIC
/begin CHARACTERISTIC DFES_EnvRef.DFC_PEnvCcMax_C "used environment signals / Reference to used environment condition set for check DFC_PEnvCcMax" VALUE 0x80504553 Val_Wu8 1.00000000000 DFES_EnvTabVerb 0.00 1.00000000000 FORMAT "%13.11" /end CHARACTERISTIC
/begin CHARACTERISTIC DFES_EnvRef.DFC_PEnvCcMin_C "used environment signals / Reference to used environment condition set for check DFC_PEnvCcMin" VALUE 0x80504554 Val_Wu8 1.00000000000 DFES_EnvTabVerb 0.00 1.00000000000 FORMAT "%13.11" /end CHARACTERISTIC
/begin CHARACTERISTIC DFES_EnvRef.DFC_PEnvRngChkMax_C "used environment signals / Reference to used environment condition set for check DFC_PEnvRngChkMax" VALUE 0x80504555 Val_Wu8 1.00000000000 DFES_EnvTabVerb 0.00 1.00000000000 FORMAT "%13.11" /end CHARACTERISTIC
/begin CHARACTERISTIC DFES_EnvRef.DFC_PEnvRngChkMin_C "used environment signals / Reference to used environment condition set for check DFC_PEnvRngChkMin" VALUE 0x80504556 Val_Wu8 1.00000000000 DFES_EnvTabVerb 0.00 1.00000000000 FORMAT "%13.11" /end CHARACTERISTIC
/begin CHARACTERISTIC DFES_EnvRef.DFC_PEnvSnsrPlaus_C "used environment signals / Reference to used environment condition set for check DFC_PEnvSnsrPlaus" VALUE 0x80504557 Val_Wu8 1.00000000000 DFES_EnvTabVerb 0.00 1.00000000000 FORMAT "%13.11" /end CHARACTERISTIC
/begin CHARACTERISTIC DFES_EnvRef.DFC_UEGOHeatrRlyPsOLS1B1_C "used environment signals / Reference to used environment condition set for check DFC_UEGOHeatrRlyPsOLS1B1" VALUE 0x80504558 Val_Wu8 1.00000000000 DFES_EnvTabVerb 0.00 1.00000000000 FORMAT "%13.11" /end CHARACTERISTIC
/begin CHARACTERISTIC DFES_EnvRef.DFC_UEGOHeatrRlyPsSCBS1B1_C "used environment signals / Reference to used environment condition set for check DFC_UEGOHeatrRlyPsSCBS1B1" VALUE 0x80504559 Val_Wu8 1.00000000000 DFES_EnvTabVerb 0.00 1.00000000000 FORMAT "%13.11" /end CHARACTERISTIC
/begin CHARACTERISTIC DFES_EnvRef.DFC_UEGOHeatrRlyPsSCGS1B1_C "used environment signals / Reference to used environment condition set for check DFC_UEGOHeatrRlyPsSCGS1B1" VALUE 0x8050455A Val_Wu8 1.00000000000 DFES_EnvTabVerb 0.00 1.00000000000 FORMAT "%13.11" /end CHARACTERISTIC
/begin CHARACTERISTIC DFES_EnvRef.DFC_UegoHeatrWireOlS1B1_C "used environment signals / Reference to used environment condition set for check DFC_UegoHeatrWireOlS1B1" VALUE 0x8050455B Val_Wu8 1.00000000000 DFES_EnvTabVerb 0.00 1.00000000000 FORMAT "%13.11" /end CHARACTERISTIC
/begin CHARACTERISTIC DFES_EnvRef.DFC_UegoHeatrWireScbS1B1_C "used environment signals / Reference to used environment condition set for check DFC_UegoHeatrWireScbS1B1" VALUE 0x8050455C Val_Wu8 1.00000000000 DFES_EnvTabVerb 0.00 1.00000000000 FORMAT "%13.11" /end CHARACTERISTIC
/begin CHARACTERISTIC DFES_EnvRef.DFC_UegoHeatrWireScgS1B1_C "used environment signals / Reference to used environment condition set for check DFC_UegoHeatrWireScgS1B1" VALUE 0x8050455D Val_Wu8 1.00000000000 DFES_EnvTabVerb 0.00 1.00000000000 FORMAT "%13.11" /end CHARACTERISTIC
/begin CHARACTERISTIC DFES_EnvRef.DFC_KnDetSens1PortAMax_C "used environment signals / Reference to used environment condition set for check DFC_KnDetSens1PortAMax" VALUE 0x8050455E Val_Wu8 1.00000000000 DFES_EnvTabVerb 0.00 1.00000000000 FORMAT "%13.11" /end CHARACTERISTIC
/begin CHARACTERISTIC DFES_EnvRef.DFC_KnDetSens1PortAMin_C "used environment signals / Reference to used environment condition set for check DFC_KnDetSens1PortAMin" VALUE 0x8050455F Val_Wu8 1.00000000000 DFES_EnvTabVerb 0.00 1.00000000000 FORMAT "%13.11" /end CHARACTERISTIC
/begin CHARACTERISTIC DFES_EnvRef.DFC_KnDetSens1PortBMax_C "used environment signals / Reference to used environment condition set for check DFC_KnDetSens1PortBMax" VALUE 0x80504560 Val_Wu8 1.00000000000 DFES_EnvTabVerb 0.00 1.00000000000 FORMAT "%13.11" /end CHARACTERISTIC
/begin CHARACTERISTIC DFES_EnvRef.DFC_KnDetSens1PortBMin_C "used environment signals / Reference to used environment condition set for check DFC_KnDetSens1PortBMin" VALUE 0x80504561 Val_Wu8 1.00000000000 DFES_EnvTabVerb 0.00 1.00000000000 FORMAT "%13.11" /end CHARACTERISTIC
/begin CHARACTERISTIC DFES_EnvRef.DFC_Clth2ONStuck_C "used environment signals / Reference to used environment condition set for check DFC_Clth2ONStuck" VALUE 0x80504562 Val_Wu8 1.00000000000 DFES_EnvTabVerb 0.00 1.00000000000 FORMAT "%13.11" /end CHARACTERISTIC
/begin CHARACTERISTIC DFES_EnvRef.DFC_Clth2ONStuckLdc_C "used environment signals / Reference to used environment condition set for check DFC_Clth2ONStuckLdc" VALUE 0x80504563 Val_Wu8 1.00000000000 DFES_EnvTabVerb 0.00 1.00000000000 FORMAT "%13.11" /end CHARACTERISTIC
/begin CHARACTERISTIC DFES_EnvRef.DFC_Clth3ONStuckLdc_C "used environment signals / Reference to used environment condition set for check DFC_Clth3ONStuckLdc" VALUE 0x80504564 Val_Wu8 1.00000000000 DFES_EnvTabVerb 0.00 1.00000000000 FORMAT "%13.11" /end CHARACTERISTIC
/begin CHARACTERISTIC DFES_EnvRef.DFC_Clth3ONStuckPostDrv_C "used environment signals / Reference to used environment condition set for check DFC_Clth3ONStuckPostDrv" VALUE 0x80504565 Val_Wu8 1.00000000000 DFES_EnvTabVerb 0.00 1.00000000000 FORMAT "%13.11" /end CHARACTERISTIC
/begin CHARACTERISTIC DFES_EnvRef.DFC_Clth4ONStuck_C "used environment signals / Reference to used environment condition set for check DFC_Clth4ONStuck" VALUE 0x80504566 Val_Wu8 1.00000000000 DFES_EnvTabVerb 0.00 1.00000000000 FORMAT "%13.11" /end CHARACTERISTIC
/begin CHARACTERISTIC DFES_EnvRef.DFC_Clth4ONStuckLdc_C "used environment signals / Reference to used environment condition set for check DFC_Clth4ONStuckLdc" VALUE 0x80504567 Val_Wu8 1.00000000000 DFES_EnvTabVerb 0.00 1.00000000000 FORMAT "%13.11" /end CHARACTERISTIC
/begin CHARACTERISTIC DFES_EnvRef.DFC_ComBCMUnit_C "used environment signals / Reference to used environment condition set for check DFC_ComBCMUnit" VALUE 0x80504568 Val_Wu8 1.00000000000 DFES_EnvTabVerb 0.00 1.00000000000 FORMAT "%13.11" /end CHARACTERISTIC
/begin CHARACTERISTIC DFES_EnvRef.DFC_ComDLCTCU01_C "used environment signals / Reference to used environment condition set for check DFC_ComDLCTCU01" VALUE 0x80504569 Val_Wu8 1.00000000000 DFES_EnvTabVerb 0.00 1.00000000000 FORMAT "%13.11" /end CHARACTERISTIC
/begin CHARACTERISTIC DFES_EnvRef.DFC_ComDLCTCU02_C "used environment signals / Reference to used environment condition set for check DFC_ComDLCTCU02" VALUE 0x8050456A Val_Wu8 1.00000000000 DFES_EnvTabVerb 0.00 1.00000000000 FORMAT "%13.11" /end CHARACTERISTIC
/begin CHARACTERISTIC DFES_EnvRef.DFC_ComDLCTCU1_C "used environment signals / Reference to used environment condition set for check DFC_ComDLCTCU1" VALUE 0x8050456B Val_Wu8 1.00000000000 DFES_EnvTabVerb 0.00 1.00000000000 FORMAT "%13.11" /end CHARACTERISTIC
/begin CHARACTERISTIC DFES_EnvRef.DFC_ComDLCTCU11_C "used environment signals / Reference to used environment condition set for check DFC_ComDLCTCU11" VALUE 0x8050456C Val_Wu8 1.00000000000 DFES_EnvTabVerb 0.00 1.00000000000 FORMAT "%13.11" /end CHARACTERISTIC
/begin CHARACTERISTIC DFES_EnvRef.DFC_ComDLCTCU12_C "used environment signals / Reference to used environment condition set for check DFC_ComDLCTCU12" VALUE 0x8050456D Val_Wu8 1.00000000000 DFES_EnvTabVerb 0.00 1.00000000000 FORMAT "%13.11" /end CHARACTERISTIC
/begin CHARACTERISTIC DFES_EnvRef.DFC_ComDLCTCU13_C "used environment signals / Reference to used environment condition set for check DFC_ComDLCTCU13" VALUE 0x8050456E Val_Wu8 1.00000000000 DFES_EnvTabVerb 0.00 1.00000000000 FORMAT "%13.11" /end CHARACTERISTIC
/begin CHARACTERISTIC DFES_EnvRef.DFC_ComDLCTCU14_C "used environment signals / Reference to used environment condition set for check DFC_ComDLCTCU14" VALUE 0x8050456F Val_Wu8 1.00000000000 DFES_EnvTabVerb 0.00 1.00000000000 FORMAT "%13.11" /end CHARACTERISTIC
/begin CHARACTERISTIC DFES_EnvRef.DFC_ComDLCTCU2_C "used environment signals / Reference to used environment condition set for check DFC_ComDLCTCU2" VALUE 0x80504570 Val_Wu8 1.00000000000 DFES_EnvTabVerb 0.00 1.00000000000 FORMAT "%13.11" /end CHARACTERISTIC
/begin CHARACTERISTIC DFES_EnvRef.DFC_ComDLCTCU3_C "used environment signals / Reference to used environment condition set for check DFC_ComDLCTCU3" VALUE 0x80504571 Val_Wu8 1.00000000000 DFES_EnvTabVerb 0.00 1.00000000000 FORMAT "%13.11" /end CHARACTERISTIC
/begin CHARACTERISTIC DFES_EnvRef.DFC_ComDLCTCU4_C "used environment signals / Reference to used environment condition set for check DFC_ComDLCTCU4" VALUE 0x80504572 Val_Wu8 1.00000000000 DFES_EnvTabVerb 0.00 1.00000000000 FORMAT "%13.11" /end CHARACTERISTIC
/begin CHARACTERISTIC DFES_EnvRef.DFC_ComEPSUnit_C "used environment signals / Reference to used environment condition set for check DFC_ComEPSUnit" VALUE 0x80504573 Val_Wu8 1.00000000000 DFES_EnvTabVerb 0.00 1.00000000000 FORMAT "%13.11" /end CHARACTERISTIC
/begin CHARACTERISTIC DFES_EnvRef.DFC_ComIDASBUnit_C "used environment signals / Reference to used environment condition set for check DFC_ComIDASBUnit" VALUE 0x80504574 Val_Wu8 1.00000000000 DFES_EnvTabVerb 0.00 1.00000000000 FORMAT "%13.11" /end CHARACTERISTIC
/begin CHARACTERISTIC DFES_EnvRef.DFC_ComIMGUnit_C "used environment signals / Reference to used environment condition set for check DFC_ComIMGUnit" VALUE 0x80504575 Val_Wu8 1.00000000000 DFES_EnvTabVerb 0.00 1.00000000000 FORMAT "%13.11" /end CHARACTERISTIC
/begin CHARACTERISTIC DFES_EnvRef.DFC_ComMETUnit_C "used environment signals / Reference to used environment condition set for check DFC_ComMETUnit" VALUE 0x80504576 Val_Wu8 1.00000000000 DFES_EnvTabVerb 0.00 1.00000000000 FORMAT "%13.11" /end CHARACTERISTIC
/begin CHARACTERISTIC DFES_EnvRef.DFC_ComSRSUnit_C "used environment signals / Reference to used environment condition set for check DFC_ComSRSUnit" VALUE 0x80504577 Val_Wu8 1.00000000000 DFES_EnvTabVerb 0.00 1.00000000000 FORMAT "%13.11" /end CHARACTERISTIC
/begin CHARACTERISTIC DFES_EnvRef.DFC_ComVSAUnit_C "used environment signals / Reference to used environment condition set for check DFC_ComVSAUnit" VALUE 0x80504578 Val_Wu8 1.00000000000 DFES_EnvTabVerb 0.00 1.00000000000 FORMAT "%13.11" /end CHARACTERISTIC
/begin CHARACTERISTIC DFES_EnvRef.DFC_EbsSocFlt_C "used environment signals / Reference to used environment condition set for check DFC_EbsSocFlt" VALUE 0x80504579 Val_Wu8 1.00000000000 DFES_EnvTabVerb 0.00 1.00000000000 FORMAT "%13.11" /end CHARACTERISTIC
/begin CHARACTERISTIC DFES_EnvRef.DFC_I14229VINErr_C "used environment signals / Reference to used environment condition set for check DFC_I14229VINErr" VALUE 0x8050457A Val_Wu8 1.00000000000 DFES_EnvTabVerb 0.00 1.00000000000 FORMAT "%13.11" /end CHARACTERISTIC
/begin CHARACTERISTIC DFES_EnvRef.DFC_InjCatHeatgErr_C "used environment signals / Reference to used environment condition set for check DFC_InjCatHeatgErr" VALUE 0x8050457B Val_Wu8 1.00000000000 DFES_EnvTabVerb 0.00 1.00000000000 FORMAT "%13.11" /end CHARACTERISTIC
/begin CHARACTERISTIC DFES_EnvRef.DFC_InjSysMulInjDiagErr_C "used environment signals / Reference to used environment condition set for check DFC_InjSysMulInjDiagErr" VALUE 0x8050457C Val_Wu8 1.00000000000 DFES_EnvTabVerb 0.00 1.00000000000 FORMAT "%13.11" /end CHARACTERISTIC
/begin CHARACTERISTIC DFES_EnvRef.DFC_LLRHmax_C "used environment signals / Reference to used environment condition set for check DFC_LLRHmax" VALUE 0x8050457D Val_Wu8 1.00000000000 DFES_EnvTabVerb 0.00 1.00000000000 FORMAT "%13.11" /end CHARACTERISTIC
/begin CHARACTERISTIC DFES_EnvRef.DFC_LLRHmin_C "used environment signals / Reference to used environment condition set for check DFC_LLRHmin" VALUE 0x8050457E Val_Wu8 1.00000000000 DFES_EnvTabVerb 0.00 1.00000000000 FORMAT "%13.11" /end CHARACTERISTIC
/begin CHARACTERISTIC DFES_EnvRef.DFC_LLRHnpl_C "used environment signals / Reference to used environment condition set for check DFC_LLRHnpl" VALUE 0x8050457F Val_Wu8 1.00000000000 DFES_EnvTabVerb 0.00 1.00000000000 FORMAT "%13.11" /end CHARACTERISTIC
/begin CHARACTERISTIC DFES_EnvRef.DFC_LLRKHmax_C "used environment signals / Reference to used environment condition set for check DFC_LLRKHmax" VALUE 0x80504580 Val_Wu8 1.00000000000 DFES_EnvTabVerb 0.00 1.00000000000 FORMAT "%13.11" /end CHARACTERISTIC
/begin CHARACTERISTIC DFES_EnvRef.DFC_LLRKHmin_C "used environment signals / Reference to used environment condition set for check DFC_LLRKHmin" VALUE 0x80504581 Val_Wu8 1.00000000000 DFES_EnvTabVerb 0.00 1.00000000000 FORMAT "%13.11" /end CHARACTERISTIC
/begin CHARACTERISTIC DFES_EnvRef.DFC_LLRKHnpl_C "used environment signals / Reference to used environment condition set for check DFC_LLRKHnpl" VALUE 0x80504582 Val_Wu8 1.00000000000 DFES_EnvTabVerb 0.00 1.00000000000 FORMAT "%13.11" /end CHARACTERISTIC
/begin CHARACTERISTIC DFES_EnvRef.DFC_LinACGUnit_C "used environment signals / Reference to used environment condition set for check DFC_LinACGUnit" VALUE 0x80504583 Val_Wu8 1.00000000000 DFES_EnvTabVerb 0.00 1.00000000000 FORMAT "%13.11" /end CHARACTERISTIC
/begin CHARACTERISTIC DFES_EnvRef.DFC_LinAEVUnit_C "used environment signals / Reference to used environment condition set for check DFC_LinAEVUnit" VALUE 0x80504584 Val_Wu8 1.00000000000 DFES_EnvTabVerb 0.00 1.00000000000 FORMAT "%13.11" /end CHARACTERISTIC
/begin CHARACTERISTIC DFES_EnvRef.DFC_LinEBSUnit_C "used environment signals / Reference to used environment condition set for check DFC_LinEBSUnit" VALUE 0x80504585 Val_Wu8 1.00000000000 DFES_EnvTabVerb 0.00 1.00000000000 FORMAT "%13.11" /end CHARACTERISTIC
/begin CHARACTERISTIC DFES_EnvRef.DFC_RoughRoad_C "used environment signals / Reference to used environment condition set for check DFC_RoughRoad" VALUE 0x80504586 Val_Wu8 1.00000000000 DFES_EnvTabVerb 0.00 1.00000000000 FORMAT "%13.11" /end CHARACTERISTIC
/begin CHARACTERISTIC DFES_EnvRef.DFC_SiaEEPRdErr_C "used environment signals / Reference to used environment condition set for check DFC_SiaEEPRdErr" VALUE 0x80504587 Val_Wu8 1.00000000000 DFES_EnvTabVerb 0.00 1.00000000000 FORMAT "%13.11" /end CHARACTERISTIC
/begin CHARACTERISTIC DFES_EnvRef.DFC_SiaEEPWrngCod_C "used environment signals / Reference to used environment condition set for check DFC_SiaEEPWrngCod" VALUE 0x80504588 Val_Wu8 1.00000000000 DFES_EnvTabVerb 0.00 1.00000000000 FORMAT "%13.11" /end CHARACTERISTIC
/begin CHARACTERISTIC DFES_EnvRef.DFC_UegoHeatrStrtS1B1_C "used environment signals / Reference to used environment condition set for check DFC_UegoHeatrStrtS1B1" VALUE 0x80504589 Val_Wu8 1.00000000000 DFES_EnvTabVerb 0.00 1.00000000000 FORMAT "%13.11" /end CHARACTERISTIC
/begin CHARACTERISTIC DFES_EnvRef.DFC_BusDiagCANAPPLBusOff_C "used environment signals / Reference to used environment condition set for check DFC_BusDiagCANAPPLBusOff" VALUE 0x8050458A Val_Wu8 1.00000000000 DFES_EnvTabVerb 0.00 1.00000000000 FORMAT "%13.11" /end CHARACTERISTIC
/begin CHARACTERISTIC DFES_EnvRef.DFC_BusDiagCANCANCBusOff_C "used environment signals / Reference to used environment condition set for check DFC_BusDiagCANCANCBusOff" VALUE 0x8050458B Val_Wu8 1.00000000000 DFES_EnvTabVerb 0.00 1.00000000000 FORMAT "%13.11" /end CHARACTERISTIC
/begin CHARACTERISTIC DFES_EnvRef.DFC_BusDiagCANVEHICLEBusOff_C "used environment signals / Reference to used environment condition set for check DFC_BusDiagCANVEHICLEBusOff" VALUE 0x8050458C Val_Wu8 1.00000000000 DFES_EnvTabVerb 0.00 1.00000000000 FORMAT "%13.11" /end CHARACTERISTIC
/begin CHARACTERISTIC DFES_EnvRef.DFC_RBA_IODIAGPWR_rba_IoExtCy329_SignalVltSply_0_C "used environment signals / Reference to used environment condition set for check DFC_RBA_IODIAGPWR_rba_IoExtCy329_SignalVltSply_0" VALUE 0x8050458D Val_Wu8 1.00000000000 DFES_EnvTabVerb 0.00 1.00000000000 FORMAT "%13.11" /end CHARACTERISTIC
/begin CHARACTERISTIC DFES_EnvRef.DFC_RBA_IODIAGPWR_rba_IoExtCy329_SignalVltSply_0OT_C "used environment signals / Reference to used environment condition set for check DFC_RBA_IODIAGPWR_rba_IoExtCy329_SignalVltSply_0OT" VALUE 0x8050458E Val_Wu8 1.00000000000 DFES_EnvTabVerb 0.00 1.00000000000 FORMAT "%13.11" /end CHARACTERISTIC
/begin CHARACTERISTIC DFES_EnvRef.DFC_RBA_IODIAGPWR_rba_IoExtCy329_SignalVltSply_0OV_C "used environment signals / Reference to used environment condition set for check DFC_RBA_IODIAGPWR_rba_IoExtCy329_SignalVltSply_0OV" VALUE 0x8050458F Val_Wu8 1.00000000000 DFES_EnvTabVerb 0.00 1.00000000000 FORMAT "%13.11" /end CHARACTERISTIC
/begin CHARACTERISTIC DFES_EnvRef.DFC_RBA_IODIAGPWR_rba_IoExtCy329_SignalVltSply_0SCG_C "used environment signals / Reference to used environment condition set for check DFC_RBA_IODIAGPWR_rba_IoExtCy329_SignalVltSply_0SCG" VALUE 0x80504590 Val_Wu8 1.00000000000 DFES_EnvTabVerb 0.00 1.00000000000 FORMAT "%13.11" /end CHARACTERISTIC
/begin CHARACTERISTIC DFES_EnvRef.DFC_RBA_IODIAGPWR_rba_IoExtCy329_SignalVltSply_0UV_C "used environment signals / Reference to used environment condition set for check DFC_RBA_IODIAGPWR_rba_IoExtCy329_SignalVltSply_0UV" VALUE 0x80504591 Val_Wu8 1.00000000000 DFES_EnvTabVerb 0.00 1.00000000000 FORMAT "%13.11" /end CHARACTERISTIC
/begin CHARACTERISTIC DFES_EnvRef.DFC_RBA_IODIAGPWR_rba_IoExtCy329_SignalVltSply_1_C "used environment signals / Reference to used environment condition set for check DFC_RBA_IODIAGPWR_rba_IoExtCy329_SignalVltSply_1" VALUE 0x80504592 Val_Wu8 1.00000000000 DFES_EnvTabVerb 0.00 1.00000000000 FORMAT "%13.11" /end CHARACTERISTIC
/begin CHARACTERISTIC DFES_EnvRef.DFC_RBA_IODIAGPWR_rba_IoExtCy329_SignalVltSply_1OT_C "used environment signals / Reference to used environment condition set for check DFC_RBA_IODIAGPWR_rba_IoExtCy329_SignalVltSply_1OT" VALUE 0x80504593 Val_Wu8 1.00000000000 DFES_EnvTabVerb 0.00 1.00000000000 FORMAT "%13.11" /end CHARACTERISTIC
/begin CHARACTERISTIC DFES_EnvRef.DFC_RBA_IODIAGPWR_rba_IoExtCy329_SignalVltSply_1OV_C "used environment signals / Reference to used environment condition set for check DFC_RBA_IODIAGPWR_rba_IoExtCy329_SignalVltSply_1OV" VALUE 0x80504594 Val_Wu8 1.00000000000 DFES_EnvTabVerb 0.00 1.00000000000 FORMAT "%13.11" /end CHARACTERISTIC
/begin CHARACTERISTIC DFES_EnvRef.DFC_RBA_IODIAGPWR_rba_IoExtCy329_SignalVltSply_1SCG_C "used environment signals / Reference to used environment condition set for check DFC_RBA_IODIAGPWR_rba_IoExtCy329_SignalVltSply_1SCG" VALUE 0x80504595 Val_Wu8 1.00000000000 DFES_EnvTabVerb 0.00 1.00000000000 FORMAT "%13.11" /end CHARACTERISTIC
/begin CHARACTERISTIC DFES_EnvRef.DFC_RBA_IODIAGPWR_rba_IoExtCy329_SignalVltSply_1UV_C "used environment signals / Reference to used environment condition set for check DFC_RBA_IODIAGPWR_rba_IoExtCy329_SignalVltSply_1UV" VALUE 0x80504596 Val_Wu8 1.00000000000 DFES_EnvTabVerb 0.00 1.00000000000 FORMAT "%13.11" /end CHARACTERISTIC
/begin CHARACTERISTIC DFES_EnvRef.DFC_RBA_IODIAGPWR_rba_IoExtCy329_SignalVltSply_2_C "used environment signals / Reference to used environment condition set for check DFC_RBA_IODIAGPWR_rba_IoExtCy329_SignalVltSply_2" VALUE 0x80504597 Val_Wu8 1.00000000000 DFES_EnvTabVerb 0.00 1.00000000000 FORMAT "%13.11" /end CHARACTERISTIC
/begin CHARACTERISTIC DFES_EnvRef.DFC_RBA_IODIAGPWR_rba_IoExtCy329_SignalVltSply_2OT_C "used environment signals / Reference to used environment condition set for check DFC_RBA_IODIAGPWR_rba_IoExtCy329_SignalVltSply_2OT" VALUE 0x80504598 Val_Wu8 1.00000000000 DFES_EnvTabVerb 0.00 1.00000000000 FORMAT "%13.11" /end CHARACTERISTIC
/begin CHARACTERISTIC DFES_EnvRef.DFC_RBA_IODIAGPWR_rba_IoExtCy329_SignalVltSply_2OV_C "used environment signals / Reference to used environment condition set for check DFC_RBA_IODIAGPWR_rba_IoExtCy329_SignalVltSply_2OV" VALUE 0x80504599 Val_Wu8 1.00000000000 DFES_EnvTabVerb 0.00 1.00000000000 FORMAT "%13.11" /end CHARACTERISTIC
/begin CHARACTERISTIC DFES_EnvRef.DFC_RBA_IODIAGPWR_rba_IoExtCy329_SignalVltSply_2SCG_C "used environment signals / Reference to used environment condition set for check DFC_RBA_IODIAGPWR_rba_IoExtCy329_SignalVltSply_2SCG" VALUE 0x8050459A Val_Wu8 1.00000000000 DFES_EnvTabVerb 0.00 1.00000000000 FORMAT "%13.11" /end CHARACTERISTIC
/begin CHARACTERISTIC DFES_EnvRef.DFC_RBA_IODIAGPWR_rba_IoExtCy329_SignalVltSply_2UV_C "used environment signals / Reference to used environment condition set for check DFC_RBA_IODIAGPWR_rba_IoExtCy329_SignalVltSply_2UV" VALUE 0x8050459B Val_Wu8 1.00000000000 DFES_EnvTabVerb 0.00 1.00000000000 FORMAT "%13.11" /end CHARACTERISTIC
/begin CHARACTERISTIC DFES_EnvRef.DFC_CAN_E_TIMEOUT_C "used environment signals / Reference to used environment condition set for check DFC_CAN_E_TIMEOUT" VALUE 0x8050459C Val_Wu8 1.00000000000 DFES_EnvTabVerb 0.00 1.00000000000 FORMAT "%13.11" /end CHARACTERISTIC
/begin CHARACTERISTIC DFES_EnvRef.DFC_LIN_E_TIMEOUT_C "used environment signals / Reference to used environment condition set for check DFC_LIN_E_TIMEOUT" VALUE 0x8050459D Val_Wu8 1.00000000000 DFES_EnvTabVerb 0.00 1.00000000000 FORMAT "%13.11" /end CHARACTERISTIC
/begin CHARACTERISTIC DFES_EnvRef.DFC_MRlyOL_C "used environment signals / Reference to used environment condition set for check DFC_MRlyOL" VALUE 0x8050459E Val_Wu8 1.00000000000 DFES_EnvTabVerb 0.00 1.00000000000 FORMAT "%13.11" /end CHARACTERISTIC
/begin CHARACTERISTIC DFES_EnvRef.DFC_MRlySCB_C "used environment signals / Reference to used environment condition set for check DFC_MRlySCB" VALUE 0x8050459F Val_Wu8 1.00000000000 DFES_EnvTabVerb 0.00 1.00000000000 FORMAT "%13.11" /end CHARACTERISTIC
/begin CHARACTERISTIC DFES_EnvRef.DFC_MRlySCG_C "used environment signals / Reference to used environment condition set for check DFC_MRlySCG" VALUE 0x805045A0 Val_Wu8 1.00000000000 DFES_EnvTabVerb 0.00 1.00000000000 FORMAT "%13.11" /end CHARACTERISTIC
/begin CHARACTERISTIC DFES_EnvRef.DFC_rba_MultiStackTrace_Threshold_C "used environment signals / Reference to used environment condition set for check DFC_rba_MultiStackTrace_Threshold" VALUE 0x805045A1 Val_Wu8 1.00000000000 DFES_EnvTabVerb 0.00 1.00000000000 FORMAT "%13.11" /end CHARACTERISTIC
/begin CHARACTERISTIC DFES_EnvRef.DFC_BSWM_E_ACTION_FAILED_C "used environment signals / Reference to used environment condition set for check DFC_BSWM_E_ACTION_FAILED" VALUE 0x805045A2 Val_Wu8 1.00000000000 DFES_EnvTabVerb 0.00 1.00000000000 FORMAT "%13.11" /end CHARACTERISTIC
/begin CHARACTERISTIC DFES_EnvRef.DFC_BSWM_E_INTRPTQUEUE_FULL_C "used environment signals / Reference to used environment condition set for check DFC_BSWM_E_INTRPTQUEUE_FULL" VALUE 0x805045A3 Val_Wu8 1.00000000000 DFES_EnvTabVerb 0.00 1.00000000000 FORMAT "%13.11" /end CHARACTERISTIC
/begin CHARACTERISTIC DFES_EnvRef.DFC_RBA_IOEXTLIB_KEEPALIVE_DRV_C "used environment signals / Reference to used environment condition set for check DFC_RBA_IOEXTLIB_KEEPALIVE_DRV" VALUE 0x805045A4 Val_Wu8 1.00000000000 DFES_EnvTabVerb 0.00 1.00000000000 FORMAT "%13.11" /end CHARACTERISTIC
/begin CHARACTERISTIC DFES_EnvRef.DFC_RBA_IOEXTLIB_KEEPALIVE_INI_C "used environment signals / Reference to used environment condition set for check DFC_RBA_IOEXTLIB_KEEPALIVE_INI" VALUE 0x805045A5 Val_Wu8 1.00000000000 DFES_EnvTabVerb 0.00 1.00000000000 FORMAT "%13.11" /end CHARACTERISTIC
/begin CHARACTERISTIC DFES_EnvRef.DFC_rba_IoSigRtc_StopCounter_C "used environment signals / Reference to used environment condition set for check DFC_rba_IoSigRtc_StopCounter" VALUE 0x805045A6 Val_Wu8 1.00000000000 DFES_EnvTabVerb 0.00 1.00000000000 FORMAT "%13.11" /end CHARACTERISTIC
/begin CHARACTERISTIC DFES_EnvRef.DFC_rba_MRly_Diag_Stk_Event_C "used environment signals / Reference to used environment condition set for check DFC_rba_MRly_Diag_Stk_Event" VALUE 0x805045A7 Val_Wu8 1.00000000000 DFES_EnvTabVerb 0.00 1.00000000000 FORMAT "%13.11" /end CHARACTERISTIC
/begin CHARACTERISTIC DFES_EnvRef.DFC_rba_MemDiag_MemReadErr_C "used environment signals / Reference to used environment condition set for check DFC_rba_MemDiag_MemReadErr" VALUE 0x805045A8 Val_Wu8 1.00000000000 DFES_EnvTabVerb 0.00 1.00000000000 FORMAT "%13.11" /end CHARACTERISTIC
/begin CHARACTERISTIC DFES_EnvRef.DFC_rba_MemDiag_MemWrErr_C "used environment signals / Reference to used environment condition set for check DFC_rba_MemDiag_MemWrErr" VALUE 0x805045A9 Val_Wu8 1.00000000000 DFES_EnvTabVerb 0.00 1.00000000000 FORMAT "%13.11" /end CHARACTERISTIC
/begin CHARACTERISTIC DFES_EnvRef.DFC_rba_SyC_IrrSwOffTrigEngRun_Event_C "used environment signals / Reference to used environment condition set for check DFC_rba_SyC_IrrSwOffTrigEngRun_Event" VALUE 0x805045AA Val_Wu8 1.00000000000 DFES_EnvTabVerb 0.00 1.00000000000 FORMAT "%13.11" /end CHARACTERISTIC
/begin CHARACTERISTIC DFES_EnvRef.DFC_rba_T15_Diag_ComInVld_Event_C "used environment signals / Reference to used environment condition set for check DFC_rba_T15_Diag_ComInVld_Event" VALUE 0x805045AB Val_Wu8 1.00000000000 DFES_EnvTabVerb 0.00 1.00000000000 FORMAT "%13.11" /end CHARACTERISTIC
/begin CHARACTERISTIC DFES_EnvRef.DFC_rba_T15_Diag_ComOff_HwOn_Event_C "used environment signals / Reference to used environment condition set for check DFC_rba_T15_Diag_ComOff_HwOn_Event" VALUE 0x805045AC Val_Wu8 1.00000000000 DFES_EnvTabVerb 0.00 1.00000000000 FORMAT "%13.11" /end CHARACTERISTIC
/begin CHARACTERISTIC DFES_EnvRef.DFC_rba_T15_Diag_ComOn_HwOff_Event_C "used environment signals / Reference to used environment condition set for check DFC_rba_T15_Diag_ComOn_HwOff_Event" VALUE 0x805045AD Val_Wu8 1.00000000000 DFES_EnvTabVerb 0.00 1.00000000000 FORMAT "%13.11" /end CHARACTERISTIC
/begin CHARACTERISTIC DFES_EnvRef.DFC_AAVmin_C "used environment signals / Reference to used environment condition set for check DFC_AAVmin" VALUE 0x805045AE Val_Wu8 1.00000000000 DFES_EnvTabVerb 0.00 1.00000000000 FORMAT "%13.11" /end CHARACTERISTIC
/begin CHARACTERISTIC DFES_EnvRef.DFC_AGRSUS_C "used environment signals / Reference to used environment condition set for check DFC_AGRSUS" VALUE 0x805045AF Val_Wu8 1.00000000000 DFES_EnvTabVerb 0.00 1.00000000000 FORMAT "%13.11" /end CHARACTERISTIC
/begin CHARACTERISTIC DFES_EnvRef.DFC_AfsPlausDiagHi_C "used environment signals / Reference to used environment condition set for check DFC_AfsPlausDiagHi" VALUE 0x805045B0 Val_Wu8 1.00000000000 DFES_EnvTabVerb 0.00 1.00000000000 FORMAT "%13.11" /end CHARACTERISTIC
/begin CHARACTERISTIC DFES_EnvRef.DFC_AfsPlausDiagLo_C "used environment signals / Reference to used environment condition set for check DFC_AfsPlausDiagLo" VALUE 0x805045B1 Val_Wu8 1.00000000000 DFES_EnvTabVerb 0.00 1.00000000000 FORMAT "%13.11" /end CHARACTERISTIC
/begin CHARACTERISTIC DFES_EnvRef.DFC_AfsVrntDiagErrB1_C "used environment signals / Reference to used environment condition set for check DFC_AfsVrntDiagErrB1" VALUE 0x805045B2 Val_Wu8 1.00000000000 DFES_EnvTabVerb 0.00 1.00000000000 FORMAT "%13.11" /end CHARACTERISTIC
/begin CHARACTERISTIC DFES_EnvRef.DFC_AppAllSnsrDfct_C "used environment signals / Reference to used environment condition set for check DFC_AppAllSnsrDfct" VALUE 0x805045B3 Val_Wu8 1.00000000000 DFES_EnvTabVerb 0.00 1.00000000000 FORMAT "%13.11" /end CHARACTERISTIC
/begin CHARACTERISTIC DFES_EnvRef.DFC_BBKRnldg_C "used environment signals / Reference to used environment condition set for check DFC_BBKRnldg" VALUE 0x805045B4 Val_Wu8 1.00000000000 DFES_EnvTabVerb 0.00 1.00000000000 FORMAT "%13.11" /end CHARACTERISTIC
/begin CHARACTERISTIC DFES_EnvRef.DFC_BBKRsyne_C "used environment signals / Reference to used environment condition set for check DFC_BBKRsyne" VALUE 0x805045B5 Val_Wu8 1.00000000000 DFES_EnvTabVerb 0.00 1.00000000000 FORMAT "%13.11" /end CHARACTERISTIC
/begin CHARACTERISTIC DFES_EnvRef.DFC_BattUStdbyDiaOL_C "used environment signals / Reference to used environment condition set for check DFC_BattUStdbyDiaOL" VALUE 0x805045B6 Val_Wu8 1.00000000000 DFES_EnvTabVerb 0.00 1.00000000000 FORMAT "%13.11" /end CHARACTERISTIC
/begin CHARACTERISTIC DFES_EnvRef.DFC_BigLeakIntkMnfldEmiInfl_C "used environment signals / Reference to used environment condition set for check DFC_BigLeakIntkMnfldEmiInfl" VALUE 0x805045B7 Val_Wu8 1.00000000000 DFES_EnvTabVerb 0.00 1.00000000000 FORMAT "%13.11" /end CHARACTERISTIC
/begin CHARACTERISTIC DFES_EnvRef.DFC_BlkdLineTank_C "used environment signals / Reference to used environment condition set for check DFC_BlkdLineTank" VALUE 0x805045B8 Val_Wu8 1.00000000000 DFES_EnvTabVerb 0.00 1.00000000000 FORMAT "%13.11" /end CHARACTERISTIC
/begin CHARACTERISTIC DFES_EnvRef.DFC_BrkMnSwtContOnWarnLmp_C "used environment signals / Reference to used environment condition set for check DFC_BrkMnSwtContOnWarnLmp" VALUE 0x805045B9 Val_Wu8 1.00000000000 DFES_EnvTabVerb 0.00 1.00000000000 FORMAT "%13.11" /end CHARACTERISTIC
/begin CHARACTERISTIC DFES_EnvRef.DFC_BrkMnSwtNotStpWarnLmp_C "used environment signals / Reference to used environment condition set for check DFC_BrkMnSwtNotStpWarnLmp" VALUE 0x805045BA Val_Wu8 1.00000000000 DFES_EnvTabVerb 0.00 1.00000000000 FORMAT "%13.11" /end CHARACTERISTIC
/begin CHARACTERISTIC DFES_EnvRef.DFC_BrkRdntSwtContOnWarnLmp_C "used environment signals / Reference to used environment condition set for check DFC_BrkRdntSwtContOnWarnLmp" VALUE 0x805045BB Val_Wu8 1.00000000000 DFES_EnvTabVerb 0.00 1.00000000000 FORMAT "%13.11" /end CHARACTERISTIC
/begin CHARACTERISTIC DFES_EnvRef.DFC_BrkRdntSwtNotStpWarnLmp_C "used environment signals / Reference to used environment condition set for check DFC_BrkRdntSwtNotStpWarnLmp" VALUE 0x805045BC Val_Wu8 1.00000000000 DFES_EnvTabVerb 0.00 1.00000000000 FORMAT "%13.11" /end CHARACTERISTIC
/begin CHARACTERISTIC DFES_EnvRef.DFC_CEngDsTColdStrtMax_C "used environment signals / Reference to used environment condition set for check DFC_CEngDsTColdStrtMax" VALUE 0x805045BD Val_Wu8 1.00000000000 DFES_EnvTabVerb 0.00 1.00000000000 FORMAT "%13.11" /end CHARACTERISTIC
/begin CHARACTERISTIC DFES_EnvRef.DFC_CEngDsTColdStrtMin_C "used environment signals / Reference to used environment condition set for check DFC_CEngDsTColdStrtMin" VALUE 0x805045BE Val_Wu8 1.00000000000 DFES_EnvTabVerb 0.00 1.00000000000 FORMAT "%13.11" /end CHARACTERISTIC
/begin CHARACTERISTIC DFES_EnvRef.DFC_CEngDsTImps_C "used environment signals / Reference to used environment condition set for check DFC_CEngDsTImps" VALUE 0x805045BF Val_Wu8 1.00000000000 DFES_EnvTabVerb 0.00 1.00000000000 FORMAT "%13.11" /end CHARACTERISTIC
/begin CHARACTERISTIC DFES_EnvRef.DFC_CEngDsTPlausHSC_C "used environment signals / Reference to used environment condition set for check DFC_CEngDsTPlausHSC" VALUE 0x805045C0 Val_Wu8 1.00000000000 DFES_EnvTabVerb 0.00 1.00000000000 FORMAT "%13.11" /end CHARACTERISTIC
/begin CHARACTERISTIC DFES_EnvRef.DFC_CEngDsTPlausLSC_C "used environment signals / Reference to used environment condition set for check DFC_CEngDsTPlausLSC" VALUE 0x805045C1 Val_Wu8 1.00000000000 DFES_EnvTabVerb 0.00 1.00000000000 FORMAT "%13.11" /end CHARACTERISTIC
/begin CHARACTERISTIC DFES_EnvRef.DFC_CEngDsTPlausSTC_C "used environment signals / Reference to used environment condition set for check DFC_CEngDsTPlausSTC" VALUE 0x805045C2 Val_Wu8 1.00000000000 DFES_EnvTabVerb 0.00 1.00000000000 FORMAT "%13.11" /end CHARACTERISTIC
/begin CHARACTERISTIC DFES_EnvRef.DFC_CEngDsTSRCMax_C "used environment signals / Reference to used environment condition set for check DFC_CEngDsTSRCMax" VALUE 0x805045C3 Val_Wu8 1.00000000000 DFES_EnvTabVerb 0.00 1.00000000000 FORMAT "%13.11" /end CHARACTERISTIC
/begin CHARACTERISTIC DFES_EnvRef.DFC_CEngDsTSRCMin_C "used environment signals / Reference to used environment condition set for check DFC_CEngDsTSRCMin" VALUE 0x805045C4 Val_Wu8 1.00000000000 DFES_EnvTabVerb 0.00 1.00000000000 FORMAT "%13.11" /end CHARACTERISTIC
/begin CHARACTERISTIC DFES_EnvRef.DFC_CEngDsTSig_C "used environment signals / Reference to used environment condition set for check DFC_CEngDsTSig" VALUE 0x805045C5 Val_Wu8 1.00000000000 DFES_EnvTabVerb 0.00 1.00000000000 FORMAT "%13.11" /end CHARACTERISTIC
/begin CHARACTERISTIC DFES_EnvRef.DFC_CEngUsTColdStrtMax_C "used environment signals / Reference to used environment condition set for check DFC_CEngUsTColdStrtMax" VALUE 0x805045C6 Val_Wu8 1.00000000000 DFES_EnvTabVerb 0.00 1.00000000000 FORMAT "%13.11" /end CHARACTERISTIC
/begin CHARACTERISTIC DFES_EnvRef.DFC_CEngUsTColdStrtMin_C "used environment signals / Reference to used environment condition set for check DFC_CEngUsTColdStrtMin" VALUE 0x805045C7 Val_Wu8 1.00000000000 DFES_EnvTabVerb 0.00 1.00000000000 FORMAT "%13.11" /end CHARACTERISTIC
/begin CHARACTERISTIC DFES_EnvRef.DFC_CEngUsTLooseCnctn_C "used environment signals / Reference to used environment condition set for check DFC_CEngUsTLooseCnctn" VALUE 0x805045C8 Val_Wu8 1.00000000000 DFES_EnvTabVerb 0.00 1.00000000000 FORMAT "%13.11" /end CHARACTERISTIC
/begin CHARACTERISTIC DFES_EnvRef.DFC_CEngUsTSRCMax_C "used environment signals / Reference to used environment condition set for check DFC_CEngUsTSRCMax" VALUE 0x805045C9 Val_Wu8 1.00000000000 DFES_EnvTabVerb 0.00 1.00000000000 FORMAT "%13.11" /end CHARACTERISTIC
/begin CHARACTERISTIC DFES_EnvRef.DFC_CEngUsTSRCMin_C "used environment signals / Reference to used environment condition set for check DFC_CEngUsTSRCMin" VALUE 0x805045CA Val_Wu8 1.00000000000 DFES_EnvTabVerb 0.00 1.00000000000 FORMAT "%13.11" /end CHARACTERISTIC
/begin CHARACTERISTIC DFES_EnvRef.DFC_ComDCDCACCFailr_C "used environment signals / Reference to used environment condition set for check DFC_ComDCDCACCFailr" VALUE 0x805045CB Val_Wu8 1.00000000000 DFES_EnvTabVerb 0.00 1.00000000000 FORMAT "%13.11" /end CHARACTERISTIC
/begin CHARACTERISTIC DFES_EnvRef.DFC_DCDCFltDet_C "used environment signals / Reference to used environment condition set for check DFC_DCDCFltDet" VALUE 0x805045CC Val_Wu8 1.00000000000 DFES_EnvTabVerb 0.00 1.00000000000 FORMAT "%13.11" /end CHARACTERISTIC
/begin CHARACTERISTIC DFES_EnvRef.DFC_DKRSA_C "used environment signals / Reference to used environment condition set for check DFC_DKRSA" VALUE 0x805045CD Val_Wu8 1.00000000000 DFES_EnvTabVerb 0.00 1.00000000000 FORMAT "%13.11" /end CHARACTERISTIC
/begin CHARACTERISTIC DFES_EnvRef.DFC_DKVSmax_C "used environment signals / Reference to used environment condition set for check DFC_DKVSmax" VALUE 0x805045CE Val_Wu8 1.00000000000 DFES_EnvTabVerb 0.00 1.00000000000 FORMAT "%13.11" /end CHARACTERISTIC
/begin CHARACTERISTIC DFES_EnvRef.DFC_DKnpl_C "used environment signals / Reference to used environment condition set for check DFC_DKnpl" VALUE 0x805045CF Val_Wu8 1.00000000000 DFES_EnvTabVerb 0.00 1.00000000000 FORMAT "%13.11" /end CHARACTERISTIC
/begin CHARACTERISTIC DFES_EnvRef.DFC_DSKVRmax_C "used environment signals / Reference to used environment condition set for check DFC_DSKVRmax" VALUE 0x805045D0 Val_Wu8 1.00000000000 DFES_EnvTabVerb 0.00 1.00000000000 FORMAT "%13.11" /end CHARACTERISTIC
/begin CHARACTERISTIC DFES_EnvRef.DFC_DSKVRmin_C "used environment signals / Reference to used environment condition set for check DFC_DSKVRmin" VALUE 0x805045D1 Val_Wu8 1.00000000000 DFES_EnvTabVerb 0.00 1.00000000000 FORMAT "%13.11" /end CHARACTERISTIC
/begin CHARACTERISTIC DFES_EnvRef.DFC_DSKVRnpl_C "used environment signals / Reference to used environment condition set for check DFC_DSKVRnpl" VALUE 0x805045D2 Val_Wu8 1.00000000000 DFES_EnvTabVerb 0.00 1.00000000000 FORMAT "%13.11" /end CHARACTERISTIC
/begin CHARACTERISTIC DFES_EnvRef.DFC_DSKVRsig_C "used environment signals / Reference to used environment condition set for check DFC_DSKVRsig" VALUE 0x805045D3 Val_Wu8 1.00000000000 DFES_EnvTabVerb 0.00 1.00000000000 FORMAT "%13.11" /end CHARACTERISTIC
/begin CHARACTERISTIC DFES_EnvRef.DFC_DSKVSsig_C "used environment signals / Reference to used environment condition set for check DFC_DSKVSsig" VALUE 0x805045D4 Val_Wu8 1.00000000000 DFES_EnvTabVerb 0.00 1.00000000000 FORMAT "%13.11" /end CHARACTERISTIC
/begin CHARACTERISTIC DFES_EnvRef.DFC_DSSmax_C "used environment signals / Reference to used environment condition set for check DFC_DSSmax" VALUE 0x805045D5 Val_Wu8 1.00000000000 DFES_EnvTabVerb 0.00 1.00000000000 FORMAT "%13.11" /end CHARACTERISTIC
/begin CHARACTERISTIC DFES_EnvRef.DFC_DSTDmax_C "used environment signals / Reference to used environment condition set for check DFC_DSTDmax" VALUE 0x805045D6 Val_Wu8 1.00000000000 DFES_EnvTabVerb 0.00 1.00000000000 FORMAT "%13.11" /end CHARACTERISTIC
/begin CHARACTERISTIC DFES_EnvRef.DFC_DSTEmax_C "used environment signals / Reference to used environment condition set for check DFC_DSTEmax" VALUE 0x805045D7 Val_Wu8 1.00000000000 DFES_EnvTabVerb 0.00 1.00000000000 FORMAT "%13.11" /end CHARACTERISTIC
/begin CHARACTERISTIC DFES_EnvRef.DFC_DSTEmin_C "used environment signals / Reference to used environment condition set for check DFC_DSTEmin" VALUE 0x805045D8 Val_Wu8 1.00000000000 DFES_EnvTabVerb 0.00 1.00000000000 FORMAT "%13.11" /end CHARACTERISTIC
/begin CHARACTERISTIC DFES_EnvRef.DFC_DSTOFmax_C "used environment signals / Reference to used environment condition set for check DFC_DSTOFmax" VALUE 0x805045D9 Val_Wu8 1.00000000000 DFES_EnvTabVerb 0.00 1.00000000000 FORMAT "%13.11" /end CHARACTERISTIC
/begin CHARACTERISTIC DFES_EnvRef.DFC_DSTRmax_C "used environment signals / Reference to used environment condition set for check DFC_DSTRmax" VALUE 0x805045DA Val_Wu8 1.00000000000 DFES_EnvTabVerb 0.00 1.00000000000 FORMAT "%13.11" /end CHARACTERISTIC
/begin CHARACTERISTIC DFES_EnvRef.DFC_DSTRmin_C "used environment signals / Reference to used environment condition set for check DFC_DSTRmin" VALUE 0x805045DB Val_Wu8 1.00000000000 DFES_EnvTabVerb 0.00 1.00000000000 FORMAT "%13.11" /end CHARACTERISTIC
/begin CHARACTERISTIC DFES_EnvRef.DFC_DSTRnpl_C "used environment signals / Reference to used environment condition set for check DFC_DSTRnpl" VALUE 0x805045DC Val_Wu8 1.00000000000 DFES_EnvTabVerb 0.00 1.00000000000 FORMAT "%13.11" /end CHARACTERISTIC
/begin CHARACTERISTIC DFES_EnvRef.DFC_DSTRsig_C "used environment signals / Reference to used environment condition set for check DFC_DSTRsig" VALUE 0x805045DD Val_Wu8 1.00000000000 DFES_EnvTabVerb 0.00 1.00000000000 FORMAT "%13.11" /end CHARACTERISTIC
/begin CHARACTERISTIC DFES_EnvRef.DFC_DSTTI_C "used environment signals / Reference to used environment condition set for check DFC_DSTTI" VALUE 0x805045DE Val_Wu8 1.00000000000 DFES_EnvTabVerb 0.00 1.00000000000 FORMAT "%13.11" /end CHARACTERISTIC
/begin CHARACTERISTIC DFES_EnvRef.DFC_DSUmax_C "used environment signals / Reference to used environment condition set for check DFC_DSUmax" VALUE 0x805045DF Val_Wu8 1.00000000000 DFES_EnvTabVerb 0.00 1.00000000000 FORMAT "%13.11" /end CHARACTERISTIC
/begin CHARACTERISTIC DFES_EnvRef.DFC_DiagCpv1DteskLoLoadStuckClsd_C "used environment signals / Reference to used environment condition set for check DFC_DiagCpv1DteskLoLoadStuckClsd" VALUE 0x805045E0 Val_Wu8 1.00000000000 DFES_EnvTabVerb 0.00 1.00000000000 FORMAT "%13.11" /end CHARACTERISTIC
/begin CHARACTERISTIC DFES_EnvRef.DFC_DiagCpv1DteskLoLoadStuckOpen_C "used environment signals / Reference to used environment condition set for check DFC_DiagCpv1DteskLoLoadStuckOpen" VALUE 0x805045E1 Val_Wu8 1.00000000000 DFES_EnvTabVerb 0.00 1.00000000000 FORMAT "%13.11" /end CHARACTERISTIC
/begin CHARACTERISTIC DFES_EnvRef.DFC_EGRVlvDrftClsd_C "used environment signals / Reference to used environment condition set for check DFC_EGRVlvDrftClsd" VALUE 0x805045E2 Val_Wu8 1.00000000000 DFES_EnvTabVerb 0.00 1.00000000000 FORMAT "%13.11" /end CHARACTERISTIC
/begin CHARACTERISTIC DFES_EnvRef.DFC_EGRVlvDrftOpn_C "used environment signals / Reference to used environment condition set for check DFC_EGRVlvDrftOpn" VALUE 0x805045E3 Val_Wu8 1.00000000000 DFES_EnvTabVerb 0.00 1.00000000000 FORMAT "%13.11" /end CHARACTERISTIC
/begin CHARACTERISTIC DFES_EnvRef.DFC_EGRVlvJamVlvClsd_C "used environment signals / Reference to used environment condition set for check DFC_EGRVlvJamVlvClsd" VALUE 0x805045E4 Val_Wu8 1.00000000000 DFES_EnvTabVerb 0.00 1.00000000000 FORMAT "%13.11" /end CHARACTERISTIC
/begin CHARACTERISTIC DFES_EnvRef.DFC_EGRVlvJamVlvOpn_C "used environment signals / Reference to used environment condition set for check DFC_EGRVlvJamVlvOpn" VALUE 0x805045E5 Val_Wu8 1.00000000000 DFES_EnvTabVerb 0.00 1.00000000000 FORMAT "%13.11" /end CHARACTERISTIC
/begin CHARACTERISTIC DFES_EnvRef.DFC_EGRVlvSprgBrk_C "used environment signals / Reference to used environment condition set for check DFC_EGRVlvSprgBrk" VALUE 0x805045E6 Val_Wu8 1.00000000000 DFES_EnvTabVerb 0.00 1.00000000000 FORMAT "%13.11" /end CHARACTERISTIC
/begin CHARACTERISTIC DFES_EnvRef.DFC_EGRVlvTempMdlEEPErr_C "used environment signals / Reference to used environment condition set for check DFC_EGRVlvTempMdlEEPErr" VALUE 0x805045E7 Val_Wu8 1.00000000000 DFES_EnvTabVerb 0.00 1.00000000000 FORMAT "%13.11" /end CHARACTERISTIC
/begin CHARACTERISTIC DFES_EnvRef.DFC_EGRVlvTmpErr_C "used environment signals / Reference to used environment condition set for check DFC_EGRVlvTmpErr" VALUE 0x805045E8 Val_Wu8 1.00000000000 DFES_EnvTabVerb 0.00 1.00000000000 FORMAT "%13.11" /end CHARACTERISTIC
/begin CHARACTERISTIC DFES_EnvRef.DFC_EGSDUS2B1LtrDly_C "used environment signals / Reference to used environment condition set for check DFC_EGSDUS2B1LtrDly" VALUE 0x805045E9 Val_Wu8 1.00000000000 DFES_EnvTabVerb 0.00 1.00000000000 FORMAT "%13.11" /end CHARACTERISTIC
/begin CHARACTERISTIC DFES_EnvRef.DFC_EGSDUS2B1LtrPT1_C "used environment signals / Reference to used environment condition set for check DFC_EGSDUS2B1LtrPT1" VALUE 0x805045EA Val_Wu8 1.00000000000 DFES_EnvTabVerb 0.00 1.00000000000 FORMAT "%13.11" /end CHARACTERISTIC
/begin CHARACTERISTIC DFES_EnvRef.DFC_EGSDUS2B1RtlDly_C "used environment signals / Reference to used environment condition set for check DFC_EGSDUS2B1RtlDly" VALUE 0x805045EB Val_Wu8 1.00000000000 DFES_EnvTabVerb 0.00 1.00000000000 FORMAT "%13.11" /end CHARACTERISTIC
/begin CHARACTERISTIC DFES_EnvRef.DFC_EGSDUS2B1RtlPT1_C "used environment signals / Reference to used environment condition set for check DFC_EGSDUS2B1RtlPT1" VALUE 0x805045EC Val_Wu8 1.00000000000 DFES_EnvTabVerb 0.00 1.00000000000 FORMAT "%13.11" /end CHARACTERISTIC
/begin CHARACTERISTIC DFES_EnvRef.DFC_EGSDUS2B1TarLean_C "used environment signals / Reference to used environment condition set for check DFC_EGSDUS2B1TarLean" VALUE 0x805045ED Val_Wu8 1.00000000000 DFES_EnvTabVerb 0.00 1.00000000000 FORMAT "%13.11" /end CHARACTERISTIC
/begin CHARACTERISTIC DFES_EnvRef.DFC_EGSDUS2B1TarRich_C "used environment signals / Reference to used environment condition set for check DFC_EGSDUS2B1TarRich" VALUE 0x805045EE Val_Wu8 1.00000000000 DFES_EnvTabVerb 0.00 1.00000000000 FORMAT "%13.11" /end CHARACTERISTIC
/begin CHARACTERISTIC DFES_EnvRef.DFC_EONVmax_C "used environment signals / Reference to used environment condition set for check DFC_EONVmax" VALUE 0x805045EF Val_Wu8 1.00000000000 DFES_EnvTabVerb 0.00 1.00000000000 FORMAT "%13.11" /end CHARACTERISTIC
/begin CHARACTERISTIC DFES_EnvRef.DFC_ETAKHLmax_C "used environment signals / Reference to used environment condition set for check DFC_ETAKHLmax" VALUE 0x805045F0 Val_Wu8 1.00000000000 DFES_EnvTabVerb 0.00 1.00000000000 FORMAT "%13.11" /end CHARACTERISTIC
/begin CHARACTERISTIC DFES_EnvRef.DFC_ETAKHTmax_C "used environment signals / Reference to used environment condition set for check DFC_ETAKHTmax" VALUE 0x805045F1 Val_Wu8 1.00000000000 DFES_EnvTabVerb 0.00 1.00000000000 FORMAT "%13.11" /end CHARACTERISTIC
/begin CHARACTERISTIC DFES_EnvRef.DFC_ETHSEmax_C "used environment signals / Reference to used environment condition set for check DFC_ETHSEmax" VALUE 0x805045F2 Val_Wu8 1.00000000000 DFES_EnvTabVerb 0.00 1.00000000000 FORMAT "%13.11" /end CHARACTERISTIC
/begin CHARACTERISTIC DFES_EnvRef.DFC_ETHSEmin_C "used environment signals / Reference to used environment condition set for check DFC_ETHSEmin" VALUE 0x805045F3 Val_Wu8 1.00000000000 DFES_EnvTabVerb 0.00 1.00000000000 FORMAT "%13.11" /end CHARACTERISTIC
/begin CHARACTERISTIC DFES_EnvRef.DFC_ETHSFmax_C "used environment signals / Reference to used environment condition set for check DFC_ETHSFmax" VALUE 0x805045F4 Val_Wu8 1.00000000000 DFES_EnvTabVerb 0.00 1.00000000000 FORMAT "%13.11" /end CHARACTERISTIC
/begin CHARACTERISTIC DFES_EnvRef.DFC_ETHSFmin_C "used environment signals / Reference to used environment condition set for check DFC_ETHSFmin" VALUE 0x805045F5 Val_Wu8 1.00000000000 DFES_EnvTabVerb 0.00 1.00000000000 FORMAT "%13.11" /end CHARACTERISTIC
/begin CHARACTERISTIC DFES_EnvRef.DFC_ETHSFsig_C "used environment signals / Reference to used environment condition set for check DFC_ETHSFsig" VALUE 0x805045F6 Val_Wu8 1.00000000000 DFES_EnvTabVerb 0.00 1.00000000000 FORMAT "%13.11" /end CHARACTERISTIC
/begin CHARACTERISTIC DFES_EnvRef.DFC_ETHSNPWmax_C "used environment signals / Reference to used environment condition set for check DFC_ETHSNPWmax" VALUE 0x805045F7 Val_Wu8 1.00000000000 DFES_EnvTabVerb 0.00 1.00000000000 FORMAT "%13.11" /end CHARACTERISTIC
/begin CHARACTERISTIC DFES_EnvRef.DFC_ETHSNPWmin_C "used environment signals / Reference to used environment condition set for check DFC_ETHSNPWmin" VALUE 0x805045F8 Val_Wu8 1.00000000000 DFES_EnvTabVerb 0.00 1.00000000000 FORMAT "%13.11" /end CHARACTERISTIC
/begin CHARACTERISTIC DFES_EnvRef.DFC_ETHSNPWsig_C "used environment signals / Reference to used environment condition set for check DFC_ETHSNPWsig" VALUE 0x805045F9 Val_Wu8 1.00000000000 DFES_EnvTabVerb 0.00 1.00000000000 FORMAT "%13.11" /end CHARACTERISTIC
/begin CHARACTERISTIC DFES_EnvRef.DFC_ETHSPLnpl_C "used environment signals / Reference to used environment condition set for check DFC_ETHSPLnpl" VALUE 0x805045FA Val_Wu8 1.00000000000 DFES_EnvTabVerb 0.00 1.00000000000 FORMAT "%13.11" /end CHARACTERISTIC
/begin CHARACTERISTIC DFES_EnvRef.DFC_ETHSTPLnpl_C "used environment signals / Reference to used environment condition set for check DFC_ETHSTPLnpl" VALUE 0x805045FB Val_Wu8 1.00000000000 DFES_EnvTabVerb 0.00 1.00000000000 FORMAT "%13.11" /end CHARACTERISTIC
/begin CHARACTERISTIC DFES_EnvRef.DFC_EngICO_C "used environment signals / Reference to used environment condition set for check DFC_EngICO" VALUE 0x805045FC Val_Wu8 1.00000000000 DFES_EnvTabVerb 0.00 1.00000000000 FORMAT "%13.11" /end CHARACTERISTIC
/begin CHARACTERISTIC DFES_EnvRef.DFC_EngPrtOvrSpdMon_C "used environment signals / Reference to used environment condition set for check DFC_EngPrtOvrSpdMon" VALUE 0x805045FD Val_Wu8 1.00000000000 DFES_EnvTabVerb 0.00 1.00000000000 FORMAT "%13.11" /end CHARACTERISTIC
/begin CHARACTERISTIC DFES_EnvRef.DFC_EpmCaSI1ErrSig_C "used environment signals / Reference to used environment condition set for check DFC_EpmCaSI1ErrSig" VALUE 0x805045FE Val_Wu8 1.00000000000 DFES_EnvTabVerb 0.00 1.00000000000 FORMAT "%13.11" /end CHARACTERISTIC
/begin CHARACTERISTIC DFES_EnvRef.DFC_EpmCaSI1MntErr_C "used environment signals / Reference to used environment condition set for check DFC_EpmCaSI1MntErr" VALUE 0x805045FF Val_Wu8 1.00000000000 DFES_EnvTabVerb 0.00 1.00000000000 FORMAT "%13.11" /end CHARACTERISTIC
/begin CHARACTERISTIC DFES_EnvRef.DFC_EpmCaSI1NoSigMax_C "used environment signals / Reference to used environment condition set for check DFC_EpmCaSI1NoSigMax" VALUE 0x80504600 Val_Wu8 1.00000000000 DFES_EnvTabVerb 0.00 1.00000000000 FORMAT "%13.11" /end CHARACTERISTIC
/begin CHARACTERISTIC DFES_EnvRef.DFC_EpmCaSI1NoSigMin_C "used environment signals / Reference to used environment condition set for check DFC_EpmCaSI1NoSigMin" VALUE 0x80504601 Val_Wu8 1.00000000000 DFES_EnvTabVerb 0.00 1.00000000000 FORMAT "%13.11" /end CHARACTERISTIC
/begin CHARACTERISTIC DFES_EnvRef.DFC_EpmCaSI1OfsErr_C "used environment signals / Reference to used environment condition set for check DFC_EpmCaSI1OfsErr" VALUE 0x80504602 Val_Wu8 1.00000000000 DFES_EnvTabVerb 0.00 1.00000000000 FORMAT "%13.11" /end CHARACTERISTIC
/begin CHARACTERISTIC DFES_EnvRef.DFC_EpmCrSDGI_C "used environment signals / Reference to used environment condition set for check DFC_EpmCrSDGI" VALUE 0x80504603 Val_Wu8 1.00000000000 DFES_EnvTabVerb 0.00 1.00000000000 FORMAT "%13.11" /end CHARACTERISTIC
/begin CHARACTERISTIC DFES_EnvRef.DFC_EpmCrSErrSig_C "used environment signals / Reference to used environment condition set for check DFC_EpmCrSErrSig" VALUE 0x80504604 Val_Wu8 1.00000000000 DFES_EnvTabVerb 0.00 1.00000000000 FORMAT "%13.11" /end CHARACTERISTIC
/begin CHARACTERISTIC DFES_EnvRef.DFC_EpmCrSNoSig_C "used environment signals / Reference to used environment condition set for check DFC_EpmCrSNoSig" VALUE 0x80504605 Val_Wu8 1.00000000000 DFES_EnvTabVerb 0.00 1.00000000000 FORMAT "%13.11" /end CHARACTERISTIC
/begin CHARACTERISTIC DFES_EnvRef.DFC_EtaEngIdleNonCsers_C "used environment signals / Reference to used environment condition set for check DFC_EtaEngIdleNonCsers" VALUE 0x80504606 Val_Wu8 1.00000000000 DFES_EnvTabVerb 0.00 1.00000000000 FORMAT "%13.11" /end CHARACTERISTIC
/begin CHARACTERISTIC DFES_EnvRef.DFC_EtaEngPtlNonCsers_C "used environment signals / Reference to used environment condition set for check DFC_EtaEngPtlNonCsers" VALUE 0x80504607 Val_Wu8 1.00000000000 DFES_EnvTabVerb 0.00 1.00000000000 FORMAT "%13.11" /end CHARACTERISTIC
/begin CHARACTERISTIC DFES_EnvRef.DFC_FRAmax_C "used environment signals / Reference to used environment condition set for check DFC_FRAmax" VALUE 0x80504608 Val_Wu8 1.00000000000 DFES_EnvTabVerb 0.00 1.00000000000 FORMAT "%13.11" /end CHARACTERISTIC
/begin CHARACTERISTIC DFES_EnvRef.DFC_FRAmin_C "used environment signals / Reference to used environment condition set for check DFC_FRAmin" VALUE 0x80504609 Val_Wu8 1.00000000000 DFES_EnvTabVerb 0.00 1.00000000000 FORMAT "%13.11" /end CHARACTERISTIC
/begin CHARACTERISTIC DFES_EnvRef.DFC_FSTEmax_C "used environment signals / Reference to used environment condition set for check DFC_FSTEmax" VALUE 0x8050460A Val_Wu8 1.00000000000 DFES_EnvTabVerb 0.00 1.00000000000 FORMAT "%13.11" /end CHARACTERISTIC
/begin CHARACTERISTIC DFES_EnvRef.DFC_FSTEmin_C "used environment signals / Reference to used environment condition set for check DFC_FSTEmin" VALUE 0x8050460B Val_Wu8 1.00000000000 DFES_EnvTabVerb 0.00 1.00000000000 FORMAT "%13.11" /end CHARACTERISTIC
/begin CHARACTERISTIC DFES_EnvRef.DFC_FSTRmax_C "used environment signals / Reference to used environment condition set for check DFC_FSTRmax" VALUE 0x8050460C Val_Wu8 1.00000000000 DFES_EnvTabVerb 0.00 1.00000000000 FORMAT "%13.11" /end CHARACTERISTIC
/begin CHARACTERISTIC DFES_EnvRef.DFC_FSTRmin_C "used environment signals / Reference to used environment condition set for check DFC_FSTRmin" VALUE 0x8050460D Val_Wu8 1.00000000000 DFES_EnvTabVerb 0.00 1.00000000000 FORMAT "%13.11" /end CHARACTERISTIC
/begin CHARACTERISTIC DFES_EnvRef.DFC_FSTRnpl_C "used environment signals / Reference to used environment condition set for check DFC_FSTRnpl" VALUE 0x8050460E Val_Wu8 1.00000000000 DFES_EnvTabVerb 0.00 1.00000000000 FORMAT "%13.11" /end CHARACTERISTIC
/begin CHARACTERISTIC DFES_EnvRef.DFC_FSTmax_C "used environment signals / Reference to used environment condition set for check DFC_FSTmax" VALUE 0x8050460F Val_Wu8 1.00000000000 DFES_EnvTabVerb 0.00 1.00000000000 FORMAT "%13.11" /end CHARACTERISTIC
/begin CHARACTERISTIC DFES_EnvRef.DFC_FTDLAmax_C "used environment signals / Reference to used environment condition set for check DFC_FTDLAmax" VALUE 0x80504610 Val_Wu8 1.00000000000 DFES_EnvTabVerb 0.00 1.00000000000 FORMAT "%13.11" /end CHARACTERISTIC
/begin CHARACTERISTIC DFES_EnvRef.DFC_FTDLAmin_C "used environment signals / Reference to used environment condition set for check DFC_FTDLAmin" VALUE 0x80504611 Val_Wu8 1.00000000000 DFES_EnvTabVerb 0.00 1.00000000000 FORMAT "%13.11" /end CHARACTERISTIC
/begin CHARACTERISTIC DFES_EnvRef.DFC_FuPHiSnsrEleclmax_C "used environment signals / Reference to used environment condition set for check DFC_FuPHiSnsrEleclmax" VALUE 0x80504612 Val_Wu8 1.00000000000 DFES_EnvTabVerb 0.00 1.00000000000 FORMAT "%13.11" /end CHARACTERISTIC
/begin CHARACTERISTIC DFES_EnvRef.DFC_FuPHiSnsrEleclmin_C "used environment signals / Reference to used environment condition set for check DFC_FuPHiSnsrEleclmin" VALUE 0x80504613 Val_Wu8 1.00000000000 DFES_EnvTabVerb 0.00 1.00000000000 FORMAT "%13.11" /end CHARACTERISTIC
/begin CHARACTERISTIC DFES_EnvRef.DFC_FuPHiSnsrEleclnpl_C "used environment signals / Reference to used environment condition set for check DFC_FuPHiSnsrEleclnpl" VALUE 0x80504614 Val_Wu8 1.00000000000 DFES_EnvTabVerb 0.00 1.00000000000 FORMAT "%13.11" /end CHARACTERISTIC
/begin CHARACTERISTIC DFES_EnvRef.DFC_FuPHiSnsrURngMax_C "used environment signals / Reference to used environment condition set for check DFC_FuPHiSnsrURngMax" VALUE 0x80504615 Val_Wu8 1.00000000000 DFES_EnvTabVerb 0.00 1.00000000000 FORMAT "%13.11" /end CHARACTERISTIC
/begin CHARACTERISTIC DFES_EnvRef.DFC_FuPHiSnsrURngMin_C "used environment signals / Reference to used environment condition set for check DFC_FuPHiSnsrURngMin" VALUE 0x80504616 Val_Wu8 1.00000000000 DFES_EnvTabVerb 0.00 1.00000000000 FORMAT "%13.11" /end CHARACTERISTIC
/begin CHARACTERISTIC DFES_EnvRef.DFC_FuSnsrPhyRngMaxErr_C "used environment signals / Reference to used environment condition set for check DFC_FuSnsrPhyRngMaxErr" VALUE 0x80504617 Val_Wu8 1.00000000000 DFES_EnvTabVerb 0.00 1.00000000000 FORMAT "%13.11" /end CHARACTERISTIC
/begin CHARACTERISTIC DFES_EnvRef.DFC_FuSnsrPhyRngMinErr_C "used environment signals / Reference to used environment condition set for check DFC_FuSnsrPhyRngMinErr" VALUE 0x80504618 Val_Wu8 1.00000000000 DFES_EnvTabVerb 0.00 1.00000000000 FORMAT "%13.11" /end CHARACTERISTIC
/begin CHARACTERISTIC DFES_EnvRef.DFC_GEVlvLockPinDiagIntkB1_C "used environment signals / Reference to used environment condition set for check DFC_GEVlvLockPinDiagIntkB1" VALUE 0x80504619 Val_Wu8 1.00000000000 DFES_EnvTabVerb 0.00 1.00000000000 FORMAT "%13.11" /end CHARACTERISTIC
/begin CHARACTERISTIC DFES_EnvRef.DFC_GEVlvPhaSlowIntkB1_C "used environment signals / Reference to used environment condition set for check DFC_GEVlvPhaSlowIntkB1" VALUE 0x8050461A Val_Wu8 1.00000000000 DFES_EnvTabVerb 0.00 1.00000000000 FORMAT "%13.11" /end CHARACTERISTIC
/begin CHARACTERISTIC DFES_EnvRef.DFC_GEVlvPhaTargIntkB1_C "used environment signals / Reference to used environment condition set for check DFC_GEVlvPhaTargIntkB1" VALUE 0x8050461B Val_Wu8 1.00000000000 DFES_EnvTabVerb 0.00 1.00000000000 FORMAT "%13.11" /end CHARACTERISTIC
/begin CHARACTERISTIC DFES_EnvRef.DFC_GbxRvsSwtStk_C "used environment signals / Reference to used environment condition set for check DFC_GbxRvsSwtStk" VALUE 0x8050461C Val_Wu8 1.00000000000 DFES_EnvTabVerb 0.00 1.00000000000 FORMAT "%13.11" /end CHARACTERISTIC
/begin CHARACTERISTIC DFES_EnvRef.DFC_HDRKHmax_C "used environment signals / Reference to used environment condition set for check DFC_HDRKHmax" VALUE 0x8050461D Val_Wu8 1.00000000000 DFES_EnvTabVerb 0.00 1.00000000000 FORMAT "%13.11" /end CHARACTERISTIC
/begin CHARACTERISTIC DFES_EnvRef.DFC_HDRKHmin_C "used environment signals / Reference to used environment condition set for check DFC_HDRKHmin" VALUE 0x8050461E Val_Wu8 1.00000000000 DFES_EnvTabVerb 0.00 1.00000000000 FORMAT "%13.11" /end CHARACTERISTIC
/begin CHARACTERISTIC DFES_EnvRef.DFC_HDRPLmax_C "used environment signals / Reference to used environment condition set for check DFC_HDRPLmax" VALUE 0x8050461F Val_Wu8 1.00000000000 DFES_EnvTabVerb 0.00 1.00000000000 FORMAT "%13.11" /end CHARACTERISTIC
/begin CHARACTERISTIC DFES_EnvRef.DFC_HDRPLmin_C "used environment signals / Reference to used environment condition set for check DFC_HDRPLmin" VALUE 0x80504620 Val_Wu8 1.00000000000 DFES_EnvTabVerb 0.00 1.00000000000 FORMAT "%13.11" /end CHARACTERISTIC
/begin CHARACTERISTIC DFES_EnvRef.DFC_HDRmax_C "used environment signals / Reference to used environment condition set for check DFC_HDRmax" VALUE 0x80504621 Val_Wu8 1.00000000000 DFES_EnvTabVerb 0.00 1.00000000000 FORMAT "%13.11" /end CHARACTERISTIC
/begin CHARACTERISTIC DFES_EnvRef.DFC_HDRmin_C "used environment signals / Reference to used environment condition set for check DFC_HDRmin" VALUE 0x80504622 Val_Wu8 1.00000000000 DFES_EnvTabVerb 0.00 1.00000000000 FORMAT "%13.11" /end CHARACTERISTIC
/begin CHARACTERISTIC DFES_EnvRef.DFC_HEGOS2B1ElecMax_C "used environment signals / Reference to used environment condition set for check DFC_HEGOS2B1ElecMax" VALUE 0x80504623 Val_Wu8 1.00000000000 DFES_EnvTabVerb 0.00 1.00000000000 FORMAT "%13.11" /end CHARACTERISTIC
/begin CHARACTERISTIC DFES_EnvRef.DFC_HEGOS2B1ElecMin_C "used environment signals / Reference to used environment condition set for check DFC_HEGOS2B1ElecMin" VALUE 0x80504624 Val_Wu8 1.00000000000 DFES_EnvTabVerb 0.00 1.00000000000 FORMAT "%13.11" /end CHARACTERISTIC
/begin CHARACTERISTIC DFES_EnvRef.DFC_HEGOS2B1ElecSig_C "used environment signals / Reference to used environment condition set for check DFC_HEGOS2B1ElecSig" VALUE 0x80504625 Val_Wu8 1.00000000000 DFES_EnvTabVerb 0.00 1.00000000000 FORMAT "%13.11" /end CHARACTERISTIC
/begin CHARACTERISTIC DFES_EnvRef.DFC_HEGOS2B1HtgNpl_C "used environment signals / Reference to used environment condition set for check DFC_HEGOS2B1HtgNpl" VALUE 0x80504626 Val_Wu8 1.00000000000 DFES_EnvTabVerb 0.00 1.00000000000 FORMAT "%13.11" /end CHARACTERISTIC
/begin CHARACTERISTIC DFES_EnvRef.DFC_HEV00max_C "used environment signals / Reference to used environment condition set for check DFC_HEV00max" VALUE 0x80504627 Val_Wu8 1.00000000000 DFES_EnvTabVerb 0.00 1.00000000000 FORMAT "%13.11" /end CHARACTERISTIC
/begin CHARACTERISTIC DFES_EnvRef.DFC_HEV01max_C "used environment signals / Reference to used environment condition set for check DFC_HEV01max" VALUE 0x80504628 Val_Wu8 1.00000000000 DFES_EnvTabVerb 0.00 1.00000000000 FORMAT "%13.11" /end CHARACTERISTIC
/begin CHARACTERISTIC DFES_EnvRef.DFC_HEV02max_C "used environment signals / Reference to used environment condition set for check DFC_HEV02max" VALUE 0x80504629 Val_Wu8 1.00000000000 DFES_EnvTabVerb 0.00 1.00000000000 FORMAT "%13.11" /end CHARACTERISTIC
/begin CHARACTERISTIC DFES_EnvRef.DFC_HEV03max_C "used environment signals / Reference to used environment condition set for check DFC_HEV03max" VALUE 0x8050462A Val_Wu8 1.00000000000 DFES_EnvTabVerb 0.00 1.00000000000 FORMAT "%13.11" /end CHARACTERISTIC
/begin CHARACTERISTIC DFES_EnvRef.DFC_HEVE0max_C "used environment signals / Reference to used environment condition set for check DFC_HEVE0max" VALUE 0x8050462B Val_Wu8 1.00000000000 DFES_EnvTabVerb 0.00 1.00000000000 FORMAT "%13.11" /end CHARACTERISTIC
/begin CHARACTERISTIC DFES_EnvRef.DFC_HEVE1max_C "used environment signals / Reference to used environment condition set for check DFC_HEVE1max" VALUE 0x8050462C Val_Wu8 1.00000000000 DFES_EnvTabVerb 0.00 1.00000000000 FORMAT "%13.11" /end CHARACTERISTIC
/begin CHARACTERISTIC DFES_EnvRef.DFC_HFMmax_C "used environment signals / Reference to used environment condition set for check DFC_HFMmax" VALUE 0x8050462D Val_Wu8 1.00000000000 DFES_EnvTabVerb 0.00 1.00000000000 FORMAT "%13.11" /end CHARACTERISTIC
/begin CHARACTERISTIC DFES_EnvRef.DFC_HiPSysHiPMaxLimExcdd_C "used environment signals / Reference to used environment condition set for check DFC_HiPSysHiPMaxLimExcdd" VALUE 0x8050462E Val_Wu8 1.00000000000 DFES_EnvTabVerb 0.00 1.00000000000 FORMAT "%13.11" /end CHARACTERISTIC
/begin CHARACTERISTIC DFES_EnvRef.DFC_IVGdiCtlCvoErrMax_0_C "used environment signals / Reference to used environment condition set for check DFC_IVGdiCtlCvoErrMax_0" VALUE 0x8050462F Val_Wu8 1.00000000000 DFES_EnvTabVerb 0.00 1.00000000000 FORMAT "%13.11" /end CHARACTERISTIC
/begin CHARACTERISTIC DFES_EnvRef.DFC_IVGdiCtlCvoErrMax_1_C "used environment signals / Reference to used environment condition set for check DFC_IVGdiCtlCvoErrMax_1" VALUE 0x80504630 Val_Wu8 1.00000000000 DFES_EnvTabVerb 0.00 1.00000000000 FORMAT "%13.11" /end CHARACTERISTIC
/begin CHARACTERISTIC DFES_EnvRef.DFC_IVGdiCtlCvoErrMax_2_C "used environment signals / Reference to used environment condition set for check DFC_IVGdiCtlCvoErrMax_2" VALUE 0x80504631 Val_Wu8 1.00000000000 DFES_EnvTabVerb 0.00 1.00000000000 FORMAT "%13.11" /end CHARACTERISTIC
/begin CHARACTERISTIC DFES_EnvRef.DFC_IVGdiCtlCvoErrMax_3_C "used environment signals / Reference to used environment condition set for check DFC_IVGdiCtlCvoErrMax_3" VALUE 0x80504632 Val_Wu8 1.00000000000 DFES_EnvTabVerb 0.00 1.00000000000 FORMAT "%13.11" /end CHARACTERISTIC
/begin CHARACTERISTIC DFES_EnvRef.DFC_IVGdiCtlCvoErrMin_0_C "used environment signals / Reference to used environment condition set for check DFC_IVGdiCtlCvoErrMin_0" VALUE 0x80504633 Val_Wu8 1.00000000000 DFES_EnvTabVerb 0.00 1.00000000000 FORMAT "%13.11" /end CHARACTERISTIC
/begin CHARACTERISTIC DFES_EnvRef.DFC_IVGdiCtlCvoErrMin_1_C "used environment signals / Reference to used environment condition set for check DFC_IVGdiCtlCvoErrMin_1" VALUE 0x80504634 Val_Wu8 1.00000000000 DFES_EnvTabVerb 0.00 1.00000000000 FORMAT "%13.11" /end CHARACTERISTIC
/begin CHARACTERISTIC DFES_EnvRef.DFC_IVGdiCtlCvoErrMin_2_C "used environment signals / Reference to used environment condition set for check DFC_IVGdiCtlCvoErrMin_2" VALUE 0x80504635 Val_Wu8 1.00000000000 DFES_EnvTabVerb 0.00 1.00000000000 FORMAT "%13.11" /end CHARACTERISTIC
/begin CHARACTERISTIC DFES_EnvRef.DFC_IVGdiCtlCvoErrMin_3_C "used environment signals / Reference to used environment condition set for check DFC_IVGdiCtlCvoErrMin_3" VALUE 0x80504636 Val_Wu8 1.00000000000 DFES_EnvTabVerb 0.00 1.00000000000 FORMAT "%13.11" /end CHARACTERISTIC
/begin CHARACTERISTIC DFES_EnvRef.DFC_IVGdiCtlCvoErrMinMax_C "used environment signals / Reference to used environment condition set for check DFC_IVGdiCtlCvoErrMinMax" VALUE 0x80504637 Val_Wu8 1.00000000000 DFES_EnvTabVerb 0.00 1.00000000000 FORMAT "%13.11" /end CHARACTERISTIC
/begin CHARACTERISTIC DFES_EnvRef.DFC_IVGdiCtlCvoSigPlausErrSmrCdn_C "used environment signals / Reference to used environment condition set for check DFC_IVGdiCtlCvoSigPlausErrSmrCdn" VALUE 0x80504638 Val_Wu8 1.00000000000 DFES_EnvTabVerb 0.00 1.00000000000 FORMAT "%13.11" /end CHARACTERISTIC
/begin CHARACTERISTIC DFES_EnvRef.DFC_IVGdiCtl_CvoErr_C "used environment signals / Reference to used environment condition set for check DFC_IVGdiCtl_CvoErr" VALUE 0x80504639 Val_Wu8 1.00000000000 DFES_EnvTabVerb 0.00 1.00000000000 FORMAT "%13.11" /end CHARACTERISTIC
/begin CHARACTERISTIC DFES_EnvRef.DFC_IVGdiCtl_CvoSigPlaus_0_C "used environment signals / Reference to used environment condition set for check DFC_IVGdiCtl_CvoSigPlaus_0" VALUE 0x8050463A Val_Wu8 1.00000000000 DFES_EnvTabVerb 0.00 1.00000000000 FORMAT "%13.11" /end CHARACTERISTIC
/begin CHARACTERISTIC DFES_EnvRef.DFC_IVGdiCtl_CvoSigPlaus_1_C "used environment signals / Reference to used environment condition set for check DFC_IVGdiCtl_CvoSigPlaus_1" VALUE 0x8050463B Val_Wu8 1.00000000000 DFES_EnvTabVerb 0.00 1.00000000000 FORMAT "%13.11" /end CHARACTERISTIC
/begin CHARACTERISTIC DFES_EnvRef.DFC_IVGdiCtl_CvoSigPlaus_2_C "used environment signals / Reference to used environment condition set for check DFC_IVGdiCtl_CvoSigPlaus_2" VALUE 0x8050463C Val_Wu8 1.00000000000 DFES_EnvTabVerb 0.00 1.00000000000 FORMAT "%13.11" /end CHARACTERISTIC
/begin CHARACTERISTIC DFES_EnvRef.DFC_IVGdiCtl_CvoSigPlaus_3_C "used environment signals / Reference to used environment condition set for check DFC_IVGdiCtl_CvoSigPlaus_3" VALUE 0x8050463D Val_Wu8 1.00000000000 DFES_EnvTabVerb 0.00 1.00000000000 FORMAT "%13.11" /end CHARACTERISTIC
/begin CHARACTERISTIC DFES_EnvRef.DFC_IntkAirTAirFltDsCrssMax_C "used environment signals / Reference to used environment condition set for check DFC_IntkAirTAirFltDsCrssMax" VALUE 0x8050463E Val_Wu8 1.00000000000 DFES_EnvTabVerb 0.00 1.00000000000 FORMAT "%13.11" /end CHARACTERISTIC
/begin CHARACTERISTIC DFES_EnvRef.DFC_IntkAirTAirFltDsCrssMin_C "used environment signals / Reference to used environment condition set for check DFC_IntkAirTAirFltDsCrssMin" VALUE 0x8050463F Val_Wu8 1.00000000000 DFES_EnvTabVerb 0.00 1.00000000000 FORMAT "%13.11" /end CHARACTERISTIC
/begin CHARACTERISTIC DFES_EnvRef.DFC_IntkAirTAirFltDsHSCMax_C "used environment signals / Reference to used environment condition set for check DFC_IntkAirTAirFltDsHSCMax" VALUE 0x80504640 Val_Wu8 1.00000000000 DFES_EnvTabVerb 0.00 1.00000000000 FORMAT "%13.11" /end CHARACTERISTIC
/begin CHARACTERISTIC DFES_EnvRef.DFC_IntkAirTAirFltDsImps_C "used environment signals / Reference to used environment condition set for check DFC_IntkAirTAirFltDsImps" VALUE 0x80504641 Val_Wu8 1.00000000000 DFES_EnvTabVerb 0.00 1.00000000000 FORMAT "%13.11" /end CHARACTERISTIC
/begin CHARACTERISTIC DFES_EnvRef.DFC_IntkAirTAirFltDsPRCMax_C "used environment signals / Reference to used environment condition set for check DFC_IntkAirTAirFltDsPRCMax" VALUE 0x80504642 Val_Wu8 1.00000000000 DFES_EnvTabVerb 0.00 1.00000000000 FORMAT "%13.11" /end CHARACTERISTIC
/begin CHARACTERISTIC DFES_EnvRef.DFC_IntkAirTAirFltDsPRCMin_C "used environment signals / Reference to used environment condition set for check DFC_IntkAirTAirFltDsPRCMin" VALUE 0x80504643 Val_Wu8 1.00000000000 DFES_EnvTabVerb 0.00 1.00000000000 FORMAT "%13.11" /end CHARACTERISTIC
/begin CHARACTERISTIC DFES_EnvRef.DFC_IntkAirTAirFltDsSRCMax_C "used environment signals / Reference to used environment condition set for check DFC_IntkAirTAirFltDsSRCMax" VALUE 0x80504644 Val_Wu8 1.00000000000 DFES_EnvTabVerb 0.00 1.00000000000 FORMAT "%13.11" /end CHARACTERISTIC
/begin CHARACTERISTIC DFES_EnvRef.DFC_IntkAirTAirFltDsSRCMin_C "used environment signals / Reference to used environment condition set for check DFC_IntkAirTAirFltDsSRCMin" VALUE 0x80504645 Val_Wu8 1.00000000000 DFES_EnvTabVerb 0.00 1.00000000000 FORMAT "%13.11" /end CHARACTERISTIC
/begin CHARACTERISTIC DFES_EnvRef.DFC_IntkAirTAirFltDsSTC_C "used environment signals / Reference to used environment condition set for check DFC_IntkAirTAirFltDsSTC" VALUE 0x80504646 Val_Wu8 1.00000000000 DFES_EnvTabVerb 0.00 1.00000000000 FORMAT "%13.11" /end CHARACTERISTIC
/begin CHARACTERISTIC DFES_EnvRef.DFC_IntkAirTIntkMnfldCrssMax_C "used environment signals / Reference to used environment condition set for check DFC_IntkAirTIntkMnfldCrssMax" VALUE 0x80504647 Val_Wu8 1.00000000000 DFES_EnvTabVerb 0.00 1.00000000000 FORMAT "%13.11" /end CHARACTERISTIC
/begin CHARACTERISTIC DFES_EnvRef.DFC_IntkAirTIntkMnfldCrssMin_C "used environment signals / Reference to used environment condition set for check DFC_IntkAirTIntkMnfldCrssMin" VALUE 0x80504648 Val_Wu8 1.00000000000 DFES_EnvTabVerb 0.00 1.00000000000 FORMAT "%13.11" /end CHARACTERISTIC
/begin CHARACTERISTIC DFES_EnvRef.DFC_IntkAirTIntkMnfldHSCMax_C "used environment signals / Reference to used environment condition set for check DFC_IntkAirTIntkMnfldHSCMax" VALUE 0x80504649 Val_Wu8 1.00000000000 DFES_EnvTabVerb 0.00 1.00000000000 FORMAT "%13.11" /end CHARACTERISTIC
/begin CHARACTERISTIC DFES_EnvRef.DFC_IntkAirTIntkMnfldImps_C "used environment signals / Reference to used environment condition set for check DFC_IntkAirTIntkMnfldImps" VALUE 0x8050464A Val_Wu8 1.00000000000 DFES_EnvTabVerb 0.00 1.00000000000 FORMAT "%13.11" /end CHARACTERISTIC
/begin CHARACTERISTIC DFES_EnvRef.DFC_IntkAirTIntkMnfldPRCMax_C "used environment signals / Reference to used environment condition set for check DFC_IntkAirTIntkMnfldPRCMax" VALUE 0x8050464B Val_Wu8 1.00000000000 DFES_EnvTabVerb 0.00 1.00000000000 FORMAT "%13.11" /end CHARACTERISTIC
/begin CHARACTERISTIC DFES_EnvRef.DFC_IntkAirTIntkMnfldPRCMin_C "used environment signals / Reference to used environment condition set for check DFC_IntkAirTIntkMnfldPRCMin" VALUE 0x8050464C Val_Wu8 1.00000000000 DFES_EnvTabVerb 0.00 1.00000000000 FORMAT "%13.11" /end CHARACTERISTIC
/begin CHARACTERISTIC DFES_EnvRef.DFC_IntkAirTIntkMnfldSRCMax_C "used environment signals / Reference to used environment condition set for check DFC_IntkAirTIntkMnfldSRCMax" VALUE 0x8050464D Val_Wu8 1.00000000000 DFES_EnvTabVerb 0.00 1.00000000000 FORMAT "%13.11" /end CHARACTERISTIC
/begin CHARACTERISTIC DFES_EnvRef.DFC_IntkAirTIntkMnfldSRCMin_C "used environment signals / Reference to used environment condition set for check DFC_IntkAirTIntkMnfldSRCMin" VALUE 0x8050464E Val_Wu8 1.00000000000 DFES_EnvTabVerb 0.00 1.00000000000 FORMAT "%13.11" /end CHARACTERISTIC
/begin CHARACTERISTIC DFES_EnvRef.DFC_IntkAirTIntkMnfldSTC_C "used environment signals / Reference to used environment condition set for check DFC_IntkAirTIntkMnfldSTC" VALUE 0x8050464F Val_Wu8 1.00000000000 DFES_EnvTabVerb 0.00 1.00000000000 FORMAT "%13.11" /end CHARACTERISTIC
/begin CHARACTERISTIC DFES_EnvRef.DFC_KRREGRLMX_C "used environment signals / Reference to used environment condition set for check DFC_KRREGRLMX" VALUE 0x80504650 Val_Wu8 1.00000000000 DFES_EnvTabVerb 0.00 1.00000000000 FORMAT "%13.11" /end CHARACTERISTIC
/begin CHARACTERISTIC DFES_EnvRef.DFC_KRVEKOCVLCI_C "used environment signals / Reference to used environment condition set for check DFC_KRVEKOCVLCI" VALUE 0x80504651 Val_Wu8 1.00000000000 DFES_EnvTabVerb 0.00 1.00000000000 FORMAT "%13.11" /end CHARACTERISTIC
/begin CHARACTERISTIC DFES_EnvRef.DFC_KRVEKOENCHMT_C "used environment signals / Reference to used environment condition set for check DFC_KRVEKOENCHMT" VALUE 0x80504652 Val_Wu8 1.00000000000 DFES_EnvTabVerb 0.00 1.00000000000 FORMAT "%13.11" /end CHARACTERISTIC
/begin CHARACTERISTIC DFES_EnvRef.DFC_KRVEKOENCHMT0_C "used environment signals / Reference to used environment condition set for check DFC_KRVEKOENCHMT0" VALUE 0x80504653 Val_Wu8 1.00000000000 DFES_EnvTabVerb 0.00 1.00000000000 FORMAT "%13.11" /end CHARACTERISTIC
/begin CHARACTERISTIC DFES_EnvRef.DFC_KRVEKOENCHMT1_C "used environment signals / Reference to used environment condition set for check DFC_KRVEKOENCHMT1" VALUE 0x80504654 Val_Wu8 1.00000000000 DFES_EnvTabVerb 0.00 1.00000000000 FORMAT "%13.11" /end CHARACTERISTIC
/begin CHARACTERISTIC DFES_EnvRef.DFC_KRVEKOENCHMT2_C "used environment signals / Reference to used environment condition set for check DFC_KRVEKOENCHMT2" VALUE 0x80504655 Val_Wu8 1.00000000000 DFES_EnvTabVerb 0.00 1.00000000000 FORMAT "%13.11" /end CHARACTERISTIC
/begin CHARACTERISTIC DFES_EnvRef.DFC_KRVEKOENCHMT3_C "used environment signals / Reference to used environment condition set for check DFC_KRVEKOENCHMT3" VALUE 0x80504656 Val_Wu8 1.00000000000 DFES_EnvTabVerb 0.00 1.00000000000 FORMAT "%13.11" /end CHARACTERISTIC
/begin CHARACTERISTIC DFES_EnvRef.DFC_KRVEKOENCHMT4_C "used environment signals / Reference to used environment condition set for check DFC_KRVEKOENCHMT4" VALUE 0x80504657 Val_Wu8 1.00000000000 DFES_EnvTabVerb 0.00 1.00000000000 FORMAT "%13.11" /end CHARACTERISTIC
/begin CHARACTERISTIC DFES_EnvRef.DFC_KRVEKOENCHMT5_C "used environment signals / Reference to used environment condition set for check DFC_KRVEKOENCHMT5" VALUE 0x80504658 Val_Wu8 1.00000000000 DFES_EnvTabVerb 0.00 1.00000000000 FORMAT "%13.11" /end CHARACTERISTIC
/begin CHARACTERISTIC DFES_EnvRef.DFC_KRVEKOENCHMT6_C "used environment signals / Reference to used environment condition set for check DFC_KRVEKOENCHMT6" VALUE 0x80504659 Val_Wu8 1.00000000000 DFES_EnvTabVerb 0.00 1.00000000000 FORMAT "%13.11" /end CHARACTERISTIC
/begin CHARACTERISTIC DFES_EnvRef.DFC_KRVEKOENCHMT7_C "used environment signals / Reference to used environment condition set for check DFC_KRVEKOENCHMT7" VALUE 0x8050465A Val_Wu8 1.00000000000 DFES_EnvTabVerb 0.00 1.00000000000 FORMAT "%13.11" /end CHARACTERISTIC
/begin CHARACTERISTIC DFES_EnvRef.DFC_KRVEKORLMX_C "used environment signals / Reference to used environment condition set for check DFC_KRVEKORLMX" VALUE 0x8050465B Val_Wu8 1.00000000000 DFES_EnvTabVerb 0.00 1.00000000000 FORMAT "%13.11" /end CHARACTERISTIC
/begin CHARACTERISTIC DFES_EnvRef.DFC_KRVEKORLMXL_C "used environment signals / Reference to used environment condition set for check DFC_KRVEKORLMXL" VALUE 0x8050465C Val_Wu8 1.00000000000 DFES_EnvTabVerb 0.00 1.00000000000 FORMAT "%13.11" /end CHARACTERISTIC
/begin CHARACTERISTIC DFES_EnvRef.DFC_KS1max_C "used environment signals / Reference to used environment condition set for check DFC_KS1max" VALUE 0x8050465D Val_Wu8 1.00000000000 DFES_EnvTabVerb 0.00 1.00000000000 FORMAT "%13.11" /end CHARACTERISTIC
/begin CHARACTERISTIC DFES_EnvRef.DFC_KS1min_C "used environment signals / Reference to used environment condition set for check DFC_KS1min" VALUE 0x8050465E Val_Wu8 1.00000000000 DFES_EnvTabVerb 0.00 1.00000000000 FORMAT "%13.11" /end CHARACTERISTIC
/begin CHARACTERISTIC DFES_EnvRef.DFC_LMmax_C "used environment signals / Reference to used environment condition set for check DFC_LMmax" VALUE 0x8050465F Val_Wu8 1.00000000000 DFES_EnvTabVerb 0.00 1.00000000000 FORMAT "%13.11" /end CHARACTERISTIC
/begin CHARACTERISTIC DFES_EnvRef.DFC_LZSRnpl_C "used environment signals / Reference to used environment condition set for check DFC_LZSRnpl" VALUE 0x80504660 Val_Wu8 1.00000000000 DFES_EnvTabVerb 0.00 1.00000000000 FORMAT "%13.11" /end CHARACTERISTIC
/begin CHARACTERISTIC DFES_EnvRef.DFC_LamDynDiagS1B1_C "used environment signals / Reference to used environment condition set for check DFC_LamDynDiagS1B1" VALUE 0x80504661 Val_Wu8 1.00000000000 DFES_EnvTabVerb 0.00 1.00000000000 FORMAT "%13.11" /end CHARACTERISTIC
/begin CHARACTERISTIC DFES_EnvRef.DFC_LeakIntkMnfldEmiInfl_C "used environment signals / Reference to used environment condition set for check DFC_LeakIntkMnfldEmiInfl" VALUE 0x80504662 Val_Wu8 1.00000000000 DFES_EnvTabVerb 0.00 1.00000000000 FORMAT "%13.11" /end CHARACTERISTIC
/begin CHARACTERISTIC DFES_EnvRef.DFC_LinFrameErrDCDC_C "used environment signals / Reference to used environment condition set for check DFC_LinFrameErrDCDC" VALUE 0x80504663 Val_Wu8 1.00000000000 DFES_EnvTabVerb 0.00 1.00000000000 FORMAT "%13.11" /end CHARACTERISTIC
/begin CHARACTERISTIC DFES_EnvRef.DFC_LinOverrunErrDCDC_C "used environment signals / Reference to used environment condition set for check DFC_LinOverrunErrDCDC" VALUE 0x80504664 Val_Wu8 1.00000000000 DFES_EnvTabVerb 0.00 1.00000000000 FORMAT "%13.11" /end CHARACTERISTIC
/begin CHARACTERISTIC DFES_EnvRef.DFC_MD00max_C "used environment signals / Reference to used environment condition set for check DFC_MD00max" VALUE 0x80504665 Val_Wu8 1.00000000000 DFES_EnvTabVerb 0.00 1.00000000000 FORMAT "%13.11" /end CHARACTERISTIC
/begin CHARACTERISTIC DFES_EnvRef.DFC_MDBmax_C "used environment signals / Reference to used environment condition set for check DFC_MDBmax" VALUE 0x80504666 Val_Wu8 1.00000000000 DFES_EnvTabVerb 0.00 1.00000000000 FORMAT "%13.11" /end CHARACTERISTIC
/begin CHARACTERISTIC DFES_EnvRef.DFC_MDCat_C "used environment signals / Reference to used environment condition set for check DFC_MDCat" VALUE 0x80504667 Val_Wu8 1.00000000000 DFES_EnvTabVerb 0.00 1.00000000000 FORMAT "%13.11" /end CHARACTERISTIC
/begin CHARACTERISTIC DFES_EnvRef.DFC_MDCatCrit_C "used environment signals / Reference to used environment condition set for check DFC_MDCatCrit" VALUE 0x80504668 Val_Wu8 1.00000000000 DFES_EnvTabVerb 0.00 1.00000000000 FORMAT "%13.11" /end CHARACTERISTIC
/begin CHARACTERISTIC DFES_EnvRef.DFC_MDCatCurr_C "used environment signals / Reference to used environment condition set for check DFC_MDCatCurr" VALUE 0x80504669 Val_Wu8 1.00000000000 DFES_EnvTabVerb 0.00 1.00000000000 FORMAT "%13.11" /end CHARACTERISTIC
/begin CHARACTERISTIC DFES_EnvRef.DFC_MDCyl_0_C "used environment signals / Reference to used environment condition set for check DFC_MDCyl_0" VALUE 0x8050466A Val_Wu8 1.00000000000 DFES_EnvTabVerb 0.00 1.00000000000 FORMAT "%13.11" /end CHARACTERISTIC
/begin CHARACTERISTIC DFES_EnvRef.DFC_MDCyl_1_C "used environment signals / Reference to used environment condition set for check DFC_MDCyl_1" VALUE 0x8050466B Val_Wu8 1.00000000000 DFES_EnvTabVerb 0.00 1.00000000000 FORMAT "%13.11" /end CHARACTERISTIC
/begin CHARACTERISTIC DFES_EnvRef.DFC_MDCyl_2_C "used environment signals / Reference to used environment condition set for check DFC_MDCyl_2" VALUE 0x8050466C Val_Wu8 1.00000000000 DFES_EnvTabVerb 0.00 1.00000000000 FORMAT "%13.11" /end CHARACTERISTIC
/begin CHARACTERISTIC DFES_EnvRef.DFC_MDCyl_3_C "used environment signals / Reference to used environment condition set for check DFC_MDCyl_3" VALUE 0x8050466D Val_Wu8 1.00000000000 DFES_EnvTabVerb 0.00 1.00000000000 FORMAT "%13.11" /end CHARACTERISTIC
/begin CHARACTERISTIC DFES_EnvRef.DFC_MDEmi_C "used environment signals / Reference to used environment condition set for check DFC_MDEmi" VALUE 0x8050466E Val_Wu8 1.00000000000 DFES_EnvTabVerb 0.00 1.00000000000 FORMAT "%13.11" /end CHARACTERISTIC
/begin CHARACTERISTIC DFES_EnvRef.DFC_MDEmiStrt_C "used environment signals / Reference to used environment condition set for check DFC_MDEmiStrt" VALUE 0x8050466F Val_Wu8 1.00000000000 DFES_EnvTabVerb 0.00 1.00000000000 FORMAT "%13.11" /end CHARACTERISTIC
/begin CHARACTERISTIC DFES_EnvRef.DFC_MDFco_C "used environment signals / Reference to used environment condition set for check DFC_MDFco" VALUE 0x80504670 Val_Wu8 1.00000000000 DFES_EnvTabVerb 0.00 1.00000000000 FORMAT "%13.11" /end CHARACTERISTIC
/begin CHARACTERISTIC DFES_EnvRef.DFC_MDMpl_C "used environment signals / Reference to used environment condition set for check DFC_MDMpl" VALUE 0x80504671 Val_Wu8 1.00000000000 DFES_EnvTabVerb 0.00 1.00000000000 FORMAT "%13.11" /end CHARACTERISTIC
/begin CHARACTERISTIC DFES_EnvRef.DFC_MDSegTiAdpn_C "used environment signals / Reference to used environment condition set for check DFC_MDSegTiAdpn" VALUE 0x80504672 Val_Wu8 1.00000000000 DFES_EnvTabVerb 0.00 1.00000000000 FORMAT "%13.11" /end CHARACTERISTIC
/begin CHARACTERISTIC DFES_EnvRef.DFC_MDmax_C "used environment signals / Reference to used environment condition set for check DFC_MDmax" VALUE 0x80504673 Val_Wu8 1.00000000000 DFES_EnvTabVerb 0.00 1.00000000000 FORMAT "%13.11" /end CHARACTERISTIC
/begin CHARACTERISTIC DFES_EnvRef.DFC_MFuOilMax_C "used environment signals / Reference to used environment condition set for check DFC_MFuOilMax" VALUE 0x80504674 Val_Wu8 1.00000000000 DFES_EnvTabVerb 0.00 1.00000000000 FORMAT "%13.11" /end CHARACTERISTIC
/begin CHARACTERISTIC DFES_EnvRef.DFC_MOXEMM_SMU_ALM0_0_C "used environment signals / Reference to used environment condition set for check DFC_MOXEMM_SMU_ALM0_0" VALUE 0x80504675 Val_Wu8 1.00000000000 DFES_EnvTabVerb 0.00 1.00000000000 FORMAT "%13.11" /end CHARACTERISTIC
/begin CHARACTERISTIC DFES_EnvRef.DFC_MOXEMM_SMU_ALM0_1_C "used environment signals / Reference to used environment condition set for check DFC_MOXEMM_SMU_ALM0_1" VALUE 0x80504676 Val_Wu8 1.00000000000 DFES_EnvTabVerb 0.00 1.00000000000 FORMAT "%13.11" /end CHARACTERISTIC
/begin CHARACTERISTIC DFES_EnvRef.DFC_MOXEMM_SMU_ALM0_10_C "used environment signals / Reference to used environment condition set for check DFC_MOXEMM_SMU_ALM0_10" VALUE 0x80504677 Val_Wu8 1.00000000000 DFES_EnvTabVerb 0.00 1.00000000000 FORMAT "%13.11" /end CHARACTERISTIC
/begin CHARACTERISTIC DFES_EnvRef.DFC_MOXEMM_SMU_ALM0_11_C "used environment signals / Reference to used environment condition set for check DFC_MOXEMM_SMU_ALM0_11" VALUE 0x80504678 Val_Wu8 1.00000000000 DFES_EnvTabVerb 0.00 1.00000000000 FORMAT "%13.11" /end CHARACTERISTIC
/begin CHARACTERISTIC DFES_EnvRef.DFC_MOXEMM_SMU_ALM0_13_C "used environment signals / Reference to used environment condition set for check DFC_MOXEMM_SMU_ALM0_13" VALUE 0x80504679 Val_Wu8 1.00000000000 DFES_EnvTabVerb 0.00 1.00000000000 FORMAT "%13.11" /end CHARACTERISTIC
/begin CHARACTERISTIC DFES_EnvRef.DFC_MOXEMM_SMU_ALM0_14_C "used environment signals / Reference to used environment condition set for check DFC_MOXEMM_SMU_ALM0_14" VALUE 0x8050467A Val_Wu8 1.00000000000 DFES_EnvTabVerb 0.00 1.00000000000 FORMAT "%13.11" /end CHARACTERISTIC
/begin CHARACTERISTIC DFES_EnvRef.DFC_MOXEMM_SMU_ALM0_2_C "used environment signals / Reference to used environment condition set for check DFC_MOXEMM_SMU_ALM0_2" VALUE 0x8050467B Val_Wu8 1.00000000000 DFES_EnvTabVerb 0.00 1.00000000000 FORMAT "%13.11" /end CHARACTERISTIC
/begin CHARACTERISTIC DFES_EnvRef.DFC_MOXEMM_SMU_ALM0_22_C "used environment signals / Reference to used environment condition set for check DFC_MOXEMM_SMU_ALM0_22" VALUE 0x8050467C Val_Wu8 1.00000000000 DFES_EnvTabVerb 0.00 1.00000000000 FORMAT "%13.11" /end CHARACTERISTIC
/begin CHARACTERISTIC DFES_EnvRef.DFC_MOXEMM_SMU_ALM0_23_C "used environment signals / Reference to used environment condition set for check DFC_MOXEMM_SMU_ALM0_23" VALUE 0x8050467D Val_Wu8 1.00000000000 DFES_EnvTabVerb 0.00 1.00000000000 FORMAT "%13.11" /end CHARACTERISTIC
/begin CHARACTERISTIC DFES_EnvRef.DFC_MOXEMM_SMU_ALM0_4_C "used environment signals / Reference to used environment condition set for check DFC_MOXEMM_SMU_ALM0_4" VALUE 0x8050467E Val_Wu8 1.00000000000 DFES_EnvTabVerb 0.00 1.00000000000 FORMAT "%13.11" /end CHARACTERISTIC
/begin CHARACTERISTIC DFES_EnvRef.DFC_MOXEMM_SMU_ALM0_5_C "used environment signals / Reference to used environment condition set for check DFC_MOXEMM_SMU_ALM0_5" VALUE 0x8050467F Val_Wu8 1.00000000000 DFES_EnvTabVerb 0.00 1.00000000000 FORMAT "%13.11" /end CHARACTERISTIC
/begin CHARACTERISTIC DFES_EnvRef.DFC_MOXEMM_SMU_ALM0_7_C "used environment signals / Reference to used environment condition set for check DFC_MOXEMM_SMU_ALM0_7" VALUE 0x80504680 Val_Wu8 1.00000000000 DFES_EnvTabVerb 0.00 1.00000000000 FORMAT "%13.11" /end CHARACTERISTIC
/begin CHARACTERISTIC DFES_EnvRef.DFC_MOXEMM_SMU_ALM0_8_C "used environment signals / Reference to used environment condition set for check DFC_MOXEMM_SMU_ALM0_8" VALUE 0x80504681 Val_Wu8 1.00000000000 DFES_EnvTabVerb 0.00 1.00000000000 FORMAT "%13.11" /end CHARACTERISTIC
/begin CHARACTERISTIC DFES_EnvRef.DFC_MOXEMM_SMU_ALM10_16_C "used environment signals / Reference to used environment condition set for check DFC_MOXEMM_SMU_ALM10_16" VALUE 0x80504682 Val_Wu8 1.00000000000 DFES_EnvTabVerb 0.00 1.00000000000 FORMAT "%13.11" /end CHARACTERISTIC
/begin CHARACTERISTIC DFES_EnvRef.DFC_MOXEMM_SMU_ALM10_17_C "used environment signals / Reference to used environment condition set for check DFC_MOXEMM_SMU_ALM10_17" VALUE 0x80504683 Val_Wu8 1.00000000000 DFES_EnvTabVerb 0.00 1.00000000000 FORMAT "%13.11" /end CHARACTERISTIC
/begin CHARACTERISTIC DFES_EnvRef.DFC_MOXEMM_SMU_ALM10_21_C "used environment signals / Reference to used environment condition set for check DFC_MOXEMM_SMU_ALM10_21" VALUE 0x80504684 Val_Wu8 1.00000000000 DFES_EnvTabVerb 0.00 1.00000000000 FORMAT "%13.11" /end CHARACTERISTIC
/begin CHARACTERISTIC DFES_EnvRef.DFC_MOXEMM_SMU_ALM11_0_C "used environment signals / Reference to used environment condition set for check DFC_MOXEMM_SMU_ALM11_0" VALUE 0x80504685 Val_Wu8 1.00000000000 DFES_EnvTabVerb 0.00 1.00000000000 FORMAT "%13.11" /end CHARACTERISTIC
/begin CHARACTERISTIC DFES_EnvRef.DFC_MOXEMM_SMU_ALM11_1_C "used environment signals / Reference to used environment condition set for check DFC_MOXEMM_SMU_ALM11_1" VALUE 0x80504686 Val_Wu8 1.00000000000 DFES_EnvTabVerb 0.00 1.00000000000 FORMAT "%13.11" /end CHARACTERISTIC
/begin CHARACTERISTIC DFES_EnvRef.DFC_MOXEMM_SMU_ALM11_2_C "used environment signals / Reference to used environment condition set for check DFC_MOXEMM_SMU_ALM11_2" VALUE 0x80504687 Val_Wu8 1.00000000000 DFES_EnvTabVerb 0.00 1.00000000000 FORMAT "%13.11" /end CHARACTERISTIC
/begin CHARACTERISTIC DFES_EnvRef.DFC_MOXEMM_SMU_ALM11_3_C "used environment signals / Reference to used environment condition set for check DFC_MOXEMM_SMU_ALM11_3" VALUE 0x80504688 Val_Wu8 1.00000000000 DFES_EnvTabVerb 0.00 1.00000000000 FORMAT "%13.11" /end CHARACTERISTIC
/begin CHARACTERISTIC DFES_EnvRef.DFC_MOXEMM_SMU_ALM11_4_C "used environment signals / Reference to used environment condition set for check DFC_MOXEMM_SMU_ALM11_4" VALUE 0x80504689 Val_Wu8 1.00000000000 DFES_EnvTabVerb 0.00 1.00000000000 FORMAT "%13.11" /end CHARACTERISTIC
/begin CHARACTERISTIC DFES_EnvRef.DFC_MOXEMM_SMU_ALM11_5_C "used environment signals / Reference to used environment condition set for check DFC_MOXEMM_SMU_ALM11_5" VALUE 0x8050468A Val_Wu8 1.00000000000 DFES_EnvTabVerb 0.00 1.00000000000 FORMAT "%13.11" /end CHARACTERISTIC
/begin CHARACTERISTIC DFES_EnvRef.DFC_MOXEMM_SMU_ALM11_8_C "used environment signals / Reference to used environment condition set for check DFC_MOXEMM_SMU_ALM11_8" VALUE 0x8050468B Val_Wu8 1.00000000000 DFES_EnvTabVerb 0.00 1.00000000000 FORMAT "%13.11" /end CHARACTERISTIC
/begin CHARACTERISTIC DFES_EnvRef.DFC_MOXEMM_SMU_ALM11_9_C "used environment signals / Reference to used environment condition set for check DFC_MOXEMM_SMU_ALM11_9" VALUE 0x8050468C Val_Wu8 1.00000000000 DFES_EnvTabVerb 0.00 1.00000000000 FORMAT "%13.11" /end CHARACTERISTIC
/begin CHARACTERISTIC DFES_EnvRef.DFC_MOXEMM_SMU_ALM1_0_C "used environment signals / Reference to used environment condition set for check DFC_MOXEMM_SMU_ALM1_0" VALUE 0x8050468D Val_Wu8 1.00000000000 DFES_EnvTabVerb 0.00 1.00000000000 FORMAT "%13.11" /end CHARACTERISTIC
/begin CHARACTERISTIC DFES_EnvRef.DFC_MOXEMM_SMU_ALM1_1_C "used environment signals / Reference to used environment condition set for check DFC_MOXEMM_SMU_ALM1_1" VALUE 0x8050468E Val_Wu8 1.00000000000 DFES_EnvTabVerb 0.00 1.00000000000 FORMAT "%13.11" /end CHARACTERISTIC
/begin CHARACTERISTIC DFES_EnvRef.DFC_MOXEMM_SMU_ALM1_10_C "used environment signals / Reference to used environment condition set for check DFC_MOXEMM_SMU_ALM1_10" VALUE 0x8050468F Val_Wu8 1.00000000000 DFES_EnvTabVerb 0.00 1.00000000000 FORMAT "%13.11" /end CHARACTERISTIC
/begin CHARACTERISTIC DFES_EnvRef.DFC_MOXEMM_SMU_ALM1_11_C "used environment signals / Reference to used environment condition set for check DFC_MOXEMM_SMU_ALM1_11" VALUE 0x80504690 Val_Wu8 1.00000000000 DFES_EnvTabVerb 0.00 1.00000000000 FORMAT "%13.11" /end CHARACTERISTIC
/begin CHARACTERISTIC DFES_EnvRef.DFC_MOXEMM_SMU_ALM1_13_C "used environment signals / Reference to used environment condition set for check DFC_MOXEMM_SMU_ALM1_13" VALUE 0x80504691 Val_Wu8 1.00000000000 DFES_EnvTabVerb 0.00 1.00000000000 FORMAT "%13.11" /end CHARACTERISTIC
/begin CHARACTERISTIC DFES_EnvRef.DFC_MOXEMM_SMU_ALM1_14_C "used environment signals / Reference to used environment condition set for check DFC_MOXEMM_SMU_ALM1_14" VALUE 0x80504692 Val_Wu8 1.00000000000 DFES_EnvTabVerb 0.00 1.00000000000 FORMAT "%13.11" /end CHARACTERISTIC
/begin CHARACTERISTIC DFES_EnvRef.DFC_MOXEMM_SMU_ALM1_2_C "used environment signals / Reference to used environment condition set for check DFC_MOXEMM_SMU_ALM1_2" VALUE 0x80504693 Val_Wu8 1.00000000000 DFES_EnvTabVerb 0.00 1.00000000000 FORMAT "%13.11" /end CHARACTERISTIC
/begin CHARACTERISTIC DFES_EnvRef.DFC_MOXEMM_SMU_ALM1_22_C "used environment signals / Reference to used environment condition set for check DFC_MOXEMM_SMU_ALM1_22" VALUE 0x80504694 Val_Wu8 1.00000000000 DFES_EnvTabVerb 0.00 1.00000000000 FORMAT "%13.11" /end CHARACTERISTIC
/begin CHARACTERISTIC DFES_EnvRef.DFC_MOXEMM_SMU_ALM1_23_C "used environment signals / Reference to used environment condition set for check DFC_MOXEMM_SMU_ALM1_23" VALUE 0x80504695 Val_Wu8 1.00000000000 DFES_EnvTabVerb 0.00 1.00000000000 FORMAT "%13.11" /end CHARACTERISTIC
/begin CHARACTERISTIC DFES_EnvRef.DFC_MOXEMM_SMU_ALM1_4_C "used environment signals / Reference to used environment condition set for check DFC_MOXEMM_SMU_ALM1_4" VALUE 0x80504696 Val_Wu8 1.00000000000 DFES_EnvTabVerb 0.00 1.00000000000 FORMAT "%13.11" /end CHARACTERISTIC
/begin CHARACTERISTIC DFES_EnvRef.DFC_MOXEMM_SMU_ALM1_5_C "used environment signals / Reference to used environment condition set for check DFC_MOXEMM_SMU_ALM1_5" VALUE 0x80504697 Val_Wu8 1.00000000000 DFES_EnvTabVerb 0.00 1.00000000000 FORMAT "%13.11" /end CHARACTERISTIC
/begin CHARACTERISTIC DFES_EnvRef.DFC_MOXEMM_SMU_ALM1_7_C "used environment signals / Reference to used environment condition set for check DFC_MOXEMM_SMU_ALM1_7" VALUE 0x80504698 Val_Wu8 1.00000000000 DFES_EnvTabVerb 0.00 1.00000000000 FORMAT "%13.11" /end CHARACTERISTIC
/begin CHARACTERISTIC DFES_EnvRef.DFC_MOXEMM_SMU_ALM1_8_C "used environment signals / Reference to used environment condition set for check DFC_MOXEMM_SMU_ALM1_8" VALUE 0x80504699 Val_Wu8 1.00000000000 DFES_EnvTabVerb 0.00 1.00000000000 FORMAT "%13.11" /end CHARACTERISTIC
/begin CHARACTERISTIC DFES_EnvRef.DFC_MOXEMM_SMU_ALM21_0_C "used environment signals / Reference to used environment condition set for check DFC_MOXEMM_SMU_ALM21_0" VALUE 0x8050469A Val_Wu8 1.00000000000 DFES_EnvTabVerb 0.00 1.00000000000 FORMAT "%13.11" /end CHARACTERISTIC
/begin CHARACTERISTIC DFES_EnvRef.DFC_MOXEMM_SMU_ALM21_16_C "used environment signals / Reference to used environment condition set for check DFC_MOXEMM_SMU_ALM21_16" VALUE 0x8050469B Val_Wu8 1.00000000000 DFES_EnvTabVerb 0.00 1.00000000000 FORMAT "%13.11" /end CHARACTERISTIC
/begin CHARACTERISTIC DFES_EnvRef.DFC_MOXEMM_SMU_ALM21_3_C "used environment signals / Reference to used environment condition set for check DFC_MOXEMM_SMU_ALM21_3" VALUE 0x8050469C Val_Wu8 1.00000000000 DFES_EnvTabVerb 0.00 1.00000000000 FORMAT "%13.11" /end CHARACTERISTIC
/begin CHARACTERISTIC DFES_EnvRef.DFC_MOXEMM_SMU_ALM2_1_C "used environment signals / Reference to used environment condition set for check DFC_MOXEMM_SMU_ALM2_1" VALUE 0x8050469D Val_Wu8 1.00000000000 DFES_EnvTabVerb 0.00 1.00000000000 FORMAT "%13.11" /end CHARACTERISTIC
/begin CHARACTERISTIC DFES_EnvRef.DFC_MOXEMM_SMU_ALM2_10_C "used environment signals / Reference to used environment condition set for check DFC_MOXEMM_SMU_ALM2_10" VALUE 0x8050469E Val_Wu8 1.00000000000 DFES_EnvTabVerb 0.00 1.00000000000 FORMAT "%13.11" /end CHARACTERISTIC
/begin CHARACTERISTIC DFES_EnvRef.DFC_MOXEMM_SMU_ALM2_11_C "used environment signals / Reference to used environment condition set for check DFC_MOXEMM_SMU_ALM2_11" VALUE 0x8050469F Val_Wu8 1.00000000000 DFES_EnvTabVerb 0.00 1.00000000000 FORMAT "%13.11" /end CHARACTERISTIC
/begin CHARACTERISTIC DFES_EnvRef.DFC_MOXEMM_SMU_ALM2_13_C "used environment signals / Reference to used environment condition set for check DFC_MOXEMM_SMU_ALM2_13" VALUE 0x805046A0 Val_Wu8 1.00000000000 DFES_EnvTabVerb 0.00 1.00000000000 FORMAT "%13.11" /end CHARACTERISTIC
/begin CHARACTERISTIC DFES_EnvRef.DFC_MOXEMM_SMU_ALM2_14_C "used environment signals / Reference to used environment condition set for check DFC_MOXEMM_SMU_ALM2_14" VALUE 0x805046A1 Val_Wu8 1.00000000000 DFES_EnvTabVerb 0.00 1.00000000000 FORMAT "%13.11" /end CHARACTERISTIC
/begin CHARACTERISTIC DFES_EnvRef.DFC_MOXEMM_SMU_ALM2_22_C "used environment signals / Reference to used environment condition set for check DFC_MOXEMM_SMU_ALM2_22" VALUE 0x805046A2 Val_Wu8 1.00000000000 DFES_EnvTabVerb 0.00 1.00000000000 FORMAT "%13.11" /end CHARACTERISTIC
/begin CHARACTERISTIC DFES_EnvRef.DFC_MOXEMM_SMU_ALM2_23_C "used environment signals / Reference to used environment condition set for check DFC_MOXEMM_SMU_ALM2_23" VALUE 0x805046A3 Val_Wu8 1.00000000000 DFES_EnvTabVerb 0.00 1.00000000000 FORMAT "%13.11" /end CHARACTERISTIC
/begin CHARACTERISTIC DFES_EnvRef.DFC_MOXEMM_SMU_ALM2_4_C "used environment signals / Reference to used environment condition set for check DFC_MOXEMM_SMU_ALM2_4" VALUE 0x805046A4 Val_Wu8 1.00000000000 DFES_EnvTabVerb 0.00 1.00000000000 FORMAT "%13.11" /end CHARACTERISTIC
/begin CHARACTERISTIC DFES_EnvRef.DFC_MOXEMM_SMU_ALM2_5_C "used environment signals / Reference to used environment condition set for check DFC_MOXEMM_SMU_ALM2_5" VALUE 0x805046A5 Val_Wu8 1.00000000000 DFES_EnvTabVerb 0.00 1.00000000000 FORMAT "%13.11" /end CHARACTERISTIC
/begin CHARACTERISTIC DFES_EnvRef.DFC_MOXEMM_SMU_ALM2_7_C "used environment signals / Reference to used environment condition set for check DFC_MOXEMM_SMU_ALM2_7" VALUE 0x805046A6 Val_Wu8 1.00000000000 DFES_EnvTabVerb 0.00 1.00000000000 FORMAT "%13.11" /end CHARACTERISTIC
/begin CHARACTERISTIC DFES_EnvRef.DFC_MOXEMM_SMU_ALM2_8_C "used environment signals / Reference to used environment condition set for check DFC_MOXEMM_SMU_ALM2_8" VALUE 0x805046A7 Val_Wu8 1.00000000000 DFES_EnvTabVerb 0.00 1.00000000000 FORMAT "%13.11" /end CHARACTERISTIC
/begin CHARACTERISTIC DFES_EnvRef.DFC_MOXEMM_SMU_ALM6_0_C "used environment signals / Reference to used environment condition set for check DFC_MOXEMM_SMU_ALM6_0" VALUE 0x805046A8 Val_Wu8 1.00000000000 DFES_EnvTabVerb 0.00 1.00000000000 FORMAT "%13.11" /end CHARACTERISTIC
/begin CHARACTERISTIC DFES_EnvRef.DFC_MOXEMM_SMU_ALM6_11_C "used environment signals / Reference to used environment condition set for check DFC_MOXEMM_SMU_ALM6_11" VALUE 0x805046A9 Val_Wu8 1.00000000000 DFES_EnvTabVerb 0.00 1.00000000000 FORMAT "%13.11" /end CHARACTERISTIC
/begin CHARACTERISTIC DFES_EnvRef.DFC_MOXEMM_SMU_ALM6_12_C "used environment signals / Reference to used environment condition set for check DFC_MOXEMM_SMU_ALM6_12" VALUE 0x805046AA Val_Wu8 1.00000000000 DFES_EnvTabVerb 0.00 1.00000000000 FORMAT "%13.11" /end CHARACTERISTIC
/begin CHARACTERISTIC DFES_EnvRef.DFC_MOXEMM_SMU_ALM6_14_C "used environment signals / Reference to used environment condition set for check DFC_MOXEMM_SMU_ALM6_14" VALUE 0x805046AB Val_Wu8 1.00000000000 DFES_EnvTabVerb 0.00 1.00000000000 FORMAT "%13.11" /end CHARACTERISTIC
/begin CHARACTERISTIC DFES_EnvRef.DFC_MOXEMM_SMU_ALM6_15_C "used environment signals / Reference to used environment condition set for check DFC_MOXEMM_SMU_ALM6_15" VALUE 0x805046AC Val_Wu8 1.00000000000 DFES_EnvTabVerb 0.00 1.00000000000 FORMAT "%13.11" /end CHARACTERISTIC
/begin CHARACTERISTIC DFES_EnvRef.DFC_MOXEMM_SMU_ALM6_17_C "used environment signals / Reference to used environment condition set for check DFC_MOXEMM_SMU_ALM6_17" VALUE 0x805046AD Val_Wu8 1.00000000000 DFES_EnvTabVerb 0.00 1.00000000000 FORMAT "%13.11" /end CHARACTERISTIC
/begin CHARACTERISTIC DFES_EnvRef.DFC_MOXEMM_SMU_ALM6_18_C "used environment signals / Reference to used environment condition set for check DFC_MOXEMM_SMU_ALM6_18" VALUE 0x805046AE Val_Wu8 1.00000000000 DFES_EnvTabVerb 0.00 1.00000000000 FORMAT "%13.11" /end CHARACTERISTIC
/begin CHARACTERISTIC DFES_EnvRef.DFC_MOXEMM_SMU_ALM6_20_C "used environment signals / Reference to used environment condition set for check DFC_MOXEMM_SMU_ALM6_20" VALUE 0x805046AF Val_Wu8 1.00000000000 DFES_EnvTabVerb 0.00 1.00000000000 FORMAT "%13.11" /end CHARACTERISTIC
/begin CHARACTERISTIC DFES_EnvRef.DFC_MOXEMM_SMU_ALM6_21_C "used environment signals / Reference to used environment condition set for check DFC_MOXEMM_SMU_ALM6_21" VALUE 0x805046B0 Val_Wu8 1.00000000000 DFES_EnvTabVerb 0.00 1.00000000000 FORMAT "%13.11" /end CHARACTERISTIC
/begin CHARACTERISTIC DFES_EnvRef.DFC_MOXEMM_SMU_ALM6_25_C "used environment signals / Reference to used environment condition set for check DFC_MOXEMM_SMU_ALM6_25" VALUE 0x805046B1 Val_Wu8 1.00000000000 DFES_EnvTabVerb 0.00 1.00000000000 FORMAT "%13.11" /end CHARACTERISTIC
/begin CHARACTERISTIC DFES_EnvRef.DFC_MOXEMM_SMU_ALM6_4_C "used environment signals / Reference to used environment condition set for check DFC_MOXEMM_SMU_ALM6_4" VALUE 0x805046B2 Val_Wu8 1.00000000000 DFES_EnvTabVerb 0.00 1.00000000000 FORMAT "%13.11" /end CHARACTERISTIC
/begin CHARACTERISTIC DFES_EnvRef.DFC_MOXEMM_SMU_ALM6_5_C "used environment signals / Reference to used environment condition set for check DFC_MOXEMM_SMU_ALM6_5" VALUE 0x805046B3 Val_Wu8 1.00000000000 DFES_EnvTabVerb 0.00 1.00000000000 FORMAT "%13.11" /end CHARACTERISTIC
/begin CHARACTERISTIC DFES_EnvRef.DFC_MOXEMM_SMU_ALM6_7_C "used environment signals / Reference to used environment condition set for check DFC_MOXEMM_SMU_ALM6_7" VALUE 0x805046B4 Val_Wu8 1.00000000000 DFES_EnvTabVerb 0.00 1.00000000000 FORMAT "%13.11" /end CHARACTERISTIC
/begin CHARACTERISTIC DFES_EnvRef.DFC_MOXEMM_SMU_ALM6_8_C "used environment signals / Reference to used environment condition set for check DFC_MOXEMM_SMU_ALM6_8" VALUE 0x805046B5 Val_Wu8 1.00000000000 DFES_EnvTabVerb 0.00 1.00000000000 FORMAT "%13.11" /end CHARACTERISTIC
/begin CHARACTERISTIC DFES_EnvRef.DFC_MOXEMM_SMU_ALM7_1_C "used environment signals / Reference to used environment condition set for check DFC_MOXEMM_SMU_ALM7_1" VALUE 0x805046B6 Val_Wu8 1.00000000000 DFES_EnvTabVerb 0.00 1.00000000000 FORMAT "%13.11" /end CHARACTERISTIC
/begin CHARACTERISTIC DFES_EnvRef.DFC_MOXEMM_SMU_ALM7_12_C "used environment signals / Reference to used environment condition set for check DFC_MOXEMM_SMU_ALM7_12" VALUE 0x805046B7 Val_Wu8 1.00000000000 DFES_EnvTabVerb 0.00 1.00000000000 FORMAT "%13.11" /end CHARACTERISTIC
/begin CHARACTERISTIC DFES_EnvRef.DFC_MOXEMM_SMU_ALM7_13_C "used environment signals / Reference to used environment condition set for check DFC_MOXEMM_SMU_ALM7_13" VALUE 0x805046B8 Val_Wu8 1.00000000000 DFES_EnvTabVerb 0.00 1.00000000000 FORMAT "%13.11" /end CHARACTERISTIC
/begin CHARACTERISTIC DFES_EnvRef.DFC_MOXEMM_SMU_ALM7_14_C "used environment signals / Reference to used environment condition set for check DFC_MOXEMM_SMU_ALM7_14" VALUE 0x805046B9 Val_Wu8 1.00000000000 DFES_EnvTabVerb 0.00 1.00000000000 FORMAT "%13.11" /end CHARACTERISTIC
/begin CHARACTERISTIC DFES_EnvRef.DFC_MOXEMM_SMU_ALM7_15_C "used environment signals / Reference to used environment condition set for check DFC_MOXEMM_SMU_ALM7_15" VALUE 0x805046BA Val_Wu8 1.00000000000 DFES_EnvTabVerb 0.00 1.00000000000 FORMAT "%13.11" /end CHARACTERISTIC
/begin CHARACTERISTIC DFES_EnvRef.DFC_MOXEMM_SMU_ALM7_16_C "used environment signals / Reference to used environment condition set for check DFC_MOXEMM_SMU_ALM7_16" VALUE 0x805046BB Val_Wu8 1.00000000000 DFES_EnvTabVerb 0.00 1.00000000000 FORMAT "%13.11" /end CHARACTERISTIC
/begin CHARACTERISTIC DFES_EnvRef.DFC_MOXEMM_SMU_ALM7_17_C "used environment signals / Reference to used environment condition set for check DFC_MOXEMM_SMU_ALM7_17" VALUE 0x805046BC Val_Wu8 1.00000000000 DFES_EnvTabVerb 0.00 1.00000000000 FORMAT "%13.11" /end CHARACTERISTIC
/begin CHARACTERISTIC DFES_EnvRef.DFC_MOXEMM_SMU_ALM7_2_C "used environment signals / Reference to used environment condition set for check DFC_MOXEMM_SMU_ALM7_2" VALUE 0x805046BD Val_Wu8 1.00000000000 DFES_EnvTabVerb 0.00 1.00000000000 FORMAT "%13.11" /end CHARACTERISTIC
/begin CHARACTERISTIC DFES_EnvRef.DFC_MOXEMM_SMU_ALM7_20_C "used environment signals / Reference to used environment condition set for check DFC_MOXEMM_SMU_ALM7_20" VALUE 0x805046BE Val_Wu8 1.00000000000 DFES_EnvTabVerb 0.00 1.00000000000 FORMAT "%13.11" /end CHARACTERISTIC
/begin CHARACTERISTIC DFES_EnvRef.DFC_MOXEMM_SMU_ALM7_25_C "used environment signals / Reference to used environment condition set for check DFC_MOXEMM_SMU_ALM7_25" VALUE 0x805046BF Val_Wu8 1.00000000000 DFES_EnvTabVerb 0.00 1.00000000000 FORMAT "%13.11" /end CHARACTERISTIC
/begin CHARACTERISTIC DFES_EnvRef.DFC_MOXEMM_SMU_ALM7_26_C "used environment signals / Reference to used environment condition set for check DFC_MOXEMM_SMU_ALM7_26" VALUE 0x805046C0 Val_Wu8 1.00000000000 DFES_EnvTabVerb 0.00 1.00000000000 FORMAT "%13.11" /end CHARACTERISTIC
/begin CHARACTERISTIC DFES_EnvRef.DFC_MOXEMM_SMU_ALM7_28_C "used environment signals / Reference to used environment condition set for check DFC_MOXEMM_SMU_ALM7_28" VALUE 0x805046C1 Val_Wu8 1.00000000000 DFES_EnvTabVerb 0.00 1.00000000000 FORMAT "%13.11" /end CHARACTERISTIC
/begin CHARACTERISTIC DFES_EnvRef.DFC_MOXEMM_SMU_ALM7_29_C "used environment signals / Reference to used environment condition set for check DFC_MOXEMM_SMU_ALM7_29" VALUE 0x805046C2 Val_Wu8 1.00000000000 DFES_EnvTabVerb 0.00 1.00000000000 FORMAT "%13.11" /end CHARACTERISTIC
/begin CHARACTERISTIC DFES_EnvRef.DFC_MOXEMM_SMU_ALM7_30_C "used environment signals / Reference to used environment condition set for check DFC_MOXEMM_SMU_ALM7_30" VALUE 0x805046C3 Val_Wu8 1.00000000000 DFES_EnvTabVerb 0.00 1.00000000000 FORMAT "%13.11" /end CHARACTERISTIC
/begin CHARACTERISTIC DFES_EnvRef.DFC_MOXEMM_SMU_ALM7_31_C "used environment signals / Reference to used environment condition set for check DFC_MOXEMM_SMU_ALM7_31" VALUE 0x805046C4 Val_Wu8 1.00000000000 DFES_EnvTabVerb 0.00 1.00000000000 FORMAT "%13.11" /end CHARACTERISTIC
/begin CHARACTERISTIC DFES_EnvRef.DFC_MOXEMM_SMU_ALM8_0_C "used environment signals / Reference to used environment condition set for check DFC_MOXEMM_SMU_ALM8_0" VALUE 0x805046C5 Val_Wu8 1.00000000000 DFES_EnvTabVerb 0.00 1.00000000000 FORMAT "%13.11" /end CHARACTERISTIC
/begin CHARACTERISTIC DFES_EnvRef.DFC_MOXEMM_SMU_ALM8_1_C "used environment signals / Reference to used environment condition set for check DFC_MOXEMM_SMU_ALM8_1" VALUE 0x805046C6 Val_Wu8 1.00000000000 DFES_EnvTabVerb 0.00 1.00000000000 FORMAT "%13.11" /end CHARACTERISTIC
/begin CHARACTERISTIC DFES_EnvRef.DFC_MOXEMM_SMU_ALM8_10_C "used environment signals / Reference to used environment condition set for check DFC_MOXEMM_SMU_ALM8_10" VALUE 0x805046C7 Val_Wu8 1.00000000000 DFES_EnvTabVerb 0.00 1.00000000000 FORMAT "%13.11" /end CHARACTERISTIC
/begin CHARACTERISTIC DFES_EnvRef.DFC_MOXEMM_SMU_ALM8_11_C "used environment signals / Reference to used environment condition set for check DFC_MOXEMM_SMU_ALM8_11" VALUE 0x805046C8 Val_Wu8 1.00000000000 DFES_EnvTabVerb 0.00 1.00000000000 FORMAT "%13.11" /end CHARACTERISTIC
/begin CHARACTERISTIC DFES_EnvRef.DFC_MOXEMM_SMU_ALM8_12_C "used environment signals / Reference to used environment condition set for check DFC_MOXEMM_SMU_ALM8_12" VALUE 0x805046C9 Val_Wu8 1.00000000000 DFES_EnvTabVerb 0.00 1.00000000000 FORMAT "%13.11" /end CHARACTERISTIC
/begin CHARACTERISTIC DFES_EnvRef.DFC_MOXEMM_SMU_ALM8_16_C "used environment signals / Reference to used environment condition set for check DFC_MOXEMM_SMU_ALM8_16" VALUE 0x805046CA Val_Wu8 1.00000000000 DFES_EnvTabVerb 0.00 1.00000000000 FORMAT "%13.11" /end CHARACTERISTIC
/begin CHARACTERISTIC DFES_EnvRef.DFC_MOXEMM_SMU_ALM8_18_C "used environment signals / Reference to used environment condition set for check DFC_MOXEMM_SMU_ALM8_18" VALUE 0x805046CB Val_Wu8 1.00000000000 DFES_EnvTabVerb 0.00 1.00000000000 FORMAT "%13.11" /end CHARACTERISTIC
/begin CHARACTERISTIC DFES_EnvRef.DFC_MOXEMM_SMU_ALM8_2_C "used environment signals / Reference to used environment condition set for check DFC_MOXEMM_SMU_ALM8_2" VALUE 0x805046CC Val_Wu8 1.00000000000 DFES_EnvTabVerb 0.00 1.00000000000 FORMAT "%13.11" /end CHARACTERISTIC
/begin CHARACTERISTIC DFES_EnvRef.DFC_MOXEMM_SMU_ALM8_3_C "used environment signals / Reference to used environment condition set for check DFC_MOXEMM_SMU_ALM8_3" VALUE 0x805046CD Val_Wu8 1.00000000000 DFES_EnvTabVerb 0.00 1.00000000000 FORMAT "%13.11" /end CHARACTERISTIC
/begin CHARACTERISTIC DFES_EnvRef.DFC_MOXEMM_SMU_ALM8_31_C "used environment signals / Reference to used environment condition set for check DFC_MOXEMM_SMU_ALM8_31" VALUE 0x805046CE Val_Wu8 1.00000000000 DFES_EnvTabVerb 0.00 1.00000000000 FORMAT "%13.11" /end CHARACTERISTIC
/begin CHARACTERISTIC DFES_EnvRef.DFC_MOXEMM_SMU_ALM8_4_C "used environment signals / Reference to used environment condition set for check DFC_MOXEMM_SMU_ALM8_4" VALUE 0x805046CF Val_Wu8 1.00000000000 DFES_EnvTabVerb 0.00 1.00000000000 FORMAT "%13.11" /end CHARACTERISTIC
/begin CHARACTERISTIC DFES_EnvRef.DFC_MOXEMM_SMU_ALM9_0_C "used environment signals / Reference to used environment condition set for check DFC_MOXEMM_SMU_ALM9_0" VALUE 0x805046D0 Val_Wu8 1.00000000000 DFES_EnvTabVerb 0.00 1.00000000000 FORMAT "%13.11" /end CHARACTERISTIC
/begin CHARACTERISTIC DFES_EnvRef.DFC_MOXEMM_SMU_ALM9_15_C "used environment signals / Reference to used environment condition set for check DFC_MOXEMM_SMU_ALM9_15" VALUE 0x805046D1 Val_Wu8 1.00000000000 DFES_EnvTabVerb 0.00 1.00000000000 FORMAT "%13.11" /end CHARACTERISTIC
/begin CHARACTERISTIC DFES_EnvRef.DFC_MOXEMM_SMU_ALM9_3_C "used environment signals / Reference to used environment condition set for check DFC_MOXEMM_SMU_ALM9_3" VALUE 0x805046D2 Val_Wu8 1.00000000000 DFES_EnvTabVerb 0.00 1.00000000000 FORMAT "%13.11" /end CHARACTERISTIC
/begin CHARACTERISTIC DFES_EnvRef.DFC_MoCADCNTP_C "used environment signals / Reference to used environment condition set for check DFC_MoCADCNTP" VALUE 0x805046D3 Val_Wu8 1.00000000000 DFES_EnvTabVerb 0.00 1.00000000000 FORMAT "%13.11" /end CHARACTERISTIC
/begin CHARACTERISTIC DFES_EnvRef.DFC_MoCADCTst_C "used environment signals / Reference to used environment condition set for check DFC_MoCADCTst" VALUE 0x805046D4 Val_Wu8 1.00000000000 DFES_EnvTabVerb 0.00 1.00000000000 FORMAT "%13.11" /end CHARACTERISTIC
/begin CHARACTERISTIC DFES_EnvRef.DFC_MoCSOPICO_C "used environment signals / Reference to used environment condition set for check DFC_MoCSOPICO" VALUE 0x805046D5 Val_Wu8 1.00000000000 DFES_EnvTabVerb 0.00 1.00000000000 FORMAT "%13.11" /end CHARACTERISTIC
/begin CHARACTERISTIC DFES_EnvRef.DFC_MoFAPP_C "used environment signals / Reference to used environment condition set for check DFC_MoFAPP" VALUE 0x805046D6 Val_Wu8 1.00000000000 DFES_EnvTabVerb 0.00 1.00000000000 FORMAT "%13.11" /end CHARACTERISTIC
/begin CHARACTERISTIC DFES_EnvRef.DFC_MoFAirFilgPrdc_C "used environment signals / Reference to used environment condition set for check DFC_MoFAirFilgPrdc" VALUE 0x805046D7 Val_Wu8 1.00000000000 DFES_EnvTabVerb 0.00 1.00000000000 FORMAT "%13.11" /end CHARACTERISTIC
/begin CHARACTERISTIC DFES_EnvRef.DFC_MoFAirFlCtOffGdi_C "used environment signals / Reference to used environment condition set for check DFC_MoFAirFlCtOffGdi" VALUE 0x805046D8 Val_Wu8 1.00000000000 DFES_EnvTabVerb 0.00 1.00000000000 FORMAT "%13.11" /end CHARACTERISTIC
/begin CHARACTERISTIC DFES_EnvRef.DFC_MoFAirFlCylGdi_C "used environment signals / Reference to used environment condition set for check DFC_MoFAirFlCylGdi" VALUE 0x805046D9 Val_Wu8 1.00000000000 DFES_EnvTabVerb 0.00 1.00000000000 FORMAT "%13.11" /end CHARACTERISTIC
/begin CHARACTERISTIC DFES_EnvRef.DFC_MoFAirFlFF_C "used environment signals / Reference to used environment condition set for check DFC_MoFAirFlFF" VALUE 0x805046DA Val_Wu8 1.00000000000 DFES_EnvTabVerb 0.00 1.00000000000 FORMAT "%13.11" /end CHARACTERISTIC
/begin CHARACTERISTIC DFES_EnvRef.DFC_MoFAirFlIn_C "used environment signals / Reference to used environment condition set for check DFC_MoFAirFlIn" VALUE 0x805046DB Val_Wu8 1.00000000000 DFES_EnvTabVerb 0.00 1.00000000000 FORMAT "%13.11" /end CHARACTERISTIC
/begin CHARACTERISTIC DFES_EnvRef.DFC_MoFAirFlMixCtlGdiChkAirFl_C "used environment signals / Reference to used environment condition set for check DFC_MoFAirFlMixCtlGdiChkAirFl" VALUE 0x805046DC Val_Wu8 1.00000000000 DFES_EnvTabVerb 0.00 1.00000000000 FORMAT "%13.11" /end CHARACTERISTIC
/begin CHARACTERISTIC DFES_EnvRef.DFC_MoFAirFlMixCtlGdiChkCtrl_C "used environment signals / Reference to used environment condition set for check DFC_MoFAirFlMixCtlGdiChkCtrl" VALUE 0x805046DD Val_Wu8 1.00000000000 DFES_EnvTabVerb 0.00 1.00000000000 FORMAT "%13.11" /end CHARACTERISTIC
/begin CHARACTERISTIC DFES_EnvRef.DFC_MoFAirFlMode_C "used environment signals / Reference to used environment condition set for check DFC_MoFAirFlMode" VALUE 0x805046DE Val_Wu8 1.00000000000 DFES_EnvTabVerb 0.00 1.00000000000 FORMAT "%13.11" /end CHARACTERISTIC
/begin CHARACTERISTIC DFES_EnvRef.DFC_MoFESpd_C "used environment signals / Reference to used environment condition set for check DFC_MoFESpd" VALUE 0x805046DF Val_Wu8 1.00000000000 DFES_EnvTabVerb 0.00 1.00000000000 FORMAT "%13.11" /end CHARACTERISTIC
/begin CHARACTERISTIC DFES_EnvRef.DFC_MoFIACo_C "used environment signals / Reference to used environment condition set for check DFC_MoFIACo" VALUE 0x805046E0 Val_Wu8 1.00000000000 DFES_EnvTabVerb 0.00 1.00000000000 FORMAT "%13.11" /end CHARACTERISTIC
/begin CHARACTERISTIC DFES_EnvRef.DFC_MoFICOL1_C "used environment signals / Reference to used environment condition set for check DFC_MoFICOL1" VALUE 0x805046E1 Val_Wu8 1.00000000000 DFES_EnvTabVerb 0.00 1.00000000000 FORMAT "%13.11" /end CHARACTERISTIC
/begin CHARACTERISTIC DFES_EnvRef.DFC_MoFICOL2_C "used environment signals / Reference to used environment condition set for check DFC_MoFICOL2" VALUE 0x805046E2 Val_Wu8 1.00000000000 DFES_EnvTabVerb 0.00 1.00000000000 FORMAT "%13.11" /end CHARACTERISTIC
/begin CHARACTERISTIC DFES_EnvRef.DFC_MoFStrt_C "used environment signals / Reference to used environment condition set for check DFC_MoFStrt" VALUE 0x805046E3 Val_Wu8 1.00000000000 DFES_EnvTabVerb 0.00 1.00000000000 FORMAT "%13.11" /end CHARACTERISTIC
/begin CHARACTERISTIC DFES_EnvRef.DFC_MoFTrqCmp_C "used environment signals / Reference to used environment condition set for check DFC_MoFTrqCmp" VALUE 0x805046E4 Val_Wu8 1.00000000000 DFES_EnvTabVerb 0.00 1.00000000000 FORMAT "%13.11" /end CHARACTERISTIC
/begin CHARACTERISTIC DFES_EnvRef.DFC_MoFTrqCmpMax_C "used environment signals / Reference to used environment condition set for check DFC_MoFTrqCmpMax" VALUE 0x805046E5 Val_Wu8 1.00000000000 DFES_EnvTabVerb 0.00 1.00000000000 FORMAT "%13.11" /end CHARACTERISTIC
/begin CHARACTERISTIC DFES_EnvRef.DFC_MoFTrqCmpMin_C "used environment signals / Reference to used environment condition set for check DFC_MoFTrqCmpMin" VALUE 0x805046E6 Val_Wu8 1.00000000000 DFES_EnvTabVerb 0.00 1.00000000000 FORMAT "%13.11" /end CHARACTERISTIC
/begin CHARACTERISTIC DFES_EnvRef.DFC_MoFVarPostBldSel_C "used environment signals / Reference to used environment condition set for check DFC_MoFVarPostBldSel" VALUE 0x805046E7 Val_Wu8 1.00000000000 DFES_EnvTabVerb 0.00 1.00000000000 FORMAT "%13.11" /end CHARACTERISTIC
/begin CHARACTERISTIC DFES_EnvRef.DFC_MoXEMMHwLTMCUFW_C "used environment signals / Reference to used environment condition set for check DFC_MoXEMMHwLTMCUFW" VALUE 0x805046E8 Val_Wu8 1.00000000000 DFES_EnvTabVerb 0.00 1.00000000000 FORMAT "%13.11" /end CHARACTERISTIC
/begin CHARACTERISTIC DFES_EnvRef.DFC_MoXEMMHwLTMonBIST_C "used environment signals / Reference to used environment condition set for check DFC_MoXEMMHwLTMonBIST" VALUE 0x805046E9 Val_Wu8 1.00000000000 DFES_EnvTabVerb 0.00 1.00000000000 FORMAT "%13.11" /end CHARACTERISTIC
/begin CHARACTERISTIC DFES_EnvRef.DFC_MoXEMMHwLTRegMonTest_C "used environment signals / Reference to used environment condition set for check DFC_MoXEMMHwLTRegMonTest" VALUE 0x805046EA Val_Wu8 1.00000000000 DFES_EnvTabVerb 0.00 1.00000000000 FORMAT "%13.11" /end CHARACTERISTIC
/begin CHARACTERISTIC DFES_EnvRef.DFC_MoXEMMHwLTStbySMUAlvTest_C "used environment signals / Reference to used environment condition set for check DFC_MoXEMMHwLTStbySMUAlvTest" VALUE 0x805046EB Val_Wu8 1.00000000000 DFES_EnvTabVerb 0.00 1.00000000000 FORMAT "%13.11" /end CHARACTERISTIC
/begin CHARACTERISTIC DFES_EnvRef.DFC_MoXEMMHwLTTempSens_C "used environment signals / Reference to used environment condition set for check DFC_MoXEMMHwLTTempSens" VALUE 0x805046EC Val_Wu8 1.00000000000 DFES_EnvTabVerb 0.00 1.00000000000 FORMAT "%13.11" /end CHARACTERISTIC
/begin CHARACTERISTIC DFES_EnvRef.DFC_MoXEMMHwLTUCBCfg_C "used environment signals / Reference to used environment condition set for check DFC_MoXEMMHwLTUCBCfg" VALUE 0x805046ED Val_Wu8 1.00000000000 DFES_EnvTabVerb 0.00 1.00000000000 FORMAT "%13.11" /end CHARACTERISTIC
/begin CHARACTERISTIC DFES_EnvRef.DFC_NWSEmax_C "used environment signals / Reference to used environment condition set for check DFC_NWSEmax" VALUE 0x805046EE Val_Wu8 1.00000000000 DFES_EnvTabVerb 0.00 1.00000000000 FORMAT "%13.11" /end CHARACTERISTIC
/begin CHARACTERISTIC DFES_EnvRef.DFC_NWSmax_C "used environment signals / Reference to used environment condition set for check DFC_NWSmax" VALUE 0x805046EF Val_Wu8 1.00000000000 DFES_EnvTabVerb 0.00 1.00000000000 FORMAT "%13.11" /end CHARACTERISTIC
/begin CHARACTERISTIC DFES_EnvRef.DFC_OCWDAABEActv_C "used environment signals / Reference to used environment condition set for check DFC_OCWDAABEActv" VALUE 0x805046F0 Val_Wu8 1.00000000000 DFES_EnvTabVerb 0.00 1.00000000000 FORMAT "%13.11" /end CHARACTERISTIC
/begin CHARACTERISTIC DFES_EnvRef.DFC_OCWDACom_C "used environment signals / Reference to used environment condition set for check DFC_OCWDACom" VALUE 0x805046F1 Val_Wu8 1.00000000000 DFES_EnvTabVerb 0.00 1.00000000000 FORMAT "%13.11" /end CHARACTERISTIC
/begin CHARACTERISTIC DFES_EnvRef.DFC_OCWDAErrPin_C "used environment signals / Reference to used environment condition set for check DFC_OCWDAErrPin" VALUE 0x805046F2 Val_Wu8 1.00000000000 DFES_EnvTabVerb 0.00 1.00000000000 FORMAT "%13.11" /end CHARACTERISTIC
/begin CHARACTERISTIC DFES_EnvRef.DFC_OCWDAOvrVltg_C "used environment signals / Reference to used environment condition set for check DFC_OCWDAOvrVltg" VALUE 0x805046F3 Val_Wu8 1.00000000000 DFES_EnvTabVerb 0.00 1.00000000000 FORMAT "%13.11" /end CHARACTERISTIC
/begin CHARACTERISTIC DFES_EnvRef.DFC_ORAmax_C "used environment signals / Reference to used environment condition set for check DFC_ORAmax" VALUE 0x805046F4 Val_Wu8 1.00000000000 DFES_EnvTabVerb 0.00 1.00000000000 FORMAT "%13.11" /end CHARACTERISTIC
/begin CHARACTERISTIC DFES_EnvRef.DFC_ORAmin_C "used environment signals / Reference to used environment condition set for check DFC_ORAmin" VALUE 0x805046F5 Val_Wu8 1.00000000000 DFES_EnvTabVerb 0.00 1.00000000000 FORMAT "%13.11" /end CHARACTERISTIC
/begin FUNCTION DFES "30000.73.0_2.0.0Diagnostic Fault Event Storage"
 /begin DEF_CHARACTERISTIC DFES_EnvRef.DFC_EbsChartcCurrErr_C DFES_EnvRef.DFC_EbsSelfDiagErr_C DFES_EnvRef.DFC_GEVlvPhaCsersIntkB1_C DFES_EnvRef.DFC_GEVlvPhaPsOpenLoadIntkB1_C DFES_EnvRef.DFC_GEVlvPhaPsShoToBattIntkB1_C DFES_EnvRef.DFC_GEVlvPhaPsShoToGndIntkB1_C DFES_EnvRef.DFC_GbxCANDigPlausErr_C DFES_EnvRef.DFC_GbxNPos1SRCMax_C DFES_EnvRef.DFC_GbxNPos1SRCMin_C DFES_EnvRef.DFC_GbxNPos2SRCMax_C DFES_EnvRef.DFC_GbxNPos2SRCMin_C DFES_EnvRef.DFC_GbxNPosAlvChk_C DFES_EnvRef.DFC_GbxNPosSyncErr_C DFES_EnvRef.DFC_HEGOS2B1HtrPsMax_C DFES_EnvRef.DFC_HEGOS2B1HtrPsMin_C DFES_EnvRef.DFC_HEGOS2B1HtrPsSig_C DFES_EnvRef.DFC_LinCSErrACG_C DFES_EnvRef.DFC_LinCSErrAEV_C DFES_EnvRef.DFC_LinCSErrDCDC_C DFES_EnvRef.DFC_LinCSErrEBS_C DFES_EnvRef.DFC_LinHdrTimeoutErrACG_C DFES_EnvRef.DFC_LinHdrTimeoutErrAEV_C DFES_EnvRef.DFC_LinHdrTimeoutErrDCDC_C DFES_EnvRef.DFC_LinHdrTimeoutErrEBS_C DFES_EnvRef.DFC_LinMsgTimeoutErrACG_C DFES_EnvRef.DFC_LinMsgTimeoutErrAEV_C DFES_EnvRef.DFC_LinMsgTimeoutErrDCDC_C DFES_EnvRef.DFC_LinMsgTimeoutErrEBS_C DFES_EnvRef.DFC_LinNoStrtComErr_C DFES_EnvRef.DFC_LowPresOilP_C DFES_EnvRef.DFC_MisfDetVWhlFrntLeOORHi_C DFES_EnvRef.DFC_MisfDetVWhlFrntLeRatyHi_C DFES_EnvRef.DFC_MisfDetVWhlFrntLeRatyLo_C DFES_EnvRef.DFC_MisfDetVWhlFrntLeStuck_C DFES_EnvRef.DFC_MisfDetVWhlFrntRiOORHi_C DFES_EnvRef.DFC_MisfDetVWhlFrntRiRatyHi_C DFES_EnvRef.DFC_MisfDetVWhlFrntRiRatyLo_C DFES_EnvRef.DFC_MisfDetVWhlFrntRiStuck_C DFES_EnvRef.DFC_MisfDetVWhlReLeOORHi_C DFES_EnvRef.DFC_MisfDetVWhlReLeRatyHi_C DFES_EnvRef.DFC_MisfDetVWhlReLeRatyLo_C DFES_EnvRef.DFC_MisfDetVWhlReLeStuck_C DFES_EnvRef.DFC_MisfDetVWhlReRiOORHi_C DFES_EnvRef.DFC_MisfDetVWhlReRiRatyHi_C DFES_EnvRef.DFC_MisfDetVWhlReRiRatyLo_C DFES_EnvRef.DFC_MisfDetVWhlReRiStuck_C DFES_EnvRef.DFC_MisfDetdVWhlFrntLePlaus_C DFES_EnvRef.DFC_MisfDetdVWhlFrntRiPlaus_C DFES_EnvRef.DFC_MisfDetdVWhlReLePlaus_C DFES_EnvRef.DFC_MisfDetdVWhlReRiPlaus_C DFES_EnvRef.DFC_PEnvSigRngMax_C DFES_EnvRef.DFC_PEnvSigRngMin_C DFES_EnvRef.DFC_StmFault_C DFES_EnvRef.DFC_StrtCtOffPth_C DFES_EnvRef.DFC_StrtCtlErr_C DFES_EnvRef.DFC_StrtFault_C DFES_EnvRef.DFC_StrtLckJudg1_C DFES_EnvRef.DFC_StrtLckJudg2_C DFES_EnvRef.DFC_StrtOL_C DFES_EnvRef.DFC_StrtOL2_C DFES_EnvRef.DFC_StrtSCB_C DFES_EnvRef.DFC_StrtSCB2_C DFES_EnvRef.DFC_StrtSCG_C DFES_EnvRef.DFC_StrtSCG2_C DFES_EnvRef.DFC_StrtStkRly1_C DFES_EnvRef.DFC_StrtStkRly2_C DFES_EnvRef.DFC_TEVEmax_C DFES_EnvRef.DFC_TEVEmin_C DFES_EnvRef.DFC_TEVEsig_C DFES_EnvRef.DFC_UegoHeatrPrfmncLoS1B1_C DFES_EnvRef.DFC_VehVAllPlaus_C DFES_EnvRef.DFC_VehVNCSnsrElecFailr_C DFES_EnvRef.DFC_VehVPlausCan_C DFES_EnvRef.DFC_VehVPlausFco_C DFES_EnvRef.DFC_VehVPlausPwr_C DFES_EnvRef.DFC_VehVPlausV2N_C DFES_EnvRef.DFC_VehVSpdSnsrAElecFailr_C DFES_EnvRef.DFC_VehVSpdSnsrBElecFailr_C DFES_EnvRef.DFC_ClthMax_C DFES_EnvRef.DFC_IgnClPs_DevComErr_C DFES_EnvRef.DFC_IgnClPs_LineOl_0_C DFES_EnvRef.DFC_IgnClPs_LineOl_1_C DFES_EnvRef.DFC_IgnClPs_LineOl_2_C DFES_EnvRef.DFC_IgnClPs_LineOl_3_C DFES_EnvRef.DFC_IgnClPs_LineScb_0_C DFES_EnvRef.DFC_IgnClPs_LineScb_1_C DFES_EnvRef.DFC_IgnClPs_LineScb_2_C DFES_EnvRef.DFC_IgnClPs_LineScb_3_C DFES_EnvRef.DFC_IgnClPs_LineScg_0_C DFES_EnvRef.DFC_IgnClPs_LineScg_1_C DFES_EnvRef.DFC_IgnClPs_LineScg_2_C DFES_EnvRef.DFC_IgnClPs_LineScg_3_C DFES_EnvRef.DFC_KRVEKOEVAB_C DFES_EnvRef.DFC_KRVEKOEVAB0_C DFES_EnvRef.DFC_KRVEKOEVAB1_C DFES_EnvRef.DFC_KRVEKOEVAB2_C DFES_EnvRef.DFC_KRVEKOEVAB3_C DFES_EnvRef.DFC_UegoSigEcuAsicS1B1_C DFES_EnvRef.DFC_UegoSigEcuComS1B1_C DFES_EnvRef.DFC_UegoSigSnsrS1B1_C DFES_EnvRef.DFC_UegoSigWireOlApesS1B1_C DFES_EnvRef.DFC_UegoSigWireOlIpeS1B1_C DFES_EnvRef.DFC_UegoSigWireOlReS1B1_C DFES_EnvRef.DFC_UegoSigWireRCmpS1B1_C DFES_EnvRef.DFC_UegoSigWireScbS1B1_C DFES_EnvRef.DFC_UegoSigWireScgS1B1_C DFES_EnvRef.DFC_AfsPhyRngHiB1_C DFES_EnvRef.DFC_AfsPhyRngLoB1_C DFES_EnvRef.DFC_AirCCmprOL_C DFES_EnvRef.DFC_AirCCmprOvrTemp_C DFES_EnvRef.DFC_AirCCmprSCB_C DFES_EnvRef.DFC_AirCCmprSCG_C DFES_EnvRef.DFC_AltErr_C DFES_EnvRef.DFC_BattUSRCMax_C DFES_EnvRef.DFC_BattUSRCMin_C DFES_EnvRef.DFC_ComChksTCU1_C DFES_EnvRef.DFC_ComChksTCU11_C DFES_EnvRef.DFC_ComChksTCU12_C DFES_EnvRef.DFC_ComChksTCU13_C DFES_EnvRef.DFC_ComChksTCU2_C DFES_EnvRef.DFC_ComChksTCU3_C DFES_EnvRef.DFC_ComChksTCU4_C DFES_EnvRef.DFC_ComCntTCU1_C DFES_EnvRef.DFC_ComCntTCU11_C DFES_EnvRef.DFC_ComCntTCU12_C DFES_EnvRef.DFC_ComCntTCU13_C DFES_EnvRef.DFC_ComCntTCU2_C DFES_EnvRef.DFC_ComCntTCU3_C DFES_EnvRef.DFC_ComCntTCU4_C DFES_EnvRef.DFC_ComTOutTCU01_C DFES_EnvRef.DFC_ComTOutTCU02_C DFES_EnvRef.DFC_ComTOutTCU1_C DFES_EnvRef.DFC_ComTOutTCU11_C DFES_EnvRef.DFC_ComTOutTCU12_C DFES_EnvRef.DFC_ComTOutTCU13_C DFES_EnvRef.DFC_ComTOutTCU14_C DFES_EnvRef.DFC_ComTOutTCU2_C DFES_EnvRef.DFC_ComTOutTCU3_C DFES_EnvRef.DFC_ComTOutTCU4_C DFES_EnvRef.DFC_DevLibBattUHi_C DFES_EnvRef.DFC_DevLibBattULo_C DFES_EnvRef.DFC_EGRVlvFailSafeActv_C DFES_EnvRef.DFC_EGRVlvGovDvtCld_C DFES_EnvRef.DFC_EGRVlvPhysSRCMax_C DFES_EnvRef.DFC_EGRVlvPhysSRCMin_C DFES_EnvRef.DFC_FanDIOOL_0_C DFES_EnvRef.DFC_FanDIOOL_1_C DFES_EnvRef.DFC_FanDIOOvrTemp_0_C DFES_EnvRef.DFC_FanDIOOvrTemp_1_C DFES_EnvRef.DFC_FanDIOSCB_0_C DFES_EnvRef.DFC_FanDIOSCB_1_C DFES_EnvRef.DFC_FanDIOSCG_0_C DFES_EnvRef.DFC_FanDIOSCG_1_C DFES_EnvRef.DFC_MRlyDcOL_C DFES_EnvRef.DFC_MRlyDcSCB_C DFES_EnvRef.DFC_MRlyDcSCG_C DFES_EnvRef.DFC_PSPOL_C DFES_EnvRef.DFC_PSPOvrTemp_C DFES_EnvRef.DFC_PSPSCB_C DFES_EnvRef.DFC_PSPSCG_C DFES_EnvRef.DFC_T50Err_C DFES_EnvRef.DFC_ThrVlvLoBattB1_C DFES_EnvRef.DFC_UegoSigOperPlausS1B1_C DFES_EnvRef.DFC_VehVPhysRngHi_C DFES_EnvRef.DFC_VehVSclOutOL_C DFES_EnvRef.DFC_VehVSclOutOT_C DFES_EnvRef.DFC_VehVSclOutSCB_C DFES_EnvRef.DFC_VehVSclOutSCG_C DFES_EnvRef.DFC_VehVSigFL_C DFES_EnvRef.DFC_VehVSigFR_C DFES_EnvRef.DFC_VehVSigRL_C DFES_EnvRef.DFC_VehVSigRR_C DFES_EnvRef.DFC_VehVSnsrARngHi_C DFES_EnvRef.DFC_VehVSnsrBRngHi_C DFES_EnvRef.DFC_VehVSpdRtyDiag_C DFES_EnvRef.DFC_DHFHD_C DFES_EnvRef.DFC_InjVlv_DI_DcDc_C DFES_EnvRef.DFC_InjVlv_DI_NoLd_0_C DFES_EnvRef.DFC_InjVlv_DI_NoLd_1_C DFES_EnvRef.DFC_InjVlv_DI_NoLd_2_C DFES_EnvRef.DFC_InjVlv_DI_NoLd_3_C DFES_EnvRef.DFC_InjVlv_DI_ScBnk_0_C DFES_EnvRef.DFC_InjVlv_DI_ScBnk_1_C DFES_EnvRef.DFC_InjVlv_DI_ScBnk_2_C DFES_EnvRef.DFC_InjVlv_DI_ScBnk_3_C DFES_EnvRef.DFC_InjVlv_DI_ScCyl_0_C DFES_EnvRef.DFC_InjVlv_DI_ScCyl_1_C DFES_EnvRef.DFC_InjVlv_DI_ScCyl_2_C DFES_EnvRef.DFC_InjVlv_DI_ScCyl_3_C DFES_EnvRef.DFC_InjVlv_DI_ScHsLs_0_C DFES_EnvRef.DFC_InjVlv_DI_ScHsLs_1_C DFES_EnvRef.DFC_InjVlv_DI_ScHsLs_2_C DFES_EnvRef.DFC_InjVlv_DI_ScHsLs_3_C DFES_EnvRef.DFC_MfPsDiaOpenLoad1_C DFES_EnvRef.DFC_MfPsDiaScHiS1_C DFES_EnvRef.DFC_MfPsDiaScHiSLowS1_C DFES_EnvRef.DFC_MfPsDiaScLowS1_C DFES_EnvRef.DFC_ACEvpTPhysRngHi_C DFES_EnvRef.DFC_ACEvpTPhysRngLo_C DFES_EnvRef.DFC_ACEvpTSRCMax_C DFES_EnvRef.DFC_ACEvpTSRCMin_C DFES_EnvRef.DFC_AfsRawSigRngHiB1_C DFES_EnvRef.DFC_AfsRawSigRngLoB1_C DFES_EnvRef.DFC_AfsSnsrErrB1_C DFES_EnvRef.DFC_AirCClntPAnaSRCMax_C DFES_EnvRef.DFC_AirCClntPAnaSRCMin_C DFES_EnvRef.DFC_AirCSwtNpl_C DFES_EnvRef.DFC_AirCSwtSig_C DFES_EnvRef.DFC_Brk_C DFES_EnvRef.DFC_BrkBstSensSCB_C DFES_EnvRef.DFC_BrkBstSensSCG_C DFES_EnvRef.DFC_BrkSig_C DFES_EnvRef.DFC_ClthSig_C DFES_EnvRef.DFC_EGRVlvCurrLim_C DFES_EnvRef.DFC_EGRVlvOL_C DFES_EnvRef.DFC_EGRVlvOvrTemp_C DFES_EnvRef.DFC_EGRVlvSCB_C DFES_EnvRef.DFC_EGRVlvSCG_C DFES_EnvRef.DFC_EGRVlvSRCMax_C DFES_EnvRef.DFC_EGRVlvSRCMin_C DFES_EnvRef.DFC_HLSDemOvhtEngLim_C DFES_EnvRef.DFC_OilPSwmpSRCMax_C DFES_EnvRef.DFC_OilPSwmpSRCMin_C DFES_EnvRef.DFC_PIntkVUsLineHiB1_C DFES_EnvRef.DFC_PIntkVUsLineLoB1_C DFES_EnvRef.DFC_VehVPhysRngLo_C DFES_EnvRef.DFC_VehVSigCan_C DFES_EnvRef.DFC_VehVSigCanSafe_C DFES_EnvRef.DFC_VlvLftFbOilPSnsrIntk11SRCMax_C DFES_EnvRef.DFC_VlvLftFbOilPSnsrIntk11SRCMin_C DFES_EnvRef.DFC_ClthNpl_C DFES_EnvRef.DFC_GbxPNPosnDrvCdn_C DFES_EnvRef.DFC_GbxPNPosnPlausy_C DFES_EnvRef.DFC_AfsSigErrLineHiB1_C DFES_EnvRef.DFC_AfsSigErrLineLoB1_C DFES_EnvRef.DFC_PEnvCcMax_C DFES_EnvRef.DFC_PEnvCcMin_C DFES_EnvRef.DFC_PEnvRngChkMax_C DFES_EnvRef.DFC_PEnvRngChkMin_C DFES_EnvRef.DFC_PEnvSnsrPlaus_C DFES_EnvRef.DFC_UEGOHeatrRlyPsOLS1B1_C DFES_EnvRef.DFC_UEGOHeatrRlyPsSCBS1B1_C DFES_EnvRef.DFC_UEGOHeatrRlyPsSCGS1B1_C DFES_EnvRef.DFC_UegoHeatrWireOlS1B1_C DFES_EnvRef.DFC_UegoHeatrWireScbS1B1_C DFES_EnvRef.DFC_UegoHeatrWireScgS1B1_C DFES_EnvRef.DFC_KnDetSens1PortAMax_C DFES_EnvRef.DFC_KnDetSens1PortAMin_C DFES_EnvRef.DFC_KnDetSens1PortBMax_C DFES_EnvRef.DFC_KnDetSens1PortBMin_C DFES_EnvRef.DFC_Clth2ONStuck_C DFES_EnvRef.DFC_Clth2ONStuckLdc_C DFES_EnvRef.DFC_Clth3ONStuckLdc_C DFES_EnvRef.DFC_Clth3ONStuckPostDrv_C DFES_EnvRef.DFC_Clth4ONStuck_C DFES_EnvRef.DFC_Clth4ONStuckLdc_C DFES_EnvRef.DFC_ComBCMUnit_C DFES_EnvRef.DFC_ComDLCTCU01_C DFES_EnvRef.DFC_ComDLCTCU02_C DFES_EnvRef.DFC_ComDLCTCU1_C DFES_EnvRef.DFC_ComDLCTCU11_C DFES_EnvRef.DFC_ComDLCTCU12_C DFES_EnvRef.DFC_ComDLCTCU13_C DFES_EnvRef.DFC_ComDLCTCU14_C DFES_EnvRef.DFC_ComDLCTCU2_C DFES_EnvRef.DFC_ComDLCTCU3_C DFES_EnvRef.DFC_ComDLCTCU4_C DFES_EnvRef.DFC_ComEPSUnit_C DFES_EnvRef.DFC_ComIDASBUnit_C DFES_EnvRef.DFC_ComIMGUnit_C DFES_EnvRef.DFC_ComMETUnit_C DFES_EnvRef.DFC_ComSRSUnit_C DFES_EnvRef.DFC_ComVSAUnit_C DFES_EnvRef.DFC_EbsSocFlt_C DFES_EnvRef.DFC_I14229VINErr_C DFES_EnvRef.DFC_InjCatHeatgErr_C DFES_EnvRef.DFC_InjSysMulInjDiagErr_C DFES_EnvRef.DFC_LLRHmax_C DFES_EnvRef.DFC_LLRHmin_C DFES_EnvRef.DFC_LLRHnpl_C DFES_EnvRef.DFC_LLRKHmax_C DFES_EnvRef.DFC_LLRKHmin_C DFES_EnvRef.DFC_LLRKHnpl_C DFES_EnvRef.DFC_LinACGUnit_C DFES_EnvRef.DFC_LinAEVUnit_C DFES_EnvRef.DFC_LinEBSUnit_C DFES_EnvRef.DFC_RoughRoad_C DFES_EnvRef.DFC_SiaEEPRdErr_C DFES_EnvRef.DFC_SiaEEPWrngCod_C DFES_EnvRef.DFC_UegoHeatrStrtS1B1_C DFES_EnvRef.DFC_BusDiagCANAPPLBusOff_C DFES_EnvRef.DFC_BusDiagCANCANCBusOff_C DFES_EnvRef.DFC_BusDiagCANVEHICLEBusOff_C DFES_EnvRef.DFC_RBA_IODIAGPWR_rba_IoExtCy329_SignalVltSply_0_C DFES_EnvRef.DFC_RBA_IODIAGPWR_rba_IoExtCy329_SignalVltSply_0OT_C DFES_EnvRef.DFC_RBA_IODIAGPWR_rba_IoExtCy329_SignalVltSply_0OV_C DFES_EnvRef.DFC_RBA_IODIAGPWR_rba_IoExtCy329_SignalVltSply_0SCG_C DFES_EnvRef.DFC_RBA_IODIAGPWR_rba_IoExtCy329_SignalVltSply_0UV_C DFES_EnvRef.DFC_RBA_IODIAGPWR_rba_IoExtCy329_SignalVltSply_1_C DFES_EnvRef.DFC_RBA_IODIAGPWR_rba_IoExtCy329_SignalVltSply_1OT_C DFES_EnvRef.DFC_RBA_IODIAGPWR_rba_IoExtCy329_SignalVltSply_1OV_C DFES_EnvRef.DFC_RBA_IODIAGPWR_rba_IoExtCy329_SignalVltSply_1SCG_C DFES_EnvRef.DFC_RBA_IODIAGPWR_rba_IoExtCy329_SignalVltSply_1UV_C DFES_EnvRef.DFC_RBA_IODIAGPWR_rba_IoExtCy329_SignalVltSply_2_C DFES_EnvRef.DFC_RBA_IODIAGPWR_rba_IoExtCy329_SignalVltSply_2OT_C DFES_EnvRef.DFC_RBA_IODIAGPWR_rba_IoExtCy329_SignalVltSply_2OV_C DFES_EnvRef.DFC_RBA_IODIAGPWR_rba_IoExtCy329_SignalVltSply_2SCG_C DFES_EnvRef.DFC_RBA_IODIAGPWR_rba_IoExtCy329_SignalVltSply_2UV_C DFES_EnvRef.DFC_CAN_E_TIMEOUT_C DFES_EnvRef.DFC_LIN_E_TIMEOUT_C DFES_EnvRef.DFC_MRlyOL_C DFES_EnvRef.DFC_MRlySCB_C DFES_EnvRef.DFC_MRlySCG_C DFES_EnvRef.DFC_rba_MultiStackTrace_Threshold_C DFES_EnvRef.DFC_BSWM_E_ACTION_FAILED_C DFES_EnvRef.DFC_BSWM_E_INTRPTQUEUE_FULL_C DFES_EnvRef.DFC_RBA_IOEXTLIB_KEEPALIVE_DRV_C DFES_EnvRef.DFC_RBA_IOEXTLIB_KEEPALIVE_INI_C DFES_EnvRef.DFC_rba_IoSigRtc_StopCounter_C DFES_EnvRef.DFC_rba_MRly_Diag_Stk_Event_C DFES_EnvRef.DFC_rba_MemDiag_MemReadErr_C DFES_EnvRef.DFC_rba_MemDiag_MemWrErr_C DFES_EnvRef.DFC_rba_SyC_IrrSwOffTrigEngRun_Event_C DFES_EnvRef.DFC_rba_T15_Diag_ComInVld_Event_C DFES_EnvRef.DFC_rba_T15_Diag_ComOff_HwOn_Event_C DFES_EnvRef.DFC_rba_T15_Diag_ComOn_HwOff_Event_C DFES_EnvRef.DFC_AAVmin_C DFES_EnvRef.DFC_AGRSUS_C DFES_EnvRef.DFC_AfsPlausDiagHi_C DFES_EnvRef.DFC_AfsPlausDiagLo_C DFES_EnvRef.DFC_AfsVrntDiagErrB1_C DFES_EnvRef.DFC_AppAllSnsrDfct_C DFES_EnvRef.DFC_BBKRnldg_C DFES_EnvRef.DFC_BBKRsyne_C DFES_EnvRef.DFC_BattUStdbyDiaOL_C DFES_EnvRef.DFC_BigLeakIntkMnfldEmiInfl_C DFES_EnvRef.DFC_BlkdLineTank_C DFES_EnvRef.DFC_BrkMnSwtContOnWarnLmp_C DFES_EnvRef.DFC_BrkMnSwtNotStpWarnLmp_C DFES_EnvRef.DFC_BrkRdntSwtContOnWarnLmp_C DFES_EnvRef.DFC_BrkRdntSwtNotStpWarnLmp_C DFES_EnvRef.DFC_CEngDsTColdStrtMax_C DFES_EnvRef.DFC_CEngDsTColdStrtMin_C DFES_EnvRef.DFC_CEngDsTImps_C DFES_EnvRef.DFC_CEngDsTPlausHSC_C DFES_EnvRef.DFC_CEngDsTPlausLSC_C DFES_EnvRef.DFC_CEngDsTPlausSTC_C DFES_EnvRef.DFC_CEngDsTSRCMax_C DFES_EnvRef.DFC_CEngDsTSRCMin_C DFES_EnvRef.DFC_CEngDsTSig_C DFES_EnvRef.DFC_CEngUsTColdStrtMax_C DFES_EnvRef.DFC_CEngUsTColdStrtMin_C DFES_EnvRef.DFC_CEngUsTLooseCnctn_C DFES_EnvRef.DFC_CEngUsTSRCMax_C DFES_EnvRef.DFC_CEngUsTSRCMin_C DFES_EnvRef.DFC_ComDCDCACCFailr_C DFES_EnvRef.DFC_DCDCFltDet_C DFES_EnvRef.DFC_DKRSA_C DFES_EnvRef.DFC_DKVSmax_C DFES_EnvRef.DFC_DKnpl_C DFES_EnvRef.DFC_DSKVRmax_C DFES_EnvRef.DFC_DSKVRmin_C DFES_EnvRef.DFC_DSKVRnpl_C DFES_EnvRef.DFC_DSKVRsig_C DFES_EnvRef.DFC_DSKVSsig_C DFES_EnvRef.DFC_DSSmax_C DFES_EnvRef.DFC_DSTDmax_C DFES_EnvRef.DFC_DSTEmax_C DFES_EnvRef.DFC_DSTEmin_C DFES_EnvRef.DFC_DSTOFmax_C DFES_EnvRef.DFC_DSTRmax_C DFES_EnvRef.DFC_DSTRmin_C DFES_EnvRef.DFC_DSTRnpl_C DFES_EnvRef.DFC_DSTRsig_C DFES_EnvRef.DFC_DSTTI_C DFES_EnvRef.DFC_DSUmax_C DFES_EnvRef.DFC_DiagCpv1DteskLoLoadStuckClsd_C DFES_EnvRef.DFC_DiagCpv1DteskLoLoadStuckOpen_C DFES_EnvRef.DFC_EGRVlvDrftClsd_C DFES_EnvRef.DFC_EGRVlvDrftOpn_C DFES_EnvRef.DFC_EGRVlvJamVlvClsd_C DFES_EnvRef.DFC_EGRVlvJamVlvOpn_C DFES_EnvRef.DFC_EGRVlvSprgBrk_C DFES_EnvRef.DFC_EGRVlvTempMdlEEPErr_C DFES_EnvRef.DFC_EGRVlvTmpErr_C DFES_EnvRef.DFC_EGSDUS2B1LtrDly_C DFES_EnvRef.DFC_EGSDUS2B1LtrPT1_C DFES_EnvRef.DFC_EGSDUS2B1RtlDly_C DFES_EnvRef.DFC_EGSDUS2B1RtlPT1_C DFES_EnvRef.DFC_EGSDUS2B1TarLean_C DFES_EnvRef.DFC_EGSDUS2B1TarRich_C DFES_EnvRef.DFC_EONVmax_C DFES_EnvRef.DFC_ETAKHLmax_C DFES_EnvRef.DFC_ETAKHTmax_C DFES_EnvRef.DFC_ETHSEmax_C DFES_EnvRef.DFC_ETHSEmin_C DFES_EnvRef.DFC_ETHSFmax_C DFES_EnvRef.DFC_ETHSFmin_C DFES_EnvRef.DFC_ETHSFsig_C DFES_EnvRef.DFC_ETHSNPWmax_C DFES_EnvRef.DFC_ETHSNPWmin_C DFES_EnvRef.DFC_ETHSNPWsig_C DFES_EnvRef.DFC_ETHSPLnpl_C DFES_EnvRef.DFC_ETHSTPLnpl_C DFES_EnvRef.DFC_EngICO_C DFES_EnvRef.DFC_EngPrtOvrSpdMon_C DFES_EnvRef.DFC_EpmCaSI1ErrSig_C DFES_EnvRef.DFC_EpmCaSI1MntErr_C DFES_EnvRef.DFC_EpmCaSI1NoSigMax_C DFES_EnvRef.DFC_EpmCaSI1NoSigMin_C DFES_EnvRef.DFC_EpmCaSI1OfsErr_C DFES_EnvRef.DFC_EpmCrSDGI_C DFES_EnvRef.DFC_EpmCrSErrSig_C DFES_EnvRef.DFC_EpmCrSNoSig_C DFES_EnvRef.DFC_EtaEngIdleNonCsers_C DFES_EnvRef.DFC_EtaEngPtlNonCsers_C DFES_EnvRef.DFC_FRAmax_C DFES_EnvRef.DFC_FRAmin_C DFES_EnvRef.DFC_FSTEmax_C DFES_EnvRef.DFC_FSTEmin_C DFES_EnvRef.DFC_FSTRmax_C DFES_EnvRef.DFC_FSTRmin_C DFES_EnvRef.DFC_FSTRnpl_C DFES_EnvRef.DFC_FSTmax_C DFES_EnvRef.DFC_FTDLAmax_C DFES_EnvRef.DFC_FTDLAmin_C DFES_EnvRef.DFC_FuPHiSnsrEleclmax_C DFES_EnvRef.DFC_FuPHiSnsrEleclmin_C DFES_EnvRef.DFC_FuPHiSnsrEleclnpl_C DFES_EnvRef.DFC_FuPHiSnsrURngMax_C DFES_EnvRef.DFC_FuPHiSnsrURngMin_C DFES_EnvRef.DFC_FuSnsrPhyRngMaxErr_C DFES_EnvRef.DFC_FuSnsrPhyRngMinErr_C DFES_EnvRef.DFC_GEVlvLockPinDiagIntkB1_C DFES_EnvRef.DFC_GEVlvPhaSlowIntkB1_C DFES_EnvRef.DFC_GEVlvPhaTargIntkB1_C DFES_EnvRef.DFC_GbxRvsSwtStk_C DFES_EnvRef.DFC_HDRKHmax_C DFES_EnvRef.DFC_HDRKHmin_C DFES_EnvRef.DFC_HDRPLmax_C DFES_EnvRef.DFC_HDRPLmin_C DFES_EnvRef.DFC_HDRmax_C DFES_EnvRef.DFC_HDRmin_C DFES_EnvRef.DFC_HEGOS2B1ElecMax_C DFES_EnvRef.DFC_HEGOS2B1ElecMin_C DFES_EnvRef.DFC_HEGOS2B1ElecSig_C DFES_EnvRef.DFC_HEGOS2B1HtgNpl_C DFES_EnvRef.DFC_HEV00max_C DFES_EnvRef.DFC_HEV01max_C DFES_EnvRef.DFC_HEV02max_C DFES_EnvRef.DFC_HEV03max_C DFES_EnvRef.DFC_HEVE0max_C DFES_EnvRef.DFC_HEVE1max_C DFES_EnvRef.DFC_HFMmax_C DFES_EnvRef.DFC_HiPSysHiPMaxLimExcdd_C DFES_EnvRef.DFC_IVGdiCtlCvoErrMax_0_C DFES_EnvRef.DFC_IVGdiCtlCvoErrMax_1_C DFES_EnvRef.DFC_IVGdiCtlCvoErrMax_2_C DFES_EnvRef.DFC_IVGdiCtlCvoErrMax_3_C DFES_EnvRef.DFC_IVGdiCtlCvoErrMin_0_C DFES_EnvRef.DFC_IVGdiCtlCvoErrMin_1_C DFES_EnvRef.DFC_IVGdiCtlCvoErrMin_2_C DFES_EnvRef.DFC_IVGdiCtlCvoErrMin_3_C DFES_EnvRef.DFC_IVGdiCtlCvoErrMinMax_C DFES_EnvRef.DFC_IVGdiCtlCvoSigPlausErrSmrCdn_C DFES_EnvRef.DFC_IVGdiCtl_CvoErr_C DFES_EnvRef.DFC_IVGdiCtl_CvoSigPlaus_0_C DFES_EnvRef.DFC_IVGdiCtl_CvoSigPlaus_1_C DFES_EnvRef.DFC_IVGdiCtl_CvoSigPlaus_2_C DFES_EnvRef.DFC_IVGdiCtl_CvoSigPlaus_3_C DFES_EnvRef.DFC_IntkAirTAirFltDsCrssMax_C DFES_EnvRef.DFC_IntkAirTAirFltDsCrssMin_C DFES_EnvRef.DFC_IntkAirTAirFltDsHSCMax_C DFES_EnvRef.DFC_IntkAirTAirFltDsImps_C DFES_EnvRef.DFC_IntkAirTAirFltDsPRCMax_C DFES_EnvRef.DFC_IntkAirTAirFltDsPRCMin_C DFES_EnvRef.DFC_IntkAirTAirFltDsSRCMax_C DFES_EnvRef.DFC_IntkAirTAirFltDsSRCMin_C DFES_EnvRef.DFC_IntkAirTAirFltDsSTC_C DFES_EnvRef.DFC_IntkAirTIntkMnfldCrssMax_C DFES_EnvRef.DFC_IntkAirTIntkMnfldCrssMin_C DFES_EnvRef.DFC_IntkAirTIntkMnfldHSCMax_C DFES_EnvRef.DFC_IntkAirTIntkMnfldImps_C DFES_EnvRef.DFC_IntkAirTIntkMnfldPRCMax_C DFES_EnvRef.DFC_IntkAirTIntkMnfldPRCMin_C DFES_EnvRef.DFC_IntkAirTIntkMnfldSRCMax_C DFES_EnvRef.DFC_IntkAirTIntkMnfldSRCMin_C DFES_EnvRef.DFC_IntkAirTIntkMnfldSTC_C DFES_EnvRef.DFC_KRREGRLMX_C DFES_EnvRef.DFC_KRVEKOCVLCI_C DFES_EnvRef.DFC_KRVEKOENCHMT_C DFES_EnvRef.DFC_KRVEKOENCHMT0_C DFES_EnvRef.DFC_KRVEKOENCHMT1_C DFES_EnvRef.DFC_KRVEKOENCHMT2_C DFES_EnvRef.DFC_KRVEKOENCHMT3_C DFES_EnvRef.DFC_KRVEKOENCHMT4_C DFES_EnvRef.DFC_KRVEKOENCHMT5_C DFES_EnvRef.DFC_KRVEKOENCHMT6_C DFES_EnvRef.DFC_KRVEKOENCHMT7_C DFES_EnvRef.DFC_KRVEKORLMX_C DFES_EnvRef.DFC_KRVEKORLMXL_C DFES_EnvRef.DFC_KS1max_C DFES_EnvRef.DFC_KS1min_C DFES_EnvRef.DFC_LMmax_C DFES_EnvRef.DFC_LZSRnpl_C DFES_EnvRef.DFC_LamDynDiagS1B1_C DFES_EnvRef.DFC_LeakIntkMnfldEmiInfl_C DFES_EnvRef.DFC_LinFrameErrDCDC_C DFES_EnvRef.DFC_LinOverrunErrDCDC_C DFES_EnvRef.DFC_MD00max_C DFES_EnvRef.DFC_MDBmax_C DFES_EnvRef.DFC_MDCat_C DFES_EnvRef.DFC_MDCatCrit_C DFES_EnvRef.DFC_MDCatCurr_C DFES_EnvRef.DFC_MDCyl_0_C DFES_EnvRef.DFC_MDCyl_1_C DFES_EnvRef.DFC_MDCyl_2_C DFES_EnvRef.DFC_MDCyl_3_C DFES_EnvRef.DFC_MDEmi_C DFES_EnvRef.DFC_MDEmiStrt_C DFES_EnvRef.DFC_MDFco_C DFES_EnvRef.DFC_MDMpl_C DFES_EnvRef.DFC_MDSegTiAdpn_C DFES_EnvRef.DFC_MDmax_C DFES_EnvRef.DFC_MFuOilMax_C DFES_EnvRef.DFC_MOXEMM_SMU_ALM0_0_C DFES_EnvRef.DFC_MOXEMM_SMU_ALM0_1_C DFES_EnvRef.DFC_MOXEMM_SMU_ALM0_10_C DFES_EnvRef.DFC_MOXEMM_SMU_ALM0_11_C DFES_EnvRef.DFC_MOXEMM_SMU_ALM0_13_C DFES_EnvRef.DFC_MOXEMM_SMU_ALM0_14_C DFES_EnvRef.DFC_MOXEMM_SMU_ALM0_2_C DFES_EnvRef.DFC_MOXEMM_SMU_ALM0_22_C DFES_EnvRef.DFC_MOXEMM_SMU_ALM0_23_C DFES_EnvRef.DFC_MOXEMM_SMU_ALM0_4_C DFES_EnvRef.DFC_MOXEMM_SMU_ALM0_5_C DFES_EnvRef.DFC_MOXEMM_SMU_ALM0_7_C DFES_EnvRef.DFC_MOXEMM_SMU_ALM0_8_C DFES_EnvRef.DFC_MOXEMM_SMU_ALM10_16_C DFES_EnvRef.DFC_MOXEMM_SMU_ALM10_17_C DFES_EnvRef.DFC_MOXEMM_SMU_ALM10_21_C DFES_EnvRef.DFC_MOXEMM_SMU_ALM11_0_C DFES_EnvRef.DFC_MOXEMM_SMU_ALM11_1_C DFES_EnvRef.DFC_MOXEMM_SMU_ALM11_2_C DFES_EnvRef.DFC_MOXEMM_SMU_ALM11_3_C DFES_EnvRef.DFC_MOXEMM_SMU_ALM11_4_C DFES_EnvRef.DFC_MOXEMM_SMU_ALM11_5_C DFES_EnvRef.DFC_MOXEMM_SMU_ALM11_8_C DFES_EnvRef.DFC_MOXEMM_SMU_ALM11_9_C DFES_EnvRef.DFC_MOXEMM_SMU_ALM1_0_C DFES_EnvRef.DFC_MOXEMM_SMU_ALM1_1_C DFES_EnvRef.DFC_MOXEMM_SMU_ALM1_10_C DFES_EnvRef.DFC_MOXEMM_SMU_ALM1_11_C DFES_EnvRef.DFC_MOXEMM_SMU_ALM1_13_C DFES_EnvRef.DFC_MOXEMM_SMU_ALM1_14_C DFES_EnvRef.DFC_MOXEMM_SMU_ALM1_2_C DFES_EnvRef.DFC_MOXEMM_SMU_ALM1_22_C DFES_EnvRef.DFC_MOXEMM_SMU_ALM1_23_C DFES_EnvRef.DFC_MOXEMM_SMU_ALM1_4_C DFES_EnvRef.DFC_MOXEMM_SMU_ALM1_5_C DFES_EnvRef.DFC_MOXEMM_SMU_ALM1_7_C DFES_EnvRef.DFC_MOXEMM_SMU_ALM1_8_C DFES_EnvRef.DFC_MOXEMM_SMU_ALM21_0_C DFES_EnvRef.DFC_MOXEMM_SMU_ALM21_16_C DFES_EnvRef.DFC_MOXEMM_SMU_ALM21_3_C DFES_EnvRef.DFC_MOXEMM_SMU_ALM2_1_C DFES_EnvRef.DFC_MOXEMM_SMU_ALM2_10_C DFES_EnvRef.DFC_MOXEMM_SMU_ALM2_11_C DFES_EnvRef.DFC_MOXEMM_SMU_ALM2_13_C DFES_EnvRef.DFC_MOXEMM_SMU_ALM2_14_C DFES_EnvRef.DFC_MOXEMM_SMU_ALM2_22_C DFES_EnvRef.DFC_MOXEMM_SMU_ALM2_23_C DFES_EnvRef.DFC_MOXEMM_SMU_ALM2_4_C DFES_EnvRef.DFC_MOXEMM_SMU_ALM2_5_C DFES_EnvRef.DFC_MOXEMM_SMU_ALM2_7_C DFES_EnvRef.DFC_MOXEMM_SMU_ALM2_8_C DFES_EnvRef.DFC_MOXEMM_SMU_ALM6_0_C DFES_EnvRef.DFC_MOXEMM_SMU_ALM6_11_C DFES_EnvRef.DFC_MOXEMM_SMU_ALM6_12_C DFES_EnvRef.DFC_MOXEMM_SMU_ALM6_14_C DFES_EnvRef.DFC_MOXEMM_SMU_ALM6_15_C DFES_EnvRef.DFC_MOXEMM_SMU_ALM6_17_C DFES_EnvRef.DFC_MOXEMM_SMU_ALM6_18_C DFES_EnvRef.DFC_MOXEMM_SMU_ALM6_20_C DFES_EnvRef.DFC_MOXEMM_SMU_ALM6_21_C DFES_EnvRef.DFC_MOXEMM_SMU_ALM6_25_C DFES_EnvRef.DFC_MOXEMM_SMU_ALM6_4_C DFES_EnvRef.DFC_MOXEMM_SMU_ALM6_5_C DFES_EnvRef.DFC_MOXEMM_SMU_ALM6_7_C DFES_EnvRef.DFC_MOXEMM_SMU_ALM6_8_C DFES_EnvRef.DFC_MOXEMM_SMU_ALM7_1_C DFES_EnvRef.DFC_MOXEMM_SMU_ALM7_12_C DFES_EnvRef.DFC_MOXEMM_SMU_ALM7_13_C DFES_EnvRef.DFC_MOXEMM_SMU_ALM7_14_C DFES_EnvRef.DFC_MOXEMM_SMU_ALM7_15_C DFES_EnvRef.DFC_MOXEMM_SMU_ALM7_16_C DFES_EnvRef.DFC_MOXEMM_SMU_ALM7_17_C DFES_EnvRef.DFC_MOXEMM_SMU_ALM7_2_C DFES_EnvRef.DFC_MOXEMM_SMU_ALM7_20_C DFES_EnvRef.DFC_MOXEMM_SMU_ALM7_25_C DFES_EnvRef.DFC_MOXEMM_SMU_ALM7_26_C DFES_EnvRef.DFC_MOXEMM_SMU_ALM7_28_C DFES_EnvRef.DFC_MOXEMM_SMU_ALM7_29_C DFES_EnvRef.DFC_MOXEMM_SMU_ALM7_30_C DFES_EnvRef.DFC_MOXEMM_SMU_ALM7_31_C DFES_EnvRef.DFC_MOXEMM_SMU_ALM8_0_C DFES_EnvRef.DFC_MOXEMM_SMU_ALM8_1_C DFES_EnvRef.DFC_MOXEMM_SMU_ALM8_10_C DFES_EnvRef.DFC_MOXEMM_SMU_ALM8_11_C DFES_EnvRef.DFC_MOXEMM_SMU_ALM8_12_C DFES_EnvRef.DFC_MOXEMM_SMU_ALM8_16_C DFES_EnvRef.DFC_MOXEMM_SMU_ALM8_18_C DFES_EnvRef.DFC_MOXEMM_SMU_ALM8_2_C DFES_EnvRef.DFC_MOXEMM_SMU_ALM8_3_C DFES_EnvRef.DFC_MOXEMM_SMU_ALM8_31_C DFES_EnvRef.DFC_MOXEMM_SMU_ALM8_4_C DFES_EnvRef.DFC_MOXEMM_SMU_ALM9_0_C DFES_EnvRef.DFC_MOXEMM_SMU_ALM9_15_C DFES_EnvRef.DFC_MOXEMM_SMU_ALM9_3_C DFES_EnvRef.DFC_MoCADCNTP_C DFES_EnvRef.DFC_MoCADCTst_C DFES_EnvRef.DFC_MoCSOPICO_C DFES_EnvRef.DFC_MoFAPP_C DFES_EnvRef.DFC_MoFAirFilgPrdc_C DFES_EnvRef.DFC_MoFAirFlCtOffGdi_C DFES_EnvRef.DFC_MoFAirFlCylGdi_C DFES_EnvRef.DFC_MoFAirFlFF_C DFES_EnvRef.DFC_MoFAirFlIn_C DFES_EnvRef.DFC_MoFAirFlMixCtlGdiChkAirFl_C DFES_EnvRef.DFC_MoFAirFlMixCtlGdiChkCtrl_C DFES_EnvRef.DFC_MoFAirFlMode_C DFES_EnvRef.DFC_MoFESpd_C DFES_EnvRef.DFC_MoFIACo_C DFES_EnvRef.DFC_MoFICOL1_C DFES_EnvRef.DFC_MoFICOL2_C DFES_EnvRef.DFC_MoFStrt_C DFES_EnvRef.DFC_MoFTrqCmp_C DFES_EnvRef.DFC_MoFTrqCmpMax_C DFES_EnvRef.DFC_MoFTrqCmpMin_C DFES_EnvRef.DFC_MoFVarPostBldSel_C DFES_EnvRef.DFC_MoXEMMHwLTMCUFW_C DFES_EnvRef.DFC_MoXEMMHwLTMonBIST_C DFES_EnvRef.DFC_MoXEMMHwLTRegMonTest_C DFES_EnvRef.DFC_MoXEMMHwLTStbySMUAlvTest_C DFES_EnvRef.DFC_MoXEMMHwLTTempSens_C DFES_EnvRef.DFC_MoXEMMHwLTUCBCfg_C DFES_EnvRef.DFC_NWSEmax_C DFES_EnvRef.DFC_NWSmax_C DFES_EnvRef.DFC_OCWDAABEActv_C DFES_EnvRef.DFC_OCWDACom_C DFES_EnvRef.DFC_OCWDAErrPin_C DFES_EnvRef.DFC_OCWDAOvrVltg_C DFES_EnvRef.DFC_ORAmax_C DFES_EnvRef.DFC_ORAmin_C /end DEF_CHARACTERISTIC
 FUNCTION_VERSION "30000.73.0_2.0.0" /end FUNCTION
/begin COMPU_METHOD DFES_EnvTabVerb "" TAB_VERB "%6.3" "-" COMPU_TAB_REF DFES_EnvTabVerb /end COMPU_METHOD
/begin COMPU_VTAB DFES_EnvTabVerb "" TAB_VERB 2 0 "xSet1" 1 "xSet2" DEFAULT_VALUE "---" /end COMPU_VTAB
/begin RECORD_LAYOUT Val_Wu8 FNC_VALUES 1 UBYTE COLUMN_DIR DIRECT /end RECORD_LAYOUT
/end MODULE
/end PROJECT
