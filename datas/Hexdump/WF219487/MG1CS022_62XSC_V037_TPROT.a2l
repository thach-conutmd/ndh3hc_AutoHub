ASAP2_VERSION 1 60
/begin PROJECT MG1CS022 "MG1CS022"
/begin HEADER "" VERSION "MG1CS022_62XSC_V037_TPROT" PROJECT_NO MG1CS022 /end HEADER
/begin MODULE DIM ""
/begin MOD_COMMON "" BYTE_ORDER MSB_LAST ALIGNMENT_BYTE 1 ALIGNMENT_WORD 2 ALIGNMENT_LONG 4 ALIGNMENT_INT64 4 ALIGNMENT_FLOAT32_IEEE 4 ALIGNMENT_FLOAT64_IEEE 4 DATA_SIZE 32 /end MOD_COMMON
/begin AXIS_PTS InjSys_nEng10_AX "base point distribution for engine speed with 10 base points" 0x80557FE0 Epm_nEng RB_Axis_S16 16383.50 EngN 10 0.00 16383.50 FORMAT "%8.2" EXTENDED_LIMITS -16384.00 16383.50 DEPOSIT ABSOLUTE /end AXIS_PTS
/begin AXIS_PTS InjSys_nEng12Hpx_AX "Base point distribution for engine speed HPx with 12 base points" 0x80557FF6 Epm_nEng RB_Axis_S16 16383.50 EngN 12 0.00 16383.50 FORMAT "%8.2" EXTENDED_LIMITS -16384.00 16383.50 DEPOSIT ABSOLUTE /end AXIS_PTS
/begin AXIS_PTS InjSys_nEng12HspVers2_AX "base point distribution for engine speed with 12 base points (Version 2 HSP Mode)" 0x80558010 Epm_nEng RB_Axis_S16 16383.50 EngN 12 0.00 16383.50 FORMAT "%8.2" EXTENDED_LIMITS -16384.00 16383.50 DEPOSIT ABSOLUTE /end AXIS_PTS
/begin AXIS_PTS InjSys_nEng12Hsp_AX "base point distribution for engine speed with 12 base points (HSP Mode)" 0x8055802A Epm_nEng RB_Axis_S16 16383.50 EngN 12 0.00 16383.50 FORMAT "%8.2" EXTENDED_LIMITS -16384.00 16383.50 DEPOSIT ABSOLUTE /end AXIS_PTS
/begin AXIS_PTS InjSys_nEng12Vers2_AX "base point distribution for engine speed with 10 base points (version 2)" 0x80558044 Epm_nEng RB_Axis_S16 16383.50 EngN 12 0.00 16383.50 FORMAT "%8.2" EXTENDED_LIMITS -16384.00 16383.50 DEPOSIT ABSOLUTE /end AXIS_PTS
/begin AXIS_PTS InjSys_nEng12_AX "base point distribution for engine speed with 12 base points" 0x8055805E Epm_nEng RB_Axis_S16 16383.50 EngN 12 0.00 16383.50 FORMAT "%8.2" EXTENDED_LIMITS -16384.00 16383.50 DEPOSIT ABSOLUTE /end AXIS_PTS
/begin AXIS_PTS InjSys_nrInj04_AX "Base point distribution number of injections with 4 base points" 0x80558078 InjSys_nrInjLimdLoc RB_Axis_U16 65535.00 dez 4 0.00 65535.00 FORMAT "%8.2" DEPOSIT ABSOLUTE /end AXIS_PTS
/begin CHARACTERISTIC InjSys_P1APPL.agBas_C "class instance packet 1 for calibration / base angle" VALUE 0x80562BEC RB_Val_Ws16 1535.977 kw_q0p0234 -768.0000 767.9766 FORMAT "%8.4" /end CHARACTERISTIC
/begin CHARACTERISTIC InjSys_P1APPL.facSpltAux1_C "class instance packet 1 for calibration / split factor auxiliary injection 1" VALUE 0x80562BEE RB_Val_Wu8 0.9961 fak_ub_b1 0.00 0.9961 /end CHARACTERISTIC
/begin CHARACTERISTIC InjSys_P1APPL.facSpltAux2_C "class instance packet 1 for calibration / split factor auxiliary injection 2" VALUE 0x80562BEF RB_Val_Wu8 0.9961 fak_ub_b1 0.00 0.9961 /end CHARACTERISTIC
/begin CHARACTERISTIC InjSys_P1APPL.facSpltAux_C "class instance packet 1 for calibration / split factor auxiliary injections" VALUE 0x80562BF0 RB_Val_Wu8 0.9961 fak_ub_b1 0.00 0.9961 /end CHARACTERISTIC
/begin CHARACTERISTIC InjSys_P1APPL.flgAbsltSplt_C "class instance packet 1 for calibration / condition split with absolute fuel mass" VALUE 0x80562BF1 RB_Val_Wu8 1.00000000000 B_TRUE 0.00 1.00000000000 FORMAT "%13.11" /end CHARACTERISTIC
/begin CHARACTERISTIC InjSys_P1APPL.flgAgAux_C "class instance packet 1 for calibration / condition angle addressing for auxiliary injections" VALUE 0x80562BF2 RB_Val_Wu8 1.00000000000 B_TRUE 0.00 1.00000000000 FORMAT "%13.11" /end CHARACTERISTIC
/begin CHARACTERISTIC InjSys_P1APPL.flgSpltAux_C "class instance packet 1 for calibration / condition split auxiliary injections with facSpltAux_C" VALUE 0x80562BF3 RB_Val_Wu8 1.00000000000 B_TRUE 0.00 1.00000000000 FORMAT "%13.11" /end CHARACTERISTIC
/begin CHARACTERISTIC InjSys_P1APPL.ratFuMAux1_C "class instance packet 1 for calibration / relative fuel mass auxiliary injection 1" VALUE 0x80562BF4 RB_Val_Wu16 3071.953 rel_uw_b3072 0.00 3071.953 FORMAT "%8.3" /end CHARACTERISTIC
/begin CHARACTERISTIC InjSys_P1APPL.ratFuMAux2_C "class instance packet 1 for calibration / relative fuel mass auxiliary injection 2" VALUE 0x80562BF6 RB_Val_Wu16 3071.953 rel_uw_b3072 0.00 3071.953 FORMAT "%8.3" /end CHARACTERISTIC
/begin CHARACTERISTIC InjSys_P1APPL.ratFuMBas_C "class instance packet 1 for calibration / relative fuel mass base injection" VALUE 0x80562BF8 RB_Val_Wu16 3071.953 rel_uw_b3072 0.00 3071.953 FORMAT "%8.3" /end CHARACTERISTIC
/begin CHARACTERISTIC InjSys_P1APPL.stAgEnd_C "class instance packet 1 for calibration / state end angle coupled" VALUE 0x80562BFA RB_Val_Wu8 255.0 dez 0.00 255.0 FORMAT "%5.1" /end CHARACTERISTIC
/begin CHARACTERISTIC InjSys_P1APPL.tiBreakAux1_C "class instance packet 1 for calibration / break time auxiliary injection 1" VALUE 0x80562BFC RB_Val_Ws16 1310.680 t_q0p04_ms 0.00 1310.680 FORMAT "%8.3" EXTENDED_LIMITS -1310.720 1310.680 /end CHARACTERISTIC
/begin CHARACTERISTIC InjSys_P1APPL.tiBreakAux2_C "class instance packet 1 for calibration / break time auxiliary injection 2" VALUE 0x80562BFE RB_Val_Ws16 1310.680 t_q0p04_ms 0.00 1310.680 FORMAT "%8.3" EXTENDED_LIMITS -1310.720 1310.680 /end CHARACTERISTIC
/begin CHARACTERISTIC InjSys_P1V1I1_HO.agBasTPistColdVers2_GM "class instance packet 1 variant 1 / base angle at cold piston temperature (version 2)" MAP 0x80562C04 RB_MapGroup_U8 382.5 kw_q1p5 0.00 382.5 FORMAT "%5.1"
 /begin AXIS_DESCR COM_AXIS Epm_nEng EngN 12 0.00 16383.50 FORMAT "%8.2" EXTENDED_LIMITS -16384.00 16383.50 AXIS_PTS_REF InjSys_nEng12Vers2_AX /end AXIS_DESCR
 /begin AXIS_DESCR COM_AXIS InjSys_ratAirMAgSpVers2AxisInp rel_uw_q0p0234 12 0.00 1535.977 FORMAT "%8.3" AXIS_PTS_REF InjSys_ratAirM12AgSpVers2_AX /end AXIS_DESCR
/end CHARACTERISTIC
/begin CHARACTERISTIC InjSys_P1V1I1_HO.agBasTPistCold_GM "class instance packet 1 variant 1 / base angle at cold piston temperature" MAP 0x80562C94 RB_MapGroup_U8 382.5 kw_q1p5 0.00 382.5 FORMAT "%5.1"
 /begin AXIS_DESCR COM_AXIS Epm_nEng EngN 12 0.00 16383.50 FORMAT "%8.2" EXTENDED_LIMITS -16384.00 16383.50 AXIS_PTS_REF InjSys_nEng12_AX /end AXIS_DESCR
 /begin AXIS_DESCR COM_AXIS InjSys_ratAirMAgSpAxisInp rel_uw_q0p0234 12 0.00 1535.977 FORMAT "%8.3" AXIS_PTS_REF InjSys_ratAirM12AgSp_AX /end AXIS_DESCR
/end CHARACTERISTIC
/begin CHARACTERISTIC InjSys_P1V1I1_HO.agBasTPistWrmVers2_GM "class instance packet 1 variant 1 / base angle for interpolation Warm TSA mode (Version 2)" MAP 0x80562D24 RB_MapGroup_U8 382.5 kw_q1p5 0.00 382.5 FORMAT "%5.1"
 /begin AXIS_DESCR COM_AXIS Epm_nEng EngN 12 0.00 16383.50 FORMAT "%8.2" EXTENDED_LIMITS -16384.00 16383.50 AXIS_PTS_REF InjSys_nEng12Vers2_AX /end AXIS_DESCR
 /begin AXIS_DESCR COM_AXIS InjSys_ratAirMAgSpVers2AxisInp rel_uw_q0p0234 12 0.00 1535.977 FORMAT "%8.3" AXIS_PTS_REF InjSys_ratAirM12AgSpVers2_AX /end AXIS_DESCR
/end CHARACTERISTIC
/begin CHARACTERISTIC InjSys_P1V1I1_HO.agBasTPistWrm_GM "class instance packet 1 variant 1 / base angle for interpolation Warm TSA mode" MAP 0x80562DB4 RB_MapGroup_U8 382.5 kw_q1p5 0.00 382.5 FORMAT "%5.1"
 /begin AXIS_DESCR COM_AXIS Epm_nEng EngN 12 0.00 16383.50 FORMAT "%8.2" EXTENDED_LIMITS -16384.00 16383.50 AXIS_PTS_REF InjSys_nEng12_AX /end AXIS_DESCR
 /begin AXIS_DESCR COM_AXIS InjSys_ratAirMAgSpAxisInp rel_uw_q0p0234 12 0.00 1535.977 FORMAT "%8.3" AXIS_PTS_REF InjSys_ratAirM12AgSp_AX /end AXIS_DESCR
/end CHARACTERISTIC
/begin CHARACTERISTIC InjSys_P1V1I1_HO.agBgnColdExtdEthnl_GM "class instance packet 1 variant 1 / base angle cold extended ethanol dependent" MAP 0x80562E44 RB_MapGroup_U8 191.3 kw_q0p75_o240 240.0 431.3 FORMAT "%5.1"
 /begin AXIS_DESCR COM_AXIS Epm_nEng EngN 12 0.00 16383.50 FORMAT "%8.2" EXTENDED_LIMITS -16384.00 16383.50 AXIS_PTS_REF InjSys_nEng12_AX /end AXIS_DESCR
 /begin AXIS_DESCR COM_AXIS InjSys_ratAirMAxisInp rel_uw_q0p0234 12 0.00 1535.977 FORMAT "%8.3" AXIS_PTS_REF InjSys_ratAirM12_AX /end AXIS_DESCR
/end CHARACTERISTIC
/begin CHARACTERISTIC InjSys_P1V1I1_HO.agBgnColdExtd_GM "class instance packet 1 variant 1 / base angld cold extended" MAP 0x80562ED4 RB_MapGroup_U8 191.3 kw_q0p75_o240 240.0 431.3 FORMAT "%5.1"
 /begin AXIS_DESCR COM_AXIS Epm_nEng EngN 12 0.00 16383.50 FORMAT "%8.2" EXTENDED_LIMITS -16384.00 16383.50 AXIS_PTS_REF InjSys_nEng12_AX /end AXIS_DESCR
 /begin AXIS_DESCR COM_AXIS InjSys_ratAirMAxisInp rel_uw_q0p0234 12 0.00 1535.977 FORMAT "%8.3" AXIS_PTS_REF InjSys_ratAirM12_AX /end AXIS_DESCR
/end CHARACTERISTIC
/begin CHARACTERISTIC InjSys_P1V1I1_HO.agBgnColdSmlVlvEthnl_GM "class instance packet 1 variant 1 / base angle cold small valve ethanol dependent" MAP 0x80562F64 RB_MapGroup_U8 191.3 kw_q0p75_o240 240.0 431.3 FORMAT "%5.1"
 /begin AXIS_DESCR COM_AXIS Epm_nEng EngN 12 0.00 16383.50 FORMAT "%8.2" EXTENDED_LIMITS -16384.00 16383.50 AXIS_PTS_REF InjSys_nEng12_AX /end AXIS_DESCR
 /begin AXIS_DESCR COM_AXIS InjSys_ratAirMAxisInp rel_uw_q0p0234 12 0.00 1535.977 FORMAT "%8.3" AXIS_PTS_REF InjSys_ratAirM12_AX /end AXIS_DESCR
/end CHARACTERISTIC
/begin CHARACTERISTIC InjSys_P1V1I1_HO.agBgnColdSmlVlv_GM "class instance packet 1 variant 1 / base angle cold small valve" MAP 0x80562FF4 RB_MapGroup_U8 191.3 kw_q0p75_o240 240.0 431.3 FORMAT "%5.1"
 /begin AXIS_DESCR COM_AXIS Epm_nEng EngN 12 0.00 16383.50 FORMAT "%8.2" EXTENDED_LIMITS -16384.00 16383.50 AXIS_PTS_REF InjSys_nEng12_AX /end AXIS_DESCR
 /begin AXIS_DESCR COM_AXIS InjSys_ratAirMAxisInp rel_uw_q0p0234 12 0.00 1535.977 FORMAT "%8.3" AXIS_PTS_REF InjSys_ratAirM12_AX /end AXIS_DESCR
/end CHARACTERISTIC
/begin CHARACTERISTIC InjSys_P1V1I1_HO.agBgnWrmExtdEthnl_GM "class instance packet 1 variant 1 / base angle warm extended ethanol dependent" MAP 0x80563084 RB_MapGroup_U8 191.3 kw_q0p75_o240 240.0 431.3 FORMAT "%5.1"
 /begin AXIS_DESCR COM_AXIS Epm_nEng EngN 12 0.00 16383.50 FORMAT "%8.2" EXTENDED_LIMITS -16384.00 16383.50 AXIS_PTS_REF InjSys_nEng12_AX /end AXIS_DESCR
 /begin AXIS_DESCR COM_AXIS InjSys_ratAirMAxisInp rel_uw_q0p0234 12 0.00 1535.977 FORMAT "%8.3" AXIS_PTS_REF InjSys_ratAirM12_AX /end AXIS_DESCR
/end CHARACTERISTIC
/begin CHARACTERISTIC InjSys_P1V1I1_HO.agBgnWrmExtd_GM "class instance packet 1 variant 1 / base angle warm extended" MAP 0x80563114 RB_MapGroup_U8 191.3 kw_q0p75_o240 240.0 431.3 FORMAT "%5.1"
 /begin AXIS_DESCR COM_AXIS Epm_nEng EngN 12 0.00 16383.50 FORMAT "%8.2" EXTENDED_LIMITS -16384.00 16383.50 AXIS_PTS_REF InjSys_nEng12_AX /end AXIS_DESCR
 /begin AXIS_DESCR COM_AXIS InjSys_ratAirMAxisInp rel_uw_q0p0234 12 0.00 1535.977 FORMAT "%8.3" AXIS_PTS_REF InjSys_ratAirM12_AX /end AXIS_DESCR
/end CHARACTERISTIC
/begin CHARACTERISTIC InjSys_P1V1I1_HO.agBgnWrmSmlVlvEthnl_GM "class instance packet 1 variant 1 / base angle warm small valve ethanol dependent" MAP 0x805631A4 RB_MapGroup_U8 191.3 kw_q0p75_o240 240.0 431.3 FORMAT "%5.1"
 /begin AXIS_DESCR COM_AXIS Epm_nEng EngN 12 0.00 16383.50 FORMAT "%8.2" EXTENDED_LIMITS -16384.00 16383.50 AXIS_PTS_REF InjSys_nEng12_AX /end AXIS_DESCR
 /begin AXIS_DESCR COM_AXIS InjSys_ratAirMAxisInp rel_uw_q0p0234 12 0.00 1535.977 FORMAT "%8.3" AXIS_PTS_REF InjSys_ratAirM12_AX /end AXIS_DESCR
/end CHARACTERISTIC
/begin CHARACTERISTIC InjSys_P1V1I1_HO.agBgnWrmSmlVlv_GM "class instance packet 1 variant 1 / base angle warm small valve" MAP 0x80563234 RB_MapGroup_U8 191.3 kw_q0p75_o240 240.0 431.3 FORMAT "%5.1"
 /begin AXIS_DESCR COM_AXIS Epm_nEng EngN 12 0.00 16383.50 FORMAT "%8.2" EXTENDED_LIMITS -16384.00 16383.50 AXIS_PTS_REF InjSys_nEng12_AX /end AXIS_DESCR
 /begin AXIS_DESCR COM_AXIS InjSys_ratAirMAxisInp rel_uw_q0p0234 12 0.00 1535.977 FORMAT "%8.3" AXIS_PTS_REF InjSys_ratAirM12_AX /end AXIS_DESCR
/end CHARACTERISTIC
/begin CHARACTERISTIC InjSys_P1V1I1_HO.agDeltaEth_M "class instance packet 1 variant 1 / delta angle ethanol dependent" MAP 0x805632C4 RB_Map_S16S16_S16 191.2500 kw_q0p75 -96.00000 95.25000 FORMAT "%8.5" EXTENDED_LIMITS -24576.00 24575.25
 /begin AXIS_DESCR STD_AXIS InjSys_facEthLnrLocSp fak_ub_b2 4 0.00 1.992188 FORMAT "%8.6" EXTENDED_LIMITS -256.0000 255.9922 DEPOSIT ABSOLUTE /end AXIS_DESCR
 /begin AXIS_DESCR STD_AXIS InjSys_tEng Temp_Cels 4 -3549.940 3003.560 FORMAT "%8.3" DEPOSIT ABSOLUTE /end AXIS_DESCR
/end CHARACTERISTIC
/begin CHARACTERISTIC InjSys_P1V1I1_HO.agDeltaLamBasCold_M "class instance packet 1 variant 1 / cold angle base lambda dependent and engine temperature dependent" MAP 0x805632F8 RB_Map_S16U16_S16 191.2500 kw_q0p75 -96.00000 95.25000 FORMAT "%8.5" EXTENDED_LIMITS -24576.00 24575.25
 /begin AXIS_DESCR STD_AXIS Epm_nEng EngN 8 -16384.00 16383.50 FORMAT "%8.2" DEPOSIT ABSOLUTE /end AXIS_DESCR
 /begin AXIS_DESCR STD_AXIS InjSys_ratAirMPredLocSp rel_uw_q0p0234 6 0.00 1535.977 FORMAT "%8.3" DEPOSIT ABSOLUTE /end AXIS_DESCR
/end CHARACTERISTIC
/begin CHARACTERISTIC InjSys_P1V1I1_HO.agDeltaLamBasWrm_M "class instance packet 1 variant 1 / warm angle base lambda dependent and engine temperature dependent" MAP 0x80563378 RB_Map_S16U16_S16 191.2500 kw_q0p75 -96.00000 95.25000 FORMAT "%8.5" EXTENDED_LIMITS -24576.00 24575.25
 /begin AXIS_DESCR STD_AXIS Epm_nEng EngN 8 -16384.00 16383.50 FORMAT "%8.2" DEPOSIT ABSOLUTE /end AXIS_DESCR
 /begin AXIS_DESCR STD_AXIS InjSys_ratAirMPredLocSp rel_uw_q0p0234 6 0.00 1535.977 FORMAT "%8.3" DEPOSIT ABSOLUTE /end AXIS_DESCR
/end CHARACTERISTIC
/begin CHARACTERISTIC InjSys_P1V1I1_HO.agDeltaLam_M "class instance packet 1 variant 1 / base angle lamda dependent" MAP 0x805633F8 RB_Map_S16U16_S16 191.2500 kw_q0p75 -96.00000 95.25000 FORMAT "%8.5" EXTENDED_LIMITS -24576.00 24575.25
 /begin AXIS_DESCR STD_AXIS Epm_nEng EngN 10 -16384.00 16383.50 FORMAT "%8.2" DEPOSIT ABSOLUTE /end AXIS_DESCR
 /begin AXIS_DESCR STD_AXIS InjSys_ratAirMPredLocSp kw_q0p0234 8 0.00 1535.977 FORMAT "%8.3" DEPOSIT ABSOLUTE /end AXIS_DESCR
/end CHARACTERISTIC
/begin CHARACTERISTIC InjSys_P1V1I1_HO.agDeltaTEngOilVers2_GM "class instance packet 1 variant 1 / delta angle engine- and oil- temperature dependent" MAP 0x805634C0 RB_MapGroup_S8 191.3 kw_q0p75 -96.00 95.25 FORMAT "%5.2"
 /begin AXIS_DESCR COM_AXIS Epm_nEng EngN 12 0.00 16383.50 FORMAT "%8.2" EXTENDED_LIMITS -16384.00 16383.50 AXIS_PTS_REF InjSys_nEng12Vers2_AX /end AXIS_DESCR
 /begin AXIS_DESCR COM_AXIS InjSys_ratAirMAgSpVers2AxisInp rel_uw_q0p0234 12 0.00 1535.977 FORMAT "%8.3" AXIS_PTS_REF InjSys_ratAirM12AgSpVers2_AX /end AXIS_DESCR
/end CHARACTERISTIC
/begin CHARACTERISTIC InjSys_P1V1I1_HO.agDeltaTEngOil_GM "class instance packet 1 variant 1 / delta angle engine- and oil- temperature dependent" MAP 0x80563550 RB_MapGroup_S8 191.3 kw_q0p75 -96.00 95.25 FORMAT "%5.2"
 /begin AXIS_DESCR COM_AXIS Epm_nEng EngN 12 0.00 16383.50 FORMAT "%8.2" EXTENDED_LIMITS -16384.00 16383.50 AXIS_PTS_REF InjSys_nEng12_AX /end AXIS_DESCR
 /begin AXIS_DESCR COM_AXIS InjSys_ratAirMAgSpAxisInp rel_uw_q0p0234 12 0.00 1535.977 FORMAT "%8.3" AXIS_PTS_REF InjSys_ratAirM12AgSp_AX /end AXIS_DESCR
/end CHARACTERISTIC
/begin CHARACTERISTIC InjSys_P1V1I1_HO.facAgBgnLam_T "class instance packet 1 variant 1 / base angle lamda dependent curve" CURVE 0x805635E0 RB_Curve_U8_U8 0.9961 fak_ub_b1 0.00 0.9961
 /begin AXIS_DESCR STD_AXIS InjSys_facLamBasLocSp fak_ub_b2 8 0.00 1.992188 FORMAT "%8.6" DEPOSIT ABSOLUTE /end AXIS_DESCR
/end CHARACTERISTIC
/begin CHARACTERISTIC InjSys_P1V1I1_HO.facEthnlAgBgn_T "class instance packet 1 variant 1 / base angle lamda dependent ethanol curve" CURVE 0x805635F1 RB_Curve_U8_U8 0.9961 fak_ub_b1 0.00 0.9961
 /begin AXIS_DESCR STD_AXIS fethstoeLocSp fak_ub_b2 4 0.00 1.992188 FORMAT "%8.6" DEPOSIT ABSOLUTE /end AXIS_DESCR
/end CHARACTERISTIC
/begin CHARACTERISTIC InjSys_P1V1I1_HO.facTPistCold_M "class instance packet 1 variant 1 / delta angle ethanol dependent" MAP 0x805635FA RB_Map_S16S16_U8 0.9961 fak_ub_b1 0.00 0.9961
 /begin AXIS_DESCR STD_AXIS InjSys_tEng Temp_Cels 8 -3549.940 3003.560 FORMAT "%8.3" DEPOSIT ABSOLUTE /end AXIS_DESCR
 /begin AXIS_DESCR STD_AXIS InjSys_tOilLocSp Temp_Cels 8 -3549.940 3003.560 FORMAT "%8.3" DEPOSIT ABSOLUTE /end AXIS_DESCR
/end CHARACTERISTIC
/begin CHARACTERISTIC InjSys_P1V1I1_HO.facTPist_M "class instance packet 1 variant 1 / factor piston temperature" MAP 0x8056365E RB_Map_S16S16_U8 0.9961 fak_ub_b1 0.00 0.9961
 /begin AXIS_DESCR STD_AXIS InjSys_tPistBas Temp_Cels 6 -3549.940 3003.560 FORMAT "%8.3" DEPOSIT ABSOLUTE /end AXIS_DESCR
 /begin AXIS_DESCR STD_AXIS InjSys_tPistDelta temp_q0p1 6 -3276.800 3276.700 FORMAT "%8.3" DEPOSIT ABSOLUTE /end AXIS_DESCR
/end CHARACTERISTIC
/begin CHARACTERISTIC InjSys_P1V1I1_HO.facWghtAgDeltaLamBasCold_T "class instance packet 1 variant 1 / weighting factor cold delta angle engine and oil temperature dependent" CURVE 0x8056369E RB_Curve_U8_U8 0.9961 fak_ub_b1 0.00 0.9961
 /begin AXIS_DESCR STD_AXIS InjSys_facLamBasLocSp fak_ub_b2 3 0.00 1.992188 FORMAT "%8.6" DEPOSIT ABSOLUTE /end AXIS_DESCR
/end CHARACTERISTIC
/begin CHARACTERISTIC InjSys_P1V1I1_HO.facWghtAgDeltaLamBasWrm_T "class instance packet 1 variant 1 / weighting factor warm delta angle engine and oil temperature dependent" CURVE 0x805636A5 RB_Curve_U8_U8 0.9961 fak_ub_b1 0.00 0.9961
 /begin AXIS_DESCR STD_AXIS InjSys_facLamBasLocSp fak_ub_b2 3 0.00 1.992188 FORMAT "%8.6" DEPOSIT ABSOLUTE /end AXIS_DESCR
/end CHARACTERISTIC
/begin CHARACTERISTIC InjSys_P1V1I1_HO.facWghtColdWrmEthnl_M "class instance packet 1 variant 1 / weighting factor cold-warm ethnaol dependent" MAP 0x805636AC RB_Map_S16S16_U8 0.9961 fak_ub_b1 0.00 0.9961
 /begin AXIS_DESCR STD_AXIS InjSys_tEng Temp_Cels 6 -3549.940 3003.560 FORMAT "%8.3" DEPOSIT ABSOLUTE /end AXIS_DESCR
 /begin AXIS_DESCR STD_AXIS InjSys_tOilLocSp Temp_Cels 4 -3549.940 3003.560 FORMAT "%8.3" DEPOSIT ABSOLUTE /end AXIS_DESCR
/end CHARACTERISTIC
/begin CHARACTERISTIC InjSys_P1V1I1_HO.facWghtColdWrm_M "class instance packet 1 variant 1 / weighting factor cold-warm" MAP 0x805636DC RB_Map_S16S16_U8 0.9961 fak_ub_b1 0.00 0.9961
 /begin AXIS_DESCR STD_AXIS InjSys_tEng Temp_Cels 6 -3549.940 3003.560 FORMAT "%8.3" DEPOSIT ABSOLUTE /end AXIS_DESCR
 /begin AXIS_DESCR STD_AXIS InjSys_tOilLocSp Temp_Cels 4 -3549.940 3003.560 FORMAT "%8.3" DEPOSIT ABSOLUTE /end AXIS_DESCR
/end CHARACTERISTIC
/begin CHARACTERISTIC InjSys_P1V1I1_HO.facWghtWrmCold_M "class instance packet 1 variant 1 / weighting factor warmcold delta angle engine- and oil- temperature dependent" MAP 0x8056370C RB_Map_S16S16_U8 0.9961 fak_ub_b1 0.00 0.9961
 /begin AXIS_DESCR STD_AXIS InjSys_tEng Temp_Cels 6 -3549.940 3003.560 FORMAT "%8.3" DEPOSIT ABSOLUTE /end AXIS_DESCR
 /begin AXIS_DESCR STD_AXIS InjSys_tOilLocSp Temp_Cels 4 -3549.940 3003.560 FORMAT "%8.3" DEPOSIT ABSOLUTE /end AXIS_DESCR
/end CHARACTERISTIC
/begin CHARACTERISTIC InjSys_P1V1I1_HO.flgAxVers_C "class instance packet 1 variant 1 / condition map selection with group axis in version 2" VALUE 0x8056373C RB_Val_Wu8 1.00000000000 B_TRUE 0.00 1.00000000000 FORMAT "%13.11" /end CHARACTERISTIC
/begin CHARACTERISTIC InjSys_P1V1I2_HO.agBasTPistColdVers2_GM "injection packet 1 in variant 1 / base angle at cold piston temperature (version 2)" MAP 0x805593C8 RB_MapGroup_U8 382.5 kw_q1p5 0.00 382.5 FORMAT "%5.1"
 /begin AXIS_DESCR COM_AXIS Epm_nEng EngN 12 0.00 16383.50 FORMAT "%8.2" EXTENDED_LIMITS -16384.00 16383.50 AXIS_PTS_REF InjSys_nEng12Vers2_AX /end AXIS_DESCR
 /begin AXIS_DESCR COM_AXIS InjSys_ratAirMAgSpVers2AxisInp rel_uw_q0p0234 12 0.00 1535.977 FORMAT "%8.3" AXIS_PTS_REF InjSys_ratAirM12AgSpVers2_AX /end AXIS_DESCR
/end CHARACTERISTIC
/begin CHARACTERISTIC InjSys_P1V1I2_HO.agBasTPistCold_GM "injection packet 1 in variant 1 / base angle at cold piston temperature" MAP 0x80559458 RB_MapGroup_U8 382.5 kw_q1p5 0.00 382.5 FORMAT "%5.1"
 /begin AXIS_DESCR COM_AXIS Epm_nEng EngN 12 0.00 16383.50 FORMAT "%8.2" EXTENDED_LIMITS -16384.00 16383.50 AXIS_PTS_REF InjSys_nEng12_AX /end AXIS_DESCR
 /begin AXIS_DESCR COM_AXIS InjSys_ratAirMAgSpAxisInp rel_uw_q0p0234 12 0.00 1535.977 FORMAT "%8.3" AXIS_PTS_REF InjSys_ratAirM12AgSp_AX /end AXIS_DESCR
/end CHARACTERISTIC
/begin CHARACTERISTIC InjSys_P1V1I2_HO.agBasTPistWrmVers2_GM "injection packet 1 in variant 1 / base angle for interpolation Warm TSA mode (Version 2)" MAP 0x805594E8 RB_MapGroup_U8 382.5 kw_q1p5 0.00 382.5 FORMAT "%5.1"
 /begin AXIS_DESCR COM_AXIS Epm_nEng EngN 12 0.00 16383.50 FORMAT "%8.2" EXTENDED_LIMITS -16384.00 16383.50 AXIS_PTS_REF InjSys_nEng12Vers2_AX /end AXIS_DESCR
 /begin AXIS_DESCR COM_AXIS InjSys_ratAirMAgSpVers2AxisInp rel_uw_q0p0234 12 0.00 1535.977 FORMAT "%8.3" AXIS_PTS_REF InjSys_ratAirM12AgSpVers2_AX /end AXIS_DESCR
/end CHARACTERISTIC
/begin CHARACTERISTIC InjSys_P1V1I2_HO.agBasTPistWrm_GM "injection packet 1 in variant 1 / base angle for interpolation Warm TSA mode" MAP 0x80559578 RB_MapGroup_U8 382.5 kw_q1p5 0.00 382.5 FORMAT "%5.1"
 /begin AXIS_DESCR COM_AXIS Epm_nEng EngN 12 0.00 16383.50 FORMAT "%8.2" EXTENDED_LIMITS -16384.00 16383.50 AXIS_PTS_REF InjSys_nEng12_AX /end AXIS_DESCR
 /begin AXIS_DESCR COM_AXIS InjSys_ratAirMAgSpAxisInp rel_uw_q0p0234 12 0.00 1535.977 FORMAT "%8.3" AXIS_PTS_REF InjSys_ratAirM12AgSp_AX /end AXIS_DESCR
/end CHARACTERISTIC
/begin CHARACTERISTIC InjSys_P1V1I2_HO.agBgnColdExtdEthnl_GM "injection packet 1 in variant 1 / base angle cold extended ethanol dependent" MAP 0x80559608 RB_MapGroup_U8 191.3 kw_q0p75_o240 240.0 431.3 FORMAT "%5.1"
 /begin AXIS_DESCR COM_AXIS Epm_nEng EngN 12 0.00 16383.50 FORMAT "%8.2" EXTENDED_LIMITS -16384.00 16383.50 AXIS_PTS_REF InjSys_nEng12_AX /end AXIS_DESCR
 /begin AXIS_DESCR COM_AXIS InjSys_ratAirMAxisInp rel_uw_q0p0234 12 0.00 1535.977 FORMAT "%8.3" AXIS_PTS_REF InjSys_ratAirM12_AX /end AXIS_DESCR
/end CHARACTERISTIC
/begin CHARACTERISTIC InjSys_P1V1I2_HO.agBgnColdExtd_GM "injection packet 1 in variant 1 / base angld cold extended" MAP 0x80559698 RB_MapGroup_U8 191.3 kw_q0p75_o240 240.0 431.3 FORMAT "%5.1"
 /begin AXIS_DESCR COM_AXIS Epm_nEng EngN 12 0.00 16383.50 FORMAT "%8.2" EXTENDED_LIMITS -16384.00 16383.50 AXIS_PTS_REF InjSys_nEng12_AX /end AXIS_DESCR
 /begin AXIS_DESCR COM_AXIS InjSys_ratAirMAxisInp rel_uw_q0p0234 12 0.00 1535.977 FORMAT "%8.3" AXIS_PTS_REF InjSys_ratAirM12_AX /end AXIS_DESCR
/end CHARACTERISTIC
/begin CHARACTERISTIC InjSys_P1V1I2_HO.agBgnColdSmlVlvEthnl_GM "injection packet 1 in variant 1 / base angle cold small valve ethanol dependent" MAP 0x80559728 RB_MapGroup_U8 191.3 kw_q0p75_o240 240.0 431.3 FORMAT "%5.1"
 /begin AXIS_DESCR COM_AXIS Epm_nEng EngN 12 0.00 16383.50 FORMAT "%8.2" EXTENDED_LIMITS -16384.00 16383.50 AXIS_PTS_REF InjSys_nEng12_AX /end AXIS_DESCR
 /begin AXIS_DESCR COM_AXIS InjSys_ratAirMAxisInp rel_uw_q0p0234 12 0.00 1535.977 FORMAT "%8.3" AXIS_PTS_REF InjSys_ratAirM12_AX /end AXIS_DESCR
/end CHARACTERISTIC
/begin CHARACTERISTIC InjSys_P1V1I2_HO.agBgnColdSmlVlv_GM "injection packet 1 in variant 1 / base angle cold small valve" MAP 0x805597B8 RB_MapGroup_U8 191.3 kw_q0p75_o240 240.0 431.3 FORMAT "%5.1"
 /begin AXIS_DESCR COM_AXIS Epm_nEng EngN 12 0.00 16383.50 FORMAT "%8.2" EXTENDED_LIMITS -16384.00 16383.50 AXIS_PTS_REF InjSys_nEng12_AX /end AXIS_DESCR
 /begin AXIS_DESCR COM_AXIS InjSys_ratAirMAxisInp rel_uw_q0p0234 12 0.00 1535.977 FORMAT "%8.3" AXIS_PTS_REF InjSys_ratAirM12_AX /end AXIS_DESCR
/end CHARACTERISTIC
/begin CHARACTERISTIC InjSys_P1V1I2_HO.agBgnWrmExtdEthnl_GM "injection packet 1 in variant 1 / base angle warm extended ethanol dependent" MAP 0x80559848 RB_MapGroup_U8 191.3 kw_q0p75_o240 240.0 431.3 FORMAT "%5.1"
 /begin AXIS_DESCR COM_AXIS Epm_nEng EngN 12 0.00 16383.50 FORMAT "%8.2" EXTENDED_LIMITS -16384.00 16383.50 AXIS_PTS_REF InjSys_nEng12_AX /end AXIS_DESCR
 /begin AXIS_DESCR COM_AXIS InjSys_ratAirMAxisInp rel_uw_q0p0234 12 0.00 1535.977 FORMAT "%8.3" AXIS_PTS_REF InjSys_ratAirM12_AX /end AXIS_DESCR
/end CHARACTERISTIC
/begin CHARACTERISTIC InjSys_P1V1I2_HO.agBgnWrmExtd_GM "injection packet 1 in variant 1 / base angle warm extended" MAP 0x805598D8 RB_MapGroup_U8 191.3 kw_q0p75_o240 240.0 431.3 FORMAT "%5.1"
 /begin AXIS_DESCR COM_AXIS Epm_nEng EngN 12 0.00 16383.50 FORMAT "%8.2" EXTENDED_LIMITS -16384.00 16383.50 AXIS_PTS_REF InjSys_nEng12_AX /end AXIS_DESCR
 /begin AXIS_DESCR COM_AXIS InjSys_ratAirMAxisInp rel_uw_q0p0234 12 0.00 1535.977 FORMAT "%8.3" AXIS_PTS_REF InjSys_ratAirM12_AX /end AXIS_DESCR
/end CHARACTERISTIC
/begin CHARACTERISTIC InjSys_P1V1I2_HO.agBgnWrmSmlVlvEthnl_GM "injection packet 1 in variant 1 / base angle warm small valve ethanol dependent" MAP 0x80559968 RB_MapGroup_U8 191.3 kw_q0p75_o240 240.0 431.3 FORMAT "%5.1"
 /begin AXIS_DESCR COM_AXIS Epm_nEng EngN 12 0.00 16383.50 FORMAT "%8.2" EXTENDED_LIMITS -16384.00 16383.50 AXIS_PTS_REF InjSys_nEng12_AX /end AXIS_DESCR
 /begin AXIS_DESCR COM_AXIS InjSys_ratAirMAxisInp rel_uw_q0p0234 12 0.00 1535.977 FORMAT "%8.3" AXIS_PTS_REF InjSys_ratAirM12_AX /end AXIS_DESCR
/end CHARACTERISTIC
/begin CHARACTERISTIC InjSys_P1V1I2_HO.agBgnWrmSmlVlv_GM "injection packet 1 in variant 1 / base angle warm small valve" MAP 0x805599F8 RB_MapGroup_U8 191.3 kw_q0p75_o240 240.0 431.3 FORMAT "%5.1"
 /begin AXIS_DESCR COM_AXIS Epm_nEng EngN 12 0.00 16383.50 FORMAT "%8.2" EXTENDED_LIMITS -16384.00 16383.50 AXIS_PTS_REF InjSys_nEng12_AX /end AXIS_DESCR
 /begin AXIS_DESCR COM_AXIS InjSys_ratAirMAxisInp rel_uw_q0p0234 12 0.00 1535.977 FORMAT "%8.3" AXIS_PTS_REF InjSys_ratAirM12_AX /end AXIS_DESCR
/end CHARACTERISTIC
/begin CHARACTERISTIC InjSys_P1V1I2_HO.agDeltaEth_M "injection packet 1 in variant 1 / delta angle ethanol dependent" MAP 0x80559A88 RB_Map_S16S16_S16 191.2500 kw_q0p75 -96.00000 95.25000 FORMAT "%8.5" EXTENDED_LIMITS -24576.00 24575.25
 /begin AXIS_DESCR STD_AXIS InjSys_facEthLnrLocSp fak_ub_b2 4 0.00 1.992188 FORMAT "%8.6" EXTENDED_LIMITS -256.0000 255.9922 DEPOSIT ABSOLUTE /end AXIS_DESCR
 /begin AXIS_DESCR STD_AXIS InjSys_tEng Temp_Cels 4 -3549.940 3003.560 FORMAT "%8.3" DEPOSIT ABSOLUTE /end AXIS_DESCR
/end CHARACTERISTIC
/begin CHARACTERISTIC InjSys_P1V1I2_HO.agDeltaLamBasCold_M "injection packet 1 in variant 1 / cold angle base lambda dependent and engine temperature dependent" MAP 0x80559ABC RB_Map_S16U16_S16 191.2500 kw_q0p75 -96.00000 95.25000 FORMAT "%8.5" EXTENDED_LIMITS -24576.00 24575.25
 /begin AXIS_DESCR STD_AXIS Epm_nEng EngN 8 -16384.00 16383.50 FORMAT "%8.2" DEPOSIT ABSOLUTE /end AXIS_DESCR
 /begin AXIS_DESCR STD_AXIS InjSys_ratAirMPredLocSp rel_uw_q0p0234 6 0.00 1535.977 FORMAT "%8.3" DEPOSIT ABSOLUTE /end AXIS_DESCR
/end CHARACTERISTIC
/begin CHARACTERISTIC InjSys_P1V1I2_HO.agDeltaLamBasWrm_M "injection packet 1 in variant 1 / warm angle base lambda dependent and engine temperature dependent" MAP 0x80559B3C RB_Map_S16U16_S16 191.2500 kw_q0p75 -96.00000 95.25000 FORMAT "%8.5" EXTENDED_LIMITS -24576.00 24575.25
 /begin AXIS_DESCR STD_AXIS Epm_nEng EngN 8 -16384.00 16383.50 FORMAT "%8.2" DEPOSIT ABSOLUTE /end AXIS_DESCR
 /begin AXIS_DESCR STD_AXIS InjSys_ratAirMPredLocSp rel_uw_q0p0234 6 0.00 1535.977 FORMAT "%8.3" DEPOSIT ABSOLUTE /end AXIS_DESCR
/end CHARACTERISTIC
/begin CHARACTERISTIC InjSys_P1V1I2_HO.agDeltaLam_M "injection packet 1 in variant 1 / base angle lamda dependent" MAP 0x80559BBC RB_Map_S16U16_S16 191.2500 kw_q0p75 -96.00000 95.25000 FORMAT "%8.5" EXTENDED_LIMITS -24576.00 24575.25
 /begin AXIS_DESCR STD_AXIS Epm_nEng EngN 10 -16384.00 16383.50 FORMAT "%8.2" DEPOSIT ABSOLUTE /end AXIS_DESCR
 /begin AXIS_DESCR STD_AXIS InjSys_ratAirMPredLocSp kw_q0p0234 8 0.00 1535.977 FORMAT "%8.3" DEPOSIT ABSOLUTE /end AXIS_DESCR
/end CHARACTERISTIC
/begin CHARACTERISTIC InjSys_P1V1I2_HO.agDeltaTEngOilVers2_GM "injection packet 1 in variant 1 / delta angle engine- and oil- temperature dependent" MAP 0x80559C84 RB_MapGroup_S8 191.3 kw_q0p75 -96.00 95.25 FORMAT "%5.2"
 /begin AXIS_DESCR COM_AXIS Epm_nEng EngN 12 0.00 16383.50 FORMAT "%8.2" EXTENDED_LIMITS -16384.00 16383.50 AXIS_PTS_REF InjSys_nEng12Vers2_AX /end AXIS_DESCR
 /begin AXIS_DESCR COM_AXIS InjSys_ratAirMAgSpVers2AxisInp rel_uw_q0p0234 12 0.00 1535.977 FORMAT "%8.3" AXIS_PTS_REF InjSys_ratAirM12AgSpVers2_AX /end AXIS_DESCR
/end CHARACTERISTIC
/begin CHARACTERISTIC InjSys_P1V1I2_HO.agDeltaTEngOil_GM "injection packet 1 in variant 1 / delta angle engine- and oil- temperature dependent" MAP 0x80559D14 RB_MapGroup_S8 191.3 kw_q0p75 -96.00 95.25 FORMAT "%5.2"
 /begin AXIS_DESCR COM_AXIS Epm_nEng EngN 12 0.00 16383.50 FORMAT "%8.2" EXTENDED_LIMITS -16384.00 16383.50 AXIS_PTS_REF InjSys_nEng12_AX /end AXIS_DESCR
 /begin AXIS_DESCR COM_AXIS InjSys_ratAirMAgSpAxisInp rel_uw_q0p0234 12 0.00 1535.977 FORMAT "%8.3" AXIS_PTS_REF InjSys_ratAirM12AgSp_AX /end AXIS_DESCR
/end CHARACTERISTIC
/begin CHARACTERISTIC InjSys_P1V1I2_HO.facAgBgnLam_T "injection packet 1 in variant 1 / base angle lamda dependent curve" CURVE 0x80559DA4 RB_Curve_U8_U8 0.9961 fak_ub_b1 0.00 0.9961
 /begin AXIS_DESCR STD_AXIS InjSys_facLamBasLocSp fak_ub_b2 8 0.00 1.992188 FORMAT "%8.6" DEPOSIT ABSOLUTE /end AXIS_DESCR
/end CHARACTERISTIC
/begin CHARACTERISTIC InjSys_P1V1I2_HO.facEthnlAgBgn_T "injection packet 1 in variant 1 / base angle lamda dependent ethanol curve" CURVE 0x80559DB5 RB_Curve_U8_U8 0.9961 fak_ub_b1 0.00 0.9961
 /begin AXIS_DESCR STD_AXIS fethstoeLocSp fak_ub_b2 4 0.00 1.992188 FORMAT "%8.6" DEPOSIT ABSOLUTE /end AXIS_DESCR
/end CHARACTERISTIC
/begin CHARACTERISTIC InjSys_P1V1I2_HO.facTPistCold_M "injection packet 1 in variant 1 / delta angle ethanol dependent" MAP 0x80559DBE RB_Map_S16S16_U8 0.9961 fak_ub_b1 0.00 0.9961
 /begin AXIS_DESCR STD_AXIS InjSys_tEng Temp_Cels 8 -3549.940 3003.560 FORMAT "%8.3" DEPOSIT ABSOLUTE /end AXIS_DESCR
 /begin AXIS_DESCR STD_AXIS InjSys_tOilLocSp Temp_Cels 8 -3549.940 3003.560 FORMAT "%8.3" DEPOSIT ABSOLUTE /end AXIS_DESCR
/end CHARACTERISTIC
/begin CHARACTERISTIC InjSys_P1V1I2_HO.facTPist_M "injection packet 1 in variant 1 / factor piston temperature" MAP 0x80559E22 RB_Map_S16S16_U8 0.9961 fak_ub_b1 0.00 0.9961
 /begin AXIS_DESCR STD_AXIS InjSys_tPistBas Temp_Cels 6 -3549.940 3003.560 FORMAT "%8.3" DEPOSIT ABSOLUTE /end AXIS_DESCR
 /begin AXIS_DESCR STD_AXIS InjSys_tPistDelta temp_q0p1 6 -3276.800 3276.700 FORMAT "%8.3" DEPOSIT ABSOLUTE /end AXIS_DESCR
/end CHARACTERISTIC
/begin CHARACTERISTIC InjSys_P1V1I2_HO.facWghtAgDeltaLamBasCold_T "injection packet 1 in variant 1 / weighting factor cold delta angle engine and oil temperature dependent" CURVE 0x80559E62 RB_Curve_U8_U8 0.9961 fak_ub_b1 0.00 0.9961
 /begin AXIS_DESCR STD_AXIS InjSys_facLamBasLocSp fak_ub_b2 3 0.00 1.992188 FORMAT "%8.6" DEPOSIT ABSOLUTE /end AXIS_DESCR
/end CHARACTERISTIC
/begin CHARACTERISTIC InjSys_P1V1I2_HO.facWghtAgDeltaLamBasWrm_T "injection packet 1 in variant 1 / weighting factor warm delta angle engine and oil temperature dependent" CURVE 0x80559E69 RB_Curve_U8_U8 0.9961 fak_ub_b1 0.00 0.9961
 /begin AXIS_DESCR STD_AXIS InjSys_facLamBasLocSp fak_ub_b2 3 0.00 1.992188 FORMAT "%8.6" DEPOSIT ABSOLUTE /end AXIS_DESCR
/end CHARACTERISTIC
/begin CHARACTERISTIC InjSys_P1V1I2_HO.facWghtColdWrmEthnl_M "injection packet 1 in variant 1 / weighting factor cold-warm ethnaol dependent" MAP 0x80559E70 RB_Map_S16S16_U8 0.9961 fak_ub_b1 0.00 0.9961
 /begin AXIS_DESCR STD_AXIS InjSys_tEng Temp_Cels 6 -3549.940 3003.560 FORMAT "%8.3" DEPOSIT ABSOLUTE /end AXIS_DESCR
 /begin AXIS_DESCR STD_AXIS InjSys_tOilLocSp Temp_Cels 4 -3549.940 3003.560 FORMAT "%8.3" DEPOSIT ABSOLUTE /end AXIS_DESCR
/end CHARACTERISTIC
/begin CHARACTERISTIC InjSys_P1V1I2_HO.facWghtColdWrm_M "injection packet 1 in variant 1 / weighting factor cold-warm" MAP 0x80559EA0 RB_Map_S16S16_U8 0.9961 fak_ub_b1 0.00 0.9961
 /begin AXIS_DESCR STD_AXIS InjSys_tEng Temp_Cels 6 -3549.940 3003.560 FORMAT "%8.3" DEPOSIT ABSOLUTE /end AXIS_DESCR
 /begin AXIS_DESCR STD_AXIS InjSys_tOilLocSp Temp_Cels 4 -3549.940 3003.560 FORMAT "%8.3" DEPOSIT ABSOLUTE /end AXIS_DESCR
/end CHARACTERISTIC
/begin CHARACTERISTIC InjSys_P1V1I2_HO.facWghtWrmCold_M "injection packet 1 in variant 1 / weighting factor warmcold delta angle engine- and oil- temperature dependent" MAP 0x80559ED0 RB_Map_S16S16_U8 0.9961 fak_ub_b1 0.00 0.9961
 /begin AXIS_DESCR STD_AXIS InjSys_tEng Temp_Cels 6 -3549.940 3003.560 FORMAT "%8.3" DEPOSIT ABSOLUTE /end AXIS_DESCR
 /begin AXIS_DESCR STD_AXIS InjSys_tOilLocSp Temp_Cels 4 -3549.940 3003.560 FORMAT "%8.3" DEPOSIT ABSOLUTE /end AXIS_DESCR
/end CHARACTERISTIC
/begin CHARACTERISTIC InjSys_P1V1I2_HO.flgAxVers_C "injection packet 1 in variant 1 / condition map selection with group axis in version 2" VALUE 0x80559F00 RB_Val_Wu8 1.00000000000 B_TRUE 0.00 1.00000000000 FORMAT "%13.11" /end CHARACTERISTIC
/begin CHARACTERISTIC InjSys_P1V2I1_HO.agBasTPistColdVers2_GM "class instance packet 1 variant 2 / base angle at cold piston temperature (version 2)" MAP 0x80563744 RB_MapGroup_U8 382.5 kw_q1p5 0.00 382.5 FORMAT "%5.1"
 /begin AXIS_DESCR COM_AXIS Epm_nEng EngN 12 0.00 16383.50 FORMAT "%8.2" EXTENDED_LIMITS -16384.00 16383.50 AXIS_PTS_REF InjSys_nEng12Vers2_AX /end AXIS_DESCR
 /begin AXIS_DESCR COM_AXIS InjSys_ratAirMAgSpVers2AxisInp rel_uw_q0p0234 12 0.00 1535.977 FORMAT "%8.3" AXIS_PTS_REF InjSys_ratAirM12AgSpVers2_AX /end AXIS_DESCR
/end CHARACTERISTIC
/begin CHARACTERISTIC InjSys_P1V2I1_HO.agBasTPistCold_GM "class instance packet 1 variant 2 / base angle at cold piston temperature" MAP 0x805637D4 RB_MapGroup_U8 382.5 kw_q1p5 0.00 382.5 FORMAT "%5.1"
 /begin AXIS_DESCR COM_AXIS Epm_nEng EngN 12 0.00 16383.50 FORMAT "%8.2" EXTENDED_LIMITS -16384.00 16383.50 AXIS_PTS_REF InjSys_nEng12_AX /end AXIS_DESCR
 /begin AXIS_DESCR COM_AXIS InjSys_ratAirMAgSpAxisInp rel_uw_q0p0234 12 0.00 1535.977 FORMAT "%8.3" AXIS_PTS_REF InjSys_ratAirM12AgSp_AX /end AXIS_DESCR
/end CHARACTERISTIC
/begin CHARACTERISTIC InjSys_P1V2I1_HO.agBasTPistWrmVers2_GM "class instance packet 1 variant 2 / base angle for interpolation Warm TSA mode (Version 2)" MAP 0x80563864 RB_MapGroup_U8 382.5 kw_q1p5 0.00 382.5 FORMAT "%5.1"
 /begin AXIS_DESCR COM_AXIS Epm_nEng EngN 12 0.00 16383.50 FORMAT "%8.2" EXTENDED_LIMITS -16384.00 16383.50 AXIS_PTS_REF InjSys_nEng12Vers2_AX /end AXIS_DESCR
 /begin AXIS_DESCR COM_AXIS InjSys_ratAirMAgSpVers2AxisInp rel_uw_q0p0234 12 0.00 1535.977 FORMAT "%8.3" AXIS_PTS_REF InjSys_ratAirM12AgSpVers2_AX /end AXIS_DESCR
/end CHARACTERISTIC
/begin CHARACTERISTIC InjSys_P1V2I1_HO.agBasTPistWrm_GM "class instance packet 1 variant 2 / base angle for interpolation Warm TSA mode" MAP 0x805638F4 RB_MapGroup_U8 382.5 kw_q1p5 0.00 382.5 FORMAT "%5.1"
 /begin AXIS_DESCR COM_AXIS Epm_nEng EngN 12 0.00 16383.50 FORMAT "%8.2" EXTENDED_LIMITS -16384.00 16383.50 AXIS_PTS_REF InjSys_nEng12_AX /end AXIS_DESCR
 /begin AXIS_DESCR COM_AXIS InjSys_ratAirMAgSpAxisInp rel_uw_q0p0234 12 0.00 1535.977 FORMAT "%8.3" AXIS_PTS_REF InjSys_ratAirM12AgSp_AX /end AXIS_DESCR
/end CHARACTERISTIC
/begin CHARACTERISTIC InjSys_P1V2I1_HO.agBgnColdExtdEthnl_GM "class instance packet 1 variant 2 / base angle when charge motion greater threshold" MAP 0x80563984 RB_MapGroup_U8 191.3 kw_q0p75_o240 240.0 431.3 FORMAT "%5.1"
 /begin AXIS_DESCR COM_AXIS Epm_nEng EngN 12 0.00 16383.50 FORMAT "%8.2" EXTENDED_LIMITS -16384.00 16383.50 AXIS_PTS_REF InjSys_nEng12_AX /end AXIS_DESCR
 /begin AXIS_DESCR COM_AXIS InjSys_ratAirMAxisInp rel_uw_q0p0234 12 0.00 1535.977 FORMAT "%8.3" AXIS_PTS_REF InjSys_ratAirM12_AX /end AXIS_DESCR
/end CHARACTERISTIC
/begin CHARACTERISTIC InjSys_P1V2I1_HO.agBgnColdExtd_GM "class instance packet 1 variant 2 / base angle cold extended" MAP 0x80563A14 RB_MapGroup_U8 191.3 kw_q0p75_o240 240.0 431.3 FORMAT "%5.1"
 /begin AXIS_DESCR COM_AXIS Epm_nEng EngN 12 0.00 16383.50 FORMAT "%8.2" EXTENDED_LIMITS -16384.00 16383.50 AXIS_PTS_REF InjSys_nEng12_AX /end AXIS_DESCR
 /begin AXIS_DESCR COM_AXIS InjSys_ratAirMAxisInp rel_uw_q0p0234 12 0.00 1535.977 FORMAT "%8.3" AXIS_PTS_REF InjSys_ratAirM12_AX /end AXIS_DESCR
/end CHARACTERISTIC
/begin CHARACTERISTIC InjSys_P1V2I1_HO.agBgnColdSmlVlvEthnl_GM "class instance packet 1 variant 2 / base angle cold small valve ethanol dependent" MAP 0x80563AA4 RB_MapGroup_U8 191.3 kw_q0p75_o240 240.0 431.3 FORMAT "%5.1"
 /begin AXIS_DESCR COM_AXIS Epm_nEng EngN 12 0.00 16383.50 FORMAT "%8.2" EXTENDED_LIMITS -16384.00 16383.50 AXIS_PTS_REF InjSys_nEng12_AX /end AXIS_DESCR
 /begin AXIS_DESCR COM_AXIS InjSys_ratAirMAxisInp rel_uw_q0p0234 12 0.00 1535.977 FORMAT "%8.3" AXIS_PTS_REF InjSys_ratAirM12_AX /end AXIS_DESCR
/end CHARACTERISTIC
/begin CHARACTERISTIC InjSys_P1V2I1_HO.agBgnColdSmlVlv_GM "class instance packet 1 variant 2 / base angle cold small valve" MAP 0x80563B34 RB_MapGroup_U8 191.3 kw_q0p75_o240 240.0 431.3 FORMAT "%5.1"
 /begin AXIS_DESCR COM_AXIS Epm_nEng EngN 12 0.00 16383.50 FORMAT "%8.2" EXTENDED_LIMITS -16384.00 16383.50 AXIS_PTS_REF InjSys_nEng12_AX /end AXIS_DESCR
 /begin AXIS_DESCR COM_AXIS InjSys_ratAirMAxisInp rel_uw_q0p0234 12 0.00 1535.977 FORMAT "%8.3" AXIS_PTS_REF InjSys_ratAirM12_AX /end AXIS_DESCR
/end CHARACTERISTIC
/begin CHARACTERISTIC InjSys_P1V2I1_HO.agBgnWrmExtdEthnl_GM "class instance packet 1 variant 2 / base angle warm extended ethanol dependent" MAP 0x80563BC4 RB_MapGroup_U8 191.3 kw_q0p75_o240 240.0 431.3 FORMAT "%5.1"
 /begin AXIS_DESCR COM_AXIS Epm_nEng EngN 12 0.00 16383.50 FORMAT "%8.2" EXTENDED_LIMITS -16384.00 16383.50 AXIS_PTS_REF InjSys_nEng12_AX /end AXIS_DESCR
 /begin AXIS_DESCR COM_AXIS InjSys_ratAirMAxisInp rel_uw_q0p0234 12 0.00 1535.977 FORMAT "%8.3" AXIS_PTS_REF InjSys_ratAirM12_AX /end AXIS_DESCR
/end CHARACTERISTIC
/begin CHARACTERISTIC InjSys_P1V2I1_HO.agBgnWrmExtd_GM "class instance packet 1 variant 2 / base angle warm extended" MAP 0x80563C54 RB_MapGroup_U8 191.3 kw_q0p75_o240 240.0 431.3 FORMAT "%5.1"
 /begin AXIS_DESCR COM_AXIS Epm_nEng EngN 12 0.00 16383.50 FORMAT "%8.2" EXTENDED_LIMITS -16384.00 16383.50 AXIS_PTS_REF InjSys_nEng12_AX /end AXIS_DESCR
 /begin AXIS_DESCR COM_AXIS InjSys_ratAirMAxisInp rel_uw_q0p0234 12 0.00 1535.977 FORMAT "%8.3" AXIS_PTS_REF InjSys_ratAirM12_AX /end AXIS_DESCR
/end CHARACTERISTIC
/begin CHARACTERISTIC InjSys_P1V2I1_HO.agBgnWrmSmlVlvEthnl_GM "class instance packet 1 variant 2 / ." MAP 0x80563CE4 RB_MapGroup_U8 191.3 kw_q0p75_o240 240.0 431.3 FORMAT "%5.1"
 /begin AXIS_DESCR COM_AXIS Epm_nEng EngN 12 0.00 16383.50 FORMAT "%8.2" EXTENDED_LIMITS -16384.00 16383.50 AXIS_PTS_REF InjSys_nEng12_AX /end AXIS_DESCR
 /begin AXIS_DESCR COM_AXIS InjSys_ratAirMAxisInp rel_uw_q0p0234 12 0.00 1535.977 FORMAT "%8.3" AXIS_PTS_REF InjSys_ratAirM12_AX /end AXIS_DESCR
/end CHARACTERISTIC
/begin CHARACTERISTIC InjSys_P1V2I1_HO.agBgnWrmSmlVlv_GM "class instance packet 1 variant 2 / ." MAP 0x80563D74 RB_MapGroup_U8 191.3 kw_q0p75_o240 240.0 431.3 FORMAT "%5.1"
 /begin AXIS_DESCR COM_AXIS Epm_nEng EngN 12 0.00 16383.50 FORMAT "%8.2" EXTENDED_LIMITS -16384.00 16383.50 AXIS_PTS_REF InjSys_nEng12_AX /end AXIS_DESCR
 /begin AXIS_DESCR COM_AXIS InjSys_ratAirMAxisInp rel_uw_q0p0234 12 0.00 1535.977 FORMAT "%8.3" AXIS_PTS_REF InjSys_ratAirM12_AX /end AXIS_DESCR
/end CHARACTERISTIC
/begin CHARACTERISTIC InjSys_P1V2I1_HO.agDeltaEth_M "class instance packet 1 variant 2 / delta angle ethanol dependent" MAP 0x80563E04 RB_Map_S16S16_S16 191.2500 kw_q0p75 -96.00000 95.25000 FORMAT "%8.5" EXTENDED_LIMITS -24576.00 24575.25
 /begin AXIS_DESCR STD_AXIS InjSys_facEthLnrLocSp fak_ub_b2 4 0.00 1.992188 FORMAT "%8.6" EXTENDED_LIMITS -256.0000 255.9922 DEPOSIT ABSOLUTE /end AXIS_DESCR
 /begin AXIS_DESCR STD_AXIS InjSys_tEng Temp_Cels 4 -3549.940 3003.560 FORMAT "%8.3" DEPOSIT ABSOLUTE /end AXIS_DESCR
/end CHARACTERISTIC
/begin CHARACTERISTIC InjSys_P1V2I1_HO.agDeltaLamBasCold_M "class instance packet 1 variant 2 / cold angle base lambda dependent and engine temperature dependent" MAP 0x80563E38 RB_Map_S16U16_S16 191.2500 kw_q0p75 -96.00000 95.25000 FORMAT "%8.5" EXTENDED_LIMITS -24576.00 24575.25
 /begin AXIS_DESCR STD_AXIS Epm_nEng EngN 8 -16384.00 16383.50 FORMAT "%8.2" DEPOSIT ABSOLUTE /end AXIS_DESCR
 /begin AXIS_DESCR STD_AXIS InjSys_ratAirMPredLocSp rel_uw_q0p0234 6 0.00 1535.977 FORMAT "%8.3" DEPOSIT ABSOLUTE /end AXIS_DESCR
/end CHARACTERISTIC
/begin CHARACTERISTIC InjSys_P1V2I1_HO.agDeltaLamBasWrm_M "class instance packet 1 variant 2 / warm angle base lambda dependent and engine temperature dependent" MAP 0x80563EB8 RB_Map_S16U16_S16 191.2500 kw_q0p75 -96.00000 95.25000 FORMAT "%8.5" EXTENDED_LIMITS -24576.00 24575.25
 /begin AXIS_DESCR STD_AXIS Epm_nEng EngN 8 -16384.00 16383.50 FORMAT "%8.2" DEPOSIT ABSOLUTE /end AXIS_DESCR
 /begin AXIS_DESCR STD_AXIS InjSys_ratAirMPredLocSp rel_uw_q0p0234 6 0.00 1535.977 FORMAT "%8.3" DEPOSIT ABSOLUTE /end AXIS_DESCR
/end CHARACTERISTIC
/begin CHARACTERISTIC InjSys_P1V2I1_HO.agDeltaLam_M "class instance packet 1 variant 2 / ." MAP 0x80563F38 RB_Map_S16U16_S16 191.2500 kw_q0p75 -96.00000 95.25000 FORMAT "%8.5" EXTENDED_LIMITS -24576.00 24575.25
 /begin AXIS_DESCR STD_AXIS Epm_nEng EngN 10 -16384.00 16383.50 FORMAT "%8.2" DEPOSIT ABSOLUTE /end AXIS_DESCR
 /begin AXIS_DESCR STD_AXIS InjSys_ratAirMPredLocSp rel_uw_q0p0234 8 0.00 1535.977 FORMAT "%8.3" DEPOSIT ABSOLUTE /end AXIS_DESCR
/end CHARACTERISTIC
/begin CHARACTERISTIC InjSys_P1V2I1_HO.agDeltaTEngOilVers2_GM "class instance packet 1 variant 2 / delta angle engine- and oil- temperature dependent" MAP 0x80564000 RB_MapGroup_S8 191.3 kw_q0p75 -96.00 95.25 FORMAT "%5.2"
 /begin AXIS_DESCR COM_AXIS Epm_nEng EngN 12 0.00 16383.50 FORMAT "%8.2" EXTENDED_LIMITS -16384.00 16383.50 AXIS_PTS_REF InjSys_nEng12Vers2_AX /end AXIS_DESCR
 /begin AXIS_DESCR COM_AXIS InjSys_ratAirMAgSpVers2AxisInp rel_uw_q0p0234 12 0.00 1535.977 FORMAT "%8.3" AXIS_PTS_REF InjSys_ratAirM12AgSpVers2_AX /end AXIS_DESCR
/end CHARACTERISTIC
/begin CHARACTERISTIC InjSys_P1V2I1_HO.agDeltaTEngOil_GM "class instance packet 1 variant 2 / delta angle engine- and oil- temperature dependent" MAP 0x80564090 RB_MapGroup_S8 191.3 kw_q0p75 -96.00 95.25 FORMAT "%5.2"
 /begin AXIS_DESCR COM_AXIS Epm_nEng EngN 12 0.00 16383.50 FORMAT "%8.2" EXTENDED_LIMITS -16384.00 16383.50 AXIS_PTS_REF InjSys_nEng12_AX /end AXIS_DESCR
 /begin AXIS_DESCR COM_AXIS InjSys_ratAirMAgSpAxisInp rel_uw_q0p0234 12 0.00 1535.977 FORMAT "%8.3" AXIS_PTS_REF InjSys_ratAirM12AgSp_AX /end AXIS_DESCR
/end CHARACTERISTIC
/begin CHARACTERISTIC InjSys_P1V2I1_HO.facAgBgnLam_T "class instance packet 1 variant 2 / ." CURVE 0x80564120 RB_Curve_U8_U8 0.9961 fak_ub_b1 0.00 0.9961
 /begin AXIS_DESCR STD_AXIS InjSys_facLamBasLocSp fak_ub_b2 8 0.00 1.992188 FORMAT "%8.6" DEPOSIT ABSOLUTE /end AXIS_DESCR
/end CHARACTERISTIC
/begin CHARACTERISTIC InjSys_P1V2I1_HO.facEthnlAgBgn_T "class instance packet 1 variant 2 / ." CURVE 0x80564131 RB_Curve_U8_U8 0.9961 fak_ub_b1 0.00 0.9961
 /begin AXIS_DESCR STD_AXIS fethstoeLocSp fak_ub_b2 4 0.00 1.992188 FORMAT "%8.6" DEPOSIT ABSOLUTE /end AXIS_DESCR
/end CHARACTERISTIC
/begin CHARACTERISTIC InjSys_P1V2I1_HO.facSpltAux1Extd_GM "class instance packet 1 variant 2 / split factor auxiliary injection 1" MAP 0x8056413A RB_MapGroup_U8 0.9961 fak_ub_b1 0.00 0.9961
 /begin AXIS_DESCR COM_AXIS Epm_nEng EngN 12 0.00 16383.50 FORMAT "%8.2" EXTENDED_LIMITS -16384.00 16383.50 AXIS_PTS_REF InjSys_nEng12Vers2_AX /end AXIS_DESCR
 /begin AXIS_DESCR COM_AXIS InjSys_ratAirMVers2AxisInp rel_uw_q0p0234 12 0.00 1535.977 FORMAT "%8.3" AXIS_PTS_REF InjSys_ratAirM12Vers2_AX /end AXIS_DESCR
/end CHARACTERISTIC
/begin CHARACTERISTIC InjSys_P1V2I1_HO.facSpltAux1_GM "class instance packet 1 variant 2 / split factor auxiliary injection 1" MAP 0x805641CA RB_MapGroup_U8 0.9961 fak_ub_b1 0.00 0.9961
 /begin AXIS_DESCR COM_AXIS Epm_nEng EngN 10 0.00 16383.50 FORMAT "%8.2" EXTENDED_LIMITS -16384.00 16383.50 AXIS_PTS_REF InjSys_nEng10_AX /end AXIS_DESCR
 /begin AXIS_DESCR COM_AXIS InjSys_ratAirMAxisInp rel_uw_q0p0234 8 0.00 1535.977 FORMAT "%8.3" AXIS_PTS_REF InjSys_ratAirM08_AX /end AXIS_DESCR
/end CHARACTERISTIC
/begin CHARACTERISTIC InjSys_P1V2I1_HO.facTPistCold_M "class instance packet 1 variant 2 / delta angle ethanol dependent" MAP 0x8056421A RB_Map_S16S16_U8 0.9961 fak_ub_b1 0.00 0.9961
 /begin AXIS_DESCR STD_AXIS InjSys_tEng Temp_Cels 8 -3549.940 3003.560 FORMAT "%8.3" DEPOSIT ABSOLUTE /end AXIS_DESCR
 /begin AXIS_DESCR STD_AXIS InjSys_tOilLocSp Temp_Cels 8 -3549.940 3003.560 FORMAT "%8.3" DEPOSIT ABSOLUTE /end AXIS_DESCR
/end CHARACTERISTIC
/begin CHARACTERISTIC InjSys_P1V2I1_HO.facTPist_M "class instance packet 1 variant 2 / factor piston temperature" MAP 0x8056427E RB_Map_S16S16_U8 0.9961 fak_ub_b1 0.00 0.9961
 /begin AXIS_DESCR STD_AXIS InjSys_tPistBas Temp_Cels 6 -3549.940 3003.560 FORMAT "%8.3" DEPOSIT ABSOLUTE /end AXIS_DESCR
 /begin AXIS_DESCR STD_AXIS InjSys_tPistDelta temp_q0p1 6 -3276.800 3276.700 FORMAT "%8.3" DEPOSIT ABSOLUTE /end AXIS_DESCR
/end CHARACTERISTIC
/begin CHARACTERISTIC InjSys_P1V2I1_HO.facWghtAgDeltaLamBasCold_T "class instance packet 1 variant 2 / weighting factor cold delta angle engine and oil temperature dependent" CURVE 0x805642BE RB_Curve_U8_U8 0.9961 fak_ub_b1 0.00 0.9961
 /begin AXIS_DESCR STD_AXIS InjSys_facLamBasLocSp fak_ub_b2 3 0.00 1.992188 FORMAT "%8.6" DEPOSIT ABSOLUTE /end AXIS_DESCR
/end CHARACTERISTIC
/begin CHARACTERISTIC InjSys_P1V2I1_HO.facWghtAgDeltaLamBasWrm_T "class instance packet 1 variant 2 / weighting factor warm delta angle engine and oil temperature dependent" CURVE 0x805642C5 RB_Curve_U8_U8 0.9961 fak_ub_b1 0.00 0.9961
 /begin AXIS_DESCR STD_AXIS InjSys_facLamBasLocSp fak_ub_b2 3 0.00 1.992188 FORMAT "%8.6" DEPOSIT ABSOLUTE /end AXIS_DESCR
/end CHARACTERISTIC
/begin CHARACTERISTIC InjSys_P1V2I1_HO.facWghtColdWrmEthnl_M "class instance packet 1 variant 2 / ." MAP 0x805642CC RB_Map_S16S16_U8 0.9961 fak_ub_b1 0.00 0.9961
 /begin AXIS_DESCR STD_AXIS InjSys_tEng Temp_Cels 6 -3549.940 3003.560 FORMAT "%8.3" DEPOSIT ABSOLUTE /end AXIS_DESCR
 /begin AXIS_DESCR STD_AXIS InjSys_tOilLocSp Temp_Cels 4 -3549.940 3003.560 FORMAT "%8.3" DEPOSIT ABSOLUTE /end AXIS_DESCR
/end CHARACTERISTIC
/begin CHARACTERISTIC InjSys_P1V2I1_HO.facWghtColdWrm_M "class instance packet 1 variant 2 / ." MAP 0x805642FC RB_Map_S16S16_U8 0.9961 fak_ub_b1 0.00 0.9961
 /begin AXIS_DESCR STD_AXIS InjSys_tEng Temp_Cels 6 -3549.940 3003.560 FORMAT "%8.3" DEPOSIT ABSOLUTE /end AXIS_DESCR
 /begin AXIS_DESCR STD_AXIS InjSys_tOilLocSp Temp_Cels 4 -3549.940 3003.560 FORMAT "%8.3" DEPOSIT ABSOLUTE /end AXIS_DESCR
/end CHARACTERISTIC
/begin CHARACTERISTIC InjSys_P1V2I1_HO.facWghtWrmCold_M "class instance packet 1 variant 2 / weighting factor warm-cold delta angle engine- and oil- temperature dependent" MAP 0x8056432C RB_Map_S16S16_U8 0.9961 fak_ub_b1 0.00 0.9961
 /begin AXIS_DESCR STD_AXIS InjSys_tEng Temp_Cels 6 -3549.940 3003.560 FORMAT "%8.3" DEPOSIT ABSOLUTE /end AXIS_DESCR
 /begin AXIS_DESCR STD_AXIS InjSys_tOilLocSp Temp_Cels 4 -3549.940 3003.560 FORMAT "%8.3" DEPOSIT ABSOLUTE /end AXIS_DESCR
/end CHARACTERISTIC
/begin CHARACTERISTIC InjSys_P1V2I1_HO.flgAbsltSplt_C "class instance packet 1 variant 2 / condition split with absolute fuel mass" VALUE 0x8056435C RB_Val_Wu8 1.00000000000 B_TRUE 0.00 1.00000000000 FORMAT "%13.11" /end CHARACTERISTIC
/begin CHARACTERISTIC InjSys_P1V2I1_HO.flgAxVers_C "class instance packet 1 variant 2 / condition map selection with group axis in version 2" VALUE 0x8056435D RB_Val_Wu8 1.00000000000 B_TRUE 0.00 1.00000000000 FORMAT "%13.11" /end CHARACTERISTIC
/begin CHARACTERISTIC InjSys_P1V2I1_HO.flgPltInj_C "class instance packet 1 variant 2 / condition pilot injection" VALUE 0x8056435E RB_Val_Wu8 1.00000000000 B_TRUE 0.00 1.00000000000 FORMAT "%13.11" /end CHARACTERISTIC
/begin CHARACTERISTIC InjSys_P1V2I1_HO.ratFuMAux1_GM "class instance packet 1 variant 2 / relative fuel mass auxiliary injection 1" MAP 0x80564360 RB_MapGroup_U16 3071.953 rel_uw_b3072 0.00 3071.953 FORMAT "%8.3"
 /begin AXIS_DESCR COM_AXIS Epm_nEng EngN 10 0.00 16383.50 FORMAT "%8.2" EXTENDED_LIMITS -16384.00 16383.50 AXIS_PTS_REF InjSys_nEng10_AX /end AXIS_DESCR
 /begin AXIS_DESCR COM_AXIS InjSys_ratAirMAxisInp rel_uw_q0p0234 8 0.00 1535.977 FORMAT "%8.3" AXIS_PTS_REF InjSys_ratAirM08_AX /end AXIS_DESCR
/end CHARACTERISTIC
/begin CHARACTERISTIC InjSys_P1V2I1_HO.ratFuMBasExtd_GM "class instance packet 1 variant 2 / relative fuel mass base injection" MAP 0x80564400 RB_MapGroup_U16 3071.953 rel_uw_b3072 0.00 3071.953 FORMAT "%8.3"
 /begin AXIS_DESCR COM_AXIS Epm_nEng EngN 12 0.00 16383.50 FORMAT "%8.2" EXTENDED_LIMITS -16384.00 16383.50 AXIS_PTS_REF InjSys_nEng12Vers2_AX /end AXIS_DESCR
 /begin AXIS_DESCR COM_AXIS InjSys_ratAirMVers2AxisInp rel_uw_q0p0234 12 0.00 1535.977 FORMAT "%8.3" AXIS_PTS_REF InjSys_ratAirM12Vers2_AX /end AXIS_DESCR
/end CHARACTERISTIC
/begin CHARACTERISTIC InjSys_P1V2I1_HO.ratFuMBas_GM "class instance packet 1 variant 2 / relative fuel mass base injection" MAP 0x80564520 RB_MapGroup_U16 3071.953 rel_uw_b3072 0.00 3071.953 FORMAT "%8.3"
 /begin AXIS_DESCR COM_AXIS Epm_nEng EngN 10 0.00 16383.50 FORMAT "%8.2" EXTENDED_LIMITS -16384.00 16383.50 AXIS_PTS_REF InjSys_nEng10_AX /end AXIS_DESCR
 /begin AXIS_DESCR COM_AXIS InjSys_ratAirMAxisInp rel_uw_q0p0234 8 0.00 1535.977 FORMAT "%8.3" AXIS_PTS_REF InjSys_ratAirM08_AX /end AXIS_DESCR
/end CHARACTERISTIC
/begin CHARACTERISTIC InjSys_P1V2I1_HO.stDiTiBreakAux_C "class instance packet 1 variant 2 / state disabling break time for auxiliary injection" VALUE 0x805645C0 RB_Val_Wu8 255.0 dez 0.00 255.0 FORMAT "%5.1" /end CHARACTERISTIC
/begin CHARACTERISTIC InjSys_P1V2I1_HO.tiBreakAux1_M "class instance packet 1 variant 2 / pause time auxiliary injection 1" MAP 0x805645C2 RB_Map_S16U16_S16 1310.680 t_q0p04_ms 0.00 1310.680 FORMAT "%8.3" EXTENDED_LIMITS -1310.720 1310.680
 /begin AXIS_DESCR STD_AXIS Epm_nEng EngN 8 -16384.00 16383.50 FORMAT "%8.2" DEPOSIT ABSOLUTE /end AXIS_DESCR
 /begin AXIS_DESCR STD_AXIS InjSys_ratAirMPredLocSp rel_uw_q0p0234 8 0.00 1535.977 FORMAT "%8.3" DEPOSIT ABSOLUTE /end AXIS_DESCR
/end CHARACTERISTIC
/begin CHARACTERISTIC InjSys_P1V2I2_HO.agBasTPistColdVers2_GM "injection packet 1 in variant 2 / base angle at cold piston temperature (version 2)" MAP 0x80559F08 RB_MapGroup_U8 382.5 kw_q1p5 0.00 382.5 FORMAT "%5.1"
 /begin AXIS_DESCR COM_AXIS Epm_nEng EngN 12 0.00 16383.50 FORMAT "%8.2" EXTENDED_LIMITS -16384.00 16383.50 AXIS_PTS_REF InjSys_nEng12Vers2_AX /end AXIS_DESCR
 /begin AXIS_DESCR COM_AXIS InjSys_ratAirMAgSpVers2AxisInp rel_uw_q0p0234 12 0.00 1535.977 FORMAT "%8.3" AXIS_PTS_REF InjSys_ratAirM12AgSpVers2_AX /end AXIS_DESCR
/end CHARACTERISTIC
/begin CHARACTERISTIC InjSys_P1V2I2_HO.agBasTPistCold_GM "injection packet 1 in variant 2 / base angle at cold piston temperature" MAP 0x80559F98 RB_MapGroup_U8 382.5 kw_q1p5 0.00 382.5 FORMAT "%5.1"
 /begin AXIS_DESCR COM_AXIS Epm_nEng EngN 12 0.00 16383.50 FORMAT "%8.2" EXTENDED_LIMITS -16384.00 16383.50 AXIS_PTS_REF InjSys_nEng12_AX /end AXIS_DESCR
 /begin AXIS_DESCR COM_AXIS InjSys_ratAirMAgSpAxisInp rel_uw_q0p0234 12 0.00 1535.977 FORMAT "%8.3" AXIS_PTS_REF InjSys_ratAirM12AgSp_AX /end AXIS_DESCR
/end CHARACTERISTIC
/begin CHARACTERISTIC InjSys_P1V2I2_HO.agBasTPistWrmVers2_GM "injection packet 1 in variant 2 / base angle for interpolation Warm TSA mode (Version 2)" MAP 0x8055A028 RB_MapGroup_U8 382.5 kw_q1p5 0.00 382.5 FORMAT "%5.1"
 /begin AXIS_DESCR COM_AXIS Epm_nEng EngN 12 0.00 16383.50 FORMAT "%8.2" EXTENDED_LIMITS -16384.00 16383.50 AXIS_PTS_REF InjSys_nEng12Vers2_AX /end AXIS_DESCR
 /begin AXIS_DESCR COM_AXIS InjSys_ratAirMAgSpVers2AxisInp rel_uw_q0p0234 12 0.00 1535.977 FORMAT "%8.3" AXIS_PTS_REF InjSys_ratAirM12AgSpVers2_AX /end AXIS_DESCR
/end CHARACTERISTIC
/begin CHARACTERISTIC InjSys_P1V2I2_HO.agBasTPistWrm_GM "injection packet 1 in variant 2 / base angle for interpolation Warm TSA mode" MAP 0x8055A0B8 RB_MapGroup_U8 382.5 kw_q1p5 0.00 382.5 FORMAT "%5.1"
 /begin AXIS_DESCR COM_AXIS Epm_nEng EngN 12 0.00 16383.50 FORMAT "%8.2" EXTENDED_LIMITS -16384.00 16383.50 AXIS_PTS_REF InjSys_nEng12_AX /end AXIS_DESCR
 /begin AXIS_DESCR COM_AXIS InjSys_ratAirMAgSpAxisInp rel_uw_q0p0234 12 0.00 1535.977 FORMAT "%8.3" AXIS_PTS_REF InjSys_ratAirM12AgSp_AX /end AXIS_DESCR
/end CHARACTERISTIC
/begin CHARACTERISTIC InjSys_P1V2I2_HO.agBgnColdExtdEthnl_GM "injection packet 1 in variant 2 / base angle when charge motion greater threshold" MAP 0x8055A148 RB_MapGroup_U8 191.3 kw_q0p75_o240 240.0 431.3 FORMAT "%5.1"
 /begin AXIS_DESCR COM_AXIS Epm_nEng EngN 12 0.00 16383.50 FORMAT "%8.2" EXTENDED_LIMITS -16384.00 16383.50 AXIS_PTS_REF InjSys_nEng12_AX /end AXIS_DESCR
 /begin AXIS_DESCR COM_AXIS InjSys_ratAirMAxisInp rel_uw_q0p0234 12 0.00 1535.977 FORMAT "%8.3" AXIS_PTS_REF InjSys_ratAirM12_AX /end AXIS_DESCR
/end CHARACTERISTIC
/begin CHARACTERISTIC InjSys_P1V2I2_HO.agBgnColdExtd_GM "injection packet 1 in variant 2 / base angle cold extended" MAP 0x8055A1D8 RB_MapGroup_U8 191.3 kw_q0p75_o240 240.0 431.3 FORMAT "%5.1"
 /begin AXIS_DESCR COM_AXIS Epm_nEng EngN 12 0.00 16383.50 FORMAT "%8.2" EXTENDED_LIMITS -16384.00 16383.50 AXIS_PTS_REF InjSys_nEng12_AX /end AXIS_DESCR
 /begin AXIS_DESCR COM_AXIS InjSys_ratAirMAxisInp rel_uw_q0p0234 12 0.00 1535.977 FORMAT "%8.3" AXIS_PTS_REF InjSys_ratAirM12_AX /end AXIS_DESCR
/end CHARACTERISTIC
/begin CHARACTERISTIC InjSys_P1V2I2_HO.agBgnColdSmlVlvEthnl_GM "injection packet 1 in variant 2 / base angle cold small valve ethanol dependent" MAP 0x8055A268 RB_MapGroup_U8 191.3 kw_q0p75_o240 240.0 431.3 FORMAT "%5.1"
 /begin AXIS_DESCR COM_AXIS Epm_nEng EngN 12 0.00 16383.50 FORMAT "%8.2" EXTENDED_LIMITS -16384.00 16383.50 AXIS_PTS_REF InjSys_nEng12_AX /end AXIS_DESCR
 /begin AXIS_DESCR COM_AXIS InjSys_ratAirMAxisInp rel_uw_q0p0234 12 0.00 1535.977 FORMAT "%8.3" AXIS_PTS_REF InjSys_ratAirM12_AX /end AXIS_DESCR
/end CHARACTERISTIC
/begin CHARACTERISTIC InjSys_P1V2I2_HO.agBgnColdSmlVlv_GM "injection packet 1 in variant 2 / base angle cold small valve" MAP 0x8055A2F8 RB_MapGroup_U8 191.3 kw_q0p75_o240 240.0 431.3 FORMAT "%5.1"
 /begin AXIS_DESCR COM_AXIS Epm_nEng EngN 12 0.00 16383.50 FORMAT "%8.2" EXTENDED_LIMITS -16384.00 16383.50 AXIS_PTS_REF InjSys_nEng12_AX /end AXIS_DESCR
 /begin AXIS_DESCR COM_AXIS InjSys_ratAirMAxisInp rel_uw_q0p0234 12 0.00 1535.977 FORMAT "%8.3" AXIS_PTS_REF InjSys_ratAirM12_AX /end AXIS_DESCR
/end CHARACTERISTIC
/begin CHARACTERISTIC InjSys_P1V2I2_HO.agBgnWrmExtdEthnl_GM "injection packet 1 in variant 2 / base angle warm extended ethanol dependent" MAP 0x8055A388 RB_MapGroup_U8 191.3 kw_q0p75_o240 240.0 431.3 FORMAT "%5.1"
 /begin AXIS_DESCR COM_AXIS Epm_nEng EngN 12 0.00 16383.50 FORMAT "%8.2" EXTENDED_LIMITS -16384.00 16383.50 AXIS_PTS_REF InjSys_nEng12_AX /end AXIS_DESCR
 /begin AXIS_DESCR COM_AXIS InjSys_ratAirMAxisInp rel_uw_q0p0234 12 0.00 1535.977 FORMAT "%8.3" AXIS_PTS_REF InjSys_ratAirM12_AX /end AXIS_DESCR
/end CHARACTERISTIC
/begin CHARACTERISTIC InjSys_P1V2I2_HO.agBgnWrmExtd_GM "injection packet 1 in variant 2 / base angle warm extended" MAP 0x8055A418 RB_MapGroup_U8 191.3 kw_q0p75_o240 240.0 431.3 FORMAT "%5.1"
 /begin AXIS_DESCR COM_AXIS Epm_nEng EngN 12 0.00 16383.50 FORMAT "%8.2" EXTENDED_LIMITS -16384.00 16383.50 AXIS_PTS_REF InjSys_nEng12_AX /end AXIS_DESCR
 /begin AXIS_DESCR COM_AXIS InjSys_ratAirMAxisInp rel_uw_q0p0234 12 0.00 1535.977 FORMAT "%8.3" AXIS_PTS_REF InjSys_ratAirM12_AX /end AXIS_DESCR
/end CHARACTERISTIC
/begin CHARACTERISTIC InjSys_P1V2I2_HO.agBgnWrmSmlVlvEthnl_GM "injection packet 1 in variant 2 / ." MAP 0x8055A4A8 RB_MapGroup_U8 191.3 kw_q0p75_o240 240.0 431.3 FORMAT "%5.1"
 /begin AXIS_DESCR COM_AXIS Epm_nEng EngN 12 0.00 16383.50 FORMAT "%8.2" EXTENDED_LIMITS -16384.00 16383.50 AXIS_PTS_REF InjSys_nEng12_AX /end AXIS_DESCR
 /begin AXIS_DESCR COM_AXIS InjSys_ratAirMAxisInp rel_uw_q0p0234 12 0.00 1535.977 FORMAT "%8.3" AXIS_PTS_REF InjSys_ratAirM12_AX /end AXIS_DESCR
/end CHARACTERISTIC
/begin CHARACTERISTIC InjSys_P1V2I2_HO.agBgnWrmSmlVlv_GM "injection packet 1 in variant 2 / ." MAP 0x8055A538 RB_MapGroup_U8 191.3 kw_q0p75_o240 240.0 431.3 FORMAT "%5.1"
 /begin AXIS_DESCR COM_AXIS Epm_nEng EngN 12 0.00 16383.50 FORMAT "%8.2" EXTENDED_LIMITS -16384.00 16383.50 AXIS_PTS_REF InjSys_nEng12_AX /end AXIS_DESCR
 /begin AXIS_DESCR COM_AXIS InjSys_ratAirMAxisInp rel_uw_q0p0234 12 0.00 1535.977 FORMAT "%8.3" AXIS_PTS_REF InjSys_ratAirM12_AX /end AXIS_DESCR
/end CHARACTERISTIC
/begin CHARACTERISTIC InjSys_P1V2I2_HO.agDeltaEth_M "injection packet 1 in variant 2 / delta angle ethanol dependent" MAP 0x8055A5C8 RB_Map_S16S16_S16 191.2500 kw_q0p75 -96.00000 95.25000 FORMAT "%8.5" EXTENDED_LIMITS -24576.00 24575.25
 /begin AXIS_DESCR STD_AXIS InjSys_facEthLnrLocSp fak_ub_b2 4 0.00 1.992188 FORMAT "%8.6" EXTENDED_LIMITS -256.0000 255.9922 DEPOSIT ABSOLUTE /end AXIS_DESCR
 /begin AXIS_DESCR STD_AXIS InjSys_tEng Temp_Cels 4 -3549.940 3003.560 FORMAT "%8.3" DEPOSIT ABSOLUTE /end AXIS_DESCR
/end CHARACTERISTIC
/begin CHARACTERISTIC InjSys_P1V2I2_HO.agDeltaLamBasCold_M "injection packet 1 in variant 2 / cold angle base lambda dependent and engine temperature dependent" MAP 0x8055A5FC RB_Map_S16U16_S16 191.2500 kw_q0p75 -96.00000 95.25000 FORMAT "%8.5" EXTENDED_LIMITS -24576.00 24575.25
 /begin AXIS_DESCR STD_AXIS Epm_nEng EngN 8 -16384.00 16383.50 FORMAT "%8.2" DEPOSIT ABSOLUTE /end AXIS_DESCR
 /begin AXIS_DESCR STD_AXIS InjSys_ratAirMPredLocSp rel_uw_q0p0234 6 0.00 1535.977 FORMAT "%8.3" DEPOSIT ABSOLUTE /end AXIS_DESCR
/end CHARACTERISTIC
/begin CHARACTERISTIC InjSys_P1V2I2_HO.agDeltaLamBasWrm_M "injection packet 1 in variant 2 / warm angle base lambda dependent and engine temperature dependent" MAP 0x8055A67C RB_Map_S16U16_S16 191.2500 kw_q0p75 -96.00000 95.25000 FORMAT "%8.5" EXTENDED_LIMITS -24576.00 24575.25
 /begin AXIS_DESCR STD_AXIS Epm_nEng EngN 8 -16384.00 16383.50 FORMAT "%8.2" DEPOSIT ABSOLUTE /end AXIS_DESCR
 /begin AXIS_DESCR STD_AXIS InjSys_ratAirMPredLocSp rel_uw_q0p0234 6 0.00 1535.977 FORMAT "%8.3" DEPOSIT ABSOLUTE /end AXIS_DESCR
/end CHARACTERISTIC
/begin CHARACTERISTIC InjSys_P1V2I2_HO.agDeltaLam_M "injection packet 1 in variant 2 / ." MAP 0x8055A6FC RB_Map_S16U16_S16 191.2500 kw_q0p75 -96.00000 95.25000 FORMAT "%8.5" EXTENDED_LIMITS -24576.00 24575.25
 /begin AXIS_DESCR STD_AXIS Epm_nEng EngN 10 -16384.00 16383.50 FORMAT "%8.2" DEPOSIT ABSOLUTE /end AXIS_DESCR
 /begin AXIS_DESCR STD_AXIS InjSys_ratAirMPredLocSp rel_uw_q0p0234 8 0.00 1535.977 FORMAT "%8.3" DEPOSIT ABSOLUTE /end AXIS_DESCR
/end CHARACTERISTIC
/begin CHARACTERISTIC InjSys_P1V2I2_HO.agDeltaTEngOilVers2_GM "injection packet 1 in variant 2 / delta angle engine- and oil- temperature dependent" MAP 0x8055A7C4 RB_MapGroup_S8 191.3 kw_q0p75 -96.00 95.25 FORMAT "%5.2"
 /begin AXIS_DESCR COM_AXIS Epm_nEng EngN 12 0.00 16383.50 FORMAT "%8.2" EXTENDED_LIMITS -16384.00 16383.50 AXIS_PTS_REF InjSys_nEng12Vers2_AX /end AXIS_DESCR
 /begin AXIS_DESCR COM_AXIS InjSys_ratAirMAgSpVers2AxisInp rel_uw_q0p0234 12 0.00 1535.977 FORMAT "%8.3" AXIS_PTS_REF InjSys_ratAirM12AgSpVers2_AX /end AXIS_DESCR
/end CHARACTERISTIC
/begin CHARACTERISTIC InjSys_P1V2I2_HO.agDeltaTEngOil_GM "injection packet 1 in variant 2 / delta angle engine- and oil- temperature dependent" MAP 0x8055A854 RB_MapGroup_S8 191.3 kw_q0p75 -96.00 95.25 FORMAT "%5.2"
 /begin AXIS_DESCR COM_AXIS Epm_nEng EngN 12 0.00 16383.50 FORMAT "%8.2" EXTENDED_LIMITS -16384.00 16383.50 AXIS_PTS_REF InjSys_nEng12_AX /end AXIS_DESCR
 /begin AXIS_DESCR COM_AXIS InjSys_ratAirMAgSpAxisInp rel_uw_q0p0234 12 0.00 1535.977 FORMAT "%8.3" AXIS_PTS_REF InjSys_ratAirM12AgSp_AX /end AXIS_DESCR
/end CHARACTERISTIC
/begin CHARACTERISTIC InjSys_P1V2I2_HO.facAgBgnLam_T "injection packet 1 in variant 2 / ." CURVE 0x8055A8E4 RB_Curve_U8_U8 0.9961 fak_ub_b1 0.00 0.9961
 /begin AXIS_DESCR STD_AXIS InjSys_facLamBasLocSp fak_ub_b2 8 0.00 1.992188 FORMAT "%8.6" DEPOSIT ABSOLUTE /end AXIS_DESCR
/end CHARACTERISTIC
/begin CHARACTERISTIC InjSys_P1V2I2_HO.facEthnlAgBgn_T "injection packet 1 in variant 2 / ." CURVE 0x8055A8F5 RB_Curve_U8_U8 0.9961 fak_ub_b1 0.00 0.9961
 /begin AXIS_DESCR STD_AXIS fethstoeLocSp fak_ub_b2 4 0.00 1.992188 FORMAT "%8.6" DEPOSIT ABSOLUTE /end AXIS_DESCR
/end CHARACTERISTIC
/begin CHARACTERISTIC InjSys_P1V2I2_HO.facSpltAux1Extd_GM "injection packet 1 in variant 2 / split factor auxiliary injection 1" MAP 0x8055A8FE RB_MapGroup_U8 0.9961 fak_ub_b1 0.00 0.9961
 /begin AXIS_DESCR COM_AXIS Epm_nEng EngN 12 0.00 16383.50 FORMAT "%8.2" EXTENDED_LIMITS -16384.00 16383.50 AXIS_PTS_REF InjSys_nEng12Vers2_AX /end AXIS_DESCR
 /begin AXIS_DESCR COM_AXIS InjSys_ratAirMVers2AxisInp rel_uw_q0p0234 12 0.00 1535.977 FORMAT "%8.3" AXIS_PTS_REF InjSys_ratAirM12Vers2_AX /end AXIS_DESCR
/end CHARACTERISTIC
/begin CHARACTERISTIC InjSys_P1V2I2_HO.facSpltAux1_GM "injection packet 1 in variant 2 / split factor auxiliary injection 1" MAP 0x8055A98E RB_MapGroup_U8 0.9961 fak_ub_b1 0.00 0.9961
 /begin AXIS_DESCR COM_AXIS Epm_nEng EngN 10 0.00 16383.50 FORMAT "%8.2" EXTENDED_LIMITS -16384.00 16383.50 AXIS_PTS_REF InjSys_nEng10_AX /end AXIS_DESCR
 /begin AXIS_DESCR COM_AXIS InjSys_ratAirMAxisInp rel_uw_q0p0234 8 0.00 1535.977 FORMAT "%8.3" AXIS_PTS_REF InjSys_ratAirM08_AX /end AXIS_DESCR
/end CHARACTERISTIC
/begin CHARACTERISTIC InjSys_P1V2I2_HO.facTPistCold_M "injection packet 1 in variant 2 / delta angle ethanol dependent" MAP 0x8055A9DE RB_Map_S16S16_U8 0.9961 fak_ub_b1 0.00 0.9961
 /begin AXIS_DESCR STD_AXIS InjSys_tEng Temp_Cels 8 -3549.940 3003.560 FORMAT "%8.3" DEPOSIT ABSOLUTE /end AXIS_DESCR
 /begin AXIS_DESCR STD_AXIS InjSys_tOilLocSp Temp_Cels 8 -3549.940 3003.560 FORMAT "%8.3" DEPOSIT ABSOLUTE /end AXIS_DESCR
/end CHARACTERISTIC
/begin CHARACTERISTIC InjSys_P1V2I2_HO.facTPist_M "injection packet 1 in variant 2 / factor piston temperature" MAP 0x8055AA42 RB_Map_S16S16_U8 0.9961 fak_ub_b1 0.00 0.9961
 /begin AXIS_DESCR STD_AXIS InjSys_tPistBas Temp_Cels 6 -3549.940 3003.560 FORMAT "%8.3" DEPOSIT ABSOLUTE /end AXIS_DESCR
 /begin AXIS_DESCR STD_AXIS InjSys_tPistDelta temp_q0p1 6 -3276.800 3276.700 FORMAT "%8.3" DEPOSIT ABSOLUTE /end AXIS_DESCR
/end CHARACTERISTIC
/begin CHARACTERISTIC InjSys_P1V2I2_HO.facWghtAgDeltaLamBasCold_T "injection packet 1 in variant 2 / weighting factor cold delta angle engine and oil temperature dependent" CURVE 0x8055AA82 RB_Curve_U8_U8 0.9961 fak_ub_b1 0.00 0.9961
 /begin AXIS_DESCR STD_AXIS InjSys_facLamBasLocSp fak_ub_b2 3 0.00 1.992188 FORMAT "%8.6" DEPOSIT ABSOLUTE /end AXIS_DESCR
/end CHARACTERISTIC
/begin CHARACTERISTIC InjSys_P1V2I2_HO.facWghtAgDeltaLamBasWrm_T "injection packet 1 in variant 2 / weighting factor warm delta angle engine and oil temperature dependent" CURVE 0x8055AA89 RB_Curve_U8_U8 0.9961 fak_ub_b1 0.00 0.9961
 /begin AXIS_DESCR STD_AXIS InjSys_facLamBasLocSp fak_ub_b2 3 0.00 1.992188 FORMAT "%8.6" DEPOSIT ABSOLUTE /end AXIS_DESCR
/end CHARACTERISTIC
/begin CHARACTERISTIC InjSys_P1V2I2_HO.facWghtColdWrmEthnl_M "injection packet 1 in variant 2 / ." MAP 0x8055AA90 RB_Map_S16S16_U8 0.9961 fak_ub_b1 0.00 0.9961
 /begin AXIS_DESCR STD_AXIS InjSys_tEng Temp_Cels 6 -3549.940 3003.560 FORMAT "%8.3" DEPOSIT ABSOLUTE /end AXIS_DESCR
 /begin AXIS_DESCR STD_AXIS InjSys_tOilLocSp Temp_Cels 4 -3549.940 3003.560 FORMAT "%8.3" DEPOSIT ABSOLUTE /end AXIS_DESCR
/end CHARACTERISTIC
/begin CHARACTERISTIC InjSys_P1V2I2_HO.facWghtColdWrm_M "injection packet 1 in variant 2 / ." MAP 0x8055AAC0 RB_Map_S16S16_U8 0.9961 fak_ub_b1 0.00 0.9961
 /begin AXIS_DESCR STD_AXIS InjSys_tEng Temp_Cels 6 -3549.940 3003.560 FORMAT "%8.3" DEPOSIT ABSOLUTE /end AXIS_DESCR
 /begin AXIS_DESCR STD_AXIS InjSys_tOilLocSp Temp_Cels 4 -3549.940 3003.560 FORMAT "%8.3" DEPOSIT ABSOLUTE /end AXIS_DESCR
/end CHARACTERISTIC
/begin CHARACTERISTIC InjSys_P1V2I2_HO.facWghtWrmCold_M "injection packet 1 in variant 2 / weighting factor warm-cold delta angle engine- and oil- temperature dependent" MAP 0x8055AAF0 RB_Map_S16S16_U8 0.9961 fak_ub_b1 0.00 0.9961
 /begin AXIS_DESCR STD_AXIS InjSys_tEng Temp_Cels 6 -3549.940 3003.560 FORMAT "%8.3" DEPOSIT ABSOLUTE /end AXIS_DESCR
 /begin AXIS_DESCR STD_AXIS InjSys_tOilLocSp Temp_Cels 4 -3549.940 3003.560 FORMAT "%8.3" DEPOSIT ABSOLUTE /end AXIS_DESCR
/end CHARACTERISTIC
/begin CHARACTERISTIC InjSys_P1V2I2_HO.flgAbsltSplt_C "injection packet 1 in variant 2 / condition split with absolute fuel mass" VALUE 0x8055AB20 RB_Val_Wu8 1.00000000000 B_TRUE 0.00 1.00000000000 FORMAT "%13.11" /end CHARACTERISTIC
/begin CHARACTERISTIC InjSys_P1V2I2_HO.flgAxVers_C "injection packet 1 in variant 2 / condition map selection with group axis in version 2" VALUE 0x8055AB21 RB_Val_Wu8 1.00000000000 B_TRUE 0.00 1.00000000000 FORMAT "%13.11" /end CHARACTERISTIC
/begin CHARACTERISTIC InjSys_P1V2I2_HO.flgPltInj_C "injection packet 1 in variant 2 / condition pilot injection" VALUE 0x8055AB22 RB_Val_Wu8 1.00000000000 B_TRUE 0.00 1.00000000000 FORMAT "%13.11" /end CHARACTERISTIC
/begin CHARACTERISTIC InjSys_P1V2I2_HO.ratFuMAux1_GM "injection packet 1 in variant 2 / relative fuel mass auxiliary injection 1" MAP 0x8055AB24 RB_MapGroup_U16 3071.953 rel_uw_b3072 0.00 3071.953 FORMAT "%8.3"
 /begin AXIS_DESCR COM_AXIS Epm_nEng EngN 10 0.00 16383.50 FORMAT "%8.2" EXTENDED_LIMITS -16384.00 16383.50 AXIS_PTS_REF InjSys_nEng10_AX /end AXIS_DESCR
 /begin AXIS_DESCR COM_AXIS InjSys_ratAirMAxisInp rel_uw_q0p0234 8 0.00 1535.977 FORMAT "%8.3" AXIS_PTS_REF InjSys_ratAirM08_AX /end AXIS_DESCR
/end CHARACTERISTIC
/begin CHARACTERISTIC InjSys_P1V2I2_HO.ratFuMBasExtd_GM "injection packet 1 in variant 2 / relative fuel mass base injection" MAP 0x8055ABC4 RB_MapGroup_U16 3071.953 rel_uw_b3072 0.00 3071.953 FORMAT "%8.3"
 /begin AXIS_DESCR COM_AXIS Epm_nEng EngN 12 0.00 16383.50 FORMAT "%8.2" EXTENDED_LIMITS -16384.00 16383.50 AXIS_PTS_REF InjSys_nEng12Vers2_AX /end AXIS_DESCR
 /begin AXIS_DESCR COM_AXIS InjSys_ratAirMVers2AxisInp rel_uw_q0p0234 12 0.00 1535.977 FORMAT "%8.3" AXIS_PTS_REF InjSys_ratAirM12Vers2_AX /end AXIS_DESCR
/end CHARACTERISTIC
/begin CHARACTERISTIC InjSys_P1V2I2_HO.ratFuMBas_GM "injection packet 1 in variant 2 / relative fuel mass base injection" MAP 0x8055ACE4 RB_MapGroup_U16 3071.953 rel_uw_b3072 0.00 3071.953 FORMAT "%8.3"
 /begin AXIS_DESCR COM_AXIS Epm_nEng EngN 10 0.00 16383.50 FORMAT "%8.2" EXTENDED_LIMITS -16384.00 16383.50 AXIS_PTS_REF InjSys_nEng10_AX /end AXIS_DESCR
 /begin AXIS_DESCR COM_AXIS InjSys_ratAirMAxisInp rel_uw_q0p0234 8 0.00 1535.977 FORMAT "%8.3" AXIS_PTS_REF InjSys_ratAirM08_AX /end AXIS_DESCR
/end CHARACTERISTIC
/begin CHARACTERISTIC InjSys_P1V2I2_HO.stDiTiBreakAux_C "injection packet 1 in variant 2 / state disabling break time for auxiliary injection" VALUE 0x8055AD84 RB_Val_Wu8 255.0 dez 0.00 255.0 FORMAT "%5.1" /end CHARACTERISTIC
/begin CHARACTERISTIC InjSys_P1V2I2_HO.tiBreakAux1_M "injection packet 1 in variant 2 / pause time auxiliary injection 1" MAP 0x8055AD86 RB_Map_S16U16_S16 1310.680 t_q0p04_ms 0.00 1310.680 FORMAT "%8.3" EXTENDED_LIMITS -1310.720 1310.680
 /begin AXIS_DESCR STD_AXIS Epm_nEng EngN 8 -16384.00 16383.50 FORMAT "%8.2" DEPOSIT ABSOLUTE /end AXIS_DESCR
 /begin AXIS_DESCR STD_AXIS InjSys_ratAirMPredLocSp rel_uw_q0p0234 8 0.00 1535.977 FORMAT "%8.3" DEPOSIT ABSOLUTE /end AXIS_DESCR
/end CHARACTERISTIC
/begin CHARACTERISTIC InjSys_P1V3I1_HO.agBasTPistColdVers2_GM "class instance packet 1 variant 3 / base angle at cold piston temperature (version 2)" MAP 0x8056466C RB_MapGroup_U8 382.5 kw_q1p5 0.00 382.5 FORMAT "%5.1"
 /begin AXIS_DESCR COM_AXIS Epm_nEng EngN 12 0.00 16383.50 FORMAT "%8.2" EXTENDED_LIMITS -16384.00 16383.50 AXIS_PTS_REF InjSys_nEng12Vers2_AX /end AXIS_DESCR
 /begin AXIS_DESCR COM_AXIS InjSys_ratAirMAgSpVers2AxisInp rel_uw_q0p0234 12 0.00 1535.977 FORMAT "%8.3" AXIS_PTS_REF InjSys_ratAirM12AgSpVers2_AX /end AXIS_DESCR
/end CHARACTERISTIC
/begin CHARACTERISTIC InjSys_P1V3I1_HO.agBasTPistCold_GM "class instance packet 1 variant 3 / base angle at cold piston temperature" MAP 0x805646FC RB_MapGroup_U8 382.5 kw_q1p5 0.00 382.5 FORMAT "%5.1"
 /begin AXIS_DESCR COM_AXIS Epm_nEng EngN 12 0.00 16383.50 FORMAT "%8.2" EXTENDED_LIMITS -16384.00 16383.50 AXIS_PTS_REF InjSys_nEng12_AX /end AXIS_DESCR
 /begin AXIS_DESCR COM_AXIS InjSys_ratAirMAgSpAxisInp rel_uw_q0p0234 12 0.00 1535.977 FORMAT "%8.3" AXIS_PTS_REF InjSys_ratAirM12AgSp_AX /end AXIS_DESCR
/end CHARACTERISTIC
/begin CHARACTERISTIC InjSys_P1V3I1_HO.agBasTPistWrmVers2_GM "class instance packet 1 variant 3 / base angle for interpolation Warm TSA mode (Version 2)" MAP 0x8056478C RB_MapGroup_U8 382.5 kw_q1p5 0.00 382.5 FORMAT "%5.1"
 /begin AXIS_DESCR COM_AXIS Epm_nEng EngN 12 0.00 16383.50 FORMAT "%8.2" EXTENDED_LIMITS -16384.00 16383.50 AXIS_PTS_REF InjSys_nEng12Vers2_AX /end AXIS_DESCR
 /begin AXIS_DESCR COM_AXIS InjSys_ratAirMAgSpVers2AxisInp rel_uw_q0p0234 12 0.00 1535.977 FORMAT "%8.3" AXIS_PTS_REF InjSys_ratAirM12AgSpVers2_AX /end AXIS_DESCR
/end CHARACTERISTIC
/begin CHARACTERISTIC InjSys_P1V3I1_HO.agBasTPistWrm_GM "class instance packet 1 variant 3 / base angle for interpolation Warm TSA mode" MAP 0x8056481C RB_MapGroup_U8 382.5 kw_q1p5 0.00 382.5 FORMAT "%5.1"
 /begin AXIS_DESCR COM_AXIS Epm_nEng EngN 12 0.00 16383.50 FORMAT "%8.2" EXTENDED_LIMITS -16384.00 16383.50 AXIS_PTS_REF InjSys_nEng12_AX /end AXIS_DESCR
 /begin AXIS_DESCR COM_AXIS InjSys_ratAirMAgSpAxisInp rel_uw_q0p0234 12 0.00 1535.977 FORMAT "%8.3" AXIS_PTS_REF InjSys_ratAirM12AgSp_AX /end AXIS_DESCR
/end CHARACTERISTIC
/begin CHARACTERISTIC InjSys_P1V3I1_HO.agBgnColdExtdEthnl_GM "class instance packet 1 variant 3 / ." MAP 0x805648AC RB_MapGroup_U8 191.3 kw_q0p75_o240 240.0 431.3 FORMAT "%5.1"
 /begin AXIS_DESCR COM_AXIS Epm_nEng EngN 12 0.00 16383.50 FORMAT "%8.2" EXTENDED_LIMITS -16384.00 16383.50 AXIS_PTS_REF InjSys_nEng12_AX /end AXIS_DESCR
 /begin AXIS_DESCR COM_AXIS InjSys_ratAirMAxisInp rel_uw_q0p0234 12 0.00 1535.977 FORMAT "%8.3" AXIS_PTS_REF InjSys_ratAirM12_AX /end AXIS_DESCR
/end CHARACTERISTIC
/begin CHARACTERISTIC InjSys_P1V3I1_HO.agBgnColdExtd_GM "class instance packet 1 variant 3 / ." MAP 0x8056493C RB_MapGroup_U8 191.3 kw_q0p75_o240 240.0 431.3 FORMAT "%5.1"
 /begin AXIS_DESCR COM_AXIS Epm_nEng EngN 12 0.00 16383.50 FORMAT "%8.2" EXTENDED_LIMITS -16384.00 16383.50 AXIS_PTS_REF InjSys_nEng12_AX /end AXIS_DESCR
 /begin AXIS_DESCR COM_AXIS InjSys_ratAirMAxisInp rel_uw_q0p0234 12 0.00 1535.977 FORMAT "%8.3" AXIS_PTS_REF InjSys_ratAirM12_AX /end AXIS_DESCR
/end CHARACTERISTIC
/begin CHARACTERISTIC InjSys_P1V3I1_HO.agBgnColdSmlVlvEthnl_GM "class instance packet 1 variant 3 / ." MAP 0x805649CC RB_MapGroup_U8 191.3 kw_q0p75_o240 240.0 431.3 FORMAT "%5.1"
 /begin AXIS_DESCR COM_AXIS Epm_nEng EngN 12 0.00 16383.50 FORMAT "%8.2" EXTENDED_LIMITS -16384.00 16383.50 AXIS_PTS_REF InjSys_nEng12_AX /end AXIS_DESCR
 /begin AXIS_DESCR COM_AXIS InjSys_ratAirMAxisInp rel_uw_q0p0234 12 0.00 1535.977 FORMAT "%8.3" AXIS_PTS_REF InjSys_ratAirM12_AX /end AXIS_DESCR
/end CHARACTERISTIC
/begin CHARACTERISTIC InjSys_P1V3I1_HO.agBgnColdSmlVlv_GM "class instance packet 1 variant 3 / ." MAP 0x80564A5C RB_MapGroup_U8 191.3 kw_q0p75_o240 240.0 431.3 FORMAT "%5.1"
 /begin AXIS_DESCR COM_AXIS Epm_nEng EngN 12 0.00 16383.50 FORMAT "%8.2" EXTENDED_LIMITS -16384.00 16383.50 AXIS_PTS_REF InjSys_nEng12_AX /end AXIS_DESCR
 /begin AXIS_DESCR COM_AXIS InjSys_ratAirMAxisInp rel_uw_q0p0234 12 0.00 1535.977 FORMAT "%8.3" AXIS_PTS_REF InjSys_ratAirM12_AX /end AXIS_DESCR
/end CHARACTERISTIC
/begin CHARACTERISTIC InjSys_P1V3I1_HO.agBgnWrmExtdEthnl_GM "class instance packet 1 variant 3 / ." MAP 0x80564AEC RB_MapGroup_U8 191.3 kw_q0p75_o240 240.0 431.3 FORMAT "%5.1"
 /begin AXIS_DESCR COM_AXIS Epm_nEng EngN 12 0.00 16383.50 FORMAT "%8.2" EXTENDED_LIMITS -16384.00 16383.50 AXIS_PTS_REF InjSys_nEng12_AX /end AXIS_DESCR
 /begin AXIS_DESCR COM_AXIS InjSys_ratAirMAxisInp rel_uw_q0p0234 12 0.00 1535.977 FORMAT "%8.3" AXIS_PTS_REF InjSys_ratAirM12_AX /end AXIS_DESCR
/end CHARACTERISTIC
/begin CHARACTERISTIC InjSys_P1V3I1_HO.agBgnWrmExtd_GM "class instance packet 1 variant 3 / ." MAP 0x80564B7C RB_MapGroup_U8 191.3 kw_q0p75_o240 240.0 431.3 FORMAT "%5.1"
 /begin AXIS_DESCR COM_AXIS Epm_nEng EngN 12 0.00 16383.50 FORMAT "%8.2" EXTENDED_LIMITS -16384.00 16383.50 AXIS_PTS_REF InjSys_nEng12_AX /end AXIS_DESCR
 /begin AXIS_DESCR COM_AXIS InjSys_ratAirMAxisInp rel_uw_q0p0234 12 0.00 1535.977 FORMAT "%8.3" AXIS_PTS_REF InjSys_ratAirM12_AX /end AXIS_DESCR
/end CHARACTERISTIC
/begin CHARACTERISTIC InjSys_P1V3I1_HO.agBgnWrmSmlVlvWEthnl_GM "class instance packet 1 variant 3 / ." MAP 0x80564C0C RB_MapGroup_U8 191.3 kw_q0p75_o240 240.0 431.3 FORMAT "%5.1"
 /begin AXIS_DESCR COM_AXIS Epm_nEng EngN 12 0.00 16383.50 FORMAT "%8.2" EXTENDED_LIMITS -16384.00 16383.50 AXIS_PTS_REF InjSys_nEng12_AX /end AXIS_DESCR
 /begin AXIS_DESCR COM_AXIS InjSys_ratAirMAxisInp rel_uw_q0p0234 12 0.00 1535.977 FORMAT "%8.3" AXIS_PTS_REF InjSys_ratAirM12_AX /end AXIS_DESCR
/end CHARACTERISTIC
/begin CHARACTERISTIC InjSys_P1V3I1_HO.agBgnWrmSmlVlv_GM "class instance packet 1 variant 3 / ." MAP 0x80564C9C RB_MapGroup_U8 191.3 kw_q0p75_o240 240.0 431.3 FORMAT "%5.1"
 /begin AXIS_DESCR COM_AXIS Epm_nEng EngN 12 0.00 16383.50 FORMAT "%8.2" EXTENDED_LIMITS -16384.00 16383.50 AXIS_PTS_REF InjSys_nEng12_AX /end AXIS_DESCR
 /begin AXIS_DESCR COM_AXIS InjSys_ratAirMAxisInp rel_uw_q0p0234 12 0.00 1535.977 FORMAT "%8.3" AXIS_PTS_REF InjSys_ratAirM12_AX /end AXIS_DESCR
/end CHARACTERISTIC
/begin CHARACTERISTIC InjSys_P1V3I1_HO.agDeltaEth_M "class instance packet 1 variant 3 / delta angle ethanol dependent" MAP 0x80564D2C RB_Map_S16S16_S16 191.2500 kw_q0p75 -96.00000 95.25000 FORMAT "%8.5" EXTENDED_LIMITS -24576.00 24575.25
 /begin AXIS_DESCR STD_AXIS InjSys_facEthLnrLocSp fak_ub_b2 4 0.00 1.992188 FORMAT "%8.6" EXTENDED_LIMITS -256.0000 255.9922 DEPOSIT ABSOLUTE /end AXIS_DESCR
 /begin AXIS_DESCR STD_AXIS InjSys_tEng Temp_Cels 4 -3549.940 3003.560 FORMAT "%8.3" DEPOSIT ABSOLUTE /end AXIS_DESCR
/end CHARACTERISTIC
/begin CHARACTERISTIC InjSys_P1V3I1_HO.agDeltaLamBasCold_M "class instance packet 1 variant 3 / cold angle base lambda dependent and engine temperature dependent" MAP 0x80564D60 RB_Map_S16U16_S16 191.2500 kw_q0p75 -96.00000 95.25000 FORMAT "%8.5" EXTENDED_LIMITS -24576.00 24575.25
 /begin AXIS_DESCR STD_AXIS Epm_nEng EngN 8 -16384.00 16383.50 FORMAT "%8.2" DEPOSIT ABSOLUTE /end AXIS_DESCR
 /begin AXIS_DESCR STD_AXIS InjSys_ratAirMPredLocSp rel_uw_q0p0234 6 0.00 1535.977 FORMAT "%8.3" DEPOSIT ABSOLUTE /end AXIS_DESCR
/end CHARACTERISTIC
/begin CHARACTERISTIC InjSys_P1V3I1_HO.agDeltaLamBasWrm_M "class instance packet 1 variant 3 / warm angle base lambda dependent and engine temperature dependent" MAP 0x80564DE0 RB_Map_S16U16_S16 191.2500 kw_q0p75 -96.00000 95.25000 FORMAT "%8.5" EXTENDED_LIMITS -24576.00 24575.25
 /begin AXIS_DESCR STD_AXIS Epm_nEng EngN 8 -16384.00 16383.50 FORMAT "%8.2" DEPOSIT ABSOLUTE /end AXIS_DESCR
 /begin AXIS_DESCR STD_AXIS InjSys_ratAirMPredLocSp rel_uw_q0p0234 6 0.00 1535.977 FORMAT "%8.3" DEPOSIT ABSOLUTE /end AXIS_DESCR
/end CHARACTERISTIC
/begin CHARACTERISTIC InjSys_P1V3I1_HO.agDeltaLam_M "class instance packet 1 variant 3 / ." MAP 0x80564E60 RB_Map_S16U16_S16 191.2500 kw_q0p75 -96.00000 95.25000 FORMAT "%8.5" EXTENDED_LIMITS -24576.00 24575.25
 /begin AXIS_DESCR STD_AXIS Epm_nEng EngN 10 -16384.00 16383.50 FORMAT "%8.2" DEPOSIT ABSOLUTE /end AXIS_DESCR
 /begin AXIS_DESCR STD_AXIS InjSys_ratAirMPredLocSp kw_q0p0234 8 0.00 1535.977 FORMAT "%8.3" DEPOSIT ABSOLUTE /end AXIS_DESCR
/end CHARACTERISTIC
/begin CHARACTERISTIC InjSys_P1V3I1_HO.agDeltaTEngOilVers2_GM "class instance packet 1 variant 3 / delta angle engine- and oil- temperature dependent" MAP 0x80564F28 RB_MapGroup_S8 191.3 kw_q0p75 -96.00 95.25 FORMAT "%5.2"
 /begin AXIS_DESCR COM_AXIS Epm_nEng EngN 12 0.00 16383.50 FORMAT "%8.2" EXTENDED_LIMITS -16384.00 16383.50 AXIS_PTS_REF InjSys_nEng12Vers2_AX /end AXIS_DESCR
 /begin AXIS_DESCR COM_AXIS InjSys_ratAirMAgSpVers2AxisInp rel_uw_q0p0234 12 0.00 1535.977 FORMAT "%8.3" AXIS_PTS_REF InjSys_ratAirM12AgSpVers2_AX /end AXIS_DESCR
/end CHARACTERISTIC
/begin CHARACTERISTIC InjSys_P1V3I1_HO.agDeltaTEngOil_GM "class instance packet 1 variant 3 / delta angle engine- and oil- temperature dependent" MAP 0x80564FB8 RB_MapGroup_S8 191.3 kw_q0p75 -96.00 95.25 FORMAT "%5.2"
 /begin AXIS_DESCR COM_AXIS Epm_nEng EngN 12 0.00 16383.50 FORMAT "%8.2" EXTENDED_LIMITS -16384.00 16383.50 AXIS_PTS_REF InjSys_nEng12_AX /end AXIS_DESCR
 /begin AXIS_DESCR COM_AXIS InjSys_ratAirMAgSpAxisInp rel_uw_q0p0234 12 0.00 1535.977 FORMAT "%8.3" AXIS_PTS_REF InjSys_ratAirM12AgSp_AX /end AXIS_DESCR
/end CHARACTERISTIC
/begin CHARACTERISTIC InjSys_P1V3I1_HO.facAgBgnLam_T "class instance packet 1 variant 3 / ." CURVE 0x80565048 RB_Curve_U8_U8 0.9961 fak_ub_b1 0.00 0.9961
 /begin AXIS_DESCR STD_AXIS InjSys_facLamBasLocSp fak_ub_b2 8 0.00 1.992188 FORMAT "%8.6" DEPOSIT ABSOLUTE /end AXIS_DESCR
/end CHARACTERISTIC
/begin CHARACTERISTIC InjSys_P1V3I1_HO.facEthnlAgBgn_T "class instance packet 1 variant 3 / ." CURVE 0x80565059 RB_Curve_U8_U8 0.9961 fak_ub_b1 0.00 0.9961
 /begin AXIS_DESCR STD_AXIS fethstoeLocSp fak_ub_b2 4 0.00 1.992188 FORMAT "%8.6" DEPOSIT ABSOLUTE /end AXIS_DESCR
/end CHARACTERISTIC
/begin CHARACTERISTIC InjSys_P1V3I1_HO.facSpltAux1Extd_GM "class instance packet 1 variant 3 / split factor auxiliary injection 1" MAP 0x80565062 RB_MapGroup_U8 0.9961 fak_ub_b1 0.00 0.9961
 /begin AXIS_DESCR COM_AXIS Epm_nEng EngN 12 0.00 16383.50 FORMAT "%8.2" EXTENDED_LIMITS -16384.00 16383.50 AXIS_PTS_REF InjSys_nEng12Vers2_AX /end AXIS_DESCR
 /begin AXIS_DESCR COM_AXIS InjSys_ratAirMVers2AxisInp rel_uw_q0p0234 12 0.00 1535.977 FORMAT "%8.3" AXIS_PTS_REF InjSys_ratAirM12Vers2_AX /end AXIS_DESCR
/end CHARACTERISTIC
/begin CHARACTERISTIC InjSys_P1V3I1_HO.facSpltAux1_GM "class instance packet 1 variant 3 / split factor auxiliary injection 1" MAP 0x805650F2 RB_MapGroup_U8 0.9961 fak_ub_b1 0.00 0.9961
 /begin AXIS_DESCR COM_AXIS Epm_nEng EngN 10 0.00 16383.50 FORMAT "%8.2" EXTENDED_LIMITS -16384.00 16383.50 AXIS_PTS_REF InjSys_nEng10_AX /end AXIS_DESCR
 /begin AXIS_DESCR COM_AXIS InjSys_ratAirMAxisInp rel_uw_q0p0234 8 0.00 1535.977 FORMAT "%8.3" AXIS_PTS_REF InjSys_ratAirM08_AX /end AXIS_DESCR
/end CHARACTERISTIC
/begin CHARACTERISTIC InjSys_P1V3I1_HO.facSpltAux2Extd_GM "class instance packet 1 variant 3 / split factor auxiliary injection 2" MAP 0x80565142 RB_MapGroup_U8 0.9961 fak_ub_b1 0.00 0.9961
 /begin AXIS_DESCR COM_AXIS Epm_nEng EngN 12 0.00 16383.50 FORMAT "%8.2" EXTENDED_LIMITS -16384.00 16383.50 AXIS_PTS_REF InjSys_nEng12Vers2_AX /end AXIS_DESCR
 /begin AXIS_DESCR COM_AXIS InjSys_ratAirMVers2AxisInp rel_uw_q0p0234 12 0.00 1535.977 FORMAT "%8.3" AXIS_PTS_REF InjSys_ratAirM12Vers2_AX /end AXIS_DESCR
/end CHARACTERISTIC
/begin CHARACTERISTIC InjSys_P1V3I1_HO.facSpltAux2_GM "class instance packet 1 variant 3 / split factor auxiliary injection 2" MAP 0x805651D2 RB_MapGroup_U8 0.9961 fak_ub_b1 0.00 0.9961
 /begin AXIS_DESCR COM_AXIS Epm_nEng EngN 10 0.00 16383.50 FORMAT "%8.2" EXTENDED_LIMITS -16384.00 16383.50 AXIS_PTS_REF InjSys_nEng10_AX /end AXIS_DESCR
 /begin AXIS_DESCR COM_AXIS InjSys_ratAirMAxisInp rel_uw_q0p0234 8 0.00 1535.977 FORMAT "%8.3" AXIS_PTS_REF InjSys_ratAirM08_AX /end AXIS_DESCR
/end CHARACTERISTIC
/begin CHARACTERISTIC InjSys_P1V3I1_HO.facTPistCold_M "class instance packet 1 variant 3 / delta angle ethanol dependent" MAP 0x80565222 RB_Map_S16S16_U8 0.9961 fak_ub_b1 0.00 0.9961
 /begin AXIS_DESCR STD_AXIS InjSys_tEng Temp_Cels 8 -3549.940 3003.560 FORMAT "%8.3" DEPOSIT ABSOLUTE /end AXIS_DESCR
 /begin AXIS_DESCR STD_AXIS InjSys_tOilLocSp Temp_Cels 8 -3549.940 3003.560 FORMAT "%8.3" DEPOSIT ABSOLUTE /end AXIS_DESCR
/end CHARACTERISTIC
/begin CHARACTERISTIC InjSys_P1V3I1_HO.facTPist_M "class instance packet 1 variant 3 / factor piston temperature" MAP 0x80565286 RB_Map_S16S16_U8 0.9961 fak_ub_b1 0.00 0.9961
 /begin AXIS_DESCR STD_AXIS InjSys_tPistBas Temp_Cels 6 -3549.940 3003.560 FORMAT "%8.3" DEPOSIT ABSOLUTE /end AXIS_DESCR
 /begin AXIS_DESCR STD_AXIS InjSys_tPistDelta temp_q0p1 6 -3276.800 3276.700 FORMAT "%8.3" DEPOSIT ABSOLUTE /end AXIS_DESCR
/end CHARACTERISTIC
/begin CHARACTERISTIC InjSys_P1V3I1_HO.facWghtAgDeltaLamBasCold_T "class instance packet 1 variant 3 / weighting factor cold delta angle engine and oil temperature dependent" CURVE 0x805652C6 RB_Curve_U8_U8 0.9961 fak_ub_b1 0.00 0.9961
 /begin AXIS_DESCR STD_AXIS InjSys_facLamBasLocSp fak_ub_b2 3 0.00 1.992188 FORMAT "%8.6" DEPOSIT ABSOLUTE /end AXIS_DESCR
/end CHARACTERISTIC
/begin CHARACTERISTIC InjSys_P1V3I1_HO.facWghtAgDeltaLamBasWrm_T "class instance packet 1 variant 3 / weighting factor warm delta angle engine and oil temperature dependent" CURVE 0x805652CD RB_Curve_U8_U8 0.9961 fak_ub_b1 0.00 0.9961
 /begin AXIS_DESCR STD_AXIS InjSys_facLamBasLocSp fak_ub_b2 3 0.00 1.992188 FORMAT "%8.6" DEPOSIT ABSOLUTE /end AXIS_DESCR
/end CHARACTERISTIC
/begin CHARACTERISTIC InjSys_P1V3I1_HO.facWghtColdWrmEthnl_M "class instance packet 1 variant 3 / ." MAP 0x805652D4 RB_Map_S16S16_U8 0.9961 fak_ub_b1 0.00 0.9961
 /begin AXIS_DESCR STD_AXIS InjSys_tEng Temp_Cels 6 -3549.940 3003.560 FORMAT "%8.3" DEPOSIT ABSOLUTE /end AXIS_DESCR
 /begin AXIS_DESCR STD_AXIS InjSys_tOilLocSp Temp_Cels 4 -3549.940 3003.560 FORMAT "%8.3" DEPOSIT ABSOLUTE /end AXIS_DESCR
/end CHARACTERISTIC
/begin CHARACTERISTIC InjSys_P1V3I1_HO.facWghtColdWrm_M "class instance packet 1 variant 3 / ." MAP 0x80565304 RB_Map_S16S16_U8 0.9961 fak_ub_b1 0.00 0.9961
 /begin AXIS_DESCR STD_AXIS InjSys_tEng Temp_Cels 6 -3549.940 3003.560 FORMAT "%8.3" DEPOSIT ABSOLUTE /end AXIS_DESCR
 /begin AXIS_DESCR STD_AXIS InjSys_tOilLocSp Temp_Cels 4 -3549.940 3003.560 FORMAT "%8.3" DEPOSIT ABSOLUTE /end AXIS_DESCR
/end CHARACTERISTIC
/begin CHARACTERISTIC InjSys_P1V3I1_HO.facWghtWrmCold_M "class instance packet 1 variant 3 / weighting factor warm-cold delta angle engine- and oil- temperature dependent" MAP 0x80565334 RB_Map_S16S16_U8 0.9961 fak_ub_b1 0.00 0.9961
 /begin AXIS_DESCR STD_AXIS InjSys_tEng Temp_Cels 6 -3549.940 3003.560 FORMAT "%8.3" DEPOSIT ABSOLUTE /end AXIS_DESCR
 /begin AXIS_DESCR STD_AXIS InjSys_tOilLocSp Temp_Cels 4 -3549.940 3003.560 FORMAT "%8.3" DEPOSIT ABSOLUTE /end AXIS_DESCR
/end CHARACTERISTIC
/begin CHARACTERISTIC InjSys_P1V3I1_HO.flgAbsltSplt_C "class instance packet 1 variant 3 / condition split with absolute fuel mass" VALUE 0x80565364 RB_Val_Wu8 1.00000000000 B_TRUE 0.00 1.00000000000 FORMAT "%13.11" /end CHARACTERISTIC
/begin CHARACTERISTIC InjSys_P1V3I1_HO.flgAxVers_C "class instance packet 1 variant 3 / condition map selection with group axis in version 2" VALUE 0x80565365 RB_Val_Wu8 1.00000000000 B_TRUE 0.00 1.00000000000 FORMAT "%13.11" /end CHARACTERISTIC
/begin CHARACTERISTIC InjSys_P1V3I1_HO.flgPltInj_C "class instance packet 1 variant 3 / condition pilot injection" VALUE 0x80565366 RB_Val_Wu8 1.00000000000 B_TRUE 0.00 1.00000000000 FORMAT "%13.11" /end CHARACTERISTIC
/begin CHARACTERISTIC InjSys_P1V3I1_HO.ratFuMAux1_GM "class instance packet 1 variant 3 / relative fuel mass auxiliary injection 1" MAP 0x80565368 RB_MapGroup_U16 3071.953 rel_uw_b3072 0.00 3071.953 FORMAT "%8.3"
 /begin AXIS_DESCR COM_AXIS Epm_nEng EngN 10 0.00 16383.50 FORMAT "%8.2" EXTENDED_LIMITS -16384.00 16383.50 AXIS_PTS_REF InjSys_nEng10_AX /end AXIS_DESCR
 /begin AXIS_DESCR COM_AXIS InjSys_ratAirMAxisInp rel_uw_q0p0234 8 0.00 1535.977 FORMAT "%8.3" AXIS_PTS_REF InjSys_ratAirM08_AX /end AXIS_DESCR
/end CHARACTERISTIC
/begin CHARACTERISTIC InjSys_P1V3I1_HO.ratFuMAux2_GM "class instance packet 1 variant 3 / relative fuel mass auxiliary injection 2" MAP 0x80565408 RB_MapGroup_U16 3071.953 rel_uw_b3072 0.00 3071.953 FORMAT "%8.3"
 /begin AXIS_DESCR COM_AXIS Epm_nEng EngN 10 0.00 16383.50 FORMAT "%8.2" EXTENDED_LIMITS -16384.00 16383.50 AXIS_PTS_REF InjSys_nEng10_AX /end AXIS_DESCR
 /begin AXIS_DESCR COM_AXIS InjSys_ratAirMAxisInp rel_uw_q0p0234 8 0.00 1535.977 FORMAT "%8.3" AXIS_PTS_REF InjSys_ratAirM08_AX /end AXIS_DESCR
/end CHARACTERISTIC
/begin CHARACTERISTIC InjSys_P1V3I1_HO.ratFuMBasExtd_GM "class instance packet 1 variant 3 / relative fuel mass base injection" MAP 0x805654A8 RB_MapGroup_U16 3071.953 rel_uw_b3072 0.00 3071.953 FORMAT "%8.3"
 /begin AXIS_DESCR COM_AXIS Epm_nEng EngN 12 0.00 16383.50 FORMAT "%8.2" EXTENDED_LIMITS -16384.00 16383.50 AXIS_PTS_REF InjSys_nEng12Vers2_AX /end AXIS_DESCR
 /begin AXIS_DESCR COM_AXIS InjSys_ratAirMVers2AxisInp rel_uw_q0p0234 12 0.00 1535.977 FORMAT "%8.3" AXIS_PTS_REF InjSys_ratAirM12Vers2_AX /end AXIS_DESCR
/end CHARACTERISTIC
/begin CHARACTERISTIC InjSys_P1V3I1_HO.ratFuMBas_GM "class instance packet 1 variant 3 / relative fuel mass base injection" MAP 0x805655C8 RB_MapGroup_U16 3071.953 rel_uw_b3072 0.00 3071.953 FORMAT "%8.3"
 /begin AXIS_DESCR COM_AXIS Epm_nEng EngN 10 0.00 16383.50 FORMAT "%8.2" EXTENDED_LIMITS -16384.00 16383.50 AXIS_PTS_REF InjSys_nEng10_AX /end AXIS_DESCR
 /begin AXIS_DESCR COM_AXIS InjSys_ratAirMAxisInp rel_uw_q0p0234 8 0.00 1535.977 FORMAT "%8.3" AXIS_PTS_REF InjSys_ratAirM08_AX /end AXIS_DESCR
/end CHARACTERISTIC
/begin CHARACTERISTIC InjSys_P1V3I1_HO.stDiTiBreakAux_C "class instance packet 1 variant 3 / state disabling break time for auxiliary injection" VALUE 0x80565668 RB_Val_Wu8 255.0 dez 0.00 255.0 FORMAT "%5.1" /end CHARACTERISTIC
/begin CHARACTERISTIC InjSys_P1V3I1_HO.tiBreakAux1_M "class instance packet 1 variant 3 / pause time auxiliary injection 1" MAP 0x8056566A RB_Map_S16U16_S16 1310.680 t_q0p04_ms 0.00 1310.680 FORMAT "%8.3" EXTENDED_LIMITS -1310.720 1310.680
 /begin AXIS_DESCR STD_AXIS Epm_nEng EngN 8 -16384.00 16383.50 FORMAT "%8.2" DEPOSIT ABSOLUTE /end AXIS_DESCR
 /begin AXIS_DESCR STD_AXIS InjSys_ratAirMPredLocSp rel_uw_q0p0234 8 0.00 1535.977 FORMAT "%8.3" DEPOSIT ABSOLUTE /end AXIS_DESCR
/end CHARACTERISTIC
/begin CHARACTERISTIC InjSys_P1V3I1_HO.tiBreakAux2_M "class instance packet 1 variant 3 / pause time auxiliary injection 2" MAP 0x8056570E RB_Map_S16U16_S16 1310.680 t_q0p04_ms 0.00 1310.680 FORMAT "%8.3" EXTENDED_LIMITS -1310.720 1310.680
 /begin AXIS_DESCR STD_AXIS Epm_nEng EngN 8 -16384.00 16383.50 FORMAT "%8.2" DEPOSIT ABSOLUTE /end AXIS_DESCR
 /begin AXIS_DESCR STD_AXIS InjSys_ratAirMPredLocSp rel_uw_q0p0234 8 0.00 1535.977 FORMAT "%8.3" DEPOSIT ABSOLUTE /end AXIS_DESCR
/end CHARACTERISTIC
/begin CHARACTERISTIC InjSys_P1V3I2_HO.agBasTPistColdVers2_GM "injection packet 1 in variant 3 / base angle at cold piston temperature (version 2)" MAP 0x8055AE30 RB_MapGroup_U8 382.5 kw_q1p5 0.00 382.5 FORMAT "%5.1"
 /begin AXIS_DESCR COM_AXIS Epm_nEng EngN 12 0.00 16383.50 FORMAT "%8.2" EXTENDED_LIMITS -16384.00 16383.50 AXIS_PTS_REF InjSys_nEng12Vers2_AX /end AXIS_DESCR
 /begin AXIS_DESCR COM_AXIS InjSys_ratAirMAgSpVers2AxisInp rel_uw_q0p0234 12 0.00 1535.977 FORMAT "%8.3" AXIS_PTS_REF InjSys_ratAirM12AgSpVers2_AX /end AXIS_DESCR
/end CHARACTERISTIC
/begin CHARACTERISTIC InjSys_P1V3I2_HO.agBasTPistCold_GM "injection packet 1 in variant 3 / base angle at cold piston temperature" MAP 0x8055AEC0 RB_MapGroup_U8 382.5 kw_q1p5 0.00 382.5 FORMAT "%5.1"
 /begin AXIS_DESCR COM_AXIS Epm_nEng EngN 12 0.00 16383.50 FORMAT "%8.2" EXTENDED_LIMITS -16384.00 16383.50 AXIS_PTS_REF InjSys_nEng12_AX /end AXIS_DESCR
 /begin AXIS_DESCR COM_AXIS InjSys_ratAirMAgSpAxisInp rel_uw_q0p0234 12 0.00 1535.977 FORMAT "%8.3" AXIS_PTS_REF InjSys_ratAirM12AgSp_AX /end AXIS_DESCR
/end CHARACTERISTIC
/begin CHARACTERISTIC InjSys_P1V3I2_HO.agBasTPistWrmVers2_GM "injection packet 1 in variant 3 / base angle for interpolation Warm TSA mode (Version 2)" MAP 0x8055AF50 RB_MapGroup_U8 382.5 kw_q1p5 0.00 382.5 FORMAT "%5.1"
 /begin AXIS_DESCR COM_AXIS Epm_nEng EngN 12 0.00 16383.50 FORMAT "%8.2" EXTENDED_LIMITS -16384.00 16383.50 AXIS_PTS_REF InjSys_nEng12Vers2_AX /end AXIS_DESCR
 /begin AXIS_DESCR COM_AXIS InjSys_ratAirMAgSpVers2AxisInp rel_uw_q0p0234 12 0.00 1535.977 FORMAT "%8.3" AXIS_PTS_REF InjSys_ratAirM12AgSpVers2_AX /end AXIS_DESCR
/end CHARACTERISTIC
/begin CHARACTERISTIC InjSys_P1V3I2_HO.agBasTPistWrm_GM "injection packet 1 in variant 3 / base angle for interpolation Warm TSA mode" MAP 0x8055AFE0 RB_MapGroup_U8 382.5 kw_q1p5 0.00 382.5 FORMAT "%5.1"
 /begin AXIS_DESCR COM_AXIS Epm_nEng EngN 12 0.00 16383.50 FORMAT "%8.2" EXTENDED_LIMITS -16384.00 16383.50 AXIS_PTS_REF InjSys_nEng12_AX /end AXIS_DESCR
 /begin AXIS_DESCR COM_AXIS InjSys_ratAirMAgSpAxisInp rel_uw_q0p0234 12 0.00 1535.977 FORMAT "%8.3" AXIS_PTS_REF InjSys_ratAirM12AgSp_AX /end AXIS_DESCR
/end CHARACTERISTIC
/begin CHARACTERISTIC InjSys_P1V3I2_HO.agBgnColdExtdEthnl_GM "injection packet 1 in variant 3 / ." MAP 0x8055B070 RB_MapGroup_U8 191.3 kw_q0p75_o240 240.0 431.3 FORMAT "%5.1"
 /begin AXIS_DESCR COM_AXIS Epm_nEng EngN 12 0.00 16383.50 FORMAT "%8.2" EXTENDED_LIMITS -16384.00 16383.50 AXIS_PTS_REF InjSys_nEng12_AX /end AXIS_DESCR
 /begin AXIS_DESCR COM_AXIS InjSys_ratAirMAxisInp rel_uw_q0p0234 12 0.00 1535.977 FORMAT "%8.3" AXIS_PTS_REF InjSys_ratAirM12_AX /end AXIS_DESCR
/end CHARACTERISTIC
/begin CHARACTERISTIC InjSys_P1V3I2_HO.agBgnColdExtd_GM "injection packet 1 in variant 3 / ." MAP 0x8055B100 RB_MapGroup_U8 191.3 kw_q0p75_o240 240.0 431.3 FORMAT "%5.1"
 /begin AXIS_DESCR COM_AXIS Epm_nEng EngN 12 0.00 16383.50 FORMAT "%8.2" EXTENDED_LIMITS -16384.00 16383.50 AXIS_PTS_REF InjSys_nEng12_AX /end AXIS_DESCR
 /begin AXIS_DESCR COM_AXIS InjSys_ratAirMAxisInp rel_uw_q0p0234 12 0.00 1535.977 FORMAT "%8.3" AXIS_PTS_REF InjSys_ratAirM12_AX /end AXIS_DESCR
/end CHARACTERISTIC
/begin CHARACTERISTIC InjSys_P1V3I2_HO.agBgnColdSmlVlvEthnl_GM "injection packet 1 in variant 3 / ." MAP 0x8055B190 RB_MapGroup_U8 191.3 kw_q0p75_o240 240.0 431.3 FORMAT "%5.1"
 /begin AXIS_DESCR COM_AXIS Epm_nEng EngN 12 0.00 16383.50 FORMAT "%8.2" EXTENDED_LIMITS -16384.00 16383.50 AXIS_PTS_REF InjSys_nEng12_AX /end AXIS_DESCR
 /begin AXIS_DESCR COM_AXIS InjSys_ratAirMAxisInp rel_uw_q0p0234 12 0.00 1535.977 FORMAT "%8.3" AXIS_PTS_REF InjSys_ratAirM12_AX /end AXIS_DESCR
/end CHARACTERISTIC
/begin CHARACTERISTIC InjSys_P1V3I2_HO.agBgnColdSmlVlv_GM "injection packet 1 in variant 3 / ." MAP 0x8055B220 RB_MapGroup_U8 191.3 kw_q0p75_o240 240.0 431.3 FORMAT "%5.1"
 /begin AXIS_DESCR COM_AXIS Epm_nEng EngN 12 0.00 16383.50 FORMAT "%8.2" EXTENDED_LIMITS -16384.00 16383.50 AXIS_PTS_REF InjSys_nEng12_AX /end AXIS_DESCR
 /begin AXIS_DESCR COM_AXIS InjSys_ratAirMAxisInp rel_uw_q0p0234 12 0.00 1535.977 FORMAT "%8.3" AXIS_PTS_REF InjSys_ratAirM12_AX /end AXIS_DESCR
/end CHARACTERISTIC
/begin CHARACTERISTIC InjSys_P1V3I2_HO.agBgnWrmExtdEthnl_GM "injection packet 1 in variant 3 / ." MAP 0x8055B2B0 RB_MapGroup_U8 191.3 kw_q0p75_o240 240.0 431.3 FORMAT "%5.1"
 /begin AXIS_DESCR COM_AXIS Epm_nEng EngN 12 0.00 16383.50 FORMAT "%8.2" EXTENDED_LIMITS -16384.00 16383.50 AXIS_PTS_REF InjSys_nEng12_AX /end AXIS_DESCR
 /begin AXIS_DESCR COM_AXIS InjSys_ratAirMAxisInp rel_uw_q0p0234 12 0.00 1535.977 FORMAT "%8.3" AXIS_PTS_REF InjSys_ratAirM12_AX /end AXIS_DESCR
/end CHARACTERISTIC
/begin CHARACTERISTIC InjSys_P1V3I2_HO.agBgnWrmExtd_GM "injection packet 1 in variant 3 / ." MAP 0x8055B340 RB_MapGroup_U8 191.3 kw_q0p75_o240 240.0 431.3 FORMAT "%5.1"
 /begin AXIS_DESCR COM_AXIS Epm_nEng EngN 12 0.00 16383.50 FORMAT "%8.2" EXTENDED_LIMITS -16384.00 16383.50 AXIS_PTS_REF InjSys_nEng12_AX /end AXIS_DESCR
 /begin AXIS_DESCR COM_AXIS InjSys_ratAirMAxisInp rel_uw_q0p0234 12 0.00 1535.977 FORMAT "%8.3" AXIS_PTS_REF InjSys_ratAirM12_AX /end AXIS_DESCR
/end CHARACTERISTIC
/begin CHARACTERISTIC InjSys_P1V3I2_HO.agBgnWrmSmlVlvWEthnl_GM "injection packet 1 in variant 3 / ." MAP 0x8055B3D0 RB_MapGroup_U8 191.3 kw_q0p75_o240 240.0 431.3 FORMAT "%5.1"
 /begin AXIS_DESCR COM_AXIS Epm_nEng EngN 12 0.00 16383.50 FORMAT "%8.2" EXTENDED_LIMITS -16384.00 16383.50 AXIS_PTS_REF InjSys_nEng12_AX /end AXIS_DESCR
 /begin AXIS_DESCR COM_AXIS InjSys_ratAirMAxisInp rel_uw_q0p0234 12 0.00 1535.977 FORMAT "%8.3" AXIS_PTS_REF InjSys_ratAirM12_AX /end AXIS_DESCR
/end CHARACTERISTIC
/begin CHARACTERISTIC InjSys_P1V3I2_HO.agBgnWrmSmlVlv_GM "injection packet 1 in variant 3 / ." MAP 0x8055B460 RB_MapGroup_U8 191.3 kw_q0p75_o240 240.0 431.3 FORMAT "%5.1"
 /begin AXIS_DESCR COM_AXIS Epm_nEng EngN 12 0.00 16383.50 FORMAT "%8.2" EXTENDED_LIMITS -16384.00 16383.50 AXIS_PTS_REF InjSys_nEng12_AX /end AXIS_DESCR
 /begin AXIS_DESCR COM_AXIS InjSys_ratAirMAxisInp rel_uw_q0p0234 12 0.00 1535.977 FORMAT "%8.3" AXIS_PTS_REF InjSys_ratAirM12_AX /end AXIS_DESCR
/end CHARACTERISTIC
/begin CHARACTERISTIC InjSys_P1V3I2_HO.agDeltaEth_M "injection packet 1 in variant 3 / delta angle ethanol dependent" MAP 0x8055B4F0 RB_Map_S16S16_S16 191.2500 kw_q0p75 -96.00000 95.25000 FORMAT "%8.5" EXTENDED_LIMITS -24576.00 24575.25
 /begin AXIS_DESCR STD_AXIS InjSys_facEthLnrLocSp fak_ub_b2 4 0.00 1.992188 FORMAT "%8.6" EXTENDED_LIMITS -256.0000 255.9922 DEPOSIT ABSOLUTE /end AXIS_DESCR
 /begin AXIS_DESCR STD_AXIS InjSys_tEng Temp_Cels 4 -3549.940 3003.560 FORMAT "%8.3" DEPOSIT ABSOLUTE /end AXIS_DESCR
/end CHARACTERISTIC
/begin CHARACTERISTIC InjSys_P1V3I2_HO.agDeltaLamBasCold_M "injection packet 1 in variant 3 / cold angle base lambda dependent and engine temperature dependent" MAP 0x8055B524 RB_Map_S16U16_S16 191.2500 kw_q0p75 -96.00000 95.25000 FORMAT "%8.5" EXTENDED_LIMITS -24576.00 24575.25
 /begin AXIS_DESCR STD_AXIS Epm_nEng EngN 8 -16384.00 16383.50 FORMAT "%8.2" DEPOSIT ABSOLUTE /end AXIS_DESCR
 /begin AXIS_DESCR STD_AXIS InjSys_ratAirMPredLocSp rel_uw_q0p0234 6 0.00 1535.977 FORMAT "%8.3" DEPOSIT ABSOLUTE /end AXIS_DESCR
/end CHARACTERISTIC
/begin CHARACTERISTIC InjSys_P1V3I2_HO.agDeltaLamBasWrm_M "injection packet 1 in variant 3 / warm angle base lambda dependent and engine temperature dependent" MAP 0x8055B5A4 RB_Map_S16U16_S16 191.2500 kw_q0p75 -96.00000 95.25000 FORMAT "%8.5" EXTENDED_LIMITS -24576.00 24575.25
 /begin AXIS_DESCR STD_AXIS Epm_nEng EngN 8 -16384.00 16383.50 FORMAT "%8.2" DEPOSIT ABSOLUTE /end AXIS_DESCR
 /begin AXIS_DESCR STD_AXIS InjSys_ratAirMPredLocSp rel_uw_q0p0234 6 0.00 1535.977 FORMAT "%8.3" DEPOSIT ABSOLUTE /end AXIS_DESCR
/end CHARACTERISTIC
/begin CHARACTERISTIC InjSys_P1V3I2_HO.agDeltaLam_M "injection packet 1 in variant 3 / ." MAP 0x8055B624 RB_Map_S16U16_S16 191.2500 kw_q0p75 -96.00000 95.25000 FORMAT "%8.5" EXTENDED_LIMITS -24576.00 24575.25
 /begin AXIS_DESCR STD_AXIS Epm_nEng EngN 10 -16384.00 16383.50 FORMAT "%8.2" DEPOSIT ABSOLUTE /end AXIS_DESCR
 /begin AXIS_DESCR STD_AXIS InjSys_ratAirMPredLocSp kw_q0p0234 8 0.00 1535.977 FORMAT "%8.3" DEPOSIT ABSOLUTE /end AXIS_DESCR
/end CHARACTERISTIC
/begin CHARACTERISTIC InjSys_P1V3I2_HO.agDeltaTEngOilVers2_GM "injection packet 1 in variant 3 / delta angle engine- and oil- temperature dependent" MAP 0x8055B6EC RB_MapGroup_S8 191.3 kw_q0p75 -96.00 95.25 FORMAT "%5.2"
 /begin AXIS_DESCR COM_AXIS Epm_nEng EngN 12 0.00 16383.50 FORMAT "%8.2" EXTENDED_LIMITS -16384.00 16383.50 AXIS_PTS_REF InjSys_nEng12Vers2_AX /end AXIS_DESCR
 /begin AXIS_DESCR COM_AXIS InjSys_ratAirMAgSpVers2AxisInp rel_uw_q0p0234 12 0.00 1535.977 FORMAT "%8.3" AXIS_PTS_REF InjSys_ratAirM12AgSpVers2_AX /end AXIS_DESCR
/end CHARACTERISTIC
/begin CHARACTERISTIC InjSys_P1V3I2_HO.agDeltaTEngOil_GM "injection packet 1 in variant 3 / delta angle engine- and oil- temperature dependent" MAP 0x8055B77C RB_MapGroup_S8 191.3 kw_q0p75 -96.00 95.25 FORMAT "%5.2"
 /begin AXIS_DESCR COM_AXIS Epm_nEng EngN 12 0.00 16383.50 FORMAT "%8.2" EXTENDED_LIMITS -16384.00 16383.50 AXIS_PTS_REF InjSys_nEng12_AX /end AXIS_DESCR
 /begin AXIS_DESCR COM_AXIS InjSys_ratAirMAgSpAxisInp rel_uw_q0p0234 12 0.00 1535.977 FORMAT "%8.3" AXIS_PTS_REF InjSys_ratAirM12AgSp_AX /end AXIS_DESCR
/end CHARACTERISTIC
/begin CHARACTERISTIC InjSys_P1V3I2_HO.facAgBgnLam_T "injection packet 1 in variant 3 / ." CURVE 0x8055B80C RB_Curve_U8_U8 0.9961 fak_ub_b1 0.00 0.9961
 /begin AXIS_DESCR STD_AXIS InjSys_facLamBasLocSp fak_ub_b2 8 0.00 1.992188 FORMAT "%8.6" DEPOSIT ABSOLUTE /end AXIS_DESCR
/end CHARACTERISTIC
/begin CHARACTERISTIC InjSys_P1V3I2_HO.facEthnlAgBgn_T "injection packet 1 in variant 3 / ." CURVE 0x8055B81D RB_Curve_U8_U8 0.9961 fak_ub_b1 0.00 0.9961
 /begin AXIS_DESCR STD_AXIS fethstoeLocSp fak_ub_b2 4 0.00 1.992188 FORMAT "%8.6" DEPOSIT ABSOLUTE /end AXIS_DESCR
/end CHARACTERISTIC
/begin CHARACTERISTIC InjSys_P1V3I2_HO.facSpltAux1Extd_GM "injection packet 1 in variant 3 / split factor auxiliary injection 1" MAP 0x8055B826 RB_MapGroup_U8 0.9961 fak_ub_b1 0.00 0.9961
 /begin AXIS_DESCR COM_AXIS Epm_nEng EngN 12 0.00 16383.50 FORMAT "%8.2" EXTENDED_LIMITS -16384.00 16383.50 AXIS_PTS_REF InjSys_nEng12Vers2_AX /end AXIS_DESCR
 /begin AXIS_DESCR COM_AXIS InjSys_ratAirMVers2AxisInp rel_uw_q0p0234 12 0.00 1535.977 FORMAT "%8.3" AXIS_PTS_REF InjSys_ratAirM12Vers2_AX /end AXIS_DESCR
/end CHARACTERISTIC
/begin CHARACTERISTIC InjSys_P1V3I2_HO.facSpltAux1_GM "injection packet 1 in variant 3 / split factor auxiliary injection 1" MAP 0x8055B8B6 RB_MapGroup_U8 0.9961 fak_ub_b1 0.00 0.9961
 /begin AXIS_DESCR COM_AXIS Epm_nEng EngN 10 0.00 16383.50 FORMAT "%8.2" EXTENDED_LIMITS -16384.00 16383.50 AXIS_PTS_REF InjSys_nEng10_AX /end AXIS_DESCR
 /begin AXIS_DESCR COM_AXIS InjSys_ratAirMAxisInp rel_uw_q0p0234 8 0.00 1535.977 FORMAT "%8.3" AXIS_PTS_REF InjSys_ratAirM08_AX /end AXIS_DESCR
/end CHARACTERISTIC
/begin CHARACTERISTIC InjSys_P1V3I2_HO.facSpltAux2Extd_GM "injection packet 1 in variant 3 / split factor auxiliary injection 2" MAP 0x8055B906 RB_MapGroup_U8 0.9961 fak_ub_b1 0.00 0.9961
 /begin AXIS_DESCR COM_AXIS Epm_nEng EngN 12 0.00 16383.50 FORMAT "%8.2" EXTENDED_LIMITS -16384.00 16383.50 AXIS_PTS_REF InjSys_nEng12Vers2_AX /end AXIS_DESCR
 /begin AXIS_DESCR COM_AXIS InjSys_ratAirMVers2AxisInp rel_uw_q0p0234 12 0.00 1535.977 FORMAT "%8.3" AXIS_PTS_REF InjSys_ratAirM12Vers2_AX /end AXIS_DESCR
/end CHARACTERISTIC
/begin CHARACTERISTIC InjSys_P1V3I2_HO.facSpltAux2_GM "injection packet 1 in variant 3 / split factor auxiliary injection 2" MAP 0x8055B996 RB_MapGroup_U8 0.9961 fak_ub_b1 0.00 0.9961
 /begin AXIS_DESCR COM_AXIS Epm_nEng EngN 10 0.00 16383.50 FORMAT "%8.2" EXTENDED_LIMITS -16384.00 16383.50 AXIS_PTS_REF InjSys_nEng10_AX /end AXIS_DESCR
 /begin AXIS_DESCR COM_AXIS InjSys_ratAirMAxisInp rel_uw_q0p0234 8 0.00 1535.977 FORMAT "%8.3" AXIS_PTS_REF InjSys_ratAirM08_AX /end AXIS_DESCR
/end CHARACTERISTIC
/begin CHARACTERISTIC InjSys_P1V3I2_HO.facTPistCold_M "injection packet 1 in variant 3 / delta angle ethanol dependent" MAP 0x8055B9E6 RB_Map_S16S16_U8 0.9961 fak_ub_b1 0.00 0.9961
 /begin AXIS_DESCR STD_AXIS InjSys_tEng Temp_Cels 8 -3549.940 3003.560 FORMAT "%8.3" DEPOSIT ABSOLUTE /end AXIS_DESCR
 /begin AXIS_DESCR STD_AXIS InjSys_tOilLocSp Temp_Cels 8 -3549.940 3003.560 FORMAT "%8.3" DEPOSIT ABSOLUTE /end AXIS_DESCR
/end CHARACTERISTIC
/begin CHARACTERISTIC InjSys_P1V3I2_HO.facTPist_M "injection packet 1 in variant 3 / factor piston temperature" MAP 0x8055BA4A RB_Map_S16S16_U8 0.9961 fak_ub_b1 0.00 0.9961
 /begin AXIS_DESCR STD_AXIS InjSys_tPistBas Temp_Cels 6 -3549.940 3003.560 FORMAT "%8.3" DEPOSIT ABSOLUTE /end AXIS_DESCR
 /begin AXIS_DESCR STD_AXIS InjSys_tPistDelta temp_q0p1 6 -3276.800 3276.700 FORMAT "%8.3" DEPOSIT ABSOLUTE /end AXIS_DESCR
/end CHARACTERISTIC
/begin CHARACTERISTIC InjSys_P1V3I2_HO.facWghtAgDeltaLamBasCold_T "injection packet 1 in variant 3 / weighting factor cold delta angle engine and oil temperature dependent" CURVE 0x8055BA8A RB_Curve_U8_U8 0.9961 fak_ub_b1 0.00 0.9961
 /begin AXIS_DESCR STD_AXIS InjSys_facLamBasLocSp fak_ub_b2 3 0.00 1.992188 FORMAT "%8.6" DEPOSIT ABSOLUTE /end AXIS_DESCR
/end CHARACTERISTIC
/begin CHARACTERISTIC InjSys_P1V3I2_HO.facWghtAgDeltaLamBasWrm_T "injection packet 1 in variant 3 / weighting factor warm delta angle engine and oil temperature dependent" CURVE 0x8055BA91 RB_Curve_U8_U8 0.9961 fak_ub_b1 0.00 0.9961
 /begin AXIS_DESCR STD_AXIS InjSys_facLamBasLocSp fak_ub_b2 3 0.00 1.992188 FORMAT "%8.6" DEPOSIT ABSOLUTE /end AXIS_DESCR
/end CHARACTERISTIC
/begin CHARACTERISTIC InjSys_P1V3I2_HO.facWghtColdWrmEthnl_M "injection packet 1 in variant 3 / ." MAP 0x8055BA98 RB_Map_S16S16_U8 0.9961 fak_ub_b1 0.00 0.9961
 /begin AXIS_DESCR STD_AXIS InjSys_tEng Temp_Cels 6 -3549.940 3003.560 FORMAT "%8.3" DEPOSIT ABSOLUTE /end AXIS_DESCR
 /begin AXIS_DESCR STD_AXIS InjSys_tOilLocSp Temp_Cels 4 -3549.940 3003.560 FORMAT "%8.3" DEPOSIT ABSOLUTE /end AXIS_DESCR
/end CHARACTERISTIC
/begin CHARACTERISTIC InjSys_P1V3I2_HO.facWghtColdWrm_M "injection packet 1 in variant 3 / ." MAP 0x8055BAC8 RB_Map_S16S16_U8 0.9961 fak_ub_b1 0.00 0.9961
 /begin AXIS_DESCR STD_AXIS InjSys_tEng Temp_Cels 6 -3549.940 3003.560 FORMAT "%8.3" DEPOSIT ABSOLUTE /end AXIS_DESCR
 /begin AXIS_DESCR STD_AXIS InjSys_tOilLocSp Temp_Cels 4 -3549.940 3003.560 FORMAT "%8.3" DEPOSIT ABSOLUTE /end AXIS_DESCR
/end CHARACTERISTIC
/begin CHARACTERISTIC InjSys_P1V3I2_HO.facWghtWrmCold_M "injection packet 1 in variant 3 / weighting factor warm-cold delta angle engine- and oil- temperature dependent" MAP 0x8055BAF8 RB_Map_S16S16_U8 0.9961 fak_ub_b1 0.00 0.9961
 /begin AXIS_DESCR STD_AXIS InjSys_tEng Temp_Cels 6 -3549.940 3003.560 FORMAT "%8.3" DEPOSIT ABSOLUTE /end AXIS_DESCR
 /begin AXIS_DESCR STD_AXIS InjSys_tOilLocSp Temp_Cels 4 -3549.940 3003.560 FORMAT "%8.3" DEPOSIT ABSOLUTE /end AXIS_DESCR
/end CHARACTERISTIC
/begin CHARACTERISTIC InjSys_P1V3I2_HO.flgAbsltSplt_C "injection packet 1 in variant 3 / condition split with absolute fuel mass" VALUE 0x8055BB28 RB_Val_Wu8 1.00000000000 B_TRUE 0.00 1.00000000000 FORMAT "%13.11" /end CHARACTERISTIC
/begin CHARACTERISTIC InjSys_P1V3I2_HO.flgAxVers_C "injection packet 1 in variant 3 / condition map selection with group axis in version 2" VALUE 0x8055BB29 RB_Val_Wu8 1.00000000000 B_TRUE 0.00 1.00000000000 FORMAT "%13.11" /end CHARACTERISTIC
/begin CHARACTERISTIC InjSys_P1V3I2_HO.flgPltInj_C "injection packet 1 in variant 3 / condition pilot injection" VALUE 0x8055BB2A RB_Val_Wu8 1.00000000000 B_TRUE 0.00 1.00000000000 FORMAT "%13.11" /end CHARACTERISTIC
/begin CHARACTERISTIC InjSys_P1V3I2_HO.ratFuMAux1_GM "injection packet 1 in variant 3 / relative fuel mass auxiliary injection 1" MAP 0x8055BB2C RB_MapGroup_U16 3071.953 rel_uw_b3072 0.00 3071.953 FORMAT "%8.3"
 /begin AXIS_DESCR COM_AXIS Epm_nEng EngN 10 0.00 16383.50 FORMAT "%8.2" EXTENDED_LIMITS -16384.00 16383.50 AXIS_PTS_REF InjSys_nEng10_AX /end AXIS_DESCR
 /begin AXIS_DESCR COM_AXIS InjSys_ratAirMAxisInp rel_uw_q0p0234 8 0.00 1535.977 FORMAT "%8.3" AXIS_PTS_REF InjSys_ratAirM08_AX /end AXIS_DESCR
/end CHARACTERISTIC
/begin CHARACTERISTIC InjSys_P1V3I2_HO.ratFuMAux2_GM "injection packet 1 in variant 3 / relative fuel mass auxiliary injection 2" MAP 0x8055BBCC RB_MapGroup_U16 3071.953 rel_uw_b3072 0.00 3071.953 FORMAT "%8.3"
 /begin AXIS_DESCR COM_AXIS Epm_nEng EngN 10 0.00 16383.50 FORMAT "%8.2" EXTENDED_LIMITS -16384.00 16383.50 AXIS_PTS_REF InjSys_nEng10_AX /end AXIS_DESCR
 /begin AXIS_DESCR COM_AXIS InjSys_ratAirMAxisInp rel_uw_q0p0234 8 0.00 1535.977 FORMAT "%8.3" AXIS_PTS_REF InjSys_ratAirM08_AX /end AXIS_DESCR
/end CHARACTERISTIC
/begin CHARACTERISTIC InjSys_P1V3I2_HO.ratFuMBasExtd_GM "injection packet 1 in variant 3 / relative fuel mass base injection" MAP 0x8055BC6C RB_MapGroup_U16 3071.953 rel_uw_b3072 0.00 3071.953 FORMAT "%8.3"
 /begin AXIS_DESCR COM_AXIS Epm_nEng EngN 12 0.00 16383.50 FORMAT "%8.2" EXTENDED_LIMITS -16384.00 16383.50 AXIS_PTS_REF InjSys_nEng12Vers2_AX /end AXIS_DESCR
 /begin AXIS_DESCR COM_AXIS InjSys_ratAirMVers2AxisInp rel_uw_q0p0234 12 0.00 1535.977 FORMAT "%8.3" AXIS_PTS_REF InjSys_ratAirM12Vers2_AX /end AXIS_DESCR
/end CHARACTERISTIC
/begin CHARACTERISTIC InjSys_P1V3I2_HO.ratFuMBas_GM "injection packet 1 in variant 3 / relative fuel mass base injection" MAP 0x8055BD8C RB_MapGroup_U16 3071.953 rel_uw_b3072 0.00 3071.953 FORMAT "%8.3"
 /begin AXIS_DESCR COM_AXIS Epm_nEng EngN 10 0.00 16383.50 FORMAT "%8.2" EXTENDED_LIMITS -16384.00 16383.50 AXIS_PTS_REF InjSys_nEng10_AX /end AXIS_DESCR
 /begin AXIS_DESCR COM_AXIS InjSys_ratAirMAxisInp rel_uw_q0p0234 8 0.00 1535.977 FORMAT "%8.3" AXIS_PTS_REF InjSys_ratAirM08_AX /end AXIS_DESCR
/end CHARACTERISTIC
/begin CHARACTERISTIC InjSys_P1V3I2_HO.stDiTiBreakAux_C "injection packet 1 in variant 3 / state disabling break time for auxiliary injection" VALUE 0x8055BE2C RB_Val_Wu8 255.0 dez 0.00 255.0 FORMAT "%5.1" /end CHARACTERISTIC
/begin CHARACTERISTIC InjSys_P1V3I2_HO.tiBreakAux1_M "injection packet 1 in variant 3 / pause time auxiliary injection 1" MAP 0x8055BE2E RB_Map_S16U16_S16 1310.680 t_q0p04_ms 0.00 1310.680 FORMAT "%8.3" EXTENDED_LIMITS -1310.720 1310.680
 /begin AXIS_DESCR STD_AXIS Epm_nEng EngN 8 -16384.00 16383.50 FORMAT "%8.2" DEPOSIT ABSOLUTE /end AXIS_DESCR
 /begin AXIS_DESCR STD_AXIS InjSys_ratAirMPredLocSp rel_uw_q0p0234 8 0.00 1535.977 FORMAT "%8.3" DEPOSIT ABSOLUTE /end AXIS_DESCR
/end CHARACTERISTIC
/begin CHARACTERISTIC InjSys_P1V3I2_HO.tiBreakAux2_M "injection packet 1 in variant 3 / pause time auxiliary injection 2" MAP 0x8055BED2 RB_Map_S16U16_S16 1310.680 t_q0p04_ms 0.00 1310.680 FORMAT "%8.3" EXTENDED_LIMITS -1310.720 1310.680
 /begin AXIS_DESCR STD_AXIS Epm_nEng EngN 8 -16384.00 16383.50 FORMAT "%8.2" DEPOSIT ABSOLUTE /end AXIS_DESCR
 /begin AXIS_DESCR STD_AXIS InjSys_ratAirMPredLocSp rel_uw_q0p0234 8 0.00 1535.977 FORMAT "%8.3" DEPOSIT ABSOLUTE /end AXIS_DESCR
/end CHARACTERISTIC
/begin CHARACTERISTIC InjSys_P1V4I1_HP.agBasHspHiVers2_GM "class instance packet 1 variant 4 / base angle in homogenous-split mode for interpolation (version 2)" MAP 0x805657B8 RB_MapGroup_U8 382.5 kw_q1p5 0.00 382.5 FORMAT "%5.1"
 /begin AXIS_DESCR COM_AXIS Epm_nEng EngN 12 0.00 16383.50 FORMAT "%8.2" EXTENDED_LIMITS -16384.00 16383.50 AXIS_PTS_REF InjSys_nEng12HspVers2_AX /end AXIS_DESCR
 /begin AXIS_DESCR COM_AXIS InjSys_ratAirMAgSpVers2AxisInp rel_uw_q0p0234 12 0.00 1535.977 FORMAT "%8.3" AXIS_PTS_REF InjSys_ratAirM12AgSpHspVers2_AX /end AXIS_DESCR
/end CHARACTERISTIC
/begin CHARACTERISTIC InjSys_P1V4I1_HP.agBasHspHi_GM "class instance packet 1 variant 4 / base angle in homogenous-split mode for interpolation" MAP 0x80565848 RB_MapGroup_U8 382.5 kw_q1p5 0.00 382.5 FORMAT "%5.1"
 /begin AXIS_DESCR COM_AXIS Epm_nEng EngN 12 0.00 16383.50 FORMAT "%8.2" EXTENDED_LIMITS -16384.00 16383.50 AXIS_PTS_REF InjSys_nEng12Hsp_AX /end AXIS_DESCR
 /begin AXIS_DESCR COM_AXIS InjSys_ratAirMAgSpAxisInp rel_uw_q0p0234 12 0.00 1535.977 FORMAT "%8.3" AXIS_PTS_REF InjSys_ratAirM12AgSpHsp_AX /end AXIS_DESCR
/end CHARACTERISTIC
/begin CHARACTERISTIC InjSys_P1V4I1_HP.agBasHspLoVers2_GM "class instance packet 1 variant 4 / base angle in homogenous-split mode for interpolation (version 2)" MAP 0x805658D8 RB_MapGroup_U8 382.5 kw_q1p5 0.00 382.5 FORMAT "%5.1"
 /begin AXIS_DESCR COM_AXIS Epm_nEng EngN 12 0.00 16383.50 FORMAT "%8.2" EXTENDED_LIMITS -16384.00 16383.50 AXIS_PTS_REF InjSys_nEng12HspVers2_AX /end AXIS_DESCR
 /begin AXIS_DESCR COM_AXIS InjSys_ratAirMAgSpVers2AxisInp rel_uw_q0p0234 12 0.00 1535.977 FORMAT "%8.3" AXIS_PTS_REF InjSys_ratAirM12AgSpHspVers2_AX /end AXIS_DESCR
/end CHARACTERISTIC
/begin CHARACTERISTIC InjSys_P1V4I1_HP.agBasHspLo_GM "class instance packet 1 variant 4 / base angle in homogenous-split mode for interpolation" MAP 0x80565968 RB_MapGroup_U8 382.5 kw_q1p5 0.00 382.5 FORMAT "%5.1"
 /begin AXIS_DESCR COM_AXIS Epm_nEng EngN 12 0.00 16383.50 FORMAT "%8.2" EXTENDED_LIMITS -16384.00 16383.50 AXIS_PTS_REF InjSys_nEng12Hsp_AX /end AXIS_DESCR
 /begin AXIS_DESCR COM_AXIS InjSys_ratAirMAgSpAxisInp rel_uw_q0p0234 12 0.00 1535.977 FORMAT "%8.3" AXIS_PTS_REF InjSys_ratAirM12AgSpHsp_AX /end AXIS_DESCR
/end CHARACTERISTIC
/begin CHARACTERISTIC InjSys_P1V4I1_HP.agBasTPistColdVers2_GM "class instance packet 1 variant 4 / base angle at cold piston temperature (version 2)" MAP 0x805659F8 RB_MapGroup_U8 382.5 kw_q1p5 0.00 382.5 FORMAT "%5.1"
 /begin AXIS_DESCR COM_AXIS Epm_nEng EngN 12 0.00 16383.50 FORMAT "%8.2" EXTENDED_LIMITS -16384.00 16383.50 AXIS_PTS_REF InjSys_nEng12Vers2_AX /end AXIS_DESCR
 /begin AXIS_DESCR COM_AXIS InjSys_ratAirMAgSpVers2AxisInp rel_uw_q0p0234 12 0.00 1535.977 FORMAT "%8.3" AXIS_PTS_REF InjSys_ratAirM12AgSpVers2_AX /end AXIS_DESCR
/end CHARACTERISTIC
/begin CHARACTERISTIC InjSys_P1V4I1_HP.agBasTPistCold_GM "class instance packet 1 variant 4 / base angle at cold piston temperature" MAP 0x80565A88 RB_MapGroup_U8 382.5 kw_q1p5 0.00 382.5 FORMAT "%5.1"
 /begin AXIS_DESCR COM_AXIS Epm_nEng EngN 12 0.00 16383.50 FORMAT "%8.2" EXTENDED_LIMITS -16384.00 16383.50 AXIS_PTS_REF InjSys_nEng12_AX /end AXIS_DESCR
 /begin AXIS_DESCR COM_AXIS InjSys_ratAirMAgSpAxisInp rel_uw_q0p0234 12 0.00 1535.977 FORMAT "%8.3" AXIS_PTS_REF InjSys_ratAirM12AgSp_AX /end AXIS_DESCR
/end CHARACTERISTIC
/begin CHARACTERISTIC InjSys_P1V4I1_HP.agBasTPistWrmVers2_GM "class instance packet 1 variant 4 / base angle for interpolation Warm TSA mode (Version 2)" MAP 0x80565B18 RB_MapGroup_U8 382.5 kw_q1p5 0.00 382.5 FORMAT "%5.1"
 /begin AXIS_DESCR COM_AXIS Epm_nEng EngN 12 0.00 16383.50 FORMAT "%8.2" EXTENDED_LIMITS -16384.00 16383.50 AXIS_PTS_REF InjSys_nEng12Vers2_AX /end AXIS_DESCR
 /begin AXIS_DESCR COM_AXIS InjSys_ratAirMAgSpVers2AxisInp rel_uw_q0p0234 12 0.00 1535.977 FORMAT "%8.3" AXIS_PTS_REF InjSys_ratAirM12AgSpVers2_AX /end AXIS_DESCR
/end CHARACTERISTIC
/begin CHARACTERISTIC InjSys_P1V4I1_HP.agBasTPistWrm_GM "class instance packet 1 variant 4 / base angle for interpolation Warm TSA mode" MAP 0x80565BA8 RB_MapGroup_U8 382.5 kw_q1p5 0.00 382.5 FORMAT "%5.1"
 /begin AXIS_DESCR COM_AXIS Epm_nEng EngN 12 0.00 16383.50 FORMAT "%8.2" EXTENDED_LIMITS -16384.00 16383.50 AXIS_PTS_REF InjSys_nEng12_AX /end AXIS_DESCR
 /begin AXIS_DESCR COM_AXIS InjSys_ratAirMAgSpAxisInp rel_uw_q0p0234 12 0.00 1535.977 FORMAT "%8.3" AXIS_PTS_REF InjSys_ratAirM12AgSp_AX /end AXIS_DESCR
/end CHARACTERISTIC
/begin CHARACTERISTIC InjSys_P1V4I1_HP.agBgnColdExtdEthnl_GM "class instance packet 1 variant 4 / ." MAP 0x80565C38 RB_MapGroup_U8 382.5 kw_q1p5 0.00 382.5 FORMAT "%5.1"
 /begin AXIS_DESCR COM_AXIS Epm_nEng EngN 12 0.00 16383.50 FORMAT "%8.2" EXTENDED_LIMITS -16384.00 16383.50 AXIS_PTS_REF InjSys_nEng12Hpx_AX /end AXIS_DESCR
 /begin AXIS_DESCR COM_AXIS InjSys_ratAirMAxisInp rel_uw_q0p0234 12 0.00 1535.977 FORMAT "%8.3" AXIS_PTS_REF InjSys_ratAirM12Hpx_AX /end AXIS_DESCR
/end CHARACTERISTIC
/begin CHARACTERISTIC InjSys_P1V4I1_HP.agBgnColdExtd_GM "class instance packet 1 variant 4 / ." MAP 0x80565CC8 RB_MapGroup_U8 382.5 kw_q1p5 0.00 382.5 FORMAT "%5.1"
 /begin AXIS_DESCR COM_AXIS Epm_nEng EngN 12 0.00 16383.50 FORMAT "%8.2" EXTENDED_LIMITS -16384.00 16383.50 AXIS_PTS_REF InjSys_nEng12Hpx_AX /end AXIS_DESCR
 /begin AXIS_DESCR COM_AXIS InjSys_ratAirMAxisInp rel_uw_q0p0234 12 0.00 1535.977 FORMAT "%8.3" AXIS_PTS_REF InjSys_ratAirM12Hpx_AX /end AXIS_DESCR
/end CHARACTERISTIC
/begin CHARACTERISTIC InjSys_P1V4I1_HP.agBgnColdSmlVlvEthnl_GM "class instance packet 1 variant 4 / ." MAP 0x80565D58 RB_MapGroup_U8 382.5 kw_q1p5 0.00 382.5 FORMAT "%5.1"
 /begin AXIS_DESCR COM_AXIS Epm_nEng EngN 12 0.00 16383.50 FORMAT "%8.2" EXTENDED_LIMITS -16384.00 16383.50 AXIS_PTS_REF InjSys_nEng12Hpx_AX /end AXIS_DESCR
 /begin AXIS_DESCR COM_AXIS InjSys_ratAirMAxisInp rel_uw_q0p0234 12 0.00 1535.977 FORMAT "%8.3" AXIS_PTS_REF InjSys_ratAirM12Hpx_AX /end AXIS_DESCR
/end CHARACTERISTIC
/begin CHARACTERISTIC InjSys_P1V4I1_HP.agBgnColdSmlVlv_GM "class instance packet 1 variant 4 / ." MAP 0x80565DE8 RB_MapGroup_U8 382.5 kw_q1p5 0.00 382.5 FORMAT "%5.1"
 /begin AXIS_DESCR COM_AXIS Epm_nEng EngN 12 0.00 16383.50 FORMAT "%8.2" EXTENDED_LIMITS -16384.00 16383.50 AXIS_PTS_REF InjSys_nEng12Hpx_AX /end AXIS_DESCR
 /begin AXIS_DESCR COM_AXIS InjSys_ratAirMAxisInp rel_uw_q0p0234 12 0.00 1535.977 FORMAT "%8.3" AXIS_PTS_REF InjSys_ratAirM12Hpx_AX /end AXIS_DESCR
/end CHARACTERISTIC
/begin CHARACTERISTIC InjSys_P1V4I1_HP.agBgnWrmExtdEthnl_GM "class instance packet 1 variant 4 / ." MAP 0x80565E78 RB_MapGroup_U8 382.5 kw_q1p5 0.00 382.5 FORMAT "%5.1"
 /begin AXIS_DESCR COM_AXIS Epm_nEng EngN 12 0.00 16383.50 FORMAT "%8.2" EXTENDED_LIMITS -16384.00 16383.50 AXIS_PTS_REF InjSys_nEng12Hpx_AX /end AXIS_DESCR
 /begin AXIS_DESCR COM_AXIS InjSys_ratAirMAxisInp rel_uw_q0p0234 12 0.00 1535.977 FORMAT "%8.3" AXIS_PTS_REF InjSys_ratAirM12Hpx_AX /end AXIS_DESCR
/end CHARACTERISTIC
/begin CHARACTERISTIC InjSys_P1V4I1_HP.agBgnWrmExtd_GM "class instance packet 1 variant 4 / ." MAP 0x80565F08 RB_MapGroup_U8 382.5 kw_q1p5 0.00 382.5 FORMAT "%5.1"
 /begin AXIS_DESCR COM_AXIS Epm_nEng EngN 12 0.00 16383.50 FORMAT "%8.2" EXTENDED_LIMITS -16384.00 16383.50 AXIS_PTS_REF InjSys_nEng12Hpx_AX /end AXIS_DESCR
 /begin AXIS_DESCR COM_AXIS InjSys_ratAirMAxisInp rel_uw_q0p0234 12 0.00 1535.977 FORMAT "%8.3" AXIS_PTS_REF InjSys_ratAirM12Hpx_AX /end AXIS_DESCR
/end CHARACTERISTIC
/begin CHARACTERISTIC InjSys_P1V4I1_HP.agBgnWrmSmlVlvEthnl_GM "class instance packet 1 variant 4 / ." MAP 0x80565F98 RB_MapGroup_U8 382.5 kw_q1p5 0.00 382.5 FORMAT "%5.1"
 /begin AXIS_DESCR COM_AXIS Epm_nEng EngN 12 0.00 16383.50 FORMAT "%8.2" EXTENDED_LIMITS -16384.00 16383.50 AXIS_PTS_REF InjSys_nEng12Hpx_AX /end AXIS_DESCR
 /begin AXIS_DESCR COM_AXIS InjSys_ratAirMAxisInp rel_uw_q0p0234 12 0.00 1535.977 FORMAT "%8.3" AXIS_PTS_REF InjSys_ratAirM12Hpx_AX /end AXIS_DESCR
/end CHARACTERISTIC
/begin CHARACTERISTIC InjSys_P1V4I1_HP.agBgnWrmSmlVlv_GM "class instance packet 1 variant 4 / ." MAP 0x80566028 RB_MapGroup_U8 382.5 kw_q1p5 0.00 382.5 FORMAT "%5.1"
 /begin AXIS_DESCR COM_AXIS Epm_nEng EngN 12 0.00 16383.50 FORMAT "%8.2" EXTENDED_LIMITS -16384.00 16383.50 AXIS_PTS_REF InjSys_nEng12Hpx_AX /end AXIS_DESCR
 /begin AXIS_DESCR COM_AXIS InjSys_ratAirMAxisInp rel_uw_q0p0234 12 0.00 1535.977 FORMAT "%8.3" AXIS_PTS_REF InjSys_ratAirM12Hpx_AX /end AXIS_DESCR
/end CHARACTERISTIC
/begin CHARACTERISTIC InjSys_P1V4I1_HP.agDeltaEth_M "class instance packet 1 variant 4 / delta angle ethanol dependent" MAP 0x805660B8 RB_Map_S16S16_S16 191.2500 kw_q0p75 -96.00000 95.25000 FORMAT "%8.5" EXTENDED_LIMITS -24576.00 24575.25
 /begin AXIS_DESCR STD_AXIS InjSys_facEthLnrLocSp fak_ub_b2 4 0.00 1.992188 FORMAT "%8.6" EXTENDED_LIMITS -256.0000 255.9922 DEPOSIT ABSOLUTE /end AXIS_DESCR
 /begin AXIS_DESCR STD_AXIS InjSys_tEng Temp_Cels 4 -3549.940 3003.560 FORMAT "%8.3" DEPOSIT ABSOLUTE /end AXIS_DESCR
/end CHARACTERISTIC
/begin CHARACTERISTIC InjSys_P1V4I1_HP.agDeltaLam_M "class instance packet 1 variant 4 / ." MAP 0x805660EC RB_Map_S16U16_S16 191.2500 kw_q0p75 -96.00000 95.25000 FORMAT "%8.5" EXTENDED_LIMITS -24576.00 24575.25
 /begin AXIS_DESCR STD_AXIS Epm_nEng EngN 10 -16384.00 16383.50 FORMAT "%8.2" DEPOSIT ABSOLUTE /end AXIS_DESCR
 /begin AXIS_DESCR STD_AXIS InjSys_ratAirMPredLocSp kw_q0p0234 8 0.00 1535.977 FORMAT "%8.3" DEPOSIT ABSOLUTE /end AXIS_DESCR
/end CHARACTERISTIC
/begin CHARACTERISTIC InjSys_P1V4I1_HP.facAgBgnLam_T "class instance packet 1 variant 4 / ." CURVE 0x805661B4 RB_Curve_U8_U8 0.9961 fak_ub_b1 0.00 0.9961
 /begin AXIS_DESCR STD_AXIS InjSys_facLamBasLocSp fak_ub_b2 8 0.00 1.992188 FORMAT "%8.6" DEPOSIT ABSOLUTE /end AXIS_DESCR
/end CHARACTERISTIC
/begin CHARACTERISTIC InjSys_P1V4I1_HP.facEthnlAgBgn_T "class instance packet 1 variant 4 / ." CURVE 0x805661C5 RB_Curve_U8_U8 0.9961 fak_ub_b1 0.00 0.9961
 /begin AXIS_DESCR STD_AXIS fethstoeLocSp fak_ub_b2 4 0.00 1.992188 FORMAT "%8.6" DEPOSIT ABSOLUTE /end AXIS_DESCR
/end CHARACTERISTIC
/begin CHARACTERISTIC InjSys_P1V4I1_HP.facTPistCold_M "class instance packet 1 variant 4 / delta angle ethanol dependent" MAP 0x805661CE RB_Map_S16S16_U8 0.9961 fak_ub_b1 0.00 0.9961
 /begin AXIS_DESCR STD_AXIS InjSys_tEng Temp_Cels 8 -3549.940 3003.560 FORMAT "%8.3" DEPOSIT ABSOLUTE /end AXIS_DESCR
 /begin AXIS_DESCR STD_AXIS InjSys_tOilLocSp Temp_Cels 8 -3549.940 3003.560 FORMAT "%8.3" DEPOSIT ABSOLUTE /end AXIS_DESCR
/end CHARACTERISTIC
/begin CHARACTERISTIC InjSys_P1V4I1_HP.facTPist_M "class instance packet 1 variant 4 / weighting factor base angle in homogenous-split mode temperature dependent" MAP 0x80566232 RB_Map_S16S16_U8 0.9961 fak_ub_b1 0.00 0.9961
 /begin AXIS_DESCR STD_AXIS InjSys_tPistBas Temp_Cels 6 -3549.940 3003.560 FORMAT "%8.3" DEPOSIT ABSOLUTE /end AXIS_DESCR
 /begin AXIS_DESCR STD_AXIS InjSys_tPistDelta temp_q0p1 6 -3276.800 3276.700 FORMAT "%8.3" DEPOSIT ABSOLUTE /end AXIS_DESCR
/end CHARACTERISTIC
/begin CHARACTERISTIC InjSys_P1V4I1_HP.facWghtColdWrmEthnl_M "class instance packet 1 variant 4 / ." MAP 0x80566272 RB_Map_S16S16_U8 0.9961 fak_ub_b1 0.00 0.9961
 /begin AXIS_DESCR STD_AXIS InjSys_tEng Temp_Cels 6 -3549.940 3003.560 FORMAT "%8.3" DEPOSIT ABSOLUTE /end AXIS_DESCR
 /begin AXIS_DESCR STD_AXIS InjSys_tOilLocSp Temp_Cels 4 -3549.940 3003.560 FORMAT "%8.3" DEPOSIT ABSOLUTE /end AXIS_DESCR
/end CHARACTERISTIC
/begin CHARACTERISTIC InjSys_P1V4I1_HP.facWghtColdWrm_M "class instance packet 1 variant 4 / ." MAP 0x805662A2 RB_Map_S16S16_U8 0.9961 fak_ub_b1 0.00 0.9961
 /begin AXIS_DESCR STD_AXIS InjSys_tEng Temp_Cels 6 -3549.940 3003.560 FORMAT "%8.3" DEPOSIT ABSOLUTE /end AXIS_DESCR
 /begin AXIS_DESCR STD_AXIS InjSys_tOilLocSp Temp_Cels 4 -3549.940 3003.560 FORMAT "%8.3" DEPOSIT ABSOLUTE /end AXIS_DESCR
/end CHARACTERISTIC
/begin CHARACTERISTIC InjSys_P1V4I1_HP.facWghtTHsp_M "class instance packet 1 variant 4 / weighting factor base angle in homogenous-split mode temperature dependent" MAP 0x805662D2 RB_Map_S16S16_U8 0.9961 fak_ub_b1 0.00 0.9961
 /begin AXIS_DESCR STD_AXIS InjSys_tEng Temp_Cels 6 -3549.940 3003.560 FORMAT "%8.3" DEPOSIT ABSOLUTE /end AXIS_DESCR
 /begin AXIS_DESCR STD_AXIS InjSys_tEngStrt Temp_Cels 4 -3549.940 3003.560 FORMAT "%8.3" DEPOSIT ABSOLUTE /end AXIS_DESCR
/end CHARACTERISTIC
/begin CHARACTERISTIC InjSys_P1V4I1_HP.facWhgtWrmColdHsp_GM "class instance packet 1 variant 4 / weighting factor warm-cold base angle in homogenous-split mode" MAP 0x80566302 RB_MapGroup_U16 1.000000 fak_uw_b2 0.00 1.000000 FORMAT "%8.6" EXTENDED_LIMITS 0.00 1.999969
 /begin AXIS_DESCR COM_AXIS InjSys_tEngStrt Temp_Cels 8 -3549.940 3003.560 FORMAT "%8.3" AXIS_PTS_REF InjSys_tEngStrt08_AX /end AXIS_DESCR
 /begin AXIS_DESCR COM_AXIS InjSys_nrInjLimdLoc dez 4 0.00 65535.00 FORMAT "%8.2" AXIS_PTS_REF InjSys_nrInj04_AX /end AXIS_DESCR
/end CHARACTERISTIC
/begin CHARACTERISTIC InjSys_P1V4I1_HP.flgAxVers_C "class instance packet 1 variant 4 / condition map selection with group axis in version 2" VALUE 0x80566342 RB_Val_Wu8 1.00000000000 B_TRUE 0.00 1.00000000000 FORMAT "%13.11" /end CHARACTERISTIC
/begin CHARACTERISTIC InjSys_P1V4I2_HP.agBasHspHiVers2_GM "injection packet 1 in variant 4 / base angle in homogenous-split mode for interpolation (version 2)" MAP 0x8055BF7C RB_MapGroup_U8 382.5 kw_q1p5 0.00 382.5 FORMAT "%5.1"
 /begin AXIS_DESCR COM_AXIS Epm_nEng EngN 12 0.00 16383.50 FORMAT "%8.2" EXTENDED_LIMITS -16384.00 16383.50 AXIS_PTS_REF InjSys_nEng12HspVers2_AX /end AXIS_DESCR
 /begin AXIS_DESCR COM_AXIS InjSys_ratAirMAgSpVers2AxisInp rel_uw_q0p0234 12 0.00 1535.977 FORMAT "%8.3" AXIS_PTS_REF InjSys_ratAirM12AgSpHspVers2_AX /end AXIS_DESCR
/end CHARACTERISTIC
/begin CHARACTERISTIC InjSys_P1V4I2_HP.agBasHspHi_GM "injection packet 1 in variant 4 / base angle in homogenous-split mode for interpolation" MAP 0x8055C00C RB_MapGroup_U8 382.5 kw_q1p5 0.00 382.5 FORMAT "%5.1"
 /begin AXIS_DESCR COM_AXIS Epm_nEng EngN 12 0.00 16383.50 FORMAT "%8.2" EXTENDED_LIMITS -16384.00 16383.50 AXIS_PTS_REF InjSys_nEng12Hsp_AX /end AXIS_DESCR
 /begin AXIS_DESCR COM_AXIS InjSys_ratAirMAgSpAxisInp rel_uw_q0p0234 12 0.00 1535.977 FORMAT "%8.3" AXIS_PTS_REF InjSys_ratAirM12AgSpHsp_AX /end AXIS_DESCR
/end CHARACTERISTIC
/begin CHARACTERISTIC InjSys_P1V4I2_HP.agBasHspLoVers2_GM "injection packet 1 in variant 4 / base angle in homogenous-split mode for interpolation (version 2)" MAP 0x8055C09C RB_MapGroup_U8 382.5 kw_q1p5 0.00 382.5 FORMAT "%5.1"
 /begin AXIS_DESCR COM_AXIS Epm_nEng EngN 12 0.00 16383.50 FORMAT "%8.2" EXTENDED_LIMITS -16384.00 16383.50 AXIS_PTS_REF InjSys_nEng12HspVers2_AX /end AXIS_DESCR
 /begin AXIS_DESCR COM_AXIS InjSys_ratAirMAgSpVers2AxisInp rel_uw_q0p0234 12 0.00 1535.977 FORMAT "%8.3" AXIS_PTS_REF InjSys_ratAirM12AgSpHspVers2_AX /end AXIS_DESCR
/end CHARACTERISTIC
/begin CHARACTERISTIC InjSys_P1V4I2_HP.agBasHspLo_GM "injection packet 1 in variant 4 / base angle in homogenous-split mode for interpolation" MAP 0x8055C12C RB_MapGroup_U8 382.5 kw_q1p5 0.00 382.5 FORMAT "%5.1"
 /begin AXIS_DESCR COM_AXIS Epm_nEng EngN 12 0.00 16383.50 FORMAT "%8.2" EXTENDED_LIMITS -16384.00 16383.50 AXIS_PTS_REF InjSys_nEng12Hsp_AX /end AXIS_DESCR
 /begin AXIS_DESCR COM_AXIS InjSys_ratAirMAgSpAxisInp rel_uw_q0p0234 12 0.00 1535.977 FORMAT "%8.3" AXIS_PTS_REF InjSys_ratAirM12AgSpHsp_AX /end AXIS_DESCR
/end CHARACTERISTIC
/begin CHARACTERISTIC InjSys_P1V4I2_HP.agBasTPistColdVers2_GM "injection packet 1 in variant 4 / base angle at cold piston temperature (version 2)" MAP 0x8055C1BC RB_MapGroup_U8 382.5 kw_q1p5 0.00 382.5 FORMAT "%5.1"
 /begin AXIS_DESCR COM_AXIS Epm_nEng EngN 12 0.00 16383.50 FORMAT "%8.2" EXTENDED_LIMITS -16384.00 16383.50 AXIS_PTS_REF InjSys_nEng12Vers2_AX /end AXIS_DESCR
 /begin AXIS_DESCR COM_AXIS InjSys_ratAirMAgSpVers2AxisInp rel_uw_q0p0234 12 0.00 1535.977 FORMAT "%8.3" AXIS_PTS_REF InjSys_ratAirM12AgSpVers2_AX /end AXIS_DESCR
/end CHARACTERISTIC
/begin CHARACTERISTIC InjSys_P1V4I2_HP.agBasTPistCold_GM "injection packet 1 in variant 4 / base angle at cold piston temperature" MAP 0x8055C24C RB_MapGroup_U8 382.5 kw_q1p5 0.00 382.5 FORMAT "%5.1"
 /begin AXIS_DESCR COM_AXIS Epm_nEng EngN 12 0.00 16383.50 FORMAT "%8.2" EXTENDED_LIMITS -16384.00 16383.50 AXIS_PTS_REF InjSys_nEng12_AX /end AXIS_DESCR
 /begin AXIS_DESCR COM_AXIS InjSys_ratAirMAgSpAxisInp rel_uw_q0p0234 12 0.00 1535.977 FORMAT "%8.3" AXIS_PTS_REF InjSys_ratAirM12AgSp_AX /end AXIS_DESCR
/end CHARACTERISTIC
/begin CHARACTERISTIC InjSys_P1V4I2_HP.agBasTPistWrmVers2_GM "injection packet 1 in variant 4 / base angle for interpolation Warm TSA mode (Version 2)" MAP 0x8055C2DC RB_MapGroup_U8 382.5 kw_q1p5 0.00 382.5 FORMAT "%5.1"
 /begin AXIS_DESCR COM_AXIS Epm_nEng EngN 12 0.00 16383.50 FORMAT "%8.2" EXTENDED_LIMITS -16384.00 16383.50 AXIS_PTS_REF InjSys_nEng12Vers2_AX /end AXIS_DESCR
 /begin AXIS_DESCR COM_AXIS InjSys_ratAirMAgSpVers2AxisInp rel_uw_q0p0234 12 0.00 1535.977 FORMAT "%8.3" AXIS_PTS_REF InjSys_ratAirM12AgSpVers2_AX /end AXIS_DESCR
/end CHARACTERISTIC
/begin CHARACTERISTIC InjSys_P1V4I2_HP.agBasTPistWrm_GM "injection packet 1 in variant 4 / base angle for interpolation Warm TSA mode" MAP 0x8055C36C RB_MapGroup_U8 382.5 kw_q1p5 0.00 382.5 FORMAT "%5.1"
 /begin AXIS_DESCR COM_AXIS Epm_nEng EngN 12 0.00 16383.50 FORMAT "%8.2" EXTENDED_LIMITS -16384.00 16383.50 AXIS_PTS_REF InjSys_nEng12_AX /end AXIS_DESCR
 /begin AXIS_DESCR COM_AXIS InjSys_ratAirMAgSpAxisInp rel_uw_q0p0234 12 0.00 1535.977 FORMAT "%8.3" AXIS_PTS_REF InjSys_ratAirM12AgSp_AX /end AXIS_DESCR
/end CHARACTERISTIC
/begin CHARACTERISTIC InjSys_P1V4I2_HP.agBgnColdExtdEthnl_GM "injection packet 1 in variant 4 / ." MAP 0x8055C3FC RB_MapGroup_U8 382.5 kw_q1p5 0.00 382.5 FORMAT "%5.1"
 /begin AXIS_DESCR COM_AXIS Epm_nEng EngN 12 0.00 16383.50 FORMAT "%8.2" EXTENDED_LIMITS -16384.00 16383.50 AXIS_PTS_REF InjSys_nEng12Hpx_AX /end AXIS_DESCR
 /begin AXIS_DESCR COM_AXIS InjSys_ratAirMAxisInp rel_uw_q0p0234 12 0.00 1535.977 FORMAT "%8.3" AXIS_PTS_REF InjSys_ratAirM12Hpx_AX /end AXIS_DESCR
/end CHARACTERISTIC
/begin CHARACTERISTIC InjSys_P1V4I2_HP.agBgnColdExtd_GM "injection packet 1 in variant 4 / ." MAP 0x8055C48C RB_MapGroup_U8 382.5 kw_q1p5 0.00 382.5 FORMAT "%5.1"
 /begin AXIS_DESCR COM_AXIS Epm_nEng EngN 12 0.00 16383.50 FORMAT "%8.2" EXTENDED_LIMITS -16384.00 16383.50 AXIS_PTS_REF InjSys_nEng12Hpx_AX /end AXIS_DESCR
 /begin AXIS_DESCR COM_AXIS InjSys_ratAirMAxisInp rel_uw_q0p0234 12 0.00 1535.977 FORMAT "%8.3" AXIS_PTS_REF InjSys_ratAirM12Hpx_AX /end AXIS_DESCR
/end CHARACTERISTIC
/begin CHARACTERISTIC InjSys_P1V4I2_HP.agBgnColdSmlVlvEthnl_GM "injection packet 1 in variant 4 / ." MAP 0x8055C51C RB_MapGroup_U8 382.5 kw_q1p5 0.00 382.5 FORMAT "%5.1"
 /begin AXIS_DESCR COM_AXIS Epm_nEng EngN 12 0.00 16383.50 FORMAT "%8.2" EXTENDED_LIMITS -16384.00 16383.50 AXIS_PTS_REF InjSys_nEng12Hpx_AX /end AXIS_DESCR
 /begin AXIS_DESCR COM_AXIS InjSys_ratAirMAxisInp rel_uw_q0p0234 12 0.00 1535.977 FORMAT "%8.3" AXIS_PTS_REF InjSys_ratAirM12Hpx_AX /end AXIS_DESCR
/end CHARACTERISTIC
/begin CHARACTERISTIC InjSys_P1V4I2_HP.agBgnColdSmlVlv_GM "injection packet 1 in variant 4 / ." MAP 0x8055C5AC RB_MapGroup_U8 382.5 kw_q1p5 0.00 382.5 FORMAT "%5.1"
 /begin AXIS_DESCR COM_AXIS Epm_nEng EngN 12 0.00 16383.50 FORMAT "%8.2" EXTENDED_LIMITS -16384.00 16383.50 AXIS_PTS_REF InjSys_nEng12Hpx_AX /end AXIS_DESCR
 /begin AXIS_DESCR COM_AXIS InjSys_ratAirMAxisInp rel_uw_q0p0234 12 0.00 1535.977 FORMAT "%8.3" AXIS_PTS_REF InjSys_ratAirM12Hpx_AX /end AXIS_DESCR
/end CHARACTERISTIC
/begin CHARACTERISTIC InjSys_P1V4I2_HP.agBgnWrmExtdEthnl_GM "injection packet 1 in variant 4 / ." MAP 0x8055C63C RB_MapGroup_U8 382.5 kw_q1p5 0.00 382.5 FORMAT "%5.1"
 /begin AXIS_DESCR COM_AXIS Epm_nEng EngN 12 0.00 16383.50 FORMAT "%8.2" EXTENDED_LIMITS -16384.00 16383.50 AXIS_PTS_REF InjSys_nEng12Hpx_AX /end AXIS_DESCR
 /begin AXIS_DESCR COM_AXIS InjSys_ratAirMAxisInp rel_uw_q0p0234 12 0.00 1535.977 FORMAT "%8.3" AXIS_PTS_REF InjSys_ratAirM12Hpx_AX /end AXIS_DESCR
/end CHARACTERISTIC
/begin CHARACTERISTIC InjSys_P1V4I2_HP.agBgnWrmExtd_GM "injection packet 1 in variant 4 / ." MAP 0x8055C6CC RB_MapGroup_U8 382.5 kw_q1p5 0.00 382.5 FORMAT "%5.1"
 /begin AXIS_DESCR COM_AXIS Epm_nEng EngN 12 0.00 16383.50 FORMAT "%8.2" EXTENDED_LIMITS -16384.00 16383.50 AXIS_PTS_REF InjSys_nEng12Hpx_AX /end AXIS_DESCR
 /begin AXIS_DESCR COM_AXIS InjSys_ratAirMAxisInp rel_uw_q0p0234 12 0.00 1535.977 FORMAT "%8.3" AXIS_PTS_REF InjSys_ratAirM12Hpx_AX /end AXIS_DESCR
/end CHARACTERISTIC
/begin CHARACTERISTIC InjSys_P1V4I2_HP.agBgnWrmSmlVlvEthnl_GM "injection packet 1 in variant 4 / ." MAP 0x8055C75C RB_MapGroup_U8 382.5 kw_q1p5 0.00 382.5 FORMAT "%5.1"
 /begin AXIS_DESCR COM_AXIS Epm_nEng EngN 12 0.00 16383.50 FORMAT "%8.2" EXTENDED_LIMITS -16384.00 16383.50 AXIS_PTS_REF InjSys_nEng12Hpx_AX /end AXIS_DESCR
 /begin AXIS_DESCR COM_AXIS InjSys_ratAirMAxisInp rel_uw_q0p0234 12 0.00 1535.977 FORMAT "%8.3" AXIS_PTS_REF InjSys_ratAirM12Hpx_AX /end AXIS_DESCR
/end CHARACTERISTIC
/begin CHARACTERISTIC InjSys_P1V4I2_HP.agBgnWrmSmlVlv_GM "injection packet 1 in variant 4 / ." MAP 0x8055C7EC RB_MapGroup_U8 382.5 kw_q1p5 0.00 382.5 FORMAT "%5.1"
 /begin AXIS_DESCR COM_AXIS Epm_nEng EngN 12 0.00 16383.50 FORMAT "%8.2" EXTENDED_LIMITS -16384.00 16383.50 AXIS_PTS_REF InjSys_nEng12Hpx_AX /end AXIS_DESCR
 /begin AXIS_DESCR COM_AXIS InjSys_ratAirMAxisInp rel_uw_q0p0234 12 0.00 1535.977 FORMAT "%8.3" AXIS_PTS_REF InjSys_ratAirM12Hpx_AX /end AXIS_DESCR
/end CHARACTERISTIC
/begin CHARACTERISTIC InjSys_P1V4I2_HP.agDeltaEth_M "injection packet 1 in variant 4 / delta angle ethanol dependent" MAP 0x8055C87C RB_Map_S16S16_S16 191.2500 kw_q0p75 -96.00000 95.25000 FORMAT "%8.5" EXTENDED_LIMITS -24576.00 24575.25
 /begin AXIS_DESCR STD_AXIS InjSys_facEthLnrLocSp fak_ub_b2 4 0.00 1.992188 FORMAT "%8.6" EXTENDED_LIMITS -256.0000 255.9922 DEPOSIT ABSOLUTE /end AXIS_DESCR
 /begin AXIS_DESCR STD_AXIS InjSys_tEng Temp_Cels 4 -3549.940 3003.560 FORMAT "%8.3" DEPOSIT ABSOLUTE /end AXIS_DESCR
/end CHARACTERISTIC
/begin CHARACTERISTIC InjSys_P1V4I2_HP.agDeltaLam_M "injection packet 1 in variant 4 / ." MAP 0x8055C8B0 RB_Map_S16U16_S16 191.2500 kw_q0p75 -96.00000 95.25000 FORMAT "%8.5" EXTENDED_LIMITS -24576.00 24575.25
 /begin AXIS_DESCR STD_AXIS Epm_nEng EngN 10 -16384.00 16383.50 FORMAT "%8.2" DEPOSIT ABSOLUTE /end AXIS_DESCR
 /begin AXIS_DESCR STD_AXIS InjSys_ratAirMPredLocSp kw_q0p0234 8 0.00 1535.977 FORMAT "%8.3" DEPOSIT ABSOLUTE /end AXIS_DESCR
/end CHARACTERISTIC
/begin CHARACTERISTIC InjSys_P1V4I2_HP.facAgBgnLam_T "injection packet 1 in variant 4 / ." CURVE 0x8055C978 RB_Curve_U8_U8 0.9961 fak_ub_b1 0.00 0.9961
 /begin AXIS_DESCR STD_AXIS InjSys_facLamBasLocSp fak_ub_b2 8 0.00 1.992188 FORMAT "%8.6" DEPOSIT ABSOLUTE /end AXIS_DESCR
/end CHARACTERISTIC
/begin CHARACTERISTIC InjSys_P1V4I2_HP.facEthnlAgBgn_T "injection packet 1 in variant 4 / ." CURVE 0x8055C989 RB_Curve_U8_U8 0.9961 fak_ub_b1 0.00 0.9961
 /begin AXIS_DESCR STD_AXIS fethstoeLocSp fak_ub_b2 4 0.00 1.992188 FORMAT "%8.6" DEPOSIT ABSOLUTE /end AXIS_DESCR
/end CHARACTERISTIC
/begin CHARACTERISTIC InjSys_P1V4I2_HP.facTPistCold_M "injection packet 1 in variant 4 / delta angle ethanol dependent" MAP 0x8055C992 RB_Map_S16S16_U8 0.9961 fak_ub_b1 0.00 0.9961
 /begin AXIS_DESCR STD_AXIS InjSys_tEng Temp_Cels 8 -3549.940 3003.560 FORMAT "%8.3" DEPOSIT ABSOLUTE /end AXIS_DESCR
 /begin AXIS_DESCR STD_AXIS InjSys_tOilLocSp Temp_Cels 8 -3549.940 3003.560 FORMAT "%8.3" DEPOSIT ABSOLUTE /end AXIS_DESCR
/end CHARACTERISTIC
/begin CHARACTERISTIC InjSys_P1V4I2_HP.facTPist_M "injection packet 1 in variant 4 / weighting factor base angle in homogenous-split mode temperature dependent" MAP 0x8055C9F6 RB_Map_S16S16_U8 0.9961 fak_ub_b1 0.00 0.9961
 /begin AXIS_DESCR STD_AXIS InjSys_tPistBas Temp_Cels 6 -3549.940 3003.560 FORMAT "%8.3" DEPOSIT ABSOLUTE /end AXIS_DESCR
 /begin AXIS_DESCR STD_AXIS InjSys_tPistDelta temp_q0p1 6 -3276.800 3276.700 FORMAT "%8.3" DEPOSIT ABSOLUTE /end AXIS_DESCR
/end CHARACTERISTIC
/begin CHARACTERISTIC InjSys_P1V4I2_HP.facWghtColdWrmEthnl_M "injection packet 1 in variant 4 / ." MAP 0x8055CA36 RB_Map_S16S16_U8 0.9961 fak_ub_b1 0.00 0.9961
 /begin AXIS_DESCR STD_AXIS InjSys_tEng Temp_Cels 6 -3549.940 3003.560 FORMAT "%8.3" DEPOSIT ABSOLUTE /end AXIS_DESCR
 /begin AXIS_DESCR STD_AXIS InjSys_tOilLocSp Temp_Cels 4 -3549.940 3003.560 FORMAT "%8.3" DEPOSIT ABSOLUTE /end AXIS_DESCR
/end CHARACTERISTIC
/begin CHARACTERISTIC InjSys_P1V4I2_HP.facWghtColdWrm_M "injection packet 1 in variant 4 / ." MAP 0x8055CA66 RB_Map_S16S16_U8 0.9961 fak_ub_b1 0.00 0.9961
 /begin AXIS_DESCR STD_AXIS InjSys_tEng Temp_Cels 6 -3549.940 3003.560 FORMAT "%8.3" DEPOSIT ABSOLUTE /end AXIS_DESCR
 /begin AXIS_DESCR STD_AXIS InjSys_tOilLocSp Temp_Cels 4 -3549.940 3003.560 FORMAT "%8.3" DEPOSIT ABSOLUTE /end AXIS_DESCR
/end CHARACTERISTIC
/begin CHARACTERISTIC InjSys_P1V4I2_HP.facWghtTHsp_M "injection packet 1 in variant 4 / weighting factor base angle in homogenous-split mode temperature dependent" MAP 0x8055CA96 RB_Map_S16S16_U8 0.9961 fak_ub_b1 0.00 0.9961
 /begin AXIS_DESCR STD_AXIS InjSys_tEng Temp_Cels 6 -3549.940 3003.560 FORMAT "%8.3" DEPOSIT ABSOLUTE /end AXIS_DESCR
 /begin AXIS_DESCR STD_AXIS InjSys_tEngStrt Temp_Cels 4 -3549.940 3003.560 FORMAT "%8.3" DEPOSIT ABSOLUTE /end AXIS_DESCR
/end CHARACTERISTIC
/begin CHARACTERISTIC InjSys_P1V4I2_HP.facWhgtWrmColdHsp_GM "injection packet 1 in variant 4 / weighting factor warm-cold base angle in homogenous-split mode" MAP 0x8055CAC6 RB_MapGroup_U16 1.000000 fak_uw_b2 0.00 1.000000 FORMAT "%8.6" EXTENDED_LIMITS 0.00 1.999969
 /begin AXIS_DESCR COM_AXIS InjSys_tEngStrt Temp_Cels 8 -3549.940 3003.560 FORMAT "%8.3" AXIS_PTS_REF InjSys_tEngStrt08_AX /end AXIS_DESCR
 /begin AXIS_DESCR COM_AXIS InjSys_nrInjLimdLoc dez 4 0.00 65535.00 FORMAT "%8.2" AXIS_PTS_REF InjSys_nrInj04_AX /end AXIS_DESCR
/end CHARACTERISTIC
/begin CHARACTERISTIC InjSys_P1V4I2_HP.flgAxVers_C "injection packet 1 in variant 4 / condition map selection with group axis in version 2" VALUE 0x8055CB06 RB_Val_Wu8 1.00000000000 B_TRUE 0.00 1.00000000000 FORMAT "%13.11" /end CHARACTERISTIC
/begin CHARACTERISTIC InjSys_P1V4I3_HP.agBasHspHiVers2_GM "injection packet 1 in variant 4 / base angle in homogenous-split mode for interpolation (version 2)" MAP 0x8055CB0C RB_MapGroup_U8 382.5 kw_q1p5 0.00 382.5 FORMAT "%5.1"
 /begin AXIS_DESCR COM_AXIS Epm_nEng EngN 12 0.00 16383.50 FORMAT "%8.2" EXTENDED_LIMITS -16384.00 16383.50 AXIS_PTS_REF InjSys_nEng12HspVers2_AX /end AXIS_DESCR
 /begin AXIS_DESCR COM_AXIS InjSys_ratAirMAgSpVers2AxisInp rel_uw_q0p0234 12 0.00 1535.977 FORMAT "%8.3" AXIS_PTS_REF InjSys_ratAirM12AgSpHspVers2_AX /end AXIS_DESCR
/end CHARACTERISTIC
/begin CHARACTERISTIC InjSys_P1V4I3_HP.agBasHspHi_GM "injection packet 1 in variant 4 / base angle in homogenous-split mode for interpolation" MAP 0x8055CB9C RB_MapGroup_U8 382.5 kw_q1p5 0.00 382.5 FORMAT "%5.1"
 /begin AXIS_DESCR COM_AXIS Epm_nEng EngN 12 0.00 16383.50 FORMAT "%8.2" EXTENDED_LIMITS -16384.00 16383.50 AXIS_PTS_REF InjSys_nEng12Hsp_AX /end AXIS_DESCR
 /begin AXIS_DESCR COM_AXIS InjSys_ratAirMAgSpAxisInp rel_uw_q0p0234 12 0.00 1535.977 FORMAT "%8.3" AXIS_PTS_REF InjSys_ratAirM12AgSpHsp_AX /end AXIS_DESCR
/end CHARACTERISTIC
/begin CHARACTERISTIC InjSys_P1V4I3_HP.agBasHspLoVers2_GM "injection packet 1 in variant 4 / base angle in homogenous-split mode for interpolation (version 2)" MAP 0x8055CC2C RB_MapGroup_U8 382.5 kw_q1p5 0.00 382.5 FORMAT "%5.1"
 /begin AXIS_DESCR COM_AXIS Epm_nEng EngN 12 0.00 16383.50 FORMAT "%8.2" EXTENDED_LIMITS -16384.00 16383.50 AXIS_PTS_REF InjSys_nEng12HspVers2_AX /end AXIS_DESCR
 /begin AXIS_DESCR COM_AXIS InjSys_ratAirMAgSpVers2AxisInp rel_uw_q0p0234 12 0.00 1535.977 FORMAT "%8.3" AXIS_PTS_REF InjSys_ratAirM12AgSpHspVers2_AX /end AXIS_DESCR
/end CHARACTERISTIC
/begin CHARACTERISTIC InjSys_P1V4I3_HP.agBasHspLo_GM "injection packet 1 in variant 4 / base angle in homogenous-split mode for interpolation" MAP 0x8055CCBC RB_MapGroup_U8 382.5 kw_q1p5 0.00 382.5 FORMAT "%5.1"
 /begin AXIS_DESCR COM_AXIS Epm_nEng EngN 12 0.00 16383.50 FORMAT "%8.2" EXTENDED_LIMITS -16384.00 16383.50 AXIS_PTS_REF InjSys_nEng12Hsp_AX /end AXIS_DESCR
 /begin AXIS_DESCR COM_AXIS InjSys_ratAirMAgSpAxisInp rel_uw_q0p0234 12 0.00 1535.977 FORMAT "%8.3" AXIS_PTS_REF InjSys_ratAirM12AgSpHsp_AX /end AXIS_DESCR
/end CHARACTERISTIC
/begin CHARACTERISTIC InjSys_P1V4I3_HP.agBasTPistColdVers2_GM "injection packet 1 in variant 4 / base angle at cold piston temperature (version 2)" MAP 0x8055CD4C RB_MapGroup_U8 382.5 kw_q1p5 0.00 382.5 FORMAT "%5.1"
 /begin AXIS_DESCR COM_AXIS Epm_nEng EngN 12 0.00 16383.50 FORMAT "%8.2" EXTENDED_LIMITS -16384.00 16383.50 AXIS_PTS_REF InjSys_nEng12Vers2_AX /end AXIS_DESCR
 /begin AXIS_DESCR COM_AXIS InjSys_ratAirMAgSpVers2AxisInp rel_uw_q0p0234 12 0.00 1535.977 FORMAT "%8.3" AXIS_PTS_REF InjSys_ratAirM12AgSpVers2_AX /end AXIS_DESCR
/end CHARACTERISTIC
/begin CHARACTERISTIC InjSys_P1V4I3_HP.agBasTPistCold_GM "injection packet 1 in variant 4 / base angle at cold piston temperature" MAP 0x8055CDDC RB_MapGroup_U8 382.5 kw_q1p5 0.00 382.5 FORMAT "%5.1"
 /begin AXIS_DESCR COM_AXIS Epm_nEng EngN 12 0.00 16383.50 FORMAT "%8.2" EXTENDED_LIMITS -16384.00 16383.50 AXIS_PTS_REF InjSys_nEng12_AX /end AXIS_DESCR
 /begin AXIS_DESCR COM_AXIS InjSys_ratAirMAgSpAxisInp rel_uw_q0p0234 12 0.00 1535.977 FORMAT "%8.3" AXIS_PTS_REF InjSys_ratAirM12AgSp_AX /end AXIS_DESCR
/end CHARACTERISTIC
/begin CHARACTERISTIC InjSys_P1V4I3_HP.agBasTPistWrmVers2_GM "injection packet 1 in variant 4 / base angle for interpolation Warm TSA mode (Version 2)" MAP 0x8055CE6C RB_MapGroup_U8 382.5 kw_q1p5 0.00 382.5 FORMAT "%5.1"
 /begin AXIS_DESCR COM_AXIS Epm_nEng EngN 12 0.00 16383.50 FORMAT "%8.2" EXTENDED_LIMITS -16384.00 16383.50 AXIS_PTS_REF InjSys_nEng12Vers2_AX /end AXIS_DESCR
 /begin AXIS_DESCR COM_AXIS InjSys_ratAirMAgSpVers2AxisInp rel_uw_q0p0234 12 0.00 1535.977 FORMAT "%8.3" AXIS_PTS_REF InjSys_ratAirM12AgSpVers2_AX /end AXIS_DESCR
/end CHARACTERISTIC
/begin CHARACTERISTIC InjSys_P1V4I3_HP.agBasTPistWrm_GM "injection packet 1 in variant 4 / base angle for interpolation Warm TSA mode" MAP 0x8055CEFC RB_MapGroup_U8 382.5 kw_q1p5 0.00 382.5 FORMAT "%5.1"
 /begin AXIS_DESCR COM_AXIS Epm_nEng EngN 12 0.00 16383.50 FORMAT "%8.2" EXTENDED_LIMITS -16384.00 16383.50 AXIS_PTS_REF InjSys_nEng12_AX /end AXIS_DESCR
 /begin AXIS_DESCR COM_AXIS InjSys_ratAirMAgSpAxisInp rel_uw_q0p0234 12 0.00 1535.977 FORMAT "%8.3" AXIS_PTS_REF InjSys_ratAirM12AgSp_AX /end AXIS_DESCR
/end CHARACTERISTIC
/begin CHARACTERISTIC InjSys_P1V4I3_HP.agBgnColdExtdEthnl_GM "injection packet 1 in variant 4 / ." MAP 0x8055CF8C RB_MapGroup_U8 382.5 kw_q1p5 0.00 382.5 FORMAT "%5.1"
 /begin AXIS_DESCR COM_AXIS Epm_nEng EngN 12 0.00 16383.50 FORMAT "%8.2" EXTENDED_LIMITS -16384.00 16383.50 AXIS_PTS_REF InjSys_nEng12Hpx_AX /end AXIS_DESCR
 /begin AXIS_DESCR COM_AXIS InjSys_ratAirMAxisInp rel_uw_q0p0234 12 0.00 1535.977 FORMAT "%8.3" AXIS_PTS_REF InjSys_ratAirM12Hpx_AX /end AXIS_DESCR
/end CHARACTERISTIC
/begin CHARACTERISTIC InjSys_P1V4I3_HP.agBgnColdExtd_GM "injection packet 1 in variant 4 / ." MAP 0x8055D01C RB_MapGroup_U8 382.5 kw_q1p5 0.00 382.5 FORMAT "%5.1"
 /begin AXIS_DESCR COM_AXIS Epm_nEng EngN 12 0.00 16383.50 FORMAT "%8.2" EXTENDED_LIMITS -16384.00 16383.50 AXIS_PTS_REF InjSys_nEng12Hpx_AX /end AXIS_DESCR
 /begin AXIS_DESCR COM_AXIS InjSys_ratAirMAxisInp rel_uw_q0p0234 12 0.00 1535.977 FORMAT "%8.3" AXIS_PTS_REF InjSys_ratAirM12Hpx_AX /end AXIS_DESCR
/end CHARACTERISTIC
/begin CHARACTERISTIC InjSys_P1V4I3_HP.agBgnColdSmlVlvEthnl_GM "injection packet 1 in variant 4 / ." MAP 0x8055D0AC RB_MapGroup_U8 382.5 kw_q1p5 0.00 382.5 FORMAT "%5.1"
 /begin AXIS_DESCR COM_AXIS Epm_nEng EngN 12 0.00 16383.50 FORMAT "%8.2" EXTENDED_LIMITS -16384.00 16383.50 AXIS_PTS_REF InjSys_nEng12Hpx_AX /end AXIS_DESCR
 /begin AXIS_DESCR COM_AXIS InjSys_ratAirMAxisInp rel_uw_q0p0234 12 0.00 1535.977 FORMAT "%8.3" AXIS_PTS_REF InjSys_ratAirM12Hpx_AX /end AXIS_DESCR
/end CHARACTERISTIC
/begin CHARACTERISTIC InjSys_P1V4I3_HP.agBgnColdSmlVlv_GM "injection packet 1 in variant 4 / ." MAP 0x8055D13C RB_MapGroup_U8 382.5 kw_q1p5 0.00 382.5 FORMAT "%5.1"
 /begin AXIS_DESCR COM_AXIS Epm_nEng EngN 12 0.00 16383.50 FORMAT "%8.2" EXTENDED_LIMITS -16384.00 16383.50 AXIS_PTS_REF InjSys_nEng12Hpx_AX /end AXIS_DESCR
 /begin AXIS_DESCR COM_AXIS InjSys_ratAirMAxisInp rel_uw_q0p0234 12 0.00 1535.977 FORMAT "%8.3" AXIS_PTS_REF InjSys_ratAirM12Hpx_AX /end AXIS_DESCR
/end CHARACTERISTIC
/begin CHARACTERISTIC InjSys_P1V4I3_HP.agBgnWrmExtdEthnl_GM "injection packet 1 in variant 4 / ." MAP 0x8055D1CC RB_MapGroup_U8 382.5 kw_q1p5 0.00 382.5 FORMAT "%5.1"
 /begin AXIS_DESCR COM_AXIS Epm_nEng EngN 12 0.00 16383.50 FORMAT "%8.2" EXTENDED_LIMITS -16384.00 16383.50 AXIS_PTS_REF InjSys_nEng12Hpx_AX /end AXIS_DESCR
 /begin AXIS_DESCR COM_AXIS InjSys_ratAirMAxisInp rel_uw_q0p0234 12 0.00 1535.977 FORMAT "%8.3" AXIS_PTS_REF InjSys_ratAirM12Hpx_AX /end AXIS_DESCR
/end CHARACTERISTIC
/begin CHARACTERISTIC InjSys_P1V4I3_HP.agBgnWrmExtd_GM "injection packet 1 in variant 4 / ." MAP 0x8055D25C RB_MapGroup_U8 382.5 kw_q1p5 0.00 382.5 FORMAT "%5.1"
 /begin AXIS_DESCR COM_AXIS Epm_nEng EngN 12 0.00 16383.50 FORMAT "%8.2" EXTENDED_LIMITS -16384.00 16383.50 AXIS_PTS_REF InjSys_nEng12Hpx_AX /end AXIS_DESCR
 /begin AXIS_DESCR COM_AXIS InjSys_ratAirMAxisInp rel_uw_q0p0234 12 0.00 1535.977 FORMAT "%8.3" AXIS_PTS_REF InjSys_ratAirM12Hpx_AX /end AXIS_DESCR
/end CHARACTERISTIC
/begin CHARACTERISTIC InjSys_P1V4I3_HP.agBgnWrmSmlVlvEthnl_GM "injection packet 1 in variant 4 / ." MAP 0x8055D2EC RB_MapGroup_U8 382.5 kw_q1p5 0.00 382.5 FORMAT "%5.1"
 /begin AXIS_DESCR COM_AXIS Epm_nEng EngN 12 0.00 16383.50 FORMAT "%8.2" EXTENDED_LIMITS -16384.00 16383.50 AXIS_PTS_REF InjSys_nEng12Hpx_AX /end AXIS_DESCR
 /begin AXIS_DESCR COM_AXIS InjSys_ratAirMAxisInp rel_uw_q0p0234 12 0.00 1535.977 FORMAT "%8.3" AXIS_PTS_REF InjSys_ratAirM12Hpx_AX /end AXIS_DESCR
/end CHARACTERISTIC
/begin CHARACTERISTIC InjSys_P1V4I3_HP.agBgnWrmSmlVlv_GM "injection packet 1 in variant 4 / ." MAP 0x8055D37C RB_MapGroup_U8 382.5 kw_q1p5 0.00 382.5 FORMAT "%5.1"
 /begin AXIS_DESCR COM_AXIS Epm_nEng EngN 12 0.00 16383.50 FORMAT "%8.2" EXTENDED_LIMITS -16384.00 16383.50 AXIS_PTS_REF InjSys_nEng12Hpx_AX /end AXIS_DESCR
 /begin AXIS_DESCR COM_AXIS InjSys_ratAirMAxisInp rel_uw_q0p0234 12 0.00 1535.977 FORMAT "%8.3" AXIS_PTS_REF InjSys_ratAirM12Hpx_AX /end AXIS_DESCR
/end CHARACTERISTIC
/begin CHARACTERISTIC InjSys_P1V4I3_HP.agDeltaEth_M "injection packet 1 in variant 4 / delta angle ethanol dependent" MAP 0x8055D40C RB_Map_S16S16_S16 191.2500 kw_q0p75 -96.00000 95.25000 FORMAT "%8.5" EXTENDED_LIMITS -24576.00 24575.25
 /begin AXIS_DESCR STD_AXIS InjSys_facEthLnrLocSp fak_ub_b2 4 0.00 1.992188 FORMAT "%8.6" EXTENDED_LIMITS -256.0000 255.9922 DEPOSIT ABSOLUTE /end AXIS_DESCR
 /begin AXIS_DESCR STD_AXIS InjSys_tEng Temp_Cels 4 -3549.940 3003.560 FORMAT "%8.3" DEPOSIT ABSOLUTE /end AXIS_DESCR
/end CHARACTERISTIC
/begin CHARACTERISTIC InjSys_P1V4I3_HP.agDeltaLam_M "injection packet 1 in variant 4 / ." MAP 0x8055D440 RB_Map_S16U16_S16 191.2500 kw_q0p75 -96.00000 95.25000 FORMAT "%8.5" EXTENDED_LIMITS -24576.00 24575.25
 /begin AXIS_DESCR STD_AXIS Epm_nEng EngN 10 -16384.00 16383.50 FORMAT "%8.2" DEPOSIT ABSOLUTE /end AXIS_DESCR
 /begin AXIS_DESCR STD_AXIS InjSys_ratAirMPredLocSp kw_q0p0234 8 0.00 1535.977 FORMAT "%8.3" DEPOSIT ABSOLUTE /end AXIS_DESCR
/end CHARACTERISTIC
/begin CHARACTERISTIC InjSys_P1V4I3_HP.facAgBgnLam_T "injection packet 1 in variant 4 / ." CURVE 0x8055D508 RB_Curve_U8_U8 0.9961 fak_ub_b1 0.00 0.9961
 /begin AXIS_DESCR STD_AXIS InjSys_facLamBasLocSp fak_ub_b2 8 0.00 1.992188 FORMAT "%8.6" DEPOSIT ABSOLUTE /end AXIS_DESCR
/end CHARACTERISTIC
/begin CHARACTERISTIC InjSys_P1V4I3_HP.facEthnlAgBgn_T "injection packet 1 in variant 4 / ." CURVE 0x8055D519 RB_Curve_U8_U8 0.9961 fak_ub_b1 0.00 0.9961
 /begin AXIS_DESCR STD_AXIS fethstoeLocSp fak_ub_b2 4 0.00 1.992188 FORMAT "%8.6" DEPOSIT ABSOLUTE /end AXIS_DESCR
/end CHARACTERISTIC
/begin CHARACTERISTIC InjSys_P1V4I3_HP.facTPistCold_M "injection packet 1 in variant 4 / delta angle ethanol dependent" MAP 0x8055D522 RB_Map_S16S16_U8 0.9961 fak_ub_b1 0.00 0.9961
 /begin AXIS_DESCR STD_AXIS InjSys_tEng Temp_Cels 8 -3549.940 3003.560 FORMAT "%8.3" DEPOSIT ABSOLUTE /end AXIS_DESCR
 /begin AXIS_DESCR STD_AXIS InjSys_tOilLocSp Temp_Cels 8 -3549.940 3003.560 FORMAT "%8.3" DEPOSIT ABSOLUTE /end AXIS_DESCR
/end CHARACTERISTIC
/begin CHARACTERISTIC InjSys_P1V4I3_HP.facTPist_M "injection packet 1 in variant 4 / weighting factor base angle in homogenous-split mode temperature dependent" MAP 0x8055D586 RB_Map_S16S16_U8 0.9961 fak_ub_b1 0.00 0.9961
 /begin AXIS_DESCR STD_AXIS InjSys_tPistBas Temp_Cels 6 -3549.940 3003.560 FORMAT "%8.3" DEPOSIT ABSOLUTE /end AXIS_DESCR
 /begin AXIS_DESCR STD_AXIS InjSys_tPistDelta temp_q0p1 6 -3276.800 3276.700 FORMAT "%8.3" DEPOSIT ABSOLUTE /end AXIS_DESCR
/end CHARACTERISTIC
/begin CHARACTERISTIC InjSys_P1V4I3_HP.facWghtColdWrmEthnl_M "injection packet 1 in variant 4 / ." MAP 0x8055D5C6 RB_Map_S16S16_U8 0.9961 fak_ub_b1 0.00 0.9961
 /begin AXIS_DESCR STD_AXIS InjSys_tEng Temp_Cels 6 -3549.940 3003.560 FORMAT "%8.3" DEPOSIT ABSOLUTE /end AXIS_DESCR
 /begin AXIS_DESCR STD_AXIS InjSys_tOilLocSp Temp_Cels 4 -3549.940 3003.560 FORMAT "%8.3" DEPOSIT ABSOLUTE /end AXIS_DESCR
/end CHARACTERISTIC
/begin CHARACTERISTIC InjSys_P1V4I3_HP.facWghtColdWrm_M "injection packet 1 in variant 4 / ." MAP 0x8055D5F6 RB_Map_S16S16_U8 0.9961 fak_ub_b1 0.00 0.9961
 /begin AXIS_DESCR STD_AXIS InjSys_tEng Temp_Cels 6 -3549.940 3003.560 FORMAT "%8.3" DEPOSIT ABSOLUTE /end AXIS_DESCR
 /begin AXIS_DESCR STD_AXIS InjSys_tOilLocSp Temp_Cels 4 -3549.940 3003.560 FORMAT "%8.3" DEPOSIT ABSOLUTE /end AXIS_DESCR
/end CHARACTERISTIC
/begin CHARACTERISTIC InjSys_P1V4I3_HP.facWghtTHsp_M "injection packet 1 in variant 4 / weighting factor base angle in homogenous-split mode temperature dependent" MAP 0x8055D626 RB_Map_S16S16_U8 0.9961 fak_ub_b1 0.00 0.9961
 /begin AXIS_DESCR STD_AXIS InjSys_tEng Temp_Cels 6 -3549.940 3003.560 FORMAT "%8.3" DEPOSIT ABSOLUTE /end AXIS_DESCR
 /begin AXIS_DESCR STD_AXIS InjSys_tEngStrt Temp_Cels 4 -3549.940 3003.560 FORMAT "%8.3" DEPOSIT ABSOLUTE /end AXIS_DESCR
/end CHARACTERISTIC
/begin CHARACTERISTIC InjSys_P1V4I3_HP.facWhgtWrmColdHsp_GM "injection packet 1 in variant 4 / weighting factor warm-cold base angle in homogenous-split mode" MAP 0x8055D656 RB_MapGroup_U16 1.000000 fak_uw_b2 0.00 1.000000 FORMAT "%8.6" EXTENDED_LIMITS 0.00 1.999969
 /begin AXIS_DESCR COM_AXIS InjSys_tEngStrt Temp_Cels 8 -3549.940 3003.560 FORMAT "%8.3" AXIS_PTS_REF InjSys_tEngStrt08_AX /end AXIS_DESCR
 /begin AXIS_DESCR COM_AXIS InjSys_nrInjLimdLoc dez 4 0.00 65535.00 FORMAT "%8.2" AXIS_PTS_REF InjSys_nrInj04_AX /end AXIS_DESCR
/end CHARACTERISTIC
/begin CHARACTERISTIC InjSys_P1V4I3_HP.flgAxVers_C "injection packet 1 in variant 4 / condition map selection with group axis in version 2" VALUE 0x8055D696 RB_Val_Wu8 1.00000000000 B_TRUE 0.00 1.00000000000 FORMAT "%13.11" /end CHARACTERISTIC
/begin CHARACTERISTIC InjSys_P1V4I4_HP.agBasHspHiVers2_GM "injection packet 1 in variant 4 / base angle in homogenous-split mode for interpolation (version 2)" MAP 0x8055D69C RB_MapGroup_U8 382.5 kw_q1p5 0.00 382.5 FORMAT "%5.1"
 /begin AXIS_DESCR COM_AXIS Epm_nEng EngN 12 0.00 16383.50 FORMAT "%8.2" EXTENDED_LIMITS -16384.00 16383.50 AXIS_PTS_REF InjSys_nEng12HspVers2_AX /end AXIS_DESCR
 /begin AXIS_DESCR COM_AXIS InjSys_ratAirMAgSpVers2AxisInp rel_uw_q0p0234 12 0.00 1535.977 FORMAT "%8.3" AXIS_PTS_REF InjSys_ratAirM12AgSpHspVers2_AX /end AXIS_DESCR
/end CHARACTERISTIC
/begin CHARACTERISTIC InjSys_P1V4I4_HP.agBasHspHi_GM "injection packet 1 in variant 4 / base angle in homogenous-split mode for interpolation" MAP 0x8055D72C RB_MapGroup_U8 382.5 kw_q1p5 0.00 382.5 FORMAT "%5.1"
 /begin AXIS_DESCR COM_AXIS Epm_nEng EngN 12 0.00 16383.50 FORMAT "%8.2" EXTENDED_LIMITS -16384.00 16383.50 AXIS_PTS_REF InjSys_nEng12Hsp_AX /end AXIS_DESCR
 /begin AXIS_DESCR COM_AXIS InjSys_ratAirMAgSpAxisInp rel_uw_q0p0234 12 0.00 1535.977 FORMAT "%8.3" AXIS_PTS_REF InjSys_ratAirM12AgSpHsp_AX /end AXIS_DESCR
/end CHARACTERISTIC
/begin CHARACTERISTIC InjSys_P1V4I4_HP.agBasHspLoVers2_GM "injection packet 1 in variant 4 / base angle in homogenous-split mode for interpolation (version 2)" MAP 0x8055D7BC RB_MapGroup_U8 382.5 kw_q1p5 0.00 382.5 FORMAT "%5.1"
 /begin AXIS_DESCR COM_AXIS Epm_nEng EngN 12 0.00 16383.50 FORMAT "%8.2" EXTENDED_LIMITS -16384.00 16383.50 AXIS_PTS_REF InjSys_nEng12HspVers2_AX /end AXIS_DESCR
 /begin AXIS_DESCR COM_AXIS InjSys_ratAirMAgSpVers2AxisInp rel_uw_q0p0234 12 0.00 1535.977 FORMAT "%8.3" AXIS_PTS_REF InjSys_ratAirM12AgSpHspVers2_AX /end AXIS_DESCR
/end CHARACTERISTIC
/begin CHARACTERISTIC InjSys_P1V4I4_HP.agBasHspLo_GM "injection packet 1 in variant 4 / base angle in homogenous-split mode for interpolation" MAP 0x8055D84C RB_MapGroup_U8 382.5 kw_q1p5 0.00 382.5 FORMAT "%5.1"
 /begin AXIS_DESCR COM_AXIS Epm_nEng EngN 12 0.00 16383.50 FORMAT "%8.2" EXTENDED_LIMITS -16384.00 16383.50 AXIS_PTS_REF InjSys_nEng12Hsp_AX /end AXIS_DESCR
 /begin AXIS_DESCR COM_AXIS InjSys_ratAirMAgSpAxisInp rel_uw_q0p0234 12 0.00 1535.977 FORMAT "%8.3" AXIS_PTS_REF InjSys_ratAirM12AgSpHsp_AX /end AXIS_DESCR
/end CHARACTERISTIC
/begin CHARACTERISTIC InjSys_P1V4I4_HP.agBasTPistColdVers2_GM "injection packet 1 in variant 4 / base angle at cold piston temperature (version 2)" MAP 0x8055D8DC RB_MapGroup_U8 382.5 kw_q1p5 0.00 382.5 FORMAT "%5.1"
 /begin AXIS_DESCR COM_AXIS Epm_nEng EngN 12 0.00 16383.50 FORMAT "%8.2" EXTENDED_LIMITS -16384.00 16383.50 AXIS_PTS_REF InjSys_nEng12Vers2_AX /end AXIS_DESCR
 /begin AXIS_DESCR COM_AXIS InjSys_ratAirMAgSpVers2AxisInp rel_uw_q0p0234 12 0.00 1535.977 FORMAT "%8.3" AXIS_PTS_REF InjSys_ratAirM12AgSpVers2_AX /end AXIS_DESCR
/end CHARACTERISTIC
/begin CHARACTERISTIC InjSys_P1V4I4_HP.agBasTPistCold_GM "injection packet 1 in variant 4 / base angle at cold piston temperature" MAP 0x8055D96C RB_MapGroup_U8 382.5 kw_q1p5 0.00 382.5 FORMAT "%5.1"
 /begin AXIS_DESCR COM_AXIS Epm_nEng EngN 12 0.00 16383.50 FORMAT "%8.2" EXTENDED_LIMITS -16384.00 16383.50 AXIS_PTS_REF InjSys_nEng12_AX /end AXIS_DESCR
 /begin AXIS_DESCR COM_AXIS InjSys_ratAirMAgSpAxisInp rel_uw_q0p0234 12 0.00 1535.977 FORMAT "%8.3" AXIS_PTS_REF InjSys_ratAirM12AgSp_AX /end AXIS_DESCR
/end CHARACTERISTIC
/begin CHARACTERISTIC InjSys_P1V4I4_HP.agBasTPistWrmVers2_GM "injection packet 1 in variant 4 / base angle for interpolation Warm TSA mode (Version 2)" MAP 0x8055D9FC RB_MapGroup_U8 382.5 kw_q1p5 0.00 382.5 FORMAT "%5.1"
 /begin AXIS_DESCR COM_AXIS Epm_nEng EngN 12 0.00 16383.50 FORMAT "%8.2" EXTENDED_LIMITS -16384.00 16383.50 AXIS_PTS_REF InjSys_nEng12Vers2_AX /end AXIS_DESCR
 /begin AXIS_DESCR COM_AXIS InjSys_ratAirMAgSpVers2AxisInp rel_uw_q0p0234 12 0.00 1535.977 FORMAT "%8.3" AXIS_PTS_REF InjSys_ratAirM12AgSpVers2_AX /end AXIS_DESCR
/end CHARACTERISTIC
/begin CHARACTERISTIC InjSys_P1V4I4_HP.agBasTPistWrm_GM "injection packet 1 in variant 4 / base angle for interpolation Warm TSA mode" MAP 0x8055DA8C RB_MapGroup_U8 382.5 kw_q1p5 0.00 382.5 FORMAT "%5.1"
 /begin AXIS_DESCR COM_AXIS Epm_nEng EngN 12 0.00 16383.50 FORMAT "%8.2" EXTENDED_LIMITS -16384.00 16383.50 AXIS_PTS_REF InjSys_nEng12_AX /end AXIS_DESCR
 /begin AXIS_DESCR COM_AXIS InjSys_ratAirMAgSpAxisInp rel_uw_q0p0234 12 0.00 1535.977 FORMAT "%8.3" AXIS_PTS_REF InjSys_ratAirM12AgSp_AX /end AXIS_DESCR
/end CHARACTERISTIC
/begin CHARACTERISTIC InjSys_P1V4I4_HP.agBgnColdExtdEthnl_GM "injection packet 1 in variant 4 / ." MAP 0x8055DB1C RB_MapGroup_U8 382.5 kw_q1p5 0.00 382.5 FORMAT "%5.1"
 /begin AXIS_DESCR COM_AXIS Epm_nEng EngN 12 0.00 16383.50 FORMAT "%8.2" EXTENDED_LIMITS -16384.00 16383.50 AXIS_PTS_REF InjSys_nEng12Hpx_AX /end AXIS_DESCR
 /begin AXIS_DESCR COM_AXIS InjSys_ratAirMAxisInp rel_uw_q0p0234 12 0.00 1535.977 FORMAT "%8.3" AXIS_PTS_REF InjSys_ratAirM12Hpx_AX /end AXIS_DESCR
/end CHARACTERISTIC
/begin CHARACTERISTIC InjSys_P1V4I4_HP.agBgnColdExtd_GM "injection packet 1 in variant 4 / ." MAP 0x8055DBAC RB_MapGroup_U8 382.5 kw_q1p5 0.00 382.5 FORMAT "%5.1"
 /begin AXIS_DESCR COM_AXIS Epm_nEng EngN 12 0.00 16383.50 FORMAT "%8.2" EXTENDED_LIMITS -16384.00 16383.50 AXIS_PTS_REF InjSys_nEng12Hpx_AX /end AXIS_DESCR
 /begin AXIS_DESCR COM_AXIS InjSys_ratAirMAxisInp rel_uw_q0p0234 12 0.00 1535.977 FORMAT "%8.3" AXIS_PTS_REF InjSys_ratAirM12Hpx_AX /end AXIS_DESCR
/end CHARACTERISTIC
/begin CHARACTERISTIC InjSys_P1V4I4_HP.agBgnColdSmlVlvEthnl_GM "injection packet 1 in variant 4 / ." MAP 0x8055DC3C RB_MapGroup_U8 382.5 kw_q1p5 0.00 382.5 FORMAT "%5.1"
 /begin AXIS_DESCR COM_AXIS Epm_nEng EngN 12 0.00 16383.50 FORMAT "%8.2" EXTENDED_LIMITS -16384.00 16383.50 AXIS_PTS_REF InjSys_nEng12Hpx_AX /end AXIS_DESCR
 /begin AXIS_DESCR COM_AXIS InjSys_ratAirMAxisInp rel_uw_q0p0234 12 0.00 1535.977 FORMAT "%8.3" AXIS_PTS_REF InjSys_ratAirM12Hpx_AX /end AXIS_DESCR
/end CHARACTERISTIC
/begin CHARACTERISTIC InjSys_P1V4I4_HP.agBgnColdSmlVlv_GM "injection packet 1 in variant 4 / ." MAP 0x8055DCCC RB_MapGroup_U8 382.5 kw_q1p5 0.00 382.5 FORMAT "%5.1"
 /begin AXIS_DESCR COM_AXIS Epm_nEng EngN 12 0.00 16383.50 FORMAT "%8.2" EXTENDED_LIMITS -16384.00 16383.50 AXIS_PTS_REF InjSys_nEng12Hpx_AX /end AXIS_DESCR
 /begin AXIS_DESCR COM_AXIS InjSys_ratAirMAxisInp rel_uw_q0p0234 12 0.00 1535.977 FORMAT "%8.3" AXIS_PTS_REF InjSys_ratAirM12Hpx_AX /end AXIS_DESCR
/end CHARACTERISTIC
/begin CHARACTERISTIC InjSys_P1V4I4_HP.agBgnWrmExtdEthnl_GM "injection packet 1 in variant 4 / ." MAP 0x8055DD5C RB_MapGroup_U8 382.5 kw_q1p5 0.00 382.5 FORMAT "%5.1"
 /begin AXIS_DESCR COM_AXIS Epm_nEng EngN 12 0.00 16383.50 FORMAT "%8.2" EXTENDED_LIMITS -16384.00 16383.50 AXIS_PTS_REF InjSys_nEng12Hpx_AX /end AXIS_DESCR
 /begin AXIS_DESCR COM_AXIS InjSys_ratAirMAxisInp rel_uw_q0p0234 12 0.00 1535.977 FORMAT "%8.3" AXIS_PTS_REF InjSys_ratAirM12Hpx_AX /end AXIS_DESCR
/end CHARACTERISTIC
/begin CHARACTERISTIC InjSys_P1V4I4_HP.agBgnWrmExtd_GM "injection packet 1 in variant 4 / ." MAP 0x8055DDEC RB_MapGroup_U8 382.5 kw_q1p5 0.00 382.5 FORMAT "%5.1"
 /begin AXIS_DESCR COM_AXIS Epm_nEng EngN 12 0.00 16383.50 FORMAT "%8.2" EXTENDED_LIMITS -16384.00 16383.50 AXIS_PTS_REF InjSys_nEng12Hpx_AX /end AXIS_DESCR
 /begin AXIS_DESCR COM_AXIS InjSys_ratAirMAxisInp rel_uw_q0p0234 12 0.00 1535.977 FORMAT "%8.3" AXIS_PTS_REF InjSys_ratAirM12Hpx_AX /end AXIS_DESCR
/end CHARACTERISTIC
/begin CHARACTERISTIC InjSys_P1V4I4_HP.agBgnWrmSmlVlvEthnl_GM "injection packet 1 in variant 4 / ." MAP 0x8055DE7C RB_MapGroup_U8 382.5 kw_q1p5 0.00 382.5 FORMAT "%5.1"
 /begin AXIS_DESCR COM_AXIS Epm_nEng EngN 12 0.00 16383.50 FORMAT "%8.2" EXTENDED_LIMITS -16384.00 16383.50 AXIS_PTS_REF InjSys_nEng12Hpx_AX /end AXIS_DESCR
 /begin AXIS_DESCR COM_AXIS InjSys_ratAirMAxisInp rel_uw_q0p0234 12 0.00 1535.977 FORMAT "%8.3" AXIS_PTS_REF InjSys_ratAirM12Hpx_AX /end AXIS_DESCR
/end CHARACTERISTIC
/begin CHARACTERISTIC InjSys_P1V4I4_HP.agBgnWrmSmlVlv_GM "injection packet 1 in variant 4 / ." MAP 0x8055DF0C RB_MapGroup_U8 382.5 kw_q1p5 0.00 382.5 FORMAT "%5.1"
 /begin AXIS_DESCR COM_AXIS Epm_nEng EngN 12 0.00 16383.50 FORMAT "%8.2" EXTENDED_LIMITS -16384.00 16383.50 AXIS_PTS_REF InjSys_nEng12Hpx_AX /end AXIS_DESCR
 /begin AXIS_DESCR COM_AXIS InjSys_ratAirMAxisInp rel_uw_q0p0234 12 0.00 1535.977 FORMAT "%8.3" AXIS_PTS_REF InjSys_ratAirM12Hpx_AX /end AXIS_DESCR
/end CHARACTERISTIC
/begin CHARACTERISTIC InjSys_P1V4I4_HP.agDeltaEth_M "injection packet 1 in variant 4 / delta angle ethanol dependent" MAP 0x8055DF9C RB_Map_S16S16_S16 191.2500 kw_q0p75 -96.00000 95.25000 FORMAT "%8.5" EXTENDED_LIMITS -24576.00 24575.25
 /begin AXIS_DESCR STD_AXIS InjSys_facEthLnrLocSp fak_ub_b2 4 0.00 1.992188 FORMAT "%8.6" EXTENDED_LIMITS -256.0000 255.9922 DEPOSIT ABSOLUTE /end AXIS_DESCR
 /begin AXIS_DESCR STD_AXIS InjSys_tEng Temp_Cels 4 -3549.940 3003.560 FORMAT "%8.3" DEPOSIT ABSOLUTE /end AXIS_DESCR
/end CHARACTERISTIC
/begin CHARACTERISTIC InjSys_P1V4I4_HP.agDeltaLam_M "injection packet 1 in variant 4 / ." MAP 0x8055DFD0 RB_Map_S16U16_S16 191.2500 kw_q0p75 -96.00000 95.25000 FORMAT "%8.5" EXTENDED_LIMITS -24576.00 24575.25
 /begin AXIS_DESCR STD_AXIS Epm_nEng EngN 10 -16384.00 16383.50 FORMAT "%8.2" DEPOSIT ABSOLUTE /end AXIS_DESCR
 /begin AXIS_DESCR STD_AXIS InjSys_ratAirMPredLocSp kw_q0p0234 8 0.00 1535.977 FORMAT "%8.3" DEPOSIT ABSOLUTE /end AXIS_DESCR
/end CHARACTERISTIC
/begin CHARACTERISTIC InjSys_P1V4I4_HP.facAgBgnLam_T "injection packet 1 in variant 4 / ." CURVE 0x8055E098 RB_Curve_U8_U8 0.9961 fak_ub_b1 0.00 0.9961
 /begin AXIS_DESCR STD_AXIS InjSys_facLamBasLocSp fak_ub_b2 8 0.00 1.992188 FORMAT "%8.6" DEPOSIT ABSOLUTE /end AXIS_DESCR
/end CHARACTERISTIC
/begin CHARACTERISTIC InjSys_P1V4I4_HP.facEthnlAgBgn_T "injection packet 1 in variant 4 / ." CURVE 0x8055E0A9 RB_Curve_U8_U8 0.9961 fak_ub_b1 0.00 0.9961
 /begin AXIS_DESCR STD_AXIS fethstoeLocSp fak_ub_b2 4 0.00 1.992188 FORMAT "%8.6" DEPOSIT ABSOLUTE /end AXIS_DESCR
/end CHARACTERISTIC
/begin CHARACTERISTIC InjSys_P1V4I4_HP.facTPistCold_M "injection packet 1 in variant 4 / delta angle ethanol dependent" MAP 0x8055E0B2 RB_Map_S16S16_U8 0.9961 fak_ub_b1 0.00 0.9961
 /begin AXIS_DESCR STD_AXIS InjSys_tEng Temp_Cels 8 -3549.940 3003.560 FORMAT "%8.3" DEPOSIT ABSOLUTE /end AXIS_DESCR
 /begin AXIS_DESCR STD_AXIS InjSys_tOilLocSp Temp_Cels 8 -3549.940 3003.560 FORMAT "%8.3" DEPOSIT ABSOLUTE /end AXIS_DESCR
/end CHARACTERISTIC
/begin CHARACTERISTIC InjSys_P1V4I4_HP.facTPist_M "injection packet 1 in variant 4 / weighting factor base angle in homogenous-split mode temperature dependent" MAP 0x8055E116 RB_Map_S16S16_U8 0.9961 fak_ub_b1 0.00 0.9961
 /begin AXIS_DESCR STD_AXIS InjSys_tPistBas Temp_Cels 6 -3549.940 3003.560 FORMAT "%8.3" DEPOSIT ABSOLUTE /end AXIS_DESCR
 /begin AXIS_DESCR STD_AXIS InjSys_tPistDelta temp_q0p1 6 -3276.800 3276.700 FORMAT "%8.3" DEPOSIT ABSOLUTE /end AXIS_DESCR
/end CHARACTERISTIC
/begin CHARACTERISTIC InjSys_P1V4I4_HP.facWghtColdWrmEthnl_M "injection packet 1 in variant 4 / ." MAP 0x8055E156 RB_Map_S16S16_U8 0.9961 fak_ub_b1 0.00 0.9961
 /begin AXIS_DESCR STD_AXIS InjSys_tEng Temp_Cels 6 -3549.940 3003.560 FORMAT "%8.3" DEPOSIT ABSOLUTE /end AXIS_DESCR
 /begin AXIS_DESCR STD_AXIS InjSys_tOilLocSp Temp_Cels 4 -3549.940 3003.560 FORMAT "%8.3" DEPOSIT ABSOLUTE /end AXIS_DESCR
/end CHARACTERISTIC
/begin CHARACTERISTIC InjSys_P1V4I4_HP.facWghtColdWrm_M "injection packet 1 in variant 4 / ." MAP 0x8055E186 RB_Map_S16S16_U8 0.9961 fak_ub_b1 0.00 0.9961
 /begin AXIS_DESCR STD_AXIS InjSys_tEng Temp_Cels 6 -3549.940 3003.560 FORMAT "%8.3" DEPOSIT ABSOLUTE /end AXIS_DESCR
 /begin AXIS_DESCR STD_AXIS InjSys_tOilLocSp Temp_Cels 4 -3549.940 3003.560 FORMAT "%8.3" DEPOSIT ABSOLUTE /end AXIS_DESCR
/end CHARACTERISTIC
/begin CHARACTERISTIC InjSys_P1V4I4_HP.facWghtTHsp_M "injection packet 1 in variant 4 / weighting factor base angle in homogenous-split mode temperature dependent" MAP 0x8055E1B6 RB_Map_S16S16_U8 0.9961 fak_ub_b1 0.00 0.9961
 /begin AXIS_DESCR STD_AXIS InjSys_tEng Temp_Cels 6 -3549.940 3003.560 FORMAT "%8.3" DEPOSIT ABSOLUTE /end AXIS_DESCR
 /begin AXIS_DESCR STD_AXIS InjSys_tEngStrt Temp_Cels 4 -3549.940 3003.560 FORMAT "%8.3" DEPOSIT ABSOLUTE /end AXIS_DESCR
/end CHARACTERISTIC
/begin CHARACTERISTIC InjSys_P1V4I4_HP.facWhgtWrmColdHsp_GM "injection packet 1 in variant 4 / weighting factor warm-cold base angle in homogenous-split mode" MAP 0x8055E1E6 RB_MapGroup_U16 1.000000 fak_uw_b2 0.00 1.000000 FORMAT "%8.6" EXTENDED_LIMITS 0.00 1.999969
 /begin AXIS_DESCR COM_AXIS InjSys_tEngStrt Temp_Cels 8 -3549.940 3003.560 FORMAT "%8.3" AXIS_PTS_REF InjSys_tEngStrt08_AX /end AXIS_DESCR
 /begin AXIS_DESCR COM_AXIS InjSys_nrInjLimdLoc dez 4 0.00 65535.00 FORMAT "%8.2" AXIS_PTS_REF InjSys_nrInj04_AX /end AXIS_DESCR
/end CHARACTERISTIC
/begin CHARACTERISTIC InjSys_P1V4I4_HP.flgAxVers_C "injection packet 1 in variant 4 / condition map selection with group axis in version 2" VALUE 0x8055E226 RB_Val_Wu8 1.00000000000 B_TRUE 0.00 1.00000000000 FORMAT "%13.11" /end CHARACTERISTIC
/begin CHARACTERISTIC InjSys_P1V4I5_HP.agBasHspHiVers2_GM "injection packet 1 in variant 4 / base angle in homogenous-split mode for interpolation (version 2)" MAP 0x8055E22C RB_MapGroup_U8 382.5 kw_q1p5 0.00 382.5 FORMAT "%5.1"
 /begin AXIS_DESCR COM_AXIS Epm_nEng EngN 12 0.00 16383.50 FORMAT "%8.2" EXTENDED_LIMITS -16384.00 16383.50 AXIS_PTS_REF InjSys_nEng12HspVers2_AX /end AXIS_DESCR
 /begin AXIS_DESCR COM_AXIS InjSys_ratAirMAgSpVers2AxisInp rel_uw_q0p0234 12 0.00 1535.977 FORMAT "%8.3" AXIS_PTS_REF InjSys_ratAirM12AgSpHspVers2_AX /end AXIS_DESCR
/end CHARACTERISTIC
/begin CHARACTERISTIC InjSys_P1V4I5_HP.agBasHspHi_GM "injection packet 1 in variant 4 / base angle in homogenous-split mode for interpolation" MAP 0x8055E2BC RB_MapGroup_U8 382.5 kw_q1p5 0.00 382.5 FORMAT "%5.1"
 /begin AXIS_DESCR COM_AXIS Epm_nEng EngN 12 0.00 16383.50 FORMAT "%8.2" EXTENDED_LIMITS -16384.00 16383.50 AXIS_PTS_REF InjSys_nEng12Hsp_AX /end AXIS_DESCR
 /begin AXIS_DESCR COM_AXIS InjSys_ratAirMAgSpAxisInp rel_uw_q0p0234 12 0.00 1535.977 FORMAT "%8.3" AXIS_PTS_REF InjSys_ratAirM12AgSpHsp_AX /end AXIS_DESCR
/end CHARACTERISTIC
/begin CHARACTERISTIC InjSys_P1V4I5_HP.agBasHspLoVers2_GM "injection packet 1 in variant 4 / base angle in homogenous-split mode for interpolation (version 2)" MAP 0x8055E34C RB_MapGroup_U8 382.5 kw_q1p5 0.00 382.5 FORMAT "%5.1"
 /begin AXIS_DESCR COM_AXIS Epm_nEng EngN 12 0.00 16383.50 FORMAT "%8.2" EXTENDED_LIMITS -16384.00 16383.50 AXIS_PTS_REF InjSys_nEng12HspVers2_AX /end AXIS_DESCR
 /begin AXIS_DESCR COM_AXIS InjSys_ratAirMAgSpVers2AxisInp rel_uw_q0p0234 12 0.00 1535.977 FORMAT "%8.3" AXIS_PTS_REF InjSys_ratAirM12AgSpHspVers2_AX /end AXIS_DESCR
/end CHARACTERISTIC
/begin CHARACTERISTIC InjSys_P1V4I5_HP.agBasHspLo_GM "injection packet 1 in variant 4 / base angle in homogenous-split mode for interpolation" MAP 0x8055E3DC RB_MapGroup_U8 382.5 kw_q1p5 0.00 382.5 FORMAT "%5.1"
 /begin AXIS_DESCR COM_AXIS Epm_nEng EngN 12 0.00 16383.50 FORMAT "%8.2" EXTENDED_LIMITS -16384.00 16383.50 AXIS_PTS_REF InjSys_nEng12Hsp_AX /end AXIS_DESCR
 /begin AXIS_DESCR COM_AXIS InjSys_ratAirMAgSpAxisInp rel_uw_q0p0234 12 0.00 1535.977 FORMAT "%8.3" AXIS_PTS_REF InjSys_ratAirM12AgSpHsp_AX /end AXIS_DESCR
/end CHARACTERISTIC
/begin CHARACTERISTIC InjSys_P1V4I5_HP.agBasTPistColdVers2_GM "injection packet 1 in variant 4 / base angle at cold piston temperature (version 2)" MAP 0x8055E46C RB_MapGroup_U8 382.5 kw_q1p5 0.00 382.5 FORMAT "%5.1"
 /begin AXIS_DESCR COM_AXIS Epm_nEng EngN 12 0.00 16383.50 FORMAT "%8.2" EXTENDED_LIMITS -16384.00 16383.50 AXIS_PTS_REF InjSys_nEng12Vers2_AX /end AXIS_DESCR
 /begin AXIS_DESCR COM_AXIS InjSys_ratAirMAgSpVers2AxisInp rel_uw_q0p0234 12 0.00 1535.977 FORMAT "%8.3" AXIS_PTS_REF InjSys_ratAirM12AgSpVers2_AX /end AXIS_DESCR
/end CHARACTERISTIC
/begin CHARACTERISTIC InjSys_P1V4I5_HP.agBasTPistCold_GM "injection packet 1 in variant 4 / base angle at cold piston temperature" MAP 0x8055E4FC RB_MapGroup_U8 382.5 kw_q1p5 0.00 382.5 FORMAT "%5.1"
 /begin AXIS_DESCR COM_AXIS Epm_nEng EngN 12 0.00 16383.50 FORMAT "%8.2" EXTENDED_LIMITS -16384.00 16383.50 AXIS_PTS_REF InjSys_nEng12_AX /end AXIS_DESCR
 /begin AXIS_DESCR COM_AXIS InjSys_ratAirMAgSpAxisInp rel_uw_q0p0234 12 0.00 1535.977 FORMAT "%8.3" AXIS_PTS_REF InjSys_ratAirM12AgSp_AX /end AXIS_DESCR
/end CHARACTERISTIC
/begin CHARACTERISTIC InjSys_P1V4I5_HP.agBasTPistWrmVers2_GM "injection packet 1 in variant 4 / base angle for interpolation Warm TSA mode (Version 2)" MAP 0x8055E58C RB_MapGroup_U8 382.5 kw_q1p5 0.00 382.5 FORMAT "%5.1"
 /begin AXIS_DESCR COM_AXIS Epm_nEng EngN 12 0.00 16383.50 FORMAT "%8.2" EXTENDED_LIMITS -16384.00 16383.50 AXIS_PTS_REF InjSys_nEng12Vers2_AX /end AXIS_DESCR
 /begin AXIS_DESCR COM_AXIS InjSys_ratAirMAgSpVers2AxisInp rel_uw_q0p0234 12 0.00 1535.977 FORMAT "%8.3" AXIS_PTS_REF InjSys_ratAirM12AgSpVers2_AX /end AXIS_DESCR
/end CHARACTERISTIC
/begin CHARACTERISTIC InjSys_P1V4I5_HP.agBasTPistWrm_GM "injection packet 1 in variant 4 / base angle for interpolation Warm TSA mode" MAP 0x8055E61C RB_MapGroup_U8 382.5 kw_q1p5 0.00 382.5 FORMAT "%5.1"
 /begin AXIS_DESCR COM_AXIS Epm_nEng EngN 12 0.00 16383.50 FORMAT "%8.2" EXTENDED_LIMITS -16384.00 16383.50 AXIS_PTS_REF InjSys_nEng12_AX /end AXIS_DESCR
 /begin AXIS_DESCR COM_AXIS InjSys_ratAirMAgSpAxisInp rel_uw_q0p0234 12 0.00 1535.977 FORMAT "%8.3" AXIS_PTS_REF InjSys_ratAirM12AgSp_AX /end AXIS_DESCR
/end CHARACTERISTIC
/begin CHARACTERISTIC InjSys_P1V4I5_HP.agBgnColdExtdEthnl_GM "injection packet 1 in variant 4 / ." MAP 0x8055E6AC RB_MapGroup_U8 382.5 kw_q1p5 0.00 382.5 FORMAT "%5.1"
 /begin AXIS_DESCR COM_AXIS Epm_nEng EngN 12 0.00 16383.50 FORMAT "%8.2" EXTENDED_LIMITS -16384.00 16383.50 AXIS_PTS_REF InjSys_nEng12Hpx_AX /end AXIS_DESCR
 /begin AXIS_DESCR COM_AXIS InjSys_ratAirMAxisInp rel_uw_q0p0234 12 0.00 1535.977 FORMAT "%8.3" AXIS_PTS_REF InjSys_ratAirM12Hpx_AX /end AXIS_DESCR
/end CHARACTERISTIC
/begin CHARACTERISTIC InjSys_P1V4I5_HP.agBgnColdExtd_GM "injection packet 1 in variant 4 / ." MAP 0x8055E73C RB_MapGroup_U8 382.5 kw_q1p5 0.00 382.5 FORMAT "%5.1"
 /begin AXIS_DESCR COM_AXIS Epm_nEng EngN 12 0.00 16383.50 FORMAT "%8.2" EXTENDED_LIMITS -16384.00 16383.50 AXIS_PTS_REF InjSys_nEng12Hpx_AX /end AXIS_DESCR
 /begin AXIS_DESCR COM_AXIS InjSys_ratAirMAxisInp rel_uw_q0p0234 12 0.00 1535.977 FORMAT "%8.3" AXIS_PTS_REF InjSys_ratAirM12Hpx_AX /end AXIS_DESCR
/end CHARACTERISTIC
/begin CHARACTERISTIC InjSys_P1V4I5_HP.agBgnColdSmlVlvEthnl_GM "injection packet 1 in variant 4 / ." MAP 0x8055E7CC RB_MapGroup_U8 382.5 kw_q1p5 0.00 382.5 FORMAT "%5.1"
 /begin AXIS_DESCR COM_AXIS Epm_nEng EngN 12 0.00 16383.50 FORMAT "%8.2" EXTENDED_LIMITS -16384.00 16383.50 AXIS_PTS_REF InjSys_nEng12Hpx_AX /end AXIS_DESCR
 /begin AXIS_DESCR COM_AXIS InjSys_ratAirMAxisInp rel_uw_q0p0234 12 0.00 1535.977 FORMAT "%8.3" AXIS_PTS_REF InjSys_ratAirM12Hpx_AX /end AXIS_DESCR
/end CHARACTERISTIC
/begin CHARACTERISTIC InjSys_P1V4I5_HP.agBgnColdSmlVlv_GM "injection packet 1 in variant 4 / ." MAP 0x8055E85C RB_MapGroup_U8 382.5 kw_q1p5 0.00 382.5 FORMAT "%5.1"
 /begin AXIS_DESCR COM_AXIS Epm_nEng EngN 12 0.00 16383.50 FORMAT "%8.2" EXTENDED_LIMITS -16384.00 16383.50 AXIS_PTS_REF InjSys_nEng12Hpx_AX /end AXIS_DESCR
 /begin AXIS_DESCR COM_AXIS InjSys_ratAirMAxisInp rel_uw_q0p0234 12 0.00 1535.977 FORMAT "%8.3" AXIS_PTS_REF InjSys_ratAirM12Hpx_AX /end AXIS_DESCR
/end CHARACTERISTIC
/begin CHARACTERISTIC InjSys_P1V4I5_HP.agBgnWrmExtdEthnl_GM "injection packet 1 in variant 4 / ." MAP 0x8055E8EC RB_MapGroup_U8 382.5 kw_q1p5 0.00 382.5 FORMAT "%5.1"
 /begin AXIS_DESCR COM_AXIS Epm_nEng EngN 12 0.00 16383.50 FORMAT "%8.2" EXTENDED_LIMITS -16384.00 16383.50 AXIS_PTS_REF InjSys_nEng12Hpx_AX /end AXIS_DESCR
 /begin AXIS_DESCR COM_AXIS InjSys_ratAirMAxisInp rel_uw_q0p0234 12 0.00 1535.977 FORMAT "%8.3" AXIS_PTS_REF InjSys_ratAirM12Hpx_AX /end AXIS_DESCR
/end CHARACTERISTIC
/begin CHARACTERISTIC InjSys_P1V4I5_HP.agBgnWrmExtd_GM "injection packet 1 in variant 4 / ." MAP 0x8055E97C RB_MapGroup_U8 382.5 kw_q1p5 0.00 382.5 FORMAT "%5.1"
 /begin AXIS_DESCR COM_AXIS Epm_nEng EngN 12 0.00 16383.50 FORMAT "%8.2" EXTENDED_LIMITS -16384.00 16383.50 AXIS_PTS_REF InjSys_nEng12Hpx_AX /end AXIS_DESCR
 /begin AXIS_DESCR COM_AXIS InjSys_ratAirMAxisInp rel_uw_q0p0234 12 0.00 1535.977 FORMAT "%8.3" AXIS_PTS_REF InjSys_ratAirM12Hpx_AX /end AXIS_DESCR
/end CHARACTERISTIC
/begin CHARACTERISTIC InjSys_P1V4I5_HP.agBgnWrmSmlVlvEthnl_GM "injection packet 1 in variant 4 / ." MAP 0x8055EA0C RB_MapGroup_U8 382.5 kw_q1p5 0.00 382.5 FORMAT "%5.1"
 /begin AXIS_DESCR COM_AXIS Epm_nEng EngN 12 0.00 16383.50 FORMAT "%8.2" EXTENDED_LIMITS -16384.00 16383.50 AXIS_PTS_REF InjSys_nEng12Hpx_AX /end AXIS_DESCR
 /begin AXIS_DESCR COM_AXIS InjSys_ratAirMAxisInp rel_uw_q0p0234 12 0.00 1535.977 FORMAT "%8.3" AXIS_PTS_REF InjSys_ratAirM12Hpx_AX /end AXIS_DESCR
/end CHARACTERISTIC
/begin CHARACTERISTIC InjSys_P1V4I5_HP.agBgnWrmSmlVlv_GM "injection packet 1 in variant 4 / ." MAP 0x8055EA9C RB_MapGroup_U8 382.5 kw_q1p5 0.00 382.5 FORMAT "%5.1"
 /begin AXIS_DESCR COM_AXIS Epm_nEng EngN 12 0.00 16383.50 FORMAT "%8.2" EXTENDED_LIMITS -16384.00 16383.50 AXIS_PTS_REF InjSys_nEng12Hpx_AX /end AXIS_DESCR
 /begin AXIS_DESCR COM_AXIS InjSys_ratAirMAxisInp rel_uw_q0p0234 12 0.00 1535.977 FORMAT "%8.3" AXIS_PTS_REF InjSys_ratAirM12Hpx_AX /end AXIS_DESCR
/end CHARACTERISTIC
/begin CHARACTERISTIC InjSys_P1V4I5_HP.agDeltaEth_M "injection packet 1 in variant 4 / delta angle ethanol dependent" MAP 0x8055EB2C RB_Map_S16S16_S16 191.2500 kw_q0p75 -96.00000 95.25000 FORMAT "%8.5" EXTENDED_LIMITS -24576.00 24575.25
 /begin AXIS_DESCR STD_AXIS InjSys_facEthLnrLocSp fak_ub_b2 4 0.00 1.992188 FORMAT "%8.6" EXTENDED_LIMITS -256.0000 255.9922 DEPOSIT ABSOLUTE /end AXIS_DESCR
 /begin AXIS_DESCR STD_AXIS InjSys_tEng Temp_Cels 4 -3549.940 3003.560 FORMAT "%8.3" DEPOSIT ABSOLUTE /end AXIS_DESCR
/end CHARACTERISTIC
/begin CHARACTERISTIC InjSys_P1V4I5_HP.agDeltaLam_M "injection packet 1 in variant 4 / ." MAP 0x8055EB60 RB_Map_S16U16_S16 191.2500 kw_q0p75 -96.00000 95.25000 FORMAT "%8.5" EXTENDED_LIMITS -24576.00 24575.25
 /begin AXIS_DESCR STD_AXIS Epm_nEng EngN 10 -16384.00 16383.50 FORMAT "%8.2" DEPOSIT ABSOLUTE /end AXIS_DESCR
 /begin AXIS_DESCR STD_AXIS InjSys_ratAirMPredLocSp kw_q0p0234 8 0.00 1535.977 FORMAT "%8.3" DEPOSIT ABSOLUTE /end AXIS_DESCR
/end CHARACTERISTIC
/begin CHARACTERISTIC InjSys_P1V4I5_HP.facAgBgnLam_T "injection packet 1 in variant 4 / ." CURVE 0x8055EC28 RB_Curve_U8_U8 0.9961 fak_ub_b1 0.00 0.9961
 /begin AXIS_DESCR STD_AXIS InjSys_facLamBasLocSp fak_ub_b2 8 0.00 1.992188 FORMAT "%8.6" DEPOSIT ABSOLUTE /end AXIS_DESCR
/end CHARACTERISTIC
/begin CHARACTERISTIC InjSys_P1V4I5_HP.facEthnlAgBgn_T "injection packet 1 in variant 4 / ." CURVE 0x8055EC39 RB_Curve_U8_U8 0.9961 fak_ub_b1 0.00 0.9961
 /begin AXIS_DESCR STD_AXIS fethstoeLocSp fak_ub_b2 4 0.00 1.992188 FORMAT "%8.6" DEPOSIT ABSOLUTE /end AXIS_DESCR
/end CHARACTERISTIC
/begin CHARACTERISTIC InjSys_P1V4I5_HP.facTPistCold_M "injection packet 1 in variant 4 / delta angle ethanol dependent" MAP 0x8055EC42 RB_Map_S16S16_U8 0.9961 fak_ub_b1 0.00 0.9961
 /begin AXIS_DESCR STD_AXIS InjSys_tEng Temp_Cels 8 -3549.940 3003.560 FORMAT "%8.3" DEPOSIT ABSOLUTE /end AXIS_DESCR
 /begin AXIS_DESCR STD_AXIS InjSys_tOilLocSp Temp_Cels 8 -3549.940 3003.560 FORMAT "%8.3" DEPOSIT ABSOLUTE /end AXIS_DESCR
/end CHARACTERISTIC
/begin CHARACTERISTIC InjSys_P1V4I5_HP.facTPist_M "injection packet 1 in variant 4 / weighting factor base angle in homogenous-split mode temperature dependent" MAP 0x8055ECA6 RB_Map_S16S16_U8 0.9961 fak_ub_b1 0.00 0.9961
 /begin AXIS_DESCR STD_AXIS InjSys_tPistBas Temp_Cels 6 -3549.940 3003.560 FORMAT "%8.3" DEPOSIT ABSOLUTE /end AXIS_DESCR
 /begin AXIS_DESCR STD_AXIS InjSys_tPistDelta temp_q0p1 6 -3276.800 3276.700 FORMAT "%8.3" DEPOSIT ABSOLUTE /end AXIS_DESCR
/end CHARACTERISTIC
/begin CHARACTERISTIC InjSys_P1V4I5_HP.facWghtColdWrmEthnl_M "injection packet 1 in variant 4 / ." MAP 0x8055ECE6 RB_Map_S16S16_U8 0.9961 fak_ub_b1 0.00 0.9961
 /begin AXIS_DESCR STD_AXIS InjSys_tEng Temp_Cels 6 -3549.940 3003.560 FORMAT "%8.3" DEPOSIT ABSOLUTE /end AXIS_DESCR
 /begin AXIS_DESCR STD_AXIS InjSys_tOilLocSp Temp_Cels 4 -3549.940 3003.560 FORMAT "%8.3" DEPOSIT ABSOLUTE /end AXIS_DESCR
/end CHARACTERISTIC
/begin CHARACTERISTIC InjSys_P1V4I5_HP.facWghtColdWrm_M "injection packet 1 in variant 4 / ." MAP 0x8055ED16 RB_Map_S16S16_U8 0.9961 fak_ub_b1 0.00 0.9961
 /begin AXIS_DESCR STD_AXIS InjSys_tEng Temp_Cels 6 -3549.940 3003.560 FORMAT "%8.3" DEPOSIT ABSOLUTE /end AXIS_DESCR
 /begin AXIS_DESCR STD_AXIS InjSys_tOilLocSp Temp_Cels 4 -3549.940 3003.560 FORMAT "%8.3" DEPOSIT ABSOLUTE /end AXIS_DESCR
/end CHARACTERISTIC
/begin CHARACTERISTIC InjSys_P1V4I5_HP.facWghtTHsp_M "injection packet 1 in variant 4 / weighting factor base angle in homogenous-split mode temperature dependent" MAP 0x8055ED46 RB_Map_S16S16_U8 0.9961 fak_ub_b1 0.00 0.9961
 /begin AXIS_DESCR STD_AXIS InjSys_tEng Temp_Cels 6 -3549.940 3003.560 FORMAT "%8.3" DEPOSIT ABSOLUTE /end AXIS_DESCR
 /begin AXIS_DESCR STD_AXIS InjSys_tEngStrt Temp_Cels 4 -3549.940 3003.560 FORMAT "%8.3" DEPOSIT ABSOLUTE /end AXIS_DESCR
/end CHARACTERISTIC
/begin CHARACTERISTIC InjSys_P1V4I5_HP.facWhgtWrmColdHsp_GM "injection packet 1 in variant 4 / weighting factor warm-cold base angle in homogenous-split mode" MAP 0x8055ED76 RB_MapGroup_U16 1.000000 fak_uw_b2 0.00 1.000000 FORMAT "%8.6" EXTENDED_LIMITS 0.00 1.999969
 /begin AXIS_DESCR COM_AXIS InjSys_tEngStrt Temp_Cels 8 -3549.940 3003.560 FORMAT "%8.3" AXIS_PTS_REF InjSys_tEngStrt08_AX /end AXIS_DESCR
 /begin AXIS_DESCR COM_AXIS InjSys_nrInjLimdLoc dez 4 0.00 65535.00 FORMAT "%8.2" AXIS_PTS_REF InjSys_nrInj04_AX /end AXIS_DESCR
/end CHARACTERISTIC
/begin CHARACTERISTIC InjSys_P1V4I5_HP.flgAxVers_C "injection packet 1 in variant 4 / condition map selection with group axis in version 2" VALUE 0x8055EDB6 RB_Val_Wu8 1.00000000000 B_TRUE 0.00 1.00000000000 FORMAT "%13.11" /end CHARACTERISTIC
/begin CHARACTERISTIC InjSys_P1V4I6_HP.agBasHspHiVers2_GM "injection packet 1 in variant 4 / base angle in homogenous-split mode for interpolation (version 2)" MAP 0x8055EDBC RB_MapGroup_U8 382.5 kw_q1p5 0.00 382.5 FORMAT "%5.1"
 /begin AXIS_DESCR COM_AXIS Epm_nEng EngN 12 0.00 16383.50 FORMAT "%8.2" EXTENDED_LIMITS -16384.00 16383.50 AXIS_PTS_REF InjSys_nEng12HspVers2_AX /end AXIS_DESCR
 /begin AXIS_DESCR COM_AXIS InjSys_ratAirMAgSpVers2AxisInp rel_uw_q0p0234 12 0.00 1535.977 FORMAT "%8.3" AXIS_PTS_REF InjSys_ratAirM12AgSpHspVers2_AX /end AXIS_DESCR
/end CHARACTERISTIC
/begin CHARACTERISTIC InjSys_P1V4I6_HP.agBasHspHi_GM "injection packet 1 in variant 4 / base angle in homogenous-split mode for interpolation" MAP 0x8055EE4C RB_MapGroup_U8 382.5 kw_q1p5 0.00 382.5 FORMAT "%5.1"
 /begin AXIS_DESCR COM_AXIS Epm_nEng EngN 12 0.00 16383.50 FORMAT "%8.2" EXTENDED_LIMITS -16384.00 16383.50 AXIS_PTS_REF InjSys_nEng12Hsp_AX /end AXIS_DESCR
 /begin AXIS_DESCR COM_AXIS InjSys_ratAirMAgSpAxisInp rel_uw_q0p0234 12 0.00 1535.977 FORMAT "%8.3" AXIS_PTS_REF InjSys_ratAirM12AgSpHsp_AX /end AXIS_DESCR
/end CHARACTERISTIC
/begin CHARACTERISTIC InjSys_P1V4I6_HP.agBasHspLoVers2_GM "injection packet 1 in variant 4 / base angle in homogenous-split mode for interpolation (version 2)" MAP 0x8055EEDC RB_MapGroup_U8 382.5 kw_q1p5 0.00 382.5 FORMAT "%5.1"
 /begin AXIS_DESCR COM_AXIS Epm_nEng EngN 12 0.00 16383.50 FORMAT "%8.2" EXTENDED_LIMITS -16384.00 16383.50 AXIS_PTS_REF InjSys_nEng12HspVers2_AX /end AXIS_DESCR
 /begin AXIS_DESCR COM_AXIS InjSys_ratAirMAgSpVers2AxisInp rel_uw_q0p0234 12 0.00 1535.977 FORMAT "%8.3" AXIS_PTS_REF InjSys_ratAirM12AgSpHspVers2_AX /end AXIS_DESCR
/end CHARACTERISTIC
/begin CHARACTERISTIC InjSys_P1V4I6_HP.agBasHspLo_GM "injection packet 1 in variant 4 / base angle in homogenous-split mode for interpolation" MAP 0x8055EF6C RB_MapGroup_U8 382.5 kw_q1p5 0.00 382.5 FORMAT "%5.1"
 /begin AXIS_DESCR COM_AXIS Epm_nEng EngN 12 0.00 16383.50 FORMAT "%8.2" EXTENDED_LIMITS -16384.00 16383.50 AXIS_PTS_REF InjSys_nEng12Hsp_AX /end AXIS_DESCR
 /begin AXIS_DESCR COM_AXIS InjSys_ratAirMAgSpAxisInp rel_uw_q0p0234 12 0.00 1535.977 FORMAT "%8.3" AXIS_PTS_REF InjSys_ratAirM12AgSpHsp_AX /end AXIS_DESCR
/end CHARACTERISTIC
/begin CHARACTERISTIC InjSys_P1V4I6_HP.agBasTPistColdVers2_GM "injection packet 1 in variant 4 / base angle at cold piston temperature (version 2)" MAP 0x8055EFFC RB_MapGroup_U8 382.5 kw_q1p5 0.00 382.5 FORMAT "%5.1"
 /begin AXIS_DESCR COM_AXIS Epm_nEng EngN 12 0.00 16383.50 FORMAT "%8.2" EXTENDED_LIMITS -16384.00 16383.50 AXIS_PTS_REF InjSys_nEng12Vers2_AX /end AXIS_DESCR
 /begin AXIS_DESCR COM_AXIS InjSys_ratAirMAgSpVers2AxisInp rel_uw_q0p0234 12 0.00 1535.977 FORMAT "%8.3" AXIS_PTS_REF InjSys_ratAirM12AgSpVers2_AX /end AXIS_DESCR
/end CHARACTERISTIC
/begin CHARACTERISTIC InjSys_P1V4I6_HP.agBasTPistCold_GM "injection packet 1 in variant 4 / base angle at cold piston temperature" MAP 0x8055F08C RB_MapGroup_U8 382.5 kw_q1p5 0.00 382.5 FORMAT "%5.1"
 /begin AXIS_DESCR COM_AXIS Epm_nEng EngN 12 0.00 16383.50 FORMAT "%8.2" EXTENDED_LIMITS -16384.00 16383.50 AXIS_PTS_REF InjSys_nEng12_AX /end AXIS_DESCR
 /begin AXIS_DESCR COM_AXIS InjSys_ratAirMAgSpAxisInp rel_uw_q0p0234 12 0.00 1535.977 FORMAT "%8.3" AXIS_PTS_REF InjSys_ratAirM12AgSp_AX /end AXIS_DESCR
/end CHARACTERISTIC
/begin CHARACTERISTIC InjSys_P1V4I6_HP.agBasTPistWrmVers2_GM "injection packet 1 in variant 4 / base angle for interpolation Warm TSA mode (Version 2)" MAP 0x8055F11C RB_MapGroup_U8 382.5 kw_q1p5 0.00 382.5 FORMAT "%5.1"
 /begin AXIS_DESCR COM_AXIS Epm_nEng EngN 12 0.00 16383.50 FORMAT "%8.2" EXTENDED_LIMITS -16384.00 16383.50 AXIS_PTS_REF InjSys_nEng12Vers2_AX /end AXIS_DESCR
 /begin AXIS_DESCR COM_AXIS InjSys_ratAirMAgSpVers2AxisInp rel_uw_q0p0234 12 0.00 1535.977 FORMAT "%8.3" AXIS_PTS_REF InjSys_ratAirM12AgSpVers2_AX /end AXIS_DESCR
/end CHARACTERISTIC
/begin CHARACTERISTIC InjSys_P1V4I6_HP.agBasTPistWrm_GM "injection packet 1 in variant 4 / base angle for interpolation Warm TSA mode" MAP 0x8055F1AC RB_MapGroup_U8 382.5 kw_q1p5 0.00 382.5 FORMAT "%5.1"
 /begin AXIS_DESCR COM_AXIS Epm_nEng EngN 12 0.00 16383.50 FORMAT "%8.2" EXTENDED_LIMITS -16384.00 16383.50 AXIS_PTS_REF InjSys_nEng12_AX /end AXIS_DESCR
 /begin AXIS_DESCR COM_AXIS InjSys_ratAirMAgSpAxisInp rel_uw_q0p0234 12 0.00 1535.977 FORMAT "%8.3" AXIS_PTS_REF InjSys_ratAirM12AgSp_AX /end AXIS_DESCR
/end CHARACTERISTIC
/begin CHARACTERISTIC InjSys_P1V4I6_HP.agBgnColdExtdEthnl_GM "injection packet 1 in variant 4 / ." MAP 0x8055F23C RB_MapGroup_U8 382.5 kw_q1p5 0.00 382.5 FORMAT "%5.1"
 /begin AXIS_DESCR COM_AXIS Epm_nEng EngN 12 0.00 16383.50 FORMAT "%8.2" EXTENDED_LIMITS -16384.00 16383.50 AXIS_PTS_REF InjSys_nEng12Hpx_AX /end AXIS_DESCR
 /begin AXIS_DESCR COM_AXIS InjSys_ratAirMAxisInp rel_uw_q0p0234 12 0.00 1535.977 FORMAT "%8.3" AXIS_PTS_REF InjSys_ratAirM12Hpx_AX /end AXIS_DESCR
/end CHARACTERISTIC
/begin CHARACTERISTIC InjSys_P1V4I6_HP.agBgnColdExtd_GM "injection packet 1 in variant 4 / ." MAP 0x8055F2CC RB_MapGroup_U8 382.5 kw_q1p5 0.00 382.5 FORMAT "%5.1"
 /begin AXIS_DESCR COM_AXIS Epm_nEng EngN 12 0.00 16383.50 FORMAT "%8.2" EXTENDED_LIMITS -16384.00 16383.50 AXIS_PTS_REF InjSys_nEng12Hpx_AX /end AXIS_DESCR
 /begin AXIS_DESCR COM_AXIS InjSys_ratAirMAxisInp rel_uw_q0p0234 12 0.00 1535.977 FORMAT "%8.3" AXIS_PTS_REF InjSys_ratAirM12Hpx_AX /end AXIS_DESCR
/end CHARACTERISTIC
/begin CHARACTERISTIC InjSys_P1V4I6_HP.agBgnColdSmlVlvEthnl_GM "injection packet 1 in variant 4 / ." MAP 0x8055F35C RB_MapGroup_U8 382.5 kw_q1p5 0.00 382.5 FORMAT "%5.1"
 /begin AXIS_DESCR COM_AXIS Epm_nEng EngN 12 0.00 16383.50 FORMAT "%8.2" EXTENDED_LIMITS -16384.00 16383.50 AXIS_PTS_REF InjSys_nEng12Hpx_AX /end AXIS_DESCR
 /begin AXIS_DESCR COM_AXIS InjSys_ratAirMAxisInp rel_uw_q0p0234 12 0.00 1535.977 FORMAT "%8.3" AXIS_PTS_REF InjSys_ratAirM12Hpx_AX /end AXIS_DESCR
/end CHARACTERISTIC
/begin CHARACTERISTIC InjSys_P1V4I6_HP.agBgnColdSmlVlv_GM "injection packet 1 in variant 4 / ." MAP 0x8055F3EC RB_MapGroup_U8 382.5 kw_q1p5 0.00 382.5 FORMAT "%5.1"
 /begin AXIS_DESCR COM_AXIS Epm_nEng EngN 12 0.00 16383.50 FORMAT "%8.2" EXTENDED_LIMITS -16384.00 16383.50 AXIS_PTS_REF InjSys_nEng12Hpx_AX /end AXIS_DESCR
 /begin AXIS_DESCR COM_AXIS InjSys_ratAirMAxisInp rel_uw_q0p0234 12 0.00 1535.977 FORMAT "%8.3" AXIS_PTS_REF InjSys_ratAirM12Hpx_AX /end AXIS_DESCR
/end CHARACTERISTIC
/begin CHARACTERISTIC InjSys_P1V4I6_HP.agBgnWrmExtdEthnl_GM "injection packet 1 in variant 4 / ." MAP 0x8055F47C RB_MapGroup_U8 382.5 kw_q1p5 0.00 382.5 FORMAT "%5.1"
 /begin AXIS_DESCR COM_AXIS Epm_nEng EngN 12 0.00 16383.50 FORMAT "%8.2" EXTENDED_LIMITS -16384.00 16383.50 AXIS_PTS_REF InjSys_nEng12Hpx_AX /end AXIS_DESCR
 /begin AXIS_DESCR COM_AXIS InjSys_ratAirMAxisInp rel_uw_q0p0234 12 0.00 1535.977 FORMAT "%8.3" AXIS_PTS_REF InjSys_ratAirM12Hpx_AX /end AXIS_DESCR
/end CHARACTERISTIC
/begin CHARACTERISTIC InjSys_P1V4I6_HP.agBgnWrmExtd_GM "injection packet 1 in variant 4 / ." MAP 0x8055F50C RB_MapGroup_U8 382.5 kw_q1p5 0.00 382.5 FORMAT "%5.1"
 /begin AXIS_DESCR COM_AXIS Epm_nEng EngN 12 0.00 16383.50 FORMAT "%8.2" EXTENDED_LIMITS -16384.00 16383.50 AXIS_PTS_REF InjSys_nEng12Hpx_AX /end AXIS_DESCR
 /begin AXIS_DESCR COM_AXIS InjSys_ratAirMAxisInp rel_uw_q0p0234 12 0.00 1535.977 FORMAT "%8.3" AXIS_PTS_REF InjSys_ratAirM12Hpx_AX /end AXIS_DESCR
/end CHARACTERISTIC
/begin CHARACTERISTIC InjSys_P1V4I6_HP.agBgnWrmSmlVlvEthnl_GM "injection packet 1 in variant 4 / ." MAP 0x8055F59C RB_MapGroup_U8 382.5 kw_q1p5 0.00 382.5 FORMAT "%5.1"
 /begin AXIS_DESCR COM_AXIS Epm_nEng EngN 12 0.00 16383.50 FORMAT "%8.2" EXTENDED_LIMITS -16384.00 16383.50 AXIS_PTS_REF InjSys_nEng12Hpx_AX /end AXIS_DESCR
 /begin AXIS_DESCR COM_AXIS InjSys_ratAirMAxisInp rel_uw_q0p0234 12 0.00 1535.977 FORMAT "%8.3" AXIS_PTS_REF InjSys_ratAirM12Hpx_AX /end AXIS_DESCR
/end CHARACTERISTIC
/begin CHARACTERISTIC InjSys_P1V4I6_HP.agBgnWrmSmlVlv_GM "injection packet 1 in variant 4 / ." MAP 0x8055F62C RB_MapGroup_U8 382.5 kw_q1p5 0.00 382.5 FORMAT "%5.1"
 /begin AXIS_DESCR COM_AXIS Epm_nEng EngN 12 0.00 16383.50 FORMAT "%8.2" EXTENDED_LIMITS -16384.00 16383.50 AXIS_PTS_REF InjSys_nEng12Hpx_AX /end AXIS_DESCR
 /begin AXIS_DESCR COM_AXIS InjSys_ratAirMAxisInp rel_uw_q0p0234 12 0.00 1535.977 FORMAT "%8.3" AXIS_PTS_REF InjSys_ratAirM12Hpx_AX /end AXIS_DESCR
/end CHARACTERISTIC
/begin CHARACTERISTIC InjSys_P1V4I6_HP.agDeltaEth_M "injection packet 1 in variant 4 / delta angle ethanol dependent" MAP 0x8055F6BC RB_Map_S16S16_S16 191.2500 kw_q0p75 -96.00000 95.25000 FORMAT "%8.5" EXTENDED_LIMITS -24576.00 24575.25
 /begin AXIS_DESCR STD_AXIS InjSys_facEthLnrLocSp fak_ub_b2 4 0.00 1.992188 FORMAT "%8.6" EXTENDED_LIMITS -256.0000 255.9922 DEPOSIT ABSOLUTE /end AXIS_DESCR
 /begin AXIS_DESCR STD_AXIS InjSys_tEng Temp_Cels 4 -3549.940 3003.560 FORMAT "%8.3" DEPOSIT ABSOLUTE /end AXIS_DESCR
/end CHARACTERISTIC
/begin CHARACTERISTIC InjSys_P1V4I6_HP.agDeltaLam_M "injection packet 1 in variant 4 / ." MAP 0x8055F6F0 RB_Map_S16U16_S16 191.2500 kw_q0p75 -96.00000 95.25000 FORMAT "%8.5" EXTENDED_LIMITS -24576.00 24575.25
 /begin AXIS_DESCR STD_AXIS Epm_nEng EngN 10 -16384.00 16383.50 FORMAT "%8.2" DEPOSIT ABSOLUTE /end AXIS_DESCR
 /begin AXIS_DESCR STD_AXIS InjSys_ratAirMPredLocSp kw_q0p0234 8 0.00 1535.977 FORMAT "%8.3" DEPOSIT ABSOLUTE /end AXIS_DESCR
/end CHARACTERISTIC
/begin CHARACTERISTIC InjSys_P1V4I6_HP.facAgBgnLam_T "injection packet 1 in variant 4 / ." CURVE 0x8055F7B8 RB_Curve_U8_U8 0.9961 fak_ub_b1 0.00 0.9961
 /begin AXIS_DESCR STD_AXIS InjSys_facLamBasLocSp fak_ub_b2 8 0.00 1.992188 FORMAT "%8.6" DEPOSIT ABSOLUTE /end AXIS_DESCR
/end CHARACTERISTIC
/begin CHARACTERISTIC InjSys_P1V4I6_HP.facEthnlAgBgn_T "injection packet 1 in variant 4 / ." CURVE 0x8055F7C9 RB_Curve_U8_U8 0.9961 fak_ub_b1 0.00 0.9961
 /begin AXIS_DESCR STD_AXIS fethstoeLocSp fak_ub_b2 4 0.00 1.992188 FORMAT "%8.6" DEPOSIT ABSOLUTE /end AXIS_DESCR
/end CHARACTERISTIC
/begin CHARACTERISTIC InjSys_P1V4I6_HP.facTPistCold_M "injection packet 1 in variant 4 / delta angle ethanol dependent" MAP 0x8055F7D2 RB_Map_S16S16_U8 0.9961 fak_ub_b1 0.00 0.9961
 /begin AXIS_DESCR STD_AXIS InjSys_tEng Temp_Cels 8 -3549.940 3003.560 FORMAT "%8.3" DEPOSIT ABSOLUTE /end AXIS_DESCR
 /begin AXIS_DESCR STD_AXIS InjSys_tOilLocSp Temp_Cels 8 -3549.940 3003.560 FORMAT "%8.3" DEPOSIT ABSOLUTE /end AXIS_DESCR
/end CHARACTERISTIC
/begin CHARACTERISTIC InjSys_P1V4I6_HP.facTPist_M "injection packet 1 in variant 4 / weighting factor base angle in homogenous-split mode temperature dependent" MAP 0x8055F836 RB_Map_S16S16_U8 0.9961 fak_ub_b1 0.00 0.9961
 /begin AXIS_DESCR STD_AXIS InjSys_tPistBas Temp_Cels 6 -3549.940 3003.560 FORMAT "%8.3" DEPOSIT ABSOLUTE /end AXIS_DESCR
 /begin AXIS_DESCR STD_AXIS InjSys_tPistDelta temp_q0p1 6 -3276.800 3276.700 FORMAT "%8.3" DEPOSIT ABSOLUTE /end AXIS_DESCR
/end CHARACTERISTIC
/begin AXIS_PTS InjSys_ratAirM08_AX "base point distribution relative air mass with 8 base points" 0x805580B8 InjSys_ratAirMAxisInp RB_Axis_U16 1535.977 rel_uw_q0p0234 8 0.00 1535.977 FORMAT "%8.3" DEPOSIT ABSOLUTE /end AXIS_PTS
/begin AXIS_PTS InjSys_ratAirM12AgSpHspVers2_AX "base point distribution relative air mass with 12 base points (Version 2 HSP Mode)" 0x805580CA InjSys_ratAirMAgSpVers2AxisInp RB_Axis_U16 1535.977 rel_uw_q0p0234 12 0.00 1535.977 FORMAT "%8.3" DEPOSIT ABSOLUTE /end AXIS_PTS
/begin AXIS_PTS InjSys_ratAirM12AgSpHsp_AX "base point distribution relative air mass with 12 base points (HSP Mode)" 0x805580E4 InjSys_ratAirMAgSpAxisInp RB_Axis_U16 1535.977 rel_uw_q0p0234 12 0.00 1535.977 FORMAT "%8.3" DEPOSIT ABSOLUTE /end AXIS_PTS
/begin AXIS_PTS InjSys_ratAirM12AgSpVers2_AX "base point distribution relative air mass with 12 base points" 0x805580FE InjSys_ratAirMAgSpVers2AxisInp RB_Axis_U16 1535.977 rel_uw_q0p0234 12 0.00 1535.977 FORMAT "%8.3" DEPOSIT ABSOLUTE /end AXIS_PTS
/begin AXIS_PTS InjSys_ratAirM12AgSp_AX "base point distribution relative air mass with 12 base points" 0x80558118 InjSys_ratAirMAgSpAxisInp RB_Axis_U16 1535.977 rel_uw_q0p0234 12 0.00 1535.977 FORMAT "%8.3" DEPOSIT ABSOLUTE /end AXIS_PTS
/begin AXIS_PTS InjSys_ratAirM12Hpx_AX "base point distribution relative air mass HPx with 12 base points" 0x80558132 InjSys_ratAirMAxisInp RB_Axis_U16 1535.977 rel_uw_q0p0234 12 0.00 1535.977 FORMAT "%8.3" DEPOSIT ABSOLUTE /end AXIS_PTS
/begin AXIS_PTS InjSys_ratAirM12Vers2_AX "base point distribution relative air mass with 12 base points" 0x8055814C InjSys_ratAirMVers2AxisInp RB_Axis_U16 1535.977 rel_uw_q0p0234 12 0.00 1535.977 FORMAT "%8.3" DEPOSIT ABSOLUTE /end AXIS_PTS
/begin AXIS_PTS InjSys_ratAirM12_AX "base point distribution relative air mass with 12 base points" 0x80558166 InjSys_ratAirMAxisInp RB_Axis_U16 1535.977 rel_uw_q0p0234 12 0.00 1535.977 FORMAT "%8.3" DEPOSIT ABSOLUTE /end AXIS_PTS
/begin AXIS_PTS InjSys_tEngStrt08_AX "Base point distribution for engine temperature at start with 8 base points" 0x805581AC InjSys_tEngStrt RB_Axis_S16 6553.500 Temp_Cels 8 -3549.940 3003.560 FORMAT "%8.3" DEPOSIT ABSOLUTE /end AXIS_PTS
/begin FUNCTION InjSyG_InjSp "159.0.0   Injection Setpoints"
 /begin DEF_CHARACTERISTIC InjSys_P1APPL.agBas_C InjSys_P1APPL.facSpltAux1_C InjSys_P1APPL.facSpltAux2_C InjSys_P1APPL.facSpltAux_C InjSys_P1APPL.flgAbsltSplt_C InjSys_P1APPL.flgAgAux_C InjSys_P1APPL.flgSpltAux_C InjSys_P1APPL.ratFuMAux1_C InjSys_P1APPL.ratFuMAux2_C InjSys_P1APPL.ratFuMBas_C InjSys_P1APPL.stAgEnd_C InjSys_P1APPL.tiBreakAux1_C InjSys_P1APPL.tiBreakAux2_C InjSys_P1V1I1_HO.agBasTPistColdVers2_GM InjSys_P1V1I1_HO.agBasTPistCold_GM InjSys_P1V1I1_HO.agBasTPistWrmVers2_GM InjSys_P1V1I1_HO.agBasTPistWrm_GM InjSys_P1V1I1_HO.agBgnColdExtdEthnl_GM InjSys_P1V1I1_HO.agBgnColdExtd_GM InjSys_P1V1I1_HO.agBgnColdSmlVlvEthnl_GM InjSys_P1V1I1_HO.agBgnColdSmlVlv_GM InjSys_P1V1I1_HO.agBgnWrmExtdEthnl_GM InjSys_P1V1I1_HO.agBgnWrmExtd_GM InjSys_P1V1I1_HO.agBgnWrmSmlVlvEthnl_GM InjSys_P1V1I1_HO.agBgnWrmSmlVlv_GM InjSys_P1V1I1_HO.agDeltaEth_M InjSys_P1V1I1_HO.agDeltaLamBasCold_M InjSys_P1V1I1_HO.agDeltaLamBasWrm_M InjSys_P1V1I1_HO.agDeltaLam_M InjSys_P1V1I1_HO.agDeltaTEngOilVers2_GM InjSys_P1V1I1_HO.agDeltaTEngOil_GM InjSys_P1V1I1_HO.facAgBgnLam_T InjSys_P1V1I1_HO.facEthnlAgBgn_T InjSys_P1V1I1_HO.facTPistCold_M InjSys_P1V1I1_HO.facTPist_M InjSys_P1V1I1_HO.facWghtAgDeltaLamBasCold_T InjSys_P1V1I1_HO.facWghtAgDeltaLamBasWrm_T InjSys_P1V1I1_HO.facWghtColdWrmEthnl_M InjSys_P1V1I1_HO.facWghtColdWrm_M InjSys_P1V1I1_HO.facWghtWrmCold_M InjSys_P1V1I1_HO.flgAxVers_C InjSys_P1V1I2_HO.agBasTPistColdVers2_GM InjSys_P1V1I2_HO.agBasTPistCold_GM InjSys_P1V1I2_HO.agBasTPistWrmVers2_GM InjSys_P1V1I2_HO.agBasTPistWrm_GM InjSys_P1V1I2_HO.agBgnColdExtdEthnl_GM InjSys_P1V1I2_HO.agBgnColdExtd_GM InjSys_P1V1I2_HO.agBgnColdSmlVlvEthnl_GM InjSys_P1V1I2_HO.agBgnColdSmlVlv_GM InjSys_P1V1I2_HO.agBgnWrmExtdEthnl_GM InjSys_P1V1I2_HO.agBgnWrmExtd_GM InjSys_P1V1I2_HO.agBgnWrmSmlVlvEthnl_GM InjSys_P1V1I2_HO.agBgnWrmSmlVlv_GM InjSys_P1V1I2_HO.agDeltaEth_M InjSys_P1V1I2_HO.agDeltaLamBasCold_M InjSys_P1V1I2_HO.agDeltaLamBasWrm_M InjSys_P1V1I2_HO.agDeltaLam_M InjSys_P1V1I2_HO.agDeltaTEngOilVers2_GM InjSys_P1V1I2_HO.agDeltaTEngOil_GM InjSys_P1V1I2_HO.facAgBgnLam_T InjSys_P1V1I2_HO.facEthnlAgBgn_T InjSys_P1V1I2_HO.facTPistCold_M InjSys_P1V1I2_HO.facTPist_M InjSys_P1V1I2_HO.facWghtAgDeltaLamBasCold_T InjSys_P1V1I2_HO.facWghtAgDeltaLamBasWrm_T InjSys_P1V1I2_HO.facWghtColdWrmEthnl_M InjSys_P1V1I2_HO.facWghtColdWrm_M InjSys_P1V1I2_HO.facWghtWrmCold_M InjSys_P1V1I2_HO.flgAxVers_C InjSys_P1V2I1_HO.agBasTPistColdVers2_GM InjSys_P1V2I1_HO.agBasTPistCold_GM InjSys_P1V2I1_HO.agBasTPistWrmVers2_GM InjSys_P1V2I1_HO.agBasTPistWrm_GM InjSys_P1V2I1_HO.agBgnColdExtdEthnl_GM InjSys_P1V2I1_HO.agBgnColdExtd_GM InjSys_P1V2I1_HO.agBgnColdSmlVlvEthnl_GM InjSys_P1V2I1_HO.agBgnColdSmlVlv_GM InjSys_P1V2I1_HO.agBgnWrmExtdEthnl_GM InjSys_P1V2I1_HO.agBgnWrmExtd_GM InjSys_P1V2I1_HO.agBgnWrmSmlVlvEthnl_GM InjSys_P1V2I1_HO.agBgnWrmSmlVlv_GM InjSys_P1V2I1_HO.agDeltaEth_M InjSys_P1V2I1_HO.agDeltaLamBasCold_M InjSys_P1V2I1_HO.agDeltaLamBasWrm_M InjSys_P1V2I1_HO.agDeltaLam_M InjSys_P1V2I1_HO.agDeltaTEngOilVers2_GM InjSys_P1V2I1_HO.agDeltaTEngOil_GM InjSys_P1V2I1_HO.facAgBgnLam_T InjSys_P1V2I1_HO.facEthnlAgBgn_T InjSys_P1V2I1_HO.facSpltAux1Extd_GM InjSys_P1V2I1_HO.facSpltAux1_GM InjSys_P1V2I1_HO.facTPistCold_M InjSys_P1V2I1_HO.facTPist_M InjSys_P1V2I1_HO.facWghtAgDeltaLamBasCold_T InjSys_P1V2I1_HO.facWghtAgDeltaLamBasWrm_T InjSys_P1V2I1_HO.facWghtColdWrmEthnl_M InjSys_P1V2I1_HO.facWghtColdWrm_M InjSys_P1V2I1_HO.facWghtWrmCold_M InjSys_P1V2I1_HO.flgAbsltSplt_C InjSys_P1V2I1_HO.flgAxVers_C InjSys_P1V2I1_HO.flgPltInj_C InjSys_P1V2I1_HO.ratFuMAux1_GM InjSys_P1V2I1_HO.ratFuMBasExtd_GM InjSys_P1V2I1_HO.ratFuMBas_GM InjSys_P1V2I1_HO.stDiTiBreakAux_C InjSys_P1V2I1_HO.tiBreakAux1_M InjSys_P1V2I2_HO.agBasTPistColdVers2_GM InjSys_P1V2I2_HO.agBasTPistCold_GM InjSys_P1V2I2_HO.agBasTPistWrmVers2_GM InjSys_P1V2I2_HO.agBasTPistWrm_GM InjSys_P1V2I2_HO.agBgnColdExtdEthnl_GM InjSys_P1V2I2_HO.agBgnColdExtd_GM InjSys_P1V2I2_HO.agBgnColdSmlVlvEthnl_GM InjSys_P1V2I2_HO.agBgnColdSmlVlv_GM InjSys_P1V2I2_HO.agBgnWrmExtdEthnl_GM InjSys_P1V2I2_HO.agBgnWrmExtd_GM InjSys_P1V2I2_HO.agBgnWrmSmlVlvEthnl_GM InjSys_P1V2I2_HO.agBgnWrmSmlVlv_GM InjSys_P1V2I2_HO.agDeltaEth_M InjSys_P1V2I2_HO.agDeltaLamBasCold_M InjSys_P1V2I2_HO.agDeltaLamBasWrm_M InjSys_P1V2I2_HO.agDeltaLam_M InjSys_P1V2I2_HO.agDeltaTEngOilVers2_GM InjSys_P1V2I2_HO.agDeltaTEngOil_GM InjSys_P1V2I2_HO.facAgBgnLam_T InjSys_P1V2I2_HO.facEthnlAgBgn_T InjSys_P1V2I2_HO.facSpltAux1Extd_GM InjSys_P1V2I2_HO.facSpltAux1_GM InjSys_P1V2I2_HO.facTPistCold_M InjSys_P1V2I2_HO.facTPist_M InjSys_P1V2I2_HO.facWghtAgDeltaLamBasCold_T InjSys_P1V2I2_HO.facWghtAgDeltaLamBasWrm_T InjSys_P1V2I2_HO.facWghtColdWrmEthnl_M InjSys_P1V2I2_HO.facWghtColdWrm_M InjSys_P1V2I2_HO.facWghtWrmCold_M InjSys_P1V2I2_HO.flgAbsltSplt_C InjSys_P1V2I2_HO.flgAxVers_C InjSys_P1V2I2_HO.flgPltInj_C InjSys_P1V2I2_HO.ratFuMAux1_GM InjSys_P1V2I2_HO.ratFuMBasExtd_GM InjSys_P1V2I2_HO.ratFuMBas_GM InjSys_P1V2I2_HO.stDiTiBreakAux_C InjSys_P1V2I2_HO.tiBreakAux1_M InjSys_P1V3I1_HO.agBasTPistColdVers2_GM InjSys_P1V3I1_HO.agBasTPistCold_GM InjSys_P1V3I1_HO.agBasTPistWrmVers2_GM InjSys_P1V3I1_HO.agBasTPistWrm_GM InjSys_P1V3I1_HO.agBgnColdExtdEthnl_GM InjSys_P1V3I1_HO.agBgnColdExtd_GM InjSys_P1V3I1_HO.agBgnColdSmlVlvEthnl_GM InjSys_P1V3I1_HO.agBgnColdSmlVlv_GM InjSys_P1V3I1_HO.agBgnWrmExtdEthnl_GM InjSys_P1V3I1_HO.agBgnWrmExtd_GM InjSys_P1V3I1_HO.agBgnWrmSmlVlvWEthnl_GM InjSys_P1V3I1_HO.agBgnWrmSmlVlv_GM InjSys_P1V3I1_HO.agDeltaEth_M InjSys_P1V3I1_HO.agDeltaLamBasCold_M InjSys_P1V3I1_HO.agDeltaLamBasWrm_M InjSys_P1V3I1_HO.agDeltaLam_M InjSys_P1V3I1_HO.agDeltaTEngOilVers2_GM InjSys_P1V3I1_HO.agDeltaTEngOil_GM InjSys_P1V3I1_HO.facAgBgnLam_T InjSys_P1V3I1_HO.facEthnlAgBgn_T InjSys_P1V3I1_HO.facSpltAux1Extd_GM InjSys_P1V3I1_HO.facSpltAux1_GM InjSys_P1V3I1_HO.facSpltAux2Extd_GM InjSys_P1V3I1_HO.facSpltAux2_GM InjSys_P1V3I1_HO.facTPistCold_M InjSys_P1V3I1_HO.facTPist_M InjSys_P1V3I1_HO.facWghtAgDeltaLamBasCold_T InjSys_P1V3I1_HO.facWghtAgDeltaLamBasWrm_T InjSys_P1V3I1_HO.facWghtColdWrmEthnl_M InjSys_P1V3I1_HO.facWghtColdWrm_M InjSys_P1V3I1_HO.facWghtWrmCold_M InjSys_P1V3I1_HO.flgAbsltSplt_C InjSys_P1V3I1_HO.flgAxVers_C InjSys_P1V3I1_HO.flgPltInj_C InjSys_P1V3I1_HO.ratFuMAux1_GM InjSys_P1V3I1_HO.ratFuMAux2_GM InjSys_P1V3I1_HO.ratFuMBasExtd_GM InjSys_P1V3I1_HO.ratFuMBas_GM InjSys_P1V3I1_HO.stDiTiBreakAux_C InjSys_P1V3I1_HO.tiBreakAux1_M InjSys_P1V3I1_HO.tiBreakAux2_M InjSys_P1V3I2_HO.agBasTPistColdVers2_GM InjSys_P1V3I2_HO.agBasTPistCold_GM InjSys_P1V3I2_HO.agBasTPistWrmVers2_GM InjSys_P1V3I2_HO.agBasTPistWrm_GM InjSys_P1V3I2_HO.agBgnColdExtdEthnl_GM InjSys_P1V3I2_HO.agBgnColdExtd_GM InjSys_P1V3I2_HO.agBgnColdSmlVlvEthnl_GM InjSys_P1V3I2_HO.agBgnColdSmlVlv_GM InjSys_P1V3I2_HO.agBgnWrmExtdEthnl_GM InjSys_P1V3I2_HO.agBgnWrmExtd_GM InjSys_P1V3I2_HO.agBgnWrmSmlVlvWEthnl_GM InjSys_P1V3I2_HO.agBgnWrmSmlVlv_GM InjSys_P1V3I2_HO.agDeltaEth_M InjSys_P1V3I2_HO.agDeltaLamBasCold_M InjSys_P1V3I2_HO.agDeltaLamBasWrm_M InjSys_P1V3I2_HO.agDeltaLam_M InjSys_P1V3I2_HO.agDeltaTEngOilVers2_GM InjSys_P1V3I2_HO.agDeltaTEngOil_GM InjSys_P1V3I2_HO.facAgBgnLam_T InjSys_P1V3I2_HO.facEthnlAgBgn_T InjSys_P1V3I2_HO.facSpltAux1Extd_GM InjSys_P1V3I2_HO.facSpltAux1_GM InjSys_P1V3I2_HO.facSpltAux2Extd_GM InjSys_P1V3I2_HO.facSpltAux2_GM InjSys_P1V3I2_HO.facTPistCold_M InjSys_P1V3I2_HO.facTPist_M InjSys_P1V3I2_HO.facWghtAgDeltaLamBasCold_T InjSys_P1V3I2_HO.facWghtAgDeltaLamBasWrm_T InjSys_P1V3I2_HO.facWghtColdWrmEthnl_M InjSys_P1V3I2_HO.facWghtColdWrm_M InjSys_P1V3I2_HO.facWghtWrmCold_M InjSys_P1V3I2_HO.flgAbsltSplt_C InjSys_P1V3I2_HO.flgAxVers_C InjSys_P1V3I2_HO.flgPltInj_C InjSys_P1V3I2_HO.ratFuMAux1_GM InjSys_P1V3I2_HO.ratFuMAux2_GM InjSys_P1V3I2_HO.ratFuMBasExtd_GM InjSys_P1V3I2_HO.ratFuMBas_GM InjSys_P1V3I2_HO.stDiTiBreakAux_C InjSys_P1V3I2_HO.tiBreakAux1_M InjSys_P1V3I2_HO.tiBreakAux2_M InjSys_P1V4I1_HP.agBasHspHiVers2_GM InjSys_P1V4I1_HP.agBasHspHi_GM InjSys_P1V4I1_HP.agBasHspLoVers2_GM InjSys_P1V4I1_HP.agBasHspLo_GM InjSys_P1V4I1_HP.agBasTPistColdVers2_GM InjSys_P1V4I1_HP.agBasTPistCold_GM InjSys_P1V4I1_HP.agBasTPistWrmVers2_GM InjSys_P1V4I1_HP.agBasTPistWrm_GM InjSys_P1V4I1_HP.agBgnColdExtdEthnl_GM InjSys_P1V4I1_HP.agBgnColdExtd_GM InjSys_P1V4I1_HP.agBgnColdSmlVlvEthnl_GM InjSys_P1V4I1_HP.agBgnColdSmlVlv_GM InjSys_P1V4I1_HP.agBgnWrmExtdEthnl_GM InjSys_P1V4I1_HP.agBgnWrmExtd_GM InjSys_P1V4I1_HP.agBgnWrmSmlVlvEthnl_GM InjSys_P1V4I1_HP.agBgnWrmSmlVlv_GM InjSys_P1V4I1_HP.agDeltaEth_M InjSys_P1V4I1_HP.agDeltaLam_M InjSys_P1V4I1_HP.facAgBgnLam_T InjSys_P1V4I1_HP.facEthnlAgBgn_T InjSys_P1V4I1_HP.facTPistCold_M InjSys_P1V4I1_HP.facTPist_M InjSys_P1V4I1_HP.facWghtColdWrmEthnl_M InjSys_P1V4I1_HP.facWghtColdWrm_M InjSys_P1V4I1_HP.facWghtTHsp_M InjSys_P1V4I1_HP.facWhgtWrmColdHsp_GM InjSys_P1V4I1_HP.flgAxVers_C InjSys_P1V4I2_HP.agBasHspHiVers2_GM InjSys_P1V4I2_HP.agBasHspHi_GM InjSys_P1V4I2_HP.agBasHspLoVers2_GM InjSys_P1V4I2_HP.agBasHspLo_GM InjSys_P1V4I2_HP.agBasTPistColdVers2_GM InjSys_P1V4I2_HP.agBasTPistCold_GM InjSys_P1V4I2_HP.agBasTPistWrmVers2_GM InjSys_P1V4I2_HP.agBasTPistWrm_GM InjSys_P1V4I2_HP.agBgnColdExtdEthnl_GM InjSys_P1V4I2_HP.agBgnColdExtd_GM InjSys_P1V4I2_HP.agBgnColdSmlVlvEthnl_GM InjSys_P1V4I2_HP.agBgnColdSmlVlv_GM InjSys_P1V4I2_HP.agBgnWrmExtdEthnl_GM InjSys_P1V4I2_HP.agBgnWrmExtd_GM InjSys_P1V4I2_HP.agBgnWrmSmlVlvEthnl_GM InjSys_P1V4I2_HP.agBgnWrmSmlVlv_GM InjSys_P1V4I2_HP.agDeltaEth_M InjSys_P1V4I2_HP.agDeltaLam_M InjSys_P1V4I2_HP.facAgBgnLam_T InjSys_P1V4I2_HP.facEthnlAgBgn_T InjSys_P1V4I2_HP.facTPistCold_M InjSys_P1V4I2_HP.facTPist_M InjSys_P1V4I2_HP.facWghtColdWrmEthnl_M InjSys_P1V4I2_HP.facWghtColdWrm_M InjSys_P1V4I2_HP.facWghtTHsp_M InjSys_P1V4I2_HP.facWhgtWrmColdHsp_GM InjSys_P1V4I2_HP.flgAxVers_C InjSys_P1V4I3_HP.agBasHspHiVers2_GM InjSys_P1V4I3_HP.agBasHspHi_GM InjSys_P1V4I3_HP.agBasHspLoVers2_GM InjSys_P1V4I3_HP.agBasHspLo_GM InjSys_P1V4I3_HP.agBasTPistColdVers2_GM InjSys_P1V4I3_HP.agBasTPistCold_GM InjSys_P1V4I3_HP.agBasTPistWrmVers2_GM InjSys_P1V4I3_HP.agBasTPistWrm_GM InjSys_P1V4I3_HP.agBgnColdExtdEthnl_GM InjSys_P1V4I3_HP.agBgnColdExtd_GM InjSys_P1V4I3_HP.agBgnColdSmlVlvEthnl_GM InjSys_P1V4I3_HP.agBgnColdSmlVlv_GM InjSys_P1V4I3_HP.agBgnWrmExtdEthnl_GM InjSys_P1V4I3_HP.agBgnWrmExtd_GM InjSys_P1V4I3_HP.agBgnWrmSmlVlvEthnl_GM InjSys_P1V4I3_HP.agBgnWrmSmlVlv_GM InjSys_P1V4I3_HP.agDeltaEth_M InjSys_P1V4I3_HP.agDeltaLam_M InjSys_P1V4I3_HP.facAgBgnLam_T InjSys_P1V4I3_HP.facEthnlAgBgn_T InjSys_P1V4I3_HP.facTPistCold_M InjSys_P1V4I3_HP.facTPist_M InjSys_P1V4I3_HP.facWghtColdWrmEthnl_M InjSys_P1V4I3_HP.facWghtColdWrm_M InjSys_P1V4I3_HP.facWghtTHsp_M InjSys_P1V4I3_HP.facWhgtWrmColdHsp_GM InjSys_P1V4I3_HP.flgAxVers_C InjSys_P1V4I4_HP.agBasHspHiVers2_GM InjSys_P1V4I4_HP.agBasHspHi_GM InjSys_P1V4I4_HP.agBasHspLoVers2_GM InjSys_P1V4I4_HP.agBasHspLo_GM InjSys_P1V4I4_HP.agBasTPistColdVers2_GM InjSys_P1V4I4_HP.agBasTPistCold_GM InjSys_P1V4I4_HP.agBasTPistWrmVers2_GM InjSys_P1V4I4_HP.agBasTPistWrm_GM InjSys_P1V4I4_HP.agBgnColdExtdEthnl_GM InjSys_P1V4I4_HP.agBgnColdExtd_GM InjSys_P1V4I4_HP.agBgnColdSmlVlvEthnl_GM InjSys_P1V4I4_HP.agBgnColdSmlVlv_GM InjSys_P1V4I4_HP.agBgnWrmExtdEthnl_GM InjSys_P1V4I4_HP.agBgnWrmExtd_GM InjSys_P1V4I4_HP.agBgnWrmSmlVlvEthnl_GM InjSys_P1V4I4_HP.agBgnWrmSmlVlv_GM InjSys_P1V4I4_HP.agDeltaEth_M InjSys_P1V4I4_HP.agDeltaLam_M InjSys_P1V4I4_HP.facAgBgnLam_T InjSys_P1V4I4_HP.facEthnlAgBgn_T InjSys_P1V4I4_HP.facTPistCold_M InjSys_P1V4I4_HP.facTPist_M InjSys_P1V4I4_HP.facWghtColdWrmEthnl_M InjSys_P1V4I4_HP.facWghtColdWrm_M InjSys_P1V4I4_HP.facWghtTHsp_M InjSys_P1V4I4_HP.facWhgtWrmColdHsp_GM InjSys_P1V4I4_HP.flgAxVers_C InjSys_P1V4I5_HP.agBasHspHiVers2_GM InjSys_P1V4I5_HP.agBasHspHi_GM InjSys_P1V4I5_HP.agBasHspLoVers2_GM InjSys_P1V4I5_HP.agBasHspLo_GM InjSys_P1V4I5_HP.agBasTPistColdVers2_GM InjSys_P1V4I5_HP.agBasTPistCold_GM InjSys_P1V4I5_HP.agBasTPistWrmVers2_GM InjSys_P1V4I5_HP.agBasTPistWrm_GM InjSys_P1V4I5_HP.agBgnColdExtdEthnl_GM InjSys_P1V4I5_HP.agBgnColdExtd_GM InjSys_P1V4I5_HP.agBgnColdSmlVlvEthnl_GM InjSys_P1V4I5_HP.agBgnColdSmlVlv_GM InjSys_P1V4I5_HP.agBgnWrmExtdEthnl_GM InjSys_P1V4I5_HP.agBgnWrmExtd_GM InjSys_P1V4I5_HP.agBgnWrmSmlVlvEthnl_GM InjSys_P1V4I5_HP.agBgnWrmSmlVlv_GM InjSys_P1V4I5_HP.agDeltaEth_M InjSys_P1V4I5_HP.agDeltaLam_M InjSys_P1V4I5_HP.facAgBgnLam_T InjSys_P1V4I5_HP.facEthnlAgBgn_T InjSys_P1V4I5_HP.facTPistCold_M InjSys_P1V4I5_HP.facTPist_M InjSys_P1V4I5_HP.facWghtColdWrmEthnl_M InjSys_P1V4I5_HP.facWghtColdWrm_M InjSys_P1V4I5_HP.facWghtTHsp_M InjSys_P1V4I5_HP.facWhgtWrmColdHsp_GM InjSys_P1V4I5_HP.flgAxVers_C InjSys_P1V4I6_HP.agBasHspHiVers2_GM InjSys_P1V4I6_HP.agBasHspHi_GM InjSys_P1V4I6_HP.agBasHspLoVers2_GM InjSys_P1V4I6_HP.agBasHspLo_GM InjSys_P1V4I6_HP.agBasTPistColdVers2_GM InjSys_P1V4I6_HP.agBasTPistCold_GM InjSys_P1V4I6_HP.agBasTPistWrmVers2_GM InjSys_P1V4I6_HP.agBasTPistWrm_GM InjSys_P1V4I6_HP.agBgnColdExtdEthnl_GM InjSys_P1V4I6_HP.agBgnColdExtd_GM InjSys_P1V4I6_HP.agBgnColdSmlVlvEthnl_GM InjSys_P1V4I6_HP.agBgnColdSmlVlv_GM InjSys_P1V4I6_HP.agBgnWrmExtdEthnl_GM InjSys_P1V4I6_HP.agBgnWrmExtd_GM InjSys_P1V4I6_HP.agBgnWrmSmlVlvEthnl_GM InjSys_P1V4I6_HP.agBgnWrmSmlVlv_GM InjSys_P1V4I6_HP.agDeltaEth_M InjSys_P1V4I6_HP.agDeltaLam_M InjSys_P1V4I6_HP.facAgBgnLam_T InjSys_P1V4I6_HP.facEthnlAgBgn_T InjSys_P1V4I6_HP.facTPistCold_M InjSys_P1V4I6_HP.facTPist_M /end DEF_CHARACTERISTIC
 FUNCTION_VERSION "159.0.0" /end FUNCTION
/begin COMPU_METHOD B_TRUE "" TAB_VERB "%6.3" "" COMPU_TAB_REF B_TRUE /end COMPU_METHOD
/begin COMPU_VTAB B_TRUE "" TAB_VERB 2 0 "FALSE" 1 "TRUE" /end COMPU_VTAB
/begin COMPU_METHOD dez "" RAT_FUNC "%6.2" "" COEFFS 0 1 0 0 0 1 /end COMPU_METHOD
/begin COMPU_METHOD EngN "" RAT_FUNC "%6.3" "rpm" COEFFS 0 2 0 0 0 1 /end COMPU_METHOD
/begin COMPU_METHOD fak_ub_b1 "" RAT_FUNC "%6.4" "-" COEFFS 0 256 0 0 0 1 /end COMPU_METHOD
/begin COMPU_METHOD fak_ub_b2 "" RAT_FUNC "%8.5" "-" COEFFS 0 256 0 0 0 2 /end COMPU_METHOD
/begin COMPU_METHOD fak_uw_b2 "" RAT_FUNC "%7.6" "-" COEFFS 0 65536 0 0 0 2 /end COMPU_METHOD
/begin COMPU_METHOD kw_q0p0234 "" RAT_FUNC "%6.4" "Grad KW" COEFFS 0 32768 0 0 0 768 /end COMPU_METHOD
/begin COMPU_METHOD kw_q0p75 "" RAT_FUNC "%6.3" "Grad KW" COEFFS 0 4 0 0 0 3 /end COMPU_METHOD
/begin COMPU_METHOD kw_q0p75_o240 "" RAT_FUNC "%6.1" "Grad KW" COEFFS 0 4 -960 0 0 3 /end COMPU_METHOD
/begin COMPU_METHOD kw_q1p5 "" RAT_FUNC "%6.2" "deg KW" COEFFS 0 256 0 0 0 384 /end COMPU_METHOD
/begin COMPU_METHOD rel_uw_b3072 "" RAT_FUNC "%6.4" "%" COEFFS 0 65536 0 0 0 3072 /end COMPU_METHOD
/begin COMPU_METHOD rel_uw_q0p0234 "" RAT_FUNC "%6.4" "%" COEFFS 0 32 0 0 0 0.75 /end COMPU_METHOD
/begin COMPU_METHOD Temp_Cels "" RAT_FUNC "%6.1" "deg C" COEFFS 0 10 2731.4 0 0 1 /end COMPU_METHOD
/begin COMPU_METHOD temp_q0p1 "" RAT_FUNC "%6.3" "Grad C" COEFFS 0 10 0 0 0 1 /end COMPU_METHOD
/begin COMPU_METHOD t_q0p04_ms "" RAT_FUNC "%6.4" "ms" COEFFS 0 1 0 0 0 0.04 /end COMPU_METHOD
/begin RECORD_LAYOUT RB_Axis_S16 NO_AXIS_PTS_X 1 SWORD AXIS_PTS_X 2 SWORD INDEX_INCR DIRECT /end RECORD_LAYOUT
/begin RECORD_LAYOUT RB_Axis_U16 NO_AXIS_PTS_X 1 UWORD AXIS_PTS_X 2 UWORD INDEX_INCR DIRECT /end RECORD_LAYOUT
/begin RECORD_LAYOUT RB_Curve_U8_U8 NO_AXIS_PTS_X 1 UBYTE AXIS_PTS_X 2 UBYTE INDEX_INCR DIRECT FNC_VALUES 3 UBYTE COLUMN_DIR DIRECT /end RECORD_LAYOUT
/begin RECORD_LAYOUT RB_MapGroup_S8 FNC_VALUES 1 SBYTE COLUMN_DIR DIRECT /end RECORD_LAYOUT
/begin RECORD_LAYOUT RB_MapGroup_U16 FNC_VALUES 1 UWORD COLUMN_DIR DIRECT /end RECORD_LAYOUT
/begin RECORD_LAYOUT RB_MapGroup_U8 FNC_VALUES 1 UBYTE COLUMN_DIR DIRECT /end RECORD_LAYOUT
/begin RECORD_LAYOUT RB_Map_S16S16_S16 NO_AXIS_PTS_X 1 SWORD NO_AXIS_PTS_Y 2 SWORD AXIS_PTS_X 3 SWORD INDEX_INCR DIRECT AXIS_PTS_Y 4 SWORD INDEX_INCR DIRECT FNC_VALUES 5 SWORD COLUMN_DIR DIRECT /end RECORD_LAYOUT
/begin RECORD_LAYOUT RB_Map_S16S16_U8 NO_AXIS_PTS_X 1 SWORD NO_AXIS_PTS_Y 2 SWORD AXIS_PTS_X 3 SWORD INDEX_INCR DIRECT AXIS_PTS_Y 4 SWORD INDEX_INCR DIRECT FNC_VALUES 5 UBYTE COLUMN_DIR DIRECT /end RECORD_LAYOUT
/begin RECORD_LAYOUT RB_Map_S16U16_S16 NO_AXIS_PTS_X 1 SWORD NO_AXIS_PTS_Y 2 SWORD AXIS_PTS_X 3 SWORD INDEX_INCR DIRECT AXIS_PTS_Y 4 UWORD INDEX_INCR DIRECT FNC_VALUES 5 SWORD ROW_DIR DIRECT /end RECORD_LAYOUT
/begin RECORD_LAYOUT RB_Val_Ws16 FNC_VALUES 1 SWORD COLUMN_DIR DIRECT /end RECORD_LAYOUT
/begin RECORD_LAYOUT RB_Val_Wu16 FNC_VALUES 1 UWORD COLUMN_DIR DIRECT /end RECORD_LAYOUT
/begin RECORD_LAYOUT RB_Val_Wu8 FNC_VALUES 1 UBYTE COLUMN_DIR DIRECT /end RECORD_LAYOUT
/end MODULE
/end PROJECT
